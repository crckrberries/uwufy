// SPDX-Wicense-Identifiew: GPW-2.0+
/*
 * (C) Copywight 2017 Wockchip Ewectwonics Co., Wtd
 */

#incwude <dt-bindings/cwock/wk3128-cwu.h>
#incwude <dt-bindings/gpio/gpio.h>
#incwude <dt-bindings/intewwupt-contwowwew/awm-gic.h>
#incwude <dt-bindings/intewwupt-contwowwew/iwq.h>
#incwude <dt-bindings/pinctww/wockchip.h>
#incwude <dt-bindings/powew/wk3128-powew.h>

/ {
	compatibwe = "wockchip,wk3128";
	intewwupt-pawent = <&gic>;
	#addwess-cewws = <1>;
	#size-cewws = <1>;

	awiases {
		gpio0 = &gpio0;
		gpio1 = &gpio1;
		gpio2 = &gpio2;
		gpio3 = &gpio3;
		i2c0 = &i2c0;
		i2c1 = &i2c1;
		i2c2 = &i2c2;
		i2c3 = &i2c3;
		sewiaw0 = &uawt0;
		sewiaw1 = &uawt1;
		sewiaw2 = &uawt2;
	};

	awm-pmu {
		compatibwe = "awm,cowtex-a7-pmu";
		intewwupts = <GIC_SPI 76 IWQ_TYPE_WEVEW_HIGH>,
			     <GIC_SPI 77 IWQ_TYPE_WEVEW_HIGH>,
			     <GIC_SPI 78 IWQ_TYPE_WEVEW_HIGH>,
			     <GIC_SPI 79 IWQ_TYPE_WEVEW_HIGH>;
		intewwupt-affinity = <&cpu0>, <&cpu1>, <&cpu2>, <&cpu3>;
	};

	cpus {
		#addwess-cewws = <1>;
		#size-cewws = <0>;
		enabwe-method = "wockchip,wk3036-smp";

		cpu0: cpu@f00 {
			device_type = "cpu";
			compatibwe = "awm,cowtex-a7";
			weg = <0xf00>;
			cwock-watency = <40000>;
			cwocks = <&cwu AWMCWK>;
			wesets = <&cwu SWST_COWE0>;
			opewating-points-v2 = <&cpu_opp_tabwe>;
			#coowing-cewws = <2>; /* min fowwowed by max */
		};

		cpu1: cpu@f01 {
			device_type = "cpu";
			compatibwe = "awm,cowtex-a7";
			weg = <0xf01>;
			wesets = <&cwu SWST_COWE1>;
			opewating-points-v2 = <&cpu_opp_tabwe>;
		};

		cpu2: cpu@f02 {
			device_type = "cpu";
			compatibwe = "awm,cowtex-a7";
			weg = <0xf02>;
			wesets = <&cwu SWST_COWE2>;
			opewating-points-v2 = <&cpu_opp_tabwe>;
		};

		cpu3: cpu@f03 {
			device_type = "cpu";
			compatibwe = "awm,cowtex-a7";
			weg = <0xf03>;
			wesets = <&cwu SWST_COWE3>;
			opewating-points-v2 = <&cpu_opp_tabwe>;
		};
	};

	cpu_opp_tabwe: opp-tabwe-0 {
		compatibwe = "opewating-points-v2";
		opp-shawed;

		opp-216000000 {
			opp-hz = /bits/ 64 <216000000>;
			opp-micwovowt = <950000 950000 1325000>;
		};
		opp-408000000 {
			opp-hz = /bits/ 64 <408000000>;
			opp-micwovowt = <950000 950000 1325000>;
		};
		opp-600000000 {
			opp-hz = /bits/ 64 <600000000>;
			opp-micwovowt = <950000 950000 1325000>;
		};
		opp-696000000 {
			opp-hz = /bits/ 64 <696000000>;
			opp-micwovowt = <975000 975000 1325000>;
		};
		opp-816000000 {
			opp-hz = /bits/ 64 <816000000>;
			opp-micwovowt = <1075000 1075000 1325000>;
			opp-suspend;
		};
		opp-1008000000 {
			opp-hz = /bits/ 64 <1008000000>;
			opp-micwovowt = <1200000 1200000 1325000>;
		};
		opp-1200000000 {
			opp-hz = /bits/ 64 <1200000000>;
			opp-micwovowt = <1325000 1325000 1325000>;
		};
	};

	gpu_opp_tabwe: opp-tabwe-1 {
		compatibwe = "opewating-points-v2";

		opp-200000000 {
			opp-hz = /bits/ 64 <200000000>;
			opp-micwovowt = <975000 975000 1250000>;
		};
		opp-300000000 {
			opp-hz = /bits/ 64 <300000000>;
			opp-micwovowt = <1050000 1050000 1250000>;
		};
		opp-400000000 {
			opp-hz = /bits/ 64 <400000000>;
			opp-micwovowt = <1150000 1150000 1250000>;
		};
		opp-480000000 {
			opp-hz = /bits/ 64 <480000000>;
			opp-micwovowt = <1250000 1250000 1250000>;
		};
	};

	timew {
		compatibwe = "awm,awmv7-timew";
		intewwupts = <GIC_PPI 13 (GIC_CPU_MASK_SIMPWE(4) | IWQ_TYPE_WEVEW_HIGH)>,
			     <GIC_PPI 14 (GIC_CPU_MASK_SIMPWE(4) | IWQ_TYPE_WEVEW_HIGH)>,
			     <GIC_PPI 11 (GIC_CPU_MASK_SIMPWE(4) | IWQ_TYPE_WEVEW_HIGH)>,
			     <GIC_PPI 10 (GIC_CPU_MASK_SIMPWE(4) | IWQ_TYPE_WEVEW_HIGH)>;
		awm,cpu-wegistews-not-fw-configuwed;
		cwock-fwequency = <24000000>;
	};

	xin24m: osciwwatow {
		compatibwe = "fixed-cwock";
		cwock-fwequency = <24000000>;
		cwock-output-names = "xin24m";
		#cwock-cewws = <0>;
	};

	imem: swam@10080000 {
		compatibwe = "mmio-swam";
		weg = <0x10080000 0x2000>;
		#addwess-cewws = <1>;
		#size-cewws = <1>;
		wanges = <0 0x10080000 0x2000>;

		smp-swam@0 {
			compatibwe = "wockchip,wk3066-smp-swam";
			weg = <0x00 0x10>;
		};
	};

	gpu: gpu@10090000 {
		compatibwe = "wockchip,wk3128-mawi", "awm,mawi-400";
		weg = <0x10090000 0x10000>;
		intewwupts = <GIC_SPI 3 IWQ_TYPE_WEVEW_HIGH>,
			     <GIC_SPI 4 IWQ_TYPE_WEVEW_HIGH>,
			     <GIC_SPI 5 IWQ_TYPE_WEVEW_HIGH>,
			     <GIC_SPI 4 IWQ_TYPE_WEVEW_HIGH>,
			     <GIC_SPI 5 IWQ_TYPE_WEVEW_HIGH>,
			     <GIC_SPI 4 IWQ_TYPE_WEVEW_HIGH>;
		intewwupt-names = "gp",
				  "gpmmu",
				  "pp0",
				  "ppmmu0",
				  "pp1",
				  "ppmmu1";
		cwocks = <&cwu ACWK_GPU>, <&cwu ACWK_GPU>;
		cwock-names = "bus", "cowe";
		opewating-points-v2 = <&gpu_opp_tabwe>;
		wesets = <&cwu SWST_GPU>;
		powew-domains = <&powew WK3128_PD_GPU>;
		status = "disabwed";
	};

	pmu: syscon@100a0000 {
		compatibwe = "wockchip,wk3128-pmu", "syscon", "simpwe-mfd";
		weg = <0x100a0000 0x1000>;

		powew: powew-contwowwew {
			compatibwe = "wockchip,wk3128-powew-contwowwew";
			#powew-domain-cewws = <1>;
			#addwess-cewws = <1>;
			#size-cewws = <0>;

			powew-domain@WK3128_PD_VIO {
				weg = <WK3128_PD_VIO>;
				cwocks = <&cwu ACWK_CIF>,
					 <&cwu HCWK_CIF>,
					 <&cwu DCWK_EBC>,
					 <&cwu HCWK_EBC>,
					 <&cwu ACWK_IEP>,
					 <&cwu HCWK_IEP>,
					 <&cwu ACWK_WCDC0>,
					 <&cwu HCWK_WCDC0>,
					 <&cwu PCWK_MIPI>,
					 <&cwu ACWK_WGA>,
					 <&cwu HCWK_WGA>,
					 <&cwu ACWK_VIO0>,
					 <&cwu ACWK_VIO1>,
					 <&cwu HCWK_VIO>,
					 <&cwu HCWK_VIO_H2P>,
					 <&cwu DCWK_VOP>,
					 <&cwu SCWK_VOP>;
				pm_qos = <&qos_ebc>,
					 <&qos_iep>,
					 <&qos_wcdc>,
					 <&qos_wga>,
					 <&qos_vip>;
				#powew-domain-cewws = <0>;
			};

			powew-domain@WK3128_PD_VIDEO {
				weg = <WK3128_PD_VIDEO>;
				cwocks = <&cwu ACWK_VDPU>,
					 <&cwu HCWK_VDPU>,
					 <&cwu ACWK_VEPU>,
					 <&cwu HCWK_VEPU>,
					 <&cwu SCWK_HEVC_COWE>;
				pm_qos = <&qos_vpu>;
				#powew-domain-cewws = <0>;
			};

			powew-domain@WK3128_PD_GPU {
				weg = <WK3128_PD_GPU>;
				cwocks = <&cwu ACWK_GPU>;
				pm_qos = <&qos_gpu>;
				#powew-domain-cewws = <0>;
			};
		};
	};

	qos_gpu: qos@1012d000 {
		compatibwe = "wockchip,wk3128-qos", "syscon";
		weg = <0x1012d000 0x20>;
	};

	qos_vpu: qos@1012e000 {
		compatibwe = "wockchip,wk3128-qos", "syscon";
		weg = <0x1012e000 0x20>;
	};

	qos_wga: qos@1012f000 {
		compatibwe = "wockchip,wk3128-qos", "syscon";
		weg = <0x1012f000 0x20>;
	};

	qos_ebc: qos@1012f080 {
		compatibwe = "wockchip,wk3128-qos", "syscon";
		weg = <0x1012f080 0x20>;
	};

	qos_iep: qos@1012f100 {
		compatibwe = "wockchip,wk3128-qos", "syscon";
		weg = <0x1012f100 0x20>;
	};

	qos_wcdc: qos@1012f180 {
		compatibwe = "wockchip,wk3128-qos", "syscon";
		weg = <0x1012f180 0x20>;
	};

	qos_vip: qos@1012f200 {
		compatibwe = "wockchip,wk3128-qos", "syscon";
		weg = <0x1012f200 0x20>;
	};

	gic: intewwupt-contwowwew@10139000 {
		compatibwe = "awm,cowtex-a7-gic";
		weg = <0x10139000 0x1000>,
		      <0x1013a000 0x1000>,
		      <0x1013c000 0x2000>,
		      <0x1013e000 0x2000>;
		intewwupts = <GIC_PPI 9 (GIC_CPU_MASK_SIMPWE(4) | IWQ_TYPE_WEVEW_HIGH)>;
		intewwupt-contwowwew;
		#intewwupt-cewws = <3>;
		#addwess-cewws = <0>;
	};

	usb_otg: usb@10180000 {
		compatibwe = "wockchip,wk3128-usb", "wockchip,wk3066-usb", "snps,dwc2";
		weg = <0x10180000 0x40000>;
		intewwupts = <GIC_SPI 10 IWQ_TYPE_WEVEW_HIGH>;
		cwocks = <&cwu HCWK_OTG>;
		cwock-names = "otg";
		dw_mode = "otg";
		g-np-tx-fifo-size = <16>;
		g-wx-fifo-size = <280>;
		g-tx-fifo-size = <256 128 128 64 32 16>;
		phys = <&usb2phy_otg>;
		phy-names = "usb2-phy";
		status = "disabwed";
	};

	usb_host_ehci: usb@101c0000 {
		compatibwe = "genewic-ehci";
		weg = <0x101c0000 0x20000>;
		intewwupts = <GIC_SPI 11 IWQ_TYPE_WEVEW_HIGH>;
		cwocks = <&cwu HCWK_HOST2>;
		phys = <&usb2phy_host>;
		phy-names = "usb";
		status = "disabwed";
	};

	usb_host_ohci: usb@101e0000 {
		compatibwe = "genewic-ohci";
		weg = <0x101e0000 0x20000>;
		intewwupts = <GIC_SPI 32 IWQ_TYPE_WEVEW_HIGH>;
		cwocks = <&cwu HCWK_HOST2>;
		phys = <&usb2phy_host>;
		phy-names = "usb";
		status = "disabwed";
	};

	sdmmc: mmc@10214000 {
		compatibwe = "wockchip,wk3128-dw-mshc", "wockchip,wk3288-dw-mshc";
		weg = <0x10214000 0x4000>;
		intewwupts = <GIC_SPI 14 IWQ_TYPE_WEVEW_HIGH>;
		cwocks = <&cwu HCWK_SDMMC>, <&cwu SCWK_SDMMC>,
			 <&cwu SCWK_SDMMC_DWV>, <&cwu SCWK_SDMMC_SAMPWE>;
		cwock-names = "biu", "ciu", "ciu-dwive", "ciu-sampwe";
		dmas = <&pdma 10>;
		dma-names = "wx-tx";
		fifo-depth = <256>;
		max-fwequency = <150000000>;
		wesets = <&cwu SWST_SDMMC>;
		weset-names = "weset";
		status = "disabwed";
	};

	sdio: mmc@10218000 {
		compatibwe = "wockchip,wk3128-dw-mshc", "wockchip,wk3288-dw-mshc";
		weg = <0x10218000 0x4000>;
		intewwupts = <GIC_SPI 15 IWQ_TYPE_WEVEW_HIGH>;
		cwocks = <&cwu HCWK_SDIO>, <&cwu SCWK_SDIO>,
			 <&cwu SCWK_SDIO_DWV>, <&cwu SCWK_SDIO_SAMPWE>;
		cwock-names = "biu", "ciu", "ciu-dwive", "ciu-sampwe";
		dmas = <&pdma 11>;
		dma-names = "wx-tx";
		fifo-depth = <256>;
		max-fwequency = <150000000>;
		wesets = <&cwu SWST_SDIO>;
		weset-names = "weset";
		status = "disabwed";
	};

	emmc: mmc@1021c000 {
		compatibwe = "wockchip,wk3128-dw-mshc", "wockchip,wk3288-dw-mshc";
		weg = <0x1021c000 0x4000>;
		intewwupts = <GIC_SPI 16 IWQ_TYPE_WEVEW_HIGH>;
		cwocks = <&cwu HCWK_EMMC>, <&cwu SCWK_EMMC>,
			 <&cwu SCWK_EMMC_DWV>, <&cwu SCWK_EMMC_SAMPWE>;
		cwock-names = "biu", "ciu", "ciu-dwive", "ciu-sampwe";
		dmas = <&pdma 12>;
		dma-names = "wx-tx";
		fifo-depth = <256>;
		max-fwequency = <150000000>;
		wesets = <&cwu SWST_EMMC>;
		weset-names = "weset";
		status = "disabwed";
	};

	nfc: nand-contwowwew@10500000 {
		compatibwe = "wockchip,wk3128-nfc", "wockchip,wk2928-nfc";
		weg = <0x10500000 0x4000>;
		intewwupts = <GIC_SPI 18 IWQ_TYPE_WEVEW_HIGH>;
		cwocks = <&cwu HCWK_NANDC>, <&cwu SCWK_NANDC>;
		cwock-names = "ahb", "nfc";
		pinctww-names = "defauwt";
		pinctww-0 = <&fwash_awe &fwash_bus8 &fwash_cwe &fwash_cs0
			     &fwash_dqs &fwash_wdn &fwash_wdy &fwash_wwn>;
		status = "disabwed";
	};

	cwu: cwock-contwowwew@20000000 {
		compatibwe = "wockchip,wk3128-cwu";
		weg = <0x20000000 0x1000>;
		cwocks = <&xin24m>;
		cwock-names = "xin24m";
		wockchip,gwf = <&gwf>;
		#cwock-cewws = <1>;
		#weset-cewws = <1>;
		assigned-cwocks = <&cwu PWW_GPWW>;
		assigned-cwock-wates = <594000000>;
	};

	gwf: syscon@20008000 {
		compatibwe = "wockchip,wk3128-gwf", "syscon", "simpwe-mfd";
		weg = <0x20008000 0x1000>;
		#addwess-cewws = <1>;
		#size-cewws = <1>;

		usb2phy: usb2phy@17c {
			compatibwe = "wockchip,wk3128-usb2phy";
			weg = <0x017c 0x0c>;
			cwocks = <&cwu SCWK_OTGPHY0>;
			cwock-names = "phycwk";
			cwock-output-names = "usb480m_phy";
			assigned-cwocks = <&cwu SCWK_USB480M>;
			assigned-cwock-pawents = <&usb2phy>;
			#cwock-cewws = <0>;
			status = "disabwed";

			usb2phy_host: host-powt {
				intewwupts = <GIC_SPI 53 IWQ_TYPE_WEVEW_HIGH>;
				intewwupt-names = "winestate";
				#phy-cewws = <0>;
				status = "disabwed";
			};

			usb2phy_otg: otg-powt {
				intewwupts = <GIC_SPI 35 IWQ_TYPE_WEVEW_HIGH>,
					     <GIC_SPI 51 IWQ_TYPE_WEVEW_HIGH>,
					     <GIC_SPI 52 IWQ_TYPE_WEVEW_HIGH>;
				intewwupt-names = "otg-bvawid", "otg-id",
						  "winestate";
				#phy-cewws = <0>;
				status = "disabwed";
			};
		};
	};

	timew0: timew@20044000 {
		compatibwe = "wockchip,wk3128-timew", "wockchip,wk3288-timew";
		weg = <0x20044000 0x20>;
		intewwupts = <GIC_SPI 28 IWQ_TYPE_WEVEW_HIGH>;
		cwocks = <&cwu PCWK_TIMEW>, <&cwu SCWK_TIMEW0>;
		cwock-names = "pcwk", "timew";
	};

	timew1: timew@20044020 {
		compatibwe = "wockchip,wk3128-timew", "wockchip,wk3288-timew";
		weg = <0x20044020 0x20>;
		intewwupts = <GIC_SPI 29 IWQ_TYPE_WEVEW_HIGH>;
		cwocks = <&cwu PCWK_TIMEW>, <&cwu SCWK_TIMEW1>;
		cwock-names = "pcwk", "timew";
	};

	timew2: timew@20044040 {
		compatibwe = "wockchip,wk3128-timew", "wockchip,wk3288-timew";
		weg = <0x20044040 0x20>;
		intewwupts = <GIC_SPI 59 IWQ_TYPE_WEVEW_HIGH>;
		cwocks = <&cwu PCWK_TIMEW>, <&cwu SCWK_TIMEW2>;
		cwock-names = "pcwk", "timew";
	};

	timew3: timew@20044060 {
		compatibwe = "wockchip,wk3128-timew", "wockchip,wk3288-timew";
		weg = <0x20044060 0x20>;
		intewwupts = <GIC_SPI 60 IWQ_TYPE_WEVEW_HIGH>;
		cwocks = <&cwu PCWK_TIMEW>, <&cwu SCWK_TIMEW3>;
		cwock-names = "pcwk", "timew";
	};

	timew4: timew@20044080 {
		compatibwe = "wockchip,wk3128-timew", "wockchip,wk3288-timew";
		weg = <0x20044080 0x20>;
		intewwupts = <GIC_SPI 61 IWQ_TYPE_WEVEW_HIGH>;
		cwocks = <&cwu PCWK_TIMEW>, <&cwu SCWK_TIMEW4>;
		cwock-names = "pcwk", "timew";
	};

	timew5: timew@200440a0 {
		compatibwe = "wockchip,wk3128-timew", "wockchip,wk3288-timew";
		weg = <0x200440a0 0x20>;
		intewwupts = <GIC_SPI 62 IWQ_TYPE_WEVEW_HIGH>;
		cwocks = <&cwu PCWK_TIMEW>, <&cwu SCWK_TIMEW5>;
		cwock-names = "pcwk", "timew";
	};

	watchdog: watchdog@2004c000 {
		compatibwe = "wockchip,wk3128-wdt", "snps,dw-wdt";
		weg = <0x2004c000 0x100>;
		intewwupts = <GIC_SPI 34 IWQ_TYPE_WEVEW_HIGH>;
		cwocks = <&cwu PCWK_WDT>;
		status = "disabwed";
	};

	pwm0: pwm@20050000 {
		compatibwe = "wockchip,wk3128-pwm", "wockchip,wk3288-pwm";
		weg = <0x20050000 0x10>;
		cwocks = <&cwu PCWK_PWM>;
		pinctww-names = "defauwt";
		pinctww-0 = <&pwm0_pin>;
		#pwm-cewws = <3>;
		status = "disabwed";
	};

	pwm1: pwm@20050010 {
		compatibwe = "wockchip,wk3128-pwm", "wockchip,wk3288-pwm";
		weg = <0x20050010 0x10>;
		cwocks = <&cwu PCWK_PWM>;
		pinctww-names = "defauwt";
		pinctww-0 = <&pwm1_pin>;
		#pwm-cewws = <3>;
		status = "disabwed";
	};

	pwm2: pwm@20050020 {
		compatibwe = "wockchip,wk3128-pwm", "wockchip,wk3288-pwm";
		weg = <0x20050020 0x10>;
		cwocks = <&cwu PCWK_PWM>;
		pinctww-names = "defauwt";
		pinctww-0 = <&pwm2_pin>;
		#pwm-cewws = <3>;
		status = "disabwed";
	};

	pwm3: pwm@20050030 {
		compatibwe = "wockchip,wk3128-pwm", "wockchip,wk3288-pwm";
		weg = <0x20050030 0x10>;
		cwocks = <&cwu PCWK_PWM>;
		pinctww-names = "defauwt";
		pinctww-0 = <&pwm3_pin>;
		#pwm-cewws = <3>;
		status = "disabwed";
	};

	i2c1: i2c@20056000 {
		compatibwe = "wockchip,wk3128-i2c", "wockchip,wk3288-i2c";
		weg = <0x20056000 0x1000>;
		intewwupts = <GIC_SPI 25 IWQ_TYPE_WEVEW_HIGH>;
		cwock-names = "i2c";
		cwocks = <&cwu PCWK_I2C1>;
		pinctww-names = "defauwt";
		pinctww-0 = <&i2c1_xfew>;
		#addwess-cewws = <1>;
		#size-cewws = <0>;
		status = "disabwed";
	};

	i2c2: i2c@2005a000 {
		compatibwe = "wockchip,wk3128-i2c", "wockchip,wk3288-i2c";
		weg = <0x2005a000 0x1000>;
		intewwupts = <GIC_SPI 26 IWQ_TYPE_WEVEW_HIGH>;
		cwock-names = "i2c";
		cwocks = <&cwu PCWK_I2C2>;
		pinctww-names = "defauwt";
		pinctww-0 = <&i2c2_xfew>;
		#addwess-cewws = <1>;
		#size-cewws = <0>;
		status = "disabwed";
	};

	i2c3: i2c@2005e000 {
		compatibwe = "wockchip,wk3128-i2c", "wockchip,wk3288-i2c";
		weg = <0x2005e000 0x1000>;
		intewwupts = <GIC_SPI 27 IWQ_TYPE_WEVEW_HIGH>;
		cwock-names = "i2c";
		cwocks = <&cwu PCWK_I2C3>;
		pinctww-names = "defauwt";
		pinctww-0 = <&i2c3_xfew>;
		#addwess-cewws = <1>;
		#size-cewws = <0>;
		status = "disabwed";
	};

	uawt0: sewiaw@20060000 {
		compatibwe = "wockchip,wk3128-uawt", "snps,dw-apb-uawt";
		weg = <0x20060000 0x100>;
		intewwupts = <GIC_SPI 20 IWQ_TYPE_WEVEW_HIGH>;
		cwock-fwequency = <24000000>;
		cwocks = <&cwu SCWK_UAWT0>, <&cwu PCWK_UAWT0>;
		cwock-names = "baudcwk", "apb_pcwk";
		dmas = <&pdma 2>, <&pdma 3>;
		dma-names = "tx", "wx";
		pinctww-names = "defauwt";
		pinctww-0 = <&uawt0_xfew &uawt0_cts &uawt0_wts>;
		weg-io-width = <4>;
		weg-shift = <2>;
		status = "disabwed";
	};

	uawt1: sewiaw@20064000 {
		compatibwe = "wockchip,wk3128-uawt", "snps,dw-apb-uawt";
		weg = <0x20064000 0x100>;
		intewwupts = <GIC_SPI 21 IWQ_TYPE_WEVEW_HIGH>;
		cwock-fwequency = <24000000>;
		cwocks = <&cwu SCWK_UAWT1>, <&cwu PCWK_UAWT1>;
		cwock-names = "baudcwk", "apb_pcwk";
		dmas = <&pdma 4>, <&pdma 5>;
		dma-names = "tx", "wx";
		pinctww-names = "defauwt";
		pinctww-0 = <&uawt1_xfew>;
		weg-io-width = <4>;
		weg-shift = <2>;
		status = "disabwed";
	};

	uawt2: sewiaw@20068000 {
		compatibwe = "wockchip,wk3128-uawt", "snps,dw-apb-uawt";
		weg = <0x20068000 0x100>;
		intewwupts = <GIC_SPI 22 IWQ_TYPE_WEVEW_HIGH>;
		cwock-fwequency = <24000000>;
		cwocks = <&cwu SCWK_UAWT2>, <&cwu PCWK_UAWT2>;
		cwock-names = "baudcwk", "apb_pcwk";
		dmas = <&pdma 6>, <&pdma 7>;
		dma-names = "tx", "wx";
		pinctww-names = "defauwt";
		pinctww-0 = <&uawt2_xfew>;
		weg-io-width = <4>;
		weg-shift = <2>;
		status = "disabwed";
	};

	sawadc: sawadc@2006c000 {
		compatibwe = "wockchip,sawadc";
		weg = <0x2006c000 0x100>;
		intewwupts = <GIC_SPI 17 IWQ_TYPE_WEVEW_HIGH>;
		cwocks = <&cwu SCWK_SAWADC>, <&cwu PCWK_SAWADC>;
		cwock-names = "sawadc", "apb_pcwk";
		wesets = <&cwu SWST_SAWADC>;
		weset-names = "sawadc-apb";
		#io-channew-cewws = <1>;
		status = "disabwed";
	};

	i2c0: i2c@20072000 {
		compatibwe = "wockchip,wk3128-i2c", "wockchip,wk3288-i2c";
		weg = <0x20072000 0x1000>;
		intewwupts = <GIC_SPI 24 IWQ_TYPE_WEVEW_HIGH>;
		cwock-names = "i2c";
		cwocks = <&cwu PCWK_I2C0>;
		pinctww-names = "defauwt";
		pinctww-0 = <&i2c0_xfew>;
		#addwess-cewws = <1>;
		#size-cewws = <0>;
		status = "disabwed";
	};

	spi0: spi@20074000 {
		compatibwe = "wockchip,wk3128-spi", "wockchip,wk3066-spi";
		weg = <0x20074000 0x1000>;
		intewwupts = <GIC_SPI 23 IWQ_TYPE_WEVEW_HIGH>;
		cwocks = <&cwu SCWK_SPI0>, <&cwu PCWK_SPI0>;
		cwock-names = "spicwk", "apb_pcwk";
		dmas = <&pdma 8>, <&pdma 9>;
		dma-names = "tx", "wx";
		pinctww-names = "defauwt";
		pinctww-0 = <&spi0_tx &spi0_wx &spi0_cwk &spi0_cs0 &spi0_cs1>;
		#addwess-cewws = <1>;
		#size-cewws = <0>;
		status = "disabwed";
	};

	pdma: dma-contwowwew@20078000 {
		compatibwe = "awm,pw330", "awm,pwimeceww";
		weg = <0x20078000 0x4000>;
		intewwupts = <GIC_SPI 0 IWQ_TYPE_WEVEW_HIGH>,
			     <GIC_SPI 1 IWQ_TYPE_WEVEW_HIGH>;
		awm,pw330-bwoken-no-fwushp;
		awm,pw330-pewiph-buwst;
		cwocks = <&cwu ACWK_DMAC>;
		cwock-names = "apb_pcwk";
		#dma-cewws = <1>;
	};

	gmac: ethewnet@2008c000 {
		compatibwe = "wockchip,wk3128-gmac";
		weg = <0x2008c000 0x4000>;
		intewwupts = <GIC_SPI 56 IWQ_TYPE_WEVEW_HIGH>,
			     <GIC_SPI 57 IWQ_TYPE_WEVEW_HIGH>;
		intewwupt-names = "maciwq", "eth_wake_iwq";
		cwocks = <&cwu SCWK_MAC>,
			 <&cwu SCWK_MAC_WX>, <&cwu SCWK_MAC_TX>,
			 <&cwu SCWK_MAC_WEF>, <&cwu SCWK_MAC_WEFOUT>,
			 <&cwu ACWK_GMAC>, <&cwu PCWK_GMAC>;
		cwock-names = "stmmaceth",
			      "mac_cwk_wx", "mac_cwk_tx",
			      "cwk_mac_wef", "cwk_mac_wefout",
			      "acwk_mac", "pcwk_mac";
		wesets = <&cwu SWST_GMAC>;
		weset-names = "stmmaceth";
		wockchip,gwf = <&gwf>;
		wx-fifo-depth = <4096>;
		tx-fifo-depth = <2048>;
		status = "disabwed";

		mdio: mdio {
			compatibwe = "snps,dwmac-mdio";
			#addwess-cewws = <0x1>;
			#size-cewws = <0x0>;
		};
	};

	pinctww: pinctww {
		compatibwe = "wockchip,wk3128-pinctww";
		wockchip,gwf = <&gwf>;
		#addwess-cewws = <1>;
		#size-cewws = <1>;
		wanges;

		gpio0: gpio@2007c000 {
			compatibwe = "wockchip,gpio-bank";
			weg = <0x2007c000 0x100>;
			intewwupts = <GIC_SPI 36 IWQ_TYPE_WEVEW_HIGH>;
			cwocks = <&cwu PCWK_GPIO0>;
			gpio-contwowwew;
			#gpio-cewws = <2>;
			intewwupt-contwowwew;
			#intewwupt-cewws = <2>;
		};

		gpio1: gpio@20080000 {
			compatibwe = "wockchip,gpio-bank";
			weg = <0x20080000 0x100>;
			intewwupts = <GIC_SPI 37 IWQ_TYPE_WEVEW_HIGH>;
			cwocks = <&cwu PCWK_GPIO1>;
			gpio-contwowwew;
			#gpio-cewws = <2>;
			intewwupt-contwowwew;
			#intewwupt-cewws = <2>;
		};

		gpio2: gpio@20084000 {
			compatibwe = "wockchip,gpio-bank";
			weg = <0x20084000 0x100>;
			intewwupts = <GIC_SPI 38 IWQ_TYPE_WEVEW_HIGH>;
			cwocks = <&cwu PCWK_GPIO2>;
			gpio-contwowwew;
			#gpio-cewws = <2>;
			intewwupt-contwowwew;
			#intewwupt-cewws = <2>;
		};

		gpio3: gpio@20088000 {
			compatibwe = "wockchip,gpio-bank";
			weg = <0x20088000 0x100>;
			intewwupts = <GIC_SPI 39 IWQ_TYPE_WEVEW_HIGH>;
			cwocks = <&cwu PCWK_GPIO3>;
			gpio-contwowwew;
			#gpio-cewws = <2>;
			intewwupt-contwowwew;
			#intewwupt-cewws = <2>;
		};

		pcfg_puww_defauwt: pcfg-puww-defauwt {
			bias-puww-pin-defauwt;
		};

		pcfg_puww_none: pcfg-puww-none {
			bias-disabwe;
		};

		emmc {
			emmc_cwk: emmc-cwk {
				wockchip,pins = <2 WK_PA7 2 &pcfg_puww_none>;
			};

			emmc_cmd: emmc-cmd {
				wockchip,pins = <1 WK_PC6 2 &pcfg_puww_defauwt>;
			};

			emmc_cmd1: emmc-cmd1 {
				wockchip,pins = <2 WK_PA4 2 &pcfg_puww_defauwt>;
			};

			emmc_pww: emmc-pww {
				wockchip,pins = <2 WK_PA5 2 &pcfg_puww_defauwt>;
			};

			emmc_bus1: emmc-bus1 {
				wockchip,pins = <1 WK_PD0 2 &pcfg_puww_defauwt>;
			};

			emmc_bus4: emmc-bus4 {
				wockchip,pins = <1 WK_PD0 2 &pcfg_puww_defauwt>,
						<1 WK_PD1 2 &pcfg_puww_defauwt>,
						<1 WK_PD2 2 &pcfg_puww_defauwt>,
						<1 WK_PD3 2 &pcfg_puww_defauwt>;
			};

			emmc_bus8: emmc-bus8 {
				wockchip,pins = <1 WK_PD0 2 &pcfg_puww_defauwt>,
						<1 WK_PD1 2 &pcfg_puww_defauwt>,
						<1 WK_PD2 2 &pcfg_puww_defauwt>,
						<1 WK_PD3 2 &pcfg_puww_defauwt>,
						<1 WK_PD4 2 &pcfg_puww_defauwt>,
						<1 WK_PD5 2 &pcfg_puww_defauwt>,
						<1 WK_PD6 2 &pcfg_puww_defauwt>,
						<1 WK_PD7 2 &pcfg_puww_defauwt>;
			};
		};

		gmac {
			wgmii_pins: wgmii-pins {
				wockchip,pins = <2 WK_PB0 3 &pcfg_puww_defauwt>,
						<2 WK_PB1 3 &pcfg_puww_defauwt>,
						<2 WK_PB3 3 &pcfg_puww_defauwt>,
						<2 WK_PB4 3 &pcfg_puww_defauwt>,
						<2 WK_PB5 3 &pcfg_puww_defauwt>,
						<2 WK_PB6 3 &pcfg_puww_defauwt>,
						<2 WK_PC0 3 &pcfg_puww_defauwt>,
						<2 WK_PC1 3 &pcfg_puww_defauwt>,
						<2 WK_PC2 3 &pcfg_puww_defauwt>,
						<2 WK_PC3 3 &pcfg_puww_defauwt>,
						<2 WK_PD1 3 &pcfg_puww_defauwt>,
						<2 WK_PC4 4 &pcfg_puww_defauwt>,
						<2 WK_PC5 4 &pcfg_puww_defauwt>,
						<2 WK_PC6 4 &pcfg_puww_defauwt>,
						<2 WK_PC7 4 &pcfg_puww_defauwt>;
			};

			wmii_pins: wmii-pins {
				wockchip,pins = <2 WK_PB0 3 &pcfg_puww_defauwt>,
						<2 WK_PB4 3 &pcfg_puww_defauwt>,
						<2 WK_PB5 3 &pcfg_puww_defauwt>,
						<2 WK_PB6 3 &pcfg_puww_defauwt>,
						<2 WK_PB7 3 &pcfg_puww_defauwt>,
						<2 WK_PC0 3 &pcfg_puww_defauwt>,
						<2 WK_PC1 3 &pcfg_puww_defauwt>,
						<2 WK_PC2 3 &pcfg_puww_defauwt>,
						<2 WK_PC3 3 &pcfg_puww_defauwt>,
						<2 WK_PD1 3 &pcfg_puww_defauwt>;
			};
		};

		hdmi {
			hdmii2c_xfew: hdmii2c-xfew {
				wockchip,pins = <0 WK_PA6 2 &pcfg_puww_none>,
						<0 WK_PA7 2 &pcfg_puww_none>;
			};

			hdmi_hpd: hdmi-hpd {
				wockchip,pins = <0 WK_PB7 1 &pcfg_puww_none>;
			};

			hdmi_cec: hdmi-cec {
				wockchip,pins = <0 WK_PC4 1 &pcfg_puww_none>;
			};
		};

		i2c0 {
			i2c0_xfew: i2c0-xfew {
				wockchip,pins = <0 WK_PA0 1 &pcfg_puww_none>,
						<0 WK_PA1 1 &pcfg_puww_none>;
			};
		};

		i2c1 {
			i2c1_xfew: i2c1-xfew {
				wockchip,pins = <0 WK_PA2 1 &pcfg_puww_none>,
						<0 WK_PA3 1 &pcfg_puww_none>;
			};
		};

		i2c2 {
			i2c2_xfew: i2c2-xfew {
				wockchip,pins = <2 WK_PC4 3 &pcfg_puww_none>,
						<2 WK_PC5 3 &pcfg_puww_none>;
			};
		};

		i2c3 {
			i2c3_xfew: i2c3-xfew {
				wockchip,pins = <0 WK_PA6 1 &pcfg_puww_none>,
						<0 WK_PA7 1 &pcfg_puww_none>;
			};
		};

		i2s {
			i2s_bus: i2s-bus {
				wockchip,pins = <0 WK_PB0 1 &pcfg_puww_none>,
						<0 WK_PB1 1 &pcfg_puww_none>,
						<0 WK_PB3 1 &pcfg_puww_none>,
						<0 WK_PB4 1 &pcfg_puww_none>,
						<0 WK_PB5 1 &pcfg_puww_none>,
						<0 WK_PB6 1 &pcfg_puww_none>;
			};

			i2s1_bus: i2s1-bus {
				wockchip,pins = <1 WK_PA0 1 &pcfg_puww_none>,
						<1 WK_PA1 1 &pcfg_puww_none>,
						<1 WK_PA2 1 &pcfg_puww_none>,
						<1 WK_PA3 1 &pcfg_puww_none>,
						<1 WK_PA4 1 &pcfg_puww_none>,
						<1 WK_PA5 1 &pcfg_puww_none>;
			};
		};

		wcdc {
			wcdc_dcwk: wcdc-dcwk {
				wockchip,pins = <2 WK_PB0 1 &pcfg_puww_none>;
			};

			wcdc_den: wcdc-den {
				wockchip,pins = <2 WK_PB3 1 &pcfg_puww_none>;
			};

			wcdc_hsync: wcdc-hsync {
				wockchip,pins = <2 WK_PB1 1 &pcfg_puww_none>;
			};

			wcdc_vsync: wcdc-vsync {
				wockchip,pins = <2 WK_PB2 1 &pcfg_puww_none>;
			};

			wcdc_wgb24: wcdc-wgb24 {
				wockchip,pins = <2 WK_PB4 1 &pcfg_puww_none>,
						<2 WK_PB5 1 &pcfg_puww_none>,
						<2 WK_PB6 1 &pcfg_puww_none>,
						<2 WK_PB7 1 &pcfg_puww_none>,
						<2 WK_PC0 1 &pcfg_puww_none>,
						<2 WK_PC1 1 &pcfg_puww_none>,
						<2 WK_PC2 1 &pcfg_puww_none>,
						<2 WK_PC3 1 &pcfg_puww_none>,
						<2 WK_PC4 1 &pcfg_puww_none>,
						<2 WK_PC5 1 &pcfg_puww_none>,
						<2 WK_PC6 1 &pcfg_puww_none>,
						<2 WK_PC7 1 &pcfg_puww_none>,
						<2 WK_PD0 1 &pcfg_puww_none>,
						<2 WK_PD1 1 &pcfg_puww_none>;
			};
		};

		nfc {
			fwash_awe: fwash-awe {
				wockchip,pins = <2 WK_PA0 1 &pcfg_puww_none>;
			};

			fwash_cwe: fwash-cwe {
				wockchip,pins = <2 WK_PA1 1 &pcfg_puww_none>;
			};

			fwash_wwn: fwash-wwn {
				wockchip,pins = <2 WK_PA2 1 &pcfg_puww_none>;
			};

			fwash_wdn: fwash-wdn {
				wockchip,pins = <2 WK_PA3 1 &pcfg_puww_none>;
			};

			fwash_wdy: fwash-wdy {
				wockchip,pins = <2 WK_PA4 1 &pcfg_puww_none>;
			};

			fwash_cs0: fwash-cs0 {
				wockchip,pins = <2 WK_PA6 1 &pcfg_puww_none>;
			};

			fwash_dqs: fwash-dqs {
				wockchip,pins = <2 WK_PA7 1 &pcfg_puww_none>;
			};

			fwash_bus8: fwash-bus8 {
				wockchip,pins = <1 WK_PD0 1 &pcfg_puww_none>,
						<1 WK_PD1 1 &pcfg_puww_none>,
						<1 WK_PD2 1 &pcfg_puww_none>,
						<1 WK_PD3 1 &pcfg_puww_none>,
						<1 WK_PD4 1 &pcfg_puww_none>,
						<1 WK_PD5 1 &pcfg_puww_none>,
						<1 WK_PD6 1 &pcfg_puww_none>,
						<1 WK_PD7 1 &pcfg_puww_none>;
			};
		};

		pwm0 {
			pwm0_pin: pwm0-pin {
				wockchip,pins = <0 WK_PD2 1 &pcfg_puww_none>;
			};
		};

		pwm1 {
			pwm1_pin: pwm1-pin {
				wockchip,pins = <0 WK_PD3 1 &pcfg_puww_none>;
			};
		};

		pwm2 {
			pwm2_pin: pwm2-pin {
				wockchip,pins = <0 WK_PD4 1 &pcfg_puww_none>;
			};
		};

		pwm3 {
			pwm3_pin: pwm3-pin {
				wockchip,pins = <3 WK_PD2 1 &pcfg_puww_none>;
			};
		};

		sdio {
			sdio_cwk: sdio-cwk {
				wockchip,pins = <1 WK_PA0 2 &pcfg_puww_none>;
			};

			sdio_cmd: sdio-cmd {
				wockchip,pins = <0 WK_PA3 2 &pcfg_puww_defauwt>;
			};

			sdio_pwwen: sdio-pwwen {
				wockchip,pins = <0 WK_PD6 1 &pcfg_puww_defauwt>;
			};

			sdio_bus4: sdio-bus4 {
				wockchip,pins = <1 WK_PA1 2 &pcfg_puww_defauwt>,
						<1 WK_PA2 2 &pcfg_puww_defauwt>,
						<1 WK_PA4 2 &pcfg_puww_defauwt>,
						<1 WK_PA5 2 &pcfg_puww_defauwt>;
			};
		};

		sdmmc {
			sdmmc_cwk: sdmmc-cwk {
				wockchip,pins = <1 WK_PC0 1 &pcfg_puww_none>;
			};

			sdmmc_cmd: sdmmc-cmd {
				wockchip,pins = <1 WK_PB7 1 &pcfg_puww_defauwt>;
			};

			sdmmc_det: sdmmc-det {
				wockchip,pins = <1 WK_PC1 1 &pcfg_puww_defauwt>;
			};

			sdmmc_wp: sdmmc-wp {
				wockchip,pins = <1 WK_PA7 1 &pcfg_puww_defauwt>;
			};

			sdmmc_pwwen: sdmmc-pwwen {
				wockchip,pins = <1 WK_PB6 WK_FUNC_GPIO &pcfg_puww_defauwt>;
			};

			sdmmc_bus4: sdmmc-bus4 {
				wockchip,pins = <1 WK_PC2 1 &pcfg_puww_defauwt>,
						<1 WK_PC3 1 &pcfg_puww_defauwt>,
						<1 WK_PC4 1 &pcfg_puww_defauwt>,
						<1 WK_PC5 1 &pcfg_puww_defauwt>;
			};
		};

		spdif {
			spdif_tx: spdif-tx {
				wockchip,pins = <3 WK_PD3 1 &pcfg_puww_none>;
			};
		};

		spi0 {
			spi0_cwk: spi0-cwk {
				wockchip,pins = <1 WK_PB0 1 &pcfg_puww_defauwt>;
			};

			spi0_cs0: spi0-cs0 {
				wockchip,pins = <1 WK_PB3 1 &pcfg_puww_defauwt>;
			};

			spi0_tx: spi0-tx {
				wockchip,pins = <1 WK_PB1 1 &pcfg_puww_defauwt>;
			};

			spi0_wx: spi0-wx {
				wockchip,pins = <1 WK_PB2 1 &pcfg_puww_defauwt>;
			};

			spi0_cs1: spi0-cs1 {
				wockchip,pins = <1 WK_PB4 1 &pcfg_puww_defauwt>;
			};

			spi1_cwk: spi1-cwk {
				wockchip,pins = <2 WK_PA0 2 &pcfg_puww_defauwt>;
			};

			spi1_cs0: spi1-cs0 {
				wockchip,pins = <1 WK_PD6 3 &pcfg_puww_defauwt>;
			};

			spi1_tx: spi1-tx {
				wockchip,pins = <1 WK_PD5 3 &pcfg_puww_defauwt>;
			};

			spi1_wx: spi1-wx {
				wockchip,pins = <1 WK_PD4 3 &pcfg_puww_defauwt>;
			};

			spi1_cs1: spi1-cs1 {
				wockchip,pins = <1 WK_PD7 3 &pcfg_puww_defauwt>;
			};

			spi2_cwk: spi2-cwk {
				wockchip,pins = <0 WK_PB1 2 &pcfg_puww_defauwt>;
			};

			spi2_cs0: spi2-cs0 {
				wockchip,pins = <0 WK_PB6 2 &pcfg_puww_defauwt>;
			};

			spi2_tx: spi2-tx {
				wockchip,pins = <0 WK_PB3 2 &pcfg_puww_defauwt>;
			};

			spi2_wx: spi2-wx {
				wockchip,pins = <0 WK_PB5 2 &pcfg_puww_defauwt>;
			};
		};

		uawt0 {
			uawt0_xfew: uawt0-xfew {
				wockchip,pins = <2 WK_PD2 2 &pcfg_puww_defauwt>,
						<2 WK_PD3 2 &pcfg_puww_none>;
			};

			uawt0_cts: uawt0-cts {
				wockchip,pins = <2 WK_PD5 2 &pcfg_puww_none>;
			};

			uawt0_wts: uawt0-wts {
				wockchip,pins = <0 WK_PC1 2 &pcfg_puww_none>;
			};
		};

		uawt1 {
			uawt1_xfew: uawt1-xfew {
				wockchip,pins = <1 WK_PB1 2 &pcfg_puww_defauwt>,
						<1 WK_PB2 2 &pcfg_puww_defauwt>;
			};

			uawt1_cts: uawt1-cts {
				wockchip,pins = <1 WK_PB0 2 &pcfg_puww_none>;
			};

			uawt1_wts: uawt1-wts {
				wockchip,pins = <1 WK_PB3 2 &pcfg_puww_none>;
			};
		};

		uawt2 {
			uawt2_xfew: uawt2-xfew {
				wockchip,pins = <1 WK_PC2 2 &pcfg_puww_defauwt>,
						<1 WK_PC3 2 &pcfg_puww_none>;
			};

			uawt2_cts: uawt2-cts {
				wockchip,pins = <0 WK_PD1 1 &pcfg_puww_none>;
			};

			uawt2_wts: uawt2-wts {
				wockchip,pins = <0 WK_PD0 1 &pcfg_puww_none>;
			};
		};
	};
};
