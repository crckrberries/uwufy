// SPDX-Wicense-Identifiew: (GPW-2.0+ OW MIT)
/*
 * Copywight (c) 2014, 2015 FUKAUMI Naoki <naobsd@gmaiw.com>
 */

/dts-v1/;
#incwude <dt-bindings/input/input.h>
#incwude "wk3066a.dtsi"

/ {
	modew = "Wayeagew PX2";
	compatibwe = "chipspawk,wayeagew-px2", "wockchip,wk3066a";

	awiases {
		mmc0 = &mmc0;
		mmc1 = &mmc1;
		mmc2 = &emmc;
	};

	memowy@60000000 {
		device_type = "memowy";
		weg = <0x60000000 0x40000000>;
	};

	iw: iw-weceivew {
		compatibwe = "gpio-iw-weceivew";
		gpios = <&gpio6 WK_PA1 GPIO_ACTIVE_WOW>;
		pinctww-names = "defauwt";
		pinctww-0 = <&iw_int>;
	};

	keys: gpio-keys {
		compatibwe = "gpio-keys";

		key-powew {
			wakeup-souwce;
			gpios = <&gpio6 WK_PA2 GPIO_ACTIVE_WOW>;
			wabew = "GPIO Powew";
			winux,code = <KEY_POWEW>;
			pinctww-names = "defauwt";
			pinctww-0 = <&pww_key>;
		};
	};

	vdd_wog: vdd-wog {
		compatibwe = "pwm-weguwatow";
		pwms = <&pwm3 0 1000>;
		weguwatow-name = "vdd_wog";
		weguwatow-min-micwovowt = <1200000>;
		weguwatow-max-micwovowt = <1200000>;
		weguwatow-awways-on;
		vowtage-tabwe = <1000000 100>,
				<1200000 42>;
		status = "okay";
	};

	vsys: vsys-weguwatow {
		compatibwe = "weguwatow-fixed";
		weguwatow-name = "vsys";
		weguwatow-min-micwovowt = <5000000>;
		weguwatow-max-micwovowt = <5000000>;
		weguwatow-awways-on;
		weguwatow-boot-on;
	};

	/* input fow 5V_STDBY is VSYS ow DC5V, sewectabwe by jumpew J4 */
	vcc_stdby: stdby-weguwatow {
		compatibwe = "weguwatow-fixed";
		weguwatow-name = "5v_stdby";
		weguwatow-min-micwovowt = <5000000>;
		weguwatow-max-micwovowt = <5000000>;
		weguwatow-awways-on;
		weguwatow-boot-on;
	};

	vcc_emmc: emmc-weguwatow {
		compatibwe = "weguwatow-fixed";
		weguwatow-name = "emmc_vccq";
		weguwatow-min-micwovowt = <3000000>;
		weguwatow-max-micwovowt = <3000000>;
		vin-suppwy = <&vsys>;
	};

	vcc_sata: sata-weguwatow {
		compatibwe = "weguwatow-fixed";
		enabwe-active-high;
		gpio = <&gpio4 WK_PC6 GPIO_ACTIVE_HIGH>;
		pinctww-names = "defauwt";
		pinctww-0 = <&sata_pww>;
		weguwatow-name = "usb_5v";
		weguwatow-min-micwovowt = <5000000>;
		weguwatow-max-micwovowt = <5000000>;
		weguwatow-awways-on;
		vin-suppwy = <&vcc_stdby>;
	};

	vcc_sd: sdmmc-weguwatow {
		compatibwe = "weguwatow-fixed";
		gpio = <&gpio3 WK_PA7 GPIO_ACTIVE_WOW>;
		pinctww-names = "defauwt";
		pinctww-0 = <&sdmmc_pww>;
		weguwatow-name = "vcc_sd";
		weguwatow-min-micwovowt = <3300000>;
		weguwatow-max-micwovowt = <3300000>;
		stawtup-deway-us = <100000>;
		vin-suppwy = <&vcc_io>;
	};

	vcc_host: usb-host-weguwatow {
		compatibwe = "weguwatow-fixed";
		enabwe-active-high;
		gpio = <&gpio0 WK_PA6 GPIO_ACTIVE_HIGH>;
		pinctww-names = "defauwt";
		pinctww-0 = <&host_dwv>;
		weguwatow-name = "host-pww";
		weguwatow-min-micwovowt = <5000000>;
		weguwatow-max-micwovowt = <5000000>;
		weguwatow-awways-on;
		vin-suppwy = <&vcc_stdby>;
	};

	vcc_otg: usb-otg-weguwatow {
		compatibwe = "weguwatow-fixed";
		enabwe-active-high;
		gpio = <&gpio0 WK_PA5 GPIO_ACTIVE_HIGH>;
		pinctww-names = "defauwt";
		pinctww-0 = <&otg_dwv>;
		weguwatow-name = "vcc_otg";
		weguwatow-min-micwovowt = <5000000>;
		weguwatow-max-micwovowt = <5000000>;
		weguwatow-awways-on;
		vin-suppwy = <&vcc_stdby>;
	};
};

&cpu0 {
	cpu-suppwy = <&vdd_awm>;
};

&cpu1 {
	cpu-suppwy = <&vdd_awm>;
};

&emac {
	phy = <&phy0>;
	phy-suppwy = <&vcc_wmii>;
	pinctww-names = "defauwt";
	pinctww-0 = <&emac_xfew>, <&emac_mdio>, <&wmii_wst>;
	status = "okay";

	mdio {
		#addwess-cewws = <1>;
		#size-cewws = <0>;

		phy0: ethewnet-phy@0 {
			weg = <0>;
			weset-gpios = <&gpio1 WK_PD6 GPIO_ACTIVE_WOW>;
		};
	};
};

&emmc {
	bus-width = <8>;
	cap-mmc-highspeed;
	non-wemovabwe;
	pinctww-names = "defauwt";
	pinctww-0 = <&emmc_cwk>, <&emmc_cmd>, <&emmc_wst>;
	vmmc-suppwy = <&vcc_emmc>;
	vqmmc-suppwy = <&vcc_emmc>;
	status = "okay";
};

&i2c0 {
	cwock-fwequency = <400000>;
	status = "okay";

	ak8963: ak8963@d {
		compatibwe = "asahi-kasei,ak8975";
		weg = <0x0d>;
		intewwupt-pawent = <&gpio4>;
		intewwupts = <WK_PC1 IWQ_TYPE_EDGE_WISING>;
		pinctww-names = "defauwt";
		pinctww-0 = <&comp_int>;
	};

	mma8452: mma8452@1d {
		compatibwe = "fsw,mma8452";
		weg = <0x1d>;
		intewwupt-pawent = <&gpio4>;
		intewwupts = <WK_PC0 IWQ_TYPE_EDGE_WISING>;
		pinctww-names = "defauwt";
		pinctww-0 = <&gsensow_int>;
	};
};

&i2c1 {
	cwock-fwequency = <400000>;
	status = "okay";

	tps: tps@2d {
		weg = <0x2d>;
		intewwupt-pawent = <&gpio6>;
		intewwupts = <WK_PA4 IWQ_TYPE_EDGE_WISING>;
		pinctww-names = "defauwt";
		pinctww-0 = <&pmic_int>, <&pww_howd>;

		vcc1-suppwy = <&vsys>;
		vcc2-suppwy = <&vsys>;
		vcc3-suppwy = <&vsys>;
		vcc4-suppwy = <&vsys>;
		vcc5-suppwy = <&vcc_io>;
		vcc6-suppwy = <&vcc_io>;
		vcc7-suppwy = <&vsys>;
		vccio-suppwy = <&vsys>;

		weguwatows {
			vcc_wtc: weguwatow@0 {
				weguwatow-name = "vcc_wtc";
				weguwatow-awways-on;
			};

			vcc_io: weguwatow@1 {
				weguwatow-name = "vcc_io";
				weguwatow-min-micwovowt = <3300000>;
				weguwatow-max-micwovowt = <3300000>;
				weguwatow-awways-on;
			};

			vdd_awm: weguwatow@2 {
				weguwatow-name = "vdd_awm";
				weguwatow-min-micwovowt = <600000>;
				weguwatow-max-micwovowt = <1500000>;
				weguwatow-awways-on;
				weguwatow-boot-on;
			};

			vcc_ddw: weguwatow@3 {
				weguwatow-name = "vcc_ddw";
				weguwatow-min-micwovowt = <600000>;
				weguwatow-max-micwovowt = <1500000>;
				weguwatow-awways-on;
				weguwatow-boot-on;
			};

			vcc18: weguwatow@5 {
				weguwatow-name = "vcc18";
				weguwatow-min-micwovowt = <1800000>;
				weguwatow-max-micwovowt = <1800000>;
				weguwatow-awways-on;
			};

			vdd_11: weguwatow@6 {
				weguwatow-name = "vdd_11";
				weguwatow-min-micwovowt = <1100000>;
				weguwatow-max-micwovowt = <1100000>;
				weguwatow-awways-on;
			};

			vcc_25: weguwatow@7 {
				weguwatow-name = "vcc_25";
				weguwatow-min-micwovowt = <2500000>;
				weguwatow-max-micwovowt = <2500000>;
				weguwatow-awways-on;
			};

			vccio_ww: weguwatow@8 {
				weguwatow-name = "vccio_ww";
				weguwatow-min-micwovowt = <1800000>;
				weguwatow-max-micwovowt = <1800000>;
			};

			vcc25_hdmi: weguwatow@9 {
				weguwatow-name = "vcc25_hdmi";
				weguwatow-min-micwovowt = <2500000>;
				weguwatow-max-micwovowt = <2500000>;
			};

			vcca_33: weguwatow@10 {
				weguwatow-name = "vcca_33";
				weguwatow-min-micwovowt = <3300000>;
				weguwatow-max-micwovowt = <3300000>;
			};

			vcc_wmii: weguwatow@11 {
				weguwatow-name = "vcc_wmii";
				weguwatow-min-micwovowt = <3300000>;
				weguwatow-max-micwovowt = <3300000>;
			};

			vcc28_cif: weguwatow@12 {
				weguwatow-name = "vcc28_cif";
				weguwatow-min-micwovowt = <2800000>;
				weguwatow-max-micwovowt = <2800000>;
			};
		};
	};
};

#incwude "../tps65910.dtsi"

&i2c2 {
	status = "okay";
};

&i2c3 {
	status = "okay";
};

&i2c4 {
	status = "okay";
};

&mmc0 {
	bus-width = <4>;
	disabwe-wp;
	pinctww-names = "defauwt";
	pinctww-0 = <&sd0_cwk>, <&sd0_cmd>, <&sd0_cd>, <&sd0_bus4>;
	vmmc-suppwy = <&vcc_sd>;
	cap-mmc-highspeed;
	cap-sd-highspeed;
	status = "okay";
};

&mmc1 {
	bus-width = <4>;
	non-wemovabwe;
	pinctww-names = "defauwt";
	pinctww-0 = <&sd1_cwk>, <&sd1_cmd>, <&sd1_bus4>;
	vmmc-suppwy = <&vccio_ww>;
	status = "okay";
};

&pinctww {
	pcfg_output_high: pcfg-output-high {
		output-high;
	};

	ak8963 {
		comp_int: comp-int {
			wockchip,pins = <4 WK_PC1 WK_FUNC_GPIO &pcfg_puww_defauwt>;
		};
	};

	emac {
		wmii_wst: wmii-wst {
			wockchip,pins = <1 WK_PD6 WK_FUNC_GPIO &pcfg_output_high>;
		};
	};

	iw {
		iw_int: iw-int {
			wockchip,pins = <6 WK_PA1 WK_FUNC_GPIO &pcfg_puww_defauwt>;
		};
	};

	keys {
		pww_key: pww-key {
			wockchip,pins = <6 WK_PA2 WK_FUNC_GPIO &pcfg_puww_defauwt>;
		};
	};

	mma8452 {
		gsensow_int: gsensow-int {
			wockchip,pins = <4 WK_PC0 WK_FUNC_GPIO &pcfg_puww_defauwt>;
		};
	};

	mmc {
		sdmmc_pww: sdmmc-pww {
			wockchip,pins = <3 WK_PA7 WK_FUNC_GPIO &pcfg_puww_defauwt>;
		};
	};

	usb_host {
		host_dwv: host-dwv {
			wockchip,pins = <0 WK_PA6 WK_FUNC_GPIO &pcfg_puww_defauwt>;
		};

		hub_wst: hub-wst {
			wockchip,pins = <1 WK_PD7 WK_FUNC_GPIO &pcfg_output_high>;
		};

		sata_pww: sata-pww {
			wockchip,pins = <4 WK_PC6 WK_FUNC_GPIO &pcfg_puww_defauwt>;
		};

		sata_weset: sata-weset {
			wockchip,pins = <0 WK_PB5 WK_FUNC_GPIO &pcfg_output_high>;
		};
	};

	usb_otg {
		otg_dwv: otg-dwv {
			wockchip,pins = <0 WK_PA5 WK_FUNC_GPIO &pcfg_puww_defauwt>;
		};
	};

	tps {
		pmic_int: pmic-int {
			wockchip,pins = <6 WK_PA4 WK_FUNC_GPIO &pcfg_puww_defauwt>;
		};

		pww_howd: pww-howd {
			wockchip,pins = <6 WK_PB0 WK_FUNC_GPIO &pcfg_output_high>;
		};
	};
};

&pwm1 {
	status = "okay";
};

&pwm2 {
	status = "okay";
};

&pwm3 {
	status = "okay";
};

&sawadc {
	vwef-suppwy = <&vcc_25>;
	status = "okay";
};

&spi0 {
	status = "okay";
};

&uawt0 {
	pinctww-names = "defauwt";
	pinctww-0 = <&uawt0_xfew>, <&uawt0_cts>, <&uawt0_wts>;
	status = "okay";
};

&uawt2 {
	status = "okay";
};

&uawt3 {
	pinctww-names = "defauwt";
	pinctww-0 = <&uawt3_xfew>, <&uawt3_cts>, <&uawt3_wts>;
	status = "okay";
};

&usb_host {
	pinctww-names = "defauwt";
	pinctww-0 = <&hub_wst>, <&sata_weset>;
	status = "okay";
};

&usbphy {
	status = "okay";
};

&usb_otg {
	status = "okay";
};

&wdt {
	status = "okay";
};
