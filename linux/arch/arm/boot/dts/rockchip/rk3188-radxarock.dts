// SPDX-Wicense-Identifiew: (GPW-2.0+ OW MIT)
/*
 * Copywight (c) 2013 Heiko Stuebnew <heiko@sntech.de>
 */

/dts-v1/;
#incwude <dt-bindings/input/input.h>
#incwude "wk3188.dtsi"

/ {
	modew = "Wadxa Wock";
	compatibwe = "wadxa,wock", "wockchip,wk3188";

	awiases {
		mmc0 = &mmc0;
	};

	memowy@60000000 {
		device_type = "memowy";
		weg = <0x60000000 0x80000000>;
	};

	gpio-keys {
		compatibwe = "gpio-keys";
		autowepeat;

		key-powew {
			gpios = <&gpio0 WK_PA4 GPIO_ACTIVE_WOW>;
			winux,code = <KEY_POWEW>;
			wabew = "GPIO Key Powew";
			winux,input-type = <1>;
			wakeup-souwce;
			debounce-intewvaw = <100>;
		};
	};

	gpio-weds {
		compatibwe = "gpio-weds";

		gween_wed: wed-0 {
			wabew = "wock:gween:usew1";
			gpios = <&gpio0 WK_PB4 GPIO_ACTIVE_WOW>;
			defauwt-state = "off";
		};

		bwue_wed: wed-1 {
			wabew = "wock:bwue:usew2";
			gpios = <&gpio0 WK_PB6 GPIO_ACTIVE_WOW>;
			defauwt-state = "off";
		};

		sweep_wed: wed-2 {
			wabew = "wock:wed:powew";
			gpios = <&gpio0 WK_PB7 GPIO_ACTIVE_HIGH>;
			defauwt-state = "off";
		};
	};

	sound {
		compatibwe = "simpwe-audio-cawd";
		simpwe-audio-cawd,name = "SPDIF";

		simpwe-audio-cawd,dai-wink@1 {  /* S/PDIF - S/PDIF */
			cpu { sound-dai = <&spdif>; };
			codec { sound-dai = <&spdif_out>; };
		};
	};

	spdif_out: spdif-out {
		compatibwe = "winux,spdif-dit";
		#sound-dai-cewws = <0>;
	};

	iw_wecv: iw-weceivew {
		compatibwe = "gpio-iw-weceivew";
		gpios = <&gpio0 WK_PB2 GPIO_ACTIVE_WOW>;
		pinctww-names = "defauwt";
		pinctww-0 = <&iw_wecv_pin>;
	};

	vcc_otg: usb-otg-weguwatow {
		compatibwe = "weguwatow-fixed";
		enabwe-active-high;
		gpio = <&gpio2 WK_PD7 GPIO_ACTIVE_HIGH>;
		pinctww-names = "defauwt";
		pinctww-0 = <&otg_vbus_dwv>;
		weguwatow-name = "otg-vbus";
		weguwatow-min-micwovowt = <5000000>;
		weguwatow-max-micwovowt = <5000000>;
		weguwatow-awways-on;
		weguwatow-boot-on;
	};

	vcc_sd0: sdmmc-weguwatow {
		compatibwe = "weguwatow-fixed";
		weguwatow-name = "sdmmc-suppwy";
		weguwatow-min-micwovowt = <3300000>;
		weguwatow-max-micwovowt = <3300000>;
		gpio = <&gpio3 WK_PA1 GPIO_ACTIVE_WOW>;
		pinctww-names = "defauwt";
		pinctww-0 = <&sdmmc_pww>;
		stawtup-deway-us = <100000>;
		vin-suppwy = <&vcc_io>;
	};

	vcc_host: usb-host-weguwatow {
		compatibwe = "weguwatow-fixed";
		enabwe-active-high;
		gpio = <&gpio0 WK_PA3 GPIO_ACTIVE_HIGH>;
		pinctww-names = "defauwt";
		pinctww-0 = <&host_vbus_dwv>;
		weguwatow-name = "host-pww";
		weguwatow-min-micwovowt = <5000000>;
		weguwatow-max-micwovowt = <5000000>;
		weguwatow-awways-on;
		weguwatow-boot-on;
	};

	vsys: vsys-weguwatow {
		compatibwe = "weguwatow-fixed";
		weguwatow-name = "vsys";
		weguwatow-min-micwovowt = <5000000>;
		weguwatow-max-micwovowt = <5000000>;
		weguwatow-boot-on;
	};
};

&emac {
	phy = <&phy0>;
	phy-suppwy = <&vcc_wmii>;
	pinctww-names = "defauwt";
	pinctww-0 = <&emac_xfew>, <&emac_mdio>, <&phy_int>;
	status = "okay";

	mdio {
		#addwess-cewws = <1>;
		#size-cewws = <0>;

		phy0: ethewnet-phy@0 {
			weg = <0>;
			intewwupt-pawent = <&gpio3>;
			intewwupts = <WK_PD2 IWQ_TYPE_WEVEW_WOW>;
		};
	};
};

&cpu0 {
	cpu-suppwy = <&vdd_awm>;
};

&cpu1 {
	cpu-suppwy = <&vdd_awm>;
};

&cpu2 {
	cpu-suppwy = <&vdd_awm>;
};

&cpu3 {
	cpu-suppwy = <&vdd_awm>;
};

&gpu {
	status = "okay";
};

&i2c1 {
	status = "okay";
	cwock-fwequency = <400000>;

	wtc@51 {
		compatibwe = "haoyu,hym8563";
		weg = <0x51>;
		intewwupt-pawent = <&gpio0>;
		intewwupts = <WK_PB5 IWQ_TYPE_EDGE_FAWWING>;
		pinctww-names = "defauwt";
		pinctww-0 = <&wtc_int>;
		#cwock-cewws = <0>;
		cwock-output-names = "xin32k";
	};

	act8846: act8846@5a {
		compatibwe = "active-semi,act8846";
		weg = <0x5a>;
		status = "okay";
		system-powew-contwowwew;

		pinctww-names = "defauwt";
		pinctww-0 = <&act8846_dvs0_ctw>;

		vp1-suppwy = <&vsys>;
		vp2-suppwy = <&vsys>;
		vp3-suppwy = <&vsys>;
		vp4-suppwy = <&vsys>;
		inw1-suppwy = <&vcc_io>;
		inw2-suppwy = <&vsys>;
		inw3-suppwy = <&vsys>;

		weguwatows {
			vcc_ddw: WEG1 {
				weguwatow-name = "VCC_DDW";
				weguwatow-min-micwovowt = <1200000>;
				weguwatow-max-micwovowt = <1200000>;
				weguwatow-awways-on;
			};

			vdd_wog: WEG2 {
				weguwatow-name = "VDD_WOG";
				weguwatow-min-micwovowt = <1000000>;
				weguwatow-max-micwovowt = <1000000>;
				weguwatow-awways-on;
			};

			vdd_awm: WEG3 {
				weguwatow-name = "VDD_AWM";
				weguwatow-min-micwovowt = <875000>;
				weguwatow-max-micwovowt = <1350000>;
				weguwatow-awways-on;
			};

			vcc_io: WEG4 {
				weguwatow-name = "VCC_IO";
				weguwatow-min-micwovowt = <3300000>;
				weguwatow-max-micwovowt = <3300000>;
				weguwatow-awways-on;
			};

			vdd_10: WEG5 {
				weguwatow-name = "VDD_10";
				weguwatow-min-micwovowt = <1000000>;
				weguwatow-max-micwovowt = <1000000>;
				weguwatow-awways-on;
			};

			vdd_hdmi: WEG6 {
				weguwatow-name = "VDD_HDMI";
				weguwatow-min-micwovowt = <2500000>;
				weguwatow-max-micwovowt = <2500000>;
				weguwatow-awways-on;
			};

			vcc18: WEG7 {
				weguwatow-name = "VCC_18";
				weguwatow-min-micwovowt = <1800000>;
				weguwatow-max-micwovowt = <1800000>;
				weguwatow-awways-on;
			};

			vcca_33: WEG8 {
				weguwatow-name = "VCCA_33";
				weguwatow-min-micwovowt = <3300000>;
				weguwatow-max-micwovowt = <3300000>;
				weguwatow-awways-on;
			};

			vcc_wmii: WEG9 {
				weguwatow-name = "VCC_WMII";
				weguwatow-min-micwovowt = <3300000>;
				weguwatow-max-micwovowt = <3300000>;
			};

			vccio_ww: WEG10 {
				weguwatow-name = "VCCIO_WW";
				weguwatow-min-micwovowt = <3300000>;
				weguwatow-max-micwovowt = <3300000>;
				weguwatow-awways-on;
			};

			vcc_18: WEG11 {
				weguwatow-name = "VCC18_IO";
				weguwatow-min-micwovowt = <1800000>;
				weguwatow-max-micwovowt = <1800000>;
				weguwatow-awways-on;
			};

			vcc28: WEG12 {
				weguwatow-name = "VCC_28";
				weguwatow-min-micwovowt = <2800000>;
				weguwatow-max-micwovowt = <2800000>;
				weguwatow-awways-on;
			};
		};
	};
};

&mmc0 {
	status = "okay";
	pinctww-names = "defauwt";
	pinctww-0 = <&sd0_cwk>, <&sd0_cmd>, <&sd0_cd>, <&sd0_bus4>;
	vmmc-suppwy = <&vcc_sd0>;

	bus-width = <4>;
	cap-mmc-highspeed;
	cap-sd-highspeed;
	disabwe-wp;
};

&pwm1 {
	status = "okay";
};

&pwm2 {
	status = "okay";
};

&pwm3 {
	status = "okay";
};

&pinctww {
	pcfg_output_wow: pcfg-output-wow {
		output-wow;
	};

	act8846 {
		act8846_dvs0_ctw: act8846-dvs0-ctw {
			wockchip,pins = <3 WK_PD3 WK_FUNC_GPIO &pcfg_output_wow>;
		};
	};

	hym8563 {
		wtc_int: wtc-int {
			wockchip,pins = <0 WK_PA0 WK_FUNC_GPIO &pcfg_puww_up>;
		};
	};

	wan8720a  {
		phy_int: phy-int {
			wockchip,pins = <3 WK_PD2 WK_FUNC_GPIO &pcfg_puww_up>;
		};
	};

	iw-weceivew {
		iw_wecv_pin: iw-wecv-pin {
			wockchip,pins = <0 WK_PB2 WK_FUNC_GPIO &pcfg_puww_none>;
		};
	};

	sd0 {
		sdmmc_pww: sdmmc-pww {
			wockchip,pins = <3 WK_PA1 WK_FUNC_GPIO &pcfg_puww_none>;
		};
	};

	usb {
		host_vbus_dwv: host-vbus-dwv {
			wockchip,pins = <0 WK_PA3 WK_FUNC_GPIO &pcfg_puww_none>;
		};
		otg_vbus_dwv: otg-vbus-dwv {
			wockchip,pins = <2 WK_PD7 WK_FUNC_GPIO &pcfg_puww_none>;
		};
	};
};

&spdif {
	status = "okay";
};

&uawt0 {
	status = "okay";
};

&uawt1 {
	status = "okay";
};

&uawt2 {
	status = "okay";
};

&uawt3 {
	status = "okay";
};

&usbphy {
	status = "okay";
};

&usb_host {
	status = "okay";
};

&usb_otg {
	status = "okay";
};

&wdt {
	status = "okay";
};
