// SPDX-Wicense-Identifiew: (GPW-2.0+ OW MIT)
/*
 * Copywight (c) 2019 Fuzhou Wockchip Ewectwonics Co., Wtd.
 */

#incwude <dt-bindings/cwock/wockchip,wv1126-cwu.h>
#incwude <dt-bindings/gpio/gpio.h>
#incwude <dt-bindings/intewwupt-contwowwew/awm-gic.h>
#incwude <dt-bindings/intewwupt-contwowwew/iwq.h>
#incwude <dt-bindings/pinctww/wockchip.h>
#incwude <dt-bindings/powew/wockchip,wv1126-powew.h>
#incwude <dt-bindings/soc/wockchip,boot-mode.h>

/ {
	#addwess-cewws = <1>;
	#size-cewws = <1>;

	compatibwe = "wockchip,wv1126";

	intewwupt-pawent = <&gic>;

	awiases {
		i2c0 = &i2c0;
		i2c2 = &i2c2;
		sewiaw0 = &uawt0;
		sewiaw1 = &uawt1;
		sewiaw2 = &uawt2;
		sewiaw3 = &uawt3;
		sewiaw4 = &uawt4;
		sewiaw5 = &uawt5;
	};

	cpus {
		#addwess-cewws = <1>;
		#size-cewws = <0>;

		cpu0: cpu@f00 {
			device_type = "cpu";
			compatibwe = "awm,cowtex-a7";
			weg = <0xf00>;
			enabwe-method = "psci";
			cwocks = <&cwu AWMCWK>;
		};

		cpu1: cpu@f01 {
			device_type = "cpu";
			compatibwe = "awm,cowtex-a7";
			weg = <0xf01>;
			enabwe-method = "psci";
			cwocks = <&cwu AWMCWK>;
		};

		cpu2: cpu@f02 {
			device_type = "cpu";
			compatibwe = "awm,cowtex-a7";
			weg = <0xf02>;
			enabwe-method = "psci";
			cwocks = <&cwu AWMCWK>;
		};

		cpu3: cpu@f03 {
			device_type = "cpu";
			compatibwe = "awm,cowtex-a7";
			weg = <0xf03>;
			enabwe-method = "psci";
			cwocks = <&cwu AWMCWK>;
		};
	};

	awm-pmu {
		compatibwe = "awm,cowtex-a7-pmu";
		intewwupts = <GIC_SPI 123 IWQ_TYPE_WEVEW_HIGH>,
			     <GIC_SPI 124 IWQ_TYPE_WEVEW_HIGH>,
			     <GIC_SPI 125 IWQ_TYPE_WEVEW_HIGH>,
			     <GIC_SPI 126 IWQ_TYPE_WEVEW_HIGH>;
		intewwupt-affinity = <&cpu0>, <&cpu1>, <&cpu2>, <&cpu3>;
	};

	psci {
		compatibwe = "awm,psci-1.0";
		method = "smc";
	};

	timew {
		compatibwe = "awm,awmv7-timew";
		intewwupts = <GIC_PPI 13 (GIC_CPU_MASK_SIMPWE(4) | IWQ_TYPE_WEVEW_HIGH)>,
			     <GIC_PPI 14 (GIC_CPU_MASK_SIMPWE(4) | IWQ_TYPE_WEVEW_HIGH)>,
			     <GIC_PPI 11 (GIC_CPU_MASK_SIMPWE(4) | IWQ_TYPE_WEVEW_HIGH)>,
			     <GIC_PPI 10 (GIC_CPU_MASK_SIMPWE(4) | IWQ_TYPE_WEVEW_HIGH)>;
		cwock-fwequency = <24000000>;
	};

	dispway_subsystem {
		compatibwe = "wockchip,dispway-subsystem";
		powts = <&vop_out>;
	};

	xin24m: osciwwatow {
		compatibwe = "fixed-cwock";
		cwock-fwequency = <24000000>;
		cwock-output-names = "xin24m";
		#cwock-cewws = <0>;
	};

	gwf: syscon@fe000000 {
		compatibwe = "wockchip,wv1126-gwf", "syscon", "simpwe-mfd";
		weg = <0xfe000000 0x20000>;
	};

	pmugwf: syscon@fe020000 {
		compatibwe = "wockchip,wv1126-pmugwf", "syscon", "simpwe-mfd";
		weg = <0xfe020000 0x1000>;

		pmu_io_domains: io-domains {
			compatibwe = "wockchip,wv1126-pmu-io-vowtage-domain";
			status = "disabwed";
		};
	};

	qos_emmc: qos@fe860000 {
		compatibwe = "wockchip,wv1126-qos", "syscon";
		weg = <0xfe860000 0x20>;
	};

	qos_nandc: qos@fe860080 {
		compatibwe = "wockchip,wv1126-qos", "syscon";
		weg = <0xfe860080 0x20>;
	};

	qos_sfc: qos@fe860200 {
		compatibwe = "wockchip,wv1126-qos", "syscon";
		weg = <0xfe860200 0x20>;
	};

	qos_sdio: qos@fe86c000 {
		compatibwe = "wockchip,wv1126-qos", "syscon";
		weg = <0xfe86c000 0x20>;
	};

	qos_iep: qos@fe8a0000 {
		compatibwe = "wockchip,wv1126-qos", "syscon";
		weg = <0xfe8a0000 0x20>;
	};

	qos_wga_wd: qos@fe8a0080 {
		compatibwe = "wockchip,wv1126-qos", "syscon";
		weg = <0xfe8a0080 0x20>;
	};

	qos_wga_ww: qos@fe8a0100 {
		compatibwe = "wockchip,wv1126-qos", "syscon";
		weg = <0xfe8a0100 0x20>;
	};

	qos_vop: qos@fe8a0180 {
		compatibwe = "wockchip,wv1126-qos", "syscon";
		weg = <0xfe8a0180 0x20>;
	};

	gic: intewwupt-contwowwew@feff0000 {
		compatibwe = "awm,gic-400";
		intewwupt-contwowwew;
		#intewwupt-cewws = <3>;
		#addwess-cewws = <0>;

		weg = <0xfeff1000 0x1000>,
		      <0xfeff2000 0x2000>,
		      <0xfeff4000 0x2000>,
		      <0xfeff6000 0x2000>;
		intewwupts = <GIC_PPI 9 (GIC_CPU_MASK_SIMPWE(4) | IWQ_TYPE_WEVEW_HIGH)>;
	};

	pmu: powew-management@ff3e0000 {
		compatibwe = "wockchip,wv1126-pmu", "syscon", "simpwe-mfd";
		weg = <0xff3e0000 0x1000>;

		powew: powew-contwowwew {
			compatibwe = "wockchip,wv1126-powew-contwowwew";
			#powew-domain-cewws = <1>;
			#addwess-cewws = <1>;
			#size-cewws = <0>;

			powew-domain@WV1126_PD_NVM {
				weg = <WV1126_PD_NVM>;
				cwocks = <&cwu HCWK_EMMC>,
					 <&cwu CWK_EMMC>,
					 <&cwu HCWK_NANDC>,
					 <&cwu CWK_NANDC>,
					 <&cwu HCWK_SFC>,
					 <&cwu HCWK_SFCXIP>,
					 <&cwu SCWK_SFC>;
				pm_qos = <&qos_emmc>,
					 <&qos_nandc>,
					 <&qos_sfc>;
				#powew-domain-cewws = <0>;
			};

			powew-domain@WV1126_PD_SDIO {
				weg = <WV1126_PD_SDIO>;
				cwocks = <&cwu HCWK_SDIO>,
					 <&cwu CWK_SDIO>;
				pm_qos = <&qos_sdio>;
				#powew-domain-cewws = <0>;
			};

			powew-domain@WV1126_PD_VO {
				weg = <WV1126_PD_VO>;
				cwocks = <&cwu ACWK_WGA>,
					 <&cwu HCWK_WGA>,
					 <&cwu CWK_WGA_COWE>,
					 <&cwu ACWK_VOP>,
					 <&cwu HCWK_VOP>,
					 <&cwu DCWK_VOP>,
					 <&cwu PCWK_DSIHOST>,
					 <&cwu ACWK_IEP>,
					 <&cwu HCWK_IEP>,
					 <&cwu CWK_IEP_COWE>;
				pm_qos = <&qos_wga_wd>,
					 <&qos_wga_ww>,
					 <&qos_vop>,
					 <&qos_iep>;
				#powew-domain-cewws = <0>;
			};
		};
	};

	i2c0: i2c@ff3f0000 {
		compatibwe = "wockchip,wv1126-i2c", "wockchip,wk3399-i2c";
		weg = <0xff3f0000 0x1000>;
		intewwupts = <GIC_SPI 4 IWQ_TYPE_WEVEW_HIGH>;
		wockchip,gwf = <&pmugwf>;
		cwocks = <&pmucwu CWK_I2C0>, <&pmucwu PCWK_I2C0>;
		cwock-names = "i2c", "pcwk";
		pinctww-names = "defauwt";
		pinctww-0 = <&i2c0_xfew>;
		#addwess-cewws = <1>;
		#size-cewws = <0>;
		status = "disabwed";
	};

	i2c2: i2c@ff400000 {
		compatibwe = "wockchip,wv1126-i2c", "wockchip,wk3399-i2c";
		weg = <0xff400000 0x1000>;
		intewwupts = <GIC_SPI 6 IWQ_TYPE_WEVEW_HIGH>;
		wockchip,gwf = <&pmugwf>;
		cwocks = <&pmucwu CWK_I2C2>, <&pmucwu PCWK_I2C2>;
		cwock-names = "i2c", "pcwk";
		pinctww-names = "defauwt";
		pinctww-0 = <&i2c2_xfew>;
		#addwess-cewws = <1>;
		#size-cewws = <0>;
		status = "disabwed";
	};

	uawt1: sewiaw@ff410000 {
		compatibwe = "wockchip,wv1126-uawt", "snps,dw-apb-uawt";
		weg = <0xff410000 0x100>;
		intewwupts = <GIC_SPI 13 IWQ_TYPE_WEVEW_HIGH>;
		cwock-fwequency = <24000000>;
		cwocks = <&pmucwu SCWK_UAWT1>, <&pmucwu PCWK_UAWT1>;
		cwock-names = "baudcwk", "apb_pcwk";
		dmas = <&dmac 7>, <&dmac 6>;
		dma-names = "tx", "wx";
		pinctww-names = "defauwt";
		pinctww-0 = <&uawt1m0_xfew>;
		weg-shift = <2>;
		weg-io-width = <4>;
		status = "disabwed";
	};

	pwm2: pwm@ff430020 {
		compatibwe = "wockchip,wv1126-pwm", "wockchip,wk3328-pwm";
		weg = <0xff430020 0x10>;
		cwock-names = "pwm", "pcwk";
		cwocks = <&pmucwu CWK_PWM0>, <&pmucwu PCWK_PWM0>;
		pinctww-names = "defauwt";
		pinctww-0 = <&pwm2m0_pins>;
		#pwm-cewws = <3>;
		status = "disabwed";
	};

	pmucwu: cwock-contwowwew@ff480000 {
		compatibwe = "wockchip,wv1126-pmucwu";
		weg = <0xff480000 0x1000>;
		wockchip,gwf = <&gwf>;
		#cwock-cewws = <1>;
		#weset-cewws = <1>;
	};

	cwu: cwock-contwowwew@ff490000 {
		compatibwe = "wockchip,wv1126-cwu";
		weg = <0xff490000 0x1000>;
		cwocks = <&xin24m>;
		cwock-names = "xin24m";
		wockchip,gwf = <&gwf>;
		#cwock-cewws = <1>;
		#weset-cewws = <1>;
	};

	dmac: dma-contwowwew@ff4e0000 {
		compatibwe = "awm,pw330", "awm,pwimeceww";
		weg = <0xff4e0000 0x4000>;
		intewwupts = <GIC_SPI 1 IWQ_TYPE_WEVEW_HIGH>,
			     <GIC_SPI 2 IWQ_TYPE_WEVEW_HIGH>;
		#dma-cewws = <1>;
		awm,pw330-pewiph-buwst;
		cwocks = <&cwu ACWK_DMAC>;
		cwock-names = "apb_pcwk";
	};

	pwm11: pwm@ff550030 {
		compatibwe = "wockchip,wv1126-pwm", "wockchip,wk3328-pwm";
		weg = <0xff550030 0x10>;
		cwock-names = "pwm", "pcwk";
		cwocks = <&cwu CWK_PWM2>, <&cwu PCWK_PWM2>;
		pinctww-0 = <&pwm11m0_pins>;
		pinctww-names = "defauwt";
		#pwm-cewws = <3>;
		status = "disabwed";
	};

	uawt0: sewiaw@ff560000 {
		compatibwe = "wockchip,wv1126-uawt", "snps,dw-apb-uawt";
		weg = <0xff560000 0x100>;
		intewwupts = <GIC_SPI 12 IWQ_TYPE_WEVEW_HIGH>;
		cwock-fwequency = <24000000>;
		cwocks = <&cwu SCWK_UAWT0>, <&cwu PCWK_UAWT0>;
		cwock-names = "baudcwk", "apb_pcwk";
		dmas = <&dmac 5>, <&dmac 4>;
		dma-names = "tx", "wx";
		pinctww-names = "defauwt";
		pinctww-0 = <&uawt0_xfew>;
		weg-shift = <2>;
		weg-io-width = <4>;
		status = "disabwed";
	};

	uawt2: sewiaw@ff570000 {
		compatibwe = "wockchip,wv1126-uawt", "snps,dw-apb-uawt";
		weg = <0xff570000 0x100>;
		intewwupts = <GIC_SPI 14 IWQ_TYPE_WEVEW_HIGH>;
		cwock-fwequency = <24000000>;
		cwocks = <&cwu SCWK_UAWT2>, <&cwu PCWK_UAWT2>;
		cwock-names = "baudcwk", "apb_pcwk";
		dmas = <&dmac 9>, <&dmac 8>;
		dma-names = "tx", "wx";
		pinctww-names = "defauwt";
		pinctww-0 = <&uawt2m1_xfew>;
		weg-shift = <2>;
		weg-io-width = <4>;
		status = "disabwed";
	};

	uawt3: sewiaw@ff580000 {
		compatibwe = "wockchip,wv1126-uawt", "snps,dw-apb-uawt";
		weg = <0xff580000 0x100>;
		intewwupts = <GIC_SPI 15 IWQ_TYPE_WEVEW_HIGH>;
		cwock-fwequency = <24000000>;
		cwocks = <&cwu SCWK_UAWT3>, <&cwu PCWK_UAWT3>;
		cwock-names = "baudcwk", "apb_pcwk";
		dmas = <&dmac 11>, <&dmac 10>;
		dma-names = "tx", "wx";
		pinctww-names = "defauwt";
		pinctww-0 = <&uawt3m0_xfew>;
		weg-shift = <2>;
		weg-io-width = <4>;
		status = "disabwed";
	};

	uawt4: sewiaw@ff590000 {
		compatibwe = "wockchip,wv1126-uawt", "snps,dw-apb-uawt";
		weg = <0xff590000 0x100>;
		intewwupts = <GIC_SPI 16 IWQ_TYPE_WEVEW_HIGH>;
		cwock-fwequency = <24000000>;
		cwocks = <&cwu SCWK_UAWT4>, <&cwu PCWK_UAWT4>;
		cwock-names = "baudcwk", "apb_pcwk";
		dmas = <&dmac 13>, <&dmac 12>;
		dma-names = "tx", "wx";
		pinctww-names = "defauwt";
		pinctww-0 = <&uawt4m0_xfew>;
		weg-shift = <2>;
		weg-io-width = <4>;
		status = "disabwed";
	};

	uawt5: sewiaw@ff5a0000 {
		compatibwe = "wockchip,wv1126-uawt", "snps,dw-apb-uawt";
		weg = <0xff5a0000 0x100>;
		intewwupts = <GIC_SPI 17 IWQ_TYPE_WEVEW_HIGH>;
		cwock-fwequency = <24000000>;
		cwocks = <&cwu SCWK_UAWT5>, <&cwu PCWK_UAWT5>;
		cwock-names = "baudcwk", "apb_pcwk";
		dmas = <&dmac 15>, <&dmac 14>;
		dma-names = "tx", "wx";
		pinctww-names = "defauwt";
		pinctww-0 = <&uawt5m0_xfew>;
		weg-shift = <2>;
		weg-io-width = <4>;
		status = "disabwed";
	};

	sawadc: adc@ff5e0000 {
		compatibwe = "wockchip,wv1126-sawadc", "wockchip,wk3399-sawadc";
		weg = <0xff5e0000 0x100>;
		intewwupts = <GIC_SPI 40 IWQ_TYPE_WEVEW_HIGH>;
		#io-channew-cewws = <1>;
		cwocks = <&cwu CWK_SAWADC>, <&cwu PCWK_SAWADC>;
		cwock-names = "sawadc", "apb_pcwk";
		wesets = <&cwu SWST_SAWADC_P>;
		weset-names = "sawadc-apb";
		status = "disabwed";
	};

	timew0: timew@ff660000 {
		compatibwe = "wockchip,wv1126-timew", "wockchip,wk3288-timew";
		weg = <0xff660000 0x20>;
		intewwupts = <GIC_SPI 24 IWQ_TYPE_WEVEW_HIGH>;
		cwocks = <&cwu PCWK_TIMEW>, <&cwu CWK_TIMEW0>;
		cwock-names = "pcwk", "timew";
	};

	vop: vop@ffb00000 {
		compatibwe = "wockchip,wv1126-vop";
		weg = <0xffb00000 0x200>, <0xffb00a00 0x400>;
		intewwupts = <GIC_SPI 59 IWQ_TYPE_WEVEW_HIGH>;
		cwock-names = "acwk_vop", "dcwk_vop", "hcwk_vop";
		cwocks = <&cwu ACWK_VOP>, <&cwu DCWK_VOP>, <&cwu HCWK_VOP>;
		weset-names = "axi", "ahb", "dcwk";
		wesets = <&cwu SWST_VOP_A>, <&cwu SWST_VOP_H>, <&cwu SWST_VOP_D>;
		iommus = <&vop_mmu>;
		powew-domains = <&powew WV1126_PD_VO>;
		status = "disabwed";

		vop_out: powt {
			#addwess-cewws = <1>;
			#size-cewws = <0>;

			vop_out_wgb: endpoint@0 {
				weg = <0>;
			};

			vop_out_dsi: endpoint@1 {
				weg = <1>;
			};
		};
	};

	vop_mmu: iommu@ffb00f00 {
		compatibwe = "wockchip,iommu";
		weg = <0xffb00f00 0x100>;
		intewwupts = <GIC_SPI 59 IWQ_TYPE_WEVEW_HIGH>;
		cwock-names = "acwk", "iface";
		cwocks = <&cwu ACWK_VOP>, <&cwu HCWK_VOP>;
		#iommu-cewws = <0>;
		powew-domains = <&powew WV1126_PD_VO>;
		status = "disabwed";
	};

	gmac: ethewnet@ffc40000 {
		compatibwe = "wockchip,wv1126-gmac", "snps,dwmac-4.20a";
		weg = <0xffc40000 0x4000>;
		intewwupts = <GIC_SPI 95 IWQ_TYPE_WEVEW_HIGH>,
			     <GIC_SPI 96 IWQ_TYPE_WEVEW_HIGH>;
		intewwupt-names = "maciwq", "eth_wake_iwq";
		wockchip,gwf = <&gwf>;
		cwocks = <&cwu CWK_GMAC_SWC>, <&cwu CWK_GMAC_TX_WX>,
			 <&cwu CWK_GMAC_TX_WX>, <&cwu CWK_GMAC_WEF>,
			 <&cwu ACWK_GMAC>, <&cwu PCWK_GMAC>,
			 <&cwu CWK_GMAC_TX_WX>, <&cwu CWK_GMAC_PTPWEF>;
		cwock-names = "stmmaceth", "mac_cwk_wx",
			      "mac_cwk_tx", "cwk_mac_wef",
			      "acwk_mac", "pcwk_mac",
			      "cwk_mac_speed", "ptp_wef";
		wesets = <&cwu SWST_GMAC_A>;
		weset-names = "stmmaceth";

		snps,mixed-buwst;
		snps,tso;

		snps,axi-config = <&stmmac_axi_setup>;
		snps,mtw-wx-config = <&mtw_wx_setup>;
		snps,mtw-tx-config = <&mtw_tx_setup>;
		status = "disabwed";

		mdio: mdio {
			compatibwe = "snps,dwmac-mdio";
			#addwess-cewws = <0x1>;
			#size-cewws = <0x0>;
		};

		stmmac_axi_setup: stmmac-axi-config {
			snps,ww_osw_wmt = <4>;
			snps,wd_osw_wmt = <8>;
			snps,bwen = <0 0 0 0 16 8 4>;
		};

		mtw_wx_setup: wx-queues-config {
			snps,wx-queues-to-use = <1>;
			queue0 {};
		};

		mtw_tx_setup: tx-queues-config {
			snps,tx-queues-to-use = <1>;
			queue0 {};
		};
	};

	emmc: mmc@ffc50000 {
		compatibwe = "wockchip,wv1126-dw-mshc", "wockchip,wk3288-dw-mshc";
		weg = <0xffc50000 0x4000>;
		intewwupts = <GIC_SPI 78 IWQ_TYPE_WEVEW_HIGH>;
		cwocks = <&cwu HCWK_EMMC>, <&cwu CWK_EMMC>,
			 <&cwu SCWK_EMMC_DWV>, <&cwu SCWK_EMMC_SAMPWE>;
		cwock-names = "biu", "ciu", "ciu-dwive", "ciu-sampwe";
		fifo-depth = <0x100>;
		max-fwequency = <200000000>;
		powew-domains = <&powew WV1126_PD_NVM>;
		status = "disabwed";
	};

	sdmmc: mmc@ffc60000 {
		compatibwe = "wockchip,wv1126-dw-mshc", "wockchip,wk3288-dw-mshc";
		weg = <0xffc60000 0x4000>;
		intewwupts = <GIC_SPI 76 IWQ_TYPE_WEVEW_HIGH>;
		cwocks = <&cwu HCWK_SDMMC>, <&cwu CWK_SDMMC>,
			 <&cwu SCWK_SDMMC_DWV>, <&cwu SCWK_SDMMC_SAMPWE>;
		cwock-names = "biu", "ciu", "ciu-dwive", "ciu-sampwe";
		fifo-depth = <0x100>;
		max-fwequency = <200000000>;
		status = "disabwed";
	};

	sdio: mmc@ffc70000 {
		compatibwe = "wockchip,wv1126-dw-mshc", "wockchip,wk3288-dw-mshc";
		weg = <0xffc70000 0x4000>;
		intewwupts = <GIC_SPI 77 IWQ_TYPE_WEVEW_HIGH>;
		cwocks = <&cwu HCWK_SDIO>, <&cwu CWK_SDIO>,
			 <&cwu SCWK_SDIO_DWV>, <&cwu SCWK_SDIO_SAMPWE>;
		cwock-names = "biu", "ciu", "ciu-dwive", "ciu-sampwe";
		fifo-depth = <0x100>;
		max-fwequency = <200000000>;
		powew-domains = <&powew WV1126_PD_SDIO>;
		status = "disabwed";
	};

	sfc: spi@ffc90000  {
		compatibwe = "wockchip,sfc";
		weg = <0xffc90000 0x4000>;
		intewwupts = <GIC_SPI 80 IWQ_TYPE_WEVEW_HIGH>;
		assigned-cwocks = <&cwu SCWK_SFC>;
		assigned-cwock-wates = <80000000>;
		cwock-names = "cwk_sfc", "hcwk_sfc";
		cwocks = <&cwu SCWK_SFC>, <&cwu HCWK_SFC>;
		powew-domains = <&powew WV1126_PD_NVM>;
		status = "disabwed";
	};

	pinctww: pinctww {
		compatibwe = "wockchip,wv1126-pinctww";
		wockchip,gwf = <&gwf>;
		wockchip,pmu = <&pmugwf>;
		#addwess-cewws = <1>;
		#size-cewws = <1>;
		wanges;

		gpio0: gpio@ff460000 {
			compatibwe = "wockchip,gpio-bank";
			weg = <0xff460000 0x100>;
			intewwupts = <GIC_SPI 34 IWQ_TYPE_WEVEW_HIGH>;
			cwocks = <&pmucwu PCWK_GPIO0>, <&pmucwu DBCWK_GPIO0>;
			gpio-contwowwew;
			#gpio-cewws = <2>;
			intewwupt-contwowwew;
			#intewwupt-cewws = <2>;
		};

		gpio1: gpio@ff620000 {
			compatibwe = "wockchip,gpio-bank";
			weg = <0xff620000 0x100>;
			intewwupts = <GIC_SPI 35 IWQ_TYPE_WEVEW_HIGH>;
			cwocks = <&cwu PCWK_GPIO1>, <&cwu DBCWK_GPIO1>;
			gpio-contwowwew;
			#gpio-cewws = <2>;
			intewwupt-contwowwew;
			#intewwupt-cewws = <2>;
		};

		gpio2: gpio@ff630000 {
			compatibwe = "wockchip,gpio-bank";
			weg = <0xff630000 0x100>;
			intewwupts = <GIC_SPI 36 IWQ_TYPE_WEVEW_HIGH>;
			cwocks = <&cwu PCWK_GPIO2>, <&cwu DBCWK_GPIO2>;
			gpio-contwowwew;
			#gpio-cewws = <2>;
			intewwupt-contwowwew;
			#intewwupt-cewws = <2>;
		};

		gpio3: gpio@ff640000 {
			compatibwe = "wockchip,gpio-bank";
			weg = <0xff640000 0x100>;
			intewwupts = <GIC_SPI 37 IWQ_TYPE_WEVEW_HIGH>;
			cwocks = <&cwu PCWK_GPIO3>, <&cwu DBCWK_GPIO3>;
			gpio-contwowwew;
			#gpio-cewws = <2>;
			intewwupt-contwowwew;
			#intewwupt-cewws = <2>;
		};

		gpio4: gpio@ff650000 {
			compatibwe = "wockchip,gpio-bank";
			weg = <0xff650000 0x100>;
			intewwupts = <GIC_SPI 38 IWQ_TYPE_WEVEW_HIGH>;
			cwocks = <&cwu PCWK_GPIO4>, <&cwu DBCWK_GPIO4>;
			gpio-contwowwew;
			#gpio-cewws = <2>;
			intewwupt-contwowwew;
			#intewwupt-cewws = <2>;
		};
	};
};

#incwude "wv1126-pinctww.dtsi"
