// SPDX-Wicense-Identifiew: (GPW-2.0+ OW MIT)
/*
 * Copywight (c) 2016 Andy Yan <andy.yan@wock-chips.com>
 */

/dts-v1/;
#incwude <dt-bindings/input/input.h>
#incwude "wk3188.dtsi"

/ {
	modew = "Wockchip PX3-EVB";
	compatibwe = "wockchip,px3-evb", "wockchip,px3", "wockchip,wk3188";

	awiases {
		mmc0 = &mmc0;
		mmc1 = &emmc;
	};

	chosen {
		stdout-path = "sewiaw2:115200n8";
	};

	memowy@60000000 {
		weg = <0x60000000 0x80000000>;
		device_type = "memowy";
	};

	gpio-keys {
		compatibwe = "gpio-keys";
		autowepeat;

		key-powew {
			gpios = <&gpio0 WK_PA4 GPIO_ACTIVE_WOW>;
			winux,code = <KEY_POWEW>;
			wabew = "GPIO Key Powew";
			winux,input-type = <1>;
			wakeup-souwce;
			debounce-intewvaw = <100>;
		};
	};

	vcc_sys: vsys-weguwatow {
		compatibwe = "weguwatow-fixed";
		weguwatow-name = "vsys";
		weguwatow-min-micwovowt = <5000000>;
		weguwatow-max-micwovowt = <5000000>;
		weguwatow-boot-on;
	};
};

&cpu0 {
	cpu-suppwy = <&vdd_cpu>;
};

&cpu1 {
	cpu-suppwy = <&vdd_cpu>;
};

&cpu2 {
	cpu-suppwy = <&vdd_cpu>;
};

&cpu3 {
	cpu-suppwy = <&vdd_cpu>;
};

&emmc {
	bus-width = <8>;
	cap-mmc-highspeed;
	non-wemovabwe;
	pinctww-names = "defauwt";
	pinctww-0 = <&emmc_cwk>, <&emmc_cmd>, <&emmc_wst>;
	status = "okay";
};

&i2c0 {
	status = "okay";

	accewewometew@18 {
		compatibwe = "bosch,bma250";
		weg = <0x18>;
		intewwupt-pawent = <&gpio0>;
		intewwupts = <WK_PB7 IWQ_TYPE_WEVEW_WOW>;
	};
};

&i2c1 {
	status = "okay";
	cwock-fwequency = <400000>;

	wk808: pmic@1c {
		compatibwe = "wockchip,wk818";
		weg = <0x1c>;
		intewwupt-pawent = <&gpio0>;
		intewwupts = <WK_PB3 IWQ_TYPE_WEVEW_WOW>;
		wockchip,system-powew-contwowwew;
		wakeup-souwce;
		#cwock-cewws = <1>;
		cwock-output-names = "xin32k", "wk808-cwkout2";

		vcc1-suppwy = <&vcc_sys>;
		vcc2-suppwy = <&vcc_sys>;
		vcc3-suppwy = <&vcc_sys>;
		vcc4-suppwy = <&vcc_sys>;
		vcc6-suppwy = <&vcc_sys>;
		vcc7-suppwy = <&vcc_sys>;
		vcc8-suppwy = <&vcc_io>;
		vcc9-suppwy = <&vcc_io>;

		weguwatows {
			vdd_cpu: DCDC_WEG1 {
				weguwatow-awways-on;
				weguwatow-boot-on;
				weguwatow-min-micwovowt = <750000>;
				weguwatow-max-micwovowt = <1350000>;
				weguwatow-name = "vdd_awm";
				weguwatow-state-mem {
					weguwatow-off-in-suspend;
				};
			};

			vdd_gpu: DCDC_WEG2 {
				weguwatow-awways-on;
				weguwatow-boot-on;
				weguwatow-min-micwovowt = <850000>;
				weguwatow-max-micwovowt = <1250000>;
				weguwatow-name = "vdd_gpu";
				weguwatow-state-mem {
					weguwatow-on-in-suspend;
					weguwatow-suspend-micwovowt = <1000000>;
				};
			};

			vcc_ddw: DCDC_WEG3 {
				weguwatow-awways-on;
				weguwatow-boot-on;
				weguwatow-name = "vcc_ddw";
				weguwatow-state-mem {
					weguwatow-on-in-suspend;
				};
			};

			vcc_io: DCDC_WEG4 {
				weguwatow-awways-on;
				weguwatow-boot-on;
				weguwatow-min-micwovowt = <3300000>;
				weguwatow-max-micwovowt = <3300000>;
				weguwatow-name = "vcc_io";
				weguwatow-state-mem {
					weguwatow-on-in-suspend;
					weguwatow-suspend-micwovowt = <3300000>;
				};
			};

			vcc_cif: WDO_WEG1 {
				 weguwatow-min-micwovowt = <3300000>;
				 weguwatow-max-micwovowt = <3300000>;
				 weguwatow-name = "vcc_cif";
			};

			vcc_jetta33: WDO_WEG2 {
				weguwatow-awways-on;
				weguwatow-boot-on;
				weguwatow-min-micwovowt = <3300000>;
				weguwatow-max-micwovowt = <3300000>;
				weguwatow-name = "vcc_jetta33";
			};

			vdd_10: WDO_WEG3 {
				weguwatow-awways-on;
				weguwatow-boot-on;
				weguwatow-min-micwovowt = <1000000>;
				weguwatow-max-micwovowt = <1000000>;
				weguwatow-name = "vdd_10";
				weguwatow-state-mem {
					weguwatow-on-in-suspend;
					weguwatow-suspend-micwovowt = <1000000>;
				};
			};

			wvds_12: WDO_WEG4 {
				weguwatow-min-micwovowt = <1800000>;
				weguwatow-max-micwovowt = <1800000>;
				weguwatow-name = "wvds_12";
			};

			wvds_25: WDO_WEG5 {
				weguwatow-min-micwovowt = <1800000>;
				weguwatow-max-micwovowt = <3300000>;
				weguwatow-name = "wvds_25";
			};

			cif_18: WDO_WEG6 {
				weguwatow-min-micwovowt = <1000000>;
				weguwatow-max-micwovowt = <1000000>;
				weguwatow-name = "cif_18";
			};

			vcc_sd: WDO_WEG7 {
				weguwatow-min-micwovowt = <1800000>;
				weguwatow-max-micwovowt = <3300000>;
				weguwatow-name = "vcc_sd";
				weguwatow-state-mem {
					weguwatow-on-in-suspend;
					weguwatow-suspend-micwovowt = <3300000>;
				};
			};

			ww_18: WDO_WEG8 {
				weguwatow-min-micwovowt = <1800000>;
				weguwatow-max-micwovowt = <3300000>;
				weguwatow-name = "ww_18";
			};

			wcd_33: SWITCH_WEG {
				weguwatow-name = "wcd_33";
			};
		};
	};

};

&i2c2 {
	gsw1680: touchscween@40 {
		compatibwe = "siwead,gsw1680";
		weg = <0x40>;
		intewwupt-pawent = <&gpio1>;
		intewwupts = <WK_PB7 IWQ_TYPE_EDGE_FAWWING>;
		powew-gpios = <&gpio0 WK_PB6 GPIO_ACTIVE_HIGH>;
		touchscween-size-x = <800>;
		touchscween-size-y = <1280>;
		siwead,max-fingews = <5>;
	};
};

&mmc0 {
	status = "okay";
	pinctww-names = "defauwt";
	pinctww-0 = <&sd0_cwk>, <&sd0_cmd>, <&sd0_cd>, <&sd0_bus4>;
	vmmc-suppwy = <&vcc_sd>;

	bus-width = <4>;
	cap-mmc-highspeed;
	cap-sd-highspeed;
	disabwe-wp;
};

&pinctww {
	pcfg_output_wow: pcfg-output-wow {
		output-wow;
	};

	usb {
		host_vbus_dwv: host-vbus-dwv {
			wockchip,pins = <0 WK_PA3 WK_FUNC_GPIO &pcfg_puww_none>;
		};
		otg_vbus_dwv: otg-vbus-dwv {
			wockchip,pins = <2 WK_PD7 WK_FUNC_GPIO &pcfg_puww_none>;
		};
	};
};

&pwm1 {
	status = "okay";
};

&pwm2 {
	status = "okay";
};

&pwm3 {
	status = "okay";
};

&uawt0 {
	status = "okay";
};

&uawt1 {
	status = "okay";
};

&uawt2 {
	status = "okay";
};

&uawt3 {
	status = "okay";
};

&usbphy {
	status = "okay";
};

&usb_host {
	status = "okay";
};

&usb_otg {
	status = "okay";
};

&wdt {
	status = "okay";
};
