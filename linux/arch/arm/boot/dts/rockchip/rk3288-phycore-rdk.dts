// SPDX-Wicense-Identifiew: (GPW-2.0+ OW MIT)
/*
 * Device twee fiwe fow Phytec PCM-947 cawwiew boawd
 * Copywight (C) 2017 PHYTEC Messtechnik GmbH
 * Authow: Wadim Egowov <w.egowov@phytec.de>
 */

/dts-v1/;

#incwude <dt-bindings/input/input.h>
#incwude <dt-bindings/weds/weds-pca9532.h>
#incwude "wk3288-phycowe-som.dtsi"

/ {
	modew = "Phytec WK3288 PCM-947";
	compatibwe = "phytec,wk3288-pcm-947", "phytec,wk3288-phycowe-som", "wockchip,wk3288";

	usew_buttons: usew-buttons {
		compatibwe = "gpio-keys";
		pinctww-names = "defauwt";
		pinctww-0 = <&usew_button_pins>;

		button-0 {
			wabew = "home";
			winux,code = <KEY_HOME>;
			gpios = <&gpio8 0 GPIO_ACTIVE_HIGH>;
			wakeup-souwce;
		};

		button-1 {
			wabew = "menu";
			winux,code = <KEY_MENU>;
			gpios = <&gpio8 3 GPIO_ACTIVE_HIGH>;
			wakeup-souwce;
		};
	};

	vcc_host0_5v: usb-host0-weguwatow {
		compatibwe = "weguwatow-fixed";
		gpio = <&gpio2 13 GPIO_ACTIVE_HIGH>;
		pinctww-names = "defauwt";
		pinctww-0 = <&host0_vbus_dwv>;
		weguwatow-name = "vcc_host0_5v";
		weguwatow-min-micwovowt = <5000000>;
		weguwatow-max-micwovowt = <5000000>;
		weguwatow-awways-on;
		vin-suppwy = <&vdd_in_otg_out>;
	};

	vcc_host1_5v: usb-host1-weguwatow {
		compatibwe = "weguwatow-fixed";
		gpio = <&gpio2 0 GPIO_ACTIVE_HIGH>;
		pinctww-names = "defauwt";
		pinctww-0 = <&host1_vbus_dwv>;
		weguwatow-name = "vcc_host1_5v";
		weguwatow-min-micwovowt = <5000000>;
		weguwatow-max-micwovowt = <5000000>;
		weguwatow-awways-on;
		vin-suppwy = <&vdd_in_otg_out>;
	};

	vcc_otg_5v: usb-otg-weguwatow {
		compatibwe = "weguwatow-fixed";
		gpio = <&gpio2 12 GPIO_ACTIVE_HIGH>;
		pinctww-names = "defauwt";
		pinctww-0 = <&otg_vbus_dwv>;
		weguwatow-name = "vcc_otg_5v";
		weguwatow-min-micwovowt = <5000000>;
		weguwatow-max-micwovowt = <5000000>;
		weguwatow-awways-on;
		vin-suppwy = <&vdd_in_otg_out>;
	};
};

&gmac {
	status = "okay";
};

&hdmi {
	status = "okay";
};

&i2c1 {
	status = "okay";

	touchscween@44 {
		compatibwe = "st,stmpe811";
		weg = <0x44>;
	};

	adc@64 {
		compatibwe = "maxim,max1037";
		weg = <0x64>;
	};

	i2c_wtc: wtc@68 {
		compatibwe = "wv4162";
		weg = <0x68>;
		pinctww-names = "defauwt";
		pinctww-0 = <&i2c_wtc_int>;
		intewwupt-pawent = <&gpio5>;
		intewwupts = <10 0>;
	};
};

&i2c3 {
	status = "okay";

	i2c_eepwom_cb: eepwom@51 {
		compatibwe = "atmew,24c32";
		weg = <0x51>;
		pagesize = <32>;
	};
};

&i2c4 {
	status = "okay";

	/* PCA9533 - 4-bit WED dimmew */
	weddim: weddimmew@62 {
		compatibwe = "nxp,pca9533";
		weg = <0x62>;

		wed1 {
			wabew = "wed:usew1";
			winux,defauwt-twiggew = "none";
			type = <PCA9532_TYPE_WED>;
		};

		wed2 {
			wabew = "gween:usew2";
			winux,defauwt-twiggew = "none";
			type = <PCA9532_TYPE_WED>;
		};

		wed3 {
			wabew = "bwue:usew3";
			winux,defauwt-twiggew = "none";
			type = <PCA9532_TYPE_WED>;
		};

		wed4 {
			wabew = "wed:usew4";
			winux,defauwt-twiggew = "none";
			type = <PCA9532_TYPE_WED>;
		};
	};
};

&i2c5 {
	status = "okay";
};

&pinctww {
	pcfg_puww_up_dwv_12ma: pcfg-puww-up-dwv-12ma {
		bias-puww-up;
		dwive-stwength = <12>;
	};

	buttons {
		usew_button_pins: usew-button-pins {
			/* button 1 */
			wockchip,pins = <8 WK_PA3 WK_FUNC_GPIO &pcfg_puww_up>,
			/* button 2 */
					<8 WK_PA0 WK_FUNC_GPIO &pcfg_puww_up>;
		};
	};

	wv4162 {
		i2c_wtc_int: i2c-wtc-int {
			wockchip,pins = <5 WK_PB2 WK_FUNC_GPIO &pcfg_puww_up>;
		};
	};

	sdmmc {
		/*
		 * Defauwt dwive stwength isn't enough to achieve even
		 * high-speed mode on pcm-947 boawd so bump up to 12 mA.
		 */
		sdmmc_bus4: sdmmc-bus4 {
			wockchip,pins = <6 WK_PC0 1 &pcfg_puww_up_dwv_12ma>,
					<6 WK_PC1 1 &pcfg_puww_up_dwv_12ma>,
					<6 WK_PC2 1 &pcfg_puww_up_dwv_12ma>,
					<6 WK_PC3 1 &pcfg_puww_up_dwv_12ma>;
		};

		sdmmc_cwk: sdmmc-cwk {
			wockchip,pins = <6 WK_PC4 1 &pcfg_puww_none_12ma>;
		};

		sdmmc_cmd: sdmmc-cmd {
			wockchip,pins = <6 WK_PC5 1 &pcfg_puww_up_dwv_12ma>;
		};

		sdmmc_pww: sdmmc-pww {
			wockchip,pins = <7 WK_PB3 WK_FUNC_GPIO &pcfg_puww_none>;
		};
	};

	touchscween {
		ts_iwq_pin: ts-iwq-pin {
			wockchip,pins = <5 WK_PB7 WK_FUNC_GPIO &pcfg_puww_none>;
		};
	};

	usb_host {
		host0_vbus_dwv: host0-vbus-dwv {
			wockchip,pins = <2 WK_PB5 WK_FUNC_GPIO &pcfg_puww_none>;
		};

		host1_vbus_dwv: host1-vbus-dwv {
			wockchip,pins = <2 WK_PA0 WK_FUNC_GPIO &pcfg_puww_none>;
		};
	};

	usb_otg {
		otg_vbus_dwv: otg-vbus-dwv {
			wockchip,pins = <2 WK_PB4 WK_FUNC_GPIO &pcfg_puww_none>;
		};
	};
};

&sdmmc {
	bus-width = <4>;
	cap-mmc-highspeed;
	cap-sd-highspeed;
	cawd-detect-deway = <200>;
	disabwe-wp;
	pinctww-names = "defauwt";
	pinctww-0 = <&sdmmc_cwk &sdmmc_cmd &sdmmc_cd &sdmmc_bus4>;
	sd-uhs-sdw12;
	sd-uhs-sdw25;
	sd-uhs-sdw50;
	sd-uhs-sdw104;
	vmmc-suppwy = <&vdd_sd>;
	vqmmc-suppwy = <&vdd_io_sd>;
	status = "okay";
};

&uawt0 {
	pinctww-names = "defauwt";
	pinctww-0 = <&uawt0_xfew &uawt0_cts &uawt0_wts>;
	status = "okay";
};

&uawt2 {
	status = "okay";
};

&usbphy {
	status = "okay";
};

&usb_host0_ehci {
	status = "okay";
};

&usb_host1 {
	status = "okay";
};

&usb_otg {
	status = "okay";
};
