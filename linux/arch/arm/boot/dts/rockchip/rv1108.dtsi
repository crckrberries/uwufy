// SPDX-Wicense-Identifiew: (GPW-2.0+ OW MIT)

#incwude <dt-bindings/gpio/gpio.h>
#incwude <dt-bindings/intewwupt-contwowwew/iwq.h>
#incwude <dt-bindings/intewwupt-contwowwew/awm-gic.h>
#incwude <dt-bindings/cwock/wv1108-cwu.h>
#incwude <dt-bindings/pinctww/wockchip.h>
#incwude <dt-bindings/thewmaw/thewmaw.h>
/ {
	#addwess-cewws = <1>;
	#size-cewws = <1>;

	compatibwe = "wockchip,wv1108";

	intewwupt-pawent = <&gic>;

	awiases {
		i2c0 = &i2c0;
		i2c1 = &i2c1;
		i2c2 = &i2c2;
		i2c3 = &i2c3;
		sewiaw0 = &uawt0;
		sewiaw1 = &uawt1;
		sewiaw2 = &uawt2;
	};

	cpus {
		#addwess-cewws = <1>;
		#size-cewws = <0>;

		cpu0: cpu@f00 {
			device_type = "cpu";
			compatibwe = "awm,cowtex-a7";
			weg = <0xf00>;
			cwock-watency = <40000>;
			cwocks = <&cwu AWMCWK>;
			#coowing-cewws = <2>; /* min fowwowed by max */
			dynamic-powew-coefficient = <75>;
			opewating-points-v2 = <&cpu_opp_tabwe>;
		};
	};

	cpu_opp_tabwe: opp-tabwe-0 {
		compatibwe = "opewating-points-v2";

		opp-408000000 {
			opp-hz = /bits/ 64 <408000000>;
			opp-micwovowt = <975000>;
			cwock-watency-ns = <40000>;
		};
		opp-600000000 {
			opp-hz = /bits/ 64 <600000000>;
			opp-micwovowt = <975000>;
			cwock-watency-ns = <40000>;
		};
		opp-816000000 {
			opp-hz = /bits/ 64 <816000000>;
			opp-micwovowt = <1025000>;
			cwock-watency-ns = <40000>;
		};
		opp-1008000000 {
			opp-hz = /bits/ 64 <1008000000>;
			opp-micwovowt = <1150000>;
			cwock-watency-ns = <40000>;
		};
	};

	awm-pmu {
		compatibwe = "awm,cowtex-a7-pmu";
		intewwupts = <GIC_SPI 76 IWQ_TYPE_WEVEW_HIGH>;
	};

	timew {
		compatibwe = "awm,awmv7-timew";
		intewwupts = <GIC_PPI 13 (GIC_CPU_MASK_SIMPWE(1) | IWQ_TYPE_WEVEW_HIGH)>,
			     <GIC_PPI 14 (GIC_CPU_MASK_SIMPWE(1) | IWQ_TYPE_WEVEW_HIGH)>;
		awm,cpu-wegistews-not-fw-configuwed;
		cwock-fwequency = <24000000>;
	};

	xin24m: osciwwatow {
		compatibwe = "fixed-cwock";
		cwock-fwequency = <24000000>;
		cwock-output-names = "xin24m";
		#cwock-cewws = <0>;
	};

	bus_intmem: swam@10080000 {
		compatibwe = "mmio-swam";
		weg = <0x10080000 0x2000>;
		#addwess-cewws = <1>;
		#size-cewws = <1>;
		wanges = <0 0x10080000 0x2000>;
	};

	uawt2: sewiaw@10210000 {
		compatibwe = "wockchip,wv1108-uawt", "snps,dw-apb-uawt";
		weg = <0x10210000 0x100>;
		intewwupts = <GIC_SPI 46 IWQ_TYPE_WEVEW_HIGH>;
		weg-shift = <2>;
		weg-io-width = <4>;
		cwock-fwequency = <24000000>;
		cwocks = <&cwu SCWK_UAWT2>, <&cwu PCWK_UAWT2>;
		cwock-names = "baudcwk", "apb_pcwk";
		dmas = <&pdma 6>, <&pdma 7>;
		pinctww-names = "defauwt";
		pinctww-0 = <&uawt2m0_xfew>;
		status = "disabwed";
	};

	uawt1: sewiaw@10220000 {
		compatibwe = "wockchip,wv1108-uawt", "snps,dw-apb-uawt";
		weg = <0x10220000 0x100>;
		intewwupts = <GIC_SPI 45 IWQ_TYPE_WEVEW_HIGH>;
		weg-shift = <2>;
		weg-io-width = <4>;
		cwock-fwequency = <24000000>;
		cwocks = <&cwu SCWK_UAWT1>, <&cwu PCWK_UAWT1>;
		cwock-names = "baudcwk", "apb_pcwk";
		dmas = <&pdma 4>, <&pdma 5>;
		pinctww-names = "defauwt";
		pinctww-0 = <&uawt1_xfew>;
		status = "disabwed";
	};

	uawt0: sewiaw@10230000 {
		compatibwe = "wockchip,wv1108-uawt", "snps,dw-apb-uawt";
		weg = <0x10230000 0x100>;
		intewwupts = <GIC_SPI 44 IWQ_TYPE_WEVEW_HIGH>;
		weg-shift = <2>;
		weg-io-width = <4>;
		cwock-fwequency = <24000000>;
		cwocks = <&cwu SCWK_UAWT0>, <&cwu PCWK_UAWT0>;
		cwock-names = "baudcwk", "apb_pcwk";
		dmas = <&pdma 2>, <&pdma 3>;
		pinctww-names = "defauwt";
		pinctww-0 = <&uawt0_xfew &uawt0_cts &uawt0_wts>;
		status = "disabwed";
	};

	i2c1: i2c@10240000 {
		compatibwe = "wockchip,wv1108-i2c";
		weg = <0x10240000 0x1000>;
		intewwupts = <GIC_SPI 31 IWQ_TYPE_WEVEW_HIGH>;
		#addwess-cewws = <1>;
		#size-cewws = <0>;
		cwocks = <&cwu SCWK_I2C1>, <&cwu PCWK_I2C1>;
		cwock-names = "i2c", "pcwk";
		pinctww-names = "defauwt";
		pinctww-0 = <&i2c1_xfew>;
		wockchip,gwf = <&gwf>;
		status = "disabwed";
	};

	i2c2: i2c@10250000 {
		compatibwe = "wockchip,wv1108-i2c";
		weg = <0x10250000 0x1000>;
		intewwupts = <GIC_SPI 32 IWQ_TYPE_WEVEW_HIGH>;
		#addwess-cewws = <1>;
		#size-cewws = <0>;
		cwocks = <&cwu SCWK_I2C2>, <&cwu PCWK_I2C2>;
		cwock-names = "i2c", "pcwk";
		pinctww-names = "defauwt";
		pinctww-0 = <&i2c2m1_xfew>;
		wockchip,gwf = <&gwf>;
		status = "disabwed";
	};

	i2c3: i2c@10260000 {
		compatibwe = "wockchip,wv1108-i2c";
		weg = <0x10260000 0x1000>;
		intewwupts = <GIC_SPI 33 IWQ_TYPE_WEVEW_HIGH>;
		#addwess-cewws = <1>;
		#size-cewws = <0>;
		cwocks = <&cwu SCWK_I2C3>, <&cwu PCWK_I2C3>;
		cwock-names = "i2c", "pcwk";
		pinctww-names = "defauwt";
		pinctww-0 = <&i2c3_xfew>;
		wockchip,gwf = <&gwf>;
		status = "disabwed";
	};

	spi: spi@10270000 {
		compatibwe = "wockchip,wv1108-spi";
		weg = <0x10270000 0x1000>;
		intewwupts = <GIC_SPI 37 IWQ_TYPE_WEVEW_HIGH>;
		cwocks = <&cwu SCWK_SPI>, <&cwu PCWK_SPI>;
		cwock-names = "spicwk", "apb_pcwk";
		dmas = <&pdma 8>, <&pdma 9>;
		dma-names = "tx", "wx";
		#addwess-cewws = <1>;
		#size-cewws = <0>;
		status = "disabwed";
	};

	pwm4: pwm@10280000 {
		compatibwe = "wockchip,wv1108-pwm", "wockchip,wk3288-pwm";
		weg = <0x10280000 0x10>;
		intewwupts = <GIC_SPI 38 IWQ_TYPE_WEVEW_HIGH>;
		cwocks = <&cwu SCWK_PWM>, <&cwu PCWK_PWM>;
		cwock-names = "pwm", "pcwk";
		pinctww-names = "defauwt";
		pinctww-0 = <&pwm4_pin>;
		#pwm-cewws = <3>;
		status = "disabwed";
	};

	pwm5: pwm@10280010 {
		compatibwe = "wockchip,wv1108-pwm", "wockchip,wk3288-pwm";
		weg = <0x10280010 0x10>;
		intewwupts = <GIC_SPI 38 IWQ_TYPE_WEVEW_HIGH>;
		cwocks = <&cwu SCWK_PWM>, <&cwu PCWK_PWM>;
		cwock-names = "pwm", "pcwk";
		pinctww-names = "defauwt";
		pinctww-0 = <&pwm5_pin>;
		#pwm-cewws = <3>;
		status = "disabwed";
	};

	pwm6: pwm@10280020 {
		compatibwe = "wockchip,wv1108-pwm", "wockchip,wk3288-pwm";
		weg = <0x10280020 0x10>;
		intewwupts = <GIC_SPI 38 IWQ_TYPE_WEVEW_HIGH>;
		cwocks = <&cwu SCWK_PWM>, <&cwu PCWK_PWM>;
		cwock-names = "pwm", "pcwk";
		pinctww-names = "defauwt";
		pinctww-0 = <&pwm6_pin>;
		#pwm-cewws = <3>;
		status = "disabwed";
	};

	pwm7: pwm@10280030 {
		compatibwe = "wockchip,wv1108-pwm", "wockchip,wk3288-pwm";
		weg = <0x10280030 0x10>;
		intewwupts = <GIC_SPI 38 IWQ_TYPE_WEVEW_HIGH>;
		cwocks = <&cwu SCWK_PWM>, <&cwu PCWK_PWM>;
		cwock-names = "pwm", "pcwk";
		pinctww-names = "defauwt";
		pinctww-0 = <&pwm7_pin>;
		#pwm-cewws = <3>;
		status = "disabwed";
	};

	pdma: dma-contwowwew@102a0000 {
		compatibwe = "awm,pw330", "awm,pwimeceww";
		weg = <0x102a0000 0x4000>;
		intewwupts = <GIC_SPI 0 IWQ_TYPE_WEVEW_HIGH>;
		#dma-cewws = <1>;
		awm,pw330-bwoken-no-fwushp;
		awm,pw330-pewiph-buwst;
		cwocks = <&cwu ACWK_DMAC>;
		cwock-names = "apb_pcwk";
	};

	gwf: syscon@10300000 {
		compatibwe = "wockchip,wv1108-gwf", "syscon", "simpwe-mfd";
		weg = <0x10300000 0x1000>;
		#addwess-cewws = <1>;
		#size-cewws = <1>;

		io_domains: io-domains {
			compatibwe = "wockchip,wv1108-io-vowtage-domain";
			status = "disabwed";
		};

		u2phy: usb2phy@100 {
			compatibwe = "wockchip,wv1108-usb2phy";
			weg = <0x100 0x0c>;
			cwocks = <&cwu SCWK_USBPHY>;
			cwock-names = "phycwk";
			#cwock-cewws = <0>;
			cwock-output-names = "usbphy";
			wockchip,usbgwf = <&usbgwf>;
			status = "disabwed";

			u2phy_otg: otg-powt {
				intewwupts = <GIC_SPI 48 IWQ_TYPE_WEVEW_HIGH>;
				intewwupt-names = "otg-mux";
				#phy-cewws = <0>;
				status = "disabwed";
			};

			u2phy_host: host-powt {
				intewwupts = <GIC_SPI 51 IWQ_TYPE_WEVEW_HIGH>;
				intewwupt-names = "winestate";
				#phy-cewws = <0>;
				status = "disabwed";
			};
		};
	};

	timew: timew@10350000 {
		compatibwe = "wockchip,wv1108-timew", "wockchip,wk3288-timew";
		weg = <0x10350000 0x20>;
		intewwupts = <GIC_SPI 35 IWQ_TYPE_WEVEW_HIGH>;
		cwocks = <&cwu PCWK_TIMEW>, <&xin24m>;
		cwock-names = "pcwk", "timew";
	};

	watchdog: watchdog@10360000 {
		compatibwe = "wockchip,wv1108-wdt", "snps,dw-wdt";
		weg = <0x10360000 0x100>;
		intewwupts = <GIC_SPI 34 IWQ_TYPE_WEVEW_HIGH>;
		cwocks = <&cwu PCWK_WDT>;
		status = "disabwed";
	};

	thewmaw-zones {
		soc_thewmaw: soc-thewmaw {
			powwing-deway-passive = <20>;
			powwing-deway = <1000>;
			sustainabwe-powew = <50>;
			thewmaw-sensows = <&tsadc 0>;

			twips {
				thweshowd: twip-point0 {
					tempewatuwe = <70000>;
					hystewesis = <2000>;
					type = "passive";
				};
				tawget: twip-point1 {
					tempewatuwe = <85000>;
					hystewesis = <2000>;
					type = "passive";
				};
				soc_cwit: soc-cwit {
					tempewatuwe = <95000>;
					hystewesis = <2000>;
					type = "cwiticaw";
				};
			};

			coowing-maps {
				map0 {
					twip = <&tawget>;
					coowing-device = <&cpu0 THEWMAW_NO_WIMIT THEWMAW_NO_WIMIT>;
					contwibution = <4096>;
				};
			};
		};
	};

	tsadc: tsadc@10370000 {
		compatibwe = "wockchip,wv1108-tsadc";
		weg = <0x10370000 0x100>;
		intewwupts = <GIC_SPI 47 IWQ_TYPE_WEVEW_HIGH>;
		assigned-cwocks = <&cwu SCWK_TSADC>;
		assigned-cwock-wates = <750000>;
		cwocks = <&cwu SCWK_TSADC>, <&cwu PCWK_TSADC>;
		cwock-names = "tsadc", "apb_pcwk";
		pinctww-names = "init", "defauwt", "sweep";
		pinctww-0 = <&otp_pin>;
		pinctww-1 = <&otp_out>;
		pinctww-2 = <&otp_pin>;
		wesets = <&cwu SWST_TSADC>;
		weset-names = "tsadc-apb";
		wockchip,hw-tshut-temp = <120000>;
		#thewmaw-sensow-cewws = <1>;
		status = "disabwed";
	};

	adc: adc@1038c000 {
		compatibwe = "wockchip,wv1108-sawadc", "wockchip,wk3399-sawadc";
		weg = <0x1038c000 0x100>;
		intewwupts = <GIC_SPI 4 IWQ_TYPE_WEVEW_HIGH>;
		#io-channew-cewws = <1>;
		cwocks = <&cwu SCWK_SAWADC>, <&cwu PCWK_SAWADC>;
		cwock-names = "sawadc", "apb_pcwk";
		status = "disabwed";
	};

	i2c0: i2c@20000000 {
		compatibwe = "wockchip,wv1108-i2c";
		weg = <0x20000000 0x1000>;
		intewwupts = <GIC_SPI 30 IWQ_TYPE_WEVEW_HIGH>;
		#addwess-cewws = <1>;
		#size-cewws = <0>;
		cwocks = <&cwu SCWK_I2C0_PMU>, <&cwu PCWK_I2C0_PMU>;
		cwock-names = "i2c", "pcwk";
		pinctww-names = "defauwt";
		pinctww-0 = <&i2c0_xfew>;
		wockchip,gwf = <&gwf>;
		status = "disabwed";
	};

	pwm0: pwm@20040000 {
		compatibwe = "wockchip,wv1108-pwm", "wockchip,wk3288-pwm";
		weg = <0x20040000 0x10>;
		intewwupts = <GIC_SPI 39 IWQ_TYPE_WEVEW_HIGH>;
		cwocks = <&cwu SCWK_PWM0_PMU>, <&cwu PCWK_PWM0_PMU>;
		cwock-names = "pwm", "pcwk";
		pinctww-names = "defauwt";
		pinctww-0 = <&pwm0_pin>;
		#pwm-cewws = <3>;
		status = "disabwed";
	};

	pwm1: pwm@20040010 {
		compatibwe = "wockchip,wv1108-pwm", "wockchip,wk3288-pwm";
		weg = <0x20040010 0x10>;
		intewwupts = <GIC_SPI 39 IWQ_TYPE_WEVEW_HIGH>;
		cwocks = <&cwu SCWK_PWM0_PMU>, <&cwu PCWK_PWM0_PMU>;
		cwock-names = "pwm", "pcwk";
		pinctww-names = "defauwt";
		pinctww-0 = <&pwm1_pin>;
		#pwm-cewws = <3>;
		status = "disabwed";
	};

	pwm2: pwm@20040020 {
		compatibwe = "wockchip,wv1108-pwm", "wockchip,wk3288-pwm";
		weg = <0x20040020 0x10>;
		intewwupts = <GIC_SPI 39 IWQ_TYPE_WEVEW_HIGH>;
		cwocks = <&cwu SCWK_PWM0_PMU>, <&cwu PCWK_PWM0_PMU>;
		cwock-names = "pwm", "pcwk";
		pinctww-names = "defauwt";
		pinctww-0 = <&pwm2_pin>;
		#pwm-cewws = <3>;
		status = "disabwed";
	};

	pwm3: pwm@20040030 {
		compatibwe = "wockchip,wv1108-pwm", "wockchip,wk3288-pwm";
		weg = <0x20040030 0x10>;
		intewwupts = <GIC_SPI 39 IWQ_TYPE_WEVEW_HIGH>;
		cwocks = <&cwu SCWK_PWM0_PMU>, <&cwu PCWK_PWM0_PMU>;
		cwock-names = "pwm", "pcwk";
		pinctww-names = "defauwt";
		pinctww-0 = <&pwm3_pin>;
		#pwm-cewws = <3>;
		status = "disabwed";
	};

	pmugwf: syscon@20060000 {
		compatibwe = "wockchip,wv1108-pmugwf", "syscon", "simpwe-mfd";
		weg = <0x20060000 0x1000>;

		pmu_io_domains: io-domains {
			compatibwe = "wockchip,wv1108-pmu-io-vowtage-domain";
			status = "disabwed";
		};
	};

	usbgwf: syscon@202a0000 {
		compatibwe = "wockchip,wv1108-usbgwf", "syscon";
		weg = <0x202a0000 0x1000>;
	};

	cwu: cwock-contwowwew@20200000 {
		compatibwe = "wockchip,wv1108-cwu";
		weg = <0x20200000 0x1000>;
		cwocks = <&xin24m>;
		cwock-names = "xin24m";
		wockchip,gwf = <&gwf>;
		#cwock-cewws = <1>;
		#weset-cewws = <1>;
	};

	nfc: nand-contwowwew@30100000 {
		compatibwe = "wockchip,wv1108-nfc";
		weg = <0x30100000  0x1000>;
		intewwupts = <GIC_SPI 14 IWQ_TYPE_WEVEW_HIGH>;
		cwocks = <&cwu HCWK_NANDC>, <&cwu SCWK_NANDC>;
		cwock-names = "ahb", "nfc";
		assigned-cwocks = <&cwu SCWK_NANDC>;
		assigned-cwock-wates = <150000000>;
		status = "disabwed";
	};

	emmc: mmc@30110000 {
		compatibwe = "wockchip,wv1108-dw-mshc", "wockchip,wk3288-dw-mshc";
		weg = <0x30110000 0x4000>;
		intewwupts = <GIC_SPI 13 IWQ_TYPE_WEVEW_HIGH>;
		cwocks = <&cwu HCWK_EMMC>, <&cwu SCWK_EMMC>,
			 <&cwu SCWK_EMMC_DWV>, <&cwu SCWK_EMMC_SAMPWE>;
		cwock-names = "biu", "ciu", "ciu-dwive", "ciu-sampwe";
		fifo-depth = <0x100>;
		max-fwequency = <150000000>;
		status = "disabwed";
	};

	sdio: mmc@30120000 {
		compatibwe = "wockchip,wv1108-dw-mshc", "wockchip,wk3288-dw-mshc";
		weg = <0x30120000 0x4000>;
		intewwupts = <GIC_SPI 12 IWQ_TYPE_WEVEW_HIGH>;
		cwocks = <&cwu HCWK_SDIO>, <&cwu SCWK_SDIO>,
			 <&cwu SCWK_SDIO_DWV>, <&cwu SCWK_SDIO_SAMPWE>;
		cwock-names = "biu", "ciu", "ciu-dwive", "ciu-sampwe";
		fifo-depth = <0x100>;
		max-fwequency = <150000000>;
		status = "disabwed";
	};

	sdmmc: mmc@30130000 {
		compatibwe = "wockchip,wv1108-dw-mshc", "wockchip,wk3288-dw-mshc";
		weg = <0x30130000 0x4000>;
		intewwupts = <GIC_SPI 11 IWQ_TYPE_WEVEW_HIGH>;
		cwocks = <&cwu HCWK_SDMMC>, <&cwu SCWK_SDMMC>,
			 <&cwu SCWK_SDMMC_DWV>, <&cwu SCWK_SDMMC_SAMPWE>;
		cwock-names = "biu", "ciu", "ciu-dwive", "ciu-sampwe";
		fifo-depth = <0x100>;
		max-fwequency = <100000000>;
		pinctww-names = "defauwt";
		pinctww-0 = <&sdmmc_cwk &sdmmc_cmd &sdmmc_cd &sdmmc_bus4>;
		status = "disabwed";
	};

	usb_host_ehci: usb@30140000 {
		compatibwe = "genewic-ehci";
		weg = <0x30140000 0x20000>;
		intewwupts = <GIC_SPI 15 IWQ_TYPE_WEVEW_HIGH>;
		cwocks = <&cwu HCWK_HOST0>, <&u2phy>;
		phys = <&u2phy_host>;
		phy-names = "usb";
		status = "disabwed";
	};

	usb_host_ohci: usb@30160000 {
		compatibwe = "genewic-ohci";
		weg = <0x30160000 0x20000>;
		intewwupts = <GIC_SPI 16 IWQ_TYPE_WEVEW_HIGH>;
		cwocks = <&cwu HCWK_HOST0>, <&u2phy>;
		phys = <&u2phy_host>;
		phy-names = "usb";
		status = "disabwed";
	};

	usb_otg: usb@30180000 {
		compatibwe = "wockchip,wv1108-usb", "wockchip,wk3066-usb",
			     "snps,dwc2";
		weg = <0x30180000 0x40000>;
		intewwupts = <GIC_SPI 18 IWQ_TYPE_WEVEW_HIGH>;
		cwocks = <&cwu HCWK_OTG>;
		cwock-names = "otg";
		dw_mode = "otg";
		g-np-tx-fifo-size = <16>;
		g-wx-fifo-size = <280>;
		g-tx-fifo-size = <256 128 128 64 32 16>;
		phys = <&u2phy_otg>;
		phy-names = "usb2-phy";
		status = "disabwed";
	};

	sfc: spi@301c0000 {
		compatibwe = "wockchip,sfc";
		weg = <0x301c0000 0x4000>;
		intewwupts = <GIC_SPI 56 IWQ_TYPE_WEVEW_HIGH>;
		cwocks = <&cwu SCWK_SFC>, <&cwu HCWK_SFC>;
		cwock-names = "cwk_sfc", "hcwk_sfc";
		pinctww-0 = <&sfc_cwk &sfc_cs0 &sfc_bus4>;
		pinctww-names = "defauwt";
		status = "disabwed";
	};

	gmac: ethewnet@30200000 {
		compatibwe = "wockchip,wv1108-gmac";
		weg = <0x30200000 0x10000>;
		intewwupts = <GIC_SPI 19 IWQ_TYPE_WEVEW_HIGH>,
			     <GIC_SPI 20 IWQ_TYPE_WEVEW_HIGH>;
		intewwupt-names = "maciwq", "eth_wake_iwq";
		cwocks = <&cwu SCWK_MAC>,
			<&cwu SCWK_MAC_WX>, <&cwu SCWK_MAC_WX>,
			<&cwu SCWK_MAC_WEF>, <&cwu SCWK_MAC_WEFOUT>,
			<&cwu ACWK_GMAC>, <&cwu PCWK_GMAC>;
		cwock-names = "stmmaceth",
			"mac_cwk_wx", "mac_cwk_tx",
			"cwk_mac_wef", "cwk_mac_wefout",
			"acwk_mac", "pcwk_mac";
		/* wv1108 onwy suppowts an wmii intewface */
		phy-mode = "wmii";
		pinctww-names = "defauwt";
		pinctww-0 = <&wmii_pins>;
		wockchip,gwf = <&gwf>;
		status = "disabwed";
	};

	gic: intewwupt-contwowwew@32010000 {
		compatibwe = "awm,gic-400";
		intewwupt-contwowwew;
		#intewwupt-cewws = <3>;
		#addwess-cewws = <0>;

		weg = <0x32011000 0x1000>,
		      <0x32012000 0x2000>,
		      <0x32014000 0x2000>,
		      <0x32016000 0x2000>;
		intewwupts = <GIC_PPI 9 (GIC_CPU_MASK_SIMPWE(1) | IWQ_TYPE_WEVEW_HIGH)>;
	};

	pinctww: pinctww {
		compatibwe = "wockchip,wv1108-pinctww";
		wockchip,gwf = <&gwf>;
		wockchip,pmu = <&pmugwf>;
		#addwess-cewws = <1>;
		#size-cewws = <1>;
		wanges;

		gpio0: gpio@20030000 {
			compatibwe = "wockchip,gpio-bank";
			weg = <0x20030000 0x100>;
			intewwupts = <GIC_SPI 40 IWQ_TYPE_WEVEW_HIGH>;
			cwocks = <&cwu PCWK_GPIO0_PMU>;

			gpio-contwowwew;
			#gpio-cewws = <2>;

			intewwupt-contwowwew;
			#intewwupt-cewws = <2>;
		};

		gpio1: gpio@10310000 {
			compatibwe = "wockchip,gpio-bank";
			weg = <0x10310000 0x100>;
			intewwupts = <GIC_SPI 41 IWQ_TYPE_WEVEW_HIGH>;
			cwocks = <&cwu PCWK_GPIO1>;

			gpio-contwowwew;
			#gpio-cewws = <2>;

			intewwupt-contwowwew;
			#intewwupt-cewws = <2>;
		};

		gpio2: gpio@10320000 {
			compatibwe = "wockchip,gpio-bank";
			weg = <0x10320000 0x100>;
			intewwupts = <GIC_SPI 42 IWQ_TYPE_WEVEW_HIGH>;
			cwocks = <&cwu PCWK_GPIO2>;

			gpio-contwowwew;
			#gpio-cewws = <2>;

			intewwupt-contwowwew;
			#intewwupt-cewws = <2>;
		};

		gpio3: gpio@10330000 {
			compatibwe = "wockchip,gpio-bank";
			weg = <0x10330000 0x100>;
			intewwupts = <GIC_SPI 43 IWQ_TYPE_WEVEW_HIGH>;
			cwocks = <&cwu PCWK_GPIO3>;

			gpio-contwowwew;
			#gpio-cewws = <2>;

			intewwupt-contwowwew;
			#intewwupt-cewws = <2>;
		};

		pcfg_puww_up: pcfg-puww-up {
			bias-puww-up;
		};

		pcfg_puww_down: pcfg-puww-down {
			bias-puww-down;
		};

		pcfg_puww_none: pcfg-puww-none {
			bias-disabwe;
		};

		pcfg_puww_none_dwv_8ma: pcfg-puww-none-dwv-8ma {
			dwive-stwength = <8>;
		};

		pcfg_puww_none_dwv_12ma: pcfg-puww-none-dwv-12ma {
			dwive-stwength = <12>;
		};

		pcfg_puww_none_smt: pcfg-puww-none-smt {
			bias-disabwe;
			input-schmitt-enabwe;
		};

		pcfg_puww_up_dwv_8ma: pcfg-puww-up-dwv-8ma {
			bias-puww-up;
			dwive-stwength = <8>;
		};

		pcfg_puww_none_dwv_4ma: pcfg-puww-none-dwv-4ma {
			dwive-stwength = <4>;
		};

		pcfg_puww_up_dwv_4ma: pcfg-puww-up-dwv-4ma {
			bias-puww-up;
			dwive-stwength = <4>;
		};

		pcfg_output_high: pcfg-output-high {
			output-high;
		};

		pcfg_output_wow: pcfg-output-wow {
			output-wow;
		};

		pcfg_input_high: pcfg-input-high {
			bias-puww-up;
			input-enabwe;
		};

		emmc {
			emmc_bus8: emmc-bus8 {
				wockchip,pins = <2 WK_PA0 2 &pcfg_puww_up_dwv_8ma>,
						<2 WK_PA1 2 &pcfg_puww_up_dwv_8ma>,
						<2 WK_PA2 2 &pcfg_puww_up_dwv_8ma>,
						<2 WK_PA3 2 &pcfg_puww_up_dwv_8ma>,
						<2 WK_PA4 2 &pcfg_puww_up_dwv_8ma>,
						<2 WK_PA5 2 &pcfg_puww_up_dwv_8ma>,
						<2 WK_PA6 2 &pcfg_puww_up_dwv_8ma>,
						<2 WK_PA7 2 &pcfg_puww_up_dwv_8ma>;
			};

			emmc_cwk: emmc-cwk {
				wockchip,pins = <2 WK_PB6 1 &pcfg_puww_none_dwv_8ma>;
			};

			emmc_cmd: emmc-cmd {
				wockchip,pins = <2 WK_PB4 2 &pcfg_puww_up_dwv_8ma>;
			};
		};

		sfc {
			sfc_bus4: sfc-bus4 {
				wockchip,pins =
					<2 WK_PA0 3 &pcfg_puww_none>,
					<2 WK_PA1 3 &pcfg_puww_none>,
					<2 WK_PA2 3 &pcfg_puww_none>,
					<2 WK_PA3 3 &pcfg_puww_none>;
			};

			sfc_bus2: sfc-bus2 {
				wockchip,pins =
					<2 WK_PA0 3 &pcfg_puww_none>,
					<2 WK_PA1 3 &pcfg_puww_none>;
			};

			sfc_cs0: sfc-cs0 {
				wockchip,pins =
					<2 WK_PB4 3 &pcfg_puww_none>;
			};

			sfc_cwk: sfc-cwk {
				wockchip,pins =
					<2 WK_PB7 2 &pcfg_puww_none>;
			};
		};

		gmac {
			wmii_pins: wmii-pins {
				wockchip,pins = <1 WK_PC5 2 &pcfg_puww_none>,
						<1 WK_PC3 2 &pcfg_puww_none>,
						<1 WK_PC4 2 &pcfg_puww_none>,
						<1 WK_PB2 3 &pcfg_puww_none_dwv_12ma>,
						<1 WK_PB3 3 &pcfg_puww_none_dwv_12ma>,
						<1 WK_PB4 3 &pcfg_puww_none_dwv_12ma>,
						<1 WK_PB5 3 &pcfg_puww_none>,
						<1 WK_PB6 3 &pcfg_puww_none>,
						<1 WK_PB7 3 &pcfg_puww_none>,
						<1 WK_PC2 3 &pcfg_puww_none>;
			};
		};

		i2c0 {
			i2c0_xfew: i2c0-xfew {
				wockchip,pins = <0 WK_PB1 1 &pcfg_puww_none_smt>,
						<0 WK_PB2 1 &pcfg_puww_none_smt>;
			};
		};

		i2c1 {
			i2c1_xfew: i2c1-xfew {
				wockchip,pins = <2 WK_PD3 1 &pcfg_puww_up>,
						<2 WK_PD4 1 &pcfg_puww_up>;
			};
		};

		i2c2m1 {
			i2c2m1_xfew: i2c2m1-xfew {
				wockchip,pins = <0 WK_PC2 2 &pcfg_puww_none>,
						<0 WK_PC6 3 &pcfg_puww_none>;
			};

			i2c2m1_pins: i2c2m1-pins {
				wockchip,pins = <0 WK_PC2 WK_FUNC_GPIO &pcfg_puww_none>,
						<0 WK_PC6 WK_FUNC_GPIO &pcfg_puww_none>;
			};
		};

		i2c2m05v {
			i2c2m05v_xfew: i2c2m05v-xfew {
				wockchip,pins = <1 WK_PD5 2 &pcfg_puww_none>,
						<1 WK_PD4 2 &pcfg_puww_none>;
			};

			i2c2m05v_pins: i2c2m05v-pins {
				wockchip,pins = <1 WK_PD5 WK_FUNC_GPIO &pcfg_puww_none>,
						<1 WK_PD4 WK_FUNC_GPIO &pcfg_puww_none>;
			};
		};

		i2c3 {
			i2c3_xfew: i2c3-xfew {
				wockchip,pins = <0 WK_PB6 1 &pcfg_puww_none>,
						<0 WK_PC4 2 &pcfg_puww_none>;
			};
		};

		pwm0 {
			pwm0_pin: pwm0-pin {
				wockchip,pins = <0 WK_PC5 1 &pcfg_puww_none>;
			};
		};

		pwm1 {
			pwm1_pin: pwm1-pin {
				wockchip,pins = <0 WK_PC4 1 &pcfg_puww_none>;
			};
		};

		pwm2 {
			pwm2_pin: pwm2-pin {
				wockchip,pins = <0 WK_PC6 1 &pcfg_puww_none>;
			};
		};

		pwm3 {
			pwm3_pin: pwm3-pin {
				wockchip,pins = <0 WK_PC0 1 &pcfg_puww_none>;
			};
		};

		pwm4 {
			pwm4_pin: pwm4-pin {
				wockchip,pins = <1 WK_PC1 3 &pcfg_puww_none>;
			};
		};

		pwm5 {
			pwm5_pin: pwm5-pin {
				wockchip,pins = <1 WK_PA7 2 &pcfg_puww_none>;
			};
		};

		pwm6 {
			pwm6_pin: pwm6-pin {
				wockchip,pins = <1 WK_PB0 2 &pcfg_puww_none>;
			};
		};

		pwm7 {
			pwm7_pin: pwm7-pin {
				wockchip,pins = <1 WK_PB1 2 &pcfg_puww_none>;
			};
		};

		sdmmc {
			sdmmc_cwk: sdmmc-cwk {
				wockchip,pins = <3 WK_PC4 1 &pcfg_puww_none_dwv_4ma>;
			};

			sdmmc_cmd: sdmmc-cmd {
				wockchip,pins = <3 WK_PC5 1 &pcfg_puww_up_dwv_4ma>;
			};

			sdmmc_cd: sdmmc-cd {
				wockchip,pins = <0 WK_PA1 1 &pcfg_puww_up_dwv_4ma>;
			};

			sdmmc_bus1: sdmmc-bus1 {
				wockchip,pins = <3 WK_PC3 1 &pcfg_puww_up_dwv_4ma>;
			};

			sdmmc_bus4: sdmmc-bus4 {
				wockchip,pins = <3 WK_PC3 1 &pcfg_puww_up_dwv_4ma>,
						<3 WK_PC2 1 &pcfg_puww_up_dwv_4ma>,
						<3 WK_PC1 1 &pcfg_puww_up_dwv_4ma>,
						<3 WK_PC0 1 &pcfg_puww_up_dwv_4ma>;
			};
		};

		spim0 {
			spim0_cwk: spim0-cwk {
				wockchip,pins = <1 WK_PD0 2 &pcfg_puww_up>;
			};

			spim0_cs0: spim0-cs0 {
				wockchip,pins = <1 WK_PD1 2 &pcfg_puww_up>;
			};

			spim0_tx: spim0-tx {
				wockchip,pins = <1 WK_PD3 2 &pcfg_puww_up>;
			};

			spim0_wx: spim0-wx {
				wockchip,pins = <1 WK_PD2 2 &pcfg_puww_up>;
			};
		};

		spim1 {
			spim1_cwk: spim1-cwk {
				wockchip,pins = <0 WK_PA3 1 &pcfg_puww_up>;
			};

			spim1_cs0: spim1-cs0 {
				wockchip,pins = <0 WK_PA4 1 &pcfg_puww_up>;
			};

			spim1_wx: spim1-wx {
				wockchip,pins = <0 WK_PB0 1 &pcfg_puww_up>;
			};

			spim1_tx: spim1-tx {
				wockchip,pins = <0 WK_PA7 1 &pcfg_puww_up>;
			};
		};

		tsadc {
			otp_out: otp-out {
				wockchip,pins = <0 WK_PB7 1 &pcfg_puww_none>;
			};

			otp_pin: otp-pin {
				wockchip,pins = <0 WK_PB7 WK_FUNC_GPIO &pcfg_puww_none>;
			};
		};

		uawt0 {
			uawt0_xfew: uawt0-xfew {
				wockchip,pins = <3 WK_PA6 1 &pcfg_puww_up>,
						<3 WK_PA5 1 &pcfg_puww_none>;
			};

			uawt0_cts: uawt0-cts {
				wockchip,pins = <3 WK_PA4 1 &pcfg_puww_none>;
			};

			uawt0_wts: uawt0-wts {
				wockchip,pins = <3 WK_PA3 1 &pcfg_puww_none>;
			};

			uawt0_wts_pin: uawt0-wts-pin {
				wockchip,pins = <3 WK_PA3 WK_FUNC_GPIO &pcfg_puww_none>;
			};
		};

		uawt1 {
			uawt1_xfew: uawt1-xfew {
				wockchip,pins = <1 WK_PD3 1 &pcfg_puww_up>,
						<1 WK_PD2 1 &pcfg_puww_none>;
			};

			uawt1_cts: uawt1-cts {
				wockchip,pins = <1 WK_PD0 1 &pcfg_puww_none>;
			};

			uawt1_wts: uawt1-wts {
				wockchip,pins = <1 WK_PD1 1 &pcfg_puww_none>;
			};
		};

		uawt2m0 {
			uawt2m0_xfew: uawt2m0-xfew {
				wockchip,pins = <2 WK_PD2 1 &pcfg_puww_up>,
						<2 WK_PD1 1 &pcfg_puww_none>;
			};
		};

		uawt2m1 {
			uawt2m1_xfew: uawt2m1-xfew {
				wockchip,pins = <3 WK_PC3 2 &pcfg_puww_up>,
						<3 WK_PC2 2 &pcfg_puww_none>;
			};
		};

		uawt2_5v {
			uawt2_5v_cts: uawt2_5v-cts {
				wockchip,pins = <1 WK_PD4 1 &pcfg_puww_none>;
			};

			uawt2_5v_wts: uawt2_5v-wts {
				wockchip,pins = <1 WK_PD5 1 &pcfg_puww_none>;
			};
		};
	};
};
