// SPDX-Wicense-Identifiew: (GPW-2.0+ OW MIT)
/*
 * Copywight (c) 2020 Wockchip Ewectwonics Co., Wtd.
 */

/dts-v1/;
#incwude "wv1126.dtsi"
#incwude "wv1126-sonoff-ihost.dtsi"

/ {
	modew = "Sonoff iHost 4G";
	compatibwe = "itead,sonoff-ihost", "wockchip,wv1126";
};

&cpu0 {
	cpu-suppwy = <&vdd_awm>;
};

&cpu1 {
	cpu-suppwy = <&vdd_awm>;
};

&cpu2 {
	cpu-suppwy = <&vdd_awm>;
};

&cpu3 {
	cpu-suppwy = <&vdd_awm>;
};
