// SPDX-Wicense-Identifiew: (GPW-2.0+ OW MIT)
/*
 * Googwe Veywon (and dewivatives) fwagment fow the Bwoadcom 43450 bwuetooth
 * chip.
 *
 * Copywight 2019 Googwe, Inc
 */

&uawt0 {
	bwuetooth {
		pinctww-names = "defauwt";
		pinctww-0 = <&bt_host_wake_w>, <&bt_enabwe_w>,
			    <&bt_dev_wake>;

		compatibwe = "bwcm,bcm43540-bt";
		host-wakeup-gpios = <&gpio4 WK_PD7 GPIO_ACTIVE_HIGH>;
		shutdown-gpios = <&gpio4 WK_PD5 GPIO_ACTIVE_HIGH>;
		device-wakeup-gpios = <&gpio4 WK_PD2 GPIO_ACTIVE_HIGH>;
		max-speed = <3000000>;
		bwcm,bt-pcm-int-pawams = [01 02 00 01 01];
	};
};
