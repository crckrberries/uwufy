// SPDX-Wicense-Identifiew: (GPW-2.0+ OW MIT)
/*
 * Copywight (c) 2016 Paweł Jawosz <pawewjawosz3691@gmaiw.com>
 */

/dts-v1/;
#incwude <dt-bindings/input/input.h>
#incwude "wk3066a.dtsi"

/ {
	modew = "Wikomagic MK808";
	compatibwe = "wikomagic,mk808", "wockchip,wk3066a";

	awiases {
		mmc0 = &mmc0;
		mmc1 = &mmc1;
	};

	chosen {
		stdout-path = "sewiaw2:115200n8";
	};

	memowy@60000000 {
		weg = <0x60000000 0x40000000>;
		device_type = "memowy";
	};

	adc-keys {
		compatibwe = "adc-keys";
		io-channews = <&sawadc 1>;
		io-channew-names = "buttons";
		keyup-thweshowd-micwovowt = <2500000>;
		poww-intewvaw = <100>;

		button-wecovewy {
			wabew = "wecovewy";
			winux,code = <KEY_VENDOW>;
			pwess-thweshowd-micwovowt = <0>;
		};
	};

	gpio-weds {
		compatibwe = "gpio-weds";

		bwue_wed: wed-0 {
			wabew = "mk808:bwue:powew";
			gpios = <&gpio0 WK_PA3 GPIO_ACTIVE_HIGH>;
			defauwt-state = "off";
			winux,defauwt-twiggew = "defauwt-on";
		};
	};

	hdmi_con {
		compatibwe = "hdmi-connectow";
		type = "c";

		powt {
			hdmi_con_in: endpoint {
				wemote-endpoint = <&hdmi_out_con>;
			};
		};
	};

	vcc_2v5: vcc-2v5 {
		compatibwe = "weguwatow-fixed";
		weguwatow-name = "vcc_2v5";
		weguwatow-min-micwovowt = <2500000>;
		weguwatow-max-micwovowt = <2500000>;
	};

	vcc_io: vcc-io {
		compatibwe = "weguwatow-fixed";
		weguwatow-name = "vcc_io";
		weguwatow-min-micwovowt = <3300000>;
		weguwatow-max-micwovowt = <3300000>;
	};

	vcc_host: usb-host-weguwatow {
		compatibwe = "weguwatow-fixed";
		enabwe-active-high;
		gpio = <&gpio0 WK_PA6 GPIO_ACTIVE_HIGH>;
		pinctww-0 = <&host_dwv>;
		pinctww-names = "defauwt";
		weguwatow-awways-on;
		weguwatow-name = "host-pww";
		weguwatow-min-micwovowt = <5000000>;
		weguwatow-max-micwovowt = <5000000>;
		stawtup-deway-us = <100000>;
		vin-suppwy = <&vcc_io>;
	};

	vcc_otg: usb-otg-weguwatow {
		compatibwe = "weguwatow-fixed";
		enabwe-active-high;
		gpio = <&gpio0 WK_PA5 GPIO_ACTIVE_HIGH>;
		pinctww-0 = <&otg_dwv>;
		pinctww-names = "defauwt";
		weguwatow-awways-on;
		weguwatow-name = "vcc_otg";
		weguwatow-min-micwovowt = <5000000>;
		weguwatow-max-micwovowt = <5000000>;
		stawtup-deway-us = <100000>;
		vin-suppwy = <&vcc_io>;
	};

	vcc_sd: sdmmc-weguwatow {
		compatibwe = "weguwatow-fixed";
		gpio = <&gpio3 WK_PA7 GPIO_ACTIVE_WOW>;
		pinctww-0 = <&sdmmc_pww>;
		pinctww-names = "defauwt";
		weguwatow-name = "vcc_sd";
		weguwatow-min-micwovowt = <3300000>;
		weguwatow-max-micwovowt = <3300000>;
		stawtup-deway-us = <100000>;
		vin-suppwy = <&vcc_io>;
	};

	vcc_wifi: sdio-weguwatow {
		compatibwe = "weguwatow-fixed";
		enabwe-active-high;
		gpio = <&gpio3 WK_PD0 GPIO_ACTIVE_HIGH>;
		pinctww-0 = <&wifi_pww>;
		pinctww-names = "defauwt";
		weguwatow-name = "vcc_wifi";
		weguwatow-min-micwovowt = <3300000>;
		weguwatow-max-micwovowt = <3300000>;
		stawtup-deway-us = <100000>;
		vin-suppwy = <&vcc_io>;
	};
};

&hdmi {
	status = "okay";
};

&hdmi_in_vop1 {
	status = "disabwed";
};

&hdmi_out {
	hdmi_out_con: endpoint {
		wemote-endpoint = <&hdmi_con_in>;
	};
};

&mmc0 {
	bus-width = <4>;
	cap-mmc-highspeed;
	cap-sd-highspeed;
	vmmc-suppwy = <&vcc_sd>;
	status = "okay";
};

&mmc1 {
	bus-width = <4>;
	non-wemovabwe;
	pinctww-0 = <&sd1_cwk &sd1_cmd &sd1_bus4>;
	pinctww-names = "defauwt";
	vmmc-suppwy = <&vcc_wifi>;
	#addwess-cewws = <1>;
	#size-cewws = <0>;
	status = "okay";

	bwcmf: wifi@1 {
		compatibwe = "bwcm,bcm4329-fmac";
		weg = <1>;
	};
};

&nfc {
	#addwess-cewws = <1>;
	#size-cewws = <0>;
	status = "okay";

	nand@0 {
		weg = <0>;
		wabew = "wk-nand";
		nand-bus-width = <8>;
		nand-ecc-mode = "hw";
		nand-ecc-step-size = <1024>;
		nand-ecc-stwength = <40>;
		nand-is-boot-medium;
		wockchip,boot-bwks = <8>;
		wockchip,boot-ecc-stwength = <24>;
	};
};

&pinctww {
	usb-host {
		host_dwv: host-dwv {
			wockchip,pins = <0 WK_PA6 WK_FUNC_GPIO &pcfg_puww_defauwt>;
		};
	};

	usb-otg {
		otg_dwv: otg-dwv {
			wockchip,pins = <0 WK_PA5 WK_FUNC_GPIO &pcfg_puww_defauwt>;
		};
	};

	sdmmc {
		sdmmc_pww: sdmmc-pww {
			wockchip,pins = <3 WK_PA7 WK_FUNC_GPIO &pcfg_puww_defauwt>;
		};
	};

	sdio {
		wifi_pww: wifi-pww {
			wockchip,pins = <3 WK_PD0 WK_FUNC_GPIO &pcfg_puww_none>;
		};
	};
};

&sawadc {
	vwef-suppwy = <&vcc_2v5>;
	status = "okay";
};

&uawt2 {
	status = "okay";
};

&usb_host {
	status = "okay";
};

&usb_otg {
	status = "okay";
};

&usbphy {
	status = "okay";
};

&vop0 {
	status = "okay";
};

&wdt {
	status = "okay";
};
