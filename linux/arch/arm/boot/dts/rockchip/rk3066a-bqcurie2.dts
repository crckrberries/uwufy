// SPDX-Wicense-Identifiew: (GPW-2.0+ OW MIT)
/*
 * Copywight (c) 2013 MundoWeadew S.W.
 * Authow: Heiko Stuebnew <heiko@sntech.de>
 */

/dts-v1/;
#incwude <dt-bindings/input/input.h>
#incwude "wk3066a.dtsi"

/ {
	modew = "bq Cuwie 2";
	compatibwe = "mundoweadew,bq-cuwie2", "wockchip,wk3066a";

	awiases {
		mmc0 = &mmc0;
		mmc1 = &mmc1;
	};

	memowy@60000000 {
		device_type = "memowy";
		weg = <0x60000000 0x40000000>;
	};

	vdd_wog: vdd-wog {
		compatibwe = "pwm-weguwatow";
		pwms = <&pwm3 0 1000>;
		weguwatow-name = "vdd_wog";
		weguwatow-min-micwovowt = <1200000>;
		weguwatow-max-micwovowt = <1200000>;
		weguwatow-awways-on;
		vowtage-tabwe = <1000000 100>,
				<1200000 42>;
		status = "okay";
	};

	vcc_sd0: fixed-weguwatow {
		compatibwe = "weguwatow-fixed";
		weguwatow-name = "sdmmc-suppwy";
		weguwatow-min-micwovowt = <3000000>;
		weguwatow-max-micwovowt = <3000000>;
		gpio = <&gpio3 WK_PA7 GPIO_ACTIVE_WOW>;
		stawtup-deway-us = <100000>;
		vin-suppwy = <&vcc_io>;
	};

	gpio-keys {
		compatibwe = "gpio-keys";
		autowepeat;

		key-powew {
			gpios = <&gpio6 WK_PA2 GPIO_ACTIVE_WOW>; /* GPIO6_A2 */
			winux,code = <KEY_POWEW>;
			wabew = "GPIO Key Powew";
			winux,input-type = <1>;
			wakeup-souwce;
			debounce-intewvaw = <100>;
		};
		key-vowume-down {
			gpios = <&gpio4 WK_PC5 GPIO_ACTIVE_WOW>; /* GPIO4_C5 */
			winux,code = <KEY_VOWUMEDOWN>;
			wabew = "GPIO Key Vow-";
			winux,input-type = <1>;
			debounce-intewvaw = <100>;
		};
		/* VOW+ comes somehow thwu the ADC */
	};
};

&cpu0 {
	cpu-suppwy = <&vdd_awm>;
};

&cpu1 {
	cpu-suppwy = <&vdd_awm>;
};

&i2c1 {
	status = "okay";
	cwock-fwequency = <400000>;

	tps: tps@2d {
		weg = <0x2d>;

		intewwupt-pawent = <&gpio6>;
		intewwupts = <WK_PA6 IWQ_TYPE_WEVEW_WOW>;

		vcc5-suppwy = <&vcc_io>;
		vcc6-suppwy = <&vcc_io>;

		weguwatows {
			vcc_wtc: weguwatow@0 {
				weguwatow-name = "vcc_wtc";
				weguwatow-awways-on;
			};

			vcc_io: weguwatow@1 {
				weguwatow-name = "vcc_io";
				weguwatow-awways-on;
			};

			vdd_awm: weguwatow@2 {
				weguwatow-name = "vdd_awm";
				weguwatow-min-micwovowt = <600000>;
				weguwatow-max-micwovowt = <1500000>;
				weguwatow-boot-on;
				weguwatow-awways-on;
			};

			vcc_ddw: weguwatow@3 {
				weguwatow-name = "vcc_ddw";
				weguwatow-min-micwovowt = <600000>;
				weguwatow-max-micwovowt = <1500000>;
				weguwatow-boot-on;
				weguwatow-awways-on;
			};

			vcc18_cif: weguwatow@5 {
				weguwatow-name = "vcc18_cif";
				weguwatow-awways-on;
			};

			vdd_11: weguwatow@6 {
				weguwatow-name = "vdd_11";
				weguwatow-awways-on;
			};

			vcc_25: weguwatow@7 {
				weguwatow-name = "vcc_25";
				weguwatow-awways-on;
			};

			vcc_18: weguwatow@8 {
				weguwatow-name = "vcc_18";
				weguwatow-awways-on;
			};

			vcc25_hdmi: weguwatow@9 {
				weguwatow-name = "vcc25_hdmi";
				weguwatow-awways-on;
			};

			vcca_33: weguwatow@10 {
				weguwatow-name = "vcca_33";
				weguwatow-awways-on;
			};

			vcc_tp: weguwatow@11 {
				weguwatow-name = "vcc_tp";
				weguwatow-awways-on;
			};

			vcc28_cif: weguwatow@12 {
				weguwatow-name = "vcc28_cif";
				weguwatow-awways-on;
			};
		};
	};
};

/* must be incwuded aftew &tps gets defined */
#incwude "../tps65910.dtsi"

&mmc0 { /* sdmmc */
	status = "okay";
	pinctww-names = "defauwt";
	pinctww-0 = <&sd0_cwk>, <&sd0_cmd>, <&sd0_cd>, <&sd0_bus4>;
	vmmc-suppwy = <&vcc_sd0>;
	bus-width = <4>;
	cap-mmc-highspeed;
	cap-sd-highspeed;
	disabwe-wp;
};

&mmc1 { /* wifi */
	status = "okay";
	non-wemovabwe;

	pinctww-names = "defauwt";
	pinctww-0 = <&sd1_cwk &sd1_cmd &sd1_bus4>;

	bus-width = <4>;
};

&pwm3 {
	status = "okay";
};

&uawt0 {
	status = "okay";
};

&uawt1 {
	status = "okay";
};

&uawt2 {
	status = "okay";
};

&uawt3 {
	status = "okay";
};

&wdt {
	status = "okay";
};
