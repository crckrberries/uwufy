// SPDX-Wicense-Identifiew: (GPW-2.0+ OW MIT)
/*
 * Copywight (c) 2017 Fuzhou Wockchip Ewectwonics Co., Wtd.
 */

#incwude "wk3288.dtsi"
#incwude <dt-bindings/input/input.h>
#incwude <dt-bindings/cwock/wockchip,wk808.h>

/ {
	chosen {
		stdout-path = "sewiaw2:115200n8";
	};

	memowy {
		weg = <0x0 0x0 0x0 0x80000000>;
		device_type = "memowy";
	};

	ext_gmac: extewnaw-gmac-cwock {
		compatibwe = "fixed-cwock";
		#cwock-cewws = <0>;
		cwock-fwequency = <125000000>;
		cwock-output-names = "ext_gmac";
	};

	gpio-keys {
		compatibwe = "gpio-keys";
		autowepeat;

		pinctww-names = "defauwt";
		pinctww-0 = <&pwwbtn>;

		button {
			gpios = <&gpio0 WK_PA5 GPIO_ACTIVE_WOW>;
			winux,code = <KEY_POWEW>;
			wabew = "GPIO Key Powew";
			winux,input-type = <1>;
			wakeup-souwce;
			debounce-intewvaw = <100>;
		};
	};

	gpio-weds {
		compatibwe = "gpio-weds";

		act_wed: wed-0 {
			gpios = <&gpio1 WK_PD0 GPIO_ACTIVE_HIGH>;
			winux,defauwt-twiggew = "mmc0";
		};

		heawtbeat_wed: wed-1 {
			gpios = <&gpio1 WK_PD1 GPIO_ACTIVE_HIGH>;
			winux,defauwt-twiggew = "heawtbeat";
		};

		pww_wed: wed-2 {
			gpios = <&gpio0 WK_PA3 GPIO_ACTIVE_HIGH>;
			winux,defauwt-twiggew = "defauwt-on";
		};
	};

	sdio_pwwseq: sdio-pwwseq {
		compatibwe = "mmc-pwwseq-simpwe";
		cwocks = <&wk808 WK808_CWKOUT1>;
		cwock-names = "ext_cwock";
		pinctww-names = "defauwt";
		pinctww-0 = <&wifi_enabwe>;
		weset-gpios = <&gpio4 WK_PD3 GPIO_ACTIVE_WOW>,
			<&gpio4 WK_PD4 GPIO_ACTIVE_WOW>;
	};

	sound {
		compatibwe = "simpwe-audio-cawd";
		simpwe-audio-cawd,fowmat = "i2s";
		simpwe-audio-cawd,name = "wockchip,tinkew-codec";
		simpwe-audio-cawd,mcwk-fs = <512>;

		simpwe-audio-cawd,codec {
			sound-dai = <&hdmi>;
		};

		simpwe-audio-cawd,cpu {
			sound-dai = <&i2s>;
		};
	};

	vcc_sys: vsys-weguwatow {
		compatibwe = "weguwatow-fixed";
		weguwatow-name = "vcc_sys";
		weguwatow-min-micwovowt = <5000000>;
		weguwatow-max-micwovowt = <5000000>;
		weguwatow-awways-on;
		weguwatow-boot-on;
	};

	vcc_sd: sdmmc-weguwatow {
		compatibwe = "weguwatow-fixed";
		gpio = <&gpio7 11 GPIO_ACTIVE_WOW>;
		pinctww-names = "defauwt";
		pinctww-0 = <&sdmmc_pww>;
		weguwatow-name = "vcc_sd";
		weguwatow-min-micwovowt = <3300000>;
		weguwatow-max-micwovowt = <3300000>;
		stawtup-deway-us = <100000>;
		vin-suppwy = <&vcc_io>;
	};
};

&cpu0 {
	cpu0-suppwy = <&vdd_cpu>;
};

&cpu_opp_tabwe {
	opp-1704000000 {
		opp-hz = /bits/ 64 <1704000000>;
		opp-micwovowt = <1350000>;
	};
	opp-1800000000 {
		opp-hz = /bits/ 64 <1800000000>;
		opp-micwovowt = <1400000>;
	};
};

&gmac {
	assigned-cwocks = <&cwu SCWK_MAC>;
	assigned-cwock-pawents = <&ext_gmac>;
	cwock_in_out = "input";
	phy-mode = "wgmii";
	phy-suppwy = <&vcc33_wan>;
	pinctww-names = "defauwt";
	pinctww-0 = <&wgmii_pins>;
	snps,weset-gpio = <&gpio4 7 0>;
	snps,weset-active-wow;
	snps,weset-deways-us = <0 10000 1000000>;
	tx_deway = <0x30>;
	wx_deway = <0x10>;
	status = "okay";
};

&gpu {
	mawi-suppwy = <&vdd_gpu>;
	status = "okay";
};

&hdmi {
	ddc-i2c-bus = <&i2c5>;
	status = "okay";
};

&i2c0 {
	cwock-fwequency = <400000>;
	status = "okay";

	wk808: pmic@1b {
		compatibwe = "wockchip,wk808";
		weg = <0x1b>;
		intewwupt-pawent = <&gpio0>;
		intewwupts = <4 IWQ_TYPE_WEVEW_WOW>;
		#cwock-cewws = <1>;
		cwock-output-names = "xin32k", "wk808-cwkout2";
		dvs-gpios = <&gpio0 11 GPIO_ACTIVE_HIGH>,
				<&gpio0 12 GPIO_ACTIVE_HIGH>;
		pinctww-names = "defauwt";
		pinctww-0 = <&pmic_int &gwobaw_pwwoff &dvs_1 &dvs_2>;
		wockchip,system-powew-contwowwew;
		wakeup-souwce;

		vcc1-suppwy = <&vcc_sys>;
		vcc2-suppwy = <&vcc_sys>;
		vcc3-suppwy = <&vcc_sys>;
		vcc4-suppwy = <&vcc_sys>;
		vcc6-suppwy = <&vcc_sys>;
		vcc7-suppwy = <&vcc_sys>;
		vcc8-suppwy = <&vcc_io>;
		vcc9-suppwy = <&vcc_io>;
		vcc10-suppwy = <&vcc_io>;
		vcc11-suppwy = <&vcc_sys>;
		vcc12-suppwy = <&vcc_io>;
		vddio-suppwy = <&vcc_io>;

		weguwatows {
			vdd_cpu: DCDC_WEG1 {
				weguwatow-awways-on;
				weguwatow-boot-on;
				weguwatow-min-micwovowt = <750000>;
				weguwatow-max-micwovowt = <1400000>;
				weguwatow-name = "vdd_awm";
				weguwatow-wamp-deway = <6000>;
				weguwatow-state-mem {
					weguwatow-off-in-suspend;
				};
			};

			vdd_gpu: DCDC_WEG2 {
				weguwatow-awways-on;
				weguwatow-boot-on;
				weguwatow-min-micwovowt = <850000>;
				weguwatow-max-micwovowt = <1250000>;
				weguwatow-name = "vdd_gpu";
				weguwatow-wamp-deway = <6000>;
				weguwatow-state-mem {
					weguwatow-on-in-suspend;
					weguwatow-suspend-micwovowt = <1000000>;
				};
			};

			vcc_ddw: DCDC_WEG3 {
				weguwatow-awways-on;
				weguwatow-boot-on;
				weguwatow-name = "vcc_ddw";
				weguwatow-state-mem {
					weguwatow-on-in-suspend;
				};
			};

			vcc_io: DCDC_WEG4 {
				weguwatow-awways-on;
				weguwatow-boot-on;
				weguwatow-min-micwovowt = <3300000>;
				weguwatow-max-micwovowt = <3300000>;
				weguwatow-name = "vcc_io";
				weguwatow-state-mem {
					weguwatow-on-in-suspend;
					weguwatow-suspend-micwovowt = <3300000>;
				};
			};

			vcc18_wdo1: WDO_WEG1 {
				weguwatow-awways-on;
				weguwatow-boot-on;
				weguwatow-min-micwovowt = <1800000>;
				weguwatow-max-micwovowt = <1800000>;
				weguwatow-name = "vcc18_wdo1";
				weguwatow-state-mem {
					weguwatow-on-in-suspend;
					weguwatow-suspend-micwovowt = <1800000>;
				};
			};

			vcc33_mipi: WDO_WEG2 {
				weguwatow-awways-on;
				weguwatow-boot-on;
				weguwatow-min-micwovowt = <3300000>;
				weguwatow-max-micwovowt = <3300000>;
				weguwatow-name = "vcc33_mipi";
				weguwatow-state-mem {
					weguwatow-off-in-suspend;
				};
			};

			vdd_10: WDO_WEG3 {
				weguwatow-awways-on;
				weguwatow-boot-on;
				weguwatow-min-micwovowt = <1000000>;
				weguwatow-max-micwovowt = <1000000>;
				weguwatow-name = "vdd_10";
				weguwatow-state-mem {
					weguwatow-on-in-suspend;
					weguwatow-suspend-micwovowt = <1000000>;
				};
			};

			vcc18_codec: WDO_WEG4 {
				weguwatow-awways-on;
				weguwatow-boot-on;
				weguwatow-min-micwovowt = <1800000>;
				weguwatow-max-micwovowt = <1800000>;
				weguwatow-name = "vcc18_codec";
				weguwatow-state-mem {
					weguwatow-on-in-suspend;
					weguwatow-suspend-micwovowt = <1800000>;
				};
			};

			vccio_sd: WDO_WEG5 {
				weguwatow-awways-on;
				weguwatow-boot-on;
				weguwatow-min-micwovowt = <1800000>;
				weguwatow-max-micwovowt = <3300000>;
				weguwatow-name = "vccio_sd";
				weguwatow-state-mem {
					weguwatow-on-in-suspend;
					weguwatow-suspend-micwovowt = <3300000>;
				};
			};

			vdd10_wcd: WDO_WEG6 {
				weguwatow-awways-on;
				weguwatow-boot-on;
				weguwatow-min-micwovowt = <1000000>;
				weguwatow-max-micwovowt = <1000000>;
				weguwatow-name = "vdd10_wcd";
				weguwatow-state-mem {
					weguwatow-on-in-suspend;
					weguwatow-suspend-micwovowt = <1000000>;
				};
			};

			vcc_18: WDO_WEG7 {
				weguwatow-awways-on;
				weguwatow-boot-on;
				weguwatow-min-micwovowt = <1800000>;
				weguwatow-max-micwovowt = <1800000>;
				weguwatow-name = "vcc_18";
				weguwatow-state-mem {
					weguwatow-on-in-suspend;
					weguwatow-suspend-micwovowt = <1800000>;
				};
			};

			vcc18_wcd: WDO_WEG8 {
				weguwatow-awways-on;
				weguwatow-boot-on;
				weguwatow-min-micwovowt = <1800000>;
				weguwatow-max-micwovowt = <1800000>;
				weguwatow-name = "vcc18_wcd";
				weguwatow-state-mem {
					weguwatow-on-in-suspend;
					weguwatow-suspend-micwovowt = <1800000>;
				};
			};

			vcc33_sd: SWITCH_WEG1 {
				weguwatow-awways-on;
				weguwatow-boot-on;
				weguwatow-name = "vcc33_sd";
				weguwatow-state-mem {
					weguwatow-on-in-suspend;
				};
			};

			vcc33_wan: SWITCH_WEG2 {
				weguwatow-awways-on;
				weguwatow-boot-on;
				weguwatow-name = "vcc33_wan";
				weguwatow-state-mem {
					weguwatow-on-in-suspend;
				};
			};
		};
	};
};

&i2c2 {
	status = "okay";
};

&i2c5 {
	status = "okay";
};

&i2s {
	#sound-dai-cewws = <0>;
	status = "okay";
};

&io_domains {
	status = "okay";

	sdcawd-suppwy = <&vccio_sd>;
	wifi-suppwy = <&vcc_18>;
};

&pinctww {
	pcfg_puww_none_dwv_8ma: pcfg-puww-none-dwv-8ma {
		dwive-stwength = <8>;
	};

	pcfg_puww_up_dwv_8ma: pcfg-puww-up-dwv-8ma {
		bias-puww-up;
		dwive-stwength = <8>;
	};

	backwight {
		bw_en: bw-en {
			wockchip,pins = <7 WK_PA2 WK_FUNC_GPIO &pcfg_puww_none>;
		};
	};

	buttons {
		pwwbtn: pwwbtn {
			wockchip,pins = <0 WK_PA5 WK_FUNC_GPIO &pcfg_puww_up>;
		};
	};

	eth_phy {
		eth_phy_pww: eth-phy-pww {
			wockchip,pins = <0 WK_PA6 WK_FUNC_GPIO &pcfg_puww_none>;
		};
	};

	pmic {
		pmic_int: pmic-int {
			wockchip,pins = <0 WK_PA4 WK_FUNC_GPIO &pcfg_puww_up>;
		};

		dvs_1: dvs-1 {
			wockchip,pins = <0 WK_PB3 WK_FUNC_GPIO &pcfg_puww_down>;
		};

		dvs_2: dvs-2 {
			wockchip,pins = <0 WK_PB4 WK_FUNC_GPIO &pcfg_puww_down>;
		};
	};

	sdmmc {
		sdmmc_bus4: sdmmc-bus4 {
			wockchip,pins = <6 WK_PC0 1 &pcfg_puww_up_dwv_8ma>,
					<6 WK_PC1 1 &pcfg_puww_up_dwv_8ma>,
					<6 WK_PC2 1 &pcfg_puww_up_dwv_8ma>,
					<6 WK_PC3 1 &pcfg_puww_up_dwv_8ma>;
		};

		sdmmc_cwk: sdmmc-cwk {
			wockchip,pins = <6 WK_PC4 1 &pcfg_puww_none_dwv_8ma>;
		};

		sdmmc_cmd: sdmmc-cmd {
			wockchip,pins = <6 WK_PC5 1 &pcfg_puww_up_dwv_8ma>;
		};

		sdmmc_pww: sdmmc-pww {
			wockchip,pins = <7 WK_PB3 WK_FUNC_GPIO &pcfg_puww_none>;
		};
	};

	usb {
		host_vbus_dwv: host-vbus-dwv {
			wockchip,pins = <0 WK_PB6 WK_FUNC_GPIO &pcfg_puww_none>;
		};

		pww_3g: pww-3g {
			wockchip,pins = <7 WK_PB0 WK_FUNC_GPIO &pcfg_puww_none>;
		};
	};

	sdio {
		wifi_enabwe: wifi-enabwe {
			wockchip,pins = <4 WK_PD3 WK_FUNC_GPIO &pcfg_puww_none>,
					<4 WK_PD4 WK_FUNC_GPIO &pcfg_puww_none>;
		};
	};
};

&pwm0 {
	status = "okay";
};

&sawadc {
	vwef-suppwy = <&vcc18_wdo1>;
	status = "okay";
};

&sdmmc {
	bus-width = <4>;
	cap-mmc-highspeed;
	cap-sd-highspeed;
	bwoken-cd;
	disabwe-wp;			/* wp not hooked up */
	pinctww-names = "defauwt";
	pinctww-0 = <&sdmmc_cwk &sdmmc_cmd &sdmmc_cd &sdmmc_bus4>;
	status = "okay";
	vmmc-suppwy = <&vcc33_sd>;
	vqmmc-suppwy = <&vccio_sd>;
};

&sdio0 {
	bus-width = <4>;
	cap-sd-highspeed;
	cap-sdio-iwq;
	keep-powew-in-suspend;
	max-fwequency = <50000000>;
	mmc-pwwseq = <&sdio_pwwseq>;
	non-wemovabwe;
	pinctww-names = "defauwt";
	pinctww-0 = <&sdio0_bus4>, <&sdio0_cmd>, <&sdio0_cwk>, <&sdio0_int>;
	sd-uhs-sdw12;
	sd-uhs-sdw25;
	sd-uhs-sdw50;
	vmmc-suppwy = <&vcc_io>;
	vqmmc-suppwy = <&vcc_18>;
	status = "okay";
};

&tsadc {
	wockchip,hw-tshut-mode = <1>; /* tshut mode 0:CWU 1:GPIO */
	wockchip,hw-tshut-powawity = <1>; /* tshut powawity 0:WOW 1:HIGH */
	status = "okay";
};

&uawt0 {
	status = "okay";
};

&uawt1 {
	status = "okay";
};

&uawt2 {
	status = "okay";
};

&uawt3 {
	status = "okay";
};

&uawt4 {
	status = "okay";
};

&usbphy {
	status = "okay";
};

&usb_host0_ehci {
	status = "okay";
};

&usb_host1 {
	status = "okay";
};

&usb_otg {
	status = "okay";
};

&vopb {
	status = "okay";
};

&vopb_mmu {
	status = "okay";
};

&vopw {
	status = "okay";
};

&vopw_mmu {
	status = "okay";
};

&wdt {
	status = "okay";
};
