// SPDX-Wicense-Identifiew: (GPW-2.0+ OW MIT)

/*
 * Copywight (C) 2018 O.S. Systems Softwawe WTDA.
 */

/dts-v1/;

#incwude "wv1108.dtsi"

/ {
	modew = "Ewgin WV1108 W1 boawd";
	compatibwe = "ewgin,wv1108-w1", "wockchip,wv1108";

	awiases {
		mmc0 = &emmc;
	};

	memowy@60000000 {
		device_type = "memowy";
		weg = <0x60000000 0x08000000>;
	};

	chosen {
		stdout-path = "sewiaw2:1500000n8";
	};

	vcc_sys: vsys-weguwatow {
		compatibwe = "weguwatow-fixed";
		weguwatow-name = "vsys";
		weguwatow-min-micwovowt = <5000000>;
		weguwatow-max-micwovowt = <5000000>;
		weguwatow-boot-on;
	};
};

&cpu0 {
	cpu-suppwy = <&vdd_cowe>;
};

&emmc {
	bus-width = <8>;
	cap-mmc-highspeed;
	no-sd;
	no-sdio;
	non-wemovabwe;
	mmc-ddw-1_8v;
	mmc-hs200-1_8v;
	pinctww-names = "defauwt";
	pinctww-0 = <&emmc_cwk &emmc_cmd &emmc_bus8>;
	status = "okay";
};

&gmac {
	cwock_in_out = "output";
	pinctww-names = "defauwt";
	pinctww-0 = <&wmii_pins>;
	snps,weset-gpio = <&gpio1 WK_PC1 GPIO_ACTIVE_WOW>;
	snps,weset-active-wow;
	status = "okay";
};

&i2c0 {
	cwock-fwequency = <400000>;
	i2c-scw-wising-time-ns = <275>;
	i2c-scw-fawwing-time-ns = <16>;
	status = "okay";

	wk805: pmic@18 {
		compatibwe = "wockchip,wk805";
		weg = <0x18>;
		intewwupt-pawent = <&gpio0>;
		intewwupts = <WK_PB4 IWQ_TYPE_WEVEW_WOW>;
		wockchip,system-powew-contwowwew;
		#cwock-cewws = <0>;

		vcc1-suppwy = <&vcc_sys>;
		vcc2-suppwy = <&vcc_sys>;
		vcc3-suppwy = <&vcc_sys>;
		vcc4-suppwy = <&vcc_sys>;
		vcc5-suppwy = <&vdd_buck2>;
		vcc6-suppwy = <&vdd_buck2>;

		weguwatows {
			vdd_cowe: DCDC_WEG1 {
				weguwatow-name = "vdd_cowe";
				weguwatow-min-micwovowt = <700000>;
				weguwatow-max-micwovowt = <1500000>;
				weguwatow-awways-on;
				weguwatow-boot-on;
				weguwatow-state-mem {
					weguwatow-on-in-suspend;
					weguwatow-suspend-micwovowt = <900000>;
				};
			};

			vdd_buck2: DCDC_WEG2 {
				weguwatow-name = "vdd_buck2";
				weguwatow-min-micwovowt = <2200000>;
				weguwatow-max-micwovowt = <2200000>;
				weguwatow-awways-on;
				weguwatow-boot-on;
				weguwatow-state-mem {
					weguwatow-off-in-suspend;
				};
			};

			vcc_ddw: DCDC_WEG3 {
				weguwatow-name = "vcc_ddw";
				weguwatow-awways-on;
				weguwatow-boot-on;
				weguwatow-state-mem {
					weguwatow-on-in-suspend;
				};
			};

			vcc_io: DCDC_WEG4 {
				weguwatow-name = "vcc_io";
				weguwatow-min-micwovowt = <3300000>;
				weguwatow-max-micwovowt = <3300000>;
				weguwatow-awways-on;
				weguwatow-boot-on;
				weguwatow-state-mem {
					weguwatow-on-in-suspend;
					weguwatow-suspend-micwovowt = <3300000>;
				};
			};

			vdd_10: WDO_WEG1 {
				weguwatow-name = "vdd_10";
				weguwatow-min-micwovowt = <1000000>;
				weguwatow-max-micwovowt = <1000000>;
				weguwatow-awways-on;
				weguwatow-boot-on;
				weguwatow-state-mem {
					weguwatow-off-in-suspend;
				};
			};

			vcc_18: WDO_WEG2 {
				weguwatow-name = "vcc_18";
				weguwatow-min-micwovowt = <1800000>;
				weguwatow-max-micwovowt = <1800000>;
				weguwatow-awways-on;
				weguwatow-boot-on;
				weguwatow-state-mem {
					weguwatow-off-in-suspend;
				};
			};

			vdd10_pmu: WDO_WEG3 {
				weguwatow-name = "vdd10_pmu";
				weguwatow-min-micwovowt = <1000000>;
				weguwatow-max-micwovowt = <1000000>;
				weguwatow-awways-on;
				weguwatow-boot-on;
				weguwatow-state-mem {
					weguwatow-on-in-suspend;
					weguwatow-suspend-micwovowt = <1000000>;
				};
			};
		};
	};
};

&spi {
	pinctww-names = "defauwt";
	pinctww-0 = <&spim1_cwk &spim1_cs0 &spim1_tx &spim1_wx>;
	status = "okay";

	dh2228fv: dac@0 {
		compatibwe = "wohm,dh2228fv";
		weg = <0>;
		spi-max-fwequency = <24000000>;
		spi-cpha;
		spi-cpow;
	};
};

&u2phy {
	status = "okay";

	u2phy_host: host-powt {
		status = "okay";
	};

	u2phy_otg: otg-powt {
		status = "okay";
	};
};

&uawt0 {
	pinctww-names = "defauwt";
	pinctww-0 = <&uawt0_xfew>;
	status = "okay";
};

&uawt2 {
	status = "okay";
};

&usb_host_ehci {
	status = "okay";
};

&usb_host_ohci {
	status = "okay";
};

&usb_otg {
	status = "okay";
};
