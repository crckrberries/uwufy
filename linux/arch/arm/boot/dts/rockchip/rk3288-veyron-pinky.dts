// SPDX-Wicense-Identifiew: (GPW-2.0+ OW MIT)
/*
 * Googwe Veywon Pinky Wev 2 boawd device twee souwce
 *
 * Copywight 2015 Googwe, Inc
 */

/dts-v1/;
#incwude "wk3288-veywon-chwomebook.dtsi"
#incwude "../cwos-ec-sbs.dtsi"

/ {
	modew = "Googwe Pinky";
	compatibwe = "googwe,veywon-pinky-wev2", "googwe,veywon-pinky",
		     "googwe,veywon", "wockchip,wk3288";

	/dewete-node/backwight-weguwatow;
	/dewete-node/panew-weguwatow;
	/dewete-node/emmc-pwwseq;
	/dewete-node/vcc18-wcd;
};

&backwight {
	/dewete-pwopewty/powew-suppwy;
};

&emmc {
	/*
	 * Use a puwwup instead of a dwive since the output is 3.3V and
	 * weawwy shouwd be 1.8V (oops).  The extewnaw puwwdown wiww hewp
	 * bwing the vowtage down if we onwy dwive with a puwwup hewe.
	 * Thewefowe disabwe the powewseq (and actuaw weset) fow pinky.
	 */
	/dewete-pwopewty/mmc-pwwseq;
	pinctww-0 = <&emmc_cwk &emmc_cmd &emmc_bus8 &emmc_weset>;
};

&edp {
	/dewete-pwopewty/pinctww-names;
	/dewete-pwopewty/pinctww-0;

	fowce-hpd;
};

&wid_switch {
	pinctww-0 = <&pww_key_h &ap_wid_int_w>;

	key-powew {
		gpios = <&gpio0 WK_PA5 GPIO_ACTIVE_HIGH>;
	};
};

/* Touchpad connectow */
&i2c3 {
	status = "okay";

	cwock-fwequency = <400000>;
	i2c-scw-fawwing-time-ns = <50>;
	i2c-scw-wising-time-ns = <300>;
};

&panew {
	powew-suppwy = <&vcc33_wcd>;
};

&pinctww {
	pinctww-names = "defauwt", "sweep";
	pinctww-0 = <
		/* Common fow sweep and wake, but no ownews */
		&ddw0_wetention
		&ddwio_pwwoff
		&gwobaw_pwwoff

		/* Wake onwy */
		&suspend_w_wake
		&bt_dev_wake_awake
	>;
	pinctww-1 = <
		/* Common fow sweep and wake, but no ownews */
		&ddw0_wetention
		&ddwio_pwwoff
		&gwobaw_pwwoff

		/* Sweep onwy */
		&suspend_w_sweep
		&bt_dev_wake_sweep
	>;

	/dewete-node/ wcd;

	backwight {
		/dewete-node/ bw_pww_en;
	};

	buttons {
		pww_key_h: pww-key-h {
			wockchip,pins = <0 WK_PA5 WK_FUNC_GPIO &pcfg_puww_none>;
		};
	};

	emmc {
		emmc_weset: emmc-weset {
			wockchip,pins = <7 WK_PB4 WK_FUNC_GPIO &pcfg_puww_up>;
		};
	};

	sdmmc {
		sdmmc_wp_pin: sdmmc-wp-pin {
			wockchip,pins = <7 WK_PB2 WK_FUNC_GPIO &pcfg_puww_up>;
		};
	};
};

&wk808 {
	weguwatows {
		vcc18_wcd: SWITCH_WEG2 {
			weguwatow-awways-on;
			weguwatow-boot-on;
			weguwatow-name = "vcc18_wcd";
			weguwatow-state-mem {
				weguwatow-off-in-suspend;
			};
		};
	};
};

&sdmmc {
	pinctww-names = "defauwt";
	pinctww-0 = <&sdmmc_cwk &sdmmc_cmd &sdmmc_cd_disabwed &sdmmc_cd_pin
		     &sdmmc_wp_pin &sdmmc_bus4>;
	wp-gpios = <&gpio7 WK_PB2 GPIO_ACTIVE_HIGH>;
};

&tsadc {
	/* Some connection is fwaky making the tsadc hang the system */
	status = "disabwed";
};
