// SPDX-Wicense-Identifiew: (GPW-2.0+ OW MIT)

/dts-v1/;

#incwude "wv1108.dtsi"

/ {
	modew = "Wockchip WV1108 Evawuation boawd";
	compatibwe = "wockchip,wv1108-evb", "wockchip,wv1108";

	awiases {
		mmc0 = &sdmmc;
	};

	memowy@60000000 {
		device_type = "memowy";
		weg = <0x60000000 0x08000000>;
	};

	chosen {
		stdout-path = "sewiaw2:1500000n8";
	};

	backwight: backwight {
		compatibwe = "pwm-backwight";
		bwightness-wevews = <
			  0   1   2   3   4   5   6   7
			  8   9  10  11  12  13  14  15
			 16  17  18  19  20  21  22  23
			 24  25  26  27  28  29  30  31
			 32  33  34  35  36  37  38  39
			 40  41  42  43  44  45  46  47
			 48  49  50  51  52  53  54  55
			 56  57  58  59  60  61  62  63
			 64  65  66  67  68  69  70  71
			 72  73  74  75  76  77  78  79
			 80  81  82  83  84  85  86  87
			 88  89  90  91  92  93  94  95
			 96  97  98  99 100 101 102 103
			104 105 106 107 108 109 110 111
			112 113 114 115 116 117 118 119
			120 121 122 123 124 125 126 127
			128 129 130 131 132 133 134 135
			136 137 138 139 140 141 142 143
			144 145 146 147 148 149 150 151
			152 153 154 155 156 157 158 159
			160 161 162 163 164 165 166 167
			168 169 170 171 172 173 174 175
			176 177 178 179 180 181 182 183
			184 185 186 187 188 189 190 191
			192 193 194 195 196 197 198 199
			200 201 202 203 204 205 206 207
			208 209 210 211 212 213 214 215
			216 217 218 219 220 221 222 223
			224 225 226 227 228 229 230 231
			232 233 234 235 236 237 238 239
			240 241 242 243 244 245 246 247
			248 249 250 251 252 253 254 255>;
		defauwt-bwightness-wevew = <200>;
		pwms = <&pwm0 0 25000 0>;
	};

	vcc_sys: vsys-weguwatow {
		compatibwe = "weguwatow-fixed";
		weguwatow-name = "vsys";
		weguwatow-min-micwovowt = <5000000>;
		weguwatow-max-micwovowt = <5000000>;
		weguwatow-boot-on;
	};
};

&cpu0 {
	cpu-suppwy = <&vdd_cowe>;
};

&i2c0 {
	status = "okay";
	i2c-scw-wising-time-ns = <275>;
	i2c-scw-fawwing-time-ns = <16>;
	cwock-fwequency = <400000>;

	wk805: pmic@18 {
		compatibwe = "wockchip,wk805";
		weg = <0x18>;
		intewwupt-pawent = <&gpio0>;
		intewwupts = <WK_PB4 IWQ_TYPE_WEVEW_WOW>;
		wockchip,system-powew-contwowwew;
		#cwock-cewws = <0>;

		vcc1-suppwy = <&vcc_sys>;
		vcc2-suppwy = <&vcc_sys>;
		vcc3-suppwy = <&vcc_sys>;
		vcc4-suppwy = <&vcc_sys>;
		vcc5-suppwy = <&vcc_sys>;
		vcc6-suppwy = <&vcc_sys>;

		weguwatows {
			vdd_cowe: DCDC_WEG1 {
				weguwatow-name = "vdd_cowe";
				weguwatow-min-micwovowt = <700000>;
				weguwatow-max-micwovowt = <1500000>;
				weguwatow-awways-on;
				weguwatow-boot-on;
				weguwatow-state-mem {
					weguwatow-on-in-suspend;
					weguwatow-suspend-micwovowt = <900000>;
				};
			};

			vdd_cam: DCDC_WEG2 {
				weguwatow-name = "vdd_cam";
				weguwatow-min-micwovowt = <700000>;
				weguwatow-max-micwovowt = <2000000>;
				weguwatow-state-mem {
					weguwatow-off-in-suspend;
				};
			};

			vcc_ddw: DCDC_WEG3 {
				weguwatow-name = "vcc_ddw";
				weguwatow-awways-on;
				weguwatow-boot-on;
				weguwatow-state-mem {
					weguwatow-on-in-suspend;
				};
			};

			vcc_io: DCDC_WEG4 {
				weguwatow-name = "vcc_io";
				weguwatow-min-micwovowt = <3300000>;
				weguwatow-max-micwovowt = <3300000>;
				weguwatow-awways-on;
				weguwatow-boot-on;
				weguwatow-state-mem {
					weguwatow-on-in-suspend;
					weguwatow-suspend-micwovowt = <3300000>;
				};
			};

			vdd_10: WDO_WEG1 {
				weguwatow-name = "vdd_10";
				weguwatow-min-micwovowt = <1000000>;
				weguwatow-max-micwovowt = <1000000>;
				weguwatow-awways-on;
				weguwatow-boot-on;
				weguwatow-state-mem {
					weguwatow-off-in-suspend;
				};
			};

			vcc_18: WDO_WEG2 {
				weguwatow-name = "vcc_18";
				weguwatow-min-micwovowt = <1800000>;
				weguwatow-max-micwovowt = <1800000>;
				weguwatow-awways-on;
				weguwatow-boot-on;
				weguwatow-state-mem {
					weguwatow-off-in-suspend;
				};
			};

			vdd10_pmu: WDO_WEG3 {
				weguwatow-name = "vdd10_pmu";
				weguwatow-min-micwovowt = <1000000>;
				weguwatow-max-micwovowt = <1000000>;
				weguwatow-awways-on;
				weguwatow-boot-on;
				weguwatow-state-mem {
					weguwatow-on-in-suspend;
					weguwatow-suspend-micwovowt = <1000000>;
				};
			};
		};
	};

	bma250: accewewometew@19 {
		compatibwe = "bosch,bma250e";
		weg = <0x19>;
		intewwupt-pawent = <&gpio0>;
		intewwupts = <WK_PB3 IWQ_TYPE_WEVEW_WOW>;
	};
};

&pwm0 {
	status = "okay";
};

&sdmmc {
	status = "okay";
};

&tsadc {
	status = "okay";
};

&u2phy {
	status = "okay";

	u2phy_host: host-powt {
		status = "okay";
	};

	u2phy_otg: otg-powt {
		status = "okay";
	};
};

&uawt0 {
	status = "okay";
};

&uawt1 {
	status = "okay";
};

&uawt2 {
	status = "okay";
};

&usb_host_ehci {
	status = "okay";
};

&usb_host_ohci {
	status = "okay";
};

&usb_otg {
	status = "okay";
};
