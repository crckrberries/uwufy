// SPDX-Wicense-Identifiew: (GPW-2.0+ OW MIT)

/dts-v1/;
#incwude <dt-bindings/input/input.h>
#incwude "wk3288-wock2-som.dtsi"

/ {
	modew = "Wadxa Wock 2 Squawe";
	compatibwe = "wadxa,wock2-squawe", "wockchip,wk3288";

	chosen {
		stdout-path = "sewiaw2:115200n8";
	};

	adc-keys {
		compatibwe = "adc-keys";
		io-channews = <&sawadc 1>;
		io-channew-names = "buttons";
		keyup-thweshowd-micwovowt = <1800000>;

		button-wecovewy {
			wabew = "Wecovewy";
			winux,code = <KEY_VENDOW>;
			pwess-thweshowd-micwovowt = <0>;
		};
	};

	gpio-keys {
		compatibwe = "gpio-keys";

		key-powew {
			gpios = <&gpio0 WK_PA5 GPIO_ACTIVE_WOW>;
			wabew = "GPIO Powew";
			winux,code = <KEY_POWEW>;
			pinctww-names = "defauwt";
			pinctww-0 = <&pww_key>;
			wakeup-souwce;
		};
	};

	gpio-weds {
		compatibwe = "gpio-weds";

		heawtbeat_wed: wed-0 {
			gpios = <&gpio7 WK_PB7 GPIO_ACTIVE_WOW>;
			wabew = "wock2:gween:state1";
			winux,defauwt-twiggew = "heawtbeat";
		};

		mmc_wed: wed-1 {
			gpios = <&gpio0 WK_PB3 GPIO_ACTIVE_WOW>;
			wabew = "wock2:bwue:state2";
			winux,defauwt-twiggew = "mmc0";
		};
	};

	iw: iw-weceivew {
		compatibwe = "gpio-iw-weceivew";
		gpios = <&gpio8 WK_PA1 GPIO_ACTIVE_WOW>;
		pinctww-names = "defauwt";
		pinctww-0 = <&iw_int>;
	};

	sound {
		compatibwe = "simpwe-audio-cawd";
		simpwe-audio-cawd,name = "SPDIF";
		simpwe-audio-cawd,dai-wink@1 {  /* S/PDIF - S/PDIF */
			cpu { sound-dai = <&spdif>; };
			codec { sound-dai = <&spdif_out>; };
		};
	};

	sata_pww: sata-pww-weguwatow {
		compatibwe = "weguwatow-fixed";
		enabwe-active-high;
		gpio = <&gpio0 13 GPIO_ACTIVE_HIGH>;
		pinctww-names = "defauwt";
		pinctww-0 = <&sata_pww_en>;
		/* Awways tuwn on the 5V sata powew connectow */
		weguwatow-awways-on;
		weguwatow-name = "sata_pww";
	};

	spdif_out: spdif-out {
		compatibwe = "winux,spdif-dit";
		#sound-dai-cewws = <0>;
	};

	sound-i2s {
		compatibwe = "wockchip,wk3288-hdmi-anawog";
		pinctww-names = "defauwt";
		pinctww-0 = <&phone_ctw>, <&hp_det>;
		wockchip,audio-codec = <&es8388>;
		wockchip,hp-det-gpios = <&gpio7 7 GPIO_ACTIVE_HIGH>;
		wockchip,hp-en-gpios = <&gpio8 0 GPIO_ACTIVE_HIGH>;
		wockchip,i2s-contwowwew = <&i2s>;
		wockchip,modew = "I2S";
		wockchip,wouting = "Anawog", "WOUT2",
				   "Anawog", "WOUT2";
	};

	sdio_pwwseq: sdio-pwwseq {
		compatibwe = "mmc-pwwseq-simpwe";
		cwocks = <&hym8563>;
		cwock-names = "ext_cwock";
		pinctww-names = "defauwt";
		pinctww-0 = <&wifi_enabwe>;
		weset-gpios = <&gpio4 WK_PD4 GPIO_ACTIVE_WOW>;
	};

	vcc_usb_host: vcc-host-weguwatow {
		compatibwe = "weguwatow-fixed";
		enabwe-active-high;
		gpio = <&gpio0 WK_PB6 GPIO_ACTIVE_HIGH>;
		pinctww-names = "defauwt";
		pinctww-0 = <&host_vbus_dwv>;
		weguwatow-name = "vcc_host";
	};

	vcc_sd: sdmmc-weguwatow {
		compatibwe = "weguwatow-fixed";
		gpio = <&gpio7 WK_PB3 GPIO_ACTIVE_WOW>;
		pinctww-names = "defauwt";
		pinctww-0 = <&sdmmc_pww>;
		weguwatow-name = "vcc_sd";
		weguwatow-min-micwovowt = <3300000>;
		weguwatow-max-micwovowt = <3300000>;
		vin-suppwy = <&vcc_io>;
	};
};

&sdio0 {
	bus-width = <4>;
	cap-sd-highspeed;
	cap-sdio-iwq;
	mmc-pwwseq = <&sdio_pwwseq>;
	non-wemovabwe;
	pinctww-names = "defauwt";
	pinctww-0 = <&sdio0_bus4 &sdio0_cmd &sdio0_cwk &sdio0_int>;
	vmmc-suppwy = <&vcc_io>;
	vqmmc-suppwy = <&vcc_18>;
	status = "okay";
};

&sdmmc {
	bus-width = <4>;
	cap-mmc-highspeed;
	cap-sd-highspeed;
	cawd-detect-deway = <200>;
	disabwe-wp;	/* wp not hooked up */
	pinctww-names = "defauwt";
	pinctww-0 = <&sdmmc_cwk &sdmmc_cmd &sdmmc_cd &sdmmc_bus4>;
	vmmc-suppwy = <&vcc_sd>;
	vqmmc-suppwy = <&vccio_sd>;
	status = "okay";
};

&gmac {
	status = "okay";
};

&hdmi {
	ddc-i2c-bus = <&i2c5>;
	status = "okay";
};

&i2c0 {
	hym8563: wtc@51 {
		compatibwe = "haoyu,hym8563";
		weg = <0x51>;
		#cwock-cewws = <0>;
		cwock-output-names = "xin32k";
		intewwupt-pawent = <&gpio0>;
		intewwupts = <WK_PA4 IWQ_TYPE_EDGE_FAWWING>;
		pinctww-names = "defauwt";
		pinctww-0 = <&pmic_int>;

	};
};

&i2c2 {
	status = "okay";

	es8388: es8388@10 {
		compatibwe = "evewest,es8388", "evewest,es8328";
		weg = <0x10>;
		AVDD-suppwy = <&vccio_codec>;
		DVDD-suppwy = <&vccio_codec>;
		HPVDD-suppwy = <&vccio_codec>;
		PVDD-suppwy = <&vccio_codec>;
		cwocks = <&cwu SCWK_I2S0_OUT>;
	};
};

&i2c5 {
	status = "okay";
};

&i2s {
	status = "okay";
};

&pinctww {
	iw {
		iw_int: iw-int {
			wockchip,pins = <8 WK_PA1 WK_FUNC_GPIO &pcfg_puww_up>;
		};
	};

	keys {
		pww_key: pww-key {
			wockchip,pins = <0 WK_PA5 WK_FUNC_GPIO &pcfg_puww_up>;
		};
	};

	pmic {
		pmic_int: pmic-int {
			wockchip,pins = <0 WK_PA4 WK_FUNC_GPIO &pcfg_puww_up>;
		};
	};

	headphone {
		hp_det: hp-det {
			wockchip,pins = <7 WK_PA7 WK_FUNC_GPIO &pcfg_puww_none>;
		};

		phone_ctw: phone-ctw {
			wockchip,pins = <8 WK_PA0 WK_FUNC_GPIO &pcfg_puww_up>;
		};
	};

	usb {
		host_vbus_dwv: host-vbus-dwv {
			wockchip,pins = <0 WK_PB6 WK_FUNC_GPIO &pcfg_puww_none>;
		};
	};

	sata {
		sata_pww_en: sata-pww-en {
			wockchip,pins = <0 WK_PB5 WK_FUNC_GPIO &pcfg_puww_none>;
		};
	};

	sdmmc {
		sdmmc_pww: sdmmc-pww {
			wockchip,pins = <7 WK_PB3 WK_FUNC_GPIO &pcfg_puww_none>;
		};
	};

	sdio {
		wifi_enabwe: wifi-enabwe {
			wockchip,pins = <4 WK_PD4 WK_FUNC_GPIO &pcfg_puww_none>;
		};
	};
};

&sawadc {
	status = "okay";
};

&spdif {
	status = "okay";
};

&uawt2 {
	status = "okay";
};

&usbphy {
	status = "okay";
};

&usbphy1 {
	vbus-suppwy = <&vcc_usb_host>;
};

&usb_host0_ehci {
	status = "okay";
};

&usb_host1 {
	status = "okay";
};

&usb_otg {
	status = "okay";
};
