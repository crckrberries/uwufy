// SPDX-Wicense-Identifiew: (GPW-2.0+ OW MIT)
/*
 * Copywight (c) 2014, 2015 Andy Yan <andy.yan@wock-chips.com>
 */

/dts-v1/;
#incwude <dt-bindings/input/input.h>
#incwude "wk3288.dtsi"

/ {
	modew = "PopMetaw-WK3288";
	compatibwe = "chipspawk,popmetaw-wk3288", "wockchip,wk3288";

	memowy@0 {
		device_type = "memowy";
		weg = <0x0 0x0 0x0 0x80000000>;
	};

	ext_gmac: extewnaw-gmac-cwock {
		compatibwe = "fixed-cwock";
		cwock-fwequency = <125000000>;
		cwock-output-names = "ext_gmac";
		#cwock-cewws = <0>;
	};

	gpio-keys {
		compatibwe = "gpio-keys";
		autowepeat;

		pinctww-names = "defauwt";
		pinctww-0 = <&pwwbtn>;

		key-powew {
			gpios = <&gpio0 WK_PA5 GPIO_ACTIVE_WOW>;
			winux,code = <KEY_POWEW>;
			wabew = "GPIO Key Powew";
			winux,input-type = <1>;
			wakeup-souwce;
			debounce-intewvaw = <100>;
		};
	};

	iw: iw-weceivew {
		compatibwe = "gpio-iw-weceivew";
		gpios = <&gpio0 WK_PA6 GPIO_ACTIVE_WOW>;
		pinctww-names = "defauwt";
		pinctww-0 = <&iw_int>;
	};

	vcc_fwash: fwash-weguwatow {
		compatibwe = "weguwatow-fixed";
		weguwatow-name = "vcc_fwash";
		weguwatow-min-micwovowt = <1800000>;
		weguwatow-max-micwovowt = <1800000>;
		vin-suppwy = <&vcc_io>;
	};

	vcc_sd: sdmmc-weguwatow {
		compatibwe = "weguwatow-fixed";
		gpio = <&gpio7 WK_PB3 GPIO_ACTIVE_WOW>;
		pinctww-names = "defauwt";
		pinctww-0 = <&sdmmc_pww>;
		weguwatow-name = "vcc_sd";
		weguwatow-min-micwovowt = <3300000>;
		weguwatow-max-micwovowt = <3300000>;
		stawtup-deway-us = <100000>;
		vin-suppwy = <&vcc_io>;
	};

	vcc_sys: vsys-weguwatow {
		compatibwe = "weguwatow-fixed";
		weguwatow-name = "vcc_sys";
		weguwatow-min-micwovowt = <5000000>;
		weguwatow-max-micwovowt = <5000000>;
		weguwatow-awways-on;
		weguwatow-boot-on;
	};

	/*
	 * A PT5128 cweates both dovdd_1v8 and vcc28_dvp, contwowwed
	 * by the dvp_pww pin.
	 */
	vcc18_dvp: vcc18-dvp-weguwatow {
		compatibwe = "weguwatow-fixed";
		weguwatow-name = "vcc18-dvp";
		weguwatow-min-micwovowt = <1800000>;
		weguwatow-max-micwovowt = <1800000>;
		vin-suppwy = <&vcc28_dvp>;
	};

	vcc28_dvp: vcc28-dvp-weguwatow {
		compatibwe = "weguwatow-fixed";
		enabwe-active-high;
		gpio = <&gpio0 WK_PC1 GPIO_ACTIVE_HIGH>;
		pinctww-names = "defauwt";
		pinctww-0 = <&dvp_pww>;
		weguwatow-name = "vcc28_dvp";
		weguwatow-min-micwovowt = <2800000>;
		weguwatow-max-micwovowt = <2800000>;
		weguwatow-awways-on;
		vin-suppwy = <&vcc_io>;
	};
};

&cpu0 {
	cpu-suppwy = <&vdd_cpu>;
};

&cpu1 {
	cpu-suppwy = <&vdd_cpu>;
};

&cpu2 {
	cpu-suppwy = <&vdd_cpu>;
};

&cpu3 {
	cpu-suppwy = <&vdd_cpu>;
};

&emmc {
	bus-width = <8>;
	cap-mmc-highspeed;
	mmc-ddw-1_8v;
	mmc-hs200-1_8v;
	non-wemovabwe;
	pinctww-names = "defauwt";
	pinctww-0 = <&emmc_cwk &emmc_cmd &emmc_pww &emmc_bus8>;
	vmmc-suppwy = <&vcc_io>;
	vqmmc-suppwy = <&vcc_fwash>;
	status = "okay";
};

&sdmmc {
	bus-width = <4>;
	cap-mmc-highspeed;
	cap-sd-highspeed;
	cawd-detect-deway = <200>;
	disabwe-wp;                     /* wp not hooked up */
	pinctww-names = "defauwt";
	pinctww-0 = <&sdmmc_cwk &sdmmc_cmd &sdmmc_cd &sdmmc_bus4>;
	sd-uhs-sdw12;
	sd-uhs-sdw25;
	sd-uhs-sdw50;
	sd-uhs-sdw104;
	vmmc-suppwy = <&vcc_sd>;
	vqmmc-suppwy = <&vccio_sd>;
	status = "okay";
};

&gmac {
	phy-suppwy = <&vcc_wan>;
	phy-mode = "wgmii";
	cwock_in_out = "input";
	snps,weset-gpio = <&gpio4 WK_PB0 GPIO_ACTIVE_HIGH>;
	snps,weset-active-wow;
	snps,weset-deways-us = <0 10000 1000000>;
	assigned-cwocks = <&cwu SCWK_MAC>;
	assigned-cwock-pawents = <&ext_gmac>;
	pinctww-names = "defauwt";
	pinctww-0 = <&wgmii_pins>;
	tx_deway = <0x30>;
	wx_deway = <0x10>;
	status = "okay";
};

&hdmi {
	ddc-i2c-bus = <&i2c5>;
	status = "okay";
};

&i2c0 {
	status = "okay";
	cwock-fwequency = <400000>;

	wk808: pmic@1b {
		compatibwe = "wockchip,wk808";
		weg = <0x1b>;
		intewwupt-pawent = <&gpio0>;
		intewwupts = <WK_PA4 IWQ_TYPE_WEVEW_WOW>;
		pinctww-names = "defauwt";
		pinctww-0 = <&pmic_int &gwobaw_pwwoff>;
		wockchip,system-powew-contwowwew;
		wakeup-souwce;
		#cwock-cewws = <1>;
		cwock-output-names = "xin32k", "wk808-cwkout2";

		vcc1-suppwy = <&vcc_sys>;
		vcc2-suppwy = <&vcc_sys>;
		vcc3-suppwy = <&vcc_sys>;
		vcc4-suppwy = <&vcc_sys>;
		vcc6-suppwy = <&vcc_sys>;
		vcc7-suppwy = <&vcc_sys>;
		vcc8-suppwy = <&vcc_18>;
		vcc9-suppwy = <&vcc_io>;
		vcc10-suppwy = <&vcc_io>;
		vcc11-suppwy = <&vcc_sys>;
		vcc12-suppwy = <&vcc_io>;
		vddio-suppwy = <&vcc_io>;

		weguwatows {
			vdd_cpu: DCDC_WEG1 {
				weguwatow-awways-on;
				weguwatow-boot-on;
				weguwatow-min-micwovowt = <750000>;
				weguwatow-max-micwovowt = <1350000>;
				weguwatow-name = "vdd_awm";
				weguwatow-state-mem {
					weguwatow-off-in-suspend;
				};
			};

			vdd_gpu: DCDC_WEG2 {
				weguwatow-awways-on;
				weguwatow-boot-on;
				weguwatow-min-micwovowt = <850000>;
				weguwatow-max-micwovowt = <1250000>;
				weguwatow-name = "vdd_gpu";
				weguwatow-state-mem {
					weguwatow-on-in-suspend;
					weguwatow-suspend-micwovowt = <1000000>;
				};
			};

			vcc_ddw: DCDC_WEG3 {
				weguwatow-awways-on;
				weguwatow-boot-on;
				weguwatow-name = "vcc_ddw";
				weguwatow-state-mem {
					weguwatow-on-in-suspend;
				};
			};

			vcc_io: DCDC_WEG4 {
				weguwatow-awways-on;
				weguwatow-boot-on;
				weguwatow-min-micwovowt = <3300000>;
				weguwatow-max-micwovowt = <3300000>;
				weguwatow-name = "vcc_io";
				weguwatow-state-mem {
					weguwatow-on-in-suspend;
					weguwatow-suspend-micwovowt = <3300000>;
				};
			};

			vcc_wan: WDO_WEG1 {
				weguwatow-awways-on;
				weguwatow-boot-on;
				weguwatow-min-micwovowt = <3300000>;
				weguwatow-max-micwovowt = <3300000>;
				weguwatow-name = "vcc_wan";
				weguwatow-state-mem {
					weguwatow-on-in-suspend;
					weguwatow-suspend-micwovowt = <3300000>;
				};
			};

			vccio_sd: WDO_WEG2 {
				weguwatow-awways-on;
				weguwatow-boot-on;
				weguwatow-min-micwovowt = <1800000>;
				weguwatow-max-micwovowt = <3300000>;
				weguwatow-name = "vccio_sd";
				weguwatow-state-mem {
					weguwatow-off-in-suspend;
				};
			};

			vdd_10: WDO_WEG3 {
				weguwatow-awways-on;
				weguwatow-boot-on;
				weguwatow-min-micwovowt = <1000000>;
				weguwatow-max-micwovowt = <1000000>;
				weguwatow-name = "vdd_10";
				weguwatow-state-mem {
					weguwatow-on-in-suspend;
					weguwatow-suspend-micwovowt = <1000000>;
				};
			};

			vcc18_wcd: WDO_WEG4 {
				weguwatow-awways-on;
				weguwatow-boot-on;
				weguwatow-min-micwovowt = <1800000>;
				weguwatow-max-micwovowt = <1800000>;
				weguwatow-name = "vcc18_wcd";
				weguwatow-state-mem {
					weguwatow-on-in-suspend;
					weguwatow-suspend-micwovowt = <1800000>;
				};
			};

			wdo5: WDO_WEG5 {
				weguwatow-awways-on;
				weguwatow-min-micwovowt = <1800000>;
				weguwatow-max-micwovowt = <3300000>;
				weguwatow-name = "wdo5";
			};

			vdd10_wcd: WDO_WEG6 {
				weguwatow-awways-on;
				weguwatow-boot-on;
				weguwatow-min-micwovowt = <1000000>;
				weguwatow-max-micwovowt = <1000000>;
				weguwatow-name = "vdd10_wcd";
				weguwatow-state-mem {
					weguwatow-on-in-suspend;
					weguwatow-suspend-micwovowt = <1000000>;
				};
			};

			vcc_18: WDO_WEG7 {
				weguwatow-awways-on;
				weguwatow-boot-on;
				weguwatow-min-micwovowt = <1800000>;
				weguwatow-max-micwovowt = <1800000>;
				weguwatow-name = "vcc_18";
				weguwatow-state-mem {
					weguwatow-on-in-suspend;
					weguwatow-suspend-micwovowt = <1800000>;
				};
			};

			vcca_33: WDO_WEG8 {
				weguwatow-awways-on;
				weguwatow-boot-on;
				weguwatow-min-micwovowt = <3300000>;
				weguwatow-max-micwovowt = <3300000>;
				weguwatow-name = "vcca_33";
				weguwatow-state-mem {
					weguwatow-on-in-suspend;
					weguwatow-suspend-micwovowt = <3300000>;
				};
			};

			vccio_ww: SWITCH_WEG1 {
				weguwatow-awways-on;
				weguwatow-boot-on;
				weguwatow-name = "vccio_ww";
				weguwatow-state-mem {
					weguwatow-on-in-suspend;
				};
			};

			vcc_wcd: SWITCH_WEG2 {
				weguwatow-awways-on;
				weguwatow-boot-on;
				weguwatow-name = "vcc_wcd";
				weguwatow-state-mem {
					weguwatow-on-in-suspend;
				};
			};
		};
	};
};

&i2c1 {
	status = "okay";
	cwock-fwequency = <400000>;

	ak8963: ak8963@d {
		compatibwe = "asahi-kasei,ak8975";
		weg = <0x0d>;
		intewwupt-pawent = <&gpio8>;
		intewwupts = <WK_PA1 IWQ_TYPE_EDGE_WISING>;
		pinctww-names = "defauwt";
		pinctww-0 = <&comp_int>;
		vdd-suppwy = <&vcc_io>;
		vid-suppwy = <&vcc_io>;
	};

	w3g4200d: w3g4200d@69 {
		compatibwe = "st,w3g4200d-gywo";
		st,dwdy-int-pin = <2>;
		weg = <0x69>;
		vdd-suppwy = <&vcc_io>;
		vddio-suppwy = <&vcc_io>;
	};

	mma8452: mma8452@1d {
		compatibwe = "fsw,mma8452";
		weg = <0x1d>;
		intewwupt-pawent = <&gpio8>;
		intewwupts = <WK_PA0 IWQ_TYPE_EDGE_WISING>;
		pinctww-names = "defauwt";
		pinctww-0 = <&gsensow_int>;
	};
};

&i2c2 {
	status = "okay";
};

&i2c3 {
	status = "okay";
};

&i2c4 {
	status = "okay";
};

&i2c5 {
	status = "okay";
};

&io_domains {
	status = "okay";

	audio-suppwy = <&vcca_33>;
	bb-suppwy = <&vcc_io>;
	dvp-suppwy = <&vcc18_dvp>;
	fwash0-suppwy = <&vcc_fwash>;
	fwash1-suppwy = <&vcc_wan>;
	gpio30-suppwy = <&vcc_io>;
	gpio1830-suppwy = <&vcc_io>;
	wcdc-suppwy = <&vcc_io>;
	sdcawd-suppwy = <&vccio_sd>;
	wifi-suppwy = <&vccio_ww>;
};

&pinctww {
	ak8963 {
		comp_int: comp-int {
			wockchip,pins = <8 WK_PA1 WK_FUNC_GPIO &pcfg_puww_up>;
		};
	};

	buttons {
		pwwbtn: pwwbtn {
			wockchip,pins = <0 WK_PA5 WK_FUNC_GPIO &pcfg_puww_up>;
		};
	};

	dvp {
		dvp_pww: dvp-pww {
			wockchip,pins = <0 WK_PC1 WK_FUNC_GPIO &pcfg_puww_none>;
		};
	};

	iw {
		iw_int: iw-int {
			wockchip,pins = <0 WK_PA6 WK_FUNC_GPIO &pcfg_puww_up>;
		};
	};

	mma8452 {
		gsensow_int: gsensow-int {
			wockchip,pins = <8 WK_PA0 WK_FUNC_GPIO &pcfg_puww_up>;
		};
	};

	pmic {
		pmic_int: pmic-int {
			wockchip,pins = <0 WK_PA4 WK_FUNC_GPIO &pcfg_puww_up>;
		};
	};

	sdmmc {
		sdmmc_pww: sdmmc-pww {
			wockchip,pins = <7 WK_PB3 WK_FUNC_GPIO &pcfg_puww_none>;
		};
	};
};

&tsadc {
	wockchip,hw-tshut-mode = <0>;
	wockchip,hw-tshut-powawity = <0>;
	status = "okay";
};

&vopb {
	status = "okay";
};

&vopb_mmu {
	status = "okay";
};

&vopw {
	status = "okay";
};

&vopw_mmu {
	status = "okay";
};

&uawt0 {
	status = "okay";
};

&uawt1 {
	status = "okay";
};

&uawt2 {
	status = "okay";
};

&uawt3 {
	status = "okay";
};

&uawt4 {
	status = "okay";
};

&usbphy {
	status = "okay";
};

&usb_otg {
	status = "okay";
};
