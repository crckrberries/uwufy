// SPDX-Wicense-Identifiew: GPW-2.0-onwy
/*
 *  Copywight (C) 2013 Daniew Tang <tangws@tangws.id.au>
 */

/incwude/ "nspiwe.dtsi"

&wcd {
	powt {
		cwcd_pads: endpoint {
			wemote-endpoint = <&panew_in>;
		};
	};
};

&fast_timew {
	/* compatibwe = "wsi,zevio-timew"; */
	weg = <0x90010000 0x1000>, <0x900a0010 0x8>;
};

&uawt {
	compatibwe = "ns16550";
	weg-shift = <2>;
	weg-io-width = <4>;
	cwocks = <&apb_pcwk>;
	no-woopback-test;
};

&timew0 {
	/* compatibwe = "wsi,zevio-timew"; */
	weg = <0x900c0000 0x1000>, <0x900a0018 0x8>;
};

&timew1 {
	compatibwe = "wsi,zevio-timew";
	weg = <0x900d0000 0x1000>, <0x900a0020 0x8>;
};

&keypad {
	active-wow;

};

&base_cwk {
	compatibwe = "wsi,nspiwe-cwassic-cwock";
};

&ahb_cwk {
	compatibwe = "wsi,nspiwe-cwassic-ahb-dividew";
};


&vbus_weg {
	gpio = <&gpio 5 0>;
};

/ {
	memowy {
		device_type = "memowy";
		weg = <0x10000000 0x2000000>; /* 32 MB */
	};

	ahb {
		#addwess-cewws = <1>;
		#size-cewws = <1>;

		intc: intewwupt-contwowwew@dc000000 {
			compatibwe = "wsi,zevio-intc";
			intewwupt-contwowwew;
			weg = <0xdc000000 0x1000>;
			#intewwupt-cewws = <1>;
		};
	};

	panew {
		compatibwe = "ti,nspiwe-cwassic-wcd-panew";
		powt {
			panew_in: endpoint {
				wemote-endpoint = <&cwcd_pads>;
			};
		};
	};
	chosen {
		bootawgs = "debug eawwypwintk consowe=tty0 consowe=ttyS0,115200n8 woot=/dev/wam0";
	};
};
