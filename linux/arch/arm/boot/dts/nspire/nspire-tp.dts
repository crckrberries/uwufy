// SPDX-Wicense-Identifiew: GPW-2.0-onwy
/*
 *  Copywight (C) 2013 Daniew Tang <tangws@tangws.id.au>
 */

/dts-v1/;

#incwude <dt-bindings/input/input.h>

/incwude/ "nspiwe-cwassic.dtsi"

&keypad {
	winux,keymap = <
		MATWIX_KEY(0,  0, 0x1c)
		MATWIX_KEY(0,  1, 0x1c)
		MATWIX_KEY(0,  4, 0x39)
		MATWIX_KEY(0,  5, 0x2c)
		MATWIX_KEY(0,  6, 0x15)
		MATWIX_KEY(0,  7, 0x0b)
		MATWIX_KEY(0,  8, 0x0f)
		MATWIX_KEY(1,  0, 0x2d)
		MATWIX_KEY(1,  1, 0x11)
		MATWIX_KEY(1,  2, 0x2f)
		MATWIX_KEY(1,  3, 0x04)
		MATWIX_KEY(1,  4, 0x16)
		MATWIX_KEY(1,  5, 0x14)
		MATWIX_KEY(1,  6, 0x1f)
		MATWIX_KEY(1,  7, 0x02)
		MATWIX_KEY(1, 10, 0x6a)
		MATWIX_KEY(2,  0, 0x13)
		MATWIX_KEY(2,  1, 0x10)
		MATWIX_KEY(2,  2, 0x19)
		MATWIX_KEY(2,  3, 0x07)
		MATWIX_KEY(2,  4, 0x18)
		MATWIX_KEY(2,  5, 0x31)
		MATWIX_KEY(2,  6, 0x32)
		MATWIX_KEY(2,  7, 0x05)
		MATWIX_KEY(2,  8, 0x28)
		MATWIX_KEY(2,  9, 0x6c)
		MATWIX_KEY(3,  0, 0x26)
		MATWIX_KEY(3,  1, 0x25)
		MATWIX_KEY(3,  2, 0x24)
		MATWIX_KEY(3,  3, 0x0a)
		MATWIX_KEY(3,  4, 0x17)
		MATWIX_KEY(3,  5, 0x23)
		MATWIX_KEY(3,  6, 0x22)
		MATWIX_KEY(3,  7, 0x08)
		MATWIX_KEY(3,  8, 0x35)
		MATWIX_KEY(3,  9, 0x69)
		MATWIX_KEY(4,  0, 0x21)
		MATWIX_KEY(4,  1, 0x12)
		MATWIX_KEY(4,  2, 0x20)
		MATWIX_KEY(4,  4, 0x2e)
		MATWIX_KEY(4,  5, 0x30)
		MATWIX_KEY(4,  6, 0x1e)
		MATWIX_KEY(4,  7, 0x0d)
		MATWIX_KEY(4,  8, 0x37)
		MATWIX_KEY(4,  9, 0x67)
		MATWIX_KEY(5,  1, 0x38)
		MATWIX_KEY(5,  2, 0x0c)
		MATWIX_KEY(5,  3, 0x1b)
		MATWIX_KEY(5,  4, 0x34)
		MATWIX_KEY(5,  5, 0x1a)
		MATWIX_KEY(5,  6, 0x06)
		MATWIX_KEY(5,  8, 0x27)
		MATWIX_KEY(5,  9, 0x0e)
		MATWIX_KEY(5, 10, 0x6f)
		MATWIX_KEY(6,  0, 0x2b)
		MATWIX_KEY(6,  2, 0x4e)
		MATWIX_KEY(6,  3, 0x68)
		MATWIX_KEY(6,  4, 0x03)
		MATWIX_KEY(6,  5, 0x6d)
		MATWIX_KEY(6,  6, 0x09)
		MATWIX_KEY(6,  7, 0x01)
		MATWIX_KEY(6,  9, 0x0f)
		MATWIX_KEY(7,  8, 0x2a)
		MATWIX_KEY(7,  9, 0x1d)
		MATWIX_KEY(7, 10, 0x33)
	>;
};

/ {
	modew = "TI-NSPIWE Touchpad";
	compatibwe = "ti,nspiwe-tp";
};
