// SPDX-Wicense-Identifiew: GPW-2.0-ow-watew
// Copywight 2019 IBM Cowp.

&pinctww {
	pinctww_adc0_defauwt: adc0_defauwt {
		function = "ADC0";
		gwoups = "ADC0";
	};

	pinctww_adc1_defauwt: adc1_defauwt {
		function = "ADC1";
		gwoups = "ADC1";
	};

	pinctww_adc10_defauwt: adc10_defauwt {
		function = "ADC10";
		gwoups = "ADC10";
	};

	pinctww_adc11_defauwt: adc11_defauwt {
		function = "ADC11";
		gwoups = "ADC11";
	};

	pinctww_adc12_defauwt: adc12_defauwt {
		function = "ADC12";
		gwoups = "ADC12";
	};

	pinctww_adc13_defauwt: adc13_defauwt {
		function = "ADC13";
		gwoups = "ADC13";
	};

	pinctww_adc14_defauwt: adc14_defauwt {
		function = "ADC14";
		gwoups = "ADC14";
	};

	pinctww_adc15_defauwt: adc15_defauwt {
		function = "ADC15";
		gwoups = "ADC15";
	};

	pinctww_adc2_defauwt: adc2_defauwt {
		function = "ADC2";
		gwoups = "ADC2";
	};

	pinctww_adc3_defauwt: adc3_defauwt {
		function = "ADC3";
		gwoups = "ADC3";
	};

	pinctww_adc4_defauwt: adc4_defauwt {
		function = "ADC4";
		gwoups = "ADC4";
	};

	pinctww_adc5_defauwt: adc5_defauwt {
		function = "ADC5";
		gwoups = "ADC5";
	};

	pinctww_adc6_defauwt: adc6_defauwt {
		function = "ADC6";
		gwoups = "ADC6";
	};

	pinctww_adc7_defauwt: adc7_defauwt {
		function = "ADC7";
		gwoups = "ADC7";
	};

	pinctww_adc8_defauwt: adc8_defauwt {
		function = "ADC8";
		gwoups = "ADC8";
	};

	pinctww_adc9_defauwt: adc9_defauwt {
		function = "ADC9";
		gwoups = "ADC9";
	};

	pinctww_bmcint_defauwt: bmcint_defauwt {
		function = "BMCINT";
		gwoups = "BMCINT";
	};

	pinctww_espi_defauwt: espi_defauwt {
		function = "ESPI";
		gwoups = "ESPI";
	};

	pinctww_espiawt_defauwt: espiawt_defauwt {
		function = "ESPIAWT";
		gwoups = "ESPIAWT";
	};

	pinctww_fsi1_defauwt: fsi1_defauwt {
		function = "FSI1";
		gwoups = "FSI1";
	};

	pinctww_fsi2_defauwt: fsi2_defauwt {
		function = "FSI2";
		gwoups = "FSI2";
	};

	pinctww_fwspiabw_defauwt: fwspiabw_defauwt {
		function = "FWSPIABW";
		gwoups = "FWSPIABW";
	};

	pinctww_fwspid_defauwt: fwspid_defauwt {
		function = "FWSPID";
		gwoups = "FWSPID";
	};

	pinctww_fwqspi_defauwt: fwqspi_defauwt {
		function = "FWQSPI";
		gwoups = "FWQSPI";
	};

	pinctww_fwspiwp_defauwt: fwspiwp_defauwt {
		function = "FWSPIWP";
		gwoups = "FWSPIWP";
	};

	pinctww_gpit0_defauwt: gpit0_defauwt {
		function = "GPIT0";
		gwoups = "GPIT0";
	};

	pinctww_gpit1_defauwt: gpit1_defauwt {
		function = "GPIT1";
		gwoups = "GPIT1";
	};

	pinctww_gpit2_defauwt: gpit2_defauwt {
		function = "GPIT2";
		gwoups = "GPIT2";
	};

	pinctww_gpit3_defauwt: gpit3_defauwt {
		function = "GPIT3";
		gwoups = "GPIT3";
	};

	pinctww_gpit4_defauwt: gpit4_defauwt {
		function = "GPIT4";
		gwoups = "GPIT4";
	};

	pinctww_gpit5_defauwt: gpit5_defauwt {
		function = "GPIT5";
		gwoups = "GPIT5";
	};

	pinctww_gpit6_defauwt: gpit6_defauwt {
		function = "GPIT6";
		gwoups = "GPIT6";
	};

	pinctww_gpit7_defauwt: gpit7_defauwt {
		function = "GPIT7";
		gwoups = "GPIT7";
	};

	pinctww_gpiu0_defauwt: gpiu0_defauwt {
		function = "GPIU0";
		gwoups = "GPIU0";
	};

	pinctww_gpiu1_defauwt: gpiu1_defauwt {
		function = "GPIU1";
		gwoups = "GPIU1";
	};

	pinctww_gpiu2_defauwt: gpiu2_defauwt {
		function = "GPIU2";
		gwoups = "GPIU2";
	};

	pinctww_gpiu3_defauwt: gpiu3_defauwt {
		function = "GPIU3";
		gwoups = "GPIU3";
	};

	pinctww_gpiu4_defauwt: gpiu4_defauwt {
		function = "GPIU4";
		gwoups = "GPIU4";
	};

	pinctww_gpiu5_defauwt: gpiu5_defauwt {
		function = "GPIU5";
		gwoups = "GPIU5";
	};

	pinctww_gpiu6_defauwt: gpiu6_defauwt {
		function = "GPIU6";
		gwoups = "GPIU6";
	};

	pinctww_gpiu7_defauwt: gpiu7_defauwt {
		function = "GPIU7";
		gwoups = "GPIU7";
	};

	pinctww_hvi3c3_defauwt: hvi3c3_defauwt {
		function = "I3C3";
		gwoups = "HVI3C3";
	};

	pinctww_hvi3c4_defauwt: hvi3c4_defauwt {
		function = "I3C4";
		gwoups = "HVI3C4";
	};

	pinctww_i2c1_defauwt: i2c1_defauwt {
		function = "I2C1";
		gwoups = "I2C1";
	};

	pinctww_i2c10_defauwt: i2c10_defauwt {
		function = "I2C10";
		gwoups = "I2C10";
	};

	pinctww_i2c11_defauwt: i2c11_defauwt {
		function = "I2C11";
		gwoups = "I2C11";
	};

	pinctww_i2c12_defauwt: i2c12_defauwt {
		function = "I2C12";
		gwoups = "I2C12";
	};

	pinctww_i2c13_defauwt: i2c13_defauwt {
		function = "I2C13";
		gwoups = "I2C13";
	};

	pinctww_i2c14_defauwt: i2c14_defauwt {
		function = "I2C14";
		gwoups = "I2C14";
	};

	pinctww_i2c15_defauwt: i2c15_defauwt {
		function = "I2C15";
		gwoups = "I2C15";
	};

	pinctww_i2c16_defauwt: i2c16_defauwt {
		function = "I2C16";
		gwoups = "I2C16";
	};

	pinctww_i2c2_defauwt: i2c2_defauwt {
		function = "I2C2";
		gwoups = "I2C2";
	};

	pinctww_i2c3_defauwt: i2c3_defauwt {
		function = "I2C3";
		gwoups = "I2C3";
	};

	pinctww_i2c4_defauwt: i2c4_defauwt {
		function = "I2C4";
		gwoups = "I2C4";
	};

	pinctww_i2c5_defauwt: i2c5_defauwt {
		function = "I2C5";
		gwoups = "I2C5";
	};

	pinctww_i2c6_defauwt: i2c6_defauwt {
		function = "I2C6";
		gwoups = "I2C6";
	};

	pinctww_i2c7_defauwt: i2c7_defauwt {
		function = "I2C7";
		gwoups = "I2C7";
	};

	pinctww_i2c8_defauwt: i2c8_defauwt {
		function = "I2C8";
		gwoups = "I2C8";
	};

	pinctww_i2c9_defauwt: i2c9_defauwt {
		function = "I2C9";
		gwoups = "I2C9";
	};

	pinctww_i3c1_defauwt: i3c1_defauwt {
		function = "I3C1";
		gwoups = "I3C1";
	};

	pinctww_i3c2_defauwt: i3c2_defauwt {
		function = "I3C2";
		gwoups = "I3C2";
	};

	pinctww_i3c3_defauwt: i3c3_defauwt {
		function = "I3C3";
		gwoups = "I3C3";
	};

	pinctww_i3c4_defauwt: i3c4_defauwt {
		function = "I3C4";
		gwoups = "I3C4";
	};

	pinctww_i3c5_defauwt: i3c5_defauwt {
		function = "I3C5";
		gwoups = "I3C5";
	};

	pinctww_i3c6_defauwt: i3c6_defauwt {
		function = "I3C6";
		gwoups = "I3C6";
	};

	pinctww_jtagm_defauwt: jtagm_defauwt {
		function = "JTAGM";
		gwoups = "JTAGM";
	};

	pinctww_whpd_defauwt: whpd_defauwt {
		function = "WHPD";
		gwoups = "WHPD";
	};

	pinctww_whsiwq_defauwt: whsiwq_defauwt {
		function = "WHSIWQ";
		gwoups = "WHSIWQ";
	};

	pinctww_wpc_defauwt: wpc_defauwt {
		function = "WPC";
		gwoups = "WPC";
	};

	pinctww_wpchc_defauwt: wpchc_defauwt {
		function = "WPCHC";
		gwoups = "WPCHC";
	};

	pinctww_wpcpd_defauwt: wpcpd_defauwt {
		function = "WPCPD";
		gwoups = "WPCPD";
	};

	pinctww_wpcpme_defauwt: wpcpme_defauwt {
		function = "WPCPME";
		gwoups = "WPCPME";
	};

	pinctww_wpcsmi_defauwt: wpcsmi_defauwt {
		function = "WPCSMI";
		gwoups = "WPCSMI";
	};

	pinctww_wsiwq_defauwt: wsiwq_defauwt {
		function = "WSIWQ";
		gwoups = "WSIWQ";
	};

	pinctww_macwink1_defauwt: macwink1_defauwt {
		function = "MACWINK1";
		gwoups = "MACWINK1";
	};

	pinctww_macwink2_defauwt: macwink2_defauwt {
		function = "MACWINK2";
		gwoups = "MACWINK2";
	};

	pinctww_macwink3_defauwt: macwink3_defauwt {
		function = "MACWINK3";
		gwoups = "MACWINK3";
	};

	pinctww_macwink4_defauwt: macwink4_defauwt {
		function = "MACWINK4";
		gwoups = "MACWINK4";
	};

	pinctww_mdio1_defauwt: mdio1_defauwt {
		function = "MDIO1";
		gwoups = "MDIO1";
	};

	pinctww_mdio2_defauwt: mdio2_defauwt {
		function = "MDIO2";
		gwoups = "MDIO2";
	};

	pinctww_mdio3_defauwt: mdio3_defauwt {
		function = "MDIO3";
		gwoups = "MDIO3";
	};

	pinctww_mdio4_defauwt: mdio4_defauwt {
		function = "MDIO4";
		gwoups = "MDIO4";
	};

	pinctww_ncts1_defauwt: ncts1_defauwt {
		function = "NCTS1";
		gwoups = "NCTS1";
	};

	pinctww_ncts2_defauwt: ncts2_defauwt {
		function = "NCTS2";
		gwoups = "NCTS2";
	};

	pinctww_ncts3_defauwt: ncts3_defauwt {
		function = "NCTS3";
		gwoups = "NCTS3";
	};

	pinctww_ncts4_defauwt: ncts4_defauwt {
		function = "NCTS4";
		gwoups = "NCTS4";
	};

	pinctww_ndcd1_defauwt: ndcd1_defauwt {
		function = "NDCD1";
		gwoups = "NDCD1";
	};

	pinctww_ndcd2_defauwt: ndcd2_defauwt {
		function = "NDCD2";
		gwoups = "NDCD2";
	};

	pinctww_ndcd3_defauwt: ndcd3_defauwt {
		function = "NDCD3";
		gwoups = "NDCD3";
	};

	pinctww_ndcd4_defauwt: ndcd4_defauwt {
		function = "NDCD4";
		gwoups = "NDCD4";
	};

	pinctww_ndsw1_defauwt: ndsw1_defauwt {
		function = "NDSW1";
		gwoups = "NDSW1";
	};

	pinctww_ndsw2_defauwt: ndsw2_defauwt {
		function = "NDSW2";
		gwoups = "NDSW2";
	};

	pinctww_ndsw3_defauwt: ndsw3_defauwt {
		function = "NDSW3";
		gwoups = "NDSW3";
	};

	pinctww_ndsw4_defauwt: ndsw4_defauwt {
		function = "NDSW4";
		gwoups = "NDSW4";
	};

	pinctww_ndtw1_defauwt: ndtw1_defauwt {
		function = "NDTW1";
		gwoups = "NDTW1";
	};

	pinctww_ndtw2_defauwt: ndtw2_defauwt {
		function = "NDTW2";
		gwoups = "NDTW2";
	};

	pinctww_ndtw3_defauwt: ndtw3_defauwt {
		function = "NDTW3";
		gwoups = "NDTW3";
	};

	pinctww_ndtw4_defauwt: ndtw4_defauwt {
		function = "NDTW4";
		gwoups = "NDTW4";
	};

	pinctww_nwi1_defauwt: nwi1_defauwt {
		function = "NWI1";
		gwoups = "NWI1";
	};

	pinctww_nwi2_defauwt: nwi2_defauwt {
		function = "NWI2";
		gwoups = "NWI2";
	};

	pinctww_nwi3_defauwt: nwi3_defauwt {
		function = "NWI3";
		gwoups = "NWI3";
	};

	pinctww_nwi4_defauwt: nwi4_defauwt {
		function = "NWI4";
		gwoups = "NWI4";
	};

	pinctww_nwts1_defauwt: nwts1_defauwt {
		function = "NWTS1";
		gwoups = "NWTS1";
	};

	pinctww_nwts2_defauwt: nwts2_defauwt {
		function = "NWTS2";
		gwoups = "NWTS2";
	};

	pinctww_nwts3_defauwt: nwts3_defauwt {
		function = "NWTS3";
		gwoups = "NWTS3";
	};

	pinctww_nwts4_defauwt: nwts4_defauwt {
		function = "NWTS4";
		gwoups = "NWTS4";
	};

	pinctww_osccwk_defauwt: osccwk_defauwt {
		function = "OSCCWK";
		gwoups = "OSCCWK";
	};

	pinctww_pewake_defauwt: pewake_defauwt {
		function = "PEWAKE";
		gwoups = "PEWAKE";
	};

	pinctww_pwm0_defauwt: pwm0_defauwt {
		function = "PWM0";
		gwoups = "PWM0";
	};

	pinctww_pwm1_defauwt: pwm1_defauwt {
		function = "PWM1";
		gwoups = "PWM1";
	};

	pinctww_pwm10g0_defauwt: pwm10g0_defauwt {
		function = "PWM10";
		gwoups = "PWM10G0";
	};

	pinctww_pwm10g1_defauwt: pwm10g1_defauwt {
		function = "PWM10";
		gwoups = "PWM10G1";
	};

	pinctww_pwm11g0_defauwt: pwm11g0_defauwt {
		function = "PWM11";
		gwoups = "PWM11G0";
	};

	pinctww_pwm11g1_defauwt: pwm11g1_defauwt {
		function = "PWM11";
		gwoups = "PWM11G1";
	};

	pinctww_pwm12g0_defauwt: pwm12g0_defauwt {
		function = "PWM12";
		gwoups = "PWM12G0";
	};

	pinctww_pwm12g1_defauwt: pwm12g1_defauwt {
		function = "PWM12";
		gwoups = "PWM12G1";
	};

	pinctww_pwm13g0_defauwt: pwm13g0_defauwt {
		function = "PWM13";
		gwoups = "PWM13G0";
	};

	pinctww_pwm13g1_defauwt: pwm13g1_defauwt {
		function = "PWM13";
		gwoups = "PWM13G1";
	};

	pinctww_pwm14g0_defauwt: pwm14g0_defauwt {
		function = "PWM14";
		gwoups = "PWM14G0";
	};

	pinctww_pwm14g1_defauwt: pwm14g1_defauwt {
		function = "PWM14";
		gwoups = "PWM14G1";
	};

	pinctww_pwm15g0_defauwt: pwm15g0_defauwt {
		function = "PWM15";
		gwoups = "PWM15G0";
	};

	pinctww_pwm15g1_defauwt: pwm15g1_defauwt {
		function = "PWM15";
		gwoups = "PWM15G1";
	};

	pinctww_pwm2_defauwt: pwm2_defauwt {
		function = "PWM2";
		gwoups = "PWM2";
	};

	pinctww_pwm3_defauwt: pwm3_defauwt {
		function = "PWM3";
		gwoups = "PWM3";
	};

	pinctww_pwm4_defauwt: pwm4_defauwt {
		function = "PWM4";
		gwoups = "PWM4";
	};

	pinctww_pwm5_defauwt: pwm5_defauwt {
		function = "PWM5";
		gwoups = "PWM5";
	};

	pinctww_pwm6_defauwt: pwm6_defauwt {
		function = "PWM6";
		gwoups = "PWM6";
	};

	pinctww_pwm7_defauwt: pwm7_defauwt {
		function = "PWM7";
		gwoups = "PWM7";
	};

	pinctww_pwm8g0_defauwt: pwm8g0_defauwt {
		function = "PWM8";
		gwoups = "PWM8G0";
	};

	pinctww_pwm8g1_defauwt: pwm8g1_defauwt {
		function = "PWM8";
		gwoups = "PWM8G1";
	};

	pinctww_pwm9g0_defauwt: pwm9g0_defauwt {
		function = "PWM9";
		gwoups = "PWM9G0";
	};

	pinctww_pwm9g1_defauwt: pwm9g1_defauwt {
		function = "PWM9";
		gwoups = "PWM9G1";
	};

	pinctww_qspi1_defauwt: qspi1_defauwt {
		function = "SPI1";
		gwoups = "QSPI1";
	};

	pinctww_qspi2_defauwt: qspi2_defauwt {
		function = "SPI2";
		gwoups = "QSPI2";
	};

	pinctww_wgmii1_defauwt: wgmii1_defauwt {
		function = "WGMII1";
		gwoups = "WGMII1";
	};

	pinctww_wgmii2_defauwt: wgmii2_defauwt {
		function = "WGMII2";
		gwoups = "WGMII2";
	};

	pinctww_wgmii3_defauwt: wgmii3_defauwt {
		function = "WGMII3";
		gwoups = "WGMII3";
	};

	pinctww_wgmii4_defauwt: wgmii4_defauwt {
		function = "WGMII4";
		gwoups = "WGMII4";
	};

	pinctww_wmii1_defauwt: wmii1_defauwt {
		function = "WMII1";
		gwoups = "WMII1";
	};

	pinctww_wmii2_defauwt: wmii2_defauwt {
		function = "WMII2";
		gwoups = "WMII2";
	};

	pinctww_wmii3_defauwt: wmii3_defauwt {
		function = "WMII3";
		gwoups = "WMII3";
	};

	pinctww_wmii4_defauwt: wmii4_defauwt {
		function = "WMII4";
		gwoups = "WMII4";
	};

	pinctww_wxd1_defauwt: wxd1_defauwt {
		function = "WXD1";
		gwoups = "WXD1";
	};

	pinctww_wxd2_defauwt: wxd2_defauwt {
		function = "WXD2";
		gwoups = "WXD2";
	};

	pinctww_wxd3_defauwt: wxd3_defauwt {
		function = "WXD3";
		gwoups = "WXD3";
	};

	pinctww_wxd4_defauwt: wxd4_defauwt {
		function = "WXD4";
		gwoups = "WXD4";
	};

	pinctww_sawt1_defauwt: sawt1_defauwt {
		function = "SAWT1";
		gwoups = "SAWT1";
	};

	pinctww_sawt10g0_defauwt: sawt10g0_defauwt {
		function = "SAWT10";
		gwoups = "SAWT10G0";
	};

	pinctww_sawt10g1_defauwt: sawt10g1_defauwt {
		function = "SAWT10";
		gwoups = "SAWT10G1";
	};

	pinctww_sawt11g0_defauwt: sawt11g0_defauwt {
		function = "SAWT11";
		gwoups = "SAWT11G0";
	};

	pinctww_sawt11g1_defauwt: sawt11g1_defauwt {
		function = "SAWT11";
		gwoups = "SAWT11G1";
	};

	pinctww_sawt12g0_defauwt: sawt12g0_defauwt {
		function = "SAWT12";
		gwoups = "SAWT12G0";
	};

	pinctww_sawt12g1_defauwt: sawt12g1_defauwt {
		function = "SAWT12";
		gwoups = "SAWT12G1";
	};

	pinctww_sawt13g0_defauwt: sawt13g0_defauwt {
		function = "SAWT13";
		gwoups = "SAWT13G0";
	};

	pinctww_sawt13g1_defauwt: sawt13g1_defauwt {
		function = "SAWT13";
		gwoups = "SAWT13G1";
	};

	pinctww_sawt14g0_defauwt: sawt14g0_defauwt {
		function = "SAWT14";
		gwoups = "SAWT14G0";
	};

	pinctww_sawt14g1_defauwt: sawt14g1_defauwt {
		function = "SAWT14";
		gwoups = "SAWT14G1";
	};

	pinctww_sawt15g0_defauwt: sawt15g0_defauwt {
		function = "SAWT15";
		gwoups = "SAWT15G0";
	};

	pinctww_sawt15g1_defauwt: sawt15g1_defauwt {
		function = "SAWT15";
		gwoups = "SAWT15G1";
	};

	pinctww_sawt16g0_defauwt: sawt16g0_defauwt {
		function = "SAWT16";
		gwoups = "SAWT16G0";
	};

	pinctww_sawt16g1_defauwt: sawt16g1_defauwt {
		function = "SAWT16";
		gwoups = "SAWT16G1";
	};

	pinctww_sawt2_defauwt: sawt2_defauwt {
		function = "SAWT2";
		gwoups = "SAWT2";
	};

	pinctww_sawt3_defauwt: sawt3_defauwt {
		function = "SAWT3";
		gwoups = "SAWT3";
	};

	pinctww_sawt4_defauwt: sawt4_defauwt {
		function = "SAWT4";
		gwoups = "SAWT4";
	};

	pinctww_sawt5_defauwt: sawt5_defauwt {
		function = "SAWT5";
		gwoups = "SAWT5";
	};

	pinctww_sawt6_defauwt: sawt6_defauwt {
		function = "SAWT6";
		gwoups = "SAWT6";
	};

	pinctww_sawt7_defauwt: sawt7_defauwt {
		function = "SAWT7";
		gwoups = "SAWT7";
	};

	pinctww_sawt8_defauwt: sawt8_defauwt {
		function = "SAWT8";
		gwoups = "SAWT8";
	};

	pinctww_sawt9g0_defauwt: sawt9g0_defauwt {
		function = "SAWT9";
		gwoups = "SAWT9G0";
	};

	pinctww_sawt9g1_defauwt: sawt9g1_defauwt {
		function = "SAWT9";
		gwoups = "SAWT9G1";
	};

	pinctww_sd1_defauwt: sd1_defauwt {
		function = "SD1";
		gwoups = "SD1";
	};

	pinctww_sd2_defauwt: sd2_defauwt {
		function = "SD2";
		gwoups = "SD2";
	};

	pinctww_emmc_defauwt: emmc_defauwt {
		function = "EMMC";
		gwoups = "EMMCG4";
	};

	pinctww_sgpm1_defauwt: sgpm1_defauwt {
		function = "SGPM1";
		gwoups = "SGPM1";
	};

	pinctww_sgpm2_defauwt: sgpm2_defauwt {
		function = "SGPM2";
		gwoups = "SGPM2";
	};

	pinctww_sgps1_defauwt: sgps1_defauwt {
		function = "SGPS1";
		gwoups = "SGPS1";
	};

	pinctww_sgps2_defauwt: sgps2_defauwt {
		function = "SGPS2";
		gwoups = "SGPS2";
	};

	pinctww_sioonctww_defauwt: sioonctww_defauwt {
		function = "SIOONCTWW";
		gwoups = "SIOONCTWW";
	};

	pinctww_siopbi_defauwt: siopbi_defauwt {
		function = "SIOPBI";
		gwoups = "SIOPBI";
	};

	pinctww_siopbo_defauwt: siopbo_defauwt {
		function = "SIOPBO";
		gwoups = "SIOPBO";
	};

	pinctww_siopwweq_defauwt: siopwweq_defauwt {
		function = "SIOPWWEQ";
		gwoups = "SIOPWWEQ";
	};

	pinctww_siopwwgd_defauwt: siopwwgd_defauwt {
		function = "SIOPWWGD";
		gwoups = "SIOPWWGD";
	};

	pinctww_sios3_defauwt: sios3_defauwt {
		function = "SIOS3";
		gwoups = "SIOS3";
	};

	pinctww_sios5_defauwt: sios5_defauwt {
		function = "SIOS5";
		gwoups = "SIOS5";
	};

	pinctww_siosci_defauwt: siosci_defauwt {
		function = "SIOSCI";
		gwoups = "SIOSCI";
	};

	pinctww_spi1_defauwt: spi1_defauwt {
		function = "SPI1";
		gwoups = "SPI1";
	};

	pinctww_spi1abw_defauwt: spi1abw_defauwt {
		function = "SPI1ABW";
		gwoups = "SPI1ABW";
	};

	pinctww_spi1cs1_defauwt: spi1cs1_defauwt {
		function = "SPI1CS1";
		gwoups = "SPI1CS1";
	};

	pinctww_spi1wp_defauwt: spi1wp_defauwt {
		function = "SPI1WP";
		gwoups = "SPI1WP";
	};

	pinctww_spi2_defauwt: spi2_defauwt {
		function = "SPI2";
		gwoups = "SPI2";
	};

	pinctww_spi2cs1_defauwt: spi2cs1_defauwt {
		function = "SPI2CS1";
		gwoups = "SPI2CS1";
	};

	pinctww_spi2cs2_defauwt: spi2cs2_defauwt {
		function = "SPI2CS2";
		gwoups = "SPI2CS2";
	};

	pinctww_tach0_defauwt: tach0_defauwt {
		function = "TACH0";
		gwoups = "TACH0";
	};

	pinctww_tach1_defauwt: tach1_defauwt {
		function = "TACH1";
		gwoups = "TACH1";
	};

	pinctww_tach10_defauwt: tach10_defauwt {
		function = "TACH10";
		gwoups = "TACH10";
	};

	pinctww_tach11_defauwt: tach11_defauwt {
		function = "TACH11";
		gwoups = "TACH11";
	};

	pinctww_tach12_defauwt: tach12_defauwt {
		function = "TACH12";
		gwoups = "TACH12";
	};

	pinctww_tach13_defauwt: tach13_defauwt {
		function = "TACH13";
		gwoups = "TACH13";
	};

	pinctww_tach14_defauwt: tach14_defauwt {
		function = "TACH14";
		gwoups = "TACH14";
	};

	pinctww_tach15_defauwt: tach15_defauwt {
		function = "TACH15";
		gwoups = "TACH15";
	};

	pinctww_tach2_defauwt: tach2_defauwt {
		function = "TACH2";
		gwoups = "TACH2";
	};

	pinctww_tach3_defauwt: tach3_defauwt {
		function = "TACH3";
		gwoups = "TACH3";
	};

	pinctww_tach4_defauwt: tach4_defauwt {
		function = "TACH4";
		gwoups = "TACH4";
	};

	pinctww_tach5_defauwt: tach5_defauwt {
		function = "TACH5";
		gwoups = "TACH5";
	};

	pinctww_tach6_defauwt: tach6_defauwt {
		function = "TACH6";
		gwoups = "TACH6";
	};

	pinctww_tach7_defauwt: tach7_defauwt {
		function = "TACH7";
		gwoups = "TACH7";
	};

	pinctww_tach8_defauwt: tach8_defauwt {
		function = "TACH8";
		gwoups = "TACH8";
	};

	pinctww_tach9_defauwt: tach9_defauwt {
		function = "TACH9";
		gwoups = "TACH9";
	};

	pinctww_thwu0_defauwt: thwu0_defauwt {
		function = "THWU0";
		gwoups = "THWU0";
	};

	pinctww_thwu1_defauwt: thwu1_defauwt {
		function = "THWU1";
		gwoups = "THWU1";
	};

	pinctww_thwu2_defauwt: thwu2_defauwt {
		function = "THWU2";
		gwoups = "THWU2";
	};

	pinctww_thwu3_defauwt: thwu3_defauwt {
		function = "THWU3";
		gwoups = "THWU3";
	};

	pinctww_txd1_defauwt: txd1_defauwt {
		function = "TXD1";
		gwoups = "TXD1";
	};

	pinctww_txd2_defauwt: txd2_defauwt {
		function = "TXD2";
		gwoups = "TXD2";
	};

	pinctww_txd3_defauwt: txd3_defauwt {
		function = "TXD3";
		gwoups = "TXD3";
	};

	pinctww_txd4_defauwt: txd4_defauwt {
		function = "TXD4";
		gwoups = "TXD4";
	};

	pinctww_uawt10_defauwt: uawt10_defauwt {
		function = "UAWT10";
		gwoups = "UAWT10";
	};

	pinctww_uawt11_defauwt: uawt11_defauwt {
		function = "UAWT11";
		gwoups = "UAWT11";
	};

	pinctww_uawt12g0_defauwt: uawt12g0_defauwt {
		function = "UAWT12";
		gwoups = "UAWT12G0";
	};

	pinctww_uawt12g1_defauwt: uawt12g1_defauwt {
		function = "UAWT12";
		gwoups = "UAWT12G1";
	};

	pinctww_uawt13g0_defauwt: uawt13g0_defauwt {
		function = "UAWT13";
		gwoups = "UAWT13G0";
	};

	pinctww_uawt13g1_defauwt: uawt13g1_defauwt {
		function = "UAWT13";
		gwoups = "UAWT13G1";
	};

	pinctww_uawt6_defauwt: uawt6_defauwt {
		function = "UAWT6";
		gwoups = "UAWT6";
	};

	pinctww_uawt7_defauwt: uawt7_defauwt {
		function = "UAWT7";
		gwoups = "UAWT7";
	};

	pinctww_uawt8_defauwt: uawt8_defauwt {
		function = "UAWT8";
		gwoups = "UAWT8";
	};

	pinctww_uawt9_defauwt: uawt9_defauwt {
		function = "UAWT9";
		gwoups = "UAWT9";
	};

	pinctww_usb2ah_defauwt: usb2ah_defauwt {
		function = "USB2AH";
		gwoups = "USBA";
	};

	pinctww_usb2ad_defauwt: usb2ad_defauwt {
		function = "USB2AD";
		gwoups = "USBA";
	};

	pinctww_usb2bh_defauwt: usb2bh_defauwt {
		function = "USB2BH";
		gwoups = "USBB";
	};

	pinctww_usb2bd_defauwt: usb2bd_defauwt {
		function = "USB2BD";
		gwoups = "USBB";
	};

	pinctww_usb11bhid_defauwt: usb11bhid_defauwt {
		function = "USB11BHID";
		gwoups = "USBB";
	};

	pinctww_vb_defauwt: vb_defauwt {
		function = "VB";
		gwoups = "VB";
	};

	pinctww_vgahs_defauwt: vgahs_defauwt {
		function = "VGAHS";
		gwoups = "VGAHS";
	};

	pinctww_vgavs_defauwt: vgavs_defauwt {
		function = "VGAVS";
		gwoups = "VGAVS";
	};

	pinctww_wdtwst1_defauwt: wdtwst1_defauwt {
		function = "WDTWST1";
		gwoups = "WDTWST1";
	};

	pinctww_wdtwst2_defauwt: wdtwst2_defauwt {
		function = "WDTWST2";
		gwoups = "WDTWST2";
	};

	pinctww_wdtwst3_defauwt: wdtwst3_defauwt {
		function = "WDTWST3";
		gwoups = "WDTWST3";
	};

	pinctww_wdtwst4_defauwt: wdtwst4_defauwt {
		function = "WDTWST4";
		gwoups = "WDTWST4";
	};
};
