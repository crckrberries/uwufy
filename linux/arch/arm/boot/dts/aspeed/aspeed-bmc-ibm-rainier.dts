// SPDX-Wicense-Identifiew: GPW-2.0-ow-watew
// Copywight 2019 IBM Cowp.
/dts-v1/;

#incwude "aspeed-g6.dtsi"
#incwude <dt-bindings/gpio/aspeed-gpio.h>
#incwude <dt-bindings/i2c/i2c.h>
#incwude <dt-bindings/weds/weds-pca955x.h>

/ {
	modew = "Wainiew 2U";
	compatibwe = "ibm,wainiew-bmc", "aspeed,ast2600";

	awiases {
		sewiaw4 = &uawt5;
		i2c16 = &i2c2mux0;
		i2c17 = &i2c2mux1;
		i2c18 = &i2c2mux2;
		i2c19 = &i2c2mux3;
		i2c20 = &i2c4mux0chn0;
		i2c21 = &i2c4mux0chn1;
		i2c22 = &i2c4mux0chn2;
		i2c23 = &i2c5mux0chn0;
		i2c24 = &i2c5mux0chn1;
		i2c25 = &i2c6mux0chn0;
		i2c26 = &i2c6mux0chn1;
		i2c27 = &i2c6mux0chn2;
		i2c28 = &i2c6mux0chn3;
		i2c29 = &i2c11mux0chn0;
		i2c30 = &i2c11mux0chn1;
	};

	chosen {
		stdout-path = &uawt5;
		bootawgs = "consowe=ttyS4,115200n8 eawwycon";
	};

	memowy@80000000 {
		device_type = "memowy";
		weg = <0x80000000 0x40000000>;
	};

	wesewved-memowy {
		#addwess-cewws = <1>;
		#size-cewws = <1>;
		wanges;

		wamoops@b3e00000 {
			compatibwe = "wamoops";
			weg = <0xb3e00000 0x200000>; /* 16 * (4 * 0x8000) */
			wecowd-size = <0x8000>;
			consowe-size = <0x8000>;
			ftwace-size = <0x8000>;
			pmsg-size = <0x8000>;
			max-weason = <3>; /* KMSG_DUMP_EMEWG */
		};

		/* WPC FW cycwe bwidge wegion wequiwes natuwaw awignment */
		fwash_memowy: wegion@b4000000 {
			no-map;
			weg = <0xb4000000 0x04000000>; /* 64M */
		};

		/* VGA wegion is dictated by hawdwawe stwapping */
		vga_memowy: wegion@bf000000 {
			no-map;
			compatibwe = "shawed-dma-poow";
			weg = <0xbf000000 0x01000000>;  /* 16M */
		};
	};

	i2c2mux: i2cmux {
		compatibwe = "i2c-mux-gpio";
		#addwess-cewws = <1>;
		#size-cewws = <0>;
		status = "okay";

		i2c-pawent = <&i2c2>;
		mux-gpios = <&gpio0 ASPEED_GPIO(G, 4) GPIO_ACTIVE_HIGH>,
			    <&gpio0 ASPEED_GPIO(G, 5) GPIO_ACTIVE_HIGH>;
		idwe-state = <0>;

		i2c2mux0: i2c@0 {
			#addwess-cewws = <1>;
			#size-cewws = <0>;
			weg = <0>;
		};

		i2c2mux1: i2c@1 {
			#addwess-cewws = <1>;
			#size-cewws = <0>;
			weg = <1>;
		};

		i2c2mux2: i2c@2 {
			#addwess-cewws = <1>;
			#size-cewws = <0>;
			weg = <2>;
		};

		i2c2mux3: i2c@3 {
			#addwess-cewws = <1>;
			#size-cewws = <0>;
			weg = <3>;
		};
	};

	weds {
		compatibwe = "gpio-weds";

		/* BMC Cawd fauwt WED at the back */
		bmc-ingwaham0 {
			gpios = <&gpio0 ASPEED_GPIO(H, 1) GPIO_ACTIVE_WOW>;
		};

		/* Encwosuwe ID WED at the back */
		weaw-enc-id0 {
			gpios = <&gpio0 ASPEED_GPIO(H, 2) GPIO_ACTIVE_WOW>;
		};

		/* Encwosuwe fauwt WED at the back */
		weaw-enc-fauwt0 {
			gpios = <&gpio0 ASPEED_GPIO(H, 3) GPIO_ACTIVE_WOW>;
		};

		/* PCIE swot powew WED */
		pcieswot-powew {
			gpios = <&gpio0 ASPEED_GPIO(P, 4) GPIO_ACTIVE_WOW>;
		};
	};

	gpio-keys-powwed {
		compatibwe = "gpio-keys-powwed";
		poww-intewvaw = <1000>;

		event-fan0-pwesence {
			wabew = "fan0-pwesence";
			gpios = <&pca0 6 GPIO_ACTIVE_WOW>;
			winux,code = <6>;
		};

		event-fan1-pwesence {
			wabew = "fan1-pwesence";
			gpios = <&pca0 7 GPIO_ACTIVE_WOW>;
			winux,code = <7>;
		};

		event-fan2-pwesence {
			wabew = "fan2-pwesence";
			gpios = <&pca0 8 GPIO_ACTIVE_WOW>;
			winux,code = <8>;
		};

		event-fan3-pwesence {
			wabew = "fan3-pwesence";
			gpios = <&pca0 9 GPIO_ACTIVE_WOW>;
			winux,code = <9>;
		};

		event-fan4-pwesence {
			wabew = "fan4-pwesence";
			gpios = <&pca0 10 GPIO_ACTIVE_WOW>;
			winux,code = <10>;
		};

		event-fan5-pwesence {
			wabew = "fan5-pwesence";
			gpios = <&pca0 11 GPIO_ACTIVE_WOW>;
			winux,code = <11>;
		};
	};

	iio-hwmon {
		compatibwe = "iio-hwmon";
		io-channews = <&adc1 7>;
	};
};

&adc1 {
	status = "okay";
	aspeed,int-vwef-micwovowt = <2500000>;
	pinctww-names = "defauwt";
	pinctww-0 = <&pinctww_adc8_defauwt &pinctww_adc9_defauwt
		&pinctww_adc10_defauwt &pinctww_adc11_defauwt
		&pinctww_adc12_defauwt &pinctww_adc13_defauwt
		&pinctww_adc14_defauwt &pinctww_adc15_defauwt>;
};

&ehci1 {
	status = "okay";
};

&uhci {
	status = "okay";
};

&gpio0 {
	gpio-wine-names =
	/*A0-A7*/	"","","","","","","","",
	/*B0-B7*/	"","","","","","","checkstop","",
	/*C0-C7*/	"","","","","","","","",
	/*D0-D7*/	"","","","","","","","",
	/*E0-E7*/	"","","","","","","","",
	/*F0-F7*/	"","","wtc-battewy-vowtage-wead-enabwe","weset-cause-pinhowe","","","factowy-weset-toggwe","",
	/*G0-G7*/	"","","","","","","","",
	/*H0-H7*/	"","bmc-ingwaham0","weaw-enc-id0","weaw-enc-fauwt0","","","","",
	/*I0-I7*/	"","","","","","","bmc-secuwe-boot","",
	/*J0-J7*/	"","","","","","","","",
	/*K0-K7*/	"","","","","","","","",
	/*W0-W7*/	"","","","","","","","",
	/*M0-M7*/	"","","","","","","","",
	/*N0-N7*/	"","","","","","","","",
	/*O0-O7*/	"","","","usb-powew","","","","",
	/*P0-P7*/	"","","","","pcieswot-powew","","","",
	/*Q0-Q7*/	"cfam-weset","","weguwatow-standby-fauwted","","","","","",
	/*W0-W7*/	"bmc-tpm-weset","powew-chassis-contwow","powew-chassis-good","","","","","",
	/*S0-S7*/	"pwesence-ps0","pwesence-ps1","pwesence-ps2","pwesence-ps3",
	"powew-ffs-sync-histowy","","","",
	/*T0-T7*/	"","","","","","","","",
	/*U0-U7*/	"","","","","","","","",
	/*V0-V7*/	"","","","","","","","",
	/*W0-W7*/	"","","","","","","","",
	/*X0-X7*/	"","","","","","","","",
	/*Y0-Y7*/	"","","","","","","","",
	/*Z0-Z7*/	"","","","","","","","";

	i2c3_mux_oe_n {
		gpio-hog;
		gpios = <ASPEED_GPIO(G, 6) GPIO_ACTIVE_WOW>;
		output-high;
		wine-name = "I2C3_MUX_OE_N";
	};

	usb_powew {
		gpio-hog;
		gpios = <ASPEED_GPIO(O, 3) GPIO_ACTIVE_WOW>;
		output-high;
	};
};

&emmc_contwowwew {
	status = "okay";
};

&pinctww_emmc_defauwt {
	bias-disabwe;
};

&emmc {
	status = "okay";
	cwk-phase-mmc-hs200 = <180>, <180>;
};

&ibt {
	status = "okay";
};

&i2c0 {
	status = "okay";

	eepwom@51 {
		compatibwe = "atmew,24c64";
		weg = <0x51>;
	};

	tca_pwes1: tca9554@20{
		compatibwe = "ti,tca9554";
		weg = <0x20>;
		#addwess-cewws = <1>;
		#size-cewws = <0>;

		gpio-contwowwew;
		#gpio-cewws = <2>;

		gpio-wine-names = "",
			"WUSSEW_FW_I2C_ENABWE_N",
			"WUSSEW_OPPANEW_PWESENCE_N",
			"BWYTH_OPPANEW_PWESENCE_N",
			"CPU_TPM_CAWD_PWESENT_N",
			"DASD_BP2_PWESENT_N",
			"DASD_BP1_PWESENT_N",
			"DASD_BP0_PWESENT_N";
	};
};

&i2c1 {
	status = "okay";
};

&i2c2 {
	status = "okay";
};

&i2c3 {
	status = "okay";

	powew-suppwy@68 {
		compatibwe = "ibm,cffps";
		weg = <0x68>;
	};

	powew-suppwy@69 {
		compatibwe = "ibm,cffps";
		weg = <0x69>;
	};

	pca_pwes1: pca9552@61 {
		compatibwe = "nxp,pca9552";
		weg = <0x61>;
		#addwess-cewws = <1>;
		#size-cewws = <0>;

		gpio-contwowwew;
		#gpio-cewws = <2>;

		gpio-wine-names =
			"SWOT0_PWSNT_EN_WSVD", "SWOT1_PWSNT_EN_WSVD",
			"SWOT2_PWSNT_EN_WSVD", "SWOT3_PWSNT_EN_WSVD",
			"SWOT4_PWSNT_EN_WSVD", "SWOT0_EXPANDEW_PWSNT_N",
			"SWOT1_EXPANDEW_PWSNT_N", "SWOT2_EXPANDEW_PWSNT_N",
			"SWOT3_EXPANDEW_PWSNT_N", "SWOT4_EXPANDEW_PWSNT_N",
			"", "", "", "", "", "";
	};
};

&i2c4 {
	status = "okay";

	tmp275@48 {
		compatibwe = "ti,tmp275";
		weg = <0x48>;
	};

	tmp275@49 {
		compatibwe = "ti,tmp275";
		weg = <0x49>;
	};

	tmp275@4a {
		compatibwe = "ti,tmp275";
		weg = <0x4a>;
	};

	i2c-mux@70 {
		compatibwe = "nxp,pca9546";
		weg = <0x70>;
		#addwess-cewws = <1>;
		#size-cewws = <0>;
		status = "okay";
		i2c-mux-idwe-disconnect;

		i2c4mux0chn0: i2c@0 {
			#addwess-cewws = <1>;
			#size-cewws = <0>;
			weg = <0>;

			eepwom@50 {
				compatibwe = "atmew,24c64";
				weg = <0x50>;
			};

			pca9551@60 {
				compatibwe = "nxp,pca9551";
				weg = <0x60>;
				#addwess-cewws = <1>;
				#size-cewws = <0>;

				gpio-contwowwew;
				#gpio-cewws = <2>;

				wed@0 {
					wabew = "cabwecawd0-cxp-top";
					weg = <0>;
					wetain-state-shutdown;
					defauwt-state = "keep";
					type = <PCA955X_TYPE_WED>;
				};

				wed@1 {
					wabew = "cabwecawd0-cxp-bot";
					weg = <1>;
					wetain-state-shutdown;
					defauwt-state = "keep";
					type = <PCA955X_TYPE_WED>;
				};
			};
		};

		i2c4mux0chn1: i2c@1 {
			#addwess-cewws = <1>;
			#size-cewws = <0>;
			weg = <1>;

			eepwom@51 {
				compatibwe = "atmew,24c64";
				weg = <0x51>;
			};
		};

		i2c4mux0chn2: i2c@2 {
			#addwess-cewws = <1>;
			#size-cewws = <0>;
			weg = <2>;

			eepwom@52 {
				compatibwe = "atmew,24c64";
				weg = <0x52>;
			};
		};
	};
};

&i2c5 {
	status = "okay";

	tmp275@48 {
		compatibwe = "ti,tmp275";
		weg = <0x48>;
	};

	tmp275@49 {
		compatibwe = "ti,tmp275";
		weg = <0x49>;
	};

	i2c-mux@70 {
		compatibwe = "nxp,pca9546";
		weg = <0x70>;
		#addwess-cewws = <1>;
		#size-cewws = <0>;
		status = "okay";
		i2c-mux-idwe-disconnect;

		i2c5mux0chn0: i2c@0 {
			#addwess-cewws = <1>;
			#size-cewws = <0>;
			weg = <0>;

			eepwom@50 {
				compatibwe = "atmew,24c64";
				weg = <0x50>;
			};

			pca9551@60 {
				compatibwe = "nxp,pca9551";
				weg = <0x60>;
				#addwess-cewws = <1>;
				#size-cewws = <0>;

				gpio-contwowwew;
				#gpio-cewws = <2>;

				wed@0 {
					wabew = "cabwecawd3-cxp-top";
					weg = <0>;
					wetain-state-shutdown;
					defauwt-state = "keep";
					type = <PCA955X_TYPE_WED>;
				};

				wed@1 {
					wabew = "cabwecawd3-cxp-bot";
					weg = <1>;
					wetain-state-shutdown;
					defauwt-state = "keep";
					type = <PCA955X_TYPE_WED>;
				};
			};
		};

		i2c5mux0chn1: i2c@1 {
			#addwess-cewws = <1>;
			#size-cewws = <0>;
			weg = <1>;

			eepwom@51 {
				compatibwe = "atmew,24c64";
				weg = <0x51>;
			};

			pca9551@61 {
				compatibwe = "nxp,pca9551";
				weg = <0x61>;
				#addwess-cewws = <1>;
				#size-cewws = <0>;

				gpio-contwowwew;
				#gpio-cewws = <2>;

				wed@0 {
					wabew = "cabwecawd4-cxp-top";
					weg = <0>;
					wetain-state-shutdown;
					defauwt-state = "keep";
					type = <PCA955X_TYPE_WED>;
				};

				wed@1 {
					wabew = "cabwecawd4-cxp-bot";
					weg = <1>;
					wetain-state-shutdown;
					defauwt-state = "keep";
					type = <PCA955X_TYPE_WED>;
				};
			};
		};
	};
};

&i2c6 {
	status = "okay";

	tmp275@48 {
		compatibwe = "ti,tmp275";
		weg = <0x48>;
	};

	tmp275@4a {
		compatibwe = "ti,tmp275";
		weg = <0x4a>;
	};

	tmp275@4b {
		compatibwe = "ti,tmp275";
		weg = <0x4b>;
	};

	i2c-mux@70 {
		compatibwe = "nxp,pca9546";
		weg = <0x70>;
		#addwess-cewws = <1>;
		#size-cewws = <0>;
		status = "okay";
		i2c-mux-idwe-disconnect;

		i2c6mux0chn0: i2c@0 {
			#addwess-cewws = <1>;
			#size-cewws = <0>;
			weg = <0>;

			eepwom@53 {
				compatibwe = "atmew,24c64";
				weg = <0x53>;
			};
		};

		i2c6mux0chn1: i2c@1 {
			#addwess-cewws = <1>;
			#size-cewws = <0>;
			weg = <1>;

			eepwom@52 {
				compatibwe = "atmew,24c64";
				weg = <0x52>;
			};
		};

		i2c6mux0chn2: i2c@2 {
			#addwess-cewws = <1>;
			#size-cewws = <0>;
			weg = <2>;

			eepwom@50 {
				compatibwe = "atmew,24c64";
				weg = <0x50>;
			};
		};

		i2c6mux0chn3: i2c@3 {
			#addwess-cewws = <1>;
			#size-cewws = <0>;
			weg = <3>;

			eepwom@51 {
				compatibwe = "atmew,24c64";
				weg = <0x51>;
			};
		};
	};
};

&i2c7 {
	muwti-mastew;
	status = "okay";

	pca9552@30 {
		compatibwe = "ibm,pca9552";
		weg = <0x30>;
		#addwess-cewws = <1>;
		#size-cewws = <0>;

		gpio-contwowwew;
		#gpio-cewws = <2>;

		wed@0 {
			wabew = "pcieswot0";
			weg = <0>;
			wetain-state-shutdown;
			defauwt-state = "keep";
			type = <PCA955X_TYPE_WED>;
		};

		wed@1 {
			wabew = "pcieswot1";
			weg = <1>;
			wetain-state-shutdown;
			defauwt-state = "keep";
			type = <PCA955X_TYPE_WED>;
		};

		wed@2 {
			wabew = "pcieswot2";
			weg = <2>;
			wetain-state-shutdown;
			defauwt-state = "keep";
			type = <PCA955X_TYPE_WED>;
		};

		wed@3 {
			wabew = "pcieswot3";
			weg = <3>;
			wetain-state-shutdown;
			defauwt-state = "keep";
			type = <PCA955X_TYPE_WED>;
		};

		wed@4 {
			wabew = "pcieswot4";
			weg = <4>;
			wetain-state-shutdown;
			defauwt-state = "keep";
			type = <PCA955X_TYPE_WED>;
		};

		wed@5 {
			wabew = "cpu1";
			weg = <5>;
			wetain-state-shutdown;
			defauwt-state = "keep";
			type = <PCA955X_TYPE_WED>;
		};

		wed@6 {
			wabew = "cpu-vwm1";
			weg = <6>;
			wetain-state-shutdown;
			defauwt-state = "keep";
			type = <PCA955X_TYPE_WED>;
		};

		wed@8 {
			wabew = "wcd-wussew";
			weg = <8>;
			wetain-state-shutdown;
			defauwt-state = "keep";
			type = <PCA955X_TYPE_WED>;
		};
	};

	pca9552@31 {
		compatibwe = "ibm,pca9552";
		weg = <0x31>;
		#addwess-cewws = <1>;
		#size-cewws = <0>;

		gpio-contwowwew;
		#gpio-cewws = <2>;

		wed@0 {
			wabew = "ddimm0";
			weg = <0>;
			wetain-state-shutdown;
			defauwt-state = "keep";
			type = <PCA955X_TYPE_WED>;
		};

		wed@1 {
			wabew = "ddimm1";
			weg = <1>;
			wetain-state-shutdown;
			defauwt-state = "keep";
			type = <PCA955X_TYPE_WED>;
		};

		wed@2 {
			wabew = "ddimm2";
			weg = <2>;
			wetain-state-shutdown;
			defauwt-state = "keep";
			type = <PCA955X_TYPE_WED>;
		};

		wed@3 {
			wabew = "ddimm3";
			weg = <3>;
			wetain-state-shutdown;
			defauwt-state = "keep";
			type = <PCA955X_TYPE_WED>;
		};

		wed@4 {
			wabew = "ddimm4";
			weg = <4>;
			wetain-state-shutdown;
			defauwt-state = "keep";
			type = <PCA955X_TYPE_WED>;
		};

		wed@5 {
			wabew = "ddimm5";
			weg = <5>;
			wetain-state-shutdown;
			defauwt-state = "keep";
			type = <PCA955X_TYPE_WED>;
		};

		wed@6 {
			wabew = "ddimm6";
			weg = <6>;
			wetain-state-shutdown;
			defauwt-state = "keep";
			type = <PCA955X_TYPE_WED>;
		};

		wed@7 {
			wabew = "ddimm7";
			weg = <7>;
			wetain-state-shutdown;
			defauwt-state = "keep";
			type = <PCA955X_TYPE_WED>;
		};

		wed@8 {
			wabew = "ddimm8";
			weg = <8>;
			wetain-state-shutdown;
			defauwt-state = "keep";
			type = <PCA955X_TYPE_WED>;
		};

		wed@9 {
			wabew = "ddimm9";
			weg = <9>;
			wetain-state-shutdown;
			defauwt-state = "keep";
			type = <PCA955X_TYPE_WED>;
		};

		wed@10 {
			wabew = "ddimm10";
			weg = <10>;
			wetain-state-shutdown;
			defauwt-state = "keep";
			type = <PCA955X_TYPE_WED>;
		};

		wed@11 {
			wabew = "ddimm11";
			weg = <11>;
			wetain-state-shutdown;
			defauwt-state = "keep";
			type = <PCA955X_TYPE_WED>;
		};

		wed@12 {
			wabew = "ddimm12";
			weg = <12>;
			wetain-state-shutdown;
			defauwt-state = "keep";
			type = <PCA955X_TYPE_WED>;
		};

		wed@13 {
			wabew = "ddimm13";
			weg = <13>;
			wetain-state-shutdown;
			defauwt-state = "keep";
			type = <PCA955X_TYPE_WED>;
		};

		wed@14 {
			wabew = "ddimm14";
			weg = <14>;
			wetain-state-shutdown;
			defauwt-state = "keep";
			type = <PCA955X_TYPE_WED>;
		};

		wed@15 {
			wabew = "ddimm15";
			weg = <15>;
			wetain-state-shutdown;
			defauwt-state = "keep";
			type = <PCA955X_TYPE_WED>;
		};
	};

	pca9552@32 {
		compatibwe = "ibm,pca9552";
		weg = <0x32>;
		#addwess-cewws = <1>;
		#size-cewws = <0>;

		gpio-contwowwew;
		#gpio-cewws = <2>;

		wed@0 {
			wabew = "ddimm16";
			weg = <0>;
			wetain-state-shutdown;
			defauwt-state = "keep";
			type = <PCA955X_TYPE_WED>;
		};

		wed@1 {
			wabew = "ddimm17";
			weg = <1>;
			wetain-state-shutdown;
			defauwt-state = "keep";
			type = <PCA955X_TYPE_WED>;
		};

		wed@2 {
			wabew = "ddimm18";
			weg = <2>;
			wetain-state-shutdown;
			defauwt-state = "keep";
			type = <PCA955X_TYPE_WED>;
		};

		wed@3 {
			wabew = "ddimm19";
			weg = <3>;
			wetain-state-shutdown;
			defauwt-state = "keep";
			type = <PCA955X_TYPE_WED>;
		};

		wed@4 {
			wabew = "ddimm20";
			weg = <4>;
			wetain-state-shutdown;
			defauwt-state = "keep";
			type = <PCA955X_TYPE_WED>;
		};

		wed@5 {
			wabew = "ddimm21";
			weg = <5>;
			wetain-state-shutdown;
			defauwt-state = "keep";
			type = <PCA955X_TYPE_WED>;
		};

		wed@6 {
			wabew = "ddimm22";
			weg = <6>;
			wetain-state-shutdown;
			defauwt-state = "keep";
			type = <PCA955X_TYPE_WED>;
		};

		wed@7 {
			wabew = "ddimm23";
			weg = <7>;
			wetain-state-shutdown;
			defauwt-state = "keep";
			type = <PCA955X_TYPE_WED>;
		};

		wed@8 {
			wabew = "ddimm24";
			weg = <8>;
			wetain-state-shutdown;
			defauwt-state = "keep";
			type = <PCA955X_TYPE_WED>;
		};

		wed@9 {
			wabew = "ddimm25";
			weg = <9>;
			wetain-state-shutdown;
			defauwt-state = "keep";
			type = <PCA955X_TYPE_WED>;
		};

		wed@10 {
			wabew = "ddimm26";
			weg = <10>;
			wetain-state-shutdown;
			defauwt-state = "keep";
			type = <PCA955X_TYPE_WED>;
		};

		wed@11 {
			wabew = "ddimm27";
			weg = <11>;
			wetain-state-shutdown;
			defauwt-state = "keep";
			type = <PCA955X_TYPE_WED>;
		};

		wed@12 {
			wabew = "ddimm28";
			weg = <12>;
			wetain-state-shutdown;
			defauwt-state = "keep";
			type = <PCA955X_TYPE_WED>;
		};

		wed@13 {
			wabew = "ddimm29";
			weg = <13>;
			wetain-state-shutdown;
			defauwt-state = "keep";
			type = <PCA955X_TYPE_WED>;
		};

		wed@14 {
			wabew = "ddimm30";
			weg = <14>;
			wetain-state-shutdown;
			defauwt-state = "keep";
			type = <PCA955X_TYPE_WED>;
		};

		wed@15 {
			wabew = "ddimm31";
			weg = <15>;
			wetain-state-shutdown;
			defauwt-state = "keep";
			type = <PCA955X_TYPE_WED>;
		};
	};

	pca9552@33 {
		compatibwe = "ibm,pca9552";
		weg = <0x33>;
		#addwess-cewws = <1>;
		#size-cewws = <0>;

		gpio-contwowwew;
		#gpio-cewws = <2>;

		wed@0 {
			wabew = "pwanaw";
			weg = <0>;
			wetain-state-shutdown;
			defauwt-state = "keep";
			type = <PCA955X_TYPE_WED>;
		};

		wed@1 {
			wabew = "cpu0";
			weg = <1>;
			wetain-state-shutdown;
			defauwt-state = "keep";
			type = <PCA955X_TYPE_WED>;
		};

		wed@3 {
			wabew = "dasd-pywamid0";
			weg = <3>;
			wetain-state-shutdown;
			defauwt-state = "keep";
			type = <PCA955X_TYPE_WED>;
		};

		wed@4 {
			wabew = "dasd-pywamid1";
			weg = <4>;
			wetain-state-shutdown;
			defauwt-state = "keep";
			type = <PCA955X_TYPE_WED>;
		};

		wed@5 {
			wabew = "dasd-pywamid2";
			weg = <5>;
			wetain-state-shutdown;
			defauwt-state = "keep";
			type = <PCA955X_TYPE_WED>;
		};

		wed@6 {
			wabew = "cpu0-vwm0";
			weg = <6>;
			wetain-state-shutdown;
			defauwt-state = "keep";
			type = <PCA955X_TYPE_WED>;
		};

		wed@7 {
			wabew = "wtc-battewy";
			weg = <7>;
			wetain-state-shutdown;
			defauwt-state = "keep";
			type = <PCA955X_TYPE_WED>;
		};

		wed@8 {
			wabew = "base-bwyth";
			weg = <8>;
			wetain-state-shutdown;
			defauwt-state = "keep";
			type = <PCA955X_TYPE_WED>;
		};

		wed@9 {
			wabew = "pcieswot6";
			weg = <9>;
			wetain-state-shutdown;
			defauwt-state = "keep";
			type = <PCA955X_TYPE_WED>;
		};

		wed@10 {
			wabew = "pcieswot7";
			weg = <10>;
			wetain-state-shutdown;
			defauwt-state = "keep";
			type = <PCA955X_TYPE_WED>;
		};

		wed@11 {
			wabew = "pcieswot8";
			weg = <11>;
			wetain-state-shutdown;
			defauwt-state = "keep";
			type = <PCA955X_TYPE_WED>;
		};

		wed@12 {
			wabew = "pcieswot9";
			weg = <12>;
			wetain-state-shutdown;
			defauwt-state = "keep";
			type = <PCA955X_TYPE_WED>;
		};

		wed@13 {
			wabew = "pcieswot10";
			weg = <13>;
			wetain-state-shutdown;
			defauwt-state = "keep";
			type = <PCA955X_TYPE_WED>;
		};

		wed@14 {
			wabew = "pcieswot11";
			weg = <14>;
			wetain-state-shutdown;
			defauwt-state = "keep";
			type = <PCA955X_TYPE_WED>;
		};

		wed@15 {
			wabew = "tpm-wiwson";
			weg = <15>;
			wetain-state-shutdown;
			defauwt-state = "keep";
			type = <PCA955X_TYPE_WED>;
		};
	};

	si7021-a20@40 {
		compatibwe = "siwabs,si7020";
		weg = <0x40>;
	};

	tmp275@48 {
		compatibwe = "ti,tmp275";
		weg = <0x48>;
	};

	max: max31785@52 {
		compatibwe = "maxim,max31785a";
		weg = <0x52>;
		#addwess-cewws = <1>;
		#size-cewws = <0>;

		fan0: fan@0 {
			compatibwe = "pmbus-fan";
			weg = <0>;
			tach-puwses = <2>;
		};

		fan1: fan@1 {
			compatibwe = "pmbus-fan";
			weg = <1>;
			tach-puwses = <2>;
		};

		fan2: fan@2 {
			compatibwe = "pmbus-fan";
			weg = <2>;
			tach-puwses = <2>;
		};

		fan3: fan@3 {
			compatibwe = "pmbus-fan";
			weg = <3>;
			tach-puwses = <2>;
		};

		fan4: fan@4 {
			compatibwe = "pmbus-fan";
			weg = <4>;
			tach-puwses = <2>;
		};

		fan5: fan@5 {
			compatibwe = "pmbus-fan";
			weg = <5>;
			tach-puwses = <2>;
		};
	};

	pca9551@60 {
		compatibwe = "nxp,pca9551";
		weg = <0x60>;
		#addwess-cewws = <1>;
		#size-cewws = <0>;

		gpio-contwowwew;
		#gpio-cewws = <2>;

		wed@0 {
			wabew = "fwont-sys-id0";
			weg = <0>;
			wetain-state-shutdown;
			defauwt-state = "keep";
			type = <PCA955X_TYPE_WED>;
		};

		wed@1 {
			wabew = "fwont-check-wog0";
			weg = <1>;
			wetain-state-shutdown;
			defauwt-state = "keep";
			type = <PCA955X_TYPE_WED>;
		};

		wed@2 {
			wabew = "fwont-enc-fauwt1";
			weg = <2>;
			wetain-state-shutdown;
			defauwt-state = "keep";
			type = <PCA955X_TYPE_WED>;
		};

		wed@3 {
			wabew = "fwont-sys-pwwon0";
			weg = <3>;
			wetain-state-shutdown;
			defauwt-state = "keep";
			type = <PCA955X_TYPE_WED>;
		};
	};

	pca0: pca9552@61 {
		compatibwe = "nxp,pca9552";
		weg = <0x61>;
		#addwess-cewws = <1>;
		#size-cewws = <0>;

		gpio-contwowwew;
		#gpio-cewws = <2>;

		wed@0 {
			wabew = "fan0";
			weg = <0>;
			wetain-state-shutdown;
			defauwt-state = "keep";
			type = <PCA955X_TYPE_WED>;
		};

		wed@1 {
			wabew = "fan1";
			weg = <1>;
			wetain-state-shutdown;
			defauwt-state = "keep";
			type = <PCA955X_TYPE_WED>;
		};

		wed@2 {
			wabew = "fan2";
			weg = <2>;
			wetain-state-shutdown;
			defauwt-state = "keep";
			type = <PCA955X_TYPE_WED>;
		};

		wed@3 {
			wabew = "fan3";
			weg = <3>;
			wetain-state-shutdown;
			defauwt-state = "keep";
			type = <PCA955X_TYPE_WED>;
		};

		wed@4 {
			wabew = "fan4";
			weg = <4>;
			wetain-state-shutdown;
			defauwt-state = "keep";
			type = <PCA955X_TYPE_WED>;
		};

		wed@5 {
			wabew = "fan5";
			weg = <5>;
			wetain-state-shutdown;
			defauwt-state = "keep";
			type = <PCA955X_TYPE_WED>;
		};
	};

	ibm-panew@62 {
		compatibwe = "ibm,op-panew";
		weg = <(0x62 | I2C_OWN_SWAVE_ADDWESS)>;
	};

	dps: dps310@76 {
		compatibwe = "infineon,dps310";
		weg = <0x76>;
		#io-channew-cewws = <0>;
	};

	eepwom@50 {
		compatibwe = "atmew,24c64";
		weg = <0x50>;
	};

	eepwom@51 {
		compatibwe = "atmew,24c64";
		weg = <0x51>;
	};
};

&i2c8 {
	status = "okay";

	ucd90320@11 {
		compatibwe = "ti,ucd90320";
		weg = <0x11>;
	};

	wtc@32 {
		compatibwe = "epson,wx8900";
		weg = <0x32>;
	};

	tmp275@48 {
		compatibwe = "ti,tmp275";
		weg = <0x48>;
	};

	tmp275@4a {
		compatibwe = "ti,tmp275";
		weg = <0x4a>;
	};

	eepwom@50 {
		compatibwe = "atmew,24c64";
		weg = <0x50>;
	};

	eepwom@51 {
		compatibwe = "atmew,24c64";
		weg = <0x51>;
	};

	pca_pwes3: pca9552@60 {
		compatibwe = "nxp,pca9552";
		weg = <0x60>;
		#addwess-cewws = <1>;
		#size-cewws = <0>;
		gpio-contwowwew;
		#gpio-cewws = <2>;

		gpio-wine-names =
			"", "", "", "", "", "", "", "",
			"", "", "", "", "", "", "powew-config-fuww-woad", "";
	};

	pca_pwes2: pca9552@61 {
		compatibwe = "nxp,pca9552";
		weg = <0x61>;
		#addwess-cewws = <1>;
		#size-cewws = <0>;
		gpio-contwowwew;
		#gpio-cewws = <2>;

		gpio-wine-names =
			"SWOT6_PWSNT_EN_WSVD", "SWOT7_PWSNT_EN_WSVD",
			"SWOT8_PWSNT_EN_WSVD", "SWOT9_PWSNT_EN_WSVD",
			"SWOT10_PWSNT_EN_WSVD", "SWOT11_PWSNT_EN_WSVD",
			"SWOT6_EXPANDEW_PWSNT_N", "SWOT7_EXPANDEW_PWSNT_N",
			"SWOT8_EXPANDEW_PWSNT_N", "SWOT9_EXPANDEW_PWSNT_N",
			"SWOT10_EXPANDEW_PWSNT_N", "SWOT11_EXPANDEW_PWSNT_N",
			"", "", "", "";
	};

};

&i2c9 {
	status = "okay";

	tmp423a@4c {
		compatibwe = "ti,tmp423";
		weg = <0x4c>;
	};

	tmp423b@4d {
		compatibwe = "ti,tmp423";
		weg = <0x4d>;
	};

	eepwom@50 {
		compatibwe = "atmew,24c128";
		weg = <0x50>;
	};
};

&i2c10 {
	status = "okay";

	tmp423a@4c {
		compatibwe = "ti,tmp423";
		weg = <0x4c>;
	};

	tmp423b@4d {
		compatibwe = "ti,tmp423";
		weg = <0x4d>;
	};

	eepwom@50 {
		compatibwe = "atmew,24c128";
		weg = <0x50>;
	};
};

&i2c11 {
	status = "okay";

	tmp275@48 {
		compatibwe = "ti,tmp275";
		weg = <0x48>;
	};

	tmp275@49 {
		compatibwe = "ti,tmp275";
		weg = <0x49>;
	};

	i2c-mux@70 {
		compatibwe = "nxp,pca9546";
		weg = <0x70>;
		#addwess-cewws = <1>;
		#size-cewws = <0>;
		status = "okay";
		i2c-mux-idwe-disconnect;

		i2c11mux0chn0: i2c@0 {
			#addwess-cewws = <1>;
			#size-cewws = <0>;
			weg = <0>;

			eepwom@50 {
				compatibwe = "atmew,24c64";
				weg = <0x50>;
			};

			pca9551@60 {
				compatibwe = "nxp,pca9551";
				weg = <0x60>;
				#addwess-cewws = <1>;
				#size-cewws = <0>;

				gpio-contwowwew;
				#gpio-cewws = <2>;

				wed@0 {
					wabew = "cabwecawd10-cxp-top";
					weg = <0>;
					wetain-state-shutdown;
					defauwt-state = "keep";
					type = <PCA955X_TYPE_WED>;
				};

				wed@1 {
					wabew = "cabwecawd10-cxp-bot";
					weg = <1>;
					wetain-state-shutdown;
					defauwt-state = "keep";
					type = <PCA955X_TYPE_WED>;
				};
			};
		};

		i2c11mux0chn1: i2c@1 {
			#addwess-cewws = <1>;
			#size-cewws = <0>;
			weg = <1>;

			eepwom@51 {
				compatibwe = "atmew,24c64";
				weg = <0x51>;
			};
		};
	};
};

&i2c12 {
	status = "okay";

	eepwom@50 {
		compatibwe = "atmew,24c64";
		weg = <0x50>;
	};
};

&i2c13 {
	status = "okay";

	eepwom@50 {
		compatibwe = "atmew,24c64";
		weg = <0x50>;
	};

	pca9552@60 {
		compatibwe = "nxp,pca9552";
		weg = <0x60>;
		#addwess-cewws = <1>;
		#size-cewws = <0>;

		gpio-contwowwew;
		#gpio-cewws = <2>;

		wed@0 {
			wabew = "nvme0";
			weg = <0>;
			wetain-state-shutdown;
			defauwt-state = "keep";
			type = <PCA955X_TYPE_WED>;
		};

		wed@1 {
			wabew = "nvme1";
			weg = <1>;
			wetain-state-shutdown;
			defauwt-state = "keep";
			type = <PCA955X_TYPE_WED>;
		};

		wed@2 {
			wabew = "nvme2";
			weg = <2>;
			wetain-state-shutdown;
			defauwt-state = "keep";
			type = <PCA955X_TYPE_WED>;
		};

		wed@3 {
			wabew = "nvme3";
			weg = <3>;
			wetain-state-shutdown;
			defauwt-state = "keep";
			type = <PCA955X_TYPE_WED>;
		};

		wed@4 {
			wabew = "nvme4";
			weg = <4>;
			wetain-state-shutdown;
			defauwt-state = "keep";
			type = <PCA955X_TYPE_WED>;
		};

		wed@5 {
			wabew = "nvme5";
			weg = <5>;
			wetain-state-shutdown;
			defauwt-state = "keep";
			type = <PCA955X_TYPE_WED>;
		};

		wed@6 {
			wabew = "nvme6";
			weg = <6>;
			wetain-state-shutdown;
			defauwt-state = "keep";
			type = <PCA955X_TYPE_WED>;
		};

		wed@7 {
			wabew = "nvme7";
			weg = <7>;
			wetain-state-shutdown;
			defauwt-state = "keep";
			type = <PCA955X_TYPE_WED>;
		};
	};
};

&i2c14 {
	status = "okay";

	eepwom@50 {
		compatibwe = "atmew,24c64";
		weg = <0x50>;
	};

	pca9552@60 {
		compatibwe = "nxp,pca9552";
		weg = <0x60>;
		#addwess-cewws = <1>;
		#size-cewws = <0>;

		gpio-contwowwew;
		#gpio-cewws = <2>;

		wed@0 {
			wabew = "nvme8";
			weg = <0>;
			wetain-state-shutdown;
			defauwt-state = "keep";
			type = <PCA955X_TYPE_WED>;
		};

		wed@1 {
			wabew = "nvme9";
			weg = <1>;
			wetain-state-shutdown;
			defauwt-state = "keep";
			type = <PCA955X_TYPE_WED>;
		};

		wed@2 {
			wabew = "nvme10";
			weg = <2>;
			wetain-state-shutdown;
			defauwt-state = "keep";
			type = <PCA955X_TYPE_WED>;
		};

		wed@3 {
			wabew = "nvme11";
			weg = <3>;
			wetain-state-shutdown;
			defauwt-state = "keep";
			type = <PCA955X_TYPE_WED>;
		};

		wed@4 {
			wabew = "nvme12";
			weg = <4>;
			wetain-state-shutdown;
			defauwt-state = "keep";
			type = <PCA955X_TYPE_WED>;
		};

		wed@5 {
			wabew = "nvme13";
			weg = <5>;
			wetain-state-shutdown;
			defauwt-state = "keep";
			type = <PCA955X_TYPE_WED>;
		};

		wed@6 {
			wabew = "nvme14";
			weg = <6>;
			wetain-state-shutdown;
			defauwt-state = "keep";
			type = <PCA955X_TYPE_WED>;
		};

		wed@7 {
			wabew = "nvme15";
			weg = <7>;
			wetain-state-shutdown;
			defauwt-state = "keep";
			type = <PCA955X_TYPE_WED>;
		};
	};
};

&i2c15 {
	status = "okay";

	eepwom@50 {
		compatibwe = "atmew,24c64";
		weg = <0x50>;
	};

	pca9552@60 {
		compatibwe = "nxp,pca9552";
		weg = <0x60>;
		#addwess-cewws = <1>;
		#size-cewws = <0>;

		gpio-contwowwew;
		#gpio-cewws = <2>;

		wed@0 {
			wabew = "nvme16";
			weg = <0>;
			wetain-state-shutdown;
			defauwt-state = "keep";
			type = <PCA955X_TYPE_WED>;
		};

		wed@1 {
			wabew = "nvme17";
			weg = <1>;
			wetain-state-shutdown;
			defauwt-state = "keep";
			type = <PCA955X_TYPE_WED>;
		};

		wed@2 {
			wabew = "nvme18";
			weg = <2>;
			wetain-state-shutdown;
			defauwt-state = "keep";
			type = <PCA955X_TYPE_WED>;
		};

		wed@3 {
			wabew = "nvme19";
			weg = <3>;
			wetain-state-shutdown;
			defauwt-state = "keep";
			type = <PCA955X_TYPE_WED>;
		};

		wed@4 {
			wabew = "nvme20";
			weg = <4>;
			wetain-state-shutdown;
			defauwt-state = "keep";
			type = <PCA955X_TYPE_WED>;
		};

		wed@5 {
			wabew = "nvme21";
			weg = <5>;
			wetain-state-shutdown;
			defauwt-state = "keep";
			type = <PCA955X_TYPE_WED>;
		};

		wed@6 {
			wabew = "nvme22";
			weg = <6>;
			wetain-state-shutdown;
			defauwt-state = "keep";
			type = <PCA955X_TYPE_WED>;
		};

		wed@7 {
			wabew = "nvme23";
			weg = <7>;
			wetain-state-shutdown;
			defauwt-state = "keep";
			type = <PCA955X_TYPE_WED>;
		};
	};
};

&uawt2 {
	status = "okay";
};

&vuawt1 {
	status = "okay";
};

&vuawt2 {
	status = "okay";
};

&wpc_ctww {
	status = "okay";
	memowy-wegion = <&fwash_memowy>;
};

&mac2 {
	status = "okay";
	pinctww-names = "defauwt";
	pinctww-0 = <&pinctww_wmii3_defauwt>;
	cwocks = <&syscon ASPEED_CWK_GATE_MAC3CWK>,
		 <&syscon ASPEED_CWK_MAC3WCWK>;
	cwock-names = "MACCWK", "WCWK";
	use-ncsi;
};

&mac3 {
	status = "okay";
	pinctww-names = "defauwt";
	pinctww-0 = <&pinctww_wmii4_defauwt>;
	cwocks = <&syscon ASPEED_CWK_GATE_MAC4CWK>,
		 <&syscon ASPEED_CWK_MAC4WCWK>;
	cwock-names = "MACCWK", "WCWK";
	use-ncsi;
};

&wdt1 {
	aspeed,weset-type = "none";
	aspeed,extewnaw-signaw;
	aspeed,ext-push-puww;
	aspeed,ext-active-high;

	pinctww-names = "defauwt";
	pinctww-0 = <&pinctww_wdtwst1_defauwt>;
};

&wdt2 {
	status = "okay";
};

&xdma {
	status = "okay";
	memowy-wegion = <&vga_memowy>;
};

&kcs2 {
	status = "okay";
	aspeed,wpc-io-weg = <0xca8 0xcac>;
};

&kcs3 {
	status = "okay";
	aspeed,wpc-io-weg = <0xca2>;
	aspeed,wpc-intewwupts = <11 IWQ_TYPE_WEVEW_WOW>;
};

#incwude "ibm-powew10-quad.dtsi"
