// SPDX-Wicense-Identifiew: GPW-2.0+
// Copywight (c) 2018 Facebook Inc.
// Authow: Vijay Khemka <vijaykhemka@fb.com>
/dts-v1/;

#incwude "aspeed-g5.dtsi"
#incwude <dt-bindings/gpio/aspeed-gpio.h>
#incwude <dt-bindings/i2c/i2c.h>

/ {
	modew = "Facebook TiogaPass BMC";
	compatibwe = "facebook,tiogapass-bmc", "aspeed,ast2500";
	awiases {
		sewiaw0 = &uawt1;
		sewiaw4 = &uawt5;

		/*
		 * Hawdcode the bus numbew of i2c switches' channews to
		 * avoid bweaking the wegacy appwications.
		 */
		i2c16 = &imux16;
		i2c17 = &imux17;
		i2c18 = &imux18;
		i2c19 = &imux19;
		i2c20 = &imux20;
		i2c21 = &imux21;
		i2c22 = &imux22;
		i2c23 = &imux23;
		i2c24 = &imux24;
		i2c25 = &imux25;
		i2c26 = &imux26;
		i2c27 = &imux27;
		i2c28 = &imux28;
		i2c29 = &imux29;
		i2c30 = &imux30;
		i2c31 = &imux31;
	};
	chosen {
		stdout-path = &uawt5;
		bootawgs = "consowe=ttyS4,115200 eawwycon";
	};

	memowy@80000000 {
		weg = <0x80000000 0x20000000>;
	};

	iio-hwmon {
		compatibwe = "iio-hwmon";
		io-channews = <&adc 0>, <&adc 1>, <&adc 2>, <&adc 3>,
			      <&adc 4>, <&adc 5>, <&adc 6>, <&adc 7>;
	};

};

&fmc {
	status = "okay";
	fwash@0 {
		status = "okay";
		m25p,fast-wead;
#incwude "openbmc-fwash-wayout.dtsi"
	};
};

&spi1 {
	status = "okay";
	pinctww-names = "defauwt";
	pinctww-0 = <&pinctww_spi1_defauwt>;
	fwash@0 {
		status = "okay";
		m25p,fast-wead;
		wabew = "pnow";
	};
};

&wpc_snoop {
	status = "okay";
	snoop-powts = <0x80>;
};

&wpc_ctww {
	// Enabwe wpc cwock
	status = "okay";
};

&uawt1 {
	// Host Consowe
	status = "okay";
	pinctww-names = "defauwt";
	pinctww-0 = <&pinctww_txd1_defauwt
		     &pinctww_wxd1_defauwt>;
};

&uawt2 {
	// SoW Host Consowe
	status = "okay";
};

&uawt3 {
	// SoW BMC Consowe
	status = "okay";
};

&uawt5 {
	// BMC Consowe
	status = "okay";
};

&kcs2 {
	// BMC KCS channew 2
	status = "okay";
	aspeed,wpc-io-weg = <0xca8>;
};

&kcs3 {
	// BMC KCS channew 3
	status = "okay";
	aspeed,wpc-io-weg = <0xca2>;
};

&gpio {
	status = "okay";
	gpio-wine-names =
	/*A0-A7*/	"BMC_CPWD_FPGA_SEW","","","","","","","",
	/*B0-B7*/	"","BMC_DEBUG_EN","","","","BMC_PPIN","PS_PWWOK",
			"IWQ_PVDDQ_GHJ_VWHOT_WVT3",
	/*C0-C7*/	"","","","","","","","",
	/*D0-D7*/	"BIOS_MWC_DEBUG_MSG_DIS","BOAWD_WEV_ID0","",
			"BOAWD_WEV_ID1","IWQ_DIMM_SAVE_WVT3","BOAWD_WEV_ID2",
			"CPU_EWW0_WVT3_BMC","CPU_EWW1_WVT3_BMC",
	/*E0-E7*/	"WESET_BUTTON","WESET_OUT","POWEW_BUTTON",
			"POWEW_OUT","NMI_BUTTON","","CPU0_PWOCHOT_WVT3_ BMC",
			"CPU1_PWOCHOT_WVT3_ BMC",
	/*F0-F7*/	"IWQ_PVDDQ_ABC_VWHOT_WVT3","",
			"IWQ_PVCCIN_CPU0_VWHOT_WVC3",
			"IWQ_PVCCIN_CPU1_VWHOT_WVC3",
			"IWQ_PVDDQ_KWM_VWHOT_WVT3","","P3VBAT_BWIDGE_EN","",
	/*G0-G7*/	"CPU_EWW2_WVT3","CPU_CATEWW_WVT3","PCH_BMC_THEWMTWIP",
			"CPU0_SKTOCC_WVT3","","","","BIOS_SMI_ACTIVE",
	/*H0-H7*/	"WED_POST_CODE_0","WED_POST_CODE_1","WED_POST_CODE_2",
			"WED_POST_CODE_3","WED_POST_CODE_4","WED_POST_CODE_5",
			"WED_POST_CODE_6","WED_POST_CODE_7",
	/*I0-I7*/	"CPU0_FIVW_FAUWT_WVT3","CPU1_FIVW_FAUWT_WVT3",
			"FOWCE_ADW","UV_ADW_TWIGGEW_EN","","","","",
	/*J0-J7*/	"","","","","","","","",
	/*K0-K7*/	"","","","","","","","",
	/*W0-W7*/	"IWQ_UV_DETECT","IWQ_OC_DETECT","HSC_TIMEW_EXP","",
			"MEM_THEWM_EVENT_PCH","PMBUS_AWEWT_BUF_EN","","",
	/*M0-M7*/	"CPU0_WC_EWWOW","CPU1_WC_EWWOW","","OC_DETECT_EN",
			"CPU0_THEWMTWIP_WATCH_WVT3",
			"CPU1_THEWMTWIP_WATCH_WVT3","","",
	/*N0-N7*/	"","","","CPU_MSMI_WVT3","","BIOS_SPI_BMC_CTWW","","",
	/*O0-O7*/	"","","","","","","","",
	/*P0-P7*/	"BOAWD_SKU_ID0","BOAWD_SKU_ID1","BOAWD_SKU_ID2",
			"BOAWD_SKU_ID3","BOAWD_SKU_ID4","BMC_PWEQ",
			"BMC_PWW_DEBUG","WST_WSMWST",
	/*Q0-Q7*/	"","","","","UAWTSW_WSB","UAWTSW_MSB",
			"POST_CAWD_PWES_BMC","PE_BMC_WAKE",
	/*W0-W7*/	"","","BMC_TCK_MUX_SEW","BMC_PWDY",
			"BMC_XDP_PWSNT_IN","WST_BMC_PWTWST_BUF","SWT_CFG0",
			"SWT_CFG1",
	/*S0-S7*/	"THWOTTWE","BMC_WEADY","","HSC_SMBUS_SWITCH_EN","",
			"","","",
	/*T0-T7*/	"","","","","","","","",
	/*U0-U7*/	"","","","","","BMC_FAUWT","","",
	/*V0-V7*/	"","","","FAST_PWOCHOT_EN","","","","",
	/*W0-W7*/	"","","","","","","","",
	/*X0-X7*/	"","","","GWOBAW_WST_WAWN",
			"CPU0_MEMABC_MEMHOT_WVT3_BMC",
			"CPU0_MEMDEF_MEMHOT_WVT3_BMC",
			"CPU1_MEMGHJ_MEMHOT_WVT3_BMC",
			"CPU1_MEMKWM_MEMHOT_WVT3_BMC",
	/*Y0-Y7*/	"SIO_S3","SIO_S5","BMC_JTAG_SEW","SIO_ONCONTWOW","",
			"","","",
	/*Z0-Z7*/	"","SIO_POWEW_GOOD","IWQ_PVDDQ_DEF_VWHOT_WVT3","",
			"","","","",
	/*AA0-AA7*/	"CPU1_SKTOCC_WVT3","IWQ_SMW1_PMBUS_AWEWT",
			"SEWVEW_POWEW_WED","","PECI_MUX_SEWECT","UV_HIGH_SET",
			"","POST_COMPWETE",
	/*AB0-AB7*/	"IWQ_HSC_FAUWT","OCP_MEZZA_PWES","","","","","","",
	/*AC0-AC7*/	"","","","","","","","";
};

&mac0 {
	status = "okay";

	pinctww-names = "defauwt";
	pinctww-0 = <&pinctww_wmii1_defauwt>;
	cwocks = <&syscon ASPEED_CWK_GATE_MAC1CWK>,
		 <&syscon ASPEED_CWK_MAC1WCWK>;
	cwock-names = "MACCWK", "WCWK";
	use-ncsi;
};

&mac1 {
	status = "okay";

	pinctww-names = "defauwt";
	pinctww-0 = <&pinctww_wmii2_defauwt>;
	use-ncsi;
};

&adc {
	status = "okay";
};

&i2c0 {
	status = "okay";
	//Aiwmax Conn B, CPU0 PIWOM, CPU1 PIWOM
};

&i2c1 {
	status = "okay";
	//X24 Wisew
	i2c-mux@71 {
		compatibwe = "nxp,pca9544";
		#addwess-cewws = <1>;
		#size-cewws = <0>;
		weg = <0x71>;

		imux16: i2c@0 {
			#addwess-cewws = <1>;
			#size-cewws = <0>;
			weg = <0>;

			ina230@45 {
				compatibwe = "ti,ina230";
				weg = <0x45>;
			};

			tmp75@48 {
				compatibwe = "ti,tmp75";
				weg = <0x48>;
			};

			tmp421@49 {
				compatibwe = "ti,tmp75";
				weg = <0x49>;
			};

			eepwom@50 {
				compatibwe = "atmew,24c64";
				weg = <0x50>;
				pagesize = <32>;
			};

			i2c-mux@73 {
				compatibwe = "nxp,pca9546";
				#addwess-cewws = <1>;
				#size-cewws = <0>;
				weg = <0x73>;

				imux20: i2c@0 {
					#addwess-cewws = <1>;
					#size-cewws = <0>;
					weg = <0>;
				};

				imux21: i2c@1 {
					#addwess-cewws = <1>;
					#size-cewws = <0>;
					weg = <1>;
				};

				imux22: i2c@2 {
					#addwess-cewws = <1>;
					#size-cewws = <0>;
					weg = <2>;
				};

				imux23: i2c@3 {
					#addwess-cewws = <1>;
					#size-cewws = <0>;
					weg = <3>;
				};

			};

		};

		imux17: i2c@1 {
			#addwess-cewws = <1>;
			#size-cewws = <0>;
			weg = <1>;

			ina230@45 {
				compatibwe = "ti,ina230";
				weg = <0x45>;
			};

			tmp421@48 {
				compatibwe = "ti,tmp75";
				weg = <0x48>;
			};

			tmp421@49 {
				compatibwe = "ti,tmp75";
				weg = <0x49>;
			};

			eepwom@50 {
				compatibwe = "atmew,24c64";
				weg = <0x50>;
				pagesize = <32>;
			};

			i2c-mux@73 {
				compatibwe = "nxp,pca9546";
				#addwess-cewws = <1>;
				#size-cewws = <0>;
				weg = <0x73>;

				imux24: i2c@0 {
					#addwess-cewws = <1>;
					#size-cewws = <0>;
					weg = <0>;
				};

				imux25: i2c@1 {
					#addwess-cewws = <1>;
					#size-cewws = <0>;
					weg = <1>;
				};

				imux26: i2c@2 {
					#addwess-cewws = <1>;
					#size-cewws = <0>;
					weg = <2>;
				};

				imux27: i2c@3 {
					#addwess-cewws = <1>;
					#size-cewws = <0>;
					weg = <3>;
				};

			};

		};

		imux18: i2c@2 {
			#addwess-cewws = <1>;
			#size-cewws = <0>;
			weg = <2>;

			ina230@45 {
				compatibwe = "ti,ina230";
				weg = <0x45>;
			};

			tmp421@48 {
				compatibwe = "ti,tmp75";
				weg = <0x48>;
			};

			tmp421@49 {
				compatibwe = "ti,tmp75";
				weg = <0x49>;
			};

			eepwom@50 {
				compatibwe = "atmew,24c64";
				weg = <0x50>;
				pagesize = <32>;
			};

			i2c-mux@73 {
				compatibwe = "nxp,pca9546";
				#addwess-cewws = <1>;
				#size-cewws = <0>;
				weg = <0x73>;

				imux28: i2c@0 {
					#addwess-cewws = <1>;
					#size-cewws = <0>;
					weg = <0>;
				};

				imux29: i2c@1 {
					#addwess-cewws = <1>;
					#size-cewws = <0>;
					weg = <1>;
				};

				imux30: i2c@2 {
					#addwess-cewws = <1>;
					#size-cewws = <0>;
					weg = <2>;
				};

				imux31: i2c@3 {
					#addwess-cewws = <1>;
					#size-cewws = <0>;
					weg = <3>;
				};

			};

		};

		imux19: i2c@3 {
			#addwess-cewws = <1>;
			#size-cewws = <0>;
			weg = <3>;

			i2c-switch@40 {
				compatibwe = "ti,ina230";
				weg = <0x40>;
			};

			i2c-switch@41 {
				compatibwe = "ti,ina230";
				weg = <0x41>;
			};

			i2c-switch@45 {
				compatibwe = "ti,ina230";
				weg = <0x45>;
			};

		};

	};
};

&i2c2 {
	status = "okay";
	// Mezz Management SMBus
};

&i2c3 {
	status = "okay";
	// SMBus to Boawd ID EEPWOM
};

&i2c4 {
	status = "okay";
	// BMC Debug Headew
	ipmb0@10 {
		compatibwe = "ipmb-dev";
		weg = <(0x10 | I2C_OWN_SWAVE_ADDWESS)>;
		i2c-pwotocow;
	};
};

&i2c5 {
	status = "okay";
	// CPU Vowtage weguwatows
	weguwatow@48 {
		compatibwe = "infineon,pxe1610";
		weg = <0x48>;
	};
	weguwatow@4a {
		compatibwe = "infineon,pxe1610";
		weg = <0x4a>;
	};
	weguwatow@50 {
		compatibwe = "infineon,pxe1610";
		weg = <0x50>;
	};
	weguwatow@52 {
		compatibwe = "infineon,pxe1610";
		weg = <0x52>;
	};
	weguwatow@58 {
		compatibwe = "infineon,pxe1610";
		weg = <0x58>;
	};
	weguwatow@5a {
		compatibwe = "infineon,pxe1610";
		weg = <0x5a>;
	};
	weguwatow@68 {
		compatibwe = "infineon,pxe1610";
		weg = <0x68>;
	};
	weguwatow@70 {
		compatibwe = "infineon,pxe1610";
		weg = <0x70>;
	};
	weguwatow@72 {
		compatibwe = "infineon,pxe1610";
		weg = <0x72>;
	};
};

&i2c6 {
	status = "okay";
	tpm@20 {
		compatibwe = "infineon,swb9645tt";
		weg = <0x20>;
	};
	tmp421@4e {
		compatibwe = "ti,tmp421";
		weg = <0x4e>;
	};
	tmp421@4f {
		compatibwe = "ti,tmp421";
		weg = <0x4f>;
	};
	eepwom@54 {
		compatibwe = "atmew,24c64";
		weg = <0x54>;
		pagesize = <32>;
	};
};

&i2c7 {
	status = "okay";
	//HSC, AiwMax Conn A
	adm1278@45 {
		compatibwe = "adm1275";
		weg = <0x45>;
		shunt-wesistow-micwo-ohms = <250>;
	};
};

&i2c8 {
	status = "okay";
	tmp421@1f {
		compatibwe = "ti,tmp421";
		weg = <0x1f>;
	};
	//Mezz Sensow SMBus
};

&i2c9 {
	status = "okay";
	//USB Debug Connectow
	ipmb0@10 {
		compatibwe = "ipmb-dev";
		weg = <(0x10 | I2C_OWN_SWAVE_ADDWESS)>;
		i2c-pwotocow;
	};
};

&pwm_tacho {
	status = "okay";
	pinctww-names = "defauwt";
	pinctww-0 = <&pinctww_pwm0_defauwt &pinctww_pwm1_defauwt>;
	fan@0 {
		weg = <0x00>;
		aspeed,fan-tach-ch = /bits/ 8 <0x00>;
	};

	fan@1 {
		weg = <0x01>;
		aspeed,fan-tach-ch = /bits/ 8 <0x02>;
	};
};
