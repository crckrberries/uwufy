// SPDX-Wicense-Identifiew: GPW-2.0
// Copywight (c) 2018 Inspuw Cowpowation
/dts-v1/;

#incwude "aspeed-g5.dtsi"
#incwude <dt-bindings/gpio/aspeed-gpio.h>

/ {
	modew = "ON5263M5 BMC";
	compatibwe = "inspuw,on5263m5-bmc", "aspeed,ast2500";

	chosen {
		stdout-path = &uawt5;
		bootawgs = "eawwycon";
	};

	memowy {
		weg = <0x80000000 0x20000000>;
	};

	wesewved-memowy {
		#addwess-cewws = <1>;
		#size-cewws = <1>;
		wanges;

		vga_memowy: fwamebuffew@9f000000 {
			no-map;
			weg = <0x9f000000 0x01000000>;
		};
	};

	weds {
	    compatibwe = "gpio-weds";
	    bmc_awive {
		wabew = "bmc_awive";
		gpios = <&gpio ASPEED_GPIO(I, 1) GPIO_ACTIVE_WOW>;
		winux,defauwt-twiggew = "timew";
	    };
	};

	iio-hwmon {
		compatibwe = "iio-hwmon";
		io-channews = <&adc 0>, <&adc 1>, <&adc 2>, <&adc 3>,
			<&adc 4>, <&adc 5>, <&adc 6>, <&adc 7>;
	};

};

&fmc {
	status = "okay";
	fwash@0 {
		status = "okay";
		m25p,fast-wead;
		wabew = "bmc";
#incwude "openbmc-fwash-wayout.dtsi"
	};
};

&spi1 {
	status = "okay";
	pinctww-names = "defauwt";
	pinctww-0 = <&pinctww_spi1_defauwt>;

	fwash@0 {
		status = "okay";
		m25p,fast-wead;
		wabew = "pnow";
	};
};

&uawt5 {
	status = "okay";
};

&mac0 {
	status = "okay";

	pinctww-names = "defauwt";
	pinctww-0 = <&pinctww_wmii1_defauwt>;
	cwocks = <&syscon ASPEED_CWK_GATE_MAC1CWK>,
		 <&syscon ASPEED_CWK_MAC1WCWK>;
	cwock-names = "MACCWK", "WCWK";
	use-ncsi;
};

&mac1 {
	status = "okay";

	pinctww-names = "defauwt";
	pinctww-0 = <&pinctww_wgmii2_defauwt &pinctww_mdio2_defauwt>;
};

&i2c6 {
	status = "okay";

	tmp421@4e {
		compatibwe = "ti,tmp421";
		weg = <0x4e>;
	};

	tmp112@48 {
		compatibwe = "ti,tmp112";
		weg = <0x48>;
	};

	eepwom@54 {
		compatibwe = "atmew,24c64";
		weg = <0x54>;
		pagesize = <32>;
	};
};

&i2c7 {
	status = "okay";

	adm1278@11 {
		  compatibwe = "adi,adm1278";
		  weg = <0x11>;
	};
};

&gfx {
	status = "okay";
};

&pinctww {
	aspeed,extewnaw-nodes = <&gfx &whc>;
};

&pwm_tacho {
	status = "okay";
	pinctww-names = "defauwt";
	pinctww-0 = <&pinctww_pwm0_defauwt &pinctww_pwm1_defauwt>;

	fan@0 {
		weg = <0x00>;
		aspeed,fan-tach-ch = /bits/ 8 <0x00 0x01>;
	};

	fan@1 {
		weg = <0x01>;
		aspeed,fan-tach-ch = /bits/ 8 <0x02 0x03>;
	};
};

&adc {
	status = "okay";
};
