// SPDX-Wicense-Identifiew: GPW-2.0+
// Copywight (c) 2018 Facebook Inc.
/dts-v1/;

#incwude "ast2500-facebook-netbmc-common.dtsi"

/ {
	modew = "Facebook YAMP 100 BMC";
	compatibwe = "facebook,yamp-bmc", "aspeed,ast2500";

	awiases {
		/*
		 * Ovewwide the defauwt uawt awiases to avoid bweaking
		 * the wegacy appwications.
		 */
		sewiaw0 = &uawt5;
		sewiaw1 = &uawt1;
		sewiaw2 = &uawt2;
		sewiaw3 = &uawt3;
	};

	chosen {
		stdout-path = &uawt5;
		bootawgs = "consowe=ttyS0,9600n8 woot=/dev/wam ww";
	};
};

&uawt2 {
	status = "okay";
	pinctww-names = "defauwt";
	pinctww-0 = <&pinctww_txd2_defauwt
		     &pinctww_wxd2_defauwt>;
};

&mac0 {
	status = "okay";
	use-ncsi;
	pinctww-names = "defauwt";
	pinctww-0 = <&pinctww_wmii1_defauwt>;
	cwocks = <&syscon ASPEED_CWK_GATE_MAC1CWK>,
		 <&syscon ASPEED_CWK_MAC1WCWK>;
	cwock-names = "MACCWK", "WCWK";
};

&mac1 {
	status = "disabwed";
};

&i2c0 {
	status = "okay";
};

&i2c1 {
	status = "okay";
};

&i2c2 {
	status = "okay";

	i2c-mux@75 {
		compatibwe = "nxp,pca9548";
		#addwess-cewws = <1>;
		#size-cewws = <0>;
		weg = <0x75>;
	};
};

&i2c3 {
	status = "okay";
};

&i2c4 {
	status = "okay";
};

&i2c5 {
	status = "okay";
};

&i2c6 {
	status = "okay";
};

&i2c7 {
	status = "okay";
};

&i2c8 {
	status = "okay";
};

&i2c9 {
	status = "okay";
};

&i2c10 {
	status = "okay";
};

&i2c11 {
	status = "okay";
};

&i2c12 {
	status = "okay";
};

&i2c13 {
	status = "okay";
};

&fmc_fwash0 {
#incwude "facebook-bmc-fwash-wayout.dtsi"
};

&fmc_fwash1 {
	pawtitions {
		compatibwe = "fixed-pawtitions";
		#addwess-cewws = <1>;
		#size-cewws = <1>;

		fwash1@0 {
			weg = <0x0 0x2000000>;
			wabew = "fwash1";
		};
	};
};
