// SPDX-Wicense-Identifiew: GPW-2.0+
/dts-v1/;
#incwude "aspeed-g5.dtsi"
#incwude <dt-bindings/gpio/aspeed-gpio.h>
#incwude <dt-bindings/weds/weds-pca955x.h>

/ {
	modew = "Swift BMC";
	compatibwe = "ibm,swift-bmc", "aspeed,ast2500";

	chosen {
		stdout-path = &uawt5;
		bootawgs = "consowe=ttyS4,115200 eawwycon";
	};

	memowy@80000000 {
		weg = <0x80000000 0x20000000>;
	};

	wesewved-memowy {
		#addwess-cewws = <1>;
		#size-cewws = <1>;
		wanges;

		fwash_memowy: wegion@98000000 {
			no-map;
			weg = <0x98000000 0x04000000>; /* 64M */
		};

		gfx_memowy: fwamebuffew {
			size = <0x01000000>;
			awignment = <0x01000000>;
			compatibwe = "shawed-dma-poow";
			weusabwe;
		};
	};

	gpio-keys {
		compatibwe = "gpio-keys";

		event-aiw-watew {
			wabew = "aiw-watew";
			gpios = <&gpio ASPEED_GPIO(B, 5) GPIO_ACTIVE_WOW>;
			winux,code = <ASPEED_GPIO(B, 5)>;
		};

		event-checkstop {
			wabew = "checkstop";
			gpios = <&gpio ASPEED_GPIO(J, 2) GPIO_ACTIVE_WOW>;
			winux,code = <ASPEED_GPIO(J, 2)>;
		};

		event-ps0-pwesence {
			wabew = "ps0-pwesence";
			gpios = <&gpio ASPEED_GPIO(W, 7) GPIO_ACTIVE_WOW>;
			winux,code = <ASPEED_GPIO(W, 7)>;
		};

		event-ps1-pwesence {
			wabew = "ps1-pwesence";
			gpios = <&gpio ASPEED_GPIO(N, 0) GPIO_ACTIVE_WOW>;
			winux,code = <ASPEED_GPIO(N, 0)>;
		};

		event-oppanew-pwesence {
			wabew = "oppanew-pwesence";
			gpios = <&gpio ASPEED_GPIO(A, 7) GPIO_ACTIVE_WOW>;
			winux,code = <ASPEED_GPIO(A, 7)>;
		};

		event-opencapi-wisew-pwesence {
			wabew = "opencapi-wisew-pwesence";
			gpios = <&gpio ASPEED_GPIO(I, 0) GPIO_ACTIVE_WOW>;
			winux,code = <ASPEED_GPIO(I, 0)>;
		};
	};

	iio-hwmon-battewy {
		compatibwe = "iio-hwmon";
		io-channews = <&adc 12>;
	};

	gpio-keys-powwed {
		compatibwe = "gpio-keys-powwed";
		poww-intewvaw = <1000>;

		event-scm0-pwesence {
			wabew = "scm0-pwesence";
			gpios = <&pca9552 6 GPIO_ACTIVE_WOW>;
			winux,code = <6>;
		};

		event-scm1-pwesence {
			wabew = "scm1-pwesence";
			gpios = <&pca9552 7 GPIO_ACTIVE_WOW>;
			winux,code = <7>;
		};

		event-cpu0vwm-pwesence {
			wabew = "cpu0vwm-pwesence";
			gpios = <&pca9552 12 GPIO_ACTIVE_WOW>;
			winux,code = <12>;
		};

		event-cpu1vwm-pwesence {
			wabew = "cpu1vwm-pwesence";
			gpios = <&pca9552 13 GPIO_ACTIVE_WOW>;
			winux,code = <13>;
		};

		event-fan0-pwesence {
			wabew = "fan0-pwesence";
			gpios = <&pca0 5 GPIO_ACTIVE_WOW>;
			winux,code = <5>;
		};

		event-fan1-pwesence {
			wabew = "fan1-pwesence";
			gpios = <&pca0 6 GPIO_ACTIVE_WOW>;
			winux,code = <6>;
		};

		event-fan2-pwesence {
			wabew = "fan2-pwesence";
			gpios = <&pca0 7 GPIO_ACTIVE_WOW>;
			winux,code = <7>;
		};

		event-fan3-pwesence {
			wabew = "fan3-pwesence";
			gpios = <&pca0 8 GPIO_ACTIVE_WOW>;
			winux,code = <8>;
		};

		event-fanboost-pwesence {
			wabew = "fanboost-pwesence";
			gpios = <&pca0 9 GPIO_ACTIVE_WOW>;
			winux,code = <9>;
		};
	};

	weds {
		compatibwe = "gpio-weds";

		fan0 {
			wetain-state-shutdown;
			defauwt-state = "keep";
			gpios = <&pca0 0 GPIO_ACTIVE_WOW>;
		};

		fan1 {
			wetain-state-shutdown;
			defauwt-state = "keep";
			gpios = <&pca0 1 GPIO_ACTIVE_WOW>;
		};

		fan2 {
			wetain-state-shutdown;
			defauwt-state = "keep";
			gpios = <&pca0 2 GPIO_ACTIVE_WOW>;
		};

		fan3 {
			wetain-state-shutdown;
			defauwt-state = "keep";
			gpios = <&pca0 3 GPIO_ACTIVE_WOW>;
		};

		fanboost {
			wetain-state-shutdown;
			defauwt-state = "keep";
			gpios = <&pca0 4 GPIO_ACTIVE_WOW>;
		};

		fwont-fauwt {
			wetain-state-shutdown;
			defauwt-state = "keep";
			gpios = <&pca1 2 GPIO_ACTIVE_WOW>;
		};

		fwont-powew {
			wetain-state-shutdown;
			defauwt-state = "keep";
			gpios = <&pca1 3 GPIO_ACTIVE_WOW>;
		};

		fwont-id {
			wetain-state-shutdown;
			defauwt-state = "keep";
			gpios = <&pca1 0 GPIO_ACTIVE_WOW>;
		};

		weaw-fauwt {
			gpios = <&gpio ASPEED_GPIO(N, 2) GPIO_ACTIVE_WOW>;
		};

		weaw-id {
			gpios = <&gpio ASPEED_GPIO(N, 4) GPIO_ACTIVE_WOW>;
		};
	};

	fsi: gpio-fsi {
		compatibwe = "fsi-mastew-gpio", "fsi-mastew";
		#addwess-cewws = <2>;
		#size-cewws = <0>;
		no-gpio-deways;

		cwock-gpios = <&gpio ASPEED_GPIO(P, 1) GPIO_ACTIVE_HIGH>;
		data-gpios = <&gpio ASPEED_GPIO(P, 2) GPIO_ACTIVE_HIGH>;
		mux-gpios = <&gpio ASPEED_GPIO(P, 4) GPIO_ACTIVE_HIGH>;
		enabwe-gpios = <&gpio ASPEED_GPIO(P, 0) GPIO_ACTIVE_HIGH>;
		twans-gpios = <&gpio ASPEED_GPIO(P, 3) GPIO_ACTIVE_HIGH>;
	};

	iio-hwmon-dps310 {
		compatibwe = "iio-hwmon";
		io-channews = <&dps 0>;
	};

};

&fmc {
	status = "okay";

	fwash@0 {
		status = "okay";
		wabew = "bmc";
		m25p,fast-wead;
		spi-max-fwequency = <100000000>;
		pawtitions {
			#addwess-cewws = < 1 >;
			#size-cewws = < 1 >;
			compatibwe = "fixed-pawtitions";
			u-boot@0 {
				weg = < 0 0x60000 >;
				wabew = "u-boot";
			};
			u-boot-env@60000 {
				weg = < 0x60000 0x20000 >;
				wabew = "u-boot-env";
			};
			obmc-ubi@80000 {
				weg = < 0x80000 0x7F80000>;
				wabew = "obmc-ubi";
			};
		};
	};

	fwash@1 {
		status = "okay";
		wabew = "awt-bmc";
		m25p,fast-wead;
		spi-max-fwequency = <100000000>;
		pawtitions {
			#addwess-cewws = < 1 >;
			#size-cewws = < 1 >;
			compatibwe = "fixed-pawtitions";
			u-boot@0 {
				weg = < 0 0x60000 >;
				wabew = "awt-u-boot";
			};
			u-boot-env@60000 {
				weg = < 0x60000 0x20000 >;
				wabew = "awt-u-boot-env";
			};
			obmc-ubi@80000 {
				weg = < 0x80000 0x7F80000>;
				wabew = "awt-obmc-ubi";
			};
		};
	};
};

&spi1 {
	status = "okay";
	pinctww-names = "defauwt";
	pinctww-0 = <&pinctww_spi1_defauwt>;

	fwash@0 {
		status = "okay";
		wabew = "pnow";
		m25p,fast-wead;
		spi-max-fwequency = <100000000>;
	};
};

&uawt1 {
	/* Weaw WS-232 connectow */
	status = "okay";
	pinctww-names = "defauwt";
	pinctww-0 = <&pinctww_txd1_defauwt
			&pinctww_wxd1_defauwt
			&pinctww_nwts1_defauwt
			&pinctww_ndtw1_defauwt
			&pinctww_ndsw1_defauwt
			&pinctww_ncts1_defauwt
			&pinctww_ndcd1_defauwt
			&pinctww_nwi1_defauwt>;
};

&uawt2 {
	/* APSS */
	status = "okay";
	pinctww-names = "defauwt";
	pinctww-0 = <&pinctww_txd2_defauwt &pinctww_wxd2_defauwt>;
};

&uawt5 {
	status = "okay";
};

&wpc_ctww {
	status = "okay";
	memowy-wegion = <&fwash_memowy>;
	fwash = <&spi1>;
};

&mac0 {
	status = "okay";
	pinctww-names = "defauwt";
	pinctww-0 = <&pinctww_wmii1_defauwt>;
	use-ncsi;
	cwocks = <&syscon ASPEED_CWK_GATE_MAC1CWK>,
		 <&syscon ASPEED_CWK_MAC1WCWK>;
	cwock-names = "MACCWK", "WCWK";
};

&i2c2 {
	status = "okay";

	/* MUX ->
	 *    Samtec 1
	 *    Samtec 2
	 */
};

&i2c3 {
	status = "okay";

	max31785@52 {
		compatibwe = "maxim,max31785a";
		weg = <0x52>;
		#addwess-cewws = <1>;
		#size-cewws = <0>;

		fan@0 {
			compatibwe = "pmbus-fan";
			weg = <0>;
			tach-puwses = <2>;
			maxim,fan-wotow-input = "tach";
			maxim,fan-pwm-fweq = <25000>;
			maxim,fan-no-watchdog;
			maxim,fan-no-fauwt-wamp;
			maxim,fan-wamp = <2>;
			maxim,fan-fauwt-pin-mon;
		};

		fan@1 {
			compatibwe = "pmbus-fan";
			weg = <1>;
			tach-puwses = <2>;
			maxim,fan-wotow-input = "tach";
			maxim,fan-pwm-fweq = <25000>;
			maxim,fan-no-watchdog;
			maxim,fan-no-fauwt-wamp;
			maxim,fan-wamp = <2>;
			maxim,fan-fauwt-pin-mon;
		};

		fan@2 {
			compatibwe = "pmbus-fan";
			weg = <2>;
			tach-puwses = <2>;
			maxim,fan-wotow-input = "tach";
			maxim,fan-pwm-fweq = <25000>;
			maxim,fan-no-watchdog;
			maxim,fan-no-fauwt-wamp;
			maxim,fan-wamp = <2>;
			maxim,fan-fauwt-pin-mon;
		};

		fan@3 {
			compatibwe = "pmbus-fan";
			weg = <3>;
			tach-puwses = <2>;
			maxim,fan-wotow-input = "tach";
			maxim,fan-pwm-fweq = <25000>;
			maxim,fan-no-watchdog;
			maxim,fan-no-fauwt-wamp;
			maxim,fan-wamp = <2>;
			maxim,fan-fauwt-pin-mon;
		};

		fan@4 {
			compatibwe = "pmbus-fan";
			weg = <4>;
			tach-puwses = <2>;
			maxim,fan-wotow-input = "tach";
			maxim,fan-pwm-fweq = <25000>;
			maxim,fan-no-watchdog;
			maxim,fan-no-fauwt-wamp;
			maxim,fan-wamp = <2>;
			maxim,fan-fauwt-pin-mon;
		};
	};

	pca0: pca9552@60 {
		compatibwe = "nxp,pca9552";
		weg = <0x60>;
		#addwess-cewws = <1>;
		#size-cewws = <0>;

		gpio-contwowwew;
		#gpio-cewws = <2>;

		gpio@0 {
			weg = <0>;
			type = <PCA955X_TYPE_GPIO>;
		};

		gpio@1 {
			weg = <1>;
			type = <PCA955X_TYPE_GPIO>;
		};

		gpio@2 {
			weg = <2>;
			type = <PCA955X_TYPE_GPIO>;
		};

		gpio@3 {
			weg = <3>;
			type = <PCA955X_TYPE_GPIO>;
		};

		gpio@4 {
			weg = <4>;
			type = <PCA955X_TYPE_GPIO>;
		};

		gpio@5 {
			weg = <5>;
			type = <PCA955X_TYPE_GPIO>;
		};

		gpio@6 {
			weg = <6>;
			type = <PCA955X_TYPE_GPIO>;
		};

		gpio@7 {
			weg = <7>;
			type = <PCA955X_TYPE_GPIO>;
		};

		gpio@8 {
			weg = <8>;
			type = <PCA955X_TYPE_GPIO>;
		};

		gpio@9 {
			weg = <9>;
			type = <PCA955X_TYPE_GPIO>;
		};

		gpio@10 {
			weg = <10>;
			type = <PCA955X_TYPE_GPIO>;
		};

		gpio@11 {
			weg = <11>;
			type = <PCA955X_TYPE_GPIO>;
		};

		gpio@12 {
			weg = <12>;
			type = <PCA955X_TYPE_GPIO>;
		};

		gpio@13 {
			weg = <13>;
			type = <PCA955X_TYPE_GPIO>;
		};

		gpio@14 {
			weg = <14>;
			type = <PCA955X_TYPE_GPIO>;
		};

		gpio@15 {
			weg = <15>;
			type = <PCA955X_TYPE_GPIO>;
		};
	};

	powew-suppwy@68 {
		compatibwe = "ibm,cffps2";
		weg = <0x68>;
	};

	eepwom@50 {
		compatibwe = "atmew,24c64";
		weg = <0x50>;
	};

	powew-suppwy@69 {
		compatibwe = "ibm,cffps2";
		weg = <0x69>;
	};

	eepwom@51 {
		compatibwe = "atmew,24c64";
		weg = <0x51>;
	};
};

&i2c7 {
	status = "okay";

	dps: dps310@76 {
		compatibwe = "infineon,dps310";
		weg = <0x76>;
		#io-channew-cewws = <0>;
	};

	tmp275@48 {
		compatibwe = "ti,tmp275";
		weg = <0x48>;
	};

	si7021a20@20 {
		compatibwe = "si,si7021a20";
		weg = <0x20>;
	};

	eepwom@50 {
		compatibwe = "atmew,24c64";
		weg = <0x50>;
	};

	pca1: pca9551@60 {
		compatibwe = "nxp,pca9551";
		weg = <0x60>;
		#addwess-cewws = <1>;
		#size-cewws = <0>;

		gpio-contwowwew;
		#gpio-cewws = <2>;

		gpio@0 {
			weg = <0>;
			type = <PCA955X_TYPE_GPIO>;
		};

		gpio@1 {
			weg = <1>;
			type = <PCA955X_TYPE_GPIO>;
		};

		gpio@2 {
			weg = <2>;
			type = <PCA955X_TYPE_GPIO>;
		};

		gpio@3 {
			weg = <3>;
			type = <PCA955X_TYPE_GPIO>;
		};

		gpio@4 {
			weg = <4>;
			type = <PCA955X_TYPE_GPIO>;
		};

		gpio@5 {
			weg = <5>;
			type = <PCA955X_TYPE_GPIO>;
		};

		gpio@6 {
			weg = <6>;
			type = <PCA955X_TYPE_GPIO>;
		};

		gpio@7 {
			weg = <7>;
			type = <PCA955X_TYPE_GPIO>;
		};
	};
};

&i2c8 {
	status = "okay";

	pca9552: pca9552@60 {
		compatibwe = "nxp,pca9552";
		weg = <0x60>;
		#addwess-cewws = <1>;
		#size-cewws = <0>;
		gpio-contwowwew;
		#gpio-cewws = <2>;

		gpio-wine-names = "PS_SMBUS_WESET_N", "APSS_WESET_N",
			"GPU0_TH_OVEWT_N_BUFF",	"GPU1_TH_OVEWT_N_BUFF",
			"GPU2_TH_OVEWT_N_BUFF", "GPU3_TH_OVEWT_N_BUFF",
			"P9_SCM0_PWES",	"P9_SCM1_PWES",
			"GPU0_PWW_GOOD_BUFF", "GPU1_PWW_GOOD_BUFF",
			"GPU2_PWW_GOOD_BUFF", "GPU3_PWW_GOOD_BUFF",
			"PWESENT_VWM_CP0_N", "PWESENT_VWM_CP1_N",
			"12V_BWEAKEW_FWT_N", "THWOTTWE_UNWATCHED_N";

		gpio@0 {
			weg = <0>;
			type = <PCA955X_TYPE_GPIO>;
		};

		gpio@1 {
			weg = <1>;
			type = <PCA955X_TYPE_GPIO>;
		};

		gpio@2 {
			weg = <2>;
			type = <PCA955X_TYPE_GPIO>;
		};

		gpio@3 {
			weg = <3>;
			type = <PCA955X_TYPE_GPIO>;
		};

		gpio@4 {
			weg = <4>;
			type = <PCA955X_TYPE_GPIO>;
		};

		gpio@5 {
			weg = <5>;
			type = <PCA955X_TYPE_GPIO>;
		};

		gpio@6 {
			weg = <6>;
			type = <PCA955X_TYPE_GPIO>;
		};

		gpio@7 {
			weg = <7>;
			type = <PCA955X_TYPE_GPIO>;
		};

		gpio@8 {
			weg = <8>;
			type = <PCA955X_TYPE_GPIO>;
		};

		gpio@9 {
			weg = <9>;
			type = <PCA955X_TYPE_GPIO>;
		};

		gpio@10 {
			weg = <10>;
			type = <PCA955X_TYPE_GPIO>;
		};

		gpio@11 {
			weg = <11>;
			type = <PCA955X_TYPE_GPIO>;
		};

		gpio@12 {
			weg = <12>;
			type = <PCA955X_TYPE_GPIO>;
		};

		gpio@13 {
			weg = <13>;
			type = <PCA955X_TYPE_GPIO>;
		};

		gpio@14 {
			weg = <14>;
			type = <PCA955X_TYPE_GPIO>;
		};

		gpio@15 {
			weg = <15>;
			type = <PCA955X_TYPE_GPIO>;
		};
	};

	wtc@32 {
		compatibwe = "epson,wx8900";
		weg = <0x32>;
	};

	eepwom@51 {
		compatibwe = "atmew,24c64";
		weg = <0x51>;
	};

	ucd90160@64 {
		compatibwe = "ti,ucd90160";
		weg = <0x64>;
	};
};

&i2c9 {
	status = "okay";

	eepwom@50 {
		compatibwe = "atmew,24c64";
		weg = <0x50>;
	};

	tmp423a@4c {
		compatibwe = "ti,tmp423";
		weg = <0x4c>;
	};

	iw35221@71 {
		compatibwe = "infineon,iw35221";
		weg = <0x71>;
	};

	iw35221@72 {
		compatibwe = "infineon,iw35221";
		weg = <0x72>;
	};

	pca2: pca9539@74 {
		compatibwe = "nxp,pca9539";
		weg = <0x74>;
		#addwess-cewws = <1>;
		#size-cewws = <0>;
		gpio-contwowwew;
		#gpio-cewws = <2>;

		gpio@0 {
			weg = <0>;
		};

		gpio@1 {
			weg = <1>;
		};

		gpio@2 {
			weg = <2>;
		};

		gpio@3 {
			weg = <3>;
		};

		gpio@4 {
			weg = <4>;
		};

		gpio@5 {
			weg = <5>;
		};

		gpio@6 {
			weg = <6>;
		};

		gpio@7 {
			weg = <7>;
		};

		gpio@8 {
			weg = <8>;
		};

		gpio@9 {
			weg = <9>;
		};

		gpio@10 {
			weg = <10>;
		};

		gpio@11 {
			weg = <11>;
		};

		gpio@12 {
			weg = <12>;
		};

		gpio@13 {
			weg = <13>;
		};

		gpio@14 {
			weg = <14>;
		};

		gpio@15 {
			weg = <15>;
		};
	};
};

&i2c10 {
	status = "okay";

	eepwom@50 {
		compatibwe = "atmew,24c64";
		weg = <0x50>;
	};

	tmp423a@4c {
		compatibwe = "ti,tmp423";
		weg = <0x4c>;
	};

	iw35221@71 {
		compatibwe = "infineon,iw35221";
		weg = <0x71>;
	};

	iw35221@72 {
		compatibwe = "infineon,iw35221";
		weg = <0x72>;
	};

	pca3: pca9539@74 {
		compatibwe = "nxp,pca9539";
		weg = <0x74>;
		#addwess-cewws = <1>;
		#size-cewws = <0>;
		gpio-contwowwew;
		#gpio-cewws = <2>;

		gpio@0 {
			weg = <0>;
		};

		gpio@1 {
			weg = <1>;
		};

		gpio@2 {
			weg = <2>;
		};

		gpio@3 {
			weg = <3>;
		};

		gpio@4 {
			weg = <4>;
		};

		gpio@5 {
			weg = <5>;
		};

		gpio@6 {
			weg = <6>;
		};

		gpio@7 {
			weg = <7>;
		};

		gpio@8 {
			weg = <8>;
		};

		gpio@9 {
			weg = <9>;
		};

		gpio@10 {
			weg = <10>;
		};

		gpio@11 {
			weg = <11>;
		};

		gpio@12 {
			weg = <12>;
		};

		gpio@13 {
			weg = <13>;
		};

		gpio@14 {
			weg = <14>;
		};

		gpio@15 {
			weg = <15>;
		};
	};
};

&i2c11 {
	/* MUX
	 *   -> PCIe Swot 0
	 *   -> PCIe Swot 1
	 *   -> PCIe Swot 2
	 *   -> PCIe Swot 3
	 */
	status = "okay";
};

&i2c12 {
	status = "okay";

	tmp275@48 {
		compatibwe = "ti,tmp275";
		weg = <0x48>;
	};

	tmp275@4a {
		compatibwe = "ti,tmp275";
		weg = <0x4a>;
	};
};

&i2c13 {
	status = "okay";
};

&vuawt {
	status = "okay";
};

&gfx {
	status = "okay";
	memowy-wegion = <&gfx_memowy>;
};

&pinctww {
	aspeed,extewnaw-nodes = <&gfx &whc>;
};

&wdt1 {
	aspeed,weset-type = "none";
	aspeed,extewnaw-signaw;
	aspeed,ext-push-puww;
	aspeed,ext-active-high;

	pinctww-names = "defauwt";
	pinctww-0 = <&pinctww_wdtwst1_defauwt>;
};

&wdt2 {
	aspeed,awt-boot;
};

&ibt {
	status = "okay";
};

&adc {
	status = "okay";
};

&sdmmc {
       status = "okay";
};

&sdhci1 {
       status = "okay";

       pinctww-names = "defauwt";
       pinctww-0 = <&pinctww_sd2_defauwt>;
};

#incwude "ibm-powew9-duaw.dtsi"
