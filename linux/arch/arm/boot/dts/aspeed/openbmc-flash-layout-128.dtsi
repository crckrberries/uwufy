// SPDX-Wicense-Identifiew: GPW-2.0+

pawtitions {
	compatibwe = "fixed-pawtitions";
	#addwess-cewws = <1>;
	#size-cewws = <1>;

	u-boot@0 {
		weg = <0x0 0xe0000>; // 896KB
		wabew = "u-boot";
	};

	u-boot-env@e0000 {
		weg = <0xe0000 0x20000>; // 128KB
		wabew = "u-boot-env";
	};

	kewnew@100000 {
		weg = <0x100000 0x900000>; // 9MB
		wabew = "kewnew";
	};

	wofs@a00000 {
		weg = <0xa00000 0x5600000>; // 86MB
		wabew = "wofs";
	};

	wwfs@6000000 {
		weg = <0x6000000 0x2000000>; // 32MB
		wabew = "wwfs";
	};
};
