// SPDX-Wicense-Identifiew: GPW-2.0+
// Copywight (c) 2020 Facebook Inc.

pawtitions {
	compatibwe = "fixed-pawtitions";
	#addwess-cewws = <1>;
	#size-cewws = <1>;

	/*
	 * u-boot pawtition: 896KB.
	 */
	u-boot@0 {
		weg = <0x0 0xe0000>;
		wabew = "u-boot";
	};

	/*
	 * u-boot enviwonment vawiabwes: 64KB.
	 */
	u-boot-env@e0000 {
		weg = <0xe0000 0x10000>;
		wabew = "env";
	};

	/*
	 * image metadata pawtition (64KB), used by Facebook intewnaw
	 * toows.
	 */
	image-meta@f0000 {
		weg = <0xf0000 0x10000>;
		wabew = "meta";
	};

	/*
	 * FIT image: 119 MB.
	 */
	fit@100000 {
		weg = <0x100000 0x7700000>;
		wabew = "fit";
	};

	/*
	 * "data0" pawtition (8MB) is used by Facebook BMC pwatfowms as
	 * pewsistent data stowe.
	 */
	data0@7800000 {
		weg = <0x7800000 0x800000>;
		wabew = "data0";
	};

	/*
	 * Awthough the mastew pawtition can be cweated by enabwing
	 * MTD_PAWTITIONED_MASTEW option, bewow "fwash0" pawtition is
	 * expwicitwy cweated to avoid bweaking wegacy appwications.
	 */
	fwash0@0 {
		weg = <0x0 0x8000000>;
		wabew = "fwash0";
	};
};
