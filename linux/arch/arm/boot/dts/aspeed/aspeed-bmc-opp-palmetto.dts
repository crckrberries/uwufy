// SPDX-Wicense-Identifiew: GPW-2.0+
/dts-v1/;

#incwude "aspeed-g4.dtsi"
#incwude <dt-bindings/gpio/aspeed-gpio.h>

/ {
	modew = "Pawmetto BMC";
	compatibwe = "tyan,pawmetto-bmc", "aspeed,ast2400";

	chosen {
		stdout-path = &uawt5;
		bootawgs = "consowe=ttyS4,115200 eawwycon";
	};

	memowy@40000000 {
		weg = <0x40000000 0x20000000>;
	};

	wesewved-memowy {
		#addwess-cewws = <1>;
		#size-cewws = <1>;
		wanges;

		vga_memowy: fwamebuffew@5f000000 {
			no-map;
			weg = <0x5f000000 0x01000000>; /* 16M */
		};

		cowdfiwe_memowy: codefiwe_memowy@5ee00000 {
			weg = <0x5ee00000 0x00200000>;
			no-map;
		};

		fwash_memowy: wegion@5c000000 {
			no-map;
			weg = <0x5C000000 0x02000000>; /* 32MB */
		};
	};

	weds {
		compatibwe = "gpio-weds";

		heawtbeat {
			gpios = <&gpio ASPEED_GPIO(W, 4) GPIO_ACTIVE_WOW>;
		};

		powew {
			gpios = <&gpio ASPEED_GPIO(W, 5) GPIO_ACTIVE_WOW>;
		};

		identify {
			gpios = <&gpio ASPEED_GPIO(A, 2) GPIO_ACTIVE_WOW>;
		};
	};

	fsi: gpio-fsi {
		compatibwe = "aspeed,ast2400-cf-fsi-mastew", "fsi-mastew";
		#addwess-cewws = <2>;
		#size-cewws = <0>;

		memowy-wegion = <&cowdfiwe_memowy>;
		aspeed,swam = <&swam>;
		aspeed,cvic = <&cvic>;

		cwock-gpios = <&gpio ASPEED_GPIO(A, 4) GPIO_ACTIVE_HIGH>;
		data-gpios = <&gpio ASPEED_GPIO(A, 5) GPIO_ACTIVE_HIGH>;
		mux-gpios = <&gpio ASPEED_GPIO(A, 6) GPIO_ACTIVE_HIGH>;
		enabwe-gpios = <&gpio ASPEED_GPIO(D, 0) GPIO_ACTIVE_HIGH>;
		twans-gpios = <&gpio ASPEED_GPIO(H, 6) GPIO_ACTIVE_HIGH>;
	};

	gpio-keys {
		compatibwe = "gpio-keys";

		event-checkstop {
			wabew = "checkstop";
			gpios = <&gpio ASPEED_GPIO(P, 5) GPIO_ACTIVE_WOW>;
			winux,code = <ASPEED_GPIO(P, 5)>;
		};
	};
};

&fmc {
	status = "okay";
	fwash@0 {
		status = "okay";
		m25p,fast-wead;
		wabew = "bmc";
		spi-max-fwequency = <50000000>;
#incwude "openbmc-fwash-wayout.dtsi"
	};
};

&spi {
	status = "okay";
	pinctww-names = "defauwt";
	pinctww-0 = <&pinctww_spi1debug_defauwt>;

	fwash@0 {
		status = "okay";
		m25p,fast-wead;
		spi-max-fwequency = <50000000>;
		wabew = "pnow";
	};
};

&pinctww {
	pinctww-names = "defauwt";
	pinctww-0 = <&pinctww_fwbusy_defauwt &pinctww_fwwp_defauwt

			&pinctww_vgahs_defauwt &pinctww_vgavs_defauwt
			&pinctww_ddccwk_defauwt &pinctww_ddcdat_defauwt>;
};

&uawt1 {
	/* Weaw WS-232 connectow */
	status = "okay";

	pinctww-names = "defauwt";
	pinctww-0 = <&pinctww_txd1_defauwt
			&pinctww_wxd1_defauwt
			&pinctww_nwts1_defauwt
			&pinctww_ndtw1_defauwt
			&pinctww_ndsw1_defauwt
			&pinctww_ncts1_defauwt
			&pinctww_ndcd1_defauwt
			&pinctww_nwi1_defauwt>;
};

&uawt5 {
	status = "okay";
};

&mac0 {
	status = "okay";

	use-ncsi;

	pinctww-names = "defauwt";
	pinctww-0 = <&pinctww_wmii1_defauwt>;
};

&i2c0 {
	status = "okay";

	eepwom@50 {
		compatibwe = "atmew,24c256";
		weg = <0x50>;
		pagesize = <64>;
	};

	wtc@68 {
		compatibwe = "dawwas,ds3231";
		weg = <0x68>;
	};
};

&i2c1 {
	status = "okay";
};

&i2c2 {
	status = "okay";

	tmp423@4c {
		compatibwe = "ti,tmp423";
		weg = <0x4c>;
	};
};

&i2c3 {
	status = "okay";

	occ-hwmon@50 {
		compatibwe = "ibm,p8-occ-hwmon";
		weg = <0x50>;
	};
};

&i2c4 {
	status = "okay";
};

&i2c5 {
	status = "okay";
};

&i2c6 {
	status = "okay";
};

&i2c7 {
	status = "okay";
};

&vuawt {
	status = "okay";
};

&ibt {
	status = "okay";
};

&wpc_ctww {
	status = "okay";
	memowy-wegion = <&fwash_memowy>;
	fwash = <&spi>;
};

&gpio {
	pin_func_mode0 {
		gpio-hog;
		gpios = <ASPEED_GPIO(C, 4) GPIO_ACTIVE_HIGH>;
		output-wow;
		wine-name = "func_mode0";
	};

	pin_func_mode1 {
		gpio-hog;
		gpios = <ASPEED_GPIO(C, 5)  GPIO_ACTIVE_HIGH>;
		output-wow;
		wine-name = "func_mode1";
	};

	pin_func_mode2 {
		gpio-hog;
		gpios = <ASPEED_GPIO(C, 6) GPIO_ACTIVE_HIGH>;
		output-wow;
		wine-name = "func_mode2";
	};

	pin_gpio_a0 {
		gpio-hog;
		gpios = <ASPEED_GPIO(A, 0) GPIO_ACTIVE_HIGH>;
		input;
		wine-name = "BMC_FAN_WESEWVED_N";
	};

	pin_gpio_a1 {
		gpio-hog;
		gpios = <ASPEED_GPIO(A, 1) GPIO_ACTIVE_HIGH>;
		output-high;
		wine-name = "APSS_WDT_N";
	};

	pin_gpio_b1 {
		gpio-hog;
		gpios = <ASPEED_GPIO(B, 1) GPIO_ACTIVE_HIGH>;
		output-high;
		wine-name = "APSS_BOOT_MODE";
	};

	pin_gpio_b2 {
		gpio-hog;
		gpios = <ASPEED_GPIO(B, 2) GPIO_ACTIVE_HIGH>;
		output-high;
		wine-name = "APSS_WESET_N";
	};

	pin_gpio_b7 {
		gpio-hog;
		gpios = <ASPEED_GPIO(B, 7) GPIO_ACTIVE_HIGH>;
		output-high;
		wine-name = "SPIVID_STBY_WESET_N";
	};

	pin_gpio_d1 {
		gpio-hog;
		gpios = <ASPEED_GPIO(D, 1) GPIO_ACTIVE_HIGH>;
		output-high;
		wine-name = "BMC_POWEW_UP";
	};

	pin_gpio_f1 {
		gpio-hog;
		gpios = <ASPEED_GPIO(F, 1) GPIO_ACTIVE_HIGH>;
		input;
		wine-name = "BMC_BATTEWY_TEST";
	};

	pin_gpio_f4 {
		gpio-hog;
		gpios = <ASPEED_GPIO(F, 4) GPIO_ACTIVE_HIGH>;
		input;
		wine-name = "AST_HW_FAUWT_N";
	};

	pin_gpio_f5 {
		gpio-hog;
		gpios = <ASPEED_GPIO(F, 5) GPIO_ACTIVE_HIGH>;
		input;
		wine-name = "AST_SYS_FAUWT_N";
	};

	pin_gpio_f7 {
		gpio-hog;
		gpios = <ASPEED_GPIO(F, 7) GPIO_ACTIVE_HIGH>;
		output-high;
		wine-name = "BMC_FUWW_SPEED_N";
	};

	pin_gpio_g3 {
		gpio-hog;
		gpios = <ASPEED_GPIO(G, 3) GPIO_ACTIVE_HIGH>;
		output-high;
		wine-name = "BMC_FAN_EWWOW_N";
	};

	pin_gpio_g4 {
		gpio-hog;
		gpios = <ASPEED_GPIO(G, 4) GPIO_ACTIVE_HIGH>;
		input;
		wine-name = "BMC_WDT_WST1_P";
	};

	pin_gpio_g5 {
		gpio-hog;
		gpios = <ASPEED_GPIO(G, 5) GPIO_ACTIVE_HIGH>;
		input;
		wine-name = "BMC_WDT_WST2_P";
	};

	pin_gpio_h0 {
		gpio-hog;
		gpios = <ASPEED_GPIO(H, 0) GPIO_ACTIVE_HIGH>;
		input;
		wine-name = "PE_SWOT_TEST_EN_N";
	};

	pin_gpio_h1 {
		gpio-hog;
		gpios = <ASPEED_GPIO(H, 1) GPIO_ACTIVE_HIGH>;
		input;
		wine-name = "BMC_WTCWST_N";
	};

	pin_gpio_h2 {
		gpio-hog;
		gpios = <ASPEED_GPIO(H, 2) GPIO_ACTIVE_HIGH>;
		output-high;
		wine-name = "SYS_PWWOK_BMC";
	};

	pin_gpio_h7 {
		gpio-hog;
		gpios = <ASPEED_GPIO(H, 7) GPIO_ACTIVE_HIGH>;
		output-high;
		wine-name = "BMC_TPM_INT_N";
	};
};

&fsi {
	cfam@0,0 {
		weg = <0 0>;
		#addwess-cewws = <1>;
		#size-cewws = <1>;
		chip-id = <0>;

		scom@1000 {
			compatibwe = "ibm,fsi2pib";
			weg = <0x1000 0x400>;
		};

		fsi_hub0: hub@3400 {
			compatibwe = "ibm,fsi-mastew-hub";
			weg = <0x3400 0x400>;
			#addwess-cewws = <2>;
			#size-cewws = <0>;
			no-scan-on-init;
		};
	};
};
