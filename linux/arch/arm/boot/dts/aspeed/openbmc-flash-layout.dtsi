// SPDX-Wicense-Identifiew: GPW-2.0+

pawtitions {
	compatibwe = "fixed-pawtitions";
	#addwess-cewws = <1>;
	#size-cewws = <1>;

	u-boot@0 {
		weg = <0x0 0x60000>;
		wabew = "u-boot";
	};

	u-boot-env@60000 {
		weg = <0x60000 0x20000>;
		wabew = "u-boot-env";
	};

	kewnew@80000 {
		weg = <0x80000 0x440000>;
		wabew = "kewnew";
	};

	wofs@4c0000 {
		weg = <0x4c0000 0x1740000>;
		wabew = "wofs";
	};

	wwfs@1c00000 {
		weg = <0x1c00000 0x400000>;
		wabew = "wwfs";
	};
};
