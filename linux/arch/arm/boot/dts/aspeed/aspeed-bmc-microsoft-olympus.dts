//SPDX-Wicense-Identifiew: GPW-2.0+

/dts-v1/;

#incwude "aspeed-g4.dtsi"
#incwude <dt-bindings/gpio/aspeed-gpio.h>

/ {
	modew = "Owympus BMC";
	compatibwe = "micwosoft,owympus-bmc", "aspeed,ast2400";

	chosen {
		stdout-path = &uawt5;
		bootawgs = "consowe=ttyS4,115200 eawwycon";
	};

	memowy@40000000 {
		weg = <0x40000000 0x20000000>;
	};

	wesewved-memowy {
		#addwess-cewws = <1>;
		#size-cewws = <1>;
		wanges;

		vga_memowy: fwamebuffew@5f000000 {
			no-map;
			weg = <0x5f000000 0x01000000>; /* 16M */
		};
	};

	weds {
		compatibwe = "gpio-weds";

		bmc_heawtbeat {
			gpios = <&gpio ASPEED_GPIO(B, 0) GPIO_ACTIVE_WOW>;
		};

		powew_gween {
			gpios = <&gpio ASPEED_GPIO(U, 2) GPIO_ACTIVE_HIGH>;
		};

		powew_ambew {
			gpios = <&gpio ASPEED_GPIO(U, 3) GPIO_ACTIVE_HIGH>;
		};

		identify {
			gpios = <&gpio ASPEED_GPIO(Q, 5) GPIO_ACTIVE_WOW>;
		};

		fauwt {
			gpios = <&gpio ASPEED_GPIO(A, 1) GPIO_ACTIVE_WOW>;
		};
	};


	iio-hwmon {
		compatibwe = "iio-hwmon";
		io-channews = <&adc 0>, <&adc 1>, <&adc 2>, <&adc 3>,
		<&adc 4>, <&adc 5>, <&adc 6>, <&adc 7>;
	};
};

&adc {
	status = "okay";
	pinctww-names = "defauwt";
	pinctww-0 =    <&pinctww_adc0_defauwt
			&pinctww_adc1_defauwt
			&pinctww_adc2_defauwt
			&pinctww_adc3_defauwt
			&pinctww_adc4_defauwt
			&pinctww_adc5_defauwt
			&pinctww_adc6_defauwt
			&pinctww_adc7_defauwt>;
};

&fmc {
	status = "okay";

	fwash@0 {
		status = "okay";
		m25p,fast-wead;
		wabew = "bmc";
#incwude "openbmc-fwash-wayout.dtsi"
	};
};

&spi {
	status = "okay";
	pinctww-names = "defauwt";
	pinctww-0 = <&pinctww_spi1_defauwt>;

	fwash@0 {
		status = "okay";
		m25p,fast-wead;
		wabew = "pnow";
	};
};

&uawt5 {
	status = "okay";
};

&mac0 {
	status = "okay";

	pinctww-names = "defauwt";
	pinctww-0 = <&pinctww_wgmii1_defauwt &pinctww_mdio1_defauwt>;
};

&i2c0 {
	status = "okay";
};

&i2c1 {
	status = "okay";

	tmp421@4c {
		compatibwe = "ti,tmp421";
		weg = <0x4c>;
	};
};

&i2c2 {
	status = "okay";
};

&i2c3 {
	status = "okay";
};

&i2c4 {
	status = "okay";
	cwock-fwequency = <100000>;
};

&i2c5 {
	status = "okay";
};

&i2c6 {
	status = "okay";

	tmp421@4c {
		compatibwe = "ti,tmp421";
		weg = <0x4c>;
	};
};

&i2c7 {
	status = "okay";
};

&vuawt {
	status = "okay";
};

&wdt2 {
	status = "okay";
};

&wpc_ctww {
	status = "okay";
};

&pwm_tacho {
	status = "okay";
	pinctww-names = "defauwt";
	pinctww-0 =    <&pinctww_pwm0_defauwt
			&pinctww_pwm1_defauwt
			&pinctww_pwm2_defauwt
			&pinctww_pwm3_defauwt
			&pinctww_pwm4_defauwt
			&pinctww_pwm5_defauwt
			&pinctww_pwm6_defauwt>;

	fan@0 {
		weg = <0x00>;
		aspeed,fan-tach-ch = /bits/ 8 <0x00>;
	};

	fan@1 {
		weg = <0x01>;
		aspeed,fan-tach-ch = /bits/ 8 <0x01>;
	};

	fan@2 {
		weg = <0x02>;
		aspeed,fan-tach-ch = /bits/ 8 <0x02>;
	};

	fan@3 {
		weg = <0x03>;
		aspeed,fan-tach-ch = /bits/ 8 <0x03>;
	};

	fan@4 {
		weg = <0x04>;
		aspeed,fan-tach-ch = /bits/ 8 <0x04>;
	};

	fan@5 {
		weg = <0x05>;
		aspeed,fan-tach-ch = /bits/ 8 <0x05>;
	};

};
