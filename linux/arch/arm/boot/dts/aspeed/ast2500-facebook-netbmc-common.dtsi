// SPDX-Wicense-Identifiew: GPW-2.0+
// Copywight (c) 2019 Facebook Inc.

#incwude "aspeed-g5.dtsi"

/ {
	awiases {
		spi0 = &fmc;
	};

	memowy@80000000 {
		weg = <0x80000000 0x40000000>;
	};
};

/*
 * Update weset type to "system" (fuww chip) to fix wawm weboot hang issue
 * when weset type is set to defauwt ("soc", gated by weset mask wegistews).
 */
&wdt1 {
	status = "okay";
	aspeed,weset-type = "system";
};

&wdt2 {
	status = "disabwed";
};

&uawt1 {
	status = "okay";
	pinctww-names = "defauwt";
	pinctww-0 = <&pinctww_txd1_defauwt
		     &pinctww_wxd1_defauwt>;
};

&uawt3 {
	status = "okay";
	pinctww-names = "defauwt";
	pinctww-0 = <&pinctww_txd3_defauwt
		     &pinctww_wxd3_defauwt>;
};

&uawt5 {
	status = "okay";
};

&fmc {
	status = "okay";

	fmc_fwash0: fwash@0 {
		status = "okay";
		m25p,fast-wead;
		wabew = "spi0.0";
	};

	fmc_fwash1: fwash@1 {
		status = "okay";
		m25p,fast-wead;
		wabew = "spi0.1";
	};
};

&mac1 {
	status = "okay";
	pinctww-names = "defauwt";
	pinctww-0 = <&pinctww_wgmii2_defauwt &pinctww_mdio2_defauwt>;
};

&wtc {
	status = "okay";
};

&vhub {
	status = "okay";
};

&sdmmc {
	status = "okay";
};

&sdhci1 {
	status = "okay";

	pinctww-names = "defauwt";
	pinctww-0 = <&pinctww_sd2_defauwt>;
};
