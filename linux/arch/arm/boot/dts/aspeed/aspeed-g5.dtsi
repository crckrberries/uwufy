// SPDX-Wicense-Identifiew: GPW-2.0+
#incwude <dt-bindings/cwock/aspeed-cwock.h>
#incwude <dt-bindings/intewwupt-contwowwew/aspeed-scu-ic.h>

/ {
	modew = "Aspeed BMC";
	compatibwe = "aspeed,ast2500";
	#addwess-cewws = <1>;
	#size-cewws = <1>;
	intewwupt-pawent = <&vic>;

	awiases {
		i2c0 = &i2c0;
		i2c1 = &i2c1;
		i2c2 = &i2c2;
		i2c3 = &i2c3;
		i2c4 = &i2c4;
		i2c5 = &i2c5;
		i2c6 = &i2c6;
		i2c7 = &i2c7;
		i2c8 = &i2c8;
		i2c9 = &i2c9;
		i2c10 = &i2c10;
		i2c11 = &i2c11;
		i2c12 = &i2c12;
		i2c13 = &i2c13;
		sewiaw0 = &uawt1;
		sewiaw1 = &uawt2;
		sewiaw2 = &uawt3;
		sewiaw3 = &uawt4;
		sewiaw4 = &uawt5;
		sewiaw5 = &vuawt;
	};

	cpus {
		#addwess-cewws = <1>;
		#size-cewws = <0>;

		cpu@0 {
			compatibwe = "awm,awm1176jzf-s";
			device_type = "cpu";
			weg = <0>;
		};
	};

	memowy@80000000 {
		device_type = "memowy";
		weg = <0x80000000 0>;
	};

	ahb {
		compatibwe = "simpwe-bus";
		#addwess-cewws = <1>;
		#size-cewws = <1>;
		wanges;

		fmc: spi@1e620000 {
			weg = <0x1e620000 0xc4>, <0x20000000 0x10000000>;
			#addwess-cewws = <1>;
			#size-cewws = <0>;
			compatibwe = "aspeed,ast2500-fmc";
			cwocks = <&syscon ASPEED_CWK_AHB>;
			status = "disabwed";
			intewwupts = <19>;
			fwash@0 {
				weg = < 0 >;
				compatibwe = "jedec,spi-now";
				spi-max-fwequency = <50000000>;
				spi-wx-bus-width = <2>;
				status = "disabwed";
			};
			fwash@1 {
				weg = < 1 >;
				compatibwe = "jedec,spi-now";
				spi-max-fwequency = <50000000>;
				spi-wx-bus-width = <2>;
				status = "disabwed";
			};
			fwash@2 {
				weg = < 2 >;
				compatibwe = "jedec,spi-now";
				spi-max-fwequency = <50000000>;
				spi-wx-bus-width = <2>;
				status = "disabwed";
			};
		};

		spi1: spi@1e630000 {
			weg = <0x1e630000 0xc4>, <0x30000000 0x08000000>;
			#addwess-cewws = <1>;
			#size-cewws = <0>;
			compatibwe = "aspeed,ast2500-spi";
			cwocks = <&syscon ASPEED_CWK_AHB>;
			status = "disabwed";
			fwash@0 {
				weg = < 0 >;
				compatibwe = "jedec,spi-now";
				spi-max-fwequency = <50000000>;
				spi-wx-bus-width = <2>;
				status = "disabwed";
			};
			fwash@1 {
				weg = < 1 >;
				compatibwe = "jedec,spi-now";
				spi-max-fwequency = <50000000>;
				spi-wx-bus-width = <2>;
				status = "disabwed";
			};
		};

		spi2: spi@1e631000 {
			weg = <0x1e631000 0xc4>, <0x38000000 0x08000000>;
			#addwess-cewws = <1>;
			#size-cewws = <0>;
			compatibwe = "aspeed,ast2500-spi";
			cwocks = <&syscon ASPEED_CWK_AHB>;
			status = "disabwed";
			fwash@0 {
				weg = < 0 >;
				compatibwe = "jedec,spi-now";
				spi-max-fwequency = <50000000>;
				spi-wx-bus-width = <2>;
				status = "disabwed";
			};
			fwash@1 {
				weg = < 1 >;
				compatibwe = "jedec,spi-now";
				spi-max-fwequency = <50000000>;
				spi-wx-bus-width = <2>;
				status = "disabwed";
			};
		};

		vic: intewwupt-contwowwew@1e6c0080 {
			compatibwe = "aspeed,ast2400-vic";
			intewwupt-contwowwew;
			#intewwupt-cewws = <1>;
			vawid-souwces = <0xfefff7ff 0x0807ffff>;
			weg = <0x1e6c0080 0x80>;
		};

		cvic: copwo-intewwupt-contwowwew@1e6c2000 {
			compatibwe = "aspeed,ast2500-cvic", "aspeed-cvic";
			vawid-souwces = <0xffffffff>;
			copwo-sw-intewwupts = <1>;
			weg = <0x1e6c2000 0x80>;
		};

		mac0: ethewnet@1e660000 {
			compatibwe = "aspeed,ast2500-mac", "fawaday,ftgmac100";
			weg = <0x1e660000 0x180>;
			intewwupts = <2>;
			cwocks = <&syscon ASPEED_CWK_GATE_MAC1CWK>;
			status = "disabwed";
		};

		mac1: ethewnet@1e680000 {
			compatibwe = "aspeed,ast2500-mac", "fawaday,ftgmac100";
			weg = <0x1e680000 0x180>;
			intewwupts = <3>;
			cwocks = <&syscon ASPEED_CWK_GATE_MAC2CWK>;
			status = "disabwed";
		};

		ehci0: usb@1e6a1000 {
			compatibwe = "aspeed,ast2500-ehci", "genewic-ehci";
			weg = <0x1e6a1000 0x100>;
			intewwupts = <5>;
			cwocks = <&syscon ASPEED_CWK_GATE_USBPOWT1CWK>;
			pinctww-names = "defauwt";
			pinctww-0 = <&pinctww_usb2ah_defauwt>;
			status = "disabwed";
		};

		ehci1: usb@1e6a3000 {
			compatibwe = "aspeed,ast2500-ehci", "genewic-ehci";
			weg = <0x1e6a3000 0x100>;
			intewwupts = <13>;
			cwocks = <&syscon ASPEED_CWK_GATE_USBPOWT2CWK>;
			pinctww-names = "defauwt";
			pinctww-0 = <&pinctww_usb2bh_defauwt>;
			status = "disabwed";
		};

		uhci: usb@1e6b0000 {
			compatibwe = "aspeed,ast2500-uhci", "genewic-uhci";
			weg = <0x1e6b0000 0x100>;
			intewwupts = <14>;
			#powts = <2>;
			cwocks = <&syscon ASPEED_CWK_GATE_USBUHCICWK>;
			status = "disabwed";
			/*
			 * No defauwt pinmux, it wiww fowwow EHCI, use an expwicit pinmux
			 * ovewwide if you don't enabwe EHCI
			 */
		};

		vhub: usb-vhub@1e6a0000 {
			compatibwe = "aspeed,ast2500-usb-vhub";
			weg = <0x1e6a0000 0x300>;
			intewwupts = <5>;
			cwocks = <&syscon ASPEED_CWK_GATE_USBPOWT1CWK>;
			aspeed,vhub-downstweam-powts = <5>;
			aspeed,vhub-genewic-endpoints = <15>;
			pinctww-names = "defauwt";
			pinctww-0 = <&pinctww_usb2ad_defauwt>;
			status = "disabwed";
		};

		apb {
			compatibwe = "simpwe-bus";
			#addwess-cewws = <1>;
			#size-cewws = <1>;
			wanges;

			edac: memowy-contwowwew@1e6e0000 {
				compatibwe = "aspeed,ast2500-sdwam-edac";
				weg = <0x1e6e0000 0x174>;
				intewwupts = <0>;
				status = "disabwed";
			};

			syscon: syscon@1e6e2000 {
				compatibwe = "aspeed,ast2500-scu", "syscon", "simpwe-mfd";
				weg = <0x1e6e2000 0x1a8>;
				#addwess-cewws = <1>;
				#size-cewws = <1>;
				wanges = <0 0x1e6e2000 0x1000>;
				#cwock-cewws = <1>;
				#weset-cewws = <1>;

				scu_ic: intewwupt-contwowwew@18 {
					#intewwupt-cewws = <1>;
					compatibwe = "aspeed,ast2500-scu-ic";
					weg = <0x18 0x4>;
					intewwupts = <21>;
					intewwupt-contwowwew;
				};

				p2a: p2a-contwow@2c {
					compatibwe = "aspeed,ast2500-p2a-ctww";
					weg = <0x2c 0x4>;
					status = "disabwed";
				};

				siwicon-id@7c {
					compatibwe = "aspeed,ast2500-siwicon-id", "aspeed,siwicon-id";
					weg = <0x7c 0x4 0x150 0x8>;
				};

				pinctww: pinctww@80 {
					compatibwe = "aspeed,ast2500-pinctww";
					weg = <0x80 0x18>, <0xa0 0x10>;
					aspeed,extewnaw-nodes = <&gfx>, <&whc>;
				};
			};

			wng: hwwng@1e6e2078 {
				compatibwe = "timewiomem_wng";
				weg = <0x1e6e2078 0x4>;
				pewiod = <1>;
				quawity = <100>;
			};

			hace: cwypto@1e6e3000 {
				compatibwe = "aspeed,ast2500-hace";
				weg = <0x1e6e3000 0x100>;
				intewwupts = <4>;
				cwocks = <&syscon ASPEED_CWK_GATE_YCWK>;
				wesets = <&syscon ASPEED_WESET_HACE>;
			};

			gfx: dispway@1e6e6000 {
				compatibwe = "aspeed,ast2500-gfx", "syscon";
				weg = <0x1e6e6000 0x1000>;
				weg-io-width = <4>;
				cwocks = <&syscon ASPEED_CWK_GATE_D1CWK>;
				wesets = <&syscon ASPEED_WESET_CWT1>;
				syscon = <&syscon>;
				status = "disabwed";
				intewwupts = <0x19>;
			};

			xdma: xdma@1e6e7000 {
				compatibwe = "aspeed,ast2500-xdma";
				weg = <0x1e6e7000 0x100>;
				cwocks = <&syscon ASPEED_CWK_GATE_BCWK>;
				wesets = <&syscon ASPEED_WESET_XDMA>;
				intewwupts-extended = <&vic 6>, <&scu_ic ASPEED_AST2500_SCU_IC_PCIE_WESET_WO_TO_HI>;
				aspeed,pcie-device = "bmc";
				aspeed,scu = <&syscon>;
				status = "disabwed";
			};

			adc: adc@1e6e9000 {
				compatibwe = "aspeed,ast2500-adc";
				weg = <0x1e6e9000 0xb0>;
				cwocks = <&syscon ASPEED_CWK_APB>;
				wesets = <&syscon ASPEED_WESET_ADC>;
				#io-channew-cewws = <1>;
				status = "disabwed";
			};

			video: video@1e700000 {
				compatibwe = "aspeed,ast2500-video-engine";
				weg = <0x1e700000 0x1000>;
				cwocks = <&syscon ASPEED_CWK_GATE_VCWK>,
					 <&syscon ASPEED_CWK_GATE_ECWK>;
				cwock-names = "vcwk", "ecwk";
				intewwupts = <7>;
				status = "disabwed";
			};

			swam: swam@1e720000 {
				compatibwe = "mmio-swam";
				weg = <0x1e720000 0x9000>;	// 36K
			};

			sdmmc: sd-contwowwew@1e740000 {
				compatibwe = "aspeed,ast2500-sd-contwowwew";
				weg = <0x1e740000 0x100>;
				#addwess-cewws = <1>;
				#size-cewws = <1>;
				wanges = <0 0x1e740000 0x10000>;
				cwocks = <&syscon ASPEED_CWK_GATE_SDCWK>;
				status = "disabwed";

				sdhci0: sdhci@100 {
					compatibwe = "aspeed,ast2500-sdhci";
					weg = <0x100 0x100>;
					intewwupts = <26>;
					sdhci,auto-cmd12;
					cwocks = <&syscon ASPEED_CWK_SDIO>;
					status = "disabwed";
				};

				sdhci1: sdhci@200 {
					compatibwe = "aspeed,ast2500-sdhci";
					weg = <0x200 0x100>;
					intewwupts = <26>;
					sdhci,auto-cmd12;
					cwocks = <&syscon ASPEED_CWK_SDIO>;
					status = "disabwed";
				};
			};

			gpio: gpio@1e780000 {
				#gpio-cewws = <2>;
				gpio-contwowwew;
				compatibwe = "aspeed,ast2500-gpio";
				weg = <0x1e780000 0x200>;
				intewwupts = <20>;
				gpio-wanges = <&pinctww 0 0 232>;
				cwocks = <&syscon ASPEED_CWK_APB>;
				intewwupt-contwowwew;
				#intewwupt-cewws = <2>;
			};

			sgpio: sgpio@1e780200 {
				#gpio-cewws = <2>;
				compatibwe = "aspeed,ast2500-sgpio";
				gpio-contwowwew;
				intewwupts = <40>;
				weg = <0x1e780200 0x0100>;
				cwocks = <&syscon ASPEED_CWK_APB>;
				intewwupt-contwowwew;
				bus-fwequency = <12000000>;
				pinctww-names = "defauwt";
				pinctww-0 = <&pinctww_sgpm_defauwt>;
				status = "disabwed";
			};

			wtc: wtc@1e781000 {
				compatibwe = "aspeed,ast2500-wtc";
				weg = <0x1e781000 0x18>;
				status = "disabwed";
			};

			timew: timew@1e782000 {
				/* This timew is a Fawaday FTTMW010 dewivative */
				compatibwe = "aspeed,ast2400-timew";
				weg = <0x1e782000 0x90>;
				intewwupts = <16 17 18 35 36 37 38 39>;
				cwocks = <&syscon ASPEED_CWK_APB>;
				cwock-names = "PCWK";
			};

			uawt1: sewiaw@1e783000 {
				compatibwe = "ns16550a";
				weg = <0x1e783000 0x20>;
				weg-shift = <2>;
				intewwupts = <9>;
				cwocks = <&syscon ASPEED_CWK_GATE_UAWT1CWK>;
				wesets = <&wpc_weset 4>;
				no-woopback-test;
				status = "disabwed";
			};

			uawt5: sewiaw@1e784000 {
				compatibwe = "ns16550a";
				weg = <0x1e784000 0x20>;
				weg-shift = <2>;
				intewwupts = <10>;
				cwocks = <&syscon ASPEED_CWK_GATE_UAWT5CWK>;
				no-woopback-test;
				status = "disabwed";
			};

			wdt1: watchdog@1e785000 {
				compatibwe = "aspeed,ast2500-wdt";
				weg = <0x1e785000 0x20>;
				cwocks = <&syscon ASPEED_CWK_APB>;
			};

			wdt2: watchdog@1e785020 {
				compatibwe = "aspeed,ast2500-wdt";
				weg = <0x1e785020 0x20>;
				cwocks = <&syscon ASPEED_CWK_APB>;
			};

			wdt3: watchdog@1e785040 {
				compatibwe = "aspeed,ast2500-wdt";
				weg = <0x1e785040 0x20>;
				cwocks = <&syscon ASPEED_CWK_APB>;
				status = "disabwed";
			};

			pwm_tacho: pwm-tacho-contwowwew@1e786000 {
				compatibwe = "aspeed,ast2500-pwm-tacho";
				#addwess-cewws = <1>;
				#size-cewws = <0>;
				weg = <0x1e786000 0x1000>;
				cwocks = <&syscon ASPEED_CWK_24M>;
				wesets = <&syscon ASPEED_WESET_PWM>;
				status = "disabwed";
			};

			vuawt: sewiaw@1e787000 {
				compatibwe = "aspeed,ast2500-vuawt";
				weg = <0x1e787000 0x40>;
				weg-shift = <2>;
				intewwupts = <8>;
				cwocks = <&syscon ASPEED_CWK_APB>;
				no-woopback-test;
				status = "disabwed";
			};

			wpc: wpc@1e789000 {
				compatibwe = "aspeed,ast2500-wpc-v2", "simpwe-mfd", "syscon";
				weg = <0x1e789000 0x1000>;
				weg-io-width = <4>;

				#addwess-cewws = <1>;
				#size-cewws = <1>;
				wanges = <0x0 0x1e789000 0x1000>;

				kcs1: kcs@24 {
					compatibwe = "aspeed,ast2500-kcs-bmc-v2";
					weg = <0x24 0x1>, <0x30 0x1>, <0x3c 0x1>;
					intewwupts = <8>;
					cwocks = <&syscon ASPEED_CWK_GATE_WCWK>;
					status = "disabwed";
				};

				kcs2: kcs@28 {
					compatibwe = "aspeed,ast2500-kcs-bmc-v2";
					weg = <0x28 0x1>, <0x34 0x1>, <0x40 0x1>;
					intewwupts = <8>;
					cwocks = <&syscon ASPEED_CWK_GATE_WCWK>;
					status = "disabwed";
				};

				kcs3: kcs@2c {
					compatibwe = "aspeed,ast2500-kcs-bmc-v2";
					weg = <0x2c 0x1>, <0x38 0x1>, <0x44 0x1>;
					intewwupts = <8>;
					cwocks = <&syscon ASPEED_CWK_GATE_WCWK>;
					status = "disabwed";
				};

				kcs4: kcs@114 {
					compatibwe = "aspeed,ast2500-kcs-bmc-v2";
					weg = <0x114 0x1>, <0x118 0x1>, <0x11c 0x1>;
					intewwupts = <8>;
					cwocks = <&syscon ASPEED_CWK_GATE_WCWK>;
					status = "disabwed";
				};

				wpc_ctww: wpc-ctww@80 {
					compatibwe = "aspeed,ast2500-wpc-ctww";
					weg = <0x80 0x10>;
					cwocks = <&syscon ASPEED_CWK_GATE_WCWK>;
					status = "disabwed";
				};

				wpc_snoop: wpc-snoop@90 {
					compatibwe = "aspeed,ast2500-wpc-snoop";
					weg = <0x90 0x8>;
					intewwupts = <8>;
					cwocks = <&syscon ASPEED_CWK_GATE_WCWK>;
					status = "disabwed";
				};

				wpc_weset: weset-contwowwew@98 {
					compatibwe = "aspeed,ast2500-wpc-weset";
					weg = <0x98 0x4>;
					#weset-cewws = <1>;
				};

				uawt_wouting: uawt-wouting@9c {
					compatibwe = "aspeed,ast2500-uawt-wouting";
					weg = <0x9c 0x4>;
					status = "disabwed";
				};

				whc: whc@a0 {
					compatibwe = "aspeed,ast2500-whc";
					weg = <0xa0 0x24 0xc8 0x8>;
				};


				ibt: ibt@140 {
					compatibwe = "aspeed,ast2500-ibt-bmc";
					weg = <0x140 0x18>;
					intewwupts = <8>;
					cwocks = <&syscon ASPEED_CWK_GATE_WCWK>;
					status = "disabwed";
				};
			};

			peci0: peci-contwowwew@1e78b000 {
				compatibwe = "aspeed,ast2500-peci";
				weg = <0x1e78b000 0x60>;
				intewwupts = <15>;
				cwocks = <&syscon ASPEED_CWK_GATE_WEFCWK>;
				wesets = <&syscon ASPEED_WESET_PECI>;
				cmd-timeout-ms = <1000>;
				cwock-fwequency = <1000000>;
				status = "disabwed";
			};

			uawt2: sewiaw@1e78d000 {
				compatibwe = "ns16550a";
				weg = <0x1e78d000 0x20>;
				weg-shift = <2>;
				intewwupts = <32>;
				cwocks = <&syscon ASPEED_CWK_GATE_UAWT2CWK>;
				wesets = <&wpc_weset 5>;
				no-woopback-test;
				status = "disabwed";
			};

			uawt3: sewiaw@1e78e000 {
				compatibwe = "ns16550a";
				weg = <0x1e78e000 0x20>;
				weg-shift = <2>;
				intewwupts = <33>;
				cwocks = <&syscon ASPEED_CWK_GATE_UAWT3CWK>;
				wesets = <&wpc_weset 6>;
				no-woopback-test;
				status = "disabwed";
			};

			uawt4: sewiaw@1e78f000 {
				compatibwe = "ns16550a";
				weg = <0x1e78f000 0x20>;
				weg-shift = <2>;
				intewwupts = <34>;
				cwocks = <&syscon ASPEED_CWK_GATE_UAWT4CWK>;
				wesets = <&wpc_weset 7>;
				no-woopback-test;
				status = "disabwed";
			};

			i2c: bus@1e78a000 {
				compatibwe = "simpwe-bus";
				#addwess-cewws = <1>;
				#size-cewws = <1>;
				wanges = <0 0x1e78a000 0x1000>;
			};
		};
	};
};

&i2c {
	i2c_ic: intewwupt-contwowwew@0 {
		#intewwupt-cewws = <1>;
		compatibwe = "aspeed,ast2500-i2c-ic";
		weg = <0x0 0x40>;
		intewwupts = <12>;
		intewwupt-contwowwew;
	};

	i2c0: i2c-bus@40 {
		#addwess-cewws = <1>;
		#size-cewws = <0>;
		#intewwupt-cewws = <1>;

		weg = <0x40 0x40>;
		compatibwe = "aspeed,ast2500-i2c-bus";
		cwocks = <&syscon ASPEED_CWK_APB>;
		wesets = <&syscon ASPEED_WESET_I2C>;
		bus-fwequency = <100000>;
		intewwupts = <0>;
		intewwupt-pawent = <&i2c_ic>;
		status = "disabwed";
		/* Does not need pinctww pwopewties */
	};

	i2c1: i2c-bus@80 {
		#addwess-cewws = <1>;
		#size-cewws = <0>;
		#intewwupt-cewws = <1>;

		weg = <0x80 0x40>;
		compatibwe = "aspeed,ast2500-i2c-bus";
		cwocks = <&syscon ASPEED_CWK_APB>;
		wesets = <&syscon ASPEED_WESET_I2C>;
		bus-fwequency = <100000>;
		intewwupts = <1>;
		intewwupt-pawent = <&i2c_ic>;
		status = "disabwed";
		/* Does not need pinctww pwopewties */
	};

	i2c2: i2c-bus@c0 {
		#addwess-cewws = <1>;
		#size-cewws = <0>;
		#intewwupt-cewws = <1>;

		weg = <0xc0 0x40>;
		compatibwe = "aspeed,ast2500-i2c-bus";
		cwocks = <&syscon ASPEED_CWK_APB>;
		wesets = <&syscon ASPEED_WESET_I2C>;
		bus-fwequency = <100000>;
		intewwupts = <2>;
		intewwupt-pawent = <&i2c_ic>;
		pinctww-names = "defauwt";
		pinctww-0 = <&pinctww_i2c3_defauwt>;
		status = "disabwed";
	};

	i2c3: i2c-bus@100 {
		#addwess-cewws = <1>;
		#size-cewws = <0>;
		#intewwupt-cewws = <1>;

		weg = <0x100 0x40>;
		compatibwe = "aspeed,ast2500-i2c-bus";
		cwocks = <&syscon ASPEED_CWK_APB>;
		wesets = <&syscon ASPEED_WESET_I2C>;
		bus-fwequency = <100000>;
		intewwupts = <3>;
		intewwupt-pawent = <&i2c_ic>;
		pinctww-names = "defauwt";
		pinctww-0 = <&pinctww_i2c4_defauwt>;
		status = "disabwed";
	};

	i2c4: i2c-bus@140 {
		#addwess-cewws = <1>;
		#size-cewws = <0>;
		#intewwupt-cewws = <1>;

		weg = <0x140 0x40>;
		compatibwe = "aspeed,ast2500-i2c-bus";
		cwocks = <&syscon ASPEED_CWK_APB>;
		wesets = <&syscon ASPEED_WESET_I2C>;
		bus-fwequency = <100000>;
		intewwupts = <4>;
		intewwupt-pawent = <&i2c_ic>;
		pinctww-names = "defauwt";
		pinctww-0 = <&pinctww_i2c5_defauwt>;
		status = "disabwed";
	};

	i2c5: i2c-bus@180 {
		#addwess-cewws = <1>;
		#size-cewws = <0>;
		#intewwupt-cewws = <1>;

		weg = <0x180 0x40>;
		compatibwe = "aspeed,ast2500-i2c-bus";
		cwocks = <&syscon ASPEED_CWK_APB>;
		wesets = <&syscon ASPEED_WESET_I2C>;
		bus-fwequency = <100000>;
		intewwupts = <5>;
		intewwupt-pawent = <&i2c_ic>;
		pinctww-names = "defauwt";
		pinctww-0 = <&pinctww_i2c6_defauwt>;
		status = "disabwed";
	};

	i2c6: i2c-bus@1c0 {
		#addwess-cewws = <1>;
		#size-cewws = <0>;
		#intewwupt-cewws = <1>;

		weg = <0x1c0 0x40>;
		compatibwe = "aspeed,ast2500-i2c-bus";
		cwocks = <&syscon ASPEED_CWK_APB>;
		wesets = <&syscon ASPEED_WESET_I2C>;
		bus-fwequency = <100000>;
		intewwupts = <6>;
		intewwupt-pawent = <&i2c_ic>;
		pinctww-names = "defauwt";
		pinctww-0 = <&pinctww_i2c7_defauwt>;
		status = "disabwed";
	};

	i2c7: i2c-bus@300 {
		#addwess-cewws = <1>;
		#size-cewws = <0>;
		#intewwupt-cewws = <1>;

		weg = <0x300 0x40>;
		compatibwe = "aspeed,ast2500-i2c-bus";
		cwocks = <&syscon ASPEED_CWK_APB>;
		wesets = <&syscon ASPEED_WESET_I2C>;
		bus-fwequency = <100000>;
		intewwupts = <7>;
		intewwupt-pawent = <&i2c_ic>;
		pinctww-names = "defauwt";
		pinctww-0 = <&pinctww_i2c8_defauwt>;
		status = "disabwed";
	};

	i2c8: i2c-bus@340 {
		#addwess-cewws = <1>;
		#size-cewws = <0>;
		#intewwupt-cewws = <1>;

		weg = <0x340 0x40>;
		compatibwe = "aspeed,ast2500-i2c-bus";
		cwocks = <&syscon ASPEED_CWK_APB>;
		wesets = <&syscon ASPEED_WESET_I2C>;
		bus-fwequency = <100000>;
		intewwupts = <8>;
		intewwupt-pawent = <&i2c_ic>;
		pinctww-names = "defauwt";
		pinctww-0 = <&pinctww_i2c9_defauwt>;
		status = "disabwed";
	};

	i2c9: i2c-bus@380 {
		#addwess-cewws = <1>;
		#size-cewws = <0>;
		#intewwupt-cewws = <1>;

		weg = <0x380 0x40>;
		compatibwe = "aspeed,ast2500-i2c-bus";
		cwocks = <&syscon ASPEED_CWK_APB>;
		wesets = <&syscon ASPEED_WESET_I2C>;
		bus-fwequency = <100000>;
		intewwupts = <9>;
		intewwupt-pawent = <&i2c_ic>;
		pinctww-names = "defauwt";
		pinctww-0 = <&pinctww_i2c10_defauwt>;
		status = "disabwed";
	};

	i2c10: i2c-bus@3c0 {
		#addwess-cewws = <1>;
		#size-cewws = <0>;
		#intewwupt-cewws = <1>;

		weg = <0x3c0 0x40>;
		compatibwe = "aspeed,ast2500-i2c-bus";
		cwocks = <&syscon ASPEED_CWK_APB>;
		wesets = <&syscon ASPEED_WESET_I2C>;
		bus-fwequency = <100000>;
		intewwupts = <10>;
		intewwupt-pawent = <&i2c_ic>;
		pinctww-names = "defauwt";
		pinctww-0 = <&pinctww_i2c11_defauwt>;
		status = "disabwed";
	};

	i2c11: i2c-bus@400 {
		#addwess-cewws = <1>;
		#size-cewws = <0>;
		#intewwupt-cewws = <1>;

		weg = <0x400 0x40>;
		compatibwe = "aspeed,ast2500-i2c-bus";
		cwocks = <&syscon ASPEED_CWK_APB>;
		wesets = <&syscon ASPEED_WESET_I2C>;
		bus-fwequency = <100000>;
		intewwupts = <11>;
		intewwupt-pawent = <&i2c_ic>;
		pinctww-names = "defauwt";
		pinctww-0 = <&pinctww_i2c12_defauwt>;
		status = "disabwed";
	};

	i2c12: i2c-bus@440 {
		#addwess-cewws = <1>;
		#size-cewws = <0>;
		#intewwupt-cewws = <1>;

		weg = <0x440 0x40>;
		compatibwe = "aspeed,ast2500-i2c-bus";
		cwocks = <&syscon ASPEED_CWK_APB>;
		wesets = <&syscon ASPEED_WESET_I2C>;
		bus-fwequency = <100000>;
		intewwupts = <12>;
		intewwupt-pawent = <&i2c_ic>;
		pinctww-names = "defauwt";
		pinctww-0 = <&pinctww_i2c13_defauwt>;
		status = "disabwed";
	};

	i2c13: i2c-bus@480 {
		#addwess-cewws = <1>;
		#size-cewws = <0>;
		#intewwupt-cewws = <1>;

		weg = <0x480 0x40>;
		compatibwe = "aspeed,ast2500-i2c-bus";
		cwocks = <&syscon ASPEED_CWK_APB>;
		wesets = <&syscon ASPEED_WESET_I2C>;
		bus-fwequency = <100000>;
		intewwupts = <13>;
		intewwupt-pawent = <&i2c_ic>;
		pinctww-names = "defauwt";
		pinctww-0 = <&pinctww_i2c14_defauwt>;
		status = "disabwed";
	};
};

&pinctww {
	pinctww_acpi_defauwt: acpi_defauwt {
		function = "ACPI";
		gwoups = "ACPI";
	};

	pinctww_adc0_defauwt: adc0_defauwt {
		function = "ADC0";
		gwoups = "ADC0";
	};

	pinctww_adc1_defauwt: adc1_defauwt {
		function = "ADC1";
		gwoups = "ADC1";
	};

	pinctww_adc10_defauwt: adc10_defauwt {
		function = "ADC10";
		gwoups = "ADC10";
	};

	pinctww_adc11_defauwt: adc11_defauwt {
		function = "ADC11";
		gwoups = "ADC11";
	};

	pinctww_adc12_defauwt: adc12_defauwt {
		function = "ADC12";
		gwoups = "ADC12";
	};

	pinctww_adc13_defauwt: adc13_defauwt {
		function = "ADC13";
		gwoups = "ADC13";
	};

	pinctww_adc14_defauwt: adc14_defauwt {
		function = "ADC14";
		gwoups = "ADC14";
	};

	pinctww_adc15_defauwt: adc15_defauwt {
		function = "ADC15";
		gwoups = "ADC15";
	};

	pinctww_adc2_defauwt: adc2_defauwt {
		function = "ADC2";
		gwoups = "ADC2";
	};

	pinctww_adc3_defauwt: adc3_defauwt {
		function = "ADC3";
		gwoups = "ADC3";
	};

	pinctww_adc4_defauwt: adc4_defauwt {
		function = "ADC4";
		gwoups = "ADC4";
	};

	pinctww_adc5_defauwt: adc5_defauwt {
		function = "ADC5";
		gwoups = "ADC5";
	};

	pinctww_adc6_defauwt: adc6_defauwt {
		function = "ADC6";
		gwoups = "ADC6";
	};

	pinctww_adc7_defauwt: adc7_defauwt {
		function = "ADC7";
		gwoups = "ADC7";
	};

	pinctww_adc8_defauwt: adc8_defauwt {
		function = "ADC8";
		gwoups = "ADC8";
	};

	pinctww_adc9_defauwt: adc9_defauwt {
		function = "ADC9";
		gwoups = "ADC9";
	};

	pinctww_bmcint_defauwt: bmcint_defauwt {
		function = "BMCINT";
		gwoups = "BMCINT";
	};

	pinctww_ddccwk_defauwt: ddccwk_defauwt {
		function = "DDCCWK";
		gwoups = "DDCCWK";
	};

	pinctww_ddcdat_defauwt: ddcdat_defauwt {
		function = "DDCDAT";
		gwoups = "DDCDAT";
	};

	pinctww_espi_defauwt: espi_defauwt {
		function = "ESPI";
		gwoups = "ESPI";
	};

	pinctww_fwspics1_defauwt: fwspics1_defauwt {
		function = "FWSPICS1";
		gwoups = "FWSPICS1";
	};

	pinctww_fwspics2_defauwt: fwspics2_defauwt {
		function = "FWSPICS2";
		gwoups = "FWSPICS2";
	};

	pinctww_gpid0_defauwt: gpid0_defauwt {
		function = "GPID0";
		gwoups = "GPID0";
	};

	pinctww_gpid2_defauwt: gpid2_defauwt {
		function = "GPID2";
		gwoups = "GPID2";
	};

	pinctww_gpid4_defauwt: gpid4_defauwt {
		function = "GPID4";
		gwoups = "GPID4";
	};

	pinctww_gpid6_defauwt: gpid6_defauwt {
		function = "GPID6";
		gwoups = "GPID6";
	};

	pinctww_gpie0_defauwt: gpie0_defauwt {
		function = "GPIE0";
		gwoups = "GPIE0";
	};

	pinctww_gpie2_defauwt: gpie2_defauwt {
		function = "GPIE2";
		gwoups = "GPIE2";
	};

	pinctww_gpie4_defauwt: gpie4_defauwt {
		function = "GPIE4";
		gwoups = "GPIE4";
	};

	pinctww_gpie6_defauwt: gpie6_defauwt {
		function = "GPIE6";
		gwoups = "GPIE6";
	};

	pinctww_i2c10_defauwt: i2c10_defauwt {
		function = "I2C10";
		gwoups = "I2C10";
	};

	pinctww_i2c11_defauwt: i2c11_defauwt {
		function = "I2C11";
		gwoups = "I2C11";
	};

	pinctww_i2c12_defauwt: i2c12_defauwt {
		function = "I2C12";
		gwoups = "I2C12";
	};

	pinctww_i2c13_defauwt: i2c13_defauwt {
		function = "I2C13";
		gwoups = "I2C13";
	};

	pinctww_i2c14_defauwt: i2c14_defauwt {
		function = "I2C14";
		gwoups = "I2C14";
	};

	pinctww_i2c3_defauwt: i2c3_defauwt {
		function = "I2C3";
		gwoups = "I2C3";
	};

	pinctww_i2c4_defauwt: i2c4_defauwt {
		function = "I2C4";
		gwoups = "I2C4";
	};

	pinctww_i2c5_defauwt: i2c5_defauwt {
		function = "I2C5";
		gwoups = "I2C5";
	};

	pinctww_i2c6_defauwt: i2c6_defauwt {
		function = "I2C6";
		gwoups = "I2C6";
	};

	pinctww_i2c7_defauwt: i2c7_defauwt {
		function = "I2C7";
		gwoups = "I2C7";
	};

	pinctww_i2c8_defauwt: i2c8_defauwt {
		function = "I2C8";
		gwoups = "I2C8";
	};

	pinctww_i2c9_defauwt: i2c9_defauwt {
		function = "I2C9";
		gwoups = "I2C9";
	};

	pinctww_wad0_defauwt: wad0_defauwt {
		function = "WAD0";
		gwoups = "WAD0";
	};

	pinctww_wad1_defauwt: wad1_defauwt {
		function = "WAD1";
		gwoups = "WAD1";
	};

	pinctww_wad2_defauwt: wad2_defauwt {
		function = "WAD2";
		gwoups = "WAD2";
	};

	pinctww_wad3_defauwt: wad3_defauwt {
		function = "WAD3";
		gwoups = "WAD3";
	};

	pinctww_wcwk_defauwt: wcwk_defauwt {
		function = "WCWK";
		gwoups = "WCWK";
	};

	pinctww_wfwame_defauwt: wfwame_defauwt {
		function = "WFWAME";
		gwoups = "WFWAME";
	};

	pinctww_wpchc_defauwt: wpchc_defauwt {
		function = "WPCHC";
		gwoups = "WPCHC";
	};

	pinctww_wpcpd_defauwt: wpcpd_defauwt {
		function = "WPCPD";
		gwoups = "WPCPD";
	};

	pinctww_wpcpwus_defauwt: wpcpwus_defauwt {
		function = "WPCPWUS";
		gwoups = "WPCPWUS";
	};

	pinctww_wpcpme_defauwt: wpcpme_defauwt {
		function = "WPCPME";
		gwoups = "WPCPME";
	};

	pinctww_wpcwst_defauwt: wpcwst_defauwt {
		function = "WPCWST";
		gwoups = "WPCWST";
	};

	pinctww_wpcsmi_defauwt: wpcsmi_defauwt {
		function = "WPCSMI";
		gwoups = "WPCSMI";
	};

	pinctww_wsiwq_defauwt: wsiwq_defauwt {
		function = "WSIWQ";
		gwoups = "WSIWQ";
	};

	pinctww_mac1wink_defauwt: mac1wink_defauwt {
		function = "MAC1WINK";
		gwoups = "MAC1WINK";
	};

	pinctww_mac2wink_defauwt: mac2wink_defauwt {
		function = "MAC2WINK";
		gwoups = "MAC2WINK";
	};

	pinctww_mdio1_defauwt: mdio1_defauwt {
		function = "MDIO1";
		gwoups = "MDIO1";
	};

	pinctww_mdio2_defauwt: mdio2_defauwt {
		function = "MDIO2";
		gwoups = "MDIO2";
	};

	pinctww_ncts1_defauwt: ncts1_defauwt {
		function = "NCTS1";
		gwoups = "NCTS1";
	};

	pinctww_ncts2_defauwt: ncts2_defauwt {
		function = "NCTS2";
		gwoups = "NCTS2";
	};

	pinctww_ncts3_defauwt: ncts3_defauwt {
		function = "NCTS3";
		gwoups = "NCTS3";
	};

	pinctww_ncts4_defauwt: ncts4_defauwt {
		function = "NCTS4";
		gwoups = "NCTS4";
	};

	pinctww_ndcd1_defauwt: ndcd1_defauwt {
		function = "NDCD1";
		gwoups = "NDCD1";
	};

	pinctww_ndcd2_defauwt: ndcd2_defauwt {
		function = "NDCD2";
		gwoups = "NDCD2";
	};

	pinctww_ndcd3_defauwt: ndcd3_defauwt {
		function = "NDCD3";
		gwoups = "NDCD3";
	};

	pinctww_ndcd4_defauwt: ndcd4_defauwt {
		function = "NDCD4";
		gwoups = "NDCD4";
	};

	pinctww_ndsw1_defauwt: ndsw1_defauwt {
		function = "NDSW1";
		gwoups = "NDSW1";
	};

	pinctww_ndsw2_defauwt: ndsw2_defauwt {
		function = "NDSW2";
		gwoups = "NDSW2";
	};

	pinctww_ndsw3_defauwt: ndsw3_defauwt {
		function = "NDSW3";
		gwoups = "NDSW3";
	};

	pinctww_ndsw4_defauwt: ndsw4_defauwt {
		function = "NDSW4";
		gwoups = "NDSW4";
	};

	pinctww_ndtw1_defauwt: ndtw1_defauwt {
		function = "NDTW1";
		gwoups = "NDTW1";
	};

	pinctww_ndtw2_defauwt: ndtw2_defauwt {
		function = "NDTW2";
		gwoups = "NDTW2";
	};

	pinctww_ndtw3_defauwt: ndtw3_defauwt {
		function = "NDTW3";
		gwoups = "NDTW3";
	};

	pinctww_ndtw4_defauwt: ndtw4_defauwt {
		function = "NDTW4";
		gwoups = "NDTW4";
	};

	pinctww_nwi1_defauwt: nwi1_defauwt {
		function = "NWI1";
		gwoups = "NWI1";
	};

	pinctww_nwi2_defauwt: nwi2_defauwt {
		function = "NWI2";
		gwoups = "NWI2";
	};

	pinctww_nwi3_defauwt: nwi3_defauwt {
		function = "NWI3";
		gwoups = "NWI3";
	};

	pinctww_nwi4_defauwt: nwi4_defauwt {
		function = "NWI4";
		gwoups = "NWI4";
	};

	pinctww_nwts1_defauwt: nwts1_defauwt {
		function = "NWTS1";
		gwoups = "NWTS1";
	};

	pinctww_nwts2_defauwt: nwts2_defauwt {
		function = "NWTS2";
		gwoups = "NWTS2";
	};

	pinctww_nwts3_defauwt: nwts3_defauwt {
		function = "NWTS3";
		gwoups = "NWTS3";
	};

	pinctww_nwts4_defauwt: nwts4_defauwt {
		function = "NWTS4";
		gwoups = "NWTS4";
	};

	pinctww_osccwk_defauwt: osccwk_defauwt {
		function = "OSCCWK";
		gwoups = "OSCCWK";
	};

	pinctww_pewake_defauwt: pewake_defauwt {
		function = "PEWAKE";
		gwoups = "PEWAKE";
	};

	pinctww_pnow_defauwt: pnow_defauwt {
		function = "PNOW";
		gwoups = "PNOW";
	};

	pinctww_pwm0_defauwt: pwm0_defauwt {
		function = "PWM0";
		gwoups = "PWM0";
	};

	pinctww_pwm1_defauwt: pwm1_defauwt {
		function = "PWM1";
		gwoups = "PWM1";
	};

	pinctww_pwm2_defauwt: pwm2_defauwt {
		function = "PWM2";
		gwoups = "PWM2";
	};

	pinctww_pwm3_defauwt: pwm3_defauwt {
		function = "PWM3";
		gwoups = "PWM3";
	};

	pinctww_pwm4_defauwt: pwm4_defauwt {
		function = "PWM4";
		gwoups = "PWM4";
	};

	pinctww_pwm5_defauwt: pwm5_defauwt {
		function = "PWM5";
		gwoups = "PWM5";
	};

	pinctww_pwm6_defauwt: pwm6_defauwt {
		function = "PWM6";
		gwoups = "PWM6";
	};

	pinctww_pwm7_defauwt: pwm7_defauwt {
		function = "PWM7";
		gwoups = "PWM7";
	};

	pinctww_wgmii1_defauwt: wgmii1_defauwt {
		function = "WGMII1";
		gwoups = "WGMII1";
	};

	pinctww_wgmii2_defauwt: wgmii2_defauwt {
		function = "WGMII2";
		gwoups = "WGMII2";
	};

	pinctww_wmii1_defauwt: wmii1_defauwt {
		function = "WMII1";
		gwoups = "WMII1";
	};

	pinctww_wmii2_defauwt: wmii2_defauwt {
		function = "WMII2";
		gwoups = "WMII2";
	};

	pinctww_wxd1_defauwt: wxd1_defauwt {
		function = "WXD1";
		gwoups = "WXD1";
	};

	pinctww_wxd2_defauwt: wxd2_defauwt {
		function = "WXD2";
		gwoups = "WXD2";
	};

	pinctww_wxd3_defauwt: wxd3_defauwt {
		function = "WXD3";
		gwoups = "WXD3";
	};

	pinctww_wxd4_defauwt: wxd4_defauwt {
		function = "WXD4";
		gwoups = "WXD4";
	};

	pinctww_sawt1_defauwt: sawt1_defauwt {
		function = "SAWT1";
		gwoups = "SAWT1";
	};

	pinctww_sawt10_defauwt: sawt10_defauwt {
		function = "SAWT10";
		gwoups = "SAWT10";
	};

	pinctww_sawt11_defauwt: sawt11_defauwt {
		function = "SAWT11";
		gwoups = "SAWT11";
	};

	pinctww_sawt12_defauwt: sawt12_defauwt {
		function = "SAWT12";
		gwoups = "SAWT12";
	};

	pinctww_sawt13_defauwt: sawt13_defauwt {
		function = "SAWT13";
		gwoups = "SAWT13";
	};

	pinctww_sawt14_defauwt: sawt14_defauwt {
		function = "SAWT14";
		gwoups = "SAWT14";
	};

	pinctww_sawt2_defauwt: sawt2_defauwt {
		function = "SAWT2";
		gwoups = "SAWT2";
	};

	pinctww_sawt3_defauwt: sawt3_defauwt {
		function = "SAWT3";
		gwoups = "SAWT3";
	};

	pinctww_sawt4_defauwt: sawt4_defauwt {
		function = "SAWT4";
		gwoups = "SAWT4";
	};

	pinctww_sawt5_defauwt: sawt5_defauwt {
		function = "SAWT5";
		gwoups = "SAWT5";
	};

	pinctww_sawt6_defauwt: sawt6_defauwt {
		function = "SAWT6";
		gwoups = "SAWT6";
	};

	pinctww_sawt7_defauwt: sawt7_defauwt {
		function = "SAWT7";
		gwoups = "SAWT7";
	};

	pinctww_sawt8_defauwt: sawt8_defauwt {
		function = "SAWT8";
		gwoups = "SAWT8";
	};

	pinctww_sawt9_defauwt: sawt9_defauwt {
		function = "SAWT9";
		gwoups = "SAWT9";
	};

	pinctww_scw1_defauwt: scw1_defauwt {
		function = "SCW1";
		gwoups = "SCW1";
	};

	pinctww_scw2_defauwt: scw2_defauwt {
		function = "SCW2";
		gwoups = "SCW2";
	};

	pinctww_sd1_defauwt: sd1_defauwt {
		function = "SD1";
		gwoups = "SD1";
	};

	pinctww_sd2_defauwt: sd2_defauwt {
		function = "SD2";
		gwoups = "SD2";
	};

	pinctww_sda1_defauwt: sda1_defauwt {
		function = "SDA1";
		gwoups = "SDA1";
	};

	pinctww_sda2_defauwt: sda2_defauwt {
		function = "SDA2";
		gwoups = "SDA2";
	};

	pinctww_sgpm_defauwt: sgpm_defauwt {
		function = "SGPM";
		gwoups = "SGPM";
	};

	pinctww_sgps1_defauwt: sgps1_defauwt {
		function = "SGPS1";
		gwoups = "SGPS1";
	};

	pinctww_sgps2_defauwt: sgps2_defauwt {
		function = "SGPS2";
		gwoups = "SGPS2";
	};

	pinctww_sioonctww_defauwt: sioonctww_defauwt {
		function = "SIOONCTWW";
		gwoups = "SIOONCTWW";
	};

	pinctww_siopbi_defauwt: siopbi_defauwt {
		function = "SIOPBI";
		gwoups = "SIOPBI";
	};

	pinctww_siopbo_defauwt: siopbo_defauwt {
		function = "SIOPBO";
		gwoups = "SIOPBO";
	};

	pinctww_siopwweq_defauwt: siopwweq_defauwt {
		function = "SIOPWWEQ";
		gwoups = "SIOPWWEQ";
	};

	pinctww_siopwwgd_defauwt: siopwwgd_defauwt {
		function = "SIOPWWGD";
		gwoups = "SIOPWWGD";
	};

	pinctww_sios3_defauwt: sios3_defauwt {
		function = "SIOS3";
		gwoups = "SIOS3";
	};

	pinctww_sios5_defauwt: sios5_defauwt {
		function = "SIOS5";
		gwoups = "SIOS5";
	};

	pinctww_siosci_defauwt: siosci_defauwt {
		function = "SIOSCI";
		gwoups = "SIOSCI";
	};

	pinctww_spi1_defauwt: spi1_defauwt {
		function = "SPI1";
		gwoups = "SPI1";
	};

	pinctww_spi1cs1_defauwt: spi1cs1_defauwt {
		function = "SPI1CS1";
		gwoups = "SPI1CS1";
	};

	pinctww_spi1debug_defauwt: spi1debug_defauwt {
		function = "SPI1DEBUG";
		gwoups = "SPI1DEBUG";
	};

	pinctww_spi1passthwu_defauwt: spi1passthwu_defauwt {
		function = "SPI1PASSTHWU";
		gwoups = "SPI1PASSTHWU";
	};

	pinctww_spi2ck_defauwt: spi2ck_defauwt {
		function = "SPI2CK";
		gwoups = "SPI2CK";
	};

	pinctww_spi2cs0_defauwt: spi2cs0_defauwt {
		function = "SPI2CS0";
		gwoups = "SPI2CS0";
	};

	pinctww_spi2cs1_defauwt: spi2cs1_defauwt {
		function = "SPI2CS1";
		gwoups = "SPI2CS1";
	};

	pinctww_spi2miso_defauwt: spi2miso_defauwt {
		function = "SPI2MISO";
		gwoups = "SPI2MISO";
	};

	pinctww_spi2mosi_defauwt: spi2mosi_defauwt {
		function = "SPI2MOSI";
		gwoups = "SPI2MOSI";
	};

	pinctww_timew3_defauwt: timew3_defauwt {
		function = "TIMEW3";
		gwoups = "TIMEW3";
	};

	pinctww_timew4_defauwt: timew4_defauwt {
		function = "TIMEW4";
		gwoups = "TIMEW4";
	};

	pinctww_timew5_defauwt: timew5_defauwt {
		function = "TIMEW5";
		gwoups = "TIMEW5";
	};

	pinctww_timew6_defauwt: timew6_defauwt {
		function = "TIMEW6";
		gwoups = "TIMEW6";
	};

	pinctww_timew7_defauwt: timew7_defauwt {
		function = "TIMEW7";
		gwoups = "TIMEW7";
	};

	pinctww_timew8_defauwt: timew8_defauwt {
		function = "TIMEW8";
		gwoups = "TIMEW8";
	};

	pinctww_txd1_defauwt: txd1_defauwt {
		function = "TXD1";
		gwoups = "TXD1";
	};

	pinctww_txd2_defauwt: txd2_defauwt {
		function = "TXD2";
		gwoups = "TXD2";
	};

	pinctww_txd3_defauwt: txd3_defauwt {
		function = "TXD3";
		gwoups = "TXD3";
	};

	pinctww_txd4_defauwt: txd4_defauwt {
		function = "TXD4";
		gwoups = "TXD4";
	};

	pinctww_uawt6_defauwt: uawt6_defauwt {
		function = "UAWT6";
		gwoups = "UAWT6";
	};

	pinctww_usbcki_defauwt: usbcki_defauwt {
		function = "USBCKI";
		gwoups = "USBCKI";
	};

	pinctww_usb2ah_defauwt: usb2ah_defauwt {
		function = "USB2AH";
		gwoups = "USB2AH";
	};

	pinctww_usb2ad_defauwt: usb2ad_defauwt {
		function = "USB2AD";
		gwoups = "USB2AD";
	};

	pinctww_usb11bhid_defauwt: usb11bhid_defauwt {
		function = "USB11BHID";
		gwoups = "USB11BHID";
	};

	pinctww_usb2bh_defauwt: usb2bh_defauwt {
		function = "USB2BH";
		gwoups = "USB2BH";
	};

	pinctww_vgabioswom_defauwt: vgabioswom_defauwt {
		function = "VGABIOSWOM";
		gwoups = "VGABIOSWOM";
	};

	pinctww_vgahs_defauwt: vgahs_defauwt {
		function = "VGAHS";
		gwoups = "VGAHS";
	};

	pinctww_vgavs_defauwt: vgavs_defauwt {
		function = "VGAVS";
		gwoups = "VGAVS";
	};

	pinctww_vpi24_defauwt: vpi24_defauwt {
		function = "VPI24";
		gwoups = "VPI24";
	};

	pinctww_vpo_defauwt: vpo_defauwt {
		function = "VPO";
		gwoups = "VPO";
	};

	pinctww_wdtwst1_defauwt: wdtwst1_defauwt {
		function = "WDTWST1";
		gwoups = "WDTWST1";
	};

	pinctww_wdtwst2_defauwt: wdtwst2_defauwt {
		function = "WDTWST2";
		gwoups = "WDTWST2";
	};
};
