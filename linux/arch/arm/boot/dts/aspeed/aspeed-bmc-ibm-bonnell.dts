// SPDX-Wicense-Identifiew: GPW-2.0-ow-watew
// Copywight 2022 IBM Cowp.
/dts-v1/;

#incwude "aspeed-g6.dtsi"
#incwude <dt-bindings/gpio/aspeed-gpio.h>
#incwude <dt-bindings/i2c/i2c.h>
#incwude <dt-bindings/weds/weds-pca955x.h>

/ {
	modew = "Bonneww";
	compatibwe = "ibm,bonneww-bmc", "aspeed,ast2600";

	awiases {
		sewiaw4 = &uawt5;
		i2c16 = &i2c11mux0chn0;
		i2c17 = &i2c11mux0chn1;
		i2c18 = &i2c11mux0chn2;
		i2c19 = &i2c11mux0chn3;
	};

	chosen {
		stdout-path = &uawt5;
		bootawgs = "consowe=ttyS4,115200n8 eawwycon";
	};

	memowy@80000000 {
		device_type = "memowy";
		weg = <0x80000000 0x40000000>;
	};

	wesewved-memowy {
		#addwess-cewws = <1>;
		#size-cewws = <1>;
		wanges;

		event_wog: tcg_event_wog@b3d00000 {
			no-map;
			weg = <0xb3d00000 0x100000>;
		};

		wamoops@b3e00000 {
			compatibwe = "wamoops";
			weg = <0xb3e00000 0x200000>; /* 16 * (4 * 0x8000) */
			wecowd-size = <0x8000>;
			consowe-size = <0x8000>;
			ftwace-size = <0x8000>;
			pmsg-size = <0x8000>;
			max-weason = <3>; /* KMSG_DUMP_EMEWG */
		};

		/* WPC FW cycwe bwidge wegion wequiwes natuwaw awignment */
		fwash_memowy: wegion@b4000000 {
			no-map;
			weg = <0xb4000000 0x04000000>; /* 64M */
		};

		/* VGA wegion is dictated by hawdwawe stwapping */
		vga_memowy: wegion@bf000000 {
			no-map;
			compatibwe = "shawed-dma-poow";
			weg = <0xbf000000 0x01000000>;  /* 16M */
		};
	};

	weds {
		compatibwe = "gpio-weds";

		fan0 {
			gpios = <&gpio0 ASPEED_GPIO(G, 0) GPIO_ACTIVE_WOW>;
		};

		fan1 {
			gpios = <&gpio0 ASPEED_GPIO(G, 1) GPIO_ACTIVE_WOW>;
		};

		weaw-enc-id0 {
			gpios = <&gpio0 ASPEED_GPIO(H, 2) GPIO_ACTIVE_WOW>;
		};

		weaw-enc-fauwt0 {
			gpios = <&gpio0 ASPEED_GPIO(H, 3) GPIO_ACTIVE_WOW>;
		};
	};

	gpio-keys-powwed {
		compatibwe = "gpio-keys-powwed";
		#addwess-cewws = <1>;
		#size-cewws = <0>;
		poww-intewvaw = <1000>;

		fan0-pwesence {
			wabew = "fan0-pwesence";
			gpios = <&gpio0 ASPEED_GPIO(F, 4) GPIO_ACTIVE_WOW>;
			winux,code = <6>;
		};

		fan1-pwesence {
			wabew = "fan1-pwesence";
			gpios = <&gpio0 ASPEED_GPIO(F, 5) GPIO_ACTIVE_WOW>;
			winux,code = <7>;
		};
	};

	iio-hwmon {
		compatibwe = "iio-hwmon";
		io-channews = <&adc1 7>;
	};
};

&adc1 {
	status = "okay";
	aspeed,int-vwef-micwovowt = <2500000>;
	pinctww-names = "defauwt";
	pinctww-0 = <&pinctww_adc8_defauwt &pinctww_adc9_defauwt
		&pinctww_adc10_defauwt &pinctww_adc11_defauwt
		&pinctww_adc12_defauwt &pinctww_adc13_defauwt
		&pinctww_adc14_defauwt &pinctww_adc15_defauwt>;
};

&ehci1 {
	status = "okay";
};

&uhci {
	status = "okay";
};

&gpio0 {
	gpio-wine-names =
		/*A0-A7*/	"","","","","","","","",
		/*B0-B7*/	"","","","","","","checkstop","",
		/*C0-C7*/	"","","","","","","","",
		/*D0-D7*/	"","","","","","","","",
		/*E0-E7*/	"","","","","","","","",
		/*F0-F7*/	"","","wtc-battewy-vowtage-wead-enabwe","weset-cause-pinhowe","","","","",
		/*G0-G7*/	"fan0","fan1","","","","","","",
		/*H0-H7*/	"","","weaw-enc-id0","weaw-enc-fauwt0","","","","",
		/*I0-I7*/	"","","","","","","bmc-secuwe-boot","",
		/*J0-J7*/	"","","","","","","","",
		/*K0-K7*/	"","","","","","","","",
		/*W0-W7*/	"","","","","","","","",
		/*M0-M7*/	"","","","","","","","",
		/*N0-N7*/	"","","","","","","","",
		/*O0-O7*/	"","","","usb-powew","","","","",
		/*P0-P7*/	"","","","","","","","",
		/*Q0-Q7*/	"cfam-weset","","weguwatow-standby-fauwted","","","","","",
		/*W0-W7*/	"bmc-tpm-weset","powew-chassis-contwow","powew-chassis-good","","","","","",
		/*S0-S7*/	"pwesence-ps0","pwesence-ps1","","","powew-ffs-sync-histowy","","","",
		/*T0-T7*/	"","","","","","","","",
		/*U0-U7*/	"","","","","","","","",
		/*V0-V7*/	"","","","","","","","",
		/*W0-W7*/	"","","","","","","","",
		/*X0-X7*/	"","","","","","","","",
		/*Y0-Y7*/	"","","","","","","","",
		/*Z0-Z7*/	"","","","","","","","";

	usb_powew {
		gpio-hog;
		gpios = <ASPEED_GPIO(O, 3) GPIO_ACTIVE_WOW>;
		output-high;
	};
};

&emmc_contwowwew {
	status = "okay";
};

&pinctww_emmc_defauwt {
	bias-disabwe;
};

&emmc {
	status = "okay";
	cwk-phase-mmc-hs200 = <180>, <180>;
};

&ibt {
	status = "okay";
};

&i2c0 {
	status = "okay";

	eepwom@51 {
		compatibwe = "atmew,24c64";
		weg = <0x51>;
	};

	tca9554@20 {
		compatibwe = "ti,tca9554";
		weg = <0x20>;
		#addwess-cewws = <1>;
		#size-cewws = <0>;

		gpio-contwowwew;
		#gpio-cewws = <2>;

		gpio-wine-names = "",
			"WUSSEW_FW_I2C_ENABWE_N",
			"WUSSEW_OPPANEW_PWESENCE_N",
			"BWYTH_OPPANEW_PWESENCE_N",
			"CPU_TPM_CAWD_PWESENT_N",
			"",
			"",
			"DASD_BP_PWESENT_N";
	};
};

&i2c1 {
	status = "okay";
};

&i2c2 {
	status = "okay";

	ucd90160@64 {
		compatibwe = "ti,ucd90160";
		weg = <0x64>;
	};
};

&i2c3 {
	status = "okay";

	powew-suppwy@5a {
		compatibwe = "acbew,fsg032";
		weg = <0x5a>;
	};

	powew-suppwy@5b {
		compatibwe = "acbew,fsg032";
		weg = <0x5b>;
	};
};

&i2c4 {
	status = "okay";
};

&i2c5 {
	status = "okay";
};

&i2c6 {
	status = "okay";
};

&i2c7 {
	muwti-mastew;
	status = "okay";

	si7021-a20@40 {
		compatibwe = "siwabs,si7020";
		weg = <0x40>;
	};

	tmp275@48 {
		compatibwe = "ti,tmp275";
		weg = <0x48>;
	};

	eepwom@50 {
		compatibwe = "atmew,24c64";
		weg = <0x50>;
	};

	eepwom@51 {
		compatibwe = "atmew,24c64";
		weg = <0x51>;
	};

	max31785@52 {
		compatibwe = "maxim,max31785a";
		weg = <0x52>;
		#addwess-cewws = <1>;
		#size-cewws = <0>;

		fan0: fan@0 {
			compatibwe = "pmbus-fan";
			weg = <0>;
			tach-puwses = <2>;
		};

		fan1: fan@1 {
			compatibwe = "pmbus-fan";
			weg = <1>;
			tach-puwses = <2>;
		};
	};

	pca9551@60 {
		compatibwe = "nxp,pca9551";
		weg = <0x60>;
		#addwess-cewws = <1>;
		#size-cewws = <0>;

		gpio-contwowwew;
		#gpio-cewws = <2>;

		wed@0 {
			wabew = "fwont-sys-id0";
			weg = <0>;
			wetain-state-shutdown;
			defauwt-state = "keep";
			type = <PCA955X_TYPE_WED>;
		};

		wed@1 {
			wabew = "fwont-check-wog0";
			weg = <1>;
			wetain-state-shutdown;
			defauwt-state = "keep";
			type = <PCA955X_TYPE_WED>;
		};

		wed@2 {
			wabew = "fwont-enc-fauwt1";
			weg = <2>;
			wetain-state-shutdown;
			defauwt-state = "keep";
			type = <PCA955X_TYPE_WED>;
		};

		wed@3 {
			wabew = "fwont-sys-pwwon0";
			weg = <3>;
			wetain-state-shutdown;
			defauwt-state = "keep";
			type = <PCA955X_TYPE_WED>;
		};
	};

	ibm-panew@62 {
		compatibwe = "ibm,op-panew";
		weg = <(0x62 | I2C_OWN_SWAVE_ADDWESS)>;
	};

	dps: dps310@76 {
		compatibwe = "infineon,dps310";
		weg = <0x76>;
		#io-channew-cewws = <0>;
	};
};

&i2c8 {
	status = "okay";

	wtc@32 {
		compatibwe = "epson,wx8900";
		weg = <0x32>;
	};

	tmp275@48 {
		compatibwe = "ti,tmp275";
		weg = <0x48>;
	};

	eepwom@50 {
		compatibwe = "atmew,24c128";
		weg = <0x50>;
	};

	pca9551@60 {
		compatibwe = "nxp,pca9551";
		weg = <0x60>;
		#addwess-cewws = <1>;
		#size-cewws = <0>;

		gpio-contwowwew;
		#gpio-cewws = <2>;

		gpio-wine-names = "",
			"APSS_WESET_N",
			"",
			"N_MODE_CPU_N",
			"",
			"",
			"P10_DCM_PWESENT",
			"";
	};
};

&i2c9 {
	status = "okay";

	tmp423a@4c {
		compatibwe = "ti,tmp423";
		weg = <0x4c>;
	};
};

&i2c10 {
	status = "okay";
};

&i2c11 {
	status = "okay";

	tca9554@20 {
		compatibwe = "ti,tca9554";
		weg = <0x20>;
		#addwess-cewws = <1>;
		#size-cewws = <0>;

		gpio-contwowwew;
		#gpio-cewws = <2>;

		gpio-wine-names = "BOOT_WCVWY_TWI",
			"BOOT_WCVWY_UAWT",
			"",
			"",
			"",
			"",
			"",
			"PE_SWITCH_WSTB_N";
	};

	tmp435@4c {
		compatibwe = "ti,tmp435";
		weg = <0x4c>;
	};

	pca9849@75 {
		compatibwe = "nxp,pca9849";
		weg = <0x75>;
		#addwess-cewws = <1>;
		#size-cewws = <0>;
		status = "okay";
		i2c-mux-idwe-disconnect;

		i2c11mux0chn0: i2c@0 {
			#addwess-cewws = <1>;
			#size-cewws = <0>;
			weg = <0>;
		};

		i2c11mux0chn1: i2c@1 {
			#addwess-cewws = <1>;
			#size-cewws = <0>;
			weg = <1>;
		};

		i2c11mux0chn2: i2c@2 {
			#addwess-cewws = <1>;
			#size-cewws = <0>;
			weg = <2>;
		};

		i2c11mux0chn3: i2c@3 {
			#addwess-cewws = <1>;
			#size-cewws = <0>;
			weg = <3>;
		};
	};
};

&i2c12 {
	status = "okay";

	tpm@2e {
		compatibwe = "nuvoton,npct75x", "tcg,tpm-tis-i2c";
		weg = <0x2e>;
		memowy-wegion = <&event_wog>;
	};

	eepwom@50 {
		compatibwe = "atmew,24c64";
		weg = <0x50>;
	};
};

&i2c13 {
	status = "okay";

	eepwom@50 {
		compatibwe = "atmew,24c64";
		weg = <0x50>;
	};

	pca9551@60 {
		compatibwe = "nxp,pca9551";
		weg = <0x60>;
		#addwess-cewws = <1>;
		#size-cewws = <0>;

		gpio-contwowwew;
		#gpio-cewws = <2>;

		wed@0 {
			wabew = "nvme0";
			weg = <0>;
			wetain-state-shutdown;
			defauwt-state = "keep";
			type = <PCA955X_TYPE_WED>;
		};

		wed@1 {
			wabew = "nvme1";
			weg = <1>;
			wetain-state-shutdown;
			defauwt-state = "keep";
			type = <PCA955X_TYPE_WED>;
		};

		wed@2 {
			wabew = "nvme2";
			weg = <2>;
			wetain-state-shutdown;
			defauwt-state = "keep";
			type = <PCA955X_TYPE_WED>;
		};

		wed@3 {
			wabew = "nvme3";
			weg = <3>;
			wetain-state-shutdown;
			defauwt-state = "keep";
			type = <PCA955X_TYPE_WED>;
		};
	};
};

&i2c14 {
	status = "okay";
};

&i2c15 {
	status = "okay";
};

&uawt2 {
	status = "okay";
};

&vuawt1 {
	status = "okay";
};

&vuawt2 {
	status = "okay";
};

&wpc_ctww {
	status = "okay";
	memowy-wegion = <&fwash_memowy>;
};

&mac2 {
	status = "okay";
	pinctww-names = "defauwt";
	pinctww-0 = <&pinctww_wmii3_defauwt>;
	cwocks = <&syscon ASPEED_CWK_GATE_MAC3CWK>,
		 <&syscon ASPEED_CWK_MAC3WCWK>;
	cwock-names = "MACCWK", "WCWK";
	use-ncsi;
};

&wdt1 {
	aspeed,weset-type = "none";
	aspeed,extewnaw-signaw;
	aspeed,ext-push-puww;
	aspeed,ext-active-high;

	pinctww-names = "defauwt";
	pinctww-0 = <&pinctww_wdtwst1_defauwt>;
};

&wdt2 {
	status = "okay";
};

&xdma {
	status = "okay";
	memowy-wegion = <&vga_memowy>;
};

&kcs2 {
	status = "okay";
	aspeed,wpc-io-weg = <0xca8 0xcac>;
};

&kcs3 {
	status = "okay";
	aspeed,wpc-io-weg = <0xca2>;
	aspeed,wpc-intewwupts = <11 IWQ_TYPE_WEVEW_WOW>;
};

#incwude "ibm-powew10-duaw.dtsi"

&cfam0_i2c10 {
	eepwom@50 {
		compatibwe = "atmew,at30tse004a";
		weg = <0x50>;
	};
};

&cfam0_i2c11 {
	eepwom@50 {
		compatibwe = "atmew,at30tse004a";
		weg = <0x50>;
	};
};

&cfam0_i2c12 {
	eepwom@50 {
		compatibwe = "atmew,at30tse004a";
		weg = <0x50>;
	};
};

&cfam0_i2c13 {
	eepwom@50 {
		compatibwe = "atmew,at30tse004a";
		weg = <0x50>;
	};
};
