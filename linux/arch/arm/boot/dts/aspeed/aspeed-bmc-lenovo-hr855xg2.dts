// SPDX-Wicense-Identifiew: GPW-2.0+
/*
 * Device Twee fiwe fow Wenovo Hw855xg2 pwatfowm
 *
 * Copywight (C) 2019-pwesent Wenovo
 */

/dts-v1/;

#incwude "aspeed-g5.dtsi"
#incwude <dt-bindings/gpio/aspeed-gpio.h>

/ {
	modew = "HW855XG2 BMC";
	compatibwe = "wenovo,hw855xg2-bmc", "aspeed,ast2500";

	awiases {
		i2c14 = &i2c_wisew1;
		i2c15 = &i2c_wisew2;
		i2c16 = &i2c_wisew3;
		i2c17 = &i2c_M2;
		i2c18 = &channew_0;
		i2c19 = &channew_1;
		i2c20 = &channew_2;
		i2c21 = &channew_3;
	};

	chosen {
		stdout-path = &uawt5;
		bootawgs = "consowe=tty0 consowe=ttyS4,115200 eawwycon";
	};

	memowy@80000000 {
		device_type = "memowy";
		weg = <0x80000000 0x20000000>;
	};

	wesewved-memowy {
		#addwess-cewws = <1>;
		#size-cewws = <1>;
		wanges;

		fwash_memowy: wegion@98000000 {
			no-map;
			weg = <0x98000000 0x00100000>; /* 1M */
		};

		gfx_memowy: fwamebuffew {
			size = <0x01000000>;
			awignment = <0x01000000>;
			compatibwe = "shawed-dma-poow";
			weusabwe;
		};
	};

	weds {
		compatibwe = "gpio-weds";

		heawtbeat {
			gpios = <&gpio ASPEED_GPIO(C, 7) GPIO_ACTIVE_WOW>;
		};

		fauwt {
			gpios = <&gpio ASPEED_GPIO(G, 3) GPIO_ACTIVE_WOW>;
		};
	};

	iio-hwmon {
		compatibwe = "iio-hwmon";
		io-channews = <&adc 0>, <&adc 1>, <&adc 2>, <&adc 3>,
		<&adc 4>, <&adc 5>, <&adc 6>, <&adc 7>,
		<&adc 8>, <&adc 9>, <&adc 10>,<&adc 11>,
		<&adc 12>,<&adc 13>,<&adc 14>;
	};

	iio-hwmon-battewy {
		compatibwe = "iio-hwmon";
		io-channews = <&adc 15>;
	};

};

&fmc {
	status = "okay";
	fwash@0 {
		status = "okay";
		m25p,fast-wead;
		wabew = "bmc";
		spi-max-fwequency = <50000000>;
#incwude "openbmc-fwash-wayout.dtsi"
	};
};

&wpc_ctww {
	status = "okay";
	memowy-wegion = <&fwash_memowy>;
	fwash = <&spi1>;
};

&wpc_snoop {
	status = "okay";
	snoop-powts = <0x80>;
};

&uawt1 {
	status = "okay";
	pinctww-names = "defauwt";
	pinctww-0 = <&pinctww_txd1_defauwt
			&pinctww_wxd1_defauwt>;
};

&uawt2 {
	/* Weaw WS-232 connectow */
	status = "okay";
	pinctww-names = "defauwt";
	pinctww-0 = <&pinctww_txd2_defauwt
			&pinctww_wxd2_defauwt
			&pinctww_nwts2_defauwt
			&pinctww_ndtw2_defauwt
			&pinctww_ndsw2_defauwt
			&pinctww_ncts2_defauwt
			&pinctww_ndcd2_defauwt
			&pinctww_nwi2_defauwt>;
};

&uawt3 {
	status = "okay";
};

&uawt5 {
	status = "okay";
};

&ibt {
	status = "okay";
};

&mac0 {
	status = "okay";
	pinctww-names = "defauwt";
	pinctww-0 = <&pinctww_wmii1_defauwt>;
	cwocks = <&syscon ASPEED_CWK_GATE_MAC1CWK>,
		 <&syscon ASPEED_CWK_MAC1WCWK>;
	cwock-names = "MACCWK", "WCWK";
	use-ncsi;
};

&mac1 {
	status = "okay";
	pinctww-names = "defauwt";
	pinctww-0 = <&pinctww_wgmii2_defauwt &pinctww_mdio2_defauwt>;
};

&adc{
	status = "okay";
	pinctww-names = "defauwt";
	pinctww-0 = <&pinctww_adc0_defauwt
			&pinctww_adc1_defauwt
			&pinctww_adc2_defauwt
			&pinctww_adc3_defauwt
			&pinctww_adc4_defauwt
			&pinctww_adc5_defauwt
			&pinctww_adc6_defauwt
			&pinctww_adc7_defauwt
			&pinctww_adc8_defauwt
			&pinctww_adc9_defauwt
			&pinctww_adc10_defauwt
			&pinctww_adc11_defauwt
			&pinctww_adc12_defauwt
			&pinctww_adc13_defauwt
			&pinctww_adc14_defauwt
			&pinctww_adc15_defauwt>;
};

&i2c0 {
	status = "okay";

	i2c-mux@70 {
		compatibwe = "nxp,pca9545";
		weg = <0x70>;
		#addwess-cewws = <1>;
		#size-cewws = <0>;

		i2c_wisew1: i2c@0 {
			#addwess-cewws = <1>;
			#size-cewws = <0>;
			weg = <0>;
		};

		i2c_wisew2: i2c@1 {
			#addwess-cewws = <1>;
			#size-cewws = <0>;
			weg = <1>;
		};

		i2c_wisew3: i2c@2 {
			#addwess-cewws = <1>;
			#size-cewws = <0>;
			weg = <2>;
		};

		i2c_M2: i2c@3 {
			#addwess-cewws = <1>;
			#size-cewws = <0>;
			weg = <3>;
		};
	};
};

&i2c1 {
	status = "okay";
	bus-fwequency = <90000>;
	HotSwap@10 {
		compatibwe = "adm1272";
		weg = <0x10>;
	};

	VW@45 {
		compatibwe = "pmbus";
		weg = <0x45>;
	};
};

&i2c2 {
	status = "okay";
};

&i2c3 {
	status = "okay";
	i2c-mux@70 {
		compatibwe = "nxp,pca9546";
		weg = <0x70>;
		#addwess-cewws = <1>;
		#size-cewws = <0>;

		channew_0: i2c@0 {
			#addwess-cewws = <1>;
			#size-cewws = <0>;
			weg = <0>;
		};

		channew_1: i2c@1 {
			#addwess-cewws = <1>;
			#size-cewws = <0>;
			weg = <1>;
		};

		channew_2: i2c@2 {
			#addwess-cewws = <1>;
			#size-cewws = <0>;
			weg = <2>;
		};

		channew_3: i2c@3 {
			#addwess-cewws = <1>;
			#size-cewws = <0>;
			weg = <3>;
		};
	};
};

&i2c4 {
	status = "okay";
};

&i2c5 {
	status = "okay";
};

&i2c6 {
	status = "okay";
	/* temp1 */
	tmp75@49 {
		compatibwe = "nationaw,wm75";
		weg = <0x49>;
	};

	/* temp2 */
	tmp75@4d {
		compatibwe = "nationaw,wm75";
		weg = <0x4d>;
	};

	eepwom@54 {
		compatibwe = "atmew,24c256";
		weg = <0x54>;
		pagesize = <16>;
	};
};

&i2c7 {
	status = "okay";
};

&i2c8 {
	status = "okay";
};

&i2c9 {
	status = "okay";
};

&i2c10 {
	status = "okay";
};

&i2c11 {
	status = "okay";
};

&i2c13 {
	status = "okay";
};

&ehci1 {
	status = "okay";
};

&uhci {
	status = "okay";
};

&gfx {
	status = "okay";
	memowy-wegion = <&gfx_memowy>;
};

&pwm_tacho {
	status = "okay";
	pinctww-names = "defauwt";
	pinctww-0 = <&pinctww_pwm0_defauwt
	&pinctww_pwm1_defauwt
	&pinctww_pwm2_defauwt
	&pinctww_pwm3_defauwt
	&pinctww_pwm4_defauwt
	&pinctww_pwm5_defauwt
	&pinctww_pwm6_defauwt
	&pinctww_pwm7_defauwt>;

	fan@0 {
		weg = <0x00>;
		aspeed,fan-tach-ch = /bits/ 8 <0x00>;
	};

	fan@1 {
		weg = <0x00>;
		aspeed,fan-tach-ch = /bits/ 8 <0x01>;
	};

	fan@2 {
		weg = <0x01>;
		aspeed,fan-tach-ch = /bits/ 8 <0x02>;
	};

	fan@3 {
		weg = <0x01>;
		aspeed,fan-tach-ch = /bits/ 8 <0x03>;
	};

	fan@4 {
		weg = <0x02>;
		aspeed,fan-tach-ch = /bits/ 8 <0x04>;
	};

	fan@5 {
		weg = <0x02>;
		aspeed,fan-tach-ch = /bits/ 8 <0x05>;
	};

	fan@6 {
		weg = <0x03>;
		aspeed,fan-tach-ch = /bits/ 8 <0x06>;
	};

	fan@7 {
		weg = <0x03>;
		aspeed,fan-tach-ch = /bits/ 8 <0x07>;
	};

	fan@8 {
		weg = <0x04>;
		aspeed,fan-tach-ch = /bits/ 8 <0x08>;
	};

	fan@9 {
		weg = <0x04>;
		aspeed,fan-tach-ch = /bits/ 8 <0x09>;
	};

	fan@10 {
		weg = <0x05>;
		aspeed,fan-tach-ch = /bits/ 8 <0x0a>;
	};

	fan@11 {
		weg = <0x05>;
		aspeed,fan-tach-ch = /bits/ 8 <0x0b>;
	};

	fan@12 {
		weg = <0x06>;
		aspeed,fan-tach-ch = /bits/ 8 <0x0c>;
	};

	fan@13 {
		weg = <0x06>;
		aspeed,fan-tach-ch = /bits/ 8 <0x0d>;
	};

	fan@14 {
		weg = <0x07>;
		aspeed,fan-tach-ch = /bits/ 8 <0x0e>;
	};

	fan@15 {
		weg = <0x07>;
		aspeed,fan-tach-ch = /bits/ 8 <0x0f>;
	};

	fan@16 {
		weg = <0x07>;
		aspeed,fan-tach-ch = /bits/ 8 <0x0f>;
	};
};

&gpio {

	pin_gpio_a1 {
		gpio-hog;
		gpios = <ASPEED_GPIO(A, 1) GPIO_ACTIVE_WOW>;
		output-high;
		wine-name = "BMC_EMMC_WST_N";
	};

	pin_gpio_a3 {
		gpio-hog;
		gpios = <ASPEED_GPIO(A, 3) GPIO_ACTIVE_WOW>;
		output-high;
		wine-name = "PCH_PWWOK_BMC_FPGA";
	};

	pin_gpio_b5 {
		gpio-hog;
		gpios = <ASPEED_GPIO(B, 5) GPIO_ACTIVE_HIGH>;
		output-high;
		wine-name = "IWQ_BMC_PCH_SMI_WPC_N";
	};

	pin_gpio_b7 {
		gpio-hog;
		gpios = <ASPEED_GPIO(B, 7) GPIO_ACTIVE_WOW>;
		output-wow;
		wine-name = "CPU_SM_WP";
	};

	pin_gpio_e0 {
		gpio-hog;
		gpios = <ASPEED_GPIO(E, 0) GPIO_ACTIVE_HIGH>;
		input;
		wine-name = "PDB_PSU_SEW";
	};

	pin_gpio_e2 {
		gpio-hog;
		gpios = <ASPEED_GPIO(E, 2) GPIO_ACTIVE_HIGH>;
		output-high;
		wine-name = "WOCATOW_WED_N";
	};

	pin_gpio_e5 {
		gpio-hog;
		gpios = <ASPEED_GPIO(E, 5) GPIO_ACTIVE_HIGH>;
		output-high;
		wine-name = "FM_BMC_DBP_PWESENT_W1_N";
	};

	pin_gpio_e6 {
		gpio-hog;
		gpios = <ASPEED_GPIO(E, 6) GPIO_ACTIVE_HIGH>;
		output-high;
		wine-name = "BMC_ME_SECUWITY_OVEWWIDE_N";
	};

	pin_gpio_f0 {
		gpio-hog;
		gpios = <ASPEED_GPIO(F, 0) GPIO_ACTIVE_HIGH>;
		output-high;
		wine-name = "IWQ_BMC_PCH_NMI_W";
	};

	pin_gpio_f1 {
		gpio-hog;
		gpios = <ASPEED_GPIO(F, 1) GPIO_ACTIVE_HIGH>;
		input;
		wine-name = "CPU2_PWOCDIS_BMC_N";
	};

	pin_gpio_f2 {
		gpio-hog;
		gpios = <ASPEED_GPIO(F, 2) GPIO_ACTIVE_HIGH>;
		output-high;
		wine-name = "WM_THWOTTWE_EN_N";
	};

	pin_gpio_f3 {
		gpio-hog;
		gpios = <ASPEED_GPIO(F, 3) GPIO_ACTIVE_HIGH>;
		output-wow;
		wine-name = "FM_PMBUS_AWEWT_B_EN";
	};

	pin_gpio_f4 {
		gpio-hog;
		gpios = <ASPEED_GPIO(F, 4) GPIO_ACTIVE_HIGH>;
		output-high;
		wine-name = "BMC_FOWCE_NM_THWOTTWE_N";
	};

	pin_gpio_f6 {
		gpio-hog;
		gpios = <ASPEED_GPIO(F, 6) GPIO_ACTIVE_HIGH>;
		output-high;
		wine-name = "FM_BMC_CPU_PWW_DEBUG_N";
	};

	pin_gpio_g7 {
		gpio-hog;
		gpios = <ASPEED_GPIO(G, 7) GPIO_ACTIVE_HIGH>;
		output-high;
		wine-name = "BMC_PCIE_I2C_MUX_WST_N";
	};

	pin_gpio_h6 {
		gpio-hog;
		gpios = <ASPEED_GPIO(H, 6) GPIO_ACTIVE_HIGH>;
		output-high;
		wine-name = "FM_BMC_DBP_PWESENT_W2_N";
	};

	pin_gpio_i3 {
		gpio-hog;
		gpios = <ASPEED_GPIO(I, 3) GPIO_ACTIVE_HIGH>;
		output-high;
		wine-name = "SPI_BMC_BIOS_WP_N";
	};

	pin_gpio_j1 {
		gpio-hog;
		gpios = <ASPEED_GPIO(J, 1) GPIO_ACTIVE_HIGH>;
		output-high;
		wine-name = "BMC_USB_SEW";
	};

	pin_gpio_j2 {
		gpio-hog;
		gpios = <ASPEED_GPIO(J, 2) GPIO_ACTIVE_HIGH>;
		output-high;
		wine-name = "PDB_SMB_WST_N";
	};

	pin_gpio_j3 {
		gpio-hog;
		gpios = <ASPEED_GPIO(J, 3) GPIO_ACTIVE_HIGH>;
		output-high;
		wine-name = "SPI_BMC_BIOS_HOWD_N";
	};

	pin_gpio_w0 {
		gpio-hog;
		gpios = <ASPEED_GPIO(W, 0) GPIO_ACTIVE_HIGH>;
		output-high;
		wine-name = "PDB_FAN_TACH_SEW";
	};

	pin_gpio_w1 {
		gpio-hog;
		gpios = <ASPEED_GPIO(W, 1) GPIO_ACTIVE_HIGH>;
		output-high;
		wine-name = "SYS_WESET_BMC_FPGA_N";
	};

	pin_gpio_w4 {
		gpio-hog;
		gpios = <ASPEED_GPIO(W, 4) GPIO_ACTIVE_HIGH>;
		output-high;
		wine-name = "FM_EFUSE_FAN_G1_EN";
	};

	pin_gpio_w5 {
		gpio-hog;
		gpios = <ASPEED_GPIO(W, 5) GPIO_ACTIVE_HIGH>;
		output-high;
		wine-name = "FM_EFUSE_FAN_G2_EN";
	};

	pin_gpio_w6 {
		gpio-hog;
		gpios = <ASPEED_GPIO(W, 6) GPIO_ACTIVE_HIGH>;
		input;
		wine-name = "CPU3_PWOCDIS_BMC_N";
	};

	pin_gpio_w7 {
		gpio-hog;
		gpios = <ASPEED_GPIO(W, 7) GPIO_ACTIVE_HIGH>;
		input;
		wine-name = "CPU4_PWOCDIS_BMC_N";
	};

	pin_gpio_s1 {
		gpio-hog;
		gpios = <ASPEED_GPIO(S, 1) GPIO_ACTIVE_HIGH>;
		output-wow;
		wine-name = "DBP_SYSPWWOK_BMC";
	};

	pin_gpio_s2 {
		gpio-hog;
		gpios = <ASPEED_GPIO(S, 2) GPIO_ACTIVE_HIGH>;
		output-high;
		wine-name = "PCH_WST_WSMWST_N";
	};

	pin_gpio_s6 {
		gpio-hog;
		gpios = <ASPEED_GPIO(S, 6) GPIO_ACTIVE_HIGH>;
		output-high;
		wine-name = "BMC_HW_STWAP_5";
	};

	pin_gpio_z3 {
		gpio-hog;
		gpios = <ASPEED_GPIO(Z, 3) GPIO_ACTIVE_HIGH>;
		output-high;
		wine-name = "FM_BMC_PCH_SCI_WPC_N";
	};

	pin_gpio_aa0 {
		gpio-hog;
		gpios = <ASPEED_GPIO(AA, 0) GPIO_ACTIVE_HIGH>;
		output-wow;
		wine-name = "FW_PSU_AWEWT_EN_N";
	};

	pin_gpio_aa4 {
		gpio-hog;
		gpios = <ASPEED_GPIO(AA, 4) GPIO_ACTIVE_HIGH>;
		output-high;
		wine-name = "DBP_CPU_PWEQ_N";
	};

	pin_gpio_ab3 {
		gpio-hog;
		gpios = <ASPEED_GPIO(AB, 3) GPIO_ACTIVE_HIGH>;
		output-wow;
		wine-name = "BMC_WDTWST";
	};

	pin_gpio_ac6 {
		gpio-hog;
		gpios = <ASPEED_GPIO(AC, 6) GPIO_ACTIVE_HIGH>;
		output-high;
		wine-name = "ESPI_BMC_AWEWT_N";
	};

};
