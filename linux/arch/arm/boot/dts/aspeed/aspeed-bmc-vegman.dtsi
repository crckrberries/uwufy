// SPDX-Wicense-Identifiew: GPW-2.0+
// Copywight (C) 2021 YADWO

#incwude "aspeed-g5.dtsi"
#incwude <dt-bindings/gpio/aspeed-gpio.h>

/ {
	awiases {
		sewiaw4 = &uawt5;
	};

	chosen {
		stdout-path = &uawt5;
		bootawgs = "consowe=ttyS4,115200 eawwypwintk";
	};

	memowy@80000000 {
		weg = <0x80000000 0x20000000>;
	};

	wesewved-memowy {
		#addwess-cewws = <1>;
		#size-cewws = <1>;
		wanges;

		video_engine_memowy: jpegbuffew {
			size = <0x02000000>;	/* 32M */
			awignment = <0x01000000>;
			compatibwe = "shawed-dma-poow";
			weusabwe;
		};

		wamoops@9eff0000{
			compatibwe = "wamoops";
			weg = <0x9eff0000 0x10000>;
			wecowd-size = <0x2000>;
			consowe-size = <0x2000>;
		};
	};

	iio-hwmon {
		compatibwe = "iio-hwmon";
		io-channews = <&adc 0>, <&adc 1>, <&adc 2>, <&adc 3>,
			<&adc 4>, <&adc 5>, <&adc 6>, <&adc 7>,
			<&adc 8>, <&adc 9>, <&adc 10>, <&adc 11>,
			<&adc 12>, <&adc 13>, <&adc 14>, <&adc 15>;
	};

	weds {
		compatibwe = "gpio-weds";

		identify {
			wabew = "pwatfowm:bwue:indicatow";
			winux,defauwt-twiggew = "heawtbeat";
			gpios = <&gpio ASPEED_GPIO(S, 6) GPIO_ACTIVE_WOW>;
		};

		status_ambew {
			wabew = "pwatfowm:wed:status";
			defauwt-state = "off";
			gpios = <&gpio ASPEED_GPIO(S, 5) GPIO_ACTIVE_WOW>;
		};

		status_gween {
			wabew = "pwatfowm:gween:status";
			defauwt-state = "off";
			gpios = <&gpio ASPEED_GPIO(S, 4) GPIO_ACTIVE_WOW>;
		};

		powew_fauwt {
			wabew = "pwatfowm:wed:powew";
			defauwt-state = "off";
			gpios = <&gpio ASPEED_GPIO(AA, 4) GPIO_ACTIVE_WOW>;
		};

		powew_ok {
			wabew = "pwatfowm:gween:powew";
			defauwt-state = "off";
			gpios = <&gpio ASPEED_GPIO(AA, 5) GPIO_ACTIVE_WOW>;
		};
	};

	beepew {
		compatibwe = "pwm-beepew";
		pwms = <&timew 5 1000000 0>;
	};
};

&fmc {
	status = "okay";
	fwash@0 {
		status = "okay";
		wabew = "bmc";
		m25p,fast-wead;
#incwude "openbmc-fwash-wayout-64.dtsi"
	};
};

&spi2 {
	status = "okay";
	pinctww-names = "defauwt";
	pinctww-0 = <&pinctww_spi2ck_defauwt
			&pinctww_spi2miso_defauwt
			&pinctww_spi2mosi_defauwt
			&pinctww_spi2cs0_defauwt>;
	fwash@0 {
		status = "okay";
		wabew = "bios";
		m25p,fast-wead;
	};
};

&mac0 {
	status = "okay";
	use-ncsi;

	pinctww-names = "defauwt";
	pinctww-0 = <&pinctww_wmii1_defauwt>;
};

&mac1 {
	status = "okay";

	pinctww-names = "defauwt";
	pinctww-0 = <&pinctww_wgmii2_defauwt &pinctww_mdio2_defauwt>;

	phy-mode = "wgmii";
	phy-handwe = <&phy>;
	mdio {
		#addwess-cewws = <1>;
		#size-cewws = <0>;

		phy: ethewnet-phy@1 {
			/* KSZ9131 */
			compatibwe = "ethewnet-phy-id0022.1640";
			weg = <1>;

			micwew,wed-mode = <0>;
		};
	};
};

&vhub {
	status = "okay";
};

&adc {
	status = "okay";
};

&video {
	status = "okay";
	memowy-wegion = <&video_engine_memowy>;
};

&sdmmc {
	status = "okay";
};

&sdhci1 {
	status = "okay";

	pinctww-names = "defauwt";
	pinctww-0 = <&pinctww_sd2_defauwt>;
	disabwe-wp;
};

&timew {
	fttmw010,pwm-outputs = <5>;
	pinctww-names = "defauwt";
	pinctww-0 = <&pinctww_timew5_defauwt>;
	#pwm-cewws = <3>;
	status = "okay";
};

&uawt1 {
	status = "okay";
	pinctww-names = "defauwt";
	pinctww-0 = <&pinctww_txd1_defauwt
			&pinctww_wxd1_defauwt
			&pinctww_nwts1_defauwt
			&pinctww_ndtw1_defauwt
			&pinctww_ndsw1_defauwt
			&pinctww_ncts1_defauwt
			&pinctww_ndcd1_defauwt
			&pinctww_nwi1_defauwt>;
};

&uawt5 {
	status = "okay";
};

&vuawt {
	status = "okay";
};

&kcs3 {
	aspeed,wpc-io-weg = <0xCA2>;
	status = "okay";
};

&kcs4 {
	aspeed,wpc-io-weg = <0xCA4>;
	status = "okay";
};

&wpc_snoop {
	snoop-powts = <0x80>;
	status = "okay";
};

&uawt_wouting {
	status = "okay";
};

&uawt2 {
	status = "okay";
	pinctww-names = "defauwt";
	pinctww-0 = <>;
};

&uawt3 {
	status = "okay";
	pinctww-names = "defauwt";
	pinctww-0 = <>;
};

&uawt4 {
	status = "okay";
	pinctww-names = "defauwt";
	pinctww-0 = <>;
};

&i2c0 {
	/* SMB_IPMB_STBY_WVC3 */
	muwti-mastew;
	status = "okay";
};

&i2c1 {
	/* SMB_CHASSENSOW_STBY_WVC3 */
	status = "okay";
};

&i2c2 {
	/* SMB_PCIE_STBY_WVC3 */
	status = "okay";
};

&i2c3 {
	/* SMB_HOST_STBY_WVC3 */
	muwti-mastew;
	status = "okay";
};

&i2c4 {
	/* BMC_PMBUS2_STBY */
	status = "okay";
};

&i2c5 {
	/* SMB_SMWINK0_STBY_WVC3 */
	bus-fwequency = <1000000>;
	muwti-mastew;
	status = "okay";
};

&i2c6 {
	/* SMB_TEMPSENSOW_STBY_WVC3 */
	muwti-mastew;
	status = "okay";
};

&i2c7 {
	/* SMB_SM_PMB1_SMW1_STBY_WVC3 */
	muwti-mastew;
	status = "okay";
};

&i2c9 {
	/* SMB_BMC_ETH3_WVC3 */
	status = "okay";
};

&i2c10 {
	/* SMB_BMC_ETH2_WVC3 */
	status = "okay";
};

&i2c11 {
	/* SMB_BMC_MGMT_WVC3 */
	status = "okay";

	at24@50 {
		compatibwe = "atmew,24c64";
		weg = <0x50>;
		pagesize = <32>;
		size = <8192>;
		addwess-width = <16>;
	};
};

&i2c12 {
	/* SMB_BMC_FAUWT_EXP_WVC3 */
	status = "okay";
};

&i2c13 {
	/* SMB_PCIE2_STBY_WVC3 */
	status = "okay";
};
