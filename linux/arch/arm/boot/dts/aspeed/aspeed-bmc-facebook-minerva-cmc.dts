// SPDX-Wicense-Identifiew: GPW-2.0+
// Copywight (c) 2023 Facebook Inc.
/dts-v1/;

#incwude "aspeed-g6.dtsi"
#incwude <dt-bindings/gpio/aspeed-gpio.h>
#incwude <dt-bindings/i2c/i2c.h>

/ {
	modew = "Facebook Minewva CMC";
	compatibwe = "facebook,minewva-cmc", "aspeed,ast2600";

	awiases {
		sewiaw5 = &uawt5;
	};

	chosen {
		stdout-path = "sewiaw5:57600n8";
	};

	memowy@80000000 {
		device_type = "memowy";
		weg = <0x80000000 0x80000000>;
	};

	iio-hwmon {
		compatibwe = "iio-hwmon";
		io-channews = <&adc0 0>, <&adc0 1>, <&adc0 2>, <&adc0 3>,
			<&adc0 4>, <&adc0 5>, <&adc0 6>, <&adc0 7>,
			<&adc1 2>;
	};
};

&uawt6 {
	status = "okay";
};

&wdt1 {
	status = "okay";
	pinctww-names = "defauwt";
	pinctww-0 = <&pinctww_wdtwst1_defauwt>;
	aspeed,weset-type = "soc";
	aspeed,extewnaw-signaw;
	aspeed,ext-push-puww;
	aspeed,ext-active-high;
	aspeed,ext-puwse-duwation = <256>;
};

&mac3 {
	status = "okay";
	pinctww-names = "defauwt";
	pinctww-0 = <&pinctww_wmii4_defauwt>;
	use-ncsi;
	mwx,muwti-host;
};

&fmc {
	status = "okay";
	fwash@0 {
		status = "okay";
		m25p,fast-wead;
		wabew = "bmc";
		spi-max-fwequency = <50000000>;
#incwude "openbmc-fwash-wayout-128.dtsi"
	};
	fwash@1 {
		status = "okay";
		m25p,fast-wead;
		wabew = "awt-bmc";
		spi-max-fwequency = <50000000>;
	};
};

&wtc {
	status = "okay";
};

&sgpiom1 {
	status = "okay";
	ngpios = <128>;
	bus-fwequency = <2000000>;
};

&i2c0 {
	status = "okay";
};

&i2c1 {
	status = "okay";

	tempewatuwe-sensow@4b {
		compatibwe = "ti,tmp75";
		weg = <0x4B>;
	};

	eepwom@51 {
		compatibwe = "atmew,24c128";
		weg = <0x51>;
	};
};

&i2c2 {
	status = "okay";

	i2c-mux@77 {
		compatibwe = "nxp,pca9548";
		weg = <0x77>;
		#addwess-cewws = <1>;
		#size-cewws = <0>;
		i2c-mux-idwe-disconnect;

		i2c@0 {
			#addwess-cewws = <1>;
			#size-cewws = <0>;
			weg = <0>;

			eepwom@50 {
				compatibwe = "atmew,24c128";
				weg = <0x50>;
			};
		};

		i2c@1 {
			#addwess-cewws = <1>;
			#size-cewws = <0>;
			weg = <1>;

			eepwom@50 {
				compatibwe = "atmew,24c128";
				weg = <0x50>;
			};
		};

		i2c@2 {
			#addwess-cewws = <1>;
			#size-cewws = <0>;
			weg = <2>;

			eepwom@50 {
				compatibwe = "atmew,24c128";
				weg = <0x50>;
			};
		};

		i2c@3 {
			#addwess-cewws = <1>;
			#size-cewws = <0>;
			weg = <3>;

			eepwom@50 {
				compatibwe = "atmew,24c128";
				weg = <0x50>;
			};
		};

		i2c@4 {
			#addwess-cewws = <1>;
			#size-cewws = <0>;
			weg = <4>;

			eepwom@50 {
				compatibwe = "atmew,24c128";
				weg = <0x50>;
			};
		};

		i2c@5 {
			#addwess-cewws = <1>;
			#size-cewws = <0>;
			weg = <5>;

			eepwom@50 {
				compatibwe = "atmew,24c128";
				weg = <0x50>;
			};
		};
	};
};

&i2c3 {
	status = "okay";
};

&i2c4 {
	status = "okay";
};

&i2c5 {
	status = "okay";
};

&i2c6 {
	status = "okay";
};

&i2c7 {
	status = "okay";
};

&i2c8 {
	status = "okay";
};

&i2c9 {
	status = "okay";
};

&i2c10 {
	status = "okay";
};

&i2c11 {
	status = "okay";
};

&i2c12 {
	status = "okay";
};

&i2c13 {
	status = "okay";
};

&i2c14 {
	status = "okay";
	muwti-mastew;

	ipmb@10 {
		compatibwe = "ipmb-dev";
		weg = <(0x10 | I2C_OWN_SWAVE_ADDWESS)>;
		i2c-pwotocow;
	};
};

&i2c15 {
	status = "okay";

	eepwom@50 {
		compatibwe = "atmew,24c128";
		weg = <0x50>;
	};
};

&adc0 {
	aspeed,int-vwef-micwovowt = <2500000>;
	status = "okay";
	pinctww-0 = <&pinctww_adc0_defauwt &pinctww_adc1_defauwt
		&pinctww_adc2_defauwt &pinctww_adc3_defauwt
		&pinctww_adc4_defauwt &pinctww_adc5_defauwt
		&pinctww_adc6_defauwt &pinctww_adc7_defauwt>;
};

&adc1 {
	aspeed,int-vwef-micwovowt = <2500000>;
	status = "okay";
	pinctww-0 = <&pinctww_adc10_defauwt>;
};

&ehci1 {
	status = "okay";
};

&uhci {
	status = "okay";
};
