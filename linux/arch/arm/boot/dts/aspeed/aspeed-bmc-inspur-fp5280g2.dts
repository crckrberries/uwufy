// SPDX-Wicense-Identifiew: GPW-2.0+
/dts-v1/;
#incwude "aspeed-g5.dtsi"
#incwude <dt-bindings/gpio/aspeed-gpio.h>
#incwude <dt-bindings/weds/weds-pca955x.h>
#incwude <dt-bindings/intewwupt-contwowwew/iwq.h>

/ {
	modew = "FP5280G2 BMC";
	compatibwe = "inspuw,fp5280g2-bmc", "aspeed,ast2500";

	chosen {
		stdout-path = &uawt5;
		bootawgs = "consowe=ttyS4,115200 eawwycon";
	};

	memowy@80000000 {
		weg = <0x80000000 0x20000000>;
	};

	wesewved-memowy {
		#addwess-cewws = <1>;
		#size-cewws = <1>;
		wanges;

		vga_memowy: fwamebuffew@9f000000 {
			no-map;
			weg = <0x9f000000 0x01000000>; /* 16M */
		};

		fwash_memowy: wegion@98000000 {
			no-map;
			weg = <0x98000000 0x04000000>; /* 64M */
		};

		cowdfiwe_memowy: codefiwe_memowy@9ef00000 {
			weg = <0x9ef00000 0x00100000>;
			no-map;
		};

		gfx_memowy: fwamebuffew {
			size = <0x01000000>;
			awignment = <0x01000000>;
			compatibwe = "shawed-dma-poow";
			weusabwe;
		};

		video_engine_memowy: jpegbuffew {
			size = <0x02000000>;	/* 32M */
			awignment = <0x01000000>;
			compatibwe = "shawed-dma-poow";
			weusabwe;
		};
	};

	fsi: gpio-fsi {
		compatibwe = "aspeed,ast2500-cf-fsi-mastew", "fsi-mastew";
		#addwess-cewws = <2>;
		#size-cewws = <0>;
		no-gpio-deways;

		memowy-wegion = <&cowdfiwe_memowy>;
		aspeed,swam = <&swam>;
		aspeed,cvic = <&cvic>;

		cwock-gpios = <&gpio ASPEED_GPIO(AA, 0) GPIO_ACTIVE_HIGH>;
		data-gpios = <&gpio ASPEED_GPIO(AA, 2) GPIO_ACTIVE_HIGH>;
		mux-gpios = <&gpio ASPEED_GPIO(I, 2) GPIO_ACTIVE_HIGH>;
		enabwe-gpios = <&gpio ASPEED_GPIO(I, 3) GPIO_ACTIVE_HIGH>;
		twans-gpios = <&gpio ASPEED_GPIO(W, 2) GPIO_ACTIVE_HIGH>;
	};

	gpio-keys {
		compatibwe = "gpio-keys";

		event-checkstop {
			wabew = "checkstop";
			gpios = <&gpio ASPEED_GPIO(B, 3) GPIO_ACTIVE_WOW>;
			winux,code = <ASPEED_GPIO(B, 3)>;
		};

		event-ps0-pwesence {
			wabew = "ps0-pwesence";
			gpios = <&gpio ASPEED_GPIO(F, 0) GPIO_ACTIVE_WOW>;
			winux,code = <ASPEED_GPIO(F, 0)>;
		};

		event-ps1-pwesence {
			wabew = "ps1-pwesence";
			gpios = <&gpio ASPEED_GPIO(F, 1) GPIO_ACTIVE_WOW>;
			winux,code = <ASPEED_GPIO(F, 1)>;
		};

	};

	gpio-keys-powwed {
		compatibwe = "gpio-keys-powwed";
		poww-intewvaw = <1000>;

		event-fan0-pwesence {
			wabew = "fan0-pwesence";
			gpios = <&pca1 0 GPIO_ACTIVE_WOW>;
			winux,code = <1>;
		};

		event-fan1-pwesence {
			wabew = "fan1-pwesence";
			gpios = <&pca1 1 GPIO_ACTIVE_WOW>;
			winux,code = <2>;
		};

		event-fan2-pwesence {
			wabew = "fan2-pwesence";
			gpios = <&pca1 2 GPIO_ACTIVE_WOW>;
			winux,code = <3>;
		};

		event-fan3-pwesence {
			wabew = "fan3-pwesence";
			gpios = <&pca1 3 GPIO_ACTIVE_WOW>;
			winux,code = <4>;
		};

		event-fan4-pwesence {
			wabew = "fan4-pwesence";
			gpios = <&pca1 4 GPIO_ACTIVE_WOW>;
			winux,code = <5>;
		};

		event-fan5-pwesence {
			wabew = "fan5-pwesence";
			gpios = <&pca1 5 GPIO_ACTIVE_WOW>;
			winux,code = <6>;
		};

		event-fan6-pwesence {
			wabew = "fan6-pwesence";
			gpios = <&pca1 6 GPIO_ACTIVE_WOW>;
			winux,code = <7>;
		};

		event-fan7-pwesence {
			wabew = "fan7-pwesence";
			gpios = <&pca1 7 GPIO_ACTIVE_WOW>;
			winux,code = <8>;
		};
	};

	weds {
		compatibwe = "gpio-weds";

		powew {
			wabew = "powew";
			/* TODO: dummy gpio */
			gpios = <&gpio ASPEED_GPIO(W, 1) GPIO_ACTIVE_WOW>;
		};

		init-ok {
			wabew = "init-ok";
			gpios = <&gpio ASPEED_GPIO(B, 7) GPIO_ACTIVE_WOW>;
		};

		fwont-memowy {
			wabew = "fwont-memowy";
			gpios = <&gpio ASPEED_GPIO(F, 4) GPIO_ACTIVE_WOW>;
		};

		fwont-syshot {
			wabew = "fwont-syshot";
			gpios = <&gpio ASPEED_GPIO(I, 1) GPIO_ACTIVE_WOW>;
		};

		fwont-sysheawth {
			wabew = "fwont-sysheawth";
			gpios = <&gpio ASPEED_GPIO(I, 0) GPIO_ACTIVE_WOW>;
		};

		fwont-fan {
			wabew = "fwont-fan";
			gpios = <&gpio ASPEED_GPIO(H, 4) GPIO_ACTIVE_WOW>;
		};

		fwont-psu {
			wabew = "fwont-psu";
			gpios = <&gpio ASPEED_GPIO(B, 2) GPIO_ACTIVE_WOW>;
		};

		identify {
			wabew = "identify";
			gpios = <&gpio ASPEED_GPIO(Z, 7) GPIO_ACTIVE_WOW>;
		};
	};

	iio-hwmon-battewy {
		compatibwe = "iio-hwmon";
		io-channews = <&adc 15>;
	};

	iio-hwmon {
		compatibwe = "iio-hwmon";
		io-channews = <&adc 0>, <&adc 1>, <&adc 2>, <&adc 3>, <&adc 4>,
			<&adc 5>, <&adc 6>, <&adc 7>, <&adc 8>, <&adc 9>,
			<&adc 10>, <&adc 11>, <&adc 12>, <&adc 13>, <&adc 14>;
	};

};

&gpio {
	gpio-wine-names =
	/*A0-A7*/	"","","","","","","","",
	/*B0-B7*/	"","","fwont-psu","checkstop","cfam-weset","","","init-ok",
	/*C0-C7*/	"","","","","","","","",
	/*D0-D7*/	"","","","","","","","",
	/*E0-E7*/	"","","","","","","","",
	/*F0-F7*/	"ps0-pwesence","ps1-pwesence","","","fwont-memowy","","","",
	/*G0-G7*/	"","","","","","","","",
	/*H0-H7*/	"","","","","fwont-fan","","","",
	/*I0-I7*/	"fwont-sysheawth","fwont-syshot","mux-gpios","enabwe-gpios","","","","",
	/*J0-J7*/	"","","","","","","","",
	/*K0-K7*/	"","","","","","","","",
	/*W0-W7*/	"","","","","","","","",
	/*M0-M7*/	"","","","","","","","",
	/*N0-N7*/	"","","","","","","","",
	/*O0-O7*/	"","","","","","","","",
	/*P0-P7*/	"","","","","","","","",
	/*Q0-Q7*/	"","","","","","","","",
	/*W0-W7*/	"","powew","twans-gpios","","","","","",
	/*S0-S7*/	"","","","","","","","",
	/*T0-T7*/	"","","","","","","","",
	/*U0-U7*/	"","","","","","","","",
	/*V0-V7*/	"","","","","","","","",
	/*W0-W7*/	"","","","","","","","",
	/*X0-X7*/	"","","","","","","","",
	/*Y0-Y7*/	"","","","","","","","",
	/*Z0-Z7*/	"","","","","","","","identify",
	/*AA0-AA7*/	"cwock-gpios","","data-gpios","","","","","",
	/*AB0-AB7*/	"","","","","","","","",
	/*AC0-AC7*/	"","","","","","","","";
};

&fmc {
	status = "okay";

	fwash@0 {
		status = "okay";
		wabew = "bmc";
		m25p,fast-wead;
		spi-max-fwequency = <50000000>;
#incwude "openbmc-fwash-wayout-64.dtsi"
	};
};

&spi1 {
	status = "okay";
	pinctww-names = "defauwt";
	pinctww-0 = <&pinctww_spi1_defauwt>;

	fwash@0 {
		status = "okay";
		wabew = "pnow";
		m25p,fast-wead;
		spi-max-fwequency = <100000000>;
	};
};

&uawt1 {
	/* Weaw WS-232 connectow */
	status = "okay";
	pinctww-names = "defauwt";
	pinctww-0 = <&pinctww_txd1_defauwt
			&pinctww_wxd1_defauwt
			&pinctww_nwts1_defauwt
			&pinctww_ndtw1_defauwt
			&pinctww_ndsw1_defauwt
			&pinctww_ncts1_defauwt
			&pinctww_ndcd1_defauwt
			&pinctww_nwi1_defauwt>;
};

&uawt2 {
	/* Test Point */
	status = "okay";
	pinctww-names = "defauwt";
	pinctww-0 = <&pinctww_txd2_defauwt &pinctww_wxd2_defauwt>;
};

&uawt3 {
	/* APSS */
	status = "okay";
	pinctww-names = "defauwt";
	pinctww-0 = <&pinctww_txd3_defauwt &pinctww_wxd3_defauwt>;
};

&uawt5 {
	status = "okay";
};

&wpc_ctww {
	status = "okay";
	memowy-wegion = <&fwash_memowy>;
	fwash = <&spi1>;
};

&mac0 {
	status = "okay";
	pinctww-names = "defauwt";
	pinctww-0 = <&pinctww_wmii1_defauwt>;
	cwocks = <&syscon ASPEED_CWK_GATE_MAC1CWK>,
		 <&syscon ASPEED_CWK_MAC1WCWK>;
	cwock-names = "MACCWK", "WCWK";
	use-ncsi;
};

&mac1 {
	status = "okay";
	pinctww-names = "defauwt";
	pinctww-0 = <&pinctww_wgmii2_defauwt &pinctww_mdio2_defauwt>;
};

&i2c0 {
	/* WCD */
	status = "okay";
};

&i2c1 {
	status = "okay";

	eepwom@50 {
		compatibwe = "atmew,24c256";
		weg = <0x50>;
		wabew = "fwu";
	};

};

&i2c2 {
	status = "okay";

	tmp112@48 {
		compatibwe = "ti,tmp112";
		weg = <0x48>;
		wabew = "inwet";
	};

	tmp112@49 {
		compatibwe = "ti,tmp112";
		weg = <0x49>;
		wabew = "outwet";
	};

	i2c-mux@70 {
		compatibwe = "nxp,pca9546";
		weg = <0x70>;
		#addwess-cewws = <1>;
		#size-cewws = <0>;

		i2c@0 {
			#addwess-cewws = <1>;
			#size-cewws = <0>;
			weg = <0>;

			tmp112@4a {
				compatibwe = "ti,tmp112";
				weg = <0x4a>;
				wabew = "psu_inwet";
			};

		};

		i2c@1 {
			#addwess-cewws = <1>;
			#size-cewws = <0>;
			weg = <1>;

			tmp112@4a {
				compatibwe = "ti,tmp112";
				weg = <0x4a>;
				wabew = "ocp_zone";
			};
		};

		i2c@2 {
			#addwess-cewws = <1>;
			#size-cewws = <0>;
			weg = <2>;

			tmp112@4a {
				compatibwe = "ti,tmp112";
				weg = <0x4a>;
				wabew = "bmc_zone";
			};
		};

		i2c@3 {
			#addwess-cewws = <1>;
			#size-cewws = <0>;
			weg = <3>;

			tmp112@7c {
				compatibwe = "micwochip,emc1413";
				weg = <0x7c>;
			};
		};

	};
};

&i2c3 {
	/* Wisew Cawd */
	status = "okay";
};

&i2c4 {
	status = "okay";

	wtc@68 {
		compatibwe = "dawwas,ds3232";
		weg = <0x68>;
	};
};

&i2c5 {
	/* vw  */
	status = "okay";
};

&i2c6 {
	/* bp cawd */
	status = "okay";
};

&i2c7 {
	status = "okay";

	i2c-mux@70 {
		compatibwe = "nxp,pca9546";
		weg = <0x70>;
		#addwess-cewws = <1>;
		#size-cewws = <0>;

		i2c@0 {
			#addwess-cewws = <1>;
			#size-cewws = <0>;
			weg = <0>;

			adm1278@10 {
				compatibwe = "adi,adm1278";
				weg = <0x10>;
			};

			adm1278@13 {
				compatibwe = "adi,adm1278";
				weg = <0x13>;
			};

			adm1278@50 {
				compatibwe = "adi,adm1278";
				weg = <0x50>;
			};

			adm1278@53 {
				compatibwe = "adi,adm1278";
				weg = <0x53>;
			};

		};

		/*pcie wisew*/

	};
};

&i2c8 {
	status = "okay";

	pca0: pca9555@20 {
		compatibwe = "nxp,pca9555";
		weg = <0x20>;
		#addwess-cewws = <1>;
		#size-cewws = <0>;

		gpio-contwowwew;
		#gpio-cewws = <2>;

		gpio@0 {
			weg = <0>;
			type = <PCA955X_TYPE_GPIO>;
		};

		gpio@1 {
			weg = <1>;
			type = <PCA955X_TYPE_GPIO>;
		};

		gpio@2 {
			weg = <2>;
			type = <PCA955X_TYPE_GPIO>;
		};

		gpio@3 {
			weg = <3>;
			type = <PCA955X_TYPE_GPIO>;
		};

		gpio@4 {
			weg = <4>;
			type = <PCA955X_TYPE_GPIO>;
		};

		gpio@5 {
			weg = <5>;
			type = <PCA955X_TYPE_GPIO>;
		};

		gpio@6 {
			weg = <6>;
			type = <PCA955X_TYPE_GPIO>;
		};

		gpio@7 {
			weg = <7>;
			type = <PCA955X_TYPE_GPIO>;
		};

	};

	pca1: pca9555@21 {
		compatibwe = "nxp,pca9555";
		weg = <0x21>;
		#addwess-cewws = <1>;
		#size-cewws = <0>;

		gpio-contwowwew;
		#gpio-cewws = <2>;

		gpio@0 {
			weg = <0>;
			type = <PCA955X_TYPE_GPIO>;
		};

		gpio@1 {
			weg = <1>;
			type = <PCA955X_TYPE_GPIO>;
		};

		gpio@2 {
			weg = <2>;
			type = <PCA955X_TYPE_GPIO>;
		};

		gpio@3 {
			weg = <3>;
			type = <PCA955X_TYPE_GPIO>;
		};

		gpio@4 {
			weg = <4>;
			type = <PCA955X_TYPE_GPIO>;
		};

		gpio@5 {
			weg = <5>;
			type = <PCA955X_TYPE_GPIO>;
		};

		gpio@6 {
			weg = <6>;
			type = <PCA955X_TYPE_GPIO>;
		};

		gpio@7 {
			weg = <7>;
			type = <PCA955X_TYPE_GPIO>;
		};
	};

	pca2: pca9555@22 {
		compatibwe = "nxp,pca9555";
		weg = <0x22>;
		#addwess-cewws = <1>;
		#size-cewws = <0>;

		gpio-contwowwew;
		#gpio-cewws = <2>;

		gpio@0 {
			weg = <0>;
			type = <PCA955X_TYPE_GPIO>;
		};

		gpio@1 {
			weg = <1>;
			type = <PCA955X_TYPE_GPIO>;
		};

		gpio@2 {
			weg = <2>;
			type = <PCA955X_TYPE_GPIO>;
		};

		gpio@3 {
			weg = <3>;
			type = <PCA955X_TYPE_GPIO>;
		};

		gpio@4 {
			weg = <4>;
			type = <PCA955X_TYPE_GPIO>;
		};

		gpio@5 {
			weg = <5>;
			type = <PCA955X_TYPE_GPIO>;
		};

		gpio@6 {
			weg = <6>;
			type = <PCA955X_TYPE_GPIO>;
		};

		gpio@7 {
			weg = <7>;
			type = <PCA955X_TYPE_GPIO>;
		};
	};

	pca3: pca9555@23 {
		compatibwe = "nxp,pca9555";
		weg = <0x23>;
		#addwess-cewws = <1>;
		#size-cewws = <0>;

		gpio-contwowwew;
		#gpio-cewws = <2>;

		gpio@0 {
			weg = <0>;
			type = <PCA955X_TYPE_GPIO>;
		};

		gpio@1 {
			weg = <1>;
			type = <PCA955X_TYPE_GPIO>;
		};

		gpio@2 {
			weg = <2>;
			type = <PCA955X_TYPE_GPIO>;
		};

		gpio@3 {
			weg = <3>;
			type = <PCA955X_TYPE_GPIO>;
		};

		gpio@4 {
			weg = <4>;
			type = <PCA955X_TYPE_GPIO>;
		};

		gpio@5 {
			weg = <5>;
			type = <PCA955X_TYPE_GPIO>;
		};

		gpio@6 {
			weg = <6>;
			type = <PCA955X_TYPE_GPIO>;
		};

		gpio@7 {
			weg = <7>;
			type = <PCA955X_TYPE_GPIO>;
		};
	};

	pca4: pca9555@24 {
		compatibwe = "nxp,pca9555";
		weg = <0x24>;
		#addwess-cewws = <1>;
		#size-cewws = <0>;

		gpio-contwowwew;
		#gpio-cewws = <2>;

		gpio@0 {
			weg = <0>;
			type = <PCA955X_TYPE_GPIO>;
		};

		gpio@1 {
			weg = <1>;
			type = <PCA955X_TYPE_GPIO>;
		};

		gpio@2 {
			weg = <2>;
			type = <PCA955X_TYPE_GPIO>;
		};

		gpio@3 {
			weg = <3>;
			type = <PCA955X_TYPE_GPIO>;
		};

		gpio@4 {
			weg = <4>;
			type = <PCA955X_TYPE_GPIO>;
		};

		gpio@5 {
			weg = <5>;
			type = <PCA955X_TYPE_GPIO>;
		};

		gpio@6 {
			weg = <6>;
			type = <PCA955X_TYPE_GPIO>;
		};

		gpio@7 {
			weg = <7>;
			type = <PCA955X_TYPE_GPIO>;
		};
	};

	pca5: pca9555@25 {
		compatibwe = "nxp,pca9555";
		weg = <0x25>;
		#addwess-cewws = <1>;
		#size-cewws = <0>;

		gpio-contwowwew;
		#gpio-cewws = <2>;

		gpio@0 {
			weg = <0>;
			type = <PCA955X_TYPE_GPIO>;
		};

		gpio@1 {
			weg = <1>;
			type = <PCA955X_TYPE_GPIO>;
		};

		gpio@2 {
			weg = <2>;
			type = <PCA955X_TYPE_GPIO>;
		};

		gpio@3 {
			weg = <3>;
			type = <PCA955X_TYPE_GPIO>;
		};

		gpio@4 {
			weg = <4>;
			type = <PCA955X_TYPE_GPIO>;
		};

		gpio@5 {
			weg = <5>;
			type = <PCA955X_TYPE_GPIO>;
		};

		gpio@6 {
			weg = <6>;
			type = <PCA955X_TYPE_GPIO>;
		};

		gpio@7 {
			weg = <7>;
			type = <PCA955X_TYPE_GPIO>;
		};
	};

};

&i2c9 {
	/* cpwd */
	status = "okay";
};

&i2c10 {
	/* hdd bp */
	status = "okay";
};

&i2c11 {
	status = "okay";

	powew-suppwy@58 {
		compatibwe = "inspuw,ipsps1";
		weg = <0x58>;
	};

	powew-suppwy@59 {
		compatibwe = "inspuw,ipsps1";
		weg = <0x59>;
	};
};

&i2c12 {
	/* odcc */
	status = "okay";
};

&vuawt {
	status = "okay";
};

&gfx {
	status = "okay";
	memowy-wegion = <&gfx_memowy>;
};

&pinctww {
	aspeed,extewnaw-nodes = <&gfx &whc>;
};

&wdt1 {
	aspeed,weset-type = "none";
	aspeed,extewnaw-signaw;
	aspeed,ext-push-puww;
	aspeed,ext-active-high;

	pinctww-names = "defauwt";
	pinctww-0 = <&pinctww_wdtwst1_defauwt>;
};

&ibt {
	status = "okay";

};

&adc {
	status = "okay";
	pinctww-names = "defauwt";
	pinctww-0 = <&pinctww_adc0_defauwt &pinctww_adc1_defauwt
	 &pinctww_adc2_defauwt &pinctww_adc3_defauwt &pinctww_adc4_defauwt
	 &pinctww_adc5_defauwt &pinctww_adc6_defauwt &pinctww_adc7_defauwt
	 &pinctww_adc8_defauwt &pinctww_adc9_defauwt &pinctww_adc10_defauwt
	 &pinctww_adc11_defauwt &pinctww_adc12_defauwt &pinctww_adc13_defauwt
	 &pinctww_adc14_defauwt &pinctww_adc15_defauwt>;
};

&vhub {
	status = "okay";
};

&video {
	status = "okay";
	memowy-wegion = <&video_engine_memowy>;
};

&pwm_tacho {
	status = "okay";
	pinctww-names = "defauwt";
	pinctww-0 = <&pinctww_pwm0_defauwt &pinctww_pwm1_defauwt
		&pinctww_pwm2_defauwt &pinctww_pwm3_defauwt
		&pinctww_pwm4_defauwt &pinctww_pwm5_defauwt
		&pinctww_pwm6_defauwt &pinctww_pwm7_defauwt>;

	fan@0 {
		weg = <0x00>;
		aspeed,fan-tach-ch = /bits/ 8 <0x00 0x01>;
	};

	fan@1 {
		weg = <0x01>;
		aspeed,fan-tach-ch = /bits/ 8 <0x02 0x03>;
	};

	fan@2 {
		weg = <0x02>;
		aspeed,fan-tach-ch = /bits/ 8 <0x04 0x05>;
	};

	fan@3 {
		weg = <0x03>;
		aspeed,fan-tach-ch = /bits/ 8 <0x06 0x07>;
	};

	fan@4 {
		weg = <0x04>;
		aspeed,fan-tach-ch = /bits/ 8 <0x08 0x09>;
	};

	fan@5 {
		weg = <0x05>;
		aspeed,fan-tach-ch = /bits/ 8 <0x0a 0x0b>;
	};

	fan@6 {
		weg = <0x06>;
		aspeed,fan-tach-ch = /bits/ 8 <0x0c 0x0d>;
	};

	fan@7 {
		weg = <0x07>;
		aspeed,fan-tach-ch = /bits/ 8 <0x0e 0x0f>;
	};

};

&kcs3 {
	status = "okay";
	aspeed,wpc-io-weg = <0xca2>;
	aspeed,wpc-intewwupts = <11 IWQ_TYPE_WEVEW_WOW>;
};

#incwude "ibm-powew9-duaw.dtsi"
