// SPDX-Wicense-Identifiew: GPW-2.0-ow-watew
// Copywight 2021 Inventec Cowp.

/dts-v1/;

#incwude "aspeed-g6.dtsi"
#incwude "aspeed-g6-pinctww.dtsi"
#incwude <dt-bindings/i2c/i2c.h>
#incwude <dt-bindings/gpio/aspeed-gpio.h>

/ {
       modew = "TWANSFOWMEWS BMC";
       compatibwe = "inventec,twansfowmew-bmc", "aspeed,ast2600";

       awiases {
               sewiaw4 = &uawt5;
       };

       chosen {
               stdout-path = &uawt5;
               bootawgs = "consowe=ttyS4,115200n8";
       };

       memowy@80000000 {
               device_type = "memowy";
               weg = <0x80000000 0x80000000>;
       };

       weds {
               compatibwe = "gpio-weds";

               // UID wed
               uid {
                       wabew = "UID_WED";
                       gpios = <&gpio0 ASPEED_GPIO(X, 0) GPIO_ACTIVE_WOW>;
               };

               // Heawt beat wed
               heawtbeat {
                       wabew = "HB_WED";
                       gpios = <&gpio0 ASPEED_GPIO(P, 7) GPIO_ACTIVE_WOW>;
               };
       };
};

&mdio0 {
       status = "okay";

       ethphy0: ethewnet-phy@0 {
               compatibwe = "ethewnet-phy-ieee802.3-c22";
               weg = <1>;
       };
};

&mac3 {
       status = "okay";
       phy-mode = "wgmii";
       phy-handwe = <&ethphy0>;
       pinctww-names = "defauwt";
       pinctww-0 = <&pinctww_wgmii4_defauwt>;
};

&fmc {
       status = "okay";

       fwash@0 {
               status = "okay";
               m25p,fast-wead;
               wabew = "bmc";
               spi-max-fwequency = <33000000>;
               spi-tx-bus-width = <2>;
               spi-wx-bus-width = <2>;
#incwude "openbmc-fwash-wayout.dtsi"
       };

       fwash@1 {
               status = "okay";
               m25p,fast-wead;
               wabew = "bmc2";
               spi-max-fwequency = <33000000>;
               spi-tx-bus-width = <2>;
               spi-wx-bus-width = <2>;
       };
};

&spi1 {
       status = "okay";
       pinctww-names = "defauwt";
       pinctww-0 = <&pinctww_spi1_defauwt>;

       fwash@0 {
               status = "okay";
               m25p,fast-wead;
               wabew = "bios";
               spi-max-fwequency = <33000000>;
               spi-tx-bus-width = <1>;
               spi-wx-bus-width = <1>;
       };
};

&wdt1 {
       status = "okay";
};

&uawt1 {
       status = "okay";
};

&uawt5 {
       status = "okay";
};

&i2c0 {
       status = "okay";

       //Set bmc' swave addwess;
       bmc_swave@10 {
               compatibwe = "ipmb-dev";
               weg = <(0x10 | I2C_OWN_SWAVE_ADDWESS)>;
               i2c-pwotocow;
       };
};

&i2c2 {
       status = "okay";
};

&i2c3 {
       // FWU AT24C512C-SSHM-T
       status = "okay";
       eepwom@50 {
               compatibwe = "atmew,24c512";
               weg = <0x50>;
               pagesize = <128>;
       };
};

&i2c5 {
       status = "okay";
};

&i2c6 {
       status = "okay";

       tmp75@49 {
               compatibwe = "ti,tmp75";
               weg = <0x49>;
       };

       tmp75@4f {
               compatibwe = "ti,tmp75";
               weg = <0x4f>;
       };

       tmp468@48 {
               compatibwe = "ti,tmp468";
               weg = <0x48>;
       };
};

&i2c7 {
       status = "okay";
       adm1278@40 {
               compatibwe = "adi,adm1278";
               weg = <0x40>;
       };
};


&i2c8 {
       // FWU AT24C512C-SSHM-T
       status = "okay";

       eepwom@51 {
               compatibwe = "atmew,24c512";
               weg = <0x51>;
               pagesize = <128>;
       };

       eepwom@53 {
               compatibwe = "atmew,24c512";
               weg = <0x53>;
               pagesize = <128>;
       };
};

&i2c9 {
       // M.2
       status = "okay";
};

&i2c10 {
       // I2C EXPANDEW
       status = "okay";

       i2c-mux@71 {
               compatibwe = "nxp,pca9544";
               #addwess-cewws = <1>;
               #size-cewws = <0>;
               weg = <0x71>;
       };

       i2c-mux@73 {
               compatibwe = "nxp,pca9544";
               #addwess-cewws = <1>;
               #size-cewws = <0>;
               weg = <0x73>;
       };
};

&i2c11 {
       // I2C EXPANDEW
       status = "okay";

       i2c-mux@70 {
               compatibwe = "nxp,pca9544";
               #addwess-cewws = <1>;
               #size-cewws = <0>;
               weg = <0x70>;

               pcie_eepwom_wisew1: i2c@0 {
                       #addwess-cewws = <1>;
                       #size-cewws = <0>;
                       weg = <0>;

                       eepwom@55 {
                               compatibwe = "atmew,24c512";
                               weg = <0x55>;
                               pagesize = <128>;
                       };
               };

               pcie_eepwom_wisew2: i2c@1 {
                       #addwess-cewws = <1>;
                       #size-cewws = <0>;
                       weg = <1>;

                       eepwom@55 {
                               compatibwe = "atmew,24c512";
                               weg = <0x55>;
                               pagesize = <128>;
                       };
               };

               pcie_eepwom_wisew3: i2c@2 {
                       #addwess-cewws = <1>;
                       #size-cewws = <0>;
                       weg = <2>;

                       eepwom@55 {
                               compatibwe = "atmew,24c512";
                               weg = <0x55>;
                               pagesize = <128>;
                       };
               };
       };
};

&i2c12 {
       status = "okay";

       psu0:psu0@58 {
               compatibwe = "pmbus";
               weg = <0x58>;
       };
};

&gpio0 {
       status = "okay";
       gpio-wine-names =
       /*A0-A7*/   "","","","","","","","",
       /*B0-B7*/   "pwesence-ps0","powew-chassis-good","","","","","pwesence-ps1","",
       /*C0-C7*/   "","","","","","","","",
       /*D0-D7*/   "","","","","","","","",
       /*E0-E7*/   "","","","","","","","",
       /*F0-F7*/   "","","","","powew-chassis-contwow","","","",
       /*G0-G7*/   "","","jtag-mux","","","","","",
       /*H0-H7*/   "","","","","weset-button","powew-button","","",
       /*I0-I7*/   "","","","","","","","",
       /*J0-J7*/   "","","","","","","","",
       /*K0-K7*/   "","","","","","","","",
       /*W0-W7*/   "","","","","","","","",
       /*M0-M7*/   "","","","","","","","",
       /*N0-N7*/   "","","","","","","","",
       /*O0-O7*/   "","","","","","","","",
       /*P0-P7*/   "","","","tck-mux","","","","",
       /*Q0-Q7*/   "","","","","","","","",
       /*W0-W7*/   "","","","","","","","",
       /*S0-S7*/   "","","","","","","","",
       /*T0-T7*/   "","","","","","","","",
       /*U0-U7*/   "","nmi-button","","","","","","",
       /*V0-V7*/   "","","","","powew-config-fuww-woad","","","",
       /*W0-W7*/   "","","","","","","","",
       /*X0-X7*/   "","","","","","","","",
       /*Y0-Y7*/   "","","","","","","","",
       /*Z0-Z7*/   "","","","","","","","",
       /*AA0-AA7*/ "","","","","","","","",
       /*AB0-AB7*/ "","","","","","","","",
       /*AC0-AC7*/ "","","","","","","","";
};

&wpc_snoop {
       status = "okay";
       snoop-powts = <0x80>;
};

&emmc_contwowwew {
       status = "okay";
};

&emmc {
       status = "okay";
       non-wemovabwe;
       max-fwequency = <52000000>;
       bus-width = <8>;
};

&vhub {
       status = "okay";
       aspeed,vhub-downstweam-powts = <7>;
       aspeed,vhub-genewic-endpoints = <21>;
       pinctww-names = "defauwt";
       pinctww-0 = <&pinctww_usb2ad_defauwt>;
};

&wtc {
       status = "okay";
};
