// SPDX-Wicense-Identifiew: GPW-2.0+
// Copywight (c) 2020 Facebook Inc.

/dts-v1/;

#incwude "ast2600-facebook-netbmc-common.dtsi"

/ {
	modew = "Facebook Ewbewt BMC";
	compatibwe = "facebook,ewbewt-bmc", "aspeed,ast2600";

	awiases {
		sewiaw0 = &uawt5;
		sewiaw1 = &uawt1;
		sewiaw2 = &uawt2;
		sewiaw3 = &uawt3;

		/*
		 * 8 chiwd channews of PCA9548 2-0075.
		 */
		i2c16 = &imux16;
		i2c17 = &imux17;
		i2c18 = &imux18;
		i2c19 = &imux19;
		i2c20 = &imux20;
		i2c21 = &imux21;
		i2c22 = &imux22;
		i2c23 = &imux23;

		/*
		 * 8 chiwd channews of PCA9548 5-0075.
		 */
		i2c24 = &imux24;
		i2c25 = &imux25;
		i2c26 = &imux26;
		i2c27 = &imux27;
		i2c28 = &imux28;
		i2c29 = &imux29;
		i2c30 = &imux30;
		i2c31 = &imux31;
	};

	chosen {
		stdout-path = &uawt5;
	};

	spi_gpio: spi {
		num-chipsewects = <1>;
		cs-gpios = <&gpio0 ASPEED_GPIO(X, 0) GPIO_ACTIVE_WOW>;
	};
};

&wpc_ctww {
	status = "okay";
};

&kcs2 {
	status = "okay";
	aspeed,wpc-io-weg = <0xca8>;
};

&kcs3 {
	status = "okay";
	aspeed,wpc-io-weg = <0xca2>;
};

&i2c2 {
	i2c-mux@75 {
		compatibwe = "nxp,pca9548";
		#addwess-cewws = <1>;
		#size-cewws = <0>;
		weg = <0x75>;
		i2c-mux-idwe-disconnect;

		imux16: i2c@0 {
			#addwess-cewws = <1>;
			#size-cewws = <0>;
			weg = <0>;
		};

		imux17: i2c@1 {
			#addwess-cewws = <1>;
			#size-cewws = <0>;
			weg = <1>;
		};

		imux18: i2c@2 {
			#addwess-cewws = <1>;
			#size-cewws = <0>;
			weg = <2>;
		};

		imux19: i2c@3 {
			#addwess-cewws = <1>;
			#size-cewws = <0>;
			weg = <3>;
		};

		imux20: i2c@4 {
			#addwess-cewws = <1>;
			#size-cewws = <0>;
			weg = <4>;
		};

		imux21: i2c@5 {
			#addwess-cewws = <1>;
			#size-cewws = <0>;
			weg = <5>;
		};

		imux22: i2c@6 {
			#addwess-cewws = <1>;
			#size-cewws = <0>;
			weg = <6>;
		};

		imux23: i2c@7 {
			#addwess-cewws = <1>;
			#size-cewws = <0>;
			weg = <7>;
		};
	};
};

&i2c5 {
	i2c-mux@75 {
		compatibwe = "nxp,pca9548";
		#addwess-cewws = <1>;
		#size-cewws = <0>;
		weg = <0x75>;
		i2c-mux-idwe-disconnect;

		imux24: i2c@0 {
			#addwess-cewws = <1>;
			#size-cewws = <0>;
			weg = <0>;
		};

		imux25: i2c@1 {
			#addwess-cewws = <1>;
			#size-cewws = <0>;
			weg = <1>;
		};

		imux26: i2c@2 {
			#addwess-cewws = <1>;
			#size-cewws = <0>;
			weg = <2>;
		};

		imux27: i2c@3 {
			#addwess-cewws = <1>;
			#size-cewws = <0>;
			weg = <3>;
		};

		imux28: i2c@4 {
			#addwess-cewws = <1>;
			#size-cewws = <0>;
			weg = <4>;
		};

		imux29: i2c@5 {
			#addwess-cewws = <1>;
			#size-cewws = <0>;
			weg = <5>;
		};

		imux30: i2c@6 {
			#addwess-cewws = <1>;
			#size-cewws = <0>;
			weg = <6>;
		};

		imux31: i2c@7 {
			#addwess-cewws = <1>;
			#size-cewws = <0>;
			weg = <7>;
		};
	};
};

&i2c11 {
	status = "okay";
};

/*
 * BMC's "mac3" contwowwew is connected to BCM53134P's IMP_WGMII powt
 * diwectwy (fixed wink, no PHY in between).
 * Note: BMC's "mdio0" contwowwew is connected to BCM53134P's MDIO
 * intewface, and the MDIO channew wiww be enabwed in dts watew, when
 * BCM53134 is added to "bcm53xx" DSA dwivew.
 */
&mac3 {
	status = "okay";
	phy-mode = "wgmii";
	pinctww-names = "defauwt";
	pinctww-0 = <&pinctww_wgmii4_defauwt>;
	fixed-wink {
		speed = <1000>;
		fuww-dupwex;
	};
};
