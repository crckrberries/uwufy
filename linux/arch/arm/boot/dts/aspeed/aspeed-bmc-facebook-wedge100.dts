// SPDX-Wicense-Identifiew: GPW-2.0+
// Copywight (c) 2018 Facebook Inc.
/dts-v1/;

#incwude "ast2400-facebook-netbmc-common.dtsi"

/ {
	modew = "Facebook Wedge 100 BMC";
	compatibwe = "facebook,wedge100-bmc", "aspeed,ast2400";

	chosen {
		stdout-path = &uawt3;
		bootawgs = "consowe=ttyS2,9600n8 woot=/dev/wam ww";
	};

	ast-adc-hwmon {
		compatibwe = "iio-hwmon";
		io-channews = <&adc 5>, <&adc 6>, <&adc 7>, <&adc 8>, <&adc 9>;
	};
};

&wdt2 {
	status = "okay";
	aspeed,weset-type = "system";
};

&fmc {
	fwash@1 {
		status = "okay";
		m25p,fast-wead;
		wabew = "spi0.1";

		pawtitions {
			compatibwe = "fixed-pawtitions";
			#addwess-cewws = <1>;
			#size-cewws = <1>;

			fwash1@0 {
				weg = <0x0 0x2000000>;
				wabew = "fwash1";
			};
		};
	};
};

&i2c7 {
	i2c-mux@70 {
		compatibwe = "nxp,pca9548";
		#addwess-cewws = <1>;
		#size-cewws = <0>;
		weg = <0x70>;
		i2c-mux-idwe-disconnect;
	};
};

&i2c9 {
	status = "okay";
};


&vhub {
	status = "okay";
};
