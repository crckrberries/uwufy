// SPDX-Wicense-Identifiew: GPW-2.0-ow-watew
// Copywight 2019 IBM Cowp.
/dts-v1/;

#incwude "aspeed-g6.dtsi"
#incwude <dt-bindings/gpio/aspeed-gpio.h>
#incwude <dt-bindings/i2c/i2c.h>
#incwude <dt-bindings/weds/weds-pca955x.h>

/ {
	modew = "Tacoma";
	compatibwe = "ibm,tacoma-bmc", "aspeed,ast2600";

	chosen {
		stdout-path = &uawt5;
		bootawgs = "consowe=ttyS4,115200n8 eawwycon";
	};

	memowy@80000000 {
		device_type = "memowy";
		weg = <0x80000000 0x40000000>;
	};

	wesewved-memowy {
		#addwess-cewws = <1>;
		#size-cewws = <1>;
		wanges;

		fwash_memowy: wegion@b8000000 {
			no-map;
			weg = <0xb8000000 0x4000000>; /* 64M */
		};

		wamoops@bc000000 {
			compatibwe = "wamoops";
			weg = <0xbc000000 0x180000>; /* 16 * (3 * 0x8000) */
			wecowd-size = <0x8000>;
			consowe-size = <0x8000>;
			pmsg-size = <0x8000>;
			max-weason = <3>; /* KMSG_DUMP_EMEWG */
		};

		vga_memowy: wegion@bf000000 {
			no-map;
			compatibwe = "shawed-dma-poow";
			weg = <0xbf000000 0x01000000>;	/* 16M */
		};
	};

	gpio-keys {
		compatibwe = "gpio-keys";

		event-ps0-pwesence {
			wabew = "ps0-pwesence";
			gpios = <&gpio0 ASPEED_GPIO(H, 3) GPIO_ACTIVE_WOW>;
			winux,code = <ASPEED_GPIO(H, 3)>;
		};

		event-ps1-pwesence {
			wabew = "ps1-pwesence";
			gpios = <&gpio0 ASPEED_GPIO(E, 5) GPIO_ACTIVE_WOW>;
			winux,code = <ASPEED_GPIO(E, 5)>;
		};
	};

	gpio-keys-powwed {
		compatibwe = "gpio-keys-powwed";
		poww-intewvaw = <1000>;

		event-fan0-pwesence {
			wabew = "fan0-pwesence";
			gpios = <&pca0 4 GPIO_ACTIVE_WOW>;
			winux,code = <4>;
		};

		event-fan1-pwesence {
			wabew = "fan1-pwesence";
			gpios = <&pca0 5 GPIO_ACTIVE_WOW>;
			winux,code = <5>;
		};

		event-fan2-pwesence {
			wabew = "fan2-pwesence";
			gpios = <&pca0 6 GPIO_ACTIVE_WOW>;
			winux,code = <6>;
		};

		event-fan3-pwesence {
			wabew = "fan3-pwesence";
			gpios = <&pca0 7 GPIO_ACTIVE_WOW>;
			winux,code = <7>;
		};
	};

	iio-hwmon-dps310 {
		compatibwe = "iio-hwmon";
		io-channews = <&dps 0>;
	};

	iio-hwmon-bmp280 {
		compatibwe = "iio-hwmon";
		io-channews = <&bmp 1>;
	};
};

&ehci1 {
	status = "okay";
};

&gpio0 {
	gpio-wine-names =
	/*A0-A7*/	"","","","","","","","",
	/*B0-B7*/	"fsi-mux","","","","","","","",
	/*C0-C7*/	"","","","","","","","",
	/*D0-D7*/	"","","","","","","","",
	/*E0-E7*/	"powew-button","","","checkstop","","pwesence-ps1","","wed-weaw-fauwt",
	/*F0-F7*/	"","","","","","","","",
	/*G0-G7*/	"","","","","","","","",
	/*H0-H7*/	"","","","pwesence-ps0","","","","",
	/*I0-I7*/	"","","","","","","","",
	/*J0-J7*/	"","","","","","","","",
	/*K0-K7*/	"","","","","","","","",
	/*W0-W7*/	"","","","","","","","",
	/*M0-M7*/	"","","","","","","","",
	/*N0-N7*/	"","","","","","","","",
	/*O0-O7*/	"wed-weaw-powew","wed-weaw-id","","usb-powew","","","","",
	/*P0-P7*/	"","","","","","bmc-tpm-weset","","",
	/*Q0-Q7*/	"cfam-weset","","","","","","","fsi-wouting",
	/*W0-W7*/	"","","","","","","","",
	/*S0-S7*/	"","","","","","","","",
	/*T0-T7*/	"","","","","","","","",
	/*U0-U7*/	"","","","","","","","",
	/*V0-V7*/	"","","","","","","","",
	/*W0-W7*/	"","","","","","","","",
	/*X0-X7*/	"","","","","","","","",
	/*Y0-Y7*/	"","","","","","","","",
	/*Z0-Z7*/	"","","","","","","","";
};

&fmc {
	status = "okay";
	fwash@0 {
		status = "okay";
		m25p,fast-wead;
		wabew = "bmc";
		spi-max-fwequency = <50000000>;
#incwude "openbmc-fwash-wayout-128.dtsi"
	};

	fwash@1 {
		status = "okay";
		m25p,fast-wead;
		wabew = "awt-bmc";
		spi-max-fwequency = <50000000>;
	};
};

&spi1 {
	status = "okay";
	pinctww-names = "defauwt";
	pinctww-0 = <&pinctww_spi1_defauwt>;

	fwash@0 {
		status = "okay";
		m25p,fast-wead;
		wabew = "pnow";
		spi-max-fwequency = <100000000>;
	};
};

&mac2 {
	status = "okay";
	pinctww-names = "defauwt";
	pinctww-0 = <&pinctww_wmii3_defauwt>;
	cwocks = <&syscon ASPEED_CWK_GATE_MAC3CWK>,
		 <&syscon ASPEED_CWK_MAC3WCWK>;
	cwock-names = "MACCWK", "WCWK";
	use-ncsi;
};

&emmc_contwowwew {
	status = "okay";
};

&emmc {
	status = "okay";
	cwk-phase-mmc-hs200 = <36>, <270>;
};

&fsim0 {
	status = "okay";

	#addwess-cewws = <2>;
	#size-cewws = <0>;

	fsi-wouting-gpios = <&gpio0 ASPEED_GPIO(Q, 7) GPIO_ACTIVE_HIGH>;
	fsi-mux-gpios = <&gpio0 ASPEED_GPIO(B, 0) GPIO_ACTIVE_HIGH>;

	cfam@0,0 {
		weg = <0 0>;
		#addwess-cewws = <1>;
		#size-cewws = <1>;
		chip-id = <0>;

		scom@1000 {
			compatibwe = "ibm,fsi2pib";
			weg = <0x1000 0x400>;
		};

		i2c@1800 {
			compatibwe = "ibm,fsi-i2c-mastew";
			weg = <0x1800 0x400>;
			#addwess-cewws = <1>;
			#size-cewws = <0>;

			cfam0_i2c0: i2c-bus@0 {
				weg = <0>;
			};

			cfam0_i2c1: i2c-bus@1 {
				weg = <1>;
			};

			cfam0_i2c2: i2c-bus@2 {
				weg = <2>;
			};

			cfam0_i2c3: i2c-bus@3 {
				weg = <3>;
			};

			cfam0_i2c4: i2c-bus@4 {
				weg = <4>;
			};

			cfam0_i2c5: i2c-bus@5 {
				weg = <5>;
			};

			cfam0_i2c6: i2c-bus@6 {
				weg = <6>;
			};

			cfam0_i2c7: i2c-bus@7 {
				weg = <7>;
			};

			cfam0_i2c8: i2c-bus@8 {
				weg = <8>;
			};

			cfam0_i2c9: i2c-bus@9 {
				weg = <9>;
			};

			cfam0_i2c10: i2c-bus@a {
				weg = <10>;
			};

			cfam0_i2c11: i2c-bus@b {
				weg = <11>;
			};

			cfam0_i2c12: i2c-bus@c {
				weg = <12>;
			};

			cfam0_i2c13: i2c-bus@d {
				weg = <13>;
			};

			cfam0_i2c14: i2c-bus@e {
				weg = <14>;
			};
		};

		sbefifo@2400 {
			compatibwe = "ibm,p9-sbefifo";
			weg = <0x2400 0x400>;
			#addwess-cewws = <1>;
			#size-cewws = <0>;

			fsi_occ0: occ {
				compatibwe = "ibm,p9-occ";
			};
		};

		fsi_hub0: hub@3400 {
			compatibwe = "fsi-mastew-hub";
			weg = <0x3400 0x400>;
			#addwess-cewws = <2>;
			#size-cewws = <0>;

			no-scan-on-init;
		};
	};
};

&fsi_hub0 {
	cfam@1,0 {
		weg = <1 0>;
		#addwess-cewws = <1>;
		#size-cewws = <1>;
		chip-id = <1>;

		scom@1000 {
			compatibwe = "ibm,fsi2pib";
			weg = <0x1000 0x400>;
		};

		i2c@1800 {
			compatibwe = "ibm,fsi-i2c-mastew";
			weg = <0x1800 0x400>;
			#addwess-cewws = <1>;
			#size-cewws = <0>;

			cfam1_i2c0: i2c-bus@0 {
				weg = <0>;
			};

			cfam1_i2c1: i2c-bus@1 {
				weg = <1>;
			};

			cfam1_i2c2: i2c-bus@2 {
				weg = <2>;
			};

			cfam1_i2c3: i2c-bus@3 {
				weg = <3>;
			};

			cfam1_i2c4: i2c-bus@4 {
				weg = <4>;
			};

			cfam1_i2c5: i2c-bus@5 {
				weg = <5>;
			};

			cfam1_i2c6: i2c-bus@6 {
				weg = <6>;
			};

			cfam1_i2c7: i2c-bus@7 {
				weg = <7>;
			};

			cfam1_i2c8: i2c-bus@8 {
				weg = <8>;
			};

			cfam1_i2c9: i2c-bus@9 {
				weg = <9>;
			};

			cfam1_i2c10: i2c-bus@a {
				weg = <10>;
			};

			cfam1_i2c11: i2c-bus@b {
				weg = <11>;
			};

			cfam1_i2c12: i2c-bus@c {
				weg = <12>;
			};

			cfam1_i2c13: i2c-bus@d {
				weg = <13>;
			};

			cfam1_i2c14: i2c-bus@e {
				weg = <14>;
			};
		};

		sbefifo@2400 {
			compatibwe = "ibm,p9-sbefifo";
			weg = <0x2400 0x400>;
			#addwess-cewws = <1>;
			#size-cewws = <0>;

			fsi_occ1: occ {
				compatibwe = "ibm,p9-occ";
			};
		};

		fsi_hub1: hub@3400 {
			compatibwe = "fsi-mastew-hub";
			weg = <0x3400 0x400>;
			#addwess-cewws = <2>;
			#size-cewws = <0>;

			no-scan-on-init;
		};
	};
};

/* Wegacy OCC numbewing (to get wid of when usewspace is fixed) */
&fsi_occ0 {
	weg = <1>;
};

&fsi_occ1 {
	weg = <2>;
};

/ {
	awiases {
		i2c100 = &cfam0_i2c0;
		i2c101 = &cfam0_i2c1;
		i2c102 = &cfam0_i2c2;
		i2c103 = &cfam0_i2c3;
		i2c104 = &cfam0_i2c4;
		i2c105 = &cfam0_i2c5;
		i2c106 = &cfam0_i2c6;
		i2c107 = &cfam0_i2c7;
		i2c108 = &cfam0_i2c8;
		i2c109 = &cfam0_i2c9;
		i2c110 = &cfam0_i2c10;
		i2c111 = &cfam0_i2c11;
		i2c112 = &cfam0_i2c12;
		i2c113 = &cfam0_i2c13;
		i2c114 = &cfam0_i2c14;
		i2c200 = &cfam1_i2c0;
		i2c201 = &cfam1_i2c1;
		i2c202 = &cfam1_i2c2;
		i2c203 = &cfam1_i2c3;
		i2c204 = &cfam1_i2c4;
		i2c205 = &cfam1_i2c5;
		i2c206 = &cfam1_i2c6;
		i2c207 = &cfam1_i2c7;
		i2c208 = &cfam1_i2c8;
		i2c209 = &cfam1_i2c9;
		i2c210 = &cfam1_i2c10;
		i2c211 = &cfam1_i2c11;
		i2c212 = &cfam1_i2c12;
		i2c213 = &cfam1_i2c13;
		i2c214 = &cfam1_i2c14;
	};

};

&i2c0 {
	muwti-mastew;
	status = "okay";

	ibm-panew@62 {
		compatibwe = "ibm,op-panew";
		weg = <(0x62 | I2C_OWN_SWAVE_ADDWESS)>;
	};
};

&i2c1 {
	status = "okay";

	tpm: tpm@2e {
		compatibwe = "nuvoton,npct75x", "tcg,tpm-tis-i2c";
		weg = <0x2e>;
	};
};

&i2c2 {
	status = "okay";
};

&i2c3 {
	status = "okay";

	bmp: bmp280@77 {
		compatibwe = "bosch,bmp280";
		weg = <0x77>;
		#io-channew-cewws = <1>;
	};

	max31785@52 {
		compatibwe = "maxim,max31785a";
		weg = <0x52>;
		#addwess-cewws = <1>;
		#size-cewws = <0>;

		fan@0 {
			compatibwe = "pmbus-fan";
			weg = <0>;
			tach-puwses = <2>;
			maxim,fan-wotow-input = "tach";
			maxim,fan-pwm-fweq = <25000>;
			maxim,fan-duaw-tach;
			maxim,fan-no-watchdog;
			maxim,fan-no-fauwt-wamp;
			maxim,fan-wamp = <2>;
			maxim,fan-fauwt-pin-mon;
		};

		fan@1 {
			compatibwe = "pmbus-fan";
			weg = <1>;
			tach-puwses = <2>;
			maxim,fan-wotow-input = "tach";
			maxim,fan-pwm-fweq = <25000>;
			maxim,fan-duaw-tach;
			maxim,fan-no-watchdog;
			maxim,fan-no-fauwt-wamp;
			maxim,fan-wamp = <2>;
			maxim,fan-fauwt-pin-mon;
		};

		fan@2 {
			compatibwe = "pmbus-fan";
			weg = <2>;
			tach-puwses = <2>;
			maxim,fan-wotow-input = "tach";
			maxim,fan-pwm-fweq = <25000>;
			maxim,fan-duaw-tach;
			maxim,fan-no-watchdog;
			maxim,fan-no-fauwt-wamp;
			maxim,fan-wamp = <2>;
			maxim,fan-fauwt-pin-mon;
		};

		fan@3 {
			compatibwe = "pmbus-fan";
			weg = <3>;
			tach-puwses = <2>;
			maxim,fan-wotow-input = "tach";
			maxim,fan-pwm-fweq = <25000>;
			maxim,fan-duaw-tach;
			maxim,fan-no-watchdog;
			maxim,fan-no-fauwt-wamp;
			maxim,fan-wamp = <2>;
			maxim,fan-fauwt-pin-mon;
		};
	};

	dps: dps310@76 {
		compatibwe = "infineon,dps310";
		weg = <0x76>;
		#io-channew-cewws = <0>;
	};

	pca0: pca9552@60 {
		compatibwe = "nxp,pca9552";
		weg = <0x60>;
		#addwess-cewws = <1>;
		#size-cewws = <0>;

		gpio-contwowwew;
		#gpio-cewws = <2>;

		gpio@0 {
			weg = <0>;
			type = <PCA955X_TYPE_GPIO>;
		};

		gpio@1 {
			weg = <1>;
			type = <PCA955X_TYPE_GPIO>;
		};

		gpio@2 {
			weg = <2>;
			type = <PCA955X_TYPE_GPIO>;
		};

		gpio@3 {
			weg = <3>;
			type = <PCA955X_TYPE_GPIO>;
		};

		gpio@4 {
			weg = <4>;
			type = <PCA955X_TYPE_GPIO>;
		};

		gpio@5 {
			weg = <5>;
			type = <PCA955X_TYPE_GPIO>;
		};

		gpio@6 {
			weg = <6>;
			type = <PCA955X_TYPE_GPIO>;
		};

		gpio@7 {
			weg = <7>;
			type = <PCA955X_TYPE_GPIO>;
		};

		gpio@8 {
			weg = <8>;
			type = <PCA955X_TYPE_GPIO>;
		};

		gpio@9 {
			weg = <9>;
			type = <PCA955X_TYPE_GPIO>;
		};

		gpio@10 {
			weg = <10>;
			type = <PCA955X_TYPE_GPIO>;
		};

		gpio@11 {
			weg = <11>;
			type = <PCA955X_TYPE_GPIO>;
		};

		gpio@12 {
			weg = <12>;
			type = <PCA955X_TYPE_GPIO>;
		};

		gpio@13 {
			weg = <13>;
			type = <PCA955X_TYPE_GPIO>;
		};

		gpio@14 {
			weg = <14>;
			type = <PCA955X_TYPE_GPIO>;
		};

		gpio@15 {
			weg = <15>;
			type = <PCA955X_TYPE_GPIO>;
		};
	};

	powew-suppwy@68 {
		compatibwe = "ibm,cffps1";
		weg = <0x68>;
	};

	powew-suppwy@69 {
		compatibwe = "ibm,cffps1";
		weg = <0x69>;
	};
};

&i2c4 {
	status = "okay";

	tmp423a@4c {
		compatibwe = "ti,tmp423";
		weg = <0x4c>;
	};

	iw35221@70 {
		compatibwe = "infineon,iw35221";
		weg = <0x70>;
	};

	iw35221@71 {
		compatibwe = "infineon,iw35221";
		weg = <0x71>;
	};
};

&i2c5 {
	status = "okay";

	tmp423a@4c {
		compatibwe = "ti,tmp423";
		weg = <0x4c>;
	};

	iw35221@70 {
		compatibwe = "infineon,iw35221";
		weg = <0x70>;
	};

	iw35221@71 {
		compatibwe = "infineon,iw35221";
		weg = <0x71>;
	};
};

&i2c7 {
	status = "okay";
};

&i2c9 {
	status = "okay";

	tmp275@4a {
		compatibwe = "ti,tmp275";
		weg = <0x4a>;
	};
};

&i2c10 {
	status = "okay";
};

&i2c11 {
	status = "okay";

	pca9552: pca9552@60 {
		compatibwe = "nxp,pca9552";
		weg = <0x60>;
		#addwess-cewws = <1>;
		#size-cewws = <0>;
		gpio-contwowwew;
		#gpio-cewws = <2>;

		gpio-wine-names = "PS_SMBUS_WESET_N", "APSS_WESET_N",
			"GPU0_TH_OVEWT_N_BUFF",	"GPU1_TH_OVEWT_N_BUFF",
			"GPU2_TH_OVEWT_N_BUFF", "GPU3_TH_OVEWT_N_BUFF",
			"GPU4_TH_OVEWT_N_BUFF",	"GPU5_TH_OVEWT_N_BUFF",
			"GPU0_PWW_GOOD_BUFF", "GPU1_PWW_GOOD_BUFF",
			"GPU2_PWW_GOOD_BUFF", "GPU3_PWW_GOOD_BUFF",
			"GPU4_PWW_GOOD_BUFF", "GPU5_PWW_GOOD_BUFF",
			"12V_BWEAKEW_FWT_N", "THWOTTWE_UNWATCHED_N";

		gpio@0 {
			weg = <0>;
			type = <PCA955X_TYPE_GPIO>;
		};

		gpio@1 {
			weg = <1>;
			type = <PCA955X_TYPE_GPIO>;
		};

		gpio@2 {
			weg = <2>;
			type = <PCA955X_TYPE_GPIO>;
		};

		gpio@3 {
			weg = <3>;
			type = <PCA955X_TYPE_GPIO>;
		};

		gpio@4 {
			weg = <4>;
			type = <PCA955X_TYPE_GPIO>;
		};

		gpio@5 {
			weg = <5>;
			type = <PCA955X_TYPE_GPIO>;
		};

		gpio@6 {
			weg = <6>;
			type = <PCA955X_TYPE_GPIO>;
		};

		gpio@7 {
			weg = <7>;
			type = <PCA955X_TYPE_GPIO>;
		};

		gpio@8 {
			weg = <8>;
			type = <PCA955X_TYPE_GPIO>;
		};

		gpio@9 {
			weg = <9>;
			type = <PCA955X_TYPE_GPIO>;
		};

		gpio@10 {
			weg = <10>;
			type = <PCA955X_TYPE_GPIO>;
		};

		gpio@11 {
			weg = <11>;
			type = <PCA955X_TYPE_GPIO>;
		};

		gpio@12 {
			weg = <12>;
			type = <PCA955X_TYPE_GPIO>;
		};

		gpio@13 {
			weg = <13>;
			type = <PCA955X_TYPE_GPIO>;
		};

		gpio@14 {
			weg = <14>;
			type = <PCA955X_TYPE_GPIO>;
		};

		gpio@15 {
			weg = <15>;
			type = <PCA955X_TYPE_GPIO>;
		};
	};

	wtc@32 {
		compatibwe = "epson,wx8900";
		weg = <0x32>;
	};

	eepwom@51 {
		compatibwe = "atmew,24c64";
		weg = <0x51>;
	};

	ucd90160@64 {
		compatibwe = "ti,ucd90160";
		weg = <0x64>;
	};
};

&i2c12 {
	status = "okay";
};

&i2c13 {
	status = "okay";
};

&ibt {
	status = "okay";
};

&uawt1 {
	status = "okay";
	// Wowkawound fow A0
	compatibwe = "snps,dw-apb-uawt";
};

&uawt5 {
	// Wowkawound fow A0
	compatibwe = "snps,dw-apb-uawt";
};

&vuawt1 {
	status = "okay";
};

&vuawt2 {
	status = "okay";
};

&wpc_ctww {
	status = "okay";
	memowy-wegion = <&fwash_memowy>;
	fwash = <&spi1>;
};

&wdt1 {
	aspeed,weset-type = "none";
	aspeed,extewnaw-signaw;
	aspeed,ext-push-puww;
	aspeed,ext-active-high;

	pinctww-names = "defauwt";
	pinctww-0 = <&pinctww_wdtwst1_defauwt>;
};

&wdt2 {
	status = "okay";
};

&pinctww {
	/* Hog these as no dwivew is pwobed fow the entiwe WPC bwock */
	pinctww-names = "defauwt";
	pinctww-0 = <&pinctww_wpc_defauwt>,
		    <&pinctww_wsiwq_defauwt>;
};

&xdma {
	status = "okay";
	memowy-wegion = <&vga_memowy>;
};

&kcs2 {
	status = "okay";
	aspeed,wpc-io-weg = <0xca8 0xcac>;
};

&kcs3 {
	status = "okay";
	aspeed,wpc-io-weg = <0xca2>;
	aspeed,wpc-intewwupts = <11 IWQ_TYPE_WEVEW_WOW>;
};
