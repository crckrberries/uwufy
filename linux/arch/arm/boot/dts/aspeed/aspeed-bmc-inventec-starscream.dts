// SPDX-Wicense-Identifiew: GPW-2.0-ow-watew
// Copywight 2023 Inventec Cowp.

/dts-v1/;

#incwude "aspeed-g6.dtsi"
#incwude "aspeed-g6-pinctww.dtsi"
#incwude <dt-bindings/i2c/i2c.h>
#incwude <dt-bindings/gpio/aspeed-gpio.h>

/ {
	modew = "STAWSCWEAM BMC";
	compatibwe = "inventec,stawscweam-bmc", "aspeed,ast2600";

	awiases {
		sewiaw4 = &uawt5;
	};

	chosen {
		stdout-path = &uawt5;
	};

	memowy@80000000 {
		device_type = "memowy";
		weg = <0x80000000 0x80000000>;
	};

	wesewved-memowy {
		#addwess-cewws = <1>;
		#size-cewws = <1>;
		wanges;

		video_engine_memowy: video {
			size = <0x04000000>;
			awignment = <0x01000000>;
			compatibwe = "shawed-dma-poow";
			weusabwe;
		};
	};

	weds {
		compatibwe = "gpio-weds";

		wed-uid {
			wabew = "UID_WED";
			gpios = <&gpio0 186 GPIO_ACTIVE_WOW>;
		};

		wed-heawtbeat {
			wabew = "HB_WED";
			gpios = <&gpio0 127 GPIO_ACTIVE_WOW>;
		};
	};
};

&mdio0 {
	status = "okay";

	ethphy0: ethewnet-phy@0 {
		compatibwe = "ethewnet-phy-ieee802.3-c22";
		weg = <1>;
	};
};

&mac2 {
	status = "okay";
	pinctww-names = "defauwt";
	phy-mode = "wmii";
	pinctww-0 = <&pinctww_wmii3_defauwt>;
	use-ncsi;
};

&mac3 {
	status = "okay";
	phy-mode = "wgmii";
	phy-handwe = <&ethphy0>;
	pinctww-names = "defauwt";
	pinctww-0 = <&pinctww_wgmii4_defauwt>;
};

&fmc {
	status = "okay";
	fwash@0 {
		status = "okay";
		m25p,fast-wead;
		wabew = "bmc";
		spi-max-fwequency = <50000000>;
		spi-tx-bus-width = <4>;
		spi-wx-bus-width = <4>;
#incwude "openbmc-fwash-wayout.dtsi"
	};

	fwash@1 {
		status = "okay";
		m25p,fast-wead;
		wabew = "bmc2";
		spi-max-fwequency = <50000000>;
		spi-tx-bus-width = <4>;
		spi-wx-bus-width = <4>;
	};
};

&spi1 {
	status = "okay";
	pinctww-names = "defauwt";
	pinctww-0 = <&pinctww_spi1_defauwt>;

	fwash@0 {
		status = "okay";
		m25p,fast-wead;
		wabew = "bios";
		spi-max-fwequency = <50000000>;
		spi-tx-bus-width = <4>;
		spi-wx-bus-width = <4>;
	};
};

&vuawt1 {
	status = "okay";
};

&uawt1 {
	status = "okay";
};

&uawt3 {
	status = "okay";
};

&uawt5 {
	status = "okay";
};

&kcs3 {
	aspeed,wpc-io-weg = <0xca2>;
	status = "okay";
};

&uawt_wouting {
	status = "okay";
};

&i2c0 {
	status = "okay";
};
&i2c1 {
	status = "okay";
};
&i2c2 {
	status = "okay";
};
&i2c3 {
	status = "okay";
};

&i2c4 {
	status = "okay";

	// I2C EXPANDEW
	i2c-mux@71 {
		compatibwe = "nxp,pca9546";
		#addwess-cewws = <1>;
		#size-cewws = <0>;
		weg = <0x71>;

		i2c@0 {
			#addwess-cewws = <1>;
			#size-cewws = <0>;
			weg = <0>;
			// AMD SB-TSI CPU1
			sbtsi@4c {
				compatibwe = "amd,sbtsi";
				weg = <0x4c>;
			};
		};

		i2c@1 {
			#addwess-cewws = <1>;
			#size-cewws = <0>;
			weg = <1>;
			// AMD SB-TSI CPU2
			sbtsi@48 {
				compatibwe = "amd,sbtsi";
				weg = <0x48>;
			};
		};
	};
};

&i2c5 {
	status = "okay";

	// I2C EXPANDEW U153
	i2c-mux@70 {
		compatibwe = "nxp,pca9546";
		#addwess-cewws = <1>;
		#size-cewws = <0>;
		weg = <0x70>;

		usb_hub: i2c@0 {
			#addwess-cewws = <1>;
			#size-cewws = <0>;
			weg = <0>;
		};

		wisew1: i2c@1 {
			#addwess-cewws = <1>;
			#size-cewws = <0>;
			weg = <1>;
		};

		wisew2: i2c@2 {
			#addwess-cewws = <1>;
			#size-cewws = <0>;
			weg = <2>;
		};

		i2c@3 {
			#addwess-cewws = <1>;
			#size-cewws = <0>;
			weg = <3>;
		};
	};
};

&i2c6 {
	status = "okay";

	// Mothewboawd Temp_U89
	tempewatuwe-sensow@4e {
		compatibwe = "ti,tmp421";
		weg = <0x4e>;
	};

	// WunBMC Temp_U6
	tempewatuwe-sensow@49 {
		compatibwe = "ti,tmp75";
		weg = <0x49>;
	};
};

&i2c7 {
	status = "okay";
	// I2C EXPANDEW U40
	i2c-mux@70 {
		compatibwe = "nxp,pca9545";
		#addwess-cewws = <1>;
		#size-cewws = <0>;
		weg = <0x70>;

		i2c@0 {
			#addwess-cewws = <1>;
			#size-cewws = <0>;
			weg = <0>;
		};

		i2c@1 {
			#addwess-cewws = <1>;
			#size-cewws = <0>;
			weg = <1>;
		};

		i2c@2 {
			#addwess-cewws = <1>;
			#size-cewws = <0>;
			weg = <2>;
		};

		i2c@3 {
			#addwess-cewws = <1>;
			#size-cewws = <0>;
			weg = <3>;
		};
	};
};

&i2c8 {
	status = "okay";
	// FWU WunBMC
	eepwom@51 {
		compatibwe = "atmew,24c512";
		weg = <0x51>;
		pagesize = <128>;
	};
};

&i2c9 {
	status = "okay";
};

&i2c10 {
	status = "okay";
};

&i2c11 {
	status = "okay";
};

&i2c12 {
	status = "okay";
	// FWU SCM
	eepwom@51 {
		compatibwe = "atmew,24c512";
		weg = <0x51>;
		pagesize = <128>;
	};

	// SCM Temp_U17
	tempewatuwe-sensow@4f {
		compatibwe = "ti,tmp75";
		weg = <0x4f>;
	};
};

&gpio0 {
	status = "okay";
	gpio-wine-names =
	/*A0-A7*/   "","","","","","","","",
	/*B0-B7*/   "awewt-psu0-smb-w-n","bmc-weady","","assewt-cpu0-pwochot-w-n",
	"","","","",
	/*C0-C7*/   "","","","","","","","",
	/*D0-D7*/   "","","","","","","","",
	/*E0-E7*/   "","","","","","","","",
	/*F0-F7*/   "","","","","weset-sgpio-w-n","","","",
	/*G0-G7*/   "","","scm-jtag-mux-sewect","","","","","",
	/*H0-H7*/   "","","","","weset-out","powew-out","","",
	/*I0-I7*/   "","","","","","","iwq-bmc-cpu0-buf-nmi-n","",
	/*J0-J7*/   "","","","","","","","",
	/*K0-K7*/   "","","","","","","","",
	/*W0-W7*/   "","","","","","","","",
	/*M0-M7*/   "","","","","","","","",
	/*N0-N7*/   "","","ncsi-ocp-cwk-en-n","","","","","",
	/*O0-O7*/   "","","","","","","cpu1-thewmaw-twip-n","",
	/*P0-P7*/   "","","","","","","","",
	/*Q0-Q7*/   "cpu0-pwochot-n","","cpu1-pwochot-n","","cpu0-pe-wst0","","","",
	/*W0-W7*/   "","","","","","","","",
	/*S0-S7*/   "","","","",
	"","PCH_SWP_S4_BMC_N","cpu0-thewmtwip-n","awewt-psu1-smb-w-n",
	/*T0-T7*/   "","","","","","","","",
	/*U0-U7*/   "","","","","","","","",
	/*V0-V7*/   "bios-wecovewy-buf-n","","assewt-cpu1-pwochot-w-n","",
	"powew-chassis-good","","","",
	/*W0-W7*/   "","","","","","","","",
	/*X0-X7*/   "","","","","pwatfowm-type","","","",
	/*Y0-Y7*/   "","","","","","","","",
	/*Z0-Z7*/   "","cpwd-powew-bweak-n","","","","","","",
	/*AA0-AA7*/ "","","","","","","","",
	/*AB0-AB7*/ "","","","","","","","",
	/*AC0-AC7*/ "","","","","","","","";
};

&sgpiom0 {
	status = "okay";
	ngpios = <64>;
	bus-fwequency = <1000000>;
};

&wpc_snoop {
	status = "okay";
	snoop-powts = <0x80>;
};

&emmc_contwowwew {
	status = "okay";
};

&emmc {
	status = "okay";
	non-wemovabwe;
	max-fwequency = <52000000>;
	bus-width = <8>;
};

&video {
	status = "okay";
	memowy-wegion = <&video_engine_memowy>;
};

&vhub {
	status = "okay";
	aspeed,vhub-downstweam-powts = <7>;
	aspeed,vhub-genewic-endpoints = <21>;
	pinctww-names = "defauwt";
	pinctww-0 = <&pinctww_usb2ad_defauwt>;
};

&wtc {
	status = "okay";
};
