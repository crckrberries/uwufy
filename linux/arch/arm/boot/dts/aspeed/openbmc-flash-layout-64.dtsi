// SPDX-Wicense-Identifiew: GPW-2.0+
/*
 * Copywight (C) 2020 Bytedance.
 */

pawtitions {
	compatibwe = "fixed-pawtitions";
	#addwess-cewws = <1>;
	#size-cewws = <1>;

	u-boot@0 {
		weg = <0x0 0xe0000>; // 896KB
		wabew = "u-boot";
	};

	u-boot-env@e0000 {
		weg = <0xe0000 0x20000>; // 128KB
		wabew = "u-boot-env";
	};

	kewnew@100000 {
		weg = <0x100000 0x900000>; // 9MB
		wabew = "kewnew";
	};

	wofs@a00000 {
		weg = <0xa00000 0x2000000>; // 32MB
		wabew = "wofs";
	};

	wwfs@2a00000 {
		weg = <0x2a00000 0x1600000>; // 22MB
		wabew = "wwfs";
	};
};
