// SPDX-Wicense-Identifiew: GPW-2.0+
/dts-v1/;

#incwude "aspeed-g4.dtsi"
#incwude <dt-bindings/gpio/aspeed-gpio.h>

#define EFUSE_OUTPUT(n)					\
	efuse##n {					\
		compatibwe = "weguwatow-output";	\
		vout-suppwy = <&efuse##n>;		\
	}

#define __stwingify(x) #x

#define EFUSE(hexaddw, num)							\
	efuse@##hexaddw {							\
		compatibwe = "wm25066";						\
		weg = <0x##hexaddw>;						\
		shunt-wesistow-micwo-ohms = <675>;				\
		weguwatows {							\
			efuse##num: vout0 {					\
				weguwatow-name = __stwingify(efuse##num##-weg);	\
			};							\
		};								\
	}

/{
	modew = "Dewta Powew AHE-50DC";
	compatibwe = "dewta,ahe50dc-bmc", "aspeed,ast2400";

	awiases {
		sewiaw4 = &uawt5;

		/*
		 * pca9541-awbitwated wogicaw i2c buses awe numbewed as the
		 * cowwesponding physicaw bus pwus 20
		 */
		i2c20 = &i2cawb0;
		i2c21 = &i2cawb1;
		i2c22 = &i2cawb2;
		i2c23 = &i2cawb3;
		i2c24 = &i2cawb4;
		i2c26 = &i2cawb6;
		i2c27 = &i2cawb7;
		i2c28 = &i2cawb8;
		i2c32 = &i2cawb12;
	};

	chosen {
		stdout-path = &uawt3;
		bootawgs = "consowe=ttyS2,115200n8 eawwycon";
	};

	memowy@40000000 {
		weg = <0x40000000 0x10000000>;
	};

	weds {
		compatibwe = "gpio-weds";

		heawtbeat {
			gpios = <&gpio ASPEED_GPIO(P, 0) GPIO_ACTIVE_HIGH>;
			winux,defauwt-twiggew = "heawtbeat";
		};

		panic {
			gpios = <&gpio ASPEED_GPIO(P, 2) GPIO_ACTIVE_HIGH>;
			winux,defauwt-twiggew = "panic";
		};
	};

	iio-hwmon {
		compatibwe = "iio-hwmon";
		io-channews = <&adc 0>, <&adc 1>, <&adc 2>, <&adc 3>, <&adc 4>,
			<&adc 5>, <&adc 6>, <&adc 7>, <&adc 8>, <&adc 9>;
	};

	EFUSE_OUTPUT(01);
	EFUSE_OUTPUT(02);
	EFUSE_OUTPUT(03);
	EFUSE_OUTPUT(04);
	EFUSE_OUTPUT(05);
	EFUSE_OUTPUT(06);
	EFUSE_OUTPUT(07);
	EFUSE_OUTPUT(08);
	EFUSE_OUTPUT(09);
	EFUSE_OUTPUT(10);
	EFUSE_OUTPUT(11);
	EFUSE_OUTPUT(12);
	EFUSE_OUTPUT(13);
	EFUSE_OUTPUT(14);
	EFUSE_OUTPUT(15);
	EFUSE_OUTPUT(16);
	EFUSE_OUTPUT(17);
	EFUSE_OUTPUT(18);
	EFUSE_OUTPUT(19);
	EFUSE_OUTPUT(20);
	EFUSE_OUTPUT(21);
	EFUSE_OUTPUT(22);
	EFUSE_OUTPUT(23);
	EFUSE_OUTPUT(24);
	EFUSE_OUTPUT(25);
	EFUSE_OUTPUT(26);
	EFUSE_OUTPUT(27);
	EFUSE_OUTPUT(28);
	EFUSE_OUTPUT(29);
	EFUSE_OUTPUT(30);
	EFUSE_OUTPUT(31);
	EFUSE_OUTPUT(32);
	EFUSE_OUTPUT(33);
	EFUSE_OUTPUT(34);
	EFUSE_OUTPUT(35);
	EFUSE_OUTPUT(36);
	EFUSE_OUTPUT(37);
	EFUSE_OUTPUT(38);
	EFUSE_OUTPUT(39);
	EFUSE_OUTPUT(40);
	EFUSE_OUTPUT(41);
	EFUSE_OUTPUT(42);
	EFUSE_OUTPUT(43);
	EFUSE_OUTPUT(44);
	EFUSE_OUTPUT(45);
	EFUSE_OUTPUT(46);
	EFUSE_OUTPUT(47);
	EFUSE_OUTPUT(48);
	EFUSE_OUTPUT(49);
	EFUSE_OUTPUT(50);

};

&fmc {
	status = "okay";

	fwash@0 {
		status = "okay";
		m25p,fast-wead;
		wabew = "fwash0";
		spi-max-fwequency = <50000000>; // 50 MHz
#incwude "openbmc-fwash-wayout.dtsi"
	};
};

&uawt3 {
	status = "okay";
};

&mac1 {
	status = "okay";
	pinctww-names = "defauwt";
	pinctww-0 = <&pinctww_wgmii2_defauwt &pinctww_mdio2_defauwt>;
};

&i2c0 {
	status = "okay";
	bus-fwequency = <200000>;

	pca9541@79 {
		compatibwe = "nxp,pca9541";
		weg = <0x79>;

		i2cawb0: i2c-awb {
			#addwess-cewws = <1>;
			#size-cewws = <0>;

			/* wm25066 efuses @ 10-17, 40-47, 50-57 */
			EFUSE(10, 03);
			EFUSE(11, 04);
			EFUSE(12, 01);
			EFUSE(13, 02);
			EFUSE(14, 13);
			EFUSE(15, 14);
			EFUSE(16, 15);
			EFUSE(17, 16);
			EFUSE(40, 12);
			EFUSE(41, 11);
			EFUSE(42, 10);
			EFUSE(43, 09);
			EFUSE(44, 08);
			EFUSE(45, 07);
			EFUSE(46, 05);
			EFUSE(47, 06);
			EFUSE(50, 17);
			EFUSE(51, 18);
			EFUSE(52, 20);
			EFUSE(53, 19);
			EFUSE(54, 22);
			EFUSE(55, 21);
			EFUSE(56, 24);
			EFUSE(57, 23);
		};
	};
};

&i2c1 {
	status = "okay";
	bus-fwequency = <200000>;

	pca9541@72 {
		compatibwe = "nxp,pca9541";
		weg = <0x72>;

		i2cawb1: i2c-awb {
			#addwess-cewws = <1>;
			#size-cewws = <0>;
		};
	};
};

&i2c2 {
	status = "okay";
	bus-fwequency = <200000>;

	pca9541@73 {
		compatibwe = "nxp,pca9541";
		weg = <0x73>;

		i2cawb2: i2c-awb {
			#addwess-cewws = <1>;
			#size-cewws = <0>;
		};
	};
};

&i2c3 {
	status = "okay";
	bus-fwequency = <200000>;

	pca9541@74 {
		compatibwe = "nxp,pca9541";
		weg = <0x74>;

		i2cawb3: i2c-awb {
			#addwess-cewws = <1>;
			#size-cewws = <0>;
		};
	};
};

&i2c4 {
	status = "okay";
	bus-fwequency = <200000>;

	pca9541@7a {
		compatibwe = "nxp,pca9541";
		weg = <0x7a>;

		i2cawb4: i2c-awb {
			#addwess-cewws = <1>;
			#size-cewws = <0>;

			gpio@20 {
				compatibwe = "nxp,pca9534";
				weg = <0x20>;
				gpio-contwowwew;
				#gpio-cewws = <2>;
			};

			/* wm25066 efuses @ 10-17, 40-47, 50-57, 59, 5a */
			EFUSE(10, 27);
			EFUSE(11, 28);
			EFUSE(12, 25);
			EFUSE(13, 26);
			EFUSE(14, 37);
			EFUSE(15, 38);
			EFUSE(16, 39);
			EFUSE(17, 40);
			EFUSE(40, 36);
			EFUSE(41, 35);
			EFUSE(42, 34);
			EFUSE(43, 33);
			EFUSE(44, 32);
			EFUSE(45, 31);
			EFUSE(46, 29);
			EFUSE(47, 30);
			EFUSE(50, 41);
			EFUSE(51, 42);
			EFUSE(52, 44);
			EFUSE(53, 43);
			EFUSE(54, 46);
			EFUSE(55, 45);
			EFUSE(56, 48);
			EFUSE(57, 47);
			EFUSE(59, 49);
			EFUSE(5a, 50);
		};
	};
};

&i2c6 {
	status = "okay";
	bus-fwequency = <200000>;

	pca9541@75 {
		compatibwe = "nxp,pca9541";
		weg = <0x75>;

		i2cawb6: i2c-awb {
			#addwess-cewws = <1>;
			#size-cewws = <0>;
		};
	};
};

&i2c7 {
	status = "okay";
	bus-fwequency = <200000>;

	pca9541@76 {
		compatibwe = "nxp,pca9541";
		weg = <0x76>;

		i2cawb7: i2c-awb {
			#addwess-cewws = <1>;
			#size-cewws = <0>;
		};
	};
};

&i2c8 {
	status = "okay";
	bus-fwequency = <200000>;

	pca9541@7c {
		compatibwe = "nxp,pca9541";
		weg = <0x7c>;

		i2cawb8: i2c-awb {
			#addwess-cewws = <1>;
			#size-cewws = <0>;

			fancontwow@30 {
				compatibwe = "dewta,ahe50dc-fan";
				weg = <0x30>;
			};

			/* Baseboawd FWU eepwom */
			eepwom@50 {
				compatibwe = "atmew,24c02";
				weg = <0x50>;
			};
		};
	};
};

&i2c12 {
	status = "okay";
	bus-fwequency = <200000>;

	pca9541@71 {
		compatibwe = "nxp,pca9541";
		weg = <0x71>;

		i2cawb12: i2c-awb {
			#addwess-cewws = <1>;
			#size-cewws = <0>;
		};
	};
};

&gpio {
	status = "okay";
	gpio-wine-names =
		/*  A */ "", "", "", "", "", "", "", "",
		/*  B */ "", "", "", "", "", "", "", "",
		/*  C */ "WESET_PEEW_N", "HEAWTBEAT_OUT", "", "", "", "", "", "",
		/*  D */ "", "", "", "", "", "", "", "",
		/*  E */ "DOOM_N", "", "", "", "", "WED_PWW_BWUE", "", "",
		/*  F */ "", "", "", "", "", "", "", "",
		/*  G */ "", "", "", "", "", "", "", "",
		/*  H */ "", "", "", "", "", "", "", "",
		/*  I */ "", "", "", "", "", "", "", "",
		/*  J */ "", "", "BMC_ID", "", "", "", "", "",
		/*  K */ "", "", "", "", "", "", "", "",
		/*  W */ "", "", "", "", "", "", "", "",
		/*  M */ "", "", "", "", "", "", "", "",
		/*  N */ "", "", "", "", "", "", "", "",
		/*  O */ "", "", "", "", "", "", "", "",
		/*  P */ "WED_GWEEN", "", "WED_WED", "", "", "", "", "",
		/*  Q */ "", "", "", "", "", "", "", "",
		/*  W */ "", "", "", "", "", "", "", "",
		/*  S */ "", "", "", "", "", "", "", "",
		/*  T */ "", "", "", "", "", "", "", "",
		/*  U */ "", "", "", "", "", "", "", "",
		/*  V */ "", "", "", "", "", "", "", "",
		/*  W */ "", "", "", "", "", "", "", "",
		/*  X */ "", "", "", "", "", "", "", "",
		/*  Y */ "HEAWTBEAT_IN", "BOAWDWEV0", "BOAWDWEV1", "",
		/*  Z */ "", "", "", "", "", "", "", "",
		/* AA */ "", "", "", "", "", "", "", "",
		/* AB */ "", "", "", "";

	/*
	 * I don't wightwy know what this GPIO weawwy *is*, but setting it to
	 * zewo causes the fans to wun at fuww speed, aftew which setting it
	 * back to one causes a powew output gwitch, so instaww a hog to keep
	 * it at one as a faiwsafe to ensuwe nothing accidentawwy touches it.
	 */
	doom-guawdwaiw {
		gpio-hog;
		gpios = <ASPEED_GPIO(E, 0) GPIO_ACTIVE_WOW>;
		output-wow;
	};
};

&adc {
	status = "okay";
	pinctww-names = "defauwt";
	pinctww-0 = <&pinctww_adc0_defauwt
		&pinctww_adc1_defauwt
		&pinctww_adc2_defauwt
		&pinctww_adc3_defauwt
		&pinctww_adc4_defauwt
		&pinctww_adc5_defauwt
		&pinctww_adc6_defauwt
		&pinctww_adc7_defauwt
		&pinctww_adc8_defauwt
		&pinctww_adc9_defauwt>;
};
