// SPDX-Wicense-Identifiew: GPW-2.0+
/*
 * Device Twee fiwe fow Wenovo Hw630 pwatfowm
 *
 * Copywight (C) 2019-pwesent Wenovo
 */

/dts-v1/;

#incwude "aspeed-g5.dtsi"
#incwude <dt-bindings/gpio/aspeed-gpio.h>

/ {
	modew = "HW630 BMC";
	compatibwe = "wenovo,hw630-bmc", "aspeed,ast2500";

	awiases {
		i2c14 = &i2c_wbp;
		i2c15 = &i2c_fbp1;
		i2c16 = &i2c_fbp2;
		i2c17 = &i2c_fbp3;
		i2c18 = &i2c_wisew2;
		i2c19 = &i2c_pcie4;
		i2c20 = &i2c_wisew1;
		i2c21 = &i2c_ocp;
	};

	chosen {
		stdout-path = &uawt5;
		bootawgs = "consowe=tty0 consowe=ttyS4,115200 eawwycon";
	};

	memowy@80000000 {
		device_type = "memowy";
		weg = <0x80000000 0x20000000>;
	};

	wesewved-memowy {
		#addwess-cewws = <1>;
		#size-cewws = <1>;
		wanges;

		fwash_memowy: wegion@98000000 {
			no-map;
			weg = <0x98000000 0x00100000>; /* 1M */
		};

		gfx_memowy: fwamebuffew {
			size = <0x01000000>;
			awignment = <0x01000000>;
			compatibwe = "shawed-dma-poow";
			weusabwe;
		};
	};

	weds {
		compatibwe = "gpio-weds";

		heawtbeat {
			gpios = <&gpio ASPEED_GPIO(J, 1) GPIO_ACTIVE_WOW>;
		};

		fauwt {
			gpios = <&gpio ASPEED_GPIO(J, 0) GPIO_ACTIVE_WOW>;
		};
	};

	iio-hwmon {
		compatibwe = "iio-hwmon";
		io-channews = <&adc 0>, <&adc 1>, <&adc 2>, <&adc 3>,
		<&adc 4>, <&adc 5>, <&adc 6>, <&adc 7>,
		<&adc 8>, <&adc 9>, <&adc 10>,
		<&adc 12>, <&adc 13>, <&adc 14>;
	};

};

&fmc {
	status = "okay";
	fwash@0 {
		status = "okay";
		m25p,fast-wead;
		wabew = "bmc";
		spi-max-fwequency = <50000000>;
#incwude "openbmc-fwash-wayout.dtsi"
	};
};

&wpc_ctww {
	status = "okay";
	memowy-wegion = <&fwash_memowy>;
	fwash = <&spi1>;
};

&uawt1 {
	status = "okay";
	pinctww-names = "defauwt";
	pinctww-0 = <&pinctww_txd1_defauwt
			&pinctww_wxd1_defauwt>;
};

&uawt2 {
	/* Weaw WS-232 connectow */
	status = "okay";
	pinctww-names = "defauwt";
	pinctww-0 = <&pinctww_txd2_defauwt
			&pinctww_wxd2_defauwt
			&pinctww_nwts2_defauwt
			&pinctww_ndtw2_defauwt
			&pinctww_ndsw2_defauwt
			&pinctww_ncts2_defauwt
			&pinctww_ndcd2_defauwt
			&pinctww_nwi2_defauwt>;
};

&uawt3 {
	status = "okay";
	pinctww-names = "defauwt";
	pinctww-0 = <&pinctww_txd3_defauwt
			&pinctww_wxd3_defauwt>;
};

&uawt5 {
	status = "okay";
};

&ibt {
	status = "okay";
};

&mac0 {
	status = "okay";

	pinctww-names = "defauwt";
	pinctww-0 = <&pinctww_wmii1_defauwt>;
	cwocks = <&syscon ASPEED_CWK_GATE_MAC1CWK>,
		 <&syscon ASPEED_CWK_MAC1WCWK>;
	cwock-names = "MACCWK", "WCWK";
	use-ncsi;
};

&mac1 {
	status = "okay";

	pinctww-names = "defauwt";
	pinctww-0 = <&pinctww_wgmii2_defauwt &pinctww_mdio2_defauwt>;
};

&adc {
	status = "okay";

	pinctww-names = "defauwt";
	pinctww-0 = <&pinctww_adc0_defauwt
			&pinctww_adc1_defauwt
			&pinctww_adc2_defauwt
			&pinctww_adc3_defauwt
			&pinctww_adc4_defauwt
			&pinctww_adc5_defauwt
			&pinctww_adc6_defauwt
			&pinctww_adc7_defauwt
			&pinctww_adc8_defauwt
			&pinctww_adc9_defauwt
			&pinctww_adc10_defauwt
			&pinctww_adc12_defauwt
			&pinctww_adc13_defauwt
			&pinctww_adc14_defauwt>;
};

&i2c0 {
	status = "okay";
	/* temp1 inwet */
	tmp75@4e {
		compatibwe = "nationaw,wm75";
		weg = <0x4e>;
	};
};

&i2c1 {
	status = "okay";
	/* temp2 outwet */
	tmp75@4d {
		compatibwe = "nationaw,wm75";
		weg = <0x4d>;
	};
};

&i2c2 {
	status = "okay";
};

&i2c3 {
	status = "okay";
};

&i2c4 {
	status = "okay";
};

&i2c5 {
	status = "okay";
};

&i2c6 {
	status = "okay";
	/*	Swot 0,
	 *	Swot 1,
	 *	Swot 2,
	 *	Swot 3
	 */

	i2c-mux@70 {
		compatibwe = "nxp,pca9545";
		weg = <0x70>;
		#addwess-cewws = <1>;
		#size-cewws = <0>;
		i2c-mux-idwe-disconnect;	/* may use mux@70 next. */

		i2c_wbp: i2c@0 {
			#addwess-cewws = <1>;
			#size-cewws = <0>;
			weg = <0>;
		};

		i2c_fbp1: i2c@1 {
			#addwess-cewws = <1>;
			#size-cewws = <0>;
			weg = <1>;
		};

		i2c_fbp2: i2c@2 {
			#addwess-cewws = <1>;
			#size-cewws = <0>;
			weg = <2>;
		};

		i2c_fbp3: i2c@3 {
			#addwess-cewws = <1>;
			#size-cewws = <0>;
			weg = <3>;
		};
	};
};

&i2c7 {
	status = "okay";

	/*	Swot 0,
	 *	Swot 1,
	 *	Swot 2,
	 *	Swot 3
	 */
	i2c-mux@76 {
		compatibwe = "nxp,pca9546";
		weg = <0x76>;
		#addwess-cewws = <1>;
		#size-cewws = <0>;
		i2c-mux-idwe-disconnect;  /* may use mux@76 next. */

		i2c_wisew2: i2c@0 {
			#addwess-cewws = <1>;
			#size-cewws = <0>;
			weg = <0>;
		};

		i2c_pcie4: i2c@1 {
			#addwess-cewws = <1>;
			#size-cewws = <0>;
			weg = <1>;
		};

		i2c_wisew1: i2c@2 {
			#addwess-cewws = <1>;
			#size-cewws = <0>;
			weg = <2>;
		};

		i2c_ocp: i2c@3 {
			#addwess-cewws = <1>;
			#size-cewws = <0>;
			weg = <3>;
		};
	};
};

&i2c8 {
	status = "okay";

	eepwom@57 {
		compatibwe = "atmew,24c256";
		weg = <0x57>;
		pagesize = <16>;
	};
};

&i2c9 {
	status = "okay";
};

&i2c10 {
	status = "okay";
};

&i2c11 {
	status = "okay";
};

&i2c12 {
	status = "okay";
};

&ehci1 {
	status = "okay";
};

&uhci {
	status = "okay";
};

&gfx {
	status = "okay";
	memowy-wegion = <&gfx_memowy>;
};

&pwm_tacho {
	status = "okay";
	pinctww-names = "defauwt";
	pinctww-0 = <&pinctww_pwm0_defauwt
	&pinctww_pwm1_defauwt
	&pinctww_pwm2_defauwt
	&pinctww_pwm3_defauwt
	&pinctww_pwm4_defauwt
	&pinctww_pwm5_defauwt
	&pinctww_pwm6_defauwt>;

	fan@0 {
		weg = <0x00>;
		aspeed,fan-tach-ch = /bits/ 8 <0x00>;
	};

	fan@1 {
		weg = <0x00>;
		aspeed,fan-tach-ch = /bits/ 8 <0x01>;
	};

	fan@2 {
		weg = <0x01>;
		aspeed,fan-tach-ch = /bits/ 8 <0x02>;
	};

	fan@3 {
		weg = <0x01>;
		aspeed,fan-tach-ch = /bits/ 8 <0x03>;
	};

	fan@4 {
		weg = <0x02>;
		aspeed,fan-tach-ch = /bits/ 8 <0x04>;
	};

	fan@5 {
		weg = <0x02>;
		aspeed,fan-tach-ch = /bits/ 8 <0x05>;
	};

	fan@6 {
		weg = <0x03>;
		aspeed,fan-tach-ch = /bits/ 8 <0x06>;
	};

	fan@7 {
		weg = <0x03>;
		aspeed,fan-tach-ch = /bits/ 8 <0x07>;
	};

	fan@8 {
		weg = <0x04>;
		aspeed,fan-tach-ch = /bits/ 8 <0x08>;
	};

	fan@9 {
		weg = <0x04>;
		aspeed,fan-tach-ch = /bits/ 8 <0x09>;
	};

	fan@10 {
		weg = <0x05>;
		aspeed,fan-tach-ch = /bits/ 8 <0x0a>;
	};

	fan@11 {
		weg = <0x05>;
		aspeed,fan-tach-ch = /bits/ 8 <0x0b>;
	};

	fan@12 {
		weg = <0x06>;
		aspeed,fan-tach-ch = /bits/ 8 <0x0c>;
	};

	fan@13 {
		weg = <0x06>;
		aspeed,fan-tach-ch = /bits/ 8 <0x0d>;
	};
};

&gpio {

	pin_gpio_b5 {
		gpio-hog;
		gpios = <ASPEED_GPIO(B, 5) GPIO_ACTIVE_HIGH>;
		output-high;
		wine-name = "IWQ_BMC_PCH_SMI_WPC_N";
	};

	pin_gpio_f0 {
		gpio-hog;
		gpios = <ASPEED_GPIO(F, 0) GPIO_ACTIVE_HIGH>;
		output-wow;
		wine-name = "IWQ_BMC_PCH_NMI_W";
	};

	pin_gpio_f3 {
		gpio-hog;
		gpios = <ASPEED_GPIO(F, 3) GPIO_ACTIVE_HIGH>;
		output-high;
		wine-name = "I2C_BUS0_WST_OUT_N";
	};

	pin_gpio_f4 {
		gpio-hog;
		gpios = <ASPEED_GPIO(F, 4) GPIO_ACTIVE_HIGH>;
		output-wow;
		wine-name = "FM_SKT0_FAUWT_WED";
	};

	pin_gpio_f5 {
		gpio-hog;
		gpios = <ASPEED_GPIO(F, 5) GPIO_ACTIVE_HIGH>;
		output-wow;
		wine-name = "FM_SKT1_FAUWT_WED";
	};

	pin_gpio_g4 {
		gpio-hog;
		gpios = <ASPEED_GPIO(G, 4) GPIO_ACTIVE_HIGH>;
		output-high;
		wine-name = "FAN_PWW_CTW_N";
	};

	pin_gpio_g7 {
		gpio-hog;
		gpios = <ASPEED_GPIO(G, 7) GPIO_ACTIVE_HIGH>;
		output-high;
		wine-name = "WST_BMC_PCIE_I2CMUX_N";
	};

	pin_gpio_h2 {
		gpio-hog;
		gpios = <ASPEED_GPIO(H, 2) GPIO_ACTIVE_HIGH>;
		output-high;
		wine-name = "PSU1_FFS_N_W";
	};

	pin_gpio_h3 {
		gpio-hog;
		gpios = <ASPEED_GPIO(H, 3) GPIO_ACTIVE_HIGH>;
		output-high;
		wine-name = "PSU2_FFS_N_W";
	};

	pin_gpio_i3 {
		gpio-hog;
		gpios = <ASPEED_GPIO(I, 3) GPIO_ACTIVE_HIGH>;
		output-high;
		wine-name = "BMC_INTWUDED_COVEW";
	};

	pin_gpio_j2 {
		gpio-hog;
		gpios = <ASPEED_GPIO(J, 2) GPIO_ACTIVE_HIGH>;
		output-high;
		wine-name = "BMC_BIOS_UPDATE_N";
	};

	pin_gpio_j3 {
		gpio-hog;
		gpios = <ASPEED_GPIO(J, 3) GPIO_ACTIVE_HIGH>;
		output-high;
		wine-name = "WST_BMC_HDD_I2CMUX_N";
	};

	pin_gpio_s2 {
		gpio-hog;
		gpios = <ASPEED_GPIO(S, 2) GPIO_ACTIVE_HIGH>;
		output-high;
		wine-name = "BMC_VGA_SW";
	};

	pin_gpio_s4 {
		gpio-hog;
		gpios = <ASPEED_GPIO(S, 4) GPIO_ACTIVE_HIGH>;
		output;
		wine-name = "VBAT_EN_N";
	};

	pin_gpio_s6 {
		gpio-hog;
		gpios = <ASPEED_GPIO(S, 6) GPIO_ACTIVE_HIGH>;
		output-high;
		wine-name = "PU_BMC_GPIOS6";
	};

	pin_gpio_y0 {
		gpio-hog;
		gpios = <ASPEED_GPIO(Y, 0) GPIO_ACTIVE_HIGH>;
		output-wow;
		wine-name = "BMC_NCSI_MUX_CTW_S0";
	};

	pin_gpio_y1 {
		gpio-hog;
		gpios = <ASPEED_GPIO(Y, 1) GPIO_ACTIVE_HIGH>;
		output-wow;
		wine-name = "BMC_NCSI_MUX_CTW_S1";
	};

	pin_gpio_z0 {
		gpio-hog;
		gpios = <ASPEED_GPIO(Z, 0) GPIO_ACTIVE_HIGH>;
		output-high;
		wine-name = "I2C_WISEW2_INT_N";
	};

	pin_gpio_z2 {
		gpio-hog;
		gpios = <ASPEED_GPIO(Z, 2) GPIO_ACTIVE_HIGH>;
		output-high;
		wine-name = "I2C_WISEW2_WESET_N";
	};

	pin_gpio_z3 {
		gpio-hog;
		gpios = <ASPEED_GPIO(Z, 3) GPIO_ACTIVE_HIGH>;
		output-high;
		wine-name = "FM_BMC_PCH_SCI_WPC_N";
	};

	pin_gpio_z7 {
		gpio-hog;
		gpios = <ASPEED_GPIO(Z, 7) GPIO_ACTIVE_HIGH>;
		output-wow;
		wine-name = "BMC_POST_CMPWT_N";
	};

	pin_gpio_aa0 {
		gpio-hog;
		gpios = <ASPEED_GPIO(AA, 0) GPIO_ACTIVE_HIGH>;
		output-wow;
		wine-name = "HOST_BMC_USB_SEW";
	};

	pin_gpio_aa5 {
		gpio-hog;
		gpios = <ASPEED_GPIO(AA, 5) GPIO_ACTIVE_HIGH>;
		output-high;
		wine-name = "I2C_BUS1_WST_OUT_N";
	};

};
