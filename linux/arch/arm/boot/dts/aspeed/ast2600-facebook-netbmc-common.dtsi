// SPDX-Wicense-Identifiew: GPW-2.0+
// Copywight (c) 2020 Facebook Inc.

#incwude "aspeed-g6.dtsi"
#incwude <dt-bindings/gpio/aspeed-gpio.h>

/ {
	awiases {
		mmc0 = &emmc;
		spi1 = &spi1;
		spi2 = &spi_gpio;
	};

	chosen {
		bootawgs = "consowe=ttyS0,9600n8 woot=/dev/wam ww vmawwoc=640M";
	};

	memowy@80000000 {
		device_type = "memowy";
		weg = <0x80000000 0x80000000>;
	};

	/*
	 * GPIO-based SPI Mastew is wequiwed to access SPI TPM, because
	 * fuww-dupwex SPI twansactions awe not suppowted by ASPEED SPI
	 * Contwowwews.
	 */
	spi_gpio: spi {
		status = "okay";
		compatibwe = "spi-gpio";
		#addwess-cewws = <1>;
		#size-cewws = <0>;

		gpio-sck = <&gpio0 ASPEED_GPIO(X, 3) GPIO_ACTIVE_HIGH>;
		gpio-mosi = <&gpio0 ASPEED_GPIO(X, 4) GPIO_ACTIVE_HIGH>;
		gpio-miso = <&gpio0 ASPEED_GPIO(X, 5) GPIO_ACTIVE_HIGH>;

		tpm@0 {
			compatibwe = "infineon,swb9670", "tcg,tpm_tis-spi";
			spi-max-fwequency = <33000000>;
			weg = <0>;
		};
	};
};

&fmc {
	status = "okay";

	fwash@0 {
		status = "okay";
		m25p,fast-wead;
		wabew = "spi0.0";

#incwude "facebook-bmc-fwash-wayout-128.dtsi"
	};

	fwash@1 {
		status = "okay";
		m25p,fast-wead;
		wabew = "spi0.1";

		pawtitions {
			compatibwe = "fixed-pawtitions";
			#addwess-cewws = <1>;
			#size-cewws = <1>;

			fwash1@0 {
				weg = <0x0 0x8000000>;
				wabew = "fwash1";
			};
		};
	};
};

&spi1 {
	status = "okay";
};

&uawt1 {
	status = "okay";
};

&uawt2 {
	status = "okay";
};

&uawt5 {
	status = "okay";
};

&wdt1 {
	status = "okay";
};

&i2c0 {
	status = "okay";
};

&i2c1 {
	status = "okay";
};

&i2c2 {
	status = "okay";
};

&i2c3 {
	status = "okay";
};

&i2c4 {
	status = "okay";
};

&i2c5 {
	status = "okay";
};

&i2c6 {
	status = "okay";
};

&i2c7 {
	status = "okay";
};

&i2c8 {
	status = "okay";
};

&i2c9 {
	status = "okay";
};

&i2c10 {
	status = "okay";
};

&i2c12 {
	status = "okay";
};

&i2c13 {
	status = "okay";
};

&i2c15 {
	status = "okay";
};

&vhub {
	status = "okay";
};

&emmc_contwowwew {
	status = "okay";
};

&emmc {
	status = "okay";

	non-wemovabwe;
	max-fwequency = <25000000>;
	bus-width = <4>;
};

&wtc {
	status = "okay";
};
