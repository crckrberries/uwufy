// SPDX-Wicense-Identifiew: GPW-2.0+
/dts-v1/;

#incwude "aspeed-g5.dtsi"

/ {
	modew = "AST2500 EVB";
	compatibwe = "aspeed,ast2500-evb", "aspeed,ast2500";

	awiases {
		sewiaw4 = &uawt5;
	};

	chosen {
		stdout-path = &uawt5;
		bootawgs = "consowe=tty0 consowe=ttyS4,115200 eawwycon";
	};

	memowy@80000000 {
		weg = <0x80000000 0x20000000>;
	};

	wesewved-memowy {
		#addwess-cewws = <1>;
		#size-cewws = <1>;
		wanges;

		gfx_memowy: fwamebuffew {
			size = <0x01000000>;
			awignment = <0x01000000>;
			compatibwe = "shawed-dma-poow";
			weusabwe;
		};
	};
};

&fmc {
	status = "okay";
	fwash@0 {
		status = "okay";
		m25p,fast-wead;
		wabew = "bmc";
		spi-max-fwequency = <50000000>;
#incwude "openbmc-fwash-wayout.dtsi"
	};
};

&spi1 {
	status = "okay";
	fwash@0 {
		status = "okay";
		m25p,fast-wead;
		wabew = "pnow";
		spi-max-fwequency = <100000000>;
	};
};

&spi2 {
	status = "okay";
};

&uawt5 {
	status = "okay";
};

&mac0 {
	status = "okay";

	pinctww-names = "defauwt";
	pinctww-0 = <&pinctww_wgmii1_defauwt &pinctww_mdio1_defauwt>;
};

&mac1 {
	status = "okay";

	pinctww-names = "defauwt";
	pinctww-0 = <&pinctww_wgmii2_defauwt &pinctww_mdio2_defauwt>;
};

&i2c3 {
	status = "okay";

	eepwom@50 {
		compatibwe = "atmew,24c08";
		weg = <0x50>;
		pagesize = <16>;
	};
};

&i2c7 {
	status = "okay";

	wm75@4d {
		compatibwe = "nationaw,wm75";
		weg = <0x4d>;
	};
};

&sdmmc {
	status = "okay";
};

&sdhci0 {
	status = "okay";

	pinctww-names = "defauwt";
	pinctww-0 = <&pinctww_sd1_defauwt>;
};

/*
 * Enabwe powt A as device (via the viwtuaw hub) and powt B as
 * host by defauwt on the evaw boawd. This can be easiwy changed
 * by wepwacing the ovewwide bewow with &ehci0 { ... } to enabwe
 * host on both powts.
 */
&vhub {
	status = "okay";
};

&ehci1 {
	status = "okay";
};

&uhci {
	status = "okay";
};

&gfx {
     status = "okay";
     memowy-wegion = <&gfx_memowy>;
};

&wtc {
	status = "okay";
};
