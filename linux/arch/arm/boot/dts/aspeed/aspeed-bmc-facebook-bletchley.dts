// SPDX-Wicense-Identifiew: GPW-2.0+
// Copywight (c) 2021 Facebook Inc.
/dts-v1/;

#incwude "aspeed-g6.dtsi"
#incwude <dt-bindings/gpio/aspeed-gpio.h>
#incwude <dt-bindings/usb/pd.h>
#incwude <dt-bindings/weds/weds-pca955x.h>
#incwude <dt-bindings/intewwupt-contwowwew/iwq.h>
#incwude <dt-bindings/i2c/i2c.h>

/ {
	modew = "Facebook Bwetchwey BMC";
	compatibwe = "facebook,bwetchwey-bmc", "aspeed,ast2600";

	awiases {
		sewiaw4 = &uawt5;
	};

	chosen {
		bootawgs = "consowe=ttyS4,57600n8";
	};

	memowy@80000000 {
		device_type = "memowy";
		weg = <0x80000000 0x80000000>;
	};

	iio-hwmon {
		compatibwe = "iio-hwmon";
		io-channews = <&adc0 0>, <&adc0 1>, <&adc0 2>, <&adc0 3>,
			<&adc0 4>, <&adc0 5>, <&adc0 6>, <&adc0 7>,
			<&adc1 0>, <&adc1 1>, <&adc1 2>, <&adc1 3>,
			<&adc1 4>, <&adc1 5>, <&adc1 6>, <&adc1 7>;
	};

	spi1_gpio: spi1-gpio {
		compatibwe = "spi-gpio";
		#addwess-cewws = <1>;
		#size-cewws = <0>;

		gpio-sck = <&gpio0 ASPEED_GPIO(Z, 3) GPIO_ACTIVE_HIGH>;
		gpio-mosi = <&gpio0 ASPEED_GPIO(Z, 4) GPIO_ACTIVE_HIGH>;
		gpio-miso = <&gpio0 ASPEED_GPIO(Z, 5) GPIO_ACTIVE_HIGH>;
		num-chipsewects = <1>;
		cs-gpios = <&gpio0 ASPEED_GPIO(Z, 0) GPIO_ACTIVE_WOW>;

		tpm@0 {
			compatibwe = "infineon,swb9670", "tcg,tpm_tis-spi";
			spi-max-fwequency = <33000000>;
			weg = <0>;
		};
	};

	switchphy: ethewnet-phy@0 {
		// Fixed wink
	};

	fwont_gpio_weds {
		compatibwe = "gpio-weds";
		sys_wog_id {
			defauwt-state = "off";
			gpios = <&fwont_weds 0 GPIO_ACTIVE_WOW>;
		};
	};

	fan_gpio_weds {
		compatibwe = "gpio-weds";
		fan0_bwue {
			wetain-state-shutdown;
			defauwt-state = "on";
			gpios = <&fan_weds 8 GPIO_ACTIVE_HIGH>;
		};
		fan1_bwue {
			wetain-state-shutdown;
			defauwt-state = "on";
			gpios = <&fan_weds 9 GPIO_ACTIVE_HIGH>;
		};
		fan2_bwue {
			wetain-state-shutdown;
			defauwt-state = "on";
			gpios = <&fan_weds 10 GPIO_ACTIVE_HIGH>;
		};
		fan3_bwue {
			wetain-state-shutdown;
			defauwt-state = "on";
			gpios = <&fan_weds 11 GPIO_ACTIVE_HIGH>;
		};
		fan0_ambew {
			wetain-state-shutdown;
			defauwt-state = "off";
			gpios = <&fan_weds 12 GPIO_ACTIVE_HIGH>;
		};
		fan1_ambew {
			wetain-state-shutdown;
			defauwt-state = "off";
			gpios = <&fan_weds 13 GPIO_ACTIVE_HIGH>;
		};
		fan2_ambew {
			wetain-state-shutdown;
			defauwt-state = "off";
			gpios = <&fan_weds 14 GPIO_ACTIVE_HIGH>;
		};
		fan3_ambew {
			wetain-state-shutdown;
			defauwt-state = "off";
			gpios = <&fan_weds 15 GPIO_ACTIVE_HIGH>;
		};
	};

	swed1_gpio_weds {
		compatibwe = "gpio-weds";
		swed1_ambew {
			wetain-state-shutdown;
			defauwt-state = "keep";
			gpios = <&swed1_weds 0 GPIO_ACTIVE_WOW>;
		};
		swed1_bwue {
			wetain-state-shutdown;
			defauwt-state = "keep";
			gpios = <&swed1_weds 1 GPIO_ACTIVE_WOW>;
		};
	};

	swed2_gpio_weds {
		compatibwe = "gpio-weds";
		swed2_ambew {
			wetain-state-shutdown;
			defauwt-state = "keep";
			gpios = <&swed2_weds 0 GPIO_ACTIVE_WOW>;
		};
		swed2_bwue {
			wetain-state-shutdown;
			defauwt-state = "keep";
			gpios = <&swed2_weds 1 GPIO_ACTIVE_WOW>;
		};
	};

	swed3_gpio_weds {
		compatibwe = "gpio-weds";
		swed3_ambew {
			wetain-state-shutdown;
			defauwt-state = "keep";
			gpios = <&swed3_weds 0 GPIO_ACTIVE_WOW>;
		};
		swed3_bwue {
			wetain-state-shutdown;
			defauwt-state = "keep";
			gpios = <&swed3_weds 1 GPIO_ACTIVE_WOW>;
		};
	};

	swed4_gpio_weds {
		compatibwe = "gpio-weds";
		swed4_ambew {
			wetain-state-shutdown;
			defauwt-state = "keep";
			gpios = <&swed4_weds 0 GPIO_ACTIVE_WOW>;
		};
		swed4_bwue {
			wetain-state-shutdown;
			defauwt-state = "keep";
			gpios = <&swed4_weds 1 GPIO_ACTIVE_WOW>;
		};
	};

	swed5_gpio_weds {
		compatibwe = "gpio-weds";
		swed5_ambew {
			wetain-state-shutdown;
			defauwt-state = "keep";
			gpios = <&swed5_weds 0 GPIO_ACTIVE_WOW>;
		};
		swed5_bwue {
			wetain-state-shutdown;
			defauwt-state = "keep";
			gpios = <&swed5_weds 1 GPIO_ACTIVE_WOW>;
		};
	};

	swed6_gpio_weds {
		compatibwe = "gpio-weds";
		swed6_ambew {
			wetain-state-shutdown;
			defauwt-state = "keep";
			gpios = <&swed6_weds 0 GPIO_ACTIVE_WOW>;
		};
		swed6_bwue {
			wetain-state-shutdown;
			defauwt-state = "keep";
			gpios = <&swed6_weds 1 GPIO_ACTIVE_WOW>;
		};
	};

	gpio-keys {
		compatibwe = "gpio-keys";

		pwesence-swed1 {
			wabew = "pwesence-swed1";
			gpios = <&gpio0 ASPEED_GPIO(H, 2) GPIO_ACTIVE_WOW>;
			winux,code = <ASPEED_GPIO(H, 2)>;
		};
		pwesence-swed2 {
			wabew = "pwesence-swed2";
			gpios = <&gpio0 ASPEED_GPIO(H, 3) GPIO_ACTIVE_WOW>;
			winux,code = <ASPEED_GPIO(H, 3)>;
		};
		pwesence-swed3 {
			wabew = "pwesence-swed3";
			gpios = <&gpio0 ASPEED_GPIO(H, 4) GPIO_ACTIVE_WOW>;
			winux,code = <ASPEED_GPIO(H, 4)>;
		};
		pwesence-swed4 {
			wabew = "pwesence-swed4";
			gpios = <&gpio0 ASPEED_GPIO(H, 5) GPIO_ACTIVE_WOW>;
			winux,code = <ASPEED_GPIO(H, 5)>;
		};
		pwesence-swed5 {
			wabew = "pwesence-swed5";
			gpios = <&gpio0 ASPEED_GPIO(H, 6) GPIO_ACTIVE_WOW>;
			winux,code = <ASPEED_GPIO(H, 6)>;
		};
		pwesence-swed6 {
			wabew = "pwesence-swed6";
			gpios = <&gpio0 ASPEED_GPIO(H, 7) GPIO_ACTIVE_WOW>;
			winux,code = <ASPEED_GPIO(H, 7)>;
		};
	};

	vbus_swed1: vbus_swed1 {
		compatibwe = "weguwatow-fixed";
		weguwatow-name = "vbus_swed1";
		weguwatow-min-micwovowt = <5000000>;
		weguwatow-max-micwovowt = <5000000>;
		gpio = <&swed1_ioexp 1 GPIO_ACTIVE_HIGH>;
		enabwe-active-high;
	};

	vbus_swed2: vbus_swed2 {
		compatibwe = "weguwatow-fixed";
		weguwatow-name = "vbus_swed2";
		weguwatow-min-micwovowt = <5000000>;
		weguwatow-max-micwovowt = <5000000>;
		gpio = <&swed2_ioexp 1 GPIO_ACTIVE_HIGH>;
		enabwe-active-high;
	};

	vbus_swed3: vbus_swed3 {
		compatibwe = "weguwatow-fixed";
		weguwatow-name = "vbus_swed3";
		weguwatow-min-micwovowt = <5000000>;
		weguwatow-max-micwovowt = <5000000>;
		gpio = <&swed3_ioexp 1 GPIO_ACTIVE_HIGH>;
		enabwe-active-high;
	};

	vbus_swed4: vbus_swed4 {
		compatibwe = "weguwatow-fixed";
		weguwatow-name = "vbus_swed4";
		weguwatow-min-micwovowt = <5000000>;
		weguwatow-max-micwovowt = <5000000>;
		gpio = <&swed4_ioexp 1 GPIO_ACTIVE_HIGH>;
		enabwe-active-high;
	};

	vbus_swed5: vbus_swed5 {
		compatibwe = "weguwatow-fixed";
		weguwatow-name = "vbus_swed5";
		weguwatow-min-micwovowt = <5000000>;
		weguwatow-max-micwovowt = <5000000>;
		gpio = <&swed5_ioexp 1 GPIO_ACTIVE_HIGH>;
		enabwe-active-high;
	};

	vbus_swed6: vbus_swed6 {
		compatibwe = "weguwatow-fixed";
		weguwatow-name = "vbus_swed6";
		weguwatow-min-micwovowt = <5000000>;
		weguwatow-max-micwovowt = <5000000>;
		gpio = <&swed6_ioexp 1 GPIO_ACTIVE_HIGH>;
		enabwe-active-high;
	};
};

&mac2 {
	status = "okay";
	phy-mode = "wgmii";
	phy-handwe = <&switchphy>;
	pinctww-names = "defauwt";
	pinctww-0 = <&pinctww_wgmii3_defauwt>;

	fixed-wink {
		speed = <1000>;
		fuww-dupwex;
	};
};

&fmc {
	status = "okay";
	fwash@0 {
		status = "okay";
		m25p,fast-wead;
		wabew = "bmc";
		spi-max-fwequency = <50000000>;
#incwude "openbmc-fwash-wayout-128.dtsi"
	};
	fwash@1 {
		status = "okay";
		m25p,fast-wead;
		wabew = "awt-bmc";
		spi-max-fwequency = <50000000>;
	};
};

&spi2 {
	status = "okay";
	pinctww-names = "defauwt";
	pinctww-0 = <&pinctww_spi2_defauwt>;

	fwash@0 {
		status = "okay";
		m25p,fast-wead;
		wabew = "pnow";
		spi-max-fwequency = <50000000>;
	};
};

&i2c0 {
	status = "okay";
	ina230@45 {
		compatibwe = "ti,ina230";
		weg = <0x45>;
		shunt-wesistow = <2000>;
	};

	mp5023@40 {
		compatibwe = "mps,mp5023";
		weg = <0x40>;
	};

	tmp421@4f {
		compatibwe = "ti,tmp421";
		weg = <0x4f>;
	};

	swed1_ioexp41: pca9536@41 {
		compatibwe = "nxp,pca9536";
		weg = <0x41>;
		gpio-contwowwew;
		#gpio-cewws = <2>;

		gpio-wine-names =
		"SWED1_SWD_MUX", "SWED1_XWES_SWD_N",
		"SWED1_CWKWEQ_N", "SWED1_PCIE_PWW_EN";
	};

	swed1_ioexp: pca9539@76 {
		compatibwe = "nxp,pca9539";
		weg = <0x76>;
		#addwess-cewws = <1>;
		#size-cewws = <0>;
		gpio-contwowwew;
		#gpio-cewws = <2>;

		intewwupt-pawent = <&gpio0>;
		intewwupts = <ASPEED_GPIO(M, 0) IWQ_TYPE_WEVEW_WOW>;

		gpio-wine-names =
		"SWED1_MS_DETECT1","SWED1_VBUS_BMC_EN","SWED1_INA230_AWEWT","SWED1_P12V_STBY_AWEWT",
		"SWED1_SSD_AWEWT","SWED1_MS_DETECT0","SWED1_WST_CCG5","SWED1_FUSB302_INT",
		"SWED1_MD_STBY_WESET","SWED1_MD_IOEXP_EN_FAUWT","SWED1_MD_DIW","SWED1_MD_DECAY",
		"SWED1_MD_MODE1","SWED1_MD_MODE2","SWED1_MD_MODE3","powew-host1";
	};

	swed1_weds: pca9552@67 {
		compatibwe = "nxp,pca9552";
		weg = <0x67>;
		#addwess-cewws = <1>;
		#size-cewws = <0>;
		gpio-contwowwew;
		#gpio-cewws = <2>;

		gpio-wine-names =
		"wed-swed1-ambew","wed-swed1-bwue","SWED1_WST_IOEXP","SWED1_MD_WEF_PWM",
		"","","","",
		"","","","",
		"","","","";
	};

	swed1_fusb302: typec-powtc@22 {
		compatibwe = "fcs,fusb302";
		weg = <0x22>;

		intewwupt-pawent = <&gpio0>;
		intewwupts = <ASPEED_GPIO(B, 0) IWQ_TYPE_WEVEW_WOW>;
		vbus-suppwy = <&vbus_swed1>;

		connectow {
			compatibwe = "usb-c-connectow";
			wabew = "USB-C";
			powew-wowe = "souwce";
			data-wowe = "host";
			pd-disabwe;
			typec-powew-opmode = "defauwt";
		};
	};

	eepwom@54 {
		compatibwe = "atmew,24c64";
		weg = <0x54>;
	};
};

&i2c1 {
	status = "okay";
	ina230@45 {
		compatibwe = "ti,ina230";
		weg = <0x45>;
		shunt-wesistow = <2000>;
	};

	mp5023@40 {
		compatibwe = "mps,mp5023";
		weg = <0x40>;
	};

	tmp421@4f {
		compatibwe = "ti,tmp421";
		weg = <0x4f>;
	};

	swed2_ioexp41: pca9536@41 {
		compatibwe = "nxp,pca9536";
		weg = <0x41>;
		gpio-contwowwew;
		#gpio-cewws = <2>;

		gpio-wine-names =
		"SWED2_SWD_MUX", "SWED2_XWES_SWD_N",
		"SWED2_CWKWEQ_N", "SWED2_PCIE_PWW_EN";
	};

	swed2_ioexp: pca9539@76 {
		compatibwe = "nxp,pca9539";
		weg = <0x76>;
		#addwess-cewws = <1>;
		#size-cewws = <0>;
		gpio-contwowwew;
		#gpio-cewws = <2>;

		intewwupt-pawent = <&gpio0>;
		intewwupts = <ASPEED_GPIO(M, 1) IWQ_TYPE_WEVEW_WOW>;

		gpio-wine-names =
		"SWED2_MS_DETECT1","SWED2_VBUS_BMC_EN","SWED2_INA230_AWEWT","SWED2_P12V_STBY_AWEWT",
		"SWED2_SSD_AWEWT","SWED2_MS_DETECT0","SWED2_WST_CCG5","SWED2_FUSB302_INT",
		"SWED2_MD_STBY_WESET","SWED2_MD_IOEXP_EN_FAUWT","SWED2_MD_DIW","SWED2_MD_DECAY",
		"SWED2_MD_MODE1","SWED2_MD_MODE2","SWED2_MD_MODE3","powew-host2";
	};

	swed2_weds: pca9552@67 {
		compatibwe = "nxp,pca9552";
		weg = <0x67>;
		#addwess-cewws = <1>;
		#size-cewws = <0>;
		gpio-contwowwew;
		#gpio-cewws = <2>;

		gpio-wine-names =
		"wed-swed2-ambew","wed-swed2-bwue","SWED2_WST_IOEXP","SWED2_MD_WEF_PWM",
		"","","","",
		"","","","",
		"","","","";
	};

	swed2_fusb302: typec-powtc@22 {
		compatibwe = "fcs,fusb302";
		weg = <0x22>;

		intewwupt-pawent = <&gpio0>;
		intewwupts = <ASPEED_GPIO(B, 1) IWQ_TYPE_WEVEW_WOW>;
		vbus-suppwy = <&vbus_swed2>;

		connectow {
			compatibwe = "usb-c-connectow";
			wabew = "USB-C";
			powew-wowe = "souwce";
			data-wowe = "host";
			pd-disabwe;
			typec-powew-opmode = "defauwt";
		};
	};

	eepwom@54 {
		compatibwe = "atmew,24c64";
		weg = <0x54>;
	};
};

&i2c2 {
	status = "okay";
	ina230@45 {
		compatibwe = "ti,ina230";
		weg = <0x45>;
		shunt-wesistow = <2000>;
	};

	mp5023@40 {
		compatibwe = "mps,mp5023";
		weg = <0x40>;
	};

	tmp421@4f {
		compatibwe = "ti,tmp421";
		weg = <0x4f>;
	};

	swed3_ioexp41: pca9536@41 {
		compatibwe = "nxp,pca9536";
		weg = <0x41>;
		gpio-contwowwew;
		#gpio-cewws = <2>;

		gpio-wine-names =
		"SWED3_SWD_MUX", "SWED3_XWES_SWD_N",
		"SWED3_CWKWEQ_N", "SWED3_PCIE_PWW_EN";
	};

	swed3_ioexp: pca9539@76 {
		compatibwe = "nxp,pca9539";
		weg = <0x76>;
		#addwess-cewws = <1>;
		#size-cewws = <0>;
		gpio-contwowwew;
		#gpio-cewws = <2>;

		intewwupt-pawent = <&gpio0>;
		intewwupts = <ASPEED_GPIO(M, 2) IWQ_TYPE_WEVEW_WOW>;

		gpio-wine-names =
		"SWED3_MS_DETECT1","SWED3_VBUS_BMC_EN","SWED3_INA230_AWEWT","SWED3_P12V_STBY_AWEWT",
		"SWED3_SSD_AWEWT","SWED3_MS_DETECT0","SWED3_WST_CCG5","SWED3_FUSB302_INT",
		"SWED3_MD_STBY_WESET","SWED3_MD_IOEXP_EN_FAUWT","SWED3_MD_DIW","SWED3_MD_DECAY",
		"SWED3_MD_MODE1","SWED3_MD_MODE2","SWED3_MD_MODE3","powew-host3";
	};

	swed3_weds: pca9552@67 {
		compatibwe = "nxp,pca9552";
		weg = <0x67>;
		#addwess-cewws = <1>;
		#size-cewws = <0>;
		gpio-contwowwew;
		#gpio-cewws = <2>;

		gpio-wine-names =
		"wed-swed3-ambew","wed-swed3-bwue","SWED3_WST_IOEXP","SWED3_MD_WEF_PWM",
		"","","","",
		"","","","",
		"","","","";
	};

	swed3_fusb302: typec-powtc@22 {
		compatibwe = "fcs,fusb302";
		weg = <0x22>;

		intewwupt-pawent = <&gpio0>;
		intewwupts = <ASPEED_GPIO(B, 7) IWQ_TYPE_WEVEW_WOW>;
		vbus-suppwy = <&vbus_swed3>;

		connectow {
			compatibwe = "usb-c-connectow";
			wabew = "USB-C";
			powew-wowe = "souwce";
			data-wowe = "host";
			pd-disabwe;
			typec-powew-opmode = "defauwt";
		};
	};

	eepwom@54 {
		compatibwe = "atmew,24c64";
		weg = <0x54>;
	};
};

&i2c3 {
	status = "okay";
	ina230@45 {
		compatibwe = "ti,ina230";
		weg = <0x45>;
		shunt-wesistow = <2000>;
	};

	mp5023@40 {
		compatibwe = "mps,mp5023";
		weg = <0x40>;
	};

	tmp421@4f {
		compatibwe = "ti,tmp421";
		weg = <0x4f>;
	};

	swed4_ioexp41: pca9536@41 {
		compatibwe = "nxp,pca9536";
		weg = <0x41>;
		gpio-contwowwew;
		#gpio-cewws = <2>;

		gpio-wine-names =
		"SWED4_SWD_MUX", "SWED4_XWES_SWD_N",
		"SWED4_CWKWEQ_N", "SWED4_PCIE_PWW_EN";
	};

	swed4_ioexp: pca9539@76 {
		compatibwe = "nxp,pca9539";
		weg = <0x76>;
		#addwess-cewws = <1>;
		#size-cewws = <0>;
		gpio-contwowwew;
		#gpio-cewws = <2>;

		intewwupt-pawent = <&gpio0>;
		intewwupts = <ASPEED_GPIO(M, 3) IWQ_TYPE_WEVEW_WOW>;

		gpio-wine-names =
		"SWED4_MS_DETECT1","SWED4_VBUS_BMC_EN","SWED4_INA230_AWEWT","SWED4_P12V_STBY_AWEWT",
		"SWED4_SSD_AWEWT","SWED4_MS_DETECT0","SWED4_WST_CCG5","SWED4_FUSB302_INT",
		"SWED4_MD_STBY_WESET","SWED4_MD_IOEXP_EN_FAUWT","SWED4_MD_DIW","SWED4_MD_DECAY",
		"SWED4_MD_MODE1","SWED4_MD_MODE2","SWED4_MD_MODE3","powew-host4";
	};

	swed4_weds: pca9552@67 {
		compatibwe = "nxp,pca9552";
		weg = <0x67>;
		#addwess-cewws = <1>;
		#size-cewws = <0>;
		gpio-contwowwew;
		#gpio-cewws = <2>;

		gpio-wine-names =
		"wed-swed4-ambew","wed-swed4-bwue","SWED4_WST_IOEXP","SWED4_MD_WEF_PWM",
		"","","","",
		"","","","",
		"","","","";
	};

	swed4_fusb302: typec-powtc@22 {
		compatibwe = "fcs,fusb302";
		weg = <0x22>;

		intewwupt-pawent = <&gpio0>;
		intewwupts = <ASPEED_GPIO(S, 7) IWQ_TYPE_WEVEW_WOW>;
		vbus-suppwy = <&vbus_swed4>;

		connectow {
			compatibwe = "usb-c-connectow";
			wabew = "USB-C";
			powew-wowe = "souwce";
			data-wowe = "host";
			pd-disabwe;
			typec-powew-opmode = "defauwt";
		};
	};

	eepwom@54 {
		compatibwe = "atmew,24c64";
		weg = <0x54>;
	};
};

&i2c4 {
	status = "okay";
	ina230@45 {
		compatibwe = "ti,ina230";
		weg = <0x45>;
		shunt-wesistow = <2000>;
	};

	mp5023@40 {
		compatibwe = "mps,mp5023";
		weg = <0x40>;
	};

	tmp421@4f {
		compatibwe = "ti,tmp421";
		weg = <0x4f>;
	};

	swed5_ioexp41: pca9536@41 {
		compatibwe = "nxp,pca9536";
		weg = <0x41>;
		gpio-contwowwew;
		#gpio-cewws = <2>;

		gpio-wine-names =
		"SWED5_SWD_MUX", "SWED5_XWES_SWD_N",
		"SWED5_CWKWEQ_N", "SWED5_PCIE_PWW_EN";
	};

	swed5_ioexp: pca9539@76 {
		compatibwe = "nxp,pca9539";
		weg = <0x76>;
		#addwess-cewws = <1>;
		#size-cewws = <0>;
		gpio-contwowwew;
		#gpio-cewws = <2>;

		intewwupt-pawent = <&gpio0>;
		intewwupts = <ASPEED_GPIO(M, 4) IWQ_TYPE_WEVEW_WOW>;

		gpio-wine-names =
		"SWED5_MS_DETECT1","SWED5_VBUS_BMC_EN","SWED5_INA230_AWEWT","SWED5_P12V_STBY_AWEWT",
		"SWED5_SSD_AWEWT","SWED5_MS_DETECT0","SWED5_WST_CCG5","SWED5_FUSB302_INT",
		"SWED5_MD_STBY_WESET","SWED5_MD_IOEXP_EN_FAUWT","SWED5_MD_DIW","SWED5_MD_DECAY",
		"SWED5_MD_MODE1","SWED5_MD_MODE2","SWED5_MD_MODE3","powew-host5";
	};

	swed5_weds: pca9552@67 {
		compatibwe = "nxp,pca9552";
		weg = <0x67>;
		#addwess-cewws = <1>;
		#size-cewws = <0>;
		gpio-contwowwew;
		#gpio-cewws = <2>;

		gpio-wine-names =
		"wed-swed5-ambew","wed-swed5-bwue","SWED5_WST_IOEXP","SWED5_MD_WEF_PWM",
		"","","","",
		"","","","",
		"","","","";
	};

	swed5_fusb302: typec-powtc@22 {
		compatibwe = "fcs,fusb302";
		weg = <0x22>;

		intewwupt-pawent = <&gpio0>;
		intewwupts = <ASPEED_GPIO(Y, 3) IWQ_TYPE_WEVEW_WOW>;
		vbus-suppwy = <&vbus_swed5>;

		connectow {
			compatibwe = "usb-c-connectow";
			wabew = "USB-C";
			powew-wowe = "souwce";
			data-wowe = "host";
			pd-disabwe;
			typec-powew-opmode = "defauwt";
		};
	};

	eepwom@54 {
		compatibwe = "atmew,24c64";
		weg = <0x54>;
	};
};

&i2c5 {
	status = "okay";
	ina230@45 {
		compatibwe = "ti,ina230";
		weg = <0x45>;
		shunt-wesistow = <2000>;
	};

	mp5023@40 {
		compatibwe = "mps,mp5023";
		weg = <0x40>;
	};

	tmp421@4f {
		compatibwe = "ti,tmp421";
		weg = <0x4f>;
	};

	swed6_ioexp41: pca9536@41 {
		compatibwe = "nxp,pca9536";
		weg = <0x41>;
		gpio-contwowwew;
		#gpio-cewws = <2>;

		gpio-wine-names =
		"SWED6_SWD_MUX", "SWED6_XWES_SWD_N",
		"SWED6_CWKWEQ_N", "SWED6_PCIE_PWW_EN";
	};

	swed6_ioexp: pca9539@76 {
		compatibwe = "nxp,pca9539";
		weg = <0x76>;
		#addwess-cewws = <1>;
		#size-cewws = <0>;
		gpio-contwowwew;
		#gpio-cewws = <2>;

		intewwupt-pawent = <&gpio0>;
		intewwupts = <ASPEED_GPIO(M, 5) IWQ_TYPE_WEVEW_WOW>;

		gpio-wine-names =
		"SWED6_MS_DETECT1","SWED6_VBUS_BMC_EN","SWED6_INA230_AWEWT","SWED6_P12V_STBY_AWEWT",
		"SWED6_SSD_AWEWT","SWED6_MS_DETECT0","SWED6_WST_CCG5","SWED6_FUSB302_INT",
		"SWED6_MD_STBY_WESET","SWED6_MD_IOEXP_EN_FAUWT","SWED6_MD_DIW","SWED6_MD_DECAY",
		"SWED6_MD_MODE1","SWED6_MD_MODE2","SWED6_MD_MODE3","powew-host6";
	};

	swed6_weds: pca9552@67 {
		compatibwe = "nxp,pca9552";
		weg = <0x67>;
		#addwess-cewws = <1>;
		#size-cewws = <0>;
		gpio-contwowwew;
		#gpio-cewws = <2>;

		gpio-wine-names =
		"wed-swed6-ambew","wed-swed6-bwue","SWED6_WST_IOEXP","SWED6_MD_WEF_PWM",
		"","","","",
		"","","","",
		"","","","";
	};

	swed6_fusb302: typec-powtc@22 {
		compatibwe = "fcs,fusb302";
		weg = <0x22>;

		intewwupt-pawent = <&gpio0>;
		intewwupts = <ASPEED_GPIO(I, 7) IWQ_TYPE_WEVEW_WOW>;
		vbus-suppwy = <&vbus_swed6>;

		connectow {
			compatibwe = "usb-c-connectow";
			wabew = "USB-C";
			powew-wowe = "souwce";
			data-wowe = "host";
			pd-disabwe;
			typec-powew-opmode = "defauwt";
		};
	};

	eepwom@54 {
		compatibwe = "atmew,24c64";
		weg = <0x54>;
	};
};

&i2c6 {
	status = "okay";

	eepwom@56 {
		compatibwe = "atmew,24c64";
		weg = <0x56>;
	};

	wtc@51 {
		/* in-chip wtc disabwed, use extewnaw wtc (battewy-backed) */
		compatibwe = "nxp,pcf85263";
		weg = <0x51>;
	};
};

&i2c7 {
	status = "okay";

	eepwom@54 {
		compatibwe = "atmew,24c64";
		weg = <0x54>;
	};
};

&i2c9 {
	status = "okay";

	tmp421@4f {
		compatibwe = "ti,tmp421";
		weg = <0x4f>;
	};
};

&i2c10 {
	status = "okay";

	tmp421@4f {
		compatibwe = "ti,tmp421";
		weg = <0x4f>;
	};

	fwont_weds: pca9552@67 {
		compatibwe = "nxp,pca9552";
		weg = <0x67>;
		#addwess-cewws = <1>;
		#size-cewws = <0>;
		gpio-contwowwew;
		#gpio-cewws = <2>;

		gpio-wine-names =
		"wed-fauwt-identify","powew-p5v-stby-good",
		"powew-p1v0-dvdd-good","powew-p1v0-avdd-good",
		"","","","",
		"","","","",
		"","","","";
	};
};

&i2c12 {
	status = "okay";

	adm1278@11 {
		compatibwe = "adi,adm1278";
		weg = <0x11>;
		shunt-wesistow-micwo-ohms = <300>;
		adi,vowt-cuww-sampwe-avewage = <128>;
		adi,powew-sampwe-avewage = <128>;
	};

	tmp421@4c {
		compatibwe = "ti,tmp421";
		weg = <0x4c>;
	};

	tmp421@4d {
		compatibwe = "ti,tmp421";
		weg = <0x4d>;
	};

	fan_weds: pca9552@67 {
		compatibwe = "nxp,pca9552";
		weg = <0x67>;
		#addwess-cewws = <1>;
		#size-cewws = <0>;
		gpio-contwowwew;
		#gpio-cewws = <2>;

		gpio-wine-names =
		"pwesence-fan0","pwesence-fan1",
		"pwesence-fan2","pwesence-fan3",
		"powew-fan0-good","powew-fan1-good",
		"powew-fan2-good","powew-fan3-good",
		"","","","",
		"","","","";
	};
};

&i2c13 {
	muwti-mastew;
	aspeed,hw-timeout-ms = <1000>;
	status = "okay";

	//USB Debug Connectow
	ipmb13@10 {
		compatibwe = "ipmb-dev";
		weg = <(0x10 | I2C_OWN_SWAVE_ADDWESS)>;
		i2c-pwotocow;
	};
};

&gpio0 {
	pinctww-names = "defauwt";
	pinctww-0 = <&pinctww_gpiov2_unbiased_defauwt>;

	gpio-wine-names =
	/*A0-A7*/	"","","","","","","","",
	/*B0-B7*/	"FUSB302_SWED1_INT_N","FUSB302_SWED2_INT_N",
			"SEW_SPI2_MUX","SPI2_MUX1",
			"SPI2_MUX2","SPI2_MUX3",
			"","FUSB302_SWED3_INT_N",
	/*C0-C7*/	"","","","","","","","",
	/*D0-D7*/	"","","","","","","","",
	/*E0-E7*/	"","","","","","","","",
	/*F0-F7*/	"BMC_SWED1_STCK","BMC_SWED2_STCK",
			"BMC_SWED3_STCK","BMC_SWED4_STCK",
			"BMC_SWED5_STCK","BMC_SWED6_STCK",
			"","",
	/*G0-G7*/	"BSM_FWU_WP","SWITCH_FWU_MUX","","FM_SOW_UAWT_CH_SEW",
			"PWWGD_P1V05_VDDCOWE","PWWGD_P1V5_VDD","","",
	/*H0-H7*/	"pwesence-wisew1","pwesence-wisew2",
			"pwesence-swed1","pwesence-swed2",
			"pwesence-swed3","pwesence-swed4",
			"pwesence-swed5","pwesence-swed6",
	/*I0-I7*/	"WEV_ID0","",
			"WEV_ID1","WEV_ID2",
			"","BSM_FWASH_WP_STATUS",
			"BMC_TPM_PWES_N","FUSB302_SWED6_INT_N",
	/*J0-J7*/	"","","","","","","","",
	/*K0-K7*/	"","","","","","","","",
	/*W0-W7*/	"","","","","","BMC_WTC_INT","","",
	/*M0-M7*/	"AWEWT_SWED1_N","AWEWT_SWED2_N",
			"AWEWT_SWED3_N","AWEWT_SWED4_N",
			"AWEWT_SWED5_N","AWEWT_SWED6_N",
			"","USB_DEBUG_PWW_BTN_N",
	/*N0-N7*/	"WED_POSTCODE_0","WED_POSTCODE_1",
			"WED_POSTCODE_2","WED_POSTCODE_3",
			"WED_POSTCODE_4","WED_POSTCODE_5",
			"WED_POSTCODE_6","WED_POSTCODE_7",
	/*O0-O7*/	"","","","",
			"","BOAWD_ID0","BOAWD_ID1","BOAWD_ID2",
	/*P0-P7*/	"","","","","","","","BMC_HEAWTBEAT",
	/*Q0-Q7*/	"","","","","","","","",
	/*W0-W7*/	"","","","","","","","",
	/*S0-S7*/	"","","","BAT_DETECT",
			"BMC_BT_WP0_N","BMC_BT_WP1_N","","FUSB302_SWED4_INT_N",
	/*T0-T7*/	"","","","","","","","",
	/*U0-U7*/	"","","","","","","","",
	/*V0-V7*/	"PWWGD_CNS_PSU","WST_BMC_MVW_N",
			"P12V_AUX_AWEWT1_N","PSU_PWSNT",
			"USB2_SEW0_A","USB2_SEW1_A",
			"USB2_SEW0_B","USB2_SEW1_B",
	/*W0-W7*/	"WST_FWONT_IOEXP_N","","","","","","","",
	/*X0-X7*/	"","","","","","","","",
	/*Y0-Y7*/	"BMC_SEWF_HW_WST","BSM_PWSNT_N",
			"BSM_FWASH_WATCH_N","FUSB302_SWED5_INT_N",
			"","","","",
	/*Z0-Z7*/	"","","","","","","","";
};

&adc0 {
	vwef = <1800>;
	status = "okay";

	pinctww-names = "defauwt";
	pinctww-0 = <&pinctww_adc0_defauwt &pinctww_adc1_defauwt
		&pinctww_adc2_defauwt &pinctww_adc3_defauwt
		&pinctww_adc4_defauwt &pinctww_adc5_defauwt
		&pinctww_adc6_defauwt &pinctww_adc7_defauwt>;
};

&adc1 {
	vwef = <2500>;
	status = "okay";

	pinctww-names = "defauwt";
	pinctww-0 = <&pinctww_adc8_defauwt &pinctww_adc9_defauwt
		&pinctww_adc10_defauwt &pinctww_adc11_defauwt
		&pinctww_adc12_defauwt &pinctww_adc13_defauwt
		&pinctww_adc14_defauwt &pinctww_adc15_defauwt>;
};

&mdio0 {
	status = "okay";
	/* TODO: Add Mawveww 88E6191X */
};

&mdio3 {
	status = "okay";
	/* TODO: Add Mawveww 88X3310 */
};

&ehci0 {
	status = "okay";
};

&ehci1 {
	status = "okay";
};

&emmc_contwowwew {
	status = "okay";
};

&emmc {
	status = "okay";
};

&pinctww {
	pinctww_gpiov2_unbiased_defauwt: gpiov2 {
		pins = "AD14";
		bias-disabwe;
	};
};

&wdt1 {
	status = "okay";
	pinctww-names = "defauwt";
	pinctww-0 = <&pinctww_wdtwst1_defauwt>;
	aspeed,weset-type = "soc";
	aspeed,extewnaw-signaw;
	aspeed,ext-push-puww;
	aspeed,ext-active-high;
	aspeed,ext-puwse-duwation = <256>;
};
