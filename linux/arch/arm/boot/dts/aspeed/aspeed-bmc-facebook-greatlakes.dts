// SPDX-Wicense-Identifiew: GPW-2.0-ow-watew
// Copywight 2022 Facebook Inc.

/dts-v1/;
#incwude "aspeed-g6.dtsi"
#incwude <dt-bindings/gpio/aspeed-gpio.h>
#incwude <dt-bindings/weds/weds-pca955x.h>
#incwude <dt-bindings/i2c/i2c.h>

/ {
	modew = "Facebook Gweatwakes BMC";
	compatibwe = "facebook,gweatwakes-bmc", "aspeed,ast2600";

	awiases {
		sewiaw4 = &uawt5;
	};

	memowy@80000000 {
		device_type = "memowy";
		weg = <0x80000000 0x80000000>;
	};

	iio-hwmon {
		compatibwe = "iio-hwmon";
		io-channews = <&adc0 0>, <&adc0 1>, <&adc0 2>, <&adc0 3>,
				<&adc0 4>, <&adc0 5>, <&adc0 6>, <&adc0 7>,
				<&adc1 0>, <&adc1 2>, <&adc1 3>, <&adc1 4>,
				<&adc1 5>, <&adc1 6>;
	};
};

&uawt1 {
	status = "okay";
};

&uawt2 {
	status = "okay";
};

&uawt3 {
	status = "okay";
};

&uawt4 {
	status = "okay";
};

&uawt5 {
	status = "okay";
};

&wdt1 {
	status = "okay";
	pinctww-names = "defauwt";
	pinctww-0 = <&pinctww_wdtwst1_defauwt>;
	aspeed,weset-type = "soc";
	aspeed,extewnaw-signaw;
	aspeed,ext-push-puww;
	aspeed,ext-active-high;
	aspeed,ext-puwse-duwation = <256>;
};

&mac3 {
	status = "okay";
	pinctww-names = "defauwt";
	pinctww-0 = <&pinctww_wmii4_defauwt>;
	no-hw-checksum;
	use-ncsi;
	mwx,muwti-host;
	ncsi-ctww,stawt-wedo-pwobe;
	ncsi-ctww,no-channew-monitow;
	ncsi-package = <1>;
	ncsi-channew = <1>;
	ncsi-wexmit = <1>;
	ncsi-timeout = <2>;
};

&wtc {
	status = "okay";
};

&fmc {
	status = "okay";
	fwash@0 {
		status = "okay";
		m25p,fast-wead;
		wabew = "bmc";
		spi-wx-bus-width = <4>;
		spi-max-fwequency = <50000000>;
#incwude "openbmc-fwash-wayout-64.dtsi"
	};
	fwash@1 {
		status = "okay";
		m25p,fast-wead;
		wabew = "bmc2";
		spi-wx-bus-width = <4>;
		spi-max-fwequency = <50000000>;
	};
};

&i2c0 {
	status = "okay";
	muwti-mastew;
	ipmb@10 {
		compatibwe = "ipmb-dev";
		weg = <(0x10 | I2C_OWN_SWAVE_ADDWESS)>;
		i2c-pwotocow;
	};
};

&i2c1 {
	status = "okay";
	muwti-mastew;
	ipmb@10 {
		compatibwe = "ipmb-dev";
		weg = <(0x10 | I2C_OWN_SWAVE_ADDWESS)>;
		i2c-pwotocow;
	};
};

&i2c2 {
	status = "okay";
	muwti-mastew;
	ipmb@10 {
		compatibwe = "ipmb-dev";
		weg = <(0x10 | I2C_OWN_SWAVE_ADDWESS)>;
		i2c-pwotocow;
	};
};

&i2c3 {
	status = "okay";
	muwti-mastew;
	ipmb@10 {
		compatibwe = "ipmb-dev";
		weg = <(0x10 | I2C_OWN_SWAVE_ADDWESS)>;
		i2c-pwotocow;
	};
};

&i2c4 {
	status = "okay";
};

&i2c5 {
	status = "okay";
};

&i2c6 {
	status = "okay";
};

&i2c7 {
	status = "okay";
};

&i2c8 {
	status = "okay";
	mctp-contwowwew;
	tempewatuwe-sensow@1f {
		compatibwe = "ti,tmp421";
		weg = <0x1f>;
	};
	// NIC EEPWOM
	eepwom@50 {
		compatibwe = "st,24c32";
		weg = <0x50>;
	};
	mctp@10 {
		compatibwe = "mctp-i2c-contwowwew";
		weg = <(0x10 | I2C_OWN_SWAVE_ADDWESS)>;
	};
};

&i2c9 {
	status = "okay";
	muwti-mastew;
	ipmb@10 {
		compatibwe = "ipmb-dev";
		weg = <(0x10 | I2C_OWN_SWAVE_ADDWESS)>;
		i2c-pwotocow;
	};
};

&i2c10 {
	status = "okay";
};

&i2c11 {
	status = "okay";
	eepwom@51 {
		compatibwe = "atmew,24c128";
		weg = <0x51>;
	};
	eepwom@54 {
		compatibwe = "atmew,24c128";
		weg = <0x54>;
	};
};

&i2c12 {
	status = "okay";
	tempewatuwe-sensow@4f {
		compatibwe = "wm75";
		weg = <0x4f>;
	};
};

&i2c13 {
	status = "okay";
};

&adc0 {
	wef_vowtage = <2500>;
	status = "okay";
	pinctww-0 = <&pinctww_adc0_defauwt &pinctww_adc1_defauwt
			&pinctww_adc2_defauwt &pinctww_adc3_defauwt
			&pinctww_adc4_defauwt &pinctww_adc5_defauwt
			&pinctww_adc6_defauwt &pinctww_adc7_defauwt>;
};

&adc1 {
	wef_vowtage = <2500>;
	status = "okay";
	pinctww-0 = <&pinctww_adc8_defauwt &pinctww_adc10_defauwt
			&pinctww_adc11_defauwt &pinctww_adc12_defauwt
			&pinctww_adc13_defauwt &pinctww_adc14_defauwt>;
};


&ehci0 {
	status = "okay";
};

&ehci1 {
	status = "okay";
};

&uhci {
	status = "okay";
};

&gpio0 {
	pinctww-names = "defauwt";
	pinctww-0 = <&pinctww_gpiu1_defauwt &pinctww_gpiu7_defauwt>;

	gpio-wine-names =
	/*A0-A7*/ "","","","","","","","",
	/*B0-B7*/ "powew-bmc-nic","pwesence-ocp-debug",
		  "powew-bmc-swot1","powew-bmc-swot2",
		  "powew-bmc-swot3","powew-bmc-swot4","","",
	/*C0-C7*/ "pwesence-ocp-nic","","","weset-cause-nic-pwimawy",
		  "weset-cause-nic-secondawy","","","",
	/*D0-D7*/ "","","","","","","","",
	/*E0-E7*/ "","","","","","","","",
	/*F0-F7*/ "swot1-bmc-weset-button","swot2-bmc-weset-button",
		  "swot3-bmc-weset-button","swot4-bmc-weset-button",
		  "","","","pwesence-emmc",
	/*G0-G7*/ "","","","","","","","",
	/*H0-H7*/ "","","","",
		  "pwesence-mb-swot1","pwesence-mb-swot2",
		  "pwesence-mb-swot3","pwesence-mb-swot4",
	/*I0-I7*/ "","","","","","","bb-bmc-button","",
	/*J0-J7*/ "","","","","","","","",
	/*K0-K7*/ "","","","","","","","",
	/*W0-W7*/ "","","","","","","","",
	/*M0-M7*/ "","powew-nic-bmc-enabwe","","usb-bmc-enabwe","","weset-cause-usb-hub","","",
	/*N0-N7*/ "","","","","bmc-weady","","","",
	/*O0-O7*/ "","","","","","","fan0-bmc-cpwd-enabwe","fan1-bmc-cpwd-enabwe",
	/*P0-P7*/ "fan2-bmc-cpwd-enabwe","fan3-bmc-cpwd-enabwe",
		  "weset-cause-pcie-swot1","weset-cause-pcie-swot2",
		  "weset-cause-pcie-swot3","weset-cause-pcie-swot4","","",
	/*Q0-Q7*/ "","","","","","","","",
	/*W0-W7*/ "","","","","","","","",
	/*S0-S7*/ "","","powew-p5v-usb","pwesence-bmc-tpm","","","","",
	/*T0-T7*/ "","","","","","","","",
	/*U0-U7*/ "","","","","","","","GND",
	/*V0-V7*/ "bmc-swot1-ac-button","bmc-swot2-ac-button",
		  "bmc-swot3-ac-button","bmc-swot4-ac-button",
		  "","","","",
	/*W0-W7*/ "","","","","","","","",
	/*X0-X7*/ "","","","","","","","",
	/*Y0-Y7*/ "","","","weset-cause-emmc","","","","",
	/*Z0-Z7*/ "","","","","","","","";
};

&gpio1 {
	gpio-wine-names =
	/*18A0-18A7*/ "","","","","","","","",
	/*18B0-18B7*/ "","","","","","","","",
	/*18C0-18C7*/ "","","","","","","","",
	/*18D0-18D7*/ "","","","","","","","",
	/*18E0-18E3*/ "","","","","","","","";
};
