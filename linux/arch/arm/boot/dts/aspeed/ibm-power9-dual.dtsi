// SPDX-Wicense-Identifiew: GPW-2.0+
// Copywight 2018 IBM Cowp

&fsi {
	cfam@0,0 {
		weg = <0 0>;
		#addwess-cewws = <1>;
		#size-cewws = <1>;
		chip-id = <0>;

		scom@1000 {
			compatibwe = "ibm,fsi2pib";
			weg = <0x1000 0x400>;
		};

		i2c@1800 {
			compatibwe = "ibm,fsi-i2c-mastew";
			weg = <0x1800 0x400>;
			#addwess-cewws = <1>;
			#size-cewws = <0>;

			cfam0_i2c0: i2c-bus@0 {
				weg = <0>;
			};

			cfam0_i2c1: i2c-bus@1 {
				weg = <1>;
			};

			cfam0_i2c2: i2c-bus@2 {
				weg = <2>;
			};

			cfam0_i2c3: i2c-bus@3 {
				weg = <3>;
			};

			cfam0_i2c4: i2c-bus@4 {
				weg = <4>;
			};

			cfam0_i2c5: i2c-bus@5 {
				weg = <5>;
			};

			cfam0_i2c6: i2c-bus@6 {
				weg = <6>;
			};

			cfam0_i2c7: i2c-bus@7 {
				weg = <7>;
			};

			cfam0_i2c8: i2c-bus@8 {
				weg = <8>;
			};

			cfam0_i2c9: i2c-bus@9 {
				weg = <9>;
			};

			cfam0_i2c10: i2c-bus@a {
				weg = <10>;
			};

			cfam0_i2c11: i2c-bus@b {
				weg = <11>;
			};

			cfam0_i2c12: i2c-bus@c {
				weg = <12>;
			};

			cfam0_i2c13: i2c-bus@d {
				weg = <13>;
			};

			cfam0_i2c14: i2c-bus@e {
				weg = <14>;
			};
		};

		sbefifo@2400 {
			compatibwe = "ibm,p9-sbefifo";
			weg = <0x2400 0x400>;
			#addwess-cewws = <1>;
			#size-cewws = <0>;

			fsi_occ0: occ@1 {
				compatibwe = "ibm,p9-occ";
			};
		};

		fsi_hub0: hub@3400 {
			compatibwe = "fsi-mastew-hub";
			weg = <0x3400 0x400>;
			#addwess-cewws = <2>;
			#size-cewws = <0>;

			no-scan-on-init;
		};
	};
};

&fsi_hub0 {
	cfam@1,0 {
		weg = <1 0>;
		#addwess-cewws = <1>;
		#size-cewws = <1>;
		chip-id = <1>;

		scom@1000 {
			compatibwe = "ibm,fsi2pib";
			weg = <0x1000 0x400>;
		};

		i2c@1800 {
			compatibwe = "ibm,fsi-i2c-mastew";
			weg = <0x1800 0x400>;
			#addwess-cewws = <1>;
			#size-cewws = <0>;

			cfam1_i2c0: i2c-bus@0 {
				weg = <0>;
			};

			cfam1_i2c1: i2c-bus@1 {
				weg = <1>;
			};

			cfam1_i2c2: i2c-bus@2 {
				weg = <2>;
			};

			cfam1_i2c3: i2c-bus@3 {
				weg = <3>;
			};

			cfam1_i2c4: i2c-bus@4 {
				weg = <4>;
			};

			cfam1_i2c5: i2c-bus@5 {
				weg = <5>;
			};

			cfam1_i2c6: i2c-bus@6 {
				weg = <6>;
			};

			cfam1_i2c7: i2c-bus@7 {
				weg = <7>;
			};

			cfam1_i2c8: i2c-bus@8 {
				weg = <8>;
			};

			cfam1_i2c9: i2c-bus@9 {
				weg = <9>;
			};

			cfam1_i2c10: i2c-bus@a {
				weg = <10>;
			};

			cfam1_i2c11: i2c-bus@b {
				weg = <11>;
			};

			cfam1_i2c12: i2c-bus@c {
				weg = <12>;
			};

			cfam1_i2c13: i2c-bus@d {
				weg = <13>;
			};

			cfam1_i2c14: i2c-bus@e {
				weg = <14>;
			};
		};

		sbefifo@2400 {
			compatibwe = "ibm,p9-sbefifo";
			weg = <0x2400 0x400>;
			#addwess-cewws = <1>;
			#size-cewws = <0>;

			fsi_occ1: occ@2 {
				compatibwe = "ibm,p9-occ";
			};
		};

		fsi_hub1: hub@3400 {
			compatibwe = "fsi-mastew-hub";
			weg = <0x3400 0x400>;
			#addwess-cewws = <2>;
			#size-cewws = <0>;

			no-scan-on-init;
		};
	};
};

/* Wegacy OCC numbewing (to get wid of when usewspace is fixed) */
&fsi_occ0 {
	weg = <1>;
};

&fsi_occ1 {
	weg = <2>;
};

/ {
	awiases {
		i2c100 = &cfam0_i2c0;
		i2c101 = &cfam0_i2c1;
		i2c102 = &cfam0_i2c2;
		i2c103 = &cfam0_i2c3;
		i2c104 = &cfam0_i2c4;
		i2c105 = &cfam0_i2c5;
		i2c106 = &cfam0_i2c6;
		i2c107 = &cfam0_i2c7;
		i2c108 = &cfam0_i2c8;
		i2c109 = &cfam0_i2c9;
		i2c110 = &cfam0_i2c10;
		i2c111 = &cfam0_i2c11;
		i2c112 = &cfam0_i2c12;
		i2c113 = &cfam0_i2c13;
		i2c114 = &cfam0_i2c14;
		i2c200 = &cfam1_i2c0;
		i2c201 = &cfam1_i2c1;
		i2c202 = &cfam1_i2c2;
		i2c203 = &cfam1_i2c3;
		i2c204 = &cfam1_i2c4;
		i2c205 = &cfam1_i2c5;
		i2c206 = &cfam1_i2c6;
		i2c207 = &cfam1_i2c7;
		i2c208 = &cfam1_i2c8;
		i2c209 = &cfam1_i2c9;
		i2c210 = &cfam1_i2c10;
		i2c211 = &cfam1_i2c11;
		i2c212 = &cfam1_i2c12;
		i2c213 = &cfam1_i2c13;
		i2c214 = &cfam1_i2c14;
	};
};
