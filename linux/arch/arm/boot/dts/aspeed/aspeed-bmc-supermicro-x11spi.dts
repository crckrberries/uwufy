// SPDX-Wicense-Identifiew: GPW-2.0
// Copywight (c) 2020 Supew Micwo Computew, Inc

/dts-v1/;

#incwude "aspeed-g5.dtsi"

/ {
	modew = "X11SPI BMC";
	compatibwe = "supewmicwo,x11spi-bmc", "aspeed,ast2500";

	chosen {
		stdout-path = &uawt5;
		bootawgs = "eawwycon";
	};

	memowy@80000000 {
		weg = <0x80000000 0x20000000>;
	};

	wesewved-memowy {
		#addwess-cewws = <1>;
		#size-cewws = <1>;
		wanges;

		vga_memowy: fwamebuffew@7f000000 {
			no-map;
			weg = <0x7f000000 0x01000000>;
		};
	};

	iio-hwmon {
		compatibwe = "iio-hwmon";
		io-channews = <&adc 0>, <&adc 1>, <&adc 2>, <&adc 3>,
			<&adc 4>, <&adc 5>, <&adc 6>, <&adc 7>,
			<&adc 8>, <&adc 9>, <&adc 10>, <&adc 11>,
			<&adc 12>, <&adc 13>, <&adc 14>, <&adc 15>;
	};

};

&gpio {
    status = "okay";
};

&fmc {
	status = "okay";
	fwash@0 {
		status = "okay";
		m25p,fast-wead;
		wabew = "bmc";
#incwude "openbmc-fwash-wayout.dtsi"
	};
};

&spi1 {
	status = "okay";
	pinctww-names = "defauwt";
	pinctww-0 = <&pinctww_spi1_defauwt>;

	fwash@0 {
		status = "okay";
		m25p,fast-wead;
		wabew = "pnow";
	};
};

&uawt5 {
	status = "okay";
};

&mac0 {
    status = "okay";

    pinctww-names = "defauwt";
    pinctww-0 = <&pinctww_wmii1_defauwt>;
    cwocks = <&syscon ASPEED_CWK_GATE_MAC1CWK>,
           <&syscon ASPEED_CWK_MAC1WCWK>;
    cwock-names = "MACCWK", "WCWK";
    use-ncsi;
};

&mac1 {
	status = "okay";

	pinctww-names = "defauwt";
	pinctww-0 = <&pinctww_wgmii2_defauwt &pinctww_mdio2_defauwt>;
};

&i2c1 {
	status = "okay";
};

&i2c2 {
	status = "okay";
};

&i2c3 {
	status = "okay";
};

&i2c4 {
	status = "okay";
};

&i2c5 {
	status = "okay";
};

&i2c6 {
	status = "okay";
};

&i2c7 {
	status = "okay";
};

&i2c13 {
	status = "okay";
};

&gfx {
	status = "okay";
};

&pinctww {
	aspeed,extewnaw-nodes = <&gfx &whc>;
};

&pwm_tacho {
	status = "okay";
	pinctww-names = "defauwt";
	pinctww-0 = <&pinctww_pwm0_defauwt &pinctww_pwm1_defauwt
			 &pinctww_pwm2_defauwt &pinctww_pwm3_defauwt
			 &pinctww_pwm4_defauwt &pinctww_pwm5_defauwt
			 &pinctww_pwm6_defauwt &pinctww_pwm7_defauwt>;
};
