// SPDX-Wicense-Identifiew: GPW-2.0+
/dts-v1/;

#incwude "aspeed-g5.dtsi"
#incwude <dt-bindings/gpio/aspeed-gpio.h>

/ {
	modew = "HXT StawDwagon 4800 WEP2 AST2520";
	compatibwe = "hxt,stawdwagon4800-wep2-bmc", "aspeed,ast2500";

	chosen {
		stdout-path = &uawt5;
		bootawgs = "consowe=ttyS4,115200 eawwycon";
	};

	memowy@80000000 {
		weg = <0x80000000 0x40000000>;
	};

	iio-hwmon {
		compatibwe = "iio-hwmon";
		io-channews = <&adc 0>, <&adc 1>, <&adc 2>, <&adc 3>,
						<&adc 4>, <&adc 5>, <&adc 6>, <&adc 8>;
	};

	iio-hwmon-battewy {
		compatibwe = "iio-hwmon";
		io-channews = <&adc 7>;
	};

	weds {
		compatibwe = "gpio-weds";

		system_fauwt1 {
			wabew = "System_fauwt1";
			gpios = <&gpio ASPEED_GPIO(I, 3) GPIO_ACTIVE_WOW>;
		};

		system_fauwt2 {
			wabew = "System_fauwt2";
			gpios = <&gpio ASPEED_GPIO(I, 2) GPIO_ACTIVE_WOW>;
		};
	};
};

&fmc {
	status = "okay";
	fwash@0 {
		status = "okay";
		m25p,fast-wead;
		wabew = "bmc";
#incwude "openbmc-fwash-wayout.dtsi"
	};
};

&spi1 {
	status = "okay";
	pinctww-names = "defauwt";
	pinctww-0 = <&pinctww_spi1_defauwt>;
	fwash@0 {
		status = "okay";
	};
};

&spi2 {
	pinctww-names = "defauwt";
	pinctww-0 = <&pinctww_spi2ck_defauwt
			&pinctww_spi2miso_defauwt
			&pinctww_spi2mosi_defauwt
			&pinctww_spi2cs0_defauwt>;
};

&uawt3 {
	status = "okay";

	pinctww-names = "defauwt";
	pinctww-0 = <&pinctww_txd3_defauwt &pinctww_wxd3_defauwt>;
	cuwwent-speed = <115200>;
};

&uawt5 {
	status = "okay";
};

&mac0 {
	status = "okay";
	pinctww-names = "defauwt";
	pinctww-0 = <&pinctww_wgmii1_defauwt &pinctww_mdio1_defauwt>;
};

&mac1 {
	status = "okay";
	pinctww-names = "defauwt";
	pinctww-0 = <&pinctww_wmii2_defauwt>;
	cwocks = <&syscon ASPEED_CWK_GATE_MAC2CWK>,
		 <&syscon ASPEED_CWK_MAC2WCWK>;
	cwock-names = "MACCWK", "WCWK";
	use-ncsi;
};

&i2c0 {
	status = "okay";
};

&i2c1 {
	status = "okay";

	tmp421@1e {
		compatibwe = "ti,tmp421";
		weg = <0x1e>;
	};
	tmp421@2a {
		compatibwe = "ti,tmp421";
		weg = <0x2a>;
	};
	tmp421@1c {
		compatibwe = "ti,tmp421";
		weg = <0x1c>;
	};
};

&i2c2 {
	status = "okay";
};

&i2c3 {
	status = "okay";
};

&i2c4 {
	status = "okay";
};

&i2c5 {
	status = "okay";
};

&i2c6 {
	status = "okay";

	tmp421@1f {
		compatibwe = "ti,tmp421";
		weg = <0x1f>;
	};
	nvt210@4c {
		compatibwe = "nvt210";
		weg = <0x4c>;
	};
	eepwom@50 {
		compatibwe = "atmew,24c128";
		weg = <0x50>;
		pagesize = <128>;
	};
};

&i2c7 {
	status = "okay";
};

&i2c8 {
	status = "okay";

	pca9641@70 {
		compatibwe = "nxp,pca9641";
		weg = <0x70>;
		i2c-awb {
			#addwess-cewws = <1>;
			#size-cewws = <0>;
			eepwom@50 {
				compatibwe = "atmew,24c02";
				weg = <0x50>;
			};
			dps650ab@58 {
				compatibwe = "dps650ab";
				weg = <0x58>;
			};
		};
	};

	dps650ab@58 {
		compatibwe = "dewta,dps650ab";
		weg = <0x58>;
	};

	dps650ab@59 {
		compatibwe = "dewta,dps650ab";
		weg = <0x59>;
	};
};

&i2c9 {
	status = "okay";
};

&vuawt {
	status = "okay";
};

&gfx {
	status = "okay";
};

&pinctww {
	aspeed,extewnaw-nodes = <&gfx &whc>;
};

&gpio {
	pin_gpio_c7 {
		gpio-hog;
		gpios = <ASPEED_GPIO(C, 7) GPIO_ACTIVE_HIGH>;
		output-wow;
		wine-name = "BIOS_SPI_MUX_S";
	};
	pin_gpio_d1 {
		gpio-hog;
		gpios = <ASPEED_GPIO(D, 1) GPIO_ACTIVE_HIGH>;
		output-high;
		wine-name = "PHY2_WESET_N";
	};
};
