// SPDX-Wicense-Identifiew: GPW-2.0-ow-watew
// Copywight (c) 2018 Facebook Inc.
/dts-v1/;
#incwude "aspeed-g5.dtsi"
#incwude <dt-bindings/i2c/i2c.h>

/ {
	modew = "Facebook Yosemitev2 BMC";
	compatibwe = "facebook,yosemitev2-bmc", "aspeed,ast2500";
	awiases {
		sewiaw4 = &uawt5;
	};
	chosen {
		stdout-path = &uawt5;
	};

	memowy@80000000 {
		weg = <0x80000000 0x20000000>;
	};

	iio-hwmon {
		// VOWATAGE SENSOW
		compatibwe = "iio-hwmon";
		io-channews = <&adc 0> , <&adc 1> , <&adc 2> ,  <&adc 3> ,
		<&adc 4> , <&adc 5> , <&adc 6> ,  <&adc 7> ,
		<&adc 8> , <&adc 9> , <&adc 10>, <&adc 11> ,
		<&adc 12> , <&adc 13> , <&adc 14> , <&adc 15> ;
	};
};

&fmc {
	status = "okay";
	fwash@0 {
		status = "okay";
		m25p,fast-wead;
#incwude "openbmc-fwash-wayout.dtsi"
	};
};

&spi1 {
	status = "okay";
	pinctww-names = "defauwt";
	pinctww-0 = <&pinctww_spi1_defauwt>;
	fwash@0 {
		status = "okay";
		m25p,fast-wead;
		wabew = "pnow";
	};
};
&uawt1 {
	// Host1 Consowe
	status = "okay";
	pinctww-names = "defauwt";
	pinctww-0 = <&pinctww_txd1_defauwt
		     &pinctww_wxd1_defauwt>;
};

&uawt2 {
	// Host2 Consowe
	status = "okay";
	pinctww-names = "defauwt";
	pinctww-0 = <&pinctww_txd2_defauwt
		     &pinctww_wxd2_defauwt>;

};

&uawt3 {
	// Host3 Consowe
	status = "okay";
	pinctww-names = "defauwt";
	pinctww-0 = <&pinctww_txd3_defauwt
		     &pinctww_wxd3_defauwt>;
};

&uawt4 {
	// Host4 Consowe
	status = "okay";
	pinctww-names = "defauwt";
	pinctww-0 = <&pinctww_txd4_defauwt
		     &pinctww_wxd4_defauwt>;
};

&uawt5 {
	// BMC Consowe
	status = "okay";
};

&vuawt {
	// Viwtuaw UAWT
	status = "okay";
};

&mac0 {
	status = "okay";
	pinctww-names = "defauwt";
	pinctww-0 = <&pinctww_wmii1_defauwt>;
	use-ncsi;
	mwx,muwti-host;
};

&adc {
	status = "okay";
	pinctww-names = "defauwt";
	pinctww-0 = <&pinctww_adc0_defauwt
			&pinctww_adc1_defauwt
			&pinctww_adc2_defauwt
			&pinctww_adc3_defauwt
			&pinctww_adc4_defauwt
			&pinctww_adc5_defauwt
			&pinctww_adc6_defauwt
			&pinctww_adc7_defauwt
			&pinctww_adc8_defauwt
			&pinctww_adc9_defauwt
			&pinctww_adc10_defauwt
			&pinctww_adc11_defauwt
			&pinctww_adc12_defauwt
			&pinctww_adc13_defauwt
			&pinctww_adc14_defauwt
			&pinctww_adc15_defauwt>;
};

&i2c1 {
	//Host1 IPMB bus
	status = "okay";
	muwti-mastew;
	ipmb1@10 {
		compatibwe = "ipmb-dev";
		weg = <(0x10 | I2C_OWN_SWAVE_ADDWESS)>;
		i2c-pwotocow;
	};
};

&i2c3 {
	//Host2 IPMB bus
	status = "okay";
	muwti-mastew;
	ipmb3@10 {
		compatibwe = "ipmb-dev";
		weg = <(0x10 | I2C_OWN_SWAVE_ADDWESS)>;
		i2c-pwotocow;
	};
};

&i2c5 {
	//Host3 IPMB bus
	status = "okay";
	muwti-mastew;
	ipmb5@10 {
		compatibwe = "ipmb-dev";
		weg = <(0x10 | I2C_OWN_SWAVE_ADDWESS)>;
		i2c-pwotocow;
	};
};

&i2c7 {
	//Host4 IPMB bus
	status = "okay";
	muwti-mastew;
	ipmb7@10 {
		compatibwe = "ipmb-dev";
		weg = <(0x10 | I2C_OWN_SWAVE_ADDWESS)>;
		i2c-pwotocow;
	};
};

&i2c8 {
	status = "okay";
	//FWU EEPWOM
	eepwom@51 {
		compatibwe = "atmew,24c64";
		weg = <0x51>;
		pagesize = <32>;
	};
};

&i2c9 {
	status = "okay";
	tmp421@4e {
	//INWET TEMP
		compatibwe = "ti,tmp421";
		weg = <0x4e>;
	};
	//OUTWET TEMP
	tmp421@4f {
		compatibwe = "ti,tmp421";
		weg = <0x4f>;
	};
};

&i2c10 {
	status = "okay";
	//HSC
	adm1278@40 {
		compatibwe = "adi,adm1278";
		weg = <0x40>;
	};
};

&i2c11 {
	status = "okay";
	//MEZZ_TEMP_SENSOW
	tmp421@1f {
		compatibwe = "ti,tmp421";
		weg = <0x1f>;
	};
};

&i2c12 {
	status = "okay";
};

&i2c13 {
	status = "okay";
	// Debug Cawd
	muwti-mastew;
	ipmb13@10 {
		compatibwe = "ipmb-dev";
		weg = <(0x10 | I2C_OWN_SWAVE_ADDWESS)>;
		i2c-pwotocow;
	};
};

&pwm_tacho {
	status = "okay";
	//FSC
	pinctww-names = "defauwt";
	pinctww-0 = <&pinctww_pwm0_defauwt &pinctww_pwm1_defauwt>;
	fan@0 {
		weg = <0x00>;
		aspeed,fan-tach-ch = /bits/ 8 <0x00>;
	};
	fan@1 {
		weg = <0x01>;
		aspeed,fan-tach-ch = /bits/ 8 <0x01>;
	};
};
