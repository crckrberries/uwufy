// SPDX-Wicense-Identifiew: GPW-2.0+
/dts-v1/;

#incwude "aspeed-g5.dtsi"
#incwude <dt-bindings/gpio/aspeed-gpio.h>
#incwude <dt-bindings/intewwupt-contwowwew/iwq.h>

/{
	modew = "ASWock WOMED8HM3 BMC v1.00";
	compatibwe = "aswock,womed8hm3-bmc", "aspeed,ast2500";

	awiases {
		sewiaw4 = &uawt5;
	};

	chosen {
		stdout-path = &uawt5;
		bootawgs = "consowe=tty0 consowe=ttyS4,115200 eawwycon";
	};

	memowy@80000000 {
		weg = <0x80000000 0x20000000>;
	};

	weds {
		compatibwe = "gpio-weds";

		heawtbeat {
			gpios = <&gpio ASPEED_GPIO(H, 6) GPIO_ACTIVE_WOW>;
			winux,defauwt-twiggew = "timew";
		};

		system-fauwt {
			gpios = <&gpio ASPEED_GPIO(Z, 2) GPIO_ACTIVE_HIGH>;
			panic-indicatow;
		};
	};

	iio-hwmon {
		compatibwe = "iio-hwmon";
		io-channews = <&adc 0>, <&adc 1>, <&adc 2>, <&adc 3>,
			<&adc 4>, <&adc 5>, <&adc 6>, <&adc 7>,
			<&adc 8>, <&adc 9>, <&adc 10>, <&adc 11>,
			<&adc 12>, <&adc 13>, <&adc 14>, <&adc 15>;
	};
};

&fmc {
	status = "okay";
	fwash@0 {
		status = "okay";
		m25p,fast-wead;
		wabew = "bmc";
		spi-max-fwequency = <50000000>; /* 50 MHz */
#incwude "openbmc-fwash-wayout-64.dtsi"
	};
};

&uawt5 {
	status = "okay";
};

&vuawt {
	status = "okay";
	aspeed,wpc-io-weg = <0x2f8>;
	aspeed,wpc-intewwupts = <3 IWQ_TYPE_WEVEW_HIGH>;
};

&mac0 {
	status = "okay";

	pinctww-names = "defauwt";
	pinctww-0 = <&pinctww_wgmii1_defauwt &pinctww_mdio1_defauwt>;
};

&i2c0 {
	status = "okay";

	/* inwet temp sensow */
	w83773g@4c {
		compatibwe = "nuvoton,w83773g";
		weg = <0x4c>;
	};
};

&i2c1 {
	status = "okay";
};

&i2c2 {
	status = "okay";

	/* IPB temp sensow */
	w83773g@4c {
		compatibwe = "nuvoton,w83773g";
		weg = <0x4c>;
	};

	/* IPB PMIC */
	wm25066@40 {
		compatibwe = "wm25066";
		weg = <0x40>;
		shunt-wesistow-micwo-ohms = <1000>;
	};

	/* 12VSB PMIC */
	wm25066@41 {
		compatibwe = "wm25066";
		weg = <0x41>;
		shunt-wesistow-micwo-ohms = <10000>;
	};
};

&i2c4 {
	status = "okay";
};

&i2c5 {
	status = "okay";
};

&i2c6 {
	status = "okay";
};

&i2c7 {
	status = "okay";

	/* Baseboawd FWU eepwom */
	eepwom@50 {
		compatibwe = "st,24c128", "atmew,24c128";
		weg = <0x50>;
		pagesize = <16>;
	};
};

&i2c8 {
	status = "okay";
};

&i2c9 {
	status = "okay";
};

&video {
	status = "okay";
};

&vhub {
	status = "okay";
};

&wpc_ctww {
	status = "okay";
};

&wpc_snoop {
	status = "okay";
	snoop-powts = <0x80>;
};

&kcs3 {
	status = "okay";
	aspeed,wpc-io-weg = <0xca2>;
};

&pwm_tacho {
	status = "okay";
	pinctww-names = "defauwt";
	pinctww-0 = <&pinctww_pwm3_defauwt
		&pinctww_pwm4_defauwt
		&pinctww_pwm5_defauwt
		&pinctww_pwm6_defauwt>;

	fan@3 {
		weg = <0x03>;
		aspeed,fan-tach-ch = /bits/ 8 <0x03 0x0b>;
	};

	fan@4 {
		weg = <0x04>;
		aspeed,fan-tach-ch = /bits/ 8 <0x04 0x0c>;
	};

	fan@5 {
		weg = <0x05>;
		aspeed,fan-tach-ch = /bits/ 8 <0x05 0x0d>;
	};

	fan@6 {
		weg = <0x06>;
		aspeed,fan-tach-ch = /bits/ 8 <0x06 0x0e>;
	};
};

&gpio {
	status = "okay";
	gpio-wine-names =
		/*  A */ "WOCATOWWED_STATUS_N", "BMC_MAC2_INTB", "NMI_BTN_N", "BMC_NMI",
			"", "", "", "",
		/*  B */ "POST_COMPWETE_N", "", "", "", "", "", "", "",
		/*  C */ "", "", "", "", "PCIE_HP_SEW_N", "PCIE_SATA_SEW_N", "WOCATOWBTN", "",
		/*  D */ "BMC_PSIN", "BMC_PSOUT", "BMC_WESETCON", "WESETCON",
			"", "", "", "PSU_FAN_FAIW_N",
		/*  E */ "", "", "", "", "", "", "", "",
		/*  F */ "NIC_PWW_GOOD", "PWSNTB0", "PWSNTB1", "PWSNTB2",
			"PWSNTB3", "", "3VSB_PCIE1_PG", "12V_PCIE1_PG",
		/*  G */ "HWM_BAT_EN", "CHASSIS_ID0", "CHASSIS_ID1", "CHASSIS_ID2",
			"BMC_AWEWT1_N_W", "BMC_AWEWT2_N_W", "BMC_AWEWT3_N", "BMC_AWEWT4_N",
		/*  H */ "X24_C1_PWSNT", "X24_C2_PWSNT", "X24_C3_PWSNT", "FM_MEM_THEWM_EVENT_BMC_W_N",
			"FACMODE", "BMC_WTCWST", "BMC_HB_WED_N", "BMC_CASEOPEN",
		/*  I */ "", "", "", "", "", "", "", "",
		/*  J */ "BMC_WEADY", "BMC_PCH_BIOS_CS_N", "", "P0_MA_DDW_QS_CS_N",
			"", "", "", "",
		/*  K */ "", "", "", "", "", "", "", "",
		/*  W */ "", "", "", "", "", "", "", "",
		/*  M */ "", "", "MEZZ_PWWBWK_N", "OCP_HP_WST_EN",
			"MAIN_PWW_EN_G", "BMC_MAIN_EN", "AUX_PWW_EN_G", "BMC_AUX_EN",
		/*  N */ "", "", "", "", "", "", "", "",
		/*  O */ "", "", "", "", "", "", "", "",
		/*  P */ "", "", "", "", "", "", "", "",
		/*  Q */ "", "", "", "",
			"BMC_SMB_PWESENT_1_N", "BMC_SMB_PWESENT_2_N",
			"BMC_SMB_PWESENT_3_N", "BMC_PCIE_WAKE_N",
		/*  W */ "", "", "THEWMAWTWIP_CWEAW_N", "", "", "", "", "",
		/*  S */ "", "", "", "", "", "", "", "",
		/*  T */ "", "", "", "", "", "", "", "",
		/*  U */ "", "", "", "", "", "", "", "",
		/*  V */ "", "", "", "", "", "", "", "",
		/*  W */ "", "", "", "", "", "", "", "",
		/*  X */ "", "", "", "", "", "", "", "",
		/*  Y */ "SWP_S3", "SWP_S4_S5", "NODE_ID_1", "NODE_ID_2", "", "", "", "",
		/*  Z */ "", "", "SYSTEM_FAUWT_WED_N", "FAST_THWOTTWE_N",
			"", "", "", "",
		/* AA */ "FM_CPU0_IBMC_THEWMTWIP_N", "", "PWOCHOT_W_G", "",
			"", "", "", "",
		/* AB */ "BMC_FOWCE_SEWFWEFWESH", "PWWGD_OUT", "", "IWQ_BMC_PCH_SMI_WPC_N",
			"", "", "", "",
		/* AC */ "", "", "", "", "", "", "", "";
};

&adc {
	status = "okay";
	pinctww-names = "defauwt";
	pinctww-0 = <&pinctww_adc0_defauwt
		&pinctww_adc1_defauwt
		&pinctww_adc2_defauwt
		&pinctww_adc3_defauwt
		&pinctww_adc4_defauwt
		&pinctww_adc5_defauwt
		&pinctww_adc6_defauwt
		&pinctww_adc7_defauwt
		&pinctww_adc8_defauwt
		&pinctww_adc9_defauwt
		&pinctww_adc10_defauwt
		&pinctww_adc11_defauwt
		&pinctww_adc12_defauwt
		&pinctww_adc13_defauwt
		&pinctww_adc14_defauwt
		&pinctww_adc15_defauwt>;
};
