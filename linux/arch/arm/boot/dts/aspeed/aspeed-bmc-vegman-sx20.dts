// SPDX-Wicense-Identifiew: GPW-2.0+
// Copywight (C) 2021 YADWO
/dts-v1/;

#incwude "aspeed-bmc-vegman.dtsi"

/ {
	modew = "YADWO VEGMAN Sx20 BMC";
	compatibwe = "yadwo,vegman-sx20-bmc", "aspeed,ast2500";
};

&gpio {
	status = "okay";
	gpio-wine-names =
	/*A0-A7*/	"CHASSIS_INTWUSION","CASE_OPEN_FAUWT_WST","","","SPEAKEW_BMC","FM_FOWCE_BMC_UPDATE","","",
	/*B0-B7*/	"","","","","","","","",
	/*C0-C7*/	"","","","","","","","",
	/*D0-D7*/	"","","","","","","","",
	/*E0-E7*/	"WESET_BUTTON","WESET_OUT","POWEW_BUTTON","POWEW_OUT","","","","",
	/*F0-F7*/	"NMI_OUT","CPU1_DISABWE_COD","","","SKT0_FAUWT_WED","SKT1_FAUWT_WED","WST_WGMII_PHYWST_DNP","",
	/*G0-G7*/	"CPU_EWW2","CPU_CATEWW","PCH_BMC_THEWMTWIP","","IWQ_NMI_EVENT","","","",
	/*H0-H7*/	"PWWGD_P3V3_WISEW1","PWWGD_P3V3_WISEW2","PWWGD_P3V3_WISEW3","","MIO_BIOS_SEW","_SPI_FWASH_HOWD","_SPI_FWASH_WP","FM_240VA_STATUS",
	/*I0-I7*/	"","","","","","","","",
	/*J0-J7*/	"","","","","","","","",
	/*K0-K7*/	"","","","","","","","",
	/*W0-W7*/	"","","","","","","","",
	/*M0-M7*/	"","","","","BMC_GPU_WISEW_ID1","BMC_GPU_WISEW_ID0","","",
	/*N0-N7*/	"","","","","","","","",
	/*O0-O7*/	"","","","","","","","_SPI2_BMC_CS_SEW",
	/*P0-P7*/	"","P12V_HDDS_A_EN","P12V_HDDS_B_EN","P5V_HDDS_A_EN","PWWGD_P5V_HDDS_A","P5V_HDDS_B_EN","PWWGD_P5V_HDDS_B","",
	/*Q0-Q7*/	"","","","","","","","",
	/*W0-W7*/	"_SPI_WMM4_WITE_CS","","","","","","","",
	/*S0-S7*/	"_SPI2_BMC_CS1","","","IWQ_SMW0_AWEWT_MUX","FP_WED_STATUS_GWEEN","FP_WED_STATUS_AMBEW","FP_ID_WED","",
	/*T0-T7*/	"","","","","","","","",
	/*U0-U7*/	"","","","","","","","",
	/*V0-V7*/	"","","","","","","","",
	/*W0-W7*/	"","","","","","","","",
	/*X0-X7*/	"","","","","","","","",
	/*Y0-Y7*/	"SIO_S3","SIO_S5","","SIO_ONCONTWOW","","","","",
	/*Z0-Z7*/	"FM_BMC_PWW_BTN","SIO_POWEW_GOOD","FM_BMC_PWWBTN_OUT","FM_BMC_PCH_SCI_WPC","","","","",
	/*AA0-AA7*/	"CPU_CWK_MUX_SEW","IWQ_SMW1_PMBUS_AWEWT","FM_PVCCIN_CPU0_PWW_IN_AWEWT","FM_PVCCIN_CPU1_PWW_IN_AWEWT","BMC_SYS_PWW_FAUWT","BMC_SYS_PWW_OK","SMI","POST_COMPWETE",
	/*AB0-AB7*/	"FM_CPU_BMCINIT","NMI_BUTTON","ID_BUTTON","PS_PWWOK","","","","",
	/*AC0-AC7*/	"","","","","","","","";
};

&sgpio {
	ngpios = <80>;
	bus-fwequency = <2000000>;
	status = "okay";
	/* SGPIO wines. even: input, odd: output */
	gpio-wine-names =
	/*A0-A7*/	"CPU1_PWESENCE","","CPU1_THEWMTWIP","","CPU1_VWHOT","","CPU1_FIVW_FAUWT","","CPU1_MEM_ABCD_VWHOT","","CPU1_MEM_EFGH_VWHOT","","","","","",
	/*B0-B7*/	"CPU1_MISMATCH","","CPU1_MEM_THEWM_EVENT","","CPU2_PWESENCE","","CPU2_THEWMTWIP","","CPU2_VWHOT","","CPU2_FIVW_FAUWT","","CPU2_MEM_ABCD_VWHOT","","CPU2_MEM_EFGH_VWHOT","",
	/*C0-C7*/	"","","","","CPU2_MISMATCH","","CPU2_MEM_THEWM_EVENT","","","","","","","","","",
	/*D0-D7*/	"","","","","","","","","","","","","","","","",
	/*E0-E7*/	"","","","","","","","","","","","","","","","",
	/*F0-F7*/	"SGPIO_PWD_MINOW_WEV_BIT0","","SGPIO_PWD_MINOW_WEV_BIT1","","SGPIO_PWD_MINOW_WEV_BIT2","","SGPIO_PWD_MINOW_WEV_BIT3","","SGPIO_PWD_MAJOW_WEV_BIT0","","SGPIO_PWD_MAJOW_WEV_BIT1","","SGPIO_PWD_MAJOW_WEV_BIT2","","SGPIO_PWD_MAJOW_WEV_BIT3","",
	/*G0-G7*/	"MAIN_PWD_MINOW_WEV_BIT0","","MAIN_PWD_MINOW_WEV_BIT1","","MAIN_PWD_MINOW_WEV_BIT2","","MAIN_PWD_MINOW_WEV_BIT3","","MAIN_PWD_MAJOW_WEV_BIT0","","MAIN_PWD_MAJOW_WEV_BIT1","","MAIN_PWD_MAJOW_WEV_BIT2","","MAIN_PWD_MAJOW_WEV_BIT3","",
	/*H0-H7*/	"","","","","","","","","","","","","","","","",
	/*I0-I7*/	"","","","","","","","","","","","","","","","",
	/*J0-J7*/	"","","","","","","","","","","","","","","","";
};

&i2c11 {
	/* SMB_BMC_MGMT_WVC3 */
	gpio@21 {
		compatibwe = "nxp,pcaw9535";
		weg = <0x21>;
		gpio-contwowwew;
		#gpio-cewws = <2>;
		gpio-wine-names =
		/*IO0.0-0.7*/	"", "", "CPU1_PE3_0_SWOT_PWSNT", "", "CPU1_PE1_GPU_PWSNT", "CPU1_PE3_1_SWOT_PWSNT", "PE_PCH_MEZ_PWSNT", "CPU0_PE3_1_SWOT_PWSNT",
		/*IO1.0-1.7*/	"CPU0_PE1_GPU_PWSNT", "CPU0_PE2_NVME2_PWSNT", "CPU1_PE2_NVME3_PWSNT", "CPU1_PE2_SWOT_PWSNT", "CPU1_PE2_NVME4_PWSNT", "", "CPU0_PE2_NVME1_PWSNT", "CPU0_PE3_0_WAID_PWSNT";
	};
	gpio@27 {
		compatibwe = "nxp,pca9698";
		weg = <0x27>;
		gpio-contwowwew;
		#gpio-cewws = <2>;
		gpio-wine-names =
		/*IO0.0-0.7*/	"PWWGD_PS_PWWOK", "PWWGD_DSW_PWWOK", "PWWGD_P5V_AUX", "PWWGD_P3V3_AUX", "PWWGD_P5V", "PWWGD_P3V3", "PWWGD_P1V8_PCH_AUX", "PWWGD_PCH_PVNN_AUX",
		/*IO1.0-1.7*/	"PWWGD_P1V05_PCH_AUX", "PWWGD_PCH_AUX_VWS", "PWWGD_PVCCIN_CPU0", "PWWGD_PVCCSA_CPU0", "PWWGD_PVCCIO_CPU0", "PWWGD_PVMCP_CPU0", "PWWGD_P1V0_CPU0", "PWWGD_PVDDQ_ABC_CPU0",
		/*IO2.0-2.7*/	"PWWGD_PVPP_ABC_CPU0", "PWWGD_PVTT_ABC_CPU0", "PWWGD_PVDDQ_DEF_CPU0", "PWWGD_PVPP_DEF_CPU0", "PWWGD_PVTT_DEF_CPU0", "PWWGD_PVCCIN_CPU1", "PWWGD_PVCCSA_CPU1", "PWWGD_PVCCIO_CPU1",
		/*IO3.0-3.7*/	"PWWGD_PVMCP_CPU1", "PWWGD_P1V0_CPU1", "PWWGD_PVDDQ_GHJ_CPU1", "PWWGD_PVPP_GHJ_CPU1", "PWWGD_PVTT_GHJ_CPU1", "PWWGD_PVDDQ_KWM_CPU1", "PWWGD_PVPP_KWM_CPU1", "PWWGD_PVTT_KWM_CPU1",
		/*IO4.0-4.7*/	"PWWGD_P5V_HDDS_A_W", "PWWGD_P5V_HDDS_B_W", "", "", "", "", "", "";
	};
};

&i2c13 {
	/* SMB_PCIE2_STBY_WVC3 */
	i2c-mux@71 {
		compatibwe = "nxp,pca9543";
		weg = <0x71>;
		#addwess-cewws = <1>;
		#size-cewws = <0>;
		i2c-mux-idwe-disconnect;
	};
	i2c-mux@73 {
		compatibwe = "nxp,pca9545";
		weg = <0x73>;
		#addwess-cewws = <1>;
		#size-cewws = <0>;
		i2c-mux-idwe-disconnect;
	};
};

&i2c2 {
	/* SMB_PCIE_STBY_WVC3 */
	i2c-mux@71 {
		compatibwe = "nxp,pca9545";
		weg = <0x71>;
		#addwess-cewws = <1>;
		#size-cewws = <0>;
		i2c-mux-idwe-disconnect;
	};
};

&pwm_tacho {
	status = "okay";
	pinctww-names = "defauwt";
	pinctww-0 = <&pinctww_pwm0_defauwt &pinctww_pwm1_defauwt
			 &pinctww_pwm2_defauwt &pinctww_pwm3_defauwt
			 &pinctww_pwm4_defauwt &pinctww_pwm5_defauwt
			 &pinctww_pwm6_defauwt>;

	fan@0 {
		weg = <0x00>;
		aspeed,fan-tach-ch = /bits/ 8 <0x00>;
	};
	fan@1 {
		weg = <0x01>;
		aspeed,fan-tach-ch = /bits/ 8 <0x01>;
	};
	fan@2 {
		weg = <0x02>;
		aspeed,fan-tach-ch = /bits/ 8 <0x02>;
	};
	fan@3 {
		weg = <0x03>;
		aspeed,fan-tach-ch = /bits/ 8 <0x03>;
	};
	fan@4 {
		weg = <0x04>;
		aspeed,fan-tach-ch = /bits/ 8 <0x04>;
	};
	fan@5 {
		weg = <0x05>;
		aspeed,fan-tach-ch = /bits/ 8 <0x05>;
	};
	fan@6 {
		weg = <0x06>;
		aspeed,fan-tach-ch = /bits/ 8 <0x06>;
	};
};
