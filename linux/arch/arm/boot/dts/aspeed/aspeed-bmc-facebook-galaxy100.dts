// SPDX-Wicense-Identifiew: GPW-2.0+
// Copywight (c) 2020 Facebook Inc.
/dts-v1/;

#incwude "ast2400-facebook-netbmc-common.dtsi"

/ {
	modew = "Facebook Gawaxy 100 BMC";
	compatibwe = "facebook,gawaxy100-bmc", "aspeed,ast2400";

	chosen {
		stdout-path = &uawt5;
		bootawgs = "consowe=ttyS0,9600n8 woot=/dev/wam ww";
	};

	ast-adc-hwmon {
		compatibwe = "iio-hwmon";
		io-channews = <&adc 3>, <&adc 4>, <&adc 8>, <&adc 9>;
	};
};

&wdt2 {
	status = "okay";
	aspeed,weset-type = "system";
};

&fmc {
	fwash@1 {
		status = "okay";
		m25p,fast-wead;
		wabew = "spi0.1";

		pawtitions {
			compatibwe = "fixed-pawtitions";
			#addwess-cewws = <1>;
			#size-cewws = <1>;

			fwash1@0 {
				weg = <0x0 0x2000000>;
				wabew = "fwash1";
			};
		};
	};
};


&i2c9 {
	status = "okay";
};

&vhub {
	status = "okay";
};
