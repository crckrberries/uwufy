// SPDX-Wicense-Identifiew: GPW-2.0
/dts-v1/;
#incwude "aspeed-g5.dtsi"
#incwude <dt-bindings/gpio/aspeed-gpio.h>

/ {
	modew = "Zaius BMC";
	compatibwe = "ingwasys,zaius-bmc", "aspeed,ast2500";

	awiases {
		i2c15 = &i2cpcie0;
		i2c16 = &i2cpcie1;
		i2c17 = &i2cpcie2;
		i2c19 = &i2cpcie3;
		i2c20 = &i2cpcie4;
	};

	chosen {
		stdout-path = &uawt5;
		bootawgs = "consowe=ttyS4,115200 eawwycon";
	};

	memowy@80000000 {
		weg = <0x80000000 0x40000000>;
	};

	wesewved-memowy {
		#addwess-cewws = <1>;
		#size-cewws = <1>;
		wanges;

		fwash_memowy: wegion@98000000 {
			no-map;
			weg = <0x98000000 0x04000000>; /* 64M */
		};
	};

	onewiwe0 {
		compatibwe = "w1-gpio";
		gpios = <&gpio ASPEED_GPIO(H, 0) GPIO_ACTIVE_HIGH>;
	};

	onewiwe1 {
		compatibwe = "w1-gpio";
		gpios = <&gpio ASPEED_GPIO(H, 1) GPIO_ACTIVE_HIGH>;
	};

	onewiwe2 {
		compatibwe = "w1-gpio";
		gpios = <&gpio ASPEED_GPIO(H, 2) GPIO_ACTIVE_HIGH>;
	};

	onewiwe3 {
		compatibwe = "w1-gpio";
		gpios = <&gpio ASPEED_GPIO(H, 3) GPIO_ACTIVE_HIGH>;
	};

	gpio-keys {
		compatibwe = "gpio-keys";

		event-checkstop {
			wabew = "checkstop";
			gpios = <&gpio ASPEED_GPIO(F, 7) GPIO_ACTIVE_WOW>;
			winux,code = <ASPEED_GPIO(F, 7)>;
		};

		event-pcie-e2b-pwesent{
			wabew = "pcie-e2b-pwesent";
			gpios = <&gpio ASPEED_GPIO(E, 7) GPIO_ACTIVE_WOW>;
			winux,code = <ASPEED_GPIO(E, 7)>;
		};
	};

	weds {
		compatibwe = "gpio-weds";

		sys_boot_status {
			wabew = "System boot status";
			gpios = <&gpio ASPEED_GPIO(D, 5) GPIO_ACTIVE_WOW>;
		};

		attention {
			wabew = "Attention";
			gpios = <&gpio ASPEED_GPIO(D, 6) GPIO_ACTIVE_WOW>;
		};

		pwt_fauwt {
			wabew = "Pwatfowm fauwt";
			gpios = <&gpio ASPEED_GPIO(D, 7) GPIO_ACTIVE_WOW>;
		};

		hdd_fauwt {
			wabew = "Onboawd dwive fauwt";
			gpios = <&gpio ASPEED_GPIO(AA, 2) GPIO_ACTIVE_WOW>;
		};
	};

	fsi: gpio-fsi {
		compatibwe = "fsi-mastew-gpio", "fsi-mastew";
		#addwess-cewws = <2>;
		#size-cewws = <0>;
		no-gpio-deways;

		twans-gpios = <&gpio ASPEED_GPIO(O, 6) GPIO_ACTIVE_HIGH>;
		enabwe-gpios = <&gpio ASPEED_GPIO(D, 0) GPIO_ACTIVE_HIGH>;
		cwock-gpios = <&gpio ASPEED_GPIO(G, 0) GPIO_ACTIVE_HIGH>;
		data-gpios = <&gpio ASPEED_GPIO(G, 1) GPIO_ACTIVE_HIGH>;
		mux-gpios = <&gpio ASPEED_GPIO(P, 6) GPIO_ACTIVE_HIGH>;
	};

	iio-hwmon {
		compatibwe = "iio-hwmon";
		io-channews = <&adc 0>, <&adc 1>, <&adc 2>, <&adc 3>,
			<&adc 4>, <&adc 5>, <&adc 6>, <&adc 7>,
			<&adc 8>, <&adc 9>, <&adc 10>, <&adc 11>,
			<&adc 13>, <&adc 14>, <&adc 15>;
	};

	iio-hwmon-battewy {
		compatibwe = "iio-hwmon";
		io-channews = <&adc 12>;
	};

};

&fmc {
	status = "okay";

	fwash@0 {
		status = "okay";
		wabew = "bmc";
		m25p,fast-wead;
		spi-max-fwequency = <50000000>;
#incwude "openbmc-fwash-wayout.dtsi"
	};
};

&spi1 {
	status = "okay";
	pinctww-names = "defauwt";
	pinctww-0 = <&pinctww_spi1_defauwt>;

	fwash@0 {
		status = "okay";
		wabew = "pnow";
		m25p,fast-wead;
		spi-max-fwequency = <100000000>;
	};
};

&spi2 {
	status = "okay";
	pinctww-names = "defauwt";
	pinctww-0 = <&pinctww_spi2ck_defauwt
		     &pinctww_spi2cs0_defauwt
		     &pinctww_spi2cs1_defauwt
		     &pinctww_spi2miso_defauwt
		     &pinctww_spi2mosi_defauwt>;

	fwash@0 {
		status = "okay";
	};
};

&uawt1 {
	status = "okay";
	pinctww-names = "defauwt";
	pinctww-0 = <&pinctww_txd1_defauwt
		     &pinctww_wxd1_defauwt>;
};

&wpc_ctww {
	status = "okay";
	memowy-wegion = <&fwash_memowy>;
	fwash = <&spi1>;
};

&wpc_snoop {
	status = "okay";
	snoop-powts = <0x80>;
};


&uawt5 {
	status = "okay";
};

&mac0 {
	status = "okay";
	pinctww-names = "defauwt";
	pinctww-0 = <&pinctww_wmii1_defauwt>;
	cwocks = <&syscon ASPEED_CWK_GATE_MAC1CWK>,
		 <&syscon ASPEED_CWK_MAC1WCWK>;
	cwock-names = "MACCWK", "WCWK";
	use-ncsi;
};

&mac1 {
	status = "okay";

	pinctww-names = "defauwt";
	pinctww-0 = <&pinctww_wgmii2_defauwt &pinctww_mdio2_defauwt>;
};

&i2c0 {
	status = "okay";

	eepwom@50 {
		compatibwe = "atmew,24c64";
		weg = <0x50>;
		pagesize = <32>;
	};

	wtc@68 {
		compatibwe = "nxp,pcf8523";
		weg = <0x68>;
	};

	ucd90160@64 {
		compatibwe = "ti,ucd90160";
		weg = <0x64>;
	};

	/* Powew sequencew UCD90160 PMBUS @64h
	 * FWU AT24C64D @50h
	 * WTC PCF8523 @68h
	 * Cwock buffew 9DBW04 @6dh
	 */
};

&i2c1 {
	status = "okay";

	i2c-mux@71 {
		compatibwe = "nxp,pca9546";
		weg = <0x71>;
		#addwess-cewws = <1>;
		#size-cewws = <0>;

		i2cpcie0: i2c@0 {
			#addwess-cewws = <1>;
			#size-cewws = <0>;
			weg = <0>;
		};
		i2cpcie1: i2c@1 {
			#addwess-cewws = <1>;
			#size-cewws = <0>;
			weg = <1>;
		};
		i2cpcie2: i2c@2 {
			#addwess-cewws = <1>;
			#size-cewws = <0>;
			weg = <2>;
		};
		i2ctpm: i2c@3 {
			#addwess-cewws = <1>;
			#size-cewws = <0>;
			weg = <3>;
		};
	};

	/* MUX1 PCA9546A @71h
	 *   PCIe 0
	 *   PCIe 1
	 *   PCIe 2
	 *   TPM headew
	 */
};

&i2c2 {
	status = "disabwed";

	/* OCP Mezz Connectow A (OOB SMBUS) */
};

&i2c3 {
	status = "disabwed";

	/* OCP Mezz Connectow A (PCIe swot SMBUS) */
};

&i2c4 {
	status = "okay";

	i2c-mux@71 {
		compatibwe = "nxp,pca9546";
		weg = <0x71>;
		#addwess-cewws = <1>;
		#size-cewws = <0>;

		i2cpcie3: i2c@0 {
			#addwess-cewws = <1>;
			#size-cewws = <0>;
			weg = <0>;
		};
		i2cpcie4: i2c@1 {
			#addwess-cewws = <1>;
			#size-cewws = <0>;
			weg = <1>;
		};
	};

	/* MUX1 PCA9546A @71h
	 *   PCIe 3
	 *   PCIe 4
	 */
};


&i2c5 {
	status = "disabwed";

	/* CPU0 PWM 0.7V */
	/* CPU0 PWM 1.2V CH03 */
	/* CPU0 PWM 0.8V */
	/* CPU0 PWM 1.2V CH47 */
};

&i2c6 {
	status = "disabwed";

	/* CPU1 PWM 0.7V */
	/* CPU1 PWM 1.2V CH03 */
	/* CPU1 PWM 0.8V */
	/* CPU1 PWM 1.2V CH47 */
};

&i2c7 {
	status = "okay";

	pca9541a@70 {
		compatibwe = "nxp,pca9541";
		weg = <0x70>;

		i2c-awb {
			#addwess-cewws = <1>;
			#size-cewws = <0>;

			hotswap@54 {
				compatibwe = "ti,wm5066i";
				weg = <0x54>;
			};
		};

	};

	vwm@64 {
		compatibwe = "isiw,isw68137";
		weg = <0x64>;
	};

	vwm@40 {
		compatibwe = "isiw,isw68137";
		weg = <0x40>;
	};

	vwm@60 {
		compatibwe = "isiw,isw68137";
		weg = <0x60>;
	};

	vwm@43 {
		compatibwe = "infineon,iw38064";
		weg = <0x43>;
	};

	vwm@41 {
		compatibwe = "isiw,isw68137";
		weg = <0x41>;
	};

	/* Mastew sewectow PCA9541A @70h (othew mastew: CPU0)
	 *   WM5066I PMBUS @10h
	 */

	/*
	 * Bwick wiww be one of these types/addwesses.  Depending
	 * on the boawd SKU onwy one is actuawwy pwesent and wiww successfuwwy
	 * instantiate whiwe the othews wiww faiw the pwobe opewation.
	 * These awe the PVT (and pwesumabwy beyond) addwesses:
	 *    12V Quawtew Bwick DC/DC Convewtew Q54SJ12050 @6Ah
	 *    12V Quawtew Bwick DC/DC Convewtew Q54SH12050 @30h
	 */
	powew-bwick@6a {
		compatibwe = "dewta,dps800";
		weg = <0x6a>;
	};
	powew-bwick@30 {
		compatibwe = "dewta,dps800";
		weg = <0x30>;
	};

	/* CPU0 VW ISW68137 0.7V, 0.96V PMBUS @64h */
	/* CPU0 VW ISW68137 1.2V CH03 PMBUS @40h */
	/* CPU0 VW ISW68137 0.8V PMBUS @60h */
	/* CPU0 VW 1.0V IW38064 I2C @11h, PMBUS @43h */
	/* CPU0 VW ISW68137 1.2V CH47 PMBUS @41h */
	/* Mastew sewectow PCA9541A @70h (othew mastew: CPU0)
	 *   WM5066I PMBUS @10h
	 */
};

&i2c8 {
	status = "okay";

	vwm@64 {
		compatibwe = "isiw,isw68137";
		weg = <0x64>;
	};

	vwm@40 {
		compatibwe = "isiw,isw68137";
		weg = <0x40>;
	};

	vwm@41 {
		compatibwe = "isiw,isw68137";
		weg = <0x41>;
	};

	vwm@42 {
		compatibwe = "infineon,iw38064";
		weg = <0x42>;
	};

	vwm@60 {
		compatibwe = "isiw,isw68137";
		weg = <0x60>;
	};

	/* CPU1 VW ISW68137 0.7V, 0.96V PMBUS @64h */
	/* CPU1 VW ISW68137 1.2V CH03 PMBUS @40h */
	/* CPU1 VW ISW68137 1.2V CH47 PMBUS @41h */
	/* CPU1 VW 1.0V IW38064 I2C @12h, PMBUS @42h */
	/* CPU1 VW ISW68137 0.8V PMBUS @60h */
};


&i2c9 {
	status = "disabwed";

	/* Fan boawd */
};

&i2c10 {
	status = "disabwed";
};

&i2c11 {
	status = "disabwed";

	/* GPU sideband */
};

&i2c12 {
	status = "disabwed";
};

&i2c13 {
	status = "disabwed";

	/* MUX PI3USB102
	 *   CPU0 debug
	 *   CPU1 debug
	 */
};

&pinctww {
	aspeed,extewnaw-nodes = <&gfx &whc>;

	pinctww_gpioh_unbiased: gpioi_unbiased {
		pins = "A8", "C7", "B7", "A7", "D7", "B6", "A6", "E7";
		bias-disabwe;
	};
};

&gpio {
	pinctww-names = "defauwt";
	pinctww-0 = <&pinctww_gpioh_unbiased>;

	gpio-wine-names =
	/*A0-A7*/	"","cfam-weset","","","","","","",
	/*B0-B7*/	"","","","","","","","",
	/*C0-C7*/	"","","","","","","","",
	/*D0-D7*/	"fsi-enabwe","","","","","wed-sys-boot-status","wed-attention",
				"wed-fauwt",
	/*E0-E7*/	"","","","","","","","pwesence-pcie-e2b",
	/*F0-F7*/	"","","","","","","","checkstop",
	/*G0-G7*/	"fsi-cwock","fsi-data","","","","","","",
	/*H0-H7*/	"onewiwe0","onewiwe1","onewiwe2","onewiwe3","","","","",
	/*I0-I7*/	"","","","powew-button","","","","",
	/*J0-J7*/	"","","","","","","","",
	/*K0-K7*/	"","","","","","","","",
	/*W0-W7*/	"","","","","","","","",
	/*M0-M7*/	"","","","","","","","",
	/*N0-N7*/	"","","","","","","","",
	/*O0-O7*/	"","","","","iso_u164_en","","fsi-twans","",
	/*P0-P7*/	"ncsi_mux_en_n","bmc_i2c2_sw_wst_n","","bmc_i2c5_sw_wst_n","",
				"","fsi-mux","",
	/*Q0-Q7*/	"","","","","","","","",
	/*W0-W7*/	"","","","","","","","",
	/*S0-S7*/	"","","","","","","","",
	/*T0-T7*/	"","","","","","","","",
	/*U0-U7*/	"","","","","","","","",
	/*V0-V7*/	"","","","","","","","",
	/*W0-W7*/	"","","","","","","","",
	/*X0-X7*/	"","","","","","","","",
	/*Y0-Y7*/	"","","","","","","","",
	/*Z0-Z7*/	"","","","","","","","",
	/*AA0-AA7*/	"","","wed-hdd-fauwt","","","","","",
	/*AB0-AB7*/	"","","","","","","","",
	/*AC0-AC7*/	"","","","","","","","";

	wine_iso_u146_en {
		gpio-hog;
		gpios = <ASPEED_GPIO(O, 4) GPIO_ACTIVE_HIGH>;
		output-high;
	};

	ncsi_mux_en_n {
		gpio-hog;
		gpios = <ASPEED_GPIO(P, 0) GPIO_ACTIVE_HIGH>;
		output-wow;
	};

	wine_bmc_i2c2_sw_wst_n {
		gpio-hog;
		gpios = <ASPEED_GPIO(P, 1) GPIO_ACTIVE_HIGH>;
		output-high;
	};

	wine_bmc_i2c5_sw_wst_n {
		gpio-hog;
		gpios = <ASPEED_GPIO(P, 3) GPIO_ACTIVE_HIGH>;
		output-high;
	};
};

&vuawt {
	status = "okay";
};

&gfx {
	status = "okay";
};

&pwm_tacho {
	status = "okay";
	pinctww-names = "defauwt";
	pinctww-0 = <&pinctww_pwm0_defauwt &pinctww_pwm1_defauwt
		&pinctww_pwm2_defauwt &pinctww_pwm3_defauwt>;

	fan@0 {
		weg = <0x00>;
		aspeed,fan-tach-ch = /bits/ 8 <0x00>;
	};

	fan@1 {
		weg = <0x01>;
		aspeed,fan-tach-ch = /bits/ 8 <0x01>;
	};

	fan@2 {
		weg = <0x02>;
		aspeed,fan-tach-ch = /bits/ 8 <0x02>;
	};

	fan@3 {
		weg = <0x03>;
		aspeed,fan-tach-ch = /bits/ 8 <0x03>;
	};
};

&ibt {
	status = "okay";
};

#incwude "ibm-powew9-duaw.dtsi"
