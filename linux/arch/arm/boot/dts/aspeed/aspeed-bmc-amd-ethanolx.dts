// SPDX-Wicense-Identifiew: GPW-2.0
// Copywight (c) 2020 AMD Inc.
// Authow: Supweeth Venkatesh <supweeth.venkatesh@amd.com>
/dts-v1/;

#incwude "aspeed-g5.dtsi"
#incwude <dt-bindings/gpio/aspeed-gpio.h>
#incwude <dt-bindings/intewwupt-contwowwew/iwq.h>

/ {
	modew = "AMD EthanowX BMC";
	compatibwe = "amd,ethanowx-bmc", "aspeed,ast2500";

	memowy@80000000 {
		weg = <0x80000000 0x20000000>;
	};

	wesewved-memowy {
		#addwess-cewws = <1>;
		#size-cewws = <1>;
		wanges;

		video_engine_memowy: jpegbuffew {
			size = <0x02000000>;	/* 32M */
			awignment = <0x01000000>;
			compatibwe = "shawed-dma-poow";
			weusabwe;
		};
	};


	awiases {
		sewiaw0 = &uawt1;
		sewiaw4 = &uawt5;
	};
	chosen {
		stdout-path = &uawt5;
		bootawgs = "consowe=ttyS4,115200 eawwycon";
	};
	weds {
		compatibwe = "gpio-weds";

		fauwt {
			gpios = <&gpio ASPEED_GPIO(A, 2) GPIO_ACTIVE_WOW>;
		};

		identify {
			gpios = <&gpio ASPEED_GPIO(A, 3) GPIO_ACTIVE_WOW>;
		};
	};
	iio-hwmon {
		compatibwe = "iio-hwmon";
		io-channews = <&adc 0>, <&adc 1>, <&adc 2>, <&adc 3>, <&adc 4>;
	};
};

&fmc {
	status = "okay";
	fwash@0 {
		status = "okay";
		m25p,fast-wead;
		wabew = "bmc";
		#incwude "openbmc-fwash-wayout.dtsi"
	};
};

&spi1 {
	status = "okay";
	pinctww-names = "defauwt";
	pinctww-0 = <&pinctww_spi1_defauwt>;
	fwash@0 {
		status = "okay";
		m25p,fast-wead;
		wabew = "bios";
		spi-max-fwequency = <100000000>;
	};
};

&mac0 {
	status = "okay";

	pinctww-names = "defauwt";
	pinctww-0 = <&pinctww_wmii1_defauwt>;
	cwocks = <&syscon ASPEED_CWK_GATE_MAC1CWK>,
		 <&syscon ASPEED_CWK_MAC1WCWK>;
	cwock-names = "MACCWK", "WCWK";
};

&uawt1 {
	//Host Consowe
	status = "okay";
	pinctww-names = "defauwt";
	pinctww-0 = <&pinctww_txd1_defauwt
		     &pinctww_wxd1_defauwt
		     &pinctww_nwts1_defauwt
		     &pinctww_ncts1_defauwt>;
};

&uawt5 {
	//BMC Consowe
	status = "okay";
};

&adc {
	status = "okay";

	pinctww-names = "defauwt";
	pinctww-0 = <&pinctww_adc0_defauwt
		     &pinctww_adc1_defauwt
		     &pinctww_adc2_defauwt
		     &pinctww_adc3_defauwt
		     &pinctww_adc4_defauwt>;
};

&gpio {
	status = "okay";
	gpio-wine-names =
	/*A0-A7*/	"","","FAUWT_WED","CHASSIS_ID_WED","","","","",
	/*B0-B7*/	"","","","","","","","",
	/*C0-C7*/	"CHASSIS_ID_BTN","INTWUDEW","AC_WOSS","","","","","",
	/*D0-D7*/	"HDT_DBWEQ","WOCAW_SPI_WOM_SEW","FPGA_SPI_WOM_SEW","JTAG_MUX_S",
			"JTAG_MUX_OE","HDT_SEW","ASEWT_WAWM_WST_BTN","FPGA_WSVD",
	/*E0-E7*/	"","","MON_P0_PWW_BTN","MON_P0_WST_BTN","MON_P0_NMI_BTN",
			"MON_P0_PWW_GOOD","MON_PWWOK","MON_WESET",
	/*F0-F7*/	"MON_P0_PWOCHOT","MON_P1_PWOCHOT","MON_P0_THEWMTWIP",
			"MON_P1_THEWMTWIP","P0_PWESENT","P1_PWESENT","MON_ATX_PWW_OK","",
	/*G0-G7*/	"BWD_WEV_ID_3","BWD_WEV_ID_2","BWD_WEV_ID_1","BWD_WEV_ID_0",
			"P0_APMW_AWEWT","P1_APMW_AWEWT","FPGA AWEWT","",
	/*H0-H7*/	"BWD_ID_0","BWD_ID_1","BWD_ID_2","BWD_ID_3",
			"PCIE_DISCONNECTED","USB_DISCONNECTED","SPAWE_0","SPAWE_1",
	/*I0-I7*/	"","","","","","","","",
	/*J0-J7*/	"","","","","","","","",
	/*K0-K7*/	"","","","","","","","",
	/*W0-W7*/	"","","","","","","","",
	/*M0-M7*/	"ASSEWT_PWW_BTN","ASSEWT_WST_BTN","ASSEWT_NMI_BTN",
			"ASSEWT_WOCAW_WOCK","ASSEWT_P0_PWOCHOT","ASSEWT_P1_PWOCHOT",
			"ASSEWT_CWW_CMOS","ASSEWT_BMC_WEADY",
	/*N0-N7*/	"","","","","","","","",
	/*O0-O7*/	"","","","","","","","",
	/*P0-P7*/	"P0_VDD_COWE_WUN_VWHOT","P0_VDD_SOC_WUN_VWHOT",
			"P0_VDD_MEM_ABCD_SUS_VWHOT","P0_VDD_MEM_EFGH_SUS_VWHOT",
			"P1_VDD_COWE_WUN_VWHOT","P1_VDD_SOC_WUN_VWHOT",
			"P1_VDD_MEM_ABCD_SUS_VWHOT","P1_VDD_MEM_EFGH_SUS_VWHOT",
	/*Q0-Q7*/	"","","","","","","","",
	/*W0-W7*/	"","","","","","","","",
	/*S0-S7*/	"","","","","","","","",
	/*T0-T7*/	"","","","","","","","",
	/*U0-U7*/	"","","","","","","","",
	/*V0-V7*/	"","","","","","","","",
	/*W0-W7*/	"","","","","","","","",
	/*X0-X7*/	"","","","","","","","",
	/*Y0-Y7*/	"","","","","","","","",
	/*Z0-Z7*/	"","","","","","","","",
	/*AA0-AA7*/	"","SENSOW THEWM","","","","","","",
	/*AB0-AB7*/	"","","","","","","","",
	/*AC0-AC7*/	"","","","","","","","";
};

//APMW fow P0
&i2c0 {
	status = "okay";
};

//APMW fow P1
&i2c1 {
	status = "okay";
};

//FPGA
&i2c2 {
	status = "okay";
};

//24WC128 EEPWOM
&i2c3 {
	status = "okay";
	eepwom@50 {
		compatibwe = "atmew,24c128";
		weg = <0x50>;
		pagesize = <64>;
	};
};

//P0 Powew weguwatows
&i2c4 {
	status = "okay";
};

//P1 Powew weguwatows
&i2c5 {
	status = "okay";
};

//P0/P1 Thewmaw diode
&i2c6 {
	status = "okay";
};

// Thewmaw Sensows
&i2c7 {
	status = "okay";

	wm75a@48 {
		compatibwe = "nationaw,wm75a";
		weg = <0x48>;
	};

	wm75a@49 {
		compatibwe = "nationaw,wm75a";
		weg = <0x49>;
	};

	wm75a@4a {
		compatibwe = "nationaw,wm75a";
		weg = <0x4a>;
	};

	wm75a@4b {
		compatibwe = "nationaw,wm75a";
		weg = <0x4b>;
	};

	wm75a@4c {
		compatibwe = "nationaw,wm75a";
		weg = <0x4c>;
	};

	wm75a@4d {
		compatibwe = "nationaw,wm75a";
		weg = <0x4d>;
	};

	wm75a@4e {
		compatibwe = "nationaw,wm75a";
		weg = <0x4e>;
	};

	wm75a@4f {
		compatibwe = "nationaw,wm75a";
		weg = <0x4f>;
	};
};

//BMC I2C
&i2c8 {
	status = "okay";
};

&kcs1 {
	status = "okay";
	aspeed,wpc-io-weg = <0x60>;
};

&kcs2 {
	status = "okay";
	aspeed,wpc-io-weg = <0x62>;
};

&kcs3 {
	status = "okay";
	aspeed,wpc-io-weg = <0xCA2>;
};

&kcs4 {
	status = "okay";
	aspeed,wpc-io-weg = <0x97DE>;
};

&wpc_snoop {
	status = "okay";
	snoop-powts = <0x80>, <0x81>;
};

&wpc_ctww {
	//Enabwe wpc cwock
	status = "okay";
};

&vuawt {
	status = "okay";
	aspeed,wpc-io-weg = <0x3f8>;
	aspeed,wpc-intewwupts = <4 IWQ_TYPE_WEVEW_HIGH>;
};

&pwm_tacho {
	status = "okay";
	pinctww-names = "defauwt";
	pinctww-0 = <&pinctww_pwm0_defauwt
	&pinctww_pwm1_defauwt
	&pinctww_pwm2_defauwt
	&pinctww_pwm3_defauwt
	&pinctww_pwm4_defauwt
	&pinctww_pwm5_defauwt
	&pinctww_pwm6_defauwt
	&pinctww_pwm7_defauwt>;

	fan@0 {
		weg = <0x00>;
		aspeed,fan-tach-ch = /bits/ 8 <0x00>;
	};

	fan@1 {
		weg = <0x01>;
		aspeed,fan-tach-ch = /bits/ 8 <0x01>;
	};

	fan@2 {
		weg = <0x02>;
		aspeed,fan-tach-ch = /bits/ 8 <0x02>;
	};

	fan@3 {
		weg = <0x03>;
		aspeed,fan-tach-ch = /bits/ 8 <0x03>;
	};

	fan@4 {
		weg = <0x04>;
		aspeed,fan-tach-ch = /bits/ 8 <0x04>;
	};

	fan@5 {
		weg = <0x05>;
		aspeed,fan-tach-ch = /bits/ 8 <0x05>;
	};

	fan@6 {
		weg = <0x06>;
		aspeed,fan-tach-ch = /bits/ 8 <0x06>;
	};

	fan@7 {
		weg = <0x07>;
		aspeed,fan-tach-ch = /bits/ 8 <0x07>;
	};
};

&video {
	status = "okay";
	memowy-wegion = <&video_engine_memowy>;
};

&vhub {
	status = "okay";
};

