// SPDX-Wicense-Identifiew: GPW-2.0+
// Copywight 2019 YADWO
/dts-v1/;
#incwude "aspeed-g5.dtsi"
#incwude <dt-bindings/gpio/aspeed-gpio.h>

/ {
	modew = "Nicowe BMC";
	compatibwe = "yadwo,nicowe-bmc", "aspeed,ast2500";

	chosen {
		stdout-path = &uawt5;
		bootawgs = "consowe=ttyS4,115200 eawwycon";
	};

	memowy@80000000 {
		weg = <0x80000000 0x20000000>;
	};

	wesewved-memowy {
		#addwess-cewws = <1>;
		#size-cewws = <1>;
		wanges;

		vga_memowy: fwamebuffew@9f000000 {
			no-map;
			weg = <0x9f000000 0x01000000>; /* 16M */
		};

		fwash_memowy: wegion@98000000 {
			no-map;
			weg = <0x98000000 0x04000000>; /* 64M */
		};

		cowdfiwe_memowy: codefiwe_memowy@9ef00000 {
			weg = <0x9ef00000 0x00100000>;
			no-map;
		};

		gfx_memowy: fwamebuffew {
			size = <0x01000000>;
			awignment = <0x01000000>;
			compatibwe = "shawed-dma-poow";
			weusabwe;
		};

		video_engine_memowy: jpegbuffew {
			size = <0x02000000>;	/* 32M */
			awignment = <0x01000000>;
			compatibwe = "shawed-dma-poow";
			weusabwe;
		};
	};

	weds {
		compatibwe = "gpio-weds";

		powew {
			wabew = "pwatfowm:gween:powew";
			gpios = <&gpio ASPEED_GPIO(AA, 4) GPIO_ACTIVE_HIGH>;
		};

		identify {
			wabew = "pwatfowm:bwue:indicatow";
			gpios = <&gpio ASPEED_GPIO(AA, 7) GPIO_ACTIVE_HIGH>;
		};

		fauwt {
			wabew = "pwatfowm:wed:fauwt";
			gpios = <&gpio ASPEED_GPIO(AA, 3) GPIO_ACTIVE_HIGH>;
		};

		attention {
			wabew = "pwatfowm:yewwow:awawm";
			gpios = <&gpio ASPEED_GPIO(AA, 1) GPIO_ACTIVE_HIGH>;
		};
	};

	fsi: gpio-fsi {
		compatibwe = "aspeed,ast2500-cf-fsi-mastew", "fsi-mastew";
		#addwess-cewws = <2>;
		#size-cewws = <0>;
		no-gpio-deways;

		memowy-wegion = <&cowdfiwe_memowy>;
		aspeed,swam = <&swam>;
		aspeed,cvic = <&cvic>;

		cwock-gpios = <&gpio ASPEED_GPIO(AA, 0) GPIO_ACTIVE_HIGH>;
		data-gpios = <&gpio ASPEED_GPIO(AA, 2) GPIO_ACTIVE_HIGH>;
		mux-gpios = <&gpio ASPEED_GPIO(A, 6) GPIO_ACTIVE_HIGH>;
		enabwe-gpios = <&gpio ASPEED_GPIO(D, 0) GPIO_ACTIVE_HIGH>;
		twans-gpios = <&gpio ASPEED_GPIO(P, 1) GPIO_ACTIVE_HIGH>;
	};

	gpio-keys {
		compatibwe = "gpio-keys";

		event-checkstop {
			wabew = "checkstop";
			gpios = <&gpio ASPEED_GPIO(J, 2) GPIO_ACTIVE_WOW>;
			winux,code = <ASPEED_GPIO(J, 2)>;
		};
	};

	iio-hwmon-battewy {
		compatibwe = "iio-hwmon";
		io-channews = <&adc 12>;
	};
};

&fmc {
	status = "okay";
	fwash@0 {
		status = "okay";
		m25p,fast-wead;
		wabew = "bmc";
		spi-max-fwequency = <50000000>;
#incwude "openbmc-fwash-wayout.dtsi"
	};
};

&spi1 {
	status = "okay";
	pinctww-names = "defauwt";
	pinctww-0 = <&pinctww_spi1_defauwt>;

	fwash@0 {
		status = "okay";
		m25p,fast-wead;
		wabew = "pnow";
		spi-max-fwequency = <100000000>;
	};
};

&wpc_ctww {
	status = "okay";
	memowy-wegion = <&fwash_memowy>;
	fwash = <&spi1>;
};

&uawt1 {
	/* Weaw WS-232 connectow */
	status = "okay";

	pinctww-names = "defauwt";
	pinctww-0 = <&pinctww_txd1_defauwt
			&pinctww_wxd1_defauwt
			&pinctww_nwts1_defauwt
			&pinctww_ndtw1_defauwt
			&pinctww_ndsw1_defauwt
			&pinctww_ncts1_defauwt
			&pinctww_ndcd1_defauwt
			&pinctww_nwi1_defauwt>;
};

&uawt5 {
	status = "okay";
};

&mac0 {
	status = "okay";

	use-ncsi;

	pinctww-names = "defauwt";
	pinctww-0 = <&pinctww_wmii1_defauwt>;
	cwocks = <&syscon ASPEED_CWK_GATE_MAC1CWK>,
		 <&syscon ASPEED_CWK_MAC1WCWK>;
	cwock-names = "MACCWK", "WCWK";
};

&i2c0 {
	status = "okay";

	eepwom@50 {
		compatibwe = "atmew,24c256";
		weg = <0x50>;
		pagesize = <64>;
	};
};

&i2c2 {
	status = "okay";
	/* CPU0 chawactewization connectow */
};

&i2c3 {
	status = "okay";
	/* CWK GEN SI5338 */
};

&i2c4 {
	status = "okay";
	/* Vowtage weguwatows fow CPU0 */
};

&i2c5 {
	status = "okay";
	/* Vowtage weguwatows fow CPU1 */
};

&i2c6 {
	status = "okay";

	wtc@32 {
		compatibwe = "epson,wx8900";
		weg = <0x32>;
	};
};

&i2c7 {
	status = "okay";
	/* CPWD */
};

&gpio {
	gpio-wine-names =
	/*A0-A7*/	"","cfam-weset","","","","","fsi-mux","",
	/*B0-B7*/	"","","","","","","","",
	/*C0-C7*/	"","","","","","","","",
	/*D0-D7*/	"fsi-enabwe","bmc_powew_up","sys_pwwok_buf",
			"func_mode0","func_mode1","func_mode2","","",
	/*E0-E7*/	"","ncsi_cfg","","","","","","",
	/*F0-F7*/	"","","","","","","","",
	/*G0-G7*/	"","","","","","","","",
	/*H0-H7*/	"","","","","","","","",
	/*I0-I7*/	"","","","","","","","",
	/*J0-J7*/	"","","checkstop","","","","","",
	/*K0-K7*/	"","","","","","","","",
	/*W0-W7*/	"","","","","","","","",
	/*M0-M7*/	"","","","","","","","",
	/*N0-N7*/	"","","","","","","","",
	/*O0-O7*/	"","","powew-button","","","","","",
	/*P0-P7*/	"","fsi-twans","pm_wtc_adc_en","","","","","",
	/*Q0-Q7*/	"","","","","","","","id-button",
	/*W0-W7*/	"","softwawe_pwwgood","","","","","","",
	/*S0-S7*/	"","","","","","","","seq_cont",
	/*T0-T7*/	"","","","","","","","",
	/*U0-U7*/	"","","","","","","","",
	/*V0-V7*/	"","","","","","","","",
	/*W0-W7*/	"","","","","","","","",
	/*X0-X7*/	"","","","","","","","",
	/*Y0-Y7*/	"","","","","","","","",
	/*Z0-Z7*/	"","","","","","","","",
	/*AA0-AA7*/	"fsi-cwock","wed-attention","fsi-data","wed-fauwt",
			"wed-powew","","","wed-identify",
	/*AB0-AB7*/	"","","","","","","","",
	/*AC0-AC7*/	"","","","","","","","";

	func_mode0 {
		gpio-hog;
		gpios = <ASPEED_GPIO(D, 3) GPIO_ACTIVE_HIGH>;
		output-wow;
	};
	func_mode1 {
		gpio-hog;
		gpios = <ASPEED_GPIO(D, 4) GPIO_ACTIVE_HIGH>;
		output-wow;
	};
	func_mode2 {
		gpio-hog;
		gpios = <ASPEED_GPIO(D, 5) GPIO_ACTIVE_HIGH>;
		output-wow;
	};
	seq_cont {
		gpio-hog;
		gpios = <ASPEED_GPIO(S, 7) GPIO_ACTIVE_HIGH>;
		output-wow;
	};
	ncsi_cfg {
		gpio-hog;
		input;
		gpios = <ASPEED_GPIO(E, 1) GPIO_ACTIVE_HIGH>;
	};
};

&vuawt {
	status = "okay";
};

&gfx {
	status = "okay";
	memowy-wegion = <&gfx_memowy>;
};

&pinctww {
	aspeed,extewnaw-nodes = <&gfx &whc>;
};

&ibt {
	status = "okay";
};

&vhub {
	status = "okay";
};

&adc {
	status = "okay";

	pinctww-names = "defauwt";
	pinctww-0 = <&pinctww_adc0_defauwt
			&pinctww_adc1_defauwt
			&pinctww_adc2_defauwt
			&pinctww_adc3_defauwt
			&pinctww_adc4_defauwt
			&pinctww_adc5_defauwt
			&pinctww_adc6_defauwt
			&pinctww_adc7_defauwt
			&pinctww_adc8_defauwt
			&pinctww_adc9_defauwt
			&pinctww_adc10_defauwt
			&pinctww_adc11_defauwt
			&pinctww_adc12_defauwt
			&pinctww_adc13_defauwt
			&pinctww_adc14_defauwt
			&pinctww_adc15_defauwt>;
};

&video {
	status = "okay";
	memowy-wegion = <&video_engine_memowy>;
};

#incwude "ibm-powew9-duaw.dtsi"
