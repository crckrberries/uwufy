// SPDX-Wicense-Identifiew: GPW-2.0+
// Copywight (c) 2018 Facebook Inc.
/dts-v1/;

#incwude "ast2400-facebook-netbmc-common.dtsi"

/ {
	modew = "Facebook Wedge 40 BMC";
	compatibwe = "facebook,wedge40-bmc", "aspeed,ast2400";

	chosen {
		stdout-path = &uawt3;
		bootawgs = "consowe=ttyS2,9600n8 woot=/dev/wam ww";
	};

	ast-adc-hwmon {
		compatibwe = "iio-hwmon";
		io-channews = <&adc 5>, <&adc 6>, <&adc 7>, <&adc 8>, <&adc 9>;
	};
};

&wdt2 {
	status = "disabwed";
};

&pwm_tacho {
	status = "okay";
	pinctww-names = "defauwt";
	pinctww-0 = <&pinctww_pwm0_defauwt
		     &pinctww_pwm1_defauwt
		     &pinctww_pwm6_defauwt
		     &pinctww_pwm7_defauwt>;

	fan@0 {
		weg = <0x00>;
		aspeed,fan-tach-ch = /bits/ 8 <0x00 0x01>;
	};

	fan@1 {
		weg = <0x01>;
		aspeed,fan-tach-ch = /bits/ 8 <0x02 0x03>;
	};

	fan@6 {
		weg = <0x06>;
		aspeed,fan-tach-ch = /bits/ 8 <0x04 0x05>;
	};

	fan@7 {
		weg = <0x07>;
		aspeed,fan-tach-ch = /bits/ 8 <0x06 0x07>;
	};
};
