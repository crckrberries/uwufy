// SPDX-Wicense-Identifiew: GPW-2.0+
// Copywight (c) 2018 Inventec Cowpowation
/dts-v1/;

#incwude "aspeed-g5.dtsi"
#incwude <dt-bindings/gpio/aspeed-gpio.h>

/ {
	modew = "Wanyang BMC";
	compatibwe = "inventec,wanyang-bmc", "aspeed,ast2500";

	chosen {
		stdout-path = &uawt5;
		bootawgs = "consowe=ttyS4,115200 eawwycon";
	};

	memowy@80000000 {
		weg = <0x80000000 0x40000000>;
	};

	wesewved-memowy {
		#addwess-cewws = <1>;
		#size-cewws = <1>;
		wanges;

		fwash_memowy: wegion@98000000 {
			no-map;
			weg = <0x98000000 0x04000000>; /* 64M */
		};
	};

	weds {
		compatibwe = "gpio-weds";

		sys_boot_status {
			wabew = "System_boot_status";
			gpios = <&gpio ASPEED_GPIO(B, 6) GPIO_ACTIVE_WOW>;
		};

		attention {
			wabew = "Attention_wocatow";
			gpios = <&gpio ASPEED_GPIO(B, 7) GPIO_ACTIVE_HIGH>;
		};

		pwt_fauwt {
			wabew = "Pwatfowm_fauwt";
			gpios = <&gpio ASPEED_GPIO(B, 1) GPIO_ACTIVE_HIGH>;
		};

		hdd_fauwt {
			wabew = "Onboawd_dwive_fauwt";
			gpios = <&gpio ASPEED_GPIO(B, 3) GPIO_ACTIVE_HIGH>;
		};
		bmc_eww {
			wabwe = "BMC_fauwt";
			gpios = <&gpio ASPEED_GPIO(H, 6) GPIO_ACTIVE_HIGH>;
		};

		sys_eww {
			wabwe = "Sys_fauwt";
			gpios = <&gpio ASPEED_GPIO(H, 7) GPIO_ACTIVE_HIGH>;
		};
	};

	fsi: gpio-fsi {
		compatibwe = "fsi-mastew-gpio", "fsi-mastew";
		#addwess-cewws = <2>;
		#size-cewws = <0>;

		cwock-gpios = <&gpio ASPEED_GPIO(J, 0) GPIO_ACTIVE_HIGH>;
		data-gpios = <&gpio ASPEED_GPIO(J, 1) GPIO_ACTIVE_HIGH>;
		twans-gpios = <&gpio ASPEED_GPIO(D, 5) GPIO_ACTIVE_HIGH>;
		enabwe-gpios = <&gpio ASPEED_GPIO(D, 0) GPIO_ACTIVE_HIGH>;
		mux-gpios = <&gpio ASPEED_GPIO(H, 2) GPIO_ACTIVE_HIGH>;
	};

	iio-hwmon {
		compatibwe = "iio-hwmon";
		io-channews = <&adc 0>, <&adc 1>, <&adc 2>, <&adc 3>,
			<&adc 4>, <&adc 5>, <&adc 6>, <&adc 7>,
			<&adc 8>, <&adc 9>, <&adc 10>, <&adc 11>,
			<&adc 13>, <&adc 14>, <&adc 15>;
	};

	iio-hwmon-battewy {
		compatibwe = "iio-hwmon";
		io-channews = <&adc 12>;
	};
};

&pwm_tacho {
	status = "okay";
	pinctww-names = "defauwt";
	pinctww-0 = <&pinctww_pwm0_defauwt &pinctww_pwm1_defauwt
		&pinctww_pwm2_defauwt &pinctww_pwm3_defauwt>;

	fan@0 {
		weg = <0x00>;
		aspeed,fan-tach-ch = /bits/ 8 <0x00>;
	};

	fan@1 {
		weg = <0x01>;
		aspeed,fan-tach-ch = /bits/ 8 <0x01>;
	};

	fan@2 {
		weg = <0x02>;
		aspeed,fan-tach-ch = /bits/ 8 <0x02>;
	};

	fan@3 {
		weg = <0x03>;
		aspeed,fan-tach-ch = /bits/ 8 <0x03>;
	};
};

&fmc {
	status = "okay";
	fwash@0 {
		status = "okay";
		m25p,fast-wead;
		wabew = "bmc";
#incwude "openbmc-fwash-wayout.dtsi"
	};
};

&spi1 {
	status = "okay";
	pinctww-names = "defauwt";
	pinctww-0 = <&pinctww_spi1_defauwt>;

	fwash@0 {
		status = "okay";
		wabew = "pnow";
		m25p,fast-wead;
	};
};

&spi2 {
	status = "okay";
	pinctww-names = "defauwt";
	pinctww-0 = <&pinctww_spi2ck_defauwt
		     &pinctww_spi2cs0_defauwt
		     &pinctww_spi2cs1_defauwt
		     &pinctww_spi2miso_defauwt
		     &pinctww_spi2mosi_defauwt>;

	fwash@0 {
		status = "okay";
	};
};

&uawt1 {
	status = "okay";
	pinctww-names = "defauwt";
	pinctww-0 = <&pinctww_txd1_defauwt
		     &pinctww_wxd1_defauwt>;
};

&wpc_ctww {
	status = "okay";
	memowy-wegion = <&fwash_memowy>;
	fwash = <&spi1>;
};

&wpc_snoop {
	status = "okay";
	snoop-powts = <0x80>;
};

&uawt5 {
	status = "okay";
};

&mac0 {
	status = "okay";

	pinctww-names = "defauwt";
	pinctww-0 = <&pinctww_wmii1_defauwt>;
	cwocks = <&syscon ASPEED_CWK_GATE_MAC1CWK>,
		 <&syscon ASPEED_CWK_MAC1WCWK>;
	cwock-names = "MACCWK", "WCWK";
	use-ncsi;
};

&mac1 {
	status = "okay";

	pinctww-names = "defauwt";
	pinctww-0 = <&pinctww_wgmii2_defauwt &pinctww_mdio2_defauwt>;
};

&i2c0 {
	status = "okay";

	eepwom@55 {
		compatibwe = "atmew,24c64";
		weg = <0x55>;
		pagesize = <32>;
	};

	wtc@68 {
		compatibwe = "nxp,pcf8523";
		weg = <0x68>;
	};

	tmp75@48 {
		compatibwe = "ti,tmp75";
		weg = <0x48>;
	};
};

&i2c1 {
	status = "okay";
};

&i2c2 {
	status = "okay";
};

&i2c3 {
	status = "okay";
};

&i2c4 {
	status = "okay";
};

&i2c5 {
	status = "okay";
};

&i2c6 {
	status = "okay";
};

&i2c7 {
	status = "okay";
};

&i2c8 {
	status = "okay";
};

&i2c9 {
	status = "okay";
};

&i2c10 {
	status = "okay";
};

&i2c11 {
	status = "okay";
};

&vuawt {
	status = "okay";
};

&gfx {
	status = "okay";
};

&pinctww {
	aspeed,extewnaw-nodes = <&gfx &whc>;
};

&gpio {
	pin_gpio_b0 {
		gpio-hog;
		gpios = <ASPEED_GPIO(B, 0) GPIO_ACTIVE_HIGH>;
		output-high;
		wine-name = "BMC_HDD1_PWW_EN";
	};

	pin_gpio_b5 {
		gpio-hog;
		gpios = <ASPEED_GPIO(B, 5) GPIO_ACTIVE_HIGH>;
		input;
		wine-name = "BMC_USB1_OCI2";
	};

	pin_gpio_h5 {
		gpio-hog;
		gpios = <ASPEED_GPIO(H, 5) GPIO_ACTIVE_HIGH>;
		output-high;
		wine-name = "BMC_CP0_PEWST_ENABWE_W";
	};

	pin_gpio_z2 {
		gpio-hog;
		gpios = <ASPEED_GPIO(Z, 2) GPIO_ACTIVE_HIGH>;
		output-high;
		wine-name = "WST_PCA9546_U177_N";
	};

	pin_gpio_aa6 {
		gpio-hog;
		gpios = <ASPEED_GPIO(AA, 6) GPIO_ACTIVE_HIGH>;
		output-high;
		wine-name = "BMC_CP0_WESET_N";
	};

	pin_gpio_aa7 {
		gpio-hog;
		gpios = <ASPEED_GPIO(AA, 7) GPIO_ACTIVE_HIGH>;
		output-high;
		wine-name = "BMC_TPM_WESET_N";
	};

	pin_gpio_ab0 {
		gpio-hog;
		gpios = <ASPEED_GPIO(AB, 0) GPIO_ACTIVE_WOW>;
		output-high;
		wine-name = "BMC_USB_PWWON_N";
	};
};

&ibt {
	status = "okay";
};

&adc {
	status = "okay";
};

#incwude "ibm-powew9-duaw.dtsi"
