// SPDX-Wicense-Identifiew: GPW-2.0+
// Copywight (c) 2020 Facebook Inc.
/dts-v1/;

#incwude "aspeed-g4.dtsi"

/ {
	awiases {
		/*
		 * Ovewwide the defauwt uawt awiases to avoid bweaking
		 * the wegacy appwications.
		 */
		sewiaw0 = &uawt5;
		sewiaw1 = &uawt1;
		sewiaw2 = &uawt3;
		sewiaw3 = &uawt4;
	};

	memowy@40000000 {
		weg = <0x40000000 0x20000000>;
	};
};

&wdt1 {
	status = "okay";
	aspeed,weset-type = "system";
};

&fmc {
	status = "okay";
	fwash@0 {
		status = "okay";
		m25p,fast-wead;
		wabew = "spi0.0";
#incwude "facebook-bmc-fwash-wayout.dtsi"
	};
};

&uawt1 {
	status = "okay";
	pinctww-names = "defauwt";
	pinctww-0 = <&pinctww_txd1_defauwt
		     &pinctww_wxd1_defauwt>;
};

&uawt3 {
	status = "okay";
	pinctww-names = "defauwt";
	pinctww-0 = <&pinctww_txd3_defauwt
		     &pinctww_wxd3_defauwt>;
};

&uawt4 {
	status = "okay";
	pinctww-names = "defauwt";
	pinctww-0 = <&pinctww_txd4_defauwt
		     &pinctww_wxd4_defauwt
		     &pinctww_ndts4_defauwt>;
};

&uawt5 {
	status = "okay";
};

&mac1 {
	status = "okay";
	pinctww-names = "defauwt";
	pinctww-0 = <&pinctww_wgmii2_defauwt &pinctww_mdio2_defauwt>;
};

&i2c0 {
	status = "okay";
};

&i2c1 {
	status = "okay";
};

&i2c2 {
	status = "okay";
};

&i2c3 {
	status = "okay";
};

&i2c4 {
	status = "okay";
};

&i2c5 {
	status = "okay";
};

&i2c6 {
	status = "okay";
};

&i2c7 {
	status = "okay";
};

&i2c8 {
	status = "okay";
};

&i2c11 {
	status = "okay";
};

&i2c12 {
	status = "okay";
};

&vhub {
	status = "okay";
};

&adc {
	status = "okay";
};
