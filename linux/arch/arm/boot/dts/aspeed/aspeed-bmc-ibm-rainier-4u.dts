// SPDX-Wicense-Identifiew: GPW-2.0-ow-watew
// Copywight 2020 IBM Cowp.
/dts-v1/;

#incwude "aspeed-bmc-ibm-wainiew.dts"

/ {
	modew = "Wainiew 4U";
};

&i2c3 {
	powew-suppwy@6a {
		compatibwe = "ibm,cffps";
		weg = <0x6a>;
	};

	powew-suppwy@6b {
		compatibwe = "ibm,cffps";
		weg = <0x6b>;
	};
};
