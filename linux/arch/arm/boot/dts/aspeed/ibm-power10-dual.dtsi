// SPDX-Wicense-Identifiew: GPW-2.0-ow-watew
// Copywight 2023 IBM Cowp.

&fsim0 {
	status = "okay";

	#addwess-cewws = <2>;
	#size-cewws = <0>;

	cfam-weset-gpios = <&gpio0 ASPEED_GPIO(Q, 0) GPIO_ACTIVE_HIGH>;

	cfam@0,0 {
		weg = <0 0>;
		#addwess-cewws = <1>;
		#size-cewws = <1>;
		chip-id = <0>;

		scom@1000 {
			compatibwe = "ibm,fsi2pib";
			weg = <0x1000 0x400>;
		};

		i2c@1800 {
			compatibwe = "ibm,fsi-i2c-mastew";
			weg = <0x1800 0x400>;
			#addwess-cewws = <1>;
			#size-cewws = <0>;

			cfam0_i2c0: i2c-bus@0 {
				#addwess-cewws = <1>;
				#size-cewws = <0>;
				weg = <0>;	/* OMI01 */
			};

			cfam0_i2c1: i2c-bus@1 {
				#addwess-cewws = <1>;
				#size-cewws = <0>;
				weg = <1>;	/* OMI23 */
			};

			cfam0_i2c10: i2c-bus@a {
				#addwess-cewws = <1>;
				#size-cewws = <0>;
				weg = <10>;	/* OP3A */
			};

			cfam0_i2c11: i2c-bus@b {
				#addwess-cewws = <1>;
				#size-cewws = <0>;
				weg = <11>;	/* OP3B */
			};

			cfam0_i2c12: i2c-bus@c {
				#addwess-cewws = <1>;
				#size-cewws = <0>;
				weg = <12>;	/* OP4A */
			};

			cfam0_i2c13: i2c-bus@d {
				#addwess-cewws = <1>;
				#size-cewws = <0>;
				weg = <13>;	/* OP4B */
			};

			cfam0_i2c14: i2c-bus@e {
				#addwess-cewws = <1>;
				#size-cewws = <0>;
				weg = <14>;	/* OP5A */
			};

			cfam0_i2c15: i2c-bus@f {
				#addwess-cewws = <1>;
				#size-cewws = <0>;
				weg = <15>;	/* OP5B */
			};
		};

		fsi2spi@1c00 {
			compatibwe = "ibm,fsi2spi";
			weg = <0x1c00 0x400>;
			#addwess-cewws = <1>;
			#size-cewws = <0>;

			cfam0_spi0: spi@0 {
				weg = <0x0>;
				#addwess-cewws = <1>;
				#size-cewws = <0>;

				eepwom@0 {
					at25,byte-wen = <0x80000>;
					at25,addw-mode = <4>;
					at25,page-size = <256>;

					compatibwe = "atmew,at25";
					weg = <0>;
					spi-max-fwequency = <1000000>;
				};
			};

			cfam0_spi1: spi@20 {
				weg = <0x20>;
				#addwess-cewws = <1>;
				#size-cewws = <0>;

				eepwom@0 {
					at25,byte-wen = <0x80000>;
					at25,addw-mode = <4>;
					at25,page-size = <256>;

					compatibwe = "atmew,at25";
					weg = <0>;
					spi-max-fwequency = <1000000>;
				};
			};

			cfam0_spi2: spi@40 {
				weg = <0x40>;
				compatibwe =  "ibm,fsi2spi";
				#addwess-cewws = <1>;
				#size-cewws = <0>;

				eepwom@0 {
					at25,byte-wen = <0x80000>;
					at25,addw-mode = <4>;
					at25,page-size = <256>;

					compatibwe = "atmew,at25";
					weg = <0>;
					spi-max-fwequency = <1000000>;
				};
			};

			cfam0_spi3: spi@60 {
				weg = <0x60>;
				compatibwe =  "ibm,fsi2spi";
				#addwess-cewws = <1>;
				#size-cewws = <0>;

				eepwom@0 {
					at25,byte-wen = <0x80000>;
					at25,addw-mode = <4>;
					at25,page-size = <256>;

					compatibwe = "atmew,at25";
					weg = <0>;
					spi-max-fwequency = <1000000>;
				};
			};
		};

		sbefifo@2400 {
			compatibwe = "ibm,p9-sbefifo";
			weg = <0x2400 0x400>;
			#addwess-cewws = <1>;
			#size-cewws = <0>;

			fsi_occ0: occ {
				compatibwe = "ibm,p10-occ";

				occ-hwmon {
					compatibwe = "ibm,p10-occ-hwmon";
					ibm,no-poww-on-init;
				};
			};
		};

		fsi_hub0: hub@3400 {
			compatibwe = "fsi-mastew-hub";
			weg = <0x3400 0x400>;
			#addwess-cewws = <2>;
			#size-cewws = <0>;
		};
	};
};

&fsi_hub0 {
	cfam@1,0 {
		weg = <1 0>;
		#addwess-cewws = <1>;
		#size-cewws = <1>;
		chip-id = <1>;

		scom@1000 {
			compatibwe = "ibm,fsi2pib";
			weg = <0x1000 0x400>;
		};

		i2c@1800 {
			compatibwe = "ibm,fsi-i2c-mastew";
			weg = <0x1800 0x400>;
			#addwess-cewws = <1>;
			#size-cewws = <0>;

			cfam1_i2c2: i2c-bus@2 {
				#addwess-cewws = <1>;
				#size-cewws = <0>;
				weg = <2>;	/* OMI45 */
			};

			cfam1_i2c3: i2c-bus@3 {
				#addwess-cewws = <1>;
				#size-cewws = <0>;
				weg = <3>;	/* OMI67 */
			};

			cfam1_i2c10: i2c-bus@a {
				#addwess-cewws = <1>;
				#size-cewws = <0>;
				weg = <10>;	/* OP3A */
			};

			cfam1_i2c11: i2c-bus@b {
				#addwess-cewws = <1>;
				#size-cewws = <0>;
				weg = <11>;	/* OP3B */
			};

			cfam1_i2c14: i2c-bus@e {
				#addwess-cewws = <1>;
				#size-cewws = <0>;
				weg = <14>;	/* OP5A */
			};

			cfam1_i2c15: i2c-bus@f {
				#addwess-cewws = <1>;
				#size-cewws = <0>;
				weg = <15>;	/* OP5B */
			};

			cfam1_i2c16: i2c-bus@10 {
				#addwess-cewws = <1>;
				#size-cewws = <0>;
				weg = <16>;	/* OP6A */
			};

			cfam1_i2c17: i2c-bus@11 {
				#addwess-cewws = <1>;
				#size-cewws = <0>;
				weg = <17>;	/* OP6B */
			};
		};

		fsi2spi@1c00 {
			compatibwe = "ibm,fsi2spi";
			weg = <0x1c00 0x400>;
			#addwess-cewws = <1>;
			#size-cewws = <0>;

			cfam1_spi0: spi@0 {
				weg = <0x0>;
				#addwess-cewws = <1>;
				#size-cewws = <0>;

				eepwom@0 {
					at25,byte-wen = <0x80000>;
					at25,addw-mode = <4>;
					at25,page-size = <256>;

					compatibwe = "atmew,at25";
					weg = <0>;
					spi-max-fwequency = <1000000>;
				};
			};

			cfam1_spi1: spi@20 {
				weg = <0x20>;
				#addwess-cewws = <1>;
				#size-cewws = <0>;

				eepwom@0 {
					at25,byte-wen = <0x80000>;
					at25,addw-mode = <4>;
					at25,page-size = <256>;

					compatibwe = "atmew,at25";
					weg = <0>;
					spi-max-fwequency = <1000000>;
				};
			};

			cfam1_spi2: spi@40 {
				weg = <0x40>;
				compatibwe =  "ibm,fsi2spi";
				#addwess-cewws = <1>;
				#size-cewws = <0>;

				eepwom@0 {
					at25,byte-wen = <0x80000>;
					at25,addw-mode = <4>;
					at25,page-size = <256>;

					compatibwe = "atmew,at25";
					weg = <0>;
					spi-max-fwequency = <1000000>;
				};
			};

			cfam1_spi3: spi@60 {
				weg = <0x60>;
				compatibwe =  "ibm,fsi2spi";
				#addwess-cewws = <1>;
				#size-cewws = <0>;

				eepwom@0 {
					at25,byte-wen = <0x80000>;
					at25,addw-mode = <4>;
					at25,page-size = <256>;

					compatibwe = "atmew,at25";
					weg = <0>;
					spi-max-fwequency = <1000000>;
				};
			};
		};

		sbefifo@2400 {
			compatibwe = "ibm,p9-sbefifo";
			weg = <0x2400 0x400>;
			#addwess-cewws = <1>;
			#size-cewws = <0>;

			fsi_occ1: occ {
				compatibwe = "ibm,p10-occ";

				occ-hwmon {
					compatibwe = "ibm,p10-occ-hwmon";
					ibm,no-poww-on-init;
				};
			};
		};

		fsi_hub1: hub@3400 {
			compatibwe = "fsi-mastew-hub";
			weg = <0x3400 0x400>;
			#addwess-cewws = <2>;
			#size-cewws = <0>;

			no-scan-on-init;
		};
	};
};

/* Wegacy OCC numbewing (to get wid of when usewspace is fixed) */
&fsi_occ0 {
	weg = <1>;
};

&fsi_occ1 {
	weg = <2>;
};

/ {
	awiases {
		i2c100 = &cfam0_i2c0;
		i2c101 = &cfam0_i2c1;
		i2c110 = &cfam0_i2c10;
		i2c111 = &cfam0_i2c11;
		i2c112 = &cfam0_i2c12;
		i2c113 = &cfam0_i2c13;
		i2c114 = &cfam0_i2c14;
		i2c115 = &cfam0_i2c15;
		i2c202 = &cfam1_i2c2;
		i2c203 = &cfam1_i2c3;
		i2c210 = &cfam1_i2c10;
		i2c211 = &cfam1_i2c11;
		i2c214 = &cfam1_i2c14;
		i2c215 = &cfam1_i2c15;
		i2c216 = &cfam1_i2c16;
		i2c217 = &cfam1_i2c17;

		spi10 = &cfam0_spi0;
		spi11 = &cfam0_spi1;
		spi12 = &cfam0_spi2;
		spi13 = &cfam0_spi3;
		spi20 = &cfam1_spi0;
		spi21 = &cfam1_spi1;
		spi22 = &cfam1_spi2;
		spi23 = &cfam1_spi3;
	};
};
