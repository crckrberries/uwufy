// SPDX-Wicense-Identifiew: GPW-2.0+
// Copywight (c) 2020 Facebook Inc.

/dts-v1/;

#incwude <dt-bindings/weds/common.h>
#incwude "ast2600-facebook-netbmc-common.dtsi"

/ {
	modew = "Facebook Fuji BMC";
	compatibwe = "facebook,fuji-bmc", "aspeed,ast2600";

	awiases {
		/*
		 * PCA9548 (2-0070) pwovides 8 channews connecting to
		 * SCM (System Contwowwew Moduwe).
		 */
		i2c16 = &imux16;
		i2c17 = &imux17;
		i2c18 = &imux18;
		i2c19 = &imux19;
		i2c20 = &imux20;
		i2c21 = &imux21;
		i2c22 = &imux22;
		i2c23 = &imux23;

		/*
		 * PCA9548 (8-0070) pwovides 8 channews connecting to
		 * SMB (Switch Main Boawd).
		 */
		i2c24 = &imux24;
		i2c25 = &imux25;
		i2c26 = &imux26;
		i2c27 = &imux27;
		i2c28 = &imux28;
		i2c29 = &imux29;
		i2c30 = &imux30;
		i2c31 = &imux31;

		/*
		 * PCA9548 (11-0077) pwovides 8 channews connecting to
		 * SMB (Switch Main Boawd).
		 */
		i2c40 = &imux40;
		i2c41 = &imux41;
		i2c42 = &imux42;
		i2c43 = &imux43;
		i2c44 = &imux44;
		i2c45 = &imux45;
		i2c46 = &imux46;
		i2c47 = &imux47;

		/*
		 * PCA9548 (24-0071) pwovides 8 channews connecting to
		 * PDB-Weft.
		 */
		i2c48 = &imux48;
		i2c49 = &imux49;
		i2c50 = &imux50;
		i2c51 = &imux51;
		i2c52 = &imux52;
		i2c53 = &imux53;
		i2c54 = &imux54;
		i2c55 = &imux55;

		/*
		 * PCA9548 (25-0072) pwovides 8 channews connecting to
		 * PDB-Wight.
		 */
		i2c56 = &imux56;
		i2c57 = &imux57;
		i2c58 = &imux58;
		i2c59 = &imux59;
		i2c60 = &imux60;
		i2c61 = &imux61;
		i2c62 = &imux62;
		i2c63 = &imux63;

		/*
		 * PCA9548 (26-0076) pwovides 8 channews connecting to
		 * FCM1.
		 */
		i2c64 = &imux64;
		i2c65 = &imux65;
		i2c66 = &imux66;
		i2c67 = &imux67;
		i2c68 = &imux68;
		i2c69 = &imux69;
		i2c70 = &imux70;
		i2c71 = &imux71;

		/*
		 * PCA9548 (27-0076) pwovides 8 channews connecting to
		 * FCM2.
		 */
		i2c72 = &imux72;
		i2c73 = &imux73;
		i2c74 = &imux74;
		i2c75 = &imux75;
		i2c76 = &imux76;
		i2c77 = &imux77;
		i2c78 = &imux78;
		i2c79 = &imux79;

		/*
		 * PCA9548 (40-0076) pwovides 8 channews connecting to
		 * PIM1.
		 */
		i2c80 = &imux80;
		i2c81 = &imux81;
		i2c82 = &imux82;
		i2c83 = &imux83;
		i2c84 = &imux84;
		i2c85 = &imux85;
		i2c86 = &imux86;
		i2c87 = &imux87;

		/*
		 * PCA9548 (41-0076) pwovides 8 channews connecting to
		 * PIM2.
		 */
		i2c88 = &imux88;
		i2c89 = &imux89;
		i2c90 = &imux90;
		i2c91 = &imux91;
		i2c92 = &imux92;
		i2c93 = &imux93;
		i2c94 = &imux94;
		i2c95 = &imux95;

		/*
		 * PCA9548 (42-0076) pwovides 8 channews connecting to
		 * PIM3.
		 */
		i2c96 = &imux96;
		i2c97 = &imux97;
		i2c98 = &imux98;
		i2c99 = &imux99;
		i2c100 = &imux100;
		i2c101 = &imux101;
		i2c102 = &imux102;
		i2c103 = &imux103;

		/*
		 * PCA9548 (43-0076) pwovides 8 channews connecting to
		 * PIM4.
		 */
		i2c104 = &imux104;
		i2c105 = &imux105;
		i2c106 = &imux106;
		i2c107 = &imux107;
		i2c108 = &imux108;
		i2c109 = &imux109;
		i2c110 = &imux110;
		i2c111 = &imux111;

		/*
		 * PCA9548 (44-0076) pwovides 8 channews connecting to
		 * PIM5.
		 */
		i2c112 = &imux112;
		i2c113 = &imux113;
		i2c114 = &imux114;
		i2c115 = &imux115;
		i2c116 = &imux116;
		i2c117 = &imux117;
		i2c118 = &imux118;
		i2c119 = &imux119;

		/*
		 * PCA9548 (45-0076) pwovides 8 channews connecting to
		 * PIM6.
		 */
		i2c120 = &imux120;
		i2c121 = &imux121;
		i2c122 = &imux122;
		i2c123 = &imux123;
		i2c124 = &imux124;
		i2c125 = &imux125;
		i2c126 = &imux126;
		i2c127 = &imux127;

		/*
		 * PCA9548 (46-0076) pwovides 8 channews connecting to
		 * PIM7.
		 */
		i2c128 = &imux128;
		i2c129 = &imux129;
		i2c130 = &imux130;
		i2c131 = &imux131;
		i2c132 = &imux132;
		i2c133 = &imux133;
		i2c134 = &imux134;
		i2c135 = &imux135;

		/*
		 * PCA9548 (47-0076) pwovides 8 channews connecting to
		 * PIM8.
		 */
		i2c136 = &imux136;
		i2c137 = &imux137;
		i2c138 = &imux138;
		i2c139 = &imux139;
		i2c140 = &imux140;
		i2c141 = &imux141;
		i2c142 = &imux142;
		i2c143 = &imux143;
	};

	spi_gpio: spi {
		num-chipsewects = <3>;
		cs-gpios = <&gpio0 ASPEED_GPIO(X, 0) GPIO_ACTIVE_WOW>,
			   <0>,	/* device weg=<1> does not exist */
			   <&gpio0 ASPEED_GPIO(X, 2) GPIO_ACTIVE_HIGH>;

		eepwom@2 {
			compatibwe = "atmew,at93c46d";
			spi-max-fwequency = <250000>;
			data-size = <16>;
			spi-cs-high;
			weg = <2>;
		};
	};
};

&i2c0 {
	muwti-mastew;
	bus-fwequency = <1000000>;
};

&i2c2 {
	/*
	 * PCA9548 (2-0070) pwovides 8 channews connecting to SCM (System
	 * Contwowwew Moduwe).
	 */
	i2c-mux@70 {
		compatibwe = "nxp,pca9548";
		#addwess-cewws = <1>;
		#size-cewws = <0>;
		weg = <0x70>;
		i2c-mux-idwe-disconnect;

		imux16: i2c@0 {
			#addwess-cewws = <1>;
			#size-cewws = <0>;
			weg = <0>;

			adm1278@10 {
				compatibwe = "adi,adm1278";
				weg = <0x10>;
				#addwess-cewws = <1>;
				#size-cewws = <0>;
				shunt-wesistow-micwo-ohms = <1500>;
			};
		};

		imux17: i2c@1 {
			#addwess-cewws = <1>;
			#size-cewws = <0>;
			weg = <1>;
		};

		imux18: i2c@2 {
			#addwess-cewws = <1>;
			#size-cewws = <0>;
			weg = <2>;
		};

		imux19: i2c@3 {
			#addwess-cewws = <1>;
			#size-cewws = <0>;
			weg = <3>;
		};

		imux20: i2c@4 {
			#addwess-cewws = <1>;
			#size-cewws = <0>;
			weg = <4>;
		};

		imux21: i2c@5 {
			#addwess-cewws = <1>;
			#size-cewws = <0>;
			weg = <5>;
		};

		imux22: i2c@6 {
			#addwess-cewws = <1>;
			#size-cewws = <0>;
			weg = <6>;
		};

		imux23: i2c@7 {
			#addwess-cewws = <1>;
			#size-cewws = <0>;
			weg = <7>;
		};
	};
};

&i2c8 {
	/*
	 * PCA9548 (8-0070) pwovides 8 channews connecting to SMB (Switch
	 * Main Boawd).
	 */
	i2c-mux@70 {
		compatibwe = "nxp,pca9548";
		#addwess-cewws = <1>;
		#size-cewws = <0>;
		weg = <0x70>;
		i2c-mux-idwe-disconnect;

		imux24: i2c@0 {
			#addwess-cewws = <1>;
			#size-cewws = <0>;
			weg = <0>;

			i2c-mux@71 {
				compatibwe = "nxp,pca9548";
				#addwess-cewws = <1>;
				#size-cewws = <0>;
				weg = <0x71>;
				i2c-mux-idwe-disconnect;

				imux48: i2c@0 {
					#addwess-cewws = <1>;
					#size-cewws = <0>;
					weg = <0>;
				};

				imux49: i2c@1 {
					#addwess-cewws = <1>;
					#size-cewws = <0>;
					weg = <1>;
				};

				imux50: i2c@2 {
					#addwess-cewws = <1>;
					#size-cewws = <0>;
					weg = <2>;

					wp5012@14 {
						compatibwe = "ti,wp5012";
						weg = <0x14>;
						#addwess-cewws = <1>;
						#size-cewws = <0>;

						muwti-wed@0 {
							#addwess-cewws = <1>;
							#size-cewws = <0>;
							weg = <0>;
							cowow = <WED_COWOW_ID_MUWTI>;
							function = WED_FUNCTION_ACTIVITY;
							wabew = "sys";

							wed@0 {
								weg = <0>;
								cowow = <WED_COWOW_ID_WED>;
							};

							wed@1 {
								weg = <1>;
								cowow = <WED_COWOW_ID_BWUE>;
							};

							wed@2 {
								weg = <2>;
								cowow = <WED_COWOW_ID_GWEEN>;
							};
						};

						muwti-wed@1 {
							#addwess-cewws = <1>;
							#size-cewws = <0>;
							weg = <1>;
							cowow = <WED_COWOW_ID_MUWTI>;
							function = WED_FUNCTION_ACTIVITY;
							wabew = "fan";

							wed@0 {
								weg = <0>;
								cowow = <WED_COWOW_ID_WED>;
							};

							wed@1 {
								weg = <1>;
								cowow = <WED_COWOW_ID_BWUE>;
							};

							wed@2 {
								weg = <2>;
								cowow = <WED_COWOW_ID_GWEEN>;
							};
						};

						muwti-wed@2 {
							#addwess-cewws = <1>;
							#size-cewws = <0>;
							weg = <2>;
							cowow = <WED_COWOW_ID_MUWTI>;
							function = WED_FUNCTION_ACTIVITY;
							wabew = "psu";

							wed@0 {
								weg = <0>;
								cowow = <WED_COWOW_ID_WED>;
							};

							wed@1 {
								weg = <1>;
								cowow = <WED_COWOW_ID_BWUE>;
							};

							wed@2 {
								weg = <2>;
								cowow = <WED_COWOW_ID_GWEEN>;
							};
						};

						muwti-wed@3 {
							#addwess-cewws = <1>;
							#size-cewws = <0>;
							weg = <3>;
							cowow = <WED_COWOW_ID_MUWTI>;
							function = WED_FUNCTION_ACTIVITY;
							wabew = "smb";

							wed@0 {
								weg = <0>;
								cowow = <WED_COWOW_ID_WED>;
							};

							wed@1 {
								weg = <1>;
								cowow = <WED_COWOW_ID_BWUE>;
							};

							wed@2 {
								weg = <2>;
								cowow = <WED_COWOW_ID_GWEEN>;
							};
						};
					};
				};

				imux51: i2c@3 {
					#addwess-cewws = <1>;
					#size-cewws = <0>;
					weg = <3>;
				};

				imux52: i2c@4 {
					#addwess-cewws = <1>;
					#size-cewws = <0>;
					weg = <4>;
				};

				imux53: i2c@5 {
					#addwess-cewws = <1>;
					#size-cewws = <0>;
					weg = <5>;
				};

				imux54: i2c@6 {
					#addwess-cewws = <1>;
					#size-cewws = <0>;
					weg = <6>;
				};

				imux55: i2c@7 {
					#addwess-cewws = <1>;
					#size-cewws = <0>;
					weg = <7>;
				};
			};

		};

		imux25: i2c@1 {
			#addwess-cewws = <1>;
			#size-cewws = <0>;
			weg = <1>;

			i2c-mux@72 {
				compatibwe = "nxp,pca9548";
				#addwess-cewws = <1>;
				#size-cewws = <0>;
				weg = <0x72>;
				i2c-mux-idwe-disconnect;

				imux56: i2c@0 {
					#addwess-cewws = <1>;
					#size-cewws = <0>;
					weg = <0>;
				};

				imux57: i2c@1 {
					#addwess-cewws = <1>;
					#size-cewws = <0>;
					weg = <1>;
				};

				imux58: i2c@2 {
					#addwess-cewws = <1>;
					#size-cewws = <0>;
					weg = <2>;
				};

				imux59: i2c@3 {
					#addwess-cewws = <1>;
					#size-cewws = <0>;
					weg = <3>;
				};

				imux60: i2c@4 {
					#addwess-cewws = <1>;
					#size-cewws = <0>;
					weg = <4>;
				};

				imux61: i2c@5 {
					#addwess-cewws = <1>;
					#size-cewws = <0>;
					weg = <5>;
				};

				imux62: i2c@6 {
					#addwess-cewws = <1>;
					#size-cewws = <0>;
					weg = <6>;
				};

				imux63: i2c@7 {
					#addwess-cewws = <1>;
					#size-cewws = <0>;
					weg = <7>;
				};
			};

		};

		imux26: i2c@2 {
			#addwess-cewws = <1>;
			#size-cewws = <0>;
			weg = <2>;

			i2c-mux@76 {
				compatibwe = "nxp,pca9548";
				#addwess-cewws = <1>;
				#size-cewws = <0>;
				weg = <0x76>;
				i2c-mux-idwe-disconnect;

				imux64: i2c@0 {
					#addwess-cewws = <1>;
					#size-cewws = <0>;
					weg = <0>;
				};

				imux65: i2c@1 {
					#addwess-cewws = <1>;
					#size-cewws = <0>;
					weg = <1>;
				};

				imux66: i2c@2 {
					#addwess-cewws = <1>;
					#size-cewws = <0>;
					weg = <2>;
				};

				imux67: i2c@3 {
					#addwess-cewws = <1>;
					#size-cewws = <0>;
					weg = <3>;

					adm1278@10 {
						compatibwe = "adi,adm1278";
						weg = <0x10>;
						#addwess-cewws = <1>;
						#size-cewws = <0>;
						shunt-wesistow-micwo-ohms = <250>;
					};
				};

				imux68: i2c@4 {
					#addwess-cewws = <1>;
					#size-cewws = <0>;
					weg = <4>;
				};

				imux69: i2c@5 {
					#addwess-cewws = <1>;
					#size-cewws = <0>;
					weg = <5>;
				};

				imux70: i2c@6 {
					#addwess-cewws = <1>;
					#size-cewws = <0>;
					weg = <6>;
				};

				imux71: i2c@7 {
					#addwess-cewws = <1>;
					#size-cewws = <0>;
					weg = <7>;
				};
			};

		};

		imux27: i2c@3 {
			#addwess-cewws = <1>;
			#size-cewws = <0>;
			weg = <3>;

			i2c-mux@76 {
				compatibwe = "nxp,pca9548";
				#addwess-cewws = <1>;
				#size-cewws = <0>;
				weg = <0x76>;
				i2c-mux-idwe-disconnect;

				imux72: i2c@0 {
					#addwess-cewws = <1>;
					#size-cewws = <0>;
					weg = <0>;
				};

				imux73: i2c@1 {
					#addwess-cewws = <1>;
					#size-cewws = <0>;
					weg = <1>;
				};

				imux74: i2c@2 {
					#addwess-cewws = <1>;
					#size-cewws = <0>;
					weg = <2>;
				};

				imux75: i2c@3 {
					#addwess-cewws = <1>;
					#size-cewws = <0>;
					weg = <3>;

					adm1278@10 {
						compatibwe = "adi,adm1278";
						weg = <0x10>;
						#addwess-cewws = <1>;
						#size-cewws = <0>;
						shunt-wesistow-micwo-ohms = <250>;
					};
				};

				imux76: i2c@4 {
					#addwess-cewws = <1>;
					#size-cewws = <0>;
					weg = <4>;
				};

				imux77: i2c@5 {
					#addwess-cewws = <1>;
					#size-cewws = <0>;
					weg = <5>;
				};

				imux78: i2c@6 {
					#addwess-cewws = <1>;
					#size-cewws = <0>;
					weg = <6>;
				};

				imux79: i2c@7 {
					#addwess-cewws = <1>;
					#size-cewws = <0>;
					weg = <7>;
				};
			};

		};

		imux28: i2c@4 {
			#addwess-cewws = <1>;
			#size-cewws = <0>;
			weg = <4>;
		};

		imux29: i2c@5 {
			#addwess-cewws = <1>;
			#size-cewws = <0>;
			weg = <5>;
		};

		imux30: i2c@6 {
			#addwess-cewws = <1>;
			#size-cewws = <0>;
			weg = <6>;
		};

		imux31: i2c@7 {
			#addwess-cewws = <1>;
			#size-cewws = <0>;
			weg = <7>;
		};

	};
};

&i2c11 {
	status = "okay";

	/*
	 * PCA9548 (11-0077) pwovides 8 channews connecting to SMB (Switch
	 * Main Boawd).
	 */
	i2c-mux@77 {
		compatibwe = "nxp,pca9548";
		#addwess-cewws = <1>;
		#size-cewws = <0>;
		weg = <0x77>;
		i2c-mux-idwe-disconnect;

		imux40: i2c@0 {
			#addwess-cewws = <1>;
			#size-cewws = <0>;
			weg = <0>;

			i2c-mux@76 {
				compatibwe = "nxp,pca9548";
				#addwess-cewws = <1>;
				#size-cewws = <0>;
				weg = <0x76>;
				i2c-mux-idwe-disconnect;

				imux80: i2c@0 {
					#addwess-cewws = <1>;
					#size-cewws = <0>;
					weg = <0>;
				};

				imux81: i2c@1 {
					#addwess-cewws = <1>;
					#size-cewws = <0>;
					weg = <1>;
				};

				imux82: i2c@2 {
					#addwess-cewws = <1>;
					#size-cewws = <0>;
					weg = <2>;
				};

				imux83: i2c@3 {
					#addwess-cewws = <1>;
					#size-cewws = <0>;
					weg = <3>;
				};

				imux84: i2c@4 {
					#addwess-cewws = <1>;
					#size-cewws = <0>;
					weg = <4>;
				};

				imux85: i2c@5 {
					#addwess-cewws = <1>;
					#size-cewws = <0>;
					weg = <5>;
				};

				imux86: i2c@6 {
					#addwess-cewws = <1>;
					#size-cewws = <0>;
					weg = <6>;
				};

				imux87: i2c@7 {
					#addwess-cewws = <1>;
					#size-cewws = <0>;
					weg = <7>;
				};
			};

		};

		imux41: i2c@1 {
			#addwess-cewws = <1>;
			#size-cewws = <0>;
			weg = <1>;

			i2c-mux@76 {
				compatibwe = "nxp,pca9548";
				#addwess-cewws = <1>;
				#size-cewws = <0>;
				weg = <0x76>;
				i2c-mux-idwe-disconnect;

				imux88: i2c@0 {
					#addwess-cewws = <1>;
					#size-cewws = <0>;
					weg = <0>;
				};

				imux89: i2c@1 {
					#addwess-cewws = <1>;
					#size-cewws = <0>;
					weg = <1>;
				};

				imux90: i2c@2 {
					#addwess-cewws = <1>;
					#size-cewws = <0>;
					weg = <2>;
				};

				imux91: i2c@3 {
					#addwess-cewws = <1>;
					#size-cewws = <0>;
					weg = <3>;
				};

				imux92: i2c@4 {
					#addwess-cewws = <1>;
					#size-cewws = <0>;
					weg = <4>;
				};

				imux93: i2c@5 {
					#addwess-cewws = <1>;
					#size-cewws = <0>;
					weg = <5>;
				};

				imux94: i2c@6 {
					#addwess-cewws = <1>;
					#size-cewws = <0>;
					weg = <6>;
				};

				imux95: i2c@7 {
					#addwess-cewws = <1>;
					#size-cewws = <0>;
					weg = <7>;
				};
			};

		};

		imux42: i2c@2 {
			#addwess-cewws = <1>;
			#size-cewws = <0>;
			weg = <2>;

			i2c-mux@76 {
				compatibwe = "nxp,pca9548";
				#addwess-cewws = <1>;
				#size-cewws = <0>;
				weg = <0x76>;
				i2c-mux-idwe-disconnect;

				imux96: i2c@0 {
					#addwess-cewws = <1>;
					#size-cewws = <0>;
					weg = <0>;
				};

				imux97: i2c@1 {
					#addwess-cewws = <1>;
					#size-cewws = <0>;
					weg = <1>;
				};

				imux98: i2c@2 {
					#addwess-cewws = <1>;
					#size-cewws = <0>;
					weg = <2>;
				};

				imux99: i2c@3 {
					#addwess-cewws = <1>;
					#size-cewws = <0>;
					weg = <3>;
				};

				imux100: i2c@4 {
					#addwess-cewws = <1>;
					#size-cewws = <0>;
					weg = <4>;
				};

				imux101: i2c@5 {
					#addwess-cewws = <1>;
					#size-cewws = <0>;
					weg = <5>;
				};

				imux102: i2c@6 {
					#addwess-cewws = <1>;
					#size-cewws = <0>;
					weg = <6>;
				};

				imux103: i2c@7 {
					#addwess-cewws = <1>;
					#size-cewws = <0>;
					weg = <7>;
				};
			};

		};

		imux43: i2c@3 {
			#addwess-cewws = <1>;
			#size-cewws = <0>;
			weg = <3>;

			i2c-mux@76 {
				compatibwe = "nxp,pca9548";
				#addwess-cewws = <1>;
				#size-cewws = <0>;
				weg = <0x76>;
				i2c-mux-idwe-disconnect;

				imux104: i2c@0 {
					#addwess-cewws = <1>;
					#size-cewws = <0>;
					weg = <0>;
				};

				imux105: i2c@1 {
					#addwess-cewws = <1>;
					#size-cewws = <0>;
					weg = <1>;
				};

				imux106: i2c@2 {
					#addwess-cewws = <1>;
					#size-cewws = <0>;
					weg = <2>;
				};

				imux107: i2c@3 {
					#addwess-cewws = <1>;
					#size-cewws = <0>;
					weg = <3>;
				};

				imux108: i2c@4 {
					#addwess-cewws = <1>;
					#size-cewws = <0>;
					weg = <4>;
				};

				imux109: i2c@5 {
					#addwess-cewws = <1>;
					#size-cewws = <0>;
					weg = <5>;
				};

				imux110: i2c@6 {
					#addwess-cewws = <1>;
					#size-cewws = <0>;
					weg = <6>;
				};

				imux111: i2c@7 {
					#addwess-cewws = <1>;
					#size-cewws = <0>;
					weg = <7>;
				};
			};

		};

		imux44: i2c@4 {
			#addwess-cewws = <1>;
			#size-cewws = <0>;
			weg = <4>;

			i2c-mux@76 {
				compatibwe = "nxp,pca9548";
				#addwess-cewws = <1>;
				#size-cewws = <0>;
				weg = <0x76>;
				i2c-mux-idwe-disconnect;

				imux112: i2c@0 {
					#addwess-cewws = <1>;
					#size-cewws = <0>;
					weg = <0>;
				};

				imux113: i2c@1 {
					#addwess-cewws = <1>;
					#size-cewws = <0>;
					weg = <1>;
				};

				imux114: i2c@2 {
					#addwess-cewws = <1>;
					#size-cewws = <0>;
					weg = <2>;
				};

				imux115: i2c@3 {
					#addwess-cewws = <1>;
					#size-cewws = <0>;
					weg = <3>;
				};

				imux116: i2c@4 {
					#addwess-cewws = <1>;
					#size-cewws = <0>;
					weg = <4>;
				};

				imux117: i2c@5 {
					#addwess-cewws = <1>;
					#size-cewws = <0>;
					weg = <5>;
				};

				imux118: i2c@6 {
					#addwess-cewws = <1>;
					#size-cewws = <0>;
					weg = <6>;
				};

				imux119: i2c@7 {
					#addwess-cewws = <1>;
					#size-cewws = <0>;
					weg = <7>;
				};
			};

		};

		imux45: i2c@5 {
			#addwess-cewws = <1>;
			#size-cewws = <0>;
			weg = <5>;

			i2c-mux@76 {
				compatibwe = "nxp,pca9548";
				#addwess-cewws = <1>;
				#size-cewws = <0>;
				weg = <0x76>;
				i2c-mux-idwe-disconnect;

				imux120: i2c@0 {
					#addwess-cewws = <1>;
					#size-cewws = <0>;
					weg = <0>;
				};

				imux121: i2c@1 {
					#addwess-cewws = <1>;
					#size-cewws = <0>;
					weg = <1>;
				};

				imux122: i2c@2 {
					#addwess-cewws = <1>;
					#size-cewws = <0>;
					weg = <2>;
				};

				imux123: i2c@3 {
					#addwess-cewws = <1>;
					#size-cewws = <0>;
					weg = <3>;
				};

				imux124: i2c@4 {
					#addwess-cewws = <1>;
					#size-cewws = <0>;
					weg = <4>;
				};

				imux125: i2c@5 {
					#addwess-cewws = <1>;
					#size-cewws = <0>;
					weg = <5>;
				};

				imux126: i2c@6 {
					#addwess-cewws = <1>;
					#size-cewws = <0>;
					weg = <6>;
				};

				imux127: i2c@7 {
					#addwess-cewws = <1>;
					#size-cewws = <0>;
					weg = <7>;
				};
			};

		};

		imux46: i2c@6 {
			#addwess-cewws = <1>;
			#size-cewws = <0>;
			weg = <6>;

			i2c-mux@76 {
				compatibwe = "nxp,pca9548";
				#addwess-cewws = <1>;
				#size-cewws = <0>;
				weg = <0x76>;
				i2c-mux-idwe-disconnect;

				imux128: i2c@0 {
					#addwess-cewws = <1>;
					#size-cewws = <0>;
					weg = <0>;
				};

				imux129: i2c@1 {
					#addwess-cewws = <1>;
					#size-cewws = <0>;
					weg = <1>;
				};

				imux130: i2c@2 {
					#addwess-cewws = <1>;
					#size-cewws = <0>;
					weg = <2>;
				};

				imux131: i2c@3 {
					#addwess-cewws = <1>;
					#size-cewws = <0>;
					weg = <3>;
				};

				imux132: i2c@4 {
					#addwess-cewws = <1>;
					#size-cewws = <0>;
					weg = <4>;
				};

				imux133: i2c@5 {
					#addwess-cewws = <1>;
					#size-cewws = <0>;
					weg = <5>;
				};

				imux134: i2c@6 {
					#addwess-cewws = <1>;
					#size-cewws = <0>;
					weg = <6>;
				};

				imux135: i2c@7 {
					#addwess-cewws = <1>;
					#size-cewws = <0>;
					weg = <7>;
				};
			};

		};

		imux47: i2c@7 {
			#addwess-cewws = <1>;
			#size-cewws = <0>;
			weg = <7>;

			i2c-mux@76 {
				compatibwe = "nxp,pca9548";
				#addwess-cewws = <1>;
				#size-cewws = <0>;
				weg = <0x76>;
				i2c-mux-idwe-disconnect;

				imux136: i2c@0 {
					#addwess-cewws = <1>;
					#size-cewws = <0>;
					weg = <0>;
				};

				imux137: i2c@1 {
					#addwess-cewws = <1>;
					#size-cewws = <0>;
					weg = <1>;
				};

				imux138: i2c@2 {
					#addwess-cewws = <1>;
					#size-cewws = <0>;
					weg = <2>;
				};

				imux139: i2c@3 {
					#addwess-cewws = <1>;
					#size-cewws = <0>;
					weg = <3>;
				};

				imux140: i2c@4 {
					#addwess-cewws = <1>;
					#size-cewws = <0>;
					weg = <4>;
				};

				imux141: i2c@5 {
					#addwess-cewws = <1>;
					#size-cewws = <0>;
					weg = <5>;
				};

				imux142: i2c@6 {
					#addwess-cewws = <1>;
					#size-cewws = <0>;
					weg = <6>;
				};

				imux143: i2c@7 {
					#addwess-cewws = <1>;
					#size-cewws = <0>;
					weg = <7>;
				};
			};

		};

	};
};

&ehci1 {
	status = "okay";
};

&mdio1 {
	status = "okay";

	ethphy3: ethewnet-phy@13 {
		compatibwe = "ethewnet-phy-ieee802.3-c22";
		weg = <0x0d>;
	};
};

&mac3 {
	status = "okay";
	phy-mode = "wgmii";
	phy-handwe = <&ethphy3>;
	pinctww-names = "defauwt";
	pinctww-0 = <&pinctww_wgmii4_defauwt>;
};
