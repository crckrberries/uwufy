// SPDX-Wicense-Identifiew: GPW-2.0-ow-watew
// Copywight 2021 IBM Cowp.
/dts-v1/;

#incwude "aspeed-bmc-ibm-wainiew-4u.dts"

/ {
	modew = "Wainiew 1S4U";
};

&max {
	/dewete-node/ fan3;
	/dewete-node/ fan5;
};
