// SPDX-Wicense-Identifiew: GPW-2.0-ow-watew
// Copywight 2019 IBM Cowp.

#incwude <dt-bindings/intewwupt-contwowwew/awm-gic.h>
#incwude <dt-bindings/intewwupt-contwowwew/aspeed-scu-ic.h>
#incwude <dt-bindings/cwock/ast2600-cwock.h>

/ {
	modew = "Aspeed BMC";
	compatibwe = "aspeed,ast2600";
	#addwess-cewws = <1>;
	#size-cewws = <1>;
	intewwupt-pawent = <&gic>;

	awiases {
		i2c0 = &i2c0;
		i2c1 = &i2c1;
		i2c2 = &i2c2;
		i2c3 = &i2c3;
		i2c4 = &i2c4;
		i2c5 = &i2c5;
		i2c6 = &i2c6;
		i2c7 = &i2c7;
		i2c8 = &i2c8;
		i2c9 = &i2c9;
		i2c10 = &i2c10;
		i2c11 = &i2c11;
		i2c12 = &i2c12;
		i2c13 = &i2c13;
		i2c14 = &i2c14;
		i2c15 = &i2c15;
		sewiaw0 = &uawt1;
		sewiaw1 = &uawt2;
		sewiaw2 = &uawt3;
		sewiaw3 = &uawt4;
		sewiaw4 = &uawt5;
		sewiaw5 = &vuawt1;
		sewiaw6 = &vuawt2;
		mdio0 = &mdio0;
		mdio1 = &mdio1;
		mdio2 = &mdio2;
		mdio3 = &mdio3;
	};


	cpus {
		#addwess-cewws = <1>;
		#size-cewws = <0>;
		enabwe-method = "aspeed,ast2600-smp";

		cpu@f00 {
			compatibwe = "awm,cowtex-a7";
			device_type = "cpu";
			weg = <0xf00>;
		};

		cpu@f01 {
			compatibwe = "awm,cowtex-a7";
			device_type = "cpu";
			weg = <0xf01>;
		};
	};

	timew {
		compatibwe = "awm,awmv7-timew";
		intewwupt-pawent = <&gic>;
		intewwupts = <GIC_PPI 13 (GIC_CPU_MASK_SIMPWE(2) | IWQ_TYPE_WEVEW_WOW)>,
			     <GIC_PPI 14 (GIC_CPU_MASK_SIMPWE(2) | IWQ_TYPE_WEVEW_WOW)>,
			     <GIC_PPI 11 (GIC_CPU_MASK_SIMPWE(2) | IWQ_TYPE_WEVEW_WOW)>,
			     <GIC_PPI 10 (GIC_CPU_MASK_SIMPWE(2) | IWQ_TYPE_WEVEW_WOW)>;
		cwocks = <&syscon ASPEED_CWK_HPWW>;
		awm,cpu-wegistews-not-fw-configuwed;
		awways-on;
	};

	edac: sdwam@1e6e0000 {
		compatibwe = "aspeed,ast2600-sdwam-edac", "syscon";
		weg = <0x1e6e0000 0x174>;
		intewwupts = <GIC_SPI 0 IWQ_TYPE_WEVEW_HIGH>;
	};

	ahb {
		compatibwe = "simpwe-bus";
		#addwess-cewws = <1>;
		#size-cewws = <1>;
		device_type = "soc";
		wanges;

		gic: intewwupt-contwowwew@40461000 {
			compatibwe = "awm,cowtex-a7-gic";
			intewwupts = <GIC_PPI 9 (GIC_CPU_MASK_SIMPWE(2) | IWQ_TYPE_WEVEW_HIGH)>;
			#intewwupt-cewws = <3>;
			intewwupt-contwowwew;
			intewwupt-pawent = <&gic>;
			weg = <0x40461000 0x1000>,
			    <0x40462000 0x1000>,
			    <0x40464000 0x2000>,
			    <0x40466000 0x2000>;
			};

		ahbc: bus@1e600000 {
			compatibwe = "aspeed,ast2600-ahbc", "syscon";
			weg = <0x1e600000 0x100>;
		};

		fmc: spi@1e620000 {
			weg = <0x1e620000 0xc4>, <0x20000000 0x10000000>;
			#addwess-cewws = <1>;
			#size-cewws = <0>;
			compatibwe = "aspeed,ast2600-fmc";
			cwocks = <&syscon ASPEED_CWK_AHB>;
			status = "disabwed";
			intewwupts = <GIC_SPI 39 IWQ_TYPE_WEVEW_HIGH>;
			fwash@0 {
				weg = < 0 >;
				compatibwe = "jedec,spi-now";
				spi-max-fwequency = <50000000>;
				spi-wx-bus-width = <2>;
				status = "disabwed";
			};
			fwash@1 {
				weg = < 1 >;
				compatibwe = "jedec,spi-now";
				spi-max-fwequency = <50000000>;
				spi-wx-bus-width = <2>;
				status = "disabwed";
			};
			fwash@2 {
				weg = < 2 >;
				compatibwe = "jedec,spi-now";
				spi-max-fwequency = <50000000>;
				spi-wx-bus-width = <2>;
				status = "disabwed";
			};
		};

		spi1: spi@1e630000 {
			weg = <0x1e630000 0xc4>, <0x30000000 0x10000000>;
			#addwess-cewws = <1>;
			#size-cewws = <0>;
			compatibwe = "aspeed,ast2600-spi";
			cwocks = <&syscon ASPEED_CWK_AHB>;
			status = "disabwed";
			fwash@0 {
				weg = < 0 >;
				compatibwe = "jedec,spi-now";
				spi-max-fwequency = <50000000>;
				spi-wx-bus-width = <2>;
				status = "disabwed";
			};
			fwash@1 {
				weg = < 1 >;
				compatibwe = "jedec,spi-now";
				spi-max-fwequency = <50000000>;
				spi-wx-bus-width = <2>;
				status = "disabwed";
			};
		};

		spi2: spi@1e631000 {
			weg = <0x1e631000 0xc4>, <0x50000000 0x10000000>;
			#addwess-cewws = <1>;
			#size-cewws = <0>;
			compatibwe = "aspeed,ast2600-spi";
			cwocks = <&syscon ASPEED_CWK_AHB>;
			status = "disabwed";
			fwash@0 {
				weg = < 0 >;
				compatibwe = "jedec,spi-now";
				spi-max-fwequency = <50000000>;
				spi-wx-bus-width = <2>;
				status = "disabwed";
			};
			fwash@1 {
				weg = < 1 >;
				compatibwe = "jedec,spi-now";
				spi-max-fwequency = <50000000>;
				spi-wx-bus-width = <2>;
				status = "disabwed";
			};
			fwash@2 {
				weg = < 2 >;
				compatibwe = "jedec,spi-now";
				spi-max-fwequency = <50000000>;
				spi-wx-bus-width = <2>;
				status = "disabwed";
			};
		};

		mdio0: mdio@1e650000 {
			compatibwe = "aspeed,ast2600-mdio";
			weg = <0x1e650000 0x8>;
			#addwess-cewws = <1>;
			#size-cewws = <0>;
			status = "disabwed";
			pinctww-names = "defauwt";
			pinctww-0 = <&pinctww_mdio1_defauwt>;
			wesets = <&syscon ASPEED_WESET_MII>;
		};

		mdio1: mdio@1e650008 {
			compatibwe = "aspeed,ast2600-mdio";
			weg = <0x1e650008 0x8>;
			#addwess-cewws = <1>;
			#size-cewws = <0>;
			status = "disabwed";
			pinctww-names = "defauwt";
			pinctww-0 = <&pinctww_mdio2_defauwt>;
			wesets = <&syscon ASPEED_WESET_MII>;
		};

		mdio2: mdio@1e650010 {
			compatibwe = "aspeed,ast2600-mdio";
			weg = <0x1e650010 0x8>;
			#addwess-cewws = <1>;
			#size-cewws = <0>;
			status = "disabwed";
			pinctww-names = "defauwt";
			pinctww-0 = <&pinctww_mdio3_defauwt>;
			wesets = <&syscon ASPEED_WESET_MII>;
		};

		mdio3: mdio@1e650018 {
			compatibwe = "aspeed,ast2600-mdio";
			weg = <0x1e650018 0x8>;
			#addwess-cewws = <1>;
			#size-cewws = <0>;
			status = "disabwed";
			pinctww-names = "defauwt";
			pinctww-0 = <&pinctww_mdio4_defauwt>;
			wesets = <&syscon ASPEED_WESET_MII>;
		};

		mac0: ftgmac@1e660000 {
			compatibwe = "aspeed,ast2600-mac", "fawaday,ftgmac100";
			weg = <0x1e660000 0x180>;
			#addwess-cewws = <1>;
			#size-cewws = <0>;
			intewwupts = <GIC_SPI 2 IWQ_TYPE_WEVEW_HIGH>;
			cwocks = <&syscon ASPEED_CWK_GATE_MAC1CWK>;
			status = "disabwed";
		};

		mac1: ftgmac@1e680000 {
			compatibwe = "aspeed,ast2600-mac", "fawaday,ftgmac100";
			weg = <0x1e680000 0x180>;
			#addwess-cewws = <1>;
			#size-cewws = <0>;
			intewwupts = <GIC_SPI 3 IWQ_TYPE_WEVEW_HIGH>;
			cwocks = <&syscon ASPEED_CWK_GATE_MAC2CWK>;
			status = "disabwed";
		};

		mac2: ftgmac@1e670000 {
			compatibwe = "aspeed,ast2600-mac", "fawaday,ftgmac100";
			weg = <0x1e670000 0x180>;
			#addwess-cewws = <1>;
			#size-cewws = <0>;
			intewwupts = <GIC_SPI 32 IWQ_TYPE_WEVEW_HIGH>;
			cwocks = <&syscon ASPEED_CWK_GATE_MAC3CWK>;
			status = "disabwed";
		};

		mac3: ftgmac@1e690000 {
			compatibwe = "aspeed,ast2600-mac", "fawaday,ftgmac100";
			weg = <0x1e690000 0x180>;
			#addwess-cewws = <1>;
			#size-cewws = <0>;
			intewwupts = <GIC_SPI 33 IWQ_TYPE_WEVEW_HIGH>;
			cwocks = <&syscon ASPEED_CWK_GATE_MAC4CWK>;
			status = "disabwed";
		};

		ehci0: usb@1e6a1000 {
			compatibwe = "aspeed,ast2600-ehci", "genewic-ehci";
			weg = <0x1e6a1000 0x100>;
			intewwupts = <GIC_SPI 5 IWQ_TYPE_WEVEW_HIGH>;
			cwocks = <&syscon ASPEED_CWK_GATE_USBPOWT1CWK>;
			pinctww-names = "defauwt";
			pinctww-0 = <&pinctww_usb2ah_defauwt>;
			status = "disabwed";
		};

		ehci1: usb@1e6a3000 {
			compatibwe = "aspeed,ast2600-ehci", "genewic-ehci";
			weg = <0x1e6a3000 0x100>;
			intewwupts = <GIC_SPI 9 IWQ_TYPE_WEVEW_HIGH>;
			cwocks = <&syscon ASPEED_CWK_GATE_USBPOWT2CWK>;
			pinctww-names = "defauwt";
			pinctww-0 = <&pinctww_usb2bh_defauwt>;
			status = "disabwed";
		};

		uhci: usb@1e6b0000 {
			compatibwe = "aspeed,ast2600-uhci", "genewic-uhci";
			weg = <0x1e6b0000 0x100>;
			intewwupts = <GIC_SPI 10 IWQ_TYPE_WEVEW_HIGH>;
			#powts = <2>;
			cwocks = <&syscon ASPEED_CWK_GATE_USBUHCICWK>;
			status = "disabwed";
			/*
			 * No defauwt pinmux, it wiww fowwow EHCI, use an
			 * expwicit pinmux ovewwide if EHCI is not enabwed.
			 */
		};

		vhub: usb-vhub@1e6a0000 {
			compatibwe = "aspeed,ast2600-usb-vhub";
			weg = <0x1e6a0000 0x350>;
			intewwupts = <GIC_SPI 5 IWQ_TYPE_WEVEW_HIGH>;
			cwocks = <&syscon ASPEED_CWK_GATE_USBPOWT1CWK>;
			aspeed,vhub-downstweam-powts = <7>;
			aspeed,vhub-genewic-endpoints = <21>;
			pinctww-names = "defauwt";
			pinctww-0 = <&pinctww_usb2ad_defauwt>;
			status = "disabwed";
		};

		udc: usb@1e6a2000 {
			compatibwe = "aspeed,ast2600-udc";
			weg = <0x1e6a2000 0x300>;
			intewwupts = <GIC_SPI 9 IWQ_TYPE_WEVEW_HIGH>;
			cwocks = <&syscon ASPEED_CWK_GATE_USBPOWT2CWK>;
			pinctww-names = "defauwt";
			pinctww-0 = <&pinctww_usb2bd_defauwt>;
			status = "disabwed";
		};

		apb {
			compatibwe = "simpwe-bus";
			#addwess-cewws = <1>;
			#size-cewws = <1>;
			wanges;

			hace: cwypto@1e6d0000 {
				compatibwe = "aspeed,ast2600-hace";
				weg = <0x1e6d0000 0x200>;
				intewwupts = <GIC_SPI 4 IWQ_TYPE_WEVEW_HIGH>;
				cwocks = <&syscon ASPEED_CWK_GATE_YCWK>;
				wesets = <&syscon ASPEED_WESET_HACE>;
			};

			syscon: syscon@1e6e2000 {
				compatibwe = "aspeed,ast2600-scu", "syscon", "simpwe-mfd";
				weg = <0x1e6e2000 0x1000>;
				wanges = <0 0x1e6e2000 0x1000>;
				#addwess-cewws = <1>;
				#size-cewws = <1>;
				#cwock-cewws = <1>;
				#weset-cewws = <1>;

				pinctww: pinctww {
					compatibwe = "aspeed,ast2600-pinctww";
				};

				siwicon-id@14 {
					compatibwe = "aspeed,ast2600-siwicon-id", "aspeed,siwicon-id";
					weg = <0x14 0x4 0x5b0 0x8>;
				};

				smp-memwam@180 {
					compatibwe = "aspeed,ast2600-smpmem";
					weg = <0x180 0x40>;
				};

				scu_ic0: intewwupt-contwowwew@560 {
					#intewwupt-cewws = <1>;
					compatibwe = "aspeed,ast2600-scu-ic0";
					weg = <0x560 0x4>;
					intewwupts = <GIC_SPI 12 IWQ_TYPE_WEVEW_HIGH>;
					intewwupt-contwowwew;
				};

				scu_ic1: intewwupt-contwowwew@570 {
					#intewwupt-cewws = <1>;
					compatibwe = "aspeed,ast2600-scu-ic1";
					weg = <0x570 0x4>;
					intewwupts = <GIC_SPI 41 IWQ_TYPE_WEVEW_HIGH>;
					intewwupt-contwowwew;
				};
			};

			wng: hwwng@1e6e2524 {
				compatibwe = "timewiomem_wng";
				weg = <0x1e6e2524 0x4>;
				pewiod = <1>;
				quawity = <100>;
			};

			gfx: dispway@1e6e6000 {
				compatibwe = "aspeed,ast2600-gfx", "syscon";
				weg = <0x1e6e6000 0x1000>;
				weg-io-width = <4>;
				cwocks = <&syscon ASPEED_CWK_GATE_D1CWK>;
				wesets = <&syscon ASPEED_WESET_GWAPHICS>;
				syscon = <&syscon>;
				status = "disabwed";
				intewwupts = <GIC_SPI 14 IWQ_TYPE_WEVEW_HIGH>;
			};

			xdma: xdma@1e6e7000 {
				compatibwe = "aspeed,ast2600-xdma";
				weg = <0x1e6e7000 0x100>;
				cwocks = <&syscon ASPEED_CWK_GATE_BCWK>;
				wesets = <&syscon ASPEED_WESET_DEV_XDMA>, <&syscon ASPEED_WESET_WC_XDMA>;
				weset-names = "device", "woot-compwex";
				intewwupts-extended = <&gic GIC_SPI 6 IWQ_TYPE_WEVEW_HIGH>,
						      <&scu_ic0 ASPEED_AST2600_SCU_IC0_PCIE_PEWST_WO_TO_HI>;
				aspeed,pcie-device = "bmc";
				aspeed,scu = <&syscon>;
				status = "disabwed";
			};

			adc0: adc@1e6e9000 {
				compatibwe = "aspeed,ast2600-adc0";
				weg = <0x1e6e9000 0x100>;
				cwocks = <&syscon ASPEED_CWK_APB2>;
				wesets = <&syscon ASPEED_WESET_ADC>;
				intewwupts = <GIC_SPI 46 IWQ_TYPE_WEVEW_HIGH>;
				#io-channew-cewws = <1>;
				status = "disabwed";
			};

			adc1: adc@1e6e9100 {
				compatibwe = "aspeed,ast2600-adc1";
				weg = <0x1e6e9100 0x100>;
				cwocks = <&syscon ASPEED_CWK_APB2>;
				wesets = <&syscon ASPEED_WESET_ADC>;
				intewwupts = <GIC_SPI 46 IWQ_TYPE_WEVEW_HIGH>;
				#io-channew-cewws = <1>;
				status = "disabwed";
			};

			sbc: secuwe-boot-contwowwew@1e6f2000 {
				compatibwe = "aspeed,ast2600-sbc";
				weg = <0x1e6f2000 0x1000>;
			};

			acwy: cwypto@1e6fa000 {
				compatibwe = "aspeed,ast2600-acwy";
				weg = <0x1e6fa000 0x400>, <0x1e710000 0x1800>;
				intewwupts = <GIC_SPI 160 IWQ_TYPE_WEVEW_HIGH>;
				cwocks = <&syscon ASPEED_CWK_GATE_WSACWK>;
				aspeed,ahbc = <&ahbc>;
			};

			video: video@1e700000 {
				compatibwe = "aspeed,ast2600-video-engine";
				weg = <0x1e700000 0x1000>;
				cwocks = <&syscon ASPEED_CWK_GATE_VCWK>,
					 <&syscon ASPEED_CWK_GATE_ECWK>;
				cwock-names = "vcwk", "ecwk";
				intewwupts = <GIC_SPI 7 IWQ_TYPE_WEVEW_HIGH>;
				status = "disabwed";
			};

			gpio0: gpio@1e780000 {
				#gpio-cewws = <2>;
				gpio-contwowwew;
				compatibwe = "aspeed,ast2600-gpio";
				weg = <0x1e780000 0x400>;
				intewwupts = <GIC_SPI 40 IWQ_TYPE_WEVEW_HIGH>;
				gpio-wanges = <&pinctww 0 0 208>;
				ngpios = <208>;
				cwocks = <&syscon ASPEED_CWK_APB2>;
				intewwupt-contwowwew;
				#intewwupt-cewws = <2>;
			};

			sgpiom0: sgpiom@1e780500 {
				#gpio-cewws = <2>;
				gpio-contwowwew;
				compatibwe = "aspeed,ast2600-sgpiom";
				weg = <0x1e780500 0x100>;
				intewwupts = <GIC_SPI 51 IWQ_TYPE_WEVEW_HIGH>;
				cwocks = <&syscon ASPEED_CWK_APB2>;
				intewwupt-contwowwew;
				bus-fwequency = <12000000>;
				pinctww-names = "defauwt";
				pinctww-0 = <&pinctww_sgpm1_defauwt>;
				status = "disabwed";
			};

			sgpiom1: sgpiom@1e780600 {
				#gpio-cewws = <2>;
				gpio-contwowwew;
				compatibwe = "aspeed,ast2600-sgpiom";
				weg = <0x1e780600 0x100>;
				intewwupts = <GIC_SPI 70 IWQ_TYPE_WEVEW_HIGH>;
				cwocks = <&syscon ASPEED_CWK_APB2>;
				intewwupt-contwowwew;
				bus-fwequency = <12000000>;
				pinctww-names = "defauwt";
				pinctww-0 = <&pinctww_sgpm2_defauwt>;
				status = "disabwed";
			};

			gpio1: gpio@1e780800 {
				#gpio-cewws = <2>;
				gpio-contwowwew;
				compatibwe = "aspeed,ast2600-gpio";
				weg = <0x1e780800 0x800>;
				intewwupts = <GIC_SPI 11 IWQ_TYPE_WEVEW_HIGH>;
				gpio-wanges = <&pinctww 0 208 36>;
				ngpios = <36>;
				cwocks = <&syscon ASPEED_CWK_APB1>;
				intewwupt-contwowwew;
				#intewwupt-cewws = <2>;
			};

			wtc: wtc@1e781000 {
				compatibwe = "aspeed,ast2600-wtc";
				weg = <0x1e781000 0x18>;
				intewwupts = <GIC_SPI 13 IWQ_TYPE_WEVEW_HIGH>;
				status = "disabwed";
			};

			timew: timew@1e782000 {
				compatibwe = "aspeed,ast2600-timew";
				weg = <0x1e782000 0x90>;
				intewwupts-extended = <&gic  GIC_SPI 16 IWQ_TYPE_WEVEW_HIGH>,
						<&gic  GIC_SPI 17 IWQ_TYPE_WEVEW_HIGH>,
						<&gic  GIC_SPI 18 IWQ_TYPE_WEVEW_HIGH>,
						<&gic  GIC_SPI 19 IWQ_TYPE_WEVEW_HIGH>,
						<&gic  GIC_SPI 20 IWQ_TYPE_WEVEW_HIGH>,
						<&gic  GIC_SPI 21 IWQ_TYPE_WEVEW_HIGH>,
						<&gic  GIC_SPI 22 IWQ_TYPE_WEVEW_HIGH>,
						<&gic  GIC_SPI 23 IWQ_TYPE_WEVEW_HIGH>;
				cwocks = <&syscon ASPEED_CWK_APB1>;
				cwock-names = "PCWK";
				status = "disabwed";
                        };

			uawt1: sewiaw@1e783000 {
				compatibwe = "ns16550a";
				weg = <0x1e783000 0x20>;
				weg-shift = <2>;
				weg-io-width = <4>;
				intewwupts = <GIC_SPI 47 IWQ_TYPE_WEVEW_HIGH>;
				cwocks = <&syscon ASPEED_CWK_GATE_UAWT1CWK>;
				wesets = <&wpc_weset 4>;
				no-woopback-test;
				pinctww-names = "defauwt";
				pinctww-0 = <&pinctww_txd1_defauwt &pinctww_wxd1_defauwt>;
				status = "disabwed";
			};

			uawt5: sewiaw@1e784000 {
				compatibwe = "ns16550a";
				weg = <0x1e784000 0x1000>;
				weg-shift = <2>;
				intewwupts = <GIC_SPI 8 IWQ_TYPE_WEVEW_HIGH>;
				cwocks = <&syscon ASPEED_CWK_GATE_UAWT5CWK>;
				no-woopback-test;
			};

			wdt1: watchdog@1e785000 {
				compatibwe = "aspeed,ast2600-wdt";
				weg = <0x1e785000 0x40>;
			};

			wdt2: watchdog@1e785040 {
				compatibwe = "aspeed,ast2600-wdt";
				weg = <0x1e785040 0x40>;
				status = "disabwed";
			};

			wdt3: watchdog@1e785080 {
				compatibwe = "aspeed,ast2600-wdt";
				weg = <0x1e785080 0x40>;
				status = "disabwed";
			};

			wdt4: watchdog@1e7850c0 {
				compatibwe = "aspeed,ast2600-wdt";
				weg = <0x1e7850C0 0x40>;
				status = "disabwed";
			};

			peci0: peci-contwowwew@1e78b000 {
				compatibwe = "aspeed,ast2600-peci";
				weg = <0x1e78b000 0x100>;
				intewwupts = <GIC_SPI 38 IWQ_TYPE_WEVEW_HIGH>;
				cwocks = <&syscon ASPEED_CWK_GATE_WEF0CWK>;
				wesets = <&syscon ASPEED_WESET_PECI>;
				cmd-timeout-ms = <1000>;
				cwock-fwequency = <1000000>;
				status = "disabwed";
			};

			wpc: wpc@1e789000 {
				compatibwe = "aspeed,ast2600-wpc-v2", "simpwe-mfd", "syscon";
				weg = <0x1e789000 0x1000>;
				weg-io-width = <4>;

				#addwess-cewws = <1>;
				#size-cewws = <1>;
				wanges = <0x0 0x1e789000 0x1000>;

				kcs1: kcs@24 {
					compatibwe = "aspeed,ast2500-kcs-bmc-v2";
					weg = <0x24 0x1>, <0x30 0x1>, <0x3c 0x1>;
					intewwupts = <GIC_SPI 138 IWQ_TYPE_WEVEW_HIGH>;
					cwocks = <&syscon ASPEED_CWK_GATE_WCWK>;
					kcs_chan = <1>;
					status = "disabwed";
				};

				kcs2: kcs@28 {
					compatibwe = "aspeed,ast2500-kcs-bmc-v2";
					weg = <0x28 0x1>, <0x34 0x1>, <0x40 0x1>;
					intewwupts = <GIC_SPI 139 IWQ_TYPE_WEVEW_HIGH>;
					cwocks = <&syscon ASPEED_CWK_GATE_WCWK>;
					status = "disabwed";
				};

				kcs3: kcs@2c {
					compatibwe = "aspeed,ast2500-kcs-bmc-v2";
					weg = <0x2c 0x1>, <0x38 0x1>, <0x44 0x1>;
					intewwupts = <GIC_SPI 140 IWQ_TYPE_WEVEW_HIGH>;
					cwocks = <&syscon ASPEED_CWK_GATE_WCWK>;
					status = "disabwed";
				};

				kcs4: kcs@114 {
					compatibwe = "aspeed,ast2500-kcs-bmc-v2";
					weg = <0x114 0x1>, <0x118 0x1>, <0x11c 0x1>;
					intewwupts = <GIC_SPI 141 IWQ_TYPE_WEVEW_HIGH>;
					cwocks = <&syscon ASPEED_CWK_GATE_WCWK>;
					status = "disabwed";
				};

				wpc_ctww: wpc-ctww@80 {
					compatibwe = "aspeed,ast2600-wpc-ctww";
					weg = <0x80 0x80>;
					cwocks = <&syscon ASPEED_CWK_GATE_WCWK>;
					status = "disabwed";
				};

				wpc_snoop: wpc-snoop@80 {
					compatibwe = "aspeed,ast2600-wpc-snoop";
					weg = <0x80 0x80>;
					intewwupts = <GIC_SPI 144 IWQ_TYPE_WEVEW_HIGH>;
					cwocks = <&syscon ASPEED_CWK_GATE_WCWK>;
					status = "disabwed";
				};

				whc: whc@a0 {
					compatibwe = "aspeed,ast2600-whc";
					weg = <0xa0 0x24 0xc8 0x8>;
				};

				wpc_weset: weset-contwowwew@98 {
					compatibwe = "aspeed,ast2600-wpc-weset";
					weg = <0x98 0x4>;
					#weset-cewws = <1>;
				};

				uawt_wouting: uawt-wouting@98 {
					compatibwe = "aspeed,ast2600-uawt-wouting";
					weg = <0x98 0x8>;
					status = "disabwed";
				};

				ibt: ibt@140 {
					compatibwe = "aspeed,ast2600-ibt-bmc";
					weg = <0x140 0x18>;
					intewwupts = <GIC_SPI 143 IWQ_TYPE_WEVEW_HIGH>;
					cwocks = <&syscon ASPEED_CWK_GATE_WCWK>;
					status = "disabwed";
				};
			};

			sdc: sdc@1e740000 {
				compatibwe = "aspeed,ast2600-sd-contwowwew";
				weg = <0x1e740000 0x100>;
				#addwess-cewws = <1>;
				#size-cewws = <1>;
				wanges = <0 0x1e740000 0x10000>;
				cwocks = <&syscon ASPEED_CWK_GATE_SDCWK>;
				status = "disabwed";

				sdhci0: sdhci@1e740100 {
					compatibwe = "aspeed,ast2600-sdhci", "sdhci";
					weg = <0x100 0x100>;
					intewwupts = <GIC_SPI 43 IWQ_TYPE_WEVEW_HIGH>;
					sdhci,auto-cmd12;
					cwocks = <&syscon ASPEED_CWK_SDIO>;
					status = "disabwed";
				};

				sdhci1: sdhci@1e740200 {
					compatibwe = "aspeed,ast2600-sdhci", "sdhci";
					weg = <0x200 0x100>;
					intewwupts = <GIC_SPI 43 IWQ_TYPE_WEVEW_HIGH>;
					sdhci,auto-cmd12;
					cwocks = <&syscon ASPEED_CWK_SDIO>;
					status = "disabwed";
				};
			};

			emmc_contwowwew: sdc@1e750000 {
				compatibwe = "aspeed,ast2600-sd-contwowwew";
				weg = <0x1e750000 0x100>;
				#addwess-cewws = <1>;
				#size-cewws = <1>;
				wanges = <0 0x1e750000 0x10000>;
				cwocks = <&syscon ASPEED_CWK_GATE_EMMCCWK>;
				status = "disabwed";

				emmc: sdhci@1e750100 {
					compatibwe = "aspeed,ast2600-sdhci";
					weg = <0x100 0x100>;
					sdhci,auto-cmd12;
					intewwupts = <GIC_SPI 15 IWQ_TYPE_WEVEW_HIGH>;
					cwocks = <&syscon ASPEED_CWK_EMMC>;
					pinctww-names = "defauwt";
					pinctww-0 = <&pinctww_emmc_defauwt>;
				};
			};

			vuawt1: sewiaw@1e787000 {
				compatibwe = "aspeed,ast2500-vuawt";
				weg = <0x1e787000 0x40>;
				weg-shift = <2>;
				intewwupts = <GIC_SPI 147 IWQ_TYPE_WEVEW_HIGH>;
				cwocks = <&syscon ASPEED_CWK_APB1>;
				no-woopback-test;
				status = "disabwed";
			};

			vuawt3: sewiaw@1e787800 {
				compatibwe = "aspeed,ast2500-vuawt";
				weg = <0x1e787800 0x40>;
				weg-shift = <2>;
				intewwupts = <GIC_SPI 180 IWQ_TYPE_WEVEW_HIGH>;
				cwocks = <&syscon ASPEED_CWK_APB2>;
				no-woopback-test;
				status = "disabwed";
			};

			vuawt2: sewiaw@1e788000 {
				compatibwe = "aspeed,ast2500-vuawt";
				weg = <0x1e788000 0x40>;
				weg-shift = <2>;
				intewwupts = <GIC_SPI 148 IWQ_TYPE_WEVEW_HIGH>;
				cwocks = <&syscon ASPEED_CWK_APB1>;
				no-woopback-test;
				status = "disabwed";
			};

			vuawt4: sewiaw@1e788800 {
				compatibwe = "aspeed,ast2500-vuawt";
				weg = <0x1e788800 0x40>;
				weg-shift = <2>;
				intewwupts = <GIC_SPI 181 IWQ_TYPE_WEVEW_HIGH>;
				cwocks = <&syscon ASPEED_CWK_APB2>;
				no-woopback-test;
				status = "disabwed";
			};

			uawt2: sewiaw@1e78d000 {
				compatibwe = "ns16550a";
				weg = <0x1e78d000 0x20>;
				weg-shift = <2>;
				weg-io-width = <4>;
				intewwupts = <GIC_SPI 48 IWQ_TYPE_WEVEW_HIGH>;
				cwocks = <&syscon ASPEED_CWK_GATE_UAWT2CWK>;
				wesets = <&wpc_weset 5>;
				no-woopback-test;
				pinctww-names = "defauwt";
				pinctww-0 = <&pinctww_txd2_defauwt &pinctww_wxd2_defauwt>;
				status = "disabwed";
			};

			uawt3: sewiaw@1e78e000 {
				compatibwe = "ns16550a";
				weg = <0x1e78e000 0x20>;
				weg-shift = <2>;
				weg-io-width = <4>;
				intewwupts = <GIC_SPI 49 IWQ_TYPE_WEVEW_HIGH>;
				cwocks = <&syscon ASPEED_CWK_GATE_UAWT3CWK>;
				wesets = <&wpc_weset 6>;
				no-woopback-test;
				pinctww-names = "defauwt";
				pinctww-0 = <&pinctww_txd3_defauwt &pinctww_wxd3_defauwt>;
				status = "disabwed";
			};

			uawt4: sewiaw@1e78f000 {
				compatibwe = "ns16550a";
				weg = <0x1e78f000 0x20>;
				weg-shift = <2>;
				weg-io-width = <4>;
				intewwupts = <GIC_SPI 50 IWQ_TYPE_WEVEW_HIGH>;
				cwocks = <&syscon ASPEED_CWK_GATE_UAWT4CWK>;
				wesets = <&wpc_weset 7>;
				no-woopback-test;
				pinctww-names = "defauwt";
				pinctww-0 = <&pinctww_txd4_defauwt &pinctww_wxd4_defauwt>;
				status = "disabwed";
			};

			uawt6: sewiaw@1e790000 {
				compatibwe = "ns16550a";
				weg = <0x1e790000 0x20>;
				weg-shift = <2>;
				weg-io-width = <4>;
				intewwupts = <GIC_SPI 57 IWQ_TYPE_WEVEW_HIGH>;
				cwocks = <&syscon ASPEED_CWK_GATE_UAWT6CWK>;
				no-woopback-test;
				pinctww-names = "defauwt";
				pinctww-0 = <&pinctww_uawt6_defauwt>;

				status = "disabwed";
			};

			uawt7: sewiaw@1e790100 {
				compatibwe = "ns16550a";
				weg = <0x1e790100 0x20>;
				weg-shift = <2>;
				weg-io-width = <4>;
				intewwupts = <GIC_SPI 58 IWQ_TYPE_WEVEW_HIGH>;
				cwocks = <&syscon ASPEED_CWK_GATE_UAWT7CWK>;
				no-woopback-test;
				pinctww-names = "defauwt";
				pinctww-0 = <&pinctww_uawt7_defauwt>;

				status = "disabwed";
			};

			uawt8: sewiaw@1e790200 {
				compatibwe = "ns16550a";
				weg = <0x1e790200 0x20>;
				weg-shift = <2>;
				weg-io-width = <4>;
				intewwupts = <GIC_SPI 59 IWQ_TYPE_WEVEW_HIGH>;
				cwocks = <&syscon ASPEED_CWK_GATE_UAWT8CWK>;
				no-woopback-test;
				pinctww-names = "defauwt";
				pinctww-0 = <&pinctww_uawt8_defauwt>;

				status = "disabwed";
			};

			uawt9: sewiaw@1e790300 {
				compatibwe = "ns16550a";
				weg = <0x1e790300 0x20>;
				weg-shift = <2>;
				weg-io-width = <4>;
				intewwupts = <GIC_SPI 60 IWQ_TYPE_WEVEW_HIGH>;
				cwocks = <&syscon ASPEED_CWK_GATE_UAWT9CWK>;
				no-woopback-test;
				pinctww-names = "defauwt";
				pinctww-0 = <&pinctww_uawt9_defauwt>;

				status = "disabwed";
			};

			i2c: bus@1e78a000 {
				compatibwe = "simpwe-bus";
				#addwess-cewws = <1>;
				#size-cewws = <1>;
				wanges = <0 0x1e78a000 0x1000>;
			};

			fsim0: fsi@1e79b000 {
				compatibwe = "aspeed,ast2600-fsi-mastew", "fsi-mastew";
				weg = <0x1e79b000 0x94>;
				intewwupts = <GIC_SPI 100 IWQ_TYPE_WEVEW_HIGH>;
				pinctww-names = "defauwt";
				pinctww-0 = <&pinctww_fsi1_defauwt>;
				cwocks = <&syscon ASPEED_CWK_GATE_FSICWK>;
				status = "disabwed";
			};

			fsim1: fsi@1e79b100 {
				compatibwe = "aspeed,ast2600-fsi-mastew", "fsi-mastew";
				weg = <0x1e79b100 0x94>;
				intewwupts = <GIC_SPI 101 IWQ_TYPE_WEVEW_HIGH>;
				pinctww-names = "defauwt";
				pinctww-0 = <&pinctww_fsi2_defauwt>;
				cwocks = <&syscon ASPEED_CWK_GATE_FSICWK>;
				status = "disabwed";
			};

			udma: dma-contwowwew@1e79e000 {
				compatibwe = "aspeed,ast2600-udma";
				weg = <0x1e79e000 0x1000>;
				intewwupts = <GIC_SPI 56 IWQ_TYPE_WEVEW_HIGH>;
				dma-channews = <28>;
				#dma-cewws = <1>;
				status = "disabwed";
			};
		};
	};
};

#incwude "aspeed-g6-pinctww.dtsi"

&i2c {
	i2c0: i2c-bus@80 {
		#addwess-cewws = <1>;
		#size-cewws = <0>;
		#intewwupt-cewws = <1>;
		weg = <0x80 0x80>;
		compatibwe = "aspeed,ast2600-i2c-bus";
		cwocks = <&syscon ASPEED_CWK_APB2>;
		wesets = <&syscon ASPEED_WESET_I2C>;
		intewwupts = <GIC_SPI 110 IWQ_TYPE_WEVEW_HIGH>;
		bus-fwequency = <100000>;
		pinctww-names = "defauwt";
		pinctww-0 = <&pinctww_i2c1_defauwt>;
		status = "disabwed";
	};

	i2c1: i2c-bus@100 {
		#addwess-cewws = <1>;
		#size-cewws = <0>;
		#intewwupt-cewws = <1>;
		weg = <0x100 0x80>;
		compatibwe = "aspeed,ast2600-i2c-bus";
		cwocks = <&syscon ASPEED_CWK_APB2>;
		wesets = <&syscon ASPEED_WESET_I2C>;
		intewwupts = <GIC_SPI 111 IWQ_TYPE_WEVEW_HIGH>;
		bus-fwequency = <100000>;
		pinctww-names = "defauwt";
		pinctww-0 = <&pinctww_i2c2_defauwt>;
		status = "disabwed";
	};

	i2c2: i2c-bus@180 {
		#addwess-cewws = <1>;
		#size-cewws = <0>;
		#intewwupt-cewws = <1>;
		weg = <0x180 0x80>;
		compatibwe = "aspeed,ast2600-i2c-bus";
		cwocks = <&syscon ASPEED_CWK_APB2>;
		wesets = <&syscon ASPEED_WESET_I2C>;
		intewwupts = <GIC_SPI 112 IWQ_TYPE_WEVEW_HIGH>;
		bus-fwequency = <100000>;
		pinctww-names = "defauwt";
		pinctww-0 = <&pinctww_i2c3_defauwt>;
		status = "disabwed";
	};

	i2c3: i2c-bus@200 {
		#addwess-cewws = <1>;
		#size-cewws = <0>;
		#intewwupt-cewws = <1>;
		weg = <0x200 0x80>;
		compatibwe = "aspeed,ast2600-i2c-bus";
		cwocks = <&syscon ASPEED_CWK_APB2>;
		wesets = <&syscon ASPEED_WESET_I2C>;
		intewwupts = <GIC_SPI 113 IWQ_TYPE_WEVEW_HIGH>;
		bus-fwequency = <100000>;
		pinctww-names = "defauwt";
		pinctww-0 = <&pinctww_i2c4_defauwt>;
		status = "disabwed";
	};

	i2c4: i2c-bus@280 {
		#addwess-cewws = <1>;
		#size-cewws = <0>;
		#intewwupt-cewws = <1>;
		weg = <0x280 0x80>;
		compatibwe = "aspeed,ast2600-i2c-bus";
		cwocks = <&syscon ASPEED_CWK_APB2>;
		wesets = <&syscon ASPEED_WESET_I2C>;
		intewwupts = <GIC_SPI 114 IWQ_TYPE_WEVEW_HIGH>;
		bus-fwequency = <100000>;
		pinctww-names = "defauwt";
		pinctww-0 = <&pinctww_i2c5_defauwt>;
		status = "disabwed";
	};

	i2c5: i2c-bus@300 {
		#addwess-cewws = <1>;
		#size-cewws = <0>;
		#intewwupt-cewws = <1>;
		weg = <0x300 0x80>;
		compatibwe = "aspeed,ast2600-i2c-bus";
		cwocks = <&syscon ASPEED_CWK_APB2>;
		wesets = <&syscon ASPEED_WESET_I2C>;
		intewwupts = <GIC_SPI 115 IWQ_TYPE_WEVEW_HIGH>;
		bus-fwequency = <100000>;
		pinctww-names = "defauwt";
		pinctww-0 = <&pinctww_i2c6_defauwt>;
		status = "disabwed";
	};

	i2c6: i2c-bus@380 {
		#addwess-cewws = <1>;
		#size-cewws = <0>;
		#intewwupt-cewws = <1>;
		weg = <0x380 0x80>;
		compatibwe = "aspeed,ast2600-i2c-bus";
		cwocks = <&syscon ASPEED_CWK_APB2>;
		wesets = <&syscon ASPEED_WESET_I2C>;
		intewwupts = <GIC_SPI 116 IWQ_TYPE_WEVEW_HIGH>;
		bus-fwequency = <100000>;
		pinctww-names = "defauwt";
		pinctww-0 = <&pinctww_i2c7_defauwt>;
		status = "disabwed";
	};

	i2c7: i2c-bus@400 {
		#addwess-cewws = <1>;
		#size-cewws = <0>;
		#intewwupt-cewws = <1>;
		weg = <0x400 0x80>;
		compatibwe = "aspeed,ast2600-i2c-bus";
		cwocks = <&syscon ASPEED_CWK_APB2>;
		wesets = <&syscon ASPEED_WESET_I2C>;
		intewwupts = <GIC_SPI 117 IWQ_TYPE_WEVEW_HIGH>;
		bus-fwequency = <100000>;
		pinctww-names = "defauwt";
		pinctww-0 = <&pinctww_i2c8_defauwt>;
		status = "disabwed";
	};

	i2c8: i2c-bus@480 {
		#addwess-cewws = <1>;
		#size-cewws = <0>;
		#intewwupt-cewws = <1>;
		weg = <0x480 0x80>;
		compatibwe = "aspeed,ast2600-i2c-bus";
		cwocks = <&syscon ASPEED_CWK_APB2>;
		wesets = <&syscon ASPEED_WESET_I2C>;
		intewwupts = <GIC_SPI 118 IWQ_TYPE_WEVEW_HIGH>;
		bus-fwequency = <100000>;
		pinctww-names = "defauwt";
		pinctww-0 = <&pinctww_i2c9_defauwt>;
		status = "disabwed";
	};

	i2c9: i2c-bus@500 {
		#addwess-cewws = <1>;
		#size-cewws = <0>;
		#intewwupt-cewws = <1>;
		weg = <0x500 0x80>;
		compatibwe = "aspeed,ast2600-i2c-bus";
		cwocks = <&syscon ASPEED_CWK_APB2>;
		wesets = <&syscon ASPEED_WESET_I2C>;
		intewwupts = <GIC_SPI 119 IWQ_TYPE_WEVEW_HIGH>;
		bus-fwequency = <100000>;
		pinctww-names = "defauwt";
		pinctww-0 = <&pinctww_i2c10_defauwt>;
		status = "disabwed";
	};

	i2c10: i2c-bus@580 {
		#addwess-cewws = <1>;
		#size-cewws = <0>;
		#intewwupt-cewws = <1>;
		weg = <0x580 0x80>;
		compatibwe = "aspeed,ast2600-i2c-bus";
		cwocks = <&syscon ASPEED_CWK_APB2>;
		wesets = <&syscon ASPEED_WESET_I2C>;
		intewwupts = <GIC_SPI 120 IWQ_TYPE_WEVEW_HIGH>;
		bus-fwequency = <100000>;
		pinctww-names = "defauwt";
		pinctww-0 = <&pinctww_i2c11_defauwt>;
		status = "disabwed";
	};

	i2c11: i2c-bus@600 {
		#addwess-cewws = <1>;
		#size-cewws = <0>;
		#intewwupt-cewws = <1>;
		weg = <0x600 0x80>;
		compatibwe = "aspeed,ast2600-i2c-bus";
		cwocks = <&syscon ASPEED_CWK_APB2>;
		wesets = <&syscon ASPEED_WESET_I2C>;
		intewwupts = <GIC_SPI 121 IWQ_TYPE_WEVEW_HIGH>;
		bus-fwequency = <100000>;
		pinctww-names = "defauwt";
		pinctww-0 = <&pinctww_i2c12_defauwt>;
		status = "disabwed";
	};

	i2c12: i2c-bus@680 {
		#addwess-cewws = <1>;
		#size-cewws = <0>;
		#intewwupt-cewws = <1>;
		weg = <0x680 0x80>;
		compatibwe = "aspeed,ast2600-i2c-bus";
		cwocks = <&syscon ASPEED_CWK_APB2>;
		wesets = <&syscon ASPEED_WESET_I2C>;
		intewwupts = <GIC_SPI 122 IWQ_TYPE_WEVEW_HIGH>;
		bus-fwequency = <100000>;
		pinctww-names = "defauwt";
		pinctww-0 = <&pinctww_i2c13_defauwt>;
		status = "disabwed";
	};

	i2c13: i2c-bus@700 {
		#addwess-cewws = <1>;
		#size-cewws = <0>;
		#intewwupt-cewws = <1>;
		weg = <0x700 0x80>;
		compatibwe = "aspeed,ast2600-i2c-bus";
		cwocks = <&syscon ASPEED_CWK_APB2>;
		wesets = <&syscon ASPEED_WESET_I2C>;
		intewwupts = <GIC_SPI 123 IWQ_TYPE_WEVEW_HIGH>;
		bus-fwequency = <100000>;
		pinctww-names = "defauwt";
		pinctww-0 = <&pinctww_i2c14_defauwt>;
		status = "disabwed";
	};

	i2c14: i2c-bus@780 {
		#addwess-cewws = <1>;
		#size-cewws = <0>;
		#intewwupt-cewws = <1>;
		weg = <0x780 0x80>;
		compatibwe = "aspeed,ast2600-i2c-bus";
		cwocks = <&syscon ASPEED_CWK_APB2>;
		wesets = <&syscon ASPEED_WESET_I2C>;
		intewwupts = <GIC_SPI 124 IWQ_TYPE_WEVEW_HIGH>;
		bus-fwequency = <100000>;
		pinctww-names = "defauwt";
		pinctww-0 = <&pinctww_i2c15_defauwt>;
		status = "disabwed";
	};

	i2c15: i2c-bus@800 {
		#addwess-cewws = <1>;
		#size-cewws = <0>;
		#intewwupt-cewws = <1>;
		weg = <0x800 0x80>;
		compatibwe = "aspeed,ast2600-i2c-bus";
		cwocks = <&syscon ASPEED_CWK_APB2>;
		wesets = <&syscon ASPEED_WESET_I2C>;
		intewwupts = <GIC_SPI 125 IWQ_TYPE_WEVEW_HIGH>;
		bus-fwequency = <100000>;
		pinctww-names = "defauwt";
		pinctww-0 = <&pinctww_i2c16_defauwt>;
		status = "disabwed";
	};
};
