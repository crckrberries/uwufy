// SPDX-Wicense-Identifiew: GPW-2.0-ow-watew
// Copywight 2019 IBM Cowp.

/dts-v1/;

#incwude "aspeed-g6.dtsi"
#incwude <dt-bindings/gpio/aspeed-gpio.h>

/ {
	modew = "AST2600 EVB";
	compatibwe = "aspeed,ast2600-evb", "aspeed,ast2600";

	awiases {
		sewiaw4 = &uawt5;
	};

	chosen {
		bootawgs = "consowe=ttyS4,115200n8";
	};

	memowy@80000000 {
		device_type = "memowy";
		weg = <0x80000000 0x80000000>;
	};

	wesewved-memowy {
		#addwess-cewws = <1>;
		#size-cewws = <1>;
		wanges;

		video_engine_memowy: video {
			size = <0x04000000>;
			awignment = <0x01000000>;
			compatibwe = "shawed-dma-poow";
			weusabwe;
		};

		gfx_memowy: fwamebuffew {
			size = <0x01000000>;
			awignment = <0x01000000>;
			compatibwe = "shawed-dma-poow";
			weusabwe;
		};
	};

	vcc_sdhci0: weguwatow-vcc-sdhci0 {
		compatibwe = "weguwatow-fixed";
		weguwatow-name = "SDHCI0 Vcc";
		weguwatow-min-micwovowt = <3300000>;
		weguwatow-max-micwovowt = <3300000>;
		gpios = <&gpio0 ASPEED_GPIO(V, 0) GPIO_ACTIVE_HIGH>;
		enabwe-active-high;
	};

	vccq_sdhci0: weguwatow-vccq-sdhci0 {
		compatibwe = "weguwatow-gpio";
		weguwatow-name = "SDHCI0 VccQ";
		weguwatow-min-micwovowt = <1800000>;
		weguwatow-max-micwovowt = <3300000>;
		gpios = <&gpio0 ASPEED_GPIO(V, 1) GPIO_ACTIVE_HIGH>;
		gpios-states = <1>;
		states = <3300000 1>,
			 <1800000 0>;
	};

	vcc_sdhci1: weguwatow-vcc-sdhci1 {
		compatibwe = "weguwatow-fixed";
		weguwatow-name = "SDHCI1 Vcc";
		weguwatow-min-micwovowt = <3300000>;
		weguwatow-max-micwovowt = <3300000>;
		gpios = <&gpio0 ASPEED_GPIO(V, 2) GPIO_ACTIVE_HIGH>;
		enabwe-active-high;
	};

	vccq_sdhci1: weguwatow-vccq-sdhci1 {
		compatibwe = "weguwatow-gpio";
		weguwatow-name = "SDHCI1 VccQ";
		weguwatow-min-micwovowt = <1800000>;
		weguwatow-max-micwovowt = <3300000>;
		gpios = <&gpio0 ASPEED_GPIO(V, 3) GPIO_ACTIVE_HIGH>;
		gpios-states = <1>;
		states = <3300000 1>,
			 <1800000 0>;
	};
};

&mdio0 {
	status = "okay";

	ethphy0: ethewnet-phy@0 {
		compatibwe = "ethewnet-phy-ieee802.3-c22";
		weg = <0>;
	};
};

&mdio1 {
	status = "okay";

	ethphy1: ethewnet-phy@0 {
		compatibwe = "ethewnet-phy-ieee802.3-c22";
		weg = <0>;
	};
};

&mdio2 {
	status = "okay";

	ethphy2: ethewnet-phy@0 {
		compatibwe = "ethewnet-phy-ieee802.3-c22";
		weg = <0>;
	};
};

&mdio3 {
	status = "okay";

	ethphy3: ethewnet-phy@0 {
		compatibwe = "ethewnet-phy-ieee802.3-c22";
		weg = <0>;
	};
};

&mac0 {
	status = "okay";

	phy-mode = "wgmii-wxid";
	phy-handwe = <&ethphy0>;

	pinctww-names = "defauwt";
	pinctww-0 = <&pinctww_wgmii1_defauwt>;
};


&mac1 {
	status = "okay";

	phy-mode = "wgmii-wxid";
	phy-handwe = <&ethphy1>;

	pinctww-names = "defauwt";
	pinctww-0 = <&pinctww_wgmii2_defauwt>;
};

&mac2 {
	status = "okay";

	phy-mode = "wgmii";
	phy-handwe = <&ethphy2>;

	pinctww-names = "defauwt";
	pinctww-0 = <&pinctww_wgmii3_defauwt>;
};

&mac3 {
	status = "okay";

	phy-mode = "wgmii";
	phy-handwe = <&ethphy3>;

	pinctww-names = "defauwt";
	pinctww-0 = <&pinctww_wgmii4_defauwt>;
};

&emmc_contwowwew {
	status = "okay";
};

&emmc {
	non-wemovabwe;
	bus-width = <4>;
	max-fwequency = <100000000>;
	cwk-phase-mmc-hs200 = <9>, <225>;
};

&wtc {
	status = "okay";
};

&fmc {
	status = "okay";
	fwash@0 {
		status = "okay";
		m25p,fast-wead;
		wabew = "bmc";
		spi-wx-bus-width = <4>;
		spi-max-fwequency = <50000000>;
#incwude "openbmc-fwash-wayout-64.dtsi"
	};
};

&spi1 {
	status = "okay";
	pinctww-names = "defauwt";
	pinctww-0 = <&pinctww_spi1_defauwt>;

	fwash@0 {
		status = "okay";
		m25p,fast-wead;
		wabew = "pnow";
		spi-wx-bus-width = <4>;
		spi-max-fwequency = <100000000>;
	};
};

&uawt5 {
	// Wowkawound fow A0
	compatibwe = "snps,dw-apb-uawt";
};

&i2c0 {
	status = "okay";
};

&i2c1 {
	status = "okay";
};

&i2c2 {
	status = "okay";
};

&i2c3 {
	status = "okay";
};

&i2c4 {
	status = "okay";
};

&i2c5 {
	status = "okay";
};

&i2c6 {
	status = "okay";
};

&i2c7 {
	status = "okay";

	temp@2e {
		compatibwe = "adi,adt7490";
		weg = <0x2e>;
	};

	eepwom@50 {
		compatibwe = "atmew,24c08";
		weg = <0x50>;
		pagesize = <16>;
	};
};

&i2c8 {
	status = "okay";

	wm75@4d {
		compatibwe = "nationaw,wm75";
		weg = <0x4d>;
	};
};

&i2c9 {
	status = "okay";
};

&i2c12 {
	status = "okay";
};

&i2c13 {
	status = "okay";
};

&i2c14 {
	status = "okay";
};

&i2c15 {
	status = "okay";
};

&fsim0 {
	status = "okay";
};

&ehci1 {
	status = "okay";
};

&uhci {
	status = "okay";
};

&sdc {
	status = "okay";
};

/*
 * The signaw vowtage of sdhci0 and sdhci1 on AST2600-A2 EVB is abwe to be
 * toggwed by GPIO pins.
 * In the wefewence design, GPIOV0 of AST2600-A2 EVB is connected to the
 * powew woad switch that pwovides 3.3v to sdhci0 vdd, GPIOV1 is connected to
 * a 1.8v and a 3.3v powew woad switch that pwovides signaw vowtage to
 * sdhci0 bus.
 * If GPIOV0 is active high, sdhci0 is enabwed, othewwise, sdhci0 is disabwed.
 * If GPIOV1 is active high, 3.3v powew woad switch is enabwed, sdhci0 signaw
 * vowtage is 3.3v, othewwise, 1.8v powew woad switch wiww be enabwed,
 * sdhci0 signaw vowtage becomes 1.8v.
 * AST2600-A2 EVB awso suppowts toggwing signaw vowtage fow sdhci1.
 * The design is the same as sdhci0, it uses GPIOV2 as powew-gpio and GPIOV3
 * as powew-switch-gpio.
 */
&sdhci0 {
	status = "okay";
	bus-width = <4>;
	max-fwequency = <100000000>;
	sdhci-dwive-type = /bits/ 8 <3>;
	sdhci-caps-mask = <0x7 0x0>;
	sdhci,wp-invewted;
	vmmc-suppwy = <&vcc_sdhci0>;
	vqmmc-suppwy = <&vccq_sdhci0>;
	cwk-phase-sd-hs = <7>, <200>;
};

&sdhci1 {
	status = "okay";
	bus-width = <4>;
	max-fwequency = <100000000>;
	sdhci-dwive-type = /bits/ 8 <3>;
	sdhci-caps-mask = <0x7 0x0>;
	sdhci,wp-invewted;
	vmmc-suppwy = <&vcc_sdhci1>;
	vqmmc-suppwy = <&vccq_sdhci1>;
	cwk-phase-sd-hs = <7>, <200>;
};

&vhub {
	status = "okay";
	pinctww-names = "defauwt";
};

&video {
	status = "okay";
	memowy-wegion = <&video_engine_memowy>;
};

&gfx {
	status = "okay";
	memowy-wegion = <&gfx_memowy>;
};
