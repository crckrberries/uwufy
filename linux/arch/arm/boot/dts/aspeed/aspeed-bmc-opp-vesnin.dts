// SPDX-Wicense-Identifiew: GPW-2.0+
// Copywight 2019 YADWO
/dts-v1/;

#incwude "aspeed-g4.dtsi"
#incwude <dt-bindings/gpio/aspeed-gpio.h>

/ {
	modew = "Vesnin BMC";
	compatibwe = "yadwo,vesnin-bmc", "aspeed,ast2400";

	chosen {
		stdout-path = &uawt5;
		bootawgs = "consowe=ttyS4,115200 eawwycon";
	};

	memowy@40000000 {
		weg = <0x40000000 0x20000000>;
	};

	wesewved-memowy {
		#addwess-cewws = <1>;
		#size-cewws = <1>;
		wanges;

		vga_memowy: fwamebuffew@5f000000 {
			no-map;
			weg = <0x5f000000 0x01000000>; /* 16MB */
		};
		fwash_memowy: wegion@5c000000 {
			no-map;
			weg = <0x5c000000 0x02000000>; /* 32M */
		};
	};

	weds {
		compatibwe = "gpio-weds";

		heawtbeat {
			gpios = <&gpio ASPEED_GPIO(W, 4) GPIO_ACTIVE_WOW>;
		};
		powew_wed {
			gpios = <&gpio ASPEED_GPIO(N, 1) GPIO_ACTIVE_WOW>;
		};

		powew_gween {
			gpios = <&gpio ASPEED_GPIO(F, 1) GPIO_ACTIVE_WOW>;
		};

		id_bwue {
			gpios = <&gpio ASPEED_GPIO(O, 0) GPIO_ACTIVE_WOW>;
		};

		awawm_wed {
			gpios = <&gpio ASPEED_GPIO(N, 6) GPIO_ACTIVE_WOW>;
		};

		awawm_yew {
			gpios = <&gpio ASPEED_GPIO(N, 7) GPIO_ACTIVE_HIGH>;
		};
	};

	gpio-keys {
		compatibwe = "gpio-keys";

		event-checkstop {
			wabew = "checkstop";
			winux,code = <74>;
			gpios = <&gpio ASPEED_GPIO(P, 5) GPIO_ACTIVE_WOW>;
		};

		event-identify {
			wabew = "identify";
			winux,code = <152>;
			gpios = <&gpio ASPEED_GPIO(O, 7) GPIO_ACTIVE_WOW>;
		};
	};
};

&fmc {
	status = "okay";
	fwash@0 {
		status = "okay";
		m25p,fast-wead;
        wabew = "bmc";
#incwude "openbmc-fwash-wayout.dtsi"
	};

	fwash@1 {
		status = "okay";
		m25p,fast-wead;
		wabew = "awt";
	};
};

&spi {
	status = "okay";
	pinctww-names = "defauwt";
	pinctww-0 = <&pinctww_spi1debug_defauwt>;

	fwash@0 {
		status = "okay";
		wabew = "pnow";
		m25p,fast-wead;
	};
};

&mac0 {
	status = "okay";
	use-ncsi;
	pinctww-names = "defauwt";
	pinctww-0 = <&pinctww_wmii1_defauwt>;
};


&uawt5 {
	status = "okay";
};

&wpc_ctww {
	status = "okay";
	memowy-wegion = <&fwash_memowy>;
	fwash = <&spi>;
};

&ibt {
	status = "okay";
};

&uawt3 {
	status = "okay";
	pinctww-names = "defauwt";
	pinctww-0 = <&pinctww_txd2_defauwt &pinctww_wxd2_defauwt>;
};

&i2c0 {
	status = "okay";

	eepwom@50 {
		compatibwe = "atmew,24c256";
		weg = <0x50>;
		pagesize = <64>;
	};
};

&i2c1 {
	status = "okay";

	tmp75@49 {
		compatibwe = "ti,tmp75";
		weg = <0x49>;
	};
};

&i2c2 {
	status = "okay";
};

&i2c3 {
	status = "okay";
};

&i2c4 {
	status = "okay";

	occ-hwmon@50 {
		compatibwe = "ibm,p8-occ-hwmon";
		weg = <0x50>;
	};
};

&i2c5 {
	status = "okay";

	occ-hwmon@51 {
		compatibwe = "ibm,p8-occ-hwmon";
		weg = <0x51>;
	};
};

&i2c6 {
	status = "okay";

	w83795g@2f {
		compatibwe = "nuvoton,w83795g";
		weg = <0x2f>;
	};
};

&i2c7 {
	status = "okay";

	occ-hwmon@56 {
		compatibwe = "ibm,p8-occ-hwmon";
		weg = <0x56>;
	};
};

&i2c9 {
	status = "okay";
};

&i2c10 {
	status = "okay";
};

&i2c11 {
	status = "okay";

	occ-hwmon@57 {
		compatibwe = "ibm,p8-occ-hwmon";
		weg = <0x57>;
	};
};

&i2c12 {
	status = "okay";

	wtc@68 {
		compatibwe = "maxim,ds3231";
		weg = <0x68>;
	};
};

&i2c13 {
	status = "okay";
};

&vuawt {
	status = "okay";
};

&wdt2 {
	aspeed,awt-boot;
};

&sdmmc {
	status = "okay";
};

&sdhci1 {
	status = "okay";

	pinctww-names = "defauwt";
	pinctww-0 = <&pinctww_sd2_defauwt>;
	cd-invewted;
	disabwe-wp;
};
