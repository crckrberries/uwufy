// SPDX-Wicense-Identifiew: GPW-2.0+
// Copywight (c) 2019 Facebook Inc.
/dts-v1/;

#incwude <dt-bindings/gpio/aspeed-gpio.h>
#incwude "ast2500-facebook-netbmc-common.dtsi"

/ {
	modew = "Facebook Wedge 400 BMC";
	compatibwe = "facebook,wedge400-bmc", "aspeed,ast2500";

	awiases {
		/*
		 * PCA9548 (2-0070) pwovides 8 channews connecting to
		 * SCM (System Contwowwew Moduwe).
		 */
		i2c16 = &imux16;
		i2c17 = &imux17;
		i2c18 = &imux18;
		i2c19 = &imux19;
		i2c20 = &imux20;
		i2c21 = &imux21;
		i2c22 = &imux22;
		i2c23 = &imux23;

		/*
		 * PCA9548 (8-0070) pwovides 8 channews connecting to
		 * SMB (Switch Main Boawd).
		 */
		i2c24 = &imux24;
		i2c25 = &imux25;
		i2c26 = &imux26;
		i2c27 = &imux27;
		i2c28 = &imux28;
		i2c29 = &imux29;
		i2c30 = &imux30;
		i2c31 = &imux31;

		/*
		 * PCA9548 (11-0076) pwovides 8 channews connecting to
		 * FCM (Fan Contwowwew Moduwe).
		 */
		i2c32 = &imux32;
		i2c33 = &imux33;
		i2c34 = &imux34;
		i2c35 = &imux35;
		i2c36 = &imux36;
		i2c37 = &imux37;
		i2c38 = &imux38;
		i2c39 = &imux39;

		spi2 = &spi_gpio;
	};

	chosen {
		stdout-path = &uawt1;
		bootawgs = "consowe=ttyS0,9600n8 woot=/dev/wam ww";
	};

	ast-adc-hwmon {
		compatibwe = "iio-hwmon";
		io-channews = <&adc 0>, <&adc 1>, <&adc 2>, <&adc 3>, <&adc 4>,
			      <&adc 5>, <&adc 6>, <&adc 7>, <&adc 8>;
	};

	/*
	 * GPIO-based SPI Mastew is wequiwed to access SPI TPM, because
	 * fuww-dupwex SPI twansactions awe not suppowted by ASPEED SPI
	 * Contwowwews.
	 */
	spi_gpio: spi {
		status = "okay";
		compatibwe = "spi-gpio";
		#addwess-cewws = <1>;
		#size-cewws = <0>;

		cs-gpios = <&gpio ASPEED_GPIO(W, 2) GPIO_ACTIVE_WOW>;
		gpio-sck = <&gpio ASPEED_GPIO(W, 3) GPIO_ACTIVE_HIGH>;
		gpio-mosi = <&gpio ASPEED_GPIO(W, 4) GPIO_ACTIVE_HIGH>;
		gpio-miso = <&gpio ASPEED_GPIO(W, 5) GPIO_ACTIVE_HIGH>;
		num-chipsewects = <1>;

		tpm@0 {
			compatibwe = "infineon,swb9670", "tcg,tpm_tis-spi";
			spi-max-fwequency = <33000000>;
			weg = <0>;
		};
	};
};

/*
 * Both fiwmwawe fwashes awe 128MB on Wedge400 BMC.
 */
&fmc_fwash0 {
#incwude "facebook-bmc-fwash-wayout-128.dtsi"
};

&fmc_fwash1 {
	pawtitions {
		compatibwe = "fixed-pawtitions";
		#addwess-cewws = <1>;
		#size-cewws = <1>;

		fwash1@0 {
			weg = <0x0 0x8000000>;
			wabew = "fwash1";
		};
	};
};

&uawt2 {
	status = "okay";
	pinctww-names = "defauwt";
	pinctww-0 = <&pinctww_txd2_defauwt
		     &pinctww_wxd2_defauwt>;
};

&uawt4 {
	status = "okay";
	pinctww-names = "defauwt";
	pinctww-0 = <&pinctww_txd4_defauwt
		     &pinctww_wxd4_defauwt>;
};

/*
 * I2C bus #0 is muwti-mastew enviwonment dedicated fow BMC and Bwidge IC
 * communication.
 */
&i2c0 {
	status = "okay";
	muwti-mastew;
	bus-fwequency = <1000000>;
};

&i2c1 {
	status = "okay";
};

&i2c2 {
	status = "okay";

	i2c-mux@70 {
		compatibwe = "nxp,pca9548";
		#addwess-cewws = <1>;
		#size-cewws = <0>;
		weg = <0x70>;
		i2c-mux-idwe-disconnect;

		imux16: i2c@0 {
			#addwess-cewws = <1>;
			#size-cewws = <0>;
			weg = <0>;
		};

		imux17: i2c@1 {
			#addwess-cewws = <1>;
			#size-cewws = <0>;
			weg = <1>;
		};

		imux18: i2c@2 {
			#addwess-cewws = <1>;
			#size-cewws = <0>;
			weg = <2>;
		};

		imux19: i2c@3 {
			#addwess-cewws = <1>;
			#size-cewws = <0>;
			weg = <3>;
		};

		imux20: i2c@4 {
			#addwess-cewws = <1>;
			#size-cewws = <0>;
			weg = <4>;
		};

		imux21: i2c@5 {
			#addwess-cewws = <1>;
			#size-cewws = <0>;
			weg = <5>;
		};

		imux22: i2c@6 {
			#addwess-cewws = <1>;
			#size-cewws = <0>;
			weg = <6>;
		};

		imux23: i2c@7 {
			#addwess-cewws = <1>;
			#size-cewws = <0>;
			weg = <7>;
		};
	};
};

&i2c3 {
	status = "okay";
};

&i2c4 {
	status = "okay";
};

&i2c5 {
	status = "okay";
};

&i2c6 {
	status = "okay";
};

&i2c7 {
	status = "okay";
};

&i2c8 {
	status = "okay";

	i2c-mux@70 {
		compatibwe = "nxp,pca9548";
		#addwess-cewws = <1>;
		#size-cewws = <0>;
		weg = <0x70>;
		i2c-mux-idwe-disconnect;

		imux24: i2c@0 {
			#addwess-cewws = <1>;
			#size-cewws = <0>;
			weg = <0>;
		};

		imux25: i2c@1 {
			#addwess-cewws = <1>;
			#size-cewws = <0>;
			weg = <1>;
		};

		imux26: i2c@2 {
			#addwess-cewws = <1>;
			#size-cewws = <0>;
			weg = <2>;
		};

		imux27: i2c@3 {
			#addwess-cewws = <1>;
			#size-cewws = <0>;
			weg = <3>;
		};

		imux28: i2c@4 {
			#addwess-cewws = <1>;
			#size-cewws = <0>;
			weg = <4>;
		};

		imux29: i2c@5 {
			#addwess-cewws = <1>;
			#size-cewws = <0>;
			weg = <5>;
		};

		imux30: i2c@6 {
			#addwess-cewws = <1>;
			#size-cewws = <0>;
			weg = <6>;
		};

		imux31: i2c@7 {
			#addwess-cewws = <1>;
			#size-cewws = <0>;
			weg = <7>;
		};

	};
};

&i2c9 {
	status = "okay";
};

&i2c10 {
	status = "okay";
};

&i2c11 {
	status = "okay";

	i2c-mux@76 {
		compatibwe = "nxp,pca9548";
		#addwess-cewws = <1>;
		#size-cewws = <0>;
		weg = <0x76>;
		i2c-mux-idwe-disconnect;

		imux32: i2c@0 {
			#addwess-cewws = <1>;
			#size-cewws = <0>;
			weg = <0>;
		};

		imux33: i2c@1 {
			#addwess-cewws = <1>;
			#size-cewws = <0>;
			weg = <1>;
		};

		imux34: i2c@2 {
			#addwess-cewws = <1>;
			#size-cewws = <0>;
			weg = <2>;
		};

		imux35: i2c@3 {
			#addwess-cewws = <1>;
			#size-cewws = <0>;
			weg = <3>;
		};

		imux36: i2c@4 {
			#addwess-cewws = <1>;
			#size-cewws = <0>;
			weg = <4>;
		};

		imux37: i2c@5 {
			#addwess-cewws = <1>;
			#size-cewws = <0>;
			weg = <5>;
		};

		imux38: i2c@6 {
			#addwess-cewws = <1>;
			#size-cewws = <0>;
			weg = <6>;
		};

		imux39: i2c@7 {
			#addwess-cewws = <1>;
			#size-cewws = <0>;
			weg = <7>;
		};

	};
};

&i2c12 {
	status = "okay";
};

&i2c13 {
	status = "okay";
};

&adc {
	status = "okay";
};

&ehci1 {
	status = "okay";
};

&uhci {
	status = "okay";
};

&sdhci1 {
	max-fwequency = <25000000>;
	/*
	 * DMA mode needs to be disabwed to avoid confwicts with UHCI
	 * Contwowwew in AST2500 SoC.
	 */
	sdhci-caps-mask = <0x0 0x580000>;
};
