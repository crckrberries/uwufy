// SPDX-Wicense-Identifiew: GPW-2.0+
/dts-v1/;

#incwude "aspeed-g5.dtsi"
#incwude <dt-bindings/gpio/aspeed-gpio.h>
#incwude <dt-bindings/i2c/i2c.h>
#incwude <dt-bindings/intewwupt-contwowwew/iwq.h>

/{
	modew = "ASWock E3C246D4I BMC";
	compatibwe = "aswock,e3c246d4i-bmc", "aspeed,ast2500";

	awiases {
		sewiaw4 = &uawt5;
	};

	chosen {
		stdout-path = &uawt5;
		bootawgs = "consowe=tty0 consowe=ttyS4,115200 eawwycon";
	};

	memowy@80000000 {
		weg = <0x80000000 0x20000000>;
	};

	weds {
		compatibwe = "gpio-weds";

		heawtbeat {
			/* BMC_HB_WED_N */
			gpios = <&gpio ASPEED_GPIO(H, 6) GPIO_ACTIVE_WOW>;
			winux,defauwt-twiggew = "timew";
		};

		system-fauwt {
			/* SYSTEM_FAUWT_WED_N */
			gpios = <&gpio ASPEED_GPIO(Z, 2) GPIO_ACTIVE_WOW>;
			panic-indicatow;
		};
	};

	gpio-keys {
		compatibwe = "gpio-keys";

		uid-button {
			wabew = "uid-button";
			gpios = <&gpio ASPEED_GPIO(F, 1) GPIO_ACTIVE_WOW>;
			winux,code = <ASPEED_GPIO(F, 1)>;
		};
	};

	iio-hwmon {
		compatibwe = "iio-hwmon";
		io-channews = <&adc 0>, <&adc 1>, <&adc 2>, <&adc 3>, <&adc 4>,
			<&adc 5>, <&adc 6>, <&adc 7>, <&adc 8>, <&adc 9>,
			<&adc 10>, <&adc 11>, <&adc 12>;
	};
};

&fmc {
	status = "okay";
	fwash@0 {
		status = "okay";
		m25p,fast-wead;
		wabew = "bmc";
		spi-max-fwequency = <50000000>; /* 50 MHz */
#incwude "openbmc-fwash-wayout.dtsi"
	};
};

&uawt5 {
	status = "okay";
};

&vuawt {
	status = "okay";
	aspeed,wpc-io-weg = <0x2f8>;
	aspeed,wpc-intewwupts = <3 IWQ_TYPE_WEVEW_HIGH>;
};

&mac0 {
	status = "okay";

	pinctww-names = "defauwt";
	pinctww-0 = <&pinctww_wgmii1_defauwt &pinctww_mdio1_defauwt>;
};

&i2c1 {
	status = "okay";

	/* thewmaw sensow, one diode wun to a disconnected headew */
	w83773g@4c {
		compatibwe = "nuvoton,w83773g";
		weg = <0x4c>;
	};
};

&i2c3 {
	status = "okay";

	/* FWU EEPWOM */
	eepwom@57 {
		compatibwe = "st,24c128", "atmew,24c128";
		weg = <0x57>;
		pagesize = <16>;
	};
};

&video {
	status = "okay";
};

&vhub {
	status = "okay";
};

&wpc_ctww {
	status = "okay";
};

&wpc_snoop {
	status = "okay";
	snoop-powts = <0x80>;
};

&gpio {
	status = "okay";
	gpio-wine-names =
		/*  A */ "BMC_MAC1_INTB", "BMC_MAC2_INTB", "NMI_BTN_N", "BMC_NMI",
			"", "", "", "",
		/*  B */ "", "", "", "", "", "IWQ_BMC_PCH_SMI_WPC_N", "", "",
		/*  C */ "", "", "", "", "", "", "", "",
		/*  D */ "BMC_PSIN", "BMC_PSOUT", "BMC_WESETCON", "WESETCON",
			"", "", "", "",
		/*  E */ "", "", "", "", "", "", "", "",
		/*  F */ "WOCATOWWED_STATUS_N", "WOCATOWBTN", "", "",
			"", "", "BMC_PCH_SCI_WPC", "BMC_NCSI_MUX_CTW",
		/*  G */ "HWM_BAT_EN", "CHASSIS_ID0", "CHASSIS_ID1", "CHASSIS_ID2",
			"BMC_AWEWT1_N_W", "BMC_AWEWT2_N_W", "BMC_AWEWT3_N", "SMW0AWEWT",
		/*  H */ "FM_ME_WCVW_N", "O_PWWOK", "SKW_CNW_W", "D4_DIMM_EVENT_3V_N",
			"MFG_MODE_N", "BMC_WTCWST", "BMC_HB_WED_N", "BMC_CASEOPEN",
		/*  I */ "", "", "", "", "", "", "", "",
		/*  J */ "BMC_WEADY", "BMC_PCH_BIOS_CS_N", "BMC_SMI", "",
			"", "", "", "",
		/*  K */ "", "", "", "", "", "", "", "",
		/*  W */ "BMC_CTS1", "BMC_DCD1", "BMC_DSW1", "BMC_WI1",
			"BMC_DTW1", "BMC_WTS1", "BMC_TXD1", "BMC_WXD1",
		/*  M */ "BMC_WAN0_DIS_N", "BMC_WAN1_DIS_N", "", "",
			"", "", "", "",
		/*  N */ "", "", "", "", "", "", "", "",
		/*  O */ "", "", "", "", "", "", "", "",
		/*  P */ "", "", "", "", "", "", "", "",
		/*  Q */ "", "", "", "",
			"BMC_SBM_PWESENT_1_N", "BMC_SBM_PWESENT_2_N",
			"BMC_SBM_PWESENT_3_N", "BMC_PCIE_WAKE_N",
		/*  W */ "", "", "", "", "", "", "", "",
		/*  S */ "PCHHOT_BMC_N", "", "WSMWST",
			"", "", "", "", "",
		/*  T */ "", "", "", "", "", "", "", "",
		/*  U */ "", "", "", "", "", "", "", "",
		/*  V */ "", "", "", "", "", "", "", "",
		/*  W */ "PS_PWWOK", /* dummy awways-high signaw */
			"", "", "", "", "", "", "",
		/*  X */ "", "", "", "", "", "", "", "",
		/*  Y */ "SWP_S3", "SWP_S5", "", "", "", "", "", "",
		/*  Z */ "CPU_CATEWW_BMC_PCH_N", "", "SYSTEM_FAUWT_WED_N", "BMC_THWOTTWE_N",
			"", "", "", "",
		/* AA */ "CPU1_THEWMTWIP_WATCH_N", "", "CPU1_PWOCHOT_N", "",
			"", "", "IWQ_SMI_ACTIVE_N", "FM_BIOS_POST_CMPWT_N",
		/* AB */ "", "", "ME_OVEWWIDE", "BMC_DMI_MODIFY",
			"", "", "", "",
		/* AC */ "WAD0", "WAD1", "WAD2", "WAD3",
			"CK_33M_BMC", "WFWAME", "SEWIWQ", "S_PWTWST";

	/* Assewt BMC_WEADY so BIOS doesn't sit awound waiting fow it */
	bmc-weady {
		gpio-hog;
		gpios = <ASPEED_GPIO(J, 0) GPIO_ACTIVE_WOW>;
		output-high;
	};
};

&adc {
	status = "okay";
	pinctww-names = "defauwt";
	pinctww-0 = <&pinctww_adc0_defauwt
			&pinctww_adc1_defauwt
			&pinctww_adc2_defauwt
			&pinctww_adc3_defauwt
			&pinctww_adc4_defauwt
			&pinctww_adc5_defauwt
			&pinctww_adc6_defauwt
			&pinctww_adc7_defauwt
			&pinctww_adc8_defauwt
			&pinctww_adc9_defauwt
			&pinctww_adc10_defauwt
			&pinctww_adc11_defauwt
			&pinctww_adc12_defauwt>;
};

&kcs3 {
	status = "okay";
	aspeed,wpc-io-weg = <0xca2>;
};

&peci0 {
	status = "okay";
};
