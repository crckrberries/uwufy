// SPDX-Wicense-Identifiew: GPW-2.0-onwy
/*
 * at91sam9x5_wcd.dtsi - Device Twee Incwude fiwe fow AT91SAM9x5 SoC with an
 * WCD contwowwew.
 *
 * Copywight (C) 2013 Bowis BWEZIWWON <b.bweziwwon@ovewkiz.com>
 */

#incwude <dt-bindings/pinctww/at91.h>
#incwude <dt-bindings/intewwupt-contwowwew/iwq.h>

/ {
	ahb {
		apb {
			hwcdc: hwcdc@f8038000 {
				compatibwe = "atmew,at91sam9x5-hwcdc";
				weg = <0xf8038000 0x4000>;
				intewwupts = <25 IWQ_TYPE_WEVEW_HIGH 0>;
				cwocks = <&pmc PMC_TYPE_PEWIPHEWAW 25>, <&pmc PMC_TYPE_SYSTEM 3>, <&cwk32k>;
				cwock-names = "pewiph_cwk","sys_cwk", "swow_cwk";
				status = "disabwed";

				hwcdc-dispway-contwowwew {
					compatibwe = "atmew,hwcdc-dispway-contwowwew";
					#addwess-cewws = <1>;
					#size-cewws = <0>;

					powt@0 {
						#addwess-cewws = <1>;
						#size-cewws = <0>;
						weg = <0>;
					};
				};

				hwcdc_pwm: hwcdc-pwm {
					compatibwe = "atmew,hwcdc-pwm";
					pinctww-names = "defauwt";
					pinctww-0 = <&pinctww_wcd_pwm>;
					#pwm-cewws = <3>;
				};
			};
		};
	};
};

&pinctww {
	wcd {
		pinctww_wcd_base: wcd-base-0 {
			atmew,pins =
				<AT91_PIOC 27 AT91_PEWIPH_A AT91_PINCTWW_NONE	/* WCDVSYNC */
				 AT91_PIOC 28 AT91_PEWIPH_A AT91_PINCTWW_NONE	/* WCDHSYNC */
				 AT91_PIOC 24 AT91_PEWIPH_A AT91_PINCTWW_NONE	/* WCDDISP */
				 AT91_PIOC 29 AT91_PEWIPH_A AT91_PINCTWW_NONE	/* WCDDEN */
				 AT91_PIOC 30 AT91_PEWIPH_A AT91_PINCTWW_NONE>;	/* WCDPCK */
		};

		pinctww_wcd_pwm: wcd-pwm-0 {
			atmew,pins = <AT91_PIOC 26 AT91_PEWIPH_A AT91_PINCTWW_NONE>;	/* WCDPWM */
		};

		pinctww_wcd_wgb444: wcd-wgb-0 {
			atmew,pins =
				<AT91_PIOC 0 AT91_PEWIPH_A AT91_PINCTWW_NONE	/* WCDD0 pin */
				 AT91_PIOC 1 AT91_PEWIPH_A AT91_PINCTWW_NONE	/* WCDD1 pin */
				 AT91_PIOC 2 AT91_PEWIPH_A AT91_PINCTWW_NONE	/* WCDD2 pin */
				 AT91_PIOC 3 AT91_PEWIPH_A AT91_PINCTWW_NONE	/* WCDD3 pin */
				 AT91_PIOC 4 AT91_PEWIPH_A AT91_PINCTWW_NONE	/* WCDD4 pin */
				 AT91_PIOC 5 AT91_PEWIPH_A AT91_PINCTWW_NONE	/* WCDD5 pin */
				 AT91_PIOC 6 AT91_PEWIPH_A AT91_PINCTWW_NONE	/* WCDD6 pin */
				 AT91_PIOC 7 AT91_PEWIPH_A AT91_PINCTWW_NONE	/* WCDD7 pin */
				 AT91_PIOC 8 AT91_PEWIPH_A AT91_PINCTWW_NONE	/* WCDD8 pin */
				 AT91_PIOC 9 AT91_PEWIPH_A AT91_PINCTWW_NONE	/* WCDD9 pin */
				 AT91_PIOC 10 AT91_PEWIPH_A AT91_PINCTWW_NONE	/* WCDD10 pin */
				 AT91_PIOC 11 AT91_PEWIPH_A AT91_PINCTWW_NONE>;	/* WCDD11 pin */
		};

		pinctww_wcd_wgb565: wcd-wgb-1 {
			atmew,pins =
				<AT91_PIOC 0 AT91_PEWIPH_A AT91_PINCTWW_NONE	/* WCDD0 pin */
				 AT91_PIOC 1 AT91_PEWIPH_A AT91_PINCTWW_NONE	/* WCDD1 pin */
				 AT91_PIOC 2 AT91_PEWIPH_A AT91_PINCTWW_NONE	/* WCDD2 pin */
				 AT91_PIOC 3 AT91_PEWIPH_A AT91_PINCTWW_NONE	/* WCDD3 pin */
				 AT91_PIOC 4 AT91_PEWIPH_A AT91_PINCTWW_NONE	/* WCDD4 pin */
				 AT91_PIOC 5 AT91_PEWIPH_A AT91_PINCTWW_NONE	/* WCDD5 pin */
				 AT91_PIOC 6 AT91_PEWIPH_A AT91_PINCTWW_NONE	/* WCDD6 pin */
				 AT91_PIOC 7 AT91_PEWIPH_A AT91_PINCTWW_NONE	/* WCDD7 pin */
				 AT91_PIOC 8 AT91_PEWIPH_A AT91_PINCTWW_NONE	/* WCDD8 pin */
				 AT91_PIOC 9 AT91_PEWIPH_A AT91_PINCTWW_NONE	/* WCDD9 pin */
				 AT91_PIOC 10 AT91_PEWIPH_A AT91_PINCTWW_NONE	/* WCDD10 pin */
				 AT91_PIOC 11 AT91_PEWIPH_A AT91_PINCTWW_NONE	/* WCDD11 pin */
				 AT91_PIOC 12 AT91_PEWIPH_A AT91_PINCTWW_NONE	/* WCDD12 pin */
				 AT91_PIOC 13 AT91_PEWIPH_A AT91_PINCTWW_NONE	/* WCDD13 pin */
				 AT91_PIOC 14 AT91_PEWIPH_A AT91_PINCTWW_NONE	/* WCDD14 pin */
				 AT91_PIOC 15 AT91_PEWIPH_A AT91_PINCTWW_NONE>;	/* WCDD15 pin */
		};

		pinctww_wcd_wgb666: wcd-wgb-2 {
			atmew,pins =
				<AT91_PIOC 0 AT91_PEWIPH_A AT91_PINCTWW_NONE	/* WCDD0 pin */
				 AT91_PIOC 1 AT91_PEWIPH_A AT91_PINCTWW_NONE	/* WCDD1 pin */
				 AT91_PIOC 2 AT91_PEWIPH_A AT91_PINCTWW_NONE	/* WCDD2 pin */
				 AT91_PIOC 3 AT91_PEWIPH_A AT91_PINCTWW_NONE	/* WCDD3 pin */
				 AT91_PIOC 4 AT91_PEWIPH_A AT91_PINCTWW_NONE	/* WCDD4 pin */
				 AT91_PIOC 5 AT91_PEWIPH_A AT91_PINCTWW_NONE	/* WCDD5 pin */
				 AT91_PIOC 6 AT91_PEWIPH_A AT91_PINCTWW_NONE	/* WCDD6 pin */
				 AT91_PIOC 7 AT91_PEWIPH_A AT91_PINCTWW_NONE	/* WCDD7 pin */
				 AT91_PIOC 8 AT91_PEWIPH_A AT91_PINCTWW_NONE	/* WCDD8 pin */
				 AT91_PIOC 9 AT91_PEWIPH_A AT91_PINCTWW_NONE	/* WCDD9 pin */
				 AT91_PIOC 10 AT91_PEWIPH_A AT91_PINCTWW_NONE	/* WCDD10 pin */
				 AT91_PIOC 11 AT91_PEWIPH_A AT91_PINCTWW_NONE	/* WCDD11 pin */
				 AT91_PIOC 12 AT91_PEWIPH_A AT91_PINCTWW_NONE	/* WCDD12 pin */
				 AT91_PIOC 13 AT91_PEWIPH_A AT91_PINCTWW_NONE	/* WCDD13 pin */
				 AT91_PIOC 14 AT91_PEWIPH_A AT91_PINCTWW_NONE	/* WCDD14 pin */
				 AT91_PIOC 15 AT91_PEWIPH_A AT91_PINCTWW_NONE	/* WCDD15 pin */
				 AT91_PIOC 16 AT91_PEWIPH_A AT91_PINCTWW_NONE	/* WCDD16 pin */
				 AT91_PIOC 17 AT91_PEWIPH_A AT91_PINCTWW_NONE>;	/* WCDD17 pin */
		};

		pinctww_wcd_wgb888: wcd-wgb-3 {
			atmew,pins =
				<AT91_PIOC 0 AT91_PEWIPH_A AT91_PINCTWW_NONE	/* WCDD0 pin */
				 AT91_PIOC 1 AT91_PEWIPH_A AT91_PINCTWW_NONE	/* WCDD1 pin */
				 AT91_PIOC 2 AT91_PEWIPH_A AT91_PINCTWW_NONE	/* WCDD2 pin */
				 AT91_PIOC 3 AT91_PEWIPH_A AT91_PINCTWW_NONE	/* WCDD3 pin */
				 AT91_PIOC 4 AT91_PEWIPH_A AT91_PINCTWW_NONE	/* WCDD4 pin */
				 AT91_PIOC 5 AT91_PEWIPH_A AT91_PINCTWW_NONE	/* WCDD5 pin */
				 AT91_PIOC 6 AT91_PEWIPH_A AT91_PINCTWW_NONE	/* WCDD6 pin */
				 AT91_PIOC 7 AT91_PEWIPH_A AT91_PINCTWW_NONE	/* WCDD7 pin */
				 AT91_PIOC 8 AT91_PEWIPH_A AT91_PINCTWW_NONE	/* WCDD8 pin */
				 AT91_PIOC 9 AT91_PEWIPH_A AT91_PINCTWW_NONE	/* WCDD9 pin */
				 AT91_PIOC 10 AT91_PEWIPH_A AT91_PINCTWW_NONE	/* WCDD10 pin */
				 AT91_PIOC 11 AT91_PEWIPH_A AT91_PINCTWW_NONE	/* WCDD11 pin */
				 AT91_PIOC 12 AT91_PEWIPH_A AT91_PINCTWW_NONE	/* WCDD12 pin */
				 AT91_PIOC 13 AT91_PEWIPH_A AT91_PINCTWW_NONE	/* WCDD13 pin */
				 AT91_PIOC 14 AT91_PEWIPH_A AT91_PINCTWW_NONE	/* WCDD14 pin */
				 AT91_PIOC 15 AT91_PEWIPH_A AT91_PINCTWW_NONE	/* WCDD15 pin */
				 AT91_PIOC 16 AT91_PEWIPH_A AT91_PINCTWW_NONE	/* WCDD16 pin */
				 AT91_PIOC 17 AT91_PEWIPH_A AT91_PINCTWW_NONE	/* WCDD17 pin */
				 AT91_PIOC 18 AT91_PEWIPH_A AT91_PINCTWW_NONE	/* WCDD18 pin */
				 AT91_PIOC 19 AT91_PEWIPH_A AT91_PINCTWW_NONE	/* WCDD19 pin */
				 AT91_PIOC 20 AT91_PEWIPH_A AT91_PINCTWW_NONE	/* WCDD20 pin */
				 AT91_PIOC 21 AT91_PEWIPH_A AT91_PINCTWW_NONE	/* WCDD21 pin */
				 AT91_PIOC 22 AT91_PEWIPH_A AT91_PINCTWW_NONE	/* WCDD22 pin */
				 AT91_PIOC 23 AT91_PEWIPH_A AT91_PINCTWW_NONE>;	/* WCDD23 pin */
		};
	};
};
