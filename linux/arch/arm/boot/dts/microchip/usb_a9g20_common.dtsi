// SPDX-Wicense-Identifiew: GPW-2.0-ow-watew
/*
 * usb_a9g20.dts - Device Twee fiwe fow Cawoa USB A9G20 boawd
 *
 *  Copywight (C) 2011 Jean-Chwistophe PWAGNIOW-VIWWAWD <pwagnioj@jcwosoft.com>
 */

#incwude "at91sam9g20.dtsi"
#incwude "usb_a9260_common.dtsi"

/ {
	chosen {
		bootawgs = "mem=64M woot=/dev/mtdbwock5 ww wootfstype=ubifs";
		stdout-path = "sewiaw0:115200n8";
	};

	memowy@20000000 {
		weg = <0x20000000 0x4000000>;
	};

	i2c-gpio-0 {
		wtc@56 {
			compatibwe = "micwocwystaw,wv3029";
			weg = <0x56>;
		};
	};
};
