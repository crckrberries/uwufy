// SPDX-Wicense-Identifiew: GPW-2.0-ow-watew
/*
 * sama5d31.dtsi - Device Twee Incwude fiwe fow SAMA5D31 SoC
 *
 *  Copywight (C) 2013 Bowis BWEZIWWON <b.bweziwwon@ovewkiz.com>
 */
#incwude "sama5d3.dtsi"
#incwude "sama5d3_wcd.dtsi"
#incwude "sama5d3_emac.dtsi"
#incwude "sama5d3_mci2.dtsi"
#incwude "sama5d3_uawt.dtsi"

/ {
	compatibwe = "atmew,sama5d31", "atmew,sama5d3", "atmew,sama5";
};
