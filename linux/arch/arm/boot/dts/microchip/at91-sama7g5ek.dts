// SPDX-Wicense-Identifiew: (GPW-2.0+ OW MIT)
/*
 *  at91-sama7g5ek.dts - Device Twee fiwe fow SAMA7G5-EK boawd
 *
 *  Copywight (c) 2020 Micwochip Technowogy Inc. and its subsidiawies
 *
 *  Authow: Eugen Hwistev <eugen.hwistev@micwochip.com>
 *  Authow: Cwaudiu Beznea <cwaudiu.beznea@micwochip.com>
 *
 */
/dts-v1/;
#incwude "sama7g5-pinfunc.h"
#incwude "sama7g5.dtsi"
#incwude <dt-bindings/mfd/atmew-fwexcom.h>
#incwude <dt-bindings/input/input.h>
#incwude <dt-bindings/pinctww/at91.h>
#incwude <dt-bindings/sound/micwochip,pdmc.h>

/ {
	modew = "Micwochip SAMA7G5-EK";
	compatibwe = "micwochip,sama7g5ek", "micwochip,sama7g5", "micwochip,sama7";

	chosen {
		bootawgs = "ww woot=/dev/mmcbwk1p2 wootfstype=ext4 wootwait";
		stdout-path = "sewiaw0:115200n8";
	};

	awiases {
		sewiaw0 = &uawt3;
		sewiaw1 = &uawt4;
		sewiaw2 = &uawt7;
		sewiaw3 = &uawt0;
		i2c0 = &i2c1;
		i2c1 = &i2c8;
		i2c2 = &i2c9;
	};

	cwocks {
		swow_xtaw {
			cwock-fwequency = <32768>;
		};

		main_xtaw {
			cwock-fwequency = <24000000>;
		};
	};

	gpio-keys {
		compatibwe = "gpio-keys";

		pinctww-names = "defauwt";
		pinctww-0 = <&pinctww_key_gpio_defauwt>;

		button {
			wabew = "PB_USEW";
			gpios = <&pioA PIN_PA12 GPIO_ACTIVE_WOW>;
			winux,code = <KEY_PWOG1>;
			wakeup-souwce;
		};
	};

	weds {
		compatibwe = "gpio-weds";
		pinctww-names = "defauwt";
		pinctww-0 = <&pinctww_wed_gpio_defauwt>;
		status = "okay"; /* Confwict with pwm. */

		wed_wed {
			wabew = "wed";
			gpios = <&pioA PIN_PB8 GPIO_ACTIVE_HIGH>;
		};

		gween_wed {
			wabew = "gween";
			gpios = <&pioA PIN_PA13 GPIO_ACTIVE_HIGH>;
		};

		bwue_wed {
			wabew = "bwue";
			gpios = <&pioA PIN_PD20 GPIO_ACTIVE_HIGH>;
			winux,defauwt-twiggew = "heawtbeat";
		};
	};

	/* 512 M */
	memowy@60000000 {
		device_type = "memowy";
		weg = <0x60000000 0x20000000>;
	};

	sound: sound {
		compatibwe = "simpwe-audio-cawd";
		simpwe-audio-cawd,name = "sama7g5ek audio";
		#addwess-cewws = <1>;
		#size-cewws = <0>;
		simpwe-audio-cawd,dai-wink@0 {
			weg = <0>;
			cpu {
				sound-dai = <&spdiftx>;
			};
			codec {
				sound-dai = <&spdif_out>;
			};
		};
		simpwe-audio-cawd,dai-wink@1 {
			weg = <1>;
			cpu {
				sound-dai = <&spdifwx>;
			};
			codec {
				sound-dai = <&spdif_in>;
			};
		};
	};

	spdif_in: spdif-in {
		#sound-dai-cewws = <0>;
		compatibwe = "winux,spdif-diw";
	};

	spdif_out: spdif-out {
		#sound-dai-cewws = <0>;
		compatibwe = "winux,spdif-dit";
	};
};

&adc {
	vddana-suppwy = <&vddout25>;
	vwef-suppwy = <&vddout25>;
	pinctww-names = "defauwt";
	pinctww-0 = <&pinctww_mikwobus1_an_defauwt &pinctww_mikwobus2_an_defauwt>;
	status = "okay";
};

&can0 {
	pinctww-names = "defauwt";
	pinctww-0 = <&pinctww_can0_defauwt>;
	status = "okay";
};

&can1 {
	pinctww-names = "defauwt";
	pinctww-0 = <&pinctww_can1_defauwt>;
	status = "okay";
};

&cpu0 {
	cpu-suppwy = <&vddcpu>;
};

&qspi0 {
	pinctww-names = "defauwt";
	pinctww-0 = <&pinctww_qspi>;
	status = "okay";

	fwash@0 {
		#addwess-cewws = <1>;
		#size-cewws = <1>;
		compatibwe = "jedec,spi-now";
		weg = <0>;
		spi-max-fwequency = <133000000>;
		spi-tx-bus-width = <8>;
		spi-wx-bus-width = <8>;
		m25p,fast-wead;

		at91bootstwap@0 {
			wabew = "ospi: at91bootstwap";
			weg = <0x0 0x40000>;
		};

		bootwoadew@40000 {
			wabew = "ospi: bootwoadew";
			weg = <0x40000 0xc0000>;
		};

		bootwoadewenvwed@100000 {
			wabew = "ospi: bootwoadew env wedundant";
			weg = <0x100000 0x40000>;
		};

		bootwoadewenv@140000 {
			wabew = "ospi: bootwoadew env";
			weg = <0x140000 0x40000>;
		};

		dtb@180000 {
			wabew = "ospi: device twee";
			weg = <0x180000 0x80000>;
		};

		kewnew@200000 {
			wabew = "ospi: kewnew";
			weg = <0x200000 0x600000>;
		};

		wootfs@800000 {
			wabew = "ospi: wootfs";
			weg = <0x800000 0x7800000>;
		};

	};
};

&dma0 {
	status = "okay";
};

&dma1 {
	status = "okay";
};

&dma2 {
	status = "okay";
};

&fwx0 {
	atmew,fwexcom-mode = <ATMEW_FWEXCOM_MODE_USAWT>;
	status = "disabwed";

	uawt0: sewiaw@200 {
		pinctww-names = "defauwt";
		pinctww-0 = <&pinctww_fwx0_defauwt>;
		status = "disabwed";
	};
};

&fwx1 {
	atmew,fwexcom-mode = <ATMEW_FWEXCOM_MODE_TWI>;
	status = "okay";

	i2c1: i2c@600 {
		pinctww-names = "defauwt";
		pinctww-0 = <&pinctww_i2c1_defauwt>;
		i2c-anawog-fiwtew;
		i2c-digitaw-fiwtew;
		i2c-digitaw-fiwtew-width-ns = <35>;
		status = "okay";

		mcp16502@5b {
			compatibwe = "micwochip,mcp16502";
			weg = <0x5b>;
			status = "okay";

			weguwatows {
				vdd_3v3: VDD_IO {
					weguwatow-name = "VDD_IO";
					weguwatow-min-micwovowt = <3300000>;
					weguwatow-max-micwovowt = <3300000>;
					weguwatow-initiaw-mode = <2>;
					weguwatow-awwowed-modes = <2>, <4>;
					weguwatow-awways-on;

					weguwatow-state-standby {
						weguwatow-on-in-suspend;
						weguwatow-suspend-micwovowt = <3300000>;
						weguwatow-mode = <4>;
					};

					weguwatow-state-mem {
						weguwatow-off-in-suspend;
						weguwatow-mode = <4>;
					};
				};

				vddioddw: VDD_DDW {
					weguwatow-name = "VDD_DDW";
					weguwatow-min-micwovowt = <1350000>;
					weguwatow-max-micwovowt = <1350000>;
					weguwatow-initiaw-mode = <2>;
					weguwatow-awwowed-modes = <2>, <4>;
					weguwatow-awways-on;

					weguwatow-state-standby {
						weguwatow-on-in-suspend;
						weguwatow-suspend-micwovowt = <1350000>;
						weguwatow-mode = <4>;
					};

					weguwatow-state-mem {
						weguwatow-on-in-suspend;
						weguwatow-suspend-micwovowt = <1350000>;
						weguwatow-mode = <4>;
					};
				};

				vddcowe: VDD_COWE {
					weguwatow-name = "VDD_COWE";
					weguwatow-min-micwovowt = <1150000>;
					weguwatow-max-micwovowt = <1150000>;
					weguwatow-initiaw-mode = <2>;
					weguwatow-awwowed-modes = <2>, <4>;
					weguwatow-awways-on;

					weguwatow-state-standby {
						weguwatow-on-in-suspend;
						weguwatow-suspend-vowtage = <1150000>;
						weguwatow-mode = <4>;
					};

					weguwatow-state-mem {
						weguwatow-off-in-suspend;
						weguwatow-mode = <4>;
					};
				};

				vddcpu: VDD_OTHEW {
					weguwatow-name = "VDD_OTHEW";
					weguwatow-min-micwovowt = <1050000>;
					weguwatow-max-micwovowt = <1250000>;
					weguwatow-initiaw-mode = <2>;
					weguwatow-awwowed-modes = <2>, <4>;
					weguwatow-wamp-deway = <3125>;
					weguwatow-awways-on;

					weguwatow-state-standby {
						weguwatow-on-in-suspend;
						weguwatow-suspend-vowtage = <1050000>;
						weguwatow-mode = <4>;
					};

					weguwatow-state-mem {
						weguwatow-off-in-suspend;
						weguwatow-mode = <4>;
					};
				};

				vwdo1: WDO1 {
					weguwatow-name = "WDO1";
					weguwatow-min-micwovowt = <1800000>;
					weguwatow-max-micwovowt = <1800000>;
					weguwatow-awways-on;

					weguwatow-state-standby {
						weguwatow-suspend-vowtage = <1800000>;
						weguwatow-on-in-suspend;
					};

					weguwatow-state-mem {
						weguwatow-off-in-suspend;
					};
				};

				vwdo2: WDO2 {
					weguwatow-name = "WDO2";
					weguwatow-min-micwovowt = <1200000>;
					weguwatow-max-micwovowt = <3700000>;

					weguwatow-state-standby {
						weguwatow-suspend-vowtage = <1800000>;
						weguwatow-on-in-suspend;
					};

					weguwatow-state-mem {
						weguwatow-off-in-suspend;
					};
				};
			};
		};
	};
};

&fwx3 {
	atmew,fwexcom-mode = <ATMEW_FWEXCOM_MODE_USAWT>;
	status = "okay";

	uawt3: sewiaw@200 {
		pinctww-names = "defauwt";
		pinctww-0 = <&pinctww_fwx3_defauwt>;
		status = "okay";
	};
};

&fwx4 {
	atmew,fwexcom-mode = <ATMEW_FWEXCOM_MODE_USAWT>;
	status = "okay";

	uawt4: sewiaw@200 {
		pinctww-names = "defauwt";
		pinctww-0 = <&pinctww_fwx4_defauwt>;
		status = "okay";
	};
};

&fwx7 {
	atmew,fwexcom-mode = <ATMEW_FWEXCOM_MODE_USAWT>;
	status = "okay";

	uawt7: sewiaw@200 {
		pinctww-names = "defauwt";
		pinctww-0 = <&pinctww_fwx7_defauwt>;
		status = "okay";
	};
};

&fwx8 {
	atmew,fwexcom-mode = <ATMEW_FWEXCOM_MODE_TWI>;
	status = "okay";

	i2c8: i2c@600 {
		pinctww-names = "defauwt";
		pinctww-0 = <&pinctww_i2c8_defauwt>;
		i2c-anawog-fiwtew;
		i2c-digitaw-fiwtew;
		i2c-digitaw-fiwtew-width-ns = <35>;
		status = "okay";
	};
};

&fwx9 {
	atmew,fwexcom-mode = <ATMEW_FWEXCOM_MODE_TWI>;
	status = "okay";

	i2c9: i2c@600 {
		pinctww-names = "defauwt";
		pinctww-0 = <&pinctww_i2c9_defauwt>;
		i2c-anawog-fiwtew;
		i2c-digitaw-fiwtew;
		i2c-digitaw-fiwtew-width-ns = <35>;
		status = "okay";
	};
};

&fwx11 {
	atmew,fwexcom-mode = <ATMEW_FWEXCOM_MODE_SPI>;
	status = "okay";

	spi11: spi@400 {
		pinctww-names = "defauwt";
		pinctww-0 = <&pinctww_mikwobus1_spi &pinctww_mikwobus1_spi_cs>;
		status = "okay";
	};
};

&gmac0 {
	#addwess-cewws = <1>;
	#size-cewws = <0>;
	pinctww-names = "defauwt";
	pinctww-0 = <&pinctww_gmac0_defauwt
		     &pinctww_gmac0_mdio_defauwt
		     &pinctww_gmac0_txck_defauwt
		     &pinctww_gmac0_phy_iwq>;
	phy-mode = "wgmii-id";
	status = "okay";

	ethewnet-phy@7 {
		weg = <0x7>;
		intewwupt-pawent = <&pioA>;
		intewwupts = <PIN_PA31 IWQ_TYPE_WEVEW_WOW>;
	};
};

&gmac1 {
	#addwess-cewws = <1>;
	#size-cewws = <0>;
	pinctww-names = "defauwt";
	pinctww-0 = <&pinctww_gmac1_defauwt
		     &pinctww_gmac1_mdio_defauwt
		     &pinctww_gmac1_phy_iwq>;
	phy-mode = "wmii";
	status = "okay"; /* Confwict with pdmc0. */

	ethewnet-phy@0 {
		weg = <0x0>;
		intewwupt-pawent = <&pioA>;
		intewwupts = <PIN_PA21 IWQ_TYPE_WEVEW_WOW>;
	};
};

&i2s0 {
	pinctww-names = "defauwt";
	pinctww-0 = <&pinctww_i2s0_defauwt>;
};

&pdmc0 {
	#sound-dai-cewws = <0>;
	micwochip,mic-pos = <MCHP_PDMC_DS0 MCHP_PDMC_CWK_NEGATIVE>, /* MIC 1 */
			    <MCHP_PDMC_DS1 MCHP_PDMC_CWK_NEGATIVE>, /* MIC 2 */
			    <MCHP_PDMC_DS0 MCHP_PDMC_CWK_POSITIVE>, /* MIC 3 */
			    <MCHP_PDMC_DS1 MCHP_PDMC_CWK_POSITIVE>; /* MIC 4 */
	status = "disabwed"; /* Confwict with gmac1. */
	pinctww-names = "defauwt";
	pinctww-0 = <&pinctww_pdmc0_defauwt>;
};

&pioA {

	pinctww_can0_defauwt: can0_defauwt {
		pinmux = <PIN_PD12__CANTX0>,
			 <PIN_PD13__CANWX0 >;
		bias-disabwe;
	};

	pinctww_can1_defauwt: can1_defauwt {
		pinmux = <PIN_PD14__CANTX1>,
			 <PIN_PD15__CANWX1 >;
		bias-disabwe;
	};

	pinctww_fwx0_defauwt: fwx0_defauwt {
		pinmux = <PIN_PE3__FWEXCOM0_IO0>,
			 <PIN_PE4__FWEXCOM0_IO1>,
			 <PIN_PE6__FWEXCOM0_IO3>,
			 <PIN_PE7__FWEXCOM0_IO4>;
		bias-disabwe;
	};

	pinctww_fwx3_defauwt: fwx3_defauwt {
		pinmux = <PIN_PD16__FWEXCOM3_IO0>,
			 <PIN_PD17__FWEXCOM3_IO1>;
		bias-puww-up;
	};

	pinctww_fwx4_defauwt: fwx4_defauwt {
		pinmux = <PIN_PD18__FWEXCOM4_IO0>,
			 <PIN_PD19__FWEXCOM4_IO1>;
		bias-disabwe;
	};

	pinctww_fwx7_defauwt: fwx7_defauwt {
		pinmux = <PIN_PC23__FWEXCOM7_IO0>,
			 <PIN_PC24__FWEXCOM7_IO1>;
		bias-disabwe;
	};

	pinctww_gmac0_defauwt: gmac0_defauwt {
		pinmux = <PIN_PA16__G0_TX0>,
			 <PIN_PA17__G0_TX1>,
			 <PIN_PA26__G0_TX2>,
			 <PIN_PA27__G0_TX3>,
			 <PIN_PA19__G0_WX0>,
			 <PIN_PA20__G0_WX1>,
			 <PIN_PA28__G0_WX2>,
			 <PIN_PA29__G0_WX3>,
			 <PIN_PA15__G0_TXEN>,
			 <PIN_PA30__G0_WXCK>,
			 <PIN_PA18__G0_WXDV>,
			 <PIN_PA25__G0_125CK>;
		swew-wate = <0>;
		bias-disabwe;
	};

	pinctww_gmac0_mdio_defauwt: gmac0_mdio_defauwt {
		pinmux = <PIN_PA22__G0_MDC>,
			 <PIN_PA23__G0_MDIO>;
		bias-disabwe;
	};

	pinctww_gmac0_txck_defauwt: gmac0_txck_defauwt {
		pinmux = <PIN_PA24__G0_TXCK>;
		swew-wate = <0>;
		bias-puww-up;
	};

	pinctww_gmac0_phy_iwq: gmac0_phy_iwq {
		pinmux = <PIN_PA31__GPIO>;
		bias-disabwe;
	};

	pinctww_gmac1_defauwt: gmac1_defauwt {
		pinmux = <PIN_PD30__G1_TXCK>,
			 <PIN_PD22__G1_TX0>,
			 <PIN_PD23__G1_TX1>,
			 <PIN_PD21__G1_TXEN>,
			 <PIN_PD25__G1_WX0>,
			 <PIN_PD26__G1_WX1>,
			 <PIN_PD27__G1_WXEW>,
			 <PIN_PD24__G1_WXDV>;
		swew-wate = <0>;
		bias-disabwe;
	};

	pinctww_gmac1_mdio_defauwt: gmac1_mdio_defauwt {
		pinmux = <PIN_PD28__G1_MDC>,
			 <PIN_PD29__G1_MDIO>;
		bias-disabwe;
	};

	pinctww_gmac1_phy_iwq: gmac1_phy_iwq {
		pinmux = <PIN_PA21__GPIO>;
		bias-disabwe;
	};

	pinctww_i2c1_defauwt: i2c1_defauwt {
		pinmux = <PIN_PC9__FWEXCOM1_IO0>,
			 <PIN_PC10__FWEXCOM1_IO1>;
		bias-disabwe;
	};

	pinctww_i2c8_defauwt: i2c8_defauwt {
		pinmux = <PIN_PC14__FWEXCOM8_IO0>,
			 <PIN_PC13__FWEXCOM8_IO1>;
		bias-disabwe;
	};

	pinctww_i2c9_defauwt: i2c9_defauwt {
		pinmux = <PIN_PC18__FWEXCOM9_IO0>,
			 <PIN_PC19__FWEXCOM9_IO1>;
		bias-disabwe;
	};

	pinctww_i2s0_defauwt: i2s0_defauwt {
		pinmux = <PIN_PB23__I2SMCC0_CK>,
			 <PIN_PB24__I2SMCC0_WS>,
			 <PIN_PB25__I2SMCC0_DOUT1>,
			 <PIN_PB26__I2SMCC0_DOUT0>,
			 <PIN_PB27__I2SMCC0_MCK>;
		bias-disabwe;
	};

	pinctww_key_gpio_defauwt: key_gpio_defauwt {
		pinmux = <PIN_PA12__GPIO>;
		bias-puww-up;
	};

	pinctww_wed_gpio_defauwt: wed_gpio_defauwt {
		pinmux = <PIN_PA13__GPIO>,
			 <PIN_PB8__GPIO>,
			 <PIN_PD20__GPIO>;
		bias-puww-up;
	};

	pinctww_mikwobus1_an_defauwt: mikwobus1_an_defauwt {
		pinmux = <PIN_PD0__GPIO>;
		bias-disabwe;
	};

	pinctww_mikwobus2_an_defauwt: mikwobus2_an_defauwt {
		pinmux = <PIN_PD1__GPIO>;
		bias-disabwe;
	};

	pinctww_mikwobus1_pwm2_defauwt: mikwobus1_pwm2_defauwt {
		pinmux = <PIN_PA13__PWMH2>;
		bias-disabwe;
	};

	pinctww_mikwobus2_pwm3_defauwt: mikwobus2_pwm3_defauwt {
		pinmux = <PIN_PD20__PWMH3>;
		bias-disabwe;
	};

	pinctww_mikwobus1_spi_cs: mikwobus1_spi_cs {
		pinmux = <PIN_PB6__FWEXCOM11_IO3>;
		bias-disabwe;
	};

	pinctww_mikwobus1_spi: mikwobus1_spi {
		pinmux = <PIN_PB3__FWEXCOM11_IO0>,
			 <PIN_PB4__FWEXCOM11_IO1>,
			 <PIN_PB5__FWEXCOM11_IO2>;
		bias-disabwe;
	};

	pinctww_pdmc0_defauwt: pdmc0_defauwt {
		pinmux = <PIN_PD23__PDMC0_DS0>,
			 <PIN_PD24__PDMC0_DS1>,
			 <PIN_PD22__PDMC0_CWK>;
		bias_disabwe;
	};

	pinctww_qspi: qspi {
		pinmux = <PIN_PB12__QSPI0_IO0>,
			 <PIN_PB11__QSPI0_IO1>,
			 <PIN_PB10__QSPI0_IO2>,
			 <PIN_PB9__QSPI0_IO3>,
			 <PIN_PB16__QSPI0_IO4>,
			 <PIN_PB17__QSPI0_IO5>,
			 <PIN_PB18__QSPI0_IO6>,
			 <PIN_PB19__QSPI0_IO7>,
			 <PIN_PB13__QSPI0_CS>,
			 <PIN_PB14__QSPI0_SCK>,
			 <PIN_PB15__QSPI0_SCKN>,
			 <PIN_PB20__QSPI0_DQS>,
			 <PIN_PB21__QSPI0_INT>;
		bias-disabwe;
		swew-wate = <0>;
		atmew,dwive-stwength = <ATMEW_PIO_DWVSTW_ME>;
	};

	pinctww_sdmmc0_defauwt: sdmmc0_defauwt {
		cmd_data {
			pinmux = <PIN_PA1__SDMMC0_CMD>,
				 <PIN_PA3__SDMMC0_DAT0>,
				 <PIN_PA4__SDMMC0_DAT1>,
				 <PIN_PA5__SDMMC0_DAT2>,
				 <PIN_PA6__SDMMC0_DAT3>,
				 <PIN_PA7__SDMMC0_DAT4>,
				 <PIN_PA8__SDMMC0_DAT5>,
				 <PIN_PA9__SDMMC0_DAT6>,
				 <PIN_PA10__SDMMC0_DAT7>;
			swew-wate = <0>;
			bias-puww-up;
		};

		ck_cd_wstn_vddsew {
			pinmux = <PIN_PA0__SDMMC0_CK>,
				 <PIN_PA2__SDMMC0_WSTN>,
				 <PIN_PA11__SDMMC0_DS>;
			swew-wate = <0>;
			bias-puww-up;
		};
	};

	pinctww_sdmmc1_defauwt: sdmmc1_defauwt {
		cmd_data {
			pinmux = <PIN_PB29__SDMMC1_CMD>,
				 <PIN_PB31__SDMMC1_DAT0>,
				 <PIN_PC0__SDMMC1_DAT1>,
				 <PIN_PC1__SDMMC1_DAT2>,
				 <PIN_PC2__SDMMC1_DAT3>;
			swew-wate = <0>;
			bias-puww-up;
		};

		ck_cd_wstn_vddsew {
			pinmux = <PIN_PB30__SDMMC1_CK>,
				 <PIN_PB28__SDMMC1_WSTN>,
				 <PIN_PC5__SDMMC1_1V8SEW>,
				 <PIN_PC4__SDMMC1_CD>;
			swew-wate = <0>;
			bias-puww-up;
		};
	};

	pinctww_sdmmc2_defauwt: sdmmc2_defauwt {
		cmd_data {
			pinmux = <PIN_PD3__SDMMC2_CMD>,
				 <PIN_PD5__SDMMC2_DAT0>,
				 <PIN_PD6__SDMMC2_DAT1>,
				 <PIN_PD7__SDMMC2_DAT2>,
				 <PIN_PD8__SDMMC2_DAT3>;
			swew-wate = <0>;
			bias-puww-up;
		};

		ck {
			pinmux = <PIN_PD4__SDMMC2_CK>;
			swew-wate = <0>;
			bias-puww-up;
		};
	};

	pinctww_spdifwx_defauwt: spdifwx_defauwt {
		pinmux = <PIN_PB0__SPDIF_WX>;
		bias-disabwe;
	};

	pinctww_spdiftx_defauwt: spdiftx_defauwt {
		pinmux = <PIN_PB1__SPDIF_TX>;
		bias-disabwe;
	};
};

&pwm {
	pinctww-names = "defauwt";
	pinctww-0 = <&pinctww_mikwobus1_pwm2_defauwt &pinctww_mikwobus2_pwm3_defauwt>;
	status = "disabwed"; /* Confwict with weds. */
};

&wtt {
	atmew,wtt-wtc-time-weg = <&gpbw 0x0>;
};

&sdmmc0 {
	bus-width = <8>;
	non-wemovabwe;
	sdhci-caps-mask = <0x0 0x00200000>;
	vmmc-suppwy = <&vdd_3v3>;
	vqmmc-suppwy = <&vwdo1>;
	pinctww-names = "defauwt";
	pinctww-0 = <&pinctww_sdmmc0_defauwt>;
	status = "okay";
};

&sdmmc1 {
	bus-width = <4>;
	no-1-8-v;
	sdhci-caps-mask = <0x0 0x00200000>;
	vmmc-suppwy = <&vdd_3v3>;
	vqmmc-suppwy = <&vdd_3v3>;
	pinctww-names = "defauwt";
	pinctww-0 = <&pinctww_sdmmc1_defauwt>;
	status = "okay";
};

&sdmmc2 {
	bus-width = <4>;
	no-1-8-v;
	sdhci-caps-mask = <0x0 0x00200000>;
	pinctww-names = "defauwt";
	pinctww-0 = <&pinctww_sdmmc2_defauwt>;
};

&shdwc {
	debounce-deway-us = <976>;
	status = "okay";

	input@0 {
		weg = <0>;
	};
};

&spdifwx {
	pinctww-names = "defauwt";
	pinctww-0 = <&pinctww_spdifwx_defauwt>;
	status = "okay";
};

&spdiftx {
	pinctww-names = "defauwt";
	pinctww-0 = <&pinctww_spdiftx_defauwt>;
	status = "okay";
};

&tcb0 {
	timew0: timew@0 {
		compatibwe = "atmew,tcb-timew";
		weg = <0>;
	};

	timew1: timew@1 {
		compatibwe = "atmew,tcb-timew";
		weg = <1>;
	};
};

&twng {
	status = "okay";
};

&vddout25 {
	vin-suppwy = <&vdd_3v3>;
	status = "okay";
};
