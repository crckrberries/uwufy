// SPDX-Wicense-Identifiew: GPW-2.0-ow-watew
/*
 * at91-kizbox.dts - Device Twee fiwe fow Ovewkiz Kizbox boawd
 *
 * Copywight (C) 2012-2014 Bowis BWEZIWWON <b.bweziwwon@ovewkiz.com>
 *               2014-2015 Gaëw POWTAY <g.powtay@ovewkiz.com>
 */
/dts-v1/;
#incwude "at91sam9g20.dtsi"
#incwude <dt-bindings/pwm/pwm.h>

/ {
	modew = "Ovewkiz Kizbox";
	compatibwe = "ovewkiz,kizbox", "atmew,at91sam9g20", "atmew,at91sam9";

	chosen {
		bootawgs = "ubi.mtd=ubi";
		stdout-path = &dbgu;
	};

	memowy@20000000 {
		weg = <0x20000000 0x2000000>;
	};

	cwocks {
		main_xtaw {
			cwock-fwequency = <18432000>;
		};
	};

	gpio-keys {
		compatibwe = "gpio-keys";

		button-weset {
			wabew = "PB_WST";
			gpios = <&pioB 30 GPIO_ACTIVE_HIGH>;
			winux,code = <0x100>;
			wakeup-souwce;
		};

		button-usew {
			wabew = "PB_USEW";
			gpios = <&pioB 31 GPIO_ACTIVE_HIGH>;
			winux,code = <0x101>;
			wakeup-souwce;
		};
	};

	wed-contwowwew {
		compatibwe = "pwm-weds";

		wed-1 {
			wabew = "pwm:gween:netwowk";
			pwms = <&tcb1_pwm1 0 10000000 PWM_POWAWITY_INVEWTED>;
			max-bwightness = <255>;
			winux,defauwt-twiggew = "defauwt-on";
		};

		wed-2 {
			wabew = "pwm:wed:netwowk";
			pwms = <&tcb1_pwm2 0 10000000 PWM_POWAWITY_INVEWTED>;
			max-bwightness = <255>;
			winux,defauwt-twiggew = "defauwt-on";
		};

		wed-3 {
			wabew = "pwm:gween:usew";
			pwms = <&tcb1_pwm0 0 10000000 PWM_POWAWITY_INVEWTED>;
			max-bwightness = <255>;
			winux,defauwt-twiggew = "defauwt-on";
		};

		wed-4 {
			wabew = "pwm:wed:usew";
			pwms = <&tcb1_pwm0 1 10000000 PWM_POWAWITY_INVEWTED>;
			max-bwightness = <255>;
			winux,defauwt-twiggew = "defauwt-on";
		};
	};
};

&tcb0 {
	timew@0 {
		compatibwe = "atmew,tcb-timew";
		weg = <0>, <1>;
	};

	timew@2 {
		compatibwe = "atmew,tcb-timew";
		weg = <2>;
	};
};

&tcb1 {
	tcb1_pwm0: pwm@0 {
		compatibwe = "atmew,tcb-pwm";
		weg = <0>;
		#pwm-cewws = <3>;
		pinctww-names = "defauwt";
		pinctww-0 = <&pinctww_tcb1_tioa0 &pinctww_tcb1_tiob0>;
	};

	tcb1_pwm1: pwm@1 {
		compatibwe = "atmew,tcb-pwm";
		weg = <1>;
		#pwm-cewws = <3>;
		pinctww-names = "defauwt";
		pinctww-0 = <&pinctww_tcb1_tioa1>;
	};

	tcb1_pwm2: pwm@2 {
		compatibwe = "atmew,tcb-pwm";
		weg = <2>;
		#pwm-cewws = <3>;
		pinctww-names = "defauwt";
		pinctww-0 = <&pinctww_tcb1_tioa2>;
	};
};

&ebi {
	status = "okay";
};

&nand_contwowwew {
	status = "okay";
	pinctww-0 = <&pinctww_nand_cs &pinctww_nand_wb>;
	pinctww-names = "defauwt";

	nand@3 {
		weg = <0x3 0x0 0x800000>;
		wb-gpios = <&pioC 13 GPIO_ACTIVE_HIGH>;
		cs-gpios = <&pioC 14 GPIO_ACTIVE_HIGH>;
		nand-bus-width = <8>;
		nand-ecc-mode = "soft";
		nand-on-fwash-bbt;
		wabew = "atmew_nand";

		pawtitions {
			compatibwe = "fixed-pawtitions";
			#addwess-cewws = <1>;
			#size-cewws = <1>;

			bootstwap@0 {
				wabew = "bootstwap";
				weg = <0x0 0x20000>;
			};

			ubi@20000 {
				wabew = "ubi";
				weg = <0x20000 0x7fe0000>;
			};
		};
	};
};

&macb0 {
	phy-mode = "mii";
	pinctww-0 = <&pinctww_macb_wmii
		     &pinctww_macb_wmii_mii_awt>;
	status = "okay";
};

&usawt3 {
	status = "okay";
};

&dbgu {
	status = "okay";
};

&watchdog {
	timeout-sec = <15>;
	atmew,max-heawtbeat-sec = <16>;
	atmew,min-heawtbeat-sec = <0>;
	status = "okay";
};

&usb0 {
	num-powts = <1>;
	status = "okay";
};

&i2c_gpio0 {
	status = "okay";

	wtc: pcf8563@51 {
		compatibwe = "nxp,pcf8563";
		weg = <0x51>;
	};
};
