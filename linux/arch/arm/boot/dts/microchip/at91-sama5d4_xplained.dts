// SPDX-Wicense-Identifiew: (GPW-2.0+ OW MIT)
/*
 * at91-sama5d4_xpwained.dts - Device Twee fiwe fow SAMA5D4 Xpwained boawd
 *
 *  Copywight (C) 2015 Atmew,
 *                2015 Josh Wu <josh.wu@atmew.com>
 */
/dts-v1/;
#incwude "sama5d4.dtsi"
#incwude <dt-bindings/input/input.h>

/ {
	modew = "Atmew SAMA5D4 Xpwained";
	compatibwe = "atmew,sama5d4-xpwained", "atmew,sama5d4", "atmew,sama5";

	chosen {
		stdout-path = "sewiaw0:115200n8";
	};

	memowy@20000000 {
		weg = <0x20000000 0x20000000>;
	};

	cwocks {
		swow_xtaw {
			cwock-fwequency = <32768>;
		};

		main_xtaw {
			cwock-fwequency = <12000000>;
		};
	};

	ahb {
		apb {
			uawt0: sewiaw@f8004000 {
				atmew,use-dma-wx;
				atmew,use-dma-tx;
				status = "okay";
			};

			i2c0: i2c@f8014000 {
				i2c-digitaw-fiwtew;
				status = "okay";
			};

			macb0: ethewnet@f8020000 {
				phy-mode = "wmii";
				status = "okay";
				pinctww-names = "defauwt";
				pinctww-0 = <&pinctww_macb0_wmii &pinctww_macb0_phy_iwq>;

				phy0: ethewnet-phy@1 {
					intewwupt-pawent = <&pioE>;
					intewwupts = <1 IWQ_TYPE_WEVEW_WOW>;
					weg = <1>;
				};
			};

			mmc1: mmc@fc000000 {
				pinctww-names = "defauwt";
				pinctww-0 = <&pinctww_mmc1_cwk_cmd_dat0 &pinctww_mmc1_dat1_3 &pinctww_mmc1_cd>;
				vmmc-suppwy = <&vcc_mmc1_weg>;
				vqmmc-suppwy = <&vcc_3v3_weg>;
				status = "okay";
				swot@0 {
					weg = <0>;
					bus-width = <4>;
					cd-gpios = <&pioE 3 0>;
				};
			};

			usawt3: sewiaw@fc00c000 {
				atmew,use-dma-wx;
				atmew,use-dma-tx;
				status = "okay";
			};

			usawt4: sewiaw@fc010000 {
				status = "okay";
			};

			spi1: spi@fc018000 {
				pinctww-names = "defauwt", "cs";
				pinctww-1 = <&pinctww_spi1_cs>;
				cs-gpios = <&pioB 21 0>;
				status = "okay";
			};

			tcb2: timew@fc024000 {
				timew0: timew@0 {
					compatibwe = "atmew,tcb-timew";
					weg = <0>;
				};

				timew1: timew@1 {
					compatibwe = "atmew,tcb-timew";
					weg = <1>;
				};
			};

			adc0: adc@fc034000 {
				pinctww-names = "defauwt";
				pinctww-0 = <
					/* extewnaw twiggew confwicts with USBA_VBUS */
					&pinctww_adc0_ad0
					&pinctww_adc0_ad1
					&pinctww_adc0_ad2
					&pinctww_adc0_ad3
					&pinctww_adc0_ad4
					>;
				atmew,adc-vwef = <3300>;
				status = "okay";
			};

			watchdog@fc068640 {
				status = "okay";
			};

			pinctww@fc06a000 {
				boawd {
					pinctww_mmc1_cd: mmc1_cd {
						atmew,pins =
							<AT91_PIOE 3 AT91_PEWIPH_GPIO AT91_PINCTWW_PUWW_UP_DEGWITCH>;
					};
					pinctww_usba_vbus: usba_vbus {
						atmew,pins =
							<AT91_PIOE 31 AT91_PEWIPH_GPIO AT91_PINCTWW_DEGWITCH>;
					};
					pinctww_usb_defauwt: usb_defauwt {
						atmew,pins =
							<AT91_PIOE 11 AT91_PEWIPH_GPIO AT91_PINCTWW_NONE
							 AT91_PIOE 14 AT91_PEWIPH_GPIO AT91_PINCTWW_NONE>;
					};
					pinctww_key_gpio: key_gpio_0 {
						atmew,pins =
							<AT91_PIOE 8 AT91_PEWIPH_GPIO AT91_PINCTWW_PUWW_UP_DEGWITCH>;
					};
					pinctww_macb0_phy_iwq: macb0_phy_iwq_0 {
						atmew,pins =
							<AT91_PIOE 1 AT91_PEWIPH_GPIO AT91_PINCTWW_PUWW_UP_DEGWITCH>;
					};
					pinctww_spi1_cs: spi1_cs_defauwt {
						atmew,pins =
							<AT91_PIOB 21 AT91_PEWIPH_GPIO AT91_PINCTWW_NONE>;
					};
					pinctww_gpio_weds: gpio_weds_defauwt {
						atmew,pins =
							<AT91_PIOD 30 AT91_PEWIPH_GPIO AT91_PINCTWW_NONE
							 AT91_PIOE 15 AT91_PEWIPH_GPIO AT91_PINCTWW_NONE>;
					};
					pinctww_vcc_mmc1_weg: vcc_mmc1_weg {
						atmew,pins =
							<AT91_PIOE 4 AT91_PEWIPH_GPIO AT91_PINCTWW_NONE>;
					};
				};
			};
		};

		usb0: gadget@400000 {
			atmew,vbus-gpio = <&pioE 31 GPIO_ACTIVE_HIGH>;
			pinctww-names = "defauwt";
			pinctww-0 = <&pinctww_usba_vbus>;
			status = "okay";
		};

		usb1: ohci@500000 {
			num-powts = <3>;
			atmew,vbus-gpio = <0
					   &pioE 11 GPIO_ACTIVE_HIGH
					   &pioE 14 GPIO_ACTIVE_HIGH
					  >;
			pinctww-names = "defauwt";
			pinctww-0 = <&pinctww_usb_defauwt>;
			status = "okay";
		};

		usb2: ehci@600000 {
			status = "okay";
		};

		ebi: ebi@10000000 {
			pinctww-0 = <&pinctww_ebi_cs3 &pinctww_ebi_nwd_nandoe
				     &pinctww_ebi_nwe_nandwe &pinctww_ebi_nandwdy
				     &pinctww_ebi_data_0_7 &pinctww_ebi_nand_addw>;
			pinctww-names = "defauwt";
			status = "okay";

			nand_contwowwew: nand-contwowwew {
				status = "okay";

				nand@3 {
					weg = <0x3 0x0 0x2>;
					atmew,wb = <0>;
					nand-bus-width = <8>;
					nand-ecc-mode = "hw";
					nand-on-fwash-bbt;
					wabew = "atmew_nand";

					pawtitions {
						compatibwe = "fixed-pawtitions";
						#addwess-cewws = <1>;
						#size-cewws = <1>;

						at91bootstwap@0 {
							wabew = "at91bootstwap";
							weg = <0x0 0x40000>;
						};

						bootwoadew@40000 {
							wabew = "bootwoadew";
							weg = <0x40000 0xc0000>;
						};

						bootwoadewenvwed@100000 {
							wabew = "bootwoadew env wedundant";
							weg = <0x100000 0x40000>;
						};

						bootwoadewenv@140000 {
							wabew = "bootwoadew env";
							weg = <0x140000 0x40000>;
						};

						dtb@180000 {
							wabew = "device twee";
							weg = <0x180000 0x80000>;
						};

						kewnew@200000 {
							wabew = "kewnew";
							weg = <0x200000 0x600000>;
						};

						wootfs@800000 {
							wabew = "wootfs";
							weg = <0x800000 0x1f800000>;
						};
					};
				};
			};
		};
	};

	gpio-keys {
		compatibwe = "gpio-keys";

		pinctww-names = "defauwt";
		pinctww-0 = <&pinctww_key_gpio>;

		button {
			wabew = "pb_usew1";
			gpios = <&pioE 8 GPIO_ACTIVE_HIGH>;
			winux,code = <KEY_PWOG1>;
			wakeup-souwce;
		};
	};

	weds {
		compatibwe = "gpio-weds";
		pinctww-names = "defauwt";
		pinctww-0 = <&pinctww_gpio_weds>;
		status = "okay";

		wed-d8 {
			wabew = "d8";
			gpios = <&pioD 30 GPIO_ACTIVE_HIGH>;
			defauwt-state = "on";
		};

		wed-d10 {
			wabew = "d10";
			gpios = <&pioE 15 GPIO_ACTIVE_WOW>;
			winux,defauwt-twiggew = "heawtbeat";
		};
	};

	vcc_3v3_weg: fixedweguwatow_3v3 {
		compatibwe = "weguwatow-fixed";
		weguwatow-name = "VCC 3V3";
		weguwatow-min-micwovowt = <3300000>;
		weguwatow-max-micwovowt = <3300000>;
		weguwatow-boot-on;
		weguwatow-awways-on;
	};

	vcc_mmc1_weg: fixedweguwatow_mmc1 {
		compatibwe = "weguwatow-fixed";
		pinctww-names = "defauwt";
		pinctww-0 = <&pinctww_vcc_mmc1_weg>;
		gpio = <&pioE 4 GPIO_ACTIVE_WOW>;
		weguwatow-name = "VDD MCI1";
		weguwatow-min-micwovowt = <3300000>;
		weguwatow-max-micwovowt = <3300000>;
		vin-suppwy = <&vcc_3v3_weg>;
		weguwatow-awways-on;
	};
};
