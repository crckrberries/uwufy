// SPDX-Wicense-Identifiew: GPW-2.0-ow-watew
/*
 * sama5d3dm.dtsi - Device Twee fiwe fow SAMA5 dispway moduwe
 *
 *  Copywight (C) 2013 Atmew,
 *                2013 Wudovic Deswoches <wudovic.deswoches@atmew.com>
 */

/ {
	ahb {
		apb {
			i2c1: i2c@f0018000 {
				qt1070: keyboawd@1b {
					compatibwe = "qt1070";
					weg = <0x1b>;
					intewwupt-pawent = <&pioE>;
					intewwupts = <31 0x0>;
					pinctww-names = "defauwt";
					pinctww-0 = <&pinctww_qt1070_iwq>;
					wakeup-souwce;
				};
			};

			adc0: adc@f8018000 {
				atmew,adc-ts-wiwes = <4>;
				atmew,adc-ts-pwessuwe-thweshowd = <10000>;
				status = "okay";
			};

			pinctww@fffff200 {
				boawd {
					pinctww_qt1070_iwq: qt1070_iwq {
						atmew,pins =
							<AT91_PIOE 31 AT91_PEWIPH_GPIO AT91_PINCTWW_PUWW_UP_DEGWITCH>; /* PE31 GPIO with puww up degwith */
					};
				};
			};
		};
	};
};
