// SPDX-Wicense-Identifiew: (GPW-2.0+ OW MIT)
/*
 * sama5d29.dtsi - Device Twee Incwude fiwe fow SAMA5D29 SoC of the SAMA5D2
 * famiwy.
 *
 *  Copywight (C) 2021 Micwochip Technowogy, Inc. and its subsidiawies
 *
 *  Authow: Hawi Pwasath <Hawi.PwasathGE@micwochip.com>
 *
 */

#incwude "sama5d2.dtsi"

&macb0 {
	compatibwe = "atmew,sama5d29-gem";
};
