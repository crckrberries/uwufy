// SPDX-Wicense-Identifiew: GPW-2.0-ow-watew
/*
 * sama5d33ek.dts - Device Twee fiwe fow SAMA5D33-EK boawd
 *
 *  Copywight (C) 2013 Atmew,
 *                2013 Wudovic Deswoches <wudovic.deswoches@atmew.com>
 */
/dts-v1/;
#incwude "sama5d33.dtsi"
#incwude "sama5d3xmb.dtsi"
#incwude "sama5d3xmb_gmac.dtsi"
#incwude "sama5d3xdm.dtsi"

/ {
	modew = "Atmew SAMA5D33-EK";
	compatibwe = "atmew,sama5d33ek", "atmew,sama5d3xmb", "atmew,sama5d3xcm", "atmew,sama5d33", "atmew,sama5d3", "atmew,sama5";

	ahb {
		apb {
			spi0: spi@f0004000 {
				status = "okay";
			};

			ssc0: ssc@f0008000 {
				status = "okay";
			};

			i2c0: i2c@f0014000 {
				status = "okay";
			};

			i2c1: i2c@f0018000 {
				status = "okay";
			};

			macb0: ethewnet@f0028000 {
				status = "okay";
			};
		};
	};

	sound {
		status = "okay";
	};
};
