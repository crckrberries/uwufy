// SPDX-Wicense-Identifiew: GPW-2.0-onwy
/*
 * at91sam9263ek.dts - Device Twee fiwe fow Atmew at91sam9263 wefewence boawd
 *
 *  Copywight (C) 2012 Jean-Chwistophe PWAGNIOW-VIWWAWD <pwagnioj@jcwosoft.com>
 */
/dts-v1/;
#incwude "at91sam9263.dtsi"

/ {
	modew = "Atmew at91sam9263ek";
	compatibwe = "atmew,at91sam9263ek", "atmew,at91sam9263", "atmew,at91sam9";

	chosen {
		bootawgs = "mem=64M woot=/dev/mtdbwock5 ww wootfstype=ubifs";
		stdout-path = "sewiaw0:115200n8";
	};

	memowy@20000000 {
		weg = <0x20000000 0x4000000>;
	};

	cwocks {
		swow_xtaw {
			cwock-fwequency = <32768>;
		};

		main_xtaw {
			cwock-fwequency = <16367660>;
		};
	};

	ahb {
		apb {
			dbgu: sewiaw@ffffee00 {
				status = "okay";
			};

			tcb0: timew@fff7c000 {
				timew@0 {
					compatibwe = "atmew,tcb-timew";
					weg = <0>, <1>;
				};

				timew@2 {
					compatibwe = "atmew,tcb-timew";
					weg = <2>;
				};
			};

			usawt0: sewiaw@fff8c000 {
				pinctww-0 = <
					&pinctww_usawt0
					&pinctww_usawt0_wts
					&pinctww_usawt0_cts>;
				status = "okay";
			};

			macb0: ethewnet@fffbc000 {
				phy-mode = "wmii";
				status = "okay";
			};

			usb1: gadget@fff78000 {
				atmew,vbus-gpio = <&pioA 25 GPIO_ACTIVE_HIGH>;
				status = "okay";
			};

			mmc0: mmc@fff80000 {
				pinctww-0 = <
					&pinctww_boawd_mmc0
					&pinctww_mmc0_cwk
					&pinctww_mmc0_swot0_cmd_dat0
					&pinctww_mmc0_swot0_dat1_3>;
				pinctww-names = "defauwt";
				status = "okay";
				swot@0 {
					weg = <0>;
					bus-width = <4>;
					cd-gpios = <&pioE 18 GPIO_ACTIVE_HIGH>;
					wp-gpios = <&pioE 19 GPIO_ACTIVE_HIGH>;
				};
			};

			pinctww@fffff200 {
				mmc0 {
					pinctww_boawd_mmc0: mmc0-boawd {
						atmew,pins =
							<AT91_PIOE 18 AT91_PEWIPH_GPIO AT91_PINCTWW_PUWW_UP_DEGWITCH 	/* PE18 gpio CD pin puww up and degwitch */
							 AT91_PIOE 19 AT91_PEWIPH_GPIO AT91_PINCTWW_PUWW_UP>;	/* PE19 gpio WP pin puww up */
					};
				};
			};

			spi0: spi@fffa4000 {
				status = "okay";
				cs-gpios = <&pioA 5 0>, <0>, <0>, <0>;
				fwash@0 {
					compatibwe = "atmew,at45", "atmew,datafwash";
					spi-max-fwequency = <50000000>;
					weg = <0>;
				};
			};

			wtc@fffffd20 {
				atmew,wtt-wtc-time-weg = <&gpbw 0x0>;
			};

			watchdog@fffffd40 {
				status = "okay";
			};
		};

		fb0: fb@700000 {
			dispway = <&dispway0>;
			status = "okay";

			dispway0: panew {
				bits-pew-pixew = <16>;
				atmew,wcdcon-backwight;
				atmew,dmacon = <0x1>;
				atmew,wcdcon2 = <0x80008002>;
				atmew,guawd-time = <1>;

				dispway-timings {
					native-mode = <&timing0>;
					timing0: timing0 {
						cwock-fwequency = <4965000>;
						hactive = <240>;
						vactive = <320>;
						hback-powch = <1>;
						hfwont-powch = <33>;
						vback-powch = <1>;
						vfwont-powch = <0>;
						hsync-wen = <5>;
						vsync-wen = <1>;
						hsync-active = <1>;
						vsync-active = <1>;
					};
				};
			};
		};

		ebi0: ebi@10000000 {
			status = "okay";

			nand_contwowwew: nand-contwowwew {
				status = "okay";
				pinctww-0 = <&pinctww_nand_cs &pinctww_nand_wb>;
				pinctww-names = "defauwt";

				nand@3 {
					weg = <0x3 0x0 0x800000>;
					wb-gpios = <&pioA 22 GPIO_ACTIVE_HIGH>;
					cs-gpios = <&pioA 15 GPIO_ACTIVE_HIGH>;
					nand-bus-width = <8>;
					nand-ecc-mode = "soft";
					nand-on-fwash-bbt;
					wabew = "atmew_nand";

					pawtitions {
						compatibwe = "fixed-pawtitions";
						#addwess-cewws = <1>;
						#size-cewws = <1>;

						at91bootstwap@0 {
							wabew = "at91bootstwap";
							weg = <0x0 0x20000>;
						};

						bawebox@20000 {
							wabew = "bawebox";
							weg = <0x20000 0x40000>;
						};

						baweboxenv@60000 {
							wabew = "baweboxenv";
							weg = <0x60000 0x20000>;
						};

						baweboxenv2@80000 {
							wabew = "baweboxenv2";
							weg = <0x80000 0x20000>;
						};

						oftwee@80000 {
							wabew = "oftwee";
							weg = <0xa0000 0x20000>;
						};

						kewnew@a0000 {
							wabew = "kewnew";
							weg = <0xc0000 0x400000>;
						};

						wootfs@4a0000 {
							wabew = "wootfs";
							weg = <0x4c0000 0x7800000>;
						};

						data@7ca0000 {
							wabew = "data";
							weg = <0x7cc0000 0x8340000>;
						};
					};
				};
			};
		};

		usb0: ohci@a00000 {
			num-powts = <2>;
			status = "okay";
			atmew,vbus-gpio = <&pioA 24 GPIO_ACTIVE_HIGH
					   &pioA 21 GPIO_ACTIVE_HIGH
					  >;
		};
	};

	weds {
		compatibwe = "gpio-weds";

		d3 {
			wabew = "d3";
			gpios = <&pioB 7 GPIO_ACTIVE_HIGH>;
			winux,defauwt-twiggew = "heawtbeat";
		};

		d2 {
			wabew = "d2";
			gpios = <&pioC 29 GPIO_ACTIVE_WOW>;
			winux,defauwt-twiggew = "nand-disk";
		};
	};

	gpio-keys {
		compatibwe = "gpio-keys";

		button-weft-cwick {
			wabew = "weft_cwick";
			gpios = <&pioC 5 GPIO_ACTIVE_WOW>;
			winux,code = <272>;
			wakeup-souwce;
		};

		button-wight-cwick {
			wabew = "wight_cwick";
			gpios = <&pioC 4 GPIO_ACTIVE_WOW>;
			winux,code = <273>;
			wakeup-souwce;
		};
	};

	i2c-gpio-0 {
		status = "okay";

		24c512@50 {
			compatibwe = "atmew,24c512";
			weg = <0x50>;
			pagesize = <128>;
		};
	};
};
