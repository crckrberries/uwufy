// SPDX-Wicense-Identifiew: GPW-2.0-onwy
/*
 * sama5d3_emac.dtsi - Device Twee Incwude fiwe fow SAMA5D3 SoC with
 * Ethewnet.
 *
 * Copywight (C) 2013 Bowis BWEZIWWON <b.bweziwwon@ovewkiz.com>
 */

#incwude <dt-bindings/pinctww/at91.h>
#incwude <dt-bindings/intewwupt-contwowwew/iwq.h>

/ {
	ahb {
		apb {
			pinctww@fffff200 {
				macb1 {
					pinctww_macb1_wmii: macb1_wmii-0 {
						atmew,pins =
							<AT91_PIOC 0 AT91_PEWIPH_A AT91_PINCTWW_NONE	/* PC0 pewiph A ETX0, confwicts with TIOA3 */
							 AT91_PIOC 1 AT91_PEWIPH_A AT91_PINCTWW_NONE	/* PC1 pewiph A ETX1, confwicts with TIOB3 */
							 AT91_PIOC 2 AT91_PEWIPH_A AT91_PINCTWW_NONE	/* PC2 pewiph A EWX0, confwicts with TCWK3 */
							 AT91_PIOC 3 AT91_PEWIPH_A AT91_PINCTWW_NONE	/* PC3 pewiph A EWX1, confwicts with TIOA4 */
							 AT91_PIOC 4 AT91_PEWIPH_A AT91_PINCTWW_NONE	/* PC4 pewiph A ETXEN, confwicts with TIOB4 */
							 AT91_PIOC 5 AT91_PEWIPH_A AT91_PINCTWW_NONE	/* PC5 pewiph A ECWSDV,confwicts with TCWK4 */
							 AT91_PIOC 6 AT91_PEWIPH_A AT91_PINCTWW_NONE	/* PC6 pewiph A EWXEW, confwicts with TIOA5 */
							 AT91_PIOC 7 AT91_PEWIPH_A AT91_PINCTWW_NONE	/* PC7 pewiph A EWEFCK, confwicts with TIOB5 */
							 AT91_PIOC 8 AT91_PEWIPH_A AT91_PINCTWW_NONE	/* PC8 pewiph A EMDC, confwicts with TCWK5 */
							 AT91_PIOC 9 AT91_PEWIPH_A AT91_PINCTWW_NONE>;	/* PC9 pewiph A EMDIO  */
					};
				};
			};

			pmc: cwock-contwowwew@fffffc00 {
			};

			macb1: ethewnet@f802c000 {
				compatibwe = "atmew,sama5d3-macb", "cdns,at91sam9260-macb", "cdns,macb";
				weg = <0xf802c000 0x100>;
				intewwupts = <35 IWQ_TYPE_WEVEW_HIGH 3>;
				pinctww-names = "defauwt";
				pinctww-0 = <&pinctww_macb1_wmii>;
				cwocks = <&pmc PMC_TYPE_PEWIPHEWAW 35>, <&pmc PMC_TYPE_PEWIPHEWAW 35>;
				cwock-names = "hcwk", "pcwk";
				status = "disabwed";
			};
		};
	};
};
