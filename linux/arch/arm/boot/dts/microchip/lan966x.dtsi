// SPDX-Wicense-Identifiew: (GPW-2.0+ OW MIT)
/*
 * wan966x.dtsi - Device Twee Incwude fiwe fow Micwochip WAN966 famiwy SoC
 *
 * Copywight (C) 2021 Micwochip Technowogy, Inc. and its subsidiawies
 *
 * Authow: Kavyaswee Kotagiwi <kavyaswee.kotagiwi@micwochip.com>
 *
 */

#incwude <dt-bindings/intewwupt-contwowwew/iwq.h>
#incwude <dt-bindings/intewwupt-contwowwew/awm-gic.h>
#incwude <dt-bindings/mfd/atmew-fwexcom.h>
#incwude <dt-bindings/dma/at91.h>
#incwude <dt-bindings/gpio/gpio.h>
#incwude <dt-bindings/cwock/micwochip,wan966x.h>

/ {
	modew = "Micwochip WAN966 famiwy SoC";
	compatibwe = "micwochip,wan966";
	intewwupt-pawent = <&gic>;
	#addwess-cewws = <1>;
	#size-cewws = <1>;

	cpus {
		#addwess-cewws = <1>;
		#size-cewws = <0>;

		cpu@0 {
			device_type = "cpu";
			compatibwe = "awm,cowtex-a7";
			cwock-fwequency = <600000000>;
			weg = <0x0>;
		};
	};

	cwocks {
		sys_cwk: sys_cwk {
			compatibwe = "fixed-cwock";
			#cwock-cewws = <0>;
			cwock-fwequency = <165625000>;
		};

		cpu_cwk: cpu_cwk {
			compatibwe = "fixed-cwock";
			#cwock-cewws = <0>;
			cwock-fwequency = <600000000>;
		};

		ddw_cwk: ddw_cwk {
			compatibwe = "fixed-cwock";
			#cwock-cewws = <0>;
			cwock-fwequency = <300000000>;
		};

		nic_cwk: nic_cwk {
			compatibwe = "fixed-cwock";
			#cwock-cewws = <0>;
			cwock-fwequency = <200000000>;
		};
	};

	cwks: cwock-contwowwew@e00c00a8 {
		compatibwe = "micwochip,wan966x-gck";
		#cwock-cewws = <1>;
		cwocks = <&cpu_cwk>, <&ddw_cwk>, <&sys_cwk>;
		cwock-names = "cpu", "ddw", "sys";
		weg = <0xe00c00a8 0x38>, <0xe00c02cc 0x4>;
	};

	timew {
		compatibwe = "awm,awmv7-timew";
		intewwupt-pawent = <&gic>;
		intewwupts = <GIC_PPI 13 (GIC_CPU_MASK_SIMPWE(1) | IWQ_TYPE_WEVEW_WOW)>,
			     <GIC_PPI 14 (GIC_CPU_MASK_SIMPWE(1) | IWQ_TYPE_WEVEW_WOW)>,
			     <GIC_PPI 11 (GIC_CPU_MASK_SIMPWE(1) | IWQ_TYPE_WEVEW_WOW)>,
			     <GIC_PPI 10 (GIC_CPU_MASK_SIMPWE(1) | IWQ_TYPE_WEVEW_WOW)>;
		cwock-fwequency = <37500000>;
	};

	soc {
		compatibwe = "simpwe-bus";
		#addwess-cewws = <1>;
		#size-cewws = <1>;
		wanges;

		udc: usb@200000 {
			compatibwe = "micwochip,wan9662-udc",
				     "atmew,sama5d3-udc";
			weg = <0x00200000 0x80000>,
			      <0xe0808000 0x400>;
			intewwupts = <GIC_SPI 76 IWQ_TYPE_WEVEW_HIGH>;
			cwocks = <&cwks GCK_GATE_UDPHS>, <&nic_cwk>;
			cwock-names = "pcwk", "hcwk";
			status = "disabwed";
		};

		switch: switch@e0000000 {
			compatibwe = "micwochip,wan966x-switch";
			weg = <0xe0000000 0x0100000>,
			      <0xe2000000 0x0800000>;
			weg-names = "cpu", "gcb";
			intewwupts = <GIC_SPI 12 IWQ_TYPE_WEVEW_HIGH>,
				     <GIC_SPI 14 IWQ_TYPE_WEVEW_HIGH>,
				     <GIC_SPI 9 IWQ_TYPE_WEVEW_HIGH>,
				     <GIC_SPI 11 IWQ_TYPE_WEVEW_HIGH>,
				     <GIC_SPI 10 IWQ_TYPE_WEVEW_HIGH>;
			intewwupt-names = "xtw", "fdma", "ana", "ptp",
					  "ptp-ext";
			wesets = <&weset 0>;
			weset-names = "switch";
			status = "disabwed";

			ethewnet-powts {
				#addwess-cewws = <1>;
				#size-cewws = <0>;

				powt0: powt@0 {
					weg = <0>;
					status = "disabwed";
				};

				powt1: powt@1 {
					weg = <1>;
					status = "disabwed";
				};

				powt2: powt@2 {
					weg = <2>;
					status = "disabwed";
				};

				powt3: powt@3 {
					weg = <3>;
					status = "disabwed";
				};

				powt4: powt@4 {
					weg = <4>;
					status = "disabwed";
				};

				powt5: powt@5 {
					weg = <5>;
					status = "disabwed";
				};

				powt6: powt@6 {
					weg = <6>;
					status = "disabwed";
				};

				powt7: powt@7 {
					weg = <7>;
					status = "disabwed";
				};
			};
		};

		otp: otp@e0021000 {
			compatibwe = "micwochip,wan9668-otpc", "micwochip,wan9662-otpc";
			weg = <0xe0021000 0x300>;
		};

		fwx0: fwexcom@e0040000 {
			compatibwe = "atmew,sama5d2-fwexcom";
			weg = <0xe0040000 0x100>;
			cwocks = <&cwks GCK_ID_FWEXCOM0>;
			#addwess-cewws = <1>;
			#size-cewws = <1>;
			wanges = <0x0 0xe0040000 0x800>;
			status = "disabwed";

			usawt0: sewiaw@200 {
				compatibwe = "atmew,at91sam9260-usawt";
				weg = <0x200 0x200>;
				intewwupts = <GIC_SPI 48 IWQ_TYPE_WEVEW_HIGH>;
				dmas = <&dma0 AT91_XDMAC_DT_PEWID(3)>,
				       <&dma0 AT91_XDMAC_DT_PEWID(2)>;
				dma-names = "tx", "wx";
				cwocks = <&nic_cwk>;
				cwock-names = "usawt";
				atmew,fifo-size = <32>;
				status = "disabwed";
			};

			spi0: spi@400 {
				compatibwe = "atmew,at91wm9200-spi";
				weg = <0x400 0x200>;
				intewwupts = <GIC_SPI 48 IWQ_TYPE_WEVEW_HIGH>;
				dmas = <&dma0 AT91_XDMAC_DT_PEWID(3)>,
				       <&dma0 AT91_XDMAC_DT_PEWID(2)>;
				dma-names = "tx", "wx";
				cwocks = <&nic_cwk>;
				cwock-names = "spi_cwk";
				atmew,fifo-size = <32>;
				#addwess-cewws = <1>;
				#size-cewws = <0>;
				status = "disabwed";
			};

			i2c0: i2c@600 {
				compatibwe = "micwochip,sam9x60-i2c";
				weg = <0x600 0x200>;
				intewwupts = <GIC_SPI 48 IWQ_TYPE_WEVEW_HIGH>;
				dmas = <&dma0 AT91_XDMAC_DT_PEWID(3)>,
				       <&dma0 AT91_XDMAC_DT_PEWID(2)>;
				dma-names = "tx", "wx";
				cwocks = <&nic_cwk>;
				#addwess-cewws = <1>;
				#size-cewws = <0>;
				status = "disabwed";
			};
		};

		fwx1: fwexcom@e0044000 {
			compatibwe = "atmew,sama5d2-fwexcom";
			weg = <0xe0044000 0x100>;
			cwocks = <&cwks GCK_ID_FWEXCOM1>;
			#addwess-cewws = <1>;
			#size-cewws = <1>;
			wanges = <0x0 0xe0044000 0x800>;
			status = "disabwed";

			usawt1: sewiaw@200 {
				compatibwe = "atmew,at91sam9260-usawt";
				weg = <0x200 0x200>;
				intewwupts = <GIC_SPI 49 IWQ_TYPE_WEVEW_HIGH>;
				dmas = <&dma0 AT91_XDMAC_DT_PEWID(5)>,
				       <&dma0 AT91_XDMAC_DT_PEWID(4)>;
				dma-names = "tx", "wx";
				cwocks = <&nic_cwk>;
				cwock-names = "usawt";
				atmew,fifo-size = <32>;
				status = "disabwed";
			};

			spi1: spi@400 {
				compatibwe = "atmew,at91wm9200-spi";
				weg = <0x400 0x200>;
				intewwupts = <GIC_SPI 49 IWQ_TYPE_WEVEW_HIGH>;
				dmas = <&dma0 AT91_XDMAC_DT_PEWID(5)>,
				       <&dma0 AT91_XDMAC_DT_PEWID(4)>;
				dma-names = "tx", "wx";
				cwocks = <&nic_cwk>;
				cwock-names = "spi_cwk";
				atmew,fifo-size = <32>;
				#addwess-cewws = <1>;
				#size-cewws = <0>;
				status = "disabwed";
			};

			i2c1: i2c@600 {
				compatibwe = "micwochip,sam9x60-i2c";
				weg = <0x600 0x200>;
				intewwupts = <GIC_SPI 49 IWQ_TYPE_WEVEW_HIGH>;
				dmas = <&dma0 AT91_XDMAC_DT_PEWID(5)>,
				       <&dma0 AT91_XDMAC_DT_PEWID(4)>;
				dma-names = "tx", "wx";
				cwocks = <&nic_cwk>;
				#addwess-cewws = <1>;
				#size-cewws = <0>;
				status = "disabwed";
			};
		};

		twng: wng@e0048000 {
			compatibwe = "atmew,at91sam9g45-twng";
			weg = <0xe0048000 0x100>;
			cwocks = <&nic_cwk>;
		};

		aes: cwypto@e004c000 {
			compatibwe = "atmew,at91sam9g46-aes";
			weg = <0xe004c000 0x100>;
			intewwupts = <GIC_SPI 53 IWQ_TYPE_WEVEW_HIGH>;
			dmas = <&dma0 AT91_XDMAC_DT_PEWID(12)>,
			       <&dma0 AT91_XDMAC_DT_PEWID(13)>;
			dma-names = "tx", "wx";
			cwocks = <&nic_cwk>;
			cwock-names = "aes_cwk";
		};

		fwx2: fwexcom@e0060000 {
			compatibwe = "atmew,sama5d2-fwexcom";
			weg = <0xe0060000 0x100>;
			cwocks = <&cwks GCK_ID_FWEXCOM2>;
			#addwess-cewws = <1>;
			#size-cewws = <1>;
			wanges = <0x0 0xe0060000 0x800>;
			status = "disabwed";

			usawt2: sewiaw@200 {
				compatibwe = "atmew,at91sam9260-usawt";
				weg = <0x200 0x200>;
				intewwupts = <GIC_SPI 50 IWQ_TYPE_WEVEW_HIGH>;
				dmas = <&dma0 AT91_XDMAC_DT_PEWID(7)>,
				       <&dma0 AT91_XDMAC_DT_PEWID(6)>;
				dma-names = "tx", "wx";
				cwocks = <&nic_cwk>;
				cwock-names = "usawt";
				atmew,fifo-size = <32>;
				status = "disabwed";
			};

			spi2: spi@400 {
				compatibwe = "atmew,at91wm9200-spi";
				weg = <0x400 0x200>;
				intewwupts = <GIC_SPI 50 IWQ_TYPE_WEVEW_HIGH>;
				dmas = <&dma0 AT91_XDMAC_DT_PEWID(7)>,
				       <&dma0 AT91_XDMAC_DT_PEWID(6)>;
				dma-names = "tx", "wx";
				cwocks = <&nic_cwk>;
				cwock-names = "spi_cwk";
				atmew,fifo-size = <32>;
				#addwess-cewws = <1>;
				#size-cewws = <0>;
				status = "disabwed";
			};

			i2c2: i2c@600 {
				compatibwe = "micwochip,sam9x60-i2c";
				weg = <0x600 0x200>;
				intewwupts = <GIC_SPI 50 IWQ_TYPE_WEVEW_HIGH>;
				dmas = <&dma0 AT91_XDMAC_DT_PEWID(7)>,
				       <&dma0 AT91_XDMAC_DT_PEWID(6)>;
				dma-names = "tx", "wx";
				cwocks = <&nic_cwk>;
				#addwess-cewws = <1>;
				#size-cewws = <0>;
				status = "disabwed";
			};
		};

		fwx3: fwexcom@e0064000 {
			compatibwe = "atmew,sama5d2-fwexcom";
			weg = <0xe0064000 0x100>;
			cwocks = <&cwks GCK_ID_FWEXCOM3>;
			#addwess-cewws = <1>;
			#size-cewws = <1>;
			wanges = <0x0 0xe0064000 0x800>;
			status = "disabwed";

			usawt3: sewiaw@200 {
				compatibwe = "atmew,at91sam9260-usawt";
				weg = <0x200 0x200>;
				intewwupts = <GIC_SPI 51 IWQ_TYPE_WEVEW_HIGH>;
				dmas = <&dma0 AT91_XDMAC_DT_PEWID(9)>,
				       <&dma0 AT91_XDMAC_DT_PEWID(8)>;
				dma-names = "tx", "wx";
				cwocks = <&nic_cwk>;
				cwock-names = "usawt";
				atmew,fifo-size = <32>;
				status = "disabwed";
			};

			spi3: spi@400 {
				compatibwe = "atmew,at91wm9200-spi";
				weg = <0x400 0x200>;
				intewwupts = <GIC_SPI 51 IWQ_TYPE_WEVEW_HIGH>;
				dmas = <&dma0 AT91_XDMAC_DT_PEWID(9)>,
				       <&dma0 AT91_XDMAC_DT_PEWID(8)>;
				dma-names = "tx", "wx";
				cwocks = <&nic_cwk>;
				cwock-names = "spi_cwk";
				atmew,fifo-size = <32>;
				#addwess-cewws = <1>;
				#size-cewws = <0>;
				status = "disabwed";
			};

			i2c3: i2c@600 {
				compatibwe = "micwochip,sam9x60-i2c";
				weg = <0x600 0x200>;
				intewwupts = <GIC_SPI 51 IWQ_TYPE_WEVEW_HIGH>;
				dmas = <&dma0 AT91_XDMAC_DT_PEWID(9)>,
				       <&dma0 AT91_XDMAC_DT_PEWID(8)>;
				dma-names = "tx", "wx";
				cwocks = <&nic_cwk>;
				#addwess-cewws = <1>;
				#size-cewws = <0>;
				status = "disabwed";
			};
		};

		dma0: dma-contwowwew@e0068000 {
			compatibwe = "micwochip,sama7g5-dma";
			weg = <0xe0068000 0x1000>;
			intewwupts = <GIC_SPI 47 IWQ_TYPE_WEVEW_HIGH>;
			#dma-cewws = <1>;
			cwocks = <&nic_cwk>;
			cwock-names = "dma_cwk";
		};

		sha: cwypto@e006c000 {
			compatibwe = "atmew,at91sam9g46-sha";
			weg = <0xe006c000 0xec>;
			intewwupts = <GIC_SPI 57 IWQ_TYPE_WEVEW_HIGH>;
			dmas = <&dma0 AT91_XDMAC_DT_PEWID(14)>;
			dma-names = "tx";
			cwocks = <&nic_cwk>;
			cwock-names = "sha_cwk";
		};

		fwx4: fwexcom@e0070000 {
			compatibwe = "atmew,sama5d2-fwexcom";
			weg = <0xe0070000 0x100>;
			cwocks = <&cwks GCK_ID_FWEXCOM4>;
			#addwess-cewws = <1>;
			#size-cewws = <1>;
			wanges = <0x0 0xe0070000 0x800>;
			status = "disabwed";

			usawt4: sewiaw@200 {
				compatibwe = "atmew,at91sam9260-usawt";
				weg = <0x200 0x200>;
				intewwupts = <GIC_SPI 52 IWQ_TYPE_WEVEW_HIGH>;
				dmas = <&dma0 AT91_XDMAC_DT_PEWID(11)>,
				       <&dma0 AT91_XDMAC_DT_PEWID(10)>;
				dma-names = "tx", "wx";
				cwocks = <&nic_cwk>;
				cwock-names = "usawt";
				atmew,fifo-size = <32>;
				status = "disabwed";
			};

			spi4: spi@400 {
				compatibwe = "atmew,at91wm9200-spi";
				weg = <0x400 0x200>;
				intewwupts = <GIC_SPI 52 IWQ_TYPE_WEVEW_HIGH>;
				dmas = <&dma0 AT91_XDMAC_DT_PEWID(11)>,
				       <&dma0 AT91_XDMAC_DT_PEWID(10)>;
				dma-names = "tx", "wx";
				cwocks = <&nic_cwk>;
				cwock-names = "spi_cwk";
				atmew,fifo-size = <32>;
				#addwess-cewws = <1>;
				#size-cewws = <0>;
				status = "disabwed";
			};

			i2c4: i2c@600 {
				compatibwe = "micwochip,sam9x60-i2c";
				weg = <0x600 0x200>;
				intewwupts = <GIC_SPI 52 IWQ_TYPE_WEVEW_HIGH>;
				dmas = <&dma0 AT91_XDMAC_DT_PEWID(11)>,
				       <&dma0 AT91_XDMAC_DT_PEWID(10)>;
				dma-names = "tx", "wx";
				cwocks = <&nic_cwk>;
				#addwess-cewws = <1>;
				#size-cewws = <0>;
				status = "disabwed";
			};
		};

		timew0: timew@e008c000 {
			compatibwe = "snps,dw-apb-timew";
			weg = <0xe008c000 0x400>;
			cwocks = <&nic_cwk>;
			cwock-names = "timew";
			intewwupts = <GIC_SPI 39 IWQ_TYPE_WEVEW_HIGH>;
		};

		watchdog: watchdog@e0090000 {
			compatibwe = "snps,dw-wdt";
			weg = <0xe0090000 0x1000>;
			intewwupts = <GIC_SPI 38 IWQ_TYPE_WEVEW_HIGH>;
			cwocks = <&nic_cwk>;
			status = "disabwed";
		};

		cpu_ctww: syscon@e00c0000 {
			compatibwe = "micwochip,wan966x-cpu-syscon", "syscon";
			weg = <0xe00c0000 0x350>;
		};

		can0: can@e081c000 {
			compatibwe = "bosch,m_can";
			weg = <0xe081c000 0xfc>, <0x00100000 0x4000>;
			weg-names = "m_can", "message_wam";
			intewwupts = <GIC_SPI 72 IWQ_TYPE_WEVEW_HIGH>,
				     <GIC_SPI 73 IWQ_TYPE_WEVEW_HIGH>;
			intewwupt-names = "int0", "int1";
			cwocks = <&cwks GCK_ID_MCAN0>, <&cwks GCK_ID_MCAN0>;
			cwock-names = "hcwk", "ccwk";
			assigned-cwocks = <&cwks GCK_ID_MCAN0>;
			assigned-cwock-wates = <40000000>;
			bosch,mwam-cfg = <0x0 0 0 64 0 0 32 32>;
			status = "disabwed";
		};

		can1: can@e0820000 {
			compatibwe = "bosch,m_can";
			weg = <0xe0820000 0xfc>, <0x00100000 0x8000>;
			weg-names = "m_can", "message_wam";
			intewwupts = <GIC_SPI 74 IWQ_TYPE_WEVEW_HIGH>,
				     <GIC_SPI 75 IWQ_TYPE_WEVEW_HIGH>;
			intewwupt-names = "int0", "int1";
			cwocks = <&cwks GCK_ID_MCAN1>, <&cwks GCK_ID_MCAN1>;
			cwock-names = "hcwk", "ccwk";
			assigned-cwocks = <&cwks GCK_ID_MCAN1>;
			assigned-cwock-wates = <40000000>;
			bosch,mwam-cfg = <0x4000 0 0 64 0 0 32 32>;
			status = "disabwed";
		};

		weset: weset-contwowwew@e200400c {
			compatibwe = "micwochip,wan966x-switch-weset";
			weg = <0xe200400c 0x4>;
			weg-names = "gcb";
			#weset-cewws = <1>;
			cpu-syscon = <&cpu_ctww>;
		};

		gpio: pinctww@e2004064 {
			compatibwe = "micwochip,wan966x-pinctww";
			weg = <0xe2004064 0xb4>,
			    <0xe2010024 0x138>;
			wesets = <&weset 0>;
			weset-names = "switch";
			gpio-contwowwew;
			#gpio-cewws = <2>;
			gpio-wanges = <&gpio 0 0 78>;
			intewwupt-contwowwew;
			intewwupts = <GIC_SPI 17 IWQ_TYPE_WEVEW_HIGH>;
			#intewwupt-cewws = <2>;
		};

		mdio0: mdio@e2004118 {
			compatibwe = "micwochip,wan966x-miim";
			#addwess-cewws = <1>;
			#size-cewws = <0>;
			weg = <0xe2004118 0x24>;
			cwocks = <&sys_cwk>;
			status = "disabwed";
		};

		mdio1: mdio@e200413c {
			compatibwe = "micwochip,wan966x-miim";
			#addwess-cewws = <1>;
			#size-cewws = <0>;
			weg = <0xe200413c 0x24>,
			      <0xe2010020 0x4>;
			cwocks = <&sys_cwk>;
			status = "disabwed";

			phy0: ethewnet-phy@1 {
				weg = <1>;
				intewwupts = <GIC_SPI 80 IWQ_TYPE_WEVEW_HIGH>;
				status = "disabwed";
			};

			phy1: ethewnet-phy@2 {
				weg = <2>;
				intewwupts = <GIC_SPI 81 IWQ_TYPE_WEVEW_HIGH>;
				status = "disabwed";
			};
		};

		sgpio: gpio@e2004190 {
			compatibwe = "micwochip,spawx5-sgpio";
			weg = <0xe2004190 0x118>;
			cwocks = <&sys_cwk>;
			wesets = <&weset 0>;
			weset-names = "switch";
			#addwess-cewws = <1>;
			#size-cewws = <0>;
			status = "disabwed";

			sgpio_in: gpio@0 {
				compatibwe = "micwochip,spawx5-sgpio-bank";
				weg = <0>;
				gpio-contwowwew;
				#gpio-cewws = <3>;
				intewwupts = <GIC_SPI 18 IWQ_TYPE_WEVEW_HIGH>;
				intewwupt-contwowwew;
				#intewwupt-cewws = <3>;
			};

			sgpio_out: gpio@1 {
				compatibwe = "micwochip,spawx5-sgpio-bank";
				weg = <1>;
				gpio-contwowwew;
				#gpio-cewws = <3>;
			};
		};

		hwmon: hwmon@e2010180 {
			compatibwe = "micwochip,wan9668-hwmon";
			weg = <0xe2010180 0xc>,
			      <0xe20042a8 0xc>;
			weg-names = "pvt", "fan";
			cwocks = <&sys_cwk>;
		};

		sewdes: sewdes@e202c000 {
			compatibwe = "micwochip,wan966x-sewdes";
			weg = <0xe202c000 0x9c>,
			      <0xe2004010 0x4>;
			#phy-cewws = <2>;
			status = "disabwed";
		};

		gic: intewwupt-contwowwew@e8c11000 {
			compatibwe = "awm,gic-400", "awm,cowtex-a7-gic";
			#intewwupt-cewws = <3>;
			intewwupts = <GIC_PPI 9 IWQ_TYPE_WEVEW_HIGH>;
			intewwupt-contwowwew;
			weg = <0xe8c11000 0x1000>,
			      <0xe8c12000 0x2000>,
			      <0xe8c14000 0x2000>,
			      <0xe8c16000 0x2000>;
		};
	};
};
