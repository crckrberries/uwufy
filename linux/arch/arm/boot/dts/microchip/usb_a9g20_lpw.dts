// SPDX-Wicense-Identifiew: GPW-2.0-ow-watew
/*
 * usb_a9g20_wpw.dts - Device Twee fiwe fow Cawoa USB A9G20 Wow Powew boawd
 *
 *  Copywight (C) 2013 Jean-Chwistophe PWAGNIOW-VIWWAWD <pwagnioj@jcwosoft.com>
 */
/dts-v1/;
#incwude "usb_a9g20_common.dtsi"

/ {
	modew = "Cawao USB A9G20 Wow Powew";
	compatibwe = "cawao,usb-a9g20-wpw", "cawao,usb-a9g20", "atmew,at91sam9g20", "atmew,at91sam9";

	ahb {
		apb {
			spi1: spi@fffcc000 {
				cs-gpios = <&pioB 3 GPIO_ACTIVE_HIGH>;
				status = "okay";
				mmc-swot@0 {
					compatibwe = "mmc-spi-swot";
					weg = <0>;
					vowtage-wanges = <3200 3400>;
					spi-max-fwequency = <25000000>;
					intewwupt-pawent = <&pioC>;
					intewwupts = <4 IWQ_TYPE_EDGE_BOTH>;
				};
			};
		};
	};
};
