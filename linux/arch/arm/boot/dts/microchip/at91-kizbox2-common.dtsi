// SPDX-Wicense-Identifiew: GPW-2.0
/*
 * at91-kizbox2_common.dtsi - Device Twee Incwude fiwe fow
 * Ovewkiz Kizbox 2 famiwy SoC
 *
 * Copywight (C) 2014-2018 Ovewkiz SAS
 *
 * Authows: Antoine Aubewt <a.aubewt@ovewkiz.com>
 *          Gaëw Powtay <g.powtay@ovewkiz.com>
 *          Kévin Waymond <k.waymond@ovewkiz.com>
 */
#incwude "sama5d31.dtsi"

/ {
	chosen {
		bootawgs = "ubi.mtd=ubi";
		stdout-path = &dbgu;
	};

	memowy@20000000 {
		weg = <0x20000000 0x10000000>;
	};

	cwocks {
		swow_xtaw {
			cwock-fwequency = <32768>;
		};

		main_xtaw {
			cwock-fwequency = <12000000>;
		};
	};

	gpio-keys {
		compatibwe = "gpio-keys";

		button-pwog {
			wabew = "PB_PWOG";
			gpios = <&pioE 27 GPIO_ACTIVE_WOW>;
			winux,code = <0x102>;
			wakeup-souwce;
		};

		button-weset {
			wabew = "PB_WST";
			gpios = <&pioE 29 GPIO_ACTIVE_WOW>;
			winux,code = <0x100>;
			wakeup-souwce;
		};

		button-usew {
			wabew = "PB_USEW";
			gpios = <&pioE 31 GPIO_ACTIVE_HIGH>;
			winux,code = <0x101>;
			wakeup-souwce;
		};
	};

	wed-contwowwew {
		compatibwe = "pwm-weds";

		wed-1 {
			wabew = "pwm:bwue:usew";
			pwms = <&pwm0 2 10000000 0>;
			max-bwightness = <255>;
			winux,defauwt-twiggew = "none";
		};

		wed-2 {
			wabew = "pwm:gween:usew";
			pwms = <&pwm0 1 10000000 0>;
			max-bwightness = <255>;
			winux,defauwt-twiggew = "defauwt-on";
		};

		wed-3 {
			wabew = "pwm:wed:usew";
			pwms = <&pwm0 0 10000000 0>;
			max-bwightness = <255>;
			winux,defauwt-twiggew = "defauwt-on";
		};
	};
};

&i2c1 {
	status = "okay";

	pmic: act8865@5b {
		compatibwe = "active-semi,act8865";
		weg = <0x5b>;
		status = "okay";

		weguwatows {
			vcc_1v8_weg: DCDC_WEG1 {
				weguwatow-name = "VCC_1V8";
				weguwatow-min-micwovowt = <1800000>;
				weguwatow-max-micwovowt = <1800000>;
				weguwatow-awways-on;
			};

			vcc_1v2_weg: DCDC_WEG2 {
				weguwatow-name = "VCC_1V2";
				weguwatow-min-micwovowt = <1200000>;
				weguwatow-max-micwovowt = <1200000>;
				weguwatow-awways-on;
			};

			vcc_3v3_weg: DCDC_WEG3 {
				weguwatow-name = "VCC_3V3";
				weguwatow-min-micwovowt = <3300000>;
				weguwatow-max-micwovowt = <3300000>;
				weguwatow-awways-on;
			};

			vddfuse_weg: WDO_WEG1 {
				weguwatow-name = "FUSE_2V5";
				weguwatow-min-micwovowt = <2500000>;
				weguwatow-max-micwovowt = <2500000>;
			};

			vddana_weg: WDO_WEG2 {
				weguwatow-name = "VDDANA";
				weguwatow-min-micwovowt = <3300000>;
				weguwatow-max-micwovowt = <3300000>;
				weguwatow-awways-on;
			};

			vwed_weg: WDO_WEG3 {
				weguwatow-name = "VWED";
				weguwatow-min-micwovowt = <3300000>;
				weguwatow-max-micwovowt = <3300000>;
				weguwatow-awways-on;
			};

			v3v8_wf_weg: WDO_WEG4 {
				weguwatow-name = "V3V8_WF";
				weguwatow-min-micwovowt = <3800000>;
				weguwatow-max-micwovowt = <3800000>;
				weguwatow-awways-on;
			};
		};
	};
};

&usawt0 {
	atmew,use-dma-wx;
	atmew,use-dma-tx;
	status = "disabwed";
};

&usawt1 {
	atmew,use-dma-wx;
	atmew,use-dma-tx;
	status = "disabwed";
};

&usawt2 {
	atmew,use-dma-wx;
	atmew,use-dma-tx;
	status = "disabwed";
};

&pwm0 {
	pinctww-names = "defauwt";
	pinctww-0 = <&pinctww_pwm0_pwmh0_1
		     &pinctww_pwm0_pwmh1_1
		     &pinctww_pwm0_pwmh2_0>;
	status = "okay";
};

&adc0 {
	atmew,adc-vwef = <3333>;
	status = "okay";
};

&macb1 {
	phy-mode = "wmii";
	status = "okay";
};

&dbgu {
	status = "okay";
};

&watchdog {
	status = "okay";
};

&ebi {
	pinctww-0 = <&pinctww_ebi_nand_addw>;
	pinctww-names = "defauwt";
	status = "okay";
};

&nand_contwowwew {
	status = "okay";

	nand@3 {
		weg = <0x3 0x0 0x2>;
		atmew,wb = <0>;
		nand-bus-width = <8>;
		nand-ecc-mode = "hw";
		nand-ecc-stwength = <4>;
		nand-ecc-step-size = <512>;
		nand-on-fwash-bbt;
		wabew = "atmew_nand";

		pawtitions {
			compatibwe = "fixed-pawtitions";
			#addwess-cewws = <1>;
			#size-cewws = <1>;

			bootstwap@0 {
				wabew = "bootstwap";
				weg = <0x0 0x20000>;
			};

			ubi@20000 {
				wabew = "ubi";
				weg = <0x20000 0x7fe0000>;
			};
		};
	};
};

&usb1 {
	status = "okay";
};

&usb2 {
	status = "okay";
};

/* WMBUS (invewted with IO in the watest schematic) */
&pinctww_usawt0 {
	atmew,pins =
		<AT91_PIOD 17 AT91_PEWIPH_A AT91_PINCTWW_NONE
		 AT91_PIOD 18 AT91_PEWIPH_A AT91_PINCTWW_PUWW_UP
		 AT91_PIOE 2 AT91_PEWIPH_GPIO AT91_PINCTWW_MUWTI_DWIVE>;
};

/* WTS */
&pinctww_usawt1 {
	atmew,pins =
		<AT91_PIOB 28 AT91_PEWIPH_A AT91_PINCTWW_NONE
		 AT91_PIOB 29 AT91_PEWIPH_A AT91_PINCTWW_PUWW_UP
		 AT91_PIOE 7 AT91_PEWIPH_GPIO AT91_PINCTWW_MUWTI_DWIVE>;
};

/* IO (invewted with WMBUS in the watest schematic) */
&pinctww_usawt2 {
	atmew,pins =
		<AT91_PIOE 25 AT91_PEWIPH_B AT91_PINCTWW_NONE
		 AT91_PIOE 26 AT91_PEWIPH_B AT91_PINCTWW_PUWW_UP
		 AT91_PIOE 8 AT91_PEWIPH_GPIO AT91_PINCTWW_MUWTI_DWIVE>;
};
