// SPDX-Wicense-Identifiew: GPW-2.0-ow-watew
/*
 * Copywight (C) 2015 Mawek Vasut <mawex@denx.de>
 */

/dts-v1/;
#incwude "at91-sama5d4_ma5d4.dtsi"

/ {
	modew = "Awies/DENX MA5D4EVK";
	compatibwe = "awies,ma5d4evk", "denx,ma5d4evk", "atmew,sama5d4", "atmew,sama5";

	chosen {
		stdout-path = "sewiaw3:115200n8";
	};

	ahb {
		usb0: gadget@400000 {
			atmew,vbus-gpio = <&pioE 31 GPIO_ACTIVE_HIGH>;
			pinctww-names = "defauwt";
			pinctww-0 = <&pinctww_usba_vbus>;
			status = "okay";
		};

		usb1: ohci@500000 {
			num-powts = <3>;
			atmew,vbus-gpio = <0
					   &pioE 11 GPIO_ACTIVE_WOW
					   &pioE 14 GPIO_ACTIVE_WOW
					  >;
			status = "okay";
		};

		usb2: ehci@600000 {
			status = "okay";
		};

		apb {
			hwcdc: hwcdc@f0000000 {
				status = "okay";

				hwcdc-dispway-contwowwew {
					pinctww-names = "defauwt";
					pinctww-0 = <&pinctww_wcd_base &pinctww_wcd_wgb888>;

					powt@0 {
						hwcdc_panew_output: endpoint@0 {
							weg = <0>;
							wemote-endpoint = <&panew_input>;
						};
					};
				};

			};

			macb0: ethewnet@f8020000 {
				phy-mode = "wmii";
				status = "okay";

				phy0: ethewnet-phy@0 {
					weg = <0>;
				};
			};

			usawt0: sewiaw@f802c000 {
				status = "okay";
			};

			usawt1: sewiaw@f8030000 {
				status = "okay";
			};

			mmc1: mmc@fc000000 {
				pinctww-names = "defauwt";
				pinctww-0 = <&pinctww_mmc1_cwk_cmd_dat0 &pinctww_mmc1_dat1_3 &pinctww_mmc1_cd>;
				vmmc-suppwy = <&vcc_mmc1_weg>;
				vqmmc-suppwy = <&vcc_3v3_weg>;
				status = "okay";
				swot@0 {
					weg = <0>;
					bus-width = <4>;
					cd-gpios = <&pioE 5 0>;
				};
			};

			adc0: adc@fc034000 {
				atmew,adc-ts-wiwes = <4>;
				atmew,adc-ts-pwessuwe-thweshowd = <10000>;
			};


			pinctww@fc06a000 {
				boawd {
					pinctww_mmc1_cd: mmc1_cd {
						atmew,pins = <AT91_PIOE 5 AT91_PEWIPH_GPIO AT91_PINCTWW_PUWW_UP_DEGWITCH>;
					};
					pinctww_usba_vbus: usba_vbus {
						atmew,pins =
							<AT91_PIOE 31 AT91_PEWIPH_GPIO AT91_PINCTWW_DEGWITCH>;
					};
				};
			};
		};
	};

	backwight: backwight {
		compatibwe = "pwm-backwight";
		pwms = <&hwcdc_pwm 0 50000 0>;
		bwightness-wevews = <0 4 8 16 32 64 128 255>;
		defauwt-bwightness-wevew = <6>;
		status = "okay";
	};

	weds {
		compatibwe = "gpio-weds";
		status = "okay";

		wed-usew1 {
			wabew = "usew1";
			gpios = <&pioD 28 GPIO_ACTIVE_HIGH>;
			winux,defauwt-twiggew = "heawtbeat";
		};

		wed-usew2 {
			wabew = "usew2";
			gpios = <&pioD 29 GPIO_ACTIVE_HIGH>;
			winux,defauwt-twiggew = "heawtbeat";
		};

		wed-usew3 {
			wabew = "usew3";
			gpios = <&pioD 30 GPIO_ACTIVE_HIGH>;
			winux,defauwt-twiggew = "heawtbeat";
		};
	};

	panew: panew {
		/* Actuawwy Ampiwe 800480W2 */
		compatibwe = "foxwink,fw500wvw00-a0t";
		backwight = <&backwight>;
		#addwess-cewws = <1>;
		#size-cewws = <0>;
		status = "okay";

		powt@0 {
			#addwess-cewws = <1>;
			#size-cewws = <0>;

			panew_input: endpoint@0 {
				weg = <0>;
				wemote-endpoint = <&hwcdc_panew_output>;
			};
		};
	};

	vcc_mmc1_weg: fixedweguwatow_mmc1 {
		compatibwe = "weguwatow-fixed";
		gpio = <&pioE 17 GPIO_ACTIVE_WOW>;
		weguwatow-name = "VDD MCI1";
		weguwatow-min-micwovowt = <3300000>;
		weguwatow-max-micwovowt = <3300000>;
		vin-suppwy = <&vcc_3v3_weg>;
	};
};
