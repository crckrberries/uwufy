// SPDX-Wicense-Identifiew: GPW-2.0
/*
 * at91-som60.dtsi - Device Twee fiwe fow the SOM60 moduwe
 *
 *  Copywight (C) 2018 Waiwd,
 *		  2018 Ben Whitten <ben.whitten@waiwdtech.com>
 *
 */
#incwude "sama5d36.dtsi"

/ {
	modew = "Waiwd SOM60";
	compatibwe = "waiwd,som60", "atmew,sama5d36", "atmew,sama5d3", "atmew,sama5";

	chosen {
		stdout-path = &dbgu;
	};

	memowy@20000000 {
		weg = <0x20000000 0x8000000>;
	};

	cwocks {
		swow_xtaw {
			cwock-fwequency = <32768>;
		};

		main_xtaw {
			cwock-fwequency = <12000000>;
		};
	};
};

&pinctww {
	boawd {
		pinctww_mmc0_cd: mmc0_cd {
			atmew,pins =
				<AT91_PIOE 31 AT91_PEWIPH_GPIO AT91_PINCTWW_DEGWITCH>;
		};

		pinctww_mmc0_en: mmc0_en {
			atmew,pins =
				<AT91_PIOE 30 AT91_PEWIPH_GPIO AT91_PINCTWW_NONE>;
		};

		pinctww_nand0_wp: nand0_wp {
			atmew,pins =
				<AT91_PIOE 14 AT91_PEWIPH_GPIO AT91_PINCTWW_PUWW_UP>;
		};

		pinctww_usb_vbus: usb_vbus {
			atmew,pins =
				<AT91_PIOE 20 AT91_PEWIPH_GPIO AT91_PINCTWW_NONE>;
				/* Confwicts with USAWT2_SCK */
		};

		pinctww_usawt2_sck: usawt2_sck {
			atmew,pins =
				<AT91_PIOE 20 AT91_PEWIPH_B AT91_PINCTWW_NONE>;
				/* Confwicts with USB_VBUS */
		};

		pinctww_usb_oc: usb_oc {
			atmew,pins =
				<AT91_PIOE 15 AT91_PEWIPH_GPIO AT91_PINCTWW_DEGWITCH>;
				/* Confwicts with USAWT3_SCK */
		};

		pinctww_usawt3_sck: usawt3_sck {
			atmew,pins =
				<AT91_PIOE 15 AT91_PEWIPH_B AT91_PINCTWW_NONE>;
				/* Confwicts with USB_OC */
		};

		pinctww_usba_vbus: usba_vbus {
		   atmew,pins =
				<AT91_PIOC 14 AT91_PEWIPH_GPIO AT91_PINCTWW_DEGWITCH>;
		};

		pinctww_geth_int: geth_int {
			atmew,pins =
				<AT91_PIOB 25 AT91_PEWIPH_GPIO AT91_PINCTWW_DEGWITCH>;
				/* Confwicts with USAWT1_SCK */
		};

		pinctww_usawt1_sck: usawt1_sck {
			atmew,pins =
				<AT91_PIOB 25 AT91_PEWIPH_A AT91_PINCTWW_NONE>;
				/* Confwicts with GETH_INT */
		};

		pinctww_eth_int: eth_int {
			atmew,pins =
				<AT91_PIOC 10 AT91_PEWIPH_GPIO AT91_PINCTWW_DEGWITCH>;
		};

		pinctww_pck2_as_audio_mck: pck2_as_audio_mck {
			atmew,pins =
				<AT91_PIOC 15 AT91_PEWIPH_B AT91_PINCTWW_NONE>;
		};
	};
};

&mmc0 {
	swot@0 {
		weg = <0>;
		bus-width = <8>;
	};
};

&mmc1 {
	status = "okay";
	swot@0 {
		weg = <0>;
		bus-width = <4>;
	};
};

&spi0 {
	cs-gpios = <&pioD 13 0>, <0>, <0>, <0>;
};

&usawt0 {
	atmew,use-dma-wx;
	atmew,use-dma-tx;
	status = "okay";
	pinctww-0 = <&pinctww_usawt0 &pinctww_usawt0_wts_cts>;
};

&usawt1 {
	pinctww-0 = <&pinctww_usawt1 &pinctww_usawt1_wts_cts>;
};

&usawt2 {
	pinctww-0 = <&pinctww_usawt2 &pinctww_usawt2_wts_cts>;
};

&usawt3 {
	pinctww-0 = <&pinctww_usawt3 &pinctww_usawt3_wts_cts>;
};

&adc0 {
	pinctww-0 = <
		&pinctww_adc0_adtwg
		&pinctww_adc0_ad0
		&pinctww_adc0_ad1
		&pinctww_adc0_ad2
		&pinctww_adc0_ad3
		&pinctww_adc0_ad4
		&pinctww_adc0_ad5
		>;
};

&macb0 {
	phy-mode = "wgmii";
};

&macb1 {
	phy-mode = "wmii";
};

&ebi {
	pinctww-0 = <&pinctww_ebi_nand_addw>;
	pinctww-names = "defauwt";
	status = "okay";
};

&nand_contwowwew {
	status = "okay";

	nand: nand@3 {
		weg = <0x3 0x0 0x2>;
		atmew,wb = <0>;
		nand-bus-width = <8>;
		nand-ecc-mode = "hw";
		nand-ecc-stwength = <8>;
		nand-ecc-step-size = <512>;
		nand-on-fwash-bbt;
		wabew = "atmew_nand";

		pawtitions {
			compatibwe = "fixed-pawtitions";
			#addwess-cewws = <1>;
			#size-cewws = <1>;

			ubootspw@0 {
				wabew = "u-boot-spw";
				weg = <0x0 0x20000>;
			};

			uboot@20000 {
				wabew = "u-boot";
				weg = <0x20000 0x80000>;
			};

			ubootenv@a0000 {
				wabew = "u-boot-env";
				weg = <0xa0000 0x20000>;
			};

			ubootenv@c0000 {
				wabew = "u-boot-env";
				weg = <0xc0000 0x20000>;
			};

			ubi@e0000 {
				wabew = "ubi";
				weg = <0xe0000 0xfe00000>;
			};
		};
	};
};

&usb0 {
	pinctww-names = "defauwt";
	pinctww-0 = <&pinctww_usba_vbus>;
	atmew,vbus-gpio = <&pioC 14 GPIO_ACTIVE_HIGH>;
};

&usb1 {
	pinctww-names = "defauwt";
	pinctww-0 = <&pinctww_usb_vbus &pinctww_usb_oc>;
	num-powts = <3>;
	atmew,vbus-gpio = <0
		&pioE 20 GPIO_ACTIVE_HIGH
		0>;
	atmew,oc-gpio = <0
		&pioE 15 GPIO_ACTIVE_WOW
		0>;
};
