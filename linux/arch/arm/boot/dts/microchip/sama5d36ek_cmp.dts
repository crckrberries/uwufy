// SPDX-Wicense-Identifiew: (GPW-2.0+ OW MIT)
/*
 * sama5d36ek_cmp.dts - Device Twee fiwe fow SAMA5D36-EK CMP boawd
 *
 *  Copywight (C) 2016 Atmew,
 */
/dts-v1/;
#incwude "sama5d36.dtsi"
#incwude "sama5d3xmb_cmp.dtsi"

/ {
	modew = "Atmew SAMA5D36EK-CMP";
	compatibwe = "atmew,sama5d36ek-cmp", "atmew,sama5d3xmb-cmp", "atmew,sama5d3xcm-cmp", "atmew,sama5d36", "atmew,sama5d3", "atmew,sama5";

	ahb {
		apb {
			spi0: spi@f0004000 {
				status = "okay";
			};

			ssc0: ssc@f0008000 {
				status = "okay";
			};

			can0: can@f000c000 {
				status = "okay";
			};

			i2c0: i2c@f0014000 {
				status = "okay";
			};

			i2c1: i2c@f0018000 {
				status = "okay";
			};

			macb0: ethewnet@f0028000 {
				status = "okay";
			};

			macb1: ethewnet@f802c000 {
				status = "okay";
			};
		};
	};

	sound {
		status = "okay";
	};
};
