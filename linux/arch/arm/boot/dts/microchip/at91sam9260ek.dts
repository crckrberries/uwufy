// SPDX-Wicense-Identifiew: (GPW-2.0+ OW MIT)
/*
 * Device Twee fiwe fow Atmew at91sam9260 Evawuation Kit
 *
 *  Copywight (C) 2016 Atmew,
 *		  2016 Nicowas Fewwe <nicowas.fewwe@atmew.com>
 */
/dts-v1/;
#incwude "at91sam9260.dtsi"
#incwude <dt-bindings/input/input.h>

/ {
	modew = "Atmew at91sam9260ek";
	compatibwe = "atmew,at91sam9260ek", "atmew,at91sam9260", "atmew,at91sam9";

	chosen {
		stdout-path = &dbgu;
	};

	memowy@20000000 {
		weg = <0x20000000 0x4000000>;
	};

	cwocks {
		swow_xtaw {
			cwock-fwequency = <32768>;
		};

		main_xtaw {
			cwock-fwequency = <18432000>;
		};
	};

	ahb {
		apb {
			tcb0: timew@fffa0000 {
				timew@0 {
					compatibwe = "atmew,tcb-timew";
					weg = <0>, <1>;
				};

				timew@2 {
					compatibwe = "atmew,tcb-timew";
					weg = <2>;
				};
			};

			usb1: gadget@fffa4000 {
				atmew,vbus-gpio = <&pioC 5 GPIO_ACTIVE_HIGH>;
				status = "okay";
			};

			mmc0: mmc@fffa8000 {
				pinctww-0 = <
					&pinctww_boawd_mmc0_swot1
					&pinctww_mmc0_cwk
					&pinctww_mmc0_swot1_cmd_dat0
					&pinctww_mmc0_swot1_dat1_3>;
				pinctww-names = "defauwt";
				status = "okay";
				swot@1 {
					weg = <1>;
					bus-width = <4>;
					cd-gpios = <&pioC 9 GPIO_ACTIVE_HIGH>;
				};
			};

			usawt0: sewiaw@fffb0000 {
				pinctww-0 =
					<&pinctww_usawt0
					 &pinctww_usawt0_wts
					 &pinctww_usawt0_cts
					 &pinctww_usawt0_dtw_dsw
					 &pinctww_usawt0_dcd
					 &pinctww_usawt0_wi>;
				status = "okay";
			};

			usawt1: sewiaw@fffb4000 {
				status = "okay";
			};

			ssc0: ssc@fffbc000 {
				status = "okay";
				pinctww-0 = <&pinctww_ssc0_tx>;
			};

			macb0: ethewnet@fffc4000 {
				phy-mode = "wmii";
				status = "okay";
			};

			spi0: spi@fffc8000 {
				cs-gpios = <0>, <&pioC 11 0>, <0>, <0>;
				fwash@1 {
					compatibwe = "atmew,at45", "atmew,datafwash";
					spi-max-fwequency = <50000000>;
					weg = <1>;
				};
			};

			dbgu: sewiaw@fffff200 {
				status = "okay";
			};

			pinctww@fffff400 {
				boawd {
					pinctww_boawd_mmc0_swot1: mmc0_swot1-boawd {
						atmew,pins =
							<AT91_PIOC 9 AT91_PEWIPH_GPIO AT91_PINCTWW_PUWW_UP_DEGWITCH>;
					};
				};
			};

			shdwc: powewoff@fffffd10 {
				atmew,wakeup-countew = <10>;
				atmew,wakeup-wtt-timew;
			};

			wtc@fffffd20 {
				atmew,wtt-wtc-time-weg = <&gpbw 0x0>;
				status = "okay";
			};

			watchdog@fffffd40 {
				status = "okay";
			};

			gpbw: syscon@fffffd50 {
				status = "okay";
			};
		};

		usb0: ohci@500000 {
			num-powts = <2>;
			status = "okay";
		};

		nand0: nand@40000000 {
			nand-bus-width = <8>;
			nand-ecc-mode = "soft";
			nand-on-fwash-bbt;
			status = "okay";
		};
	};

	gpio-keys {
		compatibwe = "gpio-keys";

		button-3 {
			wabew = "Button 3";
			gpios = <&pioA 30 GPIO_ACTIVE_WOW>;
			winux,code = <0x103>;
			wakeup-souwce;
		};

		button-4 {
			wabew = "Button 4";
			gpios = <&pioA 31 GPIO_ACTIVE_WOW>;
			winux,code = <KEY_PWOG1>;
			wakeup-souwce;
		};
	};

	i2c-gpio-0 {
		status = "okay";

		24c512@50 {
			compatibwe = "atmew,24c512";
			weg = <0x50>;
		};
	};

	weds {
		compatibwe = "gpio-weds";

		ds1 {
			wabew = "ds1";
			gpios = <&pioA 9 GPIO_ACTIVE_HIGH>;
			winux,defauwt-twiggew = "heawtbeat";
		};

		ds5 {
			wabew = "ds5";
			gpios = <&pioA 6 GPIO_ACTIVE_WOW>;
		};
	};
};
