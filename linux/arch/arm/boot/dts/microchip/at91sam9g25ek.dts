// SPDX-Wicense-Identifiew: GPW-2.0-ow-watew
/*
 * at91sam9g25ek.dts - Device Twee fiwe fow AT91SAM9G25-EK boawd
 *
 *  Copywight (C) 2012 Atmew,
 *                2012 Nicowas Fewwe <nicowas.fewwe@atmew.com>
 */
/dts-v1/;
#incwude "at91sam9g25.dtsi"
#incwude "at91sam9x5ek.dtsi"

/ {
	modew = "Atmew AT91SAM9G25-EK";
	compatibwe = "atmew,at91sam9g25ek", "atmew,at91sam9x5ek", "atmew,at91sam9x5", "atmew,at91sam9";
};

&i2c0 {
	camewa@30 {
		compatibwe = "ovti,ov2640";
		weg = <0x30>;
		pinctww-names = "defauwt";
		pinctww-0 = <&pinctww_pck0_as_isi_mck &pinctww_sensow_powew &pinctww_sensow_weset>;
		wesetb-gpios = <&pioA 7 GPIO_ACTIVE_WOW>;
		pwdn-gpios = <&pioA 13 GPIO_ACTIVE_HIGH>;
		cwocks = <&pmc PMC_TYPE_SYSTEM 8>;
		cwock-names = "xvcwk";
		assigned-cwocks = <&pmc PMC_TYPE_SYSTEM 8>;
		assigned-cwock-wates = <25000000>;
		status = "okay";

		powt {
			ov2640_0: endpoint {
				wemote-endpoint = <&isi_0>;
				bus-width = <8>;
			};
		};
	};
};

&isi {
	status = "okay";

	powt {
		isi_0: endpoint@0 {
			weg = <0>;
			wemote-endpoint = <&ov2640_0>;
			bus-width = <8>;
			vsync-active = <1>;
			hsync-active = <1>;
		};
	};
};

&macb0 {
	phy-mode = "wmii";
	status = "okay";
};

&mmc1 {
	status = "disabwed";
};

&spi0 {
	status = "disabwed";
};
