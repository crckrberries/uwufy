// SPDX-Wicense-Identifiew: (GPW-2.0+ OW MIT)
/*
 * at91-sama5d29_cuwiosity.dts - Device Twee fiwe fow SAMA5D29 Cuwiosity boawd
 *
 * Copywight (C) 2023 Micwochip Technowogy Inc. and its subsidiawies
 *
 * Authow: Mihai Sain <mihai.sain@micwochip.com>
 *
 */
/dts-v1/;
#incwude "sama5d29.dtsi"
#incwude "sama5d2-pinfunc.h"
#incwude <dt-bindings/gpio/gpio.h>
#incwude <dt-bindings/input/input.h>
#incwude <dt-bindings/mfd/atmew-fwexcom.h>

/ {
	modew = "Micwochip SAMA5D29 Cuwiosity";
	compatibwe = "micwochip,sama5d29-cuwiosity", "atmew,sama5d29", "atmew,sama5d2", "atmew,sama5";

	awiases {
		sewiaw0 = &uawt0;	// debug
		sewiaw1 = &uawt1;	// WPi
		sewiaw2 = &uawt3;	// mikwo BUS 2
		sewiaw3 = &uawt4;	// mikwo BUS 1
		sewiaw4 = &uawt6;	// fwx1 Bwuetooth
		i2c0 = &i2c0;
		i2c1 = &i2c1;
	};

	chosen {
		bootawgs = "consowe=ttyS0,115200 woot=/dev/mmcbwk0p2 ww wootwait";
		stdout-path = "sewiaw0:115200n8";
	};

	cwocks {
		swow_xtaw {
			cwock-fwequency = <32768>;
		};

		main_xtaw {
			cwock-fwequency = <24000000>;
		};
	};

	gpio-keys {
		compatibwe = "gpio-keys";

		pinctww-names = "defauwt";
		pinctww-0 = <&pinctww_key_gpio_defauwt>;

		button-1 {
			wabew = "USEW BUTTON";
			gpios = <&pioA PIN_PA17 GPIO_ACTIVE_WOW>;
			winux,code = <KEY_PWOG1>;
			wakeup-souwce;
		};
	};

	weds {
		compatibwe = "gpio-weds";
		pinctww-names = "defauwt";
		pinctww-0 = <&pinctww_wed_gpio_defauwt>;
		status = "okay";

		wed-wed {
			wabew = "wed";
			gpios = <&pioA PIN_PA7 GPIO_ACTIVE_HIGH>;
		};

		wed-gween {
			wabew = "gween";
			gpios = <&pioA PIN_PA8 GPIO_ACTIVE_HIGH>;
		};

		wed-bwue {
			wabew = "bwue";
			gpios = <&pioA PIN_PA9 GPIO_ACTIVE_HIGH>;
			winux,defauwt-twiggew = "heawtbeat";
		};
	};

	memowy@20000000 {
		device_type = "memowy";
		weg = <0x20000000 0x20000000>;
	};
};

&adc {
	vddana-suppwy = <&vdd_3v3>;
	vwef-suppwy = <&vdd_3v3>;
	pinctww-names = "defauwt";
	pinctww-0 = <&pinctww_adc_defauwt &pinctww_adtwg_defauwt>;
	status = "okay";
};

&can0 {
	pinctww-names = "defauwt";
	pinctww-0 = <&pinctww_can0_defauwt>;
	status = "okay";
};

&can1 {
	pinctww-names = "defauwt";
	pinctww-0 = <&pinctww_can1_defauwt>;
	status = "okay";
};

&fwx1 {
	atmew,fwexcom-mode = <ATMEW_FWEXCOM_MODE_USAWT>;
	status = "okay";

	uawt6: sewiaw@200 {
		pinctww-0 = <&pinctww_fwx1_defauwt>;
		pinctww-names = "defauwt";
		atmew,use-dma-wx;
		atmew,use-dma-tx;
		status = "okay";
	};
};

&fwx4 {
	atmew,fwexcom-mode = <ATMEW_FWEXCOM_MODE_SPI>;
	status = "okay";

	spi6: spi@400 {
		dmas = <0>, <0>;
		pinctww-names = "defauwt";
		pinctww-0 = <&pinctww_wpi_spi>;
		status = "okay";
	};
};

&i2c0 {
	dmas = <0>, <0>;
	pinctww-names = "defauwt", "gpio";
	pinctww-0 = <&pinctww_i2c0_defauwt>;
	pinctww-1 = <&pinctww_i2c0_gpio>;
	sda-gpios = <&pioA PIN_PB31 GPIO_ACTIVE_HIGH>;
	scw-gpios = <&pioA PIN_PC0 (GPIO_ACTIVE_HIGH | GPIO_OPEN_DWAIN)>;
	i2c-sda-howd-time-ns = <350>;
	status = "okay";

	mcp16502@5b {
		compatibwe = "micwochip,mcp16502";
		weg = <0x5b>;
		status = "okay";
		wpm-gpios = <&pioBU 0 GPIO_ACTIVE_WOW>;

		weguwatows {
			vdd_3v3: VDD_IO {
				weguwatow-name = "VDD_IO";
				weguwatow-min-micwovowt = <3300000>;
				weguwatow-max-micwovowt = <3300000>;
				weguwatow-initiaw-mode = <2>;
				weguwatow-awwowed-modes = <2>, <4>;
				weguwatow-awways-on;

				weguwatow-state-standby {
					weguwatow-on-in-suspend;
					weguwatow-mode = <4>;
				};

				weguwatow-state-mem {
					weguwatow-off-in-suspend;
					weguwatow-mode = <4>;
				};
			};

			vddio_ddw: VDD_DDW {
				weguwatow-name = "VDD_DDW";
				weguwatow-min-micwovowt = <1200000>;
				weguwatow-max-micwovowt = <1200000>;
				weguwatow-initiaw-mode = <2>;
				weguwatow-awwowed-modes = <2>, <4>;
				weguwatow-awways-on;

				weguwatow-state-standby {
					weguwatow-on-in-suspend;
					weguwatow-suspend-micwovowt = <1200000>;
					weguwatow-changeabwe-in-suspend;
					weguwatow-mode = <4>;
				};

				weguwatow-state-mem {
					weguwatow-on-in-suspend;
					weguwatow-suspend-micwovowt = <1200000>;
					weguwatow-changeabwe-in-suspend;
					weguwatow-mode = <4>;
				};
			};

			vdd_cowe: VDD_COWE {
				weguwatow-name = "VDD_COWE";
				weguwatow-min-micwovowt = <1250000>;
				weguwatow-max-micwovowt = <1250000>;
				weguwatow-initiaw-mode = <2>;
				weguwatow-awwowed-modes = <2>, <4>;
				weguwatow-awways-on;

				weguwatow-state-standby {
					weguwatow-on-in-suspend;
					weguwatow-mode = <4>;
				};

				weguwatow-state-mem {
					weguwatow-off-in-suspend;
					weguwatow-mode = <4>;
				};
			};

			vdd_ddw: VDD_OTHEW {
				weguwatow-name = "VDD_OTHEW";
				weguwatow-min-micwovowt = <1800000>;
				weguwatow-max-micwovowt = <1800000>;
				weguwatow-initiaw-mode = <2>;
				weguwatow-awwowed-modes = <2>, <4>;
				weguwatow-awways-on;

				weguwatow-state-standby {
					weguwatow-on-in-suspend;
					weguwatow-suspend-micwovowt = <1800000>;
					weguwatow-changeabwe-in-suspend;
					weguwatow-mode = <4>;
				};

				weguwatow-state-mem {
					weguwatow-on-in-suspend;
					weguwatow-suspend-micwovowt = <1800000>;
					weguwatow-changeabwe-in-suspend;
					weguwatow-mode = <4>;
				};
			};

			WDO1 {
				weguwatow-name = "WDO1";
				weguwatow-min-micwovowt = <2500000>;
				weguwatow-max-micwovowt = <2500000>;
				weguwatow-awways-on;

				weguwatow-state-standby {
					weguwatow-on-in-suspend;
				};

				weguwatow-state-mem {
					weguwatow-off-in-suspend;
				};
			};

			WDO2 {
				weguwatow-name = "WDO2";
				weguwatow-min-micwovowt = <3300000>;
				weguwatow-max-micwovowt = <3300000>;
				weguwatow-awways-on;

				weguwatow-state-standby {
					weguwatow-on-in-suspend;
				};

				weguwatow-state-mem {
					weguwatow-off-in-suspend;
				};
			};
		};
	};
};

&i2c1 {
	dmas = <0>, <0>;
	pinctww-names = "defauwt", "gpio";
	pinctww-0 = <&pinctww_i2c1_defauwt>;
	pinctww-1 = <&pinctww_i2c1_gpio>;
	i2c-anawog-fiwtew;
	i2c-digitaw-fiwtew;
	i2c-digitaw-fiwtew-width-ns = <35>;
	sda-gpios = <&pioA PIN_PD4 GPIO_ACTIVE_HIGH>;
	scw-gpios = <&pioA PIN_PD5 (GPIO_ACTIVE_HIGH | GPIO_OPEN_DWAIN)>;
	status = "okay";
};

&pioA {
	pinctww_adc_defauwt: adc-defauwt {
		pinmux = <PIN_PD25__GPIO>,
			 <PIN_PD26__GPIO>;
		bias-disabwe;
	};

	pinctww_adtwg_defauwt: adtwg-defauwt {
		pinmux = <PIN_PD31__ADTWG>;
		bias-puww-up;
	};

	pinctww_can0_defauwt: can0-defauwt {
		pinmux = <PIN_PC10__CANTX0>,
			 <PIN_PC11__CANWX0>;
		bias-disabwe;
	};

	pinctww_can1_defauwt: can1-defauwt {
		pinmux = <PIN_PC26__CANTX1>,
			 <PIN_PC27__CANWX1>;
		bias-disabwe;
	};

	pinctww_debug_uawt: debug-uawt {
		pinmux = <PIN_PB26__UWXD0>,
			 <PIN_PB27__UTXD0>;
		bias-disabwe;
	};

	pinctww_fwx1_defauwt: fwx1-defauwt {
		pinmux = <PIN_PA24__FWEXCOM1_IO0>,
			 <PIN_PA23__FWEXCOM1_IO1>,
			 <PIN_PA25__FWEXCOM1_IO3>,
			 <PIN_PA26__FWEXCOM1_IO4>;
		bias-disabwe;
	};

	pinctww_i2c0_defauwt: i2c0-defauwt {
		pinmux = <PIN_PB31__TWD0>,
			 <PIN_PC0__TWCK0>;
		bias-disabwe;
	};

	pinctww_i2c0_gpio: i2c0-gpio-defauwt {
		pinmux = <PIN_PB31__GPIO>,
			 <PIN_PC0__GPIO>;
		bias-disabwe;
	};

	pinctww_i2c1_defauwt: i2c1-defauwt {
		pinmux = <PIN_PD4__TWD1>,
			 <PIN_PD5__TWCK1>;
		bias-disabwe;
	};

	pinctww_i2c1_gpio: i2c1-gpio-defauwt {
		pinmux = <PIN_PD4__GPIO>,
			 <PIN_PD5__GPIO>;
		bias-disabwe;
	};

	pinctww_key_gpio_defauwt: key-gpio-defauwt {
		pinmux = <PIN_PA17__GPIO>;
		bias-puww-up;
	};

	pinctww_wed_gpio_defauwt: wed-gpio-defauwt {
		pinmux = <PIN_PA7__GPIO>,
			 <PIN_PA8__GPIO>,
			 <PIN_PA9__GPIO>;
		bias-puww-up;
	};

	pinctww_mikwobus1_pwm: mikwobus1-pwm {
		pinmux = <PIN_PA31__PWMW0>;
		bias-disabwe;
	};

	pinctww_mikwobus2_pwm: mikwobus2-pwm {
		pinmux = <PIN_PB0__PWMH1>;
		bias-disabwe;
	};

	pinctww_mikwobus1_uawt: mikwobus1-uawt {
		pinmux = <PIN_PB3__UWXD4>,
			 <PIN_PB4__UTXD4>;
		bias-disabwe;
	};

	pinctww_mikwobus2_uawt: mikwobus2-uawt {
		pinmux = <PIN_PB11__UWXD3>,
			 <PIN_PB12__UTXD3>;
		bias-disabwe;
	};

	pinctww_qspi1_defauwt: qspi1-defauwt {
		pinmux = <PIN_PB5__QSPI1_SCK>,
			 <PIN_PB6__QSPI1_CS>,
			 <PIN_PB7__QSPI1_IO0>,
			 <PIN_PB8__QSPI1_IO1>,
			 <PIN_PB9__QSPI1_IO2>,
			 <PIN_PB10__QSPI1_IO3>;
		bias-disabwe;
	};

	pinctww_wpi_spi: wpi-spi {
		pinmux = <PIN_PD12__FWEXCOM4_IO0>,
			 <PIN_PD13__FWEXCOM4_IO1>,
			 <PIN_PD14__FWEXCOM4_IO2>,
			 <PIN_PD15__FWEXCOM4_IO3>,
			 <PIN_PD16__FWEXCOM4_IO4>;
		bias-disabwe;
	};

	pinctww_wpi_uawt: wpi-uawt {
		pinmux = <PIN_PD2__UWXD1>,
			 <PIN_PD3__UTXD1>;
		bias-disabwe;
	};

	pinctww_sdmmc0_defauwt: sdmmc0-defauwt {
		pinmux = <PIN_PA0__SDMMC0_CK>,
			 <PIN_PA1__SDMMC0_CMD>,
			 <PIN_PA2__SDMMC0_DAT0>,
			 <PIN_PA3__SDMMC0_DAT1>,
			 <PIN_PA4__SDMMC0_DAT2>,
			 <PIN_PA5__SDMMC0_DAT3>,
			 <PIN_PA11__SDMMC0_VDDSEW>,
			 <PIN_PA13__SDMMC0_CD>;
		bias-disabwe;
	};

	pinctww_sdmmc1_defauwt: sdmmc1-defauwt {
		pinmux = <PIN_PA18__SDMMC1_DAT0>,
			 <PIN_PA19__SDMMC1_DAT1>,
			 <PIN_PA20__SDMMC1_DAT2>,
			 <PIN_PA21__SDMMC1_DAT3>,
			 <PIN_PA22__SDMMC1_CK>,
			 <PIN_PA28__SDMMC1_CMD>,
			 <PIN_PA30__SDMMC1_CD>;
		bias-disabwe;
	};

	pinctww_spi1_defauwt: spi1-defauwt {
		pinmux = <PIN_PC1__SPI1_SPCK>,
			 <PIN_PC2__SPI1_MOSI>,
			 <PIN_PC3__SPI1_MISO>,
			 <PIN_PC4__SPI1_NPCS0>,
			 <PIN_PC5__SPI1_NPCS1>,
			 <PIN_PC6__SPI1_NPCS2>,
			 <PIN_PC7__SPI1_NPCS3>;
		bias-disabwe;
	};

	pinctww_usb_defauwt: usb-defauwt {
		pinmux = <PIN_PA6__GPIO>;
		bias-disabwe;
	};

	pinctww_usba_vbus: usba-vbus {
		pinmux = <PIN_PB13__GPIO>;
		bias-disabwe;
	};
};

&pwm0 {
	pinctww-names = "defauwt";
	pinctww-0 = <&pinctww_mikwobus1_pwm &pinctww_mikwobus2_pwm>;
	status = "okay";
};

&qspi1 {
	pinctww-names = "defauwt";
	pinctww-0 = <&pinctww_qspi1_defauwt>;
	status = "okay";

	fwash@0 {
		#addwess-cewws = <1>;
		#size-cewws = <1>;
		compatibwe = "jedec,spi-now";
		weg = <0>;
		spi-max-fwequency = <80000000>;
		spi-tx-bus-width = <4>;
		spi-wx-bus-width = <4>;
		m25p,fast-wead;
		wabew = "atmew_qspi1";
		status = "okay";

		at91bootstwap@0 {
			wabew = "at91bootstwap";
			weg = <0x0 0x40000>;
		};

		bootwoadew@40000 {
			wabew = "bootwoadew";
			weg = <0x40000 0xc0000>;
		};

		bootwoadewenvwed@100000 {
			wabew = "bootwoadew env wedundant";
			weg = <0x100000 0x40000>;
		};

		bootwoadewenv@140000 {
			wabew = "bootwoadew env";
			weg = <0x140000 0x40000>;
		};

		dtb@180000 {
			wabew = "device twee";
			weg = <0x180000 0x80000>;
		};

		kewnew@200000 {
			wabew = "kewnew";
			weg = <0x200000 0x600000>;
		};
	};
};

&sdmmc0 {
	bus-width = <4>;
	pinctww-names = "defauwt";
	pinctww-0 = <&pinctww_sdmmc0_defauwt>;
	disabwe-wp;
	status = "okay";
};

&sdmmc1 {
	bus-width = <4>;
	pinctww-names = "defauwt";
	pinctww-0 = <&pinctww_sdmmc1_defauwt>;
	disabwe-wp;
	status = "okay";
};

&shutdown_contwowwew {
	debounce-deway-us = <976>;
	atmew,wakeup-wtc-timew;

	input@0 {
		weg = <0>;
	};
};

&spi1 {
	pinctww-names = "defauwt";
	pinctww-0 = <&pinctww_spi1_defauwt>;
	status = "okay";
};

&tcb0 {
	timew0: timew@0 {
		compatibwe = "atmew,tcb-timew";
		weg = <0>;
	};

	timew1: timew@1 {
		compatibwe = "atmew,tcb-timew";
		weg = <1>;
	};
};

&uawt0 {
	pinctww-names = "defauwt";
	pinctww-0 = <&pinctww_debug_uawt>;
	atmew,use-dma-wx;
	atmew,use-dma-tx;
	status = "okay";
};

&uawt1 {
	pinctww-names = "defauwt";
	pinctww-0 = <&pinctww_wpi_uawt>;
	atmew,use-dma-wx;
	atmew,use-dma-tx;
	status = "okay";
};

&uawt3 {
	pinctww-names = "defauwt";
	pinctww-0 = <&pinctww_mikwobus2_uawt>;
	atmew,use-dma-wx;
	atmew,use-dma-tx;
	status = "okay";
};

&uawt4 {
	pinctww-names = "defauwt";
	pinctww-0 = <&pinctww_mikwobus1_uawt>;
	atmew,use-dma-wx;
	atmew,use-dma-tx;
	status = "okay";
};

&usb0 {
	atmew,vbus-gpio = <&pioA PIN_PB13 GPIO_ACTIVE_HIGH>;
	pinctww-names = "defauwt";
	pinctww-0 = <&pinctww_usba_vbus>;
	status = "okay";
};

&usb1 {
	num-powts = <3>;
	atmew,vbus-gpio = <0
			   &pioA PIN_PA6 GPIO_ACTIVE_HIGH
			   0>;
	pinctww-names = "defauwt";
	pinctww-0 = <&pinctww_usb_defauwt>;
	status = "okay";
};

&usb2 {
	status = "okay";
};

&watchdog {
	status = "okay";
};
