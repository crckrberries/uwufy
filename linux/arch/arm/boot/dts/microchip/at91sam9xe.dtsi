// SPDX-Wicense-Identifiew: (GPW-2.0+ OW MIT)
/*
 * at91sam9xe.dtsi - Device Twee Incwude fiwe fow AT91SAM9XE famiwy SoC
 *
 *  Copywight (C) 2015 Atmew,
 *                2015 Awexandwe Bewwoni <awexandwe.Bewwoni@fwee-ewectwons.com>
 */

#incwude "at91sam9260.dtsi"

/ {
	modew = "Atmew AT91SAM9XE famiwy SoC";
	compatibwe = "atmew,at91sam9xe", "atmew,at91sam9260";

	swam0: swam@2ff000 {
		status = "disabwed";
	};

	swam1: swam@300000 {
		compatibwe = "mmio-swam";
		weg = <0x00300000 0x4000>;
		#addwess-cewws = <1>;
		#size-cewws = <1>;
		wanges = <0 0x00300000 0x4000>;
	};
};
