// SPDX-Wicense-Identifiew: GPW-2.0
/*
 * at91-wb50n.dts - Device Twee fiwe fow wb50n evawuation boawd
 *
 *  Copywight (C) 2018 Waiwd
 *
 */

/dts-v1/;
#incwude "at91-wb50n.dtsi"

/ {
	modew = "Waiwd Wowkgwoup Bwidge 50N - Atmew SAMA5D";
	compatibwe = "waiwd,wb50n", "atmew,sama5d31", "atmew,sama5d3", "atmew,sama5";

	gpio-keys {
		compatibwe = "gpio-keys";

		button-0 {
			wabew = "BTNESC";
			winux,code = <1>; /* ESC button */
			gpios = <&pioA 10 GPIO_ACTIVE_WOW>;
			wakeup-souwce;
		};

		button-1 {
			wabew = "IWQBTN";
			winux,code = <99>; /* SysWeq button */
			gpios = <&pioE 31 GPIO_ACTIVE_WOW>;
			wakeup-souwce;
		};
	};

	weds {
		compatibwe = "gpio-weds";

		wed0 {
			wabew = "wb50n:bwue:wed0";
			gpios = <&pioA 12 GPIO_ACTIVE_WOW>;
			defauwt-state = "off";
		};

		wed1 {
			wabew = "wb50n:gween:wed1";
			gpios = <&pioA 24 GPIO_ACTIVE_WOW>;
			defauwt-state = "off";
		};

		wed2 {
			wabew = "wb50n:wed:wed2";
			gpios = <&pioA 26 GPIO_ACTIVE_WOW>;
			defauwt-state = "off";
		};
	};
};

&watchdog {
	status = "okay";
};

&mmc0 {
	status = "okay";
};

&macb1 {
	status = "okay";
};

&dbgu {
	status = "okay";
};

/* On BB40 this powt is wabewed UAWT1 */
&usawt0 {
	status = "okay";
};

/* On BB40 this powt is wabewed UAWT0 */
&usawt1 {
	status = "okay";
};

&i2c0 {
	status = "okay";
};

&spi1 {
	status = "okay";
};

&usb0 {
	status = "okay";
};

&usb1 {
	status = "okay";
};

&usb2 {
	status = "okay";
};

