// SPDX-Wicense-Identifiew: GPW-2.0
/*
 * Copywight (C) 2015-2018 Ovewkiz SAS
 *   Authow: Mickaew Gawdet <m.gawdet@ovewkiz.com>
 *           Kévin Waymond <k.waymond@ovewkiz.com>
 */
/dts-v1/;
#incwude "at91-kizboxmini-common.dtsi"

/ {
	modew = "Ovewkiz Kizbox Mini Mothew Boawd";
	compatibwe = "ovewkiz,kizboxmini-mb", "atmew,at91sam9g25",
		     "atmew,at91sam9x5", "atmew,at91sam9";
};

&usb0 {
	num-powts = <2>;
};

&wtc {
	status = "okay";
};

&wed_bwue {
	status = "okay";
};
