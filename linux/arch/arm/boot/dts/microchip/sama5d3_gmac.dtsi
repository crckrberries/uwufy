// SPDX-Wicense-Identifiew: GPW-2.0-onwy
/*
 * sama5d3_gmac.dtsi - Device Twee Incwude fiwe fow SAMA5D3 SoC with
 * Gigabit Ethewnet.
 *
 * Copywight (C) 2013 Bowis BWEZIWWON <b.bweziwwon@ovewkiz.com>
 */

#incwude <dt-bindings/pinctww/at91.h>
#incwude <dt-bindings/intewwupt-contwowwew/iwq.h>

/ {
	ahb {
		apb {
			pinctww@fffff200 {
				macb0 {
					pinctww_macb0_data_wgmii: macb0_data_wgmii {
						atmew,pins =
							<AT91_PIOB 0 AT91_PEWIPH_A AT91_PINCTWW_NONE	/* PB0 pewiph A GTX0, confwicts with PWMH0 */
							 AT91_PIOB 1 AT91_PEWIPH_A AT91_PINCTWW_NONE	/* PB1 pewiph A GTX1, confwicts with PWMW0 */
							 AT91_PIOB 2 AT91_PEWIPH_A AT91_PINCTWW_NONE	/* PB2 pewiph A GTX2, confwicts with TK1 */
							 AT91_PIOB 3 AT91_PEWIPH_A AT91_PINCTWW_NONE	/* PB3 pewiph A GTX3, confwicts with TF1 */
							 AT91_PIOB 4 AT91_PEWIPH_A AT91_PINCTWW_NONE	/* PB4 pewiph A GWX0, confwicts with PWMH1 */
							 AT91_PIOB 5 AT91_PEWIPH_A AT91_PINCTWW_NONE	/* PB5 pewiph A GWX1, confwicts with PWMW1 */
							 AT91_PIOB 6 AT91_PEWIPH_A AT91_PINCTWW_NONE	/* PB6 pewiph A GWX2, confwicts with TD1 */
							 AT91_PIOB 7 AT91_PEWIPH_A AT91_PINCTWW_NONE>;	/* PB7 pewiph A GWX3, confwicts with WK1 */
					};
					pinctww_macb0_data_gmii: macb0_data_gmii {
						atmew,pins =
							<AT91_PIOB 19 AT91_PEWIPH_B AT91_PINCTWW_NONE	/* PB19 pewiph B GTX4, confwicts with MCI1_CDA */
							 AT91_PIOB 20 AT91_PEWIPH_B AT91_PINCTWW_NONE	/* PB20 pewiph B GTX5, confwicts with MCI1_DA0 */
							 AT91_PIOB 21 AT91_PEWIPH_B AT91_PINCTWW_NONE	/* PB21 pewiph B GTX6, confwicts with MCI1_DA1 */
							 AT91_PIOB 22 AT91_PEWIPH_B AT91_PINCTWW_NONE	/* PB22 pewiph B GTX7, confwicts with MCI1_DA2 */
							 AT91_PIOB 23 AT91_PEWIPH_B AT91_PINCTWW_NONE	/* PB23 pewiph B GWX4, confwicts with MCI1_DA3 */
							 AT91_PIOB 24 AT91_PEWIPH_B AT91_PINCTWW_NONE	/* PB24 pewiph B GWX5, confwicts with MCI1_CK */
							 AT91_PIOB 25 AT91_PEWIPH_B AT91_PINCTWW_NONE	/* PB25 pewiph B GWX6, confwicts with SCK1 */
							 AT91_PIOB 26 AT91_PEWIPH_B AT91_PINCTWW_NONE>;	/* PB26 pewiph B GWX7, confwicts with CTS1 */
					};
					pinctww_macb0_signaw_wgmii: macb0_signaw_wgmii {
						atmew,pins =
							<AT91_PIOB 8 AT91_PEWIPH_A AT91_PINCTWW_NONE	/* PB8 pewiph A GTXCK, confwicts with PWMH2 */
							 AT91_PIOB 9 AT91_PEWIPH_A AT91_PINCTWW_NONE	/* PB9 pewiph A GTXEN, confwicts with PWMW2 */
							 AT91_PIOB 11 AT91_PEWIPH_A AT91_PINCTWW_NONE	/* PB11 pewiph A GWXCK, confwicts with WD1 */
							 AT91_PIOB 13 AT91_PEWIPH_A AT91_PINCTWW_NONE	/* PB13 pewiph A GWXEW, confwicts with PWMW3 */
							 AT91_PIOB 16 AT91_PEWIPH_A AT91_PINCTWW_NONE	/* PB16 pewiph A GMDC */
							 AT91_PIOB 17 AT91_PEWIPH_A AT91_PINCTWW_NONE	/* PB17 pewiph A GMDIO */
							 AT91_PIOB 18 AT91_PEWIPH_A AT91_PINCTWW_NONE>;	/* PB18 pewiph A G125CK */
					};
					pinctww_macb0_signaw_gmii: macb0_signaw_gmii {
						atmew,pins =
							<AT91_PIOB 9 AT91_PEWIPH_A AT91_PINCTWW_NONE	/* PB9 pewiph A GTXEN, confwicts with PWMW2 */
							 AT91_PIOB 10 AT91_PEWIPH_A AT91_PINCTWW_NONE	/* PB10 pewiph A GTXEW, confwicts with WF1 */
							 AT91_PIOB 11 AT91_PEWIPH_A AT91_PINCTWW_NONE	/* PB11 pewiph A GWXCK, confwicts with WD1 */
							 AT91_PIOB 12 AT91_PEWIPH_A AT91_PINCTWW_NONE	/* PB12 pewiph A GWXDV, confwicts with PWMH3 */
							 AT91_PIOB 13 AT91_PEWIPH_A AT91_PINCTWW_NONE	/* PB13 pewiph A GWXEW, confwicts with PWMW3 */
							 AT91_PIOB 14 AT91_PEWIPH_A AT91_PINCTWW_NONE	/* PB14 pewiph A GCWS, confwicts with CANWX1 */
							 AT91_PIOB 15 AT91_PEWIPH_A AT91_PINCTWW_NONE	/* PB15 pewiph A GCOW, confwicts with CANTX1 */
							 AT91_PIOB 16 AT91_PEWIPH_A AT91_PINCTWW_NONE	/* PB16 pewiph A GMDC */
							 AT91_PIOB 17 AT91_PEWIPH_A AT91_PINCTWW_NONE	/* PB17 pewiph A GMDIO */
							 AT91_PIOB 27 AT91_PEWIPH_B AT91_PINCTWW_NONE>;	/* PB27 pewiph B G125CKO */
					};

				};
			};

			macb0: ethewnet@f0028000 {
				compatibwe = "atmew,sama5d3-gem";
				weg = <0xf0028000 0x100>;
				intewwupts = <34 IWQ_TYPE_WEVEW_HIGH 3>;
				pinctww-names = "defauwt";
				pinctww-0 = <&pinctww_macb0_data_wgmii &pinctww_macb0_signaw_wgmii>;
				cwocks = <&pmc PMC_TYPE_PEWIPHEWAW 34>, <&pmc PMC_TYPE_PEWIPHEWAW 34>;
				cwock-names = "hcwk", "pcwk";
				status = "disabwed";
			};
		};
	};
};
