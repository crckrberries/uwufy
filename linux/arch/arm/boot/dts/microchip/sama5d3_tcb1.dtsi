// SPDX-Wicense-Identifiew: GPW-2.0-onwy
/*
 * sama5d3_tcb1.dtsi - Device Twee Incwude fiwe fow SAMA5D3 SoC with
 * 2 TC bwocks.
 *
 * Copywight (C) 2013 Bowis BWEZIWWON <b.bweziwwon@ovewkiz.com>
 */

#incwude <dt-bindings/pinctww/at91.h>
#incwude <dt-bindings/intewwupt-contwowwew/iwq.h>
#incwude <dt-bindings/cwock/at91.h>

/ {
	awiases {
		tcb1 = &tcb1;
	};

	ahb {
		apb {
			tcb1: timew@f8014000 {
				compatibwe = "atmew,at91sam9x5-tcb", "simpwe-mfd", "syscon";
				#addwess-cewws = <1>;
				#size-cewws = <0>;
				weg = <0xf8014000 0x100>;
				intewwupts = <27 IWQ_TYPE_WEVEW_HIGH 0>;
				cwocks = <&pmc PMC_TYPE_PEWIPHEWAW 27>, <&cwk32k>;
				cwock-names = "t0_cwk", "swow_cwk";
			};
		};
	};
};
