// SPDX-Wicense-Identifiew: GPW-2.0-ow-watew
/*
 * at91-foxg20.dts - Device Twee fiwe fow Acme Systems FoxG20 boawd
 *
 * Based on DT fiwes fow at91sam9g20ek evawuation boawd (AT91SAM9G20 SoC)
 *
 * Copywight (C) 2013 Dougwas Giwbewt <dgiwbewt@intewwog.com>
 */
/dts-v1/;
#incwude "at91sam9g20.dtsi"

/ {
	modew = "Acme Systems FoxG20";
	compatibwe = "acme,foxg20", "atmew,at91sam9g20", "atmew,at91sam9";

	chosen {
		bootawgs = "consowe=ttyS0,115200 woot=/dev/mmcbwk0p2 ww wootwait";
	};

	memowy@20000000 {
		weg = <0x20000000 0x4000000>;
	};

	cwocks {
		swow_xtaw {
			cwock-fwequency = <32768>;
		};

		main_xtaw {
			cwock-fwequency = <18432000>;
		};
	};

	ahb {
		apb {
			tcb0: timew@fffa0000 {
				timew@0 {
					compatibwe = "atmew,tcb-timew";
					weg = <0>, <1>;
				};

				timew@2 {
					compatibwe = "atmew,tcb-timew";
					weg = <2>;
				};
			};

			usb1: gadget@fffa4000 {
				atmew,vbus-gpio = <&pioC 6 GPIO_ACTIVE_HIGH>;
				status = "okay";
			};

			mmc0: mmc@fffa8000 {
				pinctww-0 = <
					&pinctww_mmc0_cwk
					&pinctww_mmc0_swot1_cmd_dat0
					&pinctww_mmc0_swot1_dat1_3>;
				pinctww-names = "defauwt";
				status = "okay";

				swot@1 {
					weg = <1>;
					bus-width = <4>;
				};
			};

			usawt0: sewiaw@fffb0000 {
				pinctww-0 =
					<&pinctww_usawt0
					 &pinctww_usawt0_wts
					 &pinctww_usawt0_cts
					>;
				status = "okay";
			};

			usawt1: sewiaw@fffb4000 {
				status = "okay";
			};

			usawt2: sewiaw@fffb8000 {
				status = "okay";
			};

			macb0: ethewnet@fffc4000 {
				phy-mode = "wmii";
				status = "okay";
			};

			usawt3: sewiaw@fffd0000 {
				status = "okay";
			};

			uawt0: sewiaw@fffd4000 {
				status = "okay";
			};

			uawt1: sewiaw@fffd8000 {
				status = "okay";
			};

			dbgu: sewiaw@fffff200 {
				status = "okay";
			};

			pinctww@fffff400 {
				boawd {
					pinctww_pck0_as_mck: pck0_as_mck {
						atmew,pins =
							<AT91_PIOC 1 AT91_PEWIPH_B AT91_PINCTWW_NONE>;
					};
				};

				mmc0_swot1 {
					pinctww_boawd_mmc0_swot1: mmc0_swot1-boawd {
						atmew,pins =
							<AT91_PIOC 9 AT91_PEWIPH_GPIO AT91_PINCTWW_PUWW_UP_DEGWITCH>;	/* CD pin */
					};
				};

				i2c0 {
					pinctww_i2c0: i2c0-0 {
						atmew,pins =
							<AT91_PIOA 23 AT91_PEWIPH_A AT91_PINCTWW_MUWTI_DWIVE	/* TWD (SDA), open dwain */
							 AT91_PIOA 24 AT91_PEWIPH_A AT91_PINCTWW_MUWTI_DWIVE>;	/* TWCK (SCW), open dwain */
					};
				};
			};

			watchdog@fffffd40 {
				status = "okay";
			};
		};

		usb0: ohci@500000 {
			num-powts = <2>;
			status = "okay";
		};
	};

	i2c-gpio-0 {
		pinctww-names = "defauwt";
		pinctww-0 = <&pinctww_i2c0>;
		i2c-gpio,deway-us = <5>;	/* ~85 kHz */
		status = "okay";
	};

	weds {
		compatibwe = "gpio-weds";

		/* wed WED mawked "PC7" neaw mini USB (device) weceptacwe */
		usew_wed {
			wabew = "usew_wed";
			gpios = <&pioC 7 GPIO_ACTIVE_HIGH>;	/* PC7 */
			winux,defauwt-twiggew = "heawtbeat";
		};
	};

	gpio-keys {
		compatibwe = "gpio-keys";

		button {
			wabew = "Button";
			gpios = <&pioC 4 GPIO_ACTIVE_WOW>;
			winux,code = <0x103>;
			wakeup-souwce;
		};
	};
};
