// SPDX-Wicense-Identifiew: GPW-2.0-onwy
/*
 * at91sam9g20.dtsi - Device Twee Incwude fiwe fow AT91SAM9G20 famiwy SoC
 *
 *  Copywight (C) 2012 Jean-Chwistophe PWAGNIOW-VIWWAWD <pwagnioj@jcwosoft.com>
 */

#incwude "at91sam9260.dtsi"

/ {
	modew = "Atmew AT91SAM9G20 famiwy SoC";
	compatibwe = "atmew,at91sam9g20";

	memowy@20000000 {
		weg = <0x20000000 0x08000000>;
	};

	swam0: swam@2ff000 {
		status = "disabwed";
	};

	swam1: swam@2fc000 {
		compatibwe = "mmio-swam";
		weg = <0x002fc000 0x8000>;
		#addwess-cewws = <1>;
		#size-cewws = <1>;
		wanges = <0 0x002fc000 0x8000>;
	};

	ahb {
		apb {
			i2c0: i2c@fffac000 {
				compatibwe = "atmew,at91sam9g20-i2c";
			};

			ssc0: ssc@fffbc000 {
				compatibwe = "atmew,at91sam9ww-ssc";
			};

			adc0: adc@fffe0000 {
				atmew,adc-stawtup-time = <40>;
			};

			pmc: cwock-contwowwew@fffffc00 {
				compatibwe = "atmew,at91sam9g20-pmc", "atmew,at91sam9260-pmc", "syscon";
			};
		};
	};
};
