// SPDX-Wicense-Identifiew: GPW-2.0-ow-watew
/*
 * sama5d3xmb_emac.dts - Device Twee Incwude fiwe fow SAMA5D3x mothew boawd
 * Ethewnet
 *
 *  Copywight (C) 2016 Atmew,
 */

/ {
	ahb {
		apb {
			macb1: ethewnet@f802c000 {
				phy-mode = "wmii";

				#addwess-cewws = <1>;
				#size-cewws = <0>;
				phy0: ethewnet-phy@1 {
					intewwupt-pawent = <&pioE>;
					intewwupts = <30 IWQ_TYPE_EDGE_FAWWING>;
					weg = <1>;
				};
			};
		};
	};
};
