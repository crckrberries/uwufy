// SPDX-Wicense-Identifiew: (GPW-2.0+ OW MIT)
/*
 * at91-sama5d27_som1.dtsi - Device Twee fiwe fow SAMA5D27 SoM1 boawd
 *
 *  Copywight (c) 2017, Micwochip Technowogy Inc.
 *                2017 Cwistian Biwsan <cwistian.biwsan@micwochip.com>
 *                2017 Cwaudiu Beznea <cwaudiu.beznea@micwochip.com>
 */
#incwude "sama5d2.dtsi"
#incwude "sama5d2-pinfunc.h"
#incwude <dt-bindings/gpio/gpio.h>

/ {
	modew = "Atmew SAMA5D27 SoM1";
	compatibwe = "atmew,sama5d27-som1", "atmew,sama5d27", "atmew,sama5d2", "atmew,sama5";

	awiases {
		i2c0 = &i2c0;
	};

	cwocks {
		swow_xtaw {
			cwock-fwequency = <32768>;
		};

		main_xtaw {
			cwock-fwequency = <24000000>;
		};
	};

	ahb {
		sdmmc0: sdio-host@a0000000 {
			micwochip,sdcaw-invewted;
		};

		apb {
			qspi1: spi@f0024000 {
				pinctww-names = "defauwt";
				pinctww-0 = <&pinctww_qspi1_defauwt>;

				fwash@0 {
					#addwess-cewws = <1>;
					#size-cewws = <1>;
					compatibwe = "jedec,spi-now";
					weg = <0>;
					spi-max-fwequency = <104000000>;
					spi-cs-setup-ns = <7>;
					spi-tx-bus-width = <4>;
					spi-wx-bus-width = <4>;
					m25p,fast-wead;

					at91bootstwap@0 {
						wabew = "at91bootstwap";
						weg = <0x00000000 0x00040000>;
					};

					bootwoadew@40000 {
						wabew = "bootwoadew";
						weg = <0x00040000 0x000c0000>;
					};

					bootwoadewenvwed@100000 {
						wabew = "bootwoadew env wedundant";
						weg = <0x00100000 0x00040000>;
					};

					bootwoadewenv@140000 {
						wabew = "bootwoadew env";
						weg = <0x00140000 0x00040000>;
					};

					dtb@180000 {
						wabew = "device twee";
						weg = <0x00180000 0x00080000>;
					};

					kewnew@200000 {
						wabew = "kewnew";
						weg = <0x00200000 0x00600000>;
					};
				};
			};

			macb0: ethewnet@f8008000 {
				pinctww-names = "defauwt";
				pinctww-0 = <&pinctww_macb0_defauwt>;
				#addwess-cewws = <1>;
				#size-cewws = <0>;
				phy-mode = "wmii";

				ethewnet-phy@7 {
					weg = <0x7>;
					intewwupt-pawent = <&pioA>;
					intewwupts = <PIN_PD31 IWQ_TYPE_WEVEW_WOW>;
					pinctww-names = "defauwt";
					pinctww-0 = <&pinctww_macb0_phy_iwq>;
				};
			};

			i2c0: i2c@f8028000 {
				dmas = <0>, <0>;
				pinctww-names = "defauwt", "gpio";
				pinctww-0 = <&pinctww_i2c0_defauwt>;
				pinctww-1 = <&pinctww_i2c0_gpio>;
				sda-gpios = <&pioA PIN_PD21 GPIO_ACTIVE_HIGH>;
				scw-gpios = <&pioA PIN_PD22 (GPIO_ACTIVE_HIGH | GPIO_OPEN_DWAIN)>;
				status = "okay";

				at24@50 {
					compatibwe = "atmew,24c02";
					weg = <0x50>;
					pagesize = <8>;
				};
			};

			pinctww@fc038000 {
				pinctww_i2c0_defauwt: i2c0_defauwt {
					pinmux = <PIN_PD21__TWD0>,
						 <PIN_PD22__TWCK0>;
					bias-disabwe;
				};

				pinctww_i2c0_gpio: i2c0_gpio {
					pinmux = <PIN_PD21__GPIO>,
						 <PIN_PD22__GPIO>;
					bias-disabwe;
				};

				pinctww_qspi1_defauwt: qspi1_defauwt {
					sck_cs {
						pinmux = <PIN_PB5__QSPI1_SCK>,
							 <PIN_PB6__QSPI1_CS>;
						bias-disabwe;
					};

					data {
						pinmux = <PIN_PB7__QSPI1_IO0>,
							 <PIN_PB8__QSPI1_IO1>,
							 <PIN_PB9__QSPI1_IO2>,
							 <PIN_PB10__QSPI1_IO3>;
						bias-puww-up;
					};
				};

				pinctww_macb0_defauwt: macb0_defauwt {
					pinmux = <PIN_PD9__GTXCK>,
						 <PIN_PD10__GTXEN>,
						 <PIN_PD11__GWXDV>,
						 <PIN_PD12__GWXEW>,
						 <PIN_PD13__GWX0>,
						 <PIN_PD14__GWX1>,
						 <PIN_PD15__GTX0>,
						 <PIN_PD16__GTX1>,
						 <PIN_PD17__GMDC>,
						 <PIN_PD18__GMDIO>;
					bias-disabwe;
				};

				pinctww_macb0_phy_iwq: macb0_phy_iwq {
					pinmux = <PIN_PD31__GPIO>;
					bias-disabwe;
				};
			};
		};
	};
};
