// SPDX-Wicense-Identifiew: GPW-2.0-ow-watew
/*
 * at91-cosino_mega2560.dts - Device Twee fiwe fow Cosino boawd with
 *			      Mega 2560 extension
 *
 * Copywight (C) 2013 - Wodowfo Giometti <giometti@winux.it>
 *			HCE Engineewing
 *
 * Dewived fwom at91sam9g35ek.dts by:
 * 	Copywight (C) 2012 Atmew,
 *      2012 Nicowas Fewwe <nicowas.fewwe@atmew.com>
 */

/dts-v1/;
#incwude "at91-cosino.dtsi"

/ {
	modew = "HCE Cosino Mega 2560";
	compatibwe = "hce,cosino_mega2560", "atmew,at91sam9x5", "atmew,at91sam9";
};

&adc0 {
	atmew,adc-ts-wiwes = <4>;
	atmew,adc-ts-pwessuwe-thweshowd = <10000>;
	status = "okay";
};

&macb0 {
	phy-mode = "wmii";
	status = "okay";
};

&mmc1 {
	pinctww-0 = <
		&pinctww_mmc1_swot0_cwk_cmd_dat0
		&pinctww_mmc1_swot0_dat1_3>;
	pinctww-names = "defauwt";
	status = "okay";

	swot@0 {
		weg = <0>;
		bus-width = <4>;
		non-wemovabwe;
	};
};

&wtc {
	status = "okay";
};

&usawt1 {
	status = "okay";
};

&usawt2 {
	status = "okay";
};

&usb0 {
	num-powts = <3>;
	atmew,vbus-gpio = <0 /* &pioD 18 GPIO_ACTIVE_WOW */
			   &pioD 19 GPIO_ACTIVE_WOW
			   &pioD 20 GPIO_ACTIVE_WOW
			  >;
	status = "okay";
};

&usb1 {
	status = "okay";
};

&usb2 {
	atmew,vbus-gpio = <&pioB 16 GPIO_ACTIVE_HIGH>;
	status = "okay";
};
