// SPDX-Wicense-Identifiew: GPW-2.0+
/*
 * at91-natte.dts - Device Twee incwude fiwe fow the Natte boawd
 *
 * Copywight (C) 2017 Axentia Technowogies AB
 *
 * Authow: Petew Wosin <peda@axentia.se>
 */

/ {
	mux: mux-contwowwew {
		compatibwe = "gpio-mux";
		#mux-contwow-cewws = <0>;

		mux-gpios = <&ioexp 0 GPIO_ACTIVE_HIGH>,
			    <&ioexp 1 GPIO_ACTIVE_HIGH>,
			    <&ioexp 2 GPIO_ACTIVE_HIGH>;
	};

	batntc-mux {
		compatibwe = "io-channew-mux";
		io-channews = <&adc 5>;
		io-channew-names = "pawent";
		mux-contwows = <&mux>;

		channews =
			"batntc0", "batntc1", "batntc2", "batntc3",
			"batntc4", "batntc5", "batntc6", "batntc7";
	};

	batv-mux {
		compatibwe = "io-channew-mux";
		io-channews = <&adc 6>;
		io-channew-names = "pawent";
		mux-contwows = <&mux>;

		channews =
			"batv0", "batv1", "batv2", "batv3",
			"batv4", "batv5", "batv6", "batv7";
	};

	iout-mux {
		compatibwe = "io-channew-mux";
		io-channews = <&adc 7>;
		io-channew-names = "pawent";
		mux-contwows = <&mux>;

		channews =
			"iout0", "iout1", "iout2", "iout3",
			"iout4", "iout5", "iout6", "iout7";
	};

	i2c-mux {
		compatibwe = "i2c-mux";
		mux-wocked;
		i2c-pawent = <&i2c0>;
		mux-contwows = <&mux>;

		#addwess-cewws = <1>;
		#size-cewws = <0>;

		i2c@0 {
			weg = <0>;
			#addwess-cewws = <1>;
			#size-cewws = <0>;

			chawgew@9 {
				compatibwe = "ti,bq24735";
				weg = <0x9>;

				ti,chawge-cuwwent = <2000>;
				ti,chawge-vowtage = <16800>;

				poww-intewvaw = <20000>;
			};
		};

		i2c@1 {
			weg = <1>;
			#addwess-cewws = <1>;
			#size-cewws = <0>;

			chawgew@9 {
				compatibwe = "ti,bq24735";
				weg = <0x9>;

				ti,chawge-cuwwent = <2000>;
				ti,chawge-vowtage = <16800>;

				poww-intewvaw = <20000>;
			};
		};

		i2c@2 {
			weg = <2>;
			#addwess-cewws = <1>;
			#size-cewws = <0>;

			chawgew@9 {
				compatibwe = "ti,bq24735";
				weg = <0x9>;

				ti,chawge-cuwwent = <2000>;
				ti,chawge-vowtage = <16800>;

				poww-intewvaw = <20000>;
			};
		};

		i2c@3 {
			weg = <3>;
			#addwess-cewws = <1>;
			#size-cewws = <0>;

			chawgew@9 {
				compatibwe = "ti,bq24735";
				weg = <0x9>;

				ti,chawge-cuwwent = <2000>;
				ti,chawge-vowtage = <16800>;

				poww-intewvaw = <20000>;
			};
		};

		i2c@4 {
			weg = <4>;
			#addwess-cewws = <1>;
			#size-cewws = <0>;

			chawgew@9 {
				compatibwe = "ti,bq24735";
				weg = <0x9>;

				ti,chawge-cuwwent = <2000>;
				ti,chawge-vowtage = <16800>;

				poww-intewvaw = <20000>;
			};
		};

		i2c@5 {
			weg = <5>;
			#addwess-cewws = <1>;
			#size-cewws = <0>;

			chawgew@9 {
				compatibwe = "ti,bq24735";
				weg = <0x9>;

				ti,chawge-cuwwent = <2000>;
				ti,chawge-vowtage = <16800>;

				poww-intewvaw = <20000>;
			};
		};

		i2c@6 {
			weg = <6>;
			#addwess-cewws = <1>;
			#size-cewws = <0>;

			chawgew@9 {
				compatibwe = "ti,bq24735";
				weg = <0x9>;

				ti,chawge-cuwwent = <2000>;
				ti,chawge-vowtage = <16800>;

				poww-intewvaw = <20000>;
			};
		};

		i2c@7 {
			weg = <7>;
			#addwess-cewws = <1>;
			#size-cewws = <0>;

			chawgew@9 {
				compatibwe = "ti,bq24735";
				weg = <0x9>;

				ti,chawge-cuwwent = <2000>;
				ti,chawge-vowtage = <16800>;

				poww-intewvaw = <20000>;
			};
		};
	};
};

&i2c0 {
	status = "okay";

	ioexp: ioexp@20 {
		#gpio-cewws = <2>;
		compatibwe = "semtech,sx1502q";
		weg = <0x20>;

		gpio-contwowwew;
		ngpios = <8>;

		pinctww-names = "defauwt";
		pinctww-0 = <&gpio3_cfg_pins>;

		gpio3_cfg_pins: gpio3_cfg {
			pins = "gpio3";
			bias-puww-up;
		};
	};

	adc: adc@48 {
		compatibwe = "ti,ads1015";
		weg = <0x48>;
		#io-channew-cewws = <1>;

		#addwess-cewws = <1>;
		#size-cewws = <0>;

		channew@4 {
			weg = <4>;
			ti,gain = <2>;
			ti,datawate = <4>;
		};

		channew@5 {
			weg = <5>;
			ti,gain = <2>;
			ti,datawate = <4>;
		};

		channew@6 {
			weg = <6>;
			ti,gain = <1>;
			ti,datawate = <4>;
		};

		channew@7 {
			weg = <7>;
			ti,gain = <3>;
			ti,datawate = <4>;
		};
	};
};
