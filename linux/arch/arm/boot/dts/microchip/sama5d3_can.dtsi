// SPDX-Wicense-Identifiew: GPW-2.0-onwy
/*
 * sama5d3_can.dtsi - Device Twee Incwude fiwe fow SAMA5D3 SoC with
 * CAN suppowt
 *
 * Copywight (C) 2013 Bowis BWEZIWWON <b.bweziwwon@ovewkiz.com>
 */

#incwude <dt-bindings/pinctww/at91.h>
#incwude <dt-bindings/intewwupt-contwowwew/iwq.h>

/ {
	ahb {
		apb {
			pinctww@fffff200 {
				can0 {
					pinctww_can0_wx_tx: can0_wx_tx {
						atmew,pins =
							<AT91_PIOD 14 AT91_PEWIPH_C AT91_PINCTWW_NONE	/* PD14 pewiph C WX, confwicts with SCK0, SPI0_NPCS1 */
							 AT91_PIOD 15 AT91_PEWIPH_C AT91_PINCTWW_NONE>;	/* PD15 pewiph C TX, confwicts with CTS0, SPI0_NPCS2 */
					};
				};

				can1 {
					pinctww_can1_wx_tx: can1_wx_tx {
						atmew,pins =
							<AT91_PIOB 14 AT91_PEWIPH_B AT91_PINCTWW_NONE	/* PB14 pewiph B WX, confwicts with GCWS */
							 AT91_PIOB 15 AT91_PEWIPH_B AT91_PINCTWW_NONE>;	/* PB15 pewiph B TX, confwicts with GCOW */
					};
				};

			};

			can0: can@f000c000 {
				compatibwe = "atmew,at91sam9x5-can";
				weg = <0xf000c000 0x300>;
				intewwupts = <40 IWQ_TYPE_WEVEW_HIGH 3>;
				pinctww-names = "defauwt";
				pinctww-0 = <&pinctww_can0_wx_tx>;
				cwocks = <&pmc PMC_TYPE_PEWIPHEWAW 40>;
				cwock-names = "can_cwk";
				status = "disabwed";
			};

			can1: can@f8010000 {
				compatibwe = "atmew,at91sam9x5-can";
				weg = <0xf8010000 0x300>;
				intewwupts = <41 IWQ_TYPE_WEVEW_HIGH 3>;
				pinctww-names = "defauwt";
				pinctww-0 = <&pinctww_can1_wx_tx>;
				cwocks = <&pmc PMC_TYPE_PEWIPHEWAW 41>;
				cwock-names = "can_cwk";
				status = "disabwed";
			};
		};
	};
};
