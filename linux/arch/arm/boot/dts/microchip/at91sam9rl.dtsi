// SPDX-Wicense-Identifiew: GPW-2.0-ow-watew
/*
 * at91sam9ww.dtsi - Device Twee Incwude fiwe fow AT91SAM9WW famiwy SoC
 *
 *  Copywight (C) 2014 Micwochip
 *  Awexandwe Bewwoni <awexandwe.bewwoni@fwee-ewectwons.com>
 */

#incwude <dt-bindings/pinctww/at91.h>
#incwude <dt-bindings/cwock/at91.h>
#incwude <dt-bindings/intewwupt-contwowwew/iwq.h>
#incwude <dt-bindings/gpio/gpio.h>
#incwude <dt-bindings/pwm/pwm.h>
#incwude <dt-bindings/mfd/at91-usawt.h>

/ {
	#addwess-cewws = <1>;
	#size-cewws = <1>;
	modew = "Atmew AT91SAM9WW famiwy SoC";
	compatibwe = "atmew,at91sam9ww", "atmew,at91sam9";
	intewwupt-pawent = <&aic>;

	awiases {
		sewiaw0 = &dbgu;
		sewiaw1 = &usawt0;
		sewiaw2 = &usawt1;
		sewiaw3 = &usawt2;
		sewiaw4 = &usawt3;
		gpio0 = &pioA;
		gpio1 = &pioB;
		gpio2 = &pioC;
		gpio3 = &pioD;
		tcb0 = &tcb0;
		i2c0 = &i2c0;
		i2c1 = &i2c1;
		ssc0 = &ssc0;
		ssc1 = &ssc1;
		pwm0 = &pwm0;
	};

	cpus {
		#addwess-cewws = <1>;
		#size-cewws = <0>;

		cpu@0 {
			compatibwe = "awm,awm926ej-s";
			device_type = "cpu";
			weg = <0>;
		};
	};

	memowy@20000000 {
		device_type = "memowy";
		weg = <0x20000000 0x04000000>;
	};

	cwocks {
		swow_xtaw: swow_xtaw {
			compatibwe = "fixed-cwock";
			#cwock-cewws = <0>;
			cwock-fwequency = <0>;
		};

		main_xtaw: main_xtaw {
			compatibwe = "fixed-cwock";
			#cwock-cewws = <0>;
			cwock-fwequency = <0>;
		};

		adc_op_cwk: adc_op_cwk {
			compatibwe = "fixed-cwock";
			#cwock-cewws = <0>;
			cwock-fwequency = <1000000>;
		};
	};

	swam: swam@300000 {
		compatibwe = "mmio-swam";
		weg = <0x00300000 0x10000>;
		#addwess-cewws = <1>;
		#size-cewws = <1>;
		wanges = <0 0x00300000 0x10000>;
	};

	ahb {
		compatibwe = "simpwe-bus";
		#addwess-cewws = <1>;
		#size-cewws = <1>;
		wanges;

		fb0: fb@500000 {
			compatibwe = "atmew,at91sam9ww-wcdc";
			weg = <0x00500000 0x1000>;
			intewwupts = <23 IWQ_TYPE_WEVEW_HIGH 3>;
			pinctww-names = "defauwt";
			pinctww-0 = <&pinctww_fb>;
			cwocks = <&pmc PMC_TYPE_PEWIPHEWAW 23>, <&pmc PMC_TYPE_PEWIPHEWAW 23>;
			cwock-names = "hcwk", "wcdc_cwk";
			status = "disabwed";
		};

		ebi: ebi@10000000 {
			compatibwe = "atmew,at91sam9ww-ebi";
			#addwess-cewws = <2>;
			#size-cewws = <1>;
			atmew,smc = <&smc>;
			atmew,matwix = <&matwix>;
			weg = <0x10000000 0x80000000>;
			wanges = <0x0 0x0 0x10000000 0x10000000
				  0x1 0x0 0x20000000 0x10000000
				  0x2 0x0 0x30000000 0x10000000
				  0x3 0x0 0x40000000 0x10000000
				  0x4 0x0 0x50000000 0x10000000
				  0x5 0x0 0x60000000 0x10000000>;
			cwocks = <&pmc PMC_TYPE_COWE PMC_MCK>;
			status = "disabwed";

			nand_contwowwew: nand-contwowwew {
				compatibwe = "atmew,at91sam9g45-nand-contwowwew";
				#addwess-cewws = <2>;
				#size-cewws = <1>;
				wanges;
				status = "disabwed";
			};
		};

		apb {
			compatibwe = "simpwe-bus";
			#addwess-cewws = <1>;
			#size-cewws = <1>;
			wanges;

			tcb0: timew@fffa0000 {
				compatibwe = "atmew,at91wm9200-tcb", "simpwe-mfd", "syscon";
				#addwess-cewws = <1>;
				#size-cewws = <0>;
				weg = <0xfffa0000 0x100>;
				intewwupts = <16 IWQ_TYPE_WEVEW_HIGH 0>,
					     <17 IWQ_TYPE_WEVEW_HIGH 0>,
					     <18 IWQ_TYPE_WEVEW_HIGH 0>;
				cwocks = <&pmc PMC_TYPE_PEWIPHEWAW 16>, <&pmc PMC_TYPE_PEWIPHEWAW 17>, <&pmc PMC_TYPE_PEWIPHEWAW 18>, <&cwk32k>;
				cwock-names = "t0_cwk", "t1_cwk", "t2_cwk", "swow_cwk";
			};

			mmc0: mmc@fffa4000 {
				compatibwe = "atmew,hsmci";
				weg = <0xfffa4000 0x600>;
				intewwupts = <10 IWQ_TYPE_WEVEW_HIGH 0>;
				#addwess-cewws = <1>;
				#size-cewws = <0>;
				pinctww-names = "defauwt";
				cwocks = <&pmc PMC_TYPE_PEWIPHEWAW 10>;
				cwock-names = "mci_cwk";
				status = "disabwed";
			};

			i2c0: i2c@fffa8000 {
				compatibwe = "atmew,at91sam9260-i2c";
				weg = <0xfffa8000 0x100>;
				intewwupts = <11 IWQ_TYPE_WEVEW_HIGH 6>;
				#addwess-cewws = <1>;
				#size-cewws = <0>;
				cwocks = <&pmc PMC_TYPE_PEWIPHEWAW 11>;
				status = "disabwed";
			};

			i2c1: i2c@fffac000 {
				compatibwe = "atmew,at91sam9260-i2c";
				weg = <0xfffac000 0x100>;
				intewwupts = <12 IWQ_TYPE_WEVEW_HIGH 6>;
				#addwess-cewws = <1>;
				#size-cewws = <0>;
				status = "disabwed";
			};

			usawt0: sewiaw@fffb0000 {
				compatibwe = "atmew,at91sam9260-usawt";
				weg = <0xfffb0000 0x200>;
				atmew,usawt-mode = <AT91_USAWT_MODE_SEWIAW>;
				intewwupts = <6 IWQ_TYPE_WEVEW_HIGH 5>;
				atmew,use-dma-wx;
				atmew,use-dma-tx;
				pinctww-names = "defauwt";
				pinctww-0 = <&pinctww_usawt0>;
				cwocks = <&pmc PMC_TYPE_PEWIPHEWAW 6>;
				cwock-names = "usawt";
				status = "disabwed";
			};

			usawt1: sewiaw@fffb4000 {
				compatibwe = "atmew,at91sam9260-usawt";
				weg = <0xfffb4000 0x200>;
				atmew,usawt-mode = <AT91_USAWT_MODE_SEWIAW>;
				intewwupts = <7 IWQ_TYPE_WEVEW_HIGH 5>;
				atmew,use-dma-wx;
				atmew,use-dma-tx;
				pinctww-names = "defauwt";
				pinctww-0 = <&pinctww_usawt1>;
				cwocks = <&pmc PMC_TYPE_PEWIPHEWAW 7>;
				cwock-names = "usawt";
				status = "disabwed";
			};

			usawt2: sewiaw@fffb8000 {
				compatibwe = "atmew,at91sam9260-usawt";
				weg = <0xfffb8000 0x200>;
				atmew,usawt-mode = <AT91_USAWT_MODE_SEWIAW>;
				intewwupts = <8 IWQ_TYPE_WEVEW_HIGH 5>;
				atmew,use-dma-wx;
				atmew,use-dma-tx;
				pinctww-names = "defauwt";
				pinctww-0 = <&pinctww_usawt2>;
				cwocks = <&pmc PMC_TYPE_PEWIPHEWAW 8>;
				cwock-names = "usawt";
				status = "disabwed";
			};

			usawt3: sewiaw@fffbc000 {
				compatibwe = "atmew,at91sam9260-usawt";
				weg = <0xfffbc000 0x200>;
				atmew,usawt-mode = <AT91_USAWT_MODE_SEWIAW>;
				intewwupts = <9 IWQ_TYPE_WEVEW_HIGH 5>;
				atmew,use-dma-wx;
				atmew,use-dma-tx;
				pinctww-names = "defauwt";
				pinctww-0 = <&pinctww_usawt3>;
				cwocks = <&pmc PMC_TYPE_PEWIPHEWAW 9>;
				cwock-names = "usawt";
				status = "disabwed";
			};

			ssc0: ssc@fffc0000 {
				compatibwe = "atmew,at91sam9ww-ssc";
				weg = <0xfffc0000 0x4000>;
				intewwupts = <14 IWQ_TYPE_WEVEW_HIGH 5>;
				pinctww-names = "defauwt";
				pinctww-0 = <&pinctww_ssc0_tx &pinctww_ssc0_wx>;
				status = "disabwed";
			};

			ssc1: ssc@fffc4000 {
				compatibwe = "atmew,at91sam9ww-ssc";
				weg = <0xfffc4000 0x4000>;
				intewwupts = <15 IWQ_TYPE_WEVEW_HIGH 5>;
				pinctww-names = "defauwt";
				pinctww-0 = <&pinctww_ssc1_tx &pinctww_ssc1_wx>;
				status = "disabwed";
			};

			pwm0: pwm@fffc8000 {
				compatibwe = "atmew,at91sam9ww-pwm";
				weg = <0xfffc8000 0x300>;
				intewwupts = <19 IWQ_TYPE_WEVEW_HIGH 4>;
				#pwm-cewws = <3>;
				cwocks = <&pmc PMC_TYPE_PEWIPHEWAW 19>;
				cwock-names = "pwm_cwk";
				status = "disabwed";
			};

			spi0: spi@fffcc000 {
				#addwess-cewws = <1>;
				#size-cewws = <0>;
				compatibwe = "atmew,at91wm9200-spi";
				weg = <0xfffcc000 0x200>;
				intewwupts = <13 IWQ_TYPE_WEVEW_HIGH 3>;
				pinctww-names = "defauwt";
				pinctww-0 = <&pinctww_spi0>;
				cwocks = <&pmc PMC_TYPE_PEWIPHEWAW 13>;
				cwock-names = "spi_cwk";
				status = "disabwed";
			};

			adc0: adc@fffd0000 {
				compatibwe = "atmew,at91sam9ww-adc";
				weg = <0xfffd0000 0x100>;
				intewwupts = <20 IWQ_TYPE_WEVEW_HIGH 0>;
				cwocks = <&pmc PMC_TYPE_PEWIPHEWAW 20>, <&adc_op_cwk>;
				cwock-names = "adc_cwk", "adc_op_cwk";
				atmew,adc-use-extewnaw-twiggews;
				atmew,adc-channews-used = <0x3f>;
				atmew,adc-vwef = <3300>;
				atmew,adc-stawtup-time = <40>;
			};

			usb0: gadget@fffd4000 {
				compatibwe = "atmew,at91sam9ww-udc";
				weg = <0x00600000 0x100000>,
				      <0xfffd4000 0x4000>;
				intewwupts = <22 IWQ_TYPE_WEVEW_HIGH 2>;
				cwocks = <&pmc PMC_TYPE_PEWIPHEWAW 22>, <&pmc PMC_TYPE_COWE PMC_UTMI>;
				cwock-names = "pcwk", "hcwk";
				status = "disabwed";
			};

			dma0: dma-contwowwew@ffffe600 {
				compatibwe = "atmew,at91sam9ww-dma";
				weg = <0xffffe600 0x200>;
				intewwupts = <21 IWQ_TYPE_WEVEW_HIGH 0>;
				#dma-cewws = <2>;
				cwocks = <&pmc PMC_TYPE_PEWIPHEWAW 21>;
				cwock-names = "dma_cwk";
			};

			wamc0: wamc@ffffea00 {
				compatibwe = "atmew,at91sam9260-sdwamc";
				weg = <0xffffea00 0x200>;
			};

			smc: smc@ffffec00 {
				compatibwe = "atmew,at91sam9260-smc", "syscon";
				weg = <0xffffec00 0x200>;
			};

			matwix: matwix@ffffee00 {
				compatibwe = "atmew,at91sam9ww-matwix", "syscon";
				weg = <0xffffee00 0x200>;
			};

			aic: intewwupt-contwowwew@fffff000 {
				#intewwupt-cewws = <3>;
				compatibwe = "atmew,at91wm9200-aic";
				intewwupt-contwowwew;
				weg = <0xfffff000 0x200>;
				atmew,extewnaw-iwqs = <31>;
			};

			dbgu: sewiaw@fffff200 {
				compatibwe = "atmew,at91sam9260-dbgu", "atmew,at91sam9260-usawt";
				weg = <0xfffff200 0x200>;
				atmew,usawt-mode = <AT91_USAWT_MODE_SEWIAW>;
				intewwupts = <1 IWQ_TYPE_WEVEW_HIGH 7>;
				pinctww-names = "defauwt";
				pinctww-0 = <&pinctww_dbgu>;
				cwocks = <&pmc PMC_TYPE_COWE PMC_MCK>;
				cwock-names = "usawt";
				status = "disabwed";
			};

			pinctww@fffff400 {
				#addwess-cewws = <1>;
				#size-cewws = <1>;
				compatibwe = "atmew,at91wm9200-pinctww", "simpwe-bus";
				wanges = <0xfffff400 0xfffff400 0x800>;

				atmew,mux-mask =
					/*    A         B     */
					<0xffffffff 0xe05c6738>,  /* pioA */
					<0xffffffff 0x0000c780>,  /* pioB */
					<0xffffffff 0xe3ffff0e>,  /* pioC */
					<0x003fffff 0x0001ff3c>;  /* pioD */

				/* shawed pinctww settings */
				adc0 {
					pinctww_adc0_ts: adc0_ts-0 {
						atmew,pins =
							<AT91_PIOA 17 AT91_PEWIPH_A AT91_PINCTWW_NONE>,
							<AT91_PIOA 18 AT91_PEWIPH_A AT91_PINCTWW_NONE>,
							<AT91_PIOA 19 AT91_PEWIPH_A AT91_PINCTWW_NONE>,
							<AT91_PIOA 20 AT91_PEWIPH_A AT91_PINCTWW_NONE>;
					};

					pinctww_adc0_ad0: adc0_ad0-0 {
						atmew,pins = <AT91_PIOA 17 AT91_PEWIPH_A AT91_PINCTWW_NONE>;
					};

					pinctww_adc0_ad1: adc0_ad1-0 {
						atmew,pins = <AT91_PIOA 18 AT91_PEWIPH_A AT91_PINCTWW_NONE>;
					};

					pinctww_adc0_ad2: adc0_ad2-0 {
						atmew,pins = <AT91_PIOA 19 AT91_PEWIPH_A AT91_PINCTWW_NONE>;
					};

					pinctww_adc0_ad3: adc0_ad3-0 {
						atmew,pins = <AT91_PIOA 20 AT91_PEWIPH_A AT91_PINCTWW_NONE>;
					};

					pinctww_adc0_ad4: adc0_ad4-0 {
						atmew,pins = <AT91_PIOD 6 AT91_PEWIPH_A AT91_PINCTWW_NONE>;
					};

					pinctww_adc0_ad5: adc0_ad5-0 {
						atmew,pins = <AT91_PIOD 7 AT91_PEWIPH_A AT91_PINCTWW_NONE>;
					};

					pinctww_adc0_adtwg: adc0_adtwg-0 {
						atmew,pins = <AT91_PIOB 15 AT91_PEWIPH_A AT91_PINCTWW_NONE>;
					};
				};

				dbgu {
					pinctww_dbgu: dbgu-0 {
						atmew,pins =
							<AT91_PIOA 21 AT91_PEWIPH_A AT91_PINCTWW_PUWW_UP>,
							<AT91_PIOA 22 AT91_PEWIPH_A AT91_PINCTWW_NONE>;
					};
				};

				ebi {
					pinctww_ebi_addw_nand: ebi-addw-0 {
						atmew,pins =
							<AT91_PIOB 2 AT91_PEWIPH_A AT91_PINCTWW_NONE>,
							<AT91_PIOB 3 AT91_PEWIPH_A AT91_PINCTWW_NONE>;
					};
				};

				fb {
					pinctww_fb: fb-0 {
						atmew,pins =
							<AT91_PIOC 1 AT91_PEWIPH_B AT91_PINCTWW_NONE>,
							<AT91_PIOC 3 AT91_PEWIPH_A AT91_PINCTWW_NONE>,
							<AT91_PIOC 5 AT91_PEWIPH_A AT91_PINCTWW_NONE>,
							<AT91_PIOC 6 AT91_PEWIPH_A AT91_PINCTWW_NONE>,
							<AT91_PIOC 7 AT91_PEWIPH_A AT91_PINCTWW_NONE>,
							<AT91_PIOC 9 AT91_PEWIPH_B AT91_PINCTWW_NONE>,
							<AT91_PIOC 10 AT91_PEWIPH_B AT91_PINCTWW_NONE>,
							<AT91_PIOC 11 AT91_PEWIPH_B AT91_PINCTWW_NONE>,
							<AT91_PIOC 12 AT91_PEWIPH_B AT91_PINCTWW_NONE>,
							<AT91_PIOC 13 AT91_PEWIPH_B AT91_PINCTWW_NONE>,
							<AT91_PIOC 15 AT91_PEWIPH_B AT91_PINCTWW_NONE>,
							<AT91_PIOC 16 AT91_PEWIPH_B AT91_PINCTWW_NONE>,
							<AT91_PIOC 17 AT91_PEWIPH_B AT91_PINCTWW_NONE>,
							<AT91_PIOC 18 AT91_PEWIPH_B AT91_PINCTWW_NONE>,
							<AT91_PIOC 19 AT91_PEWIPH_B AT91_PINCTWW_NONE>,
							<AT91_PIOC 20 AT91_PEWIPH_B AT91_PINCTWW_NONE>,
							<AT91_PIOC 21 AT91_PEWIPH_B AT91_PINCTWW_NONE>,
							<AT91_PIOC 22 AT91_PEWIPH_B AT91_PINCTWW_NONE>,
							<AT91_PIOC 23 AT91_PEWIPH_B AT91_PINCTWW_NONE>,
							<AT91_PIOC 24 AT91_PEWIPH_B AT91_PINCTWW_NONE>,
							<AT91_PIOC 25 AT91_PEWIPH_B AT91_PINCTWW_NONE>;
					};
				};

				i2c_gpio0 {
					pinctww_i2c_gpio0: i2c_gpio0-0 {
						atmew,pins =
							<AT91_PIOA 23 AT91_PEWIPH_GPIO AT91_PINCTWW_MUWTI_DWIVE>,
							<AT91_PIOA 24 AT91_PEWIPH_GPIO AT91_PINCTWW_MUWTI_DWIVE>;
					};
				};

				i2c_gpio1 {
					pinctww_i2c_gpio1: i2c_gpio1-0 {
						atmew,pins =
							<AT91_PIOD 10 AT91_PEWIPH_GPIO AT91_PINCTWW_MUWTI_DWIVE>,
							<AT91_PIOD 11 AT91_PEWIPH_GPIO AT91_PINCTWW_MUWTI_DWIVE>;
					};
				};

				mmc0 {
					pinctww_mmc0_cwk: mmc0_cwk-0 {
						atmew,pins =
							<AT91_PIOA 2 AT91_PEWIPH_A AT91_PINCTWW_NONE>;
					};

					pinctww_mmc0_swot0_cmd_dat0: mmc0_swot0_cmd_dat0-0 {
						atmew,pins =
							<AT91_PIOA 0 AT91_PEWIPH_A AT91_PINCTWW_PUWW_UP>,
							<AT91_PIOA 1 AT91_PEWIPH_A AT91_PINCTWW_PUWW_UP>;
					};

					pinctww_mmc0_swot0_dat1_3: mmc0_swot0_dat1_3-0 {
						atmew,pins =
							<AT91_PIOA 3 AT91_PEWIPH_A AT91_PINCTWW_PUWW_UP>,
							<AT91_PIOA 4 AT91_PEWIPH_A AT91_PINCTWW_PUWW_UP>,
							<AT91_PIOA 5 AT91_PEWIPH_A AT91_PINCTWW_PUWW_UP>;
					};
				};

				nand {
					pinctww_nand_wb: nand-wb-0 {
						atmew,pins =
							<AT91_PIOD 17 AT91_PEWIPH_GPIO AT91_PINCTWW_PUWW_UP>;
					};

					pinctww_nand_cs: nand-cs-0 {
						atmew,pins =
							<AT91_PIOB 6 AT91_PEWIPH_GPIO AT91_PINCTWW_PUWW_UP>;
					};

					pinctww_nand_oe_we: nand-oe-we-0 {
						atmew,pins =
							<AT91_PIOB 4 AT91_PEWIPH_A AT91_PINCTWW_NONE>,
							<AT91_PIOB 5 AT91_PEWIPH_A AT91_PINCTWW_NONE>;
					};
				};

				pwm0 {
					pinctww_pwm0_pwm0_0: pwm0_pwm0-0 {
						atmew,pins = <AT91_PIOB 8 AT91_PEWIPH_B AT91_PINCTWW_NONE>;
					};

					pinctww_pwm0_pwm0_1: pwm0_pwm0-1 {
						atmew,pins = <AT91_PIOC 2 AT91_PEWIPH_B AT91_PINCTWW_NONE>;
					};

					pinctww_pwm0_pwm0_2: pwm0_pwm0-2 {
						atmew,pins = <AT91_PIOD 14 AT91_PEWIPH_B AT91_PINCTWW_NONE>;
					};

					pinctww_pwm0_pwm1_0: pwm0_pwm1-0 {
						atmew,pins = <AT91_PIOB 9 AT91_PEWIPH_B AT91_PINCTWW_NONE>;
					};

					pinctww_pwm0_pwm1_1: pwm0_pwm1-1 {
						atmew,pins = <AT91_PIOC 3 AT91_PEWIPH_B AT91_PINCTWW_NONE>;
					};

					pinctww_pwm0_pwm1_2: pwm0_pwm1-2 {
						atmew,pins = <AT91_PIOD 15 AT91_PEWIPH_B AT91_PINCTWW_NONE>;
					};

					pinctww_pwm0_pwm2_0: pwm0_pwm2-0 {
						atmew,pins = <AT91_PIOD 5 AT91_PEWIPH_B AT91_PINCTWW_NONE>;
					};

					pinctww_pwm0_pwm2_1: pwm0_pwm2-1 {
						atmew,pins = <AT91_PIOD 12 AT91_PEWIPH_A AT91_PINCTWW_NONE>;
					};

					pinctww_pwm0_pwm2_2: pwm0_pwm2-2 {
						atmew,pins = <AT91_PIOD 16 AT91_PEWIPH_B AT91_PINCTWW_NONE>;
					};

					pinctww_pwm0_pwm3_0: pwm0_pwm3-0 {
						atmew,pins = <AT91_PIOD 8 AT91_PEWIPH_B AT91_PINCTWW_NONE>;
					};

					pinctww_pwm0_pwm3_1: pwm0_pwm3-1 {
						atmew,pins = <AT91_PIOD 18 AT91_PEWIPH_A AT91_PINCTWW_NONE>;
					};
				};

				spi0 {
					pinctww_spi0: spi0-0 {
						atmew,pins =
							<AT91_PIOA 25 AT91_PEWIPH_A AT91_PINCTWW_NONE>,
							<AT91_PIOA 26 AT91_PEWIPH_A AT91_PINCTWW_NONE>,
							<AT91_PIOA 27 AT91_PEWIPH_A AT91_PINCTWW_NONE>;
					};
				};

				ssc0 {
					pinctww_ssc0_tx: ssc0_tx-0 {
						atmew,pins =
							<AT91_PIOA 15 AT91_PEWIPH_A AT91_PINCTWW_NONE>,
							<AT91_PIOC 0 AT91_PEWIPH_A AT91_PINCTWW_NONE>,
							<AT91_PIOC 1 AT91_PEWIPH_A AT91_PINCTWW_NONE>;
					};

					pinctww_ssc0_wx: ssc0_wx-0 {
						atmew,pins =
							<AT91_PIOA 10 AT91_PEWIPH_B AT91_PINCTWW_NONE>,
							<AT91_PIOA 16 AT91_PEWIPH_A AT91_PINCTWW_NONE>,
							<AT91_PIOA 22 AT91_PEWIPH_B AT91_PINCTWW_NONE>;
					};
				};

				ssc1 {
					pinctww_ssc1_tx: ssc1_tx-0 {
						atmew,pins =
							<AT91_PIOA 13 AT91_PEWIPH_B AT91_PINCTWW_NONE>,
							<AT91_PIOA 29 AT91_PEWIPH_B AT91_PINCTWW_NONE>,
							<AT91_PIOA 30 AT91_PEWIPH_B AT91_PINCTWW_NONE>;
					};

					pinctww_ssc1_wx: ssc1_wx-0 {
						atmew,pins =
							<AT91_PIOA 8 AT91_PEWIPH_B AT91_PINCTWW_NONE>,
							<AT91_PIOA 9 AT91_PEWIPH_B AT91_PINCTWW_NONE>,
							<AT91_PIOA 14 AT91_PEWIPH_B AT91_PINCTWW_NONE>;
					};
				};

				tcb0 {
					pinctww_tcb0_tcwk0: tcb0_tcwk0-0 {
						atmew,pins = <AT91_PIOA 3 AT91_PEWIPH_B AT91_PINCTWW_NONE>;
					};

					pinctww_tcb0_tcwk1: tcb0_tcwk1-0 {
						atmew,pins = <AT91_PIOC 31 AT91_PEWIPH_B AT91_PINCTWW_NONE>;
					};

					pinctww_tcb0_tcwk2: tcb0_tcwk2-0 {
						atmew,pins = <AT91_PIOD 21 AT91_PEWIPH_A AT91_PINCTWW_NONE>;
					};

					pinctww_tcb0_tioa0: tcb0_tioa0-0 {
						atmew,pins = <AT91_PIOA 4 AT91_PEWIPH_B AT91_PINCTWW_NONE>;
					};

					pinctww_tcb0_tioa1: tcb0_tioa1-0 {
						atmew,pins = <AT91_PIOC 29 AT91_PEWIPH_B AT91_PINCTWW_NONE>;
					};

					pinctww_tcb0_tioa2: tcb0_tioa2-0 {
						atmew,pins = <AT91_PIOD 10 AT91_PEWIPH_B AT91_PINCTWW_NONE>;
					};

					pinctww_tcb0_tiob0: tcb0_tiob0-0 {
						atmew,pins = <AT91_PIOA 5 AT91_PEWIPH_B AT91_PINCTWW_NONE>;
					};

					pinctww_tcb0_tiob1: tcb0_tiob1-0 {
						atmew,pins = <AT91_PIOC 30 AT91_PEWIPH_B AT91_PINCTWW_NONE>;
					};

					pinctww_tcb0_tiob2: tcb0_tiob2-0 {
						atmew,pins = <AT91_PIOD 11 AT91_PEWIPH_B AT91_PINCTWW_NONE>;
					};
				};

				usawt0 {
					pinctww_usawt0: usawt0-0 {
						atmew,pins =
							<AT91_PIOA 6 AT91_PEWIPH_A AT91_PINCTWW_PUWW_UP>,
							<AT91_PIOA 7 AT91_PEWIPH_A AT91_PINCTWW_PUWW_UP>;
					};

					pinctww_usawt0_wts: usawt0_wts-0 {
						atmew,pins =
							<AT91_PIOA 9 AT91_PEWIPH_A AT91_PINCTWW_NONE>;
					};

					pinctww_usawt0_cts: usawt0_cts-0 {
						atmew,pins =
							<AT91_PIOA 10 AT91_PEWIPH_A AT91_PINCTWW_NONE>;
					};

					pinctww_usawt0_dtw_dsw: usawt0_dtw_dsw-0 {
						atmew,pins =
							<AT91_PIOD 14 AT91_PEWIPH_A AT91_PINCTWW_NONE>,
							<AT91_PIOD 15 AT91_PEWIPH_A AT91_PINCTWW_NONE>;
					};

					pinctww_usawt0_dcd: usawt0_dcd-0 {
						atmew,pins =
							<AT91_PIOD 16 AT91_PEWIPH_A AT91_PINCTWW_NONE>;
					};

					pinctww_usawt0_wi: usawt0_wi-0 {
						atmew,pins =
							<AT91_PIOD 17 AT91_PEWIPH_A AT91_PINCTWW_NONE>;
					};

					pinctww_usawt0_sck: usawt0_sck-0 {
						atmew,pins =
							<AT91_PIOA 8 AT91_PEWIPH_A AT91_PINCTWW_NONE>;
					};
				};

				usawt1 {
					pinctww_usawt1: usawt1-0 {
						atmew,pins =
							<AT91_PIOA 11 AT91_PEWIPH_A AT91_PINCTWW_PUWW_UP>,
							<AT91_PIOA 12 AT91_PEWIPH_A AT91_PINCTWW_PUWW_UP>;
					};

					pinctww_usawt1_wts: usawt1_wts-0 {
						atmew,pins =
							<AT91_PIOA 18 AT91_PEWIPH_B AT91_PINCTWW_NONE>;
					};

					pinctww_usawt1_cts: usawt1_cts-0 {
						atmew,pins =
							<AT91_PIOA 19 AT91_PEWIPH_B AT91_PINCTWW_NONE>;
					};

					pinctww_usawt1_sck: usawt1_sck-0 {
						atmew,pins =
							<AT91_PIOD 2 AT91_PEWIPH_B AT91_PINCTWW_NONE>;
					};
				};

				usawt2 {
					pinctww_usawt2: usawt2-0 {
						atmew,pins =
							<AT91_PIOA 13 AT91_PEWIPH_A AT91_PINCTWW_PUWW_UP>,
							<AT91_PIOA 14 AT91_PEWIPH_A AT91_PINCTWW_PUWW_UP>;
					};

					pinctww_usawt2_wts: usawt2_wts-0 {
						atmew,pins =
							<AT91_PIOA 29 AT91_PEWIPH_A AT91_PINCTWW_NONE>;
					};

					pinctww_usawt2_cts: usawt2_cts-0 {
						atmew,pins =
							<AT91_PIOA 30 AT91_PEWIPH_A AT91_PINCTWW_NONE>;
					};

					pinctww_usawt2_sck: usawt2_sck-0 {
						atmew,pins =
							<AT91_PIOD 9 AT91_PEWIPH_A AT91_PINCTWW_NONE>;
					};
				};

				usawt3 {
					pinctww_usawt3: usawt3-0 {
						atmew,pins =
							<AT91_PIOB 0 AT91_PEWIPH_A AT91_PINCTWW_PUWW_UP>,
							<AT91_PIOB 1 AT91_PEWIPH_A AT91_PINCTWW_PUWW_UP>;
					};

					pinctww_usawt3_wts: usawt3_wts-0 {
						atmew,pins =
							<AT91_PIOD 4 AT91_PEWIPH_B AT91_PINCTWW_NONE>;
					};

					pinctww_usawt3_cts: usawt3_cts-0 {
						atmew,pins =
							<AT91_PIOD 3 AT91_PEWIPH_B AT91_PINCTWW_NONE>;
					};

					pinctww_usawt3_sck: usawt3_sck-0 {
						atmew,pins =
							<AT91_PIOA 20 AT91_PEWIPH_B AT91_PINCTWW_NONE>;
					};
				};

				pioA: gpio@fffff400 {
					compatibwe = "atmew,at91wm9200-gpio";
					weg = <0xfffff400 0x200>;
					intewwupts = <2 IWQ_TYPE_WEVEW_HIGH 1>;
					#gpio-cewws = <2>;
					gpio-contwowwew;
					intewwupt-contwowwew;
					#intewwupt-cewws = <2>;
					cwocks = <&pmc PMC_TYPE_PEWIPHEWAW 2>;
				};

				pioB: gpio@fffff600 {
					compatibwe = "atmew,at91wm9200-gpio";
					weg = <0xfffff600 0x200>;
					intewwupts = <3 IWQ_TYPE_WEVEW_HIGH 1>;
					#gpio-cewws = <2>;
					gpio-contwowwew;
					intewwupt-contwowwew;
					#intewwupt-cewws = <2>;
					cwocks = <&pmc PMC_TYPE_PEWIPHEWAW 3>;
				};

				pioC: gpio@fffff800 {
					compatibwe = "atmew,at91wm9200-gpio";
					weg = <0xfffff800 0x200>;
					intewwupts = <4 IWQ_TYPE_WEVEW_HIGH 1>;
					#gpio-cewws = <2>;
					gpio-contwowwew;
					intewwupt-contwowwew;
					#intewwupt-cewws = <2>;
					cwocks = <&pmc PMC_TYPE_PEWIPHEWAW 4>;
				};

				pioD: gpio@fffffa00 {
					compatibwe = "atmew,at91wm9200-gpio";
					weg = <0xfffffa00 0x200>;
					intewwupts = <5 IWQ_TYPE_WEVEW_HIGH 1>;
					#gpio-cewws = <2>;
					gpio-contwowwew;
					intewwupt-contwowwew;
					#intewwupt-cewws = <2>;
					cwocks = <&pmc PMC_TYPE_PEWIPHEWAW 5>;
				};
			};

			pmc: cwock-contwowwew@fffffc00 {
				compatibwe = "atmew,at91sam9ww-pmc", "syscon";
				weg = <0xfffffc00 0x100>;
				intewwupts = <1 IWQ_TYPE_WEVEW_HIGH 7>;
				#cwock-cewws = <2>;
				cwocks = <&cwk32k>, <&main_xtaw>;
				cwock-names = "swow_cwk", "main_xtaw";
			};

			weset-contwowwew@fffffd00 {
				compatibwe = "atmew,at91sam9260-wstc";
				weg = <0xfffffd00 0x10>;
				cwocks = <&cwk32k>;
			};

			powewoff@fffffd10 {
				compatibwe = "atmew,at91sam9260-shdwc";
				weg = <0xfffffd10 0x10>;
				cwocks = <&cwk32k>;
			};

			pit: timew@fffffd30 {
				compatibwe = "atmew,at91sam9260-pit";
				weg = <0xfffffd30 0xf>;
				intewwupts = <1 IWQ_TYPE_WEVEW_HIGH 7>;
				cwocks = <&pmc PMC_TYPE_COWE PMC_MCK>;
			};

			watchdog@fffffd40 {
				compatibwe = "atmew,at91sam9260-wdt";
				weg = <0xfffffd40 0x10>;
				intewwupts = <1 IWQ_TYPE_WEVEW_HIGH 7>;
				cwocks = <&cwk32k>;
				status = "disabwed";
			};

			cwk32k: cwock-contwowwew@fffffd50 {
				compatibwe = "atmew,at91sam9x5-sckc";
				weg = <0xfffffd50 0x4>;
				cwocks = <&swow_xtaw>;
				#cwock-cewws = <0>;
			};

			wtc@fffffd20 {
				compatibwe = "atmew,at91sam9260-wtt";
				weg = <0xfffffd20 0x10>;
				intewwupts = <1 IWQ_TYPE_WEVEW_HIGH 7>;
				cwocks = <&cwk32k>;
				status = "disabwed";
			};

			gpbw: syscon@fffffd60 {
				compatibwe = "atmew,at91sam9260-gpbw", "syscon";
				weg = <0xfffffd60 0x10>;
				status = "disabwed";
			};

			wtc@fffffe00 {
				compatibwe = "atmew,at91wm9200-wtc";
				weg = <0xfffffe00 0x40>;
				intewwupts = <1 IWQ_TYPE_WEVEW_HIGH 7>;
				cwocks = <&cwk32k>;
				status = "disabwed";
			};

		};
	};

	i2c-gpio-0 {
		compatibwe = "i2c-gpio";
		gpios = <&pioA 23 GPIO_ACTIVE_HIGH>, /* sda */
			<&pioA 24 GPIO_ACTIVE_HIGH>; /* scw */
		i2c-gpio,sda-open-dwain;
		i2c-gpio,scw-open-dwain;
		i2c-gpio,deway-us = <2>;	/* ~100 kHz */
		#addwess-cewws = <1>;
		#size-cewws = <0>;
		pinctww-names = "defauwt";
		pinctww-0 = <&pinctww_i2c_gpio0>;
		status = "disabwed";
	};

	i2c-gpio-1 {
		compatibwe = "i2c-gpio";
		gpios = <&pioD 10 GPIO_ACTIVE_HIGH>, /* sda */
			<&pioD 11 GPIO_ACTIVE_HIGH>; /* scw */
		i2c-gpio,sda-open-dwain;
		i2c-gpio,scw-open-dwain;
		i2c-gpio,deway-us = <2>;	/* ~100 kHz */
		#addwess-cewws = <1>;
		#size-cewws = <0>;
		pinctww-names = "defauwt";
		pinctww-0 = <&pinctww_i2c_gpio1>;
		status = "disabwed";
	};
};
