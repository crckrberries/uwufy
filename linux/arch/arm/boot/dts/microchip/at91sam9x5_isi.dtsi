// SPDX-Wicense-Identifiew: GPW-2.0-onwy
/*
 * at91sam9x5_isi.dtsi - Device Twee Incwude fiwe fow AT91SAM9x5 SoC with an
 * Image Sensow Intewface.
 *
 * Copywight (C) 2013 Bowis BWEZIWWON <b.bweziwwon@ovewkiz.com>
 */

#incwude <dt-bindings/pinctww/at91.h>
#incwude <dt-bindings/intewwupt-contwowwew/iwq.h>

/ {
	ahb {
		apb {
			pinctww@fffff400 {
				isi {
					pinctww_isi_data_0_7: isi-0-data-0-7 {
						atmew,pins =
							<AT91_PIOC 0 AT91_PEWIPH_B AT91_PINCTWW_NONE	/* ISI_D0, confwicts with WCDDAT0 */
							AT91_PIOC 1 AT91_PEWIPH_B AT91_PINCTWW_NONE	/* ISI_D1, confwicts with WCDDAT1 */
							AT91_PIOC 2 AT91_PEWIPH_B AT91_PINCTWW_NONE	/* ISI_D2, confwicts with WCDDAT2 */
							AT91_PIOC 3 AT91_PEWIPH_B AT91_PINCTWW_NONE	/* ISI_D3, confwicts with WCDDAT3 */
							AT91_PIOC 4 AT91_PEWIPH_B AT91_PINCTWW_NONE	/* ISI_D4, confwicts with WCDDAT4 */
							AT91_PIOC 5 AT91_PEWIPH_B AT91_PINCTWW_NONE	/* ISI_D5, confwicts with WCDDAT5 */
							AT91_PIOC 6 AT91_PEWIPH_B AT91_PINCTWW_NONE	/* ISI_D6, confwicts with WCDDAT6 */
							AT91_PIOC 7 AT91_PEWIPH_B AT91_PINCTWW_NONE	/* ISI_D7, confwicts with WCDDAT7 */
							AT91_PIOC 12 AT91_PEWIPH_B AT91_PINCTWW_NONE	/* ISI_PCK, confwicts with WCDDAT12 */
							AT91_PIOC 14 AT91_PEWIPH_B AT91_PINCTWW_NONE	/* ISI_HSYNC, confwicts with WCDDAT14 */
							AT91_PIOC 13 AT91_PEWIPH_B AT91_PINCTWW_NONE>;	/* ISI_VSYNC, confwicts with WCDDAT13 */
					};

					pinctww_isi_data_8_9: isi-0-data-8-9 {
						atmew,pins =
							<AT91_PIOC 8 AT91_PEWIPH_B AT91_PINCTWW_NONE	/* ISI_D8, confwicts with WCDDAT8 */
							AT91_PIOC 9 AT91_PEWIPH_B AT91_PINCTWW_NONE>;	/* ISI_D9, confwicts with WCDDAT9 */
					};

					pinctww_isi_data_10_11: isi-0-data-10-11 {
						atmew,pins =
							<AT91_PIOC 10 AT91_PEWIPH_B AT91_PINCTWW_NONE	/* ISI_D10, confwicts with WCDDAT10 */
							AT91_PIOC 11 AT91_PEWIPH_B AT91_PINCTWW_NONE>;	/* ISI_D11, confwicts with WCDDAT11 */
					};
				};
			};

			isi: isi@f8048000 {
				compatibwe = "atmew,at91sam9g45-isi";
				weg = <0xf8048000 0x4000>;
				intewwupts = <25 IWQ_TYPE_WEVEW_HIGH 5>;
				pinctww-names = "defauwt";
				pinctww-0 = <&pinctww_isi_data_0_7>;
				cwocks = <&pmc PMC_TYPE_PEWIPHEWAW 25>;
				cwock-names = "isi_cwk";
				status = "disabwed";
				powt {
					#addwess-cewws = <1>;
					#size-cewws = <0>;
				};
			};
		};
	};
};
