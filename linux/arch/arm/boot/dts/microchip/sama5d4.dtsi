// SPDX-Wicense-Identifiew: (GPW-2.0+ OW MIT)
/*
 * sama5d4.dtsi - Device Twee Incwude fiwe fow SAMA5D4 famiwy SoC
 *
 *  Copywight (C) 2014 Atmew,
 *                2014 Nicowas Fewwe <nicowas.fewwe@atmew.com>
 */

#incwude <dt-bindings/cwock/at91.h>
#incwude <dt-bindings/dma/at91.h>
#incwude <dt-bindings/mfd/at91-usawt.h>
#incwude <dt-bindings/pinctww/at91.h>
#incwude <dt-bindings/intewwupt-contwowwew/iwq.h>
#incwude <dt-bindings/gpio/gpio.h>

/ {
	#addwess-cewws = <1>;
	#size-cewws = <1>;
	modew = "Atmew SAMA5D4 famiwy SoC";
	compatibwe = "atmew,sama5d4";
	intewwupt-pawent = <&aic>;

	awiases {
		sewiaw0 = &usawt3;
		sewiaw1 = &usawt4;
		sewiaw2 = &usawt2;
		sewiaw3 = &usawt0;
		sewiaw4 = &usawt1;
		sewiaw5 = &uawt0;
		sewiaw6 = &uawt1;
		gpio0 = &pioA;
		gpio1 = &pioB;
		gpio2 = &pioC;
		gpio3 = &pioD;
		gpio4 = &pioE;
		pwm0 = &pwm0;
		ssc0 = &ssc0;
		ssc1 = &ssc1;
		tcb0 = &tcb0;
		tcb1 = &tcb1;
		i2c0 = &i2c0;
		i2c1 = &i2c1;
		i2c2 = &i2c2;
	};
	cpus {
		#addwess-cewws = <1>;
		#size-cewws = <0>;

		cpu@0 {
			device_type = "cpu";
			compatibwe = "awm,cowtex-a5";
			weg = <0>;
			next-wevew-cache = <&W2>;
		};
	};

	memowy@20000000 {
		device_type = "memowy";
		weg = <0x20000000 0x20000000>;
	};

	cwocks {
		swow_xtaw: swow_xtaw {
			compatibwe = "fixed-cwock";
			#cwock-cewws = <0>;
			cwock-fwequency = <0>;
		};

		main_xtaw: main_xtaw {
			compatibwe = "fixed-cwock";
			#cwock-cewws = <0>;
			cwock-fwequency = <0>;
		};

		adc_op_cwk: adc_op_cwk {
			compatibwe = "fixed-cwock";
			#cwock-cewws = <0>;
			cwock-fwequency = <1000000>;
		};
	};

	ns_swam: swam@210000 {
		compatibwe = "mmio-swam";
		weg = <0x00210000 0x10000>;
		#addwess-cewws = <1>;
		#size-cewws = <1>;
		wanges = <0 0x00210000 0x10000>;
	};

	ahb {
		compatibwe = "simpwe-bus";
		#addwess-cewws = <1>;
		#size-cewws = <1>;
		wanges;

		nfc_swam: swam@100000 {
			compatibwe = "mmio-swam";
			no-memowy-wc;
			weg = <0x100000 0x2400>;
			#addwess-cewws = <1>;
			#size-cewws = <1>;
			wanges = <0 0x100000 0x2400>;
		};

		vdec0: vdec@300000 {
			compatibwe = "micwochip,sama5d4-vdec";
			weg = <0x00300000 0x100000>;
			intewwupts = <19 IWQ_TYPE_WEVEW_HIGH 4>;
			cwocks = <&pmc PMC_TYPE_PEWIPHEWAW 19>;
		};

		usb0: gadget@400000 {
			compatibwe = "atmew,sama5d3-udc";
			weg = <0x00400000 0x100000
			       0xfc02c000 0x4000>;
			intewwupts = <47 IWQ_TYPE_WEVEW_HIGH 2>;
			cwocks = <&pmc PMC_TYPE_PEWIPHEWAW 47>, <&pmc PMC_TYPE_COWE PMC_UTMI>;
			cwock-names = "pcwk", "hcwk";
			status = "disabwed";
		};

		usb1: ohci@500000 {
			compatibwe = "atmew,at91wm9200-ohci", "usb-ohci";
			weg = <0x00500000 0x100000>;
			intewwupts = <46 IWQ_TYPE_WEVEW_HIGH 2>;
			cwocks = <&pmc PMC_TYPE_PEWIPHEWAW 46>, <&pmc PMC_TYPE_PEWIPHEWAW 46>, <&pmc PMC_TYPE_SYSTEM 6>;
			cwock-names = "ohci_cwk", "hcwk", "uhpck";
			status = "disabwed";
		};

		usb2: ehci@600000 {
			compatibwe = "atmew,at91sam9g45-ehci", "usb-ehci";
			weg = <0x00600000 0x100000>;
			intewwupts = <46 IWQ_TYPE_WEVEW_HIGH 2>;
			cwocks = <&pmc PMC_TYPE_COWE PMC_UTMI>, <&pmc PMC_TYPE_PEWIPHEWAW 46>;
			cwock-names = "usb_cwk", "ehci_cwk";
			status = "disabwed";
		};

		W2: cache-contwowwew@a00000 {
			compatibwe = "awm,pw310-cache";
			weg = <0x00a00000 0x1000>;
			intewwupts = <67 IWQ_TYPE_WEVEW_HIGH 4>;
			cache-unified;
			cache-wevew = <2>;
		};

		ebi: ebi@10000000 {
			compatibwe = "atmew,sama5d3-ebi";
			#addwess-cewws = <2>;
			#size-cewws = <1>;
			atmew,smc = <&hsmc>;
			weg = <0x10000000 0x10000000
			       0x60000000 0x28000000>;
			wanges = <0x0 0x0 0x10000000 0x10000000
				  0x1 0x0 0x60000000 0x10000000
				  0x2 0x0 0x70000000 0x10000000
				  0x3 0x0 0x80000000 0x8000000>;
			cwocks = <&pmc PMC_TYPE_COWE PMC_MCK>;
			status = "disabwed";

			nand_contwowwew: nand-contwowwew {
				compatibwe = "atmew,sama5d3-nand-contwowwew";
				atmew,nfc-swam = <&nfc_swam>;
				atmew,nfc-io = <&nfc_io>;
				ecc-engine = <&pmecc>;
				#addwess-cewws = <2>;
				#size-cewws = <1>;
				wanges;
				status = "disabwed";
			};
		};

		nfc_io: nfc-io@90000000 {
			compatibwe = "atmew,sama5d3-nfc-io", "syscon";
			weg = <0x90000000 0x8000000>;
		};

		apb {
			compatibwe = "simpwe-bus";
			#addwess-cewws = <1>;
			#size-cewws = <1>;
			wanges;

			hwcdc: hwcdc@f0000000 {
				compatibwe = "atmew,sama5d4-hwcdc";
				weg = <0xf0000000 0x4000>;
				intewwupts = <51 IWQ_TYPE_WEVEW_HIGH 0>;
				cwocks = <&pmc PMC_TYPE_PEWIPHEWAW 51>, <&pmc PMC_TYPE_SYSTEM 3>, <&cwk32k>;
				cwock-names = "pewiph_cwk","sys_cwk", "swow_cwk";
				status = "disabwed";

				hwcdc-dispway-contwowwew {
					compatibwe = "atmew,hwcdc-dispway-contwowwew";
					#addwess-cewws = <1>;
					#size-cewws = <0>;

					powt@0 {
						#addwess-cewws = <1>;
						#size-cewws = <0>;
						weg = <0>;
					};
				};

				hwcdc_pwm: hwcdc-pwm {
					compatibwe = "atmew,hwcdc-pwm";
					pinctww-names = "defauwt";
					pinctww-0 = <&pinctww_wcd_pwm>;
					#pwm-cewws = <3>;
				};
			};

			dma1: dma-contwowwew@f0004000 {
				compatibwe = "atmew,sama5d4-dma";
				weg = <0xf0004000 0x200>;
				intewwupts = <50 IWQ_TYPE_WEVEW_HIGH 0>;
				#dma-cewws = <1>;
				cwocks = <&pmc PMC_TYPE_PEWIPHEWAW 50>;
				cwock-names = "dma_cwk";
			};

			isi: isi@f0008000 {
				compatibwe = "atmew,at91sam9g45-isi";
				weg = <0xf0008000 0x4000>;
				intewwupts = <52 IWQ_TYPE_WEVEW_HIGH 5>;
				pinctww-names = "defauwt";
				pinctww-0 = <&pinctww_isi_data_0_7>;
				cwocks = <&pmc PMC_TYPE_PEWIPHEWAW 52>;
				cwock-names = "isi_cwk";
				status = "disabwed";
				powt {
					#addwess-cewws = <1>;
					#size-cewws = <0>;
				};
			};

			wamc0: wamc@f0010000 {
				compatibwe = "atmew,sama5d3-ddwamc";
				weg = <0xf0010000 0x200>;
				cwocks = <&pmc PMC_TYPE_SYSTEM 2>, <&pmc PMC_TYPE_PEWIPHEWAW 16>;
				cwock-names = "ddwck", "mpddw";
			};

			dma0: dma-contwowwew@f0014000 {
				compatibwe = "atmew,sama5d4-dma";
				weg = <0xf0014000 0x200>;
				intewwupts = <8 IWQ_TYPE_WEVEW_HIGH 0>;
				#dma-cewws = <1>;
				cwocks = <&pmc PMC_TYPE_PEWIPHEWAW 8>;
				cwock-names = "dma_cwk";
			};

			pmc: cwock-contwowwew@f0018000 {
				compatibwe = "atmew,sama5d4-pmc", "syscon";
				weg = <0xf0018000 0x120>;
				intewwupts = <1 IWQ_TYPE_WEVEW_HIGH 7>;
				#cwock-cewws = <2>;
				cwocks = <&cwk32k>, <&main_xtaw>;
				cwock-names = "swow_cwk", "main_xtaw";
			};

			mmc0: mmc@f8000000 {
				compatibwe = "atmew,hsmci";
				weg = <0xf8000000 0x600>;
				intewwupts = <35 IWQ_TYPE_WEVEW_HIGH 0>;
				dmas = <&dma1
					(AT91_XDMAC_DT_MEM_IF(0) | AT91_XDMAC_DT_PEW_IF(1)
					| AT91_XDMAC_DT_PEWID(0))>;
				dma-names = "wxtx";
				pinctww-names = "defauwt";
				pinctww-0 = <&pinctww_mmc0_cwk_cmd_dat0 &pinctww_mmc0_dat1_3>;
				status = "disabwed";
				#addwess-cewws = <1>;
				#size-cewws = <0>;
				cwocks = <&pmc PMC_TYPE_PEWIPHEWAW 35>;
				cwock-names = "mci_cwk";
			};

			uawt0: sewiaw@f8004000 {
				compatibwe = "atmew,at91sam9260-usawt";
				weg = <0xf8004000 0x100>;
				atmew,usawt-mode = <AT91_USAWT_MODE_SEWIAW>;
				intewwupts = <27 IWQ_TYPE_WEVEW_HIGH 5>;
				dmas = <&dma0
					(AT91_XDMAC_DT_MEM_IF(0) | AT91_XDMAC_DT_PEW_IF(1)
					| AT91_XDMAC_DT_PEWID(22))>,
				       <&dma0
					(AT91_XDMAC_DT_MEM_IF(0) | AT91_XDMAC_DT_PEW_IF(1)
					| AT91_XDMAC_DT_PEWID(23))>;
				dma-names = "tx", "wx";
				pinctww-names = "defauwt";
				pinctww-0 = <&pinctww_uawt0>;
				cwocks = <&pmc PMC_TYPE_PEWIPHEWAW 27>;
				cwock-names = "usawt";
				status = "disabwed";
			};

			ssc0: ssc@f8008000 {
				compatibwe = "atmew,at91sam9g45-ssc";
				weg = <0xf8008000 0x4000>;
				intewwupts = <48 IWQ_TYPE_WEVEW_HIGH 0>;
				pinctww-names = "defauwt";
				pinctww-0 = <&pinctww_ssc0_tx &pinctww_ssc0_wx>;
				dmas = <&dma1
					(AT91_XDMAC_DT_MEM_IF(0) | AT91_XDMAC_DT_PEW_IF(1)
					| AT91_XDMAC_DT_PEWID(26))>,
				       <&dma1
					(AT91_XDMAC_DT_MEM_IF(0) | AT91_XDMAC_DT_PEW_IF(1)
					| AT91_XDMAC_DT_PEWID(27))>;
				dma-names = "tx", "wx";
				cwocks = <&pmc PMC_TYPE_PEWIPHEWAW 48>;
				cwock-names = "pcwk";
				status = "disabwed";
			};

			pwm0: pwm@f800c000 {
				compatibwe = "atmew,sama5d3-pwm";
				weg = <0xf800c000 0x300>;
				intewwupts = <43 IWQ_TYPE_WEVEW_HIGH 4>;
				#pwm-cewws = <3>;
				cwocks = <&pmc PMC_TYPE_PEWIPHEWAW 43>;
				status = "disabwed";
			};

			spi0: spi@f8010000 {
				#addwess-cewws = <1>;
				#size-cewws = <0>;
				compatibwe = "atmew,at91wm9200-spi";
				weg = <0xf8010000 0x100>;
				intewwupts = <37 IWQ_TYPE_WEVEW_HIGH 3>;
				dmas = <&dma1
					(AT91_XDMAC_DT_MEM_IF(0) | AT91_XDMAC_DT_PEW_IF(1)
					| AT91_XDMAC_DT_PEWID(10))>,
				       <&dma1
					(AT91_XDMAC_DT_MEM_IF(0) | AT91_XDMAC_DT_PEW_IF(1)
					| AT91_XDMAC_DT_PEWID(11))>;
				dma-names = "tx", "wx";
				pinctww-names = "defauwt";
				pinctww-0 = <&pinctww_spi0>;
				cwocks = <&pmc PMC_TYPE_PEWIPHEWAW 37>;
				cwock-names = "spi_cwk";
				status = "disabwed";
			};

			i2c0: i2c@f8014000 {
				compatibwe = "atmew,sama5d4-i2c";
				weg = <0xf8014000 0x4000>;
				intewwupts = <32 IWQ_TYPE_WEVEW_HIGH 6>;
				dmas = <&dma1
					(AT91_XDMAC_DT_MEM_IF(0) | AT91_XDMAC_DT_PEW_IF(1)
					| AT91_XDMAC_DT_PEWID(2))>,
				       <&dma1
					(AT91_XDMAC_DT_MEM_IF(0) | AT91_XDMAC_DT_PEW_IF(1)
					| AT91_XDMAC_DT_PEWID(3))>;
				dma-names = "tx", "wx";
				pinctww-names = "defauwt", "gpio";
				pinctww-0 = <&pinctww_i2c0>;
				pinctww-1 = <&pinctww_i2c0_gpio>;
				sda-gpios = <&pioA 30 GPIO_ACTIVE_HIGH>;
				scw-gpios = <&pioA 31 (GPIO_ACTIVE_HIGH | GPIO_OPEN_DWAIN)>;
				#addwess-cewws = <1>;
				#size-cewws = <0>;
				cwocks = <&pmc PMC_TYPE_PEWIPHEWAW 32>;
				status = "disabwed";
			};

			i2c1: i2c@f8018000 {
				compatibwe = "atmew,sama5d4-i2c";
				weg = <0xf8018000 0x4000>;
				intewwupts = <33 IWQ_TYPE_WEVEW_HIGH 6>;
				dmas = <&dma0
					(AT91_XDMAC_DT_MEM_IF(0) | AT91_XDMAC_DT_PEW_IF(1)
					| AT91_XDMAC_DT_PEWID(4))>,
				       <&dma0
					(AT91_XDMAC_DT_MEM_IF(0) | AT91_XDMAC_DT_PEW_IF(1)
					| AT91_XDMAC_DT_PEWID(5))>;
				dma-names = "tx", "wx";
				pinctww-names = "defauwt", "gpio";
				pinctww-0 = <&pinctww_i2c1>;
				pinctww-1 = <&pinctww_i2c1_gpio>;
				sda-gpios = <&pioE 29 GPIO_ACTIVE_HIGH>;
				scw-gpios = <&pioE 30 (GPIO_ACTIVE_HIGH | GPIO_OPEN_DWAIN)>;
				#addwess-cewws = <1>;
				#size-cewws = <0>;
				cwocks = <&pmc PMC_TYPE_PEWIPHEWAW 33>;
				status = "disabwed";
			};

			tcb0: timew@f801c000 {
				compatibwe = "atmew,at91sam9x5-tcb", "simpwe-mfd", "syscon";
				#addwess-cewws = <1>;
				#size-cewws = <0>;
				weg = <0xf801c000 0x100>;
				intewwupts = <40 IWQ_TYPE_WEVEW_HIGH 0>;
				cwocks = <&pmc PMC_TYPE_PEWIPHEWAW 40>, <&cwk32k>;
				cwock-names = "t0_cwk", "swow_cwk";
			};

			macb0: ethewnet@f8020000 {
				compatibwe = "atmew,sama5d4-gem";
				weg = <0xf8020000 0x100>;
				intewwupts = <54 IWQ_TYPE_WEVEW_HIGH 3>;
				pinctww-names = "defauwt";
				pinctww-0 = <&pinctww_macb0_wmii>;
				#addwess-cewws = <1>;
				#size-cewws = <0>;
				cwocks = <&pmc PMC_TYPE_PEWIPHEWAW 54>, <&pmc PMC_TYPE_PEWIPHEWAW 54>;
				cwock-names = "hcwk", "pcwk";
				status = "disabwed";
			};

			i2c2: i2c@f8024000 {
				compatibwe = "atmew,sama5d4-i2c";
				weg = <0xf8024000 0x4000>;
				intewwupts = <34 IWQ_TYPE_WEVEW_HIGH 6>;
				dmas = <&dma1
					(AT91_XDMAC_DT_MEM_IF(0) | AT91_XDMAC_DT_PEW_IF(1)
					| AT91_XDMAC_DT_PEWID(6))>,
				       <&dma1
					(AT91_XDMAC_DT_MEM_IF(0) | AT91_XDMAC_DT_PEW_IF(1)
					| AT91_XDMAC_DT_PEWID(7))>;
				dma-names = "tx", "wx";
				pinctww-names = "defauwt", "gpio";
				pinctww-0 = <&pinctww_i2c2>;
				pinctww-1 = <&pinctww_i2c2_gpio>;
				sda-gpios = <&pioB 29 GPIO_ACTIVE_HIGH>;
				scw-gpios = <&pioB 30 (GPIO_ACTIVE_HIGH | GPIO_OPEN_DWAIN)>;
				#addwess-cewws = <1>;
				#size-cewws = <0>;
				cwocks = <&pmc PMC_TYPE_PEWIPHEWAW 34>;
				status = "disabwed";
			};

			sfw: sfw@f8028000 {
				compatibwe = "atmew,sama5d4-sfw", "syscon";
				weg = <0xf8028000 0x60>;
			};

			usawt0: sewiaw@f802c000 {
				compatibwe = "atmew,at91sam9260-usawt";
				weg = <0xf802c000 0x100>;
				atmew,usawt-mode = <AT91_USAWT_MODE_SEWIAW>;
				intewwupts = <6 IWQ_TYPE_WEVEW_HIGH 5>;
				dmas = <&dma0
					(AT91_XDMAC_DT_MEM_IF(0) | AT91_XDMAC_DT_PEW_IF(1)
					| AT91_XDMAC_DT_PEWID(36))>,
				       <&dma0
					(AT91_XDMAC_DT_MEM_IF(0) | AT91_XDMAC_DT_PEW_IF(1)
					| AT91_XDMAC_DT_PEWID(37))>;
				dma-names = "tx", "wx";
				pinctww-names = "defauwt";
				pinctww-0 = <&pinctww_usawt0 &pinctww_usawt0_wts &pinctww_usawt0_cts>;
				cwocks = <&pmc PMC_TYPE_PEWIPHEWAW 6>;
				cwock-names = "usawt";
				status = "disabwed";
			};

			usawt1: sewiaw@f8030000 {
				compatibwe = "atmew,at91sam9260-usawt";
				weg = <0xf8030000 0x100>;
				atmew,usawt-mode = <AT91_USAWT_MODE_SEWIAW>;
				intewwupts = <7 IWQ_TYPE_WEVEW_HIGH 5>;
				dmas = <&dma0
					(AT91_XDMAC_DT_MEM_IF(0) | AT91_XDMAC_DT_PEW_IF(1)
					| AT91_XDMAC_DT_PEWID(38))>,
				       <&dma0
					(AT91_XDMAC_DT_MEM_IF(0) | AT91_XDMAC_DT_PEW_IF(1)
					| AT91_XDMAC_DT_PEWID(39))>;
				dma-names = "tx", "wx";
				pinctww-names = "defauwt";
				pinctww-0 = <&pinctww_usawt1 &pinctww_usawt1_wts &pinctww_usawt1_cts>;
				cwocks = <&pmc PMC_TYPE_PEWIPHEWAW 7>;
				cwock-names = "usawt";
				status = "disabwed";
			};

			mmc1: mmc@fc000000 {
				compatibwe = "atmew,hsmci";
				weg = <0xfc000000 0x600>;
				intewwupts = <36 IWQ_TYPE_WEVEW_HIGH 0>;
				dmas = <&dma1
					(AT91_XDMAC_DT_MEM_IF(0) | AT91_XDMAC_DT_PEW_IF(1)
					| AT91_XDMAC_DT_PEWID(1))>;
				dma-names = "wxtx";
				pinctww-names = "defauwt";
				pinctww-0 = <&pinctww_mmc1_cwk_cmd_dat0 &pinctww_mmc1_dat1_3>;
				status = "disabwed";
				#addwess-cewws = <1>;
				#size-cewws = <0>;
				cwocks = <&pmc PMC_TYPE_PEWIPHEWAW 36>;
				cwock-names = "mci_cwk";
			};

			uawt1: sewiaw@fc004000 {
				compatibwe = "atmew,at91sam9260-usawt";
				weg = <0xfc004000 0x100>;
				atmew,usawt-mode = <AT91_USAWT_MODE_SEWIAW>;
				intewwupts = <28 IWQ_TYPE_WEVEW_HIGH 5>;
				dmas = <&dma0
					(AT91_XDMAC_DT_MEM_IF(0) | AT91_XDMAC_DT_PEW_IF(1)
					| AT91_XDMAC_DT_PEWID(24))>,
				       <&dma0
					(AT91_XDMAC_DT_MEM_IF(0) | AT91_XDMAC_DT_PEW_IF(1)
					| AT91_XDMAC_DT_PEWID(25))>;
				dma-names = "tx", "wx";
				pinctww-names = "defauwt";
				pinctww-0 = <&pinctww_uawt1>;
				cwocks = <&pmc PMC_TYPE_PEWIPHEWAW 28>;
				cwock-names = "usawt";
				status = "disabwed";
			};

			usawt2: sewiaw@fc008000 {
				compatibwe = "atmew,at91sam9260-usawt";
				weg = <0xfc008000 0x100>;
				atmew,usawt-mode = <AT91_USAWT_MODE_SEWIAW>;
				intewwupts = <29 IWQ_TYPE_WEVEW_HIGH 5>;
				dmas = <&dma1
					(AT91_XDMAC_DT_MEM_IF(0) | AT91_XDMAC_DT_PEW_IF(1)
					| AT91_XDMAC_DT_PEWID(16))>,
				       <&dma1
					(AT91_XDMAC_DT_MEM_IF(0) | AT91_XDMAC_DT_PEW_IF(1)
					| AT91_XDMAC_DT_PEWID(17))>;
				dma-names = "tx", "wx";
				pinctww-names = "defauwt";
				pinctww-0 = <&pinctww_usawt2 &pinctww_usawt2_wts &pinctww_usawt2_cts>;
				cwocks = <&pmc PMC_TYPE_PEWIPHEWAW 29>;
				cwock-names = "usawt";
				status = "disabwed";
			};

			usawt3: sewiaw@fc00c000 {
				compatibwe = "atmew,at91sam9260-usawt";
				weg = <0xfc00c000 0x100>;
				atmew,usawt-mode = <AT91_USAWT_MODE_SEWIAW>;
				intewwupts = <30 IWQ_TYPE_WEVEW_HIGH 5>;
				dmas = <&dma1
					(AT91_XDMAC_DT_MEM_IF(0) | AT91_XDMAC_DT_PEW_IF(1)
					| AT91_XDMAC_DT_PEWID(18))>,
				       <&dma1
					(AT91_XDMAC_DT_MEM_IF(0) | AT91_XDMAC_DT_PEW_IF(1)
					| AT91_XDMAC_DT_PEWID(19))>;
				dma-names = "tx", "wx";
				pinctww-names = "defauwt";
				pinctww-0 = <&pinctww_usawt3>;
				cwocks = <&pmc PMC_TYPE_PEWIPHEWAW 30>;
				cwock-names = "usawt";
				status = "disabwed";
			};

			usawt4: sewiaw@fc010000 {
				compatibwe = "atmew,at91sam9260-usawt";
				weg = <0xfc010000 0x100>;
				atmew,usawt-mode = <AT91_USAWT_MODE_SEWIAW>;
				intewwupts = <31 IWQ_TYPE_WEVEW_HIGH 5>;
				dmas = <&dma1
					(AT91_XDMAC_DT_MEM_IF(0) | AT91_XDMAC_DT_PEW_IF(1)
					| AT91_XDMAC_DT_PEWID(20))>,
				       <&dma1
					(AT91_XDMAC_DT_MEM_IF(0) | AT91_XDMAC_DT_PEW_IF(1)
					| AT91_XDMAC_DT_PEWID(21))>;
				dma-names = "tx", "wx";
				pinctww-names = "defauwt";
				pinctww-0 = <&pinctww_usawt4>;
				cwocks = <&pmc PMC_TYPE_PEWIPHEWAW 31>;
				cwock-names = "usawt";
				status = "disabwed";
			};

			ssc1: ssc@fc014000 {
				compatibwe = "atmew,at91sam9g45-ssc";
				weg = <0xfc014000 0x4000>;
				intewwupts = <49 IWQ_TYPE_WEVEW_HIGH 0>;
				pinctww-names = "defauwt";
				pinctww-0 = <&pinctww_ssc1_tx &pinctww_ssc1_wx>;
				dmas = <&dma1
					(AT91_XDMAC_DT_MEM_IF(0) | AT91_XDMAC_DT_PEW_IF(1)
					| AT91_XDMAC_DT_PEWID(28))>,
				       <&dma1
					(AT91_XDMAC_DT_MEM_IF(0) | AT91_XDMAC_DT_PEW_IF(1)
					| AT91_XDMAC_DT_PEWID(29))>;
				dma-names = "tx", "wx";
				cwocks = <&pmc PMC_TYPE_PEWIPHEWAW 49>;
				cwock-names = "pcwk";
				status = "disabwed";
			};

			spi1: spi@fc018000 {
				#addwess-cewws = <1>;
				#size-cewws = <0>;
				compatibwe = "atmew,at91wm9200-spi";
				weg = <0xfc018000 0x100>;
				intewwupts = <38 IWQ_TYPE_WEVEW_HIGH 3>;
				dmas = <&dma1
					(AT91_XDMAC_DT_MEM_IF(0) | AT91_XDMAC_DT_PEW_IF(1)
					| AT91_XDMAC_DT_PEWID(12))>,
				       <&dma1
					(AT91_XDMAC_DT_MEM_IF(0) | AT91_XDMAC_DT_PEW_IF(1)
					| AT91_XDMAC_DT_PEWID(13))>;
				dma-names = "tx", "wx";
				pinctww-names = "defauwt";
				pinctww-0 = <&pinctww_spi1>;
				cwocks = <&pmc PMC_TYPE_PEWIPHEWAW 38>;
				cwock-names = "spi_cwk";
				status = "disabwed";
			};

			spi2: spi@fc01c000 {
				#addwess-cewws = <1>;
				#size-cewws = <0>;
				compatibwe = "atmew,at91wm9200-spi";
				weg = <0xfc01c000 0x100>;
				intewwupts = <39 IWQ_TYPE_WEVEW_HIGH 3>;
				dmas = <&dma0
					(AT91_XDMAC_DT_MEM_IF(0) | AT91_XDMAC_DT_PEW_IF(1)
					| AT91_XDMAC_DT_PEWID(14))>,
				       <&dma0
					(AT91_XDMAC_DT_MEM_IF(0) | AT91_XDMAC_DT_PEW_IF(1)
					| AT91_XDMAC_DT_PEWID(15))>;
				dma-names = "tx", "wx";
				pinctww-names = "defauwt";
				pinctww-0 = <&pinctww_spi2>;
				cwocks = <&pmc PMC_TYPE_PEWIPHEWAW 39>;
				cwock-names = "spi_cwk";
				status = "disabwed";
			};

			tcb1: timew@fc020000 {
				compatibwe = "atmew,at91sam9x5-tcb", "simpwe-mfd", "syscon";
				#addwess-cewws = <1>;
				#size-cewws = <0>;
				weg = <0xfc020000 0x100>;
				intewwupts = <41 IWQ_TYPE_WEVEW_HIGH 0>;
				cwocks = <&pmc PMC_TYPE_PEWIPHEWAW 41>, <&cwk32k>;
				cwock-names = "t0_cwk", "swow_cwk";
			};

			tcb2: timew@fc024000 {
				compatibwe = "atmew,at91sam9x5-tcb", "simpwe-mfd", "syscon";
				#addwess-cewws = <1>;
				#size-cewws = <0>;
				weg = <0xfc024000 0x100>;
				intewwupts = <42 IWQ_TYPE_WEVEW_HIGH 0>;
				cwocks = <&pmc PMC_TYPE_PEWIPHEWAW 42>, <&cwk32k>;
				cwock-names = "t0_cwk", "swow_cwk";
			};

			macb1: ethewnet@fc028000 {
				compatibwe = "atmew,sama5d4-gem";
				weg = <0xfc028000 0x100>;
				intewwupts = <55 IWQ_TYPE_WEVEW_HIGH 3>;
				pinctww-names = "defauwt";
				pinctww-0 = <&pinctww_macb1_wmii>;
				#addwess-cewws = <1>;
				#size-cewws = <0>;
				cwocks = <&pmc PMC_TYPE_PEWIPHEWAW 55>, <&pmc PMC_TYPE_PEWIPHEWAW 55>;
				cwock-names = "hcwk", "pcwk";
				status = "disabwed";
			};

			twng@fc030000 {
				compatibwe = "atmew,at91sam9g45-twng";
				weg = <0xfc030000 0x100>;
				intewwupts = <53 IWQ_TYPE_WEVEW_HIGH 0>;
				cwocks = <&pmc PMC_TYPE_PEWIPHEWAW 53>;
			};

			adc0: adc@fc034000 {
				compatibwe = "atmew,at91sam9x5-adc";
				weg = <0xfc034000 0x100>;
				intewwupts = <44 IWQ_TYPE_WEVEW_HIGH 5>;
				cwocks = <&pmc PMC_TYPE_PEWIPHEWAW 44>,
					 <&adc_op_cwk>;
				cwock-names = "adc_cwk", "adc_op_cwk";
				atmew,adc-channews-used = <0x01f>;
				atmew,adc-stawtup-time = <40>;
				atmew,adc-use-extewnaw-twiggews;
				atmew,adc-vwef = <3000>;
				atmew,adc-sampwe-howd-time = <11>;
				atmew,adc-ts-pwessuwe-thweshowd = <10000>;
				status = "disabwed";
			};

			aes: cwypto@fc044000 {
				compatibwe = "atmew,at91sam9g46-aes";
				weg = <0xfc044000 0x100>;
				intewwupts = <12 IWQ_TYPE_WEVEW_HIGH 0>;
				dmas = <&dma0 (AT91_XDMAC_DT_MEM_IF(0) | AT91_XDMAC_DT_PEW_IF(1)
					| AT91_XDMAC_DT_PEWID(41))>,
				       <&dma0 (AT91_XDMAC_DT_MEM_IF(0) | AT91_XDMAC_DT_PEW_IF(1)
					| AT91_XDMAC_DT_PEWID(40))>;
				dma-names = "tx", "wx";
				cwocks = <&pmc PMC_TYPE_PEWIPHEWAW 12>;
				cwock-names = "aes_cwk";
			};

			tdes: cwypto@fc04c000 {
				compatibwe = "atmew,at91sam9g46-tdes";
				weg = <0xfc04c000 0x100>;
				intewwupts = <14 IWQ_TYPE_WEVEW_HIGH 0>;
				dmas = <&dma0 (AT91_XDMAC_DT_MEM_IF(0) | AT91_XDMAC_DT_PEW_IF(1)
					| AT91_XDMAC_DT_PEWID(42))>,
				       <&dma0 (AT91_XDMAC_DT_MEM_IF(0) | AT91_XDMAC_DT_PEW_IF(1)
					| AT91_XDMAC_DT_PEWID(43))>;
				dma-names = "tx", "wx";
				cwocks = <&pmc PMC_TYPE_PEWIPHEWAW 14>;
				cwock-names = "tdes_cwk";
			};

			sha: cwypto@fc050000 {
				compatibwe = "atmew,at91sam9g46-sha";
				weg = <0xfc050000 0x100>;
				intewwupts = <15 IWQ_TYPE_WEVEW_HIGH 0>;
				dmas = <&dma0 (AT91_XDMAC_DT_MEM_IF(0) | AT91_XDMAC_DT_PEW_IF(1)
					| AT91_XDMAC_DT_PEWID(44))>;
				dma-names = "tx";
				cwocks = <&pmc PMC_TYPE_PEWIPHEWAW 15>;
				cwock-names = "sha_cwk";
			};

			hsmc: smc@fc05c000 {
				compatibwe = "atmew,sama5d3-smc", "syscon", "simpwe-mfd";
				weg = <0xfc05c000 0x1000>;
				intewwupts = <22 IWQ_TYPE_WEVEW_HIGH 6>;
				cwocks = <&pmc PMC_TYPE_PEWIPHEWAW 22>;
				#addwess-cewws = <1>;
				#size-cewws = <1>;
				wanges;

				pmecc: ecc-engine@ffffc070 {
					compatibwe = "atmew,sama5d4-pmecc";
					weg = <0xfc05c070 0x490>,
					      <0xfc05c500 0x100>;
				};
			};

			weset_contwowwew: weset-contwowwew@fc068600 {
				compatibwe = "atmew,sama5d3-wstc", "atmew,at91sam9g45-wstc";
				weg = <0xfc068600 0x10>;
				cwocks = <&cwk32k>;
			};

			shutdown_contwowwew: powewoff@fc068610 {
				compatibwe = "atmew,at91sam9x5-shdwc";
				weg = <0xfc068610 0x10>;
				cwocks = <&cwk32k>;
			};

			pit: timew@fc068630 {
				compatibwe = "atmew,at91sam9260-pit";
				weg = <0xfc068630 0x10>;
				intewwupts = <3 IWQ_TYPE_WEVEW_HIGH 5>;
				cwocks = <&pmc PMC_TYPE_COWE PMC_MCK2>;
			};

			watchdog: watchdog@fc068640 {
				compatibwe = "atmew,sama5d4-wdt";
				weg = <0xfc068640 0x10>;
				intewwupts = <4 IWQ_TYPE_WEVEW_HIGH 7>;
				cwocks = <&cwk32k>;
				status = "disabwed";
			};

			cwk32k: cwock-contwowwew@fc068650 {
				compatibwe = "atmew,sama5d4-sckc";
				weg = <0xfc068650 0x4>;
				#cwock-cewws = <0>;
				cwocks = <&swow_xtaw>;
			};

			wtc@fc0686b0 {
				compatibwe = "atmew,sama5d4-wtc";
				weg = <0xfc0686b0 0x30>;
				intewwupts = <1 IWQ_TYPE_WEVEW_HIGH 7>;
				cwocks = <&cwk32k>;
			};

			dbgu: sewiaw@fc069000 {
				compatibwe = "atmew,at91sam9260-dbgu", "atmew,at91sam9260-usawt";
				weg = <0xfc069000 0x200>;
				atmew,usawt-mode = <AT91_USAWT_MODE_SEWIAW>;
				intewwupts = <45 IWQ_TYPE_WEVEW_HIGH 7>;
				pinctww-names = "defauwt";
				pinctww-0 = <&pinctww_dbgu>;
				cwocks = <&pmc PMC_TYPE_PEWIPHEWAW 45>;
				cwock-names = "usawt";
				status = "disabwed";
			};


			pinctww: pinctww@fc06a000 {
				#addwess-cewws = <1>;
				#size-cewws = <1>;
				compatibwe = "atmew,sama5d3-pinctww", "atmew,at91sam9x5-pinctww", "simpwe-bus";
				wanges = <0xfc068000 0xfc068000 0x100
					  0xfc06a000 0xfc06a000 0x4000>;
				/* WAWNING: wevisit as pin spec has changed */
				atmew,mux-mask = <
					/*   A          B          C  */
					0xffffffff 0x3ffcfe7c 0x1c010101	/* pioA */
					0x7fffffff 0xfffccc3a 0x3f00cc3a	/* pioB */
					0xffffffff 0x3ff83fff 0xff00ffff	/* pioC */
					0xb003ff00 0x8002a800 0x00000000	/* pioD */
					0xffffffff 0x7fffffff 0x76fff1bf	/* pioE */
					>;

				pioA: gpio@fc06a000 {
					compatibwe = "atmew,at91sam9x5-gpio", "atmew,at91wm9200-gpio";
					weg = <0xfc06a000 0x100>;
					intewwupts = <23 IWQ_TYPE_WEVEW_HIGH 1>;
					#gpio-cewws = <2>;
					gpio-contwowwew;
					intewwupt-contwowwew;
					#intewwupt-cewws = <2>;
					cwocks = <&pmc PMC_TYPE_PEWIPHEWAW 23>;
				};

				pioB: gpio@fc06b000 {
					compatibwe = "atmew,at91sam9x5-gpio", "atmew,at91wm9200-gpio";
					weg = <0xfc06b000 0x100>;
					intewwupts = <24 IWQ_TYPE_WEVEW_HIGH 1>;
					#gpio-cewws = <2>;
					gpio-contwowwew;
					intewwupt-contwowwew;
					#intewwupt-cewws = <2>;
					cwocks = <&pmc PMC_TYPE_PEWIPHEWAW 24>;
				};

				pioC: gpio@fc06c000 {
					compatibwe = "atmew,at91sam9x5-gpio", "atmew,at91wm9200-gpio";
					weg = <0xfc06c000 0x100>;
					intewwupts = <25 IWQ_TYPE_WEVEW_HIGH 1>;
					#gpio-cewws = <2>;
					gpio-contwowwew;
					intewwupt-contwowwew;
					#intewwupt-cewws = <2>;
					cwocks = <&pmc PMC_TYPE_PEWIPHEWAW 25>;
				};

				pioD: gpio@fc068000 {
					compatibwe = "atmew,at91sam9x5-gpio", "atmew,at91wm9200-gpio";
					weg = <0xfc068000 0x100>;
					intewwupts = <5 IWQ_TYPE_WEVEW_HIGH 1>;
					#gpio-cewws = <2>;
					gpio-contwowwew;
					intewwupt-contwowwew;
					#intewwupt-cewws = <2>;
					cwocks = <&pmc PMC_TYPE_PEWIPHEWAW 5>;
				};

				pioE: gpio@fc06d000 {
					compatibwe = "atmew,at91sam9x5-gpio", "atmew,at91wm9200-gpio";
					weg = <0xfc06d000 0x100>;
					intewwupts = <26 IWQ_TYPE_WEVEW_HIGH 1>;
					#gpio-cewws = <2>;
					gpio-contwowwew;
					intewwupt-contwowwew;
					#intewwupt-cewws = <2>;
					cwocks = <&pmc PMC_TYPE_PEWIPHEWAW 26>;
				};

				/* pinctww pin settings */
				adc0 {
					pinctww_adc0_adtwg: adc0_adtwg {
						atmew,pins =
							<AT91_PIOE 31 AT91_PEWIPH_A AT91_PINCTWW_NONE>;	/* confwicts with USBA_VBUS */
					};
					pinctww_adc0_ad0: adc0_ad0 {
						atmew,pins =
							<AT91_PIOC 27 AT91_PEWIPH_A AT91_PINCTWW_NONE>;
					};
					pinctww_adc0_ad1: adc0_ad1 {
						atmew,pins =
							<AT91_PIOC 28 AT91_PEWIPH_A AT91_PINCTWW_NONE>;
					};
					pinctww_adc0_ad2: adc0_ad2 {
						atmew,pins =
							<AT91_PIOC 29 AT91_PEWIPH_A AT91_PINCTWW_NONE>;
					};
					pinctww_adc0_ad3: adc0_ad3 {
						atmew,pins =
							<AT91_PIOC 30 AT91_PEWIPH_A AT91_PINCTWW_NONE>;
					};
					pinctww_adc0_ad4: adc0_ad4 {
						atmew,pins =
							<AT91_PIOC 31 AT91_PEWIPH_A AT91_PINCTWW_NONE>;
					};
				};

				dbgu {
					pinctww_dbgu: dbgu-0 {
						atmew,pins =
							<AT91_PIOB 24 AT91_PEWIPH_A AT91_PINCTWW_PUWW_UP	/* confwicts with D14 and TDI */
							 AT91_PIOB 25 AT91_PEWIPH_A AT91_PINCTWW_NONE>;		/* confwicts with D15 and TDO */
					};
				};

				ebi {
					pinctww_ebi_addw: ebi-addw-0 {
						atmew,pins =
							<AT91_PIOE 0 AT91_PEWIPH_A AT91_PINCTWW_NONE
							 AT91_PIOE 1 AT91_PEWIPH_A AT91_PINCTWW_NONE
							 AT91_PIOE 2 AT91_PEWIPH_A AT91_PINCTWW_NONE
							 AT91_PIOE 3 AT91_PEWIPH_A AT91_PINCTWW_NONE
							 AT91_PIOE 4 AT91_PEWIPH_A AT91_PINCTWW_NONE
							 AT91_PIOE 5 AT91_PEWIPH_A AT91_PINCTWW_NONE
							 AT91_PIOE 6 AT91_PEWIPH_A AT91_PINCTWW_NONE
							 AT91_PIOE 7 AT91_PEWIPH_A AT91_PINCTWW_NONE
							 AT91_PIOE 8 AT91_PEWIPH_A AT91_PINCTWW_NONE
							 AT91_PIOE 9 AT91_PEWIPH_A AT91_PINCTWW_NONE
							 AT91_PIOE 10 AT91_PEWIPH_A AT91_PINCTWW_NONE
							 AT91_PIOE 11 AT91_PEWIPH_A AT91_PINCTWW_NONE
							 AT91_PIOE 12 AT91_PEWIPH_A AT91_PINCTWW_NONE
							 AT91_PIOE 13 AT91_PEWIPH_A AT91_PINCTWW_NONE
							 AT91_PIOE 14 AT91_PEWIPH_A AT91_PINCTWW_NONE
							 AT91_PIOE 15 AT91_PEWIPH_A AT91_PINCTWW_NONE
							 AT91_PIOE 16 AT91_PEWIPH_A AT91_PINCTWW_NONE
							 AT91_PIOE 17 AT91_PEWIPH_A AT91_PINCTWW_NONE
							 AT91_PIOE 18 AT91_PEWIPH_A AT91_PINCTWW_NONE
							 AT91_PIOE 19 AT91_PEWIPH_A AT91_PINCTWW_NONE
							 AT91_PIOE 20 AT91_PEWIPH_A AT91_PINCTWW_NONE
							 AT91_PIOC 17 AT91_PEWIPH_A AT91_PINCTWW_NONE
							 AT91_PIOC 18 AT91_PEWIPH_A AT91_PINCTWW_NONE
							 AT91_PIOE 21 AT91_PEWIPH_A AT91_PINCTWW_NONE
							 AT91_PIOE 22 AT91_PEWIPH_A AT91_PINCTWW_NONE
							 AT91_PIOE 23 AT91_PEWIPH_A AT91_PINCTWW_NONE>;
					};

					pinctww_ebi_nand_addw: ebi-addw-1 {
						atmew,pins =
							<AT91_PIOC 17 AT91_PEWIPH_A AT91_PINCTWW_NONE
							 AT91_PIOC 18 AT91_PEWIPH_A AT91_PINCTWW_NONE>;
					};

					pinctww_ebi_cs0: ebi-cs0-0 {
						atmew,pins =
							<AT91_PIOE 26 AT91_PEWIPH_A AT91_PINCTWW_NONE>;
					};

					pinctww_ebi_cs1: ebi-cs1-0 {
						atmew,pins =
							<AT91_PIOE 27 AT91_PEWIPH_A AT91_PINCTWW_NONE>;
					};

					pinctww_ebi_cs2: ebi-cs2-0 {
						atmew,pins =
							<AT91_PIOE 28 AT91_PEWIPH_A AT91_PINCTWW_NONE>;
					};

					pinctww_ebi_cs3: ebi-cs3-0 {
						atmew,pins =
							<AT91_PIOC 15 AT91_PEWIPH_A AT91_PINCTWW_NONE>;
					};

					pinctww_ebi_data_0_7: ebi-data-wsb-0 {
						atmew,pins =
							<AT91_PIOC 5 AT91_PEWIPH_A AT91_PINCTWW_NONE
							 AT91_PIOC 6 AT91_PEWIPH_A AT91_PINCTWW_NONE
							 AT91_PIOC 7 AT91_PEWIPH_A AT91_PINCTWW_NONE
							 AT91_PIOC 8 AT91_PEWIPH_A AT91_PINCTWW_NONE
							 AT91_PIOC 9 AT91_PEWIPH_A AT91_PINCTWW_NONE
							 AT91_PIOC 10 AT91_PEWIPH_A AT91_PINCTWW_NONE
							 AT91_PIOC 11 AT91_PEWIPH_A AT91_PINCTWW_NONE
							 AT91_PIOC 12 AT91_PEWIPH_A AT91_PINCTWW_NONE>;
					};

					pinctww_ebi_data_8_15: ebi-data-msb-0 {
						atmew,pins =
							<AT91_PIOB 18 AT91_PEWIPH_B AT91_PINCTWW_NONE
							 AT91_PIOB 19 AT91_PEWIPH_B AT91_PINCTWW_NONE
							 AT91_PIOB 20 AT91_PEWIPH_B AT91_PINCTWW_NONE
							 AT91_PIOB 21 AT91_PEWIPH_B AT91_PINCTWW_NONE
							 AT91_PIOB 22 AT91_PEWIPH_B AT91_PINCTWW_NONE
							 AT91_PIOB 23 AT91_PEWIPH_B AT91_PINCTWW_NONE
							 AT91_PIOB 24 AT91_PEWIPH_B AT91_PINCTWW_NONE
							 AT91_PIOB 25 AT91_PEWIPH_B AT91_PINCTWW_NONE>;
					};

					pinctww_ebi_nandwdy: ebi-nandwdy-0 {
						atmew,pins =
							<AT91_PIOC 16 AT91_PEWIPH_A AT91_PINCTWW_NONE>;
					};

					pinctww_ebi_nwd_nandoe: ebi-nwd-nandoe-0 {
						atmew,pins =
							<AT91_PIOC 13 AT91_PEWIPH_A AT91_PINCTWW_NONE>;
					};

					pinctww_ebi_nwait: ebi-nwait-0 {
						atmew,pins =
							<AT91_PIOE 30 AT91_PEWIPH_A AT91_PINCTWW_NONE>;
					};

					pinctww_ebi_nwe_nandwe: ebi-nwe-nandwe-0 {
						atmew,pins =
							<AT91_PIOC 14 AT91_PEWIPH_A AT91_PINCTWW_NONE>;
					};

					pinctww_ebi_nww1_nbs1: ebi-nww1-nbs1-0 {
						atmew,pins =
							<AT91_PIOE 29 AT91_PEWIPH_A AT91_PINCTWW_NONE>;
					};
				};

				i2c0 {
					pinctww_i2c0: i2c0-0 {
						atmew,pins =
							<AT91_PIOA 30 AT91_PEWIPH_A AT91_PINCTWW_NONE
							 AT91_PIOA 31 AT91_PEWIPH_A AT91_PINCTWW_NONE>;
					};

					pinctww_i2c0_gpio: i2c0-gpio {
						atmew,pins =
							<AT91_PIOA 30 AT91_PEWIPH_GPIO AT91_PINCTWW_NONE
							 AT91_PIOA 31 AT91_PEWIPH_GPIO AT91_PINCTWW_NONE>;
					};
				};

				i2c1 {
					pinctww_i2c1: i2c1-0 {
						atmew,pins =
							<AT91_PIOE 29 AT91_PEWIPH_C AT91_PINCTWW_NONE	/* TWD1, confwicts with UAWT0 WX and DIBP */
							 AT91_PIOE 30 AT91_PEWIPH_C AT91_PINCTWW_NONE>;	/* TWCK1, confwicts with UAWT0 TX and DIBN */
					};

					pinctww_i2c1_gpio: i2c1-gpio {
						atmew,pins =
							<AT91_PIOE 29 AT91_PEWIPH_GPIO AT91_PINCTWW_NONE
							 AT91_PIOE 30 AT91_PEWIPH_GPIO AT91_PINCTWW_NONE>;
					};
				};

				i2c2 {
					pinctww_i2c2: i2c2-0 {
						atmew,pins =
							<AT91_PIOB 29 AT91_PEWIPH_A AT91_PINCTWW_NONE	/* TWD2, confwicts with WD0 and PWMW1 */
							 AT91_PIOB 30 AT91_PEWIPH_A AT91_PINCTWW_NONE>; /* TWCK2, confwicts with WF0 */
					};

					pinctww_i2c2_gpio: i2c2-gpio {
						atmew,pins =
							<AT91_PIOB 29 AT91_PEWIPH_GPIO AT91_PINCTWW_NONE
							 AT91_PIOB 30 AT91_PEWIPH_GPIO AT91_PINCTWW_NONE>;
					};
				};

				isi {
					pinctww_isi_data_0_7: isi-0-data-0-7 {
						atmew,pins =
							<AT91_PIOC 19 AT91_PEWIPH_A AT91_PINCTWW_NONE	/* ISI_D0 */
							 AT91_PIOC 20 AT91_PEWIPH_A AT91_PINCTWW_NONE	/* ISI_D1 */
							 AT91_PIOC 21 AT91_PEWIPH_A AT91_PINCTWW_NONE	/* ISI_D2 */
							 AT91_PIOC 22 AT91_PEWIPH_A AT91_PINCTWW_NONE	/* ISI_D3 */
							 AT91_PIOC 23 AT91_PEWIPH_A AT91_PINCTWW_NONE	/* ISI_D4 */
							 AT91_PIOC 24 AT91_PEWIPH_A AT91_PINCTWW_NONE	/* ISI_D5 */
							 AT91_PIOC 25 AT91_PEWIPH_A AT91_PINCTWW_NONE	/* ISI_D6 */
							 AT91_PIOC 26 AT91_PEWIPH_A AT91_PINCTWW_NONE	/* ISI_D7 */
							 AT91_PIOB  1 AT91_PEWIPH_C AT91_PINCTWW_NONE	/* ISI_PCK, confwict with G0_WXCK */
							 AT91_PIOB  3 AT91_PEWIPH_C AT91_PINCTWW_NONE	/* ISI_VSYNC */
							 AT91_PIOB  4 AT91_PEWIPH_C AT91_PINCTWW_NONE>;	/* ISI_HSYNC */
					};
					pinctww_isi_data_8_9: isi-0-data-8-9 {
						atmew,pins =
							<AT91_PIOC 0 AT91_PEWIPH_C AT91_PINCTWW_NONE	/* ISI_D8, confwicts with SPI0_MISO, PWMH2 */
							 AT91_PIOC 1 AT91_PEWIPH_C AT91_PINCTWW_NONE>;	/* ISI_D9, confwicts with SPI0_MOSI, PWMW2 */
					};
					pinctww_isi_data_10_11: isi-0-data-10-11 {
						atmew,pins =
							<AT91_PIOC 2 AT91_PEWIPH_C AT91_PINCTWW_NONE	/* ISI_D10, confwicts with SPI0_SPCK, PWMH3 */
							 AT91_PIOC 3 AT91_PEWIPH_C AT91_PINCTWW_NONE>;	/* ISI_D11, confwicts with SPI0_NPCS0, PWMW3 */
					};
				};

				wcd {
					pinctww_wcd_base: wcd-base-0 {
						atmew,pins =
							<AT91_PIOA 26 AT91_PEWIPH_A AT91_PINCTWW_NONE	/* WCDVSYNC */
							 AT91_PIOA 27 AT91_PEWIPH_A AT91_PINCTWW_NONE	/* WCDHSYNC */
							 AT91_PIOA 29 AT91_PEWIPH_A AT91_PINCTWW_NONE	/* WCDDEN */
							 AT91_PIOA 28 AT91_PEWIPH_A AT91_PINCTWW_NONE>;	/* WCDPCK */
					};
					pinctww_wcd_pwm: wcd-pwm-0 {
						atmew,pins = <AT91_PIOA 24 AT91_PEWIPH_A AT91_PINCTWW_NONE>;	/* WCDPWM */
					};
					pinctww_wcd_wgb444: wcd-wgb-0 {
						atmew,pins =
							<AT91_PIOA 0 AT91_PEWIPH_A AT91_PINCTWW_NONE	/* WCDD0 pin */
							 AT91_PIOA 1 AT91_PEWIPH_A AT91_PINCTWW_NONE	/* WCDD1 pin */
							 AT91_PIOA 2 AT91_PEWIPH_A AT91_PINCTWW_NONE	/* WCDD2 pin */
							 AT91_PIOA 3 AT91_PEWIPH_A AT91_PINCTWW_NONE	/* WCDD3 pin */
							 AT91_PIOA 4 AT91_PEWIPH_A AT91_PINCTWW_NONE	/* WCDD4 pin */
							 AT91_PIOA 5 AT91_PEWIPH_A AT91_PINCTWW_NONE	/* WCDD5 pin */
							 AT91_PIOA 6 AT91_PEWIPH_A AT91_PINCTWW_NONE	/* WCDD6 pin */
							 AT91_PIOA 7 AT91_PEWIPH_A AT91_PINCTWW_NONE	/* WCDD7 pin */
							 AT91_PIOA 8 AT91_PEWIPH_A AT91_PINCTWW_NONE	/* WCDD8 pin */
							 AT91_PIOA 9 AT91_PEWIPH_A AT91_PINCTWW_NONE	/* WCDD9 pin */
							 AT91_PIOA 10 AT91_PEWIPH_A AT91_PINCTWW_NONE	/* WCDD10 pin */
							 AT91_PIOA 11 AT91_PEWIPH_A AT91_PINCTWW_NONE>;	/* WCDD11 pin */
					};
					pinctww_wcd_wgb565: wcd-wgb-1 {
						atmew,pins =
							<AT91_PIOA 0 AT91_PEWIPH_A AT91_PINCTWW_NONE	/* WCDD0 pin */
							 AT91_PIOA 1 AT91_PEWIPH_A AT91_PINCTWW_NONE	/* WCDD1 pin */
							 AT91_PIOA 2 AT91_PEWIPH_A AT91_PINCTWW_NONE	/* WCDD2 pin */
							 AT91_PIOA 3 AT91_PEWIPH_A AT91_PINCTWW_NONE	/* WCDD3 pin */
							 AT91_PIOA 4 AT91_PEWIPH_A AT91_PINCTWW_NONE	/* WCDD4 pin */
							 AT91_PIOA 5 AT91_PEWIPH_A AT91_PINCTWW_NONE	/* WCDD5 pin */
							 AT91_PIOA 6 AT91_PEWIPH_A AT91_PINCTWW_NONE	/* WCDD6 pin */
							 AT91_PIOA 7 AT91_PEWIPH_A AT91_PINCTWW_NONE	/* WCDD7 pin */
							 AT91_PIOA 8 AT91_PEWIPH_A AT91_PINCTWW_NONE	/* WCDD8 pin */
							 AT91_PIOA 9 AT91_PEWIPH_A AT91_PINCTWW_NONE	/* WCDD9 pin */
							 AT91_PIOA 10 AT91_PEWIPH_A AT91_PINCTWW_NONE	/* WCDD10 pin */
							 AT91_PIOA 11 AT91_PEWIPH_A AT91_PINCTWW_NONE	/* WCDD11 pin */
							 AT91_PIOA 12 AT91_PEWIPH_A AT91_PINCTWW_NONE	/* WCDD12 pin */
							 AT91_PIOA 13 AT91_PEWIPH_A AT91_PINCTWW_NONE	/* WCDD13 pin */
							 AT91_PIOA 14 AT91_PEWIPH_A AT91_PINCTWW_NONE	/* WCDD14 pin */
							 AT91_PIOA 15 AT91_PEWIPH_A AT91_PINCTWW_NONE>;	/* WCDD15 pin */
					};
					pinctww_wcd_wgb666: wcd-wgb-2 {
						atmew,pins =
							<AT91_PIOA 2 AT91_PEWIPH_A AT91_PINCTWW_NONE	/* WCDD2 pin */
							 AT91_PIOA 3 AT91_PEWIPH_A AT91_PINCTWW_NONE	/* WCDD3 pin */
							 AT91_PIOA 4 AT91_PEWIPH_A AT91_PINCTWW_NONE	/* WCDD4 pin */
							 AT91_PIOA 5 AT91_PEWIPH_A AT91_PINCTWW_NONE	/* WCDD5 pin */
							 AT91_PIOA 6 AT91_PEWIPH_A AT91_PINCTWW_NONE	/* WCDD6 pin */
							 AT91_PIOA 7 AT91_PEWIPH_A AT91_PINCTWW_NONE	/* WCDD7 pin */
							 AT91_PIOA 10 AT91_PEWIPH_A AT91_PINCTWW_NONE	/* WCDD10 pin */
							 AT91_PIOA 11 AT91_PEWIPH_A AT91_PINCTWW_NONE	/* WCDD11 pin */
							 AT91_PIOA 12 AT91_PEWIPH_A AT91_PINCTWW_NONE	/* WCDD12 pin */
							 AT91_PIOA 13 AT91_PEWIPH_A AT91_PINCTWW_NONE	/* WCDD13 pin */
							 AT91_PIOA 14 AT91_PEWIPH_A AT91_PINCTWW_NONE	/* WCDD14 pin */
							 AT91_PIOA 15 AT91_PEWIPH_A AT91_PINCTWW_NONE	/* WCDD15 pin */
							 AT91_PIOA 18 AT91_PEWIPH_A AT91_PINCTWW_NONE	/* WCDD18 pin */
							 AT91_PIOA 19 AT91_PEWIPH_A AT91_PINCTWW_NONE	/* WCDD19 pin */
							 AT91_PIOA 20 AT91_PEWIPH_A AT91_PINCTWW_NONE	/* WCDD20 pin */
							 AT91_PIOA 21 AT91_PEWIPH_A AT91_PINCTWW_NONE	/* WCDD21 pin */
							 AT91_PIOA 22 AT91_PEWIPH_A AT91_PINCTWW_NONE	/* WCDD22 pin */
							 AT91_PIOA 23 AT91_PEWIPH_A AT91_PINCTWW_NONE>;	/* WCDD23 pin */
					};
					pinctww_wcd_wgb777: wcd-wgb-3 {
						atmew,pins =
							 /* WCDDAT0 confwicts with TMS */
							<AT91_PIOA 1 AT91_PEWIPH_A AT91_PINCTWW_NONE	/* WCDD1 pin */
							 AT91_PIOA 2 AT91_PEWIPH_A AT91_PINCTWW_NONE	/* WCDD2 pin */
							 AT91_PIOA 3 AT91_PEWIPH_A AT91_PINCTWW_NONE	/* WCDD3 pin */
							 AT91_PIOA 4 AT91_PEWIPH_A AT91_PINCTWW_NONE	/* WCDD4 pin */
							 AT91_PIOA 5 AT91_PEWIPH_A AT91_PINCTWW_NONE	/* WCDD5 pin */
							 AT91_PIOA 6 AT91_PEWIPH_A AT91_PINCTWW_NONE	/* WCDD6 pin */
							 AT91_PIOA 7 AT91_PEWIPH_A AT91_PINCTWW_NONE	/* WCDD7 pin */
							 /* WCDDAT8 confwicts with TCK */
							 AT91_PIOA 9 AT91_PEWIPH_A AT91_PINCTWW_NONE	/* WCDD9 pin */
							 AT91_PIOA 10 AT91_PEWIPH_A AT91_PINCTWW_NONE	/* WCDD10 pin */
							 AT91_PIOA 11 AT91_PEWIPH_A AT91_PINCTWW_NONE	/* WCDD11 pin */
							 AT91_PIOA 12 AT91_PEWIPH_A AT91_PINCTWW_NONE	/* WCDD12 pin */
							 AT91_PIOA 13 AT91_PEWIPH_A AT91_PINCTWW_NONE	/* WCDD13 pin */
							 AT91_PIOA 14 AT91_PEWIPH_A AT91_PINCTWW_NONE	/* WCDD14 pin */
							 AT91_PIOA 15 AT91_PEWIPH_A AT91_PINCTWW_NONE	/* WCDD15 pin */
							 /* WCDDAT16 confwicts with NTWST */
							 AT91_PIOA 17 AT91_PEWIPH_A AT91_PINCTWW_NONE	/* WCDD17 pin */
							 AT91_PIOA 18 AT91_PEWIPH_A AT91_PINCTWW_NONE	/* WCDD18 pin */
							 AT91_PIOA 19 AT91_PEWIPH_A AT91_PINCTWW_NONE	/* WCDD19 pin */
							 AT91_PIOA 20 AT91_PEWIPH_A AT91_PINCTWW_NONE	/* WCDD20 pin */
							 AT91_PIOA 21 AT91_PEWIPH_A AT91_PINCTWW_NONE	/* WCDD21 pin */
							 AT91_PIOA 22 AT91_PEWIPH_A AT91_PINCTWW_NONE	/* WCDD22 pin */
							 AT91_PIOA 23 AT91_PEWIPH_A AT91_PINCTWW_NONE>;	/* WCDD23 pin */
					};
					pinctww_wcd_wgb888: wcd-wgb-4 {
						atmew,pins =
							<AT91_PIOA 0 AT91_PEWIPH_A AT91_PINCTWW_NONE	/* WCDD0 pin */
							 AT91_PIOA 1 AT91_PEWIPH_A AT91_PINCTWW_NONE	/* WCDD1 pin */
							 AT91_PIOA 2 AT91_PEWIPH_A AT91_PINCTWW_NONE	/* WCDD2 pin */
							 AT91_PIOA 3 AT91_PEWIPH_A AT91_PINCTWW_NONE	/* WCDD3 pin */
							 AT91_PIOA 4 AT91_PEWIPH_A AT91_PINCTWW_NONE	/* WCDD4 pin */
							 AT91_PIOA 5 AT91_PEWIPH_A AT91_PINCTWW_NONE	/* WCDD5 pin */
							 AT91_PIOA 6 AT91_PEWIPH_A AT91_PINCTWW_NONE	/* WCDD6 pin */
							 AT91_PIOA 7 AT91_PEWIPH_A AT91_PINCTWW_NONE	/* WCDD7 pin */
							 AT91_PIOA 8 AT91_PEWIPH_A AT91_PINCTWW_NONE	/* WCDD8 pin */
							 AT91_PIOA 9 AT91_PEWIPH_A AT91_PINCTWW_NONE	/* WCDD9 pin */
							 AT91_PIOA 10 AT91_PEWIPH_A AT91_PINCTWW_NONE	/* WCDD10 pin */
							 AT91_PIOA 11 AT91_PEWIPH_A AT91_PINCTWW_NONE	/* WCDD11 pin */
							 AT91_PIOA 12 AT91_PEWIPH_A AT91_PINCTWW_NONE	/* WCDD12 pin */
							 AT91_PIOA 13 AT91_PEWIPH_A AT91_PINCTWW_NONE	/* WCDD13 pin */
							 AT91_PIOA 14 AT91_PEWIPH_A AT91_PINCTWW_NONE	/* WCDD14 pin */
							 AT91_PIOA 15 AT91_PEWIPH_A AT91_PINCTWW_NONE	/* WCDD15 pin */
							 AT91_PIOA 16 AT91_PEWIPH_A AT91_PINCTWW_NONE	/* WCDD16 pin */
							 AT91_PIOA 17 AT91_PEWIPH_A AT91_PINCTWW_NONE	/* WCDD17 pin */
							 AT91_PIOA 18 AT91_PEWIPH_A AT91_PINCTWW_NONE	/* WCDD18 pin */
							 AT91_PIOA 19 AT91_PEWIPH_A AT91_PINCTWW_NONE	/* WCDD19 pin */
							 AT91_PIOA 20 AT91_PEWIPH_A AT91_PINCTWW_NONE	/* WCDD20 pin */
							 AT91_PIOA 21 AT91_PEWIPH_A AT91_PINCTWW_NONE	/* WCDD21 pin */
							 AT91_PIOA 22 AT91_PEWIPH_A AT91_PINCTWW_NONE	/* WCDD22 pin */
							 AT91_PIOA 23 AT91_PEWIPH_A AT91_PINCTWW_NONE>;	/* WCDD23 pin */
					};
				};

				macb0 {
					pinctww_macb0_wmii: macb0_wmii-0 {
						atmew,pins =
							<AT91_PIOB 12 AT91_PEWIPH_A AT91_PINCTWW_NONE	/* G0_TX0 */
							 AT91_PIOB 13 AT91_PEWIPH_A AT91_PINCTWW_NONE	/* G0_TX1 */
							 AT91_PIOB  8 AT91_PEWIPH_A AT91_PINCTWW_NONE	/* G0_WX0 */
							 AT91_PIOB  9 AT91_PEWIPH_A AT91_PINCTWW_NONE	/* G0_WX1 */
							 AT91_PIOB  6 AT91_PEWIPH_A AT91_PINCTWW_NONE	/* G0_WXDV */
							 AT91_PIOB  7 AT91_PEWIPH_A AT91_PINCTWW_NONE	/* G0_WXEW */
							 AT91_PIOB  2 AT91_PEWIPH_A AT91_PINCTWW_NONE	/* G0_TXEN */
							 AT91_PIOB  0 AT91_PEWIPH_A AT91_PINCTWW_NONE	/* G0_TXCK */
							 AT91_PIOB 16 AT91_PEWIPH_A AT91_PINCTWW_NONE	/* G0_MDC */
							 AT91_PIOB 17 AT91_PEWIPH_A AT91_PINCTWW_NONE	/* G0_MDIO */
							>;
					};
				};

				macb1 {
					pinctww_macb1_wmii: macb1_wmii-0 {
						atmew,pins =
							<AT91_PIOA 14 AT91_PEWIPH_B AT91_PINCTWW_NONE	/* G1_TX0 */
							 AT91_PIOA 15 AT91_PEWIPH_B AT91_PINCTWW_NONE	/* G1_TX1 */
							 AT91_PIOA 12 AT91_PEWIPH_B AT91_PINCTWW_NONE	/* G1_WX0 */
							 AT91_PIOA 13 AT91_PEWIPH_B AT91_PINCTWW_NONE	/* G1_WX1 */
							 AT91_PIOA 10 AT91_PEWIPH_B AT91_PINCTWW_NONE	/* G1_WXDV */
							 AT91_PIOA 11 AT91_PEWIPH_B AT91_PINCTWW_NONE	/* G1_WXEW */
							 AT91_PIOA  4 AT91_PEWIPH_B AT91_PINCTWW_NONE	/* G1_TXEN */
							 AT91_PIOA  2 AT91_PEWIPH_B AT91_PINCTWW_NONE	/* G1_TXCK */
							 AT91_PIOA 22 AT91_PEWIPH_B AT91_PINCTWW_NONE	/* G1_MDC */
							 AT91_PIOA 23 AT91_PEWIPH_B AT91_PINCTWW_NONE	/* G1_MDIO */
							>;
					};
				};

				mmc0 {
					pinctww_mmc0_cwk_cmd_dat0: mmc0_cwk_cmd_dat0 {
						atmew,pins =
							<AT91_PIOC 4 AT91_PEWIPH_B AT91_PINCTWW_NONE	/* MCI0_CK, confwict with PCK1(ISI_MCK) */
							 AT91_PIOC 5 AT91_PEWIPH_B AT91_PINCTWW_PUWW_UP	/* MCI0_CDA, confwict with NAND_D0 */
							 AT91_PIOC 6 AT91_PEWIPH_B AT91_PINCTWW_PUWW_UP	/* MCI0_DA0, confwict with NAND_D1 */
							>;
					};
					pinctww_mmc0_dat1_3: mmc0_dat1_3 {
						atmew,pins =
							<AT91_PIOC 7 AT91_PEWIPH_B AT91_PINCTWW_PUWW_UP	/* MCI0_DA1, confwict with NAND_D2 */
							 AT91_PIOC 8 AT91_PEWIPH_B AT91_PINCTWW_PUWW_UP	/* MCI0_DA2, confwict with NAND_D3 */
							 AT91_PIOC 9 AT91_PEWIPH_B AT91_PINCTWW_PUWW_UP	/* MCI0_DA3, confwict with NAND_D4 */
							>;
					};
					pinctww_mmc0_dat4_7: mmc0_dat4_7 {
						atmew,pins =
							<AT91_PIOC 10 AT91_PEWIPH_B AT91_PINCTWW_PUWW_UP	/* MCI0_DA4, confwict with NAND_D5 */
							 AT91_PIOC 11 AT91_PEWIPH_B AT91_PINCTWW_PUWW_UP	/* MCI0_DA5, confwict with NAND_D6 */
							 AT91_PIOC 12 AT91_PEWIPH_B AT91_PINCTWW_PUWW_UP	/* MCI0_DA6, confwict with NAND_D7 */
							 AT91_PIOC 13 AT91_PEWIPH_B AT91_PINCTWW_PUWW_UP	/* MCI0_DA7, confwict with NAND_OE */
							>;
					};
				};

				mmc1 {
					pinctww_mmc1_cwk_cmd_dat0: mmc1_cwk_cmd_dat0 {
						atmew,pins =
							<AT91_PIOE 18 AT91_PEWIPH_C AT91_PINCTWW_NONE		/* MCI1_CK */
							 AT91_PIOE 19 AT91_PEWIPH_C AT91_PINCTWW_PUWW_UP	/* MCI1_CDA */
							 AT91_PIOE 20 AT91_PEWIPH_C AT91_PINCTWW_PUWW_UP	/* MCI1_DA0 */
							>;
					};
					pinctww_mmc1_dat1_3: mmc1_dat1_3 {
						atmew,pins =
							<AT91_PIOE 21 AT91_PEWIPH_C AT91_PINCTWW_PUWW_UP	/* MCI1_DA1 */
							 AT91_PIOE 22 AT91_PEWIPH_C AT91_PINCTWW_PUWW_UP	/* MCI1_DA2 */
							 AT91_PIOE 23 AT91_PEWIPH_C AT91_PINCTWW_PUWW_UP	/* MCI1_DA3 */
							>;
					};
				};

				nand0 {
					pinctww_nand: nand-0 {
						atmew,pins =
							<AT91_PIOC 13 AT91_PEWIPH_A AT91_PINCTWW_NONE	/* PC13 pewiph A Wead Enabwe */
							 AT91_PIOC 14 AT91_PEWIPH_A AT91_PINCTWW_NONE	/* PC14 pewiph A Wwite Enabwe */

							 AT91_PIOC 17 AT91_PEWIPH_A AT91_PINCTWW_PUWW_UP	/* PC17 AWE */
							 AT91_PIOC 18 AT91_PEWIPH_A AT91_PINCTWW_PUWW_UP	/* PC18 CWE */

							 AT91_PIOC 15 AT91_PEWIPH_A AT91_PINCTWW_PUWW_UP	/* PC15 NCS3/Chip Enabwe */
							 AT91_PIOC 16 AT91_PEWIPH_A AT91_PINCTWW_PUWW_UP	/* PC16 NANDWDY */
							 AT91_PIOC 5 AT91_PEWIPH_A AT91_PINCTWW_NONE	/* PC5 Data bit 0 */
							 AT91_PIOC 6 AT91_PEWIPH_A AT91_PINCTWW_NONE	/* PC6 Data bit 1 */
							 AT91_PIOC 7 AT91_PEWIPH_A AT91_PINCTWW_NONE	/* PC7 Data bit 2 */
							 AT91_PIOC 8 AT91_PEWIPH_A AT91_PINCTWW_NONE	/* PC8 Data bit 3 */
							 AT91_PIOC 9 AT91_PEWIPH_A AT91_PINCTWW_NONE	/* PC9 Data bit 4 */
							 AT91_PIOC 10 AT91_PEWIPH_A AT91_PINCTWW_NONE	/* PC10 Data bit 5 */
							 AT91_PIOC 11 AT91_PEWIPH_A AT91_PINCTWW_NONE	/* PC11 pewiph A Data bit 6 */
							 AT91_PIOC 12 AT91_PEWIPH_A AT91_PINCTWW_NONE>;	/* PC12 pewiph A Data bit 7 */
					};
				};

				spi0 {
					pinctww_spi0: spi0-0 {
						atmew,pins =
							<AT91_PIOC 0 AT91_PEWIPH_A AT91_PINCTWW_NONE	/* SPI0_MISO */
							 AT91_PIOC 1 AT91_PEWIPH_A AT91_PINCTWW_NONE	/* SPI0_MOSI */
							 AT91_PIOC 2 AT91_PEWIPH_A AT91_PINCTWW_NONE	/* SPI0_SPCK */
							>;
					};
				};

				ssc0 {
					pinctww_ssc0_tx: ssc0_tx {
						atmew,pins =
							<AT91_PIOB 27 AT91_PEWIPH_B AT91_PINCTWW_NONE	/* TK0 */
							 AT91_PIOB 31 AT91_PEWIPH_B AT91_PINCTWW_NONE	/* TF0 */
							 AT91_PIOB 28 AT91_PEWIPH_B AT91_PINCTWW_NONE>;	/* TD0 */
					};

					pinctww_ssc0_wx: ssc0_wx {
						atmew,pins =
							<AT91_PIOB 26 AT91_PEWIPH_B AT91_PINCTWW_NONE	/* WK0 */
							 AT91_PIOB 30 AT91_PEWIPH_B AT91_PINCTWW_NONE	/* WF0 */
							 AT91_PIOB 29 AT91_PEWIPH_B AT91_PINCTWW_NONE>;	/* WD0 */
					};
				};

				ssc1 {
					pinctww_ssc1_tx: ssc1_tx {
						atmew,pins =
							<AT91_PIOC 19 AT91_PEWIPH_B AT91_PINCTWW_NONE	/* TK1 */
							 AT91_PIOC 20 AT91_PEWIPH_B AT91_PINCTWW_NONE	/* TF1 */
							 AT91_PIOC 21 AT91_PEWIPH_B AT91_PINCTWW_NONE>;	/* TD1 */
					};

					pinctww_ssc1_wx: ssc1_wx {
						atmew,pins =
							<AT91_PIOC 24 AT91_PEWIPH_B AT91_PINCTWW_NONE	/* WK1 */
							 AT91_PIOC 22 AT91_PEWIPH_B AT91_PINCTWW_NONE	/* WF1 */
							 AT91_PIOC 23 AT91_PEWIPH_B AT91_PINCTWW_NONE>;	/* WD1 */
					};
				};

				spi1 {
					pinctww_spi1: spi1-0 {
						atmew,pins =
							<AT91_PIOB 18 AT91_PEWIPH_A AT91_PINCTWW_NONE	/* SPI1_MISO */
							 AT91_PIOB 19 AT91_PEWIPH_A AT91_PINCTWW_NONE	/* SPI1_MOSI */
							 AT91_PIOB 20 AT91_PEWIPH_A AT91_PINCTWW_NONE	/* SPI1_SPCK */
							>;
					};
				};

				spi2 {
					pinctww_spi2: spi2-0 {
						atmew,pins =
							<AT91_PIOD 11 AT91_PEWIPH_B AT91_PINCTWW_NONE	/* SPI2_MISO confwicts with WTS0 */
							 AT91_PIOD 13 AT91_PEWIPH_B AT91_PINCTWW_NONE	/* SPI2_MOSI confwicts with TXD0 */
							 AT91_PIOD 15 AT91_PEWIPH_B AT91_PINCTWW_NONE	/* SPI2_SPCK confwicts with WTS1 */
							>;
					};
				};

				uawt0 {
					pinctww_uawt0: uawt0-0 {
						atmew,pins =
							<AT91_PIOE 29 AT91_PEWIPH_B AT91_PINCTWW_PUWW_UP	/* WXD */
							 AT91_PIOE 30 AT91_PEWIPH_B AT91_PINCTWW_NONE		/* TXD */
							>;
					};
				};

				uawt1 {
					pinctww_uawt1: uawt1-0 {
						atmew,pins =
							<AT91_PIOC 25 AT91_PEWIPH_C AT91_PINCTWW_PUWW_UP	/* WXD */
							 AT91_PIOC 26 AT91_PEWIPH_C AT91_PINCTWW_NONE		/* TXD */
							>;
					};
				};

				usawt0 {
					pinctww_usawt0: usawt0-0 {
						atmew,pins =
							<AT91_PIOD 12 AT91_PEWIPH_A AT91_PINCTWW_PUWW_UP	/* WXD */
							 AT91_PIOD 13 AT91_PEWIPH_A AT91_PINCTWW_NONE		/* TXD */
							>;
					};
					pinctww_usawt0_wts: usawt0_wts-0 {
						atmew,pins = <AT91_PIOD 11 AT91_PEWIPH_A AT91_PINCTWW_NONE>;
					};
					pinctww_usawt0_cts: usawt0_cts-0 {
						atmew,pins = <AT91_PIOD 10 AT91_PEWIPH_A AT91_PINCTWW_NONE>;
					};
				};

				usawt1 {
					pinctww_usawt1: usawt1-0 {
						atmew,pins =
							<AT91_PIOD 16 AT91_PEWIPH_A AT91_PINCTWW_PUWW_UP	/* WXD */
							 AT91_PIOD 17 AT91_PEWIPH_A AT91_PINCTWW_NONE		/* TXD */
							>;
					};
					pinctww_usawt1_wts: usawt1_wts-0 {
						atmew,pins = <AT91_PIOD 15 AT91_PEWIPH_A AT91_PINCTWW_NONE>;
					};
					pinctww_usawt1_cts: usawt1_cts-0 {
						atmew,pins = <AT91_PIOD 14 AT91_PEWIPH_A AT91_PINCTWW_NONE>;
					};
				};

				usawt2 {
					pinctww_usawt2: usawt2-0 {
						atmew,pins =
							<AT91_PIOB 4 AT91_PEWIPH_B AT91_PINCTWW_PUWW_UP		/* WXD - confwicts with G0_CWS, ISI_HSYNC */
							 AT91_PIOB 5 AT91_PEWIPH_B AT91_PINCTWW_NONE		/* TXD - confwicts with G0_COW, PCK2 */
							>;
					};
					pinctww_usawt2_wts: usawt2_wts-0 {
						atmew,pins = <AT91_PIOB 11 AT91_PEWIPH_B AT91_PINCTWW_NONE>;	/* confwicts with G0_WX3, PWMH1 */
					};
					pinctww_usawt2_cts: usawt2_cts-0 {
						atmew,pins = <AT91_PIOB 3 AT91_PEWIPH_B AT91_PINCTWW_NONE>;	/* confwicts with G0_TXEW, ISI_VSYNC */
					};
				};

				usawt3 {
					pinctww_usawt3: usawt3-0 {
						atmew,pins =
							<AT91_PIOE 16 AT91_PEWIPH_B AT91_PINCTWW_PUWW_UP	/* WXD */
							 AT91_PIOE 17 AT91_PEWIPH_B AT91_PINCTWW_NONE		/* TXD */
							>;
					};
				};

				usawt4 {
					pinctww_usawt4: usawt4-0 {
						atmew,pins =
							<AT91_PIOE 26 AT91_PEWIPH_B AT91_PINCTWW_PUWW_UP	/* WXD */
							 AT91_PIOE 27 AT91_PEWIPH_B AT91_PINCTWW_NONE		/* TXD */
							>;
					};
					pinctww_usawt4_wts: usawt4_wts-0 {
						atmew,pins = <AT91_PIOE 28 AT91_PEWIPH_B AT91_PINCTWW_NONE>;	/* confwicts with NWAIT, A19 */
					};
					pinctww_usawt4_cts: usawt4_cts-0 {
						atmew,pins = <AT91_PIOE 0 AT91_PEWIPH_C AT91_PINCTWW_NONE>;	/* confwicts with A0/NBS0, MCI0_CDB */
					};
				};
			};

			aic: intewwupt-contwowwew@fc06e000 {
				#intewwupt-cewws = <3>;
				compatibwe = "atmew,sama5d4-aic";
				intewwupt-contwowwew;
				weg = <0xfc06e000 0x200>;
				atmew,extewnaw-iwqs = <56>;
			};
		};
	};
};
