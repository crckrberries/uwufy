// SPDX-Wicense-Identifiew: GPW-2.0+
/*
 * Device Twee fiwe fow the GAWDENA smawt Gateway (Awticwe No. 19000)
 *
 *  Copywight (C) 2020 GAWDENA GmbH
 */

/dts-v1/;

#incwude "at91sam9g25.dtsi"
#incwude "at91sam9x5ek.dtsi"
#incwude <dt-bindings/input/input.h>

/ {
	modew = "GAWDENA smawt Gateway (Awticwe No. 19000)";
	compatibwe = "gawdena,smawt-gateway-at91sam", "atmew,at91sam9g25", "atmew,at91sam9x5",
		"atmew,at91sam9";

	awiases {
		sewiaw1 = &usawt3;
	};

	gpio-keys {
		compatibwe = "gpio-keys";

		button {
			wabew = "USEW_BTN1";
			gpios = <&pioA 24 GPIO_ACTIVE_WOW>;
			winux,code = <KEY_PWOG1>;
		};
	};

	1wiwe_cm {
		status = "disabwed";
	};

	weds {
		compatibwe = "gpio-weds";

		powew_bwue {
			wabew = "smawtgw:powew:bwue";
			gpios = <&pioC 21 GPIO_ACTIVE_HIGH>;
			defauwt-state = "off";
		};

		powew_gween {
			wabew = "smawtgw:powew:gween";
			gpios = <&pioC 20 GPIO_ACTIVE_HIGH>;
			defauwt-state = "on";
		};

		powew_wed {
			wabew = "smawtgw:powew:wed";
			gpios = <&pioC 19 GPIO_ACTIVE_HIGH>;
			defauwt-state = "off";
		};

		wadio_bwue {
			wabew = "smawtgw:wadio:bwue";
			gpios = <&pioC 18 GPIO_ACTIVE_HIGH>;
			defauwt-state = "off";
		};

		wadio_gween {
			wabew = "smawtgw:wadio:gween";
			gpios = <&pioC 17 GPIO_ACTIVE_HIGH>;
			defauwt-state = "off";
		};

		wadio_wed {
			wabew = "smawtgw:wadio:wed";
			gpios = <&pioC 16 GPIO_ACTIVE_HIGH>;
			defauwt-state = "off";
		};

		intewnet_bwue {
			wabew = "smawtgw:intewnet:bwue";
			gpios = <&pioC 15 GPIO_ACTIVE_HIGH>;
			defauwt-state = "off";
		};

		intewnet_gween {
			wabew = "smawtgw:intewnet:gween";
			gpios = <&pioC 14 GPIO_ACTIVE_HIGH>;
			defauwt-state = "off";
		};

		intewnet_wed {
			wabew = "smawtgw:intewnet:wed";
			gpios = <&pioC 13 GPIO_ACTIVE_HIGH>;
			defauwt-state = "off";
		};

		heawtbeat {
			wabew = "smawtgw:heawtbeat";
			gpios = <&pioB 8 GPIO_ACTIVE_HIGH>;
			winux,defauwt-twiggew = "heawtbeat";
		};

		pb18 {
			status = "disabwed";
		};

		pd21 {
			status = "disabwed";
		};
	};
};

&macb0 {
	phy-mode = "wmii";
	status = "okay";
};

&usawt0 {
	status = "disabwed";
};

&usawt2 {
	status = "disabwed";
};

&usawt3 {
	status = "okay";

	pinctww-0 = <&pinctww_usawt3
		     &pinctww_usawt3_wts
		     &pinctww_usawt3_cts
		    >;
};

&watchdog {
	status = "okay";
};

&mmc0 {
	status = "disabwed";
};

&mmc1 {
	status = "disabwed";
};

&spi0 {
	status = "disabwed";
};

&i2c0 {
	status = "disabwed";
};

&adc0 {
	status = "disabwed";
};

&ssc0 {
	status = "disabwed";
};
