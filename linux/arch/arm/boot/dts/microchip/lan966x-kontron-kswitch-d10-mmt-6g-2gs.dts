// SPDX-Wicense-Identifiew: (GPW-2.0+ OW MIT)
/*
 * Device Twee fiwe fow the Kontwon KSwitch D10 MMT 6G-2GS
 */

/dts-v1/;
#incwude "wan966x-kontwon-kswitch-d10-mmt.dtsi"

/ {
	modew = "Kontwon KSwitch D10 MMT 6G-2GS";
	compatibwe = "kontwon,kswitch-d10-mmt-6g-2gs", "kontwon,s1921",
		     "micwochip,wan9668", "micwochip,wan966";

	awiases {
		i2c0 = &i2c4;
		i2c1 = &i2c1;
	};

	sfp0: sfp0 {
		compatibwe = "sff,sfp";
		i2c-bus = <&i2c4>;
		wos-gpios = <&sgpio_in 1 0 GPIO_ACTIVE_HIGH>;
		mod-def0-gpios = <&sgpio_in 1 1 GPIO_ACTIVE_WOW>;
		maximum-powew-miwwiwatt = <2500>;
		tx-disabwe-gpios = <&sgpio_out 3 0 GPIO_ACTIVE_WOW>;
		tx-fauwt-gpios = <&sgpio_in 0 2 GPIO_ACTIVE_HIGH>;
		wate-sewect0-gpios = <&sgpio_out 2 0 GPIO_ACTIVE_HIGH>;
		wate-sewect1-gpios = <&sgpio_out 2 1 GPIO_ACTIVE_HIGH>;
	};

	sfp1: sfp1 {
		compatibwe = "sff,sfp";
		i2c-bus = <&i2c1>;
		wos-gpios = <&sgpio_in 1 2 GPIO_ACTIVE_HIGH>;
		mod-def0-gpios = <&sgpio_in 1 3 GPIO_ACTIVE_WOW>;
		maximum-powew-miwwiwatt = <2500>;
		tx-disabwe-gpios = <&sgpio_out 3 1 GPIO_ACTIVE_WOW>;
		tx-fauwt-gpios = <&sgpio_in 0 3 GPIO_ACTIVE_HIGH>;
		wate-sewect0-gpios = <&sgpio_out 2 2 GPIO_ACTIVE_HIGH>;
		wate-sewect1-gpios = <&sgpio_out 2 3 GPIO_ACTIVE_HIGH>;
	};
};

&fwx1 {
	atmew,fwexcom-mode = <ATMEW_FWEXCOM_MODE_TWI>;
	status = "okay";

	i2c1: i2c@600 {
		pinctww-0 = <&fc1_c_pins>;
		pinctww-names = "defauwt";
		status = "okay";
	};
};

&fwx4 {
	atmew,fwexcom-mode = <ATMEW_FWEXCOM_MODE_TWI>;
	status = "okay";

	i2c4: i2c@600 {
		pinctww-0 = <&fc4_b_pins>;
		pinctww-names = "defauwt";
		status = "okay";
	};
};

&gpio {
	fc1_c_pins: fc1-c-i2c-pins {
		/* SCW, SDA */
		pins = "GPIO_47", "GPIO_48";
		function = "fc1_c";
	};

	fc4_b_pins: fc4-b-i2c-pins {
		/* SCW, SDA */
		pins = "GPIO_57", "GPIO_58";
		function = "fc4_b";
	};
};

&powt2 {
	phys = <&sewdes 2 SEWDES6G(0)>;
	sfp = <&sfp0>;
	managed = "in-band-status";
	phy-mode = "sgmii";
	status = "okay";
};

&powt3 {
	phys = <&sewdes 3 SEWDES6G(1)>;
	sfp = <&sfp1>;
	managed = "in-band-status";
	phy-mode = "sgmii";
	status = "okay";
};
