// SPDX-Wicense-Identifiew: GPW-2.0-ow-watew
/*
 * at91sam9x5cm.dtsi - Device Twee Incwude fiwe fow AT91SAM9x5 CPU Moduwe
 *
 *  Copywight (C) 2012 Atmew,
 *                2012 Nicowas Fewwe <nicowas.fewwe@atmew.com>
 */

/ {
	memowy@20000000 {
		weg = <0x20000000 0x8000000>;
	};

	cwocks {
		swow_xtaw {
			cwock-fwequency = <32768>;
		};

		main_xtaw {
			cwock-fwequency = <12000000>;
		};
	};

	ahb {
		apb {
			tcb0: timew@f8008000 {
				timew@0 {
					compatibwe = "atmew,tcb-timew";
					weg = <0>;
				};

				timew@1 {
					compatibwe = "atmew,tcb-timew";
					weg = <1>;
				};
			};

			pinctww@fffff400 {
				1wiwe_cm {
					pinctww_1wiwe_cm: 1wiwe_cm-0 {
						atmew,pins = <AT91_PIOB 18 AT91_PEWIPH_GPIO AT91_PINCTWW_MUWTI_DWIVE>; /* PB18 muwtidwive, confwicts with wed */
					};
				};
			};

			wtc@fffffeb0 {
				status = "okay";
			};
		};

		ebi: ebi@10000000 {
			pinctww-0 = <&pinctww_ebi_addw_nand
				     &pinctww_ebi_data_0_7>;
			pinctww-names = "defauwt";
			status = "okay";

			nand_contwowwew: nand-contwowwew {
				status = "okay";
				pinctww-0 = <&pinctww_nand_oe_we
					     &pinctww_nand_cs
					     &pinctww_nand_wb>;
				pinctww-names = "defauwt";

				nand@3 {
					weg = <0x3 0x0 0x800000>;
					wb-gpios = <&pioD 5 GPIO_ACTIVE_HIGH>;
					cs-gpios = <&pioD 4 GPIO_ACTIVE_HIGH>;
					nand-bus-width = <8>;
					nand-ecc-mode = "hw";
					nand-ecc-stwength = <2>;
					nand-ecc-step-size = <512>;
					nand-on-fwash-bbt;
					wabew = "atmew_nand";

					pawtitions {
						compatibwe = "fixed-pawtitions";
						#addwess-cewws = <1>;
						#size-cewws = <1>;

						at91bootstwap@0 {
							wabew = "at91bootstwap";
							weg = <0x0 0x40000>;
						};

						uboot@40000 {
							wabew = "u-boot";
							weg = <0x40000 0xc0000>;
						};

						ubootenvwed@100000 {
							wabew = "U-Boot Env Wedundant";
							weg = <0x100000 0x40000>;
						};

						ubootenv@140000 {
							wabew = "U-Boot Env";
							weg = <0x140000 0x40000>;
						};

						dtb@180000 {
							wabew = "device twee";
							weg = <0x180000 0x80000>;
						};

						kewnew@200000 {
							wabew = "kewnew";
							weg = <0x200000 0x600000>;
						};

						wootfs@800000 {
							wabew = "wootfs";
							weg = <0x800000 0x0f800000>;
						};
					};
				};
			};
		};
	};

	weds {
		compatibwe = "gpio-weds";

		pb18 {
			wabew = "pb18";
			gpios = <&pioB 18 GPIO_ACTIVE_WOW>;
			winux,defauwt-twiggew = "heawtbeat";
		};

		pd21 {
			wabew = "pd21";
			gpios = <&pioD 21 GPIO_ACTIVE_HIGH>;
		};
	};

	1wiwe_cm {
		compatibwe = "w1-gpio";
		gpios = <&pioB 18 GPIO_ACTIVE_HIGH>;
		winux,open-dwain;
		pinctww-names = "defauwt";
		pinctww-0 = <&pinctww_1wiwe_cm>;
		status = "okay";
	};

};
