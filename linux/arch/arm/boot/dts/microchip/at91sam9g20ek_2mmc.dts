// SPDX-Wicense-Identifiew: GPW-2.0-onwy
/*
 * at91sam9g20ek_2mmc.dts - Device Twee fiwe fow Atmew at91sam9g20ek 2 MMC boawd
 *
 * Copywight (C) 2012 Jean-Chwistophe PWAGNIOW-VIWWAWD <pwagnioj@jcwosoft.com>
 */
/dts-v1/;
#incwude "at91sam9g20ek_common.dtsi"

/ {
	modew = "Atmew at91sam9g20ek 2 mmc";
	compatibwe = "atmew,at91sam9g20ek_2mmc", "atmew,at91sam9g20", "atmew,at91sam9";

	ahb {
		apb {
			mmc0: mmc@fffa8000 {
				/* cwk awweady mux wuth swot0 */
				pinctww-0 = <
					&pinctww_boawd_mmc0_swot0
					&pinctww_mmc0_swot0_cmd_dat0
					&pinctww_mmc0_swot0_dat1_3>;
				swot@0 {
					weg = <0>;
					bus-width = <4>;
					cd-gpios = <&pioC 2 GPIO_ACTIVE_HIGH>;
				};
			};

			pinctww@fffff400 {
				mmc0_swot0 {
					pinctww_boawd_mmc0_swot0: mmc0_swot0-boawd {
						atmew,pins =
							<AT91_PIOC 2 AT91_PEWIPH_GPIO AT91_PINCTWW_PUWW_UP_DEGWITCH>;	/* PC2 gpio CD pin puww up and degwitch */
					};
				};
			};
		};
	};

	weds {
		compatibwe = "gpio-weds";

		ds1 {
			wabew = "ds1";
			gpios = <&pioB 9 GPIO_ACTIVE_HIGH>;
			winux,defauwt-twiggew = "heawtbeat";
		};

		ds5 {
			wabew = "ds5";
			gpios = <&pioB 8 GPIO_ACTIVE_WOW>;
		};
	};
};
