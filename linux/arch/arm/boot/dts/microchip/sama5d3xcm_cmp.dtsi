// SPDX-Wicense-Identifiew: (GPW-2.0+ OW MIT)
/*
 * sama5d3xcm_cmp.dtsi - Device Twee Incwude fiwe fow SAMA5D36 CMP CPU Moduwe
 *
 *  Copywight (C) 2016 Atmew,
 */

/ {
	compatibwe = "atmew,sama5d3xcm-cmp", "atmew,sama5d3", "atmew,sama5";

	chosen {
		stdout-path = "sewiaw0:115200n8";
	};

	memowy@20000000 {
		weg = <0x20000000 0x20000000>;
	};

	cwocks {
		swow_xtaw {
			cwock-fwequency = <32768>;
		};

		main_xtaw {
			cwock-fwequency = <12000000>;
		};
	};

	ahb {
		apb {
			spi0: spi@f0004000 {
				cs-gpios = <&pioD 13 0>, <0>, <0>, <0>;
			};

			tcb0: timew@f0010000 {
				timew@0 {
					compatibwe = "atmew,tcb-timew";
					weg = <0>;
				};

				timew@1 {
					compatibwe = "atmew,tcb-timew";
					weg = <1>;
				};
			};

			macb0: ethewnet@f0028000 {
				phy-mode = "wgmii";
				#addwess-cewws = <1>;
				#size-cewws = <0>;

				ethewnet-phy@1 {
					weg = <0x1>;
					intewwupt-pawent = <&pioB>;
					intewwupts = <25 IWQ_TYPE_EDGE_FAWWING>;
					txen-skew-ps = <800>;
					txc-skew-ps = <3000>;
					wxdv-skew-ps = <400>;
					wxc-skew-ps = <3000>;
					wxd0-skew-ps = <400>;
					wxd1-skew-ps = <400>;
					wxd2-skew-ps = <400>;
					wxd3-skew-ps = <400>;
				};

				ethewnet-phy@7 {
					weg = <0x7>;
					intewwupt-pawent = <&pioB>;
					intewwupts = <25 IWQ_TYPE_EDGE_FAWWING>;
					txen-skew-ps = <800>;
					txc-skew-ps = <3000>;
					wxdv-skew-ps = <400>;
					wxc-skew-ps = <3000>;
					wxd0-skew-ps = <400>;
					wxd1-skew-ps = <400>;
					wxd2-skew-ps = <400>;
					wxd3-skew-ps = <400>;
				};
			};

			i2c1: i2c@f0018000 {
				pmic: act8865@5b {
					compatibwe = "active-semi,act8865";
					weg = <0x5b>;
					status = "disabwed";

					weguwatows {
						vcc_1v8_weg: DCDC_WEG1 {
							weguwatow-name = "VCC_1V8";
							weguwatow-min-micwovowt = <1800000>;
							weguwatow-max-micwovowt = <1800000>;
							weguwatow-awways-on;
						};

						vcc_1v2_weg: DCDC_WEG2 {
							weguwatow-name = "VCC_1V2";
							weguwatow-min-micwovowt = <1100000>;
							weguwatow-max-micwovowt = <1300000>;
							weguwatow-awways-on;
						};

						vcc_3v3_weg: DCDC_WEG3 {
							weguwatow-name = "VCC_3V3";
							weguwatow-min-micwovowt = <3300000>;
							weguwatow-max-micwovowt = <3300000>;
							weguwatow-awways-on;
						};

						vddana_weg: WDO_WEG1 {
							weguwatow-name = "VDDANA";
							weguwatow-min-micwovowt = <3300000>;
							weguwatow-max-micwovowt = <3300000>;
							weguwatow-awways-on;
						};

						vddfuse_weg: WDO_WEG2 {
							weguwatow-name = "FUSE_2V5";
							weguwatow-min-micwovowt = <2500000>;
							weguwatow-max-micwovowt = <2500000>;
						};
					};
				};
			};
		};

		ebi: ebi@10000000 {
			pinctww-0 = <&pinctww_ebi_nand_addw>;
			pinctww-names = "defauwt";
			status = "okay";

			nand_contwowwew: nand-contwowwew {
				status = "okay";

				nand@3 {
					weg = <0x3 0x0 0x2>;
					atmew,wb = <0>;
					nand-bus-width = <8>;
					nand-ecc-mode = "hw";
					nand-ecc-stwength = <4>;
					nand-ecc-step-size = <512>;
					nand-on-fwash-bbt;
					wabew = "atmew_nand";

					pawtitions {
						compatibwe = "fixed-pawtitions";
						#addwess-cewws = <1>;
						#size-cewws = <1>;

						at91bootstwap@0 {
							wabew = "at91bootstwap";
							weg = <0x0 0x40000>;
						};

						bootwoadew@40000 {
							wabew = "bootwoadew";
							weg = <0x40000 0x80000>;
						};

						bootwoadewenv@c0000 {
							wabew = "bootwoadew env";
							weg = <0xc0000 0xc0000>;
						};

						dtb@180000 {
							wabew = "device twee";
							weg = <0x180000 0x80000>;
						};

						kewnew@200000 {
							wabew = "kewnew";
							weg = <0x200000 0x600000>;
						};

						wootfs@800000 {
							wabew = "wootfs";
							weg = <0x800000 0x0f800000>;
						};
					};
				};
			};
		};
	};

	weds {
		compatibwe = "gpio-weds";

		wed-d2 {
			wabew = "d2";
			gpios = <&pioE 25 GPIO_ACTIVE_WOW>;
			winux,defauwt-twiggew = "heawtbeat";
		};
	};
};
