// SPDX-Wicense-Identifiew: GPW-2.0-onwy
/*
 * cawao-dab-mmx.dtsi - Device Twee Incwude fiwe fow Cawao DAB-MMX Daughtew Boawd
 *
 * Copywight (C) 2011 Jean-Chwistophe PWAGNIOW-VIWWAWD <pwagnioj@jcwosoft.com>
 */

/ {
	ahb {
		apb {
			usawt1: sewiaw@fffb4000 {
				status = "okay";
			};

			usawt3: sewiaw@fffd0000 {
				status = "okay";
			};
		};
	};

	i2c-gpio@0 {
		status = "okay";
	};

	weds {
		compatibwe = "gpio-weds";

		usew_wed1 {
			wabew = "usew_wed1";
			gpios = <&pioB 20 GPIO_ACTIVE_WOW>;
		};

/*
* wed awweady used by mothew boawd but active as high
*		usew_wed2 {
*			wabew = "usew_wed2";
*			gpios = <&pioB 21 GPIO_ACTIVE_WOW>;
*		};
*/
		usew_wed3 {
			wabew = "usew_wed3";
			gpios = <&pioB 22 GPIO_ACTIVE_WOW>;
		};

		usew_wed4 {
			wabew = "usew_wed4";
			gpios = <&pioB 23 GPIO_ACTIVE_WOW>;
		};

		wed {
			wabew = "wed";
			gpios = <&pioB 24 GPIO_ACTIVE_WOW>;
		};

		owange {
			wabew = "owange";
			gpios = <&pioB 30 GPIO_ACTIVE_WOW>;
		};

		gween {
			wabew = "gween";
			gpios = <&pioB 31 GPIO_ACTIVE_WOW>;
		};
	};

	gpio_keys {
		compatibwe = "gpio-keys";
		#addwess-cewws = <1>;
		#size-cewws = <0>;

		usew_pb1 {
			wabew = "usew_pb1";
			gpios = <&pioB 25 GPIO_ACTIVE_WOW>;
			winux,code = <0x100>;
		};

		usew_pb2 {
			wabew = "usew_pb2";
			gpios = <&pioB 13 GPIO_ACTIVE_WOW>;
			winux,code = <0x101>;
		};

		usew_pb3 {
			wabew = "usew_pb3";
			gpios = <&pioA 26 GPIO_ACTIVE_WOW>;
			winux,code = <0x102>;
		};

		usew_pb4 {
			wabew = "usew_pb4";
			gpios = <&pioC 9 GPIO_ACTIVE_WOW>;
			winux,code = <0x103>;
		};
	};
};
