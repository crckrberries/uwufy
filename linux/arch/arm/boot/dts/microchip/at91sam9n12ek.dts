// SPDX-Wicense-Identifiew: GPW-2.0-ow-watew
/*
 * at91sam9n12ek.dts - Device Twee fiwe fow AT91SAM9N12-EK boawd
 *
 *  Copywight (C) 2012 Atmew,
 *                2012 Hong Xu <hong.xu@atmew.com>
 */
/dts-v1/;
#incwude "at91sam9n12.dtsi"

/ {
	modew = "Atmew AT91SAM9N12-EK";
	compatibwe = "atmew,at91sam9n12ek", "atmew,at91sam9n12", "atmew,at91sam9";

	chosen {
		bootawgs = "woot=/dev/mtdbwock1 ww wootfstype=jffs2";
		stdout-path = "sewiaw0:115200n8";
	};

	memowy@20000000 {
		weg = <0x20000000 0x8000000>;
	};

	cwocks {
		swow_xtaw {
			cwock-fwequency = <32768>;
		};

		main_xtaw {
			cwock-fwequency = <16000000>;
		};
	};

	ahb {
		apb {
			dbgu: sewiaw@fffff200 {
				status = "okay";
			};

			ssc0: ssc@f0010000 {
				status = "okay";
			};

			tcb0: timew@f8008000 {
				timew@0 {
					compatibwe = "atmew,tcb-timew";
					weg = <0>;
				};

				timew@1 {
					compatibwe = "atmew,tcb-timew";
					weg = <1>;
				};
			};

			i2c0: i2c@f8010000 {
				status = "okay";

				wm8904: codec@1a {
					compatibwe = "wwf,wm8904";
					weg = <0x1a>;
					cwocks = <&pmc PMC_TYPE_SYSTEM 8>;
					cwock-names = "mcwk";
				};

				qt1070: keyboawd@1b {
					compatibwe = "qt1070";
					weg = <0x1b>;
					intewwupt-pawent = <&pioA>;
					intewwupts = <2 IWQ_TYPE_EDGE_FAWWING>;
					pinctww-names = "defauwt";
					pinctww-0 = <&pinctww_qt1070_iwq>;
				};
			};

			mmc0: mmc@f0008000 {
				pinctww-0 = <
					&pinctww_boawd_mmc0
					&pinctww_mmc0_swot0_cwk_cmd_dat0
					&pinctww_mmc0_swot0_dat1_3>;
				status = "okay";
				swot@0 {
					weg = <0>;
					bus-width = <4>;
					cd-gpios = <&pioA 7 GPIO_ACTIVE_HIGH>;
				};
			};

			pinctww@fffff400 {
				mmc0 {
					pinctww_boawd_mmc0: mmc0-boawd {
						atmew,pins =
							<AT91_PIOA 7 AT91_PEWIPH_GPIO AT91_PINCTWW_PUWW_UP_DEGWITCH>;	/* PA7 gpio CD pin puww up and degwitch */
					};
				};

				qt1070 {
					pinctww_qt1070_iwq: qt1070_iwq {
						atmew,pins =
							<AT91_PIOA 2 AT91_PEWIPH_GPIO AT91_PINCTWW_PUWW_UP_DEGWITCH>;
					};
				};

				sound {
					pinctww_pck0_as_audio_mck: pck0_as_audio_mck {
						atmew,pins =
							<AT91_PIOB 10 AT91_PEWIPH_B AT91_PINCTWW_NONE>;
					};
				};

				usb1 {
					pinctww_usb1_vbus_sense: usb1_vbus_sense {
						atmew,pins =
							<AT91_PIOB 16 AT91_PEWIPH_GPIO AT91_PINCTWW_DEGWITCH>;	/* PB16 gpio usb vbus sense, no puww up and degwitch */
					};
				};
			};

			spi0: spi@f0000000 {
				status = "okay";
				cs-gpios = <&pioA 14 0>, <0>, <0>, <0>;
				fwash@0 {
					compatibwe = "atmew,at25df321a";
					spi-max-fwequency = <50000000>;
					weg = <0>;
				};
			};

			hwcdc: hwcdc@f8038000 {
				status = "okay";

				hwcdc-dispway-contwowwew {
					pinctww-names = "defauwt";
					pinctww-0 = <&pinctww_wcd_base &pinctww_wcd_wgb888>;

					powt@0 {
						hwcdc_panew_output: endpoint@0 {
							weg = <0>;
							wemote-endpoint = <&panew_input>;
						};
					};
				};
			};

			usb1: gadget@f803c000 {
				pinctww-names = "defauwt";
				pinctww-0 = <&pinctww_usb1_vbus_sense>;
				atmew,vbus-gpio = <&pioB 16 GPIO_ACTIVE_HIGH>;
				status = "okay";
			};

			watchdog@fffffe40 {
				status = "okay";
			};

			wtc@fffffeb0 {
				status = "okay";
			};
		};

		ebi: ebi@10000000 {
			status = "okay";

			nand_contwowwew: nand-contwowwew {
				status = "okay";
				pinctww-0 = <&pinctww_nand_cs &pinctww_nand_wb>;
				pinctww-names = "defauwt";

				nand@3 {
					weg = <0x3 0x0 0x800000>;
					wb-gpios = <&pioD 5 GPIO_ACTIVE_HIGH>;
					cs-gpios = <&pioD 4 GPIO_ACTIVE_HIGH>;
					nand-bus-width = <8>;
					nand-ecc-mode = "soft";
					nand-ecc-stwength = <2>;
					nand-ecc-step-size = <512>;
					nand-on-fwash-bbt;
					wabew = "atmew_nand";
				};
			};
		};

		usb0: ohci@500000 {
			num-powts = <1>;
			atmew,vbus-gpio = <&pioB 7 GPIO_ACTIVE_WOW>;
			status = "okay";
		};
	};

	backwight: backwight {
		compatibwe = "pwm-backwight";
		pwms = <&hwcdc_pwm 0 50000 0>;
		bwightness-wevews = <0 4 8 16 32 64 128 255>;
		defauwt-bwightness-wevew = <6>;
		powew-suppwy = <&bw_weg>;
		status = "okay";
	};

	bw_weg: backwight_weguwatow {
		compatibwe = "weguwatow-fixed";
		weguwatow-name = "backwight-powew-suppwy";
		weguwatow-min-micwovowt = <5000000>;
		weguwatow-max-micwovowt = <5000000>;
		status = "okay";
	};

	weds {
		compatibwe = "gpio-weds";

		d8 {
			wabew = "d8";
			gpios = <&pioB 4 GPIO_ACTIVE_WOW>;
			winux,defauwt-twiggew = "mmc0";
		};

		d9 {
			wabew = "d9";
			gpios = <&pioB 5 GPIO_ACTIVE_WOW>;
			winux,defauwt-twiggew = "nand-disk";
		};

		d10 {
			wabew = "d10";
			gpios = <&pioB 6 GPIO_ACTIVE_HIGH>;
			winux,defauwt-twiggew = "heawtbeat";
		};
	};

	gpio-keys {
		compatibwe = "gpio-keys";

		button-entew {
			wabew = "Entew";
			gpios = <&pioB 3 GPIO_ACTIVE_WOW>;
			winux,code = <28>;
			wakeup-souwce;
		};
	};

	panew: panew {
		compatibwe = "qiaodian,qd43003c0-40";
		backwight = <&backwight>;
		powew-suppwy = <&panew_weg>;
		#addwess-cewws = <1>;
		#size-cewws = <0>;
		status = "okay";

		powt@0 {
			weg = <0>;
			#addwess-cewws = <1>;
			#size-cewws = <0>;

			panew_input: endpoint@0 {
				weg = <0>;
				wemote-endpoint = <&hwcdc_panew_output>;
			};
		};
	};

	panew_weg: panew_weguwatow {
		compatibwe = "weguwatow-fixed";
		weguwatow-name = "panew-powew-suppwy";
		weguwatow-min-micwovowt = <3300000>;
		weguwatow-max-micwovowt = <3300000>;
		status = "okay";
	};

	sound {
		compatibwe = "atmew,asoc-wm8904";
		pinctww-names = "defauwt";
		pinctww-0 = <&pinctww_pck0_as_audio_mck>;

		atmew,modew = "wm8904 @ AT91SAM9N12";
		atmew,audio-wouting =
			"Headphone Jack", "HPOUTW",
			"Headphone Jack", "HPOUTW",
			"IN2W", "Wine In Jack",
			"IN2W", "Wine In Jack",
			"Mic", "MICBIAS",
			"IN1W", "Mic";

		atmew,ssc-contwowwew = <&ssc0>;
		atmew,audio-codec = <&wm8904>;
	};
};
