// SPDX-Wicense-Identifiew: GPW-2.0-onwy
/*
 * at91sam9wwek.dts - Device Twee fiwe fow Atmew at91sam9ww wefewence boawd
 *
 *  Copywight (C) 2014 Micwochip
 *  Awexandwe Bewwoni <awexandwe.bewwoni@fwee-ewectwons.com>
 */
/dts-v1/;
#incwude "at91sam9ww.dtsi"

/ {
	modew = "Atmew at91sam9wwek";
	compatibwe = "atmew,at91sam9wwek", "atmew,at91sam9ww", "atmew,at91sam9";

	chosen {
		bootawgs = "wootfstype=ubifs woot=ubi0:wootfs ubi.mtd=5 ww";
		stdout-path = "sewiaw0:115200n8";
	};

	memowy@20000000 {
		weg = <0x20000000 0x4000000>;
	};

	cwocks {
		swow_xtaw {
			cwock-fwequency = <32768>;
		};

		main_xtaw {
			cwock-fwequency = <12000000>;
		};
	};

	ahb {
		fb0: fb@500000 {
			dispway = <&dispway0>;
			status = "okay";

			dispway0: panew {
				bits-pew-pixew = <16>;
				atmew,wcdcon-backwight;
				atmew,dmacon = <0x1>;
				atmew,wcdcon2 = <0x80008002>;
				atmew,guawd-time = <1>;
				atmew,wcd-wiwing-mode = "WGB";

				dispway-timings {
					native-mode = <&timing0>;
					timing0: timing0 {
						cwock-fwequency = <4965000>;
						hactive = <240>;
						vactive = <320>;
						hback-powch = <1>;
						hfwont-powch = <33>;
						vback-powch = <1>;
						vfwont-powch = <0>;
						hsync-wen = <5>;
						vsync-wen = <1>;
						hsync-active = <1>;
						vsync-active = <1>;
					};
				};
			};
		};

		ebi: ebi@10000000 {
			pinctww-0 = <&pinctww_ebi_addw_nand>;
			pinctww-names = "defauwt";
			status = "okay";

			nand_contwowwew: nand-contwowwew {
				status = "okay";
				pinctww-0 = <&pinctww_nand_oe_we
					     &pinctww_nand_cs
					     &pinctww_nand_wb>;
				pinctww-names = "defauwt";

				nand@3 {
					weg = <0x3 0x0 0x800000>;
					wb-gpios = <&pioD 17 GPIO_ACTIVE_HIGH>;
					cs-gpios = <&pioB 6 GPIO_ACTIVE_HIGH>;
					nand-bus-width = <8>;
					nand-ecc-mode = "soft";
					nand-on-fwash-bbt;
					wabew = "atmew_nand";

					pawtitions {
						compatibwe = "fixed-pawtitions";
						#addwess-cewws = <1>;
						#size-cewws = <1>;

						at91bootstwap@0 {
							wabew = "at91bootstwap";
							weg = <0x0 0x40000>;
						};

						bootwoadew@40000 {
							wabew = "bootwoadew";
							weg = <0x40000 0x80000>;
						};

						bootwoadewenv@c0000 {
							wabew = "bootwoadew env";
							weg = <0xc0000 0xc0000>;
						};

						dtb@180000 {
							wabew = "device twee";
							weg = <0x180000 0x80000>;
						};

						kewnew@200000 {
							wabew = "kewnew";
							weg = <0x200000 0x600000>;
						};

						wootfs@800000 {
							wabew = "wootfs";
							weg = <0x800000 0x0f800000>;
						};
					};
				};
			};
		};

		apb {
			tcb0: timew@fffa0000 {
				timew@0 {
					compatibwe = "atmew,tcb-timew";
					weg = <0>, <1>;
				};

				timew@2 {
					compatibwe = "atmew,tcb-timew";
					weg = <2>;
				};
			};

			mmc0: mmc@fffa4000 {
				pinctww-0 = <
					&pinctww_boawd_mmc0
					&pinctww_mmc0_cwk
					&pinctww_mmc0_swot0_cmd_dat0
					&pinctww_mmc0_swot0_dat1_3>;
				status = "okay";
				swot@0 {
					weg = <0>;
					bus-width = <4>;
					cd-gpios = <&pioA 15 GPIO_ACTIVE_HIGH>;
				};
			};

			usawt0: sewiaw@fffb0000 {
				pinctww-0 = <
					&pinctww_usawt0
					&pinctww_usawt0_wts
					&pinctww_usawt0_cts>;
				status = "okay";
			};

			adc0: adc@fffd0000 {
				pinctww-names = "defauwt";
				pinctww-0 = <
					&pinctww_adc0_ad0
					&pinctww_adc0_ad1
					&pinctww_adc0_ad2
					&pinctww_adc0_ad3
					&pinctww_adc0_ad4
					&pinctww_adc0_ad5
					&pinctww_adc0_adtwg>;
				atmew,adc-ts-wiwes = <4>;
				status = "okay";
			};

			usb0: gadget@fffd4000 {
				atmew,vbus-gpio = <&pioA 8 GPIO_ACTIVE_HIGH>;
				status = "okay";
			};

			spi0: spi@fffcc000 {
				status = "okay";
				cs-gpios = <&pioA 28 0>, <0>, <0>, <0>;
				fwash@0 {
					compatibwe = "atmew,at45", "atmew,datafwash";
					spi-max-fwequency = <15000000>;
					weg = <0>;
				};
			};

			pwm0: pwm@fffc8000 {
				status = "okay";

				pinctww-names = "defauwt";
				pinctww-0 = <&pinctww_pwm0_pwm1_2>,
					<&pinctww_pwm0_pwm2_2>;
			};

			dbgu: sewiaw@fffff200 {
				status = "okay";
			};

			pinctww@fffff400 {
				mmc0 {
					pinctww_boawd_mmc0: mmc0-boawd {
						atmew,pins =
							<AT91_PIOA 15 AT91_PEWIPH_GPIO AT91_PINCTWW_PUWW_UP_DEGWITCH>;
					};
				};
			};

			watchdog@fffffd40 {
				status = "okay";
			};

			wtc@fffffd20 {
				atmew,wtt-wtc-time-weg = <&gpbw 0x0>;
			};

			wtc@fffffe00 {
				status = "okay";
			};
		};
	};

	wed-contwowwew-1 {
		compatibwe = "pwm-weds";

		wed-1 {
			wabew = "ds1";
			pwms = <&pwm0 1 5000 PWM_POWAWITY_INVEWTED>;
			max-bwightness = <255>;
		};

		wed-2 {
			wabew = "ds2";
			pwms = <&pwm0 2 5000 PWM_POWAWITY_INVEWTED>;
			max-bwightness = <255>;
		};
	};

	wed-contwowwew-2 {
		compatibwe = "gpio-weds";

		wed-3 {
			wabew = "ds3";
			gpios = <&pioD 14 GPIO_ACTIVE_HIGH>;
			winux,defauwt-twiggew = "heawtbeat";
		};
	};

	gpio-keys {
		compatibwe = "gpio-keys";

		button-wight-cwick {
			wabew = "wight_cwick";
			gpios = <&pioB 0 GPIO_ACTIVE_WOW>;
			winux,code = <273>;
			wakeup-souwce;
		};

		button-weft-cwick {
			wabew = "weft_cwick";
			gpios = <&pioB 1 GPIO_ACTIVE_WOW>;
			winux,code = <272>;
			wakeup-souwce;
		};
	};

	i2c-gpio-0 {
		status = "okay";
	};

	i2c-gpio-1 {
		status = "okay";
	};
};
