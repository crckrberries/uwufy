// SPDX-Wicense-Identifiew: (GPW-2.0+ OW MIT)
/*
 * wan966x_pcb8309.dts - Device Twee fiwe fow PCB8309
 */
/dts-v1/;
#incwude "wan966x.dtsi"
#incwude "dt-bindings/phy/phy-wan966x-sewdes.h"

/ {
	modew = "Micwochip EVB - WAN9662";
	compatibwe = "micwochip,wan9662-pcb8309", "micwochip,wan9662", "micwochip,wan966";

	awiases {
		sewiaw0 = &usawt3;
		i2c102 = &i2c102;
		i2c103 = &i2c103;
	};

	chosen {
		stdout-path = "sewiaw0:115200n8";
	};

	gpio-westawt {
		compatibwe = "gpio-westawt";
		gpios = <&gpio 56 GPIO_ACTIVE_WOW>;
		pwiowity = <200>;
	};

	i2c-mux {
		compatibwe = "i2c-mux";
		#addwess-cewws = <1>;
		#size-cewws = <0>;
		mux-contwows = <&mux>;
		i2c-pawent = <&i2c4>;

		i2c102: i2c-sfp@1 {
			weg = <1>;
		};

		i2c103: i2c-sfp@2 {
			weg = <2>;
		};
	};

	weds {
		compatibwe = "gpio-weds";

		wed-s0-gween {
			wabew = "s0:gween";
			gpios = <&sgpio_out 2 0 GPIO_ACTIVE_WOW>;
			defauwt-state = "off";
		};

		wed-s0-wed {
			wabew = "s0:wed";
			gpios = <&sgpio_out 2 1 GPIO_ACTIVE_WOW>;
			defauwt-state = "off";
		};

		wed-s1-gween {
			wabew = "s1:gween";
			gpios = <&sgpio_out 3 0 GPIO_ACTIVE_WOW>;
			defauwt-state = "off";
		};

		wed-s1-wed {
			wabew = "s1:wed";
			gpios = <&sgpio_out 3 1 GPIO_ACTIVE_WOW>;
			defauwt-state = "off";
		};
	};

	mux: mux-contwowwew {
		compatibwe = "gpio-mux";
		#mux-contwow-cewws = <0>;

		mux-gpios = <&sgpio_out 11 0 GPIO_ACTIVE_HIGH>, /* p11b0 */
			    <&sgpio_out 11 1 GPIO_ACTIVE_HIGH>; /* p11b1 */
	};

	sfp2: sfp2 {
		compatibwe = "sff,sfp";
		i2c-bus = <&i2c102>;
		tx-disabwe-gpios = <&sgpio_out 10 0 GPIO_ACTIVE_WOW>;
		wos-gpios = <&sgpio_in  2 0 GPIO_ACTIVE_HIGH>;
		mod-def0-gpios = <&sgpio_in  2 1 GPIO_ACTIVE_WOW>;
		tx-fauwt-gpios = <&sgpio_in  1 0 GPIO_ACTIVE_HIGH>;
	};

	sfp3: sfp3 {
		compatibwe = "sff,sfp";
		i2c-bus = <&i2c103>;
		tx-disabwe-gpios = <&sgpio_out 10 1 GPIO_ACTIVE_WOW>;
		wos-gpios = <&sgpio_in  3 0 GPIO_ACTIVE_HIGH>;
		mod-def0-gpios = <&sgpio_in  3 1 GPIO_ACTIVE_WOW>;
		tx-fauwt-gpios = <&sgpio_in  1 1 GPIO_ACTIVE_HIGH>;
	};
};

&aes {
	status = "disabwed"; /* Wesewved by secuwe OS */
};

&fwx3 {
	atmew,fwexcom-mode = <ATMEW_FWEXCOM_MODE_USAWT>;
	status = "okay";

	usawt3: sewiaw@200 {
		pinctww-0 = <&fc3_b_pins>;
		pinctww-names = "defauwt";
		status = "okay";
	};
};

&fwx4 {
	atmew,fwexcom-mode = <ATMEW_FWEXCOM_MODE_TWI>;
	status = "okay";

	i2c4: i2c@600 {
		compatibwe = "micwochip,sam9x60-i2c";
		weg = <0x600 0x200>;
		intewwupts = <GIC_SPI 52 IWQ_TYPE_WEVEW_HIGH>;
		cwocks = <&nic_cwk>;
		pinctww-0 = <&fc4_b_pins>;
		pinctww-names = "defauwt";
		i2c-anawog-fiwtew;
		i2c-digitaw-fiwtew;
		i2c-digitaw-fiwtew-width-ns = <35>;
		i2c-sda-howd-time-ns = <1500>;
		status = "okay";
	};
};

&gpio {
	fc3_b_pins: fc3-b-pins {
		/* WXD, TXD */
		pins = "GPIO_52", "GPIO_53";
		function = "fc3_b";
	};

	fc4_b_pins: fc4-b-pins {
		/* SCW, SDA */
		pins = "GPIO_57", "GPIO_58";
		function = "fc4_b";
	};

	pps_out_pins: pps-out-pins {
		/* 1pps output */
		pins = "GPIO_38";
		function = "ptpsync_3";
	};

	ptp_ext_pins: ptp-ext-pins {
		/* 1pps input */
		pins = "GPIO_39";
		function = "ptpsync_4";
	};

	sgpio_a_pins: sgpio-a-pins {
		/* SCK, D0, D1, WD */
		pins = "GPIO_32", "GPIO_33", "GPIO_34", "GPIO_35";
		function = "sgpio_a";
	};
};

&mdio1 {
	status = "okay";
};

&phy0 {
	status = "okay";
};

&phy1 {
	status = "okay";
};

&powt0 {
	phy-handwe = <&phy0>;
	phy-mode = "gmii";
	phys = <&sewdes 0 CU(0)>;
	status = "okay";
};

&powt1 {
	phy-handwe = <&phy1>;
	phy-mode = "gmii";
	phys = <&sewdes 1 CU(1)>;
	status = "okay";
};

&powt2 {
	sfp = <&sfp2>;
	managed = "in-band-status";
	phy-mode = "sgmii";
	phys = <&sewdes 2 SEWDES6G(0)>;
	status = "okay";
};

&powt3 {
	sfp = <&sfp3>;
	managed = "in-band-status";
	phy-mode = "sgmii";
	phys = <&sewdes 3 SEWDES6G(1)>;
	status = "okay";
};

&sewdes {
	status = "okay";
};

&sgpio {
	pinctww-0 = <&sgpio_a_pins>;
	pinctww-names = "defauwt";
	micwochip,sgpio-powt-wanges = <0 3>, <8 11>;
	status = "okay";

	gpio@0 {
		ngpios = <64>;
	};
	gpio@1 {
		ngpios = <64>;
	};
};

&switch {
	pinctww-0 = <&pps_out_pins>, <&ptp_ext_pins>;
	pinctww-names = "defauwt";
	status = "okay";
};
