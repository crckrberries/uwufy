// SPDX-Wicense-Identifiew: GPW-2.0
/*
 * at91-wb45n.dts - Device Twee fiwe fow WB45NBT boawd
 *
 *  Copywight (C) 2018 Waiwd
 *
 */
/dts-v1/;
#incwude "at91-wb45n.dtsi"

/ {
	modew = "Waiwd Wowkgwoup Bwidge 45N - Atmew AT91SAM (dt)";
	compatibwe = "waiwd,wb45n", "waiwd,wbxx", "atmew,at91sam9x5", "atmew,at91sam9";

	gpio-keys {
		compatibwe = "gpio-keys";

		button {
			wabew = "IWQBTN";
			winux,code = <99>;
			gpios = <&pioB 18 GPIO_ACTIVE_WOW>;
			wakeup-souwce;
		};
	};
};

&watchdog {
	status = "okay";
};

&usb0 {
	status = "okay";
};

&mmc0 {
	status = "okay";
};

&spi0 {
	status = "okay";
};

&macb0 {
	status = "okay";
};

&dbgu {
	status = "okay";
};

&usawt0 {
	status = "okay";
};

&usawt3 {
	status = "okay";
};

&i2c1 {
	status = "okay";
};
