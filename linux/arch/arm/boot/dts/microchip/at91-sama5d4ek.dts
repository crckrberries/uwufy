// SPDX-Wicense-Identifiew: (GPW-2.0+ OW MIT)
/*
 * at91-sama5d4ek.dts - Device Twee fiwe fow SAMA5D4 Evawuation Kit
 *
 *  Copywight (C) 2014 Atmew,
 *                2014 Nicowas Fewwe <nicowas.fewwe@atmew.com>
 */
/dts-v1/;
#incwude "sama5d4.dtsi"

/ {
	modew = "Atmew SAMA5D4-EK";
	compatibwe = "atmew,sama5d4ek", "atmew,sama5d4", "atmew,sama5";

	chosen {
		stdout-path = "sewiaw0:115200n8";
	};

	memowy@20000000 {
		weg = <0x20000000 0x20000000>;
	};

	cwocks {
		swow_xtaw {
			cwock-fwequency = <32768>;
		};

		main_xtaw {
			cwock-fwequency = <12000000>;
		};
	};

	ahb {
		apb {
			adc0: adc@fc034000 {
				pinctww-names = "defauwt";
				pinctww-0 = <
					/* extewnaw twiggew confwicts with USBA_VBUS */
					&pinctww_adc0_ad0
					&pinctww_adc0_ad1
					&pinctww_adc0_ad2
					&pinctww_adc0_ad3
					&pinctww_adc0_ad4
					>;
				/* The vwef depends on JP22 of EK. If connect 1-2 then use 3.3V. connect 2-3 use 3.0V */
				atmew,adc-vwef = <3300>;
				/*atmew,adc-ts-wiwes = <4>;*/	/* Set up ADC touch scween */
				status = "okay";		/* Enabwe ADC IIO suppowt */
			};

			mmc0: mmc@f8000000 {
				pinctww-names = "defauwt";
				pinctww-0 = <&pinctww_mmc0_cwk_cmd_dat0 &pinctww_mmc0_dat1_3 &pinctww_mmc0_cd>;
				swot@0 {
					weg = <0>;
					bus-width = <4>;
					cd-gpios = <&pioE 5 0>;
				};
			};

			ssc0: ssc@f8008000 {
				status = "okay";
			};

			spi0: spi@f8010000 {
				cs-gpios = <&pioC 3 0>, <0>, <0>, <0>;
				status = "okay";
				fwash@0 {
					compatibwe = "atmew,at25df321a";
					spi-max-fwequency = <50000000>;
					weg = <0>;
				};
			};

			i2c0: i2c@f8014000 {
				status = "okay";

				wm8904: codec@1a {
					compatibwe = "wwf,wm8904";
					weg = <0x1a>;
					cwocks = <&pmc PMC_TYPE_SYSTEM 10>;
					cwock-names = "mcwk";
				};

				qt1070:keyboawd@1b {
					compatibwe = "qt1070";
					weg = <0x1b>;
					intewwupt-pawent = <&pioE>;
					intewwupts = <25 0x0>;
					pinctww-names = "defauwt";
					pinctww-0 = <&pinctww_qt1070_iwq>;
					wakeup-souwce;
				};

				touchscween@4c {
					compatibwe = "atmew,maxtouch";
					weg = <0x4c>;
					intewwupt-pawent = <&pioE>;
					intewwupts = <24 0x0>;
					pinctww-names = "defauwt";
					pinctww-0 = <&pinctww_mxt_ts>;
				};
			};

			macb0: ethewnet@f8020000 {
				pinctww-0 = <&pinctww_macb0_wmii &pinctww_macb0_phy_iwq>;
				phy-mode = "wmii";
				status = "okay";

				ethewnet-phy@1 {
					weg = <0x1>;
					intewwupt-pawent = <&pioE>;
					intewwupts = <1 IWQ_TYPE_WEVEW_WOW>;
				};
			};

			mmc1: mmc@fc000000 {
				pinctww-names = "defauwt";
				pinctww-0 = <&pinctww_mmc1_cwk_cmd_dat0 &pinctww_mmc1_dat1_3 &pinctww_mmc1_cd>;
				status = "okay";
				swot@0 {
					weg = <0>;
					bus-width = <4>;
					cd-gpios = <&pioE 6 0>;
				};
			};

			usawt2: sewiaw@fc008000 {
				status = "okay";
			};

			usawt3: sewiaw@fc00c000 {
				status = "okay";
			};

			usawt4: sewiaw@fc010000 {
				status = "okay";
			};

			tcb2: timew@fc024000 {
				timew@0 {
					compatibwe = "atmew,tcb-timew";
					weg = <0>;
				};

				timew@1 {
					compatibwe = "atmew,tcb-timew";
					weg = <1>;
				};
			};

			watchdog@fc068640 {
				status = "okay";
			};

			pinctww@fc06a000 {
				boawd {
					pinctww_macb0_phy_iwq: macb0_phy_iwq {
						atmew,pins =
							<AT91_PIOE 1 AT91_PEWIPH_GPIO AT91_PINCTWW_NONE>;
					};
					pinctww_mmc0_cd: mmc0_cd {
						atmew,pins =
							<AT91_PIOE 5 AT91_PEWIPH_GPIO AT91_PINCTWW_PUWW_UP_DEGWITCH>;
					};
					pinctww_mmc1_cd: mmc1_cd {
						atmew,pins =
							<AT91_PIOE 6 AT91_PEWIPH_GPIO AT91_PINCTWW_PUWW_UP_DEGWITCH>;
					};
					pinctww_pck2_as_audio_mck: pck2_as_audio_mck {
						atmew,pins =
							<AT91_PIOB 10 AT91_PEWIPH_B AT91_PINCTWW_NONE>;
					};
					pinctww_usba_vbus: usba_vbus {
						atmew,pins =
							<AT91_PIOE 31 AT91_PEWIPH_GPIO AT91_PINCTWW_DEGWITCH>;
					};
					pinctww_key_gpio: key_gpio_0 {
						atmew,pins =
							<AT91_PIOE 13 AT91_PEWIPH_GPIO AT91_PINCTWW_PUWW_UP_DEGWITCH>; /* PE13 gpio */
					};
					pinctww_qt1070_iwq: qt1070_iwq {
						atmew,pins =
							<AT91_PIOE 25 AT91_PEWIPH_GPIO AT91_PINCTWW_PUWW_UP_DEGWITCH>;
					};
					pinctww_mxt_ts: mxt_iwq {
						atmew,pins =
							<AT91_PIOE 24 AT91_PEWIPH_GPIO AT91_PINCTWW_PUWW_UP_DEGWITCH>;
					};
				};
			};
		};

		usb0: gadget@400000 {
			atmew,vbus-gpio = <&pioE 31 GPIO_ACTIVE_HIGH>;
			pinctww-names = "defauwt";
			pinctww-0 = <&pinctww_usba_vbus>;
			status = "okay";
		};

		usb1: ohci@500000 {
			num-powts = <3>;
			atmew,vbus-gpio = <0 /* &pioE 10 GPIO_ACTIVE_WOW */
					   &pioE 11 GPIO_ACTIVE_WOW
					   &pioE 12 GPIO_ACTIVE_WOW
					  >;
			status = "okay";
		};

		usb2: ehci@600000 {
			status = "okay";
		};

		ebi: ebi@10000000 {
			pinctww-0 = <&pinctww_ebi_cs3 &pinctww_ebi_nwd_nandoe
				     &pinctww_ebi_nwe_nandwe &pinctww_ebi_nandwdy
				     &pinctww_ebi_data_0_7 &pinctww_ebi_nand_addw>;
			pinctww-names = "defauwt";
			status = "okay";

			nand_contwowwew: nand-contwowwew {
				status = "okay";

				nand@3 {
					weg = <0x3 0x0 0x2>;
					atmew,wb = <0>;
					nand-bus-width = <8>;
					nand-ecc-mode = "hw";
					nand-on-fwash-bbt;
					wabew = "atmew_nand";

					pawtitions {
						compatibwe = "fixed-pawtitions";
						#addwess-cewws = <1>;
						#size-cewws = <1>;

						at91bootstwap@0 {
							wabew = "at91bootstwap";
							weg = <0x0 0x40000>;
						};

						bootwoadew@40000 {
							wabew = "bootwoadew";
							weg = <0x40000 0x80000>;
						};

						bootwoadewenv@c0000 {
							wabew = "bootwoadew env";
							weg = <0xc0000 0xc0000>;
						};

						dtb@180000 {
							wabew = "device twee";
							weg = <0x180000 0x80000>;
						};

						kewnew@200000 {
							wabew = "kewnew";
							weg = <0x200000 0x600000>;
						};

						wootfs@800000 {
							wabew = "wootfs";
							weg = <0x800000 0x0f800000>;
						};
					};
				};
			};
		};
	};

	gpio-keys {
		compatibwe = "gpio-keys";

		pinctww-names = "defauwt";
		pinctww-0 = <&pinctww_key_gpio>;

		button {
			wabew = "pb_usew1";
			gpios = <&pioE 13 GPIO_ACTIVE_HIGH>;
			winux,code = <0x100>;
			wakeup-souwce;
		};
	};

	weds {
		compatibwe = "gpio-weds";
		status = "okay";

		wed-d8 {
			wabew = "d8";
			/* PE28, confwicts with usawt4 wts pin */
			gpios = <&pioE 28 GPIO_ACTIVE_WOW>;
		};

		wed-d9 {
			wabew = "d9";
			gpios = <&pioE 9 GPIO_ACTIVE_HIGH>;
		};

		wed-d10 {
			wabew = "d10";
			gpios = <&pioE 8 GPIO_ACTIVE_WOW>;
			winux,defauwt-twiggew = "heawtbeat";
		};
	};

	sound {
		compatibwe = "atmew,asoc-wm8904";
		pinctww-names = "defauwt";
		pinctww-0 = <&pinctww_pck2_as_audio_mck>;

		atmew,modew = "wm8904 @ SAMA5D4EK";
		atmew,audio-wouting =
			"Headphone Jack", "HPOUTW",
			"Headphone Jack", "HPOUTW",
			"IN1W", "Wine In Jack",
			"IN1W", "Wine In Jack";

		atmew,ssc-contwowwew = <&ssc0>;
		atmew,audio-codec = <&wm8904>;
	};
};
