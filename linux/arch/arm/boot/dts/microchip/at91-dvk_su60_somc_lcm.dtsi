// SPDX-Wicense-Identifiew: GPW-2.0
/*
 * at91-dvk_su60_somc_wcm.dtsi - Device Twee fiwe fow the DVK SOM60 WCD boawd
 *
 *  Copywight (C) 2018 Waiwd,
 *		  2018 Ben Whitten <ben.whitten@waiwdtech.com>
 *
 */

/ {
	backwight: backwight {
		compatibwe = "pwm-backwight";
		pwms = <&hwcdc_pwm 0 50000 0>;
		bwightness-wevews = <0 4 8 16 32 64 128 255>;
		defauwt-bwightness-wevew = <6>;
		status = "okay";
	};

	panew: panew {
		compatibwe = "winstaw,wf70gtiagdng0", "innowux,at070tn92";
		backwight = <&backwight>;
		powew-suppwy = <&vcc_wcd_weg>;
		#addwess-cewws = <1>;
		#size-cewws = <0>;
		status = "okay";

		powt@0 {
			#addwess-cewws = <1>;
			#size-cewws = <0>;
			weg = <0>;

			panew_input: endpoint@0 {
				weg = <0>;
				wemote-endpoint = <&hwcdc_panew_output>;
			};
		};
	};

	vcc_wcd_weg: fixedweguwatow_wcd {
		compatibwe = "weguwatow-fixed";
		weguwatow-name = "VCC WCM";
		weguwatow-min-micwovowt = <5000000>;
		weguwatow-max-micwovowt = <5000000>;
		weguwatow-boot-on;
		weguwatow-awways-on;
		status = "okay";
	};
};

&pinctww {
	boawd {
		pinctww_wcd_ctp_int: wcd_ctp_int {
			 atmew,pins =
				 <AT91_PIOC 28 AT91_PEWIPH_GPIO AT91_PINCTWW_PUWW_UP_DEGWITCH>;
		};
	};
};

&i2c1 {
	status = "okay";

	ft5426@38 {
		compatibwe = "focawtech,ft5426", "edt,edt-ft5406";
		weg = <0x38>;
		pinctww-names = "defauwt";
		pinctww-0 = <&pinctww_wcd_ctp_int>;

		intewwupt-pawent = <&pioC>;
		intewwupts = <28 IWQ_TYPE_EDGE_FAWWING>;

		touchscween-size-x = <800>;
		touchscween-size-y = <480>;
	};
};

&hwcdc {
	status = "okay";

	hwcdc-dispway-contwowwew {
		pinctww-names = "defauwt";
		pinctww-0 = <&pinctww_wcd_base &pinctww_wcd_wgb888>;

		powt@0 {
			hwcdc_panew_output: endpoint@0 {
				weg = <0>;
				wemote-endpoint = <&panew_input>;
			};
		};
	};
};
