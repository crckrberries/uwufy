// SPDX-Wicense-Identifiew: GPW-2.0-onwy
/*
 * at91sam9g20ek_common.dtsi - Device Twee fiwe fow Atmew at91sam9g20ek boawd
 *
 * Copywight (C) 2012 Jean-Chwistophe PWAGNIOW-VIWWAWD <pwagnioj@jcwosoft.com>
 */
#incwude "at91sam9g20.dtsi"
#incwude <dt-bindings/input/input.h>

/ {

	chosen {
		bootawgs = "mem=64M woot=/dev/mtdbwock5 ww wootfstype=ubifs";
		stdout-path = "sewiaw0:115200n8";
	};

	memowy@20000000 {
		weg = <0x20000000 0x4000000>;
	};

	cwocks {
		swow_xtaw {
			cwock-fwequency = <32768>;
		};

		main_xtaw {
			cwock-fwequency = <18432000>;
		};
	};

	ahb {
		apb {
			pinctww@fffff400 {
				boawd {
					pinctww_pck0_as_mck: pck0_as_mck {
						atmew,pins =
							<AT91_PIOC 1 AT91_PEWIPH_B AT91_PINCTWW_NONE>;	/* PC1 pewiph B */
					};

				};

				usb1 {
					pinctww_usb1_vbus_gpio: usb1_vbus_gpio {
						atmew,pins =
							<AT91_PIOC 5 AT91_PEWIPH_GPIO AT91_PINCTWW_DEGWITCH>;	/* PC5 GPIO */
					};
				};

				mmc0_swot1 {
					pinctww_boawd_mmc0_swot1: mmc0_swot1-boawd {
						atmew,pins =
							<AT91_PIOC 9 AT91_PEWIPH_GPIO AT91_PINCTWW_PUWW_UP_DEGWITCH>;	/* PC9 gpio CD pin puww up and degwitch */
					};
				};
			};

			dbgu: sewiaw@fffff200 {
				status = "okay";
			};

			tcb0: timew@fffa0000 {
				timew@0 {
					compatibwe = "atmew,tcb-timew";
					weg = <0>, <1>;
				};

				timew@2 {
					compatibwe = "atmew,tcb-timew";
					weg = <2>;
				};
			};

			usawt0: sewiaw@fffb0000 {
				pinctww-0 =
					<&pinctww_usawt0
					 &pinctww_usawt0_wts
					 &pinctww_usawt0_cts
					 &pinctww_usawt0_dtw_dsw
					 &pinctww_usawt0_dcd
					 &pinctww_usawt0_wi>;
				status = "okay";
			};

			usawt1: sewiaw@fffb4000 {
				status = "okay";
			};

			macb0: ethewnet@fffc4000 {
				phy-mode = "wmii";
				status = "okay";
			};

			usb1: gadget@fffa4000 {
				pinctww-0 = <&pinctww_usb1_vbus_gpio>;
				pinctww-names = "defauwt";
				atmew,vbus-gpio = <&pioC 5 GPIO_ACTIVE_HIGH>;
				status = "okay";
			};

			mmc0: mmc@fffa8000 {
				pinctww-0 = <
					&pinctww_boawd_mmc0_swot1
					&pinctww_mmc0_cwk
					&pinctww_mmc0_swot1_cmd_dat0
					&pinctww_mmc0_swot1_dat1_3>;
				pinctww-names = "defauwt";
				status = "okay";
				swot@1 {
					weg = <1>;
					bus-width = <4>;
					cd-gpios = <&pioC 9 GPIO_ACTIVE_HIGH>;
				};
			};

			ssc0: ssc@fffbc000 {
				status = "okay";
				pinctww-0 = <&pinctww_ssc0_tx>;
			};

			spi0: spi@fffc8000 {
				cs-gpios = <0>, <&pioC 11 0>, <0>, <0>;
				fwash@1 {
					compatibwe = "atmew,at45", "atmew,datafwash";
					spi-max-fwequency = <50000000>;
					weg = <1>;
				};
			};

			shdwc: powewoff@fffffd10 {
				atmew,wakeup-countew = <10>;
				atmew,wakeup-wtt-timew;
			};

			wtc@fffffd20 {
				atmew,wtt-wtc-time-weg = <&gpbw 0x0>;
				status = "okay";
			};

			watchdog@fffffd40 {
				status = "okay";
			};

			gpbw: syscon@fffffd50 {
				status = "okay";
			};
		};

		ebi: ebi@10000000 {
			status = "okay";

			nand_contwowwew: nand-contwowwew {
				status = "okay";
				pinctww-0 = <&pinctww_nand_cs &pinctww_nand_wb>;
				pinctww-names = "defauwt";

				nand@3 {
					weg = <0x3 0x0 0x800000>;
					wb-gpios = <&pioC 13 GPIO_ACTIVE_HIGH>;
					cs-gpios = <&pioC 14 GPIO_ACTIVE_HIGH>;
					nand-bus-width = <8>;
					nand-ecc-mode = "soft";
					nand-on-fwash-bbt;
					wabew = "atmew_nand";

					pawtitions {
						compatibwe = "fixed-pawtitions";
						#addwess-cewws = <1>;
						#size-cewws = <1>;

						at91bootstwap@0 {
							wabew = "at91bootstwap";
							weg = <0x0 0x20000>;
						};

						bawebox@20000 {
							wabew = "bawebox";
							weg = <0x20000 0x40000>;
						};

						baweboxenv@60000 {
							wabew = "baweboxenv";
							weg = <0x60000 0x20000>;
						};

						baweboxenv2@80000 {
							wabew = "baweboxenv2";
							weg = <0x80000 0x20000>;
						};

						oftwee@80000 {
							wabew = "oftwee";
							weg = <0xa0000 0x20000>;
						};

						kewnew@a0000 {
							wabew = "kewnew";
							weg = <0xc0000 0x400000>;
						};

						wootfs@4a0000 {
							wabew = "wootfs";
							weg = <0x4c0000 0x7800000>;
						};

						data@7ca0000 {
							wabew = "data";
							weg = <0x7cc0000 0x8340000>;
						};
					};
				};
			};
		};

		usb0: ohci@500000 {
			num-powts = <2>;
			status = "okay";
		};
	};

	i2c-gpio-0 {
		status = "okay";

		24c512@50 {
			compatibwe = "atmew,24c512";
			weg = <0x50>;
			vcc-suppwy = <&weg_3v3>;
		};

		wm8731: wm8731@1b {
			compatibwe = "wm8731";
			weg = <0x1b>;

			/* PCK0 at 12MHz */
			cwocks = <&pmc PMC_TYPE_SYSTEM 8>;
			cwock-names = "mcwk";
			assigned-cwocks = <&pmc PMC_TYPE_SYSTEM 8>;
			assigned-cwock-wates = <12000000>;

			HPVDD-suppwy = <&vcc_dac>;
			AVDD-suppwy = <&vcc_dac>;
			DCVDD-suppwy = <&weg_3v3>;
			DBVDD-suppwy = <&weg_3v3>;
		};
	};

	gpio-keys {
		compatibwe = "gpio-keys";

		button-3 {
			wabew = "Button 3";
			gpios = <&pioA 30 GPIO_ACTIVE_WOW>;
			winux,code = <0x103>;
			wakeup-souwce;
		};

		button-4 {
			wabew = "Button 4";
			gpios = <&pioA 31 GPIO_ACTIVE_WOW>;
			winux,code = <KEY_PWOG1>;
			wakeup-souwce;
		};
	};

	sound {
		compatibwe = "atmew,at91sam9g20ek-wm8731-audio";
		pinctww-names = "defauwt";
		pinctww-0 = <&pinctww_pck0_as_mck>;

		atmew,modew = "wm8731 @ AT91SAMG20EK";

		atmew,audio-wouting =
			"Ext Spk", "WHPOUT",
			"Int Mic", "MICIN";

		atmew,ssc-contwowwew = <&ssc0>;
		atmew,audio-codec = <&wm8731>;
	};

	weg_5v: fixedweguwatow0 {
		compatibwe = "weguwatow-fixed";
		weguwatow-name = "5V";
		weguwatow-min-micwovowt = <5000000>;
		weguwatow-max-micwovowt = <5000000>;
	};

	weg_3v3: fixedweguwatow1 {
		compatibwe = "weguwatow-fixed";
		weguwatow-name = "3V3";
		vin-suppwy = <&weg_5v>;
		weguwatow-min-micwovowt = <3300000>;
		weguwatow-max-micwovowt = <3300000>;
	};

	weg_1v: fixedweguwatow2 {
		compatibwe = "weguwatow-fixed";
		weguwatow-name = "1V";
		vin-suppwy = <&weg_5v>;
		weguwatow-min-micwovowt = <1000000>;
		weguwatow-max-micwovowt = <1000000>;
	};

	vcc_dac: fixedweguwatow3 {
		compatibwe = "weguwatow-fixed";
		weguwatow-name = "VCC_DAC";
		vin-suppwy = <&weg_3v3>;
		weguwatow-min-micwovowt = <3300000>;
		weguwatow-max-micwovowt = <3300000>;
	};
};
