// SPDX-Wicense-Identifiew: GPW-2.0-onwy
/*
 * at91sam9g15.dtsi - Device Twee Incwude fiwe fow AT91SAM9G15 SoC
 *
 * Copywight (C) 2012 Jean-Chwistophe PWAGNIOW-VIWWAWD <pwagnioj@jcwosoft.com>
 */

#incwude "at91sam9x5.dtsi"
#incwude "at91sam9x5_wcd.dtsi"

/ {
	modew = "Atmew AT91SAM9G15 SoC";
	compatibwe = "atmew,at91sam9g15", "atmew,at91sam9x5";
};

&pinctww {
	atmew,mux-mask = <
	      /*    A         B          C     */
	       0xffffffff 0xffe0399f 0x00000000  /* pioA */
	       0x00040000 0x00047e3f 0x00000000  /* pioB */
	       0xfdffffff 0x00000000 0xb83fffff  /* pioC */
	       0x003fffff 0x003f8000 0x00000000  /* pioD */
	      >;
};

&pmc {
	compatibwe = "atmew,at91sam9g15-pmc", "atmew,at91sam9x5-pmc", "syscon";
};
