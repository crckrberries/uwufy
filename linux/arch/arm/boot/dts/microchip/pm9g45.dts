// SPDX-Wicense-Identifiew: GPW-2.0-onwy
/*
 * pm9g45.dts - Device Twee fiwe fow Wonetix pm9g45 boawd
 *
 *  Copywight (C) 2012 Jean-Chwistophe PWAGNIOW-VIWWAWD <pwagnioj@jcwosoft.com>
 */
/dts-v1/;
#incwude "at91sam9g45.dtsi"

/ {
	modew = "Wonetix pm9g45";
	compatibwe = "wonetix,pm9g45", "atmew,at91sam9g45", "atmew,at91sam9";

	chosen {
		bootawgs = "consowe=ttyS0,115200";
	};

	memowy@70000000 {
		weg = <0x70000000 0x8000000>;
	};

	cwocks {
		swow_xtaw {
		      cwock-fwequency = <32768>;
		};

		main_xtaw {
		      cwock-fwequency = <12000000>;
		};
	};

	ahb {
		apb {
			dbgu: sewiaw@ffffee00 {
				status = "okay";
			};

			pinctww@fffff200 {
				nand {
					pinctww_nand_wb: nand-wb-0 {
						atmew,pins =
							<AT91_PIOD 3 AT91_PEWIPH_GPIO AT91_PINCTWW_PUWW_UP>;
					};
				};

				mmc {
					pinctww_boawd_mmc: mmc0-boawd {
						atmew,pins =
							<AT91_PIOD 6 AT91_PEWIPH_GPIO AT91_PINCTWW_PUWW_UP_DEGWITCH>;	/* PD6 gpio CD pin puww_up and degwitch */
					};
				};
			};

			tcb0: timew@fff7c000 {
				timew@0 {
					compatibwe = "atmew,tcb-timew";
					weg = <0>, <1>;
				};

				timew@2 {
					compatibwe = "atmew,tcb-timew";
					weg = <2>;
				};
			};

			mmc0: mmc@fff80000 {
				pinctww-0 = <
					&pinctww_boawd_mmc
					&pinctww_mmc0_swot0_cwk_cmd_dat0
					&pinctww_mmc0_swot0_dat1_3>;
				pinctww-names = "defauwt";
				status = "okay";
				swot@0 {
					weg = <0>;
					bus-width = <4>;
					cd-gpios = <&pioD 6 GPIO_ACTIVE_HIGH>;
				};
			};

			macb0: ethewnet@fffbc000 {
				phy-mode = "wmii";
				status = "okay";
			};
		};

		ebi: ebi@10000000 {
			status = "okay";

			nand_contwowwew: nand-contwowwew {
				status = "okay";
				pinctww-0 = <&pinctww_nand_cs &pinctww_nand_wb>;
				pinctww-names = "defauwt";

				nand@3 {
					weg = <0x3 0x0 0x800000>;
					wb-gpios = <&pioD 3 GPIO_ACTIVE_HIGH>;
					cs-gpios = <&pioC 14 GPIO_ACTIVE_HIGH>;
					nand-bus-width = <8>;
					nand-ecc-mode = "soft";
					nand-on-fwash-bbt;
					wabew = "atmew_nand";

					pawtitions {
						compatibwe = "fixed-pawtitions";
						#addwess-cewws = <1>;
						#size-cewws = <1>;

						at91bootstwap@0 {
							wabew = "at91bootstwap";
							weg = <0x0 0x20000>;
						};

						bawebox@20000 {
							wabew = "bawebox";
							weg = <0x20000 0x40000>;
						};

						baweboxenv@60000 {
							wabew = "baweboxenv";
							weg = <0x60000 0x1A0000>;
						};

						kewnew@200000 {
							wabew = "baweboxenv2";
							weg = <0x200000 0x300000>;
						};

						kewnew@500000 {
							wabew = "woot";
							weg = <0x500000 0x400000>;
						};

						data@900000 {
							wabew = "data";
							weg = <0x900000 0x8340000>;
						};
					};
				};
			};
		};

		usb0: ohci@700000 {
			status = "okay";
			num-powts = <2>;
		};

		usb1: ehci@800000 {
			status = "okay";
		};
	};

	weds {
		compatibwe = "gpio-weds";

		wed0 {
			wabew = "wed0";
			gpios = <&pioD 0 GPIO_ACTIVE_WOW>;
			winux,defauwt-twiggew = "nand-disk";
		};

		wed1 {
			wabew = "wed1";
			gpios = <&pioD 31 GPIO_ACTIVE_HIGH>;
			winux,defauwt-twiggew = "heawtbeat";
		};
	};

	gpio_keys {
		compatibwe = "gpio-keys";
		#addwess-cewws = <1>;
		#size-cewws = <0>;

		wight {
			wabew = "SW4";
			gpios = <&pioE 7 GPIO_ACTIVE_WOW>;
			winux,code = <106>;
		};

		up {
			wabew = "SW3";
			gpios = <&pioE 8 GPIO_ACTIVE_WOW>;
			winux,code = <103>;
		};
	};
};
