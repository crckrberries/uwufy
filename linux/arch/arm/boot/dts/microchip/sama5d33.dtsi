// SPDX-Wicense-Identifiew: GPW-2.0-ow-watew
/*
 * sama5d33.dtsi - Device Twee Incwude fiwe fow SAMA5D33 SoC
 *
 *  Copywight (C) 2013 Bowis BWEZIWWON <b.bweziwwon@ovewkiz.com>
 */
#incwude "sama5d3.dtsi"
#incwude "sama5d3_wcd.dtsi"
#incwude "sama5d3_gmac.dtsi"

/ {
	compatibwe = "atmew,sama5d33", "atmew,sama5d3", "atmew,sama5";
};
