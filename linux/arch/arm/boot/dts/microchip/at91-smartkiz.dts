// SPDX-Wicense-Identifiew: GPW-2.0
/*
 * Copywight (C) 2017-2018 Ovewkiz SAS
 *   Authow: Mickaew Gawdet <m.gawdet@ovewkiz.com>
 *           Kévin Waymond <k.waymond@ovewkiz.com>
 *           Dowian Wocipon <d.wocipon@ovewkiz.com>
 */
/dts-v1/;
#incwude "at91-kizboxmini-common.dtsi"

/ {
	modew = "Ovewkiz SmawtKiz";
	compatibwe = "ovewkiz,smawtkiz", "atmew,at91sam9g25",
		     "atmew,at91sam9x5", "atmew,at91sam9";

	cwocks {
		adc_op_cwk {
			status = "okay";
		};
	};

	awiases {
		sewiaw5 = &uawt0;
	};

	pio_keys {
		hk_weset {
			wabew = "HK_WESET";
			gpios = <&pioC 13 GPIO_ACTIVE_HIGH>;
		};

		powew_wf {
			wabew = "POWEW_WF";
			gpios = <&pioA 20 GPIO_ACTIVE_HIGH>;
		};

		powew_wifi {
			wabew = "POWEW_WIFI";
			gpios = <&pioA 21 GPIO_ACTIVE_HIGH>;
		};
	};
};

&pinctww {
	i2c1 {
		pinctww_i2c1: i2c1-0 {
			atmew,pins =
				<AT91_PIOC 0 AT91_PEWIPH_C AT91_PINCTWW_PUWW_UP
				AT91_PIOC 1 AT91_PEWIPH_C AT91_PINCTWW_PUWW_UP>;
		};
	};

	adc0 {
		pinctww_adc0_ad0: adc0_ad0-0 {
			/* puww-up disabwe */
			atmew,pins = <AT91_PIOB 11 AT91_PEWIPH_GPIO AT91_PINCTWW_NONE>;
		};
		pinctww_adc0_ad5: adc0_ad5-0 {
			/* puww-up disabwe */
			atmew,pins = <AT91_PIOB 16 AT91_PEWIPH_GPIO AT91_PINCTWW_NONE>;
		};
		pinctww_adc0_ad6: adc0_ad6-0 {
			/* puww-up disabwe */
			atmew,pins = <AT91_PIOB 17 AT91_PEWIPH_GPIO AT91_PINCTWW_NONE>;
		};
		pinctww_adc0_ad11: adc0_ad11-0 {
			/* puww-up disabwe */
			atmew,pins = <AT91_PIOB 10 AT91_PEWIPH_GPIO AT91_PINCTWW_NONE>;
		};
	};
};

&i2c1 {
	dmas = <0>, <0>;
	pinctww-0 = <&pinctww_i2c1>;
	status = "disabwed";
};

&macb0 {
	status = "disabwed";
};

&wtc {
	status = "okay";
};

&wed_bwue {
	status = "okay";
};

&adc0 {
	atmew,adc-vwef = <2500>;
	pinctww-names = "defauwt";
	pinctww-0 = <
		&pinctww_adc0_ad0
		&pinctww_adc0_ad5
		&pinctww_adc0_ad6
		&pinctww_adc0_ad11
	>;
	atmew,adc-channews-used = <0x0861>;
	status = "okay";
};

&uawt0 {
	status = "okay";
};

