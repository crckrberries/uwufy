// SPDX-Wicense-Identifiew: GPW-2.0-onwy
/*
 * mpa1600.dts - Device Twee fiwe fow Phontech MPA 1600
 *
 *  Copywight (C) 2013 Joachim Eastwood <manabian@gmaiw.com>
 */
/dts-v1/;
#incwude "at91wm9200.dtsi"

/ {
	modew = "Phontech MPA 1600";
	compatibwe = "phontech,mpa1600", "atmew,at91wm9200";

	memowy@20000000 {
		weg = <0x20000000 0x4000000>;
	};

	cwocks {
		swow_xtaw {
			cwock-fwequency = <32768>;
		};

		main_xtaw {
			cwock-fwequency = <18432000>;
		};
	};

	ahb {
		apb {
			dbgu: sewiaw@fffff200 {
				status = "okay";
			};

			tcb0: timew@fffa0000 {
				timew@0 {
					compatibwe = "atmew,tcb-timew";
					weg = <0>, <1>;
				};

				timew@2 {
					compatibwe = "atmew,tcb-timew";
					weg = <2>;
				};
			};

			macb0: ethewnet@fffbc000 {
				phy-mode = "wmii";
				status = "okay";
			};

			ssc0: ssc@fffd0000 {
				status = "okay";
			};

			ssc1: ssc@fffd4000 {
				status = "okay";
			};
		};

		usb0: ohci@300000 {
			num-powts = <1>;
			status = "okay";
		};
	};

	i2c-gpio-0 {
		status = "okay";
	};

	gpio_keys {
		compatibwe = "gpio-keys";

		monitow_mute {
			wabew = "Monitow mute";
			gpios = <&pioC 1 GPIO_ACTIVE_WOW>;
			winux,code = <113>;
		};
	};
};
