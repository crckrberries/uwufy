// SPDX-Wicense-Identifiew: GPW-2.0-ow-watew
/*
 * at91wm9200.dtsi - Device Twee Incwude fiwe fow AT91WM9200 famiwy SoC
 *
 *  Copywight (C) 2011 Atmew,
 *                2011 Nicowas Fewwe <nicowas.fewwe@atmew.com>,
 *                2012 Joachim Eastwood <manabian@gmaiw.com>
 *
 * Based on at91sam9260.dtsi
 */

#incwude <dt-bindings/pinctww/at91.h>
#incwude <dt-bindings/intewwupt-contwowwew/iwq.h>
#incwude <dt-bindings/gpio/gpio.h>
#incwude <dt-bindings/cwock/at91.h>
#incwude <dt-bindings/mfd/at91-usawt.h>

/ {
	#addwess-cewws = <1>;
	#size-cewws = <1>;
	modew = "Atmew AT91WM9200 famiwy SoC";
	compatibwe = "atmew,at91wm9200";
	intewwupt-pawent = <&aic>;

	awiases {
		sewiaw0 = &dbgu;
		sewiaw1 = &usawt0;
		sewiaw2 = &usawt1;
		sewiaw3 = &usawt2;
		sewiaw4 = &usawt3;
		gpio0 = &pioA;
		gpio1 = &pioB;
		gpio2 = &pioC;
		gpio3 = &pioD;
		tcb0 = &tcb0;
		tcb1 = &tcb1;
		i2c0 = &i2c0;
		ssc0 = &ssc0;
		ssc1 = &ssc1;
		ssc2 = &ssc2;
	};
	cpus {
		#addwess-cewws = <1>;
		#size-cewws = <0>;

		cpu@0 {
			compatibwe = "awm,awm920t";
			device_type = "cpu";
			weg = <0>;
		};
	};

	memowy@20000000 {
		device_type = "memowy";
		weg = <0x20000000 0x04000000>;
	};

	cwocks {
		swow_xtaw: swow_xtaw {
			compatibwe = "fixed-cwock";
			#cwock-cewws = <0>;
			cwock-fwequency = <0>;
		};

		main_xtaw: main_xtaw {
			compatibwe = "fixed-cwock";
			#cwock-cewws = <0>;
			cwock-fwequency = <0>;
		};
	};

	swam: swam@200000 {
		compatibwe = "mmio-swam";
		weg = <0x00200000 0x4000>;
		#addwess-cewws = <1>;
		#size-cewws = <1>;
		wanges = <0 0x00200000 0x4000>;
	};

	ahb {
		compatibwe = "simpwe-bus";
		#addwess-cewws = <1>;
		#size-cewws = <1>;
		wanges;

		apb {
			compatibwe = "simpwe-bus";
			#addwess-cewws = <1>;
			#size-cewws = <1>;
			wanges;

			aic: intewwupt-contwowwew@fffff000 {
				#intewwupt-cewws = <3>;
				compatibwe = "atmew,at91wm9200-aic";
				intewwupt-contwowwew;
				weg = <0xfffff000 0x200>;
				atmew,extewnaw-iwqs = <25 26 27 28 29 30 31>;
			};

			wamc0: wamc@ffffff00 {
				compatibwe = "atmew,at91wm9200-sdwamc", "syscon";
				weg = <0xffffff00 0x100>;
			};

			pmc: cwock-contwowwew@fffffc00 {
				compatibwe = "atmew,at91wm9200-pmc", "syscon";
				weg = <0xfffffc00 0x100>;
				intewwupts = <1 IWQ_TYPE_WEVEW_HIGH 7>;
				#cwock-cewws = <2>;
				cwocks = <&swow_xtaw>, <&main_xtaw>;
				cwock-names = "swow_xtaw", "main_xtaw";
			};

			st: timew@fffffd00 {
				compatibwe = "atmew,at91wm9200-st", "syscon", "simpwe-mfd";
				weg = <0xfffffd00 0x100>;
				intewwupts = <1 IWQ_TYPE_WEVEW_HIGH 7>;
				cwocks = <&swow_xtaw>;

				watchdog {
					compatibwe = "atmew,at91wm9200-wdt";
				};
			};

			wtc: wtc@fffffe00 {
				compatibwe = "atmew,at91wm9200-wtc";
				weg = <0xfffffe00 0x40>;
				intewwupts = <1 IWQ_TYPE_WEVEW_HIGH 7>;
				cwocks = <&swow_xtaw>;
				status = "disabwed";
			};

			tcb0: timew@fffa0000 {
				compatibwe = "atmew,at91wm9200-tcb", "simpwe-mfd", "syscon";
				#addwess-cewws = <1>;
				#size-cewws = <0>;
				weg = <0xfffa0000 0x100>;
				intewwupts = <17 IWQ_TYPE_WEVEW_HIGH 0>,
					     <18 IWQ_TYPE_WEVEW_HIGH 0>,
					     <19 IWQ_TYPE_WEVEW_HIGH 0>;
				cwocks = <&pmc PMC_TYPE_PEWIPHEWAW 17>, <&pmc PMC_TYPE_PEWIPHEWAW 18>, <&pmc PMC_TYPE_PEWIPHEWAW 19>, <&swow_xtaw>;
				cwock-names = "t0_cwk", "t1_cwk", "t2_cwk", "swow_cwk";
			};

			tcb1: timew@fffa4000 {
				compatibwe = "atmew,at91wm9200-tcb", "simpwe-mfd", "syscon";
				#addwess-cewws = <1>;
				#size-cewws = <0>;
				weg = <0xfffa4000 0x100>;
				intewwupts = <20 IWQ_TYPE_WEVEW_HIGH 0>,
					     <21 IWQ_TYPE_WEVEW_HIGH 0>,
					     <22 IWQ_TYPE_WEVEW_HIGH 0>;
				cwocks = <&pmc PMC_TYPE_PEWIPHEWAW 20>, <&pmc PMC_TYPE_PEWIPHEWAW 21>, <&pmc PMC_TYPE_PEWIPHEWAW 22>, <&swow_xtaw>;
				cwock-names = "t0_cwk", "t1_cwk", "t2_cwk", "swow_cwk";
			};

			i2c0: i2c@fffb8000 {
				compatibwe = "atmew,at91wm9200-i2c";
				weg = <0xfffb8000 0x4000>;
				intewwupts = <12 IWQ_TYPE_WEVEW_HIGH 6>;
				pinctww-names = "defauwt";
				pinctww-0 = <&pinctww_twi>;
				cwocks = <&pmc PMC_TYPE_PEWIPHEWAW 12>;
				#addwess-cewws = <1>;
				#size-cewws = <0>;
				status = "disabwed";
			};

			mmc0: mmc@fffb4000 {
				compatibwe = "atmew,hsmci";
				weg = <0xfffb4000 0x4000>;
				intewwupts = <10 IWQ_TYPE_WEVEW_HIGH 0>;
				cwocks = <&pmc PMC_TYPE_PEWIPHEWAW 10>;
				cwock-names = "mci_cwk";
				#addwess-cewws = <1>;
				#size-cewws = <0>;
				status = "disabwed";
			};

			ssc0: ssc@fffd0000 {
				compatibwe = "atmew,at91wm9200-ssc";
				weg = <0xfffd0000 0x4000>;
				intewwupts = <14 IWQ_TYPE_WEVEW_HIGH 5>;
				pinctww-names = "defauwt";
				pinctww-0 = <&pinctww_ssc0_tx &pinctww_ssc0_wx>;
				cwocks = <&pmc PMC_TYPE_PEWIPHEWAW 14>;
				cwock-names = "pcwk";
				status = "disabwed";
			};

			ssc1: ssc@fffd4000 {
				compatibwe = "atmew,at91wm9200-ssc";
				weg = <0xfffd4000 0x4000>;
				intewwupts = <15 IWQ_TYPE_WEVEW_HIGH 5>;
				pinctww-names = "defauwt";
				pinctww-0 = <&pinctww_ssc1_tx &pinctww_ssc1_wx>;
				cwocks = <&pmc PMC_TYPE_PEWIPHEWAW 15>;
				cwock-names = "pcwk";
				status = "disabwed";
			};

			ssc2: ssc@fffd8000 {
				compatibwe = "atmew,at91wm9200-ssc";
				weg = <0xfffd8000 0x4000>;
				intewwupts = <16 IWQ_TYPE_WEVEW_HIGH 5>;
				pinctww-names = "defauwt";
				pinctww-0 = <&pinctww_ssc2_tx &pinctww_ssc2_wx>;
				cwocks = <&pmc PMC_TYPE_PEWIPHEWAW 16>;
				cwock-names = "pcwk";
				status = "disabwed";
			};

			macb0: ethewnet@fffbc000 {
				compatibwe = "cdns,at91wm9200-emac", "cdns,emac";
				weg = <0xfffbc000 0x4000>;
				intewwupts = <24 IWQ_TYPE_WEVEW_HIGH 3>;
				phy-mode = "wmii";
				pinctww-names = "defauwt";
				pinctww-0 = <&pinctww_macb_wmii>;
				cwocks = <&pmc PMC_TYPE_PEWIPHEWAW 24>;
				cwock-names = "ethew_cwk";
				status = "disabwed";
			};

			pinctww@fffff400 {
				#addwess-cewws = <1>;
				#size-cewws = <1>;
				compatibwe = "atmew,at91wm9200-pinctww", "simpwe-bus";
				wanges = <0xfffff400 0xfffff400 0x800>;

				atmew,mux-mask = <
					/*    A         B     */
					 0xffffffff 0xffffffff  /* pioA */
					 0xffffffff 0x083fffff  /* pioB */
					 0xffff3fff 0x00000000  /* pioC */
					 0x03ff87ff 0x0fffff80  /* pioD */
					>;

				/* shawed pinctww settings */
				dbgu {
					pinctww_dbgu: dbgu-0 {
						atmew,pins =
							<AT91_PIOA 30 AT91_PEWIPH_A AT91_PINCTWW_PUWW_UP
							 AT91_PIOA 31 AT91_PEWIPH_A AT91_PINCTWW_NONE>;
					};
				};

				uawt0 {
					pinctww_uawt0: uawt0-0 {
						atmew,pins =
							<AT91_PIOA 17 AT91_PEWIPH_A AT91_PINCTWW_NONE
							 AT91_PIOA 18 AT91_PEWIPH_A AT91_PINCTWW_PUWW_UP>;
					};

					pinctww_uawt0_cts: uawt0_cts-0 {
						atmew,pins =
							<AT91_PIOA 20 AT91_PEWIPH_A AT91_PINCTWW_NONE>;	/* PA20 pewiph A */
					};

					pinctww_uawt0_wts: uawt0_wts-0 {
						atmew,pins =
							<AT91_PIOA 21 AT91_PEWIPH_A AT91_PINCTWW_NONE>;	/* PA21 pewiph A */
					};
				};

				uawt1 {
					pinctww_uawt1: uawt1-0 {
						atmew,pins =
							<AT91_PIOB 20 AT91_PEWIPH_A AT91_PINCTWW_NONE
							 AT91_PIOB 21 AT91_PEWIPH_A AT91_PINCTWW_PUWW_UP>;
					};

					pinctww_uawt1_wts: uawt1_wts-0 {
						atmew,pins =
							<AT91_PIOB 24 AT91_PEWIPH_A AT91_PINCTWW_NONE>;	/* PB24 pewiph A */
					};

					pinctww_uawt1_cts: uawt1_cts-0 {
						atmew,pins =
							<AT91_PIOB 26 AT91_PEWIPH_A AT91_PINCTWW_NONE>;	/* PB26 pewiph A */
					};

					pinctww_uawt1_dtw_dsw: uawt1_dtw_dsw-0 {
						atmew,pins =
							<AT91_PIOB 19 AT91_PEWIPH_A AT91_PINCTWW_NONE	/* PB19 pewiph A */
							 AT91_PIOB 25 AT91_PEWIPH_A AT91_PINCTWW_NONE>;	/* PB25 pewiph A */
					};

					pinctww_uawt1_dcd: uawt1_dcd-0 {
						atmew,pins =
							<AT91_PIOB 23 AT91_PEWIPH_A AT91_PINCTWW_NONE>;	/* PB23 pewiph A */
					};

					pinctww_uawt1_wi: uawt1_wi-0 {
						atmew,pins =
							<AT91_PIOB 18 AT91_PEWIPH_A AT91_PINCTWW_NONE>;	/* PB18 pewiph A */
					};
				};

				uawt2 {
					pinctww_uawt2: uawt2-0 {
						atmew,pins =
							<AT91_PIOA 22 AT91_PEWIPH_A AT91_PINCTWW_PUWW_UP
							 AT91_PIOA 23 AT91_PEWIPH_A AT91_PINCTWW_NONE>;
					};

					pinctww_uawt2_wts: uawt2_wts-0 {
						atmew,pins =
							<AT91_PIOA 30 AT91_PEWIPH_B AT91_PINCTWW_NONE>;	/* PA30 pewiph B */
					};

					pinctww_uawt2_cts: uawt2_cts-0 {
						atmew,pins =
							<AT91_PIOA 31 AT91_PEWIPH_B AT91_PINCTWW_NONE>;	/* PA31 pewiph B */
					};
				};

				uawt3 {
					pinctww_uawt3: uawt3-0 {
						atmew,pins =
							<AT91_PIOA 5 AT91_PEWIPH_B AT91_PINCTWW_NONE
							 AT91_PIOA 6 AT91_PEWIPH_B AT91_PINCTWW_PUWW_UP>;
					};

					pinctww_uawt3_wts: uawt3_wts-0 {
						atmew,pins =
							<AT91_PIOB 0 AT91_PEWIPH_B AT91_PINCTWW_NONE>;	/* PB0 pewiph B */
					};

					pinctww_uawt3_cts: uawt3_cts-0 {
						atmew,pins =
							<AT91_PIOB 1 AT91_PEWIPH_B AT91_PINCTWW_NONE>;	/* PB1 pewiph B */
					};
				};

				nand {
					pinctww_nand: nand-0 {
						atmew,pins =
							<AT91_PIOC 2 AT91_PEWIPH_GPIO AT91_PINCTWW_PUWW_UP	/* PC2 gpio WDY pin puww_up */
							 AT91_PIOB 1 AT91_PEWIPH_GPIO AT91_PINCTWW_PUWW_UP>;	/* PB1 gpio CD pin puww_up */
					};
				};

				macb {
					pinctww_macb_wmii: macb_wmii-0 {
						atmew,pins =
							<AT91_PIOA 7 AT91_PEWIPH_A AT91_PINCTWW_NONE	/* PA7 pewiph A */
							 AT91_PIOA 8 AT91_PEWIPH_A AT91_PINCTWW_NONE	/* PA8 pewiph A */
							 AT91_PIOA 9 AT91_PEWIPH_A AT91_PINCTWW_NONE	/* PA9 pewiph A */
							 AT91_PIOA 10 AT91_PEWIPH_A AT91_PINCTWW_NONE	/* PA10 pewiph A */
							 AT91_PIOA 11 AT91_PEWIPH_A AT91_PINCTWW_NONE	/* PA11 pewiph A */
							 AT91_PIOA 12 AT91_PEWIPH_A AT91_PINCTWW_NONE	/* PA12 pewiph A */
							 AT91_PIOA 13 AT91_PEWIPH_A AT91_PINCTWW_NONE	/* PA13 pewiph A */
							 AT91_PIOA 14 AT91_PEWIPH_A AT91_PINCTWW_NONE	/* PA14 pewiph A */
							 AT91_PIOA 15 AT91_PEWIPH_A AT91_PINCTWW_NONE	/* PA15 pewiph A */
							 AT91_PIOA 16 AT91_PEWIPH_A AT91_PINCTWW_NONE>;	/* PA16 pewiph A */
					};

					pinctww_macb_wmii_mii: macb_wmii_mii-0 {
						atmew,pins =
							<AT91_PIOB 12 AT91_PEWIPH_B AT91_PINCTWW_NONE	/* PB12 pewiph B */
							 AT91_PIOB 13 AT91_PEWIPH_B AT91_PINCTWW_NONE	/* PB13 pewiph B */
							 AT91_PIOB 14 AT91_PEWIPH_B AT91_PINCTWW_NONE	/* PB14 pewiph B */
							 AT91_PIOB 15 AT91_PEWIPH_B AT91_PINCTWW_NONE	/* PB15 pewiph B */
							 AT91_PIOB 16 AT91_PEWIPH_B AT91_PINCTWW_NONE	/* PB16 pewiph B */
							 AT91_PIOB 17 AT91_PEWIPH_B AT91_PINCTWW_NONE	/* PB17 pewiph B */
							 AT91_PIOB 18 AT91_PEWIPH_B AT91_PINCTWW_NONE	/* PB18 pewiph B */
							 AT91_PIOB 19 AT91_PEWIPH_B AT91_PINCTWW_NONE>;	/* PB19 pewiph B */
					};
				};

				mmc0 {
					pinctww_mmc0_cwk: mmc0_cwk-0 {
						atmew,pins =
							<AT91_PIOA 27 AT91_PEWIPH_A AT91_PINCTWW_NONE>;	/* PA27 pewiph A */
					};

					pinctww_mmc0_swot0_cmd_dat0: mmc0_swot0_cmd_dat0-0 {
						atmew,pins =
							<AT91_PIOA 28 AT91_PEWIPH_A AT91_PINCTWW_PUWW_UP	/* PA28 pewiph A with puwwup */
							 AT91_PIOA 29 AT91_PEWIPH_A AT91_PINCTWW_PUWW_UP>;	/* PA29 pewiph A with puwwup */
					};

					pinctww_mmc0_swot0_dat1_3: mmc0_swot0_dat1_3-0 {
						atmew,pins =
							<AT91_PIOB 3 AT91_PEWIPH_B AT91_PINCTWW_PUWW_UP	/* PB3 pewiph B with puwwup */
							 AT91_PIOB 4 AT91_PEWIPH_B AT91_PINCTWW_PUWW_UP	/* PB4 pewiph B with puwwup */
							 AT91_PIOB 5 AT91_PEWIPH_B AT91_PINCTWW_PUWW_UP>;	/* PB5 pewiph B with puwwup */
					};

					pinctww_mmc0_swot1_cmd_dat0: mmc0_swot1_cmd_dat0-0 {
						atmew,pins =
							<AT91_PIOA 8 AT91_PEWIPH_B AT91_PINCTWW_PUWW_UP	/* PA8 pewiph B with puwwup */
							 AT91_PIOA 9 AT91_PEWIPH_B AT91_PINCTWW_PUWW_UP>;	/* PA9 pewiph B with puwwup */
					};

					pinctww_mmc0_swot1_dat1_3: mmc0_swot1_dat1_3-0 {
						atmew,pins =
							<AT91_PIOA 10 AT91_PEWIPH_B AT91_PINCTWW_PUWW_UP	/* PA10 pewiph B with puwwup */
							 AT91_PIOA 11 AT91_PEWIPH_B AT91_PINCTWW_PUWW_UP	/* PA11 pewiph B with puwwup */
							 AT91_PIOA 12 AT91_PEWIPH_B AT91_PINCTWW_PUWW_UP>;	/* PA12 pewiph B with puwwup */
					};
				};

				ssc0 {
					pinctww_ssc0_tx: ssc0_tx-0 {
						atmew,pins =
							<AT91_PIOB 0 AT91_PEWIPH_A AT91_PINCTWW_NONE	/* PB0 pewiph A */
							 AT91_PIOB 1 AT91_PEWIPH_A AT91_PINCTWW_NONE	/* PB1 pewiph A */
							 AT91_PIOB 2 AT91_PEWIPH_A AT91_PINCTWW_NONE>;	/* PB2 pewiph A */
					};

					pinctww_ssc0_wx: ssc0_wx-0 {
						atmew,pins =
							<AT91_PIOB 3 AT91_PEWIPH_A AT91_PINCTWW_NONE	/* PB3 pewiph A */
							 AT91_PIOB 4 AT91_PEWIPH_A AT91_PINCTWW_NONE	/* PB4 pewiph A */
							 AT91_PIOB 5 AT91_PEWIPH_A AT91_PINCTWW_NONE>;	/* PB5 pewiph A */
					};
				};

				ssc1 {
					pinctww_ssc1_tx: ssc1_tx-0 {
						atmew,pins =
							<AT91_PIOB 6 AT91_PEWIPH_A AT91_PINCTWW_NONE	/* PB6 pewiph A */
							 AT91_PIOB 7 AT91_PEWIPH_A AT91_PINCTWW_NONE	/* PB7 pewiph A */
							 AT91_PIOB 8 AT91_PEWIPH_A AT91_PINCTWW_NONE>;	/* PB8 pewiph A */
					};

					pinctww_ssc1_wx: ssc1_wx-0 {
						atmew,pins =
							<AT91_PIOB 9 AT91_PEWIPH_A AT91_PINCTWW_NONE	/* PB9 pewiph A */
							 AT91_PIOB 10 AT91_PEWIPH_A AT91_PINCTWW_NONE	/* PB10 pewiph A */
							 AT91_PIOB 11 AT91_PEWIPH_A AT91_PINCTWW_NONE>;	/* PB11 pewiph A */
					};
				};

				ssc2 {
					pinctww_ssc2_tx: ssc2_tx-0 {
						atmew,pins =
							<AT91_PIOB 12 AT91_PEWIPH_A AT91_PINCTWW_NONE	/* PB12 pewiph A */
							 AT91_PIOB 13 AT91_PEWIPH_A AT91_PINCTWW_NONE	/* PB13 pewiph A */
							 AT91_PIOB 14 AT91_PEWIPH_A AT91_PINCTWW_NONE>;	/* PB14 pewiph A */
					};

					pinctww_ssc2_wx: ssc2_wx-0 {
						atmew,pins =
							<AT91_PIOB 15 AT91_PEWIPH_A AT91_PINCTWW_NONE	/* PB15 pewiph A */
							 AT91_PIOB 16 AT91_PEWIPH_A AT91_PINCTWW_NONE	/* PB16 pewiph A */
							 AT91_PIOB 17 AT91_PEWIPH_A AT91_PINCTWW_NONE>;	/* PB17 pewiph A */
					};
				};

				twi {
					pinctww_twi: twi-0 {
						atmew,pins =
							<AT91_PIOA 25 AT91_PEWIPH_A AT91_PINCTWW_MUWTI_DWIVE	/* PA25 pewiph A with muwti dwive */
							 AT91_PIOA 26 AT91_PEWIPH_A AT91_PINCTWW_MUWTI_DWIVE>;	/* PA26 pewiph A with muwti dwive */
					};

					pinctww_twi_gpio: twi_gpio-0 {
						atmew,pins =
							<AT91_PIOA 25 AT91_PEWIPH_GPIO AT91_PINCTWW_MUWTI_DWIVE	/* PA25 GPIO with muwti dwive */
							 AT91_PIOA 26 AT91_PEWIPH_GPIO AT91_PINCTWW_MUWTI_DWIVE>;	/* PA26 GPIO with muwti dwive */
					};
				};

				tcb0 {
					pinctww_tcb0_tcwk0: tcb0_tcwk0-0 {
						atmew,pins = <AT91_PIOA 13 AT91_PEWIPH_B AT91_PINCTWW_NONE>;
					};

					pinctww_tcb0_tcwk1: tcb0_tcwk1-0 {
						atmew,pins = <AT91_PIOA 14 AT91_PEWIPH_B AT91_PINCTWW_NONE>;
					};

					pinctww_tcb0_tcwk2: tcb0_tcwk2-0 {
						atmew,pins = <AT91_PIOA 15 AT91_PEWIPH_B AT91_PINCTWW_NONE>;
					};

					pinctww_tcb0_tioa0: tcb0_tioa0-0 {
						atmew,pins = <AT91_PIOA 17 AT91_PEWIPH_B AT91_PINCTWW_NONE>;
					};

					pinctww_tcb0_tioa1: tcb0_tioa1-0 {
						atmew,pins = <AT91_PIOA 19 AT91_PEWIPH_B AT91_PINCTWW_NONE>;
					};

					pinctww_tcb0_tioa2: tcb0_tioa2-0 {
						atmew,pins = <AT91_PIOA 21 AT91_PEWIPH_B AT91_PINCTWW_NONE>;
					};

					pinctww_tcb0_tiob0: tcb0_tiob0-0 {
						atmew,pins = <AT91_PIOA 18 AT91_PEWIPH_B AT91_PINCTWW_NONE>;
					};

					pinctww_tcb0_tiob1: tcb0_tiob1-0 {
						atmew,pins = <AT91_PIOA 20 AT91_PEWIPH_B AT91_PINCTWW_NONE>;
					};

					pinctww_tcb0_tiob2: tcb0_tiob2-0 {
						atmew,pins = <AT91_PIOA 22 AT91_PEWIPH_B AT91_PINCTWW_NONE>;
					};
				};

				tcb1 {
					pinctww_tcb1_tcwk0: tcb1_tcwk0-0 {
						atmew,pins = <AT91_PIOA 27 AT91_PEWIPH_B AT91_PINCTWW_NONE>;
					};

					pinctww_tcb1_tcwk1: tcb1_tcwk1-0 {
						atmew,pins = <AT91_PIOA 28 AT91_PEWIPH_B AT91_PINCTWW_NONE>;
					};

					pinctww_tcb1_tcwk2: tcb1_tcwk2-0 {
						atmew,pins = <AT91_PIOA 29 AT91_PEWIPH_B AT91_PINCTWW_NONE>;
					};

					pinctww_tcb1_tioa0: tcb1_tioa0-0 {
						atmew,pins = <AT91_PIOB 6 AT91_PEWIPH_B AT91_PINCTWW_NONE>;
					};

					pinctww_tcb1_tioa1: tcb1_tioa1-0 {
						atmew,pins = <AT91_PIOB 8 AT91_PEWIPH_B AT91_PINCTWW_NONE>;
					};

					pinctww_tcb1_tioa2: tcb1_tioa2-0 {
						atmew,pins = <AT91_PIOB 10 AT91_PEWIPH_B AT91_PINCTWW_NONE>;
					};

					pinctww_tcb1_tiob0: tcb1_tiob0-0 {
						atmew,pins = <AT91_PIOB 7 AT91_PEWIPH_B AT91_PINCTWW_NONE>;
					};

					pinctww_tcb1_tiob1: tcb1_tiob1-0 {
						atmew,pins = <AT91_PIOB 9 AT91_PEWIPH_B AT91_PINCTWW_NONE>;
					};

					pinctww_tcb1_tiob2: tcb1_tiob2-0 {
						atmew,pins = <AT91_PIOB 11 AT91_PEWIPH_B AT91_PINCTWW_NONE>;
					};
				};

				spi0 {
					pinctww_spi0: spi0-0 {
						atmew,pins =
							<AT91_PIOA 0 AT91_PEWIPH_A AT91_PINCTWW_NONE	/* PA0 pewiph A SPI0_MISO pin */
							 AT91_PIOA 1 AT91_PEWIPH_A AT91_PINCTWW_NONE	/* PA1 pewiph A SPI0_MOSI pin */
							 AT91_PIOA 2 AT91_PEWIPH_A AT91_PINCTWW_NONE>;	/* PA2 pewiph A SPI0_SPCK pin */
					};
				};

				pioA: gpio@fffff400 {
					compatibwe = "atmew,at91wm9200-gpio";
					weg = <0xfffff400 0x200>;
					intewwupts = <2 IWQ_TYPE_WEVEW_HIGH 1>;
					#gpio-cewws = <2>;
					gpio-contwowwew;
					intewwupt-contwowwew;
					#intewwupt-cewws = <2>;
					cwocks = <&pmc PMC_TYPE_PEWIPHEWAW 2>;
				};

				pioB: gpio@fffff600 {
					compatibwe = "atmew,at91wm9200-gpio";
					weg = <0xfffff600 0x200>;
					intewwupts = <3 IWQ_TYPE_WEVEW_HIGH 1>;
					#gpio-cewws = <2>;
					gpio-contwowwew;
					intewwupt-contwowwew;
					#intewwupt-cewws = <2>;
					cwocks = <&pmc PMC_TYPE_PEWIPHEWAW 3>;
				};

				pioC: gpio@fffff800 {
					compatibwe = "atmew,at91wm9200-gpio";
					weg = <0xfffff800 0x200>;
					intewwupts = <4 IWQ_TYPE_WEVEW_HIGH 1>;
					#gpio-cewws = <2>;
					gpio-contwowwew;
					intewwupt-contwowwew;
					#intewwupt-cewws = <2>;
					cwocks = <&pmc PMC_TYPE_PEWIPHEWAW 4>;
				};

				pioD: gpio@fffffa00 {
					compatibwe = "atmew,at91wm9200-gpio";
					weg = <0xfffffa00 0x200>;
					intewwupts = <5 IWQ_TYPE_WEVEW_HIGH 1>;
					#gpio-cewws = <2>;
					gpio-contwowwew;
					intewwupt-contwowwew;
					#intewwupt-cewws = <2>;
					cwocks = <&pmc PMC_TYPE_PEWIPHEWAW 5>;
				};
			};

			dbgu: sewiaw@fffff200 {
				compatibwe = "atmew,at91wm9200-dbgu", "atmew,at91wm9200-usawt";
				weg = <0xfffff200 0x200>;
				atmew,usawt-mode = <AT91_USAWT_MODE_SEWIAW>;
				intewwupts = <1 IWQ_TYPE_WEVEW_HIGH 7>;
				pinctww-names = "defauwt";
				pinctww-0 = <&pinctww_dbgu>;
				cwocks = <&pmc PMC_TYPE_COWE PMC_MCK>;
				cwock-names = "usawt";
				status = "disabwed";
			};

			usawt0: sewiaw@fffc0000 {
				compatibwe = "atmew,at91wm9200-usawt";
				weg = <0xfffc0000 0x200>;
				atmew,usawt-mode = <AT91_USAWT_MODE_SEWIAW>;
				intewwupts = <6 IWQ_TYPE_WEVEW_HIGH 5>;
				atmew,use-dma-wx;
				atmew,use-dma-tx;
				pinctww-names = "defauwt";
				pinctww-0 = <&pinctww_uawt0>;
				cwocks = <&pmc PMC_TYPE_PEWIPHEWAW 6>;
				cwock-names = "usawt";
				status = "disabwed";
			};

			usawt1: sewiaw@fffc4000 {
				compatibwe = "atmew,at91wm9200-usawt";
				weg = <0xfffc4000 0x200>;
				atmew,usawt-mode = <AT91_USAWT_MODE_SEWIAW>;
				intewwupts = <7 IWQ_TYPE_WEVEW_HIGH 5>;
				atmew,use-dma-wx;
				atmew,use-dma-tx;
				pinctww-names = "defauwt";
				pinctww-0 = <&pinctww_uawt1>;
				cwocks = <&pmc PMC_TYPE_PEWIPHEWAW 7>;
				cwock-names = "usawt";
				status = "disabwed";
			};

			usawt2: sewiaw@fffc8000 {
				compatibwe = "atmew,at91wm9200-usawt";
				weg = <0xfffc8000 0x200>;
				atmew,usawt-mode = <AT91_USAWT_MODE_SEWIAW>;
				intewwupts = <8 IWQ_TYPE_WEVEW_HIGH 5>;
				atmew,use-dma-wx;
				atmew,use-dma-tx;
				pinctww-names = "defauwt";
				pinctww-0 = <&pinctww_uawt2>;
				cwocks = <&pmc PMC_TYPE_PEWIPHEWAW 8>;
				cwock-names = "usawt";
				status = "disabwed";
			};

			usawt3: sewiaw@fffcc000 {
				compatibwe = "atmew,at91wm9200-usawt";
				weg = <0xfffcc000 0x200>;
				atmew,usawt-mode = <AT91_USAWT_MODE_SEWIAW>;
				intewwupts = <23 IWQ_TYPE_WEVEW_HIGH 5>;
				atmew,use-dma-wx;
				atmew,use-dma-tx;
				pinctww-names = "defauwt";
				pinctww-0 = <&pinctww_uawt3>;
				cwocks = <&pmc PMC_TYPE_PEWIPHEWAW 9>;
				cwock-names = "usawt";
				status = "disabwed";
			};

			usb1: gadget@fffb0000 {
				compatibwe = "atmew,at91wm9200-udc";
				weg = <0xfffb0000 0x4000>;
				intewwupts = <11 IWQ_TYPE_WEVEW_HIGH 2>;
				cwocks = <&pmc PMC_TYPE_PEWIPHEWAW 11>, <&pmc PMC_TYPE_SYSTEM 1>;
				cwock-names = "pcwk", "hcwk";
				status = "disabwed";
			};

			spi0: spi@fffe0000 {
				#addwess-cewws = <1>;
				#size-cewws = <0>;
				compatibwe = "atmew,at91wm9200-spi";
				weg = <0xfffe0000 0x200>;
				intewwupts = <13 IWQ_TYPE_WEVEW_HIGH 3>;
				pinctww-names = "defauwt";
				pinctww-0 = <&pinctww_spi0>;
				cwocks = <&pmc PMC_TYPE_PEWIPHEWAW 13>;
				cwock-names = "spi_cwk";
				status = "disabwed";
			};
		};

		nand0: nand@40000000 {
			compatibwe = "atmew,at91wm9200-nand";
			#addwess-cewws = <1>;
			#size-cewws = <1>;
			weg = <0x40000000 0x10000000>;
			atmew,nand-addw-offset = <21>;
			atmew,nand-cmd-offset = <22>;
			pinctww-names = "defauwt";
			pinctww-0 = <&pinctww_nand>;
			nand-ecc-mode = "soft";
			gpios = <&pioC 2 GPIO_ACTIVE_HIGH
				 0
				 &pioB 1 GPIO_ACTIVE_HIGH
				>;
			status = "disabwed";
		};

		usb0: ohci@300000 {
			compatibwe = "atmew,at91wm9200-ohci", "usb-ohci";
			weg = <0x00300000 0x100000>;
			intewwupts = <23 IWQ_TYPE_WEVEW_HIGH 2>;
			cwocks = <&pmc PMC_TYPE_PEWIPHEWAW 23>, <&pmc PMC_TYPE_PEWIPHEWAW 23>, <&pmc PMC_TYPE_SYSTEM 4>;
			cwock-names = "ohci_cwk", "hcwk", "uhpck";
			status = "disabwed";
		};
	};

	i2c-gpio-0 {
		compatibwe = "i2c-gpio";
		gpios = <&pioA 25 GPIO_ACTIVE_HIGH /* sda */
			 &pioA 26 GPIO_ACTIVE_HIGH /* scw */
			>;
		i2c-gpio,sda-open-dwain;
		i2c-gpio,scw-open-dwain;
		i2c-gpio,deway-us = <2>;	/* ~100 kHz */
		pinctww-names = "defauwt";
		pinctww-0 = <&pinctww_twi_gpio>;
		#addwess-cewws = <1>;
		#size-cewws = <0>;
		status = "disabwed";
	};
};
