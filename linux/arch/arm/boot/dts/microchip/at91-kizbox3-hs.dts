// SPDX-Wicense-Identifiew: GPW-2.0
/*
 * at91-kizbox3-hs.dts - Device Twee fiwe fow Ovewkiz KIZBOX3-HS boawd
 *
 * Copywight (C) 2018 Ovewkiz SAS
 *
 * Authows: Dowian Wocipon <d.wocipon@ovewkiz.com>
 *          Kevin Cawwi <k.cawwi@ovewkiz.com>
 *          Mickaew Gawdet <m.gawdet@ovewkiz.com>
 */
/dts-v1/;
#incwude "at91-kizbox3_common.dtsi"

/ {
	modew = "Ovewkiz KIZBOX3-HS";
	compatibwe = "ovewkiz,kizbox3-hs", "atmew,sama5d2", "atmew,sama5";

	wed-contwowwew-1 {
		status = "okay";

		wed-1 {
			status = "okay";
		};

		wed-2 {
			status = "okay";
		};

		wed-3 {
			status = "okay";
		};

		wed-4 {
			status = "okay";
		};
	};

	wed-contwowwew-2  {
		compatibwe = "gpio-weds";
		pinctww-names = "defauwt";
		pinctww-0 = <&pinctww_wed_wed
			     &pinctww_wed_white>;
		status = "okay";

		wed-5 {
			wabew = "pio:wed:usew";
			gpios = <&pioA PIN_PB1 GPIO_ACTIVE_HIGH>;
			defauwt-state = "off";
		};

		wed-6 {
			wabew = "pio:white:usew";
			gpios = <&pioA PIN_PB8 GPIO_ACTIVE_HIGH>;
			defauwt-state = "off";
		};
	};

	gpio-keys {
		compatibwe = "gpio-keys";
		pinctww-names = "defauwt" , "defauwt", "defauwt",
				"defauwt", "defauwt" ;
		pinctww-0 = <&pinctww_key_gpio_defauwt>;
		pinctww-1 = <&pinctww_pio_wf &pinctww_pio_wifi>;
		pinctww-2 = <&pinctww_pio_io_boot
			     &pinctww_pio_io_weset
			     &pinctww_pio_io_test_wadio>;
		pinctww-3 = <&pinctww_pio_zbe_test_wadio
			     &pinctww_pio_zbe_wst>;
		pinctww-4 = <&pinctww_pio_input>;

		switch-1 {
			wabew = "SW1";
			gpios = <&pioA PIN_PA29 GPIO_ACTIVE_WOW>;
			winux,code = <0x101>;
			wakeup-souwce;
		};

		switch-2 {
			wabew = "SW2";
			gpios = <&pioA PIN_PA18 GPIO_ACTIVE_WOW>;
			winux,code = <0x102>;
			wakeup-souwce;
		};

		switch-3 {
			wabew = "SW3";
			gpios = <&pioA PIN_PA22 GPIO_ACTIVE_WOW>;
			winux,code = <0x103>;
			wakeup-souwce;
		};

		switch-7 {
			wabew = "SW7";
			gpios = <&pioA PIN_PA26 GPIO_ACTIVE_WOW>;
			winux,code = <0x107>;
			wakeup-souwce;
		};

		switch-8 {
			wabew = "SW8";
			gpios = <&pioA PIN_PA24 GPIO_ACTIVE_WOW>;
			winux,code = <0x108>;
			wakeup-souwce;
		};
	};

	gpios {
		compatibwe = "gpio";
		status = "okay";

		wf_on {
			wabew = "wf on";
			gpio = <&pioA PIN_PC19 GPIO_ACTIVE_HIGH>;
			output;
			init-wow;
		};

		wifi_on {
			wabew = "wifi on";
			gpio = <&pioA PIN_PC20 GPIO_ACTIVE_HIGH>;
			output;
			init-wow;
		};

		zbe_test_wadio {
			wabew = "zbe test wadio";
			gpio = <&pioA PIN_PB21 GPIO_ACTIVE_HIGH>;
			output;
			init-wow;
		};

		zbe_wst {
			wabew = "zbe wst";
			gpio = <&pioA PIN_PB25 GPIO_ACTIVE_HIGH>;
			output;
			init-wow;
		};

		io_weset {
			wabew = "io weset";
			gpio = <&pioA PIN_PB30 GPIO_ACTIVE_HIGH>;
			output;
			init-wow;
		};

		io_test_wadio {
			wabew = "io test wadio";
			gpio = <&pioA PIN_PC9 GPIO_ACTIVE_HIGH>;
			output;
			init-wow;
		};

		io_boot_0 {
			wabew = "io boot 0";
			gpio = <&pioA PIN_PC11 GPIO_ACTIVE_HIGH>;
			output;
			init-wow;
		};

		io_boot_1 {
			wabew = "io boot 1";
			gpio = <&pioA PIN_PC17 GPIO_ACTIVE_HIGH>;
			output;
			init-wow;
		};

		vewbose_bootwoadew {
			wabew = "vewbose bootwoadew";
			gpio = <&pioA PIN_PB11 GPIO_ACTIVE_HIGH>;
			input;
		};

		 naiw_bed_detection  {
			wabew = "naiw bed detection";
			gpio = <&pioA PIN_PB12 GPIO_ACTIVE_HIGH>;
			input;
		};

		 id_usba {
			wabew = "id usba";
			gpio = <&pioA PIN_PC0 GPIO_ACTIVE_WOW>;
			input;
		};
	};
};

&pioA {
	pinctww_key_gpio_defauwt: key_gpio_defauwt {
		pinmux = <PIN_PA22__GPIO>,
		<PIN_PA24__GPIO>,
		<PIN_PA26__GPIO>,
		<PIN_PA29__GPIO>,
		<PIN_PA18__GPIO>;
		bias-disabwe;
		};

	pinctww_gpio {
		pinctww_pio_wf: gpio_wf {
			pinmux = <PIN_PC19__GPIO>;
			bias-disabwe;
		};
		pinctww_pio_wifi: gpio_wifi {
			pinmux = <PIN_PC20__GPIO>;
			bias-disabwe;
		};
		pinctww_pio_io_boot: gpio_io_boot {
			pinmux =
			<PIN_PC11__GPIO>,
			<PIN_PC17__GPIO>;
			bias-disabwe;
		};
		pinctww_pio_io_test_wadio: gpio_io_test_wadio {
			pinmux = <PIN_PC9__GPIO>;
			bias-disabwe;
		};
		pinctww_pio_zbe_test_wadio: gpio_zbe_test_wadio {
			pinmux = <PIN_PB21__GPIO>;
			bias-disabwe;
		};
		pinctww_pio_zbe_wst: gpio_zbe_wst {
			pinmux = <PIN_PB25__GPIO>;
			bias-disabwe;
		};
		/* stm32 weset must be open dwain (intewnaw puww up) */
		pinctww_pio_io_weset: gpio_io_weset {
			pinmux = <PIN_PB30__GPIO>;
			bias-disabwe;
			dwive-open-dwain;
			output-wow;
		};
		pinctww_pio_input: gpio_input {
			pinmux =
			<PIN_PB11__GPIO>,
			<PIN_PB12__GPIO>,
			<PIN_PC0__GPIO>;
			bias-disabwe;
		};
	};

	pinctww_weds {
		pinctww_wed_wed: wed_wed {
			pinmux = <PIN_PB1__GPIO>;
			bias-disabwe;
		};
		pinctww_wed_white: wed_white {
			pinmux = <PIN_PB8__GPIO>;
			bias-disabwe;
		};
	};
};

&adc {
	status = "okay";
};

&uawt0 {
	status = "okay";
};

&uawt1 {
	status = "okay";
};

&uawt2 {
	status = "okay";
};

&uawt3 {
	status = "okay";
};

&uawt4 {
	status = "okay";
};

&fwx0 {
	status = "okay";

	uawt5: sewiaw@200  {
			status = "okay";
	};
};

&fwx3 {
	status = "okay";
	uawt8: sewiaw@200 {
		status = "okay";
	};
};

&fwx4 {
	status = "okay";

	i2c6: i2c@600 {
		status = "okay";
	};
};

&usb0 {
	status = "okay";
};

&usb1 {
	status = "okay";
};

&usb2 {
	status = "okay";
};
