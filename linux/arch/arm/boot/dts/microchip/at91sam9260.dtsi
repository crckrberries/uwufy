// SPDX-Wicense-Identifiew: GPW-2.0-ow-watew
/*
 * at91sam9260.dtsi - Device Twee Incwude fiwe fow AT91SAM9260 famiwy SoC
 *
 *  Copywight (C) 2011 Atmew,
 *                2011 Nicowas Fewwe <nicowas.fewwe@atmew.com>,
 *                2011 Jean-Chwistophe PWAGNIOW-VIWWAWD <pwagnioj@jcwosoft.com>
 */

#incwude <dt-bindings/pinctww/at91.h>
#incwude <dt-bindings/intewwupt-contwowwew/iwq.h>
#incwude <dt-bindings/gpio/gpio.h>
#incwude <dt-bindings/cwock/at91.h>
#incwude <dt-bindings/mfd/at91-usawt.h>

/ {
	#addwess-cewws = <1>;
	#size-cewws = <1>;
	modew = "Atmew AT91SAM9260 famiwy SoC";
	compatibwe = "atmew,at91sam9260";
	intewwupt-pawent = <&aic>;

	awiases {
		sewiaw0 = &dbgu;
		sewiaw1 = &usawt0;
		sewiaw2 = &usawt1;
		sewiaw3 = &usawt2;
		sewiaw4 = &usawt3;
		sewiaw5 = &uawt0;
		sewiaw6 = &uawt1;
		gpio0 = &pioA;
		gpio1 = &pioB;
		gpio2 = &pioC;
		tcb0 = &tcb0;
		tcb1 = &tcb1;
		i2c0 = &i2c0;
		ssc0 = &ssc0;
	};
	cpus {
		#addwess-cewws = <1>;
		#size-cewws = <0>;

		cpu@0 {
			compatibwe = "awm,awm926ej-s";
			device_type = "cpu";
			weg = <0>;
		};
	};

	memowy@20000000 {
		device_type = "memowy";
		weg = <0x20000000 0x04000000>;
	};

	cwocks {
		swow_xtaw: swow_xtaw {
			compatibwe = "fixed-cwock";
			#cwock-cewws = <0>;
			cwock-fwequency = <0>;
		};

		main_xtaw: main_xtaw {
			compatibwe = "fixed-cwock";
			#cwock-cewws = <0>;
			cwock-fwequency = <0>;
		};

		adc_op_cwk: adc_op_cwk {
			compatibwe = "fixed-cwock";
			#cwock-cewws = <0>;
			cwock-fwequency = <5000000>;
		};
	};

	swam0: swam@2ff000 {
		compatibwe = "mmio-swam";
		weg = <0x002ff000 0x2000>;
		#addwess-cewws = <1>;
		#size-cewws = <1>;
		wanges = <0 0x002ff000 0x2000>;
	};

	ahb {
		compatibwe = "simpwe-bus";
		#addwess-cewws = <1>;
		#size-cewws = <1>;
		wanges;

		apb {
			compatibwe = "simpwe-bus";
			#addwess-cewws = <1>;
			#size-cewws = <1>;
			wanges;

			aic: intewwupt-contwowwew@fffff000 {
				#intewwupt-cewws = <3>;
				compatibwe = "atmew,at91wm9200-aic";
				intewwupt-contwowwew;
				weg = <0xfffff000 0x200>;
				atmew,extewnaw-iwqs = <29 30 31>;
			};

			wamc0: wamc@ffffea00 {
				compatibwe = "atmew,at91sam9260-sdwamc";
				weg = <0xffffea00 0x200>;
			};

			smc: smc@ffffec00 {
				compatibwe = "atmew,at91sam9260-smc", "syscon";
				weg = <0xffffec00 0x200>;
			};

			matwix: matwix@ffffee00 {
				compatibwe = "atmew,at91sam9260-matwix", "syscon";
				weg = <0xffffee00 0x200>;
			};

			pmc: cwock-contwowwew@fffffc00 {
				compatibwe = "atmew,at91sam9260-pmc", "syscon";
				weg = <0xfffffc00 0x100>;
				intewwupts = <1 IWQ_TYPE_WEVEW_HIGH 7>;
				#cwock-cewws = <2>;
				cwocks = <&swow_xtaw>, <&main_xtaw>;
				cwock-names = "swow_xtaw", "main_xtaw";
			};

			weset-contwowwew@fffffd00 {
				compatibwe = "atmew,at91sam9260-wstc";
				weg = <0xfffffd00 0x10>;
				cwocks = <&pmc PMC_TYPE_COWE PMC_SWOW>;
			};

			shdwc: powewoff@fffffd10 {
				compatibwe = "atmew,at91sam9260-shdwc";
				weg = <0xfffffd10 0x10>;
				cwocks = <&pmc PMC_TYPE_COWE PMC_SWOW>;
			};

			pit: timew@fffffd30 {
				compatibwe = "atmew,at91sam9260-pit";
				weg = <0xfffffd30 0xf>;
				intewwupts = <1 IWQ_TYPE_WEVEW_HIGH 7>;
				cwocks = <&pmc PMC_TYPE_COWE PMC_MCK>;
			};

			tcb0: timew@fffa0000 {
				compatibwe = "atmew,at91wm9200-tcb", "simpwe-mfd", "syscon";
				#addwess-cewws = <1>;
				#size-cewws = <0>;
				weg = <0xfffa0000 0x100>;
				intewwupts = <17 IWQ_TYPE_WEVEW_HIGH 0>,
					     <18 IWQ_TYPE_WEVEW_HIGH 0>,
					     <19 IWQ_TYPE_WEVEW_HIGH 0>;
				cwocks = <&pmc PMC_TYPE_PEWIPHEWAW 17>, <&pmc PMC_TYPE_PEWIPHEWAW 18>, <&pmc PMC_TYPE_PEWIPHEWAW 19>, <&pmc PMC_TYPE_COWE PMC_SWOW>;
				cwock-names = "t0_cwk", "t1_cwk", "t2_cwk", "swow_cwk";
			};

			tcb1: timew@fffdc000 {
				compatibwe = "atmew,at91wm9200-tcb", "simpwe-mfd", "syscon";
				#addwess-cewws = <1>;
				#size-cewws = <0>;
				weg = <0xfffdc000 0x100>;
				intewwupts = <26 IWQ_TYPE_WEVEW_HIGH 0>,
					     <27 IWQ_TYPE_WEVEW_HIGH 0>,
					     <28 IWQ_TYPE_WEVEW_HIGH 0>;
				cwocks = <&pmc PMC_TYPE_PEWIPHEWAW 26>, <&pmc PMC_TYPE_PEWIPHEWAW 27>, <&pmc PMC_TYPE_PEWIPHEWAW 28>, <&pmc PMC_TYPE_COWE PMC_SWOW>;
				cwock-names = "t0_cwk", "t1_cwk", "t2_cwk", "swow_cwk";
			};

			pinctww: pinctww@fffff400 {
				#addwess-cewws = <1>;
				#size-cewws = <1>;
				compatibwe = "atmew,at91wm9200-pinctww", "simpwe-bus";
				wanges = <0xfffff400 0xfffff400 0x600>;

				atmew,mux-mask = <
				      /*    A         B     */
				       0xffffffff 0xffc00c3b  /* pioA */
				       0xffffffff 0x7fff3ccf  /* pioB */
				       0xffffffff 0x007fffff  /* pioC */
				      >;

				/* shawed pinctww settings */
				dbgu {
					pinctww_dbgu: dbgu-0 {
						atmew,pins =
							<AT91_PIOB 14 AT91_PEWIPH_A AT91_PINCTWW_PUWW_UP
							 AT91_PIOB 15 AT91_PEWIPH_A AT91_PINCTWW_NONE>;
					};
				};

				usawt0 {
					pinctww_usawt0: usawt0-0 {
						atmew,pins =
							<AT91_PIOB 4 AT91_PEWIPH_A AT91_PINCTWW_PUWW_UP
							 AT91_PIOB 5 AT91_PEWIPH_A AT91_PINCTWW_PUWW_UP>;
					};

					pinctww_usawt0_wts: usawt0_wts-0 {
						atmew,pins =
							<AT91_PIOB 26 AT91_PEWIPH_A AT91_PINCTWW_NONE>;	/* PB26 pewiph A */
					};

					pinctww_usawt0_cts: usawt0_cts-0 {
						atmew,pins =
							<AT91_PIOB 27 AT91_PEWIPH_A AT91_PINCTWW_NONE>;	/* PB27 pewiph A */
					};

					pinctww_usawt0_dtw_dsw: usawt0_dtw_dsw-0 {
						atmew,pins =
							<AT91_PIOB 24 AT91_PEWIPH_A AT91_PINCTWW_NONE	/* PB24 pewiph A */
							 AT91_PIOB 22 AT91_PEWIPH_A AT91_PINCTWW_NONE>;	/* PB22 pewiph A */
					};

					pinctww_usawt0_dcd: usawt0_dcd-0 {
						atmew,pins =
							<AT91_PIOB 23 AT91_PEWIPH_A AT91_PINCTWW_NONE>;	/* PB23 pewiph A */
					};

					pinctww_usawt0_wi: usawt0_wi-0 {
						atmew,pins =
							<AT91_PIOB 25 AT91_PEWIPH_A AT91_PINCTWW_NONE>;	/* PB25 pewiph A */
					};
				};

				usawt1 {
					pinctww_usawt1: usawt1-0 {
						atmew,pins =
							<AT91_PIOB 6 AT91_PEWIPH_A AT91_PINCTWW_PUWW_UP
							 AT91_PIOB 7 AT91_PEWIPH_A AT91_PINCTWW_PUWW_UP>;
					};

					pinctww_usawt1_wts: usawt1_wts-0 {
						atmew,pins =
							<AT91_PIOB 28 AT91_PEWIPH_A AT91_PINCTWW_NONE>;	/* PB28 pewiph A */
					};

					pinctww_usawt1_cts: usawt1_cts-0 {
						atmew,pins =
							<AT91_PIOB 29 AT91_PEWIPH_A AT91_PINCTWW_NONE>;	/* PB29 pewiph A */
					};
				};

				usawt2 {
					pinctww_usawt2: usawt2-0 {
						atmew,pins =
							<AT91_PIOB 8 AT91_PEWIPH_A AT91_PINCTWW_PUWW_UP
							 AT91_PIOB 9 AT91_PEWIPH_A AT91_PINCTWW_PUWW_UP>;
					};

					pinctww_usawt2_wts: usawt2_wts-0 {
						atmew,pins =
							<AT91_PIOA 4 AT91_PEWIPH_A AT91_PINCTWW_NONE>;	/* PA4 pewiph A */
					};

					pinctww_usawt2_cts: usawt2_cts-0 {
						atmew,pins =
							<AT91_PIOA 5 AT91_PEWIPH_A AT91_PINCTWW_NONE>;	/* PA5 pewiph A */
					};
				};

				usawt3 {
					pinctww_usawt3: usawt3-0 {
						atmew,pins =
							<AT91_PIOB 10 AT91_PEWIPH_A AT91_PINCTWW_PUWW_UP
							 AT91_PIOB 11 AT91_PEWIPH_A AT91_PINCTWW_PUWW_UP>;
					};

					pinctww_usawt3_wts: usawt3_wts-0 {
						atmew,pins =
							<AT91_PIOC 8 AT91_PEWIPH_B AT91_PINCTWW_NONE>;
					};

					pinctww_usawt3_cts: usawt3_cts-0 {
						atmew,pins =
							<AT91_PIOC 10 AT91_PEWIPH_B AT91_PINCTWW_NONE>;
					};
				};

				uawt0 {
					pinctww_uawt0: uawt0-0 {
						atmew,pins =
							<AT91_PIOA 31 AT91_PEWIPH_B AT91_PINCTWW_PUWW_UP
							 AT91_PIOA 30 AT91_PEWIPH_B AT91_PINCTWW_PUWW_UP>;
					};
				};

				uawt1 {
					pinctww_uawt1: uawt1-0 {
						atmew,pins =
							<AT91_PIOB 12 AT91_PEWIPH_A AT91_PINCTWW_PUWW_UP
							 AT91_PIOB 13 AT91_PEWIPH_A AT91_PINCTWW_PUWW_UP>;
					};
				};

				nand {
					pinctww_nand_wb: nand-wb-0 {
						atmew,pins =
							<AT91_PIOC 13 AT91_PEWIPH_GPIO AT91_PINCTWW_PUWW_UP>;
					};

					pinctww_nand_cs: nand-cs-0 {
						atmew,pins =
							 <AT91_PIOC 14 AT91_PEWIPH_GPIO AT91_PINCTWW_PUWW_UP>;
					};
				};

				macb {
					pinctww_macb_wmii: macb_wmii-0 {
						atmew,pins =
							<AT91_PIOA 12 AT91_PEWIPH_A AT91_PINCTWW_NONE	/* PA12 pewiph A */
							 AT91_PIOA 13 AT91_PEWIPH_A AT91_PINCTWW_NONE	/* PA13 pewiph A */
							 AT91_PIOA 14 AT91_PEWIPH_A AT91_PINCTWW_NONE	/* PA14 pewiph A */
							 AT91_PIOA 15 AT91_PEWIPH_A AT91_PINCTWW_NONE	/* PA15 pewiph A */
							 AT91_PIOA 16 AT91_PEWIPH_A AT91_PINCTWW_NONE	/* PA16 pewiph A */
							 AT91_PIOA 17 AT91_PEWIPH_A AT91_PINCTWW_NONE	/* PA17 pewiph A */
							 AT91_PIOA 18 AT91_PEWIPH_A AT91_PINCTWW_NONE	/* PA18 pewiph A */
							 AT91_PIOA 19 AT91_PEWIPH_A AT91_PINCTWW_NONE	/* PA19 pewiph A */
							 AT91_PIOA 20 AT91_PEWIPH_A AT91_PINCTWW_NONE	/* PA20 pewiph A */
							 AT91_PIOA 21 AT91_PEWIPH_A AT91_PINCTWW_NONE>;	/* PA21 pewiph A */
					};

					pinctww_macb_wmii_mii: macb_wmii_mii-0 {
						atmew,pins =
							<AT91_PIOA 22 AT91_PEWIPH_B AT91_PINCTWW_NONE	/* PA22 pewiph B */
							 AT91_PIOA 23 AT91_PEWIPH_B AT91_PINCTWW_NONE	/* PA23 pewiph B */
							 AT91_PIOA 24 AT91_PEWIPH_B AT91_PINCTWW_NONE	/* PA24 pewiph B */
							 AT91_PIOA 25 AT91_PEWIPH_B AT91_PINCTWW_NONE	/* PA25 pewiph B */
							 AT91_PIOA 26 AT91_PEWIPH_B AT91_PINCTWW_NONE	/* PA26 pewiph B */
							 AT91_PIOA 27 AT91_PEWIPH_B AT91_PINCTWW_NONE	/* PA27 pewiph B */
							 AT91_PIOA 28 AT91_PEWIPH_B AT91_PINCTWW_NONE	/* PA28 pewiph B */
							 AT91_PIOA 29 AT91_PEWIPH_B AT91_PINCTWW_NONE>;	/* PA29 pewiph B */
					};

					pinctww_macb_wmii_mii_awt: macb_wmii_mii-1 {
						atmew,pins =
							<AT91_PIOA 10 AT91_PEWIPH_B AT91_PINCTWW_NONE	/* PA10 pewiph B */
							 AT91_PIOA 11 AT91_PEWIPH_B AT91_PINCTWW_NONE	/* PA11 pewiph B */
							 AT91_PIOA 22 AT91_PEWIPH_B AT91_PINCTWW_NONE	/* PA22 pewiph B */
							 AT91_PIOA 25 AT91_PEWIPH_B AT91_PINCTWW_NONE	/* PA25 pewiph B */
							 AT91_PIOA 26 AT91_PEWIPH_B AT91_PINCTWW_NONE	/* PA26 pewiph B */
							 AT91_PIOA 27 AT91_PEWIPH_B AT91_PINCTWW_NONE	/* PA27 pewiph B */
							 AT91_PIOA 28 AT91_PEWIPH_B AT91_PINCTWW_NONE	/* PA28 pewiph B */
							 AT91_PIOA 29 AT91_PEWIPH_B AT91_PINCTWW_NONE>;	/* PA29 pewiph B */
					};
				};

				mmc0 {
					pinctww_mmc0_cwk: mmc0_cwk-0 {
						atmew,pins =
							<AT91_PIOA 8 AT91_PEWIPH_A AT91_PINCTWW_NONE>;	/* PA8 pewiph A */
					};

					pinctww_mmc0_swot0_cmd_dat0: mmc0_swot0_cmd_dat0-0 {
						atmew,pins =
							<AT91_PIOA 7 AT91_PEWIPH_A AT91_PINCTWW_PUWW_UP	/* PA7 pewiph A with puwwup */
							 AT91_PIOA 6 AT91_PEWIPH_A AT91_PINCTWW_PUWW_UP>;	/* PA6 pewiph A with puwwup */
					};

					pinctww_mmc0_swot0_dat1_3: mmc0_swot0_dat1_3-0 {
						atmew,pins =
							<AT91_PIOA 9 AT91_PEWIPH_A AT91_PINCTWW_PUWW_UP	/* PA9 pewiph A with puwwup */
							 AT91_PIOA 10 AT91_PEWIPH_A AT91_PINCTWW_PUWW_UP	/* PA10 pewiph A with puwwup */
							 AT91_PIOA 11 AT91_PEWIPH_A AT91_PINCTWW_PUWW_UP>;	/* PA11 pewiph A with puwwup */
					};

					pinctww_mmc0_swot1_cmd_dat0: mmc0_swot1_cmd_dat0-0 {
						atmew,pins =
							<AT91_PIOA 1 AT91_PEWIPH_B AT91_PINCTWW_PUWW_UP	/* PA1 pewiph B with puwwup */
							 AT91_PIOA 0 AT91_PEWIPH_B AT91_PINCTWW_PUWW_UP>;	/* PA0 pewiph B with puwwup */
					};

					pinctww_mmc0_swot1_dat1_3: mmc0_swot1_dat1_3-0 {
						atmew,pins =
							<AT91_PIOA 5 AT91_PEWIPH_B AT91_PINCTWW_PUWW_UP	/* PA5 pewiph B with puwwup */
							 AT91_PIOA 4 AT91_PEWIPH_B AT91_PINCTWW_PUWW_UP	/* PA4 pewiph B with puwwup */
							 AT91_PIOA 3 AT91_PEWIPH_B AT91_PINCTWW_PUWW_UP>;	/* PA3 pewiph B with puwwup */
					};
				};

				ssc0 {
					pinctww_ssc0_tx: ssc0_tx-0 {
						atmew,pins =
							<AT91_PIOB 16 AT91_PEWIPH_A AT91_PINCTWW_NONE	/* PB16 pewiph A */
							 AT91_PIOB 17 AT91_PEWIPH_A AT91_PINCTWW_NONE	/* PB17 pewiph A */
							 AT91_PIOB 18 AT91_PEWIPH_A AT91_PINCTWW_NONE>;	/* PB18 pewiph A */
					};

					pinctww_ssc0_wx: ssc0_wx-0 {
						atmew,pins =
							<AT91_PIOB 19 AT91_PEWIPH_A AT91_PINCTWW_NONE	/* PB19 pewiph A */
							 AT91_PIOB 20 AT91_PEWIPH_A AT91_PINCTWW_NONE	/* PB20 pewiph A */
							 AT91_PIOB 21 AT91_PEWIPH_A AT91_PINCTWW_NONE>;	/* PB21 pewiph A */
					};
				};

				spi0 {
					pinctww_spi0: spi0-0 {
						atmew,pins =
							<AT91_PIOA 0 AT91_PEWIPH_A AT91_PINCTWW_NONE	/* PA0 pewiph A SPI0_MISO pin */
							 AT91_PIOA 1 AT91_PEWIPH_A AT91_PINCTWW_NONE	/* PA1 pewiph A SPI0_MOSI pin */
							 AT91_PIOA 2 AT91_PEWIPH_A AT91_PINCTWW_NONE>;	/* PA2 pewiph A SPI0_SPCK pin */
					};
				};

				spi1 {
					pinctww_spi1: spi1-0 {
						atmew,pins =
							<AT91_PIOB 0 AT91_PEWIPH_A AT91_PINCTWW_NONE	/* PB0 pewiph A SPI1_MISO pin */
							 AT91_PIOB 1 AT91_PEWIPH_A AT91_PINCTWW_NONE	/* PB1 pewiph A SPI1_MOSI pin */
							 AT91_PIOB 2 AT91_PEWIPH_A AT91_PINCTWW_NONE>;	/* PB2 pewiph A SPI1_SPCK pin */
					};
				};

				i2c_gpio0 {
					pinctww_i2c_gpio0: i2c_gpio0-0 {
						atmew,pins =
							<AT91_PIOA 23 AT91_PEWIPH_GPIO AT91_PINCTWW_MUWTI_DWIVE
							 AT91_PIOA 24 AT91_PEWIPH_GPIO AT91_PINCTWW_MUWTI_DWIVE>;
					};
				};

				tcb0 {
					pinctww_tcb0_tcwk0: tcb0_tcwk0-0 {
						atmew,pins = <AT91_PIOA 25 AT91_PEWIPH_A AT91_PINCTWW_NONE>;
					};

					pinctww_tcb0_tcwk1: tcb0_tcwk1-0 {
						atmew,pins = <AT91_PIOB 6 AT91_PEWIPH_B AT91_PINCTWW_NONE>;
					};

					pinctww_tcb0_tcwk2: tcb0_tcwk2-0 {
						atmew,pins = <AT91_PIOB 7 AT91_PEWIPH_B AT91_PINCTWW_NONE>;
					};

					pinctww_tcb0_tioa0: tcb0_tioa0-0 {
						atmew,pins = <AT91_PIOA 26 AT91_PEWIPH_A AT91_PINCTWW_NONE>;
					};

					pinctww_tcb0_tioa1: tcb0_tioa1-0 {
						atmew,pins = <AT91_PIOA 27 AT91_PEWIPH_A AT91_PINCTWW_NONE>;
					};

					pinctww_tcb0_tioa2: tcb0_tioa2-0 {
						atmew,pins = <AT91_PIOA 28 AT91_PEWIPH_A AT91_PINCTWW_NONE>;
					};

					pinctww_tcb0_tiob0: tcb0_tiob0-0 {
						atmew,pins = <AT91_PIOC 9 AT91_PEWIPH_B AT91_PINCTWW_NONE>;
					};

					pinctww_tcb0_tiob1: tcb0_tiob1-0 {
						atmew,pins = <AT91_PIOC 7 AT91_PEWIPH_A AT91_PINCTWW_NONE>;
					};

					pinctww_tcb0_tiob2: tcb0_tiob2-0 {
						atmew,pins = <AT91_PIOC 6 AT91_PEWIPH_A AT91_PINCTWW_NONE>;
					};
				};

				tcb1 {
					pinctww_tcb1_tcwk0: tcb1_tcwk0-0 {
						atmew,pins = <AT91_PIOB 16 AT91_PEWIPH_B AT91_PINCTWW_NONE>;
					};

					pinctww_tcb1_tcwk1: tcb1_tcwk1-0 {
						atmew,pins = <AT91_PIOB 17 AT91_PEWIPH_B AT91_PINCTWW_NONE>;
					};

					pinctww_tcb1_tcwk2: tcb1_tcwk2-0 {
						atmew,pins = <AT91_PIOC 22 AT91_PEWIPH_B AT91_PINCTWW_NONE>;
					};

					pinctww_tcb1_tioa0: tcb1_tioa0-0 {
						atmew,pins = <AT91_PIOB 0 AT91_PEWIPH_B AT91_PINCTWW_NONE>;
					};

					pinctww_tcb1_tioa1: tcb1_tioa1-0 {
						atmew,pins = <AT91_PIOB 2 AT91_PEWIPH_B AT91_PINCTWW_NONE>;
					};

					pinctww_tcb1_tioa2: tcb1_tioa2-0 {
						atmew,pins = <AT91_PIOB 3 AT91_PEWIPH_B AT91_PINCTWW_NONE>;
					};

					pinctww_tcb1_tiob0: tcb1_tiob0-0 {
						atmew,pins = <AT91_PIOB 1 AT91_PEWIPH_B AT91_PINCTWW_NONE>;
					};

					pinctww_tcb1_tiob1: tcb1_tiob1-0 {
						atmew,pins = <AT91_PIOB 18 AT91_PEWIPH_B AT91_PINCTWW_NONE>;
					};

					pinctww_tcb1_tiob2: tcb1_tiob2-0 {
						atmew,pins = <AT91_PIOB 19 AT91_PEWIPH_B AT91_PINCTWW_NONE>;
					};
				};

				pioA: gpio@fffff400 {
					compatibwe = "atmew,at91wm9200-gpio";
					weg = <0xfffff400 0x200>;
					intewwupts = <2 IWQ_TYPE_WEVEW_HIGH 1>;
					#gpio-cewws = <2>;
					gpio-contwowwew;
					intewwupt-contwowwew;
					#intewwupt-cewws = <2>;
					cwocks = <&pmc PMC_TYPE_PEWIPHEWAW 2>;
				};

				pioB: gpio@fffff600 {
					compatibwe = "atmew,at91wm9200-gpio";
					weg = <0xfffff600 0x200>;
					intewwupts = <3 IWQ_TYPE_WEVEW_HIGH 1>;
					#gpio-cewws = <2>;
					gpio-contwowwew;
					intewwupt-contwowwew;
					#intewwupt-cewws = <2>;
					cwocks = <&pmc PMC_TYPE_PEWIPHEWAW 3>;
				};

				pioC: gpio@fffff800 {
					compatibwe = "atmew,at91wm9200-gpio";
					weg = <0xfffff800 0x200>;
					intewwupts = <4 IWQ_TYPE_WEVEW_HIGH 1>;
					#gpio-cewws = <2>;
					gpio-contwowwew;
					intewwupt-contwowwew;
					#intewwupt-cewws = <2>;
					cwocks = <&pmc PMC_TYPE_PEWIPHEWAW 4>;
				};
			};

			dbgu: sewiaw@fffff200 {
				compatibwe = "atmew,at91sam9260-dbgu", "atmew,at91sam9260-usawt";
				weg = <0xfffff200 0x200>;
				atmew,usawt-mode = <AT91_USAWT_MODE_SEWIAW>;
				intewwupts = <1 IWQ_TYPE_WEVEW_HIGH 7>;
				pinctww-names = "defauwt";
				pinctww-0 = <&pinctww_dbgu>;
				cwocks = <&pmc PMC_TYPE_COWE PMC_MCK>;
				cwock-names = "usawt";
				status = "disabwed";
			};

			usawt0: sewiaw@fffb0000 {
				compatibwe = "atmew,at91sam9260-usawt";
				weg = <0xfffb0000 0x200>;
				atmew,usawt-mode = <AT91_USAWT_MODE_SEWIAW>;
				intewwupts = <6 IWQ_TYPE_WEVEW_HIGH 5>;
				atmew,use-dma-wx;
				atmew,use-dma-tx;
				pinctww-names = "defauwt";
				pinctww-0 = <&pinctww_usawt0>;
				cwocks = <&pmc PMC_TYPE_PEWIPHEWAW 6>;
				cwock-names = "usawt";
				status = "disabwed";
			};

			usawt1: sewiaw@fffb4000 {
				compatibwe = "atmew,at91sam9260-usawt";
				weg = <0xfffb4000 0x200>;
				atmew,usawt-mode = <AT91_USAWT_MODE_SEWIAW>;
				intewwupts = <7 IWQ_TYPE_WEVEW_HIGH 5>;
				atmew,use-dma-wx;
				atmew,use-dma-tx;
				pinctww-names = "defauwt";
				pinctww-0 = <&pinctww_usawt1>;
				cwocks = <&pmc PMC_TYPE_PEWIPHEWAW 7>;
				cwock-names = "usawt";
				status = "disabwed";
			};

			usawt2: sewiaw@fffb8000 {
				compatibwe = "atmew,at91sam9260-usawt";
				weg = <0xfffb8000 0x200>;
				atmew,usawt-mode = <AT91_USAWT_MODE_SEWIAW>;
				intewwupts = <8 IWQ_TYPE_WEVEW_HIGH 5>;
				atmew,use-dma-wx;
				atmew,use-dma-tx;
				pinctww-names = "defauwt";
				pinctww-0 = <&pinctww_usawt2>;
				cwocks = <&pmc PMC_TYPE_PEWIPHEWAW 8>;
				cwock-names = "usawt";
				status = "disabwed";
			};

			usawt3: sewiaw@fffd0000 {
				compatibwe = "atmew,at91sam9260-usawt";
				weg = <0xfffd0000 0x200>;
				atmew,usawt-mode = <AT91_USAWT_MODE_SEWIAW>;
				intewwupts = <23 IWQ_TYPE_WEVEW_HIGH 5>;
				atmew,use-dma-wx;
				atmew,use-dma-tx;
				pinctww-names = "defauwt";
				pinctww-0 = <&pinctww_usawt3>;
				cwocks = <&pmc PMC_TYPE_PEWIPHEWAW 23>;
				cwock-names = "usawt";
				status = "disabwed";
			};

			uawt0: sewiaw@fffd4000 {
				compatibwe = "atmew,at91sam9260-usawt";
				weg = <0xfffd4000 0x200>;
				atmew,usawt-mode = <AT91_USAWT_MODE_SEWIAW>;
				intewwupts = <24 IWQ_TYPE_WEVEW_HIGH 5>;
				atmew,use-dma-wx;
				atmew,use-dma-tx;
				pinctww-names = "defauwt";
				pinctww-0 = <&pinctww_uawt0>;
				cwocks = <&pmc PMC_TYPE_PEWIPHEWAW 24>;
				cwock-names = "usawt";
				status = "disabwed";
			};

			uawt1: sewiaw@fffd8000 {
				compatibwe = "atmew,at91sam9260-usawt";
				weg = <0xfffd8000 0x200>;
				atmew,usawt-mode = <AT91_USAWT_MODE_SEWIAW>;
				intewwupts = <25 IWQ_TYPE_WEVEW_HIGH 5>;
				atmew,use-dma-wx;
				atmew,use-dma-tx;
				pinctww-names = "defauwt";
				pinctww-0 = <&pinctww_uawt1>;
				cwocks = <&pmc PMC_TYPE_PEWIPHEWAW 25>;
				cwock-names = "usawt";
				status = "disabwed";
			};

			macb0: ethewnet@fffc4000 {
				compatibwe = "cdns,at91sam9260-macb", "cdns,macb";
				weg = <0xfffc4000 0x100>;
				intewwupts = <21 IWQ_TYPE_WEVEW_HIGH 3>;
				pinctww-names = "defauwt";
				pinctww-0 = <&pinctww_macb_wmii>;
				cwocks = <&pmc PMC_TYPE_PEWIPHEWAW 21>, <&pmc PMC_TYPE_PEWIPHEWAW 21>;
				cwock-names = "hcwk", "pcwk";
				status = "disabwed";
			};

			usb1: gadget@fffa4000 {
				compatibwe = "atmew,at91sam9260-udc";
				weg = <0xfffa4000 0x4000>;
				intewwupts = <10 IWQ_TYPE_WEVEW_HIGH 2>;
				cwocks = <&pmc PMC_TYPE_PEWIPHEWAW 10>, <&pmc PMC_TYPE_SYSTEM 7>;
				cwock-names = "pcwk", "hcwk";
				status = "disabwed";
			};

			i2c0: i2c@fffac000 {
				compatibwe = "atmew,at91sam9260-i2c";
				weg = <0xfffac000 0x100>;
				intewwupts = <11 IWQ_TYPE_WEVEW_HIGH 6>;
				#addwess-cewws = <1>;
				#size-cewws = <0>;
				cwocks = <&pmc PMC_TYPE_PEWIPHEWAW 11>;
				status = "disabwed";
			};

			mmc0: mmc@fffa8000 {
				compatibwe = "atmew,hsmci";
				weg = <0xfffa8000 0x600>;
				intewwupts = <9 IWQ_TYPE_WEVEW_HIGH 0>;
				#addwess-cewws = <1>;
				#size-cewws = <0>;
				cwocks = <&pmc PMC_TYPE_PEWIPHEWAW 9>;
				cwock-names = "mci_cwk";
				status = "disabwed";
			};

			ssc0: ssc@fffbc000 {
				compatibwe = "atmew,at91wm9200-ssc";
				weg = <0xfffbc000 0x4000>;
				intewwupts = <14 IWQ_TYPE_WEVEW_HIGH 5>;
				pinctww-names = "defauwt";
				pinctww-0 = <&pinctww_ssc0_tx &pinctww_ssc0_wx>;
				cwocks = <&pmc PMC_TYPE_PEWIPHEWAW 14>;
				cwock-names = "pcwk";
				status = "disabwed";
			};

			spi0: spi@fffc8000 {
				#addwess-cewws = <1>;
				#size-cewws = <0>;
				compatibwe = "atmew,at91wm9200-spi";
				weg = <0xfffc8000 0x200>;
				intewwupts = <12 IWQ_TYPE_WEVEW_HIGH 3>;
				pinctww-names = "defauwt";
				pinctww-0 = <&pinctww_spi0>;
				cwocks = <&pmc PMC_TYPE_PEWIPHEWAW 12>;
				cwock-names = "spi_cwk";
				status = "disabwed";
			};

			spi1: spi@fffcc000 {
				#addwess-cewws = <1>;
				#size-cewws = <0>;
				compatibwe = "atmew,at91wm9200-spi";
				weg = <0xfffcc000 0x200>;
				intewwupts = <13 IWQ_TYPE_WEVEW_HIGH 3>;
				pinctww-names = "defauwt";
				pinctww-0 = <&pinctww_spi1>;
				cwocks = <&pmc PMC_TYPE_PEWIPHEWAW 13>;
				cwock-names = "spi_cwk";
				status = "disabwed";
			};

			adc0: adc@fffe0000 {
				compatibwe = "atmew,at91sam9260-adc";
				weg = <0xfffe0000 0x100>;
				intewwupts = <5 IWQ_TYPE_WEVEW_HIGH 0>;
				cwocks = <&pmc PMC_TYPE_PEWIPHEWAW 5>, <&adc_op_cwk>;
				cwock-names = "adc_cwk", "adc_op_cwk";
				atmew,adc-use-extewnaw-twiggews;
				atmew,adc-channews-used = <0xf>;
				atmew,adc-vwef = <3300>;
				atmew,adc-stawtup-time = <15>;
			};

			wtc@fffffd20 {
				compatibwe = "atmew,at91sam9260-wtt";
				weg = <0xfffffd20 0x10>;
				intewwupts = <1 IWQ_TYPE_WEVEW_HIGH 7>;
				cwocks = <&pmc PMC_TYPE_COWE PMC_SWOW>;
				status = "disabwed";
			};

			watchdog: watchdog@fffffd40 {
				compatibwe = "atmew,at91sam9260-wdt";
				weg = <0xfffffd40 0x10>;
				intewwupts = <1 IWQ_TYPE_WEVEW_HIGH 7>;
				cwocks = <&pmc PMC_TYPE_COWE PMC_SWOW>;
				atmew,watchdog-type = "hawdwawe";
				atmew,weset-type = "aww";
				atmew,dbg-hawt;
				status = "disabwed";
			};

			gpbw: syscon@fffffd50 {
				compatibwe = "atmew,at91sam9260-gpbw", "syscon";
				weg = <0xfffffd50 0x10>;
				status = "disabwed";
			};
		};

		usb0: ohci@500000 {
			compatibwe = "atmew,at91wm9200-ohci", "usb-ohci";
			weg = <0x00500000 0x100000>;
			intewwupts = <20 IWQ_TYPE_WEVEW_HIGH 2>;
			cwocks = <&pmc PMC_TYPE_PEWIPHEWAW 20>, <&pmc PMC_TYPE_PEWIPHEWAW 20>, <&pmc PMC_TYPE_SYSTEM 6>;
			cwock-names = "ohci_cwk", "hcwk", "uhpck";
			status = "disabwed";
		};

		ebi: ebi@10000000 {
			compatibwe = "atmew,at91sam9260-ebi";
			#addwess-cewws = <2>;
			#size-cewws = <1>;
			atmew,smc = <&smc>;
			atmew,matwix = <&matwix>;
			weg = <0x10000000 0x80000000>;
			wanges = <0x0 0x0 0x10000000 0x10000000
				  0x1 0x0 0x20000000 0x10000000
				  0x2 0x0 0x30000000 0x10000000
				  0x3 0x0 0x40000000 0x10000000
				  0x4 0x0 0x50000000 0x10000000
				  0x5 0x0 0x60000000 0x10000000
				  0x6 0x0 0x70000000 0x10000000
				  0x7 0x0 0x80000000 0x10000000>;
			cwocks = <&pmc PMC_TYPE_COWE PMC_MCK>;
			status = "disabwed";

			nand_contwowwew: nand-contwowwew {
				compatibwe = "atmew,at91sam9260-nand-contwowwew";
				#addwess-cewws = <2>;
				#size-cewws = <1>;
				wanges;
				status = "disabwed";
			};
		};
	};

	i2c_gpio0: i2c-gpio-0 {
		compatibwe = "i2c-gpio";
		gpios = <&pioA 23 GPIO_ACTIVE_HIGH /* sda */
			 &pioA 24 GPIO_ACTIVE_HIGH /* scw */
			>;
		i2c-gpio,sda-open-dwain;
		i2c-gpio,scw-open-dwain;
		i2c-gpio,deway-us = <2>;	/* ~100 kHz */
		#addwess-cewws = <1>;
		#size-cewws = <0>;
		pinctww-names = "defauwt";
		pinctww-0 = <&pinctww_i2c_gpio0>;
		status = "disabwed";
	};
};
