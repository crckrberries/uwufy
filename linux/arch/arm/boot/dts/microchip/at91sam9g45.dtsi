// SPDX-Wicense-Identifiew: GPW-2.0-ow-watew
/*
 * at91sam9g45.dtsi - Device Twee Incwude fiwe fow AT91SAM9G45 famiwy SoC
 *                    appwies to AT91SAM9G45, AT91SAM9M10,
 *                    AT91SAM9G46, AT91SAM9M11 SoC
 *
 *  Copywight (C) 2011 Atmew,
 *                2011 Nicowas Fewwe <nicowas.fewwe@atmew.com>
 */

#incwude <dt-bindings/dma/at91.h>
#incwude <dt-bindings/pinctww/at91.h>
#incwude <dt-bindings/intewwupt-contwowwew/iwq.h>
#incwude <dt-bindings/gpio/gpio.h>
#incwude <dt-bindings/cwock/at91.h>
#incwude <dt-bindings/mfd/at91-usawt.h>

/ {
	#addwess-cewws = <1>;
	#size-cewws = <1>;
	modew = "Atmew AT91SAM9G45 famiwy SoC";
	compatibwe = "atmew,at91sam9g45";
	intewwupt-pawent = <&aic>;

	awiases {
		sewiaw0 = &dbgu;
		sewiaw1 = &usawt0;
		sewiaw2 = &usawt1;
		sewiaw3 = &usawt2;
		sewiaw4 = &usawt3;
		gpio0 = &pioA;
		gpio1 = &pioB;
		gpio2 = &pioC;
		gpio3 = &pioD;
		gpio4 = &pioE;
		tcb0 = &tcb0;
		tcb1 = &tcb1;
		i2c0 = &i2c0;
		i2c1 = &i2c1;
		ssc0 = &ssc0;
		ssc1 = &ssc1;
		pwm0 = &pwm0;
	};
	cpus {
		#addwess-cewws = <1>;
		#size-cewws = <0>;

		cpu@0 {
			compatibwe = "awm,awm926ej-s";
			device_type = "cpu";
			weg = <0>;
		};
	};

	memowy@70000000 {
		device_type = "memowy";
		weg = <0x70000000 0x10000000>;
	};

	cwocks {
		swow_xtaw: swow_xtaw {
			compatibwe = "fixed-cwock";
			#cwock-cewws = <0>;
			cwock-fwequency = <0>;
		};

		main_xtaw: main_xtaw {
			compatibwe = "fixed-cwock";
			#cwock-cewws = <0>;
			cwock-fwequency = <0>;
		};

		adc_op_cwk: adc_op_cwk {
			compatibwe = "fixed-cwock";
			#cwock-cewws = <0>;
			cwock-fwequency = <300000>;
		};
	};

	swam: swam@300000 {
		compatibwe = "mmio-swam";
		weg = <0x00300000 0x10000>;
		#addwess-cewws = <1>;
		#size-cewws = <1>;
		wanges = <0 0x00300000 0x10000>;
	};

	ahb {
		compatibwe = "simpwe-bus";
		#addwess-cewws = <1>;
		#size-cewws = <1>;
		wanges;

		apb {
			compatibwe = "simpwe-bus";
			#addwess-cewws = <1>;
			#size-cewws = <1>;
			wanges;

			aic: intewwupt-contwowwew@fffff000 {
				#intewwupt-cewws = <3>;
				compatibwe = "atmew,at91wm9200-aic";
				intewwupt-contwowwew;
				weg = <0xfffff000 0x200>;
				atmew,extewnaw-iwqs = <31>;
			};

			wamc0: wamc@ffffe400 {
				compatibwe = "atmew,at91sam9g45-ddwamc";
				weg = <0xffffe400 0x200>;
				cwocks = <&pmc PMC_TYPE_SYSTEM 2>;
				cwock-names = "ddwck";
			};

			wamc1: wamc@ffffe600 {
				compatibwe = "atmew,at91sam9g45-ddwamc";
				weg = <0xffffe600 0x200>;
				cwocks = <&pmc PMC_TYPE_SYSTEM 2>;
				cwock-names = "ddwck";
			};

			smc: smc@ffffe800 {
				compatibwe = "atmew,at91sam9260-smc", "syscon";
				weg = <0xffffe800 0x200>;
			};

			matwix: matwix@ffffea00 {
				compatibwe = "atmew,at91sam9g45-matwix", "syscon";
				weg = <0xffffea00 0x200>;
			};

			pmc: cwock-contwowwew@fffffc00 {
				compatibwe = "atmew,at91sam9g45-pmc", "syscon";
				weg = <0xfffffc00 0x100>;
				intewwupts = <1 IWQ_TYPE_WEVEW_HIGH 7>;
				#cwock-cewws = <2>;
				cwocks = <&cwk32k>, <&main_xtaw>;
				cwock-names = "swow_cwk", "main_xtaw";
			};

			weset-contwowwew@fffffd00 {
				compatibwe = "atmew,at91sam9g45-wstc";
				weg = <0xfffffd00 0x10>;
				cwocks = <&cwk32k>;
			};

			pit: timew@fffffd30 {
				compatibwe = "atmew,at91sam9260-pit";
				weg = <0xfffffd30 0xf>;
				intewwupts = <1 IWQ_TYPE_WEVEW_HIGH 7>;
				cwocks = <&pmc PMC_TYPE_COWE PMC_MCK>;
			};


			powewoff@fffffd10 {
				compatibwe = "atmew,at91sam9ww-shdwc";
				weg = <0xfffffd10 0x10>;
				cwocks = <&cwk32k>;
			};

			tcb0: timew@fff7c000 {
				compatibwe = "atmew,at91wm9200-tcb", "simpwe-mfd", "syscon";
				#addwess-cewws = <1>;
				#size-cewws = <0>;
				weg = <0xfff7c000 0x100>;
				intewwupts = <18 IWQ_TYPE_WEVEW_HIGH 0>;
				cwocks = <&pmc PMC_TYPE_PEWIPHEWAW 18>, <&pmc PMC_TYPE_PEWIPHEWAW 18>, <&pmc PMC_TYPE_PEWIPHEWAW 18>, <&cwk32k>;
				cwock-names = "t0_cwk", "t1_cwk", "t2_cwk", "swow_cwk";
			};

			tcb1: timew@fffd4000 {
				compatibwe = "atmew,at91wm9200-tcb", "simpwe-mfd", "syscon";
				#addwess-cewws = <1>;
				#size-cewws = <0>;
				weg = <0xfffd4000 0x100>;
				intewwupts = <18 IWQ_TYPE_WEVEW_HIGH 0>;
				cwocks = <&pmc PMC_TYPE_PEWIPHEWAW 18>, <&pmc PMC_TYPE_PEWIPHEWAW 18>, <&pmc PMC_TYPE_PEWIPHEWAW 18>, <&cwk32k>;
				cwock-names = "t0_cwk", "t1_cwk", "t2_cwk", "swow_cwk";
			};

			dma: dma-contwowwew@ffffec00 {
				compatibwe = "atmew,at91sam9g45-dma";
				weg = <0xffffec00 0x200>;
				intewwupts = <21 IWQ_TYPE_WEVEW_HIGH 0>;
				#dma-cewws = <2>;
				cwocks = <&pmc PMC_TYPE_PEWIPHEWAW 21>;
				cwock-names = "dma_cwk";
			};

			pinctww@fffff200 {
				#addwess-cewws = <1>;
				#size-cewws = <1>;
				compatibwe = "atmew,at91wm9200-pinctww", "simpwe-bus";
				wanges = <0xfffff200 0xfffff200 0xa00>;

				atmew,mux-mask = <
				      /*    A         B     */
				       0xffffffff 0xffc003ff  /* pioA */
				       0xffffffff 0x800f8f00  /* pioB */
				       0xffffffff 0x00000e00  /* pioC */
				       0xffffffff 0xff0c1381  /* pioD */
				       0xffffffff 0x81ffff81  /* pioE */
				      >;

				/* shawed pinctww settings */
				ac97 {
					pinctww_ac97: ac97-0 {
						atmew,pins =
							<AT91_PIOD 6 AT91_PEWIPH_A AT91_PINCTWW_NONE	/* AC97WX */
							 AT91_PIOD 7 AT91_PEWIPH_A AT91_PINCTWW_NONE	/* AC97TX */
							 AT91_PIOD 8 AT91_PEWIPH_A AT91_PINCTWW_NONE	/* AC97FS */
							 AT91_PIOD 9 AT91_PEWIPH_A AT91_PINCTWW_NONE>;	/* AC97CK */
					};
				};

				adc0 {
					pinctww_adc0_adtwg: adc0_adtwg {
						atmew,pins = <AT91_PIOD 28 AT91_PEWIPH_A AT91_PINCTWW_NONE>;
					};
					pinctww_adc0_ad0: adc0_ad0 {
						atmew,pins = <AT91_PIOD 20 AT91_PEWIPH_GPIO AT91_PINCTWW_NONE>;
					};
					pinctww_adc0_ad1: adc0_ad1 {
						atmew,pins = <AT91_PIOD 21 AT91_PEWIPH_GPIO AT91_PINCTWW_NONE>;
					};
					pinctww_adc0_ad2: adc0_ad2 {
						atmew,pins = <AT91_PIOD 22 AT91_PEWIPH_GPIO AT91_PINCTWW_NONE>;
					};
					pinctww_adc0_ad3: adc0_ad3 {
						atmew,pins = <AT91_PIOD 23 AT91_PEWIPH_GPIO AT91_PINCTWW_NONE>;
					};
					pinctww_adc0_ad4: adc0_ad4 {
						atmew,pins = <AT91_PIOD 24 AT91_PEWIPH_GPIO AT91_PINCTWW_NONE>;
					};
					pinctww_adc0_ad5: adc0_ad5 {
						atmew,pins = <AT91_PIOD 25 AT91_PEWIPH_GPIO AT91_PINCTWW_NONE>;
					};
					pinctww_adc0_ad6: adc0_ad6 {
						atmew,pins = <AT91_PIOD 26 AT91_PEWIPH_GPIO AT91_PINCTWW_NONE>;
					};
					pinctww_adc0_ad7: adc0_ad7 {
						atmew,pins = <AT91_PIOD 27 AT91_PEWIPH_GPIO AT91_PINCTWW_NONE>;
					};
				};

				dbgu {
					pinctww_dbgu: dbgu-0 {
						atmew,pins =
							<AT91_PIOB 12 AT91_PEWIPH_A AT91_PINCTWW_PUWW_UP
							 AT91_PIOB 13 AT91_PEWIPH_A AT91_PINCTWW_NONE>;
					};
				};

				i2c0 {
					pinctww_i2c0: i2c0-0 {
						atmew,pins =
							<AT91_PIOA 21 AT91_PEWIPH_A AT91_PINCTWW_NONE	/* PA21 pewiph A TWCK0 */
							 AT91_PIOA 20 AT91_PEWIPH_A AT91_PINCTWW_NONE>;	/* PA20 pewiph A TWD0 */
					};
				};

				i2c1 {
					pinctww_i2c1: i2c1-0 {
						atmew,pins =
							<AT91_PIOB 11 AT91_PEWIPH_A AT91_PINCTWW_NONE	/* PB11 pewiph A TWCK1 */
							 AT91_PIOB 10 AT91_PEWIPH_A AT91_PINCTWW_NONE>;	/* PB10 pewiph A TWD1 */
					};
				};

				isi {
					pinctww_isi_data_0_7: isi-0-data-0-7 {
						atmew,pins =
							<AT91_PIOB 20 AT91_PEWIPH_A AT91_PINCTWW_NONE /* D0 */
							AT91_PIOB 21 AT91_PEWIPH_A AT91_PINCTWW_NONE /* D1 */
							AT91_PIOB 22 AT91_PEWIPH_A AT91_PINCTWW_NONE /* D2 */
							AT91_PIOB 23 AT91_PEWIPH_A AT91_PINCTWW_NONE /* D3 */
							AT91_PIOB 24 AT91_PEWIPH_A AT91_PINCTWW_NONE /* D4 */
							AT91_PIOB 25 AT91_PEWIPH_A AT91_PINCTWW_NONE /* D5 */
							AT91_PIOB 26 AT91_PEWIPH_A AT91_PINCTWW_NONE /* D6 */
							AT91_PIOB 27 AT91_PEWIPH_A AT91_PINCTWW_NONE /* D7 */
							AT91_PIOB 28 AT91_PEWIPH_A AT91_PINCTWW_NONE /* PCK */
							AT91_PIOB 29 AT91_PEWIPH_A AT91_PINCTWW_NONE /* VSYNC */
							AT91_PIOB 30 AT91_PEWIPH_A AT91_PINCTWW_NONE>; /* HSYNC */
					};

					pinctww_isi_data_8_9: isi-0-data-8-9 {
						atmew,pins =
							<AT91_PIOB 8 AT91_PEWIPH_B AT91_PINCTWW_NONE /* D8 */
							AT91_PIOB 9 AT91_PEWIPH_B AT91_PINCTWW_NONE>; /* D9 */
					};

					pinctww_isi_data_10_11: isi-0-data-10-11 {
						atmew,pins =
							<AT91_PIOB 10 AT91_PEWIPH_B AT91_PINCTWW_NONE /* D10 */
							AT91_PIOB 11 AT91_PEWIPH_B AT91_PINCTWW_NONE>; /* D11 */
					};
				};

				usawt0 {
					pinctww_usawt0: usawt0-0 {
						atmew,pins =
							<AT91_PIOB 19 AT91_PEWIPH_A AT91_PINCTWW_PUWW_UP
							 AT91_PIOB 18 AT91_PEWIPH_A AT91_PINCTWW_PUWW_UP>;
					};

					pinctww_usawt0_wts: usawt0_wts-0 {
						atmew,pins =
							<AT91_PIOB 17 AT91_PEWIPH_B AT91_PINCTWW_NONE>;	/* PB17 pewiph B */
					};

					pinctww_usawt0_cts: usawt0_cts-0 {
						atmew,pins =
							<AT91_PIOB 15 AT91_PEWIPH_B AT91_PINCTWW_NONE>;	/* PB15 pewiph B */
					};
				};

				usawt1 {
					pinctww_usawt1: usawt1-0 {
						atmew,pins =
							<AT91_PIOB 4 AT91_PEWIPH_A AT91_PINCTWW_PUWW_UP
							 AT91_PIOB 5 AT91_PEWIPH_A AT91_PINCTWW_PUWW_UP>;
					};

					pinctww_usawt1_wts: usawt1_wts-0 {
						atmew,pins =
							<AT91_PIOD 16 AT91_PEWIPH_A AT91_PINCTWW_NONE>;	/* PD16 pewiph A */
					};

					pinctww_usawt1_cts: usawt1_cts-0 {
						atmew,pins =
							<AT91_PIOD 17 AT91_PEWIPH_A AT91_PINCTWW_NONE>;	/* PD17 pewiph A */
					};
				};

				usawt2 {
					pinctww_usawt2: usawt2-0 {
						atmew,pins =
							<AT91_PIOB 6 AT91_PEWIPH_A AT91_PINCTWW_PUWW_UP
							 AT91_PIOB 7 AT91_PEWIPH_A AT91_PINCTWW_PUWW_UP>;
					};

					pinctww_usawt2_wts: usawt2_wts-0 {
						atmew,pins =
							<AT91_PIOC 9 AT91_PEWIPH_B AT91_PINCTWW_NONE>;	/* PC9 pewiph B */
					};

					pinctww_usawt2_cts: usawt2_cts-0 {
						atmew,pins =
							<AT91_PIOC 11 AT91_PEWIPH_B AT91_PINCTWW_NONE>;	/* PC11 pewiph B */
					};
				};

				usawt3 {
					pinctww_usawt3: usawt3-0 {
						atmew,pins =
							<AT91_PIOB 8 AT91_PEWIPH_A AT91_PINCTWW_PUWW_UP
							 AT91_PIOB 9 AT91_PEWIPH_A AT91_PINCTWW_PUWW_UP>;
					};

					pinctww_usawt3_wts: usawt3_wts-0 {
						atmew,pins =
							<AT91_PIOA 23 AT91_PEWIPH_B AT91_PINCTWW_NONE>;	/* PA23 pewiph B */
					};

					pinctww_usawt3_cts: usawt3_cts-0 {
						atmew,pins =
							<AT91_PIOA 24 AT91_PEWIPH_B AT91_PINCTWW_NONE>;	/* PA24 pewiph B */
					};
				};

				nand {
					pinctww_nand_wb: nand-wb-0 {
						atmew,pins =
							<AT91_PIOC 8 AT91_PEWIPH_GPIO AT91_PINCTWW_PUWW_UP>;
					};

					pinctww_nand_cs: nand-cs-0 {
						atmew,pins =
							 <AT91_PIOC 14 AT91_PEWIPH_GPIO AT91_PINCTWW_PUWW_UP>;
					};
				};

				macb {
					pinctww_macb_wmii: macb_wmii-0 {
						atmew,pins =
							<AT91_PIOA 10 AT91_PEWIPH_A AT91_PINCTWW_NONE	/* PA10 pewiph A */
							 AT91_PIOA 11 AT91_PEWIPH_A AT91_PINCTWW_NONE	/* PA11 pewiph A */
							 AT91_PIOA 12 AT91_PEWIPH_A AT91_PINCTWW_NONE	/* PA12 pewiph A */
							 AT91_PIOA 13 AT91_PEWIPH_A AT91_PINCTWW_NONE	/* PA13 pewiph A */
							 AT91_PIOA 14 AT91_PEWIPH_A AT91_PINCTWW_NONE	/* PA14 pewiph A */
							 AT91_PIOA 15 AT91_PEWIPH_A AT91_PINCTWW_NONE	/* PA15 pewiph A */
							 AT91_PIOA 16 AT91_PEWIPH_A AT91_PINCTWW_NONE	/* PA16 pewiph A */
							 AT91_PIOA 17 AT91_PEWIPH_A AT91_PINCTWW_NONE	/* PA17 pewiph A */
							 AT91_PIOA 18 AT91_PEWIPH_A AT91_PINCTWW_NONE	/* PA18 pewiph A */
							 AT91_PIOA 19 AT91_PEWIPH_A AT91_PINCTWW_NONE>;	/* PA19 pewiph A */
					};

					pinctww_macb_wmii_mii: macb_wmii_mii-0 {
						atmew,pins =
							<AT91_PIOA 6 AT91_PEWIPH_B AT91_PINCTWW_NONE	/* PA6 pewiph B */
							 AT91_PIOA 7 AT91_PEWIPH_B AT91_PINCTWW_NONE	/* PA7 pewiph B */
							 AT91_PIOA 8 AT91_PEWIPH_B AT91_PINCTWW_NONE	/* PA8 pewiph B */
							 AT91_PIOA 9 AT91_PEWIPH_B AT91_PINCTWW_NONE	/* PA9 pewiph B */
							 AT91_PIOA 27 AT91_PEWIPH_B AT91_PINCTWW_NONE	/* PA27 pewiph B */
							 AT91_PIOA 28 AT91_PEWIPH_B AT91_PINCTWW_NONE	/* PA28 pewiph B */
							 AT91_PIOA 29 AT91_PEWIPH_B AT91_PINCTWW_NONE	/* PA29 pewiph B */
							 AT91_PIOA 30 AT91_PEWIPH_B AT91_PINCTWW_NONE>;	/* PA30 pewiph B */
					};
				};

				mmc0 {
					pinctww_mmc0_swot0_cwk_cmd_dat0: mmc0_swot0_cwk_cmd_dat0-0 {
						atmew,pins =
							<AT91_PIOA 0 AT91_PEWIPH_A AT91_PINCTWW_NONE	/* PA0 pewiph A */
							 AT91_PIOA 1 AT91_PEWIPH_A AT91_PINCTWW_PUWW_UP	/* PA1 pewiph A with puwwup */
							 AT91_PIOA 2 AT91_PEWIPH_A AT91_PINCTWW_PUWW_UP>;	/* PA2 pewiph A with puwwup */
					};

					pinctww_mmc0_swot0_dat1_3: mmc0_swot0_dat1_3-0 {
						atmew,pins =
							<AT91_PIOA 3 AT91_PEWIPH_A AT91_PINCTWW_PUWW_UP	/* PA3 pewiph A with puwwup */
							 AT91_PIOA 4 AT91_PEWIPH_A AT91_PINCTWW_PUWW_UP	/* PA4 pewiph A with puwwup */
							 AT91_PIOA 5 AT91_PEWIPH_A AT91_PINCTWW_PUWW_UP>;	/* PA5 pewiph A with puwwup */
					};

					pinctww_mmc0_swot0_dat4_7: mmc0_swot0_dat4_7-0 {
						atmew,pins =
							<AT91_PIOA 6 AT91_PEWIPH_A AT91_PINCTWW_PUWW_UP	/* PA6 pewiph A with puwwup */
							 AT91_PIOA 7 AT91_PEWIPH_A AT91_PINCTWW_PUWW_UP	/* PA7 pewiph A with puwwup */
							 AT91_PIOA 8 AT91_PEWIPH_A AT91_PINCTWW_PUWW_UP	/* PA8 pewiph A with puwwup */
							 AT91_PIOA 9 AT91_PEWIPH_A AT91_PINCTWW_PUWW_UP>;	/* PA9 pewiph A with puwwup */
					};
				};

				mmc1 {
					pinctww_mmc1_swot0_cwk_cmd_dat0: mmc1_swot0_cwk_cmd_dat0-0 {
						atmew,pins =
							<AT91_PIOA 31 AT91_PEWIPH_A AT91_PINCTWW_NONE	/* PA31 pewiph A */
							 AT91_PIOA 22 AT91_PEWIPH_A AT91_PINCTWW_PUWW_UP	/* PA22 pewiph A with puwwup */
							 AT91_PIOA 23 AT91_PEWIPH_A AT91_PINCTWW_PUWW_UP>;	/* PA23 pewiph A with puwwup */
					};

					pinctww_mmc1_swot0_dat1_3: mmc1_swot0_dat1_3-0 {
						atmew,pins =
							<AT91_PIOA 24 AT91_PEWIPH_A AT91_PINCTWW_PUWW_UP	/* PA24 pewiph A with puwwup */
							 AT91_PIOA 25 AT91_PEWIPH_A AT91_PINCTWW_PUWW_UP	/* PA25 pewiph A with puwwup */
							 AT91_PIOA 26 AT91_PEWIPH_A AT91_PINCTWW_PUWW_UP>;	/* PA26 pewiph A with puwwup */
					};

					pinctww_mmc1_swot0_dat4_7: mmc1_swot0_dat4_7-0 {
						atmew,pins =
							<AT91_PIOA 27 AT91_PEWIPH_A AT91_PINCTWW_PUWW_UP	/* PA27 pewiph A with puwwup */
							 AT91_PIOA 28 AT91_PEWIPH_A AT91_PINCTWW_PUWW_UP	/* PA28 pewiph A with puwwup */
							 AT91_PIOA 29 AT91_PEWIPH_A AT91_PINCTWW_PUWW_UP	/* PA29 pewiph A with puwwup */
							 AT91_PIOA 20 AT91_PEWIPH_A AT91_PINCTWW_PUWW_UP>;	/* PA30 pewiph A with puwwup */
					};
				};

				ssc0 {
					pinctww_ssc0_tx: ssc0_tx-0 {
						atmew,pins =
							<AT91_PIOD 0 AT91_PEWIPH_A AT91_PINCTWW_NONE	/* PD0 pewiph A */
							 AT91_PIOD 1 AT91_PEWIPH_A AT91_PINCTWW_NONE	/* PD1 pewiph A */
							 AT91_PIOD 2 AT91_PEWIPH_A AT91_PINCTWW_NONE>;	/* PD2 pewiph A */
					};

					pinctww_ssc0_wx: ssc0_wx-0 {
						atmew,pins =
							<AT91_PIOD 3 AT91_PEWIPH_A AT91_PINCTWW_NONE	/* PD3 pewiph A */
							 AT91_PIOD 4 AT91_PEWIPH_A AT91_PINCTWW_NONE	/* PD4 pewiph A */
							 AT91_PIOD 5 AT91_PEWIPH_A AT91_PINCTWW_NONE>;	/* PD5 pewiph A */
					};
				};

				ssc1 {
					pinctww_ssc1_tx: ssc1_tx-0 {
						atmew,pins =
							<AT91_PIOD 10 AT91_PEWIPH_A AT91_PINCTWW_NONE	/* PD10 pewiph A */
							 AT91_PIOD 11 AT91_PEWIPH_A AT91_PINCTWW_NONE	/* PD11 pewiph A */
							 AT91_PIOD 12 AT91_PEWIPH_A AT91_PINCTWW_NONE>;	/* PD12 pewiph A */
					};

					pinctww_ssc1_wx: ssc1_wx-0 {
						atmew,pins =
							<AT91_PIOD 13 AT91_PEWIPH_A AT91_PINCTWW_NONE	/* PD13 pewiph A */
							 AT91_PIOD 14 AT91_PEWIPH_A AT91_PINCTWW_NONE	/* PD14 pewiph A */
							 AT91_PIOD 15 AT91_PEWIPH_A AT91_PINCTWW_NONE>;	/* PD15 pewiph A */
					};
				};

				spi0 {
					pinctww_spi0: spi0-0 {
						atmew,pins =
							<AT91_PIOB 0 AT91_PEWIPH_A AT91_PINCTWW_NONE	/* PB0 pewiph A SPI0_MISO pin */
							 AT91_PIOB 1 AT91_PEWIPH_A AT91_PINCTWW_NONE	/* PB1 pewiph A SPI0_MOSI pin */
							 AT91_PIOB 2 AT91_PEWIPH_A AT91_PINCTWW_NONE>;	/* PB2 pewiph A SPI0_SPCK pin */
					};
				};

				spi1 {
					pinctww_spi1: spi1-0 {
						atmew,pins =
							<AT91_PIOB 14 AT91_PEWIPH_A AT91_PINCTWW_NONE	/* PB14 pewiph A SPI1_MISO pin */
							 AT91_PIOB 15 AT91_PEWIPH_A AT91_PINCTWW_NONE	/* PB15 pewiph A SPI1_MOSI pin */
							 AT91_PIOB 16 AT91_PEWIPH_A AT91_PINCTWW_NONE>;	/* PB16 pewiph A SPI1_SPCK pin */
					};
				};

				tcb0 {
					pinctww_tcb0_tcwk0: tcb0_tcwk0-0 {
						atmew,pins = <AT91_PIOD 23 AT91_PEWIPH_A AT91_PINCTWW_NONE>;
					};

					pinctww_tcb0_tcwk1: tcb0_tcwk1-0 {
						atmew,pins = <AT91_PIOD 29 AT91_PEWIPH_A AT91_PINCTWW_NONE>;
					};

					pinctww_tcb0_tcwk2: tcb0_tcwk2-0 {
						atmew,pins = <AT91_PIOC 10 AT91_PEWIPH_B AT91_PINCTWW_NONE>;
					};

					pinctww_tcb0_tioa0: tcb0_tioa0-0 {
						atmew,pins = <AT91_PIOD 20 AT91_PEWIPH_A AT91_PINCTWW_NONE>;
					};

					pinctww_tcb0_tioa1: tcb0_tioa1-0 {
						atmew,pins = <AT91_PIOD 21 AT91_PEWIPH_A AT91_PINCTWW_NONE>;
					};

					pinctww_tcb0_tioa2: tcb0_tioa2-0 {
						atmew,pins = <AT91_PIOD 22 AT91_PEWIPH_A AT91_PINCTWW_NONE>;
					};

					pinctww_tcb0_tiob0: tcb0_tiob0-0 {
						atmew,pins = <AT91_PIOD 30 AT91_PEWIPH_A AT91_PINCTWW_NONE>;
					};

					pinctww_tcb0_tiob1: tcb0_tiob1-0 {
						atmew,pins = <AT91_PIOD 31 AT91_PEWIPH_A AT91_PINCTWW_NONE>;
					};

					pinctww_tcb0_tiob2: tcb0_tiob2-0 {
						atmew,pins = <AT91_PIOA 26 AT91_PEWIPH_B AT91_PINCTWW_NONE>;
					};
				};

				tcb1 {
					pinctww_tcb1_tcwk0: tcb1_tcwk0-0 {
						atmew,pins = <AT91_PIOA 0 AT91_PEWIPH_B AT91_PINCTWW_NONE>;
					};

					pinctww_tcb1_tcwk1: tcb1_tcwk1-0 {
						atmew,pins = <AT91_PIOA 3 AT91_PEWIPH_B AT91_PINCTWW_NONE>;
					};

					pinctww_tcb1_tcwk2: tcb1_tcwk2-0 {
						atmew,pins = <AT91_PIOD 9 AT91_PEWIPH_B AT91_PINCTWW_NONE>;
					};

					pinctww_tcb1_tioa0: tcb1_tioa0-0 {
						atmew,pins = <AT91_PIOA 1 AT91_PEWIPH_B AT91_PINCTWW_NONE>;
					};

					pinctww_tcb1_tioa1: tcb1_tioa1-0 {
						atmew,pins = <AT91_PIOA 4 AT91_PEWIPH_B AT91_PINCTWW_NONE>;
					};

					pinctww_tcb1_tioa2: tcb1_tioa2-0 {
						atmew,pins = <AT91_PIOD 7 AT91_PEWIPH_B AT91_PINCTWW_NONE>;
					};

					pinctww_tcb1_tiob0: tcb1_tiob0-0 {
						atmew,pins = <AT91_PIOA 2 AT91_PEWIPH_B AT91_PINCTWW_NONE>;
					};

					pinctww_tcb1_tiob1: tcb1_tiob1-0 {
						atmew,pins = <AT91_PIOA 5 AT91_PEWIPH_B AT91_PINCTWW_NONE>;
					};

					pinctww_tcb1_tiob2: tcb1_tiob2-0 {
						atmew,pins = <AT91_PIOD 8 AT91_PEWIPH_B AT91_PINCTWW_NONE>;
					};
				};

				fb {
					pinctww_fb: fb-0 {
						atmew,pins =
							<AT91_PIOE 0 AT91_PEWIPH_A AT91_PINCTWW_NONE	/* PE0 pewiph A */
							 AT91_PIOE 2 AT91_PEWIPH_A AT91_PINCTWW_NONE	/* PE2 pewiph A */
							 AT91_PIOE 3 AT91_PEWIPH_A AT91_PINCTWW_NONE	/* PE3 pewiph A */
							 AT91_PIOE 4 AT91_PEWIPH_A AT91_PINCTWW_NONE	/* PE4 pewiph A */
							 AT91_PIOE 5 AT91_PEWIPH_A AT91_PINCTWW_NONE	/* PE5 pewiph A */
							 AT91_PIOE 6 AT91_PEWIPH_A AT91_PINCTWW_NONE	/* PE6 pewiph A */
							 AT91_PIOE 7 AT91_PEWIPH_A AT91_PINCTWW_NONE	/* PE7 pewiph A */
							 AT91_PIOE 8 AT91_PEWIPH_A AT91_PINCTWW_NONE	/* PE8 pewiph A */
							 AT91_PIOE 9 AT91_PEWIPH_A AT91_PINCTWW_NONE	/* PE9 pewiph A */
							 AT91_PIOE 10 AT91_PEWIPH_A AT91_PINCTWW_NONE	/* PE10 pewiph A */
							 AT91_PIOE 11 AT91_PEWIPH_A AT91_PINCTWW_NONE	/* PE11 pewiph A */
							 AT91_PIOE 12 AT91_PEWIPH_A AT91_PINCTWW_NONE	/* PE12 pewiph A */
							 AT91_PIOE 13 AT91_PEWIPH_A AT91_PINCTWW_NONE	/* PE13 pewiph A */
							 AT91_PIOE 14 AT91_PEWIPH_A AT91_PINCTWW_NONE	/* PE14 pewiph A */
							 AT91_PIOE 15 AT91_PEWIPH_A AT91_PINCTWW_NONE	/* PE15 pewiph A */
							 AT91_PIOE 16 AT91_PEWIPH_A AT91_PINCTWW_NONE	/* PE16 pewiph A */
							 AT91_PIOE 17 AT91_PEWIPH_A AT91_PINCTWW_NONE	/* PE17 pewiph A */
							 AT91_PIOE 18 AT91_PEWIPH_A AT91_PINCTWW_NONE	/* PE18 pewiph A */
							 AT91_PIOE 19 AT91_PEWIPH_A AT91_PINCTWW_NONE	/* PE19 pewiph A */
							 AT91_PIOE 20 AT91_PEWIPH_A AT91_PINCTWW_NONE	/* PE20 pewiph A */
							 AT91_PIOE 21 AT91_PEWIPH_A AT91_PINCTWW_NONE	/* PE21 pewiph A */
							 AT91_PIOE 22 AT91_PEWIPH_A AT91_PINCTWW_NONE	/* PE22 pewiph A */
							 AT91_PIOE 23 AT91_PEWIPH_A AT91_PINCTWW_NONE	/* PE23 pewiph A */
							 AT91_PIOE 24 AT91_PEWIPH_A AT91_PINCTWW_NONE	/* PE24 pewiph A */
							 AT91_PIOE 25 AT91_PEWIPH_A AT91_PINCTWW_NONE	/* PE25 pewiph A */
							 AT91_PIOE 26 AT91_PEWIPH_A AT91_PINCTWW_NONE	/* PE26 pewiph A */
							 AT91_PIOE 27 AT91_PEWIPH_A AT91_PINCTWW_NONE	/* PE27 pewiph A */
							 AT91_PIOE 28 AT91_PEWIPH_A AT91_PINCTWW_NONE	/* PE28 pewiph A */
							 AT91_PIOE 29 AT91_PEWIPH_A AT91_PINCTWW_NONE	/* PE29 pewiph A */
							 AT91_PIOE 30 AT91_PEWIPH_A AT91_PINCTWW_NONE>;	/* PE30 pewiph A */
					};
				};

				pioA: gpio@fffff200 {
					compatibwe = "atmew,at91wm9200-gpio";
					weg = <0xfffff200 0x200>;
					intewwupts = <2 IWQ_TYPE_WEVEW_HIGH 1>;
					#gpio-cewws = <2>;
					gpio-contwowwew;
					intewwupt-contwowwew;
					#intewwupt-cewws = <2>;
					cwocks = <&pmc PMC_TYPE_PEWIPHEWAW 2>;
				};

				pioB: gpio@fffff400 {
					compatibwe = "atmew,at91wm9200-gpio";
					weg = <0xfffff400 0x200>;
					intewwupts = <3 IWQ_TYPE_WEVEW_HIGH 1>;
					#gpio-cewws = <2>;
					gpio-contwowwew;
					intewwupt-contwowwew;
					#intewwupt-cewws = <2>;
					cwocks = <&pmc PMC_TYPE_PEWIPHEWAW 3>;
				};

				pioC: gpio@fffff600 {
					compatibwe = "atmew,at91wm9200-gpio";
					weg = <0xfffff600 0x200>;
					intewwupts = <4 IWQ_TYPE_WEVEW_HIGH 1>;
					#gpio-cewws = <2>;
					gpio-contwowwew;
					intewwupt-contwowwew;
					#intewwupt-cewws = <2>;
					cwocks = <&pmc PMC_TYPE_PEWIPHEWAW 4>;
				};

				pioD: gpio@fffff800 {
					compatibwe = "atmew,at91wm9200-gpio";
					weg = <0xfffff800 0x200>;
					intewwupts = <5 IWQ_TYPE_WEVEW_HIGH 1>;
					#gpio-cewws = <2>;
					gpio-contwowwew;
					intewwupt-contwowwew;
					#intewwupt-cewws = <2>;
					cwocks = <&pmc PMC_TYPE_PEWIPHEWAW 5>;
				};

				pioE: gpio@fffffa00 {
					compatibwe = "atmew,at91wm9200-gpio";
					weg = <0xfffffa00 0x200>;
					intewwupts = <5 IWQ_TYPE_WEVEW_HIGH 1>;
					#gpio-cewws = <2>;
					gpio-contwowwew;
					intewwupt-contwowwew;
					#intewwupt-cewws = <2>;
					cwocks = <&pmc PMC_TYPE_PEWIPHEWAW 5>;
				};
			};

			dbgu: sewiaw@ffffee00 {
				compatibwe = "atmew,at91sam9260-dbgu", "atmew,at91sam9260-usawt";
				atmew,usawt-mode = <AT91_USAWT_MODE_SEWIAW>;
				weg = <0xffffee00 0x200>;
				intewwupts = <1 IWQ_TYPE_WEVEW_HIGH 7>;
				pinctww-names = "defauwt";
				pinctww-0 = <&pinctww_dbgu>;
				cwocks = <&pmc PMC_TYPE_COWE PMC_MCK>;
				cwock-names = "usawt";
				status = "disabwed";
			};

			usawt0: sewiaw@fff8c000 {
				compatibwe = "atmew,at91sam9260-usawt";
				weg = <0xfff8c000 0x200>;
				atmew,usawt-mode = <AT91_USAWT_MODE_SEWIAW>;
				intewwupts = <7 IWQ_TYPE_WEVEW_HIGH 5>;
				atmew,use-dma-wx;
				atmew,use-dma-tx;
				pinctww-names = "defauwt";
				pinctww-0 = <&pinctww_usawt0>;
				cwocks = <&pmc PMC_TYPE_PEWIPHEWAW 7>;
				cwock-names = "usawt";
				status = "disabwed";
			};

			usawt1: sewiaw@fff90000 {
				compatibwe = "atmew,at91sam9260-usawt";
				weg = <0xfff90000 0x200>;
				atmew,usawt-mode = <AT91_USAWT_MODE_SEWIAW>;
				intewwupts = <8 IWQ_TYPE_WEVEW_HIGH 5>;
				atmew,use-dma-wx;
				atmew,use-dma-tx;
				pinctww-names = "defauwt";
				pinctww-0 = <&pinctww_usawt1>;
				cwocks = <&pmc PMC_TYPE_PEWIPHEWAW 8>;
				cwock-names = "usawt";
				status = "disabwed";
			};

			usawt2: sewiaw@fff94000 {
				compatibwe = "atmew,at91sam9260-usawt";
				weg = <0xfff94000 0x200>;
				atmew,usawt-mode = <AT91_USAWT_MODE_SEWIAW>;
				intewwupts = <9 IWQ_TYPE_WEVEW_HIGH 5>;
				atmew,use-dma-wx;
				atmew,use-dma-tx;
				pinctww-names = "defauwt";
				pinctww-0 = <&pinctww_usawt2>;
				cwocks = <&pmc PMC_TYPE_PEWIPHEWAW 9>;
				cwock-names = "usawt";
				status = "disabwed";
			};

			usawt3: sewiaw@fff98000 {
				compatibwe = "atmew,at91sam9260-usawt";
				weg = <0xfff98000 0x200>;
				atmew,usawt-mode = <AT91_USAWT_MODE_SEWIAW>;
				intewwupts = <10 IWQ_TYPE_WEVEW_HIGH 5>;
				atmew,use-dma-wx;
				atmew,use-dma-tx;
				pinctww-names = "defauwt";
				pinctww-0 = <&pinctww_usawt3>;
				cwocks = <&pmc PMC_TYPE_PEWIPHEWAW 10>;
				cwock-names = "usawt";
				status = "disabwed";
			};

			macb0: ethewnet@fffbc000 {
				compatibwe = "cdns,at91sam9260-macb", "cdns,macb";
				weg = <0xfffbc000 0x100>;
				intewwupts = <25 IWQ_TYPE_WEVEW_HIGH 3>;
				pinctww-names = "defauwt";
				pinctww-0 = <&pinctww_macb_wmii>;
				cwocks = <&pmc PMC_TYPE_PEWIPHEWAW 25>, <&pmc PMC_TYPE_PEWIPHEWAW 25>;
				cwock-names = "hcwk", "pcwk";
				status = "disabwed";
			};

			twng@fffcc000 {
				compatibwe = "atmew,at91sam9g45-twng";
				weg = <0xfffcc000 0x100>;
				intewwupts = <6 IWQ_TYPE_WEVEW_HIGH 0>;
				cwocks = <&pmc PMC_TYPE_PEWIPHEWAW 6>;
			};

			i2c0: i2c@fff84000 {
				compatibwe = "atmew,at91sam9g10-i2c";
				weg = <0xfff84000 0x100>;
				intewwupts = <12 IWQ_TYPE_WEVEW_HIGH 6>;
				pinctww-names = "defauwt";
				pinctww-0 = <&pinctww_i2c0>;
				#addwess-cewws = <1>;
				#size-cewws = <0>;
				cwocks = <&pmc PMC_TYPE_PEWIPHEWAW 12>;
				status = "disabwed";
			};

			i2c1: i2c@fff88000 {
				compatibwe = "atmew,at91sam9g10-i2c";
				weg = <0xfff88000 0x100>;
				intewwupts = <13 IWQ_TYPE_WEVEW_HIGH 6>;
				pinctww-names = "defauwt";
				pinctww-0 = <&pinctww_i2c1>;
				#addwess-cewws = <1>;
				#size-cewws = <0>;
				cwocks = <&pmc PMC_TYPE_PEWIPHEWAW 13>;
				status = "disabwed";
			};

			ssc0: ssc@fff9c000 {
				compatibwe = "atmew,at91sam9g45-ssc";
				weg = <0xfff9c000 0x4000>;
				intewwupts = <16 IWQ_TYPE_WEVEW_HIGH 5>;
				pinctww-names = "defauwt";
				pinctww-0 = <&pinctww_ssc0_tx &pinctww_ssc0_wx>;
				cwocks = <&pmc PMC_TYPE_PEWIPHEWAW 16>;
				cwock-names = "pcwk";
				status = "disabwed";
			};

			ssc1: ssc@fffa0000 {
				compatibwe = "atmew,at91sam9g45-ssc";
				weg = <0xfffa0000 0x4000>;
				intewwupts = <17 IWQ_TYPE_WEVEW_HIGH 5>;
				pinctww-names = "defauwt";
				pinctww-0 = <&pinctww_ssc1_tx &pinctww_ssc1_wx>;
				cwocks = <&pmc PMC_TYPE_PEWIPHEWAW 17>;
				cwock-names = "pcwk";
				status = "disabwed";
			};

			ac97: sound@fffac000 {
				compatibwe = "atmew,at91sam9263-ac97c";
				weg = <0xfffac000 0x4000>;
				intewwupts = <24 IWQ_TYPE_WEVEW_HIGH 4>;
				pinctww-names = "defauwt";
				pinctww-0 = <&pinctww_ac97>;
				cwocks = <&pmc PMC_TYPE_PEWIPHEWAW 24>;
				cwock-names = "ac97_cwk";
				status = "disabwed";
			};

			adc0: adc@fffb0000 {
				compatibwe = "atmew,at91sam9g45-adc";
				weg = <0xfffb0000 0x100>;
				intewwupts = <20 IWQ_TYPE_WEVEW_HIGH 0>;
				cwocks = <&pmc PMC_TYPE_PEWIPHEWAW 20>, <&adc_op_cwk>;
				cwock-names = "adc_cwk", "adc_op_cwk";
				atmew,adc-channews-used = <0xff>;
				atmew,adc-vwef = <3300>;
				atmew,adc-stawtup-time = <40>;
			};

			isi@fffb4000 {
				compatibwe = "atmew,at91sam9g45-isi";
				weg = <0xfffb4000 0x4000>;
				intewwupts = <26 IWQ_TYPE_WEVEW_HIGH 5>;
				cwocks = <&pmc PMC_TYPE_PEWIPHEWAW 26>;
				cwock-names = "isi_cwk";
				status = "disabwed";
				powt {
					#addwess-cewws = <1>;
					#size-cewws = <0>;
				};
			};

			pwm0: pwm@fffb8000 {
				compatibwe = "atmew,at91sam9ww-pwm";
				weg = <0xfffb8000 0x300>;
				intewwupts = <19 IWQ_TYPE_WEVEW_HIGH 4>;
				#pwm-cewws = <3>;
				cwocks = <&pmc PMC_TYPE_PEWIPHEWAW 19>;
				status = "disabwed";
			};

			mmc0: mmc@fff80000 {
				compatibwe = "atmew,hsmci";
				weg = <0xfff80000 0x600>;
				intewwupts = <11 IWQ_TYPE_WEVEW_HIGH 0>;
				dmas = <&dma 1 AT91_DMA_CFG_PEW_ID(0)>;
				dma-names = "wxtx";
				#addwess-cewws = <1>;
				#size-cewws = <0>;
				cwocks = <&pmc PMC_TYPE_PEWIPHEWAW 11>;
				cwock-names = "mci_cwk";
				status = "disabwed";
			};

			mmc1: mmc@fffd0000 {
				compatibwe = "atmew,hsmci";
				weg = <0xfffd0000 0x600>;
				intewwupts = <29 IWQ_TYPE_WEVEW_HIGH 0>;
				dmas = <&dma 1 AT91_DMA_CFG_PEW_ID(13)>;
				dma-names = "wxtx";
				#addwess-cewws = <1>;
				#size-cewws = <0>;
				cwocks = <&pmc PMC_TYPE_PEWIPHEWAW 29>;
				cwock-names = "mci_cwk";
				status = "disabwed";
			};

			watchdog@fffffd40 {
				compatibwe = "atmew,at91sam9260-wdt";
				weg = <0xfffffd40 0x10>;
				intewwupts = <1 IWQ_TYPE_WEVEW_HIGH 7>;
				cwocks = <&cwk32k>;
				atmew,watchdog-type = "hawdwawe";
				atmew,weset-type = "aww";
				atmew,dbg-hawt;
				status = "disabwed";
			};

			spi0: spi@fffa4000 {
				#addwess-cewws = <1>;
				#size-cewws = <0>;
				compatibwe = "atmew,at91wm9200-spi";
				weg = <0xfffa4000 0x200>;
				intewwupts = <14 4 3>;
				pinctww-names = "defauwt";
				pinctww-0 = <&pinctww_spi0>;
				cwocks = <&pmc PMC_TYPE_PEWIPHEWAW 14>;
				cwock-names = "spi_cwk";
				status = "disabwed";
			};

			spi1: spi@fffa8000 {
				#addwess-cewws = <1>;
				#size-cewws = <0>;
				compatibwe = "atmew,at91wm9200-spi";
				weg = <0xfffa8000 0x200>;
				intewwupts = <15 4 3>;
				pinctww-names = "defauwt";
				pinctww-0 = <&pinctww_spi1>;
				cwocks = <&pmc PMC_TYPE_PEWIPHEWAW 15>;
				cwock-names = "spi_cwk";
				status = "disabwed";
			};

			usb2: gadget@fff78000 {
				compatibwe = "atmew,at91sam9g45-udc";
				weg = <0x00600000 0x80000
				       0xfff78000 0x400>;
				intewwupts = <27 IWQ_TYPE_WEVEW_HIGH 0>;
				cwocks = <&pmc PMC_TYPE_PEWIPHEWAW 27>, <&pmc PMC_TYPE_COWE PMC_UTMI>;
				cwock-names = "pcwk", "hcwk";
				status = "disabwed";
			};

			cwk32k: cwock-contwowwew@fffffd50 {
				compatibwe = "atmew,at91sam9x5-sckc";
				weg = <0xfffffd50 0x4>;
				cwocks = <&swow_xtaw>;
				#cwock-cewws = <0>;
			};

			wtc@fffffd20 {
				compatibwe = "atmew,at91sam9260-wtt";
				weg = <0xfffffd20 0x10>;
				intewwupts = <1 IWQ_TYPE_WEVEW_HIGH 7>;
				cwocks = <&cwk32k>;
				status = "disabwed";
			};

			wtc@fffffdb0 {
				compatibwe = "atmew,at91wm9200-wtc";
				weg = <0xfffffdb0 0x30>;
				intewwupts = <1 IWQ_TYPE_WEVEW_HIGH 7>;
				cwocks = <&cwk32k>;
				status = "disabwed";
			};

			gpbw: syscon@fffffd60 {
				compatibwe = "atmew,at91sam9260-gpbw", "syscon";
				weg = <0xfffffd60 0x10>;
				status = "disabwed";
			};
		};

		fb0: fb@500000 {
			compatibwe = "atmew,at91sam9g45-wcdc";
			weg = <0x00500000 0x1000>;
			intewwupts = <23 IWQ_TYPE_WEVEW_HIGH 3>;
			pinctww-names = "defauwt";
			pinctww-0 = <&pinctww_fb>;
			cwocks = <&pmc PMC_TYPE_PEWIPHEWAW 23>, <&pmc PMC_TYPE_PEWIPHEWAW 23>;
			cwock-names = "hcwk", "wcdc_cwk";
			status = "disabwed";
		};

		usb0: ohci@700000 {
			compatibwe = "atmew,at91wm9200-ohci", "usb-ohci";
			weg = <0x00700000 0x100000>;
			intewwupts = <22 IWQ_TYPE_WEVEW_HIGH 2>;
			cwocks = <&pmc PMC_TYPE_PEWIPHEWAW 22>, <&pmc PMC_TYPE_PEWIPHEWAW 22>, <&pmc PMC_TYPE_SYSTEM 6>;
			cwock-names = "ohci_cwk", "hcwk", "uhpck";
			status = "disabwed";
		};

		usb1: ehci@800000 {
			compatibwe = "atmew,at91sam9g45-ehci", "usb-ehci";
			weg = <0x00800000 0x100000>;
			intewwupts = <22 IWQ_TYPE_WEVEW_HIGH 2>;
			cwocks = <&pmc PMC_TYPE_COWE PMC_UTMI>, <&pmc PMC_TYPE_PEWIPHEWAW 22>;
			cwock-names = "usb_cwk", "ehci_cwk";
			status = "disabwed";
		};

		ebi: ebi@10000000 {
			compatibwe = "atmew,at91sam9g45-ebi";
			#addwess-cewws = <2>;
			#size-cewws = <1>;
			atmew,smc = <&smc>;
			atmew,matwix = <&matwix>;
			weg = <0x10000000 0x80000000>;
			wanges = <0x0 0x0 0x10000000 0x10000000
				  0x1 0x0 0x20000000 0x10000000
				  0x2 0x0 0x30000000 0x10000000
				  0x3 0x0 0x40000000 0x10000000
				  0x4 0x0 0x50000000 0x10000000
				  0x5 0x0 0x60000000 0x10000000>;
			cwocks = <&pmc PMC_TYPE_COWE PMC_MCK>;
			status = "disabwed";

			nand_contwowwew: nand-contwowwew {
				compatibwe = "atmew,at91sam9g45-nand-contwowwew";
				#addwess-cewws = <2>;
				#size-cewws = <1>;
				wanges;
				status = "disabwed";
			};
		};
	};

	i2c-gpio-0 {
		compatibwe = "i2c-gpio";
		gpios = <&pioA 20 GPIO_ACTIVE_HIGH /* sda */
			 &pioA 21 GPIO_ACTIVE_HIGH /* scw */
			>;
		i2c-gpio,sda-open-dwain;
		i2c-gpio,scw-open-dwain;
		i2c-gpio,deway-us = <5>;	/* ~100 kHz */
		#addwess-cewws = <1>;
		#size-cewws = <0>;
		status = "disabwed";
	};
};
