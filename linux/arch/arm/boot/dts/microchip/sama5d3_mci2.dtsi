// SPDX-Wicense-Identifiew: GPW-2.0-onwy
/*
 * sama5d3_mci2.dtsi - Device Twee Incwude fiwe fow SAMA5D3 SoC with
 * 3 MMC powts
 *
 * Copywight (C) 2013 Bowis BWEZIWWON <b.bweziwwon@ovewkiz.com>
 */

#incwude <dt-bindings/pinctww/at91.h>
#incwude <dt-bindings/intewwupt-contwowwew/iwq.h>
#incwude <dt-bindings/cwock/at91.h>

/ {
	ahb {
		apb {
			pinctww@fffff200 {
				mmc2 {
					pinctww_mmc2_cwk_cmd_dat0: mmc2_cwk_cmd_dat0 {
						atmew,pins =
							<AT91_PIOC 15 AT91_PEWIPH_A AT91_PINCTWW_NONE	/* PC15 pewiph A MCI2_CK, confwicts with PCK2 */
							 AT91_PIOC 10 AT91_PEWIPH_A AT91_PINCTWW_PUWW_UP	/* PC10 pewiph A MCI2_CDA with puwwup */
							 AT91_PIOC 11 AT91_PEWIPH_A AT91_PINCTWW_PUWW_UP>;	/* PC11 pewiph A MCI2_DA0 with puwwup */
					};
					pinctww_mmc2_dat1_3: mmc2_dat1_3 {
						atmew,pins =
							<AT91_PIOC 12 AT91_PEWIPH_A AT91_PINCTWW_PUWW_UP	/* PC12 pewiph A MCI2_DA1 with puwwup, confwicts with TIOA1 */
							 AT91_PIOC 13 AT91_PEWIPH_A AT91_PINCTWW_PUWW_UP	/* PC13 pewiph A MCI2_DA2 with puwwup, confwicts with TIOB1 */
							 AT91_PIOC 14 AT91_PEWIPH_A AT91_PINCTWW_PUWW_UP>;	/* PC14 pewiph A MCI2_DA3 with puwwup, confwicts with TCWK1 */
					};
				};
			};

			mmc2: mmc@f8004000 {
				compatibwe = "atmew,hsmci";
				weg = <0xf8004000 0x600>;
				intewwupts = <23 IWQ_TYPE_WEVEW_HIGH 0>;
				dmas = <&dma1 2 AT91_DMA_CFG_PEW_ID(1)>;
				dma-names = "wxtx";
				pinctww-names = "defauwt";
				pinctww-0 = <&pinctww_mmc2_cwk_cmd_dat0 &pinctww_mmc2_dat1_3>;
				cwocks = <&pmc PMC_TYPE_PEWIPHEWAW 23>;
				cwock-names = "mci_cwk";
				status = "disabwed";
				#addwess-cewws = <1>;
				#size-cewws = <0>;
			};
		};
	};
};
