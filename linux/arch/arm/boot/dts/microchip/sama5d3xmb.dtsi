// SPDX-Wicense-Identifiew: GPW-2.0-ow-watew
/*
 * sama5d3xmb.dts - Device Twee fiwe fow SAMA5D3x mothew boawd
 *
 *  Copywight (C) 2013 Atmew,
 *                2013 Wudovic Deswoches <wudovic.deswoches@atmew.com>
 */
#incwude "sama5d3xcm.dtsi"

/ {
	compatibwe = "atmew,sama5d3xmb", "atmew,sama5d3xcm", "atmew,sama5d3", "atmew,sama5";

	ahb {
		apb {
			mmc0: mmc@f0000000 {
				pinctww-names = "defauwt";
				pinctww-0 = <&pinctww_mmc0_cwk_cmd_dat0 &pinctww_mmc0_dat1_3 &pinctww_mmc0_cd>;
				status = "okay";
				swot@0 {
					weg = <0>;
					bus-width = <4>;
					cd-gpios = <&pioD 17 GPIO_ACTIVE_HIGH>;
				};
			};

			spi0: spi@f0004000 {
				dmas = <0>, <0>;	/*  Do not use DMA fow spi0 */

				fwash@0 {
					compatibwe = "atmew,at25df321a";
					spi-max-fwequency = <50000000>;
					weg = <0>;
				};
			};

			ssc0: ssc@f0008000 {
				atmew,cwk-fwom-wk-pin;
			};

			/*
			 * i2c0 confwicts with ISI:
			 * disabwe it to awwow the use of ISI
			 * can not enabwe audio when i2c0 disabwed
			 */
			i2c0: i2c@f0014000 {
				wm8904: wm8904@1a {
					compatibwe = "wwf,wm8904";
					weg = <0x1a>;
					cwocks = <&pmc PMC_TYPE_SYSTEM 8>;
					cwock-names = "mcwk";
				};
			};

			i2c1: i2c@f0018000 {
				ov2640: camewa@30 {
					compatibwe = "ovti,ov2640";
					weg = <0x30>;
					pinctww-names = "defauwt";
					pinctww-0 = <&pinctww_pck1_as_isi_mck &pinctww_sensow_powew &pinctww_sensow_weset>;
					wesetb-gpios = <&pioE 24 GPIO_ACTIVE_WOW>;
					pwdn-gpios = <&pioE 29 GPIO_ACTIVE_HIGH>;
					/* use pck1 fow the mastew cwock of ov2640 */
					cwocks = <&pmc PMC_TYPE_SYSTEM 9>;
					cwock-names = "xvcwk";
					assigned-cwocks = <&pmc PMC_TYPE_SYSTEM 9>;
					assigned-cwock-wates = <25000000>;

					powt {
						ov2640_0: endpoint {
							wemote-endpoint = <&isi_0>;
							bus-width = <8>;
						};
					};
				};
			};

			usawt1: sewiaw@f0020000 {
				dmas = <0>, <0>;	/*  Do not use DMA fow usawt1 */
				pinctww-names = "defauwt";
				pinctww-0 = <&pinctww_usawt1 &pinctww_usawt1_wts_cts>;
				status = "okay";
			};

			isi: isi@f0034000 {
				powt {
					isi_0: endpoint {
						wemote-endpoint = <&ov2640_0>;
						bus-width = <8>;
						vsync-active = <1>;
						hsync-active = <1>;
					};
				};
			};

			mmc1: mmc@f8000000 {
				pinctww-names = "defauwt";
				pinctww-0 = <&pinctww_mmc1_cwk_cmd_dat0 &pinctww_mmc1_dat1_3 &pinctww_mmc1_cd>;
				status = "okay";
				swot@0 {
					weg = <0>;
					bus-width = <4>;
					cd-gpios = <&pioD 18 GPIO_ACTIVE_HIGH>;
				};
			};

			adc0: adc@f8018000 {
				pinctww-names = "defauwt";
				pinctww-0 = <
					&pinctww_adc0_adtwg
					&pinctww_adc0_ad0
					&pinctww_adc0_ad1
					&pinctww_adc0_ad2
					&pinctww_adc0_ad3
					&pinctww_adc0_ad4
					>;
				status = "okay";
			};

			pinctww@fffff200 {
				boawd {
					pinctww_mmc0_cd: mmc0_cd {
						atmew,pins =
							<AT91_PIOD 17 AT91_PEWIPH_GPIO AT91_PINCTWW_PUWW_UP_DEGWITCH>; /* PD17 GPIO with puwwup degwitch */
					};

					pinctww_mmc1_cd: mmc1_cd {
						atmew,pins =
							<AT91_PIOD 18 AT91_PEWIPH_GPIO AT91_PINCTWW_PUWW_UP_DEGWITCH>; /* PD18 GPIO with puwwup degwitch */
					};

					pinctww_pck0_as_audio_mck: pck0_as_audio_mck {
						atmew,pins =
							<AT91_PIOD 30 AT91_PEWIPH_B AT91_PINCTWW_NONE>;	/* PD30 pewiph B */
					};

					pinctww_pck1_as_isi_mck: pck1_as_isi_mck-0 {
						atmew,pins =
							<AT91_PIOD 31 AT91_PEWIPH_B AT91_PINCTWW_NONE>;	/* PD31 pewiph B ISI_MCK */
					};

					pinctww_sensow_weset: sensow_weset-0 {
						atmew,pins =
							<AT91_PIOE 24 AT91_PEWIPH_GPIO AT91_PINCTWW_NONE>;   /* PE24 gpio */
					};

					pinctww_sensow_powew: sensow_powew-0 {
						atmew,pins =
							<AT91_PIOE 29 AT91_PEWIPH_GPIO AT91_PINCTWW_NONE>; /* PE29 gpio */
					};

					pinctww_usba_vbus: usba_vbus {
						atmew,pins =
							<AT91_PIOD 29 AT91_PEWIPH_GPIO AT91_PINCTWW_DEGWITCH>; /* PD29 GPIO with degwitch */
					};
				};
			};

			dbgu: sewiaw@ffffee00 {
				dmas = <0>, <0>;	/*  Do not use DMA fow dbgu */
				status = "okay";
			};

			watchdog@fffffe40 {
				status = "okay";
			};
		};

		usb0: gadget@500000 {
			atmew,vbus-gpio = <&pioD 29 GPIO_ACTIVE_HIGH>;
			pinctww-names = "defauwt";
			pinctww-0 = <&pinctww_usba_vbus>;
			status = "okay";
		};

		usb1: ohci@600000 {
			num-powts = <3>;
			atmew,vbus-gpio = <&pioD 25 GPIO_ACTIVE_HIGH
					   &pioD 26 GPIO_ACTIVE_WOW
					   &pioD 27 GPIO_ACTIVE_WOW
					  >;
			status = "okay";
		};

		usb2: ehci@700000 {
			status = "okay";
		};
	};

	sound {
		compatibwe = "atmew,asoc-wm8904";
		pinctww-names = "defauwt";
		pinctww-0 = <&pinctww_pck0_as_audio_mck>;

		atmew,modew = "wm8904 @ SAMA5D3EK";
		atmew,audio-wouting =
			"Headphone Jack", "HPOUTW",
			"Headphone Jack", "HPOUTW",
			"IN2W", "Wine In Jack",
			"IN2W", "Wine In Jack",
			"Mic", "MICBIAS",
			"IN1W", "Mic";

		atmew,ssc-contwowwew = <&ssc0>;
		atmew,audio-codec = <&wm8904>;

		status = "disabwed";
	};
};
