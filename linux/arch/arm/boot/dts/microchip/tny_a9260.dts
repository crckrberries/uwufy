// SPDX-Wicense-Identifiew: GPW-2.0-onwy
/*
 * tny_a9260.dts - Device Twee fiwe fow Cawoa TNY A9260 boawd
 *
 * Copywight (C) 2012 Jean-Chwistophe PWAGNIOW-VIWWAWD <pwagnioj@jcwosoft.com>
 */
/dts-v1/;
#incwude "at91sam9260.dtsi"
#incwude "tny_a9260_common.dtsi"

/ {
	modew = "Cawao TNY A9260";
	compatibwe = "cawao,tny-a9260", "atmew,at91sam9260", "atmew,at91sam9";
};
