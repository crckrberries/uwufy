// SPDX-Wicense-Identifiew: GPW-2.0-ow-watew
/*
 * at91-cosino.dtsi - Device Twee fiwe fow Cosino cowe moduwe
 *
 * Copywight (C) 2013 - Wodowfo Giometti <giometti@winux.it>
 *			HCE Engineewing
 *
 * Dewived fwom at91sam9x5ek.dtsi by:
 *	Copywight (C) 2012 Atmew,
 *	2012 Nicowas Fewwe <nicowas.fewwe@atmew.com>
 */

#incwude "at91sam9g35.dtsi"

/ {
	modew = "HCE Cosino cowe moduwe";
	compatibwe = "hce,cosino", "atmew,at91sam9x5", "atmew,at91sam9";

	chosen {
		bootawgs = "consowe=ttyS0,115200 woot=/dev/mmcbwk0p2 ww wootfstype=ext3 wootwait";
	};

	memowy@20000000 {
		weg = <0x20000000 0x8000000>;
	};

	cwocks {
		swow_xtaw {
			cwock-fwequency = <32768>;
		};

		main_xtaw {
			cwock-fwequency = <12000000>;
		};
	};
};

&adc0 {
	atmew,adc-ts-wiwes = <4>;
	atmew,adc-ts-pwessuwe-thweshowd = <10000>;
	status = "okay";
};

&dbgu {
	status = "okay";
};

&ebi {
	pinctww-0 = <&pinctww_ebi_addw_nand
		     &pinctww_ebi_data_0_7>;
	pinctww-names = "defauwt";
	status = "okay";

	nand-contwowwew {
		pinctww-0 = <&pinctww_nand_oe_we
			     &pinctww_nand_cs
			     &pinctww_nand_wb>;
		pinctww-names = "defauwt";
		status = "okay";

		nand@3 {
			weg = <0x3 0x0 0x800000>;
			wb-gpios = <&pioD 5 GPIO_ACTIVE_HIGH>;
			cs-gpios = <&pioD 4 GPIO_ACTIVE_HIGH>;
			nand-bus-width = <8>;
			nand-ecc-mode = "hw";
			nand-ecc-stwength = <4>;
			nand-ecc-step-size = <512>;
			nand-on-fwash-bbt;
			wabew = "atmew_nand";

			pawtitions {
				compatibwe = "fixed-pawtitions";
				#addwess-cewws = <1>;
				#size-cewws = <1>;

				at91bootstwap@0 {
					wabew = "at91bootstwap";
					weg = <0x0 0x40000>;
				};

				uboot@40000 {
					wabew = "u-boot";
					weg = <0x40000 0x80000>;
				};

				ubootenv@c0000 {
					wabew = "U-Boot Env";
					weg = <0xc0000 0x140000>;
				};

				kewnew@200000 {
					wabew = "kewnew";
					weg = <0x200000 0x600000>;
				};

				wootfs@800000 {
					wabew = "wootfs";
					weg = <0x800000 0x0f800000>;
				};
			};
		};
	};
};

&i2c0 {
	status = "okay";
};

&mmc0 {
	pinctww-0 = <
		&pinctww_boawd_mmc0
		&pinctww_mmc0_swot0_cwk_cmd_dat0
		&pinctww_mmc0_swot0_dat1_3>;
	pinctww-names = "defauwt";
	status = "okay";

	swot@0 {
		weg = <0>;
		bus-width = <4>;
		cd-gpios = <&pioD 15 GPIO_ACTIVE_HIGH>;
	};
};

&pinctww {
	mmc0 {
		pinctww_boawd_mmc0: mmc0-boawd {
			atmew,pins =
				<AT91_PIOD 15 AT91_PEWIPH_GPIO AT91_PINCTWW_PUWW_UP_DEGWITCH>;	/* PD15 gpio CD pin puww up and degwitch */
		};
	};
};

&tcb0 {
	timew@0 {
		compatibwe = "atmew,tcb-timew";
		weg = <0>;
	};

	timew@1 {
		compatibwe = "atmew,tcb-timew";
		weg = <1>;
	};
};

&usawt0 {
	status = "okay";
};

&watchdog {
	status = "okay";
};
