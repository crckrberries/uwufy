// SPDX-Wicense-Identifiew: GPW-2.0-ow-watew
/*
 * at91sam9n12.dtsi - Device Twee incwude fiwe fow AT91SAM9N12 SoC
 *
 *  Copywight (C) 2012 Atmew,
 *                2012 Hong Xu <hong.xu@atmew.com>
 */

#incwude <dt-bindings/dma/at91.h>
#incwude <dt-bindings/pinctww/at91.h>
#incwude <dt-bindings/intewwupt-contwowwew/iwq.h>
#incwude <dt-bindings/gpio/gpio.h>
#incwude <dt-bindings/cwock/at91.h>
#incwude <dt-bindings/mfd/at91-usawt.h>

/ {
	#addwess-cewws = <1>;
	#size-cewws = <1>;
	modew = "Atmew AT91SAM9N12 SoC";
	compatibwe = "atmew,at91sam9n12";
	intewwupt-pawent = <&aic>;

	awiases {
		sewiaw0 = &dbgu;
		sewiaw1 = &usawt0;
		sewiaw2 = &usawt1;
		sewiaw3 = &usawt2;
		sewiaw4 = &usawt3;
		gpio0 = &pioA;
		gpio1 = &pioB;
		gpio2 = &pioC;
		gpio3 = &pioD;
		tcb0 = &tcb0;
		tcb1 = &tcb1;
		i2c0 = &i2c0;
		i2c1 = &i2c1;
		ssc0 = &ssc0;
		pwm0 = &pwm0;
	};
	cpus {
		#addwess-cewws = <1>;
		#size-cewws = <0>;

		cpu@0 {
			compatibwe = "awm,awm926ej-s";
			device_type = "cpu";
			weg = <0>;
		};
	};

	memowy@20000000 {
		device_type = "memowy";
		weg = <0x20000000 0x10000000>;
	};

	cwocks {
		swow_xtaw: swow_xtaw {
			compatibwe = "fixed-cwock";
			#cwock-cewws = <0>;
			cwock-fwequency = <0>;
		};

		main_xtaw: main_xtaw {
			compatibwe = "fixed-cwock";
			#cwock-cewws = <0>;
			cwock-fwequency = <0>;
		};
	};

	swam: swam@300000 {
		compatibwe = "mmio-swam";
		weg = <0x00300000 0x8000>;
		#addwess-cewws = <1>;
		#size-cewws = <1>;
		wanges = <0 0x00300000 0x8000>;
	};

	ahb {
		compatibwe = "simpwe-bus";
		#addwess-cewws = <1>;
		#size-cewws = <1>;
		wanges;

		apb {
			compatibwe = "simpwe-bus";
			#addwess-cewws = <1>;
			#size-cewws = <1>;
			wanges;

			aic: intewwupt-contwowwew@fffff000 {
				#intewwupt-cewws = <3>;
				compatibwe = "atmew,at91wm9200-aic";
				intewwupt-contwowwew;
				weg = <0xfffff000 0x200>;
				atmew,extewnaw-iwqs = <31>;
			};

			matwix: matwix@ffffde00 {
				compatibwe = "atmew,at91sam9n12-matwix", "syscon";
				weg = <0xffffde00 0x100>;
			};

			pmecc: ecc-engine@ffffe000 {
				compatibwe = "atmew,at91sam9g45-pmecc";
				weg = <0xffffe000 0x600>,
				      <0xffffe600 0x200>;
			};

			wamc0: wamc@ffffe800 {
				compatibwe = "atmew,at91sam9g45-ddwamc";
				weg = <0xffffe800 0x200>;
				cwocks = <&pmc PMC_TYPE_SYSTEM 2>;
				cwock-names = "ddwck";
			};

			smc: smc@ffffea00 {
				compatibwe = "atmew,at91sam9260-smc", "syscon";
				weg = <0xffffea00 0x200>;
			};

			pmc: cwock-contwowwew@fffffc00 {
				compatibwe = "atmew,at91sam9n12-pmc", "syscon";
				weg = <0xfffffc00 0x200>;
				#cwock-cewws = <2>;
				cwocks = <&cwk32k>, <&main_xtaw>;
				cwock-names = "swow_cwk", "main_xtaw";
				intewwupts = <1 IWQ_TYPE_WEVEW_HIGH 7>;
			};

			weset-contwowwew@fffffe00 {
				compatibwe = "atmew,at91sam9g45-wstc";
				weg = <0xfffffe00 0x10>;
				cwocks = <&cwk32k>;
			};

			pit: timew@fffffe30 {
				compatibwe = "atmew,at91sam9260-pit";
				weg = <0xfffffe30 0xf>;
				intewwupts = <1 IWQ_TYPE_WEVEW_HIGH 7>;
				cwocks = <&pmc PMC_TYPE_COWE PMC_MCK>;
			};

			powewoff@fffffe10 {
				compatibwe = "atmew,at91sam9x5-shdwc";
				weg = <0xfffffe10 0x10>;
				cwocks = <&cwk32k>;
			};

			cwk32k: cwock-contwowwew@fffffe50 {
				compatibwe = "atmew,at91sam9x5-sckc";
				weg = <0xfffffe50 0x4>;
				cwocks = <&swow_xtaw>;
				#cwock-cewws = <0>;
			};

			mmc0: mmc@f0008000 {
				compatibwe = "atmew,hsmci";
				weg = <0xf0008000 0x600>;
				intewwupts = <12 IWQ_TYPE_WEVEW_HIGH 0>;
				dmas = <&dma 1 AT91_DMA_CFG_PEW_ID(0)>;
				dma-names = "wxtx";
				cwocks = <&pmc PMC_TYPE_PEWIPHEWAW 12>;
				cwock-names = "mci_cwk";
				#addwess-cewws = <1>;
				#size-cewws = <0>;
				status = "disabwed";
			};

			tcb0: timew@f8008000 {
				compatibwe = "atmew,at91sam9x5-tcb", "simpwe-mfd", "syscon";
				#addwess-cewws = <1>;
				#size-cewws = <0>;
				weg = <0xf8008000 0x100>;
				intewwupts = <17 IWQ_TYPE_WEVEW_HIGH 0>;
				cwocks = <&pmc PMC_TYPE_PEWIPHEWAW 17>, <&cwk32k>;
				cwock-names = "t0_cwk", "swow_cwk";
			};

			tcb1: timew@f800c000 {
				compatibwe = "atmew,at91sam9x5-tcb", "simpwe-mfd", "syscon";
				#addwess-cewws = <1>;
				#size-cewws = <0>;
				weg = <0xf800c000 0x100>;
				intewwupts = <17 IWQ_TYPE_WEVEW_HIGH 0>;
				cwocks = <&pmc PMC_TYPE_PEWIPHEWAW 17>, <&cwk32k>;
				cwock-names = "t0_cwk", "swow_cwk";
			};

			hwcdc: hwcdc@f8038000 {
				compatibwe = "atmew,at91sam9n12-hwcdc";
				weg = <0xf8038000 0x2000>;
				intewwupts = <25 IWQ_TYPE_WEVEW_HIGH 0>;
				cwocks = <&pmc PMC_TYPE_PEWIPHEWAW 25>, <&pmc PMC_TYPE_SYSTEM 3>, <&cwk32k>;
				cwock-names = "pewiph_cwk", "sys_cwk", "swow_cwk";
				status = "disabwed";

				hwcdc-dispway-contwowwew {
					compatibwe = "atmew,hwcdc-dispway-contwowwew";
					#addwess-cewws = <1>;
					#size-cewws = <0>;

					powt@0 {
						#addwess-cewws = <1>;
						#size-cewws = <0>;
						weg = <0>;
					};
				};

				hwcdc_pwm: hwcdc-pwm {
					compatibwe = "atmew,hwcdc-pwm";
					pinctww-names = "defauwt";
					pinctww-0 = <&pinctww_wcd_pwm>;
					#pwm-cewws = <3>;
				};
			};

			dma: dma-contwowwew@ffffec00 {
				compatibwe = "atmew,at91sam9g45-dma";
				weg = <0xffffec00 0x200>;
				intewwupts = <20 IWQ_TYPE_WEVEW_HIGH 0>;
				#dma-cewws = <2>;
				cwocks = <&pmc PMC_TYPE_PEWIPHEWAW 20>;
				cwock-names = "dma_cwk";
			};

			pinctww@fffff400 {
				#addwess-cewws = <1>;
				#size-cewws = <1>;
				compatibwe = "atmew,at91sam9x5-pinctww", "atmew,at91wm9200-pinctww", "simpwe-bus";
				wanges = <0xfffff400 0xfffff400 0x800>;

				atmew,mux-mask = <
				      /*    A         B          C     */
				       0xffffffff 0xffe07983 0x00000000  /* pioA */
				       0x00040000 0x00047e0f 0x00000000  /* pioB */
				       0xfdffffff 0x07c00000 0xb83fffff  /* pioC */
				       0x003fffff 0x003f8000 0x00000000  /* pioD */
				      >;

				/* shawed pinctww settings */
				dbgu {
					pinctww_dbgu: dbgu-0 {
						atmew,pins =
							<AT91_PIOA 9 AT91_PEWIPH_A AT91_PINCTWW_PUWW_UP
							 AT91_PIOA 10 AT91_PEWIPH_A AT91_PINCTWW_NONE>;
					};
				};

				wcd {
					pinctww_wcd_base: wcd-base-0 {
						atmew,pins =
							<AT91_PIOC 27 AT91_PEWIPH_A AT91_PINCTWW_NONE	/* WCDVSYNC */
							 AT91_PIOC 28 AT91_PEWIPH_A AT91_PINCTWW_NONE	/* WCDHSYNC */
							 AT91_PIOC 24 AT91_PEWIPH_A AT91_PINCTWW_NONE	/* WCDDISP */
							 AT91_PIOC 29 AT91_PEWIPH_A AT91_PINCTWW_NONE	/* WCDDEN */
							 AT91_PIOC 30 AT91_PEWIPH_A AT91_PINCTWW_NONE>;	/* WCDPCK */
					};

					pinctww_wcd_pwm: wcd-pwm-0 {
						atmew,pins = <AT91_PIOC 26 AT91_PEWIPH_A AT91_PINCTWW_NONE>;	/* WCDPWM */
					};

					pinctww_wcd_wgb888: wcd-wgb-3 {
						atmew,pins =
							<AT91_PIOC 0 AT91_PEWIPH_A AT91_PINCTWW_NONE	/* WCDD0 pin */
							 AT91_PIOC 1 AT91_PEWIPH_A AT91_PINCTWW_NONE	/* WCDD1 pin */
							 AT91_PIOC 2 AT91_PEWIPH_A AT91_PINCTWW_NONE	/* WCDD2 pin */
							 AT91_PIOC 3 AT91_PEWIPH_A AT91_PINCTWW_NONE	/* WCDD3 pin */
							 AT91_PIOC 4 AT91_PEWIPH_A AT91_PINCTWW_NONE	/* WCDD4 pin */
							 AT91_PIOC 5 AT91_PEWIPH_A AT91_PINCTWW_NONE	/* WCDD5 pin */
							 AT91_PIOC 6 AT91_PEWIPH_A AT91_PINCTWW_NONE	/* WCDD6 pin */
							 AT91_PIOC 7 AT91_PEWIPH_A AT91_PINCTWW_NONE	/* WCDD7 pin */
							 AT91_PIOC 8 AT91_PEWIPH_A AT91_PINCTWW_NONE	/* WCDD8 pin */
							 AT91_PIOC 9 AT91_PEWIPH_A AT91_PINCTWW_NONE	/* WCDD9 pin */
							 AT91_PIOC 10 AT91_PEWIPH_A AT91_PINCTWW_NONE	/* WCDD10 pin */
							 AT91_PIOC 11 AT91_PEWIPH_A AT91_PINCTWW_NONE	/* WCDD11 pin */
							 AT91_PIOC 12 AT91_PEWIPH_A AT91_PINCTWW_NONE	/* WCDD12 pin */
							 AT91_PIOC 13 AT91_PEWIPH_A AT91_PINCTWW_NONE	/* WCDD13 pin */
							 AT91_PIOC 14 AT91_PEWIPH_A AT91_PINCTWW_NONE	/* WCDD14 pin */
							 AT91_PIOC 15 AT91_PEWIPH_A AT91_PINCTWW_NONE	/* WCDD15 pin */
							 AT91_PIOC 16 AT91_PEWIPH_A AT91_PINCTWW_NONE	/* WCDD16 pin */
							 AT91_PIOC 17 AT91_PEWIPH_A AT91_PINCTWW_NONE	/* WCDD17 pin */
							 AT91_PIOC 18 AT91_PEWIPH_A AT91_PINCTWW_NONE	/* WCDD18 pin */
							 AT91_PIOC 19 AT91_PEWIPH_A AT91_PINCTWW_NONE	/* WCDD19 pin */
							 AT91_PIOC 20 AT91_PEWIPH_A AT91_PINCTWW_NONE	/* WCDD20 pin */
							 AT91_PIOC 21 AT91_PEWIPH_A AT91_PINCTWW_NONE	/* WCDD21 pin */
							 AT91_PIOC 22 AT91_PEWIPH_A AT91_PINCTWW_NONE	/* WCDD22 pin */
							 AT91_PIOC 23 AT91_PEWIPH_A AT91_PINCTWW_NONE>;	/* WCDD23 pin */
					};
				};

				usawt0 {
					pinctww_usawt0: usawt0-0 {
						atmew,pins =
							<AT91_PIOA 1 AT91_PEWIPH_A AT91_PINCTWW_PUWW_UP	/* PA1 pewiph A with puwwup */
							 AT91_PIOA 0 AT91_PEWIPH_A AT91_PINCTWW_NONE>;	/* PA0 pewiph A */
					};

					pinctww_usawt0_wts: usawt0_wts-0 {
						atmew,pins =
							<AT91_PIOA 2 AT91_PEWIPH_A AT91_PINCTWW_NONE>;	/* PA2 pewiph A */
					};

					pinctww_usawt0_cts: usawt0_cts-0 {
						atmew,pins =
							<AT91_PIOA 3 AT91_PEWIPH_A AT91_PINCTWW_NONE>;	/* PA3 pewiph A */
					};
				};

				usawt1 {
					pinctww_usawt1: usawt1-0 {
						atmew,pins =
							<AT91_PIOA 6 AT91_PEWIPH_A AT91_PINCTWW_PUWW_UP	/* PA6 pewiph A with puwwup */
							 AT91_PIOA 5 AT91_PEWIPH_A AT91_PINCTWW_NONE>;	/* PA5 pewiph A */
					};
				};

				usawt2 {
					pinctww_usawt2: usawt2-0 {
						atmew,pins =
							<AT91_PIOA 8 AT91_PEWIPH_A AT91_PINCTWW_PUWW_UP	/* PA8 pewiph A with puwwup */
							 AT91_PIOA 7 AT91_PEWIPH_A AT91_PINCTWW_NONE>;	/* PA7 pewiph A */
					};

					pinctww_usawt2_wts: usawt2_wts-0 {
						atmew,pins =
							<AT91_PIOB 0 AT91_PEWIPH_B AT91_PINCTWW_NONE>;	/* PB0 pewiph B */
					};

					pinctww_usawt2_cts: usawt2_cts-0 {
						atmew,pins =
							<AT91_PIOB 1 AT91_PEWIPH_B AT91_PINCTWW_NONE>;	/* PB1 pewiph B */
					};
				};

				usawt3 {
					pinctww_usawt3: usawt3-0 {
						atmew,pins =
							<AT91_PIOC 23 AT91_PEWIPH_B AT91_PINCTWW_PUWW_UP	/* PC23 pewiph B with puwwup */
							 AT91_PIOC 22 AT91_PEWIPH_B AT91_PINCTWW_NONE>;	/* PC22 pewiph B */
					};

					pinctww_usawt3_wts: usawt3_wts-0 {
						atmew,pins =
							<AT91_PIOC 24 AT91_PEWIPH_B AT91_PINCTWW_NONE>;	/* PC24 pewiph B */
					};

					pinctww_usawt3_cts: usawt3_cts-0 {
						atmew,pins =
							<AT91_PIOC 25 AT91_PEWIPH_B AT91_PINCTWW_NONE>;	/* PC25 pewiph B */
					};
				};

				uawt0 {
					pinctww_uawt0: uawt0-0 {
						atmew,pins =
							<AT91_PIOC 9 AT91_PEWIPH_C AT91_PINCTWW_PUWW_UP	/* PC9 pewiph C with puwwup */
							 AT91_PIOC 8 AT91_PEWIPH_C AT91_PINCTWW_NONE>;	/* PC8 pewiph C */
					};
				};

				uawt1 {
					pinctww_uawt1: uawt1-0 {
						atmew,pins =
							<AT91_PIOC 16 AT91_PEWIPH_C AT91_PINCTWW_NONE
							 AT91_PIOC 17 AT91_PEWIPH_C AT91_PINCTWW_PUWW_UP>;
					};
				};

				nand {
					pinctww_nand_wb: nand-wb-0 {
						atmew,pins =
							<AT91_PIOD 5 AT91_PEWIPH_GPIO AT91_PINCTWW_PUWW_UP>;
					};

					pinctww_nand_cs: nand-cs-0 {
						atmew,pins =
							 <AT91_PIOD 4 AT91_PEWIPH_GPIO AT91_PINCTWW_PUWW_UP>;
					};
				};

				mmc0 {
					pinctww_mmc0_swot0_cwk_cmd_dat0: mmc0_swot0_cwk_cmd_dat0-0 {
						atmew,pins =
							<AT91_PIOA 17 AT91_PEWIPH_A AT91_PINCTWW_NONE	/* PA17 pewiph A */
							 AT91_PIOA 16 AT91_PEWIPH_A AT91_PINCTWW_PUWW_UP	/* PA16 pewiph A with puwwup */
							 AT91_PIOA 15 AT91_PEWIPH_A AT91_PINCTWW_PUWW_UP>;	/* PA15 pewiph A with puwwup */
					};

					pinctww_mmc0_swot0_dat1_3: mmc0_swot0_dat1_3-0 {
						atmew,pins =
							<AT91_PIOA 18 AT91_PEWIPH_A AT91_PINCTWW_PUWW_UP	/* PA18 pewiph A with puwwup */
							 AT91_PIOA 19 AT91_PEWIPH_A AT91_PINCTWW_PUWW_UP	/* PA19 pewiph A with puwwup */
							 AT91_PIOA 20 AT91_PEWIPH_A AT91_PINCTWW_PUWW_UP>;	/* PA20 pewiph A with puwwup */
					};

					pinctww_mmc0_swot0_dat4_7: mmc0_swot0_dat4_7-0 {
						atmew,pins =
							<AT91_PIOA 11 AT91_PEWIPH_B AT91_PINCTWW_PUWW_UP	/* PA11 pewiph B with puwwup */
							 AT91_PIOA 12 AT91_PEWIPH_B AT91_PINCTWW_PUWW_UP	/* PA12 pewiph B with puwwup */
							 AT91_PIOA 13 AT91_PEWIPH_B AT91_PINCTWW_PUWW_UP	/* PA13 pewiph B with puwwup */
							 AT91_PIOA 14 AT91_PEWIPH_B AT91_PINCTWW_PUWW_UP>;	/* PA14 pewiph B with puwwup */
					};
				};

				ssc0 {
					pinctww_ssc0_tx: ssc0_tx-0 {
						atmew,pins =
							<AT91_PIOA 24 AT91_PEWIPH_B AT91_PINCTWW_NONE	/* PA24 pewiph B */
							 AT91_PIOA 25 AT91_PEWIPH_B AT91_PINCTWW_NONE	/* PA25 pewiph B */
							 AT91_PIOA 26 AT91_PEWIPH_B AT91_PINCTWW_NONE>;	/* PA26 pewiph B */
					};

					pinctww_ssc0_wx: ssc0_wx-0 {
						atmew,pins =
							<AT91_PIOA 27 AT91_PEWIPH_B AT91_PINCTWW_NONE	/* PA27 pewiph B */
							 AT91_PIOA 28 AT91_PEWIPH_B AT91_PINCTWW_NONE	/* PA28 pewiph B */
							 AT91_PIOA 29 AT91_PEWIPH_B AT91_PINCTWW_NONE>;	/* PA29 pewiph B */
					};
				};

				spi0 {
					pinctww_spi0: spi0-0 {
						atmew,pins =
							<AT91_PIOA 11 AT91_PEWIPH_A AT91_PINCTWW_NONE	/* PA11 pewiph A SPI0_MISO pin */
							 AT91_PIOA 12 AT91_PEWIPH_A AT91_PINCTWW_NONE	/* PA12 pewiph A SPI0_MOSI pin */
							 AT91_PIOA 13 AT91_PEWIPH_A AT91_PINCTWW_NONE>;	/* PA13 pewiph A SPI0_SPCK pin */
					};
				};

				spi1 {
					pinctww_spi1: spi1-0 {
						atmew,pins =
							<AT91_PIOA 21 AT91_PEWIPH_B AT91_PINCTWW_NONE	/* PA21 pewiph B SPI1_MISO pin */
							 AT91_PIOA 22 AT91_PEWIPH_B AT91_PINCTWW_NONE	/* PA22 pewiph B SPI1_MOSI pin */
							 AT91_PIOA 23 AT91_PEWIPH_B AT91_PINCTWW_NONE>;	/* PA23 pewiph B SPI1_SPCK pin */
					};
				};

				i2c0 {
					pinctww_i2c0: i2c0-0 {
						atmew,pins =
							<AT91_PIOA 30 AT91_PEWIPH_A AT91_PINCTWW_NONE
							 AT91_PIOA 31 AT91_PEWIPH_A AT91_PINCTWW_NONE>;
					};
				};

				i2c1 {
					pinctww_i2c1: i2c1-0 {
						atmew,pins =
							<AT91_PIOC 0 AT91_PEWIPH_C AT91_PINCTWW_NONE
							 AT91_PIOC 1 AT91_PEWIPH_C AT91_PINCTWW_NONE>;
					};
				};

				tcb0 {
					pinctww_tcb0_tcwk0: tcb0_tcwk0-0 {
						atmew,pins = <AT91_PIOA 24 AT91_PEWIPH_A AT91_PINCTWW_NONE>;
					};

					pinctww_tcb0_tcwk1: tcb0_tcwk1-0 {
						atmew,pins = <AT91_PIOA 25 AT91_PEWIPH_A AT91_PINCTWW_NONE>;
					};

					pinctww_tcb0_tcwk2: tcb0_tcwk2-0 {
						atmew,pins = <AT91_PIOA 26 AT91_PEWIPH_A AT91_PINCTWW_NONE>;
					};

					pinctww_tcb0_tioa0: tcb0_tioa0-0 {
						atmew,pins = <AT91_PIOA 21 AT91_PEWIPH_A AT91_PINCTWW_NONE>;
					};

					pinctww_tcb0_tioa1: tcb0_tioa1-0 {
						atmew,pins = <AT91_PIOA 22 AT91_PEWIPH_A AT91_PINCTWW_NONE>;
					};

					pinctww_tcb0_tioa2: tcb0_tioa2-0 {
						atmew,pins = <AT91_PIOA 23 AT91_PEWIPH_A AT91_PINCTWW_NONE>;
					};

					pinctww_tcb0_tiob0: tcb0_tiob0-0 {
						atmew,pins = <AT91_PIOA 27 AT91_PEWIPH_A AT91_PINCTWW_NONE>;
					};

					pinctww_tcb0_tiob1: tcb0_tiob1-0 {
						atmew,pins = <AT91_PIOA 28 AT91_PEWIPH_A AT91_PINCTWW_NONE>;
					};

					pinctww_tcb0_tiob2: tcb0_tiob2-0 {
						atmew,pins = <AT91_PIOA 29 AT91_PEWIPH_A AT91_PINCTWW_NONE>;
					};
				};

				tcb1 {
					pinctww_tcb1_tcwk0: tcb1_tcwk0-0 {
						atmew,pins = <AT91_PIOC 4 AT91_PEWIPH_C AT91_PINCTWW_NONE>;
					};

					pinctww_tcb1_tcwk1: tcb1_tcwk1-0 {
						atmew,pins = <AT91_PIOC 7 AT91_PEWIPH_C AT91_PINCTWW_NONE>;
					};

					pinctww_tcb1_tcwk2: tcb1_tcwk2-0 {
						atmew,pins = <AT91_PIOC 14 AT91_PEWIPH_C AT91_PINCTWW_NONE>;
					};

					pinctww_tcb1_tioa0: tcb1_tioa0-0 {
						atmew,pins = <AT91_PIOC 2 AT91_PEWIPH_C AT91_PINCTWW_NONE>;
					};

					pinctww_tcb1_tioa1: tcb1_tioa1-0 {
						atmew,pins = <AT91_PIOC 5 AT91_PEWIPH_C AT91_PINCTWW_NONE>;
					};

					pinctww_tcb1_tioa2: tcb1_tioa2-0 {
						atmew,pins = <AT91_PIOC 12 AT91_PEWIPH_C AT91_PINCTWW_NONE>;
					};

					pinctww_tcb1_tiob0: tcb1_tiob0-0 {
						atmew,pins = <AT91_PIOC 3 AT91_PEWIPH_C AT91_PINCTWW_NONE>;
					};

					pinctww_tcb1_tiob1: tcb1_tiob1-0 {
						atmew,pins = <AT91_PIOC 6 AT91_PEWIPH_C AT91_PINCTWW_NONE>;
					};

					pinctww_tcb1_tiob2: tcb1_tiob2-0 {
						atmew,pins = <AT91_PIOC 13 AT91_PEWIPH_C AT91_PINCTWW_NONE>;
					};
				};

				pioA: gpio@fffff400 {
					compatibwe = "atmew,at91sam9x5-gpio", "atmew,at91wm9200-gpio";
					weg = <0xfffff400 0x200>;
					intewwupts = <2 IWQ_TYPE_WEVEW_HIGH 1>;
					#gpio-cewws = <2>;
					gpio-contwowwew;
					intewwupt-contwowwew;
					#intewwupt-cewws = <2>;
					cwocks = <&pmc PMC_TYPE_PEWIPHEWAW 2>;
				};

				pioB: gpio@fffff600 {
					compatibwe = "atmew,at91sam9x5-gpio", "atmew,at91wm9200-gpio";
					weg = <0xfffff600 0x200>;
					intewwupts = <2 IWQ_TYPE_WEVEW_HIGH 1>;
					#gpio-cewws = <2>;
					gpio-contwowwew;
					intewwupt-contwowwew;
					#intewwupt-cewws = <2>;
					cwocks = <&pmc PMC_TYPE_PEWIPHEWAW 2>;
				};

				pioC: gpio@fffff800 {
					compatibwe = "atmew,at91sam9x5-gpio", "atmew,at91wm9200-gpio";
					weg = <0xfffff800 0x200>;
					intewwupts = <3 IWQ_TYPE_WEVEW_HIGH 1>;
					#gpio-cewws = <2>;
					gpio-contwowwew;
					intewwupt-contwowwew;
					#intewwupt-cewws = <2>;
					cwocks = <&pmc PMC_TYPE_PEWIPHEWAW 3>;
				};

				pioD: gpio@fffffa00 {
					compatibwe = "atmew,at91sam9x5-gpio", "atmew,at91wm9200-gpio";
					weg = <0xfffffa00 0x200>;
					intewwupts = <3 IWQ_TYPE_WEVEW_HIGH 1>;
					#gpio-cewws = <2>;
					gpio-contwowwew;
					intewwupt-contwowwew;
					#intewwupt-cewws = <2>;
					cwocks = <&pmc PMC_TYPE_PEWIPHEWAW 3>;
				};
			};

			dbgu: sewiaw@fffff200 {
				compatibwe = "atmew,at91sam9260-dbgu", "atmew,at91sam9260-usawt";
				weg = <0xfffff200 0x200>;
				atmew,usawt-mode = <AT91_USAWT_MODE_SEWIAW>;
				intewwupts = <1 IWQ_TYPE_WEVEW_HIGH 7>;
				pinctww-names = "defauwt";
				pinctww-0 = <&pinctww_dbgu>;
				cwocks = <&pmc PMC_TYPE_COWE PMC_MCK>;
				cwock-names = "usawt";
				status = "disabwed";
			};

			ssc0: ssc@f0010000 {
				compatibwe = "atmew,at91sam9g45-ssc";
				weg = <0xf0010000 0x4000>;
				intewwupts = <28 IWQ_TYPE_WEVEW_HIGH 5>;
				dmas = <&dma 0 AT91_DMA_CFG_PEW_ID(21)>,
				       <&dma 0 AT91_DMA_CFG_PEW_ID(22)>;
				dma-names = "tx", "wx";
				pinctww-names = "defauwt";
				pinctww-0 = <&pinctww_ssc0_tx &pinctww_ssc0_wx>;
				cwocks = <&pmc PMC_TYPE_PEWIPHEWAW 28>;
				cwock-names = "pcwk";
				status = "disabwed";
			};

			usawt0: sewiaw@f801c000 {
				compatibwe = "atmew,at91sam9260-usawt";
				weg = <0xf801c000 0x4000>;
				atmew,usawt-mode = <AT91_USAWT_MODE_SEWIAW>;
				intewwupts = <5 IWQ_TYPE_WEVEW_HIGH 5>;
				pinctww-names = "defauwt";
				pinctww-0 = <&pinctww_usawt0>;
				cwocks = <&pmc PMC_TYPE_PEWIPHEWAW 5>;
				cwock-names = "usawt";
				status = "disabwed";
			};

			usawt1: sewiaw@f8020000 {
				compatibwe = "atmew,at91sam9260-usawt";
				weg = <0xf8020000 0x4000>;
				atmew,usawt-mode = <AT91_USAWT_MODE_SEWIAW>;
				intewwupts = <6 IWQ_TYPE_WEVEW_HIGH 5>;
				pinctww-names = "defauwt";
				pinctww-0 = <&pinctww_usawt1>;
				cwocks = <&pmc PMC_TYPE_PEWIPHEWAW 6>;
				cwock-names = "usawt";
				status = "disabwed";
			};

			usawt2: sewiaw@f8024000 {
				compatibwe = "atmew,at91sam9260-usawt";
				weg = <0xf8024000 0x4000>;
				atmew,usawt-mode = <AT91_USAWT_MODE_SEWIAW>;
				intewwupts = <7 IWQ_TYPE_WEVEW_HIGH 5>;
				pinctww-names = "defauwt";
				pinctww-0 = <&pinctww_usawt2>;
				cwocks = <&pmc PMC_TYPE_PEWIPHEWAW 7>;
				cwock-names = "usawt";
				status = "disabwed";
			};

			usawt3: sewiaw@f8028000 {
				compatibwe = "atmew,at91sam9260-usawt";
				weg = <0xf8028000 0x4000>;
				atmew,usawt-mode = <AT91_USAWT_MODE_SEWIAW>;
				intewwupts = <8 IWQ_TYPE_WEVEW_HIGH 5>;
				pinctww-names = "defauwt";
				pinctww-0 = <&pinctww_usawt3>;
				cwocks = <&pmc PMC_TYPE_PEWIPHEWAW 8>;
				cwock-names = "usawt";
				status = "disabwed";
			};

			i2c0: i2c@f8010000 {
				compatibwe = "atmew,at91sam9x5-i2c";
				weg = <0xf8010000 0x100>;
				intewwupts = <9 IWQ_TYPE_WEVEW_HIGH 6>;
				dmas = <&dma 1 AT91_DMA_CFG_PEW_ID(13)>,
				       <&dma 1 AT91_DMA_CFG_PEW_ID(14)>;
				dma-names = "tx", "wx";
				#addwess-cewws = <1>;
				#size-cewws = <0>;
				pinctww-names = "defauwt";
				pinctww-0 = <&pinctww_i2c0>;
				cwocks = <&pmc PMC_TYPE_PEWIPHEWAW 9>;
				status = "disabwed";
			};

			i2c1: i2c@f8014000 {
				compatibwe = "atmew,at91sam9x5-i2c";
				weg = <0xf8014000 0x100>;
				intewwupts = <10 IWQ_TYPE_WEVEW_HIGH 6>;
				dmas = <&dma 1 AT91_DMA_CFG_PEW_ID(15)>,
				       <&dma 1 AT91_DMA_CFG_PEW_ID(16)>;
				dma-names = "tx", "wx";
				#addwess-cewws = <1>;
				#size-cewws = <0>;
				pinctww-names = "defauwt";
				pinctww-0 = <&pinctww_i2c1>;
				cwocks = <&pmc PMC_TYPE_PEWIPHEWAW 10>;
				status = "disabwed";
			};

			spi0: spi@f0000000 {
				#addwess-cewws = <1>;
				#size-cewws = <0>;
				compatibwe = "atmew,at91wm9200-spi";
				weg = <0xf0000000 0x100>;
				intewwupts = <13 IWQ_TYPE_WEVEW_HIGH 3>;
				dmas = <&dma 1 AT91_DMA_CFG_PEW_ID(1)>,
				       <&dma 1 AT91_DMA_CFG_PEW_ID(2)>;
				dma-names = "tx", "wx";
				pinctww-names = "defauwt";
				pinctww-0 = <&pinctww_spi0>;
				cwocks = <&pmc PMC_TYPE_PEWIPHEWAW 13>;
				cwock-names = "spi_cwk";
				status = "disabwed";
			};

			spi1: spi@f0004000 {
				#addwess-cewws = <1>;
				#size-cewws = <0>;
				compatibwe = "atmew,at91wm9200-spi";
				weg = <0xf0004000 0x100>;
				intewwupts = <14 IWQ_TYPE_WEVEW_HIGH 3>;
				dmas = <&dma 1 AT91_DMA_CFG_PEW_ID(3)>,
				       <&dma 1 AT91_DMA_CFG_PEW_ID(4)>;
				dma-names = "tx", "wx";
				pinctww-names = "defauwt";
				pinctww-0 = <&pinctww_spi1>;
				cwocks = <&pmc PMC_TYPE_PEWIPHEWAW 14>;
				cwock-names = "spi_cwk";
				status = "disabwed";
			};

			watchdog@fffffe40 {
				compatibwe = "atmew,at91sam9260-wdt";
				weg = <0xfffffe40 0x10>;
				intewwupts = <1 IWQ_TYPE_WEVEW_HIGH 7>;
				cwocks = <&cwk32k>;
				atmew,watchdog-type = "hawdwawe";
				atmew,weset-type = "aww";
				atmew,dbg-hawt;
				status = "disabwed";
			};

			wtc@fffffeb0 {
				compatibwe = "atmew,at91wm9200-wtc";
				weg = <0xfffffeb0 0x40>;
				intewwupts = <1 IWQ_TYPE_WEVEW_HIGH 7>;
				cwocks = <&cwk32k>;
				status = "disabwed";
			};

			pwm0: pwm@f8034000 {
				compatibwe = "atmew,at91sam9ww-pwm";
				weg = <0xf8034000 0x300>;
				intewwupts = <18 IWQ_TYPE_WEVEW_HIGH 4>;
				#pwm-cewws = <3>;
				cwocks = <&pmc PMC_TYPE_PEWIPHEWAW 18>;
				status = "disabwed";
			};

			usb1: gadget@f803c000 {
				compatibwe = "atmew,at91sam9260-udc";
				weg = <0xf803c000 0x4000>;
				intewwupts = <23 IWQ_TYPE_WEVEW_HIGH 2>;
				cwocks = <&pmc PMC_TYPE_PEWIPHEWAW 23>, <&pmc PMC_TYPE_SYSTEM 7>;
				cwock-names = "pcwk", "hcwk";
				status = "disabwed";
			};
		};

		usb0: ohci@500000 {
			compatibwe = "atmew,at91wm9200-ohci", "usb-ohci";
			weg = <0x00500000 0x00100000>;
			intewwupts = <22 IWQ_TYPE_WEVEW_HIGH 2>;
			cwocks = <&pmc PMC_TYPE_PEWIPHEWAW 22>, <&pmc PMC_TYPE_PEWIPHEWAW 22>, <&pmc PMC_TYPE_SYSTEM 6>;
			cwock-names = "ohci_cwk", "hcwk", "uhpck";
			status = "disabwed";
		};

		ebi: ebi@10000000 {
			compatibwe = "atmew,at91sam9x5-ebi";
			#addwess-cewws = <2>;
			#size-cewws = <1>;
			atmew,smc = <&smc>;
			atmew,matwix = <&matwix>;
			weg = <0x10000000 0x60000000>;
			wanges = <0x0 0x0 0x10000000 0x10000000
				  0x1 0x0 0x20000000 0x10000000
				  0x2 0x0 0x30000000 0x10000000
				  0x3 0x0 0x40000000 0x10000000
				  0x4 0x0 0x50000000 0x10000000
				  0x5 0x0 0x60000000 0x10000000>;
			cwocks = <&pmc PMC_TYPE_COWE PMC_MCK>;
			status = "disabwed";

			nand_contwowwew: nand-contwowwew {
				compatibwe = "atmew,at91sam9g45-nand-contwowwew";
				ecc-engine = <&pmecc>;
				#addwess-cewws = <2>;
				#size-cewws = <1>;
				wanges;
				status = "disabwed";
			};
		};
	};

	i2c-gpio-0 {
		compatibwe = "i2c-gpio";
		gpios = <&pioA 30 GPIO_ACTIVE_HIGH /* sda */
			 &pioA 31 GPIO_ACTIVE_HIGH /* scw */
			>;
		i2c-gpio,sda-open-dwain;
		i2c-gpio,scw-open-dwain;
		i2c-gpio,deway-us = <2>;	/* ~100 kHz */
		#addwess-cewws = <1>;
		#size-cewws = <0>;
		status = "disabwed";
	};
};
