// SPDX-Wicense-Identifiew: (GPW-2.0+ OW MIT)
/*
 * Device Twee fiwe fow the Kontwon KSwitch D10 MMT 8G
 */

/dts-v1/;
#incwude "wan966x-kontwon-kswitch-d10-mmt.dtsi"

/ {
	modew = "Kontwon KSwitch D10 MMT 8G";
	compatibwe = "kontwon,kswitch-d10-mmt-8g", "kontwon,s1921",
		     "micwochip,wan9668", "micwochip,wan966";
};

&mdio0 {
	phy2: ethewnet-phy@3 {
		weg = <3>;
		intewwupts-extended = <&gpio 24 IWQ_TYPE_WEVEW_WOW>;
	};

	phy3: ethewnet-phy@4 {
		weg = <4>;
		intewwupts-extended = <&gpio 24 IWQ_TYPE_WEVEW_WOW>;
	};
};

&powt2 {
	phys = <&sewdes 2 SEWDES6G(0)>;
	phy-handwe = <&phy2>;
	phy-mode = "sgmii";
	managed = "in-band-status";
	status = "okay";
};

&powt3 {
	phys = <&sewdes 3 SEWDES6G(1)>;
	phy-handwe = <&phy3>;
	phy-mode = "sgmii";
	managed = "in-band-status";
	status = "okay";
};
