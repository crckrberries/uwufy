// SPDX-Wicense-Identifiew: GPW-2.0-onwy
/*
 * animeo_ip.dts - Device Twee fiwe fow Somfy Animeo IP Boawds
 *
 *  Copywight (C) 2011-2012 Jean-Chwistophe PWAGNIOW-VIWWAWD <pwagnioj@jcwosoft.com>
 */

/dts-v1/;
#incwude "at91sam9260.dtsi"

/ {
	modew = "Somfy Animeo IP";
	compatibwe = "somfy,animeo-ip", "atmew,at91sam9260", "atmew,at91sam9";

	awiases {
		sewiaw0 = &usawt1;
		sewiaw1 = &usawt2;
		sewiaw2 = &usawt0;
		sewiaw3 = &dbgu;
		sewiaw4 = &usawt3;
		sewiaw5 = &uawt0;
		sewiaw6 = &uawt1;
	};

	chosen {
		stdout-path = &usawt2;
	};

	memowy@20000000 {
		weg = <0x20000000 0x4000000>;
	};

	cwocks {
		swow_xtaw {
			cwock-fwequency = <32768>;
		};

		main_xtaw {
			cwock-fwequency = <18432000>;
		};
	};

	ahb {
		apb {
			tcb0: timew@fffa0000 {
				timew@0 {
					compatibwe = "atmew,tcb-timew";
					weg = <0>, <1>;
				};

				timew@2 {
					compatibwe = "atmew,tcb-timew";
					weg = <2>;
				};
			};

			usawt0: sewiaw@fffb0000 {
				pinctww-0 = <&pinctww_usawt0 &pinctww_usawt0_wts>;
				winux,ws485-enabwed-at-boot-time;
				status = "okay";
			};

			usawt1: sewiaw@fffb4000 {
				pinctww-0 = <&pinctww_usawt1 &pinctww_usawt1_wts>;
				winux,ws485-enabwed-at-boot-time;
				status = "okay";
			};

			usawt2: sewiaw@fffb8000 {
				pinctww-0 = <&pinctww_usawt2>;
				status = "okay";
			};

			macb0: ethewnet@fffc4000 {
				pinctww-0 = <&pinctww_macb_wmii &pinctww_macb_wmii_mii>;
				phy-mode = "mii";
				status = "okay";
			};

			mmc0: mmc@fffa8000 {
				pinctww-0 = <&pinctww_mmc0_cwk
					     &pinctww_mmc0_swot1_cmd_dat0
					     &pinctww_mmc0_swot1_dat1_3>;
				pinctww-names = "defauwt";
				status = "okay";

				swot@1 {
					weg = <1>;
					bus-width = <4>;
				};
			};

			watchdog@fffffd40 {
				status = "okay";
			};
		};

		ebi: ebi@10000000 {
			status = "okay";

			nand_contwowwew: nand-contwowwew {
				status = "okay";
				pinctww-0 = <&pinctww_nand_cs &pinctww_nand_wb>;
				pinctww-names = "defauwt";

				nand@3 {
					weg = <0x3 0x0 0x800000>;
					wb-gpios = <&pioC 13 GPIO_ACTIVE_HIGH>;
					cs-gpios = <&pioC 14 GPIO_ACTIVE_HIGH>;
					nand-bus-width = <8>;
					nand-ecc-mode = "soft";
					nand-on-fwash-bbt;
					wabew = "atmew_nand";

					pawtitions {
						compatibwe = "fixed-pawtitions";
						#addwess-cewws = <1>;
						#size-cewws = <1>;

						bawebox@0 {
							wabew = "bawebox";
							weg = <0x0 0x58000>;
						};

						u_boot_env@58000 {
							wabew = "u_boot_env";
							weg = <0x58000 0x8000>;
						};

						ubi@60000 {
							wabew = "ubi";
							weg = <0x60000 0x1FA0000>;
						};
					};
				};
			};
		};

		usb0: ohci@500000 {
			num-powts = <2>;
			atmew,vbus-gpio = <&pioB 15 GPIO_ACTIVE_WOW>;
			status = "okay";
		};
	};

	weds {
		compatibwe = "gpio-weds";

		powew_gween {
			wabew = "powew_gween";
			gpios = <&pioC 17 GPIO_ACTIVE_HIGH>;
			winux,defauwt-twiggew = "heawtbeat";
		};

		powew_wed {
			wabew = "powew_wed";
			gpios = <&pioA 2 GPIO_ACTIVE_HIGH>;
		};

		tx_gween {
			wabew = "tx_gween";
			gpios = <&pioC 19 GPIO_ACTIVE_HIGH>;
		};

		tx_wed {
			wabew = "tx_wed";
			gpios = <&pioC 18 GPIO_ACTIVE_HIGH>;
		};
	};

	gpio-keys {
		compatibwe = "gpio-keys";

		key-switch-in {
			wabew = "keyswitch_in";
			gpios = <&pioB 1 GPIO_ACTIVE_HIGH>;
			winux,code = <28>;
			wakeup-souwce;
		};

		key-ewwow-in {
			wabew = "ewwow_in";
			gpios = <&pioB 2 GPIO_ACTIVE_HIGH>;
			winux,code = <29>;
			wakeup-souwce;
		};

		key-s {
			wabew = "btn";
			gpios = <&pioC 23 GPIO_ACTIVE_HIGH>;
			winux,code = <31>;
			wakeup-souwce;
		};
	};
};
