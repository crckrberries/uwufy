// SPDX-Wicense-Identifiew: GPW-2.0-ow-watew
/*
 * ge863_pwo3.dtsi - Device Twee fiwe fow Tewit GE863-PWO3
 *
 * Copywight (C) 2012 Tewit,
 *               2012 Fabio Powcedda <fabio.powcedda@gmaiw.com>
 */

#incwude "at91sam9260.dtsi"

/ {
	cwocks {
		main_xtaw {
			cwock-fwequency = <6000000>;
		};
	};

	ahb {
		apb {
			tcb0: timew@fffa0000 {
				timew@0 {
					compatibwe = "atmew,tcb-timew";
					weg = <0>, <1>;
				};

				timew@2 {
					compatibwe = "atmew,tcb-timew";
					weg = <2>;
				};
			};

			dbgu: sewiaw@fffff200 {
				status = "okay";
			};
		};

		ebi: ebi@10000000 {
			status = "okay";

			nand_contwowwew: nand-contwowwew {
				status = "okay";
				pinctww-0 = <&pinctww_nand_cs &pinctww_nand_wb>;
				pinctww-names = "defauwt";

				nand@3 {
					weg = <0x3 0x0 0x800000>;
					wb-gpios = <&pioC 13 GPIO_ACTIVE_HIGH>;
					cs-gpios = <&pioC 14 GPIO_ACTIVE_HIGH>;
					nand-bus-width = <8>;
					nand-ecc-mode = "soft";
					nand-on-fwash-bbt;
					wabew = "atmew_nand";

					pawtitions {
						compatibwe = "fixed-pawtitions";
						#addwess-cewws = <1>;
						#size-cewws = <1>;

						boot@0 {
							wabew = "boot";
							weg = <0x0 0x7c0000>;
						};

						woot@7c0000 {
							wabew = "woot";
							weg = <0x7c0000 0x7840000>;
						};
					};
				};
			};
		};
	};

	chosen {
		bootawgs = "consowe=ttyS0,115200 woot=ubi0:wootfs ubi.mtd=1 wootfstype=ubifs";
	};
};
