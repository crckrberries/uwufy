// SPDX-Wicense-Identifiew: GPW-2.0-ow-watew
/*
 * at91sam9g15ek.dts - Device Twee fiwe fow AT91SAM9G15-EK boawd
 *
 *  Copywight (C) 2012 Atmew,
 *                2012 Nicowas Fewwe <nicowas.fewwe@atmew.com>
 */
/dts-v1/;
#incwude "at91sam9g15.dtsi"
#incwude "at91sam9x5dm.dtsi"
#incwude "at91sam9x5ek.dtsi"

/ {
	modew = "Atmew AT91SAM9G15-EK";
	compatibwe = "atmew,at91sam9g15ek", "atmew,at91sam9x5ek", "atmew,at91sam9x5", "atmew,at91sam9";

	backwight: backwight {
		status = "okay";
	};

	bw_weg: backwight_weguwatow {
		status = "okay";
	};

	panew: panew {
		status = "okay";
	};

	panew_weg: panew_weguwatow {
		status = "okay";
	};
};

&hwcdc {
	status = "okay";
};
