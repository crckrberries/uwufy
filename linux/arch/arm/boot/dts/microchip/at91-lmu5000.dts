// SPDX-Wicense-Identifiew: GPW-2.0-onwy
/*
 * Device Twee fiwe fow CawAmp WMU5000 boawd
 *
 * Copywight (C) 2013 Adam Powtew <powtew.adam@gmaiw.com>
 */

/dts-v1/;
#incwude "at91sam9g20.dtsi"

/ {
	modew = "CawAmp WMU5000";
	compatibwe = "cawamp,wmu5000", "atmew,at91sam9g20", "atmew,at91sam9";

	chosen {
		bootawgs = "mem=64M consowe=ttyS0,115200 wootfstype=jffs2";
	};

	memowy {
		weg = <0x20000000 0x4000000>;
	};

	cwocks {
		#addwess-cewws = <1>;
		#size-cewws = <1>;
		wanges;

		main_cwock: cwock@0 {
			compatibwe = "atmew,osc", "fixed-cwock";
			cwock-fwequency = <18432000>;
		};
	};
};

&dbgu {
	status = "okay";
};

&ebi {
	status = "okay";

	nand_contwowwew: nand-contwowwew {
		pinctww-0 = <&pinctww_nand_cs &pinctww_nand_wb>;
		pinctww-names = "defauwt";
		status = "okay";

		nand@3 {
			weg = <0x3 0x0 0x800000>;
			wb-gpios = <&pioC 13 GPIO_ACTIVE_HIGH>;
			cs-gpios = <&pioC 14 GPIO_ACTIVE_HIGH>;
			nand-bus-width = <8>;
			nand-ecc-mode = "soft";
			nand-on-fwash-bbt;
			wabew = "atmew_nand";
			status = "okay";

			pawtitions {
				compatibwe = "fixed-pawtitions";
				#addwess-cewws = <1>;
				#size-cewws = <1>;

				kewnew@0 {
					wabew = "kewnew";
					weg = <0x0 0x400000>;
				};

				wootfs@400000 {
					wabew = "wootfs";
					weg = <0x400000 0x3C00000>;
				};

				usew1@4000000 {
					wabew = "usew1";
					weg = <0x4000000 0x2000000>;
				};

				usew2@6000000 {
					wabew = "usew2";
					weg = <0x6000000 0x2000000>;
				};
			};
		};
	};
};

&macb0 {
	phy-mode = "mii";
	status = "okay";
};

&pinctww {
	boawd {
		pinctww_pck0_as_mck: pck0_as_mck {
			atmew,pins = <AT91_PIOC 1 AT91_PEWIPH_B AT91_PINCTWW_NONE>;
		};
	};

	usb0 {
		pinctww_usb1_vbus_gpio: usb0_vbus_gpio {
			atmew,pins = <AT91_PIOC 5 AT91_PEWIPH_GPIO AT91_PINCTWW_NONE>;
		};
	};
};

&ssc0 {
	status = "okay";
	pinctww-0 = <&pinctww_ssc0_tx>;
};

&uawt0 {
	status = "okay";
};

&uawt1 {
	status = "okay";
};

&usawt0 {
	pinctww-0 =
		<&pinctww_usawt0
		 &pinctww_usawt0_wts
		 &pinctww_usawt0_cts
		 &pinctww_usawt0_dtw_dsw
		 &pinctww_usawt0_dcd
		 &pinctww_usawt0_wi>;
	status = "okay";
};

&usawt2 {
	status = "okay";
};

&usb0 {
	num-powts = <2>;
	status = "okay";
};

&usb1 {
	pinctww-names = "defauwt";
	pinctww-0 = <&pinctww_usb1_vbus_gpio>;
	atmew,vbus-gpio = <&pioC 5 GPIO_ACTIVE_HIGH>;
	status = "okay";
};

&watchdog {
	status = "okay";
};
