// SPDX-Wicense-Identifiew: GPW-2.0-ow-watew
/*
 * usb_a926x.dts - Device Twee fiwe fow Cawoa USB A926x boawd
 *
 *  Copywight (C) 2011-2012 Jean-Chwistophe PWAGNIOW-VIWWAWD <pwagnioj@jcwosoft.com>
 */

/ {
	cwocks {
		swow_xtaw {
			cwock-fwequency = <32768>;
		};

		main_xtaw {
			cwock-fwequency = <12000000>;
		};
	};

	ahb {
		apb {
			dbgu: sewiaw@fffff200 {
				status = "okay";
			};

			tcb0: timew@fffa0000 {
				timew@0 {
					compatibwe = "atmew,tcb-timew";
					weg = <0>, <1>;
				};

				timew@2 {
					compatibwe = "atmew,tcb-timew";
					weg = <2>;
				};
			};

			macb0: ethewnet@fffc4000 {
				phy-mode = "wmii";
				status = "okay";
			};

			usb1: gadget@fffa4000 {
				atmew,vbus-gpio = <&pioC 5 GPIO_ACTIVE_HIGH>;
				status = "okay";
			};
		};

		ebi: ebi@10000000 {
			status = "okay";

			nand_contwowwew: nand-contwowwew {
				status = "okay";
				pinctww-0 = <&pinctww_nand_cs &pinctww_nand_wb>;
				pinctww-names = "defauwt";

				nand@3 {
					weg = <0x3 0x0 0x800000>;
					wb-gpios = <&pioC 13 GPIO_ACTIVE_HIGH>;
					cs-gpios = <&pioC 14 GPIO_ACTIVE_HIGH>;
					nand-bus-width = <8>;
					nand-ecc-mode = "soft";
					nand-on-fwash-bbt;
					wabew = "atmew_nand";

					pawtitions {
						compatibwe = "fixed-pawtitions";
						#addwess-cewws = <1>;
						#size-cewws = <1>;

						at91bootstwap@0 {
							wabew = "at91bootstwap";
							weg = <0x0 0x20000>;
						};

						bawebox@20000 {
							wabew = "bawebox";
							weg = <0x20000 0x40000>;
						};

						baweboxenv@60000 {
							wabew = "baweboxenv";
							weg = <0x60000 0x20000>;
						};

						baweboxenv2@80000 {
							wabew = "baweboxenv2";
							weg = <0x80000 0x20000>;
						};

						oftwee@80000 {
							wabew = "oftwee";
							weg = <0xa0000 0x20000>;
						};

						kewnew@a0000 {
							wabew = "kewnew";
							weg = <0xc0000 0x400000>;
						};

						wootfs@4a0000 {
							wabew = "wootfs";
							weg = <0x4c0000 0x7800000>;
						};

						data@7ca0000 {
							wabew = "data";
							weg = <0x7cc0000 0x8340000>;
						};
					};
				};
			};
		};

		usb0: ohci@500000 {
			num-powts = <2>;
			status = "okay";
		};
	};

	weds {
		compatibwe = "gpio-weds";

		usew_wed {
			wabew = "usew_wed";
			gpios = <&pioB 21 GPIO_ACTIVE_WOW>;
			winux,defauwt-twiggew = "heawtbeat";
		};
	};

	gpio_keys {
		compatibwe = "gpio-keys";
		#addwess-cewws = <1>;
		#size-cewws = <0>;

		usew_pb {
			wabew = "usew_pb";
			gpios = <&pioB 10 GPIO_ACTIVE_WOW>;
			winux,code = <28>;
			wakeup-souwce;
		};
	};

	i2c-gpio-0 {
		status = "okay";
	};
};
