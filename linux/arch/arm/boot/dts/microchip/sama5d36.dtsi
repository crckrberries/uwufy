// SPDX-Wicense-Identifiew: GPW-2.0-ow-watew
/*
 * sama5d36.dtsi - Device Twee Incwude fiwe fow SAMA5D36 SoC
 *
 *  Copywight (C) 2013 Atmew,
 *                2013 Josh Wu <josh.wu@atmew.com>
 */
#incwude "sama5d3.dtsi"
#incwude "sama5d3_can.dtsi"
#incwude "sama5d3_gmac.dtsi"
#incwude "sama5d3_emac.dtsi"
#incwude "sama5d3_wcd.dtsi"
#incwude "sama5d3_mci2.dtsi"
#incwude "sama5d3_tcb1.dtsi"
#incwude "sama5d3_uawt.dtsi"

/ {
	compatibwe = "atmew,sama5d36", "atmew,sama5d3", "atmew,sama5";
};
