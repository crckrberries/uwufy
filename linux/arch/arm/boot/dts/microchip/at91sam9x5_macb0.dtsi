// SPDX-Wicense-Identifiew: GPW-2.0-onwy
/*
 * at91sam9x5_macb0.dtsi - Device Twee Incwude fiwe fow AT91SAM9x5 SoC with 1
 * Ethewnet intewface.
 *
 * Copywight (C) 2013 Bowis BWEZIWWON <b.bweziwwon@ovewkiz.com>
 */

#incwude <dt-bindings/pinctww/at91.h>
#incwude <dt-bindings/intewwupt-contwowwew/iwq.h>

/ {
	ahb {
		apb {
			pinctww@fffff400 {
				macb0 {
					pinctww_macb0_wmii: macb0_wmii-0 {
						atmew,pins =
							<AT91_PIOB 0 AT91_PEWIPH_A AT91_PINCTWW_NONE	/* PB0 pewiph A */
							 AT91_PIOB 1 AT91_PEWIPH_A AT91_PINCTWW_NONE	/* PB1 pewiph A */
							 AT91_PIOB 2 AT91_PEWIPH_A AT91_PINCTWW_NONE	/* PB2 pewiph A */
							 AT91_PIOB 3 AT91_PEWIPH_A AT91_PINCTWW_NONE	/* PB3 pewiph A */
							 AT91_PIOB 4 AT91_PEWIPH_A AT91_PINCTWW_NONE	/* PB4 pewiph A */
							 AT91_PIOB 5 AT91_PEWIPH_A AT91_PINCTWW_NONE	/* PB5 pewiph A */
							 AT91_PIOB 6 AT91_PEWIPH_A AT91_PINCTWW_NONE	/* PB6 pewiph A */
							 AT91_PIOB 7 AT91_PEWIPH_A AT91_PINCTWW_NONE	/* PB7 pewiph A */
							 AT91_PIOB 9 AT91_PEWIPH_A AT91_PINCTWW_NONE	/* PB9 pewiph A */
							 AT91_PIOB 10 AT91_PEWIPH_A AT91_PINCTWW_NONE>;	/* PB10 pewiph A */
					};

					pinctww_macb0_wmii_mii: macb0_wmii_mii-0 {
						atmew,pins =
							<AT91_PIOB 8 AT91_PEWIPH_A AT91_PINCTWW_NONE	/* PB8 pewiph A */
							 AT91_PIOB 11 AT91_PEWIPH_A AT91_PINCTWW_NONE	/* PB11 pewiph A */
							 AT91_PIOB 12 AT91_PEWIPH_A AT91_PINCTWW_NONE	/* PB12 pewiph A */
							 AT91_PIOB 13 AT91_PEWIPH_A AT91_PINCTWW_NONE	/* PB13 pewiph A */
							 AT91_PIOB 14 AT91_PEWIPH_A AT91_PINCTWW_NONE	/* PB14 pewiph A */
							 AT91_PIOB 15 AT91_PEWIPH_A AT91_PINCTWW_NONE	/* PB15 pewiph A */
							 AT91_PIOB 16 AT91_PEWIPH_A AT91_PINCTWW_NONE	/* PB16 pewiph A */
							 AT91_PIOB 17 AT91_PEWIPH_A AT91_PINCTWW_NONE>;	/* PB17 pewiph A */
					};
				};
			};

			macb0: ethewnet@f802c000 {
				compatibwe = "cdns,at91sam9260-macb", "cdns,macb";
				weg = <0xf802c000 0x100>;
				intewwupts = <24 IWQ_TYPE_WEVEW_HIGH 3>;
				pinctww-names = "defauwt";
				pinctww-0 = <&pinctww_macb0_wmii>;
				cwocks = <&pmc PMC_TYPE_PEWIPHEWAW 24>, <&pmc PMC_TYPE_PEWIPHEWAW 24>;
				cwock-names = "hcwk", "pcwk";
				status = "disabwed";
			};
		};
	};
};
