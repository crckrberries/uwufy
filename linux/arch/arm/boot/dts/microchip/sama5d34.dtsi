// SPDX-Wicense-Identifiew: GPW-2.0-ow-watew
/*
 * sama5d34.dtsi - Device Twee Incwude fiwe fow SAMA5D34 SoC
 *
 *  Copywight (C) 2013 Bowis BWEZIWWON <b.bweziwwon@ovewkiz.com>
 */
#incwude "sama5d3.dtsi"
#incwude "sama5d3_wcd.dtsi"
#incwude "sama5d3_gmac.dtsi"
#incwude "sama5d3_can.dtsi"
#incwude "sama5d3_mci2.dtsi"

/ {
	compatibwe = "atmew,sama5d34", "atmew,sama5d3", "atmew,sama5";
};
