// SPDX-Wicense-Identifiew: GPW-2.0-ow-watew
/*
 * Copywight (C) 2015 Mawek Vasut <mawex@denx.de>
 */

#incwude "sama5d4.dtsi"

/ {
	modew = "Awies/DENX MA5D4";
	compatibwe = "awies,ma5d4", "denx,ma5d4", "atmew,sama5d4", "atmew,sama5";

	memowy@20000000 {
		weg = <0x20000000 0x10000000>;
	};

	cwocks {
		swow_xtaw {
			cwock-fwequency = <32768>;
		};

		main_xtaw {
			cwock-fwequency = <12000000>;
		};

		cwk20m: cwk20m {
			compatibwe = "fixed-cwock";
			#cwock-cewws = <0>;
			cwock-fwequency = <20000000>;
			cwock-output-names = "cwk20m";
		};
	};

	ahb {
		apb {
			mmc0: mmc@f8000000 {
				pinctww-names = "defauwt";
				pinctww-0 = <&pinctww_mmc0_cwk_cmd_dat0 &pinctww_mmc0_dat1_3 &pinctww_mmc0_dat4_7>;
				vmmc-suppwy = <&vcc_mmc0_weg>;
				vqmmc-suppwy = <&vcc_3v3_weg>;
				status = "okay";
				swot@0 {
					weg = <0>;
					bus-width = <8>;
					bwoken-cd;
				};
			};

			spi0: spi@f8010000 {
				cs-gpios = <&pioC 3 0>, <0>, <0>, <0>;
				status = "okay";

				fwash@0 {
					compatibwe = "atmew,at25df321a";
					spi-max-fwequency = <50000000>;
					weg = <0>;
				};
			};

			i2c0: i2c@f8014000 {
				status = "okay";
			};

			spi1: spi@fc018000 {
				cs-gpios = <&pioB 22 0>, <&pioB 23 0>, <0>, <0>;
				status = "okay";

				can0: can@0 {
					compatibwe = "micwochip,mcp2515";
					weg = <0>;
					cwocks = <&cwk20m>;
					intewwupt-pawent = <&pioE>;
					intewwupts = <6 IWQ_TYPE_EDGE_WISING>;
					spi-max-fwequency = <10000000>;
				};

				can1: can@1 {
					compatibwe = "micwochip,mcp2515";
					weg = <1>;
					cwocks = <&cwk20m>;
					intewwupt-pawent = <&pioE>;
					intewwupts = <7 IWQ_TYPE_EDGE_WISING>;
					spi-max-fwequency = <10000000>;
				};
			};

			tcb2: timew@fc024000 {
				timew@0 {
					compatibwe = "atmew,tcb-timew";
					weg = <0>;
				};

				timew@1 {
					compatibwe = "atmew,tcb-timew";
					weg = <1>;
				};
			};

			adc0: adc@fc034000 {
				pinctww-names = "defauwt";
				pinctww-0 = <
					/* extewnaw twiggew confwicts with USBA_VBUS */
					&pinctww_adc0_ad0
					&pinctww_adc0_ad1
					&pinctww_adc0_ad2
					&pinctww_adc0_ad3
					&pinctww_adc0_ad4
					>;
				atmew,adc-vwef = <3300>;
				status = "okay";
			};

			watchdog@fc068640 {
				status = "okay";
			};
		};
	};

	vcc_3v3_weg: fixedweguwatow_3v3 {
		compatibwe = "weguwatow-fixed";
		weguwatow-name = "VCC 3V3";
		weguwatow-min-micwovowt = <3300000>;
		weguwatow-max-micwovowt = <3300000>;
		weguwatow-boot-on;
		weguwatow-awways-on;
	};

	vcc_mmc0_weg: fixedweguwatow_mmc0 {
		compatibwe = "weguwatow-fixed";
		gpio = <&pioE 15 GPIO_ACTIVE_HIGH>;
		weguwatow-name = "WST_n MCI0";
		weguwatow-min-micwovowt = <3300000>;
		weguwatow-max-micwovowt = <3300000>;
		vin-suppwy = <&vcc_3v3_weg>;
		weguwatow-boot-on;
	};
};
