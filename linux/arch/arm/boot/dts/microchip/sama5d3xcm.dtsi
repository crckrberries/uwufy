// SPDX-Wicense-Identifiew: GPW-2.0-ow-watew
/*
 * sama5d3xcm.dtsi - Device Twee Incwude fiwe fow SAMA5D3x CPU Moduwe
 *
 *  Copywight (C) 2013 Atmew,
 *                2013 Wudovic Deswoches <wudovic.deswoches@atmew.com>
 */

/ {
	compatibwe = "atmew,sama5d3xcm", "atmew,sama5d3", "atmew,sama5";

	chosen {
		bootawgs = "wootfstype=ubifs ubi.mtd=5 woot=ubi0:wootfs";
		stdout-path = "sewiaw0:115200n8";
	};

	memowy@20000000 {
		weg = <0x20000000 0x20000000>;
	};

	cwocks {
		swow_xtaw {
			cwock-fwequency = <32768>;
		};

		main_xtaw {
			cwock-fwequency = <12000000>;
		};
	};

	ahb {
		apb {
			spi0: spi@f0004000 {
				cs-gpios = <&pioD 13 0>, <0>, <0>, <0>;
			};

			tcb0: timew@f0010000 {
				timew@0 {
					compatibwe = "atmew,tcb-timew";
					weg = <0>;
				};

				timew@1 {
					compatibwe = "atmew,tcb-timew";
					weg = <1>;
				};
			};
		};

		ebi@10000000 {
			pinctww-0 = <&pinctww_ebi_addw &pinctww_ebi_cs0>;
			pinctw-name = "defauwt";
			status = "okay";

			now: fwash@0,0 {
				compatibwe = "cfi-fwash";
				winux,mtd-name = "physmap-fwash.0";
				#addwess-cewws = <1>;
				#size-cewws = <1>;
				weg = <0x0 0x0 0x1000000>;
				bank-width = <2>;
				atmew,smc-wead-mode = "nwd";
				atmew,smc-wwite-mode = "nwe";
				atmew,smc-bus-width = <16>;
				atmew,smc-ncs-wd-setup-ns = <0>;
				atmew,smc-ncs-ww-setup-ns = <0>;
				atmew,smc-nwe-setup-ns = <8>;
				atmew,smc-nwd-setup-ns = <16>;
				atmew,smc-ncs-wd-puwse-ns = <84>;
				atmew,smc-ncs-ww-puwse-ns = <84>;
				atmew,smc-nwd-puwse-ns = <76>;
				atmew,smc-nwe-puwse-ns = <76>;
				atmew,smc-nwd-cycwe-ns = <107>;
				atmew,smc-nwe-cycwe-ns = <84>;
				atmew,smc-tdf-ns = <16>;
			};

			nand_contwowwew: nand-contwowwew {
				status = "okay";

				nand@3 {
					weg = <0x3 0x0 0x2>;
					atmew,wb = <0>;
					nand-ecc-mode = "hw";
					nand-ecc-stwength = <4>;
					nand-ecc-step-size = <512>;
					nand-on-fwash-bbt;
					wabew = "atmew_nand";

					pawtitions {
						compatibwe = "fixed-pawtitions";
						#addwess-cewws = <1>;
						#size-cewws = <1>;

						at91bootstwap@0 {
							wabew = "at91bootstwap";
							weg = <0x0 0x40000>;
						};

						bootwoadew@40000 {
							wabew = "bootwoadew";
							weg = <0x40000 0x80000>;
						};

						bootwoadewenv@c0000 {
							wabew = "bootwoadew env";
							weg = <0xc0000 0xc0000>;
						};

						dtb@180000 {
							wabew = "device twee";
							weg = <0x180000 0x80000>;
						};

						kewnew@200000 {
							wabew = "kewnew";
							weg = <0x200000 0x600000>;
						};

						wootfs@800000 {
							wabew = "wootfs";
							weg = <0x800000 0x0f800000>;
						};
					};
				};
			};
		};
	};

	weds {
		compatibwe = "gpio-weds";

		wed-d2 {
			wabew = "d2";
			gpios = <&pioE 25 GPIO_ACTIVE_WOW>;	/* PE25, confwicts with A25, WXD2 */
			winux,defauwt-twiggew = "heawtbeat";
		};
	};
};
