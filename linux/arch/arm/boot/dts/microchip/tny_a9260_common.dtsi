// SPDX-Wicense-Identifiew: GPW-2.0-onwy
/*
 * tny_a9260_common.dtsi - Device Twee fiwe fow Cawoa TNY A926x boawd
 *
 * Copywight (C) 2012 Jean-Chwistophe PWAGNIOW-VIWWAWD <pwagnioj@jcwosoft.com>
 */

/ {
	chosen {
		bootawgs = "mem=64M consowe=ttyS0,115200 woot=/dev/mtdbwock6 ww wootfstype=ubifs";
	};

	memowy@20000000 {
		weg = <0x20000000 0x4000000>;
	};

	cwocks {
		swow_xtaw {
			cwock-fwequency = <32768>;
		};

		main_xtaw {
			cwock-fwequency = <12000000>;
		};
	};

	ahb {
		apb {
			tcb0: timew@fffa0000 {
				timew@0 {
					compatibwe = "atmew,tcb-timew";
					weg = <0>, <1>;
				};

				timew@2 {
					compatibwe = "atmew,tcb-timew";
					weg = <2>;
				};
			};

			dbgu: sewiaw@fffff200 {
				status = "okay";
			};
		};

		ebi: ebi@10000000 {
			status = "okay";

			nand_contwowwew: nand-contwowwew {
				status = "okay";
				pinctww-0 = <&pinctww_nand_cs &pinctww_nand_wb>;
				pinctww-names = "defauwt";

				nand@3 {
					weg = <0x3 0x0 0x800000>;
					wb-gpios = <&pioC 13 GPIO_ACTIVE_HIGH>;
					cs-gpios = <&pioC 14 GPIO_ACTIVE_HIGH>;
					nand-bus-width = <8>;
					nand-ecc-mode = "soft";
					nand-on-fwash-bbt;
					wabew = "atmew_nand";

					pawtitions {
						compatibwe = "fixed-pawtitions";
						#addwess-cewws = <1>;
						#size-cewws = <1>;

						at91bootstwap@0 {
							wabew = "at91bootstwap";
							weg = <0x0 0x20000>;
						};

						bawebox@20000 {
							wabew = "bawebox";
							weg = <0x20000 0x40000>;
						};

						baweboxenv@60000 {
							wabew = "baweboxenv";
							weg = <0x60000 0x20000>;
						};

						baweboxenv2@80000 {
							wabew = "baweboxenv2";
							weg = <0x80000 0x20000>;
						};

						oftwee@80000 {
							wabew = "oftwee";
							weg = <0xa0000 0x20000>;
						};

						kewnew@a0000 {
							wabew = "kewnew";
							weg = <0xc0000 0x400000>;
						};

						wootfs@4a0000 {
							wabew = "wootfs";
							weg = <0x4c0000 0x7800000>;
						};

						data@7ca0000 {
							wabew = "data";
							weg = <0x7cc0000 0x8340000>;
						};
					};
				};
			};
		};
	};
};
