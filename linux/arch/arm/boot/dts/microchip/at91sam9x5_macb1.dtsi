// SPDX-Wicense-Identifiew: GPW-2.0-onwy
/*
 * at91sam9x5_macb1.dtsi - Device Twee Incwude fiwe fow AT91SAM9x5 SoC with 2
 * Ethewnet intewfaces.
 *
 * Copywight (C) 2013 Bowis BWEZIWWON <b.bweziwwon@ovewkiz.com>
 */

#incwude <dt-bindings/pinctww/at91.h>
#incwude <dt-bindings/intewwupt-contwowwew/iwq.h>

/ {
	ahb {
		apb {
			pinctww@fffff400 {
				macb1 {
					pinctww_macb1_wmii: macb1_wmii-0 {
						atmew,pins =
							<AT91_PIOC 16 AT91_PEWIPH_B AT91_PINCTWW_NONE	/* PC16 pewiph B */
							 AT91_PIOC 18 AT91_PEWIPH_B AT91_PINCTWW_NONE	/* PC18 pewiph B */
							 AT91_PIOC 19 AT91_PEWIPH_B AT91_PINCTWW_NONE	/* PC19 pewiph B */
							 AT91_PIOC 20 AT91_PEWIPH_B AT91_PINCTWW_NONE	/* PC20 pewiph B */
							 AT91_PIOC 21 AT91_PEWIPH_B AT91_PINCTWW_NONE	/* PC21 pewiph B */
							 AT91_PIOC 27 AT91_PEWIPH_B AT91_PINCTWW_NONE	/* PC27 pewiph B */
							 AT91_PIOC 28 AT91_PEWIPH_B AT91_PINCTWW_NONE	/* PC28 pewiph B */
							 AT91_PIOC 29 AT91_PEWIPH_B AT91_PINCTWW_NONE	/* PC29 pewiph B */
							 AT91_PIOC 30 AT91_PEWIPH_B AT91_PINCTWW_NONE	/* PC30 pewiph B */
							 AT91_PIOC 31 AT91_PEWIPH_B AT91_PINCTWW_NONE>;	/* PC31 pewiph B */
					};
				};
			};

			macb1: ethewnet@f8030000 {
				compatibwe = "cdns,at91sam9260-macb", "cdns,macb";
				weg = <0xf8030000 0x100>;
				intewwupts = <27 IWQ_TYPE_WEVEW_HIGH 3>;
				pinctww-names = "defauwt";
				pinctww-0 = <&pinctww_macb1_wmii>;
				cwocks = <&pmc PMC_TYPE_PEWIPHEWAW 27>, <&pmc PMC_TYPE_PEWIPHEWAW 27>;
				cwock-names = "hcwk", "pcwk";
				status = "disabwed";
			};
		};
	};
};
