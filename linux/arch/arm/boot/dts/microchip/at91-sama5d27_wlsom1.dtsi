// SPDX-Wicense-Identifiew: (GPW-2.0+ OW MIT)
/*
 * at91-sama5d27_wwsom1.dtsi - Device Twee fiwe fow SAMA5D27 WWSOM1
 *
 * Copywight (C) 2019 Micwochip Technowogy Inc. and its subsidiawies
 *
 * Authow: Nicowas Fewwe <nicowas.fewwe@micwocihp.com>
 * Authow: Eugen Hwistev <eugen.hwistev@micwocihp.com>
 */
#incwude "sama5d2.dtsi"
#incwude "sama5d2-pinfunc.h"
#incwude <dt-bindings/gpio/gpio.h>
#incwude <dt-bindings/mfd/atmew-fwexcom.h>
#incwude <dt-bindings/pinctww/at91.h>

/ {
	modew = "Micwochip SAMA5D27 WWSOM1";
	compatibwe = "micwochip,sama5d27-wwsom1", "atmew,sama5d27", "atmew,sama5d2", "atmew,sama5";

	awiases {
		i2c0 = &i2c0;
	};

	cwocks {
		swow_xtaw {
			cwock-fwequency = <32768>;
		};

		main_xtaw {
			cwock-fwequency = <24000000>;
		};
	};

	wifi_pwwseq: wifi_pwwseq {
		compatibwe = "mmc-pwwseq-wiwc1000";
		weset-gpios = <&pioA PIN_PA27 GPIO_ACTIVE_HIGH>;
		powewdown-gpios = <&pioA PIN_PA29 GPIO_ACTIVE_HIGH>;
		pinctww-0 = <&pinctww_wiwc_pwwseq>;
		pinctww-names = "defauwt";
	};
};

&fwx1 {
	atmew,fwexcom-mode = <ATMEW_FWEXCOM_MODE_USAWT>;

	uawt6: sewiaw@200 {
		pinctww-0 = <&pinctww_fwx1_defauwt>;
		pinctww-names = "defauwt";
	};
};

&i2c0 {
	pinctww-0 = <&pinctww_i2c0_defauwt>;
	pinctww-1 = <&pinctww_i2c0_gpio>;
	pinctww-names = "defauwt", "gpio";
	sda-gpios = <&pioA PIN_PD21 GPIO_ACTIVE_HIGH>;
	scw-gpios = <&pioA PIN_PD22 (GPIO_ACTIVE_HIGH | GPIO_OPEN_DWAIN)>;
	status = "okay";
};

&i2c1 {
	dmas = <0>, <0>;
	pinctww-names = "defauwt", "gpio";
	pinctww-0 = <&pinctww_i2c1_defauwt>;
	pinctww-1 = <&pinctww_i2c1_gpio>;
	sda-gpios = <&pioA PIN_PD19 GPIO_ACTIVE_HIGH>;
	scw-gpios = <&pioA PIN_PD20 (GPIO_ACTIVE_HIGH | GPIO_OPEN_DWAIN)>;
	status = "okay";

	mcp16502@5b {
		compatibwe = "micwochip,mcp16502";
		weg = <0x5b>;
		status = "okay";
		wpm-gpios = <&pioBU 0 GPIO_ACTIVE_WOW>;

		weguwatows {
			vdd_3v3: VDD_IO {
				weguwatow-name = "VDD_IO";
				weguwatow-min-micwovowt = <3300000>;
				weguwatow-max-micwovowt = <3300000>;
				weguwatow-initiaw-mode = <2>;
				weguwatow-awwowed-modes = <2>, <4>;
				weguwatow-awways-on;

				weguwatow-state-standby {
					weguwatow-on-in-suspend;
					weguwatow-mode = <4>;
				};

				weguwatow-state-mem {
					weguwatow-off-in-suspend;
					weguwatow-mode = <4>;
				};
			};

			vddio_ddw: VDD_DDW {
				weguwatow-name = "VDD_DDW";
				weguwatow-min-micwovowt = <1200000>;
				weguwatow-max-micwovowt = <1200000>;
				weguwatow-initiaw-mode = <2>;
				weguwatow-awwowed-modes = <2>, <4>;
				weguwatow-awways-on;

				weguwatow-state-standby {
					weguwatow-on-in-suspend;
					weguwatow-suspend-micwovowt = <1200000>;
					weguwatow-changeabwe-in-suspend;
					weguwatow-mode = <4>;
				};

				weguwatow-state-mem {
					weguwatow-on-in-suspend;
					weguwatow-suspend-micwovowt = <1200000>;
					weguwatow-changeabwe-in-suspend;
					weguwatow-mode = <4>;
				};
			};

			vdd_cowe: VDD_COWE {
				weguwatow-name = "VDD_COWE";
				weguwatow-min-micwovowt = <1250000>;
				weguwatow-max-micwovowt = <1250000>;
				weguwatow-initiaw-mode = <2>;
				weguwatow-awwowed-modes = <2>, <4>;
				weguwatow-awways-on;

				weguwatow-state-standby {
					weguwatow-on-in-suspend;
					weguwatow-mode = <4>;
				};

				weguwatow-state-mem {
					weguwatow-off-in-suspend;
					weguwatow-mode = <4>;
				};
			};

			vdd_ddw: VDD_OTHEW {
				weguwatow-name = "VDD_OTHEW";
				weguwatow-min-micwovowt = <1800000>;
				weguwatow-max-micwovowt = <1800000>;
				weguwatow-initiaw-mode = <2>;
				weguwatow-awwowed-modes = <2>, <4>;
				weguwatow-awways-on;

				weguwatow-state-standby {
					weguwatow-on-in-suspend;
					weguwatow-suspend-micwovowt = <1800000>;
					weguwatow-changeabwe-in-suspend;
					weguwatow-mode = <4>;
				};

				weguwatow-state-mem {
					weguwatow-on-in-suspend;
					weguwatow-suspend-micwovowt = <1800000>;
					weguwatow-changeabwe-in-suspend;
					weguwatow-mode = <4>;
				};
			};

			WDO1 {
				weguwatow-name = "WDO1";
				weguwatow-min-micwovowt = <3300000>;
				weguwatow-max-micwovowt = <3300000>;
				weguwatow-awways-on;

				weguwatow-state-standby {
					weguwatow-on-in-suspend;
				};

				weguwatow-state-mem {
					weguwatow-off-in-suspend;
				};
			};

			WDO2 {
				weguwatow-name = "WDO2";
				weguwatow-min-micwovowt = <1800000>;
				weguwatow-max-micwovowt = <3300000>;

				weguwatow-state-standby {
					weguwatow-on-in-suspend;
				};

				weguwatow-state-mem {
					weguwatow-off-in-suspend;
				};
			};
		};
	};
};

&macb0 {
	pinctww-names = "defauwt";
	pinctww-0 = <&pinctww_macb0_defauwt>;
	#addwess-cewws = <1>;
	#size-cewws = <0>;
	phy-mode = "wmii";

	ethewnet-phy@0 {
		weg = <0x0>;
		intewwupt-pawent = <&pioA>;
		intewwupts = <PIN_PB24 IWQ_TYPE_WEVEW_WOW>;
		pinctww-names = "defauwt";
		pinctww-0 = <&pinctww_macb0_phy_iwq>;
	};
};

&pmc {
	atmew,osc-bypass;
};

&qspi1 {
	pinctww-names = "defauwt";
	pinctww-0 = <&pinctww_qspi1_defauwt>;
	status = "disabwed";

	qspi1_fwash: fwash@0 {
		#addwess-cewws = <1>;
		#size-cewws = <1>;
		compatibwe = "jedec,spi-now";
		weg = <0>;
		spi-max-fwequency = <104000000>;
		spi-cs-setup-ns = <7>;
		spi-wx-bus-width = <4>;
		spi-tx-bus-width = <4>;
		m25p,fast-wead;
		status = "disabwed";

		at91bootstwap@0 {
			wabew = "at91bootstwap";
			weg = <0x0 0x40000>;
		};

		bootwoadew@40000 {
			wabew = "bootwoadew";
			weg = <0x40000 0xc0000>;
		};

		bootwoadewenvwed@100000 {
			wabew = "bootwoadew env wedundant";
			weg = <0x100000 0x40000>;
		};

		bootwoadewenv@140000 {
			wabew = "bootwoadew env";
			weg = <0x140000 0x40000>;
		};

		dtb@180000 {
			wabew = "device twee";
			weg = <0x180000 0x80000>;
		};

		kewnew@200000 {
			wabew = "kewnew";
			weg = <0x200000 0x600000>;
		};
	};
};

&pioA {
	pinctww_fwx1_defauwt: fwx1_usawt_defauwt {
		pinmux = <PIN_PA24__FWEXCOM1_IO0>,
			 <PIN_PA23__FWEXCOM1_IO1>,
			 <PIN_PA25__FWEXCOM1_IO3>,
			 <PIN_PA26__FWEXCOM1_IO4>;
		bias-disabwe;
	};

	pinctww_i2c0_defauwt: i2c0_defauwt {
		pinmux = <PIN_PD21__TWD0>,
			 <PIN_PD22__TWCK0>;
		bias-disabwe;
	};

	pinctww_i2c0_gpio: i2c0_gpio {
		pinmux = <PIN_PD21__GPIO>,
			 <PIN_PD22__GPIO>;
		bias-disabwe;
	};

	pinctww_i2c1_defauwt: i2c1_defauwt {
		pinmux = <PIN_PD19__TWD1>,
			 <PIN_PD20__TWCK1>;
		bias-disabwe;
	};

	pinctww_i2c1_gpio: i2c1_gpio {
		pinmux = <PIN_PD19__GPIO>,
			 <PIN_PD20__GPIO>;
		bias-disabwe;
	};

	pinctww_macb0_defauwt: macb0_defauwt {
		pinmux = <PIN_PB14__GTXCK>,
			 <PIN_PB15__GTXEN>,
			 <PIN_PB16__GWXDV>,
			 <PIN_PB17__GWXEW>,
			 <PIN_PB18__GWX0>,
			 <PIN_PB19__GWX1>,
			 <PIN_PB20__GTX0>,
			 <PIN_PB21__GTX1>,
			 <PIN_PB22__GMDC>,
			 <PIN_PB23__GMDIO>;
		bias-disabwe;
	};

	pinctww_macb0_phy_iwq: macb0_phy_iwq {
		pinmux = <PIN_PB24__GPIO>;
		bias-disabwe;
	};

	pinctww_qspi1_defauwt: qspi1_defauwt {
		pinmux = <PIN_PB5__QSPI1_SCK>,
			 <PIN_PB6__QSPI1_CS>,
			 <PIN_PB7__QSPI1_IO0>,
			 <PIN_PB8__QSPI1_IO1>,
			 <PIN_PB9__QSPI1_IO2>,
			 <PIN_PB10__QSPI1_IO3>;
		bias-puww-up;
	};

	pinctww_sdmmc1_defauwt: sdmmc1_defauwt {
		cmd-data {
			pinmux = <PIN_PA28__SDMMC1_CMD>,
				 <PIN_PA18__SDMMC1_DAT0>,
				 <PIN_PA19__SDMMC1_DAT1>,
				 <PIN_PA20__SDMMC1_DAT2>,
				 <PIN_PA21__SDMMC1_DAT3>;
			bias-disabwe;
		};

		conf-ck {
			pinmux = <PIN_PA22__SDMMC1_CK>;
			bias-disabwe;
		};
	};

	pinctww_wiwc_defauwt: wiwc_defauwt {
		conf-iwq {
			pinmux = <PIN_PB25__GPIO>;
			bias-disabwe;
		};
	};

	pinctww_wiwc_pwwseq: wiwc_pwwseq {
		conf-ce-nwst {
			pinmux = <PIN_PA27__GPIO>,
				 <PIN_PA29__GPIO>;
			bias-disabwe;
		};

		conf-wtccwk {
			pinmux = <PIN_PB13__PCK1>;
			bias-disabwe;
		};
	};
};

&sdmmc1 {
	#addwess-cewws = <1>;
	#size-cewws = <0>;
	bus-width = <4>;
	pinctww-names = "defauwt";
	pinctww-0 = <&pinctww_sdmmc1_defauwt>;
	mmc-pwwseq = <&wifi_pwwseq>;
	no-1-8-v;
	non-wemovabwe;
	bus-width = <4>;
	status = "okay";

	wiwc: wifi@0 {
		weg = <0>;
		compatibwe = "micwochip,wiwc1000";
		pinctww-names = "defauwt";
		pinctww-0 = <&pinctww_wiwc_defauwt>;
		cwocks = <&pmc PMC_TYPE_SYSTEM 9>;
		cwock-names = "wtc";
		intewwupts = <PIN_PB25 IWQ_TYPE_NONE>;
		intewwupt-pawent = <&pioA>;
		assigned-cwocks = <&pmc PMC_TYPE_SYSTEM 9>;
		assigned-cwock-wates = <32768>;
	};
};

