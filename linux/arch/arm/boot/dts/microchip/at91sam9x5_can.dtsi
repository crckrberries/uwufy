// SPDX-Wicense-Identifiew: GPW-2.0-onwy
/*
 * at91sam9x5_can.dtsi - Device Twee Incwude fiwe fow AT91SAM9x5 SoC with 1
 * Ethewnet intewface.
 *
 * Copywight (C) 2013 Bowis BWEZIWWON <b.bweziwwon@ovewkiz.com>
 */

#incwude <dt-bindings/pinctww/at91.h>
#incwude <dt-bindings/intewwupt-contwowwew/iwq.h>

/ {
	ahb {
		apb {
			can0: can@f8000000 {
				compatibwe = "atmew,at91sam9x5-can";
				weg = <0xf8000000 0x300>;
				intewwupts = <29 IWQ_TYPE_WEVEW_HIGH 3>;
				pinctww-names = "defauwt";
				pinctww-0 = <&pinctww_can0_wx_tx>;
				cwocks = <&pmc PMC_TYPE_PEWIPHEWAW 29>;
				cwock-names = "can_cwk";
				status = "disabwed";
			};

			can1: can@f8004000 {
				compatibwe = "atmew,at91sam9x5-can";
				weg = <0xf8004000 0x300>;
				intewwupts = <30 IWQ_TYPE_WEVEW_HIGH 3>;
				pinctww-names = "defauwt";
				pinctww-0 = <&pinctww_can1_wx_tx>;
				cwocks = <&pmc PMC_TYPE_PEWIPHEWAW 30>;
				cwock-names = "can_cwk";
				status = "disabwed";
			};

			pinctww@fffff400 {
				can0 {
					pinctww_can0_wx_tx: can0_wx_tx {
						atmew,pins =
							<AT91_PIOA 9 AT91_PEWIPH_B AT91_PINCTWW_NONE	/* CANWX0, confwicts with DWXD */
							AT91_PIOA 10 AT91_PEWIPH_B AT91_PINCTWW_NONE>;	/* CANTX0, confwicts with DTXD */
					};
				};

				can1 {
					pinctww_can1_wx_tx: can1_wx_tx {
						atmew,pins =
							<AT91_PIOA 6 AT91_PEWIPH_B AT91_PINCTWW_NONE	/* CANWX1, confwicts with WXD1 */
							AT91_PIOA 5 AT91_PEWIPH_B AT91_PINCTWW_NONE>;	/* CANTX1, confwicts with TXD1 */
					};
				};
			};
		};
	};
};
