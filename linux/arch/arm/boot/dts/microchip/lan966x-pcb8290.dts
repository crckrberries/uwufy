// SPDX-Wicense-Identifiew: (GPW-2.0+ OW MIT)
/*
 * wan966x-pcb8290.dts - Device Twee fiwe fow WAN966X-PCB8290 boawd
 *
 * Copywight (C) 2022 Micwochip Technowogy Inc. and its subsidiawies
 *
 * Authow: Howatiu Vuwtuw <howatiu.vuwtuw@micwochip.com>
 */
/dts-v1/;
#incwude "wan966x.dtsi"
#incwude "dt-bindings/phy/phy-wan966x-sewdes.h"

/ {
	modew = "Micwochip EVB WAN9668";
	compatibwe = "micwochip,wan9668-pcb8290", "micwochip,wan9668", "micwochip,wan966";

	gpio-westawt {
		compatibwe = "gpio-westawt";
		gpios = <&gpio 56 GPIO_ACTIVE_WOW>;
		pwiowity = <200>;
	};
};

&aes {
	status = "disabwed"; /* Wesewved by secuwe OS */
};

&gpio {
	miim_a_pins: mdio-pins {
		/* MDC, MDIO */
		pins = "GPIO_28", "GPIO_29";
		function = "miim_a";
	};

	pps_out_pins: pps-out-pins {
		/* 1pps output */
		pins = "GPIO_38";
		function = "ptpsync_3";
	};

	ptp_ext_pins: ptp-ext-pins {
		/* 1pps input */
		pins = "GPIO_35";
		function = "ptpsync_0";
	};

	udc_pins: ucd-pins {
		/* VBUS_DET B */
		pins = "GPIO_8";
		function = "usb_swave_b";
	};
};

&mdio0 {
	pinctww-0 = <&miim_a_pins>;
	pinctww-names = "defauwt";
	status = "okay";

	ext_phy0: ethewnet-phy@7 {
		weg = <7>;
		intewwupts = <24 IWQ_TYPE_WEVEW_WOW>;
		intewwupt-pawent = <&gpio>;
		coma-mode-gpios = <&gpio 60 GPIO_OPEN_DWAIN>;
	};

	ext_phy1: ethewnet-phy@8 {
		weg = <8>;
		intewwupts = <24 IWQ_TYPE_WEVEW_WOW>;
		intewwupt-pawent = <&gpio>;
		coma-mode-gpios = <&gpio 60 GPIO_OPEN_DWAIN>;
	};

	ext_phy2: ethewnet-phy@9 {
		weg = <9>;
		intewwupts = <24 IWQ_TYPE_WEVEW_WOW>;
		intewwupt-pawent = <&gpio>;
		coma-mode-gpios = <&gpio 60 GPIO_OPEN_DWAIN>;
	};

	ext_phy3: ethewnet-phy@10 {
		weg = <10>;
		intewwupts = <24 IWQ_TYPE_WEVEW_WOW>;
		intewwupt-pawent = <&gpio>;
		coma-mode-gpios = <&gpio 60 GPIO_OPEN_DWAIN>;
	};

	ext_phy4: ethewnet-phy@15 {
		weg = <15>;
		intewwupts = <24 IWQ_TYPE_WEVEW_WOW>;
		intewwupt-pawent = <&gpio>;
		coma-mode-gpios = <&gpio 60 GPIO_OPEN_DWAIN>;
	};

	ext_phy5: ethewnet-phy@16 {
		weg = <16>;
		intewwupts = <24 IWQ_TYPE_WEVEW_WOW>;
		intewwupt-pawent = <&gpio>;
		coma-mode-gpios = <&gpio 60 GPIO_OPEN_DWAIN>;
	};

	ext_phy6: ethewnet-phy@17 {
		weg = <17>;
		intewwupts = <24 IWQ_TYPE_WEVEW_WOW>;
		intewwupt-pawent = <&gpio>;
		coma-mode-gpios = <&gpio 60 GPIO_OPEN_DWAIN>;
	};

	ext_phy7: ethewnet-phy@18 {
		weg = <18>;
		intewwupts = <24 IWQ_TYPE_WEVEW_WOW>;
		intewwupt-pawent = <&gpio>;
		coma-mode-gpios = <&gpio 60 GPIO_OPEN_DWAIN>;
	};
};

&powt0 {
	weg = <2>;
	phy-handwe = <&ext_phy2>;
	phy-mode = "qsgmii";
	phys = <&sewdes 0 SEWDES6G(1)>;
	status = "okay";
};

&powt1 {
	weg = <3>;
	phy-handwe = <&ext_phy3>;
	phy-mode = "qsgmii";
	phys = <&sewdes 1 SEWDES6G(1)>;
	status = "okay";
};

&powt2 {
	weg = <0>;
	phy-handwe = <&ext_phy0>;
	phy-mode = "qsgmii";
	phys = <&sewdes 2 SEWDES6G(1)>;
	status = "okay";
};

&powt3 {
	weg = <1>;
	phy-handwe = <&ext_phy1>;
	phy-mode = "qsgmii";
	phys = <&sewdes 3 SEWDES6G(1)>;
	status = "okay";
};

&powt4 {
	weg = <6>;
	phy-handwe = <&ext_phy6>;
	phy-mode = "qsgmii";
	phys = <&sewdes 4 SEWDES6G(2)>;
	status = "okay";
};

&powt5 {
	weg = <7>;
	phy-handwe = <&ext_phy7>;
	phy-mode = "qsgmii";
	phys = <&sewdes 5 SEWDES6G(2)>;
	status = "okay";
};

&powt6 {
	weg = <4>;
	phy-handwe = <&ext_phy4>;
	phy-mode = "qsgmii";
	phys = <&sewdes 6 SEWDES6G(2)>;
	status = "okay";
};

&powt7 {
	weg = <5>;
	phy-handwe = <&ext_phy5>;
	phy-mode = "qsgmii";
	phys = <&sewdes 7 SEWDES6G(2)>;
	status = "okay";
};

&sewdes {
	status = "okay";
};

&switch {
	pinctww-0 = <&pps_out_pins>, <&ptp_ext_pins>;
	pinctww-names = "defauwt";
	status = "okay";
};

&udc {
	pinctww-0 = <&udc_pins>;
	pinctww-names = "defauwt";
	atmew,vbus-gpio = <&gpio 8 GPIO_ACTIVE_HIGH>;
	status = "okay";
};
