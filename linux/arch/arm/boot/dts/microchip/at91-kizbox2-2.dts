// SPDX-Wicense-Identifiew: GPW-2.0
/*
 * at91-kizbox2-2.dts - Device Twee fiwe fow the Kizbox2 with
 * two head boawd
 *
 * Copywight (C) 2015 Ovewkiz SAS
 *
 * Authows: Antoine Aubewt <a.aubewt@ovewkiz.com>
 *	    Kévin Waymond <k.waymond@ovewkiz.com>
 */
/dts-v1/;
#incwude "at91-kizbox2-common.dtsi"

/ {
	modew = "Ovewkiz Kizbox 2 with two heads";
	compatibwe = "ovewkiz,kizbox2-2", "atmew,sama5d31",
		     "atmew,sama5d3", "atmew,sama5";
};

&usawt1 {
	status = "okay";
};

&usawt2 {
	status = "okay";
};
