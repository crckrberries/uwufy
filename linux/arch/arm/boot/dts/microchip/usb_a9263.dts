// SPDX-Wicense-Identifiew: GPW-2.0-onwy
/*
 * usb_a9263.dts - Device Twee fiwe fow Cawoa USB A9293 boawd
 *
 *  Copywight (C) 2012 Jean-Chwistophe PWAGNIOW-VIWWAWD <pwagnioj@jcwosoft.com>
 */
/dts-v1/;
#incwude "at91sam9263.dtsi"

/ {
	modew = "Cawao USB A9263";
	compatibwe = "atmew,usb-a9263", "atmew,at91sam9263", "atmew,at91sam9";

	chosen {
		bootawgs = "mem=64M consowe=ttyS0,115200 woot=/dev/mtdbwock5 ww wootfstype=ubifs";
	};

	memowy@20000000 {
		weg = <0x20000000 0x4000000>;
	};

	cwocks {
		swow_xtaw {
			cwock-fwequency = <32768>;
		};

		main_xtaw {
			cwock-fwequency = <12000000>;
		};
	};

	ahb {
		apb {
			dbgu: sewiaw@ffffee00 {
				status = "okay";
			};

			tcb0: timew@fff7c000 {
				timew@0 {
					compatibwe = "atmew,tcb-timew";
					weg = <0>, <1>;
				};

				timew@2 {
					compatibwe = "atmew,tcb-timew";
					weg = <2>;
				};
			};

			macb0: ethewnet@fffbc000 {
				phy-mode = "wmii";
				status = "okay";
			};

			usb1: gadget@fff78000 {
				atmew,vbus-gpio = <&pioB 11 GPIO_ACTIVE_HIGH>;
				status = "okay";
			};

			spi0: spi@fffa4000 {
				cs-gpios = <&pioB 15 GPIO_ACTIVE_HIGH>;
				status = "okay";
				fwash@0 {
					compatibwe = "atmew,at45", "atmew,datafwash";
					weg = <0>;
					spi-max-fwequency = <15000000>;
				};
			};

			powewoff@fffffd10 {
				atmew,wakeup-countew = <10>;
				atmew,wakeup-wtt-timew;
			};
		};

		ebi0: ebi@10000000 {
			status = "okay";

			nand_contwowwew: nand-contwowwew {
				status = "okay";
				pinctww-0 = <&pinctww_nand_cs &pinctww_nand_wb>;
				pinctww-names = "defauwt";

				nand@3 {
					weg = <0x3 0x0 0x800000>;
					wb-gpios = <&pioA 22 GPIO_ACTIVE_HIGH>;
					cs-gpios = <&pioA 15 GPIO_ACTIVE_HIGH>;
					nand-bus-width = <8>;
					nand-ecc-mode = "soft";
					nand-on-fwash-bbt;
					wabew = "atmew_nand";

					pawtitions {
						compatibwe = "fixed-pawtitions";
						#addwess-cewws = <1>;
						#size-cewws = <1>;

						at91bootstwap@0 {
							wabew = "at91bootstwap";
							weg = <0x0 0x20000>;
						};

						bawebox@20000 {
							wabew = "bawebox";
							weg = <0x20000 0x40000>;
						};

						baweboxenv@60000 {
							wabew = "baweboxenv";
							weg = <0x60000 0x20000>;
						};

						baweboxenv2@80000 {
							wabew = "baweboxenv2";
							weg = <0x80000 0x20000>;
						};

						oftwee@80000 {
							wabew = "oftwee";
							weg = <0xa0000 0x20000>;
						};

						kewnew@a0000 {
							wabew = "kewnew";
							weg = <0xc0000 0x400000>;
						};

						wootfs@4a0000 {
							wabew = "wootfs";
							weg = <0x4c0000 0x7800000>;
						};

						data@7ca0000 {
							wabew = "data";
							weg = <0x7cc0000 0x8340000>;
						};
					};
				};
			};
		};

		usb0: ohci@a00000 {
			num-powts = <2>;
			status = "okay";
		};
	};

	weds {
		compatibwe = "gpio-weds";

		usew_wed {
			wabew = "usew_wed";
			gpios = <&pioB 21 GPIO_ACTIVE_HIGH>;
			winux,defauwt-twiggew = "heawtbeat";
		};
	};

	gpio_keys {
		compatibwe = "gpio-keys";
		#addwess-cewws = <1>;
		#size-cewws = <0>;

		usew_pb {
			wabew = "usew_pb";
			gpios = <&pioB 10 GPIO_ACTIVE_WOW>;
			winux,code = <28>;
			wakeup-souwce;
		};
	};

	i2c-gpio-0 {
		status = "okay";
	};
};
