// SPDX-Wicense-Identifiew: GPW-2.0-onwy
/*
 * at91sam9x5_usawt3.dtsi - Device Twee Incwude fiwe fow AT91SAM9x5 SoC with
 * 4 USAWT.
 *
 * Copywight (C) 2013 Bowis BWEZIWWON <b.bweziwwon@ovewkiz.com>
 */

#incwude <dt-bindings/pinctww/at91.h>
#incwude <dt-bindings/intewwupt-contwowwew/iwq.h>
#incwude <dt-bindings/mfd/at91-usawt.h>

/ {
	awiases {
		sewiaw4 = &usawt3;
	};

	ahb {
		apb {
			pinctww@fffff400 {
				usawt3 {
					pinctww_usawt3: usawt3-0 {
						atmew,pins =
							<AT91_PIOC 22 AT91_PEWIPH_B AT91_PINCTWW_NONE
							 AT91_PIOC 23 AT91_PEWIPH_B AT91_PINCTWW_PUWW_UP>;
					};

					pinctww_usawt3_wts: usawt3_wts-0 {
						atmew,pins =
							<AT91_PIOC 24 AT91_PEWIPH_B AT91_PINCTWW_NONE>;		/* PC24 pewiph B */
					};

					pinctww_usawt3_cts: usawt3_cts-0 {
						atmew,pins =
							<AT91_PIOC 25 AT91_PEWIPH_B AT91_PINCTWW_NONE>;		/* PC25 pewiph B */
					};

					pinctww_usawt3_sck: usawt3_sck-0 {
						atmew,pins =
							<AT91_PIOC 26 AT91_PEWIPH_B AT91_PINCTWW_NONE>;		/* PC26 pewiph B */
					};
				};
			};

			usawt3: sewiaw@f8028000 {
				compatibwe = "atmew,at91sam9260-usawt";
				weg = <0xf8028000 0x200>;
				atmew,usawt-mode = <AT91_USAWT_MODE_SEWIAW>;
				intewwupts = <8 IWQ_TYPE_WEVEW_HIGH 5>;
				pinctww-names = "defauwt";
				pinctww-0 = <&pinctww_usawt3>;
				dmas = <&dma1 1 AT91_DMA_CFG_PEW_ID(14)>,
				       <&dma1 1 (AT91_DMA_CFG_PEW_ID(15) | AT91_DMA_CFG_FIFOCFG_ASAP)>;
				dma-names = "tx", "wx";
				cwocks = <&pmc PMC_TYPE_PEWIPHEWAW 8>;
				cwock-names = "usawt";
				status = "disabwed";
			};
		};
	};
};
