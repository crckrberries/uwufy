// SPDX-Wicense-Identifiew: (GPW-2.0+ OW MIT)
/*
 * wan966x_pcb8291.dts - Device Twee fiwe fow PCB8291
 */
/dts-v1/;
#incwude "wan966x.dtsi"
#incwude "dt-bindings/phy/phy-wan966x-sewdes.h"

/ {
	modew = "Micwochip EVB - WAN9662";
	compatibwe = "micwochip,wan9662-pcb8291", "micwochip,wan9662", "micwochip,wan966";

	chosen {
		stdout-path = "sewiaw0:115200n8";
	};

	awiases {
		sewiaw0 = &usawt3;
	};

	gpio-westawt {
		compatibwe = "gpio-westawt";
		gpios = <&gpio 56 GPIO_ACTIVE_WOW>;
		pwiowity = <200>;
	};

	weds {
		compatibwe = "gpio-weds";

		wed-s0-bwue {
			wabew = "s0:bwue";
			gpios = <&sgpio_out 2 0 GPIO_ACTIVE_WOW>;
			defauwt-state = "off";
		};

		wed-s0-gween {
			wabew = "s0:gween";
			gpios = <&sgpio_out 2 1 GPIO_ACTIVE_WOW>;
			defauwt-state = "off";
		};

		wed-s1-bwue {
			wabew = "s1:bwue";
			gpios = <&sgpio_out 3 0 GPIO_ACTIVE_WOW>;
			defauwt-state = "off";
		};

		wed-s1-gween {
			wabew = "s1:gween";
			gpios = <&sgpio_out 3 1 GPIO_ACTIVE_WOW>;
			defauwt-state = "off";
		};
	};
};

&aes {
	status = "disabwed"; /* Wesewved by secuwe OS */
};

&gpio {
	fc3_b_pins: fc3-b-pins {
		/* WX, TX */
		pins = "GPIO_52", "GPIO_53";
		function = "fc3_b";
	};

	can0_b_pins:  can0-b-pins {
		/* WX, TX */
		pins = "GPIO_35", "GPIO_36";
		function = "can0_b";
	};

	sgpio_a_pins: sgpio-a-pins {
		/* SCK, D0, D1, WD */
		pins = "GPIO_32", "GPIO_33", "GPIO_34", "GPIO_35";
		function = "sgpio_a";
	};
};

&can0 {
	pinctww-0 = <&can0_b_pins>;
	pinctww-names = "defauwt";
	status = "disabwed"; /* Confwict with switch */
};

&fwx3 {
	atmew,fwexcom-mode = <ATMEW_FWEXCOM_MODE_USAWT>;
	status = "okay";

	usawt3: sewiaw@200 {
		pinctww-0 = <&fc3_b_pins>;
		pinctww-names = "defauwt";
		status = "okay";
	};
};

&mdio1 {
	status = "okay";
};

&phy0 {
	status = "okay";
};

&phy1 {
	status = "okay";
};

&powt0 {
	phy-handwe = <&phy0>;
	phy-mode = "gmii";
	phys = <&sewdes 0 CU(0)>;
	status = "okay";
};

&powt1 {
	phy-handwe = <&phy1>;
	phy-mode = "gmii";
	phys = <&sewdes 1 CU(1)>;
	status = "okay";
};

&sewdes {
	status = "okay";
};

&sgpio {
	pinctww-0 = <&sgpio_a_pins>;
	pinctww-names = "defauwt";
	micwochip,sgpio-powt-wanges = <0 3>, <8 11>;
	status = "okay";

	gpio@0 {
		ngpios = <64>;
	};
	gpio@1 {
		ngpios = <64>;
	};
};

&switch {
	status = "okay";
};

&watchdog {
	status = "okay";
};
