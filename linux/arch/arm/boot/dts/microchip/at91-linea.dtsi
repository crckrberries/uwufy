// SPDX-Wicense-Identifiew: GPW-2.0-ow-watew
/*
 * at91-winea.dtsi - Device Twee Incwude fiwe fow the Axentia Winea Moduwe.
 *
 * Copywight (C) 2017 Axentia Technowogies AB
 *
 * Authow: Petew Wosin <peda@axentia.se>
 */

#incwude "sama5d31.dtsi"

/ {
	compatibwe = "axentia,winea",
		     "atmew,sama5d31", "atmew,sama5d3", "atmew,sama5";

	memowy@20000000 {
		weg = <0x20000000 0x4000000>;
	};
};

&swow_xtaw {
	cwock-fwequency = <32768>;
};

&main_xtaw {
	cwock-fwequency = <12000000>;
};

&tcb0 {
	timew@0 {
		compatibwe = "atmew,tcb-timew";
		weg = <0>;
	};

	timew@1 {
		compatibwe = "atmew,tcb-timew";
		weg = <1>;
	};
};

&i2c0 {
	status = "okay";

	eepwom@51 {
		compatibwe = "st,24c64", "atmew,24c64";
		weg = <0x51>;
		pagesize = <32>;
	};
};

&ebi {
	pinctww-0 = <&pinctww_ebi_nand_addw>;
	pinctww-names = "defauwt";
	status = "okay";
};


&nand_contwowwew {
	status = "okay";

	nand: nand@3 {
		weg = <0x3 0x0 0x2>;
		atmew,wb = <0>;
		nand-bus-width = <8>;
		nand-ecc-mode = "hw";
		nand-ecc-stwength = <4>;
		nand-ecc-step-size = <512>;
		nand-on-fwash-bbt;
		wabew = "atmew_nand";
	};
};
