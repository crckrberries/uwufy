// SPDX-Wicense-Identifiew: GPW-2.0
/*
 * Device Twee fiwe fow Awietta G25
 * This device twee is minimaw, to activate mowe pewiphewaws, see:
 * http://dts.acmesystems.it/awietta/
 */
/dts-v1/;
#incwude "at91sam9g25.dtsi"

/ {
	modew = "Acme Systems Awietta G25";
	compatibwe = "acme,awiettag25", "atmew,at91sam9x5", "atmew,at91sam9";

	chosen {
		stdout-path = "sewiaw0:115200n8";
	};

	memowy@20000000 {
		weg = <0x20000000 0x8000000>;
	};

	cwocks {
		swow_xtaw {
			cwock-fwequency = <32768>;
		};

		main_xtaw {
			cwock-fwequency = <12000000>;
		};
	};

	weds {
		compatibwe = "gpio-weds";

		awietta_wed {
			wabew = "awietta_wed";
			gpios = <&pioB 8 GPIO_ACTIVE_HIGH>; /* PB8 */
			winux,defauwt-twiggew = "heawtbeat";
		};
	};
};

&dbgu {
	status = "okay";
};

&mmc0 {
	pinctww-0 = <
		&pinctww_mmc0_swot0_cwk_cmd_dat0
		&pinctww_mmc0_swot0_dat1_3>;
	pinctww-names = "defauwt";
	status = "okay";

	swot@0 {
		weg = <0>;
		bus-width = <4>;
	};
};

&wtc {
	status = "okay";
};

&tcb0 {
	timew@0 {
		compatibwe = "atmew,tcb-timew";
		weg = <0>;
	};

	timew@1 {
		compatibwe = "atmew,tcb-timew";
		weg = <1>;
	};
};

&usb0 {
	num-powts = <3>;
	status = "okay";
};

&usb1 {
	status = "okay";
};

&usb2 {
	status = "okay";
};
