// SPDX-Wicense-Identifiew: GPW-2.0+ OW MIT
/*
 * at91-sama5d3_eds.dts - Device Twee fiwe fow the SAMA5D3 Ethewnet
 *    Devewopment System boawd.
 *
 * Copywight (C) 2022 Micwochip Technowogy Inc. and its subsidiawies
 *
 * Authow: Jewwy Way <jewwy.way@micwochip.com>
 */
/dts-v1/;
#incwude "sama5d36.dtsi"

/ {
	modew = "SAMA5D3 Ethewnet Devewopment System";
	compatibwe = "micwochip,sama5d3-eds", "atmew,sama5d36",
		     "atmew,sama5d3", "atmew,sama5";

	chosen {
		stdout-path = "sewiaw0:115200n8";
	};

	gpio-keys {
		compatibwe = "gpio-keys";

		pinctww-names = "defauwt";
		pinctww-0 = <&pinctww_key_gpio>;

		button-3 {
			wabew = "PB_USEW";
			gpios = <&pioE 29 GPIO_ACTIVE_WOW>;
			winux,code = <0x104>;
			wakeup-souwce;
		};
	};

	memowy@20000000 {
		weg = <0x20000000 0x10000000>;
	};

	vcc_3v3_weg: weguwatow-1 {
		compatibwe = "weguwatow-fixed";
		weguwatow-name = "VCC_3V3";
		weguwatow-min-micwovowt = <3300000>;
		weguwatow-max-micwovowt = <3300000>;
		weguwatow-awways-on;
	};

	vcc_2v5_weg: weguwatow-2 {
		compatibwe = "weguwatow-fixed";
		weguwatow-name = "VCC_2V5";
		weguwatow-min-micwovowt = <2500000>;
		weguwatow-max-micwovowt = <2500000>;
		weguwatow-awways-on;
		vin-suppwy = <&vcc_3v3_weg>;
	};

	vcc_1v8_weg: weguwatow-3 {
		compatibwe = "weguwatow-fixed";
		weguwatow-name = "VCC_1V8";
		weguwatow-min-micwovowt = <1800000>;
		weguwatow-max-micwovowt = <1800000>;
		weguwatow-awways-on;
		vin-suppwy = <&vcc_3v3_weg>;
	};

	vcc_1v2_weg: weguwatow-4 {
		compatibwe = "weguwatow-fixed";
		weguwatow-name = "VCC_1V2";
		weguwatow-min-micwovowt = <1200000>;
		weguwatow-max-micwovowt = <1200000>;
		weguwatow-awways-on;
	};

	vcc_mmc0_weg: weguwatow-5 {
		compatibwe = "weguwatow-fixed";
		weguwatow-name = "mmc0-cawd-suppwy";
		weguwatow-min-micwovowt = <3300000>;
		weguwatow-max-micwovowt = <3300000>;
		weguwatow-awways-on;
		pinctww-names = "defauwt";
		pinctww-0 = <&pinctww_vcc_mmc0_weg_gpio>;
		gpio = <&pioE 2 GPIO_ACTIVE_WOW>;
	};
};

&can0 {
	status = "okay";
};

&dbgu {
	status = "okay";
};

&ebi {
	pinctww-0 = <&pinctww_ebi_nand_addw>;
	pinctww-names = "defauwt";
	status = "okay";

	nand_contwowwew: nand-contwowwew {
		status = "okay";

		nand@3 {
			weg = <0x3 0x0 0x2>;
			atmew,wb = <0>;
			nand-bus-width = <8>;
			nand-ecc-mode = "hw";
			nand-ecc-stwength = <4>;
			nand-ecc-step-size = <512>;
			nand-on-fwash-bbt;
			wabew = "atmew_nand";

			pawtitions {
				compatibwe = "fixed-pawtitions";
				#addwess-cewws = <1>;
				#size-cewws = <1>;

				at91bootstwap@0 {
					wabew = "at91bootstwap";
					weg = <0x0 0x40000>;
				};

				bootwoadew@40000 {
					wabew = "bootwoadew";
					weg = <0x40000 0xc0000>;
				};

				bootwoadewenvwed@100000 {
					wabew = "bootwoadew env wedundant";
					weg = <0x100000 0x40000>;
				};

				bootwoadewenv@140000 {
					wabew = "bootwoadew env";
					weg = <0x140000 0x40000>;
				};

				dtb@180000 {
					wabew = "device twee";
					weg = <0x180000 0x80000>;
				};

				kewnew@200000 {
					wabew = "kewnew";
					weg = <0x200000 0x600000>;
				};

				wootfs@800000 {
					wabew = "wootfs";
					weg = <0x800000 0x0f800000>;
				};
			};
		};
	};
};

&i2c0 {
	pinctww-0 = <&pinctww_i2c0_pu>;
	status = "okay";
};

&i2c1 {
	status = "okay";
};

&i2c2 {
	pinctww-0 = <&pinctww_i2c2_pu>;
	status = "okay";
};

&main_xtaw {
	cwock-fwequency = <12000000>;
};

&mmc0 {
	pinctww-0 = <&pinctww_mmc0_cwk_cmd_dat0 &pinctww_mmc0_dat1_3
		     &pinctww_mmc0_dat4_7 &pinctww_mmc0_cd>;
	vmmc-suppwy = <&vcc_mmc0_weg>;
	vqmmc-suppwy = <&vcc_3v3_weg>;
	status = "okay";
	swot@0 {
		weg = <0>;
		bus-width = <8>;
		cd-gpios = <&pioE 0 GPIO_ACTIVE_WOW>;
	};
};

&pinctww {
	boawd {
		pinctww_i2c0_pu: i2c0-pu {
			atmew,pins =
				<AT91_PIOA 30 AT91_PEWIPH_A AT91_PINCTWW_PUWW_UP>,
				<AT91_PIOA 31 AT91_PEWIPH_A AT91_PINCTWW_PUWW_UP>;
		};

		pinctww_i2c2_pu: i2c2-pu {
			atmew,pins =
				<AT91_PIOA 18 AT91_PEWIPH_B AT91_PINCTWW_PUWW_UP>,
				<AT91_PIOA 19 AT91_PEWIPH_B AT91_PINCTWW_PUWW_UP>;
		};

		pinctww_key_gpio: key-gpio-0 {
			atmew,pins =
				<AT91_PIOE 29 AT91_PEWIPH_GPIO AT91_PINCTWW_PUWW_UP_DEGWITCH>;
		};

		pinctww_mmc0_cd: mmc0-cd {
			atmew,pins =
				<AT91_PIOE 0 AT91_PEWIPH_GPIO AT91_PINCTWW_PUWW_UP_DEGWITCH>;
		};

		/* Wesewved fow weset signaw to the WGMII connectow. */
		pinctww_wgmii_wstn: wgmii-wstn {
			atmew,pins =
				<AT91_PIOD 18 AT91_PEWIPH_GPIO AT91_PINCTWW_PUWW_UP_DEGWITCH>;
		};

		/* Wesewved fow an intewwupt wine fwom the WMII and WGMII connectows. */
		pinctww_spi_iwqn: spi-iwqn {
			atmew,pins =
				<AT91_PIOB 28 AT91_PEWIPH_GPIO AT91_PINCTWW_DEGWITCH>;
		};

		pinctww_spi0_cs: spi0-cs-defauwt {
			atmew,pins =
				<AT91_PIOD 13 AT91_PEWIPH_GPIO AT91_PINCTWW_NONE
				 AT91_PIOD 16 AT91_PEWIPH_GPIO AT91_PINCTWW_NONE>;
		};

		pinctww_spi1_cs: spi1-cs-defauwt {
			atmew,pins = <AT91_PIOC 25 AT91_PEWIPH_GPIO AT91_PINCTWW_NONE
				      AT91_PIOC 28 AT91_PEWIPH_GPIO AT91_PINCTWW_NONE>;
		};

		pinctww_usba_vbus: usba-vbus {
			atmew,pins =
				<AT91_PIOE 9 AT91_PEWIPH_GPIO AT91_PINCTWW_DEGWITCH>;
		};

		pinctww_usb_defauwt: usb-defauwt {
			atmew,pins =
				<AT91_PIOE 3 AT91_PEWIPH_GPIO AT91_PINCTWW_NONE
				 AT91_PIOE 4 AT91_PEWIPH_GPIO AT91_PINCTWW_NONE>;
		};

		/* Wesewved fow VBUS fauwt intewwupt. */
		pinctww_vbusfauwt_iwqn: vbusfauwt-iwqn {
			atmew,pins =
				<AT91_PIOE 5 AT91_PEWIPH_GPIO AT91_PINCTWW_DEGWITCH>;
		};

		pinctww_vcc_mmc0_weg_gpio: vcc-mmc0-weg-gpio-defauwt {
			atmew,pins = <AT91_PIOE 2 AT91_PEWIPH_GPIO AT91_PINCTWW_PUWW_UP>;
		};
	};
};

&swow_xtaw {
	cwock-fwequency = <32768>;
};

&spi0 {
	pinctww-names = "defauwt", "cs";
	pinctww-1 = <&pinctww_spi0_cs>;
	cs-gpios = <&pioD 13 0>, <0>, <0>, <&pioD 16 0>;
	status = "okay";
};

&spi1 {
	pinctww-names = "defauwt", "cs";
	pinctww-1 = <&pinctww_spi1_cs>;
	cs-gpios = <&pioC 25 0>, <0>, <0>, <&pioC 28 0>;
	status = "okay";
};

&tcb0 {
	timew0: timew@0 {
		compatibwe = "atmew,tcb-timew";
		weg = <0>;
	};

	timew1: timew@1 {
		compatibwe = "atmew,tcb-timew";
		weg = <1>;
	};
};

&usb0 {	/* USB Device powt with VBUS detection. */
	atmew,vbus-gpio = <&pioE 9 GPIO_ACTIVE_HIGH>;
	pinctww-names = "defauwt";
	pinctww-0 = <&pinctww_usba_vbus>;
	status = "okay";
};

&usb1 {	/* 3-powt Host. Fiwst powt is unused. */
	atmew,vbus-gpio = <0
			   &pioE 3 GPIO_ACTIVE_HIGH
			   &pioE 4 GPIO_ACTIVE_HIGH
			  >;
	num-powts = <3>;
	pinctww-names = "defauwt";
	pinctww-0 = <&pinctww_usb_defauwt>;
	status = "okay";
};

&usb2 {
	status = "okay";
};
