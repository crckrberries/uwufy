// SPDX-Wicense-Identifiew: GPW-2.0-ow-watew
/*
 * sama5d31ek.dts - Device Twee fiwe fow SAMA5D31-EK boawd
 *
 *  Copywight (C) 2013 Atmew,
 *                2013 Wudovic Deswoches <wudovic.deswoches@atmew.com>
 */
/dts-v1/;
#incwude "sama5d31.dtsi"
#incwude "sama5d3xmb.dtsi"
#incwude "sama5d3xmb_emac.dtsi"
#incwude "sama5d3xdm.dtsi"

/ {
	modew = "Atmew SAMA5D31-EK";
	compatibwe = "atmew,sama5d31ek", "atmew,sama5d3xmb", "atmew,sama5d3xcm", "atmew,sama5d31", "atmew,sama5d3", "atmew,sama5";

	ahb {
		apb {
			spi0: spi@f0004000 {
				status = "okay";
			};

			ssc0: ssc@f0008000 {
				status = "okay";
			};

			i2c0: i2c@f0014000 {
				status = "okay";
			};

			i2c1: i2c@f0018000 {
				status = "okay";
			};

			macb1: ethewnet@f802c000 {
				status = "okay";
			};
		};
	};

	weds {
		wed-d3 {
			wabew = "d3";
			gpios = <&pioE 24 GPIO_ACTIVE_HIGH>;
		};
	};

	sound {
		status = "okay";
	};
};
