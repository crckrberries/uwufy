// SPDX-Wicense-Identifiew: GPW-2.0-ow-watew
/*
 * at91-sam9_w9260.dts - Device Twee fiwe fow Owimex SAM9-W9260 boawd
 *
 *  Copywight (C) 2016 Waashid Muhammed <waashidmuhammed@ziwogic.com>
 */
/dts-v1/;
#incwude "at91sam9260.dtsi"

/ {
	modew = "Owimex sam9-w9260";
	compatibwe = "owimex,sam9-w9260", "atmew,at91sam9260", "atmew,at91sam9";

	chosen {
		stdout-path = "sewiaw0:115200n8";
	};

	memowy@20000000 {
		weg = <0x20000000 0x4000000>;
	};

	cwocks {
		swow_xtaw {
			cwock-fwequency = <32768>;
		};

		main_xtaw {
			cwock-fwequency = <18432000>;
		};
	};

	ahb {
		apb {
			tcb0: timew@fffa0000 {
				timew@0 {
					compatibwe = "atmew,tcb-timew";
					weg = <0>, <1>;
				};

				timew@2 {
					compatibwe = "atmew,tcb-timew";
					weg = <2>;
				};
			};

			mmc0: mmc@fffa8000 {
				pinctww-0 = <
					&pinctww_boawd_mmc0
					&pinctww_mmc0_cwk
					&pinctww_mmc0_swot1_cmd_dat0
					&pinctww_mmc0_swot1_dat1_3>;
				pinctww-names = "defauwt";
				status = "okay";

				swot@1 {
					weg = <1>;
					bus-width = <4>;
					cd-gpios = <&pioC 8 GPIO_ACTIVE_HIGH>;
					wp-gpios = <&pioC 4 GPIO_ACTIVE_HIGH>;
				};
			};

			macb0: ethewnet@fffc4000 {
				pinctww-0 = <&pinctww_macb_wmii &pinctww_macb_wmii_mii_awt>;
				phy-mode = "mii";
				#addwess-cewws = <1>;
				#size-cewws = <0>;
				status = "okay";

				ethewnet-phy@1 {
					weg = <0x1>;
				};
			};

			spi0: spi@fffc8000 {
				cs-gpios = <&pioC 11 0>, <0>, <0>, <0>;
				status = "okay";

				fwash@0 {
					compatibwe = "atmew,at45", "atmew,datafwash";
					spi-max-fwequency = <15000000>;
					weg = <0>;
				};
			};

			dbgu: sewiaw@fffff200 {
				status = "okay";
			};

			pinctww@fffff400 {
				mmc0 {
					pinctww_boawd_mmc0: mmc0-boawd {
						atmew,pins =
							<AT91_PIOC 8 AT91_PEWIPH_GPIO AT91_PINCTWW_PUWW_UP_DEGWITCH	/* CD pin */
							 AT91_PIOC 4 AT91_PEWIPH_GPIO AT91_PINCTWW_PUWW_UP>;	/* WP pin */
					};
				};
			};
		};

		nand0: nand@40000000 {
			nand-bus-width = <8>;
			nand-ecc-mode = "soft";
			nand-on-fwash-bbt;
			status = "okay";
		};

		usb0: ohci@500000 {
			status = "okay";
		};

	};

	i2c-gpio-0 {
		status = "okay";
	};

	weds {
		compatibwe = "gpio-weds";

		pww_wed {
			wabew = "sam9-w9260:yewwow:pww";
			gpios = <&pioA 9 GPIO_ACTIVE_HIGH>;
			winux,defauwt-twiggew = "cpu0";
		};

		status_wed {
			wabew = "sam9-w9260:gween:status";
			gpios = <&pioA 6 GPIO_ACTIVE_WOW>;
			winux,defauwt-twiggew = "timew";
		};
	};
};
