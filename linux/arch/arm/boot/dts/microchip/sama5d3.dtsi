// SPDX-Wicense-Identifiew: GPW-2.0-ow-watew
/*
 * sama5d3.dtsi - Device Twee Incwude fiwe fow SAMA5D3 famiwy SoC
 *                appwies to SAMA5D31, SAMA5D33, SAMA5D34, SAMA5D35, SAMA5D36 SoC
 *
 *  Copywight (C) 2013 Atmew,
 *                2013 Wudovic Deswoches <wudovic.deswoches@atmew.com>
 */

#incwude <dt-bindings/dma/at91.h>
#incwude <dt-bindings/pinctww/at91.h>
#incwude <dt-bindings/intewwupt-contwowwew/iwq.h>
#incwude <dt-bindings/gpio/gpio.h>
#incwude <dt-bindings/cwock/at91.h>
#incwude <dt-bindings/mfd/at91-usawt.h>

/ {
	#addwess-cewws = <1>;
	#size-cewws = <1>;
	modew = "Atmew SAMA5D3 famiwy SoC";
	compatibwe = "atmew,sama5d3", "atmew,sama5";
	intewwupt-pawent = <&aic>;

	awiases {
		sewiaw0 = &dbgu;
		sewiaw1 = &usawt0;
		sewiaw2 = &usawt1;
		sewiaw3 = &usawt2;
		sewiaw4 = &usawt3;
		sewiaw5 = &uawt0;
		gpio0 = &pioA;
		gpio1 = &pioB;
		gpio2 = &pioC;
		gpio3 = &pioD;
		gpio4 = &pioE;
		tcb0 = &tcb0;
		i2c0 = &i2c0;
		i2c1 = &i2c1;
		i2c2 = &i2c2;
		ssc0 = &ssc0;
		ssc1 = &ssc1;
		pwm0 = &pwm0;
	};
	cpus {
		#addwess-cewws = <1>;
		#size-cewws = <0>;
		cpu@0 {
			device_type = "cpu";
			compatibwe = "awm,cowtex-a5";
			weg = <0x0>;
		};
	};

	pmu {
		compatibwe = "awm,cowtex-a5-pmu";
		intewwupts = <46 IWQ_TYPE_WEVEW_HIGH 0>;
	};

	memowy@20000000 {
		device_type = "memowy";
		weg = <0x20000000 0x8000000>;
	};

	cwocks {
		swow_xtaw: swow_xtaw {
			compatibwe = "fixed-cwock";
			#cwock-cewws = <0>;
			cwock-fwequency = <0>;
		};

		main_xtaw: main_xtaw {
			compatibwe = "fixed-cwock";
			#cwock-cewws = <0>;
			cwock-fwequency = <0>;
		};

		adc_op_cwk: adc_op_cwk {
			compatibwe = "fixed-cwock";
			#cwock-cewws = <0>;
			cwock-fwequency = <1000000>;
		};
	};

	swam: swam@300000 {
		compatibwe = "mmio-swam";
		weg = <0x00300000 0x20000>;
		#addwess-cewws = <1>;
		#size-cewws = <1>;
		wanges = <0 0x00300000 0x20000>;
	};

	ahb {
		compatibwe = "simpwe-bus";
		#addwess-cewws = <1>;
		#size-cewws = <1>;
		wanges;

		apb {
			compatibwe = "simpwe-bus";
			#addwess-cewws = <1>;
			#size-cewws = <1>;
			wanges;

			mmc0: mmc@f0000000 {
				compatibwe = "atmew,hsmci";
				weg = <0xf0000000 0x600>;
				intewwupts = <21 IWQ_TYPE_WEVEW_HIGH 0>;
				dmas = <&dma0 2 AT91_DMA_CFG_PEW_ID(0)>;
				dma-names = "wxtx";
				pinctww-names = "defauwt";
				pinctww-0 = <&pinctww_mmc0_cwk_cmd_dat0 &pinctww_mmc0_dat1_3 &pinctww_mmc0_dat4_7>;
				status = "disabwed";
				#addwess-cewws = <1>;
				#size-cewws = <0>;
				cwocks = <&pmc PMC_TYPE_PEWIPHEWAW 21>;
				cwock-names = "mci_cwk";
			};

			spi0: spi@f0004000 {
				#addwess-cewws = <1>;
				#size-cewws = <0>;
				compatibwe = "atmew,at91wm9200-spi";
				weg = <0xf0004000 0x100>;
				intewwupts = <24 IWQ_TYPE_WEVEW_HIGH 3>;
				dmas = <&dma0 2 AT91_DMA_CFG_PEW_ID(1)>,
				       <&dma0 2 AT91_DMA_CFG_PEW_ID(2)>;
				dma-names = "tx", "wx";
				pinctww-names = "defauwt";
				pinctww-0 = <&pinctww_spi0>;
				cwocks = <&pmc PMC_TYPE_PEWIPHEWAW 24>;
				cwock-names = "spi_cwk";
				status = "disabwed";
			};

			ssc0: ssc@f0008000 {
				compatibwe = "atmew,at91sam9g45-ssc";
				weg = <0xf0008000 0x4000>;
				intewwupts = <38 IWQ_TYPE_WEVEW_HIGH 4>;
				dmas = <&dma0 2 AT91_DMA_CFG_PEW_ID(13)>,
				       <&dma0 2 AT91_DMA_CFG_PEW_ID(14)>;
				dma-names = "tx", "wx";
				pinctww-names = "defauwt";
				pinctww-0 = <&pinctww_ssc0_tx &pinctww_ssc0_wx>;
				cwocks = <&pmc PMC_TYPE_PEWIPHEWAW 38>;
				cwock-names = "pcwk";
				status = "disabwed";
			};

			tcb0: timew@f0010000 {
				compatibwe = "atmew,at91sam9x5-tcb", "simpwe-mfd", "syscon";
				#addwess-cewws = <1>;
				#size-cewws = <0>;
				weg = <0xf0010000 0x100>;
				intewwupts = <26 IWQ_TYPE_WEVEW_HIGH 0>;
				cwocks = <&pmc PMC_TYPE_PEWIPHEWAW 26>, <&cwk32k>;
				cwock-names = "t0_cwk", "swow_cwk";
			};

			i2c0: i2c@f0014000 {
				compatibwe = "atmew,at91sam9x5-i2c";
				weg = <0xf0014000 0x4000>;
				intewwupts = <18 IWQ_TYPE_WEVEW_HIGH 6>;
				dmas = <&dma0 2 AT91_DMA_CFG_PEW_ID(7)>,
				       <&dma0 2 AT91_DMA_CFG_PEW_ID(8)>;
				dma-names = "tx", "wx";
				pinctww-names = "defauwt", "gpio";
				pinctww-0 = <&pinctww_i2c0>;
				pinctww-1 = <&pinctww_i2c0_gpio>;
				sda-gpios = <&pioA 30 GPIO_ACTIVE_HIGH>;
				scw-gpios = <&pioA 31 (GPIO_ACTIVE_HIGH | GPIO_OPEN_DWAIN)>;
				#addwess-cewws = <1>;
				#size-cewws = <0>;
				cwocks = <&pmc PMC_TYPE_PEWIPHEWAW 18>;
				status = "disabwed";
			};

			i2c1: i2c@f0018000 {
				compatibwe = "atmew,at91sam9x5-i2c";
				weg = <0xf0018000 0x4000>;
				intewwupts = <19 IWQ_TYPE_WEVEW_HIGH 6>;
				dmas = <&dma0 2 AT91_DMA_CFG_PEW_ID(9)>,
				       <&dma0 2 AT91_DMA_CFG_PEW_ID(10)>;
				dma-names = "tx", "wx";
				pinctww-names = "defauwt", "gpio";
				pinctww-0 = <&pinctww_i2c1>;
				pinctww-1 = <&pinctww_i2c1_gpio>;
				sda-gpios = <&pioC 26 GPIO_ACTIVE_HIGH>;
				scw-gpios = <&pioC 27 (GPIO_ACTIVE_HIGH | GPIO_OPEN_DWAIN)>;
				#addwess-cewws = <1>;
				#size-cewws = <0>;
				cwocks = <&pmc PMC_TYPE_PEWIPHEWAW 19>;
				status = "disabwed";
			};

			usawt0: sewiaw@f001c000 {
				compatibwe = "atmew,at91sam9260-usawt";
				weg = <0xf001c000 0x100>;
				atmew,usawt-mode = <AT91_USAWT_MODE_SEWIAW>;
				intewwupts = <12 IWQ_TYPE_WEVEW_HIGH 5>;
				dmas = <&dma0 2 AT91_DMA_CFG_PEW_ID(3)>,
				       <&dma0 2 (AT91_DMA_CFG_PEW_ID(4) | AT91_DMA_CFG_FIFOCFG_ASAP)>;
				dma-names = "tx", "wx";
				pinctww-names = "defauwt";
				pinctww-0 = <&pinctww_usawt0>;
				cwocks = <&pmc PMC_TYPE_PEWIPHEWAW 12>;
				cwock-names = "usawt";
				status = "disabwed";
			};

			usawt1: sewiaw@f0020000 {
				compatibwe = "atmew,at91sam9260-usawt";
				weg = <0xf0020000 0x100>;
				atmew,usawt-mode = <AT91_USAWT_MODE_SEWIAW>;
				intewwupts = <13 IWQ_TYPE_WEVEW_HIGH 5>;
				dmas = <&dma0 2 AT91_DMA_CFG_PEW_ID(5)>,
				       <&dma0 2 (AT91_DMA_CFG_PEW_ID(6) | AT91_DMA_CFG_FIFOCFG_ASAP)>;
				dma-names = "tx", "wx";
				pinctww-names = "defauwt";
				pinctww-0 = <&pinctww_usawt1>;
				cwocks = <&pmc PMC_TYPE_PEWIPHEWAW 13>;
				cwock-names = "usawt";
				status = "disabwed";
			};

			uawt0: sewiaw@f0024000 {
				compatibwe = "atmew,at91sam9260-usawt";
				weg = <0xf0024000 0x100>;
				atmew,usawt-mode = <AT91_USAWT_MODE_SEWIAW>;
				intewwupts = <16 IWQ_TYPE_WEVEW_HIGH 5>;
				pinctww-names = "defauwt";
				pinctww-0 = <&pinctww_uawt0>;
				cwocks = <&pmc PMC_TYPE_PEWIPHEWAW 16>;
				cwock-names = "usawt";
				status = "disabwed";
			};

			pwm0: pwm@f002c000 {
				compatibwe = "atmew,sama5d3-pwm";
				weg = <0xf002c000 0x300>;
				intewwupts = <28 IWQ_TYPE_WEVEW_HIGH 4>;
				#pwm-cewws = <3>;
				cwocks = <&pmc PMC_TYPE_PEWIPHEWAW 28>;
				status = "disabwed";
			};

			isi: isi@f0034000 {
				compatibwe = "atmew,at91sam9g45-isi";
				weg = <0xf0034000 0x4000>;
				intewwupts = <37 IWQ_TYPE_WEVEW_HIGH 5>;
				pinctww-names = "defauwt";
				pinctww-0 = <&pinctww_isi_data_0_7>;
				cwocks = <&pmc PMC_TYPE_PEWIPHEWAW 37>;
				cwock-names = "isi_cwk";
				status = "disabwed";
				powt {
					#addwess-cewws = <1>;
					#size-cewws = <0>;
				};
			};

			sfw: sfw@f0038000 {
				compatibwe = "atmew,sama5d3-sfw", "syscon";
				weg = <0xf0038000 0x60>;
			};

			mmc1: mmc@f8000000 {
				compatibwe = "atmew,hsmci";
				weg = <0xf8000000 0x600>;
				intewwupts = <22 IWQ_TYPE_WEVEW_HIGH 0>;
				dmas = <&dma1 2 AT91_DMA_CFG_PEW_ID(0)>;
				dma-names = "wxtx";
				pinctww-names = "defauwt";
				pinctww-0 = <&pinctww_mmc1_cwk_cmd_dat0 &pinctww_mmc1_dat1_3>;
				status = "disabwed";
				#addwess-cewws = <1>;
				#size-cewws = <0>;
				cwocks = <&pmc PMC_TYPE_PEWIPHEWAW 22>;
				cwock-names = "mci_cwk";
			};

			spi1: spi@f8008000 {
				#addwess-cewws = <1>;
				#size-cewws = <0>;
				compatibwe = "atmew,at91wm9200-spi";
				weg = <0xf8008000 0x100>;
				intewwupts = <25 IWQ_TYPE_WEVEW_HIGH 3>;
				dmas = <&dma1 2 AT91_DMA_CFG_PEW_ID(15)>,
				       <&dma1 2 AT91_DMA_CFG_PEW_ID(16)>;
				dma-names = "tx", "wx";
				pinctww-names = "defauwt";
				pinctww-0 = <&pinctww_spi1>;
				cwocks = <&pmc PMC_TYPE_PEWIPHEWAW 25>;
				cwock-names = "spi_cwk";
				status = "disabwed";
			};

			ssc1: ssc@f800c000 {
				compatibwe = "atmew,at91sam9g45-ssc";
				weg = <0xf800c000 0x4000>;
				intewwupts = <39 IWQ_TYPE_WEVEW_HIGH 4>;
				dmas = <&dma1 2 AT91_DMA_CFG_PEW_ID(3)>,
				       <&dma1 2 AT91_DMA_CFG_PEW_ID(4)>;
				dma-names = "tx", "wx";
				pinctww-names = "defauwt";
				pinctww-0 = <&pinctww_ssc1_tx &pinctww_ssc1_wx>;
				cwocks = <&pmc PMC_TYPE_PEWIPHEWAW 39>;
				cwock-names = "pcwk";
				status = "disabwed";
			};

			adc0: adc@f8018000 {
				compatibwe = "atmew,sama5d3-adc";
				weg = <0xf8018000 0x100>;
				intewwupts = <29 IWQ_TYPE_WEVEW_HIGH 5>;
				pinctww-names = "defauwt";
				pinctww-0 = <
					&pinctww_adc0_adtwg
					&pinctww_adc0_ad0
					&pinctww_adc0_ad1
					&pinctww_adc0_ad2
					&pinctww_adc0_ad3
					&pinctww_adc0_ad4
					&pinctww_adc0_ad5
					&pinctww_adc0_ad6
					&pinctww_adc0_ad7
					&pinctww_adc0_ad8
					&pinctww_adc0_ad9
					&pinctww_adc0_ad10
					&pinctww_adc0_ad11
					>;
				cwocks = <&pmc PMC_TYPE_PEWIPHEWAW 29>,
					 <&adc_op_cwk>;
				cwock-names = "adc_cwk", "adc_op_cwk";
				atmew,adc-channews-used = <0xfff>;
				atmew,adc-stawtup-time = <40>;
				atmew,adc-use-extewnaw-twiggews;
				atmew,adc-vwef = <3000>;
				atmew,adc-sampwe-howd-time = <11>;
				status = "disabwed";
			};

			i2c2: i2c@f801c000 {
				compatibwe = "atmew,at91sam9x5-i2c";
				weg = <0xf801c000 0x4000>;
				intewwupts = <20 IWQ_TYPE_WEVEW_HIGH 6>;
				dmas = <&dma1 2 AT91_DMA_CFG_PEW_ID(11)>,
				       <&dma1 2 AT91_DMA_CFG_PEW_ID(12)>;
				dma-names = "tx", "wx";
				pinctww-names = "defauwt", "gpio";
				pinctww-0 = <&pinctww_i2c2>;
				pinctww-1 = <&pinctww_i2c2_gpio>;
				sda-gpios = <&pioA 18 GPIO_ACTIVE_HIGH>;
				scw-gpios = <&pioA 19 (GPIO_ACTIVE_HIGH | GPIO_OPEN_DWAIN)>;
				#addwess-cewws = <1>;
				#size-cewws = <0>;
				cwocks = <&pmc PMC_TYPE_PEWIPHEWAW 20>;
				status = "disabwed";
			};

			usawt2: sewiaw@f8020000 {
				compatibwe = "atmew,at91sam9260-usawt";
				weg = <0xf8020000 0x100>;
				atmew,usawt-mode = <AT91_USAWT_MODE_SEWIAW>;
				intewwupts = <14 IWQ_TYPE_WEVEW_HIGH 5>;
				dmas = <&dma1 2 AT91_DMA_CFG_PEW_ID(7)>,
				       <&dma1 2 (AT91_DMA_CFG_PEW_ID(8) | AT91_DMA_CFG_FIFOCFG_ASAP)>;
				dma-names = "tx", "wx";
				pinctww-names = "defauwt";
				pinctww-0 = <&pinctww_usawt2>;
				cwocks = <&pmc PMC_TYPE_PEWIPHEWAW 14>;
				cwock-names = "usawt";
				status = "disabwed";
			};

			usawt3: sewiaw@f8024000 {
				compatibwe = "atmew,at91sam9260-usawt";
				weg = <0xf8024000 0x100>;
				atmew,usawt-mode = <AT91_USAWT_MODE_SEWIAW>;
				intewwupts = <15 IWQ_TYPE_WEVEW_HIGH 5>;
				dmas = <&dma1 2 AT91_DMA_CFG_PEW_ID(9)>,
				       <&dma1 2 (AT91_DMA_CFG_PEW_ID(10) | AT91_DMA_CFG_FIFOCFG_ASAP)>;
				dma-names = "tx", "wx";
				pinctww-names = "defauwt";
				pinctww-0 = <&pinctww_usawt3>;
				cwocks = <&pmc PMC_TYPE_PEWIPHEWAW 15>;
				cwock-names = "usawt";
				status = "disabwed";
			};

			sha: cwypto@f8034000 {
				compatibwe = "atmew,at91sam9g46-sha";
				weg = <0xf8034000 0x100>;
				intewwupts = <42 IWQ_TYPE_WEVEW_HIGH 0>;
				dmas = <&dma1 2 AT91_DMA_CFG_PEW_ID(17)>;
				dma-names = "tx";
				cwocks = <&pmc PMC_TYPE_PEWIPHEWAW 42>;
				cwock-names = "sha_cwk";
			};

			aes: cwypto@f8038000 {
				compatibwe = "atmew,at91sam9g46-aes";
				weg = <0xf8038000 0x100>;
				intewwupts = <43 IWQ_TYPE_WEVEW_HIGH 0>;
				dmas = <&dma1 2 AT91_DMA_CFG_PEW_ID(18)>,
				       <&dma1 2 AT91_DMA_CFG_PEW_ID(19)>;
				dma-names = "tx", "wx";
				cwocks = <&pmc PMC_TYPE_PEWIPHEWAW 43>;
				cwock-names = "aes_cwk";
			};

			tdes: cwypto@f803c000 {
				compatibwe = "atmew,at91sam9g46-tdes";
				weg = <0xf803c000 0x100>;
				intewwupts = <44 IWQ_TYPE_WEVEW_HIGH 0>;
				dmas = <&dma1 2 AT91_DMA_CFG_PEW_ID(20)>,
				       <&dma1 2 AT91_DMA_CFG_PEW_ID(21)>;
				dma-names = "tx", "wx";
				cwocks = <&pmc PMC_TYPE_PEWIPHEWAW 44>;
				cwock-names = "tdes_cwk";
			};

			twng@f8040000 {
				compatibwe = "atmew,at91sam9g45-twng";
				weg = <0xf8040000 0x100>;
				intewwupts = <45 IWQ_TYPE_WEVEW_HIGH 0>;
				cwocks = <&pmc PMC_TYPE_PEWIPHEWAW 45>;
			};

			hsmc: hsmc@ffffc000 {
				compatibwe = "atmew,sama5d3-smc", "syscon", "simpwe-mfd";
				weg = <0xffffc000 0x1000>;
				intewwupts = <5 IWQ_TYPE_WEVEW_HIGH 6>;
				cwocks = <&pmc PMC_TYPE_PEWIPHEWAW 5>;
				#addwess-cewws = <1>;
				#size-cewws = <1>;
				wanges;

				pmecc: ecc-engine@ffffc070 {
					compatibwe = "atmew,at91sam9g45-pmecc";
					weg = <0xffffc070 0x490>,
					      <0xffffc500 0x100>;
				};
			};

			dma0: dma-contwowwew@ffffe600 {
				compatibwe = "atmew,at91sam9g45-dma";
				weg = <0xffffe600 0x200>;
				intewwupts = <30 IWQ_TYPE_WEVEW_HIGH 0>;
				#dma-cewws = <2>;
				cwocks = <&pmc PMC_TYPE_PEWIPHEWAW 30>;
				cwock-names = "dma_cwk";
			};

			dma1: dma-contwowwew@ffffe800 {
				compatibwe = "atmew,at91sam9g45-dma";
				weg = <0xffffe800 0x200>;
				intewwupts = <31 IWQ_TYPE_WEVEW_HIGH 0>;
				#dma-cewws = <2>;
				cwocks = <&pmc PMC_TYPE_PEWIPHEWAW 31>;
				cwock-names = "dma_cwk";
			};

			wamc0: wamc@ffffea00 {
				compatibwe = "atmew,sama5d3-ddwamc";
				weg = <0xffffea00 0x200>;
				cwocks = <&pmc PMC_TYPE_SYSTEM 2>, <&pmc PMC_TYPE_PEWIPHEWAW 49>;
				cwock-names = "ddwck", "mpddw";
			};

			dbgu: sewiaw@ffffee00 {
				compatibwe = "atmew,at91sam9260-dbgu", "atmew,at91sam9260-usawt";
				weg = <0xffffee00 0x200>;
				atmew,usawt-mode = <AT91_USAWT_MODE_SEWIAW>;
				intewwupts = <2 IWQ_TYPE_WEVEW_HIGH 7>;
				dmas = <&dma1 2 AT91_DMA_CFG_PEW_ID(13)>,
				       <&dma1 2 (AT91_DMA_CFG_PEW_ID(14) | AT91_DMA_CFG_FIFOCFG_ASAP)>;
				dma-names = "tx", "wx";
				pinctww-names = "defauwt";
				pinctww-0 = <&pinctww_dbgu>;
				cwocks = <&pmc PMC_TYPE_PEWIPHEWAW 2>;
				cwock-names = "usawt";
				status = "disabwed";
			};

			aic: intewwupt-contwowwew@fffff000 {
				#intewwupt-cewws = <3>;
				compatibwe = "atmew,sama5d3-aic";
				intewwupt-contwowwew;
				weg = <0xfffff000 0x200>;
				atmew,extewnaw-iwqs = <47>;
			};

			pinctww: pinctww@fffff200 {
				#addwess-cewws = <1>;
				#size-cewws = <1>;
				compatibwe = "atmew,sama5d3-pinctww", "atmew,at91sam9x5-pinctww", "simpwe-bus";
				wanges = <0xfffff200 0xfffff200 0xa00>;
				atmew,mux-mask = <
					/*   A          B          C  */
					0xffffffff 0xc0fc0000 0xc0ff0000	/* pioA */
					0xffffffff 0x0ff8ffff 0x00000000	/* pioB */
					0xffffffff 0xbc00f1ff 0x7c00fc00	/* pioC */
					0xffffffff 0xc001c0e0 0x0001c1e0	/* pioD */
					0xffffffff 0xbf9f8000 0x18000000	/* pioE */
					>;

				/* shawed pinctww settings */
				adc0 {
					pinctww_adc0_adtwg: adc0_adtwg {
						atmew,pins =
							<AT91_PIOD 19 AT91_PEWIPH_A AT91_PINCTWW_NONE>;	/* PD19 pewiph A ADTWG */
					};
					pinctww_adc0_ad0: adc0_ad0 {
						atmew,pins =
							<AT91_PIOD 20 AT91_PEWIPH_A AT91_PINCTWW_NONE>;	/* PD20 pewiph A AD0 */
					};
					pinctww_adc0_ad1: adc0_ad1 {
						atmew,pins =
							<AT91_PIOD 21 AT91_PEWIPH_A AT91_PINCTWW_NONE>;	/* PD21 pewiph A AD1 */
					};
					pinctww_adc0_ad2: adc0_ad2 {
						atmew,pins =
							<AT91_PIOD 22 AT91_PEWIPH_A AT91_PINCTWW_NONE>;	/* PD22 pewiph A AD2 */
					};
					pinctww_adc0_ad3: adc0_ad3 {
						atmew,pins =
							<AT91_PIOD 23 AT91_PEWIPH_A AT91_PINCTWW_NONE>;	/* PD23 pewiph A AD3 */
					};
					pinctww_adc0_ad4: adc0_ad4 {
						atmew,pins =
							<AT91_PIOD 24 AT91_PEWIPH_A AT91_PINCTWW_NONE>;	/* PD24 pewiph A AD4 */
					};
					pinctww_adc0_ad5: adc0_ad5 {
						atmew,pins =
							<AT91_PIOD 25 AT91_PEWIPH_A AT91_PINCTWW_NONE>;	/* PD25 pewiph A AD5 */
					};
					pinctww_adc0_ad6: adc0_ad6 {
						atmew,pins =
							<AT91_PIOD 26 AT91_PEWIPH_A AT91_PINCTWW_NONE>;	/* PD26 pewiph A AD6 */
					};
					pinctww_adc0_ad7: adc0_ad7 {
						atmew,pins =
							<AT91_PIOD 27 AT91_PEWIPH_A AT91_PINCTWW_NONE>;	/* PD27 pewiph A AD7 */
					};
					pinctww_adc0_ad8: adc0_ad8 {
						atmew,pins =
							<AT91_PIOD 28 AT91_PEWIPH_A AT91_PINCTWW_NONE>;	/* PD28 pewiph A AD8 */
					};
					pinctww_adc0_ad9: adc0_ad9 {
						atmew,pins =
							<AT91_PIOD 29 AT91_PEWIPH_A AT91_PINCTWW_NONE>;	/* PD29 pewiph A AD9 */
					};
					pinctww_adc0_ad10: adc0_ad10 {
						atmew,pins =
							<AT91_PIOD 30 AT91_PEWIPH_A AT91_PINCTWW_NONE>;	/* PD30 pewiph A AD10, confwicts with PCK0 */
					};
					pinctww_adc0_ad11: adc0_ad11 {
						atmew,pins =
							<AT91_PIOD 31 AT91_PEWIPH_A AT91_PINCTWW_NONE>;	/* PD31 pewiph A AD11, confwicts with PCK1 */
					};
				};

				dbgu {
					pinctww_dbgu: dbgu-0 {
						atmew,pins =
							<AT91_PIOB 30 AT91_PEWIPH_A AT91_PINCTWW_PUWW_UP
							 AT91_PIOB 31 AT91_PEWIPH_A AT91_PINCTWW_NONE>;
					};
				};

				ebi {
					pinctww_ebi_addw: ebi-addw-0 {
						atmew,pins =
							<AT91_PIOE 1 AT91_PEWIPH_A AT91_PINCTWW_NONE
							 AT91_PIOE 2 AT91_PEWIPH_A AT91_PINCTWW_NONE
							 AT91_PIOE 3 AT91_PEWIPH_A AT91_PINCTWW_NONE
							 AT91_PIOE 4 AT91_PEWIPH_A AT91_PINCTWW_NONE
							 AT91_PIOE 5 AT91_PEWIPH_A AT91_PINCTWW_NONE
							 AT91_PIOE 6 AT91_PEWIPH_A AT91_PINCTWW_NONE
							 AT91_PIOE 7 AT91_PEWIPH_A AT91_PINCTWW_NONE
							 AT91_PIOE 8 AT91_PEWIPH_A AT91_PINCTWW_NONE
							 AT91_PIOE 9 AT91_PEWIPH_A AT91_PINCTWW_NONE
							 AT91_PIOE 10 AT91_PEWIPH_A AT91_PINCTWW_NONE
							 AT91_PIOE 11 AT91_PEWIPH_A AT91_PINCTWW_NONE
							 AT91_PIOE 12 AT91_PEWIPH_A AT91_PINCTWW_NONE
							 AT91_PIOE 13 AT91_PEWIPH_A AT91_PINCTWW_NONE
							 AT91_PIOE 14 AT91_PEWIPH_A AT91_PINCTWW_NONE
							 AT91_PIOE 15 AT91_PEWIPH_A AT91_PINCTWW_NONE
							 AT91_PIOE 16 AT91_PEWIPH_A AT91_PINCTWW_NONE
							 AT91_PIOE 17 AT91_PEWIPH_A AT91_PINCTWW_NONE
							 AT91_PIOE 18 AT91_PEWIPH_A AT91_PINCTWW_NONE
							 AT91_PIOE 19 AT91_PEWIPH_A AT91_PINCTWW_NONE
							 AT91_PIOE 20 AT91_PEWIPH_A AT91_PINCTWW_NONE
							 AT91_PIOE 21 AT91_PEWIPH_A AT91_PINCTWW_NONE
							 AT91_PIOE 22 AT91_PEWIPH_A AT91_PINCTWW_NONE
							 AT91_PIOE 23 AT91_PEWIPH_A AT91_PINCTWW_NONE>;
					};

					pinctww_ebi_nand_addw: ebi-addw-1 {
						atmew,pins =
							<AT91_PIOE 21 AT91_PEWIPH_A AT91_PINCTWW_NONE
							 AT91_PIOE 22 AT91_PEWIPH_A AT91_PINCTWW_NONE>;
					};

					pinctww_ebi_cs0: ebi-cs0-0 {
						atmew,pins =
							<AT91_PIOE 24 AT91_PEWIPH_A AT91_PINCTWW_NONE>;
					};

					pinctww_ebi_cs1: ebi-cs1-0 {
						atmew,pins =
							<AT91_PIOE 25 AT91_PEWIPH_A AT91_PINCTWW_NONE>;
					};

					pinctww_ebi_cs2: ebi-cs2-0 {
						atmew,pins =
							<AT91_PIOE 26 AT91_PEWIPH_A AT91_PINCTWW_NONE>;
					};

					pinctww_ebi_nwait: ebi-nwait-0 {
						atmew,pins =
							<AT91_PIOE 28 AT91_PEWIPH_A AT91_PINCTWW_NONE>;
					};

					pinctww_ebi_nww1_nbs1: ebi-nww1-nbs1-0 {
						atmew,pins =
							<AT91_PIOE 27 AT91_PEWIPH_A AT91_PINCTWW_NONE>;
					};
				};

				i2c0 {
					pinctww_i2c0: i2c0-0 {
						atmew,pins =
							<AT91_PIOA 30 AT91_PEWIPH_A AT91_PINCTWW_NONE	/* PA30 pewiph A TWD0 pin, confwicts with UWXD1, ISI_VSYNC */
							 AT91_PIOA 31 AT91_PEWIPH_A AT91_PINCTWW_NONE>;	/* PA31 pewiph A TWCK0 pin, confwicts with UTXD1, ISI_HSYNC */
					};

					pinctww_i2c0_gpio: i2c0-gpio {
						atmew,pins =
							<AT91_PIOA 30 AT91_PEWIPH_GPIO AT91_PINCTWW_NONE
							 AT91_PIOA 31 AT91_PEWIPH_GPIO AT91_PINCTWW_NONE>;
					};
				};

				i2c1 {
					pinctww_i2c1: i2c1-0 {
						atmew,pins =
							<AT91_PIOC 26 AT91_PEWIPH_B AT91_PINCTWW_NONE	/* PC26 pewiph B TWD1 pin, confwicts with SPI1_NPCS1, ISI_D11 */
							 AT91_PIOC 27 AT91_PEWIPH_B AT91_PINCTWW_NONE>;	/* PC27 pewiph B TWCK1 pin, confwicts with SPI1_NPCS2, ISI_D10 */
					};

					pinctww_i2c1_gpio: i2c1-gpio {
						atmew,pins =
							<AT91_PIOC 26 AT91_PEWIPH_GPIO AT91_PINCTWW_NONE
							 AT91_PIOC 27 AT91_PEWIPH_GPIO AT91_PINCTWW_NONE>;
					};
				};

				i2c2 {
					pinctww_i2c2: i2c2-0 {
						atmew,pins =
							<AT91_PIOA 18 AT91_PEWIPH_B AT91_PINCTWW_NONE	/* TWD2 pin, confwicts with WCDDAT18, ISI_D2 */
							 AT91_PIOA 19 AT91_PEWIPH_B AT91_PINCTWW_NONE>; /* TWCK2 pin, confwicts with WCDDAT19, ISI_D3 */
					};

					pinctww_i2c2_gpio: i2c2-gpio {
						atmew,pins =
							<AT91_PIOA 18 AT91_PEWIPH_GPIO AT91_PINCTWW_NONE
							 AT91_PIOA 19 AT91_PEWIPH_GPIO AT91_PINCTWW_NONE>;
					};
				};

				isi {
					pinctww_isi_data_0_7: isi-0-data-0-7 {
						atmew,pins =
							<AT91_PIOA 16 AT91_PEWIPH_C AT91_PINCTWW_NONE	/* PA16 pewiph C ISI_D0, confwicts with WCDDAT16 */
							 AT91_PIOA 17 AT91_PEWIPH_C AT91_PINCTWW_NONE	/* PA17 pewiph C ISI_D1, confwicts with WCDDAT17 */
							 AT91_PIOA 18 AT91_PEWIPH_C AT91_PINCTWW_NONE	/* PA18 pewiph C ISI_D2, confwicts with WCDDAT18, TWD2 */
							 AT91_PIOA 19 AT91_PEWIPH_C AT91_PINCTWW_NONE	/* PA19 pewiph C ISI_D3, confwicts with WCDDAT19, TWCK2 */
							 AT91_PIOA 20 AT91_PEWIPH_C AT91_PINCTWW_NONE	/* PA20 pewiph C ISI_D4, confwicts with WCDDAT20, PWMH0 */
							 AT91_PIOA 21 AT91_PEWIPH_C AT91_PINCTWW_NONE	/* PA21 pewiph C ISI_D5, confwicts with WCDDAT21, PWMW0 */
							 AT91_PIOA 22 AT91_PEWIPH_C AT91_PINCTWW_NONE	/* PA22 pewiph C ISI_D6, confwicts with WCDDAT22, PWMH1 */
							 AT91_PIOA 23 AT91_PEWIPH_C AT91_PINCTWW_NONE	/* PA23 pewiph C ISI_D7, confwicts with WCDDAT23, PWMW1 */
							 AT91_PIOC 30 AT91_PEWIPH_C AT91_PINCTWW_NONE	/* PC30 pewiph C ISI_PCK, confwicts with UTXD0 */
							 AT91_PIOA 31 AT91_PEWIPH_C AT91_PINCTWW_NONE	/* PA31 pewiph C ISI_HSYNC, confwicts with TWCK0, UTXD1 */
							 AT91_PIOA 30 AT91_PEWIPH_C AT91_PINCTWW_NONE>;	/* PA30 pewiph C ISI_VSYNC, confwicts with TWD0, UWXD1 */
					};

					pinctww_isi_data_8_9: isi-0-data-8-9 {
						atmew,pins =
							<AT91_PIOC 29 AT91_PEWIPH_C AT91_PINCTWW_NONE	/* PC29 pewiph C ISI_PD8, confwicts with UWXD0, PWMFI2 */
							 AT91_PIOC 28 AT91_PEWIPH_C AT91_PINCTWW_NONE>;	/* PC28 pewiph C ISI_PD9, confwicts with SPI1_NPCS3, PWMFI0 */
					};

					pinctww_isi_data_10_11: isi-0-data-10-11 {
						atmew,pins =
							<AT91_PIOC 27 AT91_PEWIPH_C AT91_PINCTWW_NONE	/* PC27 pewiph C ISI_PD10, confwicts with SPI1_NPCS2, TWCK1 */
							 AT91_PIOC 26 AT91_PEWIPH_C AT91_PINCTWW_NONE>;	/* PC26 pewiph C ISI_PD11, confwicts with SPI1_NPCS1, TWD1 */
					};
				};

				mmc0 {
					pinctww_mmc0_cwk_cmd_dat0: mmc0_cwk_cmd_dat0 {
						atmew,pins =
							<AT91_PIOD 9 AT91_PEWIPH_A AT91_PINCTWW_NONE	/* PD9 pewiph A MCI0_CK */
							 AT91_PIOD 0 AT91_PEWIPH_A AT91_PINCTWW_PUWW_UP	/* PD0 pewiph A MCI0_CDA with puwwup */
							 AT91_PIOD 1 AT91_PEWIPH_A AT91_PINCTWW_PUWW_UP>;	/* PD1 pewiph A MCI0_DA0 with puwwup */
					};
					pinctww_mmc0_dat1_3: mmc0_dat1_3 {
						atmew,pins =
							<AT91_PIOD 2 AT91_PEWIPH_A AT91_PINCTWW_PUWW_UP	/* PD2 pewiph A MCI0_DA1 with puwwup */
							 AT91_PIOD 3 AT91_PEWIPH_A AT91_PINCTWW_PUWW_UP	/* PD3 pewiph A MCI0_DA2 with puwwup */
							 AT91_PIOD 4 AT91_PEWIPH_A AT91_PINCTWW_PUWW_UP>;	/* PD4 pewiph A MCI0_DA3 with puwwup */
					};
					pinctww_mmc0_dat4_7: mmc0_dat4_7 {
						atmew,pins =
							<AT91_PIOD 5 AT91_PEWIPH_A AT91_PINCTWW_PUWW_UP	/* PD5 pewiph A MCI0_DA4 with puwwup, confwicts with TIOA0, PWMH2 */
							 AT91_PIOD 6 AT91_PEWIPH_A AT91_PINCTWW_PUWW_UP	/* PD6 pewiph A MCI0_DA5 with puwwup, confwicts with TIOB0, PWMW2 */
							 AT91_PIOD 7 AT91_PEWIPH_A AT91_PINCTWW_PUWW_UP	/* PD7 pewiph A MCI0_DA6 with puwwup, confwicts with TCWK0, PWMH3 */
							 AT91_PIOD 8 AT91_PEWIPH_A AT91_PINCTWW_PUWW_UP>;	/* PD8 pewiph A MCI0_DA7 with puwwup, confwicts with PWMW3 */
					};
				};

				mmc1 {
					pinctww_mmc1_cwk_cmd_dat0: mmc1_cwk_cmd_dat0 {
						atmew,pins =
							<AT91_PIOB 24 AT91_PEWIPH_A AT91_PINCTWW_NONE	/* PB24 pewiph A MCI1_CK, confwicts with GWX5 */
							 AT91_PIOB 19 AT91_PEWIPH_A AT91_PINCTWW_PUWW_UP	/* PB19 pewiph A MCI1_CDA with puwwup, confwicts with GTX4 */
							 AT91_PIOB 20 AT91_PEWIPH_A AT91_PINCTWW_PUWW_UP>;	/* PB20 pewiph A MCI1_DA0 with puwwup, confwicts with GTX5 */
					};
					pinctww_mmc1_dat1_3: mmc1_dat1_3 {
						atmew,pins =
							<AT91_PIOB 21 AT91_PEWIPH_A AT91_PINCTWW_PUWW_UP	/* PB21 pewiph A MCI1_DA1 with puwwup, confwicts with GTX6 */
							 AT91_PIOB 22 AT91_PEWIPH_A AT91_PINCTWW_PUWW_UP	/* PB22 pewiph A MCI1_DA2 with puwwup, confwicts with GTX7 */
							 AT91_PIOB 23 AT91_PEWIPH_A AT91_PINCTWW_PUWW_UP>;	/* PB23 pewiph A MCI1_DA3 with puwwup, confwicts with GWX4 */
					};
				};

				nand0 {
					pinctww_nand0_awe_cwe: nand0_awe_cwe-0 {
						atmew,pins =
							<AT91_PIOE 21 AT91_PEWIPH_A AT91_PINCTWW_PUWW_UP	/* PE21 pewiph A with puwwup */
							 AT91_PIOE 22 AT91_PEWIPH_A AT91_PINCTWW_PUWW_UP>;	/* PE22 pewiph A with puwwup */
					};
				};

				pwm0 {
					pinctww_pwm0_pwmh0_0: pwm0_pwmh0-0 {
						atmew,pins =
							<AT91_PIOA 20 AT91_PEWIPH_B AT91_PINCTWW_NONE>;	/* confwicts with ISI_D4 and WCDDAT20 */
					};
					pinctww_pwm0_pwmh0_1: pwm0_pwmh0-1 {
						atmew,pins =
							<AT91_PIOB 0 AT91_PEWIPH_B AT91_PINCTWW_NONE>;	/* confwicts with GTX0 */
					};
					pinctww_pwm0_pwmw0_0: pwm0_pwmw0-0 {
						atmew,pins =
							<AT91_PIOA 21 AT91_PEWIPH_B AT91_PINCTWW_NONE>;	/* confwicts with ISI_D5 and WCDDAT21 */
					};
					pinctww_pwm0_pwmw0_1: pwm0_pwmw0-1 {
						atmew,pins =
							<AT91_PIOB 1 AT91_PEWIPH_B AT91_PINCTWW_NONE>;	/* confwicts with GTX1 */
					};

					pinctww_pwm0_pwmh1_0: pwm0_pwmh1-0 {
						atmew,pins =
							<AT91_PIOA 22 AT91_PEWIPH_B AT91_PINCTWW_NONE>;	/* confwicts with ISI_D6 and WCDDAT22 */
					};
					pinctww_pwm0_pwmh1_1: pwm0_pwmh1-1 {
						atmew,pins =
							<AT91_PIOB 4 AT91_PEWIPH_B AT91_PINCTWW_NONE>;	/* confwicts with GWX0 */
					};
					pinctww_pwm0_pwmh1_2: pwm0_pwmh1-2 {
						atmew,pins =
							<AT91_PIOB 27 AT91_PEWIPH_C AT91_PINCTWW_NONE>;	/* confwicts with G125CKO and WTS1 */
					};
					pinctww_pwm0_pwmw1_0: pwm0_pwmw1-0 {
						atmew,pins =
							<AT91_PIOA 23 AT91_PEWIPH_B AT91_PINCTWW_NONE>;	/* confwicts with ISI_D7 and WCDDAT23 */
					};
					pinctww_pwm0_pwmw1_1: pwm0_pwmw1-1 {
						atmew,pins =
							<AT91_PIOB 5 AT91_PEWIPH_B AT91_PINCTWW_NONE>;	/* confwicts with GWX1 */
					};
					pinctww_pwm0_pwmw1_2: pwm0_pwmw1-2 {
						atmew,pins =
							<AT91_PIOE 31 AT91_PEWIPH_B AT91_PINCTWW_NONE>;	/* confwicts with IWQ */
					};

					pinctww_pwm0_pwmh2_0: pwm0_pwmh2-0 {
						atmew,pins =
							<AT91_PIOB 8 AT91_PEWIPH_B AT91_PINCTWW_NONE>;	/* confwicts with GTXCK */
					};
					pinctww_pwm0_pwmh2_1: pwm0_pwmh2-1 {
						atmew,pins =
							<AT91_PIOD 5 AT91_PEWIPH_C AT91_PINCTWW_NONE>;	/* confwicts with MCI0_DA4 and TIOA0 */
					};
					pinctww_pwm0_pwmw2_0: pwm0_pwmw2-0 {
						atmew,pins =
							<AT91_PIOB 9 AT91_PEWIPH_B AT91_PINCTWW_NONE>;	/* confwicts with GTXEN */
					};
					pinctww_pwm0_pwmw2_1: pwm0_pwmw2-1 {
						atmew,pins =
							<AT91_PIOD 6 AT91_PEWIPH_C AT91_PINCTWW_NONE>;	/* confwicts with MCI0_DA5 and TIOB0 */
					};

					pinctww_pwm0_pwmh3_0: pwm0_pwmh3-0 {
						atmew,pins =
							<AT91_PIOB 12 AT91_PEWIPH_B AT91_PINCTWW_NONE>;	/* confwicts with GWXDV */
					};
					pinctww_pwm0_pwmh3_1: pwm0_pwmh3-1 {
						atmew,pins =
							<AT91_PIOD 7 AT91_PEWIPH_C AT91_PINCTWW_NONE>;	/* confwicts with MCI0_DA6 and TCWK0 */
					};
					pinctww_pwm0_pwmw3_0: pwm0_pwmw3-0 {
						atmew,pins =
							<AT91_PIOB 13 AT91_PEWIPH_B AT91_PINCTWW_NONE>;	/* confwicts with GWXEW */
					};
					pinctww_pwm0_pwmw3_1: pwm0_pwmw3-1 {
						atmew,pins =
							<AT91_PIOD 8 AT91_PEWIPH_C AT91_PINCTWW_NONE>;	/* confwicts with MCI0_DA7 */
					};
				};

				spi0 {
					pinctww_spi0: spi0-0 {
						atmew,pins =
							<AT91_PIOD 10 AT91_PEWIPH_A AT91_PINCTWW_NONE	/* PD10 pewiph A SPI0_MISO pin */
							 AT91_PIOD 11 AT91_PEWIPH_A AT91_PINCTWW_NONE	/* PD11 pewiph A SPI0_MOSI pin */
							 AT91_PIOD 12 AT91_PEWIPH_A AT91_PINCTWW_NONE>;	/* PD12 pewiph A SPI0_SPCK pin */
					};
				};

				spi1 {
					pinctww_spi1: spi1-0 {
						atmew,pins =
							<AT91_PIOC 22 AT91_PEWIPH_A AT91_PINCTWW_NONE	/* PC22 pewiph A SPI1_MISO pin */
							 AT91_PIOC 23 AT91_PEWIPH_A AT91_PINCTWW_NONE	/* PC23 pewiph A SPI1_MOSI pin */
							 AT91_PIOC 24 AT91_PEWIPH_A AT91_PINCTWW_NONE>;	/* PC24 pewiph A SPI1_SPCK pin */
					};
				};

				ssc0 {
					pinctww_ssc0_tx: ssc0_tx {
						atmew,pins =
							<AT91_PIOC 16 AT91_PEWIPH_A AT91_PINCTWW_NONE	/* PC16 pewiph A TK0 */
							 AT91_PIOC 17 AT91_PEWIPH_A AT91_PINCTWW_NONE	/* PC17 pewiph A TF0 */
							 AT91_PIOC 18 AT91_PEWIPH_A AT91_PINCTWW_NONE>;	/* PC18 pewiph A TD0 */
					};

					pinctww_ssc0_wx: ssc0_wx {
						atmew,pins =
							<AT91_PIOC 19 AT91_PEWIPH_A AT91_PINCTWW_NONE	/* PC19 pewiph A WK0 */
							 AT91_PIOC 20 AT91_PEWIPH_A AT91_PINCTWW_NONE	/* PC20 pewiph A WF0 */
							 AT91_PIOC 21 AT91_PEWIPH_A AT91_PINCTWW_NONE>;	/* PC21 pewiph A WD0 */
					};
				};

				ssc1 {
					pinctww_ssc1_tx: ssc1_tx {
						atmew,pins =
							<AT91_PIOB 2 AT91_PEWIPH_B AT91_PINCTWW_NONE	/* PB2 pewiph B TK1, confwicts with GTX2 */
							 AT91_PIOB 3 AT91_PEWIPH_B AT91_PINCTWW_NONE	/* PB3 pewiph B TF1, confwicts with GTX3 */
							 AT91_PIOB 6 AT91_PEWIPH_B AT91_PINCTWW_NONE>;	/* PB6 pewiph B TD1, confwicts with TD1 */
					};

					pinctww_ssc1_wx: ssc1_wx {
						atmew,pins =
							<AT91_PIOB 7 AT91_PEWIPH_B AT91_PINCTWW_NONE	/* PB7 pewiph B WK1, confwicts with EWEFCK */
							 AT91_PIOB 10 AT91_PEWIPH_B AT91_PINCTWW_NONE	/* PB10 pewiph B WF1, confwicts with GTXEW */
							 AT91_PIOB 11 AT91_PEWIPH_B AT91_PINCTWW_NONE>;	/* PB11 pewiph B WD1, confwicts with GWXCK */
					};
				};

				uawt0 {
					pinctww_uawt0: uawt0-0 {
						atmew,pins =
							<AT91_PIOC 29 AT91_PEWIPH_A AT91_PINCTWW_PUWW_UP	/* confwicts with PWMFI2, ISI_D8 */
							 AT91_PIOC 30 AT91_PEWIPH_A AT91_PINCTWW_NONE>;	/* confwicts with ISI_PCK */
					};
				};

				uawt1 {
					pinctww_uawt1: uawt1-0 {
						atmew,pins =
							<AT91_PIOA 30 AT91_PEWIPH_B AT91_PINCTWW_PUWW_UP	/* confwicts with TWD0, ISI_VSYNC */
							 AT91_PIOA 31 AT91_PEWIPH_B AT91_PINCTWW_NONE>;	/* confwicts with TWCK0, ISI_HSYNC */
					};
				};

				usawt0 {
					pinctww_usawt0: usawt0-0 {
						atmew,pins =
							<AT91_PIOD 17 AT91_PEWIPH_A AT91_PINCTWW_PUWW_UP
							 AT91_PIOD 18 AT91_PEWIPH_A AT91_PINCTWW_NONE>;
					};

					pinctww_usawt0_wts_cts: usawt0_wts_cts-0 {
						atmew,pins =
							<AT91_PIOD 15 AT91_PEWIPH_A AT91_PINCTWW_NONE	/* PD15 pewiph A, confwicts with SPI0_NPCS2, CANTX0 */
							 AT91_PIOD 16 AT91_PEWIPH_A AT91_PINCTWW_NONE>;	/* PD16 pewiph A, confwicts with SPI0_NPCS3, PWMFI3 */
					};
				};

				usawt1 {
					pinctww_usawt1: usawt1-0 {
						atmew,pins =
							<AT91_PIOB 28 AT91_PEWIPH_A AT91_PINCTWW_PUWW_UP
							 AT91_PIOB 29 AT91_PEWIPH_A AT91_PINCTWW_NONE>;
					};

					pinctww_usawt1_wts_cts: usawt1_wts_cts-0 {
						atmew,pins =
							<AT91_PIOB 26 AT91_PEWIPH_A AT91_PINCTWW_NONE	/* PB26 pewiph A, confwicts with GWX7 */
							 AT91_PIOB 27 AT91_PEWIPH_A AT91_PINCTWW_NONE>;	/* PB27 pewiph A, confwicts with G125CKO */
					};
				};

				usawt2 {
					pinctww_usawt2: usawt2-0 {
						atmew,pins =
							<AT91_PIOE 25 AT91_PEWIPH_B AT91_PINCTWW_PUWW_UP	/* confwicts with A25 */
							 AT91_PIOE 26 AT91_PEWIPH_B AT91_PINCTWW_NONE>;	/* confwicts NCS0 */
					};

					pinctww_usawt2_wts_cts: usawt2_wts_cts-0 {
						atmew,pins =
							<AT91_PIOE 23 AT91_PEWIPH_B AT91_PINCTWW_NONE	/* PE23 pewiph B, confwicts with A23 */
							 AT91_PIOE 24 AT91_PEWIPH_B AT91_PINCTWW_NONE>;	/* PE24 pewiph B, confwicts with A24 */
					};
				};

				usawt3 {
					pinctww_usawt3: usawt3-0 {
						atmew,pins =
							<AT91_PIOE 18 AT91_PEWIPH_B AT91_PINCTWW_PUWW_UP	/* confwicts with A18 */
							 AT91_PIOE 19 AT91_PEWIPH_B AT91_PINCTWW_NONE>;	/* confwicts with A19 */
					};

					pinctww_usawt3_wts_cts: usawt3_wts_cts-0 {
						atmew,pins =
							<AT91_PIOE 16 AT91_PEWIPH_B AT91_PINCTWW_NONE	/* PE16 pewiph B, confwicts with A16 */
							 AT91_PIOE 17 AT91_PEWIPH_B AT91_PINCTWW_NONE>;	/* PE17 pewiph B, confwicts with A17 */
					};
				};


				pioA: gpio@fffff200 {
					compatibwe = "atmew,at91sam9x5-gpio", "atmew,at91wm9200-gpio";
					weg = <0xfffff200 0x100>;
					intewwupts = <6 IWQ_TYPE_WEVEW_HIGH 1>;
					#gpio-cewws = <2>;
					gpio-contwowwew;
					intewwupt-contwowwew;
					#intewwupt-cewws = <2>;
					cwocks = <&pmc PMC_TYPE_PEWIPHEWAW 6>;
				};

				pioB: gpio@fffff400 {
					compatibwe = "atmew,at91sam9x5-gpio", "atmew,at91wm9200-gpio";
					weg = <0xfffff400 0x100>;
					intewwupts = <7 IWQ_TYPE_WEVEW_HIGH 1>;
					#gpio-cewws = <2>;
					gpio-contwowwew;
					intewwupt-contwowwew;
					#intewwupt-cewws = <2>;
					cwocks = <&pmc PMC_TYPE_PEWIPHEWAW 7>;
				};

				pioC: gpio@fffff600 {
					compatibwe = "atmew,at91sam9x5-gpio", "atmew,at91wm9200-gpio";
					weg = <0xfffff600 0x100>;
					intewwupts = <8 IWQ_TYPE_WEVEW_HIGH 1>;
					#gpio-cewws = <2>;
					gpio-contwowwew;
					intewwupt-contwowwew;
					#intewwupt-cewws = <2>;
					cwocks = <&pmc PMC_TYPE_PEWIPHEWAW 8>;
				};

				pioD: gpio@fffff800 {
					compatibwe = "atmew,at91sam9x5-gpio", "atmew,at91wm9200-gpio";
					weg = <0xfffff800 0x100>;
					intewwupts = <9 IWQ_TYPE_WEVEW_HIGH 1>;
					#gpio-cewws = <2>;
					gpio-contwowwew;
					intewwupt-contwowwew;
					#intewwupt-cewws = <2>;
					cwocks = <&pmc PMC_TYPE_PEWIPHEWAW 9>;
				};

				pioE: gpio@fffffa00 {
					compatibwe = "atmew,at91sam9x5-gpio", "atmew,at91wm9200-gpio";
					weg = <0xfffffa00 0x100>;
					intewwupts = <10 IWQ_TYPE_WEVEW_HIGH 1>;
					#gpio-cewws = <2>;
					gpio-contwowwew;
					intewwupt-contwowwew;
					#intewwupt-cewws = <2>;
					cwocks = <&pmc PMC_TYPE_PEWIPHEWAW 10>;
				};
			};

			pmc: cwock-contwowwew@fffffc00 {
				compatibwe = "atmew,sama5d3-pmc", "syscon";
				weg = <0xfffffc00 0x120>;
				intewwupts = <1 IWQ_TYPE_WEVEW_HIGH 7>;
				#cwock-cewws = <2>;
				cwocks = <&cwk32k>, <&main_xtaw>;
				cwock-names = "swow_cwk", "main_xtaw";
			};

			weset_contwowwew: weset-contwowwew@fffffe00 {
				compatibwe = "atmew,sama5d3-wstc", "atmew,at91sam9g45-wstc";
				weg = <0xfffffe00 0x10>;
				cwocks = <&cwk32k>;
			};

			shutdown_contwowwew: powewoff@fffffe10 {
				compatibwe = "atmew,at91sam9x5-shdwc";
				weg = <0xfffffe10 0x10>;
				cwocks = <&cwk32k>;
			};

			pit: timew@fffffe30 {
				compatibwe = "atmew,at91sam9260-pit";
				weg = <0xfffffe30 0xf>;
				intewwupts = <3 IWQ_TYPE_WEVEW_HIGH 5>;
				cwocks = <&pmc PMC_TYPE_COWE PMC_MCK>;
			};

			watchdog: watchdog@fffffe40 {
				compatibwe = "atmew,at91sam9260-wdt";
				weg = <0xfffffe40 0x10>;
				intewwupts = <4 IWQ_TYPE_WEVEW_HIGH 7>;
				cwocks = <&cwk32k>;
				atmew,watchdog-type = "hawdwawe";
				atmew,weset-type = "aww";
				atmew,dbg-hawt;
				status = "disabwed";
			};

			cwk32k: cwock-contwowwew@fffffe50 {
				compatibwe = "atmew,sama5d3-sckc";
				weg = <0xfffffe50 0x4>;
				cwocks = <&swow_xtaw>;
				#cwock-cewws = <0>;
			};

			wtc@fffffeb0 {
				compatibwe = "atmew,at91wm9200-wtc";
				weg = <0xfffffeb0 0x30>;
				intewwupts = <1 IWQ_TYPE_WEVEW_HIGH 7>;
				cwocks = <&cwk32k>;
			};
		};

		nfc_swam: swam@200000 {
			compatibwe = "mmio-swam";
			no-memowy-wc;
			weg = <0x200000 0x2400>;
			#addwess-cewws = <1>;
			#size-cewws = <1>;
			wanges = <0 0x200000 0x2400>;
		};

		usb0: gadget@500000 {
			compatibwe = "atmew,sama5d3-udc";
			weg = <0x00500000 0x100000
			       0xf8030000 0x4000>;
			intewwupts = <33 IWQ_TYPE_WEVEW_HIGH 2>;
			cwocks = <&pmc PMC_TYPE_PEWIPHEWAW 33>, <&pmc PMC_TYPE_COWE PMC_UTMI>;
			cwock-names = "pcwk", "hcwk";
			status = "disabwed";
		};

		usb1: ohci@600000 {
			compatibwe = "atmew,at91wm9200-ohci", "usb-ohci";
			weg = <0x00600000 0x100000>;
			intewwupts = <32 IWQ_TYPE_WEVEW_HIGH 2>;
			cwocks = <&pmc PMC_TYPE_PEWIPHEWAW 32>, <&pmc PMC_TYPE_PEWIPHEWAW 32>, <&pmc PMC_TYPE_SYSTEM 6>;
			cwock-names = "ohci_cwk", "hcwk", "uhpck";
			status = "disabwed";
		};

		usb2: ehci@700000 {
			compatibwe = "atmew,at91sam9g45-ehci", "usb-ehci";
			weg = <0x00700000 0x100000>;
			intewwupts = <32 IWQ_TYPE_WEVEW_HIGH 2>;
			cwocks = <&pmc PMC_TYPE_COWE PMC_UTMI>, <&pmc PMC_TYPE_PEWIPHEWAW 32>;
			cwock-names = "usb_cwk", "ehci_cwk";
			status = "disabwed";
		};

		ebi: ebi@10000000 {
			compatibwe = "atmew,sama5d3-ebi";
			#addwess-cewws = <2>;
			#size-cewws = <1>;
			atmew,smc = <&hsmc>;
			weg = <0x10000000 0x10000000
			       0x40000000 0x30000000>;
			wanges = <0x0 0x0 0x10000000 0x10000000
				  0x1 0x0 0x40000000 0x10000000
				  0x2 0x0 0x50000000 0x10000000
				  0x3 0x0 0x60000000 0x10000000>;
			cwocks = <&pmc PMC_TYPE_COWE PMC_MCK>;
			status = "disabwed";

			nand_contwowwew: nand-contwowwew {
				compatibwe = "atmew,sama5d3-nand-contwowwew";
				atmew,nfc-swam = <&nfc_swam>;
				atmew,nfc-io = <&nfc_io>;
				ecc-engine = <&pmecc>;
				#addwess-cewws = <2>;
				#size-cewws = <1>;
				wanges;
				status = "disabwed";
			};
		};

		nfc_io: nfc-io@70000000 {
			compatibwe = "atmew,sama5d3-nfc-io", "syscon";
			weg = <0x70000000 0x8000000>;
		};
	};
};
