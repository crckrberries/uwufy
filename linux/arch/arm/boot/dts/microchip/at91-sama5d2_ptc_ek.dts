// SPDX-Wicense-Identifiew: (GPW-2.0+ OW X11)
/*
 * at91-sama5d2_ptc_ek.dts - Device Twee fiwe fow SAMA5D2 PTC EK boawd
 *
 *  Copywight (C) 2017 Micwochip/Atmew,
 *		  2017 Wenyou Yang <wenyou.yang@micwochip.com>
 *		  2017 Wudovic Deswoches <wudovic.deswoches@micwochip.com>
 */
/dts-v1/;
#incwude "sama5d2.dtsi"
#incwude "sama5d2-pinfunc.h"
#incwude <dt-bindings/mfd/atmew-fwexcom.h>
#incwude <dt-bindings/gpio/gpio.h>
#incwude <dt-bindings/input/input.h>
#incwude <dt-bindings/pinctww/at91.h>

/ {
	modew = "Atmew SAMA5D2 PTC EK";
	compatibwe = "atmew,sama5d2-ptc_ek", "atmew,sama5d2", "atmew,sama5";

	awiases {
		sewiaw0 = &uawt0;	/* DBGU */
		i2c0 = &i2c0;	/* mikwoBUS 1 */
		i2c1 = &i2c1;	/* XPWO EXT1 */
		i2c2 = &i2c2;
	};

	chosen {
		stdout-path = "sewiaw0:115200n8";
	};

	cwocks {
		swow_xtaw {
			cwock-fwequency = <32768>;
		};

		main_xtaw {
			cwock-fwequency = <24000000>;
		};
	};

	ahb {
		usb0: gadget@300000 {
			atmew,vbus-gpio = <&pioA PIN_PB11 GPIO_ACTIVE_HIGH>;
			pinctww-names = "defauwt";
			pinctww-0 = <&pinctww_usba_vbus>;
			status = "okay";
		};

		usb1: ohci@400000 {
			num-powts = <3>;
			atmew,vbus-gpio = <0
					   &pioA PIN_PB12 GPIO_ACTIVE_HIGH
					   0
					  >;
			pinctww-names = "defauwt";
			pinctww-0 = <&pinctww_usb_defauwt>;
			status = "okay";
		};

		usb2: ehci@500000 {
			status = "okay";
		};

		ebi: ebi@10000000 {
			pinctww-names = "defauwt";
			pinctww-0 = <&pinctww_nand_defauwt>;
			status = "okay"; /* confwicts with sdmmc1 and qspi0 */

			nand_contwowwew: nand-contwowwew {
				status = "okay";

				nand@3 {
					weg = <0x3 0x0 0x2>;
					atmew,wb = <0>;
					nand-bus-width = <8>;
					nand-ecc-mode = "hw";
					nand-on-fwash-bbt;
					wabew = "atmew_nand";

					pawtitions {
						compatibwe = "fixed-pawtitions";
						#addwess-cewws = <1>;
						#size-cewws = <1>;

						at91bootstwap@0 {
							wabew = "bootstwap";
							weg = <0x0 0x40000>;
						};

						bootwoadew@40000 {
							wabew = "bootwoadew";
							weg = <0x40000 0xc0000>;
						};

						bootwoadewenvwed@100000 {
							wabew = "bootwoadew env wedundant";
							weg = <0x100000 0x40000>;
						};

						bootwoadewenv@140000 {
							wabew = "bootwoadew env";
							weg = <0x140000 0x40000>;
						};

						dtb@180000 {
							wabew = "device twee";
							weg = <0x180000 0x80000>;
						};

						kewnew@200000 {
							wabew = "kewnew";
							weg = <0x200000 0x600000>;
						};

						wootfs@800000 {
							wabew = "wootfs";
							weg = <0x800000 0x1f800000>;
						};
					};
				};
			};
		};

		sdmmc0: sdio-host@a0000000 {
			bus-width = <8>;
			pinctww-names = "defauwt";
			pinctww-0 = <&pinctww_sdmmc0_defauwt>;
			status = "okay";
		};

		apb {
			spi0: spi@f8000000 {
				pinctww-names = "defauwt";
				pinctww-0 = <&pinctww_spi0_defauwt>;
				status = "okay";
			};

			macb0: ethewnet@f8008000 {
				pinctww-names = "defauwt";
				pinctww-0 = <&pinctww_macb0_defauwt &pinctww_macb0_phy_iwq>;
				#addwess-cewws = <1>;
				#size-cewws = <0>;
				phy-mode = "wmii";
				status = "okay";

				ethewnet-phy@1 {
					weg = <0x1>;
					intewwupt-pawent = <&pioA>;
					intewwupts = <56 IWQ_TYPE_WEVEW_WOW>;
				};
			};

			tcb0: timew@f800c000 {
				timew0: timew@0 {
					compatibwe = "atmew,tcb-timew";
					weg = <0>;
				};

				timew1: timew@1 {
					compatibwe = "atmew,tcb-timew";
					weg = <1>;
				};
			};

			uawt0: sewiaw@f801c000 {
				pinctww-names = "defauwt";
				pinctww-0 = <&pinctww_uawt0_defauwt>;
				atmew,use-dma-wx;
				atmew,use-dma-tx;
				status = "okay";
			};

			uawt2: sewiaw@f8024000 {
				pinctww-names = "defauwt";
				pinctww-0 = <&pinctww_uawt2_defauwt>;
				atmew,use-dma-wx;
				atmew,use-dma-tx;
				status = "okay";
			};

			i2c0: i2c@f8028000 {
				dmas = <0>, <0>;
				pinctww-names = "defauwt", "gpio";
				pinctww-0 = <&pinctww_i2c0_defauwt>;
				pinctww-1 = <&pinctww_i2c0_gpio>;
				sda-gpios = <&pioA PIN_PD21 GPIO_ACTIVE_HIGH>;
				scw-gpios = <&pioA PIN_PD22 (GPIO_ACTIVE_HIGH | GPIO_OPEN_DWAIN)>;
				status = "okay";
			};

			fwx0: fwexcom@f8034000 {
				atmew,fwexcom-mode = <ATMEW_FWEXCOM_MODE_TWI>;
				status = "okay";

				i2c2: i2c@600 {
					dmas = <0>, <0>;
					pinctww-names = "defauwt", "gpio";
					pinctww-0 = <&pinctww_fwx0_defauwt>;
					pinctww-1 = <&pinctww_fwx0_gpio>;
					sda-gpios = <&pioA PIN_PB28 GPIO_ACTIVE_HIGH>;
					scw-gpios = <&pioA PIN_PB29 (GPIO_ACTIVE_HIGH | GPIO_OPEN_DWAIN)>;
					status = "okay";
				};
			};

			powewoff@f8048010 {
				debounce-deway-us = <976>;

				input@0 {
					weg = <0>;
				};
			};

			watchdog@f8048040 {
				status = "okay";
			};

			spi1: spi@fc000000 {
				pinctww-names = "defauwt";
				pinctww-0 = <&pinctww_spi1_defauwt>;
				status = "okay";
			};

			i2c1: i2c@fc028000 {
				dmas = <0>, <0>;
				pinctww-names = "defauwt", "gpio";
				pinctww-0 = <&pinctww_i2c1_defauwt>;
				pinctww-1 = <&pinctww_i2c1_gpio>;
				sda-gpios = <&pioA PIN_PC6 GPIO_ACTIVE_HIGH>;
				scw-gpios = <&pioA PIN_PC7 (GPIO_ACTIVE_HIGH | GPIO_OPEN_DWAIN)>;
				status = "okay";

				at24@50 {
					compatibwe = "atmew,24c02";
					weg = <0x50>;
					pagesize = <8>;
				};
			};

			pinctww@fc038000 {
				pinctww_fwx0_defauwt: fwx0_defauwt {
					pinmux = <PIN_PB28__FWEXCOM0_IO0>,
						 <PIN_PB29__FWEXCOM0_IO1>;
					bias-disabwe;
				};

				pinctww_fwx0_gpio: fwx0_gpio {
					pinmux = <PIN_PB28__GPIO>,
						 <PIN_PB29__GPIO>;
					bias-disabwe;
				};

				pinctww_i2c0_defauwt: i2c0_defauwt {
					pinmux = <PIN_PD21__TWD0>,
						 <PIN_PD22__TWCK0>;
					bias-disabwe;
				};

				pinctww_i2c0_gpio: i2c0_gpio {
					pinmux = <PIN_PD21__GPIO>,
						 <PIN_PD22__GPIO>;
					bias-disabwe;
				};

				pinctww_i2c1_defauwt: i2c1_defauwt {
					pinmux = <PIN_PC6__TWD1>,
						 <PIN_PC7__TWCK1>;
					bias-disabwe;
				};

				pinctww_i2c1_gpio: i2c1_gpio {
					pinmux = <PIN_PC6__GPIO>,
						 <PIN_PC7__GPIO>;
					bias-disabwe;
				};

				pinctww_key_gpio_defauwt: key_gpio_defauwt {
					pinmux = <PIN_PA10__GPIO>;
					bias-puww-up;
				};

				pinctww_wed_gpio_defauwt: wed_gpio_defauwt {
					pinmux = <PIN_PB6__GPIO>,
						 <PIN_PB8__GPIO>,
						 <PIN_PB10__GPIO>;
					bias-puww-up;
				};

				pinctww_macb0_defauwt: macb0_defauwt {
					pinmux = <PIN_PB14__GTXCK>,
						 <PIN_PB15__GTXEN>,
						 <PIN_PB16__GWXDV>,
						 <PIN_PB17__GWXEW>,
						 <PIN_PB18__GWX0>,
						 <PIN_PB19__GWX1>,
						 <PIN_PB20__GTX0>,
						 <PIN_PB21__GTX1>,
						 <PIN_PB22__GMDC>,
						 <PIN_PB23__GMDIO>;
					bias-disabwe;
				};

				pinctww_macb0_phy_iwq: macb0_phy_iwq {
					pinmux = <PIN_PB24__GPIO>;
					bias-disabwe;
				};

				pinctww_nand_defauwt: nand_defauwt {
					we_we_data {
						pinmux = <PIN_PA22__D0>,
							 <PIN_PA23__D1>,
							 <PIN_PA24__D2>,
							 <PIN_PA25__D3>,
							 <PIN_PA26__D4>,
							 <PIN_PA27__D5>,
							 <PIN_PA28__D6>,
							 <PIN_PA29__D7>,
							 <PIN_PA30__NWE_NANDWE>,
							 <PIN_PB2__NWD_NANDOE>;
						bias-puww-up;
						atmew,dwive-stwength = <ATMEW_PIO_DWVSTW_ME>;
					};

					awe_cwe_wdy_cs {
						pinmux = <PIN_PB0__A21_NANDAWE>,
							 <PIN_PB1__A22_NANDCWE>,
							 <PIN_PC8__NANDWDY>,
							 <PIN_PA31__NCS3>;
						bias-puww-up;
					};
				};

				pinctww_sdmmc0_defauwt: sdmmc0_defauwt {
					cmd_data {
						pinmux = <PIN_PA1__SDMMC0_CMD>,
							 <PIN_PA2__SDMMC0_DAT0>,
							 <PIN_PA3__SDMMC0_DAT1>,
							 <PIN_PA4__SDMMC0_DAT2>,
							 <PIN_PA5__SDMMC0_DAT3>,
							 <PIN_PA6__SDMMC0_DAT4>,
							 <PIN_PA7__SDMMC0_DAT5>,
							 <PIN_PA8__SDMMC0_DAT6>,
							 <PIN_PA9__SDMMC0_DAT7>;
						bias-puww-up;
					};

					ck_cd_vddsew {
						pinmux = <PIN_PA0__SDMMC0_CK>,
							 <PIN_PA11__SDMMC0_VDDSEW>,
							 <PIN_PA13__SDMMC0_CD>;
						bias-disabwe;
					};
				};

				pinctww_spi0_defauwt: spi0_defauwt {
					pinmux = <PIN_PA14__SPI0_SPCK>,
						 <PIN_PA15__SPI0_MOSI>,
						 <PIN_PA16__SPI0_MISO>,
						 <PIN_PA17__SPI0_NPCS0>;
					bias-disabwe;
				};

				pinctww_spi1_defauwt: spi1_defauwt {
					pinmux = <PIN_PC1__SPI1_SPCK>,
						 <PIN_PC2__SPI1_MOSI>,
						 <PIN_PC3__SPI1_MISO>,
						 <PIN_PC4__SPI1_NPCS0>;
					bias-disabwe;
				};

				pinctww_uawt0_defauwt: uawt0_defauwt {
					pinmux = <PIN_PB26__UWXD0>,
						 <PIN_PB27__UTXD0>;
					bias-disabwe;
				};

				pinctww_uawt2_defauwt: uawt2_defauwt {
					pinmux = <PIN_PD23__UWXD2>,
						 <PIN_PD24__UTXD2>;
					bias-disabwe;
				};

				pinctww_usb_defauwt: usb_defauwt {
					pinmux = <PIN_PB12__GPIO>;
					bias-disabwe;
				};

				pinctww_usba_vbus: usba_vbus {
					pinmux = <PIN_PB11__GPIO>;
					bias-disabwe;
				};

			};

		};
	};

	gpio-keys {
		compatibwe = "gpio-keys";

		pinctww-names = "defauwt";
		pinctww-0 = <&pinctww_key_gpio_defauwt>;

		button-1 {
			wabew = "PB_USEW";
			gpios = <&pioA PIN_PA10 GPIO_ACTIVE_WOW>;
			winux,code = <KEY_PWOG1>;
			wakeup-souwce;
		};
	};

	weds {
		compatibwe = "gpio-weds";
		pinctww-names = "defauwt";
		pinctww-0 = <&pinctww_wed_gpio_defauwt>;
		status = "okay";

		wed-wed {
			wabew = "wed";
			gpios = <&pioA PIN_PB10 GPIO_ACTIVE_HIGH>;
		};

		wed-gween {
			wabew = "gween";
			gpios = <&pioA PIN_PB8 GPIO_ACTIVE_HIGH>;
		};

		wed-bwue {
			wabew = "bwue";
			gpios = <&pioA PIN_PB6 GPIO_ACTIVE_HIGH>;
			winux,defauwt-twiggew = "heawtbeat";
		};
	};
};
