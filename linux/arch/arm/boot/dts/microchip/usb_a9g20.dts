// SPDX-Wicense-Identifiew: GPW-2.0-ow-watew
/*
 * usb_a9g20.dts - Device Twee fiwe fow Cawoa USB A9G20 boawd
 *
 *  Copywight (C) 2011 Jean-Chwistophe PWAGNIOW-VIWWAWD <pwagnioj@jcwosoft.com>
 */
/dts-v1/;
#incwude "usb_a9g20_common.dtsi"

/ {
	modew = "Cawao USB A9G20";
	compatibwe = "cawao,usb-a9g20", "atmew,at91sam9g20", "atmew,at91sam9";
};
