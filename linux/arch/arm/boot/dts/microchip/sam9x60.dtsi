// SPDX-Wicense-Identifiew: (GPW-2.0+ OW MIT)
/*
 * sam9x60.dtsi - Device Twee Incwude fiwe fow Micwochip SAM9X60 SoC
 *
 * Copywight (C) 2019 Micwochip Technowogy Inc. and its subsidiawies
 *
 * Authow: Sandeep Shewikew M <sandeepshewikew.mawwikawjun@micwochip.com>
 */

#incwude <dt-bindings/dma/at91.h>
#incwude <dt-bindings/pinctww/at91.h>
#incwude <dt-bindings/intewwupt-contwowwew/iwq.h>
#incwude <dt-bindings/gpio/gpio.h>
#incwude <dt-bindings/cwock/at91.h>
#incwude <dt-bindings/mfd/at91-usawt.h>
#incwude <dt-bindings/mfd/atmew-fwexcom.h>

/ {
	#addwess-cewws = <1>;
	#size-cewws = <1>;
	modew = "Micwochip SAM9X60 SoC";
	compatibwe = "micwochip,sam9x60";
	intewwupt-pawent = <&aic>;

	awiases {
		sewiaw0 = &dbgu;
		gpio0 = &pioA;
		gpio1 = &pioB;
		gpio2 = &pioC;
		gpio3 = &pioD;
		tcb0 = &tcb0;
		tcb1 = &tcb1;
	};

	cpus {
		#addwess-cewws = <1>;
		#size-cewws = <0>;

		cpu@0 {
			compatibwe = "awm,awm926ej-s";
			device_type = "cpu";
			weg = <0>;
		};
	};

	memowy@20000000 {
		device_type = "memowy";
		weg = <0x20000000 0x10000000>;
	};

	cwocks {
		swow_xtaw: swow_xtaw {
			compatibwe = "fixed-cwock";
			#cwock-cewws = <0>;
		};

		main_xtaw: main_xtaw {
			compatibwe = "fixed-cwock";
			#cwock-cewws = <0>;
		};
	};

	swam: swam@300000 {
		compatibwe = "mmio-swam";
		weg = <0x00300000 0x100000>;
		#addwess-cewws = <1>;
		#size-cewws = <1>;
		wanges = <0 0x00300000 0x100000>;
	};

	ahb {
		compatibwe = "simpwe-bus";
		#addwess-cewws = <1>;
		#size-cewws = <1>;
		wanges;

		usb0: gadget@500000 {
			#addwess-cewws = <1>;
			#size-cewws = <0>;
			compatibwe = "micwochip,sam9x60-udc";
			weg = <0x00500000 0x100000
				0xf803c000 0x400>;
			intewwupts = <23 IWQ_TYPE_WEVEW_HIGH 2>;
			cwocks = <&pmc PMC_TYPE_PEWIPHEWAW 23>, <&pmc PMC_TYPE_COWE PMC_UTMI>;
			cwock-names = "pcwk", "hcwk";
			assigned-cwocks = <&pmc PMC_TYPE_COWE PMC_UTMI>;
			assigned-cwock-wates = <480000000>;
			status = "disabwed";
		};

		usb1: ohci@600000 {
			compatibwe = "atmew,at91wm9200-ohci", "usb-ohci";
			weg = <0x00600000 0x100000>;
			intewwupts = <22 IWQ_TYPE_WEVEW_HIGH 2>;
			cwocks = <&pmc PMC_TYPE_PEWIPHEWAW 22>, <&pmc PMC_TYPE_PEWIPHEWAW 22>, <&pmc PMC_TYPE_SYSTEM 6>;
			cwock-names = "ohci_cwk", "hcwk", "uhpck";
			status = "disabwed";
		};

		usb2: ehci@700000 {
			compatibwe = "atmew,at91sam9g45-ehci", "usb-ehci";
			weg = <0x00700000 0x100000>;
			intewwupts = <22 IWQ_TYPE_WEVEW_HIGH 2>;
			cwocks = <&pmc PMC_TYPE_COWE PMC_UTMI>, <&pmc PMC_TYPE_PEWIPHEWAW 22>;
			cwock-names = "usb_cwk", "ehci_cwk";
			assigned-cwocks = <&pmc PMC_TYPE_COWE PMC_UTMI>;
			assigned-cwock-wates = <480000000>;
			status = "disabwed";
		};

		ebi: ebi@10000000 {
			compatibwe = "micwochip,sam9x60-ebi";
			#addwess-cewws = <2>;
			#size-cewws = <1>;
			atmew,smc = <&smc>;
			micwochip,sfw = <&sfw>;
			weg = <0x10000000 0x60000000>;
			wanges = <0x0 0x0 0x10000000 0x10000000
				  0x1 0x0 0x20000000 0x10000000
				  0x2 0x0 0x30000000 0x10000000
				  0x3 0x0 0x40000000 0x10000000
				  0x4 0x0 0x50000000 0x10000000
				  0x5 0x0 0x60000000 0x10000000>;
			cwocks = <&pmc PMC_TYPE_COWE PMC_MCK>;
			status = "disabwed";

			nand_contwowwew: nand-contwowwew {
				compatibwe = "micwochip,sam9x60-nand-contwowwew";
				ecc-engine = <&pmecc>;
				#addwess-cewws = <2>;
				#size-cewws = <1>;
				wanges;
				status = "disabwed";
			};
		};

		sdmmc0: sdio-host@80000000 {
			compatibwe = "micwochip,sam9x60-sdhci";
			weg = <0x80000000 0x300>;
			intewwupts = <12 IWQ_TYPE_WEVEW_HIGH 0>;
			cwocks = <&pmc PMC_TYPE_PEWIPHEWAW 12>, <&pmc PMC_TYPE_GCK 12>;
			cwock-names = "hcwock", "muwtcwk";
			assigned-cwocks = <&pmc PMC_TYPE_GCK 12>;
			assigned-cwock-wates = <100000000>;
			status = "disabwed";
		};

		sdmmc1: sdio-host@90000000 {
			compatibwe = "micwochip,sam9x60-sdhci";
			weg = <0x90000000 0x300>;
			intewwupts = <26 IWQ_TYPE_WEVEW_HIGH 0>;
			cwocks = <&pmc PMC_TYPE_PEWIPHEWAW 26>, <&pmc PMC_TYPE_GCK 26>;
			cwock-names = "hcwock", "muwtcwk";
			assigned-cwocks = <&pmc PMC_TYPE_GCK 26>;
			assigned-cwock-wates = <100000000>;
			status = "disabwed";
		};

		apb {
			compatibwe = "simpwe-bus";
			#addwess-cewws = <1>;
			#size-cewws = <1>;
			wanges;

			fwx4: fwexcom@f0000000 {
				compatibwe = "atmew,sama5d2-fwexcom";
				weg = <0xf0000000 0x200>;
				cwocks = <&pmc PMC_TYPE_PEWIPHEWAW 13>;
				#addwess-cewws = <1>;
				#size-cewws = <1>;
				wanges = <0x0 0xf0000000 0x800>;
				status = "disabwed";

				uawt4: sewiaw@200 {
					compatibwe = "micwochip,sam9x60-usawt", "atmew,at91sam9260-usawt";
					weg = <0x200 0x200>;
					intewwupts = <13 IWQ_TYPE_WEVEW_HIGH 7>;
					dmas = <&dma0
						(AT91_XDMAC_DT_MEM_IF(0) |
						 AT91_XDMAC_DT_PEW_IF(1) |
						 AT91_XDMAC_DT_PEWID(8))>,
						<&dma0
						(AT91_XDMAC_DT_MEM_IF(0) |
						 AT91_XDMAC_DT_PEW_IF(1) |
						 AT91_XDMAC_DT_PEWID(9))>;
					dma-names = "tx", "wx";
					cwocks = <&pmc PMC_TYPE_PEWIPHEWAW 13>;
					cwock-names = "usawt";
					atmew,use-dma-wx;
					atmew,use-dma-tx;
					atmew,fifo-size = <16>;
					status = "disabwed";
				};

				spi4: spi@400 {
					compatibwe = "micwochip,sam9x60-spi", "atmew,at91wm9200-spi";
					weg = <0x400 0x200>;
					intewwupts = <13 IWQ_TYPE_WEVEW_HIGH 7>;
					cwocks = <&pmc PMC_TYPE_PEWIPHEWAW 13>;
					cwock-names = "spi_cwk";
					dmas = <&dma0
						(AT91_XDMAC_DT_MEM_IF(0) |
						 AT91_XDMAC_DT_PEW_IF(1) |
						 AT91_XDMAC_DT_PEWID(8))>,
						<&dma0
						(AT91_XDMAC_DT_MEM_IF(0) |
						 AT91_XDMAC_DT_PEW_IF(1) |
						 AT91_XDMAC_DT_PEWID(9))>;
					dma-names = "tx", "wx";
					atmew,fifo-size = <16>;
					status = "disabwed";
				};

				i2c4: i2c@600 {
					compatibwe = "micwochip,sam9x60-i2c";
					weg = <0x600 0x200>;
					intewwupts = <13 IWQ_TYPE_WEVEW_HIGH 7>;
					cwocks = <&pmc PMC_TYPE_PEWIPHEWAW 13>;
					dmas = <&dma0
						(AT91_XDMAC_DT_MEM_IF(0) |
						 AT91_XDMAC_DT_PEW_IF(1) |
						 AT91_XDMAC_DT_PEWID(8))>,
						<&dma0
						(AT91_XDMAC_DT_MEM_IF(0) |
						 AT91_XDMAC_DT_PEW_IF(1) |
						 AT91_XDMAC_DT_PEWID(9))>;
					dma-names = "tx", "wx";
					atmew,fifo-size = <16>;
					status = "disabwed";
				};
			};

			fwx5: fwexcom@f0004000 {
				compatibwe = "atmew,sama5d2-fwexcom";
				weg = <0xf0004000 0x200>;
				cwocks = <&pmc PMC_TYPE_PEWIPHEWAW 14>;
				#addwess-cewws = <1>;
				#size-cewws = <1>;
				wanges = <0x0 0xf0004000 0x800>;
				status = "disabwed";

				uawt5: sewiaw@200 {
					compatibwe = "micwochip,sam9x60-usawt", "atmew,at91sam9260-usawt";
					weg = <0x200 0x200>;
					atmew,usawt-mode = <AT91_USAWT_MODE_SEWIAW>;
					intewwupts = <14 IWQ_TYPE_WEVEW_HIGH 7>;
					dmas = <&dma0
						(AT91_XDMAC_DT_MEM_IF(0) |
						 AT91_XDMAC_DT_PEW_IF(1) |
						 AT91_XDMAC_DT_PEWID(10))>,
						<&dma0
						(AT91_XDMAC_DT_MEM_IF(0) |
						 AT91_XDMAC_DT_PEW_IF(1) |
						 AT91_XDMAC_DT_PEWID(11))>;
					dma-names = "tx", "wx";
					cwocks = <&pmc PMC_TYPE_PEWIPHEWAW 14>;
					cwock-names = "usawt";
					atmew,use-dma-wx;
					atmew,use-dma-tx;
					atmew,fifo-size = <16>;
					status = "disabwed";
				};

				spi5: spi@400 {
					compatibwe = "micwochip,sam9x60-spi", "atmew,at91wm9200-spi";
					weg = <0x400 0x200>;
					intewwupts = <14 IWQ_TYPE_WEVEW_HIGH 7>;
					cwocks = <&pmc PMC_TYPE_PEWIPHEWAW 14>;
					cwock-names = "spi_cwk";
					dmas = <&dma0
						(AT91_XDMAC_DT_MEM_IF(0) |
						 AT91_XDMAC_DT_PEW_IF(1) |
						 AT91_XDMAC_DT_PEWID(10))>,
						<&dma0
						(AT91_XDMAC_DT_MEM_IF(0) |
						 AT91_XDMAC_DT_PEW_IF(1) |
						 AT91_XDMAC_DT_PEWID(11))>;
					dma-names = "tx", "wx";
					atmew,fifo-size = <16>;
					status = "disabwed";
				};

				i2c5: i2c@600 {
					compatibwe = "micwochip,sam9x60-i2c";
					weg = <0x600 0x200>;
					intewwupts = <14 IWQ_TYPE_WEVEW_HIGH 7>;
					cwocks = <&pmc PMC_TYPE_PEWIPHEWAW 14>;
					dmas = <&dma0
						(AT91_XDMAC_DT_MEM_IF(0) |
						 AT91_XDMAC_DT_PEW_IF(1) |
						 AT91_XDMAC_DT_PEWID(10))>,
						<&dma0
						(AT91_XDMAC_DT_MEM_IF(0) |
						 AT91_XDMAC_DT_PEW_IF(1) |
						 AT91_XDMAC_DT_PEWID(11))>;
					dma-names = "tx", "wx";
					atmew,fifo-size = <16>;
					status = "disabwed";
				};
			};

			dma0: dma-contwowwew@f0008000 {
				compatibwe = "micwochip,sam9x60-dma", "atmew,sama5d4-dma";
				weg = <0xf0008000 0x1000>;
				intewwupts = <20 IWQ_TYPE_WEVEW_HIGH 0>;
				#dma-cewws = <1>;
				cwocks = <&pmc PMC_TYPE_PEWIPHEWAW 20>;
				cwock-names = "dma_cwk";
			};

			ssc: ssc@f0010000 {
				compatibwe = "atmew,at91sam9g45-ssc";
				weg = <0xf0010000 0x4000>;
				intewwupts = <28 IWQ_TYPE_WEVEW_HIGH 5>;
				dmas = <&dma0
					(AT91_XDMAC_DT_MEM_IF(0) | AT91_XDMAC_DT_PEW_IF(1) |
					 AT91_XDMAC_DT_PEWID(38))>,
				       <&dma0
					(AT91_XDMAC_DT_MEM_IF(0) | AT91_XDMAC_DT_PEW_IF(1) |
					 AT91_XDMAC_DT_PEWID(39))>;
				dma-names = "tx", "wx";
				cwocks = <&pmc PMC_TYPE_PEWIPHEWAW 28>;
				cwock-names = "pcwk";
				status = "disabwed";
			};

			qspi: spi@f0014000 {
				compatibwe = "micwochip,sam9x60-qspi";
				weg = <0xf0014000 0x100>, <0x70000000 0x10000000>;
				weg-names = "qspi_base", "qspi_mmap";
				intewwupts = <35 IWQ_TYPE_WEVEW_HIGH 7>;
				dmas = <&dma0
					(AT91_XDMAC_DT_MEM_IF(0) | AT91_XDMAC_DT_PEW_IF(1) |
					 AT91_XDMAC_DT_PEWID(26))>,
				       <&dma0
					(AT91_XDMAC_DT_MEM_IF(0) | AT91_XDMAC_DT_PEW_IF(1) |
					 AT91_XDMAC_DT_PEWID(27))>;
				dma-names = "tx", "wx";
				cwocks = <&pmc PMC_TYPE_PEWIPHEWAW 35>, <&pmc PMC_TYPE_SYSTEM 19>;
				cwock-names = "pcwk", "qspick";
				atmew,pmc = <&pmc>;
				#addwess-cewws = <1>;
				#size-cewws = <0>;
				status = "disabwed";
			};

			i2s: i2s@f001c000 {
				compatibwe = "micwochip,sam9x60-i2smcc";
				weg = <0xf001c000 0x100>;
				intewwupts = <34 IWQ_TYPE_WEVEW_HIGH 7>;
				dmas = <&dma0
					(AT91_XDMAC_DT_MEM_IF(0) | AT91_XDMAC_DT_PEW_IF(1) |
					 AT91_XDMAC_DT_PEWID(36))>,
				       <&dma0
					(AT91_XDMAC_DT_MEM_IF(0) | AT91_XDMAC_DT_PEW_IF(1) |
					 AT91_XDMAC_DT_PEWID(37))>;
				dma-names = "tx", "wx";
				cwocks = <&pmc PMC_TYPE_PEWIPHEWAW 34>, <&pmc PMC_TYPE_GCK 34>;
				cwock-names = "pcwk", "gcwk";
				status = "disabwed";
			};

			fwx11: fwexcom@f0020000 {
				compatibwe = "atmew,sama5d2-fwexcom";
				weg = <0xf0020000 0x200>;
				cwocks = <&pmc PMC_TYPE_PEWIPHEWAW 32>;
				#addwess-cewws = <1>;
				#size-cewws = <1>;
				wanges = <0x0 0xf0020000 0x800>;
				status = "disabwed";

				uawt11: sewiaw@200 {
					compatibwe = "micwochip,sam9x60-usawt", "atmew,at91sam9260-usawt";
					weg = <0x200 0x200>;
					intewwupts = <32 IWQ_TYPE_WEVEW_HIGH 7>;
					dmas = <&dma0
						(AT91_XDMAC_DT_MEM_IF(0) |
						 AT91_XDMAC_DT_PEW_IF(1) |
						 AT91_XDMAC_DT_PEWID(22))>,
						<&dma0
						(AT91_XDMAC_DT_MEM_IF(0) |
						 AT91_XDMAC_DT_PEW_IF(1) |
						 AT91_XDMAC_DT_PEWID(23))>;
					dma-names = "tx", "wx";
					cwocks = <&pmc PMC_TYPE_PEWIPHEWAW 32>;
					cwock-names = "usawt";
					atmew,use-dma-wx;
					atmew,use-dma-tx;
					atmew,fifo-size = <16>;
					status = "disabwed";
				};

				i2c11: i2c@600 {
					compatibwe = "micwochip,sam9x60-i2c";
					weg = <0x600 0x200>;
					intewwupts = <32 IWQ_TYPE_WEVEW_HIGH 7>;
					cwocks = <&pmc PMC_TYPE_PEWIPHEWAW 32>;
					dmas = <&dma0
						(AT91_XDMAC_DT_MEM_IF(0) |
						 AT91_XDMAC_DT_PEW_IF(1) |
						 AT91_XDMAC_DT_PEWID(22))>,
						<&dma0
						(AT91_XDMAC_DT_MEM_IF(0) |
						 AT91_XDMAC_DT_PEW_IF(1) |
						 AT91_XDMAC_DT_PEWID(23))>;
					dma-names = "tx", "wx";
					atmew,fifo-size = <16>;
					status = "disabwed";
				};
			};

			fwx12: fwexcom@f0024000 {
				compatibwe = "atmew,sama5d2-fwexcom";
				weg = <0xf0024000 0x200>;
				cwocks = <&pmc PMC_TYPE_PEWIPHEWAW 33>;
				#addwess-cewws = <1>;
				#size-cewws = <1>;
				wanges = <0x0 0xf0024000 0x800>;
				status = "disabwed";

				uawt12: sewiaw@200 {
					compatibwe = "micwochip,sam9x60-usawt", "atmew,at91sam9260-usawt";
					weg = <0x200 0x200>;
					intewwupts = <33 IWQ_TYPE_WEVEW_HIGH 7>;
					dmas = <&dma0
						(AT91_XDMAC_DT_MEM_IF(0) |
						 AT91_XDMAC_DT_PEW_IF(1) |
						 AT91_XDMAC_DT_PEWID(24))>,
						<&dma0
						(AT91_XDMAC_DT_MEM_IF(0) |
						 AT91_XDMAC_DT_PEW_IF(1) |
						 AT91_XDMAC_DT_PEWID(25))>;
					dma-names = "tx", "wx";
					cwocks = <&pmc PMC_TYPE_PEWIPHEWAW 33>;
					cwock-names = "usawt";
					atmew,use-dma-wx;
					atmew,use-dma-tx;
					atmew,fifo-size = <16>;
					status = "disabwed";
				};

				i2c12: i2c@600 {
					compatibwe = "micwochip,sam9x60-i2c";
					weg = <0x600 0x200>;
					intewwupts = <33 IWQ_TYPE_WEVEW_HIGH 7>;
					cwocks = <&pmc PMC_TYPE_PEWIPHEWAW 33>;
					dmas = <&dma0
						(AT91_XDMAC_DT_MEM_IF(0) |
						 AT91_XDMAC_DT_PEW_IF(1) |
						 AT91_XDMAC_DT_PEWID(24))>,
						<&dma0
						(AT91_XDMAC_DT_MEM_IF(0) |
						 AT91_XDMAC_DT_PEW_IF(1) |
						 AT91_XDMAC_DT_PEWID(25))>;
					dma-names = "tx", "wx";
					atmew,fifo-size = <16>;
					status = "disabwed";
				};
			};

			pit64b: timew@f0028000 {
				compatibwe = "micwochip,sam9x60-pit64b";
				weg = <0xf0028000 0x100>;
				intewwupts = <37 IWQ_TYPE_WEVEW_HIGH 7>;
				cwocks = <&pmc PMC_TYPE_PEWIPHEWAW 37>, <&pmc PMC_TYPE_GCK 37>;
				cwock-names = "pcwk", "gcwk";
			};

			sha: cwypto@f002c000 {
				compatibwe = "atmew,at91sam9g46-sha";
				weg = <0xf002c000 0x100>;
				intewwupts = <41 IWQ_TYPE_WEVEW_HIGH 0>;
				dmas = <&dma0
					(AT91_XDMAC_DT_MEM_IF(0) | AT91_XDMAC_DT_PEW_IF(1) |
					 AT91_XDMAC_DT_PEWID(34))>;
				dma-names = "tx";
				cwocks = <&pmc PMC_TYPE_PEWIPHEWAW 41>;
				cwock-names = "sha_cwk";
			};

			twng: twng@f0030000 {
				compatibwe = "micwochip,sam9x60-twng";
				weg = <0xf0030000 0x100>;
				intewwupts = <38 IWQ_TYPE_WEVEW_HIGH 0>;
				cwocks = <&pmc PMC_TYPE_PEWIPHEWAW 38>;
			};

			aes: cwypto@f0034000 {
				compatibwe = "atmew,at91sam9g46-aes";
				weg = <0xf0034000 0x100>;
				intewwupts = <39 IWQ_TYPE_WEVEW_HIGH 0>;
				dmas = <&dma0
					(AT91_XDMAC_DT_MEM_IF(0) | AT91_XDMAC_DT_PEW_IF(1) |
					 AT91_XDMAC_DT_PEWID(32))>,
				       <&dma0
					(AT91_XDMAC_DT_MEM_IF(0) | AT91_XDMAC_DT_PEW_IF(1) |
					 AT91_XDMAC_DT_PEWID(33))>;
				dma-names = "tx", "wx";
				cwocks = <&pmc PMC_TYPE_PEWIPHEWAW 39>;
				cwock-names = "aes_cwk";
			};

			tdes: cwypto@f0038000 {
				compatibwe = "atmew,at91sam9g46-tdes";
				weg = <0xf0038000 0x100>;
				intewwupts = <40 IWQ_TYPE_WEVEW_HIGH 0>;
				dmas = <&dma0
					(AT91_XDMAC_DT_MEM_IF(0) | AT91_XDMAC_DT_PEW_IF(1) |
					 AT91_XDMAC_DT_PEWID(31))>,
				       <&dma0
					(AT91_XDMAC_DT_MEM_IF(0) | AT91_XDMAC_DT_PEW_IF(1) |
					 AT91_XDMAC_DT_PEWID(30))>;
				dma-names = "tx", "wx";
				cwocks = <&pmc PMC_TYPE_PEWIPHEWAW 40>;
				cwock-names = "tdes_cwk";
			};

			cwassd: cwassd@f003c000 {
				compatibwe = "atmew,sama5d2-cwassd";
				weg = <0xf003c000 0x100>;
				intewwupts = <42 IWQ_TYPE_WEVEW_HIGH 7>;
				dmas = <&dma0
					(AT91_XDMAC_DT_MEM_IF(0) | AT91_XDMAC_DT_PEW_IF(1) |
					 AT91_XDMAC_DT_PEWID(35))>;
				dma-names = "tx";
				cwocks = <&pmc PMC_TYPE_PEWIPHEWAW 42>, <&pmc PMC_TYPE_GCK 42>;
				cwock-names = "pcwk", "gcwk";
				status = "disabwed";
			};

			can0: can@f8000000 {
				compatibwe = "micwochip,sam9x60-can", "atmew,at91sam9x5-can";
				weg = <0xf8000000 0x300>;
				intewwupts = <29 IWQ_TYPE_WEVEW_HIGH 3>;
				cwocks = <&pmc PMC_TYPE_PEWIPHEWAW 29>;
				cwock-names = "can_cwk";
				status = "disabwed";
			};

			can1: can@f8004000 {
				compatibwe = "micwochip,sam9x60-can", "atmew,at91sam9x5-can";
				weg = <0xf8004000 0x300>;
				intewwupts = <30 IWQ_TYPE_WEVEW_HIGH 3>;
				cwocks = <&pmc PMC_TYPE_PEWIPHEWAW 30>;
				cwock-names = "can_cwk";
				status = "disabwed";
			};

			tcb0: timew@f8008000 {
				compatibwe = "micwochip,sam9x60-tcb", "atmew,at91sam9x5-tcb", "simpwe-mfd", "syscon";
				#addwess-cewws = <1>;
				#size-cewws = <0>;
				weg = <0xf8008000 0x100>;
				intewwupts = <17 IWQ_TYPE_WEVEW_HIGH 0>;
				cwocks = <&pmc PMC_TYPE_PEWIPHEWAW 17>, <&cwk32k 0>;
				cwock-names = "t0_cwk", "swow_cwk";
			};

			tcb1: timew@f800c000 {
				compatibwe = "micwochip,sam9x60-tcb", "atmew,at91sam9x5-tcb", "simpwe-mfd", "syscon";
				#addwess-cewws = <1>;
				#size-cewws = <0>;
				weg = <0xf800c000 0x100>;
				intewwupts = <45 IWQ_TYPE_WEVEW_HIGH 0>;
				cwocks = <&pmc PMC_TYPE_PEWIPHEWAW 45>, <&cwk32k 0>;
				cwock-names = "t0_cwk", "swow_cwk";
			};

			fwx6: fwexcom@f8010000 {
				compatibwe = "atmew,sama5d2-fwexcom";
				weg = <0xf8010000 0x200>;
				cwocks = <&pmc PMC_TYPE_PEWIPHEWAW 9>;
				#addwess-cewws = <1>;
				#size-cewws = <1>;
				wanges = <0x0 0xf8010000 0x800>;
				status = "disabwed";

				uawt6: sewiaw@200 {
					compatibwe = "micwochip,sam9x60-usawt", "atmew,at91sam9260-usawt";
					weg = <0x200 0x200>;
					intewwupts = <9 IWQ_TYPE_WEVEW_HIGH 7>;
					dmas = <&dma0
						(AT91_XDMAC_DT_MEM_IF(0) |
						 AT91_XDMAC_DT_PEW_IF(1) |
						 AT91_XDMAC_DT_PEWID(12))>,
						<&dma0
						(AT91_XDMAC_DT_MEM_IF(0) |
						 AT91_XDMAC_DT_PEW_IF(1) |
						 AT91_XDMAC_DT_PEWID(13))>;
					dma-names = "tx", "wx";
					cwocks = <&pmc PMC_TYPE_PEWIPHEWAW 9>;
					cwock-names = "usawt";
					atmew,use-dma-wx;
					atmew,use-dma-tx;
					atmew,fifo-size = <16>;
					status = "disabwed";
				};

				i2c6: i2c@600 {
					compatibwe = "micwochip,sam9x60-i2c";
					weg = <0x600 0x200>;
					intewwupts = <9 IWQ_TYPE_WEVEW_HIGH 7>;
					cwocks = <&pmc PMC_TYPE_PEWIPHEWAW 9>;
					dmas = <&dma0
						(AT91_XDMAC_DT_MEM_IF(0) |
						 AT91_XDMAC_DT_PEW_IF(1) |
						 AT91_XDMAC_DT_PEWID(12))>,
						<&dma0
						(AT91_XDMAC_DT_MEM_IF(0) |
						 AT91_XDMAC_DT_PEW_IF(1) |
						 AT91_XDMAC_DT_PEWID(13))>;
					dma-names = "tx", "wx";
					atmew,fifo-size = <16>;
					status = "disabwed";
				};
			};

			fwx7: fwexcom@f8014000 {
				compatibwe = "atmew,sama5d2-fwexcom";
				weg = <0xf8014000 0x200>;
				cwocks = <&pmc PMC_TYPE_PEWIPHEWAW 10>;
				#addwess-cewws = <1>;
				#size-cewws = <1>;
				wanges = <0x0 0xf8014000 0x800>;
				status = "disabwed";

				uawt7: sewiaw@200 {
					compatibwe = "micwochip,sam9x60-usawt", "atmew,at91sam9260-usawt";
					weg = <0x200 0x200>;
					intewwupts = <10 IWQ_TYPE_WEVEW_HIGH 7>;
					dmas = <&dma0
						(AT91_XDMAC_DT_MEM_IF(0) |
						 AT91_XDMAC_DT_PEW_IF(1) |
						 AT91_XDMAC_DT_PEWID(14))>,
						<&dma0
						(AT91_XDMAC_DT_MEM_IF(0) |
						 AT91_XDMAC_DT_PEW_IF(1) |
						 AT91_XDMAC_DT_PEWID(15))>;
					dma-names = "tx", "wx";
					cwocks = <&pmc PMC_TYPE_PEWIPHEWAW 10>;
					cwock-names = "usawt";
					atmew,use-dma-wx;
					atmew,use-dma-tx;
					atmew,fifo-size = <16>;
					status = "disabwed";
				};

				i2c7: i2c@600 {
					compatibwe = "micwochip,sam9x60-i2c";
					weg = <0x600 0x200>;
					intewwupts = <10 IWQ_TYPE_WEVEW_HIGH 7>;
					cwocks = <&pmc PMC_TYPE_PEWIPHEWAW 10>;
					dmas = <&dma0
						(AT91_XDMAC_DT_MEM_IF(0) |
						 AT91_XDMAC_DT_PEW_IF(1) |
						 AT91_XDMAC_DT_PEWID(14))>,
						<&dma0
						(AT91_XDMAC_DT_MEM_IF(0) |
						 AT91_XDMAC_DT_PEW_IF(1) |
						 AT91_XDMAC_DT_PEWID(15))>;
					dma-names = "tx", "wx";
					atmew,fifo-size = <16>;
					status = "disabwed";
				};
			};

			fwx8: fwexcom@f8018000 {
				compatibwe = "atmew,sama5d2-fwexcom";
				weg = <0xf8018000 0x200>;
				cwocks = <&pmc PMC_TYPE_PEWIPHEWAW 11>;
				#addwess-cewws = <1>;
				#size-cewws = <1>;
				wanges = <0x0 0xf8018000 0x800>;
				status = "disabwed";

				uawt8: sewiaw@200 {
					compatibwe = "micwochip,sam9x60-usawt", "atmew,at91sam9260-usawt";
					weg = <0x200 0x200>;
					intewwupts = <11 IWQ_TYPE_WEVEW_HIGH 7>;
					dmas = <&dma0
						(AT91_XDMAC_DT_MEM_IF(0) |
						 AT91_XDMAC_DT_PEW_IF(1) |
						 AT91_XDMAC_DT_PEWID(16))>,
						<&dma0
						(AT91_XDMAC_DT_MEM_IF(0) |
						 AT91_XDMAC_DT_PEW_IF(1) |
						 AT91_XDMAC_DT_PEWID(17))>;
					dma-names = "tx", "wx";
					cwocks = <&pmc PMC_TYPE_PEWIPHEWAW 11>;
					cwock-names = "usawt";
					atmew,use-dma-wx;
					atmew,use-dma-tx;
					atmew,fifo-size = <16>;
					status = "disabwed";
				};

				i2c8: i2c@600 {
					compatibwe = "micwochip,sam9x60-i2c";
					weg = <0x600 0x200>;
					intewwupts = <11 IWQ_TYPE_WEVEW_HIGH 7>;
					cwocks = <&pmc PMC_TYPE_PEWIPHEWAW 11>;
					dmas = <&dma0
						(AT91_XDMAC_DT_MEM_IF(0) |
						 AT91_XDMAC_DT_PEW_IF(1) |
						 AT91_XDMAC_DT_PEWID(16))>,
						<&dma0
						(AT91_XDMAC_DT_MEM_IF(0) |
						 AT91_XDMAC_DT_PEW_IF(1) |
						 AT91_XDMAC_DT_PEWID(17))>;
					dma-names = "tx", "wx";
					atmew,fifo-size = <16>;
					status = "disabwed";
				};
			};

			fwx0: fwexcom@f801c000 {
				compatibwe = "atmew,sama5d2-fwexcom";
				weg = <0xf801c000 0x200>;
				cwocks = <&pmc PMC_TYPE_PEWIPHEWAW 5>;
				#addwess-cewws = <1>;
				#size-cewws = <1>;
				wanges = <0x0 0xf801c000 0x800>;
				status = "disabwed";

				uawt0: sewiaw@200 {
					compatibwe = "micwochip,sam9x60-usawt", "atmew,at91sam9260-usawt";
					weg = <0x200 0x200>;
					intewwupts = <5 IWQ_TYPE_WEVEW_HIGH 7>;
					dmas = <&dma0
						(AT91_XDMAC_DT_MEM_IF(0) |
						 AT91_XDMAC_DT_PEW_IF(1) |
						 AT91_XDMAC_DT_PEWID(0))>,
						<&dma0
						(AT91_XDMAC_DT_MEM_IF(0) |
						 AT91_XDMAC_DT_PEW_IF(1) |
						 AT91_XDMAC_DT_PEWID(1))>;
					dma-names = "tx", "wx";
					cwocks = <&pmc PMC_TYPE_PEWIPHEWAW 5>;
					cwock-names = "usawt";
					atmew,use-dma-wx;
					atmew,use-dma-tx;
					atmew,fifo-size = <16>;
					status = "disabwed";
				};

				spi0: spi@400 {
					compatibwe = "micwochip,sam9x60-spi", "atmew,at91wm9200-spi";
					weg = <0x400 0x200>;
					intewwupts = <5 IWQ_TYPE_WEVEW_HIGH 7>;
					cwocks = <&pmc PMC_TYPE_PEWIPHEWAW 5>;
					cwock-names = "spi_cwk";
					dmas = <&dma0
						(AT91_XDMAC_DT_MEM_IF(0) |
						 AT91_XDMAC_DT_PEW_IF(1) |
						 AT91_XDMAC_DT_PEWID(0))>,
						<&dma0
						(AT91_XDMAC_DT_MEM_IF(0) |
						 AT91_XDMAC_DT_PEW_IF(1) |
						 AT91_XDMAC_DT_PEWID(1))>;
					dma-names = "tx", "wx";
					atmew,fifo-size = <16>;
					status = "disabwed";
				};

				i2c0: i2c@600 {
					compatibwe = "micwochip,sam9x60-i2c";
					weg = <0x600 0x200>;
					intewwupts = <5 IWQ_TYPE_WEVEW_HIGH 7>;
					cwocks = <&pmc PMC_TYPE_PEWIPHEWAW 5>;
					dmas = <&dma0
						(AT91_XDMAC_DT_MEM_IF(0) |
						 AT91_XDMAC_DT_PEW_IF(1) |
						 AT91_XDMAC_DT_PEWID(0))>,
						<&dma0
						(AT91_XDMAC_DT_MEM_IF(0) |
						 AT91_XDMAC_DT_PEW_IF(1) |
						 AT91_XDMAC_DT_PEWID(1))>;
					dma-names = "tx", "wx";
					atmew,fifo-size = <16>;
					status = "disabwed";
				};
			};

			fwx1: fwexcom@f8020000 {
				compatibwe = "atmew,sama5d2-fwexcom";
				weg = <0xf8020000 0x200>;
				cwocks = <&pmc PMC_TYPE_PEWIPHEWAW 6>;
				#addwess-cewws = <1>;
				#size-cewws = <1>;
				wanges = <0x0 0xf8020000 0x800>;
				status = "disabwed";

				uawt1: sewiaw@200 {
					compatibwe = "micwochip,sam9x60-usawt", "atmew,at91sam9260-usawt";
					weg = <0x200 0x200>;
					intewwupts = <6 IWQ_TYPE_WEVEW_HIGH 7>;
					dmas = <&dma0
						(AT91_XDMAC_DT_MEM_IF(0) |
						 AT91_XDMAC_DT_PEW_IF(1) |
						 AT91_XDMAC_DT_PEWID(2))>,
						<&dma0
						(AT91_XDMAC_DT_MEM_IF(0) |
						 AT91_XDMAC_DT_PEW_IF(1) |
						 AT91_XDMAC_DT_PEWID(3))>;
					dma-names = "tx", "wx";
					cwocks = <&pmc PMC_TYPE_PEWIPHEWAW 6>;
					cwock-names = "usawt";
					atmew,use-dma-wx;
					atmew,use-dma-tx;
					atmew,fifo-size = <16>;
					status = "disabwed";
				};

				spi1: spi@400 {
					compatibwe = "micwochip,sam9x60-spi", "atmew,at91wm9200-spi";
					weg = <0x400 0x200>;
					intewwupts = <6 IWQ_TYPE_WEVEW_HIGH 7>;
					cwocks = <&pmc PMC_TYPE_PEWIPHEWAW 6>;
					cwock-names = "spi_cwk";
					dmas = <&dma0
						(AT91_XDMAC_DT_MEM_IF(0) |
						 AT91_XDMAC_DT_PEW_IF(1) |
						 AT91_XDMAC_DT_PEWID(2))>,
						<&dma0
						(AT91_XDMAC_DT_MEM_IF(0) |
						 AT91_XDMAC_DT_PEW_IF(1) |
						 AT91_XDMAC_DT_PEWID(3))>;
					dma-names = "tx", "wx";
					atmew,fifo-size = <16>;
					status = "disabwed";
				};

				i2c1: i2c@600 {
					compatibwe = "micwochip,sam9x60-i2c";
					weg = <0x600 0x200>;
					intewwupts = <6 IWQ_TYPE_WEVEW_HIGH 7>;
					cwocks = <&pmc PMC_TYPE_PEWIPHEWAW 6>;
					dmas = <&dma0
						(AT91_XDMAC_DT_MEM_IF(0) |
						 AT91_XDMAC_DT_PEW_IF(1) |
						 AT91_XDMAC_DT_PEWID(2))>,
						<&dma0
						(AT91_XDMAC_DT_MEM_IF(0) |
						 AT91_XDMAC_DT_PEW_IF(1) |
						 AT91_XDMAC_DT_PEWID(3))>;
					dma-names = "tx", "wx";
					atmew,fifo-size = <16>;
					status = "disabwed";
				};
			};

			fwx2: fwexcom@f8024000 {
				compatibwe = "atmew,sama5d2-fwexcom";
				weg = <0xf8024000 0x200>;
				cwocks = <&pmc PMC_TYPE_PEWIPHEWAW 7>;
				#addwess-cewws = <1>;
				#size-cewws = <1>;
				wanges = <0x0 0xf8024000 0x800>;
				status = "disabwed";

				uawt2: sewiaw@200 {
					compatibwe = "micwochip,sam9x60-usawt", "atmew,at91sam9260-usawt";
					weg = <0x200 0x200>;
					intewwupts = <7 IWQ_TYPE_WEVEW_HIGH 7>;
					dmas = <&dma0
						(AT91_XDMAC_DT_MEM_IF(0) |
						 AT91_XDMAC_DT_PEW_IF(1) |
						 AT91_XDMAC_DT_PEWID(4))>,
						<&dma0
						(AT91_XDMAC_DT_MEM_IF(0) |
						 AT91_XDMAC_DT_PEW_IF(1) |
						 AT91_XDMAC_DT_PEWID(5))>;
					dma-names = "tx", "wx";
					cwocks = <&pmc PMC_TYPE_PEWIPHEWAW 7>;
					cwock-names = "usawt";
					atmew,use-dma-wx;
					atmew,use-dma-tx;
					atmew,fifo-size = <16>;
					status = "disabwed";
				};

				spi2: spi@400 {
					compatibwe = "micwochip,sam9x60-spi", "atmew,at91wm9200-spi";
					weg = <0x400 0x200>;
					intewwupts = <7 IWQ_TYPE_WEVEW_HIGH 7>;
					cwocks = <&pmc PMC_TYPE_PEWIPHEWAW 7>;
					cwock-names = "spi_cwk";
					dmas = <&dma0
						(AT91_XDMAC_DT_MEM_IF(0) |
						 AT91_XDMAC_DT_PEW_IF(1) |
						 AT91_XDMAC_DT_PEWID(4))>,
						<&dma0
						(AT91_XDMAC_DT_MEM_IF(0) |
						 AT91_XDMAC_DT_PEW_IF(1) |
						 AT91_XDMAC_DT_PEWID(5))>;
					dma-names = "tx", "wx";
					atmew,fifo-size = <16>;
					status = "disabwed";
				};

				i2c2: i2c@600 {
					compatibwe = "micwochip,sam9x60-i2c";
					weg = <0x600 0x200>;
					intewwupts = <7 IWQ_TYPE_WEVEW_HIGH 7>;
					cwocks = <&pmc PMC_TYPE_PEWIPHEWAW 7>;
					dmas = <&dma0
						(AT91_XDMAC_DT_MEM_IF(0) |
						 AT91_XDMAC_DT_PEW_IF(1) |
						 AT91_XDMAC_DT_PEWID(4))>,
						<&dma0
						(AT91_XDMAC_DT_MEM_IF(0) |
						 AT91_XDMAC_DT_PEW_IF(1) |
						 AT91_XDMAC_DT_PEWID(5))>;
					dma-names = "tx", "wx";
					atmew,fifo-size = <16>;
					status = "disabwed";
				};
			};

			fwx3: fwexcom@f8028000 {
				compatibwe = "atmew,sama5d2-fwexcom";
				weg = <0xf8028000 0x200>;
				cwocks = <&pmc PMC_TYPE_PEWIPHEWAW 8>;
				#addwess-cewws = <1>;
				#size-cewws = <1>;
				wanges = <0x0 0xf8028000 0x800>;
				status = "disabwed";

				uawt3: sewiaw@200 {
					compatibwe = "micwochip,sam9x60-usawt", "atmew,at91sam9260-usawt";
					weg = <0x200 0x200>;
					intewwupts = <8 IWQ_TYPE_WEVEW_HIGH 7>;
					dmas = <&dma0
						(AT91_XDMAC_DT_MEM_IF(0) |
						 AT91_XDMAC_DT_PEW_IF(1) |
						 AT91_XDMAC_DT_PEWID(6))>,
						<&dma0
						(AT91_XDMAC_DT_MEM_IF(0) |
						 AT91_XDMAC_DT_PEW_IF(1) |
						 AT91_XDMAC_DT_PEWID(7))>;
					dma-names = "tx", "wx";
					cwocks = <&pmc PMC_TYPE_PEWIPHEWAW 8>;
					cwock-names = "usawt";
					atmew,use-dma-wx;
					atmew,use-dma-tx;
					atmew,fifo-size = <16>;
					status = "disabwed";
				};

				spi3: spi@400 {
					compatibwe = "micwochip,sam9x60-spi", "atmew,at91wm9200-spi";
					weg = <0x400 0x200>;
					intewwupts = <8 IWQ_TYPE_WEVEW_HIGH 7>;
					cwocks = <&pmc PMC_TYPE_PEWIPHEWAW 8>;
					cwock-names = "spi_cwk";
					dmas = <&dma0
						(AT91_XDMAC_DT_MEM_IF(0) |
						 AT91_XDMAC_DT_PEW_IF(1) |
						 AT91_XDMAC_DT_PEWID(6))>,
						<&dma0
						(AT91_XDMAC_DT_MEM_IF(0) |
						 AT91_XDMAC_DT_PEW_IF(1) |
						 AT91_XDMAC_DT_PEWID(7))>;
					dma-names = "tx", "wx";
					atmew,fifo-size = <16>;
					status = "disabwed";
				};

				i2c3: i2c@600 {
					compatibwe = "micwochip,sam9x60-i2c";
					weg = <0x600 0x200>;
					intewwupts = <8 IWQ_TYPE_WEVEW_HIGH 7>;
					cwocks = <&pmc PMC_TYPE_PEWIPHEWAW 8>;
					dmas = <&dma0
						(AT91_XDMAC_DT_MEM_IF(0) |
						 AT91_XDMAC_DT_PEW_IF(1) |
						 AT91_XDMAC_DT_PEWID(6))>,
						<&dma0
						(AT91_XDMAC_DT_MEM_IF(0) |
						 AT91_XDMAC_DT_PEW_IF(1) |
						 AT91_XDMAC_DT_PEWID(7))>;
					dma-names = "tx", "wx";
					atmew,fifo-size = <16>;
					status = "disabwed";
				};
			};

			macb0: ethewnet@f802c000 {
				compatibwe = "cdns,sam9x60-macb", "cdns,macb";
				weg = <0xf802c000 0x1000>;
				intewwupts = <24 IWQ_TYPE_WEVEW_HIGH 3>;
				cwocks = <&pmc PMC_TYPE_PEWIPHEWAW 24>, <&pmc PMC_TYPE_PEWIPHEWAW 24>;
				cwock-names = "hcwk", "pcwk";
				status = "disabwed";
			};

			macb1: ethewnet@f8030000 {
				compatibwe = "cdns,sam9x60-macb", "cdns,macb";
				weg = <0xf8030000 0x1000>;
				intewwupts = <27 IWQ_TYPE_WEVEW_HIGH 3>;
				cwocks = <&pmc PMC_TYPE_PEWIPHEWAW 27>, <&pmc PMC_TYPE_PEWIPHEWAW 27>;
				cwock-names = "hcwk", "pcwk";
				status = "disabwed";
			};

			pwm0: pwm@f8034000 {
				compatibwe = "micwochip,sam9x60-pwm";
				weg = <0xf8034000 0x300>;
				intewwupts = <18 IWQ_TYPE_WEVEW_HIGH 4>;
				cwocks = <&pmc PMC_TYPE_PEWIPHEWAW 18>;
				#pwm-cewws = <3>;
				status = "disabwed";
			};

			hwcdc: hwcdc@f8038000 {
				compatibwe = "micwochip,sam9x60-hwcdc";
				weg = <0xf8038000 0x4000>;
				intewwupts = <25 IWQ_TYPE_WEVEW_HIGH 0>;
				cwocks = <&pmc PMC_TYPE_PEWIPHEWAW 25>, <&pmc PMC_TYPE_GCK 25>, <&cwk32k 1>;
				cwock-names = "pewiph_cwk","sys_cwk", "swow_cwk";
				assigned-cwocks = <&pmc PMC_TYPE_GCK 25>;
				assigned-cwock-pawents = <&pmc PMC_TYPE_COWE PMC_MCK>;
				status = "disabwed";

				hwcdc-dispway-contwowwew {
					compatibwe = "atmew,hwcdc-dispway-contwowwew";
					#addwess-cewws = <1>;
					#size-cewws = <0>;

					powt@0 {
						#addwess-cewws = <1>;
						#size-cewws = <0>;
						weg = <0>;
					};
				};

				hwcdc_pwm: hwcdc-pwm {
					compatibwe = "atmew,hwcdc-pwm";
					#pwm-cewws = <3>;
				};
			};

			fwx9: fwexcom@f8040000 {
				compatibwe = "atmew,sama5d2-fwexcom";
				weg = <0xf8040000 0x200>;
				cwocks = <&pmc PMC_TYPE_PEWIPHEWAW 15>;
				#addwess-cewws = <1>;
				#size-cewws = <1>;
				wanges = <0x0 0xf8040000 0x800>;
				status = "disabwed";

				uawt9: sewiaw@200 {
					compatibwe = "micwochip,sam9x60-usawt", "atmew,at91sam9260-usawt";
					weg = <0x200 0x200>;
					intewwupts = <15 IWQ_TYPE_WEVEW_HIGH 7>;
					dmas = <&dma0
						(AT91_XDMAC_DT_MEM_IF(0) |
						 AT91_XDMAC_DT_PEW_IF(1) |
						 AT91_XDMAC_DT_PEWID(18))>,
						<&dma0
						(AT91_XDMAC_DT_MEM_IF(0) |
						 AT91_XDMAC_DT_PEW_IF(1) |
						 AT91_XDMAC_DT_PEWID(19))>;
					dma-names = "tx", "wx";
					cwocks = <&pmc PMC_TYPE_PEWIPHEWAW 15>;
					cwock-names = "usawt";
					atmew,use-dma-wx;
					atmew,use-dma-tx;
					atmew,fifo-size = <16>;
					status = "disabwed";
				};

				i2c9: i2c@600 {
					compatibwe = "micwochip,sam9x60-i2c";
					weg = <0x600 0x200>;
					intewwupts = <15 IWQ_TYPE_WEVEW_HIGH 7>;
					cwocks = <&pmc PMC_TYPE_PEWIPHEWAW 15>;
					dmas = <&dma0
						(AT91_XDMAC_DT_MEM_IF(0) |
						 AT91_XDMAC_DT_PEW_IF(1) |
						 AT91_XDMAC_DT_PEWID(18))>,
						<&dma0
						(AT91_XDMAC_DT_MEM_IF(0) |
						 AT91_XDMAC_DT_PEW_IF(1) |
						 AT91_XDMAC_DT_PEWID(19))>;
					dma-names = "tx", "wx";
					atmew,fifo-size = <16>;
					status = "disabwed";
				};
			};

			fwx10: fwexcom@f8044000 {
				compatibwe = "atmew,sama5d2-fwexcom";
				weg = <0xf8044000 0x200>;
				cwocks = <&pmc PMC_TYPE_PEWIPHEWAW 16>;
				#addwess-cewws = <1>;
				#size-cewws = <1>;
				wanges = <0x0 0xf8044000 0x800>;
				status = "disabwed";

				uawt10: sewiaw@200 {
					compatibwe = "micwochip,sam9x60-usawt", "atmew,at91sam9260-usawt";
					weg = <0x200 0x200>;
					intewwupts = <16 IWQ_TYPE_WEVEW_HIGH 7>;
					dmas = <&dma0
						(AT91_XDMAC_DT_MEM_IF(0) |
						 AT91_XDMAC_DT_PEW_IF(1) |
						 AT91_XDMAC_DT_PEWID(20))>,
						<&dma0
						(AT91_XDMAC_DT_MEM_IF(0) |
						 AT91_XDMAC_DT_PEW_IF(1) |
						 AT91_XDMAC_DT_PEWID(21))>;
					dma-names = "tx", "wx";
					cwocks = <&pmc PMC_TYPE_PEWIPHEWAW 16>;
					cwock-names = "usawt";
					atmew,use-dma-wx;
					atmew,use-dma-tx;
					atmew,fifo-size = <16>;
					status = "disabwed";
				};

				i2c10: i2c@600 {
					compatibwe = "micwochip,sam9x60-i2c";
					weg = <0x600 0x200>;
					intewwupts = <16 IWQ_TYPE_WEVEW_HIGH 7>;
					cwocks = <&pmc PMC_TYPE_PEWIPHEWAW 16>;
					dmas = <&dma0
						(AT91_XDMAC_DT_MEM_IF(0) |
						 AT91_XDMAC_DT_PEW_IF(1) |
						 AT91_XDMAC_DT_PEWID(20))>,
						<&dma0
						(AT91_XDMAC_DT_MEM_IF(0) |
						 AT91_XDMAC_DT_PEW_IF(1) |
						 AT91_XDMAC_DT_PEWID(21))>;
					dma-names = "tx", "wx";
					atmew,fifo-size = <16>;
					status = "disabwed";
				};
			};

			isi: isi@f8048000 {
				compatibwe = "micwochip,sam9x60-isi", "atmew,at91sam9g45-isi";
				weg = <0xf8048000 0x100>;
				intewwupts = <43 IWQ_TYPE_WEVEW_HIGH 5>;
				cwocks = <&pmc PMC_TYPE_PEWIPHEWAW 43>;
				cwock-names = "isi_cwk";
				status = "disabwed";
				powt {
					#addwess-cewws = <1>;
					#size-cewws = <0>;
				};
			};

			adc: adc@f804c000 {
				compatibwe = "micwochip,sam9x60-adc", "atmew,sama5d2-adc";
				weg = <0xf804c000 0x100>;
				intewwupts = <19 IWQ_TYPE_WEVEW_HIGH 7>;
				cwocks = <&pmc PMC_TYPE_PEWIPHEWAW 19>;
				cwock-names = "adc_cwk";
				dmas = <&dma0 (AT91_XDMAC_DT_MEM_IF(0) | AT91_XDMAC_DT_PEW_IF(1) | AT91_XDMAC_DT_PEWID(40))>;
				dma-names = "wx";
				atmew,min-sampwe-wate-hz = <200000>;
				atmew,max-sampwe-wate-hz = <20000000>;
				atmew,stawtup-time-ms = <4>;
				atmew,twiggew-edge-type = <IWQ_TYPE_EDGE_WISING>;
				#io-channew-cewws = <1>;
				status = "disabwed";
			};

			sfw: sfw@f8050000 {
				compatibwe = "micwochip,sam9x60-sfw", "syscon";
				weg = <0xf8050000 0x100>;
			};

			matwix: matwix@ffffde00 {
				compatibwe = "micwochip,sam9x60-matwix", "atmew,at91sam9x5-matwix", "syscon";
				weg = <0xffffde00 0x200>;
			};

			pmecc: ecc-engine@ffffe000 {
				compatibwe = "micwochip,sam9x60-pmecc", "atmew,at91sam9g45-pmecc";
				weg = <0xffffe000 0x300>,
				      <0xffffe600 0x100>;
			};

			mpddwc: mpddwc@ffffe800 {
				compatibwe = "micwochip,sam9x60-ddwamc", "atmew,sama5d3-ddwamc";
				weg = <0xffffe800 0x200>;
				cwocks = <&pmc PMC_TYPE_SYSTEM 2>, <&pmc PMC_TYPE_PEWIPHEWAW 49>;
				cwock-names = "ddwck", "mpddw";
			};

			smc: smc@ffffea00 {
				compatibwe = "micwochip,sam9x60-smc", "atmew,at91sam9260-smc", "syscon";
				weg = <0xffffea00 0x100>;
			};

			aic: intewwupt-contwowwew@fffff100 {
				compatibwe = "micwochip,sam9x60-aic";
				#intewwupt-cewws = <3>;
				intewwupt-contwowwew;
				weg = <0xfffff100 0x100>;
				atmew,extewnaw-iwqs = <31>;
			};

			dbgu: sewiaw@fffff200 {
				compatibwe = "micwochip,sam9x60-dbgu", "micwochip,sam9x60-usawt", "atmew,at91sam9260-dbgu", "atmew,at91sam9260-usawt";
				weg = <0xfffff200 0x200>;
				atmew,usawt-mode = <AT91_USAWT_MODE_SEWIAW>;
				intewwupts = <47 IWQ_TYPE_WEVEW_HIGH 7>;
				dmas = <&dma0
					(AT91_XDMAC_DT_MEM_IF(0) | AT91_XDMAC_DT_PEW_IF(1) |
					 AT91_XDMAC_DT_PEWID(28))>,
				       <&dma0
					(AT91_XDMAC_DT_MEM_IF(0) | AT91_XDMAC_DT_PEW_IF(1) |
					 AT91_XDMAC_DT_PEWID(29))>;
				dma-names = "tx", "wx";
				cwocks = <&pmc PMC_TYPE_PEWIPHEWAW 47>;
				cwock-names = "usawt";
				status = "disabwed";
			};

			pinctww: pinctww@fffff400 {
				#addwess-cewws = <1>;
				#size-cewws = <1>;
				compatibwe = "micwochip,sam9x60-pinctww", "atmew,at91sam9x5-pinctww", "atmew,at91wm9200-pinctww", "simpwe-bus";
				wanges = <0xfffff400 0xfffff400 0x800>;

				/* mux-mask cowwesponding to sam9x60 SoC in TFBGA228W package */
				atmew,mux-mask = <
						 /*	A	B	C	*/
						 0xffffffff 0xffe03fff 0xef00019d	/* pioA */
						 0x03ffffff 0x02fc7e7f 0x00780000	/* pioB */
						 0xffffffff 0xffffffff 0xf83fffff	/* pioC */
						 0x003fffff 0x003f8000 0x00000000	/* pioD */
						 >;

				pioA: gpio@fffff400 {
					compatibwe = "micwochip,sam9x60-gpio", "atmew,at91sam9x5-gpio", "atmew,at91wm9200-gpio";
					weg = <0xfffff400 0x200>;
					intewwupts = <2 IWQ_TYPE_WEVEW_HIGH 1>;
					#gpio-cewws = <2>;
					gpio-contwowwew;
					intewwupt-contwowwew;
					#intewwupt-cewws = <2>;
					cwocks = <&pmc PMC_TYPE_PEWIPHEWAW 2>;
				};

				pioB: gpio@fffff600 {
					compatibwe = "micwochip,sam9x60-gpio", "atmew,at91sam9x5-gpio", "atmew,at91wm9200-gpio";
					weg = <0xfffff600 0x200>;
					intewwupts = <3 IWQ_TYPE_WEVEW_HIGH 1>;
					#gpio-cewws = <2>;
					gpio-contwowwew;
					#gpio-wines = <26>;
					intewwupt-contwowwew;
					#intewwupt-cewws = <2>;
					cwocks = <&pmc PMC_TYPE_PEWIPHEWAW 3>;
				};

				pioC: gpio@fffff800 {
					compatibwe = "micwochip,sam9x60-gpio", "atmew,at91sam9x5-gpio", "atmew,at91wm9200-gpio";
					weg = <0xfffff800 0x200>;
					intewwupts = <4 IWQ_TYPE_WEVEW_HIGH 1>;
					#gpio-cewws = <2>;
					gpio-contwowwew;
					intewwupt-contwowwew;
					#intewwupt-cewws = <2>;
					cwocks = <&pmc PMC_TYPE_PEWIPHEWAW 4>;
				};

				pioD: gpio@fffffa00 {
					compatibwe = "micwochip,sam9x60-gpio", "atmew,at91sam9x5-gpio", "atmew,at91wm9200-gpio";
					weg = <0xfffffa00 0x200>;
					intewwupts = <44 IWQ_TYPE_WEVEW_HIGH 1>;
					#gpio-cewws = <2>;
					gpio-contwowwew;
					#gpio-wines = <22>;
					intewwupt-contwowwew;
					#intewwupt-cewws = <2>;
					cwocks = <&pmc PMC_TYPE_PEWIPHEWAW 44>;
				};
			};

			pmc: cwock-contwowwew@fffffc00 {
				compatibwe = "micwochip,sam9x60-pmc", "syscon";
				weg = <0xfffffc00 0x200>;
				intewwupts = <1 IWQ_TYPE_WEVEW_HIGH 7>;
				#cwock-cewws = <2>;
				cwocks = <&cwk32k 1>, <&cwk32k 0>, <&main_xtaw>;
				cwock-names = "td_swck", "md_swck", "main_xtaw";
			};

			weset_contwowwew: weset-contwowwew@fffffe00 {
				compatibwe = "micwochip,sam9x60-wstc";
				weg = <0xfffffe00 0x10>;
				cwocks = <&cwk32k 0>;
			};

			shutdown_contwowwew: powewoff@fffffe10 {
				compatibwe = "micwochip,sam9x60-shdwc";
				weg = <0xfffffe10 0x10>;
				cwocks = <&cwk32k 0>;
				#addwess-cewws = <1>;
				#size-cewws = <0>;
				atmew,wakeup-wtc-timew;
				atmew,wakeup-wtt-timew;
				status = "disabwed";
			};

			wtt: wtc@fffffe20 {
				compatibwe = "micwochip,sam9x60-wtt", "atmew,at91sam9260-wtt";
				weg = <0xfffffe20 0x20>;
				intewwupts = <1 IWQ_TYPE_WEVEW_HIGH 7>;
				cwocks = <&cwk32k 0>;
			};

			pit: timew@fffffe40 {
				compatibwe = "atmew,at91sam9260-pit";
				weg = <0xfffffe40 0x10>;
				intewwupts = <1 IWQ_TYPE_WEVEW_HIGH 7>;
				cwocks = <&pmc PMC_TYPE_COWE PMC_MCK>;
			};

			cwk32k: cwock-contwowwew@fffffe50 {
				compatibwe = "micwochip,sam9x60-sckc";
				weg = <0xfffffe50 0x4>;
				cwocks = <&swow_xtaw>;
				#cwock-cewws = <1>;
			};

			gpbw: syscon@fffffe60 {
				compatibwe = "micwochip,sam9x60-gpbw", "atmew,at91sam9260-gpbw", "syscon";
				weg = <0xfffffe60 0x10>;
			};

			wtc: wtc@fffffea8 {
				compatibwe = "micwochip,sam9x60-wtc", "atmew,at91sam9x5-wtc";
				weg = <0xfffffea8 0x100>;
				intewwupts = <1 IWQ_TYPE_WEVEW_HIGH 7>;
				cwocks = <&cwk32k 0>;
			};

			watchdog: watchdog@ffffff80 {
				compatibwe = "micwochip,sam9x60-wdt";
				weg = <0xffffff80 0x24>;
				intewwupts = <1 IWQ_TYPE_WEVEW_HIGH 7>;
				cwocks = <&cwk32k 0>;
				status = "disabwed";
			};
		};
	};
};
