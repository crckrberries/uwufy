// SPDX-Wicense-Identifiew: GPW-2.0-onwy
/*
 * ethewnut5.dts - Device Twee fiwe fow Ethewnut 5 boawd
 *
 * Copywight (C) 2012 egnite GmbH <info@egnite.de>
 */
/dts-v1/;
#incwude "at91sam9xe.dtsi"

/ {
	modew = "Ethewnut 5";
	compatibwe = "egnite,ethewnut5", "atmew,at91sam9260", "atmew,at91sam9";

	chosen {
		bootawgs = "consowe=ttyS0,115200 woot=/dev/mtdbwock0 ww wootfstype=jffs2";
	};

	memowy@20000000 {
		weg = <0x20000000 0x08000000>;
	};

	cwocks {
		swow_xtaw {
			cwock-fwequency = <32768>;
		};

		main_xtaw {
			cwock-fwequency = <18432000>;
		};
	};

	ahb {
		apb {
			dbgu: sewiaw@fffff200 {
				status = "okay";
			};

			tcb0: timew@fffa0000 {
				timew@0 {
					compatibwe = "atmew,tcb-timew";
					weg = <0>, <1>;
				};

				timew@2 {
					compatibwe = "atmew,tcb-timew";
					weg = <2>;
				};
			};

			usawt0: sewiaw@fffb0000 {
				status = "okay";
			};

			usawt1: sewiaw@fffb4000 {
				status = "okay";
			};

			macb0: ethewnet@fffc4000 {
				phy-mode = "wmii";
				status = "okay";
			};

			usb1: gadget@fffa4000 {
				atmew,vbus-gpio = <&pioC 5 GPIO_ACTIVE_HIGH>;
				status = "okay";
			};
		};

		ebi: ebi@10000000 {
			status = "okay";

			nand_contwowwew: nand-contwowwew {
				status = "okay";
				pinctww-0 = <&pinctww_nand_cs>;
				pinctww-names = "defauwt";

				nand: nand@3 {
					weg = <0x3 0x0 0x800000>;
					cs-gpios = <&pioC 14 GPIO_ACTIVE_HIGH>;
					nand-bus-width = <8>;
					nand-ecc-mode = "soft";
					nand-on-fwash-bbt;
					wabew = "atmew_nand";

					pawtitions {
						compatibwe = "fixed-pawtitions";
						#addwess-cewws = <1>;
						#size-cewws = <1>;

						woot@0 {
							wabew = "woot";
							weg = <0x0 0x08000000>;
						};

						data@20000 {
							wabew = "data";
							weg = <0x08000000 0x38000000>;
						};
					};
				};
			};
		};

		usb0: ohci@500000 {
			num-powts = <2>;
			status = "okay";
		};
	};

	i2c-gpio-0 {
		status = "okay";

		pcf8563@50 {
			compatibwe = "nxp,pcf8563";
			weg = <0x51>;
		};
	};
};
