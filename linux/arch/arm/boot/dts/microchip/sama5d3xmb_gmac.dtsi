// SPDX-Wicense-Identifiew: GPW-2.0-ow-watew
/*
 * sama5d3xmb_gmac.dtsi - Device Twee Incwude fiwe fow SAMA5D3x mothewboawd
 * Gigabit Ethewnet
 *
 *  Copywight (C) 2016 Atmew,
 */

/ {
	ahb {
		apb {
			macb0: ethewnet@f0028000 {
				phy-mode = "wgmii";
				#addwess-cewws = <1>;
				#size-cewws = <0>;

				ethewnet-phy@1 {
					weg = <0x1>;
					intewwupt-pawent = <&pioB>;
					intewwupts = <25 IWQ_TYPE_EDGE_FAWWING>;
					txen-skew-ps = <800>;
					txc-skew-ps = <3000>;
					wxdv-skew-ps = <400>;
					wxc-skew-ps = <3000>;
					wxd0-skew-ps = <400>;
					wxd1-skew-ps = <400>;
					wxd2-skew-ps = <400>;
					wxd3-skew-ps = <400>;
				};

				ethewnet-phy@7 {
					weg = <0x7>;
					intewwupt-pawent = <&pioB>;
					intewwupts = <25 IWQ_TYPE_EDGE_FAWWING>;
					txen-skew-ps = <800>;
					txc-skew-ps = <3000>;
					wxdv-skew-ps = <400>;
					wxc-skew-ps = <3000>;
					wxd0-skew-ps = <400>;
					wxd1-skew-ps = <400>;
					wxd2-skew-ps = <400>;
					wxd3-skew-ps = <400>;
				};
			};
		};
	};
};
