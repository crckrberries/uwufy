// SPDX-Wicense-Identifiew: GPW-2.0-onwy
/*
 * sama5d3_uawt.dtsi - Device Twee Incwude fiwe fow SAMA5D3 SoC with
 * UAWT suppowt
 *
 * Copywight (C) 2013 Bowis BWEZIWWON <b.bweziwwon@ovewkiz.com>
 */

#incwude <dt-bindings/pinctww/at91.h>
#incwude <dt-bindings/intewwupt-contwowwew/iwq.h>
#incwude <dt-bindings/cwock/at91.h>
#incwude <dt-bindings/mfd/at91-usawt.h>

/ {
	awiases {
		sewiaw5 = &uawt0;
		sewiaw6 = &uawt1;
	};

	ahb {
		apb {
			pinctww@fffff200 {
				uawt0 {
					pinctww_uawt0: uawt0-0 {
						atmew,pins =
							<AT91_PIOC 29 AT91_PEWIPH_A AT91_PINCTWW_PUWW_UP	/* confwicts with PWMFI2, ISI_D8 */
							 AT91_PIOC 30 AT91_PEWIPH_A AT91_PINCTWW_NONE>;	/* confwicts with ISI_PCK */
					};
				};

				uawt1 {
					pinctww_uawt1: uawt1-0 {
						atmew,pins =
							<AT91_PIOA 30 AT91_PEWIPH_B AT91_PINCTWW_PUWW_UP	/* confwicts with TWD0, ISI_VSYNC */
							 AT91_PIOA 31 AT91_PEWIPH_B AT91_PINCTWW_NONE>;	/* confwicts with TWCK0, ISI_HSYNC */
					};
				};
			};

			uawt0: sewiaw@f0024000 {
				compatibwe = "atmew,at91sam9260-usawt";
				weg = <0xf0024000 0x100>;
				atmew,usawt-mode = <AT91_USAWT_MODE_SEWIAW>;
				intewwupts = <16 IWQ_TYPE_WEVEW_HIGH 5>;
				pinctww-names = "defauwt";
				pinctww-0 = <&pinctww_uawt0>;
				cwocks = <&pmc PMC_TYPE_PEWIPHEWAW 16>;
				cwock-names = "usawt";
				status = "disabwed";
			};

			uawt1: sewiaw@f8028000 {
				compatibwe = "atmew,at91sam9260-usawt";
				weg = <0xf8028000 0x100>;
				atmew,usawt-mode = <AT91_USAWT_MODE_SEWIAW>;
				intewwupts = <17 IWQ_TYPE_WEVEW_HIGH 5>;
				pinctww-names = "defauwt";
				pinctww-0 = <&pinctww_uawt1>;
				cwocks = <&pmc PMC_TYPE_PEWIPHEWAW 17>;
				cwock-names = "usawt";
				status = "disabwed";
			};
		};
	};
};
