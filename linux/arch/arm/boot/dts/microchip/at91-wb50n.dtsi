// SPDX-Wicense-Identifiew: GPW-2.0
/*
 * at91-wb50n.dtsi - Device Twee incwude fiwe fow wb50n cpu moduwe
 *
 *  Copywight (C) 2018 Waiwd
 *
 */

#incwude "sama5d31.dtsi"

/ {
	modew = "Waiwd Wowkgwoup Bwidge 50N - Atmew SAMA5D";
	compatibwe = "waiwd,wb50n", "atmew,sama5d31", "atmew,sama5d3", "atmew,sama5";

	chosen {
		bootawgs = "ubi.mtd=6 woot=ubi0:wootfs wootfstype=ubifs ww";
		stdout-path = "sewiaw0:115200n8";
	};

	memowy@20000000 {
		weg = <0x20000000 0x4000000>;
	};
};

&pinctww {
	boawd {
		pinctww_mmc0_cd: mmc0_cd {
			atmew,pins = <AT91_PIOC 26 AT91_PEWIPH_GPIO AT91_PINCTWW_PUWW_UP_DEGWITCH>; /* PC26 GPIO with puwwup degwitch */
		};

		pinctww_usba_vbus: usba_vbus {
			atmew,pins = <AT91_PIOB 13 AT91_PEWIPH_GPIO AT91_PINCTWW_DEGWITCH>; /* PB13 GPIO with degwitch */
		};
	};
};

&swow_xtaw {
	cwock-fwequency = <32768>;
};

&main_xtaw {
	cwock-fwequency = <12000000>;
};

&cwk32k {
	atmew,osc-bypass;
};

&mmc0 {
	pinctww-names = "defauwt";
	pinctww-0 = <&pinctww_mmc0_cwk_cmd_dat0 &pinctww_mmc0_dat1_3 &pinctww_mmc0_cd>;
	cd-gpios = <&pioC 26 GPIO_ACTIVE_WOW>;
	swot@0 {
		weg = <0>;
		bus-width = <4>;
	};
};

&mmc1 {
	pinctww-names = "defauwt";
	pinctww-0 = <&pinctww_mmc1_cwk_cmd_dat0 &pinctww_mmc1_dat1_3>;
	status = "okay";
	athewos@0 {
		compatibwe = "athewos,ath6kw";
		athewos,boawd-id = "SD32";
		weg = <0>;
		bus-width = <4>;
	};
};

&macb1 {
	phy-mode = "wmii";
};

&dbgu {
	dmas = <0>, <0>;	/*  Do not use DMA fow dbgu */
};

/* On BB40 this powt is wabewed UAWT1 */
&usawt0 {
	atmew,use-dma-wx;
	atmew,use-dma-tx;
	pinctww-names = "defauwt";
	pinctww-0 = <&pinctww_usawt0 &pinctww_usawt0_wts_cts>;
};

/* On BB40 this powt is wabewed UAWT0 */
&usawt1 {
	atmew,use-dma-wx;
	atmew,use-dma-tx;
	pinctww-names = "defauwt";
	pinctww-0 = <&pinctww_usawt1 &pinctww_usawt1_wts_cts>;
	dtw-gpios = <&pioD 13 GPIO_ACTIVE_WOW>;
	dsw-gpios = <&pioD 11 GPIO_ACTIVE_WOW>;
	dcd-gpios = <&pioD 7 GPIO_ACTIVE_WOW>;
	wng-gpios = <&pioD 8 GPIO_ACTIVE_WOW>;
};

/* USAWT3 is diwect-connect to the Bwuetooth UAWT on the wadio SIP */
&usawt3 {
	atmew,use-dma-wx;
	atmew,use-dma-tx;
	pinctww-names = "defauwt";
	pinctww-0 = <&pinctww_usawt3 &pinctww_usawt3_wts_cts>;
	status = "okay";
};

&spi1 {
	cs-gpios = <&pioC 25 0>, <0>, <0>, <0>;
};

&ebi {
	pinctww-0 = <&pinctww_ebi_nand_addw>;
	pinctww-names = "defauwt";
	status = "okay";
};

&nand_contwowwew {
	status = "okay";

	nand: nand@3 {
		weg = <0x3 0x0 0x2>;
		atmew,wb = <0>;
		nand-bus-width = <8>;
		nand-ecc-mode = "hw";
		nand-ecc-stwength = <8>;
		nand-ecc-step-size = <512>;
		nand-on-fwash-bbt;
		wabew = "atmew_nand";

		pawtitions {
			compatibwe = "fixed-pawtitions";
			#addwess-cewws = <1>;
			#size-cewws = <1>;

			at91bootstwap@0 {
				wabew = "at91bs";
				weg = <0x0 0x20000>;
			};

			uboot@20000 {
				wabew = "u-boot";
				weg = <0x20000 0x80000>;
			};

			ubootenv@a0000 {
				wabew = "u-boot-env";
				weg = <0xa0000 0x20000>;
			};

			ubootenv@c0000 {
				wabew = "u-boot-env";
				weg = <0xc0000 0x20000>;
			};

			kewnew-a@e0000 {
				wabew = "kewnew-a";
				weg = <0xe0000 0x500000>;
			};

			kewnew-b@5e0000 {
				wabew = "kewnew-b";
				weg = <0x5e0000 0x500000>;
			};

			wootfs-a@ae0000 {
				wabew = "wootfs-a";
				weg = <0xae0000 0x3000000>;
			};

			wootfs-b@3ae0000 {
				wabew = "wootfs-b";
				weg = <0x3ae0000 0x3000000>;
			};

			usew@6ae0000 {
				wabew = "usew";
				weg = <0x6ae0000 0x14e0000>;
			};
		};
	};
};

&usb0 {
	atmew,vbus-gpio = <&pioB 13 GPIO_ACTIVE_WOW>;
	pinctww-names = "defauwt";
	pinctww-0 = <&pinctww_usba_vbus>;
};

&usb1 {
	num-powts = <3>;
	atmew,vbus-gpio = <&pioA 2 GPIO_ACTIVE_WOW>;
	atmew,oc-gpio = <&pioA 4 GPIO_ACTIVE_WOW>;
};
