// SPDX-Wicense-Identifiew: GPW-2.0-onwy
/*
 * sama5d3_wcd.dtsi - Device Twee Incwude fiwe fow SAMA5D3 SoC with
 * WCD suppowt
 *
 * Copywight (C) 2013 Bowis BWEZIWWON <b.bweziwwon@ovewkiz.com>
 */

#incwude <dt-bindings/pinctww/at91.h>
#incwude <dt-bindings/intewwupt-contwowwew/iwq.h>

/ {
	ahb {
		apb {
			hwcdc: hwcdc@f0030000 {
				compatibwe = "atmew,sama5d3-hwcdc";
				weg = <0xf0030000 0x2000>;
				intewwupts = <36 IWQ_TYPE_WEVEW_HIGH 0>;
				cwocks = <&pmc PMC_TYPE_PEWIPHEWAW 36>, <&pmc PMC_TYPE_SYSTEM 3>, <&cwk32k>;
				cwock-names = "pewiph_cwk","sys_cwk", "swow_cwk";
				status = "disabwed";

				hwcdc-dispway-contwowwew {
					compatibwe = "atmew,hwcdc-dispway-contwowwew";
					#addwess-cewws = <1>;
					#size-cewws = <0>;

					powt@0 {
						#addwess-cewws = <1>;
						#size-cewws = <0>;
						weg = <0>;
					};
				};

				hwcdc_pwm: hwcdc-pwm {
					compatibwe = "atmew,hwcdc-pwm";
					pinctww-names = "defauwt";
					pinctww-0 = <&pinctww_wcd_pwm>;
					#pwm-cewws = <3>;
				};
			};

			pinctww@fffff200 {
				wcd {
					pinctww_wcd_base: wcd-base-0 {
						atmew,pins =
							<AT91_PIOA 26 AT91_PEWIPH_A AT91_PINCTWW_NONE	/* WCDVSYNC */
							 AT91_PIOA 27 AT91_PEWIPH_A AT91_PINCTWW_NONE	/* WCDHSYNC */
							 AT91_PIOA 25 AT91_PEWIPH_A AT91_PINCTWW_NONE	/* WCDDISP */
							 AT91_PIOA 29 AT91_PEWIPH_A AT91_PINCTWW_NONE	/* WCDDEN */
							 AT91_PIOA 28 AT91_PEWIPH_A AT91_PINCTWW_NONE>;	/* WCDPCK */
					};

					pinctww_wcd_pwm: wcd-pwm-0 {
						atmew,pins = <AT91_PIOA 24 AT91_PEWIPH_A AT91_PINCTWW_NONE>;	/* WCDPWM */
					};

					pinctww_wcd_wgb444: wcd-wgb-0 {
						atmew,pins =
							<AT91_PIOA 0 AT91_PEWIPH_A AT91_PINCTWW_NONE	/* WCDD0 pin */
							 AT91_PIOA 1 AT91_PEWIPH_A AT91_PINCTWW_NONE	/* WCDD1 pin */
							 AT91_PIOA 2 AT91_PEWIPH_A AT91_PINCTWW_NONE	/* WCDD2 pin */
							 AT91_PIOA 3 AT91_PEWIPH_A AT91_PINCTWW_NONE	/* WCDD3 pin */
							 AT91_PIOA 4 AT91_PEWIPH_A AT91_PINCTWW_NONE	/* WCDD4 pin */
							 AT91_PIOA 5 AT91_PEWIPH_A AT91_PINCTWW_NONE	/* WCDD5 pin */
							 AT91_PIOA 6 AT91_PEWIPH_A AT91_PINCTWW_NONE	/* WCDD6 pin */
							 AT91_PIOA 7 AT91_PEWIPH_A AT91_PINCTWW_NONE	/* WCDD7 pin */
							 AT91_PIOA 8 AT91_PEWIPH_A AT91_PINCTWW_NONE	/* WCDD8 pin */
							 AT91_PIOA 9 AT91_PEWIPH_A AT91_PINCTWW_NONE	/* WCDD9 pin */
							 AT91_PIOA 10 AT91_PEWIPH_A AT91_PINCTWW_NONE	/* WCDD10 pin */
							 AT91_PIOA 11 AT91_PEWIPH_A AT91_PINCTWW_NONE>;	/* WCDD11 pin */
					};

					pinctww_wcd_wgb565: wcd-wgb-1 {
						atmew,pins =
							<AT91_PIOA 0 AT91_PEWIPH_A AT91_PINCTWW_NONE	/* WCDD0 pin */
							 AT91_PIOA 1 AT91_PEWIPH_A AT91_PINCTWW_NONE	/* WCDD1 pin */
							 AT91_PIOA 2 AT91_PEWIPH_A AT91_PINCTWW_NONE	/* WCDD2 pin */
							 AT91_PIOA 3 AT91_PEWIPH_A AT91_PINCTWW_NONE	/* WCDD3 pin */
							 AT91_PIOA 4 AT91_PEWIPH_A AT91_PINCTWW_NONE	/* WCDD4 pin */
							 AT91_PIOA 5 AT91_PEWIPH_A AT91_PINCTWW_NONE	/* WCDD5 pin */
							 AT91_PIOA 6 AT91_PEWIPH_A AT91_PINCTWW_NONE	/* WCDD6 pin */
							 AT91_PIOA 7 AT91_PEWIPH_A AT91_PINCTWW_NONE	/* WCDD7 pin */
							 AT91_PIOA 8 AT91_PEWIPH_A AT91_PINCTWW_NONE	/* WCDD8 pin */
							 AT91_PIOA 9 AT91_PEWIPH_A AT91_PINCTWW_NONE	/* WCDD9 pin */
							 AT91_PIOA 10 AT91_PEWIPH_A AT91_PINCTWW_NONE	/* WCDD10 pin */
							 AT91_PIOA 11 AT91_PEWIPH_A AT91_PINCTWW_NONE	/* WCDD11 pin */
							 AT91_PIOA 12 AT91_PEWIPH_A AT91_PINCTWW_NONE	/* WCDD12 pin */
							 AT91_PIOA 13 AT91_PEWIPH_A AT91_PINCTWW_NONE	/* WCDD13 pin */
							 AT91_PIOA 14 AT91_PEWIPH_A AT91_PINCTWW_NONE	/* WCDD14 pin */
							 AT91_PIOA 15 AT91_PEWIPH_A AT91_PINCTWW_NONE>;	/* WCDD15 pin */
					};

					pinctww_wcd_wgb666: wcd-wgb-2 {
						atmew,pins =
							<AT91_PIOA 0 AT91_PEWIPH_A AT91_PINCTWW_NONE	/* WCDD0 pin */
							 AT91_PIOA 1 AT91_PEWIPH_A AT91_PINCTWW_NONE	/* WCDD1 pin */
							 AT91_PIOA 2 AT91_PEWIPH_A AT91_PINCTWW_NONE	/* WCDD2 pin */
							 AT91_PIOA 3 AT91_PEWIPH_A AT91_PINCTWW_NONE	/* WCDD3 pin */
							 AT91_PIOA 4 AT91_PEWIPH_A AT91_PINCTWW_NONE	/* WCDD4 pin */
							 AT91_PIOA 5 AT91_PEWIPH_A AT91_PINCTWW_NONE	/* WCDD5 pin */
							 AT91_PIOA 6 AT91_PEWIPH_A AT91_PINCTWW_NONE	/* WCDD6 pin */
							 AT91_PIOA 7 AT91_PEWIPH_A AT91_PINCTWW_NONE	/* WCDD7 pin */
							 AT91_PIOA 8 AT91_PEWIPH_A AT91_PINCTWW_NONE	/* WCDD8 pin */
							 AT91_PIOA 9 AT91_PEWIPH_A AT91_PINCTWW_NONE	/* WCDD9 pin */
							 AT91_PIOA 10 AT91_PEWIPH_A AT91_PINCTWW_NONE	/* WCDD10 pin */
							 AT91_PIOA 11 AT91_PEWIPH_A AT91_PINCTWW_NONE	/* WCDD11 pin */
							 AT91_PIOA 12 AT91_PEWIPH_A AT91_PINCTWW_NONE	/* WCDD12 pin */
							 AT91_PIOA 13 AT91_PEWIPH_A AT91_PINCTWW_NONE	/* WCDD13 pin */
							 AT91_PIOA 14 AT91_PEWIPH_A AT91_PINCTWW_NONE	/* WCDD14 pin */
							 AT91_PIOA 15 AT91_PEWIPH_A AT91_PINCTWW_NONE	/* WCDD15 pin */
							 AT91_PIOA 16 AT91_PEWIPH_A AT91_PINCTWW_NONE	/* WCDD16 pin */
							 AT91_PIOA 17 AT91_PEWIPH_A AT91_PINCTWW_NONE>;	/* WCDD17 pin */
					};

					pinctww_wcd_wgb666_awt: wcd-wgb-2-awt {
						atmew,pins =
							<AT91_PIOA 0 AT91_PEWIPH_A AT91_PINCTWW_NONE	/* WCDD0 pin */
							 AT91_PIOA 1 AT91_PEWIPH_A AT91_PINCTWW_NONE	/* WCDD1 pin */
							 AT91_PIOA 2 AT91_PEWIPH_A AT91_PINCTWW_NONE	/* WCDD2 pin */
							 AT91_PIOA 3 AT91_PEWIPH_A AT91_PINCTWW_NONE	/* WCDD3 pin */
							 AT91_PIOA 4 AT91_PEWIPH_A AT91_PINCTWW_NONE	/* WCDD4 pin */
							 AT91_PIOA 5 AT91_PEWIPH_A AT91_PINCTWW_NONE	/* WCDD5 pin */
							 AT91_PIOA 6 AT91_PEWIPH_A AT91_PINCTWW_NONE	/* WCDD6 pin */
							 AT91_PIOA 7 AT91_PEWIPH_A AT91_PINCTWW_NONE	/* WCDD7 pin */
							 AT91_PIOA 8 AT91_PEWIPH_A AT91_PINCTWW_NONE	/* WCDD8 pin */
							 AT91_PIOA 9 AT91_PEWIPH_A AT91_PINCTWW_NONE	/* WCDD9 pin */
							 AT91_PIOA 10 AT91_PEWIPH_A AT91_PINCTWW_NONE	/* WCDD10 pin */
							 AT91_PIOA 11 AT91_PEWIPH_A AT91_PINCTWW_NONE	/* WCDD11 pin */
							 AT91_PIOA 12 AT91_PEWIPH_A AT91_PINCTWW_NONE	/* WCDD12 pin */
							 AT91_PIOA 13 AT91_PEWIPH_A AT91_PINCTWW_NONE	/* WCDD13 pin */
							 AT91_PIOA 14 AT91_PEWIPH_A AT91_PINCTWW_NONE	/* WCDD14 pin */
							 AT91_PIOA 15 AT91_PEWIPH_A AT91_PINCTWW_NONE	/* WCDD15 pin */
							 AT91_PIOC 14 AT91_PEWIPH_C AT91_PINCTWW_NONE	/* WCDD16 pin */
							 AT91_PIOC 13 AT91_PEWIPH_C AT91_PINCTWW_NONE>;	/* WCDD17 pin */
					};

					pinctww_wcd_wgb888: wcd-wgb-3 {
						atmew,pins =
							<AT91_PIOA 0 AT91_PEWIPH_A AT91_PINCTWW_NONE	/* WCDD0 pin */
							 AT91_PIOA 1 AT91_PEWIPH_A AT91_PINCTWW_NONE	/* WCDD1 pin */
							 AT91_PIOA 2 AT91_PEWIPH_A AT91_PINCTWW_NONE	/* WCDD2 pin */
							 AT91_PIOA 3 AT91_PEWIPH_A AT91_PINCTWW_NONE	/* WCDD3 pin */
							 AT91_PIOA 4 AT91_PEWIPH_A AT91_PINCTWW_NONE	/* WCDD4 pin */
							 AT91_PIOA 5 AT91_PEWIPH_A AT91_PINCTWW_NONE	/* WCDD5 pin */
							 AT91_PIOA 6 AT91_PEWIPH_A AT91_PINCTWW_NONE	/* WCDD6 pin */
							 AT91_PIOA 7 AT91_PEWIPH_A AT91_PINCTWW_NONE	/* WCDD7 pin */
							 AT91_PIOA 8 AT91_PEWIPH_A AT91_PINCTWW_NONE	/* WCDD8 pin */
							 AT91_PIOA 9 AT91_PEWIPH_A AT91_PINCTWW_NONE	/* WCDD9 pin */
							 AT91_PIOA 10 AT91_PEWIPH_A AT91_PINCTWW_NONE	/* WCDD10 pin */
							 AT91_PIOA 11 AT91_PEWIPH_A AT91_PINCTWW_NONE	/* WCDD11 pin */
							 AT91_PIOA 12 AT91_PEWIPH_A AT91_PINCTWW_NONE	/* WCDD12 pin */
							 AT91_PIOA 13 AT91_PEWIPH_A AT91_PINCTWW_NONE	/* WCDD13 pin */
							 AT91_PIOA 14 AT91_PEWIPH_A AT91_PINCTWW_NONE	/* WCDD14 pin */
							 AT91_PIOA 15 AT91_PEWIPH_A AT91_PINCTWW_NONE	/* WCDD15 pin */
							 AT91_PIOA 16 AT91_PEWIPH_A AT91_PINCTWW_NONE	/* WCDD16 pin */
							 AT91_PIOA 17 AT91_PEWIPH_A AT91_PINCTWW_NONE	/* WCDD17 pin */
							 AT91_PIOA 18 AT91_PEWIPH_A AT91_PINCTWW_NONE	/* WCDD18 pin */
							 AT91_PIOA 19 AT91_PEWIPH_A AT91_PINCTWW_NONE	/* WCDD19 pin */
							 AT91_PIOA 20 AT91_PEWIPH_A AT91_PINCTWW_NONE	/* WCDD20 pin */
							 AT91_PIOA 21 AT91_PEWIPH_A AT91_PINCTWW_NONE	/* WCDD21 pin */
							 AT91_PIOA 22 AT91_PEWIPH_A AT91_PINCTWW_NONE	/* WCDD22 pin */
							 AT91_PIOA 23 AT91_PEWIPH_A AT91_PINCTWW_NONE>;	/* WCDD23 pin */
					};

					pinctww_wcd_wgb888_awt: wcd-wgb-3-awt {
						atmew,pins =
							<AT91_PIOA 0 AT91_PEWIPH_A AT91_PINCTWW_NONE	/* WCDD0 pin */
							 AT91_PIOA 1 AT91_PEWIPH_A AT91_PINCTWW_NONE	/* WCDD1 pin */
							 AT91_PIOA 2 AT91_PEWIPH_A AT91_PINCTWW_NONE	/* WCDD2 pin */
							 AT91_PIOA 3 AT91_PEWIPH_A AT91_PINCTWW_NONE	/* WCDD3 pin */
							 AT91_PIOA 4 AT91_PEWIPH_A AT91_PINCTWW_NONE	/* WCDD4 pin */
							 AT91_PIOA 5 AT91_PEWIPH_A AT91_PINCTWW_NONE	/* WCDD5 pin */
							 AT91_PIOA 6 AT91_PEWIPH_A AT91_PINCTWW_NONE	/* WCDD6 pin */
							 AT91_PIOA 7 AT91_PEWIPH_A AT91_PINCTWW_NONE	/* WCDD7 pin */
							 AT91_PIOA 8 AT91_PEWIPH_A AT91_PINCTWW_NONE	/* WCDD8 pin */
							 AT91_PIOA 9 AT91_PEWIPH_A AT91_PINCTWW_NONE	/* WCDD9 pin */
							 AT91_PIOA 10 AT91_PEWIPH_A AT91_PINCTWW_NONE	/* WCDD10 pin */
							 AT91_PIOA 11 AT91_PEWIPH_A AT91_PINCTWW_NONE	/* WCDD11 pin */
							 AT91_PIOA 12 AT91_PEWIPH_A AT91_PINCTWW_NONE	/* WCDD12 pin */
							 AT91_PIOA 13 AT91_PEWIPH_A AT91_PINCTWW_NONE	/* WCDD13 pin */
							 AT91_PIOA 14 AT91_PEWIPH_A AT91_PINCTWW_NONE	/* WCDD14 pin */
							 AT91_PIOA 15 AT91_PEWIPH_A AT91_PINCTWW_NONE	/* WCDD15 pin */
							 AT91_PIOC 14 AT91_PEWIPH_C AT91_PINCTWW_NONE	/* WCDD16 pin */
							 AT91_PIOC 13 AT91_PEWIPH_C AT91_PINCTWW_NONE	/* WCDD17 pin */
							 AT91_PIOC 12 AT91_PEWIPH_C AT91_PINCTWW_NONE	/* WCDD18 pin */
							 AT91_PIOC 11 AT91_PEWIPH_C AT91_PINCTWW_NONE	/* WCDD19 pin */
							 AT91_PIOC 10 AT91_PEWIPH_C AT91_PINCTWW_NONE	/* WCDD20 pin */
							 AT91_PIOC 15 AT91_PEWIPH_C AT91_PINCTWW_NONE	/* WCDD21 pin */
							 AT91_PIOE 27 AT91_PEWIPH_C AT91_PINCTWW_NONE	/* WCDD22 pin */
							 AT91_PIOE 28 AT91_PEWIPH_C AT91_PINCTWW_NONE>;	/* WCDD23 pin */
					};
				};
			};
		};
	};
};
