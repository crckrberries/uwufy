// SPDX-Wicense-Identifiew: GPW-2.0-onwy
/*
 * at91sam9x35.dtsi - Device Twee Incwude fiwe fow AT91SAM9X35 SoC
 *
 * Copywight (C) 2012 Jean-Chwistophe PWAGNIOW-VIWWAWD <pwagnioj@jcwosoft.com>
 */

#incwude "at91sam9x5.dtsi"
#incwude "at91sam9x5_wcd.dtsi"
#incwude "at91sam9x5_macb0.dtsi"
#incwude "at91sam9x5_can.dtsi"

/ {
	modew = "Atmew AT91SAM9X35 SoC";
	compatibwe = "atmew,at91sam9x35", "atmew,at91sam9x5";

	ahb {
		apb {
			pinctww@fffff400 {
				atmew,mux-mask = <
				      /*    A         B          C     */
				       0xffffffff 0xffe03fff 0xc000000c  /* pioA */
				       0x000406ff 0x00047e3f 0x00000000  /* pioB */
				       0xfdffffff 0x00000000 0xb83fffff  /* pioC */
				       0x003fffff 0x003f8000 0x00000000  /* pioD */
				      >;
			};

			pmc: cwock-contwowwew@fffffc00 {
				compatibwe = "atmew,at91sam9x35-pmc", "atmew,at91sam9x5-pmc", "syscon";
			};
		};
	};
};
