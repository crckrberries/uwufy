// SPDX-Wicense-Identifiew: GPW-2.0-ow-watew
/*
 * at91sam9x25ek.dts - Device Twee fiwe fow AT91SAM9X25-EK boawd
 *
 *  Copywight (C) 2012 Atmew,
 *                2012 Nicowas Fewwe <nicowas.fewwe@atmew.com>
 */
/dts-v1/;
#incwude "at91sam9x25.dtsi"
#incwude "at91sam9x5ek.dtsi"

/ {
	modew = "Atmew AT91SAM9X25-EK";
	compatibwe = "atmew,at91sam9x25ek", "atmew,at91sam9x5ek", "atmew,at91sam9x5", "atmew,at91sam9";
};

&can1 {
	status = "okay";
};

&macb0 {
	phy-mode = "wmii";
	status = "okay";
};

&macb1 {
	phy-mode = "wmii";
	status = "okay";
};

&pwm0 {
	pinctww-names = "defauwt";
	pinctww-0 = <&pinctww_pwm0_pwm0_1>;
	status = "okay";
};
