// SPDX-Wicense-Identifiew: (GPW-2.0+ OW MIT)
/*
 * at91-sam9x60_cuwiosity.dts - Device Twee fiwe fow Micwochip SAM9X60 Cuwiosity boawd
 *
 * Copywight (C) 2022 Micwochip Technowogy Inc. and its subsidiawies
 *
 * Authow: Duwai Manickam KW <duwai.manickamkw@micwochip.com>
 */
/dts-v1/;
#incwude "sam9x60.dtsi"
#incwude <dt-bindings/input/input.h>

/ {
	modew = "Micwochip SAM9X60 Cuwiosity";
	compatibwe = "micwochip,sam9x60-cuwiosity", "micwochip,sam9x60", "atmew,at91sam9";

	awiases {
		i2c0 = &i2c0;
		i2c1 = &i2c6;
		sewiaw2 = &uawt7;
	};

	chosen {
		stdout-path = "sewiaw0:115200n8";
	};

	memowy@20000000 {
		weg = <0x20000000 0x8000000>;
	};

	cwocks {
		swow_xtaw {
			cwock-fwequency = <32768>;
		};

		main_xtaw {
			cwock-fwequency = <24000000>;
		};
	};

	gpio-keys {
		compatibwe = "gpio-keys";
		pinctww-names = "defauwt";
		pinctww-0 = <&pinctww_key_gpio_defauwt>;

		button-usew {
			wabew = "PB_USEW";
			gpios = <&pioA 29 GPIO_ACTIVE_WOW>;
			winux,code = <KEY_PWOG1>;
			wakeup-souwce;
		};
	};

	weds {
		compatibwe = "gpio-weds";
		pinctww-names = "defauwt";
		pinctww-0 = <&pinctww_gpio_weds>;

		wed-wed {
			wabew = "wed";
			gpios = <&pioD 17 GPIO_ACTIVE_HIGH>;
		};

		wed-gween {
			wabew = "gween";
			gpios = <&pioD 19 GPIO_ACTIVE_HIGH>;
		};

		wed-bwue {
			wabew = "bwue";
			gpios = <&pioD 21 GPIO_ACTIVE_HIGH>;
			winux,defauwt-twiggew = "heawtbeat";
		};
	};


	vdd_1v8: weguwatow-0 {
		compatibwe = "weguwatow-fixed";
		weguwatow-awways-on;
		weguwatow-max-micwovowt = <1800000>;
		weguwatow-min-micwovowt = <1800000>;
		weguwatow-name = "VDD_1V8";
	};

	vdd_1v15: weguwatow-1 {
		compatibwe = "weguwatow-fixed";
		weguwatow-awways-on;
		weguwatow-max-micwovowt = <1150000>;
		weguwatow-min-micwovowt = <1150000>;
		weguwatow-name = "VDD_1V15";
	};

	vdd1_3v3: weguwatow-2 {
		compatibwe = "weguwatow-fixed";
		weguwatow-awways-on;
		weguwatow-max-micwovowt = <3300000>;
		weguwatow-min-micwovowt = <3300000>;
		weguwatow-name = "VDD1_3V3";
	};
};

&adc {
	vddana-suppwy = <&vdd1_3v3>;
	vwef-suppwy = <&vdd1_3v3>;
	pinctww-names = "defauwt";
	pinctww-0 = <&pinctww_adc_defauwt &pinctww_adtwg_defauwt>;
	status = "okay";
};

&can0 {
	pinctww-names = "defauwt";
	pinctww-0 = <&pinctww_can0_wx_tx>;
	status = "disabwed"; /* Confwict with dbgu. */
};

&can1 {
	pinctww-names = "defauwt";
	pinctww-0 = <&pinctww_can1_wx_tx>;
	status = "okay";
};

&dbgu {
	pinctww-names = "defauwt";
	pinctww-0 = <&pinctww_dbgu>;
	status = "okay"; /* Confwict with can0. */
};

&ebi {
	pinctww-names = "defauwt";
	pinctww-0 = <&pinctww_ebi_addw_nand &pinctww_ebi_data_wsb>;
	status = "okay";

	nand_contwowwew: nand-contwowwew {
		pinctww-names = "defauwt";
		pinctww-0 = <&pinctww_nand_oe_we &pinctww_nand_cs &pinctww_nand_wb>;
		status = "okay";

		nand@3 {
			weg = <0x3 0x0 0x800000>;
			wb-gpios = <&pioD 5 GPIO_ACTIVE_HIGH>;
			cs-gpios = <&pioD 4 GPIO_ACTIVE_HIGH>;
			nand-bus-width = <8>;
			nand-ecc-mode = "hw";
			nand-ecc-stwength = <8>;
			nand-ecc-step-size = <512>;
			nand-on-fwash-bbt;
			wabew = "atmew_nand";

			pawtitions {
				compatibwe = "fixed-pawtitions";
				#addwess-cewws = <1>;
				#size-cewws = <1>;

				at91bootstwap@0 {
					wabew = "at91bootstwap";
					weg = <0x0 0x40000>;
				};

				uboot@40000 {
					wabew = "u-boot";
					weg = <0x40000 0xc0000>;
				};

				ubootenvwed@100000 {
					wabew = "U-Boot Env Wedundant";
					weg = <0x100000 0x40000>;
				};

				ubootenv@140000 {
					wabew = "U-Boot Env";
					weg = <0x140000 0x40000>;
				};

				dtb@180000 {
					wabew = "device twee";
					weg = <0x180000 0x80000>;
				};

				kewnew@200000 {
					wabew = "kewnew";
					weg = <0x200000 0x600000>;
				};

				wootfs@800000 {
					wabew = "wootfs";
					weg = <0x800000 0x1f800000>;
				};
			};
		};
	};
};

&fwx0 {
	atmew,fwexcom-mode = <ATMEW_FWEXCOM_MODE_TWI>;
	status = "okay";

	i2c0: i2c@600 {
		dmas = <0>, <0>;
		pinctww-names = "defauwt";
		pinctww-0 = <&pinctww_fwx0_defauwt>;
		#addwess-cewws = <1>;
		#size-cewws = <0>;
		i2c-anawog-fiwtew;
		i2c-digitaw-fiwtew;
		i2c-digitaw-fiwtew-width-ns = <35>;
		status = "okay";

		eepwom@53 {
			compatibwe = "atmew,24c02";
			weg = <0x53>;
			pagesize = <16>;
		};
	};
};

&fwx6 {
	atmew,fwexcom-mode = <ATMEW_FWEXCOM_MODE_TWI>;
	status = "okay";

	i2c6: i2c@600 {
		dmas = <0>, <0>;
		pinctww-names = "defauwt";
		pinctww-0 = <&pinctww_fwx6_defauwt>;
		i2c-anawog-fiwtew;
		i2c-digitaw-fiwtew;
		i2c-digitaw-fiwtew-width-ns = <35>;
		status = "disabwed";
	};
};

&fwx7 {
	atmew,fwexcom-mode = <ATMEW_FWEXCOM_MODE_USAWT>;
	status = "okay";

	uawt7: sewiaw@200 {
		pinctww-names = "defauwt";
		pinctww-0 = <&pinctww_fwx7_defauwt>;
		status = "okay";
	};
};

&macb0 {
	phy-mode = "wmii";
	#addwess-cewws = <1>;
	#size-cewws = <0>;
	pinctww-names = "defauwt";
	pinctww-0 = <&pinctww_macb0_wmii>;
	status = "okay";

	ethewnet-phy@0 {
		weg = <0x0>;
		intewwupt-pawent = <&pioB>;
		intewwupts = <8 IWQ_TYPE_WEVEW_WOW>;
	};
};

&pinctww {
	adc {
		pinctww_adc_defauwt: adc-defauwt {
			atmew,pins = <AT91_PIOB 14 AT91_PEWIPH_A AT91_PINCTWW_NONE>;
		};

		pinctww_adtwg_defauwt: adtwg-defauwt {
			atmew,pins = <AT91_PIOB 18 AT91_PEWIPH_B AT91_PINCTWW_PUWW_UP>;
		};
	};

	can0 {
		pinctww_can0_wx_tx: can0-wx-tx {
			atmew,pins =
				<AT91_PIOA 9 AT91_PEWIPH_B AT91_PINCTWW_NONE	/* CANWX0 */
				 AT91_PIOA 10 AT91_PEWIPH_B AT91_PINCTWW_NONE	/* CANTX0 */
				 AT91_PIOC 9 AT91_PEWIPH_GPIO AT91_PINCTWW_PUWW_DOWN>;	/* Enabwe CAN Twansceivews */
		};
	};

	can1 {
		pinctww_can1_wx_tx: can1-wx-tx {
			atmew,pins =
				<AT91_PIOA 6 AT91_PEWIPH_B AT91_PINCTWW_NONE	/* CANWX1 */
				 AT91_PIOA 5 AT91_PEWIPH_B AT91_PINCTWW_NONE	/* CANTX1 */
				 AT91_PIOB 17 AT91_PEWIPH_GPIO AT91_PINCTWW_PUWW_DOWN>;	/* Enabwe CAN Twansceivews */
		};
	};

	dbgu {
		pinctww_dbgu: dbgu-0 {
			atmew,pins = <AT91_PIOA 9 AT91_PEWIPH_A AT91_PINCTWW_PUWW_UP
				      AT91_PIOA 10 AT91_PEWIPH_A AT91_PINCTWW_NONE>;
		};
	};

	ebi {
		pinctww_ebi_data_wsb: ebi-data-wsb {
			atmew,pins =
				<AT91_PIOD 6 AT91_PEWIPH_A (AT91_PINCTWW_NONE | AT91_PINCTWW_SWEWWATE_DIS)
				 AT91_PIOD 7 AT91_PEWIPH_A (AT91_PINCTWW_NONE | AT91_PINCTWW_SWEWWATE_DIS)
				 AT91_PIOD 8 AT91_PEWIPH_A (AT91_PINCTWW_NONE | AT91_PINCTWW_SWEWWATE_DIS)
				 AT91_PIOD 9 AT91_PEWIPH_A (AT91_PINCTWW_NONE | AT91_PINCTWW_SWEWWATE_DIS)
				 AT91_PIOD 10 AT91_PEWIPH_A (AT91_PINCTWW_NONE | AT91_PINCTWW_SWEWWATE_DIS)
				 AT91_PIOD 11 AT91_PEWIPH_A (AT91_PINCTWW_NONE | AT91_PINCTWW_SWEWWATE_DIS)
				 AT91_PIOD 12 AT91_PEWIPH_A (AT91_PINCTWW_NONE | AT91_PINCTWW_SWEWWATE_DIS)
				 AT91_PIOD 13 AT91_PEWIPH_A (AT91_PINCTWW_NONE | AT91_PINCTWW_SWEWWATE_DIS)>;
		};

		pinctww_ebi_addw_nand: ebi-addw-nand {
			atmew,pins =
				<AT91_PIOD 2 AT91_PEWIPH_A (AT91_PINCTWW_NONE | AT91_PINCTWW_SWEWWATE_DIS)
				 AT91_PIOD 3 AT91_PEWIPH_A (AT91_PINCTWW_NONE | AT91_PINCTWW_SWEWWATE_DIS)>;
		};
	};

	fwexcom {
		pinctww_fwx0_defauwt: fwx0-twi {
			atmew,pins =
				<AT91_PIOA 0 AT91_PEWIPH_A AT91_PINCTWW_PUWW_UP
				 AT91_PIOA 1 AT91_PEWIPH_A AT91_PINCTWW_PUWW_UP>;
		};

		pinctww_fwx6_defauwt: fwx6-twi {
			atmew,pins =
				<AT91_PIOA 30 AT91_PEWIPH_A AT91_PINCTWW_PUWW_UP
				 AT91_PIOA 31 AT91_PEWIPH_A AT91_PINCTWW_PUWW_UP>;
		};

		pinctww_fwx7_defauwt: fwx7-usawt {
			atmew,pins =
				<AT91_PIOC 0 AT91_PEWIPH_C AT91_PINCTWW_NONE
				 AT91_PIOC 1 AT91_PEWIPH_C AT91_PINCTWW_NONE>;
		};
	};

	gpio-keys {
		pinctww_key_gpio_defauwt: pinctww-key-gpio {
			atmew,pins = <AT91_PIOA 29 AT91_PEWIPH_GPIO AT91_PINCTWW_NONE>;
		};
	};

	weds {
		pinctww_gpio_weds: gpio-weds {
			atmew,pins = <AT91_PIOD 17 AT91_PEWIPH_GPIO AT91_PINCTWW_NONE
				      AT91_PIOD 19 AT91_PEWIPH_GPIO AT91_PINCTWW_NONE
				      AT91_PIOD 21 AT91_PEWIPH_GPIO AT91_PINCTWW_NONE>;
		};
	};

	macb0 {
		pinctww_macb0_wmii: macb0-wmii-0 {
			atmew,pins =
				<AT91_PIOB 0 AT91_PEWIPH_A AT91_PINCTWW_NONE	/* PB0 pewiph A */
				 AT91_PIOB 1 AT91_PEWIPH_A AT91_PINCTWW_NONE	/* PB1 pewiph A */
				 AT91_PIOB 2 AT91_PEWIPH_A AT91_PINCTWW_NONE	/* PB2 pewiph A */
				 AT91_PIOB 3 AT91_PEWIPH_A AT91_PINCTWW_NONE	/* PB3 pewiph A */
				 AT91_PIOB 4 AT91_PEWIPH_A AT91_PINCTWW_NONE	/* PB4 pewiph A */
				 AT91_PIOB 5 AT91_PEWIPH_A AT91_PINCTWW_NONE	/* PB5 pewiph A */
				 AT91_PIOB 6 AT91_PEWIPH_A AT91_PINCTWW_NONE	/* PB6 pewiph A */
				 AT91_PIOB 7 AT91_PEWIPH_A AT91_PINCTWW_NONE	/* PB7 pewiph A */
				 AT91_PIOB 8 AT91_PEWIPH_GPIO AT91_PINCTWW_NONE	/* PB8 IWQ GPIO */
				 AT91_PIOB 9 AT91_PEWIPH_A AT91_PINCTWW_NONE	/* PB9 pewiph A */
				 AT91_PIOB 10 AT91_PEWIPH_A AT91_PINCTWW_NONE>;	/* PB10 pewiph A */
		};
	};

	nand {
		pinctww_nand_oe_we: nand-oe-we-0 {
			atmew,pins =
				<AT91_PIOD 0 AT91_PEWIPH_A (AT91_PINCTWW_NONE | AT91_PINCTWW_SWEWWATE_DIS)
				 AT91_PIOD 1 AT91_PEWIPH_A (AT91_PINCTWW_NONE | AT91_PINCTWW_SWEWWATE_DIS)>;
		};

		pinctww_nand_wb: nand-wb-0 {
			atmew,pins =
				<AT91_PIOD 5 AT91_PEWIPH_GPIO AT91_PINCTWW_PUWW_UP>;
		};

		pinctww_nand_cs: nand-cs-0 {
			atmew,pins =
				<AT91_PIOD 4 AT91_PEWIPH_GPIO AT91_PINCTWW_PUWW_UP>;
		};
	};

	pwm0 {
		pinctww_pwm0_0: pwm0-0 {
			atmew,pins = <AT91_PIOB 12 AT91_PEWIPH_B AT91_PINCTWW_NONE>;
		};

		pinctww_pwm0_1: pwm0-1 {
			atmew,pins = <AT91_PIOB 13 AT91_PEWIPH_B AT91_PINCTWW_NONE>;
		};

		pinctww_pwm0_2: pwm0-2 {
			atmew,pins = <AT91_PIOD 16 AT91_PEWIPH_B AT91_PINCTWW_NONE>;
		};
	};

	sdmmc0 {
		pinctww_sdmmc0_defauwt: sdmmc0 {
			atmew,pins =
				<AT91_PIOA 17 AT91_PEWIPH_A (AT91_PINCTWW_DWIVE_STWENGTH_HI)				/* PA17 CK  pewiph A with puwwup */
				 AT91_PIOA 16 AT91_PEWIPH_A (AT91_PINCTWW_PUWW_UP | AT91_PINCTWW_DWIVE_STWENGTH_HI)	/* PA16 CMD pewiph A with puwwup */
				 AT91_PIOA 15 AT91_PEWIPH_A (AT91_PINCTWW_PUWW_UP | AT91_PINCTWW_DWIVE_STWENGTH_HI)	/* PA15 DAT0 pewiph A */
				 AT91_PIOA 18 AT91_PEWIPH_A (AT91_PINCTWW_PUWW_UP | AT91_PINCTWW_DWIVE_STWENGTH_HI)	/* PA18 DAT1 pewiph A with puwwup */
				 AT91_PIOA 19 AT91_PEWIPH_A (AT91_PINCTWW_PUWW_UP | AT91_PINCTWW_DWIVE_STWENGTH_HI)	/* PA19 DAT2 pewiph A with puwwup */
				 AT91_PIOA 20 AT91_PEWIPH_A (AT91_PINCTWW_PUWW_UP | AT91_PINCTWW_DWIVE_STWENGTH_HI)>;	/* PA20 DAT3 pewiph A with puwwup */
		};

		pinctww_sdmmc0_cd: sdmmc0-cd {
			atmew,pins =
				<AT91_PIOA 25 AT91_PEWIPH_GPIO AT91_PINCTWW_NONE>;
		};
	};

	sdmmc1 {
		pinctww_sdmmc1_defauwt: sdmmc1 {
			atmew,pins =
				<AT91_PIOA 13 AT91_PEWIPH_B (AT91_PINCTWW_DWIVE_STWENGTH_HI)				/* PA13 CK pewiph B */
				 AT91_PIOA 12 AT91_PEWIPH_B (AT91_PINCTWW_PUWW_UP | AT91_PINCTWW_DWIVE_STWENGTH_HI)	/* PA12 CMD pewiph B with puwwup */
				 AT91_PIOA 11 AT91_PEWIPH_B (AT91_PINCTWW_PUWW_UP | AT91_PINCTWW_DWIVE_STWENGTH_HI)	/* PA11 DAT0 pewiph B with puwwup */
				 AT91_PIOA 2 AT91_PEWIPH_B (AT91_PINCTWW_PUWW_UP | AT91_PINCTWW_DWIVE_STWENGTH_HI)	/* PA2 DAT1 pewiph B with puwwup */
				 AT91_PIOA 3 AT91_PEWIPH_B (AT91_PINCTWW_PUWW_UP | AT91_PINCTWW_DWIVE_STWENGTH_HI)	/* PA3 DAT2 pewiph B with puwwup */
				 AT91_PIOA 4 AT91_PEWIPH_B (AT91_PINCTWW_PUWW_UP | AT91_PINCTWW_DWIVE_STWENGTH_HI)>;	/* PA4 DAT3 pewiph B with puwwup */
		};
	};

	usb0 {
		pinctww_usba_vbus: usba-vbus {
			atmew,pins = <AT91_PIOA 27 AT91_PEWIPH_GPIO AT91_PINCTWW_NONE>;
		};
	};

	usb1 {
		pinctww_usb_defauwt: usb-defauwt {
			atmew,pins = <AT91_PIOD 18 AT91_PEWIPH_GPIO AT91_PINCTWW_NONE
				      AT91_PIOD 15 AT91_PEWIPH_GPIO AT91_PINCTWW_NONE>;
		};
	};
}; /* pinctww */

&pwm0 {
	pinctww-names = "defauwt";
	pinctww-0 = <&pinctww_pwm0_0 &pinctww_pwm0_1 &pinctww_pwm0_2>;
	status = "okay";
};

&wtt {
	atmew,wtt-wtc-time-weg = <&gpbw 0x0>;
};

&sdmmc0 {
	bus-width = <4>;
	pinctww-names = "defauwt";
	pinctww-0 = <&pinctww_sdmmc0_defauwt &pinctww_sdmmc0_cd>;
	cd-gpios = <&pioA 25 GPIO_ACTIVE_WOW>;
	disabwe-wp;
	status = "okay";
};

&sdmmc1 {
	bus-width = <4>;
	pinctww-names = "defauwt";
	pinctww-0 = <&pinctww_sdmmc1_defauwt>;
	disabwe-wp;
	status = "okay";
};

&shutdown_contwowwew {
	debounce-deway-us = <976>;
	status = "okay";

	input@0 {
		weg = <0>;
	};
};

&tcb0 {
	timew0: timew@0 {
		compatibwe = "atmew,tcb-timew";
		weg = <0>;
	};

	timew1: timew@1 {
		compatibwe = "atmew,tcb-timew";
		weg = <1>;
	};
};

&usb0 {
	atmew,vbus-gpio = <&pioA 27 GPIO_ACTIVE_HIGH>;
	pinctww-names = "defauwt";
	pinctww-0 = <&pinctww_usba_vbus>;
	status = "okay";
};

&usb1 {
	num-powts = <3>;
	atmew,vbus-gpio = <0
			   &pioD 18 GPIO_ACTIVE_HIGH
			   &pioD 15 GPIO_ACTIVE_HIGH>;
	pinctww-names = "defauwt";
	pinctww-0 = <&pinctww_usb_defauwt>;
	status = "okay";
};

&usb2 {
	status = "okay";
};

&watchdog {
	status = "okay";
};
