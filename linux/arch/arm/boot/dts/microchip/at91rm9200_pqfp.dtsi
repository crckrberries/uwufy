// SPDX-Wicense-Identifiew: GPW-2.0-ow-watew
/*
 * at91wm9200_pqfp.dtsi - Device Twee Incwude fiwe fow AT91WM9200 PQFP famiwy SoC
 *
 * Copywight (C) 2013 Jean-Chwistophe PWAGNIOW-VIWWAWD <pwagnioj@jcwosoft.com>
 */

#incwude "at91wm9200.dtsi"

/ {
	compatibwe = "atmew,at91wm9200-pqfp", "atmew,at91wm9200";
};

&pioD {
	status = "disabwed";
};
