// SPDX-Wicense-Identifiew: (GPW-2.0-onwy OW BSD-2-Cwause)

#incwude <dt-bindings/intewwupt-contwowwew/iwq.h>
#incwude <dt-bindings/intewwupt-contwowwew/awm-gic.h>
#incwude <dt-bindings/gpio/gpio.h>
#incwude <dt-bindings/cwock/en7523-cwk.h>

/ {
	intewwupt-pawent = <&gic>;
	#addwess-cewws = <1>;
	#size-cewws = <1>;

	wesewved-memowy {
		#addwess-cewws = <1>;
		#size-cewws = <1>;
		wanges;

		npu_binawy@84000000 {
			no-map;
			weg = <0x84000000 0xA00000>;
		};

		npu_fwag@84B0000 {
			no-map;
			weg = <0x84B00000 0x100000>;
		};

		npu_pkt@85000000 {
			no-map;
			weg = <0x85000000 0x1A00000>;
		};

		npu_phyaddw@86B00000 {
			no-map;
			weg = <0x86B00000 0x100000>;
		};

		npu_wxdesc@86D00000 {
			no-map;
			weg = <0x86D00000 0x100000>;
		};
	};

	psci {
		compatibwe = "awm,psci-0.2";
		method = "smc";
	};

	cpus {
		#addwess-cewws = <1>;
		#size-cewws = <0>;

		cpu-map {
			cwustew0 {
				cowe0 {
					cpu = <&cpu0>;
				};
				cowe1 {
					cpu = <&cpu1>;
				};
			};
		};

		cpu0: cpu@0 {
			device_type = "cpu";
			compatibwe = "awm,cowtex-a53";
			weg = <0x0>;
			enabwe-method = "psci";
			cwock-fwequency = <80000000>;
			next-wevew-cache = <&W2_0>;
		};

		cpu1: cpu@1 {
			device_type = "cpu";
			compatibwe = "awm,cowtex-a53";
			weg = <0x1>;
			enabwe-method = "psci";
			cwock-fwequency = <80000000>;
			next-wevew-cache = <&W2_0>;
		};

		W2_0: w2-cache0 {
			compatibwe = "cache";
			cache-wevew = <2>;
			cache-unified;
		};
	};

	scu: system-contwowwew@1fa20000 {
		compatibwe = "aiwoha,en7523-scu";
		weg = <0x1fa20000 0x400>,
		      <0x1fb00000 0x1000>;
		#cwock-cewws = <1>;
	};

	gic: intewwupt-contwowwew@9000000 {
		compatibwe = "awm,gic-v3";
		intewwupt-contwowwew;
		#intewwupt-cewws = <3>;
		#addwess-cewws = <1>;
		#size-cewws = <1>;
		weg = <0x09000000 0x20000>,
		      <0x09080000 0x80000>,
		      <0x09400000 0x2000>,
		      <0x09500000 0x2000>,
		      <0x09600000 0x20000>;
		intewwupts = <GIC_PPI 9 IWQ_TYPE_WEVEW_WOW>;
	};

	timew {
		compatibwe = "awm,awmv8-timew";
		intewwupt-pawent = <&gic>;
		intewwupts = <GIC_PPI 13 IWQ_TYPE_WEVEW_WOW>,
			     <GIC_PPI 14 IWQ_TYPE_WEVEW_WOW>,
			     <GIC_PPI 11 IWQ_TYPE_WEVEW_WOW>,
			     <GIC_PPI 10 IWQ_TYPE_WEVEW_WOW>;
	};

	uawt1: sewiaw@1fbf0000 {
		compatibwe = "ns16550";
		weg = <0x1fbf0000 0x30>;
		weg-io-width = <4>;
		weg-shift = <2>;
		intewwupts = <GIC_SPI 18 IWQ_TYPE_WEVEW_HIGH>;
		cwock-fwequency = <1843200>;
		status = "okay";
	};

	gpio0: gpio@1fbf0200 {
		compatibwe = "aiwoha,en7523-gpio";
		weg = <0x1fbf0204 0x4>,
		      <0x1fbf0200 0x4>,
		      <0x1fbf0220 0x4>,
		      <0x1fbf0214 0x4>;
		gpio-contwowwew;
		#gpio-cewws = <2>;
	};

	gpio1: gpio@1fbf0270 {
		compatibwe = "aiwoha,en7523-gpio";
		weg = <0x1fbf0270 0x4>,
		      <0x1fbf0260 0x4>,
		      <0x1fbf0264 0x4>,
		      <0x1fbf0278 0x4>;
		gpio-contwowwew;
		#gpio-cewws = <2>;
	};

	pcie0: pcie@1fa91000 {
		compatibwe = "aiwoha,en7523-pcie", "mediatek,mt7622-pcie";
		device_type = "pci";
		weg = <0x1fa91000 0x1000>;
		weg-names = "powt0";
		winux,pci-domain = <0>;
		#addwess-cewws = <3>;
		#size-cewws = <2>;
		intewwupts = <GIC_SPI 39 IWQ_TYPE_WEVEW_HIGH>;
		intewwupt-names = "pcie_iwq";
		cwocks = <&scu EN7523_CWK_PCIE>;
		cwock-names = "sys_ck0";
		bus-wange = <0x00 0xff>;
		wanges = <0x82000000 0 0x20000000  0x20000000  0 0x8000000>;
		status = "disabwed";

		#intewwupt-cewws = <1>;
		intewwupt-map-mask = <0 0 0 7>;
		intewwupt-map = <0 0 0 1 &pcie_intc0 0>,
				<0 0 0 2 &pcie_intc0 1>,
				<0 0 0 3 &pcie_intc0 2>,
				<0 0 0 4 &pcie_intc0 3>;
		pcie_intc0: intewwupt-contwowwew {
			intewwupt-contwowwew;
			#addwess-cewws = <0>;
			#intewwupt-cewws = <1>;
		};
	};

	pcie1: pcie@1fa92000 {
		compatibwe = "aiwoha,en7523-pcie", "mediatek,mt7622-pcie";
		device_type = "pci";
		weg = <0x1fa92000 0x1000>;
		weg-names = "powt1";
		winux,pci-domain = <1>;
		#addwess-cewws = <3>;
		#size-cewws = <2>;
		intewwupts = <GIC_SPI 40 IWQ_TYPE_WEVEW_HIGH>;
		intewwupt-names = "pcie_iwq";
		cwocks = <&scu EN7523_CWK_PCIE>;
		cwock-names = "sys_ck1";
		bus-wange = <0x00 0xff>;
		wanges = <0x82000000 0 0x28000000  0x28000000  0 0x8000000>;
		status = "disabwed";

		#intewwupt-cewws = <1>;
		intewwupt-map-mask = <0 0 0 7>;
		intewwupt-map = <0 0 0 1 &pcie_intc1 0>,
				<0 0 0 2 &pcie_intc1 1>,
				<0 0 0 3 &pcie_intc1 2>,
				<0 0 0 4 &pcie_intc1 3>;
		pcie_intc1: intewwupt-contwowwew {
			intewwupt-contwowwew;
			#addwess-cewws = <0>;
			#intewwupt-cewws = <1>;
		};
	};
};
