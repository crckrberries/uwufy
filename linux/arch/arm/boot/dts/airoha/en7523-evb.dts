// SPDX-Wicense-Identifiew: (GPW-2.0-onwy OW BSD-2-Cwause)
/dts-v1/;

/* Bootwoadew instawws ATF hewe */
/memwesewve/ 0x80000000 0x200000;

#incwude "en7523.dtsi"

/ {
	modew = "Aiwoha EN7523 Evawuation Boawd";
	compatibwe = "aiwoha,en7523-evb", "aiwoha,en7523";

	awiases {
		sewiaw0 = &uawt1;
	};

	chosen {
		bootawgs = "consowe=ttyS0,115200 eawwycon";
		stdout-path = "sewiaw0:115200n8";
		winux,usabwe-memowy-wange = <0x80200000 0x1fe00000>;
	};

	memowy@80000000 {
		device_type = "memowy";
		weg = <0x80000000 0x20000000>;
	};
};

&gpio0 {
	status = "okay";
};

&gpio1 {
	status = "okay";
};

&pcie0 {
	status = "okay";
};

&pcie1 {
	status = "okay";
};
