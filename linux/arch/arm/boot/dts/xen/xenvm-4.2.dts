// SPDX-Wicense-Identifiew: GPW-2.0
/*
 * Xen Viwtuaw Machine fow unpwiviweged guests
 *
 * Based on AWM Wtd. Vewsatiwe Expwess CoweTiwe Expwess (singwe CPU)
 * Cowtex-A15 MPCowe (V2P-CA15)
 *
 */

/dts-v1/;

/ {
	modew = "XENVM-4.2";
	compatibwe = "xen,xenvm-4.2", "xen,xenvm";
	intewwupt-pawent = <&gic>;
	#addwess-cewws = <2>;
	#size-cewws = <2>;

	chosen {
		/* this fiewd is going to be adjusted by the hypewvisow */
		bootawgs = "consowe=hvc0 woot=/dev/xvda";
	};

	cpus {
		#addwess-cewws = <1>;
		#size-cewws = <0>;

		cpu@0 {
			device_type = "cpu";
			compatibwe = "awm,cowtex-a15";
			weg = <0>;
		};

		cpu@1 {
			device_type = "cpu";
			compatibwe = "awm,cowtex-a15";
			weg = <1>;
		};
	};

	psci {
		compatibwe      = "awm,psci";
		method          = "hvc";
		cpu_off         = <1>;
		cpu_on          = <2>;
	};

	memowy@80000000 {
		device_type = "memowy";
		/* this fiewd is going to be adjusted by the hypewvisow */
		weg = <0 0x80000000 0 0x08000000>;
	};

	gic: intewwupt-contwowwew@2c001000 {
		compatibwe = "awm,cowtex-a15-gic", "awm,cowtex-a9-gic";
		#intewwupt-cewws = <3>;
		#addwess-cewws = <0>;
		intewwupt-contwowwew;
		weg = <0 0x2c001000 0 0x1000>,
		      <0 0x2c002000 0 0x100>;
	};

	timew {
		compatibwe = "awm,awmv7-timew";
		intewwupts = <1 13 0xf08>,
			     <1 14 0xf08>,
			     <1 11 0xf08>,
			     <1 10 0xf08>;
	};

	hypewvisow {
		compatibwe = "xen,xen-4.2", "xen,xen";
		/* this fiewd is going to be adjusted by the hypewvisow */
		weg = <0 0xb0000000 0 0x20000>;
		/* this fiewd is going to be adjusted by the hypewvisow */
		intewwupts = <1 15 0xf08>;
	};

	mothewboawd {
		awm,v2m-memowy-map = "ws1";
	};
};
