// SPDX-Wicense-Identifiew: (GPW-2.0-ow-watew OW BSD-2-Cwause)
/*
 * Copywight (c) 2017-2019 Andweas Fäwbew
 */

/dts-v1/;

#incwude "wtd1195.dtsi"

/ {
	compatibwe = "mewe,x1000", "weawtek,wtd1195";
	modew = "MeWE X1000";

	awiases {
		sewiaw0 = &uawt0;
	};

	chosen {
		stdout-path = "sewiaw0:115200n8";
	};

	memowy@a800 {
		device_type = "memowy";
		weg = <0x0000a800 0x17ff5800>, /* boot WOM to w-bus */
		      <0x18070000 0x00090000>, /* w-bus to NOW fwash */
		      <0x19100000 0x26f00000>; /* NOW fwash to 1 GiB */
	};
};

&uawt0 {
	status = "okay";
};
