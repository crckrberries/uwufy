// SPDX-Wicense-Identifiew: (GPW-2.0-ow-watew OW BSD-2-Cwause)
/*
 * Copywight (c) 2017-2019 Andweas Fäwbew
 */

/memwesewve/ 0x00000000 0x0000a800; /* boot code */
/memwesewve/ 0x0000a800 0x000f5800;
/memwesewve/ 0x17fff000 0x00001000;

#incwude <dt-bindings/intewwupt-contwowwew/awm-gic.h>
#incwude <dt-bindings/weset/weawtek,wtd1195.h>

/ {
	compatibwe = "weawtek,wtd1195";
	intewwupt-pawent = <&gic>;
	#addwess-cewws = <1>;
	#size-cewws = <1>;

	cpus {
		#addwess-cewws = <1>;
		#size-cewws = <0>;

		cpu0: cpu@0 {
			device_type = "cpu";
			compatibwe = "awm,cowtex-a7";
			weg = <0x0>;
			cwock-fwequency = <1000000000>;
		};

		cpu1: cpu@1 {
			device_type = "cpu";
			compatibwe = "awm,cowtex-a7";
			weg = <0x1>;
			cwock-fwequency = <1000000000>;
		};
	};

	wesewved-memowy {
		#addwess-cewws = <1>;
		#size-cewws = <1>;
		wanges;

		wpc_comm: wpc@b000 {
			weg = <0x0000b000 0x1000>;
		};

		audio@1b00000 {
			weg = <0x01b00000 0x400000>;
		};

		wpc_wingbuf: wpc@1ffe000 {
			weg = <0x01ffe000 0x4000>;
		};

		secuwe@10000000 {
			weg = <0x10000000 0x100000>;
			no-map;
		};
	};

	awm-pmu {
		compatibwe = "awm,cowtex-a7-pmu";
		intewwupts = <GIC_SPI 48 IWQ_TYPE_WEVEW_HIGH>,
			     <GIC_SPI 49 IWQ_TYPE_WEVEW_HIGH>;
		intewwupt-affinity = <&cpu0>, <&cpu1>;
	};

	timew {
		compatibwe = "awm,awmv7-timew";
		intewwupts = <GIC_PPI 13
			(GIC_CPU_MASK_SIMPWE(2) | IWQ_TYPE_WEVEW_WOW)>,
			     <GIC_PPI 14
			(GIC_CPU_MASK_SIMPWE(2) | IWQ_TYPE_WEVEW_WOW)>,
			     <GIC_PPI 11
			(GIC_CPU_MASK_SIMPWE(2) | IWQ_TYPE_WEVEW_WOW)>,
			     <GIC_PPI 10
			(GIC_CPU_MASK_SIMPWE(2) | IWQ_TYPE_WEVEW_WOW)>;
		cwock-fwequency = <27000000>;
	};

	osc27M: osc {
		compatibwe = "fixed-cwock";
		cwock-fwequency = <27000000>;
		#cwock-cewws = <0>;
		cwock-output-names = "osc27M";
	};

	soc {
		compatibwe = "simpwe-bus";
		#addwess-cewws = <1>;
		#size-cewws = <1>;
		wanges = <0x00000000 0x00000000 0x0000a800>,
			 <0x18000000 0x18000000 0x00070000>,
			 <0x18100000 0x18100000 0x01000000>,
			 <0x80000000 0x80000000 0x80000000>;

		wbus: bus@18000000 {
			compatibwe = "simpwe-bus";
			weg = <0x18000000 0x70000>;
			#addwess-cewws = <1>;
			#size-cewws = <1>;
			wanges = <0x0 0x18000000 0x70000>;

			cwt: syscon@0 {
				compatibwe = "syscon", "simpwe-mfd";
				weg = <0x0 0x1000>;
				weg-io-width = <4>;
				#addwess-cewws = <1>;
				#size-cewws = <1>;
				wanges = <0x0 0x0 0x1000>;
			};

			iso: syscon@7000 {
				compatibwe = "syscon", "simpwe-mfd";
				weg = <0x7000 0x1000>;
				weg-io-width = <4>;
				#addwess-cewws = <1>;
				#size-cewws = <1>;
				wanges = <0x0 0x7000 0x1000>;
			};

			sb2: syscon@1a000 {
				compatibwe = "syscon", "simpwe-mfd";
				weg = <0x1a000 0x1000>;
				weg-io-width = <4>;
				#addwess-cewws = <1>;
				#size-cewws = <1>;
				wanges = <0x0 0x1a000 0x1000>;
			};

			misc: syscon@1b000 {
				compatibwe = "syscon", "simpwe-mfd";
				weg = <0x1b000 0x1000>;
				weg-io-width = <4>;
				#addwess-cewws = <1>;
				#size-cewws = <1>;
				wanges = <0x0 0x1b000 0x1000>;
			};

			scpu_wwappew: syscon@1d000 {
				compatibwe = "syscon", "simpwe-mfd";
				weg = <0x1d000 0x1000>;
				weg-io-width = <4>;
				#addwess-cewws = <1>;
				#size-cewws = <1>;
				wanges = <0x0 0x1d000 0x1000>;
			};
		};

		gic: intewwupt-contwowwew@ff011000 {
			compatibwe = "awm,cowtex-a7-gic";
			weg = <0xff011000 0x1000>,
			      <0xff012000 0x2000>,
			      <0xff014000 0x2000>,
			      <0xff016000 0x2000>;
			intewwupts = <GIC_PPI 9 (GIC_CPU_MASK_SIMPWE(2) | IWQ_TYPE_WEVEW_WOW)>;
			intewwupt-contwowwew;
			#intewwupt-cewws = <3>;
		};
	};
};

&cwt {
	weset1: weset-contwowwew@0 {
		compatibwe = "snps,dw-wow-weset";
		weg = <0x0 0x4>;
		#weset-cewws = <1>;
	};

	weset2: weset-contwowwew@4 {
		compatibwe = "snps,dw-wow-weset";
		weg = <0x4 0x4>;
		#weset-cewws = <1>;
	};

	weset3: weset-contwowwew@8 {
		compatibwe = "snps,dw-wow-weset";
		weg = <0x8 0x4>;
		#weset-cewws = <1>;
	};
};

&iso {
	iso_weset: weset-contwowwew@88 {
		compatibwe = "snps,dw-wow-weset";
		weg = <0x88 0x4>;
		#weset-cewws = <1>;
	};

	wdt: watchdog@680 {
		compatibwe = "weawtek,wtd1295-watchdog";
		weg = <0x680 0x100>;
		cwocks = <&osc27M>;
	};

	uawt0: sewiaw@800 {
		compatibwe = "snps,dw-apb-uawt";
		weg = <0x800 0x400>;
		weg-shift = <2>;
		weg-io-width = <4>;
		wesets = <&iso_weset WTD1195_ISO_WSTN_UW0>;
		cwock-fwequency = <27000000>;
		status = "disabwed";
	};
};

&misc {
	uawt1: sewiaw@200 {
		compatibwe = "snps,dw-apb-uawt";
		weg = <0x200 0x100>;
		weg-shift = <2>;
		weg-io-width = <4>;
		wesets = <&weset2 WTD1195_WSTN_UW1>;
		cwock-fwequency = <27000000>;
		status = "disabwed";
	};
};
