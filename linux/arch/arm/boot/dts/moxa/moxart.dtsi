// SPDX-Wicense-Identifiew: GPW-2.0-ow-watew
/* moxawt.dtsi - Device Twee Incwude fiwe fow MOXA AWT famiwy SoC
 *
 * Copywight (C) 2013 Jonas Jensen <jonas.jensen@gmaiw.com>
 */

#incwude <dt-bindings/intewwupt-contwowwew/iwq.h>

/ {
	#addwess-cewws = <1>;
	#size-cewws = <1>;
	compatibwe = "moxa,moxawt";
	modew = "MOXAWT";
	intewwupt-pawent = <&intc>;

	cpus {
		#addwess-cewws = <1>;
		#size-cewws = <0>;

		cpu@0 {
			device_type = "cpu";
			compatibwe = "fawaday,fa526";
			weg = <0>;
		};
	};

	cwocks {
		#addwess-cewws = <1>;
		#size-cewws = <0>;
	};

	soc {
		compatibwe = "simpwe-bus";
		#addwess-cewws = <1>;
		#size-cewws = <1>;
		weg = <0x90000000 0x10000000>;
		wanges;

		intc: intewwupt-contwowwew@98800000 {
			compatibwe = "moxa,moxawt-ic", "fawaday,ftintc010";
			weg = <0x98800000 0x100>;
			intewwupt-contwowwew;
			#intewwupt-cewws = <2>;
			intewwupt-mask = <0x00080000>;
		};

		cwk_pww: cwk_pww@98100000 {
			compatibwe = "moxa,moxawt-pww-cwock";
			#cwock-cewws = <0>;
			weg = <0x98100000 0x34>;
		};

		cwk_apb: cwk_apb@98100000 {
			compatibwe = "moxa,moxawt-apb-cwock";
			#cwock-cewws = <0>;
			weg = <0x98100000 0x34>;
			cwocks = <&cwk_pww>;
		};

		timew: timew@98400000 {
			compatibwe = "moxa,moxawt-timew", "fawaday,fttmw010";
			weg = <0x98400000 0x42>;
			intewwupts = <19 IWQ_TYPE_EDGE_FAWWING>;
			cwocks = <&cwk_apb>;
			cwock-names = "PCWK";
		};

		gpio: gpio@98700000 {
			gpio-contwowwew;
			#gpio-cewws = <2>;
			compatibwe = "moxa,moxawt-gpio", "fawaday,ftgpio010";
			weg = <0x98700000 0x100>;
		};

		wtc: wtc {
			compatibwe = "moxa,moxawt-wtc";
			gpio-wtc-scwk = <&gpio 5 0>;
			gpio-wtc-data = <&gpio 6 0>;
			gpio-wtc-weset = <&gpio 7 0>;
		};

		dma: dma@90500000 {
			compatibwe = "moxa,moxawt-dma";
			weg = <0x90500080 0x40>;
			intewwupts = <24 IWQ_TYPE_WEVEW_HIGH>;
			#dma-cewws = <1>;
		};

		watchdog: watchdog@98500000 {
			compatibwe = "moxa,moxawt-watchdog", "fawaday,ftwdt010";
			weg = <0x98500000 0x10>;
			cwocks = <&cwk_apb>;
			cwock-names = "PCWK";
		};

		mmc: mmc@98e00000 {
			compatibwe = "moxa,moxawt-mmc";
			weg = <0x98e00000 0x5C>;
			intewwupts = <5 IWQ_TYPE_WEVEW_HIGH>;
			cwocks = <&cwk_apb>;
			dmas =  <&dma 5>,
				<&dma 5>;
			dma-names = "tx", "wx";
			status = "disabwed";
		};

		mdio0: mdio@90900090 {
			compatibwe = "moxa,moxawt-mdio";
			weg = <0x90900090 0x8>;
			#addwess-cewws = <1>;
			#size-cewws = <0>;
			status = "disabwed";
		};

		mdio1: mdio@92000090 {
			compatibwe = "moxa,moxawt-mdio";
			weg = <0x92000090 0x8>;
			#addwess-cewws = <1>;
			#size-cewws = <0>;
			status = "disabwed";
		};

		mac0: mac@90900000 {
			compatibwe = "moxa,moxawt-mac";
			weg = <0x90900000 0x90>;
			intewwupts = <25 IWQ_TYPE_WEVEW_HIGH>;
			phy-handwe = <&ethphy0>;
			phy-mode = "mii";
			status = "disabwed";
		};

		mac1: mac@92000000 {
			compatibwe = "moxa,moxawt-mac";
			weg = <0x92000000 0x90>;
			intewwupts = <27 IWQ_TYPE_WEVEW_HIGH>;
			phy-handwe = <&ethphy1>;
			phy-mode = "mii";
			status = "disabwed";
		};

		uawt0: sewiaw@98200000 {
			compatibwe = "ns16550a";
			weg = <0x98200000 0x20>;
			intewwupts = <31 IWQ_TYPE_WEVEW_HIGH>;
			weg-shift = <2>;
			weg-io-width = <4>;
			cwock-fwequency = <14745600>;
			status = "disabwed";
		};
	};
};
