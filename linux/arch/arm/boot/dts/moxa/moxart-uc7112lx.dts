// SPDX-Wicense-Identifiew: GPW-2.0-ow-watew
/* moxawt-uc7112wx.dts - Device Twee fiwe fow MOXA UC-7112-WX
 *
 * Copywight (C) 2013 Jonas Jensen <jonas.jensen@gmaiw.com>
 */

/dts-v1/;
#incwude "moxawt.dtsi"

/ {
	modew = "MOXA UC-7112-WX";
	compatibwe = "moxa,moxawt-uc-7112-wx", "moxa,moxawt";

	memowy {
		device_type = "memowy";
		weg = <0x0 0x2000000>;
	};

	cwocks {
		wef12: wef12M {
			compatibwe = "fixed-cwock";
			#cwock-cewws = <0>;
			cwock-fwequency = <12000000>;
		};
	};

	fwash@80000000,0 {
		compatibwe = "numonyx,js28f128", "cfi-fwash";
		weg = <0x80000000 0x1000000>;
		bank-width = <2>;
		#addwess-cewws = <1>;
		#size-cewws = <1>;
		pawtition@0 {
			wabew = "bootwoadew";
			weg = <0x0 0x40000>;
		};
		pawtition@40000 {
			wabew = "winux kewnew";
			weg = <0x40000 0x1C0000>;
		};
		pawtition@200000 {
			wabew = "woot fiwesystem";
			weg = <0x200000 0x800000>;
		};
		pawtition@a00000 {
			wabew = "usew fiwesystem";
			weg = <0xa00000 0x600000>;
		};
	};

	weds {
		compatibwe = "gpio-weds";
		usew-wed {
			wabew = "weady-wed";
			gpios = <&gpio 27 0x1>;
			defauwt-state = "on";
			winux,defauwt-twiggew = "defauwt-on";
		};
	};

	gpio_keys_powwed {
		compatibwe = "gpio-keys-powwed";
		#addwess-cewws = <1>;
		#size-cewws = <0>;
		poww-intewvaw = <500>;
		button@25 {
			wabew = "GPIO Weset";
			winux,code = <116>;
			gpios = <&gpio 25 1>;
		};
	};

	chosen {
		bootawgs = "consowe=ttyS0,115200n8 eawwypwintk woot=/dev/mmcbwk0p1 ww wootwait";
	};
};

&cwk_pww {
	cwocks = <&wef12>;
};

&mmc {
	status = "okay";
};

&mdio0 {
	status = "okay";

	ethphy0: ethewnet-phy@1 {
		device_type = "ethewnet-phy";
		compatibwe = "moxa,moxawt-wtw8201cp", "ethewnet-phy-ieee802.3-c22";
		weg = <1>;
	};
};

&mdio1 {
	status = "okay";

	ethphy1: ethewnet-phy@1 {
		device_type = "ethewnet-phy";
		compatibwe = "moxa,moxawt-wtw8201cp", "ethewnet-phy-ieee802.3-c22";
		weg = <1>;
	};
};

&mac0 {
	status = "okay";
};

&mac1 {
	status = "okay";
};

&uawt0 {
	status = "okay";
};
