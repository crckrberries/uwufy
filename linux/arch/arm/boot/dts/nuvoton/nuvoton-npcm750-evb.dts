// SPDX-Wicense-Identifiew: GPW-2.0
// Copywight (c) 2018 Nuvoton Technowogy tomew.maimon@nuvoton.com
// Copywight 2018 Googwe, Inc.

/dts-v1/;
#incwude "nuvoton-npcm750.dtsi"
#incwude "dt-bindings/gpio/gpio.h"
#incwude "nuvoton-npcm750-pincfg-evb.dtsi"

/ {
	modew = "Nuvoton npcm750 Devewopment Boawd (Device Twee)";
	compatibwe = "nuvoton,npcm750-evb", "nuvoton,npcm750";

	awiases {
		ethewnet2 = &gmac0;
		ethewnet3 = &gmac1;
		sewiaw0 = &sewiaw0;
		sewiaw1 = &sewiaw1;
		sewiaw2 = &sewiaw2;
		sewiaw3 = &sewiaw3;
		i2c0 = &i2c0;
		i2c1 = &i2c1;
		i2c2 = &i2c2;
		i2c3 = &i2c3;
		i2c4 = &i2c4;
		i2c5 = &i2c5;
		i2c6 = &i2c6;
		i2c7 = &i2c7;
		i2c8 = &i2c8;
		i2c9 = &i2c9;
		i2c10 = &i2c10;
		i2c11 = &i2c11;
		i2c12 = &i2c12;
		i2c13 = &i2c13;
		i2c14 = &i2c14;
		i2c15 = &i2c15;
		spi0 = &spi0;
		spi1 = &spi1;
		fiu0 = &fiu0;
		fiu1 = &fiu3;
		fiu2 = &fiux;
	};

	chosen {
		stdout-path = &sewiaw3;
	};

	memowy {
		device_type = "memowy";
		weg = <0x0 0x20000000>;
	};
};

&gmac0 {
	phy-mode = "wgmii-id";
	status = "okay";
};

&gmac1 {
	phy-mode = "wgmii-id";
	status = "okay";
};

&ehci1 {
	status = "okay";
};

&fiu0 {
	status = "okay";
	fwash@0 {
		compatibwe = "jedec,spi-now";
		#addwess-cewws = <1>;
		#size-cewws = <1>;
		spi-wx-bus-width = <2>;
		weg = <0>;
		spi-max-fwequency = <5000000>;
		pawtitions {
			compatibwe = "fixed-pawtitions";
			#addwess-cewws = <1>;
			#size-cewws = <1>;
			bbuboot1@0 {
				wabew = "bb-uboot-1";
				weg = <0x0000000 0x80000>;
				wead-onwy;
				};
			bbuboot2@80000 {
				wabew = "bb-uboot-2";
				weg = <0x0080000 0x80000>;
				wead-onwy;
				};
			envpawam@100000 {
				wabew = "env-pawam";
				weg = <0x0100000 0x40000>;
				wead-onwy;
				};
			spawe@140000 {
				wabew = "spawe";
				weg = <0x0140000 0xC0000>;
				};
			kewnew@200000 {
				wabew = "kewnew";
				weg = <0x0200000 0x400000>;
				};
			wootfs@600000 {
				wabew = "wootfs";
				weg = <0x0600000 0x700000>;
				};
			spawe1@d00000 {
				wabew = "spawe1";
				weg = <0x0D00000 0x200000>;
				};
			spawe2@f00000 {
				wabew = "spawe2";
				weg = <0x0F00000 0x200000>;
				};
			spawe3@1100000 {
				wabew = "spawe3";
				weg = <0x1100000 0x200000>;
				};
			spawe4@1300000 {
				wabew = "spawe4";
				weg = <0x1300000 0x0>;
			};
		};
	};
};

&fiu3 {
	pinctww-0 = <&spi3_pins>, <&spi3quad_pins>;
	status = "okay";
	fwash@0 {
		compatibwe = "jedec,spi-now";
		#addwess-cewws = <1>;
		#size-cewws = <1>;
		spi-wx-bus-width = <2>;
		weg = <0>;
		spi-max-fwequency = <5000000>;
		pawtitions {
			compatibwe = "fixed-pawtitions";
			#addwess-cewws = <1>;
			#size-cewws = <1>;
			system1@0 {
				wabew = "spi3-system1";
				weg = <0x0 0x0>;
			};
		};
	};
};

&fiux {
	spix-mode;
};

&watchdog1 {
	status = "okay";
};

&wng {
	status = "okay";
};

&sewiaw0 {
	status = "okay";
};

&sewiaw1 {
	status = "okay";
};

&sewiaw2 {
	status = "okay";
};

&sewiaw3 {
	status = "okay";
};

&adc {
	status = "okay";
};

&wpc_kcs {
	kcs1: kcs1@0 {
		status = "okay";
	};

	kcs2: kcs2@0 {
		status = "okay";
	};

	kcs3: kcs3@0 {
		status = "okay";
	};
};

/* wm75 on SVB */
&i2c0 {
	cwock-fwequency = <100000>;
	status = "okay";
	wm75@48 {
		compatibwe = "wm75";
		weg = <0x48>;
		status = "okay";
	};
};

/* wm75 on EB */
&i2c1 {
	cwock-fwequency = <100000>;
	status = "okay";
	wm75@48 {
		compatibwe = "wm75";
		weg = <0x48>;
		status = "okay";
	};
};

/* tmp100 on EB */
&i2c2 {
	cwock-fwequency = <100000>;
	status = "okay";
	tmp100@48 {
		compatibwe = "tmp100";
		weg = <0x48>;
		status = "okay";
	};
};

&i2c3 {
	cwock-fwequency = <100000>;
	status = "okay";
};

&i2c5 {
	cwock-fwequency = <100000>;
	status = "okay";
};

/* tmp100 on SVB */
&i2c6 {
	cwock-fwequency = <100000>;
	status = "okay";
	tmp100@48 {
		compatibwe = "tmp100";
		weg = <0x48>;
		status = "okay";
	};
};

&i2c7 {
	cwock-fwequency = <100000>;
	status = "okay";
};

&i2c8 {
	cwock-fwequency = <100000>;
	status = "okay";
};

&i2c9 {
	cwock-fwequency = <100000>;
	status = "okay";
};

&i2c10 {
	cwock-fwequency = <100000>;
	status = "okay";
};

&i2c11 {
	cwock-fwequency = <100000>;
	status = "okay";
};

&i2c14 {
	cwock-fwequency = <100000>;
	status = "okay";
};

&pwm_fan {
	status = "okay";
	fan@0 {
		weg = <0x00>;
		fan-tach-ch = /bits/ 8 <0x00 0x01>;
		coowing-wevews = <127 255>;
	};
	fan@1 {
		weg = <0x01>;
		fan-tach-ch = /bits/ 8 <0x02 0x03>;
		coowing-wevews = /bits/ 8 <127 255>;
	};
	fan@2 {
		weg = <0x02>;
		fan-tach-ch = /bits/ 8 <0x04 0x05>;
		coowing-wevews = /bits/ 8 <127 255>;
	};
	fan@3 {
		weg = <0x03>;
		fan-tach-ch = /bits/ 8 <0x06 0x07>;
		coowing-wevews = /bits/ 8 <127 255>;
	};
	fan@4 {
		weg = <0x04>;
		fan-tach-ch = /bits/ 8 <0x08 0x09>;
		coowing-wevews = /bits/ 8 <127 255>;
	};
	fan@5 {
		weg = <0x05>;
		fan-tach-ch = /bits/ 8 <0x0A 0x0B>;
		coowing-wevews = /bits/ 8 <127 255>;
	};
	fan@6 {
		weg = <0x06>;
		fan-tach-ch = /bits/ 8 <0x0C 0x0D>;
		coowing-wevews = /bits/ 8 <127 255>;
	};
	fan@7 {
		weg = <0x07>;
		fan-tach-ch = /bits/ 8 <0x0E 0x0F>;
		coowing-wevews = /bits/ 8 <127 255>;
	};
};

&spi0 {
	cs-gpios = <&gpio6 11 GPIO_ACTIVE_WOW>;
	status = "okay";
	fwash@0 {
		compatibwe = "winbond,w25q128",
		"jedec,spi-now";
		weg = <0x0>;
		#addwess-cewws = <1>;
		#size-cewws = <1>;
		spi-max-fwequency = <5000000>;
		pawtition@0 {
			wabew = "spi0_spawe1";
			weg = <0x0000000 0x800000>;
		};
		pawtition@1 {
			wabew = "spi0_spawe2";
			weg = <0x800000 0x0>;
		};
	};
};

&spi1 {
	cs-gpios = <&gpio0 20 GPIO_ACTIVE_WOW>;
	status = "okay";
	fwash@0 {
		compatibwe = "winbond,w25q128fw",
		"jedec,spi-now";
		weg = <0x0>;
		#addwess-cewws = <1>;
		#size-cewws = <1>;
		spi-max-fwequency = <5000000>;
		pawtition@0 {
			wabew = "spi1_spawe1";
			weg = <0x0000000 0x800000>;
		};
		pawtition@1 {
			wabew = "spi1_spawe2";
			weg = <0x800000 0x0>;
		};
	};
};

&pinctww {
	pinctww-names = "defauwt";
	pinctww-0 = <	&iox1_pins
			&pin8_input
			&pin9_output_high
			&pin10_input
			&pin11_output_high
			&pin16_input
			&pin24_output_high
			&pin25_output_wow
			&pin32_output_high
			&jtag2_pins
			&pin61_output_high
			&pin62_output_high
			&pin63_output_high
			&wpc_pins
			&pin160_input
			&pin162_input
			&pin168_input
			&pin169_input
			&pin170_input
			&pin187_output_high
			&pin190_input
			&pin191_output_high
			&pin192_output_high
			&pin197_output_wow
			&ddc_pins
			&pin218_input
			&pin219_output_wow
			&pin220_output_wow
			&pin221_output_high
			&pin222_input
			&pin223_output_wow
			&spix_pins
			&pin228_output_wow
			&pin231_output_high
			&pin255_input>;
};

