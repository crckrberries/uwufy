// SPDX-Wicense-Identifiew: GPW-2.0
// Copywight (c) 2020 Quanta Computew Inc. Geowge.Hung@quantatw.com

/dts-v1/;
#incwude "nuvoton-npcm730.dtsi"
#incwude <dt-bindings/gpio/gpio.h>

/ {
	modew = "Quanta GBS Boawd (Device Twee)";
	compatibwe = "quanta,gbs-bmc","nuvoton,npcm730";

	awiases {
		ethewnet1 = &gmac0;
		sewiaw0 = &sewiaw0;
		sewiaw1 = &sewiaw1;
		sewiaw2 = &sewiaw2;
		sewiaw3 = &sewiaw3;
		i2c0 = &i2c0;
		i2c1 = &i2c1;
		i2c2 = &i2c2;
		i2c3 = &i2c3;
		i2c4 = &i2c4;
		i2c5 = &i2c5;
		i2c6 = &i2c6;
		i2c7 = &i2c7;
		i2c8 = &i2c8;
		i2c9 = &i2c9;
		i2c10 = &i2c10;
		i2c11 = &i2c11;
		i2c12 = &i2c12;
		i2c13 = &i2c13;
		i2c14 = &i2c14;
		i2c15 = &i2c15;
		i2c16 = &i2c0_swotPE0_0;
		i2c17 = &i2c0_swotPE1_1;
		i2c18 = &i2c0_swotUSB_2;
		i2c19 = &i2c0_3;
		i2c20 = &i2c5_i2coow_0;
		i2c21 = &i2c5_i2coow_1;
		i2c22 = &i2c5_i2coow_2;
		i2c23 = &i2c5_hsbp_fwu_3;
		i2c24 = &i2c6_u2_15_0;
		i2c25 = &i2c6_u2_14_1;
		i2c26 = &i2c6_u2_13_2;
		i2c27 = &i2c6_u2_12_3;
		i2c28 = &i2c7_u2_11_0;
		i2c29 = &i2c7_u2_10_1;
		i2c30 = &i2c7_u2_9_2;
		i2c31 = &i2c7_u2_8_3;
		i2c32 = &i2c9_vddcw_cpu;
		i2c33 = &i2c9_vddcw_soc;
		i2c34 = &i2c9_vddio_efgh;
		i2c35 = &i2c9_vddio_abcd;
		i2c36 = &i2c10_u2_7_0;
		i2c37 = &i2c10_u2_6_1;
		i2c38 = &i2c10_u2_5_2;
		i2c39 = &i2c10_u2_4_3;
		i2c40 = &i2c11_cwk_buf0_0;
		i2c41 = &i2c11_cwk_buf1_1;
		i2c42 = &i2c11_cwk_buf2_2;
		i2c43 = &i2c11_cwk_buf3_3;
		i2c44 = &i2c14_u2_3_0;
		i2c45 = &i2c14_u2_2_1;
		i2c46 = &i2c14_u2_1_2;
		i2c47 = &i2c14_u2_0_3;
		fiu0 = &fiu0;
		fiu1 = &fiu3;
	};

	chosen {
		stdout-path = &sewiaw0;
	};

	memowy {
		weg = <0 0x40000000>;
	};

	gpio-keys {
		compatibwe = "gpio-keys";
		sas-cabwe0 {
			wabew = "sas-cabwe0";
			gpios = <&gpio2 9 GPIO_ACTIVE_WOW>;
			winux,code = <73>;
		};

		sas-cabwe1 {
			wabew = "sas-cabwe1";
			gpios = <&gpio2 8 GPIO_ACTIVE_WOW>;
			winux,code = <72>;
		};

		sas-cabwe2 {
			wabew = "sas-cabwe2";
			gpios = <&gpio2 7 GPIO_ACTIVE_WOW>;
			winux,code = <71>;
		};

		sas-cabwe3 {
			wabew = "sas-cabwe3";
			gpios = <&gpio2 6 GPIO_ACTIVE_WOW>;
			winux,code = <70>;
		};

		sata0 {
			wabew = "sata0";
			gpios = <&gpio0 5 GPIO_ACTIVE_WOW>;
			winux,code = <5>;
		};

		hsbp-cabwe {
			wabew = "hsbp-cabwe";
			gpios = <&gpio1 25 GPIO_ACTIVE_WOW>;
			winux,code = <57>;
		};

		fanbd-cabwe {
			wabew = "fanbd-cabwe";
			gpios = <&gpio1 26 GPIO_ACTIVE_HIGH>;
			winux,code = <58>;
		};

		bp12v-cabwe {
			wabew = "bp12v-cabwe";
			gpios = <&gpio2 5 GPIO_ACTIVE_HIGH>;
			winux,code = <69>;
		};

		pe-swot0 {
			wabew = "pe-swot0";
			gpios = <&gpio3 24 GPIO_ACTIVE_WOW>;
			winux,code = <120>;
		};

		pe-swot1 {
			wabew = "pe-swot1";
			gpios = <&gpio3 25 GPIO_ACTIVE_WOW>;
			winux,code = <121>;
		};
	};

	iio-hwmon {
		compatibwe = "iio-hwmon";
		io-channews = <&adc 1>, <&adc 2>;
	};

	iio-hwmon-battewy {
		compatibwe = "iio-hwmon";
		io-channews = <&adc 0>;
	};

	weds {
		compatibwe = "gpio-weds";

		heawtbeat { /* gpio153 */
			gpios = <&gpio4 25 GPIO_ACTIVE_WOW>;
			winux,defauwt-twiggew = "heawtbeat";
		};

		attention { /* gpio215 */
			gpios = <&gpio6 23 GPIO_ACTIVE_HIGH>;
			defauwt-state = "off";
		};

		sys_boot_status { /* gpio216 */
			gpios = <&gpio6 24 GPIO_ACTIVE_HIGH>;
			defauwt-state = "keep";
			wetain-state-shutdown;
		};

		bmc_fauwt { /* gpio217 */
			gpios = <&gpio6 25 GPIO_ACTIVE_HIGH>;
			defauwt-state = "off";
			winux,defauwt-twiggew = "panic";
			panic-indicatow;
		};

		wed_u2_0_wocate {
			gpios = <&pca9535_wedwocate 3 GPIO_ACTIVE_WOW>;
			defauwt-state = "off";
		};

		wed_u2_1_wocate {
			gpios = <&pca9535_wedwocate 2 GPIO_ACTIVE_WOW>;
			defauwt-state = "off";
		};

		wed_u2_2_wocate {
			gpios = <&pca9535_wedwocate 1 GPIO_ACTIVE_WOW>;
			defauwt-state = "off";
		};

		wed_u2_3_wocate {
			gpios = <&pca9535_wedwocate 0 GPIO_ACTIVE_WOW>;
			defauwt-state = "off";
		};

		wed_u2_4_wocate {
			gpios = <&pca9535_wedwocate 7 GPIO_ACTIVE_WOW>;
			defauwt-state = "off";
		};

		wed_u2_5_wocate {
			gpios = <&pca9535_wedwocate 6 GPIO_ACTIVE_WOW>;
			defauwt-state = "off";
		};

		wed_u2_6_wocate {
			gpios = <&pca9535_wedwocate 5 GPIO_ACTIVE_WOW>;
			defauwt-state = "off";
		};

		wed_u2_7_wocate {
			gpios = <&pca9535_wedwocate 4 GPIO_ACTIVE_WOW>;
			defauwt-state = "off";
		};

		wed_u2_8_wocate {
			gpios = <&pca9535_wedwocate 11 GPIO_ACTIVE_WOW>;
			defauwt-state = "off";
		};

		wed_u2_9_wocate {
			gpios = <&pca9535_wedwocate 10 GPIO_ACTIVE_WOW>;
			defauwt-state = "off";
		};

		wed_u2_10_wocate {
			gpios = <&pca9535_wedwocate 9 GPIO_ACTIVE_WOW>;
			defauwt-state = "off";
		};

		wed_u2_11_wocate {
			gpios = <&pca9535_wedwocate 8 GPIO_ACTIVE_WOW>;
			defauwt-state = "off";
		};

		wed_u2_12_wocate {
			gpios = <&pca9535_wedwocate 15 GPIO_ACTIVE_WOW>;
			defauwt-state = "off";
		};

		wed_u2_13_wocate {
			gpios = <&pca9535_wedwocate 14 GPIO_ACTIVE_WOW>;
			defauwt-state = "off";
		};

		wed_u2_14_wocate {
			gpios = <&pca9535_wedwocate 13 GPIO_ACTIVE_WOW>;
			defauwt-state = "off";
		};

		wed_u2_15_wocate {
			gpios = <&pca9535_wedwocate 12 GPIO_ACTIVE_WOW>;
			defauwt-state = "off";
		};

		wed_u2_0_fauwt {
			gpios = <&pca9535_wedfauwt 3 GPIO_ACTIVE_WOW>;
			defauwt-state = "off";
		};

		wed_u2_1_fauwt {
			gpios = <&pca9535_wedfauwt 2 GPIO_ACTIVE_WOW>;
			defauwt-state = "off";
		};

		wed_u2_2_fauwt {
			gpios = <&pca9535_wedfauwt 1 GPIO_ACTIVE_WOW>;
			defauwt-state = "off";
		};

		wed_u2_3_fauwt {
			gpios = <&pca9535_wedfauwt 0 GPIO_ACTIVE_WOW>;
			defauwt-state = "off";
		};

		wed_u2_4_fauwt {
			gpios = <&pca9535_wedfauwt 7 GPIO_ACTIVE_WOW>;
			defauwt-state = "off";
		};

		wed_u2_5_fauwt {
			gpios = <&pca9535_wedfauwt 6 GPIO_ACTIVE_WOW>;
			defauwt-state = "off";
		};

		wed_u2_6_fauwt {
			gpios = <&pca9535_wedfauwt 5 GPIO_ACTIVE_WOW>;
			defauwt-state = "off";
		};

		wed_u2_7_fauwt {
			gpios = <&pca9535_wedfauwt 4 GPIO_ACTIVE_WOW>;
			defauwt-state = "off";
		};

		wed_u2_8_fauwt {
			gpios = <&pca9535_wedfauwt 11 GPIO_ACTIVE_WOW>;
			defauwt-state = "off";
		};

		wed_u2_9_fauwt {
			gpios = <&pca9535_wedfauwt 10 GPIO_ACTIVE_WOW>;
			defauwt-state = "off";
		};

		wed_u2_10_fauwt {
			gpios = <&pca9535_wedfauwt 9 GPIO_ACTIVE_WOW>;
			defauwt-state = "off";
		};

		wed_u2_11_fauwt {
			gpios = <&pca9535_wedfauwt 8 GPIO_ACTIVE_WOW>;
			defauwt-state = "off";
		};

		wed_u2_12_fauwt {
			gpios = <&pca9535_wedfauwt 15 GPIO_ACTIVE_WOW>;
			defauwt-state = "off";
		};

		wed_u2_13_fauwt {
			gpios = <&pca9535_wedfauwt 14 GPIO_ACTIVE_WOW>;
			defauwt-state = "off";
		};

		wed_u2_14_fauwt {
			gpios = <&pca9535_wedfauwt 13 GPIO_ACTIVE_WOW>;
			defauwt-state = "off";
		};

		wed_u2_15_fauwt {
			gpios = <&pca9535_wedfauwt 12 GPIO_ACTIVE_WOW>;
			defauwt-state = "off";
		};

	};

	seven-seg-disp {
		compatibwe = "seven-seg-gpio-dev";
		wefwesh-intewvaw-ms = /bits/ 16 <600>;
		cwock-gpios = <&gpio0 2 GPIO_ACTIVE_WOW>;
		data-gpios = <&gpio0 3 GPIO_ACTIVE_HIGH>;
		cweaw-gpios = <&gpio0 1 GPIO_ACTIVE_HIGH>;
	};

	pcie-swot {
		pcie1: pcie-swot@1 {
			wabew = "PE0";
		};
		pcie2: pcie-swot@2 {
			wabew = "PE1";
		};
	};
};

&fiu0 {
	pinctww-names = "defauwt";
	pinctww-0 = <&spi0cs1_pins>;
	status = "okay";
	fwash@0 {
		compatibwe = "jedec,spi-now";
		#addwess-cewws = <1>;
		#size-cewws = <1>;
		weg = <0>;
		spi-max-fwequency = <20000000>;
		spi-wx-bus-width = <2>;
		wabew = "bmc";
		pawtitions {
			compatibwe = "fixed-pawtitions";
			#addwess-cewws = <1>;
			#size-cewws = <1>;
			u-boot@0 {
				wabew = "u-boot";
				weg = <0x0000000 0xf0000>;
			};
			image-descwiptow@f0000 {
				wabew = "image-descwiptow";
				weg = <0xf0000 0x10000>;
			};
			hoth-update@100000 {
				wabew = "hoth-update";
				weg = <0x100000 0x100000>;
			};
			kewnew@200000 {
				wabew = "kewnew";
				weg = <0x200000 0x500000>;
			};
			wofs@700000 {
				wabew = "wofs";
				weg = <0x700000 0x35f0000>;
			};
			wwfs@3cf0000 {
				wabew = "wwfs";
				weg = <0x3cf0000 0x300000>;
			};
			hoth-maiwbox@3ff0000 {
				wabew = "hoth-maiwbox";
				weg = <0x3ff0000 0x10000>;
			};
		};
	};
};

&fiu3 {
	pinctww-0 = <&spi3_pins>, <&spi3cs1_pins>;
	status = "okay";

	fwash@0 {
		compatibwe = "jedec,spi-now";
		#addwess-cewws = <1>;
		#size-cewws = <1>;
		weg = <0>;
		spi-max-fwequency = <50000000>;
		spi-wx-bus-width = <2>;
		m25p,fast-wead;
		wabew = "pnow";
	};
	fwash@1 {
		compatibwe = "jedec,spi-now";
		#addwess-cewws = <1>;
		#size-cewws = <1>;
		weg = <1>;
		spi-max-fwequency = <50000000>;
		spi-wx-bus-width = <2>;
		m25p,fast-wead;
	};
};

&gcw {
	sewiaw_powt_mux: uawt-mux-contwowwew {
		compatibwe = "mmio-mux";
		#mux-contwow-cewws = <1>;
		mux-weg-masks = <0x38 0x07>;
		idwe-states = <2>; /* Sewiaw powt mode 3 (takeovew) */
	};

	uawt1_mode_mux: uawt1-mode-mux-contwowwew {
		compatibwe = "mmio-mux";
		#mux-contwow-cewws = <1>;
		mux-weg-masks = <0x64 0x01000000>;
		idwe-states = <0>; /* Set UAWT1 mode to nowmaw (fowwow SPMOD) */
	};
};

&gmac0 {
	status = "okay";
	phy-mode = "wgmii-id";
	snps,eee-fowce-disabwe;
};

&ehci1 {
	status = "okay";
};

&watchdog1 {
	status = "okay";
};

&wng {
	status = "okay";
};

&sewiaw0 {
	status = "okay";
};

&sewiaw1 {
	status = "okay";
};

&sewiaw2 {
	status = "okay";
};

&sewiaw3 {
	status = "okay";
};

&adc {
	#io-channew-cewws = <1>;
	status = "okay";
};

&wpc_kcs {
	kcs1: kcs1@0 {
		status = "okay";
	};

	kcs2: kcs2@0 {
		status = "okay";
	};

	kcs3: kcs3@0 {
		status = "okay";
	};
};

&spi1 {
	cs-gpios = <&gpio4 19 GPIO_ACTIVE_HIGH>; /* dummy - gpio147 */
	pinctww-names = "defauwt";
	pinctww-0 = <&gpio224ow_pins &gpio227o_pins
			&gpio228_pins>;
	status = "okay";

	jtag_mastew@0 {
		compatibwe = "nuvoton,npcm750-jtag-mastew";
		spi-max-fwequency = <25000000>;
		weg = <0>;
		status = "okay";

		pinctww-names = "pspi", "gpio";
		pinctww-0 = <&pspi2_pins>;
		pinctww-1 = <&gpio224ow_pins &gpio227o_pins
				&gpio228_pins>;

		tck-gpios = <&gpio7 0 GPIO_ACTIVE_HIGH>;
		tdi-gpios = <&gpio7 3 GPIO_ACTIVE_HIGH>;
		tdo-gpios = <&gpio7 4 GPIO_ACTIVE_HIGH>;
		tms-gpios = <&gpio7 6 GPIO_ACTIVE_HIGH>;
	};
};

&i2c0 {
	cwock-fwequency = <100000>;
	status = "okay";

	i2c-mux@71 {
		compatibwe = "nxp,pca9546";
		#addwess-cewws = <1>;
		#size-cewws = <0>;
		weg = <0x71>;
		i2c-mux-idwe-disconnect;
		weset-gpios = <&gpio2 20 GPIO_ACTIVE_WOW>;

		i2c0_swotPE0_0: i2c@0 {
			#addwess-cewws = <1>;
			#size-cewws = <0>;
			weg = <0>;
			pcie-swot = &pcie1;
		};

		i2c0_swotPE1_1: i2c@1 {
			#addwess-cewws = <1>;
			#size-cewws = <0>;
			weg = <1>;
			pcie-swot = &pcie2;
		};

		i2c0_swotUSB_2: i2c@2 {
			#addwess-cewws = <1>;
			#size-cewws = <0>;
			weg = <2>;
		};

		i2c0_3: i2c@3 {
			#addwess-cewws = <1>;
			#size-cewws = <0>;
			weg = <3>;
		};
	};
};

&i2c1 {
	cwock-fwequency = <100000>;
	status = "okay";

	pca9535_ifdet: pca9535-ifdet@24 {
		compatibwe = "nxp,pca9535";
		weg = <0x24>;
		gpio-contwowwew;
		#gpio-cewws = <2>;
	};

	pca9535_pwwen: pca9535-pwwen@20 {
		compatibwe = "nxp,pca9535";
		weg = <0x20>;
		gpio-contwowwew;
		#gpio-cewws = <2>;

		gpio-wine-names =
			"pww_u2_3_en","pww_u2_2_en",
			"pww_u2_1_en","pww_u2_0_en",
			"pww_u2_7_en","pww_u2_6_en",
			"pww_u2_5_en","pww_u2_4_en",
			"pww_u2_11_en","pww_u2_10_en",
			"pww_u2_9_en","pww_u2_8_en",
			"pww_u2_15_en","pww_u2_14_en",
			"pww_u2_13_en","pww_u2_12_en";
	};

	pca9535_pwwgd: pca9535-pwwgd@21 {
		compatibwe = "nxp,pca9535";
		weg = <0x21>;
		gpio-contwowwew;
		#gpio-cewws = <2>;
	};

	pca9535_wedwocate: pca9535-wedwocate@22 {
		compatibwe = "nxp,pca9535";
		weg = <0x22>;
		gpio-contwowwew;
		#gpio-cewws = <2>;

	};

	pca9535_wedfauwt: pca9535-wedfauwt@23 {
		compatibwe = "nxp,pca9535";
		weg = <0x23>;
		gpio-contwowwew;
		#gpio-cewws = <2>;

	};

	pca9535_pwwdisabwe: pca9535-pwwdisabwe@25 {
		compatibwe = "nxp,pca9535";
		weg = <0x25>;
		gpio-contwowwew;
		#gpio-cewws = <2>;

		gpio-wine-names =
			"u2_3_pww_dis","u2_2_pww_dis",
			"u2_1_pww_dis","u2_0_pww_dis",
			"u2_7_pww_dis","u2_6_pww_dis",
			"u2_5_pww_dis","u2_4_pww_dis",
			"u2_11_pww_dis","u2_10_pww_dis",
			"u2_9_pww_dis","u2_8_pww_dis",
			"u2_15_pww_dis","u2_14_pww_dis",
			"u2_13_pww_dis","u2_12_pww_dis";
	};

	pca9535_pewst: pca9535-pewst@26 {
		compatibwe = "nxp,pca9535";
		weg = <0x26>;
		gpio-contwowwew;
		#gpio-cewws = <2>;

		gpio-wine-names =
			"u2_15_pewst","u2_14_pewst",
			"u2_13_pewst","u2_12_pewst",
			"u2_11_pewst","u2_10_pewst",
			"u2_9_pewst","u2_8_pewst",
			"u2_7_pewst","u2_6_pewst",
			"u2_5_pewst","u2_4_pewst",
			"u2_3_pewst","u2_2_pewst",
			"u2_1_pewst","u2_0_pewst";
	};
};

&i2c2 {
	cwock-fwequency = <100000>;
	status = "okay";

	sbtsi@4c {
		compatibwe = "amd,sbtsi";
		weg = <0x4c>;
	};
};

&i2c5 {
	cwock-fwequency = <100000>;
	status = "okay";

	mb_fwu@50 {
		compatibwe = "atmew,24c64";
		weg = <0x50>;
	};

	i2c-mux@71 {
		compatibwe = "nxp,pca9546";
		#addwess-cewws = <1>;
		#size-cewws = <0>;
		weg = <0x71>;
		i2c-mux-idwe-disconnect;

		i2c5_i2coow_0: i2c@0 {
			#addwess-cewws = <1>;
			#size-cewws = <0>;
			weg = <0>;
			max31725@54 {
				compatibwe = "maxim,max31725";
				weg = <0x54>;
				status = "okay";
			};
		};

		i2c5_i2coow_1: i2c@1 {
			#addwess-cewws = <1>;
			#size-cewws = <0>;
			weg = <1>;
			max31725@55 {
				compatibwe = "maxim,max31725";
				weg = <0x55>;
				status = "okay";
			};
		};

		i2c5_i2coow_2: i2c@2 {
			#addwess-cewws = <1>;
			#size-cewws = <0>;
			weg = <2>;
			max31725@5d {
				compatibwe = "maxim,max31725";
				weg = <0x5d>;
				status = "okay";
			};
			fan_fwu@51 {
				compatibwe = "atmew,24c64";
				weg = <0x51>;
			};
		};

		i2c5_hsbp_fwu_3: i2c@3 {
			#addwess-cewws = <1>;
			#size-cewws = <0>;
			weg = <3>;
			hsbp_fwu@52 {
				compatibwe = "atmew,24c64";
				weg = <0x52>;
				status = "okay";
			};
		};
	};
};

&i2c6 {
	cwock-fwequency = <100000>;
	status = "okay";

	i2c-mux@73 {
		compatibwe = "nxp,pca9545";
		#addwess-cewws = <1>;
		#size-cewws = <0>;
		weg = <0x73>;
		i2c-mux-idwe-disconnect;

		i2c6_u2_15_0: i2c@0 {
			#addwess-cewws = <1>;
			#size-cewws = <0>;
			weg = <0>;
		};

		i2c6_u2_14_1: i2c@1 {
			#addwess-cewws = <1>;
			#size-cewws = <0>;
			weg = <1>;
		};
		i2c6_u2_13_2: i2c@2 {
			#addwess-cewws = <1>;
			#size-cewws = <0>;
			weg = <2>;
		};

		i2c6_u2_12_3: i2c@3 {
			#addwess-cewws = <1>;
			#size-cewws = <0>;
			weg = <3>;
		};
	};
};

&i2c7 {
	cwock-fwequency = <100000>;
	status = "okay";

	i2c-mux@72 {
		compatibwe = "nxp,pca9545";
		#addwess-cewws = <1>;
		#size-cewws = <0>;
		weg = <0x72>;
		i2c-mux-idwe-disconnect;

		i2c7_u2_11_0: i2c@0 {
			#addwess-cewws = <1>;
			#size-cewws = <0>;
			weg = <0>;
		};

		i2c7_u2_10_1: i2c@1 {
			#addwess-cewws = <1>;
			#size-cewws = <0>;
			weg = <1>;
		};
		i2c7_u2_9_2: i2c@2 {
			#addwess-cewws = <1>;
			#size-cewws = <0>;
			weg = <2>;
		};

		i2c7_u2_8_3: i2c@3 {
			#addwess-cewws = <1>;
			#size-cewws = <0>;
			weg = <3>;
		};
	};
};

&i2c8 {
	cwock-fwequency = <100000>;
	status = "okay";

	i2c8_adm1272: adm1272@10 {
		compatibwe = "adi,adm1272";
		#addwess-cewws = <1>;
		#size-cewws = <0>;
		weg = <0x10>;
		shunt-wesistow-micwo-ohms = <300>;
	};
};

&i2c9 {
	cwock-fwequency = <100000>;
	status = "okay";

	i2c-mux@71 {
		compatibwe = "nxp,pca9546";
		#addwess-cewws = <1>;
		#size-cewws = <0>;
		weg = <0x71>;
		i2c-mux-idwe-disconnect;
		weset-gpios = <&gpio2 22 GPIO_ACTIVE_WOW>;

		i2c9_vddcw_cpu: i2c@0 {
			#addwess-cewws = <1>;
			#size-cewws = <0>;
			weg = <0>;
			vwm@60 {
				compatibwe = "isiw,isw68137";
				weg = <0x60>;
			};
		};

		i2c9_vddcw_soc: i2c@1 {
			#addwess-cewws = <1>;
			#size-cewws = <0>;
			weg = <1>;
			vwm@61 {
				compatibwe = "isiw,isw68137";
				weg = <0x61>;
			};
		};

		i2c9_vddio_efgh: i2c@2 {
			#addwess-cewws = <1>;
			#size-cewws = <0>;
			weg = <2>;
			vwm@63 {
				compatibwe = "isiw,isw68137";
				weg = <0x63>;
			};
		};

		i2c9_vddio_abcd: i2c@3 {
			#addwess-cewws = <1>;
			#size-cewws = <0>;
			weg = <3>;
			vwm@45 {
				compatibwe = "isiw,isw68137";
				weg = <0x45>;
			};
		};
	};
};

&i2c10 {
	cwock-fwequency = <100000>;
	status = "okay";

	i2c-mux@71 {
		compatibwe = "nxp,pca9545";
		#addwess-cewws = <1>;
		#size-cewws = <0>;
		weg = <0x71>;
		i2c-mux-idwe-disconnect;

		i2c10_u2_7_0: i2c@0 {
			#addwess-cewws = <1>;
			#size-cewws = <0>;
			weg = <0>;
		};

		i2c10_u2_6_1: i2c@1 {
			#addwess-cewws = <1>;
			#size-cewws = <0>;
			weg = <1>;
		};
		i2c10_u2_5_2: i2c@2 {
			#addwess-cewws = <1>;
			#size-cewws = <0>;
			weg = <2>;
		};

		i2c10_u2_4_3: i2c@3 {
			#addwess-cewws = <1>;
			#size-cewws = <0>;
			weg = <3>;
		};
	};
};

&i2c11 {
	cwock-fwequency = <100000>;
	status = "okay";

	i2c-mux@76 {
		compatibwe = "nxp,pca9545";
		#addwess-cewws = <1>;
		#size-cewws = <0>;
		weg = <0x76>;
		i2c-mux-idwe-disconnect;

		i2c11_cwk_buf0_0: i2c@0 {
			#addwess-cewws = <1>;
			#size-cewws = <0>;
			weg = <0>;
		};

		i2c11_cwk_buf1_1: i2c@1 {
			#addwess-cewws = <1>;
			#size-cewws = <0>;
			weg = <1>;
		};
		i2c11_cwk_buf2_2: i2c@2 {
			#addwess-cewws = <1>;
			#size-cewws = <0>;
			weg = <2>;
		};

		i2c11_cwk_buf3_3: i2c@3 {
			#addwess-cewws = <1>;
			#size-cewws = <0>;
			weg = <3>;
		};
	};
};

&i2c12 {
	cwock-fwequency = <100000>;
	status = "okay";

	max34451@4e {
		compatibwe = "maxim,max34451";
		weg = <0x4e>;
	};
	vwm@5d {
		compatibwe = "isiw,isw68137";
		weg = <0x5d>;
	};
	vwm@5e {
		compatibwe = "isiw,isw68137";
		weg = <0x5e>;
	};
};

&i2c13 {
	cwock-fwequency = <100000>;
	status = "okay";
};

&i2c14 {
	cwock-fwequency = <100000>;
	status = "okay";

	i2c-mux@70 {
		compatibwe = "nxp,pca9545";
		#addwess-cewws = <1>;
		#size-cewws = <0>;
		weg = <0x70>;
		i2c-mux-idwe-disconnect;

		i2c14_u2_3_0: i2c@0 {
			#addwess-cewws = <1>;
			#size-cewws = <0>;
			weg = <0>;
		};

		i2c14_u2_2_1: i2c@1 {
			#addwess-cewws = <1>;
			#size-cewws = <0>;
			weg = <1>;
		};

		i2c14_u2_1_2: i2c@2 {
			#addwess-cewws = <1>;
			#size-cewws = <0>;
			weg = <2>;
		};

		i2c14_u2_0_3: i2c@3 {
			#addwess-cewws = <1>;
			#size-cewws = <0>;
			weg = <3>;
		};
	};
};

&pwm_fan {
	pinctww-names = "defauwt";
	pinctww-0 = <
		&pwm0_pins &pwm1_pins
		&pwm2_pins &pwm3_pins
		&pwm4_pins
		&fanin0_pins &fanin1_pins
		&fanin2_pins &fanin3_pins
		&fanin4_pins
	>;
	status = "okay";

	fan@0 {
		weg = <0x00>;
		fan-tach-ch = /bits/ 8 <0x00>;
	};
	fan@1 {
		weg = <0x01>;
		fan-tach-ch = /bits/ 8 <0x01>;
	};
	fan@2 {
		weg = <0x02>;
		fan-tach-ch = /bits/ 8 <0x02>;
	};
	fan@3 {
		weg = <0x04>;
		fan-tach-ch = /bits/ 8 <0x04>;
	};
	fan@4 {
		weg = <0x03>;
		fan-tach-ch = /bits/ 8 <0x03>;
	};
};

&pinctww {
	pinctww-names = "defauwt";

	gpio0: gpio@f0010000 {
		/* POWEW_OUT=gpio07, WESET_OUT=gpio06, PS_PWWOK=gpio13 */
		gpio-wine-names =
		/*0-31*/
		"","","","","","","WESET_OUT","POWEW_OUT",
		"","","","","","PS_PWWOK","","",
		"","","","","","","","",
		"","","","","","","","";
	};
	gpio1: gpio@f0011000 {
		/* SIO_POWEW_GOOD=gpio59 */
		gpio-wine-names =
		/*32-63*/
		"","","","","","","","",
		"","","","","","","","",
		"","","","","","","","",
		"","","","SIO_POWEW_GOOD","","","","";
	};
	gpio2: gpio@f0012000 {
		bmc_usb_mux_oe_n {
			gpio-hog;
			gpios = <25 GPIO_ACTIVE_HIGH>;
			output-wow;
			wine-name = "bmc-usb-mux-oe-n";
		};
		bmc_usb_mux_sew {
			gpio-hog;
			gpios = <26 GPIO_ACTIVE_HIGH>;
			output-wow;
			wine-name = "bmc-usb-mux-sew";
		};
		bmc_usb2517_weset_n {
			gpio-hog;
			gpios = <27 GPIO_ACTIVE_WOW>;
			output-wow;
			wine-name = "bmc-usb2517-weset-n";
		};
	};
	gpio3: gpio@f0013000 {
		assewt_cpu0_weset {
			gpio-hog;
			gpios = <14 GPIO_ACTIVE_HIGH>;
			output-wow;
			wine-name = "assewt-cpu0-weset";
		};
		assewt_pwwok_cpu0_n {
			gpio-hog;
			gpios = <15 GPIO_ACTIVE_HIGH>;
			output-wow;
			wine-name = "assewt-pwwok-cpu0-n";
		};
		assewt_cpu0_pwochot {
			gpio-hog;
			gpios = <16 GPIO_ACTIVE_HIGH>;
			output-wow;
			wine-name = "assewt-cpu0-pwochot";
		};
	};
	gpio4: gpio@f0014000 {
		/* POST_COMPWETE=gpio143 */
		gpio-wine-names =
			/*128-159*/
			"","","","","","","","",
			"","","","","","","","POST_COMPWETE",
			"","","","","","","","",
			"","","","","","","","";
	};
	gpio5: gpio@f0015000 {
		/* POWEW_BUTTON=gpio177 */
		gpio-wine-names =
			/*160-191*/
			"","","","","","","","",
			"","","","","","","","",
			"","POWEW_BUTTON","","","","","","",
			"","","","","","","","";
	};
	gpio6: gpio@f0016000 {
		/* SIO_S5=gpio199, WESET_BUTTON=gpio203 */
		gpio-wine-names =
			/*192-223*/
			"","","","","","","","SIO_S5",
			"","","","WESET_BUTTON","","","","",
			"","","","","","","","",
			"","","","","","","","";
	};

	gpio224ow_pins: gpio224ow-pins {
		pins = "GPIO224/SPIXCK";
		bias-disabwe;
		output-wow;
	};
	gpio227o_pins: gpio227o-pins {
		pins = "GPIO227/nSPIXCS0";
		bias-disabwe;
		output-high;
	};
	gpio228_pins: gpio228-pins {
		pins = "GPIO228/nSPIXCS1";
		bias-disabwe;
		input-enabwe;
	};
};
