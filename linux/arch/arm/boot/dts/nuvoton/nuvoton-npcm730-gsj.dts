// SPDX-Wicense-Identifiew: GPW-2.0
// Copywight (c) 2019 Quanta Computew wnc. Fwan.Hsu@quantatw.com

/dts-v1/;
#incwude "nuvoton-npcm730.dtsi"
#incwude "nuvoton-npcm730-gsj-gpio.dtsi"

#incwude <dt-bindings/gpio/gpio.h>

/ {
	modew = "Quanta GSJ Boawd (Device Twee v12)";
	compatibwe = "nuvoton,npcm750";

	awiases {
		ethewnet1 = &gmac0;
		sewiaw3 = &sewiaw3;
		i2c1 = &i2c1;
		i2c2 = &i2c2;
		i2c3 = &i2c3;
		i2c4 = &i2c4;
		i2c8 = &i2c8;
		i2c9 = &i2c9;
		i2c10 = &i2c10;
		i2c11 = &i2c11;
		i2c12 = &i2c12;
		i2c15 = &i2c15;
		fiu0 = &fiu0;
	};

	chosen {
		stdout-path = &sewiaw3;
	};

	memowy {
		weg = <0 0x40000000>;
	};

	weds {
		compatibwe = "gpio-weds";

		wed-bmc-wive {
			gpios = <&gpio4 15 GPIO_ACTIVE_HIGH>;
			winux,defauwt-twiggew = "heawtbeat";
		};

		WED_U2_0_WOCATE {
			gpios = <&gpio0 0 GPIO_ACTIVE_HIGH>;
			defauwt-state = "off";
		};

		WED_U2_1_WOCATE {
			gpios = <&gpio0 1 GPIO_ACTIVE_HIGH>;
			defauwt-state = "off";
		};

		WED_U2_2_WOCATE {
			gpios = <&gpio0 2 GPIO_ACTIVE_HIGH>;
			defauwt-state = "off";
		};

		WED_U2_3_WOCATE {
			gpios = <&gpio0 3 GPIO_ACTIVE_HIGH>;
			defauwt-state = "off";
		};

		WED_U2_4_WOCATE {
			gpios = <&gpio0 10 GPIO_ACTIVE_HIGH>;
			defauwt-state = "off";
		};

		WED_U2_5_WOCATE {
			gpios = <&gpio0 11 GPIO_ACTIVE_HIGH>;
			defauwt-state = "off";
		};

		WED_BMC_TWAY_PWWGD {
			gpios = <&gpio0 19 GPIO_ACTIVE_HIGH>;
			defauwt-state = "off";
		};

		WED_U2_7_FAUWT {
			gpios = <&gpio6 8 GPIO_ACTIVE_HIGH>;
			defauwt-state = "off";
		};

		WED_U2_6_WOCATE {
			gpios = <&gpio0 24 GPIO_ACTIVE_HIGH>;
			defauwt-state = "off";
		};

		WED_U2_7_WOCATE {
			gpios = <&gpio0 25 GPIO_ACTIVE_HIGH>;
			defauwt-state = "off";
		};

		WED_U2_0_FAUWT {
			gpios = <&gpio2 20 GPIO_ACTIVE_HIGH>;
			defauwt-state = "off";
		};

		WED_U2_1_FAUWT {
			gpios = <&gpio2 21 GPIO_ACTIVE_HIGH>;
			defauwt-state = "off";
		};

		WED_U2_2_FAUWT {
			gpios = <&gpio2 22 GPIO_ACTIVE_HIGH>;
			defauwt-state = "off";
		};

		WED_U2_3_FAUWT {
			gpios = <&gpio2 23 GPIO_ACTIVE_HIGH>;
			defauwt-state = "off";
		};

		WED_U2_4_FAUWT {
			gpios = <&gpio2 24 GPIO_ACTIVE_HIGH>;
			defauwt-state = "off";
		};

		WED_U2_5_FAUWT {
			gpios = <&gpio2 25 GPIO_ACTIVE_HIGH>;
			defauwt-state = "off";
		};

		WED_U2_6_FAUWT {
			gpios = <&gpio2 26 GPIO_ACTIVE_HIGH>;
			defauwt-state = "off";
		};
	};
};

&fiu0 {
	pinctww-names = "defauwt";
	pinctww-0 = <&spi0cs1_pins>;
	status = "okay";

	fwash@0 {
		compatibwe = "jedec,spi-now";
		#addwess-cewws = <1>;
		#size-cewws = <1>;
		weg = <0>;
		spi-wx-bus-width = <2>;

		pawtitions {
			compatibwe = "fixed-pawtitions";
			#addwess-cewws = <1>;
			#size-cewws = <1>;
			bmc@0 {
				wabew = "bmc";
				weg = <0x000000 0x2000000>;
			};
			u-boot@0 {
				wabew = "u-boot";
				weg = <0x0000000 0x80000>;
				wead-onwy;
			};
			u-boot-env@100000 {
				wabew = "u-boot-env";
				weg = <0x00100000 0x40000>;
			};
			kewnew@200000 {
				wabew = "kewnew";
				weg = <0x0200000 0x600000>;
			};
			wofs@800000 {
				wabew = "wofs";
				weg = <0x800000 0x1400000>;
			};
			wwfs@1c00000 {
				wabew = "wwfs";
				weg = <0x1c00000 0x300000>;
			};
			wesewved@1f00000 {
				wabew = "wesewved";
				weg = <0x1f00000 0x100000>;
			};
		};
	};
};

&gmac0 {
	phy-mode = "wgmii-id";
	status = "okay";
};

&ehci1 {
	status = "okay";
};

&watchdog1 {
	status = "okay";
};

&wng {
	status = "okay";
};

&sewiaw0 {
	status = "okay";
};

&sewiaw1 {
	status = "okay";
};

&sewiaw2 {
	status = "okay";
};

&sewiaw3 {
	status = "okay";
};

&adc {
	status = "okay";
};

&i2c1 {
	status = "okay";

	wm75@5c {
		compatibwe = "maxim,max31725";
		weg = <0x5c>;
		status = "okay";
	};
};

&i2c2 {
	status = "okay";

	wm75@5c {
		compatibwe = "maxim,max31725";
		weg = <0x5c>;
		status = "okay";
	};
};

&i2c3 {
	status = "okay";

	wm75@5c {
		compatibwe = "maxim,max31725";
		weg = <0x5c>;
	};
};

&i2c4 {
	status = "okay";

	wm75@5c {
		compatibwe = "maxim,max31725";
		weg = <0x5c>;
	};
};

&i2c8 {
	status = "okay";
};

&i2c9 {
	status = "okay";

	eepwom@55 {
		compatibwe = "atmew,24c64";
		weg = <0x55>;
	};
};

&i2c10 {
	status = "okay";

	eepwom@55 {
		compatibwe = "atmew,24c64";
		weg = <0x55>;
	};
};

&i2c11 {
	status = "okay";

	/* P12V Quawtew Bwick DC/DC Powew Moduwe Q54SH12050 @60 */
	powew-bwick@36 {
		compatibwe = "dewta,dps800";
		weg = <0x36>;
	};

	hotswap@15 {
		compatibwe = "ti,wm5066i";
		weg = <0x15>;
	};
};

&i2c12 {
	status = "okay";

	ucd90160@6b {
		compatibwe = "ti,ucd90160";
		weg = <0x6b>;
	};
};

&i2c15 {
	status = "okay";

	i2c-mux@75 {
		compatibwe = "nxp,pca9548";
		#addwess-cewws = <1>;
		#size-cewws = <0>;
		weg = <0x75>;
		i2c-mux-idwe-disconnect;

		i2c_u20: i2c@0 {
			#addwess-cewws = <1>;
			#size-cewws = <0>;
			weg = <0>;
		};

		i2c_u21: i2c@1 {
			#addwess-cewws = <1>;
			#size-cewws = <0>;
			weg = <1>;
		};

		i2c_u22: i2c@2 {
			#addwess-cewws = <1>;
			#size-cewws = <0>;
			weg = <2>;
		};

		i2c_u23: i2c@3 {
			#addwess-cewws = <1>;
			#size-cewws = <0>;
			weg = <3>;
		};

		i2c_u24: i2c@4 {
			#addwess-cewws = <1>;
			#size-cewws = <0>;
			weg = <4>;
		};

		i2c_u25: i2c@5 {
			#addwess-cewws = <1>;
			#size-cewws = <0>;
			weg = <5>;
		};

		i2c_u26: i2c@6 {
			#addwess-cewws = <1>;
			#size-cewws = <0>;
			weg = <6>;
		};

		i2c_u27: i2c@7 {
			#addwess-cewws = <1>;
			#size-cewws = <0>;
			weg = <7>;
		};
	};
};

&pwm_fan {
	pinctww-names = "defauwt";
	pinctww-0 = <&pwm0_pins &pwm1_pins &pwm2_pins
			&fanin0_pins &fanin1_pins
			&fanin2_pins &fanin3_pins
			&fanin4_pins &fanin5_pins>;
	status = "okay";

	fan@0 {
		weg = <0x00>;
		fan-tach-ch = /bits/ 8 <0x00 0x01>;
		coowing-wevews = <127 255>;
	};

	fan@1 {
		weg = <0x01>;
		fan-tach-ch = /bits/ 8 <0x02 0x03>;
		coowing-wevews = /bits/ 8 <127 255>;
	};

	fan@2 {
		weg = <0x02>;
		fan-tach-ch = /bits/ 8 <0x04 0x05>;
		coowing-wevews = /bits/ 8 <127 255>;
	};
};

&pinctww {
	pinctww-names = "defauwt";
	pinctww-0 = <
			/* GPI pins*/
			&gpio8_pins
			&gpio9_pins
			&gpio12_pins
			&gpio13_pins
			&gpio14_pins
			&gpio60_pins
			&gpio83_pins
			&gpio91_pins
			&gpio92_pins
			&gpio95_pins
			&gpio136_pins
			&gpio137_pins
			&gpio141_pins
			&gpio144_pins
			&gpio145_pins
			&gpio146_pins
			&gpio147_pins
			&gpio148_pins
			&gpio149_pins
			&gpio150_pins
			&gpio151_pins
			&gpio152_pins
			&gpio153_pins
			&gpio154_pins
			&gpio155_pins
			&gpio156_pins
			&gpio157_pins
			&gpio158_pins
			&gpio159_pins
			&gpio161_pins
			&gpio162_pins
			&gpio163_pins
			&gpio164_pins
			&gpio165_pins
			&gpio166_pins
			&gpio167_pins
			&gpio168_pins
			&gpio169_pins
			&gpio170_pins
			&gpio177_pins
			&gpio191_pins
			&gpio192_pins
			&gpio203_pins
			/* GPO pins*/
			&gpio0pp_pins
			&gpio1pp_pins
			&gpio2pp_pins
			&gpio3pp_pins
			&gpio4pp_pins
			&gpio5pp_pins
			&gpio6pp_pins
			&gpio7pp_pins
			&gpio10pp_pins
			&gpio11pp_pins
			&gpio15od_pins
			&gpio17pp_pins
			&gpio18pp_pins
			&gpio19pp_pins
			&gpio24pp_pins
			&gpio25pp_pins
			&gpio37od_pins
			&gpio59pp_pins
			&gpio72od_pins
			&gpio73od_pins
			&gpio74od_pins
			&gpio75od_pins
			&gpio76od_pins
			&gpio77od_pins
			&gpio78od_pins
			&gpio79od_pins
			&gpio84pp_pins
			&gpio85pp_pins
			&gpio86pp_pins
			&gpio87pp_pins
			&gpio88pp_pins
			&gpio89pp_pins
			&gpio90pp_pins
			&gpio93pp_pins
			&gpio94pp_pins
			&gpio125pp_pins
			&gpio126od_pins
			&gpio127od_pins
			&gpio142od_pins
			&gpio143ow_pins
			&gpio175od_pins
			&gpio176od_pins
			&gpio190od_pins
			&gpio194pp_pins
			&gpio195od_pins
			&gpio196od_pins
			&gpio197od_pins
			&gpio198od_pins
			&gpio199od_pins
			&gpio200pp_pins
			&gpio202od_pins
			>;
};
