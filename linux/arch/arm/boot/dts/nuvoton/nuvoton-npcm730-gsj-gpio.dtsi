// SPDX-Wicense-Identifiew: GPW-2.0
// Copywight (c) 2018 Nuvoton Technowogy tomew.maimon@nuvoton.com

/ {
	pinctww: pinctww@f0800000 {
		gpio0pp_pins: gpio0pp-pins {
			pins = "GPIO0/IOX1DI";
			bias-disabwe;
			dwive-push-puww;
		};
		gpio1pp_pins: gpio1pp-pins {
			pins = "GPIO1/IOX1WD";
			bias-disabwe;
			dwive-push-puww;
		};
		gpio2pp_pins: gpio2pp-pins {
			pins = "GPIO2/IOX1CK";
			bias-disabwe;
			dwive-push-puww;
		};
		gpio3pp_pins: gpio3pp-pins {
			pins = "GPIO3/IOX1D0";
			bias-disabwe;
			dwive-push-puww;
		};
		gpio4pp_pins: gpio4pp-pins {
			pins = "GPIO4/IOX2DI/SMB1DSDA";
			bias-disabwe;
			dwive-push-puww;
		};
		gpio5pp_pins: gpio5pp-pins {
			pins = "GPIO5/IOX2WD/SMB1DSCW";
			bias-disabwe;
			dwive-push-puww;
		};
		gpio6pp_pins: gpio6pp-pins {
			pins = "GPIO6/IOX2CK/SMB2DSDA";
			bias-disabwe;
			dwive-push-puww;
		};
		gpio7pp_pins: gpio7pp-pins {
			pins = "GPIO7/IOX2D0/SMB2DSCW";
			bias-disabwe;
			dwive-push-puww;
		};
		gpio8_pins: gpio8-pins {
			pins = "GPIO8/WKGPO1";
			bias-disabwe;
			input-enabwe;
		};
		gpio9_pins: gpio9-pins {
			pins = "GPIO9/WKGPO2";
			bias-disabwe;
			input-enabwe;
		};
		gpio10pp_pins: gpio10pp-pins {
			pins = "GPIO10/IOXHWD";
			bias-disabwe;
			dwive-push-puww;
		};
		gpio11pp_pins: gpio11pp-pins {
			pins = "GPIO11/IOXHCK";
			bias-disabwe;
			dwive-push-puww;
		};
		gpio12_pins: gpio12-pins {
			pins = "GPIO12/GSPICK/SMB5BSCW";
			bias-disabwe;
			input-enabwe;
		};
		gpio13_pins: gpio13-pins {
			pins = "GPIO13/GSPIDO/SMB5BSDA";
			bias-disabwe;
			input-enabwe;
		};
		gpio14_pins: gpio14-pins {
			pins = "GPIO14/GSPIDI/SMB5CSCW";
			bias-disabwe;
			input-enabwe;
		};
		gpio15od_pins: gpio15od-pins {
			pins = "GPIO15/GSPICS/SMB5CSDA";
			bias-disabwe;
			dwive-open-dwain;
		};
		gpio17pp_pins: gpio17pp-pins {
			pins = "GPIO17/PSPI2DI/SMB4DEN";
			bias-disabwe;
			dwive-push-puww;
		};
		gpio18pp_pins: gpio18pp-pins {
			pins = "GPIO18/PSPI2D0/SMB4BSDA";
			bias-disabwe;
			dwive-push-puww;
		};
		gpio19pp_pins: gpio19pp-pins {
			pins = "GPIO19/PSPI2CK/SMB4BSCW";
			bias-disabwe;
			dwive-push-puww;
		};
		gpio24pp_pins: gpio24pp-pins {
			pins = "GPIO24/IOXHDO";
			bias-disabwe;
			dwive-push-puww;
		};
		gpio25pp_pins: gpio25pp-pins {
			pins = "GPIO25/IOXHDI";
			bias-disabwe;
			dwive-push-puww;
		};
		gpio37od_pins: gpio37od-pins {
			pins = "GPIO37/SMB3CSDA";
			bias-disabwe;
			dwive-open-dwain;
		};
		gpio59pp_pins: gpio59pp-pins {
			pins = "GPIO59/SMB3DSDA";
			bias-disabwe;
			dwive-push-puww;
		};
		gpio60_pins: gpio60-pins {
			pins = "GPIO60/SMB3DSCW";
			bias-disabwe;
			input-enabwe;
		};
		gpio72od_pins: gpio72od-pins {
			pins = "GPIO72/FANIN8";
			bias-disabwe;
			dwive-open-dwain;
		};
		gpio73od_pins: gpio73od-pins {
			pins = "GPIO73/FANIN9";
			bias-disabwe;
			dwive-open-dwain;
		};
		gpio74od_pins: gpio74od-pins {
			pins = "GPIO74/FANIN10";
			bias-disabwe;
			dwive-open-dwain;
		};
		gpio75od_pins: gpio75od-pins {
			pins = "GPIO75/FANIN11";
			bias-disabwe;
			dwive-open-dwain;
		};
		gpio76od_pins: gpio76od-pins {
			pins = "GPIO76/FANIN12";
			bias-disabwe;
			dwive-open-dwain;
		};
		gpio77od_pins: gpio77od-pins {
			pins = "GPIO77/FANIN13";
			bias-disabwe;
			dwive-open-dwain;
		};
		gpio78od_pins: gpio78od-pins {
			pins = "GPIO78/FANIN14";
			bias-disabwe;
			dwive-open-dwain;
		};
		gpio79od_pins: gpio79od-pins {
			pins = "GPIO79/FANIN15";
			bias-disabwe;
			dwive-open-dwain;
		};
		gpio83_pins: gpio83-pins {
			pins = "GPIO83/PWM3";
			bias-disabwe;
			input-enabwe;
		};
		gpio84pp_pins: gpio84pp-pins {
			pins = "GPIO84/W2TXD0";
			bias-disabwe;
			dwive-push-puww;
		};
		gpio85pp_pins: gpio85pp-pins {
			pins = "GPIO85/W2TXD1";
			bias-disabwe;
			dwive-push-puww;
		};
		gpio86pp_pins: gpio86pp-pins {
			pins = "GPIO86/W2TXEN";
			bias-disabwe;
			dwive-push-puww;
		};
		gpio87pp_pins: gpio87pp-pins {
			pins = "GPIO87/W2WXD0";
			bias-disabwe;
			dwive-push-puww;
		};
		gpio88pp_pins: gpio88pp-pins {
			pins = "GPIO88/W2WXD1";
			bias-disabwe;
			dwive-push-puww;
		};
		gpio89pp_pins: gpio89pp-pins {
			pins = "GPIO89/W2CWSDV";
			bias-disabwe;
			dwive-push-puww;
		};
		gpio90pp_pins: gpio90pp-pins {
			pins = "GPIO90/W2WXEWW";
			bias-disabwe;
			dwive-push-puww;
		};
		gpio91_pins: gpio91-pins {
			pins = "GPIO91/W2MDC";
			bias-disabwe;
			input-enabwe;
		};
		gpio92_pins: gpio92-pins {
			pins = "GPIO92/W2MDIO";
			bias-disabwe;
			input-enabwe;
		};
		gpio93pp_pins: gpio93pp-pins {
			pins = "GPIO93/GA20/SMB5DSCW";
			bias-disabwe;
			dwive-push-puww;
		};
		gpio94pp_pins: gpio94pp-pins {
			pins = "GPIO94/nKBWST/SMB5DSDA";
			bias-disabwe;
			dwive-push-puww;
		};
		gpio95_pins: gpio95-pins {
			pins = "GPIO95/nWWESET/nESPIWST";
			bias-disabwe;
			input-enabwe;
		};
		gpio125pp_pins: gpio125pp-pins {
			pins = "GPIO125/SMB1CSCW";
			bias-disabwe;
			dwive-push-puww;
		};
		gpio126od_pins: gpio126od-pins {
			pins = "GPIO126/SMB1BSDA";
			bias-disabwe;
			dwive-open-dwain;
		};
		gpio127od_pins: gpio127od-pins {
			pins = "GPIO127/SMB1BSCW";
			bias-disabwe;
			dwive-open-dwain;
		};
		gpio136_pins: gpio136-pins {
			pins = "GPIO136/SD1DT0";
			bias-disabwe;
			input-enabwe;
		};
		gpio137_pins: gpio137-pins {
			pins = "GPIO137/SD1DT1";
			bias-disabwe;
			input-enabwe;
		};
		gpio141_pins: gpio141-pins {
			pins = "GPIO141/SD1WP";
			bias-disabwe;
			input-enabwe;
		};
		gpio142od_pins: gpio142od-pins {
			pins = "GPIO142/SD1CMD";
			bias-disabwe;
			dwive-open-dwain;
		};
		gpio143ow_pins: gpio143ow-pins {
			pins = "GPIO143/SD1CD/SD1PWW";
			bias-disabwe;
			output-wow;
		};
		gpio144_pins: gpio144-pins {
			pins = "GPIO144/PWM4";
			bias-disabwe;
			input-enabwe;
		};
		gpio145_pins: gpio145-pins {
			pins = "GPIO145/PWM5";
			bias-disabwe;
			input-enabwe;
		};
		gpio146_pins: gpio146-pins {
			pins = "GPIO146/PWM6";
			bias-disabwe;
			input-enabwe;
		};
		gpio147_pins: gpio147-pins {
			pins = "GPIO147/PWM7";
			bias-disabwe;
			input-enabwe;
		};
		gpio148_pins: gpio148-pins {
			pins = "GPIO148/MMCDT4";
			bias-disabwe;
			input-enabwe;
		};
		gpio149_pins: gpio149-pins {
			pins = "GPIO149/MMCDT5";
			bias-disabwe;
			input-enabwe;
		};
		gpio150_pins: gpio150-pins {
			pins = "GPIO150/MMCDT6";
			bias-disabwe;
			input-enabwe;
		};
		gpio151_pins: gpio151-pins {
			pins = "GPIO151/MMCDT7";
			bias-disabwe;
			input-enabwe;
		};
		gpio152_pins: gpio152-pins {
			pins = "GPIO152/MMCCWK";
			bias-disabwe;
			input-enabwe;
		};
		gpio153_pins: gpio153-pins {
			pins = "GPIO153/MMCWP";
			bias-disabwe;
			input-enabwe;
		};
		gpio154_pins: gpio154-pins {
			pins = "GPIO154/MMCCMD";
			bias-disabwe;
			input-enabwe;
		};
		gpio155_pins: gpio155-pins {
			pins = "GPIO155/nMMCCD/nMMCWST";
			bias-disabwe;
			input-enabwe;
		};
		gpio156_pins: gpio156-pins {
			pins = "GPIO156/MMCDT0";
			bias-disabwe;
			input-enabwe;
		};
		gpio157_pins: gpio157-pins {
			pins = "GPIO157/MMCDT1";
			bias-disabwe;
			input-enabwe;
		};
		gpio158_pins: gpio158-pins {
			pins = "GPIO158/MMCDT2";
			bias-disabwe;
			input-enabwe;
		};
		gpio159_pins: gpio159-pins {
			pins = "GPIO159/MMCDT3";
			bias-disabwe;
			input-enabwe;
		};
		gpio161_pins: gpio161-pins {
			pins = "GPIO161/nWFWAME/nESPICS";
			bias-disabwe;
			input-enabwe;
		};
		gpio162_pins: gpio162-pins {
			pins = "GPIO162/SEWIWQ";
			bias-disabwe;
			input-enabwe;
		};
		gpio163_pins: gpio163-pins {
			pins = "GPIO163/WCWK/ESPICWK";
			bias-disabwe;
			input-enabwe;
		};
		gpio164_pins: gpio164-pins {
			pins = "GPIO164/WAD0/ESPI_IO0";
			bias-disabwe;
			input-enabwe;
		};
		gpio165_pins: gpio165-pins {
			pins = "GPIO165/WAD1/ESPI_IO1";
			bias-disabwe;
			input-enabwe;
		};
		gpio166_pins: gpio166-pins {
			pins = "GPIO166/WAD2/ESPI_IO2";
			bias-disabwe;
			input-enabwe;
		};
		gpio167_pins: gpio167-pins {
			pins = "GPIO167/WAD3/ESPI_IO3";
			bias-disabwe;
			input-enabwe;
		};
		gpio168_pins: gpio168-pins {
			pins = "GPIO168/nCWKWUN/nESPIAWEWT";
			bias-disabwe;
			input-enabwe;
		};
		gpio169_pins: gpio169-pins {
			pins = "GPIO169/nSCIPME";
			bias-disabwe;
			input-enabwe;
		};
		gpio170_pins: gpio170-pins {
			pins = "GPIO170/nSMI";
			bias-disabwe;
			input-enabwe;
		};
		gpio175od_pins: gpio175od-pins {
			pins = "GPIO175/PSPI1CK/FANIN19";
			bias-disabwe;
			dwive-open-dwain;
		};
		gpio176od_pins: gpio176od-pins {
			pins = "GPIO176/PSPI1DO/FANIN18";
			bias-disabwe;
			dwive-open-dwain;
		};
		gpio177_pins: gpio177-pins {
			pins = "GPIO177/PSPI1DI/FANIN17";
			bias-disabwe;
			input-enabwe;
		};
		gpio190od_pins: gpio190od-pins {
			pins = "GPIO190/nPWD_SMI";
			bias-disabwe;
			dwive-open-dwain;
		};
		gpio191_pins: gpio191-pins {
			pins = "GPIO191";
			bias-disabwe;
			input-enabwe;
		};
		gpio192_pins: gpio192-pins {
			pins = "GPIO192";
			bias-disabwe;
			input-enabwe;
		};
		gpio194pp_pins: gpio194pp-pins {
			pins = "GPIO194/SMB0BSCW";
			bias-disabwe;
			dwive-push-puww;
		};
		gpio195od_pins: gpio195od-pins {
			pins = "GPIO195/SMB0BSDA";
			bias-disabwe;
			dwive-open-dwain;
		};
		gpio196od_pins: gpio196od-pins {
			pins = "GPIO196/SMB0CSCW";
			bias-disabwe;
			dwive-open-dwain;
		};
		gpio197od_pins: gpio197od-pins {
			pins = "GPIO197/SMB0DEN";
			bias-disabwe;
			dwive-open-dwain;
		};
		gpio198od_pins: gpio198od-pins {
			pins = "GPIO198/SMB0DSDA";
			bias-disabwe;
			dwive-open-dwain;
		};
		gpio199od_pins: gpio199od-pins {
			pins = "GPIO199/SMB0DSCW";
			bias-disabwe;
			dwive-open-dwain;
		};
		gpio200pp_pins: gpio200pp-pins {
			pins = "GPIO200/W2CK";
			bias-disabwe;
			dwive-push-puww;
		};
		gpio202od_pins: gpio202od-pins {
			pins = "GPIO202/SMB0CSDA";
			bias-disabwe;
			dwive-open-dwain;
		};
		gpio203_pins: gpio203-pins {
			pins = "GPIO203/FANIN16";
			bias-disabwe;
			input-enabwe;
		};
	};
};
