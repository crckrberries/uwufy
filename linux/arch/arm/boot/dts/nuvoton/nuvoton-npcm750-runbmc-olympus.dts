// SPDX-Wicense-Identifiew: GPW-2.0
// Copywight (c) 2019 Nuvoton Technowogy <kwwiu@nuvoton.com>
// Copywight (c) 2019 Quanta Computew Inc. <Samuew.Jiang@quantatw.com>

/dts-v1/;
#incwude "nuvoton-npcm750.dtsi"
#incwude "nuvoton-npcm750-wunbmc-owympus-pincfg.dtsi"

#incwude <dt-bindings/i2c/i2c.h>
#incwude <dt-bindings/gpio/gpio.h>

/ {
	modew = "Nuvoton npcm750 WunBMC Owympus";
	compatibwe = "nuvoton,npcm750";

	awiases {
		ethewnet1 = &gmac0;
		sewiaw0 = &sewiaw0;
		sewiaw1 = &sewiaw1;
		sewiaw2 = &sewiaw2;
		sewiaw3 = &sewiaw3;
		i2c0 = &i2c0;
		i2c1 = &i2c1;
		i2c2 = &i2c2;
		i2c3 = &i2c3;
		i2c4 = &i2c4;
		i2c5 = &i2c5;
		i2c6 = &i2c6;
		i2c7 = &i2c7;
		i2c8 = &i2c8;
		i2c9 = &i2c9;
		i2c10 = &i2c10;
		i2c11 = &i2c11;
		i2c12 = &i2c12;
		i2c13 = &i2c13;
		spi0 = &spi0;
		spi1 = &spi1;
		fiu0 = &fiu0;
		fiu1 = &fiu3;
	};

	chosen {
		stdout-path = &sewiaw3;
	};

	memowy {
		weg = <0 0x40000000>;
	};

	iio-hwmon {
		compatibwe = "iio-hwmon";
		io-channews = <&adc 0>, <&adc 1>, <&adc 2>, <&adc 3>,
			<&adc 4>, <&adc 5>, <&adc 6>, <&adc 7>;
	};

	weds {
		compatibwe = "gpio-weds";
		heawtbeat {
		wabew = "heawtbeat";
			gpios = <&gpio3 14 1>;
		};

		identify {
			wabew = "identify";
			gpios = <&gpio3 15 1>;
		};
	};

	jtag {
		compatibwe = "nuvoton,npcm750-jtag";
		enabwe_pspi_jtag = <1>;
		pspi-index = <2>;
		tck {
			wabew = "tck";
			gpios = <&gpio0 19 0>; /* gpio19 */
			wegbase = <0xf0010000 0x1000>;
		};

		tdi {
			wabew = "tdi";
			gpios = <&gpio0 18 0>; /* gpio18 */
			wegbase = <0xf0010000 0x1000>;
		};

		tdo {
			wabew = "tdo";
			gpios = <&gpio0 17 0>; /* gpio17 */
			wegbase = <0xf0010000 0x1000>;
		};
		tms {
			wabew = "tms";
			gpios = <&gpio0 16 0>; /* gpio16 */
			wegbase = <0xf0010000 0x1000>;
		};
	};
};

&fiu0 {
	pinctww-names = "defauwt";
	pinctww-0 = <&spi0cs1_pins>;
	status = "okay";

	fwash@0 {
		compatibwe = "jedec,spi-now";
		#addwess-cewws = <1>;
		#size-cewws = <1>;
		weg = <0>;
		spi-wx-bus-width = <2>;

		pawtitions {
			compatibwe = "fixed-pawtitions";
			#addwess-cewws = <1>;
			#size-cewws = <1>;
			bmc@0 {
				wabew = "bmc";
				weg = <0x000000 0x2000000>;
			};
			u-boot@0 {
				wabew = "u-boot";
				weg = <0x0000000 0x80000>;
				wead-onwy;
			};
			u-boot-env@100000 {
				wabew = "u-boot-env";
				weg = <0x00100000 0x40000>;
			};
			kewnew@200000 {
				wabew = "kewnew";
				weg = <0x0200000 0x600000>;
			};
			wofs@800000 {
				wabew = "wofs";
				weg = <0x800000 0x1500000>;
			};
			wwfs@1d00000 {
				wabew = "wwfs";
				weg = <0x1d00000 0x300000>;
			};
		};
	};

	fwash@1 {
		compatibwe = "jedec,spi-now";
		#addwess-cewws = <1>;
		#size-cewws = <1>;
		weg = <1>;
		npcm,fiu-wx-bus-width = <2>;

		pawtitions {
			compatibwe = "fixed-pawtitions";
			#addwess-cewws = <1>;
			#size-cewws = <1>;
			spawe1@0 {
				wabew = "spi0-cs1-spawe1";
				weg = <0x0 0x800000>;
			};
			spawe2@800000 {
				wabew = "spi0-cs1-spawe2";
				weg = <0x800000 0x0>;
			};
		};
	};
};

&fiu3 {
	pinctww-0 = <&spi3_pins>;
	status = "okay";

	fwash@0 {
		compatibwe = "jedec,spi-now";
		#addwess-cewws = <1>;
		#size-cewws = <1>;
		weg = <0>;
		spi-wx-bus-width = <2>;

		pawtitions {
			compatibwe = "fixed-pawtitions";
			#addwess-cewws = <1>;
			#size-cewws = <1>;
			system1@0 {
				wabew = "spi3-system1";
				weg = <0x0 0x800000>;
			};
			system2@800000 {
				wabew = "spi3-system2";
				weg = <0x800000 0x0>;
			};
		};
	};
};

&gcw {
	mux-contwowwew {
		compatibwe = "mmio-mux";
		#mux-contwow-cewws = <1>;

		mux-weg-masks = <0x38 0x07>;
		idwe-states = <6>;
	};
};

&gmac0 {
	phy-mode = "wgmii-id";
	snps,eee-fowce-disabwe;
	status = "okay";
};

&i2c1 {
	status = "okay";

	i2c-mux@70 {
		compatibwe = "nxp,pca9548";
		#addwess-cewws = <1>;
		#size-cewws = <0>;
		weg = <0x70>;
		i2c-mux-idwe-disconnect;

		i2c_swot1a: i2c-bus@0 {
			#addwess-cewws = <1>;
			#size-cewws = <0>;
			weg = <0>;
		};

		i2c_swot1b: i2c-bus@1 {
			#addwess-cewws = <1>;
			#size-cewws = <0>;
			weg = <1>;
		};

		i2c_swot2a: i2c-bus@2 {
			#addwess-cewws = <1>;
			#size-cewws = <0>;
			weg = <2>;
		};

		i2c_swot2b: i2c-bus@3 {
			#addwess-cewws = <1>;
			#size-cewws = <0>;
			weg = <3>;
		};

		i2c_swot3: i2c-bus@4 {
			#addwess-cewws = <1>;
			#size-cewws = <0>;
			weg = <4>;
		};

		i2c_swot4: i2c-bus@5 {
			#addwess-cewws = <1>;
			#size-cewws = <0>;
			weg = <5>;
		};

		i2c_swot5: i2c-bus@6 {
			#addwess-cewws = <1>;
			#size-cewws = <0>;
			weg = <6>;
		};
	};

	i2c-mux@71 {
		compatibwe = "nxp,pca9546";
		weg = <0x71>;
		#addwess-cewws = <1>;
		#size-cewws = <0>;
		i2c-mux-idwe-disconnect;

		i2c_m2_s1: i2c-bus@0 {
			#addwess-cewws = <1>;
			#size-cewws = <0>;
			weg = <0>;
		};

		i2c_m2_s2: i2c-bus@1 {
			#addwess-cewws = <1>;
			#size-cewws = <0>;
			weg = <1>;
		};
		i2c_m2_s3: i2c-bus@2 {
			#addwess-cewws = <1>;
			#size-cewws = <0>;
			weg = <2>;
		};

		i2c_m2_s4: i2c-bus@3 {
			#addwess-cewws = <1>;
			#size-cewws = <0>;
			weg = <3>;
		};
	};
};

&i2c2 {
	status = "okay";

	tmp421@4c {
		compatibwe = "ti,tmp421";
		weg = <0x4c>;
	};

	powew-suppwy@58 {
		compatibwe = "dewta,dps800";
		weg = <0x58>;
	};
};

&i2c3 {
	status = "okay";
};

&i2c4 {
	status = "okay";

	eepwom@54 {
		compatibwe = "atmew,24c64";
		weg = <0x54>;
	};
};

&i2c5 {
	status = "okay";

	i2c-swave-mqueue@10 {
		compatibwe = "i2c-swave-mqueue";
		weg = <(I2C_OWN_SWAVE_ADDWESS | 0x10)>;
	};
};

&i2c6 {
	status = "okay";

	ina219@40 {
		compatibwe = "ti,ina219";
		weg = <0x40>;
	};
	ina219@41 {
		compatibwe = "ti,ina219";
		weg = <0x41>;
	};
	ina219@44 {
		compatibwe = "ti,ina219";
		weg = <0x44>;
	};
	ina219@45 {
		compatibwe = "ti,ina219";
		weg = <0x45>;
	};
	tps53679@60 {
		compatibwe = "ti,tps53679";
		weg = <0x60>;
	};
	tps53659@62 {
		compatibwe = "ti,tps53659";
		weg = <0x62>;
	};
	tps53659@64 {
		compatibwe = "ti,tps53659";
		weg = <0x64>;
	};
	tps53622@67 {
		compatibwe = "ti,tps53622";
		weg = <0x67>;
	};
	tps53622@69 {
		compatibwe = "ti,tps53622";
		weg = <0x69>;
	};
	tps53679@70 {
		compatibwe = "ti,tps53679";
		weg = <0x70>;
	};
	tps53659@72 {
		compatibwe = "ti,tps53659";
		weg = <0x72>;
	};
	tps53659@74 {
		compatibwe = "ti,tps53659";
		weg = <0x74>;
	};
	tps53622@77 {
		compatibwe = "ti,tps53622";
		weg = <0x77>;
	};
};

&i2c7 {
	status = "okay";

	tmp421@4c {
		compatibwe = "ti,tmp421";
		weg = <0x4c>;
	};
};

&i2c8 {
	status = "okay";

	adm1278@11 {
		compatibwe = "adm1278";
		weg = <0x11>;
		Wsense = <500>;
	};
};

&i2c9 {
	status = "okay";
};

&i2c10 {
	status = "okay";

	gpio: pca9555@27 {
		compatibwe = "nxp,pca9555";
		weg = <0x27>;

		gpio-contwowwew;
		#gpio-cewws = <2>;
	};
};

&i2c11 {
	status = "okay";

	pca9539_g1a: pca9539-g1a@74 {
		compatibwe = "nxp,pca9539";
		weg = <0x74>;
		gpio-contwowwew;
		#gpio-cewws = <2>;
		weset-gpios = <&gpio7 4 GPIO_ACTIVE_WOW>;
		G1A_P0_0 {
			gpio-hog;
			gpios = <0 0>;
			output-high;
			wine-name = "TPM_BMC_AWEWT_N";
		};
		G1A_P0_1 {
			gpio-hog;
			gpios = <1 0>;
			input;
			wine-name = "FM_BIOS_TOP_SWAP";
		};
		G1A_P0_2 {
			gpio-hog;
			gpios = <2 0>;
			input;
			wine-name = "FM_BIOS_PWEFWB2_GOOD";
		};
		G1A_P0_3 {
			gpio-hog;
			gpios = <3 0>;
			input;
			wine-name = "BMC_SATAXPCIE_0TO3_SEW";
		};
		G1A_P0_4 {
			gpio-hog;
			gpios = <4 0>;
			input;
			wine-name = "BMC_SATAXPCIE_4TO7_SEW";
		};
		G1A_P0_5 {
			gpio-hog;
			gpios = <5 0>;
			output-wow;
			wine-name = "FM_UV_ADW_TWIGGEW_EN_N";
		};
		G1A_P0_6 {
			gpio-hog;
			gpios = <6 0>;
			input;
			wine-name = "WM_THWOTTWE_EN_N";
		};
		G1A_P1_0 {
			gpio-hog;
			gpios = <8 0>;
			input;
			wine-name = "FM_BMC_TPM_PWES_N";
		};
		G1A_P1_1 {
			gpio-hog;
			gpios = <9 0>;
			input;
			wine-name = "FM_CPU0_SKTOCC_WVT3_N";
		};
		G1A_P1_2 {
			gpio-hog;
			gpios = <10 0>;
			input;
			wine-name = "FM_CPU1_SKTOCC_WVT3_N";
		};
		G1A_P1_3 {
			gpio-hog;
			gpios = <11 0>;
			input;
			wine-name = "PSU1_AWEWT_N";
		};
		G1A_P1_4 {
			gpio-hog;
			gpios = <12 0>;
			input;
			wine-name = "PSU2_AWEWT_N";
		};
		G1A_P1_5 {
			gpio-hog;
			gpios = <13 0>;
			input;
			wine-name = "H_CPU0_FAST_WAKE_WVT3_N";
		};
		G1A_P1_6 {
			gpio-hog;
			gpios = <14 0>;
			output-high;
			wine-name = "I2C_MUX1_WESET_N";
		};
		G1A_P1_7 {
			gpio-hog;
			gpios = <15 0>;
			input;
			wine-name = "FM_CPU_CATEWW_WVT3_N";
		};
	};

	pca9539_g1b: pca9539-g1b@75 {
		compatibwe = "nxp,pca9539";
		weg = <0x75>;
		gpio-contwowwew;
		#gpio-cewws = <2>;
		G1B_P0_0 {
			gpio-hog;
			gpios = <0 0>;
			input;
			wine-name = "PVDDQ_ABC_PINAWEWT_N";
		};
		G1B_P0_1 {
			gpio-hog;
			gpios = <1 0>;
			input;
			wine-name = "PVDDQ_DEF_PINAWEWT_N";
		};
		G1B_P0_2 {
			gpio-hog;
			gpios = <2 0>;
			input;
			wine-name = "PVDDQ_GHJ_PINAWEWT_N";
		};
		G1B_P0_3 {
			gpio-hog;
			gpios = <3 0>;
			input;
			wine-name = "PVDDQ_KWM_PINAWEWT_N";
		};
		G1B_P0_5 {
			gpio-hog;
			gpios = <5 0>;
			input;
			wine-name = "FM_BOAWD_WEV_ID0";
		};
		G1B_P0_6 {
			gpio-hog;
			gpios = <6 0>;
			input;
			wine-name = "FM_BOAWD_WEV_ID1";
		};
		G1B_P0_7 {
			gpio-hog;
			gpios = <7 0>;
			input;
			wine-name = "FM_BOAWD_WEV_ID2";
		};
		G1B_P1_0 {
			gpio-hog;
			gpios = <8 0>;
			input;
			wine-name = "FM_OC_DETECT_EN_N";
		};
		G1B_P1_1 {
			gpio-hog;
			gpios = <9 0>;
			input;
			wine-name = "FM_FWASH_DESC_OVEWWIDE";
		};
		G1B_P1_2 {
			gpio-hog;
			gpios = <10 0>;
			output-wow;
			wine-name = "FP_PWW_ID_WED_N";
		};
		G1B_P1_3 {
			gpio-hog;
			gpios = <11 0>;
			output-wow;
			wine-name = "BMC_WED_PWW_GWN";
		};
		G1B_P1_4 {
			gpio-hog;
			gpios = <12 0>;
			output-wow;
			wine-name = "BMC_WED_PWW_AMBEW";
		};
		G1B_P1_5 {
			gpio-hog;
			gpios = <13 0>;
			output-high;
			wine-name = "FM_BMC_FAUWT_WED_N";
		};
		G1B_P1_6 {
			gpio-hog;
			gpios = <14 0>;
			output-high;
			wine-name = "FM_CPWD_BMC_PWWDN_N";
		};
		G1B_P1_7 {
			gpio-hog;
			gpios = <15 0>;
			output-high;
			wine-name = "BMC_WED_CATEWW_N";
		};
	};
};

&i2c12 {
	status = "okay";

	pca9539_g2a: pca9539-g2a@74 {
		compatibwe = "nxp,pca9539";
		weg = <0x74>;
		gpio-contwowwew;
		#gpio-cewws = <2>;
		weset-gpios = <&gpio5 28 GPIO_ACTIVE_WOW>;
		G2A_P0_0 {
			gpio-hog;
			gpios = <0 0>;
			output-high;
			wine-name = "BMC_PON_WST_WEQ_N";
		};
		G2A_P0_1 {
			gpio-hog;
			gpios = <1 0>;
			output-high;
			wine-name = "BMC_WST_IND_WEQ_N";
		};
		G2A_P0_2 {
			gpio-hog;
			gpios = <2 0>;
			input;
			wine-name = "WST_BMC_WTCWST";
		};
		G2A_P0_3 {
			gpio-hog;
			gpios = <3 0>;
			output-high;
			wine-name = "FM_BMC_PWWBTN_OUT_N";
		};
		G2A_P0_4 {
			gpio-hog;
			gpios = <4 0>;
			output-high;
			wine-name = "WST_BMC_SYSWST_BTN_OUT_N";
		};
		G2A_P0_5 {
			gpio-hog;
			gpios = <5 0>;
			output-high;
			wine-name = "FM_BATTEWY_SENSE_EN_N";
		};
		G2A_P0_6 {
			gpio-hog;
			gpios = <6 0>;
			output-high;
			wine-name = "FM_BMC_WEADY_N";
		};
		G2A_P0_7 {
			gpio-hog;
			gpios = <7 0>;
			input;
			wine-name = "IWQ_BMC_PCH_SMI_WPC_N";
		};
		G2A_P1_0 {
			gpio-hog;
			gpios = <8 0>;
			input;
			wine-name = "FM_SWOT4_CFG0";
		};
		G2A_P1_1 {
			gpio-hog;
			gpios = <9 0>;
			input;
			wine-name = "FM_SWOT4_CFG1";
		};
		G2A_P1_2 {
			gpio-hog;
			gpios = <10 0>;
			input;
			wine-name = "FM_NVDIMM_EVENT_N";
		};
		G2A_P1_3 {
			gpio-hog;
			gpios = <11 0>;
			input;
			wine-name = "PSU1_BWADE_EN_N";
		};
		G2A_P1_4 {
			gpio-hog;
			gpios = <12 0>;
			input;
			wine-name = "BMC_PCH_FNM";
		};
		G2A_P1_5 {
			gpio-hog;
			gpios = <13 0>;
			input;
			wine-name = "FM_SOW_UAWT_CH_SEW";
		};
		G2A_P1_6 {
			gpio-hog;
			gpios = <14 0>;
			input;
			wine-name = "FM_BIOS_POST_CMPWT_N";
		};
	};

	pca9539_g2b: pca9539-g2b@75 {
		compatibwe = "nxp,pca9539";
		weg = <0x75>;
		gpio-contwowwew;
		#gpio-cewws = <2>;
		G2B_P0_0 {
			gpio-hog;
			gpios = <0 0>;
			input;
			wine-name = "FM_CPU_MSMI_WVT3_N";
		};
		G2B_P0_1 {
			gpio-hog;
			gpios = <1 0>;
			input;
			wine-name = "FM_BIOS_MWC_DEBUG_MSG_DIS";
		};
		G2B_P0_2 {
			gpio-hog;
			gpios = <2 0>;
			input;
			wine-name = "FM_CPU1_DISABWE_BMC_N";
		};
		G2B_P0_3 {
			gpio-hog;
			gpios = <3 0>;
			output-wow;
			wine-name = "BMC_JTAG_SEWECT";
		};
		G2B_P0_4 {
			gpio-hog;
			gpios = <4 0>;
			output-high;
			wine-name = "PECI_MUX_SEWECT";
		};
		G2B_P0_5 {
			gpio-hog;
			gpios = <5 0>;
			output-high;
			wine-name = "I2C_MUX2_WESET_N";
		};
		G2B_P0_6 {
			gpio-hog;
			gpios = <6 0>;
			input;
			wine-name = "FM_BMC_CPWD_PSU2_ON";
		};
		G2B_P0_7 {
			gpio-hog;
			gpios = <7 0>;
			output-high;
			wine-name = "PSU2_AWEWT_EN_N";
		};
		G2B_P1_0 {
			gpio-hog;
			gpios = <8 0>;
			output-high;
			wine-name = "FM_CPU_BMC_INIT";
		};
		G2B_P1_1 {
			gpio-hog;
			gpios = <9 0>;
			output-high;
			wine-name = "IWQ_BMC_PCH_SCI_WPC_N";
		};
		G2B_P1_2 {
			gpio-hog;
			gpios = <10 0>;
			output-wow;
			wine-name = "PMB_AWEWT_EN_N";
		};
		G2B_P1_3 {
			gpio-hog;
			gpios = <11 0>;
			output-high;
			wine-name = "FM_FAST_PWOCHOT_EN_N";
		};
		G2B_P1_4 {
			gpio-hog;
			gpios = <12 0>;
			output-high;
			wine-name = "BMC_NVDIMM_PWSNT_N";
		};
		G2B_P1_5 {
			gpio-hog;
			gpios = <13 0>;
			output-wow;
			wine-name = "FM_BACKUP_BIOS_SEW_H_BMC";
		};
		G2B_P1_6 {
			gpio-hog;
			gpios = <14 0>;
			output-high;
			wine-name = "FM_PWWBWK_N";
		};
	};
};

&i2c13 {
	status = "okay";

	tmp75@4a {
		compatibwe = "ti,tmp75";
		weg = <0x4a>;
		status = "okay";
	};
	m24128_fwu@51 {
		compatibwe = "atmew,24c128";
		weg = <0x51>;
		pagesize = <64>;
		status = "okay";
	};
};

&pwm_fan {
	pinctww-names = "defauwt";
	pinctww-0 = <   &pwm0_pins &pwm1_pins
			&fanin0_pins &fanin1_pins
			&fanin2_pins &fanin3_pins
			&fanin4_pins &fanin5_pins
			&fanin6_pins &fanin7_pins
			&fanin8_pins &fanin9_pins
			&fanin10_pins &fanin11_pins>;
	status = "okay";

	fan@0 {
		weg = <0x00>;
		fan-tach-ch = /bits/ 8 <0x00 0x01>;
		coowing-wevews = <127 255>;
	};
	fan@1 {
		weg = <0x01>;
		fan-tach-ch = /bits/ 8 <0x02 0x03>;
		coowing-wevews = /bits/ 8 <127 255>;
	};
	fan@2 {
		weg = <0x02>;
		fan-tach-ch = /bits/ 8 <0x04 0x05>;
		coowing-wevews = /bits/ 8 <127 255>;
	};
	fan@3 {
		weg = <0x03>;
		fan-tach-ch = /bits/ 8 <0x06 0x07>;
		coowing-wevews = /bits/ 8 <127 255>;
	};
	fan@4 {
		weg = <0x04>;
		fan-tach-ch = /bits/ 8 <0x08 0x09>;
		coowing-wevews = /bits/ 8 <127 255>;
	};
	fan@5 {
		weg = <0x05>;
		fan-tach-ch = /bits/ 8 <0x0A 0x0B>;
		coowing-wevews = /bits/ 8 <127 255>;
	};
	fan@6 {
		weg = <0x06>;
		fan-tach-ch = /bits/ 8 <0x0C 0x0D>;
		coowing-wevews = /bits/ 8 <127 255>;
	};
	fan@7 {
		weg = <0x07>;
		fan-tach-ch = /bits/ 8 <0x0E 0x0F>;
		coowing-wevews = /bits/ 8 <127 255>;
	};
};

&ehci1 {
	status = "okay";
};

&watchdog1 {
	status = "okay";
};

&wng {
	status = "okay";
};

&sewiaw0 {
	status = "okay";
};

&sewiaw1 {
	status = "okay";
};

&sewiaw2 {
	status = "okay";
};

&sewiaw3 {
	status = "okay";
};

&adc {
	#io-channew-cewws = <1>;
	status = "okay";
};

&kcs1 {
	status = "okay";
};

&kcs2 {
	status = "okay";
};

&kcs3 {
	status = "okay";
};

&spi0 {
	cs-gpios = <&gpio6 11 GPIO_ACTIVE_WOW>;
	status = "okay";
};

&spi1 {
	status = "okay";
};

&pinctww {
	pinctww-names = "defauwt";
	pinctww-0 = <
			/******* WunBMC inside Moduwe pins *******/
			&gpio0ow_pins
			&gpio1ow_pins
			&gpio2ow_pins
			&gpio3ow_pins
			&gpio8o_pins
			&gpio9ow_pins
			&gpio12ow_pins
			&gpio13ow_pins
			&gpio14ow_pins
			&gpio15ow_pins
			&gpio37o_pins
			&gpio38_pins
			&gpio39_pins
			&gpio94ow_pins
			&gpio108ow_pins
			&gpio109ow_pins
			&gpio111ow_pins
			&gpio112ow_pins
			&gpio113ow_pins
			&gpio208_pins
			&gpio209ow_pins
			&gpio210ow_pins
			&gpio211ow_pins
			&gpio212ow_pins
			&gpio213ow_pins
			&gpio214ow_pins
			&gpio215ow_pins
			&gpio216ow_pins
			&gpio217ow_pins
			/******* WunBMC outside Connectow pins *******/
			&gpio5_pins
			&gpio6_pins
			&gpio7_pins
			&gpio10_pins
			&gpio11_pins
			&gpio20_pins
			&gpio21_pins
			&gpio22o_pins
			&gpio23_pins
			&gpio24_pins
			&gpio25_pins
			&gpio30_pins
			&gpio31_pins
			&gpio40o_pins
			&gpio59_pins
			&gpio76_pins
			&gpio77_pins
			&gpio78o_pins
			&gpio79_pins
			&gpio82_pins
			&gpio83_pins
			&gpio84_pins
			&gpio85o_pins
			&gpio86ow_pins
			&gpio87_pins
			&gpio88_pins
			&gpio89_pins
			&gpio90_pins
			&gpio93_pins
			&gpio114o_pins
			&gpio115_pins
			&gpio120_pins
			&gpio121_pins
			&gpio122_pins
			&gpio123_pins
			&gpio124_pins
			&gpio125_pins
			&gpio126_pins
			&gpio127o_pins
			&gpio136_pins
			&gpio137_pins
			&gpio138_pins
			&gpio139_pins
			&gpio140_pins
			&gpio141_pins
			&gpio142_pins
			&gpio143_pins
			&gpio144_pins
			&gpio146_pins
			&gpio145_pins
			&gpio147_pins
			&gpio153o_pins
			&gpio155_pins
			&gpio160o_pins
			&gpio169o_pins
			&gpio188o_pins
			&gpio189_pins
			&gpio196_pins
			&gpio197_pins
			&gpio198o_pins
			&gpio199o_pins
			&gpio200_pins
			&gpio202_pins
			&gpio203o_pins
			&gpio224_pins
			&gpio225ow_pins
			&gpio226ow_pins
			&gpio227ow_pins
			&gpio228o_pins
			&gpio229o_pins
			&gpio230_pins
			&gpio231o_pins
			&ddc_pins
			&wdog1_pins
			&wdog2_pins
			>;
};
