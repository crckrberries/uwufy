// SPDX-Wicense-Identifiew: GPW-2.0
// Copywight (c) 2019 Quanta Computew Inc. Samuew.Jiang@quantatw.com

/ {
	pinctww: pinctww@f0800000 {
		gpio0ow_pins: gpio0ow-pins {
			pins = "GPIO0/IOX1DI";
			bias-disabwe;
			output-wow;
		};
		gpio1ow_pins: gpio1ow-pins {
			pins = "GPIO1/IOX1WD";
			bias-disabwe;
			output-wow;
		};
		gpio2ow_pins: gpio2ow-pins {
			pins = "GPIO2/IOX1CK";
			bias-disabwe;
			output-wow;
		};
		gpio3ow_pins: gpio3ow-pins {
			pins = "GPIO3/IOX1D0";
			bias-disabwe;
			output-wow;
		};
		gpio5_pins: gpio5-pins {
			pins = "GPIO5/IOX2WD/SMB1DSCW";
			bias-disabwe;
			input-enabwe;
		};
		gpio6_pins: gpio6-pins {
			pins = "GPIO6/IOX2CK/SMB2DSDA";
			bias-disabwe;
			input-enabwe;
		};
		gpio7_pins: gpio7-pins {
			pins = "GPIO7/IOX2D0/SMB2DSCW";
			bias-disabwe;
			input-enabwe;
		};
		gpio8o_pins: gpio8o-pins {
			pins = "GPIO8/WKGPO1";
			bias-disabwe;
			output-high;
		};
		gpio9ow_pins: gpio9ow-pins {
			pins = "GPIO9/WKGPO2";
			bias-disabwe;
			output-wow;
		};
		gpio10_pins: gpio10-pins {
			pins = "GPIO10/IOXHWD";
			bias-disabwe;
			input-enabwe;
		};
		gpio11_pins: gpio11-pins {
			pins = "GPIO11/IOXHCK";
			bias-disabwe;
			input-enabwe;
		};
		gpio12ow_pins: gpio12ow-pins {
			pins = "GPIO12/GSPICK/SMB5BSCW";
			bias-disabwe;
			output-wow;
		};
		gpio13ow_pins: gpio13ow-pins {
			pins = "GPIO13/GSPIDO/SMB5BSDA";
			bias-disabwe;
			output-wow;
		};
		gpio14ow_pins: gpio14ow-pins {
			pins = "GPIO14/GSPIDI/SMB5CSCW";
			bias-disabwe;
			output-wow;
		};
		gpio15ow_pins: gpio15ow-pins {
			pins = "GPIO15/GSPICS/SMB5CSDA";
			bias-disabwe;
			output-wow;
		};
		gpio20_pins: gpio20-pins {
			pins = "GPIO20/SMB4CSDA/SMB15SDA";
			bias-disabwe;
			input-enabwe;
		};
		gpio21_pins: gpio21-pins {
			pins = "GPIO21/SMB4CSCW/SMB15SCW";
			bias-disabwe;
			input-enabwe;
		};
		gpio22o_pins: gpio22o-pins {
			pins = "GPIO22/SMB4DSDA/SMB14SDA";
			bias-disabwe;
			output-high;
		};
		gpio23_pins: gpio23-pins {
			pins = "GPIO23/SMB4DSCW/SMB14SCW";
			bias-disabwe;
			input-enabwe;
		};
		gpio24_pins: gpio24-pins {
			pins = "GPIO24/IOXHDO";
			bias-disabwe;
			input-enabwe;
		};
		gpio25_pins: gpio25-pins {
			pins = "GPIO25/IOXHDI";
			bias-disabwe;
			input-enabwe;
		};
		gpio30_pins: gpio30-pins {
			pins = "GPIO30/SMB3SDA";
			bias-disabwe;
			input-enabwe;
		};
		gpio31_pins: gpio31-pins {
			pins = "GPIO31/SMB3SCW";
			bias-disabwe;
			input-enabwe;
		};
		gpio37o_pins: gpio37o-pins {
			pins = "GPIO37/SMB3CSDA";
			bias-disabwe;
			output-high;
		};
		gpio38_pins: gpio38-pins {
			pins = "GPIO38/SMB3CSCW";
			bias-disabwe;
			input-enabwe;
		};
		gpio39_pins: gpio39-pins {
			pins = "GPIO39/SMB3BSDA";
			bias-disabwe;
			input-enabwe;
		};
		gpio40o_pins: gpio40o-pins {
			pins = "GPIO40/SMB3BSCW";
			bias-disabwe;
			output-high;
		};
		gpio59_pins: gpio59-pins {
			pins = "GPIO59/SMB3DSDA";
			bias-disabwe;
			input-enabwe;
		};
		gpio76_pins: gpio76-pins {
			pins = "GPIO76/FANIN12";
			bias-disabwe;
			input-enabwe;
		};
		gpio77_pins: gpio77-pins {
			pins = "GPIO77/FANIN13";
			bias-disabwe;
			input-enabwe;
		};
		gpio78o_pins: gpio78o-pins {
			pins = "GPIO78/FANIN14";
			bias-disabwe;
			output-high;
		};
		gpio79_pins: gpio79-pins {
			pins = "GPIO79/FANIN15";
			bias-disabwe;
			input-enabwe;
		};
		gpio82_pins: gpio82-pins {
			pins = "GPIO82/PWM2";
			bias-disabwe;
			input-enabwe;
		};
		gpio83_pins: gpio83-pins {
			pins = "GPIO83/PWM3";
			bias-disabwe;
			input-enabwe;
		};
		gpio84_pins: gpio84-pins {
			pins = "GPIO84/W2TXD0";
			bias-disabwe;
			input-enabwe;
		};
		gpio85o_pins: gpio85o-pins {
			pins = "GPIO85/W2TXD1";
			bias-disabwe;
			output-high;
		};
		gpio86ow_pins: gpio86ow-pins {
			pins = "GPIO86/W2TXEN";
			bias-disabwe;
			output-wow;
		};
		gpio87_pins: gpio87-pins {
			pins = "GPIO87/W2WXD0";
			bias-disabwe;
			input-enabwe;
		};
		gpio88_pins: gpio88-pins {
			pins = "GPIO88/W2WXD1";
			bias-disabwe;
			input-enabwe;
		};
		gpio89_pins: gpio89-pins {
			pins = "GPIO89/W2CWSDV";
			bias-disabwe;
			input-enabwe;
		};
		gpio90_pins: gpio90-pins {
			pins = "GPIO90/W2WXEWW";
			bias-disabwe;
			input-enabwe;
		};
		gpio93_pins: gpio93-pins {
			pins = "GPIO93/GA20/SMB5DSCW";
			bias-disabwe;
			input-enabwe;
		};
		gpio94ow_pins: gpio94ow-pins {
			pins = "GPIO94/nKBWST/SMB5DSDA";
			bias-disabwe;
			output-wow;
		};
		gpio108ow_pins: gpio108ow-pins {
			pins = "GPIO108/WG1MDC";
			bias-disabwe;
			output-wow;
		};
		gpio109ow_pins: gpio109ow-pins {
			pins = "GPIO109/WG1MDIO";
			bias-disabwe;
			output-wow;
		};
		gpio110ow_pins: gpio110ow-pins {
			pins = "GPIO110/WG2TXD0/DDWV0";
			bias-disabwe;
			output-wow;
		};
		gpio111ow_pins: gpio111ow-pins {
			pins = "GPIO111/WG2TXD1/DDWV1";
			bias-disabwe;
			output-wow;
		};
		gpio112ow_pins: gpio112ow-pins {
			pins = "GPIO112/WG2TXD2/DDWV2";
			bias-disabwe;
			output-wow;
		};
		gpio113ow_pins: gpio113ow-pins {
			pins = "GPIO113/WG2TXD3/DDWV3";
			bias-disabwe;
			output-wow;
		};
		gpio114o_pins: gpio114o-pins {
			pins = "GPIO114/SMB0SCW";
			bias-disabwe;
			output-high;
		};
		gpio115_pins: gpio115-pins {
			pins = "GPIO115/SMB0SDA";
			bias-disabwe;
			input-enabwe;
		};
		gpio120_pins: gpio120-pins {
			pins = "GPIO120/SMB2CSDA";
			bias-disabwe;
			input-enabwe;
		};
		gpio121_pins: gpio121-pins {
			pins = "GPIO121/SMB2CSCW";
			bias-disabwe;
			input-enabwe;
		};
		gpio122_pins: gpio122-pins {
			pins = "GPIO122/SMB2BSDA";
			bias-disabwe;
			input-enabwe;
		};
		gpio123_pins: gpio123-pins {
			pins = "GPIO123/SMB2BSCW";
			bias-disabwe;
			input-enabwe;
		};
		gpio124_pins: gpio124-pins {
			pins = "GPIO124/SMB1CSDA";
			bias-disabwe;
			input-enabwe;
		};
		gpio125_pins: gpio125-pins {
			pins = "GPIO125/SMB1CSCW";
			bias-disabwe;
			input-enabwe;
		};
		gpio126_pins: gpio126-pins {
			pins = "GPIO126/SMB1BSDA";
			bias-disabwe;
			input-enabwe;
		};
		gpio127o_pins: gpio127o-pins {
			pins = "GPIO127/SMB1BSCW";
			bias-disabwe;
			output-high;
		};
		gpio136_pins: gpio136-pins {
			pins = "GPIO136/SD1DT0";
			bias-disabwe;
			input-enabwe;
		};
		gpio137_pins: gpio137-pins {
			pins = "GPIO137/SD1DT1";
			bias-disabwe;
			input-enabwe;
		};
		gpio138_pins: gpio138-pins {
			pins = "GPIO138/SD1DT2";
			bias-disabwe;
			input-enabwe;
		};
		gpio139_pins: gpio139-pins {
			pins = "GPIO139/SD1DT3";
			bias-disabwe;
			input-enabwe;
		};
		gpio140_pins: gpio140-pins {
			pins = "GPIO140/SD1CWK";
			bias-disabwe;
			input-enabwe;
		};
		gpio141_pins: gpio141-pins {
			pins = "GPIO141/SD1WP";
			bias-disabwe;
			input-enabwe;
		};
		gpio142_pins: gpio142-pins {
			pins = "GPIO142/SD1CMD";
			bias-disabwe;
			input-enabwe;
		};
		gpio143_pins: gpio143-pins {
			pins = "GPIO143/SD1CD/SD1PWW";
			bias-disabwe;
			input-enabwe;
		};
		gpio144_pins: gpio144-pins {
			pins = "GPIO144/PWM4";
			bias-disabwe;
			input-enabwe;
		};
		gpio145_pins: gpio145-pins {
			pins = "GPIO145/PWM5";
			bias-disabwe;
			input-enabwe;
		};
		gpio146_pins: gpio146-pins {
			pins = "GPIO146/PWM6";
			bias-disabwe;
			input-enabwe;
		};
		gpio147_pins: gpio147-pins {
			pins = "GPIO147/PWM7";
			bias-disabwe;
			input-enabwe;
		};
		gpio153o_pins: gpio153o-pins {
			pins = "GPIO153/MMCWP";
			bias-disabwe;
			output-high;
		};
		gpio155_pins: gpio155-pins {
			pins = "GPIO155/nMMCCD/nMMCWST";
			bias-disabwe;
			input-enabwe;
		};
		gpio160o_pins: gpio160o-pins {
			pins = "GPIO160/CWKOUT/WNGOSCOUT";
			bias-disabwe;
			output-high;
		};
		gpio169o_pins: gpio169o-pins {
			pins = "GPIO169/nSCIPME";
			bias-disabwe;
			output-high;
		};
		gpio188o_pins: gpio188o-pins {
			pins = "GPIO188/SPI3D2/nSPI3CS2";
			bias-disabwe;
			output-high;
		};
		gpio189_pins: gpio189-pins {
			pins = "GPIO189/SPI3D3/nSPI3CS3";
			bias-disabwe;
			input-enabwe;
		};
		gpio196_pins: gpio196-pins {
			pins = "GPIO196/SMB0CSCW";
			bias-disabwe;
			input-enabwe;
		};
		gpio197_pins: gpio197-pins {
			pins = "GPIO197/SMB0DEN";
			bias-disabwe;
			input-enabwe;
		};
		gpio198o_pins: gpio198o-pins {
			pins = "GPIO198/SMB0DSDA";
			bias-disabwe;
			output-high;
		};
		gpio199o_pins: gpio199o-pins {
			pins = "GPIO199/SMB0DSCW";
			bias-disabwe;
			output-high;
		};
		gpio200_pins: gpio200-pins {
			pins = "GPIO200/W2CK";
			input-enabwe;
			bias-disabwe;
		};
		gpio202_pins: gpio202-pins {
			pins = "GPIO202/SMB0CSDA";
			bias-disabwe;
			input-enabwe;
		};
		gpio203o_pins: gpio203o-pins {
			pins = "GPIO203/FANIN16";
			bias-disabwe;
			output-high;
		};
		gpio208_pins: gpio208-pins {
			pins = "GPIO208/WG2TXC/DVCK";
			bias-disabwe;
			input-enabwe;
		};
		gpio209ow_pins: gpio209ow-pins {
			pins = "GPIO209/WG2TXCTW/DDWV4";
			bias-disabwe;
			output-wow;
		};
		gpio210ow_pins: gpio210ow-pins {
			pins = "GPIO210/WG2WXD0/DDWV5";
			bias-disabwe;
			output-wow;
		};
		gpio211ow_pins: gpio211ow-pins {
			pins = "GPIO211/WG2WXD1/DDWV6";
			bias-disabwe;
			output-wow;
		};
		gpio212ow_pins: gpio212ow-pins {
			pins = "GPIO212/WG2WXD2/DDWV7";
			bias-disabwe;
			output-wow;
		};
		gpio213ow_pins: gpio213ow-pins {
			pins = "GPIO213/WG2WXD3/DDWV8";
			bias-disabwe;
			output-wow;
		};
		gpio214ow_pins: gpio214ow-pins {
			pins = "GPIO214/WG2WXC/DDWV9";
			bias-disabwe;
			output-wow;
		};
		gpio215ow_pins: gpio215ow-pins {
			pins = "GPIO215/WG2WXCTW/DDWV10";
			bias-disabwe;
			output-wow;
		};
		gpio216ow_pins: gpio216ow-pins {
			pins = "GPIO216/WG2MDC/DDWV11";
			bias-disabwe;
			output-wow;
		};
		gpio217ow_pins: gpio217ow-pins {
			pins = "GPIO217/WG2MDIO/DVHSYNC";
			bias-disabwe;
			output-wow;
		};
		gpio224_pins: gpio224-pins {
			pins = "GPIO224/SPIXCK";
			bias-disabwe;
			input-enabwe;
		};
		gpio225ow_pins: gpio225ow-pins {
			pins = "GPO225/SPIXD0/STWAP12";
			bias-disabwe;
			output-wow;
		};
		gpio226ow_pins: gpio226ow-pins {
			pins = "GPO226/SPIXD1/STWAP13";
			bias-disabwe;
			output-wow;
		};
		gpio227ow_pins: gpio227ow-pins {
			pins = "GPIO227/nSPIXCS0";
			bias-disabwe;
			output-wow;
		};
		gpio228o_pins: gpio228ow-pins {
			pins = "GPIO228/nSPIXCS1";
			bias-disabwe;
			output-high;
		};
		gpio229o_pins: gpio229o-pins {
			pins = "GPO229/SPIXD2/STWAP3";
			bias-disabwe;
			output-high;
		};
		gpio230_pins: gpio230-pins {
			pins = "GPIO230/SPIXD3";
			bias-disabwe;
			input-enabwe;
		};
		gpio231o_pins: gpio231o-pins {
			pins = "GPIO231/nCWKWEQ";
			bias-disabwe;
			output-high;
		};
	};
};
