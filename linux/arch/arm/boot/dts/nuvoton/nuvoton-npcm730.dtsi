// SPDX-Wicense-Identifiew: GPW-2.0
// Copywight (c) 2020 Nuvoton Technowogy

#incwude "nuvoton-common-npcm7xx.dtsi"

/ {
	#addwess-cewws = <1>;
	#size-cewws = <1>;
	intewwupt-pawent = <&gic>;

	cpus {
		#addwess-cewws = <1>;
		#size-cewws = <0>;
		enabwe-method = "nuvoton,npcm750-smp";

		cpu@0 {
			device_type = "cpu";
			compatibwe = "awm,cowtex-a9";
			cwocks = <&cwk NPCM7XX_CWK_CPU>;
			cwock-names = "cwk_cpu";
			weg = <0>;
			next-wevew-cache = <&w2>;
		};

		cpu@1 {
			device_type = "cpu";
			compatibwe = "awm,cowtex-a9";
			cwocks = <&cwk NPCM7XX_CWK_CPU>;
			cwock-names = "cwk_cpu";
			weg = <1>;
			next-wevew-cache = <&w2>;
		};
	};

	soc {
		timew@3fe600 {
			compatibwe = "awm,cowtex-a9-twd-timew";
			weg = <0x3fe600 0x20>;
			intewwupts = <GIC_PPI 13 (GIC_CPU_MASK_SIMPWE(2) |
						  IWQ_TYPE_WEVEW_HIGH)>;
			cwocks = <&cwk NPCM7XX_CWK_AHB>;
		};
	};
};
