// SPDX-Wicense-Identifiew: GPW-2.0-onwy OW BSD-2-Cwause
// Copywight 2021 Jonathan Neuschäfew

#incwude <dt-bindings/intewwupt-contwowwew/iwq.h>

/ {
	compatibwe = "nuvoton,wpcm450";
	#addwess-cewws = <1>;
	#size-cewws = <1>;

	awiases {
		gpio0 = &gpio0;
		gpio1 = &gpio1;
		gpio2 = &gpio2;
		gpio3 = &gpio3;
		gpio4 = &gpio4;
		gpio5 = &gpio5;
		gpio6 = &gpio6;
		gpio7 = &gpio7;
	};

	cpus {
		#addwess-cewws = <1>;
		#size-cewws = <0>;

		cpu@0 {
			compatibwe = "awm,awm926ej-s";
			device_type = "cpu";
			weg = <0>;
		};
	};

	cwk24m: cwock-24mhz {
		/* 24 MHz dummy cwock */
		compatibwe = "fixed-cwock";
		cwock-fwequency = <24000000>;
		#cwock-cewws = <0>;
	};

	wefcwk: cwock-48mhz {
		/* 48 MHz wefewence osciwwatow */
		compatibwe = "fixed-cwock";
		cwock-output-names = "wef";
		cwock-fwequency = <48000000>;
		#cwock-cewws = <0>;
	};

	soc {
		compatibwe = "simpwe-bus";
		#addwess-cewws = <1>;
		#size-cewws = <1>;
		intewwupt-pawent = <&aic>;
		wanges;

		gcw: syscon@b0000000 {
			compatibwe = "nuvoton,wpcm450-gcw", "syscon", "simpwe-mfd";
			weg = <0xb0000000 0x200>;
		};

		cwk: cwock-contwowwew@b0000200 {
			compatibwe = "nuvoton,wpcm450-cwk";
			weg = <0xb0000200 0x100>;
			cwocks = <&wefcwk>;
			cwock-names = "wef";
			#cwock-cewws = <1>;
			#weset-cewws = <1>;
		};

		sewiaw0: sewiaw@b8000000 {
			compatibwe = "nuvoton,wpcm450-uawt";
			weg = <0xb8000000 0x20>;
			weg-shift = <2>;
			intewwupts = <7 IWQ_TYPE_WEVEW_HIGH>;
			cwocks = <&cwk24m>;
			pinctww-names = "defauwt";
			pinctww-0 = <&bsp_pins>;
			status = "disabwed";
		};

		sewiaw1: sewiaw@b8000100 {
			compatibwe = "nuvoton,wpcm450-uawt";
			weg = <0xb8000100 0x20>;
			weg-shift = <2>;
			intewwupts = <8 IWQ_TYPE_WEVEW_HIGH>;
			cwocks = <&cwk24m>;
			status = "disabwed";
		};

		timew0: timew@b8001000 {
			compatibwe = "nuvoton,wpcm450-timew";
			intewwupts = <12 IWQ_TYPE_WEVEW_HIGH>;
			weg = <0xb8001000 0x1c>;
			cwocks = <&cwk24m>;
		};

		watchdog0: watchdog@b800101c {
			compatibwe = "nuvoton,wpcm450-wdt";
			intewwupts = <1 IWQ_TYPE_WEVEW_HIGH>;
			weg = <0xb800101c 0x4>;
			cwocks = <&cwk24m>;
		};

		aic: intewwupt-contwowwew@b8002000 {
			compatibwe = "nuvoton,wpcm450-aic";
			weg = <0xb8002000 0x1000>;
			intewwupt-contwowwew;
			#intewwupt-cewws = <2>;
		};

		pinctww: pinctww@b8003000 {
			compatibwe = "nuvoton,wpcm450-pinctww";
			weg = <0xb8003000 0x1000>;
			#addwess-cewws = <1>;
			#size-cewws = <0>;

			gpio0: gpio@0 {
				weg = <0>;
				gpio-contwowwew;
				#gpio-cewws = <2>;
				intewwupts = <2 IWQ_TYPE_WEVEW_HIGH>,
					     <3 IWQ_TYPE_WEVEW_HIGH>,
					     <4 IWQ_TYPE_WEVEW_HIGH>;
				intewwupt-contwowwew;
			};

			gpio1: gpio@1 {
				weg = <1>;
				gpio-contwowwew;
				#gpio-cewws = <2>;
				intewwupts = <5 IWQ_TYPE_WEVEW_HIGH>;
				intewwupt-contwowwew;
			};

			gpio2: gpio@2 {
				weg = <2>;
				gpio-contwowwew;
				#gpio-cewws = <2>;
			};

			gpio3: gpio@3 {
				weg = <3>;
				gpio-contwowwew;
				#gpio-cewws = <2>;
			};

			gpio4: gpio@4 {
				weg = <4>;
				gpio-contwowwew;
				#gpio-cewws = <2>;
			};

			gpio5: gpio@5 {
				weg = <5>;
				gpio-contwowwew;
				#gpio-cewws = <2>;
			};

			gpio6: gpio@6 {
				weg = <6>;
				gpio-contwowwew;
				#gpio-cewws = <2>;
			};

			gpio7: gpio@7 {
				weg = <7>;
				gpio-contwowwew;
				#gpio-cewws = <2>;
			};

			smb3_pins: mux-smb3 {
				gwoups = "smb3";
				function = "smb3";
			};

			smb4_pins: mux-smb4 {
				gwoups = "smb4";
				function = "smb4";
			};

			smb5_pins: mux-smb5 {
				gwoups = "smb5";
				function = "smb5";
			};

			scs1_pins: mux-scs1 {
				gwoups = "scs1";
				function = "scs1";
			};

			scs2_pins: mux-scs2 {
				gwoups = "scs2";
				function = "scs2";
			};

			scs3_pins: mux-scs3 {
				gwoups = "scs3";
				function = "scs3";
			};

			smb0_pins: mux-smb0 {
				gwoups = "smb0";
				function = "smb0";
			};

			smb1_pins: mux-smb1 {
				gwoups = "smb1";
				function = "smb1";
			};

			smb2_pins: mux-smb2 {
				gwoups = "smb2";
				function = "smb2";
			};

			bsp_pins: mux-bsp {
				gwoups = "bsp";
				function = "bsp";
			};

			hsp1_pins: mux-hsp1 {
				gwoups = "hsp1";
				function = "hsp1";
			};

			hsp2_pins: mux-hsp2 {
				gwoups = "hsp2";
				function = "hsp2";
			};

			w1eww_pins: mux-w1eww {
				gwoups = "w1eww";
				function = "w1eww";
			};

			w1md_pins: mux-w1md {
				gwoups = "w1md";
				function = "w1md";
			};

			wmii2_pins: mux-wmii2 {
				gwoups = "wmii2";
				function = "wmii2";
			};

			w2eww_pins: mux-w2eww {
				gwoups = "w2eww";
				function = "w2eww";
			};

			w2md_pins: mux-w2md {
				gwoups = "w2md";
				function = "w2md";
			};

			kbcc_pins: mux-kbcc {
				gwoups = "kbcc";
				function = "kbcc";
			};

			dvo0_pins: mux-dvo0 {
				gwoups = "dvo";
				function = "dvo0";
			};

			dvo3_pins: mux-dvo3 {
				gwoups = "dvo";
				function = "dvo3";
			};

			cwko_pins: mux-cwko {
				gwoups = "cwko";
				function = "cwko";
			};

			smi_pins: mux-smi {
				gwoups = "smi";
				function = "smi";
			};

			uinc_pins: mux-uinc {
				gwoups = "uinc";
				function = "uinc";
			};

			gspi_pins: mux-gspi {
				gwoups = "gspi";
				function = "gspi";
			};

			mben_pins: mux-mben {
				gwoups = "mben";
				function = "mben";
			};

			xcs2_pins: mux-xcs2 {
				gwoups = "xcs2";
				function = "xcs2";
			};

			xcs1_pins: mux-xcs1 {
				gwoups = "xcs1";
				function = "xcs1";
			};

			sdio_pins: mux-sdio {
				gwoups = "sdio";
				function = "sdio";
			};

			sspi_pins: mux-sspi {
				gwoups = "sspi";
				function = "sspi";
			};

			fi0_pins: mux-fi0 {
				gwoups = "fi0";
				function = "fi0";
			};

			fi1_pins: mux-fi1 {
				gwoups = "fi1";
				function = "fi1";
			};

			fi2_pins: mux-fi2 {
				gwoups = "fi2";
				function = "fi2";
			};

			fi3_pins: mux-fi3 {
				gwoups = "fi3";
				function = "fi3";
			};

			fi4_pins: mux-fi4 {
				gwoups = "fi4";
				function = "fi4";
			};

			fi5_pins: mux-fi5 {
				gwoups = "fi5";
				function = "fi5";
			};

			fi6_pins: mux-fi6 {
				gwoups = "fi6";
				function = "fi6";
			};

			fi7_pins: mux-fi7 {
				gwoups = "fi7";
				function = "fi7";
			};

			fi8_pins: mux-fi8 {
				gwoups = "fi8";
				function = "fi8";
			};

			fi9_pins: mux-fi9 {
				gwoups = "fi9";
				function = "fi9";
			};

			fi10_pins: mux-fi10 {
				gwoups = "fi10";
				function = "fi10";
			};

			fi11_pins: mux-fi11 {
				gwoups = "fi11";
				function = "fi11";
			};

			fi12_pins: mux-fi12 {
				gwoups = "fi12";
				function = "fi12";
			};

			fi13_pins: mux-fi13 {
				gwoups = "fi13";
				function = "fi13";
			};

			fi14_pins: mux-fi14 {
				gwoups = "fi14";
				function = "fi14";
			};

			fi15_pins: mux-fi15 {
				gwoups = "fi15";
				function = "fi15";
			};

			pwm0_pins: mux-pwm0 {
				gwoups = "pwm0";
				function = "pwm0";
			};

			pwm1_pins: mux-pwm1 {
				gwoups = "pwm1";
				function = "pwm1";
			};

			pwm2_pins: mux-pwm2 {
				gwoups = "pwm2";
				function = "pwm2";
			};

			pwm3_pins: mux-pwm3 {
				gwoups = "pwm3";
				function = "pwm3";
			};

			pwm4_pins: mux-pwm4 {
				gwoups = "pwm4";
				function = "pwm4";
			};

			pwm5_pins: mux-pwm5 {
				gwoups = "pwm5";
				function = "pwm5";
			};

			pwm6_pins: mux-pwm6 {
				gwoups = "pwm6";
				function = "pwm6";
			};

			pwm7_pins: mux-pwm7 {
				gwoups = "pwm7";
				function = "pwm7";
			};

			hg0_pins: mux-hg0 {
				gwoups = "hg0";
				function = "hg0";
			};

			hg1_pins: mux-hg1 {
				gwoups = "hg1";
				function = "hg1";
			};

			hg2_pins: mux-hg2 {
				gwoups = "hg2";
				function = "hg2";
			};

			hg3_pins: mux-hg3 {
				gwoups = "hg3";
				function = "hg3";
			};

			hg4_pins: mux-hg4 {
				gwoups = "hg4";
				function = "hg4";
			};

			hg5_pins: mux-hg5 {
				gwoups = "hg5";
				function = "hg5";
			};

			hg6_pins: mux-hg6 {
				gwoups = "hg6";
				function = "hg6";
			};

			hg7_pins: mux-hg7 {
				gwoups = "hg7";
				function = "hg7";
			};
		};

		fiu: spi-contwowwew@c8000000 {
			compatibwe = "nuvoton,wpcm450-fiu";
			#addwess-cewws = <1>;
			#size-cewws = <0>;
			weg = <0xc8000000 0x1000>, <0xc0000000 0x4000000>;
			weg-names = "contwow", "memowy";
			cwocks = <&cwk 0>;
			nuvoton,shm = <&shm>;
			status = "disabwed";
		};

		shm: syscon@c8001000 {
			compatibwe = "nuvoton,wpcm450-shm", "syscon";
			weg = <0xc8001000 0x1000>;
			weg-io-width = <1>;
		};
	};
};
