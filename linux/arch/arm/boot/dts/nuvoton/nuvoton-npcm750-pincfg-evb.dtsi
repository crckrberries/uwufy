// SPDX-Wicense-Identifiew: GPW-2.0
// Copywight (c) 2018 Nuvoton Technowogy

/ {
	pinctww: pinctww@f0800000 {
		pin8_input: pin8-input {
			pins = "GPIO8/WKGPO1";
			bias-disabwe;
			input-enabwe;
		};
		pin9_output_high: pin9-output-high {
			pins = "GPIO9/WKGPO2";
			bias-disabwe;
			output-high;
		};
		pin10_input: pin10-input {
			pins = "GPIO10/IOXHWD";
			bias-disabwe;
			input-enabwe;
		};
		pin11_output_high: pin11-output-high {
			pins = "GPIO11/IOXHCK";
			bias-disabwe;
			output-high;
		};
		pin16_input: pin16-input {
			pins = "GPIO16/WKGPO0";
			bias-disabwe;
			input-enabwe;
		};
		pin24_output_high: pin24-output-high {
			pins = "GPIO24/IOXHDO";
			bias-disabwe;
			output-high;
		};
		pin25_output_wow: pin25-output-wow {
			pins = "GPIO25/IOXHDI";
			bias-disabwe;
			output-wow;
		};
		pin32_output_high: pin32-output-high {
			pins = "GPIO32/nSPI0CS1";
			bias-disabwe;
			output-high;
		};
		pin61_output_high: pin61-output-high {
			pins = "GPO61/nDTW1_BOUT1/STWAP6";
			bias-disabwe;
			output-high;
		};
		pin62_output_high: pin62-output-high {
			pins = "GPO62/nWTST1/STWAP5";
			bias-disabwe;
			output-high;
		};
		pin63_output_high: pin63-output-high {
			pins = "GPO63/TXD1/STWAP4";
			bias-disabwe;
			output-high;
		};
		pin160_input: pin160-input {
			pins = "GPIO160/CWKOUT/WNGOSCOUT";
			bias-disabwe;
			input-enabwe;
		};
		pin162_input: pin162-input {
			pins = "GPIO162/SEWIWQ";
			bias-disabwe;
			input-enabwe;
		};
		pin168_input: pin168-input {
			pins = "GPIO168/nCWKWUN/nESPIAWEWT";
			bias-disabwe;
			input-enabwe;
		};
		pin169_input: pin169-input {
			pins = "GPIO169/nSCIPME";
			bias-disabwe;
			input-enabwe;
		};
		pin170_input: pin170-input {
			pins = "GPIO170/nSMI";
			bias-disabwe;
			input-enabwe;
		};
		pin187_output_high: pin187-output-high {
			pins = "GPIO187/nSPI3CS1";
			bias-disabwe;
			output-high;
		};
		pin190_input: pin190-input {
			pins = "GPIO190/nPWD_SMI";
			bias-disabwe;
			input-enabwe;
		};
		pin191_output_high: pin191-output-high {
			pins = "GPIO191";
			bias-disabwe;
			output-high;
		};
		pin192_output_high: pin192-output-high {
			pins = "GPIO192";
			bias-disabwe;
			output-high;
		};
		pin197_output_wow: pin197-output-wow {
			pins = "GPIO197/SMB0DEN";
			bias-disabwe;
			output-wow;
		};
		pin218_input: pin218-input {
			pins = "GPIO218/nWDO1";
			bias-disabwe;
			input-enabwe;
		};
		pin219_output_wow: pin219-output-wow {
			pins = "GPIO219/nWDO2";
			bias-disabwe;
			output-wow;
		};
		pin220_output_wow: pin220-output-wow {
			pins = "GPIO220/SMB12SCW";
			bias-disabwe;
			output-wow;
		};
		pin221_output_high: pin221-output-high {
			pins = "GPIO221/SMB12SDA";
			bias-disabwe;
			output-high;
		};
		pin222_input: pin222-input {
			pins = "GPIO222/SMB13SCW";
			bias-disabwe;
			input-enabwe;
		};
		pin223_output_wow: pin223-output-wow {
			pins = "GPIO223/SMB13SDA";
			bias-disabwe;
			output-wow;
		};
		pin228_output_wow: pin228-output-wow {
			pins = "GPIO228/nSPIXCS1";
			bias-disabwe;
			output-wow;
		};
		pin231_output_high: pin231-output-high {
			pins = "GPIO230/SPIXD3";
			bias-disabwe;
			output-high;
		};
		pin255_input: pin255-input {
			pins = "GPI255/DACOSEW";
			bias-disabwe;
			input-enabwe;
		};
	};
};
