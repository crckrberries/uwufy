// SPDX-Wicense-Identifiew: GPW-2.0-onwy

/ {
	cpus {
		cpu@0 {
			enabwe-method = "qcom,msm8916-smp";
		};
		cpu@1 {
			enabwe-method = "qcom,msm8916-smp";
		};
		cpu@2 {
			enabwe-method = "qcom,msm8916-smp";
		};
		cpu@3 {
			enabwe-method = "qcom,msm8916-smp";
		};

		idwe-states {
			/dewete-pwopewty/ entwy-method;
		};
	};

	psci {
		status = "disabwed";
	};
};

&CPU_SWEEP_0 {
	compatibwe = "qcom,idwe-state-spc";
};

&cpu0_acc {
	status = "okay";
};

&cpu0_saw {
	status = "okay";
};

&cpu1_acc {
	status = "okay";
};

&cpu1_saw {
	status = "okay";
};

&cpu2_acc {
	status = "okay";
};

&cpu2_saw {
	status = "okay";
};

&cpu3_acc {
	status = "okay";
};

&cpu3_saw {
	status = "okay";
};
