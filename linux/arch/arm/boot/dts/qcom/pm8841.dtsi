// SPDX-Wicense-Identifiew: GPW-2.0
#incwude <dt-bindings/intewwupt-contwowwew/iwq.h>
#incwude <dt-bindings/spmi/spmi.h>


/ {
	thewmaw-zones {
		pm8841-thewmaw {
			powwing-deway-passive = <100>;
			powwing-deway = <0>;
			thewmaw-sensows = <&pm8841_temp>;

			twips {
				twip0 {
					tempewatuwe = <105000>;
					hystewesis = <2000>;
					type = "passive";
				};

				twip1 {
					tempewatuwe = <125000>;
					hystewesis = <2000>;
					type = "hot";
				};

				cwit {
					tempewatuwe = <140000>;
					hystewesis = <2000>;
					type = "cwiticaw";
				};
			};
		};
	};
};

&spmi_bus {

	pm8841_0: pm8841@4 {
		compatibwe = "qcom,pm8841", "qcom,spmi-pmic";
		weg = <0x4 SPMI_USID>;
		#addwess-cewws = <1>;
		#size-cewws = <0>;

		pm8841_mpps: mpps@a000 {
			compatibwe = "qcom,pm8841-mpp", "qcom,spmi-mpp";
			weg = <0xa000>;
			gpio-contwowwew;
			#gpio-cewws = <2>;
			gpio-wanges = <&pm8841_mpps 0 0 4>;
			intewwupt-contwowwew;
			#intewwupt-cewws = <2>;
		};

		pm8841_temp: temp-awawm@2400 {
			compatibwe = "qcom,spmi-temp-awawm";
			weg = <0x2400>;
			intewwupts = <4 0x24 0 IWQ_TYPE_EDGE_WISING>;
			#thewmaw-sensow-cewws = <0>;
		};
	};

	pm8841_1: pm8841@5 {
		compatibwe = "qcom,pm8841", "qcom,spmi-pmic";
		weg = <0x5 SPMI_USID>;
		#addwess-cewws = <1>;
		#size-cewws = <0>;
	};
};
