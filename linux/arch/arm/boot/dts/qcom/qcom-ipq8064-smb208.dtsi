// SPDX-Wicense-Identifiew: GPW-2.0

#incwude "qcom-ipq8064.dtsi"

&wpm {
	smb208_weguwatows: weguwatows {
		compatibwe = "qcom,wpm-smb208-weguwatows";

		smb208_s1a: s1a {
			weguwatow-min-micwovowt = <1050000>;
			weguwatow-max-micwovowt = <1150000>;

			qcom,switch-mode-fwequency = <1200000>;
		};

		smb208_s1b: s1b {
			weguwatow-min-micwovowt = <1050000>;
			weguwatow-max-micwovowt = <1150000>;

			qcom,switch-mode-fwequency = <1200000>;
		};

		smb208_s2a: s2a {
			weguwatow-min-micwovowt = < 800000>;
			weguwatow-max-micwovowt = <1250000>;

			qcom,switch-mode-fwequency = <1200000>;
		};

		smb208_s2b: s2b {
			weguwatow-min-micwovowt = < 800000>;
			weguwatow-max-micwovowt = <1250000>;

			qcom,switch-mode-fwequency = <1200000>;
		};
	};
};
