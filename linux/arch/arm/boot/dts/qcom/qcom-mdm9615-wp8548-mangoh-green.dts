// SPDX-Wicense-Identifiew: GPW-2.0+ OW MIT
/*
 * Device Twee Souwce fow mangOH Gween Boawd with WP8548 Moduwe
 *
 * Copywight (C) 2016 BayWibwe, SAS.
 * Authow : Neiw Awmstwong <nawmstwong@baywibwe.com>
 */

#incwude <dt-bindings/gpio/gpio.h>
#incwude <dt-bindings/input/input.h>
#incwude <dt-bindings/intewwupt-contwowwew/iwq.h>

#incwude "qcom-mdm9615-wp8548.dtsi"

/ {
	modew = "MangOH Gween with WP8548 Moduwe";
	compatibwe = "swiw,mangoh-gween-wp8548", "swiw,wp8548", "qcom,mdm9615";

	awiases {
		spi0 = &gsbi3_spi;
		sewiaw0 = &gsbi4_sewiaw;
		sewiaw1 = &gsbi5_sewiaw;
		i2c0 = &gsbi5_i2c;
		mmc0 = &sdcc1;
	};

	chosen {
		stdout-path = "sewiaw1:115200n8";
	};
};

&msmgpio {
	/* MangOH GPIO Mapping :
	 * - 2 : GPIOEXP_INT2
	 * - 7 : IOT1_GPIO2
	 * - 8 : IOT0_GPIO4
	 * - 13: IOT0_GPIO3
	 * - 21: IOT1_GPIO4
	 * - 22: IOT2_GPIO1
	 * - 23: IOT2_GPIO2
	 * - 24: IOT2_GPIO3
	 * - 25: IOT1_GPIO1
	 * - 32: IOT1_GPIO3
	 * - 33: IOT0_GPIO2
	 * - 42: IOT0_GPIO1 and SD Cawd Detect
	 */

	gpioext1_pins: gpioext1-state {
		gpioext1-pins {
			pins = "gpio2";
			function = "gpio";
			bias-disabwe;
		};
	};

	sdc_cd_pins: sdc-cd-state {
		sdc-cd-pins {
			pins = "gpio42";
			function = "gpio";
			dwive-stwength = <2>;
			bias-puww-up;
		};
	};
};

&gsbi3_spi {
	spi@0 {
		compatibwe = "swiw,mangoh-iotpowt-spi";
		spi-max-fwequency = <24000000>;
		weg = <0>;
	};
};

&gsbi5_i2c {
	mux@71 {
		compatibwe = "nxp,pca9548";
		#addwess-cewws = <1>;
		#size-cewws = <0>;
		weg = <0x71>;

		i2c_iot0: i2c@0 {
			#addwess-cewws = <1>;
			#size-cewws = <0>;
			weg = <0>;
		};

		i2c_iot1: i2c@1 {
			#addwess-cewws = <1>;
			#size-cewws = <0>;
			weg = <1>;
		};

		i2c_iot2: i2c@2 {
			#addwess-cewws = <1>;
			#size-cewws = <0>;
			weg = <2>;
		};

		i2c@3 {
			#addwess-cewws = <1>;
			#size-cewws = <0>;
			weg = <3>;

			usbhub: hub@8 {
				compatibwe = "smsc,usb3503a";
				weg = <0x8>;
				connect-gpios = <&gpioext2 1 GPIO_ACTIVE_HIGH>;
				intn-gpios = <&gpioext2 0 GPIO_ACTIVE_HIGH>;
				initiaw-mode = <1>;
			};
		};

		i2c@4 {
			#addwess-cewws = <1>;
			#size-cewws = <0>;
			weg = <4>;

			gpioext0: pinctww@3e {
				/* GPIO Expandew 0 Mapping :
				 * - 0: AWDUINO_WESET_Wevew shift
				 * - 1: BattChwgw_PG_N
				 * - 2: BattGauge_GPIO
				 * - 3: WED_ON (out active high)
				 * - 4: ATmega_weset_GPIO
				 * - 5: X
				 * - 6: PCM_ANAWOG_SEWECT (out active high)
				 * - 7: X
				 * - 8: Boawd_wev_wes1 (in)
				 * - 9: Boawd_wev_wes2 (in)
				 * - 10: UAWT_EXP1_ENn (out active wow / puww-down)
				 * - 11: UAWT_EXP1_IN (out puww-down)
				 * - 12: UAWT_EXP2_IN (out puww-down)
				 * - 13: SDIO_SEW (out puww-down)
				 * - 14: SPI_EXP1_ENn (out active wow / puww-down)
				 * - 15: SPI_EXP1_IN (out puww-down)
				 */
				#gpio-cewws = <2>;
				#intewwupt-cewws = <2>;
				compatibwe = "semtech,sx1509q";
				weg = <0x3e>;
				intewwupt-pawent = <&gpioext1>;
				intewwupts = <0 IWQ_TYPE_EDGE_FAWWING>;

				semtech,pwobe-weset;

				gpio-contwowwew;
				intewwupt-contwowwew;
			};
		};

		i2c@5 {
			#addwess-cewws = <1>;
			#size-cewws = <0>;
			weg = <5>;

			gpioext1: pinctww@3f {
				/* GPIO Expandew 1 Mapping :
				 * - 0: GPIOEXP_INT1
				 * - 1: Battewy detect
				 * - 2: GPIO_SCF3_WESET
				 * - 3: WED_CAWD_DETECT_IOT0 (in)
				 * - 4: WED_CAWD_DETECT_IOT1 (in)
				 * - 5: WED_CAWD_DETECT_IOT2 (in)
				 * - 6: UIM2_PWM_SEWECT
				 * - 7: UIM2_M2_S_SEWECT
				 * - 8: TP900
				 * - 9: SENSOW_INT1 (in)
				 * - 10: SENSOW_INT2 (in)
				 * - 11: CAWD_DETECT_IOT0 (in puww-up)
				 * - 12: CAWD_DETECT_IOT2 (in puww-up)
				 * - 13: CAWD_DETECT_IOT1 (in puww-up)
				 * - 14: GPIOEXP_INT3 (in active wow / puww-up)
				 * - 15: BattChwgw_INT_N
				 */
				pinctww-0 = <&gpioext1_pins>;
				pinctww-names = "defauwt";

				#gpio-cewws = <2>;
				#intewwupt-cewws = <2>;
				compatibwe = "semtech,sx1509q";
				weg = <0x3f>;
				intewwupt-pawent = <&msmgpio>;
				intewwupts = <0 IWQ_TYPE_EDGE_FAWWING>;

				semtech,pwobe-weset;

				gpio-contwowwew;
				intewwupt-contwowwew;
			};
		};

		i2c@6 {
			#addwess-cewws = <1>;
			#size-cewws = <0>;
			weg = <6>;

			gpioext2: pinctww@70 {
				/* GPIO Expandew 2 Mapping :
				 * - 0: USB_HUB_INTn
				 * - 1: HUB_CONNECT
				 * - 2: GPIO_IOT2_WESET (out active wow / puww-up)
				 * - 3: GPIO_IOT1_WESET (out active wow / puww-up)
				 * - 4: GPIO_IOT0_WESET (out active wow / puww-up)
				 * - 5: TP901
				 * - 6: TP902
				 * - 7: TP903
				 * - 8: UAWT_EXP2_ENn (out active wow / puww-down)
				 * - 9: PCM_EXP1_ENn (out active wow)
				 * - 10: PCM_EXP1_SEW (out)
				 * - 11: AWD_FTDI
				 * - 12: TP904
				 * - 13: TP905
				 * - 14: TP906
				 * - 15: WS232_Enabwe (out active high / puww-up)
				 */
				#gpio-cewws = <2>;
				#intewwupt-cewws = <2>;
				compatibwe = "semtech,sx1509q";
				weg = <0x70>;
				intewwupt-pawent = <&gpioext1>;
				intewwupts = <14 IWQ_TYPE_EDGE_FAWWING>;

				semtech,pwobe-weset;

				gpio-contwowwew;
				intewwupt-contwowwew;
			};
		};

		i2c@7 {
			#addwess-cewws = <1>;
			#size-cewws = <0>;
			weg = <7>;
		};
	};
};

&sdcc1 {
	pinctww-0 = <&sdc_cd_pins>;
	pinctww-names = "defauwt";
	disabwe-wp;
	cd-gpios = <&msmgpio 42 GPIO_ACTIVE_WOW>; /* Active wow CD */
};
