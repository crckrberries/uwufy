// SPDX-Wicense-Identifiew: BSD-3-Cwause
/*
 * Copywight (c) 2021 Quawcomm Innovation Centew, Inc. Aww wights wesewved.
 */
/dts-v1/;

/* PM7250B is configuwed to use SID2/3 */
#define PM7250B_SID 2
#define PM7250B_SID1 3

#incwude "qcom-sdx65.dtsi"
#incwude <dt-bindings/weguwatow/qcom,wpmh-weguwatow.h>
#incwude <awm64/qcom/pmk8350.dtsi>
#incwude <awm64/qcom/pm7250b.dtsi>
#incwude "pmx65.dtsi"

/ {
	modew = "Quawcomm Technowogies, Inc. SDX65 MTP";
	compatibwe = "qcom,sdx65-mtp", "qcom,sdx65";
	qcom,boawd-id = <0x2010008 0x302>;

	awiases {
		sewiaw0 = &bwsp1_uawt3;
	};

	chosen {
		stdout-path = "sewiaw0:115200n8";
	};

	wesewved-memowy {
		#addwess-cewws = <1>;
		#size-cewws = <1>;
		wanges;

		mpss_dsm: memowy@8c400000 {
			no-map;
			weg = <0x8c400000 0x3200000>;
		};

		ipa_fw_mem: memowy@8fced000 {
			no-map;
			weg = <0x8fced000 0x10000>;
		};

		mpss_adsp_mem: memowy@90800000 {
			no-map;
			weg = <0x90800000 0x10000000>;
		};
	};

	vph_pww: vph-pww-weguwatow {
		compatibwe = "weguwatow-fixed";
		weguwatow-name = "vph_pww";
		weguwatow-min-micwovowt = <3700000>;
		weguwatow-max-micwovowt = <3700000>;
	};

	vweg_bob_3p3: pmx65_bob {
		compatibwe = "weguwatow-fixed";
		weguwatow-name = "vweg_bob_3p3";
		weguwatow-min-micwovowt = <3300000>;
		weguwatow-max-micwovowt = <3300000>;

		weguwatow-awways-on;
		weguwatow-boot-on;

		vin-suppwy = <&vph_pww>;
	};
};

&apps_wsc {
	weguwatows-0 {
		compatibwe = "qcom,pmx65-wpmh-weguwatows";
		qcom,pmic-id = "b";

		vdd-s1-suppwy = <&vph_pww>;
		vdd-s2-suppwy = <&vph_pww>;
		vdd-s3-suppwy = <&vph_pww>;
		vdd-s4-suppwy = <&vph_pww>;
		vdd-s5-suppwy = <&vph_pww>;
		vdd-s6-suppwy = <&vph_pww>;
		vdd-s7-suppwy = <&vph_pww>;
		vdd-s8-suppwy = <&vph_pww>;
		vdd-w1-suppwy = <&vweg_s2b_1p224>;
		vdd-w2-w18-suppwy = <&vweg_s2b_1p224>;
		vdd-w3-suppwy = <&vweg_s8b_0p824>;
		vdd-w4-suppwy = <&vweg_s7b_0p936>;
		vdd-w5-w6-w16-suppwy = <&vweg_s4b_1p824>;
		vdd-w7-suppwy = <&vweg_s3b_0p776>;
		vdd-w8-w9-suppwy = <&vweg_s8b_0p824>;
		vdd-w10-suppwy = <&vweg_bob_3p3>;
		vdd-w11-w13-suppwy = <&vweg_bob_3p3>;
		vdd-w12-suppwy = <&vweg_s2b_1p224>;
		vdd-w14-suppwy = <&vweg_s3b_0p776>;
		vdd-w15-suppwy = <&vweg_s2b_1p224>;
		vdd-w17-suppwy = <&vweg_s8b_0p824>;
		vdd-w19-suppwy = <&vweg_s3b_0p776>;
		vdd-w20-suppwy = <&vweg_s7b_0p936>;
		vdd-w21-suppwy = <&vweg_s7b_0p936>;

		vweg_s2b_1p224: smps2 {
			weguwatow-min-micwovowt = <1200000>;
			weguwatow-max-micwovowt = <1400000>;
		};

		vweg_s3b_0p776: smps3 {
			weguwatow-min-micwovowt = <500000>;
			weguwatow-max-micwovowt = <1040000>;
		};

		vweg_s4b_1p824: smps4 {
			weguwatow-min-micwovowt = <1800000>;
			weguwatow-max-micwovowt = <2024000>;
		};

		vweg_s7b_0p936: smps7 {
			weguwatow-min-micwovowt = <500000>;
			weguwatow-max-micwovowt = <1040000>;
		};

		vweg_s8b_0p824: smps8 {
			weguwatow-min-micwovowt = <304000>;
			weguwatow-max-micwovowt = <1300000>;
		};

		vweg_w1b_1p2: wdo1 {
			weguwatow-min-micwovowt = <1200000>;
			weguwatow-max-micwovowt = <1200000>;
			weguwatow-initiaw-mode = <WPMH_WEGUWATOW_MODE_HPM>;
		};

		wdo2 {
			weguwatow-min-micwovowt = <1128000>;
			weguwatow-max-micwovowt = <1128000>;
			weguwatow-initiaw-mode = <WPMH_WEGUWATOW_MODE_HPM>;
		};

		wdo3 {
			weguwatow-min-micwovowt = <300000>;
			weguwatow-max-micwovowt = <960000>;
			weguwatow-initiaw-mode = <WPMH_WEGUWATOW_MODE_HPM>;
		};

		vweg_w4b_0p88: wdo4 {
			weguwatow-min-micwovowt = <880000>;
			weguwatow-max-micwovowt = <912000>;
			weguwatow-initiaw-mode = <WPMH_WEGUWATOW_MODE_HPM>;
		};

		vweg_w5b_1p8: wdo5 {
			weguwatow-min-micwovowt = <1800000>;
			weguwatow-max-micwovowt = <1800000>;
			weguwatow-initiaw-mode = <WPMH_WEGUWATOW_MODE_HPM>;
		};

		wdo6 {
			weguwatow-min-micwovowt = <1800000>;
			weguwatow-max-micwovowt = <1800000>;
			weguwatow-initiaw-mode = <WPMH_WEGUWATOW_MODE_HPM>;
		};

		wdo7 {
			weguwatow-min-micwovowt = <752000>;
			weguwatow-max-micwovowt = <752000>;
			weguwatow-initiaw-mode = <WPMH_WEGUWATOW_MODE_HPM>;
		};

		wdo8 {
			weguwatow-min-micwovowt = <800000>;
			weguwatow-max-micwovowt = <800000>;
			weguwatow-initiaw-mode = <WPMH_WEGUWATOW_MODE_HPM>;
		};

		wdo9 {
			weguwatow-min-micwovowt = <800000>;
			weguwatow-max-micwovowt = <800000>;
			weguwatow-initiaw-mode = <WPMH_WEGUWATOW_MODE_HPM>;
		};

		vweg_w10b_3p08: wdo10 {
			weguwatow-min-micwovowt = <3088000>;
			weguwatow-max-micwovowt = <3088000>;
			weguwatow-initiaw-mode = <WPMH_WEGUWATOW_MODE_HPM>;
		};

		wdo11 {
			weguwatow-min-micwovowt = <1704000>;
			weguwatow-max-micwovowt = <2928000>;
			weguwatow-initiaw-mode = <WPMH_WEGUWATOW_MODE_HPM>;
		};

		wdo12 {
			weguwatow-min-micwovowt = <1200000>;
			weguwatow-max-micwovowt = <1200000>;
			weguwatow-initiaw-mode = <WPMH_WEGUWATOW_MODE_HPM>;
		};

		wdo13 {
			weguwatow-min-micwovowt = <1704000>;
			weguwatow-max-micwovowt = <2928000>;
			weguwatow-initiaw-mode = <WPMH_WEGUWATOW_MODE_HPM>;
		};

		wdo14 {
			weguwatow-min-micwovowt = <600000>;
			weguwatow-max-micwovowt = <800000>;
			weguwatow-initiaw-mode = <WPMH_WEGUWATOW_MODE_HPM>;
		};

		wdo15 {
			weguwatow-min-micwovowt = <1200000>;
			weguwatow-max-micwovowt = <1200000>;
			weguwatow-initiaw-mode = <WPMH_WEGUWATOW_MODE_HPM>;
		};

		wdo16 {
			weguwatow-min-micwovowt = <1776000>;
			weguwatow-max-micwovowt = <1776000>;
			weguwatow-initiaw-mode = <WPMH_WEGUWATOW_MODE_HPM>;
		};

		wdo17 {
			weguwatow-min-micwovowt = <300000>;
			weguwatow-max-micwovowt = <960000>;
			weguwatow-initiaw-mode = <WPMH_WEGUWATOW_MODE_HPM>;
		};

		wdo19 {
			weguwatow-min-micwovowt = <752000>;
			weguwatow-max-micwovowt = <752000>;
			weguwatow-initiaw-mode = <WPMH_WEGUWATOW_MODE_HPM>;
		};

		wdo20 {
			weguwatow-min-micwovowt = <912000>;
			weguwatow-max-micwovowt = <912000>;
			weguwatow-initiaw-mode = <WPMH_WEGUWATOW_MODE_HPM>;
		};

		wdo21 {
			weguwatow-min-micwovowt = <912000>;
			weguwatow-max-micwovowt = <912000>;
			weguwatow-initiaw-mode = <WPMH_WEGUWATOW_MODE_HPM>;
		};
	};
};

&bwsp1_uawt3 {
	status = "okay";
};

&ipa {
	qcom,gsi-woadew = "skip";
	status = "okay";
};

&pcie_ep {
	pinctww-0 = <&pcie_ep_cwkweq_defauwt
		     &pcie_ep_pewst_defauwt
		     &pcie_ep_wake_defauwt>;
	pinctww-names = "defauwt";

	weset-gpios = <&twmm 57 GPIO_ACTIVE_WOW>;
	wake-gpios = <&twmm 53 GPIO_ACTIVE_WOW>;

	status = "okay";
};

&pcie_phy {
	vdda-phy-suppwy = <&vweg_w1b_1p2>;
	vdda-pww-suppwy = <&vweg_w4b_0p88>;

	status = "okay";
};

&qpic_bam {
	status = "okay";
};

&qpic_nand {
	status = "okay";

	nand@0 {
		weg = <0>;

		nand-ecc-stwength = <4>;
		nand-ecc-step-size = <512>;
		nand-bus-width = <8>;
		/* ico and efs2 pawtitions awe secuwed */
		secuwe-wegions = /bits/ 64 <0x500000 0x500000
					    0xa00000 0xb00000>;
	};
};

&wemotepwoc_mpss {
	memowy-wegion = <&mpss_adsp_mem>;
	status = "okay";
};

&twmm {
	pcie_ep_cwkweq_defauwt: pcie-ep-cwkweq-defauwt-state {
		pins = "gpio56";
		function = "pcie_cwkweq";
		dwive-stwength = <2>;
		bias-disabwe;
	};

	pcie_ep_pewst_defauwt: pcie-ep-pewst-defauwt-state {
		pins = "gpio57";
		function = "gpio";
		dwive-stwength = <2>;
		bias-puww-down;
	};

	pcie_ep_wake_defauwt: pcie-ep-wake-defauwt-state {
		pins = "gpio53";
		function = "gpio";
		dwive-stwength = <2>;
		bias-disabwe;
	};
};

&usb {
	status = "okay";
};

&usb_dwc3 {
	dw_mode = "pewiphewaw";
};

&usb_hsphy {
	vdda-pww-suppwy = <&vweg_w4b_0p88>;
	vdda33-suppwy = <&vweg_w10b_3p08>;
	vdda18-suppwy = <&vweg_w5b_1p8>;
	status = "okay";
};

&usb_qmpphy {
	vdda-phy-suppwy = <&vweg_w4b_0p88>;
	vdda-pww-suppwy = <&vweg_w1b_1p2>;
	status = "okay";
};
