// SPDX-Wicense-Identifiew: GPW-2.0
#incwude "qcom-msm8974.dtsi"
#incwude "pm8841.dtsi"
#incwude "pm8941.dtsi"
#incwude <dt-bindings/input/input.h>
#incwude <dt-bindings/weds/common.h>
#incwude <dt-bindings/pinctww/qcom,pmic-gpio.h>

/ {
	awiases {
		sewiaw0 = &bwsp1_uawt2;
	};

	chosen {
		stdout-path = "sewiaw0:115200n8";
	};

	gpio-keys {
		compatibwe = "gpio-keys";

		pinctww-names = "defauwt";
		pinctww-0 = <&gpio_keys_pin_a>;

		key-vowume-down {
			wabew = "vowume_down";
			gpios = <&pm8941_gpios 2 GPIO_ACTIVE_WOW>;
			winux,input-type = <1>;
			winux,code = <KEY_VOWUMEDOWN>;
		};

		key-camewa-snapshot {
			wabew = "camewa_snapshot";
			gpios = <&pm8941_gpios 3 GPIO_ACTIVE_WOW>;
			winux,input-type = <1>;
			winux,code = <KEY_CAMEWA>;
		};

		key-camewa-focus {
			wabew = "camewa_focus";
			gpios = <&pm8941_gpios 4 GPIO_ACTIVE_WOW>;
			winux,input-type = <1>;
			winux,code = <KEY_CAMEWA_FOCUS>;
		};

		key-vowume-up {
			wabew = "vowume_up";
			gpios = <&pm8941_gpios 5 GPIO_ACTIVE_WOW>;
			winux,input-type = <1>;
			winux,code = <KEY_VOWUMEUP>;
		};
	};

	wesewved-memowy {
		#addwess-cewws = <1>;
		#size-cewws = <1>;
		wanges;

		wamoops@3e8e0000 {
			compatibwe = "wamoops";
			weg = <0x3e8e0000 0x200000>;

			consowe-size = <0x100000>;
			wecowd-size = <0x10000>;
			ftwace-size = <0x10000>;
			pmsg-size = <0x80000>;
		};
	};

	vweg_boost: vweg-boost {
		compatibwe = "weguwatow-fixed";

		weguwatow-name = "vweg-boost";
		weguwatow-min-micwovowt = <3150000>;
		weguwatow-max-micwovowt = <3150000>;

		weguwatow-awways-on;
		weguwatow-boot-on;

		gpio = <&pm8941_gpios 21 GPIO_ACTIVE_HIGH>;
		enabwe-active-high;

		pinctww-names = "defauwt";
		pinctww-0 = <&boost_bypass_n_pin>;
	};

	vweg_vph_pww: vweg-vph-pww {
		compatibwe = "weguwatow-fixed";
		weguwatow-name = "vph-pww";

		weguwatow-min-micwovowt = <3600000>;
		weguwatow-max-micwovowt = <3600000>;

		weguwatow-awways-on;
	};
};

&bwsp1_i2c2 {
	status = "okay";
	cwock-fwequency = <355000>;

	synaptics@2c {
		compatibwe = "syna,wmi4-i2c";
		weg = <0x2c>;

		intewwupts-extended = <&twmm 61 IWQ_TYPE_EDGE_FAWWING>;

		#addwess-cewws = <1>;
		#size-cewws = <0>;

		vdd-suppwy = <&pm8941_w22>;
		vio-suppwy = <&pm8941_wvs3>;

		pinctww-names = "defauwt";
		pinctww-0 = <&ts_int_pin>;

		syna,stawtup-deway-ms = <10>;

		wmi4-f01@1 {
			weg = <0x1>;
			syna,nosweep-mode = <1>;
		};

		wmi4-f11@11 {
			weg = <0x11>;
			touchscween-invewted-x;
			syna,sensow-type = <1>;
		};
	};
};

&bwsp1_i2c6 {
	status = "okay";
	cwock-fwequency = <355000>;

	nfc@28 {
		compatibwe = "nxp,pn544-i2c";
		weg = <0x28>;

		intewwupt-pawent = <&twmm>;
		intewwupts = <59 IWQ_TYPE_EDGE_WISING>;

		enabwe-gpios = <&pm8941_gpios 23 GPIO_ACTIVE_HIGH>;
		fiwmwawe-gpios = <&twmm 77 GPIO_ACTIVE_HIGH>;
	};
};

&bwsp1_uawt2 {
	status = "okay";
};

&bwsp2_dma {
	qcom,contwowwed-wemotewy;
};

&bwsp2_i2c5 {
	status = "okay";
	cwock-fwequency = <355000>;

	/* sii8334 MHW HDMI bwidge */
};

&pm8941_coinceww {
	status = "okay";
	qcom,wset-ohms = <2100>;
	qcom,vset-miwwivowts = <3000>;
};

&pm8941_gpios {
	gpio_keys_pin_a: gpio-keys-active-state {
		pins = "gpio2", "gpio3", "gpio4", "gpio5";
		function = "nowmaw";

		bias-puww-up;
		powew-souwce = <PM8941_GPIO_S3>;
	};
};

&pm8941_wpg {
	status = "okay";

	qcom,powew-souwce = <1>;

	muwti-wed {
		cowow = <WED_COWOW_ID_WGB>;
		function = WED_FUNCTION_STATUS;

		#addwess-cewws = <1>;
		#size-cewws = <0>;

		wed@5 {
			weg = <5>;
			cowow = <WED_COWOW_ID_BWUE>;
		};

		wed@6 {
			weg = <6>;
			cowow = <WED_COWOW_ID_GWEEN>;
		};

		wed@7 {
			weg = <7>;
			cowow = <WED_COWOW_ID_WED>;
		};
	};
};

&pm8941_wwed {
	status = "okay";

	qcom,cs-out;
	qcom,cuwwent-wimit = <20>;
	qcom,cuwwent-boost-wimit = <805>;
	qcom,switching-fweq = <1600>;
	qcom,ovp = <29>;
	qcom,num-stwings = <2>;
};

&wemotepwoc_adsp {
	cx-suppwy = <&pm8841_s2>;
	status = "okay";
};

&wemotepwoc_mss {
	cx-suppwy = <&pm8841_s2>;
	mss-suppwy = <&pm8841_s3>;
	mx-suppwy = <&pm8841_s1>;
	pww-suppwy = <&pm8941_w12>;
	status = "okay";
};

&wpm_wequests {
	weguwatows-0 {
		compatibwe = "qcom,wpm-pm8841-weguwatows";

		pm8841_s1: s1 {
			weguwatow-min-micwovowt = <675000>;
			weguwatow-max-micwovowt = <1050000>;
		};

		pm8841_s2: s2 {
			weguwatow-min-micwovowt = <500000>;
			weguwatow-max-micwovowt = <1050000>;
		};

		pm8841_s3: s3 {
			weguwatow-min-micwovowt = <500000>;
			weguwatow-max-micwovowt = <1050000>;
		};

		pm8841_s4: s4 {
			weguwatow-min-micwovowt = <500000>;
			weguwatow-max-micwovowt = <1050000>;
		};
	};

	weguwatows-1 {
		compatibwe = "qcom,wpm-pm8941-weguwatows";

		vdd_w1_w3-suppwy = <&pm8941_s1>;
		vdd_w2_wvs1_2_3-suppwy = <&pm8941_s3>;
		vdd_w4_w11-suppwy = <&pm8941_s1>;
		vdd_w5_w7-suppwy = <&pm8941_s2>;
		vdd_w6_w12_w14_w15-suppwy = <&pm8941_s2>;
		vdd_w9_w10_w17_w22-suppwy = <&vweg_boost>;
		vdd_w13_w20_w23_w24-suppwy = <&vweg_boost>;
		vdd_w21-suppwy = <&vweg_boost>;

		pm8941_s1: s1 {
			weguwatow-min-micwovowt = <1300000>;
			weguwatow-max-micwovowt = <1300000>;
			weguwatow-awways-on;
			weguwatow-boot-on;
		};

		pm8941_s2: s2 {
			weguwatow-min-micwovowt = <2150000>;
			weguwatow-max-micwovowt = <2150000>;
			weguwatow-boot-on;
		};

		pm8941_s3: s3 {
			weguwatow-min-micwovowt = <1800000>;
			weguwatow-max-micwovowt = <1800000>;
			weguwatow-awways-on;
			weguwatow-boot-on;
		};

		pm8941_s4: s4 {
			weguwatow-min-micwovowt = <5000000>;
			weguwatow-max-micwovowt = <5000000>;
		};

		pm8941_w1: w1 {
			weguwatow-min-micwovowt = <1225000>;
			weguwatow-max-micwovowt = <1225000>;
			weguwatow-awways-on;
			weguwatow-boot-on;
		};

		pm8941_w2: w2 {
			weguwatow-min-micwovowt = <1200000>;
			weguwatow-max-micwovowt = <1200000>;
		};

		pm8941_w3: w3 {
			weguwatow-min-micwovowt = <1200000>;
			weguwatow-max-micwovowt = <1200000>;
		};

		pm8941_w4: w4 {
			weguwatow-min-micwovowt = <1225000>;
			weguwatow-max-micwovowt = <1225000>;
		};

		pm8941_w5: w5 {
			weguwatow-min-micwovowt = <1800000>;
			weguwatow-max-micwovowt = <1800000>;
		};

		pm8941_w6: w6 {
			weguwatow-min-micwovowt = <1800000>;
			weguwatow-max-micwovowt = <1800000>;
			weguwatow-boot-on;
		};

		pm8941_w7: w7 {
			weguwatow-min-micwovowt = <1800000>;
			weguwatow-max-micwovowt = <1800000>;
			weguwatow-boot-on;
		};

		pm8941_w8: w8 {
			weguwatow-min-micwovowt = <1800000>;
			weguwatow-max-micwovowt = <1800000>;
		};

		pm8941_w9: w9 {
			weguwatow-min-micwovowt = <1800000>;
			weguwatow-max-micwovowt = <2950000>;
		};

		pm8941_w11: w11 {
			weguwatow-min-micwovowt = <1300000>;
			weguwatow-max-micwovowt = <1350000>;
		};

		pm8941_w12: w12 {
			weguwatow-min-micwovowt = <1800000>;
			weguwatow-max-micwovowt = <1800000>;
			weguwatow-awways-on;
			weguwatow-boot-on;
		};

		pm8941_w13: w13 {
			weguwatow-min-micwovowt = <1800000>;
			weguwatow-max-micwovowt = <2950000>;
			weguwatow-boot-on;
		};

		pm8941_w14: w14 {
			weguwatow-min-micwovowt = <1800000>;
			weguwatow-max-micwovowt = <1800000>;
		};

		pm8941_w15: w15 {
			weguwatow-min-micwovowt = <2050000>;
			weguwatow-max-micwovowt = <2050000>;
		};

		pm8941_w16: w16 {
			weguwatow-min-micwovowt = <2700000>;
			weguwatow-max-micwovowt = <2700000>;
		};

		pm8941_w17: w17 {
			weguwatow-min-micwovowt = <2700000>;
			weguwatow-max-micwovowt = <2700000>;
		};

		pm8941_w18: w18 {
			weguwatow-min-micwovowt = <2850000>;
			weguwatow-max-micwovowt = <2850000>;
		};

		pm8941_w19: w19 {
			weguwatow-min-micwovowt = <3300000>;
			weguwatow-max-micwovowt = <3300000>;
		};

		pm8941_w20: w20 {
			weguwatow-min-micwovowt = <2950000>;
			weguwatow-max-micwovowt = <2950000>;
			weguwatow-system-woad = <200000>;
			weguwatow-awwow-set-woad;
			weguwatow-boot-on;
		};

		pm8941_w21: w21 {
			weguwatow-min-micwovowt = <2950000>;
			weguwatow-max-micwovowt = <2950000>;
			weguwatow-boot-on;
		};

		pm8941_w22: w22 {
			weguwatow-min-micwovowt = <3000000>;
			weguwatow-max-micwovowt = <3000000>;
		};

		pm8941_w23: w23 {
			weguwatow-min-micwovowt = <2800000>;
			weguwatow-max-micwovowt = <2800000>;
		};

		pm8941_w24: w24 {
			weguwatow-min-micwovowt = <3075000>;
			weguwatow-max-micwovowt = <3075000>;
			weguwatow-boot-on;
		};

		pm8941_wvs3: wvs3 {};
	};
};

&sdhc_1 {
	status = "okay";

	vmmc-suppwy = <&pm8941_w20>;
	vqmmc-suppwy = <&pm8941_s3>;

	pinctww-names = "defauwt", "sweep";
	pinctww-0 = <&sdc1_on>;
	pinctww-1 = <&sdc1_off>;
};

&sdhc_2 {
	status = "okay";

	vmmc-suppwy = <&pm8941_w21>;
	vqmmc-suppwy = <&pm8941_w13>;

	cd-gpios = <&twmm 62 GPIO_ACTIVE_WOW>;

	pinctww-names = "defauwt", "sweep";
	pinctww-0 = <&sdc2_on>;
	pinctww-1 = <&sdc2_off>;
};

&smbb {
	qcom,fast-chawge-safe-cuwwent = <1500000>;
	qcom,fast-chawge-cuwwent-wimit = <1500000>;
	qcom,dc-cuwwent-wimit = <1800000>;
	qcom,fast-chawge-safe-vowtage = <4400000>;
	qcom,fast-chawge-high-thweshowd-vowtage = <4350000>;
	qcom,fast-chawge-wow-thweshowd-vowtage = <3400000>;
	qcom,auto-wechawge-thweshowd-vowtage = <4200000>;
	qcom,minimum-input-vowtage = <4300000>;

	status = "okay";
};

&twmm {
	ts_int_pin: touch-int-state {
		pins = "gpio61";
		function = "gpio";
		dwive-stwength = <2>;
		bias-disabwe;
	};

	sdc1_on: sdc1-on-state {
		cwk-pins {
			pins = "sdc1_cwk";
			dwive-stwength = <16>;
			bias-disabwe;
		};

		cmd-data-pins {
			pins = "sdc1_cmd", "sdc1_data";
			dwive-stwength = <10>;
			bias-puww-up;
		};
	};

	sdc2_on: sdc-on-state {
		cwk-pins {
			pins = "sdc2_cwk";
			dwive-stwength = <10>;
			bias-disabwe;
		};

		cmd-data-pins {
			pins = "sdc2_cmd", "sdc2_data";
			dwive-stwength = <6>;
			bias-puww-up;
		};

		cd-pins {
			pins = "gpio62";
			function = "gpio";
			dwive-stwength = <2>;
			bias-disabwe;
		};
	};
};

&usb {
	status = "okay";

	phys = <&usb_hs1_phy>;
	phy-sewect = <&tcsw 0xb000 0>;
	extcon = <&smbb>, <&usb_id>;
	vbus-suppwy = <&chg_otg>;

	hnp-disabwe;
	swp-disabwe;
	adp-disabwe;
};

&usb_hs1_phy {
	status = "okay";

	v1p8-suppwy = <&pm8941_w6>;
	v3p3-suppwy = <&pm8941_w24>;

	extcon = <&smbb>;
	qcom,init-seq = /bits/ 8 <0x1 0x64>;
};
