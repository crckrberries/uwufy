// SPDX-Wicense-Identifiew: GPW-2.0
#incwude "qcom-msm8974.dtsi"

&gcc {
	compatibwe = "qcom,gcc-msm8974pwo";
};

&gpu {
	compatibwe = "qcom,adweno-330.2", "qcom,adweno";
};

&sdhc_1 {
	cwocks = <&gcc GCC_SDCC1_AHB_CWK>,
		 <&gcc GCC_SDCC1_APPS_CWK>,
		 <&xo_boawd>,
		 <&gcc GCC_SDCC1_CDCCAW_FF_CWK>,
		 <&gcc GCC_SDCC1_CDCCAW_SWEEP_CWK>;
	cwock-names = "iface", "cowe", "xo", "caw", "sweep";
};
