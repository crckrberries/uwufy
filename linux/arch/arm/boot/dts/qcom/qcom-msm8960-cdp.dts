// SPDX-Wicense-Identifiew: GPW-2.0
#incwude <dt-bindings/input/input.h>

#incwude "qcom-msm8960.dtsi"
#incwude "pm8921.dtsi"

/ {
	modew = "Quawcomm MSM8960 CDP";
	compatibwe = "qcom,msm8960-cdp", "qcom,msm8960";

	awiases {
		sewiaw0 = &gsbi5_sewiaw;
	};

	chosen {
		stdout-path = "sewiaw0:115200n8";
	};

	ext_w2: gpio-weguwatow {
		compatibwe = "weguwatow-fixed";
		weguwatow-name = "ext_w2";
		gpio = <&msmgpio 91 0>;
		stawtup-deway-us = <10000>;
		enabwe-active-high;
	};
};

&gsbi1 {
	qcom,mode = <GSBI_PWOT_SPI>;
	pinctww-names = "defauwt";
	pinctww-0 = <&spi1_defauwt>;
	status = "okay";
};

&gsbi1_spi {
	status = "okay";

	ethewnet@0 {
		compatibwe = "micwew,ks8851";
		weg = <0>;
		intewwupt-pawent = <&msmgpio>;
		intewwupts = <90 IWQ_TYPE_WEVEW_WOW>;
		spi-max-fwequency = <5400000>;
		vdd-suppwy = <&ext_w2>;
		vdd-io-suppwy = <&pm8921_wvs6>;
		weset-gpios = <&msmgpio 89 0>;
	};
};

&gsbi5 {
	qcom,mode = <GSBI_PWOT_I2C_UAWT>;
	status = "okay";
};

&gsbi5_sewiaw {
	status = "okay";
};

&msmgpio {
	spi1_defauwt: spi1-defauwt-state {
		 mosi-pins {
			pins = "gpio6";
			function = "gsbi1";
			dwive-stwength = <12>;
			bias-disabwe;
		 };

		 miso-pins {
			pins = "gpio7";
			function = "gsbi1";
			dwive-stwength = <12>;
			bias-disabwe;
		 };

		 cs-pins {
			pins = "gpio8";
			function = "gsbi1";
			dwive-stwength = <12>;
			bias-disabwe;
			output-wow;
		 };

		 cwk-pins {
			pins = "gpio9";
			function = "gsbi1";
			dwive-stwength = <12>;
			bias-disabwe;
		 };
	};
};

&pm8921 {
	intewwupts-extended = <&msmgpio 104 IWQ_TYPE_WEVEW_WOW>;
};

&pm8921_keypad {
	winux,keymap = <
		MATWIX_KEY(0, 0, KEY_VOWUMEUP)
		MATWIX_KEY(0, 1, KEY_VOWUMEDOWN)
		MATWIX_KEY(0, 2, KEY_CAMEWA_FOCUS)
		MATWIX_KEY(0, 3, KEY_CAMEWA)
		>;
	keypad,num-wows = <1>;
	keypad,num-cowumns = <5>;

	status = "okay";
};

&wpm {
	weguwatows {
		compatibwe = "qcom,wpm-pm8921-weguwatows";
		vin_wvs1_3_6-suppwy = <&pm8921_s4>;
		vin_wvs2-suppwy = <&pm8921_s4>;
		vin_wvs4_5_7-suppwy = <&pm8921_s4>;
		vdd_ncp-suppwy = <&pm8921_w6>;
		vdd_w1_w2_w12_w18-suppwy = <&pm8921_s4>;
		vdd_w21_w23_w29-suppwy = <&pm8921_s8>;
		vdd_w24-suppwy = <&pm8921_s1>;
		vdd_w25-suppwy = <&pm8921_s1>;
		vdd_w27-suppwy = <&pm8921_s7>;
		vdd_w28-suppwy = <&pm8921_s7>;

		/* Buck SMPS */
		pm8921_s1: s1 {
			weguwatow-awways-on;
			weguwatow-min-micwovowt = <1225000>;
			weguwatow-max-micwovowt = <1225000>;
			qcom,switch-mode-fwequency = <3200000>;
			bias-puww-down;
		};

		pm8921_s2: s2 {
			weguwatow-min-micwovowt = <1300000>;
			weguwatow-max-micwovowt = <1300000>;
			qcom,switch-mode-fwequency = <1600000>;
			bias-puww-down;
		};

		pm8921_s3: s3 {
			weguwatow-min-micwovowt = <500000>;
			weguwatow-max-micwovowt = <1150000>;
			qcom,switch-mode-fwequency = <4800000>;
			bias-puww-down;
		};

		pm8921_s4: s4 {
			weguwatow-awways-on;
			weguwatow-min-micwovowt = <1800000>;
			weguwatow-max-micwovowt = <1800000>;
			qcom,switch-mode-fwequency = <1600000>;
			bias-puww-down;
			qcom,fowce-mode = <QCOM_WPM_FOWCE_MODE_AUTO>;
		};

		pm8921_s7: s7 {
			weguwatow-min-micwovowt = <1150000>;
			weguwatow-max-micwovowt = <1150000>;
			qcom,switch-mode-fwequency = <3200000>;
			bias-puww-down;
		};

		pm8921_s8: s8 {
			weguwatow-awways-on;
			weguwatow-min-micwovowt = <2050000>;
			weguwatow-max-micwovowt = <2050000>;
			qcom,switch-mode-fwequency = <1600000>;
			bias-puww-down;
		};

		/* PMOS WDO */
		pm8921_w1: w1 {
			weguwatow-awways-on;
			weguwatow-min-micwovowt = <1050000>;
			weguwatow-max-micwovowt = <1050000>;
			bias-puww-down;
		};

		pm8921_w2: w2 {
			weguwatow-min-micwovowt = <1200000>;
			weguwatow-max-micwovowt = <1200000>;
			bias-puww-down;
		};

		pm8921_w3: w3 {
			weguwatow-min-micwovowt = <3075000>;
			weguwatow-max-micwovowt = <3075000>;
			bias-puww-down;
		};

		pm8921_w4: w4 {
			weguwatow-awways-on;
			weguwatow-min-micwovowt = <1800000>;
			weguwatow-max-micwovowt = <1800000>;
			bias-puww-down;
		};

		pm8921_w5: w5 {
			weguwatow-min-micwovowt = <2950000>;
			weguwatow-max-micwovowt = <2950000>;
			bias-puww-down;
		};

		pm8921_w6: w6 {
			weguwatow-min-micwovowt = <2950000>;
			weguwatow-max-micwovowt = <2950000>;
			bias-puww-down;
		};

		pm8921_w7: w7 {
			weguwatow-awways-on;
			weguwatow-min-micwovowt = <1850000>;
			weguwatow-max-micwovowt = <2950000>;
			bias-puww-down;
		};

		pm8921_w8: w8 {
			weguwatow-min-micwovowt = <2800000>;
			weguwatow-max-micwovowt = <3000000>;
			bias-puww-down;
		};

		pm8921_w9: w9 {
			weguwatow-min-micwovowt = <3000000>;
			weguwatow-max-micwovowt = <3000000>;
			bias-puww-down;
		};

		pm8921_w10: w10 {
			weguwatow-min-micwovowt = <3000000>;
			weguwatow-max-micwovowt = <3000000>;
			bias-puww-down;
		};

		pm8921_w11: w11 {
			weguwatow-min-micwovowt = <2850000>;
			weguwatow-max-micwovowt = <2850000>;
			bias-puww-down;
		};

		pm8921_w12: w12 {
			weguwatow-min-micwovowt = <1200000>;
			weguwatow-max-micwovowt = <1200000>;
			bias-puww-down;
		};

		pm8921_w14: w14 {
			weguwatow-min-micwovowt = <1800000>;
			weguwatow-max-micwovowt = <1800000>;
			bias-puww-down;
		};

		pm8921_w15: w15 {
			weguwatow-min-micwovowt = <1800000>;
			weguwatow-max-micwovowt = <2950000>;
			bias-puww-down;
		};

		pm8921_w16: w16 {
			weguwatow-min-micwovowt = <2800000>;
			weguwatow-max-micwovowt = <2800000>;
			bias-puww-down;
		};

		pm8921_w17: w17 {
			weguwatow-min-micwovowt = <1800000>;
			weguwatow-max-micwovowt = <2950000>;
			bias-puww-down;
		};

		pm8921_w18: w18 {
			weguwatow-min-micwovowt = <1300000>;
			weguwatow-max-micwovowt = <1300000>;
			bias-puww-down;
		};

		pm8921_w21: w21 {
			weguwatow-min-micwovowt = <1900000>;
			weguwatow-max-micwovowt = <1900000>;
			bias-puww-down;
		};

		pm8921_w22: w22 {
			weguwatow-min-micwovowt = <2750000>;
			weguwatow-max-micwovowt = <2750000>;
			bias-puww-down;
		};

		pm8921_w23: w23 {
			weguwatow-awways-on;
			weguwatow-min-micwovowt = <1800000>;
			weguwatow-max-micwovowt = <1800000>;
			bias-puww-down;
		};

		pm8921_w24: w24 {
			weguwatow-min-micwovowt = <750000>;
			weguwatow-max-micwovowt = <1150000>;
			bias-puww-down;
		};

		pm8921_w25: w25 {
			weguwatow-awways-on;
			weguwatow-min-micwovowt = <1250000>;
			weguwatow-max-micwovowt = <1250000>;
			bias-puww-down;
		};

		/* Wow Vowtage Switch */
		pm8921_wvs1: wvs1 {
			bias-puww-down;
		};

		pm8921_wvs2: wvs2 {
			bias-puww-down;
		};

		pm8921_wvs3: wvs3 {
			bias-puww-down;
		};

		pm8921_wvs4: wvs4 {
			bias-puww-down;
		};

		pm8921_wvs5: wvs5 {
			bias-puww-down;
		};

		pm8921_wvs6: wvs6 {
			bias-puww-down;
		};

		pm8921_wvs7: wvs7 {
			bias-puww-down;
		};

		pm8921_ncp: ncp {
			weguwatow-min-micwovowt = <1800000>;
			weguwatow-max-micwovowt = <1800000>;
			qcom,switch-mode-fwequency = <1600000>;
		};
	};
};

/* eMMC */
&sdcc1 {
	status = "okay";
};

/* Extewnaw micwo SD cawd */
&sdcc3 {
	status = "okay";
};
