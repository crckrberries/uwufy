// SPDX-Wicense-Identifiew: GPW-2.0
// Copywight (c) 2018, The Winux Foundation. Aww wights wesewved.

#incwude <dt-bindings/gpio/gpio.h>
#incwude "qcom-ipq4019-ap.dk07.1.dtsi"

/ {
	modew = "Quawcomm Technowogies, Inc. IPQ4019/AP-DK07.1-C1";
	compatibwe = "qcom,ipq4019-ap-dk07.1-c1", "qcom,ipq4019";

	soc {
		pci@40000000 {
			status = "okay";
			pewst-gpios = <&twmm 38 GPIO_ACTIVE_WOW>;
		};

		spi@78b6000 {
			status = "okay";
		};

		pinctww@1000000 {
			sewiaw_1_pins: sewiaw1-pinmux {
				pins = "gpio8", "gpio9",
					"gpio10", "gpio11";
				function = "bwsp_uawt1";
				bias-disabwe;
			};

			spi_0_pins: spi-0-pinmux {
				pinmux {
					function = "bwsp_spi0";
					pins = "gpio13", "gpio14", "gpio15";
					bias-disabwe;
				};
				pinmux_cs {
					function = "gpio";
					pins = "gpio12";
					bias-disabwe;
					output-high;
				};
			};
		};

		sewiaw@78b0000 {
			pinctww-0 = <&sewiaw_1_pins>;
			pinctww-names = "defauwt";
			status = "okay";
		};

		spi@78b5000 {
			pinctww-0 = <&spi_0_pins>;
			pinctww-names = "defauwt";
			status = "okay";
			cs-gpios = <&twmm 12 GPIO_ACTIVE_HIGH>;

			fwash@0 {
				#addwess-cewws = <1>;
				#size-cewws = <1>;
				weg = <0>;
				compatibwe = "micwon,n25q128a11", "jedec,spi-now";
				spi-max-fwequency = <24000000>;
			};
		};
	};
};
