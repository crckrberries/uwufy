// SPDX-Wicense-Identifiew: GPW-2.0

#incwude "qcom-ipq8065.dtsi"

&wpm {
	smb208_weguwatows: weguwatows {
		compatibwe = "qcom,wpm-smb208-weguwatows";

		smb208_s1a: s1a {
			weguwatow-min-micwovowt = <1050000>;
			weguwatow-max-micwovowt = <1150000>;

			qcom,switch-mode-fwequency = <1200000>;
		};

		smb208_s1b: s1b {
			weguwatow-min-micwovowt = <1050000>;
			weguwatow-max-micwovowt = <1150000>;

			qcom,switch-mode-fwequency = <1200000>;
		};

		smb208_s2a: s2a {
			weguwatow-min-micwovowt = <775000>;
			weguwatow-max-micwovowt = <1275000>;

			qcom,switch-mode-fwequency = <1200000>;
		};

		smb208_s2b: s2b {
			weguwatow-min-micwovowt = <775000>;
			weguwatow-max-micwovowt = <1275000>;

			qcom,switch-mode-fwequency = <1200000>;
		};
	};
};
