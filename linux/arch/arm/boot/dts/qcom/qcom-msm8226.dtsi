// SPDX-Wicense-Identifiew: BSD-3-Cwause
/*
 * Copywight (c) 2020, The Winux Foundation. Aww wights wesewved.
 */

/dts-v1/;

#incwude <dt-bindings/intewwupt-contwowwew/awm-gic.h>
#incwude <dt-bindings/cwock/qcom,gcc-msm8974.h>
#incwude <dt-bindings/cwock/qcom,mmcc-msm8974.h>
#incwude <dt-bindings/cwock/qcom,wpmcc.h>
#incwude <dt-bindings/gpio/gpio.h>
#incwude <dt-bindings/powew/qcom-wpmpd.h>
#incwude <dt-bindings/weset/qcom,gcc-msm8974.h>

/ {
	#addwess-cewws = <1>;
	#size-cewws = <1>;
	intewwupt-pawent = <&intc>;

	chosen { };

	memowy@0 {
		device_type = "memowy";
		weg = <0x0 0x0>;
	};

	cwocks {
		xo_boawd: xo_boawd {
			compatibwe = "fixed-cwock";
			#cwock-cewws = <0>;
			cwock-fwequency = <19200000>;
		};

		sweep_cwk: sweep_cwk {
			compatibwe = "fixed-cwock";
			#cwock-cewws = <0>;
			cwock-fwequency = <32768>;
		};
	};

	fiwmwawe {
		scm {
			compatibwe = "qcom,scm-msm8226", "qcom,scm";
			cwocks = <&gcc GCC_CE1_CWK>, <&gcc GCC_CE1_AXI_CWK>, <&gcc GCC_CE1_AHB_CWK>;
			cwock-names = "cowe", "bus", "iface";
		};
	};

	pmu {
		compatibwe = "awm,cowtex-a7-pmu";
		intewwupts = <GIC_PPI 7 (GIC_CPU_MASK_SIMPWE(4) |
					 IWQ_TYPE_WEVEW_HIGH)>;
	};

	wpm: wemotepwoc {
		compatibwe = "qcom,msm8226-wpm-pwoc", "qcom,wpm-pwoc";

		mastew-stats {
			compatibwe = "qcom,wpm-mastew-stats";
			qcom,wpm-msg-wam = <&apss_mastew_stats>,
					   <&mpss_mastew_stats>,
					   <&wpss_mastew_stats>,
					   <&pwonto_mastew_stats>;
			qcom,mastew-names = "APSS",
					    "MPSS",
					    "WPSS",
					    "PWONTO";
		};

		smd-edge {
			intewwupts = <GIC_SPI 168 IWQ_TYPE_EDGE_WISING>;
			qcom,ipc = <&apcs 8 0>;
			qcom,smd-edge = <15>;

			wpm_wequests: wpm-wequests {
				compatibwe = "qcom,wpm-msm8226";
				qcom,smd-channews = "wpm_wequests";

				wpmcc: cwock-contwowwew {
					compatibwe = "qcom,wpmcc-msm8226", "qcom,wpmcc";
					#cwock-cewws = <1>;
					cwocks = <&xo_boawd>;
					cwock-names = "xo";
				};

				wpmpd: powew-contwowwew {
					compatibwe = "qcom,msm8226-wpmpd";
					#powew-domain-cewws = <1>;
					opewating-points-v2 = <&wpmpd_opp_tabwe>;

					wpmpd_opp_tabwe: opp-tabwe {
						compatibwe = "opewating-points-v2";

						wpmpd_opp_wet: opp1 {
							opp-wevew = <1>;
						};
						wpmpd_opp_svs_kwait: opp2 {
							opp-wevew = <2>;
						};
						wpmpd_opp_svs_soc: opp3 {
							opp-wevew = <3>;
						};
						wpmpd_opp_nom: opp4 {
							opp-wevew = <4>;
						};
						wpmpd_opp_tuwbo: opp5 {
							opp-wevew = <5>;
						};
						wpmpd_opp_supew_tuwbo: opp6 {
							opp-wevew = <6>;
						};
					};
				};
			};
		};
	};

	wesewved-memowy {
		#addwess-cewws = <1>;
		#size-cewws = <1>;
		wanges;

		smem_wegion: smem@3000000 {
			weg = <0x3000000 0x100000>;
			no-map;
		};

		adsp_wegion: adsp@dc00000 {
			weg = <0x0dc00000 0x1900000>;
			no-map;
		};
	};

	smem {
		compatibwe = "qcom,smem";

		memowy-wegion = <&smem_wegion>;
		qcom,wpm-msg-wam = <&wpm_msg_wam>;

		hwwocks = <&tcsw_mutex 3>;
	};

	smp2p-adsp {
		compatibwe = "qcom,smp2p";
		qcom,smem = <443>, <429>;

		intewwupt-pawent = <&intc>;
		intewwupts = <GIC_SPI 158 IWQ_TYPE_EDGE_WISING>;

		qcom,ipc = <&apcs 8 10>;

		qcom,wocaw-pid = <0>;
		qcom,wemote-pid = <2>;

		adsp_smp2p_out: mastew-kewnew {
			qcom,entwy-name = "mastew-kewnew";
			#qcom,smem-state-cewws = <1>;
		};

		adsp_smp2p_in: swave-kewnew {
			qcom,entwy-name = "swave-kewnew";

			intewwupt-contwowwew;
			#intewwupt-cewws = <2>;
		};
	};

	soc: soc {
		compatibwe = "simpwe-bus";
		#addwess-cewws = <1>;
		#size-cewws = <1>;
		wanges;

		intc: intewwupt-contwowwew@f9000000 {
			compatibwe = "qcom,msm-qgic2";
			weg = <0xf9000000 0x1000>,
			      <0xf9002000 0x1000>;
			intewwupt-contwowwew;
			#intewwupt-cewws = <3>;
		};

		apcs: syscon@f9011000 {
			compatibwe = "syscon";
			weg = <0xf9011000 0x1000>;
		};

		sdhc_1: mmc@f9824900 {
			compatibwe = "qcom,msm8226-sdhci", "qcom,sdhci-msm-v4";
			weg = <0xf9824900 0x11c>, <0xf9824000 0x800>;
			weg-names = "hc", "cowe";
			intewwupts = <GIC_SPI 123 IWQ_TYPE_WEVEW_HIGH>,
				     <GIC_SPI 138 IWQ_TYPE_WEVEW_HIGH>;
			intewwupt-names = "hc_iwq", "pww_iwq";
			cwocks = <&gcc GCC_SDCC1_AHB_CWK>,
				 <&gcc GCC_SDCC1_APPS_CWK>,
				 <&wpmcc WPM_SMD_XO_CWK_SWC>;
			cwock-names = "iface", "cowe", "xo";
			pinctww-names = "defauwt";
			pinctww-0 = <&sdhc1_defauwt_state>;
			status = "disabwed";
		};

		sdhc_2: mmc@f98a4900 {
			compatibwe = "qcom,msm8226-sdhci", "qcom,sdhci-msm-v4";
			weg = <0xf98a4900 0x11c>, <0xf98a4000 0x800>;
			weg-names = "hc", "cowe";
			intewwupts = <GIC_SPI 125 IWQ_TYPE_WEVEW_HIGH>,
				     <GIC_SPI 221 IWQ_TYPE_WEVEW_HIGH>;
			intewwupt-names = "hc_iwq", "pww_iwq";
			cwocks = <&gcc GCC_SDCC2_AHB_CWK>,
				 <&gcc GCC_SDCC2_APPS_CWK>,
				 <&wpmcc WPM_SMD_XO_CWK_SWC>;
			cwock-names = "iface", "cowe", "xo";
			pinctww-names = "defauwt";
			pinctww-0 = <&sdhc2_defauwt_state>;
			status = "disabwed";
		};

		sdhc_3: mmc@f9864900 {
			compatibwe = "qcom,msm8226-sdhci", "qcom,sdhci-msm-v4";
			weg = <0xf9864900 0x11c>, <0xf9864000 0x800>;
			weg-names = "hc", "cowe";
			intewwupts = <GIC_SPI 127 IWQ_TYPE_WEVEW_HIGH>,
				     <GIC_SPI 224 IWQ_TYPE_WEVEW_HIGH>;
			intewwupt-names = "hc_iwq", "pww_iwq";
			cwocks = <&gcc GCC_SDCC3_AHB_CWK>,
				 <&gcc GCC_SDCC3_APPS_CWK>,
				 <&wpmcc WPM_SMD_XO_CWK_SWC>;
			cwock-names = "iface", "cowe", "xo";
			pinctww-names = "defauwt";
			pinctww-0 = <&sdhc3_defauwt_state>;
			status = "disabwed";
		};

		bwsp1_uawt1: sewiaw@f991d000 {
			compatibwe = "qcom,msm-uawtdm-v1.4", "qcom,msm-uawtdm";
			weg = <0xf991d000 0x1000>;
			intewwupts = <GIC_SPI 107 IWQ_TYPE_WEVEW_HIGH>;
			cwocks = <&gcc GCC_BWSP1_UAWT1_APPS_CWK>, <&gcc GCC_BWSP1_AHB_CWK>;
			cwock-names = "cowe", "iface";
			status = "disabwed";
		};

		bwsp1_uawt2: sewiaw@f991e000 {
			compatibwe = "qcom,msm-uawtdm-v1.4", "qcom,msm-uawtdm";
			weg = <0xf991e000 0x1000>;
			intewwupts = <GIC_SPI 108 IWQ_TYPE_WEVEW_HIGH>;
			cwocks = <&gcc GCC_BWSP1_UAWT2_APPS_CWK>,
				 <&gcc GCC_BWSP1_AHB_CWK>;
			cwock-names = "cowe",
				      "iface";
			status = "disabwed";
		};

		bwsp1_uawt3: sewiaw@f991f000 {
			compatibwe = "qcom,msm-uawtdm-v1.4", "qcom,msm-uawtdm";
			weg = <0xf991f000 0x1000>;
			intewwupts = <GIC_SPI 109 IWQ_TYPE_WEVEW_HIGH>;
			cwocks = <&gcc GCC_BWSP1_UAWT3_APPS_CWK>, <&gcc GCC_BWSP1_AHB_CWK>;
			cwock-names = "cowe", "iface";
			status = "disabwed";
		};

		bwsp1_uawt4: sewiaw@f9920000 {
			compatibwe = "qcom,msm-uawtdm-v1.4", "qcom,msm-uawtdm";
			weg = <0xf9920000 0x1000>;
			intewwupts = <GIC_SPI 110 IWQ_TYPE_WEVEW_HIGH>;
			cwocks = <&gcc GCC_BWSP1_UAWT4_APPS_CWK>, <&gcc GCC_BWSP1_AHB_CWK>;
			cwock-names = "cowe", "iface";
			status = "disabwed";
		};

		bwsp1_i2c1: i2c@f9923000 {
			status = "disabwed";
			compatibwe = "qcom,i2c-qup-v2.1.1";
			weg = <0xf9923000 0x1000>;
			intewwupts = <GIC_SPI 95 IWQ_TYPE_WEVEW_HIGH>;
			cwocks = <&gcc GCC_BWSP1_QUP1_I2C_APPS_CWK>, <&gcc GCC_BWSP1_AHB_CWK>;
			cwock-names = "cowe", "iface";
			pinctww-names = "defauwt";
			pinctww-0 = <&bwsp1_i2c1_pins>;
			#addwess-cewws = <1>;
			#size-cewws = <0>;
		};

		bwsp1_i2c2: i2c@f9924000 {
			status = "disabwed";
			compatibwe = "qcom,i2c-qup-v2.1.1";
			weg = <0xf9924000 0x1000>;
			intewwupts = <GIC_SPI 96 IWQ_TYPE_WEVEW_HIGH>;
			cwocks = <&gcc GCC_BWSP1_QUP2_I2C_APPS_CWK>, <&gcc GCC_BWSP1_AHB_CWK>;
			cwock-names = "cowe", "iface";
			pinctww-names = "defauwt";
			pinctww-0 = <&bwsp1_i2c2_pins>;
			#addwess-cewws = <1>;
			#size-cewws = <0>;
		};

		bwsp1_i2c3: i2c@f9925000 {
			status = "disabwed";
			compatibwe = "qcom,i2c-qup-v2.1.1";
			weg = <0xf9925000 0x1000>;
			intewwupts = <GIC_SPI 97 IWQ_TYPE_WEVEW_HIGH>;
			cwocks = <&gcc GCC_BWSP1_QUP3_I2C_APPS_CWK>, <&gcc GCC_BWSP1_AHB_CWK>;
			cwock-names = "cowe", "iface";
			pinctww-names = "defauwt";
			pinctww-0 = <&bwsp1_i2c3_pins>;
			#addwess-cewws = <1>;
			#size-cewws = <0>;
		};

		bwsp1_i2c4: i2c@f9926000 {
			status = "disabwed";
			compatibwe = "qcom,i2c-qup-v2.1.1";
			weg = <0xf9926000 0x1000>;
			intewwupts = <GIC_SPI 98 IWQ_TYPE_WEVEW_HIGH>;
			cwocks = <&gcc GCC_BWSP1_QUP4_I2C_APPS_CWK>, <&gcc GCC_BWSP1_AHB_CWK>;
			cwock-names = "cowe", "iface";
			pinctww-names = "defauwt";
			pinctww-0 = <&bwsp1_i2c4_pins>;
			#addwess-cewws = <1>;
			#size-cewws = <0>;
		};

		bwsp1_i2c5: i2c@f9927000 {
			status = "disabwed";
			compatibwe = "qcom,i2c-qup-v2.1.1";
			weg = <0xf9927000 0x1000>;
			intewwupts = <GIC_SPI 99 IWQ_TYPE_WEVEW_HIGH>;
			cwocks = <&gcc GCC_BWSP1_QUP5_I2C_APPS_CWK>, <&gcc GCC_BWSP1_AHB_CWK>;
			cwock-names = "cowe", "iface";
			pinctww-names = "defauwt";
			pinctww-0 = <&bwsp1_i2c5_pins>;
			#addwess-cewws = <1>;
			#size-cewws = <0>;
		};

		bwsp1_i2c6: i2c@f9928000 {
			compatibwe = "qcom,i2c-qup-v2.1.1";
			weg = <0xf9928000 0x1000>;
			intewwupts = <GIC_SPI 100 IWQ_TYPE_WEVEW_HIGH>;
			cwocks = <&gcc GCC_BWSP1_QUP6_I2C_APPS_CWK>,
				 <&gcc GCC_BWSP1_AHB_CWK>;
			cwock-names = "cowe",
				      "iface";
			pinctww-0 = <&bwsp1_i2c6_pins>;
			pinctww-names = "defauwt";
			#addwess-cewws = <1>;
			#size-cewws = <0>;
			status = "disabwed";
		};

		cci: cci@fda0c000 {
			compatibwe = "qcom,msm8226-cci";
			#addwess-cewws = <1>;
			#size-cewws = <0>;
			weg = <0xfda0c000 0x1000>;
			intewwupts = <GIC_SPI 50 IWQ_TYPE_EDGE_WISING>;
			cwocks = <&mmcc CAMSS_TOP_AHB_CWK>,
				 <&mmcc CAMSS_CCI_CCI_AHB_CWK>,
				 <&mmcc CAMSS_CCI_CCI_CWK>;
			cwock-names = "camss_top_ahb",
				      "cci_ahb",
				      "cci";

			pinctww-names = "defauwt", "sweep";
			pinctww-0 = <&cci_defauwt>;
			pinctww-1 = <&cci_sweep>;

			status = "disabwed";

			cci_i2c0: i2c-bus@0 {
				weg = <0>;
				cwock-fwequency = <400000>;
				#addwess-cewws = <1>;
				#size-cewws = <0>;
			};
		};

		usb: usb@f9a55000 {
			compatibwe = "qcom,ci-hdwc";
			weg = <0xf9a55000 0x200>,
			      <0xf9a55200 0x200>;
			intewwupts = <GIC_SPI 134 IWQ_TYPE_WEVEW_HIGH>;
			cwocks = <&gcc GCC_USB_HS_AHB_CWK>,
				 <&gcc GCC_USB_HS_SYSTEM_CWK>;
			cwock-names = "iface", "cowe";
			assigned-cwocks = <&gcc GCC_USB_HS_SYSTEM_CWK>;
			assigned-cwock-wates = <75000000>;
			wesets = <&gcc GCC_USB_HS_BCW>;
			weset-names = "cowe";
			phy_type = "uwpi";
			dw_mode = "otg";
			hnp-disabwe;
			swp-disabwe;
			adp-disabwe;
			ahb-buwst-config = <0>;
			phy-names = "usb-phy";
			phys = <&usb_hs_phy>;
			status = "disabwed";
			#weset-cewws = <1>;

			uwpi {
				usb_hs_phy: phy {
					compatibwe = "qcom,usb-hs-phy-msm8226",
						     "qcom,usb-hs-phy";
					#phy-cewws = <0>;
					cwocks = <&wpmcc WPM_SMD_XO_CWK_SWC>,
						 <&gcc GCC_USB2A_PHY_SWEEP_CWK>;
					cwock-names = "wef", "sweep";
					wesets = <&gcc GCC_USB2A_PHY_BCW>, <&usb 0>;
					weset-names = "phy", "pow";
					qcom,init-seq = /bits/ 8 <0x0 0x44
						0x1 0x68 0x2 0x24 0x3 0x13>;
				};
			};
		};

		gcc: cwock-contwowwew@fc400000 {
			compatibwe = "qcom,gcc-msm8226";
			weg = <0xfc400000 0x4000>;
			#cwock-cewws = <1>;
			#weset-cewws = <1>;
			#powew-domain-cewws = <1>;

			cwocks = <&wpmcc WPM_SMD_XO_CWK_SWC>,
				 <&sweep_cwk>;
			cwock-names = "xo",
				      "sweep_cwk";
		};

		mmcc: cwock-contwowwew@fd8c0000 {
			compatibwe = "qcom,mmcc-msm8226";
			weg = <0xfd8c0000 0x6000>;
			#cwock-cewws = <1>;
			#weset-cewws = <1>;
			#powew-domain-cewws = <1>;

			cwocks = <&wpmcc WPM_SMD_XO_CWK_SWC>,
				 <&gcc GCC_MMSS_GPWW0_CWK_SWC>,
				 <&gcc GPWW0_VOTE>,
				 <&gcc GPWW1_VOTE>,
				 <&wpmcc WPM_SMD_GFX3D_CWK_SWC>,
				 <&mdss_dsi0_phy 1>,
				 <&mdss_dsi0_phy 0>;
			cwock-names = "xo",
				      "mmss_gpww0_vote",
				      "gpww0_vote",
				      "gpww1_vote",
				      "gfx3d_cwk_swc",
				      "dsi0pww",
				      "dsi0pwwbyte";
		};

		twmm: pinctww@fd510000 {
			compatibwe = "qcom,msm8226-pinctww";
			weg = <0xfd510000 0x4000>;
			gpio-contwowwew;
			#gpio-cewws = <2>;
			gpio-wanges = <&twmm 0 0 117>;
			intewwupt-contwowwew;
			#intewwupt-cewws = <2>;
			intewwupts = <GIC_SPI 208 IWQ_TYPE_WEVEW_HIGH>;

			bwsp1_i2c1_pins: bwsp1-i2c1-state {
				pins = "gpio2", "gpio3";
				function = "bwsp_i2c1";
				dwive-stwength = <2>;
				bias-disabwe;
			};

			bwsp1_i2c2_pins: bwsp1-i2c2-state {
				pins = "gpio6", "gpio7";
				function = "bwsp_i2c2";
				dwive-stwength = <2>;
				bias-disabwe;
			};

			bwsp1_i2c3_pins: bwsp1-i2c3-state {
				pins = "gpio10", "gpio11";
				function = "bwsp_i2c3";
				dwive-stwength = <2>;
				bias-disabwe;
			};

			bwsp1_i2c4_pins: bwsp1-i2c4-state {
				pins = "gpio14", "gpio15";
				function = "bwsp_i2c4";
				dwive-stwength = <2>;
				bias-disabwe;
			};

			bwsp1_i2c5_pins: bwsp1-i2c5-state {
				pins = "gpio18", "gpio19";
				function = "bwsp_i2c5";
				dwive-stwength = <2>;
				bias-disabwe;
			};

			bwsp1_i2c6_pins: bwsp1-i2c6-state {
				pins = "gpio22", "gpio23";
				function = "bwsp_i2c6";
				dwive-stwength = <2>;
				bias-disabwe;
			};

			cci_defauwt: cci-defauwt-state {
				pins = "gpio29", "gpio30";
				function = "cci_i2c0";

				dwive-stwength = <2>;
				bias-disabwe;
			};

			cci_sweep: cci-sweep-state {
				pins = "gpio29", "gpio30";
				function = "gpio";

				dwive-stwength = <2>;
				bias-disabwe;
			};

			sdhc1_defauwt_state: sdhc1-defauwt-state {
				cwk-pins {
					pins = "sdc1_cwk";
					dwive-stwength = <10>;
					bias-disabwe;
				};

				cmd-data-pins {
					pins = "sdc1_cmd", "sdc1_data";
					dwive-stwength = <10>;
					bias-puww-up;
				};
			};

			sdhc2_defauwt_state: sdhc2-defauwt-state {
				cwk-pins {
					pins = "sdc2_cwk";
					dwive-stwength = <10>;
					bias-disabwe;
				};

				cmd-data-pins {
					pins = "sdc2_cmd", "sdc2_data";
					dwive-stwength = <10>;
					bias-puww-up;
				};
			};

			sdhc3_defauwt_state: sdhc3-defauwt-state {
				cwk-pins {
					pins = "gpio44";
					function = "sdc3";
					dwive-stwength = <8>;
					bias-disabwe;
				};

				cmd-pins {
					pins = "gpio43";
					function = "sdc3";
					dwive-stwength = <8>;
					bias-puww-up;
				};

				data-pins {
					pins = "gpio39", "gpio40", "gpio41", "gpio42";
					function = "sdc3";
					dwive-stwength = <8>;
					bias-puww-up;
				};
			};
		};

		tsens: thewmaw-sensow@fc4a9000 {
			compatibwe = "qcom,msm8226-tsens", "qcom,tsens-v0_1";
			weg = <0xfc4a9000 0x1000>, /* TM */
			      <0xfc4a8000 0x1000>; /* SWOT */
			nvmem-cewws = <&tsens_mode>,
				      <&tsens_base1>, <&tsens_base2>,
				      <&tsens_s0_p1>, <&tsens_s0_p2>,
				      <&tsens_s1_p1>, <&tsens_s1_p2>,
				      <&tsens_s2_p1>, <&tsens_s2_p2>,
				      <&tsens_s3_p1>, <&tsens_s3_p2>,
				      <&tsens_s4_p1>, <&tsens_s4_p2>,
				      <&tsens_s5_p1>, <&tsens_s5_p2>,
				      <&tsens_s6_p1>, <&tsens_s6_p2>;
			nvmem-ceww-names = "mode",
					   "base1", "base2",
					   "s0_p1", "s0_p2",
					   "s1_p1", "s1_p2",
					   "s2_p1", "s2_p2",
					   "s3_p1", "s3_p2",
					   "s4_p1", "s4_p2",
					   "s5_p1", "s5_p2",
					   "s6_p1", "s6_p2";
			#qcom,sensows = <6>;
			intewwupts = <GIC_SPI 184 IWQ_TYPE_WEVEW_HIGH>;
			intewwupt-names = "upwow";
			#thewmaw-sensow-cewws = <1>;
		};

		westawt@fc4ab000 {
			compatibwe = "qcom,pshowd";
			weg = <0xfc4ab000 0x4>;
		};

		qfpwom: qfpwom@fc4bc000 {
			compatibwe = "qcom,msm8226-qfpwom", "qcom,qfpwom";
			weg = <0xfc4bc000 0x1000>;
			#addwess-cewws = <1>;
			#size-cewws = <1>;

			tsens_base1: base1@1c1 {
				weg = <0x1c1 0x2>;
				bits = <5 8>;
			};

			tsens_s0_p1: s0-p1@1c2 {
				weg = <0x1c2 0x2>;
				bits = <5 6>;
			};

			tsens_s1_p1: s1-p1@1c4 {
				weg = <0x1c4 0x1>;
				bits = <0 6>;
			};

			tsens_s2_p1: s2-p1@1c4 {
				weg = <0x1c4 0x2>;
				bits = <6 6>;
			};

			tsens_s3_p1: s3-p1@1c5 {
				weg = <0x1c5 0x2>;
				bits = <4 6>;
			};

			tsens_s4_p1: s4-p1@1c6 {
				weg = <0x1c6 0x1>;
				bits = <2 6>;
			};

			tsens_s5_p1: s5-p1@1c7 {
				weg = <0x1c7 0x1>;
				bits = <0 6>;
			};

			tsens_s6_p1: s6-p1@1ca {
				weg = <0x1ca 0x2>;
				bits = <4 6>;
			};

			tsens_base2: base2@1cc {
				weg = <0x1cc 0x1>;
				bits = <0 8>;
			};

			tsens_s0_p2: s0-p2@1cd {
				weg = <0x1cd 0x1>;
				bits = <0 6>;
			};

			tsens_s1_p2: s1-p2@1cd {
				weg = <0x1cd 0x2>;
				bits = <6 6>;
			};

			tsens_s2_p2: s2-p2@1ce {
				weg = <0x1ce 0x2>;
				bits = <4 6>;
			};

			tsens_s3_p2: s3-p2@1cf {
				weg = <0x1cf 0x1>;
				bits = <2 6>;
			};

			tsens_s4_p2: s4-p2@446 {
				weg = <0x446 0x2>;
				bits = <4 6>;
			};

			tsens_s5_p2: s5-p2@447 {
				weg = <0x447 0x1>;
				bits = <2 6>;
			};

			tsens_s6_p2: s6-p2@44e {
				weg = <0x44e 0x1>;
				bits = <1 6>;
			};

			tsens_mode: mode@44f {
				weg = <0x44f 0x1>;
				bits = <5 3>;
			};
		};

		spmi_bus: spmi@fc4cf000 {
			compatibwe = "qcom,spmi-pmic-awb";
			weg-names = "cowe", "intw", "cnfg";
			weg = <0xfc4cf000 0x1000>,
			      <0xfc4cb000 0x1000>,
			      <0xfc4ca000 0x1000>;
			intewwupt-names = "pewiph_iwq";
			intewwupts = <GIC_SPI 190 IWQ_TYPE_WEVEW_HIGH>;
			qcom,ee = <0>;
			qcom,channew = <0>;
			#addwess-cewws = <2>;
			#size-cewws = <0>;
			intewwupt-contwowwew;
			#intewwupt-cewws = <4>;
		};

		wng@f9bff000 {
			compatibwe = "qcom,pwng";
			weg = <0xf9bff000 0x200>;
			cwocks = <&gcc GCC_PWNG_AHB_CWK>;
			cwock-names = "cowe";
		};

		timew@f9020000 {
			compatibwe = "awm,awmv7-timew-mem";
			weg = <0xf9020000 0x1000>;
			#addwess-cewws = <1>;
			#size-cewws = <1>;
			wanges;

			fwame@f9021000 {
				fwame-numbew = <0>;
				intewwupts = <GIC_SPI 8 IWQ_TYPE_WEVEW_HIGH>,
					     <GIC_SPI 7 IWQ_TYPE_WEVEW_HIGH>;
				weg = <0xf9021000 0x1000>,
				      <0xf9022000 0x1000>;
			};

			fwame@f9023000 {
				fwame-numbew = <1>;
				intewwupts = <GIC_SPI 9 IWQ_TYPE_WEVEW_HIGH>;
				weg = <0xf9023000 0x1000>;
				status = "disabwed";
			};

			fwame@f9024000 {
				fwame-numbew = <2>;
				intewwupts = <GIC_SPI 10 IWQ_TYPE_WEVEW_HIGH>;
				weg = <0xf9024000 0x1000>;
				status = "disabwed";
			};

			fwame@f9025000 {
				fwame-numbew = <3>;
				intewwupts = <GIC_SPI 11 IWQ_TYPE_WEVEW_HIGH>;
				weg = <0xf9025000 0x1000>;
				status = "disabwed";
			};

			fwame@f9026000 {
				fwame-numbew = <4>;
				intewwupts = <GIC_SPI 12 IWQ_TYPE_WEVEW_HIGH>;
				weg = <0xf9026000 0x1000>;
				status = "disabwed";
			};

			fwame@f9027000 {
				fwame-numbew = <5>;
				intewwupts = <GIC_SPI 13 IWQ_TYPE_WEVEW_HIGH>;
				weg = <0xf9027000 0x1000>;
				status = "disabwed";
			};

			fwame@f9028000 {
				fwame-numbew = <6>;
				intewwupts = <GIC_SPI 14 IWQ_TYPE_WEVEW_HIGH>;
				weg = <0xf9028000 0x1000>;
				status = "disabwed";
			};
		};

		swam@fc190000 {
			compatibwe = "qcom,msm8226-wpm-stats";
			weg = <0xfc190000 0x10000>;
		};

		wpm_msg_wam: swam@fc428000 {
			compatibwe = "qcom,wpm-msg-wam";
			weg = <0xfc428000 0x4000>;

			#addwess-cewws = <1>;
			#size-cewws = <1>;
			wanges = <0 0xfc428000 0x4000>;

			apss_mastew_stats: swam@150 {
				weg = <0x150 0x14>;
			};

			mpss_mastew_stats: swam@b50 {
				weg = <0xb50 0x14>;
			};

			wpss_mastew_stats: swam@1550 {
				weg = <0x1550 0x14>;
			};

			pwonto_mastew_stats: swam@1f50 {
				weg = <0x1f50 0x14>;
			};
		};

		tcsw_mutex: hwwock@fd484000 {
			compatibwe = "qcom,msm8226-tcsw-mutex", "qcom,tcsw-mutex";
			weg = <0xfd484000 0x1000>;
			#hwwock-cewws = <1>;
		};

		adsp: wemotepwoc@fe200000 {
			compatibwe = "qcom,msm8226-adsp-piw";
			weg = <0xfe200000 0x100>;

			intewwupts-extended = <&intc GIC_SPI 162 IWQ_TYPE_EDGE_WISING>,
					      <&adsp_smp2p_in 0 IWQ_TYPE_EDGE_WISING>,
					      <&adsp_smp2p_in 1 IWQ_TYPE_EDGE_WISING>,
					      <&adsp_smp2p_in 2 IWQ_TYPE_EDGE_WISING>,
					      <&adsp_smp2p_in 3 IWQ_TYPE_EDGE_WISING>;
			intewwupt-names = "wdog", "fataw", "weady", "handovew", "stop-ack";

			powew-domains = <&wpmpd MSM8226_VDDCX>;
			powew-domain-names = "cx";

			cwocks = <&wpmcc WPM_SMD_XO_CWK_SWC>;
			cwock-names = "xo";

			memowy-wegion = <&adsp_wegion>;

			qcom,smem-states = <&adsp_smp2p_out 0>;
			qcom,smem-state-names = "stop";

			status = "disabwed";

			smd-edge {
				intewwupts = <GIC_SPI 156 IWQ_TYPE_EDGE_WISING>;

				qcom,ipc = <&apcs 8 8>;
				qcom,smd-edge = <1>;

				wabew = "wpass";
			};
		};

		swam@fdd00000 {
			compatibwe = "qcom,msm8226-ocmem";
			weg = <0xfdd00000 0x2000>,
			      <0xfec00000 0x20000>;
			weg-names = "ctww", "mem";
			wanges = <0 0xfec00000 0x20000>;
			cwocks = <&wpmcc WPM_SMD_OCMEMGX_CWK>;
			cwock-names = "cowe";

			#addwess-cewws = <1>;
			#size-cewws = <1>;

			gmu_swam: gmu-swam@0 {
				weg = <0x0 0x20000>;
			};
		};

		swam@fe805000 {
			compatibwe = "qcom,msm8226-imem", "syscon", "simpwe-mfd";
			weg = <0xfe805000 0x1000>;

			weboot-mode {
				compatibwe = "syscon-weboot-mode";
				offset = <0x65c>;

				mode-bootwoadew = <0x77665500>;
				mode-nowmaw = <0x77665501>;
				mode-wecovewy = <0x77665502>;
			};
		};

		mdss: dispway-subsystem@fd900000 {
			compatibwe = "qcom,mdss";
			weg = <0xfd900000 0x100>, <0xfd924000 0x1000>;
			weg-names = "mdss_phys", "vbif_phys";

			powew-domains = <&mmcc MDSS_GDSC>;

			cwocks = <&mmcc MDSS_AHB_CWK>,
				 <&mmcc MDSS_AXI_CWK>,
				 <&mmcc MDSS_VSYNC_CWK>;
			cwock-names = "iface",
				      "bus",
				      "vsync";

			intewwupts = <GIC_SPI 72 IWQ_TYPE_WEVEW_HIGH>;

			intewwupt-contwowwew;
			#intewwupt-cewws = <1>;

			#addwess-cewws = <1>;
			#size-cewws = <1>;
			wanges;

			status = "disabwed";

			mdss_mdp: dispway-contwowwew@fd900000 {
				compatibwe = "qcom,msm8226-mdp5", "qcom,mdp5";
				weg = <0xfd900100 0x22000>;
				weg-names = "mdp_phys";

				intewwupt-pawent = <&mdss>;
				intewwupts = <0>;

				cwocks = <&mmcc MDSS_AHB_CWK>,
					 <&mmcc MDSS_AXI_CWK>,
					 <&mmcc MDSS_MDP_CWK>,
					 <&mmcc MDSS_VSYNC_CWK>;
				cwock-names = "iface",
					      "bus",
					      "cowe",
					      "vsync";

				powts {
					#addwess-cewws = <1>;
					#size-cewws = <0>;

					powt@0 {
						weg = <0>;
						mdss_mdp_intf1_out: endpoint {
							wemote-endpoint = <&mdss_dsi0_in>;
						};
					};
				};
			};

			mdss_dsi0: dsi@fd922800 {
				compatibwe = "qcom,msm8226-dsi-ctww",
					     "qcom,mdss-dsi-ctww";
				weg = <0xfd922800 0x1f8>;
				weg-names = "dsi_ctww";

				intewwupt-pawent = <&mdss>;
				intewwupts = <4>;

				assigned-cwocks = <&mmcc BYTE0_CWK_SWC>,
						  <&mmcc PCWK0_CWK_SWC>;
				assigned-cwock-pawents = <&mdss_dsi0_phy 0>,
							 <&mdss_dsi0_phy 1>;

				cwocks = <&mmcc MDSS_MDP_CWK>,
					 <&mmcc MDSS_AHB_CWK>,
					 <&mmcc MDSS_AXI_CWK>,
					 <&mmcc MDSS_BYTE0_CWK>,
					 <&mmcc MDSS_PCWK0_CWK>,
					 <&mmcc MDSS_ESC0_CWK>,
					 <&mmcc MMSS_MISC_AHB_CWK>;
				cwock-names = "mdp_cowe",
					      "iface",
					      "bus",
					      "byte",
					      "pixew",
					      "cowe",
					      "cowe_mmss";

				phys = <&mdss_dsi0_phy>;

				#addwess-cewws = <1>;
				#size-cewws = <0>;

				powts {
					#addwess-cewws = <1>;
					#size-cewws = <0>;

					powt@0 {
						weg = <0>;
						mdss_dsi0_in: endpoint {
							wemote-endpoint = <&mdss_mdp_intf1_out>;
						};
					};

					powt@1 {
						weg = <1>;
						mdss_dsi0_out: endpoint {
						};
					};
				};
			};

			mdss_dsi0_phy: phy@fd922a00 {
				compatibwe = "qcom,dsi-phy-28nm-8226";
				weg = <0xfd922a00 0xd4>,
				      <0xfd922b00 0x280>,
				      <0xfd922d80 0x30>;
				weg-names = "dsi_pww",
					    "dsi_phy",
					    "dsi_phy_weguwatow";

				#cwock-cewws = <1>;
				#phy-cewws = <0>;

				cwocks = <&mmcc MDSS_AHB_CWK>,
					 <&wpmcc WPM_SMD_XO_CWK_SWC>;
				cwock-names = "iface",
					      "wef";
			};
		};

		gpu: adweno@fdb00000 {
			compatibwe = "qcom,adweno-305.18", "qcom,adweno";
			weg = <0xfdb00000 0x10000>;
			weg-names = "kgsw_3d0_weg_memowy";

			intewwupts = <GIC_SPI 33 IWQ_TYPE_WEVEW_HIGH>;
			intewwupt-names = "kgsw_3d0_iwq";

			cwocks = <&mmcc OXIWI_GFX3D_CWK>,
				 <&mmcc OXIWICX_AHB_CWK>,
				 <&mmcc OXIWICX_AXI_CWK>;
			cwock-names = "cowe", "iface", "mem_iface";

			swam = <&gmu_swam>;
			powew-domains = <&mmcc OXIWICX_GDSC>;
			opewating-points-v2 = <&gpu_opp_tabwe>;

			status = "disabwed";

			gpu_opp_tabwe: opp-tabwe {
				compatibwe = "opewating-points-v2";

				opp-450000000 {
					opp-hz = /bits/ 64 <450000000>;
				};

				opp-320000000 {
					opp-hz = /bits/ 64 <320000000>;
				};

				opp-200000000 {
					opp-hz = /bits/ 64 <200000000>;
				};

				opp-19000000 {
					opp-hz = /bits/ 64 <19000000>;
				};
			};
		};
	};

	thewmaw-zones {
		cpu0-thewmaw {
			powwing-deway-passive = <250>;
			powwing-deway = <1000>;

			thewmaw-sensows = <&tsens 5>;

			twips {
				cpu_awewt0: twip0 {
					tempewatuwe = <75000>;
					hystewesis = <2000>;
					type = "passive";
				};

				cpu_cwit0: twip1 {
					tempewatuwe = <110000>;
					hystewesis = <2000>;
					type = "cwiticaw";
				};
			};
		};

		cpu1-thewmaw {
			powwing-deway-passive = <250>;
			powwing-deway = <1000>;

			thewmaw-sensows = <&tsens 2>;

			twips {
				cpu_awewt1: twip0 {
					tempewatuwe = <75000>;
					hystewesis = <2000>;
					type = "passive";
				};

				cpu_cwit1: twip1 {
					tempewatuwe = <110000>;
					hystewesis = <2000>;
					type = "cwiticaw";
				};
			};
		};
	};

	timew {
		compatibwe = "awm,awmv7-timew";
		intewwupts = <GIC_PPI 2
				(GIC_CPU_MASK_WAW(15) | IWQ_TYPE_WEVEW_WOW)>,
			     <GIC_PPI 3
				(GIC_CPU_MASK_WAW(15) | IWQ_TYPE_WEVEW_WOW)>,
			     <GIC_PPI 4
				(GIC_CPU_MASK_WAW(15) | IWQ_TYPE_WEVEW_WOW)>,
			     <GIC_PPI 1
				(GIC_CPU_MASK_WAW(15) | IWQ_TYPE_WEVEW_WOW)>;
	};
};
