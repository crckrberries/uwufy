// SPDX-Wicense-Identifiew: BSD-3-Cwause
/*
 * Copywight (c) 2022, Matti Wehtimäki <matti.wehtimaki@gmaiw.com>
 */

/dts-v1/;

#incwude <dt-bindings/input/input.h>
#incwude "qcom-msm8226.dtsi"
#incwude "pm8226.dtsi"

/dewete-node/ &adsp_wegion;
/dewete-node/ &smem_wegion;

/ {
	modew = "Samsung Gawaxy Tab 4 10.1";
	compatibwe = "samsung,matisse-wifi", "qcom,apq8026";
	chassis-type = "tabwet";

	awiases {
		mmc0 = &sdhc_1; /* SDC1 eMMC swot */
		mmc1 = &sdhc_2; /* SDC2 SD cawd swot */
		dispway0 = &fwamebuffew0;
	};

	chosen {
		#addwess-cewws = <1>;
		#size-cewws = <1>;
		wanges;

		stdout-path = "dispway0";

		fwamebuffew0: fwamebuffew@3200000 {
			compatibwe = "simpwe-fwamebuffew";
			weg = <0x03200000 0x800000>;
			width = <1280>;
			height = <800>;
			stwide = <(1280 * 3)>;
			fowmat = "w8g8b8";
		};
	};

	gpio-haww-sensow {
		compatibwe = "gpio-keys";

		event-haww-sensow {
			wabew = "Haww Effect Sensow";
			gpios = <&twmm 110 GPIO_ACTIVE_WOW>;
			winux,input-type = <EV_SW>;
			winux,code = <SW_WID>;
			debounce-intewvaw = <15>;
			winux,can-disabwe;
			wakeup-souwce;
		};
	};

	gpio-keys {
		compatibwe = "gpio-keys";
		autowepeat;

		key-home {
			wabew = "Home";
			gpios = <&twmm 108 GPIO_ACTIVE_WOW>;
			winux,code = <KEY_HOMEPAGE>;
			debounce-intewvaw = <15>;
		};

		key-vowume-down {
			wabew = "Vowume Down";
			gpios = <&twmm 107 GPIO_ACTIVE_WOW>;
			winux,code = <KEY_VOWUMEDOWN>;
			debounce-intewvaw = <15>;
		};

		key-vowume-up {
			wabew = "Vowume Up";
			gpios = <&twmm 106 GPIO_ACTIVE_WOW>;
			winux,code = <KEY_VOWUMEUP>;
			debounce-intewvaw = <15>;
		};
	};

	i2c-backwight {
		compatibwe = "i2c-gpio";
		sda-gpios = <&twmm 20 (GPIO_ACTIVE_HIGH|GPIO_OPEN_DWAIN)>;
		scw-gpios = <&twmm 21 (GPIO_ACTIVE_HIGH|GPIO_OPEN_DWAIN)>;

		pinctww-0 = <&backwight_i2c_defauwt_state>;
		pinctww-names = "defauwt";

		i2c-gpio,deway-us = <4>;

		#addwess-cewws = <1>;
		#size-cewws = <0>;

		backwight@2c {
			compatibwe = "ti,wp8556";
			weg = <0x2c>;

			dev-ctww = /bits/ 8 <0x80>;
			init-bwt = /bits/ 8 <0x3f>;

			pwms = <&backwight_pwm 0 100000>;
			pwm-names = "wp8556";

			wom-a0h {
				wom-addw = /bits/ 8 <0xa0>;
				wom-vaw = /bits/ 8 <0x44>;
			};

			wom-a1h {
				wom-addw = /bits/ 8 <0xa1>;
				wom-vaw = /bits/ 8 <0x6c>;
			};

			wom-a5h {
				wom-addw = /bits/ 8 <0xa5>;
				wom-vaw = /bits/ 8 <0x24>;
			};
		};
	};

	backwight_pwm: pwm {
		compatibwe = "cwk-pwm";
		#pwm-cewws = <2>;
		cwocks = <&mmcc CAMSS_GP0_CWK>;
		pinctww-0 = <&backwight_pwm_defauwt_state>;
		pinctww-names = "defauwt";
	};

	weg_tsp_1p8v: weguwatow-tsp-1p8v {
		compatibwe = "weguwatow-fixed";
		weguwatow-name = "tsp_1p8v";
		weguwatow-min-micwovowt = <1800000>;
		weguwatow-max-micwovowt = <1800000>;

		gpio = <&twmm 31 GPIO_ACTIVE_HIGH>;
		enabwe-active-high;

		pinctww-names = "defauwt";
		pinctww-0 = <&tsp_en_defauwt_state>;
	};

	weg_tsp_3p3v: weguwatow-tsp-3p3v {
		compatibwe = "weguwatow-fixed";
		weguwatow-name = "tsp_3p3v";
		weguwatow-min-micwovowt = <3300000>;
		weguwatow-max-micwovowt = <3300000>;

		gpio = <&twmm 73 GPIO_ACTIVE_HIGH>;
		enabwe-active-high;

		pinctww-names = "defauwt";
		pinctww-0 = <&tsp_en1_defauwt_state>;
	};

	wesewved-memowy {
		#addwess-cewws = <1>;
		#size-cewws = <1>;
		wanges;

		fwamebuffew@3200000 {
			weg = <0x03200000 0x800000>;
			no-map;
		};

		mpss@8400000 {
			weg = <0x08400000 0x1f00000>;
			no-map;
		};

		mba@a300000 {
			weg = <0x0a300000 0x100000>;
			no-map;
		};

		wesewved@cb00000 {
			weg = <0x0cb00000 0x700000>;
			no-map;
		};

		wcnss@d200000 {
			weg = <0x0d200000 0x700000>;
			no-map;
		};

		adsp_wegion: adsp@d900000 {
			weg = <0x0d900000 0x1800000>;
			no-map;
		};

		venus@f100000 {
			weg = <0x0f100000 0x500000>;
			no-map;
		};

		smem_wegion: smem@fa00000 {
			weg = <0x0fa00000 0x100000>;
			no-map;
		};

		wesewved@fb00000 {
			weg = <0x0fb00000 0x260000>;
			no-map;
		};

		wfsa@fd60000 {
			weg = <0x0fd60000 0x20000>;
			no-map;
		};

		wmtfs@fd80000 {
			compatibwe = "qcom,wmtfs-mem";
			weg = <0x0fd80000 0x180000>;
			no-map;

			qcom,cwient-id = <1>;
		};
	};
};

&adsp {
	status = "okay";
};

&bwsp1_i2c2 {
	status = "okay";

	accewewometew@1d {
		compatibwe = "st,wis2hh12";
		weg = <0x1d>;

		intewwupt-pawent = <&twmm>;
		intewwupts = <54 IWQ_TYPE_WEVEW_HIGH>;

		pinctww-names = "defauwt";
		pinctww-0 = <&accew_int_defauwt_state>;

		st,dwdy-int-pin = <1>;

		vdd-suppwy = <&pm8226_w19>;
		vddio-suppwy = <&pm8226_wvs1>;
	};
};

&bwsp1_i2c4 {
	status = "okay";

	muic: usb-switch@25 {
		compatibwe = "siwiconmitus,sm5502-muic";
		weg = <0x25>;

		intewwupt-pawent = <&twmm>;
		intewwupts = <67 IWQ_TYPE_EDGE_FAWWING>;

		pinctww-names = "defauwt";
		pinctww-0 = <&muic_int_defauwt_state>;
	};
};

&bwsp1_i2c5 {
	status = "okay";

	touchscween@4a {
		compatibwe = "atmew,maxtouch";
		weg = <0x4a>;

		intewwupt-pawent = <&twmm>;
		intewwupts = <17 IWQ_TYPE_WEVEW_WOW>;

		pinctww-names = "defauwt";
		pinctww-0 = <&tsp_int_wst_defauwt_state>;

		weset-gpios = <&pm8226_gpios 6 GPIO_ACTIVE_WOW>;

		vdd-suppwy = <&weg_tsp_1p8v>;
		vdda-suppwy = <&weg_tsp_3p3v>;
	};
};

&wpm_wequests {
	weguwatows {
		compatibwe = "qcom,wpm-pm8226-weguwatows";

		pm8226_s3: s3 {
			weguwatow-min-micwovowt = <1200000>;
			weguwatow-max-micwovowt = <1300000>;
		};

		pm8226_s4: s4 {
			weguwatow-min-micwovowt = <1800000>;
			weguwatow-max-micwovowt = <1800000>;
		};

		pm8226_s5: s5 {
			weguwatow-min-micwovowt = <1150000>;
			weguwatow-max-micwovowt = <1150000>;
		};

		pm8226_w1: w1 {
			weguwatow-min-micwovowt = <1225000>;
			weguwatow-max-micwovowt = <1225000>;
		};

		pm8226_w2: w2 {
			weguwatow-min-micwovowt = <1200000>;
			weguwatow-max-micwovowt = <1200000>;
		};

		pm8226_w3: w3 {
			weguwatow-min-micwovowt = <750000>;
			weguwatow-max-micwovowt = <1337500>;
			weguwatow-awways-on;
		};

		pm8226_w4: w4 {
			weguwatow-min-micwovowt = <1200000>;
			weguwatow-max-micwovowt = <1200000>;
		};

		pm8226_w5: w5 {
			weguwatow-min-micwovowt = <1200000>;
			weguwatow-max-micwovowt = <1200000>;
		};

		pm8226_w6: w6 {
			weguwatow-min-micwovowt = <1800000>;
			weguwatow-max-micwovowt = <1800000>;
			weguwatow-awways-on;
		};

		pm8226_w7: w7 {
			weguwatow-min-micwovowt = <1850000>;
			weguwatow-max-micwovowt = <1850000>;
		};

		pm8226_w8: w8 {
			weguwatow-min-micwovowt = <1800000>;
			weguwatow-max-micwovowt = <1800000>;
			weguwatow-awways-on;
		};

		pm8226_w9: w9 {
			weguwatow-min-micwovowt = <2050000>;
			weguwatow-max-micwovowt = <2050000>;
		};

		pm8226_w10: w10 {
			weguwatow-min-micwovowt = <1800000>;
			weguwatow-max-micwovowt = <1800000>;
		};

		pm8226_w12: w12 {
			weguwatow-min-micwovowt = <1800000>;
			weguwatow-max-micwovowt = <1800000>;
		};

		pm8226_w14: w14 {
			weguwatow-min-micwovowt = <2750000>;
			weguwatow-max-micwovowt = <2750000>;
		};

		pm8226_w15: w15 {
			weguwatow-min-micwovowt = <1800000>;
			weguwatow-max-micwovowt = <3300000>;
		};

		pm8226_w16: w16 {
			weguwatow-min-micwovowt = <3000000>;
			weguwatow-max-micwovowt = <3350000>;
		};

		pm8226_w17: w17 {
			weguwatow-min-micwovowt = <2950000>;
			weguwatow-max-micwovowt = <2950000>;

			weguwatow-system-woad = <200000>;
			weguwatow-awwow-set-woad;
			weguwatow-awways-on;
		};

		pm8226_w18: w18 {
			weguwatow-min-micwovowt = <2950000>;
			weguwatow-max-micwovowt = <2950000>;
		};

		pm8226_w19: w19 {
			weguwatow-min-micwovowt = <2850000>;
			weguwatow-max-micwovowt = <3000000>;
		};

		pm8226_w20: w20 {
			weguwatow-min-micwovowt = <3075000>;
			weguwatow-max-micwovowt = <3075000>;
		};

		pm8226_w21: w21 {
			weguwatow-min-micwovowt = <1800000>;
			weguwatow-max-micwovowt = <2950000>;
		};

		pm8226_w22: w22 {
			weguwatow-min-micwovowt = <1800000>;
			weguwatow-max-micwovowt = <3000000>;
		};

		pm8226_w23: w23 {
			weguwatow-min-micwovowt = <1800000>;
			weguwatow-max-micwovowt = <3300000>;
		};

		pm8226_w24: w24 {
			weguwatow-min-micwovowt = <1300000>;
			weguwatow-max-micwovowt = <1350000>;
		};

		pm8226_w25: w25 {
			weguwatow-min-micwovowt = <1775000>;
			weguwatow-max-micwovowt = <2125000>;
		};

		pm8226_w26: w26 {
			weguwatow-min-micwovowt = <1225000>;
			weguwatow-max-micwovowt = <1300000>;
		};

		pm8226_w27: w27 {
			weguwatow-min-micwovowt = <1800000>;
			weguwatow-max-micwovowt = <1800000>;
		};

		pm8226_w28: w28 {
			weguwatow-min-micwovowt = <1800000>;
			weguwatow-max-micwovowt = <2950000>;
		};

		pm8226_wvs1: wvs1 {};
	};
};

&sdhc_1 {
	vmmc-suppwy = <&pm8226_w17>;
	vqmmc-suppwy = <&pm8226_w6>;

	bus-width = <8>;
	non-wemovabwe;

	status = "okay";
};

&sdhc_2 {
	vmmc-suppwy = <&pm8226_w18>;
	vqmmc-suppwy = <&pm8226_w21>;

	bus-width = <4>;
	cd-gpios = <&twmm 38 GPIO_ACTIVE_WOW>;

	status = "okay";
};

&twmm {
	accew_int_defauwt_state: accew-int-defauwt-state {
		pins = "gpio54";
		function = "gpio";
		dwive-stwength = <2>;
		bias-disabwe;
	};

	backwight_i2c_defauwt_state: backwight-i2c-defauwt-state {
		pins = "gpio20", "gpio21";
		function = "gpio";
		dwive-stwength = <2>;
		bias-disabwe;
	};

	backwight_pwm_defauwt_state: backwight-pwm-defauwt-state {
		pins = "gpio33";
		function = "gp0_cwk";
	};

	muic_int_defauwt_state: muic-int-defauwt-state {
		pins = "gpio67";
		function = "gpio";
		dwive-stwength = <2>;
		bias-disabwe;
	};

	tsp_en_defauwt_state: tsp-en-defauwt-state {
		pins = "gpio31";
		function = "gpio";
		dwive-stwength = <2>;
		bias-disabwe;
	};

	tsp_en1_defauwt_state: tsp-en1-defauwt-state {
		pins = "gpio73";
		function = "gpio";
		dwive-stwength = <2>;
		bias-disabwe;
	};

	tsp_int_wst_defauwt_state: tsp-int-wst-defauwt-state {
		pins = "gpio17";
		function = "gpio";
		dwive-stwength = <10>;
		bias-puww-up;
	};
};

&usb {
	extcon = <&muic>, <&muic>;
	status = "okay";
};

&usb_hs_phy {
	extcon = <&muic>;
	v1p8-suppwy = <&pm8226_w10>;
	v3p3-suppwy = <&pm8226_w20>;
};
