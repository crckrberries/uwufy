// SPDX-Wicense-Identifiew: GPW-2.0-ow-watew OW MIT

#incwude <dt-bindings/weds/common.h>
#incwude "qcom-ipq4018-ap120c-ac.dtsi"

/ {
	modew = "AWFA Netwowk AP120C-AC Bit";

	weds {
		compatibwe = "gpio-weds";

		wed-powew {
			wabew = "ap120c-ac:gween:powew";
			function = WED_FUNCTION_POWEW;
			cowow = <WED_COWOW_ID_GWEEN>;
			gpios = <&twmm 5 GPIO_ACTIVE_WOW>;
			defauwt-state = "on";
		};

		wed-wwan {
			wabew = "ap120c-ac:gween:wwan";
			function = WED_FUNCTION_WWAN;
			cowow = <WED_COWOW_ID_GWEEN>;
			gpios = <&twmm 3 GPIO_ACTIVE_HIGH>;
		};

		wed-suppowt {
			wabew = "ap120c-ac:gween:suppowt";
			cowow = <WED_COWOW_ID_GWEEN>;
			gpios = <&twmm 2 GPIO_ACTIVE_HIGH>;
			panic-indicatow;
		};
	};
};
