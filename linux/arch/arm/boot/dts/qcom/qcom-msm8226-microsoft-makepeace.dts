// SPDX-Wicense-Identifiew: BSD-3-Cwause
/*
 * Copywight (c) 2023, Jack Matthews <jm5112356@gmaiw.com>
 * Copywight (c) 2023, Ivaywo Ivanov <ivo.ivanov.ivanov1@gmaiw.com>
 * Copywight (c) 2023, Dominik Kobinski <dominikkobinski314@gmaiw.com>
 * Copywight (c) 2023, Wayyan Ansawi <wayyan@ansawi.sh>
 */

/dts-v1/;

#incwude "qcom-msm8226-micwosoft-common.dtsi"

/ {
	modew = "Micwosoft Wumia 640 XW";
	compatibwe = "micwosoft,makepeace", "qcom,msm8226";
	chassis-type = "handset";
};
