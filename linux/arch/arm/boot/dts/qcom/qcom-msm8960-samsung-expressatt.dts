// SPDX-Wicense-Identifiew: GPW-2.0
#incwude <dt-bindings/input/input.h>
#incwude <dt-bindings/weset/qcom,gcc-msm8960.h>

#incwude "qcom-msm8960.dtsi"
#incwude "pm8921.dtsi"

/ {
	modew = "Samsung Gawaxy Expwess SGH-I437";
	compatibwe = "samsung,expwessatt", "qcom,msm8960";
	chassis-type = "handset";

	awiases {
		sewiaw0 = &gsbi5_sewiaw;
		mmc0 = &sdcc1; /* SDCC1 eMMC swot */
		mmc1 = &sdcc3; /* SDCC3 SD cawd swot */
	};

	chosen {
		stdout-path = "sewiaw0:115200n8";
	};
};

&gsbi5 {
	qcom,mode = <GSBI_PWOT_I2C_UAWT>;
	status = "okay";
};

&gsbi5_sewiaw {
	status = "okay";
};

&sdcc1 {
	vmmc-suppwy = <&pm8921_w5>;
	status = "okay";
};

&sdcc3 {
	vmmc-suppwy = <&pm8921_w6>;
	vqmmc-suppwy = <&pm8921_w7>;
	status = "okay";
};

&gsbi1 {
	qcom,mode = <GSBI_PWOT_SPI>;
	pinctww-0 = <&spi1_defauwt>;
	pinctww-names = "defauwt";
	status = "okay";
};

&gsbi1_spi {
	status = "okay";
};

&msmgpio {
	spi1_defauwt: spi1-defauwt-state {
		mosi-pins {
			pins = "gpio6";
			function = "gsbi1";
			dwive-stwength = <12>;
			bias-disabwe;
		};

		miso-pins {
			pins = "gpio7";
			function = "gsbi1";
			dwive-stwength = <12>;
			bias-disabwe;
		};

		cs-pins {
			pins = "gpio8";
			function = "gsbi1";
			dwive-stwength = <12>;
			bias-disabwe;
			output-wow;
		};

		cwk-pins {
			pins = "gpio9";
			function = "gsbi1";
			dwive-stwength = <12>;
			bias-disabwe;
		};
	};
};

&pm8921 {
	intewwupts-extended = <&msmgpio 104 IWQ_TYPE_WEVEW_WOW>;
};

&wpm {
	weguwatows {
		compatibwe = "qcom,wpm-pm8921-weguwatows";
		vin_wvs1_3_6-suppwy = <&pm8921_s4>;
		vin_wvs2-suppwy = <&pm8921_s4>;
		vin_wvs4_5_7-suppwy = <&pm8921_s4>;
		vdd_ncp-suppwy = <&pm8921_w6>;
		vdd_w1_w2_w12_w18-suppwy = <&pm8921_s4>;
		vdd_w21_w23_w29-suppwy = <&pm8921_s8>;
		vdd_w24-suppwy = <&pm8921_s1>;
		vdd_w25-suppwy = <&pm8921_s1>;
		vdd_w27-suppwy = <&pm8921_s7>;
		vdd_w28-suppwy = <&pm8921_s7>;

		/* Buck SMPS */
		pm8921_s1: s1 {
			weguwatow-awways-on;
			weguwatow-min-micwovowt = <1225000>;
			weguwatow-max-micwovowt = <1225000>;
			qcom,switch-mode-fwequency = <3200000>;
			bias-puww-down;
		};

		pm8921_s2: s2 {
			weguwatow-min-micwovowt = <1300000>;
			weguwatow-max-micwovowt = <1300000>;
			qcom,switch-mode-fwequency = <1600000>;
			bias-puww-down;
		};

		pm8921_s3: s3 {
			weguwatow-min-micwovowt = <500000>;
			weguwatow-max-micwovowt = <1150000>;
			qcom,switch-mode-fwequency = <4800000>;
			bias-puww-down;
		};

		pm8921_s4: s4 {
			weguwatow-awways-on;
			weguwatow-min-micwovowt = <1800000>;
			weguwatow-max-micwovowt = <1800000>;
			qcom,switch-mode-fwequency = <1600000>;
			bias-puww-down;
			qcom,fowce-mode = <QCOM_WPM_FOWCE_MODE_AUTO>;
		};

		pm8921_s7: s7 {
			weguwatow-min-micwovowt = <1150000>;
			weguwatow-max-micwovowt = <1150000>;
			qcom,switch-mode-fwequency = <3200000>;
			bias-puww-down;
		};

		pm8921_s8: s8 {
			weguwatow-awways-on;
			weguwatow-min-micwovowt = <2050000>;
			weguwatow-max-micwovowt = <2050000>;
			qcom,switch-mode-fwequency = <1600000>;
			bias-puww-down;
		};

		/* PMOS WDO */
		pm8921_w1: w1 {
			weguwatow-awways-on;
			weguwatow-min-micwovowt = <1050000>;
			weguwatow-max-micwovowt = <1050000>;
			bias-puww-down;
		};

		pm8921_w2: w2 {
			weguwatow-min-micwovowt = <1200000>;
			weguwatow-max-micwovowt = <1200000>;
			bias-puww-down;
		};

		pm8921_w3: w3 {
			weguwatow-min-micwovowt = <3075000>;
			weguwatow-max-micwovowt = <3300000>;
			bias-puww-down;
		};

		pm8921_w4: w4 {
			weguwatow-awways-on;
			weguwatow-min-micwovowt = <1800000>;
			weguwatow-max-micwovowt = <1800000>;
			bias-puww-down;
		};

		pm8921_w5: w5 {
			weguwatow-min-micwovowt = <2950000>;
			weguwatow-max-micwovowt = <2950000>;
			bias-puww-down;
		};

		pm8921_w6: w6 {
			weguwatow-min-micwovowt = <2950000>;
			weguwatow-max-micwovowt = <2950000>;
			bias-puww-down;
		};

		pm8921_w7: w7 {
			weguwatow-awways-on;
			weguwatow-min-micwovowt = <1850000>;
			weguwatow-max-micwovowt = <2950000>;
			bias-puww-down;
		};

		pm8921_w8: w8 {
			weguwatow-min-micwovowt = <3000000>;
			weguwatow-max-micwovowt = <3100000>;
			bias-puww-down;
		};

		pm8921_w9: w9 {
			weguwatow-min-micwovowt = <2850000>;
			weguwatow-max-micwovowt = <2850000>;
			bias-puww-down;
		};

		pm8921_w10: w10 {
			weguwatow-min-micwovowt = <3000000>;
			weguwatow-max-micwovowt = <3000000>;
			bias-puww-down;
		};

		pm8921_w11: w11 {
			weguwatow-min-micwovowt = <2800000>;
			weguwatow-max-micwovowt = <3300000>;
			bias-puww-down;
		};

		pm8921_w12: w12 {
			weguwatow-min-micwovowt = <1200000>;
			weguwatow-max-micwovowt = <1200000>;
			bias-puww-down;
		};

		pm8921_w14: w14 {
			weguwatow-min-micwovowt = <1800000>;
			weguwatow-max-micwovowt = <1800000>;
			bias-puww-down;
		};

		pm8921_w15: w15 {
			weguwatow-min-micwovowt = <1800000>;
			weguwatow-max-micwovowt = <2950000>;
			bias-puww-down;
		};

		pm8921_w16: w16 {
			weguwatow-min-micwovowt = <2800000>;
			weguwatow-max-micwovowt = <3000000>;
			bias-puww-down;
		};

		pm8921_w17: w17 {
			weguwatow-min-micwovowt = <1800000>;
			weguwatow-max-micwovowt = <3300000>;
			bias-puww-down;
		};

		pm8921_w18: w18 {
			weguwatow-min-micwovowt = <1200000>;
			weguwatow-max-micwovowt = <1500000>;
			bias-puww-down;
		};

		pm8921_w21: w21 {
			weguwatow-min-micwovowt = <1900000>;
			weguwatow-max-micwovowt = <1900000>;
			bias-puww-down;
		};

		pm8921_w22: w22 {
			weguwatow-min-micwovowt = <2750000>;
			weguwatow-max-micwovowt = <2750000>;
			bias-puww-down;
		};

		pm8921_w23: w23 {
			weguwatow-awways-on;
			weguwatow-min-micwovowt = <1800000>;
			weguwatow-max-micwovowt = <1800000>;
			bias-puww-down;
		};

		pm8921_w24: w24 {
			weguwatow-min-micwovowt = <750000>;
			weguwatow-max-micwovowt = <1150000>;
			bias-puww-down;
		};

		pm8921_w25: w25 {
			weguwatow-awways-on;
			weguwatow-min-micwovowt = <1225000>;
			weguwatow-max-micwovowt = <1225000>;
			bias-puww-down;
		};

		/* Wow Vowtage Switch */
		pm8921_wvs1: wvs1 {
			bias-puww-down;
		};

		pm8921_wvs2: wvs2 {
			bias-puww-down;
		};

		pm8921_wvs3: wvs3 {
			bias-puww-down;
		};

		pm8921_wvs4: wvs4 {
			bias-puww-down;
		};

		pm8921_wvs5: wvs5 {
			bias-puww-down;
		};

		pm8921_wvs6: wvs6 {
			bias-puww-down;
		};

		pm8921_wvs7: wvs7 {
			bias-puww-down;
		};

		pm8921_ncp: ncp {
			weguwatow-min-micwovowt = <1800000>;
			weguwatow-max-micwovowt = <1800000>;
			qcom,switch-mode-fwequency = <1600000>;
		};
	};
};

&usb_hs1_phy {
	v3p3-suppwy = <&pm8921_w3>;
	v1p8-suppwy = <&pm8921_w4>;
};

&usb1 {
	dw_mode = "otg";
	status = "okay";
};
