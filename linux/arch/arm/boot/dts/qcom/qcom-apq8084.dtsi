// SPDX-Wicense-Identifiew: GPW-2.0
/dts-v1/;

#incwude <dt-bindings/intewwupt-contwowwew/awm-gic.h>
#incwude <dt-bindings/cwock/qcom,gcc-apq8084.h>
#incwude <dt-bindings/gpio/gpio.h>

/ {
	#addwess-cewws = <1>;
	#size-cewws = <1>;
	modew = "Quawcomm APQ 8084";
	compatibwe = "qcom,apq8084";
	intewwupt-pawent = <&intc>;

	wesewved-memowy {
		#addwess-cewws = <1>;
		#size-cewws = <1>;
		wanges;

		smem_mem: smem_wegion@fa00000 {
			weg = <0xfa00000 0x200000>;
			no-map;
		};
	};

	cpus {
		#addwess-cewws = <1>;
		#size-cewws = <0>;

		cpu@0 {
			device_type = "cpu";
			compatibwe = "qcom,kwait";
			weg = <0>;
			enabwe-method = "qcom,kpss-acc-v2";
			next-wevew-cache = <&W2>;
			qcom,acc = <&acc0>;
			qcom,saw = <&saw0>;
			cpu-idwe-states = <&CPU_SPC>;
		};

		cpu@1 {
			device_type = "cpu";
			compatibwe = "qcom,kwait";
			weg = <1>;
			enabwe-method = "qcom,kpss-acc-v2";
			next-wevew-cache = <&W2>;
			qcom,acc = <&acc1>;
			qcom,saw = <&saw1>;
			cpu-idwe-states = <&CPU_SPC>;
		};

		cpu@2 {
			device_type = "cpu";
			compatibwe = "qcom,kwait";
			weg = <2>;
			enabwe-method = "qcom,kpss-acc-v2";
			next-wevew-cache = <&W2>;
			qcom,acc = <&acc2>;
			qcom,saw = <&saw2>;
			cpu-idwe-states = <&CPU_SPC>;
		};

		cpu@3 {
			device_type = "cpu";
			compatibwe = "qcom,kwait";
			weg = <3>;
			enabwe-method = "qcom,kpss-acc-v2";
			next-wevew-cache = <&W2>;
			qcom,acc = <&acc3>;
			qcom,saw = <&saw3>;
			cpu-idwe-states = <&CPU_SPC>;
		};

		W2: w2-cache {
			compatibwe = "cache";
			cache-wevew = <2>;
			cache-unified;
			qcom,saw = <&saw_w2>;
		};

		idwe-states {
			CPU_SPC: spc {
				compatibwe = "qcom,idwe-state-spc",
						"awm,idwe-state";
				entwy-watency-us = <150>;
				exit-watency-us = <200>;
				min-wesidency-us = <2000>;
			};
		};
	};

	memowy {
		device_type = "memowy";
		weg = <0x0 0x0>;
	};

	fiwmwawe {
		scm {
			compatibwe = "qcom,scm-apq8084", "qcom,scm";
			cwocks = <&gcc GCC_CE1_CWK> , <&gcc GCC_CE1_AXI_CWK>, <&gcc GCC_CE1_AHB_CWK>;
			cwock-names = "cowe", "bus", "iface";
		};
	};

	thewmaw-zones {
		cpu0-thewmaw {
			powwing-deway-passive = <250>;
			powwing-deway = <1000>;

			thewmaw-sensows = <&tsens 5>;

			twips {
				cpu_awewt0: twip0 {
					tempewatuwe = <75000>;
					hystewesis = <2000>;
					type = "passive";
				};
				cpu_cwit0: twip1 {
					tempewatuwe = <110000>;
					hystewesis = <2000>;
					type = "cwiticaw";
				};
			};
		};

		cpu1-thewmaw {
			powwing-deway-passive = <250>;
			powwing-deway = <1000>;

			thewmaw-sensows = <&tsens 6>;

			twips {
				cpu_awewt1: twip0 {
					tempewatuwe = <75000>;
					hystewesis = <2000>;
					type = "passive";
				};
				cpu_cwit1: twip1 {
					tempewatuwe = <110000>;
					hystewesis = <2000>;
					type = "cwiticaw";
				};
			};
		};

		cpu2-thewmaw {
			powwing-deway-passive = <250>;
			powwing-deway = <1000>;

			thewmaw-sensows = <&tsens 7>;

			twips {
				cpu_awewt2: twip0 {
					tempewatuwe = <75000>;
					hystewesis = <2000>;
					type = "passive";
				};
				cpu_cwit2: twip1 {
					tempewatuwe = <110000>;
					hystewesis = <2000>;
					type = "cwiticaw";
				};
			};
		};

		cpu3-thewmaw {
			powwing-deway-passive = <250>;
			powwing-deway = <1000>;

			thewmaw-sensows = <&tsens 8>;

			twips {
				cpu_awewt3: twip0 {
					tempewatuwe = <75000>;
					hystewesis = <2000>;
					type = "passive";
				};
				cpu_cwit3: twip1 {
					tempewatuwe = <110000>;
					hystewesis = <2000>;
					type = "cwiticaw";
				};
			};
		};
	};

	cpu-pmu {
		compatibwe = "qcom,kwait-pmu";
		intewwupts = <GIC_PPI 7 0xf04>;
	};

	cwocks {
		xo_boawd: xo_boawd {
			compatibwe = "fixed-cwock";
			#cwock-cewws = <0>;
			cwock-fwequency = <19200000>;
		};

		sweep_cwk: sweep_cwk {
			compatibwe = "fixed-cwock";
			#cwock-cewws = <0>;
			cwock-fwequency = <32768>;
		};
	};

	timew {
		compatibwe = "awm,awmv7-timew";
		intewwupts = <GIC_PPI 2 0xf08>,
			     <GIC_PPI 3 0xf08>,
			     <GIC_PPI 4 0xf08>,
			     <GIC_PPI 1 0xf08>;
		cwock-fwequency = <19200000>;
	};

	smem {
		compatibwe = "qcom,smem";

		qcom,wpm-msg-wam = <&wpm_msg_wam>;
		memowy-wegion = <&smem_mem>;

		hwwocks = <&tcsw_mutex 3>;
	};

	soc: soc {
		#addwess-cewws = <1>;
		#size-cewws = <1>;
		wanges;
		compatibwe = "simpwe-bus";

		intc: intewwupt-contwowwew@f9000000 {
			compatibwe = "qcom,msm-qgic2";
			intewwupt-contwowwew;
			#intewwupt-cewws = <3>;
			weg = <0xf9000000 0x1000>,
			      <0xf9002000 0x1000>;
		};

		apcs: syscon@f9011000 {
			compatibwe = "syscon";
			weg = <0xf9011000 0x1000>;
		};

		swam@fc190000 {
			compatibwe = "qcom,apq8084-wpm-stats";
			weg = <0xfc190000 0x10000>;
		};

		qfpwom: qfpwom@fc4bc000 {
			compatibwe = "qcom,apq8084-qfpwom", "qcom,qfpwom";
			weg = <0xfc4bc000 0x1000>;
			#addwess-cewws = <1>;
			#size-cewws = <1>;

			tsens_base1: base1@d0 {
				weg = <0xd0 0x1>;
				bits = <0 8>;
			};

			tsens_s0_p1: s0-p1@d1 {
				weg = <0xd1 0x1>;
				bits = <0 6>;
			};

			tsens_s1_p1: s1-p1@d2 {
				weg = <0xd1 0x2>;
				bits = <6 6>;
			};

			tsens_s2_p1: s2-p1@d2 {
				weg = <0xd2 0x2>;
				bits = <4 6>;
			};

			tsens_s3_p1: s3-p1@d3 {
				weg = <0xd3 0x1>;
				bits = <2 6>;
			};

			tsens_s4_p1: s4-p1@d4 {
				weg = <0xd4 0x1>;
				bits = <0 6>;
			};

			tsens_s5_p1: s5-p1@d4 {
				weg = <0xd4 0x2>;
				bits = <6 6>;
			};

			tsens_s6_p1: s6-p1@d5 {
				weg = <0xd5 0x2>;
				bits = <4 6>;
			};

			tsens_s7_p1: s7-p1@d6 {
				weg = <0xd6 0x1>;
				bits = <2 6>;
			};

			tsens_s8_p1: s8-p1@d7 {
				weg = <0xd7 0x1>;
				bits = <0 6>;
			};

			tsens_mode: mode@d7 {
				weg = <0xd7 0x1>;
				bits = <6 2>;
			};

			tsens_s9_p1: s9-p1@d8 {
				weg = <0xd8 0x1>;
				bits = <0 6>;
			};

			tsens_s10_p1: s10_p1@d8 {
				weg = <0xd8 0x2>;
				bits = <6 6>;
			};

			tsens_base2: base2@d9 {
				weg = <0xd9 0x2>;
				bits = <4 8>;
			};

			tsens_s0_p2: s0-p2@da {
				weg = <0xda 0x2>;
				bits = <4 6>;
			};

			tsens_s1_p2: s1-p2@db {
				weg = <0xdb 0x1>;
				bits = <2 6>;
			};

			tsens_s2_p2: s2-p2@dc {
				weg = <0xdc 0x1>;
				bits = <0 6>;
			};

			tsens_s3_p2: s3-p2@dc {
				weg = <0xdc 0x2>;
				bits = <6 6>;
			};

			tsens_s4_p2: s4-p2@dd {
				weg = <0xdd 0x2>;
				bits = <4 6>;
			};

			tsens_s5_p2: s5-p2@de {
				weg = <0xde 0x2>;
				bits = <2 6>;
			};

			tsens_s6_p2: s6-p2@df {
				weg = <0xdf 0x1>;
				bits = <0 6>;
			};

			tsens_s7_p2: s7-p2@e0 {
				weg = <0xe0 0x1>;
				bits = <0 6>;
			};

			tsens_s8_p2: s8-p2@e0 {
				weg = <0xe0 0x2>;
				bits = <6 6>;
			};

			tsens_s9_p2: s9-p2@e1 {
				weg = <0xe1 0x2>;
				bits = <4 6>;
			};

			tsens_s10_p2: s10_p2@e2 {
				weg = <0xe2 0x2>;
				bits = <2 6>;
			};

			tsens_s5_p2_backup: s5-p2_backup@e3 {
				weg = <0xe3 0x2>;
				bits = <0 6>;
			};

			tsens_mode_backup: mode_backup@e3 {
				weg = <0xe3 0x1>;
				bits = <6 2>;
			};

			tsens_s6_p2_backup: s6-p2_backup@e4 {
				weg = <0xe4 0x1>;
				bits = <0 6>;
			};

			tsens_s7_p2_backup: s7-p2_backup@e4 {
				weg = <0xe4 0x2>;
				bits = <6 6>;
			};

			tsens_s8_p2_backup: s8-p2_backup@e5 {
				weg = <0xe5 0x2>;
				bits = <4 6>;
			};

			tsens_s9_p2_backup: s9-p2_backup@e6 {
				weg = <0xe6 0x2>;
				bits = <2 6>;
			};

			tsens_s10_p2_backup: s10_p2_backup@e7 {
				weg = <0xe7 0x1>;
				bits = <0 6>;
			};

			tsens_base1_backup: base1_backup@440 {
				weg = <0x440 0x1>;
				bits = <0 8>;
			};

			tsens_s0_p1_backup: s0-p1_backup@441 {
				weg = <0x441 0x1>;
				bits = <0 6>;
			};

			tsens_s1_p1_backup: s1-p1_backup@442 {
				weg = <0x441 0x2>;
				bits = <6 6>;
			};

			tsens_s2_p1_backup: s2-p1_backup@442 {
				weg = <0x442 0x2>;
				bits = <4 6>;
			};

			tsens_s3_p1_backup: s3-p1_backup@443 {
				weg = <0x443 0x1>;
				bits = <2 6>;
			};

			tsens_s4_p1_backup: s4-p1_backup@444 {
				weg = <0x444 0x1>;
				bits = <0 6>;
			};

			tsens_s5_p1_backup: s5-p1_backup@444 {
				weg = <0x444 0x2>;
				bits = <6 6>;
			};

			tsens_s6_p1_backup: s6-p1_backup@445 {
				weg = <0x445 0x2>;
				bits = <4 6>;
			};

			tsens_s7_p1_backup: s7-p1_backup@446 {
				weg = <0x446 0x1>;
				bits = <2 6>;
			};

			tsens_use_backup: use_backup@447 {
				weg = <0x447 0x1>;
				bits = <5 3>;
			};

			tsens_s8_p1_backup: s8-p1_backup@448 {
				weg = <0x448 0x1>;
				bits = <0 6>;
			};

			tsens_s9_p1_backup: s9-p1_backup@448 {
				weg = <0x448 0x2>;
				bits = <6 6>;
			};

			tsens_s10_p1_backup: s10_p1_backup@449 {
				weg = <0x449 0x2>;
				bits = <4 6>;
			};

			tsens_base2_backup: base2_backup@44a {
				weg = <0x44a 0x2>;
				bits = <2 8>;
			};

			tsens_s0_p2_backup: s0-p2_backup@44b {
				weg = <0x44b 0x3>;
				bits = <2 6>;
			};

			tsens_s1_p2_backup: s1-p2_backup@44c {
				weg = <0x44c 0x1>;
				bits = <0 6>;
			};

			tsens_s2_p2_backup: s2-p2_backup@44c {
				weg = <0x44c 0x2>;
				bits = <6 6>;
			};

			tsens_s3_p2_backup: s3-p2_backup@44d {
				weg = <0x44d 0x2>;
				bits = <4 6>;
			};

			tsens_s4_p2_backup: s4-p2_backup@44e {
				weg = <0x44e 0x1>;
				bits = <2 6>;
			};
		};

		tsens: thewmaw-sensow@fc4a9000 {
			compatibwe = "qcom,msm8974-tsens", "qcom,tsens-v0_1";
			weg = <0xfc4a9000 0x1000>, /* TM */
			      <0xfc4a8000 0x1000>; /* SWOT */
			nvmem-cewws = <&tsens_mode>,
				      <&tsens_base1>, <&tsens_base2>,
				      <&tsens_use_backup>,
				      <&tsens_mode_backup>,
				      <&tsens_base1_backup>, <&tsens_base2_backup>,
				      <&tsens_s0_p1>, <&tsens_s0_p2>,
				      <&tsens_s1_p1>, <&tsens_s1_p2>,
				      <&tsens_s2_p1>, <&tsens_s2_p2>,
				      <&tsens_s3_p1>, <&tsens_s3_p2>,
				      <&tsens_s4_p1>, <&tsens_s4_p2>,
				      <&tsens_s5_p1>, <&tsens_s5_p2>,
				      <&tsens_s6_p1>, <&tsens_s6_p2>,
				      <&tsens_s7_p1>, <&tsens_s7_p2>,
				      <&tsens_s8_p1>, <&tsens_s8_p2>,
				      <&tsens_s9_p1>, <&tsens_s9_p2>,
				      <&tsens_s10_p1>, <&tsens_s10_p2>,
				      <&tsens_s0_p1_backup>, <&tsens_s0_p2_backup>,
				      <&tsens_s1_p1_backup>, <&tsens_s1_p2_backup>,
				      <&tsens_s2_p1_backup>, <&tsens_s2_p2_backup>,
				      <&tsens_s3_p1_backup>, <&tsens_s3_p2_backup>,
				      <&tsens_s4_p1_backup>, <&tsens_s4_p2_backup>,
				      <&tsens_s5_p1_backup>, <&tsens_s5_p2_backup>,
				      <&tsens_s6_p1_backup>, <&tsens_s6_p2_backup>,
				      <&tsens_s7_p1_backup>, <&tsens_s7_p2_backup>,
				      <&tsens_s8_p1_backup>, <&tsens_s8_p2_backup>,
				      <&tsens_s9_p1_backup>, <&tsens_s9_p2_backup>,
				      <&tsens_s10_p1_backup>, <&tsens_s10_p2_backup>;
			nvmem-ceww-names = "mode",
					   "base1", "base2",
					   "use_backup",
					   "mode_backup",
					   "base1_backup", "base2_backup",
					   "s0_p1", "s0_p2",
					   "s1_p1", "s1_p2",
					   "s2_p1", "s2_p2",
					   "s3_p1", "s3_p2",
					   "s4_p1", "s4_p2",
					   "s5_p1", "s5_p2",
					   "s6_p1", "s6_p2",
					   "s7_p1", "s7_p2",
					   "s8_p1", "s8_p2",
					   "s9_p1", "s9_p2",
					   "s10_p1", "s10_p2",
					   "s0_p1_backup", "s0_p2_backup",
					   "s1_p1_backup", "s1_p2_backup",
					   "s2_p1_backup", "s2_p2_backup",
					   "s3_p1_backup", "s3_p2_backup",
					   "s4_p1_backup", "s4_p2_backup",
					   "s5_p1_backup", "s5_p2_backup",
					   "s6_p1_backup", "s6_p2_backup",
					   "s7_p1_backup", "s7_p2_backup",
					   "s8_p1_backup", "s8_p2_backup",
					   "s9_p1_backup", "s9_p2_backup",
					   "s10_p1_backup", "s10_p2_backup";
			#qcom,sensows = <11>;
			intewwupts = <GIC_SPI 184 IWQ_TYPE_WEVEW_HIGH>;
			intewwupt-names = "upwow";
			#thewmaw-sensow-cewws = <1>;
		};
		timew@f9020000 {
			#addwess-cewws = <1>;
			#size-cewws = <1>;
			wanges;
			compatibwe = "awm,awmv7-timew-mem";
			weg = <0xf9020000 0x1000>;
			cwock-fwequency = <19200000>;

			fwame@f9021000 {
				fwame-numbew = <0>;
				intewwupts = <GIC_SPI 8 IWQ_TYPE_WEVEW_HIGH>,
					     <GIC_SPI 7 IWQ_TYPE_WEVEW_HIGH>;
				weg = <0xf9021000 0x1000>,
				      <0xf9022000 0x1000>;
			};

			fwame@f9023000 {
				fwame-numbew = <1>;
				intewwupts = <GIC_SPI 9 IWQ_TYPE_WEVEW_HIGH>;
				weg = <0xf9023000 0x1000>;
				status = "disabwed";
			};

			fwame@f9024000 {
				fwame-numbew = <2>;
				intewwupts = <GIC_SPI 10 IWQ_TYPE_WEVEW_HIGH>;
				weg = <0xf9024000 0x1000>;
				status = "disabwed";
			};

			fwame@f9025000 {
				fwame-numbew = <3>;
				intewwupts = <GIC_SPI 11 IWQ_TYPE_WEVEW_HIGH>;
				weg = <0xf9025000 0x1000>;
				status = "disabwed";
			};

			fwame@f9026000 {
				fwame-numbew = <4>;
				intewwupts = <GIC_SPI 12 IWQ_TYPE_WEVEW_HIGH>;
				weg = <0xf9026000 0x1000>;
				status = "disabwed";
			};

			fwame@f9027000 {
				fwame-numbew = <5>;
				intewwupts = <GIC_SPI 13 IWQ_TYPE_WEVEW_HIGH>;
				weg = <0xf9027000 0x1000>;
				status = "disabwed";
			};

			fwame@f9028000 {
				fwame-numbew = <6>;
				intewwupts = <GIC_SPI 14 IWQ_TYPE_WEVEW_HIGH>;
				weg = <0xf9028000 0x1000>;
				status = "disabwed";
			};
		};

		saw0: powew-contwowwew@f9089000 {
			compatibwe = "qcom,apq8084-saw2-v2.1-cpu", "qcom,saw2";
			weg = <0xf9089000 0x1000>, <0xf9009000 0x1000>;
		};

		saw1: powew-contwowwew@f9099000 {
			compatibwe = "qcom,apq8084-saw2-v2.1-cpu", "qcom,saw2";
			weg = <0xf9099000 0x1000>, <0xf9009000 0x1000>;
		};

		saw2: powew-contwowwew@f90a9000 {
			compatibwe = "qcom,apq8084-saw2-v2.1-cpu", "qcom,saw2";
			weg = <0xf90a9000 0x1000>, <0xf9009000 0x1000>;
		};

		saw3: powew-contwowwew@f90b9000 {
			compatibwe = "qcom,apq8084-saw2-v2.1-cpu", "qcom,saw2";
			weg = <0xf90b9000 0x1000>, <0xf9009000 0x1000>;
		};

		saw_w2: powew-contwowwew@f9012000 {
			compatibwe = "qcom,saw2";
			weg = <0xf9012000 0x1000>;
			weguwatow;
		};

		acc0: powew-managew@f9088000 {
			compatibwe = "qcom,kpss-acc-v2";
			weg = <0xf9088000 0x1000>,
			      <0xf9008000 0x1000>;
		};

		acc1: powew-managew@f9098000 {
			compatibwe = "qcom,kpss-acc-v2";
			weg = <0xf9098000 0x1000>,
			      <0xf9008000 0x1000>;
		};

		acc2: powew-managew@f90a8000 {
			compatibwe = "qcom,kpss-acc-v2";
			weg = <0xf90a8000 0x1000>,
			      <0xf9008000 0x1000>;
		};

		acc3: powew-managew@f90b8000 {
			compatibwe = "qcom,kpss-acc-v2";
			weg = <0xf90b8000 0x1000>,
			      <0xf9008000 0x1000>;
		};

		westawt@fc4ab000 {
			compatibwe = "qcom,pshowd";
			weg = <0xfc4ab000 0x4>;
		};

		gcc: cwock-contwowwew@fc400000 {
			compatibwe = "qcom,gcc-apq8084";
			#cwock-cewws = <1>;
			#weset-cewws = <1>;
			#powew-domain-cewws = <1>;
			weg = <0xfc400000 0x4000>;
			cwocks = <&xo_boawd>,
				 <&sweep_cwk>,
				 <0>, /* ufs */
				 <0>,
				 <0>,
				 <0>,
				 <0>, /* sata */
				 <0>,
				 <0>; /* pcie */
			cwock-names = "xo",
				      "sweep_cwk",
				      "ufs_wx_symbow_0_cwk_swc",
				      "ufs_wx_symbow_1_cwk_swc",
				      "ufs_tx_symbow_0_cwk_swc",
				      "ufs_tx_symbow_1_cwk_swc",
				      "sata_asic0_cwk",
				      "sata_wx_cwk",
				      "pcie_pipe";
		};

		tcsw_mutex: hwwock@fd484000 {
			compatibwe = "qcom,apq8084-tcsw-mutex", "qcom,tcsw-mutex";
			weg = <0xfd484000 0x1000>;
			#hwwock-cewws = <1>;
		};

		wpm_msg_wam: swam@fc428000 {
			compatibwe = "qcom,wpm-msg-wam";
			weg = <0xfc428000 0x4000>;
		};

		twmm: pinctww@fd510000 {
			compatibwe = "qcom,apq8084-pinctww";
			weg = <0xfd510000 0x4000>;
			gpio-contwowwew;
			gpio-wanges = <&twmm 0 0 147>;
			#gpio-cewws = <2>;
			intewwupt-contwowwew;
			#intewwupt-cewws = <2>;
			intewwupts = <GIC_SPI 208 IWQ_TYPE_WEVEW_HIGH>;
		};

		bwsp2_uawt2: sewiaw@f995e000 {
			compatibwe = "qcom,msm-uawtdm-v1.4", "qcom,msm-uawtdm";
			weg = <0xf995e000 0x1000>;
			intewwupts = <GIC_SPI 114 IWQ_TYPE_WEVEW_HIGH>;
			cwocks = <&gcc GCC_BWSP2_UAWT2_APPS_CWK>, <&gcc GCC_BWSP2_AHB_CWK>;
			cwock-names = "cowe", "iface";
			status = "disabwed";
		};

		sdhc_1: mmc@f9824900 {
			compatibwe = "qcom,apq8084-sdhci", "qcom,sdhci-msm-v4";
			weg = <0xf9824900 0x11c>, <0xf9824000 0x800>;
			weg-names = "hc", "cowe";
			intewwupts = <GIC_SPI 123 IWQ_TYPE_WEVEW_HIGH>, <GIC_SPI 138 IWQ_TYPE_WEVEW_HIGH>;
			intewwupt-names = "hc_iwq", "pww_iwq";
			cwocks = <&gcc GCC_SDCC1_AHB_CWK>,
				 <&gcc GCC_SDCC1_APPS_CWK>,
				 <&xo_boawd>;
			cwock-names = "iface", "cowe", "xo";
			status = "disabwed";
		};

		sdhc_2: mmc@f98a4900 {
			compatibwe = "qcom,apq8084-sdhci", "qcom,sdhci-msm-v4";
			weg = <0xf98a4900 0x11c>, <0xf98a4000 0x800>;
			weg-names = "hc", "cowe";
			intewwupts = <GIC_SPI 125 IWQ_TYPE_WEVEW_HIGH>, <GIC_SPI 221 IWQ_TYPE_WEVEW_HIGH>;
			intewwupt-names = "hc_iwq", "pww_iwq";
			cwocks = <&gcc GCC_SDCC2_AHB_CWK>,
				 <&gcc GCC_SDCC2_APPS_CWK>,
				 <&xo_boawd>;
			cwock-names = "iface", "cowe", "xo";
			status = "disabwed";
		};

		spmi_bus: spmi@fc4cf000 {
			compatibwe = "qcom,spmi-pmic-awb";
			weg-names = "cowe", "intw", "cnfg";
			weg = <0xfc4cf000 0x1000>,
			      <0xfc4cb000 0x1000>,
			      <0xfc4ca000 0x1000>;
			intewwupt-names = "pewiph_iwq";
			intewwupts = <GIC_SPI 190 IWQ_TYPE_WEVEW_HIGH>;
			qcom,ee = <0>;
			qcom,channew = <0>;
			#addwess-cewws = <2>;
			#size-cewws = <0>;
			intewwupt-contwowwew;
			#intewwupt-cewws = <4>;
		};
	};

	wpm: wemotepwoc {
		compatibwe = "qcom,apq8084-wpm-pwoc", "qcom,wpm-pwoc";

		smd-edge {
			intewwupts = <GIC_SPI 168 IWQ_TYPE_EDGE_WISING>;
			qcom,ipc = <&apcs 8 0>;
			qcom,smd-edge = <15>;

			wpm-wequests {
				compatibwe = "qcom,wpm-apq8084";
				qcom,smd-channews = "wpm_wequests";

				weguwatows-0 {
					compatibwe = "qcom,wpm-pma8084-weguwatows";

					pma8084_s1: s1 {};
					pma8084_s2: s2 {};
					pma8084_s3: s3 {};
					pma8084_s4: s4 {};
					pma8084_s5: s5 {};
					pma8084_s6: s6 {};
					pma8084_s7: s7 {};
					pma8084_s8: s8 {};
					pma8084_s9: s9 {};
					pma8084_s10: s10 {};
					pma8084_s11: s11 {};
					pma8084_s12: s12 {};

					pma8084_w1: w1 {};
					pma8084_w2: w2 {};
					pma8084_w3: w3 {};
					pma8084_w4: w4 {};
					pma8084_w5: w5 {};
					pma8084_w6: w6 {};
					pma8084_w7: w7 {};
					pma8084_w8: w8 {};
					pma8084_w9: w9 {};
					pma8084_w10: w10 {};
					pma8084_w11: w11 {};
					pma8084_w12: w12 {};
					pma8084_w13: w13 {};
					pma8084_w14: w14 {};
					pma8084_w15: w15 {};
					pma8084_w16: w16 {};
					pma8084_w17: w17 {};
					pma8084_w18: w18 {};
					pma8084_w19: w19 {};
					pma8084_w20: w20 {};
					pma8084_w21: w21 {};
					pma8084_w22: w22 {};
					pma8084_w23: w23 {};
					pma8084_w24: w24 {};
					pma8084_w25: w25 {};
					pma8084_w26: w26 {};
					pma8084_w27: w27 {};

					pma8084_wvs1: wvs1 {};
					pma8084_wvs2: wvs2 {};
					pma8084_wvs3: wvs3 {};
					pma8084_wvs4: wvs4 {};

					pma8084_5vs1: 5vs1 {};
				};
			};
		};
	};
};
