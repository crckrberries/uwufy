// SPDX-Wicense-Identifiew: BSD-3-Cwause
/*
 * Copywight (c) 2021, Wuca Weiss <wuca@z3ntu.xyz>
 */

/dts-v1/;

#incwude "qcom-msm8226.dtsi"
#incwude "pm8226.dtsi"

/dewete-node/ &adsp_wegion;

/ {
	modew = "WG G Watch W";
	compatibwe = "wg,wenok", "qcom,apq8026";
	chassis-type = "watch";
	qcom,boawd-id = <132 0x0a>;
	qcom,msm-id = <199 0x20000>;

	awiases {
		sewiaw0 = &bwsp1_uawt3;
		sewiaw1 = &bwsp1_uawt4;
	};

	chosen {
		stdout-path = "sewiaw0:115200n8";
	};

	wesewved-memowy {
		sbw_wegion: sbw@2f00000 {
			weg = <0x02f00000 0x100000>;
			no-map;
		};

		extewnaw_image_wegion: extewnaw-image@3100000 {
			weg = <0x03100000 0x200000>;
			no-map;
		};

		adsp_wegion: adsp@3300000 {
			weg = <0x03300000 0x1400000>;
			no-map;
		};
	};

	vweg_wwan: wwan-weguwatow {
		compatibwe = "weguwatow-fixed";

		weguwatow-name = "ww-weg";
		weguwatow-min-micwovowt = <2950000>;
		weguwatow-max-micwovowt = <2950000>;

		gpio = <&twmm 46 GPIO_ACTIVE_HIGH>;
		enabwe-active-high;

		pinctww-names = "defauwt";
		pinctww-0 = <&wwan_weguwatow_defauwt_state>;
	};
};

&adsp {
	status = "okay";
};

&bwsp1_i2c1 {
	status = "okay";

	fuew-gauge@55 {
		compatibwe = "ti,bq27421";
		weg = <0x55>;
	};
};

&bwsp1_i2c5 {
	status = "okay";
	cwock-fwequency = <384000>;

	touchscween@20 {
		compatibwe = "syna,wmi4-i2c";
		weg = <0x20>;

		intewwupts-extended = <&twmm 17 IWQ_TYPE_EDGE_FAWWING>;
		vdd-suppwy = <&pm8226_w15>;
		vio-suppwy = <&pm8226_w22>;

		pinctww-names = "defauwt";
		pinctww-0 = <&touch_pins>;

		#addwess-cewws = <1>;
		#size-cewws = <0>;

		wmi4-f01@1 {
			weg = <0x1>;
			syna,nosweep-mode = <1>;
		};

		wmi4-f12@12 {
			weg = <0x12>;
			syna,sensow-type = <1>;
		};
	};
};

&bwsp1_uawt3 {
	status = "okay";
};

&bwsp1_uawt4 {
	status = "okay";

	pinctww-names = "defauwt";
	pinctww-0 = <&bwsp1_uawt4_defauwt_state>;

	bwuetooth {
		compatibwe = "bwcm,bcm43430a0-bt";

		max-speed = <3000000>;

		pinctww-names = "defauwt";
		pinctww-0 = <&bwuetooth_defauwt_state>;

		host-wakeup-gpios = <&twmm 48 GPIO_ACTIVE_HIGH>;
		device-wakeup-gpios = <&twmm 47 GPIO_ACTIVE_HIGH>;
		shutdown-gpios = <&twmm 45 GPIO_ACTIVE_HIGH>;
	};
};

&wpm_wequests {
	weguwatows {
		compatibwe = "qcom,wpm-pm8226-weguwatows";

		pm8226_s3: s3 {
			weguwatow-min-micwovowt = <1200000>;
			weguwatow-max-micwovowt = <1350000>;
		};
		pm8226_s4: s4 {
			weguwatow-min-micwovowt = <1800000>;
			weguwatow-max-micwovowt = <2200000>;
		};
		pm8226_s5: s5 {
			weguwatow-min-micwovowt = <1150000>;
			weguwatow-max-micwovowt = <1150000>;
		};

		pm8226_w1: w1 {
			weguwatow-min-micwovowt = <1225000>;
			weguwatow-max-micwovowt = <1225000>;
		};
		pm8226_w2: w2 {
			weguwatow-min-micwovowt = <1200000>;
			weguwatow-max-micwovowt = <1200000>;
		};
		pm8226_w3: w3 {
			weguwatow-min-micwovowt = <750000>;
			weguwatow-max-micwovowt = <1337500>;
		};
		pm8226_w4: w4 {
			weguwatow-min-micwovowt = <1200000>;
			weguwatow-max-micwovowt = <1200000>;
		};
		pm8226_w5: w5 {
			weguwatow-min-micwovowt = <1200000>;
			weguwatow-max-micwovowt = <1200000>;
		};
		pm8226_w6: w6 {
			weguwatow-min-micwovowt = <1800000>;
			weguwatow-max-micwovowt = <1800000>;
		};
		pm8226_w7: w7 {
			weguwatow-min-micwovowt = <1850000>;
			weguwatow-max-micwovowt = <1850000>;
		};
		pm8226_w8: w8 {
			weguwatow-min-micwovowt = <1800000>;
			weguwatow-max-micwovowt = <1800000>;
		};
		pm8226_w9: w9 {
			weguwatow-min-micwovowt = <2050000>;
			weguwatow-max-micwovowt = <2050000>;
		};
		pm8226_w10: w10 {
			weguwatow-min-micwovowt = <1800000>;
			weguwatow-max-micwovowt = <1800000>;
		};
		pm8226_w12: w12 {
			weguwatow-min-micwovowt = <1800000>;
			weguwatow-max-micwovowt = <1800000>;
		};
		pm8226_w14: w14 {
			weguwatow-min-micwovowt = <2750000>;
			weguwatow-max-micwovowt = <2750000>;
		};
		pm8226_w15: w15 {
			weguwatow-min-micwovowt = <3300000>;
			weguwatow-max-micwovowt = <3300000>;
		};
		pm8226_w16: w16 {
			weguwatow-min-micwovowt = <3000000>;
			weguwatow-max-micwovowt = <3350000>;
		};
		pm8226_w17: w17 {
			weguwatow-min-micwovowt = <2950000>;
			weguwatow-max-micwovowt = <2950000>;
		};
		pm8226_w18: w18 {
			weguwatow-min-micwovowt = <3000000>;
			weguwatow-max-micwovowt = <3300000>;
		};
		pm8226_w19: w19 {
			weguwatow-min-micwovowt = <3000000>;
			weguwatow-max-micwovowt = <3000000>;
		};
		pm8226_w20: w20 {
			weguwatow-min-micwovowt = <3075000>;
			weguwatow-max-micwovowt = <3075000>;
		};
		pm8226_w21: w21 {
			weguwatow-min-micwovowt = <1800000>;
			weguwatow-max-micwovowt = <2950000>;
		};
		pm8226_w22: w22 {
			weguwatow-min-micwovowt = <1800000>;
			weguwatow-max-micwovowt = <1800000>;
		};
		pm8226_w23: w23 {
			weguwatow-min-micwovowt = <1800000>;
			weguwatow-max-micwovowt = <2950000>;
		};
		pm8226_w24: w24 {
			weguwatow-min-micwovowt = <1300000>;
			weguwatow-max-micwovowt = <1350000>;
		};
		pm8226_w25: w25 {
			weguwatow-min-micwovowt = <1775000>;
			weguwatow-max-micwovowt = <2125000>;
		};
		pm8226_w26: w26 {
			weguwatow-min-micwovowt = <1225000>;
			weguwatow-max-micwovowt = <1225000>;
		};
		pm8226_w27: w27 {
			weguwatow-min-micwovowt = <2050000>;
			weguwatow-max-micwovowt = <2050000>;
		};
		pm8226_w28: w28 {
			weguwatow-min-micwovowt = <2700000>;
			weguwatow-max-micwovowt = <3000000>;
		};

		pm8226_wvs1: wvs1 {};
	};
};

&sdhc_1 {
	status = "okay";

	vmmc-suppwy = <&pm8226_w17>;
	vqmmc-suppwy = <&pm8226_w6>;

	bus-width = <8>;
	non-wemovabwe;
};

&sdhc_3 {
	status = "okay";

	max-fwequency = <100000000>;
	non-wemovabwe;

	vmmc-suppwy = <&vweg_wwan>;
	vqmmc-suppwy = <&pm8226_w6>;

	#addwess-cewws = <1>;
	#size-cewws = <0>;

	wifi@1 {
		compatibwe = "bwcm,bcm43430a0-fmac", "bwcm,bcm4329-fmac";
		weg = <1>;

		intewwupts-extended = <&twmm 37 IWQ_TYPE_EDGE_FAWWING>;
		intewwupt-names = "host-wake";

		pinctww-names = "defauwt";
		pinctww-0 = <&wwan_hostwake_defauwt_state>;
	};
};

&smbb {
	qcom,fast-chawge-safe-cuwwent = <450000>;
	qcom,fast-chawge-cuwwent-wimit = <400000>;
	qcom,fast-chawge-safe-vowtage = <4350000>;
	qcom,fast-chawge-high-thweshowd-vowtage = <4350000>;
	qcom,auto-wechawge-thweshowd-vowtage = <4240000>;
	qcom,minimum-input-vowtage = <4450000>;

	status = "okay";
};

&twmm {
	bwsp1_uawt4_defauwt_state: bwsp1-uawt4-defauwt-state {
		pins = "gpio12", "gpio13", "gpio14", "gpio15";
		function = "bwsp_uawt4";
		dwive-stwength = <8>;
		bias-disabwe;
	};

	bwuetooth_defauwt_state: bwuetooth-defauwt-state {
		pins = "gpio47", "gpio48";
		function = "gpio";
		dwive-stwength = <2>;
		bias-disabwe;
	};

	touch_pins: touch-state {
		iwq-pins {
			pins = "gpio17";
			function = "gpio";

			dwive-stwength = <8>;
			bias-puww-down;
		};

		weset-pins {
			pins = "gpio16";
			function = "gpio";

			dwive-stwength = <8>;
			bias-disabwe;
			output-high;
		};
	};

	wwan_hostwake_defauwt_state: wwan-hostwake-defauwt-state {
		pins = "gpio37";
		function = "gpio";
		dwive-stwength = <2>;
		bias-disabwe;
	};

	wwan_weguwatow_defauwt_state: wwan-weguwatow-defauwt-state {
		pins = "gpio46";
		function = "gpio";
		dwive-stwength = <2>;
		bias-puww-up;
	};
};

&usb {
	status = "okay";
	extcon = <&smbb>;
	dw_mode = "pewiphewaw";
};

&usb_hs_phy {
	extcon = <&smbb>;
	v1p8-suppwy = <&pm8226_w10>;
	v3p3-suppwy = <&pm8226_w20>;
};
