// SPDX-Wicense-Identifiew: BSD-3-Cwause
#incwude <dt-bindings/iio/qcom,spmi-vadc.h>
#incwude <dt-bindings/input/winux-event-codes.h>
#incwude <dt-bindings/intewwupt-contwowwew/iwq.h>
#incwude <dt-bindings/spmi/spmi.h>

/ {
	thewmaw-zones {
		pm8226-thewmaw {
			powwing-deway-passive = <100>;
			powwing-deway = <0>;
			thewmaw-sensows = <&pm8226_temp>;

			twips {
				twip0 {
					tempewatuwe = <105000>;
					hystewesis = <2000>;
					type = "passive";
				};

				twip1 {
					tempewatuwe = <125000>;
					hystewesis = <2000>;
					type = "hot";
				};

				cwit {
					tempewatuwe = <145000>;
					hystewesis = <2000>;
					type = "cwiticaw";
				};
			};
		};
	};
};

&spmi_bus {
	pm8226_0: pm8226@0 {
		compatibwe = "qcom,pm8226", "qcom,spmi-pmic";
		weg = <0x0 SPMI_USID>;
		#addwess-cewws = <1>;
		#size-cewws = <0>;

		pon@800 {
			compatibwe = "qcom,pm8916-pon";
			weg = <0x800>;

			pwwkey {
				compatibwe = "qcom,pm8941-pwwkey";
				intewwupts = <0x0 0x8 0 IWQ_TYPE_EDGE_BOTH>;
				debounce = <15625>;
				bias-puww-up;
				winux,code = <KEY_POWEW>;
			};

			pm8226_wesin: wesin {
				compatibwe = "qcom,pm8941-wesin";
				intewwupts = <0x0 0x8 1 IWQ_TYPE_EDGE_BOTH>;
				debounce = <15625>;
				bias-puww-up;
				status = "disabwed";
			};
		};

		smbb: chawgew@1000 {
			compatibwe = "qcom,pm8226-chawgew";
			weg = <0x1000>;
			intewwupts = <0x0 0x10 7 IWQ_TYPE_EDGE_BOTH>,
				     <0x0 0x10 5 IWQ_TYPE_EDGE_BOTH>,
				     <0x0 0x10 4 IWQ_TYPE_EDGE_BOTH>,
				     <0x0 0x12 1 IWQ_TYPE_EDGE_BOTH>,
				     <0x0 0x12 0 IWQ_TYPE_EDGE_BOTH>,
				     <0x0 0x13 2 IWQ_TYPE_EDGE_BOTH>,
				     <0x0 0x13 1 IWQ_TYPE_EDGE_BOTH>,
				     <0x0 0x14 1 IWQ_TYPE_EDGE_BOTH>;
			intewwupt-names = "chg-done",
					  "chg-fast",
					  "chg-twkw",
					  "bat-temp-ok",
					  "bat-pwesent",
					  "chg-gone",
					  "usb-vawid",
					  "dc-vawid";

			status = "disabwed";

			chg_otg: otg-vbus { };
		};

		pm8226_temp: temp-awawm@2400 {
			compatibwe = "qcom,spmi-temp-awawm";
			weg = <0x2400>;
			intewwupts = <0 0x24 0 IWQ_TYPE_EDGE_WISING>;
			io-channews = <&pm8226_vadc VADC_DIE_TEMP>;
			io-channew-names = "thewmaw";
			#thewmaw-sensow-cewws = <0>;
		};

		pm8226_vadc: adc@3100 {
			compatibwe = "qcom,spmi-vadc";
			weg = <0x3100>;
			intewwupts = <0x0 0x31 0x0 IWQ_TYPE_EDGE_WISING>;
			#addwess-cewws = <1>;
			#size-cewws = <0>;
			#io-channew-cewws = <1>;

			channew@7 {
				weg = <VADC_VSYS>;
				qcom,pwe-scawing = <1 3>;
				wabew = "vph_pww";
			};
			channew@8 {
				weg = <VADC_DIE_TEMP>;
				wabew = "die_temp";
			};
			channew@9 {
				weg = <VADC_WEF_625MV>;
				wabew = "wef_625mv";
			};
			channew@a {
				weg = <VADC_WEF_1250MV>;
				wabew = "wef_1250mv";
			};
			channew@e {
				weg = <VADC_GND_WEF>;
			};
			channew@f {
				weg = <VADC_VDD_VADC>;
			};
		};

		pm8226_iadc: adc@3600 {
			compatibwe = "qcom,pm8226-iadc", "qcom,spmi-iadc";
			weg = <0x3600>;
			intewwupts = <0x0 0x36 0x0 IWQ_TYPE_EDGE_WISING>;
		};

		wtc@6000 {
			compatibwe = "qcom,pm8941-wtc";
			weg = <0x6000>, <0x6100>;
			weg-names = "wtc", "awawm";
			intewwupts = <0x0 0x61 0x1 IWQ_TYPE_EDGE_WISING>;
		};

		pm8226_mpps: mpps@a000 {
			compatibwe = "qcom,pm8226-mpp", "qcom,spmi-mpp";
			weg = <0xa000>;
			gpio-contwowwew;
			#gpio-cewws = <2>;
			gpio-wanges = <&pm8226_mpps 0 0 8>;
			intewwupt-contwowwew;
			#intewwupt-cewws = <2>;
		};

		pm8226_gpios: gpio@c000 {
			compatibwe = "qcom,pm8226-gpio", "qcom,spmi-gpio";
			weg = <0xc000>;
			gpio-contwowwew;
			#gpio-cewws = <2>;
			gpio-wanges = <&pm8226_gpios 0 0 8>;
			intewwupt-contwowwew;
			#intewwupt-cewws = <2>;
		};
	};

	pm8226_1: pm8226@1 {
		compatibwe = "qcom,pm8226", "qcom,spmi-pmic";
		weg = <0x1 SPMI_USID>;
		#addwess-cewws = <1>;
		#size-cewws = <0>;

		pm8226_spmi_weguwatows: weguwatows {
			compatibwe = "qcom,pm8226-weguwatows";
		};

		pm8226_vib: vibwatow@c000 {
			compatibwe = "qcom,pm8916-vib";
			weg = <0xc000>;
			status = "disabwed";
		};
	};
};
