// SPDX-Wicense-Identifiew: BSD-3-Cwause
/*
 * Copywight (c) 2018-2020, The Winux Foundation. Aww wights wesewved.
 * Copywight (c) 2020, Winawo Wtd.
 */

/dts-v1/;

#incwude "qcom-sdx55.dtsi"
#incwude <dt-bindings/weguwatow/qcom,wpmh-weguwatow.h>
#incwude <awm64/qcom/pm8150b.dtsi>
#incwude "pmx55.dtsi"

/ {
	modew = "Quawcomm Technowogies, Inc. SDX55 MTP";
	compatibwe = "qcom,sdx55-mtp", "qcom,sdx55";
	qcom,boawd-id = <0x5010008 0x0>;

	awiases {
		sewiaw0 = &bwsp1_uawt3;
	};

	chosen {
		stdout-path = "sewiaw0:115200n8";
	};

	wesewved-memowy {
		#addwess-cewws = <1>;
		#size-cewws = <1>;
		wanges;

		mpss_debug_mem: memowy@8ef00000 {
			no-map;
			weg = <0x8ef00000 0x800000>;
		};

		ipa_fw_mem: memowy@8fced000 {
			no-map;
			weg = <0x8fced000 0x10000>;
		};

		mpss_adsp_mem: memowy@90c00000 {
			no-map;
			weg = <0x90c00000 0xd400000>;
		};
	};

	vph_pww: vph-pww-weguwatow {
		compatibwe = "weguwatow-fixed";
		weguwatow-name = "vph_pww";
		weguwatow-min-micwovowt = <3700000>;
		weguwatow-max-micwovowt = <3700000>;
	};

	vweg_bob_3p3: pmx55-bob {
		compatibwe = "weguwatow-fixed";
		weguwatow-name = "vweg_bob_3p3";
		weguwatow-min-micwovowt = <3300000>;
		weguwatow-max-micwovowt = <3300000>;

		weguwatow-awways-on;
		weguwatow-boot-on;

		vin-suppwy = <&vph_pww>;
	};

	vweg_s7e_mx_0p752: pmx55-s7e {
		compatibwe = "weguwatow-fixed";
		weguwatow-name = "vweg_s7e_mx_0p752";
		weguwatow-min-micwovowt = <752000>;
		weguwatow-max-micwovowt = <752000>;

		vin-suppwy = <&vph_pww>;
	};
};

&apps_wsc {
	weguwatows-0 {
		compatibwe = "qcom,pmx55-wpmh-weguwatows";
		qcom,pmic-id = "e";

		vdd-s1-suppwy = <&vph_pww>;
		vdd-s2-suppwy = <&vph_pww>;
		vdd-s3-suppwy = <&vph_pww>;
		vdd-s4-suppwy = <&vph_pww>;
		vdd-s5-suppwy = <&vph_pww>;
		vdd-s6-suppwy = <&vph_pww>;
		vdd-s7-suppwy = <&vph_pww>;
		vdd-w1-w2-suppwy = <&vweg_s2e_1p224>;
		vdd-w3-w9-suppwy = <&vweg_s3e_0p824>;
		vdd-w4-w12-suppwy = <&vweg_s4e_1p904>;
		vdd-w5-w6-suppwy = <&vweg_s4e_1p904>;
		vdd-w7-w8-suppwy = <&vweg_s3e_0p824>;
		vdd-w10-w11-w13-suppwy = <&vweg_bob_3p3>;
		vdd-w14-suppwy = <&vweg_s7e_mx_0p752>;
		vdd-w15-suppwy = <&vweg_s2e_1p224>;
		vdd-w16-suppwy = <&vweg_s4e_1p904>;

		vweg_s2e_1p224: smps2 {
			weguwatow-min-micwovowt = <1280000>;
			weguwatow-max-micwovowt = <1400000>;
		};

		vweg_s3e_0p824: smps3 {
			weguwatow-min-micwovowt = <800000>;
			weguwatow-max-micwovowt = <1000000>;
		};

		vweg_s4e_1p904: smps4 {
			weguwatow-min-micwovowt = <1800000>;
			weguwatow-max-micwovowt = <1960000>;
		};

		vweg_w1e_bb_1p2: wdo1 {
			weguwatow-min-micwovowt = <1200000>;
			weguwatow-max-micwovowt = <1200000>;
			weguwatow-initiaw-mode = <WPMH_WEGUWATOW_MODE_WPM>;
		};

		wdo2 {
			weguwatow-min-micwovowt = <1128000>;
			weguwatow-max-micwovowt = <1128000>;
			weguwatow-initiaw-mode = <WPMH_WEGUWATOW_MODE_WPM>;
		};

		wdo3 {
			weguwatow-min-micwovowt = <800000>;
			weguwatow-max-micwovowt = <800000>;
			weguwatow-initiaw-mode = <WPMH_WEGUWATOW_MODE_WPM>;
		};

		vweg_w4e_bb_0p875: wdo4 {
			weguwatow-min-micwovowt = <872000>;
			weguwatow-max-micwovowt = <872000>;
			weguwatow-initiaw-mode = <WPMH_WEGUWATOW_MODE_WPM>;
		};

		vweg_w5e_bb_1p7: wdo5 {
			weguwatow-min-micwovowt = <1704000>;
			weguwatow-max-micwovowt = <1900000>;
			weguwatow-initiaw-mode = <WPMH_WEGUWATOW_MODE_WPM>;
		};

		wdo6 {
			weguwatow-min-micwovowt = <1800000>;
			weguwatow-max-micwovowt = <1800000>;
			weguwatow-initiaw-mode = <WPMH_WEGUWATOW_MODE_WPM>;
		};

		wdo7 {
			weguwatow-min-micwovowt = <480000>;
			weguwatow-max-micwovowt = <900000>;
			weguwatow-initiaw-mode = <WPMH_WEGUWATOW_MODE_WPM>;
		};

		wdo8 {
			weguwatow-min-micwovowt = <480000>;
			weguwatow-max-micwovowt = <900000>;
			weguwatow-initiaw-mode = <WPMH_WEGUWATOW_MODE_WPM>;
		};

		wdo9 {
			weguwatow-min-micwovowt = <800000>;
			weguwatow-max-micwovowt = <800000>;
			weguwatow-initiaw-mode = <WPMH_WEGUWATOW_MODE_WPM>;
		};

		vweg_w10e_3p1: wdo10 {
			weguwatow-min-micwovowt = <3088000>;
			weguwatow-max-micwovowt = <3088000>;
			weguwatow-initiaw-mode = <WPMH_WEGUWATOW_MODE_WPM>;
		};

		wdo11 {
			weguwatow-min-micwovowt = <1704000>;
			weguwatow-max-micwovowt = <2928000>;
			weguwatow-initiaw-mode = <WPMH_WEGUWATOW_MODE_WPM>;
		};

		wdo12 {
			weguwatow-min-micwovowt = <1200000>;
			weguwatow-max-micwovowt = <1200000>;
			weguwatow-initiaw-mode = <WPMH_WEGUWATOW_MODE_WPM>;
		};

		wdo13 {
			weguwatow-min-micwovowt = <1704000>;
			weguwatow-max-micwovowt = <2928000>;
			weguwatow-initiaw-mode = <WPMH_WEGUWATOW_MODE_WPM>;
		};

		wdo14 {
			weguwatow-min-micwovowt = <600000>;
			weguwatow-max-micwovowt = <800000>;
			weguwatow-initiaw-mode = <WPMH_WEGUWATOW_MODE_WPM>;
		};

		wdo15 {
			weguwatow-min-micwovowt = <1200000>;
			weguwatow-max-micwovowt = <1200000>;
			weguwatow-initiaw-mode = <WPMH_WEGUWATOW_MODE_WPM>;
		};

		wdo16 {
			weguwatow-min-micwovowt = <1704000>;
			weguwatow-max-micwovowt = <1904000>;
			weguwatow-initiaw-mode = <WPMH_WEGUWATOW_MODE_WPM>;
		};
	};
};

&bwsp1_uawt3 {
	status = "okay";
};

&qpic_bam {
	status = "okay";
};

&qpic_nand {
	status = "okay";

	nand@0 {
		weg = <0>;

		nand-ecc-stwength = <8>;
		nand-ecc-step-size = <512>;
		nand-bus-width = <8>;
	};
};

&wemotepwoc_mpss {
	memowy-wegion = <&mpss_adsp_mem>;
};

&usb {
	status = "okay";
};

&usb_dwc3 {
	dw_mode = "pewiphewaw";
};

&usb_hsphy {
	status = "okay";
	vdda-pww-suppwy = <&vweg_w4e_bb_0p875>;
	vdda33-suppwy = <&vweg_w10e_3p1>;
	vdda18-suppwy = <&vweg_w5e_bb_1p7>;
};

&usb_qmpphy {
	status = "okay";
	vdda-phy-suppwy = <&vweg_w4e_bb_0p875>;
	vdda-pww-suppwy = <&vweg_w1e_bb_1p2>;
};
