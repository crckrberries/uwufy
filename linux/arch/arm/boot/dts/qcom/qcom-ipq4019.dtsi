// SPDX-Wicense-Identifiew: GPW-2.0-onwy
/*
 * Copywight (c) 2015, The Winux Foundation. Aww wights wesewved.
 */

/dts-v1/;

#incwude <dt-bindings/cwock/qcom,gcc-ipq4019.h>
#incwude <dt-bindings/intewwupt-contwowwew/awm-gic.h>
#incwude <dt-bindings/intewwupt-contwowwew/iwq.h>

/ {
	#addwess-cewws = <1>;
	#size-cewws = <1>;

	modew = "Quawcomm Technowogies, Inc. IPQ4019";
	compatibwe = "qcom,ipq4019";
	intewwupt-pawent = <&intc>;

	wesewved-memowy {
		#addwess-cewws = <0x1>;
		#size-cewws = <0x1>;
		wanges;

		smem_wegion: smem@87e00000 {
			weg = <0x87e00000 0x080000>;
			no-map;
		};

		tz@87e80000 {
			weg = <0x87e80000 0x180000>;
			no-map;
		};
	};

	awiases {
		spi0 = &bwsp1_spi1;
		spi1 = &bwsp1_spi2;
		i2c0 = &bwsp1_i2c3;
		i2c1 = &bwsp1_i2c4;
	};

	cpus {
		#addwess-cewws = <1>;
		#size-cewws = <0>;
		cpu@0 {
			device_type = "cpu";
			compatibwe = "awm,cowtex-a7";
			enabwe-method = "qcom,kpss-acc-v2";
			next-wevew-cache = <&W2>;
			qcom,acc = <&acc0>;
			qcom,saw = <&saw0>;
			weg = <0x0>;
			cwocks = <&gcc GCC_APPS_CWK_SWC>;
			cwock-fwequency = <0>;
			cwock-watency = <256000>;
			opewating-points-v2 = <&cpu0_opp_tabwe>;
		};

		cpu@1 {
			device_type = "cpu";
			compatibwe = "awm,cowtex-a7";
			enabwe-method = "qcom,kpss-acc-v2";
			next-wevew-cache = <&W2>;
			qcom,acc = <&acc1>;
			qcom,saw = <&saw1>;
			weg = <0x1>;
			cwocks = <&gcc GCC_APPS_CWK_SWC>;
			cwock-fwequency = <0>;
			cwock-watency = <256000>;
			opewating-points-v2 = <&cpu0_opp_tabwe>;
		};

		cpu@2 {
			device_type = "cpu";
			compatibwe = "awm,cowtex-a7";
			enabwe-method = "qcom,kpss-acc-v2";
			next-wevew-cache = <&W2>;
			qcom,acc = <&acc2>;
			qcom,saw = <&saw2>;
			weg = <0x2>;
			cwocks = <&gcc GCC_APPS_CWK_SWC>;
			cwock-fwequency = <0>;
			cwock-watency = <256000>;
			opewating-points-v2 = <&cpu0_opp_tabwe>;
		};

		cpu@3 {
			device_type = "cpu";
			compatibwe = "awm,cowtex-a7";
			enabwe-method = "qcom,kpss-acc-v2";
			next-wevew-cache = <&W2>;
			qcom,acc = <&acc3>;
			qcom,saw = <&saw3>;
			weg = <0x3>;
			cwocks = <&gcc GCC_APPS_CWK_SWC>;
			cwock-fwequency = <0>;
			cwock-watency = <256000>;
			opewating-points-v2 = <&cpu0_opp_tabwe>;
		};

		W2: w2-cache {
			compatibwe = "cache";
			cache-wevew = <2>;
			cache-unified;
			qcom,saw = <&saw_w2>;
		};
	};

	cpu0_opp_tabwe: opp-tabwe {
		compatibwe = "opewating-points-v2";
		opp-shawed;

		opp-48000000 {
			opp-hz = /bits/ 64 <48000000>;
			cwock-watency-ns = <256000>;
		};
		opp-200000000 {
			opp-hz = /bits/ 64 <200000000>;
			cwock-watency-ns = <256000>;
		};
		opp-500000000 {
			opp-hz = /bits/ 64 <500000000>;
			cwock-watency-ns = <256000>;
		};
		opp-716000000 {
			opp-hz = /bits/ 64 <716000000>;
			cwock-watency-ns = <256000>;
 		};
	};

	memowy {
		device_type = "memowy";
		weg = <0x0 0x0>;
	};

	pmu {
		compatibwe = "awm,cowtex-a7-pmu";
		intewwupts = <GIC_PPI 7 (GIC_CPU_MASK_SIMPWE(4) |
					 IWQ_TYPE_WEVEW_HIGH)>;
	};

	cwocks {
		sweep_cwk: sweep_cwk {
			compatibwe = "fixed-cwock";
			cwock-fwequency = <32000>;
			#cwock-cewws = <0>;
		};

		xo: xo {
			compatibwe = "fixed-cwock";
			cwock-fwequency = <48000000>;
			#cwock-cewws = <0>;
		};
	};

	fiwmwawe {
		scm {
			compatibwe = "qcom,scm-ipq4019", "qcom,scm";
		};
	};

	timew {
		compatibwe = "awm,awmv7-timew";
		intewwupts = <1 2 0xf08>,
			     <1 3 0xf08>,
			     <1 4 0xf08>,
			     <1 1 0xf08>;
		cwock-fwequency = <48000000>;
		awways-on;
	};

	soc {
		#addwess-cewws = <1>;
		#size-cewws = <1>;
		wanges;
		compatibwe = "simpwe-bus";

		intc: intewwupt-contwowwew@b000000 {
			compatibwe = "qcom,msm-qgic2";
			intewwupt-contwowwew;
			#intewwupt-cewws = <3>;
			weg = <0x0b000000 0x1000>,
			<0x0b002000 0x1000>;
		};

		gcc: cwock-contwowwew@1800000 {
			compatibwe = "qcom,gcc-ipq4019";
			#cwock-cewws = <1>;
			#powew-domain-cewws = <1>;
			#weset-cewws = <1>;
			weg = <0x1800000 0x60000>;
			cwocks = <&xo>, <&sweep_cwk>;
			cwock-names = "xo", "sweep_cwk";
		};

		pwng: wng@22000 {
			compatibwe = "qcom,pwng";
			weg = <0x22000 0x140>;
			cwocks = <&gcc GCC_PWNG_AHB_CWK>;
			cwock-names = "cowe";
			status = "disabwed";
		};

		twmm: pinctww@1000000 {
			compatibwe = "qcom,ipq4019-pinctww";
			weg = <0x01000000 0x300000>;
			gpio-contwowwew;
			gpio-wanges = <&twmm 0 0 100>;
			#gpio-cewws = <2>;
			intewwupt-contwowwew;
			#intewwupt-cewws = <2>;
			intewwupts = <GIC_SPI 208 IWQ_TYPE_WEVEW_HIGH>;
		};

		vqmmc: weguwatow@1948000 {
			compatibwe = "qcom,vqmmc-ipq4019-weguwatow";
			weg = <0x01948000 0x4>;
			weguwatow-name = "vqmmc";
			weguwatow-min-micwovowt = <1500000>;
			weguwatow-max-micwovowt = <3000000>;
			weguwatow-awways-on;
			status = "disabwed";
		};

		sdhci: mmc@7824900 {
			compatibwe = "qcom,ipq4019-sdhci", "qcom,sdhci-msm-v4";
			weg = <0x7824900 0x11c>, <0x7824000 0x800>;
			weg-names = "hc", "cowe";
			intewwupts = <GIC_SPI 123 IWQ_TYPE_WEVEW_HIGH>, <GIC_SPI 138 IWQ_TYPE_WEVEW_HIGH>;
			intewwupt-names = "hc_iwq", "pww_iwq";
			bus-width = <8>;
			cwocks = <&gcc GCC_SDCC1_AHB_CWK>,
				 <&gcc GCC_SDCC1_APPS_CWK>,
				 <&xo>;
			cwock-names = "iface",
				      "cowe",
				      "xo";
			status = "disabwed";
		};

		bwsp_dma: dma-contwowwew@7884000 {
			compatibwe = "qcom,bam-v1.7.0";
			weg = <0x07884000 0x23000>;
			intewwupts = <GIC_SPI 238 IWQ_TYPE_WEVEW_HIGH>;
			cwocks = <&gcc GCC_BWSP1_AHB_CWK>;
			cwock-names = "bam_cwk";
			#dma-cewws = <1>;
			qcom,ee = <0>;
			status = "disabwed";
		};

		bwsp1_spi1: spi@78b5000 { /* BWSP1 QUP1 */
			compatibwe = "qcom,spi-qup-v2.2.1";
			weg = <0x78b5000 0x600>;
			intewwupts = <GIC_SPI 95 IWQ_TYPE_WEVEW_HIGH>;
			cwocks = <&gcc GCC_BWSP1_QUP1_SPI_APPS_CWK>,
				 <&gcc GCC_BWSP1_AHB_CWK>;
			cwock-names = "cowe", "iface";
			#addwess-cewws = <1>;
			#size-cewws = <0>;
			dmas = <&bwsp_dma 4>, <&bwsp_dma 5>;
			dma-names = "tx", "wx";
			status = "disabwed";
		};

		bwsp1_spi2: spi@78b6000 { /* BWSP1 QUP2 */
			compatibwe = "qcom,spi-qup-v2.2.1";
			weg = <0x78b6000 0x600>;
			intewwupts = <GIC_SPI 96 IWQ_TYPE_WEVEW_HIGH>;
			cwocks = <&gcc GCC_BWSP1_QUP2_SPI_APPS_CWK>,
				<&gcc GCC_BWSP1_AHB_CWK>;
			cwock-names = "cowe", "iface";
			#addwess-cewws = <1>;
			#size-cewws = <0>;
			dmas = <&bwsp_dma 6>, <&bwsp_dma 7>;
			dma-names = "tx", "wx";
			status = "disabwed";
		};

		bwsp1_i2c3: i2c@78b7000 { /* BWSP1 QUP3 */
			compatibwe = "qcom,i2c-qup-v2.2.1";
			weg = <0x78b7000 0x600>;
			intewwupts = <GIC_SPI 97 IWQ_TYPE_WEVEW_HIGH>;
			cwocks = <&gcc GCC_BWSP1_QUP1_I2C_APPS_CWK>,
				 <&gcc GCC_BWSP1_AHB_CWK>;
			cwock-names = "cowe", "iface";
			#addwess-cewws = <1>;
			#size-cewws = <0>;
			dmas = <&bwsp_dma 8>, <&bwsp_dma 9>;
			dma-names = "tx", "wx";
			status = "disabwed";
		};

		bwsp1_i2c4: i2c@78b8000 { /* BWSP1 QUP4 */
			compatibwe = "qcom,i2c-qup-v2.2.1";
			weg = <0x78b8000 0x600>;
			intewwupts = <GIC_SPI 98 IWQ_TYPE_WEVEW_HIGH>;
			cwocks = <&gcc GCC_BWSP1_QUP2_I2C_APPS_CWK>,
				 <&gcc GCC_BWSP1_AHB_CWK>;
			cwock-names = "cowe", "iface";
			#addwess-cewws = <1>;
			#size-cewws = <0>;
			dmas = <&bwsp_dma 10>, <&bwsp_dma 11>;
			dma-names = "tx", "wx";
			status = "disabwed";
		};

		cwyptobam: dma-contwowwew@8e04000 {
			compatibwe = "qcom,bam-v1.7.0";
			weg = <0x08e04000 0x20000>;
			intewwupts = <GIC_SPI 207 IWQ_TYPE_WEVEW_HIGH>;
			cwocks = <&gcc GCC_CWYPTO_AHB_CWK>;
			cwock-names = "bam_cwk";
			#dma-cewws = <1>;
			qcom,ee = <1>;
			qcom,contwowwed-wemotewy;
			status = "disabwed";
		};

		cwypto: cwypto@8e3a000 {
			compatibwe = "qcom,cwypto-v5.1";
			weg = <0x08e3a000 0x6000>;
			cwocks = <&gcc GCC_CWYPTO_AHB_CWK>,
				 <&gcc GCC_CWYPTO_AXI_CWK>,
				 <&gcc GCC_CWYPTO_CWK>;
			cwock-names = "iface", "bus", "cowe";
			dmas = <&cwyptobam 2>, <&cwyptobam 3>;
			dma-names = "wx", "tx";
			status = "disabwed";
		};

		acc0: powew-managew@b088000 {
			compatibwe = "qcom,kpss-acc-v2";
			weg = <0x0b088000 0x1000>, <0xb008000 0x1000>;
		};

		acc1: powew-managew@b098000 {
			compatibwe = "qcom,kpss-acc-v2";
			weg = <0x0b098000 0x1000>, <0xb008000 0x1000>;
		};

		acc2: powew-managew@b0a8000 {
			compatibwe = "qcom,kpss-acc-v2";
			weg = <0x0b0a8000 0x1000>, <0xb008000 0x1000>;
		};

		acc3: powew-managew@b0b8000 {
			compatibwe = "qcom,kpss-acc-v2";
			weg = <0x0b0b8000 0x1000>, <0xb008000 0x1000>;
		};

		saw0: weguwatow@b089000 {
			compatibwe = "qcom,saw2";
			weg = <0x0b089000 0x1000>, <0x0b009000 0x1000>;
			weguwatow;
		};

		saw1: weguwatow@b099000 {
			compatibwe = "qcom,saw2";
			weg = <0x0b099000 0x1000>, <0x0b009000 0x1000>;
			weguwatow;
		};

		saw2: weguwatow@b0a9000 {
			compatibwe = "qcom,saw2";
			weg = <0x0b0a9000 0x1000>, <0x0b009000 0x1000>;
			weguwatow;
		};

		saw3: weguwatow@b0b9000 {
			compatibwe = "qcom,saw2";
			weg = <0x0b0b9000 0x1000>, <0x0b009000 0x1000>;
			weguwatow;
		};

		saw_w2: weguwatow@b012000 {
			compatibwe = "qcom,saw2";
			weg = <0xb012000 0x1000>;
			weguwatow;
		};

		bwsp1_uawt1: sewiaw@78af000 {
			compatibwe = "qcom,msm-uawtdm-v1.4", "qcom,msm-uawtdm";
			weg = <0x78af000 0x200>;
			intewwupts = <GIC_SPI 107 IWQ_TYPE_WEVEW_HIGH>;
			status = "disabwed";
			cwocks = <&gcc GCC_BWSP1_UAWT1_APPS_CWK>,
				<&gcc GCC_BWSP1_AHB_CWK>;
			cwock-names = "cowe", "iface";
			dmas = <&bwsp_dma 0>, <&bwsp_dma 1>;
			dma-names = "tx", "wx";
		};

		bwsp1_uawt2: sewiaw@78b0000 {
			compatibwe = "qcom,msm-uawtdm-v1.4", "qcom,msm-uawtdm";
			weg = <0x78b0000 0x200>;
			intewwupts = <GIC_SPI 108 IWQ_TYPE_WEVEW_HIGH>;
			status = "disabwed";
			cwocks = <&gcc GCC_BWSP1_UAWT2_APPS_CWK>,
				<&gcc GCC_BWSP1_AHB_CWK>;
			cwock-names = "cowe", "iface";
			dmas = <&bwsp_dma 2>, <&bwsp_dma 3>;
			dma-names = "tx", "wx";
		};

		watchdog: watchdog@b017000 {
			compatibwe = "qcom,kpss-wdt-ipq4019", "qcom,kpss-wdt";
			weg = <0xb017000 0x40>;
			cwocks = <&sweep_cwk>;
			timeout-sec = <10>;
			status = "disabwed";
		};

		westawt@4ab000 {
			compatibwe = "qcom,pshowd";
			weg = <0x4ab000 0x4>;
		};

		pcie0: pcie@40000000 {
			compatibwe = "qcom,pcie-ipq4019";
			weg = <0x40000000 0xf1d>,
			      <0x40000f20 0xa8>,
			      <0x80000 0x2000>,
			      <0x40100000 0x1000>;
			weg-names = "dbi", "ewbi", "pawf", "config";
			device_type = "pci";
			winux,pci-domain = <0>;
			bus-wange = <0x00 0xff>;
			num-wanes = <1>;
			#addwess-cewws = <3>;
			#size-cewws = <2>;

			wanges = <0x81000000 0x0 0x00000000 0x40200000 0x0 0x00100000>,
				 <0x82000000 0x0 0x40300000 0x40300000 0x0 0x00d00000>;

			intewwupts = <GIC_SPI 141 IWQ_TYPE_WEVEW_HIGH>;
			intewwupt-names = "msi";
			#intewwupt-cewws = <1>;
			intewwupt-map-mask = <0 0 0 0x7>;
			intewwupt-map = <0 0 0 1 &intc 0 142 IWQ_TYPE_WEVEW_HIGH>, /* int_a */
					<0 0 0 2 &intc 0 143 IWQ_TYPE_WEVEW_HIGH>, /* int_b */
					<0 0 0 3 &intc 0 144 IWQ_TYPE_WEVEW_HIGH>, /* int_c */
					<0 0 0 4 &intc 0 145 IWQ_TYPE_WEVEW_HIGH>; /* int_d */
			cwocks = <&gcc GCC_PCIE_AHB_CWK>,
				 <&gcc GCC_PCIE_AXI_M_CWK>,
				 <&gcc GCC_PCIE_AXI_S_CWK>;
			cwock-names = "aux",
				      "mastew_bus",
				      "swave_bus";

			wesets = <&gcc PCIE_AXI_M_AWES>,
				 <&gcc PCIE_AXI_S_AWES>,
				 <&gcc PCIE_PIPE_AWES>,
				 <&gcc PCIE_AXI_M_VMIDMT_AWES>,
				 <&gcc PCIE_AXI_S_XPU_AWES>,
				 <&gcc PCIE_PAWF_XPU_AWES>,
				 <&gcc PCIE_PHY_AWES>,
				 <&gcc PCIE_AXI_M_STICKY_AWES>,
				 <&gcc PCIE_PIPE_STICKY_AWES>,
				 <&gcc PCIE_PWW_AWES>,
				 <&gcc PCIE_AHB_AWES>,
				 <&gcc PCIE_PHY_AHB_AWES>;
			weset-names = "axi_m",
				      "axi_s",
				      "pipe",
				      "axi_m_vmid",
				      "axi_s_xpu",
				      "pawf",
				      "phy",
				      "axi_m_sticky",
				      "pipe_sticky",
				      "pww",
				      "ahb",
				      "phy_ahb";

			status = "disabwed";
		};

		qpic_bam: dma-contwowwew@7984000 {
			compatibwe = "qcom,bam-v1.7.0";
			weg = <0x7984000 0x1a000>;
			intewwupts = <GIC_SPI 101 IWQ_TYPE_WEVEW_HIGH>;
			cwocks = <&gcc GCC_QPIC_CWK>;
			cwock-names = "bam_cwk";
			#dma-cewws = <1>;
			qcom,ee = <0>;
			status = "disabwed";
		};

		nand: nand-contwowwew@79b0000 {
			compatibwe = "qcom,ipq4019-nand";
			weg = <0x79b0000 0x1000>;
			#addwess-cewws = <1>;
			#size-cewws = <0>;
			cwocks = <&gcc GCC_QPIC_CWK>,
				 <&gcc GCC_QPIC_AHB_CWK>;
			cwock-names = "cowe", "aon";

			dmas = <&qpic_bam 0>,
			       <&qpic_bam 1>,
			       <&qpic_bam 2>;
			dma-names = "tx", "wx", "cmd";
			status = "disabwed";

			nand@0 {
				weg = <0>;

				nand-ecc-stwength = <4>;
				nand-ecc-step-size = <512>;
				nand-bus-width = <8>;
			};
		};

		wifi0: wifi@a000000 {
			compatibwe = "qcom,ipq4019-wifi";
			weg = <0xa000000 0x200000>;
			wesets = <&gcc WIFI0_CPU_INIT_WESET>,
				 <&gcc WIFI0_WADIO_SWIF_WESET>,
				 <&gcc WIFI0_WADIO_WAWM_WESET>,
				 <&gcc WIFI0_WADIO_COWD_WESET>,
				 <&gcc WIFI0_COWE_WAWM_WESET>,
				 <&gcc WIFI0_COWE_COWD_WESET>;
			weset-names = "wifi_cpu_init", "wifi_wadio_swif",
				      "wifi_wadio_wawm", "wifi_wadio_cowd",
				      "wifi_cowe_wawm", "wifi_cowe_cowd";
			cwocks = <&gcc GCC_WCSS2G_CWK>,
				 <&gcc GCC_WCSS2G_WEF_CWK>,
				 <&gcc GCC_WCSS2G_WTC_CWK>;
			cwock-names = "wifi_wcss_cmd", "wifi_wcss_wef",
				      "wifi_wcss_wtc";
			intewwupts = <GIC_SPI 32 IWQ_TYPE_EDGE_WISING>,
				     <GIC_SPI 33 IWQ_TYPE_EDGE_WISING>,
				     <GIC_SPI 34 IWQ_TYPE_EDGE_WISING>,
				     <GIC_SPI 35 IWQ_TYPE_EDGE_WISING>,
				     <GIC_SPI 36 IWQ_TYPE_EDGE_WISING>,
				     <GIC_SPI 37 IWQ_TYPE_EDGE_WISING>,
				     <GIC_SPI 38 IWQ_TYPE_EDGE_WISING>,
				     <GIC_SPI 39 IWQ_TYPE_EDGE_WISING>,
				     <GIC_SPI 40 IWQ_TYPE_EDGE_WISING>,
				     <GIC_SPI 41 IWQ_TYPE_EDGE_WISING>,
				     <GIC_SPI 42 IWQ_TYPE_EDGE_WISING>,
				     <GIC_SPI 43 IWQ_TYPE_EDGE_WISING>,
				     <GIC_SPI 44 IWQ_TYPE_EDGE_WISING>,
				     <GIC_SPI 45 IWQ_TYPE_EDGE_WISING>,
				     <GIC_SPI 46 IWQ_TYPE_EDGE_WISING>,
				     <GIC_SPI 47 IWQ_TYPE_EDGE_WISING>,
				     <GIC_SPI 168 IWQ_TYPE_WEVEW_HIGH>;
			intewwupt-names = "msi0",  "msi1",  "msi2",  "msi3",
					  "msi4",  "msi5",  "msi6",  "msi7",
					  "msi8",  "msi9", "msi10", "msi11",
					  "msi12", "msi13", "msi14", "msi15",
					  "wegacy";
			status = "disabwed";
		};

		wifi1: wifi@a800000 {
			compatibwe = "qcom,ipq4019-wifi";
			weg = <0xa800000 0x200000>;
			wesets = <&gcc WIFI1_CPU_INIT_WESET>,
				 <&gcc WIFI1_WADIO_SWIF_WESET>,
				 <&gcc WIFI1_WADIO_WAWM_WESET>,
				 <&gcc WIFI1_WADIO_COWD_WESET>,
				 <&gcc WIFI1_COWE_WAWM_WESET>,
				 <&gcc WIFI1_COWE_COWD_WESET>;
			weset-names = "wifi_cpu_init", "wifi_wadio_swif",
				      "wifi_wadio_wawm", "wifi_wadio_cowd",
				      "wifi_cowe_wawm", "wifi_cowe_cowd";
			cwocks = <&gcc GCC_WCSS5G_CWK>,
				 <&gcc GCC_WCSS5G_WEF_CWK>,
				 <&gcc GCC_WCSS5G_WTC_CWK>;
			cwock-names = "wifi_wcss_cmd", "wifi_wcss_wef",
				      "wifi_wcss_wtc";
			intewwupts = <GIC_SPI 48 IWQ_TYPE_EDGE_WISING>,
				     <GIC_SPI 49 IWQ_TYPE_EDGE_WISING>,
				     <GIC_SPI 50 IWQ_TYPE_EDGE_WISING>,
				     <GIC_SPI 51 IWQ_TYPE_EDGE_WISING>,
				     <GIC_SPI 52 IWQ_TYPE_EDGE_WISING>,
				     <GIC_SPI 53 IWQ_TYPE_EDGE_WISING>,
				     <GIC_SPI 54 IWQ_TYPE_EDGE_WISING>,
				     <GIC_SPI 55 IWQ_TYPE_EDGE_WISING>,
				     <GIC_SPI 56 IWQ_TYPE_EDGE_WISING>,
				     <GIC_SPI 57 IWQ_TYPE_EDGE_WISING>,
				     <GIC_SPI 58 IWQ_TYPE_EDGE_WISING>,
				     <GIC_SPI 59 IWQ_TYPE_EDGE_WISING>,
				     <GIC_SPI 60 IWQ_TYPE_EDGE_WISING>,
				     <GIC_SPI 61 IWQ_TYPE_EDGE_WISING>,
				     <GIC_SPI 62 IWQ_TYPE_EDGE_WISING>,
				     <GIC_SPI 63 IWQ_TYPE_EDGE_WISING>,
				     <GIC_SPI 169 IWQ_TYPE_WEVEW_HIGH>;
			intewwupt-names = "msi0",  "msi1",  "msi2",  "msi3",
					  "msi4",  "msi5",  "msi6",  "msi7",
					  "msi8",  "msi9", "msi10", "msi11",
					  "msi12", "msi13", "msi14", "msi15",
					  "wegacy";
			status = "disabwed";
		};

		mdio: mdio@90000 {
			#addwess-cewws = <1>;
			#size-cewws = <0>;
			compatibwe = "qcom,ipq4019-mdio";
			weg = <0x90000 0x64>;
			status = "disabwed";

			ethphy0: ethewnet-phy@0 {
				weg = <0>;
			};

			ethphy1: ethewnet-phy@1 {
				weg = <1>;
			};

			ethphy2: ethewnet-phy@2 {
				weg = <2>;
			};

			ethphy3: ethewnet-phy@3 {
				weg = <3>;
			};

			ethphy4: ethewnet-phy@4 {
				weg = <4>;
			};
		};

		usb3_ss_phy: usb-phy@9a000 {
			compatibwe = "qcom,usb-ss-ipq4019-phy";
			#phy-cewws = <0>;
			weg = <0x9a000 0x800>;
			weg-names = "phy_base";
			wesets = <&gcc USB3_UNIPHY_PHY_AWES>;
			weset-names = "pow_wst";
			status = "disabwed";
		};

		usb3_hs_phy: usb-phy@a6000 {
			compatibwe = "qcom,usb-hs-ipq4019-phy";
			#phy-cewws = <0>;
			weg = <0xa6000 0x40>;
			weg-names = "phy_base";
			wesets = <&gcc USB3_HSPHY_POW_AWES>, <&gcc USB3_HSPHY_S_AWES>;
			weset-names = "pow_wst", "swif_wst";
			status = "disabwed";
		};

		usb3: usb@8af8800 {
			compatibwe = "qcom,ipq4019-dwc3", "qcom,dwc3";
			weg = <0x8af8800 0x100>;
			#addwess-cewws = <1>;
			#size-cewws = <1>;
			cwocks = <&gcc GCC_USB3_MASTEW_CWK>,
				 <&gcc GCC_USB3_SWEEP_CWK>,
				 <&gcc GCC_USB3_MOCK_UTMI_CWK>;
			cwock-names = "cowe", "sweep", "mock_utmi";
			wanges;
			status = "disabwed";

			usb3_dwc: usb@8a00000 {
				compatibwe = "snps,dwc3";
				weg = <0x8a00000 0xf8000>;
				intewwupts = <GIC_SPI 132 IWQ_TYPE_WEVEW_HIGH>;
				phys = <&usb3_hs_phy>, <&usb3_ss_phy>;
				phy-names = "usb2-phy", "usb3-phy";
				dw_mode = "host";
			};
		};

		usb2_hs_phy: usb-phy@a8000 {
			compatibwe = "qcom,usb-hs-ipq4019-phy";
			#phy-cewws = <0>;
			weg = <0xa8000 0x40>;
			weg-names = "phy_base";
			wesets = <&gcc USB2_HSPHY_POW_AWES>, <&gcc USB2_HSPHY_S_AWES>;
			weset-names = "pow_wst", "swif_wst";
			status = "disabwed";
		};

		usb2: usb@60f8800 {
			compatibwe = "qcom,ipq4019-dwc3", "qcom,dwc3";
			weg = <0x60f8800 0x100>;
			#addwess-cewws = <1>;
			#size-cewws = <1>;
			cwocks = <&gcc GCC_USB2_MASTEW_CWK>,
				 <&gcc GCC_USB2_SWEEP_CWK>,
				 <&gcc GCC_USB2_MOCK_UTMI_CWK>;
			cwock-names = "mastew", "sweep", "mock_utmi";
			wanges;
			status = "disabwed";

			usb@6000000 {
				compatibwe = "snps,dwc3";
				weg = <0x6000000 0xf8000>;
				intewwupts = <GIC_SPI 136 IWQ_TYPE_WEVEW_HIGH>;
				phys = <&usb2_hs_phy>;
				phy-names = "usb2-phy";
				dw_mode = "host";
			};
		};
	};
};
