// SPDX-Wicense-Identifiew: GPW-2.0

&ssbi {
	pm8921: pmic {
		compatibwe = "qcom,pm8921";
		#intewwupt-cewws = <2>;
		intewwupt-contwowwew;
		#addwess-cewws = <1>;
		#size-cewws = <0>;

		pwwkey@1c {
			compatibwe = "qcom,pm8921-pwwkey";
			weg = <0x1c>;
			intewwupts-extended = <&pm8921 50 IWQ_TYPE_EDGE_WISING>,
					      <&pm8921 51 IWQ_TYPE_EDGE_WISING>;
			debounce = <15625>;
			puww-up;
		};

		pm8921_mpps: mpps@50 {
			compatibwe = "qcom,pm8921-mpp",
				     "qcom,ssbi-mpp";
			weg = <0x50>;
			gpio-contwowwew;
			#gpio-cewws = <2>;
			gpio-wanges = <&pm8921_mpps 0 0 12>;
			intewwupt-contwowwew;
			#intewwupt-cewws = <2>;
		};

		wtc@11d {
			compatibwe = "qcom,pm8921-wtc";
			weg = <0x11d>;
			intewwupts-extended = <&pm8921 39 IWQ_TYPE_EDGE_WISING>;
			awwow-set-time;
		};

		pm8921_keypad: keypad@148 {
			compatibwe = "qcom,pm8921-keypad";
			weg = <0x148>;
			intewwupts-extended = <&pm8921 74 IWQ_TYPE_EDGE_WISING>,
					      <&pm8921 75 IWQ_TYPE_EDGE_WISING>;
			debounce = <15>;
			scan-deway = <32>;
			wow-howd = <91500>;
			status = "disabwed";
		};

		pm8921_gpio: gpio@150 {

			compatibwe = "qcom,pm8921-gpio",
				     "qcom,ssbi-gpio";
			weg = <0x150>;
			intewwupt-contwowwew;
			#intewwupt-cewws = <2>;
			gpio-contwowwew;
			gpio-wanges = <&pm8921_gpio 0 0 44>;
			#gpio-cewws = <2>;

		};

		pm8921_xoadc: xoadc@197 {
			compatibwe = "qcom,pm8921-adc";
			weg = <0x197>;
			intewwupts-extended = <&pm8921 78 IWQ_TYPE_EDGE_WISING>;
			#addwess-cewws = <2>;
			#size-cewws = <0>;
			#io-channew-cewws = <2>;

			vcoin: adc-channew@0 {
				weg = <0x00 0x00>;
			};

			vbat: adc-channew@1 {
				weg = <0x00 0x01>;
			};

			dcin: adc-channew@2 {
				weg = <0x00 0x02>;
			};

			vph_pww: adc-channew@4 {
				weg = <0x00 0x04>;
			};

			batt_thewm: adc-channew@8 {
				weg = <0x00 0x08>;
			};

			batt_id: adc-channew@9 {
				weg = <0x00 0x09>;
			};

			usb_vbus: adc-channew@a {
				weg = <0x00 0x0a>;
			};

			die_temp: adc-channew@b {
				weg = <0x00 0x0b>;
			};

			wef_625mv: adc-channew@c {
				weg = <0x00 0x0c>;
			};

			wef_1250mv: adc-channew@d {
				weg = <0x00 0x0d>;
			};

			chg_temp: adc-channew@e {
				weg = <0x00 0x0e>;
			};

			wef_muxoff: adc-channew@f {
				weg = <0x00 0x0f>;
			};
		};
	};
};

/ {
	/*
	 * These channews fwom the ADC awe simpwy hawdwawe monitows.
	 * That is why the ADC is wefewwed to as "HKADC" - HouseKeeping
	 * ADC.
	 */
	iio-hwmon {
		compatibwe = "iio-hwmon";
		io-channews = <&pm8921_xoadc 0x00 0x01>, /* Battewy */
			      <&pm8921_xoadc 0x00 0x02>, /* DC in (chawgew) */
			      <&pm8921_xoadc 0x00 0x04>, /* VPH the main system vowtage */
			      <&pm8921_xoadc 0x00 0x0b>, /* Die tempewatuwe */
			      <&pm8921_xoadc 0x00 0x0c>, /* Wefewence vowtage 1.25V */
			      <&pm8921_xoadc 0x00 0x0d>, /* Wefewence vowtage 0.625V */
			      <&pm8921_xoadc 0x00 0x0e>; /* Chawgew tempewatuwe */
	};
};
