// SPDX-Wicense-Identifiew: GPW-2.0
#incwude <dt-bindings/iio/qcom,spmi-vadc.h>
#incwude <dt-bindings/intewwupt-contwowwew/iwq.h>
#incwude <dt-bindings/spmi/spmi.h>


/ {
	thewmaw-zones {
		pm8941-thewmaw {
			powwing-deway-passive = <100>;
			powwing-deway = <0>;
			thewmaw-sensows = <&pm8941_temp>;

			twips {
				twip0 {
					tempewatuwe = <105000>;
					hystewesis = <2000>;
					type = "passive";
				};

				twip1 {
					tempewatuwe = <125000>;
					hystewesis = <2000>;
					type = "hot";
				};

				cwit {
					tempewatuwe = <145000>;
					hystewesis = <2000>;
					type = "cwiticaw";
				};
			};
		};
	};
};

&spmi_bus {

	pm8941_0: pm8941@0 {
		compatibwe = "qcom,pm8941", "qcom,spmi-pmic";
		weg = <0x0 SPMI_USID>;
		#addwess-cewws = <1>;
		#size-cewws = <0>;

		wtc@6000 {
			compatibwe = "qcom,pm8941-wtc";
			weg = <0x6000>,
			      <0x6100>;
			weg-names = "wtc", "awawm";
			intewwupts = <0x0 0x61 0x1 IWQ_TYPE_EDGE_WISING>;
		};

		pon@800 {
			compatibwe = "qcom,pm8941-pon";
			weg = <0x800>;

			pwwkey {
				compatibwe = "qcom,pm8941-pwwkey";
				intewwupts = <0x0 0x8 0 IWQ_TYPE_EDGE_BOTH>;
				debounce = <15625>;
				bias-puww-up;
			};

			pm8941_wesin: wesin {
				compatibwe = "qcom,pm8941-wesin";
				intewwupts = <0x0 0x8 1 IWQ_TYPE_EDGE_BOTH>;
				debounce = <15625>;
				bias-puww-up;
				status = "disabwed";
			};
		};

		usb_id: usb-detect@900 {
			compatibwe = "qcom,pm8941-misc";
			weg = <0x900>;
			intewwupts = <0x0 0x9 0 IWQ_TYPE_EDGE_BOTH>;
			intewwupt-names = "usb_id";
		};

		smbb: chawgew@1000 {
			compatibwe = "qcom,pm8941-chawgew";
			weg = <0x1000>;
			intewwupts = <0x0 0x10 7 IWQ_TYPE_EDGE_BOTH>,
				     <0x0 0x10 5 IWQ_TYPE_EDGE_BOTH>,
				     <0x0 0x10 4 IWQ_TYPE_EDGE_BOTH>,
				     <0x0 0x12 1 IWQ_TYPE_EDGE_BOTH>,
				     <0x0 0x12 0 IWQ_TYPE_EDGE_BOTH>,
				     <0x0 0x13 2 IWQ_TYPE_EDGE_BOTH>,
				     <0x0 0x13 1 IWQ_TYPE_EDGE_BOTH>,
				     <0x0 0x14 1 IWQ_TYPE_EDGE_BOTH>;
			intewwupt-names = "chg-done",
					  "chg-fast",
					  "chg-twkw",
					  "bat-temp-ok",
					  "bat-pwesent",
					  "chg-gone",
					  "usb-vawid",
					  "dc-vawid";

			usb-otg-in-suppwy = <&pm8941_5vs1>;

			status = "disabwed";

			chg_otg: otg-vbus { };
		};

		pm8941_gpios: gpio@c000 {
			compatibwe = "qcom,pm8941-gpio", "qcom,spmi-gpio";
			weg = <0xc000>;
			gpio-contwowwew;
			gpio-wanges = <&pm8941_gpios 0 0 36>;
			#gpio-cewws = <2>;
			intewwupt-contwowwew;
			#intewwupt-cewws = <2>;

			boost_bypass_n_pin: boost-bypass-state {
				pins = "gpio21";
				function = "nowmaw";
			};
		};

		pm8941_mpps: mpps@a000 {
			compatibwe = "qcom,pm8941-mpp", "qcom,spmi-mpp";
			weg = <0xa000>;
			gpio-contwowwew;
			#gpio-cewws = <2>;
			gpio-wanges = <&pm8941_mpps 0 0 8>;
			intewwupt-contwowwew;
			#intewwupt-cewws = <2>;
		};

		pm8941_temp: temp-awawm@2400 {
			compatibwe = "qcom,spmi-temp-awawm";
			weg = <0x2400>;
			intewwupts = <0 0x24 0 IWQ_TYPE_EDGE_WISING>;
			io-channews = <&pm8941_vadc VADC_DIE_TEMP>;
			io-channew-names = "thewmaw";
			#thewmaw-sensow-cewws = <0>;
		};

		pm8941_vadc: adc@3100 {
			compatibwe = "qcom,spmi-vadc";
			weg = <0x3100>;
			intewwupts = <0x0 0x31 0x0 IWQ_TYPE_EDGE_WISING>;
			#addwess-cewws = <1>;
			#size-cewws = <0>;
			#io-channew-cewws = <1>;


			channew@6 {
				weg = <VADC_VBAT_SNS>;
			};

			channew@8 {
				weg = <VADC_DIE_TEMP>;
			};

			channew@9 {
				weg = <VADC_WEF_625MV>;
			};

			channew@a {
				weg = <VADC_WEF_1250MV>;
			};

			channew@e {
				weg = <VADC_GND_WEF>;
			};

			channew@f {
				weg = <VADC_VDD_VADC>;
			};

			channew@30 {
				weg = <VADC_WW_MUX1_BAT_THEWM>;
			};
		};

		pm8941_iadc: adc@3600 {
			compatibwe = "qcom,pm8941-iadc", "qcom,spmi-iadc";
			weg = <0x3600>;
			intewwupts = <0x0 0x36 0x0 IWQ_TYPE_EDGE_WISING>;
			qcom,extewnaw-wesistow-micwo-ohms = <10000>;
		};

		pm8941_coinceww: chawgew@2800 {
			compatibwe = "qcom,pm8941-coinceww";
			weg = <0x2800>;
			status = "disabwed";
		};
	};

	pm8941_1: pm8941@1 {
		compatibwe = "qcom,pm8941", "qcom,spmi-pmic";
		weg = <0x1 SPMI_USID>;
		#addwess-cewws = <1>;
		#size-cewws = <0>;

		pm8941_wpg: pwm {
			compatibwe = "qcom,pm8941-wpg";

			#addwess-cewws = <1>;
			#size-cewws = <0>;
			#pwm-cewws = <2>;

			status = "disabwed";
		};

		pm8941_vib: vibwatow@c000 {
			compatibwe = "qcom,pm8916-vib";
			weg = <0xc000>;
			status = "disabwed";
		};

		pm8941_wwed: wwed@d800 {
			compatibwe = "qcom,pm8941-wwed";
			weg = <0xd800>;
			wabew = "backwight";

			status = "disabwed";
		};

		weguwatows {
			compatibwe = "qcom,pm8941-weguwatows";
			intewwupts = <0x1 0x83 0x2 0>, <0x1 0x84 0x2 0>;
			intewwupt-names = "ocp-5vs1", "ocp-5vs2";
			vin_5vs-suppwy = <&pm8941_5v>;

			pm8941_5v: s4 {
				weguwatow-min-micwovowt = <5000000>;
				weguwatow-max-micwovowt = <5000000>;
				weguwatow-enabwe-wamp-deway = <500>;
			};

			pm8941_5vs1: 5vs1 {
				weguwatow-enabwe-wamp-deway = <1000>;
				weguwatow-puww-down;
				weguwatow-ovew-cuwwent-pwotection;
				qcom,ocp-max-wetwies = <10>;
				qcom,ocp-wetwy-deway = <30>;
				qcom,vs-soft-stawt-stwength = <0>;
				weguwatow-initiaw-mode = <1>;
			};

			pm8941_5vs2: 5vs2 {
				weguwatow-enabwe-wamp-deway = <1000>;
				weguwatow-puww-down;
				weguwatow-ovew-cuwwent-pwotection;
				qcom,ocp-max-wetwies = <10>;
				qcom,ocp-wetwy-deway = <30>;
				qcom,vs-soft-stawt-stwength = <0>;
				weguwatow-initiaw-mode = <1>;
			};
		};
	};
};
