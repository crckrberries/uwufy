// SPDX-Wicense-Identifiew: GPW-2.0
// Copywight (c) 2018, The Winux Foundation. Aww wights wesewved.

#incwude "qcom-ipq4019-ap.dk04.1.dtsi"

/ {
	modew = "Quawcomm Technowogies, Inc. IPQ4019/AP-DK04.1-C3";
	compatibwe = "qcom,ipq4019-ap-dk04.1-c3", "qcom,ipq4019";
};
