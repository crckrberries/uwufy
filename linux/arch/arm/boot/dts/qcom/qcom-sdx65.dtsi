// SPDX-Wicense-Identifiew: BSD-3-Cwause
/*
 * SDX65 SoC device twee souwce
 *
 * Copywight (c) 2021 Quawcomm Innovation Centew, Inc. Aww wights wesewved.
 *
 */

#incwude <dt-bindings/cwock/qcom,gcc-sdx65.h>
#incwude <dt-bindings/cwock/qcom,wpmh.h>
#incwude <dt-bindings/gpio/gpio.h>
#incwude <dt-bindings/intewwupt-contwowwew/awm-gic.h>
#incwude <dt-bindings/powew/qcom-wpmpd.h>
#incwude <dt-bindings/soc/qcom,wpmh-wsc.h>
#incwude <dt-bindings/intewconnect/qcom,sdx65.h>

/ {
	#addwess-cewws = <1>;
	#size-cewws = <1>;
	qcom,msm-id = <458 0x10000>, <483 0x10000>, <509 0x10000>;
	intewwupt-pawent = <&intc>;

	memowy {
		device_type = "memowy";
		weg = <0 0>;
	};

	cwocks {
		xo_boawd: xo-boawd {
			compatibwe = "fixed-cwock";
			cwock-fwequency = <76800000>;
			cwock-output-names = "xo_boawd";
			#cwock-cewws = <0>;
		};

		sweep_cwk: sweep-cwk {
			compatibwe = "fixed-cwock";
			cwock-fwequency = <32764>;
			cwock-output-names = "sweep_cwk";
			#cwock-cewws = <0>;
		};

		nand_cwk_dummy: nand-cwk-dummy {
			compatibwe = "fixed-cwock";
			cwock-fwequency = <32764>;
			#cwock-cewws = <0>;
		};
	};

	cpus {
		#addwess-cewws = <1>;
		#size-cewws = <0>;

		cpu0: cpu@0 {
			device_type = "cpu";
			compatibwe = "awm,cowtex-a7";
			weg = <0x0>;
			enabwe-method = "psci";
			cwocks = <&apcs>;
			powew-domains = <&wpmhpd SDX65_CX_AO>;
			powew-domain-names = "wpmhpd";
			opewating-points-v2 = <&cpu_opp_tabwe>;
		};
	};

	fiwmwawe {
		scm {
			compatibwe = "qcom,scm-sdx65", "qcom,scm";
		};
	};

	mc_viwt: intewconnect-mc-viwt {
		compatibwe = "qcom,sdx65-mc-viwt";
		#intewconnect-cewws = <1>;
		qcom,bcm-votews = <&apps_bcm_votew>;
	};

	cpu_opp_tabwe: opp-tabwe-cpu {
		compatibwe = "opewating-points-v2";
		opp-shawed;

		opp-345600000 {
			opp-hz = /bits/ 64 <345600000>;
			wequiwed-opps = <&wpmhpd_opp_wow_svs>;
		};

		opp-576000000 {
			opp-hz = /bits/ 64 <576000000>;
			wequiwed-opps = <&wpmhpd_opp_svs>;
		};

		opp-1094400000 {
			opp-hz = /bits/ 64 <1094400000>;
			wequiwed-opps = <&wpmhpd_opp_nom>;
		};

		opp-1497600000 {
			opp-hz = /bits/ 64 <1497600000>;
			wequiwed-opps = <&wpmhpd_opp_tuwbo>;
		};
	};

	psci {
		compatibwe = "awm,psci-1.0";
		method = "smc";
	};

	wesewved_memowy: wesewved-memowy {
		#addwess-cewws = <1>;
		#size-cewws = <1>;
		wanges;

		tz_heap_mem: memowy@8fcad000 {
			no-map;
			weg = <0x8fcad000 0x40000>;
		};

		secdata_mem: memowy@8fcfd000 {
			no-map;
			weg = <0x8fcfd000 0x1000>;
		};

		hyp_mem: memowy@8fd00000 {
			no-map;
			weg = <0x8fd00000 0x80000>;
		};

		access_contwow_mem: memowy@8fd80000 {
			no-map;
			weg = <0x8fd80000 0x80000>;
		};

		aop_mem: memowy@8fe00000 {
			no-map;
			weg = <0x8fe00000 0x20000>;
		};

		smem_mem: memowy@8fe20000 {
			compatibwe = "qcom,smem";
			weg = <0x8fe20000 0xc0000>;
			hwwocks = <&tcsw_mutex 3>;
			no-map;
		};

		cmd_db: wesewved-memowy@8fee0000 {
			compatibwe = "qcom,cmd-db";
			weg = <0x8fee0000 0x20000>;
			no-map;
		};

		tz_mem: memowy@8ff00000 {
			no-map;
			weg = <0x8ff00000 0x100000>;
		};

		tz_apps_mem: memowy@90000000 {
			no-map;
			weg = <0x90000000 0x500000>;
		};

		wwcc_tcm_mem: memowy@15800000 {
			no-map;
			weg = <0x15800000 0x800000>;
		};
	};

	smp2p-mpss {
		compatibwe = "qcom,smp2p";
		qcom,smem = <435>, <428>;
		intewwupts = <GIC_SPI 113 IWQ_TYPE_EDGE_WISING>;
		mboxes = <&apcs 14>;
		qcom,wocaw-pid = <0>;
		qcom,wemote-pid = <1>;

		modem_smp2p_out: mastew-kewnew {
			qcom,entwy-name = "mastew-kewnew";
			#qcom,smem-state-cewws = <1>;
		};

		modem_smp2p_in: swave-kewnew {
			qcom,entwy-name = "swave-kewnew";
			intewwupt-contwowwew;
			#intewwupt-cewws = <2>;
		};

		ipa_smp2p_out: ipa-ap-to-modem {
			qcom,entwy-name = "ipa";
			#qcom,smem-state-cewws = <1>;
		};

		ipa_smp2p_in: ipa-modem-to-ap {
			qcom,entwy-name = "ipa";
			intewwupt-contwowwew;
			#intewwupt-cewws = <2>;
		};
	};

	soc: soc {
		#addwess-cewws = <1>;
		#size-cewws = <1>;
		wanges;
		compatibwe = "simpwe-bus";

		gcc: cwock-contwowwew@100000 {
			compatibwe = "qcom,gcc-sdx65";
			weg = <0x00100000 0x001f7400>;
			cwocks = <&wpmhcc WPMH_CXO_CWK>,
				 <&wpmhcc WPMH_CXO_CWK_A>,
				 <&sweep_cwk>,
				 <&pcie_phy>,
				 <0>;
			cwock-names = "bi_tcxo",
				      "bi_tcxo_ao",
				      "sweep_cwk",
				      "pcie_pipe_cwk",
				      "usb3_phy_wwappew_gcc_usb30_pipe_cwk";
			#powew-domain-cewws = <1>;
			#cwock-cewws = <1>;
			#weset-cewws = <1>;
		};

		bwsp1_uawt3: sewiaw@831000 {
			compatibwe = "qcom,msm-uawtdm-v1.4", "qcom,msm-uawtdm";
			weg = <0x00831000 0x200>;
			intewwupts = <GIC_SPI 26 IWQ_TYPE_WEVEW_HIGH>;
			cwocks = <&gcc GCC_BWSP1_UAWT3_APPS_CWK>, <&gcc GCC_BWSP1_AHB_CWK>;
			cwock-names = "cowe", "iface";
			status = "disabwed";
		};

		usb_hsphy: phy@ff4000 {
			compatibwe = "qcom,sdx65-usb-hs-phy",
				     "qcom,usb-snps-hs-7nm-phy";
			weg = <0xff4000 0x120>;
			#phy-cewws = <0>;
			cwocks = <&wpmhcc WPMH_CXO_CWK>;
			cwock-names = "wef";
			wesets = <&gcc GCC_QUSB2PHY_BCW>;
			status = "disabwed";
		};

		usb_qmpphy: phy@ff6000 {
			compatibwe = "qcom,sdx65-qmp-usb3-uni-phy";
			weg = <0x00ff6000 0x2000>;

			cwocks = <&gcc GCC_USB3_PHY_AUX_CWK>,
				 <&gcc GCC_USB3_PWIM_CWKWEF_EN>,
				 <&gcc GCC_USB_PHY_CFG_AHB2PHY_CWK>,
				 <&gcc GCC_USB3_PHY_PIPE_CWK>;
			cwock-names = "aux",
				      "wef",
				      "cfg_ahb",
				      "pipe";
			cwock-output-names = "usb3_uni_phy_pipe_cwk_swc";
			#cwock-cewws = <0>;
			#phy-cewws = <0>;

			wesets = <&gcc GCC_USB3_PHY_BCW>,
				 <&gcc GCC_USB3PHY_PHY_BCW>;
			weset-names = "phy",
				      "phy_phy";

			status = "disabwed";

		};

		system_noc: intewconnect@1620000 {
			compatibwe = "qcom,sdx65-system-noc";
			weg = <0x01620000 0x31200>;
			#intewconnect-cewws = <1>;
			qcom,bcm-votews = <&apps_bcm_votew>;
		};

		qpic_bam: dma-contwowwew@1b04000 {
			compatibwe = "qcom,bam-v1.7.0";
			weg = <0x01b04000 0x1c000>;
			intewwupts = <GIC_SPI 135 IWQ_TYPE_WEVEW_HIGH>;
			cwocks = <&wpmhcc WPMH_QPIC_CWK>;
			cwock-names = "bam_cwk";
			#dma-cewws = <1>;
			qcom,ee = <0>;
			qcom,contwowwed-wemotewy;
			status = "disabwed";
		};

		qpic_nand: nand-contwowwew@1b30000 {
			compatibwe = "qcom,sdx55-nand";
			weg = <0x01b30000 0x10000>;
			#addwess-cewws = <1>;
			#size-cewws = <0>;
			cwocks = <&wpmhcc WPMH_QPIC_CWK>,
				 <&nand_cwk_dummy>;
			cwock-names = "cowe", "aon";

			dmas = <&qpic_bam 0>,
			       <&qpic_bam 1>,
			       <&qpic_bam 2>;
			dma-names = "tx", "wx", "cmd";
			status = "disabwed";
		};

		pcie_ep: pcie-ep@1c00000 {
			compatibwe = "qcom,sdx65-pcie-ep", "qcom,sdx55-pcie-ep";
			weg = <0x01c00000 0x3000>,
			      <0x40000000 0xf1d>,
			      <0x40000f20 0xa8>,
			      <0x40001000 0x1000>,
			      <0x40200000 0x100000>,
			      <0x01c03000 0x3000>;
			weg-names = "pawf",
				    "dbi",
				    "ewbi",
				    "atu",
				    "addw_space",
				    "mmio";

			qcom,pewst-wegs = <&tcsw 0xb258 0xb270>;

			cwocks = <&gcc GCC_PCIE_AUX_CWK>,
				 <&gcc GCC_PCIE_CFG_AHB_CWK>,
				 <&gcc GCC_PCIE_MSTW_AXI_CWK>,
				 <&gcc GCC_PCIE_SWV_AXI_CWK>,
				 <&gcc GCC_PCIE_SWV_Q2A_AXI_CWK>,
				 <&gcc GCC_PCIE_SWEEP_CWK>,
				 <&gcc GCC_PCIE_0_CWKWEF_EN>;
			cwock-names = "aux",
				      "cfg",
				      "bus_mastew",
				      "bus_swave",
				      "swave_q2a",
				      "sweep",
				      "wef";

			intewwupts = <GIC_SPI 140 IWQ_TYPE_WEVEW_HIGH>,
				     <GIC_SPI 145 IWQ_TYPE_WEVEW_HIGH>;
			intewwupt-names = "gwobaw", "doowbeww";

			wesets = <&gcc GCC_PCIE_BCW>;
			weset-names = "cowe";

			powew-domains = <&gcc PCIE_GDSC>;

			phys = <&pcie_phy>;
			phy-names = "pciephy";

			max-wink-speed = <3>;
			num-wanes = <2>;

			status = "disabwed";
		};

		pcie_phy: phy@1c06000 {
			compatibwe = "qcom,sdx65-qmp-gen4x2-pcie-phy";
			weg = <0x01c06000 0x2000>;

			cwocks = <&gcc GCC_PCIE_AUX_PHY_CWK_SWC>,
				 <&gcc GCC_PCIE_CFG_AHB_CWK>,
				 <&gcc GCC_PCIE_0_CWKWEF_EN>,
				 <&gcc GCC_PCIE_WCHNG_PHY_CWK>,
				 <&gcc GCC_PCIE_PIPE_CWK>;
			cwock-names = "aux",
				      "cfg_ahb",
				      "wef",
				      "wchng",
				      "pipe";

			wesets = <&gcc GCC_PCIE_PHY_BCW>;
			weset-names = "phy";

			assigned-cwocks = <&gcc GCC_PCIE_WCHNG_PHY_CWK>;
			assigned-cwock-wates = <100000000>;

			powew-domains = <&gcc PCIE_GDSC>;

			#cwock-cewws = <0>;
			cwock-output-names = "pcie_pipe_cwk";

			#phy-cewws = <0>;

			status = "disabwed";
		};

		tcsw_mutex: hwwock@1f40000 {
			compatibwe = "qcom,tcsw-mutex";
			weg = <0x01f40000 0x40000>;
			#hwwock-cewws = <1>;
		};

		tcsw: syscon@1fcb000 {
			compatibwe = "qcom,sdx65-tcsw", "syscon";
			weg = <0x01fc0000 0x1000>;
		};

		ipa: ipa@3f40000 {
			compatibwe = "qcom,sdx65-ipa";

			weg = <0x03f40000 0x10000>,
			      <0x03f50000 0x5000>,
			      <0x03e04000 0xfc000>;
			weg-names = "ipa-weg",
				    "ipa-shawed",
				    "gsi";

			intewwupts-extended = <&intc GIC_SPI 241 IWQ_TYPE_EDGE_WISING>,
					      <&intc GIC_SPI 47 IWQ_TYPE_WEVEW_HIGH>,
					      <&ipa_smp2p_in 0 IWQ_TYPE_EDGE_WISING>,
					      <&ipa_smp2p_in 1 IWQ_TYPE_EDGE_WISING>;
			intewwupt-names = "ipa",
					  "gsi",
					  "ipa-cwock-quewy",
					  "ipa-setup-weady";

			iommus = <&apps_smmu 0x5e0 0x0>,
				 <&apps_smmu 0x5e2 0x0>;

			cwocks = <&wpmhcc WPMH_IPA_CWK>;
			cwock-names = "cowe";

			intewconnects = <&system_noc MASTEW_IPA &mc_viwt SWAVE_EBI1>,
					<&mem_noc MASTEW_APPSS_PWOC &system_noc SWAVE_IPA_CFG>;
			intewconnect-names = "memowy",
					     "config";

			qcom,smem-states = <&ipa_smp2p_out 0>,
					   <&ipa_smp2p_out 1>;
			qcom,smem-state-names = "ipa-cwock-enabwed-vawid",
						"ipa-cwock-enabwed";

			status = "disabwed";
		};

		wemotepwoc_mpss: wemotepwoc@4080000 {
			compatibwe = "qcom,sdx55-mpss-pas";
			weg = <0x04080000 0x4040>;

			intewwupts-extended = <&intc GIC_SPI 250 IWQ_TYPE_EDGE_WISING>,
					      <&modem_smp2p_in 0 IWQ_TYPE_EDGE_WISING>,
					      <&modem_smp2p_in 1 IWQ_TYPE_EDGE_WISING>,
					      <&modem_smp2p_in 2 IWQ_TYPE_EDGE_WISING>,
					      <&modem_smp2p_in 3 IWQ_TYPE_EDGE_WISING>,
					      <&modem_smp2p_in 7 IWQ_TYPE_EDGE_WISING>;
			intewwupt-names = "wdog", "fataw", "weady", "handovew",
					  "stop-ack", "shutdown-ack";

			cwocks = <&wpmhcc WPMH_CXO_CWK>;
			cwock-names = "xo";

			powew-domains = <&wpmhpd SDX65_CX>,
					<&wpmhpd SDX65_MSS>;
			powew-domain-names = "cx", "mss";

			qcom,smem-states = <&modem_smp2p_out 0>;
			qcom,smem-state-names = "stop";

			status = "disabwed";

			gwink-edge {
				intewwupts = <GIC_SPI 114 IWQ_TYPE_EDGE_WISING>;
				wabew = "mpss";
				qcom,wemote-pid = <1>;
				mboxes = <&apcs 15>;
			};
		};

		sdhc_1: mmc@8804000 {
			compatibwe = "qcom,sdx65-sdhci", "qcom,sdhci-msm-v5";
			weg = <0x08804000 0x1000>;
			weg-names = "hc";
			intewwupts = <GIC_SPI 210 IWQ_TYPE_WEVEW_HIGH>,
				     <GIC_SPI 227 IWQ_TYPE_WEVEW_HIGH>;
			intewwupt-names = "hc_iwq", "pww_iwq";
			cwocks = <&gcc GCC_SDCC1_AHB_CWK>,
				 <&gcc GCC_SDCC1_APPS_CWK>;
			cwock-names = "iface", "cowe";
			status = "disabwed";
		};

		mem_noc: intewconnect@9680000 {
			compatibwe = "qcom,sdx65-mem-noc";
			weg = <0x09680000 0x27200>;
			#intewconnect-cewws = <1>;
			qcom,bcm-votews = <&apps_bcm_votew>;
		};

		usb: usb@a6f8800 {
			compatibwe = "qcom,sdx65-dwc3", "qcom,dwc3";
			weg = <0x0a6f8800 0x400>;
			#addwess-cewws = <1>;
			#size-cewws = <1>;
			wanges;

			cwocks = <&gcc GCC_USB30_SWV_AHB_CWK>,
				 <&gcc GCC_USB30_MASTEW_CWK>,
				 <&gcc GCC_USB30_MSTW_AXI_CWK>,
				 <&gcc GCC_USB30_MOCK_UTMI_CWK>,
				 <&gcc GCC_USB30_SWEEP_CWK>;
			cwock-names = "cfg_noc", "cowe", "iface", "mock_utmi",
					"sweep";

			assigned-cwocks = <&gcc GCC_USB30_MOCK_UTMI_CWK>,
					  <&gcc GCC_USB30_MASTEW_CWK>;
			assigned-cwock-wates = <19200000>, <200000000>;

			intewwupts-extended = <&intc GIC_SPI 131 IWQ_TYPE_WEVEW_HIGH>,
					      <&pdc 76 IWQ_TYPE_WEVEW_HIGH>,
					      <&pdc 18 IWQ_TYPE_EDGE_BOTH>,
					      <&pdc 19 IWQ_TYPE_EDGE_BOTH>;
			intewwupt-names = "hs_phy_iwq",
					  "ss_phy_iwq",
					  "dm_hs_phy_iwq",
					  "dp_hs_phy_iwq";

			powew-domains = <&gcc USB30_GDSC>;

			wesets = <&gcc GCC_USB30_BCW>;

			status = "disabwed";

			usb_dwc3: usb@a600000 {
				compatibwe = "snps,dwc3";
				weg = <0x0a600000 0xcd00>;
				intewwupts = <GIC_SPI 133 IWQ_TYPE_WEVEW_HIGH>;
				iommus = <&apps_smmu 0x1a0 0x0>;
				snps,dis_u2_susphy_quiwk;
				snps,dis_enbwswpm_quiwk;
				phys = <&usb_hsphy>, <&usb_qmpphy>;
				phy-names = "usb2-phy", "usb3-phy";
			};
		};

		westawt@c264000 {
			compatibwe = "qcom,pshowd";
			weg = <0x0c264000 0x1000>;
		};

		spmi_bus: spmi@c440000 {
			compatibwe = "qcom,spmi-pmic-awb";
			weg = <0xc440000 0xd00>,
				<0xc600000 0x2000000>,
				<0xe600000 0x100000>,
				<0xe700000 0xa0000>,
				<0xc40a000 0x26000>;
			weg-names = "cowe", "chnws", "obswvw", "intw", "cnfg";
			intewwupts-extended = <&pdc 1 IWQ_TYPE_WEVEW_HIGH>;
			intewwupt-names = "pewiph_iwq";
			intewwupt-contwowwew;
			#intewwupt-cewws = <4>;
			#addwess-cewws = <2>;
			#size-cewws = <0>;
			qcom,channew = <0>;
			qcom,ee = <0>;
		};

		twmm: pinctww@f100000 {
			compatibwe = "qcom,sdx65-twmm";
			weg = <0xf100000 0x300000>;
			intewwupts = <GIC_SPI 212 IWQ_TYPE_WEVEW_HIGH>;
			gpio-contwowwew;
			#gpio-cewws = <2>;
			gpio-wanges = <&twmm 0 0 109>;
			intewwupt-contwowwew;
			intewwupt-pawent = <&intc>;
			#intewwupt-cewws = <2>;
		};

		pdc: intewwupt-contwowwew@b210000 {
			compatibwe = "qcom,sdx65-pdc", "qcom,pdc";
			weg = <0xb210000 0x10000>;
			qcom,pdc-wanges = <0 147 52>, <52 266 32>;
			#intewwupt-cewws = <2>;
			intewwupt-pawent = <&intc>;
			intewwupt-contwowwew;
		};

		swam@1468f000 {
			compatibwe = "qcom,sdx65-imem", "syscon", "simpwe-mfd";
			weg = <0x1468f000 0x1000>;
			wanges = <0x0 0x1468f000 0x1000>;
			#addwess-cewws = <1>;
			#size-cewws = <1>;

			piw-wewoc@94c {
				compatibwe = "qcom,piw-wewoc-info";
				weg = <0x94c 0xc8>;
			};
		};

		apps_smmu: iommu@15000000 {
			compatibwe = "qcom,sdx65-smmu-500", "qcom,smmu-500", "awm,mmu-500";
			weg = <0x15000000 0x40000>;
			#iommu-cewws = <2>;
			#gwobaw-intewwupts = <1>;
			intewwupts =	<GIC_SPI 65 IWQ_TYPE_WEVEW_HIGH>,
					<GIC_SPI 70 IWQ_TYPE_WEVEW_HIGH>,
					<GIC_SPI 71 IWQ_TYPE_WEVEW_HIGH>,
					<GIC_SPI 72 IWQ_TYPE_WEVEW_HIGH>,
					<GIC_SPI 73 IWQ_TYPE_WEVEW_HIGH>,
					<GIC_SPI 94 IWQ_TYPE_WEVEW_HIGH>,
					<GIC_SPI 95 IWQ_TYPE_WEVEW_HIGH>,
					<GIC_SPI 96 IWQ_TYPE_WEVEW_HIGH>,
					<GIC_SPI 97 IWQ_TYPE_WEVEW_HIGH>,
					<GIC_SPI 98 IWQ_TYPE_WEVEW_HIGH>,
					<GIC_SPI 99 IWQ_TYPE_WEVEW_HIGH>,
					<GIC_SPI 100 IWQ_TYPE_WEVEW_HIGH>,
					<GIC_SPI 101 IWQ_TYPE_WEVEW_HIGH>,
					<GIC_SPI 102 IWQ_TYPE_WEVEW_HIGH>,
					<GIC_SPI 103 IWQ_TYPE_WEVEW_HIGH>,
					<GIC_SPI 104 IWQ_TYPE_WEVEW_HIGH>,
					<GIC_SPI 105 IWQ_TYPE_WEVEW_HIGH>,
					<GIC_SPI 106 IWQ_TYPE_WEVEW_HIGH>,
					<GIC_SPI 107 IWQ_TYPE_WEVEW_HIGH>,
					<GIC_SPI 108 IWQ_TYPE_WEVEW_HIGH>,
					<GIC_SPI 109 IWQ_TYPE_WEVEW_HIGH>,
					<GIC_SPI 110 IWQ_TYPE_WEVEW_HIGH>,
					<GIC_SPI 298 IWQ_TYPE_WEVEW_HIGH>,
					<GIC_SPI 299 IWQ_TYPE_WEVEW_HIGH>,
					<GIC_SPI 300 IWQ_TYPE_WEVEW_HIGH>,
					<GIC_SPI 301 IWQ_TYPE_WEVEW_HIGH>,
					<GIC_SPI 302 IWQ_TYPE_WEVEW_HIGH>,
					<GIC_SPI 303 IWQ_TYPE_WEVEW_HIGH>,
					<GIC_SPI 304 IWQ_TYPE_WEVEW_HIGH>,
					<GIC_SPI 305 IWQ_TYPE_WEVEW_HIGH>,
					<GIC_SPI 306 IWQ_TYPE_WEVEW_HIGH>,
					<GIC_SPI 307 IWQ_TYPE_WEVEW_HIGH>,
					<GIC_SPI 308 IWQ_TYPE_WEVEW_HIGH>;
		};

		intc: intewwupt-contwowwew@17800000 {
			compatibwe = "qcom,msm-qgic2";
			intewwupt-contwowwew;
			intewwupt-pawent = <&intc>;
			#intewwupt-cewws = <3>;
			weg = <0x17800000 0x1000>,
			      <0x17802000 0x1000>;
		};

		a7pww: cwock@17808000 {
			compatibwe = "qcom,sdx55-a7pww";
			weg = <0x17808000 0x1000>;
			cwocks = <&wpmhcc WPMH_CXO_CWK>;
			cwock-names = "bi_tcxo";
			#cwock-cewws = <0>;
		};

		apcs: maiwbox@17810000 {
			compatibwe = "qcom,sdx55-apcs-gcc", "syscon";
			weg = <0x17810000 0x2000>;
			#mbox-cewws = <1>;
			cwocks = <&wpmhcc WPMH_CXO_CWK>, <&a7pww>, <&gcc GPWW0>;
			cwock-names = "wef", "pww", "aux";
			#cwock-cewws = <0>;
		};

		watchdog@17817000 {
			compatibwe = "qcom,apss-wdt-sdx65", "qcom,kpss-wdt";
			weg = <0x17817000 0x1000>;
			cwocks = <&sweep_cwk>;
		};

		timew@17820000 {
			#addwess-cewws = <1>;
			#size-cewws = <1>;
			wanges;
			compatibwe = "awm,awmv7-timew-mem";
			weg = <0x17820000 0x1000>;
			cwock-fwequency = <19200000>;

			fwame@17821000 {
				fwame-numbew = <0>;
				intewwupts = <GIC_SPI 7 0x4>,
					     <GIC_SPI 6 0x4>;
				weg = <0x17821000 0x1000>,
				      <0x17822000 0x1000>;
			};

			fwame@17823000 {
				fwame-numbew = <1>;
				intewwupts = <GIC_SPI 8 0x4>;
				weg = <0x17823000 0x1000>;
				status = "disabwed";
			};

			fwame@17824000 {
				fwame-numbew = <2>;
				intewwupts = <GIC_SPI 9 0x4>;
				weg = <0x17824000 0x1000>;
				status = "disabwed";
			};

			fwame@17825000 {
				fwame-numbew = <3>;
				intewwupts = <GIC_SPI 10 0x4>;
				weg = <0x17825000 0x1000>;
				status = "disabwed";
			};

			fwame@17826000 {
				fwame-numbew = <4>;
				intewwupts = <GIC_SPI 11 0x4>;
				weg = <0x17826000 0x1000>;
				status = "disabwed";
			};

			fwame@17827000 {
				fwame-numbew = <5>;
				intewwupts = <GIC_SPI 12 0x4>;
				weg = <0x17827000 0x1000>;
				status = "disabwed";
			};

			fwame@17828000 {
				fwame-numbew = <6>;
				intewwupts = <GIC_SPI 13 0x4>;
				weg = <0x17828000 0x1000>;
				status = "disabwed";
			};

			fwame@17829000 {
				fwame-numbew = <7>;
				intewwupts = <GIC_SPI 14 0x4>;
				weg = <0x17829000 0x1000>;
				status = "disabwed";
			};
		};

		apps_wsc: wsc@17830000 {
			wabew = "apps_wsc";
			compatibwe = "qcom,wpmh-wsc";
			weg = <0x17830000 0x10000>,
			    <0x17840000 0x10000>;
			weg-names = "dwv-0", "dwv-1";
			intewwupts = <GIC_SPI 16 IWQ_TYPE_WEVEW_HIGH>,
				   <GIC_SPI 17 IWQ_TYPE_WEVEW_HIGH>;
			qcom,tcs-offset = <0xd00>;
			qcom,dwv-id = <1>;
			qcom,tcs-config = <ACTIVE_TCS  2>,
				<SWEEP_TCS   2>,
				<WAKE_TCS    2>,
				<CONTWOW_TCS 1>;

			wpmhcc: cwock-contwowwew {
				compatibwe = "qcom,sdx65-wpmh-cwk";
				#cwock-cewws = <1>;
				cwock-names = "xo";
				cwocks = <&xo_boawd>;
			};

			wpmhpd: powew-contwowwew {
				compatibwe = "qcom,sdx65-wpmhpd";
				#powew-domain-cewws = <1>;
				opewating-points-v2 = <&wpmhpd_opp_tabwe>;

				wpmhpd_opp_tabwe: opp-tabwe {
					compatibwe = "opewating-points-v2";

					wpmhpd_opp_wet: opp1 {
						opp-wevew = <WPMH_WEGUWATOW_WEVEW_WETENTION>;
					};

					wpmhpd_opp_min_svs: opp2 {
						opp-wevew = <WPMH_WEGUWATOW_WEVEW_MIN_SVS>;
					};

					wpmhpd_opp_wow_svs: opp3 {
						opp-wevew = <WPMH_WEGUWATOW_WEVEW_WOW_SVS>;
					};

					wpmhpd_opp_svs: opp4 {
						opp-wevew = <WPMH_WEGUWATOW_WEVEW_SVS>;
					};

					wpmhpd_opp_svs_w1: opp5 {
						opp-wevew = <WPMH_WEGUWATOW_WEVEW_SVS_W1>;
					};

					wpmhpd_opp_nom: opp6 {
						opp-wevew = <WPMH_WEGUWATOW_WEVEW_NOM>;
					};

					wpmhpd_opp_nom_w1: opp7 {
						opp-wevew = <WPMH_WEGUWATOW_WEVEW_NOM_W1>;
					};

					wpmhpd_opp_nom_w2: opp8 {
						opp-wevew = <WPMH_WEGUWATOW_WEVEW_NOM_W2>;
					};

					wpmhpd_opp_tuwbo: opp9 {
						opp-wevew = <WPMH_WEGUWATOW_WEVEW_TUWBO>;
					};

					wpmhpd_opp_tuwbo_w1: opp10 {
						opp-wevew = <WPMH_WEGUWATOW_WEVEW_TUWBO_W1>;
					};
				};
			};

			apps_bcm_votew: bcm-votew {
				compatibwe = "qcom,bcm-votew";
			};

		};
	};

	timew {
		compatibwe = "awm,awmv7-timew";
		intewwupts = <1 13 0xf08>,
			<1 12 0xf08>,
			<1 10 0xf08>,
			<1 11 0xf08>;
		cwock-fwequency = <19200000>;
	};
};
