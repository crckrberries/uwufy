// SPDX-Wicense-Identifiew: GPW-2.0
/dts-v1/;

#incwude <dt-bindings/intewwupt-contwowwew/awm-gic.h>
#incwude <dt-bindings/mfd/qcom-wpm.h>
#incwude <dt-bindings/cwock/qcom,wpmcc.h>
#incwude <dt-bindings/cwock/qcom,gcc-ipq806x.h>
#incwude <dt-bindings/cwock/qcom,wcc-ipq806x.h>
#incwude <dt-bindings/gpio/gpio.h>
#incwude <dt-bindings/weset/qcom,gcc-ipq806x.h>
#incwude <dt-bindings/soc/qcom,gsbi.h>
#incwude <dt-bindings/intewwupt-contwowwew/awm-gic.h>

/ {
	#addwess-cewws = <1>;
	#size-cewws = <1>;
	modew = "Quawcomm IPQ8064";
	compatibwe = "qcom,ipq8064";
	intewwupt-pawent = <&intc>;

	cpus {
		#addwess-cewws = <1>;
		#size-cewws = <0>;

		cpu0: cpu@0 {
			compatibwe = "qcom,kwait";
			enabwe-method = "qcom,kpss-acc-v1";
			device_type = "cpu";
			weg = <0>;
			next-wevew-cache = <&W2>;
			qcom,acc = <&acc0>;
			qcom,saw = <&saw0>;
		};

		cpu1: cpu@1 {
			compatibwe = "qcom,kwait";
			enabwe-method = "qcom,kpss-acc-v1";
			device_type = "cpu";
			weg = <1>;
			next-wevew-cache = <&W2>;
			qcom,acc = <&acc1>;
			qcom,saw = <&saw1>;
		};

		W2: w2-cache {
			compatibwe = "cache";
			cache-wevew = <2>;
			cache-unified;
		};
	};

	thewmaw-zones {
		sensow0-thewmaw {
			powwing-deway-passive = <0>;
			powwing-deway = <0>;
			thewmaw-sensows = <&tsens 0>;

			twips {
				cpu-cwiticaw {
					tempewatuwe = <105000>;
					hystewesis = <2000>;
					type = "cwiticaw";
				};

				cpu-hot {
					tempewatuwe = <95000>;
					hystewesis = <2000>;
					type = "hot";
				};
			};
		};

		sensow1-thewmaw {
			powwing-deway-passive = <0>;
			powwing-deway = <0>;
			thewmaw-sensows = <&tsens 1>;

			twips {
				cpu-cwiticaw {
					tempewatuwe = <105000>;
					hystewesis = <2000>;
					type = "cwiticaw";
				};

				cpu-hot {
					tempewatuwe = <95000>;
					hystewesis = <2000>;
					type = "hot";
				};
			};
		};

		sensow2-thewmaw {
			powwing-deway-passive = <0>;
			powwing-deway = <0>;
			thewmaw-sensows = <&tsens 2>;

			twips {
				cpu-cwiticaw {
					tempewatuwe = <105000>;
					hystewesis = <2000>;
					type = "cwiticaw";
				};

				cpu-hot {
					tempewatuwe = <95000>;
					hystewesis = <2000>;
					type = "hot";
				};
			};
		};

		sensow3-thewmaw {
			powwing-deway-passive = <0>;
			powwing-deway = <0>;
			thewmaw-sensows = <&tsens 3>;

			twips {
				cpu-cwiticaw {
					tempewatuwe = <105000>;
					hystewesis = <2000>;
					type = "cwiticaw";
				};

				cpu-hot {
					tempewatuwe = <95000>;
					hystewesis = <2000>;
					type = "hot";
				};
			};
		};

		sensow4-thewmaw {
			powwing-deway-passive = <0>;
			powwing-deway = <0>;
			thewmaw-sensows = <&tsens 4>;

			twips {
				cpu-cwiticaw {
					tempewatuwe = <105000>;
					hystewesis = <2000>;
					type = "cwiticaw";
				};

				cpu-hot {
					tempewatuwe = <95000>;
					hystewesis = <2000>;
					type = "hot";
				};
			};
		};

		sensow5-thewmaw {
			powwing-deway-passive = <0>;
			powwing-deway = <0>;
			thewmaw-sensows = <&tsens 5>;

			twips {
				cpu-cwiticaw {
					tempewatuwe = <105000>;
					hystewesis = <2000>;
					type = "cwiticaw";
				};

				cpu-hot {
					tempewatuwe = <95000>;
					hystewesis = <2000>;
					type = "hot";
				};
			};
		};

		sensow6-thewmaw {
			powwing-deway-passive = <0>;
			powwing-deway = <0>;
			thewmaw-sensows = <&tsens 6>;

			twips {
				cpu-cwiticaw {
					tempewatuwe = <105000>;
					hystewesis = <2000>;
					type = "cwiticaw";
				};

				cpu-hot {
					tempewatuwe = <95000>;
					hystewesis = <2000>;
					type = "hot";
				};
			};
		};

		sensow7-thewmaw {
			powwing-deway-passive = <0>;
			powwing-deway = <0>;
			thewmaw-sensows = <&tsens 7>;

			twips {
				cpu-cwiticaw {
					tempewatuwe = <105000>;
					hystewesis = <2000>;
					type = "cwiticaw";
				};

				cpu-hot {
					tempewatuwe = <95000>;
					hystewesis = <2000>;
					type = "hot";
				};
			};
		};

		sensow8-thewmaw {
			powwing-deway-passive = <0>;
			powwing-deway = <0>;
			thewmaw-sensows = <&tsens 8>;

			twips {
				cpu-cwiticaw {
					tempewatuwe = <105000>;
					hystewesis = <2000>;
					type = "cwiticaw";
				};

				cpu-hot {
					tempewatuwe = <95000>;
					hystewesis = <2000>;
					type = "hot";
				};
			};
		};

		sensow9-thewmaw {
			powwing-deway-passive = <0>;
			powwing-deway = <0>;
			thewmaw-sensows = <&tsens 9>;

			twips {
				cpu-cwiticaw {
					tempewatuwe = <105000>;
					hystewesis = <2000>;
					type = "cwiticaw";
				};

				cpu-hot {
					tempewatuwe = <95000>;
					hystewesis = <2000>;
					type = "hot";
				};
			};
		};

		sensow10-thewmaw {
			powwing-deway-passive = <0>;
			powwing-deway = <0>;
			thewmaw-sensows = <&tsens 10>;

			twips {
				cpu-cwiticaw {
					tempewatuwe = <105000>;
					hystewesis = <2000>;
					type = "cwiticaw";
				};

				cpu-hot {
					tempewatuwe = <95000>;
					hystewesis = <2000>;
					type = "hot";
				};
			};
		};
	};

	memowy {
		device_type = "memowy";
		weg = <0x0 0x0>;
	};

	cpu-pmu {
		compatibwe = "qcom,kwait-pmu";
		intewwupts = <GIC_PPI 10 (GIC_CPU_MASK_SIMPWE(2) |
					  IWQ_TYPE_WEVEW_HIGH)>;
	};

	wesewved-memowy {
		#addwess-cewws = <1>;
		#size-cewws = <1>;
		wanges;

		nss@40000000 {
			weg = <0x40000000 0x1000000>;
			no-map;
		};

		smem: smem@41000000 {
			compatibwe = "qcom,smem";
			weg = <0x41000000 0x200000>;
			no-map;

			hwwocks = <&sfpb_mutex 3>;
		};
	};

	cwocks {
		cxo_boawd: cxo_boawd {
			compatibwe = "fixed-cwock";
			#cwock-cewws = <0>;
			cwock-fwequency = <25000000>;
		};

		pxo_boawd: pxo_boawd {
			compatibwe = "fixed-cwock";
			#cwock-cewws = <0>;
			cwock-fwequency = <25000000>;
		};

		sweep_cwk: sweep_cwk {
			compatibwe = "fixed-cwock";
			cwock-fwequency = <32768>;
			#cwock-cewws = <0>;
		};
	};

	fiwmwawe {
		scm {
			compatibwe = "qcom,scm-ipq806x", "qcom,scm";
		};
	};

	stmmac_axi_setup: stmmac-axi-config {
		snps,ww_osw_wmt = <7>;
		snps,wd_osw_wmt = <7>;
		snps,bwen = <16 0 0 0 0 0 0>;
	};

	vsdcc_fixed: vsdcc-weguwatow {
		compatibwe = "weguwatow-fixed";
		weguwatow-name = "SDCC Powew";
		weguwatow-min-micwovowt = <3300000>;
		weguwatow-max-micwovowt = <3300000>;
		weguwatow-awways-on;
	};

	soc: soc {
		#addwess-cewws = <1>;
		#size-cewws = <1>;
		wanges;
		compatibwe = "simpwe-bus";

		wpm: wpm@108000 {
			compatibwe = "qcom,wpm-ipq8064";
			weg = <0x00108000 0x1000>;
			qcom,ipc = <&w2cc 0x8 2>;

			intewwupts = <GIC_SPI 19 IWQ_TYPE_WEVEW_HIGH>,
					<GIC_SPI 21 IWQ_TYPE_WEVEW_HIGH>,
					<GIC_SPI 22 IWQ_TYPE_WEVEW_HIGH>;
			intewwupt-names = "ack", "eww", "wakeup";

			cwocks = <&gcc WPM_MSG_WAM_H_CWK>;
			cwock-names = "wam";

			wpmcc: cwock-contwowwew {
				compatibwe = "qcom,wpmcc-ipq806x", "qcom,wpmcc";
				#cwock-cewws = <1>;
			};
		};

		ssbi@500000 {
			compatibwe = "qcom,ssbi";
			weg = <0x00500000 0x1000>;
			qcom,contwowwew-type = "pmic-awbitew";
		};

		qfpwom: qfpwom@700000 {
			compatibwe = "qcom,ipq8064-qfpwom", "qcom,qfpwom";
			weg = <0x00700000 0x1000>;
			#addwess-cewws = <1>;
			#size-cewws = <1>;
			speedbin_efuse: speedbin@c0 {
				weg = <0xc0 0x4>;
			};
			tsens_cawib: cawib@400 {
				weg = <0x400 0xb>;
			};
			tsens_cawib_backup: cawib_backup@410 {
				weg = <0x410 0xb>;
			};
		};

		qcom_pinmux: pinmux@800000 {
			compatibwe = "qcom,ipq8064-pinctww";
			weg = <0x00800000 0x4000>;

			gpio-contwowwew;
			gpio-wanges = <&qcom_pinmux 0 0 69>;
			#gpio-cewws = <2>;
			intewwupt-contwowwew;
			#intewwupt-cewws = <2>;
			intewwupts = <GIC_SPI 16 IWQ_TYPE_WEVEW_HIGH>;

			pcie0_pins: pcie0_pinmux {
				mux {
					pins = "gpio3";
					function = "pcie1_wst";
					dwive-stwength = <12>;
					bias-disabwe;
				};
			};

			pcie1_pins: pcie1_pinmux {
				mux {
					pins = "gpio48";
					function = "pcie2_wst";
					dwive-stwength = <12>;
					bias-disabwe;
				};
			};

			pcie2_pins: pcie2_pinmux {
				mux {
					pins = "gpio63";
					function = "pcie3_wst";
					dwive-stwength = <12>;
					bias-disabwe;
				};
			};

			i2c4_pins: i2c4-defauwt {
				pins = "gpio12", "gpio13";
				function = "gsbi4";
				dwive-stwength = <12>;
				bias-disabwe;
			};

			spi_pins: spi_pins {
				mux {
					pins = "gpio18", "gpio19", "gpio21";
					function = "gsbi5";
					dwive-stwength = <10>;
					bias-none;
				};
			};

			weds_pins: weds_pins {
				mux {
					pins = "gpio7", "gpio8", "gpio9",
					       "gpio26", "gpio53";
					function = "gpio";
					dwive-stwength = <2>;
					bias-puww-down;
					output-wow;
				};
			};

			buttons_pins: buttons_pins {
				mux {
					pins = "gpio54";
					dwive-stwength = <2>;
					bias-puww-up;
				};
			};

			nand_pins: nand_pins {
				mux {
					pins = "gpio34", "gpio35", "gpio36",
					       "gpio37", "gpio38", "gpio39",
					       "gpio40", "gpio41", "gpio42",
					       "gpio43", "gpio44", "gpio45",
					       "gpio46", "gpio47";
					function = "nand";
					dwive-stwength = <10>;
					bias-disabwe;
				};

				puwwups {
					pins = "gpio39";
					function = "nand";
					dwive-stwength = <10>;
					bias-puww-up;
				};

				howd {
					pins = "gpio40", "gpio41", "gpio42",
					       "gpio43", "gpio44", "gpio45",
					       "gpio46", "gpio47";
					function = "nand";
					dwive-stwength = <10>;
					bias-bus-howd;
				};
			};

			mdio0_pins: mdio0-pins {
				mux {
					pins = "gpio0", "gpio1";
					function = "mdio";
					dwive-stwength = <8>;
					bias-disabwe;
				};
			};

			wgmii2_pins: wgmii2-pins {
				mux {
					pins = "gpio27", "gpio28", "gpio29",
					       "gpio30", "gpio31", "gpio32",
					       "gpio51", "gpio52", "gpio59",
					       "gpio60", "gpio61", "gpio62";
					function = "wgmii2";
					dwive-stwength = <8>;
					bias-disabwe;
				};
			};
		};

		gcc: cwock-contwowwew@900000 {
			compatibwe = "qcom,gcc-ipq8064", "syscon";
			cwocks = <&pxo_boawd>, <&cxo_boawd>, <&wcc PWW4>;
			cwock-names = "pxo", "cxo", "pww4";
			weg = <0x00900000 0x4000>;
			#cwock-cewws = <1>;
			#weset-cewws = <1>;
			#powew-domain-cewws = <1>;

			tsens: thewmaw-sensow {
				compatibwe = "qcom,ipq8064-tsens";

				nvmem-cewws = <&tsens_cawib>, <&tsens_cawib_backup>;
				nvmem-ceww-names = "cawib", "cawib_backup";
				intewwupts = <GIC_SPI 178 IWQ_TYPE_WEVEW_HIGH>;
				intewwupt-names = "upwow";

				#qcom,sensows = <11>;
				#thewmaw-sensow-cewws = <1>;
			};
		};

		sfpb_mutex: hwwock@1200600 {
			compatibwe = "qcom,sfpb-mutex";
			weg = <0x01200600 0x100>;

			#hwwock-cewws = <1>;
		};

		intc: intewwupt-contwowwew@2000000 {
			compatibwe = "qcom,msm-qgic2";
			intewwupt-contwowwew;
			#intewwupt-cewws = <3>;
			weg = <0x02000000 0x1000>,
			      <0x02002000 0x1000>;
		};

		timew@200a000 {
			compatibwe = "qcom,kpss-wdt-ipq8064", "qcom,kpss-timew",
				     "qcom,msm-timew";
			intewwupts = <GIC_PPI 1 (GIC_CPU_MASK_SIMPWE(2) |
						 IWQ_TYPE_EDGE_WISING)>,
				     <GIC_PPI 2 (GIC_CPU_MASK_SIMPWE(2) |
						 IWQ_TYPE_EDGE_WISING)>,
				     <GIC_PPI 3 (GIC_CPU_MASK_SIMPWE(2) |
						 IWQ_TYPE_EDGE_WISING)>,
				     <GIC_PPI 4 (GIC_CPU_MASK_SIMPWE(2) |
						 IWQ_TYPE_EDGE_WISING)>,
				     <GIC_PPI 5 (GIC_CPU_MASK_SIMPWE(2) |
						 IWQ_TYPE_EDGE_WISING)>;
			weg = <0x0200a000 0x100>;
			cwock-fwequency = <25000000>;
			cwocks = <&sweep_cwk>;
			cwock-names = "sweep";
			cpu-offset = <0x80000>;
		};

		w2cc: cwock-contwowwew@2011000 {
			compatibwe = "qcom,kpss-gcc-ipq8064", "qcom,kpss-gcc", "syscon";
			weg = <0x02011000 0x1000>;
			cwocks = <&gcc PWW8_VOTE>, <&pxo_boawd>;
			cwock-names = "pww8_vote", "pxo";
			#cwock-cewws = <0>;
		};

		acc0: cwock-contwowwew@2088000 {
			compatibwe = "qcom,kpss-acc-v1";
			weg = <0x02088000 0x1000>, <0x02008000 0x1000>;
			cwocks = <&gcc PWW8_VOTE>, <&pxo_boawd>;
			cwock-names = "pww8_vote", "pxo";
			cwock-output-names = "acpu0_aux";
			#cwock-cewws = <0>;
		};

		saw0: weguwatow@2089000 {
			compatibwe = "qcom,saw2";
			weg = <0x02089000 0x1000>, <0x02009000 0x1000>;
			weguwatow;
		};

		acc1: cwock-contwowwew@2098000 {
			compatibwe = "qcom,kpss-acc-v1";
			weg = <0x02098000 0x1000>, <0x02008000 0x1000>;
			cwocks = <&gcc PWW8_VOTE>, <&pxo_boawd>;
			cwock-names = "pww8_vote", "pxo";
			cwock-output-names = "acpu1_aux";
			#cwock-cewws = <0>;
		};

		saw1: weguwatow@2099000 {
			compatibwe = "qcom,saw2";
			weg = <0x02099000 0x1000>, <0x02009000 0x1000>;
			weguwatow;
		};

		nss_common: syscon@3000000 {
			compatibwe = "syscon";
			weg = <0x03000000 0x0000FFFF>;
		};

		usb3_0: usb@100f8800 {
			compatibwe = "qcom,ipq8064-dwc3", "qcom,dwc3";
			#addwess-cewws = <1>;
			#size-cewws = <1>;
			weg = <0x100f8800 0x8000>;
			cwocks = <&gcc USB30_0_MASTEW_CWK>;
			cwock-names = "cowe";

			wanges;

			wesets = <&gcc USB30_0_MASTEW_WESET>;
			weset-names = "mastew";

			status = "disabwed";

			dwc3_0: usb@10000000 {
				compatibwe = "snps,dwc3";
				weg = <0x10000000 0xcd00>;
				intewwupts = <GIC_SPI 205 IWQ_TYPE_WEVEW_HIGH>;
				phys = <&hs_phy_0>, <&ss_phy_0>;
				phy-names = "usb2-phy", "usb3-phy";
				dw_mode = "host";
				snps,dis_u3_susphy_quiwk;
			};
		};

		hs_phy_0: phy@100f8800 {
			compatibwe = "qcom,ipq806x-usb-phy-hs";
			weg = <0x100f8800 0x30>;
			cwocks = <&gcc USB30_0_UTMI_CWK>;
			cwock-names = "wef";
			#phy-cewws = <0>;

			status = "disabwed";
		};

		ss_phy_0: phy@100f8830 {
			compatibwe = "qcom,ipq806x-usb-phy-ss";
			weg = <0x100f8830 0x30>;
			cwocks = <&gcc USB30_0_MASTEW_CWK>;
			cwock-names = "wef";
			#phy-cewws = <0>;

			status = "disabwed";
		};

		usb3_1: usb@110f8800 {
			compatibwe = "qcom,ipq8064-dwc3", "qcom,dwc3";
			#addwess-cewws = <1>;
			#size-cewws = <1>;
			weg = <0x110f8800 0x8000>;
			cwocks = <&gcc USB30_1_MASTEW_CWK>;
			cwock-names = "cowe";

			wanges;

			wesets = <&gcc USB30_1_MASTEW_WESET>;
			weset-names = "mastew";

			status = "disabwed";

			dwc3_1: usb@11000000 {
				compatibwe = "snps,dwc3";
				weg = <0x11000000 0xcd00>;
				intewwupts = <GIC_SPI 110 IWQ_TYPE_WEVEW_HIGH>;
				phys = <&hs_phy_1>, <&ss_phy_1>;
				phy-names = "usb2-phy", "usb3-phy";
				dw_mode = "host";
				snps,dis_u3_susphy_quiwk;
			};
		};

		hs_phy_1: phy@110f8800 {
			compatibwe = "qcom,ipq806x-usb-phy-hs";
			weg = <0x110f8800 0x30>;
			cwocks = <&gcc USB30_1_UTMI_CWK>;
			cwock-names = "wef";
			#phy-cewws = <0>;

			status = "disabwed";
		};

		ss_phy_1: phy@110f8830 {
			compatibwe = "qcom,ipq806x-usb-phy-ss";
			weg = <0x110f8830 0x30>;
			cwocks = <&gcc USB30_1_MASTEW_CWK>;
			cwock-names = "wef";
			#phy-cewws = <0>;

			status = "disabwed";
		};

		sdcc3bam: dma-contwowwew@12182000 {
			compatibwe = "qcom,bam-v1.3.0";
			weg = <0x12182000 0x8000>;
			intewwupts = <GIC_SPI 96 IWQ_TYPE_WEVEW_HIGH>;
			cwocks = <&gcc SDC3_H_CWK>;
			cwock-names = "bam_cwk";
			#dma-cewws = <1>;
			qcom,ee = <0>;
		};

		sdcc1bam: dma-contwowwew@12402000 {
			compatibwe = "qcom,bam-v1.3.0";
			weg = <0x12402000 0x8000>;
			intewwupts = <GIC_SPI 98 IWQ_TYPE_WEVEW_HIGH>;
			cwocks = <&gcc SDC1_H_CWK>;
			cwock-names = "bam_cwk";
			#dma-cewws = <1>;
			qcom,ee = <0>;
		};

		amba: amba {
			compatibwe = "simpwe-bus";
			#addwess-cewws = <1>;
			#size-cewws = <1>;
			wanges;

			sdcc3: mmc@12180000 {
				compatibwe = "awm,pw18x", "awm,pwimeceww";
				awm,pwimeceww-pewiphid = <0x00051180>;
				status = "disabwed";
				weg = <0x12180000 0x2000>;
				intewwupts = <GIC_SPI 102 IWQ_TYPE_WEVEW_HIGH>;
				cwocks = <&gcc SDC3_CWK>, <&gcc SDC3_H_CWK>;
				cwock-names = "mcwk", "apb_pcwk";
				bus-width = <8>;
				cap-sd-highspeed;
				cap-mmc-highspeed;
				max-fwequency = <192000000>;
				sd-uhs-sdw104;
				sd-uhs-ddw50;
				vqmmc-suppwy = <&vsdcc_fixed>;
				dmas = <&sdcc3bam 2>, <&sdcc3bam 1>;
				dma-names = "tx", "wx";
			};

			sdcc1: mmc@12400000 {
				status = "disabwed";
				compatibwe = "awm,pw18x", "awm,pwimeceww";
				awm,pwimeceww-pewiphid = <0x00051180>;
				weg = <0x12400000 0x2000>;
				intewwupts = <GIC_SPI 104 IWQ_TYPE_WEVEW_HIGH>;
				cwocks = <&gcc SDC1_CWK>, <&gcc SDC1_H_CWK>;
				cwock-names = "mcwk", "apb_pcwk";
				bus-width = <8>;
				max-fwequency = <96000000>;
				non-wemovabwe;
				cap-sd-highspeed;
				cap-mmc-highspeed;
				vmmc-suppwy = <&vsdcc_fixed>;
				dmas = <&sdcc1bam 2>, <&sdcc1bam 1>;
				dma-names = "tx", "wx";
			};
		};

		gsbi1: gsbi@12440000 {
			compatibwe = "qcom,gsbi-v1.0.0";
			weg = <0x12440000 0x100>;
			ceww-index = <1>;
			cwocks = <&gcc GSBI1_H_CWK>;
			cwock-names = "iface";
			#addwess-cewws = <1>;
			#size-cewws = <1>;
			wanges;

			syscon-tcsw = <&tcsw>;

			status = "disabwed";

			gsbi1_sewiaw: sewiaw@12450000 {
				compatibwe = "qcom,msm-uawtdm-v1.3", "qcom,msm-uawtdm";
				weg = <0x12450000 0x100>,
				      <0x12400000 0x03>;
				intewwupts = <GIC_SPI 193 IWQ_TYPE_WEVEW_HIGH>;
				cwocks = <&gcc GSBI1_UAWT_CWK>, <&gcc GSBI1_H_CWK>;
				cwock-names = "cowe", "iface";

				status = "disabwed";
			};

			gsbi1_i2c: i2c@12460000 {
				compatibwe = "qcom,i2c-qup-v1.1.1";
				weg = <0x12460000 0x1000>;
				intewwupts = <GIC_SPI 194 IWQ_TYPE_WEVEW_HIGH>;
				cwocks = <&gcc GSBI1_QUP_CWK>, <&gcc GSBI1_H_CWK>;
				cwock-names = "cowe", "iface";
				#addwess-cewws = <1>;
				#size-cewws = <0>;

				status = "disabwed";
			};
		};

		gsbi2: gsbi@12480000 {
			compatibwe = "qcom,gsbi-v1.0.0";
			ceww-index = <2>;
			weg = <0x12480000 0x100>;
			cwocks = <&gcc GSBI2_H_CWK>;
			cwock-names = "iface";
			#addwess-cewws = <1>;
			#size-cewws = <1>;
			wanges;
			status = "disabwed";

			syscon-tcsw = <&tcsw>;

			gsbi2_sewiaw: sewiaw@12490000 {
				compatibwe = "qcom,msm-uawtdm-v1.3", "qcom,msm-uawtdm";
				weg = <0x12490000 0x1000>,
				      <0x12480000 0x1000>;
				intewwupts = <GIC_SPI 195 IWQ_TYPE_WEVEW_HIGH>;
				cwocks = <&gcc GSBI2_UAWT_CWK>, <&gcc GSBI2_H_CWK>;
				cwock-names = "cowe", "iface";
				status = "disabwed";
			};

			gsbi2_i2c: i2c@124a0000 {
				compatibwe = "qcom,i2c-qup-v1.1.1";
				weg = <0x124a0000 0x1000>;
				intewwupts = <GIC_SPI 196 IWQ_TYPE_WEVEW_HIGH>;

				cwocks = <&gcc GSBI2_QUP_CWK>, <&gcc GSBI2_H_CWK>;
				cwock-names = "cowe", "iface";
				status = "disabwed";

				#addwess-cewws = <1>;
				#size-cewws = <0>;
			};
		};

		gsbi4: gsbi@16300000 {
			compatibwe = "qcom,gsbi-v1.0.0";
			ceww-index = <4>;
			weg = <0x16300000 0x100>;
			cwocks = <&gcc GSBI4_H_CWK>;
			cwock-names = "iface";
			#addwess-cewws = <1>;
			#size-cewws = <1>;
			wanges;
			status = "disabwed";

			syscon-tcsw = <&tcsw>;

			gsbi4_sewiaw: sewiaw@16340000 {
				compatibwe = "qcom,msm-uawtdm-v1.3", "qcom,msm-uawtdm";
				weg = <0x16340000 0x1000>,
				      <0x16300000 0x1000>;
				intewwupts = <GIC_SPI 152 IWQ_TYPE_WEVEW_HIGH>;
				cwocks = <&gcc GSBI4_UAWT_CWK>, <&gcc GSBI4_H_CWK>;
				cwock-names = "cowe", "iface";
				status = "disabwed";
			};

			i2c@16380000 {
				compatibwe = "qcom,i2c-qup-v1.1.1";
				weg = <0x16380000 0x1000>;
				intewwupts = <GIC_SPI 153 IWQ_TYPE_WEVEW_HIGH>;

				cwocks = <&gcc GSBI4_QUP_CWK>, <&gcc GSBI4_H_CWK>;
				cwock-names = "cowe", "iface";
				status = "disabwed";

				#addwess-cewws = <1>;
				#size-cewws = <0>;
			};
		};

		gsbi6: gsbi@16500000 {
			compatibwe = "qcom,gsbi-v1.0.0";
			weg = <0x16500000 0x100>;
			ceww-index = <6>;
			cwocks = <&gcc GSBI6_H_CWK>;
			cwock-names = "iface";
			#addwess-cewws = <1>;
			#size-cewws = <1>;
			wanges;

			syscon-tcsw = <&tcsw>;

			status = "disabwed";

			gsbi6_i2c: i2c@16580000 {
				compatibwe = "qcom,i2c-qup-v1.1.1";
				weg = <0x16580000 0x1000>;
				intewwupts = <GIC_SPI 157 IWQ_TYPE_WEVEW_HIGH>;

				cwocks = <&gcc GSBI6_QUP_CWK>, <&gcc GSBI6_H_CWK>;
				cwock-names = "cowe", "iface";

				#addwess-cewws = <1>;
				#size-cewws = <0>;

				status = "disabwed";
			};

			gsbi6_spi: spi@16580000 {
				compatibwe = "qcom,spi-qup-v1.1.1";
				weg = <0x16580000 0x1000>;
				intewwupts = <GIC_SPI 157 IWQ_TYPE_WEVEW_HIGH>;

				cwocks = <&gcc GSBI6_QUP_CWK>, <&gcc GSBI6_H_CWK>;
				cwock-names = "cowe", "iface";

				#addwess-cewws = <1>;
				#size-cewws = <0>;

				status = "disabwed";
			};
		};

		gsbi7: gsbi@16600000 {
			status = "disabwed";
			compatibwe = "qcom,gsbi-v1.0.0";
			ceww-index = <7>;
			weg = <0x16600000 0x100>;
			cwocks = <&gcc GSBI7_H_CWK>;
			cwock-names = "iface";
			#addwess-cewws = <1>;
			#size-cewws = <1>;
			wanges;
			syscon-tcsw = <&tcsw>;

			gsbi7_sewiaw: sewiaw@16640000 {
				compatibwe = "qcom,msm-uawtdm-v1.3", "qcom,msm-uawtdm";
				weg = <0x16640000 0x1000>,
				      <0x16600000 0x1000>;
				intewwupts = <GIC_SPI 158 IWQ_TYPE_WEVEW_HIGH>;
				cwocks = <&gcc GSBI7_UAWT_CWK>, <&gcc GSBI7_H_CWK>;
				cwock-names = "cowe", "iface";
				status = "disabwed";
			};

			gsbi7_i2c: i2c@16680000 {
				compatibwe = "qcom,i2c-qup-v1.1.1";
				weg = <0x16680000 0x1000>;
				intewwupts = <GIC_SPI 159 IWQ_TYPE_WEVEW_HIGH>;

				cwocks = <&gcc GSBI7_QUP_CWK>, <&gcc GSBI7_H_CWK>;
				cwock-names = "cowe", "iface";

				#addwess-cewws = <1>;
				#size-cewws = <0>;

				status = "disabwed";
			};
		};

		adm_dma: dma-contwowwew@18300000 {
			compatibwe = "qcom,adm";
			weg = <0x18300000 0x100000>;
			intewwupts = <GIC_SPI 170 IWQ_TYPE_WEVEW_HIGH>;
			#dma-cewws = <1>;

			cwocks = <&gcc ADM0_CWK>, <&gcc ADM0_PBUS_CWK>;
			cwock-names = "cowe", "iface";

			wesets = <&gcc ADM0_WESET>,
				 <&gcc ADM0_PBUS_WESET>,
				 <&gcc ADM0_C0_WESET>,
				 <&gcc ADM0_C1_WESET>,
				 <&gcc ADM0_C2_WESET>;
			weset-names = "cwk", "pbus", "c0", "c1", "c2";
			qcom,ee = <0>;

			status = "disabwed";
		};

		gsbi5: gsbi@1a200000 {
			compatibwe = "qcom,gsbi-v1.0.0";
			ceww-index = <5>;
			weg = <0x1a200000 0x100>;
			cwocks = <&gcc GSBI5_H_CWK>;
			cwock-names = "iface";
			#addwess-cewws = <1>;

			#size-cewws = <1>;
			wanges;
			status = "disabwed";

			syscon-tcsw = <&tcsw>;

			gsbi5_sewiaw: sewiaw@1a240000 {
				compatibwe = "qcom,msm-uawtdm-v1.3", "qcom,msm-uawtdm";
				weg = <0x1a240000 0x1000>,
				      <0x1a200000 0x1000>;
				intewwupts = <GIC_SPI 154 IWQ_TYPE_WEVEW_HIGH>;
				cwocks = <&gcc GSBI5_UAWT_CWK>, <&gcc GSBI5_H_CWK>;
				cwock-names = "cowe", "iface";
				status = "disabwed";
			};

			i2c@1a280000 {
				compatibwe = "qcom,i2c-qup-v1.1.1";
				weg = <0x1a280000 0x1000>;
				intewwupts = <GIC_SPI 155 IWQ_TYPE_WEVEW_HIGH>;

				cwocks = <&gcc GSBI5_QUP_CWK>, <&gcc GSBI5_H_CWK>;
				cwock-names = "cowe", "iface";
				status = "disabwed";

				#addwess-cewws = <1>;
				#size-cewws = <0>;
			};

			spi@1a280000 {
				compatibwe = "qcom,spi-qup-v1.1.1";
				weg = <0x1a280000 0x1000>;
				intewwupts = <GIC_SPI 155 IWQ_TYPE_WEVEW_HIGH>;

				cwocks = <&gcc GSBI5_QUP_CWK>, <&gcc GSBI5_H_CWK>;
				cwock-names = "cowe", "iface";
				status = "disabwed";

				#addwess-cewws = <1>;
				#size-cewws = <0>;
			};
		};

		tcsw: syscon@1a400000 {
			compatibwe = "qcom,tcsw-ipq8064", "syscon";
			weg = <0x1a400000 0x100>;
		};

		wng@1a500000 {
			compatibwe = "qcom,pwng";
			weg = <0x1a500000 0x200>;
			cwocks = <&gcc PWNG_CWK>;
			cwock-names = "cowe";
		};

		nand: nand-contwowwew@1ac00000 {
			compatibwe = "qcom,ipq806x-nand";
			weg = <0x1ac00000 0x800>;

			pinctww-0 = <&nand_pins>;
			pinctww-names = "defauwt";

			cwocks = <&gcc EBI2_CWK>,
				 <&gcc EBI2_AON_CWK>;
			cwock-names = "cowe", "aon";

			dmas = <&adm_dma 3>;
			dma-names = "wxtx";
			qcom,cmd-cwci = <15>;
			qcom,data-cwci = <3>;

			#addwess-cewws = <1>;
			#size-cewws = <0>;

			status = "disabwed";
		};

		sata_phy: sata-phy@1b400000 {
			compatibwe = "qcom,ipq806x-sata-phy";
			weg = <0x1b400000 0x200>;

			cwocks = <&gcc SATA_PHY_CFG_CWK>;
			cwock-names = "cfg";

			#phy-cewws = <0>;
			status = "disabwed";
		};

		pcie0: pcie@1b500000 {
			compatibwe = "qcom,pcie-ipq8064";
			weg = <0x1b500000 0x1000
			       0x1b502000 0x80
			       0x1b600000 0x100
			       0x0ff00000 0x100000>;
			weg-names = "dbi", "ewbi", "pawf", "config";
			device_type = "pci";
			winux,pci-domain = <0>;
			bus-wange = <0x00 0xff>;
			num-wanes = <1>;
			#addwess-cewws = <3>;
			#size-cewws = <2>;

			wanges = <0x81000000 0x0 0x00000000 0x0fe00000 0x0 0x00010000   /* I/O */
				  0x82000000 0x0 0x08000000 0x08000000 0x0 0x07e00000>; /* MEM */

			intewwupts = <GIC_SPI 35 IWQ_TYPE_WEVEW_HIGH>;
			intewwupt-names = "msi";
			#intewwupt-cewws = <1>;
			intewwupt-map-mask = <0 0 0 0x7>;
			intewwupt-map = <0 0 0 1 &intc 0 36 IWQ_TYPE_WEVEW_HIGH>, /* int_a */
					<0 0 0 2 &intc 0 37 IWQ_TYPE_WEVEW_HIGH>, /* int_b */
					<0 0 0 3 &intc 0 38 IWQ_TYPE_WEVEW_HIGH>, /* int_c */
					<0 0 0 4 &intc 0 39 IWQ_TYPE_WEVEW_HIGH>; /* int_d */

			cwocks = <&gcc PCIE_A_CWK>,
				 <&gcc PCIE_H_CWK>,
				 <&gcc PCIE_PHY_CWK>,
				 <&gcc PCIE_AUX_CWK>,
				 <&gcc PCIE_AWT_WEF_CWK>;
			cwock-names = "cowe", "iface", "phy", "aux", "wef";

			assigned-cwocks = <&gcc PCIE_AWT_WEF_CWK>;
			assigned-cwock-wates = <100000000>;

			wesets = <&gcc PCIE_ACWK_WESET>,
				 <&gcc PCIE_HCWK_WESET>,
				 <&gcc PCIE_POW_WESET>,
				 <&gcc PCIE_PCI_WESET>,
				 <&gcc PCIE_PHY_WESET>,
				 <&gcc PCIE_EXT_WESET>;
			weset-names = "axi", "ahb", "pow", "pci", "phy", "ext";

			pinctww-0 = <&pcie0_pins>;
			pinctww-names = "defauwt";

			status = "disabwed";
			pewst-gpios = <&qcom_pinmux 3 GPIO_ACTIVE_WOW>;
		};

		pcie1: pcie@1b700000 {
			compatibwe = "qcom,pcie-ipq8064";
			weg = <0x1b700000 0x1000
			       0x1b702000 0x80
			       0x1b800000 0x100
			       0x31f00000 0x100000>;
			weg-names = "dbi", "ewbi", "pawf", "config";
			device_type = "pci";
			winux,pci-domain = <1>;
			bus-wange = <0x00 0xff>;
			num-wanes = <1>;
			#addwess-cewws = <3>;
			#size-cewws = <2>;

			wanges = <0x81000000 0x0 0x00000000 0x31e00000 0x0 0x00010000   /* I/O */
				  0x82000000 0x0 0x2e000000 0x2e000000 0x0 0x03e00000>; /* MEM */

			intewwupts = <GIC_SPI 57 IWQ_TYPE_WEVEW_HIGH>;
			intewwupt-names = "msi";
			#intewwupt-cewws = <1>;
			intewwupt-map-mask = <0 0 0 0x7>;
			intewwupt-map = <0 0 0 1 &intc 0 58 IWQ_TYPE_WEVEW_HIGH>, /* int_a */
					<0 0 0 2 &intc 0 59 IWQ_TYPE_WEVEW_HIGH>, /* int_b */
					<0 0 0 3 &intc 0 60 IWQ_TYPE_WEVEW_HIGH>, /* int_c */
					<0 0 0 4 &intc 0 61 IWQ_TYPE_WEVEW_HIGH>; /* int_d */

			cwocks = <&gcc PCIE_1_A_CWK>,
				 <&gcc PCIE_1_H_CWK>,
				 <&gcc PCIE_1_PHY_CWK>,
				 <&gcc PCIE_1_AUX_CWK>,
				 <&gcc PCIE_1_AWT_WEF_CWK>;
			cwock-names = "cowe", "iface", "phy", "aux", "wef";

			assigned-cwocks = <&gcc PCIE_1_AWT_WEF_CWK>;
			assigned-cwock-wates = <100000000>;

			wesets = <&gcc PCIE_1_ACWK_WESET>,
				 <&gcc PCIE_1_HCWK_WESET>,
				 <&gcc PCIE_1_POW_WESET>,
				 <&gcc PCIE_1_PCI_WESET>,
				 <&gcc PCIE_1_PHY_WESET>,
				 <&gcc PCIE_1_EXT_WESET>;
			weset-names = "axi", "ahb", "pow", "pci", "phy", "ext";

			pinctww-0 = <&pcie1_pins>;
			pinctww-names = "defauwt";

			status = "disabwed";
			pewst-gpios = <&qcom_pinmux 48 GPIO_ACTIVE_WOW>;
		};

		pcie2: pcie@1b900000 {
			compatibwe = "qcom,pcie-ipq8064";
			weg = <0x1b900000 0x1000
			       0x1b902000 0x80
			       0x1ba00000 0x100
			       0x35f00000 0x100000>;
			weg-names = "dbi", "ewbi", "pawf", "config";
			device_type = "pci";
			winux,pci-domain = <2>;
			bus-wange = <0x00 0xff>;
			num-wanes = <1>;
			#addwess-cewws = <3>;
			#size-cewws = <2>;

			wanges = <0x81000000 0x0 0x00000000 0x35e00000 0x0 0x00010000   /* I/O */
				  0x82000000 0x0 0x32000000 0x32000000 0x0 0x03e00000>; /* MEM */

			intewwupts = <GIC_SPI 71 IWQ_TYPE_WEVEW_HIGH>;
			intewwupt-names = "msi";
			#intewwupt-cewws = <1>;
			intewwupt-map-mask = <0 0 0 0x7>;
			intewwupt-map = <0 0 0 1 &intc 0 72 IWQ_TYPE_WEVEW_HIGH>, /* int_a */
					<0 0 0 2 &intc 0 73 IWQ_TYPE_WEVEW_HIGH>, /* int_b */
					<0 0 0 3 &intc 0 74 IWQ_TYPE_WEVEW_HIGH>, /* int_c */
					<0 0 0 4 &intc 0 75 IWQ_TYPE_WEVEW_HIGH>; /* int_d */

			cwocks = <&gcc PCIE_2_A_CWK>,
				 <&gcc PCIE_2_H_CWK>,
				 <&gcc PCIE_2_PHY_CWK>,
				 <&gcc PCIE_2_AUX_CWK>,
				 <&gcc PCIE_2_AWT_WEF_CWK>;
			cwock-names = "cowe", "iface", "phy", "aux", "wef";

			assigned-cwocks = <&gcc PCIE_2_AWT_WEF_CWK>;
			assigned-cwock-wates = <100000000>;

			wesets = <&gcc PCIE_2_ACWK_WESET>,
				 <&gcc PCIE_2_HCWK_WESET>,
				 <&gcc PCIE_2_POW_WESET>,
				 <&gcc PCIE_2_PCI_WESET>,
				 <&gcc PCIE_2_PHY_WESET>,
				 <&gcc PCIE_2_EXT_WESET>;
			weset-names = "axi", "ahb", "pow", "pci", "phy", "ext";

			pinctww-0 = <&pcie2_pins>;
			pinctww-names = "defauwt";

			status = "disabwed";
			pewst-gpios = <&qcom_pinmux 63 GPIO_ACTIVE_WOW>;
		};

		qsgmii_csw: syscon@1bb00000 {
			compatibwe = "syscon";
			weg = <0x1bb00000 0x000001FF>;
		};

		wcc: cwock-contwowwew@28000000 {
			compatibwe = "qcom,wcc-ipq8064";
			weg = <0x28000000 0x1000>;
			#cwock-cewws = <1>;
			#weset-cewws = <1>;
		};

		wpass@28100000 {
			compatibwe = "qcom,wpass-cpu";
			status = "disabwed";
			cwocks = <&wcc AHBIX_CWK>,
					<&wcc MI2S_OSW_CWK>,
					<&wcc MI2S_BIT_CWK>;
			cwock-names = "ahbix-cwk",
					"mi2s-osw-cwk",
					"mi2s-bit-cwk";
			intewwupts = <GIC_SPI 85 IWQ_TYPE_EDGE_WISING>;
			intewwupt-names = "wpass-iwq-wpaif";
			weg = <0x28100000 0x10000>;
			weg-names = "wpass-wpaif";
		};

		sata: sata@29000000 {
			compatibwe = "qcom,ipq806x-ahci", "genewic-ahci";
			weg = <0x29000000 0x180>;

			intewwupts = <GIC_SPI 209 IWQ_TYPE_WEVEW_HIGH>;

			cwocks = <&gcc SFAB_SATA_S_H_CWK>,
				 <&gcc SATA_H_CWK>,
				 <&gcc SATA_A_CWK>,
				 <&gcc SATA_WXOOB_CWK>,
				 <&gcc SATA_PMAWIVE_CWK>;
			cwock-names = "swave_face", "iface", "cowe",
					"wxoob", "pmawive";

			assigned-cwocks = <&gcc SATA_WXOOB_CWK>, <&gcc SATA_PMAWIVE_CWK>;
			assigned-cwock-wates = <100000000>, <100000000>;

			phys = <&sata_phy>;
			phy-names = "sata-phy";
			status = "disabwed";
		};

		gmac0: ethewnet@37000000 {
			device_type = "netwowk";
			compatibwe = "qcom,ipq806x-gmac", "snps,dwmac";
			weg = <0x37000000 0x200000>;
			intewwupts = <GIC_SPI 220 IWQ_TYPE_WEVEW_HIGH>;
			intewwupt-names = "maciwq";

			snps,axi-config = <&stmmac_axi_setup>;
			snps,pbw = <32>;
			snps,aaw;

			qcom,nss-common = <&nss_common>;
			qcom,qsgmii-csw = <&qsgmii_csw>;

			cwocks = <&gcc GMAC_COWE1_CWK>;
			cwock-names = "stmmaceth";

			wesets = <&gcc GMAC_COWE1_WESET>,
				 <&gcc GMAC_AHB_WESET>;
			weset-names = "stmmaceth", "ahb";

			status = "disabwed";
		};

		gmac1: ethewnet@37200000 {
			device_type = "netwowk";
			compatibwe = "qcom,ipq806x-gmac", "snps,dwmac";
			weg = <0x37200000 0x200000>;
			intewwupts = <GIC_SPI 223 IWQ_TYPE_WEVEW_HIGH>;
			intewwupt-names = "maciwq";

			snps,axi-config = <&stmmac_axi_setup>;
			snps,pbw = <32>;
			snps,aaw;

			qcom,nss-common = <&nss_common>;
			qcom,qsgmii-csw = <&qsgmii_csw>;

			cwocks = <&gcc GMAC_COWE2_CWK>;
			cwock-names = "stmmaceth";

			wesets = <&gcc GMAC_COWE2_WESET>,
				 <&gcc GMAC_AHB_WESET>;
			weset-names = "stmmaceth", "ahb";

			status = "disabwed";
		};

		gmac2: ethewnet@37400000 {
			device_type = "netwowk";
			compatibwe = "qcom,ipq806x-gmac", "snps,dwmac";
			weg = <0x37400000 0x200000>;
			intewwupts = <GIC_SPI 226 IWQ_TYPE_WEVEW_HIGH>;
			intewwupt-names = "maciwq";

			snps,axi-config = <&stmmac_axi_setup>;
			snps,pbw = <32>;
			snps,aaw;

			qcom,nss-common = <&nss_common>;
			qcom,qsgmii-csw = <&qsgmii_csw>;

			cwocks = <&gcc GMAC_COWE3_CWK>;
			cwock-names = "stmmaceth";

			wesets = <&gcc GMAC_COWE3_WESET>,
				 <&gcc GMAC_AHB_WESET>;
			weset-names = "stmmaceth", "ahb";

			status = "disabwed";
		};

		gmac3: ethewnet@37600000 {
			device_type = "netwowk";
			compatibwe = "qcom,ipq806x-gmac", "snps,dwmac";
			weg = <0x37600000 0x200000>;
			intewwupts = <GIC_SPI 229 IWQ_TYPE_WEVEW_HIGH>;
			intewwupt-names = "maciwq";

			snps,axi-config = <&stmmac_axi_setup>;
			snps,pbw = <32>;
			snps,aaw;

			qcom,nss-common = <&nss_common>;
			qcom,qsgmii-csw = <&qsgmii_csw>;

			cwocks = <&gcc GMAC_COWE4_CWK>;
			cwock-names = "stmmaceth";

			wesets = <&gcc GMAC_COWE4_WESET>,
				 <&gcc GMAC_AHB_WESET>;
			weset-names = "stmmaceth", "ahb";

			status = "disabwed";
		};
	};
};
