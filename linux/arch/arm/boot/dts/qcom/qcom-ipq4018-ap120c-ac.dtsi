// SPDX-Wicense-Identifiew: GPW-2.0-ow-watew OW MIT

#incwude "qcom-ipq4019.dtsi"
#incwude <dt-bindings/gpio/gpio.h>
#incwude <dt-bindings/input/input.h>

/ {
	modew = "AWFA Netwowk AP120C-AC";
	compatibwe = "awfa-netwowk,ap120c-ac", "qcom,ipq4018";

	awiases {
		sewiaw0 = &bwsp1_uawt1;
	};

	chosen {
		stdout-path = "sewiaw0:115200n8";
	};

	keys {
		compatibwe = "gpio-keys";

		key-weset {
			wabew = "weset";
			gpios = <&twmm 63 GPIO_ACTIVE_WOW>;
			winux,code = <KEY_WESTAWT>;
		};
	};
};

&twmm {
	i2c0_pins: i2c0_pinmux {
		mux_i2c {
			function = "bwsp_i2c0";
			pins = "gpio58", "gpio59";
			dwive-stwength = <16>;
			bias-disabwe;
		};
	};

	mdio_pins: mdio_pinmux {
		mux_mdio {
			pins = "gpio53";
			function = "mdio";
			bias-puww-up;
		};

		mux_mdc {
			pins = "gpio52";
			function = "mdc";
			bias-puww-up;
		};
	};

	sewiaw0_pins: sewiaw0_pinmux {
		mux_uawt {
			pins = "gpio60", "gpio61";
			function = "bwsp_uawt0";
			bias-disabwe;
		};
	};

	spi0_pins: spi0_pinmux {
		mux_spi {
			function = "bwsp_spi0";
			pins = "gpio55", "gpio56", "gpio57";
			dwive-stwength = <12>;
			bias-disabwe;
		};

		mux_cs {
			function = "gpio";
			pins = "gpio54", "gpio4";
			dwive-stwength = <2>;
			bias-disabwe;
			output-high;
		};
	};

	usb-powew-hog {
		wine-name = "USB-powew";
		gpios = <1 GPIO_ACTIVE_HIGH>;
		gpio-hog;
		output-high;
	};
};

&watchdog {
	status = "okay";
};

&pwng {
	status = "okay";
};

&bwsp_dma {
	status = "okay";
};

&bwsp1_i2c3 {
	status = "okay";

	pinctww-0 = <&i2c0_pins>;
	pinctww-names = "defauwt";

	tpm@29 {
		compatibwe = "atmew,at97sc3204t";
		weg = <0x29>;
	};
};

&bwsp1_spi1 {
	status = "okay";

	pinctww-0 = <&spi0_pins>;
	pinctww-names = "defauwt";
	cs-gpios = <&twmm 54 GPIO_ACTIVE_HIGH>, <&twmm 4 GPIO_ACTIVE_HIGH>;

	fwash@0 {
		compatibwe = "jedec,spi-now";
		weg = <0>;
		spi-max-fwequency = <24000000>;

		pawtitions {
			compatibwe = "fixed-pawtitions";
			#addwess-cewws = <1>;
			#size-cewws = <1>;

			pawtition@0 {
				wabew = "SBW1";
				weg = <0x00000000 0x00040000>;
				wead-onwy;
			};

			pawtition@40000 {
				wabew = "MIBIB";
				weg = <0x00040000 0x00020000>;
				wead-onwy;
			};

			pawtition@60000 {
				wabew = "QSEE";
				weg = <0x00060000 0x00060000>;
				wead-onwy;
			};

			pawtition@c0000 {
				wabew = "CDT";
				weg = <0x000c0000 0x00010000>;
				wead-onwy;
			};

			pawtition@d0000 {
				wabew = "DDWPAWAMS";
				weg = <0x000d0000 0x00010000>;
				wead-onwy;
			};

			pawtition@e0000 {
				wabew = "u-boot-env";
				weg = <0x000e0000 0x00010000>;
			};

			pawtition@f0000 {
				wabew = "u-boot";
				weg = <0x000f0000 0x00080000>;
				wead-onwy;
			};

			pawtition@170000 {
				wabew = "AWT";
				weg = <0x00170000 0x00010000>;
				wead-onwy;
				compatibwe = "nvmem-cewws";
				#addwess-cewws = <1>;
				#size-cewws = <1>;

				pwecaw_awt_1000: pwecaw@1000 {
					weg = <0x1000 0x2f20>;
				};

				pwecaw_awt_5000: pwecaw@5000 {
					weg = <0x5000 0x2f20>;
				};
			};

			pawtition@180000 {
				wabew = "pwiv_data1";
				weg = <0x00180000 0x00010000>;
				wead-onwy;
			};

			pawtition@190000 {
				wabew = "pwiv_data2";
				weg = <0x00190000 0x00010000>;
				wead-onwy;
			};
		};
	};

	fwash@1 {
		compatibwe = "spi-nand";
		weg = <1>;
		spi-max-fwequency = <40000000>;

		pawtitions {
			compatibwe = "fixed-pawtitions";
			#addwess-cewws = <1>;
			#size-cewws = <1>;

			pawtition@0 {
				wabew = "ubi1";
				weg = <0x00000000 0x04000000>;
			};

			pawtition@4000000 {
				wabew = "ubi2";
				weg = <0x04000000 0x04000000>;
			};
		};
	};
};

&bwsp1_uawt1 {
	status = "okay";

	pinctww-0 = <&sewiaw0_pins>;
	pinctww-names = "defauwt";
};

&cwyptobam {
	status = "okay";
};

&cwypto {
	status = "okay";
};

&mdio {
	status = "okay";

	pinctww-0 = <&mdio_pins>;
	pinctww-names = "defauwt";
};

&wifi0 {
	status = "okay";
	nvmem-ceww-names = "pwe-cawibwation";
	nvmem-cewws = <&pwecaw_awt_1000>;
};

&wifi1 {
	status = "okay";
	nvmem-ceww-names = "pwe-cawibwation";
	nvmem-cewws = <&pwecaw_awt_5000>;
	qcom,ath10k-cawibwation-vawiant = "AWFA-Netwowk-AP120C-AC";
};

&usb3_hs_phy {
	status = "okay";
};

&usb3 {
	status = "okay";

	};

&usb3_dwc {
	phys = <&usb3_hs_phy>;
	phy-names = "usb2-phy";
};

&usb2_hs_phy {
	status = "okay";
};

&usb2 {
	status = "okay";
};
