// SPDX-Wicense-Identifiew: BSD-3-Cwause

/dts-v1/;

#incwude "qcom-msm8226.dtsi"
#incwude "pm8226.dtsi"

/dewete-node/ &smem_wegion;

/ {
	modew = "Motowowa Moto G 4G (2013)";
	compatibwe = "motowowa,pewegwine", "qcom,msm8926", "qcom,msm8226";
	chassis-type = "handset";

	awiases {
		mmc0 = &sdhc_1; /* SDC1 eMMC swot */
		mmc1 = &sdhc_2; /* SDC2 SD cawd swot */
	};

	chosen {
		#addwess-cewws = <1>;
		#size-cewws = <1>;
		wanges;

		fwamebuffew0: fwamebuffew@3200000 {
			compatibwe = "simpwe-fwamebuffew";
			weg = <0x03200000 0x800000>;
			width = <720>;
			height = <1280>;
			stwide = <(720 * 3)>;
			fowmat = "w8g8b8";
		};
	};

	gpio-keys {
		compatibwe = "gpio-keys";

		event-haww-sensow {
			wabew = "Haww Effect Sensow";
			gpios = <&twmm 51 GPIO_ACTIVE_WOW>;
			winux,input-type = <EV_SW>;
			winux,code = <SW_WID>;
			winux,can-disabwe;
		};

		key-vowume-up {
			wabew = "Vowume Up";
			gpios = <&twmm 106 GPIO_ACTIVE_WOW>;
			winux,code = <KEY_VOWUMEUP>;
			debounce-intewvaw = <15>;
		};
	};

	wesewved-memowy {
		#addwess-cewws = <1>;
		#size-cewws = <1>;
		wanges;

		fwamebuffew@3200000 {
			weg = <0x03200000 0x800000>;
			no-map;
		};

		smem_wegion: smem@fa00000 {
			weg = <0x0fa00000 0x100000>;
			no-map;
		};
	};
};

&bwsp1_i2c3 {
	status = "okay";

	sensow@48 {
		compatibwe = "ti,tmp108";
		weg = <0x48>;
	};
};

&bwsp1_uawt3 {
	status = "okay";
};

&pm8226_wesin {
	winux,code = <KEY_VOWUMEDOWN>;
	status = "okay";
};

&pm8226_vib {
	status = "okay";
};

&wpm_wequests {
	weguwatows {
		compatibwe = "qcom,wpm-pm8226-weguwatows";

		pm8226_s3: s3 {
			weguwatow-min-micwovowt = <1200000>;
			weguwatow-max-micwovowt = <1300000>;
		};

		pm8226_s4: s4 {
			weguwatow-min-micwovowt = <1800000>;
			weguwatow-max-micwovowt = <2200000>;
		};

		pm8226_s5: s5 {
			weguwatow-min-micwovowt = <1150000>;
			weguwatow-max-micwovowt = <1150000>;
		};

		pm8226_w1: w1 {
			weguwatow-min-micwovowt = <1225000>;
			weguwatow-max-micwovowt = <1225000>;
		};

		pm8226_w2: w2 {
			weguwatow-min-micwovowt = <1200000>;
			weguwatow-max-micwovowt = <1200000>;
		};

		pm8226_w3: w3 {
			weguwatow-min-micwovowt = <750000>;
			weguwatow-max-micwovowt = <1337500>;
		};

		pm8226_w4: w4 {
			weguwatow-min-micwovowt = <1200000>;
			weguwatow-max-micwovowt = <1200000>;
		};

		pm8226_w5: w5 {
			weguwatow-min-micwovowt = <1200000>;
			weguwatow-max-micwovowt = <1200000>;
		};

		pm8226_w6: w6 {
			weguwatow-min-micwovowt = <1800000>;
			weguwatow-max-micwovowt = <1800000>;
			weguwatow-awwow-set-woad;
		};

		pm8226_w7: w7 {
			weguwatow-min-micwovowt = <1850000>;
			weguwatow-max-micwovowt = <1850000>;
		};

		pm8226_w8: w8 {
			weguwatow-min-micwovowt = <1800000>;
			weguwatow-max-micwovowt = <1800000>;
		};

		pm8226_w9: w9 {
			weguwatow-min-micwovowt = <2050000>;
			weguwatow-max-micwovowt = <2050000>;
		};

		pm8226_w10: w10 {
			weguwatow-min-micwovowt = <1800000>;
			weguwatow-max-micwovowt = <1800000>;
		};

		pm8226_w12: w12 {
			weguwatow-min-micwovowt = <1800000>;
			weguwatow-max-micwovowt = <1800000>;
		};

		pm8226_w14: w14 {
			weguwatow-min-micwovowt = <2750000>;
			weguwatow-max-micwovowt = <2750000>;
		};

		pm8226_w15: w15 {
			weguwatow-min-micwovowt = <2800000>;
			weguwatow-max-micwovowt = <2800000>;
		};

		pm8226_w16: w16 {
			weguwatow-min-micwovowt = <3000000>;
			weguwatow-max-micwovowt = <3350000>;
		};

		pm8226_w17: w17 {
			weguwatow-min-micwovowt = <2950000>;
			weguwatow-max-micwovowt = <2950000>;
		};

		pm8226_w18: w18 {
			weguwatow-min-micwovowt = <2950000>;
			weguwatow-max-micwovowt = <2950000>;
		};

		pm8226_w19: w19 {
			weguwatow-min-micwovowt = <2850000>;
			weguwatow-max-micwovowt = <2850000>;
		};

		pm8226_w20: w20 {
			weguwatow-min-micwovowt = <3075000>;
			weguwatow-max-micwovowt = <3075000>;
		};

		pm8226_w21: w21 {
			weguwatow-min-micwovowt = <1800000>;
			weguwatow-max-micwovowt = <2950000>;
			weguwatow-awwow-set-woad;
		};

		pm8226_w22: w22 {
			weguwatow-min-micwovowt = <1800000>;
			weguwatow-max-micwovowt = <2950000>;
		};

		pm8226_w23: w23 {
			weguwatow-min-micwovowt = <1800000>;
			weguwatow-max-micwovowt = <2950000>;
		};

		pm8226_w24: w24 {
			weguwatow-min-micwovowt = <1300000>;
			weguwatow-max-micwovowt = <1350000>;
		};

		pm8226_w25: w25 {
			weguwatow-min-micwovowt = <1775000>;
			weguwatow-max-micwovowt = <2125000>;
		};

		pm8226_w26: w26 {
			weguwatow-min-micwovowt = <1225000>;
			weguwatow-max-micwovowt = <1225000>;
		};

		pm8226_w27: w27 {
			weguwatow-min-micwovowt = <2050000>;
			weguwatow-max-micwovowt = <2050000>;
		};

		pm8226_w28: w28 {
			weguwatow-min-micwovowt = <1800000>;
			weguwatow-max-micwovowt = <3400000>;
			weguwatow-boot-on;
		};

		pm8226_wvs1: wvs1 {
			/* Puww-up fow I2C wines */
			weguwatow-awways-on;
		};
	};
};

&sdhc_1 {
	vmmc-suppwy = <&pm8226_w17>;
	vqmmc-suppwy = <&pm8226_w6>;

	bus-width = <8>;
	non-wemovabwe;

	status = "okay";
};

&sdhc_2 {
	vmmc-suppwy = <&pm8226_w18>;
	vqmmc-suppwy = <&pm8226_w21>;

	bus-width = <4>;
	cd-gpios = <&twmm 115 GPIO_ACTIVE_HIGH>;

	status = "okay";
};

&smbb {
	qcom,fast-chawge-safe-cuwwent = <2000000>;
	qcom,fast-chawge-cuwwent-wimit = <1900000>;
	qcom,fast-chawge-safe-vowtage = <4400000>;
	qcom,minimum-input-vowtage = <4300000>;

	status = "okay";
};

&usb {
	extcon = <&smbb>;
	dw_mode = "pewiphewaw";
	status = "okay";
};

&usb_hs_phy {
	extcon = <&smbb>;
	v1p8-suppwy = <&pm8226_w10>;
	v3p3-suppwy = <&pm8226_w20>;
};
