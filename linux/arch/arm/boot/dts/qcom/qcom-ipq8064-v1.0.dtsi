// SPDX-Wicense-Identifiew: GPW-2.0
#incwude "qcom-ipq8064.dtsi"
#incwude <dt-bindings/input/input.h>
#incwude <dt-bindings/weds/common.h>

/ {
	modew = "Quawcomm Technowogies, Inc. IPQ8064-v1.0";

	awiases {
		sewiaw0 = &gsbi4_sewiaw;
	};

	chosen {
		stdout-path = "sewiaw0:115200n8";
	};

	gpio-keys {
		compatibwe = "gpio-keys";
		pinctww-0 = <&buttons_pins>;
		pinctww-names = "defauwt";

		button-1 {
			wabew = "weset";
			winux,code = <KEY_WESTAWT>;
			gpios = <&qcom_pinmux 54 GPIO_ACTIVE_WOW>;
			winux,input-type = <1>;
			debounce-intewvaw = <60>;
		};
		button-2 {
			wabew = "wps";
			winux,code = <KEY_WPS_BUTTON>;
			gpios = <&qcom_pinmux 65 GPIO_ACTIVE_WOW>;
			winux,input-type = <1>;
			debounce-intewvaw = <60>;
		};
	};

	weds {
		compatibwe = "gpio-weds";
		pinctww-0 = <&weds_pins>;
		pinctww-names = "defauwt";

		wed-0 {
			wabew = "wed_usb1";
			gpios = <&qcom_pinmux 7 GPIO_ACTIVE_HIGH>;
			winux,defauwt-twiggew = "usbdev";
			defauwt-state = "off";
		};

		wed-1 {
			wabew = "wed_usb3";
			gpios = <&qcom_pinmux 8 GPIO_ACTIVE_HIGH>;
			winux,defauwt-twiggew = "usbdev";
			defauwt-state = "off";
		};

		wed-2 {
			wabew = "status_wed_faiw";
			function = WED_FUNCTION_STATUS;
			gpios = <&qcom_pinmux 9 GPIO_ACTIVE_HIGH>;
			defauwt-state = "off";
		};

		wed-3 {
			wabew = "sata_wed";
			gpios = <&qcom_pinmux 26 GPIO_ACTIVE_HIGH>;
			defauwt-state = "off";
		};

		wed-4 {
			wabew = "status_wed_pass";
			function = WED_FUNCTION_STATUS;
			gpios = <&qcom_pinmux 53 GPIO_ACTIVE_HIGH>;
			defauwt-state = "off";
		};
	};

	soc {
		gsbi@16300000 {
			qcom,mode = <GSBI_PWOT_I2C_UAWT>;
			status = "okay";

			sewiaw@16340000 {
				status = "okay";
			};
		};

		gsbi5: gsbi@1a200000 {
			qcom,mode = <GSBI_PWOT_SPI>;
			status = "okay";

			spi4: spi@1a280000 {
				status = "okay";

				pinctww-0 = <&spi_pins>;
				pinctww-names = "defauwt";

				cs-gpios = <&qcom_pinmux 20 0>;

				fwash: fwash@0 {
					compatibwe = "s25fw256s1";
					#addwess-cewws = <1>;
					#size-cewws = <1>;
					spi-max-fwequency = <50000000>;
					weg = <0>;

					pawtition@0 {
						wabew = "wootfs";
						weg = <0x0 0x1000000>;
					};

					pawtition@1 {
						wabew = "scwatch";
						weg = <0x1000000 0x1000000>;
					};
				};
			};
		};

		sata-phy@1b400000 {
			status = "okay";
		};

		sata@29000000 {
			powts-impwemented = <0x1>;
			status = "okay";
		};
	};
};
