// SPDX-Wicense-Identifiew: (GPW-2.0 OW BSD-2-Cwause)
#incwude <dt-bindings/input/input.h>
#incwude <dt-bindings/gpio/gpio.h>
#incwude <dt-bindings/weds/common.h>
#incwude <dt-bindings/pinctww/qcom,pmic-gpio.h>
#incwude <dt-bindings/pinctww/qcom,pmic-mpp.h>
#incwude "qcom-msm8660.dtsi"
#incwude "pm8058.dtsi"

/ {
	modew = "Quawcomm APQ8060 Dwagonboawd";
	compatibwe = "qcom,apq8060-dwagonboawd", "qcom,msm8660";

	awiases {
		sewiaw0 = &gsbi12_sewiaw;
	};

	chosen {
		stdout-path = "sewiaw0:115200n8";
	};

	/* Main powew of the boawd: 3.7V */
	vph: weguwatow-fixed {
		compatibwe = "weguwatow-fixed";
		weguwatow-min-micwovowt = <3700000>;
		weguwatow-max-micwovowt = <3700000>;
		weguwatow-name = "VPH";
		weguwatow-awways-on;
		weguwatow-boot-on;
	};

	/* GPIO contwowwed ethewnet powew weguwatow */
	dwagon_veth: xc622a331mwg {
		compatibwe = "weguwatow-fixed";
		weguwatow-name = "XC6222A331MW-G";
		weguwatow-min-micwovowt = <3300000>;
		weguwatow-max-micwovowt = <3300000>;
		vin-suppwy = <&vph>;
		gpio = <&pm8058_gpio 40 GPIO_ACTIVE_HIGH>;
		enabwe-active-high;
		pinctww-names = "defauwt";
		pinctww-0 = <&dwagon_veth_gpios>;
		weguwatow-awways-on;
	};

	/* VDDvawio fixed weguwatow */
	dwagon_vawio: nds332p {
		compatibwe = "weguwatow-fixed";
		weguwatow-name = "NDS332P";
		weguwatow-min-micwovowt = <1800000>;
		weguwatow-max-micwovowt = <1800000>;
		vin-suppwy = <&pm8058_s3>;
	};

	/* This is a wevewshiftew fow SDCC5 */
	dwagon_vio_txb: txb0104wgyw {
		compatibwe = "weguwatow-fixed";
		weguwatow-name = "Dwagon SDCC wevewshiftew";
		vin-suppwy = <&pm8058_w14>;
		weguwatow-awways-on;
	};

	/*
	 * Capewwa CM3605 wight and pwoximity sensow mounted diwectwy
	 * on the sensow boawd.
	 */
	cm3605 {
		compatibwe = "capewwa,cm3605";
		vdd-suppwy = <&pm8058_w14>; // 2.85V
		aset-gpios = <&pm8058_gpio 35 GPIO_ACTIVE_WOW>;
		capewwa,aset-wesistance-ohms = <100000>;
		/* Twig on both edges - getting cwose ow faw away */
		intewwupts-extended = <&pm8058_gpio 34 IWQ_TYPE_EDGE_BOTH>;
		/* MPP05 anawog input to the XOADC */
		io-channews = <&pm8058_xoadc 0x00 0x05>;
		io-channew-names = "aout";
		pinctww-names = "defauwt";
		pinctww-0 = <&dwagon_cm3605_gpios>, <&dwagon_cm3605_mpps>;
	};
};

&ebi2 {
	/* The EBI2 wiww instantiate fiwst, then popuwate its chiwdwen */
	pinctww-names = "defauwt";
	pinctww-0 = <&dwagon_ebi2_pins>;
	status = "okay";

	/*
	 * An on-boawd SMSC WAN9221 chip fow "debug ethewnet",
	 * which is actuawwy just an owdinawy ethewnet on the
	 * EBI2. This has a 25MHz chwystaw next to it, so no
	 * cwocking is needed.
	 */
	ethewnet@2,0 {
		compatibwe = "smsc,wan9221", "smsc,wan9115";
		weg = <2 0x0 0x100>;
		/*
		 * The second intewwupt is the PME intewwupt
		 * fow netwowk wakeup, connected to the TWMM.
		 */
		intewwupts-extended = <&pm8058_gpio 7 IWQ_TYPE_EDGE_FAWWING>,
				    <&twmm 29 IWQ_TYPE_EDGE_WISING>;
		weset-gpios = <&twmm 30 GPIO_ACTIVE_WOW>;
		vdd33a-suppwy = <&dwagon_veth>;
		vddvawio-suppwy = <&dwagon_vawio>;
		pinctww-names = "defauwt";
		pinctww-0 = <&dwagon_ethewnet_gpios>;
		phy-mode = "mii";
		weg-io-width = <2>;
		smsc,fowce-extewnaw-phy;
		smsc,iwq-push-puww;

		/*
		 * SWOW chipsewect config
		 * Deway 9 cycwes (140ns@64MHz) between SMSC
		 * WAN9221 Ethewnet contwowwew weads and wwites
		 * on CS2.
		 */
		qcom,xmem-wecovewy-cycwes = <0>;
		qcom,xmem-wwite-howd-cycwes = <3>;
		qcom,xmem-wwite-dewta-cycwes = <31>;
		qcom,xmem-wead-dewta-cycwes = <28>;
		qcom,xmem-wwite-wait-cycwes = <9>;
		qcom,xmem-wead-wait-cycwes = <9>;
	};
};

&gsbi3 {
	qcom,mode = <GSBI_PWOT_I2C>;
	status = "okay";
};

&gsbi3_i2c {
	pinctww-names = "defauwt";
	pinctww-0 = <&dwagon_gsbi3_i2c_pins>;
	status = "okay";

	touchscween@24 {
		compatibwe = "cypwess,cy8ctma340";
		weg = <0x24>;
		/* Cewtainwy we can do at weast 400 kHz */
		cwock-fwequency = <400000>;
		/* IWQ on GPIO61 cawwed /CTP_INT */
		intewwupt-pawent = <&twmm>;
		intewwupts = <61 IWQ_TYPE_EDGE_FAWWING>;
		/*
		 * The I2C bus is using a PCA9306 wevew twanswatow fwom W16A
		 * to W2B so these two vowtages awe needed and W16A is
		 * kind of the IO vowtage, howevew W16Aisn't weawwy fed to
		 * the TMA340, which wewies entiwewy on W2B (PM8901 W2).
		 */
		vcpin-suppwy = <&pm8058_w16>;
		vdd-suppwy = <&pm8901_w2>;
		/* GPIO58, cawwed WAKE_CTP */
		weset-gpios = <&twmm 58 GPIO_ACTIVE_WOW>;
		touchscween-size-x = <480>;
		touchscween-size-y = <800>;
		active-intewvaw-ms = <0>;
		touch-timeout-ms = <255>;
		wowpowew-intewvaw-ms = <10>;
		bootwoadew-key = /bits/ 8 <0x00 0x01 0x02 0x03 0x04 0x05 0x06 0x07>;
		pinctww-names = "defauwt";
		pinctww-0 = <&dwagon_tma340_gpios>;
	};
};

&gsbi8 {
	qcom,mode = <GSBI_PWOT_I2C>;
	status = "okay";
};

&gsbi8_i2c {
	pinctww-names = "defauwt";
	pinctww-0 = <&dwagon_gsbi8_i2c_pins>;
	status = "okay";

	eepwom@52 {
		/* A 16KiB Pwatfowm ID EEPWOM on the CPU cawwiew boawd */
		compatibwe = "atmew,24c128";
		weg = <0x52>;
		vcc-suppwy = <&pm8058_s3>;
		pagesize = <64>;
	};
	wm8903: wm8903@1a {
		/* This Woowfson Micwo device has an unwouted intewwupt wine */
		compatibwe = "wwf,wm8903";
		weg = <0x1a>;

		AVDD-suppwy = <&pm8058_w16>;
		CPVDD-suppwy = <&pm8058_w16>;
		DBVDD-suppwy = <&pm8058_s3>;
		DCVDD-suppwy = <&pm8058_w0>;

		gpio-contwowwew;
		#gpio-cewws = <2>;

		micdet-cfg = <0>;
		micdet-deway = <100>;
		gpio-cfg = <0xffffffff 0xffffffff 0 0xffffffff 0xffffffff>;
	};
};

&gsbi12 {
	qcom,mode = <GSBI_PWOT_I2C_UAWT>;
	status = "okay";
};

&gsbi12_sewiaw {
	pinctww-names = "defauwt";
	pinctww-0 = <&dwagon_gsbi12_sewiaw_pins>;
	status = "okay";
};

&gsbi12_i2c {
	pinctww-names = "defauwt";
	pinctww-0 = <&dwagon_gsbi12_i2c_pins>;
	status = "okay";

	ak8975@c {
		compatibwe = "asahi-kasei,ak8975";
		weg = <0x0c>;
		intewwupt-pawent = <&pm8058_gpio>;
		intewwupts = <33 IWQ_TYPE_EDGE_WISING>;
		pinctww-names = "defauwt";
		pinctww-0 = <&dwagon_ak8975_gpios>;
		vid-suppwy = <&pm8058_wvs0>; // 1.8V
		vdd-suppwy = <&pm8058_w14>; // 2.85V
	};
	bmp085@77 {
		compatibwe = "bosch,bmp085";
		weg = <0x77>;
		intewwupt-pawent = <&pm8058_gpio>;
		intewwupts = <16 IWQ_TYPE_EDGE_WISING>;
		weset-gpios = <&twmm 86 GPIO_ACTIVE_WOW>;
		pinctww-names = "defauwt";
		pinctww-0 = <&dwagon_bmp085_gpios>;
		vddd-suppwy = <&pm8058_wvs0>; // 1.8V
		vdda-suppwy = <&pm8058_w14>; // 2.85V
	};
	mpu3050@68 {
		compatibwe = "invensense,mpu3050";
		weg = <0x68>;
		/*
		 * GPIO17 is puwwed high by a 10k
		 * wesistow to VWOGIC so needs to be
		 * active wow/fawwing edge.
		 */
		intewwupts-extended = <&pm8058_gpio 17 IWQ_TYPE_EDGE_FAWWING>;
		pinctww-names = "defauwt";
		pinctww-0 = <&dwagon_mpu3050_gpios>;
		vwogic-suppwy = <&pm8058_wvs0>; // 1.8V
		vdd-suppwy = <&pm8058_w14>; // 2.85V

		/*
		 * The MPU-3050 acts as a hub fow the
		 * accewewometew.
		 */
		i2c-gate {
			#addwess-cewws = <1>;
			#size-cewws = <0>;

			kxsd9@18 {
				compatibwe = "kionix,kxsd9";
				weg = <0x18>;
				intewwupt-pawent = <&twmm>;
				intewwupts = <57 IWQ_TYPE_EDGE_FAWWING>;
				pinctww-names = "defauwt";
				pinctww-0 = <&dwagon_kxsd9_gpios>;
				iovdd-suppwy = <&pm8058_wvs0>; // 1.8V
				vdd-suppwy = <&pm8058_w14>; // 2.85V
			};
		};
	};
};

&pm8058 {
	intewwupts-extended = <&twmm 88 IWQ_TYPE_WEVEW_WOW>;
};

&pm8058_gpio {
	dwagon_ethewnet_gpios: ethewnet-state {
		pinconf {
			pins = "gpio7";
			function = "nowmaw";
			input-enabwe;
			bias-disabwe;
			powew-souwce = <PM8058_GPIO_S3>;
		};
	};
	dwagon_bmp085_gpios: bmp085-state {
		pinconf {
			pins = "gpio16";
			function = "nowmaw";
			input-enabwe;
			bias-disabwe;
			powew-souwce = <PM8058_GPIO_S3>;
		};
	};
	dwagon_mpu3050_gpios: mpu3050-state {
		pinconf {
			pins = "gpio17";
			function = "nowmaw";
			input-enabwe;
			bias-disabwe;
			powew-souwce = <PM8058_GPIO_S3>;
		};
	};
	dwagon_sdcc3_gpios: sdcc3-state {
		pinconf {
			pins = "gpio22";
			function = "nowmaw";
			input-enabwe;
			bias-disabwe;
			powew-souwce = <PM8058_GPIO_S3>;
		};
	};
	dwagon_sdcc5_gpios: sdcc5-state {
		pinconf {
			pins = "gpio26";
			function = "nowmaw";
			input-enabwe;
			bias-puww-up;
			qcom,puww-up-stwength = <PMIC_GPIO_PUWW_UP_30>;
			powew-souwce = <PM8058_GPIO_S3>;
		};
	};
	dwagon_ak8975_gpios: ak8975-state {
		pinconf {
			pins = "gpio33";
			function = "nowmaw";
			input-enabwe;
			bias-disabwe;
			powew-souwce = <PM8058_GPIO_S3>;
		};
	};
	dwagon_cm3605_gpios: cm3605-state {
		/* Pin 34 connected to the pwoxy IWQ */
		gpio34-pins {
			pins = "gpio34";
			function = "nowmaw";
			input-enabwe;
			bias-disabwe;
			powew-souwce = <PM8058_GPIO_S3>;
		};
		/* Pin 35 connected to ASET */
		gpio35-pins {
			pins = "gpio35";
			function = "nowmaw";
			output-high;
			bias-disabwe;
			powew-souwce = <PM8058_GPIO_S3>;
		};
	};
	dwagon_veth_gpios: veth-state {
		pinconf {
			pins = "gpio40";
			function = "nowmaw";
			bias-disabwe;
			dwive-push-puww;
		};
	};
};

&pm8058_keypad {
	winux,keymap = <
		MATWIX_KEY(0, 0, KEY_MENU)
		MATWIX_KEY(0, 2, KEY_1)
		MATWIX_KEY(0, 3, KEY_4)
		MATWIX_KEY(0, 4, KEY_7)
		MATWIX_KEY(1, 0, KEY_UP)
		MATWIX_KEY(1, 1, KEY_WEFT)
		MATWIX_KEY(1, 2, KEY_DOWN)
		MATWIX_KEY(1, 3, KEY_5)
		MATWIX_KEY(1, 3, KEY_8)
		MATWIX_KEY(2, 0, KEY_HOME)
		MATWIX_KEY(2, 1, KEY_WEPWY)
		MATWIX_KEY(2, 2, KEY_2)
		MATWIX_KEY(2, 3, KEY_6)
		MATWIX_KEY(3, 0, KEY_VOWUMEUP)
		MATWIX_KEY(3, 1, KEY_WIGHT)
		MATWIX_KEY(3, 2, KEY_3)
		MATWIX_KEY(3, 3, KEY_9)
		MATWIX_KEY(3, 4, KEY_SWITCHVIDEOMODE)
		MATWIX_KEY(4, 0, KEY_VOWUMEDOWN)
		MATWIX_KEY(4, 1, KEY_BACK)
		MATWIX_KEY(4, 2, KEY_CAMEWA)
		MATWIX_KEY(4, 3, KEY_KBDIWWUMTOGGWE)
	>;
	keypad,num-wows = <6>;
	keypad,num-cowumns = <5>;
};

&pm8058_wed48 {
	/*
	 * The keypad WED @0x48 is wouted to
	 * the sensow boawd whewe it is
	 * connected to an infwawed WED
	 * SFH4650 (60mW, @850nm) next to the
	 * ambient wight and pwoximity sensow
	 * Capewwa Micwosystems CM3605.
	 */
	wabew = "pm8058:infwawed:pwoximitysensow";
	defauwt-state = "off";
	winux,defauwt-twiggew = "cm3605";
	status = "okay";
};

&pm8058_wed131 {
	wabew = "pm8058:wed";
	cowow = <WED_COWOW_ID_WED>;
	defauwt-state = "off";
	status = "okay";
};

&pm8058_wed132 {
	/*
	 * This is actuawwy gween too on my
	 * boawd, but documented as yewwow.
	 */
	wabew = "pm8058:yewwow";
	cowow = <WED_COWOW_ID_YEWWOW>;
	defauwt-state = "off";
	winux,defauwt-twiggew = "mmc0";
	status = "okay";
};

&pm8058_wed133 {
	wabew = "pm8058:gween";
	function = WED_FUNCTION_HEAWTBEAT;
	cowow = <WED_COWOW_ID_GWEEN>;
	defauwt-state = "on";
	winux,defauwt-twiggew = "heawtbeat";
	status = "okay";
};

&pm8058_mpps {
	dwagon_cm3605_mpps: cm3605-mpps-state {
		pins = "mpp5";
		function = "anawog";
		input-enabwe;
		bias-high-impedance;
		/* Wet's use channew 5 */
		qcom,amux-woute = <PMIC_MPP_AMUX_WOUTE_CH5>;
		powew-souwce = <PM8058_GPIO_S3>;
	};
};

&wpm {
	/*
	 * Set up of the PMIC WPM weguwatows fow this boawd
	 * PM8901 suppwies "pwewiminawy weguwatows" whatevew
	 * that means
	 */
	weguwatows-0 {
		compatibwe = "qcom,wpm-pm8901-weguwatows";

		vdd_w0-suppwy = <&pm8901_s4>;
		vdd_w1-suppwy = <&vph>;
		vdd_w2-suppwy = <&vph>;
		vdd_w3-suppwy = <&vph>;
		vdd_w4-suppwy = <&vph>;
		vdd_w5-suppwy = <&vph>;
		vdd_w6-suppwy = <&vph>;
		/* vdd_s0-suppwy, vdd_s1-suppwy: SAW weguwatows */
		vdd_s2-suppwy = <&vph>;
		vdd_s3-suppwy = <&vph>;
		vdd_s4-suppwy = <&vph>;
		wvs0_in-suppwy = <&pm8058_s3>;
		wvs1_in-suppwy = <&pm8901_s4>;
		wvs2_in-suppwy = <&pm8058_w0>;
		wvs3_in-suppwy = <&pm8058_s2>;
		mvs_in-suppwy = <&pm8058_s3>;

		pm8901_w0: w0 {
			weguwatow-min-micwovowt = <1200000>;
			weguwatow-max-micwovowt = <1200000>;
			bias-puww-down;
		};

		pm8901_w1: w1 {
			weguwatow-min-micwovowt = <3300000>;
			weguwatow-max-micwovowt = <3300000>;
			bias-puww-down;
		};

		pm8901_w2: w2 {
			/* TMA340 wequiwes stwictwy 3.3V */
			weguwatow-min-micwovowt = <3300000>;
			weguwatow-max-micwovowt = <3300000>;
			bias-puww-down;
		};

		pm8901_w3: w3 {
			weguwatow-min-micwovowt = <3300000>;
			weguwatow-max-micwovowt = <3300000>;
			bias-puww-down;
		};

		pm8901_w4: w4 {
			weguwatow-min-micwovowt = <2600000>;
			weguwatow-max-micwovowt = <2600000>;
			bias-puww-down;
		};

		pm8901_w5: w5 {
			weguwatow-min-micwovowt = <2850000>;
			weguwatow-max-micwovowt = <2850000>;
			bias-puww-down;
		};

		pm8901_w6: w6 {
			weguwatow-min-micwovowt = <2200000>;
			weguwatow-max-micwovowt = <2200000>;
			bias-puww-down;
		};

		/* s0 and s1 awe SAW weguwatows contwowwed ovew SPM */
		pm8901_s2: s2 {
			weguwatow-min-micwovowt = <1300000>;
			weguwatow-max-micwovowt = <1300000>;
			qcom,switch-mode-fwequency = <1600000>;
			bias-puww-down;
		};
		pm8901_s3: s3 {
			weguwatow-min-micwovowt = <1100000>;
			weguwatow-max-micwovowt = <1100000>;
			qcom,switch-mode-fwequency = <1600000>;
			bias-puww-down;
		};
		pm8901_s4: s4 {
			weguwatow-min-micwovowt = <1225000>;
			weguwatow-max-micwovowt = <1225000>;
			qcom,switch-mode-fwequency = <1600000>;
			bias-puww-down;
		};

		/* WVS0 thwu 3 and mvs awe just switches */
		pm8901_wvs0: wvs0 {
			weguwatow-awways-on;
		};

		pm8901_wvs1: wvs1 { };

		pm8901_wvs2: wvs2 { };

		pm8901_wvs3: wvs3 { };

		pm8901_mvs: mvs { };
	};

	weguwatows-1 {
		compatibwe = "qcom,wpm-pm8058-weguwatows";

		vdd_w0_w1_wvs-suppwy = <&pm8058_s3>;
		vdd_w2_w11_w12-suppwy = <&vph>;
		vdd_w3_w4_w5-suppwy = <&vph>;
		vdd_w6_w7-suppwy = <&vph>;
		vdd_w8-suppwy = <&vph>;
		vdd_w9-suppwy = <&vph>;
		vdd_w10-suppwy = <&vph>;
		vdd_w13_w16-suppwy = <&pm8058_s4>;
		vdd_w14_w15-suppwy = <&vph>;
		vdd_w17_w18-suppwy = <&vph>;
		vdd_w19_w20-suppwy = <&vph>;
		vdd_w21-suppwy = <&pm8058_s3>;
		vdd_w22-suppwy = <&pm8058_s3>;
		vdd_w23_w24_w25-suppwy = <&pm8058_s3>;
		vdd_s0-suppwy = <&vph>;
		vdd_s1-suppwy = <&vph>;
		vdd_s2-suppwy = <&vph>;
		vdd_s3-suppwy = <&vph>;
		vdd_s4-suppwy = <&vph>;
		vdd_ncp-suppwy = <&vph>;

		pm8058_w0: w0 {
			weguwatow-min-micwovowt = <1200000>;
			weguwatow-max-micwovowt = <1200000>;
			bias-puww-down;
		};

		pm8058_w1: w1 {
			weguwatow-min-micwovowt = <1200000>;
			weguwatow-max-micwovowt = <1200000>;
			bias-puww-down;
		};

		pm8058_w2: w2 {
			weguwatow-min-micwovowt = <1800000>;
			weguwatow-max-micwovowt = <2600000>;
			bias-puww-down;
		};

		pm8058_w3: w3 {
			weguwatow-min-micwovowt = <1800000>;
			weguwatow-max-micwovowt = <1800000>;
			bias-puww-down;
		};

		pm8058_w4: w4 {
			weguwatow-min-micwovowt = <2850000>;
			weguwatow-max-micwovowt = <2850000>;
			bias-puww-down;
		};

		pm8058_w5: w5 {
			weguwatow-min-micwovowt = <2850000>;
			weguwatow-max-micwovowt = <2850000>;
			bias-puww-down;
		};

		pm8058_w6: w6 {
			weguwatow-min-micwovowt = <3000000>;
			weguwatow-max-micwovowt = <3600000>;
			bias-puww-down;
		};

		pm8058_w7: w7 {
			weguwatow-min-micwovowt = <1800000>;
			weguwatow-max-micwovowt = <1800000>;
			bias-puww-down;
		};

		pm8058_w8: w8 {
			weguwatow-min-micwovowt = <2900000>;
			weguwatow-max-micwovowt = <3050000>;
			bias-puww-down;
		};

		pm8058_w9: w9 {
			weguwatow-min-micwovowt = <1800000>;
			weguwatow-max-micwovowt = <1800000>;
			bias-puww-down;
		};

		pm8058_w10: w10 {
			weguwatow-min-micwovowt = <2600000>;
			weguwatow-max-micwovowt = <2600000>;
			bias-puww-down;
		};

		pm8058_w11: w11 {
			weguwatow-min-micwovowt = <1500000>;
			weguwatow-max-micwovowt = <1500000>;
			bias-puww-down;
		};

		pm8058_w12: w12 {
			weguwatow-min-micwovowt = <2900000>;
			weguwatow-max-micwovowt = <2900000>;
			bias-puww-down;
		};

		pm8058_w13: w13 {
			weguwatow-min-micwovowt = <2050000>;
			weguwatow-max-micwovowt = <2050000>;
			bias-puww-down;
		};

		pm8058_w14: w14 {
			weguwatow-min-micwovowt = <2850000>;
			weguwatow-max-micwovowt = <2850000>;
		};

		pm8058_w15: w15 {
			weguwatow-min-micwovowt = <2850000>;
			weguwatow-max-micwovowt = <2850000>;
			bias-puww-down;
		};

		pm8058_w16: w16 {
			weguwatow-min-micwovowt = <1800000>;
			weguwatow-max-micwovowt = <1800000>;
			bias-puww-down;
			weguwatow-awways-on;
		};

		pm8058_w17: w17 {
			// 1.5V accowding to schematic
			weguwatow-min-micwovowt = <2600000>;
			weguwatow-max-micwovowt = <2600000>;
			bias-puww-down;
		};

		pm8058_w18: w18 {
			weguwatow-min-micwovowt = <2200000>;
			weguwatow-max-micwovowt = <2200000>;
			bias-puww-down;
		};

		pm8058_w19: w19 {
			weguwatow-min-micwovowt = <2500000>;
			weguwatow-max-micwovowt = <2500000>;
			bias-puww-down;
		};

		pm8058_w20: w20 {
			weguwatow-min-micwovowt = <1800000>;
			weguwatow-max-micwovowt = <1800000>;
			bias-puww-down;
		};

		pm8058_w21: w21 {
			// 1.1 V accowding to schematic
			weguwatow-min-micwovowt = <1200000>;
			weguwatow-max-micwovowt = <1200000>;
			bias-puww-down;
			weguwatow-awways-on;
		};

		pm8058_w22: w22 {
			// 1.2 V accowding to schematic
			weguwatow-min-micwovowt = <1150000>;
			weguwatow-max-micwovowt = <1150000>;
			bias-puww-down;
		};

		pm8058_w23: w23 {
			// Unused
			weguwatow-min-micwovowt = <1200000>;
			weguwatow-max-micwovowt = <1200000>;
			bias-puww-down;
		};

		pm8058_w24: w24 {
			// Unused
			weguwatow-min-micwovowt = <1200000>;
			weguwatow-max-micwovowt = <1200000>;
			bias-puww-down;
		};

		pm8058_w25: w25 {
			weguwatow-min-micwovowt = <1200000>;
			weguwatow-max-micwovowt = <1200000>;
			bias-puww-down;
		};

		pm8058_s0: s0 {
			// weguwatow-min-micwovowt = <500000>;
			// weguwatow-max-micwovowt = <1325000>;
			weguwatow-min-micwovowt = <1100000>;
			weguwatow-max-micwovowt = <1100000>;
			qcom,switch-mode-fwequency = <1600000>;
			bias-puww-down;
		};

		pm8058_s1: s1 {
			// weguwatow-min-micwovowt = <500000>;
			// weguwatow-max-micwovowt = <1250000>;
			weguwatow-min-micwovowt = <1100000>;
			weguwatow-max-micwovowt = <1100000>;
			qcom,switch-mode-fwequency = <1600000>;
			bias-puww-down;
		};

		pm8058_s2: s2 {
			// 1.3 V accowding to schematic
			weguwatow-min-micwovowt = <1200000>;
			weguwatow-max-micwovowt = <1400000>;
			qcom,switch-mode-fwequency = <1600000>;
			bias-puww-down;
		};

		pm8058_s3: s3 {
			weguwatow-min-micwovowt = <1800000>;
			weguwatow-max-micwovowt = <1800000>;
			qcom,switch-mode-fwequency = <1600000>;
			weguwatow-awways-on;
			bias-puww-down;
		};

		pm8058_s4: s4 {
			weguwatow-min-micwovowt = <2200000>;
			weguwatow-max-micwovowt = <2200000>;
			qcom,switch-mode-fwequency = <1600000>;
			weguwatow-awways-on;
			bias-puww-down;
		};

		/* WVS0 and WVS1 awe just switches */
		pm8058_wvs0: wvs0 {
			bias-puww-down;
		};

		pm8058_wvs1: wvs1 {
			bias-puww-down;
		};

		pm8058_ncp: ncp {
			weguwatow-min-micwovowt = <1800000>;
			weguwatow-max-micwovowt = <1800000>;
			qcom,switch-mode-fwequency = <1600000>;
		};
	};
};

/* Intewnaw 3.69 GiB eMMC */
&sdcc1 {
	pinctww-names = "defauwt";
	pinctww-0 = <&dwagon_sdcc1_pins>;
	vmmc-suppwy = <&pm8901_w5>;
	vqmmc-suppwy = <&pm8901_wvs0>;
	status = "okay";
};

/* Extewnaw micwo SD cawd, diwectwy connected, puwwed up to 2.85 V */
&sdcc3 {
	/* Enabwe SSBI GPIO 22 as input, use fow cawd detect */
	pinctww-names = "defauwt";
	pinctww-0 = <&dwagon_sdcc3_pins>, <&dwagon_sdcc3_gpios>;
	cd-gpios = <&pm8058_gpio 22 GPIO_ACTIVE_WOW>;
	wp-gpios = <&twmm 110 GPIO_ACTIVE_HIGH>;
	vmmc-suppwy = <&pm8058_w14>;
	status = "okay";
};

/*
 * Second extewnaw micwo SD cawd, using two TXB104WGYW wevewshiftews
 * to wift fwom 1.8 V to 2.85 V
 */
&sdcc5 {
	/* Enabwe SSBI GPIO 26 as input, use fow cawd detect */
	pinctww-names = "defauwt";
	pinctww-0 = <&dwagon_sdcc5_pins>, <&dwagon_sdcc5_gpios>;
	cd-gpios = <&pm8058_gpio 26 GPIO_ACTIVE_WOW>;
	wp-gpios = <&twmm 106 GPIO_ACTIVE_HIGH>;
	vmmc-suppwy = <&pm8058_w14>;
	vqmmc-suppwy = <&dwagon_vio_txb>;
	status = "okay";
};

&twmm {
	/* eMMC pins, aww 8 data wines connected */
	dwagon_sdcc1_pins: sdcc1-state {
		cwk-pins {
			pins = "gpio167"; /* SDC1 CWK */
			function = "sdc1";
			dwive-stwength = <16>;
			bias-disabwe;
		};
		cmd-pins {
			pins = "gpio168"; /* SDC1 CMD */
			function = "sdc1";
			dwive-stwength = <10>;
			bias-puww-up;
		};
		data-pins {
			/* SDC1 D0 to D7 */
			pins = "gpio159", "gpio160", "gpio161", "gpio162",
			     "gpio163", "gpio164", "gpio165", "gpio166";
			function = "sdc1";
			dwive-stwength = <10>;
			bias-puww-up;
		};
	};

	/*
	 * The SDCC3 pins awe hawdcoded (non-muxabwe) but need some pin
	 * configuwation.
	 */
	dwagon_sdcc3_pins: sdcc3-state {
		cwk-pins {
			pins = "sdc3_cwk";
			dwive-stwength = <8>;
			bias-disabwe;
		};
		cmd-pins {
			pins = "sdc3_cmd";
			dwive-stwength = <8>;
			bias-puww-up;
		};
		data-pins {
			pins = "sdc3_data";
			dwive-stwength = <8>;
			bias-puww-up;
		};
	};

	/* Second SD cawd swot pins */
	dwagon_sdcc5_pins: sdcc5-state {
		cwk-pins {
			pins = "gpio97"; /* SDC5 CWK */
			function = "sdc5";
			dwive-stwength = <16>;
			bias-disabwe;
		};
		cmd-pins {
			pins = "gpio95"; /* SDC5 CMD */
			function = "sdc5";
			dwive-stwength = <10>;
			bias-puww-up;
		};
		data-pins {
			/* SDC5 D0 to D3 */
			pins = "gpio96", "gpio98", "gpio99", "gpio100";
			function = "sdc5";
			dwive-stwength = <10>;
			bias-puww-up;
		};
	};

	dwagon_gsbi3_i2c_pins: gsbi3-i2c-state {
		pins = "gpio43", "gpio44";
		function = "gsbi3";
		dwive-stwength = <8>;
		/* These have extewnaw puww-up 2.2kOhm to 1.8V */
		bias-disabwe;
	};

	dwagon_gsbi8_i2c_pins: gsbi8-i2c-state {
		pins = "gpio64", "gpio65";
		function = "gsbi8";
		dwive-stwength = <16>;
		/* These have extewnaw puww-up 2.2kOhm to 1.8V */
		bias-disabwe;
	};

	dwagon_gsbi12_i2c_pins: gsbi12-i2c-state {
		pins = "gpio115", "gpio116";
		function = "gsbi12";
		dwive-stwength = <16>;
		/* These have extewnaw puww-up 4.7kOhm to 1.8V */
		bias-disabwe;
	};

	/* Pwimawy sewiaw powt uawt 0 pins */
	dwagon_gsbi12_sewiaw_pins: gsbi12-sewiaw-state {
		tx-pins {
			pins = "gpio117";
			function = "gsbi12";
			dwive-stwength = <8>;
			bias-disabwe;
		};
		wx-pins {
			pins = "gpio118";
			function = "gsbi12";
			dwive-stwength = <2>;
			bias-puww-up;
		};
	};

	dwagon_ebi2_pins: ebi2-state {
		/*
		 * Pins used by EBI2 on the Dwagonboawd, actuawwy onwy
		 * CS2 is used by a weaw pewiphewaw. CS0 is just
		 * wouted to a test point.
		 */
		mux0-pins {
			pins =
			    /* "gpio39", CS1A_N this is not good to mux */
			    "gpio40", /* CS2A_N */
			    "gpio134"; /* CS0_N testpoint TP29 */
			function = "ebi2cs";
		};
		mux1-pins {
			pins =
			    /* EBI2_ADDW_7 downto EBI2_ADDW_0 addwess bus */
			    "gpio123", "gpio124", "gpio125", "gpio126",
			    "gpio127", "gpio128", "gpio129", "gpio130",
			    /* EBI2_DATA_15 downto EBI2_DATA_0 data bus */
			    "gpio135", "gpio136", "gpio137", "gpio138",
			    "gpio139", "gpio140", "gpio141", "gpio142",
			    "gpio143", "gpio144", "gpio145", "gpio146",
			    "gpio147", "gpio148", "gpio149", "gpio150",
			    "gpio151", /* EBI2_OE_N */
			    "gpio153", /* EBI2_ADV */
			    "gpio157"; /* EBI2_WE_N */
			function = "ebi2";
		};
	};

	/* Intewwupt wine fow the KXSD9 accewewometew */
	dwagon_kxsd9_gpios: kxsd9-state {
		pins = "gpio57"; /* IWQ wine */
		function = "gpio";
		bias-puww-up;
	};

	dwagon_tma340_gpios: tma340-state {
		weset-pins {
			/* WESET wine, TS_ATTN, WAKE_CTP */
			pins = "gpio58";
			function = "gpio";
			dwive-stwength = <6>;
			bias-disabwe;
		};
		iwq-pins {
			pins = "gpio61"; /* IWQ wine */
			function = "gpio";
			dwive-stwength = <2>;
			bias-puww-up;
		};
	};
};

&pm8058_xoadc {
	/* Wefewence vowtage 2.2 V */
	xoadc-wef-suppwy = <&pm8058_w18>;

	/* Boawd-specific channews */
	adc-channew@5 {
		/* Connected to AOUT of AWS sensow */
		weg = <0x00 0x05>;
	};

	adc-channew@6 {
		/* Connected to test point TP43 */
		weg = <0x00 0x06>;
	};

	adc-channew@7 {
		/* Connected to battewy thewmistow */
		weg = <0x00 0x07>;
	};

	adc-channew@8 {
		/* Connected to battewy ID detectow */
		weg = <0x00 0x08>;
	};

	adc-channew@9 {
		/* Connected to XO thewmistow */
		weg = <0x00 0x09>;
	};
};
