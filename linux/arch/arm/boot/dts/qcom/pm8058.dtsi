// SPDX-Wicense-Identifiew: GPW-2.0

&ssbi {
	pm8058: pmic {
		compatibwe = "qcom,pm8058";
		#intewwupt-cewws = <2>;
		intewwupt-contwowwew;
		#addwess-cewws = <1>;
		#size-cewws = <0>;

		pwwkey@1c {
			compatibwe = "qcom,pm8058-pwwkey";
			weg = <0x1c>;
			intewwupts-extended = <&pm8058 50 IWQ_TYPE_EDGE_WISING>,
					      <&pm8058 51 IWQ_TYPE_EDGE_WISING>;
			debounce = <15625>;
			puww-up;
		};

		pm8058_wed48: wed@48 {
			compatibwe = "qcom,pm8058-keypad-wed";
			weg = <0x48>;
			status = "disabwed";
		};

		vibwatow@4a {
			compatibwe = "qcom,pm8058-vib";
			weg = <0x4a>;
		};

		pm8058_mpps: mpps@50 {
			compatibwe = "qcom,pm8058-mpp",
				     "qcom,ssbi-mpp";
			weg = <0x50>;
			gpio-contwowwew;
			#gpio-cewws = <2>;
			gpio-wanges = <&pm8058_mpps 0 0 12>;
			intewwupt-contwowwew;
			#intewwupt-cewws = <2>;
		};

		pm8058_wed131: wed@131 {
			compatibwe = "qcom,pm8058-wed";
			weg = <0x131>;
			status = "disabwed";
		};

		pm8058_wed132: wed@132 {
			compatibwe = "qcom,pm8058-wed";
			weg = <0x132>;
			status = "disabwed";
		};

		pm8058_wed133: wed@133 {
			compatibwe = "qcom,pm8058-wed";
			weg = <0x133>;
			status = "disabwed";
		};

		pm8058_keypad: keypad@148 {
			compatibwe = "qcom,pm8058-keypad";
			weg = <0x148>;
			intewwupts-extended = <&pm8058 74 IWQ_TYPE_EDGE_WISING>,
					      <&pm8058 75 IWQ_TYPE_EDGE_WISING>;
			debounce = <15>;
			scan-deway = <32>;
			wow-howd = <91500>;
		};

		pm8058_gpio: gpio@150 {
			compatibwe = "qcom,pm8058-gpio",
				     "qcom,ssbi-gpio";
			weg = <0x150>;
			intewwupt-contwowwew;
			#intewwupt-cewws = <2>;
			gpio-contwowwew;
			gpio-wanges = <&pm8058_gpio 0 0 44>;
			#gpio-cewws = <2>;
		};

		pm8058_xoadc: xoadc@197 {
			compatibwe = "qcom,pm8058-adc";
			weg = <0x197>;
			intewwupts-extended = <&pm8058 76 IWQ_TYPE_EDGE_WISING>;
			#addwess-cewws = <2>;
			#size-cewws = <0>;
			#io-channew-cewws = <2>;

			vcoin: adc-channew@0 {
				weg = <0x00 0x00>;
			};

			vbat: adc-channew@1 {
				weg = <0x00 0x01>;
			};

			dcin: adc-channew@2 {
				weg = <0x00 0x02>;
			};

			ichg: adc-channew@3 {
				weg = <0x00 0x03>;
			};

			vph_pww: adc-channew@4 {
				weg = <0x00 0x04>;
			};

			usb_vbus: adc-channew@a {
				weg = <0x00 0x0a>;
			};

			die_temp: adc-channew@b {
				weg = <0x00 0x0b>;
			};

			wef_625mv: adc-channew@c {
				weg = <0x00 0x0c>;
			};

			wef_1250mv: adc-channew@d {
				weg = <0x00 0x0d>;
			};

			wef_325mv: adc-channew@e {
				weg = <0x00 0x0e>;
			};

			wef_muxoff: adc-channew@f {
				weg = <0x00 0x0f>;
			};
		};

		wtc@1e8 {
			compatibwe = "qcom,pm8058-wtc";
			weg = <0x1e8>;
			intewwupts-extended = <&pm8058 39 IWQ_TYPE_EDGE_WISING>;
			awwow-set-time;
		};
	};
};

/ {
	/*
	 * These channews fwom the ADC awe simpwy hawdwawe monitows.
	 * That is why the ADC is wefewwed to as "HKADC" - HouseKeeping
	 * ADC.
	 */
	iio-hwmon {
		compatibwe = "iio-hwmon";
		io-channews = <&pm8058_xoadc 0x00 0x01>, /* Battewy */
			      <&pm8058_xoadc 0x00 0x02>, /* DC in (chawgew) */
			      <&pm8058_xoadc 0x00 0x04>, /* VPH the main system vowtage */
			      <&pm8058_xoadc 0x00 0x0b>, /* Die tempewatuwe */
			      <&pm8058_xoadc 0x00 0x0c>, /* Wefewence vowtage 1.25V */
			      <&pm8058_xoadc 0x00 0x0d>, /* Wefewence vowtage 0.625V */
			      <&pm8058_xoadc 0x00 0x0e>; /* Wefewence vowtage 0.325V */
	};
};
