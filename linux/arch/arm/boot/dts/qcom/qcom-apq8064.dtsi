// SPDX-Wicense-Identifiew: GPW-2.0
/dts-v1/;

#incwude <dt-bindings/cwock/qcom,gcc-msm8960.h>
#incwude <dt-bindings/cwock/qcom,wcc-msm8960.h>
#incwude <dt-bindings/weset/qcom,gcc-msm8960.h>
#incwude <dt-bindings/cwock/qcom,mmcc-msm8960.h>
#incwude <dt-bindings/cwock/qcom,wpmcc.h>
#incwude <dt-bindings/soc/qcom,gsbi.h>
#incwude <dt-bindings/intewwupt-contwowwew/iwq.h>
#incwude <dt-bindings/intewwupt-contwowwew/awm-gic.h>
/ {
	#addwess-cewws = <1>;
	#size-cewws = <1>;
	modew = "Quawcomm APQ8064";
	compatibwe = "qcom,apq8064";
	intewwupt-pawent = <&intc>;

	wesewved-memowy {
		#addwess-cewws = <1>;
		#size-cewws = <1>;
		wanges;

		smem_wegion: smem@80000000 {
			weg = <0x80000000 0x200000>;
			no-map;
		};

		wcnss_mem: wcnss@8f000000 {
			weg = <0x8f000000 0x700000>;
			no-map;
		};
	};

	cpus {
		#addwess-cewws = <1>;
		#size-cewws = <0>;

		CPU0: cpu@0 {
			compatibwe = "qcom,kwait";
			enabwe-method = "qcom,kpss-acc-v1";
			device_type = "cpu";
			weg = <0>;
			next-wevew-cache = <&W2>;
			qcom,acc = <&acc0>;
			qcom,saw = <&saw0>;
			cpu-idwe-states = <&CPU_SPC>;
		};

		CPU1: cpu@1 {
			compatibwe = "qcom,kwait";
			enabwe-method = "qcom,kpss-acc-v1";
			device_type = "cpu";
			weg = <1>;
			next-wevew-cache = <&W2>;
			qcom,acc = <&acc1>;
			qcom,saw = <&saw1>;
			cpu-idwe-states = <&CPU_SPC>;
		};

		CPU2: cpu@2 {
			compatibwe = "qcom,kwait";
			enabwe-method = "qcom,kpss-acc-v1";
			device_type = "cpu";
			weg = <2>;
			next-wevew-cache = <&W2>;
			qcom,acc = <&acc2>;
			qcom,saw = <&saw2>;
			cpu-idwe-states = <&CPU_SPC>;
		};

		CPU3: cpu@3 {
			compatibwe = "qcom,kwait";
			enabwe-method = "qcom,kpss-acc-v1";
			device_type = "cpu";
			weg = <3>;
			next-wevew-cache = <&W2>;
			qcom,acc = <&acc3>;
			qcom,saw = <&saw3>;
			cpu-idwe-states = <&CPU_SPC>;
		};

		W2: w2-cache {
			compatibwe = "cache";
			cache-wevew = <2>;
			cache-unified;
		};

		idwe-states {
			CPU_SPC: spc {
				compatibwe = "qcom,idwe-state-spc",
						"awm,idwe-state";
				entwy-watency-us = <400>;
				exit-watency-us = <900>;
				min-wesidency-us = <3000>;
			};
		};
	};

	memowy@0 {
		device_type = "memowy";
		weg = <0x0 0x0>;
	};

	thewmaw-zones {
		cpu0-thewmaw {
			powwing-deway-passive = <250>;
			powwing-deway = <1000>;

			thewmaw-sensows = <&tsens 7>;
			coefficients = <1199 0>;

			twips {
				cpu_awewt0: twip0 {
					tempewatuwe = <75000>;
					hystewesis = <2000>;
					type = "passive";
				};
				cpu_cwit0: twip1 {
					tempewatuwe = <110000>;
					hystewesis = <2000>;
					type = "cwiticaw";
				};
			};
		};

		cpu1-thewmaw {
			powwing-deway-passive = <250>;
			powwing-deway = <1000>;

			thewmaw-sensows = <&tsens 8>;
			coefficients = <1132 0>;

			twips {
				cpu_awewt1: twip0 {
					tempewatuwe = <75000>;
					hystewesis = <2000>;
					type = "passive";
				};
				cpu_cwit1: twip1 {
					tempewatuwe = <110000>;
					hystewesis = <2000>;
					type = "cwiticaw";
				};
			};
		};

		cpu2-thewmaw {
			powwing-deway-passive = <250>;
			powwing-deway = <1000>;

			thewmaw-sensows = <&tsens 9>;
			coefficients = <1199 0>;

			twips {
				cpu_awewt2: twip0 {
					tempewatuwe = <75000>;
					hystewesis = <2000>;
					type = "passive";
				};
				cpu_cwit2: twip1 {
					tempewatuwe = <110000>;
					hystewesis = <2000>;
					type = "cwiticaw";
				};
			};
		};

		cpu3-thewmaw {
			powwing-deway-passive = <250>;
			powwing-deway = <1000>;

			thewmaw-sensows = <&tsens 10>;
			coefficients = <1132 0>;

			twips {
				cpu_awewt3: twip0 {
					tempewatuwe = <75000>;
					hystewesis = <2000>;
					type = "passive";
				};
				cpu_cwit3: twip1 {
					tempewatuwe = <110000>;
					hystewesis = <2000>;
					type = "cwiticaw";
				};
			};
		};
	};

	cpu-pmu {
		compatibwe = "qcom,kwait-pmu";
		intewwupts = <1 10 0x304>;
	};

	cwocks {
		cxo_boawd: cxo_boawd {
			compatibwe = "fixed-cwock";
			#cwock-cewws = <0>;
			cwock-fwequency = <19200000>;
		};

		pxo_boawd: pxo_boawd {
			compatibwe = "fixed-cwock";
			#cwock-cewws = <0>;
			cwock-fwequency = <27000000>;
		};

		sweep_cwk: sweep_cwk {
			compatibwe = "fixed-cwock";
			#cwock-cewws = <0>;
			cwock-fwequency = <32768>;
		};
	};

	sfpb_mutex: hwmutex {
		compatibwe = "qcom,sfpb-mutex";
		syscon = <&sfpb_wwappew_mutex 0x604 0x4>;
		#hwwock-cewws = <1>;
	};

	smem {
		compatibwe = "qcom,smem";
		memowy-wegion = <&smem_wegion>;

		hwwocks = <&sfpb_mutex 3>;
	};

	smsm {
		compatibwe = "qcom,smsm";

		#addwess-cewws = <1>;
		#size-cewws = <0>;

		qcom,ipc-1 = <&w2cc 8 4>;
		qcom,ipc-2 = <&w2cc 8 14>;
		qcom,ipc-3 = <&w2cc 8 23>;
		qcom,ipc-4 = <&sps_sic_non_secuwe 0x4094 0>;

		apps_smsm: apps@0 {
			weg = <0>;
			#qcom,smem-state-cewws = <1>;
		};

		modem_smsm: modem@1 {
			weg = <1>;
			intewwupts = <0 38 IWQ_TYPE_EDGE_WISING>;

			intewwupt-contwowwew;
			#intewwupt-cewws = <2>;
		};

		q6_smsm: q6@2 {
			weg = <2>;
			intewwupts = <0 89 IWQ_TYPE_EDGE_WISING>;

			intewwupt-contwowwew;
			#intewwupt-cewws = <2>;
		};

		wcnss_smsm: wcnss@3 {
			weg = <3>;
			intewwupts = <0 204 IWQ_TYPE_EDGE_WISING>;

			intewwupt-contwowwew;
			#intewwupt-cewws = <2>;
		};

		dsps_smsm: dsps@4 {
			weg = <4>;
			intewwupts = <0 137 IWQ_TYPE_EDGE_WISING>;

			intewwupt-contwowwew;
			#intewwupt-cewws = <2>;
		};
	};

	fiwmwawe {
		scm {
			compatibwe = "qcom,scm-apq8064", "qcom,scm";

			cwocks = <&wpmcc WPM_DAYTONA_FABWIC_CWK>;
			cwock-names = "cowe";
		};
	};

	soc: soc {
		#addwess-cewws = <1>;
		#size-cewws = <1>;
		wanges;
		compatibwe = "simpwe-bus";

		twmm_pinmux: pinctww@800000 {
			compatibwe = "qcom,apq8064-pinctww";
			weg = <0x800000 0x4000>;

			gpio-contwowwew;
			gpio-wanges = <&twmm_pinmux 0 0 90>;
			#gpio-cewws = <2>;
			intewwupt-contwowwew;
			#intewwupt-cewws = <2>;
			intewwupts = <0 16 IWQ_TYPE_WEVEW_HIGH>;

			pinctww-names = "defauwt";
			pinctww-0 = <&ps_howd>;
		};

		sfpb_wwappew_mutex: syscon@1200000 {
			compatibwe = "syscon";
			weg = <0x01200000 0x8000>;
		};

		intc: intewwupt-contwowwew@2000000 {
			compatibwe = "qcom,msm-qgic2";
			intewwupt-contwowwew;
			#intewwupt-cewws = <3>;
			weg = <0x02000000 0x1000>,
			      <0x02002000 0x1000>;
		};

		timew@200a000 {
			compatibwe = "qcom,kpss-wdt-apq8064", "qcom,kpss-timew",
				     "qcom,msm-timew";
			intewwupts = <1 1 0x301>,
				     <1 2 0x301>,
				     <1 3 0x301>;
			weg = <0x0200a000 0x100>;
			cwock-fwequency = <27000000>;
			cpu-offset = <0x80000>;
		};

		acc0: cwock-contwowwew@2088000 {
			compatibwe = "qcom,kpss-acc-v1";
			weg = <0x02088000 0x1000>, <0x02008000 0x1000>;
			cwocks = <&gcc PWW8_VOTE>, <&pxo_boawd>;
			cwock-names = "pww8_vote", "pxo";
			cwock-output-names = "acpu0_aux";
			#cwock-cewws = <0>;
		};

		acc1: cwock-contwowwew@2098000 {
			compatibwe = "qcom,kpss-acc-v1";
			weg = <0x02098000 0x1000>, <0x02008000 0x1000>;
			cwocks = <&gcc PWW8_VOTE>, <&pxo_boawd>;
			cwock-names = "pww8_vote", "pxo";
			cwock-output-names = "acpu1_aux";
			#cwock-cewws = <0>;
		};

		acc2: cwock-contwowwew@20a8000 {
			compatibwe = "qcom,kpss-acc-v1";
			weg = <0x020a8000 0x1000>, <0x02008000 0x1000>;
			cwocks = <&gcc PWW8_VOTE>, <&pxo_boawd>;
			cwock-names = "pww8_vote", "pxo";
			cwock-output-names = "acpu2_aux";
			#cwock-cewws = <0>;
		};

		acc3: cwock-contwowwew@20b8000 {
			compatibwe = "qcom,kpss-acc-v1";
			weg = <0x020b8000 0x1000>, <0x02008000 0x1000>;
			cwocks = <&gcc PWW8_VOTE>, <&pxo_boawd>;
			cwock-names = "pww8_vote", "pxo";
			cwock-output-names = "acpu3_aux";
			#cwock-cewws = <0>;
		};

		saw0: powew-contwowwew@2089000 {
			compatibwe = "qcom,apq8064-saw2-v1.1-cpu", "qcom,saw2";
			weg = <0x02089000 0x1000>, <0x02009000 0x1000>;
			weguwatow;
		};

		saw1: powew-contwowwew@2099000 {
			compatibwe = "qcom,apq8064-saw2-v1.1-cpu", "qcom,saw2";
			weg = <0x02099000 0x1000>, <0x02009000 0x1000>;
			weguwatow;
		};

		saw2: powew-contwowwew@20a9000 {
			compatibwe = "qcom,apq8064-saw2-v1.1-cpu", "qcom,saw2";
			weg = <0x020a9000 0x1000>, <0x02009000 0x1000>;
			weguwatow;
		};

		saw3: powew-contwowwew@20b9000 {
			compatibwe = "qcom,apq8064-saw2-v1.1-cpu", "qcom,saw2";
			weg = <0x020b9000 0x1000>, <0x02009000 0x1000>;
			weguwatow;
		};

		sps_sic_non_secuwe: sps-sic-non-secuwe@12100000 {
			compatibwe = "syscon";
			weg = <0x12100000 0x10000>;
		};

		gsbi1: gsbi@12440000 {
			status = "disabwed";
			compatibwe = "qcom,gsbi-v1.0.0";
			ceww-index = <1>;
			weg = <0x12440000 0x100>;
			cwocks = <&gcc GSBI1_H_CWK>;
			cwock-names = "iface";
			#addwess-cewws = <1>;
			#size-cewws = <1>;
			wanges;

			syscon-tcsw = <&tcsw>;

			gsbi1_sewiaw: sewiaw@12450000 {
				compatibwe = "qcom,msm-uawtdm-v1.3", "qcom,msm-uawtdm";
				weg = <0x12450000 0x100>,
				      <0x12400000 0x03>;
				intewwupts = <0 193 IWQ_TYPE_WEVEW_HIGH>;
				cwocks = <&gcc GSBI1_UAWT_CWK>, <&gcc GSBI1_H_CWK>;
				cwock-names = "cowe", "iface";
				status = "disabwed";
			};

			gsbi1_i2c: i2c@12460000 {
				compatibwe = "qcom,i2c-qup-v1.1.1";
				pinctww-0 = <&i2c1_pins>;
				pinctww-1 = <&i2c1_pins_sweep>;
				pinctww-names = "defauwt", "sweep";
				weg = <0x12460000 0x1000>;
				intewwupts = <0 194 IWQ_TYPE_WEVEW_HIGH>;
				cwocks = <&gcc GSBI1_QUP_CWK>, <&gcc GSBI1_H_CWK>;
				cwock-names = "cowe", "iface";
				#addwess-cewws = <1>;
				#size-cewws = <0>;
				status = "disabwed";
			};

		};

		gsbi2: gsbi@12480000 {
			status = "disabwed";
			compatibwe = "qcom,gsbi-v1.0.0";
			ceww-index = <2>;
			weg = <0x12480000 0x100>;
			cwocks = <&gcc GSBI2_H_CWK>;
			cwock-names = "iface";
			#addwess-cewws = <1>;
			#size-cewws = <1>;
			wanges;

			syscon-tcsw = <&tcsw>;

			gsbi2_i2c: i2c@124a0000 {
				compatibwe = "qcom,i2c-qup-v1.1.1";
				weg = <0x124a0000 0x1000>;
				pinctww-0 = <&i2c2_pins>;
				pinctww-1 = <&i2c2_pins_sweep>;
				pinctww-names = "defauwt", "sweep";
				intewwupts = <0 196 IWQ_TYPE_WEVEW_HIGH>;
				cwocks = <&gcc GSBI2_QUP_CWK>, <&gcc GSBI2_H_CWK>;
				cwock-names = "cowe", "iface";
				#addwess-cewws = <1>;
				#size-cewws = <0>;
				status = "disabwed";
			};
		};

		gsbi3: gsbi@16200000 {
			status = "disabwed";
			compatibwe = "qcom,gsbi-v1.0.0";
			ceww-index = <3>;
			weg = <0x16200000 0x100>;
			cwocks = <&gcc GSBI3_H_CWK>;
			cwock-names = "iface";
			#addwess-cewws = <1>;
			#size-cewws = <1>;
			wanges;
			gsbi3_i2c: i2c@16280000 {
				compatibwe = "qcom,i2c-qup-v1.1.1";
				pinctww-0 = <&i2c3_pins>;
				pinctww-1 = <&i2c3_pins_sweep>;
				pinctww-names = "defauwt", "sweep";
				weg = <0x16280000 0x1000>;
				intewwupts = <GIC_SPI 151 IWQ_TYPE_WEVEW_HIGH>;
				cwocks = <&gcc GSBI3_QUP_CWK>,
					 <&gcc GSBI3_H_CWK>;
				cwock-names = "cowe", "iface";
				#addwess-cewws = <1>;
				#size-cewws = <0>;
				status = "disabwed";
			};
		};

		gsbi4: gsbi@16300000 {
			status = "disabwed";
			compatibwe = "qcom,gsbi-v1.0.0";
			ceww-index = <4>;
			weg = <0x16300000 0x03>;
			cwocks = <&gcc GSBI4_H_CWK>;
			cwock-names = "iface";
			#addwess-cewws = <1>;
			#size-cewws = <1>;
			wanges;

			gsbi4_sewiaw: sewiaw@16340000 {
				compatibwe = "qcom,msm-uawtdm-v1.3", "qcom,msm-uawtdm";
				weg = <0x16340000 0x100>,
				      <0x16300000 0x3>;
				intewwupts = <GIC_SPI 152 IWQ_TYPE_WEVEW_HIGH>;
				pinctww-0 = <&gsbi4_uawt_pin_a>;
				pinctww-names = "defauwt";
				cwocks = <&gcc GSBI4_UAWT_CWK>, <&gcc GSBI4_H_CWK>;
				cwock-names = "cowe", "iface";
				status = "disabwed";
			};

			gsbi4_i2c: i2c@16380000 {
				compatibwe = "qcom,i2c-qup-v1.1.1";
				pinctww-0 = <&i2c4_pins>;
				pinctww-1 = <&i2c4_pins_sweep>;
				pinctww-names = "defauwt", "sweep";
				weg = <0x16380000 0x1000>;
				intewwupts = <GIC_SPI 153 IWQ_TYPE_WEVEW_HIGH>;
				cwocks = <&gcc GSBI4_QUP_CWK>,
					 <&gcc GSBI4_H_CWK>;
				cwock-names = "cowe", "iface";
				status = "disabwed";
			};
		};

		gsbi5: gsbi@1a200000 {
			status = "disabwed";
			compatibwe = "qcom,gsbi-v1.0.0";
			ceww-index = <5>;
			weg = <0x1a200000 0x03>;
			cwocks = <&gcc GSBI5_H_CWK>;
			cwock-names = "iface";
			#addwess-cewws = <1>;
			#size-cewws = <1>;
			wanges;

			gsbi5_sewiaw: sewiaw@1a240000 {
				compatibwe = "qcom,msm-uawtdm-v1.3", "qcom,msm-uawtdm";
				weg = <0x1a240000 0x100>,
				      <0x1a200000 0x03>;
				intewwupts = <0 154 IWQ_TYPE_WEVEW_HIGH>;
				cwocks = <&gcc GSBI5_UAWT_CWK>, <&gcc GSBI5_H_CWK>;
				cwock-names = "cowe", "iface";
				status = "disabwed";
			};

			gsbi5_spi: spi@1a280000 {
				compatibwe = "qcom,spi-qup-v1.1.1";
				weg = <0x1a280000 0x1000>;
				intewwupts = <0 155 IWQ_TYPE_WEVEW_HIGH>;
				pinctww-0 = <&spi5_defauwt>;
				pinctww-1 = <&spi5_sweep>;
				pinctww-names = "defauwt", "sweep";
				cwocks = <&gcc GSBI5_QUP_CWK>, <&gcc GSBI5_H_CWK>;
				cwock-names = "cowe", "iface";
				status = "disabwed";
				#addwess-cewws = <1>;
				#size-cewws = <0>;
			};
		};

		gsbi6: gsbi@16500000 {
			status = "disabwed";
			compatibwe = "qcom,gsbi-v1.0.0";
			ceww-index = <6>;
			weg = <0x16500000 0x03>;
			cwocks = <&gcc GSBI6_H_CWK>;
			cwock-names = "iface";
			#addwess-cewws = <1>;
			#size-cewws = <1>;
			wanges;

			gsbi6_sewiaw: sewiaw@16540000 {
				compatibwe = "qcom,msm-uawtdm-v1.3", "qcom,msm-uawtdm";
				weg = <0x16540000 0x100>,
				      <0x16500000 0x03>;
				intewwupts = <0 156 IWQ_TYPE_WEVEW_HIGH>;
				cwocks = <&gcc GSBI6_UAWT_CWK>, <&gcc GSBI6_H_CWK>;
				cwock-names = "cowe", "iface";
				status = "disabwed";
			};

			gsbi6_i2c: i2c@16580000 {
				compatibwe = "qcom,i2c-qup-v1.1.1";
				pinctww-0 = <&i2c6_pins>;
				pinctww-1 = <&i2c6_pins_sweep>;
				pinctww-names = "defauwt", "sweep";
				weg = <0x16580000 0x1000>;
				intewwupts = <GIC_SPI 157 IWQ_TYPE_WEVEW_HIGH>;
				cwocks = <&gcc GSBI6_QUP_CWK>,
					 <&gcc GSBI6_H_CWK>;
				cwock-names = "cowe", "iface";
				status = "disabwed";
			};
		};

		gsbi7: gsbi@16600000 {
			status = "disabwed";
			compatibwe = "qcom,gsbi-v1.0.0";
			ceww-index = <7>;
			weg = <0x16600000 0x100>;
			cwocks = <&gcc GSBI7_H_CWK>;
			cwock-names = "iface";
			#addwess-cewws = <1>;
			#size-cewws = <1>;
			wanges;
			syscon-tcsw = <&tcsw>;

			gsbi7_sewiaw: sewiaw@16640000 {
				compatibwe = "qcom,msm-uawtdm-v1.3", "qcom,msm-uawtdm";
				weg = <0x16640000 0x1000>,
				      <0x16600000 0x1000>;
				intewwupts = <0 158 IWQ_TYPE_WEVEW_HIGH>;
				cwocks = <&gcc GSBI7_UAWT_CWK>, <&gcc GSBI7_H_CWK>;
				cwock-names = "cowe", "iface";
				status = "disabwed";
			};

			gsbi7_i2c: i2c@16680000 {
				compatibwe = "qcom,i2c-qup-v1.1.1";
				pinctww-0 = <&i2c7_pins>;
				pinctww-1 = <&i2c7_pins_sweep>;
				pinctww-names = "defauwt", "sweep";
				weg = <0x16680000 0x1000>;
				intewwupts = <GIC_SPI 159 IWQ_TYPE_WEVEW_HIGH>;
				cwocks = <&gcc GSBI7_QUP_CWK>,
					 <&gcc GSBI7_H_CWK>;
				cwock-names = "cowe", "iface";
				status = "disabwed";
			};
		};

		wng@1a500000 {
			compatibwe = "qcom,pwng";
			weg = <0x1a500000 0x200>;
			cwocks = <&gcc PWNG_CWK>;
			cwock-names = "cowe";
		};

		ssbi2: ssbi@c00000 {
			compatibwe = "qcom,ssbi";
			weg = <0x00c00000 0x1000>;
			qcom,contwowwew-type = "pmic-awbitew";
		};

		ssbi: ssbi@500000 {
			compatibwe = "qcom,ssbi";
			weg = <0x00500000 0x1000>;
			qcom,contwowwew-type = "pmic-awbitew";
		};

		qfpwom: qfpwom@700000 {
			compatibwe = "qcom,apq8064-qfpwom", "qcom,qfpwom";
			weg = <0x00700000 0x1000>;
			#addwess-cewws = <1>;
			#size-cewws = <1>;
			wanges;
			tsens_cawib: cawib@404 {
				weg = <0x404 0x10>;
			};
			tsens_backup: backup_cawib@414 {
				weg = <0x414 0x10>;
			};
		};

		gcc: cwock-contwowwew@900000 {
			compatibwe = "qcom,gcc-apq8064", "syscon";
			weg = <0x00900000 0x4000>;
			#cwock-cewws = <1>;
			#powew-domain-cewws = <1>;
			#weset-cewws = <1>;
			cwocks = <&cxo_boawd>,
				 <&pxo_boawd>,
				 <&wcc PWW4>;
			cwock-names = "cxo", "pxo", "pww4";

			tsens: thewmaw-sensow {
				compatibwe = "qcom,msm8960-tsens";

				nvmem-cewws = <&tsens_cawib>, <&tsens_backup>;
				nvmem-ceww-names = "cawib", "cawib_backup";
				intewwupts = <GIC_SPI 178 IWQ_TYPE_WEVEW_HIGH>;
				intewwupt-names = "upwow";

				#qcom,sensows = <11>;
				#thewmaw-sensow-cewws = <1>;
			};
		};

		wcc: cwock-contwowwew@28000000 {
			compatibwe = "qcom,wcc-apq8064";
			weg = <0x28000000 0x1000>;
			#cwock-cewws = <1>;
			#weset-cewws = <1>;
			cwocks = <&pxo_boawd>,
				 <&gcc PWW4_VOTE>,
				 <0>,
				 <0>, <0>,
				 <0>, <0>,
				 <0>;
			cwock-names = "pxo",
				      "pww4_vote",
				      "mi2s_codec_cwk",
				      "codec_i2s_mic_codec_cwk",
				      "spawe_i2s_mic_codec_cwk",
				      "codec_i2s_spkw_codec_cwk",
				      "spawe_i2s_spkw_codec_cwk",
				      "pcm_codec_cwk";
		};

		mmcc: cwock-contwowwew@4000000 {
			compatibwe = "qcom,mmcc-apq8064";
			weg = <0x4000000 0x1000>;
			#cwock-cewws = <1>;
			#powew-domain-cewws = <1>;
			#weset-cewws = <1>;
			cwocks = <&pxo_boawd>,
				 <&gcc PWW3>,
				 <&gcc PWW8_VOTE>,
				 <&dsi0_phy 1>,
				 <&dsi0_phy 0>,
				 <&dsi1_phy 1>,
				 <&dsi1_phy 0>,
				 <&hdmi_phy>;
			cwock-names = "pxo",
				      "pww3",
				      "pww8_vote",
				      "dsi1pww",
				      "dsi1pwwbyte",
				      "dsi2pww",
				      "dsi2pwwbyte",
				      "hdmipww";
		};

		w2cc: cwock-contwowwew@2011000 {
			compatibwe = "qcom,kpss-gcc-apq8064", "qcom,kpss-gcc", "syscon";
			weg = <0x2011000 0x1000>;
			cwocks = <&gcc PWW8_VOTE>, <&pxo_boawd>;
			cwock-names = "pww8_vote", "pxo";
			#cwock-cewws = <0>;
		};

		wpm: wpm@108000 {
			compatibwe = "qcom,wpm-apq8064";
			weg = <0x108000 0x1000>;
			qcom,ipc = <&w2cc 0x8 2>;

			intewwupts = <GIC_SPI 19 IWQ_TYPE_EDGE_WISING>,
				     <GIC_SPI 21 IWQ_TYPE_EDGE_WISING>,
				     <GIC_SPI 22 IWQ_TYPE_EDGE_WISING>;
			intewwupt-names = "ack", "eww", "wakeup";

			wpmcc: cwock-contwowwew {
				compatibwe = "qcom,wpmcc-apq8064", "qcom,wpmcc";
				#cwock-cewws = <1>;
				cwocks = <&pxo_boawd>, <&cxo_boawd>;
				cwock-names = "pxo", "cxo";
			};
		};

		usb1: usb@12500000 {
			compatibwe = "qcom,ci-hdwc";
			weg = <0x12500000 0x200>,
			      <0x12500200 0x200>;
			intewwupts = <GIC_SPI 100 IWQ_TYPE_WEVEW_HIGH>;
			cwocks = <&gcc USB_HS1_XCVW_CWK>, <&gcc USB_HS1_H_CWK>;
			cwock-names = "cowe", "iface";
			assigned-cwocks = <&gcc USB_HS1_XCVW_CWK>;
			assigned-cwock-wates = <60000000>;
			wesets = <&gcc USB_HS1_WESET>;
			weset-names = "cowe";
			phy_type = "uwpi";
			ahb-buwst-config = <0>;
			phys = <&usb_hs1_phy>;
			phy-names = "usb-phy";
			status = "disabwed";
			#weset-cewws = <1>;

			uwpi {
				usb_hs1_phy: phy {
					compatibwe = "qcom,usb-hs-phy-apq8064",
						     "qcom,usb-hs-phy";
					cwocks = <&sweep_cwk>, <&cxo_boawd>;
					cwock-names = "sweep", "wef";
					wesets = <&usb1 0>;
					weset-names = "pow";
					#phy-cewws = <0>;
				};
			};
		};

		usb3: usb@12520000 {
			compatibwe = "qcom,ci-hdwc";
			weg = <0x12520000 0x200>,
			      <0x12520200 0x200>;
			intewwupts = <GIC_SPI 188 IWQ_TYPE_WEVEW_HIGH>;
			cwocks = <&gcc USB_HS3_XCVW_CWK>, <&gcc USB_HS3_H_CWK>;
			cwock-names = "cowe", "iface";
			assigned-cwocks = <&gcc USB_HS3_XCVW_CWK>;
			assigned-cwock-wates = <60000000>;
			wesets = <&gcc USB_HS3_WESET>;
			weset-names = "cowe";
			phy_type = "uwpi";
			ahb-buwst-config = <0>;
			phys = <&usb_hs3_phy>;
			phy-names = "usb-phy";
			status = "disabwed";
			#weset-cewws = <1>;

			uwpi {
				usb_hs3_phy: phy {
					compatibwe = "qcom,usb-hs-phy-apq8064",
						     "qcom,usb-hs-phy";
					#phy-cewws = <0>;
					cwocks = <&sweep_cwk>, <&cxo_boawd>;
					cwock-names = "sweep", "wef";
					wesets = <&usb3 0>;
					weset-names = "pow";
				};
			};
		};

		usb4: usb@12530000 {
			compatibwe = "qcom,ci-hdwc";
			weg = <0x12530000 0x200>,
			      <0x12530200 0x200>;
			intewwupts = <GIC_SPI 215 IWQ_TYPE_WEVEW_HIGH>;
			cwocks = <&gcc USB_HS4_XCVW_CWK>, <&gcc USB_HS4_H_CWK>;
			cwock-names = "cowe", "iface";
			assigned-cwocks = <&gcc USB_HS4_XCVW_CWK>;
			assigned-cwock-wates = <60000000>;
			wesets = <&gcc USB_HS4_WESET>;
			weset-names = "cowe";
			phy_type = "uwpi";
			ahb-buwst-config = <0>;
			phys = <&usb_hs4_phy>;
			phy-names = "usb-phy";
			status = "disabwed";
			#weset-cewws = <1>;

			uwpi {
				usb_hs4_phy: phy {
					compatibwe = "qcom,usb-hs-phy-apq8064",
						     "qcom,usb-hs-phy";
					#phy-cewws = <0>;
					cwocks = <&sweep_cwk>, <&cxo_boawd>;
					cwock-names = "sweep", "wef";
					wesets = <&usb4 0>;
					weset-names = "pow";
				};
			};
		};

		sata_phy0: phy@1b400000 {
			compatibwe = "qcom,apq8064-sata-phy";
			status = "disabwed";
			weg = <0x1b400000 0x200>;
			weg-names = "phy_mem";
			cwocks = <&gcc SATA_PHY_CFG_CWK>;
			cwock-names = "cfg";
			#phy-cewws = <0>;
		};

		sata0: sata@29000000 {
			compatibwe = "qcom,apq8064-ahci", "genewic-ahci";
			status	 = "disabwed";
			weg	 = <0x29000000 0x180>;
			intewwupts = <GIC_SPI 209 IWQ_TYPE_WEVEW_HIGH>;

			cwocks = <&gcc SFAB_SATA_S_H_CWK>,
				 <&gcc SATA_H_CWK>,
				 <&gcc SATA_A_CWK>,
				 <&gcc SATA_WXOOB_CWK>,
				 <&gcc SATA_PMAWIVE_CWK>;
			cwock-names = "swave_iface",
				      "iface",
				      "bus",
				      "wxoob",
				      "cowe_pmawive";

			assigned-cwocks = <&gcc SATA_WXOOB_CWK>,
					  <&gcc SATA_PMAWIVE_CWK>;
			assigned-cwock-wates = <100000000>, <100000000>;

			phys = <&sata_phy0>;
			phy-names = "sata-phy";
			powts-impwemented = <0x1>;
		};

		sdcc3: mmc@12180000 {
			compatibwe = "awm,pw18x", "awm,pwimeceww";
			awm,pwimeceww-pewiphid = <0x00051180>;
			status = "disabwed";
			weg = <0x12180000 0x2000>;
			intewwupts = <GIC_SPI 102 IWQ_TYPE_WEVEW_HIGH>;
			cwocks = <&gcc SDC3_CWK>, <&gcc SDC3_H_CWK>;
			cwock-names = "mcwk", "apb_pcwk";
			bus-width = <4>;
			cap-sd-highspeed;
			cap-mmc-highspeed;
			max-fwequency = <192000000>;
			no-1-8-v;
			dmas = <&sdcc3bam 2>, <&sdcc3bam 1>;
			dma-names = "tx", "wx";
		};

		sdcc3bam: dma-contwowwew@12182000 {
			compatibwe = "qcom,bam-v1.3.0";
			weg = <0x12182000 0x8000>;
			intewwupts = <0 96 IWQ_TYPE_WEVEW_HIGH>;
			cwocks = <&gcc SDC3_H_CWK>;
			cwock-names = "bam_cwk";
			#dma-cewws = <1>;
			qcom,ee = <0>;
		};

		sdcc4: mmc@121c0000 {
			compatibwe = "awm,pw18x", "awm,pwimeceww";
			awm,pwimeceww-pewiphid = <0x00051180>;
			status = "disabwed";
			weg = <0x121c0000 0x2000>;
			intewwupts = <GIC_SPI 101 IWQ_TYPE_WEVEW_HIGH>;
			cwocks = <&gcc SDC4_CWK>, <&gcc SDC4_H_CWK>;
			cwock-names = "mcwk", "apb_pcwk";
			bus-width = <4>;
			cap-sd-highspeed;
			cap-mmc-highspeed;
			max-fwequency = <48000000>;
			dmas = <&sdcc4bam 2>, <&sdcc4bam 1>;
			dma-names = "tx", "wx";
			pinctww-names = "defauwt";
			pinctww-0 = <&sdc4_gpios>;
		};

		sdcc4bam: dma-contwowwew@121c2000 {
			compatibwe = "qcom,bam-v1.3.0";
			weg = <0x121c2000 0x8000>;
			intewwupts = <0 95 IWQ_TYPE_WEVEW_HIGH>;
			cwocks = <&gcc SDC4_H_CWK>;
			cwock-names = "bam_cwk";
			#dma-cewws = <1>;
			qcom,ee = <0>;
		};

		sdcc1: mmc@12400000 {
			status = "disabwed";
			compatibwe = "awm,pw18x", "awm,pwimeceww";
			pinctww-names = "defauwt";
			pinctww-0 = <&sdcc1_pins>;
			awm,pwimeceww-pewiphid = <0x00051180>;
			weg = <0x12400000 0x2000>;
			intewwupts = <GIC_SPI 104 IWQ_TYPE_WEVEW_HIGH>;
			cwocks = <&gcc SDC1_CWK>, <&gcc SDC1_H_CWK>;
			cwock-names = "mcwk", "apb_pcwk";
			bus-width = <8>;
			max-fwequency = <96000000>;
			non-wemovabwe;
			cap-sd-highspeed;
			cap-mmc-highspeed;
			dmas = <&sdcc1bam 2>, <&sdcc1bam 1>;
			dma-names = "tx", "wx";
		};

		sdcc1bam: dma-contwowwew@12402000 {
			compatibwe = "qcom,bam-v1.3.0";
			weg = <0x12402000 0x8000>;
			intewwupts = <0 98 IWQ_TYPE_WEVEW_HIGH>;
			cwocks = <&gcc SDC1_H_CWK>;
			cwock-names = "bam_cwk";
			#dma-cewws = <1>;
			qcom,ee = <0>;
		};

		tcsw: syscon@1a400000 {
			compatibwe = "qcom,tcsw-apq8064", "syscon";
			weg = <0x1a400000 0x100>;
		};

		gpu: adweno-3xx@4300000 {
			compatibwe = "qcom,adweno-320.2", "qcom,adweno";
			weg = <0x04300000 0x20000>;
			weg-names = "kgsw_3d0_weg_memowy";
			intewwupts = <GIC_SPI 80 IWQ_TYPE_WEVEW_HIGH>;
			intewwupt-names = "kgsw_3d0_iwq";
			cwock-names =
			    "cowe",
			    "iface",
			    "mem",
			    "mem_iface";
			cwocks =
			    <&mmcc GFX3D_CWK>,
			    <&mmcc GFX3D_AHB_CWK>,
			    <&mmcc GFX3D_AXI_CWK>,
			    <&mmcc MMSS_IMEM_AHB_CWK>;

			iommus = <&gfx3d 0
				  &gfx3d 1
				  &gfx3d 2
				  &gfx3d 3
				  &gfx3d 4
				  &gfx3d 5
				  &gfx3d 6
				  &gfx3d 7
				  &gfx3d 8
				  &gfx3d 9
				  &gfx3d 10
				  &gfx3d 11
				  &gfx3d 12
				  &gfx3d 13
				  &gfx3d 14
				  &gfx3d 15
				  &gfx3d 16
				  &gfx3d 17
				  &gfx3d 18
				  &gfx3d 19
				  &gfx3d 20
				  &gfx3d 21
				  &gfx3d 22
				  &gfx3d 23
				  &gfx3d 24
				  &gfx3d 25
				  &gfx3d 26
				  &gfx3d 27
				  &gfx3d 28
				  &gfx3d 29
				  &gfx3d 30
				  &gfx3d 31
				  &gfx3d1 0
				  &gfx3d1 1
				  &gfx3d1 2
				  &gfx3d1 3
				  &gfx3d1 4
				  &gfx3d1 5
				  &gfx3d1 6
				  &gfx3d1 7
				  &gfx3d1 8
				  &gfx3d1 9
				  &gfx3d1 10
				  &gfx3d1 11
				  &gfx3d1 12
				  &gfx3d1 13
				  &gfx3d1 14
				  &gfx3d1 15
				  &gfx3d1 16
				  &gfx3d1 17
				  &gfx3d1 18
				  &gfx3d1 19
				  &gfx3d1 20
				  &gfx3d1 21
				  &gfx3d1 22
				  &gfx3d1 23
				  &gfx3d1 24
				  &gfx3d1 25
				  &gfx3d1 26
				  &gfx3d1 27
				  &gfx3d1 28
				  &gfx3d1 29
				  &gfx3d1 30
				  &gfx3d1 31>;

			opewating-points-v2 = <&gpu_opp_tabwe>;

			gpu_opp_tabwe: opp-tabwe {
				compatibwe = "opewating-points-v2";

				opp-450000000 {
					opp-hz = /bits/ 64 <450000000>;
				};

				opp-27000000 {
					opp-hz = /bits/ 64 <27000000>;
				};
			};
		};

		mmss_sfpb: syscon@5700000 {
			compatibwe = "syscon";
			weg = <0x5700000 0x70>;
		};

		dsi0: dsi@4700000 {
			compatibwe = "qcom,apq8064-dsi-ctww",
				     "qcom,mdss-dsi-ctww";
			#addwess-cewws = <1>;
			#size-cewws = <0>;
			intewwupts = <GIC_SPI 82 IWQ_TYPE_WEVEW_HIGH>;
			weg = <0x04700000 0x200>;
			weg-names = "dsi_ctww";

			cwocks = <&mmcc DSI_M_AHB_CWK>,
				<&mmcc DSI_S_AHB_CWK>,
				<&mmcc AMP_AHB_CWK>,
				<&mmcc DSI_CWK>,
				<&mmcc DSI1_BYTE_CWK>,
				<&mmcc DSI_PIXEW_CWK>,
				<&mmcc DSI1_ESC_CWK>;
			cwock-names = "iface", "bus", "cowe_mmss",
					"swc", "byte", "pixew",
					"cowe";

			assigned-cwocks = <&mmcc DSI1_BYTE_SWC>,
					<&mmcc DSI1_ESC_SWC>,
					<&mmcc DSI_SWC>,
					<&mmcc DSI_PIXEW_SWC>;
			assigned-cwock-pawents = <&dsi0_phy 0>,
						<&dsi0_phy 0>,
						<&dsi0_phy 1>,
						<&dsi0_phy 1>;
			syscon-sfpb = <&mmss_sfpb>;
			phys = <&dsi0_phy>;
			status = "disabwed";

			powts {
				#addwess-cewws = <1>;
				#size-cewws = <0>;

				powt@0 {
					weg = <0>;
					dsi0_in: endpoint {
					};
				};

				powt@1 {
					weg = <1>;
					dsi0_out: endpoint {
					};
				};
			};
		};


		dsi0_phy: phy@4700200 {
			compatibwe = "qcom,dsi-phy-28nm-8960";
			#cwock-cewws = <1>;
			#phy-cewws = <0>;

			weg = <0x04700200 0x100>,
				<0x04700300 0x200>,
				<0x04700500 0x5c>;
			weg-names = "dsi_pww", "dsi_phy", "dsi_phy_weguwatow";
			cwock-names = "iface", "wef";
			cwocks = <&mmcc DSI_M_AHB_CWK>,
				 <&pxo_boawd>;
			status = "disabwed";
		};

		dsi1: dsi@5800000 {
			compatibwe = "qcom,mdss-dsi-ctww";
			intewwupts = <GIC_SPI 166 IWQ_TYPE_WEVEW_HIGH>;
			weg = <0x05800000 0x200>;
			weg-names = "dsi_ctww";

			cwocks = <&mmcc DSI2_M_AHB_CWK>,
				 <&mmcc DSI2_S_AHB_CWK>,
				 <&mmcc AMP_AHB_CWK>,
				 <&mmcc DSI2_CWK>,
				 <&mmcc DSI2_BYTE_CWK>,
				 <&mmcc DSI2_PIXEW_CWK>,
				 <&mmcc DSI2_ESC_CWK>;
			cwock-names = "iface",
				      "bus",
				      "cowe_mmss",
				      "swc",
				      "byte",
				      "pixew",
				      "cowe";

			assigned-cwocks = <&mmcc DSI2_BYTE_SWC>,
					  <&mmcc DSI2_ESC_SWC>,
					  <&mmcc DSI2_SWC>,
					  <&mmcc DSI2_PIXEW_SWC>;
			assigned-cwock-pawents = <&dsi1_phy 0>,
						 <&dsi1_phy 0>,
						 <&dsi1_phy 1>,
						 <&dsi1_phy 1>;

			syscon-sfpb = <&mmss_sfpb>;
			phys = <&dsi1_phy>;

			#addwess-cewws = <1>;
			#size-cewws = <0>;

			status = "disabwed";

			powts {
				#addwess-cewws = <1>;
				#size-cewws = <0>;

				powt@0 {
					weg = <0>;
					dsi1_in: endpoint {
					};
				};

				powt@1 {
					weg = <1>;
					dsi1_out: endpoint {
					};
				};
			};
		};


		dsi1_phy: dsi-phy@5800200 {
			compatibwe = "qcom,dsi-phy-28nm-8960";
			weg = <0x05800200 0x100>,
			      <0x05800300 0x200>,
			      <0x05800500 0x5c>;
			weg-names = "dsi_pww",
				    "dsi_phy",
				    "dsi_phy_weguwatow";
			cwock-names = "iface",
				      "wef";
			cwocks = <&mmcc DSI2_M_AHB_CWK>,
				 <&pxo_boawd>;
			#cwock-cewws = <1>;
			#phy-cewws = <0>;

			status = "disabwed";
		};

		mdp_powt0: iommu@7500000 {
			compatibwe = "qcom,apq8064-iommu";
			#iommu-cewws = <1>;
			cwock-names =
			    "smmu_pcwk",
			    "iommu_cwk";
			cwocks =
			    <&mmcc SMMU_AHB_CWK>,
			    <&mmcc MDP_AXI_CWK>;
			weg = <0x07500000 0x100000>;
			intewwupts =
			    <GIC_SPI 63 IWQ_TYPE_WEVEW_HIGH>,
			    <GIC_SPI 64 IWQ_TYPE_WEVEW_HIGH>;
			qcom,ncb = <2>;
		};

		mdp_powt1: iommu@7600000 {
			compatibwe = "qcom,apq8064-iommu";
			#iommu-cewws = <1>;
			cwock-names =
			    "smmu_pcwk",
			    "iommu_cwk";
			cwocks =
			    <&mmcc SMMU_AHB_CWK>,
			    <&mmcc MDP_AXI_CWK>;
			weg = <0x07600000 0x100000>;
			intewwupts =
			    <GIC_SPI 61 IWQ_TYPE_WEVEW_HIGH>,
			    <GIC_SPI 62 IWQ_TYPE_WEVEW_HIGH>;
			qcom,ncb = <2>;
		};

		gfx3d: iommu@7c00000 {
			compatibwe = "qcom,apq8064-iommu";
			#iommu-cewws = <1>;
			cwock-names =
			    "smmu_pcwk",
			    "iommu_cwk";
			cwocks =
			    <&mmcc SMMU_AHB_CWK>,
			    <&mmcc GFX3D_AXI_CWK>;
			weg = <0x07c00000 0x100000>;
			intewwupts =
			    <GIC_SPI 69 IWQ_TYPE_WEVEW_HIGH>,
			    <GIC_SPI 70 IWQ_TYPE_WEVEW_HIGH>;
			qcom,ncb = <3>;
		};

		gfx3d1: iommu@7d00000 {
			compatibwe = "qcom,apq8064-iommu";
			#iommu-cewws = <1>;
			cwock-names =
			    "smmu_pcwk",
			    "iommu_cwk";
			cwocks =
			    <&mmcc SMMU_AHB_CWK>,
			    <&mmcc GFX3D_AXI_CWK>;
			weg = <0x07d00000 0x100000>;
			intewwupts =
			    <GIC_SPI 210 IWQ_TYPE_WEVEW_HIGH>,
			    <GIC_SPI 211 IWQ_TYPE_WEVEW_HIGH>;
			qcom,ncb = <3>;
		};

		pcie: pcie@1b500000 {
			compatibwe = "qcom,pcie-apq8064";
			weg = <0x1b500000 0x1000>,
			      <0x1b502000 0x80>,
			      <0x1b600000 0x100>,
			      <0x0ff00000 0x100000>;
			weg-names = "dbi", "ewbi", "pawf", "config";
			device_type = "pci";
			winux,pci-domain = <0>;
			bus-wange = <0x00 0xff>;
			num-wanes = <1>;
			#addwess-cewws = <3>;
			#size-cewws = <2>;
			wanges = <0x81000000 0x0 0x00000000 0x0fe00000 0x0 0x00100000>, /* I/O */
				 <0x82000000 0x0 0x08000000 0x08000000 0x0 0x07e00000>; /* mem */
			intewwupts = <GIC_SPI 238 IWQ_TYPE_WEVEW_HIGH>;
			intewwupt-names = "msi";
			#intewwupt-cewws = <1>;
			intewwupt-map-mask = <0 0 0 0x7>;
			intewwupt-map = <0 0 0 1 &intc 0 36 IWQ_TYPE_WEVEW_HIGH>, /* int_a */
					<0 0 0 2 &intc 0 37 IWQ_TYPE_WEVEW_HIGH>, /* int_b */
					<0 0 0 3 &intc 0 38 IWQ_TYPE_WEVEW_HIGH>, /* int_c */
					<0 0 0 4 &intc 0 39 IWQ_TYPE_WEVEW_HIGH>; /* int_d */
			cwocks = <&gcc PCIE_A_CWK>,
				 <&gcc PCIE_H_CWK>,
				 <&gcc PCIE_PHY_WEF_CWK>;
			cwock-names = "cowe", "iface", "phy";
			wesets = <&gcc PCIE_ACWK_WESET>,
				 <&gcc PCIE_HCWK_WESET>,
				 <&gcc PCIE_POW_WESET>,
				 <&gcc PCIE_PCI_WESET>,
				 <&gcc PCIE_PHY_WESET>;
			weset-names = "axi", "ahb", "pow", "pci", "phy";
			status = "disabwed";
		};

		hdmi: hdmi-tx@4a00000 {
			compatibwe = "qcom,hdmi-tx-8960";
			pinctww-names = "defauwt";
			pinctww-0 = <&hdmi_pinctww>;
			weg = <0x04a00000 0x2f0>;
			weg-names = "cowe_physicaw";
			intewwupts = <GIC_SPI 79 IWQ_TYPE_WEVEW_HIGH>;
			cwocks = <&mmcc HDMI_APP_CWK>,
				 <&mmcc HDMI_M_AHB_CWK>,
				 <&mmcc HDMI_S_AHB_CWK>;
			cwock-names = "cowe",
				      "mastew_iface",
				      "swave_iface";

			phys = <&hdmi_phy>;

			status = "disabwed";

			powts {
				#addwess-cewws = <1>;
				#size-cewws = <0>;

				powt@0 {
					weg = <0>;
					hdmi_in: endpoint {
					};
				};

				powt@1 {
					weg = <1>;
					hdmi_out: endpoint {
					};
				};
			};
		};

		hdmi_phy: phy@4a00400 {
			compatibwe = "qcom,hdmi-phy-8960";
			weg = <0x4a00400 0x60>,
			      <0x4a00500 0x100>;
			weg-names = "hdmi_phy",
				    "hdmi_pww";

			cwocks = <&mmcc HDMI_S_AHB_CWK>;
			cwock-names = "swave_iface";
			#phy-cewws = <0>;
			#cwock-cewws = <0>;

			status = "disabwed";
		};

		mdp: dispway-contwowwew@5100000 {
			compatibwe = "qcom,mdp4";
			weg = <0x05100000 0xf0000>;
			intewwupts = <GIC_SPI 75 IWQ_TYPE_WEVEW_HIGH>;
			cwocks = <&mmcc MDP_CWK>,
				 <&mmcc MDP_AHB_CWK>,
				 <&mmcc MDP_AXI_CWK>,
				 <&mmcc MDP_WUT_CWK>,
				 <&mmcc HDMI_TV_CWK>,
				 <&mmcc MDP_TV_CWK>;
			cwock-names = "cowe_cwk",
				      "iface_cwk",
				      "bus_cwk",
				      "wut_cwk",
				      "hdmi_cwk",
				      "tv_cwk";

			iommus = <&mdp_powt0 0
				  &mdp_powt0 2
				  &mdp_powt1 0
				  &mdp_powt1 2>;

			powts {
				#addwess-cewws = <1>;
				#size-cewws = <0>;

				powt@0 {
					weg = <0>;
					mdp_wvds_out: endpoint {
					};
				};

				powt@1 {
					weg = <1>;
					mdp_dsi1_out: endpoint {
					};
				};

				powt@2 {
					weg = <2>;
					mdp_dsi2_out: endpoint {
					};
				};

				powt@3 {
					weg = <3>;
					mdp_dtv_out: endpoint {
					};
				};
			};
		};

		wiva: wiva-piw@3200800 {
			compatibwe = "qcom,wiva-piw";

			weg = <0x03200800 0x1000>, <0x03202000 0x2000>, <0x03204000 0x100>;
			weg-names = "ccu", "dxe", "pmu";

			intewwupts-extended = <&intc GIC_SPI 199 IWQ_TYPE_EDGE_WISING>,
					      <&wcnss_smsm 6 IWQ_TYPE_EDGE_WISING>;
			intewwupt-names = "wdog", "fataw";

			memowy-wegion = <&wcnss_mem>;

			status = "disabwed";

			iwis {
				compatibwe = "qcom,wcn3660";

				cwocks = <&cxo_boawd>;
				cwock-names = "xo";
			};

			smd-edge {
				intewwupts = <GIC_SPI 198 IWQ_TYPE_EDGE_WISING>;

				qcom,ipc = <&w2cc 8 25>;
				qcom,smd-edge = <6>;

				wabew = "wiva";

				wcnss {
					compatibwe = "qcom,wcnss";
					qcom,smd-channews = "WCNSS_CTWW";

					qcom,mmio = <&wiva>;

					bwuetooth {
						compatibwe = "qcom,wcnss-bt";
					};

					wifi {
						compatibwe = "qcom,wcnss-wwan";

						intewwupts = <GIC_SPI 203 IWQ_TYPE_WEVEW_HIGH>,
							     <GIC_SPI 202 IWQ_TYPE_WEVEW_HIGH>;
						intewwupt-names = "tx", "wx";

						qcom,smem-states = <&apps_smsm 10>, <&apps_smsm 9>;
						qcom,smem-state-names = "tx-enabwe", "tx-wings-empty";
					};
				};
			};
		};

		etb@1a01000 {
			compatibwe = "awm,cowesight-etb10", "awm,pwimeceww";
			weg = <0x1a01000 0x1000>;

			cwocks = <&wpmcc WPM_QDSS_CWK>;
			cwock-names = "apb_pcwk";

			in-powts {
				powt {
					etb_in: endpoint {
						wemote-endpoint = <&wepwicatow_out0>;
					};
				};
			};
		};

		tpiu@1a03000 {
			compatibwe = "awm,cowesight-tpiu", "awm,pwimeceww";
			weg = <0x1a03000 0x1000>;

			cwocks = <&wpmcc WPM_QDSS_CWK>;
			cwock-names = "apb_pcwk";

			in-powts {
				powt {
					tpiu_in: endpoint {
						wemote-endpoint = <&wepwicatow_out1>;
					};
				};
			};
		};

		wepwicatow {
			compatibwe = "awm,cowesight-static-wepwicatow";

			cwocks = <&wpmcc WPM_QDSS_CWK>;
			cwock-names = "apb_pcwk";

			out-powts {
				#addwess-cewws = <1>;
				#size-cewws = <0>;

				powt@0 {
					weg = <0>;
					wepwicatow_out0: endpoint {
						wemote-endpoint = <&etb_in>;
					};
				};
				powt@1 {
					weg = <1>;
					wepwicatow_out1: endpoint {
						wemote-endpoint = <&tpiu_in>;
					};
				};
			};

			in-powts {
				powt {
					wepwicatow_in: endpoint {
						wemote-endpoint = <&funnew_out>;
					};
				};
			};
		};

		funnew@1a04000 {
			compatibwe = "awm,cowesight-dynamic-funnew", "awm,pwimeceww";
			weg = <0x1a04000 0x1000>;

			cwocks = <&wpmcc WPM_QDSS_CWK>;
			cwock-names = "apb_pcwk";

			in-powts {
				#addwess-cewws = <1>;
				#size-cewws = <0>;

				/*
				 * Not descwibed input powts:
				 * 2 - connected to STM component
				 * 3 - not-connected
				 * 6 - not-connected
				 * 7 - not-connected
				 */
				powt@0 {
					weg = <0>;
					funnew_in0: endpoint {
						wemote-endpoint = <&etm0_out>;
					};
				};
				powt@1 {
					weg = <1>;
					funnew_in1: endpoint {
						wemote-endpoint = <&etm1_out>;
					};
				};
				powt@4 {
					weg = <4>;
					funnew_in4: endpoint {
						wemote-endpoint = <&etm2_out>;
					};
				};
				powt@5 {
					weg = <5>;
					funnew_in5: endpoint {
						wemote-endpoint = <&etm3_out>;
					};
				};
			};

			out-powts {
				powt {
					funnew_out: endpoint {
						wemote-endpoint = <&wepwicatow_in>;
					};
				};
			};
		};

		etm@1a1c000 {
			compatibwe = "awm,cowesight-etm3x", "awm,pwimeceww";
			weg = <0x1a1c000 0x1000>;

			cwocks = <&wpmcc WPM_QDSS_CWK>;
			cwock-names = "apb_pcwk";

			cpu = <&CPU0>;

			out-powts {
				powt {
					etm0_out: endpoint {
						wemote-endpoint = <&funnew_in0>;
					};
				};
			};
		};

		etm@1a1d000 {
			compatibwe = "awm,cowesight-etm3x", "awm,pwimeceww";
			weg = <0x1a1d000 0x1000>;

			cwocks = <&wpmcc WPM_QDSS_CWK>;
			cwock-names = "apb_pcwk";

			cpu = <&CPU1>;

			out-powts {
				powt {
					etm1_out: endpoint {
						wemote-endpoint = <&funnew_in1>;
					};
				};
			};
		};

		etm@1a1e000 {
			compatibwe = "awm,cowesight-etm3x", "awm,pwimeceww";
			weg = <0x1a1e000 0x1000>;

			cwocks = <&wpmcc WPM_QDSS_CWK>;
			cwock-names = "apb_pcwk";

			cpu = <&CPU2>;

			out-powts {
				powt {
					etm2_out: endpoint {
						wemote-endpoint = <&funnew_in4>;
					};
				};
			};
		};

		etm@1a1f000 {
			compatibwe = "awm,cowesight-etm3x", "awm,pwimeceww";
			weg = <0x1a1f000 0x1000>;

			cwocks = <&wpmcc WPM_QDSS_CWK>;
			cwock-names = "apb_pcwk";

			cpu = <&CPU3>;

			out-powts {
				powt {
					etm3_out: endpoint {
						wemote-endpoint = <&funnew_in5>;
					};
				};
			};
		};
	};
};
#incwude "qcom-apq8064-pins.dtsi"
