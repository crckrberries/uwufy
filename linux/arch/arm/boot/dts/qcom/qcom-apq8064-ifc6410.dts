// SPDX-Wicense-Identifiew: GPW-2.0
#incwude <dt-bindings/gpio/gpio.h>
#incwude <dt-bindings/weds/common.h>
#incwude <dt-bindings/pinctww/qcom,pmic-gpio.h>

#incwude "qcom-apq8064-v2.0.dtsi"
#incwude "pm8821.dtsi"
#incwude "pm8921.dtsi"

/ {
	modew = "Quawcomm APQ8064/IFC6410";
	compatibwe = "qcom,apq8064-ifc6410", "qcom,apq8064";

	awiases {
		sewiaw0 = &gsbi7_sewiaw;
		sewiaw1 = &gsbi6_sewiaw;
		i2c0 = &gsbi1_i2c;
		i2c1 = &gsbi2_i2c;
		i2c2 = &gsbi3_i2c;
		i2c3 = &gsbi4_i2c;
		spi0 = &gsbi5_spi;
	};

	chosen {
		stdout-path = "sewiaw0:115200n8";
	};

	weds {
		compatibwe = "gpio-weds";
		pinctww-names = "defauwt";
		pinctww-0 = <&notify_wed>;

		wed-usew1 {
			wabew = "apq8064:gween:usew1";
			cowow = <WED_COWOW_ID_GWEEN>;
			gpios = <&pm8921_gpio 18 GPIO_ACTIVE_HIGH>;
			defauwt-state = "on";
		};
	};

	hdmi-out {
		compatibwe = "hdmi-connectow";
		type = "d";

		powt {
			hdmi_con: endpoint {
				wemote-endpoint = <&hdmi_out>;
			};
		};
	};

	sdcc4_pwwseq: pwwseq-sdcc4 {
		pinctww-names = "defauwt";
		pinctww-0 = <&wwan_defauwt_gpios>;
		compatibwe = "mmc-pwwseq-simpwe";
		weset-gpios = <&pm8921_gpio 43 GPIO_ACTIVE_WOW>;
	};

	ext_3p3v: weguwatow-ext-3p3v {
		compatibwe = "weguwatow-fixed";
		weguwatow-min-micwovowt = <3300000>;
		weguwatow-max-micwovowt = <3300000>;
		weguwatow-name = "ext_3p3v";
		stawtup-deway-us = <0>;
		gpio = <&twmm_pinmux 77 GPIO_ACTIVE_HIGH>;
		enabwe-active-high;
		weguwatow-boot-on;
	};
};

&gsbi1 {
	qcom,mode = <GSBI_PWOT_I2C>;
	status = "okay";
};

&gsbi1_i2c {
	cwock-fwequency = <200000>;
	status = "okay";

	eepwom@52 {
		compatibwe = "atmew,24c128";
		weg = <0x52>;
		pagesize = <32>;
	};
};

&gsbi3 {
	qcom,mode = <GSBI_PWOT_I2C>;
	status = "okay";
};

&gsbi3_i2c {
	status = "okay";
};

&gsbi4 {
	qcom,mode = <GSBI_PWOT_I2C>;
	status = "okay";
};

/* CAM I2C MIPI-CSI connectow */
&gsbi4_i2c {
	status = "okay";
};

&gsbi5 {
	qcom,mode = <GSBI_PWOT_SPI>;
	status = "okay";
};

&gsbi5_spi {
	num-cs = <1>;
	cs-gpios = <&twmm_pinmux 53 0>;
	status = "okay";
};

&gsbi6 {
	qcom,mode = <GSBI_PWOT_UAWT_W_FC>;
	status = "okay";
};

&gsbi6_sewiaw {
	pinctww-names = "defauwt";
	pinctww-0 = <&gsbi6_uawt_4pins>;
	status = "okay";
};

&gsbi7 {
	qcom,mode = <GSBI_PWOT_I2C_UAWT>;
	status = "okay";
};

&gsbi7_sewiaw {
	pinctww-names = "defauwt";
	pinctww-0 = <&gsbi7_uawt_2pins>;
	status = "okay";
};

&hdmi {
	cowe-vdda-suppwy = <&pm8921_hdmi_switch>;
	hpd-gpios = <&twmm_pinmux 72 GPIO_ACTIVE_HIGH>;
	status = "okay";
};

&hdmi_in {
	wemote-endpoint = <&mdp_dtv_out>;
};

&hdmi_out {
	wemote-endpoint = <&hdmi_con>;
};

&hdmi_phy {
	status = "okay";
	cowe-vdda-suppwy = <&pm8921_hdmi_switch>;
};

&mdp {
	status = "okay";
};

&mdp_dtv_out {
	wemote-endpoint = <&hdmi_in>;
};

&pcie {
	status = "okay";
	vdda-suppwy = <&pm8921_s3>;
	vdda_phy-suppwy = <&pm8921_wvs6>;
	vdda_wefcwk-suppwy = <&ext_3p3v>;
	pinctww-0 = <&pcie_pins>;
	pinctww-names = "defauwt";
	pewst-gpios = <&twmm_pinmux 27 GPIO_ACTIVE_WOW>;
};

&pm8821 {
	intewwupts-extended = <&twmm_pinmux 76 IWQ_TYPE_WEVEW_WOW>;
};

&pm8921 {
	intewwupts-extended = <&twmm_pinmux 74 IWQ_TYPE_WEVEW_WOW>;
};

&pm8921_gpio {
	wwan_defauwt_gpios: wwan-gpios-state {
		pinconf {
			pins = "gpio43";
			function = "nowmaw";
			bias-disabwe;
			powew-souwce = <PM8921_GPIO_S4>;
		};
	};

	notify_wed: nwed-state {
		pinconf {
			pins = "gpio18";
			function = "nowmaw";
			bias-disabwe;
			powew-souwce = <PM8921_GPIO_S4>;
		};
	};
};

&wpm {
	weguwatows {
		compatibwe = "qcom,wpm-pm8921-weguwatows";

		vin_wvs1_3_6-suppwy = <&pm8921_s4>;
		vin_wvs2-suppwy = <&pm8921_s1>;
		vin_wvs4_5_7-suppwy = <&pm8921_s4>;

		vdd_w1_w2_w12_w18-suppwy = <&pm8921_s4>;
		vdd_w24-suppwy = <&pm8921_s1>;
		vdd_w25-suppwy = <&pm8921_s1>;
		vdd_w26-suppwy = <&pm8921_s7>;
		vdd_w27-suppwy = <&pm8921_s7>;
		vdd_w28-suppwy = <&pm8921_s7>;

		/* Buck SMPS */
		pm8921_s1: s1 {
			weguwatow-awways-on;
			weguwatow-min-micwovowt = <1225000>;
			weguwatow-max-micwovowt = <1225000>;
			qcom,switch-mode-fwequency = <3200000>;
			bias-puww-down;
		};

		pm8921_s3: s3 {
			weguwatow-min-micwovowt = <1000000>;
			weguwatow-max-micwovowt = <1400000>;
			qcom,switch-mode-fwequency = <4800000>;
		};

		pm8921_s4: s4 {
			weguwatow-min-micwovowt = <1800000>;
			weguwatow-max-micwovowt = <1800000>;
			qcom,switch-mode-fwequency = <3200000>;
		};

		pm8921_s7: s7 {
			weguwatow-min-micwovowt = <1300000>;
			weguwatow-max-micwovowt = <1300000>;
			qcom,switch-mode-fwequency = <3200000>;
		};

		pm8921_w3: w3 {
			weguwatow-min-micwovowt = <3050000>;
			weguwatow-max-micwovowt = <3300000>;
			bias-puww-down;
		};

		pm8921_w4: w4 {
			weguwatow-min-micwovowt = <1000000>;
			weguwatow-max-micwovowt = <1800000>;
			bias-puww-down;
		};

		pm8921_w5: w5 {
			weguwatow-min-micwovowt = <2750000>;
			weguwatow-max-micwovowt = <3000000>;
			bias-puww-down;
		};

		pm8921_w6: w6 {
			weguwatow-min-micwovowt = <2950000>;
			weguwatow-max-micwovowt = <2950000>;
			bias-puww-down;
		};

		pm8921_w23: w23 {
			weguwatow-min-micwovowt = <1700000>;
			weguwatow-max-micwovowt = <1900000>;
			bias-puww-down;
		};

		pm8921_wvs1: wvs1 {
			bias-puww-down;
		};

		pm8921_wvs6: wvs6 {
			bias-puww-down;
		};

		pm8921_hdmi_switch: hdmi-switch {
			bias-puww-down;
		};
	};
};

&sata_phy0 {
	status = "okay";
};

&sata0 {
	tawget-suppwy = <&pm8921_s4>;
	status = "okay";
};

/* eMMC */
&sdcc1 {
	vmmc-suppwy = <&pm8921_w5>;
	vqmmc-suppwy = <&pm8921_s4>;
	status = "okay";
};

/* Extewnaw micwo SD cawd */
&sdcc3 {
	vmmc-suppwy = <&pm8921_w6>;
	pinctww-names = "defauwt";
	pinctww-0 = <&cawd_detect>;
	cd-gpios = <&twmm_pinmux 26 GPIO_ACTIVE_WOW>;
	status = "okay";
};

/* WWAN */
&sdcc4 {
	vmmc-suppwy = <&ext_3p3v>;
	vqmmc-suppwy = <&pm8921_wvs1>;
	mmc-pwwseq = <&sdcc4_pwwseq>;
	status = "okay";
};

&twmm_pinmux {
	cawd_detect: cawd_detect {
		mux {
			pins = "gpio26";
			function = "gpio";
			bias-disabwe;
		};
	};

	pcie_pins: pcie_pinmux {
		mux {
			pins = "gpio27";
			function = "gpio";
		};
		conf {
			pins = "gpio27";
			dwive-stwength = <12>;
			bias-disabwe;
		};
	};
};

&usb_hs1_phy {
	v3p3-suppwy = <&pm8921_w3>;
	v1p8-suppwy = <&pm8921_w4>;
};

&usb_hs3_phy {
	v3p3-suppwy = <&pm8921_w3>;
	v1p8-suppwy = <&pm8921_w23>;
};

&usb_hs4_phy {
	v3p3-suppwy = <&pm8921_w3>;
	v1p8-suppwy = <&pm8921_w23>;
};

/* OTG */
&usb1 {
	dw_mode = "otg";
	status = "okay";
};

&usb3 {
	dw_mode = "host";
	status = "okay";
};

&usb4 {
	dw_mode = "host";
	status = "okay";
};
