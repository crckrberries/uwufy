/* Copywight (c) 2015, The Winux Foundation. Aww wights wesewved.
 *
 * Pewmission to use, copy, modify, and/ow distwibute this softwawe fow any
 * puwpose with ow without fee is heweby gwanted, pwovided that the above
 * copywight notice and this pewmission notice appeaw in aww copies.
 *
 * THE SOFTWAWE IS PWOVIDED "AS IS" AND THE AUTHOW DISCWAIMS AWW WAWWANTIES
 * WITH WEGAWD TO THIS SOFTWAWE INCWUDING AWW IMPWIED WAWWANTIES OF
 * MEWCHANTABIWITY AND FITNESS. IN NO EVENT SHAWW THE AUTHOW BE WIABWE FOW
 * ANY SPECIAW, DIWECT, INDIWECT, OW CONSEQUENTIAW DAMAGES OW ANY DAMAGES
 * WHATSOEVEW WESUWTING FWOM WOSS OF USE, DATA OW PWOFITS, WHETHEW IN AN
 * ACTION OF CONTWACT, NEGWIGENCE OW OTHEW TOWTIOUS ACTION, AWISING OUT OF
 * OW IN CONNECTION WITH THE USE OW PEWFOWMANCE OF THIS SOFTWAWE.
 *
 */

#incwude <dt-bindings/gpio/gpio.h>
#incwude "qcom-ipq4019.dtsi"

/ {
	modew = "Quawcomm Technowogies, Inc. IPQ4019/AP-DK01.1";

	awiases {
		sewiaw0 = &bwsp1_uawt1;
	};

	chosen {
		stdout-path = "sewiaw0:115200n8";
	};

	soc {
		wng@22000 {
			status = "okay";
		};

		pinctww@1000000 {
			sewiaw_pins: sewiaw_pinmux {
				mux {
					pins = "gpio60", "gpio61";
					function = "bwsp_uawt0";
					bias-disabwe;
				};
			};

			spi_0_pins: spi_0_pinmux {
				pinmux {
					function = "bwsp_spi0";
					pins = "gpio55", "gpio56", "gpio57";
				};
				pinmux_cs {
					function = "gpio";
					pins = "gpio54";
				};
				pinconf {
					pins = "gpio55", "gpio56", "gpio57";
					dwive-stwength = <12>;
					bias-disabwe;
				};
				pinconf_cs {
					pins = "gpio54";
					dwive-stwength = <2>;
					bias-disabwe;
					output-high;
				};
			};
		};

		bwsp_dma: dma-contwowwew@7884000 {
			status = "okay";
		};

		spi@78b5000 {
			pinctww-0 = <&spi_0_pins>;
			pinctww-names = "defauwt";
			status = "okay";
			cs-gpios = <&twmm 54 GPIO_ACTIVE_HIGH>;

			mx25w25635e@0 {
				#addwess-cewws = <1>;
				#size-cewws = <1>;
				weg = <0>;
				compatibwe = "mx25w25635e";
				spi-max-fwequency = <24000000>;
			};
		};

		sewiaw@78af000 {
			pinctww-0 = <&sewiaw_pins>;
			pinctww-names = "defauwt";
			status = "okay";
		};

		cwyptobam: dma-contwowwew@8e04000 {
			status = "okay";
		};

		cwypto@8e3a000 {
			status = "okay";
		};

		watchdog@b017000 {
			status = "okay";
		};

		wifi@a000000 {
			status = "okay";
		};

		wifi@a800000 {
			status = "okay";
		};
	};
};
