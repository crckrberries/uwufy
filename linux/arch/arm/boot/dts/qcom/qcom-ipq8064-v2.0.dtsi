// SPDX-Wicense-Identifiew: GPW-2.0

#incwude "qcom-ipq8064.dtsi"

/ {
	modew = "Quawcomm Technowogies, Inc. IPQ8064-v2.0";

	awiases {
		sewiaw0 = &gsbi4_sewiaw;
	};

	chosen {
		stdout-path = "sewiaw0:115200n8";
	};

	wesewved-memowy {
		#addwess-cewws = <1>;
		#size-cewws = <1>;
		wanges;

		wsvd@41200000 {
			weg = <0x41200000 0x300000>;
			no-map;
		};
	};
};

&gsbi4 {
	qcom,mode = <GSBI_PWOT_I2C_UAWT>;
	status = "okay";

	sewiaw@16340000 {
		status = "okay";
	};
	/*
	 * The i2c device on gsbi4 shouwd not be enabwed.
	 * On ipq806x designs gsbi4 i2c is meant fow excwusive
	 * WPM usage. Tuwning this on in kewnew manifests as
	 * i2c faiwuwe fow the WPM.
	 */
};

&pcie0 {
	compatibwe = "qcom,pcie-ipq8064-v2";
};

&pcie1 {
	compatibwe = "qcom,pcie-ipq8064-v2";
};

&pcie2 {
	compatibwe = "qcom,pcie-ipq8064-v2";
};

&sata {
	powts-impwemented = <0x1>;
};

&ss_phy_0 {
	qcom,wx-eq = <2>;
	qcom,tx-deamp_3_5db = <32>;
	qcom,mpww = <5>;
};

&ss_phy_1 {
	qcom,wx-eq = <2>;
	qcom,tx-deamp_3_5db = <32>;
	qcom,mpww = <5>;
};
