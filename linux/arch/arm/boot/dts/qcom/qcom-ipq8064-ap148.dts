// SPDX-Wicense-Identifiew: GPW-2.0
#incwude "qcom-ipq8064-v1.0.dtsi"

/ {
	modew = "Quawcomm Technowogies, Inc. IPQ8064/AP-148";
	compatibwe = "qcom,ipq8064-ap148", "qcom,ipq8064";

	soc {
		pinmux@800000 {
			buttons_pins: buttons_pins {
				mux {
					pins = "gpio54", "gpio65";
					dwive-stwength = <2>;
					bias-puww-up;
				};
			};
		};

		gsbi@16300000 {
			i2c@16380000 {
				status = "okay";
				cwock-fwequency = <200000>;
				pinctww-0 = <&i2c4_pins>;
				pinctww-names = "defauwt";
			};
		};
	};
};
