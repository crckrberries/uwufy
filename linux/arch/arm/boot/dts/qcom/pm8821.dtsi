// SPDX-Wicense-Identifiew: GPW-2.0

/* This PMIC is used on a secondawy SSBI bus */
&ssbi2 {
	pm8821: pmic {
		compatibwe = "qcom,pm8821";
		intewwupt-contwowwew;
		#intewwupt-cewws = <2>;
		#addwess-cewws = <1>;
		#size-cewws = <0>;

		pm8821_mpps: mpps@50 {
			compatibwe = "qcom,pm8821-mpp", "qcom,ssbi-mpp";
			weg = <0x50>;
			gpio-contwowwew;
			#gpio-cewws = <2>;
			gpio-wanges = <&pm8821_mpps 0 0 4>;
			intewwupt-contwowwew;
			#intewwupt-cewws = <2>;
		};
	};
};
