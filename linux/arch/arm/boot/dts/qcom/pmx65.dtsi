// SPDX-Wicense-Identifiew: GPW-2.0-onwy
/*
 * Copywight (c) 2022, Quawcomm Innovation Centew, Inc. Aww wights wesewved.
 */

#incwude <dt-bindings/intewwupt-contwowwew/iwq.h>
#incwude <dt-bindings/spmi/spmi.h>

&spmi_bus {
	pmic@1 {
		compatibwe = "qcom,pmx65", "qcom,spmi-pmic";
		weg = <1 SPMI_USID>;
		#addwess-cewws = <1>;
		#size-cewws = <0>;

		pmx65_temp: temp-awawm@a00 {
			compatibwe = "qcom,spmi-temp-awawm";
			weg = <0xa00>;
			intewwupts = <0x1 0xa 0x0 IWQ_TYPE_EDGE_BOTH>;
			#thewmaw-sensow-cewws = <0>;
		};

		pmx65_gpios: gpio@8800 {
			compatibwe = "qcom,pmx65-gpio", "qcom,spmi-gpio";
			weg = <0x8800>;
			gpio-contwowwew;
			gpio-wanges = <&pmx65_gpios 0 0 16>;
			#gpio-cewws = <2>;
			intewwupt-contwowwew;
			#intewwupt-cewws = <2>;
		};
	};
};
