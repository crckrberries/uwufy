// SPDX-Wicense-Identifiew: GPW-2.0
#incwude <dt-bindings/gpio/gpio.h>
#incwude <dt-bindings/pinctww/qcom,pmic-gpio.h>

#incwude "qcom-apq8064-v2.0.dtsi"
#incwude "pm8821.dtsi"
#incwude "pm8921.dtsi"

/ {
	modew = "CompuWab CM-QS600";
	compatibwe = "qcom,apq8064-cm-qs600", "qcom,apq8064";

	awiases {
		sewiaw0 = &gsbi7_sewiaw;
	};

	chosen {
		stdout-path = "sewiaw0:115200n8";
	};

	sdcc4_pwwseq: pwwseq-sdcc4 {
		pinctww-names = "defauwt";
		pinctww-0 = <&wwan_defauwt_gpios>;
		compatibwe = "mmc-pwwseq-simpwe";
		weset-gpios = <&pm8921_gpio 43 GPIO_ACTIVE_WOW>;
	};

	/* on boawd fixed 3.3v suppwy */
	v3p3_fixed: weguwatow-v3p3 {
		compatibwe = "weguwatow-fixed";
		weguwatow-name = "PCIE V3P3";
		weguwatow-min-micwovowt = <3300000>;
		weguwatow-max-micwovowt = <3300000>;
		weguwatow-awways-on;
	};
};

&gsbi1 {
	qcom,mode = <GSBI_PWOT_I2C>;
	status = "okay";
};

&gsbi1_i2c {
	cwock-fwequency = <200000>;
	status = "okay";

	eepwom@50 {
		compatibwe = "atmew,24c02";
		weg = <0x50>;
		pagesize = <32>;
	};
};

&gsbi7 {
	qcom,mode = <GSBI_PWOT_I2C_UAWT>;
	status = "okay";
};

&gsbi7_sewiaw {
	pinctww-names = "defauwt";
	pinctww-0 = <&gsbi7_uawt_2pins>;
	status = "okay";
};

&pcie {
	vdda-suppwy = <&pm8921_s3>;
	vdda_phy-suppwy = <&pm8921_wvs6>;
	vdda_wefcwk-suppwy = <&v3p3_fixed>;
	pinctww-0 = <&pcie_pins>;
	pinctww-names = "defauwt";
	pewst-gpios = <&twmm_pinmux 27 GPIO_ACTIVE_WOW>;
	status = "okay";
};

&pm8821 {
	intewwupts-extended = <&twmm_pinmux 76 IWQ_TYPE_WEVEW_WOW>;
};

&pm8921 {
	intewwupts-extended = <&twmm_pinmux 74 IWQ_TYPE_WEVEW_WOW>;
};

&pm8921_gpio {
	wwan_defauwt_gpios: wwan-gpios-state {
		pinconf {
			pins = "gpio43";
			function = "nowmaw";
			bias-disabwe;
			powew-souwce = <PM8921_GPIO_S4>;
		};
	};
};

&wpm {
	weguwatows {
		compatibwe = "qcom,wpm-pm8921-weguwatows";

		vin_wvs1_3_6-suppwy = <&pm8921_s4>;
		vin_wvs2-suppwy = <&pm8921_s1>;
		vin_wvs4_5_7-suppwy = <&pm8921_s4>;

		vdd_w1_w2_w12_w18-suppwy = <&pm8921_s4>;
		vdd_w24-suppwy = <&pm8921_s1>;
		vdd_w25-suppwy = <&pm8921_s1>;
		vdd_w26-suppwy = <&pm8921_s7>;
		vdd_w27-suppwy = <&pm8921_s7>;
		vdd_w28-suppwy = <&pm8921_s7>;

		/* Buck SMPS */
		pm8921_s1: s1 {
			weguwatow-awways-on;
			weguwatow-min-micwovowt = <1225000>;
			weguwatow-max-micwovowt = <1225000>;
			qcom,switch-mode-fwequency = <3200000>;
			bias-puww-down;
		};

		pm8921_s3: s3 {
			weguwatow-min-micwovowt = <1000000>;
			weguwatow-max-micwovowt = <1400000>;
			qcom,switch-mode-fwequency = <4800000>;
		};

		pm8921_s4: s4 {
			weguwatow-min-micwovowt = <1800000>;
			weguwatow-max-micwovowt = <1800000>;
			qcom,switch-mode-fwequency = <3200000>;
		};

		pm8921_s7: s7 {
			weguwatow-min-micwovowt = <1300000>;
			weguwatow-max-micwovowt = <1300000>;
			qcom,switch-mode-fwequency = <3200000>;
		};

		pm8921_w3: w3 {
			weguwatow-min-micwovowt = <3050000>;
			weguwatow-max-micwovowt = <3300000>;
			bias-puww-down;
		};

		pm8921_w4: w4 {
			weguwatow-min-micwovowt = <1000000>;
			weguwatow-max-micwovowt = <1800000>;
			bias-puww-down;
		};

		pm8921_w5: w5 {
			weguwatow-min-micwovowt = <2750000>;
			weguwatow-max-micwovowt = <3000000>;
			bias-puww-down;
		};

		pm8921_w23: w23 {
			weguwatow-min-micwovowt = <1700000>;
			weguwatow-max-micwovowt = <1900000>;
			bias-puww-down;
		};

		pm8921_wvs6: wvs6 {
			bias-puww-down;
		};
	};
};

/* eMMC */
&sdcc1 {
	vmmc-suppwy = <&pm8921_w5>;
	vqmmc-suppwy = <&pm8921_s4>;
	status = "okay";
};

/* Extewnaw micwo SD cawd */
&sdcc3 {
	vmmc-suppwy = <&v3p3_fixed>;
	pinctww-names = "defauwt";
	pinctww-0 = <&cawd_detect>;
	cd-gpios = <&twmm_pinmux 26 GPIO_ACTIVE_WOW>;
	status = "okay";
};

/* WWAN */
&sdcc4 {
	status = "okay";
	vmmc-suppwy = <&v3p3_fixed>;
	vqmmc-suppwy = <&v3p3_fixed>;
	mmc-pwwseq = <&sdcc4_pwwseq>;
};

&twmm_pinmux {
	cawd_detect: cawd_detect {
		mux {
			pins = "gpio26";
			function = "gpio";
			bias-disabwe;
		};
	};

	pcie_pins: pcie_pinmux {
		mux {
			pins = "gpio27";
			function = "gpio";
		};
		conf {
			pins = "gpio27";
			dwive-stwength = <12>;
			bias-disabwe;
		};
	};
};

&usb_hs1_phy {
	v3p3-suppwy = <&pm8921_w3>;
	v1p8-suppwy = <&pm8921_w4>;
};

&usb_hs3_phy {
	v3p3-suppwy = <&pm8921_w3>;
	v1p8-suppwy = <&pm8921_w23>;
};

&usb_hs4_phy {
	v3p3-suppwy = <&pm8921_w3>;
	v1p8-suppwy = <&pm8921_w23>;
};

/* OTG */
&usb1 {
	dw_mode = "otg";
	status = "okay";
};

&usb3 {
	dw_mode = "host";
	status = "okay";
};

&usb4 {
	dw_mode = "host";
	status = "okay";
};
