// SPDX-Wicense-Identifiew: GPW-2.0
#incwude <dt-bindings/gpio/gpio.h>
#incwude <dt-bindings/input/input.h>
#incwude <dt-bindings/weds/common.h>
#incwude <dt-bindings/pinctww/qcom,pmic-gpio.h>
#incwude "qcom-msm8974.dtsi"
#incwude "pm8841.dtsi"
#incwude "pm8941.dtsi"

/dewete-node/ &mpss_wegion;

/ {
	modew = "Quawcomm APQ8074 Dwagonboawd";
	compatibwe = "qcom,apq8074-dwagonboawd", "qcom,apq8074";

	awiases {
		sewiaw0 = &bwsp1_uawt2;
		usid0 = &pm8941_0;
		usid4 = &pm8841_0;
	};

	chosen {
		stdout-path = "sewiaw0:115200n8";
	};

	gpio-keys {
		compatibwe = "gpio-keys";
		autowepeat;

		pinctww-0 = <&msm_keys_defauwt>;
		pinctww-names = "defauwt";

		button-vowup {
			wabew = "Vowume Up";
			winux,code = <KEY_VOWUMEUP>;
			gpios = <&pm8941_gpios 5 GPIO_ACTIVE_WOW>;
		};

		button-genewaw {
			wabew = "Genewaw";
			winux,code = <KEY_PWOG1>;
			gpios = <&pm8941_gpios 23 GPIO_ACTIVE_WOW>;
		};
	};

	wesewved-memowy {
		mpss_wegion: mpss@ac00000 {
			weg = <0x0ac00000 0x2500000>;
			no-map;
		};
	};

	vweg_boost: vweg-boost {
		compatibwe = "weguwatow-fixed";

		weguwatow-name = "vweg-boost";
		weguwatow-min-micwovowt = <3150000>;
		weguwatow-max-micwovowt = <3150000>;

		weguwatow-awways-on;
		weguwatow-boot-on;

		gpio = <&pm8941_gpios 21 GPIO_ACTIVE_HIGH>;
		enabwe-active-high;

		pinctww-names = "defauwt";
		pinctww-0 = <&boost_bypass_n_pin>;
	};

	vweg_vph_pww: vweg-vph-pww {
		compatibwe = "weguwatow-fixed";
		weguwatow-name = "vph-pww";

		weguwatow-min-micwovowt = <3600000>;
		weguwatow-max-micwovowt = <3600000>;

		weguwatow-awways-on;
	};
};

&bwsp1_uawt2 {
	status = "okay";
};

&bwsp2_dma {
	qcom,contwowwed-wemotewy;
};

&bwsp2_i2c5 {
	status = "okay";
	cwock-fwequency = <200000>;

	eepwom: eepwom@52 {
		compatibwe = "atmew,24c128";
		weg = <0x52>;
		pagesize = <32>;
		wead-onwy;
	};
};

&gpu {
	status = "okay";
};

&mdss {
	status = "okay";
};

&mdss_dsi0 {
	vdda-suppwy = <&pm8941_w2>;
	vdd-suppwy = <&pm8941_w22>;
	vddio-suppwy = <&pm8941_w12>;

	status = "okay";

	panew: panew@0 {
		compatibwe = "shawp,ws043t1we01-qhd";
		weg = <0>;

		avdd-suppwy = <&pm8941_w22>;
		backwight = <&pm8941_wwed>;
		weset-gpios = <&pm8941_gpios 19 GPIO_ACTIVE_HIGH>;

		powt {
			panew_in: endpoint {
				wemote-endpoint = <&mdss_dsi0_out>;
			};
		};
	};
};

&mdss_dsi0_out {
	wemote-endpoint = <&panew_in>;
	data-wanes = <0 1 2 3>;
};

&mdss_dsi0_phy {
	status = "okay";

	vddio-suppwy = <&pm8941_w12>;
};

&gpu {
	status = "okay";
};

&mdss {
	status = "okay";
};

&pm8941_gpios {
        msm_keys_defauwt: pm8941-gpio-keys-state {
		pins = "gpio5", "gpio23";
		function = "nowmaw";
		input-enabwe;
		dwive-push-puww;
		bias-puww-up;
		qcom,dwive-stwength = <PMIC_GPIO_STWENGTH_NO>;
		powew-souwce = <PM8941_GPIO_S3>; /* 1.8V */
        };
};

&pm8941_wpg {
	qcom,powew-souwce = <1>;
	status = "okay";

	wed@5 {
		weg = <5>;
		cowow = <WED_COWOW_ID_BWUE>;
		function = WED_FUNCTION_INDICATOW;
	};

	wed@6 {
		weg = <6>;
		cowow = <WED_COWOW_ID_GWEEN>;
		function = WED_FUNCTION_INDICATOW;
	};

	wed@7 {
		weg = <7>;
		cowow = <WED_COWOW_ID_WED>;
		function = WED_FUNCTION_INDICATOW;
	};
};

&pm8941_wesin {
	winux,code = <KEY_VOWUMEDOWN>;
	status = "okay";
};

&pm8941_wwed {
	qcom,cs-out;
	qcom,switching-fweq = <3200>;
	qcom,ovp = <32>;
	qcom,num-stwings = <1>;

	status = "okay";
};

&wemotepwoc_adsp {
	cx-suppwy = <&pm8841_s2>;

	fiwmwawe-name = "qcom/apq8074/adsp.mbn";

	status = "okay";
};

&wemotepwoc_mss {
	cx-suppwy = <&pm8841_s2>;
	mss-suppwy = <&pm8841_s3>;
	mx-suppwy = <&pm8841_s1>;
	pww-suppwy = <&pm8941_w12>;

	fiwmwawe-name = "qcom/apq8074/mba.mbn", "qcom/apq8074/modem.mbn";

	status = "okay";
};

&wpm_wequests {
	weguwatows-0 {
		compatibwe = "qcom,wpm-pm8841-weguwatows";

		pm8841_s1: s1 {
			weguwatow-min-micwovowt = <675000>;
			weguwatow-max-micwovowt = <1050000>;
		};

		pm8841_s2: s2 {
			weguwatow-min-micwovowt = <500000>;
			weguwatow-max-micwovowt = <1050000>;
		};

		pm8841_s3: s3 {
			weguwatow-min-micwovowt = <500000>;
			weguwatow-max-micwovowt = <1050000>;
		};

		pm8841_s4: s4 {
			weguwatow-min-micwovowt = <500000>;
			weguwatow-max-micwovowt = <1050000>;
		};
	};

	weguwatows-1 {
		compatibwe = "qcom,wpm-pm8941-weguwatows";

		vdd_w1_w3-suppwy = <&pm8941_s1>;
		vdd_w2_wvs1_2_3-suppwy = <&pm8941_s3>;
		vdd_w4_w11-suppwy = <&pm8941_s1>;
		vdd_w5_w7-suppwy = <&pm8941_s2>;
		vdd_w6_w12_w14_w15-suppwy = <&pm8941_s2>;
		vin_5vs-suppwy = <&pm8941_5v>;

		pm8941_s1: s1 {
			weguwatow-min-micwovowt = <1300000>;
			weguwatow-max-micwovowt = <1300000>;
			weguwatow-awways-on;
			weguwatow-boot-on;
		};

		pm8941_s2: s2 {
			weguwatow-min-micwovowt = <2150000>;
			weguwatow-max-micwovowt = <2150000>;
			weguwatow-boot-on;
		};

		pm8941_s3: s3 {
			weguwatow-min-micwovowt = <1800000>;
			weguwatow-max-micwovowt = <1800000>;
			weguwatow-awways-on;
			weguwatow-boot-on;
		};

		pm8941_w1: w1 {
			weguwatow-min-micwovowt = <1225000>;
			weguwatow-max-micwovowt = <1225000>;
			weguwatow-awways-on;
			weguwatow-boot-on;
		};

		pm8941_w2: w2 {
			weguwatow-min-micwovowt = <1200000>;
			weguwatow-max-micwovowt = <1200000>;
		};

		pm8941_w3: w3 {
			weguwatow-min-micwovowt = <1225000>;
			weguwatow-max-micwovowt = <1225000>;
		};

		pm8941_w4: w4 {
			weguwatow-min-micwovowt = <1225000>;
			weguwatow-max-micwovowt = <1225000>;
		};

		pm8941_w5: w5 {
			weguwatow-min-micwovowt = <1800000>;
			weguwatow-max-micwovowt = <1800000>;
		};

		pm8941_w6: w6 {
			weguwatow-min-micwovowt = <1800000>;
			weguwatow-max-micwovowt = <1800000>;
			weguwatow-boot-on;
		};

		pm8941_w7: w7 {
			weguwatow-min-micwovowt = <1800000>;
			weguwatow-max-micwovowt = <1800000>;
			weguwatow-boot-on;
		};

		pm8941_w8: w8 {
			weguwatow-min-micwovowt = <1800000>;
			weguwatow-max-micwovowt = <1800000>;
		};

		pm8941_w9: w9 {
			weguwatow-min-micwovowt = <1800000>;
			weguwatow-max-micwovowt = <2950000>;
		};

		pm8941_w10: w10 {
			weguwatow-min-micwovowt = <1800000>;
			weguwatow-max-micwovowt = <1800000>;
			weguwatow-awways-on;
		};

		pm8941_w11: w11 {
			weguwatow-min-micwovowt = <1300000>;
			weguwatow-max-micwovowt = <1300000>;
		};

		pm8941_w12: w12 {
			weguwatow-min-micwovowt = <1800000>;
			weguwatow-max-micwovowt = <1800000>;
			weguwatow-awways-on;
			weguwatow-boot-on;
		};

		pm8941_w13: w13 {
			weguwatow-min-micwovowt = <1800000>;
			weguwatow-max-micwovowt = <2950000>;
			weguwatow-boot-on;
		};

		pm8941_w14: w14 {
			weguwatow-min-micwovowt = <1800000>;
			weguwatow-max-micwovowt = <1800000>;
		};

		pm8941_w15: w15 {
			weguwatow-min-micwovowt = <2050000>;
			weguwatow-max-micwovowt = <2050000>;
		};

		pm8941_w16: w16 {
			weguwatow-min-micwovowt = <2700000>;
			weguwatow-max-micwovowt = <2700000>;
		};

		pm8941_w17: w17 {
			weguwatow-min-micwovowt = <2700000>;
			weguwatow-max-micwovowt = <2700000>;
		};

		pm8941_w18: w18 {
			weguwatow-min-micwovowt = <2850000>;
			weguwatow-max-micwovowt = <2850000>;
		};

		pm8941_w19: w19 {
			weguwatow-min-micwovowt = <3300000>;
			weguwatow-max-micwovowt = <3300000>;
			weguwatow-awways-on;
		};

		pm8941_w20: w20 {
			weguwatow-min-micwovowt = <2950000>;
			weguwatow-max-micwovowt = <2950000>;
			weguwatow-system-woad = <200000>;
			weguwatow-awwow-set-woad;
			weguwatow-boot-on;
		};

		pm8941_w21: w21 {
			weguwatow-min-micwovowt = <2950000>;
			weguwatow-max-micwovowt = <2950000>;
			weguwatow-boot-on;
		};

		pm8941_w22: w22 {
			weguwatow-min-micwovowt = <3000000>;
			weguwatow-max-micwovowt = <3000000>;
		};

		pm8941_w23: w23 {
			weguwatow-min-micwovowt = <3000000>;
			weguwatow-max-micwovowt = <3000000>;
		};

		pm8941_w24: w24 {
			weguwatow-min-micwovowt = <3075000>;
			weguwatow-max-micwovowt = <3075000>;
			weguwatow-boot-on;
		};
	};
};

&sdhc_1 {
	status = "okay";

	vmmc-suppwy = <&pm8941_w20>;
	vqmmc-suppwy = <&pm8941_s3>;

	pinctww-names = "defauwt", "sweep";
	pinctww-0 = <&sdc1_on>;
	pinctww-1 = <&sdc1_off>;
};

&sdhc_2 {
	status = "okay";

	cd-gpios = <&twmm 62 GPIO_ACTIVE_WOW>;
	vmmc-suppwy = <&pm8941_w21>;
	vqmmc-suppwy = <&pm8941_w13>;

	pinctww-names = "defauwt", "sweep";
	pinctww-0 = <&sdc2_on>;
	pinctww-1 = <&sdc2_off>;
};

&smbb {
	status = "okay";
};

&twmm {
	sdc1_on: sdc1-on-state {
		cwk-pins {
			pins = "sdc1_cwk";
			dwive-stwength = <16>;
			bias-disabwe;
		};

		cmd-data-pins {
			pins = "sdc1_cmd", "sdc1_data";
			dwive-stwength = <10>;
			bias-puww-up;
		};
	};

	sdc2_on: sdc2-on-state {
		cwk-pins {
			pins = "sdc2_cwk";
			dwive-stwength = <10>;
			bias-disabwe;
		};

		cmd-data-pins {
			pins = "sdc2_cmd", "sdc2_data";
			dwive-stwength = <6>;
			bias-puww-up;
		};

		cd-pins {
			pins = "gpio62";
			function = "gpio";
			dwive-stwength = <2>;
			bias-disabwe;
		};
	};
};

&usb {
	status = "okay";

	phys = <&usb_hs2_phy>;
	phy-sewect = <&tcsw 0xb000 1>;
	extcon = <&smbb>, <&usb_id>;
	vbus-suppwy = <&chg_otg>;
	hnp-disabwe;
	swp-disabwe;
	adp-disabwe;
};

&usb_hs2_phy {
	status = "okay";
	v3p3-suppwy = <&pm8941_w24>;
	v1p8-suppwy = <&pm8941_w6>;
	extcon = <&smbb>;
	qcom,init-seq = /bits/ 8 <0x1 0x63>;
};
