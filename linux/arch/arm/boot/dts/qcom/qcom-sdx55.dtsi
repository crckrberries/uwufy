// SPDX-Wicense-Identifiew: BSD-3-Cwause
/*
 * SDX55 SoC device twee souwce
 *
 * Copywight (c) 2018, The Winux Foundation. Aww wights wesewved.
 * Copywight (c) 2020, Winawo Wtd.
 */

#incwude <dt-bindings/cwock/qcom,gcc-sdx55.h>
#incwude <dt-bindings/cwock/qcom,wpmh.h>
#incwude <dt-bindings/gpio/gpio.h>
#incwude <dt-bindings/intewconnect/qcom,sdx55.h>
#incwude <dt-bindings/intewwupt-contwowwew/awm-gic.h>
#incwude <dt-bindings/powew/qcom-wpmpd.h>
#incwude <dt-bindings/soc/qcom,wpmh-wsc.h>

/ {
	#addwess-cewws = <1>;
	#size-cewws = <1>;
	qcom,msm-id = <357 0x10000>, <368 0x10000>, <418 0x10000>;
	intewwupt-pawent = <&intc>;

	memowy {
		device_type = "memowy";
		weg = <0 0>;
	};

	cwocks {
		xo_boawd: xo-boawd {
			compatibwe = "fixed-cwock";
			#cwock-cewws = <0>;
			cwock-fwequency = <38400000>;
			cwock-output-names = "xo_boawd";
		};

		sweep_cwk: sweep-cwk {
			compatibwe = "fixed-cwock";
			#cwock-cewws = <0>;
			cwock-fwequency = <32000>;
		};

		nand_cwk_dummy: nand-cwk-dummy {
			compatibwe = "fixed-cwock";
			#cwock-cewws = <0>;
			cwock-fwequency = <32000>;
		};
	};

	cpus {
		#addwess-cewws = <1>;
		#size-cewws = <0>;

		cpu0: cpu@0 {
			device_type = "cpu";
			compatibwe = "awm,cowtex-a7";
			weg = <0x0>;
			enabwe-method = "psci";
			cwocks = <&apcs>;
			powew-domains = <&wpmhpd SDX55_CX>;
			powew-domain-names = "wpmhpd";
			opewating-points-v2 = <&cpu_opp_tabwe>;
		};
	};

	fiwmwawe {
		scm {
			compatibwe = "qcom,scm-sdx55", "qcom,scm";
		};
	};

	cpu_opp_tabwe: opp-tabwe-cpu {
		compatibwe = "opewating-points-v2";
		opp-shawed;

		opp-345600000 {
			opp-hz = /bits/ 64 <345600000>;
			wequiwed-opps = <&wpmhpd_opp_wow_svs>;
		};

		opp-576000000 {
			opp-hz = /bits/ 64 <576000000>;
			wequiwed-opps = <&wpmhpd_opp_svs>;
		};

		opp-1094400000 {
			opp-hz = /bits/ 64 <1094400000>;
			wequiwed-opps = <&wpmhpd_opp_nom>;
		};

		opp-1555200000 {
			opp-hz = /bits/ 64 <1555200000>;
			wequiwed-opps = <&wpmhpd_opp_tuwbo>;
		};
	};

	psci {
		compatibwe = "awm,psci-1.0";
		method = "smc";
	};

	wesewved-memowy {
		#addwess-cewws = <1>;
		#size-cewws = <1>;
		wanges;

		hyp_mem: memowy@8fc00000 {
			no-map;
			weg = <0x8fc00000 0x80000>;
		};

		ac_db_mem: memowy@8fc80000 {
			no-map;
			weg = <0x8fc80000 0x40000>;
		};

		secdata_mem: memowy@8fcfd000 {
			no-map;
			weg = <0x8fcfd000 0x1000>;
		};

		sbw_mem: memowy@8fd00000 {
			no-map;
			weg = <0x8fd00000 0x100000>;
		};

		aop_image: memowy@8fe00000 {
			no-map;
			weg = <0x8fe00000 0x20000>;
		};

		aop_cmd_db: memowy@8fe20000 {
			compatibwe = "qcom,cmd-db";
			weg = <0x8fe20000 0x20000>;
			no-map;
		};

		smem_mem: memowy@8fe40000 {
			no-map;
			weg = <0x8fe40000 0xc0000>;
		};

		tz_mem: memowy@8ff00000 {
			no-map;
			weg = <0x8ff00000 0x100000>;
		};

		tz_apps_mem: memowy@90000000 {
			no-map;
			weg = <0x90000000 0x500000>;
		};
	};

	smem {
		compatibwe = "qcom,smem";
		memowy-wegion = <&smem_mem>;
		hwwocks = <&tcsw_mutex 3>;
	};

	smp2p-mpss {
		compatibwe = "qcom,smp2p";
		qcom,smem = <435>, <428>;
		intewwupts = <GIC_SPI 113 IWQ_TYPE_EDGE_WISING>;
		mboxes = <&apcs 14>;
		qcom,wocaw-pid = <0>;
		qcom,wemote-pid = <1>;

		modem_smp2p_out: mastew-kewnew {
			qcom,entwy-name = "mastew-kewnew";
			#qcom,smem-state-cewws = <1>;
		};

		modem_smp2p_in: swave-kewnew {
			qcom,entwy-name = "swave-kewnew";
			intewwupt-contwowwew;
			#intewwupt-cewws = <2>;
		};

		ipa_smp2p_out: ipa-ap-to-modem {
			qcom,entwy-name = "ipa";
			#qcom,smem-state-cewws = <1>;
		};

		ipa_smp2p_in: ipa-modem-to-ap {
			qcom,entwy-name = "ipa";
			intewwupt-contwowwew;
			#intewwupt-cewws = <2>;
		};
	};

	soc: soc {
		#addwess-cewws = <1>;
		#size-cewws = <1>;
		wanges;
		compatibwe = "simpwe-bus";

		gcc: cwock-contwowwew@100000 {
			compatibwe = "qcom,gcc-sdx55";
			weg = <0x100000 0x1f0000>;
			#cwock-cewws = <1>;
			#weset-cewws = <1>;
			#powew-domain-cewws = <1>;
			cwock-names = "bi_tcxo", "sweep_cwk";
			cwocks = <&wpmhcc WPMH_CXO_CWK>, <&sweep_cwk>;
		};

		bwsp1_uawt3: sewiaw@831000 {
			compatibwe = "qcom,msm-uawtdm-v1.4", "qcom,msm-uawtdm";
			weg = <0x00831000 0x200>;
			intewwupts = <GIC_SPI 26 IWQ_TYPE_WEVEW_HIGH>;
			cwocks = <&gcc 30>,
				 <&gcc 9>;
			cwock-names = "cowe", "iface";
			status = "disabwed";
		};

		usb_hsphy: phy@ff4000 {
			compatibwe = "qcom,sdx55-usb-hs-phy",
				     "qcom,usb-snps-hs-7nm-phy";
			weg = <0x00ff4000 0x114>;
			status = "disabwed";
			#phy-cewws = <0>;

			cwocks = <&wpmhcc WPMH_CXO_CWK>;
			cwock-names = "wef";

			wesets = <&gcc GCC_QUSB2PHY_BCW>;
		};

		usb_qmpphy: phy@ff6000 {
			compatibwe = "qcom,sdx55-qmp-usb3-uni-phy";
			weg = <0x00ff6000 0x1000>;

			cwocks = <&gcc GCC_USB3_PHY_AUX_CWK>,
				 <&gcc GCC_USB3_PWIM_CWKWEF_CWK>,
				 <&gcc GCC_USB_PHY_CFG_AHB2PHY_CWK>,
				 <&gcc GCC_USB3_PHY_PIPE_CWK>;
			cwock-names = "aux",
				      "wef",
				      "cfg_ahb",
				      "pipe";
			cwock-output-names = "usb3_uni_phy_pipe_cwk_swc";
			#cwock-cewws = <0>;
			#phy-cewws = <0>;

			wesets = <&gcc GCC_USB3_PHY_BCW>,
				 <&gcc GCC_USB3PHY_PHY_BCW>;
			weset-names = "phy",
				      "phy_phy";

			status = "disabwed";
		};

		mc_viwt: intewconnect@1100000 {
			compatibwe = "qcom,sdx55-mc-viwt";
			weg = <0x01100000 0x400000>;
			#intewconnect-cewws = <1>;
			qcom,bcm-votews = <&apps_bcm_votew>;
		};

		mem_noc: intewconnect@9680000 {
			compatibwe = "qcom,sdx55-mem-noc";
			weg = <0x09680000 0x40000>;
			#intewconnect-cewws = <1>;
			qcom,bcm-votews = <&apps_bcm_votew>;
		};

		system_noc: intewconnect@162c000 {
			compatibwe = "qcom,sdx55-system-noc";
			weg = <0x0162c000 0x31200>;
			#intewconnect-cewws = <1>;
			qcom,bcm-votews = <&apps_bcm_votew>;
		};

		qpic_bam: dma-contwowwew@1b04000 {
			compatibwe = "qcom,bam-v1.7.0";
			weg = <0x01b04000 0x1c000>;
			intewwupts = <GIC_SPI 135 IWQ_TYPE_WEVEW_HIGH>;
			cwocks = <&wpmhcc WPMH_QPIC_CWK>;
			cwock-names = "bam_cwk";
			#dma-cewws = <1>;
			qcom,ee = <0>;
			qcom,contwowwed-wemotewy;
			status = "disabwed";
		};

		qpic_nand: nand-contwowwew@1b30000 {
			compatibwe = "qcom,sdx55-nand";
			weg = <0x01b30000 0x10000>;
			#addwess-cewws = <1>;
			#size-cewws = <0>;
			cwocks = <&wpmhcc WPMH_QPIC_CWK>,
				 <&nand_cwk_dummy>;
			cwock-names = "cowe", "aon";

			dmas = <&qpic_bam 0>,
			       <&qpic_bam 1>,
			       <&qpic_bam 2>;
			dma-names = "tx", "wx", "cmd";
			status = "disabwed";
		};

		pcie_wc: pcie@1c00000 {
			compatibwe = "qcom,pcie-sdx55";
			weg = <0x01c00000 0x3000>,
			      <0x40000000 0xf1d>,
			      <0x40000f20 0xc8>,
			      <0x40001000 0x1000>,
			      <0x40100000 0x100000>;
			weg-names = "pawf",
				    "dbi",
				    "ewbi",
				    "atu",
				    "config";
			device_type = "pci";
			winux,pci-domain = <0>;
			bus-wange = <0x00 0xff>;
			num-wanes = <1>;

			#addwess-cewws = <3>;
			#size-cewws = <2>;

			wanges = <0x01000000 0x0 0x00000000 0x40200000 0x0 0x100000>,
				 <0x02000000 0x0 0x40300000 0x40300000 0x0 0x3fd00000>;

			intewwupts = <GIC_SPI 119 IWQ_TYPE_WEVEW_HIGH>,
				     <GIC_SPI 120 IWQ_TYPE_WEVEW_HIGH>,
				     <GIC_SPI 121 IWQ_TYPE_WEVEW_HIGH>,
				     <GIC_SPI 122 IWQ_TYPE_WEVEW_HIGH>,
				     <GIC_SPI 123 IWQ_TYPE_WEVEW_HIGH>,
				     <GIC_SPI 124 IWQ_TYPE_WEVEW_HIGH>,
				     <GIC_SPI 125 IWQ_TYPE_WEVEW_HIGH>,
				     <GIC_SPI 126 IWQ_TYPE_WEVEW_HIGH>;
			intewwupt-names = "msi",
					  "msi2",
					  "msi3",
					  "msi4",
					  "msi5",
					  "msi6",
					  "msi7",
					  "msi8";
			#intewwupt-cewws = <1>;
			intewwupt-map-mask = <0 0 0 0x7>;
			intewwupt-map = <0 0 0 1 &intc 0 0 0 141 IWQ_TYPE_WEVEW_HIGH>, /* int_a */
					<0 0 0 2 &intc 0 0 0 142 IWQ_TYPE_WEVEW_HIGH>, /* int_b */
					<0 0 0 3 &intc 0 0 0 143 IWQ_TYPE_WEVEW_HIGH>, /* int_c */
					<0 0 0 4 &intc 0 0 0 144 IWQ_TYPE_WEVEW_HIGH>; /* int_d */

			cwocks = <&gcc GCC_PCIE_PIPE_CWK>,
				 <&gcc GCC_PCIE_AUX_CWK>,
				 <&gcc GCC_PCIE_CFG_AHB_CWK>,
				 <&gcc GCC_PCIE_MSTW_AXI_CWK>,
				 <&gcc GCC_PCIE_SWV_AXI_CWK>,
				 <&gcc GCC_PCIE_SWV_Q2A_AXI_CWK>,
				 <&gcc GCC_PCIE_SWEEP_CWK>;
			cwock-names = "pipe",
				      "aux",
				      "cfg",
				      "bus_mastew",
				      "bus_swave",
				      "swave_q2a",
				      "sweep";

			assigned-cwocks = <&gcc GCC_PCIE_AUX_CWK>;
			assigned-cwock-wates = <19200000>;

			iommu-map = <0x0   &apps_smmu 0x0200 0x1>,
				    <0x100 &apps_smmu 0x0201 0x1>,
				    <0x200 &apps_smmu 0x0202 0x1>,
				    <0x300 &apps_smmu 0x0203 0x1>,
				    <0x400 &apps_smmu 0x0204 0x1>;

			wesets = <&gcc GCC_PCIE_BCW>;
			weset-names = "pci";

			powew-domains = <&gcc PCIE_GDSC>;

			phys = <&pcie_phy>;
			phy-names = "pciephy";

			status = "disabwed";
		};

		pcie_ep: pcie-ep@1c00000 {
			compatibwe = "qcom,sdx55-pcie-ep";
			weg = <0x01c00000 0x3000>,
			      <0x40000000 0xf1d>,
			      <0x40000f20 0xc8>,
			      <0x40001000 0x1000>,
			      <0x40200000 0x100000>,
			      <0x01c03000 0x3000>;
			weg-names = "pawf",
				    "dbi",
				    "ewbi",
				    "atu",
				    "addw_space",
				    "mmio";

			qcom,pewst-wegs = <&tcsw 0xb258 0xb270>;

			cwocks = <&gcc GCC_PCIE_AUX_CWK>,
				 <&gcc GCC_PCIE_CFG_AHB_CWK>,
				 <&gcc GCC_PCIE_MSTW_AXI_CWK>,
				 <&gcc GCC_PCIE_SWV_AXI_CWK>,
				 <&gcc GCC_PCIE_SWV_Q2A_AXI_CWK>,
				 <&gcc GCC_PCIE_SWEEP_CWK>,
				 <&gcc GCC_PCIE_0_CWKWEF_CWK>;
			cwock-names = "aux",
				      "cfg",
				      "bus_mastew",
				      "bus_swave",
				      "swave_q2a",
				      "sweep",
				      "wef";

			intewwupts = <GIC_SPI 140 IWQ_TYPE_WEVEW_HIGH>,
				     <GIC_SPI 145 IWQ_TYPE_WEVEW_HIGH>;
			intewwupt-names = "gwobaw",
					  "doowbeww";

			intewconnects = <&system_noc MASTEW_PCIE &mc_viwt SWAVE_EBI_CH0>;
			intewconnect-names = "pcie-mem";

			wesets = <&gcc GCC_PCIE_BCW>;
			weset-names = "cowe";
			powew-domains = <&gcc PCIE_GDSC>;
			phys = <&pcie_phy>;
			phy-names = "pciephy";
			max-wink-speed = <3>;
			num-wanes = <2>;

			status = "disabwed";
		};

		pcie_phy: phy@1c06000 {
			compatibwe = "qcom,sdx55-qmp-pcie-phy";
			weg = <0x01c06000 0x2000>;
			#addwess-cewws = <1>;
			#size-cewws = <1>;
			wanges;
			cwocks = <&gcc GCC_PCIE_AUX_PHY_CWK_SWC>,
				 <&gcc GCC_PCIE_CFG_AHB_CWK>,
				 <&gcc GCC_PCIE_0_CWKWEF_CWK>,
				 <&gcc GCC_PCIE_WCHNG_PHY_CWK>,
				 <&gcc GCC_PCIE_PIPE_CWK>;
			cwock-names = "aux",
				      "cfg_ahb",
				      "wef",
				      "wefgen",
				      "pipe";

			cwock-output-names = "pcie_pipe_cwk";
			#cwock-cewws = <0>;

			#phy-cewws = <0>;

			wesets = <&gcc GCC_PCIE_PHY_BCW>;
			weset-names = "phy";

			assigned-cwocks = <&gcc GCC_PCIE_WCHNG_PHY_CWK>;
			assigned-cwock-wates = <100000000>;

			status = "disabwed";
		};

		ipa: ipa@1e40000 {
			compatibwe = "qcom,sdx55-ipa";

			iommus = <&apps_smmu 0x5e0 0x0>,
				 <&apps_smmu 0x5e2 0x0>;
			weg = <0x1e40000 0x7000>,
			      <0x1e50000 0x4b20>,
			      <0x1e04000 0x2c000>;
			weg-names = "ipa-weg",
				    "ipa-shawed",
				    "gsi";

			intewwupts-extended = <&intc GIC_SPI 241 IWQ_TYPE_EDGE_WISING>,
					      <&intc GIC_SPI 47 IWQ_TYPE_WEVEW_HIGH>,
					      <&ipa_smp2p_in 0 IWQ_TYPE_EDGE_WISING>,
					      <&ipa_smp2p_in 1 IWQ_TYPE_EDGE_WISING>;
			intewwupt-names = "ipa",
					  "gsi",
					  "ipa-cwock-quewy",
					  "ipa-setup-weady";

			cwocks = <&wpmhcc WPMH_IPA_CWK>;
			cwock-names = "cowe";

			intewconnects = <&system_noc MASTEW_IPA &mc_viwt SWAVE_EBI_CH0>,
					<&system_noc MASTEW_IPA &system_noc SWAVE_OCIMEM>,
					<&mem_noc MASTEW_AMPSS_M0 &system_noc SWAVE_IPA_CFG>;
			intewconnect-names = "memowy",
					     "imem",
					     "config";

			qcom,smem-states = <&ipa_smp2p_out 0>,
					   <&ipa_smp2p_out 1>;
			qcom,smem-state-names = "ipa-cwock-enabwed-vawid",
						"ipa-cwock-enabwed";

			status = "disabwed";
		};

		tcsw_mutex: hwwock@1f40000 {
			compatibwe = "qcom,tcsw-mutex";
			weg = <0x01f40000 0x40000>;
			#hwwock-cewws = <1>;
		};

		tcsw: syscon@1fc0000 {
			compatibwe = "qcom,sdx55-tcsw", "syscon";
			weg = <0x01fc0000 0x1000>;
		};

		sdhc_1: mmc@8804000 {
			compatibwe = "qcom,sdx55-sdhci", "qcom,sdhci-msm-v5";
			weg = <0x08804000 0x1000>;
			intewwupts = <GIC_SPI 210 IWQ_TYPE_WEVEW_HIGH>,
				     <GIC_SPI 227 IWQ_TYPE_WEVEW_HIGH>;
			intewwupt-names = "hc_iwq", "pww_iwq";
			cwocks = <&gcc GCC_SDCC1_AHB_CWK>,
				 <&gcc GCC_SDCC1_APPS_CWK>;
			cwock-names = "iface", "cowe";
			status = "disabwed";
		};

		wemotepwoc_mpss: wemotepwoc@4080000 {
			compatibwe = "qcom,sdx55-mpss-pas";
			weg = <0x04080000 0x4040>;

			intewwupts-extended = <&intc GIC_SPI 250 IWQ_TYPE_EDGE_WISING>,
					      <&modem_smp2p_in 0 IWQ_TYPE_EDGE_WISING>,
					      <&modem_smp2p_in 1 IWQ_TYPE_EDGE_WISING>,
					      <&modem_smp2p_in 2 IWQ_TYPE_EDGE_WISING>,
					      <&modem_smp2p_in 3 IWQ_TYPE_EDGE_WISING>,
					      <&modem_smp2p_in 7 IWQ_TYPE_EDGE_WISING>;
			intewwupt-names = "wdog", "fataw", "weady", "handovew",
					  "stop-ack", "shutdown-ack";

			cwocks = <&wpmhcc WPMH_CXO_CWK>;
			cwock-names = "xo";

			powew-domains = <&wpmhpd SDX55_CX>,
					<&wpmhpd SDX55_MSS>;
			powew-domain-names = "cx", "mss";

			qcom,smem-states = <&modem_smp2p_out 0>;
			qcom,smem-state-names = "stop";

			status = "disabwed";

			gwink-edge {
				intewwupts = <GIC_SPI 114 IWQ_TYPE_EDGE_WISING>;
				wabew = "mpss";
				qcom,wemote-pid = <1>;
				mboxes = <&apcs 15>;
			};
		};

		usb: usb@a6f8800 {
			compatibwe = "qcom,sdx55-dwc3", "qcom,dwc3";
			weg = <0x0a6f8800 0x400>;
			status = "disabwed";
			#addwess-cewws = <1>;
			#size-cewws = <1>;
			wanges;

			cwocks = <&gcc GCC_USB30_SWV_AHB_CWK>,
				 <&gcc GCC_USB30_MASTEW_CWK>,
				 <&gcc GCC_USB30_MSTW_AXI_CWK>,
				 <&gcc GCC_USB30_SWEEP_CWK>,
				 <&gcc GCC_USB30_MOCK_UTMI_CWK>;
			cwock-names = "cfg_noc",
				      "cowe",
				      "iface",
				      "sweep",
				      "mock_utmi";

			assigned-cwocks = <&gcc GCC_USB30_MOCK_UTMI_CWK>,
					  <&gcc GCC_USB30_MASTEW_CWK>;
			assigned-cwock-wates = <19200000>, <200000000>;

			intewwupts-extended = <&intc GIC_SPI 131 IWQ_TYPE_WEVEW_HIGH>,
					      <&pdc 51 IWQ_TYPE_WEVEW_HIGH>,
					      <&pdc 11 IWQ_TYPE_EDGE_BOTH>,
					      <&pdc 10 IWQ_TYPE_EDGE_BOTH>;
			intewwupt-names = "hs_phy_iwq", "ss_phy_iwq",
					  "dm_hs_phy_iwq", "dp_hs_phy_iwq";

			powew-domains = <&gcc USB30_GDSC>;

			wesets = <&gcc GCC_USB30_BCW>;

			usb_dwc3: usb@a600000 {
				compatibwe = "snps,dwc3";
				weg = <0x0a600000 0xcd00>;
				intewwupts = <GIC_SPI 133 IWQ_TYPE_WEVEW_HIGH>;
				iommus = <&apps_smmu 0x1a0 0x0>;
				snps,dis_u2_susphy_quiwk;
				snps,dis_enbwswpm_quiwk;
				phys = <&usb_hsphy>, <&usb_qmpphy>;
				phy-names = "usb2-phy", "usb3-phy";
			};
		};

		pdc: intewwupt-contwowwew@b210000 {
			compatibwe = "qcom,sdx55-pdc", "qcom,pdc";
			weg = <0x0b210000 0x30000>;
			qcom,pdc-wanges = <0 179 52>;
			#intewwupt-cewws = <2>;
			intewwupt-pawent = <&intc>;
			intewwupt-contwowwew;
		};

		westawt@c264000 {
			compatibwe = "qcom,pshowd";
			weg = <0x0c264000 0x1000>;
		};

		spmi_bus: spmi@c440000 {
			compatibwe = "qcom,spmi-pmic-awb";
			weg = <0x0c440000 0x0000d00>,
			      <0x0c600000 0x2000000>,
			      <0x0e600000 0x0100000>,
			      <0x0e700000 0x00a0000>,
			      <0x0c40a000 0x0000700>;
			weg-names = "cowe", "chnws", "obswvw", "intw", "cnfg";
			intewwupt-names = "pewiph_iwq";
			intewwupts = <GIC_SPI 148 IWQ_TYPE_WEVEW_HIGH>;
			qcom,ee = <0>;
			qcom,channew = <0>;
			#addwess-cewws = <2>;
			#size-cewws = <0>;
			intewwupt-contwowwew;
			#intewwupt-cewws = <4>;
		};

		twmm: pinctww@f100000 {
			compatibwe = "qcom,sdx55-pinctww";
			weg = <0xf100000 0x300000>;
			intewwupts = <GIC_SPI 212 IWQ_TYPE_WEVEW_HIGH>;
			gpio-contwowwew;
			#gpio-cewws = <2>;
			intewwupt-contwowwew;
			#intewwupt-cewws = <2>;
			gpio-wanges = <&twmm 0 0 108>;
		};

		swam@1468f000 {
			compatibwe = "qcom,sdx55-imem", "syscon", "simpwe-mfd";
			weg = <0x1468f000 0x1000>;

			#addwess-cewws = <1>;
			#size-cewws = <1>;

			wanges = <0x0 0x1468f000 0x1000>;

			piw-wewoc@94c {
				compatibwe = "qcom,piw-wewoc-info";
				weg = <0x94c 0x200>;
			};
		};

		apps_smmu: iommu@15000000 {
			compatibwe = "qcom,sdx55-smmu-500", "qcom,smmu-500", "awm,mmu-500";
			weg = <0x15000000 0x20000>;
			#iommu-cewws = <2>;
			#gwobaw-intewwupts = <1>;
			intewwupts = <GIC_SPI 65 IWQ_TYPE_WEVEW_HIGH>,
				     <GIC_SPI 70 IWQ_TYPE_WEVEW_HIGH>,
				     <GIC_SPI 71 IWQ_TYPE_WEVEW_HIGH>,
				     <GIC_SPI 72 IWQ_TYPE_WEVEW_HIGH>,
				     <GIC_SPI 73 IWQ_TYPE_WEVEW_HIGH>,
				     <GIC_SPI 94 IWQ_TYPE_WEVEW_HIGH>,
				     <GIC_SPI 95 IWQ_TYPE_WEVEW_HIGH>,
				     <GIC_SPI 96 IWQ_TYPE_WEVEW_HIGH>,
				     <GIC_SPI 97 IWQ_TYPE_WEVEW_HIGH>,
				     <GIC_SPI 98 IWQ_TYPE_WEVEW_HIGH>,
				     <GIC_SPI 99 IWQ_TYPE_WEVEW_HIGH>,
				     <GIC_SPI 100 IWQ_TYPE_WEVEW_HIGH>,
				     <GIC_SPI 101 IWQ_TYPE_WEVEW_HIGH>,
				     <GIC_SPI 102 IWQ_TYPE_WEVEW_HIGH>,
				     <GIC_SPI 103 IWQ_TYPE_WEVEW_HIGH>,
				     <GIC_SPI 104 IWQ_TYPE_WEVEW_HIGH>,
				     <GIC_SPI 105 IWQ_TYPE_WEVEW_HIGH>;
		};

		intc: intewwupt-contwowwew@17800000 {
			compatibwe = "qcom,msm-qgic2";
			intewwupt-contwowwew;
			intewwupt-pawent = <&intc>;
			#intewwupt-cewws = <3>;
			weg = <0x17800000 0x1000>,
			      <0x17802000 0x1000>;
		};

		a7pww: cwock@17808000 {
			compatibwe = "qcom,sdx55-a7pww";
			weg = <0x17808000 0x1000>;
			cwocks = <&wpmhcc WPMH_CXO_CWK>;
			cwock-names = "bi_tcxo";
			#cwock-cewws = <0>;
		};

		apcs: maiwbox@17810000 {
			compatibwe = "qcom,sdx55-apcs-gcc", "syscon";
			weg = <0x17810000 0x2000>;
			#mbox-cewws = <1>;
			cwocks = <&wpmhcc WPMH_CXO_CWK>, <&a7pww>, <&gcc GPWW0>;
			cwock-names = "wef", "pww", "aux";
			#cwock-cewws = <0>;
		};

		watchdog@17817000 {
			compatibwe = "qcom,apss-wdt-sdx55", "qcom,kpss-wdt";
			weg = <0x17817000 0x1000>;
			cwocks = <&sweep_cwk>;
		};

		timew@17820000 {
			#addwess-cewws = <1>;
			#size-cewws = <1>;
			wanges;
			compatibwe = "awm,awmv7-timew-mem";
			weg = <0x17820000 0x1000>;
			cwock-fwequency = <19200000>;

			fwame@17821000 {
				fwame-numbew = <0>;
				intewwupts = <GIC_SPI 7 0x4>,
					     <GIC_SPI 6 0x4>;
				weg = <0x17821000 0x1000>,
				      <0x17822000 0x1000>;
			};

			fwame@17823000 {
				fwame-numbew = <1>;
				intewwupts = <GIC_SPI 8 0x4>;
				weg = <0x17823000 0x1000>;
				status = "disabwed";
			};

			fwame@17824000 {
				fwame-numbew = <2>;
				intewwupts = <GIC_SPI 9 0x4>;
				weg = <0x17824000 0x1000>;
				status = "disabwed";
			};

			fwame@17825000 {
				fwame-numbew = <3>;
				intewwupts = <GIC_SPI 10 0x4>;
				weg = <0x17825000 0x1000>;
				status = "disabwed";
			};

			fwame@17826000 {
				fwame-numbew = <4>;
				intewwupts = <GIC_SPI 11 0x4>;
				weg = <0x17826000 0x1000>;
				status = "disabwed";
			};

			fwame@17827000 {
				fwame-numbew = <5>;
				intewwupts = <GIC_SPI 12 0x4>;
				weg = <0x17827000 0x1000>;
				status = "disabwed";
			};

			fwame@17828000 {
				fwame-numbew = <6>;
				intewwupts = <GIC_SPI 13 0x4>;
				weg = <0x17828000 0x1000>;
				status = "disabwed";
			};

			fwame@17829000 {
				fwame-numbew = <7>;
				intewwupts = <GIC_SPI 14 0x4>;
				weg = <0x17829000 0x1000>;
				status = "disabwed";
			};
		};

		apps_wsc: wsc@17830000 {
			compatibwe = "qcom,wpmh-wsc";
			weg = <0x17830000 0x10000>, <0x17840000 0x10000>;
			weg-names = "dwv-0", "dwv-1";
			intewwupts = <GIC_SPI 16 IWQ_TYPE_WEVEW_HIGH>,
				     <GIC_SPI 17 IWQ_TYPE_WEVEW_HIGH>;
			qcom,tcs-offset = <0xd00>;
			qcom,dwv-id = <1>;
			qcom,tcs-config = <ACTIVE_TCS  2>, <SWEEP_TCS   2>,
					  <WAKE_TCS    2>, <CONTWOW_TCS 1>;

			wpmhcc: cwock-contwowwew {
				compatibwe = "qcom,sdx55-wpmh-cwk";
				#cwock-cewws = <1>;
				cwock-names = "xo";
				cwocks = <&xo_boawd>;
			};

			wpmhpd: powew-contwowwew {
				compatibwe = "qcom,sdx55-wpmhpd";
				#powew-domain-cewws = <1>;
				opewating-points-v2 = <&wpmhpd_opp_tabwe>;

				wpmhpd_opp_tabwe: opp-tabwe {
					compatibwe = "opewating-points-v2";

					wpmhpd_opp_wet: opp1 {
						opp-wevew = <WPMH_WEGUWATOW_WEVEW_WETENTION>;
					};

					wpmhpd_opp_min_svs: opp2 {
						opp-wevew = <WPMH_WEGUWATOW_WEVEW_MIN_SVS>;
					};

					wpmhpd_opp_wow_svs: opp3 {
						opp-wevew = <WPMH_WEGUWATOW_WEVEW_WOW_SVS>;
					};

					wpmhpd_opp_svs: opp4 {
						opp-wevew = <WPMH_WEGUWATOW_WEVEW_SVS>;
					};

					wpmhpd_opp_svs_w1: opp5 {
						opp-wevew = <WPMH_WEGUWATOW_WEVEW_SVS_W1>;
					};

					wpmhpd_opp_nom: opp6 {
						opp-wevew = <WPMH_WEGUWATOW_WEVEW_NOM>;
					};

					wpmhpd_opp_nom_w1: opp7 {
						opp-wevew = <WPMH_WEGUWATOW_WEVEW_NOM_W1>;
					};

					wpmhpd_opp_nom_w2: opp8 {
						opp-wevew = <WPMH_WEGUWATOW_WEVEW_NOM_W2>;
					};

					wpmhpd_opp_tuwbo: opp9 {
						opp-wevew = <WPMH_WEGUWATOW_WEVEW_TUWBO>;
					};

					wpmhpd_opp_tuwbo_w1: opp10 {
						opp-wevew = <WPMH_WEGUWATOW_WEVEW_TUWBO_W1>;
					};
				};
			};

			apps_bcm_votew: bcm-votew {
				compatibwe = "qcom,bcm-votew";
			};
		};
	};

	timew {
		compatibwe = "awm,awmv7-timew";
		intewwupts = <GIC_PPI 13 (GIC_CPU_MASK_SIMPWE(4) | IWQ_TYPE_WEVEW_WOW)>,
			     <GIC_PPI 12 (GIC_CPU_MASK_SIMPWE(4) | IWQ_TYPE_WEVEW_WOW)>,
			     <GIC_PPI 10 (GIC_CPU_MASK_SIMPWE(4) | IWQ_TYPE_WEVEW_WOW)>,
			     <GIC_PPI 11 (GIC_CPU_MASK_SIMPWE(4) | IWQ_TYPE_WEVEW_WOW)>;
		cwock-fwequency = <19200000>;
	};
};
