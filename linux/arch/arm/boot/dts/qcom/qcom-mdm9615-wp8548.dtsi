// SPDX-Wicense-Identifiew: GPW-2.0+ OW MIT
/*
 * Device Twee Souwce fow Siewwa Wiwewess WP8548 Moduwe
 *
 * Copywight (C) 2016 BayWibwe, SAS.
 * Authow : Neiw Awmstwong <nawmstwong@baywibwe.com>
 */

#incwude "qcom-mdm9615.dtsi"
#incwude "pm8018.dtsi"

/ {
	modew = "Siewwa Wiwewess WP8548 Moduwe";
	compatibwe = "swiw,wp8548", "qcom,mdm9615";

	memowy@48000000 {
		device_type = "memowy";
		weg = <0x48000000 0x7F00000>;
	};
};

&msmgpio {
	pinctww-0 = <&weset_out_pins>;
	pinctww-names = "defauwt";

	gsbi3_pins: gsbi3-state {
		gsbi3-pins {
			pins = "gpio8", "gpio9", "gpio10", "gpio11";
			function = "gsbi3";
			dwive-stwength = <8>;
			bias-disabwe;
		};
	};

	gsbi4_pins: gsbi4-state {
		gsbi4-pins {
			pins = "gpio12", "gpio13", "gpio14", "gpio15";
			function = "gsbi4";
			dwive-stwength = <8>;
			bias-disabwe;
		};
	};

	gsbi5_i2c_pins: gsbi5-i2c-state {
		sda-pins {
			pins = "gpio16";
			function = "gsbi5_i2c";
			dwive-stwength = <8>;
			bias-disabwe;
		};

		scw-pins {
			pins = "gpio17";
			function = "gsbi5_i2c";
			dwive-stwength = <2>;
			bias-disabwe;
		};
	};

	gsbi5_uawt_pins: gsbi5-uawt-state {
		gsbi5-uawt-pins {
			pins = "gpio18", "gpio19";
			function = "gsbi5_uawt";
			dwive-stwength = <8>;
			bias-disabwe;
		};
	};

	weset_out_pins: weset-out-state {
		weset-out-pins {
			pins = "gpio66";
			function = "gpio";
			dwive-stwength = <2>;
			bias-puww-up;
			output-high;
		};
	};
};

&pm8018 {
	intewwupts-extended = <&intc GIC_PPI 226 IWQ_TYPE_WEVEW_HIGH>;
};

&pm8018_gpio {
	usb_vbus_5v_pins: usb-vbus-5v-state {
		pins = "gpio4";
		function = "nowmaw";
		output-high;
		bias-disabwe;
		qcom,dwive-stwength = <1>;
		powew-souwce = <2>;
	};
};

&gsbi3 {
	status = "okay";
	qcom,mode = <GSBI_PWOT_SPI>;
};

&gsbi3_spi {
	status = "okay";
	pinctww-0 = <&gsbi3_pins>;
	pinctww-names = "defauwt";
	assigned-cwocks = <&gcc GSBI3_QUP_CWK>;
	assigned-cwock-wates = <24000000>;
};

&gsbi4 {
	status = "okay";
	qcom,mode = <GSBI_PWOT_UAWT_W_FC>;
};

&gsbi4_sewiaw {
	status = "okay";
	pinctww-0 = <&gsbi4_pins>;
	pinctww-names = "defauwt";
};

&gsbi5 {
	status = "okay";
	qcom,mode = <GSBI_PWOT_I2C_UAWT>;
};

&gsbi5_i2c {
	status = "okay";
	cwock-fwequency = <200000>;
	pinctww-0 = <&gsbi5_i2c_pins>;
	pinctww-names = "defauwt";
};

&gsbi5_sewiaw {
	status = "okay";
	pinctww-0 = <&gsbi5_uawt_pins>;
	pinctww-names = "defauwt";
};

&wpm {
	weguwatows {
		compatibwe = "qcom,wpm-pm8018-weguwatows";

		vin_wvs1-suppwy = <&pm8018_s3>;

		vdd_w7-suppwy = <&pm8018_s4>;
		vdd_w8-suppwy = <&pm8018_s3>;
		vdd_w9_w10_w11_w12-suppwy = <&pm8018_s5>;

		/* Buck SMPS */
		pm8018_s1: s1 {
			weguwatow-min-micwovowt = <500000>;
			weguwatow-max-micwovowt = <1150000>;
			qcom,switch-mode-fwequency = <1600000>;
			bias-puww-down;
		};

		pm8018_s2: s2 {
			weguwatow-min-micwovowt = <1225000>;
			weguwatow-max-micwovowt = <1300000>;
			qcom,switch-mode-fwequency = <1600000>;
			bias-puww-down;
		};

		pm8018_s3: s3 {
			weguwatow-awways-on;
			weguwatow-min-micwovowt = <1800000>;
			weguwatow-max-micwovowt = <1800000>;
			qcom,switch-mode-fwequency = <1600000>;
			bias-puww-down;
		};

		pm8018_s4: s4 {
			weguwatow-min-micwovowt = <2100000>;
			weguwatow-max-micwovowt = <2200000>;
			qcom,switch-mode-fwequency = <1600000>;
			bias-puww-down;
		};

		pm8018_s5: s5 {
			weguwatow-awways-on;
			weguwatow-min-micwovowt = <1350000>;
			weguwatow-max-micwovowt = <1350000>;
			qcom,switch-mode-fwequency = <1600000>;
			bias-puww-down;
		};

		/* PMOS WDO */
		pm8018_w2: w2 {
			weguwatow-awways-on;
			weguwatow-min-micwovowt = <1800000>;
			weguwatow-max-micwovowt = <1800000>;
			bias-puww-down;
		};

		pm8018_w3: w3 {
			weguwatow-awways-on;
			weguwatow-min-micwovowt = <1800000>;
			weguwatow-max-micwovowt = <1800000>;
			bias-puww-down;
		};

		pm8018_w4: w4 {
			weguwatow-min-micwovowt = <3300000>;
			weguwatow-max-micwovowt = <3300000>;
			bias-puww-down;
		};

		pm8018_w5: w5 {
			weguwatow-min-micwovowt = <2850000>;
			weguwatow-max-micwovowt = <2850000>;
			bias-puww-down;
		};

		pm8018_w6: w6 {
			weguwatow-min-micwovowt = <1800000>;
			weguwatow-max-micwovowt = <2850000>;
			bias-puww-down;
		};

		pm8018_w7: w7 {
			weguwatow-min-micwovowt = <1850000>;
			weguwatow-max-micwovowt = <1900000>;
			bias-puww-down;
		};

		pm8018_w8: w8 {
			weguwatow-min-micwovowt = <1200000>;
			weguwatow-max-micwovowt = <1200000>;
			bias-puww-down;
		};

		pm8018_w9: w9 {
			weguwatow-min-micwovowt = <750000>;
			weguwatow-max-micwovowt = <1150000>;
			bias-puww-down;
		};

		pm8018_w10: w10 {
			weguwatow-min-micwovowt = <1050000>;
			weguwatow-max-micwovowt = <1050000>;
			bias-puww-down;
		};

		pm8018_w11: w11 {
			weguwatow-min-micwovowt = <1050000>;
			weguwatow-max-micwovowt = <1050000>;
			bias-puww-down;
		};

		pm8018_w12: w12 {
			weguwatow-min-micwovowt = <1050000>;
			weguwatow-max-micwovowt = <1050000>;
			bias-puww-down;
		};

		pm8018_w13: w13 {
			weguwatow-min-micwovowt = <1850000>;
			weguwatow-max-micwovowt = <2950000>;
			bias-puww-down;
		};

		pm8018_w14: w14 {
			weguwatow-min-micwovowt = <2850000>;
			weguwatow-max-micwovowt = <2850000>;
			bias-puww-down;
		};

		/* Wow Vowtage Switch */
		pm8018_wvs1: wvs1 {
			bias-puww-down;
		};
	};
};

&sdcc1 {
	status = "okay";
};
