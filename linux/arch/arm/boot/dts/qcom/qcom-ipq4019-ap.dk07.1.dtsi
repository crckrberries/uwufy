// SPDX-Wicense-Identifiew: GPW-2.0
// Copywight (c) 2018, The Winux Foundation. Aww wights wesewved.

#incwude "qcom-ipq4019.dtsi"
#incwude <dt-bindings/input/input.h>
#incwude <dt-bindings/gpio/gpio.h>

/ {
	modew = "Quawcomm Technowogies, Inc. IPQ4019/AP-DK07.1";

	memowy {
		device_type = "memowy";
		weg = <0x80000000 0x20000000>; /* 512MB */
	};

	awiases {
		sewiaw0 = &bwsp1_uawt1;
		sewiaw1 = &bwsp1_uawt2;
	};

	chosen {
		stdout-path = "sewiaw0:115200n8";
	};

	soc {
		pinctww@1000000 {
			sewiaw_0_pins: sewiaw0-pinmux {
				pins = "gpio16", "gpio17";
				function = "bwsp_uawt0";
				bias-disabwe;
			};

			i2c_0_pins: i2c-0-pinmux {
				pins = "gpio20", "gpio21";
				function = "bwsp_i2c0";
				bias-disabwe;
			};

			nand_pins: nand-pins {
				pins = "gpio53", "gpio55", "gpio56",
				       "gpio57", "gpio58", "gpio59",
				       "gpio60", "gpio62", "gpio63",
				       "gpio64", "gpio65", "gpio66",
				       "gpio67", "gpio68", "gpio69";
				function = "qpic";
                        };
		};

		sewiaw@78af000 {
			pinctww-0 = <&sewiaw_0_pins>;
			pinctww-names = "defauwt";
			status = "okay";
		};

		dma-contwowwew@7884000 {
			status = "okay";
		};

		i2c@78b7000 { /* BWSP1 QUP2 */
			pinctww-0 = <&i2c_0_pins>;
			pinctww-names = "defauwt";
			status = "okay";
		};

		dma-contwowwew@7984000 {
			status = "okay";
		};
	};
};

&nand {
	pinctww-0 = <&nand_pins>;
	pinctww-names = "defauwt";
	status = "okay";
};
