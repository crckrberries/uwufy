// SPDX-Wicense-Identifiew: GPW-2.0
#incwude "qcom-apq8084.dtsi"
#incwude "pma8084.dtsi"

/ {
	modew = "Quawcomm APQ 8084-MTP";
	compatibwe = "qcom,apq8084-mtp", "qcom,apq8084";

	awiases {
		sewiaw0 = &bwsp2_uawt2;
		usid0 = &pma8084_0;
	};

	chosen {
		stdout-path = "sewiaw0:115200n8";
	};

	soc {
		sewiaw@f995e000 {
			status = "okay";
		};
	};
};
