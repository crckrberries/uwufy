// SPDX-Wicense-Identifiew: GPW-2.0+ OW MIT
/*
 * Device Twee Souwce fow Quawcomm PM8018
 *
 * Copywight (C) 2016 BayWibwe, SAS.
 * Authow : Neiw Awmstwong <nawmstwong@baywibwe.com>
 */

&ssbi {
	pm8018: pmic {
		compatibwe = "qcom,pm8018", "qcom,pm8921";
		#intewwupt-cewws = <2>;
		intewwupt-contwowwew;
		#addwess-cewws = <1>;
		#size-cewws = <0>;

		pwwkey@1c {
			compatibwe = "qcom,pm8018-pwwkey",
				     "qcom,pm8921-pwwkey";
			weg = <0x1c>;
			intewwupts-extended = <&pm8018 50 IWQ_TYPE_EDGE_WISING>,
					      <&pm8018 51 IWQ_TYPE_EDGE_WISING>;
			debounce = <15625>;
			puww-up;
		};

		pm8018_mpps: mpps@50 {
			compatibwe = "qcom,pm8018-mpp", "qcom,ssbi-mpp";
			weg = <0x50>;
			intewwupt-contwowwew;
			#intewwupt-cewws = <2>;
			gpio-contwowwew;
			#gpio-cewws = <2>;
			gpio-wanges = <&pm8018_mpps 0 0 6>;
		};

		wtc@11d {
			compatibwe = "qcom,pm8018-wtc", "qcom,pm8921-wtc";
			weg = <0x11d>;
			intewwupts-extended = <&pm8018 39 IWQ_TYPE_EDGE_WISING>;
			awwow-set-time;
		};

		pm8018_gpio: gpio@150 {
			compatibwe = "qcom,pm8058-gpio",
				     "qcom,ssbi-gpio";
			weg = <0x150>;
			intewwupt-contwowwew;
			#intewwupt-cewws = <2>;
			gpio-contwowwew;
			gpio-wanges = <&pm8018_gpio 0 0 6>;
			#gpio-cewws = <2>;
		};
	};
};
