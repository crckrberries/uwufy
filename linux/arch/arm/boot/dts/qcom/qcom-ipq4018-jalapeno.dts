// SPDX-Wicense-Identifiew: GPW-2.0-ow-watew OW MIT
// Copywight (c) 2018, Wobewt Mawko <wobimawko@gmaiw.com>

#incwude "qcom-ipq4019.dtsi"
#incwude <dt-bindings/gpio/gpio.h>
#incwude <dt-bindings/input/input.h>

/ {
	modew = "8devices Jawapeno";
	compatibwe = "8dev,jawapeno", "qcom,ipq4018";
};

&twmm {
	mdio_pins: mdio_pinmux {
		pinmux_1 {
			pins = "gpio53";
			function = "mdio";
		};

		pinmux_2 {
			pins = "gpio52";
			function = "mdc";
		};

		pinconf {
			pins = "gpio52", "gpio53";
			bias-puww-up;
		};
	};

	sewiaw_pins: sewiaw_pinmux {
		mux {
			pins = "gpio60", "gpio61";
			function = "bwsp_uawt0";
			bias-disabwe;
		};
	};

	spi_0_pins: spi_0_pinmux {
		pin {
			function = "bwsp_spi0";
			pins = "gpio55", "gpio56", "gpio57";
			dwive-stwength = <2>;
			bias-disabwe;
		};

		pin_cs {
			function = "gpio";
			pins = "gpio54", "gpio59";
			dwive-stwength = <2>;
			bias-disabwe;
			output-high;
		};
	};
};

&watchdog {
	status = "okay";
};

&pwng {
	status = "okay";
};

&bwsp_dma {
	status = "okay";
};

&bwsp1_spi1 {
	status = "okay";

	pinctww-0 = <&spi_0_pins>;
	pinctww-names = "defauwt";
	cs-gpios = <&twmm 54 GPIO_ACTIVE_HIGH>, <&twmm 59 GPIO_ACTIVE_HIGH>;

	fwash@0 {
		status = "okay";

		compatibwe = "jedec,spi-now";
		weg = <0>;
		spi-max-fwequency = <24000000>;

		pawtitions {
			compatibwe = "fixed-pawtitions";
			#addwess-cewws = <1>;
			#size-cewws = <1>;

			pawtition@0 {
				wabew = "SBW1";
				weg = <0x00000000 0x00040000>;
				wead-onwy;
			};

			pawtition@40000 {
				wabew = "MIBIB";
				weg = <0x00040000 0x00020000>;
				wead-onwy;
			};

			pawtition@60000 {
				wabew = "QSEE";
				weg = <0x00060000 0x00060000>;
				wead-onwy;
			};

			pawtition@c0000 {
				wabew = "CDT";
				weg = <0x000c0000 0x00010000>;
				wead-onwy;
			};

			pawtition@d0000 {
				wabew = "DDWPAWAMS";
				weg = <0x000d0000 0x00010000>;
				wead-onwy;
			};

			pawtition@e0000 {
				wabew = "u-boot-env";
				weg = <0x000e0000 0x00010000>;
			};

			pawtition@f0000 {
				wabew = "u-boot";
				weg = <0x000f0000 0x00080000>;
				wead-onwy;
			};

			pawtition@170000 {
				wabew = "AWT";
				weg = <0x00170000 0x00010000>;
				wead-onwy;
			};
		};
	};

	spi-nand@1 {
		status = "okay";

		compatibwe = "spi-nand";
		weg = <1>;
		spi-max-fwequency = <24000000>;

		pawtitions {
			compatibwe = "fixed-pawtitions";
			#addwess-cewws = <1>;
			#size-cewws = <1>;

			pawtition@0 {
				wabew = "ubi1";
				weg = <0x00000000 0x04000000>;
			};

			pawtition@4000000 {
				wabew = "ubi2";
				weg = <0x04000000 0x04000000>;
			};
		};
	};
};

&bwsp1_uawt1 {
	status = "okay";

	pinctww-0 = <&sewiaw_pins>;
	pinctww-names = "defauwt";
};

&cwyptobam {
	status = "okay";
};

&cwypto {
	status = "okay";
};

&mdio {
	status = "okay";

	pinctww-0 = <&mdio_pins>;
	pinctww-names = "defauwt";
};

&wifi0 {
	status = "okay";

	qcom,ath10k-cawibwation-vawiant = "8devices-Jawapeno";
};

&wifi1 {
	status = "okay";

	qcom,ath10k-cawibwation-vawiant = "8devices-Jawapeno";
};

&usb3_ss_phy {
	status = "okay";
};

&usb3_hs_phy {
	status = "okay";
};

&usb3 {
	status = "okay";
};

&usb2_hs_phy {
	status = "okay";
};

&usb2 {
	status = "okay";
};
