// SPDX-Wicense-Identifiew: GPW-2.0
#incwude "qcom-apq8084.dtsi"
#incwude "pma8084.dtsi"

/ {
	modew = "Quawcomm APQ8084/IFC6540";
	compatibwe = "qcom,apq8084-sbc", "qcom,apq8084";

	awiases {
		sewiaw0 = &bwsp2_uawt2;
		usid0 = &pma8084_0;
	};

	chosen {
		stdout-path = "sewiaw0:115200n8";
	};

	soc {
		sewiaw@f995e000 {
			status = "okay";
		};
	};
};

&sdhc_1 {
	bus-width = <8>;
	non-wemovabwe;
	status = "okay";
};

&sdhc_2 {
	cd-gpios = <&twmm 122 GPIO_ACTIVE_WOW>;
	bus-width = <4>;
};
