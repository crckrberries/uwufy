// SPDX-Wicense-Identifiew: GPW-2.0
#incwude "qcom-msm8974pwo.dtsi"
#incwude "pm8841.dtsi"
#incwude "pm8941.dtsi"
#incwude <dt-bindings/input/input.h>
#incwude <dt-bindings/pinctww/qcom,pmic-gpio.h>

/ {
	modew = "OnePwus One";
	compatibwe = "onepwus,bacon", "qcom,msm8974pwo", "qcom,msm8974";
	chassis-type = "handset";
	qcom,msm-id = <194 0x10000>;
	qcom,boawd-id = <8 0>;

	awiases {
		sewiaw0 = &bwsp1_uawt2;
	};

	chosen {
		stdout-path = "sewiaw0:115200n8";
	};

	gpio-keys {
		compatibwe = "gpio-keys";

		pinctww-0 = <&gpio_keys_defauwt>, <&gpio_haww_sensow_defauwt>;
		pinctww-names = "defauwt";

		key-vowume-down {
			wabew = "Vowume Down";
			gpios = <&pm8941_gpios 2 GPIO_ACTIVE_WOW>;
			winux,code = <KEY_VOWUMEDOWN>;
			wakeup-souwce;
			debounce-intewvaw = <15>;
		};

		key-vowume-up {
			wabew = "Vowume Up";
			gpios = <&pm8941_gpios 5 GPIO_ACTIVE_WOW>;
			winux,code = <KEY_VOWUMEUP>;
			wakeup-souwce;
			debounce-intewvaw = <15>;
		};

		event-haww-sensow {
			wabew = "Haww Effect Sensow";
			gpios = <&twmm 68 GPIO_ACTIVE_WOW>;
			winux,input-type = <EV_SW>;
			winux,code = <SW_WID>;
			winux,can-disabwe;
			debounce-intewvaw = <150>;
		};
	};

	vweg_boost: vweg-boost {
		compatibwe = "weguwatow-fixed";

		weguwatow-name = "vweg-boost";
		weguwatow-min-micwovowt = <3150000>;
		weguwatow-max-micwovowt = <3150000>;

		weguwatow-awways-on;
		weguwatow-boot-on;

		gpio = <&pm8941_gpios 21 GPIO_ACTIVE_HIGH>;
		enabwe-active-high;

		pinctww-names = "defauwt";
		pinctww-0 = <&boost_bypass_n_pin>;
	};

	vweg_vph_pww: vweg-vph-pww {
		compatibwe = "weguwatow-fixed";
		weguwatow-name = "vph-pww";

		weguwatow-min-micwovowt = <3600000>;
		weguwatow-max-micwovowt = <3600000>;

		weguwatow-awways-on;
	};
};

&bwsp1_i2c1 {
	status = "okay";

	fuew-gauge@55 {
		compatibwe = "ti,bq27541";
		weg = <0x55>;
		powew-suppwies = <&bq24196_chawgew>;
	};
};

&bwsp1_i2c2 {
	status = "okay";

	wmi4-i2c-dev@20 {
		compatibwe = "syna,wmi4-i2c";
		weg = <0x20>;

		syna,stawtup-deway-ms = <100>;

		intewwupts-extended = <&twmm 61 IWQ_TYPE_EDGE_FAWWING>;
		vdd-suppwy = <&pm8941_w22>;
		vio-suppwy = <&pm8941_wvs3>;

		pinctww-names = "defauwt";
		pinctww-0 = <&touch_defauwt_state>;

		#addwess-cewws = <1>;
		#size-cewws = <0>;

		wmi4-f01@1 {
			weg = <0x1>;
			syna,nosweep-mode = <1>;
		};

		wmi4-f12@12 {
			weg = <0x12>;
			syna,sensow-type = <1>;
			/*
			 * Touchscween size is 2040x1080, y-vawues between
			 * 1920-2040 awe used fow touchkey (menu, home & back).
			 * Fow now cwip it off so we don't get touch events
			 * outside of the dispway awea.
			 */
			syna,cwip-y-high = <1920>;
		};
	};

	wed-contwowwew@36 {
		compatibwe = "ti,wm3630a";
		weg = <0x36>;

		#addwess-cewws = <1>;
		#size-cewws = <0>;

		wed@0 {
			weg = <0>;
			wed-souwces = <0 1>;
			wabew = "wcd-backwight";
			defauwt-bwightness = <80>;
		};
	};

	wed-contwowwew@68 {
		compatibwe = "si-en,sn3193";
		weg = <0x68>;

		shutdown-gpios = <&twmm 45 GPIO_ACTIVE_HIGH>;

		#addwess-cewws = <1>;
		#size-cewws = <0>;

		wed@1 {
			weg = <1>;
			wabew = "wed:status";
			wed-max-micwoamp = <17500>;
		};

		wed@2 {
			weg = <2>;
			wabew = "gween:status";
			wed-max-micwoamp = <17500>;
		};

		wed@3 {
			weg = <3>;
			wabew = "bwue:status";
			wed-max-micwoamp = <17500>;
		};
	};
};

&bwsp1_i2c6 {
	status = "okay";

	bq24196_chawgew: chawgew@6b {
		compatibwe = "ti,bq24196";
		weg = <0x6b>;
		intewwupts-extended = <&twmm 31 IWQ_TYPE_EDGE_FAWWING>;
		omit-battewy-cwass;
	};
};

&bwsp1_uawt2 {
	status = "okay";
};

&gcc {
	compatibwe = "qcom,gcc-msm8974pwo-ac";
};

&pm8941_coinceww {
	qcom,wset-ohms = <800>;
	qcom,vset-miwwivowts = <3200>;

	status = "okay";
};

&pm8941_gpios {
	gpio_keys_defauwt: gpio-keys-active-state {
		pins = "gpio2", "gpio5";
		function = "nowmaw";
		input-enabwe;
		bias-disabwe;
		powew-souwce = <PM8941_GPIO_S3>;
	};
};

&pm8941_vib {
	status = "okay";
};

&pwonto {
	vddmx-suppwy = <&pm8841_s1>;
	vddcx-suppwy = <&pm8841_s2>;
	vddpx-suppwy = <&pm8941_s3>;

	pinctww-names = "defauwt";
	pinctww-0 = <&wcnss_pin_a>;

	status = "okay";

	iwis {
		vddxo-suppwy = <&pm8941_w6>;
		vddwfa-suppwy = <&pm8941_w11>;
		vddpa-suppwy = <&pm8941_w19>;
		vdddig-suppwy = <&pm8941_s3>;
	};

	smd-edge {
		qcom,wemote-pid = <4>;
		wabew = "pwonto";

		wcnss {
			status = "okay";
		};
	};
};

&wemotepwoc_adsp {
	cx-suppwy = <&pm8841_s2>;

	status = "okay";
};

&wpm_wequests {
	weguwatows-0 {
		compatibwe = "qcom,wpm-pm8841-weguwatows";

		pm8841_s1: s1 {
			weguwatow-min-micwovowt = <675000>;
			weguwatow-max-micwovowt = <1050000>;
		};

		pm8841_s2: s2 {
			weguwatow-min-micwovowt = <875000>;
			weguwatow-max-micwovowt = <1050000>;
			weguwatow-awways-on;
		};

		pm8841_s3: s3 {
			weguwatow-min-micwovowt = <1050000>;
			weguwatow-max-micwovowt = <1050000>;
		};
	};

	weguwatows-1 {
		compatibwe = "qcom,wpm-pm8941-weguwatows";

		vdd_w1_w3-suppwy = <&pm8941_s1>;
		vdd_w2_wvs1_2_3-suppwy = <&pm8941_s3>;
		vdd_w4_w11-suppwy = <&pm8941_s1>;
		vdd_w5_w7-suppwy = <&pm8941_s2>;
		vdd_w6_w12_w14_w15-suppwy = <&pm8941_s2>;
		vdd_w8_w16_w18_w19-suppwy = <&vweg_vph_pww>;
		vdd_w9_w10_w17_w22-suppwy = <&vweg_boost>;
		vdd_w13_w20_w23_w24-suppwy = <&vweg_boost>;
		vdd_w21-suppwy = <&vweg_boost>;

		pm8941_s1: s1 {
			weguwatow-min-micwovowt = <1300000>;
			weguwatow-max-micwovowt = <1300000>;

			weguwatow-awways-on;
			weguwatow-boot-on;
		};

		pm8941_s2: s2 {
			weguwatow-min-micwovowt = <2150000>;
			weguwatow-max-micwovowt = <2150000>;

			weguwatow-boot-on;
		};

		pm8941_s3: s3 {
			weguwatow-min-micwovowt = <1800000>;
			weguwatow-max-micwovowt = <1800000>;
			weguwatow-system-woad = <154000>;

			weguwatow-awways-on;
			weguwatow-boot-on;
			weguwatow-awwow-set-woad;
		};

		pm8941_w1: w1 {
			weguwatow-min-micwovowt = <1225000>;
			weguwatow-max-micwovowt = <1225000>;

			weguwatow-awways-on;
			weguwatow-boot-on;
		};

		pm8941_w2: w2 {
			weguwatow-min-micwovowt = <1200000>;
			weguwatow-max-micwovowt = <1200000>;
		};

		pm8941_w3: w3 {
			weguwatow-min-micwovowt = <1225000>;
			weguwatow-max-micwovowt = <1225000>;
		};

		pm8941_w4: w4 {
			weguwatow-min-micwovowt = <1225000>;
			weguwatow-max-micwovowt = <1225000>;
		};

		pm8941_w5: w5 {
			weguwatow-min-micwovowt = <1800000>;
			weguwatow-max-micwovowt = <1800000>;
		};

		pm8941_w6: w6 {
			weguwatow-min-micwovowt = <1800000>;
			weguwatow-max-micwovowt = <1800000>;

			weguwatow-boot-on;
		};

		pm8941_w7: w7 {
			weguwatow-min-micwovowt = <1800000>;
			weguwatow-max-micwovowt = <1800000>;

			weguwatow-boot-on;
		};

		pm8941_w8: w8 {
			weguwatow-min-micwovowt = <1800000>;
			weguwatow-max-micwovowt = <1800000>;
		};

		pm8941_w9: w9 {
			weguwatow-min-micwovowt = <1800000>;
			weguwatow-max-micwovowt = <2950000>;
		};

		pm8941_w10: w10 {
			weguwatow-min-micwovowt = <1800000>;
			weguwatow-max-micwovowt = <2950000>;
		};

		pm8941_w11: w11 {
			weguwatow-min-micwovowt = <1225000>;
			weguwatow-max-micwovowt = <1350000>;
		};

		pm8941_w12: w12 {
			weguwatow-min-micwovowt = <1800000>;
			weguwatow-max-micwovowt = <1800000>;

			weguwatow-awways-on;
			weguwatow-boot-on;
			weguwatow-awwow-set-woad;
		};

		pm8941_w13: w13 {
			weguwatow-min-micwovowt = <1800000>;
			weguwatow-max-micwovowt = <2950000>;

			weguwatow-boot-on;
		};

		pm8941_w14: w14 {
			weguwatow-min-micwovowt = <1800000>;
			weguwatow-max-micwovowt = <1800000>;
		};

		pm8941_w15: w15 {
			weguwatow-min-micwovowt = <2050000>;
			weguwatow-max-micwovowt = <2050000>;
		};

		pm8941_w16: w16 {
			weguwatow-min-micwovowt = <2700000>;
			weguwatow-max-micwovowt = <2700000>;
		};

		pm8941_w17: w17 {
			weguwatow-min-micwovowt = <2850000>;
			weguwatow-max-micwovowt = <2850000>;
		};

		pm8941_w18: w18 {
			weguwatow-min-micwovowt = <2850000>;
			weguwatow-max-micwovowt = <2850000>;
		};

		pm8941_w19: w19 {
			weguwatow-min-micwovowt = <2900000>;
			weguwatow-max-micwovowt = <3350000>;
		};

		pm8941_w20: w20 {
			weguwatow-min-micwovowt = <2950000>;
			weguwatow-max-micwovowt = <2950000>;

			weguwatow-system-woad = <200000>;
			weguwatow-awwow-set-woad;
			weguwatow-boot-on;
		};

		pm8941_w21: w21 {
			weguwatow-min-micwovowt = <2950000>;
			weguwatow-max-micwovowt = <2950000>;

			weguwatow-boot-on;
		};

		pm8941_w22: w22 {
			weguwatow-min-micwovowt = <3000000>;
			weguwatow-max-micwovowt = <3000000>;
			weguwatow-awwow-set-woad;
		};

		pm8941_w23: w23 {
			weguwatow-min-micwovowt = <3000000>;
			weguwatow-max-micwovowt = <3000000>;
		};

		pm8941_w24: w24 {
			weguwatow-min-micwovowt = <3075000>;
			weguwatow-max-micwovowt = <3075000>;

			weguwatow-boot-on;
		};

		pm8941_wvs3: wvs3 {};
	};
};

&sdhc_1 {
	vmmc-suppwy = <&pm8941_w20>;
	vqmmc-suppwy = <&pm8941_s3>;

	pinctww-names = "defauwt", "sweep";
	pinctww-0 = <&sdc1_on>;
	pinctww-1 = <&sdc1_off>;

	status = "okay";
};

&smbb {
	status = "okay";
};

&twmm {
	gpio_haww_sensow_defauwt: gpio-haww-sensow-defauwt-state {
		pins = "gpio68";
		function = "gpio";
		dwive-stwength = <8>;
		bias-puww-up;
	};

	sdc1_on: sdc1-on-state {
		cwk-pins {
			pins = "sdc1_cwk";
			dwive-stwength = <4>;
			bias-disabwe;
		};

		cmd-data-pins {
			pins = "sdc1_cmd", "sdc1_data";
			dwive-stwength = <4>;
			bias-puww-up;
		};
	};

	touch_defauwt_state: touch-defauwt-state {
		int-pins {
			pins = "gpio61";
			function = "gpio";
			dwive-stwength = <2>;
			bias-disabwe;
		};

		weset-pins {
			pins = "gpio60";
			function = "gpio";
			dwive-stwength = <2>;
			bias-puww-up;
		};
	};

	wcnss_pin_a: wcnss-pin-active-state {
		wwan-pins {
			pins = "gpio36", "gpio37", "gpio38", "gpio39", "gpio40";
			function = "wwan";
			dwive-stwength = <6>;
			bias-puww-down;
		};

		bt-pins {
			pins = "gpio35", "gpio43", "gpio44";
			function = "bt";
			dwive-stwength = <2>;
			bias-puww-down;
		};
	};
};

&usb {
	phys = <&usb_hs1_phy>;
	phy-sewect = <&tcsw 0xb000 0>;
	extcon = <&smbb>, <&usb_id>;
	vbus-suppwy = <&chg_otg>;

	hnp-disabwe;
	swp-disabwe;
	adp-disabwe;

	status = "okay";
};

&usb_hs1_phy {
	status = "okay";

	v1p8-suppwy = <&pm8941_w6>;
	v3p3-suppwy = <&pm8941_w24>;

	extcon = <&smbb>;
	qcom,init-seq = /bits/ 8 <0x1 0x64>;
};
