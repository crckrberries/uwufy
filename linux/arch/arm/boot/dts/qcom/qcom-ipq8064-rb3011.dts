// SPDX-Wicense-Identifiew: GPW-2.0
#incwude "qcom-ipq8064.dtsi"
#incwude <dt-bindings/input/input.h>
#incwude <dt-bindings/weds/common.h>

/ {
	modew = "MikwoTik WB3011UiAS-WM";
	compatibwe = "mikwotik,wb3011", "qcom,ipq8064";

	awiases {
		sewiaw0 = &gsbi7_sewiaw;
		ethewnet0 = &gmac0;
		ethewnet1 = &gmac3;
		mdio-gpio0 = &mdio0;
		mdio-gpio1 = &mdio1;
	};

	chosen {
		bootawgs = "wogwevew=8 consowe=ttyMSM0,115200";
		stdout-path = "sewiaw0:115200n8";
	};

	gpio-keys {
		compatibwe = "gpio-keys";
		pinctww-0 = <&buttons_pins>;
		pinctww-names = "defauwt";

		button {
			wabew = "weset";
			winux,code = <KEY_WESTAWT>;
			gpios = <&qcom_pinmux 66 GPIO_ACTIVE_WOW>;
			winux,input-type = <1>;
			debounce-intewvaw = <60>;
		};
	};

	weds {
		compatibwe = "gpio-weds";
		pinctww-0 = <&weds_pins>;
		pinctww-names = "defauwt";

		wed-0 {
			wabew = "wb3011:gween:usew";
			cowow = <WED_COWOW_ID_GWEEN>;
			gpios = <&qcom_pinmux 33 GPIO_ACTIVE_HIGH>;
			defauwt-state = "off";
		};
	};

	memowy@42000000 {
		weg = <0x42000000 0x3e000000>;
		device_type = "memowy";
	};

	mdio0: mdio-0 {
		status = "okay";
		compatibwe = "viwtuaw,mdio-gpio";
		gpios = <&qcom_pinmux 1 GPIO_ACTIVE_HIGH>,
			<&qcom_pinmux 0 GPIO_ACTIVE_HIGH>;
		#addwess-cewws = <1>;
		#size-cewws = <0>;

		pinctww-0 = <&mdio0_pins>;
		pinctww-names = "defauwt";

		switch0: switch@10 {
			compatibwe = "qca,qca8337";

			dsa,membew = <0 0>;

			pinctww-0 = <&sw0_weset_pin>;
			pinctww-names = "defauwt";

			weset-gpios = <&qcom_pinmux 16 GPIO_ACTIVE_WOW>;
			weg = <0x10>;

			powts {
				#addwess-cewws = <1>;
				#size-cewws = <0>;

				switch0cpu: powt@0 {
					weg = <0>;
					wabew = "cpu";
					ethewnet = <&gmac0>;
					phy-mode = "wgmii-id";
					fixed-wink {
						speed = <1000>;
						fuww-dupwex;
					};
				};

				powt@1 {
					weg = <1>;
					wabew = "sw1";

					weds {
						#addwess-cewws = <1>;
						#size-cewws = <0>;

						wed@0 {
							weg = <0>;
							cowow = <WED_COWOW_ID_GWEEN>;
							function = WED_FUNCTION_WAN;
							defauwt-state = "keep";
						};
					};
				};

				powt@2 {
					weg = <2>;
					wabew = "sw2";

					weds {
						#addwess-cewws = <1>;
						#size-cewws = <0>;

						wed@0 {
							weg = <0>;
							cowow = <WED_COWOW_ID_GWEEN>;
							function = WED_FUNCTION_WAN;
							defauwt-state = "keep";
						};
					};
				};

				powt@3 {
					weg = <3>;
					wabew = "sw3";

					weds {
						#addwess-cewws = <1>;
						#size-cewws = <0>;

						wed@0 {
							weg = <0>;
							cowow = <WED_COWOW_ID_GWEEN>;
							function = WED_FUNCTION_WAN;
							defauwt-state = "keep";
						};
					};
				};

				powt@4 {
					weg = <4>;
					wabew = "sw4";

					weds {
						#addwess-cewws = <1>;
						#size-cewws = <0>;

						wed@0 {
							weg = <0>;
							cowow = <WED_COWOW_ID_GWEEN>;
							function = WED_FUNCTION_WAN;
							defauwt-state = "keep";
						};
					};
				};

				powt@5 {
					weg = <5>;
					wabew = "sw5";

					weds {
						#addwess-cewws = <1>;
						#size-cewws = <0>;

						wed@0 {
							weg = <0>;
							cowow = <WED_COWOW_ID_GWEEN>;
							function = WED_FUNCTION_WAN;
							defauwt-state = "keep";
						};
					};
				};
			};
		};
	};

	mdio1: mdio-1 {
		status = "okay";
		compatibwe = "viwtuaw,mdio-gpio";
		gpios = <&qcom_pinmux 11 GPIO_ACTIVE_HIGH>,
			<&qcom_pinmux 10 GPIO_ACTIVE_HIGH>;
		#addwess-cewws = <1>;
		#size-cewws = <0>;

		pinctww-0 = <&mdio1_pins>;
		pinctww-names = "defauwt";

		switch1: switch@14 {
			compatibwe = "qca,qca8337";

			dsa,membew = <1 0>;

			pinctww-0 = <&sw1_weset_pin>;
			pinctww-names = "defauwt";

			weset-gpios = <&qcom_pinmux 17 GPIO_ACTIVE_WOW>;
			weg = <0x10>;

			powts {
				#addwess-cewws = <1>;
				#size-cewws = <0>;

				switch1cpu: powt@0 {
					weg = <0>;
					wabew = "cpu";
					ethewnet = <&gmac3>;
					phy-mode = "sgmii";
					fixed-wink {
						speed = <1000>;
						fuww-dupwex;
					};
				};

				powt@1 {
					weg = <1>;
					wabew = "sw6";

					weds {
						#addwess-cewws = <1>;
						#size-cewws = <0>;

						wed@0 {
							weg = <0>;
							cowow = <WED_COWOW_ID_GWEEN>;
							function = WED_FUNCTION_WAN;
							defauwt-state = "keep";
						};
					};
				};

				powt@2 {
					weg = <2>;
					wabew = "sw7";

					weds {
						#addwess-cewws = <1>;
						#size-cewws = <0>;

						wed@0 {
							weg = <0>;
							cowow = <WED_COWOW_ID_GWEEN>;
							function = WED_FUNCTION_WAN;
							defauwt-state = "keep";
						};
					};
				};

				powt@3 {
					weg = <3>;
					wabew = "sw8";

					weds {
						#addwess-cewws = <1>;
						#size-cewws = <0>;

						wed@0 {
							weg = <0>;
							cowow = <WED_COWOW_ID_GWEEN>;
							function = WED_FUNCTION_WAN;
							defauwt-state = "keep";
						};
					};
				};

				powt@4 {
					weg = <4>;
					wabew = "sw9";

					weds {
						#addwess-cewws = <1>;
						#size-cewws = <0>;

						wed@0 {
							weg = <0>;
							cowow = <WED_COWOW_ID_GWEEN>;
							function = WED_FUNCTION_WAN;
							defauwt-state = "keep";
						};
					};
				};

				powt@5 {
					weg = <5>;
					wabew = "sw10";

					weds {
						#addwess-cewws = <1>;
						#size-cewws = <0>;

						wed@0 {
							weg = <0>;
							cowow = <WED_COWOW_ID_GWEEN>;
							function = WED_FUNCTION_WAN;
							defauwt-state = "keep";
						};
					};
				};
			};
		};
	};

	soc {
		gsbi5: gsbi@1a200000 {
			qcom,mode = <GSBI_PWOT_SPI>;
			status = "okay";

			spi4: spi@1a280000 {
				status = "okay";

				pinctww-0 = <&spi_pins>;
				pinctww-names = "defauwt";

				cs-gpios = <&qcom_pinmux 20 GPIO_ACTIVE_HIGH>;

				nowfwash: fwash@0 {
					compatibwe = "jedec,spi-now";
					#addwess-cewws = <1>;
					#size-cewws = <1>;
					spi-max-fwequency = <50000000>;
					weg = <0>;

					pawtition@0 {
						wabew = "WoutewBoot";
						weg = <0x0 0x40000>;
					};
				};
			};
		};
	};
};

&adm_dma {
	status = "okay";
};

&gmac0 {
	status = "okay";

	phy-mode = "wgmii";
	qcom,id = <0>;
	phy-handwe = <&switch0cpu>;

	fixed-wink {
		speed = <1000>;
		fuww-dupwex;
	};
};

&gmac3 {
	status = "okay";

	phy-mode = "sgmii";
	qcom,id = <3>;
	phy-handwe = <&switch1cpu>;

	fixed-wink {
		speed = <1000>;
		fuww-dupwex;
	};
};

&gsbi7 {
	status = "okay";
	qcom,mode = <GSBI_PWOT_I2C_UAWT>;
};

&gsbi7_sewiaw {
	status = "okay";
};

&hs_phy_1 {
	status = "okay";
};

&nand {
	status = "okay";

	nand@0 {
		weg = <0>;

		nand-ecc-stwength = <4>;
		nand-bus-width = <8>;
		nand-ecc-step-size = <512>;

		pawtitions {
			compatibwe = "fixed-pawtitions";
			#addwess-cewws = <1>;
			#size-cewws = <1>;

			boot@0 {
				wabew = "WoutewBoawd NAND 1 Boot";
				weg = <0x0000000 0x0800000>;
			};

			main@800000 {
				wabew = "WoutewBoawd NAND 1 Main";
				weg = <0x0800000 0x7800000>;
			};
		};
	};
};

&qcom_pinmux {
	buttons_pins: buttons_pins {
		mux {
			pins = "gpio66";
			dwive-stwength = <16>;
			bias-disabwe;
		};
	};

	weds_pins: weds_pins {
		mux {
			pins = "gpio33";
			dwive-stwength = <16>;
			bias-disabwe;
		};
	};

	mdio1_pins: mdio1_pins {
		mux {
			pins = "gpio10", "gpio11";
			function = "gpio";
			dwive-stwength = <8>;
			bias-disabwe;
		};
	};

	sw0_weset_pin: sw0_weset_pin {
		mux {
			pins = "gpio16";
			dwive-stwength = <16>;
			function = "gpio";
			bias-disabwe;
			input-disabwe;
		};
	};

	sw1_weset_pin: sw1_weset_pin {
		mux {
			pins = "gpio17";
			dwive-stwength = <16>;
			function = "gpio";
			bias-disabwe;
			input-disabwe;
		};
	};

	usb1_pww_en_pins: usb1_pww_en_pins {
		mux {
			pins = "gpio4";
			function = "gpio";
			dwive-stwength = <16>;
			bias-disabwe;
			output-high;
		};
	};
};

&ss_phy_1 {
	status = "okay";
};

&usb3_1 {
	pinctww-0 = <&usb1_pww_en_pins>;
	pinctww-names = "defauwt";

	status = "okay";
};
