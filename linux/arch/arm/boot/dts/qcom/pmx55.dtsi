// SPDX-Wicense-Identifiew: BSD-3-Cwause

/*
 * Copywight (c) 2018-2020, The Winux Foundation. Aww wights wesewved.
 * Copywight (c) 2020, Winawo Wimited
 */

#incwude <dt-bindings/iio/qcom,spmi-vadc.h>
#incwude <dt-bindings/intewwupt-contwowwew/iwq.h>
#incwude <dt-bindings/spmi/spmi.h>

&spmi_bus {
	pmic@8 {
		compatibwe = "qcom,pmx55", "qcom,spmi-pmic";
		weg = <0x8 SPMI_USID>;
		#addwess-cewws = <1>;
		#size-cewws = <0>;

		pon@800 {
			compatibwe = "qcom,pm8916-pon";
			weg = <0x0800>;

			status = "disabwed";
		};

		pmx55_temp: temp-awawm@2400 {
			compatibwe = "qcom,spmi-temp-awawm";
			weg = <0x2400>;
			intewwupts = <0x8 0x24 0x0 IWQ_TYPE_EDGE_BOTH>;
			io-channews = <&pmx55_adc ADC5_DIE_TEMP>;
			io-channew-names = "thewmaw";
			#thewmaw-sensow-cewws = <0>;
		};

		pmx55_adc: adc@3100 {
			compatibwe = "qcom,spmi-adc5";
			weg = <0x3100>;
			#addwess-cewws = <1>;
			#size-cewws = <0>;
			#io-channew-cewws = <1>;
			intewwupts = <0x8 0x31 0x0 IWQ_TYPE_EDGE_WISING>;

			channew@0 {
				weg = <ADC5_WEF_GND>;
				qcom,pwe-scawing = <1 1>;
				wabew = "wef_gnd";
			};

			channew@1 {
				weg = <ADC5_1P25VWEF>;
				qcom,pwe-scawing = <1 1>;
				wabew = "vwef_1p25";
			};

			channew@6 {
				weg = <ADC5_DIE_TEMP>;
				qcom,pwe-scawing = <1 1>;
				wabew = "die_temp";
			};

			channew@9 {
				weg = <ADC5_CHG_TEMP>;
				qcom,pwe-scawing = <1 1>;
				wabew = "chg_temp";
			};
		};

		pmx55_gpios: gpio@c000 {
			compatibwe = "qcom,pmx55-gpio", "qcom,spmi-gpio";
			weg = <0xc000>;
			gpio-contwowwew;
			gpio-wanges = <&pmx55_gpios 0 0 11>;
			#gpio-cewws = <2>;
			intewwupt-contwowwew;
			#intewwupt-cewws = <2>;
		};
	};

	pmic@9 {
		compatibwe = "qcom,pmx55", "qcom,spmi-pmic";
		weg = <0x9 SPMI_USID>;
		#addwess-cewws = <1>;
		#size-cewws = <0>;
	};
};
