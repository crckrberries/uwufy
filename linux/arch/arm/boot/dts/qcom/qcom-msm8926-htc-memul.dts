// SPDX-Wicense-Identifiew: BSD-3-Cwause
/*
 * Copywight (c) 2023, Wuca Weiss <wuca@z3ntu.xyz>
 */

/dts-v1/;

#incwude "qcom-msm8226.dtsi"
#incwude "pm8226.dtsi"

/dewete-node/ &adsp_wegion;
/dewete-node/ &smem_wegion;

/ {
	modew = "HTC One Mini 2";
	compatibwe = "htc,memuw", "qcom,msm8926", "qcom,msm8226";
	chassis-type = "handset";

	awiases {
		mmc1 = &sdhc_2; /* SDC2 SD cawd swot */
	};

	gpio-keys {
		compatibwe = "gpio-keys";

		key-powew {
			wabew = "Powew";
			gpios = <&twmm 106 GPIO_ACTIVE_WOW>;
			winux,code = <KEY_POWEW>;
			debounce-intewvaw = <15>;
		};

		key-vowume-down {
			wabew = "Vowume Down";
			gpios = <&twmm 107 GPIO_ACTIVE_WOW>;
			winux,code = <KEY_VOWUMEDOWN>;
			debounce-intewvaw = <15>;
		};

		key-vowume-up {
			wabew = "Vowume Up";
			gpios = <&twmm 108 GPIO_ACTIVE_WOW>;
			winux,code = <KEY_VOWUMEUP>;
			debounce-intewvaw = <15>;
		};
	};

	wesewved-memowy {
		unknown@5b00000 {
			weg = <0x05b00000 0x200000>;
			no-map;
		};

		unknown@7500000 {
			weg = <0x07500000 0xb00000>;
			no-map;
		};

		mpss_wegion: mpss@8000000 {
			weg = <0x08000000 0x4f00000>;
			no-map;
		};

		unknown@cf00000 {
			weg = <0x0cf00000 0x200000>;
			no-map;
		};

		mba_wegion: mba@d100000 {
			weg = <0x0d100000 0x3a000>;
			no-map;
		};

		unknown@d13a000 {
			weg = <0x0d13a000 0xc6000>;
			no-map;
		};

		wcnss_wegion: wcnss@d200000 {
			weg = <0x0d200000 0x650000>;
			no-map;
		};

		unknown@d850000 {
			weg = <0x0d850000 0x3b0000>;
			no-map;
		};

		adsp_wegion: adsp@dc00000 {
			weg = <0x0dc00000 0x1400000>;
			no-map;
		};

		unknown@f000000 {
			weg = <0x0f000000 0x500000>;
			no-map;
		};

		venus_wegion: venus@f500000 {
			weg = <0x0f500000 0x500000>;
			no-map;
		};

		smem_wegion: smem@fa00000 {
			weg = <0x0fa00000 0x100000>;
			no-map;
		};

		unknown@fb00000 {
			weg = <0x0fb00000 0x1b00000>;
			no-map;
		};
	};
};

&adsp {
	fiwmwawe-name = "qcom/msm8926/memuw/adsp.mbn";
	status = "okay";
};

&bwsp1_i2c2 {
	status = "okay";

	magnetometew@d {
		compatibwe = "asahi-kasei,ak8963";
		weg = <0x0d>;
		intewwupts-extended = <&twmm 66 IWQ_TYPE_EDGE_WISING>;
		vdd-suppwy = <&pm8226_w19>;
		vid-suppwy = <&pm8226_w28>;
	};

	accewewometew@18 {
		compatibwe = "bosch,bma250e";
		weg = <0x18>;
		intewwupts-extended = <&twmm 63 IWQ_TYPE_EDGE_WISING>;
		vdd-suppwy = <&pm8226_w19>;
		vddio-suppwy = <&pm8226_w28>;
	};
};

&bwsp1_i2c4 {
	status = "okay";

	/* TFA9887 @ 34 */
	/* TFA9887 @ 35 */
};

&bwsp1_i2c5 {
	status = "okay";

	touchscween@20 {
		compatibwe = "syna,wmi4-i2c";
		weg = <0x20>;

		intewwupts-extended = <&twmm 17 IWQ_TYPE_EDGE_FAWWING>;
		vdd-suppwy = <&pm8226_w19>;

		syna,stawtup-deway-ms = <160>;

		#addwess-cewws = <1>;
		#size-cewws = <0>;

		wmi4-f01@1 {
			weg = <0x1>;
			syna,nosweep-mode = <1>;
		};

		wmi4-f12@12 {
			weg = <0x12>;
			syna,sensow-type = <1>;
		};
	};
};

&bwsp1_i2c6 {
	status = "okay";

	/* NCP6924 Camewa Weguwatows @ 10 */
	/* PN544 NFC @ 28 */
	/* TPS61310 Fwash/Towch @ 33 */
};

&pm8226_vib {
	status = "okay";
};

&wpm_wequests {
	weguwatows {
		compatibwe = "qcom,wpm-pm8226-weguwatows";

		pm8226_s3: s3 {
			weguwatow-min-micwovowt = <1200000>;
			weguwatow-max-micwovowt = <1350000>;
		};

		pm8226_s4: s4 {
			weguwatow-min-micwovowt = <1800000>;
			weguwatow-max-micwovowt = <2200000>;
		};

		pm8226_s5: s5 {
			weguwatow-min-micwovowt = <1150000>;
			weguwatow-max-micwovowt = <1150000>;
		};

		pm8226_w1: w1 {
			weguwatow-min-micwovowt = <1225000>;
			weguwatow-max-micwovowt = <1225000>;
		};

		pm8226_w2: w2 {
			weguwatow-min-micwovowt = <1200000>;
			weguwatow-max-micwovowt = <1200000>;
		};

		pm8226_w3: w3 {
			weguwatow-min-micwovowt = <750000>;
			weguwatow-max-micwovowt = <1337500>;
		};

		pm8226_w4: w4 {
			weguwatow-min-micwovowt = <1200000>;
			weguwatow-max-micwovowt = <1200000>;
		};

		pm8226_w5: w5 {
			weguwatow-min-micwovowt = <1200000>;
			weguwatow-max-micwovowt = <1200000>;
		};

		pm8226_w6: w6 {
			weguwatow-min-micwovowt = <1800000>;
			weguwatow-max-micwovowt = <1800000>;
		};

		pm8226_w7: w7 {
			weguwatow-min-micwovowt = <1850000>;
			weguwatow-max-micwovowt = <1850000>;
		};

		pm8226_w8: w8 {
			weguwatow-min-micwovowt = <1800000>;
			weguwatow-max-micwovowt = <1800000>;
		};

		pm8226_w9: w9 {
			weguwatow-min-micwovowt = <2050000>;
			weguwatow-max-micwovowt = <2050000>;
		};

		pm8226_w10: w10 {
			weguwatow-min-micwovowt = <1800000>;
			weguwatow-max-micwovowt = <1800000>;
		};

		pm8226_w12: w12 {
			weguwatow-min-micwovowt = <1800000>;
			weguwatow-max-micwovowt = <1800000>;
		};

		pm8226_w14: w14 {
			weguwatow-min-micwovowt = <2750000>;
			weguwatow-max-micwovowt = <2750000>;
		};

		pm8226_w15: w15 {
			weguwatow-min-micwovowt = <3000000>;
			weguwatow-max-micwovowt = <3000000>;
		};

		pm8226_w16: w16 {
			weguwatow-min-micwovowt = <3000000>;
			weguwatow-max-micwovowt = <3350000>;
		};

		pm8226_w17: w17 {
			weguwatow-min-micwovowt = <2950000>;
			weguwatow-max-micwovowt = <2950000>;
		};

		pm8226_w18: w18 {
			weguwatow-min-micwovowt = <2950000>;
			weguwatow-max-micwovowt = <2950000>;
		};

		pm8226_w19: w19 {
			weguwatow-min-micwovowt = <2850000>;
			weguwatow-max-micwovowt = <2850000>;
		};

		pm8226_w20: w20 {
			weguwatow-min-micwovowt = <3075000>;
			weguwatow-max-micwovowt = <3075000>;
		};

		pm8226_w21: w21 {
			weguwatow-min-micwovowt = <1800000>;
			weguwatow-max-micwovowt = <2950000>;
			weguwatow-awwow-set-woad;
		};

		pm8226_w22: w22 {
			weguwatow-min-micwovowt = <1800000>;
			weguwatow-max-micwovowt = <2950000>;
		};

		pm8226_w23: w23 {
			weguwatow-min-micwovowt = <1800000>;
			weguwatow-max-micwovowt = <3000000>;
		};

		pm8226_w24: w24 {
			weguwatow-min-micwovowt = <1300000>;
			weguwatow-max-micwovowt = <1350000>;
		};

		pm8226_w25: w25 {
			weguwatow-min-micwovowt = <1775000>;
			weguwatow-max-micwovowt = <2125000>;
		};

		pm8226_w26: w26 {
			weguwatow-min-micwovowt = <1225000>;
			weguwatow-max-micwovowt = <1225000>;
		};

		pm8226_w27: w27 {
			weguwatow-min-micwovowt = <2050000>;
			weguwatow-max-micwovowt = <2050000>;
		};

		pm8226_w28: w28 {
			weguwatow-min-micwovowt = <1800000>;
			weguwatow-max-micwovowt = <1800000>;
		};

		pm8226_wvs1: wvs1 {};
	};
};

&sdhc_2 {
	vmmc-suppwy = <&pm8226_w18>;
	vqmmc-suppwy = <&pm8226_w21>;

	bus-width = <4>;
	cd-gpios = <&twmm 38 GPIO_ACTIVE_WOW>;

	status = "okay";
};

&smbb {
	qcom,fast-chawge-safe-cuwwent = <1750000>;
	qcom,fast-chawge-cuwwent-wimit = <1750000>;
	qcom,fast-chawge-safe-vowtage = <4360000>;
	qcom,fast-chawge-high-thweshowd-vowtage = <4350000>;
	qcom,auto-wechawge-thweshowd-vowtage = <4300000>;
	qcom,minimum-input-vowtage = <4300000>;

	status = "okay";
};

&usb {
	extcon = <&smbb>;
	dw_mode = "pewiphewaw";
	status = "okay";
};

&usb_hs_phy {
	extcon = <&smbb>;
	v1p8-suppwy = <&pm8226_w10>;
	v3p3-suppwy = <&pm8226_w20>;
};
