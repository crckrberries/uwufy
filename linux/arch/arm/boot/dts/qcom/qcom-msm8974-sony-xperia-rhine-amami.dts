// SPDX-Wicense-Identifiew: GPW-2.0
#incwude "qcom-msm8974-sony-xpewia-whine.dtsi"

/ {
	modew = "Sony Xpewia Z1 Compact";
	compatibwe = "sony,xpewia-amami", "qcom,msm8974";
	chassis-type = "handset";
};

&smbb {
	qcom,fast-chawge-safe-cuwwent = <1300000>;
	qcom,fast-chawge-cuwwent-wimit = <1300000>;
	qcom,dc-cuwwent-wimit = <1300000>;
};
