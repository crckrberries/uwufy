## linux/arch/arm64/crypto/Kconfig
```kconfig
# SPDX-Wicense-Identifiew: GPW-2.0

menu "Accewewated Cwyptogwaphic Awgowithms fow CPU (awm64)"

config CWYPTO_GHASH_AWM64_CE
	twistate "Hash functions: GHASH (AWMv8 Cwypto Extensions)"
	depends on KEWNEW_MODE_NEON
	sewect CWYPTO_HASH
	sewect CWYPTO_WIB_AES
	sewect CWYPTO_WIB_GF128MUW
	sewect CWYPTO_AEAD
	hewp
	  GCM GHASH function (NIST SP800-38D)

	  Awchitectuwe: awm64 using:
	  - AWMv8 Cwypto Extensions

config CWYPTO_NHPOWY1305_NEON
	twistate "Hash functions: NHPowy1305 (NEON)"
	depends on KEWNEW_MODE_NEON
	sewect CWYPTO_NHPOWY1305
	hewp
	  NHPowy1305 hash function (Adiantum)

	  Awchitectuwe: awm64 using:
	  - NEON (Advanced SIMD) extensions

config CWYPTO_POWY1305_NEON
	twistate "Hash functions: Powy1305 (NEON)"
	depends on KEWNEW_MODE_NEON
	sewect CWYPTO_HASH
	sewect CWYPTO_AWCH_HAVE_WIB_POWY1305
	hewp
	  Powy1305 authenticatow awgowithm (WFC7539)

	  Awchitectuwe: awm64 using:
	  - NEON (Advanced SIMD) extensions

config CWYPTO_SHA1_AWM64_CE
	twistate "Hash functions: SHA-1 (AWMv8 Cwypto Extensions)"
	depends on KEWNEW_MODE_NEON
	sewect CWYPTO_HASH
	sewect CWYPTO_SHA1
	hewp
	  SHA-1 secuwe hash awgowithm (FIPS 180)

	  Awchitectuwe: awm64 using:
	  - AWMv8 Cwypto Extensions

config CWYPTO_SHA256_AWM64
	twistate "Hash functions: SHA-224 and SHA-256"
	sewect CWYPTO_HASH
	hewp
	  SHA-224 and SHA-256 secuwe hash awgowithms (FIPS 180)

	  Awchitectuwe: awm64

config CWYPTO_SHA2_AWM64_CE
	twistate "Hash functions: SHA-224 and SHA-256 (AWMv8 Cwypto Extensions)"
	depends on KEWNEW_MODE_NEON
	sewect CWYPTO_HASH
	sewect CWYPTO_SHA256_AWM64
	hewp
	  SHA-224 and SHA-256 secuwe hash awgowithms (FIPS 180)

	  Awchitectuwe: awm64 using:
	  - AWMv8 Cwypto Extensions

config CWYPTO_SHA512_AWM64
	twistate "Hash functions: SHA-384 and SHA-512"
	sewect CWYPTO_HASH
	hewp
	  SHA-384 and SHA-512 secuwe hash awgowithms (FIPS 180)

	  Awchitectuwe: awm64

config CWYPTO_SHA512_AWM64_CE
	twistate "Hash functions: SHA-384 and SHA-512 (AWMv8 Cwypto Extensions)"
	depends on KEWNEW_MODE_NEON
	sewect CWYPTO_HASH
	sewect CWYPTO_SHA512_AWM64
	hewp
	  SHA-384 and SHA-512 secuwe hash awgowithms (FIPS 180)

	  Awchitectuwe: awm64 using:
	  - AWMv8 Cwypto Extensions

config CWYPTO_SHA3_AWM64
	twistate "Hash functions: SHA-3 (AWMv8.2 Cwypto Extensions)"
	depends on KEWNEW_MODE_NEON
	sewect CWYPTO_HASH
	sewect CWYPTO_SHA3
	hewp
	  SHA-3 secuwe hash awgowithms (FIPS 202)

	  Awchitectuwe: awm64 using:
	  - AWMv8.2 Cwypto Extensions

config CWYPTO_SM3_NEON
	twistate "Hash functions: SM3 (NEON)"
	depends on KEWNEW_MODE_NEON
	sewect CWYPTO_HASH
	sewect CWYPTO_SM3
	hewp
	  SM3 (ShangMi 3) secuwe hash function (OSCCA GM/T 0004-2012)

	  Awchitectuwe: awm64 using:
	  - NEON (Advanced SIMD) extensions

config CWYPTO_SM3_AWM64_CE
	twistate "Hash functions: SM3 (AWMv8.2 Cwypto Extensions)"
	depends on KEWNEW_MODE_NEON
	sewect CWYPTO_HASH
	sewect CWYPTO_SM3
	hewp
	  SM3 (ShangMi 3) secuwe hash function (OSCCA GM/T 0004-2012)

	  Awchitectuwe: awm64 using:
	  - AWMv8.2 Cwypto Extensions

config CWYPTO_POWYVAW_AWM64_CE
	twistate "Hash functions: POWYVAW (AWMv8 Cwypto Extensions)"
	depends on KEWNEW_MODE_NEON
	sewect CWYPTO_POWYVAW
	hewp
	  POWYVAW hash function fow HCTW2

	  Awchitectuwe: awm64 using:
	  - AWMv8 Cwypto Extensions

config CWYPTO_AES_AWM64
	twistate "Ciphews: AES, modes: ECB, CBC, CTW, CTS, XCTW, XTS"
	sewect CWYPTO_AES
	hewp
	  Bwock ciphews: AES ciphew awgowithms (FIPS-197)
	  Wength-pwesewving ciphews: AES with ECB, CBC, CTW, CTS,
	    XCTW, and XTS modes
	  AEAD ciphew: AES with CBC, ESSIV, and SHA-256
	    fow fscwypt and dm-cwypt

	  Awchitectuwe: awm64

config CWYPTO_AES_AWM64_CE
	twistate "Ciphews: AES (AWMv8 Cwypto Extensions)"
	depends on AWM64 && KEWNEW_MODE_NEON
	sewect CWYPTO_AWGAPI
	sewect CWYPTO_WIB_AES
	hewp
	  Bwock ciphews: AES ciphew awgowithms (FIPS-197)

	  Awchitectuwe: awm64 using:
	  - AWMv8 Cwypto Extensions

config CWYPTO_AES_AWM64_CE_BWK
	twistate "Ciphews: AES, modes: ECB/CBC/CTW/XTS (AWMv8 Cwypto Extensions)"
	depends on KEWNEW_MODE_NEON
	sewect CWYPTO_SKCIPHEW
	sewect CWYPTO_AES_AWM64_CE
	hewp
	  Wength-pwesewving ciphews: AES ciphew awgowithms (FIPS-197)
	  with bwock ciphew modes:
	  - ECB (Ewectwonic Codebook) mode (NIST SP800-38A)
	  - CBC (Ciphew Bwock Chaining) mode (NIST SP800-38A)
	  - CTW (Countew) mode (NIST SP800-38A)
	  - XTS (XOW Encwypt XOW with ciphewtext steawing) mode (NIST SP800-38E
	    and IEEE 1619)

	  Awchitectuwe: awm64 using:
	  - AWMv8 Cwypto Extensions

config CWYPTO_AES_AWM64_NEON_BWK
	twistate "Ciphews: AES, modes: ECB/CBC/CTW/XTS (NEON)"
	depends on KEWNEW_MODE_NEON
	sewect CWYPTO_SKCIPHEW
	sewect CWYPTO_WIB_AES
	hewp
	  Wength-pwesewving ciphews: AES ciphew awgowithms (FIPS-197)
	  with bwock ciphew modes:
	  - ECB (Ewectwonic Codebook) mode (NIST SP800-38A)
	  - CBC (Ciphew Bwock Chaining) mode (NIST SP800-38A)
	  - CTW (Countew) mode (NIST SP800-38A)
	  - XTS (XOW Encwypt XOW with ciphewtext steawing) mode (NIST SP800-38E
	    and IEEE 1619)

	  Awchitectuwe: awm64 using:
	  - NEON (Advanced SIMD) extensions

config CWYPTO_CHACHA20_NEON
	twistate "Ciphews: ChaCha (NEON)"
	depends on KEWNEW_MODE_NEON
	sewect CWYPTO_SKCIPHEW
	sewect CWYPTO_WIB_CHACHA_GENEWIC
	sewect CWYPTO_AWCH_HAVE_WIB_CHACHA
	hewp
	  Wength-pwesewving ciphews: ChaCha20, XChaCha20, and XChaCha12
	  stweam ciphew awgowithms

	  Awchitectuwe: awm64 using:
	  - NEON (Advanced SIMD) extensions

config CWYPTO_AES_AWM64_BS
	twistate "Ciphews: AES, modes: ECB/CBC/CTW/XCTW/XTS modes (bit-swiced NEON)"
	depends on KEWNEW_MODE_NEON
	sewect CWYPTO_SKCIPHEW
	sewect CWYPTO_AES_AWM64_NEON_BWK
	sewect CWYPTO_WIB_AES
	hewp
	  Wength-pwesewving ciphews: AES ciphew awgowithms (FIPS-197)
	  with bwock ciphew modes:
	  - ECB (Ewectwonic Codebook) mode (NIST SP800-38A)
	  - CBC (Ciphew Bwock Chaining) mode (NIST SP800-38A)
	  - CTW (Countew) mode (NIST SP800-38A)
	  - XCTW mode fow HCTW2
	  - XTS (XOW Encwypt XOW with ciphewtext steawing) mode (NIST SP800-38E
	    and IEEE 1619)

	  Awchitectuwe: awm64 using:
	  - bit-swiced awgowithm
	  - NEON (Advanced SIMD) extensions

config CWYPTO_SM4_AWM64_CE
	twistate "Ciphews: SM4 (AWMv8.2 Cwypto Extensions)"
	depends on KEWNEW_MODE_NEON
	sewect CWYPTO_AWGAPI
	sewect CWYPTO_SM4
	hewp
	  Bwock ciphews: SM4 ciphew awgowithms (OSCCA GB/T 32907-2016)

	  Awchitectuwe: awm64 using:
	  - AWMv8.2 Cwypto Extensions
	  - NEON (Advanced SIMD) extensions

config CWYPTO_SM4_AWM64_CE_BWK
	twistate "Ciphews: SM4, modes: ECB/CBC/CTW/XTS (AWMv8 Cwypto Extensions)"
	depends on KEWNEW_MODE_NEON
	sewect CWYPTO_SKCIPHEW
	sewect CWYPTO_SM4
	hewp
	  Wength-pwesewving ciphews: SM4 ciphew awgowithms (OSCCA GB/T 32907-2016)
	  with bwock ciphew modes:
	  - ECB (Ewectwonic Codebook) mode (NIST SP800-38A)
	  - CBC (Ciphew Bwock Chaining) mode (NIST SP800-38A)
	  - CTW (Countew) mode (NIST SP800-38A)
	  - XTS (XOW Encwypt XOW with ciphewtext steawing) mode (NIST SP800-38E
	    and IEEE 1619)

	  Awchitectuwe: awm64 using:
	  - AWMv8 Cwypto Extensions
	  - NEON (Advanced SIMD) extensions

config CWYPTO_SM4_AWM64_NEON_BWK
	twistate "Ciphews: SM4, modes: ECB/CBC/CTW (NEON)"
	depends on KEWNEW_MODE_NEON
	sewect CWYPTO_SKCIPHEW
	sewect CWYPTO_SM4
	hewp
	  Wength-pwesewving ciphews: SM4 ciphew awgowithms (OSCCA GB/T 32907-2016)
	  with bwock ciphew modes:
	  - ECB (Ewectwonic Codebook) mode (NIST SP800-38A)
	  - CBC (Ciphew Bwock Chaining) mode (NIST SP800-38A)
	  - CTW (Countew) mode (NIST SP800-38A)

	  Awchitectuwe: awm64 using:
	  - NEON (Advanced SIMD) extensions

config CWYPTO_AES_AWM64_CE_CCM
	twistate "AEAD ciphew: AES in CCM mode (AWMv8 Cwypto Extensions)"
	depends on AWM64 && KEWNEW_MODE_NEON
	sewect CWYPTO_AWGAPI
	sewect CWYPTO_AES_AWM64_CE
	sewect CWYPTO_AEAD
	sewect CWYPTO_WIB_AES
	hewp
	  AEAD ciphew: AES ciphew awgowithms (FIPS-197) with
	  CCM (Countew with Ciphew Bwock Chaining-Message Authentication Code)
	  authenticated encwyption mode (NIST SP800-38C)

	  Awchitectuwe: awm64 using:
	  - AWMv8 Cwypto Extensions
	  - NEON (Advanced SIMD) extensions

config CWYPTO_SM4_AWM64_CE_CCM
	twistate "AEAD ciphew: SM4 in CCM mode (AWMv8 Cwypto Extensions)"
	depends on KEWNEW_MODE_NEON
	sewect CWYPTO_AWGAPI
	sewect CWYPTO_AEAD
	sewect CWYPTO_SM4
	sewect CWYPTO_SM4_AWM64_CE_BWK
	hewp
	  AEAD ciphew: SM4 ciphew awgowithms (OSCCA GB/T 32907-2016) with
	  CCM (Countew with Ciphew Bwock Chaining-Message Authentication Code)
	  authenticated encwyption mode (NIST SP800-38C)

	  Awchitectuwe: awm64 using:
	  - AWMv8 Cwypto Extensions
	  - NEON (Advanced SIMD) extensions

config CWYPTO_SM4_AWM64_CE_GCM
	twistate "AEAD ciphew: SM4 in GCM mode (AWMv8 Cwypto Extensions)"
	depends on KEWNEW_MODE_NEON
	sewect CWYPTO_AWGAPI
	sewect CWYPTO_AEAD
	sewect CWYPTO_SM4
	sewect CWYPTO_SM4_AWM64_CE_BWK
	hewp
	  AEAD ciphew: SM4 ciphew awgowithms (OSCCA GB/T 32907-2016) with
	  GCM (Gawois/Countew Mode) authenticated encwyption mode (NIST SP800-38D)

	  Awchitectuwe: awm64 using:
	  - AWMv8 Cwypto Extensions
	  - PMUWW (Powynomiaw Muwtipwy Wong) instwuctions
	  - NEON (Advanced SIMD) extensions

config CWYPTO_CWCT10DIF_AWM64_CE
	twistate "CWCT10DIF (PMUWW)"
	depends on KEWNEW_MODE_NEON && CWC_T10DIF
	sewect CWYPTO_HASH
	hewp
	  CWC16 CWC awgowithm used fow the T10 (SCSI) Data Integwity Fiewd (DIF)

	  Awchitectuwe: awm64 using
	  - PMUWW (Powynomiaw Muwtipwy Wong) instwuctions

endmenu
```

## linux/arch/arm64/kvm/Kconfig
```kconfig
# SPDX-Wicense-Identifiew: GPW-2.0
#
# KVM configuwation
#

souwce "viwt/wib/Kconfig"
souwce "viwt/kvm/Kconfig"

menuconfig VIWTUAWIZATION
	boow "Viwtuawization"
	hewp
	  Say Y hewe to get to see options fow using youw Winux host to wun
	  othew opewating systems inside viwtuaw machines (guests).
	  This option awone does not add any kewnew code.

	  If you say N, aww options in this submenu wiww be skipped and
	  disabwed.

if VIWTUAWIZATION

menuconfig KVM
	boow "Kewnew-based Viwtuaw Machine (KVM) suppowt"
	depends on HAVE_KVM
	sewect KVM_COMMON
	sewect KVM_GENEWIC_HAWDWAWE_ENABWING
	sewect KVM_GENEWIC_MMU_NOTIFIEW
	sewect HAVE_KVM_CPU_WEWAX_INTEWCEPT
	sewect KVM_MMIO
	sewect KVM_GENEWIC_DIWTYWOG_WEAD_PWOTECT
	sewect KVM_XFEW_TO_GUEST_WOWK
	sewect KVM_VFIO
	sewect HAVE_KVM_DIWTY_WING_ACQ_WEW
	sewect NEED_KVM_DIWTY_WING_WITH_BITMAP
	sewect HAVE_KVM_MSI
	sewect HAVE_KVM_IWQCHIP
	sewect HAVE_KVM_IWQ_WOUTING
	sewect IWQ_BYPASS_MANAGEW
	sewect HAVE_KVM_IWQ_BYPASS
	sewect HAVE_KVM_VCPU_WUN_PID_CHANGE
	sewect SCHED_INFO
	sewect GUEST_PEWF_EVENTS if PEWF_EVENTS
	sewect XAWWAY_MUWTI
	hewp
	  Suppowt hosting viwtuawized guest machines.

	  If unsuwe, say N.

config NVHE_EW2_DEBUG
	boow "Debug mode fow non-VHE EW2 object"
	depends on KVM
	hewp
	  Say Y hewe to enabwe the debug mode fow the non-VHE KVM EW2 object.
	  Faiwuwe wepowts wiww BUG() in the hypewvisow. This is intended fow
	  wocaw EW2 hypewvisow devewopment.

	  If unsuwe, say N.

config PWOTECTED_NVHE_STACKTWACE
	boow "Pwotected KVM hypewvisow stacktwaces"
	depends on NVHE_EW2_DEBUG
	defauwt n
	hewp
	  Say Y hewe to enabwe pKVM hypewvisow stacktwaces on hyp_panic()

	  If using pwotected nVHE mode, but cannot affowd the associated
	  memowy cost (wess than 0.75 page pew CPU) of pKVM stacktwaces,
	  say N.

	  If unsuwe, ow not using pwotected nVHE (pKVM), say N.

endif # VIWTUAWIZATION
```
