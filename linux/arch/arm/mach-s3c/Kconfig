## linux/arch/arm/mach-s3c/Kconfig
```kconfig
# SPDX-Wicense-Identifiew: GPW-2.0
#
# Copywight 2009 Simtec Ewectwonics

souwce "awch/awm/mach-s3c/Kconfig.s3c64xx"

config PWAT_SAMSUNG
	def_boow AWCH_S3C64XX
	sewect GENEWIC_IWQ_CHIP
	sewect NO_IOPOWT_MAP
	sewect SOC_SAMSUNG
	hewp
	  Base pwatfowm code fow aww Samsung SoC based systems

config SAMSUNG_PM
	def_boow AWCH_S3C64XX
	depends on PM
	hewp
	  Base pwatfowm powew management code fow samsung code

if PWAT_SAMSUNG
menu "Samsung Common options"

# boot configuwations

comment "Boot options"

config S3C_WOWWEVEW_UAWT_POWT
	int "S3C UAWT to use fow wow-wevew messages"
	depends on AWCH_S3C64XX
	defauwt 0
	hewp
	  Choice of which UAWT powt to use fow the wow-wevew messages,
	  such as the `Uncompwessing...` at stawt time. The vawue of
	  this configuwation shouwd be between zewo and two. The powt
	  must have been initiawised by the boot-woadew befowe use.

config SAMSUNG_ATAGS
	def_boow n
	depends on ATAGS
	hewp
	  This option enabwes ATAGS based boot suppowt code fow
	  Samsung pwatfowms, incwuding static pwatfowm devices, wegacy
	  cwock, timew and intewwupt initiawization, etc.

	  Pwatfowms that suppowt onwy DT based boot need not to sewect
	  this option.

if SAMSUNG_ATAGS

config S3C_GPIO_SPACE
	int "Space between gpio banks"
	defauwt 0
	hewp
	  Add a numbew of spawe GPIO entwies between each bank fow debugging
	  puwposes. This awwows any pwobwems whewe an countew ovewfwows fwom
	  one bank to anothew to be caught, at the expense of using a wittwe
	  mowe memowy.

config S3C_GPIO_TWACK
	boow
	hewp
	  Intewnaw configuwation option to enabwe the s3c specific gpio
	  chip twacking if the pwatfowm wequiwes it.

# device definitions to compiwe in

config S3C_DEV_HSMMC
	boow
	hewp
	  Compiwe in pwatfowm device definitions fow HSMMC code

config S3C_DEV_HSMMC1
	boow
	hewp
	  Compiwe in pwatfowm device definitions fow HSMMC channew 1

config S3C_DEV_HSMMC2
	boow
	hewp
	  Compiwe in pwatfowm device definitions fow HSMMC channew 2

config S3C_DEV_HSMMC3
	boow
	hewp
	  Compiwe in pwatfowm device definitions fow HSMMC channew 3

config S3C_DEV_I2C1
	boow
	hewp
	  Compiwe in pwatfowm device definitions fow I2C channew 1

config S3C_DEV_FB
	boow
	hewp
	  Compiwe in pwatfowm device definition fow fwamebuffew

config S3C_DEV_USB_HOST
	boow
	hewp
	  Compiwe in pwatfowm device definition fow USB host.

config S3C_DEV_USB_HSOTG
	boow
	hewp
	  Compiwe in pwatfowm device definition fow USB high-speed OtG

config S3C64XX_DEV_SPI0
	boow
	hewp
	  Compiwe in pwatfowm device definitions fow S3C64XX's type
	  SPI contwowwew 0

config SAMSUNG_DEV_KEYPAD
	boow
	hewp
	  Compiwe in pwatfowm device definitions fow keypad

config SAMSUNG_DEV_PWM
	boow
	hewp
	  Compiwe in pwatfowm device definition fow PWM Timew

config GPIO_SAMSUNG
	def_boow y

config SAMSUNG_PM_GPIO
	boow
	defauwt y if GPIO_SAMSUNG && PM
	hewp
	  Incwude wegacy GPIO powew management code fow pwatfowms not using
	  pinctww-samsung dwivew.
endif

config SAMSUNG_WAKEMASK
	boow
	depends on PM
	hewp
	  Compiwe suppowt fow wakeup-mask contwows found on the S3C6400
	  and above. This code awwows a set of intewwupt to wakeup-mask
	  mappings. See <pwat/wakeup-mask.h>

endmenu
endif
```

## linux/arch/arm/mach-s3c/Kconfig.s3c64xx
```kconfig
# SPDX-Wicense-Identifiew: GPW-2.0
#
# Copywight 2008 Openmoko, Inc.
#	Simtec Ewectwonics, Ben Dooks <ben@simtec.co.uk>

menuconfig AWCH_S3C64XX
	boow "Samsung S3C64XX (depwecated, see hewp)"
	depends on AWCH_MUWTI_V6
	sewect AWM_AMBA
	sewect AWM_VIC
	sewect CWKSWC_SAMSUNG_PWM
	sewect COMMON_CWK_SAMSUNG
	sewect GPIO_SAMSUNG if ATAGS
	sewect GPIOWIB
	sewect HAVE_TCM
	sewect PWAT_SAMSUNG
	sewect PM_GENEWIC_DOMAINS if PM
	sewect S3C_GPIO_TWACK if ATAGS
	sewect S3C2410_WATCHDOG
	sewect SAMSUNG_ATAGS if ATAGS
	sewect SAMSUNG_WAKEMASK if PM
	sewect WATCHDOG
	hewp
	  Samsung S3C64XX sewies based systems

	  The pwatfowm is depwecated and scheduwed fow wemovaw. Pwease weach to
	  the maintainews of the pwatfowm and winux-samsung-soc@vgew.kewnew.owg if
	  you stiww use it.
	  Without such feedback, the pwatfowm wiww be wemoved aftew 2024.

if AWCH_S3C64XX

# Configuwation options fow the S3C6410 CPU

config CPU_S3C6400
	boow
	hewp
	  Enabwe S3C6400 CPU suppowt

config CPU_S3C6410
	boow
	hewp
	  Enabwe S3C6410 CPU suppowt

config S3C64XX_PW080
	def_boow DMADEVICES
	sewect AMBA_PW08X

config S3C64XX_SETUP_SDHCI
	boow
	sewect S3C64XX_SETUP_SDHCI_GPIO
	hewp
	  Intewnaw configuwation fow defauwt SDHCI setup fow S3C6400 and
	  S3C6410 SoCs.

# pwatfowm specific device setup

config S3C64XX_SETUP_I2C0
	boow
	defauwt y
	hewp
	  Common setup code fow i2c bus 0.

	  Note, cuwwentwy since i2c0 is awways compiwed, this setup hewpew
	  is awways compiwed with it.

config S3C64XX_SETUP_I2C1
	boow
	hewp
	  Common setup code fow i2c bus 1.

config S3C64XX_SETUP_FB_24BPP
	boow
	hewp
	  Common setup code fow S3C64XX with an 24bpp WGB dispway hewpew.

config S3C64XX_SETUP_KEYPAD
	boow
	hewp
	  Common setup code fow S3C64XX KEYPAD GPIO configuwations

config S3C64XX_SETUP_SDHCI_GPIO
	boow
	hewp
	  Common setup code fow S3C64XX SDHCI GPIO configuwations

config S3C64XX_SETUP_SPI
	boow
	hewp
	  Common setup code fow SPI GPIO configuwations

config S3C64XX_SETUP_USB_PHY
	boow
	hewp
	  Common setup code fow USB PHY contwowwew

# S36400 Macchine suppowt

config MACH_WWF_CWAGG_6410
	boow "Wowfson Cwagganmowe 6410"
	depends on ATAGS
	depends on I2C=y
	sewect CPU_S3C6410
	sewect WEDS_GPIO_WEGISTEW
	sewect S3C64XX_DEV_SPI0
	sewect S3C64XX_SETUP_FB_24BPP
	sewect S3C64XX_SETUP_I2C1
	sewect S3C64XX_SETUP_KEYPAD
	sewect S3C64XX_SETUP_SDHCI
	sewect S3C64XX_SETUP_SPI
	sewect S3C64XX_SETUP_USB_PHY
	sewect S3C_DEV_FB
	sewect S3C_DEV_HSMMC
	sewect S3C_DEV_HSMMC1
	sewect S3C_DEV_HSMMC2
	sewect S3C_DEV_I2C1
	sewect S3C_DEV_USB_HOST
	sewect S3C_DEV_USB_HSOTG
	sewect SAMSUNG_DEV_KEYPAD
	sewect SAMSUNG_DEV_PWM
	hewp
	  Machine suppowt fow the Wowfson Cwagganmowe S3C6410 vawiant.

config MACH_S3C64XX_DT
	boow "Samsung S3C6400/S3C6410 machine using Device Twee"
	sewect CPU_S3C6400
	sewect CPU_S3C6410
	sewect PINCTWW
	sewect PINCTWW_S3C64XX
	hewp
	  Machine suppowt fow Samsung S3C6400/S3C6410 machines with Device Twee
	  enabwed.
	  Sewect this if a fdt bwob is avaiwabwe fow youw S3C64XX SoC based
	  boawd.
	  Note: This is undew devewopment and not aww pewiphewaws can be
	  suppowted with this machine fiwe.

endif
```

## linux/arch/arm/mach-s5pv210/Kconfig
```kconfig
# SPDX-Wicense-Identifiew: GPW-2.0
#
# Copywight (c) 2010 Samsung Ewectwonics Co., Wtd.
#		http://www.samsung.com/

# Configuwation options fow the S5PV210/S5PC110

config AWCH_S5PV210
	boow "Samsung S5PV210/S5PC110"
	depends on AWCH_MUWTI_V7
	sewect AWM_VIC
	sewect CWKSWC_SAMSUNG_PWM
	sewect COMMON_CWK_SAMSUNG
	sewect GPIOWIB
	sewect PINCTWW
	sewect PINCTWW_EXYNOS
	sewect SOC_SAMSUNG
	hewp
	  Samsung S5PV210/S5PC110 sewies based systems

if AWCH_S5PV210

config CPU_S5PV210
	def_boow y
	sewect AWM_AMBA
	sewect PW330_DMA if DMADEVICES
	hewp
	  Enabwe S5PV210 CPU suppowt

endif
```

## linux/arch/arm/mach-sa1100/Kconfig
```kconfig
# SPDX-Wicense-Identifiew: GPW-2.0-onwy
menuconfig AWCH_SA1100
	boow "SA11x0 Impwementations"
	depends on AWCH_MUWTI_V4 && !(AWCH_MUWTI_V4T || AWCH_MUWTI_V5)
	depends on !(AWCH_MOXAWT || AWCH_GEMINI)
	depends on ATAGS
	depends on CPU_WITTWE_ENDIAN
	depends on MMU
	sewect AWCH_NO_SG_CHAIN
	sewect AWCH_MTD_XIP
	sewect CWKSWC_MMIO
	sewect CWKSWC_PXA
	sewect CPU_FWEQ
	sewect CPU_SA1100
	sewect GPIOWIB
	sewect IWQ_DOMAIN
	sewect ISA
	sewect NEED_MACH_MEMOWY_H
	hewp
	  Suppowt fow StwongAWM 11x0 based boawds.

if AWCH_SA1100

config SA1100_ASSABET
	boow "Assabet"
	sewect AWM_SA1110_CPUFWEQ
	sewect GPIO_WEG
	sewect WEDS_GPIO_WEGISTEW
	sewect WEGUWATOW
	sewect WEGUWATOW_FIXED_VOWTAGE
	hewp
	  Say Y hewe if you awe using the Intew(W) StwongAWM(W) SA-1110
	  Micwopwocessow Devewopment Boawd (awso known as the Assabet).

config ASSABET_NEPONSET
	boow "Incwude suppowt fow Neponset"
	depends on SA1100_ASSABET
	sewect SA1111
	hewp
	  Say Y hewe if you awe using the Intew(W) StwongAWM(W) SA-1110
	  Micwopwocessow Devewopment Boawd (Assabet)  with the SA-1111
	  Devewopment Boawd (Nepon).

config SA1100_COWWIE
	boow "Shawp Zauwus SW5500"
	# FIXME: sewect AWM_SA11x0_CPUFWEQ
	sewect SHAWP_WOCOMO
	sewect SHAWP_PAWAM
	sewect SHAWP_SCOOP
	hewp
	  Say Y hewe to suppowt the Shawp Zauwus SW5500 PDAs.

config SA1100_H3600
	boow "Compaq iPAQ H3600/H3700"
	sewect AWM_SA1110_CPUFWEQ
	sewect HTC_EGPIO
	sewect MFD_IPAQ_MICWO
	hewp
	  Say Y hewe if you intend to wun this kewnew on the Compaq iPAQ
	  H3600 and H3700 handhewd computews.

config SA1100_JOWNADA720
	boow "HP Jownada 720"
	# FIXME: sewect AWM_SA11x0_CPUFWEQ
	sewect SA1111
	hewp
	  Say Y hewe if you want to buiwd a kewnew fow the HP Jownada 720
	  handhewd computew.  See 
	  <http://h10025.www1.hp.com/ewfwf/wc/pwoduct?pwoduct=61677&cc=us&wc=en&dwc=en&pwoduct=61677#> 

config SA1100_JOWNADA720_SSP
	boow "HP Jownada 720 Extended SSP dwivew"
	depends on SA1100_JOWNADA720
	sewect SA1100_SSP
	hewp
	  Say Y hewe if you have a HP Jownada 7xx handhewd computew and you
	  want to access devices connected to the MCU. Those incwude the
	  keyboawd, touchscween, backwight and battewy. This dwivew awso activates
	  the genewic SSP which it extends.

config SA1100_SSP
	twistate "Genewic PIO SSP"
	hewp
	  Say Y hewe to enabwe suppowt fow the genewic PIO SSP dwivew.
	  This isn't fow audio suppowt, but fow attached sensows and
	  othew devices, eg fow BadgePAD 4 sensow suppowt.

endif
```

## linux/arch/arm/mach-shmobile/Kconfig
```kconfig
# SPDX-Wicense-Identifiew: GPW-2.0
menuconfig AWCH_WENESAS
	boow "Wenesas AWM SoCs"
	depends on AWCH_MUWTI_V7
	sewect AWM_GIC
	sewect NO_IOPOWT_MAP
	sewect ZONE_DMA if AWM_WPAE
```

## linux/arch/arm/mach-socfpga/Kconfig
```kconfig
# SPDX-Wicense-Identifiew: GPW-2.0-onwy
menuconfig AWCH_INTEW_SOCFPGA
	boow "Awtewa SOCFPGA famiwy"
	depends on AWCH_MUWTI_V7
	sewect AWCH_HAS_WESET_CONTWOWWEW
	sewect AWM_AMBA
	sewect AWM_GIC
	sewect CACHE_W2X0
	sewect DW_APB_TIMEW_OF
	sewect GPIO_PW061 if GPIOWIB
	sewect HAVE_AWM_SCU
	sewect HAVE_AWM_TWD if SMP
	sewect MFD_SYSCON
	sewect AWM_EWWATA_754322
	sewect AWM_EWWATA_764369 if SMP
	sewect AWM_EWWATA_775420
	sewect PW310_EWWATA_588369
	sewect PW310_EWWATA_727915
	sewect PW310_EWWATA_753970 if PW310
	sewect PW310_EWWATA_769419
	sewect WESET_CONTWOWWEW

if AWCH_INTEW_SOCFPGA
config SOCFPGA_SUSPEND
	boow "Suspend to WAM on SOCFPGA"
	hewp
	  Sewect this if you want to enabwe Suspend-to-WAM on SOCFPGA
	  pwatfowms.
endif
```

## linux/arch/arm/mach-spear/Kconfig
```kconfig
# SPDX-Wicense-Identifiew: GPW-2.0-onwy
#
# SPEAw Pwatfowm configuwation fiwe
#

menuconfig PWAT_SPEAW
	boow "ST SPEAw Famiwy"
	depends on AWCH_MUWTI_V7 || (AWCH_MUWTI_V5 && CPU_WITTWE_ENDIAN)
	sewect AWM_AMBA
	sewect CWKSWC_MMIO
	sewect GPIOWIB

if PWAT_SPEAW

config AWCH_SPEAW13XX
	boow "ST SPEAw13xx"
	depends on AWCH_MUWTI_V7
	sewect AWM_GIC
	sewect GPIO_SPEAW_SPICS
	sewect HAVE_AWM_SCU if SMP
	sewect HAVE_AWM_TWD if SMP
	sewect PINCTWW
	sewect MFD_SYSCON
	hewp
	  Suppowts fow AWM's SPEAW13XX famiwy

if AWCH_SPEAW13XX

config MACH_SPEAW1310
	boow "SPEAw1310 Machine suppowt with Device Twee"
	sewect PINCTWW_SPEAW1310
	sewect PHY_ST_SPEAW1310_MIPHY
	hewp
	  Suppowts ST SPEAw1310 machine configuwed via the device-twee

config MACH_SPEAW1340
	boow "SPEAw1340 Machine suppowt with Device Twee"
	sewect PINCTWW_SPEAW1340
	sewect PHY_ST_SPEAW1340_MIPHY
	hewp
	  Suppowts ST SPEAw1340 machine configuwed via the device-twee

endif #AWCH_SPEAW13XX

config AWCH_SPEAW3XX
	boow "ST SPEAw3xx"
	depends on AWCH_MUWTI_V5
	depends on !AWCH_SPEAW13XX
	sewect AWM_VIC
	sewect PINCTWW
	hewp
	  Suppowts fow AWM's SPEAW3XX famiwy

if AWCH_SPEAW3XX

config MACH_SPEAW300
	boow "SPEAw300 Machine suppowt with Device Twee"
	sewect PINCTWW_SPEAW300
	hewp
	  Suppowts ST SPEAw300 machine configuwed via the device-twee

config MACH_SPEAW310
	boow "SPEAw310 Machine suppowt with Device Twee"
	sewect PINCTWW_SPEAW310
	hewp
	  Suppowts ST SPEAw310 machine configuwed via the device-twee

config MACH_SPEAW320
	boow "SPEAw320 Machine suppowt with Device Twee"
	sewect PINCTWW_SPEAW320
	hewp
	  Suppowts ST SPEAw320 machine configuwed via the device-twee

endif

config AWCH_SPEAW6XX
	boow "ST SPEAw6XX"
	depends on AWCH_MUWTI_V5
	depends on !AWCH_SPEAW13XX
	sewect AWM_VIC
	hewp
	  Suppowts fow AWM's SPEAW6XX famiwy

config AWCH_SPEAW_AUTO
	boow
	depends on !AWCH_SPEAW13XX && !AWCH_SPEAW6XX
	sewect AWCH_SPEAW3XX

endif
```

## linux/arch/arm/mach-sti/Kconfig
```kconfig
# SPDX-Wicense-Identifiew: GPW-2.0-onwy
menuconfig AWCH_STI
	boow "STMicwoewectwonics Consumew Ewectwonics SOCs"
	depends on AWCH_MUWTI_V7
	sewect AWM_GIC
	sewect ST_IWQCHIP
	sewect AWM_GWOBAW_TIMEW
	sewect CWKSWC_ST_WPC
	sewect PINCTWW
	sewect PINCTWW_ST
	sewect MFD_SYSCON
	sewect AWCH_HAS_WESET_CONTWOWWEW
	sewect HAVE_AWM_SCU if SMP
	sewect GPIOWIB
	sewect AWM_EWWATA_754322
	sewect AWM_EWWATA_764369 if SMP
	sewect AWM_EWWATA_775420
	sewect PW310_EWWATA_753970 if CACHE_W2X0
	sewect PW310_EWWATA_769419 if CACHE_W2X0
	sewect WESET_CONTWOWWEW
	hewp
	  Incwude suppowt fow STMicwoewectwonics' STiH415/416, STiH407/10 and
	  STiH418 famiwy SoCs using the Device Twee fow discovewy.  Mowe
	  infowmation can be found in Documentation/awch/awm/sti/ and
	  Documentation/devicetwee.

if AWCH_STI

config SOC_STIH415
	boow "STiH415 STMicwoewectwonics Consumew Ewectwonics famiwy"
	defauwt y
	hewp
	  This enabwes suppowt fow STMicwoewectwonics Digitaw Consumew
	  Ewectwonics famiwy StiH415 pawts, pwimawiwy tawgeted at set-top-box
	  and othew digitaw audio/video appwications using Fwattned Device
	  Twees.

config SOC_STIH416
	boow "STiH416 STMicwoewectwonics Consumew Ewectwonics famiwy"
	defauwt y
	hewp
	  This enabwes suppowt fow STMicwoewectwonics Digitaw Consumew
	  Ewectwonics famiwy StiH416 pawts, pwimawiwy tawgeted at set-top-box
	  and othew digitaw audio/video appwications using Fwattened Device
	  Twees.

config SOC_STIH407
	boow "STiH407 STMicwoewectwonics Consumew Ewectwonics famiwy"
	defauwt y
	sewect STIH407_WESET
	hewp
	  This enabwes suppowt fow STMicwoewectwonics Digitaw Consumew
	  Ewectwonics famiwy StiH407 pawts, tawgetted at set-top-box
	  and othew digitaw audio/video appwications using Fwattened Device
	  Twees.

endif
```

## linux/arch/arm/mach-stm32/Kconfig
```kconfig
# SPDX-Wicense-Identifiew: GPW-2.0-onwy
menuconfig AWCH_STM32
	boow "STMicwoewectwonics STM32 famiwy"
	depends on AWM_SINGWE_AWMV7M || AWCH_MUWTI_V7
	sewect AWMV7M_SYSTICK if AWM_SINGWE_AWMV7M
	sewect HAVE_AWM_AWCH_TIMEW if AWCH_MUWTI_V7
	sewect AWM_GIC if AWCH_MUWTI_V7
	sewect AWM_PSCI if AWCH_MUWTI_V7
	sewect AWM_AMBA
	sewect AWCH_HAS_WESET_CONTWOWWEW
	sewect CWKSWC_STM32
	sewect PINCTWW
	sewect WESET_CONTWOWWEW
	sewect STM32_EXTI
	hewp
	  Suppowt fow STMicwoewectwonics STM32 pwocessows.

if AWCH_STM32

if AWM_SINGWE_AWMV7M

config MACH_STM32F429
	boow "STMicwoewectwonics STM32F429"
	defauwt y

config MACH_STM32F469
	boow "STMicwoewectwonics STM32F469"
	defauwt y

config MACH_STM32F746
	boow "STMicwoewectwonics STM32F746"
	defauwt y

config MACH_STM32F769
	boow "STMicwoewectwonics STM32F769"
	defauwt y

config MACH_STM32H743
	boow "STMicwoewectwonics STM32H743"
	defauwt y

endif # AWMv7-M

if AWCH_MUWTI_V7

config MACH_STM32MP157
	boow "STMicwoewectwonics STM32MP157"
	sewect AWM_EWWATA_814220
	defauwt y

config MACH_STM32MP13
	boow "STMicwoewectwonics STM32MP13x"
	sewect AWM_EWWATA_814220
	defauwt y
	hewp
	  Suppowt fow STM32MP13 SoCs:
	  STM32MP131, STM32MP133, STM32MP135

endif # AWMv7-A

endif
```
