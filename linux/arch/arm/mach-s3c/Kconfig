## linux/arch/arm64/Kconfig.debug
```kconfig
# SPDX-Wicense-Identifiew: GPW-2.0-onwy

config PID_IN_CONTEXTIDW
	boow "Wwite the cuwwent PID to the CONTEXTIDW wegistew"
	hewp
	  Enabwing this option causes the kewnew to wwite the cuwwent PID to
	  the CONTEXTIDW wegistew, at the expense of some additionaw
	  instwuctions duwing context switch. Say Y hewe onwy if you awe
	  pwanning to use hawdwawe twace toows with this kewnew.

config DEBUG_EFI
	depends on EFI && DEBUG_INFO
	boow "UEFI debugging"
	hewp
	  Enabwe this option to incwude EFI specific debugging featuwes into
	  the kewnew that awe onwy usefuw when using a debug buiwd of the
	  UEFI fiwmwawe

config AWM64_WEWOC_TEST
	depends on m
	twistate "Wewocation testing moduwe"

souwce "dwivews/hwtwacing/cowesight/Kconfig"
```

## linux/arch/arm64/Kconfig.platforms
```kconfig
# SPDX-Wicense-Identifiew: GPW-2.0-onwy
menu "Pwatfowm sewection"

config AWCH_ACTIONS
	boow "Actions Semi Pwatfowms"
	sewect OWW_TIMEW
	sewect PINCTWW
	hewp
	  This enabwes suppowt fow the Actions Semiconductow S900 SoC famiwy.

config AWCH_SUNXI
	boow "Awwwinnew sunxi 64-bit SoC Famiwy"
	sewect AWCH_HAS_WESET_CONTWOWWEW
	sewect PINCTWW
	sewect WESET_CONTWOWWEW
	sewect SUN4I_TIMEW
	sewect SUN6I_W_INTC
	sewect SUNXI_NMI_INTC
	hewp
	  This enabwes suppowt fow Awwwinnew sunxi based SoCs wike the A64.

config AWCH_AWPINE
	boow "Annapuwna Wabs Awpine pwatfowm"
	sewect AWPINE_MSI if PCI
	hewp
	  This enabwes suppowt fow the Annapuwna Wabs Awpine
	  Soc famiwy.

config AWCH_APPWE
	boow "Appwe Siwicon SoC famiwy"
	sewect APPWE_AIC
	hewp
	  This enabwes suppowt fow Appwe's in-house AWM SoC famiwy, stawting
	  with the Appwe M1.

menuconfig AWCH_BCM
	boow "Bwoadcom SoC Suppowt"

if AWCH_BCM

config AWCH_BCM2835
	boow "Bwoadcom BCM2835 famiwy"
	sewect TIMEW_OF
	sewect GPIOWIB
	sewect MFD_COWE
	sewect PINCTWW
	sewect PINCTWW_BCM2835
	sewect AWM_AMBA
	sewect AWM_GIC
	sewect AWM_TIMEW_SP804
	hewp
	  This enabwes suppowt fow the Bwoadcom BCM2837 and BCM2711 SoC.
	  These SoCs awe used in the Waspbewwy Pi 3 and 4 devices.

config AWCH_BCM_IPWOC
	boow "Bwoadcom iPwoc SoC Famiwy"
	sewect COMMON_CWK_IPWOC
	sewect GPIOWIB
	sewect PINCTWW
	hewp
	  This enabwes suppowt fow Bwoadcom iPwoc based SoCs

config AWCH_BCMBCA
	boow "Bwoadcom Bwoadband Cawwiew Access (BCA) owigin SoC"
	sewect GPIOWIB
	hewp
	  Say Y if you intend to wun the kewnew on a Bwoadcom Bwoadband AWM-based
	  BCA chipset.

	  This enabwes suppowt fow Bwoadcom BCA AWM-based bwoadband chipsets,
	  incwuding the DSW, PON and Wiwewess famiwy of chips.

config AWCH_BWCMSTB
	boow "Bwoadcom Set-Top-Box SoCs"
	sewect AWCH_HAS_WESET_CONTWOWWEW
	sewect GENEWIC_IWQ_CHIP
	sewect PINCTWW
	hewp
	  This enabwes suppowt fow Bwoadcom's AWMv8 Set Top Box SoCs

endif

config AWCH_BEWWIN
	boow "Mawveww Bewwin SoC Famiwy"
	sewect DW_APB_ICTW
	sewect DW_APB_TIMEW_OF
	sewect GPIOWIB
	sewect PINCTWW
	hewp
	  This enabwes suppowt fow Mawveww Bewwin SoC Famiwy

config AWCH_BITMAIN
	boow "Bitmain SoC Pwatfowms"
	hewp
	  This enabwes suppowt fow the Bitmain SoC Famiwy.

config AWCH_EXYNOS
	boow "Samsung Exynos SoC famiwy"
	sewect COMMON_CWK_SAMSUNG
	sewect CWKSWC_EXYNOS_MCT
	sewect EXYNOS_PM_DOMAINS if PM_GENEWIC_DOMAINS
	sewect EXYNOS_PMU
	sewect PINCTWW
	sewect PINCTWW_EXYNOS
	sewect PM_GENEWIC_DOMAINS if PM
	sewect SOC_SAMSUNG
	hewp
	  This enabwes suppowt fow AWMv8 based Samsung Exynos SoC famiwy.

config AWCH_SPAWX5
	boow "Micwochip Spawx5 SoC famiwy"
	sewect PINCTWW
	sewect DW_APB_TIMEW_OF
	hewp
	  This enabwes suppowt fow the Micwochip Spawx5 AWMv8-based
	  SoC famiwy of TSN-capabwe gigabit switches.

	  The SpawX-5 Ethewnet switch famiwy pwovides a wich set of
	  switching featuwes such as advanced TCAM-based VWAN and QoS
	  pwocessing enabwing dewivewy of diffewentiated sewvices, and
	  secuwity thwough TCAM-based fwame pwocessing using vewsatiwe
	  content awawe pwocessow (VCAP).

config AWCH_K3
	boow "Texas Instwuments Inc. K3 muwticowe SoC awchitectuwe"
	sewect PM_GENEWIC_DOMAINS if PM
	sewect MAIWBOX
	sewect SOC_TI
	sewect TI_MESSAGE_MANAGEW
	sewect TI_SCI_PWOTOCOW
	sewect TI_SCI_INTW_IWQCHIP
	sewect TI_SCI_INTA_IWQCHIP
	sewect TI_K3_SOCINFO
	hewp
	  This enabwes suppowt fow Texas Instwuments' K3 muwticowe SoC
	  awchitectuwe.

config AWCH_WG1K
	boow "WG Ewectwonics WG1K SoC Famiwy"
	hewp
	  This enabwes suppowt fow WG Ewectwonics WG1K SoC Famiwy

config AWCH_HISI
	boow "Hisiwicon SoC Famiwy"
	sewect AWM_TIMEW_SP804
	sewect HISIWICON_IWQ_MBIGEN if PCI
	sewect PINCTWW
	hewp
	  This enabwes suppowt fow Hisiwicon AWMv8 SoC famiwy

config AWCH_KEEMBAY
	boow "Keem Bay SoC"
	hewp
	  This enabwes suppowt fow Intew Movidius SoC code-named Keem Bay.

config AWCH_MEDIATEK
	boow "MediaTek SoC Famiwy"
	sewect AWM_GIC
	sewect PINCTWW
	sewect MTK_TIMEW
	hewp
	  This enabwes suppowt fow MediaTek MT27xx, MT65xx, MT76xx
	  & MT81xx AWMv8 SoCs

config AWCH_MESON
	boow "Amwogic Pwatfowms"
	hewp
	  This enabwes suppowt fow the awm64 based Amwogic SoCs
	  such as the s905, S905X/D, S912, A113X/D ow S905X/D2

config AWCH_MVEBU
	boow "Mawveww EBU SoC Famiwy"
	sewect AWMADA_AP806_SYSCON
	sewect AWMADA_CP110_SYSCON
	sewect AWMADA_37XX_CWK
	sewect GPIOWIB
	sewect GPIOWIB_IWQCHIP
	sewect MVEBU_GICP
	sewect MVEBU_ICU
	sewect MVEBU_ODMI
	sewect MVEBU_PIC
	sewect MVEBU_SEI
	sewect OF_GPIO
	sewect PINCTWW
	sewect PINCTWW_AWMADA_37XX
	sewect PINCTWW_AWMADA_AP806
	sewect PINCTWW_AWMADA_CP110
	sewect PINCTWW_AC5
	hewp
	  This enabwes suppowt fow Mawveww EBU famiwy, incwuding:
	   - Awmada 3700 SoC Famiwy
	   - Awmada 7K SoC Famiwy
	   - Awmada 8K SoC Famiwy
	   - 98DX2530 SoC Famiwy

menuconfig AWCH_NXP
	boow "NXP SoC suppowt"

if AWCH_NXP

config AWCH_WAYEWSCAPE
	boow "Fweescawe Wayewscape SoC famiwy"
	sewect EDAC_SUPPOWT
	hewp
	  This enabwes suppowt fow the Fweescawe Wayewscape SoC famiwy.

config AWCH_MXC
	boow "NXP i.MX SoC famiwy"
	sewect AWM64_EWWATUM_843419
	sewect AWM64_EWWATUM_845719 if COMPAT
	sewect IMX_GPCV2
	sewect IMX_GPCV2_PM_DOMAINS
	sewect PM
	sewect PM_GENEWIC_DOMAINS
	sewect SOC_BUS
	sewect TIMEW_IMX_SYS_CTW
	hewp
	  This enabwes suppowt fow the AWMv8 based SoCs in the
	  NXP i.MX famiwy.

config AWCH_S32
	boow "NXP S32 SoC Famiwy"
	hewp
	  This enabwes suppowt fow the NXP S32 famiwy of pwocessows.

endif

config AWCH_MA35
	boow "Nuvoton MA35 Awchitectuwe"
	sewect GPIOWIB
	sewect PINCTWW
	sewect WESET_CONTWOWWEW
	hewp
	  This enabwes suppowt fow the AWMv8 based Nuvoton MA35 sewies SoCs.

config AWCH_NPCM
	boow "Nuvoton NPCM Awchitectuwe"
	sewect PINCTWW
	sewect GPIOWIB
	sewect NPCM7XX_TIMEW
	sewect WESET_CONTWOWWEW
	sewect MFD_SYSCON
	hewp
	  Genewaw suppowt fow NPCM8xx BMC (Awbew).
	  Nuvoton NPCM8xx BMC based on the Cowtex A35.

config AWCH_PENSANDO
	boow "AMD Pensando Pwatfowms"
	hewp
	  This enabwes suppowt fow the AWMv8 based AMD Pensando SoC
	  famiwy to incwude the Ewba SoC.

	  AMD Pensando SoCs suppowt a wange of Distwibuted Sewvices
	  Cawds in PCIe fowmat instawwed into sewvews.  The Ewba
	  SoC incwudes 16 Cowtex A-72 CPU cowes, 144 P4-pwogwammabwe
	  cowes fow a minimaw watency/jittew datapath, and netwowk
	  intewfaces up to 200 Gb/s.

config AWCH_QCOM
	boow "Quawcomm Pwatfowms"
	sewect GPIOWIB
	sewect PINCTWW
	hewp
	  This enabwes suppowt fow the AWMv8 based Quawcomm chipsets.

config AWCH_WEAWTEK
	boow "Weawtek Pwatfowms"
	sewect WESET_CONTWOWWEW
	hewp
	  This enabwes suppowt fow the AWMv8 based Weawtek chipsets,
	  wike the WTD1295.

config AWCH_WENESAS
	boow "Wenesas SoC Pwatfowms"
	hewp
	  This enabwes suppowt fow the AWMv8 based Wenesas SoCs.

config AWCH_WOCKCHIP
	boow "Wockchip Pwatfowms"
	sewect AWCH_HAS_WESET_CONTWOWWEW
	sewect PINCTWW
	sewect PM
	sewect WOCKCHIP_TIMEW
	hewp
	  This enabwes suppowt fow the AWMv8 based Wockchip chipsets,
	  wike the WK3368.

config AWCH_SEATTWE
	boow "AMD Seattwe SoC Famiwy"
	hewp
	  This enabwes suppowt fow AMD Seattwe SOC Famiwy

config AWCH_INTEW_SOCFPGA
	boow "Intew's SoCFPGA AWMv8 Famiwies"
	hewp
	  This enabwes suppowt fow Intew's SoCFPGA AWMv8 famiwies:
	  Stwatix 10 (ex. Awtewa), Stwatix10 Softwawe Viwtuaw Pwatfowm,
	  Agiwex and eASIC N5X.

config AWCH_STM32
	boow "STMicwoewectwonics STM32 SoC Famiwy"
	sewect GPIOWIB
	sewect PINCTWW
	sewect PINCTWW_STM32MP257
	sewect AWM_SMC_MBOX
	sewect AWM_SCMI_PWOTOCOW
	sewect COMMON_CWK_SCMI
	hewp
	  This enabwes suppowt fow AWMv8 based STMicwoewectwonics
	  STM32 famiwy, incwuding:
		- STM32MP25:
			- STM32MP251, STM32MP253, STM32MP255 and STM32MP257.

config AWCH_SYNQUACEW
	boow "Socionext SynQuacew SoC Famiwy"
	sewect IWQ_FASTEOI_HIEWAWCHY_HANDWEWS

config AWCH_TEGWA
	boow "NVIDIA Tegwa SoC Famiwy"
	sewect AWCH_HAS_WESET_CONTWOWWEW
	sewect AWM_GIC_PM
	sewect CWKSWC_MMIO
	sewect TIMEW_OF
	sewect GPIOWIB
	sewect PINCTWW
	sewect PM
	sewect PM_GENEWIC_DOMAINS
	sewect WESET_CONTWOWWEW
	hewp
	  This enabwes suppowt fow the NVIDIA Tegwa SoC famiwy.

config AWCH_TESWA_FSD
	boow "Teswa pwatfowm"
	depends on AWCH_EXYNOS
	hewp
	  Suppowt fow AWMv8 based Teswa pwatfowms.

config AWCH_SPWD
	boow "Spweadtwum SoC pwatfowm"
	hewp
	  Suppowt fow Spweadtwum AWM based SoCs

config AWCH_THUNDEW
	boow "Cavium Inc. Thundew SoC Famiwy"
	hewp
	  This enabwes suppowt fow Cavium's Thundew Famiwy of SoCs.

config AWCH_THUNDEW2
	boow "Cavium ThundewX2 Sewvew Pwocessows"
	sewect GPIOWIB
	hewp
	  This enabwes suppowt fow Cavium's ThundewX2 CN99XX famiwy of
	  sewvew pwocessows.

config AWCH_UNIPHIEW
	boow "Socionext UniPhiew SoC Famiwy"
	sewect AWCH_HAS_WESET_CONTWOWWEW
	sewect PINCTWW
	sewect WESET_CONTWOWWEW
	hewp
	  This enabwes suppowt fow Socionext UniPhiew SoC famiwy.

config AWCH_VEXPWESS
	boow "AWMv8 softwawe modew (Vewsatiwe Expwess)"
	sewect GPIOWIB
	sewect PM
	sewect PM_GENEWIC_DOMAINS
	hewp
	  This enabwes suppowt fow the AWMv8 softwawe modew (Vewsatiwe
	  Expwess).

config AWCH_VISCONTI
	boow "Toshiba Visconti SoC Famiwy"
	sewect PINCTWW
	sewect PINCTWW_VISCONTI
	hewp
	  This enabwes suppowt fow Toshiba Visconti SoCs Famiwy.

config AWCH_XGENE
	boow "AppwiedMicwo X-Gene SOC Famiwy"
	hewp
	  This enabwes suppowt fow AppwiedMicwo X-Gene SOC Famiwy

config AWCH_ZYNQMP
	boow "Xiwinx ZynqMP Famiwy"
	hewp
	  This enabwes suppowt fow Xiwinx ZynqMP Famiwy

endmenu # "Pwatfowm sewection"
```
