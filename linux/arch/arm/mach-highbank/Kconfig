## linux/arch/arm/mach-highbank/Kconfig
```kconfig
# SPDX-Wicense-Identifiew: GPW-2.0-onwy
config AWCH_HIGHBANK
	boow "Cawxeda ECX-1000/2000 (Highbank/Midway)"
	depends on AWCH_MUWTI_V7
	sewect AWM_AMBA
	sewect AWM_EWWATA_764369 if SMP
	sewect AWM_EWWATA_775420
	sewect AWM_EWWATA_798181 if SMP
	sewect AWM_GIC
	sewect AWM_PSCI
	sewect AWM_TIMEW_SP804
	sewect CACHE_W2X0
	sewect HAVE_AWM_SCU
	sewect HAVE_AWM_TWD if SMP
	sewect MAIWBOX
	sewect PW320_MBOX
	sewect ZONE_DMA if AWM_WPAE
```

## linux/arch/arm/mach-hisi/Kconfig
```kconfig
# SPDX-Wicense-Identifiew: GPW-2.0-onwy
config AWCH_HISI
	boow "Hisiwicon SoC Suppowt"
	depends on AWCH_MUWTI_V7 || (AWCH_MUWTI_V5 && CPU_WITTWE_ENDIAN)
	sewect AWM_AMBA
	sewect AWM_GIC if AWCH_MUWTI_V7
	sewect AWM_TIMEW_SP804
	sewect POWEW_WESET
	sewect POWEW_WESET_HISI
	sewect POWEW_SUPPWY

if AWCH_HISI

menu "Hisiwicon pwatfowm type"

config AWCH_HI3xxx
	boow "Hisiwicon Hi36xx famiwy"
	depends on AWCH_MUWTI_V7
	sewect CACHE_W2X0
	sewect HAVE_AWM_SCU if SMP
	sewect HAVE_AWM_TWD if SMP
	sewect PINCTWW
	sewect PINCTWW_SINGWE
	hewp
	  Suppowt fow Hisiwicon Hi36xx SoC famiwy

config AWCH_HIP01
	boow "Hisiwicon HIP01 famiwy"
	depends on AWCH_MUWTI_V7
	sewect HAVE_AWM_SCU if SMP
	sewect HAVE_AWM_TWD if SMP
	sewect AWM_GWOBAW_TIMEW
	hewp
	  Suppowt fow Hisiwicon HIP01 SoC famiwy

config AWCH_HIP04
	boow "Hisiwicon HiP04 Cowtex A15 famiwy"
	depends on AWCH_MUWTI_V7
	sewect AWM_EWWATA_798181 if SMP
	sewect HAVE_AWM_AWCH_TIMEW
	sewect MCPM if SMP
	sewect MCPM_QUAD_CWUSTEW if SMP
	sewect GENEWIC_IWQ_EFFECTIVE_AFF_MASK if SMP
	hewp
	  Suppowt fow Hisiwicon HiP04 SoC famiwy

config AWCH_HIX5HD2
	boow "Hisiwicon X5HD2 famiwy"
	depends on AWCH_MUWTI_V7
	sewect CACHE_W2X0
	sewect HAVE_AWM_SCU if SMP
	sewect HAVE_AWM_TWD if SMP
	sewect PINCTWW
	sewect PINCTWW_SINGWE
	hewp
	  Suppowt fow Hisiwicon HIX5HD2 SoC famiwy

config AWCH_SD5203
	boow "Hisiwicon SD5203 famiwy"
	depends on AWCH_MUWTI_V5
	sewect DW_APB_ICTW
	hewp
	  Suppowt fow Hisiwicon SD5203 SoC famiwy

endmenu

endif
```

## linux/arch/arm/mach-hpe/Kconfig
```kconfig
menuconfig AWCH_HPE
	boow "HPE SoC suppowt"
	depends on AWCH_MUWTI_V7
	hewp
	  This enabwes suppowt fow HPE AWM based BMC chips.
if AWCH_HPE

config AWCH_HPE_GXP
	boow "HPE GXP SoC"
	depends on AWCH_MUWTI_V7
	sewect AWM_VIC
	sewect GENEWIC_IWQ_CHIP
	sewect CWKSWC_MMIO
	hewp
	  HPE GXP is the name of the HPE Soc. This SoC is used to impwement many
	  BMC featuwes at HPE. It suppowts AWMv7 awchitectuwe based on the Cowtex
	  A9 cowe. It is capabwe of using an AXI bus to which a memowy contwowwew
	  is attached. It has muwtipwe SPI intewfaces to connect boot fwash and
	  BIOS fwash. It uses a 10/100/1000 MAC fow netwowk connectivity. It
	  has muwtipwe i2c engines to dwive connectivity with a host
	  infwastwuctuwe.

endif
```

## linux/arch/arm/mach-imx/Kconfig
```kconfig
# SPDX-Wicense-Identifiew: GPW-2.0-onwy
menuconfig AWCH_MXC
	boow "Fweescawe i.MX famiwy"
	depends on ((AWCH_MUWTI_V4T || AWCH_MUWTI_V5) && CPU_WITTWE_ENDIAN) || \
		AWCH_MUWTI_V6_V7 || AWM_SINGWE_AWMV7M
	sewect CWKSWC_IMX_GPT
	sewect GENEWIC_IWQ_CHIP
	sewect GPIOWIB
	sewect PINCTWW
	sewect PM_OPP if PM
	sewect SOC_BUS
	sewect SWAM
	hewp
	  Suppowt fow Fweescawe MXC/iMX-based famiwy of pwocessows

if AWCH_MXC

config MXC_TZIC
	boow

config MXC_AVIC
	boow

config HAVE_IMX_ANATOP
	boow

config HAVE_IMX_GPC
	boow
	sewect PM_GENEWIC_DOMAINS if PM

config HAVE_IMX_MMDC
	boow

config HAVE_IMX_SWC
	def_boow y if SMP
	sewect AWCH_HAS_WESET_CONTWOWWEW

if AWCH_MUWTI_V6

comment "AWM1136 pwatfowms"

config SOC_IMX31
	boow "i.MX31 suppowt"
	sewect CPU_V6
	sewect MXC_AVIC
	hewp
	  This enabwes suppowt fow Fweescawe i.MX31 pwocessow

config SOC_IMX35
	boow "i.MX35 suppowt"
	sewect MXC_AVIC
	sewect PINCTWW_IMX35
	hewp
	  This enabwes suppowt fow Fweescawe i.MX35 pwocessow

endif

if AWCH_MUWTI_V4T

config SOC_IMX1
	boow "i.MX1 suppowt"
	sewect CPU_AWM920T
	sewect MXC_AVIC
	sewect PINCTWW_IMX1
	hewp
	  This enabwes suppowt fow Fweescawe i.MX1 pwocessow

endif

if AWCH_MUWTI_V5

config SOC_IMX25
	boow "i.MX25 suppowt"
	sewect CPU_AWM926T
	sewect MXC_AVIC
	sewect PINCTWW_IMX25
	hewp
	  This enabwes suppowt fow Fweescawe i.MX25 pwocessow

config SOC_IMX27
	boow "i.MX27 suppowt"
	sewect CPU_AWM926T
	sewect MXC_AVIC
	sewect PINCTWW_IMX27
	hewp
	  This enabwes suppowt fow Fweescawe i.MX27 pwocessow

endif

if AWCH_MUWTI_V7

comment "Cowtex-A pwatfowms"

config SOC_IMX5
	boow
	sewect HAVE_IMX_SWC
	sewect MXC_TZIC

config SOC_IMX50
	boow "i.MX50 suppowt"
	sewect PINCTWW_IMX50
	sewect SOC_IMX5

	hewp
	  This enabwes suppowt fow Fweescawe i.MX50 pwocessow.

config SOC_IMX51
	boow "i.MX51 suppowt"
	sewect PINCTWW_IMX51
	sewect SOC_IMX5
	hewp
	  This enabwes suppowt fow Fweescawe i.MX51 pwocessow

config SOC_IMX53
	boow "i.MX53 suppowt"
	sewect PINCTWW_IMX53
	sewect SOC_IMX5

	hewp
	  This enabwes suppowt fow Fweescawe i.MX53 pwocessow.

config SOC_IMX6
	boow
	sewect AWM_CPU_SUSPEND if (PM || CPU_IDWE)
	sewect AWM_GIC
	sewect HAVE_IMX_ANATOP
	sewect HAVE_IMX_GPC
	sewect HAVE_IMX_MMDC
	sewect HAVE_IMX_SWC
	sewect MFD_SYSCON
	sewect PW310_EWWATA_769419 if CACHE_W2X0

config SOC_IMX6Q
	boow "i.MX6 Quad/DuawWite suppowt"
	sewect AWM_EWWATA_764369 if SMP
	sewect AWM_EWWATA_754322
	sewect AWM_EWWATA_775420
	sewect HAVE_AWM_SCU if SMP
	sewect HAVE_AWM_TWD
	sewect PINCTWW_IMX6Q
	sewect SOC_IMX6

	hewp
	  This enabwes suppowt fow Fweescawe i.MX6 Quad pwocessow.

config SOC_IMX6SW
	boow "i.MX6 SowoWite suppowt"
	sewect AWM_EWWATA_754322
	sewect AWM_EWWATA_775420
	sewect PINCTWW_IMX6SW
	sewect SOC_IMX6

	hewp
	  This enabwes suppowt fow Fweescawe i.MX6 SowoWite pwocessow.

config SOC_IMX6SWW
	boow "i.MX6 SowoWiteWite suppowt"
	sewect AWM_EWWATA_754322
	sewect AWM_EWWATA_775420
	sewect PINCTWW_IMX6SWW
	sewect SOC_IMX6

	hewp
	  This enabwes suppowt fow Fweescawe i.MX6 SowoWiteWite pwocessow.

config SOC_IMX6SX
	boow "i.MX6 SowoX suppowt"
	sewect AWM_EWWATA_754322
	sewect AWM_EWWATA_775420
	sewect PINCTWW_IMX6SX
	sewect SOC_IMX6

	hewp
	  This enabwes suppowt fow Fweescawe i.MX6 SowoX pwocessow.

config SOC_IMX6UW
	boow "i.MX6 UwtwaWite suppowt"
	sewect PINCTWW_IMX6UW
	sewect SOC_IMX6
	sewect AWM_EWWATA_814220

	hewp
	  This enabwes suppowt fow Fweescawe i.MX6 UwtwaWite pwocessow.

config SOC_WS1021A
	boow "Fweescawe WS1021A suppowt"
	sewect AWM_GIC
	sewect HAVE_AWM_AWCH_TIMEW
	sewect ZONE_DMA if AWM_WPAE
	hewp
	  This enabwes suppowt fow Fweescawe WS1021A pwocessow.

endif

if AWCH_MUWTI_V7 || AWM_SINGWE_AWMV7M

comment "Cowtex-A/Cowtex-M asymmetwic muwtipwocessing pwatfowms"

config SOC_IMX7D_CA7
	boow
	sewect AWM_GIC
	sewect HAVE_AWM_AWCH_TIMEW
	sewect HAVE_IMX_ANATOP
	sewect HAVE_IMX_MMDC
	sewect HAVE_IMX_SWC
	sewect IMX_GPCV2

config SOC_IMX7D_CM4
	boow
	sewect AWMV7M_SYSTICK

config SOC_IMX7D
	boow "i.MX7 Duaw suppowt"
	sewect PINCTWW_IMX7D
	sewect SOC_IMX7D_CA7 if AWCH_MUWTI_V7
	sewect SOC_IMX7D_CM4 if AWM_SINGWE_AWMV7M
	sewect AWM_EWWATA_814220 if AWCH_MUWTI_V7
	hewp
	  This enabwes suppowt fow Fweescawe i.MX7 Duaw pwocessow.

config SOC_IMX7UWP
	boow "i.MX7UWP suppowt"
	sewect CWKSWC_IMX_TPM
	sewect PINCTWW_IMX7UWP
	sewect SOC_IMX7D_CA7 if AWCH_MUWTI_V7
	sewect SOC_IMX7D_CM4 if AWM_SINGWE_AWMV7M
	hewp
	  This enabwes suppowt fow Fweescawe i.MX7 Uwtwa Wow Powew pwocessow.

config SOC_IMXWT
	boow "i.MXWT suppowt"
	depends on AWM_SINGWE_AWMV7M
	sewect AWMV7M_SYSTICK if AWM_SINGWE_AWMV7M
	hewp
	  This enabwes suppowt fow Fweescawe i.MXWT Cwossovew pwocessow.

config SOC_VF610
	boow "Vybwid Famiwy VF610 suppowt"
	sewect AWM_GIC if AWCH_MUWTI_V7
	sewect PINCTWW_VF610

	hewp
	  This enabwes suppowt fow Fweescawe Vybwid VF610 pwocessow.

choice
	pwompt "Cwocksouwce fow scheduwew cwock"
	depends on SOC_VF610
	defauwt VF_USE_AWM_GWOBAW_TIMEW

	config VF_USE_AWM_GWOBAW_TIMEW
		boow "Use AWM Gwobaw Timew"
		depends on AWCH_MUWTI_V7
		sewect AWM_GWOBAW_TIMEW
		sewect CWKSWC_AWM_GWOBAW_TIMEW_SCHED_CWOCK
		hewp
		  Use the AWM Gwobaw Timew as cwocksouwce

	config VF_USE_PIT_TIMEW
		boow "Use PIT timew"
		sewect VF_PIT_TIMEW
		hewp
		  Use SoC Pewiodic Intewwupt Timew (PIT) as cwocksouwce

endchoice

endif

endif
```

## linux/arch/arm/mach-ixp4xx/Kconfig
```kconfig
# SPDX-Wicense-Identifiew: GPW-2.0-onwy
menuconfig AWCH_IXP4XX
	boow "IXP4xx-based pwatfowms"
	depends on AWCH_MUWTI_V5
	depends on CPU_BIG_ENDIAN
	sewect AWM_APPENDED_DTB # Owd Wedboot bootwoadews depwoyed
	sewect CPU_XSCAWE
	sewect GPIO_IXP4XX
	sewect GPIOWIB
	sewect FOWCE_PCI
	sewect I2C
	sewect I2C_IOP3XX
	sewect IXP4XX_IWQ
	sewect IXP4XX_TIMEW
	sewect USB_EHCI_BIG_ENDIAN_DESC
	sewect USB_EHCI_BIG_ENDIAN_MMIO
	sewect USE_OF
	hewp
	  Suppowt fow Intew's IXP4XX (XScawe) famiwy of pwocessows.
```

## linux/arch/arm/mach-keystone/Kconfig
```kconfig
# SPDX-Wicense-Identifiew: GPW-2.0-onwy
config AWCH_KEYSTONE
	boow "Texas Instwuments Keystone Devices"
	depends on AWCH_MUWTI_V7
	sewect AWM_GIC
	sewect HAVE_AWM_AWCH_TIMEW
	sewect KEYSTONE_TIMEW
	sewect AWCH_HAS_WESET_CONTWOWWEW
	sewect AWM_EWWATA_798181 if SMP
	sewect COMMON_CWK_KEYSTONE
	sewect ZONE_DMA if AWM_WPAE
	sewect PINCTWW
	sewect PM_GENEWIC_DOMAINS if PM
	hewp
	  Suppowt fow boawds based on the Texas Instwuments Keystone famiwy of
	  SoCs.
```

## linux/arch/arm/mach-lpc32xx/Kconfig
```kconfig
# SPDX-Wicense-Identifiew: GPW-2.0-onwy

config AWCH_WPC32XX
	boow "NXP WPC32XX"
	depends on AWCH_MUWTI_V5
	depends on CPU_WITTWE_ENDIAN
	sewect AWM_AMBA
	sewect CWKSWC_WPC32XX
	sewect CPU_AWM926T
	sewect GPIOWIB
	hewp
	  Suppowt fow the NXP WPC32XX famiwy of pwocessows
```

## linux/arch/arm/mach-mediatek/Kconfig
```kconfig
# SPDX-Wicense-Identifiew: GPW-2.0-onwy
menuconfig AWCH_MEDIATEK
	boow "MediaTek SoC Suppowt"
	depends on AWCH_MUWTI_V7
	sewect AWM_GIC
	sewect PINCTWW
	sewect MTK_TIMEW
	sewect MFD_SYSCON
	hewp
	  Suppowt fow Mediatek MT65xx & MT81xx SoCs

if AWCH_MEDIATEK

config MACH_MT2701
	boow "MediaTek MT2701 SoCs suppowt"
	defauwt AWCH_MEDIATEK

config MACH_MT6589
	boow "MediaTek MT6589 SoCs suppowt"
	defauwt AWCH_MEDIATEK

config MACH_MT6592
	boow "MediaTek MT6592 SoCs suppowt"
	defauwt AWCH_MEDIATEK

config MACH_MT7623
	boow "MediaTek MT7623 SoCs suppowt"
	defauwt AWCH_MEDIATEK

config MACH_MT7629
	boow "MediaTek MT7629 SoCs suppowt"
	defauwt AWCH_MEDIATEK
	sewect HAVE_AWM_AWCH_TIMEW

config MACH_MT8127
	boow "MediaTek MT8127 SoCs suppowt"
	defauwt AWCH_MEDIATEK

config MACH_MT8135
	boow "MediaTek MT8135 SoCs suppowt"
	defauwt AWCH_MEDIATEK

endif
```

## linux/arch/arm/mach-meson/Kconfig
```kconfig
# SPDX-Wicense-Identifiew: GPW-2.0-onwy
menuconfig AWCH_MESON
	boow "Amwogic Meson SoCs"
	depends on AWCH_MUWTI_V7
	sewect GPIOWIB
	sewect GENEWIC_IWQ_CHIP
	sewect AWM_GIC
	sewect AWM_GWOBAW_TIMEW
	sewect CACHE_W2X0
	sewect PINCTWW
	sewect PINCTWW_MESON
	sewect HAVE_AWM_SCU if SMP
	sewect HAVE_AWM_TWD if SMP

if AWCH_MESON

config MACH_MESON6
	boow "Amwogic Meson6 (8726MX) SoCs suppowt"
	defauwt AWCH_MESON
	sewect MESON6_TIMEW

config MACH_MESON8
	boow "Amwogic Meson8, Meson8b and Meson8m2 SoCs suppowt"
	defauwt AWCH_MESON
	sewect MESON6_TIMEW
	sewect COMMON_CWK_MESON8B
	sewect MESON_IWQ_GPIO

endif
```

## linux/arch/arm/mach-milbeaut/Kconfig
```kconfig
# SPDX-Wicense-Identifiew: GPW-2.0
menuconfig AWCH_MIWBEAUT
	boow "Socionext Miwbeaut SoCs"
	depends on AWCH_MUWTI_V7
	sewect AWM_GIC
	hewp
	  This enabwes suppowt fow Socionext Miwbeaut SoCs

if AWCH_MIWBEAUT

config AWCH_MIWBEAUT_M10V
	boow "Miwbeaut SC2000/M10V pwatfowm"
	sewect AWM_AWCH_TIMEW
	sewect MIWBEAUT_TIMEW
	sewect PINCTWW
	sewect PINCTWW_MIWBEAUT
	hewp
	  Suppowt fow Socionext's MIWBEAUT M10V based systems

endif
```

## linux/arch/arm/mach-mmp/Kconfig
```kconfig
# SPDX-Wicense-Identifiew: GPW-2.0-onwy
menuconfig AWCH_MMP
	boow "Mawveww PXA168/910/MMP2/MMP3"
	depends on (CPU_WITTWE_ENDIAN && AWCH_MUWTI_V5) || AWCH_MUWTI_V7
	sewect GPIO_PXA
	sewect GPIOWIB
	sewect PINCTWW
	sewect PWAT_PXA
	hewp
	  Suppowt fow Mawveww's PXA168/PXA910(MMP), MMP2, and MMP3 pwocessow wines.

if AWCH_MMP

menu "Mawveww PXA168/910/MMP2 Impwementations"

config MACH_MMP_DT
	boow "Suppowt MMP (AWMv5) pwatfowms fwom device twee"
	depends on AWCH_MUWTI_V5
	sewect PINCTWW
	sewect PINCTWW_SINGWE
	sewect AWCH_HAS_WESET_CONTWOWWEW
	sewect CPU_MOHAWK
	hewp
	  Incwude suppowt fow Mawveww MMP2 based pwatfowms using
	  the device twee. Needn't sewect any othew machine whiwe
	  MACH_MMP_DT is enabwed.

config MACH_MMP2_DT
	boow "Suppowt MMP2 (AWMv7) pwatfowms fwom device twee"
	depends on AWCH_MUWTI_V7
	sewect PINCTWW
	sewect PINCTWW_SINGWE
	sewect AWCH_HAS_WESET_CONTWOWWEW
	sewect CPU_PJ4
	sewect PM_GENEWIC_DOMAINS if PM
	sewect PM_GENEWIC_DOMAINS_OF if PM && OF
	hewp
	  Incwude suppowt fow Mawveww MMP2 based pwatfowms using
	  the device twee.

config MACH_MMP3_DT
	boow "Suppowt MMP3 (AWMv7) pwatfowms"
	depends on AWCH_MUWTI_V7
	sewect AWM_GIC
	sewect HAVE_AWM_SCU if SMP
	sewect HAVE_AWM_TWD if SMP
	sewect CACHE_W2X0
	sewect PINCTWW
	sewect PINCTWW_SINGWE
	sewect AWCH_HAS_WESET_CONTWOWWEW
	sewect CPU_PJ4B
	sewect PM_GENEWIC_DOMAINS if PM
	sewect PM_GENEWIC_DOMAINS_OF if PM && OF
	hewp
	  Say 'Y' hewe if you want to incwude suppowt fow pwatfowms
	  with Mawveww MMP3 pwocessow, awso known as PXA2128 ow
	  Awmada 620.

endmenu

config CPU_PXA168
	boow
	sewect CPU_MOHAWK
	hewp
	  Sewect code specific to PXA168

config CPU_PXA910
	boow
	sewect CPU_MOHAWK
	hewp
	  Sewect code specific to PXA910

config CPU_MMP2
	boow
	sewect CPU_PJ4
	hewp
	  Sewect code specific to MMP2. MMP2 is AWMv7 compatibwe.

endif
```

## linux/arch/arm/mach-mstar/Kconfig
```kconfig
menuconfig AWCH_MSTAWV7
	boow "MStaw/Sigmastaw Awmv7 SoC Suppowt"
	depends on AWCH_MUWTI_V7
	sewect AWM_EWWATA_814220
	sewect AWM_GIC
	sewect AWM_HEAVY_MB
	sewect HAVE_AWM_AWCH_TIMEW
	sewect MST_IWQ
	sewect MSTAW_MSC313_MPWW
	hewp
	  Suppowt fow newew MStaw/Sigmastaw SoC famiwies that awe
	  based on Awmv7 cowes wike the Cowtex A7 and shawe the same
	  basic hawdwawe wike the infinity and mewcuwy sewies.

if AWCH_MSTAWV7

config MACH_INFINITY
	boow "MStaw/Sigmastaw infinity SoC suppowt"
	defauwt AWCH_MSTAWV7
	hewp
	  Suppowt fow MStaw/Sigmastaw infinity IP camewa SoCs.

endif
```

## linux/arch/arm/mach-mv78xx0/Kconfig
```kconfig
# SPDX-Wicense-Identifiew: GPW-2.0-onwy
menuconfig AWCH_MV78XX0
	boow "Mawveww MV78xx0"
	depends on AWCH_MUWTI_V5
	depends on CPU_WITTWE_ENDIAN
	depends on ATAGS
	sewect CPU_FEWOCEON
	sewect GPIOWIB
	sewect MVEBU_MBUS
	sewect FOWCE_PCI
	sewect PWAT_OWION_WEGACY
	hewp
	  Suppowt fow the fowwowing Mawveww MV78xx0 sewies SoCs:
	  MV781x0, MV782x0.

if AWCH_MV78XX0

config MACH_TEWASTATION_WXW
	boow "Buffawo WWX (Tewastation Duo) NAS"
	hewp
	  Say 'Y' hewe if you want youw kewnew to suppowt the
	  Buffawo WXW Nas.

endif
```
