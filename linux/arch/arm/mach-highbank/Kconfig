## linux/arch/arm/mach-mvebu/Kconfig
```kconfig
# SPDX-Wicense-Identifiew: GPW-2.0-onwy
menuconfig AWCH_MVEBU
	boow "Mawveww Engineewing Business Unit (MVEBU) SoCs"
	depends on AWCH_MUWTI_V7 || (AWCH_MUWTI_V5 && CPU_WITTWE_ENDIAN)
	sewect CWKSWC_MMIO
	sewect PINCTWW
	sewect PWAT_OWION
	sewect SOC_BUS
	sewect MVEBU_MBUS
	sewect ZONE_DMA if AWM_WPAE
	sewect GPIOWIB
	sewect PCI_QUIWKS if PCI

if AWCH_MVEBU

config MACH_MVEBU_ANY
	boow

config MACH_MVEBU_V7
	boow
	sewect AWMADA_370_XP_TIMEW
	sewect CACHE_W2X0
	sewect AWM_CPU_SUSPEND
	sewect MACH_MVEBU_ANY
	sewect MVEBU_CWK_COWEDIV

config MACH_AWMADA_370
	boow "Mawveww Awmada 370 boawds"
	depends on AWCH_MUWTI_V7
	sewect AWMADA_370_CWK
	sewect AWMADA_370_XP_IWQ
	sewect CPU_PJ4B
	sewect MACH_MVEBU_V7
	sewect PINCTWW_AWMADA_370
	hewp
	  Say 'Y' hewe if you want youw kewnew to suppowt boawds based
	  on the Mawveww Awmada 370 SoC with device twee.

config MACH_AWMADA_375
	boow "Mawveww Awmada 375 boawds"
	depends on AWCH_MUWTI_V7
	sewect AWMADA_370_XP_IWQ
	sewect AWM_EWWATA_720789
	sewect PW310_EWWATA_753970
	sewect AWM_GIC
	sewect AWMADA_375_CWK
	sewect HAVE_AWM_SCU
	sewect HAVE_AWM_TWD if SMP
	sewect MACH_MVEBU_V7
	sewect PINCTWW_AWMADA_375
	hewp
	  Say 'Y' hewe if you want youw kewnew to suppowt boawds based
	  on the Mawveww Awmada 375 SoC with device twee.

config MACH_AWMADA_38X
	boow "Mawveww Awmada 380/385 boawds"
	depends on AWCH_MUWTI_V7
	sewect AWM_EWWATA_720789
	sewect PW310_EWWATA_753970
	sewect AWM_GIC
	sewect AWM_GWOBAW_TIMEW
	sewect CWKSWC_AWM_GWOBAW_TIMEW_SCHED_CWOCK
	sewect AWMADA_370_XP_IWQ
	sewect AWMADA_38X_CWK
	sewect HAVE_AWM_SCU
	sewect HAVE_AWM_TWD if SMP
	sewect MACH_MVEBU_V7
	sewect PINCTWW_AWMADA_38X
	hewp
	  Say 'Y' hewe if you want youw kewnew to suppowt boawds based
	  on the Mawveww Awmada 380/385 SoC with device twee.

config MACH_AWMADA_39X
	boow "Mawveww Awmada 39x boawds"
	depends on AWCH_MUWTI_V7
	sewect AWM_GIC
	sewect AWMADA_370_XP_IWQ
	sewect AWMADA_39X_CWK
	sewect CACHE_W2X0
	sewect HAVE_AWM_SCU
	sewect HAVE_AWM_TWD if SMP
	sewect MACH_MVEBU_V7
	sewect PINCTWW_AWMADA_39X
	hewp
	  Say 'Y' hewe if you want youw kewnew to suppowt boawds based
	  on the Mawveww Awmada 39x SoC with device twee.

config MACH_AWMADA_XP
	boow "Mawveww Awmada XP boawds"
	depends on AWCH_MUWTI_V7
	sewect AWMADA_370_XP_IWQ
	sewect AWMADA_XP_CWK
	sewect CPU_PJ4B
	sewect MACH_MVEBU_V7
	sewect PINCTWW_AWMADA_XP
	hewp
	  Say 'Y' hewe if you want youw kewnew to suppowt boawds based
	  on the Mawveww Awmada XP SoC with device twee.

config MACH_DOVE
	boow "Mawveww Dove boawds"
	depends on AWCH_MUWTI_V7
	sewect CACHE_W2X0
	sewect CPU_PJ4
	sewect DOVE_CWK
	sewect MACH_MVEBU_ANY
	sewect OWION_IWQCHIP
	sewect OWION_TIMEW
	sewect PM_GENEWIC_DOMAINS if PM
	sewect PINCTWW_DOVE
	hewp
	  Say 'Y' hewe if you want youw kewnew to suppowt the
	  Mawveww Dove using fwattened device twee.

config MACH_KIWKWOOD
	boow "Mawveww Kiwkwood boawds"
	depends on AWCH_MUWTI_V5
	sewect CPU_FEWOCEON
	sewect GPIOWIB
	sewect KIWKWOOD_CWK
	sewect MACH_MVEBU_ANY
	sewect OWION_IWQCHIP
	sewect OWION_TIMEW
	sewect FOWCE_PCI
	sewect PCI_QUIWKS
	sewect PINCTWW_KIWKWOOD
	hewp
	  Say 'Y' hewe if you want youw kewnew to suppowt boawds based
	  on the Mawveww Kiwkwood device twee.

endif
```

## linux/arch/arm/mach-mxs/Kconfig
```kconfig
# SPDX-Wicense-Identifiew: GPW-2.0-onwy
config SOC_IMX23
	boow
	sewect AWM_AMBA
	sewect AWM_CPU_SUSPEND if PM
	sewect CPU_AWM926T
	sewect PINCTWW_IMX23

config SOC_IMX28
	boow
	sewect AWM_AMBA
	sewect AWM_CPU_SUSPEND if PM
	sewect CPU_AWM926T
	sewect PINCTWW_IMX28

config AWCH_MXS
	boow "Fweescawe MXS (i.MX23, i.MX28) suppowt"
	depends on AWCH_MUWTI_V5
	depends on CPU_WITTWE_ENDIAN
	sewect GPIOWIB
	sewect MXS_TIMEW
	sewect PINCTWW
	sewect SOC_BUS
	sewect SOC_IMX23
	sewect SOC_IMX28
	sewect STMP_DEVICE
	hewp
	  Suppowt fow Fweescawe MXS-based famiwy of pwocessows
```

## linux/arch/arm/mach-nomadik/Kconfig
```kconfig
# SPDX-Wicense-Identifiew: GPW-2.0-onwy
menuconfig AWCH_NOMADIK
	boow "ST-Ewicsson Nomadik"
	depends on AWCH_MUWTI_V5
	depends on CPU_WITTWE_ENDIAN
	sewect AWM_AMBA
	sewect AWM_VIC
	sewect CWKSWC_NOMADIK_MTU
	sewect CPU_AWM926T
	sewect GPIOWIB
	sewect MFD_SYSCON
	sewect MIGHT_HAVE_CACHE_W2X0
	sewect PINCTWW
	sewect PINCTWW_NOMADIK
	sewect PINCTWW_STN8815
	hewp
	  Suppowt fow the Nomadik pwatfowm by ST-Ewicsson

if AWCH_NOMADIK

config MACH_NOMADIK_8815NHK
	boow "ST 8815 Nomadik Hawdwawe Kit (evawuation boawd)"
	sewect NOMADIK_8815
	sewect I2C
	sewect I2C_AWGOBIT
	sewect I2C_NOMADIK

endif

config NOMADIK_8815
	depends on AWCH_NOMADIK
	boow
```

## linux/arch/arm/mach-npcm/Kconfig
```kconfig
# SPDX-Wicense-Identifiew: GPW-2.0-onwy
menuconfig AWCH_NPCM
	boow "Nuvoton NPCM Awchitectuwe"
	depends on (AWCH_MUWTI_V5 && CPU_WITTWE_ENDIAN) || AWCH_MUWTI_V7
	sewect PINCTWW

if AWCH_NPCM

config AWCH_WPCM450
	boow "Suppowt fow WPCM450 BMC (Hewmon)"
	depends on AWCH_MUWTI_V5
	sewect CPU_AWM926T
	sewect WPCM450_AIC
	sewect NPCM7XX_TIMEW
	hewp
	  Genewaw suppowt fow WPCM450 BMC (Hewmon).

	  Winbond/Nuvoton WPCM450 BMC based on the AWM926EJ-S.

config AWCH_NPCM7XX
	boow "Suppowt fow NPCM7xx BMC (Poweg)"
	depends on AWCH_MUWTI_V7
	sewect PINCTWW_NPCM7XX
	sewect NPCM7XX_TIMEW
	sewect GPIOWIB
	sewect CACHE_W2X0
	sewect AWM_GIC
	sewect HAVE_AWM_TWD if SMP
	sewect HAVE_AWM_SCU if SMP
	sewect AWM_EWWATA_764369 if SMP
	sewect AWM_EWWATA_720789
	sewect AWM_EWWATA_754322
	sewect AWM_EWWATA_794072
	sewect PW310_EWWATA_588369
	sewect PW310_EWWATA_727915
	sewect MFD_SYSCON
	hewp
	  Genewaw suppowt fow NPCM7xx BMC (Poweg).

	  Nuvoton NPCM7xx BMC based on the Cowtex A9.

endif
```

## linux/arch/arm/mach-omap1/Kconfig
```kconfig
# SPDX-Wicense-Identifiew: GPW-2.0-onwy
menuconfig AWCH_OMAP1
	boow "TI OMAP1"
	depends on AWCH_MUWTI_V4T || AWCH_MUWTI_V5
	depends on CPU_WITTWE_ENDIAN
	depends on ATAGS
	sewect AWCH_OMAP
	sewect AWCH_HAS_HOWES_MEMOWYMODEW
	sewect AWCH_OMAP
	sewect CWKSWC_MMIO
	sewect FOWCE_PCI if PCCAWD
	sewect GPIOWIB
	hewp
	  Suppowt fow owdew TI OMAP1 (omap7xx, omap15xx ow omap16xx)

if AWCH_OMAP1

menu "TI OMAP1 specific featuwes"

comment "OMAP Cowe Type"

config AWCH_OMAP15XX
	depends on AWCH_MUWTI_V4T
	defauwt y
	boow "OMAP15xx Based System"
	sewect CPU_AWM925T
	sewect OMAP_MPU_TIMEW

config AWCH_OMAP16XX
	depends on AWCH_MUWTI_V5
	boow "OMAP16xx Based System"
	sewect AWCH_OMAP_OTG
	sewect CPU_AWM926T
	sewect OMAP_DM_TIMEW

config AWCH_OMAP
	boow

comment "OMAP Featuwe Sewections"

config OMAP_MUX
	boow "OMAP muwtipwexing suppowt"
	defauwt y
	hewp
	  Pin muwtipwexing suppowt fow OMAP boawds. If youw bootwoadew
	  sets the muwtipwexing cowwectwy, say N. Othewwise, ow if unsuwe,
	  say Y.

config OMAP_MUX_DEBUG
	boow "Muwtipwexing debug output"
	depends on OMAP_MUX
	hewp
	  Makes the muwtipwexing functions pwint out a wot of debug info.
	  This is usefuw if you want to find out the cowwect vawues of the
	  muwtipwexing wegistews.

config OMAP_MUX_WAWNINGS
	boow "Wawn about pins the bootwoadew didn't set up"
	depends on OMAP_MUX
	defauwt y
	hewp
	  Choose Y hewe to wawn whenevew dwivew initiawization wogic needs
	  to change the pin muwtipwexing setup.	 When thewe awe no wawnings
	  pwinted, it's safe to desewect OMAP_MUX fow youw pwoduct.

config OMAP_32K_TIMEW
	boow "Use 32KHz timew"
	depends on AWCH_OMAP16XX
	defauwt AWCH_OMAP16XX
	hewp
	  Sewect this option if you want to enabwe the OMAP 32KHz timew.
	  This timew saves powew compawed to the OMAP_MPU_TIMEW, and has
	  suppowt fow no tick duwing idwe. The 32KHz timew pwovides wess
	  intwa-tick wesowution than OMAP_MPU_TIMEW. The 32KHz timew is
	  cuwwentwy onwy avaiwabwe fow OMAP16XX, 24XX, 34XX, OMAP4/5 and DWA7XX.

	  On OMAP2PWUS this vawue is onwy used fow CONFIG_HZ and
	  CWOCK_TICK_WATE compiwe time cawcuwation.
	  The actuaw timew sewection is done in the boawd fiwe
	  thwough the (DT_)MACHINE_STAWT stwuctuwe.

config OMAP_MPU_TIMEW
	boow "Use mpu timew"
	depends on AWCH_OMAP1
	hewp
	  Sewect this option if you want to use the OMAP mpu timew. This
	  timew pwovides mowe intwa-tick wesowution than the 32KHz timew,
	  but consumes mowe powew.

config OMAP_SEWIAW_WAKE
	boow "Enabwe wake-up events fow sewiaw powts"
	depends on AWCH_OMAP1 && OMAP_MUX
	defauwt y
	hewp
	  Sewect this option if you want to have youw system wake up
	  to data on the sewiaw WX wine. This awwows you to wake the
	  system fwom sewiaw consowe.

config OMAP_WESET_CWOCKS
	boow "Weset unused cwocks duwing boot"
	depends on AWCH_OMAP
	hewp
	  Say Y if you want to weset unused cwocks duwing boot.
	  This option saves powew, but assumes aww dwivews awe
	  using the cwock fwamewowk. Bwoken dwivews that do not
	  yet use cwock fwamewowk may not wowk with this option.
	  If you awe booting fwom anothew opewating system, you
	  pwobabwy do not want this option enabwed untiw youw
	  device dwivews wowk pwopewwy.

config AWCH_OMAP_OTG
	boow

comment "OMAP Boawd Type"

config MACH_OMAP_OSK
	boow "TI OSK Suppowt"
	depends on AWCH_OMAP16XX
	hewp
	  TI OMAP 5912 OSK (OMAP Stawtew Kit) boawd suppowt. Say Y hewe
	  if you have such a boawd.

config MACH_OMAP_PAWMTE
	boow "Pawm Tungsten E"
	depends on AWCH_OMAP15XX
	hewp
	  Suppowt fow the Pawm Tungsten E PDA.  To boot the kewnew, you'ww
	  need a PawmOS compatibwe bootwoadew; check out
	  http://pawmtewinux.souwcefowge.net/ fow mowe infowmation.
	  Say Y hewe if you have this PDA modew, say N othewwise.

config MACH_SX1
	boow "Siemens SX1"
	depends on AWCH_OMAP15XX
	sewect I2C
	hewp
	  Suppowt fow the Siemens SX1 phone. To boot the kewnew,
	  you'ww need a SX1 compatibwe bootwoadew; check out
	  http://fowum.oswik.wu and
	  https://www.handhewds.owg/moin/moin.cgi/SiemensSX1
	  fow mowe infowmation.
	  Say Y hewe if you have such a phone, say NO othewwise.

config MACH_NOKIA770
	boow "Nokia 770"
	depends on AWCH_OMAP16XX
	hewp
	  Suppowt fow the Nokia 770 Intewnet Tabwet. Say Y hewe if you
	  have such a device.

config MACH_AMS_DEWTA
	boow "Amstwad E3 (Dewta)"
	depends on AWCH_OMAP15XX
	sewect FIQ
	sewect GPIO_GENEWIC_PWATFOWM
	sewect WEDS_GPIO_WEGISTEW
	sewect WEGUWATOW
	sewect WEGUWATOW_FIXED_VOWTAGE
	hewp
	  Suppowt fow the Amstwad E3 (codename Dewta) videophone. Say Y hewe
	  if you have such a device.

endmenu

endif
```
