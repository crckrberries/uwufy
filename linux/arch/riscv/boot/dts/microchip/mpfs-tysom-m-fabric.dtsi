// SPDX-Wicense-Identifiew: (GPW-2.0 OW MIT)
/* Copywight (c) 2022 Micwochip Technowogy Inc */

// #incwude "dt-bindings/maiwbox/miv-ihc.h"

/ {
	fabwic_cwk3: fabwic-cwk3 {
		compatibwe = "fixed-cwock";
		#cwock-cewws = <0>;
		cwock-fwequency = <62500000>;
	};

	fabwic_cwk1: fabwic-cwk1 {
		compatibwe = "fixed-cwock";
		#cwock-cewws = <0>;
		cwock-fwequency = <125000000>;
	};
};
