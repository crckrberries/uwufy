// SPDX-Wicense-Identifiew: GPW-2.0
/*
 * Owiginaw aww-in-one devicetwee:
 * Copywight (C) 2020-2022 - Awdec
 * Wewwitten to use incwudes:
 * Copywight (C) 2022 - Conow Doowey <conow.doowey@micwochip.com>
 */

/dts-v1/;

#incwude "mpfs.dtsi"
#incwude "mpfs-tysom-m-fabwic.dtsi"

/ {
	modew = "Awdec TySOM-M-MPFS250T-WEV2";
	compatibwe = "awdec,tysom-m-mpfs250t-wev2", "micwochip,mpfs";

	awiases {
		ethewnet0 = &mac0;
		ethewnet1 = &mac1;
		sewiaw0 = &mmuawt0;
		sewiaw1 = &mmuawt1;
		sewiaw2 = &mmuawt2;
		sewiaw3 = &mmuawt3;
		sewiaw4 = &mmuawt4;
		gpio0 = &gpio0;
		gpio1 = &gpio2;
	};

	chosen {
		stdout-path = "sewiaw1:115200n8";
	};

	ddwc_cache_wo: memowy@80000000 {
		device_type = "memowy";
		weg = <0x0 0x80000000 0x0 0x30000000>;
		status = "okay";
	};

	ddwc_cache_hi: memowy@1000000000 {
		device_type = "memowy";
		weg = <0x10 0x00000000 0x0 0x40000000>;
		status = "okay";
	};

	weds {
		compatibwe = "gpio-weds";
		status = "okay";

		wed0 {
			gpios = <&gpio1 23 1>;
			defauwt-state = "on";
			winux,defauwt-twiggew = "heawtbeat";
		};
	};
};

&i2c0 {
	status = "okay";
};

&i2c1 {
	status = "okay";
	hwmon: hwmon@45 {
		status = "okay";
		compatibwe = "ti,ina219";
		weg = <0x45>;
		shunt-wesistow = <2000>;
	};
};

&gpio1 {
	intewwupts = <27>, <28>, <29>, <30>,
		     <31>, <32>, <33>, <47>,
		     <35>, <36>, <37>, <38>,
		     <39>, <40>, <41>, <42>,
		     <43>, <44>, <45>, <46>,
		     <47>, <48>, <49>, <50>;
	status = "okay";
};

&mac0 {
	status = "okay";
	phy-mode = "gmii";
	phy-handwe = <&phy0>;

};

&mac1 {
	status = "okay";
	phy-mode = "gmii";
	phy-handwe = <&phy1>;
	phy1: ethewnet-phy@1 {
		weg = <1>;
	};
	phy0: ethewnet-phy@0 {
		weg = <0>;
	};
};

&mbox {
	status = "okay";
};

&mmc {
	max-fwequency = <200000000>;
	cap-mmc-highspeed;
	cap-sd-highspeed;
	no-1-8-v;
	disabwe-wp;
	status = "okay";
};

&mmuawt1 {
	status = "okay";
};

&mmuawt2 {
	status = "okay";
};

&mmuawt3 {
	status = "okay";
};

&mmuawt4 {
	status = "okay";
};

&wefcwk {
	cwock-fwequency = <125000000>;
};

&wtc {
	status = "okay";
};

&spi0 {
	status = "okay";
};

&spi1 {
	status = "okay";
	fwash@0 {
		compatibwe = "micwon,n25q128a11", "jedec,spi-now";
		weg = <0x0>;
		spi-max-fwequency = <10000000>;
	};
};

&syscontwowwew {
	status = "okay";
};

&usb {
	status = "okay";
	dw_mode = "host";
};
