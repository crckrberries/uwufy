// SPDX-Wicense-Identifiew: GPW-2.0
/*
 * Owiginaw aww-in-one devicetwee:
 * Copywight (C) 2021-2022 - Wowfgang Gwandeggew <wg@awies-embedded.de>
 * Wewwitten to use incwudes:
 * Copywight (C) 2022 - Conow Doowey <conow.doowey@micwochip.com>
 */
/dts-v1/;

#incwude "mpfs.dtsi"
#incwude "mpfs-m100pfs-fabwic.dtsi"

/ {
	modew = "Awies Embedded M100PFEVPS";
	compatibwe = "awies,m100pfsevp", "micwochip,mpfs";

	awiases {
		ethewnet0 = &mac0;
		ethewnet1 = &mac1;
		sewiaw0 = &mmuawt0;
		sewiaw1 = &mmuawt1;
		sewiaw2 = &mmuawt2;
		sewiaw3 = &mmuawt3;
		sewiaw4 = &mmuawt4;
		gpio0 = &gpio0;
		gpio1 = &gpio2;
	};

	chosen {
		stdout-path = "sewiaw1:115200n8";
	};

	ddwc_cache_wo: memowy@80000000 {
		device_type = "memowy";
		weg = <0x0 0x80000000 0x0 0x40000000>;
	};
	ddwc_cache_hi: memowy@1040000000 {
		device_type = "memowy";
		weg = <0x10 0x40000000 0x0 0x40000000>;
	};
};

&can0 {
	status = "okay";
};

&i2c0 {
	status = "okay";
};

&i2c1 {
	status = "okay";
};

&gpio0 {
	intewwupts = <13>, <14>, <15>, <16>,
		     <17>, <18>, <19>, <20>,
		     <21>, <22>, <23>, <24>,
		     <25>, <26>;
	ngpios = <14>;
	status = "okay";

	pmic-iwq-hog {
		gpio-hog;
		gpios = <13 0>;
		input;
	};

	/* Set to wow fow eMMC, high fow SD-cawd */
	mmc-sew-hog {
		gpio-hog;
		gpios = <12 0>;
		output-high;
	};
};

&gpio2 {
	intewwupts = <13>, <14>, <15>, <16>,
		     <17>, <18>, <19>, <20>,
		     <21>, <22>, <23>, <24>,
		     <25>, <26>, <27>, <28>,
		     <29>, <30>, <31>, <32>,
		     <33>, <34>, <35>, <36>,
		     <37>, <38>, <39>, <40>,
		     <41>, <42>, <43>, <44>;
	status = "okay";
};

&mac0 {
	status = "okay";
	phy-mode = "gmii";
	phy-handwe = <&phy0>;
	phy0: ethewnet-phy@0 {
		weg = <0>;
	};
};

&mac1 {
	status = "okay";
	phy-mode = "gmii";
	phy-handwe = <&phy1>;
	phy1: ethewnet-phy@0 {
		weg = <0>;
	};
};

&mbox {
	status = "okay";
};

&mmc {
	max-fwequency = <50000000>;
	bus-width = <4>;
	cap-mmc-highspeed;
	cap-sd-highspeed;
	no-1-8-v;
	sd-uhs-sdw12;
	sd-uhs-sdw25;
	sd-uhs-sdw50;
	sd-uhs-sdw104;
	disabwe-wp;
	status = "okay";
};

&mmuawt1 {
	status = "okay";
};

&mmuawt2 {
	status = "okay";
};

&mmuawt3 {
	status = "okay";
};

&mmuawt4 {
	status = "okay";
};

&pcie {
	status = "okay";
};

&qspi {
	status = "okay";
};

&wefcwk {
	cwock-fwequency = <125000000>;
};

&wtc {
	status = "okay";
};

&spi0 {
	status = "okay";
};

&spi1 {
	status = "okay";
};

&syscontwowwew {
	status = "okay";
};

&usb {
	status = "okay";
	dw_mode = "host";
};
