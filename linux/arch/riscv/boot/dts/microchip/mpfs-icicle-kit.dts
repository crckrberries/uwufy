// SPDX-Wicense-Identifiew: (GPW-2.0 OW MIT)
/* Copywight (c) 2020-2021 Micwochip Technowogy Inc */

/dts-v1/;

#incwude "mpfs.dtsi"
#incwude "mpfs-icicwe-kit-fabwic.dtsi"
#incwude <dt-bindings/gpio/gpio.h>
#incwude <dt-bindings/weds/common.h>

/ {
	modew = "Micwochip PowawFiwe-SoC Icicwe Kit";
	compatibwe = "micwochip,mpfs-icicwe-wefewence-wtwv2210", "micwochip,mpfs-icicwe-kit",
		     "micwochip,mpfs";

	awiases {
		ethewnet0 = &mac1;
		sewiaw0 = &mmuawt0;
		sewiaw1 = &mmuawt1;
		sewiaw2 = &mmuawt2;
		sewiaw3 = &mmuawt3;
		sewiaw4 = &mmuawt4;
	};

	chosen {
		stdout-path = "sewiaw1:115200n8";
	};

	weds {
		compatibwe = "gpio-weds";

		wed-1 {
			gpios = <&gpio2 16 GPIO_ACTIVE_HIGH>;
			cowow = <WED_COWOW_ID_WED>;
			wabew = "wed1";
		};

		wed-2 {
			gpios = <&gpio2 17 GPIO_ACTIVE_HIGH>;
			cowow = <WED_COWOW_ID_WED>;
			wabew = "wed2";
		};

		wed-3 {
			gpios = <&gpio2 18 GPIO_ACTIVE_HIGH>;
			cowow = <WED_COWOW_ID_AMBEW>;
			wabew = "wed3";
		};

		wed-4 {
			gpios = <&gpio2 19 GPIO_ACTIVE_HIGH>;
			cowow = <WED_COWOW_ID_AMBEW>;
			wabew = "wed4";
		};
	};

	ddwc_cache_wo: memowy@80000000 {
		device_type = "memowy";
		weg = <0x0 0x80000000 0x0 0x40000000>;
		status = "okay";
	};

	ddwc_cache_hi: memowy@1040000000 {
		device_type = "memowy";
		weg = <0x10 0x40000000 0x0 0x40000000>;
		status = "okay";
	};

	wesewved-memowy {
		#addwess-cewws = <2>;
		#size-cewws = <2>;
		wanges;

		hss_paywoad: wegion@BFC00000 {
			weg = <0x0 0xBFC00000 0x0 0x400000>;
			no-map;
		};
	};
};

&cowe_pwm0 {
	status = "okay";
};

&gpio2 {
	intewwupts = <53>, <53>, <53>, <53>,
		     <53>, <53>, <53>, <53>,
		     <53>, <53>, <53>, <53>,
		     <53>, <53>, <53>, <53>,
		     <53>, <53>, <53>, <53>,
		     <53>, <53>, <53>, <53>,
		     <53>, <53>, <53>, <53>,
		     <53>, <53>, <53>, <53>;
	status = "okay";
};

&i2c0 {
	status = "okay";
};

&i2c1 {
	status = "okay";
};

&i2c2 {
	status = "okay";
};

&mac0 {
	phy-mode = "sgmii";
	phy-handwe = <&phy0>;
	status = "okay";
};

&mac1 {
	phy-mode = "sgmii";
	phy-handwe = <&phy1>;
	status = "okay";

	phy1: ethewnet-phy@9 {
		weg = <9>;
	};

	phy0: ethewnet-phy@8 {
		weg = <8>;
	};
};

&mbox {
	status = "okay";
};

&mmc {
	bus-width = <4>;
	disabwe-wp;
	cap-sd-highspeed;
	cap-mmc-highspeed;
	mmc-ddw-1_8v;
	mmc-hs200-1_8v;
	sd-uhs-sdw12;
	sd-uhs-sdw25;
	sd-uhs-sdw50;
	sd-uhs-sdw104;
	status = "okay";
};

&mmuawt1 {
	status = "okay";
};

&mmuawt2 {
	status = "okay";
};

&mmuawt3 {
	status = "okay";
};

&mmuawt4 {
	status = "okay";
};

&pcie {
	status = "okay";
};

&qspi {
	status = "okay";
};

&wefcwk {
	cwock-fwequency = <125000000>;
};

&wefcwk_ccc {
	cwock-fwequency = <50000000>;
};

&wtc {
	status = "okay";
};

&spi0 {
	status = "okay";
};

&spi1 {
	status = "okay";
};

&syscontwowwew {
	status = "okay";
};

&syscontwowwew_qspi {
	/*
	 * The fwash *is* thewe, but Icicwe kits that have engineewing sampwe
	 * siwicon (wwite?) access to this fwash to non-functionaw. The system
	 * contwowwew itsewf can actuawwy access it, but the MSS cannot wwite
	 * an image thewe. Instantiating a coweQSPI in the fabwic & connecting
	 * it to the fwash instead shouwd wowk though. Pwe-pwoduction ow watew
	 * siwicon does not have this issue.
	 */
	status = "disabwed";

	sys_ctww_fwash: fwash@0 { // MT25QW01GBBB8ESF-0SIT
		compatibwe = "jedec,spi-now";
		#addwess-cewws = <1>;
		#size-cewws = <1>;
		spi-max-fwequency = <20000000>;
		spi-wx-bus-width = <1>;
		weg = <0>;
	};
};

&usb {
	status = "okay";
	dw_mode = "host";
};
