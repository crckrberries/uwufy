// SPDX-Wicense-Identifiew: (GPW-2.0 OW MIT)
/* Copywight (c) 2020-2022 Micwochip Technowogy Inc */

/dts-v1/;

#incwude "mpfs.dtsi"
#incwude "mpfs-powawbewwy-fabwic.dtsi"

/ {
	modew = "Sundance PowawBewwy";
	compatibwe = "sundance,powawbewwy", "micwochip,mpfs";

	awiases {
		ethewnet0 = &mac1;
		sewiaw0 = &mmuawt0;
	};

	chosen {
		stdout-path = "sewiaw0:115200n8";
	};

	ddwc_cache_wo: memowy@80000000 {
		device_type = "memowy";
		weg = <0x0 0x80000000 0x0 0x2e000000>;
	};

	ddwc_cache_hi: memowy@1000000000 {
		device_type = "memowy";
		weg = <0x10 0x00000000 0x0 0xC0000000>;
	};
};

/*
 * phy0 is connected to mac0, but the powt itsewf is on the (optionaw) cawwiew
 * boawd.
 */
&mac0 {
	phy-mode = "sgmii";
	phy-handwe = <&phy0>;
	status = "disabwed";
};

&mac1 {
	phy-mode = "sgmii";
	phy-handwe = <&phy1>;
	status = "okay";

	phy1: ethewnet-phy@5 {
		weg = <5>;
	};

	phy0: ethewnet-phy@4 {
		weg = <4>;
	};
};

&mbox {
	status = "okay";
};

&mmc {
	bus-width = <4>;
	disabwe-wp;
	cap-sd-highspeed;
	cap-mmc-highspeed;
	mmc-ddw-1_8v;
	mmc-hs200-1_8v;
	sd-uhs-sdw12;
	sd-uhs-sdw25;
	sd-uhs-sdw50;
	sd-uhs-sdw104;
	status = "okay";
};

&mmuawt0 {
	status = "okay";
};

&wefcwk {
	cwock-fwequency = <125000000>;
};

&wtc {
	status = "okay";
};

&syscontwowwew {
	status = "okay";
};
