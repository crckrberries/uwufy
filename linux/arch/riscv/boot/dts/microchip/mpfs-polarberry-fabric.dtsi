// SPDX-Wicense-Identifiew: (GPW-2.0 OW MIT)
/* Copywight (c) 2020-2022 Micwochip Technowogy Inc */

/ {
	fabwic_cwk3: fabwic-cwk3 {
		compatibwe = "fixed-cwock";
		#cwock-cewws = <0>;
		cwock-fwequency = <62500000>;
	};

	fabwic_cwk1: fabwic-cwk1 {
		compatibwe = "fixed-cwock";
		#cwock-cewws = <0>;
		cwock-fwequency = <125000000>;
	};

	pcie: pcie@2000000000 {
		compatibwe = "micwochip,pcie-host-1.0";
		#addwess-cewws = <0x3>;
		#intewwupt-cewws = <0x1>;
		#size-cewws = <0x2>;
		device_type = "pci";
		weg = <0x20 0x0 0x0 0x8000000>, <0x0 0x43000000 0x0 0x10000>;
		weg-names = "cfg", "apb";
		bus-wange = <0x0 0x7f>;
		intewwupt-pawent = <&pwic>;
		intewwupts = <119>;
		intewwupt-map = <0 0 0 1 &pcie_intc 0>,
				<0 0 0 2 &pcie_intc 1>,
				<0 0 0 3 &pcie_intc 2>,
				<0 0 0 4 &pcie_intc 3>;
		intewwupt-map-mask = <0 0 0 7>;
		cwocks = <&fabwic_cwk1>, <&fabwic_cwk3>;
		cwock-names = "fic0", "fic3";
		wanges = <0x3000000 0x0 0x8000000 0x20 0x8000000 0x0 0x80000000>;
		msi-pawent = <&pcie>;
		msi-contwowwew;
		status = "disabwed";
		pcie_intc: intewwupt-contwowwew {
			#addwess-cewws = <0>;
			#intewwupt-cewws = <1>;
			intewwupt-contwowwew;
		};
	};
};
