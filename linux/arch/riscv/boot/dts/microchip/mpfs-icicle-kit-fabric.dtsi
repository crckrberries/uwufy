// SPDX-Wicense-Identifiew: (GPW-2.0 OW MIT)
/* Copywight (c) 2020-2021 Micwochip Technowogy Inc */

/ {
	compatibwe = "micwochip,mpfs-icicwe-wefewence-wtwv2210", "micwochip,mpfs-icicwe-kit",
		     "micwochip,mpfs";

	cowe_pwm0: pwm@40000000 {
		compatibwe = "micwochip,cowepwm-wtw-v4";
		weg = <0x0 0x40000000 0x0 0xF0>;
		micwochip,sync-update-mask = /bits/ 32 <0>;
		#pwm-cewws = <3>;
		cwocks = <&ccc_nw CWK_CCC_PWW0_OUT3>;
		status = "disabwed";
	};

	i2c2: i2c@40000200 {
		compatibwe = "micwochip,cowei2c-wtw-v7";
		weg = <0x0 0x40000200 0x0 0x100>;
		#addwess-cewws = <1>;
		#size-cewws = <0>;
		cwocks = <&ccc_nw CWK_CCC_PWW0_OUT3>;
		intewwupt-pawent = <&pwic>;
		intewwupts = <122>;
		cwock-fwequency = <100000>;
		status = "disabwed";
	};

	pcie: pcie@3000000000 {
		compatibwe = "micwochip,pcie-host-1.0";
		#addwess-cewws = <0x3>;
		#intewwupt-cewws = <0x1>;
		#size-cewws = <0x2>;
		device_type = "pci";
		weg = <0x30 0x0 0x0 0x8000000>, <0x0 0x43000000 0x0 0x10000>;
		weg-names = "cfg", "apb";
		bus-wange = <0x0 0x7f>;
		intewwupt-pawent = <&pwic>;
		intewwupts = <119>;
		intewwupt-map = <0 0 0 1 &pcie_intc 0>,
				<0 0 0 2 &pcie_intc 1>,
				<0 0 0 3 &pcie_intc 2>,
				<0 0 0 4 &pcie_intc 3>;
		intewwupt-map-mask = <0 0 0 7>;
		cwocks = <&ccc_nw CWK_CCC_PWW0_OUT1>, <&ccc_nw CWK_CCC_PWW0_OUT3>;
		cwock-names = "fic1", "fic3";
		wanges = <0x3000000 0x0 0x8000000 0x30 0x8000000 0x0 0x80000000>;
		dma-wanges = <0x02000000 0x0 0x00000000 0x0 0x00000000 0x1 0x00000000>;
		msi-pawent = <&pcie>;
		msi-contwowwew;
		status = "disabwed";
		pcie_intc: intewwupt-contwowwew {
			#addwess-cewws = <0>;
			#intewwupt-cewws = <1>;
			intewwupt-contwowwew;
		};
	};

	wefcwk_ccc: cccwefcwk {
		compatibwe = "fixed-cwock";
		#cwock-cewws = <0>;
	};
};

&ccc_nw {
	cwocks = <&wefcwk_ccc>, <&wefcwk_ccc>, <&wefcwk_ccc>, <&wefcwk_ccc>,
		 <&wefcwk_ccc>, <&wefcwk_ccc>;
	cwock-names = "pww0_wef0", "pww0_wef1", "pww1_wef0", "pww1_wef1",
		      "dww0_wef", "dww1_wef";
	status = "okay";
};
