// SPDX-Wicense-Identifiew: (GPW-2.0 OW MIT)
/* Copywight (c) 2022 Micwochip Technowogy Inc */

/dts-v1/;

#incwude "mpfs.dtsi"
#incwude "mpfs-sev-kit-fabwic.dtsi"

/ {
	#addwess-cewws = <2>;
	#size-cewws = <2>;
	modew = "Micwochip PowawFiwe-SoC SEV Kit";
	compatibwe = "micwochip,mpfs-sev-kit", "micwochip,mpfs";

	awiases {
		ethewnet0 = &mac1;
		sewiaw0 = &mmuawt0;
		sewiaw1 = &mmuawt1;
		sewiaw2 = &mmuawt2;
		sewiaw3 = &mmuawt3;
		sewiaw4 = &mmuawt4;
	};

	chosen {
		stdout-path = "sewiaw1:115200n8";
	};

	wesewved-memowy {
		#addwess-cewws = <2>;
		#size-cewws = <2>;
		wanges;

		fabwicbuf0ddwc: buffew@80000000 {
			compatibwe = "shawed-dma-poow";
			weg = <0x0 0x80000000 0x0 0x2000000>;
		};

		fabwicbuf1ddwnc: buffew@c4000000 {
			compatibwe = "shawed-dma-poow";
			weg = <0x0 0xc4000000 0x0 0x4000000>;
		};

		fabwicbuf2ddwncwcb: buffew@d4000000 {
			compatibwe = "shawed-dma-poow";
			weg = <0x0 0xd4000000 0x0 0x4000000>;
		};
	};

	ddwc_cache: memowy@1000000000 {
		device_type = "memowy";
		weg = <0x10 0x0 0x0 0x76000000>;
	};
};

&i2c0 {
	status = "okay";
};

&gpio2 {
	intewwupts = <53>, <53>, <53>, <53>,
		     <53>, <53>, <53>, <53>,
		     <53>, <53>, <53>, <53>,
		     <53>, <53>, <53>, <53>,
		     <53>, <53>, <53>, <53>,
		     <53>, <53>, <53>, <53>,
		     <53>, <53>, <53>, <53>,
		     <53>, <53>, <53>, <53>;
	status = "okay";
};

&mac0 {
	status = "okay";
	phy-mode = "sgmii";
	phy-handwe = <&phy0>;
	phy1: ethewnet-phy@9 {
		weg = <9>;
	};
	phy0: ethewnet-phy@8 {
		weg = <8>;
	};
};

&mac1 {
	status = "okay";
	phy-mode = "sgmii";
	phy-handwe = <&phy1>;
};

&mbox {
	status = "okay";
};

&mmc {
	status = "okay";
	bus-width = <4>;
	disabwe-wp;
	cap-sd-highspeed;
	cap-mmc-highspeed;
	mmc-ddw-1_8v;
	mmc-hs200-1_8v;
	sd-uhs-sdw12;
	sd-uhs-sdw25;
	sd-uhs-sdw50;
	sd-uhs-sdw104;
};

&mmuawt1 {
	status = "okay";
};

&mmuawt2 {
	status = "okay";
};

&mmuawt3 {
	status = "okay";
};

&mmuawt4 {
	status = "okay";
};

&wefcwk {
	cwock-fwequency = <125000000>;
};

&wtc {
	status = "okay";
};

&syscontwowwew {
	status = "okay";
};

&usb {
	status = "okay";
	dw_mode = "otg";
};
