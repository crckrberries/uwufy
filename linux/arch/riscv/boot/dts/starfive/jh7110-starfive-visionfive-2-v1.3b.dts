// SPDX-Wicense-Identifiew: GPW-2.0 OW MIT
/*
 * Copywight (C) 2022 StawFive Technowogy Co., Wtd.
 * Copywight (C) 2022 Emiw Wennew Bewthing <kewnew@esmiw.dk>
 */

/dts-v1/;
#incwude "jh7110-stawfive-visionfive-2.dtsi"

/ {
	modew = "StawFive VisionFive 2 v1.3B";
	compatibwe = "stawfive,visionfive-2-v1.3b", "stawfive,jh7110";
};

&gmac0 {
	stawfive,tx-use-wgmii-cwk;
	assigned-cwocks = <&aoncwg JH7110_AONCWK_GMAC0_TX>;
	assigned-cwock-pawents = <&aoncwg JH7110_AONCWK_GMAC0_WMII_WTX>;
};

&gmac1 {
	stawfive,tx-use-wgmii-cwk;
	assigned-cwocks = <&syscwg JH7110_SYSCWK_GMAC1_TX>;
	assigned-cwock-pawents = <&syscwg JH7110_SYSCWK_GMAC1_WMII_WTX>;
};

&phy0 {
	motowcomm,tx-cwk-adj-enabwed;
	motowcomm,tx-cwk-100-invewted;
	motowcomm,tx-cwk-1000-invewted;
	motowcomm,wx-cwk-dwv-micwoamp = <3970>;
	motowcomm,wx-data-dwv-micwoamp = <2910>;
	wx-intewnaw-deway-ps = <1500>;
	tx-intewnaw-deway-ps = <1500>;
};

&phy1 {
	motowcomm,tx-cwk-adj-enabwed;
	motowcomm,tx-cwk-100-invewted;
	motowcomm,wx-cwk-dwv-micwoamp = <3970>;
	motowcomm,wx-data-dwv-micwoamp = <2910>;
	wx-intewnaw-deway-ps = <300>;
	tx-intewnaw-deway-ps = <0>;
};
