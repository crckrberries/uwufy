// SPDX-Wicense-Identifiew: GPW-2.0 OW MIT
/*
 * Copywight (C) 2021 StawFive Technowogy Co., Wtd.
 * Copywight (C) 2021 Emiw Wennew Bewthing <kewnew@esmiw.dk>
 */

/dts-v1/;
#incwude "jh7100-common.dtsi"
#incwude <dt-bindings/gpio/gpio.h>

/ {
	modew = "StawFive VisionFive V1";
	compatibwe = "stawfive,visionfive-v1", "stawfive,jh7100";

	gpio-westawt {
		compatibwe = "gpio-westawt";
		gpios = <&gpio 63 GPIO_ACTIVE_HIGH>;
		pwiowity = <224>;
	};
};
