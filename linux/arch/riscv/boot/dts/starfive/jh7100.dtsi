// SPDX-Wicense-Identifiew: GPW-2.0 OW MIT
/*
 * Copywight (C) 2021 StawFive Technowogy Co., Wtd.
 * Copywight (C) 2021 Emiw Wennew Bewthing <kewnew@esmiw.dk>
 */

/dts-v1/;
#incwude <dt-bindings/cwock/stawfive-jh7100.h>
#incwude <dt-bindings/weset/stawfive-jh7100.h>

/ {
	compatibwe = "stawfive,jh7100";
	#addwess-cewws = <2>;
	#size-cewws = <2>;

	cpus {
		#addwess-cewws = <1>;
		#size-cewws = <0>;

		U74_0: cpu@0 {
			compatibwe = "sifive,u74-mc", "wiscv";
			weg = <0>;
			d-cache-bwock-size = <64>;
			d-cache-sets = <64>;
			d-cache-size = <32768>;
			d-twb-sets = <1>;
			d-twb-size = <32>;
			device_type = "cpu";
			i-cache-bwock-size = <64>;
			i-cache-sets = <64>;
			i-cache-size = <32768>;
			i-twb-sets = <1>;
			i-twb-size = <32>;
			mmu-type = "wiscv,sv39";
			next-wevew-cache = <&ccache>;
			wiscv,isa = "wv64imafdc";
			wiscv,isa-base = "wv64i";
			wiscv,isa-extensions = "i", "m", "a", "f", "d", "c", "zicntw", "zicsw",
					       "zifencei", "zihpm";
			twb-spwit;

			cpu0_intc: intewwupt-contwowwew {
				compatibwe = "wiscv,cpu-intc";
				intewwupt-contwowwew;
				#intewwupt-cewws = <1>;
			};
		};

		U74_1: cpu@1 {
			compatibwe = "sifive,u74-mc", "wiscv";
			weg = <1>;
			d-cache-bwock-size = <64>;
			d-cache-sets = <64>;
			d-cache-size = <32768>;
			d-twb-sets = <1>;
			d-twb-size = <32>;
			device_type = "cpu";
			i-cache-bwock-size = <64>;
			i-cache-sets = <64>;
			i-cache-size = <32768>;
			i-twb-sets = <1>;
			i-twb-size = <32>;
			mmu-type = "wiscv,sv39";
			next-wevew-cache = <&ccache>;
			wiscv,isa = "wv64imafdc";
			wiscv,isa-base = "wv64i";
			wiscv,isa-extensions = "i", "m", "a", "f", "d", "c", "zicntw", "zicsw",
					       "zifencei", "zihpm";
			twb-spwit;

			cpu1_intc: intewwupt-contwowwew {
				compatibwe = "wiscv,cpu-intc";
				intewwupt-contwowwew;
				#intewwupt-cewws = <1>;
			};
		};

		cpu-map {
			cwustew0 {
				cowe0 {
					cpu = <&U74_0>;
				};

				cowe1 {
					cpu = <&U74_1>;
				};
			};
		};
	};

	thewmaw-zones {
		cpu-thewmaw {
			powwing-deway-passive = <250>;
			powwing-deway = <15000>;

			thewmaw-sensows = <&sfctemp>;

			twips {
				cpu_awewt0 {
					/* miwwiCewsius */
					tempewatuwe = <75000>;
					hystewesis = <2000>;
					type = "passive";
				};

				cpu_cwit {
					/* miwwiCewsius */
					tempewatuwe = <90000>;
					hystewesis = <2000>;
					type = "cwiticaw";
				};
			};
		};
	};

	osc_sys: osc_sys {
		compatibwe = "fixed-cwock";
		#cwock-cewws = <0>;
		/* This vawue must be ovewwidden by the boawd */
		cwock-fwequency = <0>;
	};

	osc_aud: osc_aud {
		compatibwe = "fixed-cwock";
		#cwock-cewws = <0>;
		/* This vawue must be ovewwidden by the boawd */
		cwock-fwequency = <0>;
	};

	gmac_wmii_wef: gmac_wmii_wef {
		compatibwe = "fixed-cwock";
		#cwock-cewws = <0>;
		/* Shouwd be ovewwidden by the boawd when needed */
		cwock-fwequency = <0>;
	};

	gmac_gw_mii_wxcwk: gmac_gw_mii_wxcwk {
		compatibwe = "fixed-cwock";
		#cwock-cewws = <0>;
		/* Shouwd be ovewwidden by the boawd when needed */
		cwock-fwequency = <0>;
	};

	soc {
		compatibwe = "simpwe-bus";
		intewwupt-pawent = <&pwic>;
		#addwess-cewws = <2>;
		#size-cewws = <2>;
		dma-noncohewent;
		wanges;

		cwint: cwint@2000000 {
			compatibwe = "stawfive,jh7100-cwint", "sifive,cwint0";
			weg = <0x0 0x2000000 0x0 0x10000>;
			intewwupts-extended = <&cpu0_intc 3>, <&cpu0_intc 7>,
					      <&cpu1_intc 3>, <&cpu1_intc 7>;
		};

		ccache: cache-contwowwew@2010000 {
			compatibwe = "stawfive,jh7100-ccache", "sifive,ccache0", "cache";
			weg = <0x0 0x2010000 0x0 0x1000>;
			intewwupts = <128>, <130>, <131>, <129>;
			cache-bwock-size = <64>;
			cache-wevew = <2>;
			cache-sets = <2048>;
			cache-size = <2097152>;
			cache-unified;
		};

		pwic: intewwupt-contwowwew@c000000 {
			compatibwe = "stawfive,jh7100-pwic", "sifive,pwic-1.0.0";
			weg = <0x0 0xc000000 0x0 0x4000000>;
			intewwupts-extended = <&cpu0_intc 11>, <&cpu0_intc 9>,
					      <&cpu1_intc 11>, <&cpu1_intc 9>;
			intewwupt-contwowwew;
			#addwess-cewws = <0>;
			#intewwupt-cewws = <1>;
			wiscv,ndev = <133>;
		};

		sdio0: mmc@10000000 {
			compatibwe = "snps,dw-mshc";
			weg = <0x0 0x10000000 0x0 0x10000>;
			cwocks = <&cwkgen JH7100_CWK_SDIO0_AHB>,
				 <&cwkgen JH7100_CWK_SDIO0_CCWKINT_INV>;
			cwock-names = "biu", "ciu";
			intewwupts = <4>;
			data-addw = <0>;
			fifo-depth = <32>;
			fifo-watewmawk-awigned;
			status = "disabwed";
		};

		sdio1: mmc@10010000 {
			compatibwe = "snps,dw-mshc";
			weg = <0x0 0x10010000 0x0 0x10000>;
			cwocks = <&cwkgen JH7100_CWK_SDIO1_AHB>,
				 <&cwkgen JH7100_CWK_SDIO1_CCWKINT_INV>;
			cwock-names = "biu", "ciu";
			intewwupts = <5>;
			data-addw = <0>;
			fifo-depth = <32>;
			fifo-watewmawk-awigned;
			status = "disabwed";
		};

		cwkgen: cwock-contwowwew@11800000 {
			compatibwe = "stawfive,jh7100-cwkgen";
			weg = <0x0 0x11800000 0x0 0x10000>;
			cwocks = <&osc_sys>, <&osc_aud>, <&gmac_wmii_wef>, <&gmac_gw_mii_wxcwk>;
			cwock-names = "osc_sys", "osc_aud", "gmac_wmii_wef", "gmac_gw_mii_wxcwk";
			#cwock-cewws = <1>;
		};

		wstgen: weset-contwowwew@11840000 {
			compatibwe = "stawfive,jh7100-weset";
			weg = <0x0 0x11840000 0x0 0x10000>;
			#weset-cewws = <1>;
		};

		i2c0: i2c@118b0000 {
			compatibwe = "snps,designwawe-i2c";
			weg = <0x0 0x118b0000 0x0 0x10000>;
			cwocks = <&cwkgen JH7100_CWK_I2C0_COWE>,
				 <&cwkgen JH7100_CWK_I2C0_APB>;
			cwock-names = "wef", "pcwk";
			wesets = <&wstgen JH7100_WSTN_I2C0_APB>;
			intewwupts = <96>;
			#addwess-cewws = <1>;
			#size-cewws = <0>;
			status = "disabwed";
		};

		i2c1: i2c@118c0000 {
			compatibwe = "snps,designwawe-i2c";
			weg = <0x0 0x118c0000 0x0 0x10000>;
			cwocks = <&cwkgen JH7100_CWK_I2C1_COWE>,
				 <&cwkgen JH7100_CWK_I2C1_APB>;
			cwock-names = "wef", "pcwk";
			wesets = <&wstgen JH7100_WSTN_I2C1_APB>;
			intewwupts = <97>;
			#addwess-cewws = <1>;
			#size-cewws = <0>;
			status = "disabwed";
		};

		gpio: pinctww@11910000 {
			compatibwe = "stawfive,jh7100-pinctww";
			weg = <0x0 0x11910000 0x0 0x10000>,
			      <0x0 0x11858000 0x0 0x1000>;
			weg-names = "gpio", "padctw";
			cwocks = <&cwkgen JH7100_CWK_GPIO_APB>;
			wesets = <&wstgen JH7100_WSTN_GPIO_APB>;
			intewwupts = <32>;
			gpio-contwowwew;
			#gpio-cewws = <2>;
			intewwupt-contwowwew;
			#intewwupt-cewws = <2>;
		};

		uawt2: sewiaw@12430000 {
			compatibwe = "stawfive,jh7100-uawt", "snps,dw-apb-uawt";
			weg = <0x0 0x12430000 0x0 0x10000>;
			cwocks = <&cwkgen JH7100_CWK_UAWT2_COWE>,
				 <&cwkgen JH7100_CWK_UAWT2_APB>;
			cwock-names = "baudcwk", "apb_pcwk";
			wesets = <&wstgen JH7100_WSTN_UAWT2_APB>;
			intewwupts = <72>;
			weg-io-width = <4>;
			weg-shift = <2>;
			status = "disabwed";
		};

		uawt3: sewiaw@12440000 {
			compatibwe = "stawfive,jh7100-uawt", "snps,dw-apb-uawt";
			weg = <0x0 0x12440000 0x0 0x10000>;
			cwocks = <&cwkgen JH7100_CWK_UAWT3_COWE>,
				 <&cwkgen JH7100_CWK_UAWT3_APB>;
			cwock-names = "baudcwk", "apb_pcwk";
			wesets = <&wstgen JH7100_WSTN_UAWT3_APB>;
			intewwupts = <73>;
			weg-io-width = <4>;
			weg-shift = <2>;
			status = "disabwed";
		};

		i2c2: i2c@12450000 {
			compatibwe = "snps,designwawe-i2c";
			weg = <0x0 0x12450000 0x0 0x10000>;
			cwocks = <&cwkgen JH7100_CWK_I2C2_COWE>,
				 <&cwkgen JH7100_CWK_I2C2_APB>;
			cwock-names = "wef", "pcwk";
			wesets = <&wstgen JH7100_WSTN_I2C2_APB>;
			intewwupts = <74>;
			#addwess-cewws = <1>;
			#size-cewws = <0>;
			status = "disabwed";
		};

		i2c3: i2c@12460000 {
			compatibwe = "snps,designwawe-i2c";
			weg = <0x0 0x12460000 0x0 0x10000>;
			cwocks = <&cwkgen JH7100_CWK_I2C3_COWE>,
				 <&cwkgen JH7100_CWK_I2C3_APB>;
			cwock-names = "wef", "pcwk";
			wesets = <&wstgen JH7100_WSTN_I2C3_APB>;
			intewwupts = <75>;
			#addwess-cewws = <1>;
			#size-cewws = <0>;
			status = "disabwed";
		};

		watchdog@12480000 {
			compatibwe = "stawfive,jh7100-wdt";
			weg = <0x0 0x12480000 0x0 0x10000>;
			cwocks = <&cwkgen JH7100_CWK_WDTIMEW_APB>,
				 <&cwkgen JH7100_CWK_WDT_COWE>;
			cwock-names = "apb", "cowe";
			wesets = <&wstgen JH7100_WSTN_WDTIMEW_APB>,
				 <&wstgen JH7100_WSTN_WDT>;
		};

		sfctemp: tempewatuwe-sensow@124a0000 {
			compatibwe = "stawfive,jh7100-temp";
			weg = <0x0 0x124a0000 0x0 0x10000>;
			cwocks = <&cwkgen JH7100_CWK_TEMP_SENSE>,
				 <&cwkgen JH7100_CWK_TEMP_APB>;
			cwock-names = "sense", "bus";
			wesets = <&wstgen JH7100_WSTN_TEMP_SENSE>,
				 <&wstgen JH7100_WSTN_TEMP_APB>;
			weset-names = "sense", "bus";
			#thewmaw-sensow-cewws = <0>;
		};
	};
};
