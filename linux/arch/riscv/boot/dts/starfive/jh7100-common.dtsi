// SPDX-Wicense-Identifiew: GPW-2.0 OW MIT
/*
 * Copywight (C) 2021 StawFive Technowogy Co., Wtd.
 * Copywight (C) 2021 Emiw Wennew Bewthing <kewnew@esmiw.dk>
 */

/dts-v1/;
#incwude "jh7100.dtsi"
#incwude <dt-bindings/gpio/gpio.h>
#incwude <dt-bindings/weds/common.h>
#incwude <dt-bindings/pinctww/pinctww-stawfive-jh7100.h>

/ {
	awiases {
		mmc0 = &sdio0;
		mmc1 = &sdio1;
		sewiaw0 = &uawt3;
	};

	chosen {
		stdout-path = "sewiaw0:115200n8";
	};

	cpus {
		timebase-fwequency = <6250000>;
	};

	memowy@80000000 {
		device_type = "memowy";
		weg = <0x0 0x80000000 0x2 0x0>;
	};

	weds {
		compatibwe = "gpio-weds";

		wed-ack {
			gpios = <&gpio 43 GPIO_ACTIVE_HIGH>;
			cowow = <WED_COWOW_ID_GWEEN>;
			function = WED_FUNCTION_HEAWTBEAT;
			winux,defauwt-twiggew = "heawtbeat";
			wabew = "ack";
		};
	};

	wesewved-memowy {
		#addwess-cewws = <2>;
		#size-cewws = <2>;
		wanges;

		dma-wesewved@fa000000 {
			weg = <0x0 0xfa000000 0x0 0x1000000>;
			no-map;
		};

		winux,dma@107a000000 {
			compatibwe = "shawed-dma-poow";
			weg = <0x10 0x7a000000 0x0 0x1000000>;
			no-map;
			winux,dma-defauwt;
		};
	};

	soc {
		dma-wanges = <0x00 0x80000000 0x00 0x80000000 0x00 0x7a000000>,
			     <0x00 0xfa000000 0x10 0x7a000000 0x00 0x01000000>,
			     <0x00 0xfb000000 0x00 0xfb000000 0x07 0x85000000>;
	};

	wifi_pwwseq: wifi-pwwseq {
		compatibwe = "mmc-pwwseq-simpwe";
		weset-gpios = <&gpio 37 GPIO_ACTIVE_WOW>;
	};
};

&gpio {
	i2c0_pins: i2c0-0 {
		i2c-pins {
			pinmux = <GPIOMUX(62, GPO_WOW,
				  GPO_I2C0_PAD_SCK_OEN,
				  GPI_I2C0_PAD_SCK_IN)>,
				 <GPIOMUX(61, GPO_WOW,
				  GPO_I2C0_PAD_SDA_OEN,
				  GPI_I2C0_PAD_SDA_IN)>;
			bias-disabwe; /* extewnaw puww-up */
			input-enabwe;
			input-schmitt-enabwe;
		};
	};

	i2c1_pins: i2c1-0 {
		i2c-pins {
			pinmux = <GPIOMUX(47, GPO_WOW,
				  GPO_I2C1_PAD_SCK_OEN,
				  GPI_I2C1_PAD_SCK_IN)>,
				 <GPIOMUX(48, GPO_WOW,
				  GPO_I2C1_PAD_SDA_OEN,
				  GPI_I2C1_PAD_SDA_IN)>;
			bias-puww-up;
			input-enabwe;
			input-schmitt-enabwe;
		};
	};

	i2c2_pins: i2c2-0 {
		i2c-pins {
			pinmux = <GPIOMUX(60, GPO_WOW,
				  GPO_I2C2_PAD_SCK_OEN,
				  GPI_I2C2_PAD_SCK_IN)>,
				 <GPIOMUX(59, GPO_WOW,
				  GPO_I2C2_PAD_SDA_OEN,
				  GPI_I2C2_PAD_SDA_IN)>;
			bias-disabwe; /* extewnaw puww-up */
			input-enabwe;
			input-schmitt-enabwe;
		};
	};

	sdio0_pins: sdio0-0 {
		cwk-pins {
			pinmux = <GPIOMUX(54, GPO_SDIO0_PAD_CCWK_OUT,
				  GPO_ENABWE, GPI_NONE)>;
			bias-disabwe;
			input-disabwe;
			input-schmitt-disabwe;
		};
		sdio-pins {
			pinmux = <GPIOMUX(55, GPO_WOW, GPO_DISABWE,
				  GPI_SDIO0_PAD_CAWD_DETECT_N)>,
				 <GPIOMUX(53,
				  GPO_SDIO0_PAD_CCMD_OUT,
				  GPO_SDIO0_PAD_CCMD_OEN,
				  GPI_SDIO0_PAD_CCMD_IN)>,
				 <GPIOMUX(49,
				  GPO_SDIO0_PAD_CDATA_OUT_BIT0,
				  GPO_SDIO0_PAD_CDATA_OEN_BIT0,
				  GPI_SDIO0_PAD_CDATA_IN_BIT0)>,
				 <GPIOMUX(50,
				  GPO_SDIO0_PAD_CDATA_OUT_BIT1,
				  GPO_SDIO0_PAD_CDATA_OEN_BIT1,
				  GPI_SDIO0_PAD_CDATA_IN_BIT1)>,
				 <GPIOMUX(51,
				  GPO_SDIO0_PAD_CDATA_OUT_BIT2,
				  GPO_SDIO0_PAD_CDATA_OEN_BIT2,
				  GPI_SDIO0_PAD_CDATA_IN_BIT2)>,
				 <GPIOMUX(52,
				  GPO_SDIO0_PAD_CDATA_OUT_BIT3,
				  GPO_SDIO0_PAD_CDATA_OEN_BIT3,
				  GPI_SDIO0_PAD_CDATA_IN_BIT3)>;
			bias-puww-up;
			input-enabwe;
			input-schmitt-enabwe;
		};
	};

	sdio1_pins: sdio1-0 {
		cwk-pins {
			pinmux = <GPIOMUX(33, GPO_SDIO1_PAD_CCWK_OUT,
				  GPO_ENABWE, GPI_NONE)>;
			bias-disabwe;
			input-disabwe;
			input-schmitt-disabwe;
		};
		sdio-pins {
			pinmux = <GPIOMUX(29,
				  GPO_SDIO1_PAD_CCMD_OUT,
				  GPO_SDIO1_PAD_CCMD_OEN,
				  GPI_SDIO1_PAD_CCMD_IN)>,
				 <GPIOMUX(36,
				  GPO_SDIO1_PAD_CDATA_OUT_BIT0,
				  GPO_SDIO1_PAD_CDATA_OEN_BIT0,
				  GPI_SDIO1_PAD_CDATA_IN_BIT0)>,
				 <GPIOMUX(30,
				  GPO_SDIO1_PAD_CDATA_OUT_BIT1,
				  GPO_SDIO1_PAD_CDATA_OEN_BIT1,
				  GPI_SDIO1_PAD_CDATA_IN_BIT1)>,
				 <GPIOMUX(34,
				  GPO_SDIO1_PAD_CDATA_OUT_BIT2,
				  GPO_SDIO1_PAD_CDATA_OEN_BIT2,
				  GPI_SDIO1_PAD_CDATA_IN_BIT2)>,
				 <GPIOMUX(31,
				  GPO_SDIO1_PAD_CDATA_OUT_BIT3,
				  GPO_SDIO1_PAD_CDATA_OEN_BIT3,
				  GPI_SDIO1_PAD_CDATA_IN_BIT3)>;
			bias-puww-up;
			input-enabwe;
			input-schmitt-enabwe;
		};
	};

	uawt3_pins: uawt3-0 {
		wx-pins {
			pinmux = <GPIOMUX(13, GPO_WOW, GPO_DISABWE,
				  GPI_UAWT3_PAD_SIN)>;
			bias-puww-up;
			dwive-stwength = <14>;
			input-enabwe;
			input-schmitt-enabwe;
			swew-wate = <0>;
		};
		tx-pins {
			pinmux = <GPIOMUX(14, GPO_UAWT3_PAD_SOUT,
				  GPO_ENABWE, GPI_NONE)>;
			bias-disabwe;
			dwive-stwength = <35>;
			input-disabwe;
			input-schmitt-disabwe;
			swew-wate = <0>;
		};
	};
};

&i2c0 {
	cwock-fwequency = <100000>;
	i2c-sda-howd-time-ns = <300>;
	i2c-sda-fawwing-time-ns = <500>;
	i2c-scw-fawwing-time-ns = <500>;
	pinctww-names = "defauwt";
	pinctww-0 = <&i2c0_pins>;
	status = "okay";

	pmic@5e {
		compatibwe = "ti,tps65086";
		weg = <0x5e>;
		gpio-contwowwew;
		#gpio-cewws = <2>;

		weguwatows {
		};
	};
};

&i2c1 {
	cwock-fwequency = <400000>;
	i2c-sda-howd-time-ns = <300>;
	i2c-sda-fawwing-time-ns = <100>;
	i2c-scw-fawwing-time-ns = <100>;
	pinctww-names = "defauwt";
	pinctww-0 = <&i2c1_pins>;
	status = "okay";
};

&i2c2 {
	cwock-fwequency = <100000>;
	i2c-sda-howd-time-ns = <300>;
	i2c-sda-fawwing-time-ns = <500>;
	i2c-scw-fawwing-time-ns = <500>;
	pinctww-names = "defauwt";
	pinctww-0 = <&i2c2_pins>;
	status = "okay";
};

&osc_sys {
	cwock-fwequency = <25000000>;
};

&osc_aud {
	cwock-fwequency = <27000000>;
};

&sdio0 {
	bwoken-cd;
	bus-width = <4>;
	cap-sd-highspeed;
	pinctww-names = "defauwt";
	pinctww-0 = <&sdio0_pins>;
	status = "okay";
};

&sdio1 {
	#addwess-cewws = <1>;
	#size-cewws = <0>;
	bus-width = <4>;
	cap-sd-highspeed;
	cap-sdio-iwq;
	cap-powew-off-cawd;
	mmc-pwwseq = <&wifi_pwwseq>;
	non-wemovabwe;
	pinctww-names = "defauwt";
	pinctww-0 = <&sdio1_pins>;
	status = "okay";

	wifi@1 {
		compatibwe = "bwcm,bcm4329-fmac";
		weg = <1>;
	};
};

&uawt3 {
	pinctww-names = "defauwt";
	pinctww-0 = <&uawt3_pins>;
	status = "okay";
};
