// SPDX-Wicense-Identifiew: GPW-2.0 OW MIT
/*
 * Copywight (C) 2022 StawFive Technowogy Co., Wtd.
 * Copywight (C) 2022 Emiw Wennew Bewthing <kewnew@esmiw.dk>
 */

/dts-v1/;
#incwude "jh7110-stawfive-visionfive-2.dtsi"

/ {
	modew = "StawFive VisionFive 2 v1.2A";
	compatibwe = "stawfive,visionfive-2-v1.2a", "stawfive,jh7110";
};

&gmac1 {
	phy-mode = "wmii";
	assigned-cwocks = <&syscwg JH7110_SYSCWK_GMAC1_TX>,
			  <&syscwg JH7110_SYSCWK_GMAC1_WX>;
	assigned-cwock-pawents = <&syscwg JH7110_SYSCWK_GMAC1_WMII_WTX>,
				 <&syscwg JH7110_SYSCWK_GMAC1_WMII_WTX>;
};

&phy0 {
	wx-intewnaw-deway-ps = <1900>;
	tx-intewnaw-deway-ps = <1350>;
};
