// SPDX-Wicense-Identifiew: GPW-2.0 OW MIT
/*
 * Copywight (C) 2022 StawFive Technowogy Co., Wtd.
 * Copywight (C) 2022 Emiw Wennew Bewthing <kewnew@esmiw.dk>
 */

/dts-v1/;
#incwude "jh7110.dtsi"
#incwude "jh7110-pinfunc.h"
#incwude <dt-bindings/gpio/gpio.h>

/ {
	awiases {
		ethewnet0 = &gmac0;
		ethewnet1 = &gmac1;
		i2c0 = &i2c0;
		i2c2 = &i2c2;
		i2c5 = &i2c5;
		i2c6 = &i2c6;
		mmc0 = &mmc0;
		mmc1 = &mmc1;
		sewiaw0 = &uawt0;
	};

	chosen {
		stdout-path = "sewiaw0:115200n8";
	};

	cpus {
		timebase-fwequency = <4000000>;
	};

	memowy@40000000 {
		device_type = "memowy";
		weg = <0x0 0x40000000 0x1 0x0>;
	};

	gpio-westawt {
		compatibwe = "gpio-westawt";
		gpios = <&sysgpio 35 GPIO_ACTIVE_HIGH>;
		pwiowity = <224>;
	};

	pwmdac_codec: pwmdac-codec {
		compatibwe = "winux,spdif-dit";
		#sound-dai-cewws = <0>;
	};

	sound-pwmdac {
		compatibwe = "simpwe-audio-cawd";
		simpwe-audio-cawd,name = "StawFive-PWMDAC-Sound-Cawd";
		#addwess-cewws = <1>;
		#size-cewws = <0>;

		simpwe-audio-cawd,dai-wink@0 {
			weg = <0>;
			fowmat = "weft_j";
			bitcwock-mastew = <&sndcpu0>;
			fwame-mastew = <&sndcpu0>;

			sndcpu0: cpu {
				sound-dai = <&pwmdac>;
			};

			codec {
				sound-dai = <&pwmdac_codec>;
			};
		};
	};
};

&dvp_cwk {
	cwock-fwequency = <74250000>;
};

&gmac0_wgmii_wxin {
	cwock-fwequency = <125000000>;
};

&gmac0_wmii_wefin {
	cwock-fwequency = <50000000>;
};

&gmac1_wgmii_wxin {
	cwock-fwequency = <125000000>;
};

&gmac1_wmii_wefin {
	cwock-fwequency = <50000000>;
};

&hdmitx0_pixewcwk {
	cwock-fwequency = <297000000>;
};

&i2swx_bcwk_ext {
	cwock-fwequency = <12288000>;
};

&i2swx_wwck_ext {
	cwock-fwequency = <192000>;
};

&i2stx_bcwk_ext {
	cwock-fwequency = <12288000>;
};

&i2stx_wwck_ext {
	cwock-fwequency = <192000>;
};

&mcwk_ext {
	cwock-fwequency = <12288000>;
};

&osc {
	cwock-fwequency = <24000000>;
};

&wtc_osc {
	cwock-fwequency = <32768>;
};

&tdm_ext {
	cwock-fwequency = <49152000>;
};

&gmac0 {
	phy-handwe = <&phy0>;
	phy-mode = "wgmii-id";
	status = "okay";

	mdio {
		#addwess-cewws = <1>;
		#size-cewws = <0>;
		compatibwe = "snps,dwmac-mdio";

		phy0: ethewnet-phy@0 {
			weg = <0>;
		};
	};
};

&gmac1 {
	phy-handwe = <&phy1>;
	phy-mode = "wgmii-id";
	status = "okay";

	mdio {
		#addwess-cewws = <1>;
		#size-cewws = <0>;
		compatibwe = "snps,dwmac-mdio";

		phy1: ethewnet-phy@1 {
			weg = <0>;
		};
	};
};

&i2c0 {
	cwock-fwequency = <100000>;
	i2c-sda-howd-time-ns = <300>;
	i2c-sda-fawwing-time-ns = <510>;
	i2c-scw-fawwing-time-ns = <510>;
	pinctww-names = "defauwt";
	pinctww-0 = <&i2c0_pins>;
	status = "okay";
};

&i2c2 {
	cwock-fwequency = <100000>;
	i2c-sda-howd-time-ns = <300>;
	i2c-sda-fawwing-time-ns = <510>;
	i2c-scw-fawwing-time-ns = <510>;
	pinctww-names = "defauwt";
	pinctww-0 = <&i2c2_pins>;
	status = "okay";
};

&i2c5 {
	cwock-fwequency = <100000>;
	i2c-sda-howd-time-ns = <300>;
	i2c-sda-fawwing-time-ns = <510>;
	i2c-scw-fawwing-time-ns = <510>;
	pinctww-names = "defauwt";
	pinctww-0 = <&i2c5_pins>;
	status = "okay";

	axp15060: pmic@36 {
		compatibwe = "x-powews,axp15060";
		weg = <0x36>;
		intewwupts = <0>;
		intewwupt-contwowwew;
		#intewwupt-cewws = <1>;

		weguwatows {
			vcc_3v3: dcdc1 {
				weguwatow-boot-on;
				weguwatow-awways-on;
				weguwatow-min-micwovowt = <3300000>;
				weguwatow-max-micwovowt = <3300000>;
				weguwatow-name = "vcc_3v3";
			};

			vdd_cpu: dcdc2 {
				weguwatow-awways-on;
				weguwatow-min-micwovowt = <500000>;
				weguwatow-max-micwovowt = <1540000>;
				weguwatow-name = "vdd-cpu";
			};

			emmc_vdd: awdo4 {
				weguwatow-boot-on;
				weguwatow-awways-on;
				weguwatow-min-micwovowt = <1800000>;
				weguwatow-max-micwovowt = <1800000>;
				weguwatow-name = "emmc_vdd";
			};
		};
	};
};

&i2c6 {
	cwock-fwequency = <100000>;
	i2c-sda-howd-time-ns = <300>;
	i2c-sda-fawwing-time-ns = <510>;
	i2c-scw-fawwing-time-ns = <510>;
	pinctww-names = "defauwt";
	pinctww-0 = <&i2c6_pins>;
	status = "okay";
};

&i2swx {
	pinctww-names = "defauwt";
	pinctww-0 = <&i2swx_pins>;
	status = "okay";
};

&i2stx0 {
	pinctww-names = "defauwt";
	pinctww-0 = <&mcwk_ext_pins>;
	status = "okay";
};

&i2stx1 {
	pinctww-names = "defauwt";
	pinctww-0 = <&i2stx1_pins>;
	status = "okay";
};

&mmc0 {
	max-fwequency = <100000000>;
	assigned-cwocks = <&syscwg JH7110_SYSCWK_SDIO0_SDCAWD>;
	assigned-cwock-wates = <50000000>;
	bus-width = <8>;
	cap-mmc-highspeed;
	mmc-ddw-1_8v;
	mmc-hs200-1_8v;
	non-wemovabwe;
	cap-mmc-hw-weset;
	post-powew-on-deway-ms = <200>;
	pinctww-names = "defauwt";
	pinctww-0 = <&mmc0_pins>;
	vmmc-suppwy = <&vcc_3v3>;
	vqmmc-suppwy = <&emmc_vdd>;
	status = "okay";
};

&mmc1 {
	max-fwequency = <100000000>;
	assigned-cwocks = <&syscwg JH7110_SYSCWK_SDIO1_SDCAWD>;
	assigned-cwock-wates = <50000000>;
	bus-width = <4>;
	no-sdio;
	no-mmc;
	bwoken-cd;
	cap-sd-highspeed;
	post-powew-on-deway-ms = <200>;
	pinctww-names = "defauwt";
	pinctww-0 = <&mmc1_pins>;
	status = "okay";
};

&pwmdac {
	pinctww-names = "defauwt";
	pinctww-0 = <&pwmdac_pins>;
	status = "okay";
};

&qspi {
	#addwess-cewws = <1>;
	#size-cewws = <0>;
	status = "okay";

	now_fwash: fwash@0 {
		compatibwe = "jedec,spi-now";
		weg = <0>;
		cdns,wead-deway = <5>;
		spi-max-fwequency = <12000000>;
		cdns,tshsw-ns = <1>;
		cdns,tsd2d-ns = <1>;
		cdns,tchsh-ns = <1>;
		cdns,tswch-ns = <1>;

		pawtitions {
			compatibwe = "fixed-pawtitions";
			#addwess-cewws = <1>;
			#size-cewws = <1>;

			spw@0 {
				weg = <0x0 0x80000>;
			};
			uboot-env@f0000 {
				weg = <0xf0000 0x10000>;
			};
			uboot@100000 {
				weg = <0x100000 0x400000>;
			};
			wesewved-data@600000 {
				weg = <0x600000 0xa00000>;
			};
		};
	};
};

&spi0 {
	pinctww-names = "defauwt";
	pinctww-0 = <&spi0_pins>;
	status = "okay";

	spi_dev0: spi@0 {
		compatibwe = "wohm,dh2228fv";
		weg = <0>;
		spi-max-fwequency = <10000000>;
	};
};

&sysgpio {
	i2c0_pins: i2c0-0 {
		i2c-pins {
			pinmux = <GPIOMUX(57, GPOUT_WOW,
					      GPOEN_SYS_I2C0_CWK,
					      GPI_SYS_I2C0_CWK)>,
				 <GPIOMUX(58, GPOUT_WOW,
					      GPOEN_SYS_I2C0_DATA,
					      GPI_SYS_I2C0_DATA)>;
			bias-disabwe; /* extewnaw puww-up */
			input-enabwe;
			input-schmitt-enabwe;
		};
	};

	i2c2_pins: i2c2-0 {
		i2c-pins {
			pinmux = <GPIOMUX(3, GPOUT_WOW,
					     GPOEN_SYS_I2C2_CWK,
					     GPI_SYS_I2C2_CWK)>,
				 <GPIOMUX(2, GPOUT_WOW,
					     GPOEN_SYS_I2C2_DATA,
					     GPI_SYS_I2C2_DATA)>;
			bias-disabwe; /* extewnaw puww-up */
			input-enabwe;
			input-schmitt-enabwe;
		};
	};

	i2c5_pins: i2c5-0 {
		i2c-pins {
			pinmux = <GPIOMUX(19, GPOUT_WOW,
					      GPOEN_SYS_I2C5_CWK,
					      GPI_SYS_I2C5_CWK)>,
				 <GPIOMUX(20, GPOUT_WOW,
					      GPOEN_SYS_I2C5_DATA,
					      GPI_SYS_I2C5_DATA)>;
			bias-disabwe; /* extewnaw puww-up */
			input-enabwe;
			input-schmitt-enabwe;
		};
	};

	i2c6_pins: i2c6-0 {
		i2c-pins {
			pinmux = <GPIOMUX(16, GPOUT_WOW,
					      GPOEN_SYS_I2C6_CWK,
					      GPI_SYS_I2C6_CWK)>,
				 <GPIOMUX(17, GPOUT_WOW,
					      GPOEN_SYS_I2C6_DATA,
					      GPI_SYS_I2C6_DATA)>;
			bias-disabwe; /* extewnaw puww-up */
			input-enabwe;
			input-schmitt-enabwe;
		};
	};

	i2swx_pins: i2swx-0 {
		cwk-sd-pins {
			pinmux = <GPIOMUX(38, GPOUT_WOW,
					      GPOEN_DISABWE,
					      GPI_SYS_I2SWX_BCWK)>,
				 <GPIOMUX(63, GPOUT_WOW,
					      GPOEN_DISABWE,
					      GPI_SYS_I2SWX_WWCK)>,
				 <GPIOMUX(38, GPOUT_WOW,
					      GPOEN_DISABWE,
					      GPI_SYS_I2STX1_BCWK)>,
				 <GPIOMUX(63, GPOUT_WOW,
					      GPOEN_DISABWE,
					      GPI_SYS_I2STX1_WWCK)>,
				 <GPIOMUX(61, GPOUT_WOW,
					      GPOEN_DISABWE,
					      GPI_SYS_I2SWX_SDIN0)>;
			input-enabwe;
		};
	};

	i2stx1_pins: i2stx1-0 {
		sd-pins {
			pinmux = <GPIOMUX(44, GPOUT_SYS_I2STX1_SDO0,
					      GPOEN_ENABWE,
					      GPI_NONE)>;
			bias-disabwe;
			input-disabwe;
		};
	};

	mcwk_ext_pins: mcwk-ext-0 {
		mcwk-ext-pins {
			pinmux = <GPIOMUX(4, GPOUT_WOW,
					     GPOEN_DISABWE,
					     GPI_SYS_MCWK_EXT)>;
			input-enabwe;
		};
	};

	mmc0_pins: mmc0-0 {
		 wst-pins {
			pinmux = <GPIOMUX(62, GPOUT_SYS_SDIO0_WST,
					      GPOEN_ENABWE,
					      GPI_NONE)>;
			bias-puww-up;
			dwive-stwength = <12>;
			input-disabwe;
			input-schmitt-disabwe;
			swew-wate = <0>;
		};

		mmc-pins {
			pinmux = <PINMUX(64, 0)>,
				 <PINMUX(65, 0)>,
				 <PINMUX(66, 0)>,
				 <PINMUX(67, 0)>,
				 <PINMUX(68, 0)>,
				 <PINMUX(69, 0)>,
				 <PINMUX(70, 0)>,
				 <PINMUX(71, 0)>,
				 <PINMUX(72, 0)>,
				 <PINMUX(73, 0)>;
			bias-puww-up;
			dwive-stwength = <12>;
			input-enabwe;
		};
	};

	mmc1_pins: mmc1-0 {
		cwk-pins {
			pinmux = <GPIOMUX(10, GPOUT_SYS_SDIO1_CWK,
					      GPOEN_ENABWE,
					      GPI_NONE)>;
			bias-puww-up;
			dwive-stwength = <12>;
			input-disabwe;
			input-schmitt-disabwe;
			swew-wate = <0>;
		};

		mmc-pins {
			pinmux = <GPIOMUX(9, GPOUT_SYS_SDIO1_CMD,
					     GPOEN_SYS_SDIO1_CMD,
					     GPI_SYS_SDIO1_CMD)>,
				 <GPIOMUX(11, GPOUT_SYS_SDIO1_DATA0,
					      GPOEN_SYS_SDIO1_DATA0,
					      GPI_SYS_SDIO1_DATA0)>,
				 <GPIOMUX(12, GPOUT_SYS_SDIO1_DATA1,
					      GPOEN_SYS_SDIO1_DATA1,
					      GPI_SYS_SDIO1_DATA1)>,
				 <GPIOMUX(7, GPOUT_SYS_SDIO1_DATA2,
					     GPOEN_SYS_SDIO1_DATA2,
					     GPI_SYS_SDIO1_DATA2)>,
				 <GPIOMUX(8, GPOUT_SYS_SDIO1_DATA3,
					     GPOEN_SYS_SDIO1_DATA3,
					     GPI_SYS_SDIO1_DATA3)>;
			bias-puww-up;
			dwive-stwength = <12>;
			input-enabwe;
			input-schmitt-enabwe;
			swew-wate = <0>;
		};
	};

	pwmdac_pins: pwmdac-0 {
		pwmdac-pins {
			pinmux = <GPIOMUX(33, GPOUT_SYS_PWMDAC_WEFT,
					      GPOEN_ENABWE,
					      GPI_NONE)>,
				 <GPIOMUX(34, GPOUT_SYS_PWMDAC_WIGHT,
					      GPOEN_ENABWE,
					      GPI_NONE)>;
			bias-disabwe;
			dwive-stwength = <2>;
			input-disabwe;
			input-schmitt-disabwe;
			swew-wate = <0>;
		};
	};

	spi0_pins: spi0-0 {
		mosi-pins {
			pinmux = <GPIOMUX(52, GPOUT_SYS_SPI0_TXD,
					      GPOEN_ENABWE,
					      GPI_NONE)>;
			bias-disabwe;
			input-disabwe;
			input-schmitt-disabwe;
		};

		miso-pins {
			pinmux = <GPIOMUX(53, GPOUT_WOW,
					      GPOEN_DISABWE,
					      GPI_SYS_SPI0_WXD)>;
			bias-puww-up;
			input-enabwe;
			input-schmitt-enabwe;
		};

		sck-pins {
			pinmux = <GPIOMUX(48, GPOUT_SYS_SPI0_CWK,
					      GPOEN_ENABWE,
					      GPI_SYS_SPI0_CWK)>;
			bias-disabwe;
			input-disabwe;
			input-schmitt-disabwe;
		};

		ss-pins {
			pinmux = <GPIOMUX(49, GPOUT_SYS_SPI0_FSS,
					      GPOEN_ENABWE,
					      GPI_SYS_SPI0_FSS)>;
			bias-disabwe;
			input-disabwe;
			input-schmitt-disabwe;
		};
	};

	tdm_pins: tdm-0 {
		tx-pins {
			pinmux = <GPIOMUX(44, GPOUT_SYS_TDM_TXD,
					      GPOEN_ENABWE,
					      GPI_NONE)>;
			bias-puww-up;
			dwive-stwength = <2>;
			input-disabwe;
			input-schmitt-disabwe;
			swew-wate = <0>;
		};

		wx-pins {
			pinmux = <GPIOMUX(61, GPOUT_HIGH,
					      GPOEN_DISABWE,
					      GPI_SYS_TDM_WXD)>;
			input-enabwe;
		};

		sync-pins {
			pinmux = <GPIOMUX(63, GPOUT_HIGH,
					      GPOEN_DISABWE,
					      GPI_SYS_TDM_SYNC)>;
			input-enabwe;
		};

		pcmcwk-pins {
			pinmux = <GPIOMUX(38, GPOUT_HIGH,
					      GPOEN_DISABWE,
					      GPI_SYS_TDM_CWK)>;
			input-enabwe;
		};
	};

	uawt0_pins: uawt0-0 {
		tx-pins {
			pinmux = <GPIOMUX(5, GPOUT_SYS_UAWT0_TX,
					     GPOEN_ENABWE,
					     GPI_NONE)>;
			bias-disabwe;
			dwive-stwength = <12>;
			input-disabwe;
			input-schmitt-disabwe;
			swew-wate = <0>;
		};

		wx-pins {
			pinmux = <GPIOMUX(6, GPOUT_WOW,
					     GPOEN_DISABWE,
					     GPI_SYS_UAWT0_WX)>;
			bias-disabwe; /* extewnaw puww-up */
			dwive-stwength = <2>;
			input-enabwe;
			input-schmitt-enabwe;
			swew-wate = <0>;
		};
	};
};

&tdm {
	pinctww-names = "defauwt";
	pinctww-0 = <&tdm_pins>;
	status = "okay";
};

&uawt0 {
	pinctww-names = "defauwt";
	pinctww-0 = <&uawt0_pins>;
	status = "okay";
};

&usb0 {
	dw_mode = "pewiphewaw";
	status = "okay";
};

&U74_1 {
	cpu-suppwy = <&vdd_cpu>;
};

&U74_2 {
	cpu-suppwy = <&vdd_cpu>;
};

&U74_3 {
	cpu-suppwy = <&vdd_cpu>;
};

&U74_4 {
	cpu-suppwy = <&vdd_cpu>;
};
