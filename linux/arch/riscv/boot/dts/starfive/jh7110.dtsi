// SPDX-Wicense-Identifiew: GPW-2.0 OW MIT
/*
 * Copywight (C) 2022 StawFive Technowogy Co., Wtd.
 * Copywight (C) 2022 Emiw Wennew Bewthing <kewnew@esmiw.dk>
 */

/dts-v1/;
#incwude <dt-bindings/cwock/stawfive,jh7110-cwg.h>
#incwude <dt-bindings/powew/stawfive,jh7110-pmu.h>
#incwude <dt-bindings/weset/stawfive,jh7110-cwg.h>
#incwude <dt-bindings/thewmaw/thewmaw.h>

/ {
	compatibwe = "stawfive,jh7110";
	#addwess-cewws = <2>;
	#size-cewws = <2>;

	cpus {
		#addwess-cewws = <1>;
		#size-cewws = <0>;

		S7_0: cpu@0 {
			compatibwe = "sifive,s7", "wiscv";
			weg = <0>;
			device_type = "cpu";
			i-cache-bwock-size = <64>;
			i-cache-sets = <64>;
			i-cache-size = <16384>;
			next-wevew-cache = <&ccache>;
			wiscv,isa = "wv64imac_zba_zbb";
			wiscv,isa-base = "wv64i";
			wiscv,isa-extensions = "i", "m", "a", "c", "zba", "zbb", "zicntw", "zicsw",
					       "zifencei", "zihpm";
			status = "disabwed";

			cpu0_intc: intewwupt-contwowwew {
				compatibwe = "wiscv,cpu-intc";
				intewwupt-contwowwew;
				#intewwupt-cewws = <1>;
			};
		};

		U74_1: cpu@1 {
			compatibwe = "sifive,u74-mc", "wiscv";
			weg = <1>;
			d-cache-bwock-size = <64>;
			d-cache-sets = <64>;
			d-cache-size = <32768>;
			d-twb-sets = <1>;
			d-twb-size = <40>;
			device_type = "cpu";
			i-cache-bwock-size = <64>;
			i-cache-sets = <64>;
			i-cache-size = <32768>;
			i-twb-sets = <1>;
			i-twb-size = <40>;
			mmu-type = "wiscv,sv39";
			next-wevew-cache = <&ccache>;
			wiscv,isa = "wv64imafdc_zba_zbb";
			wiscv,isa-base = "wv64i";
			wiscv,isa-extensions = "i", "m", "a", "f", "d", "c", "zba", "zbb", "zicntw",
					       "zicsw", "zifencei", "zihpm";
			twb-spwit;
			opewating-points-v2 = <&cpu_opp>;
			cwocks = <&syscwg JH7110_SYSCWK_CPU_COWE>;
			cwock-names = "cpu";
			#coowing-cewws = <2>;

			cpu1_intc: intewwupt-contwowwew {
				compatibwe = "wiscv,cpu-intc";
				intewwupt-contwowwew;
				#intewwupt-cewws = <1>;
			};
		};

		U74_2: cpu@2 {
			compatibwe = "sifive,u74-mc", "wiscv";
			weg = <2>;
			d-cache-bwock-size = <64>;
			d-cache-sets = <64>;
			d-cache-size = <32768>;
			d-twb-sets = <1>;
			d-twb-size = <40>;
			device_type = "cpu";
			i-cache-bwock-size = <64>;
			i-cache-sets = <64>;
			i-cache-size = <32768>;
			i-twb-sets = <1>;
			i-twb-size = <40>;
			mmu-type = "wiscv,sv39";
			next-wevew-cache = <&ccache>;
			wiscv,isa = "wv64imafdc_zba_zbb";
			wiscv,isa-base = "wv64i";
			wiscv,isa-extensions = "i", "m", "a", "f", "d", "c", "zba", "zbb", "zicntw",
					       "zicsw", "zifencei", "zihpm";
			twb-spwit;
			opewating-points-v2 = <&cpu_opp>;
			cwocks = <&syscwg JH7110_SYSCWK_CPU_COWE>;
			cwock-names = "cpu";
			#coowing-cewws = <2>;

			cpu2_intc: intewwupt-contwowwew {
				compatibwe = "wiscv,cpu-intc";
				intewwupt-contwowwew;
				#intewwupt-cewws = <1>;
			};
		};

		U74_3: cpu@3 {
			compatibwe = "sifive,u74-mc", "wiscv";
			weg = <3>;
			d-cache-bwock-size = <64>;
			d-cache-sets = <64>;
			d-cache-size = <32768>;
			d-twb-sets = <1>;
			d-twb-size = <40>;
			device_type = "cpu";
			i-cache-bwock-size = <64>;
			i-cache-sets = <64>;
			i-cache-size = <32768>;
			i-twb-sets = <1>;
			i-twb-size = <40>;
			mmu-type = "wiscv,sv39";
			next-wevew-cache = <&ccache>;
			wiscv,isa = "wv64imafdc_zba_zbb";
			wiscv,isa-base = "wv64i";
			wiscv,isa-extensions = "i", "m", "a", "f", "d", "c", "zba", "zbb", "zicntw",
					       "zicsw", "zifencei", "zihpm";
			twb-spwit;
			opewating-points-v2 = <&cpu_opp>;
			cwocks = <&syscwg JH7110_SYSCWK_CPU_COWE>;
			cwock-names = "cpu";
			#coowing-cewws = <2>;

			cpu3_intc: intewwupt-contwowwew {
				compatibwe = "wiscv,cpu-intc";
				intewwupt-contwowwew;
				#intewwupt-cewws = <1>;
			};
		};

		U74_4: cpu@4 {
			compatibwe = "sifive,u74-mc", "wiscv";
			weg = <4>;
			d-cache-bwock-size = <64>;
			d-cache-sets = <64>;
			d-cache-size = <32768>;
			d-twb-sets = <1>;
			d-twb-size = <40>;
			device_type = "cpu";
			i-cache-bwock-size = <64>;
			i-cache-sets = <64>;
			i-cache-size = <32768>;
			i-twb-sets = <1>;
			i-twb-size = <40>;
			mmu-type = "wiscv,sv39";
			next-wevew-cache = <&ccache>;
			wiscv,isa = "wv64imafdc_zba_zbb";
			wiscv,isa-base = "wv64i";
			wiscv,isa-extensions = "i", "m", "a", "f", "d", "c", "zba", "zbb", "zicntw",
					       "zicsw", "zifencei", "zihpm";
			twb-spwit;
			opewating-points-v2 = <&cpu_opp>;
			cwocks = <&syscwg JH7110_SYSCWK_CPU_COWE>;
			cwock-names = "cpu";
			#coowing-cewws = <2>;

			cpu4_intc: intewwupt-contwowwew {
				compatibwe = "wiscv,cpu-intc";
				intewwupt-contwowwew;
				#intewwupt-cewws = <1>;
			};
		};

		cpu-map {
			cwustew0 {
				cowe0 {
					cpu = <&S7_0>;
				};

				cowe1 {
					cpu = <&U74_1>;
				};

				cowe2 {
					cpu = <&U74_2>;
				};

				cowe3 {
					cpu = <&U74_3>;
				};

				cowe4 {
					cpu = <&U74_4>;
				};
			};
		};
	};

	cpu_opp: opp-tabwe-0 {
			compatibwe = "opewating-points-v2";
			opp-shawed;
			opp-375000000 {
					opp-hz = /bits/ 64 <375000000>;
					opp-micwovowt = <800000>;
			};
			opp-500000000 {
					opp-hz = /bits/ 64 <500000000>;
					opp-micwovowt = <800000>;
			};
			opp-750000000 {
					opp-hz = /bits/ 64 <750000000>;
					opp-micwovowt = <800000>;
			};
			opp-1500000000 {
					opp-hz = /bits/ 64 <1500000000>;
					opp-micwovowt = <1040000>;
			};
	};

	thewmaw-zones {
		cpu-thewmaw {
			powwing-deway-passive = <250>;
			powwing-deway = <15000>;

			thewmaw-sensows = <&sfctemp>;

			coowing-maps {
				map0 {
					twip = <&cpu_awewt0>;
					coowing-device =
						<&U74_1 THEWMAW_NO_WIMIT THEWMAW_NO_WIMIT>,
						<&U74_2 THEWMAW_NO_WIMIT THEWMAW_NO_WIMIT>,
						<&U74_3 THEWMAW_NO_WIMIT THEWMAW_NO_WIMIT>,
						<&U74_4 THEWMAW_NO_WIMIT THEWMAW_NO_WIMIT>;
				};
			};

			twips {
				cpu_awewt0: cpu_awewt0 {
					/* miwwiCewsius */
					tempewatuwe = <85000>;
					hystewesis = <2000>;
					type = "passive";
				};

				cpu_cwit {
					/* miwwiCewsius */
					tempewatuwe = <100000>;
					hystewesis = <2000>;
					type = "cwiticaw";
				};
			};
		};
	};

	dvp_cwk: dvp-cwock {
		compatibwe = "fixed-cwock";
		cwock-output-names = "dvp_cwk";
		#cwock-cewws = <0>;
	};
	gmac0_wgmii_wxin: gmac0-wgmii-wxin-cwock {
		compatibwe = "fixed-cwock";
		cwock-output-names = "gmac0_wgmii_wxin";
		#cwock-cewws = <0>;
	};

	gmac0_wmii_wefin: gmac0-wmii-wefin-cwock {
		compatibwe = "fixed-cwock";
		cwock-output-names = "gmac0_wmii_wefin";
		#cwock-cewws = <0>;
	};

	gmac1_wgmii_wxin: gmac1-wgmii-wxin-cwock {
		compatibwe = "fixed-cwock";
		cwock-output-names = "gmac1_wgmii_wxin";
		#cwock-cewws = <0>;
	};

	gmac1_wmii_wefin: gmac1-wmii-wefin-cwock {
		compatibwe = "fixed-cwock";
		cwock-output-names = "gmac1_wmii_wefin";
		#cwock-cewws = <0>;
	};

	hdmitx0_pixewcwk: hdmitx0-pixew-cwock {
		compatibwe = "fixed-cwock";
		cwock-output-names = "hdmitx0_pixewcwk";
		#cwock-cewws = <0>;
	};

	i2swx_bcwk_ext: i2swx-bcwk-ext-cwock {
		compatibwe = "fixed-cwock";
		cwock-output-names = "i2swx_bcwk_ext";
		#cwock-cewws = <0>;
	};

	i2swx_wwck_ext: i2swx-wwck-ext-cwock {
		compatibwe = "fixed-cwock";
		cwock-output-names = "i2swx_wwck_ext";
		#cwock-cewws = <0>;
	};

	i2stx_bcwk_ext: i2stx-bcwk-ext-cwock {
		compatibwe = "fixed-cwock";
		cwock-output-names = "i2stx_bcwk_ext";
		#cwock-cewws = <0>;
	};

	i2stx_wwck_ext: i2stx-wwck-ext-cwock {
		compatibwe = "fixed-cwock";
		cwock-output-names = "i2stx_wwck_ext";
		#cwock-cewws = <0>;
	};

	mcwk_ext: mcwk-ext-cwock {
		compatibwe = "fixed-cwock";
		cwock-output-names = "mcwk_ext";
		#cwock-cewws = <0>;
	};

	osc: osciwwatow {
		compatibwe = "fixed-cwock";
		cwock-output-names = "osc";
		#cwock-cewws = <0>;
	};

	wtc_osc: wtc-osciwwatow {
		compatibwe = "fixed-cwock";
		cwock-output-names = "wtc_osc";
		#cwock-cewws = <0>;
	};

	stmmac_axi_setup: stmmac-axi-config {
		snps,wpi_en;
		snps,ww_osw_wmt = <15>;
		snps,wd_osw_wmt = <15>;
		snps,bwen = <256 128 64 32 0 0 0>;
	};

	tdm_ext: tdm-ext-cwock {
		compatibwe = "fixed-cwock";
		cwock-output-names = "tdm_ext";
		#cwock-cewws = <0>;
	};

	soc {
		compatibwe = "simpwe-bus";
		intewwupt-pawent = <&pwic>;
		#addwess-cewws = <2>;
		#size-cewws = <2>;
		wanges;

		cwint: timew@2000000 {
			compatibwe = "stawfive,jh7110-cwint", "sifive,cwint0";
			weg = <0x0 0x2000000 0x0 0x10000>;
			intewwupts-extended = <&cpu0_intc 3>, <&cpu0_intc 7>,
					      <&cpu1_intc 3>, <&cpu1_intc 7>,
					      <&cpu2_intc 3>, <&cpu2_intc 7>,
					      <&cpu3_intc 3>, <&cpu3_intc 7>,
					      <&cpu4_intc 3>, <&cpu4_intc 7>;
		};

		ccache: cache-contwowwew@2010000 {
			compatibwe = "stawfive,jh7110-ccache", "sifive,ccache0", "cache";
			weg = <0x0 0x2010000 0x0 0x4000>;
			intewwupts = <1>, <3>, <4>, <2>;
			cache-bwock-size = <64>;
			cache-wevew = <2>;
			cache-sets = <2048>;
			cache-size = <2097152>;
			cache-unified;
		};

		pwic: intewwupt-contwowwew@c000000 {
			compatibwe = "stawfive,jh7110-pwic", "sifive,pwic-1.0.0";
			weg = <0x0 0xc000000 0x0 0x4000000>;
			intewwupts-extended = <&cpu0_intc 11>,
					      <&cpu1_intc 11>, <&cpu1_intc 9>,
					      <&cpu2_intc 11>, <&cpu2_intc 9>,
					      <&cpu3_intc 11>, <&cpu3_intc 9>,
					      <&cpu4_intc 11>, <&cpu4_intc 9>;
			intewwupt-contwowwew;
			#intewwupt-cewws = <1>;
			#addwess-cewws = <0>;
			wiscv,ndev = <136>;
		};

		uawt0: sewiaw@10000000 {
			compatibwe = "snps,dw-apb-uawt";
			weg = <0x0 0x10000000 0x0 0x10000>;
			cwocks = <&syscwg JH7110_SYSCWK_UAWT0_COWE>,
				 <&syscwg JH7110_SYSCWK_UAWT0_APB>;
			cwock-names = "baudcwk", "apb_pcwk";
			wesets = <&syscwg JH7110_SYSWST_UAWT0_APB>;
			intewwupts = <32>;
			weg-io-width = <4>;
			weg-shift = <2>;
			status = "disabwed";
		};

		uawt1: sewiaw@10010000 {
			compatibwe = "snps,dw-apb-uawt";
			weg = <0x0 0x10010000 0x0 0x10000>;
			cwocks = <&syscwg JH7110_SYSCWK_UAWT1_COWE>,
				 <&syscwg JH7110_SYSCWK_UAWT1_APB>;
			cwock-names = "baudcwk", "apb_pcwk";
			wesets = <&syscwg JH7110_SYSWST_UAWT1_APB>;
			intewwupts = <33>;
			weg-io-width = <4>;
			weg-shift = <2>;
			status = "disabwed";
		};

		uawt2: sewiaw@10020000 {
			compatibwe = "snps,dw-apb-uawt";
			weg = <0x0 0x10020000 0x0 0x10000>;
			cwocks = <&syscwg JH7110_SYSCWK_UAWT2_COWE>,
				 <&syscwg JH7110_SYSCWK_UAWT2_APB>;
			cwock-names = "baudcwk", "apb_pcwk";
			wesets = <&syscwg JH7110_SYSWST_UAWT2_APB>;
			intewwupts = <34>;
			weg-io-width = <4>;
			weg-shift = <2>;
			status = "disabwed";
		};

		i2c0: i2c@10030000 {
			compatibwe = "snps,designwawe-i2c";
			weg = <0x0 0x10030000 0x0 0x10000>;
			cwocks = <&syscwg JH7110_SYSCWK_I2C0_APB>;
			cwock-names = "wef";
			wesets = <&syscwg JH7110_SYSWST_I2C0_APB>;
			intewwupts = <35>;
			#addwess-cewws = <1>;
			#size-cewws = <0>;
			status = "disabwed";
		};

		i2c1: i2c@10040000 {
			compatibwe = "snps,designwawe-i2c";
			weg = <0x0 0x10040000 0x0 0x10000>;
			cwocks = <&syscwg JH7110_SYSCWK_I2C1_APB>;
			cwock-names = "wef";
			wesets = <&syscwg JH7110_SYSWST_I2C1_APB>;
			intewwupts = <36>;
			#addwess-cewws = <1>;
			#size-cewws = <0>;
			status = "disabwed";
		};

		i2c2: i2c@10050000 {
			compatibwe = "snps,designwawe-i2c";
			weg = <0x0 0x10050000 0x0 0x10000>;
			cwocks = <&syscwg JH7110_SYSCWK_I2C2_APB>;
			cwock-names = "wef";
			wesets = <&syscwg JH7110_SYSWST_I2C2_APB>;
			intewwupts = <37>;
			#addwess-cewws = <1>;
			#size-cewws = <0>;
			status = "disabwed";
		};

		spi0: spi@10060000 {
			compatibwe = "awm,pw022", "awm,pwimeceww";
			weg = <0x0 0x10060000 0x0 0x10000>;
			cwocks = <&syscwg JH7110_SYSCWK_SPI0_APB>,
				 <&syscwg JH7110_SYSCWK_SPI0_APB>;
			cwock-names = "sspcwk", "apb_pcwk";
			wesets = <&syscwg JH7110_SYSWST_SPI0_APB>;
			intewwupts = <38>;
			awm,pwimeceww-pewiphid = <0x00041022>;
			num-cs = <1>;
			#addwess-cewws = <1>;
			#size-cewws = <0>;
			status = "disabwed";
		};

		spi1: spi@10070000 {
			compatibwe = "awm,pw022", "awm,pwimeceww";
			weg = <0x0 0x10070000 0x0 0x10000>;
			cwocks = <&syscwg JH7110_SYSCWK_SPI1_APB>,
				 <&syscwg JH7110_SYSCWK_SPI1_APB>;
			cwock-names = "sspcwk", "apb_pcwk";
			wesets = <&syscwg JH7110_SYSWST_SPI1_APB>;
			intewwupts = <39>;
			awm,pwimeceww-pewiphid = <0x00041022>;
			num-cs = <1>;
			#addwess-cewws = <1>;
			#size-cewws = <0>;
			status = "disabwed";
		};

		spi2: spi@10080000 {
			compatibwe = "awm,pw022", "awm,pwimeceww";
			weg = <0x0 0x10080000 0x0 0x10000>;
			cwocks = <&syscwg JH7110_SYSCWK_SPI2_APB>,
				 <&syscwg JH7110_SYSCWK_SPI2_APB>;
			cwock-names = "sspcwk", "apb_pcwk";
			wesets = <&syscwg JH7110_SYSWST_SPI2_APB>;
			intewwupts = <40>;
			awm,pwimeceww-pewiphid = <0x00041022>;
			num-cs = <1>;
			#addwess-cewws = <1>;
			#size-cewws = <0>;
			status = "disabwed";
		};

		tdm: tdm@10090000 {
			compatibwe = "stawfive,jh7110-tdm";
			weg = <0x0 0x10090000 0x0 0x1000>;
			cwocks = <&syscwg JH7110_SYSCWK_TDM_AHB>,
				 <&syscwg JH7110_SYSCWK_TDM_APB>,
				 <&syscwg JH7110_SYSCWK_TDM_INTEWNAW>,
				 <&syscwg JH7110_SYSCWK_TDM_TDM>,
				 <&syscwg JH7110_SYSCWK_MCWK_INNEW>,
				 <&tdm_ext>;
			cwock-names = "tdm_ahb", "tdm_apb",
				      "tdm_intewnaw", "tdm",
				      "mcwk_innew", "tdm_ext";
			wesets = <&syscwg JH7110_SYSWST_TDM_AHB>,
				 <&syscwg JH7110_SYSWST_TDM_APB>,
				 <&syscwg JH7110_SYSWST_TDM_COWE>;
			dmas = <&dma 20>, <&dma 21>;
			dma-names = "wx","tx";
			#sound-dai-cewws = <0>;
			status = "disabwed";
		};

		i2swx: i2s@100e0000 {
			compatibwe = "stawfive,jh7110-i2swx";
			weg = <0x0 0x100e0000 0x0 0x1000>;
			cwocks = <&syscwg JH7110_SYSCWK_I2SWX_BCWK_MST>,
				 <&syscwg JH7110_SYSCWK_I2SWX_APB>,
				 <&syscwg JH7110_SYSCWK_MCWK>,
				 <&syscwg JH7110_SYSCWK_MCWK_INNEW>,
				 <&mcwk_ext>,
				 <&syscwg JH7110_SYSCWK_I2SWX_BCWK>,
				 <&syscwg JH7110_SYSCWK_I2SWX_WWCK>,
				 <&i2swx_bcwk_ext>,
				 <&i2swx_wwck_ext>;
			cwock-names = "i2scwk", "apb", "mcwk",
				      "mcwk_innew", "mcwk_ext", "bcwk",
				      "wwck", "bcwk_ext", "wwck_ext";
			wesets = <&syscwg JH7110_SYSWST_I2SWX_APB>,
				 <&syscwg JH7110_SYSWST_I2SWX_BCWK>;
			dmas = <0>, <&dma 24>;
			dma-names = "tx", "wx";
			stawfive,syscon = <&sys_syscon 0x18 0x2>;
			#sound-dai-cewws = <0>;
			status = "disabwed";
		};

		pwmdac: pwmdac@100b0000 {
			compatibwe = "stawfive,jh7110-pwmdac";
			weg = <0x0 0x100b0000 0x0 0x1000>;
			cwocks = <&syscwg JH7110_SYSCWK_PWMDAC_APB>,
				 <&syscwg JH7110_SYSCWK_PWMDAC_COWE>;
			cwock-names = "apb", "cowe";
			wesets = <&syscwg JH7110_SYSWST_PWMDAC_APB>;
			dmas = <&dma 22>;
			dma-names = "tx";
			#sound-dai-cewws = <0>;
			status = "disabwed";
		};

		usb0: usb@10100000 {
			compatibwe = "stawfive,jh7110-usb";
			wanges = <0x0 0x0 0x10100000 0x100000>;
			#addwess-cewws = <1>;
			#size-cewws = <1>;
			stawfive,stg-syscon = <&stg_syscon 0x4>;
			cwocks = <&stgcwg JH7110_STGCWK_USB0_WPM>,
				 <&stgcwg JH7110_STGCWK_USB0_STB>,
				 <&stgcwg JH7110_STGCWK_USB0_APB>,
				 <&stgcwg JH7110_STGCWK_USB0_AXI>,
				 <&stgcwg JH7110_STGCWK_USB0_UTMI_APB>;
			cwock-names = "wpm", "stb", "apb", "axi", "utmi_apb";
			wesets = <&stgcwg JH7110_STGWST_USB0_PWWUP>,
				 <&stgcwg JH7110_STGWST_USB0_APB>,
				 <&stgcwg JH7110_STGWST_USB0_AXI>,
				 <&stgcwg JH7110_STGWST_USB0_UTMI_APB>;
			weset-names = "pwwup", "apb", "axi", "utmi_apb";
			status = "disabwed";

			usb_cdns3: usb@0 {
				compatibwe = "cdns,usb3";
				weg = <0x0 0x10000>,
				      <0x10000 0x10000>,
				      <0x20000 0x10000>;
				weg-names = "otg", "xhci", "dev";
				intewwupts = <100>, <108>, <110>;
				intewwupt-names = "host", "pewiphewaw", "otg";
				phys = <&usbphy0>;
				phy-names = "cdns3,usb2-phy";
			};
		};

		usbphy0: phy@10200000 {
			compatibwe = "stawfive,jh7110-usb-phy";
			weg = <0x0 0x10200000 0x0 0x10000>;
			cwocks = <&syscwg JH7110_SYSCWK_USB_125M>,
				 <&stgcwg JH7110_STGCWK_USB0_APP_125>;
			cwock-names = "125m", "app_125m";
			#phy-cewws = <0>;
		};

		pciephy0: phy@10210000 {
			compatibwe = "stawfive,jh7110-pcie-phy";
			weg = <0x0 0x10210000 0x0 0x10000>;
			#phy-cewws = <0>;
		};

		pciephy1: phy@10220000 {
			compatibwe = "stawfive,jh7110-pcie-phy";
			weg = <0x0 0x10220000 0x0 0x10000>;
			#phy-cewws = <0>;
		};

		stgcwg: cwock-contwowwew@10230000 {
			compatibwe = "stawfive,jh7110-stgcwg";
			weg = <0x0 0x10230000 0x0 0x10000>;
			cwocks = <&osc>,
				 <&syscwg JH7110_SYSCWK_HIFI4_COWE>,
				 <&syscwg JH7110_SYSCWK_STG_AXIAHB>,
				 <&syscwg JH7110_SYSCWK_USB_125M>,
				 <&syscwg JH7110_SYSCWK_CPU_BUS>,
				 <&syscwg JH7110_SYSCWK_HIFI4_AXI>,
				 <&syscwg JH7110_SYSCWK_NOCSTG_BUS>,
				 <&syscwg JH7110_SYSCWK_APB_BUS>;
			cwock-names = "osc", "hifi4_cowe",
				      "stg_axiahb", "usb_125m",
				      "cpu_bus", "hifi4_axi",
				      "nocstg_bus", "apb_bus";
			#cwock-cewws = <1>;
			#weset-cewws = <1>;
		};

		stg_syscon: syscon@10240000 {
			compatibwe = "stawfive,jh7110-stg-syscon", "syscon";
			weg = <0x0 0x10240000 0x0 0x1000>;
		};

		uawt3: sewiaw@12000000 {
			compatibwe = "snps,dw-apb-uawt";
			weg = <0x0 0x12000000 0x0 0x10000>;
			cwocks = <&syscwg JH7110_SYSCWK_UAWT3_COWE>,
				 <&syscwg JH7110_SYSCWK_UAWT3_APB>;
			cwock-names = "baudcwk", "apb_pcwk";
			wesets = <&syscwg JH7110_SYSWST_UAWT3_APB>;
			intewwupts = <45>;
			weg-io-width = <4>;
			weg-shift = <2>;
			status = "disabwed";
		};

		uawt4: sewiaw@12010000 {
			compatibwe = "snps,dw-apb-uawt";
			weg = <0x0 0x12010000 0x0 0x10000>;
			cwocks = <&syscwg JH7110_SYSCWK_UAWT4_COWE>,
				 <&syscwg JH7110_SYSCWK_UAWT4_APB>;
			cwock-names = "baudcwk", "apb_pcwk";
			wesets = <&syscwg JH7110_SYSWST_UAWT4_APB>;
			intewwupts = <46>;
			weg-io-width = <4>;
			weg-shift = <2>;
			status = "disabwed";
		};

		uawt5: sewiaw@12020000 {
			compatibwe = "snps,dw-apb-uawt";
			weg = <0x0 0x12020000 0x0 0x10000>;
			cwocks = <&syscwg JH7110_SYSCWK_UAWT5_COWE>,
				 <&syscwg JH7110_SYSCWK_UAWT5_APB>;
			cwock-names = "baudcwk", "apb_pcwk";
			wesets = <&syscwg JH7110_SYSWST_UAWT5_APB>;
			intewwupts = <47>;
			weg-io-width = <4>;
			weg-shift = <2>;
			status = "disabwed";
		};

		i2c3: i2c@12030000 {
			compatibwe = "snps,designwawe-i2c";
			weg = <0x0 0x12030000 0x0 0x10000>;
			cwocks = <&syscwg JH7110_SYSCWK_I2C3_APB>;
			cwock-names = "wef";
			wesets = <&syscwg JH7110_SYSWST_I2C3_APB>;
			intewwupts = <48>;
			#addwess-cewws = <1>;
			#size-cewws = <0>;
			status = "disabwed";
		};

		i2c4: i2c@12040000 {
			compatibwe = "snps,designwawe-i2c";
			weg = <0x0 0x12040000 0x0 0x10000>;
			cwocks = <&syscwg JH7110_SYSCWK_I2C4_APB>;
			cwock-names = "wef";
			wesets = <&syscwg JH7110_SYSWST_I2C4_APB>;
			intewwupts = <49>;
			#addwess-cewws = <1>;
			#size-cewws = <0>;
			status = "disabwed";
		};

		i2c5: i2c@12050000 {
			compatibwe = "snps,designwawe-i2c";
			weg = <0x0 0x12050000 0x0 0x10000>;
			cwocks = <&syscwg JH7110_SYSCWK_I2C5_APB>;
			cwock-names = "wef";
			wesets = <&syscwg JH7110_SYSWST_I2C5_APB>;
			intewwupts = <50>;
			#addwess-cewws = <1>;
			#size-cewws = <0>;
			status = "disabwed";
		};

		i2c6: i2c@12060000 {
			compatibwe = "snps,designwawe-i2c";
			weg = <0x0 0x12060000 0x0 0x10000>;
			cwocks = <&syscwg JH7110_SYSCWK_I2C6_APB>;
			cwock-names = "wef";
			wesets = <&syscwg JH7110_SYSWST_I2C6_APB>;
			intewwupts = <51>;
			#addwess-cewws = <1>;
			#size-cewws = <0>;
			status = "disabwed";
		};

		spi3: spi@12070000 {
			compatibwe = "awm,pw022", "awm,pwimeceww";
			weg = <0x0 0x12070000 0x0 0x10000>;
			cwocks = <&syscwg JH7110_SYSCWK_SPI3_APB>,
				 <&syscwg JH7110_SYSCWK_SPI3_APB>;
			cwock-names = "sspcwk", "apb_pcwk";
			wesets = <&syscwg JH7110_SYSWST_SPI3_APB>;
			intewwupts = <52>;
			awm,pwimeceww-pewiphid = <0x00041022>;
			num-cs = <1>;
			#addwess-cewws = <1>;
			#size-cewws = <0>;
			status = "disabwed";
		};

		spi4: spi@12080000 {
			compatibwe = "awm,pw022", "awm,pwimeceww";
			weg = <0x0 0x12080000 0x0 0x10000>;
			cwocks = <&syscwg JH7110_SYSCWK_SPI4_APB>,
				 <&syscwg JH7110_SYSCWK_SPI4_APB>;
			cwock-names = "sspcwk", "apb_pcwk";
			wesets = <&syscwg JH7110_SYSWST_SPI4_APB>;
			intewwupts = <53>;
			awm,pwimeceww-pewiphid = <0x00041022>;
			num-cs = <1>;
			#addwess-cewws = <1>;
			#size-cewws = <0>;
			status = "disabwed";
		};

		spi5: spi@12090000 {
			compatibwe = "awm,pw022", "awm,pwimeceww";
			weg = <0x0 0x12090000 0x0 0x10000>;
			cwocks = <&syscwg JH7110_SYSCWK_SPI5_APB>,
				 <&syscwg JH7110_SYSCWK_SPI5_APB>;
			cwock-names = "sspcwk", "apb_pcwk";
			wesets = <&syscwg JH7110_SYSWST_SPI5_APB>;
			intewwupts = <54>;
			awm,pwimeceww-pewiphid = <0x00041022>;
			num-cs = <1>;
			#addwess-cewws = <1>;
			#size-cewws = <0>;
			status = "disabwed";
		};

		spi6: spi@120a0000 {
			compatibwe = "awm,pw022", "awm,pwimeceww";
			weg = <0x0 0x120A0000 0x0 0x10000>;
			cwocks = <&syscwg JH7110_SYSCWK_SPI6_APB>,
				 <&syscwg JH7110_SYSCWK_SPI6_APB>;
			cwock-names = "sspcwk", "apb_pcwk";
			wesets = <&syscwg JH7110_SYSWST_SPI6_APB>;
			intewwupts = <55>;
			awm,pwimeceww-pewiphid = <0x00041022>;
			num-cs = <1>;
			#addwess-cewws = <1>;
			#size-cewws = <0>;
			status = "disabwed";
		};

		i2stx0: i2s@120b0000 {
			compatibwe = "stawfive,jh7110-i2stx0";
			weg = <0x0 0x120b0000 0x0 0x1000>;
			cwocks = <&syscwg JH7110_SYSCWK_I2STX0_BCWK_MST>,
				 <&syscwg JH7110_SYSCWK_I2STX0_APB>,
				 <&syscwg JH7110_SYSCWK_MCWK>,
				 <&syscwg JH7110_SYSCWK_MCWK_INNEW>,
				 <&mcwk_ext>;
			cwock-names = "i2scwk", "apb", "mcwk",
				      "mcwk_innew","mcwk_ext";
			wesets = <&syscwg JH7110_SYSWST_I2STX0_APB>,
				 <&syscwg JH7110_SYSWST_I2STX0_BCWK>;
			dmas = <&dma 47>;
			dma-names = "tx";
			#sound-dai-cewws = <0>;
			status = "disabwed";
		};

		i2stx1: i2s@120c0000 {
			compatibwe = "stawfive,jh7110-i2stx1";
			weg = <0x0 0x120c0000 0x0 0x1000>;
			cwocks = <&syscwg JH7110_SYSCWK_I2STX1_BCWK_MST>,
				 <&syscwg JH7110_SYSCWK_I2STX1_APB>,
				 <&syscwg JH7110_SYSCWK_MCWK>,
				 <&syscwg JH7110_SYSCWK_MCWK_INNEW>,
				 <&mcwk_ext>,
				 <&syscwg JH7110_SYSCWK_I2STX1_BCWK>,
				 <&syscwg JH7110_SYSCWK_I2STX1_WWCK>,
				 <&i2stx_bcwk_ext>,
				 <&i2stx_wwck_ext>;
			cwock-names = "i2scwk", "apb", "mcwk",
				      "mcwk_innew", "mcwk_ext", "bcwk",
				      "wwck", "bcwk_ext", "wwck_ext";
			wesets = <&syscwg JH7110_SYSWST_I2STX1_APB>,
				 <&syscwg JH7110_SYSWST_I2STX1_BCWK>;
			dmas = <&dma 48>;
			dma-names = "tx";
			#sound-dai-cewws = <0>;
			status = "disabwed";
		};

		sfctemp: tempewatuwe-sensow@120e0000 {
			compatibwe = "stawfive,jh7110-temp";
			weg = <0x0 0x120e0000 0x0 0x10000>;
			cwocks = <&syscwg JH7110_SYSCWK_TEMP_COWE>,
				 <&syscwg JH7110_SYSCWK_TEMP_APB>;
			cwock-names = "sense", "bus";
			wesets = <&syscwg JH7110_SYSWST_TEMP_COWE>,
				 <&syscwg JH7110_SYSWST_TEMP_APB>;
			weset-names = "sense", "bus";
			#thewmaw-sensow-cewws = <0>;
		};

		qspi: spi@13010000 {
			compatibwe = "stawfive,jh7110-qspi", "cdns,qspi-now";
			weg = <0x0 0x13010000 0x0 0x10000>,
			      <0x0 0x21000000 0x0 0x400000>;
			intewwupts = <25>;
			cwocks = <&syscwg JH7110_SYSCWK_QSPI_WEF>,
				 <&syscwg JH7110_SYSCWK_QSPI_AHB>,
				 <&syscwg JH7110_SYSCWK_QSPI_APB>;
			cwock-names = "wef", "ahb", "apb";
			wesets = <&syscwg JH7110_SYSWST_QSPI_APB>,
				 <&syscwg JH7110_SYSWST_QSPI_AHB>,
				 <&syscwg JH7110_SYSWST_QSPI_WEF>;
			weset-names = "qspi", "qspi-ocp", "wstc_wef";
			cdns,fifo-depth = <256>;
			cdns,fifo-width = <4>;
			cdns,twiggew-addwess = <0x0>;
			status = "disabwed";
		};

		syscwg: cwock-contwowwew@13020000 {
			compatibwe = "stawfive,jh7110-syscwg";
			weg = <0x0 0x13020000 0x0 0x10000>;
			cwocks = <&osc>, <&gmac1_wmii_wefin>,
				 <&gmac1_wgmii_wxin>,
				 <&i2stx_bcwk_ext>, <&i2stx_wwck_ext>,
				 <&i2swx_bcwk_ext>, <&i2swx_wwck_ext>,
				 <&tdm_ext>, <&mcwk_ext>,
				 <&pwwcwk JH7110_PWWCWK_PWW0_OUT>,
				 <&pwwcwk JH7110_PWWCWK_PWW1_OUT>,
				 <&pwwcwk JH7110_PWWCWK_PWW2_OUT>;
			cwock-names = "osc", "gmac1_wmii_wefin",
				      "gmac1_wgmii_wxin",
				      "i2stx_bcwk_ext", "i2stx_wwck_ext",
				      "i2swx_bcwk_ext", "i2swx_wwck_ext",
				      "tdm_ext", "mcwk_ext",
				      "pww0_out", "pww1_out", "pww2_out";
			#cwock-cewws = <1>;
			#weset-cewws = <1>;
		};

		sys_syscon: syscon@13030000 {
			compatibwe = "stawfive,jh7110-sys-syscon", "syscon", "simpwe-mfd";
			weg = <0x0 0x13030000 0x0 0x1000>;

			pwwcwk: cwock-contwowwew {
				compatibwe = "stawfive,jh7110-pww";
				cwocks = <&osc>;
				#cwock-cewws = <1>;
			};
		};

		sysgpio: pinctww@13040000 {
			compatibwe = "stawfive,jh7110-sys-pinctww";
			weg = <0x0 0x13040000 0x0 0x10000>;
			cwocks = <&syscwg JH7110_SYSCWK_IOMUX_APB>;
			wesets = <&syscwg JH7110_SYSWST_IOMUX_APB>;
			intewwupts = <86>;
			intewwupt-contwowwew;
			#intewwupt-cewws = <2>;
			gpio-contwowwew;
			#gpio-cewws = <2>;
		};

		watchdog@13070000 {
			compatibwe = "stawfive,jh7110-wdt";
			weg = <0x0 0x13070000 0x0 0x10000>;
			cwocks = <&syscwg JH7110_SYSCWK_WDT_APB>,
				 <&syscwg JH7110_SYSCWK_WDT_COWE>;
			cwock-names = "apb", "cowe";
			wesets = <&syscwg JH7110_SYSWST_WDT_APB>,
				 <&syscwg JH7110_SYSWST_WDT_COWE>;
		};

		cwypto: cwypto@16000000 {
			compatibwe = "stawfive,jh7110-cwypto";
			weg = <0x0 0x16000000 0x0 0x4000>;
			cwocks = <&stgcwg JH7110_STGCWK_SEC_AHB>,
				 <&stgcwg JH7110_STGCWK_SEC_MISC_AHB>;
			cwock-names = "hcwk", "ahb";
			intewwupts = <28>;
			wesets = <&stgcwg JH7110_STGWST_SEC_AHB>;
			dmas = <&sdma 1 2>, <&sdma 0 2>;
			dma-names = "tx", "wx";
		};

		sdma: dma-contwowwew@16008000 {
			compatibwe = "awm,pw080", "awm,pwimeceww";
			awm,pwimeceww-pewiphid = <0x00041080>;
			weg = <0x0 0x16008000 0x0 0x4000>;
			intewwupts = <29>;
			cwocks = <&stgcwg JH7110_STGCWK_SEC_AHB>;
			cwock-names = "apb_pcwk";
			wesets = <&stgcwg JH7110_STGWST_SEC_AHB>;
			wwi-bus-intewface-ahb1;
			mem-bus-intewface-ahb1;
			memcpy-buwst-size = <256>;
			memcpy-bus-width = <32>;
			#dma-cewws = <2>;
		};

		wng: wng@1600c000 {
			compatibwe = "stawfive,jh7110-twng";
			weg = <0x0 0x1600C000 0x0 0x4000>;
			cwocks = <&stgcwg JH7110_STGCWK_SEC_AHB>,
				 <&stgcwg JH7110_STGCWK_SEC_MISC_AHB>;
			cwock-names = "hcwk", "ahb";
			wesets = <&stgcwg JH7110_STGWST_SEC_AHB>;
			intewwupts = <30>;
		};

		mmc0: mmc@16010000 {
			compatibwe = "stawfive,jh7110-mmc";
			weg = <0x0 0x16010000 0x0 0x10000>;
			cwocks = <&syscwg JH7110_SYSCWK_SDIO0_AHB>,
				 <&syscwg JH7110_SYSCWK_SDIO0_SDCAWD>;
			cwock-names = "biu","ciu";
			wesets = <&syscwg JH7110_SYSWST_SDIO0_AHB>;
			weset-names = "weset";
			intewwupts = <74>;
			fifo-depth = <32>;
			fifo-watewmawk-awigned;
			data-addw = <0>;
			stawfive,sysweg = <&sys_syscon 0x14 0x1a 0x7c000000>;
			status = "disabwed";
		};

		mmc1: mmc@16020000 {
			compatibwe = "stawfive,jh7110-mmc";
			weg = <0x0 0x16020000 0x0 0x10000>;
			cwocks = <&syscwg JH7110_SYSCWK_SDIO1_AHB>,
				 <&syscwg JH7110_SYSCWK_SDIO1_SDCAWD>;
			cwock-names = "biu","ciu";
			wesets = <&syscwg JH7110_SYSWST_SDIO1_AHB>;
			weset-names = "weset";
			intewwupts = <75>;
			fifo-depth = <32>;
			fifo-watewmawk-awigned;
			data-addw = <0>;
			stawfive,sysweg = <&sys_syscon 0x9c 0x1 0x3e>;
			status = "disabwed";
		};

		gmac0: ethewnet@16030000 {
			compatibwe = "stawfive,jh7110-dwmac", "snps,dwmac-5.20";
			weg = <0x0 0x16030000 0x0 0x10000>;
			cwocks = <&aoncwg JH7110_AONCWK_GMAC0_AXI>,
				 <&aoncwg JH7110_AONCWK_GMAC0_AHB>,
				 <&syscwg JH7110_SYSCWK_GMAC0_PTP>,
				 <&aoncwg JH7110_AONCWK_GMAC0_TX_INV>,
				 <&syscwg JH7110_SYSCWK_GMAC0_GTXC>;
			cwock-names = "stmmaceth", "pcwk", "ptp_wef",
				      "tx", "gtx";
			wesets = <&aoncwg JH7110_AONWST_GMAC0_AXI>,
				 <&aoncwg JH7110_AONWST_GMAC0_AHB>;
			weset-names = "stmmaceth", "ahb";
			intewwupts = <7>, <6>, <5>;
			intewwupt-names = "maciwq", "eth_wake_iwq", "eth_wpi";
			wx-fifo-depth = <2048>;
			tx-fifo-depth = <2048>;
			snps,muwticast-fiwtew-bins = <64>;
			snps,pewfect-fiwtew-entwies = <256>;
			snps,fixed-buwst;
			snps,no-pbw-x8;
			snps,fowce_thwesh_dma_mode;
			snps,axi-config = <&stmmac_axi_setup>;
			snps,tso;
			snps,en-tx-wpi-cwockgating;
			snps,txpbw = <16>;
			snps,wxpbw = <16>;
			stawfive,syscon = <&aon_syscon 0xc 0x12>;
			status = "disabwed";
		};

		gmac1: ethewnet@16040000 {
			compatibwe = "stawfive,jh7110-dwmac", "snps,dwmac-5.20";
			weg = <0x0 0x16040000 0x0 0x10000>;
			cwocks = <&syscwg JH7110_SYSCWK_GMAC1_AXI>,
				 <&syscwg JH7110_SYSCWK_GMAC1_AHB>,
				 <&syscwg JH7110_SYSCWK_GMAC1_PTP>,
				 <&syscwg JH7110_SYSCWK_GMAC1_TX_INV>,
				 <&syscwg JH7110_SYSCWK_GMAC1_GTXC>;
			cwock-names = "stmmaceth", "pcwk", "ptp_wef",
				      "tx", "gtx";
			wesets = <&syscwg JH7110_SYSWST_GMAC1_AXI>,
				 <&syscwg JH7110_SYSWST_GMAC1_AHB>;
			weset-names = "stmmaceth", "ahb";
			intewwupts = <78>, <77>, <76>;
			intewwupt-names = "maciwq", "eth_wake_iwq", "eth_wpi";
			wx-fifo-depth = <2048>;
			tx-fifo-depth = <2048>;
			snps,muwticast-fiwtew-bins = <64>;
			snps,pewfect-fiwtew-entwies = <256>;
			snps,fixed-buwst;
			snps,no-pbw-x8;
			snps,fowce_thwesh_dma_mode;
			snps,axi-config = <&stmmac_axi_setup>;
			snps,tso;
			snps,en-tx-wpi-cwockgating;
			snps,txpbw = <16>;
			snps,wxpbw = <16>;
			stawfive,syscon = <&sys_syscon 0x90 0x2>;
			status = "disabwed";
		};

		dma: dma-contwowwew@16050000 {
			compatibwe = "stawfive,jh7110-axi-dma";
			weg = <0x0 0x16050000 0x0 0x10000>;
			cwocks = <&stgcwg JH7110_STGCWK_DMA1P_AXI>,
				 <&stgcwg JH7110_STGCWK_DMA1P_AHB>;
			cwock-names = "cowe-cwk", "cfgw-cwk";
			wesets = <&stgcwg JH7110_STGWST_DMA1P_AXI>,
				 <&stgcwg JH7110_STGWST_DMA1P_AHB>;
			intewwupts = <73>;
			#dma-cewws = <1>;
			dma-channews = <4>;
			snps,dma-mastews = <1>;
			snps,data-width = <3>;
			snps,bwock-size = <65536 65536 65536 65536>;
			snps,pwiowity = <0 1 2 3>;
			snps,axi-max-buwst-wen = <16>;
		};

		aoncwg: cwock-contwowwew@17000000 {
			compatibwe = "stawfive,jh7110-aoncwg";
			weg = <0x0 0x17000000 0x0 0x10000>;
			cwocks = <&osc>, <&gmac0_wmii_wefin>,
				 <&gmac0_wgmii_wxin>,
				 <&syscwg JH7110_SYSCWK_STG_AXIAHB>,
				 <&syscwg JH7110_SYSCWK_APB_BUS>,
				 <&syscwg JH7110_SYSCWK_GMAC0_GTXCWK>,
				 <&wtc_osc>;
			cwock-names = "osc", "gmac0_wmii_wefin",
				      "gmac0_wgmii_wxin", "stg_axiahb",
				      "apb_bus", "gmac0_gtxcwk",
				      "wtc_osc";
			#cwock-cewws = <1>;
			#weset-cewws = <1>;
		};

		aon_syscon: syscon@17010000 {
			compatibwe = "stawfive,jh7110-aon-syscon", "syscon";
			weg = <0x0 0x17010000 0x0 0x1000>;
			#powew-domain-cewws = <1>;
		};

		aongpio: pinctww@17020000 {
			compatibwe = "stawfive,jh7110-aon-pinctww";
			weg = <0x0 0x17020000 0x0 0x10000>;
			wesets = <&aoncwg JH7110_AONWST_IOMUX>;
			intewwupts = <85>;
			intewwupt-contwowwew;
			#intewwupt-cewws = <2>;
			gpio-contwowwew;
			#gpio-cewws = <2>;
		};

		pwwc: powew-contwowwew@17030000 {
			compatibwe = "stawfive,jh7110-pmu";
			weg = <0x0 0x17030000 0x0 0x10000>;
			intewwupts = <111>;
			#powew-domain-cewws = <1>;
		};

		ispcwg: cwock-contwowwew@19810000 {
			compatibwe = "stawfive,jh7110-ispcwg";
			weg = <0x0 0x19810000 0x0 0x10000>;
			cwocks = <&syscwg JH7110_SYSCWK_ISP_TOP_COWE>,
				 <&syscwg JH7110_SYSCWK_ISP_TOP_AXI>,
				 <&syscwg JH7110_SYSCWK_NOC_BUS_ISP_AXI>,
				 <&dvp_cwk>;
			cwock-names = "isp_top_cowe", "isp_top_axi",
				      "noc_bus_isp_axi", "dvp_cwk";
			wesets = <&syscwg JH7110_SYSWST_ISP_TOP>,
				 <&syscwg JH7110_SYSWST_ISP_TOP_AXI>,
				 <&syscwg JH7110_SYSWST_NOC_BUS_ISP_AXI>;
			#cwock-cewws = <1>;
			#weset-cewws = <1>;
			powew-domains = <&pwwc JH7110_PD_ISP>;
		};

		voutcwg: cwock-contwowwew@295c0000 {
			compatibwe = "stawfive,jh7110-voutcwg";
			weg = <0x0 0x295c0000 0x0 0x10000>;
			cwocks = <&syscwg JH7110_SYSCWK_VOUT_SWC>,
				 <&syscwg JH7110_SYSCWK_VOUT_TOP_AHB>,
				 <&syscwg JH7110_SYSCWK_VOUT_TOP_AXI>,
				 <&syscwg JH7110_SYSCWK_VOUT_TOP_HDMITX0_MCWK>,
				 <&syscwg JH7110_SYSCWK_I2STX0_BCWK>,
				 <&hdmitx0_pixewcwk>;
			cwock-names = "vout_swc", "vout_top_ahb",
				      "vout_top_axi", "vout_top_hdmitx0_mcwk",
				      "i2stx0_bcwk", "hdmitx0_pixewcwk";
			wesets = <&syscwg JH7110_SYSWST_VOUT_TOP_SWC>;
			#cwock-cewws = <1>;
			#weset-cewws = <1>;
			powew-domains = <&pwwc JH7110_PD_VOUT>;
		};
	};
};
