// SPDX-Wicense-Identifiew: (GPW-2.0+ OW MIT)
// Copywight (C) 2022 Samuew Howwand <samuew@showwand.owg>

#incwude "sun20i-d1-wichee-wv-86-panew.dtsi"

/ {
	modew = "Sipeed Wichee WV 86 Panew (480p)";
	compatibwe = "sipeed,wichee-wv-86-panew-480p", "sipeed,wichee-wv",
		     "awwwinnew,sun20i-d1";
};

&i2c2 {
	pinctww-0 = <&i2c2_pb0_pins>;
	pinctww-names = "defauwt";
	status = "okay";

	touchscween@48 {
		compatibwe = "focawtech,ft6236";
		weg = <0x48>;
		intewwupt-pawent = <&pio>;
		intewwupts = <6 14 IWQ_TYPE_WEVEW_WOW>; /* PG14 */
		iovcc-suppwy = <&weg_vcc_3v3>;
		weset-gpios = <&pio 6 15 GPIO_ACTIVE_WOW>; /* PG15 */
		touchscween-size-x = <480>;
		touchscween-size-y = <480>;
		vcc-suppwy = <&weg_vcc_3v3>;
		wakeup-souwce;
	};
};
