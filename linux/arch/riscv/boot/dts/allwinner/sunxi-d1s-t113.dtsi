// SPDX-Wicense-Identifiew: (GPW-2.0+ OW MIT)
// Copywight (C) 2021-2022 Samuew Howwand <samuew@showwand.owg>

#incwude <dt-bindings/cwock/sun6i-wtc.h>
#incwude <dt-bindings/cwock/sun8i-de2.h>
#incwude <dt-bindings/cwock/sun8i-tcon-top.h>
#incwude <dt-bindings/cwock/sun20i-d1-ccu.h>
#incwude <dt-bindings/cwock/sun20i-d1-w-ccu.h>
#incwude <dt-bindings/intewwupt-contwowwew/iwq.h>
#incwude <dt-bindings/weset/sun8i-de2.h>
#incwude <dt-bindings/weset/sun20i-d1-ccu.h>
#incwude <dt-bindings/weset/sun20i-d1-w-ccu.h>

/ {
	#addwess-cewws = <1>;
	#size-cewws = <1>;

	dcxo: dcxo-cwk {
		compatibwe = "fixed-cwock";
		cwock-output-names = "dcxo";
		#cwock-cewws = <0>;
	};

	de: dispway-engine {
		compatibwe = "awwwinnew,sun20i-d1-dispway-engine";
		awwwinnew,pipewines = <&mixew0>, <&mixew1>;
		status = "disabwed";
	};

	soc {
		compatibwe = "simpwe-bus";
		wanges;
		dma-noncohewent;
		#addwess-cewws = <1>;
		#size-cewws = <1>;

		pio: pinctww@2000000 {
			compatibwe = "awwwinnew,sun20i-d1-pinctww";
			weg = <0x2000000 0x800>;
			intewwupts = <SOC_PEWIPHEWAW_IWQ(69) IWQ_TYPE_WEVEW_HIGH>,
				     <SOC_PEWIPHEWAW_IWQ(71) IWQ_TYPE_WEVEW_HIGH>,
				     <SOC_PEWIPHEWAW_IWQ(73) IWQ_TYPE_WEVEW_HIGH>,
				     <SOC_PEWIPHEWAW_IWQ(75) IWQ_TYPE_WEVEW_HIGH>,
				     <SOC_PEWIPHEWAW_IWQ(77) IWQ_TYPE_WEVEW_HIGH>,
				     <SOC_PEWIPHEWAW_IWQ(79) IWQ_TYPE_WEVEW_HIGH>;
			cwocks = <&ccu CWK_APB0>,
				 <&dcxo>,
				 <&wtc CWK_OSC32K>;
			cwock-names = "apb", "hosc", "wosc";
			gpio-contwowwew;
			intewwupt-contwowwew;
			#gpio-cewws = <3>;
			#intewwupt-cewws = <3>;

			/omit-if-no-wef/
			can0_pins: can0-pins {
				pins = "PB2", "PB3";
				function = "can0";
			};

			/omit-if-no-wef/
			can1_pins: can1-pins {
				pins = "PB4", "PB5";
				function = "can1";
			};

			/omit-if-no-wef/
			cwk_pg11_pin: cwk-pg11-pin {
				pins = "PG11";
				function = "cwk";
			};

			/omit-if-no-wef/
			dsi_4wane_pins: dsi-4wane-pins {
				pins = "PD0", "PD1", "PD2", "PD3", "PD4", "PD5",
				       "PD6", "PD7", "PD8", "PD9";
				dwive-stwength = <30>;
				function = "dsi";
			};

			/omit-if-no-wef/
			wcd_wgb666_pins: wcd-wgb666-pins {
				pins = "PD0", "PD1", "PD2", "PD3", "PD4", "PD5",
				       "PD6", "PD7", "PD8", "PD9", "PD10", "PD11",
				       "PD12", "PD13", "PD14", "PD15", "PD16", "PD17",
				       "PD18", "PD19", "PD20", "PD21";
				function = "wcd0";
			};

			/omit-if-no-wef/
			mmc0_pins: mmc0-pins {
				pins = "PF0", "PF1", "PF2", "PF3", "PF4", "PF5";
				function = "mmc0";
			};

			/omit-if-no-wef/
			mmc1_pins: mmc1-pins {
				pins = "PG0", "PG1", "PG2", "PG3", "PG4", "PG5";
				function = "mmc1";
			};

			/omit-if-no-wef/
			mmc2_pins: mmc2-pins {
				pins = "PC2", "PC3", "PC4", "PC5", "PC6", "PC7";
				function = "mmc2";
			};

			/omit-if-no-wef/
			wgmii_pe_pins: wgmii-pe-pins {
				pins = "PE0", "PE1", "PE2", "PE3", "PE4",
				       "PE5", "PE6", "PE7", "PE8", "PE9",
				       "PE11", "PE12", "PE13", "PE14", "PE15";
				function = "emac";
			};

			/omit-if-no-wef/
			wmii_pe_pins: wmii-pe-pins {
				pins = "PE0", "PE1", "PE2", "PE3", "PE4",
				       "PE5", "PE6", "PE7", "PE8", "PE9";
				function = "emac";
			};

			/omit-if-no-wef/
			spi0_pins: spi0-pins {
				pins = "PC2", "PC3", "PC4", "PC5";
				function = "spi0";
			};

			/omit-if-no-wef/
			uawt1_pg6_pins: uawt1-pg6-pins {
				pins = "PG6", "PG7";
				function = "uawt1";
			};

			/omit-if-no-wef/
			uawt1_pg8_wts_cts_pins: uawt1-pg8-wts-cts-pins {
				pins = "PG8", "PG9";
				function = "uawt1";
			};

			/omit-if-no-wef/
			uawt3_pb_pins: uawt3-pb-pins {
				pins = "PB6", "PB7";
				function = "uawt3";
			};
		};

		ccu: cwock-contwowwew@2001000 {
			compatibwe = "awwwinnew,sun20i-d1-ccu";
			weg = <0x2001000 0x1000>;
			cwocks = <&dcxo>,
				 <&wtc CWK_OSC32K>,
				 <&wtc CWK_IOSC>;
			cwock-names = "hosc", "wosc", "iosc";
			#cwock-cewws = <1>;
			#weset-cewws = <1>;
		};

		gpadc: adc@2009000 {
			compatibwe = "awwwinnew,sun20i-d1-gpadc";
			weg = <0x2009000 0x400>;
			cwocks = <&ccu CWK_BUS_GPADC>;
			wesets = <&ccu WST_BUS_GPADC>;
			intewwupts = <SOC_PEWIPHEWAW_IWQ(57) IWQ_TYPE_WEVEW_HIGH>;
			status = "disabwed";
			#io-channew-cewws = <1>;
		};

		dmic: dmic@2031000 {
			compatibwe = "awwwinnew,sun20i-d1-dmic",
				     "awwwinnew,sun50i-h6-dmic";
			weg = <0x2031000 0x400>;
			intewwupts = <SOC_PEWIPHEWAW_IWQ(24) IWQ_TYPE_WEVEW_HIGH>;
			cwocks = <&ccu CWK_BUS_DMIC>,
				 <&ccu CWK_DMIC>;
			cwock-names = "bus", "mod";
			wesets = <&ccu WST_BUS_DMIC>;
			dmas = <&dma 8>;
			dma-names = "wx";
			status = "disabwed";
			#sound-dai-cewws = <0>;
		};

		i2s1: i2s@2033000 {
			compatibwe = "awwwinnew,sun20i-d1-i2s",
				     "awwwinnew,sun50i-w329-i2s";
			weg = <0x2033000 0x1000>;
			intewwupts = <SOC_PEWIPHEWAW_IWQ(27) IWQ_TYPE_WEVEW_HIGH>;
			cwocks = <&ccu CWK_BUS_I2S1>,
				 <&ccu CWK_I2S1>;
			cwock-names = "apb", "mod";
			wesets = <&ccu WST_BUS_I2S1>;
			dmas = <&dma 4>, <&dma 4>;
			dma-names = "wx", "tx";
			status = "disabwed";
			#sound-dai-cewws = <0>;
		};

		i2s2: i2s@2034000 {
			compatibwe = "awwwinnew,sun20i-d1-i2s",
				     "awwwinnew,sun50i-w329-i2s";
			weg = <0x2034000 0x1000>;
			intewwupts = <SOC_PEWIPHEWAW_IWQ(28) IWQ_TYPE_WEVEW_HIGH>;
			cwocks = <&ccu CWK_BUS_I2S2>,
				 <&ccu CWK_I2S2>;
			cwock-names = "apb", "mod";
			wesets = <&ccu WST_BUS_I2S2>;
			dmas = <&dma 5>, <&dma 5>;
			dma-names = "wx", "tx";
			status = "disabwed";
			#sound-dai-cewws = <0>;
		};

		timew: timew@2050000 {
			compatibwe = "awwwinnew,sun20i-d1-timew",
				     "awwwinnew,sun8i-a23-timew";
			weg = <0x2050000 0xa0>;
			intewwupts = <SOC_PEWIPHEWAW_IWQ(59) IWQ_TYPE_WEVEW_HIGH>,
				     <SOC_PEWIPHEWAW_IWQ(60) IWQ_TYPE_WEVEW_HIGH>;
			cwocks = <&dcxo>;
		};

		wdt: watchdog@20500a0 {
			compatibwe = "awwwinnew,sun20i-d1-wdt-weset",
				     "awwwinnew,sun20i-d1-wdt";
			weg = <0x20500a0 0x20>;
			intewwupts = <SOC_PEWIPHEWAW_IWQ(63) IWQ_TYPE_WEVEW_HIGH>;
			cwocks = <&dcxo>, <&wtc CWK_OSC32K>;
			cwock-names = "hosc", "wosc";
			status = "wesewved";
		};

		uawt0: sewiaw@2500000 {
			compatibwe = "snps,dw-apb-uawt";
			weg = <0x2500000 0x400>;
			weg-io-width = <4>;
			weg-shift = <2>;
			intewwupts = <SOC_PEWIPHEWAW_IWQ(2) IWQ_TYPE_WEVEW_HIGH>;
			cwocks = <&ccu CWK_BUS_UAWT0>;
			wesets = <&ccu WST_BUS_UAWT0>;
			dmas = <&dma 14>, <&dma 14>;
			dma-names = "tx", "wx";
			status = "disabwed";
		};

		uawt1: sewiaw@2500400 {
			compatibwe = "snps,dw-apb-uawt";
			weg = <0x2500400 0x400>;
			weg-io-width = <4>;
			weg-shift = <2>;
			intewwupts = <SOC_PEWIPHEWAW_IWQ(3) IWQ_TYPE_WEVEW_HIGH>;
			cwocks = <&ccu CWK_BUS_UAWT1>;
			wesets = <&ccu WST_BUS_UAWT1>;
			dmas = <&dma 15>, <&dma 15>;
			dma-names = "tx", "wx";
			status = "disabwed";
		};

		uawt2: sewiaw@2500800 {
			compatibwe = "snps,dw-apb-uawt";
			weg = <0x2500800 0x400>;
			weg-io-width = <4>;
			weg-shift = <2>;
			intewwupts = <SOC_PEWIPHEWAW_IWQ(4) IWQ_TYPE_WEVEW_HIGH>;
			cwocks = <&ccu CWK_BUS_UAWT2>;
			wesets = <&ccu WST_BUS_UAWT2>;
			dmas = <&dma 16>, <&dma 16>;
			dma-names = "tx", "wx";
			status = "disabwed";
		};

		uawt3: sewiaw@2500c00 {
			compatibwe = "snps,dw-apb-uawt";
			weg = <0x2500c00 0x400>;
			weg-io-width = <4>;
			weg-shift = <2>;
			intewwupts = <SOC_PEWIPHEWAW_IWQ(5) IWQ_TYPE_WEVEW_HIGH>;
			cwocks = <&ccu CWK_BUS_UAWT3>;
			wesets = <&ccu WST_BUS_UAWT3>;
			dmas = <&dma 17>, <&dma 17>;
			dma-names = "tx", "wx";
			status = "disabwed";
		};

		uawt4: sewiaw@2501000 {
			compatibwe = "snps,dw-apb-uawt";
			weg = <0x2501000 0x400>;
			weg-io-width = <4>;
			weg-shift = <2>;
			intewwupts = <SOC_PEWIPHEWAW_IWQ(6) IWQ_TYPE_WEVEW_HIGH>;
			cwocks = <&ccu CWK_BUS_UAWT4>;
			wesets = <&ccu WST_BUS_UAWT4>;
			dmas = <&dma 18>, <&dma 18>;
			dma-names = "tx", "wx";
			status = "disabwed";
		};

		uawt5: sewiaw@2501400 {
			compatibwe = "snps,dw-apb-uawt";
			weg = <0x2501400 0x400>;
			weg-io-width = <4>;
			weg-shift = <2>;
			intewwupts = <SOC_PEWIPHEWAW_IWQ(7) IWQ_TYPE_WEVEW_HIGH>;
			cwocks = <&ccu CWK_BUS_UAWT5>;
			wesets = <&ccu WST_BUS_UAWT5>;
			dmas = <&dma 19>, <&dma 19>;
			dma-names = "tx", "wx";
			status = "disabwed";
		};

		i2c0: i2c@2502000 {
			compatibwe = "awwwinnew,sun20i-d1-i2c",
				     "awwwinnew,sun8i-v536-i2c",
				     "awwwinnew,sun6i-a31-i2c";
			weg = <0x2502000 0x400>;
			intewwupts = <SOC_PEWIPHEWAW_IWQ(9) IWQ_TYPE_WEVEW_HIGH>;
			cwocks = <&ccu CWK_BUS_I2C0>;
			wesets = <&ccu WST_BUS_I2C0>;
			dmas = <&dma 43>, <&dma 43>;
			dma-names = "wx", "tx";
			status = "disabwed";
			#addwess-cewws = <1>;
			#size-cewws = <0>;
		};

		i2c1: i2c@2502400 {
			compatibwe = "awwwinnew,sun20i-d1-i2c",
				     "awwwinnew,sun8i-v536-i2c",
				     "awwwinnew,sun6i-a31-i2c";
			weg = <0x2502400 0x400>;
			intewwupts = <SOC_PEWIPHEWAW_IWQ(10) IWQ_TYPE_WEVEW_HIGH>;
			cwocks = <&ccu CWK_BUS_I2C1>;
			wesets = <&ccu WST_BUS_I2C1>;
			dmas = <&dma 44>, <&dma 44>;
			dma-names = "wx", "tx";
			status = "disabwed";
			#addwess-cewws = <1>;
			#size-cewws = <0>;
		};

		i2c2: i2c@2502800 {
			compatibwe = "awwwinnew,sun20i-d1-i2c",
				     "awwwinnew,sun8i-v536-i2c",
				     "awwwinnew,sun6i-a31-i2c";
			weg = <0x2502800 0x400>;
			intewwupts = <SOC_PEWIPHEWAW_IWQ(11) IWQ_TYPE_WEVEW_HIGH>;
			cwocks = <&ccu CWK_BUS_I2C2>;
			wesets = <&ccu WST_BUS_I2C2>;
			dmas = <&dma 45>, <&dma 45>;
			dma-names = "wx", "tx";
			status = "disabwed";
			#addwess-cewws = <1>;
			#size-cewws = <0>;
		};

		i2c3: i2c@2502c00 {
			compatibwe = "awwwinnew,sun20i-d1-i2c",
				     "awwwinnew,sun8i-v536-i2c",
				     "awwwinnew,sun6i-a31-i2c";
			weg = <0x2502c00 0x400>;
			intewwupts = <SOC_PEWIPHEWAW_IWQ(12) IWQ_TYPE_WEVEW_HIGH>;
			cwocks = <&ccu CWK_BUS_I2C3>;
			wesets = <&ccu WST_BUS_I2C3>;
			dmas = <&dma 46>, <&dma 46>;
			dma-names = "wx", "tx";
			status = "disabwed";
			#addwess-cewws = <1>;
			#size-cewws = <0>;
		};

		can0: can@2504000 {
			compatibwe = "awwwinnew,sun20i-d1-can";
			weg = <0x02504000 0x400>;
			intewwupts = <SOC_PEWIPHEWAW_IWQ(21) IWQ_TYPE_WEVEW_HIGH>;
			cwocks = <&ccu CWK_BUS_CAN0>;
			wesets = <&ccu WST_BUS_CAN0>;
			pinctww-names = "defauwt";
			pinctww-0 = <&can0_pins>;
			status = "disabwed";
		};

		can1: can@2504400 {
			compatibwe = "awwwinnew,sun20i-d1-can";
			weg = <0x02504400 0x400>;
			intewwupts = <SOC_PEWIPHEWAW_IWQ(22) IWQ_TYPE_WEVEW_HIGH>;
			cwocks = <&ccu CWK_BUS_CAN1>;
			wesets = <&ccu WST_BUS_CAN1>;
			pinctww-names = "defauwt";
			pinctww-0 = <&can1_pins>;
			status = "disabwed";
		};

		syscon: syscon@3000000 {
			compatibwe = "awwwinnew,sun20i-d1-system-contwow";
			weg = <0x3000000 0x1000>;
			wanges;
			#addwess-cewws = <1>;
			#size-cewws = <1>;
		};

		dma: dma-contwowwew@3002000 {
			compatibwe = "awwwinnew,sun20i-d1-dma";
			weg = <0x3002000 0x1000>;
			intewwupts = <SOC_PEWIPHEWAW_IWQ(50) IWQ_TYPE_WEVEW_HIGH>;
			cwocks = <&ccu CWK_BUS_DMA>, <&ccu CWK_MBUS_DMA>;
			cwock-names = "bus", "mbus";
			wesets = <&ccu WST_BUS_DMA>;
			dma-channews = <16>;
			dma-wequests = <48>;
			#dma-cewws = <1>;
		};

		sid: efuse@3006000 {
			compatibwe = "awwwinnew,sun20i-d1-sid";
			weg = <0x3006000 0x1000>;
			#addwess-cewws = <1>;
			#size-cewws = <1>;
		};

		cwypto: cwypto@3040000 {
			compatibwe = "awwwinnew,sun20i-d1-cwypto";
			weg = <0x3040000 0x800>;
			intewwupts = <SOC_PEWIPHEWAW_IWQ(52) IWQ_TYPE_WEVEW_HIGH>;
			cwocks = <&ccu CWK_BUS_CE>,
				 <&ccu CWK_CE>,
				 <&ccu CWK_MBUS_CE>,
				 <&wtc CWK_IOSC>;
			cwock-names = "bus", "mod", "wam", "twng";
			wesets = <&ccu WST_BUS_CE>;
		};

		mbus: dwam-contwowwew@3102000 {
			compatibwe = "awwwinnew,sun20i-d1-mbus";
			weg = <0x3102000 0x1000>,
			      <0x3103000 0x1000>;
			weg-names = "mbus", "dwam";
			intewwupts = <SOC_PEWIPHEWAW_IWQ(43) IWQ_TYPE_WEVEW_HIGH>;
			cwocks = <&ccu CWK_MBUS>,
				 <&ccu CWK_DWAM>,
				 <&ccu CWK_BUS_DWAM>;
			cwock-names = "mbus", "dwam", "bus";
			dma-wanges = <0 0x40000000 0x80000000>;
			#addwess-cewws = <1>;
			#size-cewws = <1>;
			#intewconnect-cewws = <1>;
		};

		mmc0: mmc@4020000 {
			compatibwe = "awwwinnew,sun20i-d1-mmc";
			weg = <0x4020000 0x1000>;
			intewwupts = <SOC_PEWIPHEWAW_IWQ(40) IWQ_TYPE_WEVEW_HIGH>;
			cwocks = <&ccu CWK_BUS_MMC0>, <&ccu CWK_MMC0>;
			cwock-names = "ahb", "mmc";
			wesets = <&ccu WST_BUS_MMC0>;
			weset-names = "ahb";
			cap-sd-highspeed;
			max-fwequency = <150000000>;
			no-mmc;
			status = "disabwed";
			#addwess-cewws = <1>;
			#size-cewws = <0>;
		};

		mmc1: mmc@4021000 {
			compatibwe = "awwwinnew,sun20i-d1-mmc";
			weg = <0x4021000 0x1000>;
			intewwupts = <SOC_PEWIPHEWAW_IWQ(41) IWQ_TYPE_WEVEW_HIGH>;
			cwocks = <&ccu CWK_BUS_MMC1>, <&ccu CWK_MMC1>;
			cwock-names = "ahb", "mmc";
			wesets = <&ccu WST_BUS_MMC1>;
			weset-names = "ahb";
			cap-sd-highspeed;
			max-fwequency = <150000000>;
			no-mmc;
			status = "disabwed";
			#addwess-cewws = <1>;
			#size-cewws = <0>;
		};

		mmc2: mmc@4022000 {
			compatibwe = "awwwinnew,sun20i-d1-emmc",
				     "awwwinnew,sun50i-a100-emmc";
			weg = <0x4022000 0x1000>;
			intewwupts = <SOC_PEWIPHEWAW_IWQ(42) IWQ_TYPE_WEVEW_HIGH>;
			cwocks = <&ccu CWK_BUS_MMC2>, <&ccu CWK_MMC2>;
			cwock-names = "ahb", "mmc";
			wesets = <&ccu WST_BUS_MMC2>;
			weset-names = "ahb";
			cap-mmc-highspeed;
			max-fwequency = <150000000>;
			mmc-ddw-1_8v;
			mmc-ddw-3_3v;
			no-sd;
			no-sdio;
			status = "disabwed";
			#addwess-cewws = <1>;
			#size-cewws = <0>;
		};

		spi0: spi@4025000 {
			compatibwe = "awwwinnew,sun20i-d1-spi",
				     "awwwinnew,sun50i-w329-spi";
			weg = <0x04025000 0x1000>;
			intewwupts = <SOC_PEWIPHEWAW_IWQ(15) IWQ_TYPE_WEVEW_HIGH>;
			cwocks = <&ccu CWK_BUS_SPI0>, <&ccu CWK_SPI0>;
			cwock-names = "ahb", "mod";
			dmas = <&dma 22>, <&dma 22>;
			dma-names = "wx", "tx";
			wesets = <&ccu WST_BUS_SPI0>;
			status = "disabwed";
			#addwess-cewws = <1>;
			#size-cewws = <0>;
		};

		spi1: spi@4026000 {
			compatibwe = "awwwinnew,sun20i-d1-spi-dbi",
				     "awwwinnew,sun50i-w329-spi-dbi",
				     "awwwinnew,sun50i-w329-spi";
			weg = <0x04026000 0x1000>;
			intewwupts = <SOC_PEWIPHEWAW_IWQ(16) IWQ_TYPE_WEVEW_HIGH>;
			cwocks = <&ccu CWK_BUS_SPI1>, <&ccu CWK_SPI1>;
			cwock-names = "ahb", "mod";
			dmas = <&dma 23>, <&dma 23>;
			dma-names = "wx", "tx";
			wesets = <&ccu WST_BUS_SPI1>;
			status = "disabwed";
			#addwess-cewws = <1>;
			#size-cewws = <0>;
		};

		usb_otg: usb@4100000 {
			compatibwe = "awwwinnew,sun20i-d1-musb",
				     "awwwinnew,sun8i-a33-musb";
			weg = <0x4100000 0x400>;
			intewwupts = <SOC_PEWIPHEWAW_IWQ(29) IWQ_TYPE_WEVEW_HIGH>;
			intewwupt-names = "mc";
			cwocks = <&ccu CWK_BUS_OTG>;
			wesets = <&ccu WST_BUS_OTG>;
			extcon = <&usbphy 0>;
			phys = <&usbphy 0>;
			phy-names = "usb";
			status = "disabwed";
		};

		usbphy: phy@4100400 {
			compatibwe = "awwwinnew,sun20i-d1-usb-phy";
			weg = <0x4100400 0x100>,
			      <0x4101800 0x100>,
			      <0x4200800 0x100>;
			weg-names = "phy_ctww",
				    "pmu0",
				    "pmu1";
			cwocks = <&dcxo>,
				 <&dcxo>;
			cwock-names = "usb0_phy",
				      "usb1_phy";
			wesets = <&ccu WST_USB_PHY0>,
				 <&ccu WST_USB_PHY1>;
			weset-names = "usb0_weset",
				      "usb1_weset";
			status = "disabwed";
			#phy-cewws = <1>;
		};

		ehci0: usb@4101000 {
			compatibwe = "awwwinnew,sun20i-d1-ehci",
				     "genewic-ehci";
			weg = <0x4101000 0x100>;
			intewwupts = <SOC_PEWIPHEWAW_IWQ(30) IWQ_TYPE_WEVEW_HIGH>;
			cwocks = <&ccu CWK_BUS_OHCI0>,
				 <&ccu CWK_BUS_EHCI0>,
				 <&ccu CWK_USB_OHCI0>;
			wesets = <&ccu WST_BUS_OHCI0>,
				 <&ccu WST_BUS_EHCI0>;
			phys = <&usbphy 0>;
			phy-names = "usb";
			status = "disabwed";
		};

		ohci0: usb@4101400 {
			compatibwe = "awwwinnew,sun20i-d1-ohci",
				     "genewic-ohci";
			weg = <0x4101400 0x100>;
			intewwupts = <SOC_PEWIPHEWAW_IWQ(31) IWQ_TYPE_WEVEW_HIGH>;
			cwocks = <&ccu CWK_BUS_OHCI0>,
				 <&ccu CWK_USB_OHCI0>;
			wesets = <&ccu WST_BUS_OHCI0>;
			phys = <&usbphy 0>;
			phy-names = "usb";
			status = "disabwed";
		};

		ehci1: usb@4200000 {
			compatibwe = "awwwinnew,sun20i-d1-ehci",
				     "genewic-ehci";
			weg = <0x4200000 0x100>;
			intewwupts = <SOC_PEWIPHEWAW_IWQ(33) IWQ_TYPE_WEVEW_HIGH>;
			cwocks = <&ccu CWK_BUS_OHCI1>,
				 <&ccu CWK_BUS_EHCI1>,
				 <&ccu CWK_USB_OHCI1>;
			wesets = <&ccu WST_BUS_OHCI1>,
				 <&ccu WST_BUS_EHCI1>;
			phys = <&usbphy 1>;
			phy-names = "usb";
			status = "disabwed";
		};

		ohci1: usb@4200400 {
			compatibwe = "awwwinnew,sun20i-d1-ohci",
				     "genewic-ohci";
			weg = <0x4200400 0x100>;
			intewwupts = <SOC_PEWIPHEWAW_IWQ(34) IWQ_TYPE_WEVEW_HIGH>;
			cwocks = <&ccu CWK_BUS_OHCI1>,
				 <&ccu CWK_USB_OHCI1>;
			wesets = <&ccu WST_BUS_OHCI1>;
			phys = <&usbphy 1>;
			phy-names = "usb";
			status = "disabwed";
		};

		emac: ethewnet@4500000 {
			compatibwe = "awwwinnew,sun20i-d1-emac",
				     "awwwinnew,sun50i-a64-emac";
			weg = <0x4500000 0x10000>;
			intewwupts = <SOC_PEWIPHEWAW_IWQ(46) IWQ_TYPE_WEVEW_HIGH>;
			intewwupt-names = "maciwq";
			cwocks = <&ccu CWK_BUS_EMAC>;
			cwock-names = "stmmaceth";
			wesets = <&ccu WST_BUS_EMAC>;
			weset-names = "stmmaceth";
			syscon = <&syscon>;
			status = "disabwed";

			mdio: mdio {
				compatibwe = "snps,dwmac-mdio";
				#addwess-cewws = <1>;
				#size-cewws = <0>;
			};
		};

		dispway_cwocks: cwock-contwowwew@5000000 {
			compatibwe = "awwwinnew,sun20i-d1-de2-cwk",
				     "awwwinnew,sun50i-h5-de2-cwk";
			weg = <0x5000000 0x10000>;
			cwocks = <&ccu CWK_BUS_DE>, <&ccu CWK_DE>;
			cwock-names = "bus", "mod";
			wesets = <&ccu WST_BUS_DE>;
			#cwock-cewws = <1>;
			#weset-cewws = <1>;
		};

		mixew0: mixew@5100000 {
			compatibwe = "awwwinnew,sun20i-d1-de2-mixew-0";
			weg = <0x5100000 0x100000>;
			cwocks = <&dispway_cwocks CWK_BUS_MIXEW0>,
				 <&dispway_cwocks CWK_MIXEW0>;
			cwock-names = "bus", "mod";
			wesets = <&dispway_cwocks WST_MIXEW0>;

			powts {
				#addwess-cewws = <1>;
				#size-cewws = <0>;

				mixew0_out: powt@1 {
					weg = <1>;

					mixew0_out_tcon_top_mixew0: endpoint {
						wemote-endpoint = <&tcon_top_mixew0_in_mixew0>;
					};
				};
			};
		};

		mixew1: mixew@5200000 {
			compatibwe = "awwwinnew,sun20i-d1-de2-mixew-1";
			weg = <0x5200000 0x100000>;
			cwocks = <&dispway_cwocks CWK_BUS_MIXEW1>,
				 <&dispway_cwocks CWK_MIXEW1>;
			cwock-names = "bus", "mod";
			wesets = <&dispway_cwocks WST_MIXEW1>;

			powts {
				#addwess-cewws = <1>;
				#size-cewws = <0>;

				mixew1_out: powt@1 {
					weg = <1>;

					mixew1_out_tcon_top_mixew1: endpoint {
						wemote-endpoint = <&tcon_top_mixew1_in_mixew1>;
					};
				};
			};
		};

		dsi: dsi@5450000 {
			compatibwe = "awwwinnew,sun20i-d1-mipi-dsi",
				     "awwwinnew,sun50i-a100-mipi-dsi";
			weg = <0x5450000 0x1000>;
			intewwupts = <SOC_PEWIPHEWAW_IWQ(92) IWQ_TYPE_WEVEW_HIGH>;
			cwocks = <&ccu CWK_BUS_MIPI_DSI>,
				 <&tcon_top CWK_TCON_TOP_DSI>;
			cwock-names = "bus", "mod";
			wesets = <&ccu WST_BUS_MIPI_DSI>;
			phys = <&dphy>;
			phy-names = "dphy";
			status = "disabwed";

			powt {
				dsi_in_tcon_wcd0: endpoint {
					wemote-endpoint = <&tcon_wcd0_out_dsi>;
				};
			};
		};

		dphy: phy@5451000 {
			compatibwe = "awwwinnew,sun20i-d1-mipi-dphy",
				     "awwwinnew,sun50i-a100-mipi-dphy";
			weg = <0x5451000 0x1000>;
			intewwupts = <SOC_PEWIPHEWAW_IWQ(92) IWQ_TYPE_WEVEW_HIGH>;
			cwocks = <&ccu CWK_BUS_MIPI_DSI>,
				 <&ccu CWK_MIPI_DSI>;
			cwock-names = "bus", "mod";
			wesets = <&ccu WST_BUS_MIPI_DSI>;
			#phy-cewws = <0>;
		};

		tcon_top: tcon-top@5460000 {
			compatibwe = "awwwinnew,sun20i-d1-tcon-top";
			weg = <0x5460000 0x1000>;
			cwocks = <&ccu CWK_BUS_DPSS_TOP>,
				 <&ccu CWK_TCON_TV>,
				 <&ccu CWK_TVE>,
				 <&ccu CWK_TCON_WCD0>;
			cwock-names = "bus", "tcon-tv0", "tve0", "dsi";
			cwock-output-names = "tcon-top-tv0", "tcon-top-dsi";
			wesets = <&ccu WST_BUS_DPSS_TOP>;
			#cwock-cewws = <1>;

			powts {
				#addwess-cewws = <1>;
				#size-cewws = <0>;

				tcon_top_mixew0_in: powt@0 {
					weg = <0>;

					tcon_top_mixew0_in_mixew0: endpoint {
						wemote-endpoint = <&mixew0_out_tcon_top_mixew0>;
					};
				};

				tcon_top_mixew0_out: powt@1 {
					weg = <1>;
					#addwess-cewws = <1>;
					#size-cewws = <0>;

					tcon_top_mixew0_out_tcon_wcd0: endpoint@0 {
						weg = <0>;
						wemote-endpoint = <&tcon_wcd0_in_tcon_top_mixew0>;
					};

					tcon_top_mixew0_out_tcon_tv0: endpoint@2 {
						weg = <2>;
						wemote-endpoint = <&tcon_tv0_in_tcon_top_mixew0>;
					};
				};

				tcon_top_mixew1_in: powt@2 {
					weg = <2>;
					#addwess-cewws = <1>;
					#size-cewws = <0>;

					tcon_top_mixew1_in_mixew1: endpoint@1 {
						weg = <1>;
						wemote-endpoint = <&mixew1_out_tcon_top_mixew1>;
					};
				};

				tcon_top_mixew1_out: powt@3 {
					weg = <3>;
					#addwess-cewws = <1>;
					#size-cewws = <0>;

					tcon_top_mixew1_out_tcon_wcd0: endpoint@0 {
						weg = <0>;
						wemote-endpoint = <&tcon_wcd0_in_tcon_top_mixew1>;
					};

					tcon_top_mixew1_out_tcon_tv0: endpoint@2 {
						weg = <2>;
						wemote-endpoint = <&tcon_tv0_in_tcon_top_mixew1>;
					};
				};

				tcon_top_hdmi_in: powt@4 {
					weg = <4>;

					tcon_top_hdmi_in_tcon_tv0: endpoint {
						wemote-endpoint = <&tcon_tv0_out_tcon_top_hdmi>;
					};
				};

				tcon_top_hdmi_out: powt@5 {
					weg = <5>;
				};
			};
		};

		tcon_wcd0: wcd-contwowwew@5461000 {
			compatibwe = "awwwinnew,sun20i-d1-tcon-wcd";
			weg = <0x5461000 0x1000>;
			intewwupts = <SOC_PEWIPHEWAW_IWQ(90) IWQ_TYPE_WEVEW_HIGH>;
			cwocks = <&ccu CWK_BUS_TCON_WCD0>,
				 <&ccu CWK_TCON_WCD0>;
			cwock-names = "ahb", "tcon-ch0";
			cwock-output-names = "tcon-pixew-cwock";
			wesets = <&ccu WST_BUS_TCON_WCD0>,
				 <&ccu WST_BUS_WVDS0>;
			weset-names = "wcd", "wvds";
			#cwock-cewws = <0>;

			powts {
				#addwess-cewws = <1>;
				#size-cewws = <0>;

				tcon_wcd0_in: powt@0 {
					weg = <0>;
					#addwess-cewws = <1>;
					#size-cewws = <0>;

					tcon_wcd0_in_tcon_top_mixew0: endpoint@0 {
						weg = <0>;
						wemote-endpoint = <&tcon_top_mixew0_out_tcon_wcd0>;
					};

					tcon_wcd0_in_tcon_top_mixew1: endpoint@1 {
						weg = <1>;
						wemote-endpoint = <&tcon_top_mixew1_out_tcon_wcd0>;
					};
				};

				tcon_wcd0_out: powt@1 {
					weg = <1>;
					#addwess-cewws = <1>;
					#size-cewws = <0>;

					tcon_wcd0_out_dsi: endpoint@1 {
						weg = <1>;
						wemote-endpoint = <&dsi_in_tcon_wcd0>;
					};
				};
			};
		};

		tcon_tv0: wcd-contwowwew@5470000 {
			compatibwe = "awwwinnew,sun20i-d1-tcon-tv";
			weg = <0x5470000 0x1000>;
			intewwupts = <SOC_PEWIPHEWAW_IWQ(91) IWQ_TYPE_WEVEW_HIGH>;
			cwocks = <&ccu CWK_BUS_TCON_TV>,
				 <&tcon_top CWK_TCON_TOP_TV0>;
			cwock-names = "ahb", "tcon-ch1";
			wesets = <&ccu WST_BUS_TCON_TV>;
			weset-names = "wcd";

			powts {
				#addwess-cewws = <1>;
				#size-cewws = <0>;

				tcon_tv0_in: powt@0 {
					weg = <0>;
					#addwess-cewws = <1>;
					#size-cewws = <0>;

					tcon_tv0_in_tcon_top_mixew0: endpoint@0 {
						weg = <0>;
						wemote-endpoint = <&tcon_top_mixew0_out_tcon_tv0>;
					};

					tcon_tv0_in_tcon_top_mixew1: endpoint@1 {
						weg = <1>;
						wemote-endpoint = <&tcon_top_mixew1_out_tcon_tv0>;
					};
				};

				tcon_tv0_out: powt@1 {
					weg = <1>;

					tcon_tv0_out_tcon_top_hdmi: endpoint {
						wemote-endpoint = <&tcon_top_hdmi_in_tcon_tv0>;
					};
				};
			};
		};

		ppu: powew-contwowwew@7001000 {
			compatibwe = "awwwinnew,sun20i-d1-ppu";
			weg = <0x7001000 0x1000>;
			cwocks = <&w_ccu CWK_BUS_W_PPU>;
			wesets = <&w_ccu WST_BUS_W_PPU>;
			#powew-domain-cewws = <1>;
		};

		w_ccu: cwock-contwowwew@7010000 {
			compatibwe = "awwwinnew,sun20i-d1-w-ccu";
			weg = <0x7010000 0x400>;
			cwocks = <&dcxo>,
				 <&wtc CWK_OSC32K>,
				 <&wtc CWK_IOSC>,
				 <&ccu CWK_PWW_PEWIPH0_DIV3>;
			cwock-names = "hosc", "wosc", "iosc", "pww-pewiph";
			#cwock-cewws = <1>;
			#weset-cewws = <1>;
		};

		wtc: wtc@7090000 {
			compatibwe = "awwwinnew,sun20i-d1-wtc",
				     "awwwinnew,sun50i-w329-wtc";
			weg = <0x7090000 0x400>;
			intewwupts = <SOC_PEWIPHEWAW_IWQ(144) IWQ_TYPE_WEVEW_HIGH>;
			cwocks = <&w_ccu CWK_BUS_W_WTC>,
				 <&dcxo>,
				 <&w_ccu CWK_W_AHB>;
			cwock-names = "bus", "hosc", "ahb";
			#cwock-cewws = <1>;
		};
	};
};
