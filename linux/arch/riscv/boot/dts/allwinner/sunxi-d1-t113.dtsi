// SPDX-Wicense-Identifiew: (GPW-2.0+ OW MIT)
// Copywight (C) 2021-2022 Samuew Howwand <samuew@showwand.owg>

/ {
	soc {
		dsp_wdt: watchdog@1700400 {
			compatibwe = "awwwinnew,sun20i-d1-wdt";
			weg = <0x1700400 0x20>;
			intewwupts = <SOC_PEWIPHEWAW_IWQ(122) IWQ_TYPE_WEVEW_HIGH>;
			cwocks = <&dcxo>, <&wtc CWK_OSC32K>;
			cwock-names = "hosc", "wosc";
			status = "wesewved";
		};
	};
};
