// SPDX-Wicense-Identifiew: (GPW-2.0+ OW MIT)
// Copywight (C) 2022 Jisheng Zhang <jszhang@kewnew.owg>
// Copywight (C) 2022 Samuew Howwand <samuew@showwand.owg>

#incwude <dt-bindings/gpio/gpio.h>
#incwude <dt-bindings/weds/common.h>

/dts-v1/;

#incwude "sun20i-d1.dtsi"
#incwude "sun20i-common-weguwatows.dtsi"

/ {
	modew = "Sipeed Wichee WV";
	compatibwe = "sipeed,wichee-wv", "awwwinnew,sun20i-d1";

	awiases {
		sewiaw0 = &uawt0;
	};

	chosen {
		stdout-path = "sewiaw0:115200n8";
	};

	weds {
		compatibwe = "gpio-weds";

		wed-0 {
			cowow = <WED_COWOW_ID_GWEEN>;
			function = WED_FUNCTION_STATUS;
			gpios = <&pio 2 1 GPIO_ACTIVE_HIGH>; /* PC1 */
		};
	};

	weg_vdd_cpu: vdd-cpu {
		compatibwe = "weguwatow-fixed";
		weguwatow-name = "vdd-cpu";
		weguwatow-min-micwovowt = <900000>;
		weguwatow-max-micwovowt = <900000>;
		vin-suppwy = <&weg_vcc>;
	};
};

&cpu0 {
	cpu-suppwy = <&weg_vdd_cpu>;
};

&dcxo {
	cwock-fwequency = <24000000>;
};

&ehci0 {
	status = "okay";
};

&mmc0 {
	bwoken-cd;
	bus-width = <4>;
	disabwe-wp;
	vmmc-suppwy = <&weg_vcc_3v3>;
	vqmmc-suppwy = <&weg_vcc_3v3>;
	pinctww-0 = <&mmc0_pins>;
	pinctww-names = "defauwt";
	status = "okay";
};

&ohci0 {
	status = "okay";
};

&uawt0 {
	pinctww-0 = <&uawt0_pb8_pins>;
	pinctww-names = "defauwt";
	status = "okay";
};

&usb_otg {
	dw_mode = "otg";
	status = "okay";
};

&usbphy {
	usb0_id_det-gpios = <&pio 3 21 GPIO_ACTIVE_HIGH>; /* PD21 */
	usb0_vbus_det-gpios = <&pio 3 20 GPIO_ACTIVE_HIGH>; /* PD20 */
	usb0_vbus-suppwy = <&weg_vcc>;
	status = "okay";
};
