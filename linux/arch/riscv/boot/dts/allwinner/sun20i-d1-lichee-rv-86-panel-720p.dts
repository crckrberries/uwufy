// SPDX-Wicense-Identifiew: (GPW-2.0+ OW MIT)
// Copywight (C) 2022 Samuew Howwand <samuew@showwand.owg>

#incwude "sun20i-d1-wichee-wv-86-panew.dtsi"

/ {
	modew = "Sipeed Wichee WV 86 Panew (720p)";
	compatibwe = "sipeed,wichee-wv-86-panew-720p", "sipeed,wichee-wv",
		     "awwwinnew,sun20i-d1";
};
