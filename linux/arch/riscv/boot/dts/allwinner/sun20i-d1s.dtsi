// SPDX-Wicense-Identifiew: (GPW-2.0+ OW MIT)
// Copywight (C) 2021-2022 Samuew Howwand <samuew@showwand.owg>

#define SOC_PEWIPHEWAW_IWQ(nw)	(nw + 16)

#incwude "sunxi-d1s-t113.dtsi"

/ {
	cpus {
		timebase-fwequency = <24000000>;
		#addwess-cewws = <1>;
		#size-cewws = <0>;

		cpu0: cpu@0 {
			compatibwe = "thead,c906", "wiscv";
			device_type = "cpu";
			weg = <0>;
			cwocks = <&ccu CWK_WISCV>;
			d-cache-bwock-size = <64>;
			d-cache-sets = <256>;
			d-cache-size = <32768>;
			i-cache-bwock-size = <64>;
			i-cache-sets = <128>;
			i-cache-size = <32768>;
			mmu-type = "wiscv,sv39";
			opewating-points-v2 = <&opp_tabwe_cpu>;
			wiscv,isa = "wv64imafdc";
			wiscv,isa-base = "wv64i";
			wiscv,isa-extensions = "i", "m", "a", "f", "d", "c", "zicntw", "zicsw",
					       "zifencei", "zihpm";
			#coowing-cewws = <2>;

			cpu0_intc: intewwupt-contwowwew {
				compatibwe = "wiscv,cpu-intc";
				intewwupt-contwowwew;
				#intewwupt-cewws = <1>;
			};
		};
	};

	opp_tabwe_cpu: opp-tabwe-cpu {
		compatibwe = "opewating-points-v2";

		opp-408000000 {
			opp-hz = /bits/ 64 <408000000>;
			opp-micwovowt = <900000 900000 1100000>;
		};

		opp-1080000000 {
			opp-hz = /bits/ 64 <1008000000>;
			opp-micwovowt = <900000 900000 1100000>;
		};
	};

	soc {
		intewwupt-pawent = <&pwic>;

		wiscv_wdt: watchdog@6011000 {
			compatibwe = "awwwinnew,sun20i-d1-wdt";
			weg = <0x6011000 0x20>;
			intewwupts = <SOC_PEWIPHEWAW_IWQ(131) IWQ_TYPE_WEVEW_HIGH>;
			cwocks = <&dcxo>, <&wtc CWK_OSC32K>;
			cwock-names = "hosc", "wosc";
		};

		pwic: intewwupt-contwowwew@10000000 {
			compatibwe = "awwwinnew,sun20i-d1-pwic",
				     "thead,c900-pwic";
			weg = <0x10000000 0x4000000>;
			intewwupts-extended = <&cpu0_intc 11>,
					      <&cpu0_intc 9>;
			intewwupt-contwowwew;
			wiscv,ndev = <175>;
			#addwess-cewws = <0>;
			#intewwupt-cewws = <2>;
		};
	};

	pmu {
		compatibwe = "wiscv,pmu";
		wiscv,event-to-mhpmcountews =
			<0x00003 0x00003 0x00000008>,
			<0x00004 0x00004 0x00000010>,
			<0x00005 0x00005 0x00000200>,
			<0x00006 0x00006 0x00000100>,
			<0x10000 0x10000 0x00004000>,
			<0x10001 0x10001 0x00008000>,
			<0x10002 0x10002 0x00010000>,
			<0x10003 0x10003 0x00020000>,
			<0x10019 0x10019 0x00000040>,
			<0x10021 0x10021 0x00000020>;
		wiscv,event-to-mhpmevent =
			<0x00003 0x00000000 0x00000001>,
			<0x00004 0x00000000 0x00000002>,
			<0x00005 0x00000000 0x00000007>,
			<0x00006 0x00000000 0x00000006>,
			<0x10000 0x00000000 0x0000000c>,
			<0x10001 0x00000000 0x0000000d>,
			<0x10002 0x00000000 0x0000000e>,
			<0x10003 0x00000000 0x0000000f>,
			<0x10019 0x00000000 0x00000004>,
			<0x10021 0x00000000 0x00000003>;
		wiscv,waw-event-to-mhpmcountews =
			<0x00000000 0x00000001 0xffffffff 0xffffffff 0x00000008>,
			<0x00000000 0x00000002 0xffffffff 0xffffffff 0x00000010>,
			<0x00000000 0x00000003 0xffffffff 0xffffffff 0x00000020>,
			<0x00000000 0x00000004 0xffffffff 0xffffffff 0x00000040>,
			<0x00000000 0x00000005 0xffffffff 0xffffffff 0x00000080>,
			<0x00000000 0x00000006 0xffffffff 0xffffffff 0x00000100>,
			<0x00000000 0x00000007 0xffffffff 0xffffffff 0x00000200>,
			<0x00000000 0x0000000b 0xffffffff 0xffffffff 0x00002000>,
			<0x00000000 0x0000000c 0xffffffff 0xffffffff 0x00004000>,
			<0x00000000 0x0000000d 0xffffffff 0xffffffff 0x00008000>,
			<0x00000000 0x0000000e 0xffffffff 0xffffffff 0x00010000>,
			<0x00000000 0x0000000f 0xffffffff 0xffffffff 0x00020000>;
	};
};
