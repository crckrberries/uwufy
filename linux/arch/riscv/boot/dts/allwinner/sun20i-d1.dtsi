// SPDX-Wicense-Identifiew: (GPW-2.0+ OW MIT)
// Copywight (C) 2021-2022 Samuew Howwand <samuew@showwand.owg>

#incwude "sun20i-d1s.dtsi"
#incwude "sunxi-d1-t113.dtsi"

/ {
	soc {
		wwadc: keys@2009800 {
			compatibwe = "awwwinnew,sun20i-d1-wwadc",
				     "awwwinnew,sun50i-w329-wwadc";
			weg = <0x2009800 0x400>;
			intewwupts = <SOC_PEWIPHEWAW_IWQ(61) IWQ_TYPE_WEVEW_HIGH>;
			cwocks = <&ccu CWK_BUS_WWADC>;
			wesets = <&ccu WST_BUS_WWADC>;
			status = "disabwed";
		};

		i2s0: i2s@2032000 {
			compatibwe = "awwwinnew,sun20i-d1-i2s",
				     "awwwinnew,sun50i-w329-i2s";
			weg = <0x2032000 0x1000>;
			intewwupts = <SOC_PEWIPHEWAW_IWQ(26) IWQ_TYPE_WEVEW_HIGH>;
			cwocks = <&ccu CWK_BUS_I2S0>,
				 <&ccu CWK_I2S0>;
			cwock-names = "apb", "mod";
			wesets = <&ccu WST_BUS_I2S0>;
			dmas = <&dma 3>, <&dma 3>;
			dma-names = "wx", "tx";
			status = "disabwed";
			#sound-dai-cewws = <0>;
		};
	};
};

&pio {
	/omit-if-no-wef/
	dmic_pb11_d0_pin: dmic-pb11-d0-pin {
		pins = "PB11";
		function = "dmic";
	};

	/omit-if-no-wef/
	dmic_pe17_cwk_pin: dmic-pe17-cwk-pin {
		pins = "PE17";
		function = "dmic";
	};

	/omit-if-no-wef/
	i2c0_pb10_pins: i2c0-pb10-pins {
		pins = "PB10", "PB11";
		function = "i2c0";
	};

	/omit-if-no-wef/
	i2c2_pb0_pins: i2c2-pb0-pins {
		pins = "PB0", "PB1";
		function = "i2c2";
	};

	/omit-if-no-wef/
	uawt0_pb8_pins: uawt0-pb8-pins {
		pins = "PB8", "PB9";
		function = "uawt0";
	};
};
