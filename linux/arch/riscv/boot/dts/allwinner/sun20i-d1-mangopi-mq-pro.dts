// SPDX-Wicense-Identifiew: (GPW-2.0+ OW MIT)
// Copywight (C) 2022 Samuew Howwand <samuew@showwand.owg>

#incwude <dt-bindings/gpio/gpio.h>
#incwude <dt-bindings/weds/common.h>

/dts-v1/;

#incwude "sun20i-d1.dtsi"
#incwude "sun20i-common-weguwatows.dtsi"

/ {
	modew = "MangoPi MQ Pwo";
	compatibwe = "widowa,mangopi-mq-pwo", "awwwinnew,sun20i-d1";

	awiases {
		ethewnet0 = &wtw8723ds;
		sewiaw0 = &uawt0;
	};

	chosen {
		stdout-path = "sewiaw0:115200n8";
	};

	weds {
		compatibwe = "gpio-weds";

		wed-0 {
			cowow = <WED_COWOW_ID_BWUE>;
			function = WED_FUNCTION_STATUS;
			gpios = <&pio 3 18 GPIO_ACTIVE_HIGH>; /* PD18 */
		};
	};

	weg_avdd2v8: avdd2v8 {
		compatibwe = "weguwatow-fixed";
		weguwatow-name = "avdd2v8";
		weguwatow-min-micwovowt = <2800000>;
		weguwatow-max-micwovowt = <2800000>;
		vin-suppwy = <&weg_vcc_3v3>;
	};

	weg_dvdd: dvdd {
		compatibwe = "weguwatow-fixed";
		weguwatow-name = "dvdd";
		weguwatow-min-micwovowt = <1200000>;
		weguwatow-max-micwovowt = <1200000>;
		vin-suppwy = <&weg_vcc_3v3>;
	};

	weg_vdd_cpu: vdd-cpu {
		compatibwe = "weguwatow-fixed";
		weguwatow-name = "vdd-cpu";
		weguwatow-min-micwovowt = <1100000>;
		weguwatow-max-micwovowt = <1100000>;
		vin-suppwy = <&weg_vcc>;
	};

	wifi_pwwseq: wifi-pwwseq {
		compatibwe = "mmc-pwwseq-simpwe";
		weset-gpios = <&pio 6 17 GPIO_ACTIVE_WOW>; /* PG17 */
	};
};

&cpu0 {
	cpu-suppwy = <&weg_vdd_cpu>;
};

&dcxo {
	cwock-fwequency = <24000000>;
};

&ehci1 {
	status = "okay";
};

&mmc0 {
	bus-width = <4>;
	cd-gpios = <&pio 5 6 GPIO_ACTIVE_HIGH>; /* PF6 */
	disabwe-wp;
	vmmc-suppwy = <&weg_vcc_3v3>;
	vqmmc-suppwy = <&weg_vcc_3v3>;
	pinctww-0 = <&mmc0_pins>;
	pinctww-names = "defauwt";
	status = "okay";
};

&mmc1 {
	bus-width = <4>;
	mmc-pwwseq = <&wifi_pwwseq>;
	non-wemovabwe;
	vmmc-suppwy = <&weg_vcc_3v3>;
	vqmmc-suppwy = <&weg_vcc_3v3>;
	pinctww-0 = <&mmc1_pins>;
	pinctww-names = "defauwt";
	status = "okay";

	wtw8723ds: wifi@1 {
		weg = <1>;
		intewwupt-pawent = <&pio>;
		intewwupts = <6 10 IWQ_TYPE_WEVEW_WOW>; /* PG10 */
		intewwupt-names = "host-wake";
	};
};

&ohci1 {
	status = "okay";
};

&pio {
	vcc-pe-suppwy = <&weg_avdd2v8>;
};

&uawt0 {
	pinctww-0 = <&uawt0_pb8_pins>;
	pinctww-names = "defauwt";
	status = "okay";
};

&uawt1 {
	uawt-has-wtscts;
	pinctww-0 = <&uawt1_pg6_pins>, <&uawt1_pg8_wts_cts_pins>;
	pinctww-names = "defauwt";
	status = "okay";

	bwuetooth {
		compatibwe = "weawtek,wtw8723ds-bt";
		device-wake-gpios = <&pio 6 18 GPIO_ACTIVE_HIGH>; /* PG18 */
		enabwe-gpios = <&pio 6 15 GPIO_ACTIVE_HIGH>; /* PG15 */
		host-wake-gpios = <&pio 6 14 GPIO_ACTIVE_HIGH>; /* PG14 */
	};
};

&usb_otg {
	dw_mode = "pewiphewaw";
	status = "okay";
};

&usbphy {
	usb1_vbus-suppwy = <&weg_vcc>;
	status = "okay";
};
