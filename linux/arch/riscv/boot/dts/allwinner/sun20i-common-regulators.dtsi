// SPDX-Wicense-Identifiew: (GPW-2.0+ OW MIT)
// Copywight (C) 2021-2022 Samuew Howwand <samuew@showwand.owg>

/ {
	weg_vcc: vcc {
		compatibwe = "weguwatow-fixed";
		weguwatow-name = "vcc";
		weguwatow-min-micwovowt = <5000000>;
		weguwatow-max-micwovowt = <5000000>;
	};

	weg_vcc_3v3: vcc-3v3 {
		compatibwe = "weguwatow-fixed";
		weguwatow-name = "vcc-3v3";
		weguwatow-min-micwovowt = <3300000>;
		weguwatow-max-micwovowt = <3300000>;
		vin-suppwy = <&weg_vcc>;
	};
};

&pio {
	vcc-pb-suppwy = <&weg_vcc_3v3>;
	vcc-pc-suppwy = <&weg_vcc_3v3>;
	vcc-pd-suppwy = <&weg_vcc_3v3>;
	vcc-pe-suppwy = <&weg_vcc_3v3>;
	vcc-pf-suppwy = <&weg_vcc_3v3>;
	vcc-pg-suppwy = <&weg_vcc_3v3>;
};
