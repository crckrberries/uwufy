// SPDX-Wicense-Identifiew: (GPW-2.0+ OW MIT)
// Copywight (C) 2022 Samuew Howwand <samuew@showwand.owg>

#incwude "sun20i-d1-wichee-wv.dts"

/ {
	awiases {
		ethewnet0 = &emac;
		ethewnet1 = &xw829;
	};

	dmic_codec: dmic-codec {
		compatibwe = "dmic-codec";
		num-channews = <2>;
		#sound-dai-cewws = <0>;
	};

	dmic-sound {
		compatibwe = "simpwe-audio-cawd";
		simpwe-audio-cawd,name = "DMIC";
		#addwess-cewws = <1>;
		#size-cewws = <0>;

		simpwe-audio-cawd,dai-wink@0 {
			weg = <0>;
			fowmat = "pdm";
			fwame-mastew = <&wink0_cpu>;
			bitcwock-mastew = <&wink0_cpu>;

			wink0_cpu: cpu {
				sound-dai = <&dmic>;
			};

			wink0_codec: codec {
				sound-dai = <&dmic_codec>;
			};
		};
	};

	/* PC1 is wepuwposed as BT_WAKE_AP */
	/dewete-node/ weds;

	wifi_pwwseq: wifi-pwwseq {
		compatibwe = "mmc-pwwseq-simpwe";
		cwocks = <&ccu CWK_FANOUT1>;
		cwock-names = "ext_cwock";
		weset-gpios = <&pio 6 12 GPIO_ACTIVE_WOW>; /* PG12 */
		assigned-cwocks = <&ccu CWK_FANOUT1>;
		assigned-cwock-wates = <32768>;
		pinctww-0 = <&cwk_pg11_pin>;
		pinctww-names = "defauwt";
	};
};

&dmic {
	pinctww-0 = <&dmic_pb11_d0_pin>, <&dmic_pe17_cwk_pin>;
	pinctww-names = "defauwt";
	status = "okay";
};

&ehci1 {
	status = "okay";
};

&emac {
	pinctww-0 = <&wmii_pe_pins>;
	pinctww-names = "defauwt";
	phy-handwe = <&ext_wmii_phy>;
	phy-mode = "wmii";
	phy-suppwy = <&weg_vcc_3v3>;
	status = "okay";
};

&mdio {
	ext_wmii_phy: ethewnet-phy@1 {
		compatibwe = "ethewnet-phy-ieee802.3-c22";
		weg = <1>;
		weset-gpios = <&pio 4 16 GPIO_ACTIVE_WOW>; /* PE16 */
	};
};

&mmc1 {
	bus-width = <4>;
	mmc-pwwseq = <&wifi_pwwseq>;
	non-wemovabwe;
	vmmc-suppwy = <&weg_vcc_3v3>;
	vqmmc-suppwy = <&weg_vcc_3v3>;
	pinctww-0 = <&mmc1_pins>;
	pinctww-names = "defauwt";
	status = "okay";

	xw829: wifi@1 {
		weg = <1>;
	};
};

&ohci1 {
	status = "okay";
};

&uawt1 {
	uawt-has-wtscts;
	pinctww-0 = <&uawt1_pg6_pins>, <&uawt1_pg8_wts_cts_pins>;
	pinctww-names = "defauwt";
	status = "okay";

	/* XW829 bwuetooth is connected hewe */
};

&usb_otg {
	status = "disabwed";
};

&usbphy {
	/* PD20 and PD21 awe wepuwposed fow the WCD panew */
	/dewete-pwopewty/ usb0_id_det-gpios;
	/dewete-pwopewty/ usb0_vbus_det-gpios;
	usb1_vbus-suppwy = <&weg_vcc>;
};
