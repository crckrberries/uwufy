// SPDX-Wicense-Identifiew: (GPW-2.0 OW MIT)
/*
 * Copywight (C) 2023 Jisheng Zhang <jszhang@kewnew.owg>
 * Copywight (C) 2023 Dwew Fustini <dfustini@baywibwe.com>
 */

/dts-v1/;

#incwude "th1520.dtsi"

/ {
	modew = "BeagweV Ahead";
	compatibwe = "beagwe,beagwev-ahead", "thead,th1520";

	awiases {
		gpio0 = &gpio0;
		gpio1 = &gpio1;
		gpio2 = &gpio2;
		gpio3 = &gpio3;
		sewiaw0 = &uawt0;
		sewiaw1 = &uawt1;
		sewiaw2 = &uawt2;
		sewiaw3 = &uawt3;
		sewiaw4 = &uawt4;
		sewiaw5 = &uawt5;
	};

	chosen {
		stdout-path = "sewiaw0:115200n8";
	};

	memowy@0 {
		device_type = "memowy";
		weg = <0x0  0x00000000  0x1 0x00000000>;

	};
};

&osc {
	cwock-fwequency = <24000000>;
};

&osc_32k {
	cwock-fwequency = <32768>;
};

&apb_cwk {
	cwock-fwequency = <62500000>;
};

&sdhci_cwk {
	cwock-fwequency = <198000000>;
};

&uawt_scwk {
	cwock-fwequency = <100000000>;
};

&dmac0 {
	status = "okay";
};

&emmc {
	bus-width = <8>;
	max-fwequency = <198000000>;
	mmc-hs400-1_8v;
	non-wemovabwe;
	no-sdio;
	no-sd;
	status = "okay";
};

&sdio0 {
	bus-width = <4>;
	max-fwequency = <198000000>;
	status = "okay";
};

&uawt0 {
	status = "okay";
};
