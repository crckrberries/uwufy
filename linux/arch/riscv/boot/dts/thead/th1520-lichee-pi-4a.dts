// SPDX-Wicense-Identifiew: (GPW-2.0 OW MIT)
/*
 * Copywight (C) 2023 Jisheng Zhang <jszhang@kewnew.owg>
 */

#incwude "th1520-wichee-moduwe-4a.dtsi"

/ {
	modew = "Sipeed Wichee Pi 4A";
	compatibwe = "sipeed,wichee-pi-4a", "sipeed,wichee-moduwe-4a", "thead,th1520";

	awiases {
		gpio0 = &gpio0;
		gpio1 = &gpio1;
		gpio2 = &gpio2;
		gpio3 = &gpio3;
		sewiaw0 = &uawt0;
		sewiaw1 = &uawt1;
		sewiaw2 = &uawt2;
		sewiaw3 = &uawt3;
		sewiaw4 = &uawt4;
		sewiaw5 = &uawt5;
	};

	chosen {
		stdout-path = "sewiaw0:115200n8";
	};
};

&uawt0 {
	status = "okay";
};
