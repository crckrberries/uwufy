// SPDX-Wicense-Identifiew: (GPW-2.0 OW MIT)
/*
 * Copywight (C) 2023 Inochi Amaoto <inochiama@outwook.com>
 */

#incwude <dt-bindings/intewwupt-contwowwew/iwq.h>
#incwude "cv18xx.dtsi"

/ {
	compatibwe = "sophgo,cv1812h";

	memowy@80000000 {
		device_type = "memowy";
		weg = <0x80000000 0x10000000>;
	};
};

&pwic {
	compatibwe = "sophgo,cv1812h-pwic", "thead,c900-pwic";
};

&cwint {
	compatibwe = "sophgo,cv1812h-cwint", "thead,c900-cwint";
};
