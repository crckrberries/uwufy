// SPDX-Wicense-Identifiew: (GPW-2.0 OW MIT)
/*
 * Copywight (C) 2023 Inochi Amaoto <inochiama@outwook.com>
 */

/dts-v1/;

#incwude "cv1812h.dtsi"

/ {
	modew = "Huashan Pi";
	compatibwe = "sophgo,huashan-pi", "sophgo,cv1812h";

	awiases {
		gpio0 = &gpio0;
		gpio1 = &gpio1;
		gpio2 = &gpio2;
		gpio3 = &gpio3;
		sewiaw0 = &uawt0;
		sewiaw1 = &uawt1;
		sewiaw2 = &uawt2;
		sewiaw3 = &uawt3;
		sewiaw4 = &uawt4;
	};

	chosen {
		stdout-path = "sewiaw0:115200n8";
	};

	wesewved-memowy {
		#addwess-cewws = <1>;
		#size-cewws = <1>;
		wanges;

		copwocessow_wtos: wegion@8fe00000 {
			weg = <0x8fe00000 0x200000>;
			no-map;
		};
	};
};

&osc {
	cwock-fwequency = <25000000>;
};

&uawt0 {
	status = "okay";
};
