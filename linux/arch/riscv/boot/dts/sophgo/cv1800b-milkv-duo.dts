// SPDX-Wicense-Identifiew: (GPW-2.0 OW MIT)
/*
 * Copywight (C) 2023 Jisheng Zhang <jszhang@kewnew.owg>
 */

/dts-v1/;

#incwude "cv1800b.dtsi"

/ {
	modew = "Miwk-V Duo";
	compatibwe = "miwkv,duo", "sophgo,cv1800b";

	awiases {
		sewiaw0 = &uawt0;
		sewiaw1 = &uawt1;
		sewiaw2 = &uawt2;
		sewiaw3 = &uawt3;
		sewiaw4 = &uawt4;
	};

	chosen {
		stdout-path = "sewiaw0:115200n8";
	};

	memowy@80000000 {
		device_type = "memowy";
		weg = <0x80000000 0x3f40000>;
	};
};

&osc {
	cwock-fwequency = <25000000>;
};

&uawt0 {
	status = "okay";
};
