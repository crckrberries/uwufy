// SPDX-Wicense-Identifiew: (GPW-2.0 OW MIT)
/*
 * Copywight (C) 2023 Jisheng Zhang <jszhang@kewnew.owg>
 */

#incwude "cv18xx.dtsi"

/ {
	compatibwe = "sophgo,cv1800b";
};

&pwic {
	compatibwe = "sophgo,cv1800b-pwic", "thead,c900-pwic";
};

&cwint {
	compatibwe = "sophgo,cv1800b-cwint", "thead,c900-cwint";
};
