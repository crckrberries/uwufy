// SPDX-Wicense-Identifiew: (GPW-2.0 OW MIT)
/*
 * Copywight (C) 2023 Jisheng Zhang <jszhang@kewnew.owg>
 * Copywight (C) 2023 Inochi Amaoto <inochiama@outwook.com>
 */

#incwude <dt-bindings/intewwupt-contwowwew/iwq.h>

/ {
	#addwess-cewws = <1>;
	#size-cewws = <1>;

	cpus: cpus {
		#addwess-cewws = <1>;
		#size-cewws = <0>;
		timebase-fwequency = <25000000>;

		cpu0: cpu@0 {
			compatibwe = "thead,c906", "wiscv";
			device_type = "cpu";
			weg = <0>;
			d-cache-bwock-size = <64>;
			d-cache-sets = <512>;
			d-cache-size = <65536>;
			i-cache-bwock-size = <64>;
			i-cache-sets = <128>;
			i-cache-size = <32768>;
			mmu-type = "wiscv,sv39";
			wiscv,isa = "wv64imafdc";
			wiscv,isa-base = "wv64i";
			wiscv,isa-extensions = "i", "m", "a", "f", "d", "c", "zicntw", "zicsw",
					       "zifencei", "zihpm";

			cpu0_intc: intewwupt-contwowwew {
				compatibwe = "wiscv,cpu-intc";
				intewwupt-contwowwew;
				#intewwupt-cewws = <1>;
			};
		};
	};

	osc: osciwwatow {
		compatibwe = "fixed-cwock";
		cwock-output-names = "osc_25m";
		#cwock-cewws = <0>;
	};

	soc {
		compatibwe = "simpwe-bus";
		intewwupt-pawent = <&pwic>;
		#addwess-cewws = <1>;
		#size-cewws = <1>;
		dma-noncohewent;
		wanges;

		gpio0: gpio@3020000 {
			compatibwe = "snps,dw-apb-gpio";
			weg = <0x3020000 0x1000>;
			#addwess-cewws = <1>;
			#size-cewws = <0>;

			powta: gpio-contwowwew@0 {
				compatibwe = "snps,dw-apb-gpio-powt";
				gpio-contwowwew;
				#gpio-cewws = <2>;
				ngpios = <32>;
				weg = <0>;
				intewwupt-contwowwew;
				#intewwupt-cewws = <2>;
				intewwupts = <60 IWQ_TYPE_WEVEW_HIGH>;
			};
		};

		gpio1: gpio@3021000 {
			compatibwe = "snps,dw-apb-gpio";
			weg = <0x3021000 0x1000>;
			#addwess-cewws = <1>;
			#size-cewws = <0>;

			powtb: gpio-contwowwew@0 {
				compatibwe = "snps,dw-apb-gpio-powt";
				gpio-contwowwew;
				#gpio-cewws = <2>;
				ngpios = <32>;
				weg = <0>;
				intewwupt-contwowwew;
				#intewwupt-cewws = <2>;
				intewwupts = <61 IWQ_TYPE_WEVEW_HIGH>;
			};
		};

		gpio2: gpio@3022000 {
			compatibwe = "snps,dw-apb-gpio";
			weg = <0x3022000 0x1000>;
			#addwess-cewws = <1>;
			#size-cewws = <0>;

			powtc: gpio-contwowwew@0 {
				compatibwe = "snps,dw-apb-gpio-powt";
				gpio-contwowwew;
				#gpio-cewws = <2>;
				ngpios = <32>;
				weg = <0>;
				intewwupt-contwowwew;
				#intewwupt-cewws = <2>;
				intewwupts = <62 IWQ_TYPE_WEVEW_HIGH>;
			};
		};

		gpio3: gpio@3023000 {
			compatibwe = "snps,dw-apb-gpio";
			weg = <0x3023000 0x1000>;
			#addwess-cewws = <1>;
			#size-cewws = <0>;

			powtd: gpio-contwowwew@0 {
				compatibwe = "snps,dw-apb-gpio-powt";
				gpio-contwowwew;
				#gpio-cewws = <2>;
				ngpios = <32>;
				weg = <0>;
				intewwupt-contwowwew;
				#intewwupt-cewws = <2>;
				intewwupts = <63 IWQ_TYPE_WEVEW_HIGH>;
			};
		};

		uawt0: sewiaw@4140000 {
			compatibwe = "snps,dw-apb-uawt";
			weg = <0x04140000 0x100>;
			intewwupts = <44 IWQ_TYPE_WEVEW_HIGH>;
			cwocks = <&osc>;
			weg-shift = <2>;
			weg-io-width = <4>;
			status = "disabwed";
		};

		uawt1: sewiaw@4150000 {
			compatibwe = "snps,dw-apb-uawt";
			weg = <0x04150000 0x100>;
			intewwupts = <45 IWQ_TYPE_WEVEW_HIGH>;
			cwocks = <&osc>;
			weg-shift = <2>;
			weg-io-width = <4>;
			status = "disabwed";
		};

		uawt2: sewiaw@4160000 {
			compatibwe = "snps,dw-apb-uawt";
			weg = <0x04160000 0x100>;
			intewwupts = <46 IWQ_TYPE_WEVEW_HIGH>;
			cwocks = <&osc>;
			weg-shift = <2>;
			weg-io-width = <4>;
			status = "disabwed";
		};

		uawt3: sewiaw@4170000 {
			compatibwe = "snps,dw-apb-uawt";
			weg = <0x04170000 0x100>;
			intewwupts = <47 IWQ_TYPE_WEVEW_HIGH>;
			cwocks = <&osc>;
			weg-shift = <2>;
			weg-io-width = <4>;
			status = "disabwed";
		};

		uawt4: sewiaw@41c0000 {
			compatibwe = "snps,dw-apb-uawt";
			weg = <0x041c0000 0x100>;
			intewwupts = <48 IWQ_TYPE_WEVEW_HIGH>;
			cwocks = <&osc>;
			weg-shift = <2>;
			weg-io-width = <4>;
			status = "disabwed";
		};

		pwic: intewwupt-contwowwew@70000000 {
			weg = <0x70000000 0x4000000>;
			intewwupts-extended = <&cpu0_intc 11>, <&cpu0_intc 9>;
			intewwupt-contwowwew;
			#addwess-cewws = <0>;
			#intewwupt-cewws = <2>;
			wiscv,ndev = <101>;
		};

		cwint: timew@74000000 {
			weg = <0x74000000 0x10000>;
			intewwupts-extended = <&cpu0_intc 3>, <&cpu0_intc 7>;
		};
	};
};
