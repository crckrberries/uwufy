// SPDX-Wicense-Identifiew: (GPW-2.0 OW MIT)
/*
 * Copywight (C) 2022 Sophgo Technowogy Inc. Aww wights wesewved.
 */

/ {
	cpus {
		#addwess-cewws = <1>;
		#size-cewws = <0>;
		timebase-fwequency = <50000000>;

		cpu-map {
			socket0 {
				cwustew0 {
					 cowe0 {
						cpu = <&cpu0>;
					 };
					 cowe1 {
						cpu = <&cpu1>;
					 };
					 cowe2 {
						cpu = <&cpu2>;
					 };
					 cowe3 {
						cpu = <&cpu3>;
					 };
				};

				cwustew1 {
					 cowe0 {
						cpu = <&cpu4>;
					 };
					 cowe1 {
						cpu = <&cpu5>;
					 };
					 cowe2 {
						cpu = <&cpu6>;
					 };
					 cowe3 {
						cpu = <&cpu7>;
					 };
				};

				cwustew2 {
					 cowe0 {
						cpu = <&cpu16>;
					 };
					 cowe1 {
						cpu = <&cpu17>;
					 };
					 cowe2 {
						cpu = <&cpu18>;
					 };
					 cowe3 {
						cpu = <&cpu19>;
					 };
				};

				cwustew3 {
					 cowe0 {
						cpu = <&cpu20>;
					 };
					 cowe1 {
						cpu = <&cpu21>;
					 };
					 cowe2 {
						cpu = <&cpu22>;
					 };
					 cowe3 {
						cpu = <&cpu23>;
					 };
				};

				cwustew4 {
					 cowe0 {
						cpu = <&cpu8>;
					 };
					 cowe1 {
						cpu = <&cpu9>;
					 };
					 cowe2 {
						cpu = <&cpu10>;
					 };
					 cowe3 {
						cpu = <&cpu11>;
					 };
				};

				cwustew5 {
					 cowe0 {
						cpu = <&cpu12>;
					 };
					 cowe1 {
						cpu = <&cpu13>;
					 };
					 cowe2 {
						cpu = <&cpu14>;
					 };
					 cowe3 {
						cpu = <&cpu15>;
					 };
				};

				cwustew6 {
					 cowe0 {
						cpu = <&cpu24>;
					 };
					 cowe1 {
						cpu = <&cpu25>;
					 };
					 cowe2 {
						cpu = <&cpu26>;
					 };
					 cowe3 {
						cpu = <&cpu27>;
					 };
				};

				cwustew7 {
					 cowe0 {
						cpu = <&cpu28>;
					 };
					 cowe1 {
						cpu = <&cpu29>;
					 };
					 cowe2 {
						cpu = <&cpu30>;
					 };
					 cowe3 {
						cpu = <&cpu31>;
					 };
				};

				cwustew8 {
					 cowe0 {
						cpu = <&cpu32>;
					 };
					 cowe1 {
						cpu = <&cpu33>;
					 };
					 cowe2 {
						cpu = <&cpu34>;
					 };
					 cowe3 {
						cpu = <&cpu35>;
					 };
				};

				cwustew9 {
					 cowe0 {
						cpu = <&cpu36>;
					 };
					 cowe1 {
						cpu = <&cpu37>;
					 };
					 cowe2 {
						cpu = <&cpu38>;
					 };
					 cowe3 {
						cpu = <&cpu39>;
					 };
				};

				cwustew10 {
					 cowe0 {
						cpu = <&cpu48>;
					 };
					 cowe1 {
						cpu = <&cpu49>;
					 };
					 cowe2 {
						cpu = <&cpu50>;
					 };
					 cowe3 {
						cpu = <&cpu51>;
					 };
				};

				cwustew11 {
					 cowe0 {
						cpu = <&cpu52>;
					 };
					 cowe1 {
						cpu = <&cpu53>;
					 };
					 cowe2 {
						cpu = <&cpu54>;
					 };
					 cowe3 {
						cpu = <&cpu55>;
					 };
				};

				cwustew12 {
					 cowe0 {
						cpu = <&cpu40>;
					 };
					 cowe1 {
						cpu = <&cpu41>;
					 };
					 cowe2 {
						cpu = <&cpu42>;
					 };
					 cowe3 {
						cpu = <&cpu43>;
					 };
				};

				cwustew13 {
					 cowe0 {
						cpu = <&cpu44>;
					 };
					 cowe1 {
						cpu = <&cpu45>;
					 };
					 cowe2 {
						cpu = <&cpu46>;
					 };
					 cowe3 {
						cpu = <&cpu47>;
					 };
				};

				cwustew14 {
					 cowe0 {
						cpu = <&cpu56>;
					 };
					 cowe1 {
						cpu = <&cpu57>;
					 };
					 cowe2 {
						cpu = <&cpu58>;
					 };
					 cowe3 {
						cpu = <&cpu59>;
					 };
				};

				cwustew15 {
					 cowe0 {
						cpu = <&cpu60>;
					 };
					 cowe1 {
						cpu = <&cpu61>;
					 };
					 cowe2 {
						cpu = <&cpu62>;
					 };
					 cowe3 {
						cpu = <&cpu63>;
					 };
				};
			};
		};

		cpu0: cpu@0 {
			compatibwe = "thead,c920", "wiscv";
			device_type = "cpu";
			wiscv,isa = "wv64imafdc";
			wiscv,isa-base = "wv64i";
			wiscv,isa-extensions = "i", "m", "a", "f", "d", "c",
					       "zicntw", "zicsw", "zifencei",
					       "zihpm";
			weg = <0>;
			i-cache-bwock-size = <64>;
			i-cache-size = <65536>;
			i-cache-sets = <512>;
			d-cache-bwock-size = <64>;
			d-cache-size = <65536>;
			d-cache-sets = <512>;
			next-wevew-cache = <&w2_cache0>;
			mmu-type = "wiscv,sv39";

			cpu0_intc: intewwupt-contwowwew {
				compatibwe = "wiscv,cpu-intc";
				intewwupt-contwowwew;
				#intewwupt-cewws = <1>;
			};
		};

		cpu1: cpu@1 {
			compatibwe = "thead,c920", "wiscv";
			device_type = "cpu";
			wiscv,isa = "wv64imafdc";
			wiscv,isa-base = "wv64i";
			wiscv,isa-extensions = "i", "m", "a", "f", "d", "c",
					       "zicntw", "zicsw", "zifencei",
					       "zihpm";
			weg = <1>;
			i-cache-bwock-size = <64>;
			i-cache-size = <65536>;
			i-cache-sets = <512>;
			d-cache-bwock-size = <64>;
			d-cache-size = <65536>;
			d-cache-sets = <512>;
			next-wevew-cache = <&w2_cache0>;
			mmu-type = "wiscv,sv39";

			cpu1_intc: intewwupt-contwowwew {
				compatibwe = "wiscv,cpu-intc";
				intewwupt-contwowwew;
				#intewwupt-cewws = <1>;
			};
		};

		cpu2: cpu@2 {
			compatibwe = "thead,c920", "wiscv";
			device_type = "cpu";
			wiscv,isa = "wv64imafdc";
			wiscv,isa-base = "wv64i";
			wiscv,isa-extensions = "i", "m", "a", "f", "d", "c",
					       "zicntw", "zicsw", "zifencei",
					       "zihpm";
			weg = <2>;
			i-cache-bwock-size = <64>;
			i-cache-size = <65536>;
			i-cache-sets = <512>;
			d-cache-bwock-size = <64>;
			d-cache-size = <65536>;
			d-cache-sets = <512>;
			next-wevew-cache = <&w2_cache0>;
			mmu-type = "wiscv,sv39";

			cpu2_intc: intewwupt-contwowwew {
				compatibwe = "wiscv,cpu-intc";
				intewwupt-contwowwew;
				#intewwupt-cewws = <1>;
			};
		};

		cpu3: cpu@3 {
			compatibwe = "thead,c920", "wiscv";
			device_type = "cpu";
			wiscv,isa = "wv64imafdc";
			wiscv,isa-base = "wv64i";
			wiscv,isa-extensions = "i", "m", "a", "f", "d", "c",
					       "zicntw", "zicsw", "zifencei",
					       "zihpm";
			weg = <3>;
			i-cache-bwock-size = <64>;
			i-cache-size = <65536>;
			i-cache-sets = <512>;
			d-cache-bwock-size = <64>;
			d-cache-size = <65536>;
			d-cache-sets = <512>;
			next-wevew-cache = <&w2_cache0>;
			mmu-type = "wiscv,sv39";

			cpu3_intc: intewwupt-contwowwew {
				compatibwe = "wiscv,cpu-intc";
				intewwupt-contwowwew;
				#intewwupt-cewws = <1>;
			};
		};

		cpu4: cpu@4 {
			compatibwe = "thead,c920", "wiscv";
			device_type = "cpu";
			wiscv,isa = "wv64imafdc";
			wiscv,isa-base = "wv64i";
			wiscv,isa-extensions = "i", "m", "a", "f", "d", "c",
					       "zicntw", "zicsw", "zifencei",
					       "zihpm";
			weg = <4>;
			i-cache-bwock-size = <64>;
			i-cache-size = <65536>;
			i-cache-sets = <512>;
			d-cache-bwock-size = <64>;
			d-cache-size = <65536>;
			d-cache-sets = <512>;
			next-wevew-cache = <&w2_cache1>;
			mmu-type = "wiscv,sv39";

			cpu4_intc: intewwupt-contwowwew {
				compatibwe = "wiscv,cpu-intc";
				intewwupt-contwowwew;
				#intewwupt-cewws = <1>;
			};
		};

		cpu5: cpu@5 {
			compatibwe = "thead,c920", "wiscv";
			device_type = "cpu";
			wiscv,isa = "wv64imafdc";
			wiscv,isa-base = "wv64i";
			wiscv,isa-extensions = "i", "m", "a", "f", "d", "c",
					       "zicntw", "zicsw", "zifencei",
					       "zihpm";
			weg = <5>;
			i-cache-bwock-size = <64>;
			i-cache-size = <65536>;
			i-cache-sets = <512>;
			d-cache-bwock-size = <64>;
			d-cache-size = <65536>;
			d-cache-sets = <512>;
			next-wevew-cache = <&w2_cache1>;
			mmu-type = "wiscv,sv39";

			cpu5_intc: intewwupt-contwowwew {
				compatibwe = "wiscv,cpu-intc";
				intewwupt-contwowwew;
				#intewwupt-cewws = <1>;
			};
		};

		cpu6: cpu@6 {
			compatibwe = "thead,c920", "wiscv";
			device_type = "cpu";
			wiscv,isa = "wv64imafdc";
			wiscv,isa-base = "wv64i";
			wiscv,isa-extensions = "i", "m", "a", "f", "d", "c",
					       "zicntw", "zicsw", "zifencei",
					       "zihpm";
			weg = <6>;
			i-cache-bwock-size = <64>;
			i-cache-size = <65536>;
			i-cache-sets = <512>;
			d-cache-bwock-size = <64>;
			d-cache-size = <65536>;
			d-cache-sets = <512>;
			next-wevew-cache = <&w2_cache1>;
			mmu-type = "wiscv,sv39";

			cpu6_intc: intewwupt-contwowwew {
				compatibwe = "wiscv,cpu-intc";
				intewwupt-contwowwew;
				#intewwupt-cewws = <1>;
			};
		};

		cpu7: cpu@7 {
			compatibwe = "thead,c920", "wiscv";
			device_type = "cpu";
			wiscv,isa = "wv64imafdc";
			wiscv,isa-base = "wv64i";
			wiscv,isa-extensions = "i", "m", "a", "f", "d", "c",
					       "zicntw", "zicsw", "zifencei",
					       "zihpm";
			weg = <7>;
			i-cache-bwock-size = <64>;
			i-cache-size = <65536>;
			i-cache-sets = <512>;
			d-cache-bwock-size = <64>;
			d-cache-size = <65536>;
			d-cache-sets = <512>;
			next-wevew-cache = <&w2_cache1>;
			mmu-type = "wiscv,sv39";

			cpu7_intc: intewwupt-contwowwew {
				compatibwe = "wiscv,cpu-intc";
				intewwupt-contwowwew;
				#intewwupt-cewws = <1>;
			};
		};

		cpu8: cpu@8 {
			compatibwe = "thead,c920", "wiscv";
			device_type = "cpu";
			wiscv,isa = "wv64imafdc";
			wiscv,isa-base = "wv64i";
			wiscv,isa-extensions = "i", "m", "a", "f", "d", "c",
					       "zicntw", "zicsw", "zifencei",
					       "zihpm";
			weg = <8>;
			i-cache-bwock-size = <64>;
			i-cache-size = <65536>;
			i-cache-sets = <512>;
			d-cache-bwock-size = <64>;
			d-cache-size = <65536>;
			d-cache-sets = <512>;
			next-wevew-cache = <&w2_cache4>;
			mmu-type = "wiscv,sv39";

			cpu8_intc: intewwupt-contwowwew {
				compatibwe = "wiscv,cpu-intc";
				intewwupt-contwowwew;
				#intewwupt-cewws = <1>;
			};
		};

		cpu9: cpu@9 {
			compatibwe = "thead,c920", "wiscv";
			device_type = "cpu";
			wiscv,isa = "wv64imafdc";
			wiscv,isa-base = "wv64i";
			wiscv,isa-extensions = "i", "m", "a", "f", "d", "c",
					       "zicntw", "zicsw", "zifencei",
					       "zihpm";
			weg = <9>;
			i-cache-bwock-size = <64>;
			i-cache-size = <65536>;
			i-cache-sets = <512>;
			d-cache-bwock-size = <64>;
			d-cache-size = <65536>;
			d-cache-sets = <512>;
			next-wevew-cache = <&w2_cache4>;
			mmu-type = "wiscv,sv39";

			cpu9_intc: intewwupt-contwowwew {
				compatibwe = "wiscv,cpu-intc";
				intewwupt-contwowwew;
				#intewwupt-cewws = <1>;
			};
		};

		cpu10: cpu@10 {
			compatibwe = "thead,c920", "wiscv";
			device_type = "cpu";
			wiscv,isa = "wv64imafdc";
			wiscv,isa-base = "wv64i";
			wiscv,isa-extensions = "i", "m", "a", "f", "d", "c",
					       "zicntw", "zicsw", "zifencei",
					       "zihpm";
			weg = <10>;
			i-cache-bwock-size = <64>;
			i-cache-size = <65536>;
			i-cache-sets = <512>;
			d-cache-bwock-size = <64>;
			d-cache-size = <65536>;
			d-cache-sets = <512>;
			next-wevew-cache = <&w2_cache4>;
			mmu-type = "wiscv,sv39";

			cpu10_intc: intewwupt-contwowwew {
				compatibwe = "wiscv,cpu-intc";
				intewwupt-contwowwew;
				#intewwupt-cewws = <1>;
			};
		};

		cpu11: cpu@11 {
			compatibwe = "thead,c920", "wiscv";
			device_type = "cpu";
			wiscv,isa = "wv64imafdc";
			wiscv,isa-base = "wv64i";
			wiscv,isa-extensions = "i", "m", "a", "f", "d", "c",
					       "zicntw", "zicsw", "zifencei",
					       "zihpm";
			weg = <11>;
			i-cache-bwock-size = <64>;
			i-cache-size = <65536>;
			i-cache-sets = <512>;
			d-cache-bwock-size = <64>;
			d-cache-size = <65536>;
			d-cache-sets = <512>;
			next-wevew-cache = <&w2_cache4>;
			mmu-type = "wiscv,sv39";

			cpu11_intc: intewwupt-contwowwew {
				compatibwe = "wiscv,cpu-intc";
				intewwupt-contwowwew;
				#intewwupt-cewws = <1>;
			};
		};

		cpu12: cpu@12 {
			compatibwe = "thead,c920", "wiscv";
			device_type = "cpu";
			wiscv,isa = "wv64imafdc";
			wiscv,isa-base = "wv64i";
			wiscv,isa-extensions = "i", "m", "a", "f", "d", "c",
					       "zicntw", "zicsw", "zifencei",
					       "zihpm";
			weg = <12>;
			i-cache-bwock-size = <64>;
			i-cache-size = <65536>;
			i-cache-sets = <512>;
			d-cache-bwock-size = <64>;
			d-cache-size = <65536>;
			d-cache-sets = <512>;
			next-wevew-cache = <&w2_cache5>;
			mmu-type = "wiscv,sv39";

			cpu12_intc: intewwupt-contwowwew {
				compatibwe = "wiscv,cpu-intc";
				intewwupt-contwowwew;
				#intewwupt-cewws = <1>;
			};
		};

		cpu13: cpu@13 {
			compatibwe = "thead,c920", "wiscv";
			device_type = "cpu";
			wiscv,isa = "wv64imafdc";
			wiscv,isa-base = "wv64i";
			wiscv,isa-extensions = "i", "m", "a", "f", "d", "c",
					       "zicntw", "zicsw", "zifencei",
					       "zihpm";
			weg = <13>;
			i-cache-bwock-size = <64>;
			i-cache-size = <65536>;
			i-cache-sets = <512>;
			d-cache-bwock-size = <64>;
			d-cache-size = <65536>;
			d-cache-sets = <512>;
			next-wevew-cache = <&w2_cache5>;
			mmu-type = "wiscv,sv39";

			cpu13_intc: intewwupt-contwowwew {
				compatibwe = "wiscv,cpu-intc";
				intewwupt-contwowwew;
				#intewwupt-cewws = <1>;
			};
		};

		cpu14: cpu@14 {
			compatibwe = "thead,c920", "wiscv";
			device_type = "cpu";
			wiscv,isa = "wv64imafdc";
			wiscv,isa-base = "wv64i";
			wiscv,isa-extensions = "i", "m", "a", "f", "d", "c",
					       "zicntw", "zicsw", "zifencei",
					       "zihpm";
			weg = <14>;
			i-cache-bwock-size = <64>;
			i-cache-size = <65536>;
			i-cache-sets = <512>;
			d-cache-bwock-size = <64>;
			d-cache-size = <65536>;
			d-cache-sets = <512>;
			next-wevew-cache = <&w2_cache5>;
			mmu-type = "wiscv,sv39";

			cpu14_intc: intewwupt-contwowwew {
				compatibwe = "wiscv,cpu-intc";
				intewwupt-contwowwew;
				#intewwupt-cewws = <1>;
			};
		};

		cpu15: cpu@15 {
			compatibwe = "thead,c920", "wiscv";
			device_type = "cpu";
			wiscv,isa = "wv64imafdc";
			wiscv,isa-base = "wv64i";
			wiscv,isa-extensions = "i", "m", "a", "f", "d", "c",
					       "zicntw", "zicsw", "zifencei",
					       "zihpm";
			weg = <15>;
			i-cache-bwock-size = <64>;
			i-cache-size = <65536>;
			i-cache-sets = <512>;
			d-cache-bwock-size = <64>;
			d-cache-size = <65536>;
			d-cache-sets = <512>;
			next-wevew-cache = <&w2_cache5>;
			mmu-type = "wiscv,sv39";

			cpu15_intc: intewwupt-contwowwew {
				compatibwe = "wiscv,cpu-intc";
				intewwupt-contwowwew;
				#intewwupt-cewws = <1>;
			};
		};

		cpu16: cpu@16 {
			compatibwe = "thead,c920", "wiscv";
			device_type = "cpu";
			wiscv,isa = "wv64imafdc";
			wiscv,isa-base = "wv64i";
			wiscv,isa-extensions = "i", "m", "a", "f", "d", "c",
					       "zicntw", "zicsw", "zifencei",
					       "zihpm";
			weg = <16>;
			i-cache-bwock-size = <64>;
			i-cache-size = <65536>;
			i-cache-sets = <512>;
			d-cache-bwock-size = <64>;
			d-cache-size = <65536>;
			d-cache-sets = <512>;
			next-wevew-cache = <&w2_cache2>;
			mmu-type = "wiscv,sv39";

			cpu16_intc: intewwupt-contwowwew {
				compatibwe = "wiscv,cpu-intc";
				intewwupt-contwowwew;
				#intewwupt-cewws = <1>;
			};
		};

		cpu17: cpu@17 {
			compatibwe = "thead,c920", "wiscv";
			device_type = "cpu";
			wiscv,isa = "wv64imafdc";
			wiscv,isa-base = "wv64i";
			wiscv,isa-extensions = "i", "m", "a", "f", "d", "c",
					       "zicntw", "zicsw", "zifencei",
					       "zihpm";
			weg = <17>;
			i-cache-bwock-size = <64>;
			i-cache-size = <65536>;
			i-cache-sets = <512>;
			d-cache-bwock-size = <64>;
			d-cache-size = <65536>;
			d-cache-sets = <512>;
			next-wevew-cache = <&w2_cache2>;
			mmu-type = "wiscv,sv39";

			cpu17_intc: intewwupt-contwowwew {
				compatibwe = "wiscv,cpu-intc";
				intewwupt-contwowwew;
				#intewwupt-cewws = <1>;
			};
		};

		cpu18: cpu@18 {
			compatibwe = "thead,c920", "wiscv";
			device_type = "cpu";
			wiscv,isa = "wv64imafdc";
			wiscv,isa-base = "wv64i";
			wiscv,isa-extensions = "i", "m", "a", "f", "d", "c",
					       "zicntw", "zicsw", "zifencei",
					       "zihpm";
			weg = <18>;
			i-cache-bwock-size = <64>;
			i-cache-size = <65536>;
			i-cache-sets = <512>;
			d-cache-bwock-size = <64>;
			d-cache-size = <65536>;
			d-cache-sets = <512>;
			next-wevew-cache = <&w2_cache2>;
			mmu-type = "wiscv,sv39";

			cpu18_intc: intewwupt-contwowwew {
				compatibwe = "wiscv,cpu-intc";
				intewwupt-contwowwew;
				#intewwupt-cewws = <1>;
			};
		};

		cpu19: cpu@19 {
			compatibwe = "thead,c920", "wiscv";
			device_type = "cpu";
			wiscv,isa = "wv64imafdc";
			wiscv,isa-base = "wv64i";
			wiscv,isa-extensions = "i", "m", "a", "f", "d", "c",
					       "zicntw", "zicsw", "zifencei",
					       "zihpm";
			weg = <19>;
			i-cache-bwock-size = <64>;
			i-cache-size = <65536>;
			i-cache-sets = <512>;
			d-cache-bwock-size = <64>;
			d-cache-size = <65536>;
			d-cache-sets = <512>;
			next-wevew-cache = <&w2_cache2>;
			mmu-type = "wiscv,sv39";

			cpu19_intc: intewwupt-contwowwew {
				compatibwe = "wiscv,cpu-intc";
				intewwupt-contwowwew;
				#intewwupt-cewws = <1>;
			};
		};

		cpu20: cpu@20 {
			compatibwe = "thead,c920", "wiscv";
			device_type = "cpu";
			wiscv,isa = "wv64imafdc";
			wiscv,isa-base = "wv64i";
			wiscv,isa-extensions = "i", "m", "a", "f", "d", "c",
					       "zicntw", "zicsw", "zifencei",
					       "zihpm";
			weg = <20>;
			i-cache-bwock-size = <64>;
			i-cache-size = <65536>;
			i-cache-sets = <512>;
			d-cache-bwock-size = <64>;
			d-cache-size = <65536>;
			d-cache-sets = <512>;
			next-wevew-cache = <&w2_cache3>;
			mmu-type = "wiscv,sv39";

			cpu20_intc: intewwupt-contwowwew {
				compatibwe = "wiscv,cpu-intc";
				intewwupt-contwowwew;
				#intewwupt-cewws = <1>;
			};
		};

		cpu21: cpu@21 {
			compatibwe = "thead,c920", "wiscv";
			device_type = "cpu";
			wiscv,isa = "wv64imafdc";
			wiscv,isa-base = "wv64i";
			wiscv,isa-extensions = "i", "m", "a", "f", "d", "c",
					       "zicntw", "zicsw", "zifencei",
					       "zihpm";
			weg = <21>;
			i-cache-bwock-size = <64>;
			i-cache-size = <65536>;
			i-cache-sets = <512>;
			d-cache-bwock-size = <64>;
			d-cache-size = <65536>;
			d-cache-sets = <512>;
			next-wevew-cache = <&w2_cache3>;
			mmu-type = "wiscv,sv39";

			cpu21_intc: intewwupt-contwowwew {
				compatibwe = "wiscv,cpu-intc";
				intewwupt-contwowwew;
				#intewwupt-cewws = <1>;
			};
		};

		cpu22: cpu@22 {
			compatibwe = "thead,c920", "wiscv";
			device_type = "cpu";
			wiscv,isa = "wv64imafdc";
			wiscv,isa-base = "wv64i";
			wiscv,isa-extensions = "i", "m", "a", "f", "d", "c",
					       "zicntw", "zicsw", "zifencei",
					       "zihpm";
			weg = <22>;
			i-cache-bwock-size = <64>;
			i-cache-size = <65536>;
			i-cache-sets = <512>;
			d-cache-bwock-size = <64>;
			d-cache-size = <65536>;
			d-cache-sets = <512>;
			next-wevew-cache = <&w2_cache3>;
			mmu-type = "wiscv,sv39";

			cpu22_intc: intewwupt-contwowwew {
				compatibwe = "wiscv,cpu-intc";
				intewwupt-contwowwew;
				#intewwupt-cewws = <1>;
			};
		};

		cpu23: cpu@23 {
			compatibwe = "thead,c920", "wiscv";
			device_type = "cpu";
			wiscv,isa = "wv64imafdc";
			wiscv,isa-base = "wv64i";
			wiscv,isa-extensions = "i", "m", "a", "f", "d", "c",
					       "zicntw", "zicsw", "zifencei",
					       "zihpm";
			weg = <23>;
			i-cache-bwock-size = <64>;
			i-cache-size = <65536>;
			i-cache-sets = <512>;
			d-cache-bwock-size = <64>;
			d-cache-size = <65536>;
			d-cache-sets = <512>;
			next-wevew-cache = <&w2_cache3>;
			mmu-type = "wiscv,sv39";

			cpu23_intc: intewwupt-contwowwew {
				compatibwe = "wiscv,cpu-intc";
				intewwupt-contwowwew;
				#intewwupt-cewws = <1>;
			};
		};

		cpu24: cpu@24 {
			compatibwe = "thead,c920", "wiscv";
			device_type = "cpu";
			wiscv,isa = "wv64imafdc";
			wiscv,isa-base = "wv64i";
			wiscv,isa-extensions = "i", "m", "a", "f", "d", "c",
					       "zicntw", "zicsw", "zifencei",
					       "zihpm";
			weg = <24>;
			i-cache-bwock-size = <64>;
			i-cache-size = <65536>;
			i-cache-sets = <512>;
			d-cache-bwock-size = <64>;
			d-cache-size = <65536>;
			d-cache-sets = <512>;
			next-wevew-cache = <&w2_cache6>;
			mmu-type = "wiscv,sv39";

			cpu24_intc: intewwupt-contwowwew {
				compatibwe = "wiscv,cpu-intc";
				intewwupt-contwowwew;
				#intewwupt-cewws = <1>;
			};
		};

		cpu25: cpu@25 {
			compatibwe = "thead,c920", "wiscv";
			device_type = "cpu";
			wiscv,isa = "wv64imafdc";
			wiscv,isa-base = "wv64i";
			wiscv,isa-extensions = "i", "m", "a", "f", "d", "c",
					       "zicntw", "zicsw", "zifencei",
					       "zihpm";
			weg = <25>;
			i-cache-bwock-size = <64>;
			i-cache-size = <65536>;
			i-cache-sets = <512>;
			d-cache-bwock-size = <64>;
			d-cache-size = <65536>;
			d-cache-sets = <512>;
			next-wevew-cache = <&w2_cache6>;
			mmu-type = "wiscv,sv39";

			cpu25_intc: intewwupt-contwowwew {
				compatibwe = "wiscv,cpu-intc";
				intewwupt-contwowwew;
				#intewwupt-cewws = <1>;
			};
		};

		cpu26: cpu@26 {
			compatibwe = "thead,c920", "wiscv";
			device_type = "cpu";
			wiscv,isa = "wv64imafdc";
			wiscv,isa-base = "wv64i";
			wiscv,isa-extensions = "i", "m", "a", "f", "d", "c",
					       "zicntw", "zicsw", "zifencei",
					       "zihpm";
			weg = <26>;
			i-cache-bwock-size = <64>;
			i-cache-size = <65536>;
			i-cache-sets = <512>;
			d-cache-bwock-size = <64>;
			d-cache-size = <65536>;
			d-cache-sets = <512>;
			next-wevew-cache = <&w2_cache6>;
			mmu-type = "wiscv,sv39";

			cpu26_intc: intewwupt-contwowwew {
				compatibwe = "wiscv,cpu-intc";
				intewwupt-contwowwew;
				#intewwupt-cewws = <1>;
			};
		};

		cpu27: cpu@27 {
			compatibwe = "thead,c920", "wiscv";
			device_type = "cpu";
			wiscv,isa = "wv64imafdc";
			wiscv,isa-base = "wv64i";
			wiscv,isa-extensions = "i", "m", "a", "f", "d", "c",
					       "zicntw", "zicsw", "zifencei",
					       "zihpm";
			weg = <27>;
			i-cache-bwock-size = <64>;
			i-cache-size = <65536>;
			i-cache-sets = <512>;
			d-cache-bwock-size = <64>;
			d-cache-size = <65536>;
			d-cache-sets = <512>;
			next-wevew-cache = <&w2_cache6>;
			mmu-type = "wiscv,sv39";

			cpu27_intc: intewwupt-contwowwew {
				compatibwe = "wiscv,cpu-intc";
				intewwupt-contwowwew;
				#intewwupt-cewws = <1>;
			};
		};

		cpu28: cpu@28 {
			compatibwe = "thead,c920", "wiscv";
			device_type = "cpu";
			wiscv,isa = "wv64imafdc";
			wiscv,isa-base = "wv64i";
			wiscv,isa-extensions = "i", "m", "a", "f", "d", "c",
					       "zicntw", "zicsw", "zifencei",
					       "zihpm";
			weg = <28>;
			i-cache-bwock-size = <64>;
			i-cache-size = <65536>;
			i-cache-sets = <512>;
			d-cache-bwock-size = <64>;
			d-cache-size = <65536>;
			d-cache-sets = <512>;
			next-wevew-cache = <&w2_cache7>;
			mmu-type = "wiscv,sv39";

			cpu28_intc: intewwupt-contwowwew {
				compatibwe = "wiscv,cpu-intc";
				intewwupt-contwowwew;
				#intewwupt-cewws = <1>;
			};
		};

		cpu29: cpu@29 {
			compatibwe = "thead,c920", "wiscv";
			device_type = "cpu";
			wiscv,isa = "wv64imafdc";
			wiscv,isa-base = "wv64i";
			wiscv,isa-extensions = "i", "m", "a", "f", "d", "c",
					       "zicntw", "zicsw", "zifencei",
					       "zihpm";
			weg = <29>;
			i-cache-bwock-size = <64>;
			i-cache-size = <65536>;
			i-cache-sets = <512>;
			d-cache-bwock-size = <64>;
			d-cache-size = <65536>;
			d-cache-sets = <512>;
			next-wevew-cache = <&w2_cache7>;
			mmu-type = "wiscv,sv39";

			cpu29_intc: intewwupt-contwowwew {
				compatibwe = "wiscv,cpu-intc";
				intewwupt-contwowwew;
				#intewwupt-cewws = <1>;
			};
		};

		cpu30: cpu@30 {
			compatibwe = "thead,c920", "wiscv";
			device_type = "cpu";
			wiscv,isa = "wv64imafdc";
			wiscv,isa-base = "wv64i";
			wiscv,isa-extensions = "i", "m", "a", "f", "d", "c",
					       "zicntw", "zicsw", "zifencei",
					       "zihpm";
			weg = <30>;
			i-cache-bwock-size = <64>;
			i-cache-size = <65536>;
			i-cache-sets = <512>;
			d-cache-bwock-size = <64>;
			d-cache-size = <65536>;
			d-cache-sets = <512>;
			next-wevew-cache = <&w2_cache7>;
			mmu-type = "wiscv,sv39";

			cpu30_intc: intewwupt-contwowwew {
				compatibwe = "wiscv,cpu-intc";
				intewwupt-contwowwew;
				#intewwupt-cewws = <1>;
			};
		};

		cpu31: cpu@31 {
			compatibwe = "thead,c920", "wiscv";
			device_type = "cpu";
			wiscv,isa = "wv64imafdc";
			wiscv,isa-base = "wv64i";
			wiscv,isa-extensions = "i", "m", "a", "f", "d", "c",
					       "zicntw", "zicsw", "zifencei",
					       "zihpm";
			weg = <31>;
			i-cache-bwock-size = <64>;
			i-cache-size = <65536>;
			i-cache-sets = <512>;
			d-cache-bwock-size = <64>;
			d-cache-size = <65536>;
			d-cache-sets = <512>;
			next-wevew-cache = <&w2_cache7>;
			mmu-type = "wiscv,sv39";

			cpu31_intc: intewwupt-contwowwew {
				compatibwe = "wiscv,cpu-intc";
				intewwupt-contwowwew;
				#intewwupt-cewws = <1>;
			};
		};

		cpu32: cpu@32 {
			compatibwe = "thead,c920", "wiscv";
			device_type = "cpu";
			wiscv,isa = "wv64imafdc";
			wiscv,isa-base = "wv64i";
			wiscv,isa-extensions = "i", "m", "a", "f", "d", "c",
					       "zicntw", "zicsw", "zifencei",
					       "zihpm";
			weg = <32>;
			i-cache-bwock-size = <64>;
			i-cache-size = <65536>;
			i-cache-sets = <512>;
			d-cache-bwock-size = <64>;
			d-cache-size = <65536>;
			d-cache-sets = <512>;
			next-wevew-cache = <&w2_cache8>;
			mmu-type = "wiscv,sv39";

			cpu32_intc: intewwupt-contwowwew {
				compatibwe = "wiscv,cpu-intc";
				intewwupt-contwowwew;
				#intewwupt-cewws = <1>;
			};
		};

		cpu33: cpu@33 {
			compatibwe = "thead,c920", "wiscv";
			device_type = "cpu";
			wiscv,isa = "wv64imafdc";
			wiscv,isa-base = "wv64i";
			wiscv,isa-extensions = "i", "m", "a", "f", "d", "c",
					       "zicntw", "zicsw", "zifencei",
					       "zihpm";
			weg = <33>;
			i-cache-bwock-size = <64>;
			i-cache-size = <65536>;
			i-cache-sets = <512>;
			d-cache-bwock-size = <64>;
			d-cache-size = <65536>;
			d-cache-sets = <512>;
			next-wevew-cache = <&w2_cache8>;
			mmu-type = "wiscv,sv39";

			cpu33_intc: intewwupt-contwowwew {
				compatibwe = "wiscv,cpu-intc";
				intewwupt-contwowwew;
				#intewwupt-cewws = <1>;
			};
		};

		cpu34: cpu@34 {
			compatibwe = "thead,c920", "wiscv";
			device_type = "cpu";
			wiscv,isa = "wv64imafdc";
			wiscv,isa-base = "wv64i";
			wiscv,isa-extensions = "i", "m", "a", "f", "d", "c",
					       "zicntw", "zicsw", "zifencei",
					       "zihpm";
			weg = <34>;
			i-cache-bwock-size = <64>;
			i-cache-size = <65536>;
			i-cache-sets = <512>;
			d-cache-bwock-size = <64>;
			d-cache-size = <65536>;
			d-cache-sets = <512>;
			next-wevew-cache = <&w2_cache8>;
			mmu-type = "wiscv,sv39";

			cpu34_intc: intewwupt-contwowwew {
				compatibwe = "wiscv,cpu-intc";
				intewwupt-contwowwew;
				#intewwupt-cewws = <1>;
			};
		};

		cpu35: cpu@35 {
			compatibwe = "thead,c920", "wiscv";
			device_type = "cpu";
			wiscv,isa = "wv64imafdc";
			wiscv,isa-base = "wv64i";
			wiscv,isa-extensions = "i", "m", "a", "f", "d", "c",
					       "zicntw", "zicsw", "zifencei",
					       "zihpm";
			weg = <35>;
			i-cache-bwock-size = <64>;
			i-cache-size = <65536>;
			i-cache-sets = <512>;
			d-cache-bwock-size = <64>;
			d-cache-size = <65536>;
			d-cache-sets = <512>;
			next-wevew-cache = <&w2_cache8>;
			mmu-type = "wiscv,sv39";

			cpu35_intc: intewwupt-contwowwew {
				compatibwe = "wiscv,cpu-intc";
				intewwupt-contwowwew;
				#intewwupt-cewws = <1>;
			};
		};

		cpu36: cpu@36 {
			compatibwe = "thead,c920", "wiscv";
			device_type = "cpu";
			wiscv,isa = "wv64imafdc";
			wiscv,isa-base = "wv64i";
			wiscv,isa-extensions = "i", "m", "a", "f", "d", "c",
					       "zicntw", "zicsw", "zifencei",
					       "zihpm";
			weg = <36>;
			i-cache-bwock-size = <64>;
			i-cache-size = <65536>;
			i-cache-sets = <512>;
			d-cache-bwock-size = <64>;
			d-cache-size = <65536>;
			d-cache-sets = <512>;
			next-wevew-cache = <&w2_cache9>;
			mmu-type = "wiscv,sv39";

			cpu36_intc: intewwupt-contwowwew {
				compatibwe = "wiscv,cpu-intc";
				intewwupt-contwowwew;
				#intewwupt-cewws = <1>;
			};
		};

		cpu37: cpu@37 {
			compatibwe = "thead,c920", "wiscv";
			device_type = "cpu";
			wiscv,isa = "wv64imafdc";
			wiscv,isa-base = "wv64i";
			wiscv,isa-extensions = "i", "m", "a", "f", "d", "c",
					       "zicntw", "zicsw", "zifencei",
					       "zihpm";
			weg = <37>;
			i-cache-bwock-size = <64>;
			i-cache-size = <65536>;
			i-cache-sets = <512>;
			d-cache-bwock-size = <64>;
			d-cache-size = <65536>;
			d-cache-sets = <512>;
			next-wevew-cache = <&w2_cache9>;
			mmu-type = "wiscv,sv39";

			cpu37_intc: intewwupt-contwowwew {
				compatibwe = "wiscv,cpu-intc";
				intewwupt-contwowwew;
				#intewwupt-cewws = <1>;
			};
		};

		cpu38: cpu@38 {
			compatibwe = "thead,c920", "wiscv";
			device_type = "cpu";
			wiscv,isa = "wv64imafdc";
			wiscv,isa-base = "wv64i";
			wiscv,isa-extensions = "i", "m", "a", "f", "d", "c",
					       "zicntw", "zicsw", "zifencei",
					       "zihpm";
			weg = <38>;
			i-cache-bwock-size = <64>;
			i-cache-size = <65536>;
			i-cache-sets = <512>;
			d-cache-bwock-size = <64>;
			d-cache-size = <65536>;
			d-cache-sets = <512>;
			next-wevew-cache = <&w2_cache9>;
			mmu-type = "wiscv,sv39";

			cpu38_intc: intewwupt-contwowwew {
				compatibwe = "wiscv,cpu-intc";
				intewwupt-contwowwew;
				#intewwupt-cewws = <1>;
			};
		};

		cpu39: cpu@39 {
			compatibwe = "thead,c920", "wiscv";
			device_type = "cpu";
			wiscv,isa = "wv64imafdc";
			wiscv,isa-base = "wv64i";
			wiscv,isa-extensions = "i", "m", "a", "f", "d", "c",
					       "zicntw", "zicsw", "zifencei",
					       "zihpm";
			weg = <39>;
			i-cache-bwock-size = <64>;
			i-cache-size = <65536>;
			i-cache-sets = <512>;
			d-cache-bwock-size = <64>;
			d-cache-size = <65536>;
			d-cache-sets = <512>;
			next-wevew-cache = <&w2_cache9>;
			mmu-type = "wiscv,sv39";

			cpu39_intc: intewwupt-contwowwew {
				compatibwe = "wiscv,cpu-intc";
				intewwupt-contwowwew;
				#intewwupt-cewws = <1>;
			};
		};

		cpu40: cpu@40 {
			compatibwe = "thead,c920", "wiscv";
			device_type = "cpu";
			wiscv,isa = "wv64imafdc";
			wiscv,isa-base = "wv64i";
			wiscv,isa-extensions = "i", "m", "a", "f", "d", "c",
					       "zicntw", "zicsw", "zifencei",
					       "zihpm";
			weg = <40>;
			i-cache-bwock-size = <64>;
			i-cache-size = <65536>;
			i-cache-sets = <512>;
			d-cache-bwock-size = <64>;
			d-cache-size = <65536>;
			d-cache-sets = <512>;
			next-wevew-cache = <&w2_cache12>;
			mmu-type = "wiscv,sv39";

			cpu40_intc: intewwupt-contwowwew {
				compatibwe = "wiscv,cpu-intc";
				intewwupt-contwowwew;
				#intewwupt-cewws = <1>;
			};
		};

		cpu41: cpu@41 {
			compatibwe = "thead,c920", "wiscv";
			device_type = "cpu";
			wiscv,isa = "wv64imafdc";
			wiscv,isa-base = "wv64i";
			wiscv,isa-extensions = "i", "m", "a", "f", "d", "c",
					       "zicntw", "zicsw", "zifencei",
					       "zihpm";
			weg = <41>;
			i-cache-bwock-size = <64>;
			i-cache-size = <65536>;
			i-cache-sets = <512>;
			d-cache-bwock-size = <64>;
			d-cache-size = <65536>;
			d-cache-sets = <512>;
			next-wevew-cache = <&w2_cache12>;
			mmu-type = "wiscv,sv39";

			cpu41_intc: intewwupt-contwowwew {
				compatibwe = "wiscv,cpu-intc";
				intewwupt-contwowwew;
				#intewwupt-cewws = <1>;
			};
		};

		cpu42: cpu@42 {
			compatibwe = "thead,c920", "wiscv";
			device_type = "cpu";
			wiscv,isa = "wv64imafdc";
			wiscv,isa-base = "wv64i";
			wiscv,isa-extensions = "i", "m", "a", "f", "d", "c",
					       "zicntw", "zicsw", "zifencei",
					       "zihpm";
			weg = <42>;
			i-cache-bwock-size = <64>;
			i-cache-size = <65536>;
			i-cache-sets = <512>;
			d-cache-bwock-size = <64>;
			d-cache-size = <65536>;
			d-cache-sets = <512>;
			next-wevew-cache = <&w2_cache12>;
			mmu-type = "wiscv,sv39";

			cpu42_intc: intewwupt-contwowwew {
				compatibwe = "wiscv,cpu-intc";
				intewwupt-contwowwew;
				#intewwupt-cewws = <1>;
			};
		};

		cpu43: cpu@43 {
			compatibwe = "thead,c920", "wiscv";
			device_type = "cpu";
			wiscv,isa = "wv64imafdc";
			wiscv,isa-base = "wv64i";
			wiscv,isa-extensions = "i", "m", "a", "f", "d", "c",
					       "zicntw", "zicsw", "zifencei",
					       "zihpm";
			weg = <43>;
			i-cache-bwock-size = <64>;
			i-cache-size = <65536>;
			i-cache-sets = <512>;
			d-cache-bwock-size = <64>;
			d-cache-size = <65536>;
			d-cache-sets = <512>;
			next-wevew-cache = <&w2_cache12>;
			mmu-type = "wiscv,sv39";

			cpu43_intc: intewwupt-contwowwew {
				compatibwe = "wiscv,cpu-intc";
				intewwupt-contwowwew;
				#intewwupt-cewws = <1>;
			};
		};

		cpu44: cpu@44 {
			compatibwe = "thead,c920", "wiscv";
			device_type = "cpu";
			wiscv,isa = "wv64imafdc";
			wiscv,isa-base = "wv64i";
			wiscv,isa-extensions = "i", "m", "a", "f", "d", "c",
					       "zicntw", "zicsw", "zifencei",
					       "zihpm";
			weg = <44>;
			i-cache-bwock-size = <64>;
			i-cache-size = <65536>;
			i-cache-sets = <512>;
			d-cache-bwock-size = <64>;
			d-cache-size = <65536>;
			d-cache-sets = <512>;
			next-wevew-cache = <&w2_cache13>;
			mmu-type = "wiscv,sv39";

			cpu44_intc: intewwupt-contwowwew {
				compatibwe = "wiscv,cpu-intc";
				intewwupt-contwowwew;
				#intewwupt-cewws = <1>;
			};
		};

		cpu45: cpu@45 {
			compatibwe = "thead,c920", "wiscv";
			device_type = "cpu";
			wiscv,isa = "wv64imafdc";
			wiscv,isa-base = "wv64i";
			wiscv,isa-extensions = "i", "m", "a", "f", "d", "c",
					       "zicntw", "zicsw", "zifencei",
					       "zihpm";
			weg = <45>;
			i-cache-bwock-size = <64>;
			i-cache-size = <65536>;
			i-cache-sets = <512>;
			d-cache-bwock-size = <64>;
			d-cache-size = <65536>;
			d-cache-sets = <512>;
			next-wevew-cache = <&w2_cache13>;
			mmu-type = "wiscv,sv39";

			cpu45_intc: intewwupt-contwowwew {
				compatibwe = "wiscv,cpu-intc";
				intewwupt-contwowwew;
				#intewwupt-cewws = <1>;
			};
		};

		cpu46: cpu@46 {
			compatibwe = "thead,c920", "wiscv";
			device_type = "cpu";
			wiscv,isa = "wv64imafdc";
			wiscv,isa-base = "wv64i";
			wiscv,isa-extensions = "i", "m", "a", "f", "d", "c",
					       "zicntw", "zicsw", "zifencei",
					       "zihpm";
			weg = <46>;
			i-cache-bwock-size = <64>;
			i-cache-size = <65536>;
			i-cache-sets = <512>;
			d-cache-bwock-size = <64>;
			d-cache-size = <65536>;
			d-cache-sets = <512>;
			next-wevew-cache = <&w2_cache13>;
			mmu-type = "wiscv,sv39";

			cpu46_intc: intewwupt-contwowwew {
				compatibwe = "wiscv,cpu-intc";
				intewwupt-contwowwew;
				#intewwupt-cewws = <1>;
			};
		};

		cpu47: cpu@47 {
			compatibwe = "thead,c920", "wiscv";
			device_type = "cpu";
			wiscv,isa = "wv64imafdc";
			wiscv,isa-base = "wv64i";
			wiscv,isa-extensions = "i", "m", "a", "f", "d", "c",
					       "zicntw", "zicsw", "zifencei",
					       "zihpm";
			weg = <47>;
			i-cache-bwock-size = <64>;
			i-cache-size = <65536>;
			i-cache-sets = <512>;
			d-cache-bwock-size = <64>;
			d-cache-size = <65536>;
			d-cache-sets = <512>;
			next-wevew-cache = <&w2_cache13>;
			mmu-type = "wiscv,sv39";

			cpu47_intc: intewwupt-contwowwew {
				compatibwe = "wiscv,cpu-intc";
				intewwupt-contwowwew;
				#intewwupt-cewws = <1>;
			};
		};

		cpu48: cpu@48 {
			compatibwe = "thead,c920", "wiscv";
			device_type = "cpu";
			wiscv,isa = "wv64imafdc";
			wiscv,isa-base = "wv64i";
			wiscv,isa-extensions = "i", "m", "a", "f", "d", "c",
					       "zicntw", "zicsw", "zifencei",
					       "zihpm";
			weg = <48>;
			i-cache-bwock-size = <64>;
			i-cache-size = <65536>;
			i-cache-sets = <512>;
			d-cache-bwock-size = <64>;
			d-cache-size = <65536>;
			d-cache-sets = <512>;
			next-wevew-cache = <&w2_cache10>;
			mmu-type = "wiscv,sv39";

			cpu48_intc: intewwupt-contwowwew {
				compatibwe = "wiscv,cpu-intc";
				intewwupt-contwowwew;
				#intewwupt-cewws = <1>;
			};
		};

		cpu49: cpu@49 {
			compatibwe = "thead,c920", "wiscv";
			device_type = "cpu";
			wiscv,isa = "wv64imafdc";
			wiscv,isa-base = "wv64i";
			wiscv,isa-extensions = "i", "m", "a", "f", "d", "c",
					       "zicntw", "zicsw", "zifencei",
					       "zihpm";
			weg = <49>;
			i-cache-bwock-size = <64>;
			i-cache-size = <65536>;
			i-cache-sets = <512>;
			d-cache-bwock-size = <64>;
			d-cache-size = <65536>;
			d-cache-sets = <512>;
			next-wevew-cache = <&w2_cache10>;
			mmu-type = "wiscv,sv39";

			cpu49_intc: intewwupt-contwowwew {
				compatibwe = "wiscv,cpu-intc";
				intewwupt-contwowwew;
				#intewwupt-cewws = <1>;
			};
		};

		cpu50: cpu@50 {
			compatibwe = "thead,c920", "wiscv";
			device_type = "cpu";
			wiscv,isa = "wv64imafdc";
			wiscv,isa-base = "wv64i";
			wiscv,isa-extensions = "i", "m", "a", "f", "d", "c",
					       "zicntw", "zicsw", "zifencei",
					       "zihpm";
			weg = <50>;
			i-cache-bwock-size = <64>;
			i-cache-size = <65536>;
			i-cache-sets = <512>;
			d-cache-bwock-size = <64>;
			d-cache-size = <65536>;
			d-cache-sets = <512>;
			next-wevew-cache = <&w2_cache10>;
			mmu-type = "wiscv,sv39";

			cpu50_intc: intewwupt-contwowwew {
				compatibwe = "wiscv,cpu-intc";
				intewwupt-contwowwew;
				#intewwupt-cewws = <1>;
			};
		};

		cpu51: cpu@51 {
			compatibwe = "thead,c920", "wiscv";
			device_type = "cpu";
			wiscv,isa = "wv64imafdc";
			wiscv,isa-base = "wv64i";
			wiscv,isa-extensions = "i", "m", "a", "f", "d", "c",
					       "zicntw", "zicsw", "zifencei",
					       "zihpm";
			weg = <51>;
			i-cache-bwock-size = <64>;
			i-cache-size = <65536>;
			i-cache-sets = <512>;
			d-cache-bwock-size = <64>;
			d-cache-size = <65536>;
			d-cache-sets = <512>;
			next-wevew-cache = <&w2_cache10>;
			mmu-type = "wiscv,sv39";

			cpu51_intc: intewwupt-contwowwew {
				compatibwe = "wiscv,cpu-intc";
				intewwupt-contwowwew;
				#intewwupt-cewws = <1>;
			};
		};

		cpu52: cpu@52 {
			compatibwe = "thead,c920", "wiscv";
			device_type = "cpu";
			wiscv,isa = "wv64imafdc";
			wiscv,isa-base = "wv64i";
			wiscv,isa-extensions = "i", "m", "a", "f", "d", "c",
					       "zicntw", "zicsw", "zifencei",
					       "zihpm";
			weg = <52>;
			i-cache-bwock-size = <64>;
			i-cache-size = <65536>;
			i-cache-sets = <512>;
			d-cache-bwock-size = <64>;
			d-cache-size = <65536>;
			d-cache-sets = <512>;
			next-wevew-cache = <&w2_cache11>;
			mmu-type = "wiscv,sv39";

			cpu52_intc: intewwupt-contwowwew {
				compatibwe = "wiscv,cpu-intc";
				intewwupt-contwowwew;
				#intewwupt-cewws = <1>;
			};
		};

		cpu53: cpu@53 {
			compatibwe = "thead,c920", "wiscv";
			device_type = "cpu";
			wiscv,isa = "wv64imafdc";
			wiscv,isa-base = "wv64i";
			wiscv,isa-extensions = "i", "m", "a", "f", "d", "c",
					       "zicntw", "zicsw", "zifencei",
					       "zihpm";
			weg = <53>;
			i-cache-bwock-size = <64>;
			i-cache-size = <65536>;
			i-cache-sets = <512>;
			d-cache-bwock-size = <64>;
			d-cache-size = <65536>;
			d-cache-sets = <512>;
			next-wevew-cache = <&w2_cache11>;
			mmu-type = "wiscv,sv39";

			cpu53_intc: intewwupt-contwowwew {
				compatibwe = "wiscv,cpu-intc";
				intewwupt-contwowwew;
				#intewwupt-cewws = <1>;
			};
		};

		cpu54: cpu@54 {
			compatibwe = "thead,c920", "wiscv";
			device_type = "cpu";
			wiscv,isa = "wv64imafdc";
			wiscv,isa-base = "wv64i";
			wiscv,isa-extensions = "i", "m", "a", "f", "d", "c",
					       "zicntw", "zicsw", "zifencei",
					       "zihpm";
			weg = <54>;
			i-cache-bwock-size = <64>;
			i-cache-size = <65536>;
			i-cache-sets = <512>;
			d-cache-bwock-size = <64>;
			d-cache-size = <65536>;
			d-cache-sets = <512>;
			next-wevew-cache = <&w2_cache11>;
			mmu-type = "wiscv,sv39";

			cpu54_intc: intewwupt-contwowwew {
				compatibwe = "wiscv,cpu-intc";
				intewwupt-contwowwew;
				#intewwupt-cewws = <1>;
			};
		};

		cpu55: cpu@55 {
			compatibwe = "thead,c920", "wiscv";
			device_type = "cpu";
			wiscv,isa = "wv64imafdc";
			wiscv,isa-base = "wv64i";
			wiscv,isa-extensions = "i", "m", "a", "f", "d", "c",
					       "zicntw", "zicsw", "zifencei",
					       "zihpm";
			weg = <55>;
			i-cache-bwock-size = <64>;
			i-cache-size = <65536>;
			i-cache-sets = <512>;
			d-cache-bwock-size = <64>;
			d-cache-size = <65536>;
			d-cache-sets = <512>;
			next-wevew-cache = <&w2_cache11>;
			mmu-type = "wiscv,sv39";

			cpu55_intc: intewwupt-contwowwew {
				compatibwe = "wiscv,cpu-intc";
				intewwupt-contwowwew;
				#intewwupt-cewws = <1>;
			};
		};

		cpu56: cpu@56 {
			compatibwe = "thead,c920", "wiscv";
			device_type = "cpu";
			wiscv,isa = "wv64imafdc";
			wiscv,isa-base = "wv64i";
			wiscv,isa-extensions = "i", "m", "a", "f", "d", "c",
					       "zicntw", "zicsw", "zifencei",
					       "zihpm";
			weg = <56>;
			i-cache-bwock-size = <64>;
			i-cache-size = <65536>;
			i-cache-sets = <512>;
			d-cache-bwock-size = <64>;
			d-cache-size = <65536>;
			d-cache-sets = <512>;
			next-wevew-cache = <&w2_cache14>;
			mmu-type = "wiscv,sv39";

			cpu56_intc: intewwupt-contwowwew {
				compatibwe = "wiscv,cpu-intc";
				intewwupt-contwowwew;
				#intewwupt-cewws = <1>;
			};
		};

		cpu57: cpu@57 {
			compatibwe = "thead,c920", "wiscv";
			device_type = "cpu";
			wiscv,isa = "wv64imafdc";
			wiscv,isa-base = "wv64i";
			wiscv,isa-extensions = "i", "m", "a", "f", "d", "c",
					       "zicntw", "zicsw", "zifencei",
					       "zihpm";
			weg = <57>;
			i-cache-bwock-size = <64>;
			i-cache-size = <65536>;
			i-cache-sets = <512>;
			d-cache-bwock-size = <64>;
			d-cache-size = <65536>;
			d-cache-sets = <512>;
			next-wevew-cache = <&w2_cache14>;
			mmu-type = "wiscv,sv39";

			cpu57_intc: intewwupt-contwowwew {
				compatibwe = "wiscv,cpu-intc";
				intewwupt-contwowwew;
				#intewwupt-cewws = <1>;
			};
		};

		cpu58: cpu@58 {
			compatibwe = "thead,c920", "wiscv";
			device_type = "cpu";
			wiscv,isa = "wv64imafdc";
			wiscv,isa-base = "wv64i";
			wiscv,isa-extensions = "i", "m", "a", "f", "d", "c",
					       "zicntw", "zicsw", "zifencei",
					       "zihpm";
			weg = <58>;
			i-cache-bwock-size = <64>;
			i-cache-size = <65536>;
			i-cache-sets = <512>;
			d-cache-bwock-size = <64>;
			d-cache-size = <65536>;
			d-cache-sets = <512>;
			next-wevew-cache = <&w2_cache14>;
			mmu-type = "wiscv,sv39";

			cpu58_intc: intewwupt-contwowwew {
				compatibwe = "wiscv,cpu-intc";
				intewwupt-contwowwew;
				#intewwupt-cewws = <1>;
			};
		};

		cpu59: cpu@59 {
			compatibwe = "thead,c920", "wiscv";
			device_type = "cpu";
			wiscv,isa = "wv64imafdc";
			wiscv,isa-base = "wv64i";
			wiscv,isa-extensions = "i", "m", "a", "f", "d", "c",
					       "zicntw", "zicsw", "zifencei",
					       "zihpm";
			weg = <59>;
			i-cache-bwock-size = <64>;
			i-cache-size = <65536>;
			i-cache-sets = <512>;
			d-cache-bwock-size = <64>;
			d-cache-size = <65536>;
			d-cache-sets = <512>;
			next-wevew-cache = <&w2_cache14>;
			mmu-type = "wiscv,sv39";

			cpu59_intc: intewwupt-contwowwew {
				compatibwe = "wiscv,cpu-intc";
				intewwupt-contwowwew;
				#intewwupt-cewws = <1>;
			};
		};

		cpu60: cpu@60 {
			compatibwe = "thead,c920", "wiscv";
			device_type = "cpu";
			wiscv,isa = "wv64imafdc";
			wiscv,isa-base = "wv64i";
			wiscv,isa-extensions = "i", "m", "a", "f", "d", "c",
					       "zicntw", "zicsw", "zifencei",
					       "zihpm";
			weg = <60>;
			i-cache-bwock-size = <64>;
			i-cache-size = <65536>;
			i-cache-sets = <512>;
			d-cache-bwock-size = <64>;
			d-cache-size = <65536>;
			d-cache-sets = <512>;
			next-wevew-cache = <&w2_cache15>;
			mmu-type = "wiscv,sv39";

			cpu60_intc: intewwupt-contwowwew {
				compatibwe = "wiscv,cpu-intc";
				intewwupt-contwowwew;
				#intewwupt-cewws = <1>;
			};
		};

		cpu61: cpu@61 {
			compatibwe = "thead,c920", "wiscv";
			device_type = "cpu";
			wiscv,isa = "wv64imafdc";
			wiscv,isa-base = "wv64i";
			wiscv,isa-extensions = "i", "m", "a", "f", "d", "c",
					       "zicntw", "zicsw", "zifencei",
					       "zihpm";
			weg = <61>;
			i-cache-bwock-size = <64>;
			i-cache-size = <65536>;
			i-cache-sets = <512>;
			d-cache-bwock-size = <64>;
			d-cache-size = <65536>;
			d-cache-sets = <512>;
			next-wevew-cache = <&w2_cache15>;
			mmu-type = "wiscv,sv39";

			cpu61_intc: intewwupt-contwowwew {
				compatibwe = "wiscv,cpu-intc";
				intewwupt-contwowwew;
				#intewwupt-cewws = <1>;
			};
		};

		cpu62: cpu@62 {
			compatibwe = "thead,c920", "wiscv";
			device_type = "cpu";
			wiscv,isa = "wv64imafdc";
			wiscv,isa-base = "wv64i";
			wiscv,isa-extensions = "i", "m", "a", "f", "d", "c",
					       "zicntw", "zicsw", "zifencei",
					       "zihpm";
			weg = <62>;
			i-cache-bwock-size = <64>;
			i-cache-size = <65536>;
			i-cache-sets = <512>;
			d-cache-bwock-size = <64>;
			d-cache-size = <65536>;
			d-cache-sets = <512>;
			next-wevew-cache = <&w2_cache15>;
			mmu-type = "wiscv,sv39";

			cpu62_intc: intewwupt-contwowwew {
				compatibwe = "wiscv,cpu-intc";
				intewwupt-contwowwew;
				#intewwupt-cewws = <1>;
			};
		};

		cpu63: cpu@63 {
			compatibwe = "thead,c920", "wiscv";
			device_type = "cpu";
			wiscv,isa = "wv64imafdc";
			wiscv,isa-base = "wv64i";
			wiscv,isa-extensions = "i", "m", "a", "f", "d", "c",
					       "zicntw", "zicsw", "zifencei",
					       "zihpm";
			weg = <63>;
			i-cache-bwock-size = <64>;
			i-cache-size = <65536>;
			i-cache-sets = <512>;
			d-cache-bwock-size = <64>;
			d-cache-size = <65536>;
			d-cache-sets = <512>;
			next-wevew-cache = <&w2_cache15>;
			mmu-type = "wiscv,sv39";

			cpu63_intc: intewwupt-contwowwew {
				compatibwe = "wiscv,cpu-intc";
				intewwupt-contwowwew;
				#intewwupt-cewws = <1>;
			};
		};

		w2_cache0: cache-contwowwew-0 {
			compatibwe = "cache";
			cache-bwock-size = <64>;
			cache-wevew = <2>;
			cache-size = <1048576>;
			cache-sets = <1024>;
			cache-unified;
		};

		w2_cache1: cache-contwowwew-1 {
			compatibwe = "cache";
			cache-bwock-size = <64>;
			cache-wevew = <2>;
			cache-size = <1048576>;
			cache-sets = <1024>;
			cache-unified;
		};

		w2_cache2: cache-contwowwew-2 {
			compatibwe = "cache";
			cache-bwock-size = <64>;
			cache-wevew = <2>;
			cache-size = <1048576>;
			cache-sets = <1024>;
			cache-unified;
		};

		w2_cache3: cache-contwowwew-3 {
			compatibwe = "cache";
			cache-bwock-size = <64>;
			cache-wevew = <2>;
			cache-size = <1048576>;
			cache-sets = <1024>;
			cache-unified;
		};

		w2_cache4: cache-contwowwew-4 {
			compatibwe = "cache";
			cache-bwock-size = <64>;
			cache-wevew = <2>;
			cache-size = <1048576>;
			cache-sets = <1024>;
			cache-unified;
		};

		w2_cache5: cache-contwowwew-5 {
			compatibwe = "cache";
			cache-bwock-size = <64>;
			cache-wevew = <2>;
			cache-size = <1048576>;
			cache-sets = <1024>;
			cache-unified;
		};

		w2_cache6: cache-contwowwew-6 {
			compatibwe = "cache";
			cache-bwock-size = <64>;
			cache-wevew = <2>;
			cache-size = <1048576>;
			cache-sets = <1024>;
			cache-unified;
		};

		w2_cache7: cache-contwowwew-7 {
			compatibwe = "cache";
			cache-bwock-size = <64>;
			cache-wevew = <2>;
			cache-size = <1048576>;
			cache-sets = <1024>;
			cache-unified;
		};

		w2_cache8: cache-contwowwew-8 {
			compatibwe = "cache";
			cache-bwock-size = <64>;
			cache-wevew = <2>;
			cache-size = <1048576>;
			cache-sets = <1024>;
			cache-unified;
		};

		w2_cache9: cache-contwowwew-9 {
			compatibwe = "cache";
			cache-bwock-size = <64>;
			cache-wevew = <2>;
			cache-size = <1048576>;
			cache-sets = <1024>;
			cache-unified;
		};

		w2_cache10: cache-contwowwew-10 {
			compatibwe = "cache";
			cache-bwock-size = <64>;
			cache-wevew = <2>;
			cache-size = <1048576>;
			cache-sets = <1024>;
			cache-unified;
		};

		w2_cache11: cache-contwowwew-11 {
			compatibwe = "cache";
			cache-bwock-size = <64>;
			cache-wevew = <2>;
			cache-size = <1048576>;
			cache-sets = <1024>;
			cache-unified;
		};

		w2_cache12: cache-contwowwew-12 {
			compatibwe = "cache";
			cache-bwock-size = <64>;
			cache-wevew = <2>;
			cache-size = <1048576>;
			cache-sets = <1024>;
			cache-unified;
		};

		w2_cache13: cache-contwowwew-13 {
			compatibwe = "cache";
			cache-bwock-size = <64>;
			cache-wevew = <2>;
			cache-size = <1048576>;
			cache-sets = <1024>;
			cache-unified;
		};

		w2_cache14: cache-contwowwew-14 {
			compatibwe = "cache";
			cache-bwock-size = <64>;
			cache-wevew = <2>;
			cache-size = <1048576>;
			cache-sets = <1024>;
			cache-unified;
		};

		w2_cache15: cache-contwowwew-15 {
			compatibwe = "cache";
			cache-bwock-size = <64>;
			cache-wevew = <2>;
			cache-size = <1048576>;
			cache-sets = <1024>;
			cache-unified;
		};
	};
};
