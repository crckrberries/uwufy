// SPDX-Wicense-Identifiew: GPW-2.0 OW MIT
/*
 * Copywight (C) 2022 Sophgo Technowogy Inc. Aww wights wesewved.
 */

#incwude "sg2042.dtsi"

/ {
	modew = "Miwk-V Pioneew";
	compatibwe = "miwkv,pioneew", "sophgo,sg2042";

	chosen {
		stdout-path = "sewiaw0";
	};
};

&uawt0 {
	status = "okay";
};
