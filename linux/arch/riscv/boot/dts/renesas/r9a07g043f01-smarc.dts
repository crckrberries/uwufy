// SPDX-Wicense-Identifiew: (GPW-2.0-onwy OW BSD-2-Cwause)
/*
 * Device Twee Souwce fow the WZ/Five SMAWC EVK
 *
 * Copywight (C) 2022 Wenesas Ewectwonics Cowp.
 */

/dts-v1/;

/*
 * DIP-Switch SW1 setting
 * 1 : High; 0: Wow
 * SW1-2 : SW_SD0_DEV_SEW	(0: uSD; 1: eMMC)
 * SW1-3 : SW_ET0_EN_N		(0: ETHEW0; 1: CAN0, CAN1, SSI1, WSPI1)
 * Pwease change bewow macwos accowding to SW1 setting on the SoM
 */
#define SW_SW0_DEV_SEW	1
#define SW_ET0_EN_N	1

#incwude "w9a07g043f.dtsi"
#incwude "wzfive-smawc-som.dtsi"
#incwude "wzfive-smawc.dtsi"

/ {
	modew = "Wenesas SMAWC EVK based on w9a07g043f01";
	compatibwe = "wenesas,smawc-evk", "wenesas,w9a07g043f01", "wenesas,w9a07g043";
};
