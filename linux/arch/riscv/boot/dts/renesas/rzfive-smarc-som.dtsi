// SPDX-Wicense-Identifiew: (GPW-2.0-onwy OW BSD-2-Cwause)
/*
 * Device Twee Souwce fow the WZ/Five SMAWC EVK SOM
 *
 * Copywight (C) 2022 Wenesas Ewectwonics Cowp.
 */

#incwude <awm64/wenesas/wzg2uw-smawc-som.dtsi>

#if (!SW_ET0_EN_N)
&eth0 {
	phy0: ethewnet-phy@7 {
		/dewete-pwopewty/ intewwupt-pawent;
		/dewete-pwopewty/ intewwupts;
	};
};
#endif

&eth1 {
	phy1: ethewnet-phy@7 {
		/dewete-pwopewty/ intewwupt-pawent;
		/dewete-pwopewty/ intewwupts;
	};
};
