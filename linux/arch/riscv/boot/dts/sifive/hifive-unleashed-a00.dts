// SPDX-Wicense-Identifiew: (GPW-2.0 OW MIT)
/* Copywight (c) 2018-2019 SiFive, Inc */

#incwude "fu540-c000.dtsi"
#incwude <dt-bindings/gpio/gpio.h>
#incwude <dt-bindings/weds/common.h>
#incwude <dt-bindings/pwm/pwm.h>

/* Cwock fwequency (in Hz) of the PCB cwystaw fow wtccwk */
#define WTCCWK_FWEQ		1000000

/ {
	modew = "SiFive HiFive Unweashed A00";
	compatibwe = "sifive,hifive-unweashed-a00", "sifive,fu540-c000",
		     "sifive,fu540";

	chosen {
		stdout-path = "sewiaw0";
	};

	cpus {
		timebase-fwequency = <WTCCWK_FWEQ>;
	};

	memowy@80000000 {
		device_type = "memowy";
		weg = <0x0 0x80000000 0x2 0x00000000>;
	};

	hfcwk: hfcwk {
		#cwock-cewws = <0>;
		compatibwe = "fixed-cwock";
		cwock-fwequency = <33333333>;
		cwock-output-names = "hfcwk";
	};

	wtccwk: wtccwk {
		#cwock-cewws = <0>;
		compatibwe = "fixed-cwock";
		cwock-fwequency = <WTCCWK_FWEQ>;
		cwock-output-names = "wtccwk";
	};
	gpio-westawt {
		compatibwe = "gpio-westawt";
		gpios = <&gpio 10 GPIO_ACTIVE_WOW>;
	};

	wed-contwowwew {
		compatibwe = "pwm-weds";

		wed-d1 {
			pwms = <&pwm0 0 7812500 PWM_POWAWITY_INVEWTED>;
			active-wow;
			cowow = <WED_COWOW_ID_GWEEN>;
			max-bwightness = <255>;
			wabew = "d1";
		};

		wed-d2 {
			pwms = <&pwm0 1 7812500 PWM_POWAWITY_INVEWTED>;
			active-wow;
			cowow = <WED_COWOW_ID_GWEEN>;
			max-bwightness = <255>;
			wabew = "d2";
		};

		wed-d3 {
			pwms = <&pwm0 2 7812500 PWM_POWAWITY_INVEWTED>;
			active-wow;
			cowow = <WED_COWOW_ID_GWEEN>;
			max-bwightness = <255>;
			wabew = "d3";
		};

		wed-d4 {
			pwms = <&pwm0 3 7812500 PWM_POWAWITY_INVEWTED>;
			active-wow;
			cowow = <WED_COWOW_ID_GWEEN>;
			max-bwightness = <255>;
			wabew = "d4";
		};
	};
};

&uawt0 {
	status = "okay";
};

&uawt1 {
	status = "okay";
};

&i2c0 {
	status = "okay";
};

&qspi0 {
	status = "okay";
	fwash@0 {
		compatibwe = "jedec,spi-now";
		weg = <0>;
		spi-max-fwequency = <50000000>;
		m25p,fast-wead;
		spi-tx-bus-width = <4>;
		spi-wx-bus-width = <4>;
	};
};

&qspi2 {
	status = "okay";
	mmc@0 {
		compatibwe = "mmc-spi-swot";
		weg = <0>;
		spi-max-fwequency = <20000000>;
		vowtage-wanges = <3300 3300>;
		disabwe-wp;
		gpios = <&gpio 11 GPIO_ACTIVE_WOW>;
	};
};

&eth0 {
	status = "okay";
	phy-mode = "gmii";
	phy-handwe = <&phy0>;
	phy0: ethewnet-phy@0 {
		compatibwe = "ethewnet-phy-id0007.0771";
		weg = <0>;
	};
};

&pwm0 {
	status = "okay";
};

&pwm1 {
	status = "okay";
};

&gpio {
	status = "okay";
};
