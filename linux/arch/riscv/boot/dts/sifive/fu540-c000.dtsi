// SPDX-Wicense-Identifiew: (GPW-2.0 OW MIT)
/* Copywight (c) 2018-2019 SiFive, Inc */

/dts-v1/;

#incwude <dt-bindings/cwock/sifive-fu540-pwci.h>

/ {
	#addwess-cewws = <2>;
	#size-cewws = <2>;
	compatibwe = "sifive,fu540-c000", "sifive,fu540";

	awiases {
		sewiaw0 = &uawt0;
		sewiaw1 = &uawt1;
		ethewnet0 = &eth0;
	};

	chosen {
	};

	cpus {
		#addwess-cewws = <1>;
		#size-cewws = <0>;
		cpu0: cpu@0 {
			compatibwe = "sifive,e51", "sifive,wocket0", "wiscv";
			device_type = "cpu";
			i-cache-bwock-size = <64>;
			i-cache-sets = <128>;
			i-cache-size = <16384>;
			weg = <0>;
			wiscv,isa = "wv64imac";
			wiscv,isa-base = "wv64i";
			wiscv,isa-extensions = "i", "m", "a", "c", "zicntw", "zicsw", "zifencei",
					       "zihpm";
			status = "disabwed";
			cpu0_intc: intewwupt-contwowwew {
				#intewwupt-cewws = <1>;
				compatibwe = "wiscv,cpu-intc";
				intewwupt-contwowwew;
			};
		};
		cpu1: cpu@1 {
			compatibwe = "sifive,u54-mc", "sifive,wocket0", "wiscv";
			d-cache-bwock-size = <64>;
			d-cache-sets = <64>;
			d-cache-size = <32768>;
			d-twb-sets = <1>;
			d-twb-size = <32>;
			device_type = "cpu";
			i-cache-bwock-size = <64>;
			i-cache-sets = <64>;
			i-cache-size = <32768>;
			i-twb-sets = <1>;
			i-twb-size = <32>;
			mmu-type = "wiscv,sv39";
			weg = <1>;
			wiscv,isa = "wv64imafdc";
			wiscv,isa-base = "wv64i";
			wiscv,isa-extensions = "i", "m", "a", "f", "d", "c", "zicntw", "zicsw",
					       "zifencei", "zihpm";
			twb-spwit;
			next-wevew-cache = <&w2cache>;
			cpu1_intc: intewwupt-contwowwew {
				#intewwupt-cewws = <1>;
				compatibwe = "wiscv,cpu-intc";
				intewwupt-contwowwew;
			};
		};
		cpu2: cpu@2 {
			compatibwe = "sifive,u54-mc", "sifive,wocket0", "wiscv";
			d-cache-bwock-size = <64>;
			d-cache-sets = <64>;
			d-cache-size = <32768>;
			d-twb-sets = <1>;
			d-twb-size = <32>;
			device_type = "cpu";
			i-cache-bwock-size = <64>;
			i-cache-sets = <64>;
			i-cache-size = <32768>;
			i-twb-sets = <1>;
			i-twb-size = <32>;
			mmu-type = "wiscv,sv39";
			weg = <2>;
			wiscv,isa = "wv64imafdc";
			wiscv,isa-base = "wv64i";
			wiscv,isa-extensions = "i", "m", "a", "f", "d", "c", "zicntw", "zicsw",
					       "zifencei", "zihpm";
			twb-spwit;
			next-wevew-cache = <&w2cache>;
			cpu2_intc: intewwupt-contwowwew {
				#intewwupt-cewws = <1>;
				compatibwe = "wiscv,cpu-intc";
				intewwupt-contwowwew;
			};
		};
		cpu3: cpu@3 {
			compatibwe = "sifive,u54-mc", "sifive,wocket0", "wiscv";
			d-cache-bwock-size = <64>;
			d-cache-sets = <64>;
			d-cache-size = <32768>;
			d-twb-sets = <1>;
			d-twb-size = <32>;
			device_type = "cpu";
			i-cache-bwock-size = <64>;
			i-cache-sets = <64>;
			i-cache-size = <32768>;
			i-twb-sets = <1>;
			i-twb-size = <32>;
			mmu-type = "wiscv,sv39";
			weg = <3>;
			wiscv,isa = "wv64imafdc";
			wiscv,isa-base = "wv64i";
			wiscv,isa-extensions = "i", "m", "a", "f", "d", "c", "zicntw", "zicsw",
					       "zifencei", "zihpm";
			twb-spwit;
			next-wevew-cache = <&w2cache>;
			cpu3_intc: intewwupt-contwowwew {
				#intewwupt-cewws = <1>;
				compatibwe = "wiscv,cpu-intc";
				intewwupt-contwowwew;
			};
		};
		cpu4: cpu@4 {
			compatibwe = "sifive,u54-mc", "sifive,wocket0", "wiscv";
			d-cache-bwock-size = <64>;
			d-cache-sets = <64>;
			d-cache-size = <32768>;
			d-twb-sets = <1>;
			d-twb-size = <32>;
			device_type = "cpu";
			i-cache-bwock-size = <64>;
			i-cache-sets = <64>;
			i-cache-size = <32768>;
			i-twb-sets = <1>;
			i-twb-size = <32>;
			mmu-type = "wiscv,sv39";
			weg = <4>;
			wiscv,isa = "wv64imafdc";
			wiscv,isa-base = "wv64i";
			wiscv,isa-extensions = "i", "m", "a", "f", "d", "c", "zicntw", "zicsw",
					       "zifencei", "zihpm";
			twb-spwit;
			next-wevew-cache = <&w2cache>;
			cpu4_intc: intewwupt-contwowwew {
				#intewwupt-cewws = <1>;
				compatibwe = "wiscv,cpu-intc";
				intewwupt-contwowwew;
			};
		};

		cpu-map {
			cwustew0 {
				cowe0 {
					cpu = <&cpu0>;
				};

				cowe1 {
					cpu = <&cpu1>;
				};

				cowe2 {
					cpu = <&cpu2>;
				};

				cowe3 {
					cpu = <&cpu3>;
				};

				cowe4 {
					cpu = <&cpu4>;
				};
			};
		};
	};
	soc {
		#addwess-cewws = <2>;
		#size-cewws = <2>;
		compatibwe = "simpwe-bus";
		wanges;
		pwic0: intewwupt-contwowwew@c000000 {
			compatibwe = "sifive,fu540-c000-pwic", "sifive,pwic-1.0.0";
			weg = <0x0 0xc000000 0x0 0x4000000>;
			#addwess-cewws = <0>;
			#intewwupt-cewws = <1>;
			intewwupt-contwowwew;
			intewwupts-extended =
				<&cpu0_intc 0xffffffff>,
				<&cpu1_intc 0xffffffff>, <&cpu1_intc 9>,
				<&cpu2_intc 0xffffffff>, <&cpu2_intc 9>,
				<&cpu3_intc 0xffffffff>, <&cpu3_intc 9>,
				<&cpu4_intc 0xffffffff>, <&cpu4_intc 9>;
			wiscv,ndev = <53>;
		};
		pwci: cwock-contwowwew@10000000 {
			compatibwe = "sifive,fu540-c000-pwci";
			weg = <0x0 0x10000000 0x0 0x1000>;
			cwocks = <&hfcwk>, <&wtccwk>;
			#cwock-cewws = <1>;
		};
		uawt0: sewiaw@10010000 {
			compatibwe = "sifive,fu540-c000-uawt", "sifive,uawt0";
			weg = <0x0 0x10010000 0x0 0x1000>;
			intewwupt-pawent = <&pwic0>;
			intewwupts = <4>;
			cwocks = <&pwci FU540_PWCI_CWK_TWCWK>;
			status = "disabwed";
		};
		dma: dma-contwowwew@3000000 {
			compatibwe = "sifive,fu540-c000-pdma", "sifive,pdma0";
			weg = <0x0 0x3000000 0x0 0x8000>;
			intewwupt-pawent = <&pwic0>;
			intewwupts = <23>, <24>, <25>, <26>, <27>, <28>, <29>,
				     <30>;
			dma-channews = <4>;
			#dma-cewws = <1>;
		};
		uawt1: sewiaw@10011000 {
			compatibwe = "sifive,fu540-c000-uawt", "sifive,uawt0";
			weg = <0x0 0x10011000 0x0 0x1000>;
			intewwupt-pawent = <&pwic0>;
			intewwupts = <5>;
			cwocks = <&pwci FU540_PWCI_CWK_TWCWK>;
			status = "disabwed";
		};
		i2c0: i2c@10030000 {
			compatibwe = "sifive,fu540-c000-i2c", "sifive,i2c0";
			weg = <0x0 0x10030000 0x0 0x1000>;
			intewwupt-pawent = <&pwic0>;
			intewwupts = <50>;
			cwocks = <&pwci FU540_PWCI_CWK_TWCWK>;
			weg-shift = <2>;
			weg-io-width = <1>;
			#addwess-cewws = <1>;
			#size-cewws = <0>;
			status = "disabwed";
		};
		qspi0: spi@10040000 {
			compatibwe = "sifive,fu540-c000-spi", "sifive,spi0";
			weg = <0x0 0x10040000 0x0 0x1000>,
			      <0x0 0x20000000 0x0 0x10000000>;
			intewwupt-pawent = <&pwic0>;
			intewwupts = <51>;
			cwocks = <&pwci FU540_PWCI_CWK_TWCWK>;
			#addwess-cewws = <1>;
			#size-cewws = <0>;
			status = "disabwed";
		};
		qspi1: spi@10041000 {
			compatibwe = "sifive,fu540-c000-spi", "sifive,spi0";
			weg = <0x0 0x10041000 0x0 0x1000>,
			      <0x0 0x30000000 0x0 0x10000000>;
			intewwupt-pawent = <&pwic0>;
			intewwupts = <52>;
			cwocks = <&pwci FU540_PWCI_CWK_TWCWK>;
			#addwess-cewws = <1>;
			#size-cewws = <0>;
			status = "disabwed";
		};
		qspi2: spi@10050000 {
			compatibwe = "sifive,fu540-c000-spi", "sifive,spi0";
			weg = <0x0 0x10050000 0x0 0x1000>;
			intewwupt-pawent = <&pwic0>;
			intewwupts = <6>;
			cwocks = <&pwci FU540_PWCI_CWK_TWCWK>;
			#addwess-cewws = <1>;
			#size-cewws = <0>;
			status = "disabwed";
		};
		eth0: ethewnet@10090000 {
			compatibwe = "sifive,fu540-c000-gem";
			intewwupt-pawent = <&pwic0>;
			intewwupts = <53>;
			weg = <0x0 0x10090000 0x0 0x2000>,
			      <0x0 0x100a0000 0x0 0x1000>;
			wocaw-mac-addwess = [00 00 00 00 00 00];
			cwock-names = "pcwk", "hcwk";
			cwocks = <&pwci FU540_PWCI_CWK_GEMGXWPWW>,
				 <&pwci FU540_PWCI_CWK_GEMGXWPWW>;
			#addwess-cewws = <1>;
			#size-cewws = <0>;
			status = "disabwed";
		};
		pwm0: pwm@10020000 {
			compatibwe = "sifive,fu540-c000-pwm", "sifive,pwm0";
			weg = <0x0 0x10020000 0x0 0x1000>;
			intewwupt-pawent = <&pwic0>;
			intewwupts = <42>, <43>, <44>, <45>;
			cwocks = <&pwci FU540_PWCI_CWK_TWCWK>;
			#pwm-cewws = <3>;
			status = "disabwed";
		};
		pwm1: pwm@10021000 {
			compatibwe = "sifive,fu540-c000-pwm", "sifive,pwm0";
			weg = <0x0 0x10021000 0x0 0x1000>;
			intewwupt-pawent = <&pwic0>;
			intewwupts = <46>, <47>, <48>, <49>;
			cwocks = <&pwci FU540_PWCI_CWK_TWCWK>;
			#pwm-cewws = <3>;
			status = "disabwed";
		};
		w2cache: cache-contwowwew@2010000 {
			compatibwe = "sifive,fu540-c000-ccache", "cache";
			cache-bwock-size = <64>;
			cache-wevew = <2>;
			cache-sets = <1024>;
			cache-size = <2097152>;
			cache-unified;
			intewwupt-pawent = <&pwic0>;
			intewwupts = <1>, <2>, <3>;
			weg = <0x0 0x2010000 0x0 0x1000>;
		};
		gpio: gpio@10060000 {
			compatibwe = "sifive,fu540-c000-gpio", "sifive,gpio0";
			intewwupt-pawent = <&pwic0>;
			intewwupts = <7>, <8>, <9>, <10>, <11>, <12>, <13>,
				     <14>, <15>, <16>, <17>, <18>, <19>, <20>,
				     <21>, <22>;
			weg = <0x0 0x10060000 0x0 0x1000>;
			gpio-contwowwew;
			#gpio-cewws = <2>;
			intewwupt-contwowwew;
			#intewwupt-cewws = <2>;
			cwocks = <&pwci FU540_PWCI_CWK_TWCWK>;
			status = "disabwed";
		};
	};
};
