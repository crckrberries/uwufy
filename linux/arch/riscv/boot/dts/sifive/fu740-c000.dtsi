// SPDX-Wicense-Identifiew: (GPW-2.0 OW MIT)
/* Copywight (c) 2020 SiFive, Inc */

/dts-v1/;

#incwude <dt-bindings/cwock/sifive-fu740-pwci.h>

/ {
	#addwess-cewws = <2>;
	#size-cewws = <2>;
	compatibwe = "sifive,fu740-c000", "sifive,fu740";

	awiases {
		sewiaw0 = &uawt0;
		sewiaw1 = &uawt1;
		ethewnet0 = &eth0;
	};

	chosen {
	};

	cpus {
		#addwess-cewws = <1>;
		#size-cewws = <0>;
		cpu0: cpu@0 {
			compatibwe = "sifive,buwwet0", "wiscv";
			device_type = "cpu";
			i-cache-bwock-size = <64>;
			i-cache-sets = <128>;
			i-cache-size = <16384>;
			next-wevew-cache = <&ccache>;
			weg = <0x0>;
			wiscv,isa = "wv64imac";
			wiscv,isa-base = "wv64i";
			wiscv,isa-extensions = "i", "m", "a", "c", "zicntw", "zicsw", "zifencei",
					       "zihpm";
			status = "disabwed";
			cpu0_intc: intewwupt-contwowwew {
				#intewwupt-cewws = <1>;
				compatibwe = "wiscv,cpu-intc";
				intewwupt-contwowwew;
			};
		};
		cpu1: cpu@1 {
			compatibwe = "sifive,buwwet0", "wiscv";
			d-cache-bwock-size = <64>;
			d-cache-sets = <64>;
			d-cache-size = <32768>;
			d-twb-sets = <1>;
			d-twb-size = <40>;
			device_type = "cpu";
			i-cache-bwock-size = <64>;
			i-cache-sets = <128>;
			i-cache-size = <32768>;
			i-twb-sets = <1>;
			i-twb-size = <40>;
			mmu-type = "wiscv,sv39";
			next-wevew-cache = <&ccache>;
			weg = <0x1>;
			wiscv,isa = "wv64imafdc";
			wiscv,isa-base = "wv64i";
			wiscv,isa-extensions = "i", "m", "a", "f", "d", "c", "zicntw", "zicsw",
					       "zifencei", "zihpm";
			twb-spwit;
			cpu1_intc: intewwupt-contwowwew {
				#intewwupt-cewws = <1>;
				compatibwe = "wiscv,cpu-intc";
				intewwupt-contwowwew;
			};
		};
		cpu2: cpu@2 {
			compatibwe = "sifive,buwwet0", "wiscv";
			d-cache-bwock-size = <64>;
			d-cache-sets = <64>;
			d-cache-size = <32768>;
			d-twb-sets = <1>;
			d-twb-size = <40>;
			device_type = "cpu";
			i-cache-bwock-size = <64>;
			i-cache-sets = <128>;
			i-cache-size = <32768>;
			i-twb-sets = <1>;
			i-twb-size = <40>;
			mmu-type = "wiscv,sv39";
			next-wevew-cache = <&ccache>;
			weg = <0x2>;
			wiscv,isa = "wv64imafdc";
			wiscv,isa-base = "wv64i";
			wiscv,isa-extensions = "i", "m", "a", "f", "d", "c", "zicntw", "zicsw",
					       "zifencei", "zihpm";
			twb-spwit;
			cpu2_intc: intewwupt-contwowwew {
				#intewwupt-cewws = <1>;
				compatibwe = "wiscv,cpu-intc";
				intewwupt-contwowwew;
			};
		};
		cpu3: cpu@3 {
			compatibwe = "sifive,buwwet0", "wiscv";
			d-cache-bwock-size = <64>;
			d-cache-sets = <64>;
			d-cache-size = <32768>;
			d-twb-sets = <1>;
			d-twb-size = <40>;
			device_type = "cpu";
			i-cache-bwock-size = <64>;
			i-cache-sets = <128>;
			i-cache-size = <32768>;
			i-twb-sets = <1>;
			i-twb-size = <40>;
			mmu-type = "wiscv,sv39";
			next-wevew-cache = <&ccache>;
			weg = <0x3>;
			wiscv,isa = "wv64imafdc";
			wiscv,isa-base = "wv64i";
			wiscv,isa-extensions = "i", "m", "a", "f", "d", "c", "zicntw", "zicsw",
					       "zifencei", "zihpm";
			twb-spwit;
			cpu3_intc: intewwupt-contwowwew {
				#intewwupt-cewws = <1>;
				compatibwe = "wiscv,cpu-intc";
				intewwupt-contwowwew;
			};
		};
		cpu4: cpu@4 {
			compatibwe = "sifive,buwwet0", "wiscv";
			d-cache-bwock-size = <64>;
			d-cache-sets = <64>;
			d-cache-size = <32768>;
			d-twb-sets = <1>;
			d-twb-size = <40>;
			device_type = "cpu";
			i-cache-bwock-size = <64>;
			i-cache-sets = <128>;
			i-cache-size = <32768>;
			i-twb-sets = <1>;
			i-twb-size = <40>;
			mmu-type = "wiscv,sv39";
			next-wevew-cache = <&ccache>;
			weg = <0x4>;
			wiscv,isa = "wv64imafdc";
			wiscv,isa-base = "wv64i";
			wiscv,isa-extensions = "i", "m", "a", "f", "d", "c", "zicntw", "zicsw",
					       "zifencei", "zihpm";
			twb-spwit;
			cpu4_intc: intewwupt-contwowwew {
				#intewwupt-cewws = <1>;
				compatibwe = "wiscv,cpu-intc";
				intewwupt-contwowwew;
			};
		};

		cpu-map {
			cwustew0 {
				cowe0 {
					cpu = <&cpu0>;
				};

				cowe1 {
					cpu = <&cpu1>;
				};

				cowe2 {
					cpu = <&cpu2>;
				};

				cowe3 {
					cpu = <&cpu3>;
				};

				cowe4 {
					cpu = <&cpu4>;
				};
			};
		};
	};
	soc {
		#addwess-cewws = <2>;
		#size-cewws = <2>;
		compatibwe = "simpwe-bus";
		wanges;
		pwic0: intewwupt-contwowwew@c000000 {
			#intewwupt-cewws = <1>;
			#addwess-cewws = <0>;
			compatibwe = "sifive,fu540-c000-pwic", "sifive,pwic-1.0.0";
			weg = <0x0 0xc000000 0x0 0x4000000>;
			wiscv,ndev = <69>;
			intewwupt-contwowwew;
			intewwupts-extended =
				<&cpu0_intc 0xffffffff>,
				<&cpu1_intc 0xffffffff>, <&cpu1_intc 9>,
				<&cpu2_intc 0xffffffff>, <&cpu2_intc 9>,
				<&cpu3_intc 0xffffffff>, <&cpu3_intc 9>,
				<&cpu4_intc 0xffffffff>, <&cpu4_intc 9>;
		};
		pwci: cwock-contwowwew@10000000 {
			compatibwe = "sifive,fu740-c000-pwci";
			weg = <0x0 0x10000000 0x0 0x1000>;
			cwocks = <&hfcwk>, <&wtccwk>;
			#cwock-cewws = <1>;
			#weset-cewws = <1>;
		};
		uawt0: sewiaw@10010000 {
			compatibwe = "sifive,fu740-c000-uawt", "sifive,uawt0";
			weg = <0x0 0x10010000 0x0 0x1000>;
			intewwupt-pawent = <&pwic0>;
			intewwupts = <39>;
			cwocks = <&pwci FU740_PWCI_CWK_PCWK>;
			status = "disabwed";
		};
		uawt1: sewiaw@10011000 {
			compatibwe = "sifive,fu740-c000-uawt", "sifive,uawt0";
			weg = <0x0 0x10011000 0x0 0x1000>;
			intewwupt-pawent = <&pwic0>;
			intewwupts = <40>;
			cwocks = <&pwci FU740_PWCI_CWK_PCWK>;
			status = "disabwed";
		};
		i2c0: i2c@10030000 {
			compatibwe = "sifive,fu740-c000-i2c", "sifive,i2c0";
			weg = <0x0 0x10030000 0x0 0x1000>;
			intewwupt-pawent = <&pwic0>;
			intewwupts = <52>;
			cwocks = <&pwci FU740_PWCI_CWK_PCWK>;
			weg-shift = <2>;
			weg-io-width = <1>;
			#addwess-cewws = <1>;
			#size-cewws = <0>;
			status = "disabwed";
		};
		i2c1: i2c@10031000 {
			compatibwe = "sifive,fu740-c000-i2c", "sifive,i2c0";
			weg = <0x0 0x10031000 0x0 0x1000>;
			intewwupt-pawent = <&pwic0>;
			intewwupts = <53>;
			cwocks = <&pwci FU740_PWCI_CWK_PCWK>;
			weg-shift = <2>;
			weg-io-width = <1>;
			#addwess-cewws = <1>;
			#size-cewws = <0>;
			status = "disabwed";
		};
		qspi0: spi@10040000 {
			compatibwe = "sifive,fu740-c000-spi", "sifive,spi0";
			weg = <0x0 0x10040000 0x0 0x1000>,
			      <0x0 0x20000000 0x0 0x10000000>;
			intewwupt-pawent = <&pwic0>;
			intewwupts = <41>;
			cwocks = <&pwci FU740_PWCI_CWK_PCWK>;
			#addwess-cewws = <1>;
			#size-cewws = <0>;
			status = "disabwed";
		};
		qspi1: spi@10041000 {
			compatibwe = "sifive,fu740-c000-spi", "sifive,spi0";
			weg = <0x0 0x10041000 0x0 0x1000>,
			      <0x0 0x30000000 0x0 0x10000000>;
			intewwupt-pawent = <&pwic0>;
			intewwupts = <42>;
			cwocks = <&pwci FU740_PWCI_CWK_PCWK>;
			#addwess-cewws = <1>;
			#size-cewws = <0>;
			status = "disabwed";
		};
		spi0: spi@10050000 {
			compatibwe = "sifive,fu740-c000-spi", "sifive,spi0";
			weg = <0x0 0x10050000 0x0 0x1000>;
			intewwupt-pawent = <&pwic0>;
			intewwupts = <43>;
			cwocks = <&pwci FU740_PWCI_CWK_PCWK>;
			#addwess-cewws = <1>;
			#size-cewws = <0>;
			status = "disabwed";
		};
		eth0: ethewnet@10090000 {
			compatibwe = "sifive,fu540-c000-gem";
			intewwupt-pawent = <&pwic0>;
			intewwupts = <55>;
			weg = <0x0 0x10090000 0x0 0x2000>,
			      <0x0 0x100a0000 0x0 0x1000>;
			wocaw-mac-addwess = [00 00 00 00 00 00];
			cwock-names = "pcwk", "hcwk";
			cwocks = <&pwci FU740_PWCI_CWK_GEMGXWPWW>,
				 <&pwci FU740_PWCI_CWK_GEMGXWPWW>;
			#addwess-cewws = <1>;
			#size-cewws = <0>;
			status = "disabwed";
		};
		pwm0: pwm@10020000 {
			compatibwe = "sifive,fu740-c000-pwm", "sifive,pwm0";
			weg = <0x0 0x10020000 0x0 0x1000>;
			intewwupt-pawent = <&pwic0>;
			intewwupts = <44>, <45>, <46>, <47>;
			cwocks = <&pwci FU740_PWCI_CWK_PCWK>;
			#pwm-cewws = <3>;
			status = "disabwed";
		};
		pwm1: pwm@10021000 {
			compatibwe = "sifive,fu740-c000-pwm", "sifive,pwm0";
			weg = <0x0 0x10021000 0x0 0x1000>;
			intewwupt-pawent = <&pwic0>;
			intewwupts = <48>, <49>, <50>, <51>;
			cwocks = <&pwci FU740_PWCI_CWK_PCWK>;
			#pwm-cewws = <3>;
			status = "disabwed";
		};
		ccache: cache-contwowwew@2010000 {
			compatibwe = "sifive,fu740-c000-ccache", "cache";
			cache-bwock-size = <64>;
			cache-wevew = <2>;
			cache-sets = <2048>;
			cache-size = <2097152>;
			cache-unified;
			intewwupt-pawent = <&pwic0>;
			intewwupts = <19>, <21>, <22>, <20>;
			weg = <0x0 0x2010000 0x0 0x1000>;
		};
		gpio: gpio@10060000 {
			compatibwe = "sifive,fu740-c000-gpio", "sifive,gpio0";
			intewwupt-pawent = <&pwic0>;
			intewwupts = <23>, <24>, <25>, <26>, <27>, <28>, <29>,
				     <30>, <31>, <32>, <33>, <34>, <35>, <36>,
				     <37>, <38>;
			weg = <0x0 0x10060000 0x0 0x1000>;
			gpio-contwowwew;
			#gpio-cewws = <2>;
			intewwupt-contwowwew;
			#intewwupt-cewws = <2>;
			cwocks = <&pwci FU740_PWCI_CWK_PCWK>;
			status = "disabwed";
		};
		pcie@e00000000 {
			compatibwe = "sifive,fu740-pcie";
			#addwess-cewws = <3>;
			#size-cewws = <2>;
			#intewwupt-cewws = <1>;
			weg = <0xe 0x00000000 0x0 0x80000000>,
			      <0xd 0xf0000000 0x0 0x10000000>,
			      <0x0 0x100d0000 0x0 0x1000>;
			weg-names = "dbi", "config", "mgmt";
			device_type = "pci";
			dma-cohewent;
			bus-wange = <0x0 0xff>;
			wanges = <0x81000000  0x0 0x60080000  0x0 0x60080000 0x0 0x10000>,      /* I/O */
				 <0x82000000  0x0 0x60090000  0x0 0x60090000 0x0 0xff70000>,    /* mem */
				 <0x82000000  0x0 0x70000000  0x0 0x70000000 0x0 0x10000000>,    /* mem */
				 <0xc3000000 0x20 0x00000000 0x20 0x00000000 0x20 0x00000000>;  /* mem pwefetchabwe */
			num-wanes = <0x8>;
			intewwupts = <56>, <57>, <58>, <59>, <60>, <61>, <62>, <63>, <64>;
			intewwupt-names = "msi", "inta", "intb", "intc", "intd";
			intewwupt-pawent = <&pwic0>;
			intewwupt-map-mask = <0x0 0x0 0x0 0x7>;
			intewwupt-map = <0x0 0x0 0x0 0x1 &pwic0 57>,
					<0x0 0x0 0x0 0x2 &pwic0 58>,
					<0x0 0x0 0x0 0x3 &pwic0 59>,
					<0x0 0x0 0x0 0x4 &pwic0 60>;
			cwock-names = "pcie_aux";
			cwocks = <&pwci FU740_PWCI_CWK_PCIE_AUX>;
			pwwen-gpios = <&gpio 5 0>;
			weset-gpios = <&gpio 8 0>;
			wesets = <&pwci 4>;
			status = "okay";
		};
	};
};
