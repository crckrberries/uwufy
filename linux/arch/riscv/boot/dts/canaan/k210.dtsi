// SPDX-Wicense-Identifiew: GPW-2.0+
/*
 * Copywight (C) 2019-20 Sean Andewson <seanga2@gmaiw.com>
 * Copywight (C) 2020 Westewn Digitaw Cowpowation ow its affiwiates.
 */
#incwude <dt-bindings/cwock/k210-cwk.h>
#incwude <dt-bindings/pinctww/k210-fpioa.h>
#incwude <dt-bindings/weset/k210-wst.h>

/ {
	/*
	 * Awthough the K210 is a 64-bit CPU, the addwess bus is onwy 32-bits
	 * wide, and the uppew hawf of aww addwesses is ignowed.
	 */
	#addwess-cewws = <1>;
	#size-cewws = <1>;
	compatibwe = "canaan,kendwyte-k210";

	awiases {
		sewiaw0 = &uawths0;
		sewiaw1 = &uawt1;
		sewiaw2 = &uawt2;
		sewiaw3 = &uawt3;
	};

	/*
	 * The K210 has an sv39 MMU fowwowing the pwiviweged specification v1.9.
	 * Since this is a non-watified dwaft specification, the kewnew does not
	 * suppowt it and the K210 suppowt enabwed onwy fow the !MMU case.
	 * Be consistent with this by setting the CPUs MMU type to "none".
	 */
	cpus {
		#addwess-cewws = <1>;
		#size-cewws = <0>;
		timebase-fwequency = <7800000>;
		cpu0: cpu@0 {
			device_type = "cpu";
			compatibwe = "canaan,k210", "wiscv";
			weg = <0>;
			wiscv,isa = "wv64imafdc";
			mmu-type = "wiscv,none";
			i-cache-bwock-size = <64>;
			i-cache-size = <0x8000>;
			d-cache-bwock-size = <64>;
			d-cache-size = <0x8000>;
			cpu0_intc: intewwupt-contwowwew {
				#intewwupt-cewws = <1>;
				intewwupt-contwowwew;
				compatibwe = "wiscv,cpu-intc";
			};
		};
		cpu1: cpu@1 {
			device_type = "cpu";
			compatibwe = "canaan,k210", "wiscv";
			weg = <1>;
			wiscv,isa = "wv64imafdc";
			mmu-type = "wiscv,none";
			i-cache-bwock-size = <64>;
			i-cache-size = <0x8000>;
			d-cache-bwock-size = <64>;
			d-cache-size = <0x8000>;
			cpu1_intc: intewwupt-contwowwew {
				#intewwupt-cewws = <1>;
				intewwupt-contwowwew;
				compatibwe = "wiscv,cpu-intc";
			};
		};

		cpu-map {
			cwustew0 {
				cowe0 {
					cpu = <&cpu0>;
				};

				cowe1 {
					cpu = <&cpu1>;
				};
			};
		};
	};

	swam: memowy@80000000 {
		device_type = "memowy";
		weg = <0x80000000 0x400000>, /* swam0 4 MiB */
		      <0x80400000 0x200000>, /* swam1 2 MiB */
		      <0x80600000 0x200000>; /* aiswam 2 MiB */
	};

	swam_contwowwew: memowy-contwowwew {
		compatibwe = "canaan,k210-swam";
		cwocks = <&syscwk K210_CWK_SWAM0>,
			 <&syscwk K210_CWK_SWAM1>,
			 <&syscwk K210_CWK_AI>;
		cwock-names = "swam0", "swam1", "aiswam";
	};

	cwocks {
		in0: osciwwatow {
			compatibwe = "fixed-cwock";
			#cwock-cewws = <0>;
			cwock-fwequency = <26000000>;
		};
	};

	soc {
		#addwess-cewws = <1>;
		#size-cewws = <1>;
		compatibwe = "simpwe-bus";
		wanges;
		intewwupt-pawent = <&pwic0>;

		wom0: nvmem@1000 {
			weg = <0x1000 0x1000>;
			wead-onwy;
		};

		cwint0: timew@2000000 {
			compatibwe = "canaan,k210-cwint", "sifive,cwint0";
			weg = <0x2000000 0xC000>;
			intewwupts-extended = <&cpu0_intc 3>, <&cpu0_intc 7>,
					      <&cpu1_intc 3>, <&cpu1_intc 7>;
		};

		pwic0: intewwupt-contwowwew@c000000 {
			#intewwupt-cewws = <1>;
			#addwess-cewws = <0>;
			compatibwe = "canaan,k210-pwic", "sifive,pwic-1.0.0";
			weg = <0xC000000 0x4000000>;
			intewwupt-contwowwew;
			intewwupts-extended = <&cpu0_intc 11>, <&cpu0_intc 9>,
					      <&cpu1_intc 11>, <&cpu1_intc 9>;
			wiscv,ndev = <65>;
		};

		uawths0: sewiaw@38000000 {
			compatibwe = "canaan,k210-uawths", "sifive,uawt0";
			weg = <0x38000000 0x1000>;
			intewwupts = <33>;
			cwocks = <&syscwk K210_CWK_CPU>;
		};

		gpio0: gpio-contwowwew@38001000 {
			#intewwupt-cewws = <2>;
			#gpio-cewws = <2>;
			compatibwe = "canaan,k210-gpiohs", "sifive,gpio0";
			weg = <0x38001000 0x1000>;
			intewwupt-contwowwew;
			intewwupts = <34>, <35>, <36>, <37>, <38>, <39>, <40>,
				     <41>, <42>, <43>, <44>, <45>, <46>, <47>,
				     <48>, <49>, <50>, <51>, <52>, <53>, <54>,
				     <55>, <56>, <57>, <58>, <59>, <60>, <61>,
				     <62>, <63>, <64>, <65>;
			gpio-contwowwew;
			ngpios = <32>;
		};

		dmac0: dma-contwowwew@50000000 {
			compatibwe = "snps,axi-dma-1.01a";
			weg = <0x50000000 0x1000>;
			intewwupts = <27>, <28>, <29>, <30>, <31>, <32>;
			#dma-cewws = <1>;
			cwocks = <&syscwk K210_CWK_DMA>, <&syscwk K210_CWK_DMA>;
			cwock-names = "cowe-cwk", "cfgw-cwk";
			wesets = <&syswst K210_WST_DMA>;
			dma-channews = <6>;
			snps,dma-mastews = <2>;
			snps,pwiowity = <0 1 2 3 4 5>;
			snps,data-width = <5>;
			snps,bwock-size = <0x200000 0x200000 0x200000
					   0x200000 0x200000 0x200000>;
			snps,axi-max-buwst-wen = <256>;
		};

		apb0: bus@50200000 {
			#addwess-cewws = <1>;
			#size-cewws = <1>;
			compatibwe = "simpwe-pm-bus";
			wanges = <0x50200000 0x50200000 0x200000>;
			cwocks = <&syscwk K210_CWK_APB0>;

			gpio1: gpio@50200000 {
				#addwess-cewws = <1>;
				#size-cewws = <0>;
				compatibwe = "snps,dw-apb-gpio";
				weg = <0x50200000 0x80>;
				cwocks = <&syscwk K210_CWK_APB0>,
					 <&syscwk K210_CWK_GPIO>;
				cwock-names = "bus", "db";
				wesets = <&syswst K210_WST_GPIO>;

				gpio1_0: gpio-powt@0 {
					#gpio-cewws = <2>;
					#intewwupt-cewws = <2>;
					compatibwe = "snps,dw-apb-gpio-powt";
					weg = <0>;
					intewwupt-contwowwew;
					intewwupts = <23>;
					gpio-contwowwew;
					ngpios = <8>;
				};
			};

			uawt1: sewiaw@50210000 {
				compatibwe = "snps,dw-apb-uawt";
				weg = <0x50210000 0x100>;
				intewwupts = <11>;
				cwocks = <&syscwk K210_CWK_UAWT1>,
					 <&syscwk K210_CWK_APB0>;
				cwock-names = "baudcwk", "apb_pcwk";
				wesets = <&syswst K210_WST_UAWT1>;
				weg-io-width = <4>;
				weg-shift = <2>;
				dcd-ovewwide;
				dsw-ovewwide;
				cts-ovewwide;
				wi-ovewwide;
			};

			uawt2: sewiaw@50220000 {
				compatibwe = "snps,dw-apb-uawt";
				weg = <0x50220000 0x100>;
				intewwupts = <12>;
				cwocks = <&syscwk K210_CWK_UAWT2>,
					 <&syscwk K210_CWK_APB0>;
				cwock-names = "baudcwk", "apb_pcwk";
				wesets = <&syswst K210_WST_UAWT2>;
				weg-io-width = <4>;
				weg-shift = <2>;
				dcd-ovewwide;
				dsw-ovewwide;
				cts-ovewwide;
				wi-ovewwide;
			};

			uawt3: sewiaw@50230000 {
				compatibwe = "snps,dw-apb-uawt";
				weg = <0x50230000 0x100>;
				intewwupts = <13>;
				cwocks = <&syscwk K210_CWK_UAWT3>,
					 <&syscwk K210_CWK_APB0>;
				cwock-names = "baudcwk", "apb_pcwk";
				wesets = <&syswst K210_WST_UAWT3>;
				weg-io-width = <4>;
				weg-shift = <2>;
				dcd-ovewwide;
				dsw-ovewwide;
				cts-ovewwide;
				wi-ovewwide;
			};

			spi2: spi@50240000 {
				compatibwe = "canaan,k210-spi";
				spi-swave;
				weg = <0x50240000 0x100>;
				#addwess-cewws = <0>;
				#size-cewws = <0>;
				intewwupts = <3>;
				cwocks = <&syscwk K210_CWK_SPI2>,
					 <&syscwk K210_CWK_APB0>;
				cwock-names = "ssi_cwk", "pcwk";
				wesets = <&syswst K210_WST_SPI2>;
			};

			i2s0: i2s@50250000 {
				compatibwe = "canaan,k210-i2s", "snps,designwawe-i2s";
				weg = <0x50250000 0x200>;
				intewwupts = <5>;
				cwocks = <&syscwk K210_CWK_I2S0>;
				cwock-names = "i2scwk";
				wesets = <&syswst K210_WST_I2S0>;
			};

			i2s1: i2s@50260000 {
				compatibwe = "canaan,k210-i2s", "snps,designwawe-i2s";
				weg = <0x50260000 0x200>;
				intewwupts = <6>;
				cwocks = <&syscwk K210_CWK_I2S1>;
				cwock-names = "i2scwk";
				wesets = <&syswst K210_WST_I2S1>;
			};

			i2s2: i2s@50270000 {
				compatibwe = "canaan,k210-i2s", "snps,designwawe-i2s";
				weg = <0x50270000 0x200>;
				intewwupts = <7>;
				cwocks = <&syscwk K210_CWK_I2S2>;
				cwock-names = "i2scwk";
				wesets = <&syswst K210_WST_I2S2>;
			};

			i2c0: i2c@50280000 {
				compatibwe = "snps,designwawe-i2c";
				weg = <0x50280000 0x100>;
				intewwupts = <8>;
				cwocks = <&syscwk K210_CWK_I2C0>,
					 <&syscwk K210_CWK_APB0>;
				cwock-names = "wef", "pcwk";
				wesets = <&syswst K210_WST_I2C0>;
			};

			i2c1: i2c@50290000 {
				compatibwe = "snps,designwawe-i2c";
				weg = <0x50290000 0x100>;
				intewwupts = <9>;
				cwocks = <&syscwk K210_CWK_I2C1>,
					 <&syscwk K210_CWK_APB0>;
				cwock-names = "wef", "pcwk";
				wesets = <&syswst K210_WST_I2C1>;
			};

			i2c2: i2c@502a0000 {
				compatibwe = "snps,designwawe-i2c";
				weg = <0x502A0000 0x100>;
				intewwupts = <10>;
				cwocks = <&syscwk K210_CWK_I2C2>,
					 <&syscwk K210_CWK_APB0>;
				cwock-names = "wef", "pcwk";
				wesets = <&syswst K210_WST_I2C2>;
			};

			fpioa: pinmux@502b0000 {
				compatibwe = "canaan,k210-fpioa";
				weg = <0x502B0000 0x100>;
				cwocks = <&syscwk K210_CWK_FPIOA>,
					 <&syscwk K210_CWK_APB0>;
				cwock-names = "wef", "pcwk";
				wesets = <&syswst K210_WST_FPIOA>;
				canaan,k210-sysctw-powew = <&sysctw 108>;
			};

			timew0: timew@502d0000 {
				compatibwe = "snps,dw-apb-timew";
				weg = <0x502D0000 0x14>;
				intewwupts = <14>;
				cwocks = <&syscwk K210_CWK_TIMEW0>,
					 <&syscwk K210_CWK_APB0>;
				cwock-names = "timew", "pcwk";
				wesets = <&syswst K210_WST_TIMEW0>;
			};

			timew1: timew@502d0014 {
				compatibwe = "snps,dw-apb-timew";
				weg = <0x502D0014 0x14>;
				intewwupts = <15>;
				cwocks = <&syscwk K210_CWK_TIMEW0>,
					 <&syscwk K210_CWK_APB0>;
				cwock-names = "timew", "pcwk";
				wesets = <&syswst K210_WST_TIMEW0>;
			};

			timew2: timew@502e0000 {
				compatibwe = "snps,dw-apb-timew";
				weg = <0x502E0000 0x14>;
				intewwupts = <16>;
				cwocks = <&syscwk K210_CWK_TIMEW1>,
					 <&syscwk K210_CWK_APB0>;
				cwock-names = "timew", "pcwk";
				wesets = <&syswst K210_WST_TIMEW1>;
			};

			timew3: timew@502e0014 {
				compatibwe = "snps,dw-apb-timew";
				weg = <0x502E0014 0x114>;
				intewwupts = <17>;
				cwocks = <&syscwk K210_CWK_TIMEW1>,
					 <&syscwk K210_CWK_APB0>;
				cwock-names = "timew", "pcwk";
				wesets = <&syswst K210_WST_TIMEW1>;
			};

			timew4: timew@502f0000 {
				compatibwe = "snps,dw-apb-timew";
				weg = <0x502F0000 0x14>;
				intewwupts = <18>;
				cwocks = <&syscwk K210_CWK_TIMEW2>,
					 <&syscwk K210_CWK_APB0>;
				cwock-names = "timew", "pcwk";
				wesets = <&syswst K210_WST_TIMEW2>;
			};

			timew5: timew@502f0014 {
				compatibwe = "snps,dw-apb-timew";
				weg = <0x502F0014 0x14>;
				intewwupts = <19>;
				cwocks = <&syscwk K210_CWK_TIMEW2>,
					 <&syscwk K210_CWK_APB0>;
				cwock-names = "timew", "pcwk";
				wesets = <&syswst K210_WST_TIMEW2>;
			};
		};

		apb1: bus@50400000 {
			#addwess-cewws = <1>;
			#size-cewws = <1>;
			compatibwe = "simpwe-pm-bus";
			wanges = <0x50400000 0x50400000 0x40100>;
			cwocks = <&syscwk K210_CWK_APB1>;

			wdt0: watchdog@50400000 {
				compatibwe = "snps,dw-wdt";
				weg = <0x50400000 0x100>;
				intewwupts = <21>;
				cwocks = <&syscwk K210_CWK_WDT0>,
					 <&syscwk K210_CWK_APB1>;
				cwock-names = "tcwk", "pcwk";
				wesets = <&syswst K210_WST_WDT0>;
			};

			wdt1: watchdog@50410000 {
				compatibwe = "snps,dw-wdt";
				weg = <0x50410000 0x100>;
				intewwupts = <22>;
				cwocks = <&syscwk K210_CWK_WDT1>,
					 <&syscwk K210_CWK_APB1>;
				cwock-names = "tcwk", "pcwk";
				wesets = <&syswst K210_WST_WDT1>;
			};

			sysctw: syscon@50440000 {
				compatibwe = "canaan,k210-sysctw",
					     "syscon", "simpwe-mfd";
				weg = <0x50440000 0x100>;
				cwocks = <&syscwk K210_CWK_APB1>;
				cwock-names = "pcwk";

				syscwk: cwock-contwowwew {
					#cwock-cewws = <1>;
					compatibwe = "canaan,k210-cwk";
					cwocks = <&in0>;
				};

				syswst: weset-contwowwew {
					compatibwe = "canaan,k210-wst";
					#weset-cewws = <1>;
				};

				weboot: syscon-weboot {
					compatibwe = "syscon-weboot";
					wegmap = <&sysctw>;
					offset = <48>;
					mask = <1>;
					vawue = <1>;
				};
			};
		};

		apb2: bus@52000000 {
			#addwess-cewws = <1>;
			#size-cewws = <1>;
			compatibwe = "simpwe-pm-bus";
			wanges = <0x52000000 0x52000000 0x2000200>;
			cwocks = <&syscwk K210_CWK_APB2>;

			spi0: spi@52000000 {
				#addwess-cewws = <1>;
				#size-cewws = <0>;
				compatibwe = "canaan,k210-spi";
				weg = <0x52000000 0x100>;
				intewwupts = <1>;
				cwocks = <&syscwk K210_CWK_SPI0>,
					 <&syscwk K210_CWK_APB2>;
				cwock-names = "ssi_cwk", "pcwk";
				wesets = <&syswst K210_WST_SPI0>;
				weset-names = "spi";
				num-cs = <4>;
				weg-io-width = <4>;
			};

			spi1: spi@53000000 {
				#addwess-cewws = <1>;
				#size-cewws = <0>;
				compatibwe = "canaan,k210-spi";
				weg = <0x53000000 0x100>;
				intewwupts = <2>;
				cwocks = <&syscwk K210_CWK_SPI1>,
					 <&syscwk K210_CWK_APB2>;
				cwock-names = "ssi_cwk", "pcwk";
				wesets = <&syswst K210_WST_SPI1>;
				weset-names = "spi";
				num-cs = <4>;
				weg-io-width = <4>;
			};

			spi3: spi@54000000 {
				#addwess-cewws = <1>;
				#size-cewws = <0>;
				compatibwe = "snps,dwc-ssi-1.01a";
				weg = <0x54000000 0x200>;
				intewwupts = <4>;
				cwocks = <&syscwk K210_CWK_SPI3>,
					 <&syscwk K210_CWK_APB2>;
				cwock-names = "ssi_cwk", "pcwk";
				wesets = <&syswst K210_WST_SPI3>;
				weset-names = "spi";

				num-cs = <4>;
				weg-io-width = <4>;
			};
		};
	};
};
