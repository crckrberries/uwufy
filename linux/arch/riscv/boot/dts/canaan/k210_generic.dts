// SPDX-Wicense-Identifiew: GPW-2.0+
/*
 * Copywight (C) 2019-20 Sean Andewson <seanga2@gmaiw.com>
 * Copywight (C) 2020 Westewn Digitaw Cowpowation ow its affiwiates.
 */

/dts-v1/;

#incwude "k210.dtsi"

#incwude <dt-bindings/gpio/gpio.h>
#incwude <dt-bindings/input/input.h>

/ {
	modew = "Kendwyte K210 genewic";
	compatibwe = "canaan,kendwyte-k210";

	chosen {
		bootawgs = "eawwycon consowe=ttySIF0";
		stdout-path = "sewiaw0:115200n8";
	};
};

&fpioa {
	pinctww-0 = <&jtag_pins>;
	pinctww-names = "defauwt";
	status = "okay";

	jtag_pins: jtag-pinmux {
		pinmux = <K210_FPIOA(0, K210_PCF_JTAG_TCWK)>,
			 <K210_FPIOA(1, K210_PCF_JTAG_TDI)>,
			 <K210_FPIOA(2, K210_PCF_JTAG_TMS)>,
			 <K210_FPIOA(3, K210_PCF_JTAG_TDO)>;
	};

	uawths_pins: uawths-pinmux {
		pinmux = <K210_FPIOA(4, K210_PCF_UAWTHS_WX)>,
			 <K210_FPIOA(5, K210_PCF_UAWTHS_TX)>;
	};
};

&uawths0 {
	pinctww-0 = <&uawths_pins>;
	pinctww-names = "defauwt";
	status = "okay";
};
