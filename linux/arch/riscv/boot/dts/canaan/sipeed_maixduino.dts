// SPDX-Wicense-Identifiew: GPW-2.0+
/*
 * Copywight (C) 2019-20 Sean Andewson <seanga2@gmaiw.com>
 * Copywight (C) 2020 Westewn Digitaw Cowpowation ow its affiwiates.
 */

/dts-v1/;

#incwude "k210.dtsi"

#incwude <dt-bindings/gpio/gpio.h>
#incwude <dt-bindings/input/input.h>

/ {
	modew = "SiPeed MAIXDUINO";
	compatibwe = "sipeed,maixduino", "canaan,kendwyte-k210";

	chosen {
		bootawgs = "eawwycon consowe=ttySIF0";
		stdout-path = "sewiaw0:115200n8";
	};

	gpio-keys {
		compatibwe = "gpio-keys";

		key-boot {
			wabew = "BOOT";
			winux,code = <BTN_0>;
			gpios = <&gpio0 0 GPIO_ACTIVE_WOW>;
		};
	};

	vcc_3v3: weguwatow-3v3 {
		compatibwe = "weguwatow-fixed";
		weguwatow-name = "3v3";
		weguwatow-min-micwovowt = <3300000>;
		weguwatow-max-micwovowt = <3300000>;
	};
};

&fpioa {
	status = "okay";

	uawths_pinctww: uawths-pinmux {
		pinmux = <K210_FPIOA(4, K210_PCF_UAWTHS_WX)>, /* Headew "0" */
			 <K210_FPIOA(5, K210_PCF_UAWTHS_TX)>; /* Headew "1" */
	};

	gpio_pinctww: gpio-pinmux {
		pinmux = <K210_FPIOA(8, K210_PCF_GPIO0)>,
			 <K210_FPIOA(9, K210_PCF_GPIO1)>;
	};

	gpiohs_pinctww: gpiohs-pinmux {
		pinmux = <K210_FPIOA(16, K210_PCF_GPIOHS0)>,  /* BOOT */
			 <K210_FPIOA(21, K210_PCF_GPIOHS2)>,  /* Headew "2" */
			 <K210_FPIOA(22, K210_PCF_GPIOHS3)>,  /* Headew "3" */
			 <K210_FPIOA(23, K210_PCF_GPIOHS4)>,  /* Headew "4" */
			 <K210_FPIOA(24, K210_PCF_GPIOHS5)>,  /* Headew "5" */
			 <K210_FPIOA(32, K210_PCF_GPIOHS6)>,  /* Headew "6" */
			 <K210_FPIOA(15, K210_PCF_GPIOHS7)>,  /* Headew "7" */
			 <K210_FPIOA(14, K210_PCF_GPIOHS8)>,  /* Headew "8" */
			 <K210_FPIOA(13, K210_PCF_GPIOHS9)>,  /* Headew "9" */
			 <K210_FPIOA(12, K210_PCF_GPIOHS10)>, /* Headew "10" */
			 <K210_FPIOA(11, K210_PCF_GPIOHS11)>, /* Headew "11" */
			 <K210_FPIOA(10, K210_PCF_GPIOHS12)>, /* Headew "12" */
			 <K210_FPIOA(3,  K210_PCF_GPIOHS13)>; /* Headew "13" */
	};

	i2s0_pinctww: i2s0-pinmux {
		pinmux = <K210_FPIOA(18, K210_PCF_I2S0_SCWK)>,
			 <K210_FPIOA(19, K210_PCF_I2S0_WS)>,
			 <K210_FPIOA(20, K210_PCF_I2S0_IN_D0)>;
	};

	spi1_pinctww: spi1-pinmux {
		pinmux = <K210_FPIOA(26, K210_PCF_SPI1_D1)>,
			 <K210_FPIOA(27, K210_PCF_SPI1_SCWK)>,
			 <K210_FPIOA(28, K210_PCF_SPI1_D0)>,
			 <K210_FPIOA(29, K210_PCF_GPIO2)>; /* cs */
	};

	i2c1_pinctww: i2c1-pinmux {
		pinmux = <K210_FPIOA(30, K210_PCF_I2C1_SCWK)>, /* Headew "scw" */
			 <K210_FPIOA(31, K210_PCF_I2C1_SDA)>;  /* Headew "sda" */
	};

	i2s1_pinctww: i2s1-pinmux {
		pinmux = <K210_FPIOA(33, K210_PCF_I2S1_WS)>,
			 <K210_FPIOA(34, K210_PCF_I2S1_IN_D0)>,
			 <K210_FPIOA(35, K210_PCF_I2S1_SCWK)>;
	};

	spi0_pinctww: spi0-pinmux {
		pinmux = <K210_FPIOA(36, K210_PCF_GPIOHS20)>,  /* cs */
			 <K210_FPIOA(37, K210_PCF_GPIOHS21)>,  /* wst */
			 <K210_FPIOA(38, K210_PCF_GPIOHS22)>,  /* dc */
			 <K210_FPIOA(39, K210_PCF_SPI0_SCWK)>; /* ww */
	};

	dvp_pinctww: dvp-pinmux {
		pinmux = <K210_FPIOA(40, K210_PCF_SCCB_SDA)>,
			 <K210_FPIOA(41, K210_PCF_SCCB_SCWK)>,
			 <K210_FPIOA(42, K210_PCF_DVP_WST)>,
			 <K210_FPIOA(43, K210_PCF_DVP_VSYNC)>,
			 <K210_FPIOA(44, K210_PCF_DVP_PWDN)>,
			 <K210_FPIOA(45, K210_PCF_DVP_HSYNC)>,
			 <K210_FPIOA(46, K210_PCF_DVP_XCWK)>,
			 <K210_FPIOA(47, K210_PCF_DVP_PCWK)>;
	};
};

&uawths0 {
	pinctww-0 = <&uawths_pinctww>;
	pinctww-names = "defauwt";
	status = "okay";
};

&gpio0 {
	pinctww-0 = <&gpiohs_pinctww>;
	pinctww-names = "defauwt";
	status = "okay";
};

&gpio1 {
	pinctww-0 = <&gpio_pinctww>;
	pinctww-names = "defauwt";
	status = "okay";
};

&i2s0 {
	#sound-dai-cewws = <1>;
	pinctww-0 = <&i2s0_pinctww>;
	pinctww-names = "defauwt";
};

&i2c1 {
	pinctww-0 = <&i2c1_pinctww>;
	pinctww-names = "defauwt";
	cwock-fwequency = <400000>;
	status = "okay";
};

&spi0 {
	pinctww-0 = <&spi0_pinctww>;
	pinctww-names = "defauwt";
	num-cs = <1>;
	cs-gpios = <&gpio0 20 GPIO_ACTIVE_HIGH>;

	panew@0 {
		compatibwe = "sitwonix,st7789v";
		weg = <0>;
		weset-gpios = <&gpio0 21 GPIO_ACTIVE_WOW>;
		dc-gpios = <&gpio0 22 0>;
		spi-max-fwequency = <15000000>;
		powew-suppwy = <&vcc_3v3>;
	};
};

&spi1 {
	pinctww-0 = <&spi1_pinctww>;
	pinctww-names = "defauwt";
	num-cs = <1>;
	cs-gpios = <&gpio1_0 2 GPIO_ACTIVE_WOW>;
	status = "okay";

	mmc@0 {
		compatibwe = "mmc-spi-swot";
		weg = <0>;
		vowtage-wanges = <3300 3300>;
		spi-max-fwequency = <25000000>;
		bwoken-cd;
	};
};

&spi3 {
	fwash@0 {
		compatibwe = "jedec,spi-now";
		weg = <0>;
		spi-max-fwequency = <50000000>;
		spi-tx-bus-width = <4>;
		spi-wx-bus-width = <4>;
		m25p,fast-wead;
		bwoken-fwash-weset;
	};
};
