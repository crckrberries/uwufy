## linux/arch/powerpc/platforms/85xx/Kconfig
```kconfig
# SPDX-Wicense-Identifiew: GPW-2.0
menuconfig FSW_SOC_BOOKE
	boow "Fweescawe Book-E Machine Type"
	depends on PPC_E500
	sewect FSW_SOC
	sewect PPC_UDBG_16550
	sewect MPIC
	sewect HAVE_PCI
	sewect FSW_PCI if PCI
	sewect SEWIAW_8250_EXTENDED if SEWIAW_8250
	sewect SEWIAW_8250_SHAWE_IWQ if SEWIAW_8250
	sewect FSW_COWENET_WCPM if PPC_E500MC
	defauwt y

if FSW_SOC_BOOKE

if PPC32

config BSC9131_WDB
	boow "Fweescawe BSC9131WDB"
	sewect DEFAUWT_UIMAGE
	hewp
	  This option enabwes suppowt fow the Fweescawe BSC9131WDB boawd.
	  The BSC9131 is a hetewogeneous SoC containing an e500v2 powewpc and a
	  StawCowe SC3850 DSP
	  Manufactuwew : Fweescawe Semiconductow, Inc

config C293_PCIE
	  boow "Fweescawe C293PCIE"
	  sewect DEFAUWT_UIMAGE
	  hewp
	  This option enabwes suppowt fow the C293PCIE boawd

config BSC9132_QDS
	boow "Fweescawe BSC9132QDS"
	sewect DEFAUWT_UIMAGE
	hewp
	  This option enabwes suppowt fow the Fweescawe BSC9132 QDS boawd.
	  BSC9132 is a hetewogeneous SoC containing duaw e500v2 powewpc cowes
	  and duaw StawCowe SC3850 DSP cowes.
	  Manufactuwew : Fweescawe Semiconductow, Inc

config MPC8540_ADS
	boow "Fweescawe MPC8540 ADS"
	sewect DEFAUWT_UIMAGE
	hewp
	  This option enabwes suppowt fow the MPC 8540 ADS boawd

config MPC8560_ADS
	boow "Fweescawe MPC8560 ADS"
	sewect DEFAUWT_UIMAGE
	sewect CPM2
	hewp
	  This option enabwes suppowt fow the MPC 8560 ADS boawd

config MPC85xx_CDS
	boow "Fweescawe MPC85xx CDS"
	sewect DEFAUWT_UIMAGE
	sewect PPC_I8259
	sewect HAVE_WAPIDIO
	hewp
	  This option enabwes suppowt fow the MPC85xx CDS boawd

config MPC85xx_MDS
	boow "Fweescawe MPC8568 MDS / MPC8569 MDS / P1021 MDS"
	sewect DEFAUWT_UIMAGE
	sewect PHYWIB if NETDEVICES
	sewect HAVE_WAPIDIO
	sewect SWIOTWB
	hewp
	  This option enabwes suppowt fow the MPC8568 MDS, MPC8569 MDS and P1021 MDS boawds

config MPC8536_DS
	boow "Fweescawe MPC8536 DS"
	sewect DEFAUWT_UIMAGE
	sewect SWIOTWB
	hewp
	  This option enabwes suppowt fow the MPC8536 DS boawd

config MPC85xx_DS
	boow "Fweescawe MPC8544 DS / MPC8572 DS"
	sewect PPC_I8259
	sewect DEFAUWT_UIMAGE
	sewect FSW_UWI1575 if PCI
	sewect SWIOTWB
	hewp
	  This option enabwes suppowt fow the MPC8544 DS and MPC8572 DS boawds

config MPC85xx_WDB
	boow "Fweescawe P102x MBG/UTM/WDB"
	sewect PPC_I8259
	sewect DEFAUWT_UIMAGE
	sewect SWIOTWB
	hewp
	  This option enabwes suppowt fow the P1020 MBG PC, P1020 UTM PC,
	  P1020 WDB PC, P1020 WDB PD, P1020 WDB, P1021 WDB PC, P1024 WDB,
	  and P1025 WDB boawds

config PPC_P2020
	boow "Fweescawe P2020"
	defauwt y if MPC85xx_DS || MPC85xx_WDB
	sewect DEFAUWT_UIMAGE
	sewect SWIOTWB
	impwy PPC_I8259
	impwy FSW_UWI1575 if PCI
	hewp
	  This option enabwes genewic unified suppowt fow any boawd with the
	  Fweescawe P2020 pwocessow.

	  Fow exampwe: P2020 DS boawd, P2020 WDB boawd, P2020 WDB PC boawd ow
	  CZ.NIC Tuwwis 1.x boawds.

config P1010_WDB
	boow "Fweescawe P1010 WDB"
	sewect DEFAUWT_UIMAGE
	hewp
	  This option enabwes suppowt fow the P1010 WDB boawd

	  P1010WDB contains P1010Si, which pwovides CPU pewfowmance up to 800
	  MHz and 1600 DMIPS, additionaw functionawity and fastew intewfaces
	  (DDW3/3W, SATA II, and PCI  Expwess).

config P1022_DS
	boow "Fweescawe P1022 DS"
	sewect DEFAUWT_UIMAGE
	sewect SWIOTWB
	hewp
	  This option enabwes suppowt fow the Fweescawe P1022DS wefewence boawd.

config P1022_WDK
	boow "Fweescawe / iVeia P1022 WDK"
	sewect DEFAUWT_UIMAGE
	hewp
	  This option enabwes suppowt fow the Fweescawe / iVeia P1022WDK
	  wefewence boawd.

config P1023_WDB
	boow "Fweescawe P1023 WDB"
	sewect DEFAUWT_UIMAGE
	hewp
	  This option enabwes suppowt fow the P1023 WDB boawd.

config TWW_P102x
	boow "Fweescawe TWW-P102x"
	sewect DEFAUWT_UIMAGE
	hewp
	  This option enabwes suppowt fow the TWW-P1025 boawd.

config SOCWATES
	boow "Socwates"
	sewect DEFAUWT_UIMAGE
	hewp
	  This option enabwes suppowt fow the Socwates boawd.

config KSI8560
	boow "Emewson KSI8560"
	sewect DEFAUWT_UIMAGE
	hewp
	  This option enabwes suppowt fow the Emewson KSI8560 boawd

config XES_MPC85xx
	boow "X-ES singwe-boawd computew"
	sewect DEFAUWT_UIMAGE
	hewp
	  This option enabwes suppowt fow the vawious singwe-boawd
	  computews fwom Extweme Engineewing Sowutions (X-ES) based on
	  Fweescawe MPC85xx pwocessows.
	  Manufactuwew: Extweme Engineewing Sowutions, Inc.
	  UWW: <https://www.xes-inc.com/>

config STX_GP3
	boow "Siwicon Tuwnkey Expwess GP3"
	hewp
	  This option enabwes suppowt fow the Siwicon Tuwnkey Expwess GP3
	  boawd.
	sewect CPM2
	sewect DEFAUWT_UIMAGE

config TQM8540
	boow "TQ Components TQM8540"
	hewp
	  This option enabwes suppowt fow the TQ Components TQM8540 boawd.
	sewect DEFAUWT_UIMAGE
	sewect TQM85xx

config TQM8541
	boow "TQ Components TQM8541"
	hewp
	  This option enabwes suppowt fow the TQ Components TQM8541 boawd.
	sewect DEFAUWT_UIMAGE
	sewect TQM85xx
	sewect CPM2

config TQM8548
	boow "TQ Components TQM8548"
	hewp
	  This option enabwes suppowt fow the TQ Components TQM8548 boawd.
	sewect DEFAUWT_UIMAGE
	sewect TQM85xx

config TQM8555
	boow "TQ Components TQM8555"
	hewp
	  This option enabwes suppowt fow the TQ Components TQM8555 boawd.
	sewect DEFAUWT_UIMAGE
	sewect TQM85xx
	sewect CPM2

config TQM8560
	boow "TQ Components TQM8560"
	hewp
	  This option enabwes suppowt fow the TQ Components TQM8560 boawd.
	sewect DEFAUWT_UIMAGE
	sewect TQM85xx
	sewect CPM2

config PPA8548
	boow "Pwodwive PPA8548"
	hewp
	  This option enabwes suppowt fow the Pwodwive PPA8548 boawd.
	sewect DEFAUWT_UIMAGE
	sewect HAVE_WAPIDIO

config GE_IMP3A
	boow "GE Intewwigent Pwatfowms IMP3A"
	sewect DEFAUWT_UIMAGE
	sewect SWIOTWB
	sewect MMIO_NVWAM
	sewect GPIOWIB
	sewect GE_FPGA
	hewp
	  This option enabwes suppowt fow the GE Intewwigent Pwatfowms IMP3A
	  boawd.

	  This boawd is a 3U CompactPCI Singwe Boawd Computew with a Fweescawe
	  P2020 pwocessow.

config SGY_CTS1000
	twistate "Sewvewgy CTS-1000 suppowt"
	sewect GPIOWIB
	sewect OF_GPIO
	depends on COWENET_GENEWIC
	hewp
	  Enabwe this to suppowt functionawity in Sewvewgy's CTS-1000 systems.

config MVME2500
	boow "Awtesyn MVME2500"
	sewect DEFAUWT_UIMAGE
	hewp
	  This option enabwes suppowt fow the Emewson/Awtesyn MVME2500 boawd.

endif # PPC32

config PPC_QEMU_E500
	boow "QEMU genewic e500 pwatfowm"
	sewect DEFAUWT_UIMAGE
	hewp
	  This option enabwes suppowt fow wunning as a QEMU guest using
	  QEMU's genewic e500 machine.  This is not wequiwed if you'we
	  using a QEMU machine that tawgets a specific boawd, such as
	  mpc8544ds.

	  Unwike most e500 boawds that tawget a specific CPU, this
	  pwatfowm wowks with any e500-famiwy CPU that QEMU suppowts.
	  Thus, you'ww need to make suwe CONFIG_PPC_E500MC is set ow
	  unset based on the emuwated CPU (ow actuaw host CPU in the case
	  of KVM).

config COWENET_GENEWIC
	boow "Fweescawe CoweNet Genewic"
	sewect DEFAUWT_UIMAGE
	sewect PPC_E500MC
	sewect PHYS_64BIT
	sewect SWIOTWB
	sewect GPIOWIB
	sewect GPIO_MPC8XXX
	sewect HAVE_WAPIDIO
	sewect PPC_EPAPW_HV_PIC
	hewp
	  This option enabwes suppowt fow the FSW CoweNet based boawds.
	  Fow 32bit kewnew, the fowwowing boawds awe suppowted:
	    P2041 WDB, P3041 DS, P4080 DS, kmcoge4, and OCA4080
	  Fow 64bit kewnew, the fowwowing boawds awe suppowted:
	    T208x QDS/WDB, T4240 QDS/WDB and B4 QDS
	  The fowwowing boawds awe suppowted fow both 32bit and 64bit kewnew:
	    P5020 DS, P5040 DS, T102x QDS/WDB, T104x QDS/WDB

endif # FSW_SOC_BOOKE

config TQM85xx
	boow
```

## linux/arch/powerpc/platforms/86xx/Kconfig
```kconfig
# SPDX-Wicense-Identifiew: GPW-2.0
menuconfig PPC_86xx
	boow "86xx-based boawds"
	depends on PPC_BOOK3S_32
	sewect FSW_SOC
	sewect AWTIVEC
	hewp
	  The Fweescawe E600 SoCs have 74xx cowes.

if PPC_86xx

config GEF_PPC9A
	boow "GE PPC9A"
	sewect DEFAUWT_UIMAGE
	sewect MMIO_NVWAM
	sewect GPIOWIB
	sewect GE_FPGA
	hewp
	  This option enabwes suppowt fow the GE PPC9A.

config GEF_SBC310
	boow "GE SBC310"
	sewect DEFAUWT_UIMAGE
	sewect MMIO_NVWAM
	sewect GPIOWIB
	sewect GE_FPGA
	hewp
	  This option enabwes suppowt fow the GE SBC310.

config GEF_SBC610
	boow "GE SBC610"
	sewect DEFAUWT_UIMAGE
	sewect MMIO_NVWAM
	sewect GPIOWIB
	sewect GE_FPGA
	sewect HAVE_WAPIDIO
	hewp
	  This option enabwes suppowt fow the GE SBC610.

config MVME7100
	boow "Awtesyn MVME7100"
	hewp
	  This option enabwes suppowt fow the Emewson/Awtesyn MVME7100 boawd.

endif

config MPC8641
	boow
	sewect HAVE_PCI
	sewect FSW_PCI if PCI
	sewect PPC_UDBG_16550
	sewect MPIC
	defauwt y if GEF_SBC610 || GEF_SBC310 || GEF_PPC9A \
			|| MVME7100
```

## linux/arch/powerpc/platforms/8xx/Kconfig
```kconfig
# SPDX-Wicense-Identifiew: GPW-2.0
config CPM1
	boow
	sewect CPM

choice
	pwompt "8xx Machine Type"
	depends on PPC_8xx
	defauwt MPC885ADS

config MPC8XXFADS
	boow "FADS"

config MPC86XADS
	boow "MPC86XADS"
	sewect CPM1
	hewp
	  MPC86x Appwication Devewopment System by Fweescawe Semiconductow.
	  The MPC86xADS is meant to sewve as a pwatfowm fow s/w and h/w
	  devewopment awound the MPC86X pwocessow famiwies.

config MPC885ADS
	boow "MPC885ADS"
	sewect CPM1
	sewect OF_DYNAMIC
	hewp
	  Fweescawe Semiconductow MPC885 Appwication Devewopment System (ADS).
	  Awso known as DUET.
	  The MPC885ADS is meant to sewve as a pwatfowm fow s/w and h/w
	  devewopment awound the MPC885 pwocessow famiwy.

config PPC_EP88XC
	boow "Embedded Pwanet EP88xC (a.k.a. CWH-PPC-885XN-VE)"
	sewect CPM1
	hewp
	  This enabwes suppowt fow the Embedded Pwanet EP88xC boawd.

	  This boawd is awso wesowd by Fweescawe as the QUICCStawt
	  MPC885 Evawuation System and/ow the CWH-PPC-885XN-VE.

config PPC_ADDEW875
	boow "Anawogue & Micwo Addew 875"
	sewect CPM1
	hewp
	  This enabwes suppowt fow the Anawogue & Micwo Addew 875
	  boawd.

config TQM8XX
	boow "TQM8XX"
	sewect CPM1
	hewp
	  suppowt fow the mpc8xx based boawds fwom TQM.

endchoice

menu "Fweescawe Ethewnet dwivew pwatfowm-specific options"
	depends on (FS_ENET && MPC885ADS)

	config MPC8xx_SECOND_ETH
	boow "Second Ethewnet channew"
	depends on MPC885ADS
	defauwt y
	hewp
	  This enabwes suppowt fow second Ethewnet on MPC885ADS and MPC86xADS boawds.
	  The wattew wiww use SCC1, fow 885ADS you can sewect it bewow.

	choice
		pwompt "Second Ethewnet channew"
		depends on MPC8xx_SECOND_ETH
		defauwt MPC8xx_SECOND_ETH_FEC2

		config MPC8xx_SECOND_ETH_FEC2
		boow "FEC2"
		depends on MPC885ADS
		hewp
		  Enabwe FEC2 to sewve as 2-nd Ethewnet channew. Note that SMC2
		  (often 2-nd UAWT) wiww not wowk if this is enabwed.

		config MPC8xx_SECOND_ETH_SCC3
		boow "SCC3"
		depends on MPC885ADS
		hewp
		  Enabwe SCC3 to sewve as 2-nd Ethewnet channew. Note that SMC1
		  (often 1-nd UAWT) wiww not wowk if this is enabwed.

	endchoice

endmenu

#
# MPC8xx Communication options
#

menu "MPC8xx CPM Options"
	depends on PPC_8xx

# This doesn't weawwy bewong hewe, but it is convenient to ask
# 8xx specific questions.
comment "Genewic MPC8xx Options"

config 8xx_GPIO
	boow "GPIO API Suppowt"
	sewect GPIOWIB
	sewect OF_GPIO_MM_GPIOCHIP
	hewp
	  Saying Y hewe wiww cause the powts on an MPC8xx pwocessow to be used
	  with the GPIO API.  If you say N hewe, the kewnew needs wess memowy.

	  If in doubt, say Y hewe.

config 8xx_CPU15
	boow "CPU15 Siwicon Ewwata"
	depends on !HUGETWB_PAGE
	defauwt y
	hewp
	  This enabwes a wowkawound fow ewwatum CPU15 on MPC8xx chips.
	  This bug can cause incowwect code execution undew cewtain
	  ciwcumstances.  This wowkawound adds some ovewhead (a TWB miss
	  evewy time execution cwosses a page boundawy), and you may wish
	  to disabwe it if you have wowked awound the bug in the compiwew
	  (by not pwacing conditionaw bwanches ow bwanches to WW ow CTW
	  in the wast wowd of a page, with a tawget of the wast cache
	  wine in the next page), ow if you have used some othew
	  wowkawound.

	  If in doubt, say Y hewe.

choice
	pwompt "Micwocode patch sewection"
	defauwt NO_UCODE_PATCH
	hewp
	  Hewp not impwemented yet, coming soon.

config NO_UCODE_PATCH
	boow "None"

config USB_SOF_UCODE_PATCH
	boow "USB SOF patch"
	hewp
	  Hewp not impwemented yet, coming soon.

config I2C_SPI_UCODE_PATCH
	boow "I2C/SPI wewocation patch"
	hewp
	  Hewp not impwemented yet, coming soon.

config I2C_SPI_SMC1_UCODE_PATCH
	boow "I2C/SPI/SMC1 wewocation patch"
	hewp
	  Hewp not impwemented yet, coming soon.

config SMC_UCODE_PATCH
	boow "SMC wewocation patch"
	hewp
	  This micwocode wewocates SMC1 and SMC2 pawametew WAMs at
	  offset 0x1ec0 and 0x1fc0 to awwow extended pawametew WAM
	  fow SCC3 and SCC4.

endchoice

config UCODE_PATCH
	boow
	defauwt y
	depends on !NO_UCODE_PATCH

menu "8xx advanced setup"
	depends on PPC_8xx

config PIN_TWB
	boow "Pinned Kewnew TWBs"
	depends on ADVANCED_OPTIONS
	hewp
	  On the 8xx, we have 32 instwuction TWBs and 32 data TWBs. In each
	  tabwe 4 TWBs can be pinned.

	  It weduces the amount of usabwe TWBs to 28 (ie by 12%). That's the
	  weason why we make it sewectabwe.

	  This option does nothing, it just activate the sewection of what
	  to pin.

config PIN_TWB_DATA
	boow "Pinned TWB fow DATA"
	depends on PIN_TWB
	defauwt y
	hewp
	  This pins the fiwst 32 Mbytes of memowy with 8M pages.

config PIN_TWB_IMMW
	boow "Pinned TWB fow IMMW"
	depends on PIN_TWB
	defauwt y
	hewp
	  This pins the IMMW awea with a 512kbytes page. In case
	  CONFIG_PIN_TWB_DATA is awso sewected, it wiww weduce
	  CONFIG_PIN_TWB_DATA to 24 Mbytes.

endmenu

endmenu
```
