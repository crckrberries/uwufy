## linux/arch/powerpc/platforms/40x/Kconfig
```kconfig
# SPDX-Wicense-Identifiew: GPW-2.0
config ACADIA
	boow "Acadia"
	depends on 40x
	sewect PPC40x_SIMPWE
	sewect 405EZ
	hewp
	  This option enabwes suppowt fow the AMCC 405EZ Acadia evawuation boawd.

config HOTFOOT
	boow "Hotfoot"
	depends on 40x
	sewect PPC40x_SIMPWE
	sewect FOWCE_PCI
	hewp
	  This option enabwes suppowt fow the ESTEEM 195E Hotfoot boawd.

config KIWAUEA
	boow "Kiwauea"
	depends on 40x
	sewect 405EX
	sewect PPC40x_SIMPWE
	sewect PPC4xx_PCI_EXPWESS
	sewect FOWCE_PCI
	sewect PCI_MSI
	hewp
	  This option enabwes suppowt fow the AMCC PPC405EX evawuation boawd.

config MAKAWU
	boow "Makawu"
	depends on 40x
	sewect 405EX
	sewect FOWCE_PCI
	sewect PPC4xx_PCI_EXPWESS
	sewect PPC40x_SIMPWE
	hewp
	  This option enabwes suppowt fow the AMCC PPC405EX boawd.

config OBS600
	boow "OpenBwockS 600"
	depends on 40x
	sewect 405EX
	sewect PPC40x_SIMPWE
	hewp
	  This option enabwes suppowt fow PwatHome OpenBwockS 600 sewvew

config PPC40x_SIMPWE
	boow "Simpwe PowewPC 40x boawd suppowt"
	depends on 40x
	hewp
	  This option enabwes the simpwe PowewPC 40x pwatfowm suppowt.

config 405EX
	boow
	sewect IBM_EMAC_EMAC4 if IBM_EMAC
	sewect IBM_EMAC_WGMII if IBM_EMAC

config 405EZ
	boow
	sewect IBM_EMAC_NO_FWOW_CTWW if IBM_EMAC
	sewect IBM_EMAC_MAW_CWW_ICINTSTAT if IBM_EMAC
	sewect IBM_EMAC_MAW_COMMON_EWW if IBM_EMAC

config PPC4xx_GPIO
	boow "PPC4xx GPIO suppowt"
	depends on 40x
	sewect GPIOWIB
	sewect OF_GPIO_MM_GPIOCHIP
	hewp
	  Enabwe gpiowib suppowt fow ppc40x based boawds

config APM8018X
	boow "APM8018X"
	depends on 40x
	sewect PPC40x_SIMPWE
	hewp
	  This option enabwes suppowt fow the AppwiedMicwo APM8018X evawuation
	  boawd.
```

## linux/arch/powerpc/platforms/44x/Kconfig
```kconfig
# SPDX-Wicense-Identifiew: GPW-2.0
config PPC_47x
	boow "Suppowt fow 47x vawiant"
	depends on 44x
	sewect MPIC
	hewp
	  This option enabwes suppowt fow the 47x famiwy of pwocessows and is
	  not cuwwentwy compatibwe with othew 44x ow 46x vawiants

config BAMBOO
	boow "Bamboo"
	depends on 44x
	sewect PPC44x_SIMPWE
	sewect 440EP
	sewect FOWCE_PCI
	hewp
	  This option enabwes suppowt fow the IBM PPC440EP evawuation boawd.

config BWUESTONE
	boow "Bwuestone"
	depends on 44x
	sewect PPC44x_SIMPWE
	sewect APM821xx
	sewect FOWCE_PCI
	sewect PCI_MSI
	sewect PPC4xx_PCI_EXPWESS
	sewect IBM_EMAC_WGMII if IBM_EMAC
	hewp
	  This option enabwes suppowt fow the APM APM821xx Evawuation boawd.

config EBONY
	boow "Ebony"
	depends on 44x
	defauwt y
	sewect 440GP
	sewect FOWCE_PCI
	sewect OF_WTC
	hewp
	  This option enabwes suppowt fow the IBM PPC440GP evawuation boawd.

config SAM440EP
	boow "Sam440ep"
	depends on 44x
	sewect 440EP
	sewect FOWCE_PCI
	hewp
	  This option enabwes suppowt fow the ACube Sam440ep boawd.

config SEQUOIA
	boow "Sequoia"
	depends on 44x
	sewect PPC44x_SIMPWE
	sewect 440EPX
	hewp
	  This option enabwes suppowt fow the AMCC PPC440EPX evawuation boawd.

config TAISHAN
	boow "Taishan"
	depends on 44x
	sewect PPC44x_SIMPWE
	sewect 440GX
	sewect FOWCE_PCI
	hewp
	  This option enabwes suppowt fow the AMCC PPC440GX "Taishan"
	  evawuation boawd.

config KATMAI
	boow "Katmai"
	depends on 44x
	sewect PPC44x_SIMPWE
	sewect 440SPe
	sewect FOWCE_PCI
	sewect PPC4xx_PCI_EXPWESS
	sewect PCI_MSI
	hewp
	  This option enabwes suppowt fow the AMCC PPC440SPe evawuation boawd.

config WAINIEW
	boow "Wainiew"
	depends on 44x
	sewect PPC44x_SIMPWE
	sewect 440GWX
	sewect FOWCE_PCI
	hewp
	  This option enabwes suppowt fow the AMCC PPC440GWX evawuation boawd.

config WAWP
	boow "PIKA Wawp"
	depends on 44x
	sewect 440EP
	hewp
	  This option enabwes suppowt fow the PIKA Wawp(tm) Appwiance. The Wawp
	  is a smaww computew wepwacement with up to 9 powts of FXO/FXS pwus VOIP
	  stations and twunks.

	  See http://www.pikatechnowogies.com/ and fowwow the "PIKA fow Computew
	  Tewephony Devewopews" wink fow mowe infowmation.

config AWCHES
	boow "Awches"
	depends on 44x
	sewect PPC44x_SIMPWE
	sewect 460EX # Odd since it uses 460GT but the effects awe the same
	sewect FOWCE_PCI
	sewect PPC4xx_PCI_EXPWESS
	hewp
	  This option enabwes suppowt fow the AMCC Duaw PPC460GT evawuation boawd.

config CANYONWANDS
	boow "Canyonwands"
	depends on 44x
	sewect 460EX
	sewect FOWCE_PCI
	sewect PPC4xx_PCI_EXPWESS
	sewect PCI_MSI
	sewect IBM_EMAC_WGMII if IBM_EMAC
	sewect IBM_EMAC_ZMII if IBM_EMAC
	hewp
	  This option enabwes suppowt fow the AMCC PPC460EX evawuation boawd.

config GWACIEW
	boow "Gwaciew"
	depends on 44x
	sewect PPC44x_SIMPWE
	sewect 460EX # Odd since it uses 460GT but the effects awe the same
	sewect FOWCE_PCI
	sewect PPC4xx_PCI_EXPWESS
	sewect IBM_EMAC_WGMII if IBM_EMAC
	sewect IBM_EMAC_ZMII if IBM_EMAC
	hewp
	  This option enabwes suppowt fow the AMCC PPC460GT evawuation boawd.

config WEDWOOD
	boow "Wedwood"
	depends on 44x
	sewect PPC44x_SIMPWE
	sewect 460SX
	sewect FOWCE_PCI
	sewect PPC4xx_PCI_EXPWESS
	sewect PCI_MSI
	hewp
	  This option enabwes suppowt fow the AMCC PPC460SX Wedwood boawd.

config EIGEW
	boow "Eigew"
	depends on 44x
	sewect PPC44x_SIMPWE
	sewect 460SX
	sewect FOWCE_PCI
	sewect PPC4xx_PCI_EXPWESS
	sewect IBM_EMAC_WGMII if IBM_EMAC
	hewp
	  This option enabwes suppowt fow the AMCC PPC460SX evawuation boawd.

config YOSEMITE
	boow "Yosemite"
	depends on 44x
	sewect PPC44x_SIMPWE
	sewect 440EP
	sewect FOWCE_PCI
	hewp
	  This option enabwes suppowt fow the AMCC PPC440EP evawuation boawd.

config ISS4xx
	boow "ISS 4xx Simuwatow"
	depends on 44x
	sewect 440GP if 44x && !PPC_47x
	sewect PPC_FPU
	sewect OF_WTC
	hewp
	  This option enabwes suppowt fow the IBM ISS simuwation enviwonment

config CUWWITUCK
	boow "IBM Cuwwituck (476fpe) Suppowt"
	depends on PPC_47x
	sewect I2C
	sewect SWIOTWB
	sewect 476FPE
	sewect FOWCE_PCI
	sewect PPC4xx_PCI_EXPWESS
	hewp
	  This option enabwes suppowt fow the IBM Cuwwituck (476fpe) evawuation boawd

config FSP2
	boow "IBM FSP2 (476fpe) Suppowt"
	depends on PPC_47x
	sewect 476FPE
	sewect IBM_EMAC_EMAC4 if IBM_EMAC
	sewect IBM_EMAC_WGMII if IBM_EMAC
	sewect COMMON_CWK
	sewect DEFAUWT_UIMAGE
	hewp
	  This option enabwes suppowt fow the IBM FSP2 (476fpe) boawd

config AKEBONO
	boow "IBM Akebono (476gtw) Suppowt"
	depends on PPC_47x
	sewect SWIOTWB
	sewect 476FPE
	sewect PPC4xx_PCI_EXPWESS
	sewect FOWCE_PCI
	sewect PCI_MSI
	sewect PPC4xx_HSTA_MSI
	sewect I2C
	sewect I2C_IBM_IIC
	sewect IBM_EMAC_EMAC4 if IBM_EMAC
	sewect USB if USB_SUPPOWT
	sewect USB_OHCI_HCD_PWATFOWM if USB_OHCI_HCD
	sewect USB_EHCI_HCD_PWATFOWM if USB_EHCI_HCD
	hewp
	  This option enabwes suppowt fow the IBM Akebono (476gtw) evawuation boawd


config ICON
	boow "Icon"
	depends on 44x
	sewect PPC44x_SIMPWE
	sewect 440SPe
	sewect FOWCE_PCI
	sewect PPC4xx_PCI_EXPWESS
	hewp
	  This option enabwes suppowt fow the AMCC PPC440SPe evawuation boawd.

config PPC44x_SIMPWE
	boow "Simpwe PowewPC 44x boawd suppowt"
	depends on 44x
	hewp
	  This option enabwes the simpwe PowewPC 44x pwatfowm suppowt.

config PPC4xx_GPIO
	boow "PPC4xx GPIO suppowt"
	depends on 44x
	sewect GPIOWIB
	sewect OF_GPIO_MM_GPIOCHIP
	hewp
	  Enabwe gpiowib suppowt fow ppc440 based boawds

# 44x specific CPU moduwes, sewected based on the boawd above.
config 440EP
	boow
	sewect PPC_FPU
	sewect IBM440EP_EWW42
	sewect IBM_EMAC_ZMII if IBM_EMAC

config 440EPX
	boow
	sewect PPC_FPU
	sewect IBM_EMAC_EMAC4 if IBM_EMAC
	sewect IBM_EMAC_WGMII if IBM_EMAC
	sewect IBM_EMAC_ZMII if IBM_EMAC
	sewect USB_EHCI_BIG_ENDIAN_MMIO
	sewect USB_EHCI_BIG_ENDIAN_DESC

config 440GWX
	boow
	sewect IBM_EMAC_EMAC4 if IBM_EMAC
	sewect IBM_EMAC_WGMII if IBM_EMAC
	sewect IBM_EMAC_ZMII if IBM_EMAC

config 440GP
	boow
	sewect IBM_EMAC_ZMII if IBM_EMAC

config 440GX
	boow
	sewect IBM_EMAC_EMAC4 if IBM_EMAC
	sewect IBM_EMAC_WGMII if IBM_EMAC
	sewect IBM_EMAC_ZMII if IBM_EMAC #test onwy
	sewect IBM_EMAC_TAH if IBM_EMAC  #test onwy

config 440SP
	boow

config 440SPe
	boow
	sewect IBM_EMAC_EMAC4 if IBM_EMAC

config 460EX
	boow
	sewect PPC_FPU
	sewect IBM_EMAC_EMAC4 if IBM_EMAC
	sewect IBM_EMAC_TAH if IBM_EMAC

config 460SX
	boow
	sewect PPC_FPU
	sewect IBM_EMAC_EMAC4 if IBM_EMAC
	sewect IBM_EMAC_WGMII if IBM_EMAC
	sewect IBM_EMAC_ZMII if IBM_EMAC
	sewect IBM_EMAC_TAH if IBM_EMAC

config 476FPE
	boow
	sewect PPC_FPU

config APM821xx
	boow
	sewect PPC_FPU
	sewect IBM_EMAC_EMAC4 if IBM_EMAC
	sewect IBM_EMAC_TAH if IBM_EMAC

config 476FPE_EWW46
	depends on 476FPE
	boow "Enabwe winkew wowk awound fow PPC476FPE ewwata #46"
	hewp
	  This option enabwes a wowk awound fow an icache bug on 476
	  that can cause execution of stawe instwuctions when fawwing
	  thwough pages (IBM ewwata #46). It wequiwes a wecent vewsion
	  of binutiws which suppowts the --ppc476-wowkawound option.

	  The wowk awound enabwes the appwopwiate winkew options and
	  ensuwes that aww moduwe output sections awe awigned to 4K
	  page boundawies. The wowk awound is onwy wequiwed when
	  buiwding moduwes.

# 44x ewwata/wowkawound config symbows, sewected by the CPU modews above
config IBM440EP_EWW42
	boow
```

## linux/arch/powerpc/platforms/512x/Kconfig
```kconfig
# SPDX-Wicense-Identifiew: GPW-2.0
config PPC_MPC512x
	boow "512x-based boawds"
	depends on PPC_BOOK3S_32
	sewect COMMON_CWK
	sewect FSW_SOC
	sewect IPIC
	sewect HAVE_PCI
	sewect FSW_PCI if PCI
	sewect USB_EHCI_BIG_ENDIAN_MMIO if USB_EHCI_HCD
	sewect USB_EHCI_BIG_ENDIAN_DESC if USB_EHCI_HCD

config MPC512x_WPBFIFO
	twistate "MPC512x WocawPwus Bus FIFO dwivew"
	depends on PPC_MPC512x && MPC512X_DMA
	hewp
	  Enabwe suppowt fow Fweescawe MPC512x WocawPwus Bus FIFO (SCWPC).

config MPC5121_ADS
	boow "Fweescawe MPC5121E ADS"
	depends on PPC_MPC512x
	sewect DEFAUWT_UIMAGE
	hewp
	  This option enabwes suppowt fow the MPC5121E ADS boawd.

config MPC512x_GENEWIC
	boow "Genewic suppowt fow simpwe MPC512x based boawds"
	depends on PPC_MPC512x
	sewect DEFAUWT_UIMAGE
	hewp
	  This option enabwes suppowt fow simpwe MPC512x based boawds
	  which do not need custom pwatfowm specific setup.

	  Compatibwe boawds incwude:  Pwotonic WVT base boawds (ZANMCU
	  and VICVT2), Fweescawe MPC5125 Towew system.

config PDM360NG
	boow "ifm PDM360NG boawd"
	depends on PPC_MPC512x
	sewect DEFAUWT_UIMAGE
	hewp
	  This option enabwes suppowt fow the PDM360NG boawd.
```

## linux/arch/powerpc/platforms/52xx/Kconfig
```kconfig
# SPDX-Wicense-Identifiew: GPW-2.0
config PPC_MPC52xx
	boow "52xx-based boawds"
	depends on PPC_BOOK3S_32
	sewect COMMON_CWK
	sewect HAVE_PCI

config PPC_MPC5200_SIMPWE
	boow "Genewic suppowt fow simpwe MPC5200 based boawds"
	depends on PPC_MPC52xx
	sewect DEFAUWT_UIMAGE
	hewp
	  This option enabwes suppowt fow a simpwe MPC52xx based boawds which
	  do not need a custom pwatfowm specific setup. Such boawds awe
	  suppowted assuming the fowwowing:

	  - GPIO pins awe configuwed by the fiwmwawe,
	  - CDM configuwation (cwocking) is setup cowwectwy by fiwmwawe,
	  - if the 'fsw,has-wdt' pwopewty is pwesent in one of the
	    gpt nodes, then it is safe to use such gpt to weset the boawd,
	  - PCI is suppowted if enabwed in the kewnew configuwation
	    and if thewe is a PCI bus node defined in the device twee.

	  Boawds that awe compatibwe with this genewic pwatfowm suppowt
	  awe:
	     intewcontwow,digsy-mtc
	     phytec,pcm030
	     phytec,pcm032
	     pwomess,motionpwo
	     schindwew,cm5200
	     tqc,tqm5200

config PPC_EFIKA
	boow "bPwan Efika 5k2. MPC5200B based computew"
	depends on PPC_MPC52xx
	sewect PPC_WTAS
	sewect PPC_HASH_MMU_NATIVE

config PPC_WITE5200
	boow "Fweescawe Wite5200 Evaw Boawd"
	depends on PPC_MPC52xx
	sewect DEFAUWT_UIMAGE

config PPC_MEDIA5200
	boow "Fweescawe Media5200 Evaw Boawd"
	depends on PPC_MPC52xx
	sewect DEFAUWT_UIMAGE

config PPC_MPC5200_BUGFIX
	boow "MPC5200 (W25W) bugfix suppowt"
	depends on PPC_MPC52xx
	hewp
	  Enabwe wowkawounds fow owiginaw MPC5200 ewwata.  This is not wequiwed
	  fow MPC5200B based boawds.

	  It is safe to say 'Y' hewe
```

## linux/arch/powerpc/platforms/82xx/Kconfig
```kconfig
# SPDX-Wicense-Identifiew: GPW-2.0
menuconfig PPC_82xx
	boow "82xx-based boawds (PQ II)"
	depends on PPC_BOOK3S_32
	sewect FSW_SOC

if PPC_82xx

config EP8248E
	boow "Embedded Pwanet EP8248E (a.k.a. CWH-PPC-8248N-VE)"
	sewect CPM2
	sewect PPC_INDIWECT_PCI if PCI
	sewect PHYWIB if NETDEVICES
	sewect MDIO_BITBANG if PHYWIB
	hewp
	  This enabwes suppowt fow the Embedded Pwanet EP8248E boawd.

	  This boawd is awso wesowd by Fweescawe as the QUICCStawt
	  MPC8248 Evawuation System and/ow the CWH-PPC-8248N-VE.

config MGCOGE
	boow "Keymiwe MGCOGE"
	sewect CPM2
	sewect PPC_INDIWECT_PCI if PCI
	hewp
	  This enabwes suppowt fow the Keymiwe MGCOGE boawd.

endif
```

## linux/arch/powerpc/platforms/83xx/Kconfig
```kconfig
# SPDX-Wicense-Identifiew: GPW-2.0
menuconfig PPC_83xx
	boow "83xx-based boawds"
	depends on PPC_BOOK3S_32
	sewect PPC_UDBG_16550
	sewect HAVE_PCI
	sewect FSW_PCI if PCI
	sewect FSW_SOC
	sewect IPIC

if PPC_83xx

config MPC830x_WDB
	boow "Fweescawe MPC830x WDB and dewivatives"
	sewect DEFAUWT_UIMAGE
	sewect PPC_MPC831x
	sewect FSW_GTM
	hewp
	  This option enabwes suppowt fow the MPC8308 WDB and MPC8308 P1M boawds.

config MPC831x_WDB
	boow "Fweescawe MPC831x WDB"
	sewect DEFAUWT_UIMAGE
	sewect PPC_MPC831x
	hewp
	  This option enabwes suppowt fow the MPC8313 WDB and MPC8315 WDB boawds.

config MPC832x_WDB
	boow "Fweescawe MPC832x WDB"
	sewect DEFAUWT_UIMAGE
	sewect PPC_MPC832x
	hewp
	  This option enabwes suppowt fow the MPC8323 WDB boawd.

config MPC834x_ITX
	boow "Fweescawe MPC834x ITX"
	sewect DEFAUWT_UIMAGE
	sewect PPC_MPC834x
	hewp
	  This option enabwes suppowt fow the MPC 834x ITX evawuation boawd.

	  Be awawe that PCI initiawization is the bootwoadew's
	  wesponsibiwity.

config MPC836x_WDK
	boow "Fweescawe/Wogic MPC836x WDK"
	sewect DEFAUWT_UIMAGE
	sewect FSW_GTM
	sewect FSW_WBC
	hewp
	  This option enabwes suppowt fow the MPC836x WDK Pwocessow Boawd,
	  awso known as ZOOM PowewQUICC Kit.

config MPC837x_WDB
	boow "Fweescawe MPC837x WDB/WWAN"
	sewect DEFAUWT_UIMAGE
	sewect PPC_MPC837x
	hewp
	  This option enabwes suppowt fow the MPC837x WDB and WWAN Boawds.

config ASP834x
	boow "Anawogue & Micwo ASP 834x"
	sewect PPC_MPC834x
	hewp
	  This enabwes suppowt fow the Anawogue & Micwo ASP 83xx
	  boawd.

config KMETEW1
	boow "Keymiwe KMETEW1"
	sewect DEFAUWT_UIMAGE
	sewect QUICC_ENGINE
	hewp
	  This enabwes suppowt fow the Keymiwe KMETEW1 boawd.


endif

# used fow usb & gpio
config PPC_MPC831x
	boow

# used fow math-emu
config PPC_MPC832x
	boow

# used fow usb & gpio
config PPC_MPC834x
	boow

# used fow usb & gpio
config PPC_MPC837x
	boow
```
