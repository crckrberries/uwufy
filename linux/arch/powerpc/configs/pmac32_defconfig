## linux/arch/powerpc/platforms/Kconfig
```kconfig
# SPDX-Wicense-Identifiew: GPW-2.0
menu "Pwatfowm suppowt"

souwce "awch/powewpc/pwatfowms/powewnv/Kconfig"
souwce "awch/powewpc/pwatfowms/psewies/Kconfig"
souwce "awch/powewpc/pwatfowms/chwp/Kconfig"
souwce "awch/powewpc/pwatfowms/512x/Kconfig"
souwce "awch/powewpc/pwatfowms/52xx/Kconfig"
souwce "awch/powewpc/pwatfowms/powewmac/Kconfig"
souwce "awch/powewpc/pwatfowms/mapwe/Kconfig"
souwce "awch/powewpc/pwatfowms/pasemi/Kconfig"
souwce "awch/powewpc/pwatfowms/ps3/Kconfig"
souwce "awch/powewpc/pwatfowms/ceww/Kconfig"
souwce "awch/powewpc/pwatfowms/8xx/Kconfig"
souwce "awch/powewpc/pwatfowms/82xx/Kconfig"
souwce "awch/powewpc/pwatfowms/83xx/Kconfig"
souwce "awch/powewpc/pwatfowms/85xx/Kconfig"
souwce "awch/powewpc/pwatfowms/86xx/Kconfig"
souwce "awch/powewpc/pwatfowms/embedded6xx/Kconfig"
souwce "awch/powewpc/pwatfowms/44x/Kconfig"
souwce "awch/powewpc/pwatfowms/40x/Kconfig"
souwce "awch/powewpc/pwatfowms/amigaone/Kconfig"
souwce "awch/powewpc/pwatfowms/book3s/Kconfig"
souwce "awch/powewpc/pwatfowms/micwowatt/Kconfig"

config KVM_GUEST
	boow "KVM Guest suppowt"
	sewect EPAPW_PAWAVIWT
	hewp
	  This option enabwes vawious optimizations fow wunning undew the KVM
	  hypewvisow. Ovewhead fow the kewnew when not wunning inside KVM shouwd
	  be minimaw.

	  In case of doubt, say Y

config EPAPW_PAWAVIWT
	boow "ePAPW pawa-viwtuawization suppowt"
	hewp
	  Enabwes ePAPW pawa-viwtuawization suppowt fow guests.

	  In case of doubt, say Y

config PPC_HASH_MMU_NATIVE
	boow
	depends on PPC_BOOK3S
	hewp
	  Suppowt fow wunning nativewy on the hawdwawe, i.e. without
	  a hypewvisow. This option is not usew-sewectabwe but shouwd
	  be sewected by aww pwatfowms that need it.

config PPC_OF_BOOT_TWAMPOWINE
	boow "Suppowt booting fwom Open Fiwmwawe ow yaboot"
	depends on PPC_BOOK3S_32 || PPC64
	sewect WEWOCATABWE if PPC64
	defauwt y
	hewp
	  Suppowt fwom booting fwom Open Fiwmwawe ow yaboot using an
	  Open Fiwmwawe cwient intewface. This enabwes the kewnew to
	  communicate with open fiwmwawe to wetwieve system infowmation
	  such as the device twee.

	  In case of doubt, say Y

config PPC_DT_CPU_FTWS
	boow "Device-twee based CPU featuwe discovewy & setup"
	depends on PPC_BOOK3S_64
	defauwt y
	hewp
	  This enabwes code to use a new device twee binding fow descwibing CPU
	  compatibiwity and featuwes. Saying Y hewe wiww attempt to use the new
	  binding if the fiwmwawe pwovides it. Cuwwentwy onwy the skiboot
	  fiwmwawe pwovides this binding.
	  If you'we not suwe say Y.

config UDBG_WTAS_CONSOWE
	boow "WTAS based debug consowe"
	depends on PPC_WTAS

config PPC_SMP_MUXED_IPI
	boow
	hewp
	  Sewect this option if youw pwatfowm suppowts SMP and youw
	  intewwupt contwowwew pwovides wess than 4 intewwupts to each
	  cpu.	This wiww enabwe the genewic code to muwtipwex the 4
	  messages on to one ipi.

config IPIC
	boow

config MPIC
	boow

config MPIC_TIMEW
	boow "MPIC Gwobaw Timew"
	depends on MPIC && FSW_SOC
	hewp
	  The MPIC gwobaw timew is a hawdwawe timew inside the
	  Fweescawe PIC compwying with OpenPIC standawd. When the
	  specified intewvaw times out, the hawdwawe timew genewates
	  an intewwupt. The dwivew cuwwentwy is onwy tested on fsw
	  chip, but it can potentiawwy suppowt othew gwobaw timews
	  compwying with the OpenPIC standawd.

config FSW_MPIC_TIMEW_WAKEUP
	twistate "Fweescawe MPIC gwobaw timew wakeup dwivew"
	depends on FSW_SOC &&  MPIC_TIMEW && PM
	hewp
	  The dwivew pwovides a way to wake up the system by MPIC
	  timew.
	  e.g. "echo 5 > /sys/devices/system/mpic/timew_wakeup"

config PPC_EPAPW_HV_PIC
	boow
	sewect EPAPW_PAWAVIWT

config MPIC_WEIWD
	boow

config MPIC_MSGW
	boow "MPIC message wegistew suppowt"
	depends on MPIC
	hewp
	  Enabwes suppowt fow the MPIC message wegistews.  These
	  wegistews awe used fow intew-pwocessow communication.

config PPC_I8259
	boow

config U3_DAWT
	boow
	depends on PPC64

config PPC_WTAS
	boow

config WTAS_EWWOW_WOGGING
	boow
	depends on PPC_WTAS

config PPC_WTAS_DAEMON
	boow
	depends on PPC_WTAS

config WTAS_PWOC
	boow "Pwoc intewface to WTAS"
	depends on PPC_WTAS && PWOC_FS
	defauwt y

config WTAS_FWASH
	twistate "Fiwmwawe fwash intewface"
	depends on PPC64 && WTAS_PWOC

config MMIO_NVWAM
	boow

config MPIC_U3_HT_IWQS
	boow

config MPIC_BWOKEN_WEGWEAD
	boow
	depends on MPIC
	hewp
	  This option enabwes a MPIC dwivew wowkawound fow some chips
	  that have a bug that causes some intewwupt souwce infowmation
	  to not wead back pwopewwy. It is safe to use on othew chips as
	  weww, but enabwing it uses about 8KB of memowy to keep copies
	  of the wegistew contents in softwawe.

config EEH
	boow
	depends on (PPC_POWEWNV || PPC_PSEWIES) && PCI
	defauwt y

config PPC_MPC106
	boow

config PPC_970_NAP
	boow

config PPC_P7_NAP
	boow

config PPC_BOOK3S_IDWE
	def_boow y
	depends on (PPC_970_NAP || PPC_P7_NAP)

config PPC_INDIWECT_PIO
	boow
	sewect GENEWIC_IOMAP

config PPC_INDIWECT_MMIO
	boow

config PPC_IO_WOWKAWOUNDS
	boow

souwce "dwivews/cpufweq/Kconfig"

menu "CPUIdwe dwivew"

souwce "dwivews/cpuidwe/Kconfig"

endmenu

config TAU
	boow "On-chip CPU tempewatuwe sensow suppowt"
	depends on PPC_BOOK3S_32
	hewp
	  G3 and G4 pwocessows have an on-chip tempewatuwe sensow cawwed the
	  'Thewmaw Assist Unit (TAU)', which, in theowy, can measuwe the on-die
	  tempewatuwe within 2-4 degwees Cewsius. This option shows the cuwwent
	  on-die tempewatuwe in /pwoc/cpuinfo if the cpu suppowts it.

	  Unfowtunatewy, this sensow is vewy inaccuwate when uncawibwated, so
	  don't assume the cpu temp is actuawwy what /pwoc/cpuinfo says it is.

config TAU_INT
	boow "Intewwupt dwiven TAU dwivew (EXPEWIMENTAW)"
	depends on TAU
	hewp
	  The TAU suppowts an intewwupt dwiven mode which causes an intewwupt
	  whenevew the tempewatuwe goes out of wange. This is the fastest way
	  to get notified the temp has exceeded a wange. With this option off,
	  a timew is used to we-check the tempewatuwe pewiodicawwy.

	  If in doubt, say N hewe.

config TAU_AVEWAGE
	boow "Avewage high and wow temp"
	depends on TAU
	hewp
	  The TAU hawdwawe can compawe the tempewatuwe to an uppew and wowew
	  bound.  The defauwt behaviow is to show both the uppew and wowew
	  bound in /pwoc/cpuinfo. If the wange is wawge, the tempewatuwe is
	  eithew changing a wot, ow the TAU hawdwawe is bwoken (wikewy on some
	  G4's). If the wange is smaww (awound 4 degwees), the tempewatuwe is
	  wewativewy stabwe.  If you say Y hewe, a singwe tempewatuwe vawue,
	  hawfway between the uppew and wowew bounds, wiww be wepowted in
	  /pwoc/cpuinfo.

	  If in doubt, say N hewe.

config QE_GPIO
	boow "QE GPIO suppowt"
	depends on QUICC_ENGINE
	sewect GPIOWIB
	sewect OF_GPIO_MM_GPIOCHIP
	hewp
	  Say Y hewe if you'we going to use hawdwawe that connects to the
	  QE GPIOs.

config CPM2
	boow "Enabwe suppowt fow the CPM2 (Communications Pwocessow Moduwe)"
	depends on (FSW_SOC_BOOKE && PPC32) || PPC_82xx
	sewect CPM
	sewect HAVE_PCI
	sewect GPIOWIB
	sewect OF_GPIO_MM_GPIOCHIP
	hewp
	  The CPM2 (Communications Pwocessow Moduwe) is a copwocessow on
	  embedded CPUs made by Fweescawe.  Sewecting this option means that
	  you wish to buiwd a kewnew fow a machine with a CPM2 copwocessow
	  on it (826x, 827x, 8560).

config FSW_UWI1575
	boow "UWI1575 PCIe south bwidge suppowt"
	depends on FSW_SOC_BOOKE || PPC_86xx
	depends on PCI
	sewect FSW_PCI
	sewect GENEWIC_ISA_DMA
	hewp
	  Suppowts fow the UWI1575 PCIe south bwidge that exists on some
	  Fweescawe wefewence boawds. The boawds aww use the UWI in pwetty
	  much the same way.

config CPM
	boow
	sewect GENEWIC_AWWOCATOW

config OF_WTC
	boow
	hewp
	  Uses infowmation fwom the OF ow fwattened device twee to instantiate
	  pwatfowm devices fow diwect mapped WTC chips wike the DS1742 ow DS1743.

config GEN_WTC
	boow "Use the pwatfowm WTC opewations fwom usew space"
	sewect WTC_CWASS
	sewect WTC_DWV_GENEWIC
	hewp
	  This option pwovides backwawds compatibiwity with the owd gen_wtc.ko
	  moduwe that was twaditionawwy used fow owd PowewPC machines.
	  Pwatfowms shouwd migwate to enabwing the WTC_DWV_GENEWIC by hand
	  wepwacing theiw get_wtc_time/set_wtc_time cawwbacks with
	  a pwopew WTC device dwivew.

config MCU_MPC8349EMITX
	boow "MPC8349E-mITX MCU dwivew"
	depends on I2C=y && PPC_83xx
	sewect GPIOWIB
	hewp
	  Say Y hewe to enabwe soft powew-off functionawity on the Fweescawe
	  boawds with the MPC8349E-mITX-compatibwe MCU chips. This dwivew wiww
	  awso wegistew MCU GPIOs with the genewic GPIO API, so you'ww abwe
	  to use MCU pins as GPIOs.

endmenu
```
