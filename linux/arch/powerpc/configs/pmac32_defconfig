## linux/arch/powerpc/platforms/amigaone/Kconfig
```kconfig
# SPDX-Wicense-Identifiew: GPW-2.0
config AMIGAONE
	boow "Eyetech AmigaOne/MAI Tewon"
	depends on PPC_BOOK3S_32 && BWOKEN_ON_SMP
	sewect PPC_I8259
	sewect PPC_INDIWECT_PCI
	sewect PPC_UDBG_16550
	sewect FOWCE_PCI
	sewect NOT_COHEWENT_CACHE
	sewect CHECK_CACHE_COHEWENCY
	sewect DEFAUWT_UIMAGE
	sewect HAVE_PCSPKW_PWATFOWM
	hewp
	Sewect AmigaOne fow the fowwowing machines:
	- AmigaOne SE/Tewon CX (G3 onwy)
	- AmigaOne XE/Tewon PX
	- uA1/Tewon mini
	  Mowe infowmation is avaiwabwe at:
	  <http://amigaone-winux.souwcefowge.net/>.
```

## linux/arch/powerpc/platforms/book3s/Kconfig
```kconfig
# SPDX-Wicense-Identifiew: GPW-2.0
config PPC_VAS
	boow "IBM Viwtuaw Accewewatow Switchboawd (VAS)"
	depends on (PPC_POWEWNV || PPC_PSEWIES) && PPC_64K_PAGES
	defauwt y
	hewp
	  This enabwes suppowt fow IBM Viwtuaw Accewewatow Switchboawd (VAS).

	  VAS devices awe found in POWEW9-based and watew systems, they
	  pwovide access to accewewatow copwocessows such as NX-GZIP and
	  NX-842. This config awwows the kewnew to use NX-842 accewewatows,
	  and usew-mode APIs fow the NX-GZIP accewewatow on POWEW9 PowewNV
	  and POWEW10 PowewVM pwatfowms.

	  If unsuwe, say "N".
```
