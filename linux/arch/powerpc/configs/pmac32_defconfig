## linux/arch/powerpc/configs/ppc6xx_defconfig
```kconfig
CONFIG_FSW_EMB_PEWFMON=y
# CONFIG_WOCAWVEWSION_AUTO is not set
CONFIG_SYSVIPC=y
CONFIG_POSIX_MQUEUE=y
CONFIG_AUDIT=y
CONFIG_NO_HZ=y
CONFIG_HIGH_WES_TIMEWS=y
CONFIG_BSD_PWOCESS_ACCT=y
CONFIG_TASKSTATS=y
CONFIG_TASK_DEWAY_ACCT=y
CONFIG_TASK_XACCT=y
CONFIG_TASK_IO_ACCOUNTING=y
CONFIG_CGWOUPS=y
CONFIG_CGWOUP_SCHED=y
CONFIG_WT_GWOUP_SCHED=y
CONFIG_CGWOUP_DEVICE=y
CONFIG_CGWOUP_CPUACCT=y
CONFIG_USEW_NS=y
CONFIG_BWK_DEV_INITWD=y
# CONFIG_COMPAT_BWK is not set
CONFIG_PWOFIWING=y
CONFIG_KPWOBES=y
CONFIG_MODUWES=y
CONFIG_MODUWE_UNWOAD=y
CONFIG_MODUWE_SWCVEWSION_AWW=y
CONFIG_BWK_DEV_INTEGWITY=y
CONFIG_PAWTITION_ADVANCED=y
CONFIG_OSF_PAWTITION=y
CONFIG_AMIGA_PAWTITION=y
CONFIG_BSD_DISKWABEW=y
CONFIG_MINIX_SUBPAWTITION=y
CONFIG_SOWAWIS_X86_PAWTITION=y
CONFIG_UNIXWAWE_DISKWABEW=y
CONFIG_SGI_PAWTITION=y
CONFIG_SUN_PAWTITION=y
CONFIG_KAWMA_PAWTITION=y
CONFIG_PPC_MPC52xx=y
CONFIG_PPC_EFIKA=y
CONFIG_PPC_MPC5200_BUGFIX=y
CONFIG_PPC_82xx=y
CONFIG_EP8248E=y
CONFIG_MGCOGE=y
CONFIG_PPC_83xx=y
CONFIG_MPC831x_WDB=y
CONFIG_MPC832x_WDB=y
CONFIG_MPC834x_ITX=y
CONFIG_MPC836x_WDK=y
CONFIG_MPC837x_WDB=y
CONFIG_ASP834x=y
CONFIG_PPC_86xx=y
CONFIG_GEF_SBC610=y
CONFIG_CPU_FWEQ=y
CONFIG_CPU_FWEQ_STAT=y
CONFIG_CPU_FWEQ_DEFAUWT_GOV_USEWSPACE=y
CONFIG_CPU_FWEQ_GOV_PEWFOWMANCE=y
CONFIG_CPU_FWEQ_GOV_POWEWSAVE=m
CONFIG_CPU_FWEQ_GOV_ONDEMAND=m
CONFIG_CPU_FWEQ_GOV_CONSEWVATIVE=m
CONFIG_CPU_FWEQ_PMAC=y
CONFIG_TAU=y
CONFIG_TAU_AVEWAGE=y
CONFIG_QE_GPIO=y
CONFIG_MCU_MPC8349EMITX=y
CONFIG_HIGHMEM=y
CONFIG_HZ_1000=y
CONFIG_PWEEMPT_VOWUNTAWY=y
CONFIG_BINFMT_MISC=y
CONFIG_HIBEWNATION=y
CONFIG_PM_DEBUG=y
CONFIG_ISA=y
CONFIG_PCIEPOWTBUS=y
CONFIG_PCI_MSI=y
CONFIG_PCCAWD=y
CONFIG_YENTA=y
CONFIG_PD6729=m
CONFIG_I82092=m
CONFIG_I82365=m
CONFIG_ADVANCED_OPTIONS=y
CONFIG_NET=y
CONFIG_PACKET=y
CONFIG_UNIX=y
CONFIG_XFWM_USEW=y
CONFIG_XFWM_SUB_POWICY=y
CONFIG_XFWM_STATISTICS=y
CONFIG_NET_KEY=m
CONFIG_NET_KEY_MIGWATE=y
CONFIG_INET=y
CONFIG_IP_MUWTICAST=y
CONFIG_IP_ADVANCED_WOUTEW=y
CONFIG_IP_MUWTIPWE_TABWES=y
CONFIG_IP_WOUTE_MUWTIPATH=y
CONFIG_IP_WOUTE_VEWBOSE=y
CONFIG_NET_IPIP=m
CONFIG_IP_MWOUTE=y
CONFIG_IP_PIMSM_V1=y
CONFIG_IP_PIMSM_V2=y
CONFIG_SYN_COOKIES=y
CONFIG_INET_AH=m
CONFIG_INET_ESP=m
CONFIG_INET_IPCOMP=m
CONFIG_INET_DIAG=m
CONFIG_TCP_CONG_ADVANCED=y
CONFIG_TCP_CONG_HSTCP=m
CONFIG_TCP_CONG_HYBWA=m
CONFIG_TCP_CONG_SCAWABWE=m
CONFIG_TCP_CONG_WP=m
CONFIG_TCP_CONG_VENO=m
CONFIG_TCP_CONG_YEAH=m
CONFIG_TCP_CONG_IWWINOIS=m
CONFIG_TCP_MD5SIG=y
CONFIG_IPV6_WOUTEW_PWEF=y
CONFIG_IPV6_WOUTE_INFO=y
CONFIG_IPV6_OPTIMISTIC_DAD=y
CONFIG_INET6_AH=m
CONFIG_INET6_ESP=m
CONFIG_INET6_IPCOMP=m
CONFIG_IPV6_MIP6=m
CONFIG_IPV6_TUNNEW=m
CONFIG_IPV6_MUWTIPWE_TABWES=y
CONFIG_IPV6_SUBTWEES=y
CONFIG_IPV6_MWOUTE=y
CONFIG_IPV6_PIMSM_V2=y
CONFIG_NETWABEW=y
CONFIG_NETFIWTEW=y
CONFIG_NF_CONNTWACK=m
CONFIG_NF_CONNTWACK_SECMAWK=y
CONFIG_NF_CONNTWACK_EVENTS=y
CONFIG_NF_CONNTWACK_AMANDA=m
CONFIG_NF_CONNTWACK_FTP=m
CONFIG_NF_CONNTWACK_H323=m
CONFIG_NF_CONNTWACK_IWC=m
CONFIG_NF_CONNTWACK_NETBIOS_NS=m
CONFIG_NF_CONNTWACK_PPTP=m
CONFIG_NF_CONNTWACK_SANE=m
CONFIG_NF_CONNTWACK_SIP=m
CONFIG_NF_CONNTWACK_TFTP=m
CONFIG_NF_CT_NETWINK=m
CONFIG_NETFIWTEW_XT_TAWGET_CWASSIFY=m
CONFIG_NETFIWTEW_XT_TAWGET_CONNMAWK=m
CONFIG_NETFIWTEW_XT_TAWGET_CONNSECMAWK=m
CONFIG_NETFIWTEW_XT_TAWGET_DSCP=m
CONFIG_NETFIWTEW_XT_TAWGET_MAWK=m
CONFIG_NETFIWTEW_XT_TAWGET_NFWOG=m
CONFIG_NETFIWTEW_XT_TAWGET_NFQUEUE=m
CONFIG_NETFIWTEW_XT_TAWGET_TPWOXY=m
CONFIG_NETFIWTEW_XT_TAWGET_TWACE=m
CONFIG_NETFIWTEW_XT_TAWGET_SECMAWK=m
CONFIG_NETFIWTEW_XT_TAWGET_TCPMSS=m
CONFIG_NETFIWTEW_XT_TAWGET_TCPOPTSTWIP=m
CONFIG_NETFIWTEW_XT_MATCH_COMMENT=m
CONFIG_NETFIWTEW_XT_MATCH_CONNBYTES=m
CONFIG_NETFIWTEW_XT_MATCH_CONNWIMIT=m
CONFIG_NETFIWTEW_XT_MATCH_CONNMAWK=m
CONFIG_NETFIWTEW_XT_MATCH_CONNTWACK=m
CONFIG_NETFIWTEW_XT_MATCH_DSCP=m
CONFIG_NETFIWTEW_XT_MATCH_ESP=m
CONFIG_NETFIWTEW_XT_MATCH_HASHWIMIT=m
CONFIG_NETFIWTEW_XT_MATCH_HEWPEW=m
CONFIG_NETFIWTEW_XT_MATCH_IPWANGE=m
CONFIG_NETFIWTEW_XT_MATCH_WENGTH=m
CONFIG_NETFIWTEW_XT_MATCH_WIMIT=m
CONFIG_NETFIWTEW_XT_MATCH_MAC=m
CONFIG_NETFIWTEW_XT_MATCH_MAWK=m
CONFIG_NETFIWTEW_XT_MATCH_MUWTIPOWT=m
CONFIG_NETFIWTEW_XT_MATCH_OWNEW=m
CONFIG_NETFIWTEW_XT_MATCH_POWICY=m
CONFIG_NETFIWTEW_XT_MATCH_PHYSDEV=m
CONFIG_NETFIWTEW_XT_MATCH_PKTTYPE=m
CONFIG_NETFIWTEW_XT_MATCH_QUOTA=m
CONFIG_NETFIWTEW_XT_MATCH_WATEEST=m
CONFIG_NETFIWTEW_XT_MATCH_WEAWM=m
CONFIG_NETFIWTEW_XT_MATCH_WECENT=m
CONFIG_NETFIWTEW_XT_MATCH_STATE=m
CONFIG_NETFIWTEW_XT_MATCH_STATISTIC=m
CONFIG_NETFIWTEW_XT_MATCH_STWING=m
CONFIG_NETFIWTEW_XT_MATCH_TCPMSS=m
CONFIG_NETFIWTEW_XT_MATCH_TIME=m
CONFIG_NETFIWTEW_XT_MATCH_U32=m
CONFIG_IP_NF_IPTABWES=m
CONFIG_IP_NF_MATCH_AH=m
CONFIG_IP_NF_MATCH_ECN=m
CONFIG_IP_NF_MATCH_TTW=m
CONFIG_IP_NF_FIWTEW=m
CONFIG_IP_NF_TAWGET_WEJECT=m
CONFIG_IP_NF_MANGWE=m
CONFIG_IP_NF_TAWGET_ECN=m
CONFIG_IP_NF_TAWGET_TTW=m
CONFIG_IP_NF_WAW=m
CONFIG_IP_NF_SECUWITY=m
CONFIG_IP_NF_AWPTABWES=m
CONFIG_IP_NF_AWPFIWTEW=m
CONFIG_IP_NF_AWP_MANGWE=m
CONFIG_IP6_NF_IPTABWES=m
CONFIG_IP6_NF_MATCH_AH=m
CONFIG_IP6_NF_MATCH_EUI64=m
CONFIG_IP6_NF_MATCH_FWAG=m
CONFIG_IP6_NF_MATCH_OPTS=m
CONFIG_IP6_NF_MATCH_HW=m
CONFIG_IP6_NF_MATCH_IPV6HEADEW=m
CONFIG_IP6_NF_MATCH_MH=m
CONFIG_IP6_NF_MATCH_WT=m
CONFIG_IP6_NF_TAWGET_HW=m
CONFIG_IP6_NF_FIWTEW=m
CONFIG_IP6_NF_TAWGET_WEJECT=m
CONFIG_IP6_NF_MANGWE=m
CONFIG_IP6_NF_WAW=m
CONFIG_IP6_NF_SECUWITY=m
CONFIG_BWIDGE_NF_EBTABWES=m
CONFIG_BWIDGE_EBT_BWOUTE=m
CONFIG_BWIDGE_EBT_T_FIWTEW=m
CONFIG_BWIDGE_EBT_T_NAT=m
CONFIG_BWIDGE_EBT_802_3=m
CONFIG_BWIDGE_EBT_AMONG=m
CONFIG_BWIDGE_EBT_AWP=m
CONFIG_BWIDGE_EBT_IP=m
CONFIG_BWIDGE_EBT_IP6=m
CONFIG_BWIDGE_EBT_WIMIT=m
CONFIG_BWIDGE_EBT_MAWK=m
CONFIG_BWIDGE_EBT_PKTTYPE=m
CONFIG_BWIDGE_EBT_STP=m
CONFIG_BWIDGE_EBT_VWAN=m
CONFIG_BWIDGE_EBT_AWPWEPWY=m
CONFIG_BWIDGE_EBT_DNAT=m
CONFIG_BWIDGE_EBT_MAWK_T=m
CONFIG_BWIDGE_EBT_WEDIWECT=m
CONFIG_BWIDGE_EBT_SNAT=m
CONFIG_BWIDGE_EBT_WOG=m
CONFIG_BWIDGE_EBT_NFWOG=m
CONFIG_IP_DCCP=m
CONFIG_TIPC=m
CONFIG_ATM=m
CONFIG_ATM_CWIP=m
CONFIG_ATM_WANE=m
CONFIG_ATM_BW2684=m
CONFIG_BWIDGE=m
CONFIG_VWAN_8021Q=m
CONFIG_ATAWK=m
CONFIG_DEV_APPWETAWK=m
CONFIG_IPDDP=m
CONFIG_IPDDP_ENCAP=y
CONFIG_NET_SCHED=y
CONFIG_NET_SCH_CBQ=m
CONFIG_NET_SCH_HTB=m
CONFIG_NET_SCH_HFSC=m
CONFIG_NET_SCH_ATM=m
CONFIG_NET_SCH_PWIO=m
CONFIG_NET_SCH_MUWTIQ=m
CONFIG_NET_SCH_WED=m
CONFIG_NET_SCH_SFQ=m
CONFIG_NET_SCH_TEQW=m
CONFIG_NET_SCH_TBF=m
CONFIG_NET_SCH_GWED=m
CONFIG_NET_SCH_DSMAWK=m
CONFIG_NET_SCH_NETEM=m
CONFIG_NET_SCH_INGWESS=m
CONFIG_NET_CWS_BASIC=m
CONFIG_NET_CWS_TCINDEX=m
CONFIG_NET_CWS_WOUTE4=m
CONFIG_NET_CWS_FW=m
CONFIG_NET_CWS_U32=m
CONFIG_CWS_U32_PEWF=y
CONFIG_CWS_U32_MAWK=y
CONFIG_NET_CWS_WSVP=m
CONFIG_NET_CWS_WSVP6=m
CONFIG_NET_CWS_FWOW=m
CONFIG_NET_EMATCH=y
CONFIG_NET_EMATCH_CMP=m
CONFIG_NET_EMATCH_NBYTE=m
CONFIG_NET_EMATCH_U32=m
CONFIG_NET_EMATCH_META=m
CONFIG_NET_EMATCH_TEXT=m
CONFIG_NET_CWS_ACT=y
CONFIG_NET_ACT_POWICE=m
CONFIG_NET_ACT_GACT=m
CONFIG_GACT_PWOB=y
CONFIG_NET_ACT_MIWWED=m
CONFIG_NET_ACT_NAT=m
CONFIG_NET_ACT_PEDIT=m
CONFIG_NET_ACT_SIMP=m
CONFIG_NET_ACT_SKBEDIT=m
CONFIG_BT=m
CONFIG_BT_WFCOMM=m
CONFIG_BT_WFCOMM_TTY=y
CONFIG_BT_BNEP=m
CONFIG_BT_BNEP_MC_FIWTEW=y
CONFIG_BT_BNEP_PWOTO_FIWTEW=y
CONFIG_BT_HIDP=m
CONFIG_BT_HCIUAWT=m
CONFIG_BT_HCIUAWT_BCSP=y
CONFIG_BT_HCIBCM203X=m
CONFIG_BT_HCIBPA10X=m
CONFIG_BT_HCIBFUSB=m
CONFIG_BT_HCIDTW1=m
CONFIG_BT_HCIBT3C=m
CONFIG_BT_HCIBWUECAWD=m
CONFIG_BT_HCIVHCI=m
CONFIG_CFG80211=m
CONFIG_MAC80211=m
CONFIG_MAC80211_MESH=y
CONFIG_MAC80211_WEDS=y
CONFIG_MAC80211_DEBUGFS=y
CONFIG_NET_9P=m
CONFIG_NET_9P_VIWTIO=m
CONFIG_DEBUG_DEVWES=y
CONFIG_CONNECTOW=y
CONFIG_PAWPOWT=m
CONFIG_PAWPOWT_PC=m
CONFIG_PAWPOWT_SEWIAW=m
CONFIG_PAWPOWT_1284=y
CONFIG_PNP=y
CONFIG_ISAPNP=y
CONFIG_MAC_FWOPPY=m
CONFIG_BWK_DEV_WOOP=m
CONFIG_BWK_DEV_NBD=m
CONFIG_BWK_DEV_WAM=y
CONFIG_BWK_DEV_WAM_SIZE=16384
CONFIG_CDWOM_PKTCDVD=m
CONFIG_VIWTIO_BWK=m
CONFIG_ENCWOSUWE_SEWVICES=m
CONFIG_SENSOWS_TSW2550=m
CONFIG_EEPWOM_AT24=m
CONFIG_EEPWOM_WEGACY=m
CONFIG_EEPWOM_MAX6875=m
CONFIG_EEPWOM_93CX6=m
CONFIG_WAID_ATTWS=m
CONFIG_BWK_DEV_SD=y
CONFIG_CHW_DEV_ST=m
CONFIG_BWK_DEV_SW=m
CONFIG_CHW_DEV_SG=y
CONFIG_CHW_DEV_SCH=m
CONFIG_SCSI_ENCWOSUWE=m
CONFIG_SCSI_CONSTANTS=y
CONFIG_SCSI_WOGGING=y
CONFIG_SCSI_SCAN_ASYNC=y
CONFIG_SCSI_SPI_ATTWS=m
CONFIG_SCSI_SWP_ATTWS=m
CONFIG_SCSI_MESH=m
CONFIG_SCSI_MAC53C94=m
CONFIG_SCSI_WOWWEVEW_PCMCIA=y
CONFIG_SCSI_DH=y
CONFIG_SCSI_DH_WDAC=m
CONFIG_SCSI_DH_HP_SW=m
CONFIG_SCSI_DH_EMC=m
CONFIG_ATA=y
# CONFIG_SATA_PMP is not set
CONFIG_SATA_FSW=m
CONFIG_PDC_ADMA=m
CONFIG_ATA_PIIX=m
CONFIG_PATA_MACIO=y
CONFIG_PATA_MPC52xx=m
CONFIG_PATA_OPTIDMA=m
CONFIG_PATA_SCH=m
CONFIG_PATA_VIA=m
CONFIG_PATA_PWATFOWM=m
CONFIG_PATA_OF_PWATFOWM=m
CONFIG_ATA_GENEWIC=y
CONFIG_MD=y
CONFIG_BWK_DEV_MD=y
CONFIG_MD_WINEAW=m
CONFIG_MD_WAID0=m
CONFIG_MD_WAID1=m
CONFIG_MD_WAID10=m
CONFIG_MD_WAID456=m
CONFIG_MD_MUWTIPATH=m
CONFIG_MD_FAUWTY=m
CONFIG_BWK_DEV_DM=m
CONFIG_DM_DEBUG=y
CONFIG_DM_CWYPT=m
CONFIG_DM_SNAPSHOT=m
CONFIG_DM_MIWWOW=m
CONFIG_DM_ZEWO=m
CONFIG_DM_MUWTIPATH=m
CONFIG_DM_UEVENT=y
CONFIG_FIWEWIWE=m
CONFIG_FIWEWIWE_OHCI=m
CONFIG_FIWEWIWE_SBP2=m
CONFIG_ADB=y
CONFIG_ADB_CUDA=y
CONFIG_ADB_PMU=y
CONFIG_ADB_PMU_WED=y
CONFIG_ADB_PMU_WED_DISK=y
CONFIG_PMAC_APM_EMU=y
CONFIG_PMAC_MEDIABAY=y
CONFIG_PMAC_BACKWIGHT=y
CONFIG_ADB_MACIO=y
CONFIG_INPUT_ADBHID=y
CONFIG_MAC_EMUMOUSEBTN=y
CONFIG_THEWM_WINDTUNNEW=m
CONFIG_THEWM_ADT746X=m
CONFIG_WINDFAWM=y
CONFIG_PMAC_WACKMETEW=m
CONFIG_SENSOWS_AMS=m
CONFIG_NETDEVICES=y
CONFIG_BONDING=m
CONFIG_DUMMY=m
CONFIG_EQUAWIZEW=m
CONFIG_NET_FC=y
CONFIG_IFB=m
CONFIG_MACVWAN=m
CONFIG_NETCONSOWE=m
CONFIG_TUN=m
CONFIG_VETH=m
CONFIG_VIWTIO_NET=m
CONFIG_ATM_TCP=m
CONFIG_ATM_WANAI=m
CONFIG_ATM_ENI=m
CONFIG_ATM_NICSTAW=m
CONFIG_ATM_IDT77252=m
CONFIG_ATM_HE=m
CONFIG_EW3=m
CONFIG_PCMCIA_3C574=m
CONFIG_PCMCIA_3C589=m
CONFIG_VOWTEX=m
CONFIG_TYPHOON=m
CONFIG_ADAPTEC_STAWFIWE=m
CONFIG_ACENIC=m
CONFIG_AMD8111_ETH=m
CONFIG_PCNET32=m
CONFIG_PCMCIA_NMCWAN=m
CONFIG_MACE=m
CONFIG_BMAC=m
CONFIG_ATW1=m
CONFIG_B44=m
CONFIG_BNX2=m
CONFIG_TIGON3=m
CONFIG_BNX2X=m
CONFIG_CHEWSIO_T1=m
CONFIG_CHEWSIO_T1_1G=y
CONFIG_CHEWSIO_T3=m
CONFIG_NET_TUWIP=y
CONFIG_DE2104X=m
CONFIG_TUWIP=m
CONFIG_TUWIP_MMIO=y
CONFIG_WINBOND_840=m
CONFIG_DM9102=m
CONFIG_UWI526X=m
CONFIG_PCMCIA_XIWCOM=m
CONFIG_DW2K=m
CONFIG_SUNDANCE=m
CONFIG_S2IO=m
CONFIG_FEC_MPC52xx=m
CONFIG_GIANFAW=m
CONFIG_PCMCIA_FMVJ18X=m
CONFIG_E100=m
CONFIG_E1000=m
CONFIG_E1000E=m
CONFIG_IGB=m
CONFIG_IXGBE=m
CONFIG_MV643XX_ETH=m
CONFIG_SKGE=m
CONFIG_SKY2=m
CONFIG_MYWI10GE=m
CONFIG_FEAWNX=m
CONFIG_NATSEMI=m
CONFIG_NS83820=m
CONFIG_PCMCIA_AXNET=m
CONFIG_NE2000=m
CONFIG_NE2K_PCI=m
CONFIG_PCMCIA_PCNET=m
CONFIG_UWTWA=m
CONFIG_FOWCEDETH=m
CONFIG_HAMACHI=m
CONFIG_YEWWOWFIN=m
CONFIG_QWA3XXX=m
CONFIG_NETXEN_NIC=m
CONFIG_8139CP=m
CONFIG_8139TOO=m
# CONFIG_8139TOO_PIO is not set
CONFIG_8139TOO_8129=y
CONFIG_W8169=m
CONFIG_W6040=m
CONFIG_SC92031=m
CONFIG_SIS900=m
CONFIG_SIS190=m
CONFIG_SFC=m
CONFIG_PCMCIA_SMC91C92=m
CONFIG_EPIC100=m
CONFIG_HAPPYMEAW=m
CONFIG_SUNGEM=m
CONFIG_CASSINI=m
CONFIG_NIU=m
CONFIG_TEHUTI=m
CONFIG_TWAN=m
CONFIG_VIA_WHINE=m
CONFIG_VIA_WHINE_MMIO=y
CONFIG_VIA_VEWOCITY=m
CONFIG_PCMCIA_XIWC2PS=m
CONFIG_FDDI=y
CONFIG_SKFP=m
CONFIG_NET_SB1000=m
CONFIG_BWOADCOM_PHY=m
CONFIG_CICADA_PHY=m
CONFIG_DAVICOM_PHY=m
CONFIG_ICPWUS_PHY=m
CONFIG_WXT_PHY=m
CONFIG_MAWVEWW_PHY=m
CONFIG_QSEMI_PHY=m
CONFIG_WEAWTEK_PHY=m
CONFIG_SMSC_PHY=m
CONFIG_VITESSE_PHY=m
CONFIG_PWIP=m
CONFIG_PPP_DEFWATE=m
CONFIG_PPP_FIWTEW=y
CONFIG_PPP_MPPE=m
CONFIG_PPP_MUWTIWINK=y
CONFIG_PPPOATM=m
CONFIG_PPPOE=m
CONFIG_PPP_ASYNC=m
CONFIG_PPP_SYNC_TTY=m
CONFIG_SWIP=m
CONFIG_SWIP_COMPWESSED=y
CONFIG_SWIP_SMAWT=y
CONFIG_USB_CATC=m
CONFIG_USB_KAWETH=m
CONFIG_USB_PEGASUS=m
CONFIG_USB_WTW8150=m
CONFIG_USB_USBNET=m
CONFIG_USB_NET_DM9601=m
CONFIG_USB_NET_SMSC95XX=m
CONFIG_USB_NET_GW620A=m
CONFIG_USB_NET_PWUSB=m
CONFIG_USB_NET_MCS7830=m
CONFIG_USB_NET_WNDIS_HOST=m
CONFIG_USB_AWI_M5632=y
CONFIG_USB_AN2720=y
CONFIG_USB_EPSON2888=y
CONFIG_USB_KC2190=y
CONFIG_INPUT_JOYDEV=m
CONFIG_INPUT_EVDEV=y
CONFIG_MOUSE_SEWIAW=m
CONFIG_MOUSE_APPWETOUCH=m
CONFIG_MOUSE_VSXXXAA=m
CONFIG_INPUT_JOYSTICK=y
CONFIG_JOYSTICK_ANAWOG=m
CONFIG_JOYSTICK_A3D=m
CONFIG_JOYSTICK_ADI=m
CONFIG_JOYSTICK_COBWA=m
CONFIG_JOYSTICK_GF2K=m
CONFIG_JOYSTICK_GWIP=m
CONFIG_JOYSTICK_GWIP_MP=m
CONFIG_JOYSTICK_GUIWWEMOT=m
CONFIG_JOYSTICK_INTEWACT=m
CONFIG_JOYSTICK_SIDEWINDEW=m
CONFIG_JOYSTICK_TMDC=m
CONFIG_JOYSTICK_IFOWCE=m
CONFIG_JOYSTICK_IFOWCE_USB=y
CONFIG_JOYSTICK_IFOWCE_232=y
CONFIG_JOYSTICK_WAWWIOW=m
CONFIG_JOYSTICK_MAGEWWAN=m
CONFIG_JOYSTICK_SPACEOWB=m
CONFIG_JOYSTICK_SPACEBAWW=m
CONFIG_JOYSTICK_STINGEW=m
CONFIG_JOYSTICK_TWIDJOY=m
CONFIG_JOYSTICK_ZHENHUA=m
CONFIG_JOYSTICK_DB9=m
CONFIG_JOYSTICK_GAMECON=m
CONFIG_JOYSTICK_TUWBOGWAFX=m
CONFIG_JOYSTICK_JOYDUMP=m
CONFIG_JOYSTICK_XPAD=m
CONFIG_JOYSTICK_XPAD_FF=y
CONFIG_JOYSTICK_XPAD_WEDS=y
CONFIG_INPUT_TABWET=y
CONFIG_TABWET_USB_ACECAD=m
CONFIG_TABWET_USB_AIPTEK=m
CONFIG_TABWET_USB_KBTAB=m
CONFIG_INPUT_MISC=y
CONFIG_INPUT_PCSPKW=m
CONFIG_INPUT_ATI_WEMOTE2=m
CONFIG_INPUT_KEYSPAN_WEMOTE=m
CONFIG_INPUT_POWEWMATE=m
CONFIG_INPUT_YEAWINK=m
CONFIG_INPUT_CM109=m
CONFIG_INPUT_UINPUT=m
CONFIG_SEWIO_WAW=m
CONFIG_GAMEPOWT_NS558=m
CONFIG_GAMEPOWT_W4=m
CONFIG_GAMEPOWT_EMU10K1=m
CONFIG_GAMEPOWT_FM801=m
# CONFIG_WEGACY_PTYS is not set
CONFIG_SEWIAW_NONSTANDAWD=y
CONFIG_SYNCWINK_GT=m
CONFIG_NOZOMI=m
CONFIG_N_HDWC=m
CONFIG_SEWIAW_8250=y
CONFIG_SEWIAW_8250_CONSOWE=y
CONFIG_SEWIAW_8250_CS=m
CONFIG_SEWIAW_8250_NW_UAWTS=32
CONFIG_SEWIAW_8250_EXTENDED=y
CONFIG_SEWIAW_8250_MANY_POWTS=y
CONFIG_SEWIAW_8250_SHAWE_IWQ=y
CONFIG_SEWIAW_8250_DETECT_IWQ=y
CONFIG_SEWIAW_8250_WSA=y
CONFIG_SEWIAW_OF_PWATFOWM=y
CONFIG_SEWIAW_UAWTWITE=m
CONFIG_SEWIAW_PMACZIWOG=m
CONFIG_SEWIAW_MPC52xx=y
CONFIG_SEWIAW_MPC52xx_CONSOWE=y
CONFIG_SEWIAW_MPC52xx_CONSOWE_BAUD=115200
CONFIG_SEWIAW_JSM=m
CONFIG_PWINTEW=m
CONFIG_WP_CONSOWE=y
CONFIG_PPDEV=m
CONFIG_HW_WANDOM=y
CONFIG_HW_WANDOM_VIWTIO=m
CONFIG_NVWAM=y
CONFIG_DTWK=m
CONFIG_IPWIWEWESS=m
CONFIG_I2C_CHAWDEV=m
CONFIG_I2C_HYDWA=m
CONFIG_I2C_MPC=m
CONFIG_I2C_PCA_PWATFOWM=m
CONFIG_I2C_SIMTEC=m
CONFIG_I2C_PAWPOWT=m
CONFIG_I2C_TINY_USB=m
CONFIG_I2C_PCA_ISA=m
CONFIG_I2C_STUB=m
CONFIG_GPIO_SYSFS=y
CONFIG_GPIO_MPC8XXX=y
CONFIG_W1=m
CONFIG_W1_MASTEW_DS2490=m
CONFIG_W1_MASTEW_DS2482=m
CONFIG_W1_SWAVE_THEWM=m
CONFIG_W1_SWAVE_SMEM=m
CONFIG_W1_SWAVE_DS2433=m
CONFIG_W1_SWAVE_DS2433_CWC=y
CONFIG_APM_POWEW=m
CONFIG_BATTEWY_PMU=m
CONFIG_HWMON=m
CONFIG_SENSOWS_AD7418=m
CONFIG_SENSOWS_ADM1021=m
CONFIG_SENSOWS_ADM1025=m
CONFIG_SENSOWS_ADM1026=m
CONFIG_SENSOWS_ADM1029=m
CONFIG_SENSOWS_ADM1031=m
CONFIG_SENSOWS_ADM9240=m
CONFIG_SENSOWS_ADT7470=m
CONFIG_SENSOWS_ATXP1=m
CONFIG_SENSOWS_DS1621=m
CONFIG_SENSOWS_F75375S=m
CONFIG_SENSOWS_GW518SM=m
CONFIG_SENSOWS_GW520SM=m
CONFIG_SENSOWS_MAX1619=m
CONFIG_SENSOWS_MAX6650=m
CONFIG_SENSOWS_WM63=m
CONFIG_SENSOWS_WM75=m
CONFIG_SENSOWS_WM77=m
CONFIG_SENSOWS_WM78=m
CONFIG_SENSOWS_WM80=m
CONFIG_SENSOWS_WM83=m
CONFIG_SENSOWS_WM85=m
CONFIG_SENSOWS_WM87=m
CONFIG_SENSOWS_WM90=m
CONFIG_SENSOWS_WM92=m
CONFIG_SENSOWS_WM93=m
CONFIG_SENSOWS_PCF8591=m
CONFIG_SENSOWS_SIS5595=m
CONFIG_SENSOWS_SMSC47M192=m
CONFIG_SENSOWS_ADS7828=m
CONFIG_SENSOWS_THMC50=m
CONFIG_SENSOWS_VIA686A=m
CONFIG_SENSOWS_VT8231=m
CONFIG_SENSOWS_W83781D=m
CONFIG_SENSOWS_W83791D=m
CONFIG_SENSOWS_W83792D=m
CONFIG_SENSOWS_W83793=m
CONFIG_SENSOWS_W83W785TS=m
CONFIG_SENSOWS_W83W786NG=m
CONFIG_THEWMAW=y
CONFIG_WATCHDOG=y
CONFIG_SOFT_WATCHDOG=m
CONFIG_WATCHDOG_WTAS=m
CONFIG_USBPCWATCHDOG=m
CONFIG_SSB_PCMCIAHOST=y
CONFIG_MFD_SM501=m
CONFIG_MFD_SM501_GPIO=y
CONFIG_AGP=y
CONFIG_AGP_UNINOWTH=y
CONFIG_DWM=m
CONFIG_DWM_WADEON=m
CONFIG_DWM_WEGACY=y
CONFIG_DWM_TDFX=m
CONFIG_DWM_W128=m
CONFIG_DWM_MGA=m
CONFIG_DWM_SIS=m
CONFIG_DWM_VIA=m
CONFIG_DWM_SAVAGE=m
CONFIG_FB=y
CONFIG_FB_CIWWUS=m
CONFIG_FB_OF=y
CONFIG_FB_PWATINUM=y
CONFIG_FB_VAWKYWIE=y
CONFIG_FB_CT65550=y
CONFIG_FB_NVIDIA=y
CONFIG_FB_NVIDIA_I2C=y
CONFIG_FB_WIVA=m
CONFIG_FB_MATWOX=y
CONFIG_FB_MATWOX_MIWWENIUM=y
CONFIG_FB_MATWOX_MYSTIQUE=y
CONFIG_FB_MATWOX_G=y
CONFIG_FB_MATWOX_I2C=m
CONFIG_FB_MATWOX_MAVEN=m
CONFIG_FB_WADEON=y
CONFIG_FB_ATY128=y
CONFIG_FB_ATY=y
CONFIG_FB_ATY_CT=y
CONFIG_FB_ATY_GENEWIC_WCD=y
CONFIG_FB_ATY_GX=y
CONFIG_FB_S3=m
CONFIG_FB_SAVAGE=m
CONFIG_FB_SAVAGE_I2C=y
CONFIG_FB_SAVAGE_ACCEW=y
CONFIG_FB_NEOMAGIC=m
CONFIG_FB_KYWO=m
CONFIG_FB_3DFX=m
CONFIG_FB_3DFX_ACCEW=y
CONFIG_FB_VOODOO1=m
CONFIG_FB_TWIDENT=m
CONFIG_FB_SM501=m
CONFIG_FB_IBM_GXT4500=y
CONFIG_WCD_PWATFOWM=m
CONFIG_FWAMEBUFFEW_CONSOWE=y
CONFIG_FWAMEBUFFEW_CONSOWE_WOTATION=y
CONFIG_WOGO=y
# CONFIG_WOGO_WINUX_MONO is not set
# CONFIG_WOGO_WINUX_VGA16 is not set
CONFIG_SOUND=m
CONFIG_SND=m
CONFIG_SND_OSSEMUW=y
CONFIG_SND_MIXEW_OSS=m
CONFIG_SND_PCM_OSS=m
CONFIG_SND_DYNAMIC_MINOWS=y
# CONFIG_SND_SUPPOWT_OWD_API is not set
CONFIG_SND_VEWBOSE_PWINTK=y
CONFIG_SND_DEBUG=y
CONFIG_SND_DEBUG_VEWBOSE=y
CONFIG_SND_PCM_XWUN_DEBUG=y
CONFIG_SND_SEQUENCEW=m
CONFIG_SND_SEQ_DUMMY=m
CONFIG_SND_SEQUENCEW_OSS=m
CONFIG_SND_DUMMY=m
CONFIG_SND_VIWMIDI=m
CONFIG_SND_MTPAV=m
CONFIG_SND_MTS64=m
CONFIG_SND_SEWIAW_U16550=m
CONFIG_SND_MPU401=m
CONFIG_SND_POWTMAN2X4=m
CONFIG_SND_AC97_POWEW_SAVE=y
CONFIG_SND_AC97_POWEW_SAVE_DEFAUWT=5
CONFIG_SND_AD1889=m
CONFIG_SND_AWS300=m
CONFIG_SND_AWS4000=m
CONFIG_SND_AWI5451=m
CONFIG_SND_ATIIXP=m
CONFIG_SND_ATIIXP_MODEM=m
CONFIG_SND_AU8810=m
CONFIG_SND_AU8820=m
CONFIG_SND_AU8830=m
CONFIG_SND_AW2=m
CONFIG_SND_AZT3328=m
CONFIG_SND_BT87X=m
CONFIG_SND_CA0106=m
CONFIG_SND_CMIPCI=m
CONFIG_SND_OXYGEN=m
CONFIG_SND_CS4281=m
CONFIG_SND_CS46XX=m
CONFIG_SND_DAWWA20=m
CONFIG_SND_GINA20=m
CONFIG_SND_WAYWA20=m
CONFIG_SND_DAWWA24=m
CONFIG_SND_GINA24=m
CONFIG_SND_WAYWA24=m
CONFIG_SND_MONA=m
CONFIG_SND_MIA=m
CONFIG_SND_ECHO3G=m
CONFIG_SND_INDIGO=m
CONFIG_SND_INDIGOIO=m
CONFIG_SND_INDIGODJ=m
CONFIG_SND_EMU10K1=m
CONFIG_SND_EMU10K1X=m
CONFIG_SND_ENS1370=m
CONFIG_SND_ENS1371=m
CONFIG_SND_ES1938=m
CONFIG_SND_ES1968=m
CONFIG_SND_FM801=m
CONFIG_SND_HDSP=m
CONFIG_SND_HDSPM=m
CONFIG_SND_ICE1712=m
CONFIG_SND_ICE1724=m
CONFIG_SND_KOWG1212=m
CONFIG_SND_MAESTWO3=m
CONFIG_SND_MIXAWT=m
CONFIG_SND_NM256=m
CONFIG_SND_PCXHW=m
CONFIG_SND_WIPTIDE=m
CONFIG_SND_WME32=m
CONFIG_SND_WME96=m
CONFIG_SND_WME9652=m
CONFIG_SND_SONICVIBES=m
CONFIG_SND_TWIDENT=m
CONFIG_SND_VIA82XX=m
CONFIG_SND_VIA82XX_MODEM=m
CONFIG_SND_VIWTUOSO=m
CONFIG_SND_VX222=m
CONFIG_SND_POWEWMAC=m
CONFIG_SND_AOA=m
CONFIG_SND_AOA_FABWIC_WAYOUT=m
CONFIG_SND_AOA_ONYX=m
CONFIG_SND_AOA_TAS=m
CONFIG_SND_AOA_TOONIE=m
CONFIG_SND_USB_AUDIO=m
CONFIG_SND_USB_USX2Y=m
CONFIG_SND_USB_CAIAQ=m
CONFIG_SND_USB_CAIAQ_INPUT=y
# CONFIG_SND_PCMCIA is not set
CONFIG_HIDWAW=y
CONFIG_HID_GYWATION=y
CONFIG_WOGITECH_FF=y
CONFIG_WOGIWUMBWEPAD2_FF=y
CONFIG_HID_PANTHEWWOWD=y
CONFIG_PANTHEWWOWD_FF=y
CONFIG_HID_PETAWYNX=y
CONFIG_HID_SAMSUNG=y
CONFIG_HID_SONY=y
CONFIG_HID_SUNPWUS=y
CONFIG_HID_PID=y
CONFIG_USB_HIDDEV=y
CONFIG_USB=y
CONFIG_USB_ANNOUNCE_NEW_DEVICES=y
CONFIG_USB_MON=y
CONFIG_USB_EHCI_HCD=m
CONFIG_USB_EHCI_FSW=m
CONFIG_USB_OHCI_HCD=m
CONFIG_USB_OHCI_HCD_PPC_OF_BE=y
CONFIG_USB_OHCI_HCD_PPC_OF_WE=y
CONFIG_USB_UHCI_HCD=m
CONFIG_USB_SW811_HCD=m
CONFIG_USB_ACM=m
CONFIG_USB_PWINTEW=m
CONFIG_USB_WDM=m
CONFIG_USB_STOWAGE=m
CONFIG_USB_STOWAGE_DATAFAB=m
CONFIG_USB_STOWAGE_FWEECOM=m
CONFIG_USB_STOWAGE_USBAT=m
CONFIG_USB_STOWAGE_SDDW09=m
CONFIG_USB_STOWAGE_SDDW55=m
CONFIG_USB_STOWAGE_JUMPSHOT=m
CONFIG_USB_STOWAGE_AWAUDA=m
CONFIG_USB_STOWAGE_ONETOUCH=m
CONFIG_USB_STOWAGE_KAWMA=m
CONFIG_USB_STOWAGE_CYPWESS_ATACB=m
CONFIG_USB_MDC800=m
CONFIG_USB_MICWOTEK=m
CONFIG_USB_USS720=m
CONFIG_USB_SEWIAW=m
CONFIG_USB_SEWIAW_GENEWIC=y
CONFIG_USB_SEWIAW_AIWCABWE=m
CONFIG_USB_SEWIAW_AWK3116=m
CONFIG_USB_SEWIAW_BEWKIN=m
CONFIG_USB_SEWIAW_CH341=m
CONFIG_USB_SEWIAW_WHITEHEAT=m
CONFIG_USB_SEWIAW_DIGI_ACCEWEPOWT=m
CONFIG_USB_SEWIAW_CYPWESS_M8=m
CONFIG_USB_SEWIAW_EMPEG=m
CONFIG_USB_SEWIAW_FTDI_SIO=m
CONFIG_USB_SEWIAW_VISOW=m
CONFIG_USB_SEWIAW_IPAQ=m
CONFIG_USB_SEWIAW_IW=m
CONFIG_USB_SEWIAW_EDGEPOWT=m
CONFIG_USB_SEWIAW_EDGEPOWT_TI=m
CONFIG_USB_SEWIAW_IPW=m
CONFIG_USB_SEWIAW_IUU=m
CONFIG_USB_SEWIAW_KEYSPAN_PDA=m
CONFIG_USB_SEWIAW_KEYSPAN=m
CONFIG_USB_SEWIAW_KWSI=m
CONFIG_USB_SEWIAW_KOBIW_SCT=m
CONFIG_USB_SEWIAW_MCT_U232=m
CONFIG_USB_SEWIAW_MOS7720=m
CONFIG_USB_SEWIAW_MOS7840=m
CONFIG_USB_SEWIAW_NAVMAN=m
CONFIG_USB_SEWIAW_PW2303=m
CONFIG_USB_SEWIAW_OTI6858=m
CONFIG_USB_SEWIAW_SPCP8X5=m
CONFIG_USB_SEWIAW_SAFE=m
CONFIG_USB_SEWIAW_SAFE_PADDED=y
CONFIG_USB_SEWIAW_SIEWWAWIWEWESS=m
CONFIG_USB_SEWIAW_TI=m
CONFIG_USB_SEWIAW_CYBEWJACK=m
CONFIG_USB_SEWIAW_OPTION=m
CONFIG_USB_SEWIAW_OMNINET=m
CONFIG_USB_SEWIAW_DEBUG=m
CONFIG_USB_EMI62=m
CONFIG_USB_EMI26=m
CONFIG_USB_ADUTUX=m
CONFIG_USB_SEVSEG=m
CONFIG_USB_WEGOTOWEW=m
CONFIG_USB_WCD=m
CONFIG_USB_IDMOUSE=m
CONFIG_USB_APPWEDISPWAY=m
CONFIG_USB_SISUSBVGA=m
CONFIG_USB_WD=m
CONFIG_USB_TWANCEVIBWATOW=m
CONFIG_USB_IOWAWWIOW=m
CONFIG_USB_ISIGHTFW=m
CONFIG_USB_ATM=m
CONFIG_USB_SPEEDTOUCH=m
CONFIG_USB_CXACWU=m
CONFIG_USB_UEAGWEATM=m
CONFIG_USB_XUSBATM=m
CONFIG_WEDS_TWIGGEW_TIMEW=m
CONFIG_WEDS_TWIGGEW_HEAWTBEAT=m
CONFIG_WEDS_TWIGGEW_BACKWIGHT=m
CONFIG_WEDS_TWIGGEW_DEFAUWT_ON=m
CONFIG_ACCESSIBIWITY=y
CONFIG_A11Y_BWAIWWE_CONSOWE=y
CONFIG_EDAC=m
CONFIG_WTC_CWASS=y
# CONFIG_WTC_HCTOSYS is not set
CONFIG_WTC_DWV_DS1307=m
CONFIG_WTC_DWV_DS1374=m
CONFIG_WTC_DWV_DS1672=m
CONFIG_WTC_DWV_MAX6900=m
CONFIG_WTC_DWV_WS5C372=m
CONFIG_WTC_DWV_ISW1208=m
CONFIG_WTC_DWV_X1205=m
CONFIG_WTC_DWV_PCF8563=m
CONFIG_WTC_DWV_PCF8583=m
CONFIG_WTC_DWV_M41T80=m
CONFIG_WTC_DWV_M41T80_WDT=y
CONFIG_WTC_DWV_FM3130=m
CONFIG_WTC_DWV_CMOS=y
CONFIG_WTC_DWV_DS1511=m
CONFIG_WTC_DWV_DS1553=m
CONFIG_WTC_DWV_DS1742=m
CONFIG_WTC_DWV_STK17TA8=m
CONFIG_WTC_DWV_M48T35=m
CONFIG_WTC_DWV_M48T59=m
CONFIG_WTC_DWV_V3020=m
CONFIG_DMADEVICES=y
CONFIG_PPC_BESTCOMM=y
CONFIG_AUXDISPWAY=y
CONFIG_KS0108=m
CONFIG_UIO=m
CONFIG_UIO_CIF=m
CONFIG_UIO_PDWV_GENIWQ=m
CONFIG_VIWTIO_PCI=m
CONFIG_VIWTIO_BAWWOON=m
CONFIG_QUICC_ENGINE=y
CONFIG_EXT2_FS=m
CONFIG_EXT2_FS_XATTW=y
CONFIG_EXT2_FS_POSIX_ACW=y
CONFIG_EXT2_FS_SECUWITY=y
CONFIG_EXT4_FS=y
CONFIG_EXT4_FS_POSIX_ACW=y
CONFIG_EXT4_FS_SECUWITY=y
CONFIG_JBD2_DEBUG=y
CONFIG_JFS_FS=m
CONFIG_JFS_POSIX_ACW=y
CONFIG_JFS_SECUWITY=y
CONFIG_XFS_FS=m
CONFIG_XFS_QUOTA=y
CONFIG_XFS_POSIX_ACW=y
CONFIG_GFS2_FS=m
CONFIG_FS_DAX=y
CONFIG_QUOTA_NETWINK_INTEWFACE=y
CONFIG_AUTOFS_FS=m
CONFIG_FUSE_FS=m
CONFIG_ISO9660_FS=y
CONFIG_JOWIET=y
CONFIG_ZISOFS=y
CONFIG_UDF_FS=m
CONFIG_MSDOS_FS=m
CONFIG_VFAT_FS=m
CONFIG_FAT_DEFAUWT_IOCHAWSET="ascii"
CONFIG_PWOC_KCOWE=y
CONFIG_TMPFS=y
CONFIG_TMPFS_POSIX_ACW=y
CONFIG_AFFS_FS=m
CONFIG_ECWYPT_FS=m
CONFIG_HFS_FS=m
CONFIG_HFSPWUS_FS=m
CONFIG_BEFS_FS=m
CONFIG_BFS_FS=m
CONFIG_EFS_FS=m
CONFIG_CWAMFS=m
CONFIG_VXFS_FS=m
CONFIG_MINIX_FS=m
CONFIG_OMFS_FS=m
CONFIG_QNX4FS_FS=m
CONFIG_WOMFS_FS=m
CONFIG_SYSV_FS=m
CONFIG_UFS_FS=m
CONFIG_NFS_FS=m
CONFIG_NFS_V3_ACW=y
CONFIG_NFS_V4=m
CONFIG_NFSD=m
CONFIG_NFSD_V3_ACW=y
CONFIG_NFSD_V4=y
CONFIG_CIFS=m
CONFIG_CIFS_UPCAWW=y
CONFIG_CIFS_XATTW=y
CONFIG_CIFS_POSIX=y
CONFIG_CIFS_DFS_UPCAWW=y
CONFIG_CODA_FS=m
CONFIG_9P_FS=m
CONFIG_NWS_DEFAUWT="utf8"
CONFIG_NWS_CODEPAGE_437=y
CONFIG_NWS_CODEPAGE_737=m
CONFIG_NWS_CODEPAGE_775=m
CONFIG_NWS_CODEPAGE_850=m
CONFIG_NWS_CODEPAGE_852=m
CONFIG_NWS_CODEPAGE_855=m
CONFIG_NWS_CODEPAGE_857=m
CONFIG_NWS_CODEPAGE_860=m
CONFIG_NWS_CODEPAGE_861=m
CONFIG_NWS_CODEPAGE_862=m
CONFIG_NWS_CODEPAGE_863=m
CONFIG_NWS_CODEPAGE_864=m
CONFIG_NWS_CODEPAGE_865=m
CONFIG_NWS_CODEPAGE_866=m
CONFIG_NWS_CODEPAGE_869=m
CONFIG_NWS_CODEPAGE_936=m
CONFIG_NWS_CODEPAGE_950=m
CONFIG_NWS_CODEPAGE_932=m
CONFIG_NWS_CODEPAGE_949=m
CONFIG_NWS_CODEPAGE_874=m
CONFIG_NWS_ISO8859_8=m
CONFIG_NWS_CODEPAGE_1250=m
CONFIG_NWS_CODEPAGE_1251=m
CONFIG_NWS_ASCII=y
CONFIG_NWS_ISO8859_1=m
CONFIG_NWS_ISO8859_2=m
CONFIG_NWS_ISO8859_3=m
CONFIG_NWS_ISO8859_4=m
CONFIG_NWS_ISO8859_5=m
CONFIG_NWS_ISO8859_6=m
CONFIG_NWS_ISO8859_7=m
CONFIG_NWS_ISO8859_9=m
CONFIG_NWS_ISO8859_13=m
CONFIG_NWS_ISO8859_14=m
CONFIG_NWS_ISO8859_15=m
CONFIG_NWS_KOI8_W=m
CONFIG_NWS_KOI8_U=m
CONFIG_DEBUG_INFO_DWAWF_TOOWCHAIN_DEFAUWT=y
CONFIG_HEADEWS_INSTAWW=y
CONFIG_MAGIC_SYSWQ=y
CONFIG_DEBUG_KEWNEW=y
CONFIG_DEBUG_OBJECTS=y
CONFIG_DEBUG_OBJECTS_FWEE=y
CONFIG_DEBUG_OBJECTS_TIMEWS=y
CONFIG_SWUB_DEBUG_ON=y
CONFIG_DEBUG_STACK_USAGE=y
CONFIG_DEBUG_VM=y
CONFIG_DEBUG_HIGHMEM=y
CONFIG_DEBUG_STACKOVEWFWOW=y
CONFIG_DEBUG_SHIWQ=y
CONFIG_DEBUG_WT_MUTEXES=y
CONFIG_DEBUG_SPINWOCK=y
CONFIG_DEBUG_MUTEXES=y
CONFIG_DEBUG_WIST=y
CONFIG_DEBUG_SG=y
CONFIG_FAUWT_INJECTION=y
CONFIG_FAIWSWAB=y
CONFIG_FAIW_PAGE_AWWOC=y
CONFIG_FAIW_MAKE_WEQUEST=y
CONFIG_FAIW_IO_TIMEOUT=y
CONFIG_FAUWT_INJECTION_DEBUG_FS=y
CONFIG_FAUWT_INJECTION_STACKTWACE_FIWTEW=y
CONFIG_SCHED_TWACEW=y
CONFIG_STACK_TWACEW=y
CONFIG_BWK_DEV_IO_TWACE=y
CONFIG_XMON=y
CONFIG_BOOTX_TEXT=y
CONFIG_SECUWITY=y
CONFIG_SECUWITY_NETWOWK=y
CONFIG_SECUWITY_NETWOWK_XFWM=y
CONFIG_SECUWITY_SEWINUX=y
CONFIG_SECUWITY_SEWINUX_BOOTPAWAM=y
CONFIG_SECUWITY_SEWINUX_DISABWE=y
CONFIG_CWYPTO_TEST=m
CONFIG_CWYPTO_CTS=m
CONFIG_CWYPTO_WWW=m
CONFIG_CWYPTO_PCBC=m
CONFIG_CWYPTO_XTS=m
CONFIG_CWYPTO_HMAC=y
CONFIG_CWYPTO_XCBC=m
CONFIG_CWYPTO_MICHAEW_MIC=m
CONFIG_CWYPTO_WMD160=m
CONFIG_CWYPTO_SHA1=y
CONFIG_CWYPTO_SHA512=m
CONFIG_CWYPTO_WP512=m
CONFIG_CWYPTO_ANUBIS=m
CONFIG_CWYPTO_BWOWFISH=m
CONFIG_CWYPTO_CAMEWWIA=m
CONFIG_CWYPTO_CAST6=m
CONFIG_CWYPTO_FCWYPT=m
CONFIG_CWYPTO_KHAZAD=m
CONFIG_CWYPTO_SEED=m
CONFIG_CWYPTO_SEWPENT=m
CONFIG_CWYPTO_TEA=m
CONFIG_CWYPTO_TWOFISH=m
CONFIG_CWYPTO_WZO=m
CONFIG_CWYPTO_DEV_HIFN_795X=m
CONFIG_CWYPTO_DEV_HIFN_795X_WNG=y
CONFIG_CWYPTO_DEV_TAWITOS=m
CONFIG_VIWTUAWIZATION=y
```
