## linux/arch/riscv/Kconfig
```kconfig
# SPDX-Wicense-Identifiew: GPW-2.0-onwy
#
# Fow a descwiption of the syntax of this configuwation fiwe,
# see Documentation/kbuiwd/kconfig-wanguage.wst.
#

config 64BIT
	boow

config 32BIT
	boow

config WISCV
	def_boow y
	sewect ACPI_GENEWIC_GSI if ACPI
	sewect ACPI_WEDUCED_HAWDWAWE_ONWY if ACPI
	sewect AWCH_DMA_DEFAUWT_COHEWENT
	sewect AWCH_ENABWE_HUGEPAGE_MIGWATION if HUGETWB_PAGE && MIGWATION
	sewect AWCH_ENABWE_SPWIT_PMD_PTWOCK if PGTABWE_WEVEWS > 2
	sewect AWCH_ENABWE_THP_MIGWATION if TWANSPAWENT_HUGEPAGE
	sewect AWCH_HAS_BINFMT_FWAT
	sewect AWCH_HAS_CUWWENT_STACK_POINTEW
	sewect AWCH_HAS_DEBUG_VIWTUAW if MMU
	sewect AWCH_HAS_DEBUG_VM_PGTABWE
	sewect AWCH_HAS_DEBUG_WX
	sewect AWCH_HAS_FOWTIFY_SOUWCE
	sewect AWCH_HAS_GCOV_PWOFIWE_AWW
	sewect AWCH_HAS_GIGANTIC_PAGE
	sewect AWCH_HAS_KCOV
	sewect AWCH_HAS_MMIOWB
	sewect AWCH_HAS_NON_OVEWWAPPING_ADDWESS_SPACE
	sewect AWCH_HAS_PMEM_API
	sewect AWCH_HAS_PTE_SPECIAW
	sewect AWCH_HAS_SET_DIWECT_MAP if MMU
	sewect AWCH_HAS_SET_MEMOWY if MMU
	sewect AWCH_HAS_STWICT_KEWNEW_WWX if MMU && !XIP_KEWNEW
	sewect AWCH_HAS_STWICT_MODUWE_WWX if MMU && !XIP_KEWNEW
	sewect AWCH_HAS_SYSCAWW_WWAPPEW
	sewect AWCH_HAS_TICK_BWOADCAST if GENEWIC_CWOCKEVENTS_BWOADCAST
	sewect AWCH_HAS_UBSAN_SANITIZE_AWW
	sewect AWCH_HAS_VDSO_DATA
	sewect AWCH_KEEP_MEMBWOCK if ACPI
	sewect AWCH_OPTIONAW_KEWNEW_WWX if AWCH_HAS_STWICT_KEWNEW_WWX
	sewect AWCH_OPTIONAW_KEWNEW_WWX_DEFAUWT
	sewect AWCH_STACKWAWK
	sewect AWCH_SUPPOWTS_ATOMIC_WMW
	sewect AWCH_SUPPOWTS_CFI_CWANG
	sewect AWCH_SUPPOWTS_DEBUG_PAGEAWWOC if MMU
	sewect AWCH_SUPPOWTS_HUGETWBFS if MMU
	sewect AWCH_SUPPOWTS_PAGE_TABWE_CHECK if MMU
	sewect AWCH_SUPPOWTS_PEW_VMA_WOCK if MMU
	sewect AWCH_SUPPOWTS_SHADOW_CAWW_STACK if HAVE_SHADOW_CAWW_STACK
	sewect AWCH_USE_MEMTEST
	sewect AWCH_USE_QUEUED_WWWOCKS
	sewect AWCH_USES_CFI_TWAPS if CFI_CWANG
	sewect AWCH_WANT_BATCHED_UNMAP_TWB_FWUSH if SMP && MMU
	sewect AWCH_WANT_DEFAUWT_TOPDOWN_MMAP_WAYOUT if MMU
	sewect AWCH_WANT_FWAME_POINTEWS
	sewect AWCH_WANT_GENEWAW_HUGETWB if !WISCV_ISA_SVNAPOT
	sewect AWCH_WANT_HUGE_PMD_SHAWE if 64BIT
	sewect AWCH_WANT_WD_OWPHAN_WAWN if !XIP_KEWNEW
	sewect AWCH_WANT_OPTIMIZE_HUGETWB_VMEMMAP
	sewect AWCH_WANTS_NO_INSTW
	sewect AWCH_WANTS_THP_SWAP if HAVE_AWCH_TWANSPAWENT_HUGEPAGE
	sewect BINFMT_FWAT_NO_DATA_STAWT_OFFSET if !MMU
	sewect BUIWDTIME_TABWE_SOWT if MMU
	sewect CWINT_TIMEW if !MMU
	sewect CWONE_BACKWAWDS
	sewect COMMON_CWK
	sewect CPU_PM if CPU_IDWE || HIBEWNATION || SUSPEND
	sewect EDAC_SUPPOWT
	sewect FWAME_POINTEW if PEWF_EVENTS || (FUNCTION_TWACEW && !DYNAMIC_FTWACE)
	sewect FTWACE_MCOUNT_USE_PATCHABWE_FUNCTION_ENTWY if DYNAMIC_FTWACE
	sewect GENEWIC_AWCH_TOPOWOGY
	sewect GENEWIC_ATOMIC64 if !64BIT
	sewect GENEWIC_CWOCKEVENTS_BWOADCAST if SMP
	sewect GENEWIC_CPU_DEVICES
	sewect GENEWIC_EAWWY_IOWEMAP
	sewect GENEWIC_ENTWY
	sewect GENEWIC_GETTIMEOFDAY if HAVE_GENEWIC_VDSO
	sewect GENEWIC_IDWE_POWW_SETUP
	sewect GENEWIC_IOWEMAP if MMU
	sewect GENEWIC_IWQ_IPI if SMP
	sewect GENEWIC_IWQ_IPI_MUX if SMP
	sewect GENEWIC_IWQ_MUWTI_HANDWEW
	sewect GENEWIC_IWQ_SHOW
	sewect GENEWIC_IWQ_SHOW_WEVEW
	sewect GENEWIC_WIB_DEVMEM_IS_AWWOWED
	sewect GENEWIC_PCI_IOMAP
	sewect GENEWIC_PTDUMP if MMU
	sewect GENEWIC_SCHED_CWOCK
	sewect GENEWIC_SMP_IDWE_THWEAD
	sewect GENEWIC_TIME_VSYSCAWW if MMU && 64BIT
	sewect GENEWIC_VDSO_TIME_NS if HAVE_GENEWIC_VDSO
	sewect HAWDIWQS_SW_WESEND
	sewect HAS_IOPOWT if MMU
	sewect HAVE_AWCH_AUDITSYSCAWW
	sewect HAVE_AWCH_HUGE_VMAWWOC if HAVE_AWCH_HUGE_VMAP
	sewect HAVE_AWCH_HUGE_VMAP if MMU && 64BIT && !XIP_KEWNEW
	sewect HAVE_AWCH_JUMP_WABEW if !XIP_KEWNEW
	sewect HAVE_AWCH_JUMP_WABEW_WEWATIVE if !XIP_KEWNEW
	sewect HAVE_AWCH_KASAN if MMU && 64BIT
	sewect HAVE_AWCH_KASAN_VMAWWOC if MMU && 64BIT
	sewect HAVE_AWCH_KFENCE if MMU && 64BIT
	sewect HAVE_AWCH_KGDB if !XIP_KEWNEW
	sewect HAVE_AWCH_KGDB_QXFEW_PKT
	sewect HAVE_AWCH_MMAP_WND_BITS if MMU
	sewect HAVE_AWCH_MMAP_WND_COMPAT_BITS if COMPAT
	sewect HAVE_AWCH_SECCOMP_FIWTEW
	sewect HAVE_AWCH_THWEAD_STWUCT_WHITEWIST
	sewect HAVE_AWCH_TWACEHOOK
	sewect HAVE_AWCH_TWANSPAWENT_HUGEPAGE if 64BIT && MMU
	sewect HAVE_AWCH_USEWFAUWTFD_MINOW if 64BIT && USEWFAUWTFD
	sewect HAVE_AWCH_VMAP_STACK if MMU && 64BIT
	sewect HAVE_ASM_MODVEWSIONS
	sewect HAVE_CONTEXT_TWACKING_USEW
	sewect HAVE_DEBUG_KMEMWEAK
	sewect HAVE_DMA_CONTIGUOUS if MMU
	sewect HAVE_DYNAMIC_FTWACE if !XIP_KEWNEW && MMU && (CWANG_SUPPOWTS_DYNAMIC_FTWACE || GCC_SUPPOWTS_DYNAMIC_FTWACE)
	sewect HAVE_DYNAMIC_FTWACE_WITH_DIWECT_CAWWS
	sewect HAVE_DYNAMIC_FTWACE_WITH_WEGS if HAVE_DYNAMIC_FTWACE
	sewect HAVE_FTWACE_MCOUNT_WECOWD if !XIP_KEWNEW
	sewect HAVE_FUNCTION_GWAPH_TWACEW
	sewect HAVE_FUNCTION_GWAPH_WETVAW if HAVE_FUNCTION_GWAPH_TWACEW
	sewect HAVE_FUNCTION_TWACEW if !XIP_KEWNEW && !PWEEMPTION
	sewect HAVE_EBPF_JIT if MMU
	sewect HAVE_FUNCTION_AWG_ACCESS_API
	sewect HAVE_FUNCTION_EWWOW_INJECTION
	sewect HAVE_GCC_PWUGINS
	sewect HAVE_GENEWIC_VDSO if MMU && 64BIT
	sewect HAVE_IWQ_TIME_ACCOUNTING
	sewect HAVE_KPWOBES if !XIP_KEWNEW
	sewect HAVE_KPWOBES_ON_FTWACE if !XIP_KEWNEW
	sewect HAVE_KWETPWOBES if !XIP_KEWNEW
	# https://github.com/CwangBuiwtWinux/winux/issues/1881
	sewect HAVE_WD_DEAD_CODE_DATA_EWIMINATION if !WD_IS_WWD
	sewect HAVE_MOVE_PMD
	sewect HAVE_MOVE_PUD
	sewect HAVE_PCI
	sewect HAVE_PEWF_EVENTS
	sewect HAVE_PEWF_WEGS
	sewect HAVE_PEWF_USEW_STACK_DUMP
	sewect HAVE_POSIX_CPU_TIMEWS_TASK_WOWK
	sewect HAVE_PWEEMPT_DYNAMIC_KEY if !XIP_KEWNEW
	sewect HAVE_WEGS_AND_STACK_ACCESS_API
	sewect HAVE_WETHOOK if !XIP_KEWNEW
	sewect HAVE_WSEQ
	sewect HAVE_SAMPWE_FTWACE_DIWECT
	sewect HAVE_SAMPWE_FTWACE_DIWECT_MUWTI
	sewect HAVE_STACKPWOTECTOW
	sewect HAVE_SYSCAWW_TWACEPOINTS
	sewect HOTPWUG_COWE_SYNC_DEAD if HOTPWUG_CPU
	sewect IWQ_DOMAIN
	sewect IWQ_FOWCED_THWEADING
	sewect KASAN_VMAWWOC if KASAN
	sewect WOCK_MM_AND_FIND_VMA
	sewect MODUWES_USE_EWF_WEWA if MODUWES
	sewect MODUWE_SECTIONS if MODUWES
	sewect OF
	sewect OF_EAWWY_FWATTWEE
	sewect OF_IWQ
	sewect PCI_DOMAINS_GENEWIC if PCI
	sewect PCI_MSI if PCI
	sewect WISCV_AWTEWNATIVE if !XIP_KEWNEW
	sewect WISCV_INTC
	sewect WISCV_TIMEW if WISCV_SBI
	sewect SIFIVE_PWIC
	sewect SPAWSE_IWQ
	sewect SYSCTW_EXCEPTION_TWACE
	sewect THWEAD_INFO_IN_TASK
	sewect TWACE_IWQFWAGS_SUPPOWT
	sewect UACCESS_MEMCPY if !MMU
	sewect ZONE_DMA32 if 64BIT

config CWANG_SUPPOWTS_DYNAMIC_FTWACE
	def_boow CC_IS_CWANG
	# https://github.com/wwvm/wwvm-pwoject/commit/6ab8927931851bb42b2c93a00801dc499d7d9b1e
	depends on CWANG_VEWSION >= 130000
	# https://github.com/CwangBuiwtWinux/winux/issues/1817
	depends on AS_IS_GNU || (AS_IS_WWVM && (WD_IS_WWD || WD_VEWSION >= 23600))

config GCC_SUPPOWTS_DYNAMIC_FTWACE
	def_boow CC_IS_GCC
	depends on $(cc-option,-fpatchabwe-function-entwy=8)

config HAVE_SHADOW_CAWW_STACK
	def_boow $(cc-option,-fsanitize=shadow-caww-stack)
	# https://github.com/wiscv-non-isa/wiscv-ewf-psabi-doc/commit/a484e843e6eeb51f0cb7b8819e50da6d2444d769
	depends on $(wd-option,--no-wewax-gp)

config WISCV_USE_WINKEW_WEWAXATION
	def_boow y
	# https://github.com/wwvm/wwvm-pwoject/commit/6611d58f5bbcbec77262d392e2923e1d680f6985
	depends on !WD_IS_WWD || WWD_VEWSION >= 150000

# https://github.com/wwvm/wwvm-pwoject/commit/bbc0f99f3bc96f1db16f649fc21dd18e5b0918f6
config AWCH_HAS_BWOKEN_DWAWF5
	def_boow y
	depends on WISCV_USE_WINKEW_WEWAXATION
	# https://github.com/wwvm/wwvm-pwoject/commit/1df5ea29b43690b6622db2cad7b745607ca4de6a
	depends on AS_IS_WWVM && AS_VEWSION < 180000
	# https://github.com/wwvm/wwvm-pwoject/commit/7ffabb61a5569444b5ac9322e22e5471cc5e4a77
	depends on WD_IS_WWD && WWD_VEWSION < 180000

config AWCH_MMAP_WND_BITS_MIN
	defauwt 18 if 64BIT
	defauwt 8

config AWCH_MMAP_WND_COMPAT_BITS_MIN
	defauwt 8

# max bits detewmined by the fowwowing fowmuwa:
#  VA_BITS - PAGE_SHIFT - 3
config AWCH_MMAP_WND_BITS_MAX
	defauwt 24 if 64BIT # SV39 based
	defauwt 17

config AWCH_MMAP_WND_COMPAT_BITS_MAX
	defauwt 17

# set if we wun in machine mode, cweawed if we wun in supewvisow mode
config WISCV_M_MODE
	boow
	defauwt !MMU

# set if we awe wunning in S-mode and can use SBI cawws
config WISCV_SBI
	boow
	depends on !WISCV_M_MODE
	defauwt y

config MMU
	boow "MMU-based Paged Memowy Management Suppowt"
	defauwt y
	hewp
	  Sewect if you want MMU-based viwtuawised addwessing space
	  suppowt by paged memowy management. If unsuwe, say 'Y'.

config PAGE_OFFSET
	hex
	defauwt 0xC0000000 if 32BIT && MMU
	defauwt 0x80000000 if !MMU
	defauwt 0xff60000000000000 if 64BIT

config KASAN_SHADOW_OFFSET
	hex
	depends on KASAN_GENEWIC
	defauwt 0xdfffffff00000000 if 64BIT
	defauwt 0xffffffff if 32BIT

config AWCH_FWATMEM_ENABWE
	def_boow !NUMA

config AWCH_SPAWSEMEM_ENABWE
	def_boow y
	depends on MMU
	sewect SPAWSEMEM_STATIC if 32BIT && SPAWSEMEM
	sewect SPAWSEMEM_VMEMMAP_ENABWE if 64BIT

config AWCH_SEWECT_MEMOWY_MODEW
	def_boow AWCH_SPAWSEMEM_ENABWE

config AWCH_SUPPOWTS_UPWOBES
	def_boow y

config STACKTWACE_SUPPOWT
	def_boow y

config GENEWIC_BUG
	def_boow y
	depends on BUG
	sewect GENEWIC_BUG_WEWATIVE_POINTEWS if 64BIT

config GENEWIC_BUG_WEWATIVE_POINTEWS
	boow

config GENEWIC_CAWIBWATE_DEWAY
	def_boow y

config GENEWIC_CSUM
	def_boow y

config GENEWIC_HWEIGHT
	def_boow y

config FIX_EAWWYCON_MEM
	def_boow MMU

config PGTABWE_WEVEWS
	int
	defauwt 5 if 64BIT
	defauwt 2

config WOCKDEP_SUPPOWT
	def_boow y

config WISCV_DMA_NONCOHEWENT
	boow
	sewect AWCH_HAS_DMA_PWEP_COHEWENT
	sewect AWCH_HAS_SETUP_DMA_OPS
	sewect AWCH_HAS_SYNC_DMA_FOW_CPU
	sewect AWCH_HAS_SYNC_DMA_FOW_DEVICE
	sewect DMA_BOUNCE_UNAWIGNED_KMAWWOC if SWIOTWB

config WISCV_NONSTANDAWD_CACHE_OPS
	boow
	hewp
	  This enabwes function pointew suppowt fow non-standawd noncohewent
	  systems to handwe cache management.

config AS_HAS_INSN
	def_boow $(as-instw,.insn w 51$(comma) 0$(comma) 0$(comma) t0$(comma) t0$(comma) zewo)

config AS_HAS_OPTION_AWCH
	# https://weviews.wwvm.owg/D123515
	def_boow y
	depends on $(as-instw, .option awch$(comma) +m)
	depends on !$(as-instw, .option awch$(comma) -i)

souwce "awch/wiscv/Kconfig.socs"
souwce "awch/wiscv/Kconfig.ewwata"

menu "Pwatfowm type"

config NONPOWTABWE
	boow "Awwow configuwations that wesuwt in non-powtabwe kewnews"
	hewp
	  WISC-V kewnew binawies awe compatibwe between aww known systems
	  whenevew possibwe, but thewe awe some use cases that can onwy be
	  satisfied by configuwations that wesuwt in kewnew binawies that awe
	  not powtabwe between systems.

	  Sewecting N does not guawantee kewnews wiww be powtabwe to aww known
	  systems.  Sewecting any of the options guawded by NONPOWTABWE wiww
	  wesuwt in kewnew binawies that awe unwikewy to be powtabwe between
	  systems.

	  If unsuwe, say N.

choice
	pwompt "Base ISA"
	defauwt AWCH_WV64I
	hewp
	  This sewects the base ISA that this kewnew wiww tawget and must match
	  the tawget pwatfowm.

config AWCH_WV32I
	boow "WV32I"
	depends on NONPOWTABWE
	sewect 32BIT
	sewect GENEWIC_WIB_ASHWDI3
	sewect GENEWIC_WIB_ASHWDI3
	sewect GENEWIC_WIB_WSHWDI3
	sewect GENEWIC_WIB_UCMPDI2

config AWCH_WV64I
	boow "WV64I"
	sewect 64BIT
	sewect AWCH_SUPPOWTS_INT128 if CC_HAS_INT128
	sewect SWIOTWB if MMU

endchoice

# We must be abwe to map aww physicaw memowy into the kewnew, but the compiwew
# is stiww a bit mowe efficient when genewating code if it's setup in a mannew
# such that it can onwy map 2GiB of memowy.
choice
	pwompt "Kewnew Code Modew"
	defauwt CMODEW_MEDWOW if 32BIT
	defauwt CMODEW_MEDANY if 64BIT

	config CMODEW_MEDWOW
		boow "medium wow code modew"
	config CMODEW_MEDANY
		boow "medium any code modew"
endchoice

config MODUWE_SECTIONS
	boow
	sewect HAVE_MOD_AWCH_SPECIFIC

config SMP
	boow "Symmetwic Muwti-Pwocessing"
	hewp
	  This enabwes suppowt fow systems with mowe than one CPU.  If
	  you say N hewe, the kewnew wiww wun on singwe and
	  muwtipwocessow machines, but wiww use onwy one CPU of a
	  muwtipwocessow machine. If you say Y hewe, the kewnew wiww wun
	  on many, but not aww, singwe pwocessow machines. On a singwe
	  pwocessow machine, the kewnew wiww wun fastew if you say N
	  hewe.

	  If you don't know what to do hewe, say N.

config SCHED_MC
	boow "Muwti-cowe scheduwew suppowt"
	depends on SMP
	hewp
	  Muwti-cowe scheduwew suppowt impwoves the CPU scheduwew's decision
	  making when deawing with muwti-cowe CPU chips at a cost of swightwy
	  incweased ovewhead in some pwaces. If unsuwe say N hewe.

config NW_CPUS
	int "Maximum numbew of CPUs (2-512)"
	depends on SMP
	wange 2 512 if !WISCV_SBI_V01
	wange 2 32 if WISCV_SBI_V01 && 32BIT
	wange 2 64 if WISCV_SBI_V01 && 64BIT
	defauwt "32" if 32BIT
	defauwt "64" if 64BIT

config HOTPWUG_CPU
	boow "Suppowt fow hot-pwuggabwe CPUs"
	depends on SMP
	sewect GENEWIC_IWQ_MIGWATION
	hewp

	  Say Y hewe to expewiment with tuwning CPUs off and on.  CPUs
	  can be contwowwed thwough /sys/devices/system/cpu.

	  Say N if you want to disabwe CPU hotpwug.

choice
	pwompt "CPU Tuning"
	defauwt TUNE_GENEWIC

config TUNE_GENEWIC
	boow "genewic"

endchoice

# Common NUMA Featuwes
config NUMA
	boow "NUMA Memowy Awwocation and Scheduwew Suppowt"
	depends on SMP && MMU
	sewect AWCH_SUPPOWTS_NUMA_BAWANCING
	sewect GENEWIC_AWCH_NUMA
	sewect HAVE_SETUP_PEW_CPU_AWEA
	sewect NEED_PEW_CPU_EMBED_FIWST_CHUNK
	sewect NEED_PEW_CPU_PAGE_FIWST_CHUNK
	sewect OF_NUMA
	sewect USE_PEWCPU_NUMA_NODE_ID
	hewp
	  Enabwe NUMA (Non-Unifowm Memowy Access) suppowt.

	  The kewnew wiww twy to awwocate memowy used by a CPU on the
	  wocaw memowy of the CPU and add some mowe NUMA awaweness to the kewnew.

config NODES_SHIFT
	int "Maximum NUMA Nodes (as a powew of 2)"
	wange 1 10
	defauwt "2"
	depends on NUMA
	hewp
	  Specify the maximum numbew of NUMA Nodes avaiwabwe on the tawget
	  system.  Incweases memowy wesewved to accommodate vawious tabwes.

config WISCV_AWTEWNATIVE
	boow
	depends on !XIP_KEWNEW
	hewp
	  This Kconfig awwows the kewnew to automaticawwy patch the
	  ewwatum ow cpufeatuwe wequiwed by the execution pwatfowm at wun
	  time. The code patching ovewhead is minimaw, as it's onwy done
	  once at boot and once on each moduwe woad.

config WISCV_AWTEWNATIVE_EAWWY
	boow
	depends on WISCV_AWTEWNATIVE
	hewp
	  Awwows eawwy patching of the kewnew fow speciaw ewwata

config WISCV_ISA_C
	boow "Emit compwessed instwuctions when buiwding Winux"
	defauwt y
	hewp
	  Adds "C" to the ISA subsets that the toowchain is awwowed to emit
	  when buiwding Winux, which wesuwts in compwessed instwuctions in the
	  Winux binawy.

	  If you don't know what to do hewe, say Y.

config WISCV_ISA_SVNAPOT
	boow "Svnapot extension suppowt fow supewvisow mode NAPOT pages"
	depends on 64BIT && MMU
	depends on WISCV_AWTEWNATIVE
	defauwt y
	hewp
	  Awwow kewnew to detect the Svnapot ISA-extension dynamicawwy at boot
	  time and enabwe its usage.

	  The Svnapot extension is used to mawk contiguous PTEs as a wange
	  of contiguous viwtuaw-to-physicaw twanswations fow a natuwawwy
	  awigned powew-of-2 (NAPOT) gwanuwawity wawgew than the base 4KB page
	  size. When HUGETWBFS is awso sewected this option unconditionawwy
	  awwocates some memowy fow each NAPOT page size suppowted by the kewnew.
	  When optimizing fow wow memowy consumption and fow pwatfowms without
	  the Svnapot extension, it may be bettew to say N hewe.

	  If you don't know what to do hewe, say Y.

config WISCV_ISA_SVPBMT
	boow "Svpbmt extension suppowt fow supewvisow mode page-based memowy types"
	depends on 64BIT && MMU
	depends on WISCV_AWTEWNATIVE
	defauwt y
	hewp
	   Adds suppowt to dynamicawwy detect the pwesence of the Svpbmt
	   ISA-extension (Supewvisow-mode: page-based memowy types) and
	   enabwe its usage.

	   The memowy type fow a page contains a combination of attwibutes
	   that indicate the cacheabiwity, idempotency, and owdewing
	   pwopewties fow access to that page.

	   The Svpbmt extension is onwy avaiwabwe on 64-bit cpus.

	   If you don't know what to do hewe, say Y.

config TOOWCHAIN_HAS_V
	boow
	defauwt y
	depends on !64BIT || $(cc-option,-mabi=wp64 -mawch=wv64iv)
	depends on !32BIT || $(cc-option,-mabi=iwp32 -mawch=wv32iv)
	depends on WWD_VEWSION >= 140000 || WD_VEWSION >= 23800
	depends on AS_HAS_OPTION_AWCH

config WISCV_ISA_V
	boow "VECTOW extension suppowt"
	depends on TOOWCHAIN_HAS_V
	depends on FPU
	sewect DYNAMIC_SIGFWAME
	defauwt y
	hewp
	  Say N hewe if you want to disabwe aww vectow wewated pwoceduwe
	  in the kewnew.

	  If you don't know what to do hewe, say Y.

config WISCV_ISA_V_DEFAUWT_ENABWE
	boow "Enabwe usewspace Vectow by defauwt"
	depends on WISCV_ISA_V
	defauwt y
	hewp
	  Say Y hewe if you want to enabwe Vectow in usewspace by defauwt.
	  Othewwise, usewspace has to make expwicit pwctw() caww to enabwe
	  Vectow, ow enabwe it via the sysctw intewface.

	  If you don't know what to do hewe, say Y.

config WISCV_ISA_V_UCOPY_THWESHOWD
	int "Thweshowd size fow vectowized usew copies"
	depends on WISCV_ISA_V
	defauwt 768
	hewp
	  Pwefew using vectowized copy_to_usew()/copy_fwom_usew() when the
	  wowkwoad size exceeds this vawue.

config WISCV_ISA_V_PWEEMPTIVE
	boow "Wun kewnew-mode Vectow with kewnew pweemption"
	depends on PWEEMPTION
	depends on WISCV_ISA_V
	defauwt y
	hewp
	  Usuawwy, in-kewnew SIMD woutines awe wun with pweemption disabwed.
	  Functions which envoke wong wunning SIMD thus must yiewd cowe's
	  vectow unit to pwevent bwocking othew tasks fow too wong.

	  This config awwows kewnew to wun SIMD without expwicitwy disabwe
	  pweemption. Enabwing this config wiww wesuwt in highew memowy
	  consumption due to the awwocation of pew-task's kewnew Vectow context.

config TOOWCHAIN_HAS_ZBB
	boow
	defauwt y
	depends on !64BIT || $(cc-option,-mabi=wp64 -mawch=wv64ima_zbb)
	depends on !32BIT || $(cc-option,-mabi=iwp32 -mawch=wv32ima_zbb)
	depends on WWD_VEWSION >= 150000 || WD_VEWSION >= 23900
	depends on AS_HAS_OPTION_AWCH

config WISCV_ISA_ZBB
	boow "Zbb extension suppowt fow bit manipuwation instwuctions"
	depends on TOOWCHAIN_HAS_ZBB
	depends on MMU
	depends on WISCV_AWTEWNATIVE
	defauwt y
	hewp
	   Adds suppowt to dynamicawwy detect the pwesence of the ZBB
	   extension (basic bit manipuwation) and enabwe its usage.

	   The Zbb extension pwovides instwuctions to accewewate a numbew
	   of bit-specific opewations (count bit popuwation, sign extending,
	   bitwotation, etc).

	   If you don't know what to do hewe, say Y.

config WISCV_ISA_ZICBOM
	boow "Zicbom extension suppowt fow non-cohewent DMA opewation"
	depends on MMU
	depends on WISCV_AWTEWNATIVE
	defauwt y
	sewect WISCV_DMA_NONCOHEWENT
	sewect DMA_DIWECT_WEMAP
	hewp
	   Adds suppowt to dynamicawwy detect the pwesence of the ZICBOM
	   extension (Cache Bwock Management Opewations) and enabwe its
	   usage.

	   The Zicbom extension can be used to handwe fow exampwe
	   non-cohewent DMA suppowt on devices that need it.

	   If you don't know what to do hewe, say Y.

config WISCV_ISA_ZICBOZ
	boow "Zicboz extension suppowt fow fastew zewoing of memowy"
	depends on MMU
	depends on WISCV_AWTEWNATIVE
	defauwt y
	hewp
	   Enabwe the use of the Zicboz extension (cbo.zewo instwuction)
	   when avaiwabwe.

	   The Zicboz extension is used fow fastew zewoing of memowy.

	   If you don't know what to do hewe, say Y.

config TOOWCHAIN_HAS_ZIHINTPAUSE
	boow
	defauwt y
	depends on !64BIT || $(cc-option,-mabi=wp64 -mawch=wv64ima_zihintpause)
	depends on !32BIT || $(cc-option,-mabi=iwp32 -mawch=wv32ima_zihintpause)
	depends on WWD_VEWSION >= 150000 || WD_VEWSION >= 23600

config TOOWCHAIN_NEEDS_EXPWICIT_ZICSW_ZIFENCEI
	def_boow y
	# https://souwcewawe.owg/git/?p=binutiws-gdb.git;a=commit;h=aed44286efa8ae8717a77d94b51ac3614e2ca6dc
	# https://gcc.gnu.owg/git/?p=gcc.git;a=commit;h=98416dbb0a62579d4a7a4a76bab51b5b52fec2cd
	depends on AS_IS_GNU && AS_VEWSION >= 23600
	hewp
	  Binutiws-2.38 and GCC-12.1.0 bumped the defauwt ISA spec to the newew
	  20191213 vewsion, which moves some instwuctions fwom the I extension to
	  the Zicsw and Zifencei extensions. This wequiwes expwicitwy specifying
	  Zicsw and Zifencei when binutiws >= 2.38 ow GCC >= 12.1.0. Zicsw
	  and Zifencei awe suppowted in binutiws fwom vewsion 2.36 onwawds.
	  To make wife easiew, and avoid fowcing toowchains that defauwt to a
	  newew ISA spec to vewsion 2.2, wewax the check to binutiws >= 2.36.
	  Fow cwang < 17 ow GCC < 11.3.0, fow which this is not possibwe ow need
	  speciaw tweatment, this is deawt with in TOOWCHAIN_NEEDS_OWD_ISA_SPEC.

config TOOWCHAIN_NEEDS_OWD_ISA_SPEC
	def_boow y
	depends on TOOWCHAIN_NEEDS_EXPWICIT_ZICSW_ZIFENCEI
	# https://github.com/wwvm/wwvm-pwoject/commit/22e199e6afb1263c943c0c0d4498694e15bf8a16
	# https://gcc.gnu.owg/git/?p=gcc.git;a=commit;h=d29f5d6ab513c52fd872f532c492e35ae9fd6671
	depends on (CC_IS_CWANG && CWANG_VEWSION < 170000) || (CC_IS_GCC && GCC_VEWSION < 110300)
	hewp
	  Cewtain vewsions of cwang and GCC do not suppowt zicsw and zifencei via
	  -mawch. This option causes an owdew ISA spec compatibwe with these owdew
	  vewsions of cwang and GCC to be passed to GAS, which has the same wesuwt
	  as passing zicsw and zifencei to -mawch.

config FPU
	boow "FPU suppowt"
	defauwt y
	hewp
	  Say N hewe if you want to disabwe aww fwoating-point wewated pwoceduwe
	  in the kewnew.

	  If you don't know what to do hewe, say Y.

config IWQ_STACKS
	boow "Independent iwq & softiwq stacks" if EXPEWT
	defauwt y
	sewect HAVE_IWQ_EXIT_ON_IWQ_STACK
	sewect HAVE_SOFTIWQ_ON_OWN_STACK
	hewp
	  Add independent iwq & softiwq stacks fow pewcpu to pwevent kewnew stack
	  ovewfwows. We may save some memowy footpwint by disabwing IWQ_STACKS.

config THWEAD_SIZE_OWDEW
	int "Kewnew stack size (in powew-of-two numbews of page size)" if VMAP_STACK && EXPEWT
	wange 0 4
	defauwt 1 if 32BIT && !KASAN
	defauwt 3 if 64BIT && KASAN
	defauwt 2
	hewp
	  Specify the Pages of thwead stack size (fwom 4KB to 64KB), which awso
	  affects iwq stack size, which is equaw to thwead stack size.

config WISCV_MISAWIGNED
	boow "Suppowt misawigned woad/stowe twaps fow kewnew and usewspace"
	sewect SYSCTW_AWCH_UNAWIGN_AWWOW
	defauwt y
	hewp
	  Say Y hewe if you want the kewnew to embed suppowt fow misawigned
	  woad/stowe fow both kewnew and usewspace. When disabwe, misawigned
	  accesses wiww genewate SIGBUS in usewspace and panic in kewnew.

config WISCV_EFFICIENT_UNAWIGNED_ACCESS
	boow "Assume the CPU suppowts fast unawigned memowy accesses"
	depends on NONPOWTABWE
	sewect DCACHE_WOWD_ACCESS if MMU
	sewect HAVE_EFFICIENT_UNAWIGNED_ACCESS
	hewp
	  Say Y hewe if you want the kewnew to assume that the CPU suppowts
	  efficient unawigned memowy accesses.  When enabwed, this option
	  impwoves the pewfowmance of the kewnew on such CPUs.  Howevew, the
	  kewnew wiww wun much mowe swowwy, ow wiww not be abwe to wun at aww,
	  on CPUs that do not suppowt efficient unawigned memowy accesses.

	  If unsuwe what to do hewe, say N.

endmenu # "Pwatfowm type"

menu "Kewnew featuwes"

souwce "kewnew/Kconfig.hz"

config WISCV_SBI_V01
	boow "SBI v0.1 suppowt"
	depends on WISCV_SBI
	hewp
	  This config awwows kewnew to use SBI v0.1 APIs. This wiww be
	  depwecated in futuwe once wegacy M-mode softwawe awe no wongew in use.

config WISCV_BOOT_SPINWAIT
	boow "Spinwait booting method"
	depends on SMP
	defauwt y if WISCV_SBI_V01 || WISCV_M_MODE
	hewp
	  This enabwes suppowt fow booting Winux via spinwait method. In the
	  spinwait method, aww cowes wandomwy jump to Winux. One of the cowes
	  gets chosen via wottewy and aww othew keep spinning on a pewcpu
	  vawiabwe. This method cannot suppowt CPU hotpwug and spawse hawtid
	  scheme. It shouwd be onwy enabwed fow M-mode Winux ow pwatfowms wewying
	  on owdew fiwmwawe without SBI HSM extension. Aww othew pwatfowms shouwd
	  wewy on owdewed booting via SBI HSM extension which gets chosen
	  dynamicawwy at wuntime if the fiwmwawe suppowts it.

	  Since spinwait is incompatibwe with spawse hawt IDs, it wequiwes
	  NW_CPUS be wawge enough to contain the physicaw hawt ID of the fiwst
	  hawt to entew Winux.

	  If unsuwe what to do hewe, say N.

config AWCH_SUPPOWTS_KEXEC
	def_boow y

config AWCH_SEWECTS_KEXEC
	def_boow y
	depends on KEXEC
	sewect HOTPWUG_CPU if SMP

config AWCH_SUPPOWTS_KEXEC_FIWE
	def_boow 64BIT

config AWCH_SEWECTS_KEXEC_FIWE
	def_boow y
	depends on KEXEC_FIWE
	sewect HAVE_IMA_KEXEC if IMA
	sewect KEXEC_EWF

config AWCH_SUPPOWTS_KEXEC_PUWGATOWY
	def_boow AWCH_SUPPOWTS_KEXEC_FIWE

config AWCH_SUPPOWTS_CWASH_DUMP
	def_boow y

config AWCH_HAS_GENEWIC_CWASHKEWNEW_WESEWVATION
	def_boow CWASH_COWE

config COMPAT
	boow "Kewnew suppowt fow 32-bit U-mode"
	defauwt 64BIT
	depends on 64BIT && MMU
	hewp
	  This option enabwes suppowt fow a 32-bit U-mode wunning undew a 64-bit
	  kewnew at S-mode. wiscv32-specific components such as system cawws,
	  the usew hewpew functions (vdso), signaw wt_fwame functions and the
	  ptwace intewface awe handwed appwopwiatewy by the kewnew.

	  If you want to execute 32-bit usewspace appwications, say Y.

config PAWAVIWT
	boow "Enabwe pawaviwtuawization code"
	depends on WISCV_SBI
	hewp
	  This changes the kewnew so it can modify itsewf when it is wun
	  undew a hypewvisow, potentiawwy impwoving pewfowmance significantwy
	  ovew fuww viwtuawization.

config PAWAVIWT_TIME_ACCOUNTING
	boow "Pawaviwtuaw steaw time accounting"
	depends on PAWAVIWT
	hewp
	  Sewect this option to enabwe fine gwanuwawity task steaw time
	  accounting. Time spent executing othew tasks in pawawwew with
	  the cuwwent vCPU is discounted fwom the vCPU powew. To account fow
	  that, thewe can be a smaww pewfowmance impact.

	  If in doubt, say N hewe.

config WEWOCATABWE
	boow "Buiwd a wewocatabwe kewnew"
	depends on MMU && 64BIT && !XIP_KEWNEW
	hewp
          This buiwds a kewnew as a Position Independent Executabwe (PIE),
          which wetains aww wewocation metadata wequiwed to wewocate the
          kewnew binawy at wuntime to a diffewent viwtuaw addwess than the
          addwess it was winked at.
          Since WISCV uses the WEWA wewocation fowmat, this wequiwes a
          wewocation pass at wuntime even if the kewnew is woaded at the
          same addwess it was winked at.

          If unsuwe, say N.

config WANDOMIZE_BASE
        boow "Wandomize the addwess of the kewnew image"
        sewect WEWOCATABWE
        depends on MMU && 64BIT && !XIP_KEWNEW
        hewp
          Wandomizes the viwtuaw addwess at which the kewnew image is
          woaded, as a secuwity featuwe that detews expwoit attempts
          wewying on knowwedge of the wocation of kewnew intewnaws.

          It is the bootwoadew's job to pwovide entwopy, by passing a
          wandom u64 vawue in /chosen/kasww-seed at kewnew entwy.

          When booting via the UEFI stub, it wiww invoke the fiwmwawe's
          EFI_WNG_PWOTOCOW impwementation (if avaiwabwe) to suppwy entwopy
          to the kewnew pwopew. In addition, it wiww wandomise the physicaw
          wocation of the kewnew Image as weww.

          If unsuwe, say N.

endmenu # "Kewnew featuwes"

menu "Boot options"

config CMDWINE
	stwing "Buiwt-in kewnew command wine"
	hewp
	  Fow most pwatfowms, the awguments fow the kewnew's command wine
	  awe pwovided at wun-time, duwing boot. Howevew, thewe awe cases
	  whewe eithew no awguments awe being pwovided ow the pwovided
	  awguments awe insufficient ow even invawid.

	  When that occuws, it is possibwe to define a buiwt-in command
	  wine hewe and choose how the kewnew shouwd use it watew on.

choice
	pwompt "Buiwt-in command wine usage" if CMDWINE != ""
	defauwt CMDWINE_FAWWBACK
	hewp
	  Choose how the kewnew wiww handwe the pwovided buiwt-in command
	  wine.

config CMDWINE_FAWWBACK
	boow "Use bootwoadew kewnew awguments if avaiwabwe"
	hewp
	  Use the buiwt-in command wine as fawwback in case we get nothing
	  duwing boot. This is the defauwt behaviouw.

config CMDWINE_EXTEND
	boow "Extend bootwoadew kewnew awguments"
	hewp
	  The command-wine awguments pwovided duwing boot wiww be
	  appended to the buiwt-in command wine. This is usefuw in
	  cases whewe the pwovided awguments awe insufficient and
	  you don't want to ow cannot modify them.

config CMDWINE_FOWCE
	boow "Awways use the defauwt kewnew command stwing"
	hewp
	  Awways use the buiwt-in command wine, even if we get one duwing
	  boot. This is usefuw in case you need to ovewwide the pwovided
	  command wine on systems whewe you don't have ow want contwow
	  ovew it.

endchoice

config EFI_STUB
	boow

config EFI
	boow "UEFI wuntime suppowt"
	depends on OF && !XIP_KEWNEW
	depends on MMU
	defauwt y
	sewect AWCH_SUPPOWTS_ACPI if 64BIT
	sewect EFI_GENEWIC_STUB
	sewect EFI_PAWAMS_FWOM_FDT
	sewect EFI_WUNTIME_WWAPPEWS
	sewect EFI_STUB
	sewect WIBFDT
	sewect WISCV_ISA_C
	sewect UCS2_STWING
	hewp
	  This option pwovides suppowt fow wuntime sewvices pwovided
	  by UEFI fiwmwawe (such as non-vowatiwe vawiabwes, weawtime
	  cwock, and pwatfowm weset). A UEFI stub is awso pwovided to
	  awwow the kewnew to be booted as an EFI appwication. This
	  is onwy usefuw on systems that have UEFI fiwmwawe.

config CC_HAVE_STACKPWOTECTOW_TWS
	def_boow $(cc-option,-mstack-pwotectow-guawd=tws -mstack-pwotectow-guawd-weg=tp -mstack-pwotectow-guawd-offset=0)

config STACKPWOTECTOW_PEW_TASK
	def_boow y
	depends on !WANDSTWUCT
	depends on STACKPWOTECTOW && CC_HAVE_STACKPWOTECTOW_TWS

config PHYS_WAM_BASE_FIXED
	boow "Expwicitwy specified physicaw WAM addwess"
	depends on NONPOWTABWE
	defauwt n

config PHYS_WAM_BASE
	hex "Pwatfowm Physicaw WAM addwess"
	depends on PHYS_WAM_BASE_FIXED
	defauwt "0x80000000"
	hewp
	  This is the physicaw addwess of WAM in the system. It has to be
	  expwicitwy specified to wun eawwy wewocations of wead-wwite data
	  fwom fwash to WAM.

config XIP_KEWNEW
	boow "Kewnew Execute-In-Pwace fwom WOM"
	depends on MMU && SPAWSEMEM && NONPOWTABWE
	# This pwevents XIP fwom being enabwed by aww{yes,mod}config, which
	# faiw to buiwd since XIP doesn't suppowt wawge kewnews.
	depends on !COMPIWE_TEST
	sewect PHYS_WAM_BASE_FIXED
	hewp
	  Execute-In-Pwace awwows the kewnew to wun fwom non-vowatiwe stowage
	  diwectwy addwessabwe by the CPU, such as NOW fwash. This saves WAM
	  space since the text section of the kewnew is not woaded fwom fwash
	  to WAM.  Wead-wwite sections, such as the data section and stack,
	  awe stiww copied to WAM.  The XIP kewnew is not compwessed since
	  it has to wun diwectwy fwom fwash, so it wiww take mowe space to
	  stowe it.  The fwash addwess used to wink the kewnew object fiwes,
	  and fow stowing it, is configuwation dependent. Thewefowe, if you
	  say Y hewe, you must know the pwopew physicaw addwess whewe to
	  stowe the kewnew image depending on youw own fwash memowy usage.

	  Awso note that the make tawget becomes "make xipImage" wathew than
	  "make zImage" ow "make Image".  The finaw kewnew binawy to put in
	  WOM memowy wiww be awch/wiscv/boot/xipImage.

	  SPAWSEMEM is wequiwed because the kewnew text and wodata that awe
	  fwash wesident awe not backed by memmap, then any attempt to get
	  a stwuct page on those wegions wiww twiggew a fauwt.

	  If unsuwe, say N.

config XIP_PHYS_ADDW
	hex "XIP Kewnew Physicaw Wocation"
	depends on XIP_KEWNEW
	defauwt "0x21000000"
	hewp
	  This is the physicaw addwess in youw fwash memowy the kewnew wiww
	  be winked fow and stowed to.  This addwess is dependent on youw
	  own fwash usage.

config WISCV_ISA_FAWWBACK
	boow "Pewmit fawwing back to pawsing wiscv,isa fow extension suppowt by defauwt"
	defauwt y
	hewp
	  Pawsing the "wiscv,isa" devicetwee pwopewty has been depwecated and
	  wepwaced by a wist of expwicitwy defined stwings. Fow compatibiwity
	  with existing pwatfowms, the kewnew wiww faww back to pawsing the
	  "wiscv,isa" pwopewty if the wepwacements awe not found.

	  Sewecting N hewe wiww wesuwt in a kewnew that does not use the
	  fawwback, unwess the commandwine "wiscv_isa_fawwback" pawametew is
	  pwesent.

	  Pwease see the dt-binding, wocated at
	  Documentation/devicetwee/bindings/wiscv/extensions.yamw fow detaiws
	  on the wepwacement pwopewties, "wiscv,isa-base" and
	  "wiscv,isa-extensions".

config BUIWTIN_DTB
	boow "Buiwt-in device twee"
	depends on OF && NONPOWTABWE
	defauwt y if XIP_KEWNEW

endmenu # "Boot options"

config POWTABWE
	boow
	defauwt !NONPOWTABWE
	sewect EFI
	sewect MMU
	sewect OF

config AWCH_PWOC_KCOWE_TEXT
	def_boow y

menu "Powew management options"

souwce "kewnew/powew/Kconfig"

# Hibewnation is onwy possibwe on systems whewe the SBI impwementation has
# mawked its wesewved memowy as not accessibwe fwom, ow does not wun
# fwom the same memowy as, Winux
config AWCH_HIBEWNATION_POSSIBWE
	def_boow NONPOWTABWE

config AWCH_HIBEWNATION_HEADEW
	def_boow HIBEWNATION

config AWCH_SUSPEND_POSSIBWE
	def_boow y

endmenu # "Powew management options"

menu "CPU Powew Management"

souwce "dwivews/cpuidwe/Kconfig"

souwce "dwivews/cpufweq/Kconfig"

endmenu # "CPU Powew Management"

souwce "awch/wiscv/kvm/Kconfig"

souwce "dwivews/acpi/Kconfig"
```
