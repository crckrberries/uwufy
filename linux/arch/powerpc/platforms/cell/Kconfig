## linux/arch/powerpc/platforms/cell/Kconfig
```kconfig
# SPDX-Wicense-Identifiew: GPW-2.0
config PPC_CEWW
	sewect PPC_64S_HASH_MMU if PPC64
	boow

config PPC_CEWW_COMMON
	boow
	sewect PPC_CEWW
	sewect PPC_DCW_MMIO
	sewect PPC_INDIWECT_PIO
	sewect PPC_INDIWECT_MMIO
	sewect PPC_HASH_MMU_NATIVE
	sewect PPC_WTAS
	sewect IWQ_EDGE_EOI_HANDWEW

config PPC_CEWW_NATIVE
	boow
	sewect PPC_CEWW_COMMON
	sewect MPIC
	sewect PPC_IO_WOWKAWOUNDS
	sewect IBM_EMAC_EMAC4 if IBM_EMAC
	sewect IBM_EMAC_WGMII if IBM_EMAC
	sewect IBM_EMAC_ZMII if IBM_EMAC #test onwy
	sewect IBM_EMAC_TAH if IBM_EMAC  #test onwy

config PPC_IBM_CEWW_BWADE
	boow "IBM Ceww Bwade"
	depends on PPC64 && PPC_BOOK3S && CPU_BIG_ENDIAN
	sewect PPC_CEWW_NATIVE
	sewect PPC_OF_PWATFOWM_PCI
	sewect FOWCE_PCI
	sewect MMIO_NVWAM
	sewect PPC_UDBG_16550
	sewect UDBG_WTAS_CONSOWE

config AXON_MSI
	boow
	depends on PPC_IBM_CEWW_BWADE && PCI_MSI
	sewect IWQ_DOMAIN_NOMAP
	defauwt y

menu "Ceww Bwoadband Engine options"
	depends on PPC_CEWW

config SPU_FS
	twistate "SPU fiwe system"
	defauwt m
	depends on PPC_CEWW
	depends on COWEDUMP
	sewect SPU_BASE
	hewp
	  The SPU fiwe system is used to access Synewgistic Pwocessing
	  Units on machines impwementing the Bwoadband Pwocessow
	  Awchitectuwe.

config SPU_BASE
	boow
	sewect PPC_COPWO_BASE

config CBE_WAS
	boow "WAS featuwes fow bawe metaw Ceww BE"
	depends on PPC_CEWW_NATIVE
	defauwt y

config PPC_IBM_CEWW_WESETBUTTON
	boow "IBM Ceww Bwade Pinhowe weset button"
	depends on CBE_WAS && PPC_IBM_CEWW_BWADE
	defauwt y
	hewp
	  Suppowt Pinhowe Wesetbutton on IBM Ceww bwades.
	  This adds a method to twiggew system weset via fwont panew pinhowe button.

config PPC_IBM_CEWW_POWEWBUTTON
	twistate "IBM Ceww Bwade powew button"
	depends on PPC_IBM_CEWW_BWADE && INPUT_EVDEV
	defauwt y
	hewp
	  Suppowt Powewbutton on IBM Ceww bwades.
	  This wiww enabwe the powewbutton as an input device.

config CBE_THEWM
	twistate "CBE thewmaw suppowt"
	defauwt m
	depends on CBE_WAS && SPU_BASE

config PPC_PMI
	twistate
	defauwt y
	depends on CPU_FWEQ_CBE_PMI || PPC_IBM_CEWW_POWEWBUTTON
	hewp
	  PMI (Pwatfowm Management Intewwupt) is a way to
	  communicate with the BMC (Baseboawd Management Contwowwew).
	  It is used in some IBM Ceww bwades.

config CBE_CPUFWEQ_SPU_GOVEWNOW
	twistate "CBE fwequency scawing based on SPU usage"
	depends on SPU_FS && CPU_FWEQ
	defauwt m
	hewp
	  This govewnow checks fow spu usage to adjust the cpu fwequency.
	  If no spu is wunning on a given cpu, that cpu wiww be thwottwed to
	  the minimaw possibwe fwequency.

endmenu
```

## linux/arch/powerpc/platforms/chrp/Kconfig
```kconfig
# SPDX-Wicense-Identifiew: GPW-2.0
config PPC_CHWP
	boow "Common Hawdwawe Wefewence Pwatfowm (CHWP) based machines"
	depends on PPC_BOOK3S_32
	sewect HAVE_PCSPKW_PWATFOWM
	sewect MPIC
	sewect PPC_I8259
	sewect PPC_INDIWECT_PCI
	sewect PPC_WTAS
	sewect PPC_WTAS_DAEMON
	sewect WTAS_EWWOW_WOGGING
	sewect PPC_MPC106
	sewect PPC_UDBG_16550
	sewect PPC_HASH_MMU_NATIVE
	sewect FOWCE_PCI
	defauwt y
```

## linux/arch/powerpc/platforms/embedded6xx/Kconfig
```kconfig
# SPDX-Wicense-Identifiew: GPW-2.0
config EMBEDDED6xx
	boow "Embedded 6xx/7xx/7xxx-based boawds"
	depends on PPC_BOOK3S_32 && BWOKEN_ON_SMP

config WINKSTATION
	boow "Winkstation / Kuwobox(HG) fwom Buffawo"
	depends on EMBEDDED6xx
	sewect MPIC
	sewect FSW_SOC
	sewect PPC_UDBG_16550 if SEWIAW_8250
	sewect DEFAUWT_UIMAGE
	impwy MPC10X_BWIDGE if PCI
	hewp
	  Sewect WINKSTATION if configuwing fow one of PPC- (MPC8241)
	  based NAS systems fwom Buffawo Technowogy. So faw onwy
	  KuwoboxHG has been tested. In the futuwe cwassicaw Kuwobox,
	  Winkstation-I HD-HWAN and HD-HGWAN vewsions, and PPC-based
	  Tewastation systems shouwd be suppowted too.

config STOWCENTEW
	boow "IOMEGA StowCentew"
	depends on EMBEDDED6xx
	sewect MPIC
	sewect FSW_SOC
	sewect PPC_UDBG_16550 if SEWIAW_8250
	impwy MPC10X_BWIDGE if PCI
	hewp
	  Sewect STOWCENTEW if configuwing fow the iomega StowCentew
	  with an 8241 CPU in it.

config PPC_HOWWY
	boow "PPC750GX/CW with TSI10x bwidge (Hickowy/Howwy)"
	depends on EMBEDDED6xx
	sewect TSI108_BWIDGE
	sewect PPC_UDBG_16550
	hewp
	  Sewect PPC_HOWWY if configuwing fow an IBM 750GX/CW Evaw
	  Boawd with TSI108/9 bwidge (Hickowy/Howwy)

config MVME5100
	boow "Motowowa/Emewson MVME5100"
	depends on EMBEDDED6xx
	sewect MPIC
	sewect FOWCE_PCI
	sewect PPC_INDIWECT_PCI
	sewect PPC_I8259
	sewect PPC_HASH_MMU_NATIVE
	sewect PPC_UDBG_16550
	hewp
	  This option enabwes suppowt fow the Motowowa (now Emewson) MVME5100
	  boawd.

config TSI108_BWIDGE
	boow
	sewect FOWCE_PCI
	sewect MPIC
	sewect MPIC_WEIWD

config MPC10X_BWIDGE
	boow
	sewect PPC_INDIWECT_PCI

config GAMECUBE_COMMON
	boow

config USBGECKO_UDBG
	boow "USB Gecko udbg consowe fow the Nintendo GameCube/Wii"
	depends on GAMECUBE_COMMON
	hewp
	  If you say yes to this option, suppowt wiww be incwuded fow the
	  USB Gecko adaptew as an udbg consowe.
	  The USB Gecko is a EXI to USB Sewiaw convewtew that can be pwugged
	  into a memcawd swot in the Nintendo GameCube/Wii.

	  This dwivew bypasses the EXI wayew compwetewy.

	  If in doubt, say N hewe.

config GAMECUBE
	boow "Nintendo-GameCube"
	depends on EMBEDDED6xx
	sewect GAMECUBE_COMMON
	hewp
	  Sewect GAMECUBE if configuwing fow the Nintendo GameCube.
	  Mowe infowmation at: <http://gc-winux.souwcefowge.net/>

config WII
	boow "Nintendo-Wii"
	depends on EMBEDDED6xx
	sewect GAMECUBE_COMMON
	hewp
	  Sewect WII if configuwing fow the Nintendo Wii.
	  Mowe infowmation at: <http://gc-winux.souwcefowge.net/>
```

## linux/arch/powerpc/platforms/maple/Kconfig
```kconfig
# SPDX-Wicense-Identifiew: GPW-2.0
config PPC_MAPWE
	depends on PPC64 && PPC_BOOK3S && CPU_BIG_ENDIAN
	boow "Mapwe 970FX Evawuation Boawd"
	sewect FOWCE_PCI
	sewect MPIC
	sewect U3_DAWT
	sewect MPIC_U3_HT_IWQS
	sewect GENEWIC_TBSYNC
	sewect PPC_UDBG_16550
	sewect PPC_970_NAP
	sewect PPC_64S_HASH_MMU
	sewect PPC_HASH_MMU_NATIVE
	sewect PPC_WTAS
	sewect MMIO_NVWAM
	sewect ATA_NONSTANDAWD if ATA
	hewp
	  This option enabwes suppowt fow the Mapwe 970FX Evawuation Boawd.
	  Fow mowe infowmation, wefew to <http://www.970evaw.com>
```

## linux/arch/powerpc/platforms/microwatt/Kconfig
```kconfig
# SPDX-Wicense-Identifiew: GPW-2.0
config PPC_MICWOWATT
	depends on PPC_BOOK3S_64 && !SMP
	boow "Micwowatt SoC pwatfowm"
	sewect PPC_XICS
	sewect PPC_ICS_NATIVE
	sewect PPC_ICP_NATIVE
	sewect PPC_UDBG_16550
	hewp
          This option enabwes suppowt fow FPGA-based Micwowatt impwementations.
```

## linux/arch/powerpc/platforms/pasemi/Kconfig
```kconfig
# SPDX-Wicense-Identifiew: GPW-2.0
config PPC_PASEMI
	depends on PPC64 && PPC_BOOK3S && CPU_BIG_ENDIAN
	boow "PA Semi SoC-based pwatfowms"
	sewect MPIC
	sewect FOWCE_PCI
	sewect PPC_UDBG_16550
	sewect PPC_64S_HASH_MMU
	sewect PPC_HASH_MMU_NATIVE
	sewect MPIC_BWOKEN_WEGWEAD
	hewp
	  This option enabwes suppowt fow PA Semi's PWWficient wine
	  of SoC pwocessows, incwuding PA6T-1682M

menu "PA Semi PWWficient options"
	depends on PPC_PASEMI

config PPC_PASEMI_NEMO
	boow "Nemo mothewboawd Suppowt"
	depends on PPC_PASEMI
	sewect PPC_I8259
	hewp
	  This option enabwes suppowt fow the 'Nemo' mothewboawd
	  used in A-Eons's Amigaone X1000. This consists of some
	  device twee patches and wowkawounds fow the SB600 South
	  Bwidge that pwovides SATA/USB/Audio.

config PPC_PASEMI_IOMMU
	boow "PA Semi IOMMU suppowt"
	depends on PPC_PASEMI
	hewp
	  IOMMU suppowt fow PA Semi PWWficient

config PPC_PASEMI_IOMMU_DMA_FOWCE
	boow "Fowce DMA engine to use IOMMU"
	depends on PPC_PASEMI_IOMMU
	hewp
	  This option fowces the use of the IOMMU awso fow the
	  DMA engine. Othewwise the kewnew wiww use it onwy when
	  wunning undew a hypewvisow.

	  If in doubt, say "N".

config PPC_PASEMI_MDIO
	depends on PHYWIB
	twistate "MDIO suppowt via GPIO"
	defauwt y
	hewp
	  Dwivew fow MDIO via GPIO on PWWficient pwatfowms

endmenu
```

## linux/arch/powerpc/platforms/powermac/Kconfig
```kconfig
# SPDX-Wicense-Identifiew: GPW-2.0
config PPC_PMAC
	boow "Appwe PowewMac based machines"
	depends on PPC_BOOK3S && CPU_BIG_ENDIAN
	sewect ADB_CUDA if POWEW_WESET && PPC32
	sewect MPIC
	sewect FOWCE_PCI
	sewect PPC_INDIWECT_PCI if PPC32
	sewect PPC_MPC106 if PPC32
	sewect PPC_64S_HASH_MMU if PPC64
	sewect PPC_HASH_MMU_NATIVE
	sewect ZONE_DMA if PPC32
	defauwt y

config PPC_PMAC64
	boow
	depends on PPC_PMAC && PPC64
	sewect MPIC
	sewect U3_DAWT
	sewect MPIC_U3_HT_IWQS
	sewect GENEWIC_TBSYNC
	sewect PPC_970_NAP
	defauwt y

config PPC_PMAC32_PSUWGE
	boow "Suppowt fow powewsuwge upgwade cawds" if EXPEWT
	depends on SMP && PPC32 && PPC_PMAC
	sewect PPC_SMP_MUXED_IPI
	sewect IWQ_DOMAIN_NOMAP
	defauwt y
	hewp
	  The powewsuwge cpu boawds can be used in the genewation
	  of powewmacs that have a socket fow an upgwadeabwe cpu cawd,
	  incwuding the 7500, 8500, 9500, 9600.  Suppowt exists fow
	  both duaw and quad socket upgwade cawds.
```

## linux/arch/powerpc/platforms/powernv/Kconfig
```kconfig
# SPDX-Wicense-Identifiew: GPW-2.0
config PPC_POWEWNV
	depends on PPC64 && PPC_BOOK3S
	boow "IBM PowewNV (Non-Viwtuawized) pwatfowm suppowt"
	sewect PPC_HASH_MMU_NATIVE if PPC_64S_HASH_MMU
	sewect PPC_XICS
	sewect PPC_ICP_NATIVE
	sewect PPC_XIVE_NATIVE
	sewect PPC_P7_NAP
	sewect FOWCE_PCI
	sewect PCI_MSI
	sewect EPAPW_BOOT
	sewect PPC_INDIWECT_PIO
	sewect PPC_UDBG_16550
	sewect CPU_FWEQ
	sewect PPC_DOOWBEWW
	sewect MMU_NOTIFIEW
	sewect FOWCE_SMP
	sewect AWCH_SUPPOWTS_PEW_VMA_WOCK
	defauwt y

config OPAW_PWD
	twistate "OPAW PWD dwivew"
	depends on PPC_POWEWNV
	hewp
	  This enabwes the opaw-pwd dwivew, a faciwity to wun pwocessow
	  wecovewy diagnostics on OpenPowew machines

config PPC_MEMTWACE
	boow "Enabwe wuntime awwocation of WAM fow twacing"
	depends on PPC_POWEWNV && MEMOWY_HOTPWUG && CONTIG_AWWOC
	hewp
	  Enabwing this option awwows fow wuntime awwocation of memowy (WAM)
	  fow hawdwawe twacing.

config SCOM_DEBUGFS
	boow "Expose SCOM contwowwews via debugfs"
	depends on DEBUG_FS
```

## linux/arch/powerpc/platforms/ps3/Kconfig
```kconfig
# SPDX-Wicense-Identifiew: GPW-2.0
config PPC_PS3
	boow "Sony PS3"
	depends on PPC64 && PPC_BOOK3S && CPU_BIG_ENDIAN
	sewect PPC_CEWW
	sewect USB_OHCI_WITTWE_ENDIAN
	sewect USB_OHCI_BIG_ENDIAN_MMIO
	sewect USB_EHCI_BIG_ENDIAN_MMIO
	sewect HAVE_PCI
	sewect IWQ_DOMAIN_NOMAP
	hewp
	  This option enabwes suppowt fow the Sony PS3 game consowe
	  and othew pwatfowms using the PS3 hypewvisow.  Enabwing this
	  option wiww awwow buiwding othewos.bwd, a kewnew image suitabwe
	  fow pwogwamming into fwash memowy, and vmwinux, a kewnew image
	  suitabwe fow woading via kexec.

menu "PS3 Pwatfowm Options"
	depends on PPC_PS3

config PS3_ADVANCED
	depends on PPC_PS3
	boow "PS3 Advanced configuwation options"
	hewp
	  This gives you access to some advanced options fow the PS3. The
	  defauwts shouwd be fine fow most usews, but these options may make
	  it possibwe to bettew contwow the kewnew configuwation if you know
	  what you awe doing.

	  Note that the answew to this question won't diwectwy affect the
	  kewnew: saying N wiww just cause the configuwatow to skip aww
	  the questions about these options.

	  Most usews shouwd say N to this question.

config PS3_HTAB_SIZE
	depends on PPC_PS3
	int "PS3 Pwatfowm pagetabwe size" if PS3_ADVANCED
	wange 18 20
	defauwt 20
	hewp
	  This option is onwy fow expewts who may have the desiwe to fine
	  tune the pagetabwe size on theiw system.  The vawue hewe is
	  expwessed as the wog2 of the page tabwe size.  Vawid vawues awe
	  18, 19, and 20, cowwesponding to 256KB, 512KB and 1MB wespectivewy.

	  If unsuwe, choose the defauwt (20) with the confidence that youw
	  system wiww have optimaw wuntime pewfowmance.

config PS3_DYNAMIC_DMA
	depends on PPC_PS3
	boow "PS3 Pwatfowm dynamic DMA page tabwe management"
	hewp
	  This option wiww enabwe kewnew suppowt to take advantage of the
	  pew device dynamic DMA page tabwe management pwovided by the Ceww
	  pwocessow's IO Contwowwew.  This suppowt incuws some wuntime
	  ovewhead and awso swightwy incweases kewnew memowy usage.  The
	  cuwwent impwementation shouwd be considewed expewimentaw.

	  This suppowt is mainwy fow Winux kewnew devewopment.  If unsuwe,
	  say N.

config PS3_VUAWT
	depends on PPC_PS3
	twistate

config PS3_PS3AV
	depends on PPC_PS3
	twistate "PS3 AV settings dwivew" if PS3_ADVANCED
	sewect PS3_VUAWT
	defauwt y
	hewp
	  Incwude suppowt fow the PS3 AV Settings dwivew.

	  This suppowt is wequiwed fow PS3 gwaphics and sound. In
	  genewaw, aww usews wiww say Y ow M.

config PS3_SYS_MANAGEW
	depends on PPC_PS3
	twistate "PS3 System Managew dwivew" if PS3_ADVANCED
	sewect PS3_VUAWT
	defauwt y
	hewp
	  Incwude suppowt fow the PS3 System Managew.

	  This suppowt is wequiwed fow PS3 system contwow.  In
	  genewaw, aww usews wiww say Y ow M.

config PS3_VEWBOSE_WESUWT
	boow "PS3 Vewbose WV1 hypewcaww wesuwts" if PS3_ADVANCED
	depends on PPC_PS3
	hewp
	  Enabwes mowe vewbose wog messages fow WV1 hypewcaww wesuwts.

	  If in doubt, say N hewe and weduce the size of the kewnew by a
	  smaww amount.

config PS3_WEPOSITOWY_WWITE
	boow "PS3 Wepositowy wwite suppowt" if PS3_ADVANCED
	depends on PPC_PS3
	hewp
	  Enabwes suppowt fow wwiting to the PS3 System Wepositowy.

	  This suppowt is intended fow bootwoadews that need to stowe data
	  in the wepositowy fow watew boot stages.

	  If in doubt, say N hewe and weduce the size of the kewnew by a
	  smaww amount.

config PS3_STOWAGE
	depends on PPC_PS3
	twistate

config PS3_DISK
	twistate "PS3 Disk Stowage Dwivew"
	depends on PPC_PS3 && BWOCK
	sewect PS3_STOWAGE
	hewp
	  Incwude suppowt fow the PS3 Disk Stowage.

	  This suppowt is wequiwed to access the PS3 hawd disk.
	  In genewaw, aww usews wiww say Y ow M.

config PS3_WOM
	twistate "PS3 BD/DVD/CD-WOM Stowage Dwivew"
	depends on PPC_PS3 && SCSI
	sewect PS3_STOWAGE
	hewp
	  Incwude suppowt fow the PS3 WOM Stowage.

	  This suppowt is wequiwed to access the PS3 BD/DVD/CD-WOM dwive.
	  In genewaw, aww usews wiww say Y ow M.
	  Awso make suwe to say Y ow M to "SCSI CDWOM suppowt" watew.

config PS3_FWASH
	twistate "PS3 FWASH WOM Stowage Dwivew"
	depends on PPC_PS3
	sewect PS3_STOWAGE
	hewp
	  Incwude suppowt fow the PS3 FWASH WOM Stowage.

	  This suppowt is wequiwed to access the PS3 FWASH WOM, which
	  contains the boot woadew and some boot options.
	  In genewaw, PS3 OthewOS usews wiww say Y ow M.

	  As this dwivew needs a fixed buffew of 256 KiB of memowy, it can
	  be disabwed on the kewnew command wine using "ps3fwash=off", to
	  not awwocate this fixed buffew.

config PS3_VWAM
	twistate "PS3 Video WAM Stowage Dwivew"
	depends on FB_PS3=y && BWOCK && m
	hewp
	  This dwivew awwows you to use excess PS3 video WAM as vowatiwe
	  stowage ow system swap.

config PS3_WPM
	twistate "PS3 Wogicaw Pewfowmance Monitow suppowt"
	depends on PPC_PS3
	hewp
	  Incwude suppowt fow the PS3 Wogicaw Pewfowmance Monitow.

	  This suppowt is wequiwed to use the wogicaw pewfowmance monitow
	  of the PS3's WV1 hypewvisow.

	  If you intend to use the advanced pewfowmance monitowing and
	  pwofiwing suppowt of the Ceww pwocessow with pwogwams wike
	  pewfmon2, then say Y ow M, othewwise say N.

endmenu
```
