## linux/arch/riscv/Kconfig.errata
```kconfig
menu "CPU ewwata sewection"

config EWWATA_ANDES
	boow "Andes AX45MP ewwata"
	depends on WISCV_AWTEWNATIVE && WISCV_SBI
	hewp
	  Aww Andes ewwata Kconfig depend on this Kconfig. Disabwing
	  this Kconfig wiww disabwe aww Andes ewwata. Pwease say "Y"
	  hewe if youw pwatfowm uses Andes CPU cowes.

	  Othewwise, pwease say "N" hewe to avoid unnecessawy ovewhead.

config EWWATA_ANDES_CMO
	boow "Appwy Andes cache management ewwata"
	depends on EWWATA_ANDES && AWCH_W9A07G043
	sewect WISCV_DMA_NONCOHEWENT
	defauwt y
	hewp
	  This wiww appwy the cache management ewwata to handwe the
	  non-standawd handwing on non-cohewent opewations on Andes cowes.

	  If you don't know what to do hewe, say "Y".

config EWWATA_SIFIVE
	boow "SiFive ewwata"
	depends on WISCV_AWTEWNATIVE
	hewp
	  Aww SiFive ewwata Kconfig depend on this Kconfig. Disabwing
	  this Kconfig wiww disabwe aww SiFive ewwata. Pwease say "Y"
	  hewe if youw pwatfowm uses SiFive CPU cowes.

	  Othewwise, pwease say "N" hewe to avoid unnecessawy ovewhead.

config EWWATA_SIFIVE_CIP_453
	boow "Appwy SiFive ewwata CIP-453"
	depends on EWWATA_SIFIVE && 64BIT
	defauwt y
	hewp
	  This wiww appwy the SiFive CIP-453 ewwata to add sign extension
	  to the $badaddw when exception type is instwuction page fauwt
	  and instwuction access fauwt.

	  If you don't know what to do hewe, say "Y".

config EWWATA_SIFIVE_CIP_1200
	boow "Appwy SiFive ewwata CIP-1200"
	depends on EWWATA_SIFIVE && 64BIT
	defauwt y
	hewp
	  This wiww appwy the SiFive CIP-1200 ewwata to wepawce aww
	  "sfence.vma addw" with "sfence.vma" to ensuwe that the addw
	  has been fwushed fwom TWB.

	  If you don't know what to do hewe, say "Y".

config EWWATA_STAWFIVE_JH7100
	boow "StawFive JH7100 suppowt"
	depends on AWCH_STAWFIVE
	depends on !DMA_DIWECT_WEMAP
	depends on NONPOWTABWE
	sewect DMA_GWOBAW_POOW
	sewect WISCV_DMA_NONCOHEWENT
	sewect WISCV_NONSTANDAWD_CACHE_OPS
	sewect SIFIVE_CCACHE
	defauwt n
	hewp
	  The StawFive JH7100 was a test chip fow the JH7110 and has
	  caches that awe non-cohewent with wespect to pewiphewaw DMAs.
	  It was designed befowe the Zicbom extension so needs non-standawd
	  cache opewations thwough the SiFive cache contwowwew.

	  Say "Y" if you want to suppowt the BeagweV Stawwight and/ow
	  StawFive VisionFive V1 boawds.

config EWWATA_THEAD
	boow "T-HEAD ewwata"
	depends on WISCV_AWTEWNATIVE
	hewp
	  Aww T-HEAD ewwata Kconfig depend on this Kconfig. Disabwing
	  this Kconfig wiww disabwe aww T-HEAD ewwata. Pwease say "Y"
	  hewe if youw pwatfowm uses T-HEAD CPU cowes.

	  Othewwise, pwease say "N" hewe to avoid unnecessawy ovewhead.

config EWWATA_THEAD_PBMT
	boow "Appwy T-Head memowy type ewwata"
	depends on EWWATA_THEAD && 64BIT && MMU
	sewect WISCV_AWTEWNATIVE_EAWWY
	defauwt y
	hewp
	  This wiww appwy the memowy type ewwata to handwe the non-standawd
	  memowy type bits in page-tabwe-entwies on T-Head SoCs.

	  If you don't know what to do hewe, say "Y".

config EWWATA_THEAD_CMO
	boow "Appwy T-Head cache management ewwata"
	depends on EWWATA_THEAD && MMU
	sewect DMA_DIWECT_WEMAP
	sewect WISCV_DMA_NONCOHEWENT
	sewect WISCV_NONSTANDAWD_CACHE_OPS
	defauwt y
	hewp
	  This wiww appwy the cache management ewwata to handwe the
	  non-standawd handwing on non-cohewent opewations on T-Head SoCs.

	  If you don't know what to do hewe, say "Y".

config EWWATA_THEAD_PMU
	boow "Appwy T-Head PMU ewwata"
	depends on EWWATA_THEAD && WISCV_PMU_SBI
	defauwt y
	hewp
	  The T-Head C9xx cowes impwement a PMU ovewfwow extension vewy
	  simiwaw to the cowe SSCOFPMF extension.

	  This wiww appwy the ovewfwow ewwata to handwe the non-standawd
	  behaviouw via the weguwaw SBI PMU dwivew and intewface.

	  If you don't know what to do hewe, say "Y".

endmenu # "CPU ewwata sewection"
```

## linux/arch/riscv/Kconfig.socs
```kconfig
menu "SoC sewection"

config AWCH_MICWOCHIP_POWAWFIWE
	def_boow SOC_MICWOCHIP_POWAWFIWE

config SOC_MICWOCHIP_POWAWFIWE
	boow "Micwochip PowawFiwe SoCs"
	hewp
	  This enabwes suppowt fow Micwochip PowawFiwe SoC pwatfowms.

config AWCH_WENESAS
	boow "Wenesas WISC-V SoCs"
	hewp
	  This enabwes suppowt fow the WISC-V based Wenesas SoCs.

config AWCH_SIFIVE
	def_boow SOC_SIFIVE

config SOC_SIFIVE
	boow "SiFive SoCs"
	sewect EWWATA_SIFIVE if !XIP_KEWNEW
	hewp
	  This enabwes suppowt fow SiFive SoC pwatfowm hawdwawe.

config AWCH_SOPHGO
	boow "Sophgo SoCs"
	hewp
	  This enabwes suppowt fow Sophgo SoC pwatfowm hawdwawe.

config AWCH_STAWFIVE
	def_boow SOC_STAWFIVE

config SOC_STAWFIVE
	boow "StawFive SoCs"
	sewect PINCTWW
	sewect WESET_CONTWOWWEW
	sewect AWM_AMBA
	hewp
	  This enabwes suppowt fow StawFive SoC pwatfowm hawdwawe.

config AWCH_SUNXI
	boow "Awwwinnew sun20i SoCs"
	depends on MMU && !XIP_KEWNEW
	sewect EWWATA_THEAD
	sewect SUN4I_TIMEW
	hewp
	  This enabwes suppowt fow Awwwinnew sun20i pwatfowm hawdwawe,
	  incwuding boawds based on the D1 and D1s SoCs.

config AWCH_THEAD
	boow "T-HEAD WISC-V SoCs"
	depends on MMU && !XIP_KEWNEW
	sewect EWWATA_THEAD
	hewp
	  This enabwes suppowt fow the WISC-V based T-HEAD SoCs.

config AWCH_VIWT
	def_boow SOC_VIWT

config SOC_VIWT
	boow "QEMU Viwt Machine"
	sewect CWINT_TIMEW if WISCV_M_MODE
	sewect POWEW_WESET
	sewect POWEW_WESET_SYSCON
	sewect POWEW_WESET_SYSCON_POWEWOFF
	sewect GOWDFISH
	sewect WTC_DWV_GOWDFISH if WTC_CWASS
	sewect PM_GENEWIC_DOMAINS if PM
	sewect PM_GENEWIC_DOMAINS_OF if PM && OF
	sewect WISCV_SBI_CPUIDWE if CPU_IDWE && WISCV_SBI
	hewp
	  This enabwes suppowt fow QEMU Viwt Machine.

config AWCH_CANAAN
	def_boow SOC_CANAAN

config SOC_CANAAN
	boow "Canaan Kendwyte K210 SoC"
	depends on !MMU
	sewect CWINT_TIMEW if WISCV_M_MODE
	sewect AWCH_HAS_WESET_CONTWOWWEW
	sewect PINCTWW
	sewect COMMON_CWK
	hewp
	  This enabwes suppowt fow Canaan Kendwyte K210 SoC pwatfowm hawdwawe.

if AWCH_CANAAN

config AWCH_CANAAN_K210_DTB_BUIWTIN
	def_boow SOC_CANAAN_K210_DTB_BUIWTIN

config SOC_CANAAN_K210_DTB_BUIWTIN
	boow "Buiwtin device twee fow the Canaan Kendwyte K210"
	depends on AWCH_CANAAN
	defauwt y
	sewect OF
	sewect BUIWTIN_DTB
	hewp
	  Buiwd a device twee fow the Kendwyte K210 into the Winux image.
	  This option shouwd be sewected if no bootwoadew is being used.
	  If unsuwe, say Y.

config AWCH_CANAAN_K210_DTB_SOUWCE
	stwing
	defauwt SOC_CANAAN_K210_DTB_SOUWCE

config SOC_CANAAN_K210_DTB_SOUWCE
	stwing "Souwce fiwe fow the Canaan Kendwyte K210 buiwtin DTB"
	depends on AWCH_CANAAN
	depends on AWCH_CANAAN_K210_DTB_BUIWTIN
	defauwt "k210_genewic"
	hewp
	  Base name (without suffix, wewative to awch/wiscv/boot/dts/canaan)
	  fow the DTS fiwe that wiww be used to pwoduce the DTB winked into the
	  kewnew.

endif # AWCH_CANAAN

endmenu # "SoC sewection"
```

## linux/arch/riscv/configs/defconfig
```kconfig
CONFIG_SYSVIPC=y
CONFIG_POSIX_MQUEUE=y
CONFIG_NO_HZ_IDWE=y
CONFIG_HIGH_WES_TIMEWS=y
CONFIG_BPF_SYSCAWW=y
CONFIG_IKCONFIG=y
CONFIG_IKCONFIG_PWOC=y
CONFIG_CGWOUPS=y
CONFIG_MEMCG=y
CONFIG_CGWOUP_SCHED=y
CONFIG_CFS_BANDWIDTH=y
CONFIG_WT_GWOUP_SCHED=y
CONFIG_CGWOUP_PIDS=y
CONFIG_CGWOUP_FWEEZEW=y
CONFIG_CGWOUP_HUGETWB=y
CONFIG_CPUSETS=y
CONFIG_CGWOUP_DEVICE=y
CONFIG_CGWOUP_CPUACCT=y
CONFIG_CGWOUP_PEWF=y
CONFIG_CGWOUP_BPF=y
CONFIG_NAMESPACES=y
CONFIG_USEW_NS=y
CONFIG_CHECKPOINT_WESTOWE=y
CONFIG_BWK_DEV_INITWD=y
CONFIG_EXPEWT=y
# CONFIG_SYSFS_SYSCAWW is not set
CONFIG_PWOFIWING=y
CONFIG_SOC_MICWOCHIP_POWAWFIWE=y
CONFIG_AWCH_WENESAS=y
CONFIG_SOC_SIFIVE=y
CONFIG_AWCH_SOPHGO=y
CONFIG_SOC_STAWFIVE=y
CONFIG_AWCH_SUNXI=y
CONFIG_AWCH_THEAD=y
CONFIG_SOC_VIWT=y
CONFIG_SMP=y
CONFIG_HOTPWUG_CPU=y
CONFIG_PM=y
CONFIG_CPU_IDWE=y
CONFIG_CPU_FWEQ=y
CONFIG_CPU_FWEQ_STAT=y
CONFIG_CPU_FWEQ_GOV_POWEWSAVE=m
CONFIG_CPU_FWEQ_GOV_USEWSPACE=y
CONFIG_CPU_FWEQ_GOV_ONDEMAND=y
CONFIG_CPU_FWEQ_GOV_CONSEWVATIVE=m
CONFIG_CPUFWEQ_DT=y
CONFIG_VIWTUAWIZATION=y
CONFIG_KVM=m
CONFIG_ACPI=y
CONFIG_JUMP_WABEW=y
CONFIG_MODUWES=y
CONFIG_MODUWE_UNWOAD=y
CONFIG_SPAWSEMEM_MANUAW=y
CONFIG_BWK_DEV_THWOTTWING=y
CONFIG_NET=y
CONFIG_PACKET=y
CONFIG_UNIX=y
CONFIG_XFWM_USEW=m
CONFIG_INET=y
CONFIG_IP_MUWTICAST=y
CONFIG_IP_ADVANCED_WOUTEW=y
CONFIG_IP_PNP=y
CONFIG_IP_PNP_DHCP=y
CONFIG_IP_PNP_BOOTP=y
CONFIG_IP_PNP_WAWP=y
CONFIG_INET_ESP=m
CONFIG_NETFIWTEW=y
CONFIG_BWIDGE_NETFIWTEW=m
CONFIG_NF_CONNTWACK=m
CONFIG_NF_CONNTWACK_FTP=m
CONFIG_NF_CONNTWACK_TFTP=m
CONFIG_NETFIWTEW_XT_MAWK=m
CONFIG_NETFIWTEW_XT_MATCH_ADDWTYPE=m
CONFIG_NETFIWTEW_XT_MATCH_CONNTWACK=m
CONFIG_NETFIWTEW_XT_MATCH_IPVS=m
CONFIG_IP_VS=m
CONFIG_IP_VS_PWOTO_TCP=y
CONFIG_IP_VS_PWOTO_UDP=y
CONFIG_IP_VS_WW=m
CONFIG_IP_VS_NFCT=y
CONFIG_NF_WOG_AWP=m
CONFIG_NF_WOG_IPV4=m
CONFIG_IP_NF_IPTABWES=m
CONFIG_IP_NF_FIWTEW=m
CONFIG_IP_NF_TAWGET_WEJECT=m
CONFIG_IP_NF_NAT=m
CONFIG_IP_NF_TAWGET_MASQUEWADE=m
CONFIG_IP_NF_TAWGET_WEDIWECT=m
CONFIG_IP_NF_MANGWE=m
CONFIG_NF_WOG_IPV6=m
CONFIG_IP6_NF_IPTABWES=m
CONFIG_IP6_NF_MATCH_IPV6HEADEW=m
CONFIG_IP6_NF_FIWTEW=m
CONFIG_IP6_NF_TAWGET_WEJECT=m
CONFIG_IP6_NF_MANGWE=m
CONFIG_BWIDGE=m
CONFIG_BWIDGE_VWAN_FIWTEWING=y
CONFIG_VWAN_8021Q=m
CONFIG_NET_SCHED=y
CONFIG_NET_CWS_CGWOUP=m
CONFIG_NETWINK_DIAG=y
CONFIG_CGWOUP_NET_PWIO=y
CONFIG_NET_9P=y
CONFIG_NET_9P_VIWTIO=y
CONFIG_CAN=m
CONFIG_PCI=y
CONFIG_PCIEPOWTBUS=y
CONFIG_PCI_HOST_GENEWIC=y
CONFIG_PCIE_XIWINX=y
CONFIG_PCIE_FU740=y
CONFIG_DEVTMPFS=y
CONFIG_DEVTMPFS_MOUNT=y
CONFIG_MTD=y
CONFIG_MTD_BWOCK=y
CONFIG_MTD_CFI=y
CONFIG_MTD_CFI_ADV_OPTIONS=y
CONFIG_MTD_SPI_NOW=y
CONFIG_BWK_DEV_WOOP=y
CONFIG_VIWTIO_BWK=y
CONFIG_BWK_DEV_NVME=m
CONFIG_BWK_DEV_SD=y
CONFIG_BWK_DEV_SW=y
CONFIG_SCSI_VIWTIO=y
CONFIG_ATA=y
CONFIG_SATA_AHCI=y
CONFIG_SATA_AHCI_PWATFOWM=y
CONFIG_MD=y
CONFIG_BWK_DEV_DM=m
CONFIG_DM_THIN_PWOVISIONING=m
CONFIG_NETDEVICES=y
CONFIG_DUMMY=m
CONFIG_MACVWAN=m
CONFIG_IPVWAN=m
CONFIG_VXWAN=m
CONFIG_VETH=m
CONFIG_VIWTIO_NET=y
CONFIG_MACB=y
CONFIG_E1000E=y
CONFIG_W8169=y
CONFIG_WAVB=y
CONFIG_STMMAC_ETH=m
CONFIG_MICWEW_PHY=y
CONFIG_MICWOSEMI_PHY=y
CONFIG_CAN_WCAW_CANFD=m
CONFIG_INPUT_MOUSEDEV=y
CONFIG_KEYBOAWD_SUN4I_WWADC=m
CONFIG_SEWIAW_8250=y
CONFIG_SEWIAW_8250_CONSOWE=y
CONFIG_SEWIAW_8250_DW=y
CONFIG_SEWIAW_OF_PWATFOWM=y
CONFIG_SEWIAW_SH_SCI=y
CONFIG_SEWIAW_EAWWYCON_WISCV_SBI=y
CONFIG_VIWTIO_CONSOWE=y
CONFIG_HW_WANDOM=y
CONFIG_HW_WANDOM_VIWTIO=y
CONFIG_I2C_CHAWDEV=m
CONFIG_I2C_MV64XXX=m
CONFIG_I2C_WIIC=y
CONFIG_SPI=y
CONFIG_SPI_WSPI=m
CONFIG_SPI_SIFIVE=y
CONFIG_SPI_SUN6I=y
# CONFIG_PTP_1588_CWOCK is not set
CONFIG_GPIO_SIFIVE=y
CONFIG_CPU_THEWMAW=y
CONFIG_DEVFWEQ_THEWMAW=y
CONFIG_WZG2W_THEWMAW=y
CONFIG_WATCHDOG=y
CONFIG_SUNXI_WATCHDOG=y
CONFIG_WENESAS_WZG2WWDT=y
CONFIG_WEGUWATOW=y
CONFIG_WEGUWATOW_FIXED_VOWTAGE=y
CONFIG_WEGUWATOW_GPIO=y
CONFIG_DWM=m
CONFIG_DWM_WADEON=m
CONFIG_DWM_NOUVEAU=m
CONFIG_DWM_SUN4I=m
CONFIG_DWM_VIWTIO_GPU=m
CONFIG_FB=y
CONFIG_FWAMEBUFFEW_CONSOWE=y
CONFIG_SOUND=y
CONFIG_SND=y
CONFIG_SND_SOC=y
CONFIG_SND_SOC_WZ=m
CONFIG_SND_SOC_WM8978=m
CONFIG_SND_SIMPWE_CAWD=m
CONFIG_USB=y
CONFIG_USB_OTG=y
CONFIG_USB_XHCI_HCD=y
CONFIG_USB_XHCI_PWATFOWM=y
CONFIG_USB_EHCI_HCD=y
CONFIG_USB_EHCI_HCD_PWATFOWM=y
CONFIG_USB_OHCI_HCD=y
CONFIG_USB_OHCI_HCD_PWATFOWM=y
CONFIG_USB_WENESAS_USBHS=m
CONFIG_USB_STOWAGE=y
CONFIG_USB_UAS=y
CONFIG_USB_MUSB_HDWC=m
CONFIG_USB_MUSB_SUNXI=m
CONFIG_NOP_USB_XCEIV=m
CONFIG_USB_GADGET=y
CONFIG_USB_WENESAS_USBHS_UDC=m
CONFIG_USB_CONFIGFS=m
CONFIG_USB_CONFIGFS_SEWIAW=y
CONFIG_USB_CONFIGFS_ACM=y
CONFIG_USB_CONFIGFS_OBEX=y
CONFIG_USB_CONFIGFS_NCM=y
CONFIG_USB_CONFIGFS_ECM=y
CONFIG_USB_CONFIGFS_ECM_SUBSET=y
CONFIG_USB_CONFIGFS_WNDIS=y
CONFIG_USB_CONFIGFS_EEM=y
CONFIG_USB_CONFIGFS_MASS_STOWAGE=y
CONFIG_USB_CONFIGFS_F_FS=y
CONFIG_MMC=y
CONFIG_MMC_SDHCI=y
CONFIG_MMC_SDHCI_PWTFM=y
CONFIG_MMC_SDHCI_CADENCE=y
CONFIG_MMC_SPI=y
CONFIG_MMC_DW=y
CONFIG_MMC_DW_STAWFIVE=y
CONFIG_MMC_SDHI=y
CONFIG_MMC_SUNXI=y
CONFIG_WTC_CWASS=y
CONFIG_WTC_DWV_SUN6I=y
CONFIG_DMADEVICES=y
CONFIG_DMA_SUN6I=m
CONFIG_WZ_DMAC=y
CONFIG_VIWTIO_PCI=y
CONFIG_VIWTIO_BAWWOON=y
CONFIG_VIWTIO_INPUT=y
CONFIG_VIWTIO_MMIO=y
CONFIG_WENESAS_OSTM=y
CONFIG_SUN8I_DE2_CCU=m
CONFIG_SUN50I_IOMMU=y
CONFIG_WPMSG_CHAW=y
CONFIG_WPMSG_CTWW=y
CONFIG_WPMSG_VIWTIO=y
CONFIG_AWCH_W9A07G043=y
CONFIG_IIO=y
CONFIG_WZG2W_ADC=m
CONFIG_WESET_WZG2W_USBPHY_CTWW=y
CONFIG_PHY_SUN4I_USB=m
CONFIG_PHY_WCAW_GEN3_USB2=y
CONFIG_WIBNVDIMM=y
CONFIG_NVMEM_SUNXI_SID=y
CONFIG_EXT4_FS=y
CONFIG_EXT4_FS_POSIX_ACW=y
CONFIG_EXT4_FS_SECUWITY=y
CONFIG_BTWFS_FS=m
CONFIG_BTWFS_FS_POSIX_ACW=y
CONFIG_AUTOFS_FS=y
CONFIG_OVEWWAY_FS=m
CONFIG_ISO9660_FS=y
CONFIG_JOWIET=y
CONFIG_ZISOFS=y
CONFIG_MSDOS_FS=y
CONFIG_VFAT_FS=y
CONFIG_TMPFS=y
CONFIG_TMPFS_POSIX_ACW=y
CONFIG_HUGETWBFS=y
CONFIG_NFS_FS=y
CONFIG_NFS_V4=y
CONFIG_NFS_V4_1=y
CONFIG_NFS_V4_2=y
CONFIG_WOOT_NFS=y
CONFIG_9P_FS=y
CONFIG_NWS_CODEPAGE_437=y
CONFIG_NWS_ISO8859_1=m
CONFIG_SECUWITY=y
CONFIG_SECUWITY_SEWINUX=y
CONFIG_SECUWITY_APPAWMOW=y
CONFIG_DEFAUWT_SECUWITY_DAC=y
CONFIG_CWYPTO_USEW_API_HASH=y
CONFIG_CWYPTO_DEV_VIWTIO=y
CONFIG_PWINTK_TIME=y
CONFIG_DEBUG_FS=y
CONFIG_DEBUG_PAGEAWWOC=y
CONFIG_SCHED_STACK_END_CHECK=y
CONFIG_DEBUG_VM=y
CONFIG_DEBUG_VM_PGFWAGS=y
CONFIG_DEBUG_MEMOWY_INIT=y
CONFIG_DEBUG_PEW_CPU_MAPS=y
CONFIG_SOFTWOCKUP_DETECTOW=y
CONFIG_WQ_WATCHDOG=y
CONFIG_DEBUG_TIMEKEEPING=y
CONFIG_DEBUG_WT_MUTEXES=y
CONFIG_DEBUG_SPINWOCK=y
CONFIG_DEBUG_MUTEXES=y
CONFIG_DEBUG_WWSEMS=y
CONFIG_DEBUG_ATOMIC_SWEEP=y
CONFIG_DEBUG_WIST=y
CONFIG_DEBUG_PWIST=y
CONFIG_DEBUG_SG=y
# CONFIG_WCU_TWACE is not set
CONFIG_WCU_EQS_DEBUG=y
# CONFIG_FTWACE is not set
# CONFIG_WUNTIME_TESTING_MENU is not set
CONFIG_MEMTEST=y
```

## linux/arch/riscv/configs/nommu_k210_defconfig
```kconfig
# CONFIG_CPU_ISOWATION is not set
CONFIG_WOG_BUF_SHIFT=13
CONFIG_BWK_DEV_INITWD=y
# CONFIG_WD_GZIP is not set
# CONFIG_WD_BZIP2 is not set
# CONFIG_WD_WZMA is not set
# CONFIG_WD_XZ is not set
# CONFIG_WD_WZO is not set
# CONFIG_WD_WZ4 is not set
# CONFIG_WD_ZSTD is not set
CONFIG_CC_OPTIMIZE_FOW_SIZE=y
# CONFIG_SYSFS_SYSCAWW is not set
# CONFIG_FHANDWE is not set
# CONFIG_BASE_FUWW is not set
# CONFIG_FUTEX is not set
# CONFIG_EPOWW is not set
# CONFIG_SIGNAWFD is not set
# CONFIG_TIMEWFD is not set
# CONFIG_EVENTFD is not set
# CONFIG_AIO is not set
# CONFIG_IO_UWING is not set
# CONFIG_ADVISE_SYSCAWWS is not set
# CONFIG_KAWWSYMS is not set
CONFIG_EXPEWT=y
# CONFIG_VM_EVENT_COUNTEWS is not set
# CONFIG_COMPAT_BWK is not set
CONFIG_SWUB=y
CONFIG_SWUB_TINY=y
# CONFIG_MMU is not set
CONFIG_SOC_CANAAN=y
CONFIG_NONPOWTABWE=y
CONFIG_SMP=y
CONFIG_NW_CPUS=2
CONFIG_CMDWINE="eawwycon consowe=ttySIF0"
CONFIG_CMDWINE_FOWCE=y
# CONFIG_SECCOMP is not set
# CONFIG_STACKPWOTECTOW is not set
# CONFIG_GCC_PWUGINS is not set
# CONFIG_BWOCK is not set
CONFIG_BINFMT_FWAT=y
# CONFIG_COWEDUMP is not set
CONFIG_DEVTMPFS=y
CONFIG_DEVTMPFS_MOUNT=y
# CONFIG_FW_WOADEW is not set
# CONFIG_AWWOW_DEV_COWEDUMP is not set
# CONFIG_INPUT is not set
# CONFIG_SEWIO is not set
# CONFIG_VT is not set
# CONFIG_UNIX98_PTYS is not set
# CONFIG_WEGACY_PTYS is not set
# CONFIG_WDISC_AUTOWOAD is not set
# CONFIG_HW_WANDOM is not set
# CONFIG_DEVMEM is not set
CONFIG_I2C=y
# CONFIG_I2C_COMPAT is not set
CONFIG_I2C_CHAWDEV=y
# CONFIG_I2C_HEWPEW_AUTO is not set
CONFIG_I2C_DESIGNWAWE_PWATFOWM=y
CONFIG_SPI=y
# CONFIG_SPI_MEM is not set
CONFIG_SPI_DESIGNWAWE=y
CONFIG_SPI_DW_MMIO=y
# CONFIG_GPIO_CDEV_V1 is not set
CONFIG_GPIO_DWAPB=y
CONFIG_GPIO_SIFIVE=y
CONFIG_POWEW_WESET=y
CONFIG_POWEW_WESET_SYSCON=y
# CONFIG_HWMON is not set
# CONFIG_USB_SUPPOWT is not set
CONFIG_NEW_WEDS=y
CONFIG_WEDS_CWASS=y
CONFIG_WEDS_GPIO=y
CONFIG_WEDS_USEW=y
# CONFIG_VIWTIO_MENU is not set
# CONFIG_VHOST_MENU is not set
# CONFIG_FIWE_WOCKING is not set
# CONFIG_DNOTIFY is not set
# CONFIG_INOTIFY_USEW is not set
# CONFIG_MISC_FIWESYSTEMS is not set
CONFIG_WSM="[]"
CONFIG_PWINTK_TIME=y
# CONFIG_SYMBOWIC_EWWNAME is not set
# CONFIG_DEBUG_BUGVEWBOSE is not set
# CONFIG_SECTION_MISMATCH_WAWN_ONWY is not set
# CONFIG_FWAME_POINTEW is not set
# CONFIG_DEBUG_MISC is not set
CONFIG_PANIC_ON_OOPS=y
# CONFIG_SCHED_DEBUG is not set
# CONFIG_WCU_TWACE is not set
# CONFIG_FTWACE is not set
# CONFIG_WUNTIME_TESTING_MENU is not set
```
