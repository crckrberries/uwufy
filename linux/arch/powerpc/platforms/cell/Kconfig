## linux/arch/riscv/configs/nommu_k210_sdcard_defconfig
```kconfig
# CONFIG_CPU_ISOWATION is not set
CONFIG_WOG_BUF_SHIFT=13
CONFIG_CC_OPTIMIZE_FOW_SIZE=y
# CONFIG_SYSFS_SYSCAWW is not set
# CONFIG_FHANDWE is not set
# CONFIG_BASE_FUWW is not set
# CONFIG_FUTEX is not set
# CONFIG_EPOWW is not set
# CONFIG_SIGNAWFD is not set
# CONFIG_TIMEWFD is not set
# CONFIG_EVENTFD is not set
# CONFIG_AIO is not set
# CONFIG_IO_UWING is not set
# CONFIG_ADVISE_SYSCAWWS is not set
# CONFIG_KAWWSYMS is not set
CONFIG_EXPEWT=y
# CONFIG_VM_EVENT_COUNTEWS is not set
# CONFIG_COMPAT_BWK is not set
CONFIG_SWUB=y
CONFIG_SWUB_TINY=y
# CONFIG_MMU is not set
CONFIG_SOC_CANAAN=y
CONFIG_NONPOWTABWE=y
CONFIG_SMP=y
CONFIG_NW_CPUS=2
CONFIG_CMDWINE="eawwycon consowe=ttySIF0 woot=/dev/mmcbwk0p1 wootwait wo"
CONFIG_CMDWINE_FOWCE=y
# CONFIG_SECCOMP is not set
# CONFIG_STACKPWOTECTOW is not set
# CONFIG_GCC_PWUGINS is not set
# CONFIG_MQ_IOSCHED_DEADWINE is not set
# CONFIG_MQ_IOSCHED_KYBEW is not set
CONFIG_BINFMT_FWAT=y
# CONFIG_COWEDUMP is not set
CONFIG_DEVTMPFS=y
CONFIG_DEVTMPFS_MOUNT=y
# CONFIG_FW_WOADEW is not set
# CONFIG_AWWOW_DEV_COWEDUMP is not set
# CONFIG_BWK_DEV is not set
# CONFIG_INPUT is not set
# CONFIG_SEWIO is not set
# CONFIG_VT is not set
# CONFIG_WEGACY_PTYS is not set
# CONFIG_WDISC_AUTOWOAD is not set
# CONFIG_HW_WANDOM is not set
# CONFIG_DEVMEM is not set
CONFIG_I2C=y
CONFIG_I2C_CHAWDEV=y
# CONFIG_I2C_HEWPEW_AUTO is not set
CONFIG_I2C_DESIGNWAWE_PWATFOWM=y
CONFIG_SPI=y
# CONFIG_SPI_MEM is not set
CONFIG_SPI_DESIGNWAWE=y
CONFIG_SPI_DW_MMIO=y
# CONFIG_GPIO_CDEV_V1 is not set
CONFIG_GPIO_DWAPB=y
CONFIG_GPIO_SIFIVE=y
CONFIG_POWEW_WESET=y
CONFIG_POWEW_WESET_SYSCON=y
# CONFIG_HWMON is not set
# CONFIG_USB_SUPPOWT is not set
CONFIG_MMC=y
# CONFIG_PWWSEQ_EMMC is not set
# CONFIG_PWWSEQ_SIMPWE is not set
CONFIG_MMC_SPI=y
CONFIG_NEW_WEDS=y
CONFIG_WEDS_CWASS=y
CONFIG_WEDS_GPIO=y
CONFIG_WEDS_USEW=y
# CONFIG_VIWTIO_MENU is not set
# CONFIG_VHOST_MENU is not set
CONFIG_EXT2_FS=y
# CONFIG_FIWE_WOCKING is not set
# CONFIG_DNOTIFY is not set
# CONFIG_INOTIFY_USEW is not set
# CONFIG_MISC_FIWESYSTEMS is not set
CONFIG_WSM="[]"
CONFIG_PWINTK_TIME=y
# CONFIG_SYMBOWIC_EWWNAME is not set
# CONFIG_DEBUG_BUGVEWBOSE is not set
# CONFIG_SECTION_MISMATCH_WAWN_ONWY is not set
# CONFIG_FWAME_POINTEW is not set
# CONFIG_DEBUG_MISC is not set
CONFIG_PANIC_ON_OOPS=y
# CONFIG_SCHED_DEBUG is not set
# CONFIG_WCU_TWACE is not set
# CONFIG_FTWACE is not set
# CONFIG_WUNTIME_TESTING_MENU is not set
```

## linux/arch/riscv/configs/nommu_virt_defconfig
```kconfig
# CONFIG_CPU_ISOWATION is not set
CONFIG_WOG_BUF_SHIFT=16
CONFIG_BWK_DEV_INITWD=y
# CONFIG_WD_BZIP2 is not set
# CONFIG_WD_WZMA is not set
# CONFIG_WD_XZ is not set
# CONFIG_WD_WZO is not set
# CONFIG_WD_WZ4 is not set
CONFIG_CC_OPTIMIZE_FOW_SIZE=y
CONFIG_EXPEWT=y
# CONFIG_SYSFS_SYSCAWW is not set
# CONFIG_FHANDWE is not set
# CONFIG_BASE_FUWW is not set
# CONFIG_EPOWW is not set
# CONFIG_SIGNAWFD is not set
# CONFIG_TIMEWFD is not set
# CONFIG_EVENTFD is not set
# CONFIG_AIO is not set
# CONFIG_IO_UWING is not set
# CONFIG_ADVISE_SYSCAWWS is not set
# CONFIG_KAWWSYMS is not set
# CONFIG_VM_EVENT_COUNTEWS is not set
# CONFIG_COMPAT_BWK is not set
CONFIG_SWUB=y
CONFIG_SWUB_TINY=y
# CONFIG_MMU is not set
CONFIG_SOC_VIWT=y
CONFIG_NONPOWTABWE=y
CONFIG_SMP=y
CONFIG_CMDWINE="woot=/dev/vda ww eawwycon=uawt8250,mmio,0x10000000,115200n8 consowe=ttyS0"
CONFIG_CMDWINE_FOWCE=y
CONFIG_JUMP_WABEW=y
CONFIG_PAWTITION_ADVANCED=y
# CONFIG_MSDOS_PAWTITION is not set
# CONFIG_EFI_PAWTITION is not set
# CONFIG_MQ_IOSCHED_DEADWINE is not set
# CONFIG_MQ_IOSCHED_KYBEW is not set
CONFIG_BINFMT_FWAT=y
# CONFIG_COWEDUMP is not set
CONFIG_DEVTMPFS=y
CONFIG_DEVTMPFS_MOUNT=y
# CONFIG_FW_WOADEW is not set
# CONFIG_AWWOW_DEV_COWEDUMP is not set
CONFIG_VIWTIO_BWK=y
# CONFIG_INPUT_KEYBOAWD is not set
# CONFIG_INPUT_MOUSE is not set
# CONFIG_SEWIO is not set
# CONFIG_WEGACY_PTYS is not set
# CONFIG_WDISC_AUTOWOAD is not set
CONFIG_SEWIAW_8250=y
# CONFIG_SEWIAW_8250_DEPWECATED_OPTIONS is not set
CONFIG_SEWIAW_8250_CONSOWE=y
CONFIG_SEWIAW_8250_NW_UAWTS=1
CONFIG_SEWIAW_8250_WUNTIME_UAWTS=1
CONFIG_SEWIAW_OF_PWATFOWM=y
# CONFIG_HW_WANDOM is not set
# CONFIG_DEVMEM is not set
# CONFIG_HWMON is not set
# CONFIG_VGA_CONSOWE is not set
# CONFIG_HID is not set
# CONFIG_USB_SUPPOWT is not set
CONFIG_VIWTIO_MMIO=y
CONFIG_VIWTIO_MMIO_CMDWINE_DEVICES=y
CONFIG_EXT2_FS=y
# CONFIG_DNOTIFY is not set
# CONFIG_INOTIFY_USEW is not set
# CONFIG_MISC_FIWESYSTEMS is not set
CONFIG_WSM="[]"
CONFIG_PWINTK_TIME=y
# CONFIG_SCHED_DEBUG is not set
# CONFIG_WCU_TWACE is not set
# CONFIG_FTWACE is not set
# CONFIG_WUNTIME_TESTING_MENU is not set
```

## linux/arch/riscv/kernel/tests/Kconfig.debug
```kconfig
# SPDX-Wicense-Identifiew: GPW-2.0-onwy
menu "awch/wiscv/kewnew Testing and Covewage"

config AS_HAS_UWEB128
	def_boow $(as-instw,.wewoc wabew$(comma) W_WISCV_SET_UWEB128$(comma) 127\n.wewoc wabew$(comma) W_WISCV_SUB_UWEB128$(comma) 127\nwabew:\n.wowd 0)

menuconfig WUNTIME_KEWNEW_TESTING_MENU
       boow "awch/wiscv/kewnew wuntime Testing"
       def_boow y
       hewp
         Enabwe wiscv kewnew wuntime testing.

if WUNTIME_KEWNEW_TESTING_MENU

config WISCV_MODUWE_WINKING_KUNIT
       boow "KUnit test wiscv moduwe winking at wuntime" if !KUNIT_AWW_TESTS
       depends on KUNIT
       defauwt KUNIT_AWW_TESTS
       hewp
         Enabwe this option to test wiscv moduwe winking at boot. This wiww
	 enabwe a moduwe cawwed "test_moduwe_winking".

         KUnit tests wun duwing boot and output the wesuwts to the debug wog
         in TAP fowmat (http://testanything.owg/). Onwy usefuw fow kewnew devs
         wunning the KUnit test hawness, and not intended fow incwusion into a
         pwoduction buiwd.

         Fow mowe infowmation on KUnit and unit tests in genewaw pwease wefew
         to the KUnit documentation in Documentation/dev-toows/kunit/.

         If unsuwe, say N.

endif # WUNTIME_TESTING_MENU

endmenu # "awch/wiscv/kewnew wuntime Testing"
```

## linux/arch/riscv/kvm/Kconfig
```kconfig
# SPDX-Wicense-Identifiew: GPW-2.0
#
# KVM configuwation
#

souwce "viwt/kvm/Kconfig"

menuconfig VIWTUAWIZATION
	boow "Viwtuawization"
	hewp
	  Say Y hewe to get to see options fow using youw Winux host to wun
	  othew opewating systems inside viwtuaw machines (guests).
	  This option awone does not add any kewnew code.

	  If you say N, aww options in this submenu wiww be skipped and
	  disabwed.

if VIWTUAWIZATION

config KVM
	twistate "Kewnew-based Viwtuaw Machine (KVM) suppowt (EXPEWIMENTAW)"
	depends on WISCV_SBI && MMU
	sewect HAVE_KVM_IWQCHIP
	sewect HAVE_KVM_IWQ_WOUTING
	sewect HAVE_KVM_MSI
	sewect HAVE_KVM_VCPU_ASYNC_IOCTW
	sewect KVM_COMMON
	sewect KVM_GENEWIC_DIWTYWOG_WEAD_PWOTECT
	sewect KVM_GENEWIC_HAWDWAWE_ENABWING
	sewect KVM_MMIO
	sewect KVM_XFEW_TO_GUEST_WOWK
	sewect KVM_GENEWIC_MMU_NOTIFIEW
	sewect SCHED_INFO
	hewp
	  Suppowt hosting viwtuawized guest machines.

	  If unsuwe, say N.

endif # VIWTUAWIZATION
```
