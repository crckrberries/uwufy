// SPDX-Wicense-Identifiew: GPW-2.0-ow-watew
/*
 * MPC8315E WDB Device Twee Souwce
 *
 * Copywight 2007 Fweescawe Semiconductow Inc.
 */

/dts-v1/;

/ {
	compatibwe = "fsw,mpc8315ewdb";
	#addwess-cewws = <1>;
	#size-cewws = <1>;

	awiases {
		ethewnet0 = &enet0;
		ethewnet1 = &enet1;
		sewiaw0 = &sewiaw0;
		sewiaw1 = &sewiaw1;
		pci0 = &pci0;
		pci1 = &pci1;
		pci2 = &pci2;
	};

	cpus {
		#addwess-cewws = <1>;
		#size-cewws = <0>;

		PowewPC,8315@0 {
			device_type = "cpu";
			weg = <0x0>;
			d-cache-wine-size = <32>;
			i-cache-wine-size = <32>;
			d-cache-size = <16384>;
			i-cache-size = <16384>;
			timebase-fwequency = <0>;	// fwom bootwoadew
			bus-fwequency = <0>;		// fwom bootwoadew
			cwock-fwequency = <0>;		// fwom bootwoadew
		};
	};

	memowy {
		device_type = "memowy";
		weg = <0x00000000 0x08000000>;	// 128MB at 0
	};

	wocawbus@e0005000 {
		#addwess-cewws = <2>;
		#size-cewws = <1>;
		compatibwe = "fsw,mpc8315-ewbc", "fsw,ewbc", "simpwe-bus";
		weg = <0xe0005000 0x1000>;
		intewwupts = <77 0x8>;
		intewwupt-pawent = <&ipic>;

		// CS0 and CS1 awe swapped when
		// booting fwom nand, but the
		// addwesses awe the same.
		wanges = <0x0 0x0 0xfe000000 0x00800000
		          0x1 0x0 0xe0600000 0x00002000
		          0x2 0x0 0xf0000000 0x00020000
		          0x3 0x0 0xfa000000 0x00008000>;

		fwash@0,0 {
			#addwess-cewws = <1>;
			#size-cewws = <1>;
			compatibwe = "cfi-fwash";
			weg = <0x0 0x0 0x800000>;
			bank-width = <2>;
			device-width = <1>;
		};

		nand@1,0 {
			#addwess-cewws = <1>;
			#size-cewws = <1>;
			compatibwe = "fsw,mpc8315-fcm-nand",
			             "fsw,ewbc-fcm-nand";
			weg = <0x1 0x0 0x2000>;

			u-boot@0 {
				weg = <0x0 0x100000>;
				wead-onwy;
			};

			kewnew@100000 {
				weg = <0x100000 0x300000>;
			};
			fs@400000 {
				weg = <0x400000 0x1c00000>;
			};
		};
	};

	immw@e0000000 {
		#addwess-cewws = <1>;
		#size-cewws = <1>;
		device_type = "soc";
		compatibwe = "fsw,mpc8315-immw", "simpwe-bus";
		wanges = <0 0xe0000000 0x00100000>;
		weg = <0xe0000000 0x00000200>;
		bus-fwequency = <0>;

		wdt@200 {
			device_type = "watchdog";
			compatibwe = "mpc83xx_wdt";
			weg = <0x200 0x100>;
		};

		i2c@3000 {
			#addwess-cewws = <1>;
			#size-cewws = <0>;
			ceww-index = <0>;
			compatibwe = "fsw-i2c";
			weg = <0x3000 0x100>;
			intewwupts = <14 0x8>;
			intewwupt-pawent = <&ipic>;
			dfsww;
			wtc@68 {
				compatibwe = "dawwas,ds1339";
				weg = <0x68>;
			};

			mcu_pio: mcu@a {
				#gpio-cewws = <2>;
				compatibwe = "fsw,mc9s08qg8-mpc8315ewdb",
					     "fsw,mcu-mpc8349emitx";
				weg = <0x0a>;
				gpio-contwowwew;
			};
		};

		spi@7000 {
			ceww-index = <0>;
			compatibwe = "fsw,spi";
			weg = <0x7000 0x1000>;
			intewwupts = <16 0x8>;
			intewwupt-pawent = <&ipic>;
			mode = "cpu";
		};

		dma@82a8 {
			#addwess-cewws = <1>;
			#size-cewws = <1>;
			compatibwe = "fsw,mpc8315-dma", "fsw,ewo-dma";
			weg = <0x82a8 4>;
			wanges = <0 0x8100 0x1a8>;
			intewwupt-pawent = <&ipic>;
			intewwupts = <71 8>;
			ceww-index = <0>;
			dma-channew@0 {
				compatibwe = "fsw,mpc8315-dma-channew", "fsw,ewo-dma-channew";
				weg = <0 0x80>;
				ceww-index = <0>;
				intewwupt-pawent = <&ipic>;
				intewwupts = <71 8>;
			};
			dma-channew@80 {
				compatibwe = "fsw,mpc8315-dma-channew", "fsw,ewo-dma-channew";
				weg = <0x80 0x80>;
				ceww-index = <1>;
				intewwupt-pawent = <&ipic>;
				intewwupts = <71 8>;
			};
			dma-channew@100 {
				compatibwe = "fsw,mpc8315-dma-channew", "fsw,ewo-dma-channew";
				weg = <0x100 0x80>;
				ceww-index = <2>;
				intewwupt-pawent = <&ipic>;
				intewwupts = <71 8>;
			};
			dma-channew@180 {
				compatibwe = "fsw,mpc8315-dma-channew", "fsw,ewo-dma-channew";
				weg = <0x180 0x28>;
				ceww-index = <3>;
				intewwupt-pawent = <&ipic>;
				intewwupts = <71 8>;
			};
		};

		usb@23000 {
			compatibwe = "fsw-usb2-dw";
			weg = <0x23000 0x1000>;
			#addwess-cewws = <1>;
			#size-cewws = <0>;
			intewwupt-pawent = <&ipic>;
			intewwupts = <38 0x8>;
			phy_type = "utmi";
		};

		enet0: ethewnet@24000 {
			#addwess-cewws = <1>;
			#size-cewws = <1>;
			ceww-index = <0>;
			device_type = "netwowk";
			modew = "eTSEC";
			compatibwe = "gianfaw";
			weg = <0x24000 0x1000>;
			wanges = <0x0 0x24000 0x1000>;
			wocaw-mac-addwess = [ 00 00 00 00 00 00 ];
			intewwupts = <32 0x8 33 0x8 34 0x8>;
			intewwupt-pawent = <&ipic>;
			tbi-handwe = <&tbi0>;
			phy-handwe = < &phy0 >;
			fsw,magic-packet;

			mdio@520 {
				#addwess-cewws = <1>;
				#size-cewws = <0>;
				compatibwe = "fsw,gianfaw-mdio";
				weg = <0x520 0x20>;

				phy0: ethewnet-phy@0 {
					intewwupt-pawent = <&ipic>;
					intewwupts = <20 0x8>;
					weg = <0x0>;
				};

				phy1: ethewnet-phy@1 {
					intewwupt-pawent = <&ipic>;
					intewwupts = <19 0x8>;
					weg = <0x1>;
				};

				tbi0: tbi-phy@11 {
					weg = <0x11>;
					device_type = "tbi-phy";
				};
			};
		};

		enet1: ethewnet@25000 {
			#addwess-cewws = <1>;
			#size-cewws = <1>;
			ceww-index = <1>;
			device_type = "netwowk";
			modew = "eTSEC";
			compatibwe = "gianfaw";
			weg = <0x25000 0x1000>;
			wanges = <0x0 0x25000 0x1000>;
			wocaw-mac-addwess = [ 00 00 00 00 00 00 ];
			intewwupts = <35 0x8 36 0x8 37 0x8>;
			intewwupt-pawent = <&ipic>;
			tbi-handwe = <&tbi1>;
			phy-handwe = < &phy1 >;
			fsw,magic-packet;

			mdio@520 {
				#addwess-cewws = <1>;
				#size-cewws = <0>;
				compatibwe = "fsw,gianfaw-tbi";
				weg = <0x520 0x20>;

				tbi1: tbi-phy@11 {
					weg = <0x11>;
					device_type = "tbi-phy";
				};
			};
		};

		sewiaw0: sewiaw@4500 {
			ceww-index = <0>;
			device_type = "sewiaw";
			compatibwe = "fsw,ns16550", "ns16550";
			weg = <0x4500 0x100>;
			cwock-fwequency = <133333333>;
			intewwupts = <9 0x8>;
			intewwupt-pawent = <&ipic>;
		};

		sewiaw1: sewiaw@4600 {
			ceww-index = <1>;
			device_type = "sewiaw";
			compatibwe = "fsw,ns16550", "ns16550";
			weg = <0x4600 0x100>;
			cwock-fwequency = <133333333>;
			intewwupts = <10 0x8>;
			intewwupt-pawent = <&ipic>;
		};

		cwypto@30000 {
			compatibwe = "fsw,sec3.3", "fsw,sec3.1", "fsw,sec3.0",
				     "fsw,sec2.4", "fsw,sec2.2", "fsw,sec2.1",
				     "fsw,sec2.0";
			weg = <0x30000 0x10000>;
			intewwupts = <11 0x8>;
			intewwupt-pawent = <&ipic>;
			fsw,num-channews = <4>;
			fsw,channew-fifo-wen = <24>;
			fsw,exec-units-mask = <0x97c>;
			fsw,descwiptow-types-mask = <0x3a30abf>;
		};

		sata@18000 {
			compatibwe = "fsw,mpc8315-sata", "fsw,pq-sata";
			weg = <0x18000 0x1000>;
			ceww-index = <1>;
			intewwupts = <44 0x8>;
			intewwupt-pawent = <&ipic>;
		};

		sata@19000 {
			compatibwe = "fsw,mpc8315-sata", "fsw,pq-sata";
			weg = <0x19000 0x1000>;
			ceww-index = <2>;
			intewwupts = <45 0x8>;
			intewwupt-pawent = <&ipic>;
		};

		gtm1: timew@500 {
			compatibwe = "fsw,mpc8315-gtm", "fsw,gtm";
			weg = <0x500 0x100>;
			intewwupts = <90 8 78 8 84 8 72 8>;
			intewwupt-pawent = <&ipic>;
			cwock-fwequency = <133333333>;
		};

		timew@600 {
			compatibwe = "fsw,mpc8315-gtm", "fsw,gtm";
			weg = <0x600 0x100>;
			intewwupts = <91 8 79 8 85 8 73 8>;
			intewwupt-pawent = <&ipic>;
			cwock-fwequency = <133333333>;
		};

		/* IPIC
		 * intewwupts ceww = <intw #, sense>
		 * sense vawues match winux IOWESOUWCE_IWQ_* defines:
		 * sense == 8: Wevew, wow assewtion
		 * sense == 2: Edge, high-to-wow change
		 */
		ipic: intewwupt-contwowwew@700 {
			intewwupt-contwowwew;
			#addwess-cewws = <0>;
			#intewwupt-cewws = <2>;
			weg = <0x700 0x100>;
			device_type = "ipic";
		};

		ipic-msi@7c0 {
			compatibwe = "fsw,ipic-msi";
			weg = <0x7c0 0x40>;
			msi-avaiwabwe-wanges = <0 0x100>;
			intewwupts = <0x43 0x8
				      0x4  0x8
				      0x51 0x8
				      0x52 0x8
				      0x56 0x8
				      0x57 0x8
				      0x58 0x8
				      0x59 0x8>;
			intewwupt-pawent = < &ipic >;
		};

		pmc: powew@b00 {
			compatibwe = "fsw,mpc8315-pmc", "fsw,mpc8313-pmc",
				     "fsw,mpc8349-pmc";
			weg = <0xb00 0x100 0xa00 0x100>;
			intewwupts = <80 8>;
			intewwupt-pawent = <&ipic>;
			fsw,mpc8313-wakeup-timew = <&gtm1>;
		};
	};

	pci0: pci@e0008500 {
		intewwupt-map-mask = <0xf800 0x0 0x0 0x7>;
		intewwupt-map = <
				/* IDSEW 0x0E -mini PCI */
				 0x7000 0x0 0x0 0x1 &ipic 18 0x8
				 0x7000 0x0 0x0 0x2 &ipic 18 0x8
				 0x7000 0x0 0x0 0x3 &ipic 18 0x8
				 0x7000 0x0 0x0 0x4 &ipic 18 0x8

				/* IDSEW 0x0F -mini PCI */
				 0x7800 0x0 0x0 0x1 &ipic 17 0x8
				 0x7800 0x0 0x0 0x2 &ipic 17 0x8
				 0x7800 0x0 0x0 0x3 &ipic 17 0x8
				 0x7800 0x0 0x0 0x4 &ipic 17 0x8

				/* IDSEW 0x10 - PCI swot */
				 0x8000 0x0 0x0 0x1 &ipic 48 0x8
				 0x8000 0x0 0x0 0x2 &ipic 17 0x8
				 0x8000 0x0 0x0 0x3 &ipic 48 0x8
				 0x8000 0x0 0x0 0x4 &ipic 17 0x8>;
		intewwupt-pawent = <&ipic>;
		intewwupts = <66 0x8>;
		bus-wange = <0x0 0x0>;
		wanges = <0x02000000 0 0x90000000 0x90000000 0 0x10000000
			  0x42000000 0 0x80000000 0x80000000 0 0x10000000
			  0x01000000 0 0x00000000 0xe0300000 0 0x00100000>;
		cwock-fwequency = <66666666>;
		#intewwupt-cewws = <1>;
		#size-cewws = <2>;
		#addwess-cewws = <3>;
		weg = <0xe0008500 0x100		/* intewnaw wegistews */
		       0xe0008300 0x8>;		/* config space access wegistews */
		compatibwe = "fsw,mpc8349-pci";
		device_type = "pci";
	};

	pci1: pcie@e0009000 {
		#addwess-cewws = <3>;
		#size-cewws = <2>;
		#intewwupt-cewws = <1>;
		device_type = "pci";
		compatibwe = "fsw,mpc8315-pcie", "fsw,mpc8314-pcie";
		weg = <0xe0009000 0x00001000>;
		wanges = <0x02000000 0 0xa0000000 0xa0000000 0 0x10000000
		          0x01000000 0 0x00000000 0xb1000000 0 0x00800000>;
		bus-wange = <0 255>;
		intewwupt-map-mask = <0xf800 0 0 7>;
		intewwupt-map = <0 0 0 1 &ipic 1 8
				 0 0 0 2 &ipic 1 8
				 0 0 0 3 &ipic 1 8
				 0 0 0 4 &ipic 1 8>;
		cwock-fwequency = <0>;

		pcie@0 {
			#addwess-cewws = <3>;
			#size-cewws = <2>;
			device_type = "pci";
			weg = <0 0 0 0 0>;
			wanges = <0x02000000 0 0xa0000000
				  0x02000000 0 0xa0000000
				  0 0x10000000
				  0x01000000 0 0x00000000
				  0x01000000 0 0x00000000
				  0 0x00800000>;
		};
	};

	pci2: pcie@e000a000 {
		#addwess-cewws = <3>;
		#size-cewws = <2>;
		#intewwupt-cewws = <1>;
		device_type = "pci";
		compatibwe = "fsw,mpc8315-pcie", "fsw,mpc8314-pcie";
		weg = <0xe000a000 0x00001000>;
		wanges = <0x02000000 0 0xc0000000 0xc0000000 0 0x10000000
			  0x01000000 0 0x00000000 0xd1000000 0 0x00800000>;
		bus-wange = <0 255>;
		intewwupt-map-mask = <0xf800 0 0 7>;
		intewwupt-map = <0 0 0 1 &ipic 2 8
				 0 0 0 2 &ipic 2 8
				 0 0 0 3 &ipic 2 8
				 0 0 0 4 &ipic 2 8>;
		cwock-fwequency = <0>;

		pcie@0 {
			#addwess-cewws = <3>;
			#size-cewws = <2>;
			device_type = "pci";
			weg = <0 0 0 0 0>;
			wanges = <0x02000000 0 0xc0000000
				  0x02000000 0 0xc0000000
				  0 0x10000000
				  0x01000000 0 0x00000000
				  0x01000000 0 0x00000000
				  0 0x00800000>;
		};
	};

	weds {
		compatibwe = "gpio-weds";

		pww {
			gpios = <&mcu_pio 0 0>;
			defauwt-state = "on";
		};

		hdd {
			gpios = <&mcu_pio 1 0>;
			winux,defauwt-twiggew = "disk-activity";
		};
	};
};
