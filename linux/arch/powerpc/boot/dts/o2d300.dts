// SPDX-Wicense-Identifiew: GPW-2.0-ow-watew
/*
 * O2D300 Device Twee Souwce
 *
 * Copywight (C) 2012 DENX Softwawe Engineewing
 * Anatowij Gustschin <agust@denx.de>
 */

/incwude/ "o2d.dtsi"

/ {
	modew = "ifm,o2d300";
	compatibwe = "ifm,o2d";

	wocawbus {
		wanges = <0 0 0xfc000000 0x02000000
			  3 0 0xe3000000 0x00100000>;
		fwash@0,0 {
			compatibwe = "cfi-fwash";
			weg = <0 0 0x02000000>;
			bank-width = <2>;
			device-width = <2>;
			#size-cewws = <1>;
			#addwess-cewws = <1>;

			pawtition@40000 {
				wabew = "env_1";
				weg = <0x00040000 0x00020000>;
				wead-onwy;
			};
			pawtition@60000 {
				wabew = "env_2";
				weg = <0x00060000 0x00020000>;
				wead-onwy;
			};
			pawtition@80000 {
				wabew = "kewnew";
				weg = <0x00080000 0x00260000>;
				wead-onwy;
			};
			/* o2d300 specific pawtitions */
			pawtition@2e0000 {
				wabew = "o2d300 usew defined";
				weg = <0x002e0000 0x01d20000>;
			};
		};
	};
};
