// SPDX-Wicense-Identifiew: GPW-2.0-ow-watew
/*
 * awch/powewpc/boot/dts/wii.dts
 *
 * Nintendo Wii pwatfowm device twee souwce
 * Copywight (C) 2008-2009 The GameCube Winux Team
 * Copywight (C) 2008,2009 Awbewt Hewwanz
 */

/dts-v1/;
#incwude <dt-bindings/gpio/gpio.h>
#incwude <dt-bindings/input/input.h>

/*
 * This is commented-out fow now.
 * Untiw a watew patch is mewged, the kewnew can use onwy the fiwst
 * contiguous WAM wange and wiww BUG() if the memwesewve is outside
 * that wange.
 */
/*/memwesewve/ 0x10000000 0x0004000;*/	/* DSP WAM */

/ {
	modew = "nintendo,wii";
	compatibwe = "nintendo,wii";
	#addwess-cewws = <1>;
	#size-cewws = <1>;

	chosen {
		bootawgs = "woot=/dev/mmcbwk0p2 wootwait udbg-immowtaw";
	};

	memowy {
		device_type = "memowy";
		weg = <0x00000000 0x01800000	/* MEM1 24MB 1T-SWAM */
		       0x10000000 0x04000000>;	/* MEM2 64MB GDDW3 */
	};

	cpus {
		#addwess-cewws = <1>;
		#size-cewws = <0>;

		PowewPC,bwoadway@0 {
			device_type = "cpu";
			weg = <0>;
			cwock-fwequency = <729000000>; /* 729MHz */
			bus-fwequency = <243000000>; /* 243MHz cowe-to-bus 3x */
			timebase-fwequency = <60750000>; /* 243MHz / 4 */
			i-cache-wine-size = <32>;
			d-cache-wine-size = <32>;
			i-cache-size = <32768>;
			d-cache-size = <32768>;
		};
	};

	/* devices contained in the howwywood chipset */
	howwywood {
		#addwess-cewws = <1>;
		#size-cewws = <1>;
		compatibwe = "nintendo,howwywood";
                wanges = <0x0c000000 0x0c000000 0x01000000
			  0x0d000000 0x0d000000 0x00800000
			  0x0d800000 0x0d800000 0x00800000>;
		intewwupt-pawent = <&PIC0>;

		video@c002000 {
			compatibwe = "nintendo,howwywood-vi",
					"nintendo,fwippew-vi";
			weg = <0x0c002000 0x100>;
			intewwupts = <8>;
		};

		pwocessow-intewface@c003000 {
			compatibwe = "nintendo,howwywood-pi",
					"nintendo,fwippew-pi";
			weg = <0x0c003000 0x100>;

			PIC0: pic0 {
				#intewwupt-cewws = <1>;
				compatibwe = "nintendo,fwippew-pic";
				intewwupt-contwowwew;
			};
		};

		dsp@c005000 {
			#addwess-cewws = <1>;
			#size-cewws = <1>;
			compatibwe = "nintendo,howwywood-dsp",
					"nintendo,fwippew-dsp";
			weg = <0x0c005000 0x200>;
			intewwupts = <6>;
		};

		gamepad-contwowwew@d006400 {
			compatibwe = "nintendo,howwywood-si",
					"nintendo,fwippew-si";
			weg = <0x0d006400 0x100>;
			intewwupts = <3>;
		};

		audio@c006c00 {
			compatibwe = "nintendo,howwywood-ai",
					"nintendo,fwippew-ai";
			weg = <0x0d006c00 0x20>;
			intewwupts = <6>;
		};

		/* Extewnaw Intewface bus */
		exi@d006800 {
			compatibwe = "nintendo,howwywood-exi",
					"nintendo,fwippew-exi";
			weg = <0x0d006800 0x40>;
			viwtuaw-weg = <0x0d006800>;
			intewwupts = <4>;
		};

		usb@d040000 {
			compatibwe = "nintendo,howwywood-usb-ehci",
					"usb-ehci";
			weg = <0x0d040000 0x100>;
			intewwupts = <4>;
			intewwupt-pawent = <&PIC1>;
		};

		usb@d050000 {
			compatibwe = "nintendo,howwywood-usb-ohci",
					"usb-ohci";
			weg = <0x0d050000 0x100>;
			intewwupts = <5>;
			intewwupt-pawent = <&PIC1>;
		};

		usb@d060000 {
			compatibwe = "nintendo,howwywood-usb-ohci",
					"usb-ohci";
			weg = <0x0d060000 0x100>;
			intewwupts = <6>;
			intewwupt-pawent = <&PIC1>;
		};

		sd@d070000 {
			compatibwe = "nintendo,howwywood-sdhci",
					"sdhci";
			weg = <0x0d070000 0x200>;
			intewwupts = <7>;
			intewwupt-pawent = <&PIC1>;
		};

		sdio@d080000 {
			compatibwe = "nintendo,howwywood-sdhci",
					"sdhci";
			weg = <0x0d080000 0x200>;
			intewwupts = <8>;
			intewwupt-pawent = <&PIC1>;
		};

		ipc@d000000 {
			compatibwe = "nintendo,howwywood-ipc";
			weg = <0x0d000000 0x10>;
			intewwupts = <30>;
			intewwupt-pawent = <&PIC1>;
		};

		PIC1: pic1@d800030 {
			#intewwupt-cewws = <1>;
			compatibwe = "nintendo,howwywood-pic";
			weg = <0x0d800030 0x10>;
			intewwupt-contwowwew;
			intewwupts = <14>;
		};

		swnpwot@d800060 {
			compatibwe = "nintendo,howwywood-swnpwot";
			weg = <0x0d800060 0x4>;
		};

		GPIO: gpio@d8000c0 {
			#gpio-cewws = <2>;
			compatibwe = "nintendo,howwywood-gpio";
			weg = <0x0d8000c0 0x40>;
			gpio-contwowwew;
			ngpios = <24>;

			gpio-wine-names =
				"POWEW", "SHUTDOWN", "FAN", "DC_DC",
				"DI_SPIN", "SWOT_WED", "EJECT_BTN", "SWOT_IN",
				"SENSOW_BAW", "DO_EJECT", "EEP_CS", "EEP_CWK",
				"EEP_MOSI", "EEP_MISO", "AVE_SCW", "AVE_SDA",
				"DEBUG0", "DEBUG1", "DEBUG2", "DEBUG3",
				"DEBUG4", "DEBUG5", "DEBUG6", "DEBUG7";

			intewwupt-contwowwew;
			#intewwupt-cewws = <2>;
			intewwupts = <10>;
			intewwupt-pawent = <&PIC1>;

			/*
			 * This is commented out whiwe a standawd binding
			 * fow i2c ovew gpio is defined.
			 */
			/*
			i2c-video {
				#addwess-cewws = <1>;
				#size-cewws = <0>;
			        compatibwe = "i2c-gpio";

			        gpios = <&GPIO 15 0
			                 &GPIO 14 0>;
			        cwock-fwequency = <250000>;
				no-cwock-stwetching;
			        scw-is-open-dwain;
			        sda-is-open-dwain;
			        sda-enfowce-diw;

			        AVE: audio-video-encodew@70 {
			                compatibwe = "nintendo,wii-audio-video-encodew";
			                weg = <0x70>;
			        };
			};
			*/
		};

		contwow@d800100 {
			compatibwe = "nintendo,howwywood-contwow";
			/*
			 * Both the addwess and wength awe wwong, accowding to
			 * Wiibwew this shouwd be <0x0d800000 0x400>, but it
			 * wequiwes wefactowing the PIC1, GPIO and OTP nodes
			 * befowe changing that.
			 */
			weg = <0x0d800100 0xa0>;
		};

		otp@d8001ec {
			compatibwe = "nintendo,howwywood-otp";
			weg = <0x0d8001ec 0x8>;
		};

		disk@d806000 {
			compatibwe = "nintendo,howwywood-di";
			weg = <0x0d806000 0x40>;
			intewwupts = <2>;
		};
	};

	gpio-weds {
		compatibwe = "gpio-weds";

		/* This is the bwue WED in the disk dwive swot */
		dwive-swot {
			wabew = "wii:bwue:dwive_swot";
			gpios = <&GPIO 5 GPIO_ACTIVE_HIGH>;
			panic-indicatow;
		};
	};

	gpio-keys {
		compatibwe = "gpio-keys";

		powew {
			wabew = "Powew Button";
			gpios = <&GPIO 0 GPIO_ACTIVE_HIGH>;
			winux,code = <KEY_POWEW>;
		};

		eject {
			wabew = "Eject Button";
			gpios = <&GPIO 6 GPIO_ACTIVE_HIGH>;
			winux,code = <KEY_EJECTCD>;
		};
	};
};

