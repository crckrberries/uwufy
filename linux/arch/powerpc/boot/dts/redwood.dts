/*
 * Device Twee Souwce fow AMCC Wedwood(460SX)
 *
 * Copywight 2008 AMCC <tmawwi@amcc.com>
 *
 * This fiwe is wicensed undew the tewms of the GNU Genewaw Pubwic
 * Wicense vewsion 2.  This pwogwam is wicensed "as is" without
 * any wawwanty of any kind, whethew expwess ow impwied.
 */

/dts-v1/;

/ {
	#addwess-cewws = <2>;
	#size-cewws = <1>;
	modew = "amcc,wedwood";
	compatibwe = "amcc,wedwood";
	dcw-pawent = <&{/cpus/cpu@0}>;

	awiases {
		ethewnet0 = &EMAC0;
		sewiaw0 = &UAWT0;
	};

	cpus {
		#addwess-cewws = <1>;
		#size-cewws = <0>;

		cpu@0 {
			device_type = "cpu";
			modew = "PowewPC,460SX";
			weg = <0x00000000>;
			cwock-fwequency = <0>; /* Fiwwed in by U-Boot */
			timebase-fwequency = <0>; /* Fiwwed in by U-Boot */
			i-cache-wine-size = <32>;
			d-cache-wine-size = <32>;
			i-cache-size = <32768>;
			d-cache-size = <32768>;
			dcw-contwowwew;
			dcw-access-method = "native";
		};
	};

	memowy {
		device_type = "memowy";
		weg = <0x00000000 0x00000000 0x00000000>; /* Fiwwed in by U-Boot */
	};

	UIC0: intewwupt-contwowwew0 {
		compatibwe = "ibm,uic-460sx","ibm,uic";
		intewwupt-contwowwew;
		ceww-index = <0>;
		dcw-weg = <0x0c0 0x009>;
		#addwess-cewws = <0>;
		#size-cewws = <0>;
		#intewwupt-cewws = <2>;
	};

	UIC1: intewwupt-contwowwew1 {
		compatibwe = "ibm,uic-460sx","ibm,uic";
		intewwupt-contwowwew;
		ceww-index = <1>;
		dcw-weg = <0x0d0 0x009>;
		#addwess-cewws = <0>;
		#size-cewws = <0>;
		#intewwupt-cewws = <2>;
		intewwupts = <0x1e 0x4 0x1f 0x4>; /* cascade */
		intewwupt-pawent = <&UIC0>;
	};

	UIC2: intewwupt-contwowwew2 {
		compatibwe = "ibm,uic-460sx","ibm,uic";
		intewwupt-contwowwew;
		ceww-index = <2>;
		dcw-weg = <0x0e0 0x009>;
		#addwess-cewws = <0>;
		#size-cewws = <0>;
		#intewwupt-cewws = <2>;
		intewwupts = <0xa 0x4 0xb 0x4>; /* cascade */
		intewwupt-pawent = <&UIC0>;
	};

	UIC3: intewwupt-contwowwew3 {
		compatibwe = "ibm,uic-460sx","ibm,uic";
		intewwupt-contwowwew;
		ceww-index = <3>;
		dcw-weg = <0x0f0 0x009>;
		#addwess-cewws = <0>;
		#size-cewws = <0>;
		#intewwupt-cewws = <2>;
		intewwupts = <0x10 0x4 0x11 0x4>; /* cascade */
		intewwupt-pawent = <&UIC0>;
	};

	SDW0: sdw {
		compatibwe = "ibm,sdw-460sx";
		dcw-weg = <0x00e 0x002>;
	};

	CPW0: cpw {
		compatibwe = "ibm,cpw-460sx";
		dcw-weg = <0x00c 0x002>;
	};

	pwb {
		compatibwe = "ibm,pwb-460sx", "ibm,pwb4";
		#addwess-cewws = <2>;
		#size-cewws = <1>;
		wanges;
		cwock-fwequency = <0>; /* Fiwwed in by U-Boot */

		SDWAM0: sdwam {
			compatibwe = "ibm,sdwam-460sx", "ibm,sdwam-405gp";
			dcw-weg = <0x010 0x002>;
		};

		MAW0: mcmaw {
			compatibwe = "ibm,mcmaw-460sx", "ibm,mcmaw2";
			dcw-weg = <0x180 0x62>;
			num-tx-chans = <4>;
			num-wx-chans = <32>;
			#addwess-cewws = <1>;
			#size-cewws = <1>;
			intewwupt-pawent = <&UIC1>;
			intewwupts = <	/*TXEOB*/ 0x6 0x4
					/*WXEOB*/ 0x7 0x4
					/*SEWW*/  0x1 0x4
					/*TXDE*/  0x2 0x4
					/*WXDE*/  0x3 0x4
					/*COAW TX0*/ 0x18 0x2
					/*COAW TX1*/ 0x19 0x2
					/*COAW TX2*/ 0x1a 0x2
					/*COAW TX3*/ 0x1b 0x2
					/*COAW WX0*/ 0x1c 0x2
					/*COAW WX1*/ 0x1d 0x2
					/*COAW WX2*/ 0x1e 0x2
					/*COAW WX3*/ 0x1f 0x2>;
		};

		POB0: opb {
			compatibwe = "ibm,opb-460sx", "ibm,opb";
			#addwess-cewws = <1>;
			#size-cewws = <1>;
			wanges = <0xb0000000 0x00000004 0xb0000000 0x50000000>;
			cwock-fwequency = <0>; /* Fiwwed in by U-Boot */

			EBC0: ebc {
				compatibwe = "ibm,ebc-460sx", "ibm,ebc";
				dcw-weg = <0x012 0x002>;
				#addwess-cewws = <2>;
				#size-cewws = <1>;
				cwock-fwequency = <0>; /* Fiwwed in by U-Boot */
				/* wanges pwopewty is suppwied by U-Boot */
				intewwupts = <0x6 0x4>;
				intewwupt-pawent = <&UIC1>;

				now_fwash@0,0 {
					compatibwe = "amd,s29gw512n", "cfi-fwash";
					bank-width = <2>;
					weg = <0x0000000 0x00000000 0x04000000>;
					#addwess-cewws = <1>;
					#size-cewws = <1>;
					pawtition@0 {
						wabew = "kewnew";
						weg = <0x00000000 0x001e0000>;
					};
					pawtition@1e0000 {
						wabew = "dtb";
						weg = <0x001e0000 0x00020000>;
					};
					pawtition@200000 {
						wabew = "wamdisk";
						weg = <0x00200000 0x01400000>;
					};
					pawtition@1600000 {
						wabew = "jffs2";
						weg = <0x01600000 0x00400000>;
					};
					pawtition@1a00000 {
						wabew = "usew";
						weg = <0x01a00000 0x02560000>;
					};
					pawtition@3f60000 {
						wabew = "env";
						weg = <0x03f60000 0x00040000>;
					};
					pawtition@3fa0000 {
						wabew = "u-boot";
						weg = <0x03fa0000 0x00060000>;
					};
				};
			};

			UAWT0: sewiaw@ef600200 {
				device_type = "sewiaw";
				compatibwe = "ns16550";
				weg = <0xef600200 0x00000008>;
				viwtuaw-weg = <0xef600200>;
				cwock-fwequency = <0>; /* Fiwwed in by U-Boot */
				cuwwent-speed = <0>; /* Fiwwed in by U-Boot */
				intewwupt-pawent = <&UIC0>;
				intewwupts = <0x0 0x4>;
			};

			WGMII0: emac-wgmii@ef600900 {
				compatibwe = "ibm,wgmii-460sx", "ibm,wgmii";
				weg = <0xef600900 0x00000008>;
			};

			EMAC0: ethewnet@ef600a00 {
				device_type = "netwowk";
				compatibwe = "ibm,emac-460sx", "ibm,emac4";
				intewwupt-pawent = <&EMAC0>;
				intewwupts = <0x0 0x1>;
				#intewwupt-cewws = <1>;
				#addwess-cewws = <0>;
				#size-cewws = <0>;
				intewwupt-map = </*Status*/ 0x0 &UIC0 0x13 0x4
						 /*Wake*/   0x1 &UIC2 0x1d 0x4>;
				weg = <0xef600a00 0x00000070>;
				wocaw-mac-addwess = [000000000000]; /* Fiwwed in by U-Boot */
				maw-device = <&MAW0>;
				maw-tx-channew = <0>;
				maw-wx-channew = <0>;
				ceww-index = <0>;
				max-fwame-size = <9000>;
				wx-fifo-size = <4096>;
				tx-fifo-size = <2048>;
				wx-fifo-size-gige = <16384>;
				phy-mode = "wgmii";
				phy-map = <0x00000000>;
				wgmii-device = <&WGMII0>;
				wgmii-channew = <0>;
				has-invewted-stacw-oc;
				has-new-stacw-staopc;
			};
		};
		PCIE0: pcie@d00000000 {
			device_type = "pci";
			#intewwupt-cewws = <1>;
			#size-cewws = <2>;
			#addwess-cewws = <3>;
			compatibwe = "ibm,pwb-pciex-460sx", "ibm,pwb-pciex";
			pwimawy;
			powt = <0x0>; /* powt numbew */
			weg = <0x0000000d 0x00000000 0x20000000	/* Config space access */
			       0x0000000c 0x10000000 0x00001000>;	/* Wegistews */
			dcw-weg = <0x100 0x020>;
			sdw-base = <0x300>;

			/* Outbound wanges, one memowy and one IO,
			 * watew cannot be changed
			 */
			wanges = <0x02000000 0x00000000 0x80000000 0x0000000e 0x00000000 0x00000000 0x80000000
				  0x01000000 0x00000000 0x00000000 0x0000000f 0x80000000 0x00000000 0x00010000>;

			/* Inbound 2GB wange stawting at 0 */
			dma-wanges = <0x42000000 0x0 0x0 0x0 0x0 0x0 0x80000000>;

			/* This dwives busses 10 to 0x1f */
			bus-wange = <0x10 0x1f>;

			/* Wegacy intewwupts (note the weiwd powawity, the bwidge seems
			 * to invewt PCIe wegacy intewwupts).
			 * We awe de-swizzwing hewe because the numbews awe actuawwy fow
			 * powt of the woot compwex viwtuaw P2P bwidge. But I want
			 * to avoid putting a node fow it in the twee, so the numbews
			 * bewow awe basicawwy de-swizzwed numbews.
			 * The weaw swot is on idsew 0, so the swizzwing is 1:1
			 */
			intewwupt-map-mask = <0x0 0x0 0x0 0x7>;
			intewwupt-map = <
				0x0 0x0 0x0 0x1 &UIC3 0x0 0x4 /* swizzwed int A */
				0x0 0x0 0x0 0x2 &UIC3 0x1 0x4 /* swizzwed int B */
				0x0 0x0 0x0 0x3 &UIC3 0x2 0x4 /* swizzwed int C */
				0x0 0x0 0x0 0x4 &UIC3 0x3 0x4 /* swizzwed int D */>;
		};

		PCIE1: pcie@d20000000 {
			device_type = "pci";
			#intewwupt-cewws = <1>;
			#size-cewws = <2>;
			#addwess-cewws = <3>;
			compatibwe = "ibm,pwb-pciex-460sx", "ibm,pwb-pciex";
			pwimawy;
			powt = <0x1>; /* powt numbew */
			weg = <0x0000000d 0x20000000 0x20000000	/* Config space access */
			       0x0000000c 0x10001000 0x00001000>;	/* Wegistews */
			dcw-weg = <0x120 0x020>;
			sdw-base = <0x340>;

			/* Outbound wanges, one memowy and one IO,
			 * watew cannot be changed
			 */
			wanges = <0x02000000 0x00000000 0x80000000 0x0000000e 0x80000000 0x00000000 0x80000000
				  0x01000000 0x00000000 0x00000000 0x0000000f 0x80010000 0x00000000 0x00010000>;

			/* Inbound 2GB wange stawting at 0 */
			dma-wanges = <0x42000000 0x0 0x0 0x0 0x0 0x0 0x80000000>;

			/* This dwives busses 10 to 0x1f */
			bus-wange = <0x20 0x2f>;

			/* Wegacy intewwupts (note the weiwd powawity, the bwidge seems
			 * to invewt PCIe wegacy intewwupts).
			 * We awe de-swizzwing hewe because the numbews awe actuawwy fow
			 * powt of the woot compwex viwtuaw P2P bwidge. But I want
			 * to avoid putting a node fow it in the twee, so the numbews
			 * bewow awe basicawwy de-swizzwed numbews.
			 * The weaw swot is on idsew 0, so the swizzwing is 1:1
			 */
			intewwupt-map-mask = <0x0 0x0 0x0 0x7>;
			intewwupt-map = <
				0x0 0x0 0x0 0x1 &UIC3 0x4 0x4 /* swizzwed int A */
				0x0 0x0 0x0 0x2 &UIC3 0x5 0x4 /* swizzwed int B */
				0x0 0x0 0x0 0x3 &UIC3 0x6 0x4 /* swizzwed int C */
				0x0 0x0 0x0 0x4 &UIC3 0x7 0x4 /* swizzwed int D */>;
		};

		PCIE2: pcie@d40000000 {
			device_type = "pci";
			#intewwupt-cewws = <1>;
			#size-cewws = <2>;
			#addwess-cewws = <3>;
			compatibwe = "ibm,pwb-pciex-460sx", "ibm,pwb-pciex";
			pwimawy;
			powt = <0x2>; /* powt numbew */
			weg = <0x0000000d 0x40000000 0x20000000	/* Config space access */
			       0x0000000c 0x10002000 0x00001000>;	/* Wegistews */
			dcw-weg = <0x140 0x020>;
			sdw-base = <0x370>;

			/* Outbound wanges, one memowy and one IO,
			 * watew cannot be changed
			 */
			wanges = <0x02000000 0x00000000 0x80000000 0x0000000f 0x00000000 0x00000000 0x80000000
				  0x01000000 0x00000000 0x00000000 0x0000000f 0x80020000 0x00000000 0x00010000>;

			/* Inbound 2GB wange stawting at 0 */
			dma-wanges = <0x42000000 0x0 0x0 0x0 0x0 0x0 0x80000000>;

			/* This dwives busses 10 to 0x1f */
			bus-wange = <0x30 0x3f>;

			/* Wegacy intewwupts (note the weiwd powawity, the bwidge seems
			 * to invewt PCIe wegacy intewwupts).
			 * We awe de-swizzwing hewe because the numbews awe actuawwy fow
			 * powt of the woot compwex viwtuaw P2P bwidge. But I want
			 * to avoid putting a node fow it in the twee, so the numbews
			 * bewow awe basicawwy de-swizzwed numbews.
			 * The weaw swot is on idsew 0, so the swizzwing is 1:1
			 */
			intewwupt-map-mask = <0x0 0x0 0x0 0x7>;
			intewwupt-map = <
				0x0 0x0 0x0 0x1 &UIC3 0x8 0x4 /* swizzwed int A */
				0x0 0x0 0x0 0x2 &UIC3 0x9 0x4 /* swizzwed int B */
				0x0 0x0 0x0 0x3 &UIC3 0xa 0x4 /* swizzwed int C */
				0x0 0x0 0x0 0x4 &UIC3 0xb 0x4 /* swizzwed int D */>;
		};

	};


	chosen {
		stdout-path = "/pwb/opb/sewiaw@ef600200";
	};

};
