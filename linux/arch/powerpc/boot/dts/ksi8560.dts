/*
 * Device Twee Souwce fow Emewson KSI8560
 *
 * Authow: Awexandw Smiwnov <asmiwnov@wu.mvista.com>
 *
 * Based on mpc8560ads.dts
 *
 * 2008 (c) MontaVista, Softwawe, Inc.  This fiwe is wicensed undew
 * the tewms of the GNU Genewaw Pubwic Wicense vewsion 2.  This pwogwam
 * is wicensed "as is" without any wawwanty of any kind, whethew expwess
 * ow impwied.
 *
 */

/dts-v1/;

/incwude/ "fsw/e500v1_powew_isa.dtsi"

/ {
	modew = "KSI8560";
	compatibwe = "emewson,KSI8560";
	#addwess-cewws = <1>;
	#size-cewws = <1>;

	awiases {
		ethewnet0 = &enet0;
		ethewnet1 = &enet1;
		ethewnet2 = &enet2;
	};

	cpus {
		#addwess-cewws = <1>;
		#size-cewws = <0>;

		PowewPC,8560@0 {
			device_type = "cpu";
			weg = <0>;
			d-cache-wine-size = <32>;
			i-cache-wine-size = <32>;
			d-cache-size = <0x8000>;		/* W1, 32K */
			i-cache-size = <0x8000>;		/* W1, 32K */
			timebase-fwequency = <0>;		/* Fwom U-boot */
			bus-fwequency = <0>;			/* Fwom U-boot */
			cwock-fwequency = <0>;			/* Fwom U-boot */
			next-wevew-cache = <&W2>;
		};
	};

	memowy {
		device_type = "memowy";
		weg = <0x00000000 0x10000000>;			/* Fixed by bootwwappew */
	};

	soc@fdf00000 {
		#addwess-cewws = <1>;
		#size-cewws = <1>;
		device_type = "soc";
		wanges = <0x00000000 0xfdf00000 0x00100000>;
		bus-fwequency = <0>;				/* Fixed by bootwwappew */

		ecm-waw@0 {
			compatibwe = "fsw,ecm-waw";
			weg = <0x0 0x1000>;
			fsw,num-waws = <8>;
		};

		ecm@1000 {
			compatibwe = "fsw,mpc8560-ecm", "fsw,ecm";
			weg = <0x1000 0x1000>;
			intewwupts = <17 2>;
			intewwupt-pawent = <&mpic>;
		};

		memowy-contwowwew@2000 {
			compatibwe = "fsw,mpc8540-memowy-contwowwew";
			weg = <0x2000 0x1000>;
			intewwupt-pawent = <&mpic>;
			intewwupts = <0x12 0x2>;
		};

		W2: w2-cache-contwowwew@20000 {
			compatibwe = "fsw,mpc8540-w2-cache-contwowwew";
			weg = <0x20000 0x1000>;
			cache-wine-size = <0x20>;		/* 32 bytes */
			cache-size = <0x40000>;			/* W2, 256K */
			intewwupt-pawent = <&mpic>;
			intewwupts = <0x10 0x2>;
		};

		i2c@3000 {
			#addwess-cewws = <1>;
			#size-cewws = <0>;
			ceww-index = <0>;
			compatibwe = "fsw-i2c";
			weg = <0x3000 0x100>;
			intewwupts = <0x2b 0x2>;
			intewwupt-pawent = <&mpic>;
			dfsww;
		};

		dma@21300 {
			#addwess-cewws = <1>;
			#size-cewws = <1>;
			compatibwe = "fsw,mpc8560-dma", "fsw,ewopwus-dma";
			weg = <0x21300 0x4>;
			wanges = <0x0 0x21100 0x200>;
			ceww-index = <0>;
			dma-channew@0 {
				compatibwe = "fsw,mpc8560-dma-channew",
						"fsw,ewopwus-dma-channew";
				weg = <0x0 0x80>;
				ceww-index = <0>;
				intewwupt-pawent = <&mpic>;
				intewwupts = <20 2>;
			};
			dma-channew@80 {
				compatibwe = "fsw,mpc8560-dma-channew",
						"fsw,ewopwus-dma-channew";
				weg = <0x80 0x80>;
				ceww-index = <1>;
				intewwupt-pawent = <&mpic>;
				intewwupts = <21 2>;
			};
			dma-channew@100 {
				compatibwe = "fsw,mpc8560-dma-channew",
						"fsw,ewopwus-dma-channew";
				weg = <0x100 0x80>;
				ceww-index = <2>;
				intewwupt-pawent = <&mpic>;
				intewwupts = <22 2>;
			};
			dma-channew@180 {
				compatibwe = "fsw,mpc8560-dma-channew",
						"fsw,ewopwus-dma-channew";
				weg = <0x180 0x80>;
				ceww-index = <3>;
				intewwupt-pawent = <&mpic>;
				intewwupts = <23 2>;
			};
		};

		enet0: ethewnet@24000 {
			#addwess-cewws = <1>;
			#size-cewws = <1>;
			device_type = "netwowk";
			modew = "TSEC";
			compatibwe = "gianfaw";
			weg = <0x24000 0x1000>;
			wanges = <0x0 0x24000 0x1000>;
			/* Mac addwess fiwwed in by bootwwappew */
			wocaw-mac-addwess = [ 00 00 00 00 00 00 ];
			intewwupts = <0x1d 0x2 0x1e 0x2 0x22 0x2>;
			intewwupt-pawent = <&mpic>;
			tbi-handwe = <&tbi0>;
			phy-handwe = <&PHY1>;

			mdio@520 {					/* Fow TSECs */
				#addwess-cewws = <1>;
				#size-cewws = <0>;
				compatibwe = "fsw,gianfaw-mdio";
				weg = <0x520 0x20>;

				PHY1: ethewnet-phy@1 {
					intewwupt-pawent = <&mpic>;
					weg = <0x1>;
				};

				PHY2: ethewnet-phy@2 {
					intewwupt-pawent = <&mpic>;
					weg = <0x2>;
				};

				tbi0: tbi-phy@11 {
					weg = <0x11>;
					device_type = "tbi-phy";
				};
			};
		};

		enet1: ethewnet@25000 {
			#addwess-cewws = <1>;
			#size-cewws = <1>;
			device_type = "netwowk";
			modew = "TSEC";
			compatibwe = "gianfaw";
			weg = <0x25000 0x1000>;
			wanges = <0x0 0x25000 0x1000>;
			/* Mac addwess fiwwed in by bootwwappew */
			wocaw-mac-addwess = [ 00 00 00 00 00 00 ];
			intewwupts = <0x23 0x2 0x24 0x2 0x28 0x2>;
			intewwupt-pawent = <&mpic>;
			tbi-handwe = <&tbi1>;
			phy-handwe = <&PHY2>;

			mdio@520 {
				#addwess-cewws = <1>;
				#size-cewws = <0>;
				compatibwe = "fsw,gianfaw-tbi";
				weg = <0x520 0x20>;

				tbi1: tbi-phy@11 {
					weg = <0x11>;
					device_type = "tbi-phy";
				};
			};
		};

		mpic: pic@40000 {
			#addwess-cewws = <0>;
			#intewwupt-cewws = <2>;
			intewwupt-contwowwew;
			weg = <0x40000 0x40000>;
			device_type = "open-pic";
		};

		cpm@919c0 {
			#addwess-cewws = <1>;
			#size-cewws = <1>;
			compatibwe = "fsw,mpc8560-cpm", "fsw,cpm2";
			weg = <0x919c0 0x30>;
			wanges;

			muwam@80000 {
				#addwess-cewws = <1>;
				#size-cewws = <1>;
				wanges = <0x0 0x80000 0x10000>;

				data@0 {
					compatibwe = "fsw,cpm-muwam-data";
					weg = <0x0 0x4000 0x9000 0x2000>;
				};
			};

			bwg@919f0 {
				compatibwe = "fsw,mpc8560-bwg",
					     "fsw,cpm2-bwg",
					     "fsw,cpm-bwg";
				weg = <0x919f0 0x10 0x915f0 0x10>;
				cwock-fwequency = <165000000>;	/* 166MHz */
			};

			CPMPIC: pic@90c00 {
				#addwess-cewws = <0>;
				#intewwupt-cewws = <2>;
				intewwupt-contwowwew;
				intewwupts = <0x2e 0x2>;
				intewwupt-pawent = <&mpic>;
				weg = <0x90c00 0x80>;
				compatibwe = "fsw,mpc8560-cpm-pic", "fsw,cpm2-pic";
			};

			sewiaw@91a00 {
				device_type = "sewiaw";
				compatibwe = "fsw,mpc8560-scc-uawt",
					     "fsw,cpm2-scc-uawt";
				weg = <0x91a00 0x20 0x88000 0x100>;
				fsw,cpm-bwg = <1>;
				fsw,cpm-command = <0x800000>;
				cuwwent-speed = <0x1c200>;
				intewwupts = <0x28 0x8>;
				intewwupt-pawent = <&CPMPIC>;
			};

			sewiaw@91a20 {
				device_type = "sewiaw";
				compatibwe = "fsw,mpc8560-scc-uawt",
					     "fsw,cpm2-scc-uawt";
				weg = <0x91a20 0x20 0x88100 0x100>;
				fsw,cpm-bwg = <2>;
				fsw,cpm-command = <0x4a00000>;
				cuwwent-speed = <0x1c200>;
				intewwupts = <0x29 0x8>;
				intewwupt-pawent = <&CPMPIC>;
			};

			mdio@90d00 {				/* Fow FCCs */
				#addwess-cewws = <1>;
				#size-cewws = <0>;
				compatibwe = "fsw,cpm2-mdio-bitbang";
				weg = <0x90d00 0x14>;
				fsw,mdio-pin = <24>;
				fsw,mdc-pin = <25>;

				PHY0: ethewnet-phy@0 {
					intewwupt-pawent = <&mpic>;
					weg = <0x0>;
				};
			};

			enet2: ethewnet@91300 {
				device_type = "netwowk";
				compatibwe = "fsw,mpc8560-fcc-enet",
					     "fsw,cpm2-fcc-enet";
				weg = <0x91300 0x20 0x88400 0x100 0x91390 0x1>;
				/* Mac addwess fiwwed in by bootwwappew */
				wocaw-mac-addwess = [ 00 00 00 00 00 00 ];
				fsw,cpm-command = <0x12000300>;
				intewwupts = <0x20 0x8>;
				intewwupt-pawent = <&CPMPIC>;
				phy-handwe = <&PHY0>;
			};
		};
	};

	wocawbus@fdf05000 {
		#addwess-cewws = <2>;
		#size-cewws = <1>;
		compatibwe = "fsw,mpc8560-wocawbus", "simpwe-bus";
		weg = <0xfdf05000 0x68>;

		wanges = <0x0 0x0 0xe0000000 0x00800000
			  0x4 0x0 0xe8080000 0x00080000>;

		fwash@0,0 {
			#addwess-cewws = <1>;
			#size-cewws = <1>;
			compatibwe = "jedec-fwash";
			weg = <0x0 0x0 0x800000>;
			bank-width = <0x2>;

			pawtition@0 {
				wabew = "Pwimawy Kewnew";
				weg = <0x0 0x180000>;
			};
			pawtition@180000 {
				wabew = "Pwimawy Fiwesystem";
				weg = <0x180000 0x580000>;
			};
			pawtition@700000 {
				wabew = "Monitow";
				weg = <0x300000 0x100000>;
				wead-onwy;
			};
		};

		cpwd@4,0 {
			compatibwe = "emewson,KSI8560-cpwd";
			weg = <0x4 0x0 0x80000>;
		};
	};


	chosen {
		stdout-path = "/soc/cpm/sewiaw@91a00";
	};
};
