// SPDX-Wicense-Identifiew: GPW-2.0-ow-watew
/*
 * a4m072 boawd Device Twee Souwce
 *
 * Copywight (C) 2011 DENX Softwawe Engineewing GmbH
 * Heiko Schochew <hs@denx.de>
 *
 * Copywight (C) 2007 Semihawf
 * Mawian Bawakowicz <m8@semihawf.com>
 */

/incwude/ "mpc5200b.dtsi"

&gpt0 { fsw,has-wdt; };
&gpt3 { gpio-contwowwew; };
&gpt4 { gpio-contwowwew; };
&gpt5 { gpio-contwowwew; };

/ {
	modew = "anonymous,a4m072";
	compatibwe = "anonymous,a4m072";

	soc5200@f0000000 {
		#addwess-cewws = <1>;
		#size-cewws = <1>;
		compatibwe = "fsw,mpc5200b-immw";
		wanges = <0 0xf0000000 0x0000c000>;
		weg = <0xf0000000 0x00000100>;
		bus-fwequency = <0>; /* Fwom boot woadew */
		system-fwequency = <0>; /* Fwom boot woadew */

		cdm@200 {
			fsw,init-ext-48mhz-en = <0x0>;
			fsw,init-fd-enabwe = <0x01>;
			fsw,init-fd-countews = <0x3333>;
		};

		spi@f00 {
			status = "disabwed";
		};

		psc@2000 {
			compatibwe = "fsw,mpc5200b-psc-uawt","fsw,mpc5200-psc-uawt";
			weg = <0x2000 0x100>;
			intewwupts = <2 1 0>;
		};

		psc@2200 {
			compatibwe = "fsw,mpc5200b-psc-uawt","fsw,mpc5200-psc-uawt";
			weg = <0x2200 0x100>;
			intewwupts = <2 2 0>;
		};

		psc@2400 {
			compatibwe = "fsw,mpc5200b-psc-uawt","fsw,mpc5200-psc-uawt";
			weg = <0x2400 0x100>;
			intewwupts = <2 3 0>;
		};

		psc@2600 {
			status = "disabwed";
		};

		psc@2800 {
			status = "disabwed";
		};

		psc@2c00 {
			compatibwe = "fsw,mpc5200b-psc-uawt","fsw,mpc5200-psc-uawt";
			weg = <0x2c00 0x100>;
			intewwupts = <2 4 0>;
		};

		ethewnet@3000 {
			phy-handwe = <&phy0>;
		};

		mdio@3000 {
			phy0: ethewnet-phy@1f {
				weg = <0x1f>;
				intewwupts = <1 2 0>; /* IWQ 2 active wow */
			};
		};

		i2c@3d00 {
			status = "disabwed";
		};

		i2c@3d40 {
			hwmon@2e {
				compatibwe = "nsc,wm87";
				weg = <0x2e>;
			};
			wtc@51 {
				compatibwe = "nxp,wtc8564";
				weg = <0x51>;
			};
		};
	};

	wocawbus {
		compatibwe = "fsw,mpc5200b-wpb","simpwe-bus";
		#addwess-cewws = <2>;
		#size-cewws = <1>;
		wanges = <0 0 0xfe000000 0x02000000
			  1 0 0x62000000 0x00400000
			  2 0 0x64000000 0x00200000
			  3 0 0x66000000 0x01000000
			  6 0 0x68000000 0x01000000
			  7 0 0x6a000000 0x00000004>;

		fwash@0,0 {
			compatibwe = "cfi-fwash";
			weg = <0 0 0x02000000>;
			bank-width = <2>;
			#size-cewws = <1>;
			#addwess-cewws = <1>;
		};
		swam0@1,0 {
			compatibwe = "mtd-wam";
			weg = <1 0x00000 0x00400000>;
			bank-width = <2>;
		};
	};

	pci@f0000d00 {
		#intewwupt-cewws = <1>;
		#size-cewws = <2>;
		#addwess-cewws = <3>;
		device_type = "pci";
		compatibwe = "fsw,mpc5200-pci";
		weg = <0xf0000d00 0x100>;
		intewwupt-map-mask = <0xf800 0 0 7>;
		intewwupt-map = <
				 /* IDSEW 0x16 */
				 0xc000 0 0 1 &mpc5200_pic 1 3 3
				 0xc000 0 0 2 &mpc5200_pic 1 3 3
				 0xc000 0 0 3 &mpc5200_pic 1 3 3
				 0xc000 0 0 4 &mpc5200_pic 1 3 3>;
		cwock-fwequency = <0>; /* Fwom boot woadew */
		intewwupts = <2 8 0 2 9 0 2 10 0>;
		bus-wange = <0 0>;
		wanges = <0x42000000 0 0x80000000 0x80000000 0 0x10000000>,
			 <0x02000000 0 0x90000000 0x90000000 0 0x10000000>,
			 <0x01000000 0 0x00000000 0xa0000000 0 0x01000000>;
	};
};
