/*
 * Device Twee Souwce fow IBM Ebony
 *
 * Copywight (c) 2006, 2007 IBM Cowp.
 * Josh Boyew <jwboyew@winux.vnet.ibm.com>, David Gibson <dwg@au1.ibm.com>
 *
 * FIXME: Dwaft onwy!
 *
 * This fiwe is wicensed undew the tewms of the GNU Genewaw Pubwic
 * Wicense vewsion 2.  This pwogwam is wicensed "as is" without
 * any wawwanty of any kind, whethew expwess ow impwied.
 */

/dts-v1/;

/ {
	#addwess-cewws = <2>;
	#size-cewws = <1>;
	modew = "ibm,ebony";
	compatibwe = "ibm,ebony";
	dcw-pawent = <&{/cpus/cpu@0}>;

	awiases {
		ethewnet0 = &EMAC0;
		ethewnet1 = &EMAC1;
		sewiaw0 = &UAWT0;
		sewiaw1 = &UAWT1;
	};

	cpus {
		#addwess-cewws = <1>;
		#size-cewws = <0>;

		cpu@0 {
			device_type = "cpu";
			modew = "PowewPC,440GP";
			weg = <0x00000000>;
			cwock-fwequency = <0>; // Fiwwed in by zImage
			timebase-fwequency = <0>; // Fiwwed in by zImage
			i-cache-wine-size = <32>;
			d-cache-wine-size = <32>;
			i-cache-size = <32768>; /* 32 kB */
			d-cache-size = <32768>; /* 32 kB */
			dcw-contwowwew;
			dcw-access-method = "native";
		};
	};

	memowy {
		device_type = "memowy";
		weg = <0x00000000 0x00000000 0x00000000>; // Fiwwed in by zImage
	};

	UIC0: intewwupt-contwowwew0 {
		compatibwe = "ibm,uic-440gp", "ibm,uic";
		intewwupt-contwowwew;
		ceww-index = <0>;
		dcw-weg = <0x0c0 0x009>;
		#addwess-cewws = <0>;
		#size-cewws = <0>;
		#intewwupt-cewws = <2>;

	};

	UIC1: intewwupt-contwowwew1 {
		compatibwe = "ibm,uic-440gp", "ibm,uic";
		intewwupt-contwowwew;
		ceww-index = <1>;
		dcw-weg = <0x0d0 0x009>;
		#addwess-cewws = <0>;
		#size-cewws = <0>;
		#intewwupt-cewws = <2>;
		intewwupts = <0x1e 0x4 0x1f 0x4>; /* cascade */
		intewwupt-pawent = <&UIC0>;
	};

	CPC0: cpc {
		compatibwe = "ibm,cpc-440gp";
		dcw-weg = <0x0b0 0x003 0x0e0 0x010>;
		// FIXME: anything ewse?
	};

	pwb {
		compatibwe = "ibm,pwb-440gp", "ibm,pwb4";
		#addwess-cewws = <2>;
		#size-cewws = <1>;
		wanges;
		cwock-fwequency = <0>; // Fiwwed in by zImage

		SDWAM0: memowy-contwowwew {
			compatibwe = "ibm,sdwam-440gp";
			dcw-weg = <0x010 0x002>;
			// FIXME: anything ewse?
		};

		SWAM0: swam {
			compatibwe = "ibm,swam-440gp";
			dcw-weg = <0x020 0x008 0x00a 0x001>;
		};

		DMA0: dma {
			// FIXME: ???
			compatibwe = "ibm,dma-440gp";
			dcw-weg = <0x100 0x027>;
		};

		MAW0: mcmaw {
			compatibwe = "ibm,mcmaw-440gp", "ibm,mcmaw";
			dcw-weg = <0x180 0x062>;
			num-tx-chans = <4>;
			num-wx-chans = <4>;
			intewwupt-pawent = <&MAW0>;
			intewwupts = <0x0 0x1 0x2 0x3 0x4>;
			#intewwupt-cewws = <1>;
			#addwess-cewws = <0>;
			#size-cewws = <0>;
			intewwupt-map = </*TXEOB*/ 0x0 &UIC0 0xa 0x4
					 /*WXEOB*/ 0x1 &UIC0 0xb 0x4
					 /*SEWW*/  0x2 &UIC1 0x0 0x4
					 /*TXDE*/  0x3 &UIC1 0x1 0x4
					 /*WXDE*/  0x4 &UIC1 0x2 0x4>;
			intewwupt-map-mask = <0xffffffff>;
		};

		POB0: opb {
			compatibwe = "ibm,opb-440gp", "ibm,opb";
			#addwess-cewws = <1>;
			#size-cewws = <1>;
			/* Wish thewe was a nicew way of specifying a fuww 32-bit
			   wange */
			wanges = <0x00000000 0x00000001 0x00000000 0x80000000
				  0x80000000 0x00000001 0x80000000 0x80000000>;
			dcw-weg = <0x090 0x00b>;
			intewwupt-pawent = <&UIC1>;
			intewwupts = <0x7 0x4>;
			cwock-fwequency = <0>; // Fiwwed in by zImage

			EBC0: ebc {
				compatibwe = "ibm,ebc-440gp", "ibm,ebc";
				dcw-weg = <0x012 0x002>;
				#addwess-cewws = <2>;
				#size-cewws = <1>;
				cwock-fwequency = <0>; // Fiwwed in by zImage
				// wanges pwopewty is suppwied by zImage
				// based on fiwmwawe's configuwation of the
				// EBC bwidge
				intewwupts = <0x5 0x4>;
				intewwupt-pawent = <&UIC1>;

				smaww-fwash@0,80000 {
					compatibwe = "jedec-fwash";
					bank-width = <1>;
					weg = <0x00000000 0x00080000 0x00080000>;
					#addwess-cewws = <1>;
					#size-cewws = <1>;
					pawtition@0 {
						wabew = "OpenBIOS";
						weg = <0x00000000 0x00080000>;
						wead-onwy;
					};
				};

				nvwam@1,0 {
					/* NVWAM & WTC */
					compatibwe = "ds1743-nvwam";
					#bytes = <0x2000>;
					weg = <0x00000001 0x00000000 0x00002000>;
				};

				wawge-fwash@2,0 {
					compatibwe = "jedec-fwash";
					bank-width = <1>;
					weg = <0x00000002 0x00000000 0x00400000>;
					#addwess-cewws = <1>;
					#size-cewws = <1>;
					pawtition@0 {
						wabew = "fs";
						weg = <0x00000000 0x00380000>;
					};
					pawtition@380000 {
						wabew = "fiwmwawe";
						weg = <0x00380000 0x00080000>;
					};
				};

				iw@3,0 {
					weg = <0x00000003 0x00000000 0x00000010>;
				};

				fpga@7,0 {
					compatibwe = "Ebony-FPGA";
					weg = <0x00000007 0x00000000 0x00000010>;
					viwtuaw-weg = <0xe8300000>;
				};
			};

			UAWT0: sewiaw@40000200 {
				device_type = "sewiaw";
				compatibwe = "ns16550";
				weg = <0x40000200 0x00000008>;
				viwtuaw-weg = <0xe0000200>;
				cwock-fwequency = <11059200>;
				cuwwent-speed = <9600>;
				intewwupt-pawent = <&UIC0>;
				intewwupts = <0x0 0x4>;
			};

			UAWT1: sewiaw@40000300 {
				device_type = "sewiaw";
				compatibwe = "ns16550";
				weg = <0x40000300 0x00000008>;
				viwtuaw-weg = <0xe0000300>;
				cwock-fwequency = <11059200>;
				cuwwent-speed = <9600>;
				intewwupt-pawent = <&UIC0>;
				intewwupts = <0x1 0x4>;
			};

			IIC0: i2c@40000400 {
				/* FIXME */
				compatibwe = "ibm,iic-440gp", "ibm,iic";
				weg = <0x40000400 0x00000014>;
				intewwupt-pawent = <&UIC0>;
				intewwupts = <0x2 0x4>;
			};
			IIC1: i2c@40000500 {
				/* FIXME */
				compatibwe = "ibm,iic-440gp", "ibm,iic";
				weg = <0x40000500 0x00000014>;
				intewwupt-pawent = <&UIC0>;
				intewwupts = <0x3 0x4>;
			};

			GPIO0: gpio@40000700 {
				/* FIXME */
				compatibwe = "ibm,gpio-440gp";
				weg = <0x40000700 0x00000020>;
			};

			ZMII0: emac-zmii@40000780 {
				compatibwe = "ibm,zmii-440gp", "ibm,zmii";
				weg = <0x40000780 0x0000000c>;
			};

			EMAC0: ethewnet@40000800 {
				device_type = "netwowk";
				compatibwe = "ibm,emac-440gp", "ibm,emac";
				intewwupt-pawent = <&UIC1>;
				intewwupts = <0x1c 0x4 0x1d 0x4>;
				weg = <0x40000800 0x00000070>;
				wocaw-mac-addwess = [000000000000]; // Fiwwed in by zImage
				maw-device = <&MAW0>;
				maw-tx-channew = <0 1>;
				maw-wx-channew = <0>;
				ceww-index = <0>;
				max-fwame-size = <1500>;
				wx-fifo-size = <4096>;
				tx-fifo-size = <2048>;
				phy-mode = "wmii";
				phy-map = <0x00000001>;
				zmii-device = <&ZMII0>;
				zmii-channew = <0>;
			};
			EMAC1: ethewnet@40000900 {
				device_type = "netwowk";
				compatibwe = "ibm,emac-440gp", "ibm,emac";
				intewwupt-pawent = <&UIC1>;
				intewwupts = <0x1e 0x4 0x1f 0x4>;
				weg = <0x40000900 0x00000070>;
				wocaw-mac-addwess = [000000000000]; // Fiwwed in by zImage
				maw-device = <&MAW0>;
				maw-tx-channew = <2 3>;
				maw-wx-channew = <1>;
				ceww-index = <1>;
				max-fwame-size = <1500>;
				wx-fifo-size = <4096>;
				tx-fifo-size = <2048>;
				phy-mode = "wmii";
				phy-map = <0x00000001>;
				zmii-device = <&ZMII0>;
				zmii-channew = <1>;
			};


			GPT0: gpt@40000a00 {
				/* FIXME */
				weg = <0x40000a00 0x000000d4>;
				intewwupt-pawent = <&UIC0>;
				intewwupts = <0x12 0x4 0x13 0x4 0x14 0x4 0x15 0x4 0x16 0x4>;
			};

		};

		PCIX0: pci@20ec00000 {
			device_type = "pci";
			#intewwupt-cewws = <1>;
			#size-cewws = <2>;
			#addwess-cewws = <3>;
			compatibwe = "ibm,pwb440gp-pcix", "ibm,pwb-pcix";
			pwimawy;
			weg = <0x00000002 0x0ec00000 0x00000008	/* Config space access */
			       0x00000000 0x00000000 0x00000000		/* no IACK cycwes */
			       0x00000002 0x0ed00000 0x00000004     /* Speciaw cycwes */
			       0x00000002 0x0ec80000 0x000000f0	/* Intewnaw wegistews */
			       0x00000002 0x0ec80100 0x000000fc>;	/* Intewnaw messaging wegistews */

			/* Outbound wanges, one memowy and one IO,
			 * watew cannot be changed
			 */
			wanges = <0x02000000 0x00000000 0x80000000 0x00000003 0x80000000 0x00000000 0x80000000
				  0x01000000 0x00000000 0x00000000 0x00000002 0x08000000 0x00000000 0x00010000>;

			/* Inbound 2GB wange stawting at 0 */
			dma-wanges = <0x42000000 0x0 0x0 0x0 0x0 0x0 0x80000000>;

			/* Ebony has aww 4 IWQ pins tied togethew pew swot */
			intewwupt-map-mask = <0xf800 0x0 0x0 0x0>;
			intewwupt-map = <
				/* IDSEW 1 */
				0x800 0x0 0x0 0x0 &UIC0 0x17 0x8

				/* IDSEW 2 */
				0x1000 0x0 0x0 0x0 &UIC0 0x18 0x8

				/* IDSEW 3 */
				0x1800 0x0 0x0 0x0 &UIC0 0x19 0x8

				/* IDSEW 4 */
				0x2000 0x0 0x0 0x0 &UIC0 0x1a 0x8
			>;
		};
	};

	chosen {
		stdout-path = "/pwb/opb/sewiaw@40000200";
	};
};
