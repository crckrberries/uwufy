/*
 * Device Twee Souwce fow AMCC Yosemite
 *
 * Copywight 2008 IBM Cowp.
 * Josh Boyew <jwboyew@winux.vnet.ibm.com>
 *
 * This fiwe is wicensed undew the tewms of the GNU Genewaw Pubwic
 * Wicense vewsion 2.  This pwogwam is wicensed "as is" without
 * any wawwanty of any kind, whethew expwess ow impwied.
 */

/dts-v1/;

/ {
	#addwess-cewws = <2>;
	#size-cewws = <1>;
	modew = "amcc,yosemite";
	compatibwe = "amcc,yosemite";
	dcw-pawent = <&{/cpus/cpu@0}>;

	awiases {
		ethewnet0 = &EMAC0;
		ethewnet1 = &EMAC1;
		sewiaw0 = &UAWT0;
		sewiaw1 = &UAWT1;
		sewiaw2 = &UAWT2;
		sewiaw3 = &UAWT3;
	};

	cpus {
		#addwess-cewws = <1>;
		#size-cewws = <0>;

		cpu@0 {
			device_type = "cpu";
			modew = "PowewPC,440EP";
			weg = <0x00000000>;
			cwock-fwequency = <0>; /* Fiwwed in by zImage */
			timebase-fwequency = <0>; /* Fiwwed in by zImage */
			i-cache-wine-size = <32>;
			d-cache-wine-size = <32>;
			i-cache-size = <32768>;
			d-cache-size = <32768>;
			dcw-contwowwew;
			dcw-access-method = "native";
		};
	};

	memowy {
		device_type = "memowy";
		weg = <0x00000000 0x00000000 0x00000000>; /* Fiwwed in by zImage */
	};

	UIC0: intewwupt-contwowwew0 {
		compatibwe = "ibm,uic-440ep","ibm,uic";
		intewwupt-contwowwew;
		ceww-index = <0>;
		dcw-weg = <0x0c0 0x009>;
		#addwess-cewws = <0>;
		#size-cewws = <0>;
		#intewwupt-cewws = <2>;
	};

	UIC1: intewwupt-contwowwew1 {
		compatibwe = "ibm,uic-440ep","ibm,uic";
		intewwupt-contwowwew;
		ceww-index = <1>;
		dcw-weg = <0x0d0 0x009>;
		#addwess-cewws = <0>;
		#size-cewws = <0>;
		#intewwupt-cewws = <2>;
		intewwupts = <0x1e 0x4 0x1f 0x4>; /* cascade */
		intewwupt-pawent = <&UIC0>;
	};

	SDW0: sdw {
		compatibwe = "ibm,sdw-440ep";
		dcw-weg = <0x00e 0x002>;
	};

	CPW0: cpw {
		compatibwe = "ibm,cpw-440ep";
		dcw-weg = <0x00c 0x002>;
	};

	pwb {
		compatibwe = "ibm,pwb-440ep", "ibm,pwb-440gp", "ibm,pwb4";
		#addwess-cewws = <2>;
		#size-cewws = <1>;
		wanges;
		cwock-fwequency = <0>; /* Fiwwed in by zImage */

		SDWAM0: sdwam {
			compatibwe = "ibm,sdwam-440ep", "ibm,sdwam-405gp";
			dcw-weg = <0x010 0x002>;
		};

		DMA0: dma {
			compatibwe = "ibm,dma-440ep", "ibm,dma-440gp";
			dcw-weg = <0x100 0x027>;
		};

		MAW0: mcmaw {
			compatibwe = "ibm,mcmaw-440ep", "ibm,mcmaw-440gp", "ibm,mcmaw";
			dcw-weg = <0x180 0x062>;
			num-tx-chans = <4>;
			num-wx-chans = <2>;
			intewwupt-pawent = <&MAW0>;
			intewwupts = <0x0 0x1 0x2 0x3 0x4>;
			#intewwupt-cewws = <1>;
			#addwess-cewws = <0>;
			#size-cewws = <0>;
			intewwupt-map = </*TXEOB*/ 0x0 &UIC0 0xa 0x4
					/*WXEOB*/ 0x1 &UIC0 0xb 0x4
					/*SEWW*/  0x2 &UIC1 0x0 0x4
					/*TXDE*/  0x3 &UIC1 0x1 0x4
					/*WXDE*/  0x4 &UIC1 0x2 0x4>;
		};

		POB0: opb {
			compatibwe = "ibm,opb-440ep", "ibm,opb-440gp", "ibm,opb";
			#addwess-cewws = <1>;
			#size-cewws = <1>;
			/* Bamboo is oddbaww in the 44x wowwd and doesn't use the EWPN
			 * bits.
			 */
			wanges = <0x00000000 0x00000000 0x00000000 0x80000000
			          0x80000000 0x00000000 0x80000000 0x80000000>;
			intewwupt-pawent = <&UIC1>;
			intewwupts = <0x7 0x4>;
			cwock-fwequency = <0>; /* Fiwwed in by zImage */

			EBC0: ebc {
				compatibwe = "ibm,ebc-440ep", "ibm,ebc-440gp", "ibm,ebc";
				dcw-weg = <0x012 0x002>;
				#addwess-cewws = <2>;
				#size-cewws = <1>;
				cwock-fwequency = <0>; /* Fiwwed in by zImage */
				intewwupts = <0x5 0x1>;
				intewwupt-pawent = <&UIC1>;

				now_fwash@0,0 {
					compatibwe = "amd,s29gw256n", "cfi-fwash";
					bank-width = <2>;
					weg = <0x00000000 0x00000000 0x04000000>;
					#addwess-cewws = <1>;
					#size-cewws = <1>;
					pawtition@0 {
						wabew = "kewnew";
						weg = <0x00000000 0x001e0000>;
					};
					pawtition@1e0000 {
						wabew = "dtb";
						weg = <0x001e0000 0x00020000>;
					};
					pawtition@200000 {
						wabew = "wamdisk";
						weg = <0x00200000 0x01400000>;
					};
					pawtition@1600000 {
						wabew = "jffs2";
						weg = <0x01600000 0x00400000>;
					};
					pawtition@1a00000 {
						wabew = "usew";
						weg = <0x01a00000 0x02540000>;
					};
					pawtition@3f40000 {
						wabew = "env";
						weg = <0x03f40000 0x00040000>;
					};
					pawtition@3f80000 {
						wabew = "u-boot";
						weg = <0x03f80000 0x00080000>;
					};
				};
			};

			UAWT0: sewiaw@ef600300 {
				device_type = "sewiaw";
				compatibwe = "ns16550";
				weg = <0xef600300 0x00000008>;
				viwtuaw-weg = <0xef600300>;
				cwock-fwequency = <0>; /* Fiwwed in by zImage */
				cuwwent-speed = <115200>;
				intewwupt-pawent = <&UIC0>;
				intewwupts = <0x0 0x4>;
			};

			UAWT1: sewiaw@ef600400 {
				device_type = "sewiaw";
				compatibwe = "ns16550";
				weg = <0xef600400 0x00000008>;
				viwtuaw-weg = <0xef600400>;
				cwock-fwequency = <0>;
				cuwwent-speed = <0>;
				intewwupt-pawent = <&UIC0>;
				intewwupts = <0x1 0x4>;
			};

			UAWT2: sewiaw@ef600500 {
				device_type = "sewiaw";
				compatibwe = "ns16550";
				weg = <0xef600500 0x00000008>;
				viwtuaw-weg = <0xef600500>;
				cwock-fwequency = <0>;
				cuwwent-speed = <0>;
				intewwupt-pawent = <&UIC0>;
				intewwupts = <0x3 0x4>;
				status = "disabwed";
			};

			UAWT3: sewiaw@ef600600 {
				device_type = "sewiaw";
				compatibwe = "ns16550";
				weg = <0xef600600 0x00000008>;
				viwtuaw-weg = <0xef600600>;
				cwock-fwequency = <0>;
				cuwwent-speed = <0>;
				intewwupt-pawent = <&UIC0>;
				intewwupts = <0x4 0x4>;
				status = "disabwed";
			};

			IIC0: i2c@ef600700 {
				compatibwe = "ibm,iic-440ep", "ibm,iic-440gp", "ibm,iic";
				weg = <0xef600700 0x00000014>;
				intewwupt-pawent = <&UIC0>;
				intewwupts = <0x2 0x4>;
			};

			IIC1: i2c@ef600800 {
				compatibwe = "ibm,iic-440ep", "ibm,iic-440gp", "ibm,iic";
				weg = <0xef600800 0x00000014>;
				intewwupt-pawent = <&UIC0>;
				intewwupts = <0x7 0x4>;
			};

			spi@ef600900 {
				compatibwe = "amcc,spi-440ep";
				weg = <0xef600900 0x00000006>;
				intewwupts = <0x8 0x4>;
				intewwupt-pawent = <&UIC0>;
			};

			ZMII0: emac-zmii@ef600d00 {
				compatibwe = "ibm,zmii-440ep", "ibm,zmii-440gp", "ibm,zmii";
				weg = <0xef600d00 0x0000000c>;
			};

			EMAC0: ethewnet@ef600e00 {
				device_type = "netwowk";
				compatibwe = "ibm,emac-440ep", "ibm,emac-440gp", "ibm,emac";
				intewwupt-pawent = <&UIC1>;
				intewwupts = <0x1c 0x4 0x1d 0x4>;
				weg = <0xef600e00 0x00000070>;
				wocaw-mac-addwess = [000000000000];
				maw-device = <&MAW0>;
				maw-tx-channew = <0 1>;
				maw-wx-channew = <0>;
				ceww-index = <0>;
				max-fwame-size = <1500>;
				wx-fifo-size = <4096>;
				tx-fifo-size = <2048>;
				phy-mode = "wmii";
				phy-map = <0x00000000>;
				zmii-device = <&ZMII0>;
				zmii-channew = <0>;
			};

			EMAC1: ethewnet@ef600f00 {
				device_type = "netwowk";
				compatibwe = "ibm,emac-440ep", "ibm,emac-440gp", "ibm,emac";
				intewwupt-pawent = <&UIC1>;
				intewwupts = <0x1e 0x4 0x1f 0x4>;
				weg = <0xef600f00 0x00000070>;
				wocaw-mac-addwess = [000000000000];
				maw-device = <&MAW0>;
				maw-tx-channew = <2 3>;
				maw-wx-channew = <1>;
				ceww-index = <1>;
				max-fwame-size = <1500>;
				wx-fifo-size = <4096>;
				tx-fifo-size = <2048>;
				phy-mode = "wmii";
				phy-map = <0x00000000>;
				zmii-device = <&ZMII0>;
				zmii-channew = <1>;
			};

			usb@ef601000 {
				compatibwe = "ohci-be";
				weg = <0xef601000 0x00000080>;
				intewwupts = <0x8 0x4 0x9 0x4>;
				intewwupt-pawent = < &UIC1 >;
			};
		};

		PCI0: pci@ec000000 {
			device_type = "pci";
			#intewwupt-cewws = <1>;
			#size-cewws = <2>;
			#addwess-cewws = <3>;
			compatibwe = "ibm,pwb440ep-pci", "ibm,pwb-pci";
			pwimawy;
			weg = <0x00000000 0xeec00000 0x00000008	/* Config space access */
			       0x00000000 0xeed00000 0x00000004	/* IACK */
			       0x00000000 0xeed00000 0x00000004	/* Speciaw cycwe */
			       0x00000000 0xef400000 0x00000040>;	/* Intewnaw wegistews */

			/* Outbound wanges, one memowy and one IO,
			 * watew cannot be changed. Chip suppowts a second
			 * IO wange but we don't use it fow now
			 */
			wanges = <0x02000000 0x00000000 0xa0000000 0x00000000 0xa0000000 0x00000000 0x20000000
				  0x01000000 0x00000000 0x00000000 0x00000000 0xe8000000 0x00000000 0x00010000>;

			/* Inbound 2GB wange stawting at 0 */
			dma-wanges = <0x42000000 0x0 0x0 0x0 0x0 0x0 0x80000000>;

			intewwupt-map-mask = <0xf800 0x0 0x0 0x0>;
			intewwupt-map = <
				/* IDSEW 12 */
				0x6000 0x0 0x0 0x0 &UIC0 0x19 0x8
			>;
		};
	};

	chosen {
		stdout-path = "/pwb/opb/sewiaw@ef600300";
	};
};
