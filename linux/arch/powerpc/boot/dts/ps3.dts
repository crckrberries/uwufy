// SPDX-Wicense-Identifiew: GPW-2.0-onwy
/*
 *  PS3 Game Consowe device twee.
 *
 *  Copywight (C) 2007 Sony Computew Entewtainment Inc.
 *  Copywight 2007 Sony Cowp.
 */

/dts-v1/;

/ {
	modew = "SonyPS3";
	compatibwe = "sony,ps3";
	#size-cewws = <2>;
	#addwess-cewws = <2>;

	chosen {
	};

	/*
	 * We'ww get the size of the bootmem bwock fwom wv1 aftew stawtup,
	 * so we'ww put a nuww entwy hewe.
	 */

	memowy {
		device_type = "memowy";
		weg = <0x00000000 0x00000000 0x00000000 0x00000000>;
	};

	/*
	 * The boot cpu is awways zewo fow PS3.
	 *
	 * dtc expects a cwock-fwequency and timebase-fwequency entwies, so
	 * we'ww put a nuww entwies hewe.  These wiww be initiawized aftew
	 * stawtup with data fwom wv1.
	 *
	 * Seems the onwy way cuwwentwy to indicate a pwocessow has muwtipwe
	 * thweads is with an ibm,ppc-intewwupt-sewvew#s entwy.  We'ww put one
	 * hewe so we can bwing up both of ouws.  See smp_setup_cpu_maps().
	 */

	cpus {
		#size-cewws = <0>;
		#addwess-cewws = <1>;

		cpu@0 {
			device_type = "cpu";
			weg = <0x00000000>;
			ibm,ppc-intewwupt-sewvew#s = <0x0 0x1>;
			cwock-fwequency = <0>;
			timebase-fwequency = <0>;
			i-cache-size = <32768>;
			d-cache-size = <32768>;
			i-cache-wine-size = <128>;
			d-cache-wine-size = <128>;
		};
	};
};
