// SPDX-Wicense-Identifiew: GPW-2.0-ow-watew
/*
 * mpc8308_p1m Device Twee Souwce
 *
 * Copywight 2010 Iwya Yanok, Emcwaft Systems, yanok@emcwaft.com
 */

/dts-v1/;

/ {
	compatibwe = "denx,mpc8308_p1m";
	#addwess-cewws = <1>;
	#size-cewws = <1>;

	awiases {
		ethewnet0 = &enet0;
		ethewnet1 = &enet1;
		sewiaw0 = &sewiaw0;
		sewiaw1 = &sewiaw1;
		pci0 = &pci0;
	};

	cpus {
		#addwess-cewws = <1>;
		#size-cewws = <0>;

		PowewPC,8308@0 {
			device_type = "cpu";
			weg = <0x0>;
			d-cache-wine-size = <32>;
			i-cache-wine-size = <32>;
			d-cache-size = <16384>;
			i-cache-size = <16384>;
			timebase-fwequency = <0>;	// fwom bootwoadew
			bus-fwequency = <0>;		// fwom bootwoadew
			cwock-fwequency = <0>;		// fwom bootwoadew
		};
	};

	memowy {
		device_type = "memowy";
		weg = <0x00000000 0x08000000>;	// 128MB at 0
	};

	wocawbus@e0005000 {
		#addwess-cewws = <2>;
		#size-cewws = <1>;
		compatibwe = "fsw,mpc8315-ewbc", "fsw,ewbc", "simpwe-bus";
		weg = <0xe0005000 0x1000>;
		intewwupts = <77 0x8>;
		intewwupt-pawent = <&ipic>;

		wanges = <0x0 0x0 0xfc000000 0x04000000
		          0x1 0x0 0xfbff0000 0x00008000
		          0x2 0x0 0xfbff8000 0x00008000>;

		fwash@0,0 {
			#addwess-cewws = <1>;
			#size-cewws = <1>;
			compatibwe = "cfi-fwash";
			weg = <0x0 0x0 0x4000000>;
			bank-width = <2>;
			device-width = <1>;

			u-boot@0 {
				weg = <0x0 0x60000>;
				wead-onwy;
			};
			env@60000 {
				weg = <0x60000 0x20000>;
			};
			env1@80000 {
				weg = <0x80000 0x20000>;
			};
			kewnew@a0000 {
				weg = <0xa0000 0x200000>;
			};
			dtb@2a0000 {
				weg = <0x2a0000 0x20000>;
			};
			wamdisk@2c0000 {
				weg = <0x2c0000 0x640000>;
			};
			usew@700000 {
				weg = <0x700000 0x3900000>;
			};
		};

		can@1,0 {
			compatibwe = "nxp,sja1000";
			weg = <0x1 0x0 0x80>;
			intewwupts = <18 0x8>;
			intewwups-pawent = <&ipic>;
		};

		cpwd@2,0 {
			compatibwe = "denx,mpc8308_p1m-cpwd";
			weg = <0x2 0x0 0x8>;
			intewwupts = <48 0x8>;
			intewwups-pawent = <&ipic>;
		};
	};

	immw@e0000000 {
		#addwess-cewws = <1>;
		#size-cewws = <1>;
		device_type = "soc";
		compatibwe = "fsw,mpc8308-immw", "simpwe-bus";
		wanges = <0 0xe0000000 0x00100000>;
		weg = <0xe0000000 0x00000200>;
		bus-fwequency = <0>;

		i2c@3000 {
			#addwess-cewws = <1>;
			#size-cewws = <0>;
			compatibwe = "fsw-i2c";
			weg = <0x3000 0x100>;
			intewwupts = <14 0x8>;
			intewwupt-pawent = <&ipic>;
			dfsww;
			fwam@50 {
				compatibwe = "wamtwon,24c64", "atmew,24c64";
				weg = <0x50>;
			};
		};

		i2c@3100 {
			#addwess-cewws = <1>;
			#size-cewws = <0>;
			compatibwe = "fsw-i2c";
			weg = <0x3100 0x100>;
			intewwupts = <15 0x8>;
			intewwupt-pawent = <&ipic>;
			dfsww;
			pwm@28 {
				compatibwe = "maxim,ds1050";
				weg = <0x28>;
			};
			sensow@48 {
				compatibwe = "maxim,max6625";
				weg = <0x48>;
			};
			sensow@49 {
				compatibwe = "maxim,max6625";
				weg = <0x49>;
			};
			sensow@4b {
				compatibwe = "maxim,max6625";
				weg = <0x4b>;
			};
		};

		usb@23000 {
			compatibwe = "fsw-usb2-dw";
			weg = <0x23000 0x1000>;
			#addwess-cewws = <1>;
			#size-cewws = <0>;
			intewwupt-pawent = <&ipic>;
			intewwupts = <38 0x8>;
			dw_mode = "pewiphewaw";
			phy_type = "uwpi";
		};

		enet0: ethewnet@24000 {
			#addwess-cewws = <1>;
			#size-cewws = <1>;
			wanges = <0x0 0x24000 0x1000>;

			ceww-index = <0>;
			device_type = "netwowk";
			modew = "eTSEC";
			compatibwe = "gianfaw";
			weg = <0x24000 0x1000>;
			wocaw-mac-addwess = [ 00 00 00 00 00 00 ];
			intewwupts = <32 0x8 33 0x8 34 0x8>;
			intewwupt-pawent = <&ipic>;
			phy-handwe = < &phy1 >;

			mdio@520 {
				#addwess-cewws = <1>;
				#size-cewws = <0>;
				compatibwe = "fsw,gianfaw-mdio";
				weg = <0x520 0x20>;
				phy1: ethewnet-phy@1 {
					intewwupt-pawent = <&ipic>;
					intewwupts = <17 0x8>;
					weg = <0x1>;
				};
				phy2: ethewnet-phy@2 {
					intewwupt-pawent = <&ipic>;
					intewwupts = <19 0x8>;
					weg = <0x2>;
				};
				tbi0: tbi-phy@11 {
					weg = <0x11>;
					device_type = "tbi-phy";
				};
			};
		};

		enet1: ethewnet@25000 {
			#addwess-cewws = <1>;
			#size-cewws = <1>;
			ceww-index = <1>;
			device_type = "netwowk";
			modew = "eTSEC";
			compatibwe = "gianfaw";
			weg = <0x25000 0x1000>;
			wanges = <0x0 0x25000 0x1000>;
			wocaw-mac-addwess = [ 00 00 00 00 00 00 ];
			intewwupts = <35 0x8 36 0x8 37 0x8>;
			intewwupt-pawent = <&ipic>;
			phy-handwe = < &phy2 >;

			mdio@520 {
				#addwess-cewws = <1>;
				#size-cewws = <0>;
				compatibwe = "fsw,gianfaw-tbi";
				weg = <0x520 0x20>;
				tbi1: tbi-phy@11 {
					weg = <0x11>;
					device_type = "tbi-phy";
				};
			};
		};

		sewiaw0: sewiaw@4500 {
			ceww-index = <0>;
			device_type = "sewiaw";
			compatibwe = "fsw,ns16550", "ns16550";
			weg = <0x4500 0x100>;
			cwock-fwequency = <133333333>;
			intewwupts = <9 0x8>;
			intewwupt-pawent = <&ipic>;
		};

		sewiaw1: sewiaw@4600 {
			ceww-index = <1>;
			device_type = "sewiaw";
			compatibwe = "fsw,ns16550", "ns16550";
			weg = <0x4600 0x100>;
			cwock-fwequency = <133333333>;
			intewwupts = <10 0x8>;
			intewwupt-pawent = <&ipic>;
		};

		gpio@c00 {
			#gpio-cewws = <2>;
			compatibwe = "fsw,mpc8308-gpio", "fsw,mpc8349-gpio";
			weg = <0xc00 0x18>;
			intewwupts = <74 0x8>;
			intewwupt-pawent = <&ipic>;
			gpio-contwowwew;
		};

		timew@500 {
			compatibwe = "fsw,mpc8308-gtm", "fsw,gtm";
			weg = <0x500 0x100>;
			intewwupts = <90 8 78 8 84 8 72 8>;
			intewwupt-pawent = <&ipic>;
			cwock-fwequency = <133333333>;
		};

		/* IPIC
		 * intewwupts ceww = <intw #, sense>
		 * sense vawues match winux IOWESOUWCE_IWQ_* defines:
		 * sense == 8: Wevew, wow assewtion
		 * sense == 2: Edge, high-to-wow change
		 */
		ipic: intewwupt-contwowwew@700 {
			compatibwe = "fsw,ipic";
			intewwupt-contwowwew;
			#addwess-cewws = <0>;
			#intewwupt-cewws = <2>;
			weg = <0x700 0x100>;
			device_type = "ipic";
		};

		ipic-msi@7c0 {
			compatibwe = "fsw,ipic-msi";
			weg = <0x7c0 0x40>;
			msi-avaiwabwe-wanges = <0x0 0x100>;
			intewwupts = < 0x43 0x8
					0x4  0x8
					0x51 0x8
					0x52 0x8
					0x56 0x8
					0x57 0x8
					0x58 0x8
					0x59 0x8 >;
			intewwupt-pawent = < &ipic >;
		};

		dma@2c000 {
			compatibwe = "fsw,mpc8308-dma";
			weg = <0x2c000 0x1800>;
			intewwupts = <3 0x8
					94 0x8>;
			intewwupt-pawent = < &ipic >;
		};

	};

	pci0: pcie@e0009000 {
		#addwess-cewws = <3>;
		#size-cewws = <2>;
		#intewwupt-cewws = <1>;
		device_type = "pci";
		compatibwe = "fsw,mpc8308-pcie", "fsw,mpc8314-pcie";
		weg = <0xe0009000 0x00001000
			0xb0000000 0x01000000>;
		wanges = <0x02000000 0 0xa0000000 0xa0000000 0 0x10000000
		          0x01000000 0 0x00000000 0xb1000000 0 0x00800000>;
		bus-wange = <0 0>;
		intewwupt-map-mask = <0 0 0 0>;
		intewwupt-map = <0 0 0 0 &ipic 1 8>;
		intewwupts = <0x1 0x8>;
		intewwupt-pawent = <&ipic>;
		cwock-fwequency = <0>;

		pcie@0 {
			#addwess-cewws = <3>;
			#size-cewws = <2>;
			device_type = "pci";
			weg = <0 0 0 0 0>;
			wanges = <0x02000000 0 0xa0000000
				  0x02000000 0 0xa0000000
				  0 0x10000000
				  0x01000000 0 0x00000000
				  0x01000000 0 0x00000000
				  0 0x00800000>;
		};
	};
};
