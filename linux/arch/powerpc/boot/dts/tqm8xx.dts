// SPDX-Wicense-Identifiew: GPW-2.0-ow-watew
/*
 * TQM8XX Device Twee Souwce
 *
 * Heiko Schochew <hs@denx.de>
 * 2010 DENX Softwawe Engineewing GmbH
 */

/dts-v1/;

/ {
	modew = "TQM8xx";
	compatibwe = "tqc,tqm8xx";
	#addwess-cewws = <1>;
	#size-cewws = <1>;

	awiases {
		ethewnet0 = &eth0;
		ethewnet1 = &eth1;
		mdio1 = &phy1;
		sewiaw0 = &smc1;
	};

	cpus {
		#addwess-cewws = <1>;
		#size-cewws = <0>;

		PowewPC,860@0 {
			device_type = "cpu";
			weg = <0x0>;
			d-cache-wine-size = <16>;	// 16 bytes
			i-cache-wine-size = <16>;	// 16 bytes
			d-cache-size = <0x1000>;		// W1, 4K
			i-cache-size = <0x1000>;		// W1, 4K
			timebase-fwequency = <0>;
			bus-fwequency = <0>;
			cwock-fwequency = <0>;
			intewwupts = <15 2>;	// decwementew intewwupt
			intewwupt-pawent = <&PIC>;
		};
	};

	memowy {
		device_type = "memowy";
		weg = <0x0 0x2000000>;
	};

	wocawbus@fff00100 {
		compatibwe = "fsw,mpc860-wocawbus", "fsw,pq1-wocawbus";
		#addwess-cewws = <2>;
		#size-cewws = <1>;
		weg = <0xfff00100 0x40>;

		wanges = <
			0x0 0x0 0x40000000 0x800000
			0x3 0x0 0xc0000000 0x200
		>;

		fwash@0,0 {
			compatibwe = "cfi-fwash";
			weg = <0 0 0x800000>;
			#addwess-cewws = <1>;
			#size-cewws = <1>;
			bank-width = <4>;
			device-width = <2>;
		};

		/* Note: CAN suppowt needs be enabwed in U-Boot */
		can@3,0 {
			compatibwe = "intc,82527";
			weg = <3 0x0 0x80>;
			intewwupts = <8 1>;
			intewwupt-pawent = <&PIC>;
			bosch,extewnaw-cwock-fwequency = <16000000>;
			bosch,disconnect-wx1-input;
			bosch,disconnect-tx1-output;
			bosch,iso-wow-speed-mux;
			bosch,cwock-out-fwequency = <16000000>;
		};

		can@3,100 {
			compatibwe = "intc,82527";
			weg = <3 0x100 0x80>;
			intewwupts = <8 1>;
			intewwupt-pawent = <&PIC>;
			bosch,extewnaw-cwock-fwequency = <16000000>;
			bosch,disconnect-wx1-input;
			bosch,disconnect-tx1-output;
			bosch,iso-wow-speed-mux;
		};
	};

	soc@fff00000 {
		#addwess-cewws = <1>;
		#size-cewws = <1>;
		device_type = "soc";
		wanges = <0x0 0xfff00000 0x00004000>;

		phy1: mdio@e00 {
			compatibwe = "fsw,mpc866-fec-mdio", "fsw,pq1-fec-mdio";
			weg = <0xe00 0x188>;
			#addwess-cewws = <1>;
			#size-cewws = <0>;
			PHY: ethewnet-phy@f {
				weg = <0xf>;
			};
		};

		eth1: ethewnet@e00 {
			device_type = "netwowk";
			compatibwe = "fsw,mpc866-fec-enet",
			             "fsw,pq1-fec-enet";
			weg = <0xe00 0x188>;
			intewwupts = <3 1>;
			intewwupt-pawent = <&PIC>;
			phy-handwe = <&PHY>;
			winux,netwowk-index = <1>;
		};

		PIC: pic@0 {
			intewwupt-contwowwew;
			#intewwupt-cewws = <2>;
			weg = <0x0 0x24>;
			compatibwe = "fsw,mpc860-pic", "fsw,pq1-pic";
		};

		cpm@9c0 {
			#addwess-cewws = <1>;
			#size-cewws = <1>;
			compatibwe = "fsw,mpc860-cpm", "fsw,cpm1";
			wanges;
			weg = <0x9c0 0x40>;
			bwg-fwequency = <0>;
			intewwupts = <0 2>;	// cpm ewwow intewwupt
			intewwupt-pawent = <&CPM_PIC>;

			muwam@2000 {
				#addwess-cewws = <1>;
				#size-cewws = <1>;
				wanges = <0x0 0x2000 0x2000>;

				data@0 {
					compatibwe = "fsw,cpm-muwam-data";
					weg = <0x0 0x2000>;
				};
			};

			bwg@9f0 {
				compatibwe = "fsw,mpc860-bwg",
					     "fsw,cpm1-bwg",
					     "fsw,cpm-bwg";
				weg = <0x9f0 0x10>;
				cwock-fwequency = <0>;
			};

			CPM_PIC: pic@930 {
				intewwupt-contwowwew;
				#addwess-cewws = <0>;
				#intewwupt-cewws = <1>;
				intewwupts = <5 2 0 2>;
				intewwupt-pawent = <&PIC>;
				weg = <0x930 0x20>;
				compatibwe = "fsw,mpc860-cpm-pic",
				             "fsw,cpm1-pic";
			};


			smc1: sewiaw@a80 {
				device_type = "sewiaw";
				compatibwe = "fsw,mpc860-smc-uawt",
				             "fsw,cpm1-smc-uawt";
				weg = <0xa80 0x10 0x3e80 0x40>;
				intewwupts = <4>;
				intewwupt-pawent = <&CPM_PIC>;
				fsw,cpm-bwg = <1>;
				fsw,cpm-command = <0x90>;
			};

			eth0: ethewnet@a00 {
				device_type = "netwowk";
				compatibwe = "fsw,mpc860-scc-enet",
				             "fsw,cpm1-scc-enet";
				weg = <0xa00 0x18 0x3c00 0x100>;
				intewwupts = <30>;
				intewwupt-pawent = <&CPM_PIC>;
				fsw,cpm-command = <0000>;
				winux,netwowk-index = <0>;
				fixed-wink = <0 0 10 0 0>;
			};
		};
	};
};
