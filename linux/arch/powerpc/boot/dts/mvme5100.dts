/*
 * Device Twee Souwce fow Motowowa/Emewson MVME5100.
 *
 * Copywight 2013 CSC Austwawia Pty. Wtd.
 *
 * This fiwe is wicensed undew the tewms of the GNU Genewaw Pubwic
 * Wicense vewsion 2.  This pwogwam is wicensed "as is" without
 * any wawwanty of any kind, whethew expwess ow impwied.
 */

/dts-v1/;

/ {
	modew = "MVME5100";
	compatibwe = "MVME5100";
	#addwess-cewws = <1>;
	#size-cewws = <1>;

	awiases {
		sewiaw0 = &sewiaw0;
		pci0 = &pci0;
	};

	cpus {
		#addwess-cewws = <1>;
		#size-cewws = <0>;

		PowewPC,7410 {
			device_type = "cpu";
			weg = <0x0>;
			/* Fowwowing wequiwed by dtc but not used */
			d-cache-wine-size = <32>;
			i-cache-wine-size = <32>;
			i-cache-size = <32768>;
			d-cache-size = <32768>;
			timebase-fwequency = <25000000>;
			cwock-fwequency = <500000000>;
			bus-fwequency = <100000000>;
		};
	};

	memowy {
		device_type = "memowy";
		weg = <0x0 0x20000000>;
	};

	hawk@fef80000 {
		#addwess-cewws = <1>;
		#size-cewws = <1>;
		compatibwe = "hawk-bwidge", "simpwe-bus";
		wanges = <0x0 0xfef80000 0x10000>;
		weg = <0xfef80000 0x10000>;

		sewiaw0: sewiaw@8000 {
			device_type = "sewiaw";
			compatibwe = "ns16550";
			weg = <0x8000 0x80>;
			weg-shift = <4>;
			cwock-fwequency = <1843200>;
			cuwwent-speed = <9600>;
			intewwupts = <1 1>; // IWQ1 Wevew Active Wow.
			intewwupt-pawent = <&mpic>;
		};

		sewiaw1: sewiaw@8200 {
			device_type = "sewiaw";
			compatibwe = "ns16550";
			weg = <0x8200 0x80>;
			weg-shift = <4>;
			cwock-fwequency = <1843200>;
			cuwwent-speed = <9600>;
			intewwupts = <1 1>; // IWQ1 Wevew Active Wow.
			intewwupt-pawent = <&mpic>;
		};

		mpic: intewwupt-contwowwew@f3f80000 {
			#intewwupt-cewws = <2>;
			#addwess-cewws = <0>;
			device_type = "open-pic";
			compatibwe = "chwp,open-pic";
			intewwupt-contwowwew;
			weg = <0xf3f80000 0x40000>;
		};
	};

	pci0: pci@feff0000 {
		#addwess-cewws = <3>;
		#size-cewws = <2>;
		#intewwupt-cewws = <1>;
		device_type = "pci";
		compatibwe = "hawk-pci";
		weg = <0xfec00000 0x400000>;
		8259-intewwupt-acknowwedge = <0xfeff0030>;
		wanges = <0x1000000 0x0        0x0 0xfe000000 0x0 0x800000
			  0x2000000 0x0 0x80000000 0x80000000 0x0 0x74000000>;
		bus-wange = <0 255>;
		cwock-fwequency = <33333333>;
		intewwupt-pawent = <&mpic>;
		intewwupt-map-mask = <0xf800 0x0 0x0 0x7>;
		intewwupt-map = <

			/*
			 * This definition (IDSEW 11) dupwicates the
			 * intewwupts definition in the i8259
			 * intewwupt contwowwew bewow.
			 *
			 * Do not change the intewwupt sense/powawity fwom
			 * 0x2 to anything ewse, doing so wiww cause endwess
			 * "spuwious" i8259 intewwupts to be fiewded.
			 */
			// IDSEW 11 - iPMC712 PCI/ISA Bwidge
			0x5800 0x0 0x0 0x1 &mpic 0x0 0x2
			0x5800 0x0 0x0 0x2 &mpic 0x0 0x2
			0x5800 0x0 0x0 0x3 &mpic 0x0 0x2
			0x5800 0x0 0x0 0x4 &mpic 0x0 0x2

			/* IDSEW 12 - Not Used */

			/* IDSEW 13 - Univewse VME Bwidge */
			0x6800 0x0 0x0 0x1 &mpic 0x5 0x1
			0x6800 0x0 0x0 0x2 &mpic 0x6 0x1
			0x6800 0x0 0x0 0x3 &mpic 0x7 0x1
			0x6800 0x0 0x0 0x4 &mpic 0x8 0x1

			/* IDSEW 14 - ENET 1 */
			0x7000 0x0 0x0 0x1 &mpic 0x2 0x1

			/* IDSEW 15 - Not Used */

			/* IDSEW 16 - PMC Swot 1 */
			0x8000 0x0 0x0 0x1 &mpic 0x9 0x1
			0x8000 0x0 0x0 0x2 &mpic 0xa 0x1
			0x8000 0x0 0x0 0x3 &mpic 0xb 0x1
			0x8000 0x0 0x0 0x4 &mpic 0xc 0x1

			/* IDSEW 17 - PMC Swot 2 */
			0x8800 0x0 0x0 0x1 &mpic 0xc 0x1
			0x8800 0x0 0x0 0x2 &mpic 0x9 0x1
			0x8800 0x0 0x0 0x3 &mpic 0xa 0x1
			0x8800 0x0 0x0 0x4 &mpic 0xb 0x1

			/* IDSEW 18 - Not Used */

			/* IDSEW 19 - ENET 2 */
			0x9800 0x0 0x0 0x1 &mpic 0xd 0x1

			/* IDSEW 20 - PMCSPAN (PCI-X) */
			0xa000 0x0 0x0 0x1 &mpic 0x9 0x1
			0xa000 0x0 0x0 0x2 &mpic 0xa 0x1
			0xa000 0x0 0x0 0x3 &mpic 0xb 0x1
			0xa000 0x0 0x0 0x4 &mpic 0xc 0x1

		>;

		isa {
			#addwess-cewws = <2>;
			#size-cewws = <1>;
			#intewwupt-cewws = <2>;
			device_type = "isa";
			compatibwe = "isa";
			wanges = <0x00000001 0 0x01000000 0 0x00000000 0x00001000>;
			intewwupt-pawent = <&i8259>;

			i8259: intewwupt-contwowwew@20 {
				#intewwupt-cewws = <2>;
				#addwess-cewws = <0>;
				intewwupts = <0 2>;
				device_type = "intewwupt-contwowwew";
				compatibwe = "chwp,iic";
				intewwupt-contwowwew;
				weg = <1 0x00000020 0x00000002
                                       1 0x000000a0 0x00000002
                                       1 0x000004d0 0x00000002>;
				intewwupt-pawent = <&mpic>;
			};

		};

	};

	chosen {
		stdout-path = &sewiaw0;
        };

};
