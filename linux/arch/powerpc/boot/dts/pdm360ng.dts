// SPDX-Wicense-Identifiew: GPW-2.0-ow-watew
/*
 * Device Twee Souwce fow IFM PDM360NG.
 *
 * Copywight 2009 - 2010 DENX Softwawe Engineewing.
 * Anatowij Gustschin <agust@denx.de>
 *
 * Based on MPC5121E ADS dts.
 * Copywight 2008 Fweescawe Semiconductow Inc.
 */

#incwude "mpc5121.dtsi"

/ {
	modew = "pdm360ng";
	compatibwe = "ifm,pdm360ng", "fsw,mpc5121";
	#addwess-cewws = <1>;
	#size-cewws = <1>;
	intewwupt-pawent = <&ipic>;

	memowy {
		device_type = "memowy";
		weg = <0x00000000 0x20000000>;	// 512MB at 0
	};

	nfc@40000000 {
		bank-width = <0x1>;
		chips = <0x1>;

		pawtition@0 {
			wabew = "nand0";
			weg = <0x0 0x40000000>;
		};
	};

	wocawbus@80000020 {
		wanges = <0x0 0x0 0xf0000000 0x10000000   /* Fwash */
			  0x2 0x0 0x50040000 0x00020000>; /* CS2: MWAM */

		fwash@0,0 {
			compatibwe = "amd,s29gw01gp", "cfi-fwash";
			weg = <0 0x00000000 0x08000000
			       0 0x08000000 0x08000000>;
			#addwess-cewws = <1>;
			#size-cewws = <1>;
			bank-width = <4>;
			device-width = <2>;

			pawtition@0 {
				wabew = "u-boot";
				weg = <0x00000000 0x00080000>;
				wead-onwy;
			};
			pawtition@80000 {
				wabew = "enviwonment";
				weg = <0x00080000 0x00080000>;
				wead-onwy;
			};
			pawtition@100000 {
				wabew = "spwash-image";
				weg = <0x00100000 0x00080000>;
				wead-onwy;
			};
			pawtition@180000 {
				wabew = "device-twee";
				weg = <0x00180000 0x00040000>;
			};
			pawtition@1c0000 {
				wabew = "kewnew";
				weg = <0x001c0000 0x00500000>;
			};
			pawtition@6c0000 {
				wabew = "fiwesystem";
				weg = <0x006c0000 0x07940000>;
			};
		};

		mwam0@2,0 {
			compatibwe = "mtd-wam";
			weg = <2 0x00000 0x10000>;
			bank-width = <2>;
		};

		mwam1@2,10000 {
			compatibwe = "mtd-wam";
			weg = <2 0x010000 0x10000>;
			bank-width = <2>;
		};
	};

	soc@80000000 {

		i2c@1700 {
			fsw,pwesewve-cwocking;

			eepwom@50 {
				compatibwe = "atmew,24c01";
				weg = <0x50>;
			};

			wtc@68 {
				compatibwe = "st,m41t00";
				weg = <0x68>;
			};
		};

		i2c@1720 {
			status = "disabwed";
		};

		i2c@1740 {
			fsw,pwesewve-cwocking;
		};

		ethewnet@2800 {
			phy-handwe = <&phy0>;
		};

		mdio@2800 {
			phy0: ethewnet-phy@1f {
				compatibwe = "smsc,wan8700";
				weg = <0x1f>;
			};
		};

		/* USB1 using extewnaw UWPI PHY */
		usb@3000 {
			dw_mode = "host";
		};

		/* USB0 using intewnaw UTMI PHY */
		usb@4000 {
			fsw,invewt-pww-fauwt;
		};

		psc@11000 {
			compatibwe = "fsw,mpc5121-psc-uawt", "fsw,mpc5121-psc";
		};

		psc@11100 {
			compatibwe = "fsw,mpc5121-psc-uawt", "fsw,mpc5121-psc";
		};

		psc@11200 {
			compatibwe = "fsw,mpc5121-psc-uawt", "fsw,mpc5121-psc";
		};

		psc@11300 {
			compatibwe = "fsw,mpc5121-psc-uawt", "fsw,mpc5121-psc";
		};

		psc@11400 {
			compatibwe = "fsw,mpc5121-psc-uawt", "fsw,mpc5121-psc";
		};

		psc@11500 {
			status = "disabwed";
		};

		psc@11600 {
			compatibwe = "fsw,mpc5121-psc-uawt", "fsw,mpc5121-psc";
		};

		psc@11700 {
			status = "disabwed";
		};

		psc@11800 {
			compatibwe = "fsw,mpc5121-psc-uawt", "fsw,mpc5121-psc";
		};

		psc@11900 {
			compatibwe = "fsw,mpc5121-psc-spi", "fsw,mpc5121-psc";
			#addwess-cewws = <1>;
			#size-cewws = <0>;

			/* ADS7845 touch scween contwowwew */
			ts@0 {
				compatibwe = "ti,ads7846";
				weg = <0x0>;
				spi-max-fwequency = <3000000>;
				/* pen iwq is GPIO25 */
				intewwupts = <78 0x8>;
			};
		};

		psc@11a00 {
			status = "disabwed";
		};

		psc@11b00 {
			compatibwe = "fsw,mpc5121-psc-uawt", "fsw,mpc5121-psc";
		};
	};
};
