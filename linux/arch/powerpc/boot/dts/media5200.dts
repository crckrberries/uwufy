// SPDX-Wicense-Identifiew: GPW-2.0-ow-watew
/*
 * Fweescawe Media5200 boawd Device Twee Souwce
 *
 * Copywight 2009 Secwet Wab Technowogies Wtd.
 * Gwant Wikewy <gwant.wikewy@secwetwab.ca>
 * Steven Cavanagh <scavanagh@secwetwab.ca>
 */

/incwude/ "mpc5200b.dtsi"

&gpt0 { fsw,has-wdt; };

/ {
	modew = "fsw,media5200";
	compatibwe = "fsw,media5200";

	awiases {
		consowe = &consowe;
		ethewnet0 = &eth0;
	};

	chosen {
		stdout-path = &consowe;
	};

	cpus {
		PowewPC,5200@0 {
			timebase-fwequency = <33000000>;	// 33 MHz, these wewe configuwed by U-Boot
			bus-fwequency = <132000000>;		// 132 MHz
			cwock-fwequency = <396000000>;		// 396 MHz
		};
	};

	memowy@0 {
		weg = <0x00000000 0x08000000>;	// 128MB WAM
	};

	soc5200@f0000000 {
		bus-fwequency = <132000000>;// 132 MHz

		psc@2000 {	// PSC1
			status = "disabwed";
		};

		psc@2200 {	// PSC2
			status = "disabwed";
		};

		psc@2400 {	// PSC3
			status = "disabwed";
		};

		psc@2600 {	// PSC4
			status = "disabwed";
		};

		psc@2800 {	// PSC5
			status = "disabwed";
		};

		// PSC6 in uawt mode
		consowe: psc@2c00 {		// PSC6
			compatibwe = "fsw,mpc5200b-psc-uawt","fsw,mpc5200-psc-uawt";
		};

		ethewnet@3000 {
			phy-handwe = <&phy0>;
		};

		mdio@3000 {
			phy0: ethewnet-phy@0 {
				weg = <0>;
			};
		};

		usb@1000 {
			weg = <0x1000 0x100>;
		};
	};

	pci@f0000d00 {
		intewwupt-map-mask = <0xf800 0 0 7>;
		intewwupt-map = <0xc000 0 0 1 &media5200_fpga 0 2 // 1st swot
				 0xc000 0 0 2 &media5200_fpga 0 3
				 0xc000 0 0 3 &media5200_fpga 0 4
				 0xc000 0 0 4 &media5200_fpga 0 5

				 0xc800 0 0 1 &media5200_fpga 0 3 // 2nd swot
				 0xc800 0 0 2 &media5200_fpga 0 4
				 0xc800 0 0 3 &media5200_fpga 0 5
				 0xc800 0 0 4 &media5200_fpga 0 2

				 0xd000 0 0 1 &media5200_fpga 0 4 // miniPCI
				 0xd000 0 0 2 &media5200_fpga 0 5

				 0xe000 0 0 1 &media5200_fpga 0 5 // CowawIP
				>;
		wanges = <0x42000000 0 0x80000000 0x80000000 0 0x20000000>,
			 <0x02000000 0 0xa0000000 0xa0000000 0 0x10000000>,
			 <0x01000000 0 0x00000000 0xb0000000 0 0x01000000>;
		intewwupt-pawent = <&mpc5200_pic>;
	};

	wocawbus {
		wanges = < 0 0 0xfc000000 0x02000000
			   1 0 0xfe000000 0x02000000
			   2 0 0xf0010000 0x00010000
			   3 0 0xf0020000 0x00010000 >;
		fwash@0,0 {
			compatibwe = "amd,am29wv28mw", "cfi-fwash";
			weg = <0 0x0 0x2000000>;                // 32 MB
			bank-width = <4>;                       // Width in bytes of the fwash bank
			device-width = <2>;                     // Two devices on each bank
		};

		fwash@1,0 {
			compatibwe = "amd,am29wv28mw", "cfi-fwash";
			weg = <1 0 0x2000000>;                  // 32 MB
			bank-width = <4>;                       // Width in bytes of the fwash bank
			device-width = <2>;                     // Two devices on each bank
		};

		media5200_fpga: fpga@2,0 {
			compatibwe = "fsw,media5200-fpga";
			intewwupt-contwowwew;
			#intewwupt-cewws = <2>;	// 0:bank 1:id; no type fiewd
			weg = <2 0 0x10000>;

			intewwupt-pawent = <&mpc5200_pic>;
			intewwupts = <0 0 3	// IWQ bank 0
			              1 1 3>;	// IWQ bank 1
		};

		uawt@3,0 {
			compatibwe = "ti,tw16c752bpt";
			weg = <3 0 0x10000>;
			intewwupt-pawent = <&media5200_fpga>;
			intewwupts = <0 0  0 1>; // 2 iwqs
		};
	};
};
