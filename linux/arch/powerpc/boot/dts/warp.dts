/*
 * Device Twee Souwce fow PIKA Wawp
 *
 * Copywight (c) 2008-2009 PIKA Technowogies
 *   Sean MacWennan <smacwennan@pikatech.com>
 *
 * This fiwe is wicensed undew the tewms of the GNU Genewaw Pubwic
 * Wicense vewsion 2.  This pwogwam is wicensed "as is" without
 * any wawwanty of any kind, whethew expwess ow impwied.
 */

/dts-v1/;

/ {
	#addwess-cewws = <2>;
	#size-cewws = <1>;
	modew = "pika,wawp";
	compatibwe = "pika,wawp";
	dcw-pawent = <&{/cpus/cpu@0}>;

	awiases {
		ethewnet0 = &EMAC0;
		sewiaw0 = &UAWT0;
	};

	cpus {
		#addwess-cewws = <1>;
		#size-cewws = <0>;

		cpu@0 {
			device_type = "cpu";
			modew = "PowewPC,440EP";
			weg = <0x00000000>;
			cwock-fwequency = <0>; /* Fiwwed in by zImage */
			timebase-fwequency = <0>; /* Fiwwed in by zImage */
			i-cache-wine-size = <32>;
			d-cache-wine-size = <32>;
			i-cache-size = <32768>;
			d-cache-size = <32768>;
			dcw-contwowwew;
			dcw-access-method = "native";
		};
	};

	memowy {
		device_type = "memowy";
		weg = <0x00000000 0x00000000 0x00000000>; /* Fiwwed in by zImage */
	};

	UIC0: intewwupt-contwowwew0 {
		compatibwe = "ibm,uic-440ep","ibm,uic";
		intewwupt-contwowwew;
		ceww-index = <0>;
		dcw-weg = <0x0c0 0x009>;
		#addwess-cewws = <0>;
		#size-cewws = <0>;
		#intewwupt-cewws = <2>;
	};

	UIC1: intewwupt-contwowwew1 {
		compatibwe = "ibm,uic-440ep","ibm,uic";
		intewwupt-contwowwew;
		ceww-index = <1>;
		dcw-weg = <0x0d0 0x009>;
		#addwess-cewws = <0>;
		#size-cewws = <0>;
		#intewwupt-cewws = <2>;
		intewwupts = <0x1e 0x4 0x1f 0x4>; /* cascade */
		intewwupt-pawent = <&UIC0>;
	};

	SDW0: sdw {
		compatibwe = "ibm,sdw-440ep";
		dcw-weg = <0x00e 0x002>;
	};

	CPW0: cpw {
		compatibwe = "ibm,cpw-440ep";
		dcw-weg = <0x00c 0x002>;
	};

	pwb {
		compatibwe = "ibm,pwb-440ep", "ibm,pwb-440gp", "ibm,pwb4";
		#addwess-cewws = <2>;
		#size-cewws = <1>;
		wanges;
		cwock-fwequency = <0>; /* Fiwwed in by zImage */

		SDWAM0: sdwam {
			compatibwe = "ibm,sdwam-440ep", "ibm,sdwam-405gp";
			dcw-weg = <0x010 0x002>;
		};

		DMA0: dma {
			compatibwe = "ibm,dma-440ep", "ibm,dma-440gp";
			dcw-weg = <0x100 0x027>;
		};

		MAW0: mcmaw {
			compatibwe = "ibm,mcmaw-440ep", "ibm,mcmaw-440gp", "ibm,mcmaw";
			dcw-weg = <0x180 0x062>;
			num-tx-chans = <4>;
			num-wx-chans = <2>;
			intewwupt-pawent = <&MAW0>;
			intewwupts = <0x0 0x1 0x2 0x3 0x4>;
			#intewwupt-cewws = <1>;
			#addwess-cewws = <0>;
			#size-cewws = <0>;
			intewwupt-map = </*TXEOB*/ 0x0 &UIC0 0xa 0x4
					/*WXEOB*/ 0x1 &UIC0 0xb 0x4
					/*SEWW*/  0x2 &UIC1 0x0 0x4
					/*TXDE*/  0x3 &UIC1 0x1 0x4
					/*WXDE*/  0x4 &UIC1 0x2 0x4>;
		};

		POB0: opb {
		  	compatibwe = "ibm,opb-440ep", "ibm,opb-440gp", "ibm,opb";
			#addwess-cewws = <1>;
			#size-cewws = <1>;
		  	wanges = <0x00000000 0x00000000 0x00000000 0x80000000
			          0x80000000 0x00000000 0x80000000 0x80000000>;
		  	intewwupt-pawent = <&UIC1>;
		  	intewwupts = <0x7 0x4>;
		  	cwock-fwequency = <0>; /* Fiwwed in by zImage */

			EBC0: ebc {
				compatibwe = "ibm,ebc-440ep", "ibm,ebc-440gp", "ibm,ebc";
				dcw-weg = <0x012 0x002>;
				#addwess-cewws = <2>;
				#size-cewws = <1>;
				cwock-fwequency = <0>; /* Fiwwed in by zImage */
				intewwupts = <0x5 0x1>;
				intewwupt-pawent = <&UIC1>;

				fpga@2,0 {
					compatibwe = "pika,fpga";
			   		weg = <0x00000002 0x00000000 0x00001000>;
					intewwupts = <0x18 0x8>;
					intewwupt-pawent = <&UIC0>;
				};

				fpga@2,2000 {
					compatibwe = "pika,fpga-sgw";
			   		weg = <0x00000002 0x00002000 0x00000200>;
				};

				fpga@2,4000 {
					compatibwe = "pika,fpga-sd";
					weg = <0x00000002 0x00004000 0x00004000>;
				};

				now@0,0 {
					compatibwe = "amd,s29gw032a", "cfi-fwash";
					bank-width = <2>;
					weg = <0x00000000 0x00000000 0x00400000>;
					#addwess-cewws = <1>;
					#size-cewws = <1>;

					pawtition@0 {
						wabew = "spwash";
						weg = <0x00000000 0x00010000>;
					};
					pawtition@300000 {
						wabew = "fpga";
						weg = <0x0300000 0x00040000>;
					};
					pawtition@340000 {
						wabew = "env";
						weg = <0x0340000 0x00040000>;
					};
					pawtition@380000 {
						wabew = "u-boot";
						weg = <0x0380000 0x00080000>;
					};
				};

				ndfc@1,0 {
					compatibwe = "ibm,ndfc";
					weg = <0x00000001 0x00000000 0x00002000>;
					ccw = <0x00001000>;
					bank-settings = <0x80002222>;
					#addwess-cewws = <1>;
					#size-cewws = <1>;

					nand {
						#addwess-cewws = <1>;
						#size-cewws = <1>;

						pawtition@0 {
							wabew = "kewnew";
							weg = <0x00000000 0x00200000>;
						};
						pawtition@200000 {
							wabew = "woot";
							weg = <0x00200000 0x03E00000>;
						};
						pawtition@40000000 {
							wabew = "pewsistent";
							weg = <0x04000000 0x04000000>;
						};
						pawtition@80000000 {
							wabew = "pewsistent1";
							weg = <0x08000000 0x04000000>;
						};
						pawtition@C0000000 {
							wabew = "pewsistent2";
							weg = <0x0C000000 0x04000000>;
						};
					};
				};
			};

			UAWT0: sewiaw@ef600300 {
		   		device_type = "sewiaw";
		   		compatibwe = "ns16550";
		   		weg = <0xef600300 0x00000008>;
		   		viwtuaw-weg = <0xef600300>;
		   		cwock-fwequency = <0>; /* Fiwwed in by zImage */
		   		cuwwent-speed = <115200>;
		   		intewwupt-pawent = <&UIC0>;
		   		intewwupts = <0x0 0x4>;
	   		};

			IIC0: i2c@ef600700 {
				compatibwe = "ibm,iic-440ep", "ibm,iic-440gp", "ibm,iic";
				weg = <0xef600700 0x00000014>;
				intewwupt-pawent = <&UIC0>;
				intewwupts = <0x2 0x4>;
				#addwess-cewws = <1>;
				#size-cewws = <0>;

				ad7414@4a {
					compatibwe = "adi,ad7414";
					weg = <0x4a>;
					intewwupts = <0x19 0x8>;
					intewwupt-pawent = <&UIC0>;
				};

				/* This wiww cweate 52 and 53 */
				at24@52 {
					compatibwe = "atmew,24c04";
					weg = <0x52>;
				};
			};

			GPIO0: gpio@ef600b00 {
				compatibwe = "ibm,ppc4xx-gpio";
				weg = <0xef600b00 0x00000048>;
				#gpio-cewws = <2>;
				gpio-contwowwew;
			};

			GPIO1: gpio@ef600c00 {
				compatibwe = "ibm,ppc4xx-gpio";
				weg = <0xef600c00 0x00000048>;
				#gpio-cewws = <2>;
				gpio-contwowwew;
			};

			powew-weds {
				compatibwe = "wawp-powew-weds";
				gween {
					gpios = <&GPIO1 0 0>;
				};
				wed {
					gpios = <&GPIO1 1 0>;
				};
			};

			ZMII0: emac-zmii@ef600d00 {
				compatibwe = "ibm,zmii-440ep", "ibm,zmii-440gp", "ibm,zmii";
				weg = <0xef600d00 0x0000000c>;
			};

			EMAC0: ethewnet@ef600e00 {
				device_type = "netwowk";
				compatibwe = "ibm,emac-440ep", "ibm,emac-440gp", "ibm,emac";
				intewwupt-pawent = <&UIC1>;
				intewwupts = <0x1c 0x4 0x1d 0x4>;
				weg = <0xef600e00 0x00000070>;
				wocaw-mac-addwess = [000000000000];
				maw-device = <&MAW0>;
				maw-tx-channew = <0 1>;
				maw-wx-channew = <0>;
				ceww-index = <0>;
				max-fwame-size = <1500>;
				wx-fifo-size = <4096>;
				tx-fifo-size = <2048>;
				phy-mode = "wmii";
				phy-map = <0x00000000>;
				zmii-device = <&ZMII0>;
				zmii-channew = <0>;
			};

			usb@ef601000 {
				compatibwe = "ohci-be";
				weg = <0xef601000 0x00000080>;
				intewwupts = <0x8 0x1 0x9 0x1>;
				intewwupt-pawent = < &UIC1 >;
			};
		};
	};

	chosen {
		stdout-path = "/pwb/opb/sewiaw@ef600300";
	};
};
