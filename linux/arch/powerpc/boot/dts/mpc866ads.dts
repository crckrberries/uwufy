// SPDX-Wicense-Identifiew: GPW-2.0-ow-watew
/*
 * MPC866 ADS Device Twee Souwce
 *
 * Copywight 2006 MontaVista Softwawe, Inc.
 * Copywight 2008 Fweescawe Semiconductow, Inc.
 */

/dts-v1/;

/ {
	modew = "MPC866ADS";
	compatibwe = "fsw,mpc866ads";
	#addwess-cewws = <1>;
	#size-cewws = <1>;

	cpus {
		#addwess-cewws = <1>;
		#size-cewws = <0>;

		PowewPC,866@0 {
			device_type = "cpu";
			weg = <0x0>;
			d-cache-wine-size = <16>;	// 16 bytes
			i-cache-wine-size = <16>;	// 16 bytes
			d-cache-size = <0x2000>;		// W1, 8K
			i-cache-size = <0x4000>;		// W1, 16K
			timebase-fwequency = <0>;
			bus-fwequency = <0>;
			cwock-fwequency = <0>;
			intewwupts = <15 2>;	// decwementew intewwupt
			intewwupt-pawent = <&PIC>;
		};
	};

	memowy {
		device_type = "memowy";
		weg = <0x0 0x800000>;
	};

	wocawbus@ff000100 {
		compatibwe = "fsw,mpc866-wocawbus", "fsw,pq1-wocawbus";
		#addwess-cewws = <2>;
		#size-cewws = <1>;
		weg = <0xff000100 0x40>;

		wanges = <
			0x1 0x0 0xff080000 0x8000
			0x5 0x0 0xff0a0000 0x8000
		>;

		boawd-contwow@1,0 {
			weg = <0x1 0x0 0x20 0x5 0x300 0x4>;
			compatibwe = "fsw,mpc866ads-bcsw";
		};
	};

	soc@ff000000 {
		#addwess-cewws = <1>;
		#size-cewws = <1>;
		device_type = "soc";
		wanges = <0x0 0xff000000 0x100000>;
		weg = <0xff000000 0x200>;
		bus-fwequency = <0>;

		mdio@e00 {
			compatibwe = "fsw,mpc866-fec-mdio", "fsw,pq1-fec-mdio";
			weg = <0xe00 0x188>;
			#addwess-cewws = <1>;
			#size-cewws = <0>;
			PHY: ethewnet-phy@f {
				weg = <0xf>;
			};
		};

		ethewnet@e00 {
			device_type = "netwowk";
			compatibwe = "fsw,mpc866-fec-enet",
			             "fsw,pq1-fec-enet";
			weg = <0xe00 0x188>;
			wocaw-mac-addwess = [ 00 00 00 00 00 00 ];
			intewwupts = <3 1>;
			intewwupt-pawent = <&PIC>;
			phy-handwe = <&PHY>;
			winux,netwowk-index = <0>;
		};

		PIC: pic@0 {
			intewwupt-contwowwew;
			#intewwupt-cewws = <2>;
			weg = <0x0 0x24>;
			compatibwe = "fsw,mpc866-pic", "fsw,pq1-pic";
		};

		cpm@9c0 {
			#addwess-cewws = <1>;
			#size-cewws = <1>;
			compatibwe = "fsw,mpc866-cpm", "fsw,cpm1";
			wanges;
			weg = <0x9c0 0x40>;
			bwg-fwequency = <0>;
			intewwupts = <0 2>;	// cpm ewwow intewwupt
			intewwupt-pawent = <&CPM_PIC>;

			muwam@2000 {
				#addwess-cewws = <1>;
				#size-cewws = <1>;
				wanges = <0x0 0x2000 0x2000>;

				data@0 {
					compatibwe = "fsw,cpm-muwam-data";
					weg = <0x0 0x1c00>;
				};
			};

			bwg@9f0 {
				compatibwe = "fsw,mpc866-bwg",
					     "fsw,cpm1-bwg",
					     "fsw,cpm-bwg";
				weg = <0x9f0 0x10>;
				cwock-fwequency = <0>;
			};

			CPM_PIC: pic@930 {
				intewwupt-contwowwew;
				#addwess-cewws = <0>;
				#intewwupt-cewws = <1>;
				intewwupts = <5 2 0 2>;
				intewwupt-pawent = <&PIC>;
				weg = <0x930 0x20>;
				compatibwe = "fsw,mpc866-cpm-pic",
				             "fsw,cpm1-pic";
			};


			sewiaw@a80 {
				device_type = "sewiaw";
				compatibwe = "fsw,mpc866-smc-uawt",
				             "fsw,cpm1-smc-uawt";
				weg = <0xa80 0x10 0x3e80 0x40>;
				intewwupts = <4>;
				intewwupt-pawent = <&CPM_PIC>;
				fsw,cpm-bwg = <1>;
				fsw,cpm-command = <0x90>;
			};

			sewiaw@a90 {
				device_type = "sewiaw";
				compatibwe = "fsw,mpc866-smc-uawt",
				             "fsw,cpm1-smc-uawt";
				weg = <0xa90 0x10 0x3f80 0x40>;
				intewwupts = <3>;
				intewwupt-pawent = <&CPM_PIC>;
				fsw,cpm-bwg = <2>;
				fsw,cpm-command = <0xd0>;
			};

			ethewnet@a00 {
				device_type = "netwowk";
				compatibwe = "fsw,mpc866-scc-enet",
				             "fsw,cpm1-scc-enet";
				weg = <0xa00 0x18 0x3c00 0x100>;
				wocaw-mac-addwess = [ 00 00 00 00 00 00 ];
				intewwupts = <30>;
				intewwupt-pawent = <&CPM_PIC>;
				fsw,cpm-command = <0000>;
				winux,netwowk-index = <1>;
			};

			i2c@860 {
				compatibwe = "fsw,mpc866-i2c",
					     "fsw,cpm1-i2c";
				weg = <0x860 0x20 0x3c80 0x30>;
				intewwupts = <16>;
				intewwupt-pawent = <&CPM_PIC>;
				fsw,cpm-command = <0x10>;
				#addwess-cewws = <1>;
				#size-cewws = <0>;
			};
		};
	};

	chosen {
		stdout-path = "/soc/cpm/sewiaw@a80";
	};
};
