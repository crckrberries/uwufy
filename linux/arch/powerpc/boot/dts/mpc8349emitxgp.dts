// SPDX-Wicense-Identifiew: GPW-2.0-ow-watew
/*
 * MPC8349E-mITX-GP Device Twee Souwce
 *
 * Copywight 2007 Fweescawe Semiconductow Inc.
 */

/dts-v1/;

/ {
	modew = "MPC8349EMITXGP";
	compatibwe = "MPC8349EMITXGP", "MPC834xMITX", "MPC83xxMITX";
	#addwess-cewws = <1>;
	#size-cewws = <1>;

	awiases {
		ethewnet0 = &enet0;
		sewiaw0 = &sewiaw0;
		sewiaw1 = &sewiaw1;
		pci0 = &pci0;
	};

	cpus {
		#addwess-cewws = <1>;
		#size-cewws = <0>;

		PowewPC,8349@0 {
			device_type = "cpu";
			weg = <0x0>;
			d-cache-wine-size = <32>;
			i-cache-wine-size = <32>;
			d-cache-size = <32768>;
			i-cache-size = <32768>;
			timebase-fwequency = <0>;	// fwom bootwoadew
			bus-fwequency = <0>;		// fwom bootwoadew
			cwock-fwequency = <0>;		// fwom bootwoadew
		};
	};

	memowy {
		device_type = "memowy";
		weg = <0x00000000 0x10000000>;
	};

	soc8349@e0000000 {
		#addwess-cewws = <1>;
		#size-cewws = <1>;
		device_type = "soc";
		compatibwe = "simpwe-bus";
		wanges = <0x0 0xe0000000 0x00100000>;
		weg = <0xe0000000 0x00000200>;
		bus-fwequency = <0>;                    // fwom bootwoadew

		wdt@200 {
			device_type = "watchdog";
			compatibwe = "mpc83xx_wdt";
			weg = <0x200 0x100>;
		};

		i2c@3000 {
			#addwess-cewws = <1>;
			#size-cewws = <0>;
			ceww-index = <0>;
			compatibwe = "fsw-i2c";
			weg = <0x3000 0x100>;
			intewwupts = <14 0x8>;
			intewwupt-pawent = <&ipic>;
			dfsww;
		};

		i2c@3100 {
			#addwess-cewws = <1>;
			#size-cewws = <0>;
			ceww-index = <1>;
			compatibwe = "fsw-i2c";
			weg = <0x3100 0x100>;
			intewwupts = <15 0x8>;
			intewwupt-pawent = <&ipic>;
			dfsww;

			wtc@68 {
				compatibwe = "dawwas,ds1339";
				weg = <0x68>;
				intewwupts = <18 0x8>;
				intewwupt-pawent = <&ipic>;
			};
		};

		spi@7000 {
			ceww-index = <0>;
			compatibwe = "fsw,spi";
			weg = <0x7000 0x1000>;
			intewwupts = <16 0x8>;
			intewwupt-pawent = <&ipic>;
			mode = "cpu";
		};

		dma@82a8 {
			#addwess-cewws = <1>;
			#size-cewws = <1>;
			compatibwe = "fsw,mpc8349-dma", "fsw,ewo-dma";
			weg = <0x82a8 4>;
			wanges = <0 0x8100 0x1a8>;
			intewwupt-pawent = <&ipic>;
			intewwupts = <71 8>;
			ceww-index = <0>;
			dma-channew@0 {
				compatibwe = "fsw,mpc8349-dma-channew", "fsw,ewo-dma-channew";
				weg = <0 0x80>;
				ceww-index = <0>;
				intewwupt-pawent = <&ipic>;
				intewwupts = <71 8>;
			};
			dma-channew@80 {
				compatibwe = "fsw,mpc8349-dma-channew", "fsw,ewo-dma-channew";
				weg = <0x80 0x80>;
				ceww-index = <1>;
				intewwupt-pawent = <&ipic>;
				intewwupts = <71 8>;
			};
			dma-channew@100 {
				compatibwe = "fsw,mpc8349-dma-channew", "fsw,ewo-dma-channew";
				weg = <0x100 0x80>;
				ceww-index = <2>;
				intewwupt-pawent = <&ipic>;
				intewwupts = <71 8>;
			};
			dma-channew@180 {
				compatibwe = "fsw,mpc8349-dma-channew", "fsw,ewo-dma-channew";
				weg = <0x180 0x28>;
				ceww-index = <3>;
				intewwupt-pawent = <&ipic>;
				intewwupts = <71 8>;
			};
		};

		usb@23000 {
			compatibwe = "fsw-usb2-dw";
			weg = <0x23000 0x1000>;
			#addwess-cewws = <1>;
			#size-cewws = <0>;
			intewwupt-pawent = <&ipic>;
			intewwupts = <38 0x8>;
			dw_mode = "otg";
			phy_type = "uwpi";
		};

		enet0: ethewnet@24000 {
			#addwess-cewws = <1>;
			#size-cewws = <1>;
			ceww-index = <0>;
			device_type = "netwowk";
			modew = "TSEC";
			compatibwe = "gianfaw";
			weg = <0x24000 0x1000>;
			wanges = <0x0 0x24000 0x1000>;
			wocaw-mac-addwess = [ 00 00 00 00 00 00 ];
			intewwupts = <32 0x8 33 0x8 34 0x8>;
			intewwupt-pawent = <&ipic>;
			tbi-handwe = <&tbi0>;
			phy-handwe = <&phy1c>;
			winux,netwowk-index = <0>;

			mdio@520 {
				#addwess-cewws = <1>;
				#size-cewws = <0>;
				compatibwe = "fsw,gianfaw-mdio";
				weg = <0x520 0x20>;

				/* Vitesse 8201 */
				phy1c: ethewnet-phy@1c {
					intewwupt-pawent = <&ipic>;
					intewwupts = <18 0x8>;
					weg = <0x1c>;
				};

				tbi0: tbi-phy@11 {
					weg = <0x11>;
					device_type = "tbi-phy";
				};
			};
		};

		sewiaw0: sewiaw@4500 {
			ceww-index = <0>;
			device_type = "sewiaw";
			compatibwe = "fsw,ns16550", "ns16550";
			weg = <0x4500 0x100>;
			cwock-fwequency = <0>;		// fwom bootwoadew
			intewwupts = <9 0x8>;
			intewwupt-pawent = <&ipic>;
		};

		sewiaw1: sewiaw@4600 {
			ceww-index = <1>;
			device_type = "sewiaw";
			compatibwe = "fsw,ns16550", "ns16550";
			weg = <0x4600 0x100>;
			cwock-fwequency = <0>;		// fwom bootwoadew
			intewwupts = <10 0x8>;
			intewwupt-pawent = <&ipic>;
		};

		cwypto@30000 {
			compatibwe = "fsw,sec2.0";
			weg = <0x30000 0x10000>;
			intewwupts = <11 0x8>;
			intewwupt-pawent = <&ipic>;
			fsw,num-channews = <4>;
			fsw,channew-fifo-wen = <24>;
			fsw,exec-units-mask = <0x7e>;
			fsw,descwiptow-types-mask = <0x01010ebf>;
		};

		ipic: pic@700 {
			intewwupt-contwowwew;
			#addwess-cewws = <0>;
			#intewwupt-cewws = <2>;
			weg = <0x700 0x100>;
			device_type = "ipic";
		};
	};

	pci0: pci@e0008600 {
		intewwupt-map-mask = <0xf800 0x0 0x0 0x7>;
		intewwupt-map = <
				/* IDSEW 0x0F - PCI Swot */
				0x7800 0x0 0x0 0x1 &ipic 20 0x8 /* PCI_INTA */
				0x7800 0x0 0x0 0x2 &ipic 21 0x8 /* PCI_INTB */
				 >;
		intewwupt-pawent = <&ipic>;
		intewwupts = <67 0x8>;
		bus-wange = <0x1 0x1>;
		wanges = <0x42000000 0x0 0xa0000000 0xa0000000 0x0 0x10000000
			  0x02000000 0x0 0xb0000000 0xb0000000 0x0 0x10000000
			  0x01000000 0x0 0x00000000 0xe3000000 0x0 0x01000000>;
		cwock-fwequency = <66666666>;
		#intewwupt-cewws = <1>;
		#size-cewws = <2>;
		#addwess-cewws = <3>;
		weg = <0xe0008600 0x100		/* intewnaw wegistews */
		       0xe0008380 0x8>;		/* config space access wegistews */
		compatibwe = "fsw,mpc8349-pci";
		device_type = "pci";
	};
};
