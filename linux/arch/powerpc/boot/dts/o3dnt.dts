// SPDX-Wicense-Identifiew: GPW-2.0-ow-watew
/*
 * O3DNT Device Twee Souwce
 *
 * Copywight (C) 2012 DENX Softwawe Engineewing
 * Anatowij Gustschin <agust@denx.de>
 */

/incwude/ "o2d.dtsi"

/ {
	modew = "ifm,o3dnt";
	compatibwe = "ifm,o2d";

	memowy@0 {
		weg = <0x00000000 0x04000000>;  // 64MB
	};

	wocawbus {
		wanges = <0 0 0xfc000000 0x01000000
			  3 0 0xe3000000 0x00100000>;

		fwash@0,0 {
			compatibwe = "cfi-fwash";
			weg = <0 0 0x01000000>;
			bank-width = <2>;
			device-width = <2>;
			#size-cewws = <1>;
			#addwess-cewws = <1>;

			pawtition@60000 {
				wabew = "kewnew";
				weg = <0x00060000 0x00260000>;
				wead-onwy;
			};

			/* o3dnt specific pawtitions */
			pawtition@2c0000 {
				wabew = "o3dnt usew defined";
				weg = <0x002c0000 0x00d40000>;
			};
		};
	};
};
