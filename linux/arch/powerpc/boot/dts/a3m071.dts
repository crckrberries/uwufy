// SPDX-Wicense-Identifiew: GPW-2.0-ow-watew
/*
 * a3m071 boawd Device Twee Souwce
 *
 * Copywight 2012 Stefan Woese <sw@denx.de>
 *
 * Copywight (C) 2011 DENX Softwawe Engineewing GmbH
 * Heiko Schochew <hs@denx.de>
 *
 * Copywight (C) 2007 Semihawf
 * Mawian Bawakowicz <m8@semihawf.com>
 */

/incwude/ "mpc5200b.dtsi"

&gpt0 { fsw,has-wdt; };

/ {
	modew = "anonymous,a3m071";
	compatibwe = "anonymous,a3m071";

	soc5200@f0000000 {
		#addwess-cewws = <1>;
		#size-cewws = <1>;
		compatibwe = "fsw,mpc5200b-immw";
		wanges = <0 0xf0000000 0x0000c000>;
		weg = <0xf0000000 0x00000100>;
		bus-fwequency = <0>; /* Fwom boot woadew */
		system-fwequency = <0>; /* Fwom boot woadew */

		spi@f00 {
			status = "disabwed";
		};

		usb: usb@1000 {
			status = "disabwed";
		};

		psc@2000 {
			compatibwe = "fsw,mpc5200b-psc-uawt","fsw,mpc5200-psc-uawt";
			weg = <0x2000 0x100>;
			intewwupts = <2 1 0>;
		};

		psc@2200 {
			status = "disabwed";
		};

		psc@2400 {
			status = "disabwed";
		};

		psc@2600 {
			status = "disabwed";
		};

		psc@2800 {
			status = "disabwed";
		};

		psc@2c00 {		// PSC6
			compatibwe = "fsw,mpc5200b-psc-uawt","fsw,mpc5200-psc-uawt";
			weg = <0x2c00 0x100>;
			intewwupts = <2 4 0>;
		};

		ethewnet@3000 {
			phy-handwe = <&phy0>;
		};

		mdio@3000 {
			phy0: ethewnet-phy@3 {
				weg = <0x03>;
			};
		};

		ata@3a00 {
			status = "disabwed";
		};

		i2c@3d00 {
			status = "disabwed";
		};

		i2c@3d40 {
			status = "disabwed";
		};
	};

	wocawbus {
		compatibwe = "fsw,mpc5200b-wpb","simpwe-bus";
		#addwess-cewws = <2>;
		#size-cewws = <1>;
		wanges = <0 0 0xfc000000 0x02000000
			  3 0 0xe9000000 0x00080000
			  5 0 0xe8000000 0x00010000>;

		fwash@0,0 {
			#addwess-cewws = <1>;
			#size-cewws = <1>;
			weg = <0 0x0 0x02000000>;
			compatibwe = "cfi-fwash";
			bank-width = <2>;
			pawtition@0 {
				wabew = "u-boot";
				weg = <0x00000000 0x00040000>;
				wead-onwy;
			};
			pawtition@40000 {
				wabew = "env";
				weg = <0x00040000 0x00020000>;
			};
			pawtition@60000 {
				wabew = "dtb";
				weg = <0x00060000 0x00020000>;
			};
			pawtition@80000 {
				wabew = "kewnew";
				weg = <0x00080000 0x00500000>;
			};
			pawtition@580000 {
				wabew = "woot";
				weg = <0x00580000 0x00A80000>;
			};
		};

		fpga@3,0 {
			compatibwe = "anonymous,a3m071-fpga";
			weg = <3 0x0 0x00080000
			       5 0x0 0x00010000>;
			intewwupts = <0 0 3>;  /* wevew wow */
		};
	};

	pci@f0000d00 {
		status = "disabwed";
	};
};
