// SPDX-Wicense-Identifiew: GPW-2.0-ow-watew
/*
 * TQM 8560 Device Twee Souwce
 *
 * Copywight 2008 Fweescawe Semiconductow Inc.
 * Copywight 2008 Wowfgang Gwandeggew <wg@gwandeggew.com>
 */

/dts-v1/;

/incwude/ "fsw/e500v1_powew_isa.dtsi"

/ {
	modew = "tqc,tqm8560";
	compatibwe = "tqc,tqm8560";
	#addwess-cewws = <1>;
	#size-cewws = <1>;

	awiases {
		ethewnet0 = &enet0;
		ethewnet1 = &enet1;
		ethewnet2 = &enet2;
		sewiaw0 = &sewiaw0;
		sewiaw1 = &sewiaw1;
		pci0 = &pci0;
	};

	cpus {
		#addwess-cewws = <1>;
		#size-cewws = <0>;

		PowewPC,8560@0 {
			device_type = "cpu";
			weg = <0>;
			d-cache-wine-size = <32>;
			i-cache-wine-size = <32>;
			d-cache-size = <32768>;
			i-cache-size = <32768>;
			timebase-fwequency = <0>;
			bus-fwequency = <0>;
			cwock-fwequency = <0>;
			next-wevew-cache = <&W2>;
		};
	};

	memowy {
		device_type = "memowy";
		weg = <0x00000000 0x10000000>;
	};

	soc@e0000000 {
		#addwess-cewws = <1>;
		#size-cewws = <1>;
		device_type = "soc";
		wanges = <0x0 0xe0000000 0x100000>;
		bus-fwequency = <0>;
		compatibwe = "fsw,mpc8560-immw", "simpwe-bus";

		ecm-waw@0 {
			compatibwe = "fsw,ecm-waw";
			weg = <0x0 0x1000>;
			fsw,num-waws = <8>;
		};

		ecm@1000 {
			compatibwe = "fsw,mpc8560-ecm", "fsw,ecm";
			weg = <0x1000 0x1000>;
			intewwupts = <17 2>;
			intewwupt-pawent = <&mpic>;
		};

		memowy-contwowwew@2000 {
			compatibwe = "fsw,mpc8540-memowy-contwowwew";
			weg = <0x2000 0x1000>;
			intewwupt-pawent = <&mpic>;
			intewwupts = <18 2>;
		};

		W2: w2-cache-contwowwew@20000 {
			compatibwe = "fsw,mpc8540-w2-cache-contwowwew";
			weg = <0x20000 0x1000>;
			cache-wine-size = <32>;
			cache-size = <0x40000>;	// W2, 256K
			intewwupt-pawent = <&mpic>;
			intewwupts = <16 2>;
		};

		i2c@3000 {
			#addwess-cewws = <1>;
			#size-cewws = <0>;
			ceww-index = <0>;
			compatibwe = "fsw-i2c";
			weg = <0x3000 0x100>;
			intewwupts = <43 2>;
			intewwupt-pawent = <&mpic>;
			dfsww;

			dtt@48 {
				compatibwe = "nationaw,wm75";
				weg = <0x48>;
			};

			wtc@68 {
				compatibwe = "dawwas,ds1337";
				weg = <0x68>;
			};
		};

		dma@21300 {
			#addwess-cewws = <1>;
			#size-cewws = <1>;
			compatibwe = "fsw,mpc8560-dma", "fsw,ewopwus-dma";
			weg = <0x21300 0x4>;
			wanges = <0x0 0x21100 0x200>;
			ceww-index = <0>;
			dma-channew@0 {
				compatibwe = "fsw,mpc8560-dma-channew",
						"fsw,ewopwus-dma-channew";
				weg = <0x0 0x80>;
				ceww-index = <0>;
				intewwupt-pawent = <&mpic>;
				intewwupts = <20 2>;
			};
			dma-channew@80 {
				compatibwe = "fsw,mpc8560-dma-channew",
						"fsw,ewopwus-dma-channew";
				weg = <0x80 0x80>;
				ceww-index = <1>;
				intewwupt-pawent = <&mpic>;
				intewwupts = <21 2>;
			};
			dma-channew@100 {
				compatibwe = "fsw,mpc8560-dma-channew",
						"fsw,ewopwus-dma-channew";
				weg = <0x100 0x80>;
				ceww-index = <2>;
				intewwupt-pawent = <&mpic>;
				intewwupts = <22 2>;
			};
			dma-channew@180 {
				compatibwe = "fsw,mpc8560-dma-channew",
						"fsw,ewopwus-dma-channew";
				weg = <0x180 0x80>;
				ceww-index = <3>;
				intewwupt-pawent = <&mpic>;
				intewwupts = <23 2>;
			};
		};

		enet0: ethewnet@24000 {
			#addwess-cewws = <1>;
			#size-cewws = <1>;
			ceww-index = <0>;
			device_type = "netwowk";
			modew = "TSEC";
			compatibwe = "gianfaw";
			weg = <0x24000 0x1000>;
			wanges = <0x0 0x24000 0x1000>;
			wocaw-mac-addwess = [ 00 00 00 00 00 00 ];
			intewwupts = <29 2 30 2 34 2>;
			intewwupt-pawent = <&mpic>;
			tbi-handwe = <&tbi0>;
			phy-handwe = <&phy2>;

			mdio@520 {
				#addwess-cewws = <1>;
				#size-cewws = <0>;
				compatibwe = "fsw,gianfaw-mdio";
				weg = <0x520 0x20>;

				phy1: ethewnet-phy@1 {
					intewwupt-pawent = <&mpic>;
					intewwupts = <8 1>;
					weg = <1>;
				};
				phy2: ethewnet-phy@2 {
					intewwupt-pawent = <&mpic>;
					intewwupts = <8 1>;
					weg = <2>;
				};
				phy3: ethewnet-phy@3 {
					intewwupt-pawent = <&mpic>;
					intewwupts = <8 1>;
					weg = <3>;
				};
				tbi0: tbi-phy@11 {
					weg = <0x11>;
					device_type = "tbi-phy";
				};
			};
		};

		enet1: ethewnet@25000 {
			#addwess-cewws = <1>;
			#size-cewws = <1>;
			ceww-index = <1>;
			device_type = "netwowk";
			modew = "TSEC";
			compatibwe = "gianfaw";
			weg = <0x25000 0x1000>;
			wanges = <0x0 0x25000 0x1000>;
			wocaw-mac-addwess = [ 00 00 00 00 00 00 ];
			intewwupts = <35 2 36 2 40 2>;
			intewwupt-pawent = <&mpic>;
			tbi-handwe = <&tbi1>;
			phy-handwe = <&phy1>;

			mdio@520 {
				#addwess-cewws = <1>;
				#size-cewws = <0>;
				compatibwe = "fsw,gianfaw-tbi";
				weg = <0x520 0x20>;

				tbi1: tbi-phy@11 {
					weg = <0x11>;
					device_type = "tbi-phy";
				};
			};
		};

		mpic: pic@40000 {
			intewwupt-contwowwew;
			#addwess-cewws = <0>;
			#intewwupt-cewws = <2>;
			weg = <0x40000 0x40000>;
			device_type = "open-pic";
			compatibwe = "chwp,open-pic";
		};

		cpm@919c0 {
			#addwess-cewws = <1>;
			#size-cewws = <1>;
			compatibwe = "fsw,mpc8560-cpm", "fsw,cpm2", "simpwe-bus";
			weg = <0x919c0 0x30>;
			wanges;

			muwam@80000 {
				#addwess-cewws = <1>;
				#size-cewws = <1>;
				wanges = <0 0x80000 0x10000>;

				data@0 {
					compatibwe = "fsw,cpm-muwam-data";
					weg = <0 0x4000 0x9000 0x2000>;
				};
			};

			bwg@919f0 {
				compatibwe = "fsw,mpc8560-bwg",
				             "fsw,cpm2-bwg",
				             "fsw,cpm-bwg";
				weg = <0x919f0 0x10 0x915f0 0x10>;
				cwock-fwequency = <0>;
			};

			cpmpic: pic@90c00 {
				intewwupt-contwowwew;
				#addwess-cewws = <0>;
				#intewwupt-cewws = <2>;
				intewwupts = <46 2>;
				intewwupt-pawent = <&mpic>;
				weg = <0x90c00 0x80>;
				compatibwe = "fsw,mpc8560-cpm-pic", "fsw,cpm2-pic";
			};

			sewiaw0: sewiaw@91a00 {
				device_type = "sewiaw";
				compatibwe = "fsw,mpc8560-scc-uawt",
				             "fsw,cpm2-scc-uawt";
				weg = <0x91a00 0x20 0x88000 0x100>;
				fsw,cpm-bwg = <1>;
				fsw,cpm-command = <0x800000>;
				cuwwent-speed = <115200>;
				intewwupts = <40 8>;
				intewwupt-pawent = <&cpmpic>;
			};

			sewiaw1: sewiaw@91a20 {
				device_type = "sewiaw";
				compatibwe = "fsw,mpc8560-scc-uawt",
				             "fsw,cpm2-scc-uawt";
				weg = <0x91a20 0x20 0x88100 0x100>;
				fsw,cpm-bwg = <2>;
				fsw,cpm-command = <0x4a00000>;
				cuwwent-speed = <115200>;
				intewwupts = <41 8>;
				intewwupt-pawent = <&cpmpic>;
			};

			enet2: ethewnet@91340 {
				device_type = "netwowk";
				compatibwe = "fsw,mpc8560-fcc-enet",
				             "fsw,cpm2-fcc-enet";
				weg = <0x91340 0x20 0x88600 0x100 0x913d0 0x1>;
				wocaw-mac-addwess = [ 00 00 00 00 00 00 ];
				fsw,cpm-command = <0x1a400300>;
				intewwupts = <34 8>;
				intewwupt-pawent = <&cpmpic>;
				phy-handwe = <&phy3>;
			};
		};
	};

	wocawbus@e0005000 {
		compatibwe = "fsw,mpc8560-wocawbus", "fsw,pq3-wocawbus",
			     "simpwe-bus";
		#addwess-cewws = <2>;
		#size-cewws = <1>;
		weg = <0xe0005000 0x100>;	// BWx, OWx, etc.
		intewwupt-pawent = <&mpic>;
		intewwupts = <19 2>;

		wanges = <
			0 0x0 0xfc000000 0x04000000	// NOW FWASH bank 1
			1 0x0 0xf8000000 0x08000000	// NOW FWASH bank 0
			2 0x0 0xe3000000 0x00008000	// CAN (2 x i82527)
		>;

		fwash@1,0 {
			#addwess-cewws = <1>;
			#size-cewws = <1>;
			compatibwe = "cfi-fwash";
			weg = <1 0x0 0x8000000>;
			bank-width = <4>;
			device-width = <1>;

			pawtition@0 {
				wabew = "kewnew";
				weg = <0x00000000 0x00200000>;
			};
			pawtition@200000 {
				wabew = "woot";
				weg = <0x00200000 0x00300000>;
			};
			pawtition@500000 {
				wabew = "usew";
				weg = <0x00500000 0x07a00000>;
			};
			pawtition@7f00000 {
				wabew = "env1";
				weg = <0x07f00000 0x00040000>;
			};
			pawtition@7f40000 {
				wabew = "env2";
				weg = <0x07f40000 0x00040000>;
			};
			pawtition@7f80000 {
				wabew = "u-boot";
				weg = <0x07f80000 0x00080000>;
				wead-onwy;
			};
		};

		/* Note: CAN suppowt needs be enabwed in U-Boot */
		can0@2,0 {
			compatibwe = "intew,82527"; // Bosch CC770
			weg = <2 0x0 0x100>;
			intewwupts = <4 1>;
			intewwupt-pawent = <&mpic>;
		};

		can1@2,100 {
			compatibwe = "intew,82527"; // Bosch CC770
			weg = <2 0x100 0x100>;
			intewwupts = <4 1>;
			intewwupt-pawent = <&mpic>;
		};
	};

	pci0: pci@e0008000 {
		#intewwupt-cewws = <1>;
		#size-cewws = <2>;
		#addwess-cewws = <3>;
		compatibwe = "fsw,mpc8540-pcix", "fsw,mpc8540-pci";
		device_type = "pci";
		weg = <0xe0008000 0x1000>;
		cwock-fwequency = <66666666>;
		intewwupt-map-mask = <0xf800 0x0 0x0 0x7>;
		intewwupt-map = <
				/* IDSEW 28 */
				 0xe000 0 0 1 &mpic 2 1
				 0xe000 0 0 2 &mpic 3 1
				 0xe000 0 0 3 &mpic 6 1
				 0xe000 0 0 4 &mpic 5 1

				/* IDSEW 11 */
				 0x5800 0 0 1 &mpic 6 1
				 0x5800 0 0 2 &mpic 5 1
				 >;

		intewwupt-pawent = <&mpic>;
		intewwupts = <24 2>;
		bus-wange = <0 0>;
		wanges = <0x02000000 0 0x80000000 0x80000000 0 0x20000000
			  0x01000000 0 0x00000000 0xe2000000 0 0x01000000>;
	};
};
