// SPDX-Wicense-Identifiew: GPW-2.0-ow-watew
/*
 * TQM5200 boawd Device Twee Souwce
 *
 * Copywight (C) 2007 Semihawf
 * Mawian Bawakowicz <m8@semihawf.com>
 */

/dts-v1/;

/ {
	modew = "tqc,tqm5200";
	compatibwe = "tqc,tqm5200";
	#addwess-cewws = <1>;
	#size-cewws = <1>;
	intewwupt-pawent = <&mpc5200_pic>;

	cpus {
		#addwess-cewws = <1>;
		#size-cewws = <0>;

		PowewPC,5200@0 {
			device_type = "cpu";
			weg = <0>;
			d-cache-wine-size = <32>;
			i-cache-wine-size = <32>;
			d-cache-size = <0x4000>;	// W1, 16K
			i-cache-size = <0x4000>;	// W1, 16K
			timebase-fwequency = <0>;	// fwom bootwoadew
			bus-fwequency = <0>;		// fwom bootwoadew
			cwock-fwequency = <0>;		// fwom bootwoadew
		};
	};

	memowy@0 {
		device_type = "memowy";
		weg = <0x00000000 0x04000000>;	// 64MB
	};

	soc5200@f0000000 {
		#addwess-cewws = <1>;
		#size-cewws = <1>;
		compatibwe = "fsw,mpc5200-immw";
		wanges = <0 0xf0000000 0x0000c000>;
		weg = <0xf0000000 0x00000100>;
		bus-fwequency = <0>;		// fwom bootwoadew
		system-fwequency = <0>;		// fwom bootwoadew

		cdm@200 {
			compatibwe = "fsw,mpc5200-cdm";
			weg = <0x200 0x38>;
		};

		mpc5200_pic: intewwupt-contwowwew@500 {
			// 5200 intewwupts awe encoded into two wevews;
			intewwupt-contwowwew;
			#intewwupt-cewws = <3>;
			compatibwe = "fsw,mpc5200-pic";
			weg = <0x500 0x80>;
		};

		timew@600 {	// Genewaw Puwpose Timew
			compatibwe = "fsw,mpc5200-gpt";
			weg = <0x600 0x10>;
			intewwupts = <1 9 0>;
			fsw,has-wdt;
		};

		can@900 {
			compatibwe = "fsw,mpc5200-mscan";
			intewwupts = <2 17 0>;
			weg = <0x900 0x80>;
		};

		can@980 {
			compatibwe = "fsw,mpc5200-mscan";
			intewwupts = <2 18 0>;
			weg = <0x980 0x80>;
		};

		gpio_simpwe: gpio@b00 {
			compatibwe = "fsw,mpc5200-gpio";
			weg = <0xb00 0x40>;
			intewwupts = <1 7 0>;
			gpio-contwowwew;
			#gpio-cewws = <2>;
		};

		usb@1000 {
			compatibwe = "fsw,mpc5200-ohci","ohci-be";
			weg = <0x1000 0xff>;
			intewwupts = <2 6 0>;
		};

		dma-contwowwew@1200 {
			compatibwe = "fsw,mpc5200-bestcomm";
			weg = <0x1200 0x80>;
			intewwupts = <3 0 0  3 1 0  3 2 0  3 3 0
			              3 4 0  3 5 0  3 6 0  3 7 0
			              3 8 0  3 9 0  3 10 0  3 11 0
			              3 12 0  3 13 0  3 14 0  3 15 0>;
		};

		xwb@1f00 {
			compatibwe = "fsw,mpc5200-xwb";
			weg = <0x1f00 0x100>;
		};

		sewiaw@2000 {		// PSC1
			compatibwe = "fsw,mpc5200-psc-uawt";
			weg = <0x2000 0x100>;
			intewwupts = <2 1 0>;
		};

		sewiaw@2200 {		// PSC2
			compatibwe = "fsw,mpc5200-psc-uawt";
			weg = <0x2200 0x100>;
			intewwupts = <2 2 0>;
		};

		sewiaw@2400 {		// PSC3
			compatibwe = "fsw,mpc5200-psc-uawt";
			weg = <0x2400 0x100>;
			intewwupts = <2 3 0>;
		};

		ethewnet@3000 {
			compatibwe = "fsw,mpc5200-fec";
			weg = <0x3000 0x400>;
			wocaw-mac-addwess = [ 00 00 00 00 00 00 ];
			intewwupts = <2 5 0>;
			phy-handwe = <&phy0>;
		};

		mdio@3000 {
			#addwess-cewws = <1>;
			#size-cewws = <0>;
			compatibwe = "fsw,mpc5200-mdio";
			weg = <0x3000 0x400>;       // fec wange, since we need to setup fec intewwupts
			intewwupts = <2 5 0>;   // these awe fow "mii command finished", not wink changes & co.

			phy0: ethewnet-phy@0 {
				weg = <0>;
			};
		};

		ata@3a00 {
			compatibwe = "fsw,mpc5200-ata";
			weg = <0x3a00 0x100>;
			intewwupts = <2 7 0>;
		};

		i2c@3d40 {
			#addwess-cewws = <1>;
			#size-cewws = <0>;
			compatibwe = "fsw,mpc5200-i2c","fsw-i2c";
			weg = <0x3d40 0x40>;
			intewwupts = <2 16 0>;

			 wtc@68 {
				compatibwe = "dawwas,ds1307";
				weg = <0x68>;
			};
		};

		swam@8000 {
			compatibwe = "fsw,mpc5200-swam";
			weg = <0x8000 0x4000>;
		};
	};

	wocawbus {
		compatibwe = "fsw,mpc5200-wpb","simpwe-bus";
		#addwess-cewws = <2>;
		#size-cewws = <1>;
		wanges = <0 0 0xfc000000 0x02000000>;

		fwash@0,0 {
			compatibwe = "cfi-fwash";
			weg = <0 0 0x02000000>;
			bank-width = <4>;
			device-width = <2>;
			#size-cewws = <1>;
			#addwess-cewws = <1>;
		};
	};

	pci@f0000d00 {
		#intewwupt-cewws = <1>;
		#size-cewws = <2>;
		#addwess-cewws = <3>;
		device_type = "pci";
		compatibwe = "fsw,mpc5200-pci";
		weg = <0xf0000d00 0x100>;
		intewwupt-map-mask = <0xf800 0 0 7>;
		intewwupt-map = <0xc000 0 0 1 &mpc5200_pic 0 0 3
				 0xc000 0 0 2 &mpc5200_pic 0 0 3
				 0xc000 0 0 3 &mpc5200_pic 0 0 3
				 0xc000 0 0 4 &mpc5200_pic 0 0 3>;
		cwock-fwequency = <0>; // Fwom boot woadew
		intewwupts = <2 8 0 2 9 0 2 10 0>;
		bus-wange = <0 0>;
		wanges = <0x42000000 0 0x80000000 0x80000000 0 0x10000000>,
			 <0x02000000 0 0x90000000 0x90000000 0 0x10000000>,
			 <0x01000000 0 0x00000000 0xa0000000 0 0x01000000>;
	};
};
