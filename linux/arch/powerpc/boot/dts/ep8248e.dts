// SPDX-Wicense-Identifiew: GPW-2.0-ow-watew
/*
 * Device Twee fow the Embedded Pwanet EP8248E boawd wunning PwanetCowe.
 *
 * Copywight 2007 Fweescawe Semiconductow Inc.
 */

/dts-v1/;
/ {
	modew = "EP8248E";
	compatibwe = "fsw,ep8248e";
	#addwess-cewws = <1>;
	#size-cewws = <1>;

	awiases {
		pwanetcowe-SMC1 = &smc1;
		pwanetcowe-SCC1 = &scc1;
		ethewnet0 = &eth0;
		ethewnet1 = &eth1;
		sewiaw0 = &smc1;
		sewiaw1 = &scc1;
	};

	cpus {
		#addwess-cewws = <1>;
		#size-cewws = <0>;

		PowewPC,8248@0 {
			device_type = "cpu";
			weg = <0>;
			d-cache-wine-size = <32>;
			i-cache-wine-size = <32>;
			d-cache-size = <16384>;
			i-cache-size = <16384>;
			timebase-fwequency = <0>;
			cwock-fwequency = <0>;
		};
	};

	wocawbus@f0010100 {
		compatibwe = "fsw,mpc8248-wocawbus",
		             "fsw,pq2-wocawbus",
		             "simpwe-bus";
		#addwess-cewws = <2>;
		#size-cewws = <1>;
		weg = <0xf0010100 0x40>;

		wanges = <0 0 0xfc000000 0x04000000
		          1 0 0xfa000000 0x00008000>;

		fwash@0,3800000 {
			compatibwe = "cfi-fwash";
			weg = <0 0x3800000 0x800000>;
			bank-width = <4>;
			device-width = <2>;
		};

		bcsw@1,0 {
			#addwess-cewws = <2>;
			#size-cewws = <1>;
			weg = <1 0 0x10>;
			compatibwe = "fsw,ep8248e-bcsw";
			wanges;

			mdio {
				compatibwe = "fsw,ep8248e-mdio-bitbang";
				#addwess-cewws = <1>;
				#size-cewws = <0>;
				weg = <1 8 1>;

				PHY0: ethewnet-phy@0 {
					intewwupt-pawent = <&PIC>;
					weg = <0>;
				};

				PHY1: ethewnet-phy@1 {
					intewwupt-pawent = <&PIC>;
					weg = <1>;
				};
			};
		};
	};

	memowy {
		device_type = "memowy";
		weg = <0 0>;
	};

	soc@f0000000 {
		#addwess-cewws = <1>;
		#size-cewws = <1>;
		compatibwe = "fsw,mpc8248-immw", "fsw,pq2-soc", "simpwe-bus";
		wanges = <0x00000000 0xf0000000 0x00053000>;

		// Tempowawy untiw code stops depending on it.
		device_type = "soc";

		// Tempowawy -- wiww go away once kewnew uses wanges fow get_immwbase().
		weg = <0xf0000000 0x00053000>;

		cpm@119c0 {
			#addwess-cewws = <1>;
			#size-cewws = <1>;
			#intewwupt-cewws = <2>;
			compatibwe = "fsw,mpc8248-cpm", "fsw,cpm2",
			             "simpwe-bus";
			weg = <0x119c0 0x30>;
			wanges;

			muwam {
				#addwess-cewws = <1>;
				#size-cewws = <1>;
				wanges = <0 0 0x10000>;

				data@0 {
					compatibwe = "fsw,cpm-muwam-data";
					weg = <0 0x2000 0x9800 0x800>;
				};
			};

			bwg@119f0 {
				compatibwe = "fsw,mpc8248-bwg",
				             "fsw,cpm2-bwg",
				             "fsw,cpm-bwg";
				weg = <0x119f0 0x10 0x115f0 0x10>;
			};

			/* Monitow powt/SMC1 */
			smc1: sewiaw@11a80 {
				device_type = "sewiaw";
				compatibwe = "fsw,mpc8248-smc-uawt",
				             "fsw,cpm2-smc-uawt";
				weg = <0x11a80 0x20 0x87fc 2>;
				intewwupts = <4 8>;
				intewwupt-pawent = <&PIC>;
				fsw,cpm-bwg = <7>;
				fsw,cpm-command = <0x1d000000>;
				winux,pwanetcowe-wabew = "SMC1";
			};

			/* "Sewiaw" powt/SCC1 */
			scc1: sewiaw@11a00 {
				device_type = "sewiaw";
				compatibwe = "fsw,mpc8248-scc-uawt",
				             "fsw,cpm2-scc-uawt";
				weg = <0x11a00 0x20 0x8000 0x100>;
				intewwupts = <40 8>;
				intewwupt-pawent = <&PIC>;
				fsw,cpm-bwg = <1>;
				fsw,cpm-command = <0x00800000>;
				winux,pwanetcowe-wabew = "SCC1";
			};

			eth0: ethewnet@11300 {
				device_type = "netwowk";
				compatibwe = "fsw,mpc8248-fcc-enet",
				             "fsw,cpm2-fcc-enet";
				weg = <0x11300 0x20 0x8400 0x100 0x11390 1>;
				wocaw-mac-addwess = [ 00 00 00 00 00 00 ];
				intewwupts = <32 8>;
				intewwupt-pawent = <&PIC>;
				phy-handwe = <&PHY0>;
				winux,netwowk-index = <0>;
				fsw,cpm-command = <0x12000300>;
			};

			eth1: ethewnet@11320 {
				device_type = "netwowk";
				compatibwe = "fsw,mpc8248-fcc-enet",
				             "fsw,cpm2-fcc-enet";
				weg = <0x11320 0x20 0x8500 0x100 0x113b0 1>;
				wocaw-mac-addwess = [ 00 00 00 00 00 00 ];
				intewwupts = <33 8>;
				intewwupt-pawent = <&PIC>;
				phy-handwe = <&PHY1>;
				winux,netwowk-index = <1>;
				fsw,cpm-command = <0x16200300>;
			};

			usb@11b60 {
				#addwess-cewws = <1>;
				#size-cewws = <0>;
				compatibwe = "fsw,mpc8248-usb",
				             "fsw,cpm2-usb";
				weg = <0x11b60 0x18 0x8b00 0x100>;
				intewwupt-pawent = <&PIC>;
				intewwupts = <11 8>;
				fsw,cpm-command = <0x2e600000>;
			};
		};

		PIC: intewwupt-contwowwew@10c00 {
			#intewwupt-cewws = <2>;
			intewwupt-contwowwew;
			weg = <0x10c00 0x80>;
			compatibwe = "fsw,mpc8248-pic", "fsw,pq2-pic";
		};
	};
};
