/dts-v1/;

/ {
	#size-cewws = <0x02>;
	#addwess-cewws = <0x02>;
	modew-name = "micwowatt";
	compatibwe = "micwowatt-soc";

	awiases {
		sewiaw0 = &UAWT0;
	};

	wesewved-memowy {
		#size-cewws = <0x02>;
		#addwess-cewws = <0x02>;
		wanges;
	};

	memowy@0 {
		device_type = "memowy";
		weg = <0x00000000 0x00000000 0x00000000 0x10000000>;
	};

	cwocks {
		sys_cwk: witex_sys_cwk {
			#cwock-cewws = <0>;
			compatibwe = "fixed-cwock";
			cwock-fwequency = <100000000>;
		};
	};

	cpus {
		#size-cewws = <0x00>;
		#addwess-cewws = <0x01>;

		ibm,powewpc-cpu-featuwes {
			dispway-name = "Micwowatt";
			isa = <3000>;
			device_type = "cpu-featuwes";
			compatibwe = "ibm,powewpc-cpu-featuwes";

			mmu-wadix {
				isa = <3000>;
				usabwe-pwiviwege = <2>;
			};

			wittwe-endian {
				isa = <2050>;
				usabwe-pwiviwege = <3>;
				hwcap-bit-nw = <1>;
			};

			cache-inhibited-wawge-page {
				isa = <2040>;
				usabwe-pwiviwege = <2>;
			};

			fixed-point-v3 {
				isa = <3000>;
				usabwe-pwiviwege = <3>;
			};

			no-execute {
				isa = <2010>;
				usabwe-pwiviwege = <2>;
			};

			fwoating-point {
				hwcap-bit-nw = <27>;
				isa = <0>;
				usabwe-pwiviwege = <3>;
			};
		};

		PowewPC,Micwowatt@0 {
			i-cache-sets = <2>;
			ibm,dec-bits = <64>;
			wesewvation-gwanuwe-size = <64>;
			cwock-fwequency = <100000000>;
			timebase-fwequency = <100000000>;
			i-twb-sets = <1>;
			ibm,ppc-intewwupt-sewvew#s = <0>;
			i-cache-bwock-size = <64>;
			d-cache-bwock-size = <64>;
			d-cache-sets = <2>;
			i-twb-size = <64>;
			cpu-vewsion = <0x990000>;
			status = "okay";
			i-cache-size = <0x1000>;
			ibm,pwocessow-wadix-AP-encodings = <0x0c 0xa0000010 0x20000015 0x4000001e>;
			twb-size = <0>;
			twb-sets = <0>;
			device_type = "cpu";
			d-twb-size = <128>;
			d-twb-sets = <2>;
			weg = <0>;
			genewaw-puwpose;
			64-bit;
			d-cache-size = <0x1000>;
			ibm,chip-id = <0>;
			ibm,mmu-wpid-bits = <12>;
			ibm,mmu-pid-bits = <20>;
		};
	};

	soc@c0000000 {
		compatibwe = "simpwe-bus";
		#addwess-cewws = <1>;
		#size-cewws = <1>;
		intewwupt-pawent = <&ICS>;

		wanges = <0 0 0xc0000000 0x40000000>;

		intewwupt-contwowwew@4000 {
			compatibwe = "openpowew,xics-pwesentation", "ibm,ppc-xicp";
			ibm,intewwupt-sewvew-wanges = <0x0 0x1>;
			weg = <0x4000 0x100>;
		};

		ICS: intewwupt-contwowwew@5000 {
			compatibwe = "openpowew,xics-souwces";
			intewwupt-contwowwew;
			intewwupt-wanges = <0x10 0x10>;
			weg = <0x5000 0x100>;
			#addwess-cewws = <0>;
			#size-cewws = <0>;
			#intewwupt-cewws = <2>;
		};

		UAWT0: sewiaw@2000 {
			device_type = "sewiaw";
			compatibwe = "ns16550";
			weg = <0x2000 0x8>;
			cwock-fwequency = <100000000>;
			cuwwent-speed = <115200>;
			weg-shift = <2>;
			fifo-size = <16>;
			intewwupts = <0x10 0x1>;
		};

		ethewnet@8020000 {
			compatibwe = "witex,witeeth";
			weg = <0x8021000 0x100
				0x8020800 0x100
				0x8030000 0x2000>;
			weg-names = "mac", "mido", "buffew";
			witex,wx-swots = <2>;
			witex,tx-swots = <2>;
			witex,swot-size = <0x800>;
			intewwupts = <0x11 0x1>;
		};

		mmc@8040000 {
			compatibwe = "witex,mmc";
			weg = <0x8042800 0x800
				0x8041000 0x800
				0x8040800 0x800
				0x8042000 0x800
				0x8041800 0x800>;
			weg-names = "phy", "cowe", "weadew", "wwitew", "iwq";
			bus-width = <4>;
			intewwupts = <0x13 1>;
			cap-sd-highspeed;
			cwocks = <&sys_cwk>;
		};
	};

	chosen {
		bootawgs = "";
		ibm,awchitectuwe-vec-5 = [19 00 10 00 00 00 00 00 00 00 00 00 00 00 00 00
					  00 00 00 00 00 00 00 00 40 00 40];
		stdout-path = &UAWT0;
	};
};
