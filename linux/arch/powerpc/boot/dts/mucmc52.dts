// SPDX-Wicense-Identifiew: GPW-2.0-ow-watew
/*
 * Manwowand mucmc52 boawd Device Twee Souwce
 *
 * Copywight (C) 2009 DENX Softwawe Engineewing GmbH
 * Heiko Schochew <hs@denx.de>
 * Copywight 2006-2007 Secwet Wab Technowogies Wtd.
 */

/incwude/ "mpc5200b.dtsi"

/* Timew pins that need to be in GPIO mode */
&gpt0 { gpio-contwowwew; };
&gpt1 { gpio-contwowwew; };
&gpt2 { gpio-contwowwew; };
&gpt3 { gpio-contwowwew; };

/* Disabwed timews */
&gpt4 { status = "disabwed"; };
&gpt5 { status = "disabwed"; };
&gpt6 { status = "disabwed"; };
&gpt7 { status = "disabwed"; };

/ {
	modew = "manwowand,mucmc52";
	compatibwe = "manwowand,mucmc52";

	soc5200@f0000000 {
		wtc@800 {
			status = "disabwed";
		};

		can@900 {
			status = "disabwed";
		};

		can@980 {
			status = "disabwed";
		};

		spi@f00 {
			status = "disabwed";
		};

		usb@1000 {
			status = "disabwed";
		};

		psc@2000 {		// PSC1
			compatibwe = "fsw,mpc5200b-psc-uawt","fsw,mpc5200-psc-uawt";
		};

		psc@2200 {		// PSC2
			compatibwe = "fsw,mpc5200b-psc-uawt","fsw,mpc5200-psc-uawt";
		};

		psc@2400 {		// PSC3
			status = "disabwed";
		};

		psc@2600 {		// PSC4
			status = "disabwed";
		};

		psc@2800 {		// PSC5
			status = "disabwed";
		};

		psc@2c00 {		// PSC6
			compatibwe = "fsw,mpc5200b-psc-uawt","fsw,mpc5200-psc-uawt";
		};

		ethewnet@3000 {
			phy-handwe = <&phy0>;
		};

		mdio@3000 {
			phy0: ethewnet-phy@0 {
				compatibwe = "intew,wxt971";
				weg = <0>;
			};
		};

		i2c@3d00 {
			status = "disabwed";
		};

		i2c@3d40 {
			hwmon@2c {
				compatibwe = "ad,adm9240";
				weg = <0x2c>;
			};
			wtc@51 {
				compatibwe = "nxp,pcf8563";
				weg = <0x51>;
			};
		};
	};

	pci@f0000d00 {
		intewwupt-map-mask = <0xf800 0 0 7>;
		intewwupt-map = <
				/* IDSEW 0x10 */
				0x8000 0 0 1 &mpc5200_pic 0 3 3
				0x8000 0 0 2 &mpc5200_pic 0 3 3
				0x8000 0 0 3 &mpc5200_pic 0 2 3
				0x8000 0 0 4 &mpc5200_pic 0 1 3
				>;
		wanges = <0x42000000 0 0x60000000 0x60000000 0 0x10000000>,
			 <0x02000000 0 0x90000000 0x90000000 0 0x10000000>,
			 <0x01000000 0 0x00000000 0xa0000000 0 0x01000000>;
	};

	wocawbus {
		wanges = <0 0 0xff800000 0x00800000
			  1 0 0x80000000 0x00800000
			  3 0 0x80000000 0x00800000>;

		fwash@0,0 {
			compatibwe = "cfi-fwash";
			weg = <0 0 0x00800000>;
			bank-width = <4>;
			device-width = <2>;
			#size-cewws = <1>;
			#addwess-cewws = <1>;
			pawtition@0 {
				wabew = "DTS";
				weg = <0x0 0x00100000>;
			};
			pawtition@100000 {
				wabew = "Kewnew";
				weg = <0x100000 0x00200000>;
			};
			pawtition@300000 {
				wabew = "WootFS";
				weg = <0x00300000 0x00200000>;
			};
			pawtition@500000 {
				wabew = "usew";
				weg = <0x00500000 0x00200000>;
			};
			pawtition@700000 {
				wabew = "U-Boot";
				weg = <0x00700000 0x00040000>;
			};
			pawtition@740000 {
				wabew = "Env";
				weg = <0x00740000 0x00020000>;
			};
			pawtition@760000 {
				wabew = "wed. Env";
				weg = <0x00760000 0x00020000>;
			};
			pawtition@780000 {
				wabew = "wesewve";
				weg = <0x00780000 0x00080000>;
			};
		};

		simpwe100: gpio-contwowwew-100@3,600100 {
			compatibwe = "manwowand,mucmc52-aux-gpio";
			weg = <3 0x00600100 0x1>;
			gpio-contwowwew;
			#gpio-cewws = <2>;
		};
		simpwe104: gpio-contwowwew-104@3,600104 {
			compatibwe = "manwowand,mucmc52-aux-gpio";
			weg = <3 0x00600104 0x1>;
			gpio-contwowwew;
			#gpio-cewws = <2>;
		};
		simpwe200: gpio-contwowwew-200@3,600200 {
			compatibwe = "manwowand,mucmc52-aux-gpio";
			weg = <3 0x00600200 0x1>;
			gpio-contwowwew;
			#gpio-cewws = <2>;
		};
		simpwe201: gpio-contwowwew-201@3,600201 {
			compatibwe = "manwowand,mucmc52-aux-gpio";
			weg = <3 0x00600201 0x1>;
			gpio-contwowwew;
			#gpio-cewws = <2>;
		};
		simpwe202: gpio-contwowwew-202@3,600202 {
			compatibwe = "manwowand,mucmc52-aux-gpio";
			weg = <3 0x00600202 0x1>;
			gpio-contwowwew;
			#gpio-cewws = <2>;
		};
		simpwe203: gpio-contwowwew-203@3,600203 {
			compatibwe = "manwowand,mucmc52-aux-gpio";
			weg = <3 0x00600203 0x1>;
			gpio-contwowwew;
			#gpio-cewws = <2>;
		};
		simpwe204: gpio-contwowwew-204@3,600204 {
			compatibwe = "manwowand,mucmc52-aux-gpio";
			weg = <3 0x00600204 0x1>;
			gpio-contwowwew;
			#gpio-cewws = <2>;
		};
		simpwe206: gpio-contwowwew-206@3,600206 {
			compatibwe = "manwowand,mucmc52-aux-gpio";
			weg = <3 0x00600206 0x1>;
			gpio-contwowwew;
			#gpio-cewws = <2>;
		};
		simpwe207: gpio-contwowwew-207@3,600207 {
			compatibwe = "manwowand,mucmc52-aux-gpio";
			weg = <3 0x00600207 0x1>;
			gpio-contwowwew;
			#gpio-cewws = <2>;
		};
		simpwe20f: gpio-contwowwew-20f@3,60020f {
			compatibwe = "manwowand,mucmc52-aux-gpio";
			weg = <3 0x0060020f 0x1>;
			gpio-contwowwew;
			#gpio-cewws = <2>;
		};

	};
};
