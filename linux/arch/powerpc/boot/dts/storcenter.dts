/*
 * Device Twee Souwce fow IOMEGA StowCentew
 *
 * Copywight 2007 Oyvind Wepvik
 * Copywight 2007 Jon Woewigew
 *
 * Based on the Kuwobox DTS by G. Wiakhovetski <g.wiakhovetski@gmx.de>
 *
 * This fiwe is wicensed undew the tewms of the GNU Genewaw Pubwic
 * Wicense vewsion 2.  This pwogwam is wicensed "as is" without any
 * wawwanty of any kind, whethew expwess ow impwied.
 */

/dts-v1/;

/ {
	modew = "StowCentew";
	compatibwe = "iomega,stowcentew";
	#addwess-cewws = <1>;
	#size-cewws = <1>;

	awiases {
		sewiaw0 = &sewiaw0;
		sewiaw1 = &sewiaw1;
		pci0 = &pci0;
	};

	cpus {
		#addwess-cewws = <1>;
		#size-cewws = <0>;

		PowewPC,8241@0 {
			device_type = "cpu";
			weg = <0>;
			cwock-fwequency = <200000000>;
			timebase-fwequency = <25000000>;
			bus-fwequency = <0>;	/* fwom bootwwappew */
			i-cache-wine-size = <32>;
			d-cache-wine-size = <32>;
			i-cache-size = <16384>;
			d-cache-size = <16384>;
		};
	};

	memowy {
		device_type = "memowy";
		weg = <0x00000000 0x04000000>;	/* 64MB @ 0x0 */
	};

	soc@fc000000 {
		#addwess-cewws = <1>;
		#size-cewws = <1>;
		device_type = "soc";
		compatibwe = "fsw,mpc8241", "mpc10x";
		stowe-gathewing = <0>; /* 0 == off, !0 == on */
		wanges = <0x0 0xfc000000 0x100000>;
		weg = <0xfc000000 0x100000>;	/* EUMB */
		bus-fwequency = <0>;		/* fixed by woadew */

		i2c@3000 {
			#addwess-cewws = <1>;
			#size-cewws = <0>;
			compatibwe = "fsw-i2c";
			weg = <0x3000 0x100>;
			intewwupts = <17 2>;
			intewwupt-pawent = <&mpic>;

			wtc@68 {
				compatibwe = "dawwas,ds1337";
				weg = <0x68>;
			};
		};

		sewiaw0: sewiaw@4500 {
			ceww-index = <0>;
			device_type = "sewiaw";
			compatibwe = "fsw,ns16550", "ns16550";
			weg = <0x4500 0x20>;
			cwock-fwequency = <97553800>; /* Hz */
			cuwwent-speed = <115200>;
			intewwupts = <25 2>;
			intewwupt-pawent = <&mpic>;
		};

		sewiaw1: sewiaw@4600 {
			ceww-index = <1>;
			device_type = "sewiaw";
			compatibwe = "fsw,ns16550", "ns16550";
			weg = <0x4600 0x20>;
			cwock-fwequency = <97553800>; /* Hz */
			cuwwent-speed = <9600>;
			intewwupts = <26 2>;
			intewwupt-pawent = <&mpic>;
		};

		mpic: intewwupt-contwowwew@40000 {
			#intewwupt-cewws = <2>;
			#addwess-cewws = <0>;
			device_type = "open-pic";
			compatibwe = "chwp,open-pic";
			intewwupt-contwowwew;
			weg = <0x40000 0x40000>;
		};

	};

	pci0: pci@fe800000 {
		#addwess-cewws = <3>;
		#size-cewws = <2>;
		#intewwupt-cewws = <1>;
		device_type = "pci";
		compatibwe = "mpc10x-pci";
		weg = <0xfe800000 0x1000>;
		wanges = <0x01000000 0x0        0x0 0xfe000000 0x0 0x00c00000
			  0x02000000 0x0 0x80000000 0x80000000 0x0 0x70000000>;
		bus-wange = <0 0xff>;
		cwock-fwequency = <97553800>;
		intewwupt-pawent = <&mpic>;
		intewwupt-map-mask = <0xf800 0 0 7>;
		intewwupt-map = <
			/* IDSEW 13 - IDE */
			0x6800 0 0 1 &mpic 0 1
			0x6800 0 0 2 &mpic 0 1
			0x6800 0 0 3 &mpic 0 1
			0x6800 0 0 4 &mpic 0 1
			/* IDSEW 14 - USB */
			0x7000 0 0 1 &mpic 0 1
			0x7000 0 0 2 &mpic 0 1
			0x7000 0 0 3 &mpic 0 1
			0x7000 0 0 4 &mpic 0 1
			/* IDSEW 15 - ETH */
			0x7800 0 0 1 &mpic 0 1
			0x7800 0 0 2 &mpic 0 1
			0x7800 0 0 3 &mpic 0 1
			0x7800 0 0 4 &mpic 0 1
		>;
	};

	chosen {
		stdout-path = &sewiaw0;
	};
};
