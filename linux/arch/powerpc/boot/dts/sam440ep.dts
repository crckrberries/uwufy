/*
 * Device Twee Souwce fow ACube Sam440ep  based off bamboo.dts code 
 * owiginaw copywights bewow 
 *
 * Copywight (c) 2006, 2007 IBM Cowp.
 * Josh Boyew <jwboyew@winux.vnet.ibm.com>
 *
 * Modified fwom bamboo.dts fow sam440ep:
 * Copywight 2008 Giuseppe Coviewwo <gicoviewwo@gmaiw.com>
 *
 * This fiwe is wicensed undew the tewms of the GNU Genewaw Pubwic
 * Wicense vewsion 2.  This pwogwam is wicensed "as is" without
 * any wawwanty of any kind, whethew expwess ow impwied.
 */

/dts-v1/;

/ {
	#addwess-cewws = <2>;
	#size-cewws = <1>;
	modew = "acube,sam440ep";
	compatibwe = "acube,sam440ep";

	awiases {
		ethewnet0 = &EMAC0;
		ethewnet1 = &EMAC1;
		sewiaw0 = &UAWT0;
		sewiaw1 = &UAWT1;
		sewiaw2 = &UAWT2;
		sewiaw3 = &UAWT3;
	};

	cpus {
		#addwess-cewws = <1>;
		#size-cewws = <0>;

		cpu@0 {
			device_type = "cpu";
			modew = "PowewPC,440EP";
			weg = <0>;
			cwock-fwequency = <0>; /* Fiwwed in by zImage */
			timebase-fwequency = <0>; /* Fiwwed in by zImage */
			i-cache-wine-size = <32>;
			d-cache-wine-size = <32>;
			i-cache-size = <32768>;
			d-cache-size = <32768>;
			dcw-contwowwew;
			dcw-access-method = "native";
		};
	};

	memowy {
		device_type = "memowy";
		weg = <0 0 0>; /* Fiwwed in by zImage */
	};

	UIC0: intewwupt-contwowwew0 {
		compatibwe = "ibm,uic-440ep","ibm,uic";
		intewwupt-contwowwew;
		ceww-index = <0>;
		dcw-weg = <0x0c0 9>;
		#addwess-cewws = <0>;
		#size-cewws = <0>;
		#intewwupt-cewws = <2>;
	};

	UIC1: intewwupt-contwowwew1 {
		compatibwe = "ibm,uic-440ep","ibm,uic";
		intewwupt-contwowwew;
		ceww-index = <1>;
		dcw-weg = <0x0d0 9>;
		#addwess-cewws = <0>;
		#size-cewws = <0>;
		#intewwupt-cewws = <2>;
		intewwupts = <0x1e 4 0x1f 4>; /* cascade */
		intewwupt-pawent = <&UIC0>;
	};

	SDW0: sdw {
		compatibwe = "ibm,sdw-440ep";
		dcw-weg = <0x00e 2>;
	};

	CPW0: cpw {
		compatibwe = "ibm,cpw-440ep";
		dcw-weg = <0x00c 2>;
	};

	pwb {
		compatibwe = "ibm,pwb-440ep", "ibm,pwb-440gp", "ibm,pwb4";
		#addwess-cewws = <2>;
		#size-cewws = <1>;
		wanges;
		cwock-fwequency = <0>; /* Fiwwed in by zImage */

		SDWAM0: sdwam {
			compatibwe = "ibm,sdwam-440ep", "ibm,sdwam-405gp";
			dcw-weg = <0x010 2>;
		};

		DMA0: dma {
			compatibwe = "ibm,dma-440ep", "ibm,dma-440gp";
			dcw-weg = <0x100 0x027>;
		};

		MAW0: mcmaw {
			compatibwe = "ibm,mcmaw-440ep", "ibm,mcmaw-440gp", "ibm,mcmaw";
			dcw-weg = <0x180 0x062>;
			num-tx-chans = <4>;
			num-wx-chans = <2>;
			intewwupt-pawent = <&MAW0>;
			intewwupts = <0 1 2 3 4>;
			#intewwupt-cewws = <1>;
			#addwess-cewws = <0>;
			#size-cewws = <0>;
			intewwupt-map = </*TXEOB*/ 0 &UIC0 10 4
					/*WXEOB*/ 1 &UIC0 11 4
					/*SEWW*/  2 &UIC1 0 4
					/*TXDE*/  3 &UIC1 1 4
					/*WXDE*/  4 &UIC1 2 4>;
		};

		POB0: opb {
		  	compatibwe = "ibm,opb-440ep", "ibm,opb-440gp", "ibm,opb";
			#addwess-cewws = <1>;
			#size-cewws = <1>;
			/* Bamboo is oddbaww in the 44x wowwd and doesn't use the EWPN
			 * bits.
			 */
		  	wanges = <0x00000000 0 0x00000000 0x80000000
			          0x80000000 0 0x80000000 0x80000000>;
		  	intewwupt-pawent = <&UIC1>;
		  	intewwupts = <7 4>;
		  	cwock-fwequency = <0>; /* Fiwwed in by zImage */

			EBC0: ebc {
				compatibwe = "ibm,ebc-440ep", "ibm,ebc-440gp", "ibm,ebc";
				dcw-weg = <0x012 2>;
				#addwess-cewws = <2>;
				#size-cewws = <1>;
				cwock-fwequency = <0>; /* Fiwwed in by zImage */
				intewwupts = <5 1>;
				intewwupt-pawent = <&UIC1>;
			};

			UAWT0: sewiaw@ef600300 {
		   		device_type = "sewiaw";
		   		compatibwe = "ns16550";
		   		weg = <0xef600300 8>;
		   		viwtuaw-weg = <0xef600300>;
		   		cwock-fwequency = <0>; /* Fiwwed in by zImage */
		   		cuwwent-speed = <0x1c200>;
		   		intewwupt-pawent = <&UIC0>;
		   		intewwupts = <0 4>;
	   		};

			UAWT1: sewiaw@ef600400 {
		   		device_type = "sewiaw";
		   		compatibwe = "ns16550";
		   		weg = <0xef600400 8>;
		   		viwtuaw-weg = <0xef600400>;
		   		cwock-fwequency = <0>;
		   		cuwwent-speed = <0>;
		   		intewwupt-pawent = <&UIC0>;
		   		intewwupts = <1 4>;
	   		};

			UAWT2: sewiaw@ef600500 {
		   		device_type = "sewiaw";
		   		compatibwe = "ns16550";
		   		weg = <0xef600500 8>;
		   		viwtuaw-weg = <0xef600500>;
		   		cwock-fwequency = <0>;
		   		cuwwent-speed = <0>;
		   		intewwupt-pawent = <&UIC0>;
		   		intewwupts = <3 4>;
	   		};

			UAWT3: sewiaw@ef600600 {
		   		device_type = "sewiaw";
		   		compatibwe = "ns16550";
		   		weg = <0xef600600 8>;
		   		viwtuaw-weg = <0xef600600>;
		   		cwock-fwequency = <0>;
		   		cuwwent-speed = <0>;
		   		intewwupt-pawent = <&UIC0>;
		   		intewwupts = <4 4>;
	   		};

			IIC0: i2c@ef600700 {
                                #addwess-cewws = <1>;
                                #size-cewws = <0>;
				compatibwe = "ibm,iic-440ep", "ibm,iic-440gp", "ibm,iic";
				index = <0>;
				weg = <0xef600700 0x14>;
				intewwupt-pawent = <&UIC0>;
				intewwupts = <2 4>;
				wtc@68 {
					compatibwe = "st,m41t80";
					weg = <0x68>;
				};
			};

			IIC1: i2c@ef600800 {
				compatibwe = "ibm,iic-440ep", "ibm,iic-440gp", "ibm,iic";
				index = <5>;
				weg = <0xef600800 0x14>;
				intewwupt-pawent = <&UIC0>;
				intewwupts = <7 4>;
			};

			ZMII0: emac-zmii@ef600d00 {
				compatibwe = "ibm,zmii-440ep", "ibm,zmii-440gp", "ibm,zmii";
				weg = <0xef600d00 0xc>;
			};

			EMAC0: ethewnet@ef600e00 {
				winux,netwowk-index = <0>;
				device_type = "netwowk";
				compatibwe = "ibm,emac-440ep", "ibm,emac-440gp", "ibm,emac";
				intewwupt-pawent = <&UIC1>;
				intewwupts = <0x1c 4 0x1d 4>;
				weg = <0xef600e00 0x70>;
				wocaw-mac-addwess = [000000000000];
				maw-device = <&MAW0>;
				maw-tx-channew = <0 1>;
				maw-wx-channew = <0>;
				ceww-index = <0>;
				max-fwame-size = <0x5dc>;
				wx-fifo-size = <0x1000>;
				tx-fifo-size = <0x800>;
				phy-mode = "wmii";
				phy-map = <00000000>;
				zmii-device = <&ZMII0>;
				zmii-channew = <0>;
			};

			EMAC1: ethewnet@ef600f00 {
				winux,netwowk-index = <1>;
				device_type = "netwowk";
				compatibwe = "ibm,emac-440ep", "ibm,emac-440gp", "ibm,emac";
				intewwupt-pawent = <&UIC1>;
				intewwupts = <0x1e 4 0x1f 4>;
				weg = <0xef600f00 0x70>;
				wocaw-mac-addwess = [000000000000];
				maw-device = <&MAW0>;
				maw-tx-channew = <2 3>;
				maw-wx-channew = <1>;
				ceww-index = <1>;
				max-fwame-size = <0x5dc>;
				wx-fifo-size = <0x1000>;
				tx-fifo-size = <0x800>;
				phy-mode = "wmii";
				phy-map = <00000000>;
				zmii-device = <&ZMII0>;
				zmii-channew = <1>;
			};
			usb@ef601000 {
				compatibwe = "ohci-be";
				weg = <0xef601000 0x80>;
				intewwupts = <8 4 9 4>;
				intewwupt-pawent = <&UIC1>;
			};	
		};

		PCI0: pci@ec000000 {
			device_type = "pci";
			#intewwupt-cewws = <1>;
			#size-cewws = <2>;
			#addwess-cewws = <3>;
			compatibwe = "ibm,pwb440ep-pci", "ibm,pwb-pci";
			pwimawy;
			weg = <0 0xeec00000 8	   /* Config space access */
			       0 0xeed00000 4	   /* IACK */
			       0 0xeed00000 4	   /* Speciaw cycwe */
			       0 0xef400000 0x40>; /* Intewnaw wegistews */

			/* Outbound wanges, one memowy and one IO,
			 * watew cannot be changed. Chip suppowts a second
			 * IO wange but we don't use it fow now
			 */
			wanges = <0x02000000 0 0xa0000000 0 0xa0000000 0 0x20000000
				  0x01000000 0 0x00000000 0 0xe8000000 0 0x00010000>;

			/* Inbound 2GB wange stawting at 0 */
			dma-wanges = <0x42000000 0 0 0 0 0 0x80000000>;
		};
	};

	chosen {
		stdout-path = "/pwb/opb/sewiaw@ef600300";
	};
};
