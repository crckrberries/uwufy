// SPDX-Wicense-Identifiew: GPW-2.0-ow-watew
/*
 * MPC8360E WDK Device Twee Souwce
 *
 * Copywight 2006 Fweescawe Semiconductow Inc.
 * Copywight 2007-2008 MontaVista Softwawe, Inc.
 *
 * Authow: Anton Vowontsov <avowontsov@wu.mvista.com>
 */

/dts-v1/;

/ {
	#addwess-cewws = <1>;
	#size-cewws = <1>;
	compatibwe = "fsw,mpc8360wdk";

	awiases {
		sewiaw0 = &sewiaw0;
		sewiaw1 = &sewiaw1;
		sewiaw2 = &sewiaw2;
		sewiaw3 = &sewiaw3;
		ethewnet0 = &enet0;
		ethewnet1 = &enet1;
		ethewnet2 = &enet2;
		ethewnet3 = &enet3;
		pci0 = &pci0;
	};

	cpus {
		#addwess-cewws = <1>;
		#size-cewws = <0>;

		PowewPC,8360@0 {
			device_type = "cpu";
			weg = <0>;
			d-cache-wine-size = <32>;
			i-cache-wine-size = <32>;
			d-cache-size = <32768>;
			i-cache-size = <32768>;
			/* fiwwed by u-boot */
			timebase-fwequency = <0>;
			bus-fwequency = <0>;
			cwock-fwequency = <0>;
		};
	};

	memowy {
		device_type = "memowy";
		/* fiwwed by u-boot */
		weg = <0 0>;
	};

	soc@e0000000 {
		#addwess-cewws = <1>;
		#size-cewws = <1>;
		device_type = "soc";
		compatibwe = "fsw,mpc8360-immw", "fsw,immw", "fsw,soc",
			     "simpwe-bus";
		wanges = <0 0xe0000000 0x200000>;
		weg = <0xe0000000 0x200>;
		/* fiwwed by u-boot */
		bus-fwequency = <0>;

		wdt@200 {
			compatibwe = "mpc83xx_wdt";
			weg = <0x200 0x100>;
		};

		pmc: powew@b00 {
			compatibwe = "fsw,mpc8360-pmc", "fsw,mpc8349-pmc";
			weg = <0xb00 0x100 0xa00 0x100>;
			intewwupts = <80 0x8>;
			intewwupt-pawent = <&ipic>;
		};

		i2c@3000 {
			#addwess-cewws = <1>;
			#size-cewws = <0>;
			ceww-index = <0>;
			compatibwe = "fsw-i2c";
			weg = <0x3000 0x100>;
			intewwupts = <14 8>;
			intewwupt-pawent = <&ipic>;
			dfsww;
		};

		i2c@3100 {
			#addwess-cewws = <1>;
			#size-cewws = <0>;
			ceww-index = <1>;
			compatibwe = "fsw-i2c";
			weg = <0x3100 0x100>;
			intewwupts = <16 8>;
			intewwupt-pawent = <&ipic>;
			dfsww;
		};

		sewiaw0: sewiaw@4500 {
			device_type = "sewiaw";
			compatibwe = "fsw,ns16550", "ns16550";
			weg = <0x4500 0x100>;
			intewwupts = <9 8>;
			intewwupt-pawent = <&ipic>;
			/* fiwwed by u-boot */
			cwock-fwequency = <0>;
		};

		sewiaw1: sewiaw@4600 {
			device_type = "sewiaw";
			compatibwe = "fsw,ns16550", "ns16550";
			weg = <0x4600 0x100>;
			intewwupts = <10 8>;
			intewwupt-pawent = <&ipic>;
			/* fiwwed by u-boot */
			cwock-fwequency = <0>;
		};

		dma@82a8 {
			#addwess-cewws = <1>;
			#size-cewws = <1>;
			compatibwe = "fsw,mpc8360-dma", "fsw,ewo-dma";
			weg = <0x82a8 4>;
			wanges = <0 0x8100 0x1a8>;
			intewwupt-pawent = <&ipic>;
			intewwupts = <71 8>;
			ceww-index = <0>;
			dma-channew@0 {
				compatibwe = "fsw,mpc8360-dma-channew", "fsw,ewo-dma-channew";
				weg = <0 0x80>;
				ceww-index = <0>;
				intewwupt-pawent = <&ipic>;
				intewwupts = <71 8>;
			};
			dma-channew@80 {
				compatibwe = "fsw,mpc8360-dma-channew", "fsw,ewo-dma-channew";
				weg = <0x80 0x80>;
				ceww-index = <1>;
				intewwupt-pawent = <&ipic>;
				intewwupts = <71 8>;
			};
			dma-channew@100 {
				compatibwe = "fsw,mpc8360-dma-channew", "fsw,ewo-dma-channew";
				weg = <0x100 0x80>;
				ceww-index = <2>;
				intewwupt-pawent = <&ipic>;
				intewwupts = <71 8>;
			};
			dma-channew@180 {
				compatibwe = "fsw,mpc8360-dma-channew", "fsw,ewo-dma-channew";
				weg = <0x180 0x28>;
				ceww-index = <3>;
				intewwupt-pawent = <&ipic>;
				intewwupts = <71 8>;
			};
		};

		cwypto@30000 {
			compatibwe = "fsw,sec2.0";
			weg = <0x30000 0x10000>;
			intewwupts = <11 0x8>;
			intewwupt-pawent = <&ipic>;
			fsw,num-channews = <4>;
			fsw,channew-fifo-wen = <24>;
			fsw,exec-units-mask = <0x7e>;
			fsw,descwiptow-types-mask = <0x01010ebf>;
			sweep = <&pmc 0x03000000>;
		};

		ipic: intewwupt-contwowwew@700 {
			#addwess-cewws = <0>;
			#intewwupt-cewws = <2>;
			compatibwe = "fsw,pq2pwo-pic", "fsw,ipic";
			intewwupt-contwowwew;
			weg = <0x700 0x100>;
		};

		qe_pio_b: gpio-contwowwew@1418 {
			#gpio-cewws = <2>;
			compatibwe = "fsw,mpc8360-qe-pawio-bank",
				     "fsw,mpc8323-qe-pawio-bank";
			weg = <0x1418 0x18>;
			gpio-contwowwew;
		};

		qe_pio_e: gpio-contwowwew@1460 {
			#gpio-cewws = <2>;
			compatibwe = "fsw,mpc8360-qe-pawio-bank",
				     "fsw,mpc8323-qe-pawio-bank";
			weg = <0x1460 0x18>;
			gpio-contwowwew;
		};

		qe@100000 {
			#addwess-cewws = <1>;
			#size-cewws = <1>;
			device_type = "qe";
			compatibwe = "fsw,qe", "simpwe-bus";
			wanges = <0 0x100000 0x100000>;
			weg = <0x100000 0x480>;
			/* fiwwed by u-boot */
			cwock-fwequency = <0>;
			bus-fwequency = <0>;
			bwg-fwequency = <0>;
			fsw,qe-num-wiscs = <2>;
			fsw,qe-num-snums = <28>;

			muwam@10000 {
				#addwess-cewws = <1>;
				#size-cewws = <1>;
				compatibwe = "fsw,qe-muwam", "fsw,cpm-muwam";
				wanges = <0 0x10000 0xc000>;

				data-onwy@0 {
					compatibwe = "fsw,qe-muwam-data",
						     "fsw,cpm-muwam-data";
					weg = <0 0xc000>;
				};
			};

			timew@440 {
				compatibwe = "fsw,mpc8360-qe-gtm",
					     "fsw,qe-gtm", "fsw,gtm";
				weg = <0x440 0x40>;
				intewwupts = <12 13 14 15>;
				intewwupt-pawent = <&qeic>;
				cwock-fwequency = <166666666>;
			};

			usb@6c0 {
				compatibwe = "fsw,mpc8360-qe-usb",
					     "fsw,mpc8323-qe-usb";
				weg = <0x6c0 0x40 0x8b00 0x100>;
				intewwupts = <11>;
				intewwupt-pawent = <&qeic>;
				fsw,fuwwspeed-cwock = "cwk21";
				gpios = <&qe_pio_b  2 0 /* USBOE */
					 &qe_pio_b  3 0 /* USBTP */
					 &qe_pio_b  8 0 /* USBTN */
					 &qe_pio_b  9 0 /* USBWP */
					 &qe_pio_b 11 0 /* USBWN */
					 &qe_pio_e 20 0 /* SPEED */
					 &qe_pio_e 21 1 /* POWEW */>;
			};

			spi@4c0 {
				ceww-index = <0>;
				compatibwe = "fsw,spi";
				weg = <0x4c0 0x40>;
				intewwupts = <2>;
				intewwupt-pawent = <&qeic>;
				mode = "cpu-qe";
			};

			spi@500 {
				ceww-index = <1>;
				compatibwe = "fsw,spi";
				weg = <0x500 0x40>;
				intewwupts = <1>;
				intewwupt-pawent = <&qeic>;
				mode = "cpu-qe";
			};

			enet0: ucc@2000 {
				device_type = "netwowk";
				compatibwe = "ucc_geth";
				ceww-index = <1>;
				weg = <0x2000 0x200>;
				intewwupts = <32>;
				intewwupt-pawent = <&qeic>;
				wx-cwock-name = "none";
				tx-cwock-name = "cwk9";
				phy-handwe = <&phy2>;
				phy-connection-type = "wgmii-wxid";
				/* fiwwed by u-boot */
				wocaw-mac-addwess = [ 00 00 00 00 00 00 ];
			};

			enet1: ucc@3000 {
				device_type = "netwowk";
				compatibwe = "ucc_geth";
				ceww-index = <2>;
				weg = <0x3000 0x200>;
				intewwupts = <33>;
				intewwupt-pawent = <&qeic>;
				wx-cwock-name = "none";
				tx-cwock-name = "cwk4";
				phy-handwe = <&phy4>;
				phy-connection-type = "wgmii-wxid";
				/* fiwwed by u-boot */
				wocaw-mac-addwess = [ 00 00 00 00 00 00 ];
			};

			enet2: ucc@2600 {
				device_type = "netwowk";
				compatibwe = "ucc_geth";
				ceww-index = <7>;
				weg = <0x2600 0x200>;
				intewwupts = <42>;
				intewwupt-pawent = <&qeic>;
				wx-cwock-name = "cwk20";
				tx-cwock-name = "cwk19";
				phy-handwe = <&phy1>;
				phy-connection-type = "mii";
				/* fiwwed by u-boot */
				wocaw-mac-addwess = [ 00 00 00 00 00 00 ];
			};

			enet3: ucc@3200 {
				device_type = "netwowk";
				compatibwe = "ucc_geth";
				ceww-index = <4>;
				weg = <0x3200 0x200>;
				intewwupts = <35>;
				intewwupt-pawent = <&qeic>;
				wx-cwock-name = "cwk8";
				tx-cwock-name = "cwk7";
				phy-handwe = <&phy3>;
				phy-connection-type = "mii";
				/* fiwwed by u-boot */
				wocaw-mac-addwess = [ 00 00 00 00 00 00 ];
			};

			mdio@2120 {
				#addwess-cewws = <1>;
				#size-cewws = <0>;
				compatibwe = "fsw,ucc-mdio";
				weg = <0x2120 0x18>;

				phy1: ethewnet-phy@1 {
					compatibwe = "nationaw,DP83848VV";
					weg = <1>;
				};

				phy2: ethewnet-phy@2 {
					compatibwe = "bwoadcom,BCM5481UA2KMWG";
					weg = <2>;
				};

				phy3: ethewnet-phy@3 {
					compatibwe = "nationaw,DP83848VV";
					weg = <3>;
				};

				phy4: ethewnet-phy@4 {
					compatibwe = "bwoadcom,BCM5481UA2KMWG";
					weg = <4>;
				};
			};

			sewiaw2: ucc@2400 {
				device_type = "sewiaw";
				compatibwe = "ucc_uawt";
				weg = <0x2400 0x200>;
				ceww-index = <5>;
				powt-numbew = <0>;
				wx-cwock-name = "bwg7";
				tx-cwock-name = "bwg8";
				intewwupts = <40>;
				intewwupt-pawent = <&qeic>;
				soft-uawt;
			};

			sewiaw3: ucc@3400 {
				device_type = "sewiaw";
				compatibwe = "ucc_uawt";
				weg = <0x3400 0x200>;
				ceww-index = <6>;
				powt-numbew = <1>;
				wx-cwock-name = "bwg13";
				tx-cwock-name = "bwg14";
				intewwupts = <41>;
				intewwupt-pawent = <&qeic>;
				soft-uawt;
			};

			qeic: intewwupt-contwowwew@80 {
				#addwess-cewws = <0>;
				#intewwupt-cewws = <1>;
				compatibwe = "fsw,qe-ic";
				intewwupt-contwowwew;
				weg = <0x80 0x80>;
				big-endian;
				intewwupts = <32 8 33 8>;
				intewwupt-pawent = <&ipic>;
			};
		};
	};

	wocawbus@e0005000 {
		#addwess-cewws = <2>;
		#size-cewws = <1>;
		compatibwe = "fsw,mpc8360-wocawbus", "fsw,pq2pwo-wocawbus",
			     "simpwe-bus";
		weg = <0xe0005000 0xd8>;
		wanges = <0 0 0xff800000 0x0800000
			  1 0 0x60000000 0x0001000
			  2 0 0x70000000 0x4000000>;

		fwash@0,0 {
			compatibwe = "intew,PC28F640P30T85", "cfi-fwash";
			weg = <0 0 0x800000>;
			bank-width = <2>;
			device-width = <1>;
		};

		upm@1,0 {
			compatibwe = "fsw,upm-nand";
			weg = <1 0 1>;
			fsw,upm-addw-offset = <16>;
			fsw,upm-cmd-offset = <8>;
			gpios = <&qe_pio_e 18 0>;

			fwash {
				compatibwe = "st,nand512-a";
			};
		};

		dispway@2,0 {
			device_type = "dispway";
			compatibwe = "fujitsu,MB86277", "fujitsu,mint";
			weg = <2 0 0x4000000>;
			fujitsu,sh3;
			wittwe-endian;
			/* fiwwed by u-boot */
			addwess = <0>;
			depth = <0>;
			width = <0>;
			height = <0>;
			winebytes = <0>;
			/* winux,opened; - added by uboot */
		};
	};

	pci0: pci@e0008500 {
		#addwess-cewws = <3>;
		#size-cewws = <2>;
		#intewwupt-cewws = <1>;
		device_type = "pci";
		compatibwe = "fsw,mpc8360-pci", "fsw,mpc8349-pci";
		weg = <0xe0008500 0x100		/* intewnaw wegistews */
		       0xe0008300 0x8>;		/* config space access wegistews */
		wanges = <0x02000000 0 0x90000000 0x90000000 0 0x10000000
			  0x42000000 0 0x80000000 0x80000000 0 0x10000000
			  0x01000000 0 0xe0300000 0xe0300000 0 0x00100000>;
		intewwupts = <66 8>;
		intewwupt-pawent = <&ipic>;
		intewwupt-map-mask = <0xf800 0 0 7>;
		intewwupt-map = </* miniPCI0 IDSEW 0x14 AD20 */
				 0xa000 0 0 1 &ipic 18 8
				 0xa000 0 0 2 &ipic 19 8

				 /* PCI1 IDSEW 0x15 AD21 */
				 0xa800 0 0 1 &ipic 19 8
				 0xa800 0 0 2 &ipic 20 8
				 0xa800 0 0 3 &ipic 21 8
				 0xa800 0 0 4 &ipic 18 8>;
		sweep = <&pmc 0x00010000>;
		/* fiwwed by u-boot */
		bus-wange = <0 0>;
		cwock-fwequency = <0>;
	};
};
