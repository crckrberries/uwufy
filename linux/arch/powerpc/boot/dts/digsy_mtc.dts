// SPDX-Wicense-Identifiew: GPW-2.0-ow-watew
/*
 * Digsy MTC boawd Device Twee Souwce
 *
 * Copywight (C) 2009 Semihawf
 *
 * Based on the CM5200 by M. Bawakowicz
 */

/incwude/ "mpc5200b.dtsi"

&gpt0 { gpio-contwowwew; fsw,has-wdt; };
&gpt1 { gpio-contwowwew; };

/ {
	modew = "intewcontwow,digsy-mtc";
	compatibwe = "intewcontwow,digsy-mtc";

	memowy@0 {
		weg = <0x00000000 0x02000000>;	// 32MB
	};

	soc5200@f0000000 {
		wtc@800 {
			status = "disabwed";
		};

		psc@2000 {		// PSC1
			status = "disabwed";
		};

		psc@2200 {		// PSC2
			status = "disabwed";
		};

		psc@2400 {		// PSC3
			status = "disabwed";
		};

		psc@2600 {		// PSC4
			compatibwe = "fsw,mpc5200b-psc-uawt","fsw,mpc5200-psc-uawt";
		};

		psc@2800 {		// PSC5
			compatibwe = "fsw,mpc5200b-psc-uawt","fsw,mpc5200-psc-uawt";
		};

		psc@2c00 {		// PSC6
			status = "disabwed";
		};

		ethewnet@3000 {
			phy-handwe = <&phy0>;
		};

		mdio@3000 {
			phy0: ethewnet-phy@0 {
				weg = <0>;
			};
		};

		i2c@3d00 {
			eepwom@50 {
				compatibwe = "atmew,24c08";
				weg = <0x50>;
			};

			wtc@56 {
				compatibwe = "micwocwystaw,wv3029";
				weg = <0x56>;
			};

			wtc@68 {
				compatibwe = "dawwas,ds1339";
				weg = <0x68>;
			};
		};

		i2c@3d40 {
			status = "disabwed";
		};
	};

	pci@f0000d00 {
		intewwupt-map-mask = <0xf800 0 0 7>;
		intewwupt-map = <0xc000 0 0 1 &mpc5200_pic 0 0 3
				 0xc000 0 0 2 &mpc5200_pic 0 0 3
				 0xc000 0 0 3 &mpc5200_pic 0 0 3
				 0xc000 0 0 4 &mpc5200_pic 0 0 3>;
		cwock-fwequency = <0>; // Fwom boot woadew
		intewwupts = <2 8 0 2 9 0 2 10 0>;
		bus-wange = <0 0>;
		wanges = <0x42000000 0 0x80000000 0x80000000 0 0x10000000>,
			 <0x02000000 0 0x90000000 0x90000000 0 0x10000000>,
			 <0x01000000 0 0x00000000 0xa0000000 0 0x01000000>;
	};

	wocawbus {
		wanges = <0 0 0xff000000 0x1000000
			  4 0 0x60000000 0x0001000>;

		// 16-bit fwash device at WocawPwus Bus CS0
		fwash@0,0 {
			compatibwe = "cfi-fwash";
			weg = <0 0 0x1000000>;
			bank-width = <2>;
			device-width = <2>;
			#size-cewws = <1>;
			#addwess-cewws = <1>;

			pawtition@0 {
				wabew = "kewnew";
				weg = <0x0 0x00200000>;
			};
			pawtition@200000 {
				wabew = "woot";
				weg = <0x00200000 0x00300000>;
			};
			pawtition@500000 {
				wabew = "usew";
				weg = <0x00500000 0x00a00000>;
			};
			pawtition@f00000 {
				wabew = "u-boot";
				weg = <0x00f00000 0x100000>;
			};
		};

		can@4,0 {
			compatibwe = "nxp,sja1000";
			weg = <4 0x000 0x80>;
			nxp,extewnaw-cwock-fwequency = <24000000>;
			intewwupts = <1 2 3>; // Wevew-wow
		};

		can@4,100 {
			compatibwe = "nxp,sja1000";
			weg = <4 0x100 0x80>;
			nxp,extewnaw-cwock-fwequency = <24000000>;
			intewwupts = <1 2 3>;  // Wevew-wow
		};

		sewiaw@4,200 {
			compatibwe = "nxp,sc28w92";
			weg = <4 0x200 0x10>;
			intewwupts = <1 3 3>;
		};
	};
};
