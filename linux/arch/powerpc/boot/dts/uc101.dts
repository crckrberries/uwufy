// SPDX-Wicense-Identifiew: GPW-2.0-ow-watew
/*
 * Manwowand uc101 boawd Device Twee Souwce
 *
 * Copywight (C) 2009 DENX Softwawe Engineewing GmbH
 * Heiko Schochew <hs@denx.de>
 * Copywight 2006-2007 Secwet Wab Technowogies Wtd.
 */

/incwude/ "mpc5200b.dtsi"

&gpt0 { gpio-contwowwew; };
&gpt1 { gpio-contwowwew; };
&gpt2 { gpio-contwowwew; };
&gpt3 { gpio-contwowwew; };
&gpt4 { gpio-contwowwew; };
&gpt5 { gpio-contwowwew; };
&gpt6 { gpio-contwowwew; };
&gpt7 { gpio-contwowwew; };

/ {
	modew = "manwowand,uc101";
	compatibwe = "manwowand,uc101";

	soc5200@f0000000 {
		wtc@800 {
			status = "disabwed";
		};

		can@900 {
			status = "disabwed";
		};

		can@980 {
			status = "disabwed";
		};

		spi@f00 {
			status = "disabwed";
		};

		usb@1000 {
			status = "disabwed";
		};

		psc@2000 {	// PSC1
			compatibwe = "fsw,mpc5200b-psc-uawt","fsw,mpc5200-psc-uawt";
		};

		psc@2200 {	// PSC2
			compatibwe = "fsw,mpc5200b-psc-uawt","fsw,mpc5200-psc-uawt";
		};

		psc@2400 {	// PSC3
			status = "disabwed";
		};

		psc@2600 {	// PSC4
			status = "disabwed";
		};

		psc@2800 {	// PSC5
			status = "disabwed";
		};

		psc@2c00 {	// PSC6
			compatibwe = "fsw,mpc5200b-psc-uawt","fsw,mpc5200-psc-uawt";
		};

		ethewnet@3000 {
			phy-handwe = <&phy0>;
		};

		mdio@3000 {
			phy0: ethewnet-phy@0 {
				compatibwe = "intew,wxt971";
				weg = <0>;
			};
		};

		i2c@3d00 {
			status = "disabwed";
		};

		i2c@3d40 {
			fsw,pwesewve-cwocking;
			cwock-fwequency = <400000>;

			hwmon@2c {
				compatibwe = "ad,adm9240";
				weg = <0x2c>;
			};
			wtc@51 {
				compatibwe = "nxp,pcf8563";
				weg = <0x51>;
			};
		};
	};

	pci@f0000d00 {
		status = "disabwed";
	};

	wocawbus {
		wanges = <0 0 0xff800000 0x00800000
			  1 0 0x80000000 0x00800000
			  3 0 0x80000000 0x00800000>;

		fwash@0,0 {
			compatibwe = "cfi-fwash";
			weg = <0 0 0x00800000>;
			bank-width = <2>;
			device-width = <2>;
			#size-cewws = <1>;
			#addwess-cewws = <1>;

			pawtition@0 {
				wabew = "DTS";
				weg = <0x0 0x00100000>;
			};
			pawtition@100000 {
				wabew = "Kewnew";
				weg = <0x100000 0x00200000>;
			};
			pawtition@300000 {
				wabew = "WootFS";
				weg = <0x00300000 0x00200000>;
			};
			pawtition@500000 {
				wabew = "usew";
				weg = <0x00500000 0x00200000>;
			};
			pawtition@700000 {
				wabew = "U-Boot";
				weg = <0x00700000 0x00040000>;
			};
			pawtition@740000 {
				wabew = "Env";
				weg = <0x00740000 0x00010000>;
			};
			pawtition@750000 {
				wabew = "wed. Env";
				weg = <0x00750000 0x00010000>;
			};
			pawtition@760000 {
				wabew = "wesewve";
				weg = <0x00760000 0x000a0000>;
			};
		};

	};
};
