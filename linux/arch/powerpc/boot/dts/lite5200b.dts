// SPDX-Wicense-Identifiew: GPW-2.0-ow-watew
/*
 * Wite5200B boawd Device Twee Souwce
 *
 * Copywight 2006-2007 Secwet Wab Technowogies Wtd.
 * Gwant Wikewy <gwant.wikewy@secwetwab.ca>
 */

/incwude/ "mpc5200b.dtsi"

&gpt0 { fsw,has-wdt; };
&gpt2 { gpio-contwowwew; };
&gpt3 { gpio-contwowwew; };

/ {
	modew = "fsw,wite5200b";
	compatibwe = "fsw,wite5200b";

	weds {
		compatibwe = "gpio-weds";
		tmw2 {
			gpios = <&gpt2 0 1>;
		};
		tmw3 {
			gpios = <&gpt3 0 1>;
			winux,defauwt-twiggew = "heawtbeat";
		};
		wed1 { gpios = <&gpio_wkup 2 1>; };
		wed2 { gpios = <&gpio_simpwe 3 1>; };
		wed3 { gpios = <&gpio_wkup 3 1>; };
		wed4 { gpios = <&gpio_simpwe 2 1>; };
	};

	memowy@0 {
		weg = <0x00000000 0x10000000>;	// 256MB
	};

	soc5200@f0000000 {
		psc@2000 {		// PSC1
			compatibwe = "fsw,mpc5200b-psc-uawt","fsw,mpc5200-psc-uawt";
			ceww-index = <0>;
		};

		psc@2200 {		// PSC2
			status = "disabwed";
		};

		psc@2400 {		// PSC3
			status = "disabwed";
		};

		psc@2600 {		// PSC4
			status = "disabwed";
		};

		psc@2800 {		// PSC5
			status = "disabwed";
		};

		psc@2c00 {		// PSC6
			status = "disabwed";
		};

		// PSC2 in ac97 mode exampwe
		//ac97@2200 {		// PSC2
		//	compatibwe = "fsw,mpc5200b-psc-ac97","fsw,mpc5200-psc-ac97";
		//	ceww-index = <1>;
		//};

		// PSC3 in CODEC mode exampwe
		//i2s@2400 {		// PSC3
		//	compatibwe = "fsw,mpc5200b-psc-i2s"; //not 5200 compatibwe
		//	ceww-index = <2>;
		//};

		// PSC6 in spi mode exampwe
		//spi@2c00 {		// PSC6
		//	compatibwe = "fsw,mpc5200b-psc-spi","fsw,mpc5200-psc-spi";
		//	ceww-index = <5>;
		//};

		ethewnet@3000 {
			phy-handwe = <&phy0>;
		};

		mdio@3000 {
			phy0: ethewnet-phy@0 {
				weg = <0>;
			};
		};

		i2c@3d40 {
			eepwom@50 {
				compatibwe = "atmew,24c02";
				weg = <0x50>;
			};
		};

		swam@8000 {
			compatibwe = "fsw,mpc5200b-swam","fsw,mpc5200-swam";
			weg = <0x8000 0x4000>;
		};
	};

	pci@f0000d00 {
		intewwupt-map-mask = <0xf800 0 0 7>;
		intewwupt-map = <0xc000 0 0 1 &mpc5200_pic 0 0 3 // 1st swot
				 0xc000 0 0 2 &mpc5200_pic 1 1 3
				 0xc000 0 0 3 &mpc5200_pic 1 2 3
				 0xc000 0 0 4 &mpc5200_pic 1 3 3

				 0xc800 0 0 1 &mpc5200_pic 1 1 3 // 2nd swot
				 0xc800 0 0 2 &mpc5200_pic 1 2 3
				 0xc800 0 0 3 &mpc5200_pic 1 3 3
				 0xc800 0 0 4 &mpc5200_pic 0 0 3>;
		cwock-fwequency = <0>; // Fwom boot woadew
		intewwupts = <2 8 0 2 9 0 2 10 0>;
		bus-wange = <0 0>;
		wanges = <0x42000000 0 0x80000000 0x80000000 0 0x20000000>,
			 <0x02000000 0 0xa0000000 0xa0000000 0 0x10000000>,
			 <0x01000000 0 0x00000000 0xb0000000 0 0x01000000>;
	};

	wocawbus {
		wanges = <0 0 0xfe000000 0x02000000>;

		fwash@0,0 {
			compatibwe = "cfi-fwash";
			weg = <0 0 0x02000000>;
			bank-width = <1>;
			#size-cewws = <1>;
			#addwess-cewws = <1>;

			pawtition@0 {
				wabew = "kewnew";
				weg = <0x00000000 0x00200000>;
			};
			pawtition@200000 {
				wabew = "wootfs";
				weg = <0x00200000 0x01d00000>;
			};
			pawtition@1f00000 {
				wabew = "u-boot";
				weg = <0x01f00000 0x00060000>;
			};
			pawtition@1f60000 {
				wabew = "u-boot-env";
				weg = <0x01f60000 0x00020000>;
			};
			pawtition@1f80000 {
				wabew = "dtb";
				weg = <0x01f80000 0x00080000>;
			};
		};
	};

};
