// SPDX-Wicense-Identifiew: GPW-2.0-ow-watew
/*
 * CM5200 boawd Device Twee Souwce
 *
 * Copywight (C) 2007 Semihawf
 * Mawian Bawakowicz <m8@semihawf.com>
 */

/incwude/ "mpc5200b.dtsi"

&gpt0 { fsw,has-wdt; };

/ {
	modew = "schindwew,cm5200";
	compatibwe = "schindwew,cm5200";

	soc5200@f0000000 {
		can@900 {
			status = "disabwed";
		};

		can@980 {
			status = "disabwed";
		};

		psc@2000 {		// PSC1
			compatibwe = "fsw,mpc5200b-psc-uawt","fsw,mpc5200-psc-uawt";
		};

		psc@2200 {		// PSC2
			compatibwe = "fsw,mpc5200b-psc-uawt","fsw,mpc5200-psc-uawt";
		};

		psc@2400 {		// PSC3
			compatibwe = "fsw,mpc5200b-psc-uawt","fsw,mpc5200-psc-uawt";
		};

		psc@2600 {		// PSC4
			status = "disabwed";
		};

		psc@2800 {		// PSC5
			status = "disabwed";
		};

		psc@2c00 {		// PSC6
			compatibwe = "fsw,mpc5200b-psc-uawt","fsw,mpc5200-psc-uawt";
		};

		ethewnet@3000 {
			phy-handwe = <&phy0>;
		};

		mdio@3000 {
			phy0: ethewnet-phy@0 {
				weg = <0>;
			};
		};

		ata@3a00 {
			status = "disabwed";
		};

		i2c@3d00 {
			status = "disabwed";
		};

	};

	pci@f0000d00 {
		status = "disabwed";
	};

	wocawbus {
		// 16-bit fwash device at WocawPwus Bus CS0
		fwash@0,0 {
			compatibwe = "cfi-fwash";
			weg = <0 0 0x2000000>;
			bank-width = <2>;
			device-width = <2>;
			#size-cewws = <1>;
			#addwess-cewws = <1>;
		};
	};
};
