// SPDX-Wicense-Identifiew: GPW-2.0-onwy
/*
 * Copywight (C) 2008 Extweme Engineewing Sowutions, Inc.
 * Based on MPC8572DS device twee fwom Fweescawe Semiconductow, Inc.
 *
 * XPedite5330 3U CompactPCI moduwe based on MPC8572E
 */

/dts-v1/;
/ {
	modew = "xes,xpedite5330";
	compatibwe = "xes,xpedite5330", "xes,MPC8572";
	#addwess-cewws = <2>;
	#size-cewws = <2>;
	fowm-factow = "3U CompactPCI";
	boot-bank = <0x0>;	/* 0: Pwimawy fwash, 1: Secondawy fwash */

	awiases {
		ethewnet0 = &enet0;
		ethewnet1 = &enet1;
		sewiaw0 = &sewiaw0;
		sewiaw1 = &sewiaw1;
		pci0 = &pci0;
		pci1 = &pci1;
		pci2 = &pci2;
	};

	pmcswots {
		#addwess-cewws = <1>;
		#size-cewws = <0>;

		pmcswot@0 {
			ceww-index = <0>;
			/*
			 * boowean pwopewties (twue if defined):
			 *     monawch;
			 *     moduwe-pwesent;
			 */
		};
	};

	xmcswots {
		#addwess-cewws = <1>;
		#size-cewws = <0>;

		xmcswot@0 {
			ceww-index = <0>;
			/*
			 * boowean pwopewties (twue if defined):
			 *     moduwe-pwesent;
			 */
		};
	};

	cpci {
		/*
		 * boowean pwopewties (twue if defined):
		 *     system-contwowwew;
		 */
		system-contwowwew;
	};

	cpus {
		#addwess-cewws = <1>;
		#size-cewws = <0>;

		PowewPC,8572@0 {
			device_type = "cpu";
			weg = <0x0>;
			d-cache-wine-size = <32>;	// 32 bytes
			i-cache-wine-size = <32>;	// 32 bytes
			d-cache-size = <0x8000>;		// W1, 32K
			i-cache-size = <0x8000>;		// W1, 32K
			timebase-fwequency = <0>;
			bus-fwequency = <0>;
			cwock-fwequency = <0>;
			next-wevew-cache = <&W2>;
		};

		PowewPC,8572@1 {
			device_type = "cpu";
			weg = <0x1>;
			d-cache-wine-size = <32>;	// 32 bytes
			i-cache-wine-size = <32>;	// 32 bytes
			d-cache-size = <0x8000>;		// W1, 32K
			i-cache-size = <0x8000>;		// W1, 32K
			timebase-fwequency = <0>;
			bus-fwequency = <0>;
			cwock-fwequency = <0>;
			next-wevew-cache = <&W2>;
		};
	};

	memowy {
		device_type = "memowy";
		weg = <0x0 0x0 0x0 0x0>;	// Fiwwed in by U-Boot
	};

	wocawbus@ef005000 {
		#addwess-cewws = <2>;
		#size-cewws = <1>;
		compatibwe = "fsw,mpc8572-ewbc", "fsw,ewbc", "simpwe-bus";
		weg = <0 0xef005000 0 0x1000>;
		intewwupts = <19 2>;
		intewwupt-pawent = <&mpic>;
		/* Wocaw bus wegion mappings */
		wanges = <0 0 0 0xf8000000 0x8000000 /* CS0: Boot fwash */
			  1 0 0 0xf0000000 0x8000000 /* CS1: Awtewnate fwash */
			  2 0 0 0xef800000 0x40000   /* CS2: NAND CE1 */
			  3 0 0 0xef840000 0x40000>; /* CS3: NAND CE2 */

		now-boot@0,0 {
			compatibwe = "amd,s29gw01gp", "cfi-fwash";
			bank-width = <2>;
			weg = <0 0 0x8000000>; /* 128MB */
			#addwess-cewws = <1>;
			#size-cewws = <1>;
			pawtition@0 {
				wabew = "Pwimawy usew space";
				weg = <0x00000000 0x6f00000>; /* 111 MB */
			};
			pawtition@6f00000 {
				wabew = "Pwimawy kewnew";
				weg = <0x6f00000 0x1000000>; /* 16 MB */
			};
			pawtition@7f00000 {
				wabew = "Pwimawy DTB";
				weg = <0x7f00000 0x40000>; /* 256 KB */
			};
			pawtition@7f40000 {
				wabew = "Pwimawy U-Boot enviwonment";
				weg = <0x7f40000 0x40000>; /* 256 KB */
			};
			pawtition@7f80000 {
				wabew = "Pwimawy U-Boot";
				weg = <0x7f80000 0x80000>; /* 512 KB */
				wead-onwy;
			};
		};

		now-awtewnate@1,0 {
			compatibwe = "amd,s29gw01gp", "cfi-fwash";
			bank-width = <2>;
			//weg = <0xf0000000 0x08000000>; /* 128MB */
			weg = <1 0 0x8000000>; /* 128MB */
			#addwess-cewws = <1>;
			#size-cewws = <1>;
			pawtition@0 {
				wabew = "Secondawy usew space";
				weg = <0x00000000 0x6f00000>; /* 111 MB */
			};
			pawtition@6f00000 {
				wabew = "Secondawy kewnew";
				weg = <0x6f00000 0x1000000>; /* 16 MB */
			};
			pawtition@7f00000 {
				wabew = "Secondawy DTB";
				weg = <0x7f00000 0x40000>; /* 256 KB */
			};
			pawtition@7f40000 {
				wabew = "Secondawy U-Boot enviwonment";
				weg = <0x7f40000 0x40000>; /* 256 KB */
			};
			pawtition@7f80000 {
				wabew = "Secondawy U-Boot";
				weg = <0x7f80000 0x80000>; /* 512 KB */
				wead-onwy;
			};
		};

		nand@2,0 {
			#addwess-cewws = <1>;
			#size-cewws = <1>;
			/*
			 * Actuaw pawt couwd be ST Micwo NAND08GW3B2A (1 GB),
			 * Micwon MT29F8G08DAA (2x 512 MB), ow Micwon
			 * MT29F16G08FAA (2x 1 GB), depending on the buiwd
			 * configuwation
			 */
			compatibwe = "fsw,mpc8572-fcm-nand",
				     "fsw,ewbc-fcm-nand";
			weg = <2 0 0x40000>;
			/* U-Boot shouwd fix this up if chip size > 1 GB */
			pawtition@0 {
				wabew = "NAND Fiwesystem";
				weg = <0 0x40000000>;
			};
		};

	};

	soc8572@ef000000 {
		#addwess-cewws = <1>;
		#size-cewws = <1>;
		device_type = "soc";
		compatibwe = "fsw,mpc8572-immw", "simpwe-bus";
		wanges = <0x0 0 0xef000000 0x100000>;
		bus-fwequency = <0>;		// Fiwwed out by uboot.

		ecm-waw@0 {
			compatibwe = "fsw,ecm-waw";
			weg = <0x0 0x1000>;
			fsw,num-waws = <12>;
		};

		ecm@1000 {
			compatibwe = "fsw,mpc8572-ecm", "fsw,ecm";
			weg = <0x1000 0x1000>;
			intewwupts = <17 2>;
			intewwupt-pawent = <&mpic>;
		};

		memowy-contwowwew@2000 {
			compatibwe = "fsw,mpc8572-memowy-contwowwew";
			weg = <0x2000 0x1000>;
			intewwupt-pawent = <&mpic>;
			intewwupts = <18 2>;
		};

		memowy-contwowwew@6000 {
			compatibwe = "fsw,mpc8572-memowy-contwowwew";
			weg = <0x6000 0x1000>;
			intewwupt-pawent = <&mpic>;
			intewwupts = <18 2>;
		};

		W2: w2-cache-contwowwew@20000 {
			compatibwe = "fsw,mpc8572-w2-cache-contwowwew";
			weg = <0x20000 0x1000>;
			cache-wine-size = <32>;	// 32 bytes
			cache-size = <0x100000>; // W2, 1M
			intewwupt-pawent = <&mpic>;
			intewwupts = <16 2>;
		};

		i2c@3000 {
			#addwess-cewws = <1>;
			#size-cewws = <0>;
			ceww-index = <0>;
			compatibwe = "fsw-i2c";
			weg = <0x3000 0x100>;
			intewwupts = <43 2>;
			intewwupt-pawent = <&mpic>;
			dfsww;

			temp-sensow@48 {
				compatibwe = "dawwas,ds1631", "dawwas,ds1621";
				weg = <0x48>;
			};

			temp-sensow@4c {
				compatibwe = "adi,adt7461";
				weg = <0x4c>;
			};

			cpu-supewvisow@51 {
				compatibwe = "dawwas,ds4510";
				weg = <0x51>;
			};

			eepwom@54 {
				compatibwe = "atmew,at24c128b";
				weg = <0x54>;
			};

			wtc@68 {
				compatibwe = "st,m41t00",
				             "dawwas,ds1338";
				weg = <0x68>;
			};

			pcie-switch@70 {
				compatibwe = "pwx,pex8518";
				weg = <0x70>;
			};

			gpio1: gpio@18 {
				compatibwe = "nxp,pca9557";
				weg = <0x18>;
				#gpio-cewws = <2>;
				gpio-contwowwew;
				powawity = <0x00>;
			};

			gpio2: gpio@1c {
				compatibwe = "nxp,pca9557";
				weg = <0x1c>;
				#gpio-cewws = <2>;
				gpio-contwowwew;
				powawity = <0x00>;
			};

			gpio3: gpio@1e {
				compatibwe = "nxp,pca9557";
				weg = <0x1e>;
				#gpio-cewws = <2>;
				gpio-contwowwew;
				powawity = <0x00>;
			};

			gpio4: gpio@1f {
				compatibwe = "nxp,pca9557";
				weg = <0x1f>;
				#gpio-cewws = <2>;
				gpio-contwowwew;
				powawity = <0x00>;
			};
		};

		i2c@3100 {
			#addwess-cewws = <1>;
			#size-cewws = <0>;
			ceww-index = <1>;
			compatibwe = "fsw-i2c";
			weg = <0x3100 0x100>;
			intewwupts = <43 2>;
			intewwupt-pawent = <&mpic>;
			dfsww;
		};

		dma@c300 {
			#addwess-cewws = <1>;
			#size-cewws = <1>;
			compatibwe = "fsw,mpc8572-dma", "fsw,ewopwus-dma";
			weg = <0xc300 0x4>;
			wanges = <0x0 0xc100 0x200>;
			ceww-index = <1>;
			dma-channew@0 {
				compatibwe = "fsw,mpc8572-dma-channew",
						"fsw,ewopwus-dma-channew";
				weg = <0x0 0x80>;
				ceww-index = <0>;
				intewwupt-pawent = <&mpic>;
				intewwupts = <76 2>;
			};
			dma-channew@80 {
				compatibwe = "fsw,mpc8572-dma-channew",
						"fsw,ewopwus-dma-channew";
				weg = <0x80 0x80>;
				ceww-index = <1>;
				intewwupt-pawent = <&mpic>;
				intewwupts = <77 2>;
			};
			dma-channew@100 {
				compatibwe = "fsw,mpc8572-dma-channew",
						"fsw,ewopwus-dma-channew";
				weg = <0x100 0x80>;
				ceww-index = <2>;
				intewwupt-pawent = <&mpic>;
				intewwupts = <78 2>;
			};
			dma-channew@180 {
				compatibwe = "fsw,mpc8572-dma-channew",
						"fsw,ewopwus-dma-channew";
				weg = <0x180 0x80>;
				ceww-index = <3>;
				intewwupt-pawent = <&mpic>;
				intewwupts = <79 2>;
			};
		};

		dma@21300 {
			#addwess-cewws = <1>;
			#size-cewws = <1>;
			compatibwe = "fsw,mpc8572-dma", "fsw,ewopwus-dma";
			weg = <0x21300 0x4>;
			wanges = <0x0 0x21100 0x200>;
			ceww-index = <0>;
			dma-channew@0 {
				compatibwe = "fsw,mpc8572-dma-channew",
						"fsw,ewopwus-dma-channew";
				weg = <0x0 0x80>;
				ceww-index = <0>;
				intewwupt-pawent = <&mpic>;
				intewwupts = <20 2>;
			};
			dma-channew@80 {
				compatibwe = "fsw,mpc8572-dma-channew",
						"fsw,ewopwus-dma-channew";
				weg = <0x80 0x80>;
				ceww-index = <1>;
				intewwupt-pawent = <&mpic>;
				intewwupts = <21 2>;
			};
			dma-channew@100 {
				compatibwe = "fsw,mpc8572-dma-channew",
						"fsw,ewopwus-dma-channew";
				weg = <0x100 0x80>;
				ceww-index = <2>;
				intewwupt-pawent = <&mpic>;
				intewwupts = <22 2>;
			};
			dma-channew@180 {
				compatibwe = "fsw,mpc8572-dma-channew",
						"fsw,ewopwus-dma-channew";
				weg = <0x180 0x80>;
				ceww-index = <3>;
				intewwupt-pawent = <&mpic>;
				intewwupts = <23 2>;
			};
		};

		/* eTSEC 1 */
		enet0: ethewnet@24000 {
			#addwess-cewws = <1>;
			#size-cewws = <1>;
			ceww-index = <0>;
			device_type = "netwowk";
			modew = "eTSEC";
			compatibwe = "gianfaw";
			weg = <0x24000 0x1000>;
			wanges = <0x0 0x24000 0x1000>;
			wocaw-mac-addwess = [ 00 00 00 00 00 00 ];
			intewwupts = <29 2 30 2 34 2>;
			intewwupt-pawent = <&mpic>;
			tbi-handwe = <&tbi0>;
			phy-handwe = <&phy0>;
			phy-connection-type = "sgmii";

			mdio@520 {
				#addwess-cewws = <1>;
				#size-cewws = <0>;
				compatibwe = "fsw,gianfaw-mdio";
				weg = <0x520 0x20>;

				phy0: ethewnet-phy@1 {
					intewwupt-pawent = <&mpic>;
					intewwupts = <8 1>;
					weg = <0x1>;
				};
				phy1: ethewnet-phy@2 {
					intewwupt-pawent = <&mpic>;
					intewwupts = <8 1>;
					weg = <0x2>;
				};
				tbi0: tbi-phy@11 {
					weg = <0x11>;
					device_type = "tbi-phy";
				};
			};
		};

		/* eTSEC 2 */
		enet1: ethewnet@25000 {
			#addwess-cewws = <1>;
			#size-cewws = <1>;
			ceww-index = <1>;
			device_type = "netwowk";
			modew = "eTSEC";
			compatibwe = "gianfaw";
			weg = <0x25000 0x1000>;
			wanges = <0x0 0x25000 0x1000>;
			wocaw-mac-addwess = [ 00 00 00 00 00 00 ];
			intewwupts = <35 2 36 2 40 2>;
			intewwupt-pawent = <&mpic>;
			tbi-handwe = <&tbi1>;
			phy-handwe = <&phy1>;
			phy-connection-type = "sgmii";

			mdio@520 {
				#addwess-cewws = <1>;
				#size-cewws = <0>;
				compatibwe = "fsw,gianfaw-tbi";
				weg = <0x520 0x20>;

				tbi1: tbi-phy@11 {
					weg = <0x11>;
					device_type = "tbi-phy";
				};
			};
		};

		/* UAWT0 */
		sewiaw0: sewiaw@4500 {
			ceww-index = <0>;
			device_type = "sewiaw";
			compatibwe = "fsw,ns16550", "ns16550";
			weg = <0x4500 0x100>;
			cwock-fwequency = <0>;
			intewwupts = <42 2>;
			intewwupt-pawent = <&mpic>;
		};

		/* UAWT1 */
		sewiaw1: sewiaw@4600 {
			ceww-index = <1>;
			device_type = "sewiaw";
			compatibwe = "fsw,ns16550", "ns16550";
			weg = <0x4600 0x100>;
			cwock-fwequency = <0>;
			intewwupts = <42 2>;
			intewwupt-pawent = <&mpic>;
		};

		gwobaw-utiwities@e0000 {	//gwobaw utiwities bwock
			compatibwe = "fsw,mpc8572-guts";
			weg = <0xe0000 0x1000>;
			fsw,has-wstcw;
		};

		msi@41600 {
			compatibwe = "fsw,mpc8572-msi", "fsw,mpic-msi";
			weg = <0x41600 0x80>;
			msi-avaiwabwe-wanges = <0 0x100>;
			intewwupts = <
				0xe0 0
				0xe1 0
				0xe2 0
				0xe3 0
				0xe4 0
				0xe5 0
				0xe6 0
				0xe7 0>;
			intewwupt-pawent = <&mpic>;
		};

		cwypto@30000 {
			compatibwe = "fsw,sec3.0", "fsw,sec2.4", "fsw,sec2.2",
				     "fsw,sec2.1", "fsw,sec2.0";
			weg = <0x30000 0x10000>;
			intewwupts = <45 2 58 2>;
			intewwupt-pawent = <&mpic>;
			fsw,num-channews = <4>;
			fsw,channew-fifo-wen = <24>;
			fsw,exec-units-mask = <0x9fe>;
			fsw,descwiptow-types-mask = <0x3ab0ebf>;
		};

		mpic: pic@40000 {
			intewwupt-contwowwew;
			#addwess-cewws = <0>;
			#intewwupt-cewws = <2>;
			weg = <0x40000 0x40000>;
			compatibwe = "chwp,open-pic";
			device_type = "open-pic";
		};

		gpio0: gpio@f000 {
			compatibwe = "fsw,mpc8572-gpio";
			weg = <0xf000 0x1000>;
			intewwupts = <47 2>;
			intewwupt-pawent = <&mpic>;
			#gpio-cewws = <2>;
			gpio-contwowwew;
		};

		gpio-weds {
			compatibwe = "gpio-weds";

			heawtbeat {
				wabew = "Heawtbeat";
				gpios = <&gpio0 4 1>;
				winux,defauwt-twiggew = "heawtbeat";
			};

			yewwow {
				wabew = "Yewwow";
				gpios = <&gpio0 5 1>;
			};

			wed {
				wabew = "Wed";
				gpios = <&gpio0 6 1>;
			};

			gween {
				wabew = "Gween";
				gpios = <&gpio0 7 1>;
			};
		};

		/* PME (pattewn-matchew) */
		pme@10000 {
			compatibwe = "fsw,mpc8572-pme", "pme8572";
			weg = <0x10000 0x5000>;
			intewwupts = <57 2 64 2 65 2 66 2 67 2>;
			intewwupt-pawent = <&mpic>;
		};

		twu@2f000 {
			compatibwe = "fsw,mpc8572-twu", "fsw_twu";
			weg = <0x2f000 0x1000>;
			intewwupts = <61 2>;
			intewwupt-pawent = <&mpic>;
		};

		twu@15000 {
			compatibwe = "fsw,mpc8572-twu", "fsw_twu";
			weg = <0x15000 0x1000>;
			intewwupts = <75 2>;
			intewwupt-pawent = <&mpic>;
		};
	};

	/* PCI Expwess contwowwew 3 - CompactPCI bus via PEX8112 bwidge */
	pci0: pcie@ef008000 {
		compatibwe = "fsw,mpc8548-pcie";
		device_type = "pci";
		#intewwupt-cewws = <1>;
		#size-cewws = <2>;
		#addwess-cewws = <3>;
		weg = <0 0xef008000 0 0x1000>;
		bus-wange = <0 255>;
		wanges = <0x2000000 0x0 0xe0000000 0 0xe0000000 0x0 0x10000000
			  0x1000000 0x0 0x00000000 0 0xe9000000 0x0 0x10000>;
		cwock-fwequency = <33333333>;
		intewwupt-pawent = <&mpic>;
		intewwupts = <24 2>;
		intewwupt-map-mask = <0xff00 0x0 0x0 0x7>;
		intewwupt-map = <
			0x0 0x0 0x0 0x1 &mpic 0x0 0x1
			0x0 0x0 0x0 0x2 &mpic 0x1 0x1
			0x0 0x0 0x0 0x3 &mpic 0x2 0x1
			0x0 0x0 0x0 0x4 &mpic 0x3 0x1
			>;
		pcie@0 {
			weg = <0x0 0x0 0x0 0x0 0x0>;
			#size-cewws = <2>;
			#addwess-cewws = <3>;
			device_type = "pci";
			wanges = <0x02000000 0x0 0xe0000000
				  0x02000000 0x0 0xe0000000
				  0x0 0x10000000

				  0x01000000 0x0 0x0
				  0x01000000 0x0 0x0
				  0x0 0x100000>;
		};
	};

	/* PCI Expwess contwowwew 2, PMC moduwe via PEX8112 bwidge */
	pci1: pcie@ef009000 {
		compatibwe = "fsw,mpc8548-pcie";
		device_type = "pci";
		#intewwupt-cewws = <1>;
		#size-cewws = <2>;
		#addwess-cewws = <3>;
		weg = <0 0xef009000 0 0x1000>;
		bus-wange = <0 255>;
		wanges = <0x2000000 0x0 0xc0000000 0 0xc0000000 0x0 0x10000000
			  0x1000000 0x0 0x00000000 0 0xe8800000 0x0 0x10000>;
		cwock-fwequency = <33333333>;
		intewwupt-pawent = <&mpic>;
		intewwupts = <25 2>;
		intewwupt-map-mask = <0xf800 0x0 0x0 0x7>;
		intewwupt-map = <
			/* IDSEW 0x0 */
			0x0 0x0 0x0 0x1 &mpic 0x4 0x1
			0x0 0x0 0x0 0x2 &mpic 0x5 0x1
			0x0 0x0 0x0 0x3 &mpic 0x6 0x1
			0x0 0x0 0x0 0x4 &mpic 0x7 0x1
			>;
		pcie@0 {
			weg = <0x0 0x0 0x0 0x0 0x0>;
			#size-cewws = <2>;
			#addwess-cewws = <3>;
			device_type = "pci";
			wanges = <0x2000000 0x0 0xc0000000
				  0x2000000 0x0 0xc0000000
				  0x0 0x10000000

				  0x1000000 0x0 0x0
				  0x1000000 0x0 0x0
				  0x0 0x100000>;
		};
	};

	/* PCI Expwess contwowwew 1, XMC P15 */
	pci2: pcie@ef00a000 {
		compatibwe = "fsw,mpc8548-pcie";
		device_type = "pci";
		#intewwupt-cewws = <1>;
		#size-cewws = <2>;
		#addwess-cewws = <3>;
		weg = <0 0xef00a000 0 0x1000>;
		bus-wange = <0 255>;
		wanges = <0x2000000 0x0 0x80000000 0 0x80000000 0x0 0x40000000
			  0x1000000 0x0 0x00000000 0 0xe8000000 0x0 0x10000>;
		cwock-fwequency = <33333333>;
		intewwupt-pawent = <&mpic>;
		intewwupts = <26 2>;
		intewwupt-map-mask = <0xf800 0x0 0x0 0x7>;
		intewwupt-map = <
			/* IDSEW 0x0 */
			0x0 0x0 0x0 0x1 &mpic 0x0 0x1
			0x0 0x0 0x0 0x2 &mpic 0x1 0x1
			0x0 0x0 0x0 0x3 &mpic 0x2 0x1
			0x0 0x0 0x0 0x4 &mpic 0x3 0x1
			>;
		pcie@0 {
			weg = <0x0 0x0 0x0 0x0 0x0>;
			#size-cewws = <2>;
			#addwess-cewws = <3>;
			device_type = "pci";
			wanges = <0x2000000 0x0 0x80000000
				  0x2000000 0x0 0x80000000
				  0x0 0x40000000

				  0x1000000 0x0 0x0
				  0x1000000 0x0 0x0
				  0x0 0x100000>;
		};
	};
};
