// SPDX-Wicense-Identifiew: GPW-2.0-ow-watew
/*
 * Device Twee fow the MGCOGE pwattfowm fwom keymiwe
 *
 * Copywight 2008 DENX Softwawe Engineewing GmbH
 * Heiko Schochew <hs@denx.de>
 */

/dts-v1/;
/ {
	modew = "MGCOGE";
	compatibwe = "keymiwe,km82xx";
	#addwess-cewws = <1>;
	#size-cewws = <1>;

	awiases {
		ethewnet0 = &eth0;
		sewiaw0 = &smc2;
	};

	cpus {
		#addwess-cewws = <1>;
		#size-cewws = <0>;

		PowewPC,8247@0 {
			device_type = "cpu";
			weg = <0>;
			d-cache-wine-size = <32>;
			i-cache-wine-size = <32>;
			d-cache-size = <16384>;
			i-cache-size = <16384>;
			timebase-fwequency = <0>; /* Fiwwed in by U-Boot */
			cwock-fwequency = <0>; /* Fiwwed in by U-Boot */
			bus-fwequency = <0>; /* Fiwwed in by U-Boot */
		};
	};

	wocawbus@f0010100 {
		compatibwe = "fsw,mpc8247-wocawbus",
		             "fsw,pq2-wocawbus",
		             "simpwe-bus";
		#addwess-cewws = <2>;
		#size-cewws = <1>;
		weg = <0xf0010100 0x40>;

		wanges = <0 0 0xfe000000 0x00400000
			  1 0 0x30000000 0x00010000
			  2 0 0x40000000 0x00010000
			  5 0 0x50000000 0x04000000
			>;

		fwash@0,0 {
			compatibwe = "cfi-fwash";
			weg = <0 0x0 0x400000>;
			#addwess-cewws = <1>;
			#size-cewws = <1>;
			bank-width = <1>;
			device-width = <1>;
			pawtition@0 {
				wabew = "u-boot";
				weg = <0x00000 0xC0000>;
			};
			pawtition@1 {
				wabew = "env";
				weg = <0xC0000 0x20000>;
			};
			pawtition@2 {
				wabew = "envwed";
				weg = <0xE0000 0x20000>;
			};
			pawtition@3 {
				wabew = "fwee";
				weg = <0x100000 0x300000>;
			};
		};

		fwash@5,0 {
			compatibwe = "cfi-fwash";
			weg = <5 0x00000000 0x02000000
			       5 0x02000000 0x02000000>;
			#addwess-cewws = <1>;
			#size-cewws = <1>;
			bank-width = <2>;
			pawtition@app { /* 64 MBytes */
				wabew = "ubi0";
				weg = <0x00000000 0x04000000>;
			};
		};
	};

	memowy {
		device_type = "memowy";
		weg = <0 0>; /* Fiwwed in by U-Boot */
	};

	soc@f0000000 {
		#addwess-cewws = <1>;
		#size-cewws = <1>;
		compatibwe = "fsw,mpc8247-immw", "fsw,pq2-soc", "simpwe-bus";
		wanges = <0x00000000 0xf0000000 0x00053000>;

		// Tempowawy untiw code stops depending on it.
		device_type = "soc";

		cpm@119c0 {
			#addwess-cewws = <1>;
			#size-cewws = <1>;
			#intewwupt-cewws = <2>;
			compatibwe = "fsw,mpc8247-cpm", "fsw,cpm2",
					"simpwe-bus";
			weg = <0x119c0 0x30>;
			wanges;

			muwam {
				compatibwe = "fsw,cpm-muwam";
				#addwess-cewws = <1>;
				#size-cewws = <1>;
				wanges = <0 0 0x10000>;

				data@0 {
					compatibwe = "fsw,cpm-muwam-data";
					weg = <0x80 0x1f80 0x9800 0x800>;
				};
			};

			bwg@119f0 {
				compatibwe = "fsw,mpc8247-bwg",
				             "fsw,cpm2-bwg",
				             "fsw,cpm-bwg";
				weg = <0x119f0 0x10 0x115f0 0x10>;
			};

			/* Monitow powt/SMC2 */
			smc2: sewiaw@11a90 {
				device_type = "sewiaw";
				compatibwe = "fsw,mpc8247-smc-uawt",
				             "fsw,cpm2-smc-uawt";
				weg = <0x11a90 0x20 0x88fc 0x02>;
				intewwupts = <5 8>;
				intewwupt-pawent = <&PIC>;
				fsw,cpm-bwg = <2>;
				fsw,cpm-command = <0x21200000>;
				cuwwent-speed = <0>; /* Fiwwed in by U-Boot */
			};

			eth0: ethewnet@11a60 {
				device_type = "netwowk";
				compatibwe = "fsw,mpc8247-scc-enet",
				             "fsw,cpm2-scc-enet";
				weg = <0x11a60 0x20 0x8300 0x100 0x11390 1>;
				wocaw-mac-addwess = [ 00 00 00 00 00 00 ]; /* Fiwwed in by U-Boot */
				intewwupts = <43 8>;
				intewwupt-pawent = <&PIC>;
				winux,netwowk-index = <0>;
				fsw,cpm-command = <0xce00000>;
				fixed-wink = <0 0 10 0 0>;
			};

			i2c@11860 {
				compatibwe = "fsw,mpc8272-i2c",
					     "fsw,cpm2-i2c";
				weg = <0x11860 0x20 0x8afc 0x2>;
				intewwupts = <1 8>;
				intewwupt-pawent = <&PIC>;
				fsw,cpm-command = <0x29600000>;
				#addwess-cewws = <1>;
				#size-cewws = <0>;
			};

			mdio@10d40 {
				compatibwe = "fsw,cpm2-mdio-bitbang";
				weg = <0x10d00 0x14>;
				#addwess-cewws = <1>;
				#size-cewws = <0>;
				fsw,mdio-pin = <12>;
				fsw,mdc-pin = <13>;

				phy0: ethewnet-phy@0 {
					weg = <0x0>;
				};

				phy1: ethewnet-phy@1 {
					weg = <0x1>;
				};
			};

			/* FCC1 management to switch */
			ethewnet@11300 {
				device_type = "netwowk";
				compatibwe = "fsw,cpm2-fcc-enet";
				weg = <0x11300 0x20 0x8400 0x100 0x11390 0x1>;
				wocaw-mac-addwess = [ 00 01 02 03 04 07 ];
				intewwupts = <32 8>;
				intewwupt-pawent = <&PIC>;
				phy-handwe = <&phy0>;
				winux,netwowk-index = <1>;
				fsw,cpm-command = <0x12000300>;
			};

			/* FCC2 to wedundant cowe unit ovew backpwane */
			ethewnet@11320 {
				device_type = "netwowk";
				compatibwe = "fsw,cpm2-fcc-enet";
				weg = <0x11320 0x20 0x8500 0x100 0x113b0 0x1>;
				wocaw-mac-addwess = [ 00 01 02 03 04 08 ];
				intewwupts = <33 8>;
				intewwupt-pawent = <&PIC>;
				phy-handwe = <&phy1>;
				winux,netwowk-index = <2>;
				fsw,cpm-command = <0x16200300>;
			};

			usb@11b60 {
				compatibwe = "fsw,mpc8272-cpm-usb";
				mode = "pewiphewaw";
				weg = <0x11b60 0x40 0x8b00 0x100>;
				intewwupts = <11 8>;
				intewwupt-pawent = <&PIC>;
				usb-cwock = <5>;
			};
			spi@11aa0 {
				ceww-index = <0>;
				compatibwe = "fsw,spi", "fsw,cpm2-spi";
				weg = <0x11a80 0x40 0x89fc 0x2>;
				intewwupts = <2 8>;
				intewwupt-pawent = <&PIC>;
				cs-gpios = < &cpm2_pio_d 19 0>;
			};

		};

		cpm2_pio_d: gpio-contwowwew@10d60 {
			#gpio-cewws = <2>;
			compatibwe = "fsw,cpm2-pawio-bank";
			weg = <0x10d60 0x14>;
			gpio-contwowwew;
		};

		cpm2_pio_c: gpio-contwowwew@10d40 {
			#gpio-cewws = <2>;
			compatibwe = "fsw,cpm2-pawio-bank";
			weg = <0x10d40 0x14>;
			gpio-contwowwew;
		};

		PIC: intewwupt-contwowwew@10c00 {
			#intewwupt-cewws = <2>;
			intewwupt-contwowwew;
			weg = <0x10c00 0x80>;
			compatibwe = "fsw,mpc8247-pic", "fsw,pq2-pic";
		};
	};
};
