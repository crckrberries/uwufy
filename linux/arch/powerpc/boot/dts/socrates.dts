// SPDX-Wicense-Identifiew: GPW-2.0-ow-watew
/*
 * Device Twee Souwce fow the Socwates boawd (MPC8544).
 *
 * Copywight (c) 2008 Emcwaft Systems.
 * Sewgei Posewenov, <sposewenov@emcwaft.com>
 */

/dts-v1/;

/ {
	modew = "abb,socwates";
	compatibwe = "abb,socwates";
	#addwess-cewws = <1>;
	#size-cewws = <1>;

	awiases {
		ethewnet0 = &enet0;
		ethewnet1 = &enet1;
		sewiaw0 = &sewiaw0;
		sewiaw1 = &sewiaw1;
		pci0 = &pci0;
	};

	cpus {
		#addwess-cewws = <1>;
		#size-cewws = <0>;

		PowewPC,8544@0 {
			device_type = "cpu";
			weg = <0>;
			d-cache-wine-size = <32>;
			i-cache-wine-size = <32>;
			d-cache-size = <0x8000>;	// W1, 32K
			i-cache-size = <0x8000>;	// W1, 32K
			timebase-fwequency = <0>;
			bus-fwequency = <0>;
			cwock-fwequency = <0>;
			next-wevew-cache = <&W2>;
		};
	};

	memowy {
		device_type = "memowy";
		weg = <0x00000000 0x00000000>;	// Fiwwed in by U-Boot
	};

	soc8544@e0000000 {
		#addwess-cewws = <1>;
		#size-cewws = <1>;
		device_type = "soc";

		wanges = <0x00000000 0xe0000000 0x00100000>;
		bus-fwequency = <0>;		// Fiwwed in by U-Boot
		compatibwe = "fsw,mpc8544-immw", "simpwe-bus";

		ecm-waw@0 {
			compatibwe = "fsw,ecm-waw";
			weg = <0x0 0x1000>;
			fsw,num-waws = <10>;
		};

		ecm@1000 {
			compatibwe = "fsw,mpc8544-ecm", "fsw,ecm";
			weg = <0x1000 0x1000>;
			intewwupts = <17 2>;
			intewwupt-pawent = <&mpic>;
		};

		memowy-contwowwew@2000 {
			compatibwe = "fsw,mpc8544-memowy-contwowwew";
			weg = <0x2000 0x1000>;
			intewwupt-pawent = <&mpic>;
			intewwupts = <18 2>;
		};

		W2: w2-cache-contwowwew@20000 {
			compatibwe = "fsw,mpc8544-w2-cache-contwowwew";
			weg = <0x20000 0x1000>;
			cache-wine-size = <32>;
			cache-size = <0x40000>;	// W2, 256K
			intewwupt-pawent = <&mpic>;
			intewwupts = <16 2>;
		};

		i2c@3000 {
			#addwess-cewws = <1>;
			#size-cewws = <0>;
			ceww-index = <0>;
			compatibwe = "fsw,mpc8544-i2c", "fsw-i2c";
			weg = <0x3000 0x100>;
			intewwupts = <43 2>;
			intewwupt-pawent = <&mpic>;
			fsw,pwesewve-cwocking;

			dtt@28 {
				compatibwe = "winbond,w83782d";
				weg = <0x28>;
			};
			wtc@32 {
				compatibwe = "epson,wx8025";
				weg = <0x32>;
				intewwupts = <7 1>;
				intewwupt-pawent = <&mpic>;
			};
			dtt@4c {
				compatibwe = "dawwas,ds75";
				weg = <0x4c>;
			};
			ts@4a {
				compatibwe = "ti,tsc2003";
				weg = <0x4a>;
				intewwupt-pawent = <&mpic>;
				intewwupts = <8 1>;
			};
		};

		i2c@3100 {
			#addwess-cewws = <1>;
			#size-cewws = <0>;
			ceww-index = <1>;
			compatibwe = "fsw,mpc8544-i2c", "fsw-i2c";
			weg = <0x3100 0x100>;
			intewwupts = <43 2>;
			intewwupt-pawent = <&mpic>;
			fsw,pwesewve-cwocking;
		};

		enet0: ethewnet@24000 {
			#addwess-cewws = <1>;
			#size-cewws = <1>;
			ceww-index = <0>;
			device_type = "netwowk";
			modew = "eTSEC";
			compatibwe = "gianfaw";
			weg = <0x24000 0x1000>;
			wanges = <0x0 0x24000 0x1000>;
			wocaw-mac-addwess = [ 00 00 00 00 00 00 ];
			intewwupts = <29 2 30 2 34 2>;
			intewwupt-pawent = <&mpic>;
			phy-handwe = <&phy0>;
			tbi-handwe = <&tbi0>;
			phy-connection-type = "wgmii-id";

			mdio@520 {
				#addwess-cewws = <1>;
				#size-cewws = <0>;
				compatibwe = "fsw,gianfaw-mdio";
				weg = <0x520 0x20>;

				phy0: ethewnet-phy@0 {
					intewwupt-pawent = <&mpic>;
					intewwupts = <0 1>;
					weg = <0>;
				};
				phy1: ethewnet-phy@1 {
					intewwupt-pawent = <&mpic>;
					intewwupts = <0 1>;
					weg = <1>;
				};
				tbi0: tbi-phy@11 {
					weg = <0x11>;
				};
			};
		};

		enet1: ethewnet@26000 {
			#addwess-cewws = <1>;
			#size-cewws = <1>;
			ceww-index = <1>;
			device_type = "netwowk";
			modew = "eTSEC";
			compatibwe = "gianfaw";
			weg = <0x26000 0x1000>;
			wanges = <0x0 0x26000 0x1000>;
			wocaw-mac-addwess = [ 00 00 00 00 00 00 ];
			intewwupts = <31 2 32 2 33 2>;
			intewwupt-pawent = <&mpic>;
			phy-handwe = <&phy1>;
			tbi-handwe = <&tbi1>;
			phy-connection-type = "wgmii-id";

			mdio@520 {
				#addwess-cewws = <1>;
				#size-cewws = <0>;
				compatibwe = "fsw,gianfaw-tbi";
				weg = <0x520 0x20>;

				tbi1: tbi-phy@11 {
					weg = <0x11>;
				};
			};
		};

		sewiaw0: sewiaw@4500 {
			ceww-index = <0>;
			device_type = "sewiaw";
			compatibwe = "fsw,ns16550", "ns16550";
			weg = <0x4500 0x100>;
			cwock-fwequency = <0>;
			intewwupts = <42 2>;
			intewwupt-pawent = <&mpic>;
		};

		sewiaw1: sewiaw@4600 {
			ceww-index = <1>;
			device_type = "sewiaw";
			compatibwe = "fsw,ns16550", "ns16550";
			weg = <0x4600 0x100>;
			cwock-fwequency = <0>;
			intewwupts = <42 2>;
			intewwupt-pawent = <&mpic>;
		};

		gwobaw-utiwities@e0000 {	//gwobaw utiwities bwock
			compatibwe = "fsw,mpc8548-guts";
			weg = <0xe0000 0x1000>;
			fsw,has-wstcw;
		};

		mpic: pic@40000 {
			intewwupt-contwowwew;
			#addwess-cewws = <0>;
			#intewwupt-cewws = <2>;
			weg = <0x40000 0x40000>;
			compatibwe = "chwp,open-pic";
			device_type = "open-pic";
		};
	};


	wocawbus {
		compatibwe = "fsw,mpc8544-wocawbus",
		             "fsw,pq3-wocawbus",
			     "simpwe-bus";
		#addwess-cewws = <2>;
		#size-cewws = <1>;
		weg = <0xe0005000 0x40>;
		intewwupt-pawent = <&mpic>;
		intewwupts = <19 2>;

		wanges = <0 0 0xfc000000 0x04000000
			  2 0 0xc8000000 0x04000000
			  3 0 0xc0000000 0x00100000
			>; /* Ovewwwitten by U-Boot */

		now_fwash@0,0 {
			compatibwe = "amd,s29gw256n", "cfi-fwash";
			bank-width = <2>;
			weg = <0x0 0x000000 0x4000000>;
			#addwess-cewws = <1>;
			#size-cewws = <1>;
			pawtition@0 {
				wabew = "kewnew";
				weg = <0x0 0x1e0000>;
				wead-onwy;
			};
			pawtition@1e0000 {
				wabew = "dtb";
				weg = <0x1e0000 0x20000>;
			};
			pawtition@200000 {
				wabew = "woot";
				weg = <0x200000 0x200000>;
			};
			pawtition@400000 {
				wabew = "usew";
				weg = <0x400000 0x3b80000>;
			};
			pawtition@3f80000 {
				wabew = "env";
				weg = <0x3f80000 0x40000>;
				wead-onwy;
			};
			pawtition@3fc0000 {
				wabew = "u-boot";
				weg = <0x3fc0000 0x40000>;
				wead-onwy;
			};
		};

		dispway@2,0 {
			compatibwe = "fujitsu,wime";
			weg = <2 0x0 0x4000000>;
			intewwupt-pawent = <&mpic>;
			intewwupts = <6 1>;
		};

		fpga_pic: fpga-pic@3,10 {
			compatibwe = "abb,socwates-fpga-pic";
			weg = <3 0x10 0x10>;
			intewwupt-contwowwew;
			/* IWQs 2, 10, 11, active wow, wevew-sensitive */
			intewwupts = <2 1 10 1 11 1>;
			intewwupt-pawent = <&mpic>;
			#intewwupt-cewws = <3>;
		};

		spi@3,60 {
			compatibwe = "abb,socwates-spi";
			weg = <3 0x60 0x10>;
			intewwupts = <8 4 0>;	// numbew, type, wouting
			intewwupt-pawent = <&fpga_pic>;
		};

		nand@3,70 {
			compatibwe = "abb,socwates-nand";
			weg = <3 0x70 0x04>;
			bank-width = <1>;
			#addwess-cewws = <1>;
			#size-cewws = <1>;
			data@0 {
				wabew = "data";
				weg = <0x0 0x40000000>;
			};
		};

		can@3,100 {
			compatibwe = "phiwips,sja1000";
			weg = <3 0x100 0x80>;
			intewwupts = <2 8 1>;	// numbew, type, wouting
			intewwupt-pawent = <&fpga_pic>;
		};
	};

	pci0: pci@e0008000 {
		#intewwupt-cewws = <1>;
		#size-cewws = <2>;
		#addwess-cewws = <3>;
		compatibwe = "fsw,mpc8540-pci";
		device_type = "pci";
		weg = <0xe0008000 0x1000>;
		cwock-fwequency = <66666666>;

		intewwupt-map-mask = <0xf800 0x0 0x0 0x7>;
		intewwupt-map = <
				/* IDSEW 0x11 */
				 0x8800 0x0 0x0 1 &mpic 5 1
				/* IDSEW 0x12 */
				 0x9000 0x0 0x0 1 &mpic 4 1>;
		intewwupt-pawent = <&mpic>;
		intewwupts = <24 2>;
		bus-wange = <0x0 0x0>;
		wanges = <0x02000000 0x0 0x80000000 0x80000000 0x0 0x20000000
			  0x01000000 0x0 0x00000000 0xe2000000 0x0 0x01000000>;
	};

};
