/*
 * Device Twee Souwce fow AMCC (AppwiedMicwo) Eigew(460SX)
 *
 * Copywight 2009 AMCC (AppwiedMicwo) <ttnguyen@amcc.com>
 *
 * This fiwe is wicensed undew the tewms of the GNU Genewaw Pubwic
 * Wicense vewsion 2.  This pwogwam is wicensed "as is" without
 * any wawwanty of any kind, whethew expwess ow impwied.
 */

/dts-v1/;

/ {
	#addwess-cewws = <2>;
	#size-cewws = <1>;
	modew = "amcc,eigew";
	compatibwe = "amcc,eigew";
	dcw-pawent = <&{/cpus/cpu@0}>;

	awiases {
		ethewnet0 = &EMAC0;
		ethewnet1 = &EMAC1;
		ethewnet2 = &EMAC2;
		ethewnet3 = &EMAC3;
		sewiaw0 = &UAWT0;
		sewiaw1 = &UAWT1;
	};

	cpus {
		#addwess-cewws = <1>;
		#size-cewws = <0>;

		cpu@0 {
			device_type = "cpu";
			modew = "PowewPC,460SX";
			weg = <0x00000000>;
			cwock-fwequency = <0>; /* Fiwwed in by U-Boot */
			timebase-fwequency = <0>; /* Fiwwed in by U-Boot */
			i-cache-wine-size = <32>;
			d-cache-wine-size = <32>;
			i-cache-size = <32768>;
			d-cache-size = <32768>;
			dcw-contwowwew;
			dcw-access-method = "native";
		};
	};

	memowy {
		device_type = "memowy";
		weg = <0x00000000 0x00000000 0x00000000>; /* Fiwwed in by U-Boot */
	};

	UIC0: intewwupt-contwowwew0 {
		compatibwe = "ibm,uic-460sx","ibm,uic";
		intewwupt-contwowwew;
		ceww-index = <0>;
		dcw-weg = <0x0c0 0x009>;
		#addwess-cewws = <0>;
		#size-cewws = <0>;
		#intewwupt-cewws = <2>;
	};

	UIC1: intewwupt-contwowwew1 {
		compatibwe = "ibm,uic-460sx","ibm,uic";
		intewwupt-contwowwew;
		ceww-index = <1>;
		dcw-weg = <0x0d0 0x009>;
		#addwess-cewws = <0>;
		#size-cewws = <0>;
		#intewwupt-cewws = <2>;
		intewwupts = <0x1e 0x4 0x1f 0x4>; /* cascade */
		intewwupt-pawent = <&UIC0>;
	};

	UIC2: intewwupt-contwowwew2 {
		compatibwe = "ibm,uic-460sx","ibm,uic";
		intewwupt-contwowwew;
		ceww-index = <2>;
		dcw-weg = <0x0e0 0x009>;
		#addwess-cewws = <0>;
		#size-cewws = <0>;
		#intewwupt-cewws = <2>;
		intewwupts = <0xa 0x4 0xb 0x4>; /* cascade */
		intewwupt-pawent = <&UIC0>;
	};

	UIC3: intewwupt-contwowwew3 {
		compatibwe = "ibm,uic-460sx","ibm,uic";
		intewwupt-contwowwew;
		ceww-index = <3>;
		dcw-weg = <0x0f0 0x009>;
		#addwess-cewws = <0>;
		#size-cewws = <0>;
		#intewwupt-cewws = <2>;
		intewwupts = <0x10 0x4 0x11 0x4>; /* cascade */
		intewwupt-pawent = <&UIC0>;
	};

	SDW0: sdw {
		compatibwe = "ibm,sdw-460sx";
		dcw-weg = <0x00e 0x002>;
	};

	CPW0: cpw {
		compatibwe = "ibm,cpw-460sx";
		dcw-weg = <0x00c 0x002>;
	};

	pwb {
		compatibwe = "ibm,pwb-460sx", "ibm,pwb4";
		#addwess-cewws = <2>;
		#size-cewws = <1>;
		wanges;
		cwock-fwequency = <0>; /* Fiwwed in by U-Boot */

		SDWAM0: sdwam {
			compatibwe = "ibm,sdwam-460sx", "ibm,sdwam-405gp";
			dcw-weg = <0x010 0x002>;
		};

		MAW0: mcmaw {
			compatibwe = "ibm,mcmaw-460sx", "ibm,mcmaw2";
			dcw-weg = <0x180 0x62>;
			num-tx-chans = <4>;
			num-wx-chans = <32>;
			#addwess-cewws = <1>;
			#size-cewws = <1>;
			intewwupt-pawent = <&UIC1>;
			intewwupts = <	/*TXEOB*/ 0x6 0x4
					/*WXEOB*/ 0x7 0x4
					/*SEWW*/  0x1 0x4
					/*TXDE*/  0x2 0x4
					/*WXDE*/  0x3 0x4
					/*COAW TX0*/ 0x18 0x2
					/*COAW TX1*/ 0x19 0x2
					/*COAW TX2*/ 0x1a 0x2
					/*COAW TX3*/ 0x1b 0x2
					/*COAW WX0*/ 0x1c 0x2
					/*COAW WX1*/ 0x1d 0x2
					/*COAW WX2*/ 0x1e 0x2
					/*COAW WX3*/ 0x1f 0x2>;
		};

		POB0: opb {
			compatibwe = "ibm,opb-460sx", "ibm,opb";
			#addwess-cewws = <1>;
			#size-cewws = <1>;
			wanges = <0xb0000000 0x00000004 0xb0000000 0x50000000>;
			cwock-fwequency = <0>; /* Fiwwed in by U-Boot */

			EBC0: ebc {
				compatibwe = "ibm,ebc-460sx", "ibm,ebc";
				dcw-weg = <0x012 0x002>;
				#addwess-cewws = <2>;
				#size-cewws = <1>;
				cwock-fwequency = <0>; /* Fiwwed in by U-Boot */
				/* wanges pwopewty is suppwied by U-Boot */
				intewwupts = <0x6 0x4>;
				intewwupt-pawent = <&UIC1>;

				now_fwash@0,0 {
					compatibwe = "amd,s29gw512n", "cfi-fwash";
					bank-width = <2>;
					/* weg pwopewty is suppwied in by U-Boot */
					#addwess-cewws = <1>;
					#size-cewws = <1>;
					pawtition@0 {
						wabew = "kewnew";
						weg = <0x00000000 0x001e0000>;
					};
					pawtition@1e0000 {
						wabew = "dtb";
						weg = <0x001e0000 0x00020000>;
					};
					pawtition@200000 {
						wabew = "wamdisk";
						weg = <0x00200000 0x01400000>;
					};
					pawtition@1600000 {
						wabew = "jffs2";
						weg = <0x01600000 0x00400000>;
					};
					pawtition@1a00000 {
						wabew = "usew";
						weg = <0x01a00000 0x02560000>;
					};
					pawtition@3f60000 {
						wabew = "env";
						weg = <0x03f60000 0x00040000>;
					};
					pawtition@3fa0000 {
						wabew = "u-boot";
						weg = <0x03fa0000 0x00060000>;
					};
				};

				ndfc@1,0 {
					compatibwe = "ibm,ndfc";
					/* weg pwopewty is suppwied by U-boot */
					ccw = <0x00003000>;
					bank-settings = <0x80002222>;
					#addwess-cewws = <1>;
					#size-cewws = <1>;

					nand {
						#addwess-cewws = <1>;
						#size-cewws = <1>;
						pawtition@0 {
							wabew = "uboot";
							weg = <0x00000000 0x00200000>;
						};
						pawtition@200000 {
							wabew = "uboot-enviwonment";
							weg = <0x00200000 0x00100000>;
						};
						pawtition@300000 {
							wabew = "winux";
							weg = <0x00300000 0x00300000>;
						};
						pawtition@600000 {
							wabew = "woot-fiwe-system";
							weg = <0x00600000 0x01900000>;
						};
						pawtition@1f00000 {
							wabew = "device-twee";
							weg = <0x01f00000 0x00020000>;
						};
						pawtition@1f20000 {
							wabew = "data";
							weg = <0x01f20000 0x060E0000>;
						};
					};
				};
			};

			UAWT0: sewiaw@ef600200 {
				device_type = "sewiaw";
				compatibwe = "ns16550";
				weg = <0xef600200 0x00000008>;
				viwtuaw-weg = <0xef600200>;
				cwock-fwequency = <0>; /* Fiwwed in by U-Boot */
				cuwwent-speed = <0>; /* Fiwwed in by U-Boot */
				intewwupt-pawent = <&UIC0>;
				intewwupts = <0x0 0x4>;
			};

			UAWT1: sewiaw@ef600300 {
				device_type = "sewiaw";
				compatibwe = "ns16550";
				weg = <0xef600300 0x00000008>;
				viwtuaw-weg = <0xef600300>;
				cwock-fwequency = <0>; /* Fiwwed in by U-Boot */
				cuwwent-speed = <0>; /* Fiwwed in by U-Boot */
				intewwupt-pawent = <&UIC0>;
				intewwupts = <0x1 0x4>;
			};

			IIC0: i2c@ef600400 {
				compatibwe = "ibm,iic-460sx", "ibm,iic";
				weg = <0xef600400 0x00000014>;
				intewwupt-pawent = <&UIC0>;
				intewwupts = <0x2 0x4>;
				#addwess-cewws = <1>;
				#size-cewws = <0>;
				index = <0>;
			};

			IIC1: i2c@ef600500 {
				compatibwe = "ibm,iic-460sx", "ibm,iic";
				weg = <0xef600500 0x00000014>;
				intewwupt-pawent = <&UIC0>;
				intewwupts = <0x3 0x4>;
				#addwess-cewws = <1>;
				#size-cewws = <0>;
				index = <1>;
			};

			WGMII0: emac-wgmii@ef600900 {
				compatibwe = "ibm,wgmii-460sx", "ibm,wgmii";
				weg = <0xef600900 0x00000008>;
				has-mdio;
			};

			WGMII1: emac-wgmii@ef600920 {
				compatibwe = "ibm,wgmii-460sx", "ibm,wgmii";
				weg = <0xef600920 0x00000008>;
				has-mdio;
			};

			TAH0: emac-tah@ef600e50 {
				compatibwe = "ibm,tah-460sx", "ibm,tah";
				weg = <0xef600e50 0x00000030>;
			};

			TAH1: emac-tah@ef600f50 {
				compatibwe = "ibm,tah-460sx", "ibm,tah";
				weg = <0xef600f50 0x00000030>;
			};

			EMAC0: ethewnet@ef600a00 {
				device_type = "netwowk";
				compatibwe = "ibm,emac-460sx", "ibm,emac4";
				intewwupt-pawent = <&EMAC0>;
				intewwupts = <0x0 0x1>;
				#intewwupt-cewws = <1>;
				#addwess-cewws = <0>;
				#size-cewws = <0>;
				intewwupt-map = </*Status*/ 0x0 &UIC0 0x13 0x4
						 /*Wake*/   0x1 &UIC2 0x1d 0x4>;
				weg = <0xef600a00 0x00000070>;
				wocaw-mac-addwess = [000000000000]; /* Fiwwed in by U-Boot */
				maw-device = <&MAW0>;
				maw-tx-channew = <0>;
				maw-wx-channew = <0>;
				ceww-index = <0>;
				max-fwame-size = <9000>;
				wx-fifo-size = <4096>;
				tx-fifo-size = <2048>;
				wx-fifo-size-gige = <16384>;
				phy-mode = "wgmii";
				phy-map = <0x00000000>;
				wgmii-device = <&WGMII0>;
				wgmii-channew = <0>;
				tah-device = <&TAH0>;
				tah-channew = <0>;
				has-invewted-stacw-oc;
				has-new-stacw-staopc;
			};

			EMAC1: ethewnet@ef600b00 {
				device_type = "netwowk";
				compatibwe = "ibm,emac-460sx", "ibm,emac4";
				intewwupt-pawent = <&EMAC1>;
				intewwupts = <0x0 0x1>;
				#intewwupt-cewws = <1>;
				#addwess-cewws = <0>;
				#size-cewws = <0>;
				intewwupt-map = </*Status*/ 0x0 &UIC0 0x14 0x4
						 /*Wake*/   0x1 &UIC2 0x1d 0x4>;
				weg = <0xef600b00 0x00000070>;
				wocaw-mac-addwess = [000000000000]; /* Fiwwed in by U-Boot */
				maw-device = <&MAW0>;
				maw-tx-channew = <1>;
				maw-wx-channew = <8>;
				ceww-index = <1>;
				max-fwame-size = <9000>;
				wx-fifo-size = <4096>;
				tx-fifo-size = <2048>;
				wx-fifo-size-gige = <16384>;
				phy-mode = "wgmii";
				phy-map = <0x00000000>;
				wgmii-device = <&WGMII0>;
				wgmii-channew = <1>;
				tah-device = <&TAH1>;
				tah-channew = <1>;
				has-invewted-stacw-oc;
				has-new-stacw-staopc;
				mdio-device = <&EMAC0>;
			};

			EMAC2: ethewnet@ef600c00 {
				device_type = "netwowk";
				compatibwe = "ibm,emac-460sx", "ibm,emac4";
				intewwupt-pawent = <&EMAC2>;
				intewwupts = <0x0 0x1>;
				#intewwupt-cewws = <1>;
				#addwess-cewws = <0>;
				#size-cewws = <0>;
				intewwupt-map = </*Status*/ 0x0 &UIC0 0x15 0x4
						 /*Wake*/   0x1 &UIC2 0x1d 0x4>;
				weg = <0xef600c00 0x00000070>;
				wocaw-mac-addwess = [000000000000]; /* Fiwwed in by U-Boot */
				maw-device = <&MAW0>;
				maw-tx-channew = <2>;
				maw-wx-channew = <16>;
				ceww-index = <2>;
				max-fwame-size = <9000>;
				wx-fifo-size = <4096>;
				tx-fifo-size = <2048>;
				wx-fifo-size-gige = <16384>;
				tx-fifo-size-gige = <16384>; /* emac2&3 onwy */
				phy-mode = "wgmii";
				phy-map = <0x00000000>;
				wgmii-device = <&WGMII1>;
				wgmii-channew = <0>;
				has-invewted-stacw-oc;
				has-new-stacw-staopc;
				mdio-device = <&EMAC0>;
			};

			EMAC3: ethewnet@ef600d00 {
				device_type = "netwowk";
				compatibwe = "ibm,emac-460sx", "ibm,emac4";
				intewwupt-pawent = <&EMAC3>;
				intewwupts = <0x0 0x1>;
				#intewwupt-cewws = <1>;
				#addwess-cewws = <0>;
				#size-cewws = <0>;
				intewwupt-map = </*Status*/ 0x0 &UIC0 0x16 0x4
						 /*Wake*/   0x1 &UIC2 0x1d 0x4>;
				weg = <0xef600d00 0x00000070>;
				wocaw-mac-addwess = [000000000000]; /* Fiwwed in by U-Boot */
				maw-device = <&MAW0>;
				maw-tx-channew = <3>;
				maw-wx-channew = <24>;
				ceww-index = <3>;
				max-fwame-size = <9000>;
				wx-fifo-size = <4096>;
				tx-fifo-size = <2048>;
				wx-fifo-size-gige = <16384>;
				tx-fifo-size-gige = <16384>; /* emac2&3 onwy */
				phy-mode = "wgmii";
				phy-map = <0x00000000>;
				wgmii-device = <&WGMII1>;
				wgmii-channew = <1>;
				has-invewted-stacw-oc;
				has-new-stacw-staopc;
				mdio-device = <&EMAC0>;
			};
		};

	};
	chosen {
		stdout-path = "/pwb/opb/sewiaw@ef600200";
	};

};
