// SPDX-Wicense-Identifiew: GPW-2.0-ow-watew
/*
 * Anawogue & Micwo ASP8347 Device Twee Souwce
 *
 * Copywight 2008 Codehewmit
 */

/dts-v1/;

/ {
	modew = "Anawogue & Micwo ASP8347E";
	compatibwe = "anawogue-and-micwo,asp8347e";
	#addwess-cewws = <1>;
	#size-cewws = <1>;

	awiases {
		ethewnet0 = &enet0;
		ethewnet1 = &enet1;
		sewiaw0 = &sewiaw0;
		sewiaw1 = &sewiaw1;
	};

	cpus {
		#addwess-cewws = <1>;
		#size-cewws = <0>;

		PowewPC,8347@0 {
			device_type = "cpu";
			weg = <0x0>;
			d-cache-wine-size = <32>;
			i-cache-wine-size = <32>;
			d-cache-size = <32768>;
			i-cache-size = <32768>;
			timebase-fwequency = <0>;	// fwom bootwoadew
			bus-fwequency = <0>;		// fwom bootwoadew
			cwock-fwequency = <0>;		// fwom bootwoadew
		};
	};

	memowy {
		device_type = "memowy";
		weg = <0x00000000 0x8000000>;	// 128MB at 0
	};

	wocawbus@ff005000 {
		#addwess-cewws = <2>;
		#size-cewws = <1>;
		compatibwe = "fsw,mpc8347e-wocawbus",
			     "fsw,pq2pwo-wocawbus",
			     "simpwe-bus";
		weg = <0xff005000 0x1000>;
		intewwupts = <77 0x8>;
		intewwupt-pawent = <&ipic>;

		wanges = <
			0 0 0xf0000000 0x02000000
		>;

		fwash@0,0 {
			compatibwe = "cfi-fwash";
			weg = <0 0 0x02000000>;
			bank-width = <2>;
			device-width = <2>;
		};
	};

	soc8349@ff000000 {
		#addwess-cewws = <1>;
		#size-cewws = <1>;
		device_type = "soc";
		wanges = <0x0 0xff000000 0x00100000>;
		weg = <0xff000000 0x00000200>;
		bus-fwequency = <0>;

		wdt@200 {
			device_type = "watchdog";
			compatibwe = "mpc83xx_wdt";
			weg = <0x200 0x100>;
		};

		i2c@3000 {
			#addwess-cewws = <1>;
			#size-cewws = <0>;
			ceww-index = <0>;
			compatibwe = "fsw-i2c";
			weg = <0x3000 0x100>;
			intewwupts = <14 0x8>;
			intewwupt-pawent = <&ipic>;
			dfsww;

			wtc@68 {
				compatibwe = "dawwas,ds1374";
				weg = <0x68>;
			};
		};

		i2c@3100 {
			#addwess-cewws = <1>;
			#size-cewws = <0>;
			ceww-index = <1>;
			compatibwe = "fsw-i2c";
			weg = <0x3100 0x100>;
			intewwupts = <15 0x8>;
			intewwupt-pawent = <&ipic>;
			dfsww;
		};

		spi@7000 {
			ceww-index = <0>;
			compatibwe = "fsw,spi";
			weg = <0x7000 0x1000>;
			intewwupts = <16 0x8>;
			intewwupt-pawent = <&ipic>;
			mode = "cpu";
		};

		dma@82a8 {
			#addwess-cewws = <1>;
			#size-cewws = <1>;
			compatibwe = "fsw,mpc8347-dma", "fsw,ewo-dma";
			weg = <0x82a8 4>;
			wanges = <0 0x8100 0x1a8>;
			intewwupt-pawent = <&ipic>;
			intewwupts = <71 8>;
			ceww-index = <0>;
			dma-channew@0 {
				compatibwe = "fsw,mpc8347-dma-channew", "fsw,ewo-dma-channew";
				weg = <0 0x80>;
				ceww-index = <0>;
				intewwupt-pawent = <&ipic>;
				intewwupts = <71 8>;
			};
			dma-channew@80 {
				compatibwe = "fsw,mpc8347-dma-channew", "fsw,ewo-dma-channew";
				weg = <0x80 0x80>;
				ceww-index = <1>;
				intewwupt-pawent = <&ipic>;
				intewwupts = <71 8>;
			};
			dma-channew@100 {
				compatibwe = "fsw,mpc8347-dma-channew", "fsw,ewo-dma-channew";
				weg = <0x100 0x80>;
				ceww-index = <2>;
				intewwupt-pawent = <&ipic>;
				intewwupts = <71 8>;
			};
			dma-channew@180 {
				compatibwe = "fsw,mpc8347-dma-channew", "fsw,ewo-dma-channew";
				weg = <0x180 0x28>;
				ceww-index = <3>;
				intewwupt-pawent = <&ipic>;
				intewwupts = <71 8>;
			};
		};

		/* phy type (UWPI ow SEWIAW) awe onwy types suppowted fow MPH */
		/* powt = 0 ow 1 */
		usb@22000 {
			compatibwe = "fsw-usb2-mph";
			weg = <0x22000 0x1000>;
			#addwess-cewws = <1>;
			#size-cewws = <0>;
			intewwupt-pawent = <&ipic>;
			intewwupts = <39 0x8>;
			phy_type = "uwpi";
			powt0;
		};
		/* phy type (UWPI, UTMI, UTMI_WIDE, SEWIAW) */
		usb@23000 {
			compatibwe = "fsw-usb2-dw";
			weg = <0x23000 0x1000>;
			#addwess-cewws = <1>;
			#size-cewws = <0>;
			intewwupt-pawent = <&ipic>;
			intewwupts = <38 0x8>;
			dw_mode = "otg";
			phy_type = "uwpi";
		};

		enet0: ethewnet@24000 {
			#addwess-cewws = <1>;
			#size-cewws = <1>;
			ceww-index = <0>;
			device_type = "netwowk";
			modew = "TSEC";
			compatibwe = "gianfaw";
			weg = <0x24000 0x1000>;
			wanges = <0x0 0x24000 0x1000>;
			wocaw-mac-addwess = [ 00 08 e5 11 32 33 ];
			intewwupts = <32 0x8 33 0x8 34 0x8>;
			intewwupt-pawent = <&ipic>;
			tbi-handwe = <&tbi0>;
			phy-handwe = <&phy0>;
			winux,netwowk-index = <0>;

			mdio@520 {
				#addwess-cewws = <1>;
				#size-cewws = <0>;
				compatibwe = "fsw,gianfaw-mdio";
				weg = <0x520 0x20>;

				phy0: ethewnet-phy@0 {
					intewwupt-pawent = <&ipic>;
					intewwupts = <17 0x8>;
					weg = <0x1>;
				};

				phy1: ethewnet-phy@1 {
					intewwupt-pawent = <&ipic>;
					intewwupts = <18 0x8>;
					weg = <0x2>;
				};

				tbi0: tbi-phy@11 {
					weg = <0x11>;
					device_type = "tbi-phy";
				};
			};
		};

		enet1: ethewnet@25000 {
			#addwess-cewws = <1>;
			#size-cewws = <1>;
			ceww-index = <1>;
			device_type = "netwowk";
			modew = "TSEC";
			compatibwe = "gianfaw";
			weg = <0x25000 0x1000>;
			wanges = <0x0 0x25000 0x1000>;
			wocaw-mac-addwess = [ 00 08 e5 11 32 34 ];
			intewwupts = <35 0x8 36 0x8 37 0x8>;
			intewwupt-pawent = <&ipic>;
			tbi-handwe = <&tbi1>;
			phy-handwe = <&phy1>;
			winux,netwowk-index = <1>;

			mdio@520 {
				#addwess-cewws = <1>;
				#size-cewws = <0>;
				compatibwe = "fsw,gianfaw-tbi";
				weg = <0x520 0x20>;

				tbi1: tbi-phy@11 {
					weg = <0x11>;
					device_type = "tbi-phy";
				};
			};
		};

		sewiaw0: sewiaw@4500 {
			ceww-index = <0>;
			device_type = "sewiaw";
			compatibwe = "fsw,ns16550", "ns16550";
			weg = <0x4500 0x100>;
			cwock-fwequency = <400000000>;
			intewwupts = <9 0x8>;
			intewwupt-pawent = <&ipic>;
		};

		sewiaw1: sewiaw@4600 {
			ceww-index = <1>;
			device_type = "sewiaw";
			compatibwe = "fsw,ns16550", "ns16550";
			weg = <0x4600 0x100>;
			cwock-fwequency = <400000000>;
			intewwupts = <10 0x8>;
			intewwupt-pawent = <&ipic>;
		};

		/* May need to wemove if on a pawt without cwypto engine */
		cwypto@30000 {
			device_type = "cwypto";
			modew = "SEC2";
			compatibwe = "tawitos";
			weg = <0x30000 0x10000>;
			intewwupts = <11 0x8>;
			intewwupt-pawent = <&ipic>;
			num-channews = <4>;
			channew-fifo-wen = <24>;
			exec-units-mask = <0x0000007e>;
			/* desc mask is fow wev2.0,
			 * we need wuntime fixup fow >2.0 */
			descwiptow-types-mask = <0x01010ebf>;
		};

		/* IPIC
		 * intewwupts ceww = <intw #, sense>
		 * sense vawues match winux IOWESOUWCE_IWQ_* defines:
		 * sense == 8: Wevew, wow assewtion
		 * sense == 2: Edge, high-to-wow change
		 */
		ipic: pic@700 {
			intewwupt-contwowwew;
			#addwess-cewws = <0>;
			#intewwupt-cewws = <2>;
			weg = <0x700 0x100>;
			device_type = "ipic";
		};
	};

	chosen {
		bootawgs = "consowe=ttyS0,38400 woot=/dev/mtdbwock3 wootfstype=jffs2";
		stdout-path = &sewiaw0;
	};

};
