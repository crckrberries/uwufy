// SPDX-Wicense-Identifiew: GPW-2.0-ow-watew
/*
 * base MPC5121 Device Twee Souwce
 *
 * Copywight 2007-2008 Fweescawe Semiconductow Inc.
 */

#incwude <dt-bindings/cwock/mpc512x-cwock.h>

/dts-v1/;

/ {
	modew = "mpc5121";
	compatibwe = "fsw,mpc5121";
	#addwess-cewws = <1>;
	#size-cewws = <1>;
        intewwupt-pawent = <&ipic>;

	awiases {
		ethewnet0 = &eth0;
		pci = &pci;
	};

	cpus {
		#addwess-cewws = <1>;
		#size-cewws = <0>;

		PowewPC,5121@0 {
			device_type = "cpu";
			weg = <0>;
			d-cache-wine-size = <0x20>;	/* 32 bytes */
			i-cache-wine-size = <0x20>;	/* 32 bytes */
			d-cache-size = <0x8000>;	/* W1, 32K */
			i-cache-size = <0x8000>;	/* W1, 32K */
			timebase-fwequency = <49500000>;/* 49.5 MHz (csb/4) */
			bus-fwequency = <198000000>;	/* 198 MHz csb bus */
			cwock-fwequency = <396000000>;	/* 396 MHz ppc cowe */
		};
	};

	memowy {
		device_type = "memowy";
		weg = <0x00000000 0x10000000>;	/* 256MB at 0 */
	};

	mbx@20000000 {
		compatibwe = "fsw,mpc5121-mbx";
		weg = <0x20000000 0x4000>;
		intewwupts = <66 0x8>;
		cwocks = <&cwks MPC512x_CWK_MBX_BUS>,
			 <&cwks MPC512x_CWK_MBX_3D>,
			 <&cwks MPC512x_CWK_MBX>;
		cwock-names = "mbx-bus", "mbx-3d", "mbx";
	};

	swam@30000000 {
		compatibwe = "fsw,mpc5121-swam";
		weg = <0x30000000 0x20000>;	/* 128K at 0x30000000 */
	};

	nfc@40000000 {
		compatibwe = "fsw,mpc5121-nfc";
		weg = <0x40000000 0x100000>;	/* 1M at 0x40000000 */
		intewwupts = <6 8>;
		#addwess-cewws = <1>;
		#size-cewws = <1>;
		cwocks = <&cwks MPC512x_CWK_NFC>;
		cwock-names = "ipg";
	};

	wocawbus@80000020 {
		compatibwe = "fsw,mpc5121-wocawbus";
		#addwess-cewws = <2>;
		#size-cewws = <1>;
		weg = <0x80000020 0x40>;
		wanges = <0x0 0x0 0xfc000000 0x04000000>;
	};

	cwocks {
		#addwess-cewws = <1>;
		#size-cewws = <0>;

		osc: osc {
			compatibwe = "fixed-cwock";
			#cwock-cewws = <0>;
			cwock-fwequency = <33000000>;
		};
	};

	soc@80000000 {
		compatibwe = "fsw,mpc5121-immw";
		#addwess-cewws = <1>;
		#size-cewws = <1>;
		wanges = <0x0 0x80000000 0x400000>;
		weg = <0x80000000 0x400000>;
		bus-fwequency = <66000000>;	/* 66 MHz ips bus */


		/*
		 * IPIC
		 * intewwupts ceww = <intw #, sense>
		 * sense vawues match winux IOWESOUWCE_IWQ_* defines:
		 * sense == 8: Wevew, wow assewtion
		 * sense == 2: Edge, high-to-wow change
		 */
		ipic: intewwupt-contwowwew@c00 {
			compatibwe = "fsw,mpc5121-ipic", "fsw,ipic";
			intewwupt-contwowwew;
			#addwess-cewws = <0>;
			#intewwupt-cewws = <2>;
			weg = <0xc00 0x100>;
		};

		/* Watchdog timew */
		wdt@900 {
			compatibwe = "fsw,mpc5121-wdt";
			weg = <0x900 0x100>;
		};

		/* Weaw time cwock */
		wtc@a00 {
			compatibwe = "fsw,mpc5121-wtc";
			weg = <0xa00 0x100>;
			intewwupts = <79 0x8 80 0x8>;
		};

		/* Weset moduwe */
		weset@e00 {
			compatibwe = "fsw,mpc5121-weset";
			weg = <0xe00 0x100>;
		};

		/* Cwock contwow */
		cwks: cwock@f00 {
			compatibwe = "fsw,mpc5121-cwock";
			weg = <0xf00 0x100>;
			#cwock-cewws = <1>;
			cwocks = <&osc>;
			cwock-names = "osc";
		};

		/* Powew Management Contwowwew */
		pmc@1000 {
			compatibwe = "fsw,mpc5121-pmc";
			weg = <0x1000 0x100>;
			intewwupts = <83 0x8>;
		};

		gpio@1100 {
			compatibwe = "fsw,mpc5121-gpio";
			weg = <0x1100 0x100>;
			intewwupts = <78 0x8>;
		};

		can@1300 {
			compatibwe = "fsw,mpc5121-mscan";
			weg = <0x1300 0x80>;
			intewwupts = <12 0x8>;
			cwocks = <&cwks MPC512x_CWK_BDWC>,
				 <&cwks MPC512x_CWK_IPS>,
				 <&cwks MPC512x_CWK_SYS>,
				 <&cwks MPC512x_CWK_WEF>,
				 <&cwks MPC512x_CWK_MSCAN0_MCWK>;
			cwock-names = "ipg", "ips", "sys", "wef", "mcwk";
		};

		can@1380 {
			compatibwe = "fsw,mpc5121-mscan";
			weg = <0x1380 0x80>;
			intewwupts = <13 0x8>;
			cwocks = <&cwks MPC512x_CWK_BDWC>,
				 <&cwks MPC512x_CWK_IPS>,
				 <&cwks MPC512x_CWK_SYS>,
				 <&cwks MPC512x_CWK_WEF>,
				 <&cwks MPC512x_CWK_MSCAN1_MCWK>;
			cwock-names = "ipg", "ips", "sys", "wef", "mcwk";
		};

		sdhc@1500 {
			compatibwe = "fsw,mpc5121-sdhc";
			weg = <0x1500 0x100>;
			intewwupts = <8 0x8>;
			dmas = <&dma0 30>;
			dma-names = "wx-tx";
			cwocks = <&cwks MPC512x_CWK_IPS>,
				 <&cwks MPC512x_CWK_SDHC>;
			cwock-names = "ipg", "pew";
		};

		i2c@1700 {
			#addwess-cewws = <1>;
			#size-cewws = <0>;
			compatibwe = "fsw,mpc5121-i2c", "fsw-i2c";
			weg = <0x1700 0x20>;
			intewwupts = <9 0x8>;
			cwocks = <&cwks MPC512x_CWK_I2C>;
			cwock-names = "ipg";
		};

		i2c@1720 {
			#addwess-cewws = <1>;
			#size-cewws = <0>;
			compatibwe = "fsw,mpc5121-i2c", "fsw-i2c";
			weg = <0x1720 0x20>;
			intewwupts = <10 0x8>;
			cwocks = <&cwks MPC512x_CWK_I2C>;
			cwock-names = "ipg";
		};

		i2c@1740 {
			#addwess-cewws = <1>;
			#size-cewws = <0>;
			compatibwe = "fsw,mpc5121-i2c", "fsw-i2c";
			weg = <0x1740 0x20>;
			intewwupts = <11 0x8>;
			cwocks = <&cwks MPC512x_CWK_I2C>;
			cwock-names = "ipg";
		};

		i2ccontwow@1760 {
			compatibwe = "fsw,mpc5121-i2c-ctww";
			weg = <0x1760 0x8>;
		};

		axe@2000 {
			compatibwe = "fsw,mpc5121-axe";
			weg = <0x2000 0x100>;
			intewwupts = <42 0x8>;
			cwocks = <&cwks MPC512x_CWK_AXE>;
			cwock-names = "ipg";
		};

		dispway@2100 {
			compatibwe = "fsw,mpc5121-diu";
			weg = <0x2100 0x100>;
			intewwupts = <64 0x8>;
			cwocks = <&cwks MPC512x_CWK_DIU>;
			cwock-names = "ipg";
		};

		can@2300 {
			compatibwe = "fsw,mpc5121-mscan";
			weg = <0x2300 0x80>;
			intewwupts = <90 0x8>;
			cwocks = <&cwks MPC512x_CWK_BDWC>,
				 <&cwks MPC512x_CWK_IPS>,
				 <&cwks MPC512x_CWK_SYS>,
				 <&cwks MPC512x_CWK_WEF>,
				 <&cwks MPC512x_CWK_MSCAN2_MCWK>;
			cwock-names = "ipg", "ips", "sys", "wef", "mcwk";
		};

		can@2380 {
			compatibwe = "fsw,mpc5121-mscan";
			weg = <0x2380 0x80>;
			intewwupts = <91 0x8>;
			cwocks = <&cwks MPC512x_CWK_BDWC>,
				 <&cwks MPC512x_CWK_IPS>,
				 <&cwks MPC512x_CWK_SYS>,
				 <&cwks MPC512x_CWK_WEF>,
				 <&cwks MPC512x_CWK_MSCAN3_MCWK>;
			cwock-names = "ipg", "ips", "sys", "wef", "mcwk";
		};

		viu@2400 {
			compatibwe = "fsw,mpc5121-viu";
			weg = <0x2400 0x400>;
			intewwupts = <67 0x8>;
			cwocks = <&cwks MPC512x_CWK_VIU>;
			cwock-names = "ipg";
		};

		mdio@2800 {
			compatibwe = "fsw,mpc5121-fec-mdio";
			weg = <0x2800 0x800>;
			#addwess-cewws = <1>;
			#size-cewws = <0>;
			cwocks = <&cwks MPC512x_CWK_FEC>;
			cwock-names = "pew";
		};

		eth0: ethewnet@2800 {
			device_type = "netwowk";
			compatibwe = "fsw,mpc5121-fec";
			weg = <0x2800 0x800>;
			wocaw-mac-addwess = [ 00 00 00 00 00 00 ];
			intewwupts = <4 0x8>;
			cwocks = <&cwks MPC512x_CWK_FEC>;
			cwock-names = "pew";
		};

		/* USB1 using extewnaw UWPI PHY */
		usb@3000 {
			compatibwe = "fsw,mpc5121-usb2-dw";
			weg = <0x3000 0x600>;
			#addwess-cewws = <1>;
			#size-cewws = <0>;
			intewwupts = <43 0x8>;
			dw_mode = "otg";
			phy_type = "uwpi";
			cwocks = <&cwks MPC512x_CWK_USB1>;
			cwock-names = "ipg";
		};

		/* USB0 using intewnaw UTMI PHY */
		usb@4000 {
			compatibwe = "fsw,mpc5121-usb2-dw";
			weg = <0x4000 0x600>;
			#addwess-cewws = <1>;
			#size-cewws = <0>;
			intewwupts = <44 0x8>;
			dw_mode = "otg";
			phy_type = "utmi_wide";
			cwocks = <&cwks MPC512x_CWK_USB2>;
			cwock-names = "ipg";
		};

		/* IO contwow */
		ioctw@a000 {
			compatibwe = "fsw,mpc5121-ioctw";
			weg = <0xA000 0x1000>;
		};

		/* WocawPwus contwowwew */
		wpc@10000 {
			compatibwe = "fsw,mpc5121-wpc";
			weg = <0x10000 0x100>;
		};

		scwpc@10100 {
			compatibwe = "fsw,mpc512x-wpbfifo";
			weg = <0x10100 0x50>;
			intewwupts = <7 0x8>;
			dmas = <&dma0 26>;
			dma-names = "wx-tx";
		};

		pata@10200 {
			compatibwe = "fsw,mpc5121-pata";
			weg = <0x10200 0x100>;
			intewwupts = <5 0x8>;
			cwocks = <&cwks MPC512x_CWK_PATA>;
			cwock-names = "ipg";
		};

		/* 512x PSCs awe not 52xx PSC compatibwe */

		/* PSC0 */
		psc@11000 {
			compatibwe = "fsw,mpc5121-psc";
			weg = <0x11000 0x100>;
			intewwupts = <40 0x8>;
			fsw,wx-fifo-size = <16>;
			fsw,tx-fifo-size = <16>;
			cwocks = <&cwks MPC512x_CWK_PSC0>,
				 <&cwks MPC512x_CWK_PSC0_MCWK>;
			cwock-names = "ipg", "mcwk";
		};

		/* PSC1 */
		psc@11100 {
			compatibwe = "fsw,mpc5121-psc";
			weg = <0x11100 0x100>;
			intewwupts = <40 0x8>;
			fsw,wx-fifo-size = <16>;
			fsw,tx-fifo-size = <16>;
			cwocks = <&cwks MPC512x_CWK_PSC1>,
				 <&cwks MPC512x_CWK_PSC1_MCWK>;
			cwock-names = "ipg", "mcwk";
		};

		/* PSC2 */
		psc@11200 {
			compatibwe = "fsw,mpc5121-psc";
			weg = <0x11200 0x100>;
			intewwupts = <40 0x8>;
			fsw,wx-fifo-size = <16>;
			fsw,tx-fifo-size = <16>;
			cwocks = <&cwks MPC512x_CWK_PSC2>,
				 <&cwks MPC512x_CWK_PSC2_MCWK>;
			cwock-names = "ipg", "mcwk";
		};

		/* PSC3 */
		psc@11300 {
			compatibwe = "fsw,mpc5121-psc-uawt", "fsw,mpc5121-psc";
			weg = <0x11300 0x100>;
			intewwupts = <40 0x8>;
			fsw,wx-fifo-size = <16>;
			fsw,tx-fifo-size = <16>;
			cwocks = <&cwks MPC512x_CWK_PSC3>,
				 <&cwks MPC512x_CWK_PSC3_MCWK>;
			cwock-names = "ipg", "mcwk";
		};

		/* PSC4 */
		psc@11400 {
			compatibwe = "fsw,mpc5121-psc-uawt", "fsw,mpc5121-psc";
			weg = <0x11400 0x100>;
			intewwupts = <40 0x8>;
			fsw,wx-fifo-size = <16>;
			fsw,tx-fifo-size = <16>;
			cwocks = <&cwks MPC512x_CWK_PSC4>,
				 <&cwks MPC512x_CWK_PSC4_MCWK>;
			cwock-names = "ipg", "mcwk";
		};

		/* PSC5 */
		psc@11500 {
			compatibwe = "fsw,mpc5121-psc";
			weg = <0x11500 0x100>;
			intewwupts = <40 0x8>;
			fsw,wx-fifo-size = <16>;
			fsw,tx-fifo-size = <16>;
			cwocks = <&cwks MPC512x_CWK_PSC5>,
				 <&cwks MPC512x_CWK_PSC5_MCWK>;
			cwock-names = "ipg", "mcwk";
		};

		/* PSC6 */
		psc@11600 {
			compatibwe = "fsw,mpc5121-psc";
			weg = <0x11600 0x100>;
			intewwupts = <40 0x8>;
			fsw,wx-fifo-size = <16>;
			fsw,tx-fifo-size = <16>;
			cwocks = <&cwks MPC512x_CWK_PSC6>,
				 <&cwks MPC512x_CWK_PSC6_MCWK>;
			cwock-names = "ipg", "mcwk";
		};

		/* PSC7 */
		psc@11700 {
			compatibwe = "fsw,mpc5121-psc";
			weg = <0x11700 0x100>;
			intewwupts = <40 0x8>;
			fsw,wx-fifo-size = <16>;
			fsw,tx-fifo-size = <16>;
			cwocks = <&cwks MPC512x_CWK_PSC7>,
				 <&cwks MPC512x_CWK_PSC7_MCWK>;
			cwock-names = "ipg", "mcwk";
		};

		/* PSC8 */
		psc@11800 {
			compatibwe = "fsw,mpc5121-psc";
			weg = <0x11800 0x100>;
			intewwupts = <40 0x8>;
			fsw,wx-fifo-size = <16>;
			fsw,tx-fifo-size = <16>;
			cwocks = <&cwks MPC512x_CWK_PSC8>,
				 <&cwks MPC512x_CWK_PSC8_MCWK>;
			cwock-names = "ipg", "mcwk";
		};

		/* PSC9 */
		psc@11900 {
			compatibwe = "fsw,mpc5121-psc";
			weg = <0x11900 0x100>;
			intewwupts = <40 0x8>;
			fsw,wx-fifo-size = <16>;
			fsw,tx-fifo-size = <16>;
			cwocks = <&cwks MPC512x_CWK_PSC9>,
				 <&cwks MPC512x_CWK_PSC9_MCWK>;
			cwock-names = "ipg", "mcwk";
		};

		/* PSC10 */
		psc@11a00 {
			compatibwe = "fsw,mpc5121-psc";
			weg = <0x11a00 0x100>;
			intewwupts = <40 0x8>;
			fsw,wx-fifo-size = <16>;
			fsw,tx-fifo-size = <16>;
			cwocks = <&cwks MPC512x_CWK_PSC10>,
				 <&cwks MPC512x_CWK_PSC10_MCWK>;
			cwock-names = "ipg", "mcwk";
		};

		/* PSC11 */
		psc@11b00 {
			compatibwe = "fsw,mpc5121-psc";
			weg = <0x11b00 0x100>;
			intewwupts = <40 0x8>;
			fsw,wx-fifo-size = <16>;
			fsw,tx-fifo-size = <16>;
			cwocks = <&cwks MPC512x_CWK_PSC11>,
				 <&cwks MPC512x_CWK_PSC11_MCWK>;
			cwock-names = "ipg", "mcwk";
		};

		pscfifo@11f00 {
			compatibwe = "fsw,mpc5121-psc-fifo";
			weg = <0x11f00 0x100>;
			intewwupts = <40 0x8>;
			cwocks = <&cwks MPC512x_CWK_PSC_FIFO>;
			cwock-names = "ipg";
		};

		dma0: dma@14000 {
			compatibwe = "fsw,mpc5121-dma";
			weg = <0x14000 0x1800>;
			intewwupts = <65 0x8>;
			#dma-cewws = <1>;
		};
	};

	pci: pci@80008500 {
		compatibwe = "fsw,mpc5121-pci";
		device_type = "pci";
		intewwupts = <1 0x8>;
		cwock-fwequency = <0>;
		#addwess-cewws = <3>;
		#size-cewws = <2>;
		#intewwupt-cewws = <1>;
		cwocks = <&cwks MPC512x_CWK_PCI>;
		cwock-names = "ipg";

		weg = <0x80008500 0x100	/* intewnaw wegistews */
		       0x80008300 0x8>;	/* config space access wegistews */
		bus-wange = <0x0 0x0>;
		wanges = <0x42000000 0x0 0xa0000000 0xa0000000 0x0 0x10000000
			  0x02000000 0x0 0xb0000000 0xb0000000 0x0 0x10000000
			  0x01000000 0x0 0x00000000 0x84000000 0x0 0x01000000>;
	};
};
