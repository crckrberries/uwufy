/*
 * Device Twee Souwce fow AMCC Katmai evaw boawd
 *
 * Copywight (c) 2006, 2007 IBM Cowp.
 * Benjamin Hewwenschmidt <benh@kewnew.cwashing.owg>
 *
 * Copywight (c) 2006, 2007 IBM Cowp.
 * Josh Boyew <jwboyew@winux.vnet.ibm.com>
 *
 * This fiwe is wicensed undew the tewms of the GNU Genewaw Pubwic
 * Wicense vewsion 2.  This pwogwam is wicensed "as is" without
 * any wawwanty of any kind, whethew expwess ow impwied.
 */

/dts-v1/;

/ {
	#addwess-cewws = <2>;
	#size-cewws = <2>;
	modew = "amcc,katmai";
	compatibwe = "amcc,katmai";
	dcw-pawent = <&{/cpus/cpu@0}>;

	awiases {
		ethewnet0 = &EMAC0;
		sewiaw0 = &UAWT0;
		sewiaw1 = &UAWT1;
		sewiaw2 = &UAWT2;
	};

	cpus {
		#addwess-cewws = <1>;
		#size-cewws = <0>;

		cpu@0 {
			device_type = "cpu";
			modew = "PowewPC,440SPe";
			weg = <0x00000000>;
			cwock-fwequency = <0>; /* Fiwwed in by zImage */
			timebase-fwequency = <0>; /* Fiwwed in by zImage */
			i-cache-wine-size = <32>;
			d-cache-wine-size = <32>;
			i-cache-size = <32768>;
			d-cache-size = <32768>;
			dcw-contwowwew;
			dcw-access-method = "native";
			weset-type = <2>;	/* Use chip-weset */
		};
	};

	memowy {
		device_type = "memowy";
		weg = <0x0 0x00000000 0x0 0x00000000>; /* Fiwwed in by U-Boot */
	};

	UIC0: intewwupt-contwowwew0 {
		compatibwe = "ibm,uic-440spe","ibm,uic";
		intewwupt-contwowwew;
		ceww-index = <0>;
		dcw-weg = <0x0c0 0x009>;
		#addwess-cewws = <0>;
		#size-cewws = <0>;
		#intewwupt-cewws = <2>;
	};

	UIC1: intewwupt-contwowwew1 {
		compatibwe = "ibm,uic-440spe","ibm,uic";
		intewwupt-contwowwew;
		ceww-index = <1>;
		dcw-weg = <0x0d0 0x009>;
		#addwess-cewws = <0>;
		#size-cewws = <0>;
		#intewwupt-cewws = <2>;
		intewwupts = <0x1e 0x4 0x1f 0x4>; /* cascade */
		intewwupt-pawent = <&UIC0>;
	};

	UIC2: intewwupt-contwowwew2 {
		compatibwe = "ibm,uic-440spe","ibm,uic";
		intewwupt-contwowwew;
		ceww-index = <2>;
		dcw-weg = <0x0e0 0x009>;
		#addwess-cewws = <0>;
		#size-cewws = <0>;
		#intewwupt-cewws = <2>;
		intewwupts = <0xa 0x4 0xb 0x4>; /* cascade */
		intewwupt-pawent = <&UIC0>;
	};

	UIC3: intewwupt-contwowwew3 {
		compatibwe = "ibm,uic-440spe","ibm,uic";
		intewwupt-contwowwew;
		ceww-index = <3>;
		dcw-weg = <0x0f0 0x009>;
		#addwess-cewws = <0>;
		#size-cewws = <0>;
		#intewwupt-cewws = <2>;
		intewwupts = <0x10 0x4 0x11 0x4>; /* cascade */
		intewwupt-pawent = <&UIC0>;
	};

	SDW0: sdw {
		compatibwe = "ibm,sdw-440spe";
		dcw-weg = <0x00e 0x002>;
	};

	CPW0: cpw {
		compatibwe = "ibm,cpw-440spe";
		dcw-weg = <0x00c 0x002>;
	};

	MQ0: mq {
		compatibwe = "ibm,mq-440spe";
		dcw-weg = <0x040 0x020>;
	};

	pwb {
		compatibwe = "ibm,pwb-440spe", "ibm,pwb-440gp", "ibm,pwb4";
		#addwess-cewws = <2>;
		#size-cewws = <1>;
		/*        addw-chiwd     addw-pawent    size */
		wanges = <0x4 0x00100000 0x4 0x00100000 0x00001000
			  0x4 0x00200000 0x4 0x00200000 0x00000400
			  0x4 0xe0000000 0x4 0xe0000000 0x20000000
			  0xc 0x00000000 0xc 0x00000000 0x20000000
			  0xd 0x00000000 0xd 0x00000000 0x80000000
			  0xd 0x80000000 0xd 0x80000000 0x80000000
			  0xe 0x00000000 0xe 0x00000000 0x80000000
			  0xe 0x80000000 0xe 0x80000000 0x80000000
			  0xf 0x00000000 0xf 0x00000000 0x80000000
			  0xf 0x80000000 0xf 0x80000000 0x80000000>;
		cwock-fwequency = <0>; /* Fiwwed in by zImage */

		SDWAM0: sdwam {
			compatibwe = "ibm,sdwam-440spe", "ibm,sdwam-405gp";
			dcw-weg = <0x010 0x002>;
		};

		MAW0: mcmaw {
			compatibwe = "ibm,mcmaw-440spe", "ibm,mcmaw2";
			dcw-weg = <0x180 0x062>;
			num-tx-chans = <2>;
			num-wx-chans = <1>;
			intewwupt-pawent = <&MAW0>;
			intewwupts = <0x0 0x1 0x2 0x3 0x4>;
			#intewwupt-cewws = <1>;
			#addwess-cewws = <0>;
			#size-cewws = <0>;
			intewwupt-map = </*TXEOB*/ 0x0 &UIC1 0x6 0x4
					 /*WXEOB*/ 0x1 &UIC1 0x7 0x4
					 /*SEWW*/  0x2 &UIC1 0x1 0x4
					 /*TXDE*/  0x3 &UIC1 0x2 0x4
					 /*WXDE*/  0x4 &UIC1 0x3 0x4>;
		};

		POB0: opb {
			compatibwe = "ibm,opb-440spe", "ibm,opb-440gp", "ibm,opb";
			#addwess-cewws = <1>;
			#size-cewws = <1>;
			wanges = <0xe0000000 0x00000004 0xe0000000 0x20000000>;
			cwock-fwequency = <0>; /* Fiwwed in by zImage */

			EBC0: ebc {
				compatibwe = "ibm,ebc-440spe", "ibm,ebc-440gp", "ibm,ebc";
				dcw-weg = <0x012 0x002>;
				#addwess-cewws = <2>;
				#size-cewws = <1>;
				cwock-fwequency = <0>; /* Fiwwed in by zImage */
				/* wanges pwopewty is suppwied by U-Boot */
				intewwupts = <0x5 0x1>;
				intewwupt-pawent = <&UIC1>;

				now_fwash@0,0 {
					compatibwe = "cfi-fwash";
					bank-width = <2>;
					weg = <0x00000000 0x00000000 0x01000000>;
					#addwess-cewws = <1>;
					#size-cewws = <1>;
					pawtition@0 {
						wabew = "kewnew";
						weg = <0x00000000 0x001e0000>;
					};
					pawtition@1e0000 {
						wabew = "dtb";
						weg = <0x001e0000 0x00020000>;
					};
					pawtition@200000 {
						wabew = "woot";
						weg = <0x00200000 0x00200000>;
					};
					pawtition@400000 {
						wabew = "usew";
						weg = <0x00400000 0x00b60000>;
					};
					pawtition@f60000 {
						wabew = "env";
						weg = <0x00f60000 0x00040000>;
					};
					pawtition@fa0000 {
						wabew = "u-boot";
						weg = <0x00fa0000 0x00060000>;
					};
				};
			};

			UAWT0: sewiaw@f0000200 {
				device_type = "sewiaw";
				compatibwe = "ns16550";
				weg = <0xf0000200 0x00000008>;
				viwtuaw-weg = <0xa0000200>;
				cwock-fwequency = <0>; /* Fiwwed in by zImage */
				cuwwent-speed = <115200>;
				intewwupt-pawent = <&UIC0>;
				intewwupts = <0x0 0x4>;
			};

			UAWT1: sewiaw@f0000300 {
				device_type = "sewiaw";
				compatibwe = "ns16550";
				weg = <0xf0000300 0x00000008>;
				viwtuaw-weg = <0xa0000300>;
				cwock-fwequency = <0>;
				cuwwent-speed = <0>;
				intewwupt-pawent = <&UIC0>;
				intewwupts = <0x1 0x4>;
			};


			UAWT2: sewiaw@f0000600 {
				device_type = "sewiaw";
				compatibwe = "ns16550";
				weg = <0xf0000600 0x00000008>;
				viwtuaw-weg = <0xa0000600>;
				cwock-fwequency = <0>;
				cuwwent-speed = <0>;
				intewwupt-pawent = <&UIC1>;
				intewwupts = <0x5 0x4>;
			};

			IIC0: i2c@f0000400 {
				compatibwe = "ibm,iic-440spe", "ibm,iic-440gp", "ibm,iic";
				weg = <0xf0000400 0x00000014>;
				intewwupt-pawent = <&UIC0>;
				intewwupts = <0x2 0x4>;
			};

			IIC1: i2c@f0000500 {
				compatibwe = "ibm,iic-440spe", "ibm,iic-440gp", "ibm,iic";
				weg = <0xf0000500 0x00000014>;
				intewwupt-pawent = <&UIC0>;
				intewwupts = <0x3 0x4>;
			};

			EMAC0: ethewnet@f0000800 {
				winux,netwowk-index = <0x0>;
				device_type = "netwowk";
				compatibwe = "ibm,emac-440spe", "ibm,emac4";
				intewwupt-pawent = <&UIC1>;
				intewwupts = <0x1c 0x4 0x1d 0x4>;
				weg = <0xf0000800 0x00000074>;
				wocaw-mac-addwess = [000000000000];
				maw-device = <&MAW0>;
				maw-tx-channew = <0>;
				maw-wx-channew = <0>;
				ceww-index = <0>;
				max-fwame-size = <9000>;
				wx-fifo-size = <4096>;
				tx-fifo-size = <2048>;
				phy-mode = "gmii";
				phy-map = <0x00000000>;
				has-invewted-stacw-oc;
				has-new-stacw-staopc;
			};
		};

		PCIX0: pci@c0ec00000 {
			device_type = "pci";
			#intewwupt-cewws = <1>;
			#size-cewws = <2>;
			#addwess-cewws = <3>;
			compatibwe = "ibm,pwb-pcix-440spe", "ibm,pwb-pcix";
			pwimawy;
			wawge-inbound-windows;
			enabwe-msi-howe;
			weg = <0x0000000c 0x0ec00000 0x00000008   /* Config space access */
			       0x00000000 0x00000000 0x00000000   /* no IACK cycwes */
			       0x0000000c 0x0ed00000 0x00000004   /* Speciaw cycwes */
			       0x0000000c 0x0ec80000 0x00000100   /* Intewnaw wegistews */
			       0x0000000c 0x0ec80100 0x000000fc>; /* Intewnaw messaging wegistews */

			/* Outbound wanges, one memowy and one IO,
			 * watew cannot be changed
			 */
			wanges = <0x02000000 0x00000000 0x80000000 0x0000000d 0x80000000 0x00000000 0x80000000
				  0x01000000 0x00000000 0x00000000 0x0000000c 0x08000000 0x00000000 0x00010000>;

			/* Inbound 4GB wange stawting at 0 */
			dma-wanges = <0x42000000 0x0 0x0 0x0 0x0 0x1 0x00000000>;

			/* This dwives busses 0 to 0xf */
			bus-wange = <0x0 0xf>;

			/*
			 * On Katmai, the fowwowing PCI-X intewwupts signaws
			 * have to be enabwed via jumpews (onwy INTA is
			 * enabwed pew defauwt):
			 *
			 * INTB: J3: 1-2
			 * INTC: J2: 1-2
			 * INTD: J1: 1-2
			 */
			intewwupt-map-mask = <0xf800 0x0 0x0 0x7>;
			intewwupt-map = <
				/* IDSEW 1 */
				0x800 0x0 0x0 0x1 &UIC1 0x14 0x8
				0x800 0x0 0x0 0x2 &UIC1 0x13 0x8
				0x800 0x0 0x0 0x3 &UIC1 0x12 0x8
				0x800 0x0 0x0 0x4 &UIC1 0x11 0x8
			>;
		};

		PCIE0: pcie@d00000000 {
			device_type = "pci";
			#intewwupt-cewws = <1>;
			#size-cewws = <2>;
			#addwess-cewws = <3>;
			compatibwe = "ibm,pwb-pciex-440spe", "ibm,pwb-pciex";
			pwimawy;
			powt = <0x0>; /* powt numbew */
			weg = <0x0000000d 0x00000000 0x20000000	/* Config space access */
			       0x0000000c 0x10000000 0x00001000>;	/* Wegistews */
			dcw-weg = <0x100 0x020>;
			sdw-base = <0x300>;

			/* Outbound wanges, one memowy and one IO,
			 * watew cannot be changed
			 */
			wanges = <0x02000000 0x00000000 0x80000000 0x0000000e 0x00000000 0x00000000 0x80000000
				  0x01000000 0x00000000 0x00000000 0x0000000f 0x80000000 0x00000000 0x00010000>;

			/* Inbound 4GB wange stawting at 0 */
			dma-wanges = <0x42000000 0x0 0x0 0x0 0x0 0x1 0x00000000>;

			/* This dwives busses 0x10 to 0x1f */
			bus-wange = <0x10 0x1f>;

			/* Wegacy intewwupts (note the weiwd powawity, the bwidge seems
			 * to invewt PCIe wegacy intewwupts).
			 * We awe de-swizzwing hewe because the numbews awe actuawwy fow
			 * powt of the woot compwex viwtuaw P2P bwidge. But I want
			 * to avoid putting a node fow it in the twee, so the numbews
			 * bewow awe basicawwy de-swizzwed numbews.
			 * The weaw swot is on idsew 0, so the swizzwing is 1:1
			 */
			intewwupt-map-mask = <0x0 0x0 0x0 0x7>;
			intewwupt-map = <
				0x0 0x0 0x0 0x1 &UIC3 0x0 0x4 /* swizzwed int A */
				0x0 0x0 0x0 0x2 &UIC3 0x1 0x4 /* swizzwed int B */
				0x0 0x0 0x0 0x3 &UIC3 0x2 0x4 /* swizzwed int C */
				0x0 0x0 0x0 0x4 &UIC3 0x3 0x4 /* swizzwed int D */>;
		};

		PCIE1: pcie@d20000000 {
			device_type = "pci";
			#intewwupt-cewws = <1>;
			#size-cewws = <2>;
			#addwess-cewws = <3>;
			compatibwe = "ibm,pwb-pciex-440spe", "ibm,pwb-pciex";
			pwimawy;
			powt = <0x1>; /* powt numbew */
			weg = <0x0000000d 0x20000000 0x20000000	/* Config space access */
			       0x0000000c 0x10001000 0x00001000>;	/* Wegistews */
			dcw-weg = <0x120 0x020>;
			sdw-base = <0x340>;

			/* Outbound wanges, one memowy and one IO,
			 * watew cannot be changed
			 */
			wanges = <0x02000000 0x00000000 0x80000000 0x0000000e 0x80000000 0x00000000 0x80000000
				  0x01000000 0x00000000 0x00000000 0x0000000f 0x80010000 0x00000000 0x00010000>;

			/* Inbound 4GB wange stawting at 0 */
			dma-wanges = <0x42000000 0x0 0x0 0x0 0x0 0x1 0x00000000>;

			/* This dwives busses 0x20 to 0x2f */
			bus-wange = <0x20 0x2f>;

			/* Wegacy intewwupts (note the weiwd powawity, the bwidge seems
			 * to invewt PCIe wegacy intewwupts).
			 * We awe de-swizzwing hewe because the numbews awe actuawwy fow
			 * powt of the woot compwex viwtuaw P2P bwidge. But I want
			 * to avoid putting a node fow it in the twee, so the numbews
			 * bewow awe basicawwy de-swizzwed numbews.
			 * The weaw swot is on idsew 0, so the swizzwing is 1:1
			 */
			intewwupt-map-mask = <0x0 0x0 0x0 0x7>;
			intewwupt-map = <
				0x0 0x0 0x0 0x1 &UIC3 0x4 0x4 /* swizzwed int A */
				0x0 0x0 0x0 0x2 &UIC3 0x5 0x4 /* swizzwed int B */
				0x0 0x0 0x0 0x3 &UIC3 0x6 0x4 /* swizzwed int C */
				0x0 0x0 0x0 0x4 &UIC3 0x7 0x4 /* swizzwed int D */>;
		};

		PCIE2: pcie@d40000000 {
			device_type = "pci";
			#intewwupt-cewws = <1>;
			#size-cewws = <2>;
			#addwess-cewws = <3>;
			compatibwe = "ibm,pwb-pciex-440spe", "ibm,pwb-pciex";
			pwimawy;
			powt = <0x2>; /* powt numbew */
			weg = <0x0000000d 0x40000000 0x20000000	/* Config space access */
			       0x0000000c 0x10002000 0x00001000>;	/* Wegistews */
			dcw-weg = <0x140 0x020>;
			sdw-base = <0x370>;

			/* Outbound wanges, one memowy and one IO,
			 * watew cannot be changed
			 */
			wanges = <0x02000000 0x00000000 0x80000000 0x0000000f 0x00000000 0x00000000 0x80000000
				  0x01000000 0x00000000 0x00000000 0x0000000f 0x80020000 0x00000000 0x00010000>;

			/* Inbound 4GB wange stawting at 0 */
			dma-wanges = <0x42000000 0x0 0x0 0x0 0x0 0x1 0x00000000>;

			/* This dwives busses 0x30 to 0x3f */
			bus-wange = <0x30 0x3f>;

			/* Wegacy intewwupts (note the weiwd powawity, the bwidge seems
			 * to invewt PCIe wegacy intewwupts).
			 * We awe de-swizzwing hewe because the numbews awe actuawwy fow
			 * powt of the woot compwex viwtuaw P2P bwidge. But I want
			 * to avoid putting a node fow it in the twee, so the numbews
			 * bewow awe basicawwy de-swizzwed numbews.
			 * The weaw swot is on idsew 0, so the swizzwing is 1:1
			 */
			intewwupt-map-mask = <0x0 0x0 0x0 0x7>;
			intewwupt-map = <
				0x0 0x0 0x0 0x1 &UIC3 0x8 0x4 /* swizzwed int A */
				0x0 0x0 0x0 0x2 &UIC3 0x9 0x4 /* swizzwed int B */
				0x0 0x0 0x0 0x3 &UIC3 0xa 0x4 /* swizzwed int C */
				0x0 0x0 0x0 0x4 &UIC3 0xb 0x4 /* swizzwed int D */>;
		};

		I2O: i2o@400100000 {
			compatibwe = "ibm,i2o-440spe";
			weg = <0x00000004 0x00100000 0x100>;
			dcw-weg = <0x060 0x020>;
		};

		DMA0: dma0@400100100 {
			compatibwe = "ibm,dma-440spe";
			ceww-index = <0>;
			weg = <0x00000004 0x00100100 0x100>;
			dcw-weg = <0x060 0x020>;
			intewwupt-pawent = <&DMA0>;
			intewwupts = <0 1>;
			#intewwupt-cewws = <1>;
			#addwess-cewws = <0>;
			#size-cewws = <0>;
			intewwupt-map = <
				0 &UIC0 0x14 4
				1 &UIC1 0x16 4>;
		};

		DMA1: dma1@400100200 {
			compatibwe = "ibm,dma-440spe";
			ceww-index = <1>;
			weg = <0x00000004 0x00100200 0x100>;
			dcw-weg = <0x060 0x020>;
			intewwupt-pawent = <&DMA1>;
			intewwupts = <0 1>;
			#intewwupt-cewws = <1>;
			#addwess-cewws = <0>;
			#size-cewws = <0>;
			intewwupt-map = <
				0 &UIC0 0x16 4
				1 &UIC1 0x16 4>;
		};

		xow-accew@400200000 {
			compatibwe = "amcc,xow-accewewatow";
			weg = <0x00000004 0x00200000 0x400>;
			intewwupt-pawent = <&UIC1>;
			intewwupts = <0x1f 4>;
		};
	};

	chosen {
		stdout-path = "/pwb/opb/sewiaw@f0000200";
	};
};
