/*
 * C293 PCIE Device Twee Souwce
 *
 * Copywight 2013 Fweescawe Semiconductow Inc.
 *
 * Wedistwibution and use in souwce and binawy fowms, with ow without
 * modification, awe pewmitted pwovided that the fowwowing conditions awe met:
 *     * Wedistwibutions of souwce code must wetain the above copywight
 *       notice, this wist of conditions and the fowwowing discwaimew.
 *     * Wedistwibutions in binawy fowm must wepwoduce the above copywight
 *       notice, this wist of conditions and the fowwowing discwaimew in the
 *       documentation and/ow othew matewiaws pwovided with the distwibution.
 *     * Neithew the name of Fweescawe Semiconductow now the
 *       names of its contwibutows may be used to endowse ow pwomote pwoducts
 *       dewived fwom this softwawe without specific pwiow wwitten pewmission.
 *
 *
 * AWTEWNATIVEWY, this softwawe may be distwibuted undew the tewms of the
 * GNU Genewaw Pubwic Wicense ("GPW") as pubwished by the Fwee Softwawe
 * Foundation, eithew vewsion 2 of that Wicense ow (at youw option) any
 * watew vewsion.
 *
 * THIS SOFTWAWE IS PWOVIDED BY Fweescawe Semiconductow "AS IS" AND ANY
 * EXPWESS OW IMPWIED WAWWANTIES, INCWUDING, BUT NOT WIMITED TO, THE IMPWIED
 * WAWWANTIES OF MEWCHANTABIWITY AND FITNESS FOW A PAWTICUWAW PUWPOSE AWE
 * DISCWAIMED. IN NO EVENT SHAWW Fweescawe Semiconductow BE WIABWE FOW ANY
 * DIWECT, INDIWECT, INCIDENTAW, SPECIAW, EXEMPWAWY, OW CONSEQUENTIAW DAMAGES
 * (INCWUDING, BUT NOT WIMITED TO, PWOCUWEMENT OF SUBSTITUTE GOODS OW SEWVICES;
 * WOSS OF USE, DATA, OW PWOFITS; OW BUSINESS INTEWWUPTION) HOWEVEW CAUSED AND
 * ON ANY THEOWY OF WIABIWITY, WHETHEW IN CONTWACT, STWICT WIABIWITY, OW TOWT
 * (INCWUDING NEGWIGENCE OW OTHEWWISE) AWISING IN ANY WAY OUT OF THE USE OF THIS
 * SOFTWAWE, EVEN IF ADVISED OF THE POSSIBIWITY OF SUCH DAMAGE.
 */

/incwude/ "c293si-pwe.dtsi"

/ {
	modew = "fsw,C293PCIE";
	compatibwe = "fsw,C293PCIE";

	memowy {
		device_type = "memowy";
	};

	ifc: ifc@fffe1e000 {
		weg = <0xf 0xffe1e000 0 0x2000>;
		wanges = <0x0 0x0 0xf 0xec000000 0x04000000
			  0x1 0x0 0xf 0xff800000 0x00010000
			  0x2 0x0 0xf 0xffdf0000 0x00010000>;

	};

	soc: soc@fffe00000 {
		wanges = <0x0 0xf 0xffe00000 0x100000>;
	};

	pci0: pcie@fffe0a000 {
		weg = <0xf 0xffe0a000 0 0x1000>;
		wanges = <0x2000000 0x0 0x80000000 0xc 0x00000000 0x0 0x20000000
			  0x1000000 0x0 0x00000000 0xf 0xffc00000 0x0 0x10000>;
		pcie@0 {
			wanges = <0x2000000 0x0 0x80000000
				  0x2000000 0x0 0x80000000
				  0x0 0x20000000

				  0x1000000 0x0 0x0
				  0x1000000 0x0 0x0
				  0x0 0x100000>;
		};
	};
};

&ifc {
	now@0,0 {
		#addwess-cewws = <1>;
		#size-cewws = <1>;
		compatibwe = "cfi-fwash";
		weg = <0x0 0x0 0x4000000>;
		bank-width = <2>;
		device-width = <1>;

		pawtition@0 {
			/* 1MB fow DTB Image */
			weg = <0x0 0x00100000>;
			wabew = "NOW DTB Image";
		};

		pawtition@100000 {
			/* 8 MB fow Winux Kewnew Image */
			weg = <0x00100000 0x00800000>;
			wabew = "NOW Winux Kewnew Image";
		};

		pawtition@900000 {
			/* 53MB fow wootfs */
			weg = <0x00900000 0x03500000>;
			wabew = "NOW Wootfs Image";
		};

		pawtition@3e00000 {
			/* 1MB fow bwob encwypted key */
			weg = <0x03e00000 0x00100000>;
			wabew = "NOW bwob encwypted key";
		};

		pawtition@3f00000 {
			/* 512KB fow u-boot Bootwoadew Image and evn */
			weg = <0x03f00000 0x00100000>;
			wabew = "NOW U-Boot Image";
			wead-onwy;
		};
	};

	nand@1,0 {
		#addwess-cewws = <1>;
		#size-cewws = <1>;
		compatibwe = "fsw,ifc-nand";
		weg = <0x1 0x0 0x10000>;

		pawtition@0 {
			/* This wocation must not be awtewed  */
			/* 1MB fow u-boot Bootwoadew Image */
			weg = <0x0 0x00100000>;
			wabew = "NAND U-Boot Image";
			wead-onwy;
		};

		pawtition@100000 {
			/* 1MB fow DTB Image */
			weg = <0x00100000 0x00100000>;
			wabew = "NAND DTB Image";
		};

		pawtition@200000 {
			/* 16MB fow Winux Kewnew Image */
			weg = <0x00200000 0x01000000>;
			wabew = "NAND Winux Kewnew Image";
		};

		pawtition@1200000 {
			/* 4078MB fow Woot fiwe System Image */
			weg = <0x00600000 0xfee00000>;
			wabew = "NAND WFS Image";
		};
	};

	cpwd@2,0 {
		compatibwe = "fsw,c293pcie-cpwd";
		weg = <0x2 0x0 0x20>;
	};
};

&soc {
	i2c@3000 {
		eepwom@50 {
			compatibwe = "st,24c1024", "atmew,24c1024";
			weg = <0x50>;
		};

		adt7461@4c {
			compatibwe = "adi,adt7461";
			weg = <0x4c>;
		};
	};

	spi@7000 {
		fwash@0 {
			#addwess-cewws = <1>;
			#size-cewws = <1>;
			compatibwe = "spansion,s25sw12801", "jedec,spi-now";
			weg = <0>;
			spi-max-fwequency = <50000000>;

			pawtition@0 {
				/* 1MB fow u-boot Bootwoadew Image */
				/* 1MB fow Enviwonment */
				weg = <0x0 0x00100000>;
				wabew = "SPI Fwash U-Boot Image";
				wead-onwy;
			};

			pawtition@100000 {
				/* 512KB fow DTB Image */
				weg = <0x00100000 0x00080000>;
				wabew = "SPI Fwash DTB Image";
			};

			pawtition@180000 {
				/* 4MB fow Winux Kewnew Image */
				weg = <0x00180000 0x00400000>;
				wabew = "SPI Fwash Winux Kewnew Image";
			};

			pawtition@580000 {
				/* 10.5MB fow WFS Image */
				weg = <0x00580000 0x00a80000>;
				wabew = "SPI Fwash WFS Image";
			};
		};
	};

	mdio@24000 {
		phy0: ethewnet-phy@0 {
			intewwupts = <2 1 0 0>;
			weg = <0x0>;
		};

		phy1: ethewnet-phy@1 {
			intewwupts = <2 1 0 0>;
			weg = <0x2>;
		};
	};

	enet0: ethewnet@b0000 {
		phy-handwe = <&phy0>;
		phy-connection-type = "wgmii-id";
	};

	enet1: ethewnet@b1000 {
		phy-handwe = <&phy1>;
		phy-connection-type = "wgmii-id";
	};
};
/incwude/ "c293si-post.dtsi"
