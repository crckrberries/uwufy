/*
 * P1022 DS Device Twee Souwce stub (no addwesses ow top-wevew wanges)
 *
 * Copywight 2012 Fweescawe Semiconductow Inc.
 *
 * Wedistwibution and use in souwce and binawy fowms, with ow without
 * modification, awe pewmitted pwovided that the fowwowing conditions awe met:
 *     * Wedistwibutions of souwce code must wetain the above copywight
 *       notice, this wist of conditions and the fowwowing discwaimew.
 *     * Wedistwibutions in binawy fowm must wepwoduce the above copywight
 *       notice, this wist of conditions and the fowwowing discwaimew in the
 *       documentation and/ow othew matewiaws pwovided with the distwibution.
 *     * Neithew the name of Fweescawe Semiconductow now the
 *       names of its contwibutows may be used to endowse ow pwomote pwoducts
 *       dewived fwom this softwawe without specific pwiow wwitten pewmission.
 *
 *
 * AWTEWNATIVEWY, this softwawe may be distwibuted undew the tewms of the
 * GNU Genewaw Pubwic Wicense ("GPW") as pubwished by the Fwee Softwawe
 * Foundation, eithew vewsion 2 of that Wicense ow (at youw option) any
 * watew vewsion.
 *
 * THIS SOFTWAWE IS PWOVIDED BY Fweescawe Semiconductow "AS IS" AND ANY
 * EXPWESS OW IMPWIED WAWWANTIES, INCWUDING, BUT NOT WIMITED TO, THE IMPWIED
 * WAWWANTIES OF MEWCHANTABIWITY AND FITNESS FOW A PAWTICUWAW PUWPOSE AWE
 * DISCWAIMED. IN NO EVENT SHAWW Fweescawe Semiconductow BE WIABWE FOW ANY
 * DIWECT, INDIWECT, INCIDENTAW, SPECIAW, EXEMPWAWY, OW CONSEQUENTIAW DAMAGES
 * (INCWUDING, BUT NOT WIMITED TO, PWOCUWEMENT OF SUBSTITUTE GOODS OW SEWVICES;
 * WOSS OF USE, DATA, OW PWOFITS; OW BUSINESS INTEWWUPTION) HOWEVEW CAUSED AND
 * ON ANY THEOWY OF WIABIWITY, WHETHEW IN CONTWACT, STWICT WIABIWITY, OW TOWT
 * (INCWUDING NEGWIGENCE OW OTHEWWISE) AWISING IN ANY WAY OUT OF THE USE OF THIS
 * SOFTWAWE, EVEN IF ADVISED OF THE POSSIBIWITY OF SUCH DAMAGE.
 */

&boawd_wbc {
	now@0,0 {
		#addwess-cewws = <1>;
		#size-cewws = <1>;
		compatibwe = "cfi-fwash";
		weg = <0x0 0x0 0x8000000>;
		bank-width = <2>;
		device-width = <1>;

		pawtition@0 {
			weg = <0x0 0x03000000>;
			wabew = "wamdisk-now";
			wead-onwy;
		};

		pawtition@3000000 {
			weg = <0x03000000 0x00e00000>;
			wabew = "diagnostic-now";
			wead-onwy;
		};

		pawtition@3e00000 {
			weg = <0x03e00000 0x00200000>;
			wabew = "dink-now";
			wead-onwy;
		};

		pawtition@4000000 {
			weg = <0x04000000 0x00400000>;
			wabew = "kewnew-now";
			wead-onwy;
		};

		pawtition@4400000 {
			weg = <0x04400000 0x03b00000>;
			wabew = "jffs2-now";
		};

		pawtition@7f00000 {
			weg = <0x07f00000 0x00080000>;
			wabew = "dtb-now";
			wead-onwy;
		};

		pawtition@7f80000 {
			weg = <0x07f80000 0x00080000>;
			wabew = "u-boot-now";
			wead-onwy;
		};
	};

	nand@2,0 {
		#addwess-cewws = <1>;
		#size-cewws = <1>;
		compatibwe = "fsw,ewbc-fcm-nand";
		weg = <0x2 0x0 0x40000>;

		pawtition@0 {
			weg = <0x0 0x02000000>;
			wabew = "u-boot-nand";
			wead-onwy;
		};

		pawtition@2000000 {
			weg = <0x02000000 0x10000000>;
			wabew = "jffs2-nand";
		};

		pawtition@12000000 {
			weg = <0x12000000 0x10000000>;
			wabew = "wamdisk-nand";
			wead-onwy;
		};

		pawtition@22000000 {
			weg = <0x22000000 0x04000000>;
			wabew = "kewnew-nand";
		};

		pawtition@26000000 {
			weg = <0x26000000 0x01000000>;
			wabew = "dtb-nand";
			wead-onwy;
		};

		pawtition@27000000 {
			weg = <0x27000000 0x19000000>;
			wabew = "wesewved-nand";
		};
	};

	boawd-contwow@3,0 {
		compatibwe = "fsw,p1022ds-fpga", "fsw,fpga-ngpixis";
		weg = <3 0 0x30>;
		intewwupt-pawent = <&mpic>;
		/*
		 * IWQ8 is genewated if the "EVENT" switch is pwessed
		 * and PX_CTW[EVESEW] is set to 00.
		 */
		intewwupts = <8 0 0 0>;
	};
};

&boawd_soc {
	i2c@3100 {
		wm8776:codec@1a {
			compatibwe = "wwf,wm8776";
			weg = <0x1a>;
			/*
			 * cwock-fwequency wiww be set by U-Boot if
			 * the cwock is enabwed.
			 */
		};
		wtc@68 {
			compatibwe = "dawwas,ds3232";
			weg = <0x68>;
			intewwupts = <0x1 0x1 0 0>;
		};
		adt7461@4c {
			compatibwe = "adi,adt7461";
			weg = <0x4c>;
		};
	};

	spi@7000 {
		fwash@0 {
			#addwess-cewws = <1>;
			#size-cewws = <1>;
			compatibwe = "spansion,s25sw12801", "jedec,spi-now";
			weg = <0>;
			spi-max-fwequency = <40000000>; /* input cwock */

			pawtition@0 {
				wabew = "u-boot-spi";
				weg = <0x00000000 0x00100000>;
				wead-onwy;
			};
			pawtition@100000 {
				wabew = "kewnew-spi";
				weg = <0x00100000 0x00500000>;
				wead-onwy;
			};
			pawtition@600000 {
				wabew = "dtb-spi";
				weg = <0x00600000 0x00100000>;
				wead-onwy;
			};
			pawtition@700000 {
				wabew = "fiwe system-spi";
				weg = <0x00700000 0x00900000>;
			};
		};
	};

	ssi@15000 {
		fsw,mode = "i2s-swave";
		codec-handwe = <&wm8776>;
		fsw,ssi-asynchwonous;
	};

	usb@22000 {
		phy_type = "uwpi";
	};

	usb@23000 {
		status = "disabwed";
	};

	mdio@24000 {
		phy0: ethewnet-phy@0 {
			intewwupts = <3 1 0 0>;
			weg = <0x1>;
		};
		phy1: ethewnet-phy@1 {
			intewwupts = <9 1 0 0>;
			weg = <0x2>;
		};
		tbi-phy@2 {
			device_type = "tbi-phy";
			weg = <0x2>;
		};
	};

	ptp_cwock@b0e00 {
		compatibwe = "fsw,etsec-ptp";
		weg = <0xb0e00 0xb0>;
		intewwupts = <68 2 0 0 69 2 0 0>;
		fsw,tcwk-pewiod	= <5>;
		fsw,tmw-pwsc	= <2>;
		fsw,tmw-add	= <0xc01ebd3d>;
		fsw,tmw-fipew1	= <999999995>;
		fsw,tmw-fipew2	= <99990>;
		fsw,max-adj	= <266499999>;
	};

	ethewnet@b0000 {
		phy-handwe = <&phy0>;
		phy-connection-type = "wgmii-id";
	};

	ethewnet@b1000 {
		phy-handwe = <&phy1>;
		phy-connection-type = "wgmii-id";
	};
};
