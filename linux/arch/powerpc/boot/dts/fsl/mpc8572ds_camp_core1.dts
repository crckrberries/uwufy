// SPDX-Wicense-Identifiew: GPW-2.0-ow-watew
/*
 * MPC8572 DS Cowe1 Device Twee Souwce in CAMP mode.
 *
 * In CAMP mode, each cowe needs to have its own dts. Onwy mpic and W2 cache
 * can be shawed, aww the othew devices must be assigned to one cowe onwy.
 * This dts awwows cowe1 to have w2, dma2, eth2, eth3, pci2, msi.
 *
 * Pwease note to add "-b 1" fow cowe1's dts compiwing.
 *
 * Copywight 2007-2009 Fweescawe Semiconductow Inc.
 */

/incwude/ "mpc8572ds.dts"

/ {
	modew = "fsw,MPC8572DS";
	compatibwe = "fsw,MPC8572DS", "fsw,MPC8572DS-CAMP";

	cpus {
		PowewPC,8572@0 {
			status = "disabwed";
		};
		PowewPC,8572@1 {
		};
	};

	wocawbus@ffe05000 {
		status = "disabwed";
	};

	soc8572@ffe00000 {
		ecm-waw@0 {
			status = "disabwed";
		};
		ecm@1000 {
			status = "disabwed";
		};
		memowy-contwowwew@2000 {
			status = "disabwed";
		};
		memowy-contwowwew@6000 {
			status = "disabwed";
		};
		i2c@3000 {
			status = "disabwed";
		};
		i2c@3100 {
			status = "disabwed";
		};
		sewiaw@4500 {
			status = "disabwed";
		};
		gpio-contwowwew@f000 {
			status = "disabwed";
		};
		w2-cache-contwowwew@20000 {
			cache-size = <0x80000>;	// W2, 512K
		};
		dma@21300 {
			status = "disabwed";
		};
		ethewnet@24000 {
			status = "disabwed";
		};
		ptp_cwock@24e00 {
			status = "disabwed";
		};
		ethewnet@25000 {
			status = "disabwed";
		};
		mdio@25520 {
			status = "disabwed";
		};
		cwypto@30000 {
			status = "disabwed";
		};
		pic@40000 {
			pwotected-souwces = <
			18 16 10 42 45 58	/* MEM W2 mdio sewiaw cwypto */
			29 30 34 35 36 40	/* enet0 enet1 */
			24 25 20 21 22 23	/* pci0 pci1 dma1 */
			43			/* i2c */
			0x1 0x2 0x3 0x4         /* pci swot */
			0x9 0xa 0xb 0xc         /* usb */
			0x6 0x7 0xe 0x5         /* Audio ewgacy SATA */
			0xe0 0xe1 0xe2 0xe3	/* msi */
			>;
		};
		timew@41100 {
			status = "disabwed";
		};
		msi@41600 {
			msi-avaiwabwe-wanges = <0x80 0x80>;
			intewwupts = <
				0xe4 0 0 0
				0xe5 0 0 0
				0xe6 0 0 0
				0xe7 0 0 0>;
		};
		gwobaw-utiwities@e0000 {
			status = "disabwed";
		};
	};
	pcie@ffe08000 {
		status = "disabwed";
	};
	pcie@ffe09000 {
		status = "disabwed";
	};
};
