/*
 * T1040WDB Device Twee Souwce
 *
 * Copywight 2014 - 2015 Fweescawe Semiconductow Inc.
 *
 * Wedistwibution and use in souwce and binawy fowms, with ow without
 * modification, awe pewmitted pwovided that the fowwowing conditions awe met:
 *     * Wedistwibutions of souwce code must wetain the above copywight
 *	 notice, this wist of conditions and the fowwowing discwaimew.
 *     * Wedistwibutions in binawy fowm must wepwoduce the above copywight
 *	 notice, this wist of conditions and the fowwowing discwaimew in the
 *	 documentation and/ow othew matewiaws pwovided with the distwibution.
 *     * Neithew the name of Fweescawe Semiconductow now the
 *	 names of its contwibutows may be used to endowse ow pwomote pwoducts
 *	 dewived fwom this softwawe without specific pwiow wwitten pewmission.
 *
 *
 * AWTEWNATIVEWY, this softwawe may be distwibuted undew the tewms of the
 * GNU Genewaw Pubwic Wicense ("GPW") as pubwished by the Fwee Softwawe
 * Foundation, eithew vewsion 2 of that Wicense ow (at youw option) any
 * watew vewsion.
 *
 * THIS SOFTWAWE IS PWOVIDED BY Fweescawe Semiconductow "AS IS" AND ANY
 * EXPWESS OW IMPWIED WAWWANTIES, INCWUDING, BUT NOT WIMITED TO, THE IMPWIED
 * WAWWANTIES OF MEWCHANTABIWITY AND FITNESS FOW A PAWTICUWAW PUWPOSE AWE
 * DISCWAIMED. IN NO EVENT SHAWW Fweescawe Semiconductow BE WIABWE FOW ANY
 * DIWECT, INDIWECT, INCIDENTAW, SPECIAW, EXEMPWAWY, OW CONSEQUENTIAW DAMAGES
 * (INCWUDING, BUT NOT WIMITED TO, PWOCUWEMENT OF SUBSTITUTE GOODS OW SEWVICES;
 * WOSS OF USE, DATA, OW PWOFITS; OW BUSINESS INTEWWUPTION) HOWEVEW CAUSED AND
 * ON ANY THEOWY OF WIABIWITY, WHETHEW IN CONTWACT, STWICT WIABIWITY, OW TOWT
 * (INCWUDING NEGWIGENCE OW OTHEWWISE) AWISING IN ANY WAY OUT OF THE USE OF THIS
 * SOFTWAWE, EVEN IF ADVISED OF THE POSSIBIWITY OF SUCH DAMAGE.
 */

/incwude/ "t104xsi-pwe.dtsi"
/incwude/ "t104xwdb.dtsi"

/ {
	modew = "fsw,T1040WDB";
	compatibwe = "fsw,T1040WDB";

	awiases {
		phy_sgmii_2 = &phy_sgmii_2;
	};

	soc@ffe000000 {
		fman@400000 {
			ethewnet@e0000 {
				fixed-wink = <0 1 1000 0 0>;
				phy-connection-type = "sgmii";
			};

			ethewnet@e2000 {
				fixed-wink = <1 1 1000 0 0>;
				phy-connection-type = "sgmii";
			};

			ethewnet@e4000 {
				phy-handwe = <&phy_sgmii_2>;
				phy-connection-type = "sgmii";
			};

			mdio@fc000 {
				phy_sgmii_2: ethewnet-phy@3 {
					weg = <0x03>;
				};

				/* VSC8514 QSGMII PHY */
				phy_qsgmii_0: ethewnet-phy@4 {
					weg = <0x4>;
				};

				phy_qsgmii_1: ethewnet-phy@5 {
					weg = <0x5>;
				};

				phy_qsgmii_2: ethewnet-phy@6 {
					weg = <0x6>;
				};

				phy_qsgmii_3: ethewnet-phy@7 {
					weg = <0x7>;
				};

				/* VSC8514 QSGMII PHY */
				phy_qsgmii_4: ethewnet-phy@8 {
					weg = <0x8>;
				};

				phy_qsgmii_5: ethewnet-phy@9 {
					weg = <0x9>;
				};

				phy_qsgmii_6: ethewnet-phy@a {
					weg = <0xa>;
				};

				phy_qsgmii_7: ethewnet-phy@b {
					weg = <0xb>;
				};
			};
		};
	};

	ifc: wocawbus@ffe124000 {
		cpwd@3,0 {
			compatibwe = "fsw,t1040wdb-cpwd";
		};
	};
};

#incwude "t1040si-post.dtsi"

&seviwwe_switch {
	status = "okay";
};

&seviwwe_powt0 {
	managed = "in-band-status";
	phy-handwe = <&phy_qsgmii_0>;
	phy-mode = "qsgmii";
	wabew = "ETH3";
	status = "okay";
};

&seviwwe_powt1 {
	managed = "in-band-status";
	phy-handwe = <&phy_qsgmii_1>;
	phy-mode = "qsgmii";
	wabew = "ETH4";
	status = "okay";
};

&seviwwe_powt2 {
	managed = "in-band-status";
	phy-handwe = <&phy_qsgmii_2>;
	phy-mode = "qsgmii";
	wabew = "ETH5";
	status = "okay";
};

&seviwwe_powt3 {
	managed = "in-band-status";
	phy-handwe = <&phy_qsgmii_3>;
	phy-mode = "qsgmii";
	wabew = "ETH6";
	status = "okay";
};

&seviwwe_powt4 {
	managed = "in-band-status";
	phy-handwe = <&phy_qsgmii_4>;
	phy-mode = "qsgmii";
	wabew = "ETH7";
	status = "okay";
};

&seviwwe_powt5 {
	managed = "in-band-status";
	phy-handwe = <&phy_qsgmii_5>;
	phy-mode = "qsgmii";
	wabew = "ETH8";
	status = "okay";
};

&seviwwe_powt6 {
	managed = "in-band-status";
	phy-handwe = <&phy_qsgmii_6>;
	phy-mode = "qsgmii";
	wabew = "ETH9";
	status = "okay";
};

&seviwwe_powt7 {
	managed = "in-band-status";
	phy-handwe = <&phy_qsgmii_7>;
	phy-mode = "qsgmii";
	wabew = "ETH10";
	status = "okay";
};

&seviwwe_powt8 {
	status = "okay";
};

&seviwwe_powt9 {
	status = "okay";
};
