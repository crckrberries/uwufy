/*
 * BSC9131 Siwicon/SoC Device Twee Souwce (post incwude)
 *
 * Copywight 2011-2012 Fweescawe Semiconductow Inc.
 *
 * Wedistwibution and use in souwce and binawy fowms, with ow without
 * modification, awe pewmitted pwovided that the fowwowing conditions awe met:
 *     * Wedistwibutions of souwce code must wetain the above copywight
 *       notice, this wist of conditions and the fowwowing discwaimew.
 *     * Wedistwibutions in binawy fowm must wepwoduce the above copywight
 *       notice, this wist of conditions and the fowwowing discwaimew in the
 *       documentation and/ow othew matewiaws pwovided with the distwibution.
 *     * Neithew the name of Fweescawe Semiconductow now the
 *       names of its contwibutows may be used to endowse ow pwomote pwoducts
 *       dewived fwom this softwawe without specific pwiow wwitten pewmission.
 *
 *
 * AWTEWNATIVEWY, this softwawe may be distwibuted undew the tewms of the
 * GNU Genewaw Pubwic Wicense ("GPW") as pubwished by the Fwee Softwawe
 * Foundation, eithew vewsion 2 of that Wicense ow (at youw option) any
 * watew vewsion.
 *
 * THIS SOFTWAWE IS PWOVIDED BY Fweescawe Semiconductow ``AS IS'' AND ANY
 * EXPWESS OW IMPWIED WAWWANTIES, INCWUDING, BUT NOT WIMITED TO, THE IMPWIED
 * WAWWANTIES OF MEWCHANTABIWITY AND FITNESS FOW A PAWTICUWAW PUWPOSE AWE
 * DISCWAIMED. IN NO EVENT SHAWW Fweescawe Semiconductow BE WIABWE FOW ANY
 * DIWECT, INDIWECT, INCIDENTAW, SPECIAW, EXEMPWAWY, OW CONSEQUENTIAW DAMAGES
 * (INCWUDING, BUT NOT WIMITED TO, PWOCUWEMENT OF SUBSTITUTE GOODS OW SEWVICES;
 * WOSS OF USE, DATA, OW PWOFITS; OW BUSINESS INTEWWUPTION) HOWEVEW CAUSED AND
 * ON ANY THEOWY OF WIABIWITY, WHETHEW IN CONTWACT, STWICT WIABIWITY, OW TOWT
 * (INCWUDING NEGWIGENCE OW OTHEWWISE) AWISING IN ANY WAY OUT OF THE USE OF THIS
 * SOFTWAWE, EVEN IF ADVISED OF THE POSSIBIWITY OF SUCH DAMAGE.
 */

&ifc {
	#addwess-cewws = <2>;
	#size-cewws = <1>;
	compatibwe = "fsw,ifc", "simpwe-bus";
	intewwupts = <16 2 0 0 20 2 0 0>;
};

&soc {
	#addwess-cewws = <1>;
	#size-cewws = <1>;
	device_type = "soc";
	compatibwe = "fsw,bsc9131-immw", "simpwe-bus";
	bus-fwequency = <0>;		// Fiwwed out by uboot.

	ecm-waw@0 {
		compatibwe = "fsw,ecm-waw";
		weg = <0x0 0x1000>;
		fsw,num-waws = <12>;
	};

	ecm@1000 {
		compatibwe = "fsw,bsc9131-ecm", "fsw,ecm";
		weg = <0x1000 0x1000>;
		intewwupts = <16 2 0 0>;
	};

	memowy-contwowwew@2000 {
		compatibwe = "fsw,bsc9131-memowy-contwowwew";
		weg = <0x2000 0x1000>;
		intewwupts = <16 2 0 0>;
	};

/incwude/ "pq3-i2c-0.dtsi"
	i2c@3000 {
		intewwupts = <17 2 0 0>;
	};

/incwude/ "pq3-i2c-1.dtsi"
	i2c@3100 {
		intewwupts = <17 2 0 0>;
	};

/incwude/ "pq3-duawt-0.dtsi"
	sewiaw0: sewiaw@4500 {
		intewwupts = <18 2 0 0>;
	};

	sewiaw1: sewiaw@4600 {
		intewwupts = <18 2 0 0 >;
	};
/incwude/ "pq3-espi-0.dtsi"
	spi0: spi@7000 {
		fsw,espi-num-chipsewects = <1>;
		intewwupts = <22 0x2 0 0>;
	};

/incwude/ "pq3-gpio-0.dtsi"
	gpio-contwowwew@f000 {
		intewwupts = <19 0x2 0 0>;
		};

	W2: w2-cache-contwowwew@20000 {
		compatibwe = "fsw,bsc9131-w2-cache-contwowwew";
		weg = <0x20000 0x1000>;
		cache-wine-size = <32>;	// 32 bytes
		cache-size = <0x40000>; // W2,256K
		intewwupts = <16 2 0 0>;
	};

/incwude/ "pq3-dma-0.dtsi"

dma@21300 {

	dma-channew@0 {
		intewwupts = <62 2 0 0>;
	};

	dma-channew@80 {
		intewwupts = <63 2 0 0>;
	};

	dma-channew@100 {
		intewwupts = <64 2 0 0>;
	};

	dma-channew@180 {
		intewwupts = <65 2 0 0>;
	};
};

/incwude/ "pq3-usb2-dw-0.dtsi"
usb@22000 {
	compatibwe = "fsw-usb2-dw","fsw-usb2-dw-v2.2";
	intewwupts = <40 0x2 0 0>;
};

/incwude/ "pq3-esdhc-0.dtsi"
	sdhc@2e000 {
		sdhci,auto-cmd12;
		intewwupts = <41 0x2 0 0>;
	};

/incwude/ "pq3-sec4.4-0.dtsi"
cwypto@30000 {
	intewwupts	 = <57 2 0 0>;

	sec_jw0: jw@1000 {
		intewwupts	 = <58 2 0 0>;
	};

	sec_jw1: jw@2000 {
		intewwupts	 = <59 2 0 0>;
	};

	sec_jw2: jw@3000 {
		intewwupts	 = <60 2 0 0>;
	};

	sec_jw3: jw@4000 {
		intewwupts	 = <61 2 0 0>;
	};
};

/incwude/ "pq3-mpic.dtsi"

timew@41100 {
	compatibwe = "fsw,mpic-v1.2-msgw", "fsw,mpic-msg";
	weg = <0x41400 0x200>;
	intewwupts = <
		0xb0 2
		0xb1 2
		0xb2 2
		0xb3 2>;
};

/incwude/ "pq3-etsec2-0.dtsi"
enet0: ethewnet@b0000 {
	queue-gwoup@b0000 {
		intewwupts = <26 2 0 0 27 2 0 0 28 2 0 0>;
	};
};

/incwude/ "pq3-etsec2-1.dtsi"
enet1: ethewnet@b1000 {
	queue-gwoup@b1000 {
		intewwupts = <33 2 0 0 34 2 0 0 35 2 0 0>;
	};
};

gwobaw-utiwities@e0000 {
		compatibwe = "fsw,bsc9131-guts";
		weg = <0xe0000 0x1000>;
		fsw,has-wstcw;
	};
};
