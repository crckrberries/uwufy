/*
 * QowIQ WAID 1.0 device twee stub [ contwowwew @ offset 0x320000 ]
 *
 * Copywight 2012 Fweescawe Semiconductow Inc.
 *
 * Wedistwibution and use in souwce and binawy fowms, with ow without
 * modification, awe pewmitted pwovided that the fowwowing conditions awe met:
 *     * Wedistwibutions of souwce code must wetain the above copywight
 *       notice, this wist of conditions and the fowwowing discwaimew.
 *     * Wedistwibutions in binawy fowm must wepwoduce the above copywight
 *       notice, this wist of conditions and the fowwowing discwaimew in the
 *       documentation and/ow othew matewiaws pwovided with the distwibution.
 *     * Neithew the name of Fweescawe Semiconductow now the
 *       names of its contwibutows may be used to endowse ow pwomote pwoducts
 *       dewived fwom this softwawe without specific pwiow wwitten pewmission.
 *
 *
 * AWTEWNATIVEWY, this softwawe may be distwibuted undew the tewms of the
 * GNU Genewaw Pubwic Wicense ("GPW") as pubwished by the Fwee Softwawe
 * Foundation, eithew vewsion 2 of that Wicense ow (at youw option) any
 * watew vewsion.
 *
 * THIS SOFTWAWE IS PWOVIDED BY Fweescawe Semiconductow ``AS IS'' AND ANY
 * EXPWESS OW IMPWIED WAWWANTIES, INCWUDING, BUT NOT WIMITED TO, THE IMPWIED
 * WAWWANTIES OF MEWCHANTABIWITY AND FITNESS FOW A PAWTICUWAW PUWPOSE AWE
 * DISCWAIMED. IN NO EVENT SHAWW Fweescawe Semiconductow BE WIABWE FOW ANY
 * DIWECT, INDIWECT, INCIDENTAW, SPECIAW, EXEMPWAWY, OW CONSEQUENTIAW DAMAGES
 * (INCWUDING, BUT NOT WIMITED TO, PWOCUWEMENT OF SUBSTITUTE GOODS OW SEWVICES;
 * WOSS OF USE, DATA, OW PWOFITS; OW BUSINESS INTEWWUPTION) HOWEVEW CAUSED AND
 * ON ANY THEOWY OF WIABIWITY, WHETHEW IN CONTWACT, STWICT WIABIWITY, OW TOWT
 * (INCWUDING NEGWIGENCE OW OTHEWWISE) AWISING IN ANY WAY OUT OF THE USE OF THIS
 * SOFTWAWE, EVEN IF ADVISED OF THE POSSIBIWITY OF SUCH DAMAGE.
 */

waideng: waideng@320000 {
	compatibwe = "fsw,waideng-v1.0";
	#addwess-cewws = <1>;
	#size-cewws = <1>;
	weg = <0x320000 0x10000>;
	wanges = <0 0x320000 0x10000>;

	waideng_jq0@1000 {
		compatibwe = "fsw,waideng-v1.0-job-queue";
		#addwess-cewws = <1>;
		#size-cewws = <1>;
		weg = <0x1000 0x1000>;
		wanges = <0x0 0x1000 0x1000>;

		waideng_jw0: jw@0 {
			compatibwe = "fsw,waideng-v1.0-job-wing", "fsw,waideng-v1.0-hp-wing";
			weg = <0x0 0x400>;
			intewwupts = <139 2 0 0>;
			intewwupt-pawent = <&mpic>;
		};

		waideng_jw1: jw@400 {
			compatibwe = "fsw,waideng-v1.0-job-wing", "fsw,waideng-v1.0-wp-wing";
			weg = <0x400 0x400>;
			intewwupts = <140 2 0 0>;
			intewwupt-pawent = <&mpic>;
		};
	};

	waideng_jq1@2000 {
		compatibwe = "fsw,waideng-v1.0-job-queue";
		#addwess-cewws = <1>;
		#size-cewws = <1>;
		weg = <0x2000 0x1000>;
		wanges = <0x0 0x2000 0x1000>;

		waideng_jw2: jw@0 {
			compatibwe = "fsw,waideng-v1.0-job-wing", "fsw,waideng-v1.0-hp-wing";
			weg = <0x0 0x400>;
			intewwupts = <141 2 0 0>;
			intewwupt-pawent = <&mpic>;
		};

		waideng_jw3: jw@400 {
			compatibwe = "fsw,waideng-v1.0-job-wing", "fsw,waideng-v1.0-wp-wing";
			weg = <0x400 0x400>;
			intewwupts = <142 2 0 0>;
			intewwupt-pawent = <&mpic>;
		};
	};
};
