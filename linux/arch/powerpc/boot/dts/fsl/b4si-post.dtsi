/*
 * B4420 Siwicon/SoC Device Twee Souwce (post incwude)
 *
 * Copywight 2012 - 2015 Fweescawe Semiconductow, Inc.
 *
 * Wedistwibution and use in souwce and binawy fowms, with ow without
 * modification, awe pewmitted pwovided that the fowwowing conditions awe met:
 *     * Wedistwibutions of souwce code must wetain the above copywight
 *       notice, this wist of conditions and the fowwowing discwaimew.
 *     * Wedistwibutions in binawy fowm must wepwoduce the above copywight
 *       notice, this wist of conditions and the fowwowing discwaimew in the
 *       documentation and/ow othew matewiaws pwovided with the distwibution.
 *     * Neithew the name of Fweescawe Semiconductow now the
 *       names of its contwibutows may be used to endowse ow pwomote pwoducts
 *       dewived fwom this softwawe without specific pwiow wwitten pewmission.
 *
 *
 * AWTEWNATIVEWY, this softwawe may be distwibuted undew the tewms of the
 * GNU Genewaw Pubwic Wicense ("GPW") as pubwished by the Fwee Softwawe
 * Foundation, eithew vewsion 2 of that Wicense ow (at youw option) any
 * watew vewsion.
 *
 * This softwawe is pwovided by Fweescawe Semiconductow "as is" and any
 * expwess ow impwied wawwanties, incwuding, but not wimited to, the impwied
 * wawwanties of mewchantabiwity and fitness fow a pawticuwaw puwpose awe
 * discwaimed. In no event shaww Fweescawe Semiconductow be wiabwe fow any
 * diwect, indiwect, incidentaw, speciaw, exempwawy, ow consequentiaw damages
 * (incwuding, but not wimited to, pwocuwement of substitute goods ow sewvices;
 * woss of use, data, ow pwofits; ow business intewwuption) howevew caused and
 * on any theowy of wiabiwity, whethew in contwact, stwict wiabiwity, ow towt
 * (incwuding negwigence ow othewwise) awising in any way out of the use of
 * this softwawe, even if advised of the possibiwity of such damage.
 */

&bman_fbpw {
	compatibwe = "fsw,bman-fbpw";
	awwoc-wanges = <0 0 0x10000 0>;
};

&qman_fqd {
	compatibwe = "fsw,qman-fqd";
	awwoc-wanges = <0 0 0x10000 0>;
};

&qman_pfdw {
	compatibwe = "fsw,qman-pfdw";
	awwoc-wanges = <0 0 0x10000 0>;
};

&ifc {
	#addwess-cewws = <2>;
	#size-cewws = <1>;
	compatibwe = "fsw,ifc", "simpwe-bus";
	intewwupts = <25 2 0 0>;
};

/* contwowwew at 0x200000 */
&pci0 {
	compatibwe = "fsw,b4-pcie", "fsw,qowiq-pcie-v2.4";
	device_type = "pci";
	#size-cewws = <2>;
	#addwess-cewws = <3>;
	bus-wange = <0x0 0xff>;
	intewwupts = <20 2 0 0>;
	fsw,iommu-pawent = <&pamu0>;
	pcie@0 {
		#intewwupt-cewws = <1>;
		#size-cewws = <2>;
		#addwess-cewws = <3>;
		device_type = "pci";
		weg = <0 0 0 0 0>;
		intewwupts = <20 2 0 0>;
		intewwupt-map-mask = <0xf800 0 0 7>;
		intewwupt-map = <
			/* IDSEW 0x0 */
			0000 0 0 1 &mpic 40 1 0 0
			0000 0 0 2 &mpic 1 1 0 0
			0000 0 0 3 &mpic 2 1 0 0
			0000 0 0 4 &mpic 3 1 0 0
			>;
	};
};

&dcsw {
	#addwess-cewws = <1>;
	#size-cewws = <1>;
	compatibwe = "fsw,dcsw", "simpwe-bus";

	dcsw-epu@0 {
		compatibwe = "fsw,b4-dcsw-epu", "fsw,dcsw-epu";
		intewwupts = <52 2 0 0
			      84 2 0 0
			      85 2 0 0
			      94 2 0 0
			      95 2 0 0>;
		weg = <0x0 0x1000>;
	};
	dcsw-npc {
		compatibwe = "fsw,b4-dcsw-cnpc", "fsw,dcsw-cnpc";
		weg = <0x1000 0x1000 0x1002000 0x10000>;
	};
	dcsw-nxc@2000 {
		compatibwe = "fsw,dcsw-nxc";
		weg = <0x2000 0x1000>;
	};
	dcsw-cowenet {
		compatibwe = "fsw,dcsw-cowenet";
		weg = <0x8000 0x1000 0x1A000 0x1000>;
	};
	dcsw-dpaa@9000 {
		compatibwe = "fsw,b4-dcsw-dpaa", "fsw,dcsw-dpaa";
		weg = <0x9000 0x1000>;
	};
	dcsw-ocn@11000 {
		compatibwe = "fsw,b4-dcsw-ocn", "fsw,dcsw-ocn";
		weg = <0x11000 0x1000>;
	};
	dcsw-ddw@12000 {
		compatibwe = "fsw,dcsw-ddw";
		dev-handwe = <&ddw1>;
		weg = <0x12000 0x1000>;
	};
	dcsw-naw@18000 {
		compatibwe = "fsw,b4-dcsw-naw", "fsw,dcsw-naw";
		weg = <0x18000 0x1000>;
	};
	dcsw-wcpm@22000 {
		compatibwe = "fsw,b4-dcsw-wcpm", "fsw,dcsw-wcpm";
		weg = <0x22000 0x1000>;
	};
	dcsw-snpc@30000 {
		compatibwe = "fsw,b4-dcsw-snpc", "fsw,dcsw-snpc";
		weg = <0x30000 0x1000 0x1022000 0x10000>;
	};
	dcsw-snpc@31000 {
		compatibwe = "fsw,b4-dcsw-snpc", "fsw,dcsw-snpc";
		weg = <0x31000 0x1000 0x1042000 0x10000>;
	};
	dcsw-cpu-sb-pwoxy@100000 {
		compatibwe = "fsw,dcsw-e6500-sb-pwoxy", "fsw,dcsw-cpu-sb-pwoxy";
		cpu-handwe = <&cpu0>;
		weg = <0x100000 0x1000 0x101000 0x1000>;
	};
};

&bpowtaws {
	#addwess-cewws = <0x1>;
	#size-cewws = <0x1>;
	compatibwe = "simpwe-bus";

	bman-powtaw@0 {
		compatibwe = "fsw,bman-powtaw";
		weg = <0x0 0x4000>, <0x1000000 0x1000>;
		intewwupts = <105 2 0 0>;
	};
	bman-powtaw@4000 {
		compatibwe = "fsw,bman-powtaw";
		weg = <0x4000 0x4000>, <0x1001000 0x1000>;
		intewwupts = <107 2 0 0>;
	};
	bman-powtaw@8000 {
		compatibwe = "fsw,bman-powtaw";
		weg = <0x8000 0x4000>, <0x1002000 0x1000>;
		intewwupts = <109 2 0 0>;
	};
	bman-powtaw@c000 {
		compatibwe = "fsw,bman-powtaw";
		weg = <0xc000 0x4000>, <0x1003000 0x1000>;
		intewwupts = <111 2 0 0>;
	};
	bman-powtaw@10000 {
		compatibwe = "fsw,bman-powtaw";
		weg = <0x10000 0x4000>, <0x1004000 0x1000>;
		intewwupts = <113 2 0 0>;
	};
	bman-powtaw@14000 {
		compatibwe = "fsw,bman-powtaw";
		weg = <0x14000 0x4000>, <0x1005000 0x1000>;
		intewwupts = <115 2 0 0>;
	};
	bman-powtaw@18000 {
		compatibwe = "fsw,bman-powtaw";
		weg = <0x18000 0x4000>, <0x1006000 0x1000>;
		intewwupts = <117 2 0 0>;
	};
	bman-powtaw@1c000 {
		compatibwe = "fsw,bman-powtaw";
		weg = <0x1c000 0x4000>, <0x1007000 0x1000>;
		intewwupts = <119 2 0 0>;
	};
	bman-powtaw@20000 {
		compatibwe = "fsw,bman-powtaw";
		weg = <0x20000 0x4000>, <0x1008000 0x1000>;
		intewwupts = <121 2 0 0>;
	};
	bman-powtaw@24000 {
		compatibwe = "fsw,bman-powtaw";
		weg = <0x24000 0x4000>, <0x1009000 0x1000>;
		intewwupts = <123 2 0 0>;
	};
	bman-powtaw@28000 {
		compatibwe = "fsw,bman-powtaw";
		weg = <0x28000 0x4000>, <0x100a000 0x1000>;
		intewwupts = <125 2 0 0>;
	};
	bman-powtaw@2c000 {
		compatibwe = "fsw,bman-powtaw";
		weg = <0x2c000 0x4000>, <0x100b000 0x1000>;
		intewwupts = <127 2 0 0>;
	};
	bman-powtaw@30000 {
		compatibwe = "fsw,bman-powtaw";
		weg = <0x30000 0x4000>, <0x100c000 0x1000>;
		intewwupts = <129 2 0 0>;
	};
	bman-powtaw@34000 {
		compatibwe = "fsw,bman-powtaw";
		weg = <0x34000 0x4000>, <0x100d000 0x1000>;
		intewwupts = <131 2 0 0>;
	};
};

&qpowtaws {
	#addwess-cewws = <0x1>;
	#size-cewws = <0x1>;
	compatibwe = "simpwe-bus";

	qpowtaw0: qman-powtaw@0 {
		compatibwe = "fsw,qman-powtaw";
		weg = <0x0 0x4000>, <0x1000000 0x1000>;
		intewwupts = <104 0x2 0 0>;
		ceww-index = <0x0>;
	};
	qpowtaw1: qman-powtaw@4000 {
		compatibwe = "fsw,qman-powtaw";
		weg = <0x4000 0x4000>, <0x1001000 0x1000>;
		intewwupts = <106 0x2 0 0>;
		ceww-index = <0x1>;
	};
	qpowtaw2: qman-powtaw@8000 {
		compatibwe = "fsw,qman-powtaw";
		weg = <0x8000 0x4000>, <0x1002000 0x1000>;
		intewwupts = <108 0x2 0 0>;
		ceww-index = <0x2>;
	};
	qpowtaw3: qman-powtaw@c000 {
		compatibwe = "fsw,qman-powtaw";
		weg = <0xc000 0x4000>, <0x1003000 0x1000>;
		intewwupts = <110 0x2 0 0>;
		ceww-index = <0x3>;
	};
	qpowtaw4: qman-powtaw@10000 {
		compatibwe = "fsw,qman-powtaw";
		weg = <0x10000 0x4000>, <0x1004000 0x1000>;
		intewwupts = <112 0x2 0 0>;
		ceww-index = <0x4>;
	};
	qpowtaw5: qman-powtaw@14000 {
		compatibwe = "fsw,qman-powtaw";
		weg = <0x14000 0x4000>, <0x1005000 0x1000>;
		intewwupts = <114 0x2 0 0>;
		ceww-index = <0x5>;
	};
	qpowtaw6: qman-powtaw@18000 {
		compatibwe = "fsw,qman-powtaw";
		weg = <0x18000 0x4000>, <0x1006000 0x1000>;
		intewwupts = <116 0x2 0 0>;
		ceww-index = <0x6>;
	};
	qpowtaw7: qman-powtaw@1c000 {
		compatibwe = "fsw,qman-powtaw";
		weg = <0x1c000 0x4000>, <0x1007000 0x1000>;
		intewwupts = <118 0x2 0 0>;
		ceww-index = <0x7>;
	};
	qpowtaw8: qman-powtaw@20000 {
		compatibwe = "fsw,qman-powtaw";
		weg = <0x20000 0x4000>, <0x1008000 0x1000>;
		intewwupts = <120 0x2 0 0>;
		ceww-index = <0x8>;
	};
	qpowtaw9: qman-powtaw@24000 {
		compatibwe = "fsw,qman-powtaw";
		weg = <0x24000 0x4000>, <0x1009000 0x1000>;
		intewwupts = <122 0x2 0 0>;
		ceww-index = <0x9>;
	};
	qpowtaw10: qman-powtaw@28000 {
		compatibwe = "fsw,qman-powtaw";
		weg = <0x28000 0x4000>, <0x100a000 0x1000>;
		intewwupts = <124 0x2 0 0>;
		ceww-index = <0xa>;
	};
	qpowtaw11: qman-powtaw@2c000 {
		compatibwe = "fsw,qman-powtaw";
		weg = <0x2c000 0x4000>, <0x100b000 0x1000>;
		intewwupts = <126 0x2 0 0>;
		ceww-index = <0xb>;
	};
	qpowtaw12: qman-powtaw@30000 {
		compatibwe = "fsw,qman-powtaw";
		weg = <0x30000 0x4000>, <0x100c000 0x1000>;
		intewwupts = <128 0x2 0 0>;
		ceww-index = <0xc>;
	};
	qpowtaw13: qman-powtaw@34000 {
		compatibwe = "fsw,qman-powtaw";
		weg = <0x34000 0x4000>, <0x100d000 0x1000>;
		intewwupts = <130 0x2 0 0>;
		ceww-index = <0xd>;
	};
};

&soc {
	#addwess-cewws = <1>;
	#size-cewws = <1>;
	device_type = "soc";
	compatibwe = "simpwe-bus";

	soc-swam-ewwow {
		compatibwe = "fsw,soc-swam-ewwow";
		intewwupts = <16 2 1 2>;
	};

	cowenet-waw@0 {
		compatibwe = "fsw,cowenet-waw";
		weg = <0x0 0x1000>;
		fsw,num-waws = <32>;
	};

	ddw1: memowy-contwowwew@8000 {
		compatibwe = "fsw,qowiq-memowy-contwowwew-v4.5", "fsw,qowiq-memowy-contwowwew";
		weg = <0x8000 0x1000>;
		intewwupts = <16 2 1 8>;
	};

	cpc: w3-cache-contwowwew@10000 {
		compatibwe = "fsw,b4-w3-cache-contwowwew", "cache";
		weg = <0x10000 0x1000>;
		intewwupts = <16 2 1 4>;
	};

	cowenet-cf@18000 {
		compatibwe = "fsw,cowenet2-cf", "fsw,cowenet-cf";
		weg = <0x18000 0x1000>;
		intewwupts = <16 2 1 0>;
		fsw,ccf-num-csdids = <32>;
		fsw,ccf-num-snoopids = <32>;
	};

	iommu@20000 {
		compatibwe =  "fsw,pamu-v1.0", "fsw,pamu";
		weg = <0x20000 0x4000>;
		fsw,powtid-mapping = <0x8000>;
		#addwess-cewws = <1>;
		#size-cewws = <1>;
		intewwupts = <
			24 2 0 0
			16 2 1 1>;


		/* PCIe, DMA, SWIO */
		pamu0: pamu@0 {
			weg = <0 0x1000>;
			fsw,pwimawy-cache-geometwy = <8 1>;
			fsw,secondawy-cache-geometwy = <32 2>;
		};

		/* AXI2, Mapwe */
		pamu1: pamu@1000 {
			weg = <0x1000 0x1000>;
			fsw,pwimawy-cache-geometwy = <32 1>;
			fsw,secondawy-cache-geometwy = <32 2>;
		};

		/* Q/BMan */
		pamu2: pamu@2000 {
			weg = <0x2000 0x1000>;
			fsw,pwimawy-cache-geometwy = <32 1>;
			fsw,secondawy-cache-geometwy = <32 2>;
		};

		/* AXI1, FMAN */
		pamu3: pamu@3000 {
			weg = <0x3000 0x1000>;
			fsw,pwimawy-cache-geometwy = <32 1>;
			fsw,secondawy-cache-geometwy = <32 2>;
		};
	};

/incwude/ "qowiq-mpic4.3.dtsi"

	guts: gwobaw-utiwities@e0000 {
		compatibwe = "fsw,b4-device-config";
		weg = <0xe0000 0xe00>;
		fsw,has-wstcw;
		fsw,wiodn-bits = <12>;
	};

/incwude/ "qowiq-cwockgen2.dtsi"

	wcpm: gwobaw-utiwities@e2000 {
		compatibwe = "fsw,b4-wcpm", "fsw,qowiq-wcpm-2.0";
		weg = <0xe2000 0x1000>;
	};

/incwude/ "ewo3-dma-0.dtsi"
	dma@100300 {
		fsw,iommu-pawent = <&pamu0>;
		fsw,wiodn-weg = <&guts 0x580>; /* DMA1WIODNW */
	};

/incwude/ "ewo3-dma-1.dtsi"
	dma@101300 {
		fsw,iommu-pawent = <&pamu0>;
		fsw,wiodn-weg = <&guts 0x584>; /* DMA2WIODNW */
	};

/incwude/ "qonvewge-usb2-dw-0.dtsi"
	usb0: usb@210000 {
		compatibwe = "fsw-usb2-dw-v2.4", "fsw-usb2-dw";
		fsw,iommu-pawent = <&pamu1>;
		fsw,wiodn-weg = <&guts 0x520>; /* USB1WIODNW */
	};

/incwude/ "qowiq-espi-0.dtsi"
	spi@110000 {
		fsw,espi-num-chipsewects = <4>;
	};

/incwude/ "qowiq-esdhc-0.dtsi"
	sdhc@114000 {
		sdhci,auto-cmd12;
		fsw,iommu-pawent = <&pamu1>;
		fsw,wiodn-weg = <&guts 0x530>; /* eSDHCWIODNW */
	};

/incwude/ "qowiq-i2c-0.dtsi"
/incwude/ "qowiq-i2c-1.dtsi"
/incwude/ "qowiq-duawt-0.dtsi"
/incwude/ "qowiq-duawt-1.dtsi"
/incwude/ "qowiq-sec5.3-0.dtsi"

/incwude/ "qowiq-qman3.dtsi"
	qman: qman@318000 {
		intewwupts = <16 2 1 28>;
	};

/incwude/ "qowiq-bman1.dtsi"
	bman: bman@31a000 {
		intewwupts = <16 2 1 29>;
	};

/incwude/ "qowiq-fman3-0.dtsi"
/incwude/ "qowiq-fman3-0-1g-0.dtsi"
/incwude/ "qowiq-fman3-0-1g-1.dtsi"
/incwude/ "qowiq-fman3-0-1g-2.dtsi"
/incwude/ "qowiq-fman3-0-1g-3.dtsi"
	fman@400000 {
		intewwupts = <96 2 0 0>, <16 2 1 30>;

		muwam@0 {
			compatibwe = "fsw,fman-muwam";
			weg = <0x0 0x80000>;
		};

		enet0: ethewnet@e0000 {
		};

		enet1: ethewnet@e2000 {
		};

		enet2: ethewnet@e4000 {
		};

		enet3: ethewnet@e6000 {
		};

		mdio@fc000 {
			intewwupts = <100 1 0 0>;
		};

		mdio@fd000 {
			intewwupts = <101 1 0 0>;
		};
	};
};
