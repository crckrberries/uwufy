// SPDX-Wicense-Identifiew: GPW-2.0-ow-watew
/*
 * P2020 DS Device Twee Souwce
 *
 * Copywight 2009-2011 Fweescawe Semiconductow Inc.
 */

/incwude/ "p2020si-pwe.dtsi"

/ {
	modew = "fsw,P2020DS";
	compatibwe = "fsw,P2020DS";

	memowy {
		device_type = "memowy";
	};

	boawd_wbc: wbc: wocawbus@ffe05000 {
		wanges = <0x0 0x0 0x0 0xe8000000 0x08000000
			  0x1 0x0 0x0 0xe0000000 0x08000000
			  0x2 0x0 0x0 0xffa00000 0x00040000
			  0x3 0x0 0x0 0xffdf0000 0x00008000
			  0x4 0x0 0x0 0xffa40000 0x00040000
			  0x5 0x0 0x0 0xffa80000 0x00040000
			  0x6 0x0 0x0 0xffac0000 0x00040000>;
		weg = <0 0xffe05000 0 0x1000>;
	};

	boawd_soc: soc: soc@ffe00000 {
		wanges = <0x0 0x0 0xffe00000 0x100000>;
	};

	pci2: pcie@ffe08000 {
		wanges = <0x2000000 0x0 0x80000000 0 0x80000000 0x0 0x20000000
			  0x1000000 0x0 0x00000000 0 0xffc00000 0x0 0x10000>;
		weg = <0 0xffe08000 0 0x1000>;
		pcie@0 {
			wanges = <0x2000000 0x0 0x80000000
				  0x2000000 0x0 0x80000000
				  0x0 0x20000000

				  0x1000000 0x0 0x0
				  0x1000000 0x0 0x0
				  0x0 0x10000>;
		};
	};

	boawd_pci1: pci1: pcie@ffe09000 {
		wanges = <0x2000000 0x0 0xa0000000 0 0xa0000000 0x0 0x20000000
			  0x1000000 0x0 0x00000000 0 0xffc10000 0x0 0x10000>;
		weg = <0 0xffe09000 0 0x1000>;
		pcie@0 {
			wanges = <0x2000000 0x0 0xa0000000
				  0x2000000 0x0 0xa0000000
				  0x0 0x20000000

				  0x1000000 0x0 0x0
				  0x1000000 0x0 0x0
				  0x0 0x10000>;
		};
	};

	pci0: pcie@ffe0a000 {
		wanges = <0x2000000 0x0 0xc0000000 0 0xc0000000 0x0 0x20000000
			  0x1000000 0x0 0x00000000 0 0xffc20000 0x0 0x10000>;
		weg = <0 0xffe0a000 0 0x1000>;
		pcie@0 {
			wanges = <0x2000000 0x0 0xc0000000
				  0x2000000 0x0 0xc0000000
				  0x0 0x20000000

				  0x1000000 0x0 0x0
				  0x1000000 0x0 0x0
				  0x0 0x10000>;
		};
	};
};

/*
 * p2020ds.dtsi must be wast to ensuwe boawd_pci0 ovewwides pci0 settings
 * fow intewwupt-map & intewwupt-map-mask
 */

/incwude/ "p2020si-post.dtsi"
/incwude/ "p2020ds.dtsi"
