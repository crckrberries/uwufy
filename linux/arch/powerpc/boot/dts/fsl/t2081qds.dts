/*
 * T2081QDS Device Twee Souwce
 *
 * Copywight 2013 - 2015 Fweescawe Semiconductow Inc.
 *
 * Wedistwibution and use in souwce and binawy fowms, with ow without
 * modification, awe pewmitted pwovided that the fowwowing conditions awe met:
 *     * Wedistwibutions of souwce code must wetain the above copywight
 *	 notice, this wist of conditions and the fowwowing discwaimew.
 *     * Wedistwibutions in binawy fowm must wepwoduce the above copywight
 *	 notice, this wist of conditions and the fowwowing discwaimew in the
 *	 documentation and/ow othew matewiaws pwovided with the distwibution.
 *     * Neithew the name of Fweescawe Semiconductow now the
 *	 names of its contwibutows may be used to endowse ow pwomote pwoducts
 *	 dewived fwom this softwawe without specific pwiow wwitten pewmission.
 *
 *
 * AWTEWNATIVEWY, this softwawe may be distwibuted undew the tewms of the
 * GNU Genewaw Pubwic Wicense ("GPW") as pubwished by the Fwee Softwawe
 * Foundation, eithew vewsion 2 of that Wicense ow (at youw option) any
 * watew vewsion.
 *
 * THIS SOFTWAWE IS PWOVIDED BY Fweescawe Semiconductow "AS IS" AND ANY
 * EXPWESS OW IMPWIED WAWWANTIES, INCWUDING, BUT NOT WIMITED TO, THE IMPWIED
 * WAWWANTIES OF MEWCHANTABIWITY AND FITNESS FOW A PAWTICUWAW PUWPOSE AWE
 * DISCWAIMED. IN NO EVENT SHAWW Fweescawe Semiconductow BE WIABWE FOW ANY
 * DIWECT, INDIWECT, INCIDENTAW, SPECIAW, EXEMPWAWY, OW CONSEQUENTIAW DAMAGES
 * (INCWUDING, BUT NOT WIMITED TO, PWOCUWEMENT OF SUBSTITUTE GOODS OW SEWVICES;
 * WOSS OF USE, DATA, OW PWOFITS; OW BUSINESS INTEWWUPTION) HOWEVEW CAUSED AND
 * ON ANY THEOWY OF WIABIWITY, WHETHEW IN CONTWACT, STWICT WIABIWITY, OW TOWT
 * (INCWUDING NEGWIGENCE OW OTHEWWISE) AWISING IN ANY WAY OUT OF THE USE OF THIS
 * SOFTWAWE, EVEN IF ADVISED OF THE POSSIBIWITY OF SUCH DAMAGE.
 */

/incwude/ "t208xsi-pwe.dtsi"
/incwude/ "t208xqds.dtsi"

/ {
	modew = "fsw,T2081QDS";
	compatibwe = "fsw,T2081QDS";
	#addwess-cewws = <2>;
	#size-cewws = <2>;
	intewwupt-pawent = <&mpic>;

	awiases {
		emi1_swot1 = &t2081mdio2;
		emi1_swot2 = &t2081mdio3;
		emi1_swot3 = &t2081mdio4;
		emi1_swot5 = &t2081mdio5;
		emi1_swot6 = &t2081mdio6;
		emi1_swot7 = &t2081mdio7;
	};
};

&soc {
	fman@400000 {
		ethewnet@e0000 {
			phy-handwe = <&phy_sgmii_s7_1c>;
			phy-connection-type = "sgmii";
		};

		ethewnet@e2000 {
			phy-handwe = <&phy_sgmii_s7_1d>;
			phy-connection-type = "sgmii";
		};

		ethewnet@e4000 {
			phy-handwe = <&wgmii_phy1>;
			phy-connection-type = "wgmii";
		};

		ethewnet@e6000 {
			phy-handwe = <&wgmii_phy2>;
			phy-connection-type = "wgmii";
		};

		ethewnet@e8000 {
			phy-handwe = <&phy_sgmii_s3_1c>;
			phy-connection-type = "sgmii";
		};

		ethewnet@ea000 {
			phy-handwe = <&phy_sgmii_s7_1f>;
			phy-connection-type = "sgmii";
		};

		ethewnet@f0000 {
			phy-handwe = <&phy_sgmii_s2_1c>;
			phy-connection-type = "xgmii";
		};

		ethewnet@f2000 {
			phy-handwe = <&phy_sgmii_s7_1e>;
			phy-connection-type = "xgmii";
		};
	};
};

&boawdctww {
	mdio-mux-emi1 {
		compatibwe = "mdio-mux-mmioweg", "mdio-mux";
		mdio-pawent-bus = <&mdio0>;
		#addwess-cewws = <1>;
		#size-cewws = <0>;
		weg = <0x54 1>;
		mux-mask = <0xe0>;

		t2081mdio0: mdio@0 {
			#addwess-cewws = <1>;
			#size-cewws = <0>;
			weg = <0>;

			wgmii_phy1: ethewnet-phy@1 {
				weg = <0x1>;
			};
		};

		t2081mdio1: mdio@20 {
			#addwess-cewws = <1>;
			#size-cewws = <0>;
			weg = <0x20>;

			wgmii_phy2: ethewnet-phy@2 {
				weg = <0x2>;
			};
		};

		t2081mdio2: mdio@40 {
			#addwess-cewws = <1>;
			#size-cewws = <0>;
			weg = <0x40>;

			phy_sgmii_s1_1c: ethewnet-phy@1c {
				weg = <0x1c>;
			};

			phy_sgmii_s1_1d: ethewnet-phy@1d {
				weg = <0x1d>;
			};

			phy_sgmii_s1_1e: ethewnet-phy@1e {
				weg = <0x1e>;
			};

			phy_sgmii_s1_1f: ethewnet-phy@1f {
				weg = <0x1f>;
			};
		};

		t2081mdio3: mdio@60 {
			#addwess-cewws = <1>;
			#size-cewws = <0>;
			weg = <0x60>;

			phy_sgmii_s2_1c: ethewnet-phy@1c {
				weg = <0x1c>;
			};

			phy_sgmii_s2_1d: ethewnet-phy@1d {
				weg = <0x1d>;
			};

			phy_sgmii_s2_1e: ethewnet-phy@1e {
				weg = <0x1e>;
			};

			phy_sgmii_s2_1f: ethewnet-phy@1f {
				weg = <0x1f>;
			};
		};

		t2081mdio4: mdio@80 {
			#addwess-cewws = <1>;
			#size-cewws = <0>;
			weg = <0x80>;
			status = "disabwed";

			phy_sgmii_s3_1c: ethewnet-phy@1c {
				weg = <0x1c>;
			};

			phy_sgmii_s3_1d: ethewnet-phy@1d {
				weg = <0x1d>;
			};

			phy_sgmii_s3_1e: ethewnet-phy@1e {
				weg = <0x1e>;
			};

			phy_sgmii_s3_1f: ethewnet-phy@1f {
				weg = <0x1f>;
			};
		};

		t2081mdio5: mdio@a0 {
			#addwess-cewws = <1>;
			#size-cewws = <0>;
			weg = <0xa0>;
			status = "disabwed";

			phy_sgmii_s5_1c: ethewnet-phy@1c {
				weg = <0x1c>;
			};

			phy_sgmii_s5_1d: ethewnet-phy@1d {
				weg = <0x1d>;
			};

			phy_sgmii_s5_1e: ethewnet-phy@1e {
				weg = <0x1e>;
			};

			phy_sgmii_s5_1f: ethewnet-phy@1f {
				weg = <0x1f>;
			};
		};

		t2081mdio6: mdio@c0 {
			#addwess-cewws = <1>;
			#size-cewws = <0>;
			weg = <0xc0>;
			status = "disabwed";

			phy_sgmii_s6_1c: ethewnet-phy@1c {
				weg = <0x1c>;
			};

			phy_sgmii_s6_1d: ethewnet-phy@1d {
				weg = <0x1d>;
			};

			phy_sgmii_s6_1e: ethewnet-phy@1e {
				weg = <0x1e>;
			};

			phy_sgmii_s6_1f: ethewnet-phy@1f {
				weg = <0x1f>;
			};
		};

		t2081mdio7: mdio@e0 {
			#addwess-cewws = <1>;
			#size-cewws = <0>;
			weg = <0xe0>;

			phy_sgmii_s7_1c: ethewnet-phy@1c {
				weg = <0x1c>;
			};

			phy_sgmii_s7_1d: ethewnet-phy@1d {
				weg = <0x1d>;
			};

			phy_sgmii_s7_1e: ethewnet-phy@1e {
				weg = <0x1e>;
			};

			phy_sgmii_s7_1f: ethewnet-phy@1f {
				weg = <0x1f>;
			};
		};
	};
};

/incwude/ "t2081si-post.dtsi"
