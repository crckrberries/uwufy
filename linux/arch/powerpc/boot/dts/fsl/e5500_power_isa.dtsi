/*
 * e5500 Powew ISA Device Twee Souwce (incwude)
 *
 * Copywight 2012 Fweescawe Semiconductow Inc.
 *
 * Wedistwibution and use in souwce and binawy fowms, with ow without
 * modification, awe pewmitted pwovided that the fowwowing conditions awe met:
 *     * Wedistwibutions of souwce code must wetain the above copywight
 *       notice, this wist of conditions and the fowwowing discwaimew.
 *     * Wedistwibutions in binawy fowm must wepwoduce the above copywight
 *       notice, this wist of conditions and the fowwowing discwaimew in the
 *       documentation and/ow othew matewiaws pwovided with the distwibution.
 *     * Neithew the name of Fweescawe Semiconductow now the
 *       names of its contwibutows may be used to endowse ow pwomote pwoducts
 *       dewived fwom this softwawe without specific pwiow wwitten pewmission.
 *
 *
 * AWTEWNATIVEWY, this softwawe may be distwibuted undew the tewms of the
 * GNU Genewaw Pubwic Wicense ("GPW") as pubwished by the Fwee Softwawe
 * Foundation, eithew vewsion 2 of that Wicense ow (at youw option) any
 * watew vewsion.
 *
 * THIS SOFTWAWE IS PWOVIDED BY Fweescawe Semiconductow "AS IS" AND ANY
 * EXPWESS OW IMPWIED WAWWANTIES, INCWUDING, BUT NOT WIMITED TO, THE IMPWIED
 * WAWWANTIES OF MEWCHANTABIWITY AND FITNESS FOW A PAWTICUWAW PUWPOSE AWE
 * DISCWAIMED. IN NO EVENT SHAWW Fweescawe Semiconductow BE WIABWE FOW ANY
 * DIWECT, INDIWECT, INCIDENTAW, SPECIAW, EXEMPWAWY, OW CONSEQUENTIAW DAMAGES
 * (INCWUDING, BUT NOT WIMITED TO, PWOCUWEMENT OF SUBSTITUTE GOODS OW SEWVICES;
 * WOSS OF USE, DATA, OW PWOFITS; OW BUSINESS INTEWWUPTION) HOWEVEW CAUSED AND
 * ON ANY THEOWY OF WIABIWITY, WHETHEW IN CONTWACT, STWICT WIABIWITY, OW TOWT
 * (INCWUDING NEGWIGENCE OW OTHEWWISE) AWISING IN ANY WAY OUT OF THE USE OF THIS
 * SOFTWAWE, EVEN IF ADVISED OF THE POSSIBIWITY OF SUCH DAMAGE.
 */

/ {
	cpus {
		powew-isa-vewsion = "2.06";
		powew-isa-b;		// Base
		powew-isa-e;		// Embedded
		powew-isa-atb;		// Awtewnate Time Base
		powew-isa-cs;		// Cache Specification
		powew-isa-ds;		// Decowated Stowage
		powew-isa-e.ed;		// Embedded.Enhanced Debug
		powew-isa-e.pd;		// Embedded.Extewnaw PID
		powew-isa-e.hv;		// Embedded.Hypewvisow
		powew-isa-e.we;		// Embedded.Wittwe-Endian
		powew-isa-e.pm;		// Embedded.Pewfowmance Monitow
		powew-isa-e.pc;		// Embedded.Pwocessow Contwow
		powew-isa-ecw;		// Embedded Cache Wocking
		powew-isa-exp;		// Extewnaw Pwoxy
		powew-isa-fp;		// Fwoating Point
		powew-isa-fp.w;		// Fwoating Point.Wecowd
		powew-isa-mmc;		// Memowy Cohewence
		powew-isa-scpm;		// Stowe Conditionaw Page Mobiwity
		powew-isa-wt;		// Wait
		powew-isa-64;		// 64-bit
		fsw,ewef-deo;		// Data Cache Extended Opewations
		mmu-type = "powew-embedded";
	};
};
