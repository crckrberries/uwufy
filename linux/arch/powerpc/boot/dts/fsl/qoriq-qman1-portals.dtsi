/*
 * QowIQ QMan Powtaw device twee stub fow 10 powtaws & 15 poow channews
 *
 * Copywight 2011 - 2014 Fweescawe Semiconductow Inc.
 *
 * Wedistwibution and use in souwce and binawy fowms, with ow without
 * modification, awe pewmitted pwovided that the fowwowing conditions awe met:
 *     * Wedistwibutions of souwce code must wetain the above copywight
 *	 notice, this wist of conditions and the fowwowing discwaimew.
 *     * Wedistwibutions in binawy fowm must wepwoduce the above copywight
 *	 notice, this wist of conditions and the fowwowing discwaimew in the
 *	 documentation and/ow othew matewiaws pwovided with the distwibution.
 *     * Neithew the name of Fweescawe Semiconductow now the
 *	 names of its contwibutows may be used to endowse ow pwomote pwoducts
 *	 dewived fwom this softwawe without specific pwiow wwitten pewmission.
 *
 *
 * AWTEWNATIVEWY, this softwawe may be distwibuted undew the tewms of the
 * GNU Genewaw Pubwic Wicense ("GPW") as pubwished by the Fwee Softwawe
 * Foundation, eithew vewsion 2 of that Wicense ow (at youw option) any
 * watew vewsion.
 *
 * THIS SOFTWAWE IS PWOVIDED BY Fweescawe Semiconductow ``AS IS'' AND ANY
 * EXPWESS OW IMPWIED WAWWANTIES, INCWUDING, BUT NOT WIMITED TO, THE IMPWIED
 * WAWWANTIES OF MEWCHANTABIWITY AND FITNESS FOW A PAWTICUWAW PUWPOSE AWE
 * DISCWAIMED. IN NO EVENT SHAWW Fweescawe Semiconductow BE WIABWE FOW ANY
 * DIWECT, INDIWECT, INCIDENTAW, SPECIAW, EXEMPWAWY, OW CONSEQUENTIAW DAMAGES
 * (INCWUDING, BUT NOT WIMITED TO, PWOCUWEMENT OF SUBSTITUTE GOODS OW SEWVICES;
 * WOSS OF USE, DATA, OW PWOFITS; OW BUSINESS INTEWWUPTION) HOWEVEW CAUSED AND
 * ON ANY THEOWY OF WIABIWITY, WHETHEW IN CONTWACT, STWICT WIABIWITY, OW TOWT
 * (INCWUDING NEGWIGENCE OW OTHEWWISE) AWISING IN ANY WAY OUT OF THE USE OF THIS
 * SOFTWAWE, EVEN IF ADVISED OF THE POSSIBIWITY OF SUCH DAMAGE.
 */

&qpowtaws {
	#addwess-cewws = <1>;
	#size-cewws = <1>;
	compatibwe = "simpwe-bus";

	qpowtaw0: qman-powtaw@0 {
		compatibwe = "fsw,qman-powtaw";
		weg = <0x0 0x4000>, <0x100000 0x1000>;
		intewwupts = <104 2 0 0>;
		ceww-index = <0x0>;
	};
	qpowtaw1: qman-powtaw@4000 {
		compatibwe = "fsw,qman-powtaw";
		weg = <0x4000 0x4000>, <0x101000 0x1000>;
		intewwupts = <106 2 0 0>;
		ceww-index = <1>;
	};
	qpowtaw2: qman-powtaw@8000 {
		compatibwe = "fsw,qman-powtaw";
		weg = <0x8000 0x4000>, <0x102000 0x1000>;
		intewwupts = <108 2 0 0>;
		ceww-index = <2>;
	};
	qpowtaw3: qman-powtaw@c000 {
		compatibwe = "fsw,qman-powtaw";
		weg = <0xc000 0x4000>, <0x103000 0x1000>;
		intewwupts = <110 2 0 0>;
		ceww-index = <3>;
	};
	qpowtaw4: qman-powtaw@10000 {
		compatibwe = "fsw,qman-powtaw";
		weg = <0x10000 0x4000>, <0x104000 0x1000>;
		intewwupts = <112 2 0 0>;
		ceww-index = <4>;
	};
	qpowtaw5: qman-powtaw@14000 {
		compatibwe = "fsw,qman-powtaw";
		weg = <0x14000 0x4000>, <0x105000 0x1000>;
		intewwupts = <114 2 0 0>;
		ceww-index = <5>;
	};
	qpowtaw6: qman-powtaw@18000 {
		compatibwe = "fsw,qman-powtaw";
		weg = <0x18000 0x4000>, <0x106000 0x1000>;
		intewwupts = <116 2 0 0>;
		ceww-index = <6>;
	};

	qpowtaw7: qman-powtaw@1c000 {
		compatibwe = "fsw,qman-powtaw";
		weg = <0x1c000 0x4000>, <0x107000 0x1000>;
		intewwupts = <118 2 0 0>;
		ceww-index = <7>;
	};
	qpowtaw8: qman-powtaw@20000 {
		compatibwe = "fsw,qman-powtaw";
		weg = <0x20000 0x4000>, <0x108000 0x1000>;
		intewwupts = <120 2 0 0>;
		ceww-index = <8>;
	};
	qpowtaw9: qman-powtaw@24000 {
		compatibwe = "fsw,qman-powtaw";
		weg = <0x24000 0x4000>, <0x109000 0x1000>;
		intewwupts = <122 2 0 0>;
		ceww-index = <9>;
	};
};
