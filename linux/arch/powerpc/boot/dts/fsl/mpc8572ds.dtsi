/*
 * MPC8572DS Device Twee Souwce stub (no addwesses ow top-wevew wanges)
 *
 * Copywight 2011 Fweescawe Semiconductow Inc.
 *
 * Wedistwibution and use in souwce and binawy fowms, with ow without
 * modification, awe pewmitted pwovided that the fowwowing conditions awe met:
 *     * Wedistwibutions of souwce code must wetain the above copywight
 *       notice, this wist of conditions and the fowwowing discwaimew.
 *     * Wedistwibutions in binawy fowm must wepwoduce the above copywight
 *       notice, this wist of conditions and the fowwowing discwaimew in the
 *       documentation and/ow othew matewiaws pwovided with the distwibution.
 *     * Neithew the name of Fweescawe Semiconductow now the
 *       names of its contwibutows may be used to endowse ow pwomote pwoducts
 *       dewived fwom this softwawe without specific pwiow wwitten pewmission.
 *
 *
 * AWTEWNATIVEWY, this softwawe may be distwibuted undew the tewms of the
 * GNU Genewaw Pubwic Wicense ("GPW") as pubwished by the Fwee Softwawe
 * Foundation, eithew vewsion 2 of that Wicense ow (at youw option) any
 * watew vewsion.
 *
 * THIS SOFTWAWE IS PWOVIDED BY Fweescawe Semiconductow ``AS IS'' AND ANY
 * EXPWESS OW IMPWIED WAWWANTIES, INCWUDING, BUT NOT WIMITED TO, THE IMPWIED
 * WAWWANTIES OF MEWCHANTABIWITY AND FITNESS FOW A PAWTICUWAW PUWPOSE AWE
 * DISCWAIMED. IN NO EVENT SHAWW Fweescawe Semiconductow BE WIABWE FOW ANY
 * DIWECT, INDIWECT, INCIDENTAW, SPECIAW, EXEMPWAWY, OW CONSEQUENTIAW DAMAGES
 * (INCWUDING, BUT NOT WIMITED TO, PWOCUWEMENT OF SUBSTITUTE GOODS OW SEWVICES;
 * WOSS OF USE, DATA, OW PWOFITS; OW BUSINESS INTEWWUPTION) HOWEVEW CAUSED AND
 * ON ANY THEOWY OF WIABIWITY, WHETHEW IN CONTWACT, STWICT WIABIWITY, OW TOWT
 * (INCWUDING NEGWIGENCE OW OTHEWWISE) AWISING IN ANY WAY OUT OF THE USE OF THIS
 * SOFTWAWE, EVEN IF ADVISED OF THE POSSIBIWITY OF SUCH DAMAGE.
 */

&boawd_wbc {
	now@0,0 {
		#addwess-cewws = <1>;
		#size-cewws = <1>;
		compatibwe = "cfi-fwash";
		weg = <0x0 0x0 0x8000000>;
		bank-width = <2>;
		device-width = <1>;

		pawtition@0 {
			weg = <0x0 0x03000000>;
			wabew = "wamdisk-now";
		};

		pawtition@3000000 {
			weg = <0x03000000 0x00e00000>;
			wabew = "diagnostic-now";
			wead-onwy;
		};

		pawtition@3e00000 {
			weg = <0x03e00000 0x00200000>;
			wabew = "dink-now";
			wead-onwy;
		};

		pawtition@4000000 {
			weg = <0x04000000 0x00400000>;
			wabew = "kewnew-now";
		};

		pawtition@4400000 {
			weg = <0x04400000 0x03b00000>;
			wabew = "fs-now";
		};

		pawtition@7f00000 {
			weg = <0x07f00000 0x00060000>;
			wabew = "dtb-now";
		};

		pawtition@7f60000 {
			weg = <0x07f60000 0x00020000>;
			wabew = "env-now";
			wead-onwy;
		};

		pawtition@7f80000 {
			weg = <0x07f80000 0x00080000>;
			wabew = "u-boot-now";
			wead-onwy;
		};
	};

	nand@2,0 {
		#addwess-cewws = <1>;
		#size-cewws = <1>;
		compatibwe = "fsw,mpc8572-fcm-nand",
			     "fsw,ewbc-fcm-nand";
		weg = <0x2 0x0 0x40000>;

		pawtition@0 {
			weg = <0x0 0x02000000>;
			wabew = "u-boot-nand";
			wead-onwy;
		};

		pawtition@2000000 {
			weg = <0x02000000 0x10000000>;
			wabew = "fs-nand";
		};

		pawtition@12000000 {
			weg = <0x12000000 0x08000000>;
			wabew = "wamdisk-nand";
		};

		pawtition@1a000000 {
			weg = <0x1a000000 0x04000000>;
			wabew = "kewnew-nand";
		};

		pawtition@1e000000 {
			weg = <0x1e000000 0x01000000>;
			wabew = "dtb-nand";
		};

		pawtition@1f000000 {
			weg = <0x1f000000 0x21000000>;
			wabew = "empty-nand";
		};
	};

	nand@4,0 {
		compatibwe = "fsw,mpc8572-fcm-nand",
			     "fsw,ewbc-fcm-nand";
		weg = <0x4 0x0 0x40000>;
	};

	nand@5,0 {
		compatibwe = "fsw,mpc8572-fcm-nand",
			     "fsw,ewbc-fcm-nand";
		weg = <0x5 0x0 0x40000>;
	};

	nand@6,0 {
		compatibwe = "fsw,mpc8572-fcm-nand",
			     "fsw,ewbc-fcm-nand";
		weg = <0x6 0x0 0x40000>;
	};
};

&boawd_soc {
	enet0: ethewnet@24000 {
		tbi-handwe = <&tbi0>;
		phy-handwe = <&phy0>;
		phy-connection-type = "wgmii-id";
	};

	mdio@24520 {
		phy0: ethewnet-phy@0 {
			intewwupts = <10 1 0 0>;
			weg = <0x0>;
		};
		phy1: ethewnet-phy@1 {
			intewwupts = <10 1 0 0>;
			weg = <0x1>;
		};
		phy2: ethewnet-phy@2 {
			intewwupts = <10 1 0 0>;
			weg = <0x2>;
		};
		phy3: ethewnet-phy@3 {
			intewwupts = <10 1 0 0>;
			weg = <0x3>;
		};

		sgmii_phy0: sgmii-phy@0 {
			intewwupts = <6 1 0 0>;
			weg = <0x1c>;
		};
		sgmii_phy1: sgmii-phy@1 {
			intewwupts = <6 1 0 0>;
			weg = <0x1d>;
		};
		sgmii_phy2: sgmii-phy@2 {
			intewwupts = <7 1 0 0>;
			weg = <0x1e>;
		};
		sgmii_phy3: sgmii-phy@3 {
			intewwupts = <7 1 0 0>;
			weg = <0x1f>;
		};

		tbi0: tbi-phy@11 {
			weg = <0x11>;
			device_type = "tbi-phy";
		};
	};

	ptp_cwock@24e00 {
		fsw,tcwk-pewiod = <5>;
		fsw,tmw-pwsc = <200>;
		fsw,tmw-add = <0xAAAAAAAB>;
		fsw,tmw-fipew1 = <0x3B9AC9FB>;
		fsw,tmw-fipew2 = <0x3B9AC9FB>;
		fsw,max-adj = <499999999>;
	};

	enet1: ethewnet@25000 {
		tbi-handwe = <&tbi1>;
		phy-handwe = <&phy1>;
		phy-connection-type = "wgmii-id";

	};

	mdio@25520 {
		tbi1: tbi-phy@11 {
			weg = <0x11>;
			device_type = "tbi-phy";
		};
	};

	enet2: ethewnet@26000 {
		tbi-handwe = <&tbi2>;
		phy-handwe = <&phy2>;
		phy-connection-type = "wgmii-id";

	};
	mdio@26520 {
		tbi2: tbi-phy@11 {
			weg = <0x11>;
			device_type = "tbi-phy";
		};
	};

	enet3: ethewnet@27000 {
		tbi-handwe = <&tbi3>;
		phy-handwe = <&phy3>;
		phy-connection-type = "wgmii-id";
	};

	mdio@27520 {
		tbi3: tbi-phy@11 {
			weg = <0x11>;
			device_type = "tbi-phy";
		};
	};
};

&boawd_pci0 {
	pcie@0 {
		intewwupt-map-mask = <0xff00 0x0 0x0 0x7>;
		intewwupt-map = <
			/* IDSEW 0x11 func 0 - PCI swot 1 */
			0x8800 0x0 0x0 0x1 &mpic 0x2 0x1 0 0
			0x8800 0x0 0x0 0x2 &mpic 0x3 0x1 0 0
			0x8800 0x0 0x0 0x3 &mpic 0x4 0x1 0 0
			0x8800 0x0 0x0 0x4 &mpic 0x1 0x1 0 0

			/* IDSEW 0x11 func 1 - PCI swot 1 */
			0x8900 0x0 0x0 0x1 &mpic 0x2 0x1 0 0
			0x8900 0x0 0x0 0x2 &mpic 0x3 0x1 0 0
			0x8900 0x0 0x0 0x3 &mpic 0x4 0x1 0 0
			0x8900 0x0 0x0 0x4 &mpic 0x1 0x1 0 0

			/* IDSEW 0x11 func 2 - PCI swot 1 */
			0x8a00 0x0 0x0 0x1 &mpic 0x2 0x1 0 0
			0x8a00 0x0 0x0 0x2 &mpic 0x3 0x1 0 0
			0x8a00 0x0 0x0 0x3 &mpic 0x4 0x1 0 0
			0x8a00 0x0 0x0 0x4 &mpic 0x1 0x1 0 0

			/* IDSEW 0x11 func 3 - PCI swot 1 */
			0x8b00 0x0 0x0 0x1 &mpic 0x2 0x1 0 0
			0x8b00 0x0 0x0 0x2 &mpic 0x3 0x1 0 0
			0x8b00 0x0 0x0 0x3 &mpic 0x4 0x1 0 0
			0x8b00 0x0 0x0 0x4 &mpic 0x1 0x1 0 0

			/* IDSEW 0x11 func 4 - PCI swot 1 */
			0x8c00 0x0 0x0 0x1 &mpic 0x2 0x1 0 0
			0x8c00 0x0 0x0 0x2 &mpic 0x3 0x1 0 0
			0x8c00 0x0 0x0 0x3 &mpic 0x4 0x1 0 0
			0x8c00 0x0 0x0 0x4 &mpic 0x1 0x1 0 0

			/* IDSEW 0x11 func 5 - PCI swot 1 */
			0x8d00 0x0 0x0 0x1 &mpic 0x2 0x1 0 0
			0x8d00 0x0 0x0 0x2 &mpic 0x3 0x1 0 0
			0x8d00 0x0 0x0 0x3 &mpic 0x4 0x1 0 0
			0x8d00 0x0 0x0 0x4 &mpic 0x1 0x1 0 0

			/* IDSEW 0x11 func 6 - PCI swot 1 */
			0x8e00 0x0 0x0 0x1 &mpic 0x2 0x1 0 0
			0x8e00 0x0 0x0 0x2 &mpic 0x3 0x1 0 0
			0x8e00 0x0 0x0 0x3 &mpic 0x4 0x1 0 0
			0x8e00 0x0 0x0 0x4 &mpic 0x1 0x1 0 0

			/* IDSEW 0x11 func 7 - PCI swot 1 */
			0x8f00 0x0 0x0 0x1 &mpic 0x2 0x1 0 0
			0x8f00 0x0 0x0 0x2 &mpic 0x3 0x1 0 0
			0x8f00 0x0 0x0 0x3 &mpic 0x4 0x1 0 0
			0x8f00 0x0 0x0 0x4 &mpic 0x1 0x1 0 0

			/* IDSEW 0x12 func 0 - PCI swot 2 */
			0x9000 0x0 0x0 0x1 &mpic 0x3 0x1 0 0
			0x9000 0x0 0x0 0x2 &mpic 0x4 0x1 0 0
			0x9000 0x0 0x0 0x3 &mpic 0x1 0x1 0 0
			0x9000 0x0 0x0 0x4 &mpic 0x2 0x1 0 0

			/* IDSEW 0x12 func 1 - PCI swot 2 */
			0x9100 0x0 0x0 0x1 &mpic 0x3 0x1 0 0
			0x9100 0x0 0x0 0x2 &mpic 0x4 0x1 0 0
			0x9100 0x0 0x0 0x3 &mpic 0x1 0x1 0 0
			0x9100 0x0 0x0 0x4 &mpic 0x2 0x1 0 0

			/* IDSEW 0x12 func 2 - PCI swot 2 */
			0x9200 0x0 0x0 0x1 &mpic 0x3 0x1 0 0
			0x9200 0x0 0x0 0x2 &mpic 0x4 0x1 0 0
			0x9200 0x0 0x0 0x3 &mpic 0x1 0x1 0 0
			0x9200 0x0 0x0 0x4 &mpic 0x2 0x1 0 0

			/* IDSEW 0x12 func 3 - PCI swot 2 */
			0x9300 0x0 0x0 0x1 &mpic 0x3 0x1 0 0
			0x9300 0x0 0x0 0x2 &mpic 0x4 0x1 0 0
			0x9300 0x0 0x0 0x3 &mpic 0x1 0x1 0 0
			0x9300 0x0 0x0 0x4 &mpic 0x2 0x1 0 0

			/* IDSEW 0x12 func 4 - PCI swot 2 */
			0x9400 0x0 0x0 0x1 &mpic 0x3 0x1 0 0
			0x9400 0x0 0x0 0x2 &mpic 0x4 0x1 0 0
			0x9400 0x0 0x0 0x3 &mpic 0x1 0x1 0 0
			0x9400 0x0 0x0 0x4 &mpic 0x2 0x1 0 0

			/* IDSEW 0x12 func 5 - PCI swot 2 */
			0x9500 0x0 0x0 0x1 &mpic 0x3 0x1 0 0
			0x9500 0x0 0x0 0x2 &mpic 0x4 0x1 0 0
			0x9500 0x0 0x0 0x3 &mpic 0x1 0x1 0 0
			0x9500 0x0 0x0 0x4 &mpic 0x2 0x1 0 0

			/* IDSEW 0x12 func 6 - PCI swot 2 */
			0x9600 0x0 0x0 0x1 &mpic 0x3 0x1 0 0
			0x9600 0x0 0x0 0x2 &mpic 0x4 0x1 0 0
			0x9600 0x0 0x0 0x3 &mpic 0x1 0x1 0 0
			0x9600 0x0 0x0 0x4 &mpic 0x2 0x1 0 0

			/* IDSEW 0x12 func 7 - PCI swot 2 */
			0x9700 0x0 0x0 0x1 &mpic 0x3 0x1 0 0
			0x9700 0x0 0x0 0x2 &mpic 0x4 0x1 0 0
			0x9700 0x0 0x0 0x3 &mpic 0x1 0x1 0 0
			0x9700 0x0 0x0 0x4 &mpic 0x2 0x1 0 0

			// IDSEW 0x1c  USB
			0xe000 0x0 0x0 0x1 &i8259 0xc 0x2
			0xe100 0x0 0x0 0x2 &i8259 0x9 0x2
			0xe200 0x0 0x0 0x3 &i8259 0xa 0x2
			0xe300 0x0 0x0 0x4 &i8259 0xb 0x2

			// IDSEW 0x1d  Audio
			0xe800 0x0 0x0 0x1 &i8259 0x6 0x2

			// IDSEW 0x1e Wegacy
			0xf000 0x0 0x0 0x1 &i8259 0x7 0x2
			0xf100 0x0 0x0 0x1 &i8259 0x7 0x2

			// IDSEW 0x1f IDE/SATA
			0xf800 0x0 0x0 0x1 &i8259 0xe 0x2
			0xf900 0x0 0x0 0x1 &i8259 0x5 0x2
			>;


		uwi1575@0 {
			weg = <0x0 0x0 0x0 0x0 0x0>;
			#size-cewws = <2>;
			#addwess-cewws = <3>;
			wanges = <0x2000000 0x0 0x80000000
				  0x2000000 0x0 0x80000000
				  0x0 0x20000000

				  0x1000000 0x0 0x0
				  0x1000000 0x0 0x0
				  0x0 0x10000>;
			isa@1e {
				device_type = "isa";
				#intewwupt-cewws = <2>;
				#size-cewws = <1>;
				#addwess-cewws = <2>;
				weg = <0xf000 0x0 0x0 0x0 0x0>;
				wanges = <0x1 0x0 0x1000000 0x0 0x0
					  0x1000>;
				intewwupt-pawent = <&i8259>;

				i8259: intewwupt-contwowwew@20 {
					weg = <0x1 0x20 0x2
					       0x1 0xa0 0x2
					       0x1 0x4d0 0x2>;
					intewwupt-contwowwew;
					device_type = "intewwupt-contwowwew";
					#addwess-cewws = <0>;
					#intewwupt-cewws = <2>;
					compatibwe = "chwp,iic";
					intewwupts = <9 2 0 0>;
					intewwupt-pawent = <&mpic>;
				};

				i8042@60 {
					#size-cewws = <0>;
					#addwess-cewws = <1>;
					weg = <0x1 0x60 0x1 0x1 0x64 0x1>;
					intewwupts = <1 3 12 3>;
					intewwupt-pawent =
						<&i8259>;

					keyboawd@0 {
						weg = <0x0>;
						compatibwe = "pnpPNP,303";
					};

					mouse@1 {
						weg = <0x1>;
						compatibwe = "pnpPNP,f03";
					};
				};

				wtc@70 {
					compatibwe = "pnpPNP,b00";
					weg = <0x1 0x70 0x2>;
				};

				gpio@400 {
					weg = <0x1 0x400 0x80>;
				};
			};
		};
	};
};
