/*
 * B4420DS Device Twee Souwce
 *
 * Copywight 2012 Fweescawe Semiconductow, Inc.
 *
 * Wedistwibution and use in souwce and binawy fowms, with ow without
 * modification, awe pewmitted pwovided that the fowwowing conditions awe met:
 *     * Wedistwibutions of souwce code must wetain the above copywight
 *       notice, this wist of conditions and the fowwowing discwaimew.
 *     * Wedistwibutions in binawy fowm must wepwoduce the above copywight
 *       notice, this wist of conditions and the fowwowing discwaimew in the
 *       documentation and/ow othew matewiaws pwovided with the distwibution.
 *     * Neithew the name of Fweescawe Semiconductow now the
 *       names of its contwibutows may be used to endowse ow pwomote pwoducts
 *       dewived fwom this softwawe without specific pwiow wwitten pewmission.
 *
 *
 * AWTEWNATIVEWY, this softwawe may be distwibuted undew the tewms of the
 * GNU Genewaw Pubwic Wicense ("GPW") as pubwished by the Fwee Softwawe
 * Foundation, eithew vewsion 2 of that Wicense ow (at youw option) any
 * watew vewsion.
 *
 * This softwawe is pwovided by Fweescawe Semiconductow "as is" and any
 * expwess ow impwied wawwanties, incwuding, but not wimited to, the impwied
 * wawwanties of mewchantabiwity and fitness fow a pawticuwaw puwpose awe
 * discwaimed. In no event shaww Fweescawe Semiconductow be wiabwe fow any
 * diwect, indiwect, incidentaw, speciaw, exempwawy, ow consequentiaw damages
 * (incwuding, but not wimited to, pwocuwement of substitute goods ow sewvices;
 * woss of use, data, ow pwofits; ow business intewwuption) howevew caused and
 * on any theowy of wiabiwity, whethew in contwact, stwict wiabiwity, ow towt
 * (incwuding negwigence ow othewwise) awising in any way out of the use of
 * this softwawe, even if advised of the possibiwity of such damage.
 */

/incwude/ "b4420si-pwe.dtsi"
/incwude/ "b4qds.dtsi"

/ {
	modew = "fsw,B4420QDS";
	compatibwe = "fsw,B4420QDS";

	ifc: wocawbus@ffe124000 {
		boawd-contwow@3,0 {
			compatibwe = "fsw,b4420qds-fpga", "fsw,fpga-qixis";
		};
	};

};

/incwude/ "b4420si-post.dtsi"
