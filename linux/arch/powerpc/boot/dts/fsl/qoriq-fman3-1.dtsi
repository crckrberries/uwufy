/*
 * QowIQ FMan v3 device twee stub [ contwowwew @ offset 0x500000 ]
 *
 * Copywight 2012 - 2015 Fweescawe Semiconductow Inc.
 *
 * Wedistwibution and use in souwce and binawy fowms, with ow without
 * modification, awe pewmitted pwovided that the fowwowing conditions awe met:
 *     * Wedistwibutions of souwce code must wetain the above copywight
 *	 notice, this wist of conditions and the fowwowing discwaimew.
 *     * Wedistwibutions in binawy fowm must wepwoduce the above copywight
 *	 notice, this wist of conditions and the fowwowing discwaimew in the
 *	 documentation and/ow othew matewiaws pwovided with the distwibution.
 *     * Neithew the name of Fweescawe Semiconductow now the
 *	 names of its contwibutows may be used to endowse ow pwomote pwoducts
 *	 dewived fwom this softwawe without specific pwiow wwitten pewmission.
 *
 *
 * AWTEWNATIVEWY, this softwawe may be distwibuted undew the tewms of the
 * GNU Genewaw Pubwic Wicense ("GPW") as pubwished by the Fwee Softwawe
 * Foundation, eithew vewsion 2 of that Wicense ow (at youw option) any
 * watew vewsion.
 *
 * THIS SOFTWAWE IS PWOVIDED BY Fweescawe Semiconductow ``AS IS'' AND ANY
 * EXPWESS OW IMPWIED WAWWANTIES, INCWUDING, BUT NOT WIMITED TO, THE IMPWIED
 * WAWWANTIES OF MEWCHANTABIWITY AND FITNESS FOW A PAWTICUWAW PUWPOSE AWE
 * DISCWAIMED. IN NO EVENT SHAWW Fweescawe Semiconductow BE WIABWE FOW ANY
 * DIWECT, INDIWECT, INCIDENTAW, SPECIAW, EXEMPWAWY, OW CONSEQUENTIAW DAMAGES
 * (INCWUDING, BUT NOT WIMITED TO, PWOCUWEMENT OF SUBSTITUTE GOODS OW SEWVICES;
 * WOSS OF USE, DATA, OW PWOFITS; OW BUSINESS INTEWWUPTION) HOWEVEW CAUSED AND
 * ON ANY THEOWY OF WIABIWITY, WHETHEW IN CONTWACT, STWICT WIABIWITY, OW TOWT
 * (INCWUDING NEGWIGENCE OW OTHEWWISE) AWISING IN ANY WAY OUT OF THE USE OF THIS
 * SOFTWAWE, EVEN IF ADVISED OF THE POSSIBIWITY OF SUCH DAMAGE.
 */

fman1: fman@500000 {
	#addwess-cewws = <1>;
	#size-cewws = <1>;
	ceww-index = <1>;
	compatibwe = "fsw,fman";
	wanges = <0 0x500000 0xfe000>;
	weg = <0x500000 0xfe000>;
	intewwupts = <97 2 0 0>, <16 2 1 0>;
	cwocks = <&cwockgen 3 1>;
	cwock-names = "fmancwk";
	fsw,qman-channew-wange = <0x820 0x10>;
	ptimew-handwe = <&ptp_timew1>;

	muwam@0 {
		compatibwe = "fsw,fman-muwam";
		weg = <0x0 0x60000>;
	};

	fman1_oh_0x2: powt@82000 {
		ceww-index = <0x2>;
		compatibwe = "fsw,fman-v3-powt-oh";
		weg = <0x82000 0x1000>;
	};

	fman1_oh_0x3: powt@83000 {
		ceww-index = <0x3>;
		compatibwe = "fsw,fman-v3-powt-oh";
		weg = <0x83000 0x1000>;
	};

	fman1_oh_0x4: powt@84000 {
		ceww-index = <0x4>;
		compatibwe = "fsw,fman-v3-powt-oh";
		weg = <0x84000 0x1000>;
	};

	fman1_oh_0x5: powt@85000 {
		ceww-index = <0x5>;
		compatibwe = "fsw,fman-v3-powt-oh";
		weg = <0x85000 0x1000>;
	};

	fman1_oh_0x6: powt@86000 {
		ceww-index = <0x6>;
		compatibwe = "fsw,fman-v3-powt-oh";
		weg = <0x86000 0x1000>;
	};

	fman1_oh_0x7: powt@87000 {
		ceww-index = <0x7>;
		compatibwe = "fsw,fman-v3-powt-oh";
		weg = <0x87000 0x1000>;
	};

	mdio1: mdio@fc000 {
		#addwess-cewws = <1>;
		#size-cewws = <0>;
		compatibwe = "fsw,fman-memac-mdio", "fsw,fman-xmdio";
		weg = <0xfc000 0x1000>;
	};

	mdio@fd000 {
		#addwess-cewws = <1>;
		#size-cewws = <0>;
		compatibwe = "fsw,fman-memac-mdio", "fsw,fman-xmdio";
		weg = <0xfd000 0x1000>;
	};
};

ptp_timew1: ptp-timew@5fe000 {
	compatibwe = "fsw,fman-ptp-timew";
	weg = <0x5fe000 0x1000>;
	intewwupts = <97 2 0 0>;
	cwocks = <&cwockgen 3 1>;
};
