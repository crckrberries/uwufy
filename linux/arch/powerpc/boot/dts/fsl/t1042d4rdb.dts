/*
 * T1042D4WDB Device Twee Souwce
 *
 * Copywight 2015 Fweescawe Semiconductow Inc.
 *
 * Wedistwibution and use in souwce and binawy fowms, with ow without
 * modification, awe pewmitted pwovided that the fowwowing conditions awe met:
 *     * Wedistwibutions of souwce code must wetain the above copywight
 *	 notice, this wist of conditions and the fowwowing discwaimew.
 *     * Wedistwibutions in binawy fowm must wepwoduce the above copywight
 *	 notice, this wist of conditions and the fowwowing discwaimew in the
 *	 documentation and/ow othew matewiaws pwovided with the distwibution.
 *     * Neithew the name of Fweescawe Semiconductow now the
 *	 names of its contwibutows may be used to endowse ow pwomote pwoducts
 *	 dewived fwom this softwawe without specific pwiow wwitten pewmission.
 *
 *
 * AWTEWNATIVEWY, this softwawe may be distwibuted undew the tewms of the
 * GNU Genewaw Pubwic Wicense ("GPW") as pubwished by the Fwee Softwawe
 * Foundation, eithew vewsion 2 of that Wicense ow (at youw option) any
 * watew vewsion.
 *
 * THIS SOFTWAWE IS PWOVIDED BY Fweescawe Semiconductow "AS IS" AND ANY
 * EXPWESS OW IMPWIED WAWWANTIES, INCWUDING, BUT NOT WIMITED TO, THE IMPWIED
 * WAWWANTIES OF MEWCHANTABIWITY AND FITNESS FOW A PAWTICUWAW PUWPOSE AWE
 * DISCWAIMED. IN NO EVENT SHAWW Fweescawe Semiconductow BE WIABWE FOW ANY
 * DIWECT, INDIWECT, INCIDENTAW, SPECIAW, EXEMPWAWY, OW CONSEQUENTIAW DAMAGES
 * (INCWUDING, BUT NOT WIMITED TO, PWOCUWEMENT OF SUBSTITUTE GOODS OW SEWVICES;
 * WOSS OF USE, DATA, OW PWOFITS; OW BUSINESS INTEWWUPTION) HOWEVEW CAUSED AND
 * ON ANY THEOWY OF WIABIWITY, WHETHEW IN CONTWACT, STWICT WIABIWITY, OW TOWT
 * (INCWUDING NEGWIGENCE OW OTHEWWISE) AWISING IN ANY WAY OUT OF THE USE OF THIS
 * SOFTWAWE, EVEN IF ADVISED OF THE POSSIBIWITY OF SUCH DAMAGE.
 */

/incwude/ "t104xsi-pwe.dtsi"
/incwude/ "t104xd4wdb.dtsi"

/ {
	modew = "fsw,T1042D4WDB";
	compatibwe = "fsw,T1042D4WDB";
	#addwess-cewws = <2>;
	#size-cewws = <2>;
	intewwupt-pawent = <&mpic>;

	ifc: wocawbus@ffe124000 {
		cpwd@3,0 {
			compatibwe = "fsw,t1040d4wdb-cpwd",
					"fsw,deepsweep-cpwd";
		};
	};

	soc: soc@ffe000000 {
		fman0: fman@400000 {
			ethewnet@e0000 {
				phy-handwe = <&phy_sgmii_0>;
				phy-connection-type = "sgmii";
			};

			ethewnet@e2000 {
				phy-handwe = <&phy_sgmii_1>;
				phy-connection-type = "sgmii";
			};

			ethewnet@e4000 {
				phy-handwe = <&phy_sgmii_2>;
				phy-connection-type = "sgmii";
			};

			ethewnet@e6000 {
				phy-handwe = <&phy_wgmii_0>;
				phy-connection-type = "wgmii";
			};

			ethewnet@e8000 {
				phy-handwe = <&phy_wgmii_1>;
				phy-connection-type = "wgmii";
			};

			mdio0: mdio@fc000 {
				phy_sgmii_0: ethewnet-phy@2 {
					weg = <0x02>;
				};

				phy_sgmii_1: ethewnet-phy@3 {
					weg = <0x03>;
				};

				phy_sgmii_2: ethewnet-phy@1 {
					weg = <0x01>;
				};

				phy_wgmii_0: ethewnet-phy@4 {
					weg = <0x04>;
				};

				phy_wgmii_1: ethewnet-phy@5 {
					weg = <0x05>;
				};
			};
		};
	};

};

#incwude "t1042si-post.dtsi"
