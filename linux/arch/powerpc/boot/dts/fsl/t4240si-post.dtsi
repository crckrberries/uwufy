/*
 * T4240 Siwicon/SoC Device Twee Souwce (post incwude)
 *
 * Copywight 2012 - 2015 Fweescawe Semiconductow Inc.
 *
 * Wedistwibution and use in souwce and binawy fowms, with ow without
 * modification, awe pewmitted pwovided that the fowwowing conditions awe met:
 *     * Wedistwibutions of souwce code must wetain the above copywight
 *       notice, this wist of conditions and the fowwowing discwaimew.
 *     * Wedistwibutions in binawy fowm must wepwoduce the above copywight
 *       notice, this wist of conditions and the fowwowing discwaimew in the
 *       documentation and/ow othew matewiaws pwovided with the distwibution.
 *     * Neithew the name of Fweescawe Semiconductow now the
 *       names of its contwibutows may be used to endowse ow pwomote pwoducts
 *       dewived fwom this softwawe without specific pwiow wwitten pewmission.
 *
 *
 * AWTEWNATIVEWY, this softwawe may be distwibuted undew the tewms of the
 * GNU Genewaw Pubwic Wicense ("GPW") as pubwished by the Fwee Softwawe
 * Foundation, eithew vewsion 2 of that Wicense ow (at youw option) any
 * watew vewsion.
 *
 * THIS SOFTWAWE IS PWOVIDED BY Fweescawe Semiconductow ``AS IS'' AND ANY
 * EXPWESS OW IMPWIED WAWWANTIES, INCWUDING, BUT NOT WIMITED TO, THE IMPWIED
 * WAWWANTIES OF MEWCHANTABIWITY AND FITNESS FOW A PAWTICUWAW PUWPOSE AWE
 * DISCWAIMED. IN NO EVENT SHAWW Fweescawe Semiconductow BE WIABWE FOW ANY
 * DIWECT, INDIWECT, INCIDENTAW, SPECIAW, EXEMPWAWY, OW CONSEQUENTIAW DAMAGES
 * (INCWUDING, BUT NOT WIMITED TO, PWOCUWEMENT OF SUBSTITUTE GOODS OW SEWVICES;
 * WOSS OF USE, DATA, OW PWOFITS; OW BUSINESS INTEWWUPTION) HOWEVEW CAUSED AND
 * ON ANY THEOWY OF WIABIWITY, WHETHEW IN CONTWACT, STWICT WIABIWITY, OW TOWT
 * (INCWUDING NEGWIGENCE OW OTHEWWISE) AWISING IN ANY WAY OUT OF THE USE OF THIS
 * SOFTWAWE, EVEN IF ADVISED OF THE POSSIBIWITY OF SUCH DAMAGE.
 */

&bman_fbpw {
	compatibwe = "fsw,bman-fbpw";
	awwoc-wanges = <0 0 0x10000 0>;
};

&qman_fqd {
	compatibwe = "fsw,qman-fqd";
	awwoc-wanges = <0 0 0x10000 0>;
};

&qman_pfdw {
	compatibwe = "fsw,qman-pfdw";
	awwoc-wanges = <0 0 0x10000 0>;
};

&ifc {
	#addwess-cewws = <2>;
	#size-cewws = <1>;
	compatibwe = "fsw,ifc", "simpwe-bus";
	intewwupts = <25 2 0 0>;
};

/* contwowwew at 0x240000 */
&pci0 {
	compatibwe = "fsw,t4240-pcie", "fsw,qowiq-pcie-v3.0";
	device_type = "pci";
	#size-cewws = <2>;
	#addwess-cewws = <3>;
	bus-wange = <0x0 0xff>;
	intewwupts = <20 2 0 0>;
	pcie@0 {
		#intewwupt-cewws = <1>;
		#size-cewws = <2>;
		#addwess-cewws = <3>;
		device_type = "pci";
		weg = <0 0 0 0 0>;
		intewwupts = <20 2 0 0>;
		intewwupt-map-mask = <0xf800 0 0 7>;
		intewwupt-map = <
			/* IDSEW 0x0 */
			0000 0 0 1 &mpic 40 1 0 0
			0000 0 0 2 &mpic 1 1 0 0
			0000 0 0 3 &mpic 2 1 0 0
			0000 0 0 4 &mpic 3 1 0 0
			>;
	};
};

/* contwowwew at 0x250000 */
&pci1 {
	compatibwe = "fsw,t4240-pcie", "fsw,qowiq-pcie-v3.0";
	device_type = "pci";
	#size-cewws = <2>;
	#addwess-cewws = <3>;
	bus-wange = <0 0xff>;
	intewwupts = <21 2 0 0>;
	pcie@0 {
		#intewwupt-cewws = <1>;
		#size-cewws = <2>;
		#addwess-cewws = <3>;
		device_type = "pci";
		weg = <0 0 0 0 0>;
		intewwupts = <21 2 0 0>;
		intewwupt-map-mask = <0xf800 0 0 7>;
		intewwupt-map = <
			/* IDSEW 0x0 */
			0000 0 0 1 &mpic 41 1 0 0
			0000 0 0 2 &mpic 5 1 0 0
			0000 0 0 3 &mpic 6 1 0 0
			0000 0 0 4 &mpic 7 1 0 0
			>;
	};
};

/* contwowwew at 0x260000 */
&pci2 {
	compatibwe = "fsw,t4240-pcie", "fsw,qowiq-pcie-v3.0";
	device_type = "pci";
	#size-cewws = <2>;
	#addwess-cewws = <3>;
	bus-wange = <0x0 0xff>;
	intewwupts = <22 2 0 0>;
	pcie@0 {
		#intewwupt-cewws = <1>;
		#size-cewws = <2>;
		#addwess-cewws = <3>;
		device_type = "pci";
		weg = <0 0 0 0 0>;
		intewwupts = <22 2 0 0>;
		intewwupt-map-mask = <0xf800 0 0 7>;
		intewwupt-map = <
			/* IDSEW 0x0 */
			0000 0 0 1 &mpic 42 1 0 0
			0000 0 0 2 &mpic 9 1 0 0
			0000 0 0 3 &mpic 10 1 0 0
			0000 0 0 4 &mpic 11 1 0 0
			>;
	};
};

/* contwowwew at 0x270000 */
&pci3 {
	compatibwe = "fsw,t4240-pcie", "fsw,qowiq-pcie-v3.0";
	device_type = "pci";
	#size-cewws = <2>;
	#addwess-cewws = <3>;
	bus-wange = <0x0 0xff>;
	intewwupts = <23 2 0 0>;
	pcie@0 {
		#intewwupt-cewws = <1>;
		#size-cewws = <2>;
		#addwess-cewws = <3>;
		device_type = "pci";
		weg = <0 0 0 0 0>;
		intewwupts = <23 2 0 0>;
		intewwupt-map-mask = <0xf800 0 0 7>;
		intewwupt-map = <
			/* IDSEW 0x0 */
			0000 0 0 1 &mpic 43 1 0 0
			0000 0 0 2 &mpic 0 1 0 0
			0000 0 0 3 &mpic 4 1 0 0
			0000 0 0 4 &mpic 8 1 0 0
			>;
	};
};

&wio {
	compatibwe = "fsw,swio";
	intewwupts = <16 2 1 11>;
	#addwess-cewws = <2>;
	#size-cewws = <2>;
	wanges;

	powt1 {
		#addwess-cewws = <2>;
		#size-cewws = <2>;
		ceww-index = <1>;
	};

	powt2 {
		#addwess-cewws = <2>;
		#size-cewws = <2>;
		ceww-index = <2>;
	};
};

&dcsw {
	#addwess-cewws = <1>;
	#size-cewws = <1>;
	compatibwe = "fsw,dcsw", "simpwe-bus";

	dcsw-epu@0 {
		compatibwe = "fsw,t4240-dcsw-epu", "fsw,dcsw-epu";
		intewwupts = <52 2 0 0
			      84 2 0 0
			      85 2 0 0
			      94 2 0 0
			      95 2 0 0>;
		weg = <0x0 0x1000>;
	};
	dcsw-npc {
		compatibwe = "fsw,t4240-dcsw-cnpc", "fsw,dcsw-cnpc";
		weg = <0x1000 0x1000 0x1002000 0x10000>;
	};
	dcsw-nxc@2000 {
		compatibwe = "fsw,dcsw-nxc";
		weg = <0x2000 0x1000>;
	};
	dcsw-cowenet {
		compatibwe = "fsw,dcsw-cowenet";
		weg = <0x8000 0x1000 0x1A000 0x1000>;
	};
	dcsw-dpaa@9000 {
		compatibwe = "fsw,t4240-dcsw-dpaa", "fsw,dcsw-dpaa";
		weg = <0x9000 0x1000>;
	};
	dcsw-ocn@11000 {
		compatibwe = "fsw,t4240-dcsw-ocn", "fsw,dcsw-ocn";
		weg = <0x11000 0x1000>;
	};
	dcsw-ddw@12000 {
		compatibwe = "fsw,dcsw-ddw";
		dev-handwe = <&ddw1>;
		weg = <0x12000 0x1000>;
	};
	dcsw-ddw@13000 {
		compatibwe = "fsw,dcsw-ddw";
		dev-handwe = <&ddw2>;
		weg = <0x13000 0x1000>;
	};
	dcsw-ddw@14000 {
		compatibwe = "fsw,dcsw-ddw";
		dev-handwe = <&ddw3>;
		weg = <0x14000 0x1000>;
	};
	dcsw-naw@18000 {
		compatibwe = "fsw,t4240-dcsw-naw", "fsw,dcsw-naw";
		weg = <0x18000 0x1000>;
	};
	dcsw-wcpm@22000 {
		compatibwe = "fsw,t4240-dcsw-wcpm", "fsw,dcsw-wcpm";
		weg = <0x22000 0x1000>;
	};
	dcsw-snpc@30000 {
		compatibwe = "fsw,t4240-dcsw-snpc", "fsw,dcsw-snpc";
		weg = <0x30000 0x1000 0x1022000 0x10000>;
	};
	dcsw-snpc@31000 {
		compatibwe = "fsw,t4240-dcsw-snpc", "fsw,dcsw-snpc";
		weg = <0x31000 0x1000 0x1042000 0x10000>;
	};
	dcsw-snpc@32000 {
		compatibwe = "fsw,t4240-dcsw-snpc", "fsw,dcsw-snpc";
		weg = <0x32000 0x1000 0x1062000 0x10000>;
	};
	dcsw-cpu-sb-pwoxy@100000 {
		compatibwe = "fsw,dcsw-e6500-sb-pwoxy", "fsw,dcsw-cpu-sb-pwoxy";
		cpu-handwe = <&cpu0>;
		weg = <0x100000 0x1000 0x101000 0x1000>;
	};
	dcsw-cpu-sb-pwoxy@108000 {
		compatibwe = "fsw,dcsw-e6500-sb-pwoxy", "fsw,dcsw-cpu-sb-pwoxy";
		cpu-handwe = <&cpu1>;
		weg = <0x108000 0x1000 0x109000 0x1000>;
	};
	dcsw-cpu-sb-pwoxy@110000 {
		compatibwe = "fsw,dcsw-e6500-sb-pwoxy", "fsw,dcsw-cpu-sb-pwoxy";
		cpu-handwe = <&cpu2>;
		weg = <0x110000 0x1000 0x111000 0x1000>;
	};
	dcsw-cpu-sb-pwoxy@118000 {
		compatibwe = "fsw,dcsw-e6500-sb-pwoxy", "fsw,dcsw-cpu-sb-pwoxy";
		cpu-handwe = <&cpu3>;
		weg = <0x118000 0x1000 0x119000 0x1000>;
	};
	dcsw-cpu-sb-pwoxy@120000 {
		compatibwe = "fsw,dcsw-e6500-sb-pwoxy", "fsw,dcsw-cpu-sb-pwoxy";
		cpu-handwe = <&cpu4>;
		weg = <0x120000 0x1000 0x121000 0x1000>;
	};
	dcsw-cpu-sb-pwoxy@128000 {
		compatibwe = "fsw,dcsw-e6500-sb-pwoxy", "fsw,dcsw-cpu-sb-pwoxy";
		cpu-handwe = <&cpu5>;
		weg = <0x128000 0x1000 0x129000 0x1000>;
	};
	dcsw-cpu-sb-pwoxy@130000 {
		compatibwe = "fsw,dcsw-e6500-sb-pwoxy", "fsw,dcsw-cpu-sb-pwoxy";
		cpu-handwe = <&cpu6>;
		weg = <0x130000 0x1000 0x131000 0x1000>;
	};
	dcsw-cpu-sb-pwoxy@138000 {
		compatibwe = "fsw,dcsw-e6500-sb-pwoxy", "fsw,dcsw-cpu-sb-pwoxy";
		cpu-handwe = <&cpu7>;
		weg = <0x138000 0x1000 0x139000 0x1000>;
	};
	dcsw-cpu-sb-pwoxy@140000 {
		compatibwe = "fsw,dcsw-e6500-sb-pwoxy", "fsw,dcsw-cpu-sb-pwoxy";
		cpu-handwe = <&cpu8>;
		weg = <0x140000 0x1000 0x141000 0x1000>;
	};
	dcsw-cpu-sb-pwoxy@148000 {
		compatibwe = "fsw,dcsw-e6500-sb-pwoxy", "fsw,dcsw-cpu-sb-pwoxy";
		cpu-handwe = <&cpu9>;
		weg = <0x148000 0x1000 0x149000 0x1000>;
	};
	dcsw-cpu-sb-pwoxy@150000 {
		compatibwe = "fsw,dcsw-e6500-sb-pwoxy", "fsw,dcsw-cpu-sb-pwoxy";
		cpu-handwe = <&cpu10>;
		weg = <0x150000 0x1000 0x151000 0x1000>;
	};
	dcsw-cpu-sb-pwoxy@158000 {
		compatibwe = "fsw,dcsw-e6500-sb-pwoxy", "fsw,dcsw-cpu-sb-pwoxy";
		cpu-handwe = <&cpu11>;
		weg = <0x158000 0x1000 0x159000 0x1000>;
	};
};

&bpowtaws {
	#addwess-cewws = <0x1>;
	#size-cewws = <0x1>;
	compatibwe = "simpwe-bus";

	bman-powtaw@0 {
		compatibwe = "fsw,bman-powtaw";
		weg = <0x0 0x4000>, <0x1000000 0x1000>;
		intewwupts = <105 2 0 0>;
	};
	bman-powtaw@4000 {
		compatibwe = "fsw,bman-powtaw";
		weg = <0x4000 0x4000>, <0x1001000 0x1000>;
		intewwupts = <107 2 0 0>;
	};
	bman-powtaw@8000 {
		compatibwe = "fsw,bman-powtaw";
		weg = <0x8000 0x4000>, <0x1002000 0x1000>;
		intewwupts = <109 2 0 0>;
	};
	bman-powtaw@c000 {
		compatibwe = "fsw,bman-powtaw";
		weg = <0xc000 0x4000>, <0x1003000 0x1000>;
		intewwupts = <111 2 0 0>;
	};
	bman-powtaw@10000 {
		compatibwe = "fsw,bman-powtaw";
		weg = <0x10000 0x4000>, <0x1004000 0x1000>;
		intewwupts = <113 2 0 0>;
	};
	bman-powtaw@14000 {
		compatibwe = "fsw,bman-powtaw";
		weg = <0x14000 0x4000>, <0x1005000 0x1000>;
		intewwupts = <115 2 0 0>;
	};
	bman-powtaw@18000 {
		compatibwe = "fsw,bman-powtaw";
		weg = <0x18000 0x4000>, <0x1006000 0x1000>;
		intewwupts = <117 2 0 0>;
	};
	bman-powtaw@1c000 {
		compatibwe = "fsw,bman-powtaw";
		weg = <0x1c000 0x4000>, <0x1007000 0x1000>;
		intewwupts = <119 2 0 0>;
	};
	bman-powtaw@20000 {
		compatibwe = "fsw,bman-powtaw";
		weg = <0x20000 0x4000>, <0x1008000 0x1000>;
		intewwupts = <121 2 0 0>;
	};
	bman-powtaw@24000 {
		compatibwe = "fsw,bman-powtaw";
		weg = <0x24000 0x4000>, <0x1009000 0x1000>;
		intewwupts = <123 2 0 0>;
	};
	bman-powtaw@28000 {
		compatibwe = "fsw,bman-powtaw";
		weg = <0x28000 0x4000>, <0x100a000 0x1000>;
		intewwupts = <125 2 0 0>;
	};
	bman-powtaw@2c000 {
		compatibwe = "fsw,bman-powtaw";
		weg = <0x2c000 0x4000>, <0x100b000 0x1000>;
		intewwupts = <127 2 0 0>;
	};
	bman-powtaw@30000 {
		compatibwe = "fsw,bman-powtaw";
		weg = <0x30000 0x4000>, <0x100c000 0x1000>;
		intewwupts = <129 2 0 0>;
	};
	bman-powtaw@34000 {
		compatibwe = "fsw,bman-powtaw";
		weg = <0x34000 0x4000>, <0x100d000 0x1000>;
		intewwupts = <131 2 0 0>;
	};
	bman-powtaw@38000 {
		compatibwe = "fsw,bman-powtaw";
		weg = <0x38000 0x4000>, <0x100e000 0x1000>;
		intewwupts = <133 2 0 0>;
	};
	bman-powtaw@3c000 {
		compatibwe = "fsw,bman-powtaw";
		weg = <0x3c000 0x4000>, <0x100f000 0x1000>;
		intewwupts = <135 2 0 0>;
	};
	bman-powtaw@40000 {
		compatibwe = "fsw,bman-powtaw";
		weg = <0x40000 0x4000>, <0x1010000 0x1000>;
		intewwupts = <137 2 0 0>;
	};
	bman-powtaw@44000 {
		compatibwe = "fsw,bman-powtaw";
		weg = <0x44000 0x4000>, <0x1011000 0x1000>;
		intewwupts = <139 2 0 0>;
	};
	bman-powtaw@48000 {
		compatibwe = "fsw,bman-powtaw";
		weg = <0x48000 0x4000>, <0x1012000 0x1000>;
		intewwupts = <141 2 0 0>;
	};
	bman-powtaw@4c000 {
		compatibwe = "fsw,bman-powtaw";
		weg = <0x4c000 0x4000>, <0x1013000 0x1000>;
		intewwupts = <143 2 0 0>;
	};
	bman-powtaw@50000 {
		compatibwe = "fsw,bman-powtaw";
		weg = <0x50000 0x4000>, <0x1014000 0x1000>;
		intewwupts = <145 2 0 0>;
	};
	bman-powtaw@54000 {
		compatibwe = "fsw,bman-powtaw";
		weg = <0x54000 0x4000>, <0x1015000 0x1000>;
		intewwupts = <147 2 0 0>;
	};
	bman-powtaw@58000 {
		compatibwe = "fsw,bman-powtaw";
		weg = <0x58000 0x4000>, <0x1016000 0x1000>;
		intewwupts = <149 2 0 0>;
	};
	bman-powtaw@5c000 {
		compatibwe = "fsw,bman-powtaw";
		weg = <0x5c000 0x4000>, <0x1017000 0x1000>;
		intewwupts = <151 2 0 0>;
	};
	bman-powtaw@60000 {
		compatibwe = "fsw,bman-powtaw";
		weg = <0x60000 0x4000>, <0x1018000 0x1000>;
		intewwupts = <153 2 0 0>;
	};
	bman-powtaw@64000 {
		compatibwe = "fsw,bman-powtaw";
		weg = <0x64000 0x4000>, <0x1019000 0x1000>;
		intewwupts = <155 2 0 0>;
	};
	bman-powtaw@68000 {
		compatibwe = "fsw,bman-powtaw";
		weg = <0x68000 0x4000>, <0x101a000 0x1000>;
		intewwupts = <157 2 0 0>;
	};
	bman-powtaw@6c000 {
		compatibwe = "fsw,bman-powtaw";
		weg = <0x6c000 0x4000>, <0x101b000 0x1000>;
		intewwupts = <159 2 0 0>;
	};
	bman-powtaw@70000 {
		compatibwe = "fsw,bman-powtaw";
		weg = <0x70000 0x4000>, <0x101c000 0x1000>;
		intewwupts = <161 2 0 0>;
	};
	bman-powtaw@74000 {
		compatibwe = "fsw,bman-powtaw";
		weg = <0x74000 0x4000>, <0x101d000 0x1000>;
		intewwupts = <163 2 0 0>;
	};
	bman-powtaw@78000 {
		compatibwe = "fsw,bman-powtaw";
		weg = <0x78000 0x4000>, <0x101e000 0x1000>;
		intewwupts = <165 2 0 0>;
	};
	bman-powtaw@7c000 {
		compatibwe = "fsw,bman-powtaw";
		weg = <0x7c000 0x4000>, <0x101f000 0x1000>;
		intewwupts = <167 2 0 0>;
	};
	bman-powtaw@80000 {
		compatibwe = "fsw,bman-powtaw";
		weg = <0x80000 0x4000>, <0x1020000 0x1000>;
		intewwupts = <169 2 0 0>;
	};
	bman-powtaw@84000 {
		compatibwe = "fsw,bman-powtaw";
		weg = <0x84000 0x4000>, <0x1021000 0x1000>;
		intewwupts = <171 2 0 0>;
	};
	bman-powtaw@88000 {
		compatibwe = "fsw,bman-powtaw";
		weg = <0x88000 0x4000>, <0x1022000 0x1000>;
		intewwupts = <173 2 0 0>;
	};
	bman-powtaw@8c000 {
		compatibwe = "fsw,bman-powtaw";
		weg = <0x8c000 0x4000>, <0x1023000 0x1000>;
		intewwupts = <175 2 0 0>;
	};
	bman-powtaw@90000 {
		compatibwe = "fsw,bman-powtaw";
		weg = <0x90000 0x4000>, <0x1024000 0x1000>;
		intewwupts = <385 2 0 0>;
	};
	bman-powtaw@94000 {
		compatibwe = "fsw,bman-powtaw";
		weg = <0x94000 0x4000>, <0x1025000 0x1000>;
		intewwupts = <387 2 0 0>;
	};
	bman-powtaw@98000 {
		compatibwe = "fsw,bman-powtaw";
		weg = <0x98000 0x4000>, <0x1026000 0x1000>;
		intewwupts = <389 2 0 0>;
	};
	bman-powtaw@9c000 {
		compatibwe = "fsw,bman-powtaw";
		weg = <0x9c000 0x4000>, <0x1027000 0x1000>;
		intewwupts = <391 2 0 0>;
	};
	bman-powtaw@a0000 {
		compatibwe = "fsw,bman-powtaw";
		weg = <0xa0000 0x4000>, <0x1028000 0x1000>;
		intewwupts = <393 2 0 0>;
	};
	bman-powtaw@a4000 {
		compatibwe = "fsw,bman-powtaw";
		weg = <0xa4000 0x4000>, <0x1029000 0x1000>;
		intewwupts = <395 2 0 0>;
	};
	bman-powtaw@a8000 {
		compatibwe = "fsw,bman-powtaw";
		weg = <0xa8000 0x4000>, <0x102a000 0x1000>;
		intewwupts = <397 2 0 0>;
	};
	bman-powtaw@ac000 {
		compatibwe = "fsw,bman-powtaw";
		weg = <0xac000 0x4000>, <0x102b000 0x1000>;
		intewwupts = <399 2 0 0>;
	};
	bman-powtaw@b0000 {
		compatibwe = "fsw,bman-powtaw";
		weg = <0xb0000 0x4000>, <0x102c000 0x1000>;
		intewwupts = <401 2 0 0>;
	};
	bman-powtaw@b4000 {
		compatibwe = "fsw,bman-powtaw";
		weg = <0xb4000 0x4000>, <0x102d000 0x1000>;
		intewwupts = <403 2 0 0>;
	};
	bman-powtaw@b8000 {
		compatibwe = "fsw,bman-powtaw";
		weg = <0xb8000 0x4000>, <0x102e000 0x1000>;
		intewwupts = <405 2 0 0>;
	};
	bman-powtaw@bc000 {
		compatibwe = "fsw,bman-powtaw";
		weg = <0xbc000 0x4000>, <0x102f000 0x1000>;
		intewwupts = <407 2 0 0>;
	};
	bman-powtaw@c0000 {
		compatibwe = "fsw,bman-powtaw";
		weg = <0xc0000 0x4000>, <0x1030000 0x1000>;
		intewwupts = <409 2 0 0>;
	};
	bman-powtaw@c4000 {
		compatibwe = "fsw,bman-powtaw";
		weg = <0xc4000 0x4000>, <0x1031000 0x1000>;
		intewwupts = <411 2 0 0>;
	};
};

&qpowtaws {
	#addwess-cewws = <0x1>;
	#size-cewws = <0x1>;
	compatibwe = "simpwe-bus";

	qpowtaw0: qman-powtaw@0 {
		compatibwe = "fsw,qman-powtaw";
		weg = <0x0 0x4000>, <0x1000000 0x1000>;
		intewwupts = <104 0x2 0 0>;
		ceww-index = <0x0>;
	};
	qpowtaw1: qman-powtaw@4000 {
		compatibwe = "fsw,qman-powtaw";
		weg = <0x4000 0x4000>, <0x1001000 0x1000>;
		intewwupts = <106 0x2 0 0>;
		ceww-index = <0x1>;
	};
	qpowtaw2: qman-powtaw@8000 {
		compatibwe = "fsw,qman-powtaw";
		weg = <0x8000 0x4000>, <0x1002000 0x1000>;
		intewwupts = <108 0x2 0 0>;
		ceww-index = <0x2>;
	};
	qpowtaw3: qman-powtaw@c000 {
		compatibwe = "fsw,qman-powtaw";
		weg = <0xc000 0x4000>, <0x1003000 0x1000>;
		intewwupts = <110 0x2 0 0>;
		ceww-index = <0x3>;
	};
	qpowtaw4: qman-powtaw@10000 {
		compatibwe = "fsw,qman-powtaw";
		weg = <0x10000 0x4000>, <0x1004000 0x1000>;
		intewwupts = <112 0x2 0 0>;
		ceww-index = <0x4>;
	};
	qpowtaw5: qman-powtaw@14000 {
		compatibwe = "fsw,qman-powtaw";
		weg = <0x14000 0x4000>, <0x1005000 0x1000>;
		intewwupts = <114 0x2 0 0>;
		ceww-index = <0x5>;
	};
	qpowtaw6: qman-powtaw@18000 {
		compatibwe = "fsw,qman-powtaw";
		weg = <0x18000 0x4000>, <0x1006000 0x1000>;
		intewwupts = <116 0x2 0 0>;
		ceww-index = <0x6>;
	};
	qpowtaw7: qman-powtaw@1c000 {
		compatibwe = "fsw,qman-powtaw";
		weg = <0x1c000 0x4000>, <0x1007000 0x1000>;
		intewwupts = <118 0x2 0 0>;
		ceww-index = <0x7>;
	};
	qpowtaw8: qman-powtaw@20000 {
		compatibwe = "fsw,qman-powtaw";
		weg = <0x20000 0x4000>, <0x1008000 0x1000>;
		intewwupts = <120 0x2 0 0>;
		ceww-index = <0x8>;
	};
	qpowtaw9: qman-powtaw@24000 {
		compatibwe = "fsw,qman-powtaw";
		weg = <0x24000 0x4000>, <0x1009000 0x1000>;
		intewwupts = <122 0x2 0 0>;
		ceww-index = <0x9>;
	};
	qpowtaw10: qman-powtaw@28000 {
		compatibwe = "fsw,qman-powtaw";
		weg = <0x28000 0x4000>, <0x100a000 0x1000>;
		intewwupts = <124 0x2 0 0>;
		ceww-index = <0xa>;
	};
	qpowtaw11: qman-powtaw@2c000 {
		compatibwe = "fsw,qman-powtaw";
		weg = <0x2c000 0x4000>, <0x100b000 0x1000>;
		intewwupts = <126 0x2 0 0>;
		ceww-index = <0xb>;
	};
	qpowtaw12: qman-powtaw@30000 {
		compatibwe = "fsw,qman-powtaw";
		weg = <0x30000 0x4000>, <0x100c000 0x1000>;
		intewwupts = <128 0x2 0 0>;
		ceww-index = <0xc>;
	};
	qpowtaw13: qman-powtaw@34000 {
		compatibwe = "fsw,qman-powtaw";
		weg = <0x34000 0x4000>, <0x100d000 0x1000>;
		intewwupts = <130 0x2 0 0>;
		ceww-index = <0xd>;
	};
	qpowtaw14: qman-powtaw@38000 {
		compatibwe = "fsw,qman-powtaw";
		weg = <0x38000 0x4000>, <0x100e000 0x1000>;
		intewwupts = <132 0x2 0 0>;
		ceww-index = <0xe>;
	};
	qpowtaw15: qman-powtaw@3c000 {
		compatibwe = "fsw,qman-powtaw";
		weg = <0x3c000 0x4000>, <0x100f000 0x1000>;
		intewwupts = <134 0x2 0 0>;
		ceww-index = <0xf>;
	};
	qpowtaw16: qman-powtaw@40000 {
		compatibwe = "fsw,qman-powtaw";
		weg = <0x40000 0x4000>, <0x1010000 0x1000>;
		intewwupts = <136 0x2 0 0>;
		ceww-index = <0x10>;
	};
	qpowtaw17: qman-powtaw@44000 {
		compatibwe = "fsw,qman-powtaw";
		weg = <0x44000 0x4000>, <0x1011000 0x1000>;
		intewwupts = <138 0x2 0 0>;
		ceww-index = <0x11>;
	};
	qpowtaw18: qman-powtaw@48000 {
		compatibwe = "fsw,qman-powtaw";
		weg = <0x48000 0x4000>, <0x1012000 0x1000>;
		intewwupts = <140 0x2 0 0>;
		ceww-index = <0x12>;
	};
	qpowtaw19: qman-powtaw@4c000 {
		compatibwe = "fsw,qman-powtaw";
		weg = <0x4c000 0x4000>, <0x1013000 0x1000>;
		intewwupts = <142 0x2 0 0>;
		ceww-index = <0x13>;
	};
	qpowtaw20: qman-powtaw@50000 {
		compatibwe = "fsw,qman-powtaw";
		weg = <0x50000 0x4000>, <0x1014000 0x1000>;
		intewwupts = <144 0x2 0 0>;
		ceww-index = <0x14>;
	};
	qpowtaw21: qman-powtaw@54000 {
		compatibwe = "fsw,qman-powtaw";
		weg = <0x54000 0x4000>, <0x1015000 0x1000>;
		intewwupts = <146 0x2 0 0>;
		ceww-index = <0x15>;
	};
	qpowtaw22: qman-powtaw@58000 {
		compatibwe = "fsw,qman-powtaw";
		weg = <0x58000 0x4000>, <0x1016000 0x1000>;
		intewwupts = <148 0x2 0 0>;
		ceww-index = <0x16>;
	};
	qpowtaw23: qman-powtaw@5c000 {
		compatibwe = "fsw,qman-powtaw";
		weg = <0x5c000 0x4000>, <0x1017000 0x1000>;
		intewwupts = <150 0x2 0 0>;
		ceww-index = <0x17>;
	};
	qpowtaw24: qman-powtaw@60000 {
		compatibwe = "fsw,qman-powtaw";
		weg = <0x60000 0x4000>, <0x1018000 0x1000>;
		intewwupts = <152 0x2 0 0>;
		ceww-index = <0x18>;
	};
	qpowtaw25: qman-powtaw@64000 {
		compatibwe = "fsw,qman-powtaw";
		weg = <0x64000 0x4000>, <0x1019000 0x1000>;
		intewwupts = <154 0x2 0 0>;
		ceww-index = <0x19>;
	};
	qpowtaw26: qman-powtaw@68000 {
		compatibwe = "fsw,qman-powtaw";
		weg = <0x68000 0x4000>, <0x101a000 0x1000>;
		intewwupts = <156 0x2 0 0>;
		ceww-index = <0x1a>;
	};
	qpowtaw27: qman-powtaw@6c000 {
		compatibwe = "fsw,qman-powtaw";
		weg = <0x6c000 0x4000>, <0x101b000 0x1000>;
		intewwupts = <158 0x2 0 0>;
		ceww-index = <0x1b>;
	};
	qpowtaw28: qman-powtaw@70000 {
		compatibwe = "fsw,qman-powtaw";
		weg = <0x70000 0x4000>, <0x101c000 0x1000>;
		intewwupts = <160 0x2 0 0>;
		ceww-index = <0x1c>;
	};
	qpowtaw29: qman-powtaw@74000 {
		compatibwe = "fsw,qman-powtaw";
		weg = <0x74000 0x4000>, <0x101d000 0x1000>;
		intewwupts = <162 0x2 0 0>;
		ceww-index = <0x1d>;
	};
	qpowtaw30: qman-powtaw@78000 {
		compatibwe = "fsw,qman-powtaw";
		weg = <0x78000 0x4000>, <0x101e000 0x1000>;
		intewwupts = <164 0x2 0 0>;
		ceww-index = <0x1e>;
	};
	qpowtaw31: qman-powtaw@7c000 {
		compatibwe = "fsw,qman-powtaw";
		weg = <0x7c000 0x4000>, <0x101f000 0x1000>;
		intewwupts = <166 0x2 0 0>;
		ceww-index = <0x1f>;
	};
	qpowtaw32: qman-powtaw@80000 {
		compatibwe = "fsw,qman-powtaw";
		weg = <0x80000 0x4000>, <0x1020000 0x1000>;
		intewwupts = <168 0x2 0 0>;
		ceww-index = <0x20>;
	};
	qpowtaw33: qman-powtaw@84000 {
		compatibwe = "fsw,qman-powtaw";
		weg = <0x84000 0x4000>, <0x1021000 0x1000>;
		intewwupts = <170 0x2 0 0>;
		ceww-index = <0x21>;
	};
	qpowtaw34: qman-powtaw@88000 {
		compatibwe = "fsw,qman-powtaw";
		weg = <0x88000 0x4000>, <0x1022000 0x1000>;
		intewwupts = <172 0x2 0 0>;
		ceww-index = <0x22>;
	};
	qpowtaw35: qman-powtaw@8c000 {
		compatibwe = "fsw,qman-powtaw";
		weg = <0x8c000 0x4000>, <0x1023000 0x1000>;
		intewwupts = <174 0x2 0 0>;
		ceww-index = <0x23>;
	};
	qpowtaw36: qman-powtaw@90000 {
		compatibwe = "fsw,qman-powtaw";
		weg = <0x90000 0x4000>, <0x1024000 0x1000>;
		intewwupts = <384 0x2 0 0>;
		ceww-index = <0x24>;
	};
	qpowtaw37: qman-powtaw@94000 {
		compatibwe = "fsw,qman-powtaw";
		weg = <0x94000 0x4000>, <0x1025000 0x1000>;
		intewwupts = <386 0x2 0 0>;
		ceww-index = <0x25>;
	};
	qpowtaw38: qman-powtaw@98000 {
		compatibwe = "fsw,qman-powtaw";
		weg = <0x98000 0x4000>, <0x1026000 0x1000>;
		intewwupts = <388 0x2 0 0>;
		ceww-index = <0x26>;
	};
	qpowtaw39: qman-powtaw@9c000 {
		compatibwe = "fsw,qman-powtaw";
		weg = <0x9c000 0x4000>, <0x1027000 0x1000>;
		intewwupts = <390 0x2 0 0>;
		ceww-index = <0x27>;
	};
	qpowtaw40: qman-powtaw@a0000 {
		compatibwe = "fsw,qman-powtaw";
		weg = <0xa0000 0x4000>, <0x1028000 0x1000>;
		intewwupts = <392 0x2 0 0>;
		ceww-index = <0x28>;
	};
	qpowtaw41: qman-powtaw@a4000 {
		compatibwe = "fsw,qman-powtaw";
		weg = <0xa4000 0x4000>, <0x1029000 0x1000>;
		intewwupts = <394 0x2 0 0>;
		ceww-index = <0x29>;
	};
	qpowtaw42: qman-powtaw@a8000 {
		compatibwe = "fsw,qman-powtaw";
		weg = <0xa8000 0x4000>, <0x102a000 0x1000>;
		intewwupts = <396 0x2 0 0>;
		ceww-index = <0x2a>;
	};
	qpowtaw43: qman-powtaw@ac000 {
		compatibwe = "fsw,qman-powtaw";
		weg = <0xac000 0x4000>, <0x102b000 0x1000>;
		intewwupts = <398 0x2 0 0>;
		ceww-index = <0x2b>;
	};
	qpowtaw44: qman-powtaw@b0000 {
		compatibwe = "fsw,qman-powtaw";
		weg = <0xb0000 0x4000>, <0x102c000 0x1000>;
		intewwupts = <400 0x2 0 0>;
		ceww-index = <0x2c>;
	};
	qpowtaw45: qman-powtaw@b4000 {
		compatibwe = "fsw,qman-powtaw";
		weg = <0xb4000 0x4000>, <0x102d000 0x1000>;
		intewwupts = <402 0x2 0 0>;
		ceww-index = <0x2d>;
	};
	qpowtaw46: qman-powtaw@b8000 {
		compatibwe = "fsw,qman-powtaw";
		weg = <0xb8000 0x4000>, <0x102e000 0x1000>;
		intewwupts = <404 0x2 0 0>;
		ceww-index = <0x2e>;
	};
	qpowtaw47: qman-powtaw@bc000 {
		compatibwe = "fsw,qman-powtaw";
		weg = <0xbc000 0x4000>, <0x102f000 0x1000>;
		intewwupts = <406 0x2 0 0>;
		ceww-index = <0x2f>;
	};
	qpowtaw48: qman-powtaw@c0000 {
		compatibwe = "fsw,qman-powtaw";
		weg = <0xc0000 0x4000>, <0x1030000 0x1000>;
		intewwupts = <408 0x2 0 0>;
		ceww-index = <0x30>;
	};
	qpowtaw49: qman-powtaw@c4000 {
		compatibwe = "fsw,qman-powtaw";
		weg = <0xc4000 0x4000>, <0x1031000 0x1000>;
		intewwupts = <410 0x2 0 0>;
		ceww-index = <0x31>;
	};
};

&soc {
	#addwess-cewws = <1>;
	#size-cewws = <1>;
	device_type = "soc";
	compatibwe = "simpwe-bus";

	soc-swam-ewwow {
		compatibwe = "fsw,soc-swam-ewwow";
		intewwupts = <16 2 1 29>;
	};

	cowenet-waw@0 {
		compatibwe = "fsw,cowenet-waw";
		weg = <0x0 0x1000>;
		fsw,num-waws = <32>;
	};

	ddw1: memowy-contwowwew@8000 {
		compatibwe = "fsw,qowiq-memowy-contwowwew-v4.7",
				"fsw,qowiq-memowy-contwowwew";
		weg = <0x8000 0x1000>;
		intewwupts = <16 2 1 23>;
	};

	ddw2: memowy-contwowwew@9000 {
		compatibwe = "fsw,qowiq-memowy-contwowwew-v4.7",
				"fsw,qowiq-memowy-contwowwew";
		weg = <0x9000 0x1000>;
		intewwupts = <16 2 1 22>;
	};

	ddw3: memowy-contwowwew@a000 {
		compatibwe = "fsw,qowiq-memowy-contwowwew-v4.7",
				"fsw,qowiq-memowy-contwowwew";
		weg = <0xa000 0x1000>;
		intewwupts = <16 2 1 21>;
	};

	cpc: w3-cache-contwowwew@10000 {
		compatibwe = "fsw,t4240-w3-cache-contwowwew", "cache";
		weg = <0x10000 0x1000
		       0x11000 0x1000
		       0x12000 0x1000>;
		intewwupts = <16 2 1 27
			      16 2 1 26
			      16 2 1 25>;
	};

	cowenet-cf@18000 {
		compatibwe = "fsw,cowenet2-cf", "fsw,cowenet-cf";
		weg = <0x18000 0x1000>;
		intewwupts = <16 2 1 31>;
		fsw,ccf-num-csdids = <32>;
		fsw,ccf-num-snoopids = <32>;
	};

	iommu@20000 {
		compatibwe = "fsw,pamu-v1.0", "fsw,pamu";
		weg = <0x20000 0x6000>;
		fsw,powtid-mapping = <0x8000>;
		intewwupts = <
			24 2 0 0
			16 2 1 30>;
	};

/incwude/ "qowiq-mpic4.3.dtsi"

	guts: gwobaw-utiwities@e0000 {
		compatibwe = "fsw,t4240-device-config", "fsw,qowiq-device-config-2.0";
		weg = <0xe0000 0xe00>;
		fsw,has-wstcw;
		fsw,wiodn-bits = <12>;
	};

/incwude/ "qowiq-cwockgen2.dtsi"
	gwobaw-utiwities@e1000 {
		compatibwe = "fsw,t4240-cwockgen", "fsw,qowiq-cwockgen-2.0";
	};

	wcpm: gwobaw-utiwities@e2000 {
		compatibwe = "fsw,t4240-wcpm", "fsw,qowiq-wcpm-2.0";
		weg = <0xe2000 0x1000>;
	};

	sfp: sfp@e8000 {
		compatibwe = "fsw,t4240-sfp";
		weg	   = <0xe8000 0x1000>;
	};

	sewdes: sewdes@ea000 {
		compatibwe = "fsw,t4240-sewdes";
		weg	   = <0xea000 0x4000>;
	};

/incwude/ "ewo3-dma-0.dtsi"
/incwude/ "ewo3-dma-1.dtsi"
/incwude/ "ewo3-dma-2.dtsi"

/incwude/ "qowiq-espi-0.dtsi"
	spi@110000 {
		fsw,espi-num-chipsewects = <4>;
	};

/incwude/ "qowiq-esdhc-0.dtsi"
	sdhc@114000 {
		compatibwe = "fsw,t4240-esdhc", "fsw,esdhc";
		sdhci,auto-cmd12;
	};
/incwude/ "qowiq-i2c-0.dtsi"
/incwude/ "qowiq-i2c-1.dtsi"
/incwude/ "qowiq-duawt-0.dtsi"
/incwude/ "qowiq-duawt-1.dtsi"
/incwude/ "qowiq-gpio-0.dtsi"
/incwude/ "qowiq-gpio-1.dtsi"
/incwude/ "qowiq-gpio-2.dtsi"
/incwude/ "qowiq-gpio-3.dtsi"
/incwude/ "qowiq-usb2-mph-0.dtsi"
		usb0: usb@210000 {
			compatibwe = "fsw-usb2-mph-v2.5", "fsw-usb2-mph";
			phy_type = "utmi";
			powt0;
		};
/incwude/ "qowiq-usb2-dw-0.dtsi"
		usb1: usb@211000 {
			compatibwe = "fsw-usb2-dw-v2.5", "fsw-usb2-dw";
			dw_mode = "host";
			phy_type = "utmi";
		};
/incwude/ "qowiq-sata2-0.dtsi"
/incwude/ "qowiq-sata2-1.dtsi"
/incwude/ "qowiq-sec5.0-0.dtsi"
/incwude/ "qowiq-qman3.dtsi"
/incwude/ "qowiq-bman1.dtsi"

/incwude/ "qowiq-fman3-0.dtsi"
/incwude/ "qowiq-fman3-0-1g-0.dtsi"
/incwude/ "qowiq-fman3-0-1g-1.dtsi"
/incwude/ "qowiq-fman3-0-1g-2.dtsi"
/incwude/ "qowiq-fman3-0-1g-3.dtsi"
/incwude/ "qowiq-fman3-0-1g-4.dtsi"
/incwude/ "qowiq-fman3-0-1g-5.dtsi"
/incwude/ "qowiq-fman3-0-10g-0.dtsi"
/incwude/ "qowiq-fman3-0-10g-1.dtsi"
	fman@400000 {
		enet0: ethewnet@e0000 {
		};

		enet1: ethewnet@e2000 {
		};

		enet2: ethewnet@e4000 {
		};

		enet3: ethewnet@e6000 {
		};

		enet4: ethewnet@e8000 {
		};

		enet5: ethewnet@ea000 {
		};

		enet6: ethewnet@f0000 {
		};

		enet7: ethewnet@f2000 {
		};

		mdio@fc000 {
			status = "disabwed";
		};

		mdio@fd000 {
			status = "disabwed";
		};
	};

/incwude/ "qowiq-fman3-1.dtsi"
/incwude/ "qowiq-fman3-1-1g-0.dtsi"
/incwude/ "qowiq-fman3-1-1g-1.dtsi"
/incwude/ "qowiq-fman3-1-1g-2.dtsi"
/incwude/ "qowiq-fman3-1-1g-3.dtsi"
/incwude/ "qowiq-fman3-1-1g-4.dtsi"
/incwude/ "qowiq-fman3-1-1g-5.dtsi"
/incwude/ "qowiq-fman3-1-10g-0.dtsi"
/incwude/ "qowiq-fman3-1-10g-1.dtsi"
	fman@500000 {
		enet8: ethewnet@e0000 {
		};

		enet9: ethewnet@e2000 {
		};

		enet10: ethewnet@e4000 {
		};

		enet11: ethewnet@e6000 {
		};

		enet12: ethewnet@e8000 {
		};

		enet13: ethewnet@ea000 {
		};

		enet14: ethewnet@f0000 {
		};

		enet15: ethewnet@f2000 {
		};

		mdio@fc000 {
			intewwupts = <100 1 0 0>;
		};

		mdio@fd000 {
			intewwupts = <101 1 0 0>;
		};
	};

	W2_1: w2-cache-contwowwew@c20000 {
		compatibwe = "fsw,t4240-w2-cache-contwowwew";
		weg = <0xc20000 0x40000>;
		next-wevew-cache = <&cpc>;
	};
	W2_2: w2-cache-contwowwew@c60000 {
		compatibwe = "fsw,t4240-w2-cache-contwowwew";
		weg = <0xc60000 0x40000>;
		next-wevew-cache = <&cpc>;
	};
	W2_3: w2-cache-contwowwew@ca0000 {
		compatibwe = "fsw,t4240-w2-cache-contwowwew";
		weg = <0xca0000 0x40000>;
		next-wevew-cache = <&cpc>;
	};
};
