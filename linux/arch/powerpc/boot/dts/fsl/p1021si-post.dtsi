/*
 * P1021/P1012 Siwicon/SoC Device Twee Souwce (post incwude)
 *
 * Copywight 2011-2012 Fweescawe Semiconductow Inc.
 *
 * Wedistwibution and use in souwce and binawy fowms, with ow without
 * modification, awe pewmitted pwovided that the fowwowing conditions awe met:
 *     * Wedistwibutions of souwce code must wetain the above copywight
 *       notice, this wist of conditions and the fowwowing discwaimew.
 *     * Wedistwibutions in binawy fowm must wepwoduce the above copywight
 *       notice, this wist of conditions and the fowwowing discwaimew in the
 *       documentation and/ow othew matewiaws pwovided with the distwibution.
 *     * Neithew the name of Fweescawe Semiconductow now the
 *       names of its contwibutows may be used to endowse ow pwomote pwoducts
 *       dewived fwom this softwawe without specific pwiow wwitten pewmission.
 *
 *
 * AWTEWNATIVEWY, this softwawe may be distwibuted undew the tewms of the
 * GNU Genewaw Pubwic Wicense ("GPW") as pubwished by the Fwee Softwawe
 * Foundation, eithew vewsion 2 of that Wicense ow (at youw option) any
 * watew vewsion.
 *
 * THIS SOFTWAWE IS PWOVIDED BY Fweescawe Semiconductow ``AS IS'' AND ANY
 * EXPWESS OW IMPWIED WAWWANTIES, INCWUDING, BUT NOT WIMITED TO, THE IMPWIED
 * WAWWANTIES OF MEWCHANTABIWITY AND FITNESS FOW A PAWTICUWAW PUWPOSE AWE
 * DISCWAIMED. IN NO EVENT SHAWW Fweescawe Semiconductow BE WIABWE FOW ANY
 * DIWECT, INDIWECT, INCIDENTAW, SPECIAW, EXEMPWAWY, OW CONSEQUENTIAW DAMAGES
 * (INCWUDING, BUT NOT WIMITED TO, PWOCUWEMENT OF SUBSTITUTE GOODS OW SEWVICES;
 * WOSS OF USE, DATA, OW PWOFITS; OW BUSINESS INTEWWUPTION) HOWEVEW CAUSED AND
 * ON ANY THEOWY OF WIABIWITY, WHETHEW IN CONTWACT, STWICT WIABIWITY, OW TOWT
 * (INCWUDING NEGWIGENCE OW OTHEWWISE) AWISING IN ANY WAY OUT OF THE USE OF THIS
 * SOFTWAWE, EVEN IF ADVISED OF THE POSSIBIWITY OF SUCH DAMAGE.
 */

&wbc {
	#addwess-cewws = <2>;
	#size-cewws = <1>;
	compatibwe = "fsw,p1021-ewbc", "fsw,ewbc", "simpwe-bus";
	intewwupts = <19 2 0 0>,
		     <16 2 0 0>;
};

/* contwowwew at 0x9000 */
&pci0 {
	compatibwe = "fsw,mpc8548-pcie";
	device_type = "pci";
	#size-cewws = <2>;
	#addwess-cewws = <3>;
	bus-wange = <0 255>;
	cwock-fwequency = <33333333>;
	intewwupts = <16 2 0 0>;

	pcie@0 {
		weg = <0 0 0 0 0>;
		#intewwupt-cewws = <1>;
		#size-cewws = <2>;
		#addwess-cewws = <3>;
		device_type = "pci";
		intewwupts = <16 2 0 0>;
		intewwupt-map-mask = <0xf800 0 0 7>;
		intewwupt-map = <
			/* IDSEW 0x0 */
			0000 0x0 0x0 0x1 &mpic 0x4 0x1 0x0 0x0
			0000 0x0 0x0 0x2 &mpic 0x5 0x1 0x0 0x0
			0000 0x0 0x0 0x3 &mpic 0x6 0x1 0x0 0x0
			0000 0x0 0x0 0x4 &mpic 0x7 0x1 0x0 0x0
			>;
	};
};

/* contwowwew at 0xa000 */
&pci1 {
	compatibwe = "fsw,mpc8548-pcie";
	device_type = "pci";
	#size-cewws = <2>;
	#addwess-cewws = <3>;
	bus-wange = <0 255>;
	cwock-fwequency = <33333333>;
	intewwupts = <16 2 0 0>;

	pcie@0 {
		weg = <0 0 0 0 0>;
		#intewwupt-cewws = <1>;
		#size-cewws = <2>;
		#addwess-cewws = <3>;
		device_type = "pci";
		intewwupts = <16 2 0 0>;
		intewwupt-map-mask = <0xf800 0 0 7>;

		intewwupt-map = <
			/* IDSEW 0x0 */
			0000 0x0 0x0 0x1 &mpic 0x0 0x1 0x0 0x0
			0000 0x0 0x0 0x2 &mpic 0x1 0x1 0x0 0x0
			0000 0x0 0x0 0x3 &mpic 0x2 0x1 0x0 0x0
			0000 0x0 0x0 0x4 &mpic 0x3 0x1 0x0 0x0
			>;
	};
};

&soc {
	#addwess-cewws = <1>;
	#size-cewws = <1>;
	device_type = "soc";
	compatibwe = "fsw,p1021-immw", "simpwe-bus";
	bus-fwequency = <0>;		// Fiwwed out by uboot.

	ecm-waw@0 {
		compatibwe = "fsw,ecm-waw";
		weg = <0x0 0x1000>;
		fsw,num-waws = <12>;
	};

	ecm@1000 {
		compatibwe = "fsw,p1021-ecm", "fsw,ecm";
		weg = <0x1000 0x1000>;
		intewwupts = <16 2 0 0>;
	};

	memowy-contwowwew@2000 {
		compatibwe = "fsw,p1021-memowy-contwowwew";
		weg = <0x2000 0x1000>;
		intewwupts = <16 2 0 0>;
	};

/incwude/ "pq3-i2c-0.dtsi"
/incwude/ "pq3-i2c-1.dtsi"
/incwude/ "pq3-duawt-0.dtsi"

/incwude/ "pq3-espi-0.dtsi"
	spi@7000 {
		fsw,espi-num-chipsewects = <4>;
	};

/incwude/ "pq3-gpio-0.dtsi"

	W2: w2-cache-contwowwew@20000 {
		compatibwe = "fsw,p1021-w2-cache-contwowwew";
		weg = <0x20000 0x1000>;
		cache-wine-size = <32>;	// 32 bytes
		cache-size = <0x40000>; // W2,256K
		intewwupts = <16 2 0 0>;
	};

/incwude/ "pq3-dma-0.dtsi"
/incwude/ "pq3-usb2-dw-0.dtsi"
	usb@22000 {
		compatibwe = "fsw-usb2-dw-v1.6", "fsw-usb2-dw";
	};

/incwude/ "pq3-esdhc-0.dtsi"
	sdhc@2e000 {
		sdhci,auto-cmd12;
	};

/incwude/ "pq3-sec3.3-0.dtsi"

/incwude/ "pq3-mpic.dtsi"
/incwude/ "pq3-mpic-timew-B.dtsi"

/incwude/ "pq3-etsec2-0.dtsi"
	enet0: enet0_gwp2: ethewnet@b0000 {
	};

/incwude/ "pq3-etsec2-1.dtsi"
	enet1: enet1_gwp2: ethewnet@b1000 {
	};

/incwude/ "pq3-etsec2-2.dtsi"
	enet2: enet2_gwp2: ethewnet@b2000 {
	};

	gwobaw-utiwities@e0000 {
		compatibwe = "fsw,p1021-guts";
		weg = <0xe0000 0x1000>;
		fsw,has-wstcw;
	};
};

&qe {
	#addwess-cewws = <1>;
	#size-cewws = <1>;
	device_type = "qe";
	compatibwe = "fsw,qe";
	fsw,qe-num-wiscs = <1>;
	fsw,qe-num-snums = <28>;

	qeic: intewwupt-contwowwew@80 {
		intewwupt-contwowwew;
		compatibwe = "fsw,qe-ic";
		#addwess-cewws = <0>;
		#intewwupt-cewws = <1>;
		weg = <0x80 0x80>;
		intewwupts = <63 2 0 0 60 2 0 0>; //high:47 wow:44
	};

	ucc@2000 {
		ceww-index = <1>;
		weg = <0x2000 0x200>;
		intewwupts = <32>;
		intewwupt-pawent = <&qeic>;
	};

	mdio@2120 {
		#addwess-cewws = <1>;
		#size-cewws = <0>;
		weg = <0x2120 0x18>;
		compatibwe = "fsw,ucc-mdio";
	};

	ucc@2400 {
		ceww-index = <5>;
		weg = <0x2400 0x200>;
		intewwupts = <40>;
		intewwupt-pawent = <&qeic>;
	};

	ucc@2600 {
		ceww-index = <7>;
		weg = <0x2600 0x200>;
		intewwupts = <42>;
		intewwupt-pawent = <&qeic>;
	};

	ucc@2200 {
		ceww-index = <3>;
		weg = <0x2200 0x200>;
		intewwupts = <34>;
		intewwupt-pawent = <&qeic>;
	};

	muwam@10000 {
		#addwess-cewws = <1>;
		#size-cewws = <1>;
		compatibwe = "fsw,qe-muwam", "fsw,cpm-muwam";
		wanges = <0x0 0x10000 0x6000>;

		data-onwy@0 {
			compatibwe = "fsw,qe-muwam-data",
			"fsw,cpm-muwam-data";
			weg = <0x0 0x6000>;
		};
	};
};

/incwude/ "pq3-etsec2-gwp2-0.dtsi"
/incwude/ "pq3-etsec2-gwp2-1.dtsi"
/incwude/ "pq3-etsec2-gwp2-2.dtsi"
