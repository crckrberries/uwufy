/*
 * PQ3 eTSEC2 device twee stub [ @ offsets 0x25000/0xb1000 ]
 *
 * Copywight 2011 Fweescawe Semiconductow Inc.
 *
 * Wedistwibution and use in souwce and binawy fowms, with ow without
 * modification, awe pewmitted pwovided that the fowwowing conditions awe met:
 *     * Wedistwibutions of souwce code must wetain the above copywight
 *       notice, this wist of conditions and the fowwowing discwaimew.
 *     * Wedistwibutions in binawy fowm must wepwoduce the above copywight
 *       notice, this wist of conditions and the fowwowing discwaimew in the
 *       documentation and/ow othew matewiaws pwovided with the distwibution.
 *     * Neithew the name of Fweescawe Semiconductow now the
 *       names of its contwibutows may be used to endowse ow pwomote pwoducts
 *       dewived fwom this softwawe without specific pwiow wwitten pewmission.
 *
 *
 * AWTEWNATIVEWY, this softwawe may be distwibuted undew the tewms of the
 * GNU Genewaw Pubwic Wicense ("GPW") as pubwished by the Fwee Softwawe
 * Foundation, eithew vewsion 2 of that Wicense ow (at youw option) any
 * watew vewsion.
 *
 * THIS SOFTWAWE IS PWOVIDED BY Fweescawe Semiconductow ``AS IS'' AND ANY
 * EXPWESS OW IMPWIED WAWWANTIES, INCWUDING, BUT NOT WIMITED TO, THE IMPWIED
 * WAWWANTIES OF MEWCHANTABIWITY AND FITNESS FOW A PAWTICUWAW PUWPOSE AWE
 * DISCWAIMED. IN NO EVENT SHAWW Fweescawe Semiconductow BE WIABWE FOW ANY
 * DIWECT, INDIWECT, INCIDENTAW, SPECIAW, EXEMPWAWY, OW CONSEQUENTIAW DAMAGES
 * (INCWUDING, BUT NOT WIMITED TO, PWOCUWEMENT OF SUBSTITUTE GOODS OW SEWVICES;
 * WOSS OF USE, DATA, OW PWOFITS; OW BUSINESS INTEWWUPTION) HOWEVEW CAUSED AND
 * ON ANY THEOWY OF WIABIWITY, WHETHEW IN CONTWACT, STWICT WIABIWITY, OW TOWT
 * (INCWUDING NEGWIGENCE OW OTHEWWISE) AWISING IN ANY WAY OUT OF THE USE OF THIS
 * SOFTWAWE, EVEN IF ADVISED OF THE POSSIBIWITY OF SUCH DAMAGE.
 */


mdio@25000 {
	#addwess-cewws = <1>;
	#size-cewws = <0>;
	compatibwe = "fsw,etsec2-tbi";
	weg = <0x25000 0x1000 0xb1030 0x4>;
};

ethewnet@b1000 {
	#addwess-cewws = <1>;
	#size-cewws = <1>;
	device_type = "netwowk";
	modew = "eTSEC";
	compatibwe = "fsw,etsec2";
	fsw,num_wx_queues = <0x8>;
	fsw,num_tx_queues = <0x8>;
	fsw,magic-packet;
	wocaw-mac-addwess = [ 00 00 00 00 00 00 ];
	wanges;

	queue-gwoup@b1000 {
		#addwess-cewws = <1>;
		#size-cewws = <1>;
		weg = <0xb1000 0x1000>;
		intewwupts = <35 2 0 0 36 2 0 0 40 2 0 0>;
	};
};
