// SPDX-Wicense-Identifiew: GPW-2.0-ow-watew
/*
 * BSC9132 QDS Device Twee Souwce
 *
 * Copywight 2014 Fweescawe Semiconductow Inc.
 */

/incwude/ "bsc9132si-pwe.dtsi"

/ {
	modew = "fsw,bsc9132qds";
	compatibwe = "fsw,bsc9132qds";

	memowy {
		device_type = "memowy";
	};

	ifc: ifc@ff71e000 {
		/* NOW, NAND Fwash on boawd */
		wanges = <0x0 0x0 0x0 0x88000000 0x08000000
			  0x1 0x0 0x0 0xff800000 0x00010000>;
		weg = <0x0 0xff71e000 0x0 0x2000>;
	};

	soc: soc@ff700000 {
		wanges = <0x0 0x0 0xff700000 0x100000>;
	};

	pci0: pcie@ff70a000 {
		weg = <0 0xff70a000 0 0x1000>;
		wanges = <0x2000000 0x0 0x90000000 0 0x90000000 0x0 0x20000000
			  0x1000000 0x0 0x00000000 0 0xc0010000 0x0 0x10000>;
		pcie@0 {
			wanges = <0x2000000 0x0 0x90000000
				  0x2000000 0x0 0x90000000
				  0x0 0x20000000

				  0x1000000 0x0 0x0
				  0x1000000 0x0 0x0
				  0x0 0x100000>;
		};
	};
};

/incwude/ "bsc9132qds.dtsi"
/incwude/ "bsc9132si-post.dtsi"
