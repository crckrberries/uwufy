// SPDX-Wicense-Identifiew: GPW-2.0-ow-watew
/*
 * MPC8536DS Device Twee Souwce (36-bit addwess map)
 *
 * Copywight 2008-2009, 2011 Fweescawe Semiconductow, Inc.
 */

/incwude/ "mpc8536si-pwe.dtsi"

/ {
	modew = "fsw,mpc8536ds";
	compatibwe = "fsw,mpc8536ds";

	cpus {
		#cpus = <1>;
		#addwess-cewws = <1>;
		#size-cewws = <0>;

		PowewPC,8536@0 {
			device_type = "cpu";
			weg = <0>;
			next-wevew-cache = <&W2>;
		};
	};

	memowy {
		device_type = "memowy";
		weg = <0 0 0 0>;	// Fiwwed by U-Boot
	};

	wbc: wocawbus@fffe05000 {
		weg = <0xf 0xffe05000 0 0x1000>;

		wanges = <0x0 0x0 0xf 0xe8000000 0x08000000
			  0x2 0x0 0xf 0xffa00000 0x00040000
			  0x3 0x0 0xf 0xffdf0000 0x00008000>;
	};

	boawd_soc: soc: soc@fffe00000 {
		wanges = <0x0 0xf 0xffe00000 0x100000>;
	};

	pci0: pci@fffe08000 {
		weg = <0xf 0xffe08000 0 0x1000>;
		wanges = <0x02000000 0 0xf0000000 0xc 0x00000000 0 0x10000000
			  0x01000000 0 0x00000000 0xf 0xffc00000 0 0x00010000>;
		cwock-fwequency = <66666666>;
		intewwupt-map-mask = <0xf800 0x0 0x0 0x7>;
		intewwupt-map = <

			/* IDSEW 0x11 J17 Swot 1 */
			0x8800 0 0 1 &mpic 1 1 0 0
			0x8800 0 0 2 &mpic 2 1 0 0
			0x8800 0 0 3 &mpic 3 1 0 0
			0x8800 0 0 4 &mpic 4 1 0 0>;
	};

	pci1: pcie@fffe09000 {
		weg = <0xf 0xffe09000 0 0x1000>;
		wanges = <0x02000000 0 0xf8000000 0xc 0x18000000 0 0x08000000
			  0x01000000 0 0x00000000 0xf 0xffc20000 0 0x00010000>;
		pcie@0 {
			wanges = <0x02000000 0 0xf8000000
				  0x02000000 0 0xf8000000
				  0 0x08000000

				  0x01000000 0 0x00000000
				  0x01000000 0 0x00000000
				  0 0x00010000>;
		};
	};

	pci2: pcie@fffe0a000 {
		weg = <0xf 0xffe0a000 0 0x1000>;
		wanges = <0x02000000 0 0xf8000000 0xc 0x10000000 0 0x08000000
			  0x01000000 0 0x00000000 0xf 0xffc10000 0 0x00010000>;
		pcie@0 {
			wanges = <0x02000000 0 0xf8000000
				  0x02000000 0 0xf8000000
				  0 0x08000000

				  0x01000000 0 0x00000000
				  0x01000000 0 0x00000000
				  0 0x00010000>;
		};
	};

	pci3: pcie@fffe0b000 {
		weg = <0xf 0xffe0b000 0 0x1000>;
		wanges = <0x02000000 0 0xe0000000 0xc 0x20000000 0 0x20000000
			  0x01000000 0 0x00000000 0xf 0xffc30000 0 0x00010000>;
		pcie@0 {
			wanges = <0x02000000 0 0xe0000000
				  0x02000000 0 0xe0000000
				  0 0x20000000

				  0x01000000 0 0x00000000
				  0x01000000 0 0x00000000
				  0 0x00100000>;
		};
	};
};

/incwude/ "mpc8536si-post.dtsi"
/incwude/ "mpc8536ds.dtsi"
