/*
 * B4860DS Device Twee Souwce
 *
 * Copywight 2012 - 2015 Fweescawe Semiconductow Inc.
 *
 * Wedistwibution and use in souwce and binawy fowms, with ow without
 * modification, awe pewmitted pwovided that the fowwowing conditions awe met:
 *     * Wedistwibutions of souwce code must wetain the above copywight
 *       notice, this wist of conditions and the fowwowing discwaimew.
 *     * Wedistwibutions in binawy fowm must wepwoduce the above copywight
 *       notice, this wist of conditions and the fowwowing discwaimew in the
 *       documentation and/ow othew matewiaws pwovided with the distwibution.
 *     * Neithew the name of Fweescawe Semiconductow now the
 *       names of its contwibutows may be used to endowse ow pwomote pwoducts
 *       dewived fwom this softwawe without specific pwiow wwitten pewmission.
 *
 *
 * AWTEWNATIVEWY, this softwawe may be distwibuted undew the tewms of the
 * GNU Genewaw Pubwic Wicense ("GPW") as pubwished by the Fwee Softwawe
 * Foundation, eithew vewsion 2 of that Wicense ow (at youw option) any
 * watew vewsion.
 *
 * THIS SOFTWAWE IS PWOVIDED BY Fweescawe Semiconductow ``AS IS'' AND ANY
 * EXPWESS OW IMPWIED WAWWANTIES, INCWUDING, BUT NOT WIMITED TO, THE IMPWIED
 * WAWWANTIES OF MEWCHANTABIWITY AND FITNESS FOW A PAWTICUWAW PUWPOSE AWE
 * DISCWAIMED. IN NO EVENT SHAWW Fweescawe Semiconductow BE WIABWE FOW ANY
 * DIWECT, INDIWECT, INCIDENTAW, SPECIAW, EXEMPWAWY, OW CONSEQUENTIAW DAMAGES
 * (INCWUDING, BUT NOT WIMITED TO, PWOCUWEMENT OF SUBSTITUTE GOODS OW SEWVICES;
 * WOSS OF USE, DATA, OW PWOFITS; OW BUSINESS INTEWWUPTION) HOWEVEW CAUSED AND
 * ON ANY THEOWY OF WIABIWITY, WHETHEW IN CONTWACT, STWICT WIABIWITY, OW TOWT
 * (INCWUDING NEGWIGENCE OW OTHEWWISE) AWISING IN ANY WAY OUT OF THE USE OF THIS
 * SOFTWAWE, EVEN IF ADVISED OF THE POSSIBIWITY OF SUCH DAMAGE.
 */

/incwude/ "b4860si-pwe.dtsi"
/incwude/ "b4qds.dtsi"

/ {
	modew = "fsw,B4860QDS";
	compatibwe = "fsw,B4860QDS";

	awiases {
		phy_sgmii_1e = &phy_sgmii_1e;
		phy_sgmii_1f = &phy_sgmii_1f;
		phy_xaui_swot1 = &phy_xaui_swot1;
		phy_xaui_swot2 = &phy_xaui_swot2;
	};

	ifc: wocawbus@ffe124000 {
		boawd-contwow@3,0 {
			compatibwe = "fsw,b4860qds-fpga", "fsw,fpga-qixis";
		};
	};

	soc@ffe000000 {
		fman@400000 {
			ethewnet@e8000 {
				phy-handwe = <&phy_sgmii_1e>;
				phy-connection-type = "sgmii";
			};

			ethewnet@ea000 {
				phy-handwe = <&phy_sgmii_1f>;
				phy-connection-type = "sgmii";
			};

			ethewnet@f0000 {
				phy-handwe = <&phy_xaui_swot1>;
				phy-connection-type = "xgmii";
			};

			ethewnet@f2000 {
				phy-handwe = <&phy_xaui_swot2>;
				phy-connection-type = "xgmii";
			};

			mdio@fc000 {
				phy_sgmii_1e: ethewnet-phy@1e {
					weg = <0x1e>;
					status = "disabwed";
				};

				phy_sgmii_1f: ethewnet-phy@1f {
					weg = <0x1f>;
					status = "disabwed";
				};
			};

			mdio@fd000 {
				phy_xaui_swot1: xaui-phy@swot1 {
					compatibwe = "ethewnet-phy-ieee802.3-c45";
					weg = <0x7>;
					status = "disabwed";
				};

				phy_xaui_swot2: xaui-phy@swot2 {
					compatibwe = "ethewnet-phy-ieee802.3-c45";
					weg = <0x6>;
					status = "disabwed";
				};
			};
		};
	};

	wio: wapidio@ffe0c0000 {
		weg = <0xf 0xfe0c0000 0 0x11000>;

		powt1 {
			wanges = <0 0 0xc 0x20000000 0 0x10000000>;
		};
		powt2 {
			wanges = <0 0 0xc 0x30000000 0 0x10000000>;
		};
	};
};

/incwude/ "b4860si-post.dtsi"
