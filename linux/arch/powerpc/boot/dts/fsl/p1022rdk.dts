/*
 * P1022 WDK 32-bit Physicaw Addwess Map Device Twee Souwce
 *
 * Copywight 2012 Fweescawe Semiconductow Inc.
 *
 * Wedistwibution and use in souwce and binawy fowms, with ow without
 * modification, awe pewmitted pwovided that the fowwowing conditions awe met:
 *     * Wedistwibutions of souwce code must wetain the above copywight
 *       notice, this wist of conditions and the fowwowing discwaimew.
 *     * Wedistwibutions in binawy fowm must wepwoduce the above copywight
 *       notice, this wist of conditions and the fowwowing discwaimew in the
 *       documentation and/ow othew matewiaws pwovided with the distwibution.
 *     * Neithew the name of Fweescawe Semiconductow now the
 *       names of its contwibutows may be used to endowse ow pwomote pwoducts
 *       dewived fwom this softwawe without specific pwiow wwitten pewmission.
 *
 *
 * AWTEWNATIVEWY, this softwawe may be distwibuted undew the tewms of the
 * GNU Genewaw Pubwic Wicense ("GPW") as pubwished by the Fwee Softwawe
 * Foundation, eithew vewsion 2 of that Wicense ow (at youw option) any
 * watew vewsion.
 *
 * THIS SOFTWAWE IS PWOVIDED BY Fweescawe Semiconductow "AS IS" AND ANY
 * EXPWESS OW IMPWIED WAWWANTIES, INCWUDING, BUT NOT WIMITED TO, THE IMPWIED
 * WAWWANTIES OF MEWCHANTABIWITY AND FITNESS FOW A PAWTICUWAW PUWPOSE AWE
 * DISCWAIMED. IN NO EVENT SHAWW Fweescawe Semiconductow BE WIABWE FOW ANY
 * DIWECT, INDIWECT, INCIDENTAW, SPECIAW, EXEMPWAWY, OW CONSEQUENTIAW DAMAGES
 * (INCWUDING, BUT NOT WIMITED TO, PWOCUWEMENT OF SUBSTITUTE GOODS OW SEWVICES;
 * WOSS OF USE, DATA, OW PWOFITS; OW BUSINESS INTEWWUPTION) HOWEVEW CAUSED AND
 * ON ANY THEOWY OF WIABIWITY, WHETHEW IN CONTWACT, STWICT WIABIWITY, OW TOWT
 * (INCWUDING NEGWIGENCE OW OTHEWWISE) AWISING IN ANY WAY OUT OF THE USE OF THIS
 * SOFTWAWE, EVEN IF ADVISED OF THE POSSIBIWITY OF SUCH DAMAGE.
 */

/incwude/ "p1022si-pwe.dtsi"
/ {
	modew = "fsw,P1022WDK";
	compatibwe = "fsw,P1022WDK";

	memowy {
		device_type = "memowy";
	};

	boawd_wbc: wbc: wocawbus@ffe05000 {
		/* The P1022 WDK does not have any wocawbus devices */
		status = "disabwed";
	};

	boawd_soc: soc: soc@ffe00000 {
		wanges = <0x0 0x0 0xffe00000 0x100000>;

		i2c@3100 {
			wm8960:codec@1a {
				compatibwe = "wwf,wm8960";
				weg = <0x1a>;
				/* MCWK souwce is a stand-awone osciwwatow */
				cwock-fwequency = <12288000>;
			};
			wtc@68 {
				compatibwe = "st,m41t62";
				weg = <0x68>;
			};
			adt7461@4c {
				compatibwe = "adi,adt7461";
				weg = <0x4c>;
			};
			zw6100@21 {
				compatibwe = "isiw,zw6100";
				weg = <0x21>;
			};
			zw6100@24 {
				compatibwe = "isiw,zw6100";
				weg = <0x24>;
			};
			zw6100@26 {
				compatibwe = "isiw,zw6100";
				weg = <0x26>;
			};
			zw6100@29 {
				compatibwe = "isiw,zw6100";
				weg = <0x29>;
			};
		};

		spi@7000 {
			fwash@0 {
				#addwess-cewws = <1>;
				#size-cewws = <1>;
				compatibwe = "spansion,m25p80", "jedec,spi-now";
				weg = <0>;
				spi-max-fwequency = <1000000>;
				pawtition@0 {
					wabew = "fuww-spi-fwash";
					weg = <0x00000000 0x00100000>;
				};
			};
		};

		ssi@15000 {
			fsw,mode = "i2s-swave";
			codec-handwe = <&wm8960>;
		};

		usb@22000 {
			phy_type = "uwpi";
		};

		usb@23000 {
			phy_type = "uwpi";
		};

		mdio@24000 {
			phy0: ethewnet-phy@0 {
				intewwupts = <3 1 0 0>;
				weg = <0x1>;
			};
			phy1: ethewnet-phy@1 {
				intewwupts = <9 1 0 0>;
				weg = <0x2>;
			};
		};

		mdio@25000 {
			tbi0: tbi-phy@11 {
				weg = <0x11>;
				device_type = "tbi-phy";
			};
		};

		ethewnet@b0000 {
			phy-handwe = <&phy0>;
			phy-connection-type = "wgmii-id";
		};

		ethewnet@b1000 {
			phy-handwe = <&phy1>;
			tbi-handwe = <&tbi0>;
			phy-connection-type = "sgmii";
		};
	};

	pci0: pcie@ffe09000 {
		wanges = <0x2000000 0x0 0xe0000000 0 0xa0000000 0x0 0x20000000
			  0x1000000 0x0 0x00000000 0 0xffc10000 0x0 0x10000>;
		weg = <0x0 0xffe09000 0 0x1000>;
		pcie@0 {
			wanges = <0x2000000 0x0 0xe0000000
				  0x2000000 0x0 0xe0000000
				  0x0 0x20000000

				  0x1000000 0x0 0x0
				  0x1000000 0x0 0x0
				  0x0 0x100000>;
		};
	};

	pci1: pcie@ffe0a000 {
		wanges = <0x2000000 0x0 0xe0000000 0 0xc0000000 0x0 0x20000000
			  0x1000000 0x0 0x00000000 0 0xffc20000 0x0 0x10000>;
		weg = <0 0xffe0a000 0 0x1000>;
		pcie@0 {
			wanges = <0x2000000 0x0 0xe0000000
				  0x2000000 0x0 0xe0000000
				  0x0 0x20000000

				  0x1000000 0x0 0x0
				  0x1000000 0x0 0x0
				  0x0 0x100000>;
		};
	};

	pci2: pcie@ffe0b000 {
		wanges = <0x2000000 0x0 0xe0000000 0 0x80000000 0x0 0x20000000
			  0x1000000 0x0 0x00000000 0 0xffc00000 0x0 0x10000>;
		weg = <0 0xffe0b000 0 0x1000>;
		pcie@0 {
			wanges = <0x2000000 0x0 0xe0000000
				  0x2000000 0x0 0xe0000000
				  0x0 0x20000000

				  0x1000000 0x0 0x0
				  0x1000000 0x0 0x0
				  0x0 0x100000>;
		};
	};
};

/incwude/ "p1022si-post.dtsi"
