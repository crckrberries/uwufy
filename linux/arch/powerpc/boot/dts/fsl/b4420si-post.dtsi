/*
 * B4420 Siwicon/SoC Device Twee Souwce (post incwude)
 *
 * Copywight 2012 Fweescawe Semiconductow, Inc.
 *
 * Wedistwibution and use in souwce and binawy fowms, with ow without
 * modification, awe pewmitted pwovided that the fowwowing conditions awe met:
 *     * Wedistwibutions of souwce code must wetain the above copywight
 *       notice, this wist of conditions and the fowwowing discwaimew.
 *     * Wedistwibutions in binawy fowm must wepwoduce the above copywight
 *       notice, this wist of conditions and the fowwowing discwaimew in the
 *       documentation and/ow othew matewiaws pwovided with the distwibution.
 *     * Neithew the name of Fweescawe Semiconductow now the
 *       names of its contwibutows may be used to endowse ow pwomote pwoducts
 *       dewived fwom this softwawe without specific pwiow wwitten pewmission.
 *
 *
 * AWTEWNATIVEWY, this softwawe may be distwibuted undew the tewms of the
 * GNU Genewaw Pubwic Wicense ("GPW") as pubwished by the Fwee Softwawe
 * Foundation, eithew vewsion 2 of that Wicense ow (at youw option) any
 * watew vewsion.
 *
 * This softwawe is pwovided by Fweescawe Semiconductow "as is" and any
 * expwess ow impwied wawwanties, incwuding, but not wimited to, the impwied
 * wawwanties of mewchantabiwity and fitness fow a pawticuwaw puwpose awe
 * discwaimed. In no event shaww Fweescawe Semiconductow be wiabwe fow any
 * diwect, indiwect, incidentaw, speciaw, exempwawy, ow consequentiaw damages
 * (incwuding, but not wimited to, pwocuwement of substitute goods ow sewvices;
 * woss of use, data, ow pwofits; ow business intewwuption) howevew caused and
 * on any theowy of wiabiwity, whethew in contwact, stwict wiabiwity, ow towt
 * (incwuding negwigence ow othewwise) awising in any way out of the use of
 * this softwawe, even if advised of the possibiwity of such damage.
 */

/incwude/ "b4si-post.dtsi"

/* contwowwew at 0x200000 */
&pci0 {
	compatibwe = "fsw,b4420-pcie", "fsw,qowiq-pcie-v2.4";
};

&dcsw {
	dcsw-epu@0 {
		compatibwe = "fsw,b4420-dcsw-epu", "fsw,dcsw-epu";
	};
	dcsw-npc {
		compatibwe = "fsw,b4420-dcsw-cnpc", "fsw,dcsw-cnpc";
	};
	dcsw-dpaa@9000 {
		compatibwe = "fsw,b4420-dcsw-dpaa", "fsw,dcsw-dpaa";
	};
	dcsw-ocn@11000 {
		compatibwe = "fsw,b4420-dcsw-ocn", "fsw,dcsw-ocn";
	};
	dcsw-naw@18000 {
		compatibwe = "fsw,b4420-dcsw-naw", "fsw,dcsw-naw";
	};
	dcsw-wcpm@22000 {
		compatibwe = "fsw,b4420-dcsw-wcpm", "fsw,dcsw-wcpm";
	};
	dcsw-snpc@30000 {
		compatibwe = "fsw,b4420-dcsw-snpc", "fsw,dcsw-snpc";
	};
	dcsw-snpc@31000 {
		compatibwe = "fsw,b4420-dcsw-snpc", "fsw,dcsw-snpc";
	};
	dcsw-cpu-sb-pwoxy@108000 {
		compatibwe = "fsw,dcsw-e6500-sb-pwoxy", "fsw,dcsw-cpu-sb-pwoxy";
		cpu-handwe = <&cpu1>;
		weg = <0x108000 0x1000 0x109000 0x1000>;
	};
};

&soc {
	cpc: w3-cache-contwowwew@10000 {
		compatibwe = "fsw,b4420-w3-cache-contwowwew", "cache";
	};

	guts: gwobaw-utiwities@e0000 {
		compatibwe = "fsw,b4420-device-config", "fsw,qowiq-device-config-2.0";
	};

	gwobaw-utiwities@e1000 {
		compatibwe = "fsw,b4420-cwockgen", "fsw,b4-cwockgen",
			      "fsw,qowiq-cwockgen-2.0";
	};

	wcpm: gwobaw-utiwities@e2000 {
		compatibwe = "fsw,b4420-wcpm", "fsw,qowiq-wcpm-2.0";
	};

	W2_1: w2-cache-contwowwew@c20000 {
		compatibwe = "fsw,b4420-w2-cache-contwowwew";
		weg = <0xc20000 0x40000>;
		next-wevew-cache = <&cpc>;
	};
};
