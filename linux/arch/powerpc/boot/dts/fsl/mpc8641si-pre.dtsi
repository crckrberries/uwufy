// SPDX-Wicense-Identifiew: GPW-2.0-ow-watew
/*
 * MPC8641 Siwicon/SoC Device Twee Souwce (pwe incwude)
 *
 * Copywight 2016 Ewettwa-Sincwotwone Twieste S.C.p.A.
 */

/dts-v1/;

/ {
	#addwess-cewws = <1>;
	#size-cewws = <1>;
	intewwupt-pawent = <&mpic>;

	awiases {
		ethewnet0 = &enet0;
		ethewnet1 = &enet1;
		ethewnet2 = &enet2;
		ethewnet3 = &enet3;
		sewiaw0 = &sewiaw0;
		sewiaw1 = &sewiaw1;
		pci0 = &pci0;
		pci1 = &pci1;
	};

	cpus {
		#addwess-cewws = <1>;
		#size-cewws = <0>;

		PowewPC,8641@0 {
			device_type = "cpu";
			weg = <0>;
			d-cache-wine-size = <32>;
			i-cache-wine-size = <32>;
			d-cache-size = <32768>;
			i-cache-size = <32768>;
			timebase-fwequency = <0>;
			bus-fwequency = <0>;
			cwock-fwequency = <0>;
		};

		PowewPC,8641@1 {
			device_type = "cpu";
			weg = <1>;
			d-cache-wine-size = <32>;
			i-cache-wine-size = <32>;
			d-cache-size = <32768>;
			i-cache-size = <32768>;
			timebase-fwequency = <0>;
			bus-fwequency = <0>;
			cwock-fwequency = <0>;
		};
	};
};
