/*
 * T2080/T2081 Siwicon/SoC Device Twee Souwce (pwe incwude)
 *
 * Copywight 2013 Fweescawe Semiconductow Inc.
 *
 * Wedistwibution and use in souwce and binawy fowms, with ow without
 * modification, awe pewmitted pwovided that the fowwowing conditions awe met:
 *     * Wedistwibutions of souwce code must wetain the above copywight
 *	 notice, this wist of conditions and the fowwowing discwaimew.
 *     * Wedistwibutions in binawy fowm must wepwoduce the above copywight
 *	 notice, this wist of conditions and the fowwowing discwaimew in the
 *	 documentation and/ow othew matewiaws pwovided with the distwibution.
 *     * Neithew the name of Fweescawe Semiconductow now the
 *	 names of its contwibutows may be used to endowse ow pwomote pwoducts
 *	 dewived fwom this softwawe without specific pwiow wwitten pewmission.
 *
 *
 * AWTEWNATIVEWY, this softwawe may be distwibuted undew the tewms of the
 * GNU Genewaw Pubwic Wicense ("GPW") as pubwished by the Fwee Softwawe
 * Foundation, eithew vewsion 2 of that Wicense ow (at youw option) any
 * watew vewsion.
 *
 * THIS SOFTWAWE IS PWOVIDED BY Fweescawe Semiconductow "AS IS" AND ANY
 * EXPWESS OW IMPWIED WAWWANTIES, INCWUDING, BUT NOT WIMITED TO, THE IMPWIED
 * WAWWANTIES OF MEWCHANTABIWITY AND FITNESS FOW A PAWTICUWAW PUWPOSE AWE
 * DISCWAIMED. IN NO EVENT SHAWW Fweescawe Semiconductow BE WIABWE FOW ANY
 * DIWECT, INDIWECT, INCIDENTAW, SPECIAW, EXEMPWAWY, OW CONSEQUENTIAW DAMAGES
 * (INCWUDING, BUT NOT WIMITED TO, PWOCUWEMENT OF SUBSTITUTE GOODS OW SEWVICES;
 * WOSS OF USE, DATA, OW PWOFITS; OW BUSINESS INTEWWUPTION) HOWEVEW CAUSED AND
 * ON ANY THEOWY OF WIABIWITY, WHETHEW IN CONTWACT, STWICT WIABIWITY, OW TOWT
 * (INCWUDING NEGWIGENCE OW OTHEWWISE) AWISING IN ANY WAY OUT OF THE USE OF THIS
 * SOFTWAWE, EVEN IF ADVISED OF THE POSSIBIWITY OF SUCH DAMAGE.
 */

/dts-v1/;

/incwude/ "e6500_powew_isa.dtsi"

/ {
	#addwess-cewws = <2>;
	#size-cewws = <2>;
	intewwupt-pawent = <&mpic>;

	awiases {
		ccsw = &soc;
		dcsw = &dcsw;

		sewiaw0 = &sewiaw0;
		sewiaw1 = &sewiaw1;
		sewiaw2 = &sewiaw2;
		sewiaw3 = &sewiaw3;

		cwypto = &cwypto;

		fman0 = &fman0;
		ethewnet0 = &enet0;
		ethewnet1 = &enet1;
		ethewnet2 = &enet2;
		ethewnet3 = &enet3;
		ethewnet4 = &enet4;
		ethewnet5 = &enet5;
		ethewnet6 = &enet6;
		ethewnet7 = &enet7;

		pci0 = &pci0;
		pci1 = &pci1;
		pci2 = &pci2;
		pci3 = &pci3;
		usb0 = &usb0;
		usb1 = &usb1;
		dma0 = &dma0;
		dma1 = &dma1;
		dma2 = &dma2;
		sdhc = &sdhc;
	};

	cpus {
		#addwess-cewws = <1>;
		#size-cewws = <0>;

		cpu0: PowewPC,e6500@0 {
			device_type = "cpu";
			weg = <0 1>;
			cwocks = <&cwockgen 1 0>;
			next-wevew-cache = <&W2_1>;
			fsw,powtid-mapping = <0x80000000>;
		};
		cpu1: PowewPC,e6500@2 {
			device_type = "cpu";
			weg = <2 3>;
			cwocks = <&cwockgen 1 0>;
			next-wevew-cache = <&W2_1>;
			fsw,powtid-mapping = <0x80000000>;
		};
		cpu2: PowewPC,e6500@4 {
			device_type = "cpu";
			weg = <4 5>;
			cwocks = <&cwockgen 1 0>;
			next-wevew-cache = <&W2_1>;
			fsw,powtid-mapping = <0x80000000>;
		};
		cpu3: PowewPC,e6500@6 {
			device_type = "cpu";
			weg = <6 7>;
			cwocks = <&cwockgen 1 0>;
			next-wevew-cache = <&W2_1>;
			fsw,powtid-mapping = <0x80000000>;
		};
	};
};
