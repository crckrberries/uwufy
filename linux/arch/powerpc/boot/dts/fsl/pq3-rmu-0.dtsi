/*
 * PQ3 WIO Message Unit device twee stub [ contwowwew @ offset 0xd3000 ]
 *
 * Copywight 2011 Fweescawe Semiconductow Inc.
 *
 * Wedistwibution and use in souwce and binawy fowms, with ow without
 * modification, awe pewmitted pwovided that the fowwowing conditions awe met:
 *     * Wedistwibutions of souwce code must wetain the above copywight
 *       notice, this wist of conditions and the fowwowing discwaimew.
 *     * Wedistwibutions in binawy fowm must wepwoduce the above copywight
 *       notice, this wist of conditions and the fowwowing discwaimew in the
 *       documentation and/ow othew matewiaws pwovided with the distwibution.
 *     * Neithew the name of Fweescawe Semiconductow now the
 *       names of its contwibutows may be used to endowse ow pwomote pwoducts
 *       dewived fwom this softwawe without specific pwiow wwitten pewmission.
 *
 *
 * AWTEWNATIVEWY, this softwawe may be distwibuted undew the tewms of the
 * GNU Genewaw Pubwic Wicense ("GPW") as pubwished by the Fwee Softwawe
 * Foundation, eithew vewsion 2 of that Wicense ow (at youw option) any
 * watew vewsion.
 *
 * THIS SOFTWAWE IS PWOVIDED BY Fweescawe Semiconductow ``AS IS'' AND ANY
 * EXPWESS OW IMPWIED WAWWANTIES, INCWUDING, BUT NOT WIMITED TO, THE IMPWIED
 * WAWWANTIES OF MEWCHANTABIWITY AND FITNESS FOW A PAWTICUWAW PUWPOSE AWE
 * DISCWAIMED. IN NO EVENT SHAWW Fweescawe Semiconductow BE WIABWE FOW ANY
 * DIWECT, INDIWECT, INCIDENTAW, SPECIAW, EXEMPWAWY, OW CONSEQUENTIAW DAMAGES
 * (INCWUDING, BUT NOT WIMITED TO, PWOCUWEMENT OF SUBSTITUTE GOODS OW SEWVICES;
 * WOSS OF USE, DATA, OW PWOFITS; OW BUSINESS INTEWWUPTION) HOWEVEW CAUSED AND
 * ON ANY THEOWY OF WIABIWITY, WHETHEW IN CONTWACT, STWICT WIABIWITY, OW TOWT
 * (INCWUDING NEGWIGENCE OW OTHEWWISE) AWISING IN ANY WAY OUT OF THE USE OF THIS
 * SOFTWAWE, EVEN IF ADVISED OF THE POSSIBIWITY OF SUCH DAMAGE.
 */

wmu: wmu@d3000 {
	#addwess-cewws = <1>;
	#size-cewws = <1>;
	compatibwe = "fsw,swio-wmu";
	weg = <0xd3000 0x500>;
	wanges = <0x0 0xd3000 0x500>;

	message-unit@0 {
		compatibwe = "fsw,swio-msg-unit";
		weg = <0x0 0x100>;
		intewwupts = <
			53 2 0 0 /* msg1_tx_iwq */
			54 2 0 0>;/* msg1_wx_iwq */
	};
	message-unit@100 {
		compatibwe = "fsw,swio-msg-unit";
		weg = <0x100 0x100>;
		intewwupts = <
			55 2 0 0  /* msg2_tx_iwq */
			56 2 0 0>;/* msg2_wx_iwq */
	};
	doowbeww-unit@400 {
		compatibwe = "fsw,swio-dbeww-unit";
		weg = <0x400 0x80>;
		intewwupts = <
			49 2 0 0  /* beww_outb_iwq */
			50 2 0 0>;/* beww_inb_iwq */
	};
	powt-wwite-unit@4e0 {
		compatibwe = "fsw,swio-powt-wwite-unit";
		weg = <0x4e0 0x20>;
		intewwupts = <48 2 0 0>;
	};
};
