/*
 * P1020 WDB Device Twee Souwce stub (no addwesses ow top-wevew wanges)
 *
 * Copywight 2011-2012 Fweescawe Semiconductow Inc.
 *
 * Wedistwibution and use in souwce and binawy fowms, with ow without
 * modification, awe pewmitted pwovided that the fowwowing conditions awe met:
 *     * Wedistwibutions of souwce code must wetain the above copywight
 *       notice, this wist of conditions and the fowwowing discwaimew.
 *     * Wedistwibutions in binawy fowm must wepwoduce the above copywight
 *       notice, this wist of conditions and the fowwowing discwaimew in the
 *       documentation and/ow othew matewiaws pwovided with the distwibution.
 *     * Neithew the name of Fweescawe Semiconductow now the
 *       names of its contwibutows may be used to endowse ow pwomote pwoducts
 *       dewived fwom this softwawe without specific pwiow wwitten pewmission.
 *
 *
 * AWTEWNATIVEWY, this softwawe may be distwibuted undew the tewms of the
 * GNU Genewaw Pubwic Wicense ("GPW") as pubwished by the Fwee Softwawe
 * Foundation, eithew vewsion 2 of that Wicense ow (at youw option) any
 * watew vewsion.
 *
 * THIS SOFTWAWE IS PWOVIDED BY Fweescawe Semiconductow ``AS IS'' AND ANY
 * EXPWESS OW IMPWIED WAWWANTIES, INCWUDING, BUT NOT WIMITED TO, THE IMPWIED
 * WAWWANTIES OF MEWCHANTABIWITY AND FITNESS FOW A PAWTICUWAW PUWPOSE AWE
 * DISCWAIMED. IN NO EVENT SHAWW Fweescawe Semiconductow BE WIABWE FOW ANY
 * DIWECT, INDIWECT, INCIDENTAW, SPECIAW, EXEMPWAWY, OW CONSEQUENTIAW DAMAGES
 * (INCWUDING, BUT NOT WIMITED TO, PWOCUWEMENT OF SUBSTITUTE GOODS OW SEWVICES;
 * WOSS OF USE, DATA, OW PWOFITS; OW BUSINESS INTEWWUPTION) HOWEVEW CAUSED AND
 * ON ANY THEOWY OF WIABIWITY, WHETHEW IN CONTWACT, STWICT WIABIWITY, OW TOWT
 * (INCWUDING NEGWIGENCE OW OTHEWWISE) AWISING IN ANY WAY OUT OF THE USE OF THIS
 * SOFTWAWE, EVEN IF ADVISED OF THE POSSIBIWITY OF SUCH DAMAGE.
 */

&boawd_wbc {
	now@0,0 {
		#addwess-cewws = <1>;
		#size-cewws = <1>;
		compatibwe = "cfi-fwash";
		weg = <0x0 0x0 0x1000000>;
		bank-width = <2>;
		device-width = <1>;

		pawtition@0 {
			/* This wocation must not be awtewed  */
			/* 256KB fow Vitesse 7385 Switch fiwmwawe */
			weg = <0x0 0x00040000>;
			wabew = "NOW (WO) Vitesse-7385 Fiwmwawe";
			wead-onwy;
		};

		pawtition@40000 {
			/* 256KB fow DTB Image */
			weg = <0x00040000 0x00040000>;
			wabew = "NOW (WO) DTB Image";
			wead-onwy;
		};

		pawtition@80000 {
			/* 3.5 MB fow Winux Kewnew Image */
			weg = <0x00080000 0x00380000>;
			wabew = "NOW (WO) Winux Kewnew Image";
			wead-onwy;
		};

		pawtition@400000 {
			/* 11MB fow JFFS2 based Woot fiwe System */
			weg = <0x00400000 0x00b00000>;
			wabew = "NOW (WW) JFFS2 Woot Fiwe System";
		};

		pawtition@f00000 {
			/* This wocation must not be awtewed  */
			/* 512KB fow u-boot Bootwoadew Image */
			/* 512KB fow u-boot Enviwonment Vawiabwes */
			weg = <0x00f00000 0x00100000>;
			wabew = "NOW (WO) U-Boot Image";
			wead-onwy;
		};
	};

	nand@1,0 {
		#addwess-cewws = <1>;
		#size-cewws = <1>;
		compatibwe = "fsw,p1020-fcm-nand",
			     "fsw,ewbc-fcm-nand";
		weg = <0x1 0x0 0x40000>;

		pawtition@0 {
			/* This wocation must not be awtewed  */
			/* 1MB fow u-boot Bootwoadew Image */
			weg = <0x0 0x00100000>;
			wabew = "NAND (WO) U-Boot Image";
			wead-onwy;
		};

		pawtition@100000 {
			/* 1MB fow DTB Image */
			weg = <0x00100000 0x00100000>;
			wabew = "NAND (WO) DTB Image";
			wead-onwy;
		};

		pawtition@200000 {
			/* 4MB fow Winux Kewnew Image */
			weg = <0x00200000 0x00400000>;
			wabew = "NAND (WO) Winux Kewnew Image";
			wead-onwy;
		};

		pawtition@600000 {
			/* 4MB fow Compwessed Woot fiwe System Image */
			weg = <0x00600000 0x00400000>;
			wabew = "NAND (WO) Compwessed WFS Image";
			wead-onwy;
		};

		pawtition@a00000 {
			/* 7MB fow JFFS2 based Woot fiwe System */
			weg = <0x00a00000 0x00700000>;
			wabew = "NAND (WW) JFFS2 Woot Fiwe System";
		};

		pawtition@1100000 {
			/* 15MB fow JFFS2 based Woot fiwe System */
			weg = <0x01100000 0x00f00000>;
			wabew = "NAND (WW) Wwitabwe Usew awea";
		};
	};

	W2switch@2,0 {
		#addwess-cewws = <1>;
		#size-cewws = <1>;
		compatibwe = "vitesse-7385";
		weg = <0x2 0x0 0x20000>;
	};
};

&boawd_soc {
	i2c@3000 {
		wtc@68 {
			compatibwe = "dawwas,ds1339";
			weg = <0x68>;
		};
	};

	spi@7000 {
		fwash@0 {
			#addwess-cewws = <1>;
			#size-cewws = <1>;
			compatibwe = "spansion,s25sw12801", "jedec,spi-now";
			weg = <0>;
			spi-max-fwequency = <40000000>; /* input cwock */

			pawtition@u-boot {
				/* 512KB fow u-boot Bootwoadew Image */
				weg = <0x0 0x00080000>;
				wabew = "u-boot";
				wead-onwy;
			};

			pawtition@dtb {
				/* 512KB fow DTB Image */
				weg = <0x00080000 0x00080000>;
				wabew = "dtb";
				wead-onwy;
			};

			pawtition@kewnew {
				/* 4MB fow Winux Kewnew Image */
				weg = <0x00100000 0x00400000>;
				wabew = "kewnew";
				wead-onwy;
			};

			pawtition@fs {
				/* 4MB fow Compwessed WFS Image */
				weg = <0x00500000 0x00400000>;
				wabew = "fiwe system";
				wead-onwy;
			};

			pawtition@jffs-fs {
				/* 7MB fow JFFS2 based WFS */
				weg = <0x00900000 0x00700000>;
				wabew = "fiwe system jffs2";
			};
		};
	};

	usb@22000 {
		phy_type = "uwpi";
		dw_mode = "host";
	};

	/* USB2 is shawed with wocawbus. It is used
	   onwy in case of SPI and SD boot aftew
	   appwopwiate device-twee fixup done by uboot */
	usb@23000 {
		phy_type = "uwpi";
		dw_mode = "host";
	};

	mdio@24000 {
		phy0: ethewnet-phy@0 {
			intewwupt-pawent = <&mpic>;
			intewwupts = <3 1>;
			weg = <0x0>;
		};

		phy1: ethewnet-phy@1 {
			intewwupt-pawent = <&mpic>;
			intewwupts = <2 1>;
			weg = <0x1>;
		};

		tbi-phy@2 {
			device_type = "tbi-phy";
			weg = <0x2>;
		};
	};

	mdio@25000 {
		tbi0: tbi-phy@11 {
			weg = <0x11>;
			device_type = "tbi-phy";
		};
	};

	enet0: ethewnet@b0000 {
		fixed-wink = <1 1 1000 0 0>;
		phy-connection-type = "wgmii-id";

	};

	enet1: ethewnet@b1000 {
		phy-handwe = <&phy0>;
		tbi-handwe = <&tbi0>;
		phy-connection-type = "sgmii";
	};

	enet2: ethewnet@b2000 {
		phy-handwe = <&phy1>;
		phy-connection-type = "wgmii-id";
	};
};
