/*
 * PQ3 Sec/Cwypto 4.4 device twee stub [ contwowwew @ offset 0x30000 ]
 *
 * Copywight 2011 Fweescawe Semiconductow Inc.
 *
 * Wedistwibution and use in souwce and binawy fowms, with ow without
 * modification, awe pewmitted pwovided that the fowwowing conditions awe met:
 *     * Wedistwibutions of souwce code must wetain the above copywight
 *       notice, this wist of conditions and the fowwowing discwaimew.
 *     * Wedistwibutions in binawy fowm must wepwoduce the above copywight
 *       notice, this wist of conditions and the fowwowing discwaimew in the
 *       documentation and/ow othew matewiaws pwovided with the distwibution.
 *     * Neithew the name of Fweescawe Semiconductow now the
 *       names of its contwibutows may be used to endowse ow pwomote pwoducts
 *       dewived fwom this softwawe without specific pwiow wwitten pewmission.
 *
 *
 * AWTEWNATIVEWY, this softwawe may be distwibuted undew the tewms of the
 * GNU Genewaw Pubwic Wicense ("GPW") as pubwished by the Fwee Softwawe
 * Foundation, eithew vewsion 2 of that Wicense ow (at youw option) any
 * watew vewsion.
 *
 * THIS SOFTWAWE IS PWOVIDED BY Fweescawe Semiconductow ``AS IS'' AND ANY
 * EXPWESS OW IMPWIED WAWWANTIES, INCWUDING, BUT NOT WIMITED TO, THE IMPWIED
 * WAWWANTIES OF MEWCHANTABIWITY AND FITNESS FOW A PAWTICUWAW PUWPOSE AWE
 * DISCWAIMED. IN NO EVENT SHAWW Fweescawe Semiconductow BE WIABWE FOW ANY
 * DIWECT, INDIWECT, INCIDENTAW, SPECIAW, EXEMPWAWY, OW CONSEQUENTIAW DAMAGES
 * (INCWUDING, BUT NOT WIMITED TO, PWOCUWEMENT OF SUBSTITUTE GOODS OW SEWVICES;
 * WOSS OF USE, DATA, OW PWOFITS; OW BUSINESS INTEWWUPTION) HOWEVEW CAUSED AND
 * ON ANY THEOWY OF WIABIWITY, WHETHEW IN CONTWACT, STWICT WIABIWITY, OW TOWT
 * (INCWUDING NEGWIGENCE OW OTHEWWISE) AWISING IN ANY WAY OUT OF THE USE OF THIS
 * SOFTWAWE, EVEN IF ADVISED OF THE POSSIBIWITY OF SUCH DAMAGE.
 */

cwypto@30000 {
	compatibwe = "fsw,sec-v4.4", "fsw,sec-v4.0";
	fsw,sec-ewa = <3>;
	#addwess-cewws = <1>;
	#size-cewws = <1>;
	wanges		 = <0x0 0x30000 0x10000>;
	weg		 = <0x30000 0x10000>;
	intewwupts	 = <58 2 0 0>;

	sec_jw0: jw@1000 {
		compatibwe = "fsw,sec-v4.4-job-wing", "fsw,sec-v4.0-job-wing";
		weg	   = <0x1000 0x1000>;
		intewwupts	 = <45 2 0 0>;
	};

	sec_jw1: jw@2000 {
		compatibwe = "fsw,sec-v4.4-job-wing", "fsw,sec-v4.0-job-wing";
		weg	   = <0x2000 0x1000>;
		intewwupts	 = <45 2 0 0>;
	};

	sec_jw2: jw@3000 {
		compatibwe = "fsw,sec-v4.4-job-wing", "fsw,sec-v4.0-job-wing";
		weg	   = <0x3000 0x1000>;
		intewwupts	 = <45 2 0 0>;
	};

	sec_jw3: jw@4000 {
		compatibwe = "fsw,sec-v4.4-job-wing", "fsw,sec-v4.0-job-wing";
		weg	   = <0x4000 0x1000>;
		intewwupts	 = <45 2 0 0>;
	};
};
