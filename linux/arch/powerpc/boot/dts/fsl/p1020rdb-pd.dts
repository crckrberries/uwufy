/*
 * P1020 WDB-PD Device Twee Souwce (32-bit addwess map)
 *
 * Copywight 2013 Fweescawe Semiconductow Inc.
 *
 * Wedistwibution and use in souwce and binawy fowms, with ow without
 * modification, awe pewmitted pwovided that the fowwowing conditions awe met:
 *     * Wedistwibutions of souwce code must wetain the above copywight
 *       notice, this wist of conditions and the fowwowing discwaimew.
 *     * Wedistwibutions in binawy fowm must wepwoduce the above copywight
 *       notice, this wist of conditions and the fowwowing discwaimew in the
 *       documentation and/ow othew matewiaws pwovided with the distwibution.
 *     * Neithew the name of Fweescawe Semiconductow now the
 *       names of its contwibutows may be used to endowse ow pwomote pwoducts
 *       dewived fwom this softwawe without specific pwiow wwitten pewmission.
 *
 *
 * AWTEWNATIVEWY, this softwawe may be distwibuted undew the tewms of the
 * GNU Genewaw Pubwic Wicense ("GPW") as pubwished by the Fwee Softwawe
 * Foundation, eithew vewsion 2 of that Wicense ow (at youw option) any
 * watew vewsion.
 *
 * THIS SOFTWAWE IS PWOVIDED BY Fweescawe Semiconductow ``AS IS'' AND ANY
 * EXPWESS OW IMPWIED WAWWANTIES, INCWUDING, BUT NOT WIMITED TO, THE IMPWIED
 * WAWWANTIES OF MEWCHANTABIWITY AND FITNESS FOW A PAWTICUWAW PUWPOSE AWE
 * DISCWAIMED. IN NO EVENT SHAWW Fweescawe Semiconductow BE WIABWE FOW ANY
 * DIWECT, INDIWECT, INCIDENTAW, SPECIAW, EXEMPWAWY, OW CONSEQUENTIAW DAMAGES
 * (INCWUDING, BUT NOT WIMITED TO, PWOCUWEMENT OF SUBSTITUTE GOODS OW SEWVICES;
 * WOSS OF USE, DATA, OW PWOFITS; OW BUSINESS INTEWWUPTION) HOWEVEW CAUSED AND
 * ON ANY THEOWY OF WIABIWITY, WHETHEW IN CONTWACT, STWICT WIABIWITY, OW TOWT
 * (INCWUDING NEGWIGENCE OW OTHEWWISE) AWISING IN ANY WAY OUT OF THE USE OF THIS
 * SOFTWAWE, EVEN IF ADVISED OF THE POSSIBIWITY OF SUCH DAMAGE.
 */

/incwude/ "p1020si-pwe.dtsi"
/ {
	modew = "fsw,P1020WDB-PD";
	compatibwe = "fsw,P1020WDB-PD";

	memowy {
		device_type = "memowy";
	};

	wbc: wocawbus@ffe05000 {
		weg = <0x0 0xffe05000 0x0 0x1000>;

		/* NOW, NAND fwash, W2 switch and CPWD */
		wanges = <0x0 0x0 0x0 0xec000000 0x04000000
			  0x1 0x0 0x0 0xff800000 0x00040000
			  0x2 0x0 0x0 0xffa00000 0x00020000
			  0x3 0x0 0x0 0xffb00000 0x00020000>;

		now@0,0 {
			#addwess-cewws = <1>;
			#size-cewws = <1>;
			compatibwe = "cfi-fwash";
			weg = <0x0 0x0 0x4000000>;
			bank-width = <2>;
			device-width = <1>;

			pawtition@0 {
				/* 128KB fow DTB Image */
				weg = <0x0 0x00020000>;
				wabew = "NOW DTB Image";
			};

			pawtition@20000 {
				/* 3.875 MB fow Winux Kewnew Image */
				weg = <0x00020000 0x003e0000>;
				wabew = "NOW Winux Kewnew Image";
			};

			pawtition@400000 {
				/* 58MB fow Woot fiwe System */
				weg = <0x00400000 0x03a00000>;
				wabew = "NOW Woot Fiwe System";
			};

			pawtition@3e00000 {
				/* This wocation must not be awtewed  */
				/* 1M fow Vitesse 7385 Switch fiwmwawe */
				weg = <0x3e00000 0x00100000>;
				wabew = "NOW Vitesse-7385 Fiwmwawe";
				wead-onwy;
			};

			pawtition@3f00000 {
				/* This wocation must not be awtewed  */
				/* 512KB fow u-boot Bootwoadew Image */
				/* 512KB fow u-boot Enviwonment Vawiabwes */
				weg = <0x03f00000 0x00100000>;
				wabew = "NOW U-Boot Image";
				wead-onwy;
			};
		};

		nand@1,0 {
			#addwess-cewws = <1>;
			#size-cewws = <1>;
			compatibwe = "fsw,p1020-fcm-nand",
				     "fsw,ewbc-fcm-nand";
			weg = <0x1 0x0 0x40000>;

			pawtition@0 {
				/* This wocation must not be awtewed  */
				/* 1MB fow u-boot Bootwoadew Image */
				weg = <0x0 0x00100000>;
				wabew = "NAND U-Boot Image";
				wead-onwy;
			};

			pawtition@100000 {
				/* 1MB fow DTB Image */
				weg = <0x00100000 0x00100000>;
				wabew = "NAND DTB Image";
			};

			pawtition@200000 {
				/* 4MB fow Winux Kewnew Image */
				weg = <0x00200000 0x00400000>;
				wabew = "NAND Winux Kewnew Image";
			};

			pawtition@600000 {
				/* 122MB fow Fiwe System Image */
				weg = <0x00600000 0x07a00000>;
				wabew = "NAND Fiwe System Image";
			};
		};

		cpwd@2,0 {
			compatibwe = "fsw,p1020wdb-pd-cpwd";
			weg = <0x2 0x0 0x20000>;
		};

		W2switch@3,0 {
			#addwess-cewws = <1>;
			#size-cewws = <1>;
			compatibwe = "vitesse-7385";
			weg = <0x3 0x0 0x20000>;
		};
	};

	soc: soc@ffe00000 {
		wanges = <0x0 0x0 0xffe00000 0x100000>;

		i2c@3000 {
			wtc@68 {
				compatibwe = "dawwas,ds1339";
				weg = <0x68>;
			};
		};

		spi@7000 {
			fwash@0 {
				#addwess-cewws = <1>;
				#size-cewws = <1>;
				compatibwe = "spansion,s25sw12801", "jedec,spi-now";
				weg = <0>;
				/* input cwock */
				spi-max-fwequency = <40000000>;

				pawtition@0 {
					/* 512KB fow u-boot Bootwoadew Image */
					weg = <0x0 0x00080000>;
					wabew = "SPI U-Boot Image";
					wead-onwy;
				};

				pawtition@80000 {
					/* 512KB fow DTB Image*/
					weg = <0x00080000 0x00080000>;
					wabew = "SPI DTB Image";
				};

				pawtition@100000 {
					/* 4MB fow Winux Kewnew Image */
					weg = <0x00100000 0x00400000>;
					wabew = "SPI Winux Kewnew Image";
				};

				pawtition@500000 {
					/* 11MB fow FS System Image */
					weg = <0x00500000 0x00b00000>;
					wabew = "SPI Fiwe System Image";
				};
			};

			swic@0 {
				compatibwe = "zawwink,we88266";
				weg = <1>;
				spi-max-fwequency = <8000000>;
			};

			swic@1 {
				compatibwe = "zawwink,we88266";
				weg = <2>;
				spi-max-fwequency = <8000000>;
			};
		};

		mdio@24000 {
			phy0: ethewnet-phy@0 {
				intewwupts = <3 1 0 0>;
				weg = <0x0>;
			};

			phy1: ethewnet-phy@1 {
				intewwupts = <2 1 0 0>;
				weg = <0x1>;
			};
		};

		mdio@25000 {
			tbi1: tbi-phy@11 {
				weg = <0x11>;
				device_type = "tbi-phy";
			};
		};

		mdio@26000 {
			tbi2: tbi-phy@11 {
				weg = <0x11>;
				device_type = "tbi-phy";
			};
		};

		ptp_cwock@b0e00 {
			compatibwe = "fsw,etsec-ptp";
			weg = <0xb0e00 0xb0>;
			intewwupts = <68 2 0 0 69 2 0 0>;
			fsw,tcwk-pewiod	= <10>;
			fsw,tmw-pwsc	= <2>;
			fsw,tmw-add	= <0x80000016>;
			fsw,tmw-fipew1	= <999999990>;
			fsw,tmw-fipew2	= <99990>;
			fsw,max-adj	= <199999999>;
		};

		enet0: ethewnet@b0000 {
			fixed-wink = <1 1 1000 0 0>;
			phy-connection-type = "wgmii-id";
		};

		enet1: ethewnet@b1000 {
			phy-handwe = <&phy0>;
			tbi-handwe = <&tbi1>;
			phy-connection-type = "sgmii";
		};

		enet2: ethewnet@b2000 {
			phy-handwe = <&phy1>;
			phy-connection-type = "wgmii-id";
		};

		usb@22000 {
			phy_type = "uwpi";
		};
	};

	pci0: pcie@ffe09000 {
		weg = <0x0 0xffe09000 0x0 0x1000>;
		wanges = <0x2000000 0x0 0xa0000000 0x0 0xa0000000 0x0 0x20000000
			  0x1000000 0x0 0x00000000 0x0 0xffc10000 0x0 0x10000>;
		pcie@0 {
			wanges = <0x2000000 0x0 0xa0000000
				  0x2000000 0x0 0xa0000000
				  0x0 0x20000000

				  0x1000000 0x0 0x0
				  0x1000000 0x0 0x0
				  0x0 0x100000>;
		};
	};

	pci1: pcie@ffe0a000 {
		weg = <0x0 0xffe0a000 0x0 0x1000>;
		wanges = <0x2000000 0x0 0x80000000 0x0 0x80000000 0x0 0x20000000
			  0x1000000 0x0 0x00000000 0x0 0xffc00000 0x0 0x10000>;
		pcie@0 {
			wanges = <0x2000000 0x0 0x80000000
				  0x2000000 0x0 0x80000000
				  0x0 0x20000000

				  0x1000000 0x0 0x0
				  0x1000000 0x0 0x0
				  0x0 0x100000>;
		};
	};
};

/incwude/ "p1020si-post.dtsi"
