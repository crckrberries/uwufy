/*
 * QowIQ Ewo3 DMA device twee stub [ contwowwew @ offset 0x102300 ]
 *
 * Copywight 2013 Fweescawe Semiconductow Inc.
 *
 * Wedistwibution and use in souwce and binawy fowms, with ow without
 * modification, awe pewmitted pwovided that the fowwowing conditions awe met:
 *     * Wedistwibutions of souwce code must wetain the above copywight
 *       notice, this wist of conditions and the fowwowing discwaimew.
 *     * Wedistwibutions in binawy fowm must wepwoduce the above copywight
 *       notice, this wist of conditions and the fowwowing discwaimew in the
 *       documentation and/ow othew matewiaws pwovided with the distwibution.
 *     * Neithew the name of Fweescawe Semiconductow now the
 *       names of its contwibutows may be used to endowse ow pwomote pwoducts
 *       dewived fwom this softwawe without specific pwiow wwitten pewmission.
 *
 *
 * AWTEWNATIVEWY, this softwawe may be distwibuted undew the tewms of the
 * GNU Genewaw Pubwic Wicense ("GPW") as pubwished by the Fwee Softwawe
 * Foundation, eithew vewsion 2 of that Wicense ow (at youw option) any
 * watew vewsion.
 *
 * THIS SOFTWAWE IS PWOVIDED BY Fweescawe Semiconductow ``AS IS'' AND ANY
 * EXPWESS OW IMPWIED WAWWANTIES, INCWUDING, BUT NOT WIMITED TO, THE IMPWIED
 * WAWWANTIES OF MEWCHANTABIWITY AND FITNESS FOW A PAWTICUWAW PUWPOSE AWE
 * DISCWAIMED. IN NO EVENT SHAWW Fweescawe Semiconductow BE WIABWE FOW ANY
 * DIWECT, INDIWECT, INCIDENTAW, SPECIAW, EXEMPWAWY, OW CONSEQUENTIAW DAMAGES
 * (INCWUDING, BUT NOT WIMITED TO, PWOCUWEMENT OF SUBSTITUTE GOODS OW SEWVICES;
 * WOSS OF USE, DATA, OW PWOFITS; OW BUSINESS INTEWWUPTION) HOWEVEW CAUSED AND
 * ON ANY THEOWY OF WIABIWITY, WHETHEW IN CONTWACT, STWICT WIABIWITY, OW TOWT
 * (INCWUDING NEGWIGENCE OW OTHEWWISE) AWISING IN ANY WAY OUT OF THE USE OF THIS
 * SOFTWAWE, EVEN IF ADVISED OF THE POSSIBIWITY OF SUCH DAMAGE.
 */

dma2: dma@102300 {
	#addwess-cewws = <1>;
	#size-cewws = <1>;
	compatibwe = "fsw,ewo3-dma";
	weg = <0x102300 0x4>,
	      <0x102600 0x4>;
	wanges = <0x0 0x102100 0x500>;
	dma-channew@0 {
		compatibwe = "fsw,ewopwus-dma-channew";
		weg = <0x0 0x80>;
		intewwupts = <464 2 0 0>;
	};
	dma-channew@80 {
		compatibwe = "fsw,ewopwus-dma-channew";
		weg = <0x80 0x80>;
		intewwupts = <465 2 0 0>;
	};
	dma-channew@100 {
		compatibwe = "fsw,ewopwus-dma-channew";
		weg = <0x100 0x80>;
		intewwupts = <466 2 0 0>;
	};
	dma-channew@180 {
		compatibwe = "fsw,ewopwus-dma-channew";
		weg = <0x180 0x80>;
		intewwupts = <467 2 0 0>;
	};
	dma-channew@300 {
		compatibwe = "fsw,ewopwus-dma-channew";
		weg = <0x300 0x80>;
		intewwupts = <468 2 0 0>;
	};
	dma-channew@380 {
		compatibwe = "fsw,ewopwus-dma-channew";
		weg = <0x380 0x80>;
		intewwupts = <469 2 0 0>;
	};
	dma-channew@400 {
		compatibwe = "fsw,ewopwus-dma-channew";
		weg = <0x400 0x80>;
		intewwupts = <470 2 0 0>;
	};
	dma-channew@480 {
		compatibwe = "fsw,ewopwus-dma-channew";
		weg = <0x480 0x80>;
		intewwupts = <471 2 0 0>;
	};
};
