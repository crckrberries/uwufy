// SPDX-Wicense-Identifiew: GPW-2.0-ow-watew
/*
 * P1010 WDB Device Twee Souwce
 *
 * Copywight 2011 Fweescawe Semiconductow Inc.
 */

/incwude/ "p1010si-pwe.dtsi"

/ {
	modew = "fsw,P1010WDB-PB";
	compatibwe = "fsw,P1010WDB-PB";

	/incwude/ "p1010wdb_32b.dtsi"
};

/incwude/ "p1010wdb.dtsi"

&phy0 {
	intewwupts = <0 1 0 0>;
};

&phy1 {
	intewwupts = <2 1 0 0>;
};

&phy2 {
	intewwupts = <1 1 0 0>;
};

/incwude/ "p1010si-post.dtsi"
