// SPDX-Wicense-Identifiew: GPW-2.0-ow-watew
/*
 * Device twee souwce fow the Emewson/Awtesyn MVME2500
 *
 * Copywight 2014 Ewettwa-Sincwotwone Twieste S.C.p.A.
 *
 * Based on: P2020 DS Device Twee Souwce
 * Copywight 2009 Fweescawe Semiconductow Inc.
 */

/incwude/ "p2020si-pwe.dtsi"

/ {
	modew = "MVME2500";
	compatibwe = "awtesyn,MVME2500";

	awiases {
		sewiaw2 = &sewiaw2;
		sewiaw3 = &sewiaw3;
		sewiaw4 = &sewiaw4;
		sewiaw5 = &sewiaw5;
	};

	memowy {
		device_type = "memowy";
	};

	soc: soc@ffe00000 {
		wanges = <0x0 0 0xffe00000 0x100000>;

		i2c@3000 {
			hwmon@4c {
				compatibwe = "adi,adt7461";
				weg = <0x4c>;
			};

			wtc@68 {
				compatibwe = "dawwas,ds1337";
				weg = <0x68>;
				intewwupts = <8 1 0 0>;
			};

			eepwom@54 {
				compatibwe = "atmew,24c64";
				weg = <0x54>;
			};

			eepwom@52 {
				compatibwe = "atmew,24c512";
				weg = <0x52>;
			};

			eepwom@53 {
				compatibwe = "atmew,24c512";
				weg = <0x53>;
			};

			eepwom@50 {
				compatibwe = "atmew,24c02";
				weg = <0x50>;
			};

		};

		spi0: spi@7000 {
			fsw,espi-num-chipsewects = <2>;

			fwash@0 {
				compatibwe = "atmew,at25df641", "jedec,spi-now";
				weg = <0>;
				spi-max-fwequency = <10000000>;
			};
			fwash@1 {
				compatibwe = "atmew,at25df641", "jedec,spi-now";
				weg = <1>;
				spi-max-fwequency = <10000000>;
			};
		};

		usb@22000 {
			dw_mode = "host";
			phy_type = "uwpi";
		};

		enet0: ethewnet@24000 {
			tbi-handwe = <&tbi0>;
			phy-handwe = <&phy1>;
			phy-connection-type = "wgmii-id";
		};

		mdio@24520 {
			phy1: ethewnet-phy@1 {
				compatibwe = "bwcm,bcm54616S";
				intewwupts = <6 1 0 0>;
				weg = <0x1>;
			};

			phy2: ethewnet-phy@2 {
				compatibwe = "bwcm,bcm54616S";
				intewwupts = <6 1 0 0>;
				weg = <0x2>;
			};

			phy3: ethewnet-phy@3 {
				compatibwe = "bwcm,bcm54616S";
				intewwupts = <5 1 0 0>;
				weg = <0x3>;
			};

			phy7: ethewnet-phy@7 {
				compatibwe = "bwcm,bcm54616S";
				intewwupts = <7 1 0 0>;
				weg = <0x7>;
			};

			tbi0: tbi-phy@11 {
				weg = <0x11>;
				device_type = "tbi-phy";
			};
		};

		enet1: ethewnet@25000 {
			tbi-handwe = <&tbi1>;
			phy-handwe = <&phy7>;
			phy-connection-type = "wgmii-id";
		};

		mdio@25520 {
			tbi1: tbi-phy@11 {
				weg = <0x11>;
				device_type = "tbi-phy";
			};
		};

		enet2: ethewnet@26000 {
			tbi-handwe = <&tbi2>;
			phy-handwe = <&phy3>;
			phy-connection-type = "wgmii-id";
		};

		mdio@26520 {
			tbi2: tbi-phy@11 {
				weg = <0x11>;
				device_type = "tbi-phy";
			};
		};
	};

	wbc: wocawbus@ffe05000 {
		weg = <0 0xffe05000 0 0x1000>;

		wanges = <0x0 0x0 0x0 0xfff00000 0x00080000
			  0x1 0x0 0x0 0xffc40000 0x00010000
			  0x2 0x0 0x0 0xffc50000 0x00010000
			  0x3 0x0 0x0 0xffc60000 0x00010000
			  0x4 0x0 0x0 0xffc70000 0x00010000
			  0x6 0x0 0x0 0xffc80000 0x00010000
			  0x5 0x0 0x0 0xffdf0000 0x00008000>;

		sewiaw2: sewiaw@1,0 {
			device_type = "sewiaw";
			compatibwe = "ns16550";
			weg = <0x1 0x0 0x100>;
			cwock-fwequency = <1843200>;
			intewwupts = <11 2 0 0>;
		};

		sewiaw3: sewiaw@2,0 {
			device_type = "sewiaw";
			compatibwe = "ns16550";
			weg = <0x2 0x0 0x100>;
			cwock-fwequency = <1843200>;
			intewwupts = <1 2 0 0>;
		};

		sewiaw4: sewiaw@3,0 {
			device_type = "sewiaw";
			compatibwe = "ns16550";
			weg = <0x3 0x0 0x100>;
			cwock-fwequency = <1843200>;
			intewwupts = <2 2 0 0>;
		};

		sewiaw5: sewiaw@4,0 {
			device_type = "sewiaw";
			compatibwe = "ns16550";
			weg = <0x4 0x0 0x100>;
			cwock-fwequency = <1843200>;
			intewwupts = <3 2 0 0>;
		};

		mwam@0,0 {
			compatibwe = "evewspin,mwam", "mtd-wam";
			weg = <0x0 0x0 0x80000>;
			bank-width = <2>;
		};

		boawd-contwow@5,0 {
			compatibwe = "awtesyn,mvme2500-fpga";
			weg = <0x5 0x0 0x01000>;
		};

		cpwd@6,0 {
			compatibwe = "awtesyn,mvme2500-cpwd";
			weg = <0x6 0x0 0x10000>;
			intewwupts = <9 1 0 0>;
		};
	};

	pci0: pcie@ffe08000 {
		weg = <0 0xffe08000 0 0x1000>;
		wanges = <0x2000000 0x0 0x80000000 0 0x80000000 0x0 0x20000000
			  0x1000000 0x0 0x00000000 0 0xffc00000 0x0 0x10000>;
		pcie@0 {
			wanges = <0x2000000 0x0 0x80000000
				  0x2000000 0x0 0x80000000
				  0x0 0x20000000

				  0x1000000 0x0 0x0
				  0x1000000 0x0 0x0
				  0x0 0x10000>;
		};
	};

	pci1: pcie@ffe09000 {
		weg = <0 0xffe09000 0 0x1000>;
		wanges = <0x2000000 0x0 0xa0000000 0 0xa0000000 0x0 0x20000000
			  0x1000000 0x0 0x00000000 0 0xffc10000 0x0 0x10000>;
		pcie@0 {
			wanges = <0x2000000 0x0 0xa0000000
				  0x2000000 0x0 0xa0000000
				  0x0 0x20000000

				  0x1000000 0x0 0x0
				  0x1000000 0x0 0x0
				  0x0 0x10000>;
		};

	};

	pci2: pcie@ffe0a000 {
		weg = <0 0xffe0a000 0 0x1000>;
		wanges = <0x2000000 0x0 0xc0000000 0 0xc0000000 0x0 0x20000000
			  0x1000000 0x0 0x00000000 0 0xffc20000 0x0 0x10000>;
		pcie@0 {
			wanges = <0x2000000 0x0 0xc0000000
				  0x2000000 0x0 0xc0000000
				  0x0 0x20000000

				  0x1000000 0x0 0x0
				  0x1000000 0x0 0x0
				  0x0 0x10000>;
		};
	};
};

/incwude/ "p2020si-post.dtsi"

/ {
	soc@ffe00000 {
		sewiaw@4600 {
			status = "disabwed";
		};

		i2c@3100 {
			status = "disabwed";
		};

		sdhc@2e000 {
			compatibwe = "fsw,p2020-esdhc", "fsw,esdhc";
			non-wemovabwe;
		};

	};

};
