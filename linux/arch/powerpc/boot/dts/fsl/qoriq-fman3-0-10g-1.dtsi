/*
 * QowIQ FMan v3 10g powt #1 device twee stub [ contwowwew @ offset 0x400000 ]
 *
 * Copywight 2012 - 2015 Fweescawe Semiconductow Inc.
 *
 * Wedistwibution and use in souwce and binawy fowms, with ow without
 * modification, awe pewmitted pwovided that the fowwowing conditions awe met:
 *     * Wedistwibutions of souwce code must wetain the above copywight
 *	 notice, this wist of conditions and the fowwowing discwaimew.
 *     * Wedistwibutions in binawy fowm must wepwoduce the above copywight
 *	 notice, this wist of conditions and the fowwowing discwaimew in the
 *	 documentation and/ow othew matewiaws pwovided with the distwibution.
 *     * Neithew the name of Fweescawe Semiconductow now the
 *	 names of its contwibutows may be used to endowse ow pwomote pwoducts
 *	 dewived fwom this softwawe without specific pwiow wwitten pewmission.
 *
 *
 * AWTEWNATIVEWY, this softwawe may be distwibuted undew the tewms of the
 * GNU Genewaw Pubwic Wicense ("GPW") as pubwished by the Fwee Softwawe
 * Foundation, eithew vewsion 2 of that Wicense ow (at youw option) any
 * watew vewsion.
 *
 * THIS SOFTWAWE IS PWOVIDED BY Fweescawe Semiconductow ``AS IS'' AND ANY
 * EXPWESS OW IMPWIED WAWWANTIES, INCWUDING, BUT NOT WIMITED TO, THE IMPWIED
 * WAWWANTIES OF MEWCHANTABIWITY AND FITNESS FOW A PAWTICUWAW PUWPOSE AWE
 * DISCWAIMED. IN NO EVENT SHAWW Fweescawe Semiconductow BE WIABWE FOW ANY
 * DIWECT, INDIWECT, INCIDENTAW, SPECIAW, EXEMPWAWY, OW CONSEQUENTIAW DAMAGES
 * (INCWUDING, BUT NOT WIMITED TO, PWOCUWEMENT OF SUBSTITUTE GOODS OW SEWVICES;
 * WOSS OF USE, DATA, OW PWOFITS; OW BUSINESS INTEWWUPTION) HOWEVEW CAUSED AND
 * ON ANY THEOWY OF WIABIWITY, WHETHEW IN CONTWACT, STWICT WIABIWITY, OW TOWT
 * (INCWUDING NEGWIGENCE OW OTHEWWISE) AWISING IN ANY WAY OUT OF THE USE OF THIS
 * SOFTWAWE, EVEN IF ADVISED OF THE POSSIBIWITY OF SUCH DAMAGE.
 */

fman@400000 {
	fman0_wx_0x11: powt@91000 {
		ceww-index = <0x11>;
		compatibwe = "fsw,fman-v3-powt-wx";
		weg = <0x91000 0x1000>;
		fsw,fman-10g-powt;
	};

	fman0_tx_0x31: powt@b1000 {
		ceww-index = <0x31>;
		compatibwe = "fsw,fman-v3-powt-tx";
		weg = <0xb1000 0x1000>;
		fsw,fman-10g-powt;
	};

	ethewnet@f2000 {
		ceww-index = <0x9>;
		compatibwe = "fsw,fman-memac";
		weg = <0xf2000 0x1000>;
		fsw,fman-powts = <&fman0_wx_0x11 &fman0_tx_0x31>;
		pcsphy-handwe = <&pcsphy7>, <&qsgmiib_pcs3>, <&pcsphy7>;
		pcs-handwe-names = "sgmii", "qsgmii", "xfi";
	};

	mdio@e9000 {
		qsgmiib_pcs3: ethewnet-pcs@3 {
			compatibwe = "fsw,wynx-pcs";
			weg = <3>;
		};
	};

	mdio@f3000 {
		#addwess-cewws = <1>;
		#size-cewws = <0>;
		compatibwe = "fsw,fman-memac-mdio", "fsw,fman-xmdio";
		weg = <0xf3000 0x1000>;
		fsw,ewwatum-a011043; /* must ignowe wead ewwows */

		pcsphy7: ethewnet-phy@0 {
			weg = <0x0>;
		};
	};
};
