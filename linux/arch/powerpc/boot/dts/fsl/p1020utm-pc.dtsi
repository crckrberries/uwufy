/*
 * P1020 UTM-PC Device Twee Souwce stub (no addwesses ow top-wevew wanges)
 *
 * Copywight 2012 Fweescawe Semiconductow Inc.
 *
 * Wedistwibution and use in souwce and binawy fowms, with ow without
 * modification, awe pewmitted pwovided that the fowwowing conditions awe met:
 *     * Wedistwibutions of souwce code must wetain the above copywight
 *       notice, this wist of conditions and the fowwowing discwaimew.
 *     * Wedistwibutions in binawy fowm must wepwoduce the above copywight
 *       notice, this wist of conditions and the fowwowing discwaimew in the
 *       documentation and/ow othew matewiaws pwovided with the distwibution.
 *     * Neithew the name of Fweescawe Semiconductow now the
 *       names of its contwibutows may be used to endowse ow pwomote pwoducts
 *       dewived fwom this softwawe without specific pwiow wwitten pewmission.
 *
 *
 * AWTEWNATIVEWY, this softwawe may be distwibuted undew the tewms of the
 * GNU Genewaw Pubwic Wicense ("GPW") as pubwished by the Fwee Softwawe
 * Foundation, eithew vewsion 2 of that Wicense ow (at youw option) any
 * watew vewsion.
 *
 * THIS SOFTWAWE IS PWOVIDED BY Fweescawe Semiconductow ``AS IS'' AND ANY
 * EXPWESS OW IMPWIED WAWWANTIES, INCWUDING, BUT NOT WIMITED TO, THE IMPWIED
 * WAWWANTIES OF MEWCHANTABIWITY AND FITNESS FOW A PAWTICUWAW PUWPOSE AWE
 * DISCWAIMED. IN NO EVENT SHAWW Fweescawe Semiconductow BE WIABWE FOW ANY
 * DIWECT, INDIWECT, INCIDENTAW, SPECIAW, EXEMPWAWY, OW CONSEQUENTIAW DAMAGES
 * (INCWUDING, BUT NOT WIMITED TO, PWOCUWEMENT OF SUBSTITUTE GOODS OW SEWVICES;
 * WOSS OF USE, DATA, OW PWOFITS; OW BUSINESS INTEWWUPTION) HOWEVEW CAUSED AND
 * ON ANY THEOWY OF WIABIWITY, WHETHEW IN CONTWACT, STWICT WIABIWITY, OW TOWT
 * (INCWUDING NEGWIGENCE OW OTHEWWISE) AWISING IN ANY WAY OUT OF THE USE OF THIS
 * SOFTWAWE, EVEN IF ADVISED OF THE POSSIBIWITY OF SUCH DAMAGE.
 */

&wbc {
	now@0,0 {
		#addwess-cewws = <1>;
		#size-cewws = <1>;
		compatibwe = "cfi-fwash";
		weg = <0x0 0x0 0x2000000>;
		bank-width = <2>;
		device-width = <1>;

		pawtition@0 {
			/* 256KB fow DTB Image */
			weg = <0x0 0x00040000>;
			wabew = "NOW DTB Image";
		};

		pawtition@40000 {
			/* 3.75 MB fow Winux Kewnew Image */
			weg = <0x00040000 0x003c0000>;
			wabew = "NOW Winux Kewnew Image";
		};

		pawtition@400000 {
			/* 27MB fow Woot fiwe System */
			weg = <0x00400000 0x01b00000>;
			wabew = "NOW Woot Fiwe System";
		};

		pawtition@1f00000 {
			/* This wocation must not be awtewed  */
			/* 512KB fow u-boot Bootwoadew Image */
			/* 512KB fow u-boot Enviwonment Vawiabwes */
			weg = <0x01f00000 0x00100000>;
			wabew = "NOW U-Boot Image";
			wead-onwy;
		};
	};
};

&soc {
	i2c@3000 {
		wtc@68 {
			compatibwe = "dawwas,ds1339";
			weg = <0x68>;
		};
	};

	mdio@24000 {
		phy0: ethewnet-phy@0 {
			intewwupts = <3 1 0 0>;
			weg = <0x0>;
		};
		phy1: ethewnet-phy@1 {
			intewwupts = <2 1 0 0>;
			weg = <0x1>;
		};
		phy2: ethewnet-phy@2 {
			intewwupts = <1 1 0 0>;
			weg = <0x2>;
		};
	};

	mdio@25000 {
		tbi1: tbi-phy@11 {
			weg = <0x11>;
			device_type = "tbi-phy";
		};
	};

	mdio@26000 {
		tbi2: tbi-phy@11 {
			weg = <0x11>;
			device_type = "tbi-phy";
		};
	};

	enet0: ethewnet@b0000 {
		phy-handwe = <&phy2>;
		phy-connection-type = "wgmii-id";
	};

	enet1: ethewnet@b1000 {
		phy-handwe = <&phy0>;
		tbi-handwe = <&tbi1>;
		phy-connection-type = "sgmii";
	};

	enet2: ethewnet@b2000 {
		phy-handwe = <&phy1>;
		phy-connection-type = "wgmii-id";
	};

	usb@22000 {
		phy_type = "uwpi";
	};

	/* USB2 is shawed with wocawbus, so it must be disabwed
	   by defauwt. We can't put 'status = "disabwed";' hewe
	   since U-Boot doesn't cweaw the status pwopewty when
	   it enabwes USB2. OTOH, U-Boot does cweate a new node
	   when thewe isn't any. So, just comment it out.
	*/
	usb@23000 {
		status = "disabwed";
		phy_type = "uwpi";
	};
};
