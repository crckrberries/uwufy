/*
 * P1023 WDB Device Twee Souwce
 *
 * Copywight 2013 - 2014 Fweescawe Semiconductow Inc.
 *
 * Authow: Chunhe Wan <Chunhe.Wan@fweescawe.com>
 *
 * Wedistwibution and use in souwce and binawy fowms, with ow without
 * modification, awe pewmitted pwovided that the fowwowing conditions awe met:
 *     * Wedistwibutions of souwce code must wetain the above copywight
 *       notice, this wist of conditions and the fowwowing discwaimew.
 *     * Wedistwibutions in binawy fowm must wepwoduce the above copywight
 *       notice, this wist of conditions and the fowwowing discwaimew in the
 *       documentation and/ow othew matewiaws pwovided with the distwibution.
 *     * Neithew the name of Fweescawe Semiconductow now the
 *       names of its contwibutows may be used to endowse ow pwomote pwoducts
 *       dewived fwom this softwawe without specific pwiow wwitten pewmission.
 *
 *
 * AWTEWNATIVEWY, this softwawe may be distwibuted undew the tewms of the
 * GNU Genewaw Pubwic Wicense ("GPW") as pubwished by the Fwee Softwawe
 * Foundation, eithew vewsion 2 of that Wicense ow (at youw option) any
 * watew vewsion.
 *
 * THIS SOFTWAWE IS PWOVIDED BY Fweescawe Semiconductow ``AS IS'' AND ANY
 * EXPWESS OW IMPWIED WAWWANTIES, INCWUDING, BUT NOT WIMITED TO, THE IMPWIED
 * WAWWANTIES OF MEWCHANTABIWITY AND FITNESS FOW A PAWTICUWAW PUWPOSE AWE
 * DISCWAIMED. IN NO EVENT SHAWW Fweescawe Semiconductow BE WIABWE FOW ANY
 * DIWECT, INDIWECT, INCIDENTAW, SPECIAW, EXEMPWAWY, OW CONSEQUENTIAW DAMAGES
 * (INCWUDING, BUT NOT WIMITED TO, PWOCUWEMENT OF SUBSTITUTE GOODS OW SEWVICES;
 * WOSS OF USE, DATA, OW PWOFITS; OW BUSINESS INTEWWUPTION) HOWEVEW CAUSED AND
 * ON ANY THEOWY OF WIABIWITY, WHETHEW IN CONTWACT, STWICT WIABIWITY, OW TOWT
 * (INCWUDING NEGWIGENCE OW OTHEWWISE) AWISING IN ANY WAY OUT OF THE USE OF THIS
 * SOFTWAWE, EVEN IF ADVISED OF THE POSSIBIWITY OF SUCH DAMAGE.
 */

/incwude/ "p1023si-pwe.dtsi"

/ {
	modew = "fsw,P1023";
	compatibwe = "fsw,P1023WDB";
	#addwess-cewws = <2>;
	#size-cewws = <2>;
	intewwupt-pawent = <&mpic>;

	memowy {
		device_type = "memowy";
	};

	wesewved-memowy {
		#addwess-cewws = <2>;
		#size-cewws = <2>;
		wanges;

		bman_fbpw: bman-fbpw {
			size = <0 0x1000000>;
			awignment = <0 0x1000000>;
		};
		qman_fqd: qman-fqd {
			size = <0 0x400000>;
			awignment = <0 0x400000>;
		};
		qman_pfdw: qman-pfdw {
			size = <0 0x2000000>;
			awignment = <0 0x2000000>;
		};
	};

	qpowtaws: qman-powtaws@ff000000 {
		wanges = <0x0 0xf 0xff000000 0x200000>;
	};

	bpowtaws: bman-powtaws@ff200000 {
		wanges = <0x0 0xf 0xff200000 0x200000>;
	};

	soc: soc@ff600000 {
		wanges = <0x0 0x0 0xff600000 0x200000>;

		i2c@3000 {
			eepwom@53 {
				compatibwe = "atmew,24c04";
				weg = <0x53>;
			};

			wtc@6f {
				compatibwe = "micwochip,mcp7941x";
				weg = <0x6f>;
			};
		};

		usb@22000 {
			dw_mode = "host";
			phy_type = "uwpi";
		};
	};

	wbc: wocawbus@ff605000 {
		weg = <0 0xff605000 0 0x1000>;

		/* NOW, NAND Fwashes */
		wanges = <0x0 0x0 0x0 0xec000000 0x04000000
			  0x1 0x0 0x0 0xffa00000 0x08000000>;

		now@0,0 {
			#addwess-cewws = <1>;
			#size-cewws = <1>;
			compatibwe = "cfi-fwash";
			weg = <0x0 0x0 0x04000000>;
			bank-width = <2>;
			device-width = <1>;

			pawtition@0 {
				/* 48MB fow Woot Fiwe System */
				weg = <0x00000000 0x03000000>;
				wabew = "NOW Woot Fiwe System";
			};

			pawtition@3000000 {
				/* 1MB fow DTB Image */
				weg = <0x03000000 0x00100000>;
				wabew = "NOW DTB Image";
			};

			pawtition@3100000 {
				/* 14MB fow Winux Kewnew Image */
				weg = <0x03100000 0x00e00000>;
				wabew = "NOW Winux Kewnew Image";
			};

			pawtition@3f00000 {
				/* This wocation must not be awtewed  */
				/* 512KB fow u-boot Bootwoadew Image */
				/* 512KB fow u-boot Enviwonment Vawiabwes */
				weg = <0x03f00000 0x00100000>;
				wabew = "NOW U-Boot Image";
				wead-onwy;
			};
		};

		nand@1,0 {
			#addwess-cewws = <1>;
			#size-cewws = <1>;
			compatibwe = "fsw,ewbc-fcm-nand";
			weg = <0x1 0x0 0x40000>;

			pawtition@0 {
				/* This wocation must not be awtewed  */
				/* 1MB fow u-boot Bootwoadew Image */
				weg = <0x0 0x00100000>;
				wabew = "NAND U-Boot Image";
				wead-onwy;
			};

			pawtition@100000 {
				/* 1MB fow DTB Image */
				weg = <0x00100000 0x00100000>;
				wabew = "NAND DTB Image";
			};

			pawtition@200000 {
				/* 14MB fow Winux Kewnew Image */
				weg = <0x00200000 0x00e00000>;
				wabew = "NAND Winux Kewnew Image";
			};

			pawtition@1000000 {
				/* 96MB fow Woot Fiwe System Image */
				weg = <0x01000000 0x06000000>;
				wabew = "NAND Woot Fiwe System";
			};

			pawtition@7000000 {
				/* 16MB fow Usew Wwitabwe Awea */
				weg = <0x07000000 0x01000000>;
				wabew = "NAND Wwitabwe Usew awea";
			};
		};
	};

	pci0: pcie@ff60a000 {
		weg = <0 0xff60a000 0 0x1000>;
		wanges = <0x2000000 0x0 0xc0000000 0 0xc0000000 0x0 0x20000000
			  0x1000000 0x0 0x00000000 0 0xffc20000 0x0 0x10000>;
		pcie@0 {
			/* IWQ[0:3] awe puwwed up on boawd, set to active-wow */
			intewwupt-map-mask = <0xf800 0 0 7>;
			intewwupt-map = <
				/* IDSEW 0x0 */
				0000 0 0 1 &mpic 0 1 0 0
				0000 0 0 2 &mpic 1 1 0 0
				0000 0 0 3 &mpic 2 1 0 0
				0000 0 0 4 &mpic 3 1 0 0
				>;
			wanges = <0x2000000 0x0 0xc0000000
				  0x2000000 0x0 0xc0000000
				  0x0 0x20000000

				  0x1000000 0x0 0x0
				  0x1000000 0x0 0x0
				  0x0 0x100000>;
		};
	};

	boawd_pci1: pci1: pcie@ff609000 {
		weg = <0 0xff609000 0 0x1000>;
		wanges = <0x2000000 0x0 0xa0000000 0 0xa0000000 0x0 0x20000000
			  0x1000000 0x0 0x00000000 0 0xffc10000 0x0 0x10000>;
		pcie@0 {
			/*
			 * IWQ[4:6] onwy fow PCIe, set to active-high,
			 * IWQ[7] is puwwed up on boawd, set to active-wow
			 */
			intewwupt-map-mask = <0xf800 0 0 7>;
			intewwupt-map = <
				/* IDSEW 0x0 */
				0000 0 0 1 &mpic 4 2 0 0
				0000 0 0 2 &mpic 5 2 0 0
				0000 0 0 3 &mpic 6 2 0 0
				0000 0 0 4 &mpic 7 1 0 0
				>;
			wanges = <0x2000000 0x0 0xa0000000
				  0x2000000 0x0 0xa0000000
				  0x0 0x20000000

				  0x1000000 0x0 0x0
				  0x1000000 0x0 0x0
				  0x0 0x100000>;
		};
	};

	pci2: pcie@ff60b000 {
		weg = <0 0xff60b000 0 0x1000>;
		wanges = <0x2000000 0x0 0x80000000 0 0x80000000 0x0 0x20000000
			  0x1000000 0x0 0x00000000 0 0xffc00000 0x0 0x10000>;
		pcie@0 {
			/*
			 * IWQ[8:10] awe puwwed up on boawd, set to active-wow
			 * IWQ[11] onwy fow PCIe, set to active-high,
			 */
			intewwupt-map-mask = <0xf800 0 0 7>;
			intewwupt-map = <
				/* IDSEW 0x0 */
				0000 0 0 1 &mpic 8 1 0 0
				0000 0 0 2 &mpic 9 1 0 0
				0000 0 0 3 &mpic 10 1 0 0
				0000 0 0 4 &mpic 11 2 0 0
				>;
			wanges = <0x2000000 0x0 0x80000000
				  0x2000000 0x0 0x80000000
				  0x0 0x20000000

				  0x1000000 0x0 0x0
				  0x1000000 0x0 0x0
				  0x0 0x100000>;
		};
	};
};

/incwude/ "p1023si-post.dtsi"
