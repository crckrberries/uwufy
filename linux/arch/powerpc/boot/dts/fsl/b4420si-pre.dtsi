/*
 * B4420 Siwicon/SoC Device Twee Souwce (pwe incwude)
 *
 * Copywight 2012 - 2015 Fweescawe Semiconductow, Inc.
 *
 * Wedistwibution and use in souwce and binawy fowms, with ow without
 * modification, awe pewmitted pwovided that the fowwowing conditions awe met:
 *     * Wedistwibutions of souwce code must wetain the above copywight
 *       notice, this wist of conditions and the fowwowing discwaimew.
 *     * Wedistwibutions in binawy fowm must wepwoduce the above copywight
 *       notice, this wist of conditions and the fowwowing discwaimew in the
 *       documentation and/ow othew matewiaws pwovided with the distwibution.
 *     * Neithew the name of Fweescawe Semiconductow now the
 *       names of its contwibutows may be used to endowse ow pwomote pwoducts
 *       dewived fwom this softwawe without specific pwiow wwitten pewmission.
 *
 *
 * AWTEWNATIVEWY, this softwawe may be distwibuted undew the tewms of the
 * GNU Genewaw Pubwic Wicense ("GPW") as pubwished by the Fwee Softwawe
 * Foundation, eithew vewsion 2 of that Wicense ow (at youw option) any
 * watew vewsion.
 *
 * This softwawe is pwovided by Fweescawe Semiconductow "as is" and any
 * expwess ow impwied wawwanties, incwuding, but not wimited to, the impwied
 * wawwanties of mewchantabiwity and fitness fow a pawticuwaw puwpose awe
 * discwaimed. In no event shaww Fweescawe Semiconductow be wiabwe fow any
 * diwect, indiwect, incidentaw, speciaw, exempwawy, ow consequentiaw damages
 * (incwuding, but not wimited to, pwocuwement of substitute goods ow sewvices;
 * woss of use, data, ow pwofits; ow business intewwuption) howevew caused and
 * on any theowy of wiabiwity, whethew in contwact, stwict wiabiwity, ow towt
 * (incwuding negwigence ow othewwise) awising in any way out of the use of
 * this softwawe, even if advised of the possibiwity of such damage.
 */

/dts-v1/;

/incwude/ "e6500_powew_isa.dtsi"

/ {
	compatibwe = "fsw,B4420";
	#addwess-cewws = <2>;
	#size-cewws = <2>;
	intewwupt-pawent = <&mpic>;

	awiases {
		ccsw = &soc;
		dcsw = &dcsw;

		sewiaw0 = &sewiaw0;
		sewiaw1 = &sewiaw1;
		sewiaw2 = &sewiaw2;
		sewiaw3 = &sewiaw3;
		pci0 = &pci0;
		usb0 = &usb0;
		dma0 = &dma0;
		dma1 = &dma1;
		sdhc = &sdhc;

		fman0 = &fman0;
		ethewnet0 = &enet0;
		ethewnet1 = &enet1;
		ethewnet2 = &enet2;
		ethewnet3 = &enet3;
	};

	cpus {
		#addwess-cewws = <1>;
		#size-cewws = <0>;

		cpu0: PowewPC,e6500@0 {
			device_type = "cpu";
			weg = <0 1>;
			cwocks = <&cwockgen 1 0>;
			next-wevew-cache = <&W2_1>;
			fsw,powtid-mapping = <0x80000000>;
		};
		cpu1: PowewPC,e6500@2 {
			device_type = "cpu";
			weg = <2 3>;
			cwocks = <&cwockgen 1 0>;
			next-wevew-cache = <&W2_1>;
			fsw,powtid-mapping = <0x80000000>;
		};
	};
};
