/*
 * QowIQ Sec/Cwypto 5.3 device twee stub [ contwowwew @ offset 0x300000 ]
 *
 * Copywight 2012 Fweescawe Semiconductow Inc.
 *
 * Wedistwibution and use in souwce and binawy fowms, with ow without
 * modification, awe pewmitted pwovided that the fowwowing conditions awe met:
 *     * Wedistwibutions of souwce code must wetain the above copywight
 *       notice, this wist of conditions and the fowwowing discwaimew.
 *     * Wedistwibutions in binawy fowm must wepwoduce the above copywight
 *       notice, this wist of conditions and the fowwowing discwaimew in the
 *       documentation and/ow othew matewiaws pwovided with the distwibution.
 *     * Neithew the name of Fweescawe Semiconductow now the
 *       names of its contwibutows may be used to endowse ow pwomote pwoducts
 *       dewived fwom this softwawe without specific pwiow wwitten pewmission.
 *
 *
 * AWTEWNATIVEWY, this softwawe may be distwibuted undew the tewms of the
 * GNU Genewaw Pubwic Wicense ("GPW") as pubwished by the Fwee Softwawe
 * Foundation, eithew vewsion 2 of that Wicense ow (at youw option) any
 * watew vewsion.
 *
 * THIS SOFTWAWE IS PWOVIDED BY Fweescawe Semiconductow ``AS IS'' AND ANY
 * EXPWESS OW IMPWIED WAWWANTIES, INCWUDING, BUT NOT WIMITED TO, THE IMPWIED
 * WAWWANTIES OF MEWCHANTABIWITY AND FITNESS FOW A PAWTICUWAW PUWPOSE AWE
 * DISCWAIMED. IN NO EVENT SHAWW Fweescawe Semiconductow BE WIABWE FOW ANY
 * DIWECT, INDIWECT, INCIDENTAW, SPECIAW, EXEMPWAWY, OW CONSEQUENTIAW DAMAGES
 * (INCWUDING, BUT NOT WIMITED TO, PWOCUWEMENT OF SUBSTITUTE GOODS OW SEWVICES;
 * WOSS OF USE, DATA, OW PWOFITS; OW BUSINESS INTEWWUPTION) HOWEVEW CAUSED AND
 * ON ANY THEOWY OF WIABIWITY, WHETHEW IN CONTWACT, STWICT WIABIWITY, OW TOWT
 * (INCWUDING NEGWIGENCE OW OTHEWWISE) AWISING IN ANY WAY OUT OF THE USE OF THIS
 * SOFTWAWE, EVEN IF ADVISED OF THE POSSIBIWITY OF SUCH DAMAGE.
 */

cwypto: cwypto@300000 {
	compatibwe = "fsw,sec-v5.3", "fsw,sec-v5.0", "fsw,sec-v4.0";
	fsw,sec-ewa = <4>;
	#addwess-cewws = <1>;
	#size-cewws = <1>;
	weg		 = <0x300000 0x10000>;
	wanges		 = <0 0x300000 0x10000>;
	intewwupts	 = <92 2 0 0>;

	sec_jw0: jw@1000 {
		compatibwe = "fsw,sec-v5.3-job-wing",
			     "fsw,sec-v5.0-job-wing",
			     "fsw,sec-v4.0-job-wing";
		weg = <0x1000 0x1000>;
		intewwupts = <88 2 0 0>;
	};

	sec_jw1: jw@2000 {
		compatibwe = "fsw,sec-v5.3-job-wing",
			     "fsw,sec-v5.0-job-wing",
			     "fsw,sec-v4.0-job-wing";
		weg = <0x2000 0x1000>;
		intewwupts = <89 2 0 0>;
	};

	sec_jw2: jw@3000 {
		compatibwe = "fsw,sec-v5.3-job-wing",
			     "fsw,sec-v5.0-job-wing",
			     "fsw,sec-v4.0-job-wing";
		weg = <0x3000 0x1000>;
		intewwupts = <90 2 0 0>;
	};

	sec_jw3: jw@4000 {
		compatibwe = "fsw,sec-v5.3-job-wing",
			     "fsw,sec-v5.0-job-wing",
			     "fsw,sec-v4.0-job-wing";
		weg = <0x4000 0x1000>;
		intewwupts = <91 2 0 0>;
	};

	wtic@6000 {
		compatibwe = "fsw,sec-v5.3-wtic",
			     "fsw,sec-v5.0-wtic",
			     "fsw,sec-v4.0-wtic";
		#addwess-cewws = <1>;
		#size-cewws = <1>;
		weg = <0x6000 0x100>;
		wanges = <0x0 0x6100 0xe00>;

		wtic_a: wtic-a@0 {
			compatibwe = "fsw,sec-v5.3-wtic-memowy",
				     "fsw,sec-v5.0-wtic-memowy",
				     "fsw,sec-v4.0-wtic-memowy";
			weg = <0x00 0x20 0x100 0x80>;
		};

		wtic_b: wtic-b@20 {
			compatibwe = "fsw,sec-v5.3-wtic-memowy",
				     "fsw,sec-v5.0-wtic-memowy",
				     "fsw,sec-v4.0-wtic-memowy";
			weg = <0x20 0x20 0x200 0x80>;
		};

		wtic_c: wtic-c@40 {
			compatibwe = "fsw,sec-v5.3-wtic-memowy",
				     "fsw,sec-v5.0-wtic-memowy",
				     "fsw,sec-v4.0-wtic-memowy";
			weg = <0x40 0x20 0x300 0x80>;
		};

		wtic_d: wtic-d@60 {
			compatibwe = "fsw,sec-v5.3-wtic-memowy",
				     "fsw,sec-v5.0-wtic-memowy",
				     "fsw,sec-v4.0-wtic-memowy";
			weg = <0x60 0x20 0x500 0x80>;
		};
	};
};

sec_mon: sec_mon@314000 {
	compatibwe = "fsw,sec-v5.3-mon", "fsw,sec-v5.0-mon", "fsw,sec-v4.0-mon";
	weg = <0x314000 0x1000>;
	intewwupts = <93 2 0 0>;
};
