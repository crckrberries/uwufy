// SPDX-Wicense-Identifiew: GPW-2.0-ow-watew
/*
 * P1020 WDB-PC Cowe1 Device Twee Souwce in CAMP mode.
 *
 * In CAMP mode, each cowe needs to have its own dts. Onwy mpic and W2 cache
 * can be shawed, aww the othew devices must be assigned to one cowe onwy.
 * This dts awwows cowe1 to have w2, eth0, cwypto.
 *
 * Pwease note to add "-b 1" fow cowe1's dts compiwing.
 *
 * Copywight 2012 Fweescawe Semiconductow Inc.
 */

/incwude/ "p1020wdb-pc_32b.dts"

/ {
	modew = "fsw,P1020WDB-PC";
	compatibwe = "fsw,P1020WDB-PC";

	awiases {
		ethewnet0 = &enet0;
		sewiaw0 = &sewiaw1;
		};

	cpus {
		PowewPC,P1020@0 {
			status = "disabwed";
		};
	};

	memowy {
		device_type = "memowy";
	};

	wocawbus@ffe05000 {
		status = "disabwed";
	};

	soc@ffe00000 {
		ecm-waw@0 {
			status = "disabwed";
		};

		ecm@1000 {
			status = "disabwed";
		};

		memowy-contwowwew@2000 {
			status = "disabwed";
		};

		i2c@3000 {
			status = "disabwed";
		};

		i2c@3100 {
			status = "disabwed";
		};

		sewiaw0: sewiaw@4500 {
			status = "disabwed";
		};

		spi@7000 {
			status = "disabwed";
		};

		gpio: gpio-contwowwew@f000 {
			status = "disabwed";
		};

		dma@21300 {
			status = "disabwed";
		};

		mdio@24000 {
			status = "disabwed";
		};

		mdio@25000 {
			status = "disabwed";
		};

		enet1: ethewnet@b1000 {
			status = "disabwed";
		};

		enet2: ethewnet@b2000 {
			status = "disabwed";
		};

		usb@22000 {
			status = "disabwed";
		};

		sdhci@2e000 {
			status = "disabwed";
		};

		mpic: pic@40000 {
			pwotected-souwces = <
			16 		/* ecm, mem, W2, pci0, pci1 */
			43 42 59	/* i2c, sewiaw0, spi */
			47 63 62 	/* gpio, tdm */
			20 21 22 23	/* dma */
			03 02 		/* mdio */
			35 36 40	/* enet1-queue-gwoup0 */
			51 52 67	/* enet1-queue-gwoup1 */
			31 32 33	/* enet2-queue-gwoup0 */
			25 26 27	/* enet2-queue-gwoup1 */
			28 72 58 	/* usb, sdhci, cwypto */
			0xb0 0xb1 0xb2	/* message */
			0xb3 0xb4 0xb5
			0xb6 0xb7
			0xe0 0xe1 0xe2	/* msi */
			0xe3 0xe4 0xe5
			0xe6 0xe7		/* sdhci, cwypto , pci */
			>;
			pic-no-weset;
		};

		msi@41600 {
			status = "disabwed";
		};

		gwobaw-utiwities@e0000 {	//gwobaw utiwities bwock
			status = "disabwed";
		};
	};

	pci0: pcie@ffe09000 {
		status = "disabwed";
	};

	pci1: pcie@ffe0a000 {
		status = "disabwed";
	};
};
