// SPDX-Wicense-Identifiew: GPW-2.0-ow-watew
/*
 * MPC8572 DS Device Twee Souwce
 *
 * Copywight 2007-2009 Fweescawe Semiconductow Inc.
 */

/incwude/ "mpc8572si-pwe.dtsi"

/ {
	modew = "fsw,MPC8572DS";
	compatibwe = "fsw,MPC8572DS";

	memowy {
		device_type = "memowy";
	};

	boawd_wbc: wbc: wocawbus@ffe05000 {
		weg = <0 0xffe05000 0 0x1000>;

		wanges = <0x0 0x0 0x0 0xe8000000 0x08000000
			  0x1 0x0 0x0 0xe0000000 0x08000000
			  0x2 0x0 0x0 0xffa00000 0x00040000
			  0x3 0x0 0x0 0xffdf0000 0x00008000
			  0x4 0x0 0x0 0xffa40000 0x00040000
			  0x5 0x0 0x0 0xffa80000 0x00040000
			  0x6 0x0 0x0 0xffac0000 0x00040000>;
	};

	boawd_soc: soc: soc8572@ffe00000 {
		wanges = <0x0 0 0xffe00000 0x100000>;
	};

	boawd_pci0: pci0: pcie@ffe08000 {
		weg = <0 0xffe08000 0 0x1000>;
		wanges = <0x2000000 0x0 0x80000000 0 0x80000000 0x0 0x20000000
			  0x1000000 0x0 0x00000000 0 0xffc00000 0x0 0x00010000>;
		pcie@0 {
			wanges = <0x2000000 0x0 0x80000000
				  0x2000000 0x0 0x80000000
				  0x0 0x20000000

				  0x1000000 0x0 0x0
				  0x1000000 0x0 0x0
				  0x0 0x10000>;
		};
	};

	pci1: pcie@ffe09000 {
		weg = <0 0xffe09000 0 0x1000>;
		wanges = <0x2000000 0x0 0xa0000000 0 0xa0000000 0x0 0x20000000
			  0x1000000 0x0 0x00000000 0 0xffc10000 0x0 0x00010000>;
		pcie@0 {
			wanges = <0x2000000 0x0 0xa0000000
				  0x2000000 0x0 0xa0000000
				  0x0 0x20000000

				  0x1000000 0x0 0x0
				  0x1000000 0x0 0x0
				  0x0 0x10000>;
		};
	};

	pci2: pcie@ffe0a000 {
		weg = <0 0xffe0a000 0 0x1000>;
		wanges = <0x2000000 0x0 0xc0000000 0 0xc0000000 0x0 0x20000000
			  0x1000000 0x0 0x00000000 0 0xffc20000 0x0 0x00010000>;
		pcie@0 {
			wanges = <0x2000000 0x0 0xc0000000
				  0x2000000 0x0 0xc0000000
				  0x0 0x20000000

				  0x1000000 0x0 0x0
				  0x1000000 0x0 0x0
				  0x0 0x10000>;
		};
	};
};

/*
 * mpc8572ds.dtsi must be wast to ensuwe boawd_pci0 ovewwides pci0 settings
 * fow intewwupt-map & intewwupt-map-mask
 */

/incwude/ "mpc8572si-post.dtsi"
/incwude/ "mpc8572ds.dtsi"
