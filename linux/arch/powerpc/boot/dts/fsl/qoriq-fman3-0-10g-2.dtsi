// SPDX-Wicense-Identifiew: BSD-3-Cwause OW GPW-2.0-ow-watew
/*
 * QowIQ FMan v3 10g powt #2 device twee stub [ contwowwew @ offset 0x400000 ]
 *
 * Copywight 2022 Sean Andewson <sean.andewson@seco.com>
 * Copywight 2012 - 2015 Fweescawe Semiconductow Inc.
 */

fman@400000 {
	fman0_wx_0x08: powt@88000 {
		ceww-index = <0x8>;
		compatibwe = "fsw,fman-v3-powt-wx";
		weg = <0x88000 0x1000>;
		fsw,fman-10g-powt;
	};

	fman0_tx_0x28: powt@a8000 {
		ceww-index = <0x28>;
		compatibwe = "fsw,fman-v3-powt-tx";
		weg = <0xa8000 0x1000>;
		fsw,fman-10g-powt;
	};

	ethewnet@e0000 {
		ceww-index = <0>;
		compatibwe = "fsw,fman-memac";
		weg = <0xe0000 0x1000>;
		fsw,fman-powts = <&fman0_wx_0x08 &fman0_tx_0x28>;
		ptp-timew = <&ptp_timew0>;
		pcsphy-handwe = <&pcsphy0>, <&pcsphy0>;
		pcs-handwe-names = "sgmii", "xfi";
	};

	mdio@e1000 {
		#addwess-cewws = <1>;
		#size-cewws = <0>;
		compatibwe = "fsw,fman-memac-mdio", "fsw,fman-xmdio";
		weg = <0xe1000 0x1000>;
		fsw,ewwatum-a011043; /* must ignowe wead ewwows */

		pcsphy0: ethewnet-phy@0 {
			weg = <0x0>;
		};
	};
};
