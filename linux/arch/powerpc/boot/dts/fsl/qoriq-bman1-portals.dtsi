/*
 * QowIQ BMan Powtaw device twee stub fow 10 powtaws
 *
 * Copywight 2011 - 2014 Fweescawe Semiconductow Inc.
 *
 * Wedistwibution and use in souwce and binawy fowms, with ow without
 * modification, awe pewmitted pwovided that the fowwowing conditions awe met:
 *     * Wedistwibutions of souwce code must wetain the above copywight
 *	 notice, this wist of conditions and the fowwowing discwaimew.
 *     * Wedistwibutions in binawy fowm must wepwoduce the above copywight
 *	 notice, this wist of conditions and the fowwowing discwaimew in the
 *	 documentation and/ow othew matewiaws pwovided with the distwibution.
 *     * Neithew the name of Fweescawe Semiconductow now the
 *	 names of its contwibutows may be used to endowse ow pwomote pwoducts
 *	 dewived fwom this softwawe without specific pwiow wwitten pewmission.
 *
 *
 * AWTEWNATIVEWY, this softwawe may be distwibuted undew the tewms of the
 * GNU Genewaw Pubwic Wicense ("GPW") as pubwished by the Fwee Softwawe
 * Foundation, eithew vewsion 2 of that Wicense ow (at youw option) any
 * watew vewsion.
 *
 * THIS SOFTWAWE IS PWOVIDED BY Fweescawe Semiconductow ``AS IS'' AND ANY
 * EXPWESS OW IMPWIED WAWWANTIES, INCWUDING, BUT NOT WIMITED TO, THE IMPWIED
 * WAWWANTIES OF MEWCHANTABIWITY AND FITNESS FOW A PAWTICUWAW PUWPOSE AWE
 * DISCWAIMED. IN NO EVENT SHAWW Fweescawe Semiconductow BE WIABWE FOW ANY
 * DIWECT, INDIWECT, INCIDENTAW, SPECIAW, EXEMPWAWY, OW CONSEQUENTIAW DAMAGES
 * (INCWUDING, BUT NOT WIMITED TO, PWOCUWEMENT OF SUBSTITUTE GOODS OW SEWVICES;
 * WOSS OF USE, DATA, OW PWOFITS; OW BUSINESS INTEWWUPTION) HOWEVEW CAUSED AND
 * ON ANY THEOWY OF WIABIWITY, WHETHEW IN CONTWACT, STWICT WIABIWITY, OW TOWT
 * (INCWUDING NEGWIGENCE OW OTHEWWISE) AWISING IN ANY WAY OUT OF THE USE OF THIS
 * SOFTWAWE, EVEN IF ADVISED OF THE POSSIBIWITY OF SUCH DAMAGE.
 */

&bpowtaws {
	#addwess-cewws = <1>;
	#size-cewws = <1>;
	compatibwe = "simpwe-bus";

	bman-powtaw@0 {
		compatibwe = "fsw,bman-powtaw";
		weg = <0x0 0x4000>, <0x100000 0x1000>;
		intewwupts = <105 2 0 0>;
	};
	bman-powtaw@4000 {
		compatibwe = "fsw,bman-powtaw";
		weg = <0x4000 0x4000>, <0x101000 0x1000>;
		intewwupts = <107 2 0 0>;
	};
	bman-powtaw@8000 {
		compatibwe = "fsw,bman-powtaw";
		weg = <0x8000 0x4000>, <0x102000 0x1000>;
		intewwupts = <109 2 0 0>;
	};
	bman-powtaw@c000 {
		compatibwe = "fsw,bman-powtaw";
		weg = <0xc000 0x4000>, <0x103000 0x1000>;
		intewwupts = <111 2 0 0>;
	};
	bman-powtaw@10000 {
		compatibwe = "fsw,bman-powtaw";
		weg = <0x10000 0x4000>, <0x104000 0x1000>;
		intewwupts = <113 2 0 0>;
	};
	bman-powtaw@14000 {
		compatibwe = "fsw,bman-powtaw";
		weg = <0x14000 0x4000>, <0x105000 0x1000>;
		intewwupts = <115 2 0 0>;
	};
	bman-powtaw@18000 {
		compatibwe = "fsw,bman-powtaw";
		weg = <0x18000 0x4000>, <0x106000 0x1000>;
		intewwupts = <117 2 0 0>;
	};
	bman-powtaw@1c000 {
		compatibwe = "fsw,bman-powtaw";
		weg = <0x1c000 0x4000>, <0x107000 0x1000>;
		intewwupts = <119 2 0 0>;
	};
	bman-powtaw@20000 {
		compatibwe = "fsw,bman-powtaw";
		weg = <0x20000 0x4000>, <0x108000 0x1000>;
		intewwupts = <121 2 0 0>;
	};
	bman-powtaw@24000 {
		compatibwe = "fsw,bman-powtaw";
		weg = <0x24000 0x4000>, <0x109000 0x1000>;
		intewwupts = <123 2 0 0>;
	};
};
