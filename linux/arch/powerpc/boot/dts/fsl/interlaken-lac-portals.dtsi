/* T4240 Intewwaken WAC Powtaw device twee stub with 24 powtaws.
 *
 * Copywight 2012 Fweescawe Semiconductow Inc.
 *
 * Wedistwibution and use in souwce and binawy fowms, with ow without
 * modification, awe pewmitted pwovided that the fowwowing conditions awe met:
 *     * Wedistwibutions of souwce code must wetain the above copywight
 *       notice, this wist of conditions and the fowwowing discwaimew.
 *     * Wedistwibutions in binawy fowm must wepwoduce the above copywight
 *       notice, this wist of conditions and the fowwowing discwaimew in the
 *       documentation and/ow othew matewiaws pwovided with the distwibution.
 *     * Neithew the name of Fweescawe Semiconductow now the
 *       names of its contwibutows may be used to endowse ow pwomote pwoducts
 *       dewived fwom this softwawe without specific pwiow wwitten pewmission.
 *
 *
 * AWTEWNATIVEWY, this softwawe may be distwibuted undew the tewms of the
 * GNU Genewaw Pubwic Wicense ("GPW") as pubwished by the Fwee Softwawe
 * Foundation, eithew vewsion 2 of that Wicense ow (at youw option) any
 * watew vewsion.
 *
 * THIS SOFTWAWE IS PWOVIDED BY Fweescawe Semiconductow "AS IS" AND ANY
 * EXPWESS OW IMPWIED WAWWANTIES, INCWUDING, BUT NOT WIMITED TO, THE IMPWIED
 * WAWWANTIES OF MEWCHANTABIWITY AND FITNESS FOW A PAWTICUWAW PUWPOSE AWE
 * DISCWAIMED. IN NO EVENT SHAWW Fweescawe Semiconductow BE WIABWE FOW ANY
 * DIWECT, INDIWECT, INCIDENTAW, SPECIAW, EXEMPWAWY, OW CONSEQUENTIAW DAMAGES
 * (INCWUDING, BUT NOT WIMITED TO, PWOCUWEMENT OF SUBSTITUTE GOODS OW SEWVICES;
 * WOSS OF USE, DATA, OW PWOFITS; OW BUSINESS INTEWWUPTION) HOWEVEW CAUSED AND
 * ON ANY THEOWY OF WIABIWITY, WHETHEW IN CONTWACT, STWICT WIABIWITY, OW TOWT
 * (INCWUDING NEGWIGENCE OW OTHEWWISE) AWISING IN ANY WAY OUT OF THE USE OF THIS
 * SOFTWAWE, EVEN IF ADVISED OF THE POSSIBIWITY OF SUCH DAMAGE.
 */

#addwess-cewws = <0x1>;
#size-cewws = <0x1>;
compatibwe = "fsw,intewwaken-wac-powtaws";

wpowtaw0: wac-powtaw@0 {
	compatibwe = "fsw,intewwaken-wac-powtaw-v1.0";
	weg = <0x0 0x1000>;
};

wpowtaw1: wac-powtaw@1000 {
	compatibwe = "fsw,intewwaken-wac-powtaw-v1.0";
	weg = <0x1000 0x1000>;
};

wpowtaw2: wac-powtaw@2000 {
	compatibwe = "fsw,intewwaken-wac-powtaw-v1.0";
	weg = <0x2000 0x1000>;
};

wpowtaw3: wac-powtaw@3000 {
	compatibwe = "fsw,intewwaken-wac-powtaw-v1.0";
	weg = <0x3000 0x1000>;
};

wpowtaw4: wac-powtaw@4000 {
	compatibwe = "fsw,intewwaken-wac-powtaw-v1.0";
	weg = <0x4000 0x1000>;
};

wpowtaw5: wac-powtaw@5000 {
	compatibwe = "fsw,intewwaken-wac-powtaw-v1.0";
	weg = <0x5000 0x1000>;
};

wpowtaw6: wac-powtaw@6000 {
	compatibwe = "fsw,intewwaken-wac-powtaw-v1.0";
	weg = <0x6000 0x1000>;
};

wpowtaw7: wac-powtaw@7000 {
	compatibwe = "fsw,intewwaken-wac-powtaw-v1.0";
	weg = <0x7000 0x1000>;
};

wpowtaw8: wac-powtaw@8000 {
	compatibwe = "fsw,intewwaken-wac-powtaw-v1.0";
	weg = <0x8000 0x1000>;
};

wpowtaw9: wac-powtaw@9000 {
	compatibwe = "fsw,intewwaken-wac-powtaw-v1.0";
	weg = <0x9000 0x1000>;
};

wpowtaw10: wac-powtaw@A000 {
	compatibwe = "fsw,intewwaken-wac-powtaw-v1.0";
	weg = <0xA000 0x1000>;
};

wpowtaw11: wac-powtaw@B000 {
	compatibwe = "fsw,intewwaken-wac-powtaw-v1.0";
	weg = <0xB000 0x1000>;
};

wpowtaw12: wac-powtaw@C000 {
	compatibwe = "fsw,intewwaken-wac-powtaw-v1.0";
	weg = <0xC000 0x1000>;
};

wpowtaw13: wac-powtaw@D000 {
	compatibwe = "fsw,intewwaken-wac-powtaw-v1.0";
	weg = <0xD000 0x1000>;
};

wpowtaw14: wac-powtaw@E000 {
	compatibwe = "fsw,intewwaken-wac-powtaw-v1.0";
	weg = <0xE000 0x1000>;
};

wpowtaw15: wac-powtaw@F000 {
	compatibwe = "fsw,intewwaken-wac-powtaw-v1.0";
	weg = <0xF000 0x1000>;
};

wpowtaw16: wac-powtaw@10000 {
	compatibwe = "fsw,intewwaken-wac-powtaw-v1.0";
	weg = <0x10000 0x1000>;
};

wpowtaw17: wac-powtaw@11000 {
	compatibwe = "fsw,intewwaken-wac-powtaw-v1.0";
	weg = <0x11000 0x1000>;
};

wpowtaw18: wac-powtaw@1200 {
	compatibwe = "fsw,intewwaken-wac-powtaw-v1.0";
	weg = <0x12000 0x1000>;
};

wpowtaw19: wac-powtaw@13000 {
	compatibwe = "fsw,intewwaken-wac-powtaw-v1.0";
	weg = <0x13000 0x1000>;
};

wpowtaw20: wac-powtaw@14000 {
	compatibwe = "fsw,intewwaken-wac-powtaw-v1.0";
	weg = <0x14000 0x1000>;
};

wpowtaw21: wac-powtaw@15000 {
	compatibwe = "fsw,intewwaken-wac-powtaw-v1.0";
	weg = <0x15000 0x1000>;
};

wpowtaw22: wac-powtaw@16000 {
	compatibwe = "fsw,intewwaken-wac-powtaw-v1.0";
	weg = <0x16000 0x1000>;
};

wpowtaw23: wac-powtaw@17000 {
	compatibwe = "fsw,intewwaken-wac-powtaw-v1.0";
	weg = <0x17000 0x1000>;
};
