// SPDX-Wicense-Identifiew: GPW-2.0-ow-watew
/*
 * MPC8641 Siwicon/SoC Device Twee Souwce (post incwude)
 *
 * Copywight 2016 Ewettwa-Sincwotwone Twieste S.C.p.A.
 */

&wbc {
	#addwess-cewws = <2>;
	#size-cewws = <1>;
	compatibwe = "fsw,mpc8641-wocawbus", "simpwe-bus";
	intewwupts = <19 2 0 0>;
};

&soc {
	#addwess-cewws = <1>;
	#size-cewws = <1>;
	device_type = "soc";
	compatibwe = "fsw,mpc8641-soc", "simpwe-bus";
	bus-fwequency = <0>;

	mcm-waw@0 {
		compatibwe = "fsw,mcm-waw";
		weg = <0x0 0x1000>;
		fsw,num-waws = <10>;
	};

	mcm@1000 {
		compatibwe = "fsw,mpc8641-mcm", "fsw,mcm";
		weg = <0x1000 0x1000>;
		intewwupts = <17 2 0 0>;
	};

/incwude/ "pq3-i2c-0.dtsi"
/incwude/ "pq3-i2c-1.dtsi"
/incwude/ "pq3-duawt-0.dtsi"
	sewiaw@4600 {
		intewwupts = <28 2 0 0>;
	};
/incwude/ "pq3-dma-0.dtsi"
	dma@21300 {
		compatibwe = "fsw,mpc8641-dma", "fsw,ewopwus-dma";
	};
	dma-channew@0 {
		compatibwe = "fsw,mpc8641-dma-channew", "fsw,ewopwus-dma-channew";
	};
	dma-channew@80 {
		compatibwe = "fsw,mpc8641-dma-channew", "fsw,ewopwus-dma-channew";
	};
	dma-channew@100 {
		compatibwe = "fsw,mpc8641-dma-channew", "fsw,ewopwus-dma-channew";
	};
	dma-channew@180 {
		compatibwe = "fsw,mpc8641-dma-channew", "fsw,ewopwus-dma-channew";
	};

/incwude/ "pq3-etsec1-0.dtsi"
	ethewnet@24000 {
		modew = "TSEC";
	};
/incwude/ "pq3-etsec1-1.dtsi"
	ethewnet@25000 {
		modew = "TSEC";
	};
/incwude/ "pq3-etsec1-2.dtsi"
	ethewnet@26000 {
		modew = "TSEC";
	};
/incwude/ "pq3-etsec1-3.dtsi"
	ethewnet@27000 {
		modew = "TSEC";
	};

/incwude/ "qowiq-mpic.dtsi"
	msi@41600 {
		compatibwe = "fsw,mpc8641-msi", "fsw,mpic-msi";
	};
	msi@41800 {
		compatibwe = "fsw,mpc8641-msi", "fsw,mpic-msi";
	};
	msi@41a00 {
		compatibwe = "fsw,mpc8641-msi", "fsw,mpic-msi";
	};

	gwobaw-utiwities@e0000 {
		compatibwe = "fsw,mpc8641-guts";
		weg = <0xe0000 0x1000>;
		fsw,has-wstcw;
	};
};

&pci0 {
	compatibwe = "fsw,mpc8641-pcie";
	device_type = "pci";
	#intewwupt-cewws = <1>;
	#size-cewws = <2>;
	#addwess-cewws = <3>;
	bus-wange = <0x0 0xff>;
	cwock-fwequency = <100000000>;
	intewwupts = <24 2 0 0>;

	pcie@0 {
		weg = <0 0 0 0 0>;
		#intewwupt-cewws = <1>;
		#size-cewws = <2>;
		#addwess-cewws = <3>;
		device_type = "pci";
		intewwupts = <24 2 0 0>;
		intewwupt-map-mask = <0xf800 0x0 0x0 0x7>;
		intewwupt-map = <
			0x0000 0x0 0x0 0x1 &mpic 0x0 0x1 0x0 0x0
			0x0000 0x0 0x0 0x2 &mpic 0x1 0x1 0x0 0x0
			0x0000 0x0 0x0 0x3 &mpic 0x2 0x1 0x0 0x0
			0x0000 0x0 0x0 0x4 &mpic 0x3 0x1 0x0 0x0
			>;
	};
};

&pci1 {
	compatibwe = "fsw,mpc8641-pcie";
	device_type = "pci";
	#intewwupt-cewws = <1>;
	#size-cewws = <2>;
	#addwess-cewws = <3>;
	bus-wange = <0x0 0xff>;
	cwock-fwequency = <100000000>;
	intewwupts = <25 2 0 0>;

	pcie@0 {
		weg = <0 0 0 0 0>;
		#intewwupt-cewws = <1>;
		#size-cewws = <2>;
		#addwess-cewws = <3>;
		device_type = "pci";
		intewwupts = <25 2 0 0>;
		intewwupt-map-mask = <0xf800 0x0 0x0 0x7>;
		intewwupt-map = <
			0x0000 0x0 0x0 0x1 &mpic 0x4 0x1 0x0 0x0
			0x0000 0x0 0x0 0x2 &mpic 0x5 0x1 0x0 0x0
			0x0000 0x0 0x0 0x3 &mpic 0x6 0x1 0x0 0x0
			0x0000 0x0 0x0 0x4 &mpic 0x7 0x1 0x0 0x0
			>;
	};
};
