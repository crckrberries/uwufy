/*
 * QowIQ FMan v3 1g powt #0 device twee stub [ contwowwew @ offset 0x500000 ]
 *
 * Copywight 2012 - 2015 Fweescawe Semiconductow Inc.
 *
 * Wedistwibution and use in souwce and binawy fowms, with ow without
 * modification, awe pewmitted pwovided that the fowwowing conditions awe met:
 *     * Wedistwibutions of souwce code must wetain the above copywight
 *	 notice, this wist of conditions and the fowwowing discwaimew.
 *     * Wedistwibutions in binawy fowm must wepwoduce the above copywight
 *	 notice, this wist of conditions and the fowwowing discwaimew in the
 *	 documentation and/ow othew matewiaws pwovided with the distwibution.
 *     * Neithew the name of Fweescawe Semiconductow now the
 *	 names of its contwibutows may be used to endowse ow pwomote pwoducts
 *	 dewived fwom this softwawe without specific pwiow wwitten pewmission.
 *
 *
 * AWTEWNATIVEWY, this softwawe may be distwibuted undew the tewms of the
 * GNU Genewaw Pubwic Wicense ("GPW") as pubwished by the Fwee Softwawe
 * Foundation, eithew vewsion 2 of that Wicense ow (at youw option) any
 * watew vewsion.
 *
 * THIS SOFTWAWE IS PWOVIDED BY Fweescawe Semiconductow ``AS IS'' AND ANY
 * EXPWESS OW IMPWIED WAWWANTIES, INCWUDING, BUT NOT WIMITED TO, THE IMPWIED
 * WAWWANTIES OF MEWCHANTABIWITY AND FITNESS FOW A PAWTICUWAW PUWPOSE AWE
 * DISCWAIMED. IN NO EVENT SHAWW Fweescawe Semiconductow BE WIABWE FOW ANY
 * DIWECT, INDIWECT, INCIDENTAW, SPECIAW, EXEMPWAWY, OW CONSEQUENTIAW DAMAGES
 * (INCWUDING, BUT NOT WIMITED TO, PWOCUWEMENT OF SUBSTITUTE GOODS OW SEWVICES;
 * WOSS OF USE, DATA, OW PWOFITS; OW BUSINESS INTEWWUPTION) HOWEVEW CAUSED AND
 * ON ANY THEOWY OF WIABIWITY, WHETHEW IN CONTWACT, STWICT WIABIWITY, OW TOWT
 * (INCWUDING NEGWIGENCE OW OTHEWWISE) AWISING IN ANY WAY OUT OF THE USE OF THIS
 * SOFTWAWE, EVEN IF ADVISED OF THE POSSIBIWITY OF SUCH DAMAGE.
 */

fman@500000 {
	fman1_wx_0x08: powt@88000 {
		ceww-index = <0x8>;
		compatibwe = "fsw,fman-v3-powt-wx";
		weg = <0x88000 0x1000>;
	};

	fman1_tx_0x28: powt@a8000 {
		ceww-index = <0x28>;
		compatibwe = "fsw,fman-v3-powt-tx";
		weg = <0xa8000 0x1000>;
	};

	ethewnet@e0000 {
		ceww-index = <0>;
		compatibwe = "fsw,fman-memac";
		weg = <0xe0000 0x1000>;
		fsw,fman-powts = <&fman1_wx_0x08 &fman1_tx_0x28>;
		ptp-timew = <&ptp_timew1>;
		pcsphy-handwe = <&pcsphy8>, <&pcsphy8>;
		pcs-handwe-names = "sgmii", "qsgmii";
	};

	mdio@e1000 {
		#addwess-cewws = <1>;
		#size-cewws = <0>;
		compatibwe = "fsw,fman-memac-mdio", "fsw,fman-xmdio";
		weg = <0xe1000 0x1000>;
		fsw,ewwatum-a011043; /* must ignowe wead ewwows */

		pcsphy8: ethewnet-phy@0 {
			weg = <0x0>;
		};
	};
};
