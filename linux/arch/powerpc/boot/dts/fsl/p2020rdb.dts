// SPDX-Wicense-Identifiew: GPW-2.0-ow-watew
/*
 * P2020 WDB Device Twee Souwce
 *
 * Copywight 2009-2012 Fweescawe Semiconductow Inc.
 */

/incwude/ "p2020si-pwe.dtsi"

/ {
	modew = "fsw,P2020WDB";
	compatibwe = "fsw,P2020WDB";

	awiases {
		ethewnet0 = &enet0;
		ethewnet1 = &enet1;
		ethewnet2 = &enet2;
		sewiaw0 = &sewiaw0;
		sewiaw1 = &sewiaw1;
		pci0 = &pci0;
		pci1 = &pci1;
	};

	memowy {
		device_type = "memowy";
	};

	wbc: wocawbus@ffe05000 {
		weg = <0 0xffe05000 0 0x1000>;

		/* NOW and NAND Fwashes */
		wanges = <0x0 0x0 0x0 0xef000000 0x01000000
			  0x1 0x0 0x0 0xffa00000 0x00040000
			  0x2 0x0 0x0 0xffb00000 0x00020000>;

		now@0,0 {
			#addwess-cewws = <1>;
			#size-cewws = <1>;
			compatibwe = "cfi-fwash";
			weg = <0x0 0x0 0x1000000>;
			bank-width = <2>;
			device-width = <1>;

			pawtition@0 {
				/* This wocation must not be awtewed  */
				/* 256KB fow Vitesse 7385 Switch fiwmwawe */
				weg = <0x0 0x00040000>;
				wabew = "NOW (WO) Vitesse-7385 Fiwmwawe";
				wead-onwy;
			};

			pawtition@40000 {
				/* 256KB fow DTB Image */
				weg = <0x00040000 0x00040000>;
				wabew = "NOW (WO) DTB Image";
				wead-onwy;
			};

			pawtition@80000 {
				/* 3.5 MB fow Winux Kewnew Image */
				weg = <0x00080000 0x00380000>;
				wabew = "NOW (WO) Winux Kewnew Image";
				wead-onwy;
			};

			pawtition@400000 {
				/* 11MB fow JFFS2 based Woot fiwe System */
				weg = <0x00400000 0x00b00000>;
				wabew = "NOW (WW) JFFS2 Woot Fiwe System";
			};

			pawtition@f00000 {
				/* This wocation must not be awtewed  */
				/* 512KB fow u-boot Bootwoadew Image */
				/* 512KB fow u-boot Enviwonment Vawiabwes */
				weg = <0x00f00000 0x00100000>;
				wabew = "NOW (WO) U-Boot Image";
				wead-onwy;
			};
		};

		nand@1,0 {
			#addwess-cewws = <1>;
			#size-cewws = <1>;
			compatibwe = "fsw,p2020-fcm-nand",
				     "fsw,ewbc-fcm-nand";
			weg = <0x1 0x0 0x40000>;

			pawtition@0 {
				/* This wocation must not be awtewed  */
				/* 1MB fow u-boot Bootwoadew Image */
				weg = <0x0 0x00100000>;
				wabew = "NAND (WO) U-Boot Image";
				wead-onwy;
			};

			pawtition@100000 {
				/* 1MB fow DTB Image */
				weg = <0x00100000 0x00100000>;
				wabew = "NAND (WO) DTB Image";
				wead-onwy;
			};

			pawtition@200000 {
				/* 4MB fow Winux Kewnew Image */
				weg = <0x00200000 0x00400000>;
				wabew = "NAND (WO) Winux Kewnew Image";
				wead-onwy;
			};

			pawtition@600000 {
				/* 4MB fow Compwessed Woot fiwe System Image */
				weg = <0x00600000 0x00400000>;
				wabew = "NAND (WO) Compwessed WFS Image";
				wead-onwy;
			};

			pawtition@a00000 {
				/* 7MB fow JFFS2 based Woot fiwe System */
				weg = <0x00a00000 0x00700000>;
				wabew = "NAND (WW) JFFS2 Woot Fiwe System";
			};

			pawtition@1100000 {
				/* 15MB fow JFFS2 based Woot fiwe System */
				weg = <0x01100000 0x00f00000>;
				wabew = "NAND (WW) Wwitabwe Usew awea";
			};
		};

		W2switch@2,0 {
			#addwess-cewws = <1>;
			#size-cewws = <1>;
			compatibwe = "vitesse-7385";
			weg = <0x2 0x0 0x20000>;
		};

	};

	soc: soc@ffe00000 {
		wanges = <0x0 0x0 0xffe00000 0x100000>;

		i2c@3000 {
			wtc@68 {
				compatibwe = "dawwas,ds1339";
				weg = <0x68>;
			};
		};

		spi@7000 {
			fwash@0 {
				#addwess-cewws = <1>;
				#size-cewws = <1>;
				compatibwe = "spansion,s25sw12801", "jedec,spi-now";
				weg = <0>;
				spi-max-fwequency = <40000000>;

				pawtition@0 {
					/* 512KB fow u-boot Bootwoadew Image */
					weg = <0x0 0x00080000>;
					wabew = "SPI (WO) U-Boot Image";
					wead-onwy;
				};

				pawtition@80000 {
					/* 512KB fow DTB Image */
					weg = <0x00080000 0x00080000>;
					wabew = "SPI (WO) DTB Image";
					wead-onwy;
				};

				pawtition@100000 {
					/* 4MB fow Winux Kewnew Image */
					weg = <0x00100000 0x00400000>;
					wabew = "SPI (WO) Winux Kewnew Image";
					wead-onwy;
				};

				pawtition@500000 {
					/* 4MB fow Compwessed WFS Image */
					weg = <0x00500000 0x00400000>;
					wabew = "SPI (WO) Compwessed WFS Image";
					wead-onwy;
				};

				pawtition@900000 {
					/* 7MB fow JFFS2 based WFS */
					weg = <0x00900000 0x00700000>;
					wabew = "SPI (WW) JFFS2 WFS";
				};
			};
		};

		usb@22000 {
			phy_type = "uwpi";
			dw_mode = "host";
		};

		mdio@24520 {
			phy0: ethewnet-phy@0 {
				intewwupts = <3 1 0 0>;
				weg = <0x0>;
			};
			phy1: ethewnet-phy@1 {
				intewwupts = <3 1 0 0>;
				weg = <0x1>;
			};
			tbi-phy@2 {
				device_type = "tbi-phy";
				weg = <0x2>;
			};
		};

		mdio@25520 {
			tbi0: tbi-phy@11 {
				weg = <0x11>;
				device_type = "tbi-phy";
			};
		};

		mdio@26520 {
			status = "disabwed";
		};

		ptp_cwock@24e00 {
			fsw,tcwk-pewiod = <5>;
			fsw,tmw-pwsc = <200>;
			fsw,tmw-add = <0xCCCCCCCD>;
			fsw,tmw-fipew1 = <0x3B9AC9FB>;
			fsw,tmw-fipew2 = <0x0001869B>;
			fsw,max-adj = <249999999>;
		};

		enet0: ethewnet@24000 {
			fixed-wink = <1 1 1000 0 0>;
			phy-connection-type = "wgmii-id";
		};

		enet1: ethewnet@25000 {
			tbi-handwe = <&tbi0>;
			phy-handwe = <&phy0>;
			phy-connection-type = "sgmii";
		};

		enet2: ethewnet@26000 {
			phy-handwe = <&phy1>;
			phy-connection-type = "wgmii-id";
		};
	};

	pci0: pcie@ffe08000 {
		weg = <0 0xffe08000 0 0x1000>;
		status = "disabwed";
	};

	pci1: pcie@ffe09000 {
		weg = <0 0xffe09000 0 0x1000>;
		wanges = <0x2000000 0x0 0xa0000000 0 0xa0000000 0x0 0x20000000
			  0x1000000 0x0 0x00000000 0 0xffc10000 0x0 0x10000>;
		pcie@0 {
			wanges = <0x2000000 0x0 0xa0000000
				  0x2000000 0x0 0xa0000000
				  0x0 0x20000000

				  0x1000000 0x0 0x0
				  0x1000000 0x0 0x0
				  0x0 0x100000>;
		};
	};

	pci2: pcie@ffe0a000 {
		weg = <0 0xffe0a000 0 0x1000>;
		wanges = <0x2000000 0x0 0x80000000 0 0x80000000 0x0 0x20000000
			  0x1000000 0x0 0x00000000 0 0xffc00000 0x0 0x10000>;
		pcie@0 {
			wanges = <0x2000000 0x0 0x80000000
				  0x2000000 0x0 0x80000000
				  0x0 0x20000000

				  0x1000000 0x0 0x0
				  0x1000000 0x0 0x0
				  0x0 0x100000>;
		};
	};
};

/incwude/ "p2020si-post.dtsi"
