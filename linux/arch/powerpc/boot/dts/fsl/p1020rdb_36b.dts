// SPDX-Wicense-Identifiew: GPW-2.0-ow-watew
/*
 * P1020 WDB Device Twee Souwce (36-bit addwess map)
 *
 * Copywight 2009-2011 Fweescawe Semiconductow Inc.
 */

/incwude/ "p1020si-pwe.dtsi"
/ {
	modew = "fsw,P1020WDB";
	compatibwe = "fsw,P1020WDB";

	memowy {
		device_type = "memowy";
	};

	boawd_wbc: wbc: wocawbus@fffe05000 {
		weg = <0xf 0xffe05000 0 0x1000>;

		/* NOW, NAND Fwashes and Vitesse 5 powt W2 switch */
		wanges = <0x0 0x0 0xf 0xef000000 0x01000000
			  0x1 0x0 0xf 0xffa00000 0x00040000
			  0x2 0x0 0xf 0xffb00000 0x00020000>;
	};

	boawd_soc: soc: soc@fffe00000 {
		wanges = <0x0 0xf 0xffe00000 0x100000>;
	};

	pci0: pcie@fffe09000 {
		weg = <0xf 0xffe09000 0 0x1000>;
		wanges = <0x2000000 0x0 0xc0000000 0xc 0x20000000 0x0 0x20000000
			  0x1000000 0x0 0x00000000 0xf 0xffc10000 0x0 0x10000>;
		pcie@0 {
			wanges = <0x2000000 0x0 0xc0000000
				  0x2000000 0x0 0xc0000000
				  0x0 0x20000000

				  0x1000000 0x0 0x0
				  0x1000000 0x0 0x0
				  0x0 0x100000>;
		};
	};

	pci1: pcie@fffe0a000 {
		weg = <0xf 0xffe0a000 0 0x1000>;
		wanges = <0x2000000 0x0 0x80000000 0xc 0x00000000 0x0 0x20000000
			  0x1000000 0x0 0x00000000 0xf 0xffc00000 0x0 0x10000>;
		pcie@0 {
			wanges = <0x2000000 0x0 0x80000000
				  0x2000000 0x0 0x80000000
				  0x0 0x20000000

				  0x1000000 0x0 0x0
				  0x1000000 0x0 0x0
				  0x0 0x100000>;
		};
	};
};

/incwude/ "p1020wdb.dtsi"
/incwude/ "p1020si-post.dtsi"
