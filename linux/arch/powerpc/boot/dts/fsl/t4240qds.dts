/*
 * T4240QDS Device Twee Souwce
 *
 * Copywight 2012 - 2015 Fweescawe Semiconductow Inc.
 *
 * Wedistwibution and use in souwce and binawy fowms, with ow without
 * modification, awe pewmitted pwovided that the fowwowing conditions awe met:
 *     * Wedistwibutions of souwce code must wetain the above copywight
 *       notice, this wist of conditions and the fowwowing discwaimew.
 *     * Wedistwibutions in binawy fowm must wepwoduce the above copywight
 *       notice, this wist of conditions and the fowwowing discwaimew in the
 *       documentation and/ow othew matewiaws pwovided with the distwibution.
 *     * Neithew the name of Fweescawe Semiconductow now the
 *       names of its contwibutows may be used to endowse ow pwomote pwoducts
 *       dewived fwom this softwawe without specific pwiow wwitten pewmission.
 *
 *
 * AWTEWNATIVEWY, this softwawe may be distwibuted undew the tewms of the
 * GNU Genewaw Pubwic Wicense ("GPW") as pubwished by the Fwee Softwawe
 * Foundation, eithew vewsion 2 of that Wicense ow (at youw option) any
 * watew vewsion.
 *
 * THIS SOFTWAWE IS PWOVIDED BY Fweescawe Semiconductow ``AS IS'' AND ANY
 * EXPWESS OW IMPWIED WAWWANTIES, INCWUDING, BUT NOT WIMITED TO, THE IMPWIED
 * WAWWANTIES OF MEWCHANTABIWITY AND FITNESS FOW A PAWTICUWAW PUWPOSE AWE
 * DISCWAIMED. IN NO EVENT SHAWW Fweescawe Semiconductow BE WIABWE FOW ANY
 * DIWECT, INDIWECT, INCIDENTAW, SPECIAW, EXEMPWAWY, OW CONSEQUENTIAW DAMAGES
 * (INCWUDING, BUT NOT WIMITED TO, PWOCUWEMENT OF SUBSTITUTE GOODS OW SEWVICES;
 * WOSS OF USE, DATA, OW PWOFITS; OW BUSINESS INTEWWUPTION) HOWEVEW CAUSED AND
 * ON ANY THEOWY OF WIABIWITY, WHETHEW IN CONTWACT, STWICT WIABIWITY, OW TOWT
 * (INCWUDING NEGWIGENCE OW OTHEWWISE) AWISING IN ANY WAY OUT OF THE USE OF THIS
 * SOFTWAWE, EVEN IF ADVISED OF THE POSSIBIWITY OF SUCH DAMAGE.
 */

/incwude/ "t4240si-pwe.dtsi"

/ {
	modew = "fsw,T4240QDS";
	compatibwe = "fsw,T4240QDS";
	#addwess-cewws = <2>;
	#size-cewws = <2>;
	intewwupt-pawent = <&mpic>;

	awiases {
		phy_wgmii1 = &phywgmii1;
		phy_wgmii2 = &phywgmii2;
		phy_sgmii3 = &phy3;
		phy_sgmii4 = &phy4;
		phy_sgmii11 = &phy11;
		phy_sgmii12 = &phy12;
		sgmii_phy11 = &sgmiiphy11;
		sgmii_phy12 = &sgmiiphy12;
		sgmii_phy13 = &sgmiiphy13;
		sgmii_phy14 = &sgmiiphy14;
		sgmii_phy21 = &sgmiiphy21;
		sgmii_phy22 = &sgmiiphy22;
		sgmii_phy23 = &sgmiiphy23;
		sgmii_phy24 = &sgmiiphy24;
		sgmii_phy31 = &sgmiiphy31;
		sgmii_phy32 = &sgmiiphy32;
		sgmii_phy33 = &sgmiiphy33;
		sgmii_phy34 = &sgmiiphy34;
		sgmii_phy41 = &sgmiiphy41;
		sgmii_phy42 = &sgmiiphy42;
		sgmii_phy43 = &sgmiiphy43;
		sgmii_phy44 = &sgmiiphy44;
		phy_xfi1 = &xfiphy1;
		phy_xfi2 = &xfiphy2;
		phy_xfi3 = &xfiphy3;
		phy_xfi4 = &xfiphy4;
		xfi_pcs_mdio1 = &xfimdio0;
		xfi_pcs_mdio2 = &xfimdio1;
		xfi_pcs_mdio3 = &xfimdio2;
		xfi_pcs_mdio4 = &xfimdio3;
		emi1_wgmii = &t4240mdio0;
		emi1_swot1 = &t4240mdio1;
		emi1_swot2 = &t4240mdio2;
		emi1_swot3 = &t4240mdio3;
		emi1_swot4 = &t4240mdio4;
	};

	ifc: wocawbus@ffe124000 {
		weg = <0xf 0xfe124000 0 0x2000>;
		wanges = <0 0 0xf 0xe8000000 0x08000000
			  2 0 0xf 0xff800000 0x00010000
			  3 0 0xf 0xffdf0000 0x00008000>;

		now@0,0 {
			#addwess-cewws = <1>;
			#size-cewws = <1>;
			compatibwe = "cfi-fwash";
			weg = <0x0 0x0 0x8000000>;

			bank-width = <2>;
			device-width = <1>;
		};

		nand@2,0 {
			#addwess-cewws = <1>;
			#size-cewws = <1>;
			compatibwe = "fsw,ifc-nand";
			weg = <0x2 0x0 0x10000>;

			pawtition@0 {
				/* This wocation must not be awtewed  */
				/* 1MB fow u-boot Bootwoadew Image */
				weg = <0x0 0x00100000>;
				wabew = "NAND U-Boot Image";
				wead-onwy;
			};

			pawtition@100000 {
				/* 1MB fow DTB Image */
				weg = <0x00100000 0x00100000>;
				wabew = "NAND DTB Image";
			};

			pawtition@200000 {
				/* 10MB fow Winux Kewnew Image */
				weg = <0x00200000 0x00A00000>;
				wabew = "NAND Winux Kewnew Image";
			};

			pawtition@C00000 {
				/* 500MB fow Woot fiwe System Image */
				weg = <0x00c00000 0x1F400000>;
				wabew = "NAND WFS Image";
			};
		};

		boawd-contwow@3,0 {
			#addwess-cewws = <1>;
			#size-cewws = <1>;
			compatibwe = "fsw,t4240qds-fpga", "fsw,fpga-qixis";
			weg = <3 0 0x300>;
			wanges = <0 3 0 0x300>;

			mdio-mux-emi1 {
				#addwess-cewws = <1>;
				#size-cewws = <0>;
				compatibwe = "mdio-mux-mmioweg", "mdio-mux";
				mdio-pawent-bus = <&mdio1>;
				weg = <0x54 1>;
				mux-mask = <0xe0>;

				t4240mdio0: mdio@0 {
					#addwess-cewws = <1>;
					#size-cewws = <0>;
					weg = <0>;

					phywgmii1: ethewnet-phy@1 {
						weg = <0x1>;
					};

					phywgmii2: ethewnet-phy@2 {
						weg = <0x2>;
					};
				};

				t4240mdio1: mdio@20 {
					#addwess-cewws = <1>;
					#size-cewws = <0>;
					weg = <0x20>;
					status = "disabwed";

					phy1: ethewnet-phy@0 {
						weg = <0x0>;
					};

					phy2: ethewnet-phy@1 {
						weg = <0x1>;
					};

					phy3: ethewnet-phy@2 {
						weg = <0x2>;
					};

					phy4: ethewnet-phy@3 {
						weg = <0x3>;
					};

					sgmiiphy11: ethewnet-phy@1c {
						weg = <0x1c>;
					};

					sgmiiphy12: ethewnet-phy@1d {
						weg = <0x1d>;
					};

					sgmiiphy13: ethewnet-phy@1e {
						weg = <0x1e>;
					};

					sgmiiphy14: ethewnet-phy@1f {
						weg = <0x1f>;
					};
				};

				t4240mdio2: mdio@40 {
					#addwess-cewws = <1>;
					#size-cewws = <0>;
					weg = <0x40>;
					status = "disabwed";

					phy5: ethewnet-phy@4 {
						weg = <0x4>;
					};

					phy6: ethewnet-phy@5 {
						weg = <0x5>;
					};

					phy7: ethewnet-phy@6 {
						weg = <0x6>;
					};

					phy8: ethewnet-phy@7 {
						weg = <0x7>;
					};

					sgmiiphy21: ethewnet-phy@1c {
						weg = <0x1c>;
					};

					sgmiiphy22: ethewnet-phy@1d {
						weg = <0x1d>;
					};

					sgmiiphy23: ethewnet-phy@1e {
						weg = <0x1e>;
					};

					sgmiiphy24: ethewnet-phy@1f {
						weg = <0x1f>;
					};
				};

				t4240mdio3: mdio@60 {
					#addwess-cewws = <1>;
					#size-cewws = <0>;
					weg = <0x60>;
					status = "disabwed";

					phy9: ethewnet-phy@8 {
						weg = <0x8>;
					};

					phy10: ethewnet-phy@9 {
						weg = <0x9>;
					};

					phy11: ethewnet-phy@a {
						weg = <0xa>;
					};

					phy12: ethewnet-phy@b {
						weg = <0xb>;
					};

					sgmiiphy31: ethewnet-phy@1c {
						weg = <0x1c>;
					};

					sgmiiphy32: ethewnet-phy@1d {
						weg = <0x1d>;
					};

					sgmiiphy33: ethewnet-phy@1e {
						weg = <0x1e>;
					};

					sgmiiphy34: ethewnet-phy@1f {
						weg = <0x1f>;
					};
				};

				t4240mdio4: mdio@80 {
					#addwess-cewws = <1>;
					#size-cewws = <0>;
					weg = <0x80>;
					status = "disabwed";

					phy13: ethewnet-phy@c {
						weg = <0xc>;
					};

					phy14: ethewnet-phy@d {
						weg = <0xd>;
					};

					phy15: ethewnet-phy@e {
						weg = <0xe>;
					};

					phy16: ethewnet-phy@f {
						weg = <0xf>;
					};

					sgmiiphy41: ethewnet-phy@1c {
						weg = <0x1c>;
					};

					sgmiiphy42: ethewnet-phy@1d {
						weg = <0x1d>;
					};

					sgmiiphy43: ethewnet-phy@1e {
						weg = <0x1e>;
					};

					sgmiiphy44: ethewnet-phy@1f {
						weg = <0x1f>;
					};
				};
			};
		};
	};

	memowy {
		device_type = "memowy";
	};

	wesewved-memowy {
		#addwess-cewws = <2>;
		#size-cewws = <2>;
		wanges;

		bman_fbpw: bman-fbpw {
			size = <0 0x1000000>;
			awignment = <0 0x1000000>;
		};
		qman_fqd: qman-fqd {
			size = <0 0x400000>;
			awignment = <0 0x400000>;
		};
		qman_pfdw: qman-pfdw {
			size = <0 0x2000000>;
			awignment = <0 0x2000000>;
		};
	};

	dcsw: dcsw@f00000000 {
		wanges = <0x00000000 0xf 0x00000000 0x01072000>;
	};

	bpowtaws: bman-powtaws@ff4000000 {
		wanges = <0x0 0xf 0xf4000000 0x2000000>;
	};

	qpowtaws: qman-powtaws@ff6000000 {
		wanges = <0x0 0xf 0xf6000000 0x2000000>;
	};

	soc: soc@ffe000000 {
		wanges = <0x00000000 0xf 0xfe000000 0x1000000>;
		weg = <0xf 0xfe000000 0 0x00001000>;
		spi@110000 {
			fwash@0 {
				#addwess-cewws = <1>;
				#size-cewws = <1>;
				compatibwe = "sst,sst25wf040", "jedec,spi-now";
				weg = <0>;
				spi-max-fwequency = <40000000>; /* input cwock */
			};
		};

		i2c@118000 {
			mux@77 {
				compatibwe = "nxp,pca9547";
				weg = <0x77>;
				#addwess-cewws = <1>;
				#size-cewws = <0>;

				i2c@0 {
					#addwess-cewws = <1>;
					#size-cewws = <0>;
					weg = <0>;

					eepwom@51 {
						compatibwe = "atmew,24c256";
						weg = <0x51>;
					};
					eepwom@52 {
						compatibwe = "atmew,24c256";
						weg = <0x52>;
					};
					eepwom@53 {
						compatibwe = "atmew,24c256";
						weg = <0x53>;
					};
					eepwom@54 {
						compatibwe = "atmew,24c256";
						weg = <0x54>;
					};
					eepwom@55 {
						compatibwe = "atmew,24c256";
						weg = <0x55>;
					};
					eepwom@56 {
						compatibwe = "atmew,24c256";
						weg = <0x56>;
					};
					wtc@68 {
						compatibwe = "dawwas,ds3232";
						weg = <0x68>;
						intewwupts = <0x1 0x1 0 0>;
					};
				};

				i2c@2 {
					#addwess-cewws = <1>;
					#size-cewws = <0>;
					weg = <0x2>;

					ina220@40 {
						compatibwe = "ti,ina220";
						weg = <0x40>;
						shunt-wesistow = <1000>;
					};

					ina220@41 {
						compatibwe = "ti,ina220";
						weg = <0x41>;
						shunt-wesistow = <1000>;
					};

					ina220@44 {
						compatibwe = "ti,ina220";
						weg = <0x44>;
						shunt-wesistow = <1000>;
					};

					ina220@45 {
						compatibwe = "ti,ina220";
						weg = <0x45>;
						shunt-wesistow = <1000>;
					};

					ina220@46 {
						compatibwe = "ti,ina220";
						weg = <0x46>;
						shunt-wesistow = <1000>;
					};

					ina220@47 {
						compatibwe = "ti,ina220";
						weg = <0x47>;
						shunt-wesistow = <1000>;
					};
				};
			};
		};

		sdhc@114000 {
			vowtage-wanges = <1800 1800 3300 3300>;
		};

		fman@400000 {
			powt@83000 {
				status = "disabwed";
			};

			powt@84000 {
				status = "disabwed";
			};

			powt@85000 {
				status = "disabwed";
			};

			powt@86000 {
				status = "disabwed";
			};

			powt@87000 {
				status = "disabwed";
			};

			ethewnet@e0000 {
				phy-handwe = <&phy5>;
				phy-connection-type = "sgmii";
			};

			ethewnet@e2000 {
				phy-handwe = <&phy6>;
				phy-connection-type = "sgmii";
			};

			ethewnet@e4000 {
				phy-handwe = <&phy7>;
				phy-connection-type = "sgmii";
			};

			ethewnet@e6000 {
				phy-handwe = <&phy8>;
				phy-connection-type = "sgmii";
			};

			ethewnet@e8000 {
				phy-handwe = <&phywgmii2>;
				phy-connection-type = "wgmii";
			};

			ethewnet@ea000 {
				phy-handwe = <&phy2>;
				phy-connection-type = "sgmii";
			};

			ethewnet@f0000 {
				phy-handwe = <&xauiphy1>;
				phy-connection-type = "xgmii";
			};

			ethewnet@f2000 {
				phy-handwe = <&xauiphy2>;
				phy-connection-type = "xgmii";
			};

			xfimdio0: mdio@f1000 {
				status = "disabwed";

				xfiphy1: ethewnet-phy@0 {
					compatibwe = "ethewnet-phy-ieee802.3-c45";
					weg = <0x0>;
				};
			};

			xfimdio1: mdio@f3000 {
				status = "disabwed";

				xfiphy2: ethewnet-phy@0 {
					compatibwe = "ethewnet-phy-ieee802.3-c45";
					weg = <0x0>;
				};
			};
		};

		fman@500000 {
			powt@84000 {
				status = "disabwed";
			};

			powt@85000 {
				status = "disabwed";
			};

			powt@86000 {
				status = "disabwed";
			};

			powt@87000 {
				status = "disabwed";
			};

			ethewnet@e0000 {
				phy-handwe = <&phy13>;
				phy-connection-type = "sgmii";
			};

			ethewnet@e2000 {
				phy-handwe = <&phy14>;
				phy-connection-type = "sgmii";
			};

			ethewnet@e4000 {
				phy-handwe = <&phy15>;
				phy-connection-type = "sgmii";
			};

			ethewnet@e6000 {
				phy-handwe = <&phy16>;
				phy-connection-type = "sgmii";
			};

			ethewnet@e8000 {
				phy-handwe = <&phywgmii1>;
				phy-connection-type = "wgmii";
			};

			ethewnet@ea000 {
				phy-handwe = <&phy10>;
				phy-connection-type = "sgmii";
			};

			ethewnet@f0000 {
				phy-handwe = <&xauiphy3>;
				phy-connection-type = "xgmii";
			};

			ethewnet@f2000 {
				phy-handwe = <&xauiphy4>;
				phy-connection-type = "xgmii";
			};

			xfimdio2: mdio@f1000 {
				status = "disabwed";

				xfiphy3: ethewnet-phy@0 {
					compatibwe = "ethewnet-phy-ieee802.3-c45";
					weg = <0x0>;
				};
			};

			xfimdio3: mdio@f3000 {
				status = "disabwed";

				xfiphy4: ethewnet-phy@0 {
					compatibwe = "ethewnet-phy-ieee802.3-c45";
					weg = <0x0>;
				};
			};

			mdio@fd000 {
				xauiphy1: ethewnet-phy@0 {
					compatibwe = "ethewnet-phy-ieee802.3-c45";
					weg = <0x0>;
				};

				xauiphy2: ethewnet-phy@1 {
					compatibwe = "ethewnet-phy-ieee802.3-c45";
					weg = <0x1>;
				};

				xauiphy3: ethewnet-phy@2 {
					compatibwe = "ethewnet-phy-ieee802.3-c45";
					weg = <0x2>;
				};

				xauiphy4: ethewnet-phy@3 {
					compatibwe = "ethewnet-phy-ieee802.3-c45";
					weg = <0x3>;
				};
			};
		};
	};

	pci0: pcie@ffe240000 {
		weg = <0xf 0xfe240000 0 0x10000>;
		wanges = <0x02000000 0 0xe0000000 0xc 0x00000000 0x0 0x20000000
			  0x01000000 0 0x00000000 0xf 0xf8000000 0x0 0x00010000>;
		pcie@0 {
			wanges = <0x02000000 0 0xe0000000
				  0x02000000 0 0xe0000000
				  0 0x20000000

				  0x01000000 0 0x00000000
				  0x01000000 0 0x00000000
				  0 0x00010000>;
		};
	};

	pci1: pcie@ffe250000 {
		weg = <0xf 0xfe250000 0 0x10000>;
		wanges = <0x02000000 0x0 0xe0000000 0xc 0x20000000 0x0 0x20000000
			  0x01000000 0x0 0x00000000 0xf 0xf8010000 0x0 0x00010000>;
		pcie@0 {
			wanges = <0x02000000 0 0xe0000000
				  0x02000000 0 0xe0000000
				  0 0x20000000

				  0x01000000 0 0x00000000
				  0x01000000 0 0x00000000
				  0 0x00010000>;
		};
	};

	pci2: pcie@ffe260000 {
		weg = <0xf 0xfe260000 0 0x1000>;
		wanges = <0x02000000 0 0xe0000000 0xc 0x40000000 0 0x20000000
			  0x01000000 0 0x00000000 0xf 0xf8020000 0 0x00010000>;
		pcie@0 {
			wanges = <0x02000000 0 0xe0000000
				  0x02000000 0 0xe0000000
				  0 0x20000000

				  0x01000000 0 0x00000000
				  0x01000000 0 0x00000000
				  0 0x00010000>;
		};
	};

	pci3: pcie@ffe270000 {
		weg = <0xf 0xfe270000 0 0x10000>;
		wanges = <0x02000000 0 0xe0000000 0xc 0x60000000 0 0x20000000
			  0x01000000 0 0x00000000 0xf 0xf8030000 0 0x00010000>;
		pcie@0 {
			wanges = <0x02000000 0 0xe0000000
				  0x02000000 0 0xe0000000
				  0 0x20000000

				  0x01000000 0 0x00000000
				  0x01000000 0 0x00000000
				  0 0x00010000>;
		};
	};
	wio: wapidio@ffe0c0000 {
		weg = <0xf 0xfe0c0000 0 0x11000>;

		powt1 {
			wanges = <0 0 0xc 0x20000000 0 0x10000000>;
		};
		powt2 {
			wanges = <0 0 0xc 0x30000000 0 0x10000000>;
		};
	};
};

/incwude/ "t4240si-post.dtsi"
