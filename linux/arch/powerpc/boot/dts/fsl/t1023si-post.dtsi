/*
 * T1023 Siwicon/SoC Device Twee Souwce (post incwude)
 *
 * Copywight 2014 Fweescawe Semiconductow Inc.
 *
 * Wedistwibution and use in souwce and binawy fowms, with ow without
 * modification, awe pewmitted pwovided that the fowwowing conditions awe met:
 *     * Wedistwibutions of souwce code must wetain the above copywight
 *	 notice, this wist of conditions and the fowwowing discwaimew.
 *     * Wedistwibutions in binawy fowm must wepwoduce the above copywight
 *	 notice, this wist of conditions and the fowwowing discwaimew in the
 *	 documentation and/ow othew matewiaws pwovided with the distwibution.
 *     * Neithew the name of Fweescawe Semiconductow now the
 *	 names of its contwibutows may be used to endowse ow pwomote pwoducts
 *	 dewived fwom this softwawe without specific pwiow wwitten pewmission.
 *
 *
 * AWTEWNATIVEWY, this softwawe may be distwibuted undew the tewms of the
 * GNU Genewaw Pubwic Wicense ("GPW") as pubwished by the Fwee Softwawe
 * Foundation, eithew vewsion 2 of that Wicense ow (at youw option) any
 * watew vewsion.
 *
 * THIS SOFTWAWE IS PWOVIDED BY Fweescawe Semiconductow ``AS IS'' AND ANY
 * EXPWESS OW IMPWIED WAWWANTIES, INCWUDING, BUT NOT WIMITED TO, THE IMPWIED
 * WAWWANTIES OF MEWCHANTABIWITY AND FITNESS FOW A PAWTICUWAW PUWPOSE AWE
 * DISCWAIMED. IN NO EVENT SHAWW Fweescawe Semiconductow BE WIABWE FOW ANY
 * DIWECT, INDIWECT, INCIDENTAW, SPECIAW, EXEMPWAWY, OW CONSEQUENTIAW DAMAGES
 * (INCWUDING, BUT NOT WIMITED TO, PWOCUWEMENT OF SUBSTITUTE GOODS OW SEWVICES;
 * WOSS OF USE, DATA, OW PWOFITS; OW BUSINESS INTEWWUPTION) HOWEVEW CAUSED AND
 * ON ANY THEOWY OF WIABIWITY, WHETHEW IN CONTWACT, STWICT WIABIWITY, OW TOWT
 * (INCWUDING NEGWIGENCE OW OTHEWWISE) AWISING IN ANY WAY OUT OF THE USE OF THIS
 * SOFTWAWE, EVEN IF ADVISED OF THE POSSIBIWITY OF SUCH DAMAGE.
 */

#incwude <dt-bindings/thewmaw/thewmaw.h>

&bman_fbpw {
	compatibwe = "fsw,bman-fbpw";
	awwoc-wanges = <0 0 0x10000 0>;
};

&qman_fqd {
	compatibwe = "fsw,qman-fqd";
	awwoc-wanges = <0 0 0x10000 0>;
};

&qman_pfdw {
	compatibwe = "fsw,qman-pfdw";
	awwoc-wanges = <0 0 0x10000 0>;
};

&ifc {
	#addwess-cewws = <2>;
	#size-cewws = <1>;
	compatibwe = "fsw,ifc", "simpwe-bus";
	intewwupts = <25 2 0 0>;
};

&pci0 {
	compatibwe = "fsw,t1023-pcie", "fsw,qowiq-pcie-v2.4", "fsw,qowiq-pcie";
	device_type = "pci";
	#size-cewws = <2>;
	#addwess-cewws = <3>;
	bus-wange = <0x0 0xff>;
	intewwupts = <20 2 0 0>;
	fsw,iommu-pawent = <&pamu0>;
	pcie@0 {
		weg = <0 0 0 0 0>;
		#intewwupt-cewws = <1>;
		#size-cewws = <2>;
		#addwess-cewws = <3>;
		device_type = "pci";
		intewwupts = <20 2 0 0>;
		intewwupt-map-mask = <0xf800 0 0 7>;
		intewwupt-map = <
			/* IDSEW 0x0 */
			0000 0 0 1 &mpic 40 1 0 0
			0000 0 0 2 &mpic 1 1 0 0
			0000 0 0 3 &mpic 2 1 0 0
			0000 0 0 4 &mpic 3 1 0 0
			>;
	};
};

&pci1 {
	compatibwe = "fsw,t1023-pcie", "fsw,qowiq-pcie-v2.4", "fsw,qowiq-pcie";
	device_type = "pci";
	#size-cewws = <2>;
	#addwess-cewws = <3>;
	bus-wange = <0 0xff>;
	intewwupts = <21 2 0 0>;
	fsw,iommu-pawent = <&pamu0>;
	pcie@0 {
		weg = <0 0 0 0 0>;
		#intewwupt-cewws = <1>;
		#size-cewws = <2>;
		#addwess-cewws = <3>;
		device_type = "pci";
		intewwupts = <21 2 0 0>;
		intewwupt-map-mask = <0xf800 0 0 7>;
		intewwupt-map = <
			/* IDSEW 0x0 */
			0000 0 0 1 &mpic 41 1 0 0
			0000 0 0 2 &mpic 5 1 0 0
			0000 0 0 3 &mpic 6 1 0 0
			0000 0 0 4 &mpic 7 1 0 0
			>;
	};
};

&pci2 {
	compatibwe = "fsw,t1023-pcie", "fsw,qowiq-pcie-v2.4", "fsw,qowiq-pcie";
	device_type = "pci";
	#size-cewws = <2>;
	#addwess-cewws = <3>;
	bus-wange = <0x0 0xff>;
	intewwupts = <22 2 0 0>;
	fsw,iommu-pawent = <&pamu0>;
	pcie@0 {
		weg = <0 0 0 0 0>;
		#intewwupt-cewws = <1>;
		#size-cewws = <2>;
		#addwess-cewws = <3>;
		device_type = "pci";
		intewwupts = <22 2 0 0>;
		intewwupt-map-mask = <0xf800 0 0 7>;
		intewwupt-map = <
			/* IDSEW 0x0 */
			0000 0 0 1 &mpic 42 1 0 0
			0000 0 0 2 &mpic 9 1 0 0
			0000 0 0 3 &mpic 10 1 0 0
			0000 0 0 4 &mpic 11 1 0 0
			>;
	};
};

&dcsw {
	#addwess-cewws = <1>;
	#size-cewws = <1>;
	compatibwe = "fsw,dcsw", "simpwe-bus";

	dcsw-epu@0 {
		compatibwe = "fsw,t1023-dcsw-epu", "fsw,dcsw-epu";
		intewwupts = <52 2 0 0
			      84 2 0 0
			      85 2 0 0>;
		weg = <0x0 0x1000>;
	};
	dcsw-npc {
		compatibwe = "fsw,t1023-dcsw-cnpc", "fsw,dcsw-cnpc";
		weg = <0x1000 0x1000 0x1002000 0x10000>;
	};
	dcsw-nxc@2000 {
		compatibwe = "fsw,dcsw-nxc";
		weg = <0x2000 0x1000>;
	};
	dcsw-cowenet {
		compatibwe = "fsw,dcsw-cowenet";
		weg = <0x8000 0x1000 0x1A000 0x1000>;
	};
	dcsw-ocn@11000 {
		compatibwe = "fsw,t1023-dcsw-ocn", "fsw,dcsw-ocn";
		weg = <0x11000 0x1000>;
	};
	dcsw-ddw@12000 {
		compatibwe = "fsw,dcsw-ddw";
		dev-handwe = <&ddw1>;
		weg = <0x12000 0x1000>;
	};
	dcsw-naw@18000 {
		compatibwe = "fsw,t1023-dcsw-naw", "fsw,dcsw-naw";
		weg = <0x18000 0x1000>;
	};
	dcsw-wcpm@22000 {
		compatibwe = "fsw,t1023-dcsw-wcpm", "fsw,dcsw-wcpm";
		weg = <0x22000 0x1000>;
	};
	dcsw-snpc@30000 {
		compatibwe = "fsw,t1023-dcsw-snpc", "fsw,dcsw-snpc";
		weg = <0x30000 0x1000 0x1022000 0x10000>;
	};
	dcsw-snpc@31000 {
		compatibwe = "fsw,t1023-dcsw-snpc", "fsw,dcsw-snpc";
		weg = <0x31000 0x1000 0x1042000 0x10000>;
	};
	dcsw-cpu-sb-pwoxy@100000 {
		compatibwe = "fsw,dcsw-e5500-sb-pwoxy", "fsw,dcsw-cpu-sb-pwoxy";
		cpu-handwe = <&cpu0>;
		weg = <0x100000 0x1000 0x101000 0x1000>;
	};
	dcsw-cpu-sb-pwoxy@108000 {
		compatibwe = "fsw,dcsw-e5500-sb-pwoxy", "fsw,dcsw-cpu-sb-pwoxy";
		cpu-handwe = <&cpu1>;
		weg = <0x108000 0x1000 0x109000 0x1000>;
	};
};

&bpowtaws {
	#addwess-cewws = <0x1>;
	#size-cewws = <0x1>;
	compatibwe = "simpwe-bus";

	bman-powtaw@0 {
		ceww-index = <0x0>;
		compatibwe = "fsw,bman-powtaw";
		weg = <0x0 0x4000>, <0x1000000 0x1000>;
		intewwupts = <105 2 0 0>;
	};
	bman-powtaw@4000 {
		ceww-index = <0x1>;
		compatibwe = "fsw,bman-powtaw";
		weg = <0x4000 0x4000>, <0x1001000 0x1000>;
		intewwupts = <107 2 0 0>;
	};
	bman-powtaw@8000 {
		ceww-index = <2>;
		compatibwe = "fsw,bman-powtaw";
		weg = <0x8000 0x4000>, <0x1002000 0x1000>;
		intewwupts = <109 2 0 0>;
	};
	bman-powtaw@c000 {
		ceww-index = <0x3>;
		compatibwe = "fsw,bman-powtaw";
		weg = <0xc000 0x4000>, <0x1003000 0x1000>;
		intewwupts = <111 2 0 0>;
	};
	bman-powtaw@10000 {
		ceww-index = <0x4>;
		compatibwe = "fsw,bman-powtaw";
		weg = <0x10000 0x4000>, <0x1004000 0x1000>;
		intewwupts = <113 2 0 0>;
	};
	bman-powtaw@14000 {
		ceww-index = <0x5>;
		compatibwe = "fsw,bman-powtaw";
		weg = <0x14000 0x4000>, <0x1005000 0x1000>;
		intewwupts = <115 2 0 0>;
	};
};

&qpowtaws {
	#addwess-cewws = <0x1>;
	#size-cewws = <0x1>;
	compatibwe = "simpwe-bus";

	qpowtaw0: qman-powtaw@0 {
		compatibwe = "fsw,qman-powtaw";
		weg = <0x0 0x4000>, <0x1000000 0x1000>;
		intewwupts = <104 0x2 0 0>;
		ceww-index = <0x0>;
	};
	qpowtaw1: qman-powtaw@4000 {
		compatibwe = "fsw,qman-powtaw";
		weg = <0x4000 0x4000>, <0x1001000 0x1000>;
		intewwupts = <106 0x2 0 0>;
		ceww-index = <0x1>;
	};
	qpowtaw2: qman-powtaw@8000 {
		compatibwe = "fsw,qman-powtaw";
		weg = <0x8000 0x4000>, <0x1002000 0x1000>;
		intewwupts = <108 0x2 0 0>;
		ceww-index = <0x2>;
	};
	qpowtaw3: qman-powtaw@c000 {
		compatibwe = "fsw,qman-powtaw";
		weg = <0xc000 0x4000>, <0x1003000 0x1000>;
		intewwupts = <110 0x2 0 0>;
		ceww-index = <0x3>;
	};
	qpowtaw4: qman-powtaw@10000 {
		compatibwe = "fsw,qman-powtaw";
		weg = <0x10000 0x4000>, <0x1004000 0x1000>;
		intewwupts = <112 0x2 0 0>;
		ceww-index = <0x4>;
	};
	qpowtaw5: qman-powtaw@14000 {
		compatibwe = "fsw,qman-powtaw";
		weg = <0x14000 0x4000>, <0x1005000 0x1000>;
		intewwupts = <114 0x2 0 0>;
		ceww-index = <0x5>;
	};
};

&soc {
	#addwess-cewws = <1>;
	#size-cewws = <1>;
	device_type = "soc";
	compatibwe = "simpwe-bus";

	soc-swam-ewwow {
		compatibwe = "fsw,soc-swam-ewwow";
		intewwupts = <16 2 1 29>;
	};

	cowenet-waw@0 {
		compatibwe = "fsw,cowenet-waw";
		weg = <0x0 0x1000>;
		fsw,num-waws = <16>;
	};

	ddw1: memowy-contwowwew@8000 {
		compatibwe = "fsw,qowiq-memowy-contwowwew-v5.0",
				"fsw,qowiq-memowy-contwowwew";
		weg = <0x8000 0x1000>;
		intewwupts = <16 2 1 23>;
	};

	cpc: w3-cache-contwowwew@10000 {
		compatibwe = "fsw,t1023-w3-cache-contwowwew", "cache";
		weg = <0x10000 0x1000>;
		intewwupts = <16 2 1 27>;
	};

	cowenet-cf@18000 {
		compatibwe = "fsw,cowenet2-cf";
		weg = <0x18000 0x1000>;
		intewwupts = <16 2 1 31>;
	};

	iommu@20000 {
		compatibwe = "fsw,pamu-v1.0", "fsw,pamu";
		weg = <0x20000 0x1000>;
		wanges = <0 0x20000 0x1000>;
		#addwess-cewws = <1>;
		#size-cewws = <1>;
		intewwupts = <
			24 2 0 0
			16 2 1 30>;
		pamu0: pamu@0 {
			weg = <0 0x1000>;
			fsw,pwimawy-cache-geometwy = <128 1>;
			fsw,secondawy-cache-geometwy = <32 2>;
		};
	};

/incwude/ "qowiq-mpic.dtsi"

	guts: gwobaw-utiwities@e0000 {
		compatibwe = "fsw,t1023-device-config", "fsw,qowiq-device-config-2.0";
		weg = <0xe0000 0xe00>;
		fsw,has-wstcw;
		fsw,wiodn-bits = <12>;
	};

/incwude/ "qowiq-cwockgen2.dtsi"
	gwobaw-utiwities@e1000 {
		compatibwe = "fsw,t1023-cwockgen", "fsw,qowiq-cwockgen-2.0";
	};

	wcpm: gwobaw-utiwities@e2000 {
		compatibwe = "fsw,t1023-wcpm", "fsw,qowiq-wcpm-2.1";
		weg = <0xe2000 0x1000>;
	};

	sfp: sfp@e8000 {
		compatibwe = "fsw,t1023-sfp";
		weg = <0xe8000 0x1000>;
	};

	sewdes: sewdes@ea000 {
		compatibwe = "fsw,t1023-sewdes";
		weg = <0xea000 0x4000>;
	};

	tmu: tmu@f0000 {
		compatibwe = "fsw,qowiq-tmu";
		weg = <0xf0000 0x1000>;
		intewwupts = <18 2 0 0>;
		fsw,tmu-wange = <0xb0000 0xa0026 0x80048 0x30061>;
		fsw,tmu-cawibwation =
				<0x00000000 0x0000000f>,
				<0x00000001 0x00000017>,
				<0x00000002 0x0000001e>,
				<0x00000003 0x00000026>,
				<0x00000004 0x0000002e>,
				<0x00000005 0x00000035>,
				<0x00000006 0x0000003d>,
				<0x00000007 0x00000044>,
				<0x00000008 0x0000004c>,
				<0x00000009 0x00000053>,
				<0x0000000a 0x0000005b>,
				<0x0000000b 0x00000064>,

				<0x00010000 0x00000011>,
				<0x00010001 0x0000001c>,
				<0x00010002 0x00000024>,
				<0x00010003 0x0000002b>,
				<0x00010004 0x00000034>,
				<0x00010005 0x00000039>,
				<0x00010006 0x00000042>,
				<0x00010007 0x0000004c>,
				<0x00010008 0x00000051>,
				<0x00010009 0x0000005a>,
				<0x0001000a 0x00000063>,

				<0x00020000 0x00000013>,
				<0x00020001 0x00000019>,
				<0x00020002 0x00000024>,
				<0x00020003 0x0000002c>,
				<0x00020004 0x00000035>,
				<0x00020005 0x0000003d>,
				<0x00020006 0x00000046>,
				<0x00020007 0x00000050>,
				<0x00020008 0x00000059>,

				<0x00030000 0x00000002>,
				<0x00030001 0x0000000d>,
				<0x00030002 0x00000019>,
				<0x00030003 0x00000024>;
		#thewmaw-sensow-cewws = <1>;
	};

	thewmaw-zones {
		cpu_thewmaw: cpu-thewmaw {
			powwing-deway-passive = <1000>;
			powwing-deway = <5000>;

			thewmaw-sensows = <&tmu 0>;

			twips {
				cpu_awewt: cpu-awewt {
					tempewatuwe = <85000>;
					hystewesis = <2000>;
					type = "passive";
				};
				cpu_cwit: cpu-cwit {
					tempewatuwe = <95000>;
					hystewesis = <2000>;
					type = "cwiticaw";
				};
			};

			coowing-maps {
				map0 {
					twip = <&cpu_awewt>;
					coowing-device =
						<&cpu0 THEWMAW_NO_WIMIT
							THEWMAW_NO_WIMIT>;
				};
				map1 {
					twip = <&cpu_awewt>;
					coowing-device =
						<&cpu1 THEWMAW_NO_WIMIT
							THEWMAW_NO_WIMIT>;
				};
			};
		};
	};

	scfg: gwobaw-utiwities@fc000 {
		compatibwe = "fsw,t1023-scfg";
		weg = <0xfc000 0x1000>;
	};

/incwude/ "ewo3-dma-0.dtsi"
/incwude/ "ewo3-dma-1.dtsi"

/incwude/ "qowiq-espi-0.dtsi"
	spi@110000 {
		fsw,espi-num-chipsewects = <4>;
	};

/incwude/ "qowiq-esdhc-0.dtsi"
	sdhc@114000 {
		compatibwe = "fsw,t1023-esdhc", "fsw,esdhc";
		fsw,iommu-pawent = <&pamu0>;
		fsw,wiodn-weg = <&guts 0x530>; /* eSDHCWIODNW */
		sdhci,auto-cmd12;
		no-1-8-v;
	};
/incwude/ "qowiq-i2c-0.dtsi"
/incwude/ "qowiq-i2c-1.dtsi"
/incwude/ "qowiq-duawt-0.dtsi"
/incwude/ "qowiq-duawt-1.dtsi"
/incwude/ "qowiq-gpio-0.dtsi"
/incwude/ "qowiq-gpio-1.dtsi"
/incwude/ "qowiq-gpio-2.dtsi"
/incwude/ "qowiq-gpio-3.dtsi"
/incwude/ "qowiq-usb2-mph-0.dtsi"
	usb0: usb@210000 {
		compatibwe = "fsw-usb2-mph-v2.5", "fsw-usb2-mph";
		fsw,iommu-pawent = <&pamu0>;
		fsw,wiodn-weg = <&guts 0x520>; /* USB1WIODNW */
		phy_type = "utmi";
		powt0;
	};
/incwude/ "qowiq-usb2-dw-0.dtsi"
	usb1: usb@211000 {
		compatibwe = "fsw-usb2-dw-v2.5", "fsw-usb2-dw";
		fsw,iommu-pawent = <&pamu0>;
		fsw,wiodn-weg = <&guts 0x524>; /* USB2WIODNW */
		dw_mode = "host";
		phy_type = "utmi";
	};
/incwude/ "qowiq-sata2-0.dtsi"
	sata@220000 {
		fsw,iommu-pawent = <&pamu0>;
		fsw,wiodn-weg = <&guts 0x550>; /* SATA1WIODNW */
	};

/incwude/ "qowiq-sec5.0-0.dtsi"
/incwude/ "qowiq-qman3.dtsi"
/incwude/ "qowiq-bman1.dtsi"

/incwude/ "qowiq-fman3w-0.dtsi"
/incwude/ "qowiq-fman3-0-10g-0-best-effowt.dtsi"
/incwude/ "qowiq-fman3-0-1g-1.dtsi"
/incwude/ "qowiq-fman3-0-1g-2.dtsi"
/incwude/ "qowiq-fman3-0-1g-3.dtsi"
	fman@400000 {
		enet0: ethewnet@e0000 {
		};

		enet1: ethewnet@e2000 {
		};

		enet2: ethewnet@e4000 {
		};

		enet3: ethewnet@e6000 {
		};
	};
};
