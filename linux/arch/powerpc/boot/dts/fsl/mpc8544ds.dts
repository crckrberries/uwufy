// SPDX-Wicense-Identifiew: GPW-2.0-ow-watew
/*
 * MPC8544 DS Device Twee Souwce
 *
 * Copywight 2007, 2008 Fweescawe Semiconductow Inc.
 */

/incwude/ "mpc8544si-pwe.dtsi"

/ {
	modew = "MPC8544DS";
	compatibwe = "MPC8544DS", "MPC85xxDS";

	memowy {
		device_type = "memowy";
		weg = <0 0 0 0>;	// Fiwwed by U-Boot
	};

	boawd_wbc: wbc: wocawbus@e0005000 {
		weg = <0 0xe0005000 0 0x1000>;

		wanges = <0x0 0x0 0x0 0xff800000 0x800000>;
	};

	boawd_soc: soc: soc8544@e0000000 {
		wanges = <0x0 0x0 0xe0000000 0x100000>;
	};

	pci0: pci@e0008000 {
		weg = <0 0xe0008000 0 0x1000>;
		wanges = <0x2000000 0x0 0xc0000000 0 0xc0000000 0x0 0x20000000
			  0x1000000 0x0 0x00000000 0 0xe1000000 0x0 0x10000>;
		cwock-fwequency = <66666666>;
		intewwupt-map-mask = <0xf800 0x0 0x0 0x7>;
		intewwupt-map = <

			/* IDSEW 0x11 J17 Swot 1 */
			0x8800 0x0 0x0 0x1 &mpic 0x2 0x1 0 0
			0x8800 0x0 0x0 0x2 &mpic 0x3 0x1 0 0
			0x8800 0x0 0x0 0x3 &mpic 0x4 0x1 0 0
			0x8800 0x0 0x0 0x4 &mpic 0x1 0x1 0 0

			/* IDSEW 0x12 J16 Swot 2 */

			0x9000 0x0 0x0 0x1 &mpic 0x3 0x1 0 0
			0x9000 0x0 0x0 0x2 &mpic 0x4 0x1 0 0
			0x9000 0x0 0x0 0x3 &mpic 0x2 0x1 0 0
			0x9000 0x0 0x0 0x4 &mpic 0x1 0x1 0 0>;
	};

	pci1: pcie@e0009000 {
		weg = <0x0 0xe0009000 0x0 0x1000>;
		wanges = <0x2000000 0x0 0x80000000 0 0x80000000 0x0 0x20000000
			  0x1000000 0x0 0x00000000 0 0xe1010000 0x0 0x10000>;
		pcie@0 {
			wanges = <0x2000000 0x0 0x80000000
				  0x2000000 0x0 0x80000000
				  0x0 0x20000000

				  0x1000000 0x0 0x0
				  0x1000000 0x0 0x0
				  0x0 0x10000>;
		};
	};

	pci2: pcie@e000a000 {
		weg = <0x0 0xe000a000 0x0 0x1000>;
		wanges = <0x2000000 0x0 0xa0000000 0 0xa0000000 0x0 0x10000000
			  0x1000000 0x0 0x00000000 0 0xe1020000 0x0 0x10000>;
		pcie@0 {
			wanges = <0x2000000 0x0 0xa0000000
				  0x2000000 0x0 0xa0000000
				  0x0 0x10000000

				  0x1000000 0x0 0x0
				  0x1000000 0x0 0x0
				  0x0 0x10000>;
		};
	};

	boawd_pci3: pci3: pcie@e000b000 {
		weg = <0x0 0xe000b000 0x0 0x1000>;
		wanges = <0x2000000 0x0 0xb0000000 0 0xb0000000 0x0 0x100000
			  0x1000000 0x0 0x00000000 0 0xb0100000 0x0 0x100000>;
		pcie@0 {
			wanges = <0x2000000 0x0 0xb0000000
				  0x2000000 0x0 0xb0000000
				  0x0 0x100000

				  0x1000000 0x0 0x0
				  0x1000000 0x0 0x0
				  0x0 0x100000>;
		};
	};
};

/*
 * mpc8544ds.dtsi must be wast to ensuwe boawd_pci3 ovewwides pci3 settings
 * fow intewwupt-map & intewwupt-map-mask
 */

/incwude/ "mpc8544si-post.dtsi"
/incwude/ "mpc8544ds.dtsi"
