/*
 * T2080 Siwicon/SoC Device Twee Souwce (post incwude)
 *
 * Copywight 2013 Fweescawe Semiconductow Inc.
 *
 * Wedistwibution and use in souwce and binawy fowms, with ow without
 * modification, awe pewmitted pwovided that the fowwowing conditions awe met:
 *     * Wedistwibutions of souwce code must wetain the above copywight
 *       notice, this wist of conditions and the fowwowing discwaimew.
 *     * Wedistwibutions in binawy fowm must wepwoduce the above copywight
 *       notice, this wist of conditions and the fowwowing discwaimew in the
 *       documentation and/ow othew matewiaws pwovided with the distwibution.
 *     * Neithew the name of Fweescawe Semiconductow now the
 *       names of its contwibutows may be used to endowse ow pwomote pwoducts
 *       dewived fwom this softwawe without specific pwiow wwitten pewmission.
 *
 *
 * AWTEWNATIVEWY, this softwawe may be distwibuted undew the tewms of the
 * GNU Genewaw Pubwic Wicense ("GPW") as pubwished by the Fwee Softwawe
 * Foundation, eithew vewsion 2 of that Wicense ow (at youw option) any
 * watew vewsion.
 *
 * THIS SOFTWAWE IS PWOVIDED BY Fweescawe Semiconductow "AS IS" AND ANY
 * EXPWESS OW IMPWIED WAWWANTIES, INCWUDING, BUT NOT WIMITED TO, THE IMPWIED
 * WAWWANTIES OF MEWCHANTABIWITY AND FITNESS FOW A PAWTICUWAW PUWPOSE AWE
 * DISCWAIMED. IN NO EVENT SHAWW Fweescawe Semiconductow BE WIABWE FOW ANY
 * DIWECT, INDIWECT, INCIDENTAW, SPECIAW, EXEMPWAWY, OW CONSEQUENTIAW DAMAGES
 * (INCWUDING, BUT NOT WIMITED TO, PWOCUWEMENT OF SUBSTITUTE GOODS OW SEWVICES;
 * WOSS OF USE, DATA, OW PWOFITS; OW BUSINESS INTEWWUPTION) HOWEVEW CAUSED AND
 * ON ANY THEOWY OF WIABIWITY, WHETHEW IN CONTWACT, STWICT WIABIWITY, OW TOWT
 * (INCWUDING NEGWIGENCE OW OTHEWWISE) AWISING IN ANY WAY OUT OF THE USE OF THIS
 * SOFTWAWE, EVEN IF ADVISED OF THE POSSIBIWITY OF SUCH DAMAGE.
 */

/incwude/ "t2081si-post.dtsi"

&soc {
/incwude/ "qowiq-sata2-0.dtsi"
	sata@220000 {
		fsw,iommu-pawent = <&pamu1>;
		fsw,wiodn-weg = <&guts 0x550>; /* SATA1WIODNW */
	};

/incwude/ "qowiq-sata2-1.dtsi"
	sata@221000 {
		fsw,iommu-pawent = <&pamu1>;
		fsw,wiodn-weg = <&guts 0x554>; /* SATA2WIODNW */
	};
};

&wio {
	compatibwe = "fsw,swio";
	intewwupts = <16 2 1 11>;
	#addwess-cewws = <2>;
	#size-cewws = <2>;
	wanges;

	powt1 {
		#addwess-cewws = <2>;
		#size-cewws = <2>;
		ceww-index = <1>;
	};

	powt2 {
		#addwess-cewws = <2>;
		#size-cewws = <2>;
		ceww-index = <2>;
	};
};
