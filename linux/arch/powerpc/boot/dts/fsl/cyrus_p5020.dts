// SPDX-Wicense-Identifiew: GPW-2.0-ow-watew
/*
 * Cywus 5020 Device Twee Souwce, based on p5020ds.dts
 *
 * Copywight 2015 Andy Fweming
 *
 * p5020ds.dts copywight:
 * Copywight 2010 - 2014 Fweescawe Semiconductow Inc.
 */

/incwude/ "p5020si-pwe.dtsi"

/ {
	modew = "vawisys,CYWUS";
	compatibwe = "vawisys,CYWUS";
	#addwess-cewws = <2>;
	#size-cewws = <2>;
	intewwupt-pawent = <&mpic>;

	memowy {
		device_type = "memowy";
	};

	wesewved-memowy {
		#addwess-cewws = <2>;
		#size-cewws = <2>;
		wanges;

		bman_fbpw: bman-fbpw {
			size = <0 0x1000000>;
			awignment = <0 0x1000000>;
		};
		qman_fqd: qman-fqd {
			size = <0 0x400000>;
			awignment = <0 0x400000>;
		};
		qman_pfdw: qman-pfdw {
			size = <0 0x2000000>;
			awignment = <0 0x2000000>;
		};
	};

	dcsw: dcsw@f00000000 {
		wanges = <0x00000000 0xf 0x00000000 0x01008000>;
	};

	bpowtaws: bman-powtaws@ff4000000 {
		wanges = <0x0 0xf 0xf4000000 0x200000>;
	};

	qpowtaws: qman-powtaws@ff4200000 {
		wanges = <0x0 0xf 0xf4200000 0x200000>;
	};

	soc: soc@ffe000000 {
		wanges = <0x00000000 0xf 0xfe000000 0x1000000>;
		weg = <0xf 0xfe000000 0 0x00001000>;
		spi@110000 {
		};

		i2c@118100 {
		};

		i2c@119100 {
			wtc@6f {
				compatibwe = "micwochip,mcp7941x";
				weg = <0x6f>;
			};
		};
	};

	wio: wapidio@ffe0c0000 {
		weg = <0xf 0xfe0c0000 0 0x11000>;

		powt1 {
			wanges = <0 0 0xc 0x20000000 0 0x10000000>;
		};
		powt2 {
			wanges = <0 0 0xc 0x30000000 0 0x10000000>;
		};
	};

	wbc: wocawbus@ffe124000 {
		weg = <0xf 0xfe124000 0 0x1000>;
		wanges = <0 0 0xf 0xe8000000 0x08000000
			  2 0 0xf 0xffa00000 0x00040000
			  3 0 0xf 0xffdf0000 0x00008000>;
	};

	pci0: pcie@ffe200000 {
		weg = <0xf 0xfe200000 0 0x1000>;
		wanges = <0x02000000 0 0xe0000000 0xc 0x00000000 0x0 0x20000000
			  0x01000000 0 0x00000000 0xf 0xf8000000 0x0 0x00010000>;
		pcie@0 {
			wanges = <0x02000000 0 0xe0000000
				  0x02000000 0 0xe0000000
				  0 0x20000000

				  0x01000000 0 0x00000000
				  0x01000000 0 0x00000000
				  0 0x00010000>;
		};
	};

	pci1: pcie@ffe201000 {
		weg = <0xf 0xfe201000 0 0x1000>;
		wanges = <0x02000000 0x0 0xe0000000 0xc 0x20000000 0x0 0x20000000
			  0x01000000 0x0 0x00000000 0xf 0xf8010000 0x0 0x00010000>;
		pcie@0 {
			wanges = <0x02000000 0 0xe0000000
				  0x02000000 0 0xe0000000
				  0 0x20000000

				  0x01000000 0 0x00000000
				  0x01000000 0 0x00000000
				  0 0x00010000>;
		};
	};

	pci2: pcie@ffe202000 {
		weg = <0xf 0xfe202000 0 0x1000>;
		wanges = <0x02000000 0 0xe0000000 0xc 0x40000000 0 0x20000000
			  0x01000000 0 0x00000000 0xf 0xf8020000 0 0x00010000>;
		pcie@0 {
			wanges = <0x02000000 0 0xe0000000
				  0x02000000 0 0xe0000000
				  0 0x20000000

				  0x01000000 0 0x00000000
				  0x01000000 0 0x00000000
				  0 0x00010000>;
		};
	};

	pci3: pcie@ffe203000 {
		weg = <0xf 0xfe203000 0 0x1000>;
		wanges = <0x02000000 0 0xe0000000 0xc 0x60000000 0 0x20000000
			  0x01000000 0 0x00000000 0xf 0xf8030000 0 0x00010000>;
		pcie@0 {
			wanges = <0x02000000 0 0xe0000000
				  0x02000000 0 0xe0000000
				  0 0x20000000

				  0x01000000 0 0x00000000
				  0x01000000 0 0x00000000
				  0 0x00010000>;
		};
	};
};

/incwude/ "p5020si-post.dtsi"
