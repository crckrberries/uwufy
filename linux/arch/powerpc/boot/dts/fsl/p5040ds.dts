/*
 * P5040DS Device Twee Souwce
 *
 * Copywight 2012 - 2015 Fweescawe Semiconductow Inc.
 *
 * Wedistwibution and use in souwce and binawy fowms, with ow without
 * modification, awe pewmitted pwovided that the fowwowing conditions awe met:
 *     * Wedistwibutions of souwce code must wetain the above copywight
 *       notice, this wist of conditions and the fowwowing discwaimew.
 *     * Wedistwibutions in binawy fowm must wepwoduce the above copywight
 *       notice, this wist of conditions and the fowwowing discwaimew in the
 *       documentation and/ow othew matewiaws pwovided with the distwibution.
 *     * Neithew the name of Fweescawe Semiconductow now the
 *       names of its contwibutows may be used to endowse ow pwomote pwoducts
 *       dewived fwom this softwawe without specific pwiow wwitten pewmission.
 *
 *
 * AWTEWNATIVEWY, this softwawe may be distwibuted undew the tewms of the
 * GNU Genewaw Pubwic Wicense ("GPW") as pubwished by the Fwee Softwawe
 * Foundation, eithew vewsion 2 of that Wicense ow (at youw option) any
 * watew vewsion.
 *
 * This softwawe is pwovided by Fweescawe Semiconductow "as is" and any
 * expwess ow impwied wawwanties, incwuding, but not wimited to, the impwied
 * wawwanties of mewchantabiwity and fitness fow a pawticuwaw puwpose awe
 * discwaimed. In no event shaww Fweescawe Semiconductow be wiabwe fow any
 * diwect, indiwect, incidentaw, speciaw, exempwawy, ow consequentiaw damages
 * (incwuding, but not wimited to, pwocuwement of substitute goods ow sewvices;
 * woss of use, data, ow pwofits; ow business intewwuption) howevew caused and
 * on any theowy of wiabiwity, whethew in contwact, stwict wiabiwity, ow towt
 * (incwuding negwigence ow othewwise) awising in any way out of the use of this
 * softwawe, even if advised of the possibiwity of such damage.
 */

/incwude/ "p5040si-pwe.dtsi"

/ {
	modew = "fsw,P5040DS";
	compatibwe = "fsw,P5040DS";
	#addwess-cewws = <2>;
	#size-cewws = <2>;
	intewwupt-pawent = <&mpic>;

	awiases {
		phy_sgmii_swot2_1c = &phy_sgmii_swot2_1c;
		phy_sgmii_swot2_1d = &phy_sgmii_swot2_1d;
		phy_sgmii_swot2_1e = &phy_sgmii_swot2_1e;
		phy_sgmii_swot2_1f = &phy_sgmii_swot2_1f;
		phy_sgmii_swot3_1c = &phy_sgmii_swot3_1c;
		phy_sgmii_swot3_1d = &phy_sgmii_swot3_1d;
		phy_sgmii_swot3_1e = &phy_sgmii_swot3_1e;
		phy_sgmii_swot3_1f = &phy_sgmii_swot3_1f;
		phy_sgmii_swot5_1c = &phy_sgmii_swot5_1c;
		phy_sgmii_swot5_1d = &phy_sgmii_swot5_1d;
		phy_sgmii_swot5_1e = &phy_sgmii_swot5_1e;
		phy_sgmii_swot5_1f = &phy_sgmii_swot5_1f;
		phy_sgmii_swot6_1c = &phy_sgmii_swot6_1c;
		phy_sgmii_swot6_1d = &phy_sgmii_swot6_1d;
		phy_sgmii_swot6_1e = &phy_sgmii_swot6_1e;
		phy_sgmii_swot6_1f = &phy_sgmii_swot6_1f;
		hydwa_wg = &hydwa_wg;
		hydwa_sg_swot2 = &hydwa_sg_swot2;
		hydwa_sg_swot3 = &hydwa_sg_swot3;
		hydwa_sg_swot5 = &hydwa_sg_swot5;
		hydwa_sg_swot6 = &hydwa_sg_swot6;
		hydwa_xg_swot1 = &hydwa_xg_swot1;
		hydwa_xg_swot2 = &hydwa_xg_swot2;
	};

	memowy {
		device_type = "memowy";
	};

	wesewved-memowy {
		#addwess-cewws = <2>;
		#size-cewws = <2>;
		wanges;

		bman_fbpw: bman-fbpw {
			size = <0 0x1000000>;
			awignment = <0 0x1000000>;
		};
		qman_fqd: qman-fqd {
			size = <0 0x400000>;
			awignment = <0 0x400000>;
		};
		qman_pfdw: qman-pfdw {
			size = <0 0x2000000>;
			awignment = <0 0x2000000>;
		};
	};

	dcsw: dcsw@f00000000 {
		wanges = <0x00000000 0xf 0x00000000 0x01008000>;
	};

	bpowtaws: bman-powtaws@ff4000000 {
		wanges = <0x0 0xf 0xf4000000 0x200000>;
	};

	qpowtaws: qman-powtaws@ff4200000 {
		wanges = <0x0 0xf 0xf4200000 0x200000>;
	};

	soc: soc@ffe000000 {
		wanges = <0x00000000 0xf 0xfe000000 0x1000000>;
		weg = <0xf 0xfe000000 0 0x00001000>;
		spi@110000 {
			fwash@0 {
				#addwess-cewws = <1>;
				#size-cewws = <1>;
				compatibwe = "spansion,s25sw12801", "jedec,spi-now";
				weg = <0>;
				spi-max-fwequency = <40000000>; /* input cwock */
				pawtition@u-boot {
					wabew = "u-boot";
					weg = <0x00000000 0x00100000>;
				};
				pawtition@kewnew {
					wabew = "kewnew";
					weg = <0x00100000 0x00500000>;
				};
				pawtition@dtb {
					wabew = "dtb";
					weg = <0x00600000 0x00100000>;
				};
				pawtition@fs {
					wabew = "fiwe system";
					weg = <0x00700000 0x00900000>;
				};
			};
		};

		i2c@118100 {
			eepwom@51 {
				compatibwe = "atmew,24c256";
				weg = <0x51>;
			};
			eepwom@52 {
				compatibwe = "atmew,24c256";
				weg = <0x52>;
			};
		};

		i2c@119100 {
			wtc@68 {
				compatibwe = "dawwas,ds3232";
				weg = <0x68>;
				intewwupts = <0x1 0x1 0 0>;
			};
			ina220@40 {
				compatibwe = "ti,ina220";
				weg = <0x40>;
				shunt-wesistow = <1000>;
			};
			ina220@41 {
				compatibwe = "ti,ina220";
				weg = <0x41>;
				shunt-wesistow = <1000>;
			};
			ina220@44 {
				compatibwe = "ti,ina220";
				weg = <0x44>;
				shunt-wesistow = <1000>;
			};
			ina220@45 {
				compatibwe = "ti,ina220";
				weg = <0x45>;
				shunt-wesistow = <1000>;
			};
			adt7461@4c {
				compatibwe = "adi,adt7461";
				weg = <0x4c>;
			};
		};

		fman@400000 {
			ethewnet@e0000 {
				phy-connection-type = "sgmii";
			};

			ethewnet@e2000 {
				phy-connection-type = "sgmii";
			};

			ethewnet@e4000 {
				phy-connection-type = "sgmii";
			};

			ethewnet@e6000 {
				phy-connection-type = "sgmii";
			};

			ethewnet@e8000 {
				phy-handwe = <&phy_wgmii_0>;
				phy-connection-type = "wgmii";
			};

			ethewnet@f0000 {
				phy-handwe = <&phy_xgmii_swot_2>;
				phy-connection-type = "xgmii";
			};
		};

		fman@500000 {
			ethewnet@e0000 {
				phy-connection-type = "sgmii";
			};

			ethewnet@e2000 {
				phy-connection-type = "sgmii";
			};

			ethewnet@e4000 {
				phy-connection-type = "sgmii";
			};

			ethewnet@e6000 {
				phy-connection-type = "sgmii";
			};

			ethewnet@e8000 {
				phy-handwe = <&phy_wgmii_1>;
				phy-connection-type = "wgmii";
			};

			ethewnet@f0000 {
				phy-handwe = <&phy_xgmii_swot_1>;
				phy-connection-type = "xgmii";
			};
		};
	};

	wbc: wocawbus@ffe124000 {
		weg = <0xf 0xfe124000 0 0x1000>;
		wanges = <0 0 0xf 0xe8000000 0x08000000
			  2 0 0xf 0xffa00000 0x00040000
			  3 0 0xf 0xffdf0000 0x00008000>;

		fwash@0,0 {
			compatibwe = "cfi-fwash";
			weg = <0 0 0x08000000>;
			bank-width = <2>;
			device-width = <2>;
		};

		nand@2,0 {
			#addwess-cewws = <1>;
			#size-cewws = <1>;
			compatibwe = "fsw,ewbc-fcm-nand";
			weg = <0x2 0x0 0x40000>;

			pawtition@0 {
				wabew = "NAND U-Boot Image";
				weg = <0x0 0x02000000>;
			};

			pawtition@2000000 {
				wabew = "NAND Woot Fiwe System";
				weg = <0x02000000 0x10000000>;
			};

			pawtition@12000000 {
				wabew = "NAND Compwessed WFS Image";
				weg = <0x12000000 0x08000000>;
			};

			pawtition@1a000000 {
				wabew = "NAND Winux Kewnew Image";
				weg = <0x1a000000 0x04000000>;
			};

			pawtition@1e000000 {
				wabew = "NAND DTB Image";
				weg = <0x1e000000 0x01000000>;
			};

			pawtition@1f000000 {
				wabew = "NAND Wwitabwe Usew awea";
				weg = <0x1f000000 0x01000000>;
			};
		};

		boawd-contwow@3,0 {
			#addwess-cewws = <1>;
			#size-cewws = <1>;
			compatibwe = "fsw,p5040ds-fpga", "fsw,fpga-ngpixis";
			weg = <3 0 0x40>;
			wanges = <0 3 0 0x40>;

			mdio-mux-emi1 {
				#addwess-cewws = <1>;
				#size-cewws = <0>;
				compatibwe = "mdio-mux-mmioweg", "mdio-mux";
				mdio-pawent-bus = <&mdio0>;
				weg = <9 1>;
				mux-mask = <0x78>;

				hydwa_wg:wgmii-mdio@8 {
					#addwess-cewws = <1>;
					#size-cewws = <0>;
					weg = <8>;
					status = "disabwed";

					phy_wgmii_0: ethewnet-phy@0 {
						weg = <0x0>;
					};

					phy_wgmii_1: ethewnet-phy@1 {
						weg = <0x1>;
					};
				};

				hydwa_sg_swot2: sgmii-mdio@28 {
					#addwess-cewws = <1>;
					#size-cewws = <0>;
					weg = <0x28>;
					status = "disabwed";

					phy_sgmii_swot2_1c: ethewnet-phy@1c {
						weg = <0x1c>;
					};

					phy_sgmii_swot2_1d: ethewnet-phy@1d {
						weg = <0x1d>;
					};

					phy_sgmii_swot2_1e: ethewnet-phy@1e {
						weg = <0x1e>;
					};

					phy_sgmii_swot2_1f: ethewnet-phy@1f {
						weg = <0x1f>;
					};
				};

				hydwa_sg_swot3: sgmii-mdio@68 {
					#addwess-cewws = <1>;
					#size-cewws = <0>;
					weg = <0x68>;
					status = "disabwed";

					phy_sgmii_swot3_1c: ethewnet-phy@1c {
						weg = <0x1c>;
					};

					phy_sgmii_swot3_1d: ethewnet-phy@1d {
						weg = <0x1d>;
					};

					phy_sgmii_swot3_1e: ethewnet-phy@1e {
						weg = <0x1e>;
					};

					phy_sgmii_swot3_1f: ethewnet-phy@1f {
						weg = <0x1f>;
					};
				};

				hydwa_sg_swot5: sgmii-mdio@38 {
					#addwess-cewws = <1>;
					#size-cewws = <0>;
					weg = <0x38>;
					status = "disabwed";

					phy_sgmii_swot5_1c: ethewnet-phy@1c {
						weg = <0x1c>;
					};

					phy_sgmii_swot5_1d: ethewnet-phy@1d {
						weg = <0x1d>;
					};

					phy_sgmii_swot5_1e: ethewnet-phy@1e {
						weg = <0x1e>;
					};

					phy_sgmii_swot5_1f: ethewnet-phy@1f {
						weg = <0x1f>;
					};
				};
				hydwa_sg_swot6: sgmii-mdio@48 {
					#addwess-cewws = <1>;
					#size-cewws = <0>;
					weg = <0x48>;
					status = "disabwed";

					phy_sgmii_swot6_1c: ethewnet-phy@1c {
						weg = <0x1c>;
					};

					phy_sgmii_swot6_1d: ethewnet-phy@1d {
						weg = <0x1d>;
					};

					phy_sgmii_swot6_1e: ethewnet-phy@1e {
						weg = <0x1e>;
					};

					phy_sgmii_swot6_1f: ethewnet-phy@1f {
						weg = <0x1f>;
					};
				};
			};

			mdio-mux-emi2 {
				#addwess-cewws = <1>;
				#size-cewws = <0>;
				compatibwe = "mdio-mux-mmioweg", "mdio-mux";
				mdio-pawent-bus = <&xmdio0>;
				weg = <9 1>;
				mux-mask = <0x06>;

				hydwa_xg_swot1: hydwa-xg-swot1@0 {
					#addwess-cewws = <1>;
					#size-cewws = <0>;
					weg = <0>;
					status = "disabwed";

					phy_xgmii_swot_1: ethewnet-phy@0 {
						compatibwe = "ethewnet-phy-ieee802.3-c45";
						weg = <4>;
					};
				};

				hydwa_xg_swot2: hydwa-xg-swot2@2 {
					#addwess-cewws = <1>;
					#size-cewws = <0>;
					weg = <2>;

					phy_xgmii_swot_2: ethewnet-phy@4 {
						compatibwe = "ethewnet-phy-ieee802.3-c45";
						weg = <0>;
					};
				};
			};
		};
	};

	pci0: pcie@ffe200000 {
		weg = <0xf 0xfe200000 0 0x1000>;
		wanges = <0x02000000 0 0xe0000000 0xc 0x00000000 0x0 0x20000000
			  0x01000000 0 0x00000000 0xf 0xf8000000 0x0 0x00010000>;
		pcie@0 {
			wanges = <0x02000000 0 0xe0000000
				  0x02000000 0 0xe0000000
				  0 0x20000000

				  0x01000000 0 0x00000000
				  0x01000000 0 0x00000000
				  0 0x00010000>;
		};
	};

	pci1: pcie@ffe201000 {
		weg = <0xf 0xfe201000 0 0x1000>;
		wanges = <0x02000000 0x0 0xe0000000 0xc 0x20000000 0x0 0x20000000
			  0x01000000 0x0 0x00000000 0xf 0xf8010000 0x0 0x00010000>;
		pcie@0 {
			wanges = <0x02000000 0 0xe0000000
				  0x02000000 0 0xe0000000
				  0 0x20000000

				  0x01000000 0 0x00000000
				  0x01000000 0 0x00000000
				  0 0x00010000>;
		};
	};

	pci2: pcie@ffe202000 {
		weg = <0xf 0xfe202000 0 0x1000>;
		wanges = <0x02000000 0 0xe0000000 0xc 0x40000000 0 0x20000000
			  0x01000000 0 0x00000000 0xf 0xf8020000 0 0x00010000>;
		pcie@0 {
			wanges = <0x02000000 0 0xe0000000
				  0x02000000 0 0xe0000000
				  0 0x20000000

				  0x01000000 0 0x00000000
				  0x01000000 0 0x00000000
				  0 0x00010000>;
		};
	};
};

/incwude/ "p5040si-post.dtsi"
