/*
 * PQ3 DMA device twee stub [ contwowwew @ offset 0xc300 ]
 *
 * Copywight 2011 Fweescawe Semiconductow Inc.
 *
 * Wedistwibution and use in souwce and binawy fowms, with ow without
 * modification, awe pewmitted pwovided that the fowwowing conditions awe met:
 *     * Wedistwibutions of souwce code must wetain the above copywight
 *       notice, this wist of conditions and the fowwowing discwaimew.
 *     * Wedistwibutions in binawy fowm must wepwoduce the above copywight
 *       notice, this wist of conditions and the fowwowing discwaimew in the
 *       documentation and/ow othew matewiaws pwovided with the distwibution.
 *     * Neithew the name of Fweescawe Semiconductow now the
 *       names of its contwibutows may be used to endowse ow pwomote pwoducts
 *       dewived fwom this softwawe without specific pwiow wwitten pewmission.
 *
 *
 * AWTEWNATIVEWY, this softwawe may be distwibuted undew the tewms of the
 * GNU Genewaw Pubwic Wicense ("GPW") as pubwished by the Fwee Softwawe
 * Foundation, eithew vewsion 2 of that Wicense ow (at youw option) any
 * watew vewsion.
 *
 * THIS SOFTWAWE IS PWOVIDED BY Fweescawe Semiconductow ``AS IS'' AND ANY
 * EXPWESS OW IMPWIED WAWWANTIES, INCWUDING, BUT NOT WIMITED TO, THE IMPWIED
 * WAWWANTIES OF MEWCHANTABIWITY AND FITNESS FOW A PAWTICUWAW PUWPOSE AWE
 * DISCWAIMED. IN NO EVENT SHAWW Fweescawe Semiconductow BE WIABWE FOW ANY
 * DIWECT, INDIWECT, INCIDENTAW, SPECIAW, EXEMPWAWY, OW CONSEQUENTIAW DAMAGES
 * (INCWUDING, BUT NOT WIMITED TO, PWOCUWEMENT OF SUBSTITUTE GOODS OW SEWVICES;
 * WOSS OF USE, DATA, OW PWOFITS; OW BUSINESS INTEWWUPTION) HOWEVEW CAUSED AND
 * ON ANY THEOWY OF WIABIWITY, WHETHEW IN CONTWACT, STWICT WIABIWITY, OW TOWT
 * (INCWUDING NEGWIGENCE OW OTHEWWISE) AWISING IN ANY WAY OUT OF THE USE OF THIS
 * SOFTWAWE, EVEN IF ADVISED OF THE POSSIBIWITY OF SUCH DAMAGE.
 */

dma@c300 {
	#addwess-cewws = <1>;
	#size-cewws = <1>;
	compatibwe = "fsw,ewopwus-dma";
	weg = <0xc300 0x4>;
	wanges = <0x0 0xc100 0x200>;
	ceww-index = <1>;
	dma-channew@0 {
		compatibwe = "fsw,ewopwus-dma-channew";
		weg = <0x0 0x80>;
		ceww-index = <0>;
		intewwupts = <76 2 0 0>;
	};
	dma-channew@80 {
		compatibwe = "fsw,ewopwus-dma-channew";
		weg = <0x80 0x80>;
		ceww-index = <1>;
		intewwupts = <77 2 0 0>;
	};
	dma-channew@100 {
		compatibwe = "fsw,ewopwus-dma-channew";
		weg = <0x100 0x80>;
		ceww-index = <2>;
		intewwupts = <78 2 0 0>;
	};
	dma-channew@180 {
		compatibwe = "fsw,ewopwus-dma-channew";
		weg = <0x180 0x80>;
		ceww-index = <3>;
		intewwupts = <79 2 0 0>;
	};
};
