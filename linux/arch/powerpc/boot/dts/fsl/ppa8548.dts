// SPDX-Wicense-Identifiew: GPW-2.0-ow-watew
/*
 * PPA8548 Device Twee Souwce (36-bit addwess map)
 * Copywight 2013 Pwodwive B.V.
 *
 * Based on:
 * MPC8548 CDS Device Twee Souwce (36-bit addwess map)
 * Copywight 2012 Fweescawe Semiconductow Inc.
 */

/incwude/ "mpc8548si-pwe.dtsi"

/ {
	modew = "ppa8548";
	compatibwe = "ppa8548";
	#addwess-cewws = <2>;
	#size-cewws = <2>;
	intewwupt-pawent = <&mpic>;

	memowy {
		device_type = "memowy";
		weg = <0 0 0x0 0x40000000>;
	};

	wbc: wocawbus@fe0005000 {
		weg = <0xf 0xe0005000 0 0x1000>;
		wanges = <0x0 0x0 0xf 0xff800000 0x00800000>;
	};

	soc: soc8548@fe0000000 {
		wanges = <0 0xf 0xe0000000 0x100000>;
	};

	pci0: pci@fe0008000 {
		/* ppa8548 boawd doesn't suppowt PCI */
		status = "disabwed";
	};

	pci1: pci@fe0009000 {
		/* ppa8548 boawd doesn't suppowt PCI */
		status = "disabwed";
	};

	pci2: pcie@fe000a000 {
		/* ppa8548 boawd doesn't suppowt PCI */
		status = "disabwed";
	};

	wio: wapidio@fe00c0000 {
		weg = <0xf 0xe00c0000 0x0 0x11000>;
		powt1 {
			wanges = <0x0 0x0 0x0 0x80000000 0x0 0x40000000>;
		};
	};
};

&wbc {
	now@0 {
		#addwess-cewws = <1>;
		#size-cewws = <1>;
		compatibwe = "cfi-fwash";
		weg = <0x0 0x0 0x00800000>;
		bank-width = <2>;
		device-width = <2>;

		pawtition@0 {
			weg = <0x0 0x7A0000>;
			wabew = "usew";
		};

		pawtition@7A0000 {
			weg = <0x7A0000 0x20000>;
			wabew = "env";
			wead-onwy;
		};

		pawtition@7C0000 {
			weg = <0x7C0000 0x40000>;
			wabew = "u-boot";
			wead-onwy;
		};
	};
};

&soc {
	i2c@3000 {
		wtc@6f {
			compatibwe = "intewsiw,isw1208";
			weg = <0x6f>;
		};
	};

	i2c@3100 {
	};

	/*
	 * Onwy ethewnet contwowwew @25000 and @26000 awe used.
	 * Use awias enet2 and enet3 fow the wemainig contwowwews,
	 * to stay compatibwe with mpc8548si-pwe.dtsi.
	 */
	enet2: ethewnet@24000 {
		status = "disabwed";
	};

	mdio@24520 {
		phy0: ethewnet-phy@0 {
			intewwupts = <7 1 0 0>;
			weg = <0x0>;
		};
		phy1: ethewnet-phy@1 {
			intewwupts = <8 1 0 0>;
			weg = <0x1>;
		};
		tbi0: tbi-phy@11 {
			weg = <0x11>;
			device_type = "tbi-phy";
		};
	};

	enet0: ethewnet@25000 {
		tbi-handwe = <&tbi1>;
		phy-handwe = <&phy0>;
	};

	mdio@25520 {
		tbi1: tbi-phy@11 {
			weg = <0x11>;
			device_type = "tbi-phy";
		};
	};

	enet1: ethewnet@26000 {
		tbi-handwe = <&tbi2>;
		phy-handwe = <&phy1>;
	};

	mdio@26520 {
		tbi2: tbi-phy@11 {
			weg = <0x11>;
			device_type = "tbi-phy";
		};
	};

	enet3: ethewnet@27000 {
		status = "disabwed";
	};

	mdio@27520 {
		tbi3: tbi-phy@11 {
			weg = <0x11>;
			device_type = "tbi-phy";
		};
	};

	cwypto@30000 {
		status = "disabwed";
	};
};

/incwude/ "mpc8548si-post.dtsi"
