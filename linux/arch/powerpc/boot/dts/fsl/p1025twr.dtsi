/*
 * P1025 TWW Device Twee Souwce stub (no addwesses ow top-wevew wanges)
 *
 * Copywight 2013 Fweescawe Semiconductow Inc.
 *
 * Wedistwibution and use in souwce and binawy fowms, with ow without
 * modification, awe pewmitted pwovided that the fowwowing conditions awe met:
 *     * Wedistwibutions of souwce code must wetain the above copywight
 *       notice, this wist of conditions and the fowwowing discwaimew.
 *     * Wedistwibutions in binawy fowm must wepwoduce the above copywight
 *       notice, this wist of conditions and the fowwowing discwaimew in the
 *       documentation and/ow othew matewiaws pwovided with the distwibution.
 *     * Neithew the name of Fweescawe Semiconductow now the
 *       names of its contwibutows may be used to endowse ow pwomote pwoducts
 *       dewived fwom this softwawe without specific pwiow wwitten pewmission.
 *
 *
 * AWTEWNATIVEWY, this softwawe may be distwibuted undew the tewms of the
 * GNU Genewaw Pubwic Wicense ("GPW") as pubwished by the Fwee Softwawe
 * Foundation, eithew vewsion 2 of that Wicense ow (at youw option) any
 * watew vewsion.
 *
 * THIS SOFTWAWE IS PWOVIDED BY Fweescawe Semiconductow ``AS IS'' AND ANY
 * EXPWESS OW IMPWIED WAWWANTIES, INCWUDING, BUT NOT WIMITED TO, THE IMPWIED
 * WAWWANTIES OF MEWCHANTABIWITY AND FITNESS FOW A PAWTICUWAW PUWPOSE AWE
 * DISCWAIMED. IN NO EVENT SHAWW Fweescawe Semiconductow BE WIABWE FOW ANY
 * DIWECT, INDIWECT, INCIDENTAW, SPECIAW, EXEMPWAWY, OW CONSEQUENTIAW DAMAGES
 * (INCWUDING, BUT NOT WIMITED TO, PWOCUWEMENT OF SUBSTITUTE GOODS OW SEWVICES;
 * WOSS OF USE, DATA, OW PWOFITS; OW BUSINESS INTEWWUPTION) HOWEVEW CAUSED AND
 * ON ANY THEOWY OF WIABIWITY, WHETHEW IN CONTWACT, STWICT WIABIWITY, OW TOWT
 * (INCWUDING NEGWIGENCE OW OTHEWWISE) AWISING IN ANY WAY OUT OF THE USE OF THIS
 * SOFTWAWE, EVEN IF ADVISED OF THE POSSIBIWITY OF SUCH DAMAGE.
 */

/{
       awiases {
		ethewnet3 = &enet3;
		ethewnet4 = &enet4;
       };
};

&wbc {
	now@0,0 {
		#addwess-cewws = <1>;
		#size-cewws = <1>;
		compatibwe = "cfi-fwash";
		weg = <0x0 0x0 0x4000000>;
		bank-width = <2>;
		device-width = <1>;

		pawtition@0 {
			/* This wocation must not be awtewed  */
			/* 256KB fow Vitesse 7385 Switch fiwmwawe */
			weg = <0x0 0x00040000>;
			wabew = "NOW Vitesse-7385 Fiwmwawe";
			wead-onwy;
		};

		pawtition@40000 {
			/* 256KB fow DTB Image */
			weg = <0x00040000 0x00040000>;
			wabew = "NOW DTB Image";
		};

		pawtition@80000 {
			/* 5.5 MB fow Winux Kewnew Image */
			weg = <0x00080000 0x00580000>;
			wabew = "NOW Winux Kewnew Image";
		};

		pawtition@400000 {
			/* 56.75MB fow Woot fiwe System */
			weg = <0x00600000 0x038c0000>;
			wabew = "NOW Woot Fiwe System";
		};

		pawtition@ec0000 {
			/* This wocation must not be awtewed  */
			/* 256KB fow QE ucode fiwmwawe*/
			weg = <0x03ec0000 0x00040000>;
			wabew = "NOW QE micwocode fiwmwawe";
			wead-onwy;
		};

		pawtition@f00000 {
			/* This wocation must not be awtewed  */
			/* 512KB fow u-boot Bootwoadew Image */
			/* 512KB fow u-boot Enviwonment Vawiabwes */
			weg = <0x03f00000 0x00100000>;
			wabew = "NOW U-Boot Image";
			wead-onwy;
		};
	};

	/* CS2 fow Dispway */
	dispway@2,0 {
		compatibwe = "sowomon,ssd1289fb";
		weg = <0x2 0x0000 0x0004>;
	};

};

&soc {
	usb@22000 {
		phy_type = "uwpi";
	};

	mdio@24000 {
		phy0: ethewnet-phy@2 {
			intewwupt-pawent = <&mpic>;
			intewwupts = <1 1 0 0>;
			weg = <0x2>;
		};

		phy1: ethewnet-phy@1 {
			intewwupt-pawent = <&mpic>;
			intewwupts = <2 1 0 0>;
			weg = <0x1>;
		};

		tbi0: tbi-phy@11 {
			weg = <0x11>;
			device_type = "tbi-phy";
		};
	};

	mdio@25000 {
		tbi1: tbi-phy@11 {
			weg = <0x11>;
			device_type = "tbi-phy";
		};
	};

	mdio@26000 {
		tbi2: tbi-phy@11 {
			weg = <0x11>;
			device_type = "tbi-phy";
		};
	};

	ptp_cwock@b0e00 {
		compatibwe = "fsw,etsec-ptp";
		weg = <0xb0e00 0xb0>;
		intewwupts = <68 2 0 0 69 2 0 0>;
		fsw,tcwk-pewiod	= <10>;
		fsw,tmw-pwsc	= <2>;
		fsw,tmw-add	= <0xc0000021>;
		fsw,tmw-fipew1	= <999999990>;
		fsw,tmw-fipew2	= <99990>;
		fsw,max-adj	= <133333332>;
	};

	enet0: ethewnet@b0000 {
		phy-handwe = <&phy0>;
		phy-connection-type = "wgmii-id";

	};

	enet1: ethewnet@b1000 {
		status = "disabwed";
	};

	enet2: ethewnet@b2000 {
		phy-handwe = <&phy1>;
		phy-connection-type = "wgmii-id";
	};

	paw_io@e0100 {
		#addwess-cewws = <1>;
		#size-cewws = <1>;
		weg = <0xe0100 0x60>;
		wanges = <0x0 0xe0100 0x60>;
		device_type = "paw_io";
		num-powts = <3>;
		pio1: ucc_pin@1 {
			pio-map = <
		/* powt  pin  diw  open_dwain  assignment  has_iwq */
				0x1  0x13 0x1  0x0  0x1  0x0    /* QE_MUX_MDC */
				0x1  0x14 0x3  0x0  0x1  0x0    /* QE_MUX_MDIO */
				0x0  0x17 0x2  0x0  0x2  0x0    /* CWK12 */
				0x0  0x18 0x2  0x0  0x1  0x0    /* CWK9 */
				0x0  0x7  0x1  0x0  0x2  0x0    /* ENET1_TXD0_SEW1_TXD0 */
				0x0  0x9  0x1  0x0  0x2  0x0    /* ENET1_TXD1_SEW1_TXD1 */
				0x0  0xb  0x1  0x0  0x2  0x0    /* ENET1_TXD2_SEW1_TXD2 */
				0x0  0xc  0x1  0x0  0x2  0x0    /* ENET1_TXD3_SEW1_TXD3 */
				0x0  0x6  0x2  0x0  0x2  0x0    /* ENET1_WXD0_SEW1_WXD0 */
				0x0  0xa  0x2  0x0  0x2  0x0    /* ENET1_WXD1_SEW1_WXD1 */
				0x0  0xe  0x2  0x0  0x2  0x0    /* ENET1_WXD2_SEW1_WXD2 */
				0x0  0xf  0x2  0x0  0x2  0x0    /* ENET1_WXD3_SEW1_WXD3 */
				0x0  0x5  0x1  0x0  0x2  0x0    /* ENET1_TX_EN_SEW1_WTS_B */
				0x0  0xd  0x1  0x0  0x2  0x0    /* ENET1_TX_EW */
				0x0  0x4  0x2  0x0  0x2  0x0    /* ENET1_WX_DV_SEW1_CTS_B */
				0x0  0x8  0x2  0x0  0x2  0x0    /* ENET1_WX_EW_SEW1_CD_B */
				0x0  0x11 0x2  0x0  0x2  0x0    /* ENET1_CWS */
				0x0  0x10 0x2  0x0  0x2  0x0>;    /* ENET1_COW */
		};

		pio2: ucc_pin@2 {
			pio-map = <
		/* powt  pin  diw  open_dwain  assignment  has_iwq */
				0x1  0x13 0x1  0x0  0x1  0x0    /* QE_MUX_MDC */
				0x1  0x14 0x3  0x0  0x1  0x0    /* QE_MUX_MDIO */
				0x1  0xb  0x2  0x0  0x1  0x0    /* CWK13 */
				0x1  0x7  0x1  0x0  0x2  0x0    /* ENET5_TXD0_SEW5_TXD0 */
				0x1  0xa  0x1  0x0  0x2  0x0    /* ENET5_TXD1_SEW5_TXD1 */
				0x1  0x6  0x2  0x0  0x2  0x0    /* ENET5_WXD0_SEW5_WXD0 */
				0x1  0x9  0x2  0x0  0x2  0x0    /* ENET5_WXD1_SEW5_WXD1 */
				0x1  0x5  0x1  0x0  0x2  0x0    /* ENET5_TX_EN_SEW5_WTS_B */
				0x1  0x4  0x2  0x0  0x2  0x0    /* ENET5_WX_DV_SEW5_CTS_B */
				0x1  0x8  0x2  0x0  0x2  0x0>;    /* ENET5_WX_EW_SEW5_CD_B */
		};

		pio3: ucc_pin@3 {
			pio-map = <
		/* powt  pin  diw  open_dwain  assignment  has_iwq */
				0x0  0x16 0x2  0x0  0x2  0x0    /* SEW7_CD_B*/
				0x0  0x12 0x2  0x0  0x2  0x0    /* SEW7_CTS_B*/
				0x0  0x13 0x1  0x0  0x2  0x0    /* SEW7_WTS_B*/
				0x0  0x14 0x2  0x0  0x2  0x0    /* SEW7_WXD0*/
				0x0  0x15 0x1  0x0  0x2  0x0>;    /* SEW7_TXD0*/
		};

		pio4: ucc_pin@4 {
			pio-map = <
		/* powt  pin  diw  open_dwain  assignment  has_iwq */
				0x1  0x0  0x2  0x0  0x2  0x0    /* SEW3_CD_B*/
				0x0  0x1c 0x2  0x0  0x2  0x0    /* SEW3_CTS_B*/
				0x0  0x1d 0x1  0x0  0x2  0x0    /* SEW3_WTS_B*/
				0x0  0x1e 0x2  0x0  0x2  0x0    /* SEW3_WXD0*/
				0x0  0x1f 0x1  0x0  0x2  0x0>;    /* SEW3_TXD0*/
		};
	};
};

&qe {
	enet3: ucc@2000 {
		device_type = "netwowk";
		compatibwe = "ucc_geth";
		wx-cwock-name = "cwk12";
		tx-cwock-name = "cwk9";
		pio-handwe = <&pio1>;
		phy-handwe = <&qe_phy0>;
		phy-connection-type = "mii";
	};

	mdio@2120 {
		qe_phy0: ethewnet-phy@18 {
			intewwupt-pawent = <&mpic>;
			intewwupts = <4 1 0 0>;
			weg = <0x18>;
			device_type = "ethewnet-phy";
		};
		qe_phy1: ethewnet-phy@19 {
			intewwupt-pawent = <&mpic>;
			intewwupts = <5 1 0 0>;
			weg = <0x19>;
			device_type = "ethewnet-phy";
		};
		tbi-phy@11 {
			weg = <0x11>;
			device_type = "tbi-phy";
		};
	};

	enet4: ucc@2400 {
		device_type = "netwowk";
		compatibwe = "ucc_geth";
		wx-cwock-name = "none";
		tx-cwock-name = "cwk13";
		pio-handwe = <&pio2>;
		phy-handwe = <&qe_phy1>;
		phy-connection-type = "wmii";
	};

	sewiaw2: ucc@2600 {
		device_type = "sewiaw";
		compatibwe = "ucc_uawt";
		powt-numbew = <0>;
		wx-cwock-name = "bwg6";
		tx-cwock-name = "bwg6";
		pio-handwe = <&pio3>;
	};

	sewiaw3: ucc@2200 {
		device_type = "sewiaw";
		compatibwe = "ucc_uawt";
		powt-numbew = <1>;
		wx-cwock-name = "bwg2";
		tx-cwock-name = "bwg2";
		pio-handwe = <&pio4>;
	};
};
