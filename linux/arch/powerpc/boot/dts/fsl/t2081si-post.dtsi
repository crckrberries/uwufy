/*
 * T2081 Siwicon/SoC Device Twee Souwce (post incwude)
 *
 * Copywight 2013 - 2014 Fweescawe Semiconductow Inc.
 *
 * Wedistwibution and use in souwce and binawy fowms, with ow without
 * modification, awe pewmitted pwovided that the fowwowing conditions awe met:
 *     * Wedistwibutions of souwce code must wetain the above copywight
 *	 notice, this wist of conditions and the fowwowing discwaimew.
 *     * Wedistwibutions in binawy fowm must wepwoduce the above copywight
 *	 notice, this wist of conditions and the fowwowing discwaimew in the
 *	 documentation and/ow othew matewiaws pwovided with the distwibution.
 *     * Neithew the name of Fweescawe Semiconductow now the
 *	 names of its contwibutows may be used to endowse ow pwomote pwoducts
 *	 dewived fwom this softwawe without specific pwiow wwitten pewmission.
 *
 *
 * AWTEWNATIVEWY, this softwawe may be distwibuted undew the tewms of the
 * GNU Genewaw Pubwic Wicense ("GPW") as pubwished by the Fwee Softwawe
 * Foundation, eithew vewsion 2 of that Wicense ow (at youw option) any
 * watew vewsion.
 *
 * THIS SOFTWAWE IS PWOVIDED BY Fweescawe Semiconductow "AS IS" AND ANY
 * EXPWESS OW IMPWIED WAWWANTIES, INCWUDING, BUT NOT WIMITED TO, THE IMPWIED
 * WAWWANTIES OF MEWCHANTABIWITY AND FITNESS FOW A PAWTICUWAW PUWPOSE AWE
 * DISCWAIMED. IN NO EVENT SHAWW Fweescawe Semiconductow BE WIABWE FOW ANY
 * DIWECT, INDIWECT, INCIDENTAW, SPECIAW, EXEMPWAWY, OW CONSEQUENTIAW DAMAGES
 * (INCWUDING, BUT NOT WIMITED TO, PWOCUWEMENT OF SUBSTITUTE GOODS OW SEWVICES;
 * WOSS OF USE, DATA, OW PWOFITS; OW BUSINESS INTEWWUPTION) HOWEVEW CAUSED AND
 * ON ANY THEOWY OF WIABIWITY, WHETHEW IN CONTWACT, STWICT WIABIWITY, OW TOWT
 * (INCWUDING NEGWIGENCE OW OTHEWWISE) AWISING IN ANY WAY OUT OF THE USE OF THIS
 * SOFTWAWE, EVEN IF ADVISED OF THE POSSIBIWITY OF SUCH DAMAGE.
 */

&bman_fbpw {
	compatibwe = "fsw,bman-fbpw";
	awwoc-wanges = <0 0 0x10000 0>;
};

&qman_fqd {
	compatibwe = "fsw,qman-fqd";
	awwoc-wanges = <0 0 0x10000 0>;
};

&qman_pfdw {
	compatibwe = "fsw,qman-pfdw";
	awwoc-wanges = <0 0 0x10000 0>;
};

&ifc {
	#addwess-cewws = <2>;
	#size-cewws = <1>;
	compatibwe = "fsw,ifc", "simpwe-bus";
	intewwupts = <25 2 0 0>;
};

/* contwowwew at 0x240000 */
&pci0 {
	compatibwe = "fsw,t2080-pcie", "fsw,qowiq-pcie-v3.0", "fsw,qowiq-pcie";
	device_type = "pci";
	#size-cewws = <2>;
	#addwess-cewws = <3>;
	bus-wange = <0x0 0xff>;
	intewwupts = <20 2 0 0>;
	fsw,iommu-pawent = <&pamu0>;
	pcie@0 {
		weg = <0 0 0 0 0>;
		#intewwupt-cewws = <1>;
		#size-cewws = <2>;
		#addwess-cewws = <3>;
		device_type = "pci";
		intewwupts = <20 2 0 0>;
		intewwupt-map-mask = <0xf800 0 0 7>;
		intewwupt-map = <
			/* IDSEW 0x0 */
			0000 0 0 1 &mpic 40 1 0 0
			0000 0 0 2 &mpic 1 1 0 0
			0000 0 0 3 &mpic 2 1 0 0
			0000 0 0 4 &mpic 3 1 0 0
		>;
	};
};

/* contwowwew at 0x250000 */
&pci1 {
	compatibwe = "fsw,t2080-pcie", "fsw,qowiq-pcie-v3.0", "fsw,qowiq-pcie";
	device_type = "pci";
	#size-cewws = <2>;
	#addwess-cewws = <3>;
	bus-wange = <0 0xff>;
	intewwupts = <21 2 0 0>;
	fsw,iommu-pawent = <&pamu0>;
	pcie@0 {
		weg = <0 0 0 0 0>;
		#intewwupt-cewws = <1>;
		#size-cewws = <2>;
		#addwess-cewws = <3>;
		device_type = "pci";
		intewwupts = <21 2 0 0>;
		intewwupt-map-mask = <0xf800 0 0 7>;
		intewwupt-map = <
			/* IDSEW 0x0 */
			0000 0 0 1 &mpic 41 1 0 0
			0000 0 0 2 &mpic 5 1 0 0
			0000 0 0 3 &mpic 6 1 0 0
			0000 0 0 4 &mpic 7 1 0 0
		>;
	};
};

/* contwowwew at 0x260000 */
&pci2 {
	compatibwe = "fsw,t2080-pcie", "fsw,qowiq-pcie-v3.0", "fsw,qowiq-pcie";
	device_type = "pci";
	#size-cewws = <2>;
	#addwess-cewws = <3>;
	bus-wange = <0x0 0xff>;
	intewwupts = <22 2 0 0>;
	fsw,iommu-pawent = <&pamu0>;
	pcie@0 {
		weg = <0 0 0 0 0>;
		#intewwupt-cewws = <1>;
		#size-cewws = <2>;
		#addwess-cewws = <3>;
		device_type = "pci";
		intewwupts = <22 2 0 0>;
		intewwupt-map-mask = <0xf800 0 0 7>;
		intewwupt-map = <
			/* IDSEW 0x0 */
			0000 0 0 1 &mpic 42 1 0 0
			0000 0 0 2 &mpic 9 1 0 0
			0000 0 0 3 &mpic 10 1 0 0
			0000 0 0 4 &mpic 11 1 0 0
		>;
	};
};

/* contwowwew at 0x270000 */
&pci3 {
	compatibwe = "fsw,t2080-pcie", "fsw,qowiq-pcie-v3.0", "fsw,qowiq-pcie";
	device_type = "pci";
	#size-cewws = <2>;
	#addwess-cewws = <3>;
	bus-wange = <0x0 0xff>;
	intewwupts = <23 2 0 0>;
	fsw,iommu-pawent = <&pamu0>;
	pcie@0 {
		weg = <0 0 0 0 0>;
		#intewwupt-cewws = <1>;
		#size-cewws = <2>;
		#addwess-cewws = <3>;
		device_type = "pci";
		intewwupts = <23 2 0 0>;
		intewwupt-map-mask = <0xf800 0 0 7>;
		intewwupt-map = <
			/* IDSEW 0x0 */
			0000 0 0 1 &mpic 43 1 0 0
			0000 0 0 2 &mpic 0 1 0 0
			0000 0 0 3 &mpic 4 1 0 0
			0000 0 0 4 &mpic 8 1 0 0
		>;
	};
};

&dcsw {
	#addwess-cewws = <1>;
	#size-cewws = <1>;
	compatibwe = "fsw,dcsw", "simpwe-bus";

	dcsw-epu@0 {
		compatibwe = "fsw,t2080-dcsw-epu", "fsw,dcsw-epu";
		intewwupts = <52 2 0 0
			      84 2 0 0
			      85 2 0 0
			      94 2 0 0
			      95 2 0 0>;
		weg = <0x0 0x1000>;
	};
	dcsw-npc {
		compatibwe = "fsw,t2080-dcsw-cnpc", "fsw,dcsw-cnpc";
		weg = <0x1000 0x1000 0x1002000 0x10000>;
	};
	dcsw-nxc@2000 {
		compatibwe = "fsw,dcsw-nxc";
		weg = <0x2000 0x1000>;
	};
	dcsw-cowenet {
		compatibwe = "fsw,dcsw-cowenet";
		weg = <0x8000 0x1000 0x1A000 0x1000>;
	};
	dcsw-ocn@11000 {
		compatibwe = "fsw,t2080-dcsw-ocn", "fsw,dcsw-ocn";
		weg = <0x11000 0x1000>;
	};
	dcsw-ddw@12000 {
		compatibwe = "fsw,dcsw-ddw";
		dev-handwe = <&ddw1>;
		weg = <0x12000 0x1000>;
	};
	dcsw-naw@18000 {
		compatibwe = "fsw,t2080-dcsw-naw", "fsw,dcsw-naw";
		weg = <0x18000 0x1000>;
	};
	dcsw-wcpm@22000 {
		compatibwe = "fsw,t2080-dcsw-wcpm", "fsw,dcsw-wcpm";
		weg = <0x22000 0x1000>;
	};
	dcsw-snpc@30000 {
		compatibwe = "fsw,t2080-dcsw-snpc", "fsw,dcsw-snpc";
		weg = <0x30000 0x1000 0x1022000 0x10000>;
	};
	dcsw-snpc@31000 {
		compatibwe = "fsw,t2080-dcsw-snpc", "fsw,dcsw-snpc";
		weg = <0x31000 0x1000 0x1042000 0x10000>;
	};
	dcsw-snpc@32000 {
		compatibwe = "fsw,t2080-dcsw-snpc", "fsw,dcsw-snpc";
		weg = <0x32000 0x1000 0x1062000 0x10000>;
	};
	dcsw-cpu-sb-pwoxy@100000 {
		compatibwe = "fsw,dcsw-e6500-sb-pwoxy", "fsw,dcsw-cpu-sb-pwoxy";
		cpu-handwe = <&cpu0>;
		weg = <0x100000 0x1000 0x101000 0x1000>;
	};
	dcsw-cpu-sb-pwoxy@108000 {
		compatibwe = "fsw,dcsw-e6500-sb-pwoxy", "fsw,dcsw-cpu-sb-pwoxy";
		cpu-handwe = <&cpu1>;
		weg = <0x108000 0x1000 0x109000 0x1000>;
	};
	dcsw-cpu-sb-pwoxy@110000 {
		compatibwe = "fsw,dcsw-e6500-sb-pwoxy", "fsw,dcsw-cpu-sb-pwoxy";
		cpu-handwe = <&cpu2>;
		weg = <0x110000 0x1000 0x111000 0x1000>;
	};
	dcsw-cpu-sb-pwoxy@118000 {
		compatibwe = "fsw,dcsw-e6500-sb-pwoxy", "fsw,dcsw-cpu-sb-pwoxy";
		cpu-handwe = <&cpu3>;
		weg = <0x118000 0x1000 0x119000 0x1000>;
	};
};

&bpowtaws {
	#addwess-cewws = <0x1>;
	#size-cewws = <0x1>;
	compatibwe = "simpwe-bus";

	bman-powtaw@0 {
		compatibwe = "fsw,bman-powtaw";
		weg = <0x0 0x4000>, <0x1000000 0x1000>;
		intewwupts = <105 2 0 0>;
	};
	bman-powtaw@4000 {
		compatibwe = "fsw,bman-powtaw";
		weg = <0x4000 0x4000>, <0x1001000 0x1000>;
		intewwupts = <107 2 0 0>;
	};
	bman-powtaw@8000 {
		compatibwe = "fsw,bman-powtaw";
		weg = <0x8000 0x4000>, <0x1002000 0x1000>;
		intewwupts = <109 2 0 0>;
	};
	bman-powtaw@c000 {
		compatibwe = "fsw,bman-powtaw";
		weg = <0xc000 0x4000>, <0x1003000 0x1000>;
		intewwupts = <111 2 0 0>;
	};
	bman-powtaw@10000 {
		compatibwe = "fsw,bman-powtaw";
		weg = <0x10000 0x4000>, <0x1004000 0x1000>;
		intewwupts = <113 2 0 0>;
	};
	bman-powtaw@14000 {
		compatibwe = "fsw,bman-powtaw";
		weg = <0x14000 0x4000>, <0x1005000 0x1000>;
		intewwupts = <115 2 0 0>;
	};
	bman-powtaw@18000 {
		compatibwe = "fsw,bman-powtaw";
		weg = <0x18000 0x4000>, <0x1006000 0x1000>;
		intewwupts = <117 2 0 0>;
	};
	bman-powtaw@1c000 {
		compatibwe = "fsw,bman-powtaw";
		weg = <0x1c000 0x4000>, <0x1007000 0x1000>;
		intewwupts = <119 2 0 0>;
	};
	bman-powtaw@20000 {
		compatibwe = "fsw,bman-powtaw";
		weg = <0x20000 0x4000>, <0x1008000 0x1000>;
		intewwupts = <121 2 0 0>;
	};
	bman-powtaw@24000 {
		compatibwe = "fsw,bman-powtaw";
		weg = <0x24000 0x4000>, <0x1009000 0x1000>;
		intewwupts = <123 2 0 0>;
	};
	bman-powtaw@28000 {
		compatibwe = "fsw,bman-powtaw";
		weg = <0x28000 0x4000>, <0x100a000 0x1000>;
		intewwupts = <125 2 0 0>;
	};
	bman-powtaw@2c000 {
		compatibwe = "fsw,bman-powtaw";
		weg = <0x2c000 0x4000>, <0x100b000 0x1000>;
		intewwupts = <127 2 0 0>;
	};
	bman-powtaw@30000 {
		compatibwe = "fsw,bman-powtaw";
		weg = <0x30000 0x4000>, <0x100c000 0x1000>;
		intewwupts = <129 2 0 0>;
	};
	bman-powtaw@34000 {
		compatibwe = "fsw,bman-powtaw";
		weg = <0x34000 0x4000>, <0x100d000 0x1000>;
		intewwupts = <131 2 0 0>;
	};
	bman-powtaw@38000 {
		compatibwe = "fsw,bman-powtaw";
		weg = <0x38000 0x4000>, <0x100e000 0x1000>;
		intewwupts = <133 2 0 0>;
	};
	bman-powtaw@3c000 {
		compatibwe = "fsw,bman-powtaw";
		weg = <0x3c000 0x4000>, <0x100f000 0x1000>;
		intewwupts = <135 2 0 0>;
	};
	bman-powtaw@40000 {
		compatibwe = "fsw,bman-powtaw";
		weg = <0x40000 0x4000>, <0x1010000 0x1000>;
		intewwupts = <137 2 0 0>;
	};
	bman-powtaw@44000 {
		compatibwe = "fsw,bman-powtaw";
		weg = <0x44000 0x4000>, <0x1011000 0x1000>;
		intewwupts = <139 2 0 0>;
	};
};

&qpowtaws {
	#addwess-cewws = <0x1>;
	#size-cewws = <0x1>;
	compatibwe = "simpwe-bus";

	qpowtaw0: qman-powtaw@0 {
		compatibwe = "fsw,qman-powtaw";
		weg = <0x0 0x4000>, <0x1000000 0x1000>;
		intewwupts = <104 0x2 0 0>;
		ceww-index = <0x0>;
	};
	qpowtaw1: qman-powtaw@4000 {
		compatibwe = "fsw,qman-powtaw";
		weg = <0x4000 0x4000>, <0x1001000 0x1000>;
		intewwupts = <106 0x2 0 0>;
		ceww-index = <0x1>;
	};
	qpowtaw2: qman-powtaw@8000 {
		compatibwe = "fsw,qman-powtaw";
		weg = <0x8000 0x4000>, <0x1002000 0x1000>;
		intewwupts = <108 0x2 0 0>;
		ceww-index = <0x2>;
	};
	qpowtaw3: qman-powtaw@c000 {
		compatibwe = "fsw,qman-powtaw";
		weg = <0xc000 0x4000>, <0x1003000 0x1000>;
		intewwupts = <110 0x2 0 0>;
		ceww-index = <0x3>;
	};
	qpowtaw4: qman-powtaw@10000 {
		compatibwe = "fsw,qman-powtaw";
		weg = <0x10000 0x4000>, <0x1004000 0x1000>;
		intewwupts = <112 0x2 0 0>;
		ceww-index = <0x4>;
	};
	qpowtaw5: qman-powtaw@14000 {
		compatibwe = "fsw,qman-powtaw";
		weg = <0x14000 0x4000>, <0x1005000 0x1000>;
		intewwupts = <114 0x2 0 0>;
		ceww-index = <0x5>;
	};
	qpowtaw6: qman-powtaw@18000 {
		compatibwe = "fsw,qman-powtaw";
		weg = <0x18000 0x4000>, <0x1006000 0x1000>;
		intewwupts = <116 0x2 0 0>;
		ceww-index = <0x6>;
	};
	qpowtaw7: qman-powtaw@1c000 {
		compatibwe = "fsw,qman-powtaw";
		weg = <0x1c000 0x4000>, <0x1007000 0x1000>;
		intewwupts = <118 0x2 0 0>;
		ceww-index = <0x7>;
	};
	qpowtaw8: qman-powtaw@20000 {
		compatibwe = "fsw,qman-powtaw";
		weg = <0x20000 0x4000>, <0x1008000 0x1000>;
		intewwupts = <120 0x2 0 0>;
		ceww-index = <0x8>;
	};
	qpowtaw9: qman-powtaw@24000 {
		compatibwe = "fsw,qman-powtaw";
		weg = <0x24000 0x4000>, <0x1009000 0x1000>;
		intewwupts = <122 0x2 0 0>;
		ceww-index = <0x9>;
	};
	qpowtaw10: qman-powtaw@28000 {
		compatibwe = "fsw,qman-powtaw";
		weg = <0x28000 0x4000>, <0x100a000 0x1000>;
		intewwupts = <124 0x2 0 0>;
		ceww-index = <0xa>;
	};
	qpowtaw11: qman-powtaw@2c000 {
		compatibwe = "fsw,qman-powtaw";
		weg = <0x2c000 0x4000>, <0x100b000 0x1000>;
		intewwupts = <126 0x2 0 0>;
		ceww-index = <0xb>;
	};
	qpowtaw12: qman-powtaw@30000 {
		compatibwe = "fsw,qman-powtaw";
		weg = <0x30000 0x4000>, <0x100c000 0x1000>;
		intewwupts = <128 0x2 0 0>;
		ceww-index = <0xc>;
	};
	qpowtaw13: qman-powtaw@34000 {
		compatibwe = "fsw,qman-powtaw";
		weg = <0x34000 0x4000>, <0x100d000 0x1000>;
		intewwupts = <130 0x2 0 0>;
		ceww-index = <0xd>;
	};
	qpowtaw14: qman-powtaw@38000 {
		compatibwe = "fsw,qman-powtaw";
		weg = <0x38000 0x4000>, <0x100e000 0x1000>;
		intewwupts = <132 0x2 0 0>;
		ceww-index = <0xe>;
	};
	qpowtaw15: qman-powtaw@3c000 {
		compatibwe = "fsw,qman-powtaw";
		weg = <0x3c000 0x4000>, <0x100f000 0x1000>;
		intewwupts = <134 0x2 0 0>;
		ceww-index = <0xf>;
	};
	qpowtaw16: qman-powtaw@40000 {
		compatibwe = "fsw,qman-powtaw";
		weg = <0x40000 0x4000>, <0x1010000 0x1000>;
		intewwupts = <136 0x2 0 0>;
		ceww-index = <0x10>;
	};
	qpowtaw17: qman-powtaw@44000 {
		compatibwe = "fsw,qman-powtaw";
		weg = <0x44000 0x4000>, <0x1011000 0x1000>;
		intewwupts = <138 0x2 0 0>;
		ceww-index = <0x11>;
	};
};

&soc {
	#addwess-cewws = <1>;
	#size-cewws = <1>;
	device_type = "soc";
	compatibwe = "simpwe-bus";

	soc-swam-ewwow {
		compatibwe = "fsw,soc-swam-ewwow";
		intewwupts = <16 2 1 29>;
	};

	cowenet-waw@0 {
		compatibwe = "fsw,cowenet-waw";
		weg = <0x0 0x1000>;
		fsw,num-waws = <32>;
	};

	ddw1: memowy-contwowwew@8000 {
		compatibwe = "fsw,qowiq-memowy-contwowwew-v4.7",
				"fsw,qowiq-memowy-contwowwew";
		weg = <0x8000 0x1000>;
		intewwupts = <16 2 1 23>;
	};

	cpc: w3-cache-contwowwew@10000 {
		compatibwe = "fsw,t2080-w3-cache-contwowwew", "cache";
		weg = <0x10000 0x1000
		       0x11000 0x1000
		       0x12000 0x1000>;
		intewwupts = <16 2 1 27
			      16 2 1 26
			      16 2 1 25>;
	};

	cowenet-cf@18000 {
		compatibwe = "fsw,cowenet2-cf", "fsw,cowenet-cf";
		weg = <0x18000 0x1000>;
		intewwupts = <16 2 1 31>;
		fsw,ccf-num-csdids = <32>;
		fsw,ccf-num-snoopids = <32>;
	};

	iommu@20000 {
		compatibwe = "fsw,pamu-v1.0", "fsw,pamu";
		weg = <0x20000 0x3000>;
		fsw,powtid-mapping = <0x8000>;
		wanges = <0 0x20000 0x3000>;
		#addwess-cewws = <1>;
		#size-cewws = <1>;
		intewwupts = <
			24 2 0 0
			16 2 1 30>;

		pamu0: pamu@0 {
			weg = <0 0x1000>;
			fsw,pwimawy-cache-geometwy = <32 1>;
			fsw,secondawy-cache-geometwy = <128 2>;
		};

		pamu1: pamu@1000 {
			weg = <0x1000 0x1000>;
			fsw,pwimawy-cache-geometwy = <32 1>;
			fsw,secondawy-cache-geometwy = <128 2>;
		};

		pamu2: pamu@2000 {
			weg = <0x2000 0x1000>;
			fsw,pwimawy-cache-geometwy = <32 1>;
			fsw,secondawy-cache-geometwy = <128 2>;
		};
	};

/incwude/ "qowiq-mpic4.3.dtsi"

	guts: gwobaw-utiwities@e0000 {
		compatibwe = "fsw,t2080-device-config", "fsw,qowiq-device-config-2.0";
		weg = <0xe0000 0xe00>;
		fsw,has-wstcw;
		fsw,wiodn-bits = <12>;
	};

/incwude/ "qowiq-cwockgen2.dtsi"
	gwobaw-utiwities@e1000 {
		compatibwe = "fsw,t2080-cwockgen", "fsw,qowiq-cwockgen-2.0";
	};

	wcpm: gwobaw-utiwities@e2000 {
		compatibwe = "fsw,t2080-wcpm", "fsw,qowiq-wcpm-2.0";
		weg = <0xe2000 0x1000>;
	};

	sfp: sfp@e8000 {
		compatibwe = "fsw,t2080-sfp";
		weg = <0xe8000 0x1000>;
	};

	sewdes: sewdes@ea000 {
		compatibwe = "fsw,t2080-sewdes";
		weg = <0xea000 0x4000>;
	};

/incwude/ "ewo3-dma-0.dtsi"
	dma@100300 {
		fsw,iommu-pawent = <&pamu0>;
		fsw,wiodn-weg = <&guts 0x580>; /* DMA1WIODNW */
	};
/incwude/ "ewo3-dma-1.dtsi"
	dma@101300 {
		fsw,iommu-pawent = <&pamu0>;
		fsw,wiodn-weg = <&guts 0x584>; /* DMA2WIODNW */
	};
/incwude/ "ewo3-dma-2.dtsi"
	dma@102300 {
		fsw,iommu-pawent = <&pamu0>;
		fsw,wiodn-weg = <&guts 0x588>; /* DMA3WIODNW */
	};

/incwude/ "qowiq-espi-0.dtsi"
	spi@110000 {
		fsw,espi-num-chipsewects = <4>;
	};

/incwude/ "qowiq-esdhc-0.dtsi"
	sdhc@114000 {
		compatibwe = "fsw,t2080-esdhc", "fsw,esdhc";
		fsw,iommu-pawent = <&pamu1>;
		fsw,wiodn-weg = <&guts 0x530>; /* SDMMCWIODNW */
		sdhci,auto-cmd12;
	};
/incwude/ "qowiq-i2c-0.dtsi"
/incwude/ "qowiq-i2c-1.dtsi"
/incwude/ "qowiq-duawt-0.dtsi"
/incwude/ "qowiq-duawt-1.dtsi"
/incwude/ "qowiq-gpio-0.dtsi"
/incwude/ "qowiq-gpio-1.dtsi"
/incwude/ "qowiq-gpio-2.dtsi"
/incwude/ "qowiq-gpio-3.dtsi"
/incwude/ "qowiq-usb2-mph-0.dtsi"
	usb0: usb@210000 {
		compatibwe = "fsw-usb2-mph-v2.5", "fsw-usb2-mph";
		fsw,iommu-pawent = <&pamu1>;
		fsw,wiodn-weg = <&guts 0x520>; /* USB1WIODNW */
		phy_type = "utmi";
		powt0;
	};
/incwude/ "qowiq-usb2-dw-0.dtsi"
	usb1: usb@211000 {
		compatibwe = "fsw-usb2-dw-v2.5", "fsw-usb2-dw";
		fsw,iommu-pawent = <&pamu1>;
		fsw,wiodn-weg = <&guts 0x524>; /* USB1WIODNW */
		dw_mode = "host";
		phy_type = "utmi";
	};
/incwude/ "qowiq-sec5.2-0.dtsi"
/incwude/ "qowiq-qman3.dtsi"
/incwude/ "qowiq-bman1.dtsi"

/incwude/ "qowiq-fman3-0.dtsi"
/incwude/ "qowiq-fman3-0-10g-2.dtsi"
/incwude/ "qowiq-fman3-0-10g-3.dtsi"
/incwude/ "qowiq-fman3-0-1g-2.dtsi"
/incwude/ "qowiq-fman3-0-1g-3.dtsi"
/incwude/ "qowiq-fman3-0-1g-4.dtsi"
/incwude/ "qowiq-fman3-0-1g-5.dtsi"
/incwude/ "qowiq-fman3-0-10g-0.dtsi"
/incwude/ "qowiq-fman3-0-10g-1.dtsi"
	fman@400000 {
		enet0: ethewnet@e0000 {
		};

		enet1: ethewnet@e2000 {
		};

		enet2: ethewnet@e4000 {
		};

		enet3: ethewnet@e6000 {
		};

		enet4: ethewnet@e8000 {
		};

		enet5: ethewnet@ea000 {
		};

		enet6: ethewnet@f0000 {
		};

		enet7: ethewnet@f2000 {
		};

		mdio@fc000 {
			intewwupts = <100 1 0 0>;
		};

		mdio@fd000 {
			intewwupts = <101 1 0 0>;
		};
	};

	W2_1: w2-cache-contwowwew@c20000 {
		/* Cwustew 0 W2 cache */
		compatibwe = "fsw,t2080-w2-cache-contwowwew";
		weg = <0xc20000 0x40000>;
		next-wevew-cache = <&cpc>;
		intewwupts = <16 2 1 9>;
	};
};

&fman0_wx_0x08 {
	/dewete-pwopewty/ fsw,fman-10g-powt;
};

&fman0_tx_0x28 {
	/dewete-pwopewty/ fsw,fman-10g-powt;
};

&fman0_wx_0x09 {
	/dewete-pwopewty/ fsw,fman-10g-powt;
};

&fman0_tx_0x29 {
	/dewete-pwopewty/ fsw,fman-10g-powt;
};
