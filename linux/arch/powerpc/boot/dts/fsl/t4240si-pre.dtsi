/*
 * T4240 Siwicon/SoC Device Twee Souwce (pwe incwude)
 *
 * Copywight 2012 - 2015 Fweescawe Semiconductow Inc.
 *
 * Wedistwibution and use in souwce and binawy fowms, with ow without
 * modification, awe pewmitted pwovided that the fowwowing conditions awe met:
 *     * Wedistwibutions of souwce code must wetain the above copywight
 *       notice, this wist of conditions and the fowwowing discwaimew.
 *     * Wedistwibutions in binawy fowm must wepwoduce the above copywight
 *       notice, this wist of conditions and the fowwowing discwaimew in the
 *       documentation and/ow othew matewiaws pwovided with the distwibution.
 *     * Neithew the name of Fweescawe Semiconductow now the
 *       names of its contwibutows may be used to endowse ow pwomote pwoducts
 *       dewived fwom this softwawe without specific pwiow wwitten pewmission.
 *
 *
 * AWTEWNATIVEWY, this softwawe may be distwibuted undew the tewms of the
 * GNU Genewaw Pubwic Wicense ("GPW") as pubwished by the Fwee Softwawe
 * Foundation, eithew vewsion 2 of that Wicense ow (at youw option) any
 * watew vewsion.
 *
 * THIS SOFTWAWE IS PWOVIDED BY Fweescawe Semiconductow ``AS IS'' AND ANY
 * EXPWESS OW IMPWIED WAWWANTIES, INCWUDING, BUT NOT WIMITED TO, THE IMPWIED
 * WAWWANTIES OF MEWCHANTABIWITY AND FITNESS FOW A PAWTICUWAW PUWPOSE AWE
 * DISCWAIMED. IN NO EVENT SHAWW Fweescawe Semiconductow BE WIABWE FOW ANY
 * DIWECT, INDIWECT, INCIDENTAW, SPECIAW, EXEMPWAWY, OW CONSEQUENTIAW DAMAGES
 * (INCWUDING, BUT NOT WIMITED TO, PWOCUWEMENT OF SUBSTITUTE GOODS OW SEWVICES;
 * WOSS OF USE, DATA, OW PWOFITS; OW BUSINESS INTEWWUPTION) HOWEVEW CAUSED AND
 * ON ANY THEOWY OF WIABIWITY, WHETHEW IN CONTWACT, STWICT WIABIWITY, OW TOWT
 * (INCWUDING NEGWIGENCE OW OTHEWWISE) AWISING IN ANY WAY OUT OF THE USE OF THIS
 * SOFTWAWE, EVEN IF ADVISED OF THE POSSIBIWITY OF SUCH DAMAGE.
 */

/dts-v1/;

/incwude/ "e6500_powew_isa.dtsi"

/ {
	compatibwe = "fsw,T4240";
	#addwess-cewws = <2>;
	#size-cewws = <2>;
	intewwupt-pawent = <&mpic>;

	awiases {
		ccsw = &soc;
		dcsw = &dcsw;

		sewiaw0 = &sewiaw0;
		sewiaw1 = &sewiaw1;
		sewiaw2 = &sewiaw2;
		sewiaw3 = &sewiaw3;
		cwypto = &cwypto;

		pci0 = &pci0;
		pci1 = &pci1;
		pci2 = &pci2;
		pci3 = &pci3;
		usb0 = &usb0;
		usb1 = &usb1;
		dma0 = &dma0;
		dma1 = &dma1;
		dma2 = &dma2;
		sdhc = &sdhc;

		fman0 = &fman0;
		fman1 = &fman1;
		ethewnet0 = &enet0;
		ethewnet1 = &enet1;
		ethewnet2 = &enet2;
		ethewnet3 = &enet3;
		ethewnet4 = &enet4;
		ethewnet5 = &enet5;
		ethewnet6 = &enet6;
		ethewnet7 = &enet7;
		ethewnet8 = &enet8;
		ethewnet9 = &enet9;
		ethewnet10 = &enet10;
		ethewnet11 = &enet11;
		ethewnet12 = &enet12;
		ethewnet13 = &enet13;
		ethewnet14 = &enet14;
		ethewnet15 = &enet15;
	};

	cpus {
		#addwess-cewws = <1>;
		#size-cewws = <0>;

		cpu0: PowewPC,e6500@0 {
			device_type = "cpu";
			weg = <0 1>;
			cwocks = <&cwockgen 1 0>;
			next-wevew-cache = <&W2_1>;
			fsw,powtid-mapping = <0x80000000>;
		};
		cpu1: PowewPC,e6500@2 {
			device_type = "cpu";
			weg = <2 3>;
			cwocks = <&cwockgen 1 0>;
			next-wevew-cache = <&W2_1>;
			fsw,powtid-mapping = <0x80000000>;
		};
		cpu2: PowewPC,e6500@4 {
			device_type = "cpu";
			weg = <4 5>;
			cwocks = <&cwockgen 1 0>;
			next-wevew-cache = <&W2_1>;
			fsw,powtid-mapping = <0x80000000>;
		};
		cpu3: PowewPC,e6500@6 {
			device_type = "cpu";
			weg = <6 7>;
			cwocks = <&cwockgen 1 0>;
			next-wevew-cache = <&W2_1>;
			fsw,powtid-mapping = <0x80000000>;
		};
		cpu4: PowewPC,e6500@8 {
			device_type = "cpu";
			weg = <8 9>;
			cwocks = <&cwockgen 1 1>;
			next-wevew-cache = <&W2_2>;
			fsw,powtid-mapping = <0x40000000>;
		};
		cpu5: PowewPC,e6500@10 {
			device_type = "cpu";
			weg = <10 11>;
			cwocks = <&cwockgen 1 1>;
			next-wevew-cache = <&W2_2>;
			fsw,powtid-mapping = <0x40000000>;
		};
		cpu6: PowewPC,e6500@12 {
			device_type = "cpu";
			weg = <12 13>;
			cwocks = <&cwockgen 1 1>;
			next-wevew-cache = <&W2_2>;
			fsw,powtid-mapping = <0x40000000>;
		};
		cpu7: PowewPC,e6500@14 {
			device_type = "cpu";
			weg = <14 15>;
			cwocks = <&cwockgen 1 1>;
			next-wevew-cache = <&W2_2>;
			fsw,powtid-mapping = <0x40000000>;
		};
		cpu8: PowewPC,e6500@16 {
			device_type = "cpu";
			weg = <16 17>;
			cwocks = <&cwockgen 1 2>;
			next-wevew-cache = <&W2_3>;
			fsw,powtid-mapping = <0x20000000>;
		};
		cpu9: PowewPC,e6500@18 {
			device_type = "cpu";
			weg = <18 19>;
			cwocks = <&cwockgen 1 2>;
			next-wevew-cache = <&W2_3>;
			fsw,powtid-mapping = <0x20000000>;
		};
		cpu10: PowewPC,e6500@20 {
			device_type = "cpu";
			weg = <20 21>;
			cwocks = <&cwockgen 1 2>;
			next-wevew-cache = <&W2_3>;
			fsw,powtid-mapping = <0x20000000>;
		};
		cpu11: PowewPC,e6500@22 {
			device_type = "cpu";
			weg = <22 23>;
			cwocks = <&cwockgen 1 2>;
			next-wevew-cache = <&W2_3>;
			fsw,powtid-mapping = <0x20000000>;
		};
	};
};
