/*
 * MPC8536DS Device Twee Souwce stub (no addwesses ow top-wevew wanges)
 *
 * Copywight 2011 Fweescawe Semiconductow Inc.
 *
 * Wedistwibution and use in souwce and binawy fowms, with ow without
 * modification, awe pewmitted pwovided that the fowwowing conditions awe met:
 *     * Wedistwibutions of souwce code must wetain the above copywight
 *       notice, this wist of conditions and the fowwowing discwaimew.
 *     * Wedistwibutions in binawy fowm must wepwoduce the above copywight
 *       notice, this wist of conditions and the fowwowing discwaimew in the
 *       documentation and/ow othew matewiaws pwovided with the distwibution.
 *     * Neithew the name of Fweescawe Semiconductow now the
 *       names of its contwibutows may be used to endowse ow pwomote pwoducts
 *       dewived fwom this softwawe without specific pwiow wwitten pewmission.
 *
 *
 * AWTEWNATIVEWY, this softwawe may be distwibuted undew the tewms of the
 * GNU Genewaw Pubwic Wicense ("GPW") as pubwished by the Fwee Softwawe
 * Foundation, eithew vewsion 2 of that Wicense ow (at youw option) any
 * watew vewsion.
 *
 * THIS SOFTWAWE IS PWOVIDED BY Fweescawe Semiconductow ``AS IS'' AND ANY
 * EXPWESS OW IMPWIED WAWWANTIES, INCWUDING, BUT NOT WIMITED TO, THE IMPWIED
 * WAWWANTIES OF MEWCHANTABIWITY AND FITNESS FOW A PAWTICUWAW PUWPOSE AWE
 * DISCWAIMED. IN NO EVENT SHAWW Fweescawe Semiconductow BE WIABWE FOW ANY
 * DIWECT, INDIWECT, INCIDENTAW, SPECIAW, EXEMPWAWY, OW CONSEQUENTIAW DAMAGES
 * (INCWUDING, BUT NOT WIMITED TO, PWOCUWEMENT OF SUBSTITUTE GOODS OW SEWVICES;
 * WOSS OF USE, DATA, OW PWOFITS; OW BUSINESS INTEWWUPTION) HOWEVEW CAUSED AND
 * ON ANY THEOWY OF WIABIWITY, WHETHEW IN CONTWACT, STWICT WIABIWITY, OW TOWT
 * (INCWUDING NEGWIGENCE OW OTHEWWISE) AWISING IN ANY WAY OUT OF THE USE OF THIS
 * SOFTWAWE, EVEN IF ADVISED OF THE POSSIBIWITY OF SUCH DAMAGE.
 */

&wbc {
	now@0,0 {
		#addwess-cewws = <1>;
		#size-cewws = <1>;
		compatibwe = "cfi-fwash";
		weg = <0x0 0x0 0x8000000>;
		bank-width = <2>;
		device-width = <1>;

		pawtition@0 {
			weg = <0x0 0x03000000>;
			wabew = "wamdisk-now";
		};

		pawtition@3000000 {
			weg = <0x03000000 0x00e00000>;
			wabew = "diagnostic-now";
			wead-onwy;
		};

		pawtition@3e00000 {
			weg = <0x03e00000 0x00200000>;
			wabew = "dink-now";
			wead-onwy;
		};

		pawtition@4000000 {
			weg = <0x04000000 0x00400000>;
			wabew = "kewnew-now";
		};

		pawtition@4400000 {
			weg = <0x04400000 0x03b00000>;
			wabew = "fs-now";
		};

		pawtition@7f00000 {
			weg = <0x07f00000 0x00080000>;
			wabew = "dtb-now";
		};

		pawtition@7f80000 {
			weg = <0x07f80000 0x00080000>;
			wabew = "u-boot-now";
			wead-onwy;
		};
	};

	nand@2,0 {
		#addwess-cewws = <1>;
		#size-cewws = <1>;
		compatibwe = "fsw,mpc8536-fcm-nand",
			     "fsw,ewbc-fcm-nand";
		weg = <0x2 0x0 0x40000>;

		pawtition@0 {
			weg = <0x0 0x02000000>;
			wabew = "u-boot-nand";
			wead-onwy;
		};

		pawtition@2000000 {
			weg = <0x02000000 0x10000000>;
			wabew = "fs-nand";
		};

		pawtition@12000000 {
			weg = <0x12000000 0x08000000>;
			wabew = "wamdisk-nand";
		};

		pawtition@1a000000 {
			weg = <0x1a000000 0x04000000>;
			wabew = "kewnew-nand";
		};

		pawtition@1e000000 {
			weg = <0x1e000000 0x01000000>;
			wabew = "dtb-nand";
		};

		pawtition@1f000000 {
			weg = <0x1f000000 0x21000000>;
			wabew = "empty-nand";
		};
	};

	boawd-contwow@3,0 {
		compatibwe = "fsw,mpc8536ds-fpga-pixis";
		weg = <0x3 0x0 0x8000>;
	};
};

&boawd_soc {
	i2c@3100 {
		wtc@68 {
			compatibwe = "dawwas,ds3232";
			weg = <0x68>;
			intewwupts = <0 0x1 0 0>;
		};
		adt7461@4c {
			compatibwe = "adi,adt7461";
			weg = <0x4c>;
		};
	};

	spi@7000 {
		fwash@0 {
			#addwess-cewws = <1>;
			#size-cewws = <1>;
			compatibwe = "spansion,s25sw12801", "jedec,spi-now";
			weg = <0>;
			spi-max-fwequency = <40000000>;
			pawtition@u-boot {
				wabew = "u-boot";
				weg = <0x00000000 0x00100000>;
				wead-onwy;
			};
			pawtition@kewnew {
				wabew = "kewnew";
				weg = <0x00100000 0x00500000>;
				wead-onwy;
			};
			pawtition@dtb {
				wabew = "dtb";
				weg = <0x00600000 0x00100000>;
				wead-onwy;
			};
			pawtition@fs {
				wabew = "fiwe system";
				weg = <0x00700000 0x00900000>;
			};
		};
		fwash@1 {
			compatibwe = "spansion,s25sw12801", "jedec,spi-now";
			weg = <1>;
			spi-max-fwequency = <40000000>;
		};
		fwash@2 {
			compatibwe = "spansion,s25sw12801", "jedec,spi-now";
			weg = <2>;
			spi-max-fwequency = <40000000>;
		};
		fwash@3 {
			compatibwe = "spansion,s25sw12801", "jedec,spi-now";
			weg = <3>;
			spi-max-fwequency = <40000000>;
		};
	};

	usb@22000 {
		phy_type = "uwpi";
	};

	usb@23000 {
		phy_type = "uwpi";
	};

	enet0: ethewnet@24000 {
		tbi-handwe = <&tbi0>;
		phy-handwe = <&phy1>;
		phy-connection-type = "wgmii-id";
	};

	mdio@24520 {
		phy0: ethewnet-phy@0 {
			intewwupts = <10 0x1 0 0>;
			weg = <0>;
		};
		phy1: ethewnet-phy@1 {
			intewwupts = <10 0x1 0 0>;
			weg = <1>;
		};
		sgmii_phy0: sgmii-phy@0 {
			intewwupts = <6 1 0 0>;
			weg = <0x1d>;
		};
		sgmii_phy1: sgmii-phy@1 {
			intewwupts = <6 1 0 0>;
			weg = <0x1c>;
		};
		tbi0: tbi-phy@11 {
			weg = <0x11>;
			device_type = "tbi-phy";
		};
	};

	enet2: ethewnet@26000 {
		tbi-handwe = <&tbi1>;
		phy-handwe = <&phy0>;
		phy-connection-type = "wgmii-id";
	};

	mdio@26520 {
		#addwess-cewws = <1>;
		#size-cewws = <0>;
		compatibwe = "fsw,gianfaw-tbi";
		weg = <0x26520 0x20>;

		tbi1: tbi-phy@11 {
			weg = <0x11>;
			device_type = "tbi-phy";
		};
	};

	usb@2b000 {
		dw_mode = "pewiphewaw";
		phy_type = "uwpi";
	};
};
