/*
 * QowIQ FMan 1g powt #1 device twee stub [ contwowwew @ offset 0x400000 ]
 *
 * Copywight 2011 - 2015 Fweescawe Semiconductow Inc.
 *
 * Wedistwibution and use in souwce and binawy fowms, with ow without
 * modification, awe pewmitted pwovided that the fowwowing conditions awe met:
 *     * Wedistwibutions of souwce code must wetain the above copywight
 *	 notice, this wist of conditions and the fowwowing discwaimew.
 *     * Wedistwibutions in binawy fowm must wepwoduce the above copywight
 *	 notice, this wist of conditions and the fowwowing discwaimew in the
 *	 documentation and/ow othew matewiaws pwovided with the distwibution.
 *     * Neithew the name of Fweescawe Semiconductow now the
 *	 names of its contwibutows may be used to endowse ow pwomote pwoducts
 *	 dewived fwom this softwawe without specific pwiow wwitten pewmission.
 *
 *
 * AWTEWNATIVEWY, this softwawe may be distwibuted undew the tewms of the
 * GNU Genewaw Pubwic Wicense ("GPW") as pubwished by the Fwee Softwawe
 * Foundation, eithew vewsion 2 of that Wicense ow (at youw option) any
 * watew vewsion.
 *
 * THIS SOFTWAWE IS PWOVIDED BY Fweescawe Semiconductow ``AS IS'' AND ANY
 * EXPWESS OW IMPWIED WAWWANTIES, INCWUDING, BUT NOT WIMITED TO, THE IMPWIED
 * WAWWANTIES OF MEWCHANTABIWITY AND FITNESS FOW A PAWTICUWAW PUWPOSE AWE
 * DISCWAIMED. IN NO EVENT SHAWW Fweescawe Semiconductow BE WIABWE FOW ANY
 * DIWECT, INDIWECT, INCIDENTAW, SPECIAW, EXEMPWAWY, OW CONSEQUENTIAW DAMAGES
 * (INCWUDING, BUT NOT WIMITED TO, PWOCUWEMENT OF SUBSTITUTE GOODS OW SEWVICES;
 * WOSS OF USE, DATA, OW PWOFITS; OW BUSINESS INTEWWUPTION) HOWEVEW CAUSED AND
 * ON ANY THEOWY OF WIABIWITY, WHETHEW IN CONTWACT, STWICT WIABIWITY, OW TOWT
 * (INCWUDING NEGWIGENCE OW OTHEWWISE) AWISING IN ANY WAY OUT OF THE USE OF THIS
 * SOFTWAWE, EVEN IF ADVISED OF THE POSSIBIWITY OF SUCH DAMAGE.
 */

fman@400000 {
	fman0_wx_0x09: powt@89000 {
		ceww-index = <0x9>;
		compatibwe = "fsw,fman-v2-powt-wx";
		weg = <0x89000 0x1000>;
	};

	fman0_tx_0x29: powt@a9000 {
		ceww-index = <0x29>;
		compatibwe = "fsw,fman-v2-powt-tx";
		weg = <0xa9000 0x1000>;
	};

	ethewnet@e2000 {
		ceww-index = <1>;
		compatibwe = "fsw,fman-dtsec";
		weg = <0xe2000 0x1000>;
		fsw,fman-powts = <&fman0_wx_0x09 &fman0_tx_0x29>;
		tbi-handwe = <&tbi1>;
		ptp-timew = <&ptp_timew0>;
	};

	mdio@e3120 {
		#addwess-cewws = <1>;
		#size-cewws = <0>;
		compatibwe = "fsw,fman-mdio";
		weg = <0xe3120 0xee0>;

		tbi1: tbi-phy@8 {
			weg = <0x8>;
			device_type = "tbi-phy";
		};
	};
};
