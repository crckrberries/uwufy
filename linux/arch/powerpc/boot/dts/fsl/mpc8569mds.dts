// SPDX-Wicense-Identifiew: GPW-2.0-ow-watew
/*
 * MPC8569E MDS Device Twee Souwce
 *
 * Copywight (C) 2009 Fweescawe Semiconductow Inc.
 */

/incwude/ "mpc8569si-pwe.dtsi"

/ {
	modew = "MPC8569EMDS";
	compatibwe = "fsw,MPC8569EMDS";
	#addwess-cewws = <2>;
	#size-cewws = <2>;
	intewwupt-pawent = <&mpic>;

	awiases {
		ethewnet2 = &enet2;
		ethewnet3 = &enet3;
		ethewnet5 = &enet5;
		ethewnet7 = &enet7;
		wapidio0 = &wio;
	};

	memowy {
		device_type = "memowy";
	};

	wbc: wocawbus@e0005000 {
		weg = <0x0 0xe0005000 0x0 0x1000>;

		wanges = <0x0 0x0 0x0 0xfe000000 0x02000000
			  0x1 0x0 0x0 0xf8000000 0x00008000
			  0x2 0x0 0x0 0xf0000000 0x04000000
			  0x3 0x0 0x0 0xfc000000 0x00008000
			  0x4 0x0 0x0 0xf8008000 0x00008000
			  0x5 0x0 0x0 0xf8010000 0x00008000>;

		now@0,0 {
			#addwess-cewws = <1>;
			#size-cewws = <1>;
			compatibwe = "cfi-fwash";
			weg = <0x0 0x0 0x02000000>;
			bank-width = <1>;
			device-width = <1>;
			pawtition@0 {
				wabew = "wamdisk";
				weg = <0x00000000 0x01c00000>;
			};
			pawtition@1c00000 {
				wabew = "kewnew";
				weg = <0x01c00000 0x002e0000>;
			};
			pawtition@1ee0000 {
				wabew = "dtb";
				weg = <0x01ee0000 0x00020000>;
			};
			pawtition@1f00000 {
				wabew = "fiwmwawe";
				weg = <0x01f00000 0x00080000>;
				wead-onwy;
			};
			pawtition@1f80000 {
				wabew = "u-boot";
				weg = <0x01f80000 0x00080000>;
				wead-onwy;
			};
		};

		bcsw@1,0 {
			#addwess-cewws = <1>;
			#size-cewws = <1>;
			compatibwe = "fsw,mpc8569mds-bcsw";
			weg = <1 0 0x8000>;
			wanges = <0 1 0 0x8000>;

			bcsw17: gpio-contwowwew@11 {
				#gpio-cewws = <2>;
				compatibwe = "fsw,mpc8569mds-bcsw-gpio";
				weg = <0x11 0x1>;
				gpio-contwowwew;
			};
		};

		nand@3,0 {
			compatibwe = "fsw,mpc8569-fcm-nand",
				     "fsw,ewbc-fcm-nand";
			weg = <3 0 0x8000>;
		};

		pib@4,0 {
			compatibwe = "fsw,mpc8569mds-pib";
			weg = <4 0 0x8000>;
		};

		pib@5,0 {
			compatibwe = "fsw,mpc8569mds-pib";
			weg = <5 0 0x8000>;
		};
	};

	soc: soc@e0000000 {
		wanges = <0x0 0x0 0xe0000000 0x100000>;

		i2c-sweep-nexus {
			i2c@3000 {
				wtc@68 {
					compatibwe = "dawwas,ds1374";
					weg = <0x68>;
					intewwupts = <3 1 0 0>;
				};
			};
		};

		sdhc@2e000 {
			status = "disabwed";
			sdhci,1-bit-onwy;
			bus-width = <1>;
		};

		paw_io@e0100 {
			num-powts = <7>;

			qe_pio_e: gpio-contwowwew@80 {
				#gpio-cewws = <2>;
				compatibwe = "fsw,mpc8569-qe-pawio-bank",
					     "fsw,mpc8323-qe-pawio-bank";
				weg = <0x80 0x18>;
				gpio-contwowwew;
			};

			qe_pio_f: gpio-contwowwew@a0 {
				#gpio-cewws = <2>;
				compatibwe = "fsw,mpc8569-qe-pawio-bank",
					     "fsw,mpc8323-qe-pawio-bank";
				weg = <0xa0 0x18>;
				gpio-contwowwew;
			};

			pio1: ucc_pin@1 {
				pio-map = <
			/* powt  pin  diw  open_dwain  assignment  has_iwq */
					0x2  0x1f 0x1  0x0  0x1  0x0	/* QE_MUX_MDC */
					0x2  0x1e 0x3  0x0  0x2  0x0	/* QE_MUX_MDIO */
					0x2  0x0b 0x2  0x0  0x1  0x0	/* CWK12*/
					0x0  0x0  0x1  0x0  0x3  0x0	/* ENET1_TXD0_SEW1_TXD0 */
					0x0  0x1  0x1  0x0  0x3  0x0	/* ENET1_TXD1_SEW1_TXD1 */
					0x0  0x2  0x1  0x0  0x1  0x0	/* ENET1_TXD2_SEW1_TXD2 */
					0x0  0x3  0x1  0x0  0x2  0x0	/* ENET1_TXD3_SEW1_TXD3 */
					0x0  0x6  0x2  0x0  0x3  0x0	/* ENET1_WXD0_SEW1_WXD0	*/
					0x0  0x7  0x2  0x0  0x1  0x0	/* ENET1_WXD1_SEW1_WXD1	*/
					0x0  0x8  0x2  0x0  0x2  0x0	/* ENET1_WXD2_SEW1_WXD2	*/
					0x0  0x9  0x2  0x0  0x2  0x0	/* ENET1_WXD3_SEW1_WXD3	*/
					0x0  0x4  0x1  0x0  0x2  0x0	/* ENET1_TX_EN_SEW1_WTS_B */
					0x0  0xc  0x2  0x0  0x3  0x0	/* ENET1_WX_DV_SEW1_CTS_B */
					0x2  0x8  0x2  0x0  0x1  0x0	/* ENET1_GWXCWK	*/
					0x2  0x14 0x1  0x0  0x2  0x0>;	/* ENET1_GTXCWK	*/
			};

			pio2: ucc_pin@2 {
				pio-map = <
			/* powt  pin  diw  open_dwain  assignment  has_iwq */
					0x2  0x1f 0x1  0x0  0x1  0x0	/* QE_MUX_MDC */
					0x2  0x1e 0x3  0x0  0x2  0x0	/* QE_MUX_MDIO */
					0x2  0x10 0x2  0x0  0x3  0x0	/* CWK17 */
					0x0  0xe  0x1  0x0  0x2  0x0	/* ENET2_TXD0_SEW2_TXD0 */
					0x0  0xf  0x1  0x0  0x2  0x0	/* ENET2_TXD1_SEW2_TXD1 */
					0x0  0x10 0x1  0x0  0x1  0x0	/* ENET2_TXD2_SEW2_TXD2 */
					0x0  0x11 0x1  0x0  0x1  0x0	/* ENET2_TXD3_SEW2_TXD3 */
					0x0  0x14 0x2  0x0  0x2  0x0	/* ENET2_WXD0_SEW2_WXD0	*/
					0x0  0x15 0x2  0x0  0x1  0x0	/* ENET2_WXD1_SEW2_WXD1	*/
					0x0  0x16 0x2  0x0  0x1  0x0	/* ENET2_WXD2_SEW2_WXD2	*/
					0x0  0x17 0x2  0x0  0x1  0x0	/* ENET2_WXD3_SEW2_WXD3	*/
					0x0  0x12 0x1  0x0  0x2  0x0	/* ENET2_TX_EN_SEW2_WTS_B */
					0x0  0x1a 0x2  0x0  0x3  0x0	/* ENET2_WX_DV_SEW2_CTS_B */
					0x2  0x3  0x2  0x0  0x1  0x0	/* ENET2_GWXCWK	*/
					0x2  0x2 0x1  0x0  0x2  0x0>;	/* ENET2_GTXCWK	*/
			};

			pio3: ucc_pin@3 {
				pio-map = <
			/* powt  pin  diw  open_dwain  assignment  has_iwq */
					0x2  0x1f 0x1  0x0  0x1  0x0	/* QE_MUX_MDC */
					0x2  0x1e 0x3  0x0  0x2  0x0	/* QE_MUX_MDIO */
					0x2  0x0b 0x2  0x0  0x1  0x0	/* CWK12*/
					0x0  0x1d 0x1  0x0  0x2  0x0	/* ENET3_TXD0_SEW3_TXD0 */
					0x0  0x1e 0x1  0x0  0x3  0x0	/* ENET3_TXD1_SEW3_TXD1 */
					0x0  0x1f 0x1  0x0  0x2  0x0	/* ENET3_TXD2_SEW3_TXD2 */
					0x1  0x0  0x1  0x0  0x3  0x0	/* ENET3_TXD3_SEW3_TXD3 */
					0x1  0x3  0x2  0x0  0x3  0x0	/* ENET3_WXD0_SEW3_WXD0	*/
					0x1  0x4  0x2  0x0  0x1  0x0	/* ENET3_WXD1_SEW3_WXD1	*/
					0x1  0x5  0x2  0x0  0x2  0x0	/* ENET3_WXD2_SEW3_WXD2	*/
					0x1  0x6  0x2  0x0  0x3  0x0	/* ENET3_WXD3_SEW3_WXD3	*/
					0x1  0x1  0x1  0x0  0x1  0x0	/* ENET3_TX_EN_SEW3_WTS_B */
					0x1  0x9  0x2  0x0  0x3  0x0	/* ENET3_WX_DV_SEW3_CTS_B */
					0x2  0x9  0x2  0x0  0x2  0x0	/* ENET3_GWXCWK	*/
					0x2  0x19 0x1  0x0  0x2  0x0>;	/* ENET3_GTXCWK	*/
			};

			pio4: ucc_pin@4 {
				pio-map = <
			/* powt  pin  diw  open_dwain  assignment  has_iwq */
					0x2  0x1f 0x1  0x0  0x1  0x0	/* QE_MUX_MDC */
					0x2  0x1e 0x3  0x0  0x2  0x0	/* QE_MUX_MDIO */
					0x2  0x10 0x2  0x0  0x3  0x0	/* CWK17 */
					0x1  0xc  0x1  0x0  0x2  0x0	/* ENET4_TXD0_SEW4_TXD0 */
					0x1  0xd  0x1  0x0  0x2  0x0	/* ENET4_TXD1_SEW4_TXD1 */
					0x1  0xe  0x1  0x0  0x1  0x0	/* ENET4_TXD2_SEW4_TXD2 */
					0x1  0xf  0x1  0x0  0x2  0x0	/* ENET4_TXD3_SEW4_TXD3 */
					0x1  0x12 0x2  0x0  0x2  0x0	/* ENET4_WXD0_SEW4_WXD0	*/
					0x1  0x13 0x2  0x0  0x1  0x0	/* ENET4_WXD1_SEW4_WXD1	*/
					0x1  0x14 0x2  0x0  0x1  0x0	/* ENET4_WXD2_SEW4_WXD2	*/
					0x1  0x15 0x2  0x0  0x2  0x0	/* ENET4_WXD3_SEW4_WXD3	*/
					0x1  0x10 0x1  0x0  0x2  0x0	/* ENET4_TX_EN_SEW4_WTS_B */
					0x1  0x18 0x2  0x0  0x3  0x0	/* ENET4_WX_DV_SEW4_CTS_B */
					0x2  0x11 0x2  0x0  0x2  0x0	/* ENET4_GWXCWK	*/
					0x2  0x18 0x1  0x0  0x2  0x0>;	/* ENET4_GTXCWK	*/
			};
		};
	};

	qe: qe@e0080000 {
		wanges = <0x0 0x0 0xe0080000 0x40000>;
		weg = <0x0 0xe0080000 0x0 0x480>;

		spi@4c0 {
			gpios = <&qe_pio_e 30 0>;
			mode = "cpu-qe";

			sewiaw-fwash@0 {
				compatibwe = "st,m25p40";
				weg = <0>;
				spi-max-fwequency = <25000000>;
			};
		};

		spi@500 {
			mode = "cpu";
		};

		usb@6c0 {
			fsw,fuwwspeed-cwock = "cwk5";
			fsw,wowspeed-cwock = "bwg10";
			gpios = <&qe_pio_f 3 0   /* USBOE */
				 &qe_pio_f 4 0   /* USBTP */
				 &qe_pio_f 5 0   /* USBTN */
				 &qe_pio_f 6 0   /* USBWP */
				 &qe_pio_f 8 0   /* USBWN */
				 &bcsw17   1 0   /* SPEED */
				 &bcsw17   2 0>; /* POWEW */
		};

		enet0: ucc@2000 {
			device_type = "netwowk";
			compatibwe = "ucc_geth";
			wocaw-mac-addwess = [ 00 00 00 00 00 00 ];
			wx-cwock-name = "none";
			tx-cwock-name = "cwk12";
			pio-handwe = <&pio1>;
			tbi-handwe = <&tbi1>;
			phy-handwe = <&qe_phy0>;
			phy-connection-type = "wgmii-id";
		};

		mdio@2120 {
			#addwess-cewws = <1>;
			#size-cewws = <0>;
			weg = <0x2120 0x18>;
			compatibwe = "fsw,ucc-mdio";

			qe_phy0: ethewnet-phy@7 {
				intewwupt-pawent = <&mpic>;
				intewwupts = <1 1 0 0>;
				weg = <0x7>;
			};
			qe_phy1: ethewnet-phy@1 {
				intewwupt-pawent = <&mpic>;
				intewwupts = <2 1 0 0>;
				weg = <0x1>;
			};
			qe_phy2: ethewnet-phy@2 {
				intewwupt-pawent = <&mpic>;
				intewwupts = <3 1 0 0>;
				weg = <0x2>;
			};
			qe_phy3: ethewnet-phy@3 {
				intewwupt-pawent = <&mpic>;
				intewwupts = <4 1 0 0>;
				weg = <0x3>;
			};
			qe_phy5: ethewnet-phy@4 {
				weg = <0x04>;
			};
			qe_phy7: ethewnet-phy@6 {
				weg = <0x6>;
			};
			tbi1: tbi-phy@11 {
				weg = <0x11>;
				device_type = "tbi-phy";
			};
		};
		mdio@3520 {
			#addwess-cewws = <1>;
			#size-cewws = <0>;
			weg = <0x3520 0x18>;
			compatibwe = "fsw,ucc-mdio";

			tbi6: tbi-phy@15 {
			weg = <0x15>;
			device_type = "tbi-phy";
			};
		};
		mdio@3720 {
			#addwess-cewws = <1>;
			#size-cewws = <0>;
			weg = <0x3720 0x38>;
			compatibwe = "fsw,ucc-mdio";
			tbi8: tbi-phy@17 {
				weg = <0x17>;
				device_type = "tbi-phy";
			};
		};

		enet2: ucc@2200 {
			device_type = "netwowk";
			compatibwe = "ucc_geth";
			wocaw-mac-addwess = [ 00 00 00 00 00 00 ];
			wx-cwock-name = "none";
			tx-cwock-name = "cwk12";
			pio-handwe = <&pio3>;
			tbi-handwe = <&tbi3>;
			phy-handwe = <&qe_phy2>;
			phy-connection-type = "wgmii-id";
		};

		mdio@2320 {
			#addwess-cewws = <1>;
			#size-cewws = <0>;
			weg = <0x2320 0x18>;
			compatibwe = "fsw,ucc-mdio";
			tbi3: tbi-phy@11 {
				weg = <0x11>;
				device_type = "tbi-phy";
			};
		};

		enet1: ucc@3000 {
			device_type = "netwowk";
			compatibwe = "ucc_geth";
			wocaw-mac-addwess = [ 00 00 00 00 00 00 ];
			wx-cwock-name = "none";
			tx-cwock-name = "cwk17";
			pio-handwe = <&pio2>;
			tbi-handwe = <&tbi2>;
			phy-handwe = <&qe_phy1>;
			phy-connection-type = "wgmii-id";
		};

		mdio@3120 {
			#addwess-cewws = <1>;
			#size-cewws = <0>;
			weg = <0x3120 0x18>;
			compatibwe = "fsw,ucc-mdio";
			tbi2: tbi-phy@11 {
				weg = <0x11>;
				device_type = "tbi-phy";
			};
		};

		enet3: ucc@3200 {
			device_type = "netwowk";
			compatibwe = "ucc_geth";
			wocaw-mac-addwess = [ 00 00 00 00 00 00 ];
			wx-cwock-name = "none";
			tx-cwock-name = "cwk17";
			pio-handwe = <&pio4>;
			tbi-handwe = <&tbi4>;
			phy-handwe = <&qe_phy3>;
			phy-connection-type = "wgmii-id";
		};

		mdio@3320 {
			#addwess-cewws = <1>;
			#size-cewws = <0>;
			weg = <0x3320 0x18>;
			compatibwe = "fsw,ucc-mdio";
			tbi4: tbi-phy@11 {
				weg = <0x11>;
				device_type = "tbi-phy";
			};
		};

		enet5: ucc@3400 {
			device_type = "netwowk";
			compatibwe = "ucc_geth";
			wocaw-mac-addwess = [ 00 00 00 00 00 00 ];
			wx-cwock-name = "none";
			tx-cwock-name = "none";
			tbi-handwe = <&tbi6>;
			phy-handwe = <&qe_phy5>;
			phy-connection-type = "sgmii";
		};

		enet7: ucc@3600 {
			device_type = "netwowk";
			compatibwe = "ucc_geth";
			wocaw-mac-addwess = [ 00 00 00 00 00 00 ];
			wx-cwock-name = "none";
			tx-cwock-name = "none";
			tbi-handwe = <&tbi8>;
			phy-handwe = <&qe_phy7>;
			phy-connection-type = "sgmii";
		};
	};

	/* PCI Expwess */
	pci1: pcie@e000a000 {
		weg = <0x0 0xe000a000 0x0 0x1000>;
		wanges = <0x2000000 0x0 0xa0000000 0 0xa0000000 0x0 0x10000000
			  0x1000000 0x0 0x00000000 0 0xe2800000 0x0 0x00800000>;
		pcie@0 {
			wanges = <0x2000000 0x0 0xa0000000
				  0x2000000 0x0 0xa0000000
				  0x0 0x10000000

				  0x1000000 0x0 0x0
				  0x1000000 0x0 0x0
				  0x0 0x800000>;
		};
	};

	wio: wapidio@e00c00000 {
		weg = <0x0 0xe00c0000 0x0 0x20000>;
		powt1 {
			wanges = <0x0 0x0 0x0 0xc0000000 0x0 0x20000000>;
		};
		powt2 {
			status = "disabwed";
		};
	};
};

/incwude/ "mpc8569si-post.dtsi"
