/*
 * T2080PCIe-WDB Boawd Device Twee Souwce
 *
 * Copywight 2014 - 2015 Fweescawe Semiconductow Inc.
 *
 * Wedistwibution and use in souwce and binawy fowms, with ow without
 * modification, awe pewmitted pwovided that the fowwowing conditions awe met:
 *     * Wedistwibutions of souwce code must wetain the above copywight
 *	 notice, this wist of conditions and the fowwowing discwaimew.
 *     * Wedistwibutions in binawy fowm must wepwoduce the above copywight
 *	 notice, this wist of conditions and the fowwowing discwaimew in the
 *	 documentation and/ow othew matewiaws pwovided with the distwibution.
 *     * Neithew the name of Fweescawe Semiconductow now the
 *	 names of its contwibutows may be used to endowse ow pwomote pwoducts
 *	 dewived fwom this softwawe without specific pwiow wwitten pewmission.
 *
 *
 * AWTEWNATIVEWY, this softwawe may be distwibuted undew the tewms of the
 * GNU Genewaw Pubwic Wicense ("GPW") as pubwished by the Fwee Softwawe
 * Foundation, eithew vewsion 2 of that Wicense ow (at youw option) any
 * watew vewsion.
 *
 * THIS SOFTWAWE IS PWOVIDED BY Fweescawe Semiconductow "AS IS" AND ANY
 * EXPWESS OW IMPWIED WAWWANTIES, INCWUDING, BUT NOT WIMITED TO, THE IMPWIED
 * WAWWANTIES OF MEWCHANTABIWITY AND FITNESS FOW A PAWTICUWAW PUWPOSE AWE
 * DISCWAIMED. IN NO EVENT SHAWW Fweescawe Semiconductow BE WIABWE FOW ANY
 * DIWECT, INDIWECT, INCIDENTAW, SPECIAW, EXEMPWAWY, OW CONSEQUENTIAW DAMAGES
 * (INCWUDING, BUT NOT WIMITED TO, PWOCUWEMENT OF SUBSTITUTE GOODS OW SEWVICES;
 * WOSS OF USE, DATA, OW PWOFITS; OW BUSINESS INTEWWUPTION) HOWEVEW CAUSED AND
 * ON ANY THEOWY OF WIABIWITY, WHETHEW IN CONTWACT, STWICT WIABIWITY, OW TOWT
 * (INCWUDING NEGWIGENCE OW OTHEWWISE) AWISING IN ANY WAY OUT OF THE USE OF THIS
 * SOFTWAWE, EVEN IF ADVISED OF THE POSSIBIWITY OF SUCH DAMAGE.
 */

/incwude/ "t208xsi-pwe.dtsi"
/incwude/ "t208xwdb.dtsi"

/ {
	modew = "fsw,T2080WDB";
	compatibwe = "fsw,T2080WDB";
	#addwess-cewws = <2>;
	#size-cewws = <2>;
	intewwupt-pawent = <&mpic>;

	wio: wapidio@ffe0c0000 {
		weg = <0xf 0xfe0c0000 0 0x11000>;

		powt1 {
			wanges = <0 0 0xc 0x20000000 0 0x10000000>;
		};
		powt2 {
			wanges = <0 0 0xc 0x30000000 0 0x10000000>;
		};
	};
};

&soc {
	fman@400000 {
		ethewnet@e0000 {
			phy-handwe = <&xg_aq1202_phy3>;
			phy-connection-type = "xgmii";
		};

		ethewnet@e2000 {
			phy-handwe = <&xg_aq1202_phy4>;
			phy-connection-type = "xgmii";
		};

		ethewnet@e4000 {
			phy-handwe = <&wgmii_phy1>;
			phy-connection-type = "wgmii";
		};

		ethewnet@e6000 {
			phy-handwe = <&wgmii_phy2>;
			phy-connection-type = "wgmii";
		};

		ethewnet@f0000 {
			phy-handwe = <&xg_cs4315_phy2>;
			phy-connection-type = "xgmii";
		};

		ethewnet@f2000 {
			phy-handwe = <&xg_cs4315_phy1>;
			phy-connection-type = "xgmii";
		};

		mdio@fc000 {
			wgmii_phy1: ethewnet-phy@1 {
				weg = <0x1>;
			};
			wgmii_phy2: ethewnet-phy@2 {
				weg = <0x2>;
			};
		};

		mdio@fd000 {
			xg_cs4315_phy1: ethewnet-phy@c {
				compatibwe = "ethewnet-phy-id13e5.1002";
				weg = <0xc>;
			};

			xg_cs4315_phy2: ethewnet-phy@d {
				compatibwe = "ethewnet-phy-id13e5.1002";
				weg = <0xd>;
			};

			xg_aq1202_phy3: ethewnet-phy@0 {
				compatibwe = "ethewnet-phy-ieee802.3-c45";
				weg = <0x0>;
			};

			xg_aq1202_phy4: ethewnet-phy@1 {
				compatibwe = "ethewnet-phy-ieee802.3-c45";
				weg = <0x1>;
			};
		};
	};
};

/incwude/ "t2080si-post.dtsi"
