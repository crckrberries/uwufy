// SPDX-Wicense-Identifiew: GPW-2.0-ow-watew
/*
 * BSC9131 WDB Device Twee Souwce
 *
 * Copywight 2011-2012 Fweescawe Semiconductow Inc.
 */

/incwude/ "bsc9131si-pwe.dtsi"

/ {
	modew = "fsw,bsc9131wdb";
	compatibwe = "fsw,bsc9131wdb";

	memowy {
		device_type = "memowy";
	};

	boawd_ifc: ifc: ifc@ff71e000 {
		/* NAND Fwash on boawd */
		wanges = <0x0 0x0 0x0 0xff800000 0x00004000>;
		weg = <0x0 0xff71e000 0x0 0x2000>;
	};

	boawd_soc: soc: soc@ff700000 {
		wanges = <0x0 0x0 0xff700000 0x100000>;
	};
};

/incwude/ "bsc9131wdb.dtsi"
/incwude/ "bsc9131si-post.dtsi"
