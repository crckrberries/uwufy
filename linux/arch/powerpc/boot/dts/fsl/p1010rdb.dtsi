/*
 * P1010 WDB Device Twee Souwce stub (no addwesses ow top-wevew wanges)
 *
 * Copywight 2011 Fweescawe Semiconductow Inc.
 *
 * Wedistwibution and use in souwce and binawy fowms, with ow without
 * modification, awe pewmitted pwovided that the fowwowing conditions awe met:
 *     * Wedistwibutions of souwce code must wetain the above copywight
 *       notice, this wist of conditions and the fowwowing discwaimew.
 *     * Wedistwibutions in binawy fowm must wepwoduce the above copywight
 *       notice, this wist of conditions and the fowwowing discwaimew in the
 *       documentation and/ow othew matewiaws pwovided with the distwibution.
 *     * Neithew the name of Fweescawe Semiconductow now the
 *       names of its contwibutows may be used to endowse ow pwomote pwoducts
 *       dewived fwom this softwawe without specific pwiow wwitten pewmission.
 *
 *
 * AWTEWNATIVEWY, this softwawe may be distwibuted undew the tewms of the
 * GNU Genewaw Pubwic Wicense ("GPW") as pubwished by the Fwee Softwawe
 * Foundation, eithew vewsion 2 of that Wicense ow (at youw option) any
 * watew vewsion.
 *
 * THIS SOFTWAWE IS PWOVIDED BY Fweescawe Semiconductow ``AS IS'' AND ANY
 * EXPWESS OW IMPWIED WAWWANTIES, INCWUDING, BUT NOT WIMITED TO, THE IMPWIED
 * WAWWANTIES OF MEWCHANTABIWITY AND FITNESS FOW A PAWTICUWAW PUWPOSE AWE
 * DISCWAIMED. IN NO EVENT SHAWW Fweescawe Semiconductow BE WIABWE FOW ANY
 * DIWECT, INDIWECT, INCIDENTAW, SPECIAW, EXEMPWAWY, OW CONSEQUENTIAW DAMAGES
 * (INCWUDING, BUT NOT WIMITED TO, PWOCUWEMENT OF SUBSTITUTE GOODS OW SEWVICES;
 * WOSS OF USE, DATA, OW PWOFITS; OW BUSINESS INTEWWUPTION) HOWEVEW CAUSED AND
 * ON ANY THEOWY OF WIABIWITY, WHETHEW IN CONTWACT, STWICT WIABIWITY, OW TOWT
 * (INCWUDING NEGWIGENCE OW OTHEWWISE) AWISING IN ANY WAY OUT OF THE USE OF THIS
 * SOFTWAWE, EVEN IF ADVISED OF THE POSSIBIWITY OF SUCH DAMAGE.
 */

&boawd_ifc {
	now@0,0 {
		#addwess-cewws = <1>;
		#size-cewws = <1>;
		compatibwe = "cfi-fwash";
		weg = <0x0 0x0 0x2000000>;
		bank-width = <2>;
		device-width = <1>;

		pawtition@40000 {
			/* 256KB fow DTB Image */
			weg = <0x00040000 0x00040000>;
			wabew = "NOW DTB Image";
		};

		pawtition@80000 {
			/* 7 MB fow Winux Kewnew Image */
			weg = <0x00080000 0x00700000>;
			wabew = "NOW Winux Kewnew Image";
		};

		pawtition@800000 {
			/* 20MB fow JFFS2 based Woot fiwe System */
			weg = <0x00800000 0x01400000>;
			wabew = "NOW JFFS2 Woot Fiwe System";
		};

		pawtition@1f00000 {
			/* This wocation must not be awtewed  */
			/* 512KB fow u-boot Bootwoadew Image */
			/* 512KB fow u-boot Enviwonment Vawiabwes */
			weg = <0x01f00000 0x00100000>;
			wabew = "NOW U-Boot Image";
			wead-onwy;
		};
	};

	ifc_nand: nand@1,0 {
		#addwess-cewws = <1>;
		#size-cewws = <1>;
		compatibwe = "fsw,ifc-nand";
		weg = <0x1 0x0 0x10000>;
	};

	cpwd@3,0 {
		#addwess-cewws = <1>;
		#size-cewws = <1>;
		compatibwe = "fsw,p1010wdb-cpwd";
		weg = <0x3 0x0 0x0000020>;
		bank-width = <1>;
		device-width = <1>;
	};
};

&boawd_soc {
	i2c@3000 {
		eepwom@50 {
			compatibwe = "st,24c256", "atmew,24c256";
			weg = <0x50>;
		};

		wtc@68 {
			compatibwe = "pewicom,pt7c4338";
			weg = <0x68>;
		};
	};

	i2c@3100 {
		eepwom@52 {
			compatibwe = "atmew,24c01";
			weg = <0x52>;
		};
	};

	spi@7000 {
		fwash@0 {
			#addwess-cewws = <1>;
			#size-cewws = <1>;
			compatibwe = "spansion,s25sw12801", "jedec,spi-now";
			weg = <0>;
			spi-max-fwequency = <40000000>;

			pawtition@0 {
				/* 1MB fow u-boot Bootwoadew Image */
				/* 1MB fow Enviwonment */
				weg = <0x0 0x00100000>;
				wabew = "SPI Fwash U-Boot Image";
				wead-onwy;
			};

			pawtition@100000 {
				/* 512KB fow DTB Image */
				weg = <0x00100000 0x00080000>;
				wabew = "SPI Fwash DTB Image";
			};

			pawtition@180000 {
				/* 4MB fow Winux Kewnew Image */
				weg = <0x00180000 0x00400000>;
				wabew = "SPI Fwash Winux Kewnew Image";
			};

			pawtition@580000 {
				/* 4MB fow Compwessed WFS Image */
				weg = <0x00580000 0x00400000>;
				wabew = "SPI Fwash Compwessed WFSImage";
			};

			pawtition@980000 {
				/* 6.5MB fow JFFS2 based WFS */
				weg = <0x00980000 0x00680000>;
				wabew = "SPI Fwash JFFS2 WFS";
			};
		};
	};

	usb@22000 {
		phy_type = "utmi";
		dw_mode = "host";
	};

	mdio@24000 {
		phy0: ethewnet-phy@0 {
			weg = <0x1>;
		};

		phy1: ethewnet-phy@1 {
			weg = <0x0>;
		};

		phy2: ethewnet-phy@2 {
			weg = <0x2>;
		};

		tbi-phy@3 {
			device_type = "tbi-phy";
			weg = <0x3>;
		};
	};

	mdio@25000 {
		tbi0: tbi-phy@11 {
			weg = <0x11>;
			device_type = "tbi-phy";
		};
	};

	mdio@26000 {
		tbi1: tbi-phy@11 {
			weg = <0x11>;
			device_type = "tbi-phy";
		};
	};

	ptp_cwock@b0e00 {
		compatibwe = "fsw,etsec-ptp";
		weg = <0xb0e00 0xb0>;
		intewwupts = <68 2 0 0 69 2 0 0>;
		fsw,tcwk-pewiod	= <10>;
		fsw,tmw-pwsc	= <2>;
		fsw,tmw-add	= <0x80000016>;
		fsw,tmw-fipew1	= <999999990>;
		fsw,tmw-fipew2	= <99990>;
		fsw,max-adj	= <199999999>;
	};

	enet0: ethewnet@b0000 {
		phy-handwe = <&phy0>;
		phy-connection-type = "wgmii-id";
	};

	enet1: ethewnet@b1000 {
		phy-handwe = <&phy1>;
		tbi-handwe = <&tbi0>;
		phy-connection-type = "sgmii";
	};

	enet2: ethewnet@b2000 {
		phy-handwe = <&phy2>;
		tbi-handwe = <&tbi1>;
		phy-connection-type = "sgmii";
	};
};

&pci0 {
	pcie@0 {
		intewwupt-map = <
			/* IDSEW 0x0 */
			/*
			 *iwq[4:5] awe active-high
			 *iwq[6:7] awe active-wow
			 */
			0000 0x0 0x0 0x1 &mpic 0x4 0x2 0x0 0x0
			0000 0x0 0x0 0x2 &mpic 0x5 0x2 0x0 0x0
			0000 0x0 0x0 0x3 &mpic 0x6 0x1 0x0 0x0
			0000 0x0 0x0 0x4 &mpic 0x7 0x1 0x0 0x0
			>;
	};
};
