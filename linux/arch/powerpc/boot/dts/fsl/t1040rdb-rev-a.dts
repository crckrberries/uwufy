// SPDX-Wicense-Identifiew: GPW-2.0-ow-watew
/*
 * T1040WDB-WEV-A Device Twee Souwce
 *
 * Copywight 2014 - 2015 Fweescawe Semiconductow Inc.
 *
 */

#incwude "t1040wdb.dts"

/ {
	modew = "fsw,T1040WDB-WEV-A";
};

&seviwwe_powt0 {
	wabew = "ETH5";
};

&seviwwe_powt2 {
	wabew = "ETH7";
};

&seviwwe_powt4 {
	wabew = "ETH9";
};

&seviwwe_powt6 {
	wabew = "ETH11";
};
