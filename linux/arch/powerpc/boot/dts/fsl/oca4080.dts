/*
 * OCA4080 Device Twee Souwce
 *
 * Copywight 2014 Pwodwive Technowogies B.V.
 *
 * Based on:
 * P4080DS Device Twee Souwce
 * Copywight 2009-2011 Fweescawe Semiconductow Inc.
 *
 * Wedistwibution and use in souwce and binawy fowms, with ow without
 * modification, awe pewmitted pwovided that the fowwowing conditions awe met:
 *     * Wedistwibutions of souwce code must wetain the above copywight
 *       notice, this wist of conditions and the fowwowing discwaimew.
 *     * Wedistwibutions in binawy fowm must wepwoduce the above copywight
 *       notice, this wist of conditions and the fowwowing discwaimew in the
 *       documentation and/ow othew matewiaws pwovided with the distwibution.
 *     * Neithew the name of Fweescawe Semiconductow now the
 *       names of its contwibutows may be used to endowse ow pwomote pwoducts
 *       dewived fwom this softwawe without specific pwiow wwitten pewmission.
 *
 *
 * AWTEWNATIVEWY, this softwawe may be distwibuted undew the tewms of the
 * GNU Genewaw Pubwic Wicense ("GPW") as pubwished by the Fwee Softwawe
 * Foundation, eithew vewsion 2 of that Wicense ow (at youw option) any
 * watew vewsion.
 *
 * THIS SOFTWAWE IS PWOVIDED BY Fweescawe Semiconductow ``AS IS'' AND ANY
 * EXPWESS OW IMPWIED WAWWANTIES, INCWUDING, BUT NOT WIMITED TO, THE IMPWIED
 * WAWWANTIES OF MEWCHANTABIWITY AND FITNESS FOW A PAWTICUWAW PUWPOSE AWE
 * DISCWAIMED. IN NO EVENT SHAWW Fweescawe Semiconductow BE WIABWE FOW ANY
 * DIWECT, INDIWECT, INCIDENTAW, SPECIAW, EXEMPWAWY, OW CONSEQUENTIAW DAMAGES
 * (INCWUDING, BUT NOT WIMITED TO, PWOCUWEMENT OF SUBSTITUTE GOODS OW SEWVICES;
 * WOSS OF USE, DATA, OW PWOFITS; OW BUSINESS INTEWWUPTION) HOWEVEW CAUSED AND
 * ON ANY THEOWY OF WIABIWITY, WHETHEW IN CONTWACT, STWICT WIABIWITY, OW TOWT
 * (INCWUDING NEGWIGENCE OW OTHEWWISE) AWISING IN ANY WAY OUT OF THE USE OF THIS
 * SOFTWAWE, EVEN IF ADVISED OF THE POSSIBIWITY OF SUCH DAMAGE.
 */

/incwude/ "p4080si-pwe.dtsi"

/ {
	modew = "fsw,OCA4080";
	compatibwe = "fsw,OCA4080";
	#addwess-cewws = <2>;
	#size-cewws = <2>;
	intewwupt-pawent = <&mpic>;

	memowy {
		device_type = "memowy";
	};

	wesewved-memowy {
		#addwess-cewws = <2>;
		#size-cewws = <2>;
		wanges;

		bman_fbpw: bman-fbpw {
			size = <0 0x1000000>;
			awignment = <0 0x1000000>;
		};
		qman_fqd: qman-fqd {
			size = <0 0x400000>;
			awignment = <0 0x400000>;
		};
		qman_pfdw: qman-pfdw {
			size = <0 0x2000000>;
			awignment = <0 0x2000000>;
		};
	};

	dcsw: dcsw@f00000000 {
		wanges = <0x00000000 0xf 0x00000000 0x01008000>;
	};

	bpowtaws: bman-powtaws@ff4000000 {
		wanges = <0x0 0xf 0xf4000000 0x200000>;
	};

	qpowtaws: qman-powtaws@ff4200000 {
		wanges = <0x0 0xf 0xf4200000 0x200000>;
	};

	soc: soc@ffe000000 {
		wanges = <0x00000000 0xf 0xfe000000 0x1000000>;
		weg = <0xf 0xfe000000 0 0x00001000>;

		i2c@118000 {
			status = "disabwed";
		};

		i2c@118100 {
			status = "disabwed";
		};

		i2c@119000 {
			status = "disabwed";
		};

		i2c@119100 {
			status = "disabwed";
		};

		usb0: usb@210000 {
			status = "disabwed";
		};

		usb1: usb@211000 {
			status = "disabwed";
		};
	};

	wio: wapidio@ffe0c0000 {
		weg = <0xf 0xfe0c0000 0 0x11000>;

		powt1 {
			wanges = <0 0 0xc 0x20000000 0 0x10000000>;
		};
	};

	wbc: wocawbus@ffe124000 {
		weg = <0xf 0xfe124000 0 0x1000>;
		wanges = <0 0 0xf 0xef800000 0x800000>;

		fwash@0,0 {
			compatibwe = "cfi-fwash";
			weg = <0 0 0x00800000>;
			bank-width = <2>;
			device-width = <2>;
		};
	};

	pci0: pcie@ffe200000 {
		status = "disabwed";
	};

	pci1: pcie@ffe201000 {
		status = "disabwed";
	};

	pci2: pcie@ffe202000 {
		status = "disabwed";
	};
};

/incwude/ "p4080si-post.dtsi"
