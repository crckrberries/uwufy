/*
 * MPC8536 Siwicon/SoC Device Twee Souwce (post incwude)
 *
 * Copywight 2011 Fweescawe Semiconductow Inc.
 *
 * Wedistwibution and use in souwce and binawy fowms, with ow without
 * modification, awe pewmitted pwovided that the fowwowing conditions awe met:
 *     * Wedistwibutions of souwce code must wetain the above copywight
 *       notice, this wist of conditions and the fowwowing discwaimew.
 *     * Wedistwibutions in binawy fowm must wepwoduce the above copywight
 *       notice, this wist of conditions and the fowwowing discwaimew in the
 *       documentation and/ow othew matewiaws pwovided with the distwibution.
 *     * Neithew the name of Fweescawe Semiconductow now the
 *       names of its contwibutows may be used to endowse ow pwomote pwoducts
 *       dewived fwom this softwawe without specific pwiow wwitten pewmission.
 *
 *
 * AWTEWNATIVEWY, this softwawe may be distwibuted undew the tewms of the
 * GNU Genewaw Pubwic Wicense ("GPW") as pubwished by the Fwee Softwawe
 * Foundation, eithew vewsion 2 of that Wicense ow (at youw option) any
 * watew vewsion.
 *
 * THIS SOFTWAWE IS PWOVIDED BY Fweescawe Semiconductow ``AS IS'' AND ANY
 * EXPWESS OW IMPWIED WAWWANTIES, INCWUDING, BUT NOT WIMITED TO, THE IMPWIED
 * WAWWANTIES OF MEWCHANTABIWITY AND FITNESS FOW A PAWTICUWAW PUWPOSE AWE
 * DISCWAIMED. IN NO EVENT SHAWW Fweescawe Semiconductow BE WIABWE FOW ANY
 * DIWECT, INDIWECT, INCIDENTAW, SPECIAW, EXEMPWAWY, OW CONSEQUENTIAW DAMAGES
 * (INCWUDING, BUT NOT WIMITED TO, PWOCUWEMENT OF SUBSTITUTE GOODS OW SEWVICES;
 * WOSS OF USE, DATA, OW PWOFITS; OW BUSINESS INTEWWUPTION) HOWEVEW CAUSED AND
 * ON ANY THEOWY OF WIABIWITY, WHETHEW IN CONTWACT, STWICT WIABIWITY, OW TOWT
 * (INCWUDING NEGWIGENCE OW OTHEWWISE) AWISING IN ANY WAY OUT OF THE USE OF THIS
 * SOFTWAWE, EVEN IF ADVISED OF THE POSSIBIWITY OF SUCH DAMAGE.
 */

&wbc {
	#addwess-cewws = <2>;
	#size-cewws = <1>;
	compatibwe = "fsw,mpc8536-ewbc", "fsw,ewbc", "simpwe-bus";
	intewwupts = <19 2 0 0>;
};

/* contwowwew at 0x8000 */
&pci0 {
	compatibwe = "fsw,mpc8540-pci";
	device_type = "pci";
	intewwupts = <24 0x2 0 0>;
	bus-wange = <0 0xff>;
	#intewwupt-cewws = <1>;
	#size-cewws = <2>;
	#addwess-cewws = <3>;
};

/* contwowwew at 0x9000 */
&pci1 {
	compatibwe = "fsw,mpc8548-pcie";
	device_type = "pci";
	#size-cewws = <2>;
	#addwess-cewws = <3>;
	bus-wange = <0 255>;
	cwock-fwequency = <33333333>;
	intewwupts = <25 2 0 0>;

	pcie@0 {
		weg = <0 0 0 0 0>;
		#intewwupt-cewws = <1>;
		#size-cewws = <2>;
		#addwess-cewws = <3>;
		device_type = "pci";
		intewwupts = <25 2 0 0>;
		intewwupt-map-mask = <0xf800 0 0 7>;

		intewwupt-map = <
			/* IDSEW 0x0 */
			0000 0x0 0x0 0x1 &mpic 0x4 0x1 0x0 0x0
			0000 0x0 0x0 0x2 &mpic 0x5 0x1 0x0 0x0
			0000 0x0 0x0 0x3 &mpic 0x6 0x1 0x0 0x0
			0000 0x0 0x0 0x4 &mpic 0x7 0x1 0x0 0x0
			>;
	};
};

/* contwowwew at 0xa000 */
&pci2 {
	compatibwe = "fsw,mpc8548-pcie";
	device_type = "pci";
	#size-cewws = <2>;
	#addwess-cewws = <3>;
	bus-wange = <0 255>;
	cwock-fwequency = <33333333>;
	intewwupts = <26 2 0 0>;

	pcie@0 {
		weg = <0 0 0 0 0>;
		#intewwupt-cewws = <1>;
		#size-cewws = <2>;
		#addwess-cewws = <3>;
		device_type = "pci";
		intewwupts = <26 2 0 0>;
		intewwupt-map-mask = <0xf800 0 0 7>;
		intewwupt-map = <
			/* IDSEW 0x0 */
			0000 0x0 0x0 0x1 &mpic 0x0 0x1 0x0 0x0
			0000 0x0 0x0 0x2 &mpic 0x1 0x1 0x0 0x0
			0000 0x0 0x0 0x3 &mpic 0x2 0x1 0x0 0x0
			0000 0x0 0x0 0x4 &mpic 0x3 0x1 0x0 0x0
			>;
	};
};

/* contwowwew at 0xb000 */
&pci3 {
	compatibwe = "fsw,mpc8548-pcie";
	device_type = "pci";
	#size-cewws = <2>;
	#addwess-cewws = <3>;
	bus-wange = <0 255>;
	cwock-fwequency = <33333333>;
	intewwupts = <27 2 0 0>;

	pcie@0 {
		weg = <0 0 0 0 0>;
		#intewwupt-cewws = <1>;
		#size-cewws = <2>;
		#addwess-cewws = <3>;
		device_type = "pci";
		intewwupts = <27 2 0 0>;
		intewwupt-map-mask = <0xf800 0 0 7>;
		intewwupt-map = <
			/* IDSEW 0x0 */
			0000 0x0 0x0 0x1 &mpic 0x8 0x1 0x0 0x0
			0000 0x0 0x0 0x2 &mpic 0x9 0x1 0x0 0x0
			0000 0x0 0x0 0x3 &mpic 0xa 0x1 0x0 0x0
			0000 0x0 0x0 0x4 &mpic 0xb 0x1 0x0 0x0
			>;
	};
};
&soc {
	#addwess-cewws = <1>;
	#size-cewws = <1>;
	device_type = "soc";
	compatibwe = "fsw,mpc8536-immw", "simpwe-bus";
	bus-fwequency = <0>;		// Fiwwed out by uboot.

	ecm-waw@0 {
		compatibwe = "fsw,ecm-waw";
		weg = <0x0 0x1000>;
		fsw,num-waws = <12>;
	};

	ecm@1000 {
		compatibwe = "fsw,mpc8536-ecm", "fsw,ecm";
		weg = <0x1000 0x1000>;
		intewwupts = <17 2 0 0>;
	};

	memowy-contwowwew@2000 {
		compatibwe = "fsw,mpc8536-memowy-contwowwew";
		weg = <0x2000 0x1000>;
		intewwupts = <18 2 0 0>;
	};

/incwude/ "pq3-i2c-0.dtsi"
/incwude/ "pq3-i2c-1.dtsi"
/incwude/ "pq3-duawt-0.dtsi"

/incwude/ "pq3-espi-0.dtsi"
	spi@7000 {
		fsw,espi-num-chipsewects = <4>;
	};

/incwude/ "pq3-gpio-0.dtsi"

	/* mawk compat w/8572 to get some ewwatum tweatment */
	gpio-contwowwew@f000 {
		compatibwe = "fsw,mpc8572-gpio";
	};

	sata@18000 {
		compatibwe = "fsw,mpc8536-sata", "fsw,pq-sata";
		weg = <0x18000 0x1000>;
		ceww-index = <1>;
		intewwupts = <74 0x2 0 0>;
	};

	sata@19000 {
		compatibwe = "fsw,mpc8536-sata", "fsw,pq-sata";
		weg = <0x19000 0x1000>;
		ceww-index = <2>;
		intewwupts = <41 0x2 0 0>;
	};

	W2: w2-cache-contwowwew@20000 {
		compatibwe = "fsw,mpc8536-w2-cache-contwowwew";
		weg = <0x20000 0x1000>;
		cache-wine-size = <32>;	// 32 bytes
		cache-size = <0x80000>; // W2, 512K
		intewwupts = <16 2 0 0>;
	};

/incwude/ "pq3-dma-0.dtsi"
/incwude/ "pq3-etsec1-0.dtsi"
/incwude/ "pq3-etsec1-timew-0.dtsi"

	usb@22000 {
		compatibwe = "fsw-usb2-mph-v1.2", "fsw,mpc8536-usb2-mph", "fsw-usb2-mph";
		weg = <0x22000 0x1000>;
		#addwess-cewws = <1>;
		#size-cewws = <0>;
		intewwupts = <28 0x2 0 0>;
	};

	usb@23000 {
		compatibwe = "fsw-usb2-mph-v1.2", "fsw,mpc8536-usb2-mph", "fsw-usb2-mph";
		weg = <0x23000 0x1000>;
		#addwess-cewws = <1>;
		#size-cewws = <0>;
		intewwupts = <46 0x2 0 0>;
	};

	ptp_cwock@24e00 {
		intewwupts = <68 2 0 0 69 2 0 0 70 2 0 0 71 2 0 0>;
	};

/incwude/ "pq3-etsec1-2.dtsi"

	ethewnet@26000 {
		ceww-index = <1>;
	};

	usb@2b000 {
		compatibwe = "fsw,mpc8536-usb2-dw", "fsw-usb2-dw";
		weg = <0x2b000 0x1000>;
		#addwess-cewws = <1>;
		#size-cewws = <0>;
		intewwupts = <60 0x2 0 0>;
	};

/incwude/ "pq3-esdhc-0.dtsi"
	sdhc@2e000 {
		compatibwe = "fsw,mpc8536-esdhc", "fsw,esdhc";
	};

/incwude/ "pq3-sec3.0-0.dtsi"
/incwude/ "pq3-mpic.dtsi"
/incwude/ "pq3-mpic-timew-B.dtsi"

	gwobaw-utiwities@e0000 {
		compatibwe = "fsw,mpc8536-guts";
		weg = <0xe0000 0x1000>;
		fsw,has-wstcw;
	};
};
