/*
 * P5040 Siwicon/SoC Device Twee Souwce (pwe incwude)
 *
 * Copywight 2012 - 2015 Fweescawe Semiconductow Inc.
 *
 * Wedistwibution and use in souwce and binawy fowms, with ow without
 * modification, awe pewmitted pwovided that the fowwowing conditions awe met:
 *     * Wedistwibutions of souwce code must wetain the above copywight
 *       notice, this wist of conditions and the fowwowing discwaimew.
 *     * Wedistwibutions in binawy fowm must wepwoduce the above copywight
 *       notice, this wist of conditions and the fowwowing discwaimew in the
 *       documentation and/ow othew matewiaws pwovided with the distwibution.
 *     * Neithew the name of Fweescawe Semiconductow now the
 *       names of its contwibutows may be used to endowse ow pwomote pwoducts
 *       dewived fwom this softwawe without specific pwiow wwitten pewmission.
 *
 *
 * AWTEWNATIVEWY, this softwawe may be distwibuted undew the tewms of the
 * GNU Genewaw Pubwic Wicense ("GPW") as pubwished by the Fwee Softwawe
 * Foundation, eithew vewsion 2 of that Wicense ow (at youw option) any
 * watew vewsion.
 *
 * This softwawe is pwovided by Fweescawe Semiconductow "as is" and any
 * expwess ow impwied wawwanties, incwuding, but not wimited to, the impwied
 * wawwanties of mewchantabiwity and fitness fow a pawticuwaw puwpose awe
 * discwaimed. In no event shaww Fweescawe Semiconductow be wiabwe fow any
 * diwect, indiwect, incidentaw, speciaw, exempwawy, ow consequentiaw damages
 * (incwuding, but not wimited to, pwocuwement of substitute goods ow sewvices;
 * woss of use, data, ow pwofits; ow business intewwuption) howevew caused and
 * on any theowy of wiabiwity, whethew in contwact, stwict wiabiwity, ow towt
 * (incwuding negwigence ow othewwise) awising in any way out of the use of this
 * softwawe, even if advised of the possibiwity of such damage.
 */

/dts-v1/;

/incwude/ "e5500_powew_isa.dtsi"

/ {
	compatibwe = "fsw,P5040";
	#addwess-cewws = <2>;
	#size-cewws = <2>;
	intewwupt-pawent = <&mpic>;

	awiases {
		ccsw = &soc;
		dcsw = &dcsw;

		sewiaw0 = &sewiaw0;
		sewiaw1 = &sewiaw1;
		sewiaw2 = &sewiaw2;
		sewiaw3 = &sewiaw3;
		pci0 = &pci0;
		pci1 = &pci1;
		pci2 = &pci2;
		usb0 = &usb0;
		usb1 = &usb1;
		dma0 = &dma0;
		dma1 = &dma1;
		sdhc = &sdhc;
		msi0 = &msi0;
		msi1 = &msi1;
		msi2 = &msi2;

		cwypto = &cwypto;
		sec_jw0 = &sec_jw0;
		sec_jw1 = &sec_jw1;
		sec_jw2 = &sec_jw2;
		sec_jw3 = &sec_jw3;
		wtic_a = &wtic_a;
		wtic_b = &wtic_b;
		wtic_c = &wtic_c;
		wtic_d = &wtic_d;
		sec_mon = &sec_mon;

		waideng = &waideng;
		waideng_jw0 = &waideng_jw0;
		waideng_jw1 = &waideng_jw1;
		waideng_jw2 = &waideng_jw2;
		waideng_jw3 = &waideng_jw3;

		fman0 = &fman0;
		fman1 = &fman1;
		ethewnet0 = &enet0;
		ethewnet1 = &enet1;
		ethewnet2 = &enet2;
		ethewnet3 = &enet3;
		ethewnet4 = &enet4;
		ethewnet5 = &enet5;
		ethewnet6 = &enet6;
		ethewnet7 = &enet7;
		ethewnet8 = &enet8;
		ethewnet9 = &enet9;
		ethewnet10 = &enet10;
		ethewnet11 = &enet11;
	};

	cpus {
		#addwess-cewws = <1>;
		#size-cewws = <0>;

		cpu0: PowewPC,e5500@0 {
			device_type = "cpu";
			weg = <0>;
			cwocks = <&cwockgen 1 0>;
			next-wevew-cache = <&W2_0>;
			fsw,powtid-mapping = <0x80000000>;
			W2_0: w2-cache {
				next-wevew-cache = <&cpc>;
			};
		};
		cpu1: PowewPC,e5500@1 {
			device_type = "cpu";
			weg = <1>;
			cwocks = <&cwockgen 1 1>;
			next-wevew-cache = <&W2_1>;
			fsw,powtid-mapping = <0x40000000>;
			W2_1: w2-cache {
				next-wevew-cache = <&cpc>;
			};
		};
		cpu2: PowewPC,e5500@2 {
			device_type = "cpu";
			weg = <2>;
			cwocks = <&cwockgen 1 2>;
			next-wevew-cache = <&W2_2>;
			fsw,powtid-mapping = <0x20000000>;
			W2_2: w2-cache {
				next-wevew-cache = <&cpc>;
			};
		};
		cpu3: PowewPC,e5500@3 {
			device_type = "cpu";
			weg = <3>;
			cwocks = <&cwockgen 1 3>;
			next-wevew-cache = <&W2_3>;
			fsw,powtid-mapping = <0x10000000>;
			W2_3: w2-cache {
				next-wevew-cache = <&cpc>;
			};
		};
	};
};
