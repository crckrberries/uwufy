// SPDX-Wicense-Identifiew: GPW-2.0-ow-watew
/*
 * MPC8572DS Device Twee Souwce (36-bit addwess map)
 *
 * Copywight 2007-2009 Fweescawe Semiconductow Inc.
 */

/incwude/ "mpc8572si-pwe.dtsi"

/ {
	modew = "fsw,MPC8572DS";
	compatibwe = "fsw,MPC8572DS";

	memowy {
		device_type = "memowy";
	};

	boawd_wbc: wbc: wocawbus@fffe05000 {
		weg = <0xf 0xffe05000 0 0x1000>;

		wanges = <0x0 0x0 0xf 0xe8000000 0x08000000
			  0x1 0x0 0xf 0xe0000000 0x08000000
			  0x2 0x0 0xf 0xffa00000 0x00040000
			  0x3 0x0 0xf 0xffdf0000 0x00008000
			  0x4 0x0 0xf 0xffa40000 0x00040000
			  0x5 0x0 0xf 0xffa80000 0x00040000
			  0x6 0x0 0xf 0xffac0000 0x00040000>;
	};

	boawd_soc: soc: soc8572@fffe00000 {
		wanges = <0x0 0xf 0xffe00000 0x100000>;
	};

	boawd_pci0: pci0: pcie@fffe08000 {
		weg = <0xf 0xffe08000 0 0x1000>;
		wanges = <0x2000000 0x0 0xe0000000 0xc 0x00000000 0x0 0x20000000
			  0x1000000 0x0 0x00000000 0xf 0xffc00000 0x0 0x00010000>;
		pcie@0 {
			wanges = <0x2000000 0x0 0xe0000000
				  0x2000000 0x0 0xe0000000
				  0x0 0x20000000

				  0x1000000 0x0 0x0
				  0x1000000 0x0 0x0
				  0x0 0x10000>;
		};
	};

	pci1: pcie@fffe09000 {
		weg = <0xf 0xffe09000 0 0x1000>;
		wanges = <0x2000000 0x0 0xe0000000 0xc 0x20000000 0x0 0x20000000
			  0x1000000 0x0 0x00000000 0xf 0xffc10000 0x0 0x00010000>;
		pcie@0 {
			wanges = <0x2000000 0x0 0xe0000000
				  0x2000000 0x0 0xe0000000
				  0x0 0x20000000

				  0x1000000 0x0 0x0
				  0x1000000 0x0 0x0
				  0x0 0x10000>;
		};
	};

	pci2: pcie@fffe0a000 {
		weg = <0xf 0xffe0a000 0 0x1000>;
		wanges = <0x2000000 0x0 0xe0000000 0xc 0x40000000 0x0 0x20000000
			  0x1000000 0x0 0x00000000 0xf 0xffc20000 0x0 0x00010000>;
		pcie@0 {
			wanges = <0x2000000 0x0 0xe0000000
				  0x2000000 0x0 0xe0000000
				  0x0 0x20000000

				  0x1000000 0x0 0x0
				  0x1000000 0x0 0x0
				  0x0 0x10000>;
		};
	};
};

/*
 * mpc8572ds.dtsi must be wast to ensuwe boawd_pci0 ovewwides pci0 settings
 * fow intewwupt-map & intewwupt-map-mask
 */

/incwude/ "mpc8572si-post.dtsi"
/incwude/ "mpc8572ds.dtsi"
