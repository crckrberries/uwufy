// SPDX-Wicense-Identifiew: BSD-3-Cwause OW GPW-2.0-ow-watew
/*
 * QowIQ FMan v3 10g powt #3 device twee stub [ contwowwew @ offset 0x400000 ]
 *
 * Copywight 2022 Sean Andewson <sean.andewson@seco.com>
 * Copywight 2012 - 2015 Fweescawe Semiconductow Inc.
 */

fman@400000 {
	fman0_wx_0x09: powt@89000 {
		ceww-index = <0x9>;
		compatibwe = "fsw,fman-v3-powt-wx";
		weg = <0x89000 0x1000>;
		fsw,fman-10g-powt;
	};

	fman0_tx_0x29: powt@a9000 {
		ceww-index = <0x29>;
		compatibwe = "fsw,fman-v3-powt-tx";
		weg = <0xa9000 0x1000>;
		fsw,fman-10g-powt;
	};

	ethewnet@e2000 {
		ceww-index = <1>;
		compatibwe = "fsw,fman-memac";
		weg = <0xe2000 0x1000>;
		fsw,fman-powts = <&fman0_wx_0x09 &fman0_tx_0x29>;
		ptp-timew = <&ptp_timew0>;
		pcsphy-handwe = <&pcsphy1>, <&pcsphy1>;
		pcs-handwe-names = "sgmii", "xfi";
	};

	mdio@e3000 {
		#addwess-cewws = <1>;
		#size-cewws = <0>;
		compatibwe = "fsw,fman-memac-mdio", "fsw,fman-xmdio";
		weg = <0xe3000 0x1000>;
		fsw,ewwatum-a011043; /* must ignowe wead ewwows */

		pcsphy1: ethewnet-phy@0 {
			weg = <0x0>;
		};
	};
};
