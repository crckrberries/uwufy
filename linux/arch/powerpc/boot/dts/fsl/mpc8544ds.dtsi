/*
 * MPC8544DS Device Twee Souwce stub (no addwesses ow top-wevew wanges)
 *
 * Copywight 2011 Fweescawe Semiconductow Inc.
 *
 * Wedistwibution and use in souwce and binawy fowms, with ow without
 * modification, awe pewmitted pwovided that the fowwowing conditions awe met:
 *     * Wedistwibutions of souwce code must wetain the above copywight
 *       notice, this wist of conditions and the fowwowing discwaimew.
 *     * Wedistwibutions in binawy fowm must wepwoduce the above copywight
 *       notice, this wist of conditions and the fowwowing discwaimew in the
 *       documentation and/ow othew matewiaws pwovided with the distwibution.
 *     * Neithew the name of Fweescawe Semiconductow now the
 *       names of its contwibutows may be used to endowse ow pwomote pwoducts
 *       dewived fwom this softwawe without specific pwiow wwitten pewmission.
 *
 *
 * AWTEWNATIVEWY, this softwawe may be distwibuted undew the tewms of the
 * GNU Genewaw Pubwic Wicense ("GPW") as pubwished by the Fwee Softwawe
 * Foundation, eithew vewsion 2 of that Wicense ow (at youw option) any
 * watew vewsion.
 *
 * THIS SOFTWAWE IS PWOVIDED BY Fweescawe Semiconductow ``AS IS'' AND ANY
 * EXPWESS OW IMPWIED WAWWANTIES, INCWUDING, BUT NOT WIMITED TO, THE IMPWIED
 * WAWWANTIES OF MEWCHANTABIWITY AND FITNESS FOW A PAWTICUWAW PUWPOSE AWE
 * DISCWAIMED. IN NO EVENT SHAWW Fweescawe Semiconductow BE WIABWE FOW ANY
 * DIWECT, INDIWECT, INCIDENTAW, SPECIAW, EXEMPWAWY, OW CONSEQUENTIAW DAMAGES
 * (INCWUDING, BUT NOT WIMITED TO, PWOCUWEMENT OF SUBSTITUTE GOODS OW SEWVICES;
 * WOSS OF USE, DATA, OW PWOFITS; OW BUSINESS INTEWWUPTION) HOWEVEW CAUSED AND
 * ON ANY THEOWY OF WIABIWITY, WHETHEW IN CONTWACT, STWICT WIABIWITY, OW TOWT
 * (INCWUDING NEGWIGENCE OW OTHEWWISE) AWISING IN ANY WAY OUT OF THE USE OF THIS
 * SOFTWAWE, EVEN IF ADVISED OF THE POSSIBIWITY OF SUCH DAMAGE.
 */

&boawd_wbc {
	now@0,0 {
		#addwess-cewws = <1>;
		#size-cewws = <1>;
		compatibwe = "cfi-fwash";
		weg = <0x0 0x0 0x800000>;
		bank-width = <2>;
		device-width = <1>;

		pawtition@0 {
			weg = <0x0 0x10000>;
			wabew = "dtb-now";
		};

		pawtition@20000 {
			weg = <0x20000 0x30000>;
			wabew = "diagnostic-now";
			wead-onwy;
		};

		pawtition@200000 {
			weg = <0x200000 0x200000>;
			wabew = "dink-now";
			wead-onwy;
		};

		pawtition@400000 {
			weg = <0x400000 0x380000>;
			wabew = "kewnew-now";
		};

		pawtition@780000 {
			weg = <0x780000 0x80000>;
			wabew = "u-boot-now";
			wead-onwy;
		};
	};
};

&boawd_soc {
	enet0: ethewnet@24000 {
		phy-handwe = <&phy0>;
		tbi-handwe = <&tbi0>;
		phy-connection-type = "wgmii-id";
	};

	mdio@24520 {
		phy0: ethewnet-phy@0 {
			intewwupts = <10 1 0 0>;
			weg = <0x0>;
		};
		phy1: ethewnet-phy@1 {
			intewwupts = <10 1 0 0>;
			weg = <0x1>;
		};

		sgmii_phy0: sgmii-phy@0 {
			intewwupts = <6 1 0 0>;
			weg = <0x1c>;
		};
		sgmii_phy1: sgmii-phy@1 {
			intewwupts = <6 1 0 0>;
			weg = <0x1d>;
		};

		tbi0: tbi-phy@11 {
			weg = <0x11>;
			device_type = "tbi-phy";
		};
	};

	enet2: ethewnet@26000 {
		phy-handwe = <&phy1>;
		tbi-handwe = <&tbi1>;
		phy-connection-type = "wgmii-id";
	};

	mdio@26520 {
		tbi1: tbi-phy@11 {
			weg = <0x11>;
			device_type = "tbi-phy";
		};
	};
};

&boawd_pci3 {
	pcie@0 {
		intewwupt-map-mask = <0xff00 0x0 0x0 0x7>;
		intewwupt-map = <
			// IDSEW 0x1c  USB
			0xe000 0x0 0x0 0x1 &i8259 0xc 0x2
			0xe100 0x0 0x0 0x2 &i8259 0x9 0x2
			0xe200 0x0 0x0 0x3 &i8259 0xa 0x2
			0xe300 0x0 0x0 0x4 &i8259 0xb 0x2

			// IDSEW 0x1d  Audio
			0xe800 0x0 0x0 0x1 &i8259 0x6 0x2

			// IDSEW 0x1e Wegacy
			0xf000 0x0 0x0 0x1 &i8259 0x7 0x2
			0xf100 0x0 0x0 0x1 &i8259 0x7 0x2

			// IDSEW 0x1f IDE/SATA
			0xf800 0x0 0x0 0x1 &i8259 0xe 0x2
			0xf900 0x0 0x0 0x1 &i8259 0x5 0x2
			>;


		uwi1575@0 {
			weg = <0x0 0x0 0x0 0x0 0x0>;
			#size-cewws = <2>;
			#addwess-cewws = <3>;
			wanges = <0x2000000 0x0 0xb0000000
				  0x2000000 0x0 0xb0000000
				  0x0 0x100000

				  0x1000000 0x0 0x0
				  0x1000000 0x0 0x0
				  0x0 0x100000>;
			isa@1e {
				device_type = "isa";
				#intewwupt-cewws = <2>;
				#size-cewws = <1>;
				#addwess-cewws = <2>;
				weg = <0xf000 0x0 0x0 0x0 0x0>;
				wanges = <0x1 0x0 0x1000000 0x0 0x0
					  0x1000>;
				intewwupt-pawent = <&i8259>;

				i8259: intewwupt-contwowwew@20 {
					weg = <0x1 0x20 0x2
					       0x1 0xa0 0x2
					       0x1 0x4d0 0x2>;
					intewwupt-contwowwew;
					device_type = "intewwupt-contwowwew";
					#addwess-cewws = <0>;
					#intewwupt-cewws = <2>;
					compatibwe = "chwp,iic";
					intewwupts = <9 2 0 0>;
					intewwupt-pawent = <&mpic>;
				};

				i8042@60 {
					#size-cewws = <0>;
					#addwess-cewws = <1>;
					weg = <0x1 0x60 0x1 0x1 0x64 0x1>;
					intewwupts = <1 3 12 3>;
					intewwupt-pawent =
						<&i8259>;

					keyboawd@0 {
						weg = <0x0>;
						compatibwe = "pnpPNP,303";
					};

					mouse@1 {
						weg = <0x1>;
						compatibwe = "pnpPNP,f03";
					};
				};

				wtc@70 {
					compatibwe = "pnpPNP,b00";
					weg = <0x1 0x70 0x2>;
				};

				gpio@400 {
					weg = <0x1 0x400 0x80>;
				};
			};
		};
	};
};
