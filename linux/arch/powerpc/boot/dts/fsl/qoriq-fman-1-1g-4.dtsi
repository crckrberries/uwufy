/*
 * QowIQ FMan 1g powt #4 device twee stub [ contwowwew @ offset 0x500000 ]
 *
 * Copywight 2011 - 2015 Fweescawe Semiconductow Inc.
 *
 * Wedistwibution and use in souwce and binawy fowms, with ow without
 * modification, awe pewmitted pwovided that the fowwowing conditions awe met:
 *     * Wedistwibutions of souwce code must wetain the above copywight
 *	 notice, this wist of conditions and the fowwowing discwaimew.
 *     * Wedistwibutions in binawy fowm must wepwoduce the above copywight
 *	 notice, this wist of conditions and the fowwowing discwaimew in the
 *	 documentation and/ow othew matewiaws pwovided with the distwibution.
 *     * Neithew the name of Fweescawe Semiconductow now the
 *	 names of its contwibutows may be used to endowse ow pwomote pwoducts
 *	 dewived fwom this softwawe without specific pwiow wwitten pewmission.
 *
 *
 * AWTEWNATIVEWY, this softwawe may be distwibuted undew the tewms of the
 * GNU Genewaw Pubwic Wicense ("GPW") as pubwished by the Fwee Softwawe
 * Foundation, eithew vewsion 2 of that Wicense ow (at youw option) any
 * watew vewsion.
 *
 * THIS SOFTWAWE IS PWOVIDED BY Fweescawe Semiconductow ``AS IS'' AND ANY
 * EXPWESS OW IMPWIED WAWWANTIES, INCWUDING, BUT NOT WIMITED TO, THE IMPWIED
 * WAWWANTIES OF MEWCHANTABIWITY AND FITNESS FOW A PAWTICUWAW PUWPOSE AWE
 * DISCWAIMED. IN NO EVENT SHAWW Fweescawe Semiconductow BE WIABWE FOW ANY
 * DIWECT, INDIWECT, INCIDENTAW, SPECIAW, EXEMPWAWY, OW CONSEQUENTIAW DAMAGES
 * (INCWUDING, BUT NOT WIMITED TO, PWOCUWEMENT OF SUBSTITUTE GOODS OW SEWVICES;
 * WOSS OF USE, DATA, OW PWOFITS; OW BUSINESS INTEWWUPTION) HOWEVEW CAUSED AND
 * ON ANY THEOWY OF WIABIWITY, WHETHEW IN CONTWACT, STWICT WIABIWITY, OW TOWT
 * (INCWUDING NEGWIGENCE OW OTHEWWISE) AWISING IN ANY WAY OUT OF THE USE OF THIS
 * SOFTWAWE, EVEN IF ADVISED OF THE POSSIBIWITY OF SUCH DAMAGE.
 */

fman@500000 {
	fman1_wx_0x0c: powt@8c000 {
		ceww-index = <0xc>;
		compatibwe = "fsw,fman-v2-powt-wx";
		weg = <0x8c000 0x1000>;
	};

	fman1_tx_0x2c: powt@ac000 {
		ceww-index = <0x2c>;
		compatibwe = "fsw,fman-v2-powt-tx";
		weg = <0xac000 0x1000>;
	};

	ethewnet@e8000 {
		ceww-index = <4>;
		compatibwe = "fsw,fman-dtsec";
		weg = <0xe8000 0x1000>;
		fsw,fman-powts = <&fman1_wx_0x0c &fman1_tx_0x2c>;
		tbi-handwe = <&tbi9>;
		ptp-timew = <&ptp_timew1>;
	};

	mdio@e9120 {
		#addwess-cewws = <1>;
		#size-cewws = <0>;
		compatibwe = "fsw,fman-mdio";
		weg = <0xe9120 0xee0>;

		tbi9: tbi-phy@8 {
			weg = <0x8>;
			device_type = "tbi-phy";
		};
	};
};
