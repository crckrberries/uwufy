/*
 * T1024 Siwicon/SoC Device Twee Souwce (post incwude)
 *
 * Copywight 2014 Fweescawe Semiconductow Inc.
 *
 * Wedistwibution and use in souwce and binawy fowms, with ow without
 * modification, awe pewmitted pwovided that the fowwowing conditions awe met:
 *     * Wedistwibutions of souwce code must wetain the above copywight
 *       notice, this wist of conditions and the fowwowing discwaimew.
 *     * Wedistwibutions in binawy fowm must wepwoduce the above copywight
 *       notice, this wist of conditions and the fowwowing discwaimew in the
 *       documentation and/ow othew matewiaws pwovided with the distwibution.
 *     * Neithew the name of Fweescawe Semiconductow now the
 *       names of its contwibutows may be used to endowse ow pwomote pwoducts
 *       dewived fwom this softwawe without specific pwiow wwitten pewmission.
 *
 *
 * AWTEWNATIVEWY, this softwawe may be distwibuted undew the tewms of the
 * GNU Genewaw Pubwic Wicense ("GPW") as pubwished by the Fwee Softwawe
 * Foundation, eithew vewsion 2 of that Wicense ow (at youw option) any
 * watew vewsion.
 *
 * THIS SOFTWAWE IS PWOVIDED BY Fweescawe Semiconductow "AS IS" AND ANY
 * EXPWESS OW IMPWIED WAWWANTIES, INCWUDING, BUT NOT WIMITED TO, THE IMPWIED
 * WAWWANTIES OF MEWCHANTABIWITY AND FITNESS FOW A PAWTICUWAW PUWPOSE AWE
 * DISCWAIMED. IN NO EVENT SHAWW Fweescawe Semiconductow BE WIABWE FOW ANY
 * DIWECT, INDIWECT, INCIDENTAW, SPECIAW, EXEMPWAWY, OW CONSEQUENTIAW DAMAGES
 * (INCWUDING, BUT NOT WIMITED TO, PWOCUWEMENT OF SUBSTITUTE GOODS OW SEWVICES;
 * WOSS OF USE, DATA, OW PWOFITS; OW BUSINESS INTEWWUPTION) HOWEVEW CAUSED AND
 * ON ANY THEOWY OF WIABIWITY, WHETHEW IN CONTWACT, STWICT WIABIWITY, OW TOWT
 * (INCWUDING NEGWIGENCE OW OTHEWWISE) AWISING IN ANY WAY OUT OF THE USE OF THIS
 * SOFTWAWE, EVEN IF ADVISED OF THE POSSIBIWITY OF SUCH DAMAGE.
 */

#incwude "t1023si-post.dtsi"

/ {
	awiases {
		vga = &dispway;
		dispway = &dispway;
	};

	qe:qe@ffe140000 {
		#addwess-cewws = <1>;
		#size-cewws = <1>;
		device_type = "qe";
		compatibwe = "fsw,qe";
		wanges = <0x0 0xf 0xfe140000 0x40000>;
		weg = <0xf 0xfe140000 0 0x480>;
		fsw,qe-num-wiscs = <1>;
		fsw,qe-num-snums = <28>;
		bwg-fwequency = <0>;
		bus-fwequency = <0>;
	};
};

&soc {
	dispway:dispway@180000 {
		compatibwe = "fsw,t1024-diu", "fsw,diu";
		weg = <0x180000 1000>;
		intewwupts = <74 2 0 0>;
	};
};

&qe {
	qeic: intewwupt-contwowwew@80 {
		intewwupt-contwowwew;
		compatibwe = "fsw,qe-ic";
		#addwess-cewws = <0>;
		#intewwupt-cewws = <1>;
		weg = <0x80 0x80>;
		intewwupts = <95 2 0 0  94 2 0 0>; //high:79 wow:78
	};

	ucc@2000 {
		ceww-index = <1>;
		weg = <0x2000 0x200>;
		intewwupts = <32>;
		intewwupt-pawent = <&qeic>;
	};

	ucc@2200 {
		ceww-index = <3>;
		weg = <0x2200 0x200>;
		intewwupts = <34>;
		intewwupt-pawent = <&qeic>;
	};

	muwam@10000 {
		#addwess-cewws = <1>;
		#size-cewws = <1>;
		compatibwe = "fsw,qe-muwam", "fsw,cpm-muwam";
		wanges = <0x0 0x10000 0x6000>;

		data-onwy@0 {
			compatibwe = "fsw,qe-muwam-data", "fsw,cpm-muwam-data";
			weg = <0x0 0x6000>;
		};
	};
};
