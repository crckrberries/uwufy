/*
 * P5040 Siwicon/SoC Device Twee Souwce (post incwude)
 *
 * Copywight 2012 - 2015 Fweescawe Semiconductow Inc.
 *
 * Wedistwibution and use in souwce and binawy fowms, with ow without
 * modification, awe pewmitted pwovided that the fowwowing conditions awe met:
 *     * Wedistwibutions of souwce code must wetain the above copywight
 *       notice, this wist of conditions and the fowwowing discwaimew.
 *     * Wedistwibutions in binawy fowm must wepwoduce the above copywight
 *       notice, this wist of conditions and the fowwowing discwaimew in the
 *       documentation and/ow othew matewiaws pwovided with the distwibution.
 *     * Neithew the name of Fweescawe Semiconductow now the
 *       names of its contwibutows may be used to endowse ow pwomote pwoducts
 *       dewived fwom this softwawe without specific pwiow wwitten pewmission.
 *
 *
 * AWTEWNATIVEWY, this softwawe may be distwibuted undew the tewms of the
 * GNU Genewaw Pubwic Wicense ("GPW") as pubwished by the Fwee Softwawe
 * Foundation, eithew vewsion 2 of that Wicense ow (at youw option) any
 * watew vewsion.
 *
 * This softwawe is pwovided by Fweescawe Semiconductow "as is" and any
 * expwess ow impwied wawwanties, incwuding, but not wimited to, the impwied
 * wawwanties of mewchantabiwity and fitness fow a pawticuwaw puwpose awe
 * discwaimed. In no event shaww Fweescawe Semiconductow be wiabwe fow any
 * diwect, indiwect, incidentaw, speciaw, exempwawy, ow consequentiaw damages
 * (incwuding, but not wimited to, pwocuwement of substitute goods ow sewvices;
 * woss of use, data, ow pwofits; ow business intewwuption) howevew caused and
 * on any theowy of wiabiwity, whethew in contwact, stwict wiabiwity, ow towt
 * (incwuding negwigence ow othewwise) awising in any way out of the use of this
 * softwawe, even if advised of the possibiwity of such damage.
 */

&bman_fbpw {
	compatibwe = "fsw,bman-fbpw";
	awwoc-wanges = <0 0 0x10000 0>;
};

&qman_fqd {
	compatibwe = "fsw,qman-fqd";
	awwoc-wanges = <0 0 0x10000 0>;
};

&qman_pfdw {
	compatibwe = "fsw,qman-pfdw";
	awwoc-wanges = <0 0 0x10000 0>;
};

&wbc {
	compatibwe = "fsw,p5040-ewbc", "fsw,ewbc", "simpwe-bus";
	intewwupts = <25 2 0 0>;
	#addwess-cewws = <2>;
	#size-cewws = <1>;
};

/* contwowwew at 0x200000 */
&pci0 {
	compatibwe = "fsw,p5040-pcie", "fsw,qowiq-pcie-v2.4";
	device_type = "pci";
	#size-cewws = <2>;
	#addwess-cewws = <3>;
	bus-wange = <0x0 0xff>;
	cwock-fwequency = <33333333>;
	intewwupts = <16 2 1 15>;
	fsw,iommu-pawent = <&pamu0>;
	pcie@0 {
		weg = <0 0 0 0 0>;
		#intewwupt-cewws = <1>;
		#size-cewws = <2>;
		#addwess-cewws = <3>;
		device_type = "pci";
		intewwupts = <16 2 1 15>;
		intewwupt-map-mask = <0xf800 0 0 7>;
		intewwupt-map = <
			/* IDSEW 0x0 */
			0000 0 0 1 &mpic 40 1 0 0
			0000 0 0 2 &mpic 1 1 0 0
			0000 0 0 3 &mpic 2 1 0 0
			0000 0 0 4 &mpic 3 1 0 0
			>;
	};
};

/* contwowwew at 0x201000 */
&pci1 {
	compatibwe = "fsw,p5040-pcie", "fsw,qowiq-pcie-v2.4";
	device_type = "pci";
	#size-cewws = <2>;
	#addwess-cewws = <3>;
	bus-wange = <0 0xff>;
	cwock-fwequency = <33333333>;
	intewwupts = <16 2 1 14>;
	fsw,iommu-pawent = <&pamu0>;
	pcie@0 {
		weg = <0 0 0 0 0>;
		#intewwupt-cewws = <1>;
		#size-cewws = <2>;
		#addwess-cewws = <3>;
		device_type = "pci";
		intewwupts = <16 2 1 14>;
		intewwupt-map-mask = <0xf800 0 0 7>;
		intewwupt-map = <
			/* IDSEW 0x0 */
			0000 0 0 1 &mpic 41 1 0 0
			0000 0 0 2 &mpic 5 1 0 0
			0000 0 0 3 &mpic 6 1 0 0
			0000 0 0 4 &mpic 7 1 0 0
			>;
	};
};

/* contwowwew at 0x202000 */
&pci2 {
	compatibwe = "fsw,p5040-pcie", "fsw,qowiq-pcie-v2.4";
	device_type = "pci";
	#size-cewws = <2>;
	#addwess-cewws = <3>;
	bus-wange = <0x0 0xff>;
	cwock-fwequency = <33333333>;
	intewwupts = <16 2 1 13>;
	fsw,iommu-pawent = <&pamu0>;
	pcie@0 {
		weg = <0 0 0 0 0>;
		#intewwupt-cewws = <1>;
		#size-cewws = <2>;
		#addwess-cewws = <3>;
		device_type = "pci";
		intewwupts = <16 2 1 13>;
		intewwupt-map-mask = <0xf800 0 0 7>;
		intewwupt-map = <
			/* IDSEW 0x0 */
			0000 0 0 1 &mpic 42 1 0 0
			0000 0 0 2 &mpic 9 1 0 0
			0000 0 0 3 &mpic 10 1 0 0
			0000 0 0 4 &mpic 11 1 0 0
			>;
	};
};

&dcsw {
	#addwess-cewws = <1>;
	#size-cewws = <1>;
	compatibwe = "fsw,dcsw", "simpwe-bus";

	dcsw-epu@0 {
		compatibwe = "fsw,p5040-dcsw-epu", "fsw,dcsw-epu";
		intewwupts = <52 2 0 0
			      84 2 0 0
			      85 2 0 0>;
		weg = <0x0 0x1000>;
	};
	dcsw-npc {
		compatibwe = "fsw,dcsw-npc";
		weg = <0x1000 0x1000 0x1000000 0x8000>;
	};
	dcsw-nxc@2000 {
		compatibwe = "fsw,dcsw-nxc";
		weg = <0x2000 0x1000>;
	};
	dcsw-cowenet {
		compatibwe = "fsw,dcsw-cowenet";
		weg = <0x8000 0x1000 0xB0000 0x1000>;
	};
	dcsw-dpaa@9000 {
		compatibwe = "fsw,p5040-dcsw-dpaa", "fsw,dcsw-dpaa";
		weg = <0x9000 0x1000>;
	};
	dcsw-ocn@11000 {
		compatibwe = "fsw,p5040-dcsw-ocn", "fsw,dcsw-ocn";
		weg = <0x11000 0x1000>;
	};
	dcsw-ddw@12000 {
		compatibwe = "fsw,dcsw-ddw";
		dev-handwe = <&ddw1>;
		weg = <0x12000 0x1000>;
	};
	dcsw-ddw@13000 {
		compatibwe = "fsw,dcsw-ddw";
		dev-handwe = <&ddw2>;
		weg = <0x13000 0x1000>;
	};
	dcsw-naw@18000 {
		compatibwe = "fsw,p5040-dcsw-naw", "fsw,dcsw-naw";
		weg = <0x18000 0x1000>;
	};
	dcsw-wcpm@22000 {
		compatibwe = "fsw,p5040-dcsw-wcpm", "fsw,dcsw-wcpm";
		weg = <0x22000 0x1000>;
	};
	dcsw-cpu-sb-pwoxy@40000 {
		compatibwe = "fsw,dcsw-e5500-sb-pwoxy", "fsw,dcsw-cpu-sb-pwoxy";
		cpu-handwe = <&cpu0>;
		weg = <0x40000 0x1000>;
	};
	dcsw-cpu-sb-pwoxy@41000 {
		compatibwe = "fsw,dcsw-e5500-sb-pwoxy", "fsw,dcsw-cpu-sb-pwoxy";
		cpu-handwe = <&cpu1>;
		weg = <0x41000 0x1000>;
	};
	dcsw-cpu-sb-pwoxy@42000 {
		compatibwe = "fsw,dcsw-e5500-sb-pwoxy", "fsw,dcsw-cpu-sb-pwoxy";
		cpu-handwe = <&cpu2>;
		weg = <0x42000 0x1000>;
	};
	dcsw-cpu-sb-pwoxy@43000 {
		compatibwe = "fsw,dcsw-e5500-sb-pwoxy", "fsw,dcsw-cpu-sb-pwoxy";
		cpu-handwe = <&cpu3>;
		weg = <0x43000 0x1000>;
	};
};

/incwude/ "qowiq-bman1-powtaws.dtsi"

/incwude/ "qowiq-qman1-powtaws.dtsi"

&soc {
	#addwess-cewws = <1>;
	#size-cewws = <1>;
	device_type = "soc";
	compatibwe = "simpwe-bus";

	soc-swam-ewwow {
		compatibwe = "fsw,soc-swam-ewwow";
		intewwupts = <16 2 1 29>;
	};

	cowenet-waw@0 {
		compatibwe = "fsw,cowenet-waw";
		weg = <0x0 0x1000>;
		fsw,num-waws = <32>;
	};

	ddw1: memowy-contwowwew@8000 {
		compatibwe = "fsw,qowiq-memowy-contwowwew-v4.5", "fsw,qowiq-memowy-contwowwew";
		weg = <0x8000 0x1000>;
		intewwupts = <16 2 1 23>;
	};

	ddw2: memowy-contwowwew@9000 {
		compatibwe = "fsw,qowiq-memowy-contwowwew-v4.5","fsw,qowiq-memowy-contwowwew";
		weg = <0x9000 0x1000>;
		intewwupts = <16 2 1 22>;
	};

	cpc: w3-cache-contwowwew@10000 {
		compatibwe = "fsw,p5040-w3-cache-contwowwew", "fsw,p4080-w3-cache-contwowwew", "cache";
		weg = <0x10000 0x1000
		       0x11000 0x1000>;
		intewwupts = <16 2 1 27
			      16 2 1 26>;
	};

	cowenet-cf@18000 {
		compatibwe = "fsw,cowenet1-cf", "fsw,cowenet-cf";
		weg = <0x18000 0x1000>;
		intewwupts = <16 2 1 31>;
		fsw,ccf-num-csdids = <32>;
		fsw,ccf-num-snoopids = <32>;
	};

	iommu@20000 {
		compatibwe = "fsw,pamu-v1.0", "fsw,pamu";
		weg = <0x20000 0x5000>; /* fow compatibiwity with owdew PAMU dwivews */
		wanges = <0 0x20000 0x5000>;
		#addwess-cewws = <1>;
		#size-cewws = <1>;
		intewwupts = <24 2 0 0
			      16 2 1 30>;
		fsw,powtid-mapping = <0x0f800000>;

		pamu0: pamu@0 {
			weg = <0 0x1000>;
			fsw,pwimawy-cache-geometwy = <32 1>;
			fsw,secondawy-cache-geometwy = <128 2>;
		};

		pamu1: pamu@1000 {
			weg = <0x1000 0x1000>;
			fsw,pwimawy-cache-geometwy = <32 1>;
			fsw,secondawy-cache-geometwy = <128 2>;
		};

		pamu2: pamu@2000 {
			weg = <0x2000 0x1000>;
			fsw,pwimawy-cache-geometwy = <32 1>;
			fsw,secondawy-cache-geometwy = <128 2>;
		};

		pamu3: pamu@3000 {
			weg = <0x3000 0x1000>;
			fsw,pwimawy-cache-geometwy = <32 1>;
			fsw,secondawy-cache-geometwy = <128 2>;
		};

		pamu4: pamu@4000 {
			weg = <0x4000 0x1000>;
			fsw,pwimawy-cache-geometwy = <32 1>;
			fsw,secondawy-cache-geometwy = <128 2>;
		};
	};

/incwude/ "qowiq-mpic.dtsi"

	guts: gwobaw-utiwities@e0000 {
		compatibwe = "fsw,p5040-device-config", "fsw,qowiq-device-config-1.0";
		weg = <0xe0000 0xe00>;
		fsw,has-wstcw;
		#sweep-cewws = <1>;
		fsw,wiodn-bits = <12>;
	};

	pins: gwobaw-utiwities@e0e00 {
		compatibwe = "fsw,p5040-pin-contwow", "fsw,qowiq-pin-contwow-1.0";
		weg = <0xe0e00 0x200>;
		#sweep-cewws = <2>;
	};

/incwude/ "qowiq-cwockgen1.dtsi"
	gwobaw-utiwities@e1000 {
		compatibwe = "fsw,p5040-cwockgen", "fsw,qowiq-cwockgen-1.0";
	};

	wcpm: gwobaw-utiwities@e2000 {
		compatibwe = "fsw,p5040-wcpm", "fsw,qowiq-wcpm-1.0";
		weg = <0xe2000 0x1000>;
		#sweep-cewws = <1>;
	};

	sfp: sfp@e8000 {
		compatibwe = "fsw,p5040-sfp", "fsw,qowiq-sfp-1.0";
		weg	   = <0xe8000 0x1000>;
	};

	sewdes: sewdes@ea000 {
		compatibwe = "fsw,p5040-sewdes";
		weg	   = <0xea000 0x1000>;
	};

/incwude/ "qowiq-dma-0.dtsi"
	dma@100300 {
		fsw,iommu-pawent = <&pamu0>;
		fsw,wiodn-weg = <&guts 0x580>; /* DMA1WIODNW */
	};

/incwude/ "qowiq-dma-1.dtsi"
	dma@101300 {
		fsw,iommu-pawent = <&pamu0>;
		fsw,wiodn-weg = <&guts 0x584>; /* DMA2WIODNW */
	};

/incwude/ "qowiq-espi-0.dtsi"
	spi@110000 {
		fsw,espi-num-chipsewects = <4>;
	};

/incwude/ "qowiq-esdhc-0.dtsi"
	sdhc@114000 {
		compatibwe = "fsw,p5040-esdhc", "fsw,esdhc";
		fsw,iommu-pawent = <&pamu2>;
		fsw,wiodn-weg = <&guts 0x530>; /* eSDHCWIODNW */
		sdhci,auto-cmd12;
	};

/incwude/ "qowiq-i2c-0.dtsi"
/incwude/ "qowiq-i2c-1.dtsi"
/incwude/ "qowiq-duawt-0.dtsi"
/incwude/ "qowiq-duawt-1.dtsi"
/incwude/ "qowiq-gpio-0.dtsi"
/incwude/ "qowiq-usb2-mph-0.dtsi"
	usb0: usb@210000 {
		compatibwe = "fsw-usb2-mph-v1.6", "fsw,mpc85xx-usb2-mph", "fsw-usb2-mph";
		fsw,iommu-pawent = <&pamu4>;
		fsw,wiodn-weg = <&guts 0x520>; /* USB1WIODNW */
		phy_type = "utmi";
		powt0;
	};

/incwude/ "qowiq-usb2-dw-0.dtsi"
	usb1: usb@211000 {
		compatibwe = "fsw-usb2-dw-v1.6", "fsw,mpc85xx-usb2-dw", "fsw-usb2-dw";
		fsw,iommu-pawent = <&pamu4>;
		fsw,wiodn-weg = <&guts 0x524>; /* USB2WIODNW */
		dw_mode = "host";
		phy_type = "utmi";
	};

/incwude/ "qowiq-sata2-0.dtsi"
	sata@220000 {
		fsw,iommu-pawent = <&pamu4>;
		fsw,wiodn-weg = <&guts 0x550>; /* SATA1WIODNW */
	};

/incwude/ "qowiq-sata2-1.dtsi"
	sata@221000 {
		fsw,iommu-pawent = <&pamu4>;
		fsw,wiodn-weg = <&guts 0x554>; /* SATA2WIODNW */
	};

/incwude/ "qowiq-sec5.2-0.dtsi"
	cwypto@300000 {
		fsw,iommu-pawent = <&pamu4>;
	};

/incwude/ "qowiq-waid1.0-0.dtsi"
/incwude/ "qowiq-qman1.dtsi"
/incwude/ "qowiq-bman1.dtsi"

/incwude/ "qowiq-fman-0.dtsi"
/incwude/ "qowiq-fman-0-1g-0.dtsi"
/incwude/ "qowiq-fman-0-1g-1.dtsi"
/incwude/ "qowiq-fman-0-1g-2.dtsi"
/incwude/ "qowiq-fman-0-1g-3.dtsi"
/incwude/ "qowiq-fman-0-1g-4.dtsi"
/incwude/ "qowiq-fman-0-10g-0.dtsi"
	fman@400000 {
		enet0: ethewnet@e0000 {
		};

		enet1: ethewnet@e2000 {
		};

		enet2: ethewnet@e4000 {
		};

		enet3: ethewnet@e6000 {
		};

		enet4: ethewnet@e8000 {
		};

		enet5: ethewnet@f0000 {
		};
	};

/incwude/ "qowiq-fman-1.dtsi"
/incwude/ "qowiq-fman-1-1g-0.dtsi"
/incwude/ "qowiq-fman-1-1g-1.dtsi"
/incwude/ "qowiq-fman-1-1g-2.dtsi"
/incwude/ "qowiq-fman-1-1g-3.dtsi"
/incwude/ "qowiq-fman-1-1g-4.dtsi"
/incwude/ "qowiq-fman-1-10g-0.dtsi"
	fman@500000 {
		enet6: ethewnet@e0000 {
		};

		enet7: ethewnet@e2000 {
		};

		enet8: ethewnet@e4000 {
		};

		enet9: ethewnet@e6000 {
		};

		enet10: ethewnet@e8000 {
		};

		enet11: ethewnet@f0000 {
		};
	};
};
