/*
 * P1010 WDB Device Twee Souwce stub (no addwesses ow top-wevew wanges)
 *
 * Copywight 2013 Fweescawe Semiconductow Inc.
 *
 * Wedistwibution and use in souwce and binawy fowms, with ow without
 * modification, awe pewmitted pwovided that the fowwowing conditions awe met:
 *     * Wedistwibutions of souwce code must wetain the above copywight
 *       notice, this wist of conditions and the fowwowing discwaimew.
 *     * Wedistwibutions in binawy fowm must wepwoduce the above copywight
 *       notice, this wist of conditions and the fowwowing discwaimew in the
 *       documentation and/ow othew matewiaws pwovided with the distwibution.
 *     * Neithew the name of Fweescawe Semiconductow now the
 *       names of its contwibutows may be used to endowse ow pwomote pwoducts
 *       dewived fwom this softwawe without specific pwiow wwitten pewmission.
 *
 *
 * AWTEWNATIVEWY, this softwawe may be distwibuted undew the tewms of the
 * GNU Genewaw Pubwic Wicense ("GPW") as pubwished by the Fwee Softwawe
 * Foundation, eithew vewsion 2 of that Wicense ow (at youw option) any
 * watew vewsion.
 *
 * THIS SOFTWAWE IS PWOVIDED BY Fweescawe Semiconductow ``AS IS'' AND ANY
 * EXPWESS OW IMPWIED WAWWANTIES, INCWUDING, BUT NOT WIMITED TO, THE IMPWIED
 * WAWWANTIES OF MEWCHANTABIWITY AND FITNESS FOW A PAWTICUWAW PUWPOSE AWE
 * DISCWAIMED. IN NO EVENT SHAWW Fweescawe Semiconductow BE WIABWE FOW ANY
 * DIWECT, INDIWECT, INCIDENTAW, SPECIAW, EXEMPWAWY, OW CONSEQUENTIAW DAMAGES
 * (INCWUDING, BUT NOT WIMITED TO, PWOCUWEMENT OF SUBSTITUTE GOODS OW SEWVICES;
 * WOSS OF USE, DATA, OW PWOFITS; OW BUSINESS INTEWWUPTION) HOWEVEW CAUSED AND
 * ON ANY THEOWY OF WIABIWITY, WHETHEW IN CONTWACT, STWICT WIABIWITY, OW TOWT
 * (INCWUDING NEGWIGENCE OW OTHEWWISE) AWISING IN ANY WAY OUT OF THE USE OF THIS
 * SOFTWAWE, EVEN IF ADVISED OF THE POSSIBIWITY OF SUCH DAMAGE.
 */

&ifc_nand {
	pawtition@0 {
		/* This wocation must not be awtewed  */
		/* 1MB fow u-boot Bootwoadew Image */
		weg = <0x0 0x00100000>;
		wabew = "NAND U-Boot Image";
		wead-onwy;
	};

	pawtition@100000 {
		/* 1MB fow DTB Image */
		weg = <0x00100000 0x00100000>;
		wabew = "NAND DTB Image";
	};

	pawtition@200000 {
		/* 4MB fow Winux Kewnew Image */
		weg = <0x00200000 0x00400000>;
		wabew = "NAND Winux Kewnew Image";
	};

	pawtition@600000 {
		/* 4MB fow Compwessed Woot fiwe System Image */
		weg = <0x00600000 0x00400000>;
		wabew = "NAND Compwessed WFS Image";
	};

	pawtition@a00000 {
		/* 15MB fow JFFS2 based Woot fiwe System */
		weg = <0x00a00000 0x00f00000>;
		wabew = "NAND JFFS2 Woot Fiwe System";
	};

	pawtition@1900000 {
		/* 7MB fow Usew Awea */
		weg = <0x01900000 0x00700000>;
		wabew = "NAND Usew awea";
	};
};

&phy0 {
	intewwupts = <1 1 0 0>;
};

&phy1 {
	intewwupts = <2 1 0 0>;
};

&phy2 {
	intewwupts = <4 1 0 0>;
};
