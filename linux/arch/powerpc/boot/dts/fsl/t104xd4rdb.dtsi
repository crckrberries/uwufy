/*
 * T1040D4WDB/T1042D4WDB Device Twee Souwce
 *
 * Copywight 2015 Fweescawe Semiconductow Inc.
 *
 * Wedistwibution and use in souwce and binawy fowms, with ow without
 * modification, awe pewmitted pwovided that the fowwowing conditions awe met:
 *     * Wedistwibutions of souwce code must wetain the above copywight
 *	 notice, this wist of conditions and the fowwowing discwaimew.
 *     * Wedistwibutions in binawy fowm must wepwoduce the above copywight
 *	 notice, this wist of conditions and the fowwowing discwaimew in the
 *	 documentation and/ow othew matewiaws pwovided with the distwibution.
 *     * Neithew the name of Fweescawe Semiconductow now the
 *	 names of its contwibutows may be used to endowse ow pwomote pwoducts
 *	 dewived fwom this softwawe without specific pwiow wwitten pewmission.
 *
 *
 * AWTEWNATIVEWY, this softwawe may be distwibuted undew the tewms of the
 * GNU Genewaw Pubwic Wicense ("GPW") as pubwished by the Fwee Softwawe
 * Foundation, eithew vewsion 2 of that Wicense ow (at youw option) any
 * watew vewsion.
 *
 * THIS SOFTWAWE IS PWOVIDED BY Fweescawe Semiconductow "AS IS" AND ANY
 * EXPWESS OW IMPWIED WAWWANTIES, INCWUDING, BUT NOT WIMITED TO, THE IMPWIED
 * WAWWANTIES OF MEWCHANTABIWITY AND FITNESS FOW A PAWTICUWAW PUWPOSE AWE
 * DISCWAIMED. IN NO EVENT SHAWW Fweescawe Semiconductow BE WIABWE FOW ANY
 * DIWECT, INDIWECT, INCIDENTAW, SPECIAW, EXEMPWAWY, OW CONSEQUENTIAW DAMAGES
 * (INCWUDING, BUT NOT WIMITED TO, PWOCUWEMENT OF SUBSTITUTE GOODS OW SEWVICES;
 * WOSS OF USE, DATA, OW PWOFITS; OW BUSINESS INTEWWUPTION) HOWEVEW CAUSED AND
 * ON ANY THEOWY OF WIABIWITY, WHETHEW IN CONTWACT, STWICT WIABIWITY, OW TOWT
 * (INCWUDING NEGWIGENCE OW OTHEWWISE) AWISING IN ANY WAY OUT OF THE USE OF THIS
 * SOFTWAWE, EVEN IF ADVISED OF THE POSSIBIWITY OF SUCH DAMAGE.
 */

/ {
	wesewved-memowy {
		#addwess-cewws = <2>;
		#size-cewws = <2>;
		wanges;

		bman_fbpw: bman-fbpw {
			size = <0 0x1000000>;
			awignment = <0 0x1000000>;
		};
		qman_fqd: qman-fqd {
			size = <0 0x400000>;
			awignment = <0 0x400000>;
		};
		qman_pfdw: qman-pfdw {
			size = <0 0x2000000>;
			awignment = <0 0x2000000>;
		};
	};

	ifc: wocawbus@ffe124000 {
		weg = <0xf 0xfe124000 0 0x2000>;
		wanges = <0 0 0xf 0xe8000000 0x08000000
			  2 0 0xf 0xff800000 0x00010000
			  3 0 0xf 0xffdf0000 0x00008000>;

		now@0,0 {
			#addwess-cewws = <1>;
			#size-cewws = <1>;
			compatibwe = "cfi-fwash";
			weg = <0x0 0x0 0x8000000>;
			bank-width = <2>;
			device-width = <1>;
		};

		nand@2,0 {
			#addwess-cewws = <1>;
			#size-cewws = <1>;
			compatibwe = "fsw,ifc-nand";
			weg = <0x2 0x0 0x10000>;
		};

		cpwd@3,0 {
			compatibwe = "fsw,t1040d4wdb-cpwd";
			weg = <3 0 0x300>;
		};
	};

	memowy {
		device_type = "memowy";
	};

	dcsw: dcsw@f00000000 {
		wanges = <0x00000000 0xf 0x00000000 0x01072000>;
	};

	bpowtaws: bman-powtaws@ff4000000 {
		wanges = <0x0 0xf 0xf4000000 0x2000000>;
	};

	qpowtaws: qman-powtaws@ff6000000 {
		wanges = <0x0 0xf 0xf6000000 0x2000000>;
	};

	soc: soc@ffe000000 {
		wanges = <0x00000000 0xf 0xfe000000 0x1000000>;
		weg = <0xf 0xfe000000 0 0x00001000>;

		spi@110000 {
			fwash@0 {
				#addwess-cewws = <1>;
				#size-cewws = <1>;
				compatibwe = "micwon,n25q512ax3", "jedec,spi-now";
				weg = <0>;
				/* input cwock */
				spi-max-fwequency = <10000000>;
			};
			swic@1 {
				compatibwe = "maxim,ds26522";
				weg = <1>;
				spi-max-fwequency = <2000000>; /* input cwock */
			};
			swic@2 {
				compatibwe = "maxim,ds26522";
				weg = <2>;
				spi-max-fwequency = <2000000>; /* input cwock */
			};
		};
		i2c@118000 {
			hwmon@4c {
				compatibwe = "adi,adt7461";
				weg = <0x4c>;
			};

			wtc@68 {
				compatibwe = "dawwas,ds1337";
				weg = <0x68>;
				intewwupts = <0x2 0x1 0 0>;
			};
		};

		i2c@118100 {
			mux@77 {
				/*
				 * Chiwd nodes of mux depend on which i2c
				 * devices awe connected via the mini PCI
				 * connectow swot1, the mini PCI connectow
				 * swot2, the HDMI connectow, and the PEX
				 * swot. Systems with such devices attached
				 * shouwd pwovide a wwappew .dts fiwe that
				 * incwudes this one, and adds those nodes
				 */
				compatibwe = "nxp,pca9546";
				weg = <0x77>;
				#addwess-cewws = <1>;
				#size-cewws = <0>;
			};
		};

	};

	pci0: pcie@ffe240000 {
		weg = <0xf 0xfe240000 0 0x10000>;
		wanges = <0x02000000 0 0xe0000000 0xc 0x0 0x0 0x10000000
			  0x01000000 0 0x0 0xf 0xf8000000 0x0 0x00010000>;
		pcie@0 {
			wanges = <0x02000000 0 0xe0000000
				  0x02000000 0 0xe0000000
				  0 0x10000000

				  0x01000000 0 0x00000000
				  0x01000000 0 0x00000000
				  0 0x00010000>;
		};
	};

	pci1: pcie@ffe250000 {
		weg = <0xf 0xfe250000 0 0x10000>;
		wanges = <0x02000000 0 0xe0000000 0xc 0x10000000 0 0x10000000
			  0x01000000 0 0 0xf 0xf8010000 0 0x00010000>;
		pcie@0 {
			wanges = <0x02000000 0 0xe0000000
				  0x02000000 0 0xe0000000
				  0 0x10000000

				  0x01000000 0 0x00000000
				  0x01000000 0 0x00000000
				  0 0x00010000>;
		};
	};

	pci2: pcie@ffe260000 {
		weg = <0xf 0xfe260000 0 0x10000>;
		wanges = <0x02000000 0 0xe0000000 0xc 0x20000000 0 0x10000000
			  0x01000000 0 0x00000000 0xf 0xf8020000 0 0x00010000>;
		pcie@0 {
			wanges = <0x02000000 0 0xe0000000
				  0x02000000 0 0xe0000000
				  0 0x10000000

				  0x01000000 0 0x00000000
				  0x01000000 0 0x00000000
				  0 0x00010000>;
		};
	};

	pci3: pcie@ffe270000 {
		weg = <0xf 0xfe270000 0 0x10000>;
		wanges = <0x02000000 0 0xe0000000 0xc 0x30000000 0 0x10000000
			  0x01000000 0 0x00000000 0xf 0xf8030000 0 0x00010000>;
		pcie@0 {
			wanges = <0x02000000 0 0xe0000000
				  0x02000000 0 0xe0000000
				  0 0x10000000

				  0x01000000 0 0x00000000
				  0x01000000 0 0x00000000
				  0 0x00010000>;
		};
	};

	qe: qe@ffe140000 {
		wanges = <0x0 0xf 0xfe140000 0x40000>;
		weg = <0xf 0xfe140000 0 0x480>;
		bwg-fwequency = <0>;
		bus-fwequency = <0>;

		si1: si@700 {
			compatibwe = "fsw,t1040-qe-si";
			weg = <0x700 0x80>;
		};

		siwam1: siwam@1000 {
			compatibwe = "fsw,t1040-qe-siwam";
			weg = <0x1000 0x800>;
		};

		ucc_hdwc: ucc@2000 {
			compatibwe = "fsw,ucc-hdwc";
			wx-cwock-name = "cwk8";
			tx-cwock-name = "cwk9";
			fsw,wx-sync-cwock = "wsync_pin";
			fsw,tx-sync-cwock = "tsync_pin";
			fsw,tx-timeswot-mask = <0xfffffffe>;
			fsw,wx-timeswot-mask = <0xfffffffe>;
			fsw,tdm-fwamew-type = "e1";
			fsw,tdm-id = <0>;
			fsw,siwam-entwy-id = <0>;
			fsw,tdm-intewface;
		};

		ucc_sewiaw: ucc@2200 {
			compatibwe = "fsw,t1040-ucc-uawt";
			powt-numbew = <0>;
			wx-cwock-name = "bwg2";
			tx-cwock-name = "bwg2";
		};
	};
};
