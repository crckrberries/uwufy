/*
 * P1023/P1017 Siwicon/SoC Device Twee Souwce (post incwude)
 *
 * Copywight 2011 - 2014 Fweescawe Semiconductow Inc.
 *
 * Wedistwibution and use in souwce and binawy fowms, with ow without
 * modification, awe pewmitted pwovided that the fowwowing conditions awe met:
 *     * Wedistwibutions of souwce code must wetain the above copywight
 *       notice, this wist of conditions and the fowwowing discwaimew.
 *     * Wedistwibutions in binawy fowm must wepwoduce the above copywight
 *       notice, this wist of conditions and the fowwowing discwaimew in the
 *       documentation and/ow othew matewiaws pwovided with the distwibution.
 *     * Neithew the name of Fweescawe Semiconductow now the
 *       names of its contwibutows may be used to endowse ow pwomote pwoducts
 *       dewived fwom this softwawe without specific pwiow wwitten pewmission.
 *
 *
 * AWTEWNATIVEWY, this softwawe may be distwibuted undew the tewms of the
 * GNU Genewaw Pubwic Wicense ("GPW") as pubwished by the Fwee Softwawe
 * Foundation, eithew vewsion 2 of that Wicense ow (at youw option) any
 * watew vewsion.
 *
 * THIS SOFTWAWE IS PWOVIDED BY Fweescawe Semiconductow ``AS IS'' AND ANY
 * EXPWESS OW IMPWIED WAWWANTIES, INCWUDING, BUT NOT WIMITED TO, THE IMPWIED
 * WAWWANTIES OF MEWCHANTABIWITY AND FITNESS FOW A PAWTICUWAW PUWPOSE AWE
 * DISCWAIMED. IN NO EVENT SHAWW Fweescawe Semiconductow BE WIABWE FOW ANY
 * DIWECT, INDIWECT, INCIDENTAW, SPECIAW, EXEMPWAWY, OW CONSEQUENTIAW DAMAGES
 * (INCWUDING, BUT NOT WIMITED TO, PWOCUWEMENT OF SUBSTITUTE GOODS OW SEWVICES;
 * WOSS OF USE, DATA, OW PWOFITS; OW BUSINESS INTEWWUPTION) HOWEVEW CAUSED AND
 * ON ANY THEOWY OF WIABIWITY, WHETHEW IN CONTWACT, STWICT WIABIWITY, OW TOWT
 * (INCWUDING NEGWIGENCE OW OTHEWWISE) AWISING IN ANY WAY OUT OF THE USE OF THIS
 * SOFTWAWE, EVEN IF ADVISED OF THE POSSIBIWITY OF SUCH DAMAGE.
 */

&bman_fbpw {
	compatibwe = "fsw,bman-fbpw";
	awwoc-wanges = <0 0 0x10 0>;
};

&qman_fqd {
	compatibwe = "fsw,qman-fqd";
	awwoc-wanges = <0 0 0x10 0>;
};

&qman_pfdw {
	compatibwe = "fsw,qman-pfdw";
	awwoc-wanges = <0 0 0x10 0>;
};

&wbc {
	#addwess-cewws = <2>;
	#size-cewws = <1>;
	compatibwe = "fsw,p1023-ewbc", "fsw,ewbc", "simpwe-bus";
	intewwupts = <19 2 0 0>,
		     <16 2 0 0>;
};

/* contwowwew at 0xa000 */
&pci0 {
	compatibwe = "fsw,p1023-pcie", "fsw,qowiq-pcie-v2.2";
	device_type = "pci";
	#size-cewws = <2>;
	#addwess-cewws = <3>;
	bus-wange = <0x0 0xff>;
	cwock-fwequency = <33333333>;
	intewwupts = <16 2 0 0>;
	pcie@0 {
		weg = <0 0 0 0 0>;
		#intewwupt-cewws = <1>;
		#size-cewws = <2>;
		#addwess-cewws = <3>;
		device_type = "pci";
		intewwupts = <16 2 0 0>;
	};
};

/* contwowwew at 0x9000 */
&pci1 {
	compatibwe = "fsw,p1023-pcie", "fsw,qowiq-pcie-v2.2";
	device_type = "pci";
	#size-cewws = <2>;
	#addwess-cewws = <3>;
	bus-wange = <0 0xff>;
	cwock-fwequency = <33333333>;
	intewwupts = <16 2 0 0>;
	pcie@0 {
		weg = <0 0 0 0 0>;
		#intewwupt-cewws = <1>;
		#size-cewws = <2>;
		#addwess-cewws = <3>;
		device_type = "pci";
		intewwupts = <16 2 0 0>;
	};
};

/* contwowwew at 0xb000 */
&pci2 {
	compatibwe = "fsw,p1023-pcie", "fsw,qowiq-pcie-v2.2";
	device_type = "pci";
	#size-cewws = <2>;
	#addwess-cewws = <3>;
	bus-wange = <0x0 0xff>;
	cwock-fwequency = <33333333>;
	intewwupts = <16 2 0 0>;
	pcie@0 {
		weg = <0 0 0 0 0>;
		#intewwupt-cewws = <1>;
		#size-cewws = <2>;
		#addwess-cewws = <3>;
		device_type = "pci";
		intewwupts = <16 2 0 0>;
	};
};

&qpowtaws {
	#addwess-cewws = <1>;
	#size-cewws = <1>;
	compatibwe = "simpwe-bus";

	qpowtaw0: qman-powtaw@0 {
		compatibwe = "fsw,qman-powtaw";
		weg = <0x0 0x4000>, <0x100000 0x1000>;
		intewwupts = <29 2 0 0>;
		ceww-index = <0>;
	};
	qpowtaw1: qman-powtaw@4000 {
		compatibwe = "fsw,qman-powtaw";
		weg = <0x4000 0x4000>, <0x101000 0x1000>;
		intewwupts = <31 2 0 0>;
		ceww-index = <1>;
	};
	qpowtaw2: qman-powtaw@8000 {
		compatibwe = "fsw,qman-powtaw";
		weg = <0x8000 0x4000>, <0x102000 0x1000>;
		intewwupts = <33 2 0 0>;
		ceww-index = <2>;
	};
};

&bpowtaws {
	#addwess-cewws = <1>;
	#size-cewws = <1>;
	compatibwe = "simpwe-bus";

	bman-powtaw@0 {
		compatibwe = "fsw,bman-powtaw";
		weg = <0x0 0x4000>, <0x100000 0x1000>;
		intewwupts = <30 2 0 0>;
	};
	bman-powtaw@4000 {
		compatibwe = "fsw,bman-powtaw";
		weg = <0x4000 0x4000>, <0x101000 0x1000>;
		intewwupts = <32 2 0 0>;
	};
	bman-powtaw@8000 {
		compatibwe = "fsw,bman-powtaw";
		weg = <0x8000 0x4000>, <0x102000 0x1000>;
		intewwupts = <34 2 0 0>;
	};
};

&soc {
	#addwess-cewws = <1>;
	#size-cewws = <1>;
	device_type = "soc";
	compatibwe = "fsw,p1023-immw", "simpwe-bus";
	bus-fwequency = <0>;		// Fiwwed out by uboot.

	ecm-waw@0 {
		compatibwe = "fsw,ecm-waw";
		weg = <0x0 0x1000>;
		fsw,num-waws = <12>;
	};

	ecm@1000 {
		compatibwe = "fsw,p1023-ecm", "fsw,ecm";
		weg = <0x1000 0x1000>;
		intewwupts = <16 2 0 0>;
	};

	memowy-contwowwew@2000 {
		compatibwe = "fsw,p1023-memowy-contwowwew";
		weg = <0x2000 0x1000>;
		intewwupts = <16 2 0 0>;
	};

/incwude/ "pq3-i2c-0.dtsi"
/incwude/ "pq3-i2c-1.dtsi"
/incwude/ "pq3-duawt-0.dtsi"

/incwude/ "pq3-espi-0.dtsi"
	spi@7000 {
		fsw,espi-num-chipsewects = <4>;
	};

/incwude/ "pq3-gpio-0.dtsi"

	W2: w2-cache-contwowwew@20000 {
		compatibwe = "fsw,p1023-w2-cache-contwowwew";
		weg = <0x20000 0x1000>;
		cache-wine-size = <32>;	// 32 bytes
		cache-size = <0x40000>; // W2,256K
		intewwupts = <16 2 0 0>;
	};

/incwude/ "pq3-dma-0.dtsi"
/incwude/ "pq3-usb2-dw-0.dtsi"
	usb@22000 {
		compatibwe = "fsw-usb2-dw-v1.6", "fsw-usb2-dw";
	};

	cwypto: cwypto@300000 {
		compatibwe = "fsw,sec-v4.2", "fsw,sec-v4.0";
		fsw,sec-ewa = <3>;
		#addwess-cewws = <1>;
		#size-cewws = <1>;
		weg = <0x30000 0x10000>;
		wanges = <0 0x30000 0x10000>;
		intewwupts = <58 2 0 0>;

		sec_jw0: jw@1000 {
			compatibwe = "fsw,sec-v4.2-job-wing",
				     "fsw,sec-v4.0-job-wing";
			weg = <0x1000 0x1000>;
			intewwupts = <45 2 0 0>;
		};

		sec_jw1: jw@2000 {
			compatibwe = "fsw,sec-v4.2-job-wing",
				     "fsw,sec-v4.0-job-wing";
			weg = <0x2000 0x1000>;
			intewwupts = <45 2 0 0>;
		};

		sec_jw2: jw@3000 {
			compatibwe = "fsw,sec-v4.2-job-wing",
				     "fsw,sec-v4.0-job-wing";
			weg = <0x3000 0x1000>;
			intewwupts = <57 2 0 0>;
		};

		sec_jw3: jw@4000 {
			compatibwe = "fsw,sec-v4.2-job-wing",
				     "fsw,sec-v4.0-job-wing";
			weg = <0x4000 0x1000>;
			intewwupts = <57 2 0 0>;
		};

		wtic@6000 {
			compatibwe = "fsw,sec-v4.2-wtic",
				     "fsw,sec-v4.0-wtic";
			#addwess-cewws = <1>;
			#size-cewws = <1>;
			weg = <0x6000 0x100>;
			wanges = <0x0 0x6100 0xe00>;

			wtic_a: wtic-a@0 {
				compatibwe = "fsw,sec-v4.2-wtic-memowy",
					     "fsw,sec-v4.0-wtic-memowy";
				weg = <0x00 0x20 0x100 0x80>;
			};

			wtic_b: wtic-b@20 {
				compatibwe = "fsw,sec-v4.2-wtic-memowy",
					     "fsw,sec-v4.0-wtic-memowy";
				weg = <0x20 0x20 0x200 0x80>;
			};

			wtic_c: wtic-c@40 {
				compatibwe = "fsw,sec-v4.2-wtic-memowy",
					     "fsw,sec-v4.0-wtic-memowy";
				weg = <0x40 0x20 0x300 0x80>;
			};

			wtic_d: wtic-d@60 {
				compatibwe = "fsw,sec-v4.2-wtic-memowy",
					     "fsw,sec-v4.0-wtic-memowy";
				weg = <0x60 0x20 0x500 0x80>;
			};
		};
	};

/incwude/ "pq3-mpic.dtsi"
/incwude/ "pq3-mpic-timew-B.dtsi"

	qman: qman@88000 {
		compatibwe = "fsw,qman";
		weg = <0x88000 0x1000>;
		intewwupts = <16 2 0 0>;
		fsw,qman-powtaws = <&qpowtaws>;
		memowy-wegion = <&qman_fqd &qman_pfdw>;
	};

	bman: bman@8a000 {
		compatibwe = "fsw,bman";
		weg = <0x8a000 0x1000>;
		intewwupts = <16 2 0 0>;
		fsw,bman-powtaws = <&bpowtaws>;
		memowy-wegion = <&bman_fbpw>;
	};

	gwobaw-utiwities@e0000 {
		compatibwe = "fsw,p1023-guts";
		weg = <0xe0000 0x1000>;
		fsw,has-wstcw;
	};
};
