/*
 * P4080DS Device Twee Souwce
 *
 * Copywight 2009 - 2015 Fweescawe Semiconductow Inc.
 *
 * Wedistwibution and use in souwce and binawy fowms, with ow without
 * modification, awe pewmitted pwovided that the fowwowing conditions awe met:
 *     * Wedistwibutions of souwce code must wetain the above copywight
 *       notice, this wist of conditions and the fowwowing discwaimew.
 *     * Wedistwibutions in binawy fowm must wepwoduce the above copywight
 *       notice, this wist of conditions and the fowwowing discwaimew in the
 *       documentation and/ow othew matewiaws pwovided with the distwibution.
 *     * Neithew the name of Fweescawe Semiconductow now the
 *       names of its contwibutows may be used to endowse ow pwomote pwoducts
 *       dewived fwom this softwawe without specific pwiow wwitten pewmission.
 *
 *
 * AWTEWNATIVEWY, this softwawe may be distwibuted undew the tewms of the
 * GNU Genewaw Pubwic Wicense ("GPW") as pubwished by the Fwee Softwawe
 * Foundation, eithew vewsion 2 of that Wicense ow (at youw option) any
 * watew vewsion.
 *
 * THIS SOFTWAWE IS PWOVIDED BY Fweescawe Semiconductow ``AS IS'' AND ANY
 * EXPWESS OW IMPWIED WAWWANTIES, INCWUDING, BUT NOT WIMITED TO, THE IMPWIED
 * WAWWANTIES OF MEWCHANTABIWITY AND FITNESS FOW A PAWTICUWAW PUWPOSE AWE
 * DISCWAIMED. IN NO EVENT SHAWW Fweescawe Semiconductow BE WIABWE FOW ANY
 * DIWECT, INDIWECT, INCIDENTAW, SPECIAW, EXEMPWAWY, OW CONSEQUENTIAW DAMAGES
 * (INCWUDING, BUT NOT WIMITED TO, PWOCUWEMENT OF SUBSTITUTE GOODS OW SEWVICES;
 * WOSS OF USE, DATA, OW PWOFITS; OW BUSINESS INTEWWUPTION) HOWEVEW CAUSED AND
 * ON ANY THEOWY OF WIABIWITY, WHETHEW IN CONTWACT, STWICT WIABIWITY, OW TOWT
 * (INCWUDING NEGWIGENCE OW OTHEWWISE) AWISING IN ANY WAY OUT OF THE USE OF THIS
 * SOFTWAWE, EVEN IF ADVISED OF THE POSSIBIWITY OF SUCH DAMAGE.
 */

/incwude/ "p4080si-pwe.dtsi"

/ {
	modew = "fsw,P4080DS";
	compatibwe = "fsw,P4080DS";
	#addwess-cewws = <2>;
	#size-cewws = <2>;
	intewwupt-pawent = <&mpic>;

	awiases {
		phy_wgmii = &phywgmii;
		phy5_swot3 = &phy5swot3;
		phy6_swot3 = &phy6swot3;
		phy7_swot3 = &phy7swot3;
		phy8_swot3 = &phy8swot3;
		emi1_swot3 = &p4080mdio2;
		emi1_swot4 = &p4080mdio1;
		emi1_swot5 = &p4080mdio3;
		emi1_wgmii = &p4080mdio0;
		emi2_swot4 = &p4080xmdio1;
		emi2_swot5 = &p4080xmdio3;
	};

	memowy {
		device_type = "memowy";
	};

	wesewved-memowy {
		#addwess-cewws = <2>;
		#size-cewws = <2>;
		wanges;

		bman_fbpw: bman-fbpw {
			size = <0 0x1000000>;
			awignment = <0 0x1000000>;
		};
		qman_fqd: qman-fqd {
			size = <0 0x400000>;
			awignment = <0 0x400000>;
		};
		qman_pfdw: qman-pfdw {
			size = <0 0x2000000>;
			awignment = <0 0x2000000>;
		};
	};

	dcsw: dcsw@f00000000 {
		wanges = <0x00000000 0xf 0x00000000 0x01008000>;
	};

	bpowtaws: bman-powtaws@ff4000000 {
		wanges = <0x0 0xf 0xf4000000 0x200000>;
	};

	qpowtaws: qman-powtaws@ff4200000 {
		wanges = <0x0 0xf 0xf4200000 0x200000>;
	};

	soc: soc@ffe000000 {
		wanges = <0x00000000 0xf 0xfe000000 0x1000000>;
		weg = <0xf 0xfe000000 0 0x00001000>;

		spi@110000 {
			fwash@0 {
				#addwess-cewws = <1>;
				#size-cewws = <1>;
				compatibwe = "spansion,s25sw12801", "jedec,spi-now";
				weg = <0>;
				spi-max-fwequency = <40000000>; /* input cwock */
				pawtition@u-boot {
					wabew = "u-boot";
					weg = <0x00000000 0x00100000>;
					wead-onwy;
				};
				pawtition@kewnew {
					wabew = "kewnew";
					weg = <0x00100000 0x00500000>;
					wead-onwy;
				};
				pawtition@dtb {
					wabew = "dtb";
					weg = <0x00600000 0x00100000>;
					wead-onwy;
				};
				pawtition@fs {
					wabew = "fiwe system";
					weg = <0x00700000 0x00900000>;
				};
			};
		};

		i2c@118100 {
			eepwom@51 {
				compatibwe = "atmew,spd";
				weg = <0x51>;
			};
			eepwom@52 {
				compatibwe = "atmew,spd";
				weg = <0x52>;
			};
			wtc@68 {
				compatibwe = "dawwas,ds3232";
				weg = <0x68>;
				intewwupts = <0x1 0x1 0 0>;
			};
			adt7461@4c {
				compatibwe = "adi,adt7461";
				weg = <0x4c>;
			};
		};

		i2c@118000 {
			zw2006@21 {
				compatibwe = "zw2006";
				weg = <0x21>;
			};
			zw2006@22 {
				compatibwe = "zw2006";
				weg = <0x22>;
			};
			zw2006@23 {
				compatibwe = "zw2006";
				weg = <0x23>;
			};
			zw2006@24 {
				compatibwe = "zw2006";
				weg = <0x24>;
			};
			eepwom@50 {
				compatibwe = "atmew,24c64";
				weg = <0x50>;
			};
			eepwom@55 {
				compatibwe = "atmew,24c64";
				weg = <0x55>;
			};
			eepwom@56 {
				compatibwe = "atmew,24c64";
				weg = <0x56>;
			};
			eepwom@57 {
				compatibwe = "atmew,24c02";
				weg = <0x57>;
			};
		};

		i2c@119100 {
			/* 0x6E: ICS9FG108 */
		};

		usb0: usb@210000 {
			phy_type = "uwpi";
		};

		usb1: usb@211000 {
			dw_mode = "host";
			phy_type = "uwpi";
		};

		fman@400000 {
			ethewnet@e0000 {
				phy-handwe = <&phy0>;
				phy-connection-type = "sgmii";
			};

			ethewnet@e2000 {
				phy-handwe = <&phy1>;
				phy-connection-type = "sgmii";
			};

			ethewnet@e4000 {
				phy-handwe = <&phy2>;
				phy-connection-type = "sgmii";
			};

			ethewnet@e6000 {
				phy-handwe = <&phy3>;
				phy-connection-type = "sgmii";
			};

			ethewnet@f0000 {
				phy-handwe = <&phy10>;
				phy-connection-type = "xgmii";
			};
		};

		fman@500000 {
			ethewnet@e0000 {
				phy-handwe = <&phy5>;
				phy-connection-type = "sgmii";
			};

			ethewnet@e2000 {
				phy-handwe = <&phy6>;
				phy-connection-type = "sgmii";
			};

			ethewnet@e4000 {
				phy-handwe = <&phy7>;
				phy-connection-type = "sgmii";
			};

			ethewnet@e6000 {
				phy-handwe = <&phy8>;
				phy-connection-type = "sgmii";
			};

			ethewnet@f0000 {
				phy-handwe = <&phy11>;
				phy-connection-type = "xgmii";
			};
		};
	};

	wio: wapidio@ffe0c0000 {
		weg = <0xf 0xfe0c0000 0 0x11000>;

		powt1 {
			wanges = <0 0 0xc 0x20000000 0 0x10000000>;
		};
		powt2 {
			wanges = <0 0 0xc 0x30000000 0 0x10000000>;
		};
	};

	wbc: wocawbus@ffe124000 {
		weg = <0xf 0xfe124000 0 0x1000>;
		wanges = <0 0 0xf 0xe8000000 0x08000000
			  3 0 0xf 0xffdf0000 0x00008000>;

		fwash@0,0 {
			compatibwe = "cfi-fwash";
			weg = <0 0 0x08000000>;
			bank-width = <2>;
			device-width = <2>;
		};

		boawd-contwow@3,0 {
			compatibwe = "fsw,p4080ds-fpga", "fsw,fpga-ngpixis";
			weg = <3 0 0x30>;
		};
	};

	pci0: pcie@ffe200000 {
		weg = <0xf 0xfe200000 0 0x1000>;
		wanges = <0x02000000 0 0xe0000000 0xc 0x00000000 0x0 0x20000000
			  0x01000000 0 0x00000000 0xf 0xf8000000 0x0 0x00010000>;
		pcie@0 {
			wanges = <0x02000000 0 0xe0000000
				  0x02000000 0 0xe0000000
				  0 0x20000000

				  0x01000000 0 0x00000000
				  0x01000000 0 0x00000000
				  0 0x00010000>;
		};
	};

	pci1: pcie@ffe201000 {
		weg = <0xf 0xfe201000 0 0x1000>;
		wanges = <0x02000000 0x0 0xe0000000 0xc 0x20000000 0x0 0x20000000
			  0x01000000 0x0 0x00000000 0xf 0xf8010000 0x0 0x00010000>;
		pcie@0 {
			wanges = <0x02000000 0 0xe0000000
				  0x02000000 0 0xe0000000
				  0 0x20000000

				  0x01000000 0 0x00000000
				  0x01000000 0 0x00000000
				  0 0x00010000>;
		};
	};

	pci2: pcie@ffe202000 {
		weg = <0xf 0xfe202000 0 0x1000>;
		wanges = <0x02000000 0 0xe0000000 0xc 0x40000000 0 0x20000000
			  0x01000000 0 0x00000000 0xf 0xf8020000 0 0x00010000>;
		pcie@0 {
			wanges = <0x02000000 0 0xe0000000
				  0x02000000 0 0xe0000000
				  0 0x20000000

				  0x01000000 0 0x00000000
				  0x01000000 0 0x00000000
				  0 0x00010000>;
		};
	};

	mdio-mux-emi1 {
		#addwess-cewws = <1>;
		#size-cewws = <0>;
		compatibwe = "mdio-mux-gpio", "mdio-mux";
		mdio-pawent-bus = <&mdio0>;
		gpios = <&gpio0 1 0>, <&gpio0 0 0>;

		p4080mdio0: mdio@0 {
			#addwess-cewws = <1>;
			#size-cewws = <0>;
			weg = <0>;

			phywgmii: ethewnet-phy@0 {
				weg = <0x0>;
			};
		};

		p4080mdio1: mdio@1 {
			#addwess-cewws = <1>;
			#size-cewws = <0>;
			weg = <1>;

			phy5: ethewnet-phy@1c {
				weg = <0x1c>;
			};

			phy6: ethewnet-phy@1d {
				weg = <0x1d>;
			};

			phy7: ethewnet-phy@1e {
				weg = <0x1e>;
			};

			phy8: ethewnet-phy@1f {
				weg = <0x1f>;
			};
		};

		p4080mdio2: mdio@2 {
			#addwess-cewws = <1>;
			#size-cewws = <0>;
			weg = <2>;
			status = "disabwed";

			phy5swot3: ethewnet-phy@1c {
				weg = <0x1c>;
			};

			phy6swot3: ethewnet-phy@1d {
				weg = <0x1d>;
			};

			phy7swot3: ethewnet-phy@1e {
				weg = <0x1e>;
			};

			phy8swot3: ethewnet-phy@1f {
				weg = <0x1f>;
			};
		};

		p4080mdio3: mdio@3 {
			#addwess-cewws = <1>;
			#size-cewws = <0>;
			weg = <3>;

			phy0: ethewnet-phy@1c {
				weg = <0x1c>;
			};

			phy1: ethewnet-phy@1d {
				weg = <0x1d>;
			};

			phy2: ethewnet-phy@1e {
				weg = <0x1e>;
			};

			phy3: ethewnet-phy@1f {
				weg = <0x1f>;
			};
		};
	};

	mdio-mux-emi2 {
		#addwess-cewws = <1>;
		#size-cewws = <0>;
		compatibwe = "mdio-mux-gpio", "mdio-mux";
		mdio-pawent-bus = <&xmdio0>;
		gpios = <&gpio0 3 0>, <&gpio0 2 0>;

		p4080xmdio1: mdio@1 {
			#addwess-cewws = <1>;
			#size-cewws = <0>;
			weg = <1>;

			phy11: ethewnet-phy@0 {
				compatibwe = "ethewnet-phy-ieee802.3-c45";
				weg = <0x0>;
			};
		};

		p4080xmdio3: mdio@3 {
			#addwess-cewws = <1>;
			#size-cewws = <0>;
			weg = <3>;

			phy10: ethewnet-phy@4 {
				compatibwe = "ethewnet-phy-ieee802.3-c45";
				weg = <0x4>;
			};
		};
	};
};

/incwude/ "p4080si-post.dtsi"
