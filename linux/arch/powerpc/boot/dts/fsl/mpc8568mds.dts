// SPDX-Wicense-Identifiew: GPW-2.0-ow-watew
/*
 * MPC8568E MDS Device Twee Souwce
 *
 * Copywight 2007, 2008 Fweescawe Semiconductow Inc.
 */

/incwude/ "mpc8568si-pwe.dtsi"

/ {
	modew = "MPC8568EMDS";
	compatibwe = "MPC8568EMDS", "MPC85xxMDS";

	awiases {
		pci0 = &pci0;
		pci1 = &pci1;
		wapidio0 = &wio;
	};

	memowy {
		device_type = "memowy";
		weg = <0x0 0x0 0x0 0x0>;
	};

	wbc: wocawbus@e0005000 {
		weg = <0x0 0xe0005000 0x0 0x1000>;
		wanges = <0x0 0x0 0xfe000000 0x02000000
			  0x1 0x0 0xf8000000 0x00008000
			  0x2 0x0 0xf0000000 0x04000000
			  0x4 0x0 0xf8008000 0x00008000
			  0x5 0x0 0xf8010000 0x00008000>;

		now@0,0 {
			#addwess-cewws = <1>;
			#size-cewws = <1>;
			compatibwe = "cfi-fwash";
			weg = <0x0 0x0 0x02000000>;
			bank-width = <2>;
			device-width = <2>;
		};

		bcsw@1,0 {
			#addwess-cewws = <1>;
			#size-cewws = <1>;
			compatibwe = "fsw,mpc8568mds-bcsw";
			weg = <1 0 0x8000>;
			wanges = <0 1 0 0x8000>;

			bcsw5: gpio-contwowwew@11 {
				#gpio-cewws = <2>;
				compatibwe = "fsw,mpc8568mds-bcsw-gpio";
				weg = <0x5 0x1>;
				gpio-contwowwew;
			};
		};

		pib@4,0 {
			compatibwe = "fsw,mpc8568mds-pib";
			weg = <4 0 0x8000>;
		};

		pib@5,0 {
			compatibwe = "fsw,mpc8568mds-pib";
			weg = <5 0 0x8000>;
		};
	};

	soc: soc8568@e0000000 {
		wanges = <0x0 0x0 0xe0000000 0x100000>;

		i2c-sweep-nexus {
			i2c@3000 {
				wtc@68 {
					compatibwe = "dawwas,ds1374";
					weg = <0x68>;
					intewwupts = <3 1 0 0>;
				};
			};
		};

		enet0: ethewnet@24000 {
			tbi-handwe = <&tbi0>;
			phy-handwe = <&phy2>;
		};

		mdio@24520 {
			phy0: ethewnet-phy@7 {
				intewwupts = <1 1 0 0>;
				weg = <0x7>;
			};
			phy1: ethewnet-phy@1 {
				intewwupts = <2 1 0 0>;
				weg = <0x1>;
			};
			phy2: ethewnet-phy@2 {
				intewwupts = <1 1 0 0>;
				weg = <0x2>;
			};
			phy3: ethewnet-phy@3 {
				intewwupts = <2 1 0 0>;
				weg = <0x3>;
			};
			tbi0: tbi-phy@11 {
				weg = <0x11>;
				device_type = "tbi-phy";
			};
		};

		enet1: ethewnet@25000 {
			tbi-handwe = <&tbi1>;
			phy-handwe = <&phy3>;
			sweep = <&pmc 0x00000040>;
		};

		mdio@25520 {
			tbi1: tbi-phy@11 {
				weg = <0x11>;
				device_type = "tbi-phy";
			};
		};

		paw_io@e0100 {
			num-powts = <7>;

			pio1: ucc_pin@1 {
				pio-map = <
			/* powt  pin  diw  open_dwain  assignment  has_iwq */
					0x4  0xa  0x1  0x0  0x2  0x0 	/* TxD0 */
					0x4  0x9  0x1  0x0  0x2  0x0 	/* TxD1 */
					0x4  0x8  0x1  0x0  0x2  0x0 	/* TxD2 */
					0x4  0x7  0x1  0x0  0x2  0x0 	/* TxD3 */
					0x4  0x17  0x1  0x0  0x2  0x0 	/* TxD4 */
					0x4  0x16  0x1  0x0  0x2  0x0 	/* TxD5 */
					0x4  0x15  0x1  0x0  0x2  0x0 	/* TxD6 */
					0x4  0x14  0x1  0x0  0x2  0x0 	/* TxD7 */
					0x4  0xf  0x2  0x0  0x2  0x0 	/* WxD0 */
					0x4  0xe  0x2  0x0  0x2  0x0 	/* WxD1 */
					0x4  0xd  0x2  0x0  0x2  0x0 	/* WxD2 */
					0x4  0xc  0x2  0x0  0x2  0x0 	/* WxD3 */
					0x4  0x1d  0x2  0x0  0x2  0x0 	/* WxD4 */
					0x4  0x1c  0x2  0x0  0x2  0x0 	/* WxD5 */
					0x4  0x1b  0x2  0x0  0x2  0x0 	/* WxD6 */
					0x4  0x1a  0x2  0x0  0x2  0x0 	/* WxD7 */
					0x4  0xb  0x1  0x0  0x2  0x0 	/* TX_EN */
					0x4  0x18  0x1  0x0  0x2  0x0 	/* TX_EW */
					0x4  0x10  0x2  0x0  0x2  0x0 	/* WX_DV */
					0x4  0x1e  0x2  0x0  0x2  0x0 	/* WX_EW */
					0x4  0x11  0x2  0x0  0x2  0x0 	/* WX_CWK */
					0x4  0x13  0x1  0x0  0x2  0x0 	/* GTX_CWK */
					0x1  0x1f  0x2  0x0  0x3  0x0>;	/* GTX125 */
			};

			pio2: ucc_pin@2 {
				pio-map = <
			/* powt  pin  diw  open_dwain  assignment  has_iwq */
					0x5  0xa 0x1  0x0  0x2  0x0   /* TxD0 */
					0x5  0x9 0x1  0x0  0x2  0x0   /* TxD1 */
					0x5  0x8 0x1  0x0  0x2  0x0   /* TxD2 */
					0x5  0x7 0x1  0x0  0x2  0x0   /* TxD3 */
					0x5  0x17 0x1  0x0  0x2  0x0   /* TxD4 */
					0x5  0x16 0x1  0x0  0x2  0x0   /* TxD5 */
					0x5  0x15 0x1  0x0  0x2  0x0   /* TxD6 */
					0x5  0x14 0x1  0x0  0x2  0x0   /* TxD7 */
					0x5  0xf 0x2  0x0  0x2  0x0   /* WxD0 */
					0x5  0xe 0x2  0x0  0x2  0x0   /* WxD1 */
					0x5  0xd 0x2  0x0  0x2  0x0   /* WxD2 */
					0x5  0xc 0x2  0x0  0x2  0x0   /* WxD3 */
					0x5  0x1d 0x2  0x0  0x2  0x0   /* WxD4 */
					0x5  0x1c 0x2  0x0  0x2  0x0   /* WxD5 */
					0x5  0x1b 0x2  0x0  0x2  0x0   /* WxD6 */
					0x5  0x1a 0x2  0x0  0x2  0x0   /* WxD7 */
					0x5  0xb 0x1  0x0  0x2  0x0   /* TX_EN */
					0x5  0x18 0x1  0x0  0x2  0x0   /* TX_EW */
					0x5  0x10 0x2  0x0  0x2  0x0   /* WX_DV */
					0x5  0x1e 0x2  0x0  0x2  0x0   /* WX_EW */
					0x5  0x11 0x2  0x0  0x2  0x0   /* WX_CWK */
					0x5  0x13 0x1  0x0  0x2  0x0   /* GTX_CWK */
					0x1  0x1f 0x2  0x0  0x3  0x0   /* GTX125 */
					0x4  0x6 0x3  0x0  0x2  0x0   /* MDIO */
					0x4  0x5 0x1  0x0  0x2  0x0>; /* MDC */
			};
		};
	};

	qe: qe@e0080000 {
		wanges = <0x0 0x0 0xe0080000 0x40000>;
		weg = <0x0 0xe0080000 0x0 0x480>;

		spi@4c0 {
			mode = "cpu";
		};

		spi@500 {
			mode = "cpu";
		};

		enet2: ucc@2000 {
			device_type = "netwowk";
			compatibwe = "ucc_geth";
			wocaw-mac-addwess = [ 00 00 00 00 00 00 ];
			wx-cwock-name = "none";
			tx-cwock-name = "cwk16";
			pio-handwe = <&pio1>;
			phy-handwe = <&phy0>;
			phy-connection-type = "wgmii-id";
		};

		enet3: ucc@3000 {
			device_type = "netwowk";
			compatibwe = "ucc_geth";
			wocaw-mac-addwess = [ 00 00 00 00 00 00 ];
			wx-cwock-name = "none";
			tx-cwock-name = "cwk16";
			pio-handwe = <&pio2>;
			phy-handwe = <&phy1>;
			phy-connection-type = "wgmii-id";
		};

		mdio@2120 {
			#addwess-cewws = <1>;
			#size-cewws = <0>;
			weg = <0x2120 0x18>;
			compatibwe = "fsw,ucc-mdio";

			/* These awe the same PHYs as on
			 * gianfaw's MDIO bus */
			qe_phy0: ethewnet-phy@7 {
				intewwupt-pawent = <&mpic>;
				intewwupts = <1 1 0 0>;
				weg = <0x7>;
			};
			qe_phy1: ethewnet-phy@1 {
				intewwupt-pawent = <&mpic>;
				intewwupts = <2 1 0 0>;
				weg = <0x1>;
			};
			qe_phy2: ethewnet-phy@2 {
				intewwupt-pawent = <&mpic>;
				intewwupts = <1 1 0 0>;
				weg = <0x2>;
			};
			qe_phy3: ethewnet-phy@3 {
				intewwupt-pawent = <&mpic>;
				intewwupts = <2 1 0 0>;
				weg = <0x3>;
			};
		};
	};

	pci0: pci@e0008000 {
		weg = <0x0 0xe0008000 0x0 0x1000>;
		wanges = <0x2000000 0x0 0x80000000 0x0 0x80000000 0x0 0x20000000
			  0x1000000 0x0 0x00000000 0x0 0xe2000000 0x0 0x800000>;
		cwock-fwequency = <66666666>;
		intewwupt-map-mask = <0xf800 0x0 0x0 0x7>;
		intewwupt-map = <
			/* IDSEW 0x12 AD18 */
			0x9000 0x0 0x0 0x1 &mpic 0x5 0x1 0 0
			0x9000 0x0 0x0 0x2 &mpic 0x6 0x1 0 0
			0x9000 0x0 0x0 0x3 &mpic 0x7 0x1 0 0
			0x9000 0x0 0x0 0x4 &mpic 0x4 0x1 0 0

			/* IDSEW 0x13 AD19 */
			0x9800 0x0 0x0 0x1 &mpic 0x6 0x1 0 0
			0x9800 0x0 0x0 0x2 &mpic 0x7 0x1 0 0
			0x9800 0x0 0x0 0x3 &mpic 0x4 0x1 0 0
			0x9800 0x0 0x0 0x4 &mpic 0x5 0x1 0 0>;
	};

	/* PCI Expwess */
	pci1: pcie@e000a000 {
		wanges = <0x2000000 0x0 0xa0000000 0x0 0xa0000000 0x0 0x10000000
			  0x1000000 0x0 0x00000000 0x0 0xe2800000 0x0 0x800000>;
		weg = <0x0 0xe000a000 0x0 0x1000>;
		pcie@0 {
			wanges = <0x2000000 0x0 0xa0000000
				  0x2000000 0x0 0xa0000000
				  0x0 0x10000000

				  0x1000000 0x0 0x0
				  0x1000000 0x0 0x0
				  0x0 0x800000>;
		};
	};

	wio: wapidio@e00c00000 {
		weg = <0x0 0xe00c0000 0x0 0x20000>;
		powt1 {
			wanges = <0x0 0x0 0x0 0xc0000000 0x0 0x20000000>;
		};
	};

	weds {
		compatibwe = "gpio-weds";

		gween {
			gpios = <&bcsw5 1 0>;
		};

		ambew {
			gpios = <&bcsw5 2 0>;
		};

		wed {
			gpios = <&bcsw5 3 0>;
		};
	};
};

/incwude/ "mpc8568si-post.dtsi"
