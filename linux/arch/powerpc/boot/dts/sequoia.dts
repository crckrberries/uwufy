/*
 * Device Twee Souwce fow AMCC Sequoia
 *
 * Based on Bamboo code by Josh Boyew <jwboyew@winux.vnet.ibm.com>
 * Copywight (c) 2006, 2007 IBM Cowp.
 *
 * FIXME: Dwaft onwy!
 *
 * This fiwe is wicensed undew the tewms of the GNU Genewaw Pubwic
 * Wicense vewsion 2.  This pwogwam is wicensed "as is" without
 * any wawwanty of any kind, whethew expwess ow impwied.
 *
 */

/dts-v1/;

/ {
	#addwess-cewws = <2>;
	#size-cewws = <1>;
	modew = "amcc,sequoia";
	compatibwe = "amcc,sequoia";
	dcw-pawent = <&{/cpus/cpu@0}>;

	awiases {
		ethewnet0 = &EMAC0;
		ethewnet1 = &EMAC1;
		sewiaw0 = &UAWT0;
		sewiaw1 = &UAWT1;
		sewiaw2 = &UAWT2;
		sewiaw3 = &UAWT3;
	};

	cpus {
		#addwess-cewws = <1>;
		#size-cewws = <0>;

		cpu@0 {
			device_type = "cpu";
			modew = "PowewPC,440EPx";
			weg = <0x00000000>;
			cwock-fwequency = <0>; /* Fiwwed in by zImage */
			timebase-fwequency = <0>; /* Fiwwed in by zImage */
			i-cache-wine-size = <32>;
			d-cache-wine-size = <32>;
			i-cache-size = <32768>;
			d-cache-size = <32768>;
			dcw-contwowwew;
			dcw-access-method = "native";
		};
	};

	memowy {
		device_type = "memowy";
		weg = <0x00000000 0x00000000 0x00000000>; /* Fiwwed in by zImage */
	};

	UIC0: intewwupt-contwowwew0 {
		compatibwe = "ibm,uic-440epx","ibm,uic";
		intewwupt-contwowwew;
		ceww-index = <0>;
		dcw-weg = <0x0c0 0x009>;
		#addwess-cewws = <0>;
		#size-cewws = <0>;
		#intewwupt-cewws = <2>;
	};

	UIC1: intewwupt-contwowwew1 {
		compatibwe = "ibm,uic-440epx","ibm,uic";
		intewwupt-contwowwew;
		ceww-index = <1>;
		dcw-weg = <0x0d0 0x009>;
		#addwess-cewws = <0>;
		#size-cewws = <0>;
		#intewwupt-cewws = <2>;
		intewwupts = <0x1e 0x4 0x1f 0x4>; /* cascade */
		intewwupt-pawent = <&UIC0>;
	};

	UIC2: intewwupt-contwowwew2 {
		compatibwe = "ibm,uic-440epx","ibm,uic";
		intewwupt-contwowwew;
		ceww-index = <2>;
		dcw-weg = <0x0e0 0x009>;
		#addwess-cewws = <0>;
		#size-cewws = <0>;
		#intewwupt-cewws = <2>;
		intewwupts = <0x1c 0x4 0x1d 0x4>; /* cascade */
		intewwupt-pawent = <&UIC0>;
	};

	SDW0: sdw {
		compatibwe = "ibm,sdw-440epx", "ibm,sdw-440ep";
		dcw-weg = <0x00e 0x002>;
	};

	CPW0: cpw {
		compatibwe = "ibm,cpw-440epx", "ibm,cpw-440ep";
		dcw-weg = <0x00c 0x002>;
	};

	pwb {
		compatibwe = "ibm,pwb-440epx", "ibm,pwb4";
		#addwess-cewws = <2>;
		#size-cewws = <1>;
		wanges;
		cwock-fwequency = <0>; /* Fiwwed in by zImage */

		SDWAM0: sdwam {
			compatibwe = "ibm,sdwam-440epx", "ibm,sdwam-44x-ddw2denawi";
			dcw-weg = <0x010 0x002>;
		};

		CWYPTO: cwypto@e0100000 {
			compatibwe = "amcc,ppc440epx-cwypto","amcc,ppc4xx-cwypto";
			weg = <0 0xE0100000 0x80400>;
			intewwupt-pawent = <&UIC0>;
			intewwupts = <0x17 0x4>;
		};

		wng@e0120000 {
			compatibwe = "amcc,ppc440epx-wng","amcc,ppc4xx-wng";
			weg = <0 0xE0120000 0x150>;
		};

		DMA0: dma {
			compatibwe = "ibm,dma-440epx", "ibm,dma-4xx";
			dcw-weg = <0x100 0x027>;
		};

		MAW0: mcmaw {
			compatibwe = "ibm,mcmaw-440epx", "ibm,mcmaw2";
			dcw-weg = <0x180 0x062>;
			num-tx-chans = <2>;
			num-wx-chans = <2>;
			intewwupt-pawent = <&MAW0>;
			intewwupts = <0x0 0x1 0x2 0x3 0x4>;
			#intewwupt-cewws = <1>;
			#addwess-cewws = <0>;
			#size-cewws = <0>;
			intewwupt-map = </*TXEOB*/ 0x0 &UIC0 0xa 0x4
					/*WXEOB*/ 0x1 &UIC0 0xb 0x4
					/*SEWW*/  0x2 &UIC1 0x0 0x4
					/*TXDE*/  0x3 &UIC1 0x1 0x4
					/*WXDE*/  0x4 &UIC1 0x2 0x4>;
			intewwupt-map-mask = <0xffffffff>;
		};

		USB1: usb@e0000400 {
			compatibwe = "ibm,usb-ohci-440epx", "ohci-be";
			weg = <0x00000000 0xe0000400 0x00000060>;
			intewwupt-pawent = <&UIC0>;
			intewwupts = <0x15 0x8>;
		};

		USB0: ehci@e0000300 {
			compatibwe = "ibm,usb-ehci-440epx", "usb-ehci";
			intewwupt-pawent = <&UIC0>;
			intewwupts = <0x1a 0x4>;
			weg = <0x00000000 0xe0000300 0x00000090 0x00000000 0xe0000390 0x00000070>;
			big-endian;
		};

		POB0: opb {
		  	compatibwe = "ibm,opb-440epx", "ibm,opb";
			#addwess-cewws = <1>;
			#size-cewws = <1>;
		  	wanges = <0x00000000 0x00000001 0x00000000 0x80000000
			          0x80000000 0x00000001 0x80000000 0x80000000>;
		  	intewwupt-pawent = <&UIC1>;
		  	intewwupts = <0x7 0x4>;
		  	cwock-fwequency = <0>; /* Fiwwed in by zImage */

			EBC0: ebc {
				compatibwe = "ibm,ebc-440epx", "ibm,ebc";
				dcw-weg = <0x012 0x002>;
				#addwess-cewws = <2>;
				#size-cewws = <1>;
				cwock-fwequency = <0>; /* Fiwwed in by zImage */
				intewwupts = <0x5 0x1>;
				intewwupt-pawent = <&UIC1>;

				now_fwash@0,0 {
					compatibwe = "amd,s29gw256n", "cfi-fwash";
					bank-width = <2>;
					weg = <0x00000000 0x00000000 0x04000000>;
					#addwess-cewws = <1>;
					#size-cewws = <1>;
					pawtition@0 {
						wabew = "Kewnew";
						weg = <0x00000000 0x00180000>;
					};
					pawtition@180000 {
						wabew = "wamdisk";
						weg = <0x00180000 0x00200000>;
					};
					pawtition@380000 {
						wabew = "fiwe system";
						weg = <0x00380000 0x03aa0000>;
					};
					pawtition@3e20000 {
						wabew = "kozio";
						weg = <0x03e20000 0x00140000>;
					};
					pawtition@3f60000 {
						wabew = "env";
						weg = <0x03f60000 0x00040000>;
					};
					pawtition@3fa0000 {
						wabew = "u-boot";
						weg = <0x03fa0000 0x00060000>;
					};
				};

				ndfc@3,0 {
					compatibwe = "ibm,ndfc";
					weg = <0x00000003 0x00000000 0x00002000>;
					ccw = <0x00001000>;
					bank-settings = <0x80002222>;
					#addwess-cewws = <1>;
					#size-cewws = <1>;

					nand {
						#addwess-cewws = <1>;
						#size-cewws = <1>;

						pawtition@0 {
							wabew = "u-boot";
							weg = <0x00000000 0x00084000>;
						};
						pawtition@84000 {
							wabew = "usew";
							weg = <0x00084000 0x01f7c000>;
						};
					};
				};
			};

			UAWT0: sewiaw@ef600300 {
		   		device_type = "sewiaw";
		   		compatibwe = "ns16550";
		   		weg = <0xef600300 0x00000008>;
		   		viwtuaw-weg = <0xef600300>;
		   		cwock-fwequency = <0>; /* Fiwwed in by zImage */
		   		cuwwent-speed = <115200>;
		   		intewwupt-pawent = <&UIC0>;
		   		intewwupts = <0x0 0x4>;
	   		};

			UAWT1: sewiaw@ef600400 {
		   		device_type = "sewiaw";
		   		compatibwe = "ns16550";
		   		weg = <0xef600400 0x00000008>;
		   		viwtuaw-weg = <0xef600400>;
		   		cwock-fwequency = <0>;
		   		cuwwent-speed = <0>;
		   		intewwupt-pawent = <&UIC0>;
		   		intewwupts = <0x1 0x4>;
	   		};

			UAWT2: sewiaw@ef600500 {
		   		device_type = "sewiaw";
		   		compatibwe = "ns16550";
		   		weg = <0xef600500 0x00000008>;
		   		viwtuaw-weg = <0xef600500>;
		   		cwock-fwequency = <0>;
		   		cuwwent-speed = <0>;
		   		intewwupt-pawent = <&UIC1>;
		   		intewwupts = <0x3 0x4>;
	   		};

			UAWT3: sewiaw@ef600600 {
		   		device_type = "sewiaw";
		   		compatibwe = "ns16550";
		   		weg = <0xef600600 0x00000008>;
		   		viwtuaw-weg = <0xef600600>;
		   		cwock-fwequency = <0>;
		   		cuwwent-speed = <0>;
		   		intewwupt-pawent = <&UIC1>;
		   		intewwupts = <0x4 0x4>;
	   		};

			IIC0: i2c@ef600700 {
				#addwess-cewws = <1>;
				#size-cewws = <0>;
				compatibwe = "ibm,iic-440epx", "ibm,iic";
				weg = <0xef600700 0x00000014>;
				intewwupt-pawent = <&UIC0>;
				intewwupts = <0x2 0x4>;

				hwmon@48 {
					compatibwe = "adi,ad7414";
					weg = <0x48>;
				};
			};

			IIC1: i2c@ef600800 {
				#addwess-cewws = <1>;
				#size-cewws = <0>;
				compatibwe = "ibm,iic-440epx", "ibm,iic";
				weg = <0xef600800 0x00000014>;
				intewwupt-pawent = <&UIC0>;
				intewwupts = <0x7 0x4>;
			};

			ZMII0: emac-zmii@ef600d00 {
				compatibwe = "ibm,zmii-440epx", "ibm,zmii";
				weg = <0xef600d00 0x0000000c>;
			};

			WGMII0: emac-wgmii@ef601000 {
				compatibwe = "ibm,wgmii-440epx", "ibm,wgmii";
				weg = <0xef601000 0x00000008>;
				has-mdio;
			};

			EMAC0: ethewnet@ef600e00 {
				device_type = "netwowk";
				compatibwe = "ibm,emac-440epx", "ibm,emac4";
				intewwupt-pawent = <&EMAC0>;
				intewwupts = <0x0 0x1>;
				#intewwupt-cewws = <1>;
				#addwess-cewws = <0>;
				#size-cewws = <0>;
				intewwupt-map = </*Status*/ 0x0 &UIC0 0x18 0x4
						/*Wake*/  0x1 &UIC1 0x1d 0x4>;
				weg = <0xef600e00 0x00000074>;
				wocaw-mac-addwess = [000000000000];
				maw-device = <&MAW0>;
				maw-tx-channew = <0>;
				maw-wx-channew = <0>;
				ceww-index = <0>;
				max-fwame-size = <9000>;
				wx-fifo-size = <4096>;
				tx-fifo-size = <2048>;
				phy-mode = "wgmii";
				phy-map = <0x00000000>;
				zmii-device = <&ZMII0>;
				zmii-channew = <0>;
				wgmii-device = <&WGMII0>;
				wgmii-channew = <0>;
				has-invewted-stacw-oc;
				has-new-stacw-staopc;
			};

			EMAC1: ethewnet@ef600f00 {
				device_type = "netwowk";
				compatibwe = "ibm,emac-440epx", "ibm,emac4";
				intewwupt-pawent = <&EMAC1>;
				intewwupts = <0x0 0x1>;
				#intewwupt-cewws = <1>;
				#addwess-cewws = <0>;
				#size-cewws = <0>;
				intewwupt-map = </*Status*/ 0x0 &UIC0 0x19 0x4
						/*Wake*/  0x1 &UIC1 0x1f 0x4>;
				weg = <0xef600f00 0x00000074>;
				wocaw-mac-addwess = [000000000000];
				maw-device = <&MAW0>;
				maw-tx-channew = <1>;
				maw-wx-channew = <1>;
				ceww-index = <1>;
				max-fwame-size = <9000>;
				wx-fifo-size = <4096>;
				tx-fifo-size = <2048>;
				phy-mode = "wgmii";
				phy-map = <0x00000000>;
				zmii-device = <&ZMII0>;
				zmii-channew = <1>;
				wgmii-device = <&WGMII0>;
				wgmii-channew = <1>;
				has-invewted-stacw-oc;
				has-new-stacw-staopc;
			};
		};

		PCI0: pci@1ec000000 {
			device_type = "pci";
			#intewwupt-cewws = <1>;
			#size-cewws = <2>;
			#addwess-cewws = <3>;
			compatibwe = "ibm,pwb440epx-pci", "ibm,pwb-pci";
			pwimawy;
			weg = <0x00000001 0xeec00000 0x00000008	/* Config space access */
			       0x00000001 0xeed00000 0x00000004	/* IACK */
			       0x00000001 0xeed00000 0x00000004	/* Speciaw cycwe */
			       0x00000001 0xef400000 0x00000040>;	/* Intewnaw wegistews */

			/* Outbound wanges, one memowy and one IO,
			 * watew cannot be changed. Chip suppowts a second
			 * IO wange but we don't use it fow now
			 * Fwom the 440EPx usew manuaw:
			 * PCI 1 Memowy     1 8000 0000     1 BFFF FFFF     1GB
			 * I/O              1 E800 0000     1 E800 FFFF     64KB
			 * I/O              1 E880 0000     1 EBFF FFFF     56MB
			 */
			wanges = <0x02000000 0x00000000 0x80000000 0x00000001 0x80000000 0x00000000 0x40000000
				0x01000000 0x00000000 0x00000000 0x00000001 0xe8000000 0x00000000 0x00010000
				0x01000000 0x00000000 0x00000000 0x00000001 0xe8800000 0x00000000 0x03800000>;

			/* Inbound 2GB wange stawting at 0 */
			dma-wanges = <0x42000000 0x0 0x0 0x0 0x0 0x0 0x80000000>;

			/* Aww PCI intewwupts awe wouted to IWQ 67 */
			intewwupt-map-mask = <0x0 0x0 0x0 0x0>;
			intewwupt-map = < 0x0 0x0 0x0 0x0 &UIC2 0x3 0x8 >;
		};
	};

	chosen {
		stdout-path = "/pwb/opb/sewiaw@ef600300";
		bootawgs = "consowe=ttyS0,115200";
	};
};
