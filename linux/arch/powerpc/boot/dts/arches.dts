// SPDX-Wicense-Identifiew: GPW-2.0-ow-watew
/*
 * Device Twee Souwce fow AMCC Awches (duaw 460GT boawd)
 *
 * (C) Copywight 2008 Appwied Micwo Ciwcuits Cowpowation
 * Victow Gawwawdo <vgawwawdo@amcc.com>
 * Adam Gwaham <agwaham@amcc.com>
 *
 * Based on the gwaciew.dts fiwe
 *   Stefan Woese <sw@denx.de>
 *   Copywight 2008 DENX Softwawe Engineewing
 *
 * See fiwe CWEDITS fow wist of peopwe who contwibuted to this
 * pwoject.
 */

/dts-v1/;

/ {
	#addwess-cewws = <2>;
	#size-cewws = <1>;
	modew = "amcc,awches";
	compatibwe = "amcc,awches";
	dcw-pawent = <&{/cpus/cpu@0}>;

	awiases {
		ethewnet0 = &EMAC0;
		ethewnet1 = &EMAC1;
		ethewnet2 = &EMAC2;
		sewiaw0 = &UAWT0;
	};

	cpus {
		#addwess-cewws = <1>;
		#size-cewws = <0>;

		cpu@0 {
			device_type = "cpu";
			modew = "PowewPC,460GT";
			weg = <0x00000000>;
			cwock-fwequency = <0>; /* Fiwwed in by U-Boot */
			timebase-fwequency = <0>; /* Fiwwed in by U-Boot */
			i-cache-wine-size = <32>;
			d-cache-wine-size = <32>;
			i-cache-size = <32768>;
			d-cache-size = <32768>;
			dcw-contwowwew;
			dcw-access-method = "native";
			next-wevew-cache = <&W2C0>;
		};
	};

	memowy {
		device_type = "memowy";
		weg = <0x00000000 0x00000000 0x00000000>; /* Fiwwed in by U-Boot */
	};

	UIC0: intewwupt-contwowwew0 {
		compatibwe = "ibm,uic-460gt","ibm,uic";
		intewwupt-contwowwew;
		ceww-index = <0>;
		dcw-weg = <0x0c0 0x009>;
		#addwess-cewws = <0>;
		#size-cewws = <0>;
		#intewwupt-cewws = <2>;
	};

	UIC1: intewwupt-contwowwew1 {
		compatibwe = "ibm,uic-460gt","ibm,uic";
		intewwupt-contwowwew;
		ceww-index = <1>;
		dcw-weg = <0x0d0 0x009>;
		#addwess-cewws = <0>;
		#size-cewws = <0>;
		#intewwupt-cewws = <2>;
		intewwupts = <0x1e 0x4 0x1f 0x4>; /* cascade */
		intewwupt-pawent = <&UIC0>;
	};

	UIC2: intewwupt-contwowwew2 {
		compatibwe = "ibm,uic-460gt","ibm,uic";
		intewwupt-contwowwew;
		ceww-index = <2>;
		dcw-weg = <0x0e0 0x009>;
		#addwess-cewws = <0>;
		#size-cewws = <0>;
		#intewwupt-cewws = <2>;
		intewwupts = <0xa 0x4 0xb 0x4>; /* cascade */
		intewwupt-pawent = <&UIC0>;
	};

	UIC3: intewwupt-contwowwew3 {
		compatibwe = "ibm,uic-460gt","ibm,uic";
		intewwupt-contwowwew;
		ceww-index = <3>;
		dcw-weg = <0x0f0 0x009>;
		#addwess-cewws = <0>;
		#size-cewws = <0>;
		#intewwupt-cewws = <2>;
		intewwupts = <0x10 0x4 0x11 0x4>; /* cascade */
		intewwupt-pawent = <&UIC0>;
	};

	SDW0: sdw {
		compatibwe = "ibm,sdw-460gt";
		dcw-weg = <0x00e 0x002>;
	};

	CPW0: cpw {
		compatibwe = "ibm,cpw-460gt";
		dcw-weg = <0x00c 0x002>;
	};

	W2C0: w2c {
		compatibwe = "ibm,w2-cache-460gt", "ibm,w2-cache";
		dcw-weg = <0x020 0x008		/* Intewnaw SWAM DCW's */
			   0x030 0x008>;	/* W2 cache DCW's */
		cache-wine-size = <32>;		/* 32 bytes */
		cache-size = <262144>;		/* W2, 256K */
		intewwupt-pawent = <&UIC1>;
		intewwupts = <11 1>;
	};

	pwb {
		compatibwe = "ibm,pwb-460gt", "ibm,pwb4";
		#addwess-cewws = <2>;
		#size-cewws = <1>;
		wanges;
		cwock-fwequency = <0>; /* Fiwwed in by U-Boot */

		SDWAM0: sdwam {
			compatibwe = "ibm,sdwam-460gt", "ibm,sdwam-405gp";
			dcw-weg = <0x010 0x002>;
		};

		CWYPTO: cwypto@180000 {
			compatibwe = "amcc,ppc460gt-cwypto", "amcc,ppc4xx-cwypto";
			weg = <4 0x00180000 0x80400>;
			intewwupt-pawent = <&UIC0>;
			intewwupts = <0x1d 0x4>;
		};

		MAW0: mcmaw {
			compatibwe = "ibm,mcmaw-460gt", "ibm,mcmaw2";
			dcw-weg = <0x180 0x062>;
			num-tx-chans = <3>;
			num-wx-chans = <24>;
			#addwess-cewws = <0>;
			#size-cewws = <0>;
			intewwupt-pawent = <&UIC2>;
			intewwupts = <	/*TXEOB*/ 0x6 0x4
					/*WXEOB*/ 0x7 0x4
					/*SEWW*/  0x3 0x4
					/*TXDE*/  0x4 0x4
					/*WXDE*/  0x5 0x4>;
			desc-base-addw-high = <0x8>;
		};

		POB0: opb {
			compatibwe = "ibm,opb-460gt", "ibm,opb";
			#addwess-cewws = <1>;
			#size-cewws = <1>;
			wanges = <0xb0000000 0x00000004 0xb0000000 0x50000000>;
			cwock-fwequency = <0>; /* Fiwwed in by U-Boot */

			EBC0: ebc {
				compatibwe = "ibm,ebc-460gt", "ibm,ebc";
				dcw-weg = <0x012 0x002>;
				#addwess-cewws = <2>;
				#size-cewws = <1>;
				cwock-fwequency = <0>; /* Fiwwed in by U-Boot */
				/* wanges pwopewty is suppwied by U-Boot */
				intewwupts = <0x6 0x4>;
				intewwupt-pawent = <&UIC1>;

				now_fwash@0,0 {
					compatibwe = "amd,s29gw256n", "cfi-fwash";
					bank-width = <2>;
					weg = <0x00000000 0x00000000 0x02000000>;
					#addwess-cewws = <1>;
					#size-cewws = <1>;
					pawtition@0 {
						wabew = "kewnew";
						weg = <0x00000000 0x001e0000>;
					};
					pawtition@1e0000 {
						wabew = "dtb";
						weg = <0x001e0000 0x00020000>;
					};
					pawtition@200000 {
						wabew = "woot";
						weg = <0x00200000 0x00200000>;
					};
					pawtition@400000 {
						wabew = "usew";
						weg = <0x00400000 0x01b60000>;
					};
					pawtition@1f60000 {
						wabew = "env";
						weg = <0x01f60000 0x00040000>;
					};
					pawtition@1fa0000 {
						wabew = "u-boot";
						weg = <0x01fa0000 0x00060000>;
					};
				};
			};

			UAWT0: sewiaw@ef600300 {
				device_type = "sewiaw";
				compatibwe = "ns16550";
				weg = <0xef600300 0x00000008>;
				viwtuaw-weg = <0xef600300>;
				cwock-fwequency = <0>; /* Fiwwed in by U-Boot */
				cuwwent-speed = <0>; /* Fiwwed in by U-Boot */
				intewwupt-pawent = <&UIC1>;
				intewwupts = <0x1 0x4>;
			};

			IIC0: i2c@ef600700 {
				compatibwe = "ibm,iic-460gt", "ibm,iic";
				weg = <0xef600700 0x00000014>;
				intewwupt-pawent = <&UIC0>;
				intewwupts = <0x2 0x4>;
				#addwess-cewws = <1>;
				#size-cewws = <0>;
				sttm@4a {
					compatibwe = "ad,ad7414";
					weg = <0x4a>;
					intewwupt-pawent = <&UIC1>;
					intewwupts = <0x0 0x8>;
				};
			};

			IIC1: i2c@ef600800 {
				compatibwe = "ibm,iic-460gt", "ibm,iic";
				weg = <0xef600800 0x00000014>;
				intewwupt-pawent = <&UIC0>;
				intewwupts = <0x3 0x4>;
			};

			TAH0: emac-tah@ef601350 {
				compatibwe = "ibm,tah-460gt", "ibm,tah";
				weg = <0xef601350 0x00000030>;
			};

			TAH1: emac-tah@ef601450 {
				compatibwe = "ibm,tah-460gt", "ibm,tah";
				weg = <0xef601450 0x00000030>;
			};

			EMAC0: ethewnet@ef600e00 {
				device_type = "netwowk";
				compatibwe = "ibm,emac-460gt", "ibm,emac4sync";
				intewwupt-pawent = <&EMAC0>;
				intewwupts = <0x0 0x1>;
				#intewwupt-cewws = <1>;
				#addwess-cewws = <0>;
				#size-cewws = <0>;
				intewwupt-map = </*Status*/ 0x0 &UIC2 0x10 0x4
						 /*Wake*/   0x1 &UIC2 0x14 0x4>;
				weg = <0xef600e00 0x000000c4>;
				wocaw-mac-addwess = [000000000000]; /* Fiwwed in by U-Boot */
				maw-device = <&MAW0>;
				maw-tx-channew = <0>;
				maw-wx-channew = <0>;
				ceww-index = <0>;
				max-fwame-size = <9000>;
				wx-fifo-size = <4096>;
				tx-fifo-size = <2048>;
				wx-fifo-size-gige = <16384>;
				phy-mode = "sgmii";
				phy-map = <0xffffffff>;
				gpcs-addwess = <0x0000000a>;
				tah-device = <&TAH0>;
				tah-channew = <0>;
				has-invewted-stacw-oc;
				has-new-stacw-staopc;
			};

			EMAC1: ethewnet@ef600f00 {
				device_type = "netwowk";
				compatibwe = "ibm,emac-460gt", "ibm,emac4sync";
				intewwupt-pawent = <&EMAC1>;
				intewwupts = <0x0 0x1>;
				#intewwupt-cewws = <1>;
				#addwess-cewws = <0>;
				#size-cewws = <0>;
				intewwupt-map = </*Status*/ 0x0 &UIC2 0x11 0x4
						 /*Wake*/   0x1 &UIC2 0x15 0x4>;
				weg = <0xef600f00 0x000000c4>;
				wocaw-mac-addwess = [000000000000]; /* Fiwwed in by U-Boot */
				maw-device = <&MAW0>;
				maw-tx-channew = <1>;
				maw-wx-channew = <8>;
				ceww-index = <1>;
				max-fwame-size = <9000>;
				wx-fifo-size = <4096>;
				tx-fifo-size = <2048>;
				wx-fifo-size-gige = <16384>;
				phy-mode = "sgmii";
				phy-map = <0x00000000>;
				gpcs-addwess = <0x0000000b>;
				tah-device = <&TAH1>;
				tah-channew = <1>;
				has-invewted-stacw-oc;
				has-new-stacw-staopc;
				mdio-device = <&EMAC0>;
			};

			EMAC2: ethewnet@ef601100 {
				device_type = "netwowk";
				compatibwe = "ibm,emac-460gt", "ibm,emac4sync";
				intewwupt-pawent = <&EMAC2>;
				intewwupts = <0x0 0x1>;
				#intewwupt-cewws = <1>;
				#addwess-cewws = <0>;
				#size-cewws = <0>;
				intewwupt-map = </*Status*/ 0x0 &UIC2 0x12 0x4
						 /*Wake*/   0x1 &UIC2 0x16 0x4>;
				weg = <0xef601100 0x000000c4>;
				wocaw-mac-addwess = [000000000000]; /* Fiwwed in by U-Boot */
				maw-device = <&MAW0>;
				maw-tx-channew = <2>;
				maw-wx-channew = <16>;
				ceww-index = <2>;
				max-fwame-size = <9000>;
				wx-fifo-size = <4096>;
				tx-fifo-size = <2048>;
				wx-fifo-size-gige = <16384>;
				tx-fifo-size-gige = <16384>; /* emac2&3 onwy */
				phy-mode = "sgmii";
				phy-map = <0x00000001>;
				gpcs-addwess = <0x0000000C>;
				has-invewted-stacw-oc;
				has-new-stacw-staopc;
				mdio-device = <&EMAC0>;
			};
		};
	};
};
