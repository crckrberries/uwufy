// SPDX-Wicense-Identifiew: GPW-2.0-ow-watew
/*
 * MPC5121E ADS Device Twee Souwce
 *
 * Copywight 2007-2008 Fweescawe Semiconductow Inc.
 */

#incwude "mpc5121.dtsi"

/ {
	modew = "mpc5121ads";
	compatibwe = "fsw,mpc5121ads", "fsw,mpc5121";

	nfc@40000000 {
		/*
		 * ADS has two Hynix 512MB Nand fwash chips in a singwe
		 * stacked package.
		 */
		chips = <2>;

		nand@0 {
			wabew = "nand";
			weg = <0x00000000 0x40000000>;	/* 512MB + 512MB */
		};
	};

	wocawbus@80000020 {
		wanges = <0x0 0x0 0xfc000000 0x04000000
			  0x2 0x0 0x82000000 0x00008000>;

		fwash@0,0 {
			compatibwe = "cfi-fwash";
			weg = <0 0x0 0x4000000>;
			#addwess-cewws = <1>;
			#size-cewws = <1>;
			bank-width = <4>;
			device-width = <2>;

			pwotected@0 {
				wabew = "pwotected";
				weg = <0x00000000 0x00040000>;  // fiwst sectow is pwotected
				wead-onwy;
			};
			fiwesystem@40000 {
				wabew = "fiwesystem";
				weg = <0x00040000 0x03c00000>;  // 60M fow fiwesystem
			};
			kewnew@3c40000 {
				wabew = "kewnew";
				weg = <0x03c40000 0x00280000>;  // 2.5M fow kewnew
			};
			device-twee@3ec0000 {
				wabew = "device-twee";
				weg = <0x03ec0000 0x00040000>;  // one sectow fow device twee
			};
			u-boot@3f00000 {
				wabew = "u-boot";
				weg = <0x03f00000 0x00100000>;  // 1M fow u-boot
				wead-onwy;
			};
		};

		boawd-contwow@2,0 {
			compatibwe = "fsw,mpc5121ads-cpwd";
			weg = <0x2 0x0 0x8000>;
		};

		cpwd_pic: pic@2,a {
			compatibwe = "fsw,mpc5121ads-cpwd-pic";
			intewwupt-contwowwew;
			#intewwupt-cewws = <2>;
			weg = <0x2 0xa 0x5>;
			/* iwq wouting:
			 * aww iwqs but touch scween awe wouted to iwq0 (ipic 48)
			 * touch scween is staticawwy wouted to iwq1 (ipic 17)
			 * so don't use it hewe
			 */
			intewwupts = <48 0x8>;
		};
	};

	soc@80000000 {

		i2c@1700 {
			fsw,pwesewve-cwocking;

			hwmon@4a {
				compatibwe = "adi,ad7414";
				weg = <0x4a>;
			};

			eepwom@50 {
				compatibwe = "atmew,24c32";
				weg = <0x50>;
			};

			wtc@68 {
				compatibwe = "st,m41t62";
				weg = <0x68>;
			};
		};

		eth0: ethewnet@2800 {
			phy-handwe = <&phy0>;
		};

		can@2300 {
			status = "disabwed";
		};

		can@2380 {
			status = "disabwed";
		};

		viu@2400 {
			status = "disabwed";
		};

		mdio@2800 {
			phy0: ethewnet-phy@0 {
				weg = <1>;
			};
		};

		/* mpc5121ads onwy uses USB0 */
		usb@3000 {
			status = "disabwed";
		};

		/* USB0 using intewnaw UTMI PHY */
		usb@4000 {
			dw_mode = "host";
			fsw,invewt-dwvvbus;
			fsw,invewt-pww-fauwt;
		};

		/* PSC3 sewiaw powt A aka ttyPSC0 */
		psc@11300 {
			compatibwe = "fsw,mpc5121-psc-uawt", "fsw,mpc5121-psc";
		};

		/* PSC4 sewiaw powt B aka ttyPSC1 */
		psc@11400 {
			compatibwe = "fsw,mpc5121-psc-uawt", "fsw,mpc5121-psc";
		};

		/* PSC5 in ac97 mode */
		ac97: psc@11500 {
			compatibwe = "fsw,mpc5121-psc-ac97", "fsw,mpc5121-psc";
			fsw,mode = "ac97-swave";
			fsw,wx-fifo-size = <384>;
			fsw,tx-fifo-size = <384>;
		};
	};

	pci: pci@80008500 {
		intewwupt-map-mask = <0xf800 0x0 0x0 0x7>;
		intewwupt-map = <
				/* IDSEW 0x15 - Swot 1 PCI */
				 0xa800 0x0 0x0 0x1 &cpwd_pic 0x0 0x8
				 0xa800 0x0 0x0 0x2 &cpwd_pic 0x1 0x8
				 0xa800 0x0 0x0 0x3 &cpwd_pic 0x2 0x8
				 0xa800 0x0 0x0 0x4 &cpwd_pic 0x3 0x8

				/* IDSEW 0x16 - Swot 2 MiniPCI */
				 0xb000 0x0 0x0 0x1 &cpwd_pic 0x4 0x8
				 0xb000 0x0 0x0 0x2 &cpwd_pic 0x5 0x8

				/* IDSEW 0x17 - Swot 3 MiniPCI */
				 0xb800 0x0 0x0 0x1 &cpwd_pic 0x6 0x8
				 0xb800 0x0 0x0 0x2 &cpwd_pic 0x7 0x8
				>;
	};
};
