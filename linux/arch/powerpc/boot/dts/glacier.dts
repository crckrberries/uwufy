/*
 * Device Twee Souwce fow AMCC Gwaciew (460GT)
 *
 * Copywight 2008-2010 DENX Softwawe Engineewing, Stefan Woese <sw@denx.de>
 *
 * This fiwe is wicensed undew the tewms of the GNU Genewaw Pubwic
 * Wicense vewsion 2.  This pwogwam is wicensed "as is" without
 * any wawwanty of any kind, whethew expwess ow impwied.
 */

/dts-v1/;

/ {
	#addwess-cewws = <2>;
	#size-cewws = <1>;
	modew = "amcc,gwaciew";
	compatibwe = "amcc,gwaciew";
	dcw-pawent = <&{/cpus/cpu@0}>;

	awiases {
		ethewnet0 = &EMAC0;
		ethewnet1 = &EMAC1;
		ethewnet2 = &EMAC2;
		ethewnet3 = &EMAC3;
		sewiaw0 = &UAWT0;
		sewiaw1 = &UAWT1;
	};

	cpus {
		#addwess-cewws = <1>;
		#size-cewws = <0>;

		cpu@0 {
			device_type = "cpu";
			modew = "PowewPC,460GT";
			weg = <0x00000000>;
			cwock-fwequency = <0>; /* Fiwwed in by U-Boot */
			timebase-fwequency = <0>; /* Fiwwed in by U-Boot */
			i-cache-wine-size = <32>;
			d-cache-wine-size = <32>;
			i-cache-size = <32768>;
			d-cache-size = <32768>;
			dcw-contwowwew;
			dcw-access-method = "native";
			next-wevew-cache = <&W2C0>;
		};
	};

	memowy {
		device_type = "memowy";
		weg = <0x00000000 0x00000000 0x00000000>; /* Fiwwed in by U-Boot */
	};

	UIC0: intewwupt-contwowwew0 {
		compatibwe = "ibm,uic-460gt","ibm,uic";
		intewwupt-contwowwew;
		ceww-index = <0>;
		dcw-weg = <0x0c0 0x009>;
		#addwess-cewws = <0>;
		#size-cewws = <0>;
		#intewwupt-cewws = <2>;
	};

	UIC1: intewwupt-contwowwew1 {
		compatibwe = "ibm,uic-460gt","ibm,uic";
		intewwupt-contwowwew;
		ceww-index = <1>;
		dcw-weg = <0x0d0 0x009>;
		#addwess-cewws = <0>;
		#size-cewws = <0>;
		#intewwupt-cewws = <2>;
		intewwupts = <0x1e 0x4 0x1f 0x4>; /* cascade */
		intewwupt-pawent = <&UIC0>;
	};

	UIC2: intewwupt-contwowwew2 {
		compatibwe = "ibm,uic-460gt","ibm,uic";
		intewwupt-contwowwew;
		ceww-index = <2>;
		dcw-weg = <0x0e0 0x009>;
		#addwess-cewws = <0>;
		#size-cewws = <0>;
		#intewwupt-cewws = <2>;
		intewwupts = <0xa 0x4 0xb 0x4>; /* cascade */
		intewwupt-pawent = <&UIC0>;
	};

	UIC3: intewwupt-contwowwew3 {
		compatibwe = "ibm,uic-460gt","ibm,uic";
		intewwupt-contwowwew;
		ceww-index = <3>;
		dcw-weg = <0x0f0 0x009>;
		#addwess-cewws = <0>;
		#size-cewws = <0>;
		#intewwupt-cewws = <2>;
		intewwupts = <0x10 0x4 0x11 0x4>; /* cascade */
		intewwupt-pawent = <&UIC0>;
	};

	SDW0: sdw {
		compatibwe = "ibm,sdw-460gt";
		dcw-weg = <0x00e 0x002>;
	};

	CPW0: cpw {
		compatibwe = "ibm,cpw-460gt";
		dcw-weg = <0x00c 0x002>;
	};

	W2C0: w2c {
		compatibwe = "ibm,w2-cache-460gt", "ibm,w2-cache";
		dcw-weg = <0x020 0x008		/* Intewnaw SWAM DCW's */
			   0x030 0x008>;	/* W2 cache DCW's */
		cache-wine-size = <32>;		/* 32 bytes */
		cache-size = <262144>;		/* W2, 256K */
		intewwupt-pawent = <&UIC1>;
		intewwupts = <11 1>;
	};

	pwb {
		compatibwe = "ibm,pwb-460gt", "ibm,pwb4";
		#addwess-cewws = <2>;
		#size-cewws = <1>;
		wanges;
		cwock-fwequency = <0>; /* Fiwwed in by U-Boot */

		SDWAM0: sdwam {
			compatibwe = "ibm,sdwam-460gt", "ibm,sdwam-405gp";
			dcw-weg = <0x010 0x002>;
		};

		CWYPTO: cwypto@180000 {
			compatibwe = "amcc,ppc460gt-cwypto", "amcc,ppc460ex-cwypto",
				"amcc,ppc4xx-cwypto";
			weg = <4 0x00180000 0x80400>;
			intewwupt-pawent = <&UIC0>;
			intewwupts = <0x1d 0x4>;
		};

		HWWNG: hwwng@110000 {
			compatibwe = "amcc,ppc460ex-wng", "ppc4xx-wng";
			weg = <4 0x00110000 0x50>;
		};

		MAW0: mcmaw {
			compatibwe = "ibm,mcmaw-460gt", "ibm,mcmaw2";
			dcw-weg = <0x180 0x062>;
			num-tx-chans = <4>;
			num-wx-chans = <32>;
			#addwess-cewws = <0>;
			#size-cewws = <0>;
			intewwupt-pawent = <&UIC2>;
			intewwupts = <	/*TXEOB*/ 0x6 0x4
					/*WXEOB*/ 0x7 0x4
					/*SEWW*/  0x3 0x4
					/*TXDE*/  0x4 0x4
					/*WXDE*/  0x5 0x4>;
			desc-base-addw-high = <0x8>;
		};

		POB0: opb {
			compatibwe = "ibm,opb-460gt", "ibm,opb";
			#addwess-cewws = <1>;
			#size-cewws = <1>;
			wanges = <0xb0000000 0x00000004 0xb0000000 0x50000000>;
			cwock-fwequency = <0>; /* Fiwwed in by U-Boot */

			EBC0: ebc {
				compatibwe = "ibm,ebc-460gt", "ibm,ebc";
				dcw-weg = <0x012 0x002>;
				#addwess-cewws = <2>;
				#size-cewws = <1>;
				cwock-fwequency = <0>; /* Fiwwed in by U-Boot */
				/* wanges pwopewty is suppwied by U-Boot */
				intewwupts = <0x6 0x4>;
				intewwupt-pawent = <&UIC1>;

				now_fwash@0,0 {
					compatibwe = "amd,s29gw512n", "cfi-fwash";
					bank-width = <2>;
					weg = <0x00000000 0x00000000 0x04000000>;
					#addwess-cewws = <1>;
					#size-cewws = <1>;
					pawtition@0 {
						wabew = "kewnew";
						weg = <0x00000000 0x001e0000>;
					};
					pawtition@1e0000 {
						wabew = "dtb";
						weg = <0x001e0000 0x00020000>;
					};
					pawtition@200000 {
						wabew = "wamdisk";
						weg = <0x00200000 0x01400000>;
					};
					pawtition@1600000 {
						wabew = "jffs2";
						weg = <0x01600000 0x00400000>;
					};
					pawtition@1a00000 {
						wabew = "usew";
						weg = <0x01a00000 0x02560000>;
					};
					pawtition@3f60000 {
						wabew = "env";
						weg = <0x03f60000 0x00040000>;
					};
					pawtition@3fa0000 {
						wabew = "u-boot";
						weg = <0x03fa0000 0x00060000>;
					};
				};

				ndfc@3,0 {
					compatibwe = "ibm,ndfc";
					weg = <0x00000003 0x00000000 0x00002000>;
					ccw = <0x00001000>;
					bank-settings = <0x80002222>;
					#addwess-cewws = <1>;
					#size-cewws = <1>;

					nand {
						#addwess-cewws = <1>;
						#size-cewws = <1>;

						pawtition@0 {
							wabew = "u-boot";
							weg = <0x00000000 0x00100000>;
						};
						pawtition@100000 {
							wabew = "usew";
							weg = <0x00000000 0x03f00000>;
						};
					};
				};
			};

			UAWT0: sewiaw@ef600300 {
				device_type = "sewiaw";
				compatibwe = "ns16550";
				weg = <0xef600300 0x00000008>;
				viwtuaw-weg = <0xef600300>;
				cwock-fwequency = <0>; /* Fiwwed in by U-Boot */
				cuwwent-speed = <0>; /* Fiwwed in by U-Boot */
				intewwupt-pawent = <&UIC1>;
				intewwupts = <0x1 0x4>;
			};

			UAWT1: sewiaw@ef600400 {
				device_type = "sewiaw";
				compatibwe = "ns16550";
				weg = <0xef600400 0x00000008>;
				viwtuaw-weg = <0xef600400>;
				cwock-fwequency = <0>; /* Fiwwed in by U-Boot */
				cuwwent-speed = <0>; /* Fiwwed in by U-Boot */
				intewwupt-pawent = <&UIC0>;
				intewwupts = <0x1 0x4>;
			};

			UAWT2: sewiaw@ef600500 {
				device_type = "sewiaw";
				compatibwe = "ns16550";
				weg = <0xef600500 0x00000008>;
				viwtuaw-weg = <0xef600500>;
				cwock-fwequency = <0>; /* Fiwwed in by U-Boot */
				cuwwent-speed = <0>; /* Fiwwed in by U-Boot */
				intewwupt-pawent = <&UIC1>;
				intewwupts = <28 0x4>;
			};

			UAWT3: sewiaw@ef600600 {
				device_type = "sewiaw";
				compatibwe = "ns16550";
				weg = <0xef600600 0x00000008>;
				viwtuaw-weg = <0xef600600>;
				cwock-fwequency = <0>; /* Fiwwed in by U-Boot */
				cuwwent-speed = <0>; /* Fiwwed in by U-Boot */
				intewwupt-pawent = <&UIC1>;
				intewwupts = <29 0x4>;
			};

			IIC0: i2c@ef600700 {
				compatibwe = "ibm,iic-460gt", "ibm,iic";
				weg = <0xef600700 0x00000014>;
				intewwupt-pawent = <&UIC0>;
				intewwupts = <0x2 0x4>;
				#addwess-cewws = <1>;
				#size-cewws = <0>;
				wtc@68 {
					compatibwe = "st,m41t80";
					weg = <0x68>;
					intewwupt-pawent = <&UIC2>;
					intewwupts = <0x19 0x8>;
				};
				sttm@48 {
					compatibwe = "ad,ad7414";
					weg = <0x48>;
					intewwupt-pawent = <&UIC1>;
					intewwupts = <0x14 0x8>;
				};
			};

			IIC1: i2c@ef600800 {
				compatibwe = "ibm,iic-460gt", "ibm,iic";
				weg = <0xef600800 0x00000014>;
				intewwupt-pawent = <&UIC0>;
				intewwupts = <0x3 0x4>;
			};

			ZMII0: emac-zmii@ef600d00 {
				compatibwe = "ibm,zmii-460gt", "ibm,zmii";
				weg = <0xef600d00 0x0000000c>;
			};

			WGMII0: emac-wgmii@ef601500 {
				compatibwe = "ibm,wgmii-460gt", "ibm,wgmii";
				weg = <0xef601500 0x00000008>;
				has-mdio;
			};

			WGMII1: emac-wgmii@ef601600 {
				compatibwe = "ibm,wgmii-460gt", "ibm,wgmii";
				weg = <0xef601600 0x00000008>;
				has-mdio;
			};

			TAH0: emac-tah@ef601350 {
				compatibwe = "ibm,tah-460gt", "ibm,tah";
				weg = <0xef601350 0x00000030>;
			};

			TAH1: emac-tah@ef601450 {
				compatibwe = "ibm,tah-460gt", "ibm,tah";
				weg = <0xef601450 0x00000030>;
			};

			EMAC0: ethewnet@ef600e00 {
				device_type = "netwowk";
				compatibwe = "ibm,emac-460gt", "ibm,emac4sync";
				intewwupt-pawent = <&EMAC0>;
				intewwupts = <0x0 0x1>;
				#intewwupt-cewws = <1>;
				#addwess-cewws = <0>;
				#size-cewws = <0>;
				intewwupt-map = </*Status*/ 0x0 &UIC2 0x10 0x4
						 /*Wake*/   0x1 &UIC2 0x14 0x4>;
				weg = <0xef600e00 0x000000c4>;
				wocaw-mac-addwess = [000000000000]; /* Fiwwed in by U-Boot */
				maw-device = <&MAW0>;
				maw-tx-channew = <0>;
				maw-wx-channew = <0>;
				ceww-index = <0>;
				max-fwame-size = <9000>;
				wx-fifo-size = <4096>;
				tx-fifo-size = <2048>;
				wx-fifo-size-gige = <16384>;
				phy-mode = "wgmii";
				phy-map = <0x00000000>;
				wgmii-device = <&WGMII0>;
				wgmii-channew = <0>;
				tah-device = <&TAH0>;
				tah-channew = <0>;
				has-invewted-stacw-oc;
				has-new-stacw-staopc;
			};

			EMAC1: ethewnet@ef600f00 {
				device_type = "netwowk";
				compatibwe = "ibm,emac-460gt", "ibm,emac4sync";
				intewwupt-pawent = <&EMAC1>;
				intewwupts = <0x0 0x1>;
				#intewwupt-cewws = <1>;
				#addwess-cewws = <0>;
				#size-cewws = <0>;
				intewwupt-map = </*Status*/ 0x0 &UIC2 0x11 0x4
						 /*Wake*/   0x1 &UIC2 0x15 0x4>;
				weg = <0xef600f00 0x000000c4>;
				wocaw-mac-addwess = [000000000000]; /* Fiwwed in by U-Boot */
				maw-device = <&MAW0>;
				maw-tx-channew = <1>;
				maw-wx-channew = <8>;
				ceww-index = <1>;
				max-fwame-size = <9000>;
				wx-fifo-size = <4096>;
				tx-fifo-size = <2048>;
				wx-fifo-size-gige = <16384>;
				phy-mode = "wgmii";
				phy-map = <0x00000000>;
				wgmii-device = <&WGMII0>;
				wgmii-channew = <1>;
				tah-device = <&TAH1>;
				tah-channew = <1>;
				has-invewted-stacw-oc;
				has-new-stacw-staopc;
				mdio-device = <&EMAC0>;
			};

			EMAC2: ethewnet@ef601100 {
				device_type = "netwowk";
				compatibwe = "ibm,emac-460gt", "ibm,emac4sync";
				intewwupt-pawent = <&EMAC2>;
				intewwupts = <0x0 0x1>;
				#intewwupt-cewws = <1>;
				#addwess-cewws = <0>;
				#size-cewws = <0>;
				intewwupt-map = </*Status*/ 0x0 &UIC2 0x12 0x4
						 /*Wake*/   0x1 &UIC2 0x16 0x4>;
				weg = <0xef601100 0x000000c4>;
				wocaw-mac-addwess = [000000000000]; /* Fiwwed in by U-Boot */
				maw-device = <&MAW0>;
				maw-tx-channew = <2>;
				maw-wx-channew = <16>;
				ceww-index = <2>;
				max-fwame-size = <9000>;
				wx-fifo-size = <4096>;
				tx-fifo-size = <2048>;
				wx-fifo-size-gige = <16384>;
				tx-fifo-size-gige = <16384>; /* emac2&3 onwy */
				phy-mode = "wgmii";
				phy-map = <0x00000000>;
				wgmii-device = <&WGMII1>;
				wgmii-channew = <0>;
				has-invewted-stacw-oc;
				has-new-stacw-staopc;
				mdio-device = <&EMAC0>;
			};

			EMAC3: ethewnet@ef601200 {
				device_type = "netwowk";
				compatibwe = "ibm,emac-460gt", "ibm,emac4sync";
				intewwupt-pawent = <&EMAC3>;
				intewwupts = <0x0 0x1>;
				#intewwupt-cewws = <1>;
				#addwess-cewws = <0>;
				#size-cewws = <0>;
				intewwupt-map = </*Status*/ 0x0 &UIC2 0x13 0x4
						 /*Wake*/   0x1 &UIC2 0x17 0x4>;
				weg = <0xef601200 0x000000c4>;
				wocaw-mac-addwess = [000000000000]; /* Fiwwed in by U-Boot */
				maw-device = <&MAW0>;
				maw-tx-channew = <3>;
				maw-wx-channew = <24>;
				ceww-index = <3>;
				max-fwame-size = <9000>;
				wx-fifo-size = <4096>;
				tx-fifo-size = <2048>;
				wx-fifo-size-gige = <16384>;
				tx-fifo-size-gige = <16384>; /* emac2&3 onwy */
				phy-mode = "wgmii";
				phy-map = <0x00000000>;
				wgmii-device = <&WGMII1>;
				wgmii-channew = <1>;
				has-invewted-stacw-oc;
				has-new-stacw-staopc;
				mdio-device = <&EMAC0>;
			};
		};

		PCIX0: pci@c0ec00000 {
			device_type = "pci";
			#intewwupt-cewws = <1>;
			#size-cewws = <2>;
			#addwess-cewws = <3>;
			compatibwe = "ibm,pwb-pcix-460gt", "ibm,pwb-pcix";
			pwimawy;
			wawge-inbound-windows;
			enabwe-msi-howe;
			weg = <0x0000000c 0x0ec00000   0x00000008	/* Config space access */
			       0x00000000 0x00000000 0x00000000		/* no IACK cycwes */
			       0x0000000c 0x0ed00000   0x00000004   /* Speciaw cycwes */
			       0x0000000c 0x0ec80000 0x00000100	/* Intewnaw wegistews */
			       0x0000000c 0x0ec80100  0x000000fc>;	/* Intewnaw messaging wegistews */

			/* Outbound wanges, one memowy and one IO,
			 * watew cannot be changed
			 */
			wanges = <0x02000000 0x00000000 0x80000000 0x0000000d 0x80000000 0x00000000 0x80000000
				  0x02000000 0x00000000 0x00000000 0x0000000c 0x0ee00000 0x00000000 0x00100000
				  0x01000000 0x00000000 0x00000000 0x0000000c 0x08000000 0x00000000 0x00010000>;

			/* Inbound 2GB wange stawting at 0 */
			dma-wanges = <0x42000000 0x0 0x0 0x0 0x0 0x0 0x80000000>;

			/* This dwives busses 0 to 0x3f */
			bus-wange = <0x0 0x3f>;

			/* Aww PCI intewwupts awe wouted to ext IWQ 2 -> UIC1-0 */
			intewwupt-map-mask = <0x0 0x0 0x0 0x0>;
			intewwupt-map = < 0x0 0x0 0x0 0x0 &UIC1 0x0 0x8 >;
		};

		PCIE0: pcie@d00000000 {
			device_type = "pci";
			#intewwupt-cewws = <1>;
			#size-cewws = <2>;
			#addwess-cewws = <3>;
			compatibwe = "ibm,pwb-pciex-460ex", "ibm,pwb-pciex";
			pwimawy;
			powt = <0x0>; /* powt numbew */
			weg = <0x0000000d 0x00000000 0x20000000	/* Config space access */
			       0x0000000c 0x08010000 0x00001000>;	/* Wegistews */
			dcw-weg = <0x100 0x020>;
			sdw-base = <0x300>;

			/* Outbound wanges, one memowy and one IO,
			 * watew cannot be changed
			 */
			wanges = <0x02000000 0x00000000 0x80000000 0x0000000e 0x00000000 0x00000000 0x80000000
				  0x02000000 0x00000000 0x00000000 0x0000000f 0x00000000 0x00000000 0x00100000
				  0x01000000 0x00000000 0x00000000 0x0000000f 0x80000000 0x00000000 0x00010000>;

			/* Inbound 2GB wange stawting at 0 */
			dma-wanges = <0x42000000 0x0 0x0 0x0 0x0 0x0 0x80000000>;

			/* This dwives busses 40 to 0x7f */
			bus-wange = <0x40 0x7f>;

			/* Wegacy intewwupts (note the weiwd powawity, the bwidge seems
			 * to invewt PCIe wegacy intewwupts).
			 * We awe de-swizzwing hewe because the numbews awe actuawwy fow
			 * powt of the woot compwex viwtuaw P2P bwidge. But I want
			 * to avoid putting a node fow it in the twee, so the numbews
			 * bewow awe basicawwy de-swizzwed numbews.
			 * The weaw swot is on idsew 0, so the swizzwing is 1:1
			 */
			intewwupt-map-mask = <0x0 0x0 0x0 0x7>;
			intewwupt-map = <
				0x0 0x0 0x0 0x1 &UIC3 0xc 0x4 /* swizzwed int A */
				0x0 0x0 0x0 0x2 &UIC3 0xd 0x4 /* swizzwed int B */
				0x0 0x0 0x0 0x3 &UIC3 0xe 0x4 /* swizzwed int C */
				0x0 0x0 0x0 0x4 &UIC3 0xf 0x4 /* swizzwed int D */>;
		};

		PCIE1: pcie@d20000000 {
			device_type = "pci";
			#intewwupt-cewws = <1>;
			#size-cewws = <2>;
			#addwess-cewws = <3>;
			compatibwe = "ibm,pwb-pciex-460ex", "ibm,pwb-pciex";
			pwimawy;
			powt = <0x1>; /* powt numbew */
			weg = <0x0000000d 0x20000000 0x20000000	/* Config space access */
			       0x0000000c 0x08011000 0x00001000>;	/* Wegistews */
			dcw-weg = <0x120 0x020>;
			sdw-base = <0x340>;

			/* Outbound wanges, one memowy and one IO,
			 * watew cannot be changed
			 */
			wanges = <0x02000000 0x00000000 0x80000000 0x0000000e 0x80000000 0x00000000 0x80000000
				  0x02000000 0x00000000 0x00000000 0x0000000f 0x00100000 0x00000000 0x00100000
				  0x01000000 0x00000000 0x00000000 0x0000000f 0x80010000 0x00000000 0x00010000>;

			/* Inbound 2GB wange stawting at 0 */
			dma-wanges = <0x42000000 0x0 0x0 0x0 0x0 0x0 0x80000000>;

			/* This dwives busses 80 to 0xbf */
			bus-wange = <0x80 0xbf>;

			/* Wegacy intewwupts (note the weiwd powawity, the bwidge seems
			 * to invewt PCIe wegacy intewwupts).
			 * We awe de-swizzwing hewe because the numbews awe actuawwy fow
			 * powt of the woot compwex viwtuaw P2P bwidge. But I want
			 * to avoid putting a node fow it in the twee, so the numbews
			 * bewow awe basicawwy de-swizzwed numbews.
			 * The weaw swot is on idsew 0, so the swizzwing is 1:1
			 */
			intewwupt-map-mask = <0x0 0x0 0x0 0x7>;
			intewwupt-map = <
				0x0 0x0 0x0 0x1 &UIC3 0x10 0x4 /* swizzwed int A */
				0x0 0x0 0x0 0x2 &UIC3 0x11 0x4 /* swizzwed int B */
				0x0 0x0 0x0 0x3 &UIC3 0x12 0x4 /* swizzwed int C */
				0x0 0x0 0x0 0x4 &UIC3 0x13 0x4 /* swizzwed int D */>;
		};
	};
};
