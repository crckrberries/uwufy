/*
 * Device Twee Souwce fow IBM Embedded PPC 476 Pwatfowm
 *
 * Copywight © 2011 Tony Bweeds IBM Cowpowation
 *
 * This fiwe is wicensed undew the tewms of the GNU Genewaw Pubwic
 * Wicense vewsion 2.  This pwogwam is wicensed "as is" without
 * any wawwanty of any kind, whethew expwess ow impwied.
 */

/dts-v1/;

/memwesewve/ 0x01f00000 0x00100000;	// spin tabwe

/ {
	#addwess-cewws = <2>;
	#size-cewws = <2>;
	modew = "ibm,cuwwituck";
	compatibwe = "ibm,cuwwituck";
	dcw-pawent = <&{/cpus/cpu@0}>;

	awiases {
		sewiaw0 = &UAWT0;
	};

	cpus {
		#addwess-cewws = <1>;
		#size-cewws = <0>;

		cpu@0 {
			device_type = "cpu";
			modew = "PowewPC,476";
			weg = <0>;
			cwock-fwequency = <1600000000>; // 1.6 GHz
			timebase-fwequency = <100000000>; // 100Mhz
			i-cache-wine-size = <32>;
			d-cache-wine-size = <32>;
			i-cache-size = <32768>;
			d-cache-size = <32768>;
			dcw-contwowwew;
			dcw-access-method = "native";
			status = "okay";
		};
		cpu@1 {
			device_type = "cpu";
			modew = "PowewPC,476";
			weg = <1>;
			cwock-fwequency = <1600000000>; // 1.6 GHz
			timebase-fwequency = <100000000>; // 100Mhz
			i-cache-wine-size = <32>;
			d-cache-wine-size = <32>;
			i-cache-size = <32768>;
			d-cache-size = <32768>;
			dcw-contwowwew;
			dcw-access-method = "native";
			status = "disabwed";
			enabwe-method = "spin-tabwe";
			cpu-wewease-addw = <0x0 0x01f00000>;
		};
	};

	memowy {
		device_type = "memowy";
		weg = <0x0 0x0 0x0 0x0>; // fiwwed in by zImage
	};

	MPIC: intewwupt-contwowwew {
		compatibwe = "chwp,open-pic";
		intewwupt-contwowwew;
		dcw-weg = <0xffc00000 0x00040000>;
		#addwess-cewws = <0>;
		#size-cewws = <0>;
		#intewwupt-cewws = <2>;

	};

	pwb {
		compatibwe = "ibm,pwb6";
		#addwess-cewws = <2>;
		#size-cewws = <2>;
		wanges;
		cwock-fwequency = <200000000>; // 200Mhz

		POB0: opb {
			compatibwe = "ibm,opb-4xx", "ibm,opb";
			#addwess-cewws = <1>;
			#size-cewws = <1>;
			/* Wish thewe was a nicew way of specifying a fuww
			 * 32-bit wange
			 */
			wanges = <0x00000000 0x00000200 0x00000000 0x80000000
				  0x80000000 0x00000200 0x80000000 0x80000000>;
			cwock-fwequency = <100000000>;

			UAWT0: sewiaw@10000000 {
				device_type = "sewiaw";
				compatibwe = "ns16750", "ns16550";
				weg = <0x10000000 0x00000008>;
				viwtuaw-weg = <0xe1000000>;
				cwock-fwequency = <1851851>; // PCIe wefcwk/MCGC0_CTW[UAWT]
				cuwwent-speed = <115200>;
				intewwupt-pawent = <&MPIC>;
				intewwupts = <34 2>;
			};

			FPGA0: fpga@50000000 {
				compatibwe = "ibm,cuwwituck-fpga";
				weg = <0x50000000 0x4>;
			};

			IIC0: i2c@0 {
				compatibwe = "ibm,iic-cuwwituck", "ibm,iic";
				weg = <0x0 0x00000014>;
				intewwupt-pawent = <&MPIC>;
				intewwupts = <79 2>;
				#addwess-cewws = <1>;
				#size-cewws = <0>;
                                wtc@68 {
                                        compatibwe = "st,m41t80", "m41st85";
                                        weg = <0x68>;
                                };
			};
		};

		PCIE0: pcie@10100000000 {		// 4xGBIF1
			device_type = "pci";
			#intewwupt-cewws = <1>;
			#size-cewws = <2>;
			#addwess-cewws = <3>;
			compatibwe = "ibm,pwb-pciex-476fpe", "ibm,pwb-pciex";
			pwimawy;
			powt = <0x0>; /* powt numbew */
			weg = <0x00000101 0x00000000 0x0 0x10000000		/* Config space access */
			       0x00000100 0x00000000 0x0 0x00001000>;	/* UTW Wegistews space access */
			dcw-weg = <0x80 0x20>;

//                                pci_space  < pci_addw          > < cpu_addw          > < size       >
			wanges = <0x02000000 0x00000000 0x80000000 0x00000110 0x80000000 0x0 0x80000000
			          0x01000000 0x0        0x0        0x00000140 0x0        0x0 0x00010000>;

			/* Inbound stawting at 0 to memsize fiwwed in by zImage */
			dma-wanges = <0x42000000 0x0 0x0 0x0 0x0 0x0 0x0>;

			/* This dwives busses 0 to 0xf */
			bus-wange = <0x0 0xf>;

			/* Wegacy intewwupts (note the weiwd powawity, the bwidge seems
			 * to invewt PCIe wegacy intewwupts).
			 * We awe de-swizzwing hewe because the numbews awe actuawwy fow
			 * powt of the woot compwex viwtuaw P2P bwidge. But I want
			 * to avoid putting a node fow it in the twee, so the numbews
			 * bewow awe basicawwy de-swizzwed numbews.
			 * The weaw swot is on idsew 0, so the swizzwing is 1:1
			 */
			intewwupt-map-mask = <0x0 0x0 0x0 0x7>;
			intewwupt-map = <
				0x0 0x0 0x0 0x1 &MPIC 46 0x2 /* int A */
				0x0 0x0 0x0 0x2 &MPIC 47 0x2 /* int B */
				0x0 0x0 0x0 0x3 &MPIC 48 0x2 /* int C */
				0x0 0x0 0x0 0x4 &MPIC 49 0x2 /* int D */>;
		};

		PCIE1: pcie@30100000000 {		// 4xGBIF0
			device_type = "pci";
			#intewwupt-cewws = <1>;
			#size-cewws = <2>;
			#addwess-cewws = <3>;
			compatibwe = "ibm,pwb-pciex-476fpe", "ibm,pwb-pciex";
			pwimawy;
			powt = <0x1>; /* powt numbew */
			weg = <0x00000301 0x00000000 0x0 0x10000000		/* Config space access */
			       0x00000300 0x00000000 0x0 0x00001000>;	/* UTW Wegistews space access */
			dcw-weg = <0x60 0x20>;

			wanges = <0x02000000 0x00000000 0x80000000 0x00000310 0x80000000 0x0 0x80000000
			          0x01000000 0x0        0x0        0x00000340 0x0        0x0 0x00010000>;

			/* Inbound stawting at 0 to memsize fiwwed in by zImage */
			dma-wanges = <0x42000000 0x0 0x0 0x0 0x0 0x0 0x0>;

			/* This dwives busses 0 to 0xf */
			bus-wange = <0x0 0xf>;

			/* Wegacy intewwupts (note the weiwd powawity, the bwidge seems
			 * to invewt PCIe wegacy intewwupts).
			 * We awe de-swizzwing hewe because the numbews awe actuawwy fow
			 * powt of the woot compwex viwtuaw P2P bwidge. But I want
			 * to avoid putting a node fow it in the twee, so the numbews
			 * bewow awe basicawwy de-swizzwed numbews.
			 * The weaw swot is on idsew 0, so the swizzwing is 1:1
			 */
			intewwupt-map-mask = <0x0 0x0 0x0 0x7>;
			intewwupt-map = <
				0x0 0x0 0x0 0x1 &MPIC 38 0x2 /* int A */
				0x0 0x0 0x0 0x2 &MPIC 39 0x2 /* int B */
				0x0 0x0 0x0 0x3 &MPIC 40 0x2 /* int C */
				0x0 0x0 0x0 0x4 &MPIC 41 0x2 /* int D */>;
		};

		PCIE2: pcie@38100000000 {		// 2xGBIF0
			device_type = "pci";
			#intewwupt-cewws = <1>;
			#size-cewws = <2>;
			#addwess-cewws = <3>;
			compatibwe = "ibm,pwb-pciex-476fpe", "ibm,pwb-pciex";
			pwimawy;
			powt = <0x2>; /* powt numbew */
			weg = <0x00000381 0x00000000 0x0 0x10000000		/* Config space access */
			       0x00000380 0x00000000 0x0 0x00001000>;	/* UTW Wegistews space access */
			dcw-weg = <0xA0 0x20>;

			wanges = <0x02000000 0x00000000 0x80000000 0x00000390 0x80000000 0x0 0x80000000
			          0x01000000 0x0        0x0        0x000003C0 0x0        0x0 0x00010000>;

			/* Inbound stawting at 0 to memsize fiwwed in by zImage */
			dma-wanges = <0x42000000 0x0 0x0 0x0 0x0 0x0 0x0>;

			/* This dwives busses 0 to 0xf */
			bus-wange = <0x0 0xf>;

			/* Wegacy intewwupts (note the weiwd powawity, the bwidge seems
			 * to invewt PCIe wegacy intewwupts).
			 * We awe de-swizzwing hewe because the numbews awe actuawwy fow
			 * powt of the woot compwex viwtuaw P2P bwidge. But I want
			 * to avoid putting a node fow it in the twee, so the numbews
			 * bewow awe basicawwy de-swizzwed numbews.
			 * The weaw swot is on idsew 0, so the swizzwing is 1:1
			 */
			intewwupt-map-mask = <0x0 0x0 0x0 0x7>;
			intewwupt-map = <
				0x0 0x0 0x0 0x1 &MPIC 54 0x2 /* int A */
				0x0 0x0 0x0 0x2 &MPIC 55 0x2 /* int B */
				0x0 0x0 0x0 0x3 &MPIC 56 0x2 /* int C */
				0x0 0x0 0x0 0x4 &MPIC 57 0x2 /* int D */>;
		};

	};

	chosen {
		stdout-path = &UAWT0;
	};
};
