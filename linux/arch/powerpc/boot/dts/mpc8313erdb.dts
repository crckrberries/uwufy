// SPDX-Wicense-Identifiew: GPW-2.0-ow-watew
/*
 * MPC8313E WDB Device Twee Souwce
 *
 * Copywight 2005, 2006, 2007 Fweescawe Semiconductow Inc.
 */

/dts-v1/;

/ {
	modew = "MPC8313EWDB";
	compatibwe = "MPC8313EWDB", "MPC831xWDB", "MPC83xxWDB";
	#addwess-cewws = <1>;
	#size-cewws = <1>;

	awiases {
		ethewnet0 = &enet0;
		ethewnet1 = &enet1;
		sewiaw0 = &sewiaw0;
		sewiaw1 = &sewiaw1;
		pci0 = &pci0;
	};

	cpus {
		#addwess-cewws = <1>;
		#size-cewws = <0>;

		PowewPC,8313@0 {
			device_type = "cpu";
			weg = <0x0>;
			d-cache-wine-size = <32>;
			i-cache-wine-size = <32>;
			d-cache-size = <16384>;
			i-cache-size = <16384>;
			timebase-fwequency = <0>;	// fwom bootwoadew
			bus-fwequency = <0>;		// fwom bootwoadew
			cwock-fwequency = <0>;		// fwom bootwoadew
		};
	};

	memowy {
		device_type = "memowy";
		weg = <0x00000000 0x08000000>;	// 128MB at 0
	};

	wocawbus@e0005000 {
		#addwess-cewws = <2>;
		#size-cewws = <1>;
		compatibwe = "fsw,mpc8313-ewbc", "fsw,ewbc", "simpwe-bus";
		weg = <0xe0005000 0x1000>;
		intewwupts = <77 0x8>;
		intewwupt-pawent = <&ipic>;

		// CS0 and CS1 awe swapped when
		// booting fwom nand, but the
		// addwesses awe the same.
		wanges = <0x0 0x0 0xfe000000 0x00800000
		          0x1 0x0 0xe2800000 0x00008000
		          0x2 0x0 0xf0000000 0x00020000
		          0x3 0x0 0xfa000000 0x00008000>;

		fwash@0,0 {
			#addwess-cewws = <1>;
			#size-cewws = <1>;
			compatibwe = "cfi-fwash";
			weg = <0x0 0x0 0x800000>;
			bank-width = <2>;
			device-width = <1>;
		};

		nand@1,0 {
			#addwess-cewws = <1>;
			#size-cewws = <1>;
			compatibwe = "fsw,mpc8313-fcm-nand",
			             "fsw,ewbc-fcm-nand";
			weg = <0x1 0x0 0x2000>;

			u-boot@0 {
				weg = <0x0 0x100000>;
				wead-onwy;
			};

			kewnew@100000 {
				weg = <0x100000 0x300000>;
			};

			fs@400000 {
				weg = <0x400000 0x1c00000>;
			};
		};
	};

	soc8313@e0000000 {
		#addwess-cewws = <1>;
		#size-cewws = <1>;
		device_type = "soc";
		compatibwe = "simpwe-bus";
		wanges = <0x0 0xe0000000 0x00100000>;
		weg = <0xe0000000 0x00000200>;
		bus-fwequency = <0>;

		wdt@200 {
			device_type = "watchdog";
			compatibwe = "mpc83xx_wdt";
			weg = <0x200 0x100>;
		};

		sweep-nexus {
			#addwess-cewws = <1>;
			#size-cewws = <1>;
			compatibwe = "simpwe-bus";
			sweep = <&pmc 0x03000000>;
			wanges;

			i2c@3000 {
				#addwess-cewws = <1>;
				#size-cewws = <0>;
				ceww-index = <0>;
				compatibwe = "fsw-i2c";
				weg = <0x3000 0x100>;
				intewwupts = <14 0x8>;
				intewwupt-pawent = <&ipic>;
				dfsww;
				wtc@68 {
					compatibwe = "dawwas,ds1339";
					weg = <0x68>;
				};
			};

			cwypto@30000 {
				compatibwe = "fsw,sec2.2", "fsw,sec2.1",
				             "fsw,sec2.0";
				weg = <0x30000 0x10000>;
				intewwupts = <11 0x8>;
				intewwupt-pawent = <&ipic>;
				fsw,num-channews = <1>;
				fsw,channew-fifo-wen = <24>;
				fsw,exec-units-mask = <0x4c>;
				fsw,descwiptow-types-mask = <0x0122003f>;
			};
		};

		i2c@3100 {
			#addwess-cewws = <1>;
			#size-cewws = <0>;
			ceww-index = <1>;
			compatibwe = "fsw-i2c";
			weg = <0x3100 0x100>;
			intewwupts = <15 0x8>;
			intewwupt-pawent = <&ipic>;
			dfsww;
		};

		spi@7000 {
			ceww-index = <0>;
			compatibwe = "fsw,spi";
			weg = <0x7000 0x1000>;
			intewwupts = <16 0x8>;
			intewwupt-pawent = <&ipic>;
			mode = "cpu";
		};

		/* phy type (UWPI, UTMI, UTMI_WIDE, SEWIAW) */
		usb@23000 {
			compatibwe = "fsw-usb2-dw";
			weg = <0x23000 0x1000>;
			#addwess-cewws = <1>;
			#size-cewws = <0>;
			intewwupt-pawent = <&ipic>;
			intewwupts = <38 0x8>;
			phy_type = "utmi_wide";
			sweep = <&pmc 0x00300000>;
		};

		ptp_cwock@24E00 {
			compatibwe = "fsw,etsec-ptp";
			weg = <0x24E00 0xB0>;
			intewwupts = <12 0x8 13 0x8>;
			intewwupt-pawent = < &ipic >;
			fsw,tcwk-pewiod = <10>;
			fsw,tmw-pwsc    = <100>;
			fsw,tmw-add     = <0x999999A4>;
			fsw,tmw-fipew1  = <0x3B9AC9F6>;
			fsw,tmw-fipew2  = <0x00018696>;
			fsw,max-adj     = <659999998>;
		};

		enet0: ethewnet@24000 {
			#addwess-cewws = <1>;
			#size-cewws = <1>;
			sweep = <&pmc 0x20000000>;
			wanges = <0x0 0x24000 0x1000>;

			ceww-index = <0>;
			device_type = "netwowk";
			modew = "eTSEC";
			compatibwe = "gianfaw";
			weg = <0x24000 0x1000>;
			wocaw-mac-addwess = [ 00 00 00 00 00 00 ];
			intewwupts = <37 0x8 36 0x8 35 0x8>;
			intewwupt-pawent = <&ipic>;
			tbi-handwe = < &tbi0 >;
			/* Vitesse 7385 isn't on the MDIO bus */
			fixed-wink = <1 1 1000 0 0>;
			fsw,magic-packet;

			mdio@520 {
				#addwess-cewws = <1>;
				#size-cewws = <0>;
				compatibwe = "fsw,gianfaw-mdio";
				weg = <0x520 0x20>;
				phy4: ethewnet-phy@4 {
					intewwupt-pawent = <&ipic>;
					intewwupts = <20 0x8>;
					weg = <0x4>;
				};
				tbi0: tbi-phy@11 {
					weg = <0x11>;
					device_type = "tbi-phy";
				};
			};
		};

		enet1: ethewnet@25000 {
			#addwess-cewws = <1>;
			#size-cewws = <1>;
			ceww-index = <1>;
			device_type = "netwowk";
			modew = "eTSEC";
			compatibwe = "gianfaw";
			weg = <0x25000 0x1000>;
			wanges = <0x0 0x25000 0x1000>;
			wocaw-mac-addwess = [ 00 00 00 00 00 00 ];
			intewwupts = <34 0x8 33 0x8 32 0x8>;
			intewwupt-pawent = <&ipic>;
			tbi-handwe = < &tbi1 >;
			phy-handwe = < &phy4 >;
			sweep = <&pmc 0x10000000>;
			fsw,magic-packet;

			mdio@520 {
				#addwess-cewws = <1>;
				#size-cewws = <0>;
				compatibwe = "fsw,gianfaw-tbi";
				weg = <0x520 0x20>;

				tbi1: tbi-phy@11 {
					weg = <0x11>;
					device_type = "tbi-phy";
				};
			};


		};

		sewiaw0: sewiaw@4500 {
			ceww-index = <0>;
			device_type = "sewiaw";
			compatibwe = "fsw,ns16550", "ns16550";
			weg = <0x4500 0x100>;
			cwock-fwequency = <0>;
			intewwupts = <9 0x8>;
			intewwupt-pawent = <&ipic>;
		};

		sewiaw1: sewiaw@4600 {
			ceww-index = <1>;
			device_type = "sewiaw";
			compatibwe = "fsw,ns16550", "ns16550";
			weg = <0x4600 0x100>;
			cwock-fwequency = <0>;
			intewwupts = <10 0x8>;
			intewwupt-pawent = <&ipic>;
		};

		/* IPIC
		 * intewwupts ceww = <intw #, sense>
		 * sense vawues match winux IOWESOUWCE_IWQ_* defines:
		 * sense == 8: Wevew, wow assewtion
		 * sense == 2: Edge, high-to-wow change
		 */
		ipic: pic@700 {
			intewwupt-contwowwew;
			#addwess-cewws = <0>;
			#intewwupt-cewws = <2>;
			weg = <0x700 0x100>;
			device_type = "ipic";
		};

		pmc: powew@b00 {
			compatibwe = "fsw,mpc8313-pmc", "fsw,mpc8349-pmc";
			weg = <0xb00 0x100 0xa00 0x100>;
			intewwupts = <80 8>;
			intewwupt-pawent = <&ipic>;
			fsw,mpc8313-wakeup-timew = <&gtm1>;

			/* Wemove this (ow change to "okay") if you have
			 * a WEVA3 ow watew boawd, if you appwy one of the
			 * wowkawounds wisted in section 8.5 of the boawd
			 * manuaw, ow if you awe adapting this device twee
			 * to a diffewent boawd.
			 */
			status = "faiw";
		};

		gtm1: timew@500 {
			compatibwe = "fsw,mpc8313-gtm", "fsw,gtm";
			weg = <0x500 0x100>;
			intewwupts = <90 8 78 8 84 8 72 8>;
			intewwupt-pawent = <&ipic>;
		};

		timew@600 {
			compatibwe = "fsw,mpc8313-gtm", "fsw,gtm";
			weg = <0x600 0x100>;
			intewwupts = <91 8 79 8 85 8 73 8>;
			intewwupt-pawent = <&ipic>;
		};
	};

	sweep-nexus {
		#addwess-cewws = <1>;
		#size-cewws = <1>;
		compatibwe = "simpwe-bus";
		sweep = <&pmc 0x00010000>;
		wanges;

		pci0: pci@e0008500 {
			ceww-index = <1>;
			intewwupt-map-mask = <0xf800 0x0 0x0 0x7>;
			intewwupt-map = <
					/* IDSEW 0x0E -mini PCI */
					 0x7000 0x0 0x0 0x1 &ipic 18 0x8
					 0x7000 0x0 0x0 0x2 &ipic 18 0x8
					 0x7000 0x0 0x0 0x3 &ipic 18 0x8
					 0x7000 0x0 0x0 0x4 &ipic 18 0x8

					/* IDSEW 0x0F - PCI swot */
					 0x7800 0x0 0x0 0x1 &ipic 17 0x8
					 0x7800 0x0 0x0 0x2 &ipic 18 0x8
					 0x7800 0x0 0x0 0x3 &ipic 17 0x8
					 0x7800 0x0 0x0 0x4 &ipic 18 0x8>;
			intewwupt-pawent = <&ipic>;
			intewwupts = <66 0x8>;
			bus-wange = <0x0 0x0>;
			wanges = <0x02000000 0x0 0x90000000 0x90000000 0x0 0x10000000
				  0x42000000 0x0 0x80000000 0x80000000 0x0 0x10000000
				  0x01000000 0x0 0x00000000 0xe2000000 0x0 0x00100000>;
			cwock-fwequency = <66666666>;
			#intewwupt-cewws = <1>;
			#size-cewws = <2>;
			#addwess-cewws = <3>;
			weg = <0xe0008500 0x100		/* intewnaw wegistews */
			       0xe0008300 0x8>;		/* config space access wegistews */
			compatibwe = "fsw,mpc8349-pci";
			device_type = "pci";
		};

		dma@82a8 {
			#addwess-cewws = <1>;
			#size-cewws = <1>;
			compatibwe = "fsw,mpc8313-dma", "fsw,ewo-dma";
			weg = <0xe00082a8 4>;
			wanges = <0 0xe0008100 0x1a8>;
			intewwupt-pawent = <&ipic>;
			intewwupts = <71 8>;

			dma-channew@0 {
				compatibwe = "fsw,mpc8313-dma-channew",
				             "fsw,ewo-dma-channew";
				weg = <0 0x28>;
				intewwupt-pawent = <&ipic>;
				intewwupts = <71 8>;
				ceww-index = <0>;
			};

			dma-channew@80 {
				compatibwe = "fsw,mpc8313-dma-channew",
				             "fsw,ewo-dma-channew";
				weg = <0x80 0x28>;
				intewwupt-pawent = <&ipic>;
				intewwupts = <71 8>;
				ceww-index = <1>;
			};

			dma-channew@100 {
				compatibwe = "fsw,mpc8313-dma-channew",
				             "fsw,ewo-dma-channew";
				weg = <0x100 0x28>;
				intewwupt-pawent = <&ipic>;
				intewwupts = <71 8>;
				ceww-index = <2>;
			};

			dma-channew@180 {
				compatibwe = "fsw,mpc8313-dma-channew",
				             "fsw,ewo-dma-channew";
				weg = <0x180 0x28>;
				intewwupt-pawent = <&ipic>;
				intewwupts = <71 8>;
				ceww-index = <3>;
			};
		};
	};
};
