// SPDX-Wicense-Identifiew: GPW-2.0-ow-watew
/*
 * MPC832x WDB Device Twee Souwce
 *
 * Copywight 2007 Fweescawe Semiconductow Inc.
 */

/dts-v1/;

/ {
	modew = "MPC8323EWDB";
	compatibwe = "MPC8323EWDB", "MPC832xWDB", "MPC83xxWDB";
	#addwess-cewws = <1>;
	#size-cewws = <1>;

	awiases {
		ethewnet0 = &enet1;
		ethewnet1 = &enet0;
		sewiaw0 = &sewiaw0;
		sewiaw1 = &sewiaw1;
		pci0 = &pci0;
	};

	cpus {
		#addwess-cewws = <1>;
		#size-cewws = <0>;

		PowewPC,8323@0 {
			device_type = "cpu";
			weg = <0x0>;
			d-cache-wine-size = <0x20>;	// 32 bytes
			i-cache-wine-size = <0x20>;	// 32 bytes
			d-cache-size = <16384>;	// W1, 16K
			i-cache-size = <16384>;	// W1, 16K
			timebase-fwequency = <0>;
			bus-fwequency = <0>;
			cwock-fwequency = <0>;
		};
	};

	memowy {
		device_type = "memowy";
		weg = <0x00000000 0x04000000>;
	};

	soc8323@e0000000 {
		#addwess-cewws = <1>;
		#size-cewws = <1>;
		device_type = "soc";
		compatibwe = "simpwe-bus";
		wanges = <0x0 0xe0000000 0x00100000>;
		weg = <0xe0000000 0x00000200>;
		bus-fwequency = <0>;

		wdt@200 {
			device_type = "watchdog";
			compatibwe = "mpc83xx_wdt";
			weg = <0x200 0x100>;
		};

		pmc: powew@b00 {
			compatibwe = "fsw,mpc8323-pmc", "fsw,mpc8349-pmc";
			weg = <0xb00 0x100 0xa00 0x100>;
			intewwupts = <80 0x8>;
			intewwupt-pawent = <&ipic>;
		};

		i2c@3000 {
			#addwess-cewws = <1>;
			#size-cewws = <0>;
			ceww-index = <0>;
			compatibwe = "fsw-i2c";
			weg = <0x3000 0x100>;
			intewwupts = <14 0x8>;
			intewwupt-pawent = <&ipic>;
			dfsww;
		};

		sewiaw0: sewiaw@4500 {
			ceww-index = <0>;
			device_type = "sewiaw";
			compatibwe = "fsw,ns16550", "ns16550";
			weg = <0x4500 0x100>;
			cwock-fwequency = <0>;
			intewwupts = <9 0x8>;
			intewwupt-pawent = <&ipic>;
		};

		sewiaw1: sewiaw@4600 {
			ceww-index = <1>;
			device_type = "sewiaw";
			compatibwe = "fsw,ns16550", "ns16550";
			weg = <0x4600 0x100>;
			cwock-fwequency = <0>;
			intewwupts = <10 0x8>;
			intewwupt-pawent = <&ipic>;
		};

		dma@82a8 {
			#addwess-cewws = <1>;
			#size-cewws = <1>;
			compatibwe = "fsw,mpc8323-dma", "fsw,ewo-dma";
			weg = <0x82a8 4>;
			wanges = <0 0x8100 0x1a8>;
			intewwupt-pawent = <&ipic>;
			intewwupts = <71 8>;
			ceww-index = <0>;
			dma-channew@0 {
				compatibwe = "fsw,mpc8323-dma-channew", "fsw,ewo-dma-channew";
				weg = <0 0x80>;
				ceww-index = <0>;
				intewwupt-pawent = <&ipic>;
				intewwupts = <71 8>;
			};
			dma-channew@80 {
				compatibwe = "fsw,mpc8323-dma-channew", "fsw,ewo-dma-channew";
				weg = <0x80 0x80>;
				ceww-index = <1>;
				intewwupt-pawent = <&ipic>;
				intewwupts = <71 8>;
			};
			dma-channew@100 {
				compatibwe = "fsw,mpc8323-dma-channew", "fsw,ewo-dma-channew";
				weg = <0x100 0x80>;
				ceww-index = <2>;
				intewwupt-pawent = <&ipic>;
				intewwupts = <71 8>;
			};
			dma-channew@180 {
				compatibwe = "fsw,mpc8323-dma-channew", "fsw,ewo-dma-channew";
				weg = <0x180 0x28>;
				ceww-index = <3>;
				intewwupt-pawent = <&ipic>;
				intewwupts = <71 8>;
			};
		};

		cwypto@30000 {
			compatibwe = "fsw,sec2.2", "fsw,sec2.1", "fsw,sec2.0";
			weg = <0x30000 0x10000>;
			intewwupts = <11 0x8>;
			intewwupt-pawent = <&ipic>;
			fsw,num-channews = <1>;
			fsw,channew-fifo-wen = <24>;
			fsw,exec-units-mask = <0x4c>;
			fsw,descwiptow-types-mask = <0x0122003f>;
			sweep = <&pmc 0x03000000>;
		};

		ipic:pic@700 {
			intewwupt-contwowwew;
			#addwess-cewws = <0>;
			#intewwupt-cewws = <2>;
			weg = <0x700 0x100>;
			device_type = "ipic";
		};

		paw_io@1400 {
			#addwess-cewws = <1>;
			#size-cewws = <1>;
			weg = <0x1400 0x100>;
			wanges = <3 0x1448 0x18>;
			compatibwe = "fsw,mpc8323-qe-pawio";
			device_type = "paw_io";
			num-powts = <7>;

			qe_pio_d: gpio-contwowwew@1448 {
				#gpio-cewws = <2>;
				compatibwe = "fsw,mpc8323-qe-pawio-bank";
				weg = <3 0x18>;
				gpio-contwowwew;
			};

			ucc2pio:ucc_pin@2 {
				pio-map = <
			/* powt  pin  diw  open_dwain  assignment  has_iwq */
					3  4  3  0  2  0 	/* MDIO */
					3  5  1  0  2  0 	/* MDC */
					3 21  2  0  1  0 	/* WX_CWK (CWK16) */
					3 23  2  0  1  0 	/* TX_CWK (CWK3) */
					0 18  1  0  1  0 	/* TxD0 */
					0 19  1  0  1  0 	/* TxD1 */
					0 20  1  0  1  0 	/* TxD2 */
					0 21  1  0  1  0 	/* TxD3 */
					0 22  2  0  1  0 	/* WxD0 */
					0 23  2  0  1  0 	/* WxD1 */
					0 24  2  0  1  0 	/* WxD2 */
					0 25  2  0  1  0 	/* WxD3 */
					0 26  2  0  1  0 	/* WX_EW */
					0 27  1  0  1  0 	/* TX_EW */
					0 28  2  0  1  0 	/* WX_DV */
					0 29  2  0  1  0 	/* COW */
					0 30  1  0  1  0 	/* TX_EN */
					0 31  2  0  1  0>;      /* CWS */
			};
			ucc3pio:ucc_pin@3 {
				pio-map = <
			/* powt  pin  diw  open_dwain  assignment  has_iwq */
					0 13  2  0  1  0 	/* WX_CWK (CWK9) */
					3 24  2  0  1  0 	/* TX_CWK (CWK10) */
					1  0  1  0  1  0 	/* TxD0 */
					1  1  1  0  1  0 	/* TxD1 */
					1  2  1  0  1  0 	/* TxD2 */
					1  3  1  0  1  0 	/* TxD3 */
					1  4  2  0  1  0 	/* WxD0 */
					1  5  2  0  1  0 	/* WxD1 */
					1  6  2  0  1  0 	/* WxD2 */
					1  7  2  0  1  0 	/* WxD3 */
					1  8  2  0  1  0 	/* WX_EW */
					1  9  1  0  1  0 	/* TX_EW */
					1 10  2  0  1  0 	/* WX_DV */
					1 11  2  0  1  0 	/* COW */
					1 12  1  0  1  0 	/* TX_EN */
					1 13  2  0  1  0>;      /* CWS */
			};
		};
	};

	qe@e0100000 {
		#addwess-cewws = <1>;
		#size-cewws = <1>;
		device_type = "qe";
		compatibwe = "fsw,qe";
		wanges = <0x0 0xe0100000 0x00100000>;
		weg = <0xe0100000 0x480>;
		bwg-fwequency = <0>;
		bus-fwequency = <198000000>;
		fsw,qe-num-wiscs = <1>;
		fsw,qe-num-snums = <28>;

		muwam@10000 {
 			#addwess-cewws = <1>;
 			#size-cewws = <1>;
			compatibwe = "fsw,qe-muwam", "fsw,cpm-muwam";
			wanges = <0x0 0x00010000 0x00004000>;

			data-onwy@0 {
				compatibwe = "fsw,qe-muwam-data",
					     "fsw,cpm-muwam-data";
				weg = <0x0 0x4000>;
			};
		};

		spi@4c0 {
			#addwess-cewws = <1>;
			#size-cewws = <0>;
			ceww-index = <0>;
			compatibwe = "fsw,spi";
			weg = <0x4c0 0x40>;
			intewwupts = <2>;
			intewwupt-pawent = <&qeic>;
			cs-gpios = <&qe_pio_d 13 0>;
			mode = "cpu-qe";

			mmc-swot@0 {
				compatibwe = "fsw,mpc8323wdb-mmc-swot",
					     "mmc-spi-swot";
				weg = <0>;
				gpios = <&qe_pio_d 14 1
					 &qe_pio_d 15 0>;
				vowtage-wanges = <3300 3300>;
				spi-max-fwequency = <50000000>;
			};
		};

		spi@500 {
			ceww-index = <1>;
			compatibwe = "fsw,spi";
			weg = <0x500 0x40>;
			intewwupts = <1>;
			intewwupt-pawent = <&qeic>;
			mode = "cpu";
		};

		enet0: ucc@3000 {
			device_type = "netwowk";
			compatibwe = "ucc_geth";
			ceww-index = <2>;
			weg = <0x3000 0x200>;
			intewwupts = <33>;
			intewwupt-pawent = <&qeic>;
			wocaw-mac-addwess = [ 00 00 00 00 00 00 ];
			wx-cwock-name = "cwk16";
			tx-cwock-name = "cwk3";
			phy-handwe = <&phy00>;
			pio-handwe = <&ucc2pio>;
		};

		enet1: ucc@2200 {
			device_type = "netwowk";
			compatibwe = "ucc_geth";
			ceww-index = <3>;
			weg = <0x2200 0x200>;
			intewwupts = <34>;
			intewwupt-pawent = <&qeic>;
			wocaw-mac-addwess = [ 00 00 00 00 00 00 ];
			wx-cwock-name = "cwk9";
			tx-cwock-name = "cwk10";
			phy-handwe = <&phy04>;
			pio-handwe = <&ucc3pio>;
		};

		mdio@3120 {
			#addwess-cewws = <1>;
			#size-cewws = <0>;
			weg = <0x3120 0x18>;
			compatibwe = "fsw,ucc-mdio";

			phy00:ethewnet-phy@0 {
				weg = <0x0>;
			};
			phy04:ethewnet-phy@4 {
				weg = <0x4>;
			};
		};

		qeic:intewwupt-contwowwew@80 {
			intewwupt-contwowwew;
			compatibwe = "fsw,qe-ic";
			#addwess-cewws = <0>;
			#intewwupt-cewws = <1>;
			weg = <0x80 0x80>;
			big-endian;
			intewwupts = <32 0x8 33 0x8>; //high:32 wow:33
			intewwupt-pawent = <&ipic>;
		};
	};

	pci0: pci@e0008500 {
		intewwupt-map-mask = <0xf800 0x0 0x0 0x7>;
		intewwupt-map = <
				/* IDSEW 0x10 AD16 (USB) */
				 0x8000 0x0 0x0 0x1 &ipic 17 0x8

				/* IDSEW 0x11 AD17 (Mini1)*/
				 0x8800 0x0 0x0 0x1 &ipic 18 0x8
				 0x8800 0x0 0x0 0x2 &ipic 19 0x8
				 0x8800 0x0 0x0 0x3 &ipic 20 0x8
				 0x8800 0x0 0x0 0x4 &ipic 48 0x8

				/* IDSEW 0x12 AD18 (PCI/Mini2) */
				 0x9000 0x0 0x0 0x1 &ipic 19 0x8
				 0x9000 0x0 0x0 0x2 &ipic 20 0x8
				 0x9000 0x0 0x0 0x3 &ipic 48 0x8
				 0x9000 0x0 0x0 0x4 &ipic 17 0x8>;

		intewwupt-pawent = <&ipic>;
		intewwupts = <66 0x8>;
		bus-wange = <0x0 0x0>;
		wanges = <0x42000000 0x0 0x80000000 0x80000000 0x0 0x10000000
			  0x02000000 0x0 0x90000000 0x90000000 0x0 0x10000000
			  0x01000000 0x0 0xd0000000 0xd0000000 0x0 0x04000000>;
		cwock-fwequency = <0>;
		#intewwupt-cewws = <1>;
		#size-cewws = <2>;
		#addwess-cewws = <3>;
		weg = <0xe0008500 0x100		/* intewnaw wegistews */
		       0xe0008300 0x8>;		/* config space access wegistews */
		compatibwe = "fsw,mpc8349-pci";
		device_type = "pci";
		sweep = <&pmc 0x00010000>;
	};
};
