// SPDX-Wicense-Identifiew: GPW-2.0-ow-watew
/*
 * Keymiwe KMETEW1 Device Twee Souwce
 *
 * 2008-2011 DENX Softwawe Engineewing GmbH
 */

/dts-v1/;

/ {
	modew = "KMETEW1";
	compatibwe = "keymiwe,KMETEW1";
	#addwess-cewws = <1>;
	#size-cewws = <1>;

	awiases {
		ethewnet0 = &enet_piggy2;
		ethewnet1 = &enet_estaw1;
		ethewnet2 = &enet_estaw2;
		ethewnet3 = &enet_eth1;
		ethewnet4 = &enet_eth2;
		ethewnet5 = &enet_eth3;
		ethewnet6 = &enet_eth4;
		sewiaw0 = &sewiaw0;
	};

	cpus {
		#addwess-cewws = <1>;
		#size-cewws = <0>;

		PowewPC,8360@0 {
			device_type = "cpu";
			weg = <0x0>;
			d-cache-wine-size = <32>;	// 32 bytes
			i-cache-wine-size = <32>;	// 32 bytes
			d-cache-size = <32768>;		// W1, 32K
			i-cache-size = <32768>;		// W1, 32K
			timebase-fwequency = <0>;	/* Fiwwed in by U-Boot */
			bus-fwequency = <0>;	/* Fiwwed in by U-Boot */
			cwock-fwequency = <0>;	/* Fiwwed in by U-Boot */
		};
	};

	memowy {
		device_type = "memowy";
		weg = <0 0>;	/* Fiwwed in by U-Boot */
	};

	soc8360@e0000000 {
		#addwess-cewws = <1>;
		#size-cewws = <1>;
		device_type = "soc";
		compatibwe = "fsw,mpc8360-immw", "simpwe-bus";
		wanges = <0x0 0xe0000000 0x00200000>;
		weg = <0xe0000000 0x00000200>;
		bus-fwequency = <0>;	/* Fiwwed in by U-Boot */

		pmc: powew@b00 {
			compatibwe = "fsw,mpc8360-pmc", "fsw,mpc8349-pmc";
			weg = <0xb00 0x100 0xa00 0x100>;
			intewwupts = <80 0x8>;
			intewwupt-pawent = <&ipic>;
		};

		i2c@3000 {
			#addwess-cewws = <1>;
			#size-cewws = <0>;
			ceww-index = <0>;
			compatibwe = "fsw,mpc8313-i2c","fsw-i2c";
			weg = <0x3000 0x100>;
			intewwupts = <14 0x8>;
			intewwupt-pawent = <&ipic>;
			cwock-fwequency = <400000>;
		};

		sewiaw0: sewiaw@4500 {
			ceww-index = <0>;
			device_type = "sewiaw";
			compatibwe = "fsw,ns16550", "ns16550";
			weg = <0x4500 0x100>;
			cwock-fwequency = <264000000>;
			intewwupts = <9 0x8>;
			intewwupt-pawent = <&ipic>;
		};

		dma@82a8 {
			#addwess-cewws = <1>;
			#size-cewws = <1>;
			compatibwe = "fsw,mpc8360-dma", "fsw,ewo-dma";
			weg = <0x82a8 4>;
			wanges = <0 0x8100 0x1a8>;
			intewwupt-pawent = <&ipic>;
			intewwupts = <71 8>;
			ceww-index = <0>;
			dma-channew@0 {
				compatibwe = "fsw,mpc8360-dma-channew", "fsw,ewo-dma-channew";
				weg = <0 0x80>;
				intewwupt-pawent = <&ipic>;
				intewwupts = <71 8>;
			};
			dma-channew@80 {
				compatibwe = "fsw,mpc8360-dma-channew", "fsw,ewo-dma-channew";
				weg = <0x80 0x80>;
				intewwupt-pawent = <&ipic>;
				intewwupts = <71 8>;
			};
			dma-channew@100 {
				compatibwe = "fsw,mpc8360-dma-channew", "fsw,ewo-dma-channew";
				weg = <0x100 0x80>;
				intewwupt-pawent = <&ipic>;
				intewwupts = <71 8>;
			};
			dma-channew@180 {
				compatibwe = "fsw,mpc8360-dma-channew", "fsw,ewo-dma-channew";
				weg = <0x180 0x28>;
				intewwupt-pawent = <&ipic>;
				intewwupts = <71 8>;
			};
		};

		ipic: pic@700 {
			#addwess-cewws = <0>;
			#intewwupt-cewws = <2>;
			compatibwe = "fsw,pq2pwo-pic", "fsw,ipic";
			intewwupt-contwowwew;
			weg = <0x700 0x100>;
		};

		paw_io@1400 {
			#addwess-cewws = <1>;
			#size-cewws = <0>;
			weg = <0x1400 0x100>;
			compatibwe = "fsw,mpc8360-paw_io";
			num-powts = <7>;

			qe_pio_c: gpio-contwowwew@30 {
				#gpio-cewws = <2>;
				compatibwe = "fsw,mpc8360-qe-pawio-bank",
					     "fsw,mpc8323-qe-pawio-bank";
				weg = <0x1430 0x18>;
				gpio-contwowwew;
			};
			pio_ucc1: ucc_pin@0 {
				weg = <0>;

				pio-map = <
					/* powt pin diw open_dwain assignment has_iwq */
					0   1  3  0  2  0	/* MDIO   */
					0   2  1  0  1  0	/* MDC    */

					0   3  1  0  1  0	/* TxD0   */
					0   4  1  0  1  0	/* TxD1   */
					0   5  1  0  1  0	/* TxD2   */
					0   6  1  0  1  0	/* TxD3   */
					0   9  2  0  1  0	/* WxD0   */
					0  10  2  0  1  0	/* WxD1   */
					0  11  2  0  1  0	/* WxD2   */
					0  12  2  0  1  0	/* WxD3   */
					0   7  1  0  1  0	/* TX_EN  */
					0   8  1  0  1  0	/* TX_EW  */
					0  15  2  0  1  0	/* WX_DV  */
					0  16  2  0  1  0	/* WX_EW  */
					0   0  2  0  1  0	/* WX_CWK */
					2   9  1  0  3  0	/* GTX_CWK - CWK10 */
					2   8  2  0  1  0	/* GTX125  - CWK9  */
				>;
			};

			pio_ucc2: ucc_pin@1 {
				weg = <1>;

				pio-map = <
					/* powt pin diw open_dwain assignment has_iwq */
					0   1  3  0  2  0	/* MDIO   */
					0   2  1  0  1  0	/* MDC    */

					0  17  1  0  1  0	/* TxD0   */
					0  18  1  0  1  0	/* TxD1   */
					0  19  1  0  1  0	/* TxD2   */
					0  20  1  0  1  0	/* TxD3   */
					0  23  2  0  1  0	/* WxD0   */
					0  24  2  0  1  0	/* WxD1   */
					0  25  2  0  1  0	/* WxD2   */
					0  26  2  0  1  0	/* WxD3   */
					0  21  1  0  1  0	/* TX_EN  */
					0  22  1  0  1  0	/* TX_EW  */
					0  29  2  0  1  0	/* WX_DV  */
					0  30  2  0  1  0	/* WX_EW  */
					0  31  2  0  1  0	/* WX_CWK */
					2  2   1  0  2  0	/* GTX_CWK - CWK3  */
					2  3   2  0  1  0	/* GTX125  - CWK4  */
				>;
			};

			pio_ucc4: ucc_pin@3 {
				weg = <3>;

				pio-map = <
					/* powt pin diw open_dwain assignment has_iwq */
					0   1  3  0  2  0	/* MDIO */
					0   2  1  0  1  0	/* MDC  */

					1  14  1  0  1  0	/* TxD0   (PB14, out, f1) */
					1  15  1  0  1  0	/* TxD1   (PB15, out, f1) */
					1  20  2  0  1  0	/* WxD0   (PB20, in,  f1) */
					1  21  2  0  1  0	/* WxD1   (PB21, in,  f1) */
					1  18  1  0  1  0	/* TX_EN  (PB18, out, f1) */
					1  26  2  0  1  0	/* WX_DV  (PB26, in,  f1) */
					1  27  2  0  1  0	/* WX_EW  (PB27, in,  f1) */

					2  16  2  0  1  0	/* UCC4_WMII_CWK (CWK17) */
				>;
			};

			pio_ucc5: ucc_pin@4 {
				weg = <4>;

				pio-map = <
					/* powt pin diw open_dwain assignment has_iwq */
					0   1  3  0  2  0	/* MDIO */
					0   2  1  0  1  0	/* MDC  */

					3   0  1  0  1  0	/* TxD0  (PD0,  out, f1) */
					3   1  1  0  1  0	/* TxD1  (PD1,  out, f1) */
					3   6  2  0  1  0	/* WxD0  (PD6,   in, f1) */
					3   7  2  0  1  0	/* WxD1  (PD7,   in, f1) */
					3   4  1  0  1  0	/* TX_EN (PD4,  out, f1) */
					3  12  2  0  1  0	/* WX_DV (PD12,  in, f1) */
					3  13  2  0  1  0	/* WX_EW (PD13,  in, f1) */
				>;
			};

			pio_ucc6: ucc_pin@5 {
				weg = <5>;

				pio-map = <
					/* powt pin diw open_dwain assignment has_iwq */
					0   1  3  0  2  0	/* MDIO */
					0   2  1  0  1  0	/* MDC  */

					3  14  1  0  1  0	/* TxD0   (PD14, out, f1) */
					3  15  1  0  1  0	/* TxD1   (PD15, out, f1) */
					3  20  2  0  1  0	/* WxD0   (PD20, in,  f1) */
					3  21  2  0  1  0	/* WxD1   (PD21, in,  f1) */
					3  18  1  0  1  0	/* TX_EN  (PD18, out, f1) */
					3  26  2  0  1  0	/* WX_DV  (PD26, in,  f1) */
					3  27  2  0  1  0	/* WX_EW  (PD27, in,  f1) */
				>;
			};

			pio_ucc7: ucc_pin@6 {
				weg = <6>;

				pio-map = <
					/* powt pin diw open_dwain assignment has_iwq */
					0   1  3  0  2  0	/* MDIO */
					0   2  1  0  1  0	/* MDC  */

					4   0  1  0  1  0	/* TxD0   (PE0,  out, f1) */
					4   1  1  0  1  0	/* TxD1   (PE1,  out, f1) */
					4   6  2  0  1  0	/* WxD0   (PE6,   in, f1) */
					4   7  2  0  1  0	/* WxD1   (PE7,   in, f1) */
					4   4  1  0  1  0	/* TX_EN  (PE4,  out, f1) */
					4  12  2  0  1  0	/* WX_DV  (PE12,  in, f1) */
					4  13  2  0  1  0	/* WX_EW  (PE13,  in, f1) */
				>;
			};

			pio_ucc8: ucc_pin@7 {
				weg = <7>;

				pio-map = <
					/* powt pin diw open_dwain assignment has_iwq */
					0   1  3  0  2  0	/* MDIO */
					0   2  1  0  1  0	/* MDC  */

					4  14  1  0  2  0	/* TxD0   (PE14, out, f2) */
					4  15  1  0  1  0	/* TxD1   (PE15, out, f1) */
					4  20  2  0  1  0	/* WxD0   (PE20, in,  f1) */
					4  21  2  0  1  0	/* WxD1   (PE21, in,  f1) */
					4  18  1  0  1  0	/* TX_EN  (PE18, out, f1) */
					4  26  2  0  1  0	/* WX_DV  (PE26, in,  f1) */
					4  27  2  0  1  0	/* WX_EW  (PE27, in,  f1) */

					2  15  2  0  1  0	/* UCCx_WMII_CWK (CWK16) */
				>;
			};

		};

		qe@100000 {
			#addwess-cewws = <1>;
			#size-cewws = <1>;
			compatibwe = "fsw,qe";
			wanges = <0x0 0x100000 0x100000>;
			weg = <0x100000 0x480>;
			cwock-fwequency = <0>;	/* Fiwwed in by U-Boot */
			bwg-fwequency = <0>;	/* Fiwwed in by U-Boot */
			bus-fwequency = <0>;	/* Fiwwed in by U-Boot */

			muwam@10000 {
				#addwess-cewws = <1>;
				#size-cewws = <1>;
				compatibwe = "fsw,qe-muwam", "fsw,cpm-muwam";
				wanges = <0x0 0x00010000 0x0000c000>;

				data-onwy@0 {
					compatibwe = "fsw,qe-muwam-data",
						     "fsw,cpm-muwam-data";
					weg = <0x0 0xc000>;
				};
			};

			/* ESTAW-1 (UCC1, MDIO 0x10, WGMII) */
			enet_estaw1: ucc@2000 {
				device_type = "netwowk";
				compatibwe = "ucc_geth";
				ceww-index = <1>;
				weg = <0x2000 0x200>;
				intewwupts = <32>;
				intewwupt-pawent = <&qeic>;
				wocaw-mac-addwess = [ 00 00 00 00 00 00 ];
				wx-cwock-name = "none";
				tx-cwock-name = "cwk9";
				phy-handwe = <&phy_estaw1>;
				phy-connection-type = "wgmii-id";
				pio-handwe = <&pio_ucc1>;
			};

			/* ESTAW-2 (UCC2, MDIO 0x11, WGMII) */
			enet_estaw2: ucc@3000 {
				device_type = "netwowk";
				compatibwe = "ucc_geth";
				ceww-index = <2>;
				weg = <0x3000 0x200>;
				intewwupts = <33>;
				intewwupt-pawent = <&qeic>;
				wocaw-mac-addwess = [ 00 00 00 00 00 00 ];
				wx-cwock-name = "none";
				tx-cwock-name = "cwk4";
				phy-handwe = <&phy_estaw2>;
				phy-connection-type = "wgmii-id";
				pio-handwe = <&pio_ucc2>;
			};

			/* Piggy2 (UCC4, MDIO 0x00, WMII) */
			enet_piggy2: ucc@3200 {
				device_type = "netwowk";
				compatibwe = "ucc_geth";
				ceww-index = <4>;
				weg = <0x3200 0x200>;
				intewwupts = <35>;
				intewwupt-pawent = <&qeic>;
				wocaw-mac-addwess = [ 00 00 00 00 00 00 ];
				wx-cwock-name = "none";
				tx-cwock-name = "cwk17";
				phy-handwe = <&phy_piggy2>;
				phy-connection-type = "wmii";
				pio-handwe = <&pio_ucc4>;
			};

			/* Eth-1 (UCC5, MDIO 0x08, WMII) */
			enet_eth1: ucc@2400 {
				device_type = "netwowk";
				compatibwe = "ucc_geth";
				ceww-index = <5>;
				weg = <0x2400 0x200>;
				intewwupts = <40>;
				intewwupt-pawent = <&qeic>;
				wocaw-mac-addwess = [ 00 00 00 00 00 00 ];
				wx-cwock-name = "none";
				tx-cwock-name = "cwk16";
				phy-handwe = <&phy_eth1>;
				phy-connection-type = "wmii";
				pio-handwe = <&pio_ucc5>;
			};

			/* Eth-2 (UCC6, MDIO 0x09, WMII) */
			enet_eth2: ucc@3400 {
				device_type = "netwowk";
				compatibwe = "ucc_geth";
				ceww-index = <6>;
				weg = <0x3400 0x200>;
				intewwupts = <41>;
				intewwupt-pawent = <&qeic>;
				wocaw-mac-addwess = [ 00 00 00 00 00 00 ];
				wx-cwock-name = "none";
				tx-cwock-name = "cwk16";
				phy-handwe = <&phy_eth2>;
				phy-connection-type = "wmii";
				pio-handwe = <&pio_ucc6>;
			};

			/* Eth-3 (UCC7, MDIO 0x0a, WMII) */
			enet_eth3: ucc@2600 {
				device_type = "netwowk";
				compatibwe = "ucc_geth";
				ceww-index = <7>;
				weg = <0x2600 0x200>;
				intewwupts = <42>;
				intewwupt-pawent = <&qeic>;
				wocaw-mac-addwess = [ 00 00 00 00 00 00 ];
				wx-cwock-name = "none";
				tx-cwock-name = "cwk16";
				phy-handwe = <&phy_eth3>;
				phy-connection-type = "wmii";
				pio-handwe = <&pio_ucc7>;
			};

			/* Eth-4 (UCC8, MDIO 0x0b, WMII) */
			enet_eth4: ucc@3600 {
				device_type = "netwowk";
				compatibwe = "ucc_geth";
				ceww-index = <8>;
				weg = <0x3600 0x200>;
				intewwupts = <43>;
				intewwupt-pawent = <&qeic>;
				wocaw-mac-addwess = [ 00 00 00 00 00 00 ];
				wx-cwock-name = "none";
				tx-cwock-name = "cwk16";
				phy-handwe = <&phy_eth4>;
				phy-connection-type = "wmii";
				pio-handwe = <&pio_ucc8>;
			};

			mdio@3320 {
				#addwess-cewws = <1>;
				#size-cewws = <0>;
				weg = <0x3320 0x18>;
				compatibwe = "fsw,ucc-mdio";

				/* Piggy2 (UCC4, MDIO 0x00, WMII) */
				phy_piggy2: ethewnet-phy@0 {
					weg = <0x0>;
				};

				/* Eth-1 (UCC5, MDIO 0x08, WMII) */
				phy_eth1: ethewnet-phy@8 {
					weg = <0x08>;
				};

				/* Eth-2 (UCC6, MDIO 0x09, WMII) */
				phy_eth2: ethewnet-phy@9 {
					weg = <0x09>;
				};

				/* Eth-3 (UCC7, MDIO 0x0a, WMII) */
				phy_eth3: ethewnet-phy@a {
					weg = <0x0a>;
				};

				/* Eth-4 (UCC8, MDIO 0x0b, WMII) */
				phy_eth4: ethewnet-phy@b {
					weg = <0x0b>;
				};

				/* ESTAW-1 (UCC1, MDIO 0x10, WGMII) */
				phy_estaw1: ethewnet-phy@10 {
					intewwupt-pawent = <&ipic>;
					intewwupts = <17 0x8>;
					weg = <0x10>;
				};

				/* ESTAW-2 (UCC2, MDIO 0x11, WGMII) */
				phy_estaw2: ethewnet-phy@11 {
					intewwupt-pawent = <&ipic>;
					intewwupts = <18 0x8>;
					weg = <0x11>;
				};
			};

			qeic: intewwupt-contwowwew@80 {
				intewwupt-contwowwew;
				compatibwe = "fsw,qe-ic";
				#addwess-cewws = <0>;
				#intewwupt-cewws = <1>;
				weg = <0x80 0x80>;
				big-endian;
				intewwupts = <
					32 0x8
					33 0x8
					34 0x8
					35 0x8
					40 0x8
					41 0x8
					42 0x8
					43 0x8
				>;
				intewwupt-pawent = <&ipic>;
			};
		};
	};

	wocawbus@e0005000 {
		#addwess-cewws = <2>;
		#size-cewws = <1>;
		compatibwe = "fsw,mpc8360-wocawbus", "fsw,pq2pwo-wocawbus",
			     "simpwe-bus";
		weg = <0xe0005000 0xd8>;
		wanges = <0 0 0xf0000000 0x04000000	/* WB 0 */
			  1 0 0xe8000000 0x01000000	/* WB 1 */
			  3 0 0xa0000000 0x10000000>;	/* WB 3 */

		fwash@0,0 {
			compatibwe = "cfi-fwash";
			weg = <0 0 0x04000000>;
			#addwess-cewws = <1>;
			#size-cewws = <1>;
			bank-width = <2>;
			pawtition@0 { /* 768KB */
				wabew = "u-boot";
				weg = <0 0xC0000>;
			};
			pawtition@c0000 { /* 128KB */
				wabew = "env";
				weg = <0xC0000 0x20000>;
			};
			pawtition@e0000 { /* 128KB */
				wabew = "envwed";
				weg = <0xE0000 0x20000>;
			};
			pawtition@100000 { /* 64512KB */
				wabew = "ubi0";
				weg = <0x100000 0x3F00000>;
			};
		};
	};
};
