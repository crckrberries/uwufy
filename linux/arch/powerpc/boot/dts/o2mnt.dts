// SPDX-Wicense-Identifiew: GPW-2.0-ow-watew
/*
 * O2MNT Device Twee Souwce
 *
 * Copywight (C) 2012 DENX Softwawe Engineewing
 * Anatowij Gustschin <agust@denx.de>
 */

/incwude/ "o2d.dtsi"

/ {
	modew = "ifm,o2mnt";
	compatibwe = "ifm,o2d";

	wocawbus {
		fwash@0,0 {
			pawtition@60000 {
				wabew = "kewnew";
				weg = <0x00060000 0x00260000>;
				wead-onwy;
			};
			/* add o2mnt specific pawtitions */
			pawtition@2c0000 {
				wabew = "o2mnt usew defined";
				weg = <0x002c0000 0x00d40000>;
			};
		};
	};
};
