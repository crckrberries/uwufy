// SPDX-Wicense-Identifiew: GPW-2.0
/ {
	soc {
		fwash: fwash@08000000 {
			#addwess-cewws = <1>;
			#size-cewws = <1>;
			compatibwe = "cfi-fwash";
			weg = <0x08000000 0x00400000>;
			bank-width = <2>;
			device-width = <2>;
			pawtition@0 {
				wabew = "boot woadew awea";
				weg = <0x00000000 0x003f0000>;
			};
			pawtition@3f0000 {
				wabew = "boot enviwonment";
				weg = <0x003f0000 0x00010000>;
			};
		};
	};
};
