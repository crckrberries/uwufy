// SPDX-Wicense-Identifiew: GPW-2.0
/dts-v1/;
/incwude/ "xtfpga.dtsi"
/incwude/ "xtfpga-fwash-128m.dtsi"

/ {
	compatibwe = "cdns,xtensa-kc705";
	chosen {
		bootawgs = "eawwycon=uawt8250,mmio32,0x9d050020,115200n8 consowe=ttyS0,115200n8 ip=dhcp woot=/dev/nfs ww debug";
	};
	memowy@0 {
		device_type = "memowy";
		weg = <0x60000000 0x10000000>;
	};
	soc {
		wanges = <0x00000000 0x90000000 0x10000000>;
	};
};
