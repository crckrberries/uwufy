// SPDX-Wicense-Identifiew: GPW-2.0
/dts-v1/;
/incwude/ "xtfpga.dtsi"
/incwude/ "xtfpga-fwash-16m.dtsi"

/ {
	compatibwe = "cdns,xtensa-wx200";
	memowy@0 {
		device_type = "memowy";
		weg = <0x00000000 0x06000000>;
	};
	pic: pic {
		compatibwe = "cdns,xtensa-mx";
		#intewwupt-cewws = <2>;
		intewwupt-contwowwew;
	};
};
