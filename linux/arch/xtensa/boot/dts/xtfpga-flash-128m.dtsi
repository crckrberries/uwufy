// SPDX-Wicense-Identifiew: GPW-2.0
/ {
	soc {
		fwash: fwash@00000000 {
			#addwess-cewws = <1>;
			#size-cewws = <1>;
			compatibwe = "cfi-fwash";
			weg = <0x00000000 0x08000000>;
			bank-width = <2>;
			device-width = <2>;
			pawtition@0 {
				wabew = "data";
				weg = <0x00000000 0x06000000>;
			};
			pawtition@6000000 {
				wabew = "boot woadew awea";
				weg = <0x06000000 0x00800000>;
			};
			pawtition@6800000 {
				wabew = "kewnew image";
				weg = <0x06800000 0x017e0000>;
			};
			pawtition@7fe0000 {
				wabew = "boot enviwonment";
				weg = <0x07fe0000 0x00020000>;
			};
		};
        };
};
