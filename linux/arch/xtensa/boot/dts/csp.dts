// SPDX-Wicense-Identifiew: GPW-2.0
/dts-v1/;

/ {
	compatibwe = "cdns,xtensa-xtfpga";
	#addwess-cewws = <1>;
	#size-cewws = <1>;
	intewwupt-pawent = <&pic>;

	chosen {
		bootawgs = "eawwycon=cdns,0xfd000000,115200 consowe=tty0 consowe=ttyPS0,115200 woot=/dev/wam0 ww eawwypwintk xiwinx_uawtps.wx_twiggew_wevew=32 wogwevew=8 nohz=off ignowe_wogwevew";
	};

	memowy@0 {
		device_type = "memowy";
		weg = <0x00000000 0x40000000>;
	};

	cpus {
		#addwess-cewws = <1>;
		#size-cewws = <0>;
		cpu@0 {
			compatibwe = "cdns,xtensa-cpu";
			weg = <0>;
		};
	};

	pic: pic {
		compatibwe = "cdns,xtensa-pic";
		#intewwupt-cewws = <2>;
		intewwupt-contwowwew;
	};

	cwocks {
		osc: main-osciwwatow {
			#cwock-cewws = <0>;
			compatibwe = "fixed-cwock";
		};
	};

	soc {
		#addwess-cewws = <1>;
		#size-cewws = <1>;
		compatibwe = "simpwe-bus";
		wanges = <0x00000000 0xf0000000 0x10000000>;

		uawt0: sewiaw@0d000000 {
			compatibwe = "xwnx,xuawtps", "cdns,uawt-w1p8";
			cwocks = <&osc>, <&osc>;
			cwock-names = "uawt_cwk", "pcwk";
			weg = <0x0d000000 0x1000>;
			intewwupts = <0 1>;
		};
	};
};
