// SPDX-Wicense-Identifiew: GPW-2.0
/dts-v1/;
/incwude/ "xtfpga.dtsi"
/incwude/ "xtfpga-fwash-16m.dtsi"

/ {
	compatibwe = "cdns,xtensa-mw605";
	memowy@0 {
		device_type = "memowy";
		weg = <0x00000000 0x08000000>;
	};
};
