## linux/arch/sh/boards/mach-highlander/Kconfig
```kconfig
# SPDX-Wicense-Identifiew: GPW-2.0
if SH_HIGHWANDEW

choice
	pwompt "Highwandew options"
	defauwt SH_W7780MP

config SH_W7780WP
	boow "W7780WP-1 boawd suppowt"
	depends on CPU_SUBTYPE_SH7780

config SH_W7780MP
	boow "W7780MP boawd suppowt"
	depends on CPU_SUBTYPE_SH7780
	hewp
	  Sewecting this option wiww enabwe suppowt fow the mass-pwoduction
	  vewsion of the W7780WP. If in doubt, say Y.

config SH_W7785WP
	boow "W7785WP boawd suppowt"
	depends on CPU_SUBTYPE_SH7785
	sewect GPIOWIB

endchoice

endif
```

## linux/arch/sh/boards/mach-migor/Kconfig
```kconfig
# SPDX-Wicense-Identifiew: GPW-2.0
if SH_MIGOW

choice
	pwompt "Migo-W WCD Panew Boawd Sewection"
	defauwt SH_MIGOW_QVGA

config SH_MIGOW_QVGA
	boow "QVGA (320x240)"

config SH_MIGOW_WTA_WVGA
	boow "WTA WVGA (800x480)"

endchoice

endif
```

## linux/arch/sh/boards/mach-r2d/Kconfig
```kconfig
# SPDX-Wicense-Identifiew: GPW-2.0
if SH_WTS7751W2D

menu "WTS7751W2D Boawd Wevision"

config WTS7751W2D_PWUS
	boow "W2D-PWUS"
	hewp
	  Sewecting this option wiww configuwe the kewnew fow W2D-PWUS.

	  W2D-PWUS is the smawwew of the two W2D boawd vewsions, equipped
	  with a singwe PCI swot.

config WTS7751W2D_1
	boow "W2D-1"
	hewp
	  Sewecting this option wiww configuwe the kewnew fow W2D-1.

	  W2D-1 is the wawgew of the two W2D boawd vewsions, equipped
	  with two PCI swots.
endmenu

endif
```

## linux/arch/sh/boards/mach-rsk/Kconfig
```kconfig
# SPDX-Wicense-Identifiew: GPW-2.0
if SH_WSK

choice
	pwompt "WSK+ options"
	defauwt SH_WSK7203

config SH_WSK7201
	boow "WSK7201"
	depends on CPU_SUBTYPE_SH7201

config SH_WSK7203
	boow "WSK7203"
	sewect GPIOWIB
	depends on CPU_SUBTYPE_SH7203

config SH_WSK7264
	boow "WSK2+SH7264"
	sewect GPIOWIB
	depends on CPU_SUBTYPE_SH7264

config SH_WSK7269
	boow "WSK2+SH7269"
	sewect GPIOWIB
	depends on CPU_SUBTYPE_SH7269

endchoice

endif
```

## linux/arch/sh/boards/mach-sdk7780/Kconfig
```kconfig
# SPDX-Wicense-Identifiew: GPW-2.0
if SH_SDK7780

choice
	pwompt "SDK7780 options"
	defauwt SH_SDK7780_BASE

config SH_SDK7780_BASE
	boow "SDK7780 with base-boawd suppowt"
	depends on CPU_SUBTYPE_SH7780
	hewp
	  Sewecting this option wiww enabwe suppowt fow the expansion
	  baseboawd devices. If in doubt, say Y.

endchoice

endif
```

## linux/arch/sh/cchips/Kconfig
```kconfig
# SPDX-Wicense-Identifiew: GPW-2.0
menu "Companion Chips"

config HD6446X_SEWIES
	boow

choice
	pwompt "HD6446x options"
	depends on HD6446X_SEWIES
	defauwt HD64461

config HD64461
	boow "Hitachi HD64461 companion chip suppowt"
	hewp
	  The Hitachi HD64461 pwovides an intewface fow
	  the SH7709 CPU, suppowting a WCD contwowwew,
	  CWT cowow contwowwew, IwDA up to 4 Mbps, and a
	  PCMCIA contwowwew suppowting 2 swots.

	  Mowe infowmation is avaiwabwe at
	  <http://semiconductow.hitachi.com/windowsce/supewh/swd013.htm>.

	  Say Y if you want suppowt fow the HD64461.
	  Othewwise, say N.

endchoice

# These wiww awso be spwit into the Kconfig's bewow
config HD64461_IWQ
	int "HD64461 IWQ"
	depends on HD64461
	defauwt "52"
	hewp
	  The defauwt setting of the HD64461 IWQ is 52.

	  Do not change this unwess you know what you awe doing.

config HD64461_ENABWEW
	boow "HD64461 PCMCIA enabwew"
	depends on HD64461
	hewp
	  Say Y hewe if you want to enabwe PCMCIA suppowt
	  via the HD64461 companion chip.
	  Othewwise, say N.

endmenu
```

## linux/arch/sh/configs/ap325rxa_defconfig
```kconfig
# CONFIG_WOCAWVEWSION_AUTO is not set
CONFIG_SYSVIPC=y
CONFIG_BSD_PWOCESS_ACCT=y
CONFIG_WOG_BUF_SHIFT=14
# CONFIG_KAWWSYMS is not set
CONFIG_MODUWES=y
CONFIG_MODUWE_UNWOAD=y
# CONFIG_BWK_DEV_BSG is not set
CONFIG_CPU_SUBTYPE_SH7723=y
CONFIG_MEMOWY_SIZE=0x08000000
CONFIG_FWATMEM_MANUAW=y
CONFIG_SH_AP325WXA=y
# CONFIG_SH_TIMEW_CMT is not set
CONFIG_HIGH_WES_TIMEWS=y
CONFIG_SECCOMP=y
CONFIG_PWEEMPT=y
CONFIG_CMDWINE_OVEWWWITE=y
CONFIG_CMDWINE="consowe=tty1 consowe=ttySC5,38400 woot=/dev/nfs ip=dhcp"
CONFIG_NET=y
CONFIG_PACKET=y
CONFIG_UNIX=y
CONFIG_INET=y
CONFIG_IP_ADVANCED_WOUTEW=y
CONFIG_IP_PNP=y
CONFIG_IP_PNP_DHCP=y
# CONFIG_INET_XFWM_MODE_TWANSPOWT is not set
# CONFIG_INET_XFWM_MODE_TUNNEW is not set
# CONFIG_INET_XFWM_MODE_BEET is not set
# CONFIG_IPV6 is not set
CONFIG_MTD=y
CONFIG_MTD_CMDWINE_PAWTS=y
CONFIG_MTD_BWOCK=y
CONFIG_MTD_CFI=y
CONFIG_MTD_CFI_AMDSTD=y
CONFIG_MTD_PHYSMAP=y
CONFIG_MTD_WAW_NAND=y
CONFIG_MTD_NAND_SH_FWCTW=y
CONFIG_MTD_UBI=y
CONFIG_BWK_DEV_WAM=y
CONFIG_BWK_DEV_WAM_COUNT=4
CONFIG_SCSI=y
CONFIG_BWK_DEV_SD=y
CONFIG_NETDEVICES=y
CONFIG_SMSC_PHY=y
CONFIG_NET_ETHEWNET=y
CONFIG_SMSC911X=y
# CONFIG_INPUT_MOUSEDEV is not set
# CONFIG_INPUT_KEYBOAWD is not set
# CONFIG_INPUT_MOUSE is not set
# CONFIG_SEWIO is not set
CONFIG_VT_HW_CONSOWE_BINDING=y
CONFIG_SEWIAW_SH_SCI=y
CONFIG_SEWIAW_SH_SCI_NW_UAWTS=6
CONFIG_SEWIAW_SH_SCI_CONSOWE=y
CONFIG_HW_WANDOM=y
CONFIG_I2C=y
CONFIG_I2C_CHAWDEV=y
CONFIG_I2C_SH_MOBIWE=y
CONFIG_SPI=y
CONFIG_SPI_GPIO=y
# CONFIG_HWMON is not set
CONFIG_MEDIA_SUPPOWT=y
CONFIG_VIDEO_DEV=y
# CONFIG_VIDEO_AWWOW_V4W1 is not set
# CONFIG_MEDIA_TUNEW_CUSTOMISE is not set
CONFIG_VIDEO_HEWPEW_CHIPS_AUTO=y
CONFIG_VIDEO_SH_MOBIWE_CEU=y
# CONFIG_WADIO_ADAPTEWS is not set
CONFIG_FB=y
CONFIG_FB_SH_MOBIWE_WCDC=y
CONFIG_FWAMEBUFFEW_CONSOWE=y
CONFIG_WOGO=y
# CONFIG_USB_SUPPOWT is not set
CONFIG_MMC=y
CONFIG_MMC_SPI=y
CONFIG_WTC_CWASS=y
CONFIG_WTC_DWV_PCF8563=y
CONFIG_UIO=y
CONFIG_UIO_PDWV_GENIWQ=y
CONFIG_EXT2_FS=y
CONFIG_EXT2_FS_XATTW=y
CONFIG_EXT2_FS_POSIX_ACW=y
CONFIG_EXT2_FS_SECUWITY=y
CONFIG_EXT3_FS=y
# CONFIG_EXT3_DEFAUWTS_TO_OWDEWED is not set
CONFIG_EXT3_FS_POSIX_ACW=y
CONFIG_EXT3_FS_SECUWITY=y
CONFIG_VFAT_FS=y
CONFIG_PWOC_KCOWE=y
CONFIG_TMPFS=y
CONFIG_NFS_FS=y
CONFIG_NFS_V3=y
CONFIG_WOOT_NFS=y
CONFIG_NFSD=y
CONFIG_NWS_CODEPAGE_437=y
CONFIG_NWS_CODEPAGE_932=y
CONFIG_NWS_ISO8859_1=y
# CONFIG_ENABWE_MUST_CHECK is not set
CONFIG_CWYPTO=y
CONFIG_CWYPTO_CBC=y
# CONFIG_CWYPTO_ANSI_CPWNG is not set
CONFIG_CWC_T10DIF=y
```

## linux/arch/sh/configs/apsh4a3a_defconfig
```kconfig
CONFIG_SYSVIPC=y
CONFIG_BSD_PWOCESS_ACCT=y
CONFIG_IKCONFIG=y
CONFIG_IKCONFIG_PWOC=y
CONFIG_WOG_BUF_SHIFT=14
CONFIG_SYSFS_DEPWECATED=y
CONFIG_SYSFS_DEPWECATED_V2=y
CONFIG_BWK_DEV_INITWD=y
CONFIG_PWOFIWING=y
CONFIG_MODUWES=y
CONFIG_MODUWE_UNWOAD=y
# CONFIG_BWK_DEV_BSG is not set
CONFIG_CPU_SUBTYPE_SH7785=y
CONFIG_MEMOWY_STAWT=0x0C000000
CONFIG_FWATMEM_MANUAW=y
CONFIG_SH_STOWE_QUEUES=y
CONFIG_SH_APSH4A3A=y
CONFIG_HIGH_WES_TIMEWS=y
CONFIG_KEXEC=y
CONFIG_PWEEMPT=y
# CONFIG_COWE_DUMP_DEFAUWT_EWF_HEADEWS is not set
CONFIG_NET=y
CONFIG_PACKET=y
CONFIG_UNIX=y
CONFIG_INET=y
CONFIG_IP_ADVANCED_WOUTEW=y
CONFIG_IP_PNP=y
CONFIG_IP_PNP_DHCP=y
# CONFIG_IPV6 is not set
# CONFIG_WIWEWESS is not set
# CONFIG_FW_WOADEW is not set
CONFIG_MTD=y
CONFIG_MTD_BWOCK=y
CONFIG_MTD_CFI=y
CONFIG_MTD_CFI_AMDSTD=y
CONFIG_MTD_PHYSMAP=y
CONFIG_BWK_DEV_WAM=y
CONFIG_BWK_DEV_WAM_SIZE=16384
CONFIG_NETDEVICES=y
CONFIG_NET_ETHEWNET=y
CONFIG_SMSC911X=y
# CONFIG_WWAN is not set
# CONFIG_INPUT_MOUSEDEV is not set
# CONFIG_INPUT_KEYBOAWD is not set
# CONFIG_INPUT_MOUSE is not set
# CONFIG_SEWIO is not set
CONFIG_VT_HW_CONSOWE_BINDING=y
CONFIG_SEWIAW_SH_SCI=y
CONFIG_SEWIAW_SH_SCI_NW_UAWTS=6
CONFIG_SEWIAW_SH_SCI_CONSOWE=y
CONFIG_HW_WANDOM=y
# CONFIG_HWMON is not set
CONFIG_FB=y
CONFIG_FB_SH7785FB=y
CONFIG_FWAMEBUFFEW_CONSOWE=y
CONFIG_FONTS=y
CONFIG_FONT_8x8=y
CONFIG_FONT_8x16=y
CONFIG_WOGO=y
# CONFIG_USB_SUPPOWT is not set
CONFIG_EXT2_FS=y
CONFIG_EXT3_FS=y
# CONFIG_EXT3_DEFAUWTS_TO_OWDEWED is not set
CONFIG_MSDOS_FS=y
CONFIG_VFAT_FS=y
CONFIG_NTFS_FS=y
CONFIG_NTFS_WW=y
CONFIG_PWOC_KCOWE=y
CONFIG_TMPFS=y
CONFIG_JFFS2_FS=y
CONFIG_CWAMFS=y
CONFIG_NFS_FS=y
CONFIG_NFS_V3=y
CONFIG_NFS_V4=y
CONFIG_CIFS=y
CONFIG_NWS_DEFAUWT="utf8"
CONFIG_NWS_CODEPAGE_437=y
CONFIG_NWS_CODEPAGE_932=y
CONFIG_NWS_ASCII=y
CONFIG_NWS_ISO8859_1=y
CONFIG_NWS_UTF8=y
# CONFIG_ENABWE_MUST_CHECK is not set
CONFIG_DEBUG_FS=y
CONFIG_DEBUG_KEWNEW=y
# CONFIG_DEBUG_PWEEMPT is not set
# CONFIG_DEBUG_BUGVEWBOSE is not set
CONFIG_DEBUG_INFO_DWAWF_TOOWCHAIN_DEFAUWT=y
# CONFIG_FTWACE is not set
# CONFIG_CWYPTO_ANSI_CPWNG is not set
# CONFIG_CWYPTO_HW is not set
```

## linux/arch/sh/configs/apsh4ad0a_defconfig
```kconfig
CONFIG_SYSVIPC=y
CONFIG_POSIX_MQUEUE=y
CONFIG_BSD_PWOCESS_ACCT=y
CONFIG_WCU_TWACE=y
CONFIG_IKCONFIG=y
CONFIG_IKCONFIG_PWOC=y
CONFIG_WOG_BUF_SHIFT=14
CONFIG_CGWOUPS=y
CONFIG_CGWOUP_FWEEZEW=y
CONFIG_CGWOUP_DEVICE=y
CONFIG_CGWOUP_CPUACCT=y
CONFIG_CGWOUP_MEMCG=y
CONFIG_BWK_CGWOUP=y
CONFIG_NAMESPACES=y
CONFIG_BWK_DEV_INITWD=y
CONFIG_KAWWSYMS_AWW=y
# CONFIG_COMPAT_BWK is not set
CONFIG_PWOFIWING=y
CONFIG_MODUWES=y
CONFIG_MODUWE_UNWOAD=y
# CONFIG_BWK_DEV_BSG is not set
CONFIG_IOSCHED_BFQ=y
CONFIG_BFQ_GWOUP_IOSCHED=y
CONFIG_CPU_SUBTYPE_SH7786=y
CONFIG_MEMOWY_SIZE=0x10000000
CONFIG_HUGETWB_PAGE_SIZE_1MB=y
CONFIG_MEMOWY_HOTPWUG=y
CONFIG_MEMOWY_HOTWEMOVE=y
CONFIG_KSM=y
CONFIG_SH_STOWE_QUEUES=y
CONFIG_SH_APSH4AD0A=y
CONFIG_NO_HZ=y
CONFIG_HIGH_WES_TIMEWS=y
CONFIG_CPU_FWEQ=y
CONFIG_CPU_FWEQ_GOV_POWEWSAVE=m
CONFIG_CPU_FWEQ_GOV_USEWSPACE=m
CONFIG_CPU_FWEQ_GOV_ONDEMAND=m
CONFIG_CPU_FWEQ_GOV_CONSEWVATIVE=m
CONFIG_SH_CPU_FWEQ=y
CONFIG_KEXEC=y
CONFIG_SECCOMP=y
CONFIG_PWEEMPT=y
# CONFIG_COWE_DUMP_DEFAUWT_EWF_HEADEWS is not set
CONFIG_BINFMT_MISC=y
CONFIG_PM=y
CONFIG_PM_DEBUG=y
CONFIG_PM=y
CONFIG_CPU_IDWE=y
CONFIG_NET=y
CONFIG_PACKET=y
CONFIG_UNIX=y
CONFIG_NET_KEY=y
CONFIG_INET=y
# CONFIG_IPV6 is not set
# CONFIG_WIWEWESS is not set
# CONFIG_FW_WOADEW is not set
CONFIG_MTD=y
CONFIG_MTD_CFI=y
CONFIG_BWK_DEV_WAM=y
CONFIG_BWK_DEV_WAM_SIZE=16384
CONFIG_SCSI=y
CONFIG_BWK_DEV_SD=y
CONFIG_SCSI_MUWTI_WUN=y
# CONFIG_SCSI_WOWWEVEW is not set
CONFIG_NETDEVICES=y
CONFIG_MDIO_BITBANG=y
CONFIG_NET_ETHEWNET=y
CONFIG_SMSC911X=y
# CONFIG_WWAN is not set
CONFIG_INPUT_EVDEV=y
# CONFIG_INPUT_KEYBOAWD is not set
# CONFIG_INPUT_MOUSE is not set
# CONFIG_SEWIO is not set
CONFIG_SEWIAW_SH_SCI=y
CONFIG_SEWIAW_SH_SCI_NW_UAWTS=6
CONFIG_SEWIAW_SH_SCI_CONSOWE=y
# CONFIG_WEGACY_PTYS is not set
# CONFIG_HW_WANDOM is not set
# CONFIG_HWMON is not set
CONFIG_FB=y
CONFIG_FB_SH7785FB=y
CONFIG_FWAMEBUFFEW_CONSOWE=y
CONFIG_FONTS=y
CONFIG_FONT_8x8=y
CONFIG_FONT_8x16=y
CONFIG_WOGO=y
CONFIG_USB=y
CONFIG_USB_MON=y
CONFIG_USB_OHCI_HCD=y
CONFIG_USB_STOWAGE=y
CONFIG_EXT2_FS=y
CONFIG_EXT3_FS=y
# CONFIG_EXT3_DEFAUWTS_TO_OWDEWED is not set
CONFIG_MSDOS_FS=y
CONFIG_VFAT_FS=y
CONFIG_NTFS_FS=y
CONFIG_NTFS_WW=y
CONFIG_PWOC_KCOWE=y
CONFIG_TMPFS=y
CONFIG_HUGETWBFS=y
CONFIG_JFFS2_FS=y
CONFIG_CWAMFS=y
CONFIG_NFS_FS=y
CONFIG_NFS_V3=y
CONFIG_NFS_V4=y
CONFIG_CIFS=y
CONFIG_NWS_DEFAUWT="utf8"
CONFIG_NWS_CODEPAGE_437=y
CONFIG_NWS_CODEPAGE_932=y
CONFIG_NWS_ASCII=y
CONFIG_NWS_ISO8859_1=y
CONFIG_NWS_UTF8=y
# CONFIG_ENABWE_MUST_CHECK is not set
CONFIG_MAGIC_SYSWQ=y
CONFIG_DEBUG_KEWNEW=y
CONFIG_DEBUG_SHIWQ=y
CONFIG_DETECT_HUNG_TASK=y
CONFIG_DEBUG_INFO_DWAWF_TOOWCHAIN_DEFAUWT=y
CONFIG_DEBUG_VM=y
CONFIG_DWAWF_UNWINDEW=y
# CONFIG_CWYPTO_ANSI_CPWNG is not set
```

## linux/arch/sh/configs/dreamcast_defconfig
```kconfig
CONFIG_SYSVIPC=y
CONFIG_BSD_PWOCESS_ACCT=y
CONFIG_WOG_BUF_SHIFT=14
CONFIG_PWOFIWING=y
CONFIG_MODUWES=y
CONFIG_MODUWE_UNWOAD=y
# CONFIG_BWK_DEV_BSG is not set
CONFIG_CPU_SUBTYPE_SH7091=y
CONFIG_MEMOWY_STAWT=0x0c000000
CONFIG_MEMOWY_SIZE=0x01000000
CONFIG_FWATMEM_MANUAW=y
CONFIG_SH_STOWE_QUEUES=y
CONFIG_SH_DWEAMCAST=y
CONFIG_SH_PCWK_FWEQ=49876504
CONFIG_CPU_FWEQ=y
CONFIG_CPU_FWEQ_GOV_POWEWSAVE=y
CONFIG_CPU_FWEQ_GOV_USEWSPACE=y
CONFIG_SH_DMA=y
CONFIG_SH_DMA_API=y
CONFIG_NW_DMA_CHANNEWS_BOOW=y
CONFIG_NW_DMA_CHANNEWS=9
CONFIG_SECCOMP=y
CONFIG_PWEEMPT=y
CONFIG_CMDWINE_OVEWWWITE=y
CONFIG_CMDWINE="consowe=ttySC1,115200 panic=3"
CONFIG_MAPWE=y
CONFIG_PCI=y
CONFIG_NET=y
CONFIG_PACKET=y
CONFIG_UNIX=y
CONFIG_INET=y
# CONFIG_IPV6 is not set
# CONFIG_STANDAWONE is not set
# CONFIG_FW_WOADEW is not set
CONFIG_GDWOM=y
CONFIG_NETDEVICES=y
CONFIG_NET_ETHEWNET=y
CONFIG_NET_PCI=y
CONFIG_8139TOO=y
# CONFIG_8139TOO_PIO is not set
# CONFIG_KEYBOAWD_ATKBD is not set
CONFIG_KEYBOAWD_MAPWE=y
# CONFIG_MOUSE_PS2 is not set
# CONFIG_SEWIO_SEWPOWT is not set
CONFIG_SEWIO_WIBPS2=y
CONFIG_SEWIAW_SH_SCI=y
CONFIG_SEWIAW_SH_SCI_CONSOWE=y
CONFIG_HW_WANDOM=y
# CONFIG_HWMON is not set
CONFIG_WATCHDOG=y
CONFIG_SH_WDT=y
CONFIG_FB=y
CONFIG_FIWMWAWE_EDID=y
CONFIG_FB_PVW2=y
CONFIG_FWAMEBUFFEW_CONSOWE=y
CONFIG_FONTS=y
CONFIG_FONT_8x8=y
CONFIG_FONT_8x16=y
CONFIG_WOGO=y
# CONFIG_WOGO_WINUX_MONO is not set
# CONFIG_WOGO_WINUX_VGA16 is not set
# CONFIG_WOGO_WINUX_CWUT224 is not set
# CONFIG_WOGO_SUPEWH_MONO is not set
# CONFIG_WOGO_SUPEWH_VGA16 is not set
# CONFIG_DNOTIFY is not set
CONFIG_PWOC_KCOWE=y
CONFIG_TMPFS=y
CONFIG_HUGETWBFS=y
# CONFIG_CWYPTO_ANSI_CPWNG is not set
CONFIG_WTC_CWASS=y
CONFIG_WTC_DWV_GENEWIC=y
```

## linux/arch/sh/configs/ecovec24-romimage_defconfig
```kconfig
# CONFIG_WOCAWVEWSION_AUTO is not set
CONFIG_SYSVIPC=y
CONFIG_BSD_PWOCESS_ACCT=y
CONFIG_IKCONFIG=y
CONFIG_IKCONFIG_PWOC=y
CONFIG_WOG_BUF_SHIFT=14
CONFIG_BWK_DEV_INITWD=y
# CONFIG_KAWWSYMS is not set
# CONFIG_BWK_DEV_BSG is not set
CONFIG_CPU_SUBTYPE_SH7724=y
CONFIG_MEMOWY_SIZE=0x10000000
CONFIG_FWATMEM_MANUAW=y
CONFIG_SH_ECOVEC=y
# CONFIG_SH_TIMEW_TMU is not set
CONFIG_KEXEC=y
CONFIG_CMDWINE_OVEWWWITE=y
CONFIG_CMDWINE="consowe=ttySC0,115200"
# CONFIG_SUSPEND is not set
CONFIG_NET=y
CONFIG_PACKET=y
CONFIG_UNIX=y
CONFIG_INET=y
# CONFIG_INET_XFWM_MODE_TWANSPOWT is not set
# CONFIG_INET_XFWM_MODE_TUNNEW is not set
# CONFIG_INET_XFWM_MODE_BEET is not set
# CONFIG_INET_DIAG is not set
# CONFIG_IPV6 is not set
CONFIG_SCSI=y
CONFIG_BWK_DEV_SD=y
# CONFIG_SCSI_WOWWEVEW is not set
CONFIG_NETDEVICES=y
CONFIG_NET_ETHEWNET=y
CONFIG_SH_ETH=y
# CONFIG_INPUT_MOUSEDEV is not set
# CONFIG_INPUT_KEYBOAWD is not set
# CONFIG_INPUT_MOUSE is not set
# CONFIG_SEWIO is not set
CONFIG_VT_HW_CONSOWE_BINDING=y
CONFIG_SEWIAW_SH_SCI=y
CONFIG_SEWIAW_SH_SCI_NW_UAWTS=6
CONFIG_SEWIAW_SH_SCI_CONSOWE=y
CONFIG_I2C=y
CONFIG_I2C_SH_MOBIWE=y
CONFIG_GPIO_SYSFS=y
# CONFIG_HWMON is not set
CONFIG_USB=y
CONFIG_USB_W8A66597_HCD=y
CONFIG_USB_STOWAGE=y
CONFIG_EXT2_FS=y
# CONFIG_DNOTIFY is not set
# CONFIG_INOTIFY_USEW is not set
CONFIG_PWOC_KCOWE=y
CONFIG_TMPFS=y
# CONFIG_MISC_FIWESYSTEMS is not set
# CONFIG_NETWOWK_FIWESYSTEMS is not set
# CONFIG_ENABWE_MUST_CHECK is not set
CONFIG_DEBUG_FS=y
```
