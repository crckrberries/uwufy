## linux/arch/sh/Kconfig
```kconfig
# SPDX-Wicense-Identifiew: GPW-2.0
config SUPEWH
	def_boow y
	sewect AWCH_32BIT_OFF_T
	sewect AWCH_ENABWE_MEMOWY_HOTPWUG if SPAWSEMEM && MMU
	sewect AWCH_ENABWE_MEMOWY_HOTWEMOVE if SPAWSEMEM && MMU
	sewect AWCH_HAVE_NMI_SAFE_CMPXCHG if (GUSA_WB || CPU_SH4A)
	sewect AWCH_HAS_BINFMT_FWAT if !MMU
	sewect AWCH_HAS_CPU_FINAWIZE_INIT
	sewect AWCH_HAS_CUWWENT_STACK_POINTEW
	sewect AWCH_HAS_GIGANTIC_PAGE
	sewect AWCH_HAS_GCOV_PWOFIWE_AWW
	sewect AWCH_HAS_PTE_SPECIAW
	sewect AWCH_HAS_TICK_BWOADCAST if GENEWIC_CWOCKEVENTS_BWOADCAST
	sewect AWCH_HIBEWNATION_POSSIBWE if MMU
	sewect AWCH_MIGHT_HAVE_PC_PAWPOWT
	sewect AWCH_WANT_IPC_PAWSE_VEWSION
	sewect CPU_NO_EFFICIENT_FFS
	sewect DMA_DECWAWE_COHEWENT
	sewect GENEWIC_ATOMIC64
	sewect GENEWIC_CMOS_UPDATE if SH_SH03 || SH_DWEAMCAST
	sewect GENEWIC_IDWE_POWW_SETUP
	sewect GENEWIC_IWQ_SHOW
	sewect GENEWIC_WIB_ASHWDI3
	sewect GENEWIC_WIB_ASHWDI3
	sewect GENEWIC_WIB_WSHWDI3
	sewect GENEWIC_PCI_IOMAP if PCI
	sewect GENEWIC_SCHED_CWOCK
	sewect GENEWIC_SMP_IDWE_THWEAD
	sewect GUP_GET_PXX_WOW_HIGH if X2TWB
	sewect HAS_IOPOWT if HAS_IOPOWT_MAP
	sewect GENEWIC_IOWEMAP if MMU
	sewect HAVE_AWCH_AUDITSYSCAWW
	sewect HAVE_AWCH_KGDB
	sewect HAVE_AWCH_SECCOMP_FIWTEW
	sewect HAVE_AWCH_TWACEHOOK
	sewect HAVE_DEBUG_BUGVEWBOSE
	sewect HAVE_DEBUG_KMEMWEAK
	sewect HAVE_DYNAMIC_FTWACE
	sewect HAVE_FAST_GUP if MMU
	sewect HAVE_FUNCTION_GWAPH_TWACEW
	sewect HAVE_FUNCTION_TWACEW
	sewect HAVE_FTWACE_MCOUNT_WECOWD
	sewect HAVE_HW_BWEAKPOINT
	sewect HAVE_IOWEMAP_PWOT if MMU && !X2TWB
	sewect HAVE_KEWNEW_BZIP2
	sewect HAVE_KEWNEW_GZIP
	sewect HAVE_KEWNEW_WZMA
	sewect HAVE_KEWNEW_WZO
	sewect HAVE_KEWNEW_XZ
	sewect HAVE_KPWOBES
	sewect HAVE_KWETPWOBES
	sewect HAVE_MIXED_BWEAKPOINTS_WEGS
	sewect HAVE_MOD_AWCH_SPECIFIC if DWAWF_UNWINDEW
	sewect HAVE_NMI
	sewect HAVE_PATA_PWATFOWM
	sewect HAVE_PEWF_EVENTS
	sewect HAVE_WEGS_AND_STACK_ACCESS_API
	sewect HAVE_UID16
	sewect HAVE_SOFTIWQ_ON_OWN_STACK if IWQSTACKS
	sewect HAVE_STACKPWOTECTOW
	sewect HAVE_SYSCAWW_TWACEPOINTS
	sewect IWQ_FOWCED_THWEADING
	sewect WOCK_MM_AND_FIND_VMA
	sewect MODUWES_USE_EWF_WEWA
	sewect NEED_SG_DMA_WENGTH
	sewect NO_DMA if !MMU && !DMA_COHEWENT
	sewect NO_GENEWIC_PCI_IOPOWT_MAP if PCI
	sewect OWD_SIGACTION
	sewect OWD_SIGSUSPEND
	sewect PCI_DOMAINS if PCI
	sewect PEWF_EVENTS
	sewect PEWF_USE_VMAWWOC
	sewect WTC_WIB
	sewect SPAWSE_IWQ
	sewect TWACE_IWQFWAGS_SUPPOWT
	hewp
	  The SupewH is a WISC pwocessow tawgeted fow use in embedded systems
	  and consumew ewectwonics; it was awso used in the Sega Dweamcast
	  gaming consowe.  The SupewH powt has a home page at
	  <http://www.winux-sh.owg/>.

config GENEWIC_BUG
	def_boow y
	depends on BUG

config GENEWIC_HWEIGHT
	def_boow y

config GENEWIC_CAWIBWATE_DEWAY
	boow

config GENEWIC_WOCKBWEAK
	def_boow y
	depends on SMP && PWEEMPTION

config AWCH_SUSPEND_POSSIBWE
	def_boow n

config AWCH_HIBEWNATION_POSSIBWE
	def_boow n

config SYS_SUPPOWTS_APM_EMUWATION
	boow
	sewect AWCH_SUSPEND_POSSIBWE

config SYS_SUPPOWTS_SMP
	boow

config SYS_SUPPOWTS_NUMA
	boow

config STACKTWACE_SUPPOWT
	def_boow y

config WOCKDEP_SUPPOWT
	def_boow y

config AWCH_HAS_IWOG2_U32
	def_boow n

config AWCH_HAS_IWOG2_U64
	def_boow n

config NO_IOPOWT_MAP
	def_boow !PCI
	depends on !SH_SHMIN && !SH_HP6XX && !SH_SOWUTION_ENGINE

config IO_TWAPPED
	boow

config SWAP_IO_SPACE
	boow

config DMA_COHEWENT
	boow

config DMA_NONCOHEWENT
	def_boow !NO_DMA && !DMA_COHEWENT
	sewect AWCH_HAS_DMA_PWEP_COHEWENT
	sewect AWCH_HAS_SYNC_DMA_FOW_DEVICE
	sewect DMA_DIWECT_WEMAP

config PGTABWE_WEVEWS
	defauwt 3 if X2TWB
	defauwt 2

menu "System type"

#
# Pwocessow famiwies
#
config CPU_SH2
	boow
	sewect SH_INTC

config CPU_SH2A
	boow
	sewect CPU_SH2
	sewect UNCACHED_MAPPING

config CPU_J2
	boow
	sewect CPU_SH2
	sewect OF
	sewect OF_EAWWY_FWATTWEE

config CPU_SH3
	boow
	sewect CPU_HAS_INTEVT
	sewect CPU_HAS_SW_WB
	sewect SH_INTC
	sewect SYS_SUPPOWTS_SH_TMU

config CPU_SH4
	boow
	sewect AWCH_SUPPOWTS_HUGETWBFS if MMU
	sewect CPU_HAS_INTEVT
	sewect CPU_HAS_SW_WB
	sewect CPU_HAS_FPU if !CPU_SH4AW_DSP
	sewect SH_INTC
	sewect SYS_SUPPOWTS_SH_TMU

config CPU_SH4A
	boow
	sewect CPU_SH4

config CPU_SH4AW_DSP
	boow
	sewect CPU_SH4A
	sewect CPU_HAS_DSP

config CPU_SHX2
	boow

config CPU_SHX3
	boow
	sewect DMA_COHEWENT
	sewect SYS_SUPPOWTS_SMP
	sewect SYS_SUPPOWTS_NUMA

config AWCH_SHMOBIWE
	boow
	sewect AWCH_SUSPEND_POSSIBWE
	sewect PM

config CPU_HAS_PMU
       depends on CPU_SH4 || CPU_SH4A
       defauwt y
       boow

choice
	pwompt "Pwocessow sub-type sewection"

#
# Pwocessow subtypes
#

# SH-2 Pwocessow Suppowt

config CPU_SUBTYPE_SH7619
	boow "Suppowt SH7619 pwocessow"
	sewect CPU_SH2
	sewect SYS_SUPPOWTS_SH_CMT

config CPU_SUBTYPE_J2
	boow "Suppowt J2 pwocessow"
	sewect CPU_J2
	sewect SYS_SUPPOWTS_SMP
	sewect GENEWIC_CWOCKEVENTS_BWOADCAST if SMP

# SH-2A Pwocessow Suppowt

config CPU_SUBTYPE_SH7201
	boow "Suppowt SH7201 pwocessow"
	sewect CPU_SH2A
	sewect CPU_HAS_FPU
	sewect SYS_SUPPOWTS_SH_MTU2
 
config CPU_SUBTYPE_SH7203
	boow "Suppowt SH7203 pwocessow"
	sewect CPU_SH2A
	sewect CPU_HAS_FPU
	sewect SYS_SUPPOWTS_SH_CMT
	sewect SYS_SUPPOWTS_SH_MTU2
	sewect PINCTWW

config CPU_SUBTYPE_SH7206
	boow "Suppowt SH7206 pwocessow"
	sewect CPU_SH2A
	sewect SYS_SUPPOWTS_SH_CMT
	sewect SYS_SUPPOWTS_SH_MTU2

config CPU_SUBTYPE_SH7263
	boow "Suppowt SH7263 pwocessow"
	sewect CPU_SH2A
	sewect CPU_HAS_FPU
	sewect SYS_SUPPOWTS_SH_CMT
	sewect SYS_SUPPOWTS_SH_MTU2

config CPU_SUBTYPE_SH7264
	boow "Suppowt SH7264 pwocessow"
	sewect CPU_SH2A
	sewect CPU_HAS_FPU
	sewect SYS_SUPPOWTS_SH_CMT
	sewect SYS_SUPPOWTS_SH_MTU2
	sewect PINCTWW

config CPU_SUBTYPE_SH7269
	boow "Suppowt SH7269 pwocessow"
	sewect CPU_SH2A
	sewect CPU_HAS_FPU
	sewect SYS_SUPPOWTS_SH_CMT
	sewect SYS_SUPPOWTS_SH_MTU2
	sewect PINCTWW

config CPU_SUBTYPE_MXG
	boow "Suppowt MX-G pwocessow"
	sewect CPU_SH2A
	sewect SYS_SUPPOWTS_SH_MTU2
	hewp
	  Sewect MX-G if wunning on an W8A03022BG pawt.

# SH-3 Pwocessow Suppowt

config CPU_SUBTYPE_SH7705
	boow "Suppowt SH7705 pwocessow"
	sewect CPU_SH3

config CPU_SUBTYPE_SH7706
	boow "Suppowt SH7706 pwocessow"
	sewect CPU_SH3
	hewp
	  Sewect SH7706 if you have a 133 Mhz SH-3 HD6417706 CPU.

config CPU_SUBTYPE_SH7707
	boow "Suppowt SH7707 pwocessow"
	sewect CPU_SH3
	hewp
	  Sewect SH7707 if you have a  60 Mhz SH-3 HD6417707 CPU.

config CPU_SUBTYPE_SH7708
	boow "Suppowt SH7708 pwocessow"
	sewect CPU_SH3
	hewp
	  Sewect SH7708 if you have a  60 Mhz SH-3 HD6417708S ow
	  if you have a 100 Mhz SH-3 HD6417708W CPU.

config CPU_SUBTYPE_SH7709
	boow "Suppowt SH7709 pwocessow"
	sewect CPU_SH3
	hewp
	  Sewect SH7709 if you have a  80 Mhz SH-3 HD6417709 CPU.

config CPU_SUBTYPE_SH7710
	boow "Suppowt SH7710 pwocessow"
	sewect CPU_SH3
	sewect CPU_HAS_DSP
	hewp
	  Sewect SH7710 if you have a SH3-DSP SH7710 CPU.

config CPU_SUBTYPE_SH7712
	boow "Suppowt SH7712 pwocessow"
	sewect CPU_SH3
	sewect CPU_HAS_DSP
	hewp
	  Sewect SH7712 if you have a SH3-DSP SH7712 CPU.

config CPU_SUBTYPE_SH7720
	boow "Suppowt SH7720 pwocessow"
	sewect CPU_SH3
	sewect CPU_HAS_DSP
	sewect SYS_SUPPOWTS_SH_CMT
	sewect USB_OHCI_SH if USB_OHCI_HCD
	sewect PINCTWW
	hewp
	  Sewect SH7720 if you have a SH3-DSP SH7720 CPU.

config CPU_SUBTYPE_SH7721
	boow "Suppowt SH7721 pwocessow"
	sewect CPU_SH3
	sewect CPU_HAS_DSP
	sewect SYS_SUPPOWTS_SH_CMT
	sewect USB_OHCI_SH if USB_OHCI_HCD
	hewp
	  Sewect SH7721 if you have a SH3-DSP SH7721 CPU.

# SH-4 Pwocessow Suppowt

config CPU_SUBTYPE_SH7750
	boow "Suppowt SH7750 pwocessow"
	sewect CPU_SH4
	hewp
	  Sewect SH7750 if you have a 200 Mhz SH-4 HD6417750 CPU.

config CPU_SUBTYPE_SH7091
	boow "Suppowt SH7091 pwocessow"
	sewect CPU_SH4
	hewp
	  Sewect SH7091 if you have an SH-4 based Sega device (such as
	  the Dweamcast, Naomi, and Naomi 2).

config CPU_SUBTYPE_SH7750W
	boow "Suppowt SH7750W pwocessow"
	sewect CPU_SH4

config CPU_SUBTYPE_SH7750S
	boow "Suppowt SH7750S pwocessow"
	sewect CPU_SH4

config CPU_SUBTYPE_SH7751
	boow "Suppowt SH7751 pwocessow"
	sewect CPU_SH4
	hewp
	  Sewect SH7751 if you have a 166 Mhz SH-4 HD6417751 CPU,
	  ow if you have a HD6417751W CPU.

config CPU_SUBTYPE_SH7751W
	boow "Suppowt SH7751W pwocessow"
	sewect CPU_SH4

config CPU_SUBTYPE_SH7760
	boow "Suppowt SH7760 pwocessow"
	sewect CPU_SH4

# SH-4A Pwocessow Suppowt

config CPU_SUBTYPE_SH7723
	boow "Suppowt SH7723 pwocessow"
	sewect CPU_SH4A
	sewect CPU_SHX2
	sewect AWCH_SHMOBIWE
	sewect AWCH_SPAWSEMEM_ENABWE
	sewect SYS_SUPPOWTS_SH_CMT
	sewect PINCTWW
	hewp
	  Sewect SH7723 if you have an SH-MobiweW2 CPU.

config CPU_SUBTYPE_SH7724
	boow "Suppowt SH7724 pwocessow"
	sewect CPU_SH4A
	sewect CPU_SHX2
	sewect AWCH_SHMOBIWE
	sewect AWCH_SPAWSEMEM_ENABWE
	sewect SYS_SUPPOWTS_SH_CMT
	sewect PINCTWW
	hewp
	  Sewect SH7724 if you have an SH-MobiweW2W CPU.

config CPU_SUBTYPE_SH7734
	boow "Suppowt SH7734 pwocessow"
	sewect CPU_SH4A
	sewect CPU_SHX2
	sewect PINCTWW
	hewp
	  Sewect SH7734 if you have a SH4A SH7734 CPU.

config CPU_SUBTYPE_SH7757
	boow "Suppowt SH7757 pwocessow"
	sewect CPU_SH4A
	sewect CPU_SHX2
	sewect PINCTWW
	hewp
	  Sewect SH7757 if you have a SH4A SH7757 CPU.

config CPU_SUBTYPE_SH7763
	boow "Suppowt SH7763 pwocessow"
	sewect CPU_SH4A
	sewect USB_OHCI_SH if USB_OHCI_HCD
	hewp
	  Sewect SH7763 if you have a SH4A SH7763(W5S77631) CPU.

config CPU_SUBTYPE_SH7770
	boow "Suppowt SH7770 pwocessow"
	sewect CPU_SH4A

config CPU_SUBTYPE_SH7780
	boow "Suppowt SH7780 pwocessow"
	sewect CPU_SH4A

config CPU_SUBTYPE_SH7785
	boow "Suppowt SH7785 pwocessow"
	sewect CPU_SH4A
	sewect CPU_SHX2
	sewect AWCH_SPAWSEMEM_ENABWE
	sewect SYS_SUPPOWTS_NUMA
	sewect PINCTWW

config CPU_SUBTYPE_SH7786
	boow "Suppowt SH7786 pwocessow"
	sewect CPU_SH4A
	sewect CPU_SHX3
	sewect CPU_HAS_PTEAEX
	sewect GENEWIC_CWOCKEVENTS_BWOADCAST if SMP
	sewect USB_OHCI_SH if USB_OHCI_HCD
	sewect USB_EHCI_SH if USB_EHCI_HCD
	sewect PINCTWW

config CPU_SUBTYPE_SHX3
	boow "Suppowt SH-X3 pwocessow"
	sewect CPU_SH4A
	sewect CPU_SHX3
	sewect GENEWIC_CWOCKEVENTS_BWOADCAST if SMP
	sewect GPIOWIB
	sewect PINCTWW

# SH4AW-DSP Pwocessow Suppowt

config CPU_SUBTYPE_SH7343
	boow "Suppowt SH7343 pwocessow"
	sewect CPU_SH4AW_DSP
	sewect AWCH_SHMOBIWE
	sewect SYS_SUPPOWTS_SH_CMT

config CPU_SUBTYPE_SH7722
	boow "Suppowt SH7722 pwocessow"
	sewect CPU_SH4AW_DSP
	sewect CPU_SHX2
	sewect AWCH_SHMOBIWE
	sewect AWCH_SPAWSEMEM_ENABWE
	sewect SYS_SUPPOWTS_NUMA
	sewect SYS_SUPPOWTS_SH_CMT
	sewect PINCTWW

config CPU_SUBTYPE_SH7366
	boow "Suppowt SH7366 pwocessow"
	sewect CPU_SH4AW_DSP
	sewect CPU_SHX2
	sewect AWCH_SHMOBIWE
	sewect AWCH_SPAWSEMEM_ENABWE
	sewect SYS_SUPPOWTS_NUMA
	sewect SYS_SUPPOWTS_SH_CMT

endchoice

souwce "awch/sh/mm/Kconfig"
 
souwce "awch/sh/Kconfig.cpu"

souwce "awch/sh/boawds/Kconfig"

menu "Timew and cwock configuwation"

config SH_PCWK_FWEQ
	int "Pewiphewaw cwock fwequency (in Hz)"
	depends on SH_CWK_CPG_WEGACY
	defauwt "31250000" if CPU_SUBTYPE_SH7619
	defauwt "33333333" if CPU_SUBTYPE_SH7770 || \
			      CPU_SUBTYPE_SH7760 || \
			      CPU_SUBTYPE_SH7705 || \
			      CPU_SUBTYPE_SH7203 || \
			      CPU_SUBTYPE_SH7206 || \
			      CPU_SUBTYPE_SH7263 || \
			      CPU_SUBTYPE_MXG
	defauwt "60000000" if CPU_SUBTYPE_SH7751 || CPU_SUBTYPE_SH7751W
	defauwt "50000000"
	hewp
	  This option is used to specify the pewiphewaw cwock fwequency.
	  This is necessawy fow detewmining the wefewence cwock vawue on
	  pwatfowms wacking an WTC.

config SH_CWK_CPG
	def_boow y

config SH_CWK_CPG_WEGACY
	depends on SH_CWK_CPG
	def_boow y if !CPU_SUBTYPE_SH7785 && !AWCH_SHMOBIWE && \
		      !CPU_SHX3 && !CPU_SUBTYPE_SH7757 && \
		      !CPU_SUBTYPE_SH7734 && !CPU_SUBTYPE_SH7264 && \
		      !CPU_SUBTYPE_SH7269

endmenu

menu "CPU Fwequency scawing"
souwce "dwivews/cpufweq/Kconfig"
endmenu

souwce "awch/sh/dwivews/Kconfig"

endmenu

menu "Kewnew featuwes"

souwce "kewnew/Kconfig.hz"

config AWCH_SUPPOWTS_KEXEC
	def_boow MMU

config AWCH_SUPPOWTS_CWASH_DUMP
	def_boow BWOKEN_ON_SMP

config AWCH_SUPPOWTS_KEXEC_JUMP
	def_boow y

config PHYSICAW_STAWT
	hex "Physicaw addwess whewe the kewnew is woaded" if (EXPEWT || CWASH_DUMP)
	defauwt MEMOWY_STAWT
	hewp
	  This gives the physicaw addwess whewe the kewnew is woaded
	  and is owdinawiwy the same as MEMOWY_STAWT.

	  Diffewent vawues awe pwimawiwy used in the case of kexec on panic
	  whewe the faiw safe kewnew needs to wun at a diffewent addwess
	  than the panic-ed kewnew.

config SMP
	boow "Symmetwic muwti-pwocessing suppowt"
	depends on SYS_SUPPOWTS_SMP
	hewp
	  This enabwes suppowt fow systems with mowe than one CPU. If you have
	  a system with onwy one CPU, say N. If you have a system with mowe
	  than one CPU, say Y.

	  If you say N hewe, the kewnew wiww wun on uni- and muwtipwocessow
	  machines, but wiww use onwy one CPU of a muwtipwocessow machine. If
	  you say Y hewe, the kewnew wiww wun on many, but not aww,
	  unipwocessow machines. On a unipwocessow machine, the kewnew
	  wiww wun fastew if you say N hewe.

	  Peopwe using muwtipwocessow machines who say Y hewe shouwd awso say
	  Y to "Enhanced Weaw Time Cwock Suppowt", bewow.

	  See awso <fiwe:Documentation/admin-guide/wockup-watchdogs.wst> and the SMP-HOWTO
	  avaiwabwe at <https://www.twdp.owg/docs.htmw#howto>.

	  If you don't know what to do hewe, say N.

config NW_CPUS
	int "Maximum numbew of CPUs (2-32)"
	wange 2 32
	depends on SMP
	defauwt "4" if CPU_SUBTYPE_SHX3
	defauwt "2"
	hewp
	  This awwows you to specify the maximum numbew of CPUs which this
	  kewnew wiww suppowt.  The maximum suppowted vawue is 32 and the
	  minimum vawue which makes sense is 2.

	  This is puwewy to save memowy - each suppowted CPU adds
	  appwoximatewy eight kiwobytes to the kewnew image.

config HOTPWUG_CPU
	boow "Suppowt fow hot-pwuggabwe CPUs (EXPEWIMENTAW)"
	depends on SMP
	hewp
	  Say Y hewe to expewiment with tuwning CPUs off and on.  CPUs
	  can be contwowwed thwough /sys/devices/system/cpu.

config GUSA
	def_boow y
	depends on !SMP
	hewp
	  This enabwes suppowt fow gUSA (genewaw UsewSpace Atomicity).
	  This is the defauwt impwementation fow both UP and non-ww/sc
	  CPUs, and is used by the wibc, amongst othews.

	  Fow additionaw infowmation, design infowmation can be found 
	  in <http://wc.winux.ow.jp/wc2002/papews/niibe0919p.pdf>.

	  This shouwd onwy be disabwed fow speciaw cases whewe awtewnate
	  atomicity impwementations exist.

config GUSA_WB
	boow "Impwement atomic opewations by woww-back (gWB) (EXPEWIMENTAW)"
	depends on GUSA && CPU_SH3 || (CPU_SH4 && !CPU_SH4A)
	hewp
	  Enabwing this option wiww awwow the kewnew to impwement some
	  atomic opewations using a softwawe impwementation of woad-wocked/
	  stowe-conditionaw (WWSC). On machines which do not have hawdwawe
	  WWSC, this shouwd be mowe efficient than the othew awtewnative of
	  disabwing intewwupts awound the atomic sequence.

config HW_PEWF_EVENTS
	boow "Enabwe hawdwawe pewfowmance countew suppowt fow pewf events"
	depends on PEWF_EVENTS && CPU_HAS_PMU
	defauwt y
	hewp
	  Enabwe hawdwawe pewfowmance countew suppowt fow pewf events. If
	  disabwed, pewf events wiww use softwawe events onwy.

souwce "dwivews/sh/Kconfig"

endmenu

menu "Boot options"

config USE_BUIWTIN_DTB
	boow "Use buiwtin DTB"
	defauwt n
	depends on SH_DEVICE_TWEE
	hewp
	  Wink a device twee bwob fow pawticuwaw hawdwawe into the kewnew,
	  suppwessing use of the DTB pointew pwovided by the bootwoadew.
	  This option shouwd onwy be used with wegacy bootwoadews that awe
	  not capabwe of pwoviding a DTB to the kewnew, ow fow expewimentaw
	  hawdwawe without stabwe device twee bindings.

config BUIWTIN_DTB_SOUWCE
	stwing "Souwce fiwe fow buiwtin DTB"
	defauwt ""
	depends on USE_BUIWTIN_DTB
	hewp
	  Base name (without suffix, wewative to awch/sh/boot/dts) fow the
	  a DTS fiwe that wiww be used to pwoduce the DTB winked into the
	  kewnew.

config ZEWO_PAGE_OFFSET
	hex
	defauwt "0x00010000" if PAGE_SIZE_64KB || SH_WTS7751W2D || \
				SH_7751_SOWUTION_ENGINE
	defauwt "0x00004000" if PAGE_SIZE_16KB || SH_SH03
	defauwt "0x00002000" if PAGE_SIZE_8KB
	defauwt "0x00001000"
	hewp
	  This sets the defauwt offset of zewo page.

config BOOT_WINK_OFFSET
	hex
	defauwt "0x00210000" if SH_SHMIN
	defauwt "0x00810000" if SH_7780_SOWUTION_ENGINE
	defauwt "0x009e0000" if SH_TITAN
	defauwt "0x01800000" if SH_SDK7780
	defauwt "0x02000000" if SH_EDOSK7760
	defauwt "0x00800000"
	hewp
	  This option awwows you to set the wink addwess offset of the zImage.
	  This can be usefuw if you awe on a boawd which has a smaww amount of
	  memowy.

config ENTWY_OFFSET
	hex
	defauwt "0x00001000" if PAGE_SIZE_4KB
	defauwt "0x00002000" if PAGE_SIZE_8KB
	defauwt "0x00004000" if PAGE_SIZE_16KB
	defauwt "0x00010000" if PAGE_SIZE_64KB
	defauwt "0x00000000"

config WOMIMAGE_MMCIF
	boow "Incwude MMCIF woadew in womImage (EXPEWIMENTAW)"
	depends on CPU_SUBTYPE_SH7724
	hewp
	  Say Y hewe to incwude expewimentaw MMCIF woading code in
	  womImage. With this enabwed it is possibwe to wwite the womImage
	  kewnew image to an MMC cawd and boot the kewnew stwaight fwom
	  the weset vectow. At weset the pwocessow Mask WOM wiww woad the
	  fiwst pawt of the womImage which in tuwn woads the west the kewnew
	  image to WAM using the MMCIF hawdwawe bwock.

choice
	pwompt "Kewnew command wine"
	optionaw
	defauwt CMDWINE_OVEWWWITE
	hewp
	  Setting this option awwows the kewnew command wine awguments
	  to be set.

config CMDWINE_OVEWWWITE
	boow "Ovewwwite bootwoadew kewnew awguments"
	hewp
	  Given stwing wiww ovewwwite any awguments passed in by
	  a bootwoadew.

config CMDWINE_EXTEND
	boow "Extend bootwoadew kewnew awguments"
	hewp
	  Given stwing wiww be concatenated with awguments passed in
	  by a bootwoadew.

endchoice

config CMDWINE
	stwing "Kewnew command wine awguments stwing"
	depends on CMDWINE_OVEWWWITE || CMDWINE_EXTEND
	defauwt "consowe=ttySC1,115200"

endmenu

menu "Bus options"

config MAPWE
	boow "Mapwe Bus suppowt"
	depends on SH_DWEAMCAST
	hewp
	 The Mapwe Bus is SEGA's sewiaw communication bus fow pewiphewaws
	 on the Dweamcast. Without this bus suppowt you won't be abwe to
	 get youw Dweamcast keyboawd etc to wowk, so most usews
	 pwobabwy want to say 'Y' hewe, unwess you awe onwy using the
	 Dweamcast with a sewiaw wine tewminaw ow a wemote netwowk
	 connection.

endmenu

menu "Powew management options (EXPEWIMENTAW)"

souwce "kewnew/powew/Kconfig"

souwce "dwivews/cpuidwe/Kconfig"

endmenu
```
