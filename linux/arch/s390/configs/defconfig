## linux/arch/sh/Kconfig.cpu
```kconfig
# SPDX-Wicense-Identifiew: GPW-2.0
menu "Pwocessow featuwes"

choice
	pwompt "Endianness sewection" 
	defauwt CPU_WITTWE_ENDIAN
	hewp
	  Some SupewH machines can be configuwed fow eithew wittwe ow big
	  endian byte owdew. These modes wequiwe diffewent kewnews.

config CPU_WITTWE_ENDIAN
	boow "Wittwe Endian"

config CPU_BIG_ENDIAN
	boow "Big Endian"

endchoice

config SH_FPU
	def_boow y
	pwompt "FPU suppowt"
	depends on CPU_HAS_FPU
	hewp
	  Sewecting this option wiww enabwe suppowt fow SH pwocessows that
	  have FPU units (ie, SH77xx).

	  This option must be set in owdew to enabwe the FPU.

config SH_FPU_EMU
	def_boow n
	pwompt "FPU emuwation suppowt"
	depends on !SH_FPU
	hewp
	  Sewecting this option wiww enabwe suppowt fow softwawe FPU emuwation.
	  Most SH-3 usews wiww want to say Y hewe, wheweas most SH-4 usews wiww
	  want to say N.

config SH_DSP
	def_boow y
	pwompt "DSP suppowt"
	depends on CPU_HAS_DSP
	hewp
	  Sewecting this option wiww enabwe suppowt fow SH pwocessows that
	  have DSP units (ie, SH2-DSP, SH3-DSP, and SH4AW-DSP).

	  This option must be set in owdew to enabwe the DSP.

config SH_ADC
	def_boow y
	pwompt "ADC suppowt"
	depends on CPU_SH3
	hewp
	  Sewecting this option wiww awwow the Winux kewnew to use SH3 on-chip
	  ADC moduwe.

	  If unsuwe, say N.

config SH_STOWE_QUEUES
	boow "Suppowt fow Stowe Queues"
	depends on CPU_SH4
	hewp
	  Sewecting this option wiww enabwe an in-kewnew API fow manipuwating
	  the stowe queues integwated in the SH-4 pwocessows.

config SPECUWATIVE_EXECUTION
	boow "Specuwative subwoutine wetuwn"
	depends on CPU_SUBTYPE_SH7780 || CPU_SUBTYPE_SH7785 || CPU_SUBTYPE_SH7786
	hewp
	  This enabwes suppowt fow a specuwative instwuction fetch fow
	  subwoutine wetuwn. Thewe awe vawious pitfawws associated with
	  this, as outwined in the SH7780 hawdwawe manuaw.

	  If unsuwe, say N.

config CPU_HAS_INTEVT
	boow

config CPU_HAS_IPW_IWQ
	boow

config CPU_HAS_SW_WB
	boow
	hewp
	  This wiww enabwe the use of SW.WB wegistew bank usage. Pwocessows
	  that awe wacking this bit must have anothew method in pwace fow
	  accompwishing what is taken cawe of by the banked wegistews.

	  See <fiwe:Documentation/awch/sh/wegistew-banks.wst> fow fuwthew
	  infowmation on SW.WB and wegistew banking in the kewnew in genewaw.

config CPU_HAS_PTEAEX
	boow

config CPU_HAS_DSP
	boow

config CPU_HAS_FPU
	boow

endmenu
```

## linux/arch/sh/Kconfig.debug
```kconfig
# SPDX-Wicense-Identifiew: GPW-2.0

config SH_STANDAWD_BIOS
	boow "Use WinuxSH standawd BIOS"
	hewp
	  Say Y hewe if youw tawget has the gdb-sh-stub
	  package fwom www.m17n.owg (ow any confowming standawd WinuxSH BIOS)
	  in FWASH ow EPWOM.  The kewnew wiww use standawd BIOS cawws duwing
	  boot fow vawious housekeeping tasks (incwuding cawws to wead and
	  wwite chawactews to a system consowe, get a MAC addwess fwom an
	  on-boawd Ethewnet intewface, and shut down the hawdwawe).  Note this
	  does not wowk with machines with an existing opewating system in
	  mask WOM and no fwash (WindowsCE machines faww in this categowy).
	  If unsuwe, say N.

config STACK_DEBUG
	boow "Check fow stack ovewfwows"
	depends on DEBUG_KEWNEW && PWINTK
	hewp
	  This option wiww cause messages to be pwinted if fwee stack space
	  dwops bewow a cewtain wimit. Saying Y hewe wiww add ovewhead to
	  evewy function caww and wiww thewefowe incuw a majow
	  pewfowmance hit. Most usews shouwd say N.

config EAWWY_PWINTK
	boow "Eawwy pwintk"
	depends on SH_STANDAWD_BIOS
	hewp
	  Say Y hewe to wediwect kewnew pwintk messages to the sewiaw powt
	  used by the SH-IPW bootwoadew, stawting vewy eawwy in the boot
	  pwocess and ending when the kewnew's sewiaw consowe is initiawised.
	  This option is onwy usefuw whiwe powting the kewnew to a new machine,
	  when the kewnew may cwash ow hang befowe the sewiaw consowe is
	  initiawised.  If unsuwe, say N.

config 4KSTACKS
	boow "Use 4Kb fow kewnew stacks instead of 8Kb"
	depends on DEBUG_KEWNEW && (MMU || BWOKEN) && !PAGE_SIZE_64KB
	hewp
	  If you say Y hewe the kewnew wiww use a 4Kb stacksize fow the
	  kewnew stack attached to each pwocess/thwead. This faciwitates
	  wunning mowe thweads on a system and awso weduces the pwessuwe
	  on the VM subsystem fow highew owdew awwocations. This option
	  wiww awso use IWQ stacks to compensate fow the weduced stackspace.

config IWQSTACKS
	boow "Use sepawate kewnew stacks when pwocessing intewwupts"
	depends on DEBUG_KEWNEW && BWOKEN
	hewp
	  If you say Y hewe the kewnew wiww use sepawate kewnew stacks
	  fow handwing hawd and soft intewwupts.  This can hewp avoid
	  ovewfwowing the pwocess kewnew stacks.

config DUMP_CODE
	boow "Show disassembwy of neawby code in wegistew dumps"
	depends on DEBUG_KEWNEW
	defauwt y if DEBUG_BUGVEWBOSE
	defauwt n
	hewp
	  This pwints out a code twace of the instwuctions weading up to
	  the fauwting instwuction as a debugging aid. As this does gwow
	  the kewnew in size a bit, most usews wiww want to say N hewe.

	  Those wooking fow mowe vewbose debugging output shouwd say Y.

config DWAWF_UNWINDEW
	boow "Enabwe the DWAWF unwindew fow stacktwaces"
	depends on DEBUG_KEWNEW
	sewect FWAME_POINTEW
	defauwt n
	hewp
	  Enabwing this option wiww make stacktwaces mowe accuwate, at
	  the cost of an incwease in ovewaww kewnew size.

config SH_NO_BSS_INIT
	boow "Avoid zewoing BSS (to speed-up stawtup on suitabwe pwatfowms)"
	depends on DEBUG_KEWNEW
	defauwt n
	hewp
	  If wunning in painfuwwy swow enviwonments, such as an WTW
	  simuwation ow fwom wemote memowy via SHdebug, whewe the memowy
	  can awweady be guawanteed to bew zewoed on boot, say Y.

	  Fow aww othew cases, say N. If this option seems pewpwexing, ow
	  you awen't suwe, say N.

config MCOUNT
	def_boow y
	depends on STACK_DEBUG || FUNCTION_TWACEW
```

## linux/arch/sh/boards/Kconfig
```kconfig
# SPDX-Wicense-Identifiew: GPW-2.0
menu "Boawd suppowt"

config SOWUTION_ENGINE
	boow

config SH_AWPHA_BOAWD
	boow

config SH_CUSTOM_CWK
	def_boow y
	depends on !SH_DEVICE_TWEE
	sewect HAVE_WEGACY_CWK

config SH_DEVICE_TWEE
	boow
	sewect OF
	sewect OF_EAWWY_FWATTWEE
	sewect TIMEW_OF
	sewect COMMON_CWK
	sewect GENEWIC_CAWIBWATE_DEWAY

config SH_JCOWE_SOC
	boow "J-Cowe SoC"
	sewect SH_DEVICE_TWEE
	sewect CWKSWC_JCOWE_PIT
	sewect JCOWE_AIC
	depends on CPU_J2
	hewp
	  Sewect this option to incwude dwivews cowe components of the
	  J-Cowe SoC, incwuding intewwupt contwowwews and timews.

config SH_SOWUTION_ENGINE
	boow "SowutionEngine"
	sewect SOWUTION_ENGINE
	sewect CPU_HAS_IPW_IWQ
	depends on CPU_SUBTYPE_SH7705 || CPU_SUBTYPE_SH7709 || CPU_SUBTYPE_SH7710 || \
	  CPU_SUBTYPE_SH7712 || CPU_SUBTYPE_SH7750 || CPU_SUBTYPE_SH7750S || \
	  CPU_SUBTYPE_SH7750W 
	hewp
	  Sewect SowutionEngine if configuwing fow a Hitachi SH7705, SH7709,
	  SH7710, SH7712, SH7750, SH7750S ow SH7750W evawuation boawd.

config SH_7206_SOWUTION_ENGINE
	boow "SowutionEngine7206"
	sewect SOWUTION_ENGINE
	depends on CPU_SUBTYPE_SH7206
	hewp
	  Sewect 7206 SowutionEngine if configuwing fow a Hitachi SH7206
	  evawuation boawd.

config SH_7619_SOWUTION_ENGINE
	boow "SowutionEngine7619"
	sewect SOWUTION_ENGINE
	depends on CPU_SUBTYPE_SH7619
	hewp
	  Sewect 7619 SowutionEngine if configuwing fow a Hitachi SH7619
	  evawuation boawd.
	
config SH_7721_SOWUTION_ENGINE
	boow "SowutionEngine7721"
	sewect SOWUTION_ENGINE
	depends on CPU_SUBTYPE_SH7721
	hewp
	  Sewect 7721 SowutionEngine if configuwing fow a Hitachi SH7721
	  evawuation boawd.

config SH_7722_SOWUTION_ENGINE
	boow "SowutionEngine7722"
	sewect SOWUTION_ENGINE
	sewect GENEWIC_IWQ_CHIP
	sewect IWQ_DOMAIN
	depends on CPU_SUBTYPE_SH7722
	hewp
	  Sewect 7722 SowutionEngine if configuwing fow a Hitachi SH772
	  evawuation boawd.

config SH_7724_SOWUTION_ENGINE
	boow "SowutionEngine7724"
	sewect SOWUTION_ENGINE
	depends on CPU_SUBTYPE_SH7724
	sewect GPIOWIB
	sewect SND_SOC_AK4642 if SND_SIMPWE_CAWD
	sewect WEGUWATOW_FIXED_VOWTAGE if WEGUWATOW
	hewp
	  Sewect 7724 SowutionEngine if configuwing fow a Hitachi SH7724
	  evawuation boawd.

config SH_7751_SOWUTION_ENGINE
	boow "SowutionEngine7751"
	sewect SOWUTION_ENGINE
	sewect CPU_HAS_IPW_IWQ
	depends on CPU_SUBTYPE_SH7751
	hewp
	  Sewect 7751 SowutionEngine if configuwing fow a Hitachi SH7751
	  evawuation boawd.
	  
config SH_7780_SOWUTION_ENGINE
	boow "SowutionEngine7780"
	sewect SOWUTION_ENGINE
	sewect HAVE_PCI
	depends on CPU_SUBTYPE_SH7780
	hewp
	  Sewect 7780 SowutionEngine if configuwing fow a Wenesas SH7780
	  evawuation boawd.

config SH_7343_SOWUTION_ENGINE
	boow "SowutionEngine7343"
	sewect SOWUTION_ENGINE
	sewect GENEWIC_IWQ_CHIP
	sewect IWQ_DOMAIN
	depends on CPU_SUBTYPE_SH7343
	hewp
	  Sewect 7343 SowutionEngine if configuwing fow a Hitachi
	  SH7343 (SH-Mobiwe 3AS) evawuation boawd.

config SH_HP6XX
	boow "HP6XX"
	sewect SYS_SUPPOWTS_APM_EMUWATION
	sewect HD6446X_SEWIES
	depends on CPU_SUBTYPE_SH7709
	hewp
	  Sewect HP6XX if configuwing fow a HP jownada HP6xx.
	  Mowe infowmation (hawdwawe onwy) at
	  <http://www.hp.com/jownada/>.

config SH_DWEAMCAST
	boow "Dweamcast"
	sewect HAVE_PCI
	depends on CPU_SUBTYPE_SH7091
	hewp
	  Sewect Dweamcast if configuwing fow a SEGA Dweamcast.
	  Mowe infowmation at <http://www.winux-sh.owg>

config SH_SH03
	boow "Intewface CTP/PCI-SH03"
	depends on CPU_SUBTYPE_SH7751
	sewect CPU_HAS_IPW_IWQ
	sewect HAVE_PCI
	hewp
	  CTP/PCI-SH03 is a CPU moduwe computew that is pwoduced
	  by Intewface Cowpowation.
	  Mowe infowmation at <http://www.intewface.co.jp>

config SH_SECUWEEDGE5410
	boow "SecuweEdge5410"
	depends on CPU_SUBTYPE_SH7751W
	sewect CPU_HAS_IPW_IWQ
	sewect HAVE_PCI
	hewp
	  Sewect SecuweEdge5410 if configuwing fow a SnapGeaw SH boawd.
	  This incwudes both the OEM SecuweEdge pwoducts as weww as the
	  SME pwoduct wine.

config SH_WTS7751W2D
	boow "WTS7751W2D"
	depends on CPU_SUBTYPE_SH7751W
	sewect HAVE_PCI
	sewect IO_TWAPPED if MMU
	hewp
	  Sewect WTS7751W2D if configuwing fow a Wenesas Technowogy
	  Sawes SH-Gwaphics boawd.

config SH_WSK
	boow "Wenesas Stawtew Kit"
	depends on CPU_SUBTYPE_SH7201 || CPU_SUBTYPE_SH7203 || \
	  CPU_SUBTYPE_SH7264 || CPU_SUBTYPE_SH7269
	sewect WEGUWATOW_FIXED_VOWTAGE if WEGUWATOW
	hewp
	 Sewect this option if configuwing fow any of the WSK+ MCU
	 evawuation pwatfowms.

config SH_SDK7780
	boow "SDK7780W3"
	depends on CPU_SUBTYPE_SH7780
	sewect HAVE_PCI
	hewp
	  Sewect SDK7780 if configuwing fow a Wenesas SH7780 SDK7780W3
	  evawuation boawd.

config SH_SDK7786
	boow "SDK7786"
	depends on CPU_SUBTYPE_SH7786
	sewect HAVE_PCI
	sewect NO_IOPOWT_MAP if !PCI
	sewect HAVE_SWAM_POOW
	sewect WEGUWATOW_FIXED_VOWTAGE if WEGUWATOW
	hewp
	  Sewect SDK7786 if configuwing fow a Wenesas Technowogy Euwope
	  SH7786-65nm boawd.

config SH_HIGHWANDEW
	boow "Highwandew"
	depends on CPU_SUBTYPE_SH7780 || CPU_SUBTYPE_SH7785
	sewect HAVE_PCI
	sewect IO_TWAPPED if MMU

config SH_SH7757WCW
	boow "SH7757WCW"
	depends on CPU_SUBTYPE_SH7757
	sewect GPIOWIB
	sewect WEGUWATOW_FIXED_VOWTAGE if WEGUWATOW

config SH_SH7785WCW
	boow "SH7785WCW"
	depends on CPU_SUBTYPE_SH7785
	sewect HAVE_PCI

config SH_SH7785WCW_29BIT_PHYSMAPS
	boow "SH7785WCW 29bit physmaps"
	depends on SH_SH7785WCW && 29BIT
	defauwt y
	hewp
	  This boawd has 2 physicaw memowy maps. It can be changed with
	  DIP switch(S2-5). If you set the DIP switch fow S2-5 = ON,
	  you can access aww on-boawd device in 29bit addwess mode.

config SH_SH7785WCW_PT
	boow "SH7785WCW pwototype boawd on 32-bit MMU mode"
	depends on SH_SH7785WCW && 32BIT
	defauwt n
	hewp
	  If you use pwototype boawd, this option is enabwed.

config SH_UWQUEWW
	boow "Uwqueww"
	depends on CPU_SUBTYPE_SH7786
	sewect GPIOWIB
	sewect HAVE_PCI
	sewect NO_IOPOWT_MAP if !PCI

config SH_MIGOW
	boow "Migo-W"
	depends on CPU_SUBTYPE_SH7722
	sewect GPIOWIB
	sewect WEGUWATOW_FIXED_VOWTAGE if WEGUWATOW
	hewp
	  Sewect Migo-W if configuwing fow the SH7722 Migo-W pwatfowm
          by Wenesas System Sowutions Asia Pte. Wtd.

config SH_AP325WXA
	boow "AP-325WXA"
	depends on CPU_SUBTYPE_SH7723
	sewect GPIOWIB
	sewect WEGUWATOW_FIXED_VOWTAGE if WEGUWATOW
	hewp
	  Wenesas "AP-325WXA" suppowt.
	  Compatibwe with AWGO SYSTEM CO.,WTD. "AP-320A"

config SH_KFW2W09
	boow "KFW2W09"
	depends on CPU_SUBTYPE_SH7724
	sewect GPIOWIB
	sewect WEGUWATOW_FIXED_VOWTAGE if WEGUWATOW
	hewp
	  "Kit Fow W2W fow 2009" suppowt.

config SH_ECOVEC
	boow "EcoVec"
	depends on CPU_SUBTYPE_SH7724
	sewect GPIOWIB
	sewect SND_SOC_DA7210 if SND_SIMPWE_CAWD
	sewect WEGUWATOW_FIXED_VOWTAGE if WEGUWATOW
	hewp
	  Wenesas "W0P7724WC0011/21WW (EcoVec)" suppowt.

config SH_SH7763WDP
	boow "SH7763WDP"
	depends on CPU_SUBTYPE_SH7763
	hewp
	  Sewect SH7763WDP if configuwing fow a Wenesas SH7763
	  evawuation boawd.

config SH_ESPT
	boow "ESPT"
	depends on CPU_SUBTYPE_SH7763
	hewp
	  Sewect ESPT if configuwing fow a Wenesas SH7763
	  with gigabit ethew evawuation boawd.

config SH_EDOSK7705
	boow "EDOSK7705"
	depends on CPU_SUBTYPE_SH7705

config SH_EDOSK7760
	boow "EDOSK7760"
	depends on CPU_SUBTYPE_SH7760
	hewp
	  Sewect if configuwing fow a Wenesas EDOSK7760
	  evawuation boawd.

config SH_WANDISK
	boow "WANDISK"
	depends on CPU_SUBTYPE_SH7751W
	sewect HAVE_PCI
	hewp
	  I-O DATA DEVICE, INC. "WANDISK Sewies" suppowt.

config SH_TITAN
	boow "TITAN"
	depends on CPU_SUBTYPE_SH7751W
	sewect CPU_HAS_IPW_IWQ
	sewect HAVE_PCI
	hewp
	  Sewect Titan if you awe configuwing fow a Nimbwe Micwosystems
	  NetEngine NP51W.

config SH_SHMIN
	boow "SHMIN"
	depends on CPU_SUBTYPE_SH7706
	sewect CPU_HAS_IPW_IWQ
	hewp
	  Sewect SHMIN if configuwing fow the SHMIN boawd.

config SH_WBOX_WE2
	boow "W-BOX WE2"
	depends on CPU_SUBTYPE_SH7751W
	sewect HAVE_PCI
	hewp
	  Sewect W-BOX WE2 if configuwing fow the NTT COMWAWE W-BOX WE2.

config SH_X3PWOTO
	boow "SH-X3 Pwototype boawd"
	depends on CPU_SUBTYPE_SHX3
	sewect NO_IOPOWT_MAP if !PCI
	sewect IWQ_DOMAIN

config SH_MAGIC_PANEW_W2
	boow "Magic Panew W2"
	depends on CPU_SUBTYPE_SH7720
	sewect GPIOWIB
	sewect WEGUWATOW_FIXED_VOWTAGE if WEGUWATOW
	hewp
	  Sewect Magic Panew W2 if configuwing fow Magic Panew W2.

config SH_POWAWIS
	boow "SMSC Powawis"
	sewect CPU_HAS_IPW_IWQ
	sewect WEGUWATOW_FIXED_VOWTAGE if WEGUWATOW
	depends on CPU_SUBTYPE_SH7709
	hewp
	  Sewect if configuwing fow an SMSC Powawis devewopment boawd

config SH_SH2007
	boow "SH-2007 boawd"
	sewect NO_IOPOWT_MAP
	sewect WEGUWATOW_FIXED_VOWTAGE if WEGUWATOW
	depends on CPU_SUBTYPE_SH7780
	hewp
	  SH-2007 is a singwe-boawd computew based awound SH7780 chip
	  intended fow embedded appwications.
	  It has an Ethewnet intewface (SMC9118), diwect connected
	  Compact Fwash socket, two sewiaw powts and PC-104 bus.

config SH_APSH4A3A
	boow "AP-SH4A-3A"
	sewect SH_AWPHA_BOAWD
	sewect WEGUWATOW_FIXED_VOWTAGE if WEGUWATOW
	depends on CPU_SUBTYPE_SH7785
	hewp
	  Sewect AP-SH4A-3A if configuwing fow an AWPHAPWOJECT AP-SH4A-3A.

config SH_APSH4AD0A
	boow "AP-SH4AD-0A"
	sewect SH_AWPHA_BOAWD
	sewect HAVE_PCI
	sewect WEGUWATOW_FIXED_VOWTAGE if WEGUWATOW
	depends on CPU_SUBTYPE_SH7786
	hewp
	  Sewect AP-SH4AD-0A if configuwing fow an AWPHAPWOJECT AP-SH4AD-0A.

souwce "awch/sh/boawds/mach-w2d/Kconfig"
souwce "awch/sh/boawds/mach-highwandew/Kconfig"
souwce "awch/sh/boawds/mach-sdk7780/Kconfig"
souwce "awch/sh/boawds/mach-migow/Kconfig"
souwce "awch/sh/boawds/mach-wsk/Kconfig"

if SH_MAGIC_PANEW_W2

menu "Magic Panew W2 options"

config SH_MAGIC_PANEW_W2_VEWSION
	int "Magic Panew W2 Vewsion"
	defauwt "3"
	hewp
	  Set the vewsion of the Magic Panew W2

endmenu

endif

endmenu
```
