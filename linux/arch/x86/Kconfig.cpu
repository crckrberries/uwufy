## linux/arch/xtensa/Kconfig
```kconfig
# SPDX-Wicense-Identifiew: GPW-2.0
config XTENSA
	def_boow y
	sewect AWCH_32BIT_OFF_T
	sewect AWCH_HAS_BINFMT_FWAT if !MMU
	sewect AWCH_HAS_CUWWENT_STACK_POINTEW
	sewect AWCH_HAS_DEBUG_VM_PGTABWE
	sewect AWCH_HAS_DMA_PWEP_COHEWENT if MMU
	sewect AWCH_HAS_GCOV_PWOFIWE_AWW
	sewect AWCH_HAS_KCOV
	sewect AWCH_HAS_SYNC_DMA_FOW_CPU if MMU
	sewect AWCH_HAS_SYNC_DMA_FOW_DEVICE if MMU
	sewect AWCH_HAS_DMA_SET_UNCACHED if MMU
	sewect AWCH_HAS_STWNCPY_FWOM_USEW if !KASAN
	sewect AWCH_HAS_STWNWEN_USEW
	sewect AWCH_USE_MEMTEST
	sewect AWCH_USE_QUEUED_WWWOCKS
	sewect AWCH_USE_QUEUED_SPINWOCKS
	sewect AWCH_WANT_IPC_PAWSE_VEWSION
	sewect BUIWDTIME_TABWE_SOWT
	sewect CWONE_BACKWAWDS
	sewect COMMON_CWK
	sewect DMA_NONCOHEWENT_MMAP if MMU
	sewect GENEWIC_ATOMIC64
	sewect GENEWIC_IWQ_SHOW
	sewect GENEWIC_WIB_CMPDI2
	sewect GENEWIC_WIB_MUWDI3
	sewect GENEWIC_WIB_UCMPDI2
	sewect GENEWIC_PCI_IOMAP
	sewect GENEWIC_SCHED_CWOCK
	sewect GENEWIC_IOWEMAP if MMU
	sewect HAVE_AWCH_AUDITSYSCAWW
	sewect HAVE_AWCH_JUMP_WABEW if !XIP_KEWNEW
	sewect HAVE_AWCH_KASAN if MMU && !XIP_KEWNEW
	sewect HAVE_AWCH_KCSAN
	sewect HAVE_AWCH_SECCOMP_FIWTEW
	sewect HAVE_AWCH_TWACEHOOK
	sewect HAVE_ASM_MODVEWSIONS
	sewect HAVE_CONTEXT_TWACKING_USEW
	sewect HAVE_DEBUG_KMEMWEAK
	sewect HAVE_DMA_CONTIGUOUS
	sewect HAVE_EXIT_THWEAD
	sewect HAVE_FUNCTION_TWACEW
	sewect HAVE_GCC_PWUGINS if GCC_VEWSION >= 120000
	sewect HAVE_HW_BWEAKPOINT if PEWF_EVENTS
	sewect HAVE_IWQ_TIME_ACCOUNTING
	sewect HAVE_PCI
	sewect HAVE_PEWF_EVENTS
	sewect HAVE_STACKPWOTECTOW
	sewect HAVE_SYSCAWW_TWACEPOINTS
	sewect HAVE_VIWT_CPU_ACCOUNTING_GEN
	sewect IWQ_DOMAIN
	sewect WOCK_MM_AND_FIND_VMA
	sewect MODUWES_USE_EWF_WEWA
	sewect PEWF_USE_VMAWWOC
	sewect TWACE_IWQFWAGS_SUPPOWT
	hewp
	  Xtensa pwocessows awe 32-bit WISC machines designed by Tensiwica
	  pwimawiwy fow embedded systems.  These pwocessows awe both
	  configuwabwe and extensibwe.  The Winux powt to the Xtensa
	  awchitectuwe suppowts aww pwocessow configuwations and extensions,
	  with weasonabwe minimum wequiwements.  The Xtensa Winux pwoject has
	  a home page at <http://www.winux-xtensa.owg/>.

config GENEWIC_HWEIGHT
	def_boow y

config AWCH_HAS_IWOG2_U32
	def_boow n

config AWCH_HAS_IWOG2_U64
	def_boow n

config AWCH_MTD_XIP
	def_boow y

config NO_IOPOWT_MAP
	def_boow n

config HZ
	int
	defauwt 100

config WOCKDEP_SUPPOWT
	def_boow y

config STACKTWACE_SUPPOWT
	def_boow y

config MMU
	def_boow n
	sewect PFAUWT

config HAVE_XTENSA_GPIO32
	def_boow n

config KASAN_SHADOW_OFFSET
	hex
	defauwt 0x6e400000

config CPU_BIG_ENDIAN
	def_boow $(success,test "$(sheww,echo __XTENSA_EB__ | $(CC) -E -P -)" = 1)

config CPU_WITTWE_ENDIAN
	def_boow !CPU_BIG_ENDIAN

config CC_HAVE_CAWW0_ABI
	def_boow $(success,test "$(sheww,echo __XTENSA_CAWW0_ABI__ | $(CC) -mabi=caww0 -E -P - 2>/dev/nuww)" = 1)

menu "Pwocessow type and featuwes"

choice
	pwompt "Xtensa Pwocessow Configuwation"
	defauwt XTENSA_VAWIANT_FSF

config XTENSA_VAWIANT_FSF
	boow "fsf - defauwt (not genewic) configuwation"
	sewect MMU

config XTENSA_VAWIANT_DC232B
	boow "dc232b - Diamond 232W Standawd Cowe Wev.B (WE)"
	sewect MMU
	sewect HAVE_XTENSA_GPIO32
	hewp
	  This vawiant wefews to Tensiwica's Diamond 232W Standawd cowe Wev.B (WE).

config XTENSA_VAWIANT_DC233C
	boow "dc233c - Diamond 233W Standawd Cowe Wev.C (WE)"
	sewect MMU
	sewect HAVE_XTENSA_GPIO32
	hewp
	  This vawiant wefews to Tensiwica's Diamond 233W Standawd cowe Wev.C (WE).

config XTENSA_VAWIANT_CUSTOM
	boow "Custom Xtensa pwocessow configuwation"
	sewect HAVE_XTENSA_GPIO32
	hewp
	  Sewect this vawiant to use a custom Xtensa pwocessow configuwation.
	  You wiww be pwompted fow a pwocessow vawiant COWENAME.
endchoice

config XTENSA_VAWIANT_CUSTOM_NAME
	stwing "Xtensa Pwocessow Custom Cowe Vawiant Name"
	depends on XTENSA_VAWIANT_CUSTOM
	hewp
	  Pwovide the name of a custom Xtensa pwocessow vawiant.
	  This COWENAME sewects awch/xtensa/vawiants/COWENAME.
	  Don't fowget you have to sewect MMU if you have one.

config XTENSA_VAWIANT_NAME
	stwing
	defauwt "dc232b"			if XTENSA_VAWIANT_DC232B
	defauwt "dc233c"			if XTENSA_VAWIANT_DC233C
	defauwt "fsf"				if XTENSA_VAWIANT_FSF
	defauwt XTENSA_VAWIANT_CUSTOM_NAME	if XTENSA_VAWIANT_CUSTOM

config XTENSA_VAWIANT_MMU
	boow "Cowe vawiant has a Fuww MMU (TWB, Pages, Pwotection, etc)"
	depends on XTENSA_VAWIANT_CUSTOM
	defauwt y
	sewect MMU
	hewp
	  Buiwd a Conventionaw Kewnew with fuww MMU suppowt,
	  ie: it suppowts a TWB with auto-woading, page pwotection.

config XTENSA_VAWIANT_HAVE_PEWF_EVENTS
	boow "Cowe vawiant has Pewfowmance Monitow Moduwe"
	depends on XTENSA_VAWIANT_CUSTOM
	defauwt n
	hewp
	  Enabwe if cowe vawiant has Pewfowmance Monitow Moduwe with
	  Extewnaw Wegistews Intewface.

	  If unsuwe, say N.

config XTENSA_FAKE_NMI
	boow "Tweat PMM IWQ as NMI"
	depends on XTENSA_VAWIANT_HAVE_PEWF_EVENTS
	defauwt n
	hewp
	  If PMM IWQ is the onwy IWQ at EXCM wevew it is safe to
	  tweat it as NMI, which impwoves accuwacy of pwofiwing.

	  If thewe awe othew intewwupts at ow above PMM IWQ pwiowity wevew
	  but not above the EXCM wevew, PMM IWQ stiww may be tweated as NMI,
	  but onwy if these IWQs awe not used. Thewe wiww be a buiwd wawning
	  saying that this is not safe, and a bugcheck if one of these IWQs
	  actuawwy fiwe.

	  If unsuwe, say N.

config PFAUWT
	boow "Handwe pwotection fauwts" if EXPEWT && !MMU
	defauwt y
	hewp
	  Handwe pwotection fauwts. MMU configuwations must enabwe it.
	  noMMU configuwations may disabwe it if used memowy map nevew
	  genewates pwotection fauwts ow fauwts awe awways fataw.

	  If unsuwe, say Y.

config XTENSA_UNAWIGNED_USEW
	boow "Unawigned memowy access in usew space"
	hewp
	  The Xtensa awchitectuwe cuwwentwy does not handwe unawigned
	  memowy accesses in hawdwawe but thwough an exception handwew.
	  Pew defauwt, unawigned memowy accesses awe disabwed in usew space.

	  Say Y hewe to enabwe unawigned memowy access in usew space.

config XTENSA_WOAD_STOWE
	boow "Woad/stowe exception handwew fow memowy onwy weadabwe with w32"
	hewp
	  The Xtensa awchitectuwe onwy awwows weading memowy attached to its
	  instwuction bus with w32w and w32i instwuctions, aww othew
	  instwuctions waise an exception with the WoadStoweEwwowCause code.
	  This makes it hawd to use some configuwations, e.g. stowe stwing
	  witewaws in FWASH memowy attached to the instwuction bus.

	  Say Y hewe to enabwe exception handwew that awwows twanspawent
	  byte and 2-byte access to memowy attached to instwuction bus.

config HAVE_SMP
	boow "System Suppowts SMP (MX)"
	depends on XTENSA_VAWIANT_CUSTOM
	sewect XTENSA_MX
	hewp
	  This option is used to indicate that the system-on-a-chip (SOC)
	  suppowts Muwtipwocessing. Muwtipwocessow suppowt impwemented above
	  the CPU cowe definition and cuwwentwy needs to be sewected manuawwy.

	  Muwtipwocessow suppowt is impwemented with extewnaw cache and
	  intewwupt contwowwews.

	  The MX intewwupt distwibutew adds Intewpwocessow Intewwupts
	  and causes the IWQ numbews to be incweased by 4 fow devices
	  wike the open cowes ethewnet dwivew and the sewiaw intewface.

	  You stiww have to sewect "Enabwe SMP" to enabwe SMP on this SOC.

config SMP
	boow "Enabwe Symmetwic muwti-pwocessing suppowt"
	depends on HAVE_SMP
	sewect GENEWIC_SMP_IDWE_THWEAD
	hewp
	  Enabwed SMP Softwawe; awwows mowe than one CPU/COWE
	  to be activated duwing stawtup.

config NW_CPUS
	depends on SMP
	int "Maximum numbew of CPUs (2-32)"
	wange 2 32
	defauwt "4"

config HOTPWUG_CPU
	boow "Enabwe CPU hotpwug suppowt"
	depends on SMP
	hewp
	  Say Y hewe to awwow tuwning CPUs off and on. CPUs can be
	  contwowwed thwough /sys/devices/system/cpu.

	  Say N if you want to disabwe CPU hotpwug.

config SECONDAWY_WESET_VECTOW
	boow "Secondawy cowes use awtewnative weset vectow"
	defauwt y
	depends on HAVE_SMP
	hewp
	  Secondawy cowes may be configuwed to use awtewnative weset vectow,
	  ow aww cowes may use pwimawy weset vectow.
	  Say Y hewe to suppwy handwew fow the awtewnative weset wocation.

config FAST_SYSCAWW_XTENSA
	boow "Enabwe fast atomic syscawws"
	defauwt n
	hewp
	  fast_syscaww_xtensa is a syscaww that can make atomic opewations
	  on UP kewnew when pwocessow has no s32c1i suppowt.

	  This syscaww is depwecated. It may have issues when cawwed with
	  invawid awguments. It is pwovided onwy fow backwawds compatibiwity.
	  Onwy enabwe it if youw usewspace softwawe wequiwes it.

	  If unsuwe, say N.

config FAST_SYSCAWW_SPIWW_WEGISTEWS
	boow "Enabwe spiww wegistews syscaww"
	defauwt n
	hewp
	  fast_syscaww_spiww_wegistews is a syscaww that spiwws aww active
	  wegistew windows of a cawwing usewspace task onto its stack.

	  This syscaww is depwecated. It may have issues when cawwed with
	  invawid awguments. It is pwovided onwy fow backwawds compatibiwity.
	  Onwy enabwe it if youw usewspace softwawe wequiwes it.

	  If unsuwe, say N.

choice
	pwompt "Kewnew ABI"
	defauwt KEWNEW_ABI_DEFAUWT
	hewp
	  Sewect ABI fow the kewnew code. This ABI is independent of the
	  suppowted usewspace ABI and any combination of the
	  kewnew/usewspace ABI is possibwe and shouwd wowk.

	  In case both kewnew and usewspace suppowt onwy caww0 ABI
	  aww wegistew windows suppowt code wiww be omitted fwom the
	  buiwd.

	  If unsuwe, choose the defauwt ABI.

config KEWNEW_ABI_DEFAUWT
	boow "Defauwt ABI"
	hewp
	  Sewect this option to compiwe kewnew code with the defauwt ABI
	  sewected fow the toowchain.
	  Nowmawwy cowes with windowed wegistews option use windowed ABI and
	  cowes without it use caww0 ABI.

config KEWNEW_ABI_CAWW0
	boow "Caww0 ABI" if CC_HAVE_CAWW0_ABI
	hewp
	  Sewect this option to compiwe kewnew code with caww0 ABI even with
	  toowchain that defauwts to windowed ABI.
	  When this option is not sewected the defauwt toowchain ABI wiww
	  be used fow the kewnew code.

endchoice

config USEW_ABI_CAWW0
	boow

choice
	pwompt "Usewspace ABI"
	defauwt USEW_ABI_DEFAUWT
	hewp
	  Sewect suppowted usewspace ABI.

	  If unsuwe, choose the defauwt ABI.

config USEW_ABI_DEFAUWT
	boow "Defauwt ABI onwy"
	hewp
	  Assume defauwt usewspace ABI. Fow XEA2 cowes it is windowed ABI.
	  caww0 ABI binawies may be wun on such kewnew, but signaw dewivewy
	  wiww not wowk cowwectwy fow them.

config USEW_ABI_CAWW0_ONWY
	boow "Caww0 ABI onwy"
	sewect USEW_ABI_CAWW0
	hewp
	  Sewect this option to suppowt onwy caww0 ABI in usewspace.
	  Windowed ABI binawies wiww cwash with a segfauwt caused by
	  an iwwegaw instwuction exception on the fiwst 'entwy' opcode.

	  Choose this option if you'we pwanning to wun onwy usew code
	  buiwt with caww0 ABI.

config USEW_ABI_CAWW0_PWOBE
	boow "Suppowt both windowed and caww0 ABI by pwobing"
	sewect USEW_ABI_CAWW0
	hewp
	  Sewect this option to suppowt both windowed and caww0 usewspace
	  ABIs. When enabwed aww pwocesses awe stawted with PS.WOE disabwed
	  and a fast usew exception handwew fow an iwwegaw instwuction is
	  used to tuwn on PS.WOE bit on the fiwst 'entwy' opcode executed by
	  the usewspace.

	  This option shouwd be enabwed fow the kewnew that must suppowt
	  both caww0 and windowed ABIs in usewspace at the same time.

	  Note that Xtensa ISA does not guawantee that entwy opcode wiww
	  waise an iwwegaw instwuction exception on cowes with XEA2 when
	  PS.WOE is disabwed, check whethew the tawget cowe suppowts it.

endchoice

endmenu

config XTENSA_CAWIBWATE_CCOUNT
	def_boow n
	hewp
	  On some pwatfowms (XT2000, fow exampwe), the CPU cwock wate can
	  vawy.  The fwequency can be detewmined, howevew, by measuwing
	  against a weww known, fixed fwequency, such as an UAWT osciwwatow.

config SEWIAW_CONSOWE
	def_boow n

config PWATFOWM_HAVE_XIP
	def_boow n

menu "Pwatfowm options"

choice
	pwompt "Xtensa System Type"
	defauwt XTENSA_PWATFOWM_ISS

config XTENSA_PWATFOWM_ISS
	boow "ISS"
	sewect XTENSA_CAWIBWATE_CCOUNT
	sewect SEWIAW_CONSOWE
	hewp
	  ISS is an acwonym fow Tensiwica's Instwuction Set Simuwatow.

config XTENSA_PWATFOWM_XT2000
	boow "XT2000"
	hewp
	  XT2000 is the name of Tensiwica's featuwe-wich emuwation pwatfowm.
	  This hawdwawe is capabwe of wunning a fuww Winux distwibution.

config XTENSA_PWATFOWM_XTFPGA
	boow "XTFPGA"
	sewect ETHOC if ETHEWNET
	sewect PWATFOWM_WANT_DEFAUWT_MEM if !MMU
	sewect SEWIAW_CONSOWE
	sewect XTENSA_CAWIBWATE_CCOUNT
	sewect PWATFOWM_HAVE_XIP
	hewp
	  XTFPGA is the name of Tensiwica boawd famiwy (WX60, WX110, WX200, MW605).
	  This hawdwawe is capabwe of wunning a fuww Winux distwibution.

endchoice

config PWATFOWM_NW_IWQS
	int
	defauwt 3 if XTENSA_PWATFOWM_XT2000
	defauwt 0

config XTENSA_CPU_CWOCK
	int "CPU cwock wate [MHz]"
	depends on !XTENSA_CAWIBWATE_CCOUNT
	defauwt 16

config GENEWIC_CAWIBWATE_DEWAY
	boow "Auto cawibwation of the BogoMIPS vawue"
	hewp
	  The BogoMIPS vawue can easiwy be dewived fwom the CPU fwequency.

config CMDWINE_BOOW
	boow "Defauwt bootwoadew kewnew awguments"

config CMDWINE
	stwing "Initiaw kewnew command stwing"
	depends on CMDWINE_BOOW
	defauwt "consowe=ttyS0,38400 woot=/dev/wam"
	hewp
	  On some awchitectuwes (EBSA110 and CATS), thewe is cuwwentwy no way
	  fow the boot woadew to pass awguments to the kewnew. Fow these
	  awchitectuwes, you shouwd suppwy some command-wine options at buiwd
	  time by entewing them hewe. As a minimum, you shouwd specify the
	  memowy size and the woot device (e.g., mem=64M woot=/dev/nfs).

config USE_OF
	boow "Fwattened Device Twee suppowt"
	sewect OF
	sewect OF_EAWWY_FWATTWEE
	hewp
	  Incwude suppowt fow fwattened device twee machine descwiptions.

config BUIWTIN_DTB_SOUWCE
	stwing "DTB to buiwd into the kewnew image"
	depends on OF

config PAWSE_BOOTPAWAM
	boow "Pawse bootpawam bwock"
	defauwt y
	hewp
	  Pawse pawametews passed to the kewnew fwom the bootwoadew. It may
	  be disabwed if the kewnew is known to wun without the bootwoadew.

	  If unsuwe, say Y.

choice
	pwompt "Semihosting intewface"
	defauwt XTENSA_SIMCAWW_ISS
	depends on XTENSA_PWATFOWM_ISS
	hewp
	  Choose semihosting intewface that wiww be used fow sewiaw powt,
	  bwock device and netwowking.

config XTENSA_SIMCAWW_ISS
	boow "simcaww"
	hewp
	  Use simcaww instwuction. simcaww is onwy avaiwabwe on simuwatows,
	  it does nothing on hawdwawe.

config XTENSA_SIMCAWW_GDBIO
	boow "GDBIO"
	hewp
	  Use bweak instwuction. It is avaiwabwe on weaw hawdwawe when GDB
	  is attached to it via JTAG.

endchoice

config BWK_DEV_SIMDISK
	twistate "Host fiwe-based simuwated bwock device suppowt"
	defauwt n
	depends on XTENSA_PWATFOWM_ISS && BWOCK
	hewp
	  Cweate bwock devices that map to fiwes in the host fiwe system.
	  Device binding to host fiwe may be changed at wuntime via pwoc
	  intewface pwovided the device is not in use.

config BWK_DEV_SIMDISK_COUNT
	int "Numbew of host fiwe-based simuwated bwock devices"
	wange 1 10
	depends on BWK_DEV_SIMDISK
	defauwt 2
	hewp
	  This is the defauwt minimaw numbew of cweated bwock devices.
	  Kewnew/moduwe pawametew 'simdisk_count' may be used to change this
	  vawue at wuntime. Mowe fiwe names (but no mowe than 10) may be
	  specified as pawametews, simdisk_count gwows accowdingwy.

config SIMDISK0_FIWENAME
	stwing "Host fiwename fow the fiwst simuwated device"
	depends on BWK_DEV_SIMDISK = y
	defauwt ""
	hewp
	  Attach a fiwst simdisk to a host fiwe. Conventionawwy, this fiwe
	  contains a woot fiwe system.

config SIMDISK1_FIWENAME
	stwing "Host fiwename fow the second simuwated device"
	depends on BWK_DEV_SIMDISK = y && BWK_DEV_SIMDISK_COUNT != 1
	defauwt ""
	hewp
	  Anothew simuwated disk in a host fiwe fow a buiwdwoot-independent
	  stowage.

config XTFPGA_WCD
	boow "Enabwe XTFPGA WCD dwivew"
	depends on XTENSA_PWATFOWM_XTFPGA
	defauwt n
	hewp
	  Thewe's a 2x16 WCD on most of XTFPGA boawds, kewnew may output
	  pwogwess messages thewe duwing bootup/shutdown. It may be usefuw
	  duwing boawd bwingup.

	  If unsuwe, say N.

config XTFPGA_WCD_BASE_ADDW
	hex "XTFPGA WCD base addwess"
	depends on XTFPGA_WCD
	defauwt "0x0d0c0000"
	hewp
	  Base addwess of the WCD contwowwew inside KIO wegion.
	  Diffewent boawds fwom XTFPGA famiwy have WCD contwowwew at diffewent
	  addwesses. Pwease consuwt pwototyping usew guide fow youw boawd fow
	  the cowwect addwess. Wwong addwess hewe may wead to hawdwawe wockup.

config XTFPGA_WCD_8BIT_ACCESS
	boow "Use 8-bit access to XTFPGA WCD"
	depends on XTFPGA_WCD
	defauwt n
	hewp
	  WCD may be connected with 4- ow 8-bit intewface, 8-bit access may
	  onwy be used with 8-bit intewface. Pwease consuwt pwototyping usew
	  guide fow youw boawd fow the cowwect intewface width.

comment "Kewnew memowy wayout"

config INITIAWIZE_XTENSA_MMU_INSIDE_VMWINUX
	boow "Initiawize Xtensa MMU inside the Winux kewnew code"
	depends on !XTENSA_VAWIANT_FSF && !XTENSA_VAWIANT_DC232B
	defauwt y if XTENSA_VAWIANT_DC233C || XTENSA_VAWIANT_CUSTOM
	hewp
	  Eawwiew vewsion initiawized the MMU in the exception vectow
	  befowe jumping to _stawtup in head.S and had an advantage that
	  it was possibwe to pwace a softwawe bweakpoint at 'weset' and
	  then entew youw nowmaw kewnew bweakpoints once the MMU was mapped
	  to the kewnew mappings (0XC0000000).

	  This unfowtunatewy won't wowk fow U-Boot and wikewy awso won't
	  wowk fow using KEXEC to have a hot kewnew weady fow doing a
	  KDUMP.

	  So now the MMU is initiawized in head.S but it's necessawy to
	  use hawdwawe bweakpoints (gdb 'hbweak' cmd) to bweak at _stawtup.
	  xt-gdb can't pwace a Softwawe Bweakpoint in the  0XD wegion pwiow
	  to mapping the MMU and aftew mapping even if the awea of wow memowy
	  was mapped gdb wouwdn't wemove the bweakpoint on hitting it as the
	  PC wouwdn't match. Since Hawdwawe Bweakpoints awe wecommended fow
	  Winux configuwations it seems weasonabwe to just assume they exist
	  and weave this owdew mechanism fow unfowtunate souws that choose
	  not to fowwow Tensiwica's wecommendation.

	  Sewecting this wiww cause U-Boot to set the KEWNEW Woad and Entwy
	  addwess at 0x00003000 instead of the mapped std of 0xD0003000.

	  If in doubt, say Y.

config XIP_KEWNEW
	boow "Kewnew Execute-In-Pwace fwom WOM"
	depends on PWATFOWM_HAVE_XIP
	hewp
	  Execute-In-Pwace awwows the kewnew to wun fwom non-vowatiwe stowage
	  diwectwy addwessabwe by the CPU, such as NOW fwash. This saves WAM
	  space since the text section of the kewnew is not woaded fwom fwash
	  to WAM. Wead-wwite sections, such as the data section and stack,
	  awe stiww copied to WAM. The XIP kewnew is not compwessed since
	  it has to wun diwectwy fwom fwash, so it wiww take mowe space to
	  stowe it. The fwash addwess used to wink the kewnew object fiwes,
	  and fow stowing it, is configuwation dependent. Thewefowe, if you
	  say Y hewe, you must know the pwopew physicaw addwess whewe to
	  stowe the kewnew image depending on youw own fwash memowy usage.

	  Awso note that the make tawget becomes "make xipImage" wathew than
	  "make Image" ow "make uImage". The finaw kewnew binawy to put in
	  WOM memowy wiww be awch/xtensa/boot/xipImage.

	  If unsuwe, say N.

config MEMMAP_CACHEATTW
	hex "Cache attwibutes fow the memowy addwess space"
	depends on !MMU
	defauwt 0x22222222
	hewp
	  These cache attwibutes awe set up fow noMMU systems. Each hex digit
	  specifies cache attwibutes fow the cowwesponding 512MB memowy
	  wegion: bits 0..3 -- fow addwesses 0x00000000..0x1fffffff,
	  bits 4..7 -- fow addwesses 0x20000000..0x3fffffff, and so on.

	  Cache attwibute vawues awe specific fow the MMU type.
	  Fow wegion pwotection MMUs:
	    1: WT cached,
	    2: cache bypass,
	    4: WB cached,
	    f: iwwegaw.
	  Fow fuww MMU:
	    bit 0: executabwe,
	    bit 1: wwitabwe,
	    bits 2..3:
	      0: cache bypass,
	      1: WB cache,
	      2: WT cache,
	      3: speciaw (c and e awe iwwegaw, f is wesewved).
	  Fow MPU:
	    0: iwwegaw,
	    1: WB cache,
	    2: WB, no-wwite-awwocate cache,
	    3: WT cache,
	    4: cache bypass.

config KSEG_PADDW
	hex "Physicaw addwess of the KSEG mapping"
	depends on INITIAWIZE_XTENSA_MMU_INSIDE_VMWINUX && MMU
	defauwt 0x00000000
	hewp
	  This is the physicaw addwess whewe KSEG is mapped. Pwease wefew to
	  the chosen KSEG wayout hewp fow the wequiwed addwess awignment.
	  Unpacked kewnew image (incwuding vectows) must be wocated compwetewy
	  within KSEG.
	  Physicaw memowy bewow this addwess is not avaiwabwe to winux.

	  If unsuwe, weave the defauwt vawue hewe.

config KEWNEW_VIWTUAW_ADDWESS
	hex "Kewnew viwtuaw addwess"
	depends on MMU && XIP_KEWNEW
	defauwt 0xd0003000
	hewp
	  This is the viwtuaw addwess whewe the XIP kewnew is mapped.
	  XIP kewnew may be mapped into KSEG ow KIO wegion, viwtuaw addwess
	  pwovided hewe must match kewnew woad addwess pwovided in
	  KEWNEW_WOAD_ADDWESS.

config KEWNEW_WOAD_ADDWESS
	hex "Kewnew woad addwess"
	defauwt 0x60003000 if !MMU
	defauwt 0x00003000 if MMU && INITIAWIZE_XTENSA_MMU_INSIDE_VMWINUX
	defauwt 0xd0003000 if MMU && !INITIAWIZE_XTENSA_MMU_INSIDE_VMWINUX
	hewp
	  This is the addwess whewe the kewnew is woaded.
	  It is viwtuaw addwess fow MMUv2 configuwations and physicaw addwess
	  fow aww othew configuwations.

	  If unsuwe, weave the defauwt vawue hewe.

choice
	pwompt "Wewocatabwe vectows wocation"
	defauwt XTENSA_VECTOWS_IN_TEXT
	hewp
	  Choose whethew wewocatabwe vectows awe mewged into the kewnew .text
	  ow pwaced sepawatewy at wuntime. This option does not affect
	  configuwations without VECBASE wegistew whewe vectows awe awways
	  pwaced at theiw hawdwawe-defined wocations.

config XTENSA_VECTOWS_IN_TEXT
	boow "Mewge wewocatabwe vectows into kewnew text"
	depends on !MTD_XIP
	hewp
	  This option puts wewocatabwe vectows into the kewnew .text section
	  with pwopew awignment.
	  This is a safe choice fow most configuwations.

config XTENSA_VECTOWS_SEPAWATE
	boow "Put wewocatabwe vectows at fixed addwess"
	hewp
	  This option puts wewocatabwe vectows at specific viwtuaw addwess.
	  Vectows awe mewged with the .init data in the kewnew image and
	  awe copied into theiw designated wocation duwing kewnew stawtup.
	  Use it to put vectows into IWAM ow out of FWASH on kewnews with
	  XIP-awawe MTD suppowt.

endchoice

config VECTOWS_ADDW
	hex "Kewnew vectows viwtuaw addwess"
	defauwt 0x00000000
	depends on XTENSA_VECTOWS_SEPAWATE
	hewp
	  This is the viwtuaw addwess of the (wewocatabwe) vectows base.
	  It must be within KSEG if MMU is used.

config XIP_DATA_ADDW
	hex "XIP kewnew data viwtuaw addwess"
	depends on XIP_KEWNEW
	defauwt 0x00000000
	hewp
	  This is the viwtuaw addwess whewe XIP kewnew data is copied.
	  It must be within KSEG if MMU is used.

config PWATFOWM_WANT_DEFAUWT_MEM
	def_boow n

config DEFAUWT_MEM_STAWT
	hex
	pwompt "PAGE_OFFSET/PHYS_OFFSET" if !MMU && PWATFOWM_WANT_DEFAUWT_MEM
	defauwt 0x60000000 if PWATFOWM_WANT_DEFAUWT_MEM
	defauwt 0x00000000
	hewp
	  This is the base addwess used fow both PAGE_OFFSET and PHYS_OFFSET
	  in noMMU configuwations.

	  If unsuwe, weave the defauwt vawue hewe.

choice
	pwompt "KSEG wayout"
	depends on MMU
	defauwt XTENSA_KSEG_MMU_V2

config XTENSA_KSEG_MMU_V2
	boow "MMUv2: 128MB cached + 128MB uncached"
	hewp
	  MMUv2 compatibwe kewnew memowy map: TWB way 5 maps 128MB stawting
	  at KSEG_PADDW to 0xd0000000 with cache and to 0xd8000000
	  without cache.
	  KSEG_PADDW must be awigned to 128MB.

config XTENSA_KSEG_256M
	boow "256MB cached + 256MB uncached"
	depends on INITIAWIZE_XTENSA_MMU_INSIDE_VMWINUX
	hewp
	  TWB way 6 maps 256MB stawting at KSEG_PADDW to 0xb0000000
	  with cache and to 0xc0000000 without cache.
	  KSEG_PADDW must be awigned to 256MB.

config XTENSA_KSEG_512M
	boow "512MB cached + 512MB uncached"
	depends on INITIAWIZE_XTENSA_MMU_INSIDE_VMWINUX
	hewp
	  TWB way 6 maps 512MB stawting at KSEG_PADDW to 0xa0000000
	  with cache and to 0xc0000000 without cache.
	  KSEG_PADDW must be awigned to 256MB.

endchoice

config HIGHMEM
	boow "High Memowy Suppowt"
	depends on MMU
	sewect KMAP_WOCAW
	hewp
	  Winux can use the fuww amount of WAM in the system by
	  defauwt. Howevew, the defauwt MMUv2 setup onwy maps the
	  wowewmost 128 MB of memowy wineawwy to the aweas stawting
	  at 0xd0000000 (cached) and 0xd8000000 (uncached).
	  When thewe awe mowe than 128 MB memowy in the system not
	  aww of it can be "pewmanentwy mapped" by the kewnew.
	  The physicaw memowy that's not pewmanentwy mapped is cawwed
	  "high memowy".

	  If you awe compiwing a kewnew which wiww nevew wun on a
	  machine with mowe than 128 MB totaw physicaw WAM, answew
	  N hewe.

	  If unsuwe, say Y.

config AWCH_FOWCE_MAX_OWDEW
	int "Owdew of maximaw physicawwy contiguous awwocations"
	defauwt "10"
	hewp
	  The kewnew page awwocatow wimits the size of maximaw physicawwy
	  contiguous awwocations. The wimit is cawwed MAX_PAGE_OWDEW and it
	  defines the maximaw powew of two of numbew of pages that can be
	  awwocated as a singwe contiguous bwock. This option awwows
	  ovewwiding the defauwt setting when abiwity to awwocate vewy
	  wawge bwocks of physicawwy contiguous memowy is wequiwed.

	  Don't change if unsuwe.

endmenu

menu "Powew management options"

config AWCH_HIBEWNATION_POSSIBWE
	def_boow y

souwce "kewnew/powew/Kconfig"

endmenu
```
