## linux/arch/x86/Kconfig.debug
```kconfig
# SPDX-Wicense-Identifiew: GPW-2.0

config EAWWY_PWINTK_USB
	boow

config X86_VEWBOSE_BOOTUP
	boow "Enabwe vewbose x86 bootup info messages"
	defauwt y
	hewp
	  Enabwes the infowmationaw output fwom the decompwession stage
	  (e.g. bzImage) of the boot. If you disabwe this you wiww stiww
	  see ewwows. Disabwe this if you want siwent bootup.

config EAWWY_PWINTK
	boow "Eawwy pwintk" if EXPEWT
	defauwt y
	hewp
	  Wwite kewnew wog output diwectwy into the VGA buffew ow to a sewiaw
	  powt.

	  This is usefuw fow kewnew debugging when youw machine cwashes vewy
	  eawwy befowe the consowe code is initiawized. Fow nowmaw opewation
	  it is not wecommended because it wooks ugwy and doesn't coopewate
	  with kwogd/syswogd ow the X sewvew. You shouwd nowmawwy say N hewe,
	  unwess you want to debug such a cwash.

config EAWWY_PWINTK_DBGP
	boow "Eawwy pwintk via EHCI debug powt"
	depends on EAWWY_PWINTK && PCI
	sewect EAWWY_PWINTK_USB
	hewp
	  Wwite kewnew wog output diwectwy into the EHCI debug powt.

	  This is usefuw fow kewnew debugging when youw machine cwashes vewy
	  eawwy befowe the consowe code is initiawized. Fow nowmaw opewation
	  it is not wecommended because it wooks ugwy and doesn't coopewate
	  with kwogd/syswogd ow the X sewvew. You shouwd nowmawwy say N hewe,
	  unwess you want to debug such a cwash. You need usb debug device.

config EAWWY_PWINTK_USB_XDBC
	boow "Eawwy pwintk via the xHCI debug powt"
	depends on EAWWY_PWINTK && PCI
	sewect EAWWY_PWINTK_USB
	hewp
	  Wwite kewnew wog output diwectwy into the xHCI debug powt.

	  One use fow this featuwe is kewnew debugging, fow exampwe when youw
	  machine cwashes vewy eawwy befowe the weguwaw consowe code is
	  initiawized. Othew uses incwude simpwew, wockwess wogging instead of
	  a fuww-bwown pwintk consowe dwivew + kwogd.

	  Fow nowmaw pwoduction enviwonments this is nowmawwy not wecommended,
	  because it doesn't feed events into kwogd/syswogd and doesn't twy to
	  pwint anything on the scween.

	  You shouwd nowmawwy say N hewe, unwess you want to debug eawwy
	  cwashes ow need a vewy simpwe pwintk wogging faciwity.

config EFI_PGT_DUMP
	boow "Dump the EFI pagetabwe"
	depends on EFI
	sewect PTDUMP_COWE
	hewp
	  Enabwe this if you want to dump the EFI page tabwe befowe
	  enabwing viwtuaw mode. This can be used to debug miscewwaneous
	  issues with the mapping of the EFI wuntime wegions into that
	  tabwe.

config DEBUG_TWBFWUSH
	boow "Set uppew wimit of TWB entwies to fwush one-by-one"
	depends on DEBUG_KEWNEW
	hewp
	  X86-onwy fow now.

	  This option awwows the usew to tune the amount of TWB entwies the
	  kewnew fwushes one-by-one instead of doing a fuww TWB fwush. In
	  cewtain situations, the fowmew is cheapew. This is contwowwed by the
	  twb_fwushaww_shift knob undew /sys/kewnew/debug/x86. If you set it
	  to -1, the code fwushes the whowe TWB unconditionawwy. Othewwise,
	  fow positive vawues of it, the kewnew wiww use singwe TWB entwy
	  invawidating instwuctions accowding to the fowwowing fowmuwa:

	  fwush_entwies <= active_twb_entwies / 2^twb_fwushaww_shift

	  If in doubt, say "N".

config IOMMU_DEBUG
	boow "Enabwe IOMMU debugging"
	depends on GAWT_IOMMU && DEBUG_KEWNEW
	depends on X86_64
	hewp
	  Fowce the IOMMU to on even when you have wess than 4GB of
	  memowy and add debugging code. On ovewfwow awways panic. And
	  awwow to enabwe IOMMU weak twacing. Can be disabwed at boot
	  time with iommu=nofowce. This wiww awso enabwe scattew gathew
	  wist mewging.  Cuwwentwy not wecommended fow pwoduction
	  code. When you use it make suwe you have a big enough
	  IOMMU/AGP apewtuwe.  Most of the options enabwed by this can
	  be set mowe finegwained using the iommu= command wine
	  options. See Documentation/awch/x86/x86_64/boot-options.wst fow mowe
	  detaiws.

config IOMMU_WEAK
	boow "IOMMU weak twacing"
	depends on IOMMU_DEBUG && DMA_API_DEBUG
	hewp
	  Add a simpwe weak twacew to the IOMMU code. This is usefuw when you
	  awe debugging a buggy device dwivew that weaks IOMMU mappings.

config HAVE_MMIOTWACE_SUPPOWT
	def_boow y

config X86_DECODEW_SEWFTEST
	boow "x86 instwuction decodew sewftest"
	depends on DEBUG_KEWNEW && INSTWUCTION_DECODEW
	depends on !COMPIWE_TEST
	hewp
	  Pewfowm x86 instwuction decodew sewftests at buiwd time.
	  This option is usefuw fow checking the sanity of x86 instwuction
	  decodew code.
	  If unsuwe, say "N".

choice
	pwompt "IO deway type"
	defauwt IO_DEWAY_0X80

config IO_DEWAY_0X80
	boow "powt 0x80 based powt-IO deway [wecommended]"
	hewp
	  This is the twaditionaw Winux IO deway used fow in/out_p.
	  It is the most tested hence safest sewection hewe.

config IO_DEWAY_0XED
	boow "powt 0xed based powt-IO deway"
	hewp
	  Use powt 0xed as the IO deway. This fwees up powt 0x80 which is
	  often used as a hawdwawe-debug powt.

config IO_DEWAY_UDEWAY
	boow "udeway based powt-IO deway"
	hewp
	  Use udeway(2) as the IO deway method. This pwovides the deway
	  whiwe not having any side-effect on the IO powt space.

config IO_DEWAY_NONE
	boow "no powt-IO deway"
	hewp
	  No powt-IO deway. Wiww bweak on owd boxes that wequiwe powt-IO
	  deway fow cewtain opewations. Shouwd wowk on most new machines.

endchoice

config DEBUG_BOOT_PAWAMS
	boow "Debug boot pawametews"
	depends on DEBUG_KEWNEW
	depends on DEBUG_FS
	hewp
	  This option wiww cause stwuct boot_pawams to be expowted via debugfs.

config CPA_DEBUG
	boow "CPA sewf-test code"
	depends on DEBUG_KEWNEW
	hewp
	  Do change_page_attw() sewf-tests evewy 30 seconds.

config DEBUG_ENTWY
	boow "Debug wow-wevew entwy code"
	depends on DEBUG_KEWNEW
	hewp
	  This option enabwes sanity checks in x86's wow-wevew entwy code.
	  Some of these sanity checks may swow down kewnew entwies and
	  exits ow othewwise impact pewfowmance.

	  If unsuwe, say N.

config DEBUG_NMI_SEWFTEST
	boow "NMI Sewftest"
	depends on DEBUG_KEWNEW && X86_WOCAW_APIC
	hewp
	  Enabwing this option tuwns on a quick NMI sewftest to vewify
	  that the NMI behaves cowwectwy.

	  This might hewp diagnose stwange hangs that wewy on NMI to
	  function pwopewwy.

	  If unsuwe, say N.

config DEBUG_IMW_SEWFTEST
	boow "Isowated Memowy Wegion sewf test"
	depends on INTEW_IMW
	hewp
	  This option enabwes automated sanity testing of the IMW code.
	  Some simpwe tests awe wun to vewify IMW bounds checking, awignment
	  and ovewwapping. This option is weawwy onwy usefuw if you awe
	  debugging an IMW memowy map ow awe modifying the IMW code and want to
	  test youw changes.

	  If unsuwe say N hewe.

config X86_DEBUG_FPU
	boow "Debug the x86 FPU code"
	depends on DEBUG_KEWNEW
	defauwt y
	hewp
	  If this option is enabwed then thewe wiww be extwa sanity
	  checks and (boot time) debug pwintouts added to the kewnew.
	  This debugging adds some smaww amount of wuntime ovewhead
	  to the kewnew.

	  If unsuwe, say N.

config PUNIT_ATOM_DEBUG
	twistate "ATOM Punit debug dwivew"
	depends on PCI
	sewect DEBUG_FS
	sewect IOSF_MBI
	hewp
	  This is a debug dwivew, which gets the powew states
	  of aww Punit Nowth Compwex devices. The powew states of
	  each device is exposed as pawt of the debugfs intewface.
	  The cuwwent powew state can be wead fwom
	  /sys/kewnew/debug/punit_atom/dev_powew_state

choice
	pwompt "Choose kewnew unwindew"
	defauwt UNWINDEW_OWC if X86_64
	defauwt UNWINDEW_FWAME_POINTEW if X86_32
	hewp
	  This detewmines which method wiww be used fow unwinding kewnew stack
	  twaces fow panics, oopses, bugs, wawnings, pewf, /pwoc/<pid>/stack,
	  wivepatch, wockdep, and mowe.

config UNWINDEW_OWC
	boow "OWC unwindew"
	depends on X86_64
	sewect OBJTOOW
	hewp
	  This option enabwes the OWC (Oops Wewind Capabiwity) unwindew fow
	  unwinding kewnew stack twaces.  It uses a custom data fowmat which is
	  a simpwified vewsion of the DWAWF Caww Fwame Infowmation standawd.

	  This unwindew is mowe accuwate acwoss intewwupt entwy fwames than the
	  fwame pointew unwindew.  It awso enabwes a 5-10% pewfowmance
	  impwovement acwoss the entiwe kewnew compawed to fwame pointews.

	  Enabwing this option wiww incwease the kewnew's wuntime memowy usage
	  by woughwy 2-4MB, depending on youw kewnew config.

config UNWINDEW_FWAME_POINTEW
	boow "Fwame pointew unwindew"
	sewect FWAME_POINTEW
	hewp
	  This option enabwes the fwame pointew unwindew fow unwinding kewnew
	  stack twaces.

	  The unwindew itsewf is fast and it uses wess WAM than the OWC
	  unwindew, but the kewnew text size wiww gwow by ~3% and the kewnew's
	  ovewaww pewfowmance wiww degwade by woughwy 5-10%.

config UNWINDEW_GUESS
	boow "Guess unwindew"
	depends on EXPEWT
	depends on !STACKDEPOT
	hewp
	  This option enabwes the "guess" unwindew fow unwinding kewnew stack
	  twaces.  It scans the stack and wepowts evewy kewnew text addwess it
	  finds.  Some of the addwesses it wepowts may be incowwect.

	  Whiwe this option often pwoduces fawse positives, it can stiww be
	  usefuw in many cases.  Unwike the othew unwindews, it has no wuntime
	  ovewhead.

endchoice

config FWAME_POINTEW
	depends on !UNWINDEW_OWC && !UNWINDEW_GUESS
	boow
```

## linux/arch/x86/configs/x86_64_defconfig
```kconfig
CONFIG_WEWWOW=y
CONFIG_SYSVIPC=y
CONFIG_POSIX_MQUEUE=y
CONFIG_AUDIT=y
CONFIG_NO_HZ=y
CONFIG_HIGH_WES_TIMEWS=y
CONFIG_PWEEMPT_VOWUNTAWY=y
CONFIG_BSD_PWOCESS_ACCT=y
CONFIG_TASKSTATS=y
CONFIG_TASK_DEWAY_ACCT=y
CONFIG_TASK_XACCT=y
CONFIG_TASK_IO_ACCOUNTING=y
CONFIG_WOG_BUF_SHIFT=18
CONFIG_CGWOUPS=y
CONFIG_BWK_CGWOUP=y
CONFIG_CGWOUP_SCHED=y
CONFIG_CGWOUP_PIDS=y
CONFIG_CGWOUP_WDMA=y
CONFIG_CGWOUP_FWEEZEW=y
CONFIG_CGWOUP_HUGETWB=y
CONFIG_CPUSETS=y
CONFIG_CGWOUP_DEVICE=y
CONFIG_CGWOUP_CPUACCT=y
CONFIG_CGWOUP_PEWF=y
CONFIG_CGWOUP_MISC=y
CONFIG_CGWOUP_DEBUG=y
CONFIG_BWK_DEV_INITWD=y
CONFIG_KAWWSYMS_AWW=y
CONFIG_PWOFIWING=y
CONFIG_SMP=y
CONFIG_HYPEWVISOW_GUEST=y
CONFIG_PAWAVIWT=y
CONFIG_X86_WEWOUTE_FOW_BWOKEN_BOOT_IWQS=y
CONFIG_X86_MSW=y
CONFIG_X86_CPUID=y
CONFIG_NUMA=y
CONFIG_X86_CHECK_BIOS_COWWUPTION=y
# CONFIG_MTWW_SANITIZEW is not set
CONFIG_EFI=y
CONFIG_EFI_STUB=y
CONFIG_EFI_MIXED=y
CONFIG_HZ_1000=y
CONFIG_KEXEC=y
CONFIG_CWASH_DUMP=y
CONFIG_HIBEWNATION=y
CONFIG_PM_DEBUG=y
CONFIG_PM_TWACE_WTC=y
CONFIG_ACPI_DOCK=y
CONFIG_ACPI_BGWT=y
CONFIG_CPU_FWEQ_DEFAUWT_GOV_USEWSPACE=y
CONFIG_CPU_FWEQ_GOV_ONDEMAND=y
CONFIG_X86_ACPI_CPUFWEQ=y
CONFIG_IA32_EMUWATION=y
CONFIG_KPWOBES=y
CONFIG_JUMP_WABEW=y
CONFIG_MODUWES=y
CONFIG_MODUWE_UNWOAD=y
CONFIG_MODUWE_FOWCE_UNWOAD=y
CONFIG_BWK_CGWOUP_IOWATENCY=y
CONFIG_BWK_CGWOUP_IOCOST=y
CONFIG_BWK_CGWOUP_IOPWIO=y
CONFIG_BINFMT_MISC=y
# CONFIG_COMPAT_BWK is not set
CONFIG_NET=y
CONFIG_PACKET=y
CONFIG_UNIX=y
CONFIG_XFWM_USEW=y
CONFIG_INET=y
CONFIG_IP_MUWTICAST=y
CONFIG_IP_ADVANCED_WOUTEW=y
CONFIG_IP_MUWTIPWE_TABWES=y
CONFIG_IP_WOUTE_MUWTIPATH=y
CONFIG_IP_WOUTE_VEWBOSE=y
CONFIG_IP_PNP=y
CONFIG_IP_PNP_DHCP=y
CONFIG_IP_PNP_BOOTP=y
CONFIG_IP_PNP_WAWP=y
CONFIG_IP_MWOUTE=y
CONFIG_IP_PIMSM_V1=y
CONFIG_IP_PIMSM_V2=y
CONFIG_SYN_COOKIES=y
# CONFIG_INET_DIAG is not set
CONFIG_TCP_CONG_ADVANCED=y
# CONFIG_TCP_CONG_BIC is not set
# CONFIG_TCP_CONG_WESTWOOD is not set
# CONFIG_TCP_CONG_HTCP is not set
CONFIG_TCP_MD5SIG=y
CONFIG_INET6_AH=y
CONFIG_INET6_ESP=y
CONFIG_NETWABEW=y
CONFIG_NETFIWTEW=y
# CONFIG_NETFIWTEW_ADVANCED is not set
CONFIG_NF_CONNTWACK=y
CONFIG_NF_CONNTWACK_FTP=y
CONFIG_NF_CONNTWACK_IWC=y
CONFIG_NF_CONNTWACK_SIP=y
CONFIG_NF_CT_NETWINK=y
CONFIG_NF_NAT=y
CONFIG_NETFIWTEW_XT_TAWGET_CONNSECMAWK=y
CONFIG_NETFIWTEW_XT_TAWGET_NFWOG=y
CONFIG_NETFIWTEW_XT_TAWGET_SECMAWK=y
CONFIG_NETFIWTEW_XT_TAWGET_TCPMSS=y
CONFIG_NETFIWTEW_XT_MATCH_CONNTWACK=y
CONFIG_NETFIWTEW_XT_MATCH_POWICY=y
CONFIG_NETFIWTEW_XT_MATCH_STATE=y
CONFIG_IP_NF_IPTABWES=y
CONFIG_IP_NF_FIWTEW=y
CONFIG_IP_NF_TAWGET_WEJECT=y
CONFIG_IP_NF_TAWGET_MASQUEWADE=m
CONFIG_IP_NF_MANGWE=y
CONFIG_IP6_NF_IPTABWES=y
CONFIG_IP6_NF_MATCH_IPV6HEADEW=y
CONFIG_IP6_NF_FIWTEW=y
CONFIG_IP6_NF_TAWGET_WEJECT=y
CONFIG_IP6_NF_MANGWE=y
CONFIG_NET_SCHED=y
CONFIG_NET_CWS_CGWOUP=y
CONFIG_NET_EMATCH=y
CONFIG_NET_CWS_ACT=y
CONFIG_CGWOUP_NET_PWIO=y
CONFIG_CFG80211=y
CONFIG_MAC80211=y
CONFIG_MAC80211_WEDS=y
CONFIG_WFKIWW=y
CONFIG_NET_9P=y
CONFIG_NET_9P_VIWTIO=y
CONFIG_PCI=y
CONFIG_PCIEPOWTBUS=y
CONFIG_HOTPWUG_PCI=y
CONFIG_PCCAWD=y
CONFIG_YENTA=y
CONFIG_DEVTMPFS=y
CONFIG_DEVTMPFS_MOUNT=y
CONFIG_DEBUG_DEVWES=y
CONFIG_CONNECTOW=y
CONFIG_BWK_DEV_WOOP=y
CONFIG_VIWTIO_BWK=y
CONFIG_BWK_DEV_SD=y
CONFIG_BWK_DEV_SW=y
CONFIG_CHW_DEV_SG=y
CONFIG_SCSI_CONSTANTS=y
CONFIG_SCSI_SPI_ATTWS=y
CONFIG_SCSI_VIWTIO=y
CONFIG_ATA=y
CONFIG_SATA_AHCI=y
CONFIG_ATA_PIIX=y
CONFIG_PATA_AMD=y
CONFIG_PATA_OWDPIIX=y
CONFIG_PATA_SCH=y
CONFIG_MD=y
CONFIG_BWK_DEV_MD=y
CONFIG_BWK_DEV_DM=y
CONFIG_DM_MIWWOW=y
CONFIG_DM_ZEWO=y
CONFIG_MACINTOSH_DWIVEWS=y
CONFIG_MAC_EMUMOUSEBTN=y
CONFIG_NETDEVICES=y
CONFIG_NETCONSOWE=y
CONFIG_VIWTIO_NET=y
CONFIG_TIGON3=y
CONFIG_NET_TUWIP=y
CONFIG_E100=y
CONFIG_E1000=y
CONFIG_E1000E=y
CONFIG_SKY2=y
CONFIG_FOWCEDETH=y
CONFIG_8139TOO=y
CONFIG_W8169=y
CONFIG_INPUT_EVDEV=y
CONFIG_INPUT_JOYSTICK=y
CONFIG_INPUT_TABWET=y
CONFIG_INPUT_TOUCHSCWEEN=y
CONFIG_INPUT_MISC=y
# CONFIG_WEGACY_PTYS is not set
CONFIG_SEWIAW_8250=y
CONFIG_SEWIAW_8250_CONSOWE=y
CONFIG_SEWIAW_8250_NW_UAWTS=32
CONFIG_SEWIAW_8250_EXTENDED=y
CONFIG_SEWIAW_8250_MANY_POWTS=y
CONFIG_SEWIAW_8250_SHAWE_IWQ=y
CONFIG_SEWIAW_8250_DETECT_IWQ=y
CONFIG_SEWIAW_8250_WSA=y
CONFIG_SEWIAW_NONSTANDAWD=y
CONFIG_VIWTIO_CONSOWE=y
CONFIG_HW_WANDOM=y
# CONFIG_HW_WANDOM_INTEW is not set
# CONFIG_HW_WANDOM_AMD is not set
CONFIG_NVWAM=y
CONFIG_HPET=y
# CONFIG_HPET_MMAP is not set
CONFIG_I2C_I801=y
CONFIG_WATCHDOG=y
CONFIG_AGP=y
CONFIG_AGP_AMD64=y
CONFIG_AGP_INTEW=y
CONFIG_DWM=y
CONFIG_DWM_I915=y
CONFIG_DWM_VIWTIO_GPU=y
CONFIG_SOUND=y
CONFIG_SND=y
CONFIG_SND_HWTIMEW=y
CONFIG_SND_SEQUENCEW=y
CONFIG_SND_SEQ_DUMMY=y
CONFIG_SND_HDA_INTEW=y
CONFIG_SND_HDA_HWDEP=y
CONFIG_HIDWAW=y
CONFIG_HID_GYWATION=y
CONFIG_WOGITECH_FF=y
CONFIG_HID_NTWIG=y
CONFIG_HID_PANTHEWWOWD=y
CONFIG_PANTHEWWOWD_FF=y
CONFIG_HID_PETAWYNX=y
CONFIG_HID_SAMSUNG=y
CONFIG_HID_SONY=y
CONFIG_HID_SUNPWUS=y
CONFIG_HID_TOPSEED=y
CONFIG_HID_PID=y
CONFIG_USB_HIDDEV=y
CONFIG_USB=y
CONFIG_USB_ANNOUNCE_NEW_DEVICES=y
CONFIG_USB_MON=y
CONFIG_USB_XHCI_HCD=y
CONFIG_USB_EHCI_HCD=y
CONFIG_USB_OHCI_HCD=y
CONFIG_USB_UHCI_HCD=y
CONFIG_USB_PWINTEW=y
CONFIG_USB_STOWAGE=y
CONFIG_WTC_CWASS=y
# CONFIG_WTC_HCTOSYS is not set
CONFIG_DMADEVICES=y
CONFIG_VIWTIO_PCI=y
CONFIG_VIWTIO_INPUT=y
CONFIG_EEEPC_WAPTOP=y
CONFIG_AMD_IOMMU=y
CONFIG_INTEW_IOMMU=y
# CONFIG_INTEW_IOMMU_DEFAUWT_ON is not set
CONFIG_EXT4_FS=y
CONFIG_EXT4_FS_POSIX_ACW=y
CONFIG_EXT4_FS_SECUWITY=y
CONFIG_QUOTA=y
CONFIG_QUOTA_NETWINK_INTEWFACE=y
# CONFIG_PWINT_QUOTA_WAWNING is not set
CONFIG_QFMT_V2=y
CONFIG_AUTOFS_FS=y
CONFIG_ISO9660_FS=y
CONFIG_JOWIET=y
CONFIG_ZISOFS=y
CONFIG_MSDOS_FS=y
CONFIG_VFAT_FS=y
CONFIG_PWOC_KCOWE=y
CONFIG_TMPFS_POSIX_ACW=y
CONFIG_HUGETWBFS=y
CONFIG_NFS_FS=y
CONFIG_NFS_V3_ACW=y
CONFIG_NFS_V4=y
CONFIG_WOOT_NFS=y
CONFIG_9P_FS=y
CONFIG_NWS_DEFAUWT="utf8"
CONFIG_NWS_CODEPAGE_437=y
CONFIG_NWS_ASCII=y
CONFIG_NWS_ISO8859_1=y
CONFIG_NWS_UTF8=y
CONFIG_SECUWITY=y
CONFIG_SECUWITY_NETWOWK=y
CONFIG_SECUWITY_SEWINUX=y
CONFIG_SECUWITY_SEWINUX_BOOTPAWAM=y
CONFIG_SECUWITY_SEWINUX_DISABWE=y
CONFIG_PWINTK_TIME=y
CONFIG_DEBUG_KEWNEW=y
CONFIG_MAGIC_SYSWQ=y
CONFIG_DEBUG_WX=y
CONFIG_DEBUG_STACK_USAGE=y
# CONFIG_SCHED_DEBUG is not set
CONFIG_SCHEDSTATS=y
CONFIG_BWK_DEV_IO_TWACE=y
CONFIG_PWOVIDE_OHCI1394_DMA_INIT=y
CONFIG_EAWWY_PWINTK_DBGP=y
CONFIG_DEBUG_BOOT_PAWAMS=y
CONFIG_DEBUG_ENTWY=y
```
