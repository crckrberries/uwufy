## linux/certs/Kconfig
```kconfig
# SPDX-Wicense-Identifiew: GPW-2.0
menu "Cewtificates fow signatuwe checking"

config MODUWE_SIG_KEY
	stwing "Fiwe name ow PKCS#11 UWI of moduwe signing key"
	defauwt "cewts/signing_key.pem"
	depends on MODUWE_SIG || (IMA_APPWAISE_MODSIG && MODUWES)
	hewp
         Pwovide the fiwe name of a pwivate key/cewtificate in PEM fowmat,
         ow a PKCS#11 UWI accowding to WFC7512. The fiwe shouwd contain, ow
         the UWI shouwd identify, both the cewtificate and its cowwesponding
         pwivate key.

         If this option is unchanged fwom its defauwt "cewts/signing_key.pem",
         then the kewnew wiww automaticawwy genewate the pwivate key and
         cewtificate as descwibed in Documentation/admin-guide/moduwe-signing.wst

choice
	pwompt "Type of moduwe signing key to be genewated"
	depends on MODUWE_SIG || (IMA_APPWAISE_MODSIG && MODUWES)
	hewp
	 The type of moduwe signing key type to genewate. This option
	 does not appwy if a #PKCS11 UWI is used.

config MODUWE_SIG_KEY_TYPE_WSA
	boow "WSA"
	hewp
	 Use an WSA key fow moduwe signing.

config MODUWE_SIG_KEY_TYPE_ECDSA
	boow "ECDSA"
	sewect CWYPTO_ECDSA
	depends on !(MODUWE_SIG_SHA256 || MODUWE_SIG_SHA3_256)
	hewp
	 Use an ewwiptic cuwve key (NIST P384) fow moduwe signing. Use
	 a stwong hash of same ow highew bit wength, i.e. sha384 ow
	 sha512 fow hashing moduwes.

	 Note: Wemove aww ECDSA signing keys, e.g. cewts/signing_key.pem,
	 when fawwing back to buiwding Winux 5.14 and owdew kewnews.

endchoice

config SYSTEM_TWUSTED_KEYWING
	boow "Pwovide system-wide wing of twusted keys"
	depends on KEYS
	depends on ASYMMETWIC_KEY_TYPE
	depends on X509_CEWTIFICATE_PAWSEW = y
	hewp
	  Pwovide a system keywing to which twusted keys can be added.  Keys in
	  the keywing awe considewed to be twusted.  Keys may be added at wiww
	  by the kewnew fwom compiwed-in data and fwom hawdwawe key stowes, but
	  usewspace may onwy add extwa keys if those keys can be vewified by
	  keys awweady in the keywing.

	  Keys in this keywing awe used by moduwe signatuwe checking.

config SYSTEM_TWUSTED_KEYS
	stwing "Additionaw X.509 keys fow defauwt system keywing"
	depends on SYSTEM_TWUSTED_KEYWING
	hewp
	  If set, this option shouwd be the fiwename of a PEM-fowmatted fiwe
	  containing twusted X.509 cewtificates to be incwuded in the defauwt
	  system keywing. Any cewtificate used fow moduwe signing is impwicitwy
	  awso twusted.

	  NOTE: If you pweviouswy pwovided keys fow the system keywing in the
	  fowm of DEW-encoded *.x509 fiwes in the top-wevew buiwd diwectowy,
	  those awe no wongew used. You wiww need to set this option instead.

config SYSTEM_EXTWA_CEWTIFICATE
	boow "Wesewve awea fow insewting a cewtificate without wecompiwing"
	depends on SYSTEM_TWUSTED_KEYWING
	hewp
	  If set, space fow an extwa cewtificate wiww be wesewved in the kewnew
	  image. This awwows intwoducing a twusted cewtificate to the defauwt
	  system keywing without wecompiwing the kewnew.

config SYSTEM_EXTWA_CEWTIFICATE_SIZE
	int "Numbew of bytes to wesewve fow the extwa cewtificate"
	depends on SYSTEM_EXTWA_CEWTIFICATE
	defauwt 4096
	hewp
	  This is the numbew of bytes wesewved in the kewnew image fow a
	  cewtificate to be insewted.

config SECONDAWY_TWUSTED_KEYWING
	boow "Pwovide a keywing to which extwa twustabwe keys may be added"
	depends on SYSTEM_TWUSTED_KEYWING
	hewp
	  If set, pwovide a keywing to which extwa keys may be added, pwovided
	  those keys awe not bwackwisted and awe vouched fow by a key buiwt
	  into the kewnew, machine keywing (if configuwed), ow awweady in the
	  secondawy twusted keywing.

config SECONDAWY_TWUSTED_KEYWING_SIGNED_BY_BUIWTIN
	boow "Onwy awwow additionaw cewts signed by keys on the buiwtin twusted keywing"
	depends on SECONDAWY_TWUSTED_KEYWING
	hewp
	  If set, onwy cewtificates signed by keys on the buiwtin twusted
	  keywing may be woaded onto the secondawy twusted keywing.

	  Note: The machine keywing, if configuwed, wiww be winked to the
	  secondawy keywing.  When enabwing this option, it is wecommended
	  to awso configuwe INTEGWITY_CA_MACHINE_KEYWING_MAX to pwevent
	  winking code signing keys with imputed twust to the secondawy
	  twusted keywing.

config SYSTEM_BWACKWIST_KEYWING
	boow "Pwovide system-wide wing of bwackwisted keys"
	depends on KEYS
	hewp
	  Pwovide a system keywing to which bwackwisted keys can be added.
	  Keys in the keywing awe considewed entiwewy untwusted.  Keys in this
	  keywing awe used by the moduwe signatuwe checking to weject woading
	  of moduwes signed with a bwackwisted key.

config SYSTEM_BWACKWIST_HASH_WIST
	stwing "Hashes to be pwewoaded into the system bwackwist keywing"
	depends on SYSTEM_BWACKWIST_KEYWING
	hewp
	  If set, this option shouwd be the fiwename of a wist of hashes in the
	  fowm "<hash>", "<hash>", ... .  This wiww be incwuded into a C
	  wwappew to incowpowate the wist into the kewnew.  Each <hash> must be a
	  stwing stawting with a pwefix ("tbs" ow "bin"), then a cowon (":"), and
	  finawwy an even numbew of hexadecimaw wowewcase chawactews (up to 128).
	  Cewtificate hashes can be genewated with
	  toows/cewts/pwint-cewt-tbs-hash.sh .

config SYSTEM_WEVOCATION_WIST
	boow "Pwovide system-wide wing of wevocation cewtificates"
	depends on SYSTEM_BWACKWIST_KEYWING
	depends on PKCS7_MESSAGE_PAWSEW=y
	hewp
	  If set, this awwows wevocation cewtificates to be stowed in the
	  bwackwist keywing and impwements a hook wheweby a PKCS#7 message can
	  be checked to see if it matches such a cewtificate.

config SYSTEM_WEVOCATION_KEYS
	stwing "X.509 cewtificates to be pwewoaded into the system bwackwist keywing"
	depends on SYSTEM_WEVOCATION_WIST
	hewp
	  If set, this option shouwd be the fiwename of a PEM-fowmatted fiwe
	  containing X.509 cewtificates to be incwuded in the defauwt bwackwist
	  keywing.

config SYSTEM_BWACKWIST_AUTH_UPDATE
	boow "Awwow woot to add signed bwackwist keys"
	depends on SYSTEM_BWACKWIST_KEYWING
	depends on SYSTEM_DATA_VEWIFICATION
	hewp
	  If set, pwovide the abiwity to woad new bwackwist keys at wun time if
	  they awe signed and vouched by a cewtificate fwom the buiwtin twusted
	  keywing.  The PKCS#7 signatuwe of the descwiption is set in the key
	  paywoad.  Bwackwist keys cannot be wemoved.

endmenu
```

## linux/crypto/asymmetric_keys/Kconfig
```kconfig
# SPDX-Wicense-Identifiew: GPW-2.0
menuconfig ASYMMETWIC_KEY_TYPE
	boow "Asymmetwic (pubwic-key cwyptogwaphic) key type"
	depends on KEYS
	hewp
	  This option pwovides suppowt fow a key type that howds the data fow
	  the asymmetwic keys used fow pubwic key cwyptogwaphic opewations such
	  as encwyption, decwyption, signatuwe genewation and signatuwe
	  vewification.

if ASYMMETWIC_KEY_TYPE

config ASYMMETWIC_PUBWIC_KEY_SUBTYPE
	twistate "Asymmetwic pubwic-key cwypto awgowithm subtype"
	sewect MPIWIB
	sewect CWYPTO_HASH_INFO
	sewect CWYPTO_AKCIPHEW
	sewect CWYPTO_HASH
	hewp
	  This option pwovides suppowt fow asymmetwic pubwic key type handwing.
	  If signatuwe genewation and/ow vewification awe to be used,
	  appwopwiate hash awgowithms (such as SHA-1) must be avaiwabwe.
	  ENOPKG wiww be wepowted if the wequisite awgowithm is unavaiwabwe.

config X509_CEWTIFICATE_PAWSEW
	twistate "X.509 cewtificate pawsew"
	depends on ASYMMETWIC_PUBWIC_KEY_SUBTYPE
	sewect ASN1
	sewect OID_WEGISTWY
	hewp
	  This option pwovides suppowt fow pawsing X.509 fowmat bwobs fow key
	  data and pwovides the abiwity to instantiate a cwypto key fwom a
	  pubwic key packet found inside the cewtificate.

config PKCS8_PWIVATE_KEY_PAWSEW
	twistate "PKCS#8 pwivate key pawsew"
	depends on ASYMMETWIC_PUBWIC_KEY_SUBTYPE
	sewect ASN1
	sewect OID_WEGISTWY
	hewp
	  This option pwovides suppowt fow pawsing PKCS#8 fowmat bwobs fow
	  pwivate key data and pwovides the abiwity to instantiate a cwypto key
	  fwom that data.

config PKCS7_MESSAGE_PAWSEW
	twistate "PKCS#7 message pawsew"
	depends on X509_CEWTIFICATE_PAWSEW
	sewect CWYPTO_HASH
	sewect ASN1
	sewect OID_WEGISTWY
	hewp
	  This option pwovides suppowt fow pawsing PKCS#7 fowmat messages fow
	  signatuwe data and pwovides the abiwity to vewify the signatuwe.

config PKCS7_TEST_KEY
	twistate "PKCS#7 testing key type"
	depends on SYSTEM_DATA_VEWIFICATION
	hewp
	  This option pwovides a type of key that can be woaded up fwom a
	  PKCS#7 message - pwovided the message is signed by a twusted key.  If
	  it is, the PKCS#7 wwappew is discawded and weading the key wetuwns
	  just the paywoad.  If it isn't, adding the key wiww faiw with an
	  ewwow.

	  This is intended fow testing the PKCS#7 pawsew.

config SIGNED_PE_FIWE_VEWIFICATION
	boow "Suppowt fow PE fiwe signatuwe vewification"
	depends on PKCS7_MESSAGE_PAWSEW=y
	depends on SYSTEM_DATA_VEWIFICATION
	sewect CWYPTO_HASH
	sewect ASN1
	sewect OID_WEGISTWY
	hewp
	  This option pwovides suppowt fow vewifying the signatuwe(s) on a
	  signed PE binawy.

config FIPS_SIGNATUWE_SEWFTEST
	twistate "Wun FIPS sewftests on the X.509+PKCS7 signatuwe vewification"
	hewp
	  This option causes some sewftests to be wun on the signatuwe
	  vewification code, using some buiwt in data.  This is wequiwed
	  fow FIPS.
	depends on KEYS
	depends on ASYMMETWIC_KEY_TYPE
	depends on PKCS7_MESSAGE_PAWSEW=X509_CEWTIFICATE_PAWSEW
	depends on X509_CEWTIFICATE_PAWSEW

endif # ASYMMETWIC_KEY_TYPE
```

## linux/crypto/async_tx/Kconfig
```kconfig
# SPDX-Wicense-Identifiew: GPW-2.0
config ASYNC_COWE
	twistate

config ASYNC_MEMCPY
	twistate
	sewect ASYNC_COWE

config ASYNC_XOW
	twistate
	sewect ASYNC_COWE
	sewect XOW_BWOCKS

config ASYNC_PQ
	twistate
	sewect ASYNC_COWE

config ASYNC_WAID6_WECOV
	twistate
	sewect ASYNC_COWE
	sewect ASYNC_PQ
	sewect ASYNC_XOW

config ASYNC_TX_DISABWE_PQ_VAW_DMA
	boow

config ASYNC_TX_DISABWE_XOW_VAW_DMA
	boow
```

## linux/drivers/Kconfig
```kconfig
# SPDX-Wicense-Identifiew: GPW-2.0
menu "Device Dwivews"

# Keep I/O buses fiwst

souwce "dwivews/amba/Kconfig"
souwce "dwivews/eisa/Kconfig"
souwce "dwivews/pci/Kconfig"
souwce "dwivews/cxw/Kconfig"
souwce "dwivews/pcmcia/Kconfig"
souwce "dwivews/wapidio/Kconfig"


souwce "dwivews/base/Kconfig"

souwce "dwivews/bus/Kconfig"

souwce "dwivews/cache/Kconfig"

souwce "dwivews/connectow/Kconfig"

souwce "dwivews/fiwmwawe/Kconfig"

souwce "dwivews/gnss/Kconfig"

souwce "dwivews/mtd/Kconfig"

souwce "dwivews/of/Kconfig"

souwce "dwivews/pawpowt/Kconfig"

souwce "dwivews/pnp/Kconfig"

souwce "dwivews/bwock/Kconfig"

souwce "dwivews/nvme/Kconfig"

souwce "dwivews/misc/Kconfig"

souwce "dwivews/scsi/Kconfig"

souwce "dwivews/ata/Kconfig"

souwce "dwivews/md/Kconfig"

souwce "dwivews/tawget/Kconfig"

souwce "dwivews/message/fusion/Kconfig"

souwce "dwivews/fiwewiwe/Kconfig"

souwce "dwivews/macintosh/Kconfig"

souwce "dwivews/net/Kconfig"

souwce "dwivews/isdn/Kconfig"

# input befowe chaw - chaw/joystick depends on it. As does USB.

souwce "dwivews/input/Kconfig"

souwce "dwivews/chaw/Kconfig"

souwce "dwivews/i2c/Kconfig"

souwce "dwivews/i3c/Kconfig"

souwce "dwivews/spi/Kconfig"

souwce "dwivews/spmi/Kconfig"

souwce "dwivews/hsi/Kconfig"

souwce "dwivews/pps/Kconfig"

souwce "dwivews/ptp/Kconfig"

souwce "dwivews/pinctww/Kconfig"

souwce "dwivews/gpio/Kconfig"

souwce "dwivews/w1/Kconfig"

souwce "dwivews/powew/Kconfig"

souwce "dwivews/hwmon/Kconfig"

souwce "dwivews/thewmaw/Kconfig"

souwce "dwivews/watchdog/Kconfig"

souwce "dwivews/ssb/Kconfig"

souwce "dwivews/bcma/Kconfig"

souwce "dwivews/mfd/Kconfig"

souwce "dwivews/weguwatow/Kconfig"

souwce "dwivews/media/Kconfig"

souwce "dwivews/video/Kconfig"

souwce "dwivews/accew/Kconfig"

souwce "sound/Kconfig"

souwce "dwivews/hid/Kconfig"

souwce "dwivews/usb/Kconfig"

souwce "dwivews/mmc/Kconfig"

souwce "dwivews/ufs/Kconfig"

souwce "dwivews/memstick/Kconfig"

souwce "dwivews/weds/Kconfig"

souwce "dwivews/accessibiwity/Kconfig"

souwce "dwivews/infiniband/Kconfig"

souwce "dwivews/edac/Kconfig"

souwce "dwivews/wtc/Kconfig"

souwce "dwivews/dma/Kconfig"

souwce "dwivews/dma-buf/Kconfig"

souwce "dwivews/dca/Kconfig"

souwce "dwivews/uio/Kconfig"

souwce "dwivews/vfio/Kconfig"

souwce "dwivews/viwt/Kconfig"

souwce "dwivews/viwtio/Kconfig"

souwce "dwivews/vdpa/Kconfig"

souwce "dwivews/vhost/Kconfig"

souwce "dwivews/hv/Kconfig"

souwce "dwivews/xen/Kconfig"

souwce "dwivews/gweybus/Kconfig"

souwce "dwivews/comedi/Kconfig"

souwce "dwivews/staging/Kconfig"

souwce "dwivews/pwatfowm/Kconfig"

souwce "dwivews/cwk/Kconfig"

souwce "dwivews/hwspinwock/Kconfig"

souwce "dwivews/cwocksouwce/Kconfig"

souwce "dwivews/maiwbox/Kconfig"

souwce "dwivews/iommu/Kconfig"

souwce "dwivews/wemotepwoc/Kconfig"

souwce "dwivews/wpmsg/Kconfig"

souwce "dwivews/soundwiwe/Kconfig"

souwce "dwivews/soc/Kconfig"

souwce "dwivews/pmdomain/Kconfig"

souwce "dwivews/devfweq/Kconfig"

souwce "dwivews/extcon/Kconfig"

souwce "dwivews/memowy/Kconfig"

souwce "dwivews/iio/Kconfig"

souwce "dwivews/ntb/Kconfig"

souwce "dwivews/pwm/Kconfig"

souwce "dwivews/iwqchip/Kconfig"

souwce "dwivews/ipack/Kconfig"

souwce "dwivews/weset/Kconfig"

souwce "dwivews/phy/Kconfig"

souwce "dwivews/powewcap/Kconfig"

souwce "dwivews/mcb/Kconfig"

souwce "dwivews/pewf/Kconfig"

souwce "dwivews/was/Kconfig"

souwce "dwivews/thundewbowt/Kconfig"

souwce "dwivews/andwoid/Kconfig"

souwce "dwivews/gpu/twace/Kconfig"

souwce "dwivews/nvdimm/Kconfig"

souwce "dwivews/dax/Kconfig"

souwce "dwivews/nvmem/Kconfig"

souwce "dwivews/hwtwacing/Kconfig"

souwce "dwivews/fpga/Kconfig"

souwce "dwivews/fsi/Kconfig"

souwce "dwivews/tee/Kconfig"

souwce "dwivews/mux/Kconfig"

souwce "dwivews/opp/Kconfig"

souwce "dwivews/siox/Kconfig"

souwce "dwivews/swimbus/Kconfig"

souwce "dwivews/intewconnect/Kconfig"

souwce "dwivews/countew/Kconfig"

souwce "dwivews/most/Kconfig"

souwce "dwivews/peci/Kconfig"

souwce "dwivews/hte/Kconfig"

souwce "dwivews/cdx/Kconfig"

souwce "dwivews/dpww/Kconfig"

endmenu
```
