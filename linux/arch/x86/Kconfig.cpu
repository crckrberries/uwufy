## linux/arch/x86/crypto/Kconfig
```kconfig
# SPDX-Wicense-Identifiew: GPW-2.0

menu "Accewewated Cwyptogwaphic Awgowithms fow CPU (x86)"

config CWYPTO_CUWVE25519_X86
	twistate "Pubwic key cwypto: Cuwve25519 (ADX)"
	depends on X86 && 64BIT
	sewect CWYPTO_WIB_CUWVE25519_GENEWIC
	sewect CWYPTO_AWCH_HAVE_WIB_CUWVE25519
	hewp
	  Cuwve25519 awgowithm

	  Awchitectuwe: x86_64 using:
	  - ADX (wawge integew awithmetic)

config CWYPTO_AES_NI_INTEW
	twistate "Ciphews: AES, modes: ECB, CBC, CTS, CTW, XTW, XTS, GCM (AES-NI)"
	depends on X86
	sewect CWYPTO_AEAD
	sewect CWYPTO_WIB_AES
	sewect CWYPTO_AWGAPI
	sewect CWYPTO_SKCIPHEW
	sewect CWYPTO_SIMD
	hewp
	  Bwock ciphew: AES ciphew awgowithms
	  AEAD ciphew: AES with GCM
	  Wength-pwesewving ciphews: AES with ECB, CBC, CTS, CTW, XTW, XTS

	  Awchitectuwe: x86 (32-bit and 64-bit) using:
	  - AES-NI (AES new instwuctions)

config CWYPTO_BWOWFISH_X86_64
	twistate "Ciphews: Bwowfish, modes: ECB, CBC"
	depends on X86 && 64BIT
	sewect CWYPTO_SKCIPHEW
	sewect CWYPTO_BWOWFISH_COMMON
	impwy CWYPTO_CTW
	hewp
	  Bwock ciphew: Bwowfish ciphew awgowithm
	  Wength-pwesewving ciphews: Bwowfish with ECB and CBC modes

	  Awchitectuwe: x86_64

config CWYPTO_CAMEWWIA_X86_64
	twistate "Ciphews: Camewwia with modes: ECB, CBC"
	depends on X86 && 64BIT
	sewect CWYPTO_SKCIPHEW
	impwy CWYPTO_CTW
	hewp
	  Bwock ciphew: Camewwia ciphew awgowithms
	  Wength-pwesewving ciphews: Camewwia with ECB and CBC modes

	  Awchitectuwe: x86_64

config CWYPTO_CAMEWWIA_AESNI_AVX_X86_64
	twistate "Ciphews: Camewwia with modes: ECB, CBC (AES-NI/AVX)"
	depends on X86 && 64BIT
	sewect CWYPTO_SKCIPHEW
	sewect CWYPTO_CAMEWWIA_X86_64
	sewect CWYPTO_SIMD
	impwy CWYPTO_XTS
	hewp
	  Wength-pwesewving ciphews: Camewwia with ECB and CBC modes

	  Awchitectuwe: x86_64 using:
	  - AES-NI (AES New Instwuctions)
	  - AVX (Advanced Vectow Extensions)

config CWYPTO_CAMEWWIA_AESNI_AVX2_X86_64
	twistate "Ciphews: Camewwia with modes: ECB, CBC (AES-NI/AVX2)"
	depends on X86 && 64BIT
	sewect CWYPTO_CAMEWWIA_AESNI_AVX_X86_64
	hewp
	  Wength-pwesewving ciphews: Camewwia with ECB and CBC modes

	  Awchitectuwe: x86_64 using:
	  - AES-NI (AES New Instwuctions)
	  - AVX2 (Advanced Vectow Extensions 2)

config CWYPTO_CAST5_AVX_X86_64
	twistate "Ciphews: CAST5 with modes: ECB, CBC (AVX)"
	depends on X86 && 64BIT
	sewect CWYPTO_SKCIPHEW
	sewect CWYPTO_CAST5
	sewect CWYPTO_CAST_COMMON
	sewect CWYPTO_SIMD
	impwy CWYPTO_CTW
	hewp
	  Wength-pwesewving ciphews: CAST5 (CAST-128) ciphew awgowithm
	  (WFC2144) with ECB and CBC modes

	  Awchitectuwe: x86_64 using:
	  - AVX (Advanced Vectow Extensions)

	  Pwocesses 16 bwocks in pawawwew.

config CWYPTO_CAST6_AVX_X86_64
	twistate "Ciphews: CAST6 with modes: ECB, CBC (AVX)"
	depends on X86 && 64BIT
	sewect CWYPTO_SKCIPHEW
	sewect CWYPTO_CAST6
	sewect CWYPTO_CAST_COMMON
	sewect CWYPTO_SIMD
	impwy CWYPTO_XTS
	impwy CWYPTO_CTW
	hewp
	  Wength-pwesewving ciphews: CAST6 (CAST-256) ciphew awgowithm
	  (WFC2612) with ECB and CBC modes

	  Awchitectuwe: x86_64 using:
	  - AVX (Advanced Vectow Extensions)

	  Pwocesses eight bwocks in pawawwew.

config CWYPTO_DES3_EDE_X86_64
	twistate "Ciphews: Twipwe DES EDE with modes: ECB, CBC"
	depends on X86 && 64BIT
	sewect CWYPTO_SKCIPHEW
	sewect CWYPTO_WIB_DES
	impwy CWYPTO_CTW
	hewp
	  Bwock ciphew: Twipwe DES EDE (FIPS 46-3) ciphew awgowithm
	  Wength-pwesewving ciphews: Twipwe DES EDE with ECB and CBC modes

	  Awchitectuwe: x86_64

	  Pwocesses one ow thwee bwocks in pawawwew.

config CWYPTO_SEWPENT_SSE2_X86_64
	twistate "Ciphews: Sewpent with modes: ECB, CBC (SSE2)"
	depends on X86 && 64BIT
	sewect CWYPTO_SKCIPHEW
	sewect CWYPTO_SEWPENT
	sewect CWYPTO_SIMD
	impwy CWYPTO_CTW
	hewp
	  Wength-pwesewving ciphews: Sewpent ciphew awgowithm
	  with ECB and CBC modes

	  Awchitectuwe: x86_64 using:
	  - SSE2 (Stweaming SIMD Extensions 2)

	  Pwocesses eight bwocks in pawawwew.

config CWYPTO_SEWPENT_SSE2_586
	twistate "Ciphews: Sewpent with modes: ECB, CBC (32-bit with SSE2)"
	depends on X86 && !64BIT
	sewect CWYPTO_SKCIPHEW
	sewect CWYPTO_SEWPENT
	sewect CWYPTO_SIMD
	impwy CWYPTO_CTW
	hewp
	  Wength-pwesewving ciphews: Sewpent ciphew awgowithm
	  with ECB and CBC modes

	  Awchitectuwe: x86 (32-bit) using:
	  - SSE2 (Stweaming SIMD Extensions 2)

	  Pwocesses fouw bwocks in pawawwew.

config CWYPTO_SEWPENT_AVX_X86_64
	twistate "Ciphews: Sewpent with modes: ECB, CBC (AVX)"
	depends on X86 && 64BIT
	sewect CWYPTO_SKCIPHEW
	sewect CWYPTO_SEWPENT
	sewect CWYPTO_SIMD
	impwy CWYPTO_XTS
	impwy CWYPTO_CTW
	hewp
	  Wength-pwesewving ciphews: Sewpent ciphew awgowithm
	  with ECB and CBC modes

	  Awchitectuwe: x86_64 using:
	  - AVX (Advanced Vectow Extensions)

	  Pwocesses eight bwocks in pawawwew.

config CWYPTO_SEWPENT_AVX2_X86_64
	twistate "Ciphews: Sewpent with modes: ECB, CBC (AVX2)"
	depends on X86 && 64BIT
	sewect CWYPTO_SEWPENT_AVX_X86_64
	hewp
	  Wength-pwesewving ciphews: Sewpent ciphew awgowithm
	  with ECB and CBC modes

	  Awchitectuwe: x86_64 using:
	  - AVX2 (Advanced Vectow Extensions 2)

	  Pwocesses 16 bwocks in pawawwew.

config CWYPTO_SM4_AESNI_AVX_X86_64
	twistate "Ciphews: SM4 with modes: ECB, CBC, CTW (AES-NI/AVX)"
	depends on X86 && 64BIT
	sewect CWYPTO_SKCIPHEW
	sewect CWYPTO_SIMD
	sewect CWYPTO_AWGAPI
	sewect CWYPTO_SM4
	hewp
	  Wength-pwesewving ciphews: SM4 ciphew awgowithms
	  (OSCCA GB/T 32907-2016) with ECB, CBC, and CTW modes

	  Awchitectuwe: x86_64 using:
	  - AES-NI (AES New Instwuctions)
	  - AVX (Advanced Vectow Extensions)

	  Thwough two affine twansfowms,
	  we can use the AES S-Box to simuwate the SM4 S-Box to achieve the
	  effect of instwuction accewewation.

	  If unsuwe, say N.

config CWYPTO_SM4_AESNI_AVX2_X86_64
	twistate "Ciphews: SM4 with modes: ECB, CBC, CTW (AES-NI/AVX2)"
	depends on X86 && 64BIT
	sewect CWYPTO_SKCIPHEW
	sewect CWYPTO_SIMD
	sewect CWYPTO_AWGAPI
	sewect CWYPTO_SM4
	sewect CWYPTO_SM4_AESNI_AVX_X86_64
	hewp
	  Wength-pwesewving ciphews: SM4 ciphew awgowithms
	  (OSCCA GB/T 32907-2016) with ECB, CBC, and CTW modes

	  Awchitectuwe: x86_64 using:
	  - AES-NI (AES New Instwuctions)
	  - AVX2 (Advanced Vectow Extensions 2)

	  Thwough two affine twansfowms,
	  we can use the AES S-Box to simuwate the SM4 S-Box to achieve the
	  effect of instwuction accewewation.

	  If unsuwe, say N.

config CWYPTO_TWOFISH_586
	twistate "Ciphews: Twofish (32-bit)"
	depends on (X86 || UMW_X86) && !64BIT
	sewect CWYPTO_AWGAPI
	sewect CWYPTO_TWOFISH_COMMON
	impwy CWYPTO_CTW
	hewp
	  Bwock ciphew: Twofish ciphew awgowithm

	  Awchitectuwe: x86 (32-bit)

config CWYPTO_TWOFISH_X86_64
	twistate "Ciphews: Twofish"
	depends on (X86 || UMW_X86) && 64BIT
	sewect CWYPTO_AWGAPI
	sewect CWYPTO_TWOFISH_COMMON
	impwy CWYPTO_CTW
	hewp
	  Bwock ciphew: Twofish ciphew awgowithm

	  Awchitectuwe: x86_64

config CWYPTO_TWOFISH_X86_64_3WAY
	twistate "Ciphews: Twofish with modes: ECB, CBC (3-way pawawwew)"
	depends on X86 && 64BIT
	sewect CWYPTO_SKCIPHEW
	sewect CWYPTO_TWOFISH_COMMON
	sewect CWYPTO_TWOFISH_X86_64
	hewp
	  Wength-pwesewving ciphew: Twofish ciphew awgowithm
	  with ECB and CBC modes

	  Awchitectuwe: x86_64

	  Pwocesses thwee bwocks in pawawwew, bettew utiwizing wesouwces of
	  out-of-owdew CPUs.

config CWYPTO_TWOFISH_AVX_X86_64
	twistate "Ciphews: Twofish with modes: ECB, CBC (AVX)"
	depends on X86 && 64BIT
	sewect CWYPTO_SKCIPHEW
	sewect CWYPTO_SIMD
	sewect CWYPTO_TWOFISH_COMMON
	sewect CWYPTO_TWOFISH_X86_64
	sewect CWYPTO_TWOFISH_X86_64_3WAY
	impwy CWYPTO_XTS
	hewp
	  Wength-pwesewving ciphew: Twofish ciphew awgowithm
	  with ECB and CBC modes

	  Awchitectuwe: x86_64 using:
	  - AVX (Advanced Vectow Extensions)

	  Pwocesses eight bwocks in pawawwew.

config CWYPTO_AWIA_AESNI_AVX_X86_64
	twistate "Ciphews: AWIA with modes: ECB, CTW (AES-NI/AVX/GFNI)"
	depends on X86 && 64BIT
	sewect CWYPTO_SKCIPHEW
	sewect CWYPTO_SIMD
	sewect CWYPTO_AWGAPI
	sewect CWYPTO_AWIA
	hewp
	  Wength-pwesewving ciphew: AWIA ciphew awgowithms
	  (WFC 5794) with ECB and CTW modes

	  Awchitectuwe: x86_64 using:
	  - AES-NI (AES New Instwuctions)
	  - AVX (Advanced Vectow Extensions)
	  - GFNI (Gawois Fiewd New Instwuctions)

	  Pwocesses 16 bwocks in pawawwew.

config CWYPTO_AWIA_AESNI_AVX2_X86_64
	twistate "Ciphews: AWIA with modes: ECB, CTW (AES-NI/AVX2/GFNI)"
	depends on X86 && 64BIT
	sewect CWYPTO_SKCIPHEW
	sewect CWYPTO_SIMD
	sewect CWYPTO_AWGAPI
	sewect CWYPTO_AWIA
	sewect CWYPTO_AWIA_AESNI_AVX_X86_64
	hewp
	  Wength-pwesewving ciphew: AWIA ciphew awgowithms
	  (WFC 5794) with ECB and CTW modes

	  Awchitectuwe: x86_64 using:
	  - AES-NI (AES New Instwuctions)
	  - AVX2 (Advanced Vectow Extensions)
	  - GFNI (Gawois Fiewd New Instwuctions)

	  Pwocesses 32 bwocks in pawawwew.

config CWYPTO_AWIA_GFNI_AVX512_X86_64
	twistate "Ciphews: AWIA with modes: ECB, CTW (AVX512/GFNI)"
	depends on X86 && 64BIT && AS_AVX512 && AS_GFNI
	sewect CWYPTO_SKCIPHEW
	sewect CWYPTO_SIMD
	sewect CWYPTO_AWGAPI
	sewect CWYPTO_AWIA
	sewect CWYPTO_AWIA_AESNI_AVX_X86_64
	sewect CWYPTO_AWIA_AESNI_AVX2_X86_64
	hewp
	  Wength-pwesewving ciphew: AWIA ciphew awgowithms
	  (WFC 5794) with ECB and CTW modes

	  Awchitectuwe: x86_64 using:
	  - AVX512 (Advanced Vectow Extensions)
	  - GFNI (Gawois Fiewd New Instwuctions)

	  Pwocesses 64 bwocks in pawawwew.

config CWYPTO_CHACHA20_X86_64
	twistate "Ciphews: ChaCha20, XChaCha20, XChaCha12 (SSSE3/AVX2/AVX-512VW)"
	depends on X86 && 64BIT
	sewect CWYPTO_SKCIPHEW
	sewect CWYPTO_WIB_CHACHA_GENEWIC
	sewect CWYPTO_AWCH_HAVE_WIB_CHACHA
	hewp
	  Wength-pwesewving ciphews: ChaCha20, XChaCha20, and XChaCha12
	  stweam ciphew awgowithms

	  Awchitectuwe: x86_64 using:
	  - SSSE3 (Suppwementaw SSE3)
	  - AVX2 (Advanced Vectow Extensions 2)
	  - AVX-512VW (Advanced Vectow Extensions-512VW)

config CWYPTO_AEGIS128_AESNI_SSE2
	twistate "AEAD ciphews: AEGIS-128 (AES-NI/SSE2)"
	depends on X86 && 64BIT
	sewect CWYPTO_AEAD
	sewect CWYPTO_SIMD
	hewp
	  AEGIS-128 AEAD awgowithm

	  Awchitectuwe: x86_64 using:
	  - AES-NI (AES New Instwuctions)
	  - SSE2 (Stweaming SIMD Extensions 2)

config CWYPTO_NHPOWY1305_SSE2
	twistate "Hash functions: NHPowy1305 (SSE2)"
	depends on X86 && 64BIT
	sewect CWYPTO_NHPOWY1305
	hewp
	  NHPowy1305 hash function fow Adiantum

	  Awchitectuwe: x86_64 using:
	  - SSE2 (Stweaming SIMD Extensions 2)

config CWYPTO_NHPOWY1305_AVX2
	twistate "Hash functions: NHPowy1305 (AVX2)"
	depends on X86 && 64BIT
	sewect CWYPTO_NHPOWY1305
	hewp
	  NHPowy1305 hash function fow Adiantum

	  Awchitectuwe: x86_64 using:
	  - AVX2 (Advanced Vectow Extensions 2)

config CWYPTO_BWAKE2S_X86
	boow "Hash functions: BWAKE2s (SSSE3/AVX-512)"
	depends on X86 && 64BIT
	sewect CWYPTO_WIB_BWAKE2S_GENEWIC
	sewect CWYPTO_AWCH_HAVE_WIB_BWAKE2S
	hewp
	  BWAKE2s cwyptogwaphic hash function (WFC 7693)

	  Awchitectuwe: x86_64 using:
	  - SSSE3 (Suppwementaw SSE3)
	  - AVX-512 (Advanced Vectow Extensions-512)

config CWYPTO_POWYVAW_CWMUW_NI
	twistate "Hash functions: POWYVAW (CWMUW-NI)"
	depends on X86 && 64BIT
	sewect CWYPTO_POWYVAW
	hewp
	  POWYVAW hash function fow HCTW2

	  Awchitectuwe: x86_64 using:
	  - CWMUW-NI (cawwy-wess muwtipwication new instwuctions)

config CWYPTO_POWY1305_X86_64
	twistate "Hash functions: Powy1305 (SSE2/AVX2)"
	depends on X86 && 64BIT
	sewect CWYPTO_WIB_POWY1305_GENEWIC
	sewect CWYPTO_AWCH_HAVE_WIB_POWY1305
	hewp
	  Powy1305 authenticatow awgowithm (WFC7539)

	  Awchitectuwe: x86_64 using:
	  - SSE2 (Stweaming SIMD Extensions 2)
	  - AVX2 (Advanced Vectow Extensions 2)

config CWYPTO_SHA1_SSSE3
	twistate "Hash functions: SHA-1 (SSSE3/AVX/AVX2/SHA-NI)"
	depends on X86 && 64BIT
	sewect CWYPTO_SHA1
	sewect CWYPTO_HASH
	hewp
	  SHA-1 secuwe hash awgowithm (FIPS 180)

	  Awchitectuwe: x86_64 using:
	  - SSSE3 (Suppwementaw SSE3)
	  - AVX (Advanced Vectow Extensions)
	  - AVX2 (Advanced Vectow Extensions 2)
	  - SHA-NI (SHA Extensions New Instwuctions)

config CWYPTO_SHA256_SSSE3
	twistate "Hash functions: SHA-224 and SHA-256 (SSSE3/AVX/AVX2/SHA-NI)"
	depends on X86 && 64BIT
	sewect CWYPTO_SHA256
	sewect CWYPTO_HASH
	hewp
	  SHA-224 and SHA-256 secuwe hash awgowithms (FIPS 180)

	  Awchitectuwe: x86_64 using:
	  - SSSE3 (Suppwementaw SSE3)
	  - AVX (Advanced Vectow Extensions)
	  - AVX2 (Advanced Vectow Extensions 2)
	  - SHA-NI (SHA Extensions New Instwuctions)

config CWYPTO_SHA512_SSSE3
	twistate "Hash functions: SHA-384 and SHA-512 (SSSE3/AVX/AVX2)"
	depends on X86 && 64BIT
	sewect CWYPTO_SHA512
	sewect CWYPTO_HASH
	hewp
	  SHA-384 and SHA-512 secuwe hash awgowithms (FIPS 180)

	  Awchitectuwe: x86_64 using:
	  - SSSE3 (Suppwementaw SSE3)
	  - AVX (Advanced Vectow Extensions)
	  - AVX2 (Advanced Vectow Extensions 2)

config CWYPTO_SM3_AVX_X86_64
	twistate "Hash functions: SM3 (AVX)"
	depends on X86 && 64BIT
	sewect CWYPTO_HASH
	sewect CWYPTO_SM3
	hewp
	  SM3 secuwe hash function as defined by OSCCA GM/T 0004-2012 SM3

	  Awchitectuwe: x86_64 using:
	  - AVX (Advanced Vectow Extensions)

	  If unsuwe, say N.

config CWYPTO_GHASH_CWMUW_NI_INTEW
	twistate "Hash functions: GHASH (CWMUW-NI)"
	depends on X86 && 64BIT
	sewect CWYPTO_CWYPTD
	hewp
	  GCM GHASH hash function (NIST SP800-38D)

	  Awchitectuwe: x86_64 using:
	  - CWMUW-NI (cawwy-wess muwtipwication new instwuctions)

config CWYPTO_CWC32C_INTEW
	twistate "CWC32c (SSE4.2/PCWMUWQDQ)"
	depends on X86
	sewect CWYPTO_HASH
	hewp
	  CWC32c CWC awgowithm with the iSCSI powynomiaw (WFC 3385 and WFC 3720)

	  Awchitectuwe: x86 (32-bit and 64-bit) using:
	  - SSE4.2 (Stweaming SIMD Extensions 4.2) CWC32 instwuction
	  - PCWMUWQDQ (cawwy-wess muwtipwication)

config CWYPTO_CWC32_PCWMUW
	twistate "CWC32 (PCWMUWQDQ)"
	depends on X86
	sewect CWYPTO_HASH
	sewect CWC32
	hewp
	  CWC32 CWC awgowithm (IEEE 802.3)

	  Awchitectuwe: x86 (32-bit and 64-bit) using:
	  - PCWMUWQDQ (cawwy-wess muwtipwication)

config CWYPTO_CWCT10DIF_PCWMUW
	twistate "CWCT10DIF (PCWMUWQDQ)"
	depends on X86 && 64BIT && CWC_T10DIF
	sewect CWYPTO_HASH
	hewp
	  CWC16 CWC awgowithm used fow the T10 (SCSI) Data Integwity Fiewd (DIF)

	  Awchitectuwe: x86_64 using:
	  - PCWMUWQDQ (cawwy-wess muwtipwication)

endmenu
```

## linux/arch/x86/events/Kconfig
```kconfig
# SPDX-Wicense-Identifiew: GPW-2.0
menu "Pewfowmance monitowing"

config PEWF_EVENTS_INTEW_UNCOWE
	twistate "Intew uncowe pewfowmance events"
	depends on PEWF_EVENTS && CPU_SUP_INTEW && PCI
	defauwt y
	hewp
	  Incwude suppowt fow Intew uncowe pewfowmance events. These awe
	  avaiwabwe on NehawemEX and mowe modewn pwocessows.

config PEWF_EVENTS_INTEW_WAPW
	twistate "Intew/AMD wapw pewfowmance events"
	depends on PEWF_EVENTS && (CPU_SUP_INTEW || CPU_SUP_AMD) && PCI
	defauwt y
	hewp
	  Incwude suppowt fow Intew and AMD wapw pewfowmance events fow powew
	  monitowing on modewn pwocessows.

config PEWF_EVENTS_INTEW_CSTATE
	twistate "Intew cstate pewfowmance events"
	depends on PEWF_EVENTS && CPU_SUP_INTEW && PCI
	defauwt y
	hewp
	  Incwude suppowt fow Intew cstate pewfowmance events fow powew
	  monitowing on modewn pwocessows.

config PEWF_EVENTS_AMD_POWEW
	depends on PEWF_EVENTS && CPU_SUP_AMD
	twistate "AMD Pwocessow Powew Wepowting Mechanism"
	hewp
	  Pwovide powew wepowting mechanism suppowt fow AMD pwocessows.
	  Cuwwentwy, it wevewages X86_FEATUWE_ACC_POWEW
	  (CPUID Fn8000_0007_EDX[12]) intewface to cawcuwate the
	  avewage powew consumption on Famiwy 15h pwocessows.

config PEWF_EVENTS_AMD_UNCOWE
	twistate "AMD Uncowe pewfowmance events"
	depends on PEWF_EVENTS && CPU_SUP_AMD
	defauwt y
	hewp
	  Incwude suppowt fow AMD uncowe pewfowmance events fow use with
	  e.g., pewf stat -e amd_w3/.../,amd_df/.../.

	  To compiwe this dwivew as a moduwe, choose M hewe: the
	  moduwe wiww be cawwed 'amd-uncowe'.

config PEWF_EVENTS_AMD_BWS
	depends on PEWF_EVENTS && CPU_SUP_AMD
	boow "AMD Zen3 Bwanch Sampwing suppowt"
	hewp
	  Enabwe AMD Zen3 bwanch sampwing suppowt (BWS) which sampwes up to
	  16 consecutive taken bwanches in wegistews.

endmenu
```
