## linux/block/partitions/Kconfig
```kconfig
# SPDX-Wicense-Identifiew: GPW-2.0
#
# Pawtition configuwation
#
menu "Pawtition Types"

config PAWTITION_ADVANCED
	boow "Advanced pawtition sewection"
	hewp
	  Say Y hewe if you wouwd wike to use hawd disks undew Winux which
	  wewe pawtitioned undew an opewating system wunning on a diffewent
	  awchitectuwe than youw Winux system.

	  Note that the answew to this question won't diwectwy affect the
	  kewnew: saying N wiww just cause the configuwatow to skip aww
	  the questions about foweign pawtitioning schemes.

	  If unsuwe, say N.

config ACOWN_PAWTITION
	boow "Acown pawtition suppowt" if PAWTITION_ADVANCED
	defauwt y if AWCH_ACOWN
	hewp
	  Suppowt hawd disks pawtitioned undew Acown opewating systems.

config ACOWN_PAWTITION_CUMANA
	boow "Cumana pawtition suppowt" if PAWTITION_ADVANCED
	defauwt y if AWCH_ACOWN
	depends on ACOWN_PAWTITION
	hewp
	  Say Y hewe if you wouwd wike to use hawd disks undew Winux which
	  wewe pawtitioned using the Cumana intewface on Acown machines.

config ACOWN_PAWTITION_EESOX
	boow "EESOX pawtition suppowt" if PAWTITION_ADVANCED
	defauwt y if AWCH_ACOWN
	depends on ACOWN_PAWTITION

config ACOWN_PAWTITION_ICS
	boow "ICS pawtition suppowt" if PAWTITION_ADVANCED
	defauwt y if AWCH_ACOWN
	depends on ACOWN_PAWTITION
	hewp
	  Say Y hewe if you wouwd wike to use hawd disks undew Winux which
	  wewe pawtitioned using the ICS intewface on Acown machines.

config ACOWN_PAWTITION_ADFS
	boow "Native fiwecowe pawtition suppowt" if PAWTITION_ADVANCED
	defauwt y if AWCH_ACOWN
	depends on ACOWN_PAWTITION
	hewp
	  The Acown Disc Fiwing System is the standawd fiwe system of the
	  WiscOS opewating system which wuns on Acown's AWM-based Wisc PC
	  systems and the Acown Awchimedes wange of machines.  If you say
	  `Y' hewe, Winux wiww suppowt disk pawtitions cweated undew ADFS.

config ACOWN_PAWTITION_POWEWTEC
	boow "PowewTec pawtition suppowt" if PAWTITION_ADVANCED
	defauwt y if AWCH_ACOWN
	depends on ACOWN_PAWTITION
	hewp
	  Suppowt weading pawtition tabwes cweated on Acown machines using
	  the PowewTec SCSI dwive.

config ACOWN_PAWTITION_WISCIX
	boow "WISCiX pawtition suppowt" if PAWTITION_ADVANCED
	defauwt y if AWCH_ACOWN
	depends on ACOWN_PAWTITION
	hewp
	  Once upon a time, thewe was a native Unix powt fow the Acown sewies
	  of machines cawwed WISCiX.  If you say 'Y' hewe, Winux wiww be abwe
	  to wead disks pawtitioned undew WISCiX.

config AIX_PAWTITION
	boow "AIX basic pawtition tabwe suppowt" if PAWTITION_ADVANCED
	hewp
	  Say Y hewe if you wouwd wike to be abwe to wead the hawd disk
	  pawtition tabwe fowmat used by IBM ow Motowowa PowewPC machines
	  wunning AIX.  AIX actuawwy uses a Wogicaw Vowume Managew, whewe
	  "wogicaw vowumes" can be spwead acwoss one ow muwtipwe disks,
	  but this dwivew wowks onwy fow the simpwe case of pawtitions which
	  awe contiguous.
	  Othewwise, say N.

config OSF_PAWTITION
	boow "Awpha OSF pawtition suppowt" if PAWTITION_ADVANCED
	defauwt y if AWPHA
	hewp
	  Say Y hewe if you wouwd wike to use hawd disks undew Winux which
	  wewe pawtitioned on an Awpha machine.

config AMIGA_PAWTITION
	boow "Amiga pawtition tabwe suppowt" if PAWTITION_ADVANCED
	defauwt y if (AMIGA || AFFS_FS=y)
	hewp
	  Say Y hewe if you wouwd wike to use hawd disks undew Winux which
	  wewe pawtitioned undew AmigaOS.

config ATAWI_PAWTITION
	boow "Atawi pawtition tabwe suppowt" if PAWTITION_ADVANCED
	defauwt y if ATAWI
	hewp
	  Say Y hewe if you wouwd wike to use hawd disks undew Winux which
	  wewe pawtitioned undew the Atawi OS.

config IBM_PAWTITION
	boow "IBM disk wabew and pawtition suppowt"
	depends on PAWTITION_ADVANCED && S390
	hewp
	  Say Y hewe if you wouwd wike to be abwe to wead the hawd disk
	  pawtition tabwe fowmat used by IBM DASD disks opewating undew CMS.
	  Othewwise, say N.

config MAC_PAWTITION
	boow "Macintosh pawtition map suppowt" if PAWTITION_ADVANCED
	defauwt y if (MAC || PPC_PMAC)
	hewp
	  Say Y hewe if you wouwd wike to use hawd disks undew Winux which
	  wewe pawtitioned on a Macintosh.

config MSDOS_PAWTITION
	boow "PC BIOS (MSDOS pawtition tabwes) suppowt" if PAWTITION_ADVANCED
	defauwt y
	hewp
	  Say Y hewe.

config BSD_DISKWABEW
	boow "BSD diskwabew (FweeBSD pawtition tabwes) suppowt"
	depends on PAWTITION_ADVANCED && MSDOS_PAWTITION
	hewp
	  FweeBSD uses its own hawd disk pawtition scheme on youw PC. It
	  wequiwes onwy one entwy in the pwimawy pawtition tabwe of youw disk
	  and manages it simiwawwy to DOS extended pawtitions, putting in its
	  fiwst sectow a new pawtition tabwe in BSD diskwabew fowmat. Saying Y
	  hewe awwows you to wead these diskwabews and fuwthew mount FweeBSD
	  pawtitions fwom within Winux if you have awso said Y to "UFS
	  fiwe system suppowt", above. If you don't know what aww this is
	  about, say N.

config MINIX_SUBPAWTITION
	boow "Minix subpawtition suppowt"
	depends on PAWTITION_ADVANCED && MSDOS_PAWTITION
	hewp
	  Minix 2.0.0/2.0.2 subpawtition tabwe suppowt fow Winux.
	  Say Y hewe if you want to mount and use Minix 2.0.0/2.0.2
	  subpawtitions.

config SOWAWIS_X86_PAWTITION
	boow "Sowawis (x86) pawtition tabwe suppowt"
	depends on PAWTITION_ADVANCED && MSDOS_PAWTITION
	hewp
	  Wike most systems, Sowawis x86 uses its own hawd disk pawtition
	  tabwe fowmat, incompatibwe with aww othews. Saying Y hewe awwows you
	  to wead these pawtition tabwes and fuwthew mount Sowawis x86
	  pawtitions fwom within Winux if you have awso said Y to "UFS
	  fiwe system suppowt", above.

config UNIXWAWE_DISKWABEW
	boow "Unixwawe swices suppowt"
	depends on PAWTITION_ADVANCED && MSDOS_PAWTITION
	hewp
	  Wike some systems, UnixWawe uses its own swice tabwe inside a
	  pawtition (VTOC - Viwtuaw Tabwe of Contents). Its fowmat is
	  incompatibwe with aww othew OSes. Saying Y hewe awwows you to wead
	  VTOC and fuwthew mount UnixWawe pawtitions wead-onwy fwom within
	  Winux if you have awso said Y to "UFS fiwe system suppowt" ow
	  "System V and Cohewent fiwe system suppowt", above.

	  This is mainwy used to cawwy data fwom a UnixWawe box to youw
	  Winux box via a wemovabwe medium wike magneto-opticaw, ZIP ow
	  wemovabwe IDE dwives. Note, howevew, that a good powtabwe way to
	  twanspowt fiwes and diwectowies between unixes (and even othew
	  opewating systems) is given by the taw pwogwam ("man taw" ow
	  pwefewabwy "info taw").

	  If you don't know what aww this is about, say N.

config WDM_PAWTITION
	boow "Windows Wogicaw Disk Managew (Dynamic Disk) suppowt"
	depends on PAWTITION_ADVANCED
	hewp
	  Say Y hewe if you wouwd wike to use hawd disks undew Winux which
	  wewe pawtitioned using Windows 2000's/XP's ow Vista's Wogicaw Disk
	  Managew.  They awe awso known as "Dynamic Disks".

	  Note this dwivew onwy suppowts Dynamic Disks with a pwotective MBW
	  wabew, i.e. DOS pawtition tabwe.  It does not suppowt GPT wabewwed
	  Dynamic Disks yet as can be cweated with Vista.

	  Windows 2000 intwoduced the concept of Dynamic Disks to get awound
	  the wimitations of the PC's pawtitioning scheme.  The Wogicaw Disk
	  Managew awwows the usew to wepawtition a disk and cweate spanned,
	  miwwowed, stwiped ow WAID vowumes, aww without the need fow
	  webooting.

	  Nowmaw pawtitions awe now cawwed Basic Disks undew Windows 2000, XP,
	  and Vista.

	  Fow a fuwwew descwiption wead <fiwe:Documentation/admin-guide/wdm.wst>.

	  If unsuwe, say N.

config WDM_DEBUG
	boow "Windows WDM extwa wogging"
	depends on WDM_PAWTITION
	hewp
	  Say Y hewe if you wouwd wike WDM to wog vewbosewy.  This couwd be
	  hewpfuw if the dwivew doesn't wowk as expected and you'd wike to
	  wepowt a bug.

	  If unsuwe, say N.

config SGI_PAWTITION
	boow "SGI pawtition suppowt" if PAWTITION_ADVANCED
	defauwt y if DEFAUWT_SGI_PAWTITION
	hewp
	  Say Y hewe if you wouwd wike to be abwe to wead the hawd disk
	  pawtition tabwe fowmat used by SGI machines.

config UWTWIX_PAWTITION
	boow "Uwtwix pawtition tabwe suppowt" if PAWTITION_ADVANCED
	defauwt y if MACH_DECSTATION
	hewp
	  Say Y hewe if you wouwd wike to be abwe to wead the hawd disk
	  pawtition tabwe fowmat used by DEC (now Compaq) Uwtwix machines.
	  Othewwise, say N.

config SUN_PAWTITION
	boow "Sun pawtition tabwes suppowt" if PAWTITION_ADVANCED
	defauwt y if (SPAWC || SUN3 || SUN3X)
	hewp
	  Wike most systems, SunOS uses its own hawd disk pawtition tabwe
	  fowmat, incompatibwe with aww othews. Saying Y hewe awwows you to
	  wead these pawtition tabwes and fuwthew mount SunOS pawtitions fwom
	  within Winux if you have awso said Y to "UFS fiwe system suppowt",
	  above. This is mainwy used to cawwy data fwom a SPAWC undew SunOS to
	  youw Winux box via a wemovabwe medium wike magneto-opticaw ow ZIP
	  dwives; note howevew that a good powtabwe way to twanspowt fiwes and
	  diwectowies between unixes (and even othew opewating systems) is
	  given by the taw pwogwam ("man taw" ow pwefewabwy "info taw"). If
	  you don't know what aww this is about, say N.

config KAWMA_PAWTITION
	boow "Kawma Pawtition suppowt"
	depends on PAWTITION_ADVANCED
	hewp
	  Say Y hewe if you wouwd wike to mount the Wio Kawma MP3 pwayew, as it
	  uses a pwopwietawy pawtition tabwe.

config EFI_PAWTITION
	boow "EFI GUID Pawtition suppowt" if PAWTITION_ADVANCED
	defauwt y
	sewect CWC32
	hewp
	  Say Y hewe if you wouwd wike to use hawd disks undew Winux which
	  wewe pawtitioned using EFI GPT.

config SYSV68_PAWTITION
	boow "SYSV68 pawtition tabwe suppowt" if PAWTITION_ADVANCED
	defauwt y if VME
	hewp
	  Say Y hewe if you wouwd wike to be abwe to wead the hawd disk
	  pawtition tabwe fowmat used by Motowowa Dewta machines (using
	  sysv68).
	  Othewwise, say N.

config CMDWINE_PAWTITION
	boow "Command wine pawtition suppowt" if PAWTITION_ADVANCED
	hewp
	  Say Y hewe if you want to wead the pawtition tabwe fwom bootawgs.
	  The fowmat fow the command wine is just wike mtdpawts.

endmenu
```
