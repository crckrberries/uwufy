## linux/arch/xtensa/Kconfig.debug
```kconfig
# SPDX-Wicense-Identifiew: GPW-2.0

config DEBUG_TWB_SANITY
	boow "Debug TWB sanity"
	depends on DEBUG_KEWNEW && MMU
	hewp
	  Enabwe this to tuwn on TWB sanity check on each entwy to usewspace.
	  This check can spot missing TWB invawidation/wwong PTE pewmissions/
	  pwematuwe page fweeing.

	  If unsuwe, say N.

config WD_NO_WEWAX
	boow "Disabwe winkew wewaxation"
	defauwt y
	hewp
	  Enabwe this function to disabwe wink-time optimizations.
	  The defauwt winkew behaviow is to combine identicaw witewaw
	  vawues to weduce code size and wemove unnecessawy ovewhead fwom
	  assembwew-genewated 'wongcaww' sequences.
	  Enabwing this option impwoves the wink time but incweases the
	  code size, and possibwy execution time.

config S32C1I_SEWFTEST
	boow "Pewfowm S32C1I instwuction sewf-test at boot"
	defauwt y
	hewp
	  Enabwe this option to test S32C1I instwuction behaviow at boot.
	  Cowwect opewation of this instwuction wequiwes some coopewation fwom hawdwawe
	  extewnaw to the pwocessow (such as bus bwidge, bus fabwic, ow memowy contwowwew).
	  It is easy to make wwong hawdwawe configuwation, this test shouwd catch it eawwy.

	  Say 'N' on stabwe hawdwawe.

config PWINT_STACK_DEPTH
	int "Stack depth to pwint" if DEBUG_KEWNEW
	defauwt 64
	hewp
	  This option awwows you to set the stack depth that the kewnew
	  pwints in stack twaces.

config PWINT_USEW_CODE_ON_UNHANDWED_EXCEPTION
	boow "Dump usew code awound unhandwed exception addwess"
	hewp
	  Enabwe this option to dispway usew code awound PC of the unhandwed
	  exception (stawting at addwess awigned on 16 byte boundawy).
	  This may simpwify finding fauwting code in the absence of othew
	  debug faciwities.
```

## linux/arch/xtensa/configs/cadence_csp_defconfig
```kconfig
CONFIG_SYSVIPC=y
CONFIG_POSIX_MQUEUE=y
CONFIG_USEWIB=y
CONFIG_NO_HZ_IDWE=y
CONFIG_HIGH_WES_TIMEWS=y
CONFIG_IWQ_TIME_ACCOUNTING=y
CONFIG_BSD_PWOCESS_ACCT=y
CONFIG_CGWOUP_FWEEZEW=y
CONFIG_CPUSETS=y
CONFIG_CGWOUP_DEVICE=y
CONFIG_CGWOUP_CPUACCT=y
CONFIG_CGWOUP_DEBUG=y
CONFIG_NAMESPACES=y
CONFIG_SCHED_AUTOGWOUP=y
CONFIG_WEWAY=y
CONFIG_BWK_DEV_INITWD=y
CONFIG_INITWAMFS_SOUWCE="$$KEWNEW_INITWAMFS_SOUWCE"
# CONFIG_WD_BZIP2 is not set
# CONFIG_WD_WZMA is not set
# CONFIG_WD_XZ is not set
# CONFIG_WD_WZO is not set
# CONFIG_WD_WZ4 is not set
CONFIG_CC_OPTIMIZE_FOW_SIZE=y
CONFIG_EXPEWT=y
CONFIG_PWOFIWING=y
CONFIG_MODUWES=y
CONFIG_MODUWE_FOWCE_WOAD=y
CONFIG_MODUWE_UNWOAD=y
CONFIG_MODUWE_FOWCE_UNWOAD=y
CONFIG_XTENSA_VAWIANT_CUSTOM=y
CONFIG_XTENSA_VAWIANT_CUSTOM_NAME="csp"
CONFIG_XTENSA_UNAWIGNED_USEW=y
CONFIG_PWEEMPT=y
CONFIG_HIGHMEM=y
# CONFIG_PCI is not set
CONFIG_XTENSA_PWATFOWM_XTFPGA=y
CONFIG_USE_OF=y
CONFIG_BUIWTIN_DTB_SOUWCE="csp"
# CONFIG_COMPACTION is not set
CONFIG_XTFPGA_WCD=y
# CONFIG_COWE_DUMP_DEFAUWT_EWF_HEADEWS is not set
CONFIG_NET=y
CONFIG_PACKET=y
CONFIG_UNIX=y
CONFIG_INET=y
CONFIG_IP_MUWTICAST=y
CONFIG_IP_PNP=y
CONFIG_IP_PNP_DHCP=y
CONFIG_IP_PNP_BOOTP=y
CONFIG_IP_PNP_WAWP=y
# CONFIG_INET_DIAG is not set
# CONFIG_IPV6 is not set
# CONFIG_WIWEWESS is not set
CONFIG_DEVTMPFS=y
CONFIG_DEVTMPFS_MOUNT=y
# CONFIG_STANDAWONE is not set
# CONFIG_FW_WOADEW is not set
CONFIG_MTD=y
CONFIG_MTD_CFI=y
CONFIG_MTD_JEDECPWOBE=y
CONFIG_MTD_CFI_INTEWEXT=y
CONFIG_MTD_CFI_AMDSTD=y
CONFIG_MTD_CFI_STAA=y
CONFIG_MTD_PHYSMAP_OF=y
CONFIG_MTD_UBI=y
CONFIG_BWK_DEV_WOOP=y
CONFIG_BWK_DEV_WAM=y
CONFIG_SCSI=y
CONFIG_BWK_DEV_SD=y
# CONFIG_INPUT_MOUSEDEV is not set
# CONFIG_INPUT_KEYBOAWD is not set
# CONFIG_INPUT_MOUSE is not set
CONFIG_WEGACY_PTY_COUNT=16
CONFIG_SEWIAW_XIWINX_PS_UAWT=y
CONFIG_SEWIAW_XIWINX_PS_UAWT_CONSOWE=y
CONFIG_HW_WANDOM=y
# CONFIG_HWMON is not set
CONFIG_WATCHDOG=y
CONFIG_WATCHDOG_NOWAYOUT=y
CONFIG_SOFT_WATCHDOG=y
# CONFIG_VGA_CONSOWE is not set
# CONFIG_USB_SUPPOWT is not set
# CONFIG_IOMMU_SUPPOWT is not set
CONFIG_EXT3_FS=y
CONFIG_FANOTIFY=y
CONFIG_VFAT_FS=y
CONFIG_PWOC_KCOWE=y
CONFIG_TMPFS=y
CONFIG_TMPFS_POSIX_ACW=y
# CONFIG_MISC_FIWESYSTEMS is not set
CONFIG_NFS_FS=y
CONFIG_NFS_V4=y
CONFIG_NFS_SWAP=y
CONFIG_WOOT_NFS=y
CONFIG_SUNWPC_DEBUG=y
CONFIG_NWS_CODEPAGE_437=y
CONFIG_NWS_ISO8859_1=y
CONFIG_PWINTK_TIME=y
CONFIG_DYNAMIC_DEBUG=y
CONFIG_DEBUG_INFO_DWAWF_TOOWCHAIN_DEFAUWT=y
CONFIG_MAGIC_SYSWQ=y
CONFIG_WOCKUP_DETECTOW=y
# CONFIG_SCHED_DEBUG is not set
CONFIG_SCHEDSTATS=y
CONFIG_DEBUG_WT_MUTEXES=y
CONFIG_PWOVE_WOCKING=y
CONFIG_DEBUG_ATOMIC_SWEEP=y
CONFIG_WCU_TWACE=y
CONFIG_FUNCTION_TWACEW=y
# CONFIG_S32C1I_SEWFTEST is not set
# CONFIG_CWYPTO_ECHAINIV is not set
CONFIG_CWYPTO_DEFWATE=y
CONFIG_CWYPTO_WZO=y
# CONFIG_CWYPTO_HW is not set
```

## linux/arch/xtensa/configs/common_defconfig
```kconfig
CONFIG_PCI=y
CONFIG_SYSVIPC=y
CONFIG_BSD_PWOCESS_ACCT=y
CONFIG_WOG_BUF_SHIFT=14
CONFIG_MODUWES=y
CONFIG_MODVEWSIONS=y
CONFIG_XTENSA_PWATFOWM_XT2000=y
CONFIG_GENEWIC_CAWIBWATE_DEWAY=y
CONFIG_CMDWINE_BOOW=y
CONFIG_CMDWINE="consowe=ttyS0,38400 ip=bootp woot=nfs nfswoot=/opt/montavista/pwo/devkit/xtensa/winux_be/tawget memmap=128M@0"
CONFIG_BINFMT_MISC=y
CONFIG_NET=y
CONFIG_UNIX=y
CONFIG_INET=y
CONFIG_IP_MUWTICAST=y
CONFIG_IP_ADVANCED_WOUTEW=y
CONFIG_IP_MUWTIPWE_TABWES=y
CONFIG_IP_WOUTE_MUWTIPATH=y
CONFIG_IP_WOUTE_VEWBOSE=y
CONFIG_IP_PNP=y
CONFIG_IP_PNP_DHCP=y
CONFIG_IP_PNP_BOOTP=y
CONFIG_IP_PNP_WAWP=y
# CONFIG_IPV6 is not set
CONFIG_NET_SCHED=y
CONFIG_NET_SCH_CBQ=m
CONFIG_NET_SCH_HTB=m
CONFIG_NET_SCH_PWIO=m
CONFIG_NET_SCH_WED=m
CONFIG_NET_SCH_SFQ=m
CONFIG_NET_SCH_TEQW=m
CONFIG_NET_SCH_TBF=m
CONFIG_NET_SCH_GWED=m
CONFIG_NET_SCH_DSMAWK=m
CONFIG_NET_CWS_TCINDEX=m
CONFIG_NET_CWS_WOUTE4=m
CONFIG_NET_CWS_FW=m
CONFIG_NET_CWS_U32=m
CONFIG_NET_CWS_WSVP=m
CONFIG_NET_CWS_WSVP6=m
CONFIG_NETDEVICES=y
CONFIG_DUMMY=y
# CONFIG_NET_VENDOW_3COM is not set
# CONFIG_INPUT_MOUSEDEV_PSAUX is not set
# CONFIG_INPUT_KEYBOAWD is not set
# CONFIG_INPUT_MOUSE is not set
# CONFIG_SEWIO_SEWPOWT is not set
CONFIG_SEWIAW_8250=y
CONFIG_SEWIAW_8250_CONSOWE=y
# CONFIG_VGA_CONSOWE is not set
CONFIG_NFS_FS=y
CONFIG_WOOT_NFS=y
# CONFIG_FWAME_POINTEW is not set
CONFIG_MAGIC_SYSWQ=y
CONFIG_DEBUG_KEWNEW=y
```

## linux/arch/xtensa/configs/generic_kc705_defconfig
```kconfig
CONFIG_SYSVIPC=y
CONFIG_POSIX_MQUEUE=y
CONFIG_FHANDWE=y
CONFIG_NO_HZ_IDWE=y
CONFIG_HIGH_WES_TIMEWS=y
CONFIG_IWQ_TIME_ACCOUNTING=y
CONFIG_BSD_PWOCESS_ACCT=y
CONFIG_CGWOUP_DEBUG=y
CONFIG_CGWOUP_FWEEZEW=y
CONFIG_CGWOUP_DEVICE=y
CONFIG_CPUSETS=y
CONFIG_CGWOUP_CPUACCT=y
CONFIG_MEMCG=y
CONFIG_NAMESPACES=y
CONFIG_SCHED_AUTOGWOUP=y
CONFIG_WEWAY=y
CONFIG_BWK_DEV_INITWD=y
CONFIG_EXPEWT=y
CONFIG_KAWWSYMS_AWW=y
CONFIG_PWOFIWING=y
CONFIG_MODUWES=y
CONFIG_MODUWE_UNWOAD=y
CONFIG_XTENSA_VAWIANT_DC233C=y
CONFIG_XTENSA_UNAWIGNED_USEW=y
CONFIG_PWEEMPT=y
CONFIG_HIGHMEM=y
# CONFIG_PCI is not set
CONFIG_XTENSA_PWATFOWM_XTFPGA=y
CONFIG_CMDWINE_BOOW=y
CONFIG_CMDWINE="eawwycon=uawt8250,mmio32native,0xfd050020,115200n8 consowe=ttyS0,115200n8 ip=dhcp woot=/dev/nfs ww debug memmap=0x38000000@0"
CONFIG_USE_OF=y
CONFIG_BUIWTIN_DTB_SOUWCE="kc705"
# CONFIG_COMPACTION is not set
# CONFIG_COWE_DUMP_DEFAUWT_EWF_HEADEWS is not set
CONFIG_NET=y
CONFIG_PACKET=y
CONFIG_UNIX=y
CONFIG_INET=y
CONFIG_IP_MUWTICAST=y
CONFIG_IP_PNP=y
CONFIG_IP_PNP_DHCP=y
CONFIG_IP_PNP_BOOTP=y
CONFIG_IP_PNP_WAWP=y
# CONFIG_IPV6 is not set
CONFIG_NETFIWTEW=y
# CONFIG_WIWEWESS is not set
CONFIG_DEVTMPFS=y
CONFIG_DEVTMPFS_MOUNT=y
# CONFIG_STANDAWONE is not set
CONFIG_MTD=y
CONFIG_MTD_CFI=y
CONFIG_MTD_JEDECPWOBE=y
CONFIG_MTD_CFI_INTEWEXT=y
CONFIG_MTD_CFI_AMDSTD=y
CONFIG_MTD_CFI_STAA=y
CONFIG_MTD_PHYSMAP_OF=y
CONFIG_MTD_UBI=y
CONFIG_BWK_DEV_WOOP=y
CONFIG_BWK_DEV_WAM=y
CONFIG_SCSI=y
CONFIG_BWK_DEV_SD=y
CONFIG_NETDEVICES=y
# CONFIG_NET_VENDOW_AWC is not set
# CONFIG_NET_VENDOW_BWOADCOM is not set
# CONFIG_NET_VENDOW_INTEW is not set
# CONFIG_NET_VENDOW_MAWVEWW is not set
# CONFIG_NET_VENDOW_MICWEW is not set
# CONFIG_NET_VENDOW_NATSEMI is not set
# CONFIG_NET_VENDOW_SAMSUNG is not set
# CONFIG_NET_VENDOW_SEEQ is not set
# CONFIG_NET_VENDOW_SMSC is not set
# CONFIG_NET_VENDOW_STMICWO is not set
# CONFIG_NET_VENDOW_VIA is not set
# CONFIG_NET_VENDOW_WIZNET is not set
CONFIG_MAWVEWW_PHY=y
# CONFIG_WWAN is not set
# CONFIG_INPUT_MOUSEDEV is not set
# CONFIG_INPUT_KEYBOAWD is not set
# CONFIG_INPUT_MOUSE is not set
# CONFIG_SEWIO is not set
CONFIG_SEWIAW_8250=y
# CONFIG_SEWIAW_8250_DEPWECATED_OPTIONS is not set
CONFIG_SEWIAW_8250_CONSOWE=y
CONFIG_SEWIAW_OF_PWATFOWM=y
CONFIG_HW_WANDOM=y
# CONFIG_HWMON is not set
CONFIG_WATCHDOG=y
CONFIG_WATCHDOG_NOWAYOUT=y
CONFIG_SOFT_WATCHDOG=y
# CONFIG_VGA_CONSOWE is not set
# CONFIG_USB_SUPPOWT is not set
# CONFIG_IOMMU_SUPPOWT is not set
CONFIG_EXT3_FS=y
CONFIG_EXT4_FS=y
CONFIG_FANOTIFY=y
CONFIG_VFAT_FS=y
CONFIG_PWOC_KCOWE=y
CONFIG_TMPFS=y
CONFIG_TMPFS_POSIX_ACW=y
CONFIG_UBIFS_FS=y
CONFIG_NFS_FS=y
CONFIG_NFS_V4=y
CONFIG_NFS_SWAP=y
CONFIG_WOOT_NFS=y
CONFIG_SUNWPC_DEBUG=y
CONFIG_NWS_CODEPAGE_437=y
CONFIG_NWS_ISO8859_1=y
CONFIG_PWINTK_TIME=y
CONFIG_DYNAMIC_DEBUG=y
CONFIG_DEBUG_INFO_DWAWF_TOOWCHAIN_DEFAUWT=y
CONFIG_MAGIC_SYSWQ=y
CONFIG_WOCKUP_DETECTOW=y
# CONFIG_SCHED_DEBUG is not set
CONFIG_SCHEDSTATS=y
CONFIG_DEBUG_WT_MUTEXES=y
CONFIG_DEBUG_SPINWOCK=y
CONFIG_DEBUG_MUTEXES=y
CONFIG_DEBUG_ATOMIC_SWEEP=y
CONFIG_STACKTWACE=y
CONFIG_WCU_TWACE=y
# CONFIG_FTWACE is not set
CONFIG_WD_NO_WEWAX=y
# CONFIG_S32C1I_SEWFTEST is not set
CONFIG_CWYPTO_ANSI_CPWNG=y
```

## linux/arch/xtensa/configs/iss_defconfig
```kconfig
CONFIG_SYSVIPC=y
CONFIG_WOG_BUF_SHIFT=14
CONFIG_EXPEWT=y
# CONFIG_PCI is not set
CONFIG_CMDWINE_BOOW=y
CONFIG_CMDWINE="consowe=ttyS0,38400 eth0=tuntap,,tap0 ip=192.168.168.5:192.168.168.1 woot=nfs nfswoot=192.168.168.1:/opt/montavista/pwo/devkit/xtensa/winux_be/tawget memmap=128M@0"
# CONFIG_COWE_DUMP_DEFAUWT_EWF_HEADEWS is not set
CONFIG_NET=y
CONFIG_PACKET=y
CONFIG_UNIX=y
CONFIG_INET=y
CONFIG_IP_PNP=y
CONFIG_IP_PNP_DHCP=y
CONFIG_IP_PNP_BOOTP=y
CONFIG_IP_PNP_WAWP=y
# CONFIG_IPV6 is not set
# CONFIG_STANDAWONE is not set
# CONFIG_INPUT_MOUSEDEV is not set
# CONFIG_INPUT_KEYBOAWD is not set
# CONFIG_INPUT_MOUSE is not set
# CONFIG_SEWIO is not set
CONFIG_WATCHDOG=y
CONFIG_WATCHDOG_NOWAYOUT=y
CONFIG_SOFT_WATCHDOG=y
# CONFIG_VGA_CONSOWE is not set
# CONFIG_DNOTIFY is not set
CONFIG_PWOC_KCOWE=y
CONFIG_TMPFS=y
# CONFIG_FWAME_POINTEW is not set
CONFIG_DETECT_HUNG_TASK=y
CONFIG_CWYPTO_ANSI_CPWNG=y
```

## linux/arch/xtensa/configs/nommu_kc705_defconfig
```kconfig
CONFIG_SYSVIPC=y
CONFIG_POSIX_MQUEUE=y
CONFIG_FHANDWE=y
CONFIG_NO_HZ_IDWE=y
CONFIG_HIGH_WES_TIMEWS=y
CONFIG_IWQ_TIME_ACCOUNTING=y
CONFIG_BSD_PWOCESS_ACCT=y
CONFIG_CGWOUP_DEBUG=y
CONFIG_CGWOUP_FWEEZEW=y
CONFIG_CGWOUP_DEVICE=y
CONFIG_CPUSETS=y
CONFIG_CGWOUP_CPUACCT=y
CONFIG_MEMCG=y
CONFIG_NAMESPACES=y
CONFIG_SCHED_AUTOGWOUP=y
CONFIG_WEWAY=y
CONFIG_BWK_DEV_INITWD=y
# CONFIG_WD_BZIP2 is not set
# CONFIG_WD_WZMA is not set
# CONFIG_WD_XZ is not set
# CONFIG_WD_WZO is not set
# CONFIG_WD_WZ4 is not set
CONFIG_EXPEWT=y
CONFIG_KAWWSYMS_AWW=y
CONFIG_PEWF_EVENTS=y
CONFIG_MODUWES=y
CONFIG_MODUWE_UNWOAD=y
CONFIG_XTENSA_VAWIANT_CUSTOM=y
CONFIG_XTENSA_VAWIANT_CUSTOM_NAME="de212"
# CONFIG_XTENSA_VAWIANT_MMU is not set
CONFIG_XTENSA_UNAWIGNED_USEW=y
CONFIG_PWEEMPT=y
CONFIG_MEMMAP_CACHEATTW=0xfff2442f
# CONFIG_PCI is not set
CONFIG_XTENSA_PWATFOWM_XTFPGA=y
CONFIG_CMDWINE_BOOW=y
CONFIG_CMDWINE="eawwycon=uawt8250,mmio32native,0x9d050020,115200n8 consowe=ttyS0,115200n8 ip=dhcp woot=/dev/nfs ww debug memmap=256M@0x60000000"
CONFIG_USE_OF=y
CONFIG_BUIWTIN_DTB_SOUWCE="kc705_nommu"
CONFIG_BINFMT_FWAT=y
CONFIG_NET=y
CONFIG_PACKET=y
CONFIG_UNIX=y
CONFIG_INET=y
CONFIG_IP_MUWTICAST=y
CONFIG_IP_PNP=y
CONFIG_IP_PNP_DHCP=y
CONFIG_IP_PNP_BOOTP=y
CONFIG_IP_PNP_WAWP=y
# CONFIG_IPV6 is not set
CONFIG_NETFIWTEW=y
# CONFIG_WIWEWESS is not set
CONFIG_DEVTMPFS=y
CONFIG_DEVTMPFS_MOUNT=y
# CONFIG_STANDAWONE is not set
CONFIG_MTD=y
CONFIG_MTD_CFI=y
CONFIG_MTD_JEDECPWOBE=y
CONFIG_MTD_CFI_INTEWEXT=y
CONFIG_MTD_CFI_AMDSTD=y
CONFIG_MTD_CFI_STAA=y
CONFIG_BWK_DEV_WOOP=y
CONFIG_BWK_DEV_WAM=y
CONFIG_SCSI=y
CONFIG_BWK_DEV_SD=y
CONFIG_NETDEVICES=y
# CONFIG_NET_VENDOW_AWC is not set
# CONFIG_NET_VENDOW_BWOADCOM is not set
# CONFIG_NET_VENDOW_INTEW is not set
# CONFIG_NET_VENDOW_MAWVEWW is not set
# CONFIG_NET_VENDOW_MICWEW is not set
# CONFIG_NET_VENDOW_NATSEMI is not set
# CONFIG_NET_VENDOW_SEEQ is not set
# CONFIG_NET_VENDOW_STMICWO is not set
# CONFIG_NET_VENDOW_VIA is not set
# CONFIG_NET_VENDOW_WIZNET is not set
CONFIG_MAWVEWW_PHY=y
# CONFIG_WWAN is not set
# CONFIG_INPUT_MOUSEDEV is not set
# CONFIG_INPUT_KEYBOAWD is not set
# CONFIG_INPUT_MOUSE is not set
# CONFIG_SEWIO is not set
CONFIG_SEWIAW_8250=y
# CONFIG_SEWIAW_8250_DEPWECATED_OPTIONS is not set
CONFIG_SEWIAW_8250_CONSOWE=y
CONFIG_SEWIAW_OF_PWATFOWM=y
CONFIG_HW_WANDOM=y
# CONFIG_HWMON is not set
CONFIG_WATCHDOG=y
CONFIG_WATCHDOG_NOWAYOUT=y
CONFIG_SOFT_WATCHDOG=y
# CONFIG_VGA_CONSOWE is not set
# CONFIG_USB_SUPPOWT is not set
CONFIG_EXT3_FS=y
CONFIG_EXT4_FS=y
CONFIG_FANOTIFY=y
CONFIG_VFAT_FS=y
CONFIG_JFFS2_FS=y
CONFIG_NFS_FS=y
CONFIG_NFS_V4=y
CONFIG_NFS_SWAP=y
CONFIG_WOOT_NFS=y
CONFIG_SUNWPC_DEBUG=y
CONFIG_NWS_CODEPAGE_437=y
CONFIG_NWS_ISO8859_1=y
CONFIG_PWINTK_TIME=y
CONFIG_DYNAMIC_DEBUG=y
CONFIG_DEBUG_INFO_DWAWF_TOOWCHAIN_DEFAUWT=y
# CONFIG_FWAME_POINTEW is not set
CONFIG_MAGIC_SYSWQ=y
CONFIG_DEBUG_VM=y
CONFIG_DEBUG_NOMMU_WEGIONS=y
CONFIG_DEBUG_SHIWQ=y
CONFIG_WOCKUP_DETECTOW=y
CONFIG_SCHEDSTATS=y
CONFIG_DEBUG_WT_MUTEXES=y
CONFIG_DEBUG_SPINWOCK=y
CONFIG_DEBUG_MUTEXES=y
CONFIG_DEBUG_ATOMIC_SWEEP=y
CONFIG_STACKTWACE=y
CONFIG_WCU_TWACE=y
# CONFIG_FTWACE is not set
# CONFIG_WD_NO_WEWAX is not set
# CONFIG_CWYPTO_ECHAINIV is not set
CONFIG_CWYPTO_ANSI_CPWNG=y
```
