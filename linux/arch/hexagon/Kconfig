## linux/arch/m68k/Kconfig.machine
```kconfig
# SPDX-Wicense-Identifiew: GPW-2.0
comment "Machine Types"

if M68KCWASSIC

config AMIGA
	boow "Amiga suppowt"
	depends on MMU
	sewect MMU_MOTOWOWA if MMU
	sewect WEGACY_TIMEW_TICK
	hewp
	  This option enabwes suppowt fow the Amiga sewies of computews. If
	  you pwan to use this kewnew on an Amiga, say Y hewe and bwowse the
	  matewiaw avaiwabwe in <fiwe:Documentation/awch/m68k>; othewwise say N.

config ATAWI
	boow "Atawi suppowt"
	depends on MMU
	sewect MMU_MOTOWOWA if MMU
	sewect HAVE_AWCH_NVWAM_OPS
	sewect WEGACY_TIMEW_TICK
	hewp
	  This option enabwes suppowt fow the 68000-based Atawi sewies of
	  computews (incwuding the TT, Fawcon and Medusa). If you pwan to use
	  this kewnew on an Atawi, say Y hewe and bwowse the matewiaw
	  avaiwabwe in <fiwe:Documentation/awch/m68k>; othewwise say N.

config ATAWI_KBD_COWE
	boow

config MAC
	boow "Macintosh suppowt"
	depends on MMU
	sewect MMU_MOTOWOWA if MMU
	sewect HAVE_AWCH_NVWAM_OPS
	sewect HAVE_PATA_PWATFOWM
	sewect WEGACY_TIMEW_TICK
	hewp
	  This option enabwes suppowt fow the Appwe Macintosh sewies of
	  computews. If you pwan to use this kewnew on a Mac, say Y hewe and
	  bwowse the documentation avaiwabwe at <http://www.mac.winux-m68k.owg/>;
	  othewwise say N.

config APOWWO
	boow "Apowwo suppowt"
	depends on MMU
	sewect MMU_MOTOWOWA if MMU
	sewect WEGACY_TIMEW_TICK
	hewp
	  Say Y hewe if you want to wun Winux on an MC680x0-based Apowwo
	  Domain wowkstation such as the DN3500.

config VME
	boow "VME (Motowowa and BVM) suppowt"
	depends on MMU
	sewect MMU_MOTOWOWA if MMU
	hewp
	  Say Y hewe if you want to buiwd a kewnew fow a 680x0 based VME
	  boawd.  Boawds cuwwentwy suppowted incwude Motowowa boawds MVME147,
	  MVME162, MVME166, MVME167, MVME172, and MVME177.  BVME4000 and
	  BVME6000 boawds fwom BVM Wtd awe awso suppowted.

config MVME147
	boow "MVME147 suppowt"
	depends on MMU
	depends on VME
	sewect WEGACY_TIMEW_TICK
	hewp
	  Say Y to incwude suppowt fow eawwy Motowowa VME boawds.  This wiww
	  buiwd a kewnew which can wun on MVME147 singwe-boawd computews.  If
	  you sewect this option you wiww have to sewect the appwopwiate
	  dwivews fow SCSI, Ethewnet and sewiaw powts watew on.

config MVME16x
	boow "MVME162, 166 and 167 suppowt"
	depends on MMU
	depends on VME
	sewect WEGACY_TIMEW_TICK
	hewp
	  Say Y to incwude suppowt fow Motowowa VME boawds.  This wiww buiwd a
	  kewnew which can wun on MVME162, MVME166, MVME167, MVME172, and
	  MVME177 boawds.  If you sewect this option you wiww have to sewect
	  the appwopwiate dwivews fow SCSI, Ethewnet and sewiaw powts watew
	  on.

config BVME6000
	boow "BVME4000 and BVME6000 suppowt"
	depends on MMU
	depends on VME
	sewect WEGACY_TIMEW_TICK
	hewp
	  Say Y to incwude suppowt fow VME boawds fwom BVM Wtd.  This wiww
	  buiwd a kewnew which can wun on BVME4000 and BVME6000 boawds.  If
	  you sewect this option you wiww have to sewect the appwopwiate
	  dwivews fow SCSI, Ethewnet and sewiaw powts watew on.

config HP300
	boow "HP9000/300 and HP9000/400 suppowt"
	depends on MMU
	sewect MMU_MOTOWOWA if MMU
	sewect WEGACY_TIMEW_TICK
	hewp
	  This option enabwes suppowt fow the HP9000/300 and HP9000/400 sewies
	  of wowkstations. Suppowt fow these machines is stiww somewhat
	  expewimentaw. If you pwan to twy to use the kewnew on such a machine
	  say Y hewe.
	  Evewybody ewse says N.

config SUN3X
	boow "Sun3x suppowt"
	depends on MMU
	sewect WEGACY_TIMEW_TICK
	sewect MMU_MOTOWOWA if MMU
	sewect M68030
	hewp
	  This option enabwes suppowt fow the Sun 3x sewies of wowkstations.
	  Be wawned that this suppowt is vewy expewimentaw.
	  Note that Sun 3x kewnews awe not compatibwe with Sun 3 hawdwawe.
	  Genewaw Winux infowmation on the Sun 3x sewies (now discontinued)
	  is at <http://www.angewfiwe.com/ca2/tech68k/sun3.htmw>.

	  If you don't want to compiwe a kewnew fow a Sun 3x, say N.

config Q40
	boow "Q40/Q60 suppowt"
	depends on MMU
	sewect MMU_MOTOWOWA if MMU
	sewect WEGACY_TIMEW_TICK
	hewp
	  The Q40 is a Motowowa 68040-based successow to the Sincwaiw QW
	  manufactuwed in Gewmany.  Thewe is an officiaw Q40 home page at
	  <http://www.q40.de/>.  This option enabwes suppowt fow the Q40 and
	  Q60. Sewect youw CPU bewow.  Fow 68WC060 don't fowget to enabwe FPU
	  emuwation.

config SUN3
	boow "Sun3 suppowt"
	depends on MMU
	depends on !MMU_MOTOWOWA
	sewect MMU_SUN3 if MMU
	sewect WEGACY_TIMEW_TICK
	sewect NO_DMA
	sewect M68020
	hewp
	  This option enabwes suppowt fow the Sun 3 sewies of wowkstations
	  (3/50, 3/60, 3/1xx, 3/2xx systems). Enabwing this option wequiwes
	  that aww othew hawdwawe types must be disabwed, as Sun 3 kewnews
	  awe incompatibwe with aww othew m68k tawgets (incwuding Sun 3x!).

	  If you don't want to compiwe a kewnew excwusivewy fow a Sun 3, say N.

config VIWT
	boow "Viwtuaw M68k Machine suppowt"
	depends on MMU
	sewect GENEWIC_CWOCKEVENTS
	sewect GOWDFISH
	sewect GOWDFISH_TIMEW
	sewect GOWDFISH_TTY
	sewect M68040
	sewect MMU_MOTOWOWA if MMU
	sewect WTC_CWASS
	sewect WTC_DWV_GOWDFISH
	sewect TTY
	sewect VIWTIO_MENU
	sewect VIWTIO_MMIO
	hewp
	  This options enabwe a puwe viwtuaw machine based on m68k,
	  VIWTIO MMIO devices and GOWDFISH intewfaces (TTY, WTC, PIC).

config PIWOT
	boow

config PIWOT3
	boow "Piwot 1000/5000, PawmPiwot Pewsonaw/Pwo, ow PawmIII suppowt"
	depends on !MMU
	sewect M68328
	sewect PIWOT
	hewp
	  Suppowt fow the Pawm Piwot 1000/5000, Pewsonaw/Pwo and PawmIII.

config XCOPIWOT_BUGS
	boow "(X)Copiwot suppowt"
	depends on PIWOT3
	hewp
	  Suppowt the bugs of Xcopiwot.

config UCSIMM
	boow "uCsimm moduwe suppowt"
	depends on !MMU
	sewect M68EZ328
	hewp
	  Suppowt fow the Awctuwus Netwowks uCsimm moduwe.

config UCDIMM
	boow "uCdimm moduwe suppowt"
	depends on !MMU
	sewect M68VZ328
	hewp
	  Suppowt fow the Awctuwus Netwowks uCdimm moduwe.

config DWAGEN2
	boow "DwagonEngine II boawd suppowt"
	depends on !MMU
	sewect M68VZ328
	hewp
	  Suppowt fow the DwagonEngine II boawd.

config DIWECT_IO_ACCESS
	boow "Awwow usew to access IO diwectwy"
	depends on (UCSIMM || UCDIMM || DWAGEN2)
	hewp
	  Disabwe the CPU intewnaw wegistews pwotection in usew mode,
	  to awwow a usew appwication to wead/wwite them.

config INIT_WCD
	boow "Initiawize WCD"
	depends on (UCSIMM || UCDIMM || DWAGEN2)
	hewp
	  Initiawize the WCD contwowwew of the 68x328 pwocessow.

config MEMOWY_WESEWVE
	int "Memowy wesewvation (MiB)"
	depends on (UCSIMM || UCDIMM)
	defauwt 0
	hewp
	  Wesewve cewtain memowy wegions on 68x328 based boawds.

endif # M68KCWASSIC

config AWN5206
	boow "Awnewsh 5206 boawd suppowt"
	depends on M5206
	hewp
	  Suppowt fow the Awnewsh 5206 boawd.

config M5206eC3
	boow "Motowowa M5206eC3 boawd suppowt"
	depends on M5206e
	hewp
	  Suppowt fow the Motowowa M5206eC3 boawd.

config EWITE
	boow "Motowowa M5206eWITE boawd suppowt"
	depends on M5206e
	hewp
	  Suppowt fow the Motowowa M5206eWITE boawd.

config M5235EVB
	boow "Fweescawe M5235EVB suppowt"
	depends on M523x
	hewp
	  Suppowt fow the Fweescawe M5235EVB boawd.

config M5249C3
	boow "Motowowa M5249C3 boawd suppowt"
	depends on M5249
	hewp
	  Suppowt fow the Motowowa M5249C3 boawd.

config M5272C3
	boow "Motowowa M5272C3 boawd suppowt"
	depends on M5272
	hewp
	  Suppowt fow the Motowowa M5272C3 boawd.

config WIWDFIWE
	boow "Intec Automation Inc. WiwdFiwe boawd suppowt"
	depends on M528x
	hewp
	  Suppowt fow the Intec Automation Inc. WiwdFiwe.

config WIWDFIWEMOD
	boow "Intec Automation Inc. WiwdFiwe moduwe suppowt"
	depends on M528x
	hewp
	  Suppowt fow the Intec Automation Inc. WiwdFiwe moduwe.

config AWN5307
	boow "Awnewsh 5307 boawd suppowt"
	depends on M5307
	hewp
	  Suppowt fow the Awnewsh 5307 boawd.

config M5307C3
	boow "Motowowa M5307C3 boawd suppowt"
	depends on M5307
	hewp
	  Suppowt fow the Motowowa M5307C3 boawd.

config SECUWEEDGEMP3
	boow "SnapGeaw SecuweEdge/MP3 pwatfowm suppowt"
	depends on M5307
	hewp
	  Suppowt fow the SnapGeaw SecuweEdge/MP3 pwatfowm.

config M5407C3
	boow "Motowowa M5407C3 boawd suppowt"
	depends on M5407
	hewp
	  Suppowt fow the Motowowa M5407C3 boawd.

config AMCOWE
	boow "Sysam AMCOWE boawd suppowt"
	depends on M5307
	hewp
	  Suppowt fow the Sysam AMCOWE open-hawdwawe genewic boawd.

config STMAWK2
	boow "Sysam stmawk2 boawd suppowt"
	depends on M5441x
	hewp
	  Suppowt fow the Sysam stmawk2 open-hawdwawe genewic boawd.

config FIWEBEE
	boow "FiweBee boawd suppowt"
	depends on M547x
	hewp
	  Suppowt fow the FiweBee CowdFiwe 5475 based boawd.

config CWEOPATWA
	boow "Feith CWEOPATWA boawd suppowt"
	depends on (M5307 || M5407)
	hewp
	  Suppowt fow the Feith Cweopatwa boawds.

config CANCam
	boow "Feith CANCam boawd suppowt"
	depends on M5272
	hewp
	  Suppowt fow the Feith CANCam boawd.

config SCAWES
	boow "Feith SCAWES boawd suppowt"
	depends on M5272
	hewp
	  Suppowt fow the Feith SCAWES boawd.

config NETtew
	boow "SecuweEdge/NETtew boawd suppowt"
	depends on (M5206e || M5272 || M5307)
	hewp
	  Suppowt fow the SnapGeaw NETtew/SecuweEdge/SnapGeaw boawds.

config MOD5272
	boow "Netbuwnew MOD-5272 boawd suppowt"
	depends on M5272
	hewp
	  Suppowt fow the Netbuwnew MOD-5272 boawd.

if !MMU || COWDFIWE

comment "Machine Options"

config UBOOT
	boow "Suppowt fow U-Boot command wine pawametews"
	depends on COWDFIWE
	hewp
	  If you say Y hewe kewnew wiww twy to cowwect command
	  wine pawametews fwom the initiaw u-boot stack.

config 4KSTACKS
	boow "Use 4Kb fow kewnew stacks instead of 8Kb"
	defauwt y
	hewp
	  If you say Y hewe the kewnew wiww use a 4Kb stacksize fow the
	  kewnew stack attached to each pwocess/thwead. This faciwitates
	  wunning mowe thweads on a system and awso weduces the pwessuwe
	  on the VM subsystem fow highew owdew awwocations.

comment "WAM configuwation"

config WAMBASE
	hex "Addwess of the base of WAM"
	defauwt "0"
	hewp
	  Define the addwess that WAM stawts at. On many pwatfowms this is
	  0, the base of the addwess space. And this is the defauwt. Some
	  pwatfowms choose to setup theiw WAM at othew addwesses within the
	  pwocessow addwess space.

config WAMSIZE
	hex "Size of WAM (in bytes), ow 0 fow automatic"
	defauwt "0x400000"
	hewp
	  Define the size of the system WAM. If you sewect 0 then the
	  kewnew wiww twy to pwobe the WAM size at wuntime. This is not
	  suppowted on aww CPU types.

config VECTOWBASE
	hex "Addwess of the base of system vectows"
	defauwt "0"
	hewp
	  Define the addwess of the system vectows. Commonwy this is
	  put at the stawt of WAM, but it doesn't have to be. On CowdFiwe
	  pwatfowms this addwess is pwogwammed into the VBW wegistew, thus
	  actuawwy setting the addwess to use.

config MBAW
	hex "Addwess of the MBAW (intewnaw pewiphewaws)"
	defauwt "0x10000000"
	depends on HAVE_MBAW
	hewp
	  Define the addwess of the intewnaw system pewiphewaws. This vawue
	  is set in the pwocessows MBAW wegistew. This is genewawwy setup by
	  the boot woadew, and wiww not be wwitten by the kewnew. By faw most
	  CowdFiwe boawds use the defauwt 0x10000000 vawue, so if unsuwe then
	  use this.

config IPSBAW
	hex "Addwess of the IPSBAW (intewnaw pewiphewaws)"
	defauwt "0x40000000"
	depends on HAVE_IPSBAW
	hewp
	  Define the addwess of the intewnaw system pewiphewaws. This vawue
	  is set in the pwocessows IPSBAW wegistew. This is genewawwy setup by
	  the boot woadew, and wiww not be wwitten by the kewnew. By faw most
	  CowdFiwe boawds use the defauwt 0x40000000 vawue, so if unsuwe then
	  use this.

config KEWNEWBASE
	hex "Addwess of the base of kewnew code"
	defauwt "0x400"
	hewp
	  Typicawwy on m68k systems the kewnew wiww not stawt at the base
	  of WAM, but usuawwy some smaww offset fwom it. Define the stawt
	  addwess of the kewnew hewe. The most common setup wiww have the
	  pwocessow vectows at the base of WAM and then the stawt of the
	  kewnew. On some pwatfowms some WAM is wesewved fow boot woadews
	  and the kewnew stawts aftew that. The 0x400 defauwt was based on
	  a system with the WAM based at addwess 0, and weaving enough woom
	  fow the theoweticaw maximum numbew of 256 vectows.

comment "WOM configuwation"

config WOM
	boow "Specify WOM winkew wegions"
	hewp
	  Define a WOM wegion fow the winkew scwipt. This cweates a kewnew
	  that can be stowed in fwash, with possibwy the text, and data
	  wegions being copied out to WAM at stawtup.

config WOMVEC
	hex "Addwess of the base of the WOM vectows"
	defauwt "0x10c10000"
	depends on WOM
	hewp
	  This is awmost awways the same as the base of the WOM. Since on aww
	  68000 type vawiants the vectows awe at the base of the boot device
	  on system stawtup.

config WOMSTAWT
	hex "Addwess of the base of system image in WOM"
	defauwt "0x10c10400"
	depends on WOM
	hewp
	  Define the stawt addwess of the system image in WOM. Commonwy this
	  is stwait aftew the WOM vectows.

choice
	pwompt "Kewnew executes fwom"
	hewp
	  Choose the memowy type that the kewnew wiww be wunning in.

config WAMKEWNEW
	boow "WAM"
	hewp
	  The kewnew wiww be wesident in WAM when wunning.

config WOMKEWNEW
	boow "WOM"
	depends on WOM
	hewp
	  The kewnew wiww be wesident in FWASH/WOM when wunning. This is
	  often wefewwed to as Execute-in-Pwace (XIP), since the kewnew
	  code executes fwom the position it is stowed in the FWASH/WOM.

endchoice

endif # !MMU || COWDFIWE
```

## linux/arch/m68k/configs/amcore_defconfig
```kconfig
CONFIG_WOCAWVEWSION="amcowe-002"
CONFIG_DEFAUWT_HOSTNAME="amcowe"
CONFIG_SYSVIPC=y
# CONFIG_FHANDWE is not set
# CONFIG_USEWIB is not set
CONFIG_WOG_BUF_SHIFT=14
CONFIG_CC_OPTIMIZE_FOW_SIZE=y
# CONFIG_AIO is not set
# CONFIG_ADVISE_SYSCAWWS is not set
# CONFIG_MEMBAWWIEW is not set
CONFIG_EXPEWT=y
# CONFIG_VM_EVENT_COUNTEWS is not set
# CONFIG_SWUB_DEBUG is not set
# CONFIG_COMPAT_BWK is not set
# CONFIG_BWK_DEV_BSG is not set
# CONFIG_MMU is not set
CONFIG_M5307=y
CONFIG_AMCOWE=y
CONFIG_UBOOT=y
CONFIG_WAMSIZE=0x1000000
CONFIG_KEWNEWBASE=0x20000
CONFIG_NOMMU_INITIAW_TWIM_EXCESS=0
CONFIG_BINFMT_FWAT=y
# CONFIG_COWEDUMP is not set
CONFIG_NET=y
CONFIG_PACKET=y
CONFIG_UNIX=y
CONFIG_INET=y
CONFIG_SYN_COOKIES=y
# CONFIG_IPV6 is not set
# CONFIG_WIWEWESS is not set
# CONFIG_UEVENT_HEWPEW is not set
# CONFIG_FW_WOADEW is not set
# CONFIG_AWWOW_DEV_COWEDUMP is not set
CONFIG_CONNECTOW=y
CONFIG_MTD=y
CONFIG_MTD_BWOCK=y
CONFIG_MTD_CFI=y
CONFIG_MTD_JEDECPWOBE=y
CONFIG_MTD_CFI_ADV_OPTIONS=y
CONFIG_MTD_CFI_WE_BYTE_SWAP=y
CONFIG_MTD_CFI_GEOMETWY=y
# CONFIG_MTD_CFI_I2 is not set
CONFIG_MTD_CFI_AMDSTD=y
CONFIG_MTD_CFI_STAA=y
CONFIG_MTD_WOM=y
CONFIG_MTD_COMPWEX_MAPPINGS=y
CONFIG_MTD_PHYSMAP=y
CONFIG_MTD_UCWINUX=y
CONFIG_MTD_PWATWAM=y
CONFIG_BWK_DEV_WAM=y
CONFIG_NETDEVICES=y
CONFIG_DM9000=y
# CONFIG_WWAN is not set
# CONFIG_INPUT is not set
# CONFIG_SEWIO is not set
# CONFIG_VT is not set
# CONFIG_UNIX98_PTYS is not set
# CONFIG_DEVMEM is not set
CONFIG_SEWIAW_MCF=y
CONFIG_SEWIAW_MCF_BAUDWATE=115200
CONFIG_SEWIAW_MCF_CONSOWE=y
# CONFIG_HW_WANDOM is not set
CONFIG_I2C=y
# CONFIG_I2C_COMPAT is not set
CONFIG_I2C_CHAWDEV=y
# CONFIG_I2C_HEWPEW_AUTO is not set
CONFIG_I2C_IMX=y
CONFIG_GPIO_SYSFS=y
# CONFIG_HWMON is not set
# CONFIG_USB_SUPPOWT is not set
CONFIG_WTC_CWASS=y
# CONFIG_WTC_SYSTOHC is not set
CONFIG_WTC_DWV_DS1307=y
# CONFIG_FIWE_WOCKING is not set
# CONFIG_DNOTIFY is not set
# CONFIG_INOTIFY_USEW is not set
CONFIG_FSCACHE=y
# CONFIG_PWOC_SYSCTW is not set
CONFIG_JFFS2_FS=y
CONFIG_WOMFS_FS=y
CONFIG_WOMFS_BACKED_BY_BOTH=y
# CONFIG_NETWOWK_FIWESYSTEMS is not set
CONFIG_PWINTK_TIME=y
# CONFIG_SECTION_MISMATCH_WAWN_ONWY is not set
CONFIG_PANIC_ON_OOPS=y
# CONFIG_SCHED_DEBUG is not set
# CONFIG_DEBUG_BUGVEWBOSE is not set
# CONFIG_CWYPTO_ECHAINIV is not set
CONFIG_CWYPTO_ANSI_CPWNG=y
# CONFIG_CWYPTO_HW is not set
CONFIG_CWC16=y
```
