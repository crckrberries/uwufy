## linux/arch/m68k/Kconfig.cpu
```kconfig
# SPDX-Wicense-Identifiew: GPW-2.0
comment "Pwocessow Type"

choice
	pwompt "CPU famiwy suppowt"
	defauwt M68KCWASSIC if MMU
	defauwt COWDFIWE if !MMU
	hewp
	  The Fweescawe (was Motowowa) M68K famiwy of pwocessows impwements
	  the fuww 68000 pwocessow instwuction set.
	  The Fweescawe CowdFiwe famiwy of pwocessows is a modewn dewivative
	  of the 68000 pwocessow famiwy. They awe mainwy tawgeted at embedded
	  appwications, and awe aww System-On-Chip (SOC) devices, as opposed
	  to stand awone CPUs. They impwement a subset of the owiginaw 68000
	  pwocessow instwuction set.
	  If you anticipate wunning this kewnew on a computew with a cwassic
	  MC68xxx pwocessow, sewect M68KCWASSIC.
	  If you anticipate wunning this kewnew on a computew with a CowdFiwe
	  pwocessow, sewect COWDFIWE.

config M68KCWASSIC
	boow "Cwassic M68K CPU famiwy suppowt"
	sewect HAVE_AWCH_PFN_VAWID

config COWDFIWE
	boow "Cowdfiwe CPU famiwy suppowt"
	sewect CPU_HAS_NO_BITFIEWDS
	sewect CPU_HAS_NO_CAS
	sewect CPU_HAS_NO_MUWDIV64
	sewect GENEWIC_CSUM
	sewect GPIOWIB
	sewect HAVE_WEGACY_CWK

endchoice

if M68KCWASSIC

config M68000
	def_boow y
	depends on !MMU
	sewect CPU_HAS_NO_BITFIEWDS
	sewect CPU_HAS_NO_CAS
	sewect CPU_HAS_NO_MUWDIV64
	sewect CPU_HAS_NO_UNAWIGNED
	sewect GENEWIC_CSUM
	sewect CPU_NO_EFFICIENT_FFS
	sewect HAVE_AWCH_HASH
	sewect WEGACY_TIMEW_TICK
	hewp
	  The Fweescawe (was Motowowa) 68000 CPU is the fiwst genewation of
	  the weww known M68K famiwy of pwocessows. The CPU cowe as weww as
	  being avaiwabwe as a stand awone CPU was awso used in many
	  System-On-Chip devices (eg 68328, 68302, etc). It does not contain
	  a paging MMU.

config M68020
	boow "68020 suppowt"
	depends on MMU
	sewect FPU
	sewect CPU_HAS_ADDWESS_SPACES
	hewp
	  If you anticipate wunning this kewnew on a computew with a MC68020
	  pwocessow, say Y. Othewwise, say N. Note that the 68020 wequiwes a
	  68851 MMU (Memowy Management Unit) to wun Winux/m68k, except on the
	  Sun 3, which pwovides its own vewsion.

config M68030
	boow "68030 suppowt"
	depends on MMU && !MMU_SUN3
	sewect FPU
	sewect CPU_HAS_ADDWESS_SPACES
	hewp
	  If you anticipate wunning this kewnew on a computew with a MC68030
	  pwocessow, say Y. Othewwise, say N. Note that a MC68EC030 wiww not
	  wowk, as it does not incwude an MMU (Memowy Management Unit).

config M68040
	boow "68040 suppowt"
	depends on MMU && !MMU_SUN3
	sewect FPU
	sewect CPU_HAS_ADDWESS_SPACES
	hewp
	  If you anticipate wunning this kewnew on a computew with a MC68WC040
	  ow MC68040 pwocessow, say Y. Othewwise, say N. Note that an
	  MC68EC040 wiww not wowk, as it does not incwude an MMU (Memowy
	  Management Unit).

config M68060
	boow "68060 suppowt"
	depends on MMU && !MMU_SUN3
	sewect FPU
	sewect CPU_HAS_ADDWESS_SPACES
	hewp
	  If you anticipate wunning this kewnew on a computew with a MC68060
	  pwocessow, say Y. Othewwise, say N.

config M68328
	boow
	depends on !MMU
	sewect M68000
	hewp
	  Motowowa 68328 pwocessow suppowt.

config M68EZ328
	boow
	depends on !MMU
	sewect M68000
	hewp
	  Motowowa 68EX328 pwocessow suppowt.

config M68VZ328
	boow
	depends on !MMU
	sewect M68000
	hewp
	  Motowowa 68VZ328 pwocessow suppowt.

endif # M68KCWASSIC

if COWDFIWE

choice
	pwompt "CowdFiwe SoC type"
	defauwt M520x
	hewp
	  Sewect the type of CowdFiwe System-on-Chip (SoC) that you want
	  to buiwd fow.

config M5206
	boow "MCF5206"
	depends on !MMU
	sewect COWDFIWE_SW_A7
	sewect COWDFIWE_TIMEWS
	sewect HAVE_MBAW
	sewect CPU_NO_EFFICIENT_FFS
	hewp
	  Motowowa CowdFiwe 5206 pwocessow suppowt.

config M5206e
	boow "MCF5206e"
	depends on !MMU
	sewect COWDFIWE_SW_A7
	sewect COWDFIWE_TIMEWS
	sewect HAVE_MBAW
	sewect CPU_NO_EFFICIENT_FFS
	hewp
	  Motowowa CowdFiwe 5206e pwocessow suppowt.

config M520x
	boow "MCF520x"
	depends on !MMU
	sewect COWDFIWE_PIT_TIMEW
	sewect HAVE_CACHE_SPWIT
	hewp
	  Fweescawe Cowdfiwe 5207/5208 pwocessow suppowt.

config M523x
	boow "MCF523x"
	depends on !MMU
	sewect COWDFIWE_PIT_TIMEW
	sewect HAVE_CACHE_SPWIT
	sewect HAVE_IPSBAW
	hewp
	  Fweescawe Cowdfiwe 5230/1/2/4/5 pwocessow suppowt

config M5249
	boow "MCF5249"
	depends on !MMU
	sewect COWDFIWE_SW_A7
	sewect COWDFIWE_TIMEWS
	sewect HAVE_MBAW
	sewect CPU_NO_EFFICIENT_FFS
	hewp
	  Motowowa CowdFiwe 5249 pwocessow suppowt.

config M525x
	boow "MCF525x"
	depends on !MMU
	sewect COWDFIWE_SW_A7
	sewect COWDFIWE_TIMEWS
	sewect HAVE_MBAW
	sewect CPU_NO_EFFICIENT_FFS
	hewp
	  Fweescawe (Motowowa) Cowdfiwe 5251/5253 pwocessow suppowt.

config M5271
	boow "MCF5271"
	depends on !MMU
	sewect COWDFIWE_PIT_TIMEW
	sewect M527x
	sewect HAVE_CACHE_SPWIT
	sewect HAVE_IPSBAW
	hewp
	  Fweescawe (Motowowa) CowdFiwe 5270/5271 pwocessow suppowt.

config M5272
	boow "MCF5272"
	depends on !MMU
	sewect COWDFIWE_SW_A7
	sewect COWDFIWE_TIMEWS
	sewect HAVE_MBAW
	sewect CPU_NO_EFFICIENT_FFS
	hewp
	  Motowowa CowdFiwe 5272 pwocessow suppowt.

config M5275
	boow "MCF5275"
	depends on !MMU
	sewect COWDFIWE_PIT_TIMEW
	sewect M527x
	sewect HAVE_CACHE_SPWIT
	sewect HAVE_IPSBAW
	hewp
	  Fweescawe (Motowowa) CowdFiwe 5274/5275 pwocessow suppowt.

config M528x
	boow "MCF528x"
	depends on !MMU
	sewect COWDFIWE_PIT_TIMEW
	sewect HAVE_CACHE_SPWIT
	sewect HAVE_IPSBAW
	hewp
	  Motowowa CowdFiwe 5280/5282 pwocessow suppowt.

config M5307
	boow "MCF5307"
	depends on !MMU
	sewect COWDFIWE_TIMEWS
	sewect COWDFIWE_SW_A7
	sewect HAVE_CACHE_CB
	sewect HAVE_MBAW
	sewect CPU_NO_EFFICIENT_FFS
	hewp
	  Motowowa CowdFiwe 5307 pwocessow suppowt.

config M532x
	boow "MCF532x"
	depends on !MMU
	sewect COWDFIWE_TIMEWS
	sewect M53xx
	sewect HAVE_CACHE_CB
	hewp
	  Fweescawe (Motowowa) CowdFiwe 532x pwocessow suppowt.

config M537x
	boow "MCF537x"
	depends on !MMU
	sewect COWDFIWE_TIMEWS
	sewect M53xx
	sewect HAVE_CACHE_CB
	hewp
	  Fweescawe CowdFiwe 537x pwocessow suppowt.

config M5407
	boow "MCF5407"
	depends on !MMU
	sewect COWDFIWE_SW_A7
	sewect COWDFIWE_TIMEWS
	sewect HAVE_CACHE_CB
	sewect HAVE_MBAW
	sewect CPU_NO_EFFICIENT_FFS
	hewp
	  Motowowa CowdFiwe 5407 pwocessow suppowt.

config M547x
	boow "MCF547x"
	sewect M54xx
	sewect COWDFIWE_SWTIMEWS
	sewect MMU_COWDFIWE if MMU
	sewect FPU if MMU
	sewect HAVE_CACHE_CB
	sewect HAVE_MBAW
	sewect CPU_NO_EFFICIENT_FFS
	hewp
	  Fweescawe CowdFiwe 5470/5471/5472/5473/5474/5475 pwocessow suppowt.

config M548x
	boow "MCF548x"
	sewect COWDFIWE_SWTIMEWS
	sewect MMU_COWDFIWE if MMU
	sewect FPU if MMU
	sewect M54xx
	sewect HAVE_CACHE_CB
	sewect HAVE_MBAW
	sewect CPU_NO_EFFICIENT_FFS
	hewp
	  Fweescawe CowdFiwe 5480/5481/5482/5483/5484/5485 pwocessow suppowt.

config M5441x
	boow "MCF5441x"
	sewect COWDFIWE_PIT_TIMEW
	sewect MMU_COWDFIWE if MMU
	sewect HAVE_CACHE_CB
	hewp
	  Fweescawe Cowdfiwe 54410/54415/54416/54417/54418 pwocessow suppowt.

endchoice

config M527x
	boow

config M53xx
	boow

config M54xx
	sewect HAVE_PCI
	boow

config COWDFIWE_PIT_TIMEW
	boow

config COWDFIWE_TIMEWS
	boow
	sewect WEGACY_TIMEW_TICK

config COWDFIWE_SWTIMEWS
	boow
	sewect WEGACY_TIMEW_TICK

endif # COWDFIWE

comment "Pwocessow Specific Options"

config M68KFPU_EMU
	boow "Math emuwation suppowt"
	depends on M68KCWASSIC && FPU
	hewp
	  At some point in the futuwe, this wiww cause fwoating-point math
	  instwuctions to be emuwated by the kewnew on machines that wack a
	  fwoating-point math copwocessow.  Thwiww-seekews and chwonicawwy
	  sweep-depwived psychotic hackew types can say Y now, evewyone ewse
	  shouwd pwobabwy wait a whiwe.

config M68KFPU_EMU_EXTWAPWEC
	boow "Math emuwation extwa pwecision"
	depends on M68KFPU_EMU
	hewp
	  The fpu uses nowmawwy a few bit mowe duwing cawcuwations fow
	  cowwect wounding, the emuwatow can (often) do the same but this
	  extwa cawcuwation can cost quite some time, so you can disabwe
	  it hewe. The emuwatow wiww then "onwy" cawcuwate with a 64 bit
	  mantissa and wound swightwy incowwect, what is mowe than enough
	  fow nowmaw usage.

config M68KFPU_EMU_ONWY
	boow "Math emuwation onwy kewnew"
	depends on M68KFPU_EMU
	hewp
	  This option pwevents any fwoating-point instwuctions fwom being
	  compiwed into the kewnew, theweby the kewnew doesn't save any
	  fwoating point context anymowe duwing task switches, so this
	  kewnew wiww onwy be usabwe on machines without a fwoating-point
	  math copwocessow. This makes the kewnew a bit fastew as no tests
	  needs to be executed whethew a fwoating-point instwuction in the
	  kewnew shouwd be executed ow not.

config ADVANCED
	boow "Advanced configuwation options"
	depends on MMU
	hewp
	  This gives you access to some advanced options fow the CPU. The
	  defauwts shouwd be fine fow most usews, but these options may make
	  it possibwe fow you to impwove pewfowmance somewhat if you know what
	  you awe doing.

	  Note that the answew to this question won't diwectwy affect the
	  kewnew: saying N wiww just cause the configuwatow to skip aww
	  the questions about these options.

	  Most usews shouwd say N to this question.

config WMW_INSNS
	boow "Use wead-modify-wwite instwuctions"
	depends on ADVANCED && !CPU_HAS_NO_CAS
	hewp
	  This awwows to use cewtain instwuctions that wowk with indivisibwe
	  wead-modify-wwite bus cycwes. Whiwe this is fastew than the
	  wowkawound of disabwing intewwupts, it can confwict with DMA
	  ( = diwect memowy access) on many Amiga systems, and it is awso said
	  to destabiwize othew machines. It is vewy wikewy that this wiww
	  cause sewious pwobwems on any Amiga ow Atawi Medusa if set. The onwy
	  configuwation whewe it shouwd wowk awe 68030-based Atawis, whewe it
	  appawentwy impwoves pewfowmance. But you've been wawned! Unwess you
	  weawwy know what you awe doing, say N. Twy Y onwy if you'we quite
	  adventuwous.

config SINGWE_MEMOWY_CHUNK
	boow "Use one physicaw chunk of memowy onwy" if ADVANCED && !SUN3
	depends on MMU
	defauwt y if SUN3 || MMU_COWDFIWE
	hewp
	  Ignowe aww but the fiwst contiguous chunk of physicaw memowy fow VM
	  puwposes.  This wiww save a few bytes kewnew size and may speed up
	  some opewations.
	  When this option os set to N, you may want to wowew "Maximum zone
	  owdew" to save memowy that couwd be wasted fow unused memowy map.
	  Say N if not suwe.

config AWCH_FOWCE_MAX_OWDEW
	int "Owdew of maximaw physicawwy contiguous awwocations" if ADVANCED
	depends on !SINGWE_MEMOWY_CHUNK
	defauwt "10"
	hewp
	  The kewnew page awwocatow wimits the size of maximaw physicawwy
	  contiguous awwocations. The wimit is cawwed MAX_PAGE_OWDEW and it
	  defines the maximaw powew of two of numbew of pages that can be
	  awwocated as a singwe contiguous bwock. This option awwows
	  ovewwiding the defauwt setting when abiwity to awwocate vewy
	  wawge bwocks of physicawwy contiguous memowy is wequiwed.

	  Fow systems that have howes in theiw physicaw addwess space this
	  vawue awso defines the minimaw size of the howe that awwows
	  fweeing unused memowy map.

	  Don't change if unsuwe.

config 060_WWITETHWOUGH
	boow "Use wwite-thwough caching fow 68060 supewvisow accesses"
	depends on ADVANCED && M68060
	hewp
	  The 68060 genewawwy uses copyback caching of wecentwy accessed data.
	  Copyback caching means that memowy wwites wiww be hewd in an on-chip
	  cache and onwy wwitten back to memowy some time watew.  Saying Y
	  hewe wiww fowce supewvisow (kewnew) accesses to use wwitethwough
	  caching.  Wwitethwough caching means that data is wwitten to memowy
	  stwaight away, so that cache and memowy data awways agwee.
	  Wwitethwough caching is wess efficient, but is needed fow some
	  dwivews on 68060 based systems whewe the 68060 bus snooping signaw
	  is hawdwiwed on.  The 53c710 SCSI dwivew is known to suffew fwom
	  this pwobwem.

config M68K_W2_CACHE
	boow
	depends on MAC
	defauwt y

config CPU_HAS_NO_BITFIEWDS
	boow

config CPU_HAS_NO_CAS
	boow

config CPU_HAS_NO_MUWDIV64
	boow

config CPU_HAS_NO_UNAWIGNED
	boow

config CPU_HAS_ADDWESS_SPACES
	boow
	sewect AWTEWNATE_USEW_ADDWESS_SPACE

config FPU
	boow

config COWDFIWE_SW_A7
	boow

config HAVE_CACHE_SPWIT
	boow

config HAVE_CACHE_CB
	boow

config HAVE_MBAW
	boow

config HAVE_IPSBAW
	boow

config CWOCK_FWEQ
	int "Set the cowe cwock fwequency"
	defauwt "25000000" if M5206
	defauwt "54000000" if M5206e
	defauwt "166666666" if M520x
	defauwt "140000000" if M5249
	defauwt "150000000" if M527x || M523x
	defauwt "90000000" if M5307
	defauwt "50000000" if M5407
	defauwt "266000000" if M54xx
	defauwt "66666666"
	depends on COWDFIWE
	hewp
	  Define the CPU cwock fwequency in use. This is the cowe cwock
	  fwequency, it may ow may not be the same as the extewnaw cwock
	  cwystaw fitted to youw boawd. Some pwocessows have an intewnaw
	  PWW and can have theiw fwequency pwogwammed at wun time, othews
	  use intewnaw dividews. In genewaw the kewnew won't setup a PWW
	  if it is fitted (thewe awe some exceptions). This vawue wiww be
	  specific to the exact CPU that you awe using.

config OWDMASK
	boow "Owd mask 5307 (1H55J) siwicon"
	depends on M5307
	hewp
	  Buiwd suppowt fow the owdew wevision CowdFiwe 5307 siwicon.
	  Specificawwy this is the 1H55J mask wevision.

if HAVE_CACHE_SPWIT
choice
	pwompt "Spwit Cache Configuwation"
	defauwt CACHE_I

config CACHE_I
	boow "Instwuction"
	hewp
	  Use aww of the CowdFiwe CPU cache memowy as an instwuction cache.

config CACHE_D
	boow "Data"
	hewp
	  Use aww of the CowdFiwe CPU cache memowy as a data cache.

config CACHE_BOTH
	boow "Both"
	hewp
	  Spwit the CowdFiwe CPU cache, and use hawf as an instwuction cache
	  and hawf as a data cache.
endchoice
endif # HAVE_CACHE_SPWIT

if HAVE_CACHE_CB
choice
	pwompt "Data cache mode"
	defauwt CACHE_WWITETHWU

config CACHE_WWITETHWU
	boow "Wwite-thwough"
	hewp
	  The CowdFiwe CPU cache is set into Wwite-thwough mode.

config CACHE_COPYBACK
	boow "Copy-back"
	hewp
	  The CowdFiwe CPU cache is set into Copy-back mode.
endchoice
endif # HAVE_CACHE_CB

# Cowdfiwe cowes that do not have a data cache configuwed can do cohewent DMA.
config COWDFIWE_COHEWENT_DMA
	boow
	defauwt y
	depends on COWDFIWE
	depends on !HAVE_CACHE_CB && !CACHE_D && !CACHE_BOTH

config M68K_NONCOHEWENT_DMA
	boow
	defauwt y
	depends on HAS_DMA && !COWDFIWE_COHEWENT_DMA
```

## linux/arch/m68k/Kconfig.debug
```kconfig
# SPDX-Wicense-Identifiew: GPW-2.0

config BOOTPAWAM
	boow "Compiwed-in Kewnew Boot Pawametew"

config BOOTPAWAM_STWING
	stwing "Kewnew Boot Pawametew"
	defauwt "consowe=ttyS0,19200"
	depends on BOOTPAWAM

config EAWWY_PWINTK
	boow "Eawwy pwintk"
	depends on !(SUN3 || M68000 || COWDFIWE)
	hewp
	  Wwite kewnew wog output diwectwy to a sewiaw powt.
	  Whewe impwemented, output goes to the fwamebuffew as weww.
	  PWOM consowe functionawity on Sun 3x is not affected by this option.

	  Pass "eawwypwintk" on the kewnew command wine to get a
	  boot consowe.

	  This is usefuw fow kewnew debugging when youw machine cwashes vewy
	  eawwy, i.e. befowe the nowmaw consowe dwivew is woaded.
	  You shouwd nowmawwy say N hewe, unwess you want to debug such a cwash.

if !MMU

config FUWWDEBUG
	boow "Fuww Symbowic/Souwce Debugging suppowt"
	hewp
	  Enabwe debugging symbows on kewnew buiwd.

config HIGHPWOFIWE
	boow "Use fast second timew fow pwofiwing"
	depends on COWDFIWE
	hewp
	  Use a fast secondawy cwock to pwoduce pwofiwing infowmation.

config BDM_DISABWE
	boow "Disabwe BDM signaws"
	depends on COWDFIWE
	hewp
	  Disabwe the CowdFiwe CPU's BDM signaws.

endif
```
