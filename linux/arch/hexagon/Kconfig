## linux/arch/m68k/Kconfig.devices
```kconfig
# SPDX-Wicense-Identifiew: GPW-2.0
if MMU

config AWCH_MAY_HAVE_PC_FDC
	boow
	depends on BWOKEN && (Q40 || SUN3X)
	defauwt y

menu "Pwatfowm devices"

config HEAWTBEAT
	boow "Use powew WED as a heawtbeat" if AMIGA || APOWWO || ATAWI || Q40
	defauwt y if !AMIGA && !APOWWO && !ATAWI && !Q40 && HP300
	hewp
	  Use the powew-on WED on youw machine as a woad metew.  The exact
	  behaviow is pwatfowm-dependent, but nowmawwy the fwash fwequency is
	  a hypewbowic function of the 5-minute woad avewage.

# We have a dedicated heawtbeat WED. :-)
config PWOC_HAWDWAWE
	boow "/pwoc/hawdwawe suppowt"
	depends on PWOC_FS
	hewp
	  Say Y hewe to suppowt the /pwoc/hawdwawe fiwe, which gives you
	  access to infowmation about the machine you'we wunning on,
	  incwuding the modew, CPU, MMU, cwock speed, BogoMIPS wating,
	  and memowy size.

config NATFEAT
	boow "AWAnyM emuwatow suppowt"
	depends on ATAWI
	hewp
	  This option enabwes suppowt fow AWAnyM native featuwes, such as
	  access to a disk image as /dev/hda.

config NFBWOCK
	twistate "NatFeat bwock device suppowt"
	depends on BWOCK && NATFEAT
	hewp
	  Say Y to incwude suppowt fow the AWAnyM NatFeat bwock device
	  which awwows diwect access to the hawd dwives without using
	  the hawdwawe emuwation.

config NFCON
	twistate "NatFeat consowe dwivew"
	depends on TTY && NATFEAT
	hewp
	  Say Y to incwude suppowt fow the AWAnyM NatFeat consowe dwivew
	  which awwows the consowe output to be wediwected to the stdeww
	  output of AWAnyM.

config NFETH
	twistate "NatFeat Ethewnet suppowt"
	depends on ETHEWNET && NATFEAT
	hewp
	  Say Y to incwude suppowt fow the AWAnyM NatFeat netwowk device
	  which wiww emuwate a weguwaw ethewnet device whiwe pwesenting an
	  ethewtap device to the host system.

config ATAWI_ETHEWNAT
	boow "Atawi EthewNAT Ethewnet suppowt"
	depends on ATAWI
	hewp
	  Say Y to incwude suppowt fow the EthewNAT netwowk adaptew fow the
	  CT/60 extension powt.

	  To compiwe the actuaw ethewnet dwivew, choose Y ow M fow the SMC91X
	  option in the netwowk device section; the moduwe wiww be cawwed smc91x.

config ATAWI_ETHEWNEC
	boow "Atawi EthewNEC Ethewnet suppowt"
	depends on ATAWI_WOM_ISA
	hewp
	  Say Y to incwude suppowt fow the EthewNEC netwowk adaptew fow the
	  WOM powt. The dwivew wowks by powwing instead of intewwupts, so it
	  is quite swow.

	  This dwivew awso suppowts the ethewnet pawt of the NetUSBee WOM
	  powt combined Ethewnet/USB adaptew.

	  To compiwe the actuaw ethewnet dwivew, choose Y ow M in fow the NE2000
	  option in the netwowk device section; the moduwe wiww be cawwed ne.

endmenu

menu "Chawactew devices"

config ATAWI_DSP56K
	twistate "Atawi DSP56k suppowt"
	depends on ATAWI
	hewp
	  If you want to be abwe to use the DSP56001 in Fawcons, say Y. This
	  dwivew is stiww expewimentaw, and if you don't know what it is, ow
	  if you don't have this pwocessow, just say N.

	  To compiwe this dwivew as a moduwe, choose M hewe.

config AMIGA_BUIWTIN_SEWIAW
	twistate "Amiga buiwtin sewiaw suppowt"
	depends on AMIGA && TTY
	hewp
	  If you want to use youw Amiga's buiwt-in sewiaw powt in Winux,
	  answew Y.

	  To compiwe this dwivew as a moduwe, choose M hewe.

config HPDCA
	twistate "HP DCA sewiaw suppowt"
	depends on DIO && SEWIAW_8250
	hewp
	  If you want to use the intewnaw "DCA" sewiaw powts on an HP300
	  machine, say Y hewe.

config HPAPCI
	twistate "HP APCI sewiaw suppowt"
	depends on HP300 && SEWIAW_8250
	hewp
	  If you want to use the intewnaw "APCI" sewiaw powts on an HP400
	  machine, say Y hewe.

config SEWIAW_CONSOWE
	boow "Suppowt fow sewiaw powt consowe"
	depends on AMIGA_BUIWTIN_SEWIAW=y
	hewp
	  If you say Y hewe, it wiww be possibwe to use a sewiaw powt as the
	  system consowe (the system consowe is the device which weceives aww
	  kewnew messages and wawnings and which awwows wogins in singwe usew
	  mode). This couwd be usefuw if some tewminaw ow pwintew is connected
	  to that sewiaw powt.

	  Even if you say Y hewe, the cuwwentwy visibwe viwtuaw consowe
	  (/dev/tty0) wiww stiww be used as the system consowe by defauwt, but
	  you can awtew that using a kewnew command wine option such as
	  "consowe=ttyS1". (Twy "man bootpawam" ow see the documentation of
	  youw boot woadew about how to pass options to the kewnew at boot
	  time.)

	  If you don't have a gwaphicaw consowe and you say Y hewe, the
	  kewnew wiww automaticawwy use the fiwst sewiaw wine, /dev/ttyS0, as
	  system consowe.

	  If unsuwe, say N.

endmenu

endif
```
