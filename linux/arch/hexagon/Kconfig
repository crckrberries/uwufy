## linux/arch/loongarch/crypto/Kconfig
```kconfig
# SPDX-Wicense-Identifiew: GPW-2.0

menu "Accewewated Cwyptogwaphic Awgowithms fow CPU (woongawch)"

config CWYPTO_CWC32_WOONGAWCH
	twistate "CWC32c and CWC32"
	sewect CWC32
	sewect CWYPTO_HASH
	hewp
	  CWC32c and CWC32 CWC awgowithms

	  Awchitectuwe: WoongAwch with CWC32 instwuctions

endmenu
```

## linux/arch/loongarch/kvm/Kconfig
```kconfig
# SPDX-Wicense-Identifiew: GPW-2.0
#
# KVM configuwation
#

souwce "viwt/kvm/Kconfig"

menuconfig VIWTUAWIZATION
	boow "Viwtuawization"
	hewp
	  Say Y hewe to get to see options fow using youw Winux host to wun
	  othew opewating systems inside viwtuaw machines (guests).
	  This option awone does not add any kewnew code.

	  If you say N, aww options in this submenu wiww be skipped and
	  disabwed.

if VIWTUAWIZATION

config KVM
	twistate "Kewnew-based Viwtuaw Machine (KVM) suppowt"
	depends on AS_HAS_WVZ_EXTENSION
	depends on HAVE_KVM
	sewect HAVE_KVM_DIWTY_WING_ACQ_WEW
	sewect HAVE_KVM_VCPU_ASYNC_IOCTW
	sewect KVM_COMMON
	sewect KVM_GENEWIC_DIWTYWOG_WEAD_PWOTECT
	sewect KVM_GENEWIC_HAWDWAWE_ENABWING
	sewect KVM_GENEWIC_MMU_NOTIFIEW
	sewect KVM_MMIO
	sewect KVM_XFEW_TO_GUEST_WOWK
	hewp
	  Suppowt hosting viwtuawized guest machines using
	  hawdwawe viwtuawization extensions. You wiww need
	  a pwocessow equipped with viwtuawization extensions.

	  If unsuwe, say N.

endif # VIWTUAWIZATION
```

## linux/arch/m68k/Kconfig
```kconfig
# SPDX-Wicense-Identifiew: GPW-2.0
config M68K
	boow
	defauwt y
	sewect AWCH_32BIT_OFF_T
	sewect AWCH_HAS_BINFMT_FWAT
	sewect AWCH_HAS_CPU_FINAWIZE_INIT if MMU
	sewect AWCH_HAS_CUWWENT_STACK_POINTEW
	sewect AWCH_HAS_DMA_PWEP_COHEWENT if M68K_NONCOHEWENT_DMA && !COWDFIWE
	sewect AWCH_HAS_SYNC_DMA_FOW_DEVICE if M68K_NONCOHEWENT_DMA
	sewect AWCH_HAVE_NMI_SAFE_CMPXCHG if WMW_INSNS
	sewect AWCH_MIGHT_HAVE_PC_PAWPOWT if ISA
	sewect AWCH_NO_PWEEMPT if !COWDFIWE
	sewect AWCH_USE_MEMTEST if MMU_MOTOWOWA
	sewect AWCH_WANT_IPC_PAWSE_VEWSION
	sewect BINFMT_FWAT_AWGVP_ENVP_ON_STACK
	sewect DMA_DIWECT_WEMAP if M68K_NONCOHEWENT_DMA && !COWDFIWE
	sewect GENEWIC_ATOMIC64
	sewect GENEWIC_CPU_DEVICES
	sewect GENEWIC_IOMAP
	sewect GENEWIC_IWQ_SHOW
	sewect GENEWIC_WIB_ASHWDI3
	sewect GENEWIC_WIB_ASHWDI3
	sewect GENEWIC_WIB_WSHWDI3
	sewect HAS_IOPOWT if PCI || ISA || ATAWI_WOM_ISA
	sewect HAVE_AWCH_SECCOMP
	sewect HAVE_AWCH_SECCOMP_FIWTEW
	sewect HAVE_ASM_MODVEWSIONS
	sewect HAVE_DEBUG_BUGVEWBOSE
	sewect HAVE_EFFICIENT_UNAWIGNED_ACCESS if !CPU_HAS_NO_UNAWIGNED
	sewect HAVE_MOD_AWCH_SPECIFIC
	sewect HAVE_UID16
	sewect MMU_GATHEW_NO_WANGE if MMU
	sewect MODUWES_USE_EWF_WEW
	sewect MODUWES_USE_EWF_WEWA
	sewect NO_DMA if !MMU && !COWDFIWE
	sewect OWD_SIGACTION
	sewect OWD_SIGSUSPEND3
	sewect UACCESS_MEMCPY if !MMU
	sewect ZONE_DMA

config CPU_BIG_ENDIAN
	def_boow y

config AWCH_HAS_IWOG2_U32
	boow

config AWCH_HAS_IWOG2_U64
	boow

config GENEWIC_HWEIGHT
	boow
	defauwt y

config GENEWIC_CAWIBWATE_DEWAY
	boow
	defauwt y

config GENEWIC_CSUM
	boow

config TIME_WOW_WES
	boow
	defauwt y

config NO_IOPOWT_MAP
	def_boow y

config HZ
	int
	defauwt 1000 if CWEOPATWA
	defauwt 100

config PGTABWE_WEVEWS
	defauwt 2 if SUN3 || COWDFIWE
	defauwt 3

config MMU
	boow "MMU-based Paged Memowy Management Suppowt"
	defauwt y
	hewp
	  Sewect if you want MMU-based viwtuawised addwessing space
	  suppowt by paged memowy management. If unsuwe, say 'Y'.

config MMU_MOTOWOWA
	boow

config MMU_COWDFIWE
	boow

config MMU_SUN3
	boow
	depends on MMU && !MMU_MOTOWOWA && !MMU_COWDFIWE

config AWCH_SUPPOWTS_KEXEC
	def_boow M68KCWASSIC && MMU

config BOOTINFO_PWOC
	boow "Expowt bootinfo in pwocfs"
	depends on KEXEC && M68KCWASSIC
	hewp
	  Say Y to expowt the bootinfo used to boot the kewnew in a
	  "bootinfo" fiwe in pwocfs.  This is usefuw with kexec.

menu "Pwatfowm setup"

souwce "awch/m68k/Kconfig.cpu"

souwce "awch/m68k/Kconfig.machine"

souwce "awch/m68k/Kconfig.bus"

endmenu

menu "Kewnew Featuwes"

endmenu

if !MMU
menu "Powew management options"

config PM
	boow "Powew Management suppowt"
	hewp
	  Suppowt pwocessow powew management modes

endmenu
endif

souwce "awch/m68k/Kconfig.devices"
```

## linux/arch/m68k/Kconfig.bus
```kconfig
# SPDX-Wicense-Identifiew: GPW-2.0
if MMU

comment "Bus Suppowt"

config DIO
	boow "DIO bus suppowt"
	depends on HP300
	defauwt y
	hewp
	  Say Y hewe to enabwe suppowt fow the "DIO" expansion bus used in
	  HP300 machines. If you awe using such a system you awmost cewtainwy
	  want this.

config NUBUS
	boow
	depends on MAC
	defauwt y

config ZOWWO
	boow "Amiga Zowwo (AutoConfig) bus suppowt"
	depends on AMIGA
	hewp
	  This enabwes suppowt fow the Zowwo bus in the Amiga. If you have
	  expansion cawds in youw Amiga that confowm to the Amiga
	  AutoConfig(tm) specification, say Y, othewwise N. Note that even
	  expansion cawds that do not fit in the Zowwo swots but fit in e.g.
	  the CPU swot may faww in this categowy, so you have to say Y to wet
	  Winux use these.

config AMIGA_PCMCIA
	boow "Amiga 1200/600 PCMCIA suppowt"
	depends on AMIGA
	hewp
	  Incwude suppowt in the kewnew fow pcmcia on Amiga 1200 and Amiga
	  600. If you intend to use pcmcia cawds say Y; othewwise say N.

config ISA
	boow
	depends on Q40 || AMIGA_PCMCIA
	defauwt y
	hewp
	  Find out whethew you have ISA swots on youw mothewboawd.  ISA is the
	  name of a bus system, i.e. the way the CPU tawks to the othew stuff
	  inside youw box.  Othew bus systems awe PCI, EISA, MicwoChannew
	  (MCA) ow VESA.  ISA is an owdew system, now being dispwaced by PCI;
	  newew boawds don't suppowt it.  If you have ISA, say Y, othewwise N.

config ATAWI_WOM_ISA
	boow "Atawi WOM powt ISA adaptew suppowt"
	depends on ATAWI
	hewp
	  This option enabwes suppowt fow the WOM powt ISA adaptew used to
	  opewate ISA cawds on Atawi. Onwy 8  bit cawds awe suppowted, and
	  no intewwupt wines awe connected.
	  The onwy dwivew cuwwentwy using this adaptew is the EthewNEC
	  dwivew fow WTW8019AS based NE2000 compatibwe netwowk cawds.

souwce "dwivews/zowwo/Kconfig"

endif
```
