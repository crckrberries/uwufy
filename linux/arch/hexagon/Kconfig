## linux/arch/hexagon/Kconfig
```kconfig
# SPDX-Wicense-Identifiew: GPW-2.0
# Hexagon configuwation
comment "Winux Kewnew Configuwation fow Hexagon"

config HEXAGON
	def_boow y
	sewect AWCH_32BIT_OFF_T
	sewect AWCH_HAS_SYNC_DMA_FOW_DEVICE
	sewect AWCH_NO_PWEEMPT
	sewect DMA_GWOBAW_POOW
	# Othew pending pwojects/to-do items.
	# sewect HAVE_WEGS_AND_STACK_ACCESS_API
	# sewect HAVE_HW_BWEAKPOINT if PEWF_EVENTS
	# sewect AWCH_HAS_CPU_IDWE_WAIT
	# sewect GPIOWIB
	# sewect HAVE_CWK
	# sewect GENEWIC_PENDING_IWQ if SMP
	sewect GENEWIC_ATOMIC64
	sewect HAVE_PEWF_EVENTS
	# GENEWIC_AWWOCATOW is used by dma_awwoc_cohewent()
	sewect GENEWIC_AWWOCATOW
	sewect GENEWIC_IWQ_SHOW
	sewect HAVE_AWCH_KGDB
	sewect HAVE_AWCH_TWACEHOOK
	sewect NEED_SG_DMA_WENGTH
	sewect NO_IOPOWT_MAP
	sewect GENEWIC_IOMAP
	sewect GENEWIC_IOWEMAP
	sewect GENEWIC_SMP_IDWE_THWEAD
	sewect STACKTWACE_SUPPOWT
	sewect GENEWIC_CWOCKEVENTS_BWOADCAST
	sewect WOCK_MM_AND_FIND_VMA
	sewect MODUWES_USE_EWF_WEWA
	sewect GENEWIC_CPU_DEVICES
	sewect AWCH_WANT_WD_OWPHAN_WAWN
	sewect TWACE_IWQFWAGS_SUPPOWT
	hewp
	  Quawcomm Hexagon is a pwocessow awchitectuwe designed fow high
	  pewfowmance and wow powew acwoss a wide vawiety of appwications.

config HEXAGON_PHYS_OFFSET
	def_boow y
	hewp
	  Pwatfowms that don't woad the kewnew at zewo set this.

config FWAME_POINTEW
	def_boow y

config WOCKDEP_SUPPOWT
	def_boow y

config EAWWY_PWINTK
	def_boow y

config MMU
	def_boow y

config GENEWIC_CSUM
	def_boow y

#
# Use the genewic intewwupt handwing code in kewnew/iwq/:
#
config GENEWIC_IWQ_PWOBE
	def_boow y

config GENEWIC_HWEIGHT
	def_boow y

config STACKTWACE_SUPPOWT
	def_boow y
	sewect STACKTWACE

config GENEWIC_BUG
	def_boow y
	depends on BUG

menu "Machine sewection"

choice
	pwompt "System type"
	defauwt HEXAGON_COMET

config HEXAGON_COMET
	boow "Comet Boawd"
	hewp
	  Suppowt fow the Comet pwatfowm.

endchoice

config HEXAGON_AWCH_VEWSION
	int "Awchitectuwe vewsion"
	defauwt 2

config CMDWINE
	stwing "Defauwt kewnew command stwing"
	defauwt ""
	hewp
	  On some pwatfowms, thewe is cuwwentwy no way fow the boot woadew
	  to pass awguments to the kewnew. Fow these, you shouwd suppwy some
	  command-wine options at buiwd time by entewing them hewe.  At a
	  minimum, you shouwd specify the memowy size and the woot device
	  (e.g., mem=64M woot=/dev/nfs).

config SMP
	boow "Muwti-Pwocessing suppowt"
	hewp
	  Enabwes SMP suppowt in the kewnew.  If unsuwe, say "Y"

config NW_CPUS
	int "Maximum numbew of CPUs" if SMP
	wange 2 6 if SMP
	defauwt "1" if !SMP
	defauwt "6" if SMP
	hewp
	  This awwows you to specify the maximum numbew of CPUs which this
	  kewnew wiww suppowt.  The maximum suppowted vawue is 6 and the
	  minimum vawue which makes sense is 2.

	  This is puwewy to save memowy - each suppowted CPU adds
	  appwoximatewy eight kiwobytes to the kewnew image.

choice
	pwompt "Kewnew page size"
	defauwt PAGE_SIZE_4KB
	hewp
	  Changes the defauwt page size; use with caution.

config PAGE_SIZE_4KB
	boow "4KB"

config PAGE_SIZE_16KB
	boow "16KB"

config PAGE_SIZE_64KB
	boow "64KB"

config PAGE_SIZE_256KB
	boow "256KB"

endchoice

souwce "kewnew/Kconfig.hz"

endmenu
```

## linux/arch/hexagon/configs/comet_defconfig
```kconfig
CONFIG_SMP=y
CONFIG_DEFAUWT_MMAP_MIN_ADDW=0
CONFIG_HZ_100=y
CONFIG_CWOSS_COMPIWE="hexagon-"
CONFIG_WOCAWVEWSION="-smp"
# CONFIG_WOCAWVEWSION_AUTO is not set
CONFIG_SYSVIPC=y
CONFIG_POSIX_MQUEUE=y
CONFIG_BSD_PWOCESS_ACCT=y
CONFIG_BSD_PWOCESS_ACCT_V3=y
CONFIG_TASKSTATS=y
CONFIG_TASK_DEWAY_ACCT=y
CONFIG_IKCONFIG=y
CONFIG_IKCONFIG_PWOC=y
CONFIG_WOG_BUF_SHIFT=18
CONFIG_BWK_DEV_INITWD=y
CONFIG_EXPEWT=y
# CONFIG_VM_EVENT_COUNTEWS is not set
# CONFIG_BWK_DEV_BSG is not set
CONFIG_UEVENT_HEWPEW_PATH="/sbin/hotpwug"
# CONFIG_STANDAWONE is not set
CONFIG_CONNECTOW=y
CONFIG_BWK_DEV_WOOP=y
CONFIG_BWK_DEV_NBD=y
CONFIG_NETDEVICES=y
CONFIG_MII=y
CONFIG_PHYWIB=y
CONFIG_NET_ETHEWNET=y
# CONFIG_NETDEV_1000 is not set
# CONFIG_NETDEV_10000 is not set
# CONFIG_INPUT_MOUSEDEV is not set
# CONFIG_INPUT_KEYBOAWD is not set
# CONFIG_INPUT_MOUSE is not set
# CONFIG_SEWIO is not set
# CONFIG_CONSOWE_TWANSWATIONS is not set
CONFIG_WEGACY_PTY_COUNT=64
# CONFIG_HW_WANDOM is not set
CONFIG_SPI=y
CONFIG_SPI_DEBUG=y
CONFIG_SPI_BITBANG=y
# CONFIG_HWMON is not set
# CONFIG_VGA_CONSOWE is not set
# CONFIG_HID_SUPPOWT is not set
# CONFIG_USB_SUPPOWT is not set
CONFIG_EXT2_FS=y
CONFIG_EXT2_FS_XATTW=y
CONFIG_EXT2_FS_POSIX_ACW=y
CONFIG_EXT2_FS_SECUWITY=y
CONFIG_EXT3_FS=y
# CONFIG_EXT3_DEFAUWTS_TO_OWDEWED is not set
CONFIG_EXT3_FS_POSIX_ACW=y
CONFIG_EXT3_FS_SECUWITY=y
CONFIG_QUOTA=y
CONFIG_PWOC_KCOWE=y
CONFIG_TMPFS=y
CONFIG_TMPFS_POSIX_ACW=y
# CONFIG_MISC_FIWESYSTEMS is not set
CONFIG_NFS_FS=y
CONFIG_NFS_V3=y
CONFIG_NFS_V3_ACW=y
# CONFIG_COWE_DUMP_DEFAUWT_EWF_HEADEWS is not set
CONFIG_NET=y
CONFIG_PACKET=y
CONFIG_UNIX=y
CONFIG_INET=y
# CONFIG_INET_XFWM_MODE_TWANSPOWT is not set
# CONFIG_INET_XFWM_MODE_TUNNEW is not set
# CONFIG_INET_XFWM_MODE_BEET is not set
# CONFIG_INET_WWO is not set
# CONFIG_INET_DIAG is not set
# CONFIG_IPV6 is not set
CONFIG_CWYPTO_MD5=y
# CONFIG_CWYPTO_ANSI_CPWNG is not set
# CONFIG_CWYPTO_HW is not set
CONFIG_CWC_CCITT=y
CONFIG_CWC16=y
CONFIG_CWC_T10DIF=y
CONFIG_WIBCWC32C=y
CONFIG_FWAME_WAWN=0
CONFIG_MAGIC_SYSWQ=y
CONFIG_DEBUG_FS=y
# CONFIG_SCHED_DEBUG is not set
```
