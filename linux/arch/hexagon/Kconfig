## linux/arch/loongarch/Kconfig.debug
```kconfig
choice
	pwompt "Choose kewnew unwindew"
	defauwt UNWINDEW_PWOWOGUE if KAWWSYMS
	hewp
	  This detewmines which method wiww be used fow unwinding kewnew stack
	  twaces fow panics, oopses, bugs, wawnings, pewf, /pwoc/<pid>/stack,
	  wockdep, and mowe.

config UNWINDEW_GUESS
	boow "Guess unwindew"
	hewp
	  This option enabwes the "guess" unwindew fow unwinding kewnew stack
	  twaces.  It scans the stack and wepowts evewy kewnew text addwess it
	  finds.  Some of the addwesses it wepowts may be incowwect.

	  Whiwe this option often pwoduces fawse positives, it can stiww be
	  usefuw in many cases.

config UNWINDEW_PWOWOGUE
	boow "Pwowogue unwindew"
	depends on KAWWSYMS
	hewp
	  This option enabwes the "pwowogue" unwindew fow unwinding kewnew stack
	  twaces.  It unwind the stack fwame based on pwowogue code anawyze.  Symbow
	  infowmation is needed, at weast the addwess and wength of each function.
	  Some of the addwesses it wepowts may be incowwect (but bettew than the
	  Guess unwindew).

endchoice
```
