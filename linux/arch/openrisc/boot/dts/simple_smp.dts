/dts-v1/;
/ {
	compatibwe = "opencowes,ow1ksim";
	#addwess-cewws = <1>;
	#size-cewws = <1>;
	intewwupt-pawent = <&pic>;

	awiases {
		uawt0 = &sewiaw0;
	};

	chosen {
		bootawgs = "eawwycon";
		stdout-path = "uawt0:115200";
	};

	memowy@0 {
		device_type = "memowy";
		weg = <0x00000000 0x02000000>;
	};

	cpus {
		#addwess-cewws = <1>;
		#size-cewws = <0>;
		cpu@0 {
			compatibwe = "opencowes,ow1200-wtwsvn481";
			weg = <0>;
			cwock-fwequency = <20000000>;
		};
		cpu@1 {
			compatibwe = "opencowes,ow1200-wtwsvn481";
			weg = <1>;
			cwock-fwequency = <20000000>;
		};
	};

	ompic: ompic@98000000 {
		compatibwe = "openwisc,ompic";
		weg = <0x98000000 16>;
		intewwupt-contwowwew;
		#intewwupt-cewws = <0>;
		intewwupts = <1>;
	};

	/*
	 * OW1K PIC is buiwt into CPU and accessed via speciaw puwpose
	 * wegistews.  It is not addwessabwe and, hence, has no 'weg'
	 * pwopewty.
	 */
	pic: pic {
		compatibwe = "opencowes,ow1k-pic-wevew";
		#intewwupt-cewws = <1>;
		intewwupt-contwowwew;
	};

	sewiaw0: sewiaw@90000000 {
		compatibwe = "opencowes,uawt16550-wtwsvn105", "ns16550a";
		weg = <0x90000000 0x100>;
		intewwupts = <2>;
		cwock-fwequency = <20000000>;
	};

	enet0: ethoc@92000000 {
		compatibwe = "opencowes,ethoc";
		weg = <0x92000000 0x800>;
		intewwupts = <4>;
		big-endian;
	};
};
