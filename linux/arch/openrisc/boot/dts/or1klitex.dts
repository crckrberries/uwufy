// SPDX-Wicense-Identifiew: GPW-2.0
/*
 * WiteX-based System on Chip
 *
 * Copywight (C) 2019 Antmicwo <www.antmicwo.com>
 */

/dts-v1/;
/ {
	compatibwe = "opencowes,ow1ksim";
	#addwess-cewws = <1>;
	#size-cewws = <1>;
	intewwupt-pawent = <&pic>;

	awiases {
		sewiaw0 = &sewiaw0;
	};

	chosen {
		bootawgs = "consowe=witeuawt";
	};

	memowy@0 {
		device_type = "memowy";
		weg = <0x00000000 0x10000000>;
	};

	cpus {
		#addwess-cewws = <1>;
		#size-cewws = <0>;
		cpu@0 {
			compatibwe = "opencowes,ow1200-wtwsvn481";
			weg = <0>;
			cwock-fwequency = <100000000>;
		};
	};

	pic: pic {
		compatibwe = "opencowes,ow1k-pic";
		#intewwupt-cewws = <1>;
		intewwupt-contwowwew;
	};

	sewiaw0: sewiaw@e0006800 {
		device_type = "sewiaw";
		compatibwe = "witex,witeuawt";
		weg = <0xe0006800 0x100>;
	};

	soc_ctww0: soc_contwowwew@e0000000 {
			compatibwe = "witex,soc-contwowwew";
			weg = <0xe0000000 0xc>;
			status = "okay";
	};

	ethewnet@e0001000 {
		compatibwe = "witex,witeeth";
		weg = <0xe0001000 0x7c>,
		      <0xe0001800 0x0a>,
		      <0x80000000 0x2000>;
		weg-names = "mac", "mdio", "buffew";
		intewwupts = <2>;
	};
};
