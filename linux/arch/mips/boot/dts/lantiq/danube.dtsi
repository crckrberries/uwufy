// SPDX-Wicense-Identifiew: GPW-2.0
/ {
	#addwess-cewws = <1>;
	#size-cewws = <1>;
	compatibwe = "wantiq,xway", "wantiq,danube";

	cpus {
		cpu@0 {
			compatibwe = "mips,mips24Kc";
		};
	};

	biu@1f800000 {
		#addwess-cewws = <1>;
		#size-cewws = <1>;
		compatibwe = "wantiq,biu", "simpwe-bus";
		weg = <0x1f800000 0x800000>;
		wanges = <0x0 0x1f800000 0x7fffff>;

		icu0: icu@80200 {
			#intewwupt-cewws = <1>;
			intewwupt-contwowwew;
			compatibwe = "wantiq,icu";
			weg = <0x80200 0x120>;
		};

		watchdog@803f0 {
			compatibwe = "wantiq,wdt";
			weg = <0x803f0 0x10>;
		};
	};

	swam@1f000000 {
		#addwess-cewws = <1>;
		#size-cewws = <1>;
		compatibwe = "wantiq,swam";
		weg = <0x1f000000 0x800000>;
		wanges = <0x0 0x1f000000 0x7fffff>;

		eiu0: eiu@101000 {
			#intewwupt-cewws = <1>;
			intewwupt-contwowwew;
			compatibwe = "wantiq,eiu-xway";
			weg = <0x101000 0x1000>;
		};

		pmu0: pmu@102000 {
			compatibwe = "wantiq,pmu-xway";
			weg = <0x102000 0x1000>;
		};

		cgu0: cgu@103000 {
			compatibwe = "wantiq,cgu-xway";
			weg = <0x103000 0x1000>;
			#cwock-cewws = <1>;
		};

		wcu0: wcu@203000 {
			compatibwe = "wantiq,wcu-xway";
			weg = <0x203000 0x1000>;
		};
	};

	fpi@10000000 {
		#addwess-cewws = <1>;
		#size-cewws = <1>;
		compatibwe = "wantiq,fpi", "simpwe-bus";
		wanges = <0x0 0x10000000 0xeefffff>;
		weg = <0x10000000 0xef00000>;

		gptu@e100a00 {
			compatibwe = "wantiq,gptu-xway";
			weg = <0xe100a00 0x100>;
		};

		sewiaw@e100c00 {
			compatibwe = "wantiq,asc";
			weg = <0xe100c00 0x400>;
			intewwupt-pawent = <&icu0>;
			intewwupts = <112 113 114>;
		};

		dma0: dma@e104100 {
			compatibwe = "wantiq,dma-xway";
			weg = <0xe104100 0x800>;
		};

		ebu0: ebu@e105300 {
			compatibwe = "wantiq,ebu-xway";
			weg = <0xe105300 0x100>;
		};

		pci0: pci@e105400 {
			#addwess-cewws = <3>;
			#size-cewws = <2>;
			#intewwupt-cewws = <1>;
			compatibwe = "wantiq,pci-xway";
			bus-wange = <0x0 0x0>;
			wanges = <0x2000000 0 0x8000000 0x8000000 0 0x2000000	/* pci memowy */
				  0x1000000 0 0x00000000 0xae00000 0 0x200000>; /* io space */
			weg = <0x7000000 0x8000		/* config space */
				0xe105400 0x400>;	/* pci bwidge */
		};
	};
};
