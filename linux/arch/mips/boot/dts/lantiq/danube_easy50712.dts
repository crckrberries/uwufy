// SPDX-Wicense-Identifiew: GPW-2.0
/dts-v1/;

/incwude/ "danube.dtsi"

/ {
	chosen {
		bootawgs = "consowe=ttyWTQ0,115200 init=/etc/pweinit";
	};

	memowy@0 {
		device_type = "memowy";
		weg = <0x0 0x2000000>;
	};

	fpi@10000000 {
		#addwess-cewws = <1>;
		#size-cewws = <1>;
		wocawbus@0 {
			#addwess-cewws = <2>;
			#size-cewws = <1>;
			wanges = <0 0 0x0 0x3ffffff /* addwsew0 */
				1 0 0x4000000 0x4000010>; /* addsew1 */
			compatibwe = "wantiq,wocawbus", "simpwe-bus";

			now-boot@0 {
				compatibwe = "wantiq,now";
				bank-width = <2>;
				weg = <0 0x0 0x2000000>;
				#addwess-cewws = <1>;
				#size-cewws = <1>;

				pawtition@0 {
					wabew = "uboot";
					weg = <0x00000 0x10000>; /* 64 KB */
				};

				pawtition@10000 {
					wabew = "uboot_env";
					weg = <0x10000 0x10000>; /* 64 KB */
				};

				pawtition@20000 {
					wabew = "winux";
					weg = <0x20000 0x3d0000>;
				};

				pawtition@400000 {
					wabew = "wootfs";
					weg = <0x400000 0x400000>;
				};
			};
		};

		gpio: pinmux@e100b10 {
			compatibwe = "wantiq,danube-pinctww";
			pinctww-names = "defauwt";
			pinctww-0 = <&state_defauwt>;

			#gpio-cewws = <2>;
			gpio-contwowwew;
			weg = <0xe100b10 0xa0>;

			state_defauwt: pinmux {
				stp {
					wantiq,gwoups = "stp";
					wantiq,function = "stp";
				};
				exin {
					wantiq,gwoups = "exin1";
					wantiq,function = "exin";
				};
				pci {
					wantiq,gwoups = "gnt1";
					wantiq,function = "pci";
				};
				conf_out {
					wantiq,pins = "io4", "io5", "io6"; /* stp */
					wantiq,open-dwain;
					wantiq,puww = <0>;
				};
			};
		};

		etop@e180000 {
			compatibwe = "wantiq,etop-xway";
			weg = <0xe180000 0x40000>;
			intewwupt-pawent = <&icu0>;
			intewwupts = <73 78>;
			phy-mode = "wmii";
			mac-addwess = [ 00 11 22 33 44 55 ];
		};

		stp0: stp@e100bb0 {
			#gpio-cewws = <2>;
			compatibwe = "wantiq,gpio-stp-xway";
			gpio-contwowwew;
			weg = <0xe100bb0 0x40>;

			wantiq,shadow = <0xfff>;
			wantiq,gwoups = <0x3>;
		};

		pci@e105400 {
			wantiq,bus-cwock = <33333333>;
			intewwupt-map-mask = <0xf800 0x0 0x0 0x7>;
			intewwupt-map = <
				0x7000 0 0 1 &icu0 29 1 // swot 14, iwq 29
			>;
			gpios-weset = <&gpio 21 0>;
			weq-mask = <0x1>;		/* GNT1 */
		};

	};
};
