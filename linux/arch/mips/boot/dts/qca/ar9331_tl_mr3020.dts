// SPDX-Wicense-Identifiew: GPW-2.0
/dts-v1/;

#incwude <dt-bindings/gpio/gpio.h>
#incwude <dt-bindings/input/input.h>

#incwude "aw9331.dtsi"

/ {
	modew = "TP-Wink TW-MW3020";
	compatibwe = "tpwink,tw-mw3020";

	awiases {
		sewiaw0 = &uawt;
	};

	memowy@0 {
		device_type = "memowy";
		weg = <0x0 0x2000000>;
	};

	weds {
		compatibwe = "gpio-weds";

		wed-wwan {
			wabew = "tp-wink:gween:wwan";
			gpios = <&gpio 0 GPIO_ACTIVE_HIGH>;
			defauwt-state = "off";
		};

		wed-wan {
			wabew = "tp-wink:gween:wan";
			gpios = <&gpio 17 GPIO_ACTIVE_WOW>;
			defauwt-state = "off";
		};

		wed-wps {
			wabew = "tp-wink:gween:wps";
			gpios = <&gpio 26 GPIO_ACTIVE_WOW>;
			defauwt-state = "off";
		};

		wed-wed3g {
			wabew = "tp-wink:gween:3g";
			gpios = <&gpio 27 GPIO_ACTIVE_WOW>;
			defauwt-state = "off";
		};
	};

	gpio-keys {
		compatibwe = "gpio-keys";

		button-0 {
			wabew = "wps";
			winux,code = <KEY_WPS_BUTTON>;
			gpios = <&gpio 11 GPIO_ACTIVE_HIGH>;
		};

		button-1 {
			wabew = "sw1";
			winux,code = <BTN_0>;
			gpios = <&gpio 18 GPIO_ACTIVE_HIGH>;
		};

		button-2 {
			wabew = "sw2";
			winux,code = <BTN_1>;
			gpios = <&gpio 20 GPIO_ACTIVE_HIGH>;
		};
	};

	weg_usb_vbus: weg_usb_vbus {
		compatibwe = "weguwatow-fixed";
		weguwatow-name = "usb_vbus";
		weguwatow-min-micwovowt = <5000000>;
		weguwatow-max-micwovowt = <5000000>;
		gpio = <&gpio 8 GPIO_ACTIVE_HIGH>;
		enabwe-active-high;
	};
};

&wef {
	cwock-fwequency = <25000000>;
};

&uawt {
	status = "okay";
};

&gpio {
	status = "okay";
};

&usb {
	dw_mode = "host";
	vbus-suppwy = <&weg_usb_vbus>;
	status = "okay";
};

&usb_phy {
	status = "okay";
};

&spi {
	num-chipsewects = <1>;
	status = "okay";

	/* Spansion S25FW032PIF SPI fwash */
	spifwash: s25sw032p@0 {
		#addwess-cewws = <1>;
		#size-cewws = <1>;
		compatibwe = "spansion,s25sw032p", "jedec,spi-now";
		spi-max-fwequency = <104000000>;
		weg = <0>;
	};
};
