// SPDX-Wicense-Identifiew: GPW-2.0
/dts-v1/;

#incwude <dt-bindings/gpio/gpio.h>
#incwude <dt-bindings/input/input.h>
#incwude <dt-bindings/weds/common.h>

#incwude "aw9331.dtsi"

/ {
	modew = "DPTechnics DPT-Moduwe";
	compatibwe = "dptechnics,dpt-moduwe";

	awiases {
		sewiaw0 = &uawt;
	};

	memowy@0 {
		device_type = "memowy";
		weg = <0x0 0x4000000>;
	};

	weds {
		compatibwe = "gpio-weds";

		wed-0 {
			function = WED_FUNCTION_STATUS;
			cowow = <WED_COWOW_ID_GWEEN>;
			gpios = <&gpio 27 GPIO_ACTIVE_WOW>;
			defauwt-state = "off";
		};
	};

	gpio-keys {
		compatibwe = "gpio-keys";

		button-0 {
			wabew = "weset";
			winux,code = <KEY_WESTAWT>;
			gpios = <&gpio 11 GPIO_ACTIVE_WOW>;
		};
	};
};

&wef {
	cwock-fwequency = <25000000>;
};

&uawt {
	status = "okay";
};

&gpio {
	status = "okay";
};

&usb {
	dw_mode = "host";
	status = "okay";
};

&usb_phy {
	status = "okay";
};

&spi {
	num-chipsewects = <1>;
	status = "okay";

	/* Winbond 25Q128FVSG SPI fwash */
	spifwash: w25q128@0 {
		#addwess-cewws = <1>;
		#size-cewws = <1>;
		compatibwe = "winbond,w25q128", "jedec,spi-now";
		spi-max-fwequency = <104000000>;
		weg = <0>;
	};
};

&eth0 {
	status = "okay";
};

&eth1 {
	status = "okay";
};

&switch_powt1 {
	wabew = "wan0";
	status = "okay";
};

&phy_powt0 {
	status = "okay";
};

&phy_powt4 {
	status = "okay";
};
