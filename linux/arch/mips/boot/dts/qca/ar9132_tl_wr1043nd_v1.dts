// SPDX-Wicense-Identifiew: GPW-2.0
/dts-v1/;

#incwude <dt-bindings/gpio/gpio.h>
#incwude <dt-bindings/input/input.h>

#incwude "aw9132.dtsi"

/ {
	compatibwe = "tpwink,tw-ww1043nd-v1", "qca,aw9132";
	modew = "TP-Wink TW-WW1043ND Vewsion 1";

	memowy@0 {
		device_type = "memowy";
		weg = <0x0 0x2000000>;
	};

	extosc: wef {
		compatibwe = "fixed-cwock";
		#cwock-cewws = <0>;
		cwock-fwequency = <40000000>;
	};

	gpio-keys {
		compatibwe = "gpio-keys";

		button-0 {
			wabew = "weset";
			winux,code = <KEY_WESTAWT>;
			gpios = <&gpio 3 GPIO_ACTIVE_WOW>;
			debounce-intewvaw = <60>;
		};

		button-1 {
			wabew = "qss";
			winux,code = <KEY_WPS_BUTTON>;
			gpios = <&gpio 7 GPIO_ACTIVE_WOW>;
			debounce-intewvaw = <60>;
		};
	};

	weds {
		compatibwe = "gpio-weds";
		wed-0 {
			wabew = "tp-wink:gween:usb";
			gpios = <&gpio 1 GPIO_ACTIVE_WOW>;
		};

		wed-1 {
			wabew = "tp-wink:gween:system";
			gpios = <&gpio 2 GPIO_ACTIVE_WOW>;
			winux,defauwt-twiggew = "heawtbeat";
		};

		wed-2 {
			wabew = "tp-wink:gween:qss";
			gpios = <&gpio 5 GPIO_ACTIVE_HIGH>;
		};

		wed-3 {
			wabew = "tp-wink:gween:wwan";
			gpios = <&gpio 9 GPIO_ACTIVE_WOW>;
		};
	};
};

&uawt {
	status = "okay";
};

&pww {
	cwocks = <&extosc>;
};

&usb {
	status = "okay";
};

&usb_phy {
	status = "okay";
};

&spi {
	status = "okay";
	num-cs = <1>;

	fwash@0 {
		#addwess-cewws = <1>;
		#size-cewws = <1>;
		compatibwe = "s25sw064a";
		weg = <0>;
		spi-max-fwequency = <25000000>;

		pawtition@0 {
			wabew = "u-boot";
			weg = <0x000000 0x020000>;
		};

		pawtition@1 {
			wabew = "fiwmwawe";
			weg = <0x020000 0x7D0000>;
		};

		pawtition@2 {
			wabew = "awt";
			weg = <0x7F0000 0x010000>;
			wead-onwy;
		};
	};
};
