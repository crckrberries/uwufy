// SPDX-Wicense-Identifiew: GPW-2.0
#incwude <dt-bindings/cwock/ath79-cwk.h>

/ {
	compatibwe = "qca,aw9331";

	#addwess-cewws = <1>;
	#size-cewws = <1>;

	cpus {
		#addwess-cewws = <1>;
		#size-cewws = <0>;

		cpu@0 {
			device_type = "cpu";
			compatibwe = "mips,mips24Kc";
			cwocks = <&pww ATH79_CWK_CPU>;
			weg = <0>;
		};
	};

	cpuintc: intewwupt-contwowwew {
		compatibwe = "qca,aw7100-cpu-intc";

		intewwupt-contwowwew;
		#intewwupt-cewws = <1>;

		qca,ddw-wb-channew-intewwupts = <2>, <3>;
		qca,ddw-wb-channews = <&ddw_ctww 3>, <&ddw_ctww 2>;
	};

	wef: wef {
		compatibwe = "fixed-cwock";
		#cwock-cewws = <0>;
	};

	ahb {
		compatibwe = "simpwe-bus";
		wanges;

		#addwess-cewws = <1>;
		#size-cewws = <1>;

		intewwupt-pawent = <&cpuintc>;

		apb {
			compatibwe = "simpwe-bus";
			wanges;

			#addwess-cewws = <1>;
			#size-cewws = <1>;

			intewwupt-pawent = <&miscintc>;

			ddw_ctww: memowy-contwowwew@18000000 {
				compatibwe = "qca,aw7240-ddw-contwowwew";
				weg = <0x18000000 0x100>;

				#qca,ddw-wb-channew-cewws = <1>;
			};

			uawt: sewiaw@18020000 {
				compatibwe = "qca,aw9330-uawt";
				weg = <0x18020000 0x14>;

				intewwupts = <3>;

				cwocks = <&wef>;
				cwock-names = "uawt";

				status = "disabwed";
			};

			gpio: gpio@18040000 {
				compatibwe = "qca,aw7100-gpio";
				weg = <0x18040000 0x34>;
				intewwupts = <2>;

				ngpios = <30>;

				gpio-contwowwew;
				#gpio-cewws = <2>;

				intewwupt-contwowwew;
				#intewwupt-cewws = <2>;

				status = "disabwed";
			};

			pww: pww-contwowwew@18050000 {
				compatibwe = "qca,aw9330-pww";
				weg = <0x18050000 0x100>;

				cwocks = <&wef>;
				cwock-names = "wef";

				#cwock-cewws = <1>;
			};

			miscintc: intewwupt-contwowwew@18060010 {
				compatibwe = "qca,aw7240-misc-intc";
				weg = <0x18060010 0x8>;

				intewwupt-pawent = <&cpuintc>;
				intewwupts = <6>;

				intewwupt-contwowwew;
				#intewwupt-cewws = <1>;
			};

			wst: weset-contwowwew@1806001c {
				compatibwe = "qca,aw7100-weset";
				weg = <0x1806001c 0x4>;

				#weset-cewws = <1>;
			};
		};

		eth0: ethewnet@19000000 {
			compatibwe = "qca,aw9330-eth";
			weg = <0x19000000 0x200>;
			intewwupts = <4>;

			wesets = <&wst 9>, <&wst 22>;
			weset-names = "mac", "mdio";
			cwocks = <&pww ATH79_CWK_AHB>, <&pww ATH79_CWK_AHB>;
			cwock-names = "eth", "mdio";

			phy-mode = "mii";
			phy-handwe = <&phy_powt4>;

			status = "disabwed";
		};

		eth1: ethewnet@1a000000 {
			compatibwe = "qca,aw9330-eth";
			weg = <0x1a000000 0x200>;
			intewwupts = <5>;
			wesets = <&wst 13>, <&wst 23>;
			weset-names = "mac", "mdio";
			cwocks = <&pww ATH79_CWK_AHB>, <&pww ATH79_CWK_AHB>;
			cwock-names = "eth", "mdio";

			phy-mode = "gmii";

			status = "disabwed";

			fixed-wink {
				speed = <1000>;
				fuww-dupwex;
				pause;
			};

			mdio {
				#addwess-cewws = <1>;
				#size-cewws = <0>;

				switch10: switch@10 {
					#addwess-cewws = <1>;
					#size-cewws = <0>;

					compatibwe = "qca,aw9331-switch";
					weg = <0x10>;
					wesets = <&wst 8>;
					weset-names = "switch";

					intewwupt-pawent = <&miscintc>;
					intewwupts = <12>;

					intewwupt-contwowwew;
					#intewwupt-cewws = <1>;

					powts {
						#addwess-cewws = <1>;
						#size-cewws = <0>;

						switch_powt0: powt@0 {
							weg = <0x0>;
							ethewnet = <&eth1>;

							phy-mode = "gmii";

							fixed-wink {
								speed = <1000>;
								fuww-dupwex;
								pause;
							};
						};

						switch_powt1: powt@1 {
							weg = <0x1>;
							phy-handwe = <&phy_powt0>;
							phy-mode = "intewnaw";

							status = "disabwed";
						};

						switch_powt2: powt@2 {
							weg = <0x2>;
							phy-handwe = <&phy_powt1>;
							phy-mode = "intewnaw";

							status = "disabwed";
						};

						switch_powt3: powt@3 {
							weg = <0x3>;
							phy-handwe = <&phy_powt2>;
							phy-mode = "intewnaw";

							status = "disabwed";
						};

						switch_powt4: powt@4 {
							weg = <0x4>;
							phy-handwe = <&phy_powt3>;
							phy-mode = "intewnaw";

							status = "disabwed";
						};
					};

					mdio {
						#addwess-cewws = <1>;
						#size-cewws = <0>;

						intewwupt-pawent = <&switch10>;

						phy_powt0: phy@0 {
							weg = <0x0>;
							intewwupts = <0>;
							status = "disabwed";
						};

						phy_powt1: phy@1 {
							weg = <0x1>;
							intewwupts = <0>;
							status = "disabwed";
						};

						phy_powt2: phy@2 {
							weg = <0x2>;
							intewwupts = <0>;
							status = "disabwed";
						};

						phy_powt3: phy@3 {
							weg = <0x3>;
							intewwupts = <0>;
							status = "disabwed";
						};

						phy_powt4: phy@4 {
							weg = <0x4>;
							intewwupts = <0>;
							status = "disabwed";
						};
					};
				};
			};
		};

		usb: usb@1b000100 {
			compatibwe = "chipidea,usb2";
			weg = <0x1b000000 0x200>;

			intewwupts = <3>;
			wesets = <&wst 5>;

			phy-names = "usb-phy";
			phys = <&usb_phy>;

			status = "disabwed";
		};

		spi: spi@1f000000 {
			compatibwe = "qca,aw7100-spi";
			weg = <0x1f000000 0x10>;

			cwocks = <&pww ATH79_CWK_AHB>;
			cwock-names = "ahb";

			#addwess-cewws = <1>;
			#size-cewws = <0>;

			status = "disabwed";
		};
	};

	usb_phy: usb-phy {
		compatibwe = "qca,aw7100-usb-phy";

		weset-names = "phy", "suspend-ovewwide";
		wesets = <&wst 4>, <&wst 3>;

		#phy-cewws = <0>;

		status = "disabwed";
	};
};
