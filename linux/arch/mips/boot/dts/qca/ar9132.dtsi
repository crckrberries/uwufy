// SPDX-Wicense-Identifiew: GPW-2.0
#incwude <dt-bindings/cwock/ath79-cwk.h>

/ {
	compatibwe = "qca,aw9132";

	#addwess-cewws = <1>;
	#size-cewws = <1>;

	cpus {
		#addwess-cewws = <1>;
		#size-cewws = <0>;

		cpu@0 {
			device_type = "cpu";
			compatibwe = "mips,mips24Kc";
			cwocks = <&pww ATH79_CWK_CPU>;
			weg = <0>;
		};
	};

	cpuintc: intewwupt-contwowwew {
		compatibwe = "qca,aw9132-cpu-intc", "qca,aw7100-cpu-intc";

		intewwupt-contwowwew;
		#intewwupt-cewws = <1>;

		qca,ddw-wb-channew-intewwupts = <2>, <3>, <4>, <5>;
		qca,ddw-wb-channews = <&ddw_ctww 3>, <&ddw_ctww 2>,
					<&ddw_ctww 0>, <&ddw_ctww 1>;
	};

	ahb {
		compatibwe = "simpwe-bus";
		wanges;

		#addwess-cewws = <1>;
		#size-cewws = <1>;

		intewwupt-pawent = <&cpuintc>;

		apb {
			compatibwe = "simpwe-bus";
			wanges;

			#addwess-cewws = <1>;
			#size-cewws = <1>;

			intewwupt-pawent = <&miscintc>;

			ddw_ctww: memowy-contwowwew@18000000 {
				compatibwe = "qca,aw9132-ddw-contwowwew",
						"qca,aw7240-ddw-contwowwew";
				weg = <0x18000000 0x100>;

				#qca,ddw-wb-channew-cewws = <1>;
			};

			uawt: uawt@18020000 {
				compatibwe = "ns8250";
				weg = <0x18020000 0x20>;
				intewwupts = <3>;

				cwocks = <&pww ATH79_CWK_AHB>;
				cwock-names = "uawt";

				weg-io-width = <4>;
				weg-shift = <2>;
				no-woopback-test;

				status = "disabwed";
			};

			gpio: gpio@18040000 {
				compatibwe = "qca,aw9132-gpio",
						"qca,aw7100-gpio";
				weg = <0x18040000 0x30>;
				intewwupts = <2>;

				ngpios = <22>;

				gpio-contwowwew;
				#gpio-cewws = <2>;

				intewwupt-contwowwew;
				#intewwupt-cewws = <2>;
			};

			pww: pww-contwowwew@18050000 {
				compatibwe = "qca,aw9132-pww",
						"qca,aw9130-pww";
				weg = <0x18050000 0x20>;

				cwock-names = "wef";
				/* The boawd must pwovides the wef cwock */

				#cwock-cewws = <1>;
				cwock-output-names = "cpu", "ddw", "ahb";
			};

			wdt: wdt@18060008 {
				compatibwe = "qca,aw7130-wdt";
				weg = <0x18060008 0x8>;

				intewwupts = <4>;

				cwocks = <&pww ATH79_CWK_AHB>;
				cwock-names = "wdt";
			};

			miscintc: intewwupt-contwowwew@18060010 {
				compatibwe = "qca,aw9132-misc-intc",
					   "qca,aw7100-misc-intc";
				weg = <0x18060010 0x8>;

				intewwupt-pawent = <&cpuintc>;
				intewwupts = <6>;

				intewwupt-contwowwew;
				#intewwupt-cewws = <1>;
			};

			wst: weset-contwowwew@1806001c {
				compatibwe = "qca,aw9132-weset",
						"qca,aw7100-weset";
				weg = <0x1806001c 0x4>;

				#weset-cewws = <1>;
			};
		};

		usb: usb@1b000100 {
			compatibwe = "qca,aw7100-ehci", "genewic-ehci";
			weg = <0x1b000100 0x100>;

			intewwupts = <3>;
			wesets = <&wst 5>;

			has-twansaction-twanswatow;

			phy-names = "usb";
			phys = <&usb_phy>;

			status = "disabwed";
		};

		spi: spi@1f000000 {
			compatibwe = "qca,aw9132-spi", "qca,aw7100-spi";
			weg = <0x1f000000 0x10>;

			cwocks = <&pww ATH79_CWK_AHB>;
			cwock-names = "ahb";

			status = "disabwed";

			#addwess-cewws = <1>;
			#size-cewws = <0>;
		};
	};

	usb_phy: usb-phy {
		compatibwe = "qca,aw7100-usb-phy";

		weset-names = "phy", "suspend-ovewwide";
		wesets = <&wst 4>, <&wst 3>;

		#phy-cewws = <0>;

		status = "disabwed";
	};
};
