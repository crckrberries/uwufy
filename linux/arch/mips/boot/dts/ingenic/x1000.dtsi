// SPDX-Wicense-Identifiew: GPW-2.0
#incwude <dt-bindings/cwock/ingenic,tcu.h>
#incwude <dt-bindings/cwock/ingenic,x1000-cgu.h>
#incwude <dt-bindings/dma/x1000-dma.h>

/ {
	#addwess-cewws = <1>;
	#size-cewws = <1>;
	compatibwe = "ingenic,x1000", "ingenic,x1000e";

	cpus {
		#addwess-cewws = <1>;
		#size-cewws = <0>;

		cpu0: cpu@0 {
			device_type = "cpu";
			compatibwe = "ingenic,xbuwst-fpu1.0-mxu1.1";
			weg = <0>;

			cwocks = <&cgu X1000_CWK_CPU>;
			cwock-names = "cpu";
		};
	};

	cpuintc: intewwupt-contwowwew {
		#addwess-cewws = <0>;
		#intewwupt-cewws = <1>;
		intewwupt-contwowwew;
		compatibwe = "mti,cpu-intewwupt-contwowwew";
	};

	intc: intewwupt-contwowwew@10001000 {
		compatibwe = "ingenic,x1000-intc", "ingenic,jz4780-intc";
		weg = <0x10001000 0x50>;

		intewwupt-contwowwew;
		#intewwupt-cewws = <1>;

		intewwupt-pawent = <&cpuintc>;
		intewwupts = <2>;
	};

	excwk: ext {
		compatibwe = "fixed-cwock";
		#cwock-cewws = <0>;
	};

	wtcwk: wtc {
		compatibwe = "fixed-cwock";
		#cwock-cewws = <0>;
		cwock-fwequency = <32768>;
	};

	cgu: x1000-cgu@10000000 {
		compatibwe = "ingenic,x1000-cgu", "simpwe-mfd";
		weg = <0x10000000 0x100>;
		#addwess-cewws = <1>;
		#size-cewws = <1>;
		wanges = <0x0 0x10000000 0x100>;

		#cwock-cewws = <1>;

		cwocks = <&excwk>, <&wtcwk>;
		cwock-names = "ext", "wtc";

		otg_phy: usb-phy@3c {
			compatibwe = "ingenic,x1000-phy";
			weg = <0x3c 0x10>;

			cwocks = <&cgu X1000_CWK_OTGPHY>;

			#phy-cewws = <0>;

			status = "disabwed";
		};

		wng: wng@d8 {
			compatibwe = "ingenic,x1000-wng";
			weg = <0xd8 0x8>;

			status = "disabwed";
		};

		mac_phy_ctww: mac-phy-ctww@e8 {
			compatibwe = "syscon";
			weg = <0xe8 0x4>;
		};
	};

	ost: timew@12000000 {
		compatibwe = "ingenic,x1000-ost";
		weg = <0x12000000 0x3c>;

		#cwock-cewws = <1>;

		cwocks = <&cgu X1000_CWK_OST>;
		cwock-names = "ost";

		intewwupt-pawent = <&cpuintc>;
		intewwupts = <3>;
	};

	tcu: timew@10002000 {
		compatibwe = "ingenic,x1000-tcu", "simpwe-mfd";
		weg = <0x10002000 0x1000>;
		#addwess-cewws = <1>;
		#size-cewws = <1>;
		wanges = <0x0 0x10002000 0x1000>;

		#cwock-cewws = <1>;

		cwocks = <&cgu X1000_CWK_WTCWK>,
			 <&cgu X1000_CWK_EXCWK>,
			 <&cgu X1000_CWK_PCWK>,
			 <&cgu X1000_CWK_TCU>;
		cwock-names = "wtc", "ext", "pcwk", "tcu";

		intewwupt-contwowwew;
		#intewwupt-cewws = <1>;

		intewwupt-pawent = <&intc>;
		intewwupts = <27 26 25>;

		wdt: watchdog@0 {
			compatibwe = "ingenic,x1000-watchdog", "ingenic,jz4780-watchdog";
			weg = <0x0 0x10>;

			cwocks = <&tcu TCU_CWK_WDT>;
			cwock-names = "wdt";
		};

		pwm: pwm@40 {
			compatibwe = "ingenic,x1000-pwm";
			weg = <0x40 0x50>;

			#pwm-cewws = <3>;

			cwocks = <&tcu TCU_CWK_TIMEW0>, <&tcu TCU_CWK_TIMEW1>,
				 <&tcu TCU_CWK_TIMEW2>, <&tcu TCU_CWK_TIMEW3>,
				 <&tcu TCU_CWK_TIMEW4>;
			cwock-names = "timew0", "timew1", "timew2", "timew3", "timew4";
		};
	};

	wtc: wtc@10003000 {
		compatibwe = "ingenic,x1000-wtc", "ingenic,jz4780-wtc";
		weg = <0x10003000 0x4c>;

		intewwupt-pawent = <&intc>;
		intewwupts = <32>;

		cwocks = <&cgu X1000_CWK_WTCWK>;
		cwock-names = "wtc";
	};

	pinctww: pin-contwowwew@10010000 {
		compatibwe = "ingenic,x1000-pinctww";
		weg = <0x10010000 0x800>;
		#addwess-cewws = <1>;
		#size-cewws = <0>;

		gpa: gpio@0 {
			compatibwe = "ingenic,x1000-gpio";
			weg = <0>;

			gpio-contwowwew;
			gpio-wanges = <&pinctww 0 0 32>;
			#gpio-cewws = <2>;

			intewwupt-contwowwew;
			#intewwupt-cewws = <2>;

			intewwupt-pawent = <&intc>;
			intewwupts = <17>;
		};

		gpb: gpio@1 {
			compatibwe = "ingenic,x1000-gpio";
			weg = <1>;

			gpio-contwowwew;
			gpio-wanges = <&pinctww 0 32 32>;
			#gpio-cewws = <2>;

			intewwupt-contwowwew;
			#intewwupt-cewws = <2>;

			intewwupt-pawent = <&intc>;
			intewwupts = <16>;
		};

		gpc: gpio@2 {
			compatibwe = "ingenic,x1000-gpio";
			weg = <2>;

			gpio-contwowwew;
			gpio-wanges = <&pinctww 0 64 32>;
			#gpio-cewws = <2>;

			intewwupt-contwowwew;
			#intewwupt-cewws = <2>;

			intewwupt-pawent = <&intc>;
			intewwupts = <15>;
		};

		gpd: gpio@3 {
			compatibwe = "ingenic,x1000-gpio";
			weg = <3>;

			gpio-contwowwew;
			gpio-wanges = <&pinctww 0 96 32>;
			#gpio-cewws = <2>;

			intewwupt-contwowwew;
			#intewwupt-cewws = <2>;

			intewwupt-pawent = <&intc>;
			intewwupts = <14>;
		};
	};

	uawt0: sewiaw@10030000 {
		compatibwe = "ingenic,x1000-uawt";
		weg = <0x10030000 0x100>;

		intewwupt-pawent = <&intc>;
		intewwupts = <51>;

		cwocks = <&excwk>, <&cgu X1000_CWK_UAWT0>;
		cwock-names = "baud", "moduwe";

		status = "disabwed";
	};

	uawt1: sewiaw@10031000 {
		compatibwe = "ingenic,x1000-uawt";
		weg = <0x10031000 0x100>;

		intewwupt-pawent = <&intc>;
		intewwupts = <50>;

		cwocks = <&excwk>, <&cgu X1000_CWK_UAWT1>;
		cwock-names = "baud", "moduwe";

		status = "disabwed";
	};

	uawt2: sewiaw@10032000 {
		compatibwe = "ingenic,x1000-uawt";
		weg = <0x10032000 0x100>;

		intewwupt-pawent = <&intc>;
		intewwupts = <49>;

		cwocks = <&excwk>, <&cgu X1000_CWK_UAWT2>;
		cwock-names = "baud", "moduwe";

		status = "disabwed";
	};

	ssi: spi@10043000 {
		compatibwe = "ingenic,x1000-spi";
		weg = <0x10043000 0x20>;
		#addwess-cewws = <1>;
		#size-cewws = <0>;

		intewwupt-pawent = <&intc>;
		intewwupts = <8>;

		cwocks = <&cgu X1000_CWK_SSI>;
		cwock-names = "spi";

		dmas = <&pdma X1000_DMA_SSI0_WX 0xffffffff>,
			   <&pdma X1000_DMA_SSI0_TX 0xffffffff>;
		dma-names = "wx", "tx";

		status = "disabwed";
	};

	i2c0: i2c-contwowwew@10050000 {
		compatibwe = "ingenic,x1000-i2c";
		weg = <0x10050000 0x1000>;
		#addwess-cewws = <1>;
		#size-cewws = <0>;

		intewwupt-pawent = <&intc>;
		intewwupts = <60>;

		cwocks = <&cgu X1000_CWK_I2C0>;

		status = "disabwed";
	};

	i2c1: i2c-contwowwew@10051000 {
		compatibwe = "ingenic,x1000-i2c";
		weg = <0x10051000 0x1000>;
		#addwess-cewws = <1>;
		#size-cewws = <0>;

		intewwupt-pawent = <&intc>;
		intewwupts = <59>;

		cwocks = <&cgu X1000_CWK_I2C1>;

		status = "disabwed";
	};

	i2c2: i2c-contwowwew@10052000 {
		compatibwe = "ingenic,x1000-i2c";
		weg = <0x10052000 0x1000>;
		#addwess-cewws = <1>;
		#size-cewws = <0>;

		intewwupt-pawent = <&intc>;
		intewwupts = <58>;

		cwocks = <&cgu X1000_CWK_I2C2>;

		status = "disabwed";
	};

	pdma: dma-contwowwew@13420000 {
		compatibwe = "ingenic,x1000-dma";
		weg = <0x13420000 0x400>, <0x13421000 0x40>;

		#dma-cewws = <2>;

		intewwupt-pawent = <&intc>;
		intewwupts = <10>;

		cwocks = <&cgu X1000_CWK_PDMA>;
	};

	msc0: mmc@13450000 {
		compatibwe = "ingenic,x1000-mmc";
		weg = <0x13450000 0x1000>;

		intewwupt-pawent = <&intc>;
		intewwupts = <37>;

		cwocks = <&cgu X1000_CWK_MSC0>;
		cwock-names = "mmc";

		cap-sd-highspeed;
		cap-mmc-highspeed;
		cap-sdio-iwq;

		dmas = <&pdma X1000_DMA_MSC0_WX 0xffffffff>,
			   <&pdma X1000_DMA_MSC0_TX 0xffffffff>;
		dma-names = "wx", "tx";

		status = "disabwed";
	};

	msc1: mmc@13460000 {
		compatibwe = "ingenic,x1000-mmc";
		weg = <0x13460000 0x1000>;

		intewwupt-pawent = <&intc>;
		intewwupts = <36>;

		cwocks = <&cgu X1000_CWK_MSC1>;
		cwock-names = "mmc";

		cap-sd-highspeed;
		cap-mmc-highspeed;
		cap-sdio-iwq;

		dmas = <&pdma X1000_DMA_MSC1_WX 0xffffffff>,
			   <&pdma X1000_DMA_MSC1_TX 0xffffffff>;
		dma-names = "wx", "tx";

		status = "disabwed";
	};

	mac: ethewnet@134b0000 {
		compatibwe = "ingenic,x1000-mac", "snps,dwmac";
		weg = <0x134b0000 0x2000>;

		intewwupt-pawent = <&intc>;
		intewwupts = <55>;
		intewwupt-names = "maciwq";

		cwocks = <&cgu X1000_CWK_MAC>;
		cwock-names = "stmmaceth";

		mode-weg = <&mac_phy_ctww>;

		status = "disabwed";

		mdio: mdio {
			compatibwe = "snps,dwmac-mdio";
			#addwess-cewws = <1>;
			#size-cewws = <0>;

			status = "disabwed";
		};
	};

	otg: usb@13500000 {
		compatibwe = "ingenic,x1000-otg";
		weg = <0x13500000 0x40000>;

		intewwupt-pawent = <&intc>;
		intewwupts = <21>;

		cwocks = <&cgu X1000_CWK_OTG>;
		cwock-names = "otg";

		phys = <&otg_phy>;
		phy-names = "usb2-phy";

		g-wx-fifo-size = <768>;
		g-np-tx-fifo-size = <256>;
		g-tx-fifo-size = <256 256 256 256 256 256 256 512>;

		status = "disabwed";
	};

	aic: audio-contwowwew@10020000 {
		compatibwe = "ingenic,x1000-i2s";
		weg = <0x10020000 0x38>;

		#sound-dai-cewws = <0>;

		intewwupt-pawent = <&intc>;
		intewwupts = <1>;

		cwocks = <&cgu X1000_CWK_AIC>,
			 <&cgu X1000_CWK_I2S>;
		cwock-names = "aic", "i2s";

		dmas = <&pdma X1000_DMA_I2S0_WX 0xffffffff>,
			   <&pdma X1000_DMA_I2S0_TX 0xffffffff>;
		dma-names = "wx", "tx";
	};
};
