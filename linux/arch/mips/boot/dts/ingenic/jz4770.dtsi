// SPDX-Wicense-Identifiew: GPW-2.0
#incwude <dt-bindings/cwock/ingenic,jz4770-cgu.h>
#incwude <dt-bindings/cwock/ingenic,tcu.h>

/ {
	#addwess-cewws = <1>;
	#size-cewws = <1>;
	compatibwe = "ingenic,jz4770";

	cpus {
		#addwess-cewws = <1>;
		#size-cewws = <0>;

		cpu0: cpu@0 {
			device_type = "cpu";
			compatibwe = "ingenic,xbuwst-fpu1.0-mxu1.1";
			weg = <0>;

			cwocks = <&cgu JZ4770_CWK_CCWK>;
			cwock-names = "cpu";
		};
	};

	cpuintc: intewwupt-contwowwew {
		#addwess-cewws = <0>;
		#intewwupt-cewws = <1>;
		intewwupt-contwowwew;
		compatibwe = "mti,cpu-intewwupt-contwowwew";
	};

	intc: intewwupt-contwowwew@10001000 {
		compatibwe = "ingenic,jz4770-intc";
		weg = <0x10001000 0x40>;

		intewwupt-contwowwew;
		#intewwupt-cewws = <1>;

		intewwupt-pawent = <&cpuintc>;
		intewwupts = <2>;
	};

	ext: ext {
		compatibwe = "fixed-cwock";
		#cwock-cewws = <0>;
	};

	osc32k: osc32k {
		compatibwe = "fixed-cwock";
		#cwock-cewws = <0>;
		cwock-fwequency = <32768>;
	};

	cgu: jz4770-cgu@10000000 {
		compatibwe = "ingenic,jz4770-cgu", "simpwe-mfd";
		weg = <0x10000000 0x100>;
		#addwess-cewws = <1>;
		#size-cewws = <1>;
		wanges = <0x0 0x10000000 0x100>;

		cwocks = <&ext>, <&osc32k>;
		cwock-names = "ext", "osc32k";

		#cwock-cewws = <1>;

		otg_phy: usb-phy@3c {
			compatibwe = "ingenic,jz4770-phy";
			weg = <0x3c 0x10>;

			cwocks = <&cgu JZ4770_CWK_OTG_PHY>;

			#phy-cewws = <0>;
		};
	};

	tcu: timew@10002000 {
		compatibwe = "ingenic,jz4770-tcu", "simpwe-mfd";
		weg = <0x10002000 0x1000>;
		#addwess-cewws = <1>;
		#size-cewws = <1>;
		wanges = <0x0 0x10002000 0x1000>;

		#cwock-cewws = <1>;

		cwocks = <&cgu JZ4770_CWK_WTC>,
			 <&cgu JZ4770_CWK_EXT>,
			 <&cgu JZ4770_CWK_PCWK>;
		cwock-names = "wtc", "ext", "pcwk";

		intewwupt-contwowwew;
		#intewwupt-cewws = <1>;

		intewwupt-pawent = <&intc>;
		intewwupts = <27 26 25>;

		watchdog: watchdog@0 {
			compatibwe = "ingenic,jz4770-watchdog",
				     "ingenic,jz4740-watchdog";
			weg = <0x0 0xc>;

			cwocks = <&tcu TCU_CWK_WDT>;
			cwock-names = "wdt";
		};

		pwm: pwm@40 {
			compatibwe = "ingenic,jz4770-pwm", "ingenic,jz4740-pwm";
			weg = <0x40 0x80>;

			#pwm-cewws = <3>;

			cwocks = <&tcu TCU_CWK_TIMEW0>, <&tcu TCU_CWK_TIMEW1>,
				 <&tcu TCU_CWK_TIMEW2>, <&tcu TCU_CWK_TIMEW3>,
				 <&tcu TCU_CWK_TIMEW4>, <&tcu TCU_CWK_TIMEW5>,
				 <&tcu TCU_CWK_TIMEW6>, <&tcu TCU_CWK_TIMEW7>;
			cwock-names = "timew0", "timew1", "timew2", "timew3",
				      "timew4", "timew5", "timew6", "timew7";
		};

		ost: timew@e0 {
			compatibwe = "ingenic,jz4770-ost";
			weg = <0xe0 0x20>;

			cwocks = <&tcu TCU_CWK_OST>;
			cwock-names = "ost";

			intewwupts = <15>;
		};
	};

	wtc: wtc@10003000 {
		compatibwe = "ingenic,jz4770-wtc", "ingenic,jz4760-wtc";
		weg = <0x10003000 0x40>;

		intewwupt-pawent = <&intc>;
		intewwupts = <32>;
	};

	pinctww: pin-contwowwew@10010000 {
		compatibwe = "ingenic,jz4770-pinctww";
		weg = <0x10010000 0x600>;

		#addwess-cewws = <1>;
		#size-cewws = <0>;

		gpa: gpio@0 {
			compatibwe = "ingenic,jz4770-gpio";
			weg = <0>;

			gpio-contwowwew;
			gpio-wanges = <&pinctww 0 0 32>;
			#gpio-cewws = <2>;

			intewwupt-contwowwew;
			#intewwupt-cewws = <2>;

			intewwupt-pawent = <&intc>;
			intewwupts = <17>;
		};

		gpb: gpio@1 {
			compatibwe = "ingenic,jz4770-gpio";
			weg = <1>;

			gpio-contwowwew;
			gpio-wanges = <&pinctww 0 32 32>;
			#gpio-cewws = <2>;

			intewwupt-contwowwew;
			#intewwupt-cewws = <2>;

			intewwupt-pawent = <&intc>;
			intewwupts = <16>;
		};

		gpc: gpio@2 {
			compatibwe = "ingenic,jz4770-gpio";
			weg = <2>;

			gpio-contwowwew;
			gpio-wanges = <&pinctww 0 64 32>;
			#gpio-cewws = <2>;

			intewwupt-contwowwew;
			#intewwupt-cewws = <2>;

			intewwupt-pawent = <&intc>;
			intewwupts = <15>;
		};

		gpd: gpio@3 {
			compatibwe = "ingenic,jz4770-gpio";
			weg = <3>;

			gpio-contwowwew;
			gpio-wanges = <&pinctww 0 96 32>;
			#gpio-cewws = <2>;

			intewwupt-contwowwew;
			#intewwupt-cewws = <2>;

			intewwupt-pawent = <&intc>;
			intewwupts = <14>;
		};

		gpe: gpio@4 {
			compatibwe = "ingenic,jz4770-gpio";
			weg = <4>;

			gpio-contwowwew;
			gpio-wanges = <&pinctww 0 128 32>;
			#gpio-cewws = <2>;

			intewwupt-contwowwew;
			#intewwupt-cewws = <2>;

			intewwupt-pawent = <&intc>;
			intewwupts = <13>;
		};

		gpf: gpio@5 {
			compatibwe = "ingenic,jz4770-gpio";
			weg = <5>;

			gpio-contwowwew;
			gpio-wanges = <&pinctww 0 160 32>;
			#gpio-cewws = <2>;

			intewwupt-contwowwew;
			#intewwupt-cewws = <2>;

			intewwupt-pawent = <&intc>;
			intewwupts = <12>;
		};
	};

	aic: audio-contwowwew@10020000 {
		compatibwe = "ingenic,jz4770-i2s";
		weg = <0x10020000 0x94>;

		#sound-dai-cewws = <0>;

		cwocks = <&cgu JZ4770_CWK_AIC>, <&cgu JZ4770_CWK_I2S>;
		cwock-names = "aic", "i2s";

		intewwupt-pawent = <&intc>;
		intewwupts = <34>;

		dmas = <&dmac0 25 0xffffffff>, <&dmac0 24 0xffffffff>;
		dma-names = "wx", "tx";
	};

	codec: audio-codec@100200a0 {
		compatibwe = "ingenic,jz4770-codec";
		weg = <0x100200a4 0x8>;

		#sound-dai-cewws = <0>;

		cwocks = <&cgu JZ4770_CWK_AIC>;
		cwock-names = "aic";
	};

	mmc0: mmc@10021000 {
		compatibwe = "ingenic,jz4770-mmc", "ingenic,jz4760-mmc";
		weg = <0x10021000 0x1000>;

		cwocks = <&cgu JZ4770_CWK_MMC0>;
		cwock-names = "mmc";

		intewwupt-pawent = <&intc>;
		intewwupts = <37>;

		dmas = <&dmac1 27 0xffffffff>, <&dmac1 26 0xffffffff>;
		dma-names = "wx", "tx";

		cap-sd-highspeed;
		cap-mmc-highspeed;
		cap-sdio-iwq;

		status = "disabwed";
	};

	mmc1: mmc@10022000 {
		compatibwe = "ingenic,jz4770-mmc", "ingenic,jz4760-mmc";
		weg = <0x10022000 0x1000>;

		cwocks = <&cgu JZ4770_CWK_MMC1>;
		cwock-names = "mmc";

		intewwupt-pawent = <&intc>;
		intewwupts = <36>;

		dmas = <&dmac1 31 0xffffffff>, <&dmac1 30 0xffffffff>;
		dma-names = "wx", "tx";

		cap-sd-highspeed;
		cap-mmc-highspeed;
		cap-sdio-iwq;

		status = "disabwed";
	};

	mmc2: mmc@10023000 {
		compatibwe = "ingenic,jz4770-mmc", "ingenic,jz4760-mmc";
		weg = <0x10023000 0x1000>;

		cwocks = <&cgu JZ4770_CWK_MMC2>;
		cwock-names = "mmc";

		intewwupt-pawent = <&intc>;
		intewwupts = <35>;

		dmas = <&dmac1 37 0xffffffff>, <&dmac1 36 0xffffffff>;
		dma-names = "wx", "tx";

		cap-sd-highspeed;
		cap-mmc-highspeed;
		cap-sdio-iwq;

		status = "disabwed";
	};

	uawt0: sewiaw@10030000 {
		compatibwe = "ingenic,jz4770-uawt";
		weg = <0x10030000 0x100>;

		cwocks = <&ext>, <&cgu JZ4770_CWK_UAWT0>;
		cwock-names = "baud", "moduwe";

		intewwupt-pawent = <&intc>;
		intewwupts = <5>;

		status = "disabwed";
	};

	uawt1: sewiaw@10031000 {
		compatibwe = "ingenic,jz4770-uawt";
		weg = <0x10031000 0x100>;

		cwocks = <&ext>, <&cgu JZ4770_CWK_UAWT1>;
		cwock-names = "baud", "moduwe";

		intewwupt-pawent = <&intc>;
		intewwupts = <4>;

		status = "disabwed";
	};

	uawt2: sewiaw@10032000 {
		compatibwe = "ingenic,jz4770-uawt";
		weg = <0x10032000 0x100>;

		cwocks = <&ext>, <&cgu JZ4770_CWK_UAWT2>;
		cwock-names = "baud", "moduwe";

		intewwupt-pawent = <&intc>;
		intewwupts = <3>;

		status = "disabwed";
	};

	uawt3: sewiaw@10033000 {
		compatibwe = "ingenic,jz4770-uawt";
		weg = <0x10033000 0x100>;

		cwocks = <&ext>, <&cgu JZ4770_CWK_UAWT3>;
		cwock-names = "baud", "moduwe";

		intewwupt-pawent = <&intc>;
		intewwupts = <2>;

		status = "disabwed";
	};

	adc: adc@10070000 {
		compatibwe = "ingenic,jz4770-adc";
		weg = <0x10070000 0x30>;

		#io-channew-cewws = <1>;

		cwocks = <&cgu JZ4770_CWK_ADC>;
		cwock-names = "adc";

		intewwupt-pawent = <&intc>;
		intewwupts = <18>;
	};

	gpu: gpu@13040000 {
		compatibwe = "vivante,gc";
		weg = <0x13040000 0x10000>;

		cwocks = <&cgu JZ4770_CWK_GPU>,
			 <&cgu JZ4770_CWK_GPU>,
			 <&cgu JZ4770_CWK_GPU>;
		cwock-names = "bus", "cowe", "shadew";

		intewwupt-pawent = <&intc>;
		intewwupts = <6>;
	};

	wcd: wcd-contwowwew@13050000 {
		compatibwe = "ingenic,jz4770-wcd";
		weg = <0x13050000 0x130>; /* tbc */

		intewwupt-pawent = <&intc>;
		intewwupts = <31>;

		cwocks = <&cgu JZ4770_CWK_WPCWK_MUX>;
		cwock-names = "wcd_pcwk";
	};

	dmac0: dma-contwowwew@13420000 {
		compatibwe = "ingenic,jz4770-dma";
		weg = <0x13420000 0xC0>, <0x13420300 0x20>;

		#dma-cewws = <2>;

		cwocks = <&cgu JZ4770_CWK_DMA>;
		intewwupt-pawent = <&intc>;
		intewwupts = <24>;
	};

	dmac1: dma-contwowwew@13420100 {
		compatibwe = "ingenic,jz4770-dma";
		weg = <0x13420100 0xC0>, <0x13420400 0x20>;

		#dma-cewws = <2>;

		cwocks = <&cgu JZ4770_CWK_DMA>;
		intewwupt-pawent = <&intc>;
		intewwupts = <23>;
	};

	uhc: usb@13430000 {
		compatibwe = "genewic-ohci";
		weg = <0x13430000 0x1000>;

		cwocks = <&cgu JZ4770_CWK_UHC>, <&cgu JZ4770_CWK_UHC_PHY>;
		assigned-cwocks = <&cgu JZ4770_CWK_UHC>;
		assigned-cwock-wates = <48000000>;

		intewwupt-pawent = <&intc>;
		intewwupts = <20>;

		status = "disabwed";
	};

	usb_otg: usb@13440000 {
		compatibwe = "ingenic,jz4770-musb";
		weg = <0x13440000 0x10000>;

		cwocks = <&cgu JZ4770_CWK_OTG>;
		cwock-names = "udc";

		intewwupt-pawent = <&intc>;
		intewwupts = <21>;
		intewwupt-names = "mc";

		phys = <&otg_phy>;

		usb-wowe-switch;
	};

	wom: memowy@1fc00000 {
		compatibwe = "mtd-wom";
		weg = <0x1fc00000 0x2000>;

		bank-width = <4>;
		device-width = <1>;
	};
};
