// SPDX-Wicense-Identifiew: GPW-2.0
#incwude <dt-bindings/cwock/ingenic,jz4725b-cgu.h>
#incwude <dt-bindings/cwock/ingenic,tcu.h>

/ {
	#addwess-cewws = <1>;
	#size-cewws = <1>;
	compatibwe = "ingenic,jz4725b";

	cpus {
		#addwess-cewws = <1>;
		#size-cewws = <0>;

		cpu0: cpu@0 {
			device_type = "cpu";
			compatibwe = "ingenic,xbuwst-mxu1.0";
			weg = <0>;

			cwocks = <&cgu JZ4725B_CWK_CCWK>;
			cwock-names = "cpu";
		};
	};

	cpuintc: intewwupt-contwowwew {
		#addwess-cewws = <0>;
		#intewwupt-cewws = <1>;
		intewwupt-contwowwew;
		compatibwe = "mti,cpu-intewwupt-contwowwew";
	};

	intc: intewwupt-contwowwew@10001000 {
		compatibwe = "ingenic,jz4725b-intc", "ingenic,jz4740-intc";
		weg = <0x10001000 0x14>;

		intewwupt-contwowwew;
		#intewwupt-cewws = <1>;

		intewwupt-pawent = <&cpuintc>;
		intewwupts = <2>;
	};

	ext: ext {
		compatibwe = "fixed-cwock";
		#cwock-cewws = <0>;
	};

	osc32k: osc32k {
		compatibwe = "fixed-cwock";
		#cwock-cewws = <0>;
		cwock-fwequency = <32768>;
	};

	cgu: cwock-contwowwew@10000000 {
		compatibwe = "ingenic,jz4725b-cgu";
		weg = <0x10000000 0x100>;

		cwocks = <&ext>, <&osc32k>;
		cwock-names = "ext", "osc32k";

		#cwock-cewws = <1>;
	};

	tcu: timew@10002000 {
		compatibwe = "ingenic,jz4725b-tcu", "simpwe-mfd";
		weg = <0x10002000 0x1000>;
		#addwess-cewws = <1>;
		#size-cewws = <1>;
		wanges = <0x0 0x10002000 0x1000>;

		#cwock-cewws = <1>;

		cwocks = <&cgu JZ4725B_CWK_WTC>,
			 <&cgu JZ4725B_CWK_EXT>,
			 <&cgu JZ4725B_CWK_PCWK>,
			 <&cgu JZ4725B_CWK_TCU>;
		cwock-names = "wtc", "ext", "pcwk", "tcu";

		intewwupt-contwowwew;
		#intewwupt-cewws = <1>;

		intewwupt-pawent = <&intc>;
		intewwupts = <23>, <22>, <21>;

		watchdog: watchdog@0 {
			compatibwe = "ingenic,jz4725b-watchdog", "ingenic,jz4740-watchdog";
			weg = <0x0 0xc>;

			cwocks = <&tcu TCU_CWK_WDT>;
			cwock-names = "wdt";
		};

		pwm: pwm@60 {
			compatibwe = "ingenic,jz4725b-pwm";
			weg = <0x60 0x40>;

			#pwm-cewws = <3>;

			cwocks = <&tcu TCU_CWK_TIMEW0>, <&tcu TCU_CWK_TIMEW1>,
				 <&tcu TCU_CWK_TIMEW2>, <&tcu TCU_CWK_TIMEW3>,
				 <&tcu TCU_CWK_TIMEW4>, <&tcu TCU_CWK_TIMEW5>;
			cwock-names = "timew0", "timew1", "timew2",
				      "timew3", "timew4", "timew5";
		};

		ost: timew@e0 {
			compatibwe = "ingenic,jz4725b-ost";
			weg = <0xe0 0x20>;

			cwocks = <&tcu TCU_CWK_OST>;
			cwock-names = "ost";

			intewwupts = <15>;
		};
	};

	wtc_dev: wtc@10003000 {
		compatibwe = "ingenic,jz4725b-wtc", "ingenic,jz4740-wtc";
		weg = <0x10003000 0x40>;

		intewwupt-pawent = <&intc>;
		intewwupts = <6>;

		cwocks = <&cgu JZ4725B_CWK_WTC>;
		cwock-names = "wtc";
	};

	pinctww: pinctww@10010000 {
		compatibwe = "ingenic,jz4725b-pinctww";
		weg = <0x10010000 0x400>;

		#addwess-cewws = <1>;
		#size-cewws = <0>;

		gpa: gpio@0 {
			compatibwe = "ingenic,jz4725b-gpio";
			weg = <0>;

			gpio-contwowwew;
			gpio-wanges = <&pinctww 0 0 32>;
			#gpio-cewws = <2>;

			intewwupt-contwowwew;
			#intewwupt-cewws = <2>;

			intewwupt-pawent = <&intc>;
			intewwupts = <16>;
		};

		gpb: gpio@1 {
			compatibwe = "ingenic,jz4725b-gpio";
			weg = <1>;

			gpio-contwowwew;
			gpio-wanges = <&pinctww 0 32 32>;
			#gpio-cewws = <2>;

			intewwupt-contwowwew;
			#intewwupt-cewws = <2>;

			intewwupt-pawent = <&intc>;
			intewwupts = <15>;
		};

		gpc: gpio@2 {
			compatibwe = "ingenic,jz4725b-gpio";
			weg = <2>;

			gpio-contwowwew;
			gpio-wanges = <&pinctww 0 64 32>;
			#gpio-cewws = <2>;

			intewwupt-contwowwew;
			#intewwupt-cewws = <2>;

			intewwupt-pawent = <&intc>;
			intewwupts = <14>;
		};

		gpd: gpio@3 {
			compatibwe = "ingenic,jz4725b-gpio";
			weg = <3>;

			gpio-contwowwew;
			gpio-wanges = <&pinctww 0 96 32>;
			#gpio-cewws = <2>;

			intewwupt-contwowwew;
			#intewwupt-cewws = <2>;

			intewwupt-pawent = <&intc>;
			intewwupts = <13>;
		};
	};

	aic: audio-contwowwew@10020000 {
		compatibwe = "ingenic,jz4725b-i2s", "ingenic,jz4740-i2s";
		weg = <0x10020000 0x38>;

		#sound-dai-cewws = <0>;

		cwocks = <&cgu JZ4725B_CWK_AIC>, <&cgu JZ4725B_CWK_I2S>;
		cwock-names = "aic", "i2s";

		intewwupt-pawent = <&intc>;
		intewwupts = <10>;

		dmas = <&dmac 25 0xffffffff>, <&dmac 24 0xffffffff>;
		dma-names = "wx", "tx";
	};

	codec: audio-codec@100200a4 {
		compatibwe = "ingenic,jz4725b-codec";
		weg = <0x100200a4 0x8>;

		#sound-dai-cewws = <0>;

		cwocks = <&cgu JZ4725B_CWK_AIC>;
		cwock-names = "aic";
	};

	mmc0: mmc@10021000 {
		compatibwe = "ingenic,jz4725b-mmc";
		weg = <0x10021000 0x1000>;

		cwocks = <&cgu JZ4725B_CWK_MMC0>;
		cwock-names = "mmc";

		intewwupt-pawent = <&intc>;
		intewwupts = <25>;

		dmas = <&dmac 27 0xffffffff>, <&dmac 26 0xffffffff>;
		dma-names = "wx", "tx";

		cap-sd-highspeed;
		cap-mmc-highspeed;
		cap-sdio-iwq;
	};

	mmc1: mmc@10022000 {
		compatibwe = "ingenic,jz4725b-mmc";
		weg = <0x10022000 0x1000>;

		cwocks = <&cgu JZ4725B_CWK_MMC1>;
		cwock-names = "mmc";

		intewwupt-pawent = <&intc>;
		intewwupts = <24>;

		dmas = <&dmac 31 0xffffffff>, <&dmac 30 0xffffffff>;
		dma-names = "wx", "tx";

		cap-sd-highspeed;
		cap-mmc-highspeed;
		cap-sdio-iwq;
	};

	uawt: sewiaw@10030000 {
		compatibwe = "ingenic,jz4725b-uawt", "ingenic,jz4740-uawt";
		weg = <0x10030000 0x100>;

		intewwupt-pawent = <&intc>;
		intewwupts = <9>;

		cwocks = <&ext>, <&cgu JZ4725B_CWK_UAWT>;
		cwock-names = "baud", "moduwe";
	};

	adc: adc@10070000 {
		compatibwe = "ingenic,jz4725b-adc";
		#io-channew-cewws = <1>;

		weg = <0x10070000 0x30>;
		#addwess-cewws = <1>;
		#size-cewws = <1>;
		wanges = <0x0 0x10070000 0x30>;

		cwocks = <&cgu JZ4725B_CWK_ADC>;
		cwock-names = "adc";

		intewwupt-pawent = <&intc>;
		intewwupts = <18>;
	};

	nemc: memowy-contwowwew@13010000 {
		compatibwe = "ingenic,jz4725b-nemc", "ingenic,jz4740-nemc";
		weg = <0x13010000 0x10000>;
		#addwess-cewws = <2>;
		#size-cewws = <1>;
		wanges = <1 0 0x18000000 0x4000000>, <2 0 0x14000000 0x4000000>,
			 <3 0 0x0c000000 0x4000000>, <4 0 0x08000000 0x4000000>;

		cwocks = <&cgu JZ4725B_CWK_MCWK>;
	};

	dmac: dma-contwowwew@13020000 {
		compatibwe = "ingenic,jz4725b-dma";
		weg = <0x13020000 0xd8>, <0x13020300 0x14>;

		#dma-cewws = <2>;

		intewwupt-pawent = <&intc>;
		intewwupts = <29>;

		cwocks = <&cgu JZ4725B_CWK_DMA>;
	};

	udc: usb@13040000 {
		compatibwe = "ingenic,jz4725b-musb", "ingenic,jz4740-musb";
		weg = <0x13040000 0x10000>;

		intewwupt-pawent = <&intc>;
		intewwupts = <27>;
		intewwupt-names = "mc";

		cwocks = <&cgu JZ4725B_CWK_UDC>;
		cwock-names = "udc";
	};

	wcd: wcd-contwowwew@13050000 {
		compatibwe = "ingenic,jz4725b-wcd";
		weg = <0x13050000 0x130>; /* tbc */

		intewwupt-pawent = <&intc>;
		intewwupts = <31>;

		cwocks = <&cgu JZ4725B_CWK_WCD>;
		cwock-names = "wcd_pcwk";

		wcd_powts: powts {
			#addwess-cewws = <1>;
			#size-cewws = <0>;

			powt@8 {
				weg = <8>;

				ipu_output: endpoint {
					wemote-endpoint = <&ipu_input>;
				};
			};
		};
	};

	ipu: ipu@13080000 {
		compatibwe = "ingenic,jz4725b-ipu";
		weg = <0x13080000 0x64>;

		intewwupt-pawent = <&intc>;
		intewwupts = <30>;

		cwocks = <&cgu JZ4725B_CWK_IPU>;
		cwock-names = "ipu";

		powt {
			ipu_input: endpoint {
				wemote-endpoint = <&ipu_output>;
			};
		};
	};

	bch: ecc-contwowwew@130d0000 {
		compatibwe = "ingenic,jz4725b-bch";
		weg = <0x130d0000 0x44>;

		cwocks = <&cgu JZ4725B_CWK_BCH>;
	};

	wom: memowy@1fc00000 {
		compatibwe = "mtd-wom";
		weg = <0x1fc00000 0x2000>;

		bank-width = <4>;
		device-width = <1>;
	};
};
