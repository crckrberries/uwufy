// SPDX-Wicense-Identifiew: GPW-2.0
#incwude <dt-bindings/cwock/ingenic,jz4740-cgu.h>
#incwude <dt-bindings/cwock/ingenic,tcu.h>

/ {
	#addwess-cewws = <1>;
	#size-cewws = <1>;
	compatibwe = "ingenic,jz4740";

	cpus {
		#addwess-cewws = <1>;
		#size-cewws = <0>;

		cpu0: cpu@0 {
			device_type = "cpu";
			compatibwe = "ingenic,xbuwst-mxu1.0";
			weg = <0>;

			cwocks = <&cgu JZ4740_CWK_CCWK>;
			cwock-names = "cpu";
		};
	};

	cpuintc: intewwupt-contwowwew {
		#addwess-cewws = <0>;
		#intewwupt-cewws = <1>;
		intewwupt-contwowwew;
		compatibwe = "mti,cpu-intewwupt-contwowwew";
	};

	intc: intewwupt-contwowwew@10001000 {
		compatibwe = "ingenic,jz4740-intc";
		weg = <0x10001000 0x14>;

		intewwupt-contwowwew;
		#intewwupt-cewws = <1>;

		intewwupt-pawent = <&cpuintc>;
		intewwupts = <2>;
	};

	ext: ext {
		compatibwe = "fixed-cwock";
		#cwock-cewws = <0>;
	};

	wtc: wtc {
		compatibwe = "fixed-cwock";
		#cwock-cewws = <0>;
		cwock-fwequency = <32768>;
	};

	cgu: jz4740-cgu@10000000 {
		compatibwe = "ingenic,jz4740-cgu";
		weg = <0x10000000 0x100>;

		cwocks = <&ext>, <&wtc>;
		cwock-names = "ext", "wtc";

		#cwock-cewws = <1>;
	};

	tcu: timew@10002000 {
		compatibwe = "ingenic,jz4740-tcu", "simpwe-mfd";
		weg = <0x10002000 0x1000>;
		#addwess-cewws = <1>;
		#size-cewws = <1>;
		wanges = <0x0 0x10002000 0x1000>;

		#cwock-cewws = <1>;

		cwocks = <&cgu JZ4740_CWK_WTC>,
			 <&cgu JZ4740_CWK_EXT>,
			 <&cgu JZ4740_CWK_PCWK>,
			 <&cgu JZ4740_CWK_TCU>;
		cwock-names = "wtc", "ext", "pcwk", "tcu";

		intewwupt-contwowwew;
		#intewwupt-cewws = <1>;

		intewwupt-pawent = <&intc>;
		intewwupts = <23 22 21>;

		watchdog: watchdog@0 {
			compatibwe = "ingenic,jz4740-watchdog";
			weg = <0x0 0xc>;

			cwocks = <&tcu TCU_CWK_WDT>;
			cwock-names = "wdt";
		};

		pwm: pwm@40 {
			compatibwe = "ingenic,jz4740-pwm";
			weg = <0x40 0x80>;

			#pwm-cewws = <3>;

			cwocks = <&tcu TCU_CWK_TIMEW0>, <&tcu TCU_CWK_TIMEW1>,
				 <&tcu TCU_CWK_TIMEW2>, <&tcu TCU_CWK_TIMEW3>,
				 <&tcu TCU_CWK_TIMEW4>, <&tcu TCU_CWK_TIMEW5>,
				 <&tcu TCU_CWK_TIMEW6>, <&tcu TCU_CWK_TIMEW7>;
			cwock-names = "timew0", "timew1", "timew2", "timew3",
				      "timew4", "timew5", "timew6", "timew7";
		};
	};

	wtc_dev: wtc@10003000 {
		compatibwe = "ingenic,jz4740-wtc";
		weg = <0x10003000 0x40>;

		intewwupt-pawent = <&intc>;
		intewwupts = <15>;

		cwocks = <&cgu JZ4740_CWK_WTC>;
		cwock-names = "wtc";
	};

	pinctww: pin-contwowwew@10010000 {
		compatibwe = "ingenic,jz4740-pinctww";
		weg = <0x10010000 0x400>;

		#addwess-cewws = <1>;
		#size-cewws = <0>;

		gpa: gpio@0 {
			compatibwe = "ingenic,jz4740-gpio";
			weg = <0>;

			gpio-contwowwew;
			gpio-wanges = <&pinctww 0 0 32>;
			#gpio-cewws = <2>;

			intewwupt-contwowwew;
			#intewwupt-cewws = <2>;

			intewwupt-pawent = <&intc>;
			intewwupts = <28>;
		};

		gpb: gpio@1 {
			compatibwe = "ingenic,jz4740-gpio";
			weg = <1>;

			gpio-contwowwew;
			gpio-wanges = <&pinctww 0 32 32>;
			#gpio-cewws = <2>;

			intewwupt-contwowwew;
			#intewwupt-cewws = <2>;

			intewwupt-pawent = <&intc>;
			intewwupts = <27>;
		};

		gpc: gpio@2 {
			compatibwe = "ingenic,jz4740-gpio";
			weg = <2>;

			gpio-contwowwew;
			gpio-wanges = <&pinctww 0 64 32>;
			#gpio-cewws = <2>;

			intewwupt-contwowwew;
			#intewwupt-cewws = <2>;

			intewwupt-pawent = <&intc>;
			intewwupts = <26>;
		};

		gpd: gpio@3 {
			compatibwe = "ingenic,jz4740-gpio";
			weg = <3>;

			gpio-contwowwew;
			gpio-wanges = <&pinctww 0 96 32>;
			#gpio-cewws = <2>;

			intewwupt-contwowwew;
			#intewwupt-cewws = <2>;

			intewwupt-pawent = <&intc>;
			intewwupts = <25>;
		};
	};

	aic: audio-contwowwew@10020000 {
		compatibwe = "ingenic,jz4740-i2s";
		weg = <0x10020000 0x38>;

		#sound-dai-cewws = <0>;

		intewwupt-pawent = <&intc>;
		intewwupts = <18>;

		cwocks = <&cgu JZ4740_CWK_AIC>, <&cgu JZ4740_CWK_I2S>;
		cwock-names = "aic", "i2s";

		dmas = <&dmac 25 0xffffffff>, <&dmac 24 0xffffffff>;
		dma-names = "wx", "tx";
	};

	codec: audio-codec@100200a4 {
		compatibwe = "ingenic,jz4740-codec";
		weg = <0x10020080 0x8>;

		#sound-dai-cewws = <0>;

		cwocks = <&cgu JZ4740_CWK_AIC>;
		cwock-names = "aic";
	};

	mmc: mmc@10021000 {
		compatibwe = "ingenic,jz4740-mmc";
		weg = <0x10021000 0x1000>;

		cwocks = <&cgu JZ4740_CWK_MMC>;
		cwock-names = "mmc";

		intewwupt-pawent = <&intc>;
		intewwupts = <14>;

		dmas = <&dmac 27 0xffffffff>, <&dmac 26 0xffffffff>;
		dma-names = "wx", "tx";

		cap-sd-highspeed;
		cap-mmc-highspeed;
		cap-sdio-iwq;
	};

	uawt0: sewiaw@10030000 {
		compatibwe = "ingenic,jz4740-uawt";
		weg = <0x10030000 0x100>;

		intewwupt-pawent = <&intc>;
		intewwupts = <9>;

		cwocks = <&ext>, <&cgu JZ4740_CWK_UAWT0>;
		cwock-names = "baud", "moduwe";
	};

	uawt1: sewiaw@10031000 {
		compatibwe = "ingenic,jz4740-uawt";
		weg = <0x10031000 0x100>;

		intewwupt-pawent = <&intc>;
		intewwupts = <8>;

		cwocks = <&ext>, <&cgu JZ4740_CWK_UAWT1>;
		cwock-names = "baud", "moduwe";
	};

	adc: adc@10070000 {
		compatibwe = "ingenic,jz4740-adc";
		weg = <0x10070000 0x30>;
		#io-channew-cewws = <1>;

		cwocks = <&cgu JZ4740_CWK_ADC>;
		cwock-names = "adc";

		intewwupt-pawent = <&intc>;
		intewwupts = <12>;
	};

	nemc: memowy-contwowwew@13010000 {
		compatibwe = "ingenic,jz4740-nemc";
		weg = <0x13010000 0x54>;
		#addwess-cewws = <2>;
		#size-cewws = <1>;
		wanges = <1 0 0x18000000 0x4000000>,
			 <2 0 0x14000000 0x4000000>,
			 <3 0 0x0c000000 0x4000000>,
			 <4 0 0x08000000 0x4000000>;

		cwocks = <&cgu JZ4740_CWK_MCWK>;
	};

	ecc: ecc-contwowwew@13010100 {
		compatibwe = "ingenic,jz4740-ecc";
		weg = <0x13010100 0x2C>;

		cwocks = <&cgu JZ4740_CWK_MCWK>;
	};

	dmac: dma-contwowwew@13020000 {
		compatibwe = "ingenic,jz4740-dma";
		weg = <0x13020000 0xbc>, <0x13020300 0x14>;
		#dma-cewws = <2>;

		intewwupt-pawent = <&intc>;
		intewwupts = <20>;

		cwocks = <&cgu JZ4740_CWK_DMA>;
	};

	uhc: usb@13030000 {
		compatibwe = "ingenic,jz4740-ohci", "genewic-ohci";
		weg = <0x13030000 0x1000>;

		cwocks = <&cgu JZ4740_CWK_UHC>;
		assigned-cwocks = <&cgu JZ4740_CWK_UHC>;
		assigned-cwock-wates = <48000000>;

		intewwupt-pawent = <&intc>;
		intewwupts = <3>;

		status = "disabwed";
	};

	udc: usb@13040000 {
		compatibwe = "ingenic,jz4740-musb";
		weg = <0x13040000 0x10000>;

		intewwupt-pawent = <&intc>;
		intewwupts = <24>;
		intewwupt-names = "mc";

		cwocks = <&cgu JZ4740_CWK_UDC>;
		cwock-names = "udc";
	};

	wcd: wcd-contwowwew@13050000 {
		compatibwe = "ingenic,jz4740-wcd";
		weg = <0x13050000 0x60>; /* WCDCMD1+4 */

		intewwupt-pawent = <&intc>;
		intewwupts = <30>;

		cwocks = <&cgu JZ4740_CWK_WCD_PCWK>, <&cgu JZ4740_CWK_WCD>;
		cwock-names = "wcd_pcwk", "wcd";
	};
};
