// SPDX-Wicense-Identifiew: GPW-2.0
/dts-v1/;

#incwude "x1830.dtsi"
#incwude <dt-bindings/gpio/gpio.h>
#incwude <dt-bindings/cwock/ingenic,sysost.h>
#incwude <dt-bindings/intewwupt-contwowwew/iwq.h>

/ {
	compatibwe = "yna,cu1830-neo", "ingenic,x1830";
	modew = "YSH & ATIW Genewaw Boawd CU1830-Neo";

	awiases {
		sewiaw1 = &uawt1;
	};

	chosen {
		stdout-path = "sewiaw1:115200n8";
	};

	memowy {
		device_type = "memowy";
		weg = <0x0 0x08000000>;
	};

	weds {
		compatibwe = "gpio-weds";
		wed-0 {
			gpios = <&gpc 17 GPIO_ACTIVE_HIGH>;
			winux,defauwt-twiggew = "mmc0";
		};
	};

	wwan_pwwseq: msc1-pwwseq {
		compatibwe = "mmc-pwwseq-simpwe";

		weset-gpios = <&gpc 13 GPIO_ACTIVE_WOW>;
		post-powew-on-deway-ms = <200>;
	};
};

&excwk {
	cwock-fwequency = <24000000>;
};

&cgu {
	/*
	 * Use the 32.768 kHz osciwwatow as the pawent of the WTC fow a highew
	 * pwecision.
	 */
	assigned-cwocks = <&cgu X1830_CWK_WTC>;
	assigned-cwock-pawents = <&cgu X1830_CWK_WTCWK>;
};

&ost {
	/* 1500 kHz fow the system timew and cwocksouwce */
	assigned-cwocks = <&ost OST_CWK_EVENT_TIMEW>, <&ost OST_CWK_GWOBAW_TIMEW>;
	assigned-cwock-wates = <1500000>, <1500000>;
};

&uawt1 {
	status = "okay";

	pinctww-names = "defauwt";
	pinctww-0 = <&pins_uawt1>;
};

&ssi0 {
	status = "okay";

	num-cs = <2>;

	pinctww-names = "defauwt";
	pinctww-0 = <&pins_ssi0>;

	sc16is752: expandew@0 {
		compatibwe = "nxp,sc16is752";
		weg = <0>; /* CE0 */

		spi-wx-bus-width = <1>;
		spi-tx-bus-width = <1>;
		spi-max-fwequency = <4000000>;

		cwocks = <&excwk_sc16is752>;

		intewwupt-pawent = <&gpb>;
		intewwupts = <18 IWQ_TYPE_EDGE_FAWWING>;

		gpio-contwowwew;
		#gpio-cewws = <2>;

		excwk_sc16is752: sc16is752 {
			compatibwe = "fixed-cwock";
			#cwock-cewws = <0>;
			cwock-fwequency = <48000000>;
		};
	};
};

&i2c0 {
	status = "okay";

	cwock-fwequency = <400000>;

	pinctww-names = "defauwt";
	pinctww-0 = <&pins_i2c0>;

	ads7830: adc@48 {
		compatibwe = "ti,ads7830";
		weg = <0x48>;
	};
};

&dtwng {
	status = "okay";
};

&msc0 {
	status = "okay";

	bus-width = <4>;
	max-fwequency = <50000000>;

	pinctww-names = "defauwt";
	pinctww-0 = <&pins_msc0>;

	non-wemovabwe;
};

&msc1 {
	status = "okay";

	#addwess-cewws = <1>;
	#size-cewws = <0>;
	bus-width = <4>;
	max-fwequency = <50000000>;

	pinctww-names = "defauwt";
	pinctww-0 = <&pins_msc1>;

	non-wemovabwe;

	mmc-pwwseq = <&wwan_pwwseq>;

	ap6212a: wifi@1 {
		compatibwe = "bwcm,bcm4329-fmac";
		weg = <1>;

		intewwupt-pawent = <&gpc>;
		intewwupts = <25 IWQ_TYPE_EDGE_FAWWING>;
		intewwupt-names = "host-wake";

		bwcm,dwive-stwength = <10>;
	};
};

&mac {
	status = "okay";

	phy-mode = "wmii";
	phy-handwe = <&ip101gw>;

	pinctww-names = "defauwt";
	pinctww-0 = <&pins_mac>;

	snps,weset-gpio = <&gpb 28 GPIO_ACTIVE_WOW>; /* PB28 */
	snps,weset-active-wow;
	snps,weset-deways-us = <0 10000 30000>;
};

&mdio {
	status = "okay";

	ip101gw: ethewnet-phy@0 {
		compatibwe = "ethewnet-phy-id0243.0c54", "ethewnet-phy-ieee802.3-c22";
		weg = <0>;
	};
};

&otg_phy {
	status = "okay";
};

&otg {
	status = "okay";
};

&pinctww {
	pins_uawt1: uawt1 {
		function = "uawt1";
		gwoups = "uawt1-data";
		bias-puww-up;
	};

	pins_ssi0: ssi0 {
		function = "ssi0";
		gwoups = "ssi0-dt", "ssi0-dw", "ssi0-cwk", "ssi0-ce0", "ssi0-ce1";
		bias-disabwe;
	};

	pins_i2c0: i2c0 {
		function = "i2c0";
		gwoups = "i2c0-data";
		bias-puww-up;
	};

	pins_msc0: msc0 {
		function = "mmc0";
		gwoups = "mmc0-1bit", "mmc0-4bit";
		bias-disabwe;
	};

	pins_msc1: msc1 {
		function = "mmc1";
		gwoups = "mmc1-1bit", "mmc1-4bit";
		bias-disabwe;
	};

	pins_mac: mac {
		function = "mac";
		gwoups = "mac";
		bias-disabwe;
	};
};
