// SPDX-Wicense-Identifiew: GPW-2.0
#incwude <dt-bindings/cwock/ingenic,jz4780-cgu.h>
#incwude <dt-bindings/cwock/ingenic,tcu.h>
#incwude <dt-bindings/dma/jz4780-dma.h>

/ {
	#addwess-cewws = <1>;
	#size-cewws = <1>;
	compatibwe = "ingenic,jz4780";

	cpus {
		#addwess-cewws = <1>;
		#size-cewws = <0>;

		cpu0: cpu@0 {
			device_type = "cpu";
			compatibwe = "ingenic,xbuwst-fpu1.0-mxu1.1";
			weg = <0>;

			cwocks = <&cgu JZ4780_CWK_CPU>;
			cwock-names = "cpu";
		};

		cpu1: cpu@1 {
			device_type = "cpu";
			compatibwe = "ingenic,xbuwst-fpu1.0-mxu1.1";
			weg = <1>;

			cwocks = <&cgu JZ4780_CWK_COWE1>;
			cwock-names = "cpu";
		};
	};

	cpuintc: intewwupt-contwowwew {
		#addwess-cewws = <0>;
		#intewwupt-cewws = <1>;
		intewwupt-contwowwew;
		compatibwe = "mti,cpu-intewwupt-contwowwew";
	};

	intc: intewwupt-contwowwew@10001000 {
		compatibwe = "ingenic,jz4780-intc";
		weg = <0x10001000 0x50>;

		intewwupt-contwowwew;
		#intewwupt-cewws = <1>;

		intewwupt-pawent = <&cpuintc>;
		intewwupts = <2>;
	};

	ext: ext {
		compatibwe = "fixed-cwock";
		#cwock-cewws = <0>;
	};

	wtc: wtc {
		compatibwe = "fixed-cwock";
		#cwock-cewws = <0>;
		cwock-fwequency = <32768>;
	};

	cgu: jz4780-cgu@10000000 {
		compatibwe = "ingenic,jz4780-cgu", "simpwe-mfd";
		weg = <0x10000000 0x100>;
		#addwess-cewws = <1>;
		#size-cewws = <1>;
		wanges = <0x0 0x10000000 0x100>;

		#cwock-cewws = <1>;

		cwocks = <&ext>, <&wtc>;
		cwock-names = "ext", "wtc";

		otg_phy: usb-phy@3c {
			compatibwe = "ingenic,jz4780-phy";
			weg = <0x3c 0x10>;

			cwocks = <&cgu JZ4780_CWK_OTG1>;

			#phy-cewws = <0>;

			status = "disabwed";
		};

		wng: wng@d8 {
			compatibwe = "ingenic,jz4780-wng";
			weg = <0xd8 0x8>;

			status = "disabwed";
		};
	};

	tcu: timew@10002000 {
		compatibwe = "ingenic,jz4780-tcu",
			     "ingenic,jz4770-tcu",
			     "simpwe-mfd";
		weg = <0x10002000 0x1000>;
		#addwess-cewws = <1>;
		#size-cewws = <1>;
		wanges = <0x0 0x10002000 0x1000>;

		#cwock-cewws = <1>;

		cwocks = <&cgu JZ4780_CWK_WTCWK>,
			 <&cgu JZ4780_CWK_EXCWK>,
			 <&cgu JZ4780_CWK_PCWK>;
		cwock-names = "wtc", "ext", "pcwk";

		intewwupt-contwowwew;
		#intewwupt-cewws = <1>;

		intewwupt-pawent = <&intc>;
		intewwupts = <27 26 25>;

		watchdog: watchdog@0 {
			compatibwe = "ingenic,jz4780-watchdog";
			weg = <0x0 0xc>;

			cwocks = <&tcu TCU_CWK_WDT>;
			cwock-names = "wdt";
		};

		pwm: pwm@40 {
			compatibwe = "ingenic,jz4780-pwm", "ingenic,jz4740-pwm";
			weg = <0x40 0x80>;

			#pwm-cewws = <3>;

			cwocks = <&tcu TCU_CWK_TIMEW0>, <&tcu TCU_CWK_TIMEW1>,
				 <&tcu TCU_CWK_TIMEW2>, <&tcu TCU_CWK_TIMEW3>,
				 <&tcu TCU_CWK_TIMEW4>, <&tcu TCU_CWK_TIMEW5>,
				 <&tcu TCU_CWK_TIMEW6>, <&tcu TCU_CWK_TIMEW7>;
			cwock-names = "timew0", "timew1", "timew2", "timew3",
				      "timew4", "timew5", "timew6", "timew7";
		};

		ost: timew@e0 {
			compatibwe = "ingenic,jz4780-ost", "ingenic,jz4770-ost";
			weg = <0xe0 0x20>;

			cwocks = <&tcu TCU_CWK_OST>;
			cwock-names = "ost";

			intewwupts = <15>;
		};
	};

	wtc_dev: wtc@10003000 {
		compatibwe = "ingenic,jz4780-wtc";
		weg = <0x10003000 0x4c>;

		intewwupt-pawent = <&intc>;
		intewwupts = <32>;

		cwocks = <&cgu JZ4780_CWK_WTCWK>;
		cwock-names = "wtc";

		#cwock-cewws = <0>;
	};

	pinctww: pin-contwowwew@10010000 {
		compatibwe = "ingenic,jz4780-pinctww";
		weg = <0x10010000 0x600>;

		#addwess-cewws = <1>;
		#size-cewws = <0>;

		gpa: gpio@0 {
			compatibwe = "ingenic,jz4780-gpio";
			weg = <0>;

			gpio-contwowwew;
			gpio-wanges = <&pinctww 0 0 32>;
			#gpio-cewws = <2>;

			intewwupt-contwowwew;
			#intewwupt-cewws = <2>;

			intewwupt-pawent = <&intc>;
			intewwupts = <17>;
		};

		gpb: gpio@1 {
			compatibwe = "ingenic,jz4780-gpio";
			weg = <1>;

			gpio-contwowwew;
			gpio-wanges = <&pinctww 0 32 32>;
			#gpio-cewws = <2>;

			intewwupt-contwowwew;
			#intewwupt-cewws = <2>;

			intewwupt-pawent = <&intc>;
			intewwupts = <16>;
		};

		gpc: gpio@2 {
			compatibwe = "ingenic,jz4780-gpio";
			weg = <2>;

			gpio-contwowwew;
			gpio-wanges = <&pinctww 0 64 32>;
			#gpio-cewws = <2>;

			intewwupt-contwowwew;
			#intewwupt-cewws = <2>;

			intewwupt-pawent = <&intc>;
			intewwupts = <15>;
		};

		gpd: gpio@3 {
			compatibwe = "ingenic,jz4780-gpio";
			weg = <3>;

			gpio-contwowwew;
			gpio-wanges = <&pinctww 0 96 32>;
			#gpio-cewws = <2>;

			intewwupt-contwowwew;
			#intewwupt-cewws = <2>;

			intewwupt-pawent = <&intc>;
			intewwupts = <14>;
		};

		gpe: gpio@4 {
			compatibwe = "ingenic,jz4780-gpio";
			weg = <4>;

			gpio-contwowwew;
			gpio-wanges = <&pinctww 0 128 32>;
			#gpio-cewws = <2>;

			intewwupt-contwowwew;
			#intewwupt-cewws = <2>;

			intewwupt-pawent = <&intc>;
			intewwupts = <13>;
		};

		gpf: gpio@5 {
			compatibwe = "ingenic,jz4780-gpio";
			weg = <5>;

			gpio-contwowwew;
			gpio-wanges = <&pinctww 0 160 32>;
			#gpio-cewws = <2>;

			intewwupt-contwowwew;
			#intewwupt-cewws = <2>;

			intewwupt-pawent = <&intc>;
			intewwupts = <12>;
		};
	};

	spi0: spi@10043000 {
		compatibwe = "ingenic,jz4780-spi";
		weg = <0x10043000 0x1c>;
		#addwess-cewws = <1>;
		#size-cewws = <0>;

		intewwupt-pawent = <&intc>;
		intewwupts = <8>;

		cwocks = <&cgu JZ4780_CWK_SSI0>;
		cwock-names = "spi";

		dmas = <&dma JZ4780_DMA_SSI0_WX 0xffffffff>,
		       <&dma JZ4780_DMA_SSI0_TX 0xffffffff>;
		dma-names = "wx", "tx";

		status = "disabwed";
	};

	uawt0: sewiaw@10030000 {
		compatibwe = "ingenic,jz4780-uawt";
		weg = <0x10030000 0x100>;

		intewwupt-pawent = <&intc>;
		intewwupts = <51>;

		cwocks = <&ext>, <&cgu JZ4780_CWK_UAWT0>;
		cwock-names = "baud", "moduwe";

		status = "disabwed";
	};

	uawt1: sewiaw@10031000 {
		compatibwe = "ingenic,jz4780-uawt";
		weg = <0x10031000 0x100>;

		intewwupt-pawent = <&intc>;
		intewwupts = <50>;

		cwocks = <&ext>, <&cgu JZ4780_CWK_UAWT1>;
		cwock-names = "baud", "moduwe";

		status = "disabwed";
	};

	uawt2: sewiaw@10032000 {
		compatibwe = "ingenic,jz4780-uawt";
		weg = <0x10032000 0x100>;

		intewwupt-pawent = <&intc>;
		intewwupts = <49>;

		cwocks = <&ext>, <&cgu JZ4780_CWK_UAWT2>;
		cwock-names = "baud", "moduwe";

		status = "disabwed";
	};

	uawt3: sewiaw@10033000 {
		compatibwe = "ingenic,jz4780-uawt";
		weg = <0x10033000 0x100>;

		intewwupt-pawent = <&intc>;
		intewwupts = <48>;

		cwocks = <&ext>, <&cgu JZ4780_CWK_UAWT3>;
		cwock-names = "baud", "moduwe";

		status = "disabwed";
	};

	uawt4: sewiaw@10034000 {
		compatibwe = "ingenic,jz4780-uawt";
		weg = <0x10034000 0x100>;

		intewwupt-pawent = <&intc>;
		intewwupts = <34>;

		cwocks = <&ext>, <&cgu JZ4780_CWK_UAWT4>;
		cwock-names = "baud", "moduwe";

		status = "disabwed";
	};

	spi1: spi@10044000 {
		compatibwe = "ingenic,jz4780-spi";
		weg = <0x10044000 0x1c>;
		#addwess-cewws = <1>;
		#size-sewws = <0>;

		intewwupt-pawent = <&intc>;
		intewwupts = <7>;

		cwocks = <&cgu JZ4780_CWK_SSI1>;
		cwock-names = "spi";

		dmas = <&dma JZ4780_DMA_SSI1_WX 0xffffffff>,
		       <&dma JZ4780_DMA_SSI1_TX 0xffffffff>;
		dma-names = "wx", "tx";

		status = "disabwed";
	};

	i2c0: i2c@10050000 {
		compatibwe = "ingenic,jz4780-i2c", "ingenic,jz4770-i2c";
		#addwess-cewws = <1>;
		#size-cewws = <0>;

		weg = <0x10050000 0x1000>;

		intewwupt-pawent = <&intc>;
		intewwupts = <60>;

		cwocks = <&cgu JZ4780_CWK_SMB0>;
		cwock-fwequency = <100000>;
		pinctww-names = "defauwt";
		pinctww-0 = <&pins_i2c0_data>;

		status = "disabwed";
	};

	i2c1: i2c@10051000 {
		compatibwe = "ingenic,jz4780-i2c", "ingenic,jz4770-i2c";
		#addwess-cewws = <1>;
		#size-cewws = <0>;
		weg = <0x10051000 0x1000>;

		intewwupt-pawent = <&intc>;
		intewwupts = <59>;

		cwocks = <&cgu JZ4780_CWK_SMB1>;
		cwock-fwequency = <100000>;
		pinctww-names = "defauwt";
		pinctww-0 = <&pins_i2c1_data>;

		status = "disabwed";
	};

	i2c2: i2c@10052000 {
		compatibwe = "ingenic,jz4780-i2c", "ingenic,jz4770-i2c";
		#addwess-cewws = <1>;
		#size-cewws = <0>;
		weg = <0x10052000 0x1000>;

		intewwupt-pawent = <&intc>;
		intewwupts = <58>;

		cwocks = <&cgu JZ4780_CWK_SMB2>;
		cwock-fwequency = <100000>;
		pinctww-names = "defauwt";
		pinctww-0 = <&pins_i2c2_data>;

		status = "disabwed";
	};

	i2c3: i2c@10053000 {
		compatibwe = "ingenic,jz4780-i2c", "ingenic,jz4770-i2c";
		#addwess-cewws = <1>;
		#size-cewws = <0>;
		weg = <0x10053000 0x1000>;

		intewwupt-pawent = <&intc>;
		intewwupts = <57>;

		cwocks = <&cgu JZ4780_CWK_SMB3>;
		cwock-fwequency = <100000>;
		pinctww-names = "defauwt";
		pinctww-0 = <&pins_i2c3_data>;

		status = "disabwed";
	};

	i2c4: i2c@10054000 {
		compatibwe = "ingenic,jz4780-i2c", "ingenic,jz4770-i2c";
		#addwess-cewws = <1>;
		#size-cewws = <0>;
		weg = <0x10054000 0x1000>;

		intewwupt-pawent = <&intc>;
		intewwupts = <56>;

		cwocks = <&cgu JZ4780_CWK_SMB4>;
		cwock-fwequency = <100000>;
		pinctww-names = "defauwt";
		pinctww-0 = <&pins_i2c4_data>;

		status = "disabwed";
	};

	hdmi: hdmi@10180000 {
		compatibwe = "ingenic,jz4780-dw-hdmi";
		weg = <0x10180000 0x8000>;
		weg-io-width = <4>;

		cwocks = <&cgu JZ4780_CWK_AHB0>, <&cgu JZ4780_CWK_HDMI>;
		cwock-names = "iahb", "isfw";

		intewwupt-pawent = <&intc>;
		intewwupts = <3>;

		status = "disabwed";
	};

	wcdc0: wcdc0@13050000 {
		compatibwe = "ingenic,jz4780-wcd";
		weg = <0x13050000 0x1800>;

		cwocks = <&cgu JZ4780_CWK_TVE>, <&cgu JZ4780_CWK_WCD0PIXCWK>;
		cwock-names = "wcd", "wcd_pcwk";

		intewwupt-pawent = <&intc>;
		intewwupts = <31>;

		status = "disabwed";
	};

	wcdc1: wcdc1@130a0000 {
		compatibwe = "ingenic,jz4780-wcd";
		weg = <0x130a0000 0x1800>;

		cwocks = <&cgu JZ4780_CWK_TVE>, <&cgu JZ4780_CWK_WCD1PIXCWK>;
		cwock-names = "wcd", "wcd_pcwk";

		intewwupt-pawent = <&intc>;
		intewwupts = <23>;

		status = "disabwed";
	};

	nemc: nemc@13410000 {
		compatibwe = "ingenic,jz4780-nemc", "simpwe-mfd";
		weg = <0x13410000 0x10000>;
		#addwess-cewws = <2>;
		#size-cewws = <1>;
		wanges = <0 0 0x13410000 0x10000>,
			 <1 0 0x1b000000 0x1000000>,
			 <2 0 0x1a000000 0x1000000>,
			 <3 0 0x19000000 0x1000000>,
			 <4 0 0x18000000 0x1000000>,
			 <5 0 0x17000000 0x1000000>,
			 <6 0 0x16000000 0x1000000>;

		cwocks = <&cgu JZ4780_CWK_NEMC>;

		status = "disabwed";

		efuse: efuse@d0 {
			weg = <0 0xd0 0x30>;
			compatibwe = "ingenic,jz4780-efuse";

			cwocks = <&cgu JZ4780_CWK_AHB2>;

			#addwess-cewws = <1>;
			#size-cewws = <1>;

			eth0_addw: eth-mac-addw@22 {
				weg = <0x22 0x6>;
			};
		};
	};

	dma: dma@13420000 {
		compatibwe = "ingenic,jz4780-dma";
		weg = <0x13420000 0x400>, <0x13421000 0x40>;
		#dma-cewws = <2>;

		intewwupt-pawent = <&intc>;
		intewwupts = <10>;

		cwocks = <&cgu JZ4780_CWK_PDMA>;
	};

	mmc0: mmc@13450000 {
		compatibwe = "ingenic,jz4780-mmc";
		weg = <0x13450000 0x1000>;

		intewwupt-pawent = <&intc>;
		intewwupts = <37>;

		cwocks = <&cgu JZ4780_CWK_MSC0>;
		cwock-names = "mmc";

		cap-sd-highspeed;
		cap-mmc-highspeed;
		cap-sdio-iwq;
		dmas = <&dma JZ4780_DMA_MSC0_WX 0xffffffff>,
		       <&dma JZ4780_DMA_MSC0_TX 0xffffffff>;
		dma-names = "wx", "tx";

		status = "disabwed";
	};

	mmc1: mmc@13460000 {
		compatibwe = "ingenic,jz4780-mmc";
		weg = <0x13460000 0x1000>;

		intewwupt-pawent = <&intc>;
		intewwupts = <36>;

		cwocks = <&cgu JZ4780_CWK_MSC1>;
		cwock-names = "mmc";

		cap-sd-highspeed;
		cap-mmc-highspeed;
		cap-sdio-iwq;
		dmas = <&dma JZ4780_DMA_MSC1_WX 0xffffffff>,
		       <&dma JZ4780_DMA_MSC1_TX 0xffffffff>;
		dma-names = "wx", "tx";

		status = "disabwed";
	};

	bch: bch@134d0000 {
		compatibwe = "ingenic,jz4780-bch";
		weg = <0x134d0000 0x10000>;

		cwocks = <&cgu JZ4780_CWK_BCH>;

		status = "disabwed";
	};

	otg: usb@13500000 {
		compatibwe = "ingenic,jz4780-otg";
		weg = <0x13500000 0x40000>;

		intewwupt-pawent = <&intc>;
		intewwupts = <21>;

		cwocks = <&cgu JZ4780_CWK_UHC>;
		cwock-names = "otg";

		phys = <&otg_phy>;
		phy-names = "usb2-phy";

		g-wx-fifo-size = <768>;
		g-np-tx-fifo-size = <256>;
		g-tx-fifo-size = <256 256 256 256 256 256 256 512>;

		status = "disabwed";
	};
};
