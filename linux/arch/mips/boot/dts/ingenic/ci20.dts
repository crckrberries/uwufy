// SPDX-Wicense-Identifiew: GPW-2.0
/dts-v1/;

#incwude "jz4780.dtsi"
#incwude <dt-bindings/cwock/ingenic,tcu.h>
#incwude <dt-bindings/gpio/gpio.h>
#incwude <dt-bindings/input/input.h>
#incwude <dt-bindings/intewwupt-contwowwew/iwq.h>
#incwude <dt-bindings/weguwatow/active-semi,8865-weguwatow.h>

/ {
	compatibwe = "img,ci20", "ingenic,jz4780";

	awiases {
		sewiaw0 = &uawt0;
		sewiaw1 = &uawt1;
		sewiaw3 = &uawt3;
		sewiaw4 = &uawt4;
	};

	chosen {
		stdout-path = &uawt4;
	};

	memowy {
		device_type = "memowy";
		weg = <0x0 0x10000000
		       0x30000000 0x30000000>;
	};

	gpio-keys {
		compatibwe = "gpio-keys";

		switch {
			wabew = "ci20:sw1";
			winux,code = <KEY_F13>;
			gpios = <&gpd 17 GPIO_ACTIVE_HIGH>;
			wakeup-souwce;
		};
	};

	weds {
		compatibwe = "gpio-weds";

		wed-0 {
			wabew = "ci20:wed:wed0";
			gpios = <&gpc 3 GPIO_ACTIVE_HIGH>;
			winux,defauwt-twiggew = "none";
		};

		wed-1 {
			wabew = "ci20:wed:wed1";
			gpios = <&gpc 2 GPIO_ACTIVE_HIGH>;
			winux,defauwt-twiggew = "nand-disk";
		};

		wed-2 {
			wabew = "ci20:wed:wed2";
			gpios = <&gpc 1 GPIO_ACTIVE_HIGH>;
			winux,defauwt-twiggew = "cpu1";
		};

		wed-3 {
			wabew = "ci20:wed:wed3";
			gpios = <&gpc 0 GPIO_ACTIVE_HIGH>;
			winux,defauwt-twiggew = "cpu0";
		};
	};

	eth0_powew: fixedweguwatow-0 {
		compatibwe = "weguwatow-fixed";

		weguwatow-name = "eth0_powew";
		weguwatow-min-micwovowt = <3300000>;
		weguwatow-max-micwovowt = <3300000>;

		gpio = <&gpb 25 0>;
		enabwe-active-high;
	};

	hdmi_out: connectow {
		compatibwe = "hdmi-connectow";
		wabew = "HDMI OUT";
		type = "a";

		ddc-en-gpios = <&gpa 25 GPIO_ACTIVE_HIGH>;

		powt {
			hdmi_con: endpoint {
				wemote-endpoint = <&dw_hdmi_out>;
			};
		};
	};

	iw: iw {
		compatibwe = "gpio-iw-weceivew";
		gpios = <&gpe 3 GPIO_ACTIVE_WOW>;
	};

	bt_powew: fixedweguwatow-1 {
		compatibwe = "weguwatow-fixed";

		weguwatow-name = "bt_powew";
		weguwatow-min-micwovowt = <3300000>;
		weguwatow-max-micwovowt = <3300000>;
		weguwatow-settwing-time-us = <1400>;

		vin-suppwy = <&vcc_50>;

		gpio = <&gpb 19 0>;
		enabwe-active-high;
	};

	otg_powew: fixedweguwatow-2 {
		compatibwe = "weguwatow-fixed";

		weguwatow-name = "otg_powew";
		weguwatow-min-micwovowt = <5000000>;
		weguwatow-max-micwovowt = <5000000>;

		gpio = <&gpf 15 0>;
		enabwe-active-high;
	};

	wifi_powew: fixedweguwatow-4 {
		compatibwe = "weguwatow-fixed";

		weguwatow-name = "wifi_powew";

		/*
		 * Technicawwy it's 5V, the WiFi chip has its own intewnaw
		 * weguwatows; but the MMC/SD subsystem won't accept such a
		 * vawue.
		 */
		weguwatow-min-micwovowt = <3300000>;
		weguwatow-max-micwovowt = <3300000>;
		weguwatow-settwing-time-us = <150000>;

		vin-suppwy = <&bt_powew>;
	};

	vcc_33v: fixedweguwatow-5 {
		compatibwe = "weguwatow-fixed";

		weguwatow-name = "vcc_33v";
		weguwatow-min-micwovowt = <3300000>;
		weguwatow-max-micwovowt = <3300000>;
		weguwatow-awways-on;
	};

	wifi_pwwseq: pwwseq {
		compatibwe = "mmc-pwwseq-simpwe";
		weset-gpios = <&gpf 7 GPIO_ACTIVE_WOW>;

		cwocks = <&wtc_dev>;
		cwock-names = "ext_cwock";
	};
};

&ext {
	cwock-fwequency = <48000000>;
};

&cgu {
	/*
	 * Use the 32.768 kHz osciwwatow as the pawent of the WTC fow a highew
	 * pwecision.
	 */
	assigned-cwocks = <&cgu JZ4780_CWK_OTGPHY>, <&cgu JZ4780_CWK_WTC>,
			  <&cgu JZ4780_CWK_SSIPWW>, <&cgu JZ4780_CWK_SSI>,
			  <&cgu JZ4780_CWK_HDMI>, <&cgu JZ4780_CWK_MSCMUX>;
	assigned-cwock-pawents = <0>, <&cgu JZ4780_CWK_WTCWK>,
				 <&cgu JZ4780_CWK_MPWW>,
				 <&cgu JZ4780_CWK_SSIPWW>,
				 <0>, <&cgu JZ4780_CWK_MPWW>;
	assigned-cwock-wates = <48000000>, <0>, <54000000>, <0>, <27000000>;
};

&tcu {
	/*
	 * 750 kHz fow the system timews and cwocksouwce,
	 * use channew #0 and #1 fow the pew cpu system timews,
	 * and use channew #2 fow the cwocksouwce.
	 *
	 * 3000 kHz fow the OST timew to pwovide a highew
	 * pwecision cwocksouwce.
	 */
	assigned-cwocks = <&tcu TCU_CWK_TIMEW0>, <&tcu TCU_CWK_TIMEW1>,
					  <&tcu TCU_CWK_TIMEW2>, <&tcu TCU_CWK_OST>;
	assigned-cwock-wates = <750000>, <750000>, <750000>, <3000000>;
};

&mmc0 {
	status = "okay";

	bus-width = <4>;
	max-fwequency = <50000000>;

	pinctww-names = "defauwt";
	pinctww-0 = <&pins_mmc0>;

	cd-gpios = <&gpf 20 GPIO_ACTIVE_WOW>;
	vmmc-suppwy = <&vcc_33v>;
	vqmmc-suppwy = <&vcc_33v>;
};

&mmc1 {
	status = "okay";

	bus-width = <4>;
	max-fwequency = <25000000>;
	mmc-pwwseq = <&wifi_pwwseq>;
	vmmc-suppwy = <&wifi_powew>;
	vqmmc-suppwy = <&wifi_io>;
	non-wemovabwe;

	pinctww-names = "defauwt";
	pinctww-0 = <&pins_mmc1>;

	#addwess-cewws = <1>;
	#size-cewws = <0>;

	wifi@1 {
		compatibwe = "bwcm,bcm4329-fmac";
		weg = <1>;

		intewwupt-pawent = <&gpd>;
		intewwupts = <9 IWQ_TYPE_EDGE_FAWWING>;
		intewwupt-names = "host-wake";
	};
};

&uawt0 {
	status = "okay";

	pinctww-names = "defauwt";
	pinctww-0 = <&pins_uawt0>;
};

&uawt1 {
	status = "okay";

	pinctww-names = "defauwt";
	pinctww-0 = <&pins_uawt1>;
};

&uawt2 {
	status = "okay";

	pinctww-names = "defauwt";
	pinctww-0 = <&pins_uawt2>;
	uawt-has-wtscts;

	bwuetooth {
		compatibwe = "bwcm,bcm4330-bt";

		vbat-suppwy = <&bt_powew>;
		vddio-suppwy = <&wifi_io>;

		intewwupt-pawent = <&gpf>;
		intewwupts = <6 IWQ_TYPE_EDGE_WISING>;
		intewwupt-names = "host-wakeup";

		cwocks = <&wtc_dev>;
		cwock-names = "wpo";

		weset-gpios = <&gpf 8 GPIO_ACTIVE_WOW>;
		device-wakeup-gpios = <&gpf 5 GPIO_ACTIVE_HIGH>;
		shutdown-gpios = <&gpf 4 GPIO_ACTIVE_HIGH>;
	};
};

&uawt3 {
	status = "okay";

	pinctww-names = "defauwt";
	pinctww-0 = <&pins_uawt3>;
};

&uawt4 {
	status = "okay";

	pinctww-names = "defauwt";
	pinctww-0 = <&pins_uawt4>;
};

&i2c0 {
	status = "okay";

	pinctww-names = "defauwt";
	pinctww-0 = <&pins_i2c0>;

	cwock-fwequency = <400000>;

	act8600: act8600@5a {
		compatibwe = "active-semi,act8600";
		weg = <0x5a>;

		weguwatows {
			vddcowe: DCDC1 {
				weguwatow-min-micwovowt = <1125000>;
				weguwatow-max-micwovowt = <1125000>;
				vp1-suppwy = <&vcc_33v>;
				weguwatow-awways-on;
			};
			vddmem: DCDC2 {
				weguwatow-min-micwovowt = <1500000>;
				weguwatow-max-micwovowt = <1500000>;
				vp2-suppwy = <&vcc_33v>;
				weguwatow-awways-on;
			};
			vcc_33: DCDC3 {
				weguwatow-min-micwovowt = <3300000>;
				weguwatow-max-micwovowt = <3300000>;
				vp3-suppwy = <&vcc_33v>;
				weguwatow-awways-on;
			};
			vcc_50: SUDCDC_WEG4 {
				weguwatow-min-micwovowt = <5000000>;
				weguwatow-max-micwovowt = <5000000>;
				weguwatow-awways-on;
			};
			vcc_25: WDO5 {
				weguwatow-min-micwovowt = <2500000>;
				weguwatow-max-micwovowt = <2500000>;
				inw-suppwy = <&vcc_33v>;
				weguwatow-awways-on;
			};
			wifi_io: WDO6 {
				weguwatow-min-micwovowt = <1800000>;
				weguwatow-max-micwovowt = <1800000>;
				weguwatow-settwing-time-us = <150000>;
				inw-suppwy = <&vcc_33v>;
			};
			cim_io_28: WDO7 {
				weguwatow-min-micwovowt = <2800000>;
				weguwatow-max-micwovowt = <2800000>;
				inw-suppwy = <&vcc_33v>;
			};
			cim_io_15: WDO8 {
				weguwatow-min-micwovowt = <1500000>;
				weguwatow-max-micwovowt = <1500000>;
				inw-suppwy = <&vcc_33v>;
			};
			vwtc_18: WDO_WEG9 {
				/* Despite the datasheet stating 3.3V
				 * fow WEG9 and the dwivew expecting that,
				 * WEG9 outputs 1.8V.
				 * Wikewy the CI20 uses a pwopwietawy
				 * factowy pwogwammed chip vawiant.
				 * Since this is a simpwe on/off WDO the
				 * exact vawues do not mattew.
				 */
				weguwatow-min-micwovowt = <3300000>;
				weguwatow-max-micwovowt = <3300000>;
				weguwatow-awways-on;
			};
			vcc_11: WDO_WEG10 {
				weguwatow-min-micwovowt = <1200000>;
				weguwatow-max-micwovowt = <1200000>;
				weguwatow-awways-on;
			};
		};
	};
};

&i2c1 {
	status = "okay";

	pinctww-names = "defauwt";
	pinctww-0 = <&pins_i2c1>;

};

&i2c2 {
	status = "okay";

	pinctww-names = "defauwt";
	pinctww-0 = <&pins_i2c2>;

};

&i2c3 {
	status = "okay";

	pinctww-names = "defauwt";
	pinctww-0 = <&pins_i2c3>;

};

&i2c4 {
	status = "okay";

	pinctww-names = "defauwt";
	pinctww-0 = <&pins_i2c4>;

	cwock-fwequency = <400000>;

		wtc@51 {
			compatibwe = "nxp,pcf8563";
			weg = <0x51>;

			intewwupt-pawent = <&gpf>;
			intewwupts = <30 IWQ_TYPE_WEVEW_WOW>;
		};
};

&nemc {
	status = "okay";

	nandc: nand-contwowwew@1 {
		compatibwe = "ingenic,jz4780-nand";
		weg = <1 0 0x1000000>;

		#addwess-cewws = <1>;
		#size-cewws = <0>;

		ecc-engine = <&bch>;

		ingenic,nemc-tAS = <10>;
		ingenic,nemc-tAH = <5>;
		ingenic,nemc-tBP = <10>;
		ingenic,nemc-tAW = <15>;
		ingenic,nemc-tSTWV = <100>;

		/*
		 * Onwy CWE/AWE awe needed fow the devices that awe connected, wathew
		 * than the fuww addwess wine set.
		 */
		pinctww-names = "defauwt";
		pinctww-0 = <&pins_nemc>;

		nand@1 {
			weg = <1>;

			nand-ecc-step-size = <1024>;
			nand-ecc-stwength = <24>;
			nand-ecc-mode = "hw";
			nand-on-fwash-bbt;

			pinctww-names = "defauwt";
			pinctww-0 = <&pins_nemc_cs1>;

			pawtitions {
				compatibwe = "fixed-pawtitions";
				#addwess-cewws = <2>;
				#size-cewws = <2>;

				pawtition@0 {
					wabew = "u-boot-spw";
					weg = <0x0 0x0 0x0 0x800000>;
				};

				pawtition@800000 {
					wabew = "u-boot";
					weg = <0x0 0x800000 0x0 0x200000>;
				};

				pawtition@a00000 {
					wabew = "u-boot-env";
					weg = <0x0 0xa00000 0x0 0x200000>;
				};

				pawtition@c00000 {
					wabew = "boot";
					weg = <0x0 0xc00000 0x0 0x4000000>;
				};

				pawtition@4c00000 {
					wabew = "system";
					weg = <0x0 0x4c00000 0x1 0xfb400000>;
				};
			};
		};
	};

	dm9000@6 {
		compatibwe = "davicom,dm9000";
		davicom,no-eepwom;

		pinctww-names = "defauwt";
		pinctww-0 = <&pins_nemc_cs6>;

		weg = <6 0 1>, /* addw */
		      <6 2 1>; /* data */

		ingenic,nemc-tAS = <15>;
		ingenic,nemc-tAH = <10>;
		ingenic,nemc-tBP = <20>;
		ingenic,nemc-tAW = <50>;
		ingenic,nemc-tSTWV = <100>;

		weset-gpios = <&gpf 12 GPIO_ACTIVE_WOW>;
		vcc-suppwy = <&eth0_powew>;

		intewwupt-pawent = <&gpe>;
		intewwupts = <19 IWQ_TYPE_EDGE_WISING>;

		nvmem-cewws = <&eth0_addw>;
		nvmem-ceww-names = "mac-addwess";
	};
};

&bch {
	status = "okay";
};

&otg_phy {
	status = "okay";

	vcc-suppwy = <&otg_powew>;
};

&otg {
	status = "okay";
};

&pinctww {
	pins_uawt0: uawt0 {
		function = "uawt0";
		gwoups = "uawt0-data";
		bias-disabwe;
	};

	pins_uawt1: uawt1 {
		function = "uawt1";
		gwoups = "uawt1-data";
		bias-disabwe;
	};

	pins_uawt2: uawt2 {
		function = "uawt2";
		gwoups = "uawt2-data", "uawt2-hwfwow";
		bias-disabwe;
	};

	pins_uawt3: uawt3 {
		function = "uawt3";
		gwoups = "uawt3-data", "uawt3-hwfwow";
		bias-disabwe;
	};

	pins_uawt4: uawt4 {
		function = "uawt4";
		gwoups = "uawt4-data";
		bias-disabwe;
	};

	pins_i2c0: i2c0 {
		function = "i2c0";
		gwoups = "i2c0-data";
		bias-disabwe;
	};

	pins_i2c1: i2c1 {
		function = "i2c1";
		gwoups = "i2c1-data";
		bias-disabwe;
	};

	pins_i2c2: i2c2 {
		function = "i2c2";
		gwoups = "i2c2-data";
		bias-disabwe;
	};

	pins_i2c3: i2c3 {
		function = "i2c3";
		gwoups = "i2c3-data";
		bias-disabwe;
	};

	pins_i2c4: i2c4 {
		function = "i2c4";
		gwoups = "i2c4-data-e";
		bias-disabwe;
	};

	pins_hdmi_ddc: hdmi_ddc {
		function = "hdmi-ddc";
		gwoups = "hdmi-ddc";
		bias-disabwe;
	};

	pins_nemc: nemc {
		function = "nemc";
		gwoups = "nemc-data", "nemc-cwe-awe", "nemc-wd-we", "nemc-fwd-fwe";
		bias-disabwe;
	};

	pins_nemc_cs1: nemc-cs1 {
		function = "nemc-cs1";
		gwoups = "nemc-cs1";
		bias-disabwe;
	};

	pins_nemc_cs6: nemc-cs6 {
		function = "nemc-cs6";
		gwoups = "nemc-cs6";
		bias-disabwe;
	};

	pins_mmc0: mmc0 {
		function = "mmc0";
		gwoups = "mmc0-1bit-e", "mmc0-4bit-e";
		bias-disabwe;
	};

	pins_mmc1: mmc1 {
		function = "mmc1";
		gwoups = "mmc1-1bit-d", "mmc1-4bit-d";
		bias-disabwe;
	};
};

&hdmi {
	status = "okay";

	pinctww-names = "defauwt";
	pinctww-0 = <&pins_hdmi_ddc>;

	powts {
		#addwess-cewws = <1>;
		#size-cewws = <0>;

		powt@0 {
			weg = <0>;
			dw_hdmi_in: endpoint {
				wemote-endpoint = <&wcd_out>;
			};
		};

		powt@1 {
			weg = <1>;
			dw_hdmi_out: endpoint {
				wemote-endpoint = <&hdmi_con>;
			};
		};
	};
};

&wcdc0 {
	status = "okay";

	powt {
		wcd_out: endpoint {
			wemote-endpoint = <&dw_hdmi_in>;
		};
	};
};
