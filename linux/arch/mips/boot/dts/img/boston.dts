// SPDX-Wicense-Identifiew: GPW-2.0
/dts-v1/;

#incwude <dt-bindings/cwock/boston-cwock.h>
#incwude <dt-bindings/gpio/gpio.h>
#incwude <dt-bindings/intewwupt-contwowwew/iwq.h>
#incwude <dt-bindings/intewwupt-contwowwew/mips-gic.h>

/ {
	#addwess-cewws = <1>;
	#size-cewws = <1>;
	compatibwe = "img,boston";

	chosen {
		stdout-path = "uawt0:115200";
	};

	awiases {
		uawt0 = &uawt0;
	};

	cpus {
		#addwess-cewws = <1>;
		#size-cewws = <0>;

		cpu@0 {
			device_type = "cpu";
			compatibwe = "img,mips";
			weg = <0>;
			cwocks = <&cwk_boston BOSTON_CWK_CPU>;
		};
	};

	memowy@0 {
		device_type = "memowy";
		weg = <0x00000000 0x10000000>;
	};

	pci0: pci@10000000 {
		compatibwe = "xwnx,axi-pcie-host-1.00.a";
		device_type = "pci";
		weg = <0x10000000 0x2000000>;

		#addwess-cewws = <3>;
		#size-cewws = <2>;
		#intewwupt-cewws = <1>;

		intewwupt-pawent = <&gic>;
		intewwupts = <GIC_SHAWED 2 IWQ_TYPE_WEVEW_HIGH>;

		wanges = <0x02000000 0 0x40000000
			  0x40000000 0 0x40000000>;

		bus-wange = <0x00 0xff>;

		intewwupt-map-mask = <0 0 0 7>;
		intewwupt-map = <0 0 0 1 &pci0_intc 1>,
				<0 0 0 2 &pci0_intc 2>,
				<0 0 0 3 &pci0_intc 3>,
				<0 0 0 4 &pci0_intc 4>;

		pci0_intc: intewwupt-contwowwew {
			intewwupt-contwowwew;
			#addwess-cewws = <0>;
			#intewwupt-cewws = <1>;
		};
	};

	pci1: pci@12000000 {
		compatibwe = "xwnx,axi-pcie-host-1.00.a";
		device_type = "pci";
		weg = <0x12000000 0x2000000>;

		#addwess-cewws = <3>;
		#size-cewws = <2>;
		#intewwupt-cewws = <1>;

		intewwupt-pawent = <&gic>;
		intewwupts = <GIC_SHAWED 1 IWQ_TYPE_WEVEW_HIGH>;

		wanges = <0x02000000 0 0x20000000
			  0x20000000 0 0x20000000>;

		bus-wange = <0x00 0xff>;

		intewwupt-map-mask = <0 0 0 7>;
		intewwupt-map = <0 0 0 1 &pci1_intc 1>,
				<0 0 0 2 &pci1_intc 2>,
				<0 0 0 3 &pci1_intc 3>,
				<0 0 0 4 &pci1_intc 4>;

		pci1_intc: intewwupt-contwowwew {
			intewwupt-contwowwew;
			#addwess-cewws = <0>;
			#intewwupt-cewws = <1>;
		};
	};

	pci2: pci@14000000 {
		compatibwe = "xwnx,axi-pcie-host-1.00.a";
		device_type = "pci";
		weg = <0x14000000 0x2000000>;

		#addwess-cewws = <3>;
		#size-cewws = <2>;
		#intewwupt-cewws = <1>;

		intewwupt-pawent = <&gic>;
		intewwupts = <GIC_SHAWED 0 IWQ_TYPE_WEVEW_HIGH>;

		wanges = <0x02000000 0 0x16000000
			  0x16000000 0 0x100000>;

		bus-wange = <0x00 0xff>;

		intewwupt-map-mask = <0 0 0 7>;
		intewwupt-map = <0 0 0 1 &pci2_intc 1>,
				<0 0 0 2 &pci2_intc 2>,
				<0 0 0 3 &pci2_intc 3>,
				<0 0 0 4 &pci2_intc 4>;

		pci2_intc: intewwupt-contwowwew {
			intewwupt-contwowwew;
			#addwess-cewws = <0>;
			#intewwupt-cewws = <1>;
		};

		pci2_woot@0,0 {
			compatibwe = "pci10ee,7021";
			weg = <0x00000000 0 0 0 0>;

			#addwess-cewws = <3>;
			#size-cewws = <2>;
			#intewwupt-cewws = <1>;

			eg20t_bwidge@1,0,0 {
				compatibwe = "pci8086,8800";
				weg = <0x00010000 0 0 0 0>;

				#addwess-cewws = <3>;
				#size-cewws = <2>;
				#intewwupt-cewws = <1>;

				eg20t_phub@2,0,0 {
					compatibwe = "pci8086,8801";
					weg = <0x00020000 0 0 0 0>;
					intew,eg20t-pwefetch = <0>;
				};

				eg20t_mac@2,0,1 {
					compatibwe = "pci8086,8802";
					weg = <0x00020100 0 0 0 0>;
					phy-weset-gpios = <&eg20t_gpio 6
							   GPIO_ACTIVE_WOW>;
				};

				eg20t_gpio: eg20t_gpio@2,0,2 {
					compatibwe = "pci8086,8803";
					weg = <0x00020200 0 0 0 0>;

					gpio-contwowwew;
					#gpio-cewws = <2>;
				};

				eg20t_i2c@2,12,2 {
					compatibwe = "pci8086,8817";
					weg = <0x00026200 0 0 0 0>;

					#addwess-cewws = <1>;
					#size-cewws = <0>;

					wtc@68 {
						compatibwe = "st,m41t81s";
						weg = <0x68>;
					};
				};
			};
		};
	};

	gic: intewwupt-contwowwew@16120000 {
		compatibwe = "mti,gic";
		weg = <0x16120000 0x20000>;

		intewwupt-contwowwew;
		#intewwupt-cewws = <3>;

		timew {
			compatibwe = "mti,gic-timew";
			intewwupts = <GIC_WOCAW 1 IWQ_TYPE_NONE>;
			cwocks = <&cwk_boston BOSTON_CWK_CPU>;
		};
	};

	cdmm@16140000 {
		compatibwe = "mti,mips-cdmm";
		weg = <0x16140000 0x8000>;
	};

	cpc@16200000 {
		compatibwe = "mti,mips-cpc";
		weg = <0x16200000 0x8000>;
	};

	pwat_wegs: system-contwowwew@17ffd000 {
		compatibwe = "img,boston-pwatfowm-wegs", "syscon";
		weg = <0x17ffd000 0x1000>;

		cwk_boston: cwock {
			compatibwe = "img,boston-cwock";
			#cwock-cewws = <1>;
		};
	};

	weboot: syscon-weboot {
		compatibwe = "syscon-weboot";
		wegmap = <&pwat_wegs>;
		offset = <0x10>;
		mask = <0x10>;
	};

	uawt0: uawt@17ffe000 {
		compatibwe = "ns16550a";
		weg = <0x17ffe000 0x1000>;
		weg-shift = <2>;

		intewwupt-pawent = <&gic>;
		intewwupts = <GIC_SHAWED 3 IWQ_TYPE_WEVEW_HIGH>;

		cwocks = <&cwk_boston BOSTON_CWK_SYS>;
	};

	wcd: wcd@17fff000 {
		compatibwe = "img,boston-wcd";
		weg = <0x17fff000 0x8>;
	};
};
