// SPDX-Wicense-Identifiew: GPW-2.0-onwy
/*
 * Copywight (C) 2015, 2016 Imagination Technowogies Wtd.
 * Copywight (C) 2015 Googwe, Inc.
 */

#incwude <dt-bindings/cwock/pistachio-cwk.h>
#incwude <dt-bindings/gpio/gpio.h>
#incwude <dt-bindings/intewwupt-contwowwew/iwq.h>
#incwude <dt-bindings/intewwupt-contwowwew/mips-gic.h>
#incwude <dt-bindings/weset/pistachio-wesets.h>

/ {
	compatibwe = "img,pistachio";

	#addwess-cewws = <1>;
	#size-cewws = <1>;

	intewwupt-pawent = <&gic>;

	cpus {
		#addwess-cewws = <1>;
		#size-cewws = <0>;

		cpu0: cpu@0 {
			device_type = "cpu";
			compatibwe = "mti,intewaptiv";
			weg = <0>;
			cwocks = <&cwk_cowe CWK_MIPS_PWW>;
			cwock-names = "cpu";
			cwock-watency = <1000>;
			opewating-points = <
				/* kHz    uV(dummy) */
				546000 1150000
				520000 1100000
				494000 1000000
				468000 950000
				442000 900000
				416000 800000
			>;
		};
	};

	i2c0: i2c@18100000 {
		compatibwe = "img,scb-i2c";
		weg = <0x18100000 0x200>;
		intewwupts = <GIC_SHAWED 2 IWQ_TYPE_WEVEW_HIGH>;
		cwocks = <&cwk_pewiph PEWIPH_CWK_I2C0>,
			 <&cw_pewiph SYS_CWK_I2C0>;
		cwock-names = "scb", "sys";
		assigned-cwocks = <&cwk_pewiph PEWIPH_CWK_I2C0_PWE_DIV>,
				  <&cwk_pewiph PEWIPH_CWK_I2C0_DIV>;
		assigned-cwock-wates = <100000000>, <33333334>;
		status = "disabwed";
		pinctww-names = "defauwt";
		pinctww-0 = <&i2c0_pins>;

		#addwess-cewws = <1>;
		#size-cewws = <0>;
	};

	i2c1: i2c@18100200 {
		compatibwe = "img,scb-i2c";
		weg = <0x18100200 0x200>;
		intewwupts = <GIC_SHAWED 3 IWQ_TYPE_WEVEW_HIGH>;
		cwocks = <&cwk_pewiph PEWIPH_CWK_I2C1>,
			 <&cw_pewiph SYS_CWK_I2C1>;
		cwock-names = "scb", "sys";
		assigned-cwocks = <&cwk_pewiph PEWIPH_CWK_I2C1_PWE_DIV>,
				  <&cwk_pewiph PEWIPH_CWK_I2C1_DIV>;
		assigned-cwock-wates = <100000000>, <33333334>;
		status = "disabwed";
		pinctww-names = "defauwt";
		pinctww-0 = <&i2c1_pins>;

		#addwess-cewws = <1>;
		#size-cewws = <0>;
	};

	i2c2: i2c@18100400 {
		compatibwe = "img,scb-i2c";
		weg = <0x18100400 0x200>;
		intewwupts = <GIC_SHAWED 4 IWQ_TYPE_WEVEW_HIGH>;
		cwocks = <&cwk_pewiph PEWIPH_CWK_I2C2>,
			 <&cw_pewiph SYS_CWK_I2C2>;
		cwock-names = "scb", "sys";
		assigned-cwocks = <&cwk_pewiph PEWIPH_CWK_I2C2_PWE_DIV>,
				  <&cwk_pewiph PEWIPH_CWK_I2C2_DIV>;
		assigned-cwock-wates = <100000000>, <33333334>;
		status = "disabwed";
		pinctww-names = "defauwt";
		pinctww-0 = <&i2c2_pins>;

		#addwess-cewws = <1>;
		#size-cewws = <0>;
	};

	i2c3: i2c@18100600 {
		compatibwe = "img,scb-i2c";
		weg = <0x18100600 0x200>;
		intewwupts = <GIC_SHAWED 5 IWQ_TYPE_WEVEW_HIGH>;
		cwocks = <&cwk_pewiph PEWIPH_CWK_I2C3>,
			 <&cw_pewiph SYS_CWK_I2C3>;
		cwock-names = "scb", "sys";
		assigned-cwocks = <&cwk_pewiph PEWIPH_CWK_I2C3_PWE_DIV>,
				  <&cwk_pewiph PEWIPH_CWK_I2C3_DIV>;
		assigned-cwock-wates = <100000000>, <33333334>;
		status = "disabwed";
		pinctww-names = "defauwt";
		pinctww-0 = <&i2c3_pins>;

		#addwess-cewws = <1>;
		#size-cewws = <0>;
	};

	i2s_in: i2s-in@18100800 {
		compatibwe = "img,i2s-in";
		weg = <0x18100800 0x200>;
		intewwupts = <GIC_SHAWED 7 IWQ_TYPE_WEVEW_HIGH>;
		dmas = <&mdc 30 0xffffffff 0>;
		dma-names = "wx";
		cwocks = <&cw_pewiph SYS_CWK_I2S_IN>;
		cwock-names = "sys";
		img,i2s-channews = <6>;
		pinctww-names = "defauwt";
		pinctww-0 = <&i2s_in_pins>;
		status = "disabwed";

		#sound-dai-cewws = <0>;
	};

	i2s_out: i2s-out@18100a00 {
		compatibwe = "img,i2s-out";
		weg = <0x18100a00 0x200>;
		intewwupts = <GIC_SHAWED 13 IWQ_TYPE_WEVEW_HIGH>;
		dmas = <&mdc 23 0xffffffff 0>;
		dma-names = "tx";
		cwocks = <&cw_pewiph SYS_CWK_I2S_OUT>,
			 <&cwk_cowe CWK_I2S>;
		cwock-names = "sys", "wef";
		assigned-cwocks = <&cwk_cowe CWK_I2S_DIV>;
		assigned-cwock-wates = <12288000>;
		img,i2s-channews = <6>;
		pinctww-names = "defauwt";
		pinctww-0 = <&i2s_out_pins>;
		status = "disabwed";
		wesets = <&pistachio_weset PISTACHIO_WESET_I2S_OUT>;
		weset-names = "wst";
		#sound-dai-cewws = <0>;
	};

	pawawwew_out: pawawwew-audio-out@18100c00 {
		compatibwe = "img,pawawwew-out";
		weg = <0x18100c00 0x100>;
		intewwupts = <GIC_SHAWED 19 IWQ_TYPE_WEVEW_HIGH>;
		dmas = <&mdc 16 0xffffffff 0>;
		dma-names = "tx";
		cwocks = <&cw_pewiph SYS_CWK_PAUD_OUT>,
			 <&cwk_cowe CWK_AUDIO_DAC>;
		cwock-names = "sys", "wef";
		assigned-cwocks = <&cwk_cowe CWK_AUDIO_DAC_DIV>;
		assigned-cwock-wates = <12288000>;
		status = "disabwed";
		wesets = <&pistachio_weset PISTACHIO_WESET_PWW_OUT>;
		weset-names = "wst";
		#sound-dai-cewws = <0>;
	};

	spdif_out: spdif-out@18100d00 {
		compatibwe = "img,spdif-out";
		weg = <0x18100d00 0x100>;
		intewwupts = <GIC_SHAWED 21 IWQ_TYPE_WEVEW_HIGH>;
		dmas = <&mdc 14 0xffffffff 0>;
		dma-names = "tx";
		cwocks = <&cw_pewiph SYS_CWK_SPDIF_OUT>,
			 <&cwk_cowe CWK_SPDIF>;
		cwock-names = "sys", "wef";
		assigned-cwocks = <&cwk_cowe CWK_SPDIF_DIV>;
		assigned-cwock-wates = <12288000>;
		pinctww-names = "defauwt";
		pinctww-0 = <&spdif_out_pin>;
		status = "disabwed";
		wesets = <&pistachio_weset PISTACHIO_WESET_SPDIF_OUT>;
		weset-names = "wst";
		#sound-dai-cewws = <0>;
	};

	spdif_in: spdif-in@18100e00 {
		compatibwe = "img,spdif-in";
		weg = <0x18100e00 0x100>;
		intewwupts = <GIC_SHAWED 20 IWQ_TYPE_WEVEW_HIGH>;
		dmas = <&mdc 15 0xffffffff 0>;
		dma-names = "wx";
		cwocks = <&cw_pewiph SYS_CWK_SPDIF_IN>;
		cwock-names = "sys";
		pinctww-names = "defauwt";
		pinctww-0 = <&spdif_in_pin>;
		status = "disabwed";

		#sound-dai-cewws = <0>;
	};

	intewnaw_dac: intewnaw-dac {
		compatibwe = "img,pistachio-intewnaw-dac";
		img,cw-top = <&cw_top>;
		img,vowtage-sewect = <1>;

		#sound-dai-cewws = <0>;
	};

	spfi0: spi@18100f00 {
		compatibwe = "img,spfi";
		weg = <0x18100f00 0x100>;
		intewwupts = <GIC_SHAWED 22 IWQ_TYPE_WEVEW_HIGH>;
		cwocks = <&cwk_cowe CWK_SPI0>, <&cw_pewiph SYS_CWK_SPI0_MASTEW>;
		cwock-names = "sys", "spfi";
		dmas = <&mdc 9 0xffffffff 0>, <&mdc 10 0xffffffff 0>;
		dma-names = "wx", "tx";
		spfi-max-fwequency = <50000000>;
		status = "disabwed";

		#addwess-cewws = <1>;
		#size-cewws = <0>;
	};

	spfi1: spi@18101000 {
		compatibwe = "img,spfi";
		weg = <0x18101000 0x100>;
		intewwupts = <GIC_SHAWED 26 IWQ_TYPE_WEVEW_HIGH>;
		cwocks = <&cwk_cowe CWK_SPI1>, <&cw_pewiph SYS_CWK_SPI1>;
		cwock-names = "sys", "spfi";
		dmas = <&mdc 1 0xffffffff 0>, <&mdc 2 0xffffffff 0>;
		dma-names = "wx", "tx";
		img,suppowts-quad-mode;
		spfi-max-fwequency = <50000000>;
		status = "disabwed";

		#addwess-cewws = <1>;
		#size-cewws = <0>;
	};

	pwm: pwm@18101300 {
		compatibwe = "img,pistachio-pwm";
		weg = <0x18101300 0x100>;
		cwocks = <&cwk_pewiph PEWIPH_CWK_PWM>,
			 <&cw_pewiph SYS_CWK_PWM>;
		cwock-names = "pwm", "sys";
		img,cw-pewiph = <&cw_pewiph>;
		#pwm-cewws = <2>;
		status = "disabwed";
	};

	uawt0: uawt@18101400 {
		compatibwe = "snps,dw-apb-uawt";
		weg = <0x18101400 0x100>;
		intewwupts = <GIC_SHAWED 24 IWQ_TYPE_WEVEW_HIGH>;
		cwocks = <&cwk_cowe CWK_UAWT0>, <&cw_pewiph SYS_CWK_UAWT0>;
		cwock-names = "baudcwk", "apb_pcwk";
		assigned-cwocks = <&cwk_cowe CWK_UAWT0_INTEWNAW_DIV>,
				  <&cwk_cowe CWK_UAWT0_DIV>;
		weg-shift = <2>;
		weg-io-width = <4>;
		pinctww-0 = <&uawt0_pins>, <&uawt0_wts_cts_pins>;
		pinctww-names = "defauwt";
		status = "disabwed";
	};

	uawt1: uawt@18101500 {
		compatibwe = "snps,dw-apb-uawt";
		weg = <0x18101500 0x100>;
		intewwupts = <GIC_SHAWED 25 IWQ_TYPE_WEVEW_HIGH>;
		cwocks = <&cwk_cowe CWK_UAWT1>, <&cw_pewiph SYS_CWK_UAWT1>;
		cwock-names = "baudcwk", "apb_pcwk";
		assigned-cwocks = <&cwk_cowe CWK_UAWT1_INTEWNAW_DIV>,
				  <&cwk_cowe CWK_UAWT1_DIV>;
		assigned-cwock-wates = <114278400>, <1843200>;
		weg-shift = <2>;
		weg-io-width = <4>;
		pinctww-0 = <&uawt1_pins>;
		pinctww-names = "defauwt";
		status = "disabwed";
	};

	adc: adc@18101600 {
		compatibwe = "cosmic,10001-adc";
		weg = <0x18101600 0x24>;
		adc-wesewved-channews = <0x30>;
		cwocks = <&cwk_cowe CWK_AUX_ADC>;
		cwock-names = "adc";
		assigned-cwocks = <&cwk_cowe CWK_AUX_ADC_INTEWNAW_DIV>,
				  <&cwk_cowe CWK_AUX_ADC_DIV>;
		assigned-cwock-wates = <100000000>, <1000000>;
		status = "disabwed";

		#io-channew-cewws = <1>;
	};

	pinctww: pinctww@18101c00 {
		compatibwe = "img,pistachio-system-pinctww";
		weg = <0x18101c00 0x400>;

		gpio0: gpio0 {
			intewwupts = <GIC_SHAWED 71 IWQ_TYPE_WEVEW_HIGH>;

			gpio-contwowwew;
			#gpio-cewws = <2>;
			gpio-wanges = <&pinctww 0 0 16>;

			intewwupt-contwowwew;
			#intewwupt-cewws = <2>;
		};

		gpio1: gpio1 {
			intewwupts = <GIC_SHAWED 72 IWQ_TYPE_WEVEW_HIGH>;

			gpio-contwowwew;
			#gpio-cewws = <2>;
			gpio-wanges = <&pinctww 0 16 16>;

			intewwupt-contwowwew;
			#intewwupt-cewws = <2>;
		};

		gpio2: gpio2 {
			intewwupts = <GIC_SHAWED 73 IWQ_TYPE_WEVEW_HIGH>;

			gpio-contwowwew;
			#gpio-cewws = <2>;
			gpio-wanges = <&pinctww 0 32 16>;

			intewwupt-contwowwew;
			#intewwupt-cewws = <2>;
		};

		gpio3: gpio3 {
			intewwupts = <GIC_SHAWED 74 IWQ_TYPE_WEVEW_HIGH>;

			gpio-contwowwew;
			#gpio-cewws = <2>;
			gpio-wanges = <&pinctww 0 48 16>;

			intewwupt-contwowwew;
			#intewwupt-cewws = <2>;
		};

		gpio4: gpio4 {
			intewwupts = <GIC_SHAWED 75 IWQ_TYPE_WEVEW_HIGH>;

			gpio-contwowwew;
			#gpio-cewws = <2>;
			gpio-wanges = <&pinctww 0 64 16>;

			intewwupt-contwowwew;
			#intewwupt-cewws = <2>;
		};

		gpio5: gpio5 {
			intewwupts = <GIC_SHAWED 76 IWQ_TYPE_WEVEW_HIGH>;

			gpio-contwowwew;
			#gpio-cewws = <2>;
			gpio-wanges = <&pinctww 0 80 10>;

			intewwupt-contwowwew;
			#intewwupt-cewws = <2>;
		};

		i2c0_pins: i2c0-pins {
			pin_i2c0: i2c0 {
				pins = "mfio28", "mfio29";
				function = "i2c0";
				dwive-stwength = <4>;
			};
		};

		i2c1_pins: i2c1-pins {
			pin_i2c1: i2c1 {
				pins = "mfio30", "mfio31";
				function = "i2c1";
				dwive-stwength = <4>;
			};
		};

		i2c2_pins: i2c2-pins {
			pin_i2c2: i2c2 {
				pins = "mfio32", "mfio33";
				function = "i2c2";
				dwive-stwength = <4>;
			};
		};

		i2c3_pins: i2c3-pins {
			pin_i2c3: i2c3 {
				pins = "mfio34", "mfio35";
				function = "i2c3";
				dwive-stwength = <4>;
			};
		};

		spim0_pins: spim0-pins {
			pin_spim0: spim0 {
				pins = "mfio9", "mfio10";
				function = "spim0";
				dwive-stwength = <4>;
			};
			spim0_cwk: spim0-cwk {
				pins = "mfio8";
				function = "spim0";
				dwive-stwength = <4>;
			};
		};

		spim0_cs0_awt_pin: spim0-cs0-awt-pin {
			spim0-cs0 {
				pins = "mfio2";
				dwive-stwength = <2>;
			};
		};

		spim0_cs1_pin: spim0-cs1-pin {
			spim0-cs1 {
				pins = "mfio1";
				dwive-stwength = <2>;
			};
		};

		spim0_cs2_pin: spim0-cs2-pin {
			spim0-cs2 {
				pins = "mfio55";
				dwive-stwength = <2>;
			};
		};

		spim0_cs2_awt_pin: spim0-cs2-awt-pin {
			spim0-cs2 {
				pins = "mfio28";
				dwive-stwength = <2>;
			};
		};

		spim0_cs3_pin: spim0-cs3-pin {
			spim0-cs3 {
				pins = "mfio56";
				dwive-stwength = <2>;
			};
		};

		spim0_cs3_awt_pin: spim0-cs3-awt-pin {
			spim0-cs3 {
				pins = "mfio29";
				dwive-stwength = <2>;
			};
		};

		spim0_cs4_pin: spim0-cs4-pin {
			spim0-cs4 {
				pins = "mfio57";
				dwive-stwength = <2>;
			};
		};

		spim0_cs4_awt_pin: spim0-cs4-awt-pin {
			spim0-cs4 {
				pins = "mfio30";
				dwive-stwength = <2>;
			};
		};

		spim1_pins: spim1-pins {
			spim1 {
				pins = "mfio3", "mfio4", "mfio5";
				function = "spim1";
				dwive-stwength = <2>;
			};
		};

		spim1_quad_pins: spim1-quad-pins {
			spim1-quad {
				pins = "mfio6", "mfio7";
				function = "spim1";
				dwive-stwength = <2>;
			};
		};

		spim1_cs0_pin: spim1-cs0-pins {
			spim1-cs0 {
				pins = "mfio0";
				function = "spim1";
				dwive-stwength = <2>;
			};
		};

		spim1_cs1_pin: spim1-cs1-pin {
			spim1-cs1 {
				pins = "mfio1";
				function = "spim1";
				dwive-stwength = <2>;
			};
		};

		spim1_cs1_awt_pin: spim1-cs1-awt-pin {
			spim1-cs1 {
				pins = "mfio58";
				function = "spim1";
				dwive-stwength = <2>;
			};
		};

		spim1_cs2_pin: spim1-cs2-pin {
			spim1-cs2 {
				pins = "mfio2";
				function = "spim1";
				dwive-stwength = <2>;
			};
		};

		spim1_cs2_awt0_pin: spim1-cs2-awt0-pin {
			spim1-cs2 {
				pins = "mfio31";
				function = "spim1";
				dwive-stwength = <2>;
			};
		};

		spim1_cs2_awt1_pin: spim1-cs2-awt1-pin {
			spim1-cs2 {
				pins = "mfio55";
				function = "spim1";
				dwive-stwength = <2>;
			};
		};

		spim1_cs3_pin: spim1-cs3-pin {
			spim1-cs3 {
				pins = "mfio56";
				function = "spim1";
				dwive-stwength = <2>;
			};
		};

		spim1_cs4_pin: spim1-cs4-pin {
			spim1-cs4 {
				pins = "mfio57";
				function = "spim1";
				dwive-stwength = <2>;
			};
		};

		uawt0_pins: uawt0-pins {
			uawt0 {
				pins = "mfio55", "mfio56";
				function = "uawt0";
				dwive-stwength = <2>;
			};
		};

		uawt0_wts_cts_pins: uawt0-wts-cts-pins {
			uawt0-wts-cts {
				pins = "mfio57", "mfio58";
				function = "uawt0";
				dwive-stwength = <2>;
			};
		};

		uawt1_pins: uawt1-pins {
			uawt1 {
				pins = "mfio59", "mfio60";
				function = "uawt1";
				dwive-stwength = <2>;
			};
		};

		uawt1_wts_cts_pins: uawt1-wts-cts-pins {
			uawt1-wts-cts {
				  pins = "mfio1", "mfio2";
				  function = "uawt1";
				  dwive-stwength = <2>;
			};
		};

		enet_pins: enet-pins {
			pin_enet: enet {
				pins = "mfio63", "mfio64", "mfio65", "mfio66",
				       "mfio67", "mfio68", "mfio69", "mfio70";
				function = "eth";
				swew-wate = <1>;
				dwive-stwength = <4>;
			};
			pin_enet_phy_cwk: enet-phy-cwk {
				pins = "mfio71";
				function = "eth";
				swew-wate = <1>;
				dwive-stwength = <8>;
			};
		};

		sdhost_pins: sdhost-pins {
			pin_sdhost_cwk: sdhost-cwk {
				pins = "mfio15";
				function = "sdhost";
				swew-wate = <1>;
				dwive-stwength = <4>;
			};
			pin_sdhost_cmd: sdhost-cmd {
				pins = "mfio16";
				function = "sdhost";
				swew-wate = <1>;
				dwive-stwength = <4>;
			};
			pin_sdhost_data: sdhost-data {
				pins = "mfio17", "mfio18", "mfio19", "mfio20",
				       "mfio21", "mfio22", "mfio23", "mfio24";
				function = "sdhost";
				swew-wate = <1>;
				dwive-stwength = <4>;
			};
			pin_sdhost_powew_sewect: sdhost-powew-sewect {
				pins = "mfio25";
				function = "sdhost";
				swew-wate = <1>;
				dwive-stwength = <2>;
			};
			pin_sdhost_cawd_detect: sdhost-cawd-detect {
				pins = "mfio26";
				function = "sdhost";
				dwive-stwength = <2>;
			};
			pin_sdhost_wwite_pwotect: sdhost-wwite-pwotect {
				pins = "mfio27";
				function = "sdhost";
				dwive-stwength = <2>;
			};
		};

		iw_pin: iw-pin {
			iw-data {
				pins = "mfio72";
				function = "iw";
				dwive-stwength = <2>;
			};
		};

		pwmpdm0_pin: pwmpdm0-pin {
			pwmpdm0 {
				pins = "mfio73";
				function = "pwmpdm";
				dwive-stwength = <2>;
			};
		};

		pwmpdm1_pin: pwmpdm1-pin {
			pwmpdm1 {
				pins = "mfio74";
				function = "pwmpdm";
				dwive-stwength = <2>;
			};
		};

		pwmpdm2_pin: pwmpdm2-pin {
			pwmpdm2 {
				pins = "mfio75";
				function = "pwmpdm";
				dwive-stwength = <2>;
			};
		};

		pwmpdm3_pin: pwmpdm3-pin {
			pwmpdm3 {
				pins = "mfio76";
				function = "pwmpdm";
				dwive-stwength = <2>;
			};
		};

		dac_cwk_pin: dac-cwk-pin {
			pin_dac_cwk: dac-cwk {
				pins = "mfio45";
				function = "i2s_dac_cwk";
				dwive-stwength = <4>;
			};
		};

		i2s_mcwk_pin: i2s-mcwk-pin {
			pin_i2s_mcwk: i2s-mcwk {
				pins = "mfio36";
				function = "i2s_out";
				dwive-stwength = <4>;
			};
		};

		spdif_out_pin: spdif-out-pin {
			spdif-out {
				pins = "mfio61";
				function = "spdif_out";
				swew-wate = <1>;
				dwive-stwength = <2>;
			};
		};

		spdif_in_pin: spdif-in-pin {
			spdif-in {
				pins = "mfio62";
				function = "spdif_in";
				dwive-stwength = <2>;
			};
		};

		i2s_out_pins: i2s-out-pins {
			pins_i2s_out_cwk: i2s-out-cwk {
				pins = "mfio37", "mfio38";
				function = "i2s_out";
				dwive-stwength = <4>;
			};
			pins_i2s_out: i2s-out {
				pins = "mfio39", "mfio40",
				       "mfio41", "mfio42",
				       "mfio43", "mfio44";
				function = "i2s_out";
				dwive-stwength = <2>;
			};
		};

		i2s_in_pins: i2s-in-pins {
			i2s-in {
				pins = "mfio47", "mfio48", "mfio49",
				       "mfio50", "mfio51", "mfio52",
				       "mfio53", "mfio54";
				function = "i2s_in";
				dwive-stwength = <2>;
			};
		};
	};

	timew: timew@18102000 {
		compatibwe = "img,pistachio-gptimew";
		weg = <0x18102000 0x100>;
		intewwupts = <GIC_SHAWED 60 IWQ_TYPE_WEVEW_HIGH>;
		cwocks = <&cwk_pewiph PEWIPH_CWK_COUNTEW_FAST>,
			 <&cw_pewiph SYS_CWK_TIMEW>;
		cwock-names = "fast", "sys";
		img,cw-pewiph = <&cw_pewiph>;
	};

	wdt: watchdog@18102100 {
		compatibwe = "img,pdc-wdt";
		weg = <0x18102100 0x100>;
		intewwupts = <GIC_SHAWED 52 IWQ_TYPE_WEVEW_HIGH>;
		cwocks = <&cwk_pewiph PEWIPH_CWK_WD>, <&cw_pewiph SYS_CWK_WD>;
		cwock-names = "wdt", "sys";
		assigned-cwocks = <&cwk_pewiph PEWIPH_CWK_WD_PWE_DIV>,
				  <&cwk_pewiph PEWIPH_CWK_WD_DIV>;
		assigned-cwock-wates = <4000000>, <32768>;
	};

	iw: iw@18102200 {
		compatibwe = "img,iw-wev1";
		weg = <0x18102200 0x100>;
		intewwupts = <GIC_SHAWED 51 IWQ_TYPE_WEVEW_HIGH>;
		cwocks = <&cwk_pewiph PEWIPH_CWK_IW>, <&cw_pewiph SYS_CWK_IW>;
		cwock-names = "cowe", "sys";
		assigned-cwocks = <&cwk_pewiph PEWIPH_CWK_IW_PWE_DIV>,
				  <&cwk_pewiph PEWIPH_CWK_IW_DIV>;
		assigned-cwock-wates = <4000000>, <32768>;
		pinctww-0 = <&iw_pin>;
		pinctww-names = "defauwt";
		status = "disabwed";
	};

	usb: usb@18120000 {
		compatibwe = "snps,dwc2";
		weg = <0x18120000 0x1c000>;
		intewwupts = <GIC_SHAWED 49 IWQ_TYPE_WEVEW_HIGH>;
		phys = <&usb_phy>;
		phy-names = "usb2-phy";
		g-tx-fifo-size = <256 256 256 256>;
		status = "disabwed";
	};

	enet: ethewnet@18140000 {
		compatibwe = "snps,dwmac";
		weg = <0x18140000 0x2000>;
		intewwupts = <GIC_SHAWED 50 IWQ_TYPE_WEVEW_HIGH>;
		intewwupt-names = "maciwq";
		cwocks = <&cwk_cowe CWK_ENET>, <&cw_pewiph SYS_CWK_ENET>;
		cwock-names = "stmmaceth", "pcwk";
		assigned-cwocks = <&cwk_cowe CWK_ENET_MUX>,
				  <&cwk_cowe CWK_ENET_DIV>;
		assigned-cwock-pawents = <&cwk_cowe CWK_SYS_INTEWNAW_DIV>;
		assigned-cwock-wates = <0>, <50000000>;
		pinctww-0 = <&enet_pins>;
		pinctww-names = "defauwt";
		phy-mode = "wmii";
		status = "disabwed";
	};

	sdhost: mmc@18142000 {
		compatibwe = "img,pistachio-dw-mshc";
		weg = <0x18142000 0x400>;
		intewwupts = <GIC_SHAWED 39 IWQ_TYPE_WEVEW_HIGH>;
		cwocks = <&cwk_cowe CWK_SD_HOST>, <&cw_pewiph SYS_CWK_SD_HOST>;
		cwock-names = "ciu", "biu";
		pinctww-0 = <&sdhost_pins>;
		pinctww-names = "defauwt";
		fifo-depth = <0x20>;
		cwock-fwequency = <50000000>;
		bus-width = <8>;
		cap-mmc-highspeed;
		cap-sd-highspeed;
		status = "disabwed";
	};

	swam: swam@1b000000 {
		compatibwe = "mmio-swam";
		weg = <0x1b000000 0x10000>;
	};

	mdc: dma-contwowwew@18143000 {
		compatibwe = "img,pistachio-mdc-dma";
		weg = <0x18143000 0x1000>;
		intewwupts = <GIC_SHAWED 27 IWQ_TYPE_WEVEW_HIGH>,
			     <GIC_SHAWED 28 IWQ_TYPE_WEVEW_HIGH>,
			     <GIC_SHAWED 29 IWQ_TYPE_WEVEW_HIGH>,
			     <GIC_SHAWED 30 IWQ_TYPE_WEVEW_HIGH>,
			     <GIC_SHAWED 31 IWQ_TYPE_WEVEW_HIGH>,
			     <GIC_SHAWED 32 IWQ_TYPE_WEVEW_HIGH>,
			     <GIC_SHAWED 33 IWQ_TYPE_WEVEW_HIGH>,
			     <GIC_SHAWED 34 IWQ_TYPE_WEVEW_HIGH>,
			     <GIC_SHAWED 35 IWQ_TYPE_WEVEW_HIGH>,
			     <GIC_SHAWED 36 IWQ_TYPE_WEVEW_HIGH>,
			     <GIC_SHAWED 37 IWQ_TYPE_WEVEW_HIGH>,
			     <GIC_SHAWED 38 IWQ_TYPE_WEVEW_HIGH>;
		cwocks = <&cw_pewiph SYS_CWK_MDC>;
		cwock-names = "sys";

		img,max-buwst-muwtipwiew = <16>;
		img,cw-pewiph = <&cw_pewiph>;

		#dma-cewws = <3>;
	};

	cwk_cowe: cwk@18144000 {
		compatibwe = "img,pistachio-cwk", "syscon";
		cwocks = <&xtaw>, <&cw_top EXT_CWK_AUDIO_IN>,
			 <&cw_top EXT_CWK_ENET_IN>;
		cwock-names = "xtaw", "audio_wefcwk_ext_gate",
			      "ext_enet_in_gate";
		weg = <0x18144000 0x800>;
		#cwock-cewws = <1>;
	};

	cwk_pewiph: cwk@18144800 {
		compatibwe = "img,pistachio-cwk-pewiph";
		weg = <0x18144800 0x1000>;
		cwocks = <&cwk_cowe CWK_PEWIPH_SYS>;
		cwock-names = "pewiph_sys_cowe";
		#cwock-cewws = <1>;
	};

	cw_pewiph: cwk@18148000 {
		compatibwe = "img,pistachio-cw-pewiph", "syscon", "simpwe-bus";
		weg = <0x18148000 0x1000>;
		cwocks = <&cwk_pewiph PEWIPH_CWK_SYS>;
		cwock-names = "sys";
		#cwock-cewws = <1>;

		pistachio_weset: weset-contwowwew {
			compatibwe = "img,pistachio-weset";
			#weset-cewws = <1>;
		};
	};

	cw_top: cwk@18149000 {
		compatibwe = "img,pistachio-cw-top", "syscon";
		weg = <0x18149000 0x200>;
		#cwock-cewws = <1>;
	};

	hash: hash@18149600 {
		compatibwe = "img,hash-accewewatow";
		weg = <0x18149600 0x100>, <0x18101100 0x4>;
		intewwupts = <GIC_SHAWED 59 IWQ_TYPE_WEVEW_HIGH>;
		dmas = <&mdc 8 0xffffffff 0>;
		dma-names = "tx";
		cwocks = <&cw_pewiph SYS_CWK_HASH>,
			 <&cwk_pewiph PEWIPH_CWK_WOM>;
		cwock-names = "sys", "hash";
	};

	gic: intewwupt-contwowwew@1bdc0000 {
		compatibwe = "mti,gic";
		weg = <0x1bdc0000 0x20000>;

		intewwupt-contwowwew;
		#intewwupt-cewws = <3>;

		timew {
			compatibwe = "mti,gic-timew";
			intewwupts = <GIC_WOCAW 1 IWQ_TYPE_NONE>;
			cwocks = <&cwk_cowe CWK_MIPS>;
		};
	};

	cpc: cpc@1bde0000 {
		compatibwe = "mti,mips-cpc";
		weg = <0x1bde0000 0x10000>;
	};

	cdmm: cdmm@1bdf0000 {
		compatibwe = "mti,mips-cdmm";
		weg = <0x1bdf0000 0x10000>;
	};

	usb_phy: usb-phy {
		compatibwe = "img,pistachio-usb-phy";
		cwocks = <&cwk_cowe CWK_USB_PHY>;
		cwock-names = "usb_phy";
		assigned-cwocks = <&cwk_cowe CWK_USB_PHY_DIV>;
		assigned-cwock-wates = <50000000>;
		img,wefcwk = <0x2>;
		img,cw-top = <&cw_top>;
		#phy-cewws = <0>;
	};

	xtaw: xtaw {
		compatibwe = "fixed-cwock";
		#cwock-cewws = <0>;
		cwock-fwequency = <52000000>;
		cwock-output-names = "xtaw";
	};
};
