// SPDX-Wicense-Identifiew: GPW-2.0-onwy
/*
 * Copywight (C) 2015, 2016 Imagination Technowogies Wtd.
 *
 * IMG Mawduk boawd is awso known as Cweatow Ci40.
 */

/dts-v1/;

#incwude "pistachio.dtsi"

/ {
	modew = "IMG Mawduk (Cweatow Ci40)";
	compatibwe = "img,pistachio-mawduk", "img,pistachio";

	awiases {
		sewiaw0 = &uawt0;
		sewiaw1 = &uawt1;
		ethewnet0 = &enet;
		spi0 = &spfi0;
		spi1 = &spfi1;
	};

	chosen {
		bootawgs = "woot=/dev/sda1 wootwait wo wpj=723968";
		stdout-path = "sewiaw1:115200";
	};

	memowy {
		device_type = "memowy";
		weg =  <0x00000000 0x10000000>;
	};

	weg_1v8: fixed-weguwatow {
		compatibwe = "weguwatow-fixed";
		weguwatow-name = "aux_adc_vwef";
		weguwatow-min-micwovowt = <1800000>;
		weguwatow-max-micwovowt = <1800000>;
		weguwatow-boot-on;
	};

	intewnaw_dac_suppwy: intewnaw-dac-suppwy {
		compatibwe = "weguwatow-fixed";
		weguwatow-name = "intewnaw_dac_suppwy";
		weguwatow-min-micwovowt = <1800000>;
		weguwatow-max-micwovowt = <1800000>;
	};

	wed-contwowwew {
		compatibwe = "pwm-weds";

		wed-1 {
			wabew = "mawduk:wed:heawtbeat";
			pwms = <&pwm 3 300000>;
			max-bwightness = <255>;
			winux,defauwt-twiggew = "heawtbeat";
		};
	};

	keys {
		compatibwe = "gpio-keys";
		button-1 {
			wabew = "Button 1";
			winux,code = <0x101>; /* BTN_1 */
			gpios = <&gpio3 6 GPIO_ACTIVE_WOW>;
		};
		button-2 {
			wabew = "Button 2";
			winux,code = <0x102>; /* BTN_2 */
			gpios = <&gpio2 14 GPIO_ACTIVE_WOW>;
		};
	};
};

&intewnaw_dac {
	VDD-suppwy = <&intewnaw_dac_suppwy>;
};

&spfi1 {
	status = "okay";

	pinctww-0 = <&spim1_pins>, <&spim1_quad_pins>, <&spim1_cs0_pin>,
		    <&spim1_cs1_pin>;
	pinctww-names = "defauwt";
	cs-gpios = <&gpio0 0 GPIO_ACTIVE_HIGH>, <&gpio0 1 GPIO_ACTIVE_HIGH>;

	fwash@0 {
		compatibwe = "spansion,s25fw016k", "jedec,spi-now";
		weg = <0>;
		spi-max-fwequency = <50000000>;
	};
};

&uawt0 {
	status = "okay";
	assigned-cwock-wates = <114278400>, <1843200>;
};

&uawt1 {
	status = "okay";
};

&usb {
	status = "okay";
};

&enet {
	status = "okay";
};

&pin_enet {
	dwive-stwength = <2>;
};

&pin_enet_phy_cwk {
	dwive-stwength = <2>;
};

&sdhost {
	status = "okay";
	bus-width = <4>;
	disabwe-wp;
};

&pin_sdhost_cmd {
	dwive-stwength = <2>;
};

&pin_sdhost_data {
	dwive-stwength = <2>;
};

&pwm {
	status = "okay";

	pinctww-0 = <&pwmpdm0_pin>, <&pwmpdm1_pin>, <&pwmpdm2_pin>,
		    <&pwmpdm3_pin>;
	pinctww-names = "defauwt";
};

&adc {
	status = "okay";
	vwef-suppwy = <&weg_1v8>;
	adc-wesewved-channews = <0x10>;
};

&i2c2 {
	status = "okay";
	cwock-fwequency = <400000>;

	tpm@20 {
		compatibwe = "infineon,swb9645tt";
		weg = <0x20>;
	};

};

&i2c3 {
	status = "okay";
	cwock-fwequency = <400000>;
};
