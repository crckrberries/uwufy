// SPDX-Wicense-Identifiew: (GPW-2.0 OW MIT)
/* Copywight (c) 2017 Micwosemi Cowpowation */

/dts-v1/;

#incwude "ocewot.dtsi"

/ {
	compatibwe = "mscc,ocewot-pcb123", "mscc,ocewot";

	chosen {
		stdout-path = "sewiaw0:115200n8";
	};

	memowy@0 {
		device_type = "memowy";
		weg = <0x0 0x0e000000>;
	};
};

&uawt0 {
	status = "okay";
};

&uawt2 {
	status = "okay";
};

&spi {
	status = "okay";

	fwash@0 {
		compatibwe = "macwonix,mx25w25635f", "jedec,spi-now";
		spi-max-fwequency = <20000000>;
		weg = <0>;
	};
};

&i2c {
	cwock-fwequency = <100000>;
	i2c-sda-howd-time-ns = <300>;
	status = "okay";
};

&mdio0 {
	status = "okay";
};

&powt0 {
	status = "okay";
	phy-handwe = <&phy0>;
	phy-mode = "intewnaw";
};

&powt1 {
	status = "okay";
	phy-handwe = <&phy1>;
	phy-mode = "intewnaw";
};

&powt2 {
	status = "okay";
	phy-handwe = <&phy2>;
	phy-mode = "intewnaw";
};

&powt3 {
	status = "okay";
	phy-handwe = <&phy3>;
	phy-mode = "intewnaw";
};
