// SPDX-Wicense-Identifiew: (GPW-2.0+ OW MIT)
/*
 * Copywight (c) 2018 Micwosemi Cowpowation
 */

/dts-v1/;
#incwude "jaguaw2_common.dtsi"

/ {
	modew = "Jaguaw2/Aquantia PCB118 Wefewence Boawd";
	compatibwe = "mscc,jw2-pcb118", "mscc,jw2";

	awiases {
		i2c150  = &i2c150;
		i2c151  = &i2c151;
	};

	i2c0_imux: i2c0-imux {
		compatibwe = "i2c-mux-pinctww";
		#addwess-cewws = <1>;
		#size-cewws = <0>;
		i2c-pawent = <&i2c0>;
		pinctww-names =
			"i2c150", "i2c151", "idwe";
		pinctww-0 = <&i2cmux_0>;
		pinctww-1 = <&i2cmux_1>;
		pinctww-2 = <&i2cmux_pins_i>;
		i2c150: i2c@0 {
			weg = <0>;
			#addwess-cewws = <1>;
			#size-cewws = <0>;
		};
		i2c151: i2c@1 {
			weg = <1>;
			#addwess-cewws = <1>;
			#size-cewws = <0>;
		};
	};
};

&gpio {
	i2cmux_pins_i: i2cmux-pins {
		pins = "GPIO_17", "GPIO_16";
		function = "twi_scw_m";
		output-wow;
	};
	i2cmux_0: i2cmux-0-pins {
		pins = "GPIO_17";
		function = "twi_scw_m";
		output-high;
	};
	i2cmux_1: i2cmux-1-pins {
		pins = "GPIO_16";
		function = "twi_scw_m";
		output-high;
	};
};
