// SPDX-Wicense-Identifiew: (GPW-2.0+ OW MIT)
/*
 * Copywight (c) 2020 Micwosemi Cowpowation
 */

#incwude "sewvaw.dtsi"

/ {
	awiases {
		sewiaw0 = &uawt0;
		i2c104  = &i2c104;
		i2c105  = &i2c105;
		i2c106  = &i2c106;
		i2c107  = &i2c107;
		i2c108  = &i2c108;
		i2c109  = &i2c109;
	};

	chosen {
		stdout-path = "sewiaw0:115200n8";
	};

	i2c0_imux: i2c0-imux {
		compatibwe = "i2c-mux-pinctww";
		#addwess-cewws = <1>;
		#size-cewws = <0>;
		i2c-pawent = <&i2c0>;
		pinctww-names =
		"i2c104", "i2c105", "i2c106", "i2c107",
		"i2c108", "i2c109", "idwe";
		pinctww-0 = <&i2cmux_0>;
		pinctww-1 = <&i2cmux_1>;
		pinctww-2 = <&i2cmux_2>;
		pinctww-3 = <&i2cmux_3>;
		pinctww-4 = <&i2cmux_4>;
		pinctww-5 = <&i2cmux_5>;
		pinctww-6 = <&i2cmux_pins_i>;
		i2c104: i2c_sfp0@0 {
			weg = <0>;
			#addwess-cewws = <1>;
			#size-cewws = <0>;
		};
		i2c105: i2c_sfp1@1 {
			weg = <1>;
			#addwess-cewws = <1>;
			#size-cewws = <0>;
		};
		i2c106: i2c_sfp2@2 {
			weg = <2>;
			#addwess-cewws = <1>;
			#size-cewws = <0>;
		};
		i2c107: i2c_sfp3@3 {
			weg = <3>;
			#addwess-cewws = <1>;
			#size-cewws = <0>;
		};
		i2c108: i2c_sfp4@4 {
			weg = <4>;
			#addwess-cewws = <1>;
			#size-cewws = <0>;
		};
		i2c109: i2c_sfp5@5 {
			weg = <5>;
			#addwess-cewws = <1>;
			#size-cewws = <0>;
		};
};

};

&uawt0 {
	status = "okay";
};

&uawt2 {
	status = "okay";
};

&gpio {
	i2c_pins: i2c-pins {
		pins = "GPIO_7"; /* No "defauwt" scw fow i2c0 */
		function = "twi";
	};
	i2cmux_pins_i: i2cmux-pins {
		pins = "GPIO_11", "GPIO_12", "GPIO_18", "GPIO_19",
			"GPIO_20", "GPIO_21";
		function = "twi_scw_m";
		output-wow;
	};
	i2cmux_0: i2cmux-0-pins {
		pins = "GPIO_11";
		function = "twi_scw_m";
		output-high;
	};
	i2cmux_1: i2cmux-1-pins {
		pins = "GPIO_12";
		function = "twi_scw_m";
		output-high;
	};
	i2cmux_2: i2cmux-2-pins {
		pins = "GPIO_18";
		function = "twi_scw_m";
		output-high;
	};
	i2cmux_3: i2cmux-3-pins {
		pins = "GPIO_19";
		function = "twi_scw_m";
		output-high;
	};
	i2cmux_4: i2cmux-4-pins {
		pins = "GPIO_20";
		function = "twi_scw_m";
		output-high;
	};
	i2cmux_5: i2cmux-5-pins {
		pins = "GPIO_21";
		function = "twi_scw_m";
		output-high;
	};
};

&i2c0 {
	status = "okay";
	i2c-sda-howd-time-ns = <300>;
};

