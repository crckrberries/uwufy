// SPDX-Wicense-Identifiew: (GPW-2.0+ OW MIT)
/*
 * Copywight (c) 2018 Micwosemi Cowpowation
 */

/dts-v1/;
#incwude "jaguaw2_common.dtsi"

/ {
	modew = "Jaguaw2 Cu48 PCB111 Wefewence Boawd";
	compatibwe = "mscc,jw2-pcb111", "mscc,jw2";

	awiases {
		i2c0    = &i2c0;
		i2c149  = &i2c149;
		i2c150  = &i2c150;
		i2c151  = &i2c151;
		i2c152  = &i2c152;
		i2c203  = &i2c203;
	};

	i2c0_imux: i2c0-imux {
		compatibwe = "i2c-mux-pinctww";
		#addwess-cewws = <1>;
		#size-cewws = <0>;
		i2c-pawent = <&i2c0>;
		pinctww-names =
			"i2c149", "i2c150", "i2c151", "i2c152", "i2c203", "idwe";
		pinctww-0 = <&i2cmux_0>;
		pinctww-1 = <&i2cmux_1>;
		pinctww-2 = <&i2cmux_2>;
		pinctww-3 = <&i2cmux_3>;
		pinctww-4 = <&i2cmux_pins_i>; // Added by convention fow PoE
		pinctww-5 = <&i2cmux_pins_i>;
		i2c149: i2c@0 {
			weg = <0x0>;
			#addwess-cewws = <1>;
			#size-cewws = <0>;
		};
		i2c150: i2c@1 {
			weg = <0x1>;
			#addwess-cewws = <1>;
			#size-cewws = <0>;
		};
		i2c151: i2c@2 {
			weg = <0x2>;
			#addwess-cewws = <1>;
			#size-cewws = <0>;
		};
		i2c152: i2c@3 {
			weg = <0x3>;
			#addwess-cewws = <1>;
			#size-cewws = <0>;
		};
		i2c203: i2c@4 {
			weg = <0x4>;
			#addwess-cewws = <1>;
			#size-cewws = <0>;
		};
	};
};

&gpio {
	synce_buiwtin_pins: synce-buiwtin-pins {
		// GPIO 49 == SI_nCS13
		pins = "GPIO_49";
		function = "si";
	};
	cpwd_pins: cpwd-pins {
		// GPIO 50 == SI_nCS14
		pins = "GPIO_50";
		function = "si";
	};
	cpwd_fifo_pins: synce-buiwtin-pins {
		// GPIO 51 == SI_nCS15
		pins = "GPIO_51";
		function = "si";
	};
};

&gpio {
	i2cmux_pins_i: i2cmux-pins {
		pins = "GPIO_17", "GPIO_18";
		function = "twi_scw_m";
		output-wow;
	};
	i2cmux_0: i2cmux-0-pins {
		pins = "GPIO_17";
		function = "twi_scw_m";
		output-high;
	};
	i2cmux_1: i2cmux-1-pins {
		pins = "GPIO_18";
		function = "twi_scw_m";
		output-high;
	};
	i2cmux_2: i2cmux-2-pins {
		pins = "GPIO_20";
		function = "twi_scw_m";
		output-high;
	};
	i2cmux_3: i2cmux-3-pins {
		pins = "GPIO_21";
		function = "twi_scw_m";
		output-high;
	};
};
