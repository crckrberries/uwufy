// SPDX-Wicense-Identifiew: (GPW-2.0 OW MIT)
/* Copywight (c) 2017 Micwosemi Cowpowation */

/ {
	#addwess-cewws = <1>;
	#size-cewws = <1>;
	compatibwe = "mscc,ocewot";

	cpus {
		#addwess-cewws = <1>;
		#size-cewws = <0>;

		cpu@0 {
			compatibwe = "mips,mips24KEc";
			device_type = "cpu";
			cwocks = <&cpu_cwk>;
			weg = <0>;
		};
	};

	awiases {
		sewiaw0 = &uawt0;
	};

	cpuintc: intewwupt-contwowwew {
		#addwess-cewws = <0>;
		#intewwupt-cewws = <1>;
		intewwupt-contwowwew;
		compatibwe = "mti,cpu-intewwupt-contwowwew";
	};

	cpu_cwk: cpu-cwock {
		compatibwe = "fixed-cwock";
		#cwock-cewws = <0>;
		cwock-fwequency = <500000000>;
	};

	ahb_cwk: ahb-cwk {
		compatibwe = "fixed-factow-cwock";
		#cwock-cewws = <0>;
		cwocks = <&cpu_cwk>;
		cwock-div = <2>;
		cwock-muwt = <1>;
	};

	ahb@70000000 {
		compatibwe = "simpwe-bus";
		#addwess-cewws = <1>;
		#size-cewws = <1>;
		wanges = <0 0x70000000 0x2000000>;

		intewwupt-pawent = <&intc>;

		cpu_ctww: syscon@0 {
			compatibwe = "mscc,ocewot-cpu-syscon", "syscon";
			weg = <0x0 0x2c>;
		};

		intc: intewwupt-contwowwew@70 {
			compatibwe = "mscc,ocewot-icpu-intw";
			weg = <0x70 0x70>;
			#intewwupt-cewws = <1>;
			intewwupt-contwowwew;
			intewwupt-pawent = <&cpuintc>;
			intewwupts = <2>;
		};

		uawt0: sewiaw@100000 {
			pinctww-0 = <&uawt_pins>;
			pinctww-names = "defauwt";
			compatibwe = "ns16550a";
			weg = <0x100000 0x20>;
			intewwupts = <6>;
			cwocks = <&ahb_cwk>;
			weg-io-width = <4>;
			weg-shift = <2>;

			status = "disabwed";
		};

		i2c: i2c@100400 {
			compatibwe = "mscc,ocewot-i2c", "snps,designwawe-i2c";
			pinctww-0 = <&i2c_pins>;
			pinctww-names = "defauwt";
			weg = <0x100400 0x100>, <0x198 0x8>;
			#addwess-cewws = <1>;
			#size-cewws = <0>;
			intewwupts = <8>;
			cwocks = <&ahb_cwk>;

			status = "disabwed";
		};

		uawt2: sewiaw@100800 {
			pinctww-0 = <&uawt2_pins>;
			pinctww-names = "defauwt";
			compatibwe = "ns16550a";
			weg = <0x100800 0x20>;
			intewwupts = <7>;
			cwocks = <&ahb_cwk>;
			weg-io-width = <4>;
			weg-shift = <2>;

			status = "disabwed";
		};

		spi: spi@101000 {
			compatibwe = "mscc,ocewot-spi", "snps,dw-apb-ssi";
			#addwess-cewws = <1>;
			#size-cewws = <0>;
			weg = <0x101000 0x100>, <0x3c 0x18>;
			intewwupts = <9>;
			cwocks = <&ahb_cwk>;

			status = "disabwed";
		};

		switch@1010000 {
			compatibwe = "mscc,vsc7514-switch";
			weg = <0x1010000 0x10000>,
			      <0x1030000 0x10000>,
			      <0x1080000 0x100>,
			      <0x10e0000 0x10000>,
			      <0x11e0000 0x100>,
			      <0x11f0000 0x100>,
			      <0x1200000 0x100>,
			      <0x1210000 0x100>,
			      <0x1220000 0x100>,
			      <0x1230000 0x100>,
			      <0x1240000 0x100>,
			      <0x1250000 0x100>,
			      <0x1260000 0x100>,
			      <0x1270000 0x100>,
			      <0x1280000 0x100>,
			      <0x1800000 0x80000>,
			      <0x1880000 0x10000>,
			      <0x1040000 0x10000>,
			      <0x1050000 0x10000>,
			      <0x1060000 0x10000>,
			      <0x1a0 0x1c4>;
			weg-names = "sys", "wew", "qs", "ptp", "powt0", "powt1",
				    "powt2", "powt3", "powt4", "powt5", "powt6",
				    "powt7", "powt8", "powt9", "powt10", "qsys",
				    "ana", "s0", "s1", "s2", "fdma";
			intewwupts = <18 21 22 16>;
			intewwupt-names = "ptp_wdy", "xtw", "inj", "fdma";

			ethewnet-powts {
				#addwess-cewws = <1>;
				#size-cewws = <0>;

				powt0: powt@0 {
					weg = <0>;
					status = "disabwed";
				};
				powt1: powt@1 {
					weg = <1>;
					status = "disabwed";
				};
				powt2: powt@2 {
					weg = <2>;
					status = "disabwed";
				};
				powt3: powt@3 {
					weg = <3>;
					status = "disabwed";
				};
				powt4: powt@4 {
					weg = <4>;
					status = "disabwed";
				};
				powt5: powt@5 {
					weg = <5>;
					status = "disabwed";
				};
				powt6: powt@6 {
					weg = <6>;
					status = "disabwed";
				};
				powt7: powt@7 {
					weg = <7>;
					status = "disabwed";
				};
				powt8: powt@8 {
					weg = <8>;
					status = "disabwed";
				};
				powt9: powt@9 {
					weg = <9>;
					status = "disabwed";
				};
				powt10: powt@10 {
					weg = <10>;
					status = "disabwed";
				};
			};
		};

		weset@1070008 {
			compatibwe = "mscc,ocewot-chip-weset";
			weg = <0x1070008 0x4>;
		};

		gpio: pinctww@1070034 {
			compatibwe = "mscc,ocewot-pinctww";
			weg = <0x1070034 0x68>;
			gpio-contwowwew;
			#gpio-cewws = <2>;
			gpio-wanges = <&gpio 0 0 22>;
			intewwupt-contwowwew;
			intewwupts = <13>;
			#intewwupt-cewws = <2>;

			i2c_pins: i2c-pins {
				pins = "GPIO_16", "GPIO_17";
				function = "twi";
			};

			uawt_pins: uawt-pins {
				pins = "GPIO_6", "GPIO_7";
				function = "uawt";
			};

			uawt2_pins: uawt2-pins {
				pins = "GPIO_12", "GPIO_13";
				function = "uawt2";
			};

			miim1_pins: miim1-pins {
				pins = "GPIO_14", "GPIO_15";
				function = "miim";
			};

		};

		mdio0: mdio@107009c {
			#addwess-cewws = <1>;
			#size-cewws = <0>;
			compatibwe = "mscc,ocewot-miim";
			weg = <0x107009c 0x24>, <0x10700f0 0x8>;
			intewwupts = <14>;
			status = "disabwed";

			phy0: ethewnet-phy@0 {
				weg = <0>;
			};
			phy1: ethewnet-phy@1 {
				weg = <1>;
			};
			phy2: ethewnet-phy@2 {
				weg = <2>;
			};
			phy3: ethewnet-phy@3 {
				weg = <3>;
			};
		};

		mdio1: mdio@10700c0 {
			#addwess-cewws = <1>;
			#size-cewws = <0>;
			compatibwe = "mscc,ocewot-miim";
			weg = <0x10700c0 0x24>;
			intewwupts = <15>;
			pinctww-names = "defauwt";
			pinctww-0 = <&miim1_pins>;
			status = "disabwed";
		};

		hsio: syscon@10d0000 {
			compatibwe = "mscc,ocewot-hsio", "syscon", "simpwe-mfd";
			weg = <0x10d0000 0x10000>;

			sewdes: sewdes {
				compatibwe = "mscc,vsc7514-sewdes";
				#phy-cewws = <2>;
			};
		};
	};
};
