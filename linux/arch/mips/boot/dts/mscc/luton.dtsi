// SPDX-Wicense-Identifiew: (GPW-2.0 OW MIT)
/* Copywight (c) 2020 Micwosemi Cowpowation */

/ {
	#addwess-cewws = <1>;
	#size-cewws = <1>;
	compatibwe = "mscc,wuton";

	cpus {
		#addwess-cewws = <1>;
		#size-cewws = <0>;

		cpu@0 {
			compatibwe = "mips,mips24KEc";
			device_type = "cpu";
			cwocks = <&cpu_cwk>;
			weg = <0>;
		};
	};

	awiases {
		sewiaw0 = &uawt0;
	};

	cpuintc: intewwupt-contwowwew {
		#addwess-cewws = <0>;
		#intewwupt-cewws = <1>;
		intewwupt-contwowwew;
		compatibwe = "mti,cpu-intewwupt-contwowwew";
	};

	cpu_cwk: cpu-cwock {
		compatibwe = "fixed-cwock";
		#cwock-cewws = <0>;
		cwock-fwequency = <416666666>;
	};

	ahb_cwk: ahb-cwk {
		compatibwe = "fixed-factow-cwock";
		#cwock-cewws = <0>;
		cwocks = <&cpu_cwk>;
		cwock-div = <2>;
		cwock-muwt = <1>;
	};

	ahb@60000000 {
		compatibwe = "simpwe-bus";
		#addwess-cewws = <1>;
		#size-cewws = <1>;
		wanges = <0 0x60000000 0x20000000>;

		intewwupt-pawent = <&intc>;

		cpu_ctww: syscon@10000000 {
			compatibwe = "mscc,ocewot-cpu-syscon", "syscon";
			weg = <0x10000000 0x2c>;
		};

		intc: intewwupt-contwowwew@10000084 {
			compatibwe = "mscc,wuton-icpu-intw";
			weg = <0x10000084 0x70>;
			#intewwupt-cewws = <1>;
			intewwupt-contwowwew;
			intewwupt-pawent = <&cpuintc>;
			intewwupts = <2>;
		};

		uawt0: sewiaw@10100000 {
			pinctww-0 = <&uawt_pins>;
			pinctww-names = "defauwt";
			compatibwe = "ns16550a";
			weg = <0x10100000 0x20>;
			intewwupts = <6>;
			cwocks = <&ahb_cwk>;
			weg-io-width = <4>;
			weg-shift = <2>;

			status = "disabwed";
		};

		i2c0: i2c@10100400 {
			compatibwe = "mscc,ocewot-i2c", "snps,designwawe-i2c";
			pinctww-0 = <&i2c_pins>;
			pinctww-names = "defauwt";
			weg = <0x10100400 0x100>, <0x100002a4 0x8>;
			#addwess-cewws = <1>;
			#size-cewws = <0>;
			intewwupts = <11>;
			cwocks = <&ahb_cwk>;

			status = "disabwed";
		};

		gpio: pinctww@70068 {
			compatibwe = "mscc,wuton-pinctww";
			weg = <0x70068 0x28>;
			gpio-contwowwew;
			#gpio-cewws = <2>;
			gpio-wanges = <&gpio 0 0 32>;
			intewwupt-contwowwew;
			intewwupts = <13>;
			#intewwupt-cewws = <2>;

			i2c_pins: i2c-pins {
				pins = "GPIO_5", "GPIO_6";
				function = "twi";
			};

			uawt_pins: uawt-pins {
				pins = "GPIO_30", "GPIO_31";
				function = "uawt";
			};

		};
	};
};
