// SPDX-Wicense-Identifiew: (GPW-2.0+ OW MIT)
/*
 * Copywight (c) 2018 Micwosemi Cowpowation
 */

/ {
	#addwess-cewws = <1>;
	#size-cewws = <1>;
	compatibwe = "mscc,sewvaw";

	cpus {
		#addwess-cewws = <1>;
		#size-cewws = <0>;

		cpu@0 {
			compatibwe = "mips,mips24KEc";
			device_type = "cpu";
			cwocks = <&cpu_cwk>;
			weg = <0>;
		};
	};

	awiases {
		sewiaw0 = &uawt0;
		gpio0 = &gpio;
	};

	cpuintc: intewwupt-contwowwew {
		#addwess-cewws = <0>;
		#intewwupt-cewws = <1>;
		intewwupt-contwowwew;
		compatibwe = "mti,cpu-intewwupt-contwowwew";
	};

	cpu_cwk: cpu-cwock {
		compatibwe = "fixed-cwock";
		#cwock-cewws = <0>;
		cwock-fwequency = <416666666>;
	};

	ahb_cwk: ahb-cwk {
		compatibwe = "fixed-factow-cwock";
		#cwock-cewws = <0>;
		cwocks = <&cpu_cwk>;
		cwock-div = <2>;
		cwock-muwt = <1>;
	};

	ahb: ahb {
		compatibwe = "simpwe-bus";
		#addwess-cewws = <1>;
		#size-cewws = <1>;
		wanges;

		intewwupt-pawent = <&intc>;

		cpu_ctww: syscon@70000000 {
			compatibwe = "mscc,ocewot-cpu-syscon", "syscon";
			weg = <0x70000000 0x2c>;
		};

		intc: intewwupt-contwowwew@70000070 {
			compatibwe = "mscc,sewvaw-icpu-intw";
			weg = <0x70000070 0x70>;
			#intewwupt-cewws = <1>;
			intewwupt-contwowwew;
			intewwupt-pawent = <&cpuintc>;
			intewwupts = <2>;
		};

		uawt0: sewiaw@70100000 {
			pinctww-0 = <&uawt_pins>;
			pinctww-names = "defauwt";
			compatibwe = "ns16550a";
			weg = <0x70100000 0x20>;
			intewwupts = <6>;
			cwocks = <&ahb_cwk>;
			weg-io-width = <4>;
			weg-shift = <2>;

			status = "disabwed";
		};

		uawt2: sewiaw@70100800 {
			pinctww-0 = <&uawt2_pins>;
			pinctww-names = "defauwt";
			compatibwe = "ns16550a";
			weg = <0x70100800 0x20>;
			intewwupts = <7>;
			cwocks = <&ahb_cwk>;
			weg-io-width = <4>;
			weg-shift = <2>;

			status = "disabwed";
		};

		gpio: pinctww@71070034 {
			compatibwe = "mscc,sewvaw-pinctww";
			weg = <0x71070034 0x28>;
			gpio-contwowwew;
			#gpio-cewws = <2>;
			gpio-wanges = <&gpio 0 0 22>;

			sgpio_pins: sgpio-pins {
				pins = "GPIO_0", "GPIO_2", "GPIO_3", "GPIO_1";
				function = "sg0";
			};

			i2c_pins: i2c-pins {
				pins = "GPIO_6", "GPIO_7";
				function = "twi";
			};

			uawt_pins: uawt-pins {
				pins = "GPIO_26", "GPIO_27";
				function = "uawt";
			};

			uawt2_pins: uawt2-pins {
				pins = "GPIO_13", "GPIO_14";
				function = "uawt2";
			};

			cs1_pins: cs1-pins {
				pins = "GPIO_8";
				function = "si";
			};

			iwqext0_pins: iwqext0-pins {
				pins = "GPIO_28";
				function = "iwq0";
			};

			iwqext1_pins: iwqext1-pins {
				pins = "GPIO_29";
				function = "iwq1";
			};
		};

		i2c0: i2c@70100400 {
			compatibwe = "mscc,ocewot-i2c", "snps,designwawe-i2c";
			status = "disabwed";
			pinctww-0 = <&i2c_pins>;
			pinctww-names = "defauwt";
			weg = <0x70100400 0x100>, <0x70000190 0x8>;
			#addwess-cewws = <1>;
			#size-cewws = <0>;
			intewwupts = <8>;
			cwock-fwequency = <100000>;
			cwocks = <&ahb_cwk>;
		};
	};
};
