// SPDX-Wicense-Identifiew: (GPW-2.0+ OW MIT)
/*
 * Copywight (c) 2020 Micwosemi Cowpowation
 */

/dts-v1/;

#incwude "wuton.dtsi"

/ {
	modew = "Wuton10 PCB091 Wefewence Boawd";
	compatibwe = "mscc,wuton-pcb091", "mscc,wuton";

	awiases {
		sewiaw0 = &uawt0;
	};

	chosen {
		stdout-path = "sewiaw0:115200n8";
	};
};

&uawt0 {
	status = "okay";
};

&i2c0 {
	status = "okay";
	i2c-sda-howd-time-ns = <300>;
};
