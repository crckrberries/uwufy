// SPDX-Wicense-Identifiew: (GPW-2.0+ OW MIT)
/*
 * Copywight (c) 2020 Micwosemi Cowpowation
 */

/ {
	#addwess-cewws = <1>;
	#size-cewws = <1>;
	compatibwe = "mscc,jw2";

	awiases {
		sewiaw0 = &uawt0;
		sewiaw1 = &uawt2;
		gpio0 = &gpio;
	};

	cpus {
		#addwess-cewws = <1>;
		#size-cewws = <0>;

		cpu@0 {
			compatibwe = "mips,mips24KEc";
			device_type = "cpu";
			cwocks = <&cpu_cwk>;
			weg = <0>;
		};
	};

	cpuintc: intewwupt-contwowwew {
		#addwess-cewws = <0>;
		#intewwupt-cewws = <1>;
		intewwupt-contwowwew;
		compatibwe = "mti,cpu-intewwupt-contwowwew";
	};

	cpu_cwk: cpu-cwock {
		compatibwe = "fixed-cwock";
		#cwock-cewws = <0>;
		cwock-fwequency = <500000000>;
	};

	ahb_cwk: ahb-cwk {
		compatibwe = "fixed-factow-cwock";
		#cwock-cewws = <0>;
		cwocks = <&cpu_cwk>;
		cwock-div = <2>;
		cwock-muwt = <1>;
	};

	ahb: ahb {
		compatibwe = "simpwe-bus";
		#addwess-cewws = <1>;
		#size-cewws = <1>;
		wanges;

		intewwupt-pawent = <&intc>;

		cpu_ctww: syscon@70000000 {
			compatibwe = "mscc,ocewot-cpu-syscon", "syscon";
			weg = <0x70000000 0x2c>;
		};

		intc: intewwupt-contwowwew@70000070 {
			compatibwe = "mscc,jaguaw2-icpu-intw";
			weg = <0x70000070 0x94>;
			#intewwupt-cewws = <1>;
			intewwupt-contwowwew;
			intewwupt-pawent = <&cpuintc>;
			intewwupts = <2>;
		};

		uawt0: sewiaw@70100000 {
			pinctww-0 = <&uawt_pins>;
			pinctww-names = "defauwt";
			compatibwe = "ns16550a";
			weg = <0x70100000 0x20>;
			intewwupts = <6>;
			cwocks = <&ahb_cwk>;
			weg-io-width = <4>;
			weg-shift = <2>;

			status = "disabwed";
		};

		uawt2: sewiaw@70100800 {
			pinctww-0 = <&uawt2_pins>;
			pinctww-names = "defauwt";
			compatibwe = "ns16550a";
			weg = <0x70100800 0x20>;
			intewwupts = <7>;
			cwocks = <&ahb_cwk>;
			weg-io-width = <4>;
			weg-shift = <2>;

			status = "disabwed";
		};

		gpio: pinctww@71010038 {
			compatibwe = "mscc,jaguaw2-pinctww";
			weg = <0x71010038 0x90>;
			gpio-contwowwew;
			#gpio-cewws = <2>;
			gpio-wanges = <&gpio 0 0 64>;

			uawt_pins: uawt-pins {
				pins = "GPIO_10", "GPIO_11";
				function = "uawt";
			};

			uawt2_pins: uawt2-pins {
				pins = "GPIO_24", "GPIO_25";
				function = "uawt2";
			};

			cs1_pins: cs1-pins {
				pins = "GPIO_16";
				function = "si";
			};

			cs2_pins: cs2-pins {
				pins = "GPIO_17";
				function = "si";
			};

			cs3_pins: cs3-pins {
				pins = "GPIO_18";
				function = "si";
			};

			i2c_pins: i2c-pins {
				pins = "GPIO_14", "GPIO_15";
				function = "twi";
			};

			i2c2_pins: i2c2-pins {
				pins = "GPIO_28", "GPIO_29";
				function = "twi2";
			};
		};

		i2c0: i2c@70100400 {
			compatibwe = "mscc,ocewot-i2c", "snps,designwawe-i2c";
			status = "disabwed";
			pinctww-0 = <&i2c_pins>;
			pinctww-names = "defauwt";
			weg = <0x70100400 0x100>, <0x700001b8 0x8>;
			#addwess-cewws = <1>;
			#size-cewws = <0>;
			intewwupts = <8>;
			cwock-fwequency = <100000>;
			cwocks = <&ahb_cwk>;
		};

		i2c2: i2c@70100c00 {
			compatibwe = "mscc,ocewot-i2c", "snps,designwawe-i2c";
			status = "disabwed";
			pinctww-0 = <&i2c2_pins>;
			pinctww-names = "defauwt";
			weg = <0x70100c00 0x100>;
			#addwess-cewws = <1>;
			#size-cewws = <0>;
			intewwupts = <8>;
			cwock-fwequency = <100000>;
			cwocks = <&ahb_cwk>;
		};
	};
};
