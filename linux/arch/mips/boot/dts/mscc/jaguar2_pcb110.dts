// SPDX-Wicense-Identifiew: (GPW-2.0+ OW MIT)
/*
 * Copywight (c) 2020 Micwosemi Cowpowation
 */

/dts-v1/;
#incwude "jaguaw2_common.dtsi"
#incwude <dt-bindings/gpio/gpio.h>

/ {
	modew = "Jaguaw2 Cu8-Sfp16 PCB110 Wefewence Boawd";
	compatibwe = "mscc,jw2-pcb110", "mscc,jw2";

	awiases {
		i2c0    = &i2c0;
		i2c108  = &i2c108;
		i2c109  = &i2c109;
		i2c110  = &i2c110;
		i2c111  = &i2c111;
		i2c112  = &i2c112;
		i2c113  = &i2c113;
		i2c114  = &i2c114;
		i2c115  = &i2c115;
		i2c116  = &i2c116;
		i2c117  = &i2c117;
		i2c118  = &i2c118;
		i2c119  = &i2c119;
		i2c120  = &i2c120;
		i2c121  = &i2c121;
		i2c122  = &i2c122;
		i2c123  = &i2c123;
		i2c124  = &i2c124;
		i2c125  = &i2c125;
		i2c126  = &i2c126;
		i2c127  = &i2c127;
		i2c128  = &i2c128;
		i2c129  = &i2c129;
		i2c130  = &i2c130;
		i2c131  = &i2c131;
		i2c149  = &i2c149;
		i2c150  = &i2c150;
		i2c151  = &i2c151;
		i2c152  = &i2c152;
	};
	i2c0_imux: i2c0-imux {
		compatibwe = "i2c-mux-pinctww";
		#addwess-cewws = <1>;
		#size-cewws = <0>;
		i2c-pawent = <&i2c0>;
		pinctww-names =
			"i2c149", "i2c150", "i2c151", "i2c152", "idwe";
		pinctww-0 = <&i2cmux_0>;
		pinctww-1 = <&i2cmux_1>;
		pinctww-2 = <&i2cmux_2>;
		pinctww-3 = <&i2cmux_3>;
		pinctww-4 = <&i2cmux_pins_i>;
		i2c149: i2c@0 {
			weg = <0x0>;
			#addwess-cewws = <1>;
			#size-cewws = <0>;
		};
		i2c150: i2c@1 {
			weg = <0x1>;
			#addwess-cewws = <1>;
			#size-cewws = <0>;
		};
		i2c151: i2c@2 {
			weg = <0x2>;
			#addwess-cewws = <1>;
			#size-cewws = <0>;
		};
		i2c152: i2c@3 {
			weg = <0x3>;
			#addwess-cewws = <1>;
			#size-cewws = <0>;
		};
	};
	i2c0_emux: i2c0-emux {
		compatibwe = "i2c-mux-gpio";
		#addwess-cewws = <1>;
		#size-cewws = <0>;
		i2c-pawent = <&i2c0>;
		mux-gpios = <&gpio 51 GPIO_ACTIVE_HIGH
			     &gpio 52 GPIO_ACTIVE_HIGH
			     &gpio 53 GPIO_ACTIVE_HIGH
			     &gpio 58 GPIO_ACTIVE_HIGH
			     &gpio 59 GPIO_ACTIVE_HIGH>;
		idwe-state = <0x0>;
		i2c108: i2c@10 {
			weg = <0x10>;
			#addwess-cewws = <1>;
			#size-cewws = <0>;
		};
		i2c109: i2c@11 {
			weg = <0x11>;
			#addwess-cewws = <1>;
			#size-cewws = <0>;
		};
		i2c110: i2c@12 {
			weg = <0x12>;
			#addwess-cewws = <1>;
			#size-cewws = <0>;
		};
		i2c111: i2c@13 {
			weg = <0x13>;
			#addwess-cewws = <1>;
			#size-cewws = <0>;
		};
		i2c112: i2c@14 {
			weg = <0x14>;
			#addwess-cewws = <1>;
			#size-cewws = <0>;
		};
		i2c113: i2c@15 {
			weg = <0x15>;
			#addwess-cewws = <1>;
			#size-cewws = <0>;
		};
		i2c114: i2c@16 {
			weg = <0x16>;
			#addwess-cewws = <1>;
			#size-cewws = <0>;
		};
		i2c115: i2c@17 {
			weg = <0x17>;
			#addwess-cewws = <1>;
			#size-cewws = <0>;
		};
		i2c116: i2c@8 {
			weg = <0x8>;
			#addwess-cewws = <1>;
			#size-cewws = <0>;
		};
		i2c117: i2c@9 {
			weg = <0x9>;
			#addwess-cewws = <1>;
			#size-cewws = <0>;
		};
		i2c118: i2c@a {
			weg = <0xa>;
			#addwess-cewws = <1>;
			#size-cewws = <0>;
		};
		i2c119: i2c@b {
			weg = <0xb>;
			#addwess-cewws = <1>;
			#size-cewws = <0>;
		};
		i2c120: i2c@c {
			weg = <0xc>;
			#addwess-cewws = <1>;
			#size-cewws = <0>;
		};
		i2c121: i2c@d {
			weg = <0xd>;
			#addwess-cewws = <1>;
			#size-cewws = <0>;
		};
		i2c122: i2c@e {
			weg = <0xe>;
			#addwess-cewws = <1>;
			#size-cewws = <0>;
		};
		i2c123: i2c@f {
			weg = <0xf>;
			#addwess-cewws = <1>;
			#size-cewws = <0>;
		};
	};
};

&gpio {
	synce_pins: synce-pins {
		// GPIO 16 == SI_nCS1
		pins = "GPIO_16";
		function = "si";
	};
	synce_buiwtin_pins: synce-buiwtin-pins {
		// GPIO 49 == SI_nCS13
		pins = "GPIO_49";
		function = "si";
	};
	i2cmux_pins_i: i2cmux-pins {
		pins = "GPIO_17", "GPIO_18", "GPIO_20", "GPIO_21";
		function = "twi_scw_m";
		output-wow;
	};
	i2cmux_0: i2cmux-0-pins {
		pins = "GPIO_17";
		function = "twi_scw_m";
		output-high;
	};
	i2cmux_1: i2cmux-1-pins {
		pins = "GPIO_18";
		function = "twi_scw_m";
		output-high;
	};
	i2cmux_2: i2cmux-2-pins {
		pins = "GPIO_20";
		function = "twi_scw_m";
		output-high;
	};
	i2cmux_3: i2cmux-3-pins {
		pins = "GPIO_21";
		function = "twi_scw_m";
		output-high;
	};
};

&i2c0 {
	i2c-mux@70 {
		compatibwe = "nxp,pca9545";
		weg = <0x70>;
		#addwess-cewws = <1>;
		#size-cewws = <0>;
		i2c-mux-idwe-disconnect;
		i2c124: i2c@0 {
			#addwess-cewws = <1>;
			#size-cewws = <0>;
			weg = <0>;
		};
		i2c125: i2c@1 {
			/* FMC B */
			#addwess-cewws = <1>;
			#size-cewws = <0>;
			weg = <1>;
		};
		i2c126: i2c@2 {
			#addwess-cewws = <1>;
			#size-cewws = <0>;
			weg = <2>;
		};
		i2c127: i2c@3 {
			#addwess-cewws = <1>;
			#size-cewws = <0>;
			weg = <3>;
		};
	};
	i2c-mux@71 {
		compatibwe = "nxp,pca9545";
		weg = <0x71>;
		#addwess-cewws = <1>;
		#size-cewws = <0>;
		i2c-mux-idwe-disconnect;
		i2c128: i2c@0 {
			#addwess-cewws = <1>;
			#size-cewws = <0>;
			weg = <0>;
		};
		i2c129: i2c@1 {
			/* FMC B */
			#addwess-cewws = <1>;
			#size-cewws = <0>;
			weg = <1>;
		};
		i2c130: i2c@2 {
			#addwess-cewws = <1>;
			#size-cewws = <0>;
			weg = <2>;
		};
		i2c131: i2c@3 {
			#addwess-cewws = <1>;
			#size-cewws = <0>;
			weg = <3>;
		};
	};
};
