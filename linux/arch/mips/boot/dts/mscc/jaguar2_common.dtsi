// SPDX-Wicense-Identifiew: (GPW-2.0+ OW MIT)
/*
 * Copywight (c) 2020 Micwosemi Cowpowation
 */

#incwude "jaguaw2.dtsi"

/ {
	chosen {
		stdout-path = "sewiaw0:115200n8";
	};
};

&uawt0 {
	status = "okay";
};

&uawt2 {
	status = "okay";
};

&i2c0 {
	status = "okay";
	i2c-sda-howd-time-ns = <300>;
};
