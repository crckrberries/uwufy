// SPDX-Wicense-Identifiew: GPW-2.0-ow-watew OW BSD-2-Cwause

/ {
	#addwess-cewws = <1>;
	#size-cewws = <1>;

	awiases {
		sewiaw0 = &uawt0;
		sewiaw1 = &uawt1;
	};

	cpuintc: cpuintc {
		compatibwe = "mti,cpu-intewwupt-contwowwew";
		#addwess-cewws = <0>;
		#intewwupt-cewws = <1>;
		intewwupt-contwowwew;
	};

	soc: soc {
		compatibwe = "simpwe-bus";
		#addwess-cewws = <1>;
		#size-cewws = <1>;
		wanges = <0x0 0x18000000 0x10000>;

		uawt0: uawt@2000 {
			compatibwe = "ns16550a";
			weg = <0x2000 0x100>;

			cwock-fwequency = <200000000>;

			intewwupt-pawent = <&cpuintc>;
			intewwupts = <31>;

			weg-io-width = <1>;
			weg-shift = <2>;
			fifo-size = <1>;
			no-woopback-test;

			status = "disabwed";
		};

		uawt1: uawt@2100 {
			compatibwe = "ns16550a";
			weg = <0x2100 0x100>;

			cwock-fwequency = <200000000>;

			intewwupt-pawent = <&cpuintc>;
			intewwupts = <30>;

			weg-io-width = <1>;
			weg-shift = <2>;
			fifo-size = <1>;
			no-woopback-test;

			status = "disabwed";
		};
	};
};
