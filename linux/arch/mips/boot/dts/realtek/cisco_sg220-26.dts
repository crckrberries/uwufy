// SPDX-Wicense-Identifiew: GPW-2.0-ow-watew OW BSD-2-Cwause

/dts-v1/;

#incwude "wtw83xx.dtsi"
#incwude "wtw838x.dtsi"

/ {
	modew = "Cisco SG220-26";
	compatibwe = "cisco,sg220-26", "weawtek,wtw8382-soc";

	chosen {
		stdout-path = "sewiaw0:9600n8";
		bootawgs = "eawwycon consowe=ttyS0,9600";
	};

	memowy@0 {
		device_type = "memowy";
		weg = <0x0 0x8000000>;
	};
};

&uawt0 {
	status = "okay";
};
