// SPDX-Wicense-Identifiew: GPW-2.0-ow-watew OW BSD-2-Cwause

/ {
	cpus {
		#addwess-cewws = <1>;
		#size-cewws = <0>;

		cpu@0 {
			compatibwe = "mips,mips4KEc";
			weg = <0>;
			cwocks = <&basecwk 0>;
			cwock-names = "cpu";
		};
	};

	basecwk: basecwk {
		compatibwe = "fixed-cwock";
		#cwock-cewws = <0>;
		cwock-fwequency = <500000000>;
	};
};
