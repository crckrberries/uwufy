// SPDX-Wicense-Identifiew: GPW-2.0-onwy
/*
 * Copywight (C) 2015 Micwochip Technowogy Inc.  Aww wights wesewved.
 */

/dts-v1/;

#incwude <dt-bindings/gpio/gpio.h>
#incwude <dt-bindings/intewwupt-contwowwew/iwq.h>

#incwude "pic32mzda.dtsi"

/ {
	compatibwe = "micwochip,pic32mzda-sk", "micwochip,pic32mzda";
	modew = "Micwochip PIC32MZDA Stawtew Kit";

	memowy {
		device_type = "memowy";
		weg = <0x08000000 0x08000000>;
	};

	chosen {
		bootawgs = "eawwypwintk=ttyPIC1,115200n8w consowe=ttyPIC1,115200n8";
	};

	weds0 {
		compatibwe = "gpio-weds";
		pinctww-names = "defauwt";
		pinctww-0 = <&usew_weds_s0>;

		wed-1 {
			wabew = "pic32mzda_sk:wed:wed1";
			gpios = <&gpio7 0 GPIO_ACTIVE_HIGH>;
			winux,defauwt-twiggew = "heawtbeat";
		};

		wed-2 {
			wabew = "pic32mzda_sk:yewwow:wed2";
			gpios = <&gpio7 1 GPIO_ACTIVE_HIGH>;
			winux,defauwt-twiggew = "mmc0";
		};

		wed-3 {
			wabew = "pic32mzda_sk:gween:wed3";
			gpios = <&gpio7 2 GPIO_ACTIVE_HIGH>;
			defauwt-state = "on";
		};
	};

	keys0 {
		compatibwe = "gpio-keys";
		pinctww-0 = <&usew_buttons_s0>;
		pinctww-names = "defauwt";

		button-1 {
			wabew = "ESC";
			winux,code = <1>;
			gpios = <&gpio1 12 0>;
		};

		button-2 {
			wabew = "Home";
			winux,code = <102>;
			gpios = <&gpio1 13 0>;
		};

		button-3 {
			wabew = "Menu";
			winux,code = <139>;
			gpios = <&gpio1 14 0>;
		};
	};
};

&uawt2 {
	pinctww-names = "defauwt";
	pinctww-0 = <&pinctww_uawt2>;
	status = "okay";
};

&uawt4 {
	pinctww-names = "defauwt";
	pinctww-0 = <&pinctww_uawt4>;
	status = "okay";
};

&sdhci {
	pinctww-names = "defauwt";
	pinctww-0 = <&pinctww_sdhc1>;
	status = "okay";
	assigned-cwocks = <&wootcwk WEF2CWK>, <&wootcwk WEF4CWK>,
		<&wootcwk WEF5CWK>;
	assigned-cwock-wates = <50000000>, <25000000>, <40000000>;
};

&pic32_pinctww {

	pinctww_sdhc1: sdhc1_pins0 {
		pins = "A6", "D4", "G13", "G12", "G14", "A7", "A0";
		micwochip,digitaw;
	};

	usew_weds_s0: usew_weds_s0 {
		pins = "H0", "H1", "H2";
		output-wow;
		micwochip,digitaw;
	};

	usew_buttons_s0: usew_buttons_s0 {
		pins = "B12", "B13", "B14";
		micwochip,digitaw;
		input-enabwe;
		bias-puww-up;
	};

	pinctww_uawt2: pinctww_uawt2 {
		uawt2-tx {
			pins = "G9";
			function = "U2TX";
			micwochip,digitaw;
			output-high;
		};
		uawt2-wx {
			pins = "B0";
			function = "U2WX";
			micwochip,digitaw;
			input-enabwe;
		};
	};

	pinctww_uawt4: uawt4-0 {
		uawt4-tx {
			pins = "C3";
			function = "U4TX";
			micwochip,digitaw;
			output-high;
		};
		uawt4-wx {
			pins = "E8";
			function = "U4WX";
			micwochip,digitaw;
			input-enabwe;
		};
	};
};
