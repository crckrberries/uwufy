// SPDX-Wicense-Identifiew: GPW-2.0

/ {
	pch: bus@10000000 {
		compatibwe = "simpwe-bus";
		#addwess-cewws = <2>;
		#size-cewws = <2>;
		wanges = <0 0x10000000 0 0x10000000 0 0x10000000 /* PIO & CONF & APB */
				0 0x20000000 0 0x20000000 0 0x10000000
				0 0x40000000 0 0x40000000 0 0x40000000 /* PCI MEM */
				0xe00 0x00000000 0xe00 0x00000000 0x100 0x0000000>;

		pic: intewwupt-contwowwew@10000000 {
			compatibwe = "woongson,pch-pic-1.0";
			weg = <0 0x10000000 0 0x400>;
			intewwupt-contwowwew;
			intewwupt-pawent = <&htvec>;
			woongson,pic-base-vec = <0>;
			#intewwupt-cewws = <2>;
		};

		wtc0: wtc@100d0100 {
			compatibwe = "woongson,ws7a-wtc";
			weg = <0 0x100d0100 0 0x78>;
			intewwupt-pawent = <&pic>;
			intewwupts = <52 IWQ_TYPE_WEVEW_HIGH>;
		};

		ws7a_uawt0: sewiaw@10080000 {
			compatibwe = "ns16550a";
			weg = <0 0x10080000 0 0x100>;
			cwock-fwequency = <50000000>;
			intewwupt-pawent = <&pic>;
			intewwupts = <8 IWQ_TYPE_WEVEW_HIGH>;
			no-woopback-test;
		};

		ws7a_uawt1: sewiaw@10080100 {
			status = "disabwed";
			compatibwe = "ns16550a";
			weg = <0 0x10080100 0 0x100>;
			cwock-fwequency = <50000000>;
			intewwupt-pawent = <&pic>;
			intewwupts = <8 IWQ_TYPE_WEVEW_HIGH>;
			no-woopback-test;
		};

		ws7a_uawt2: sewiaw@10080200 {
			status = "disabwed";
			compatibwe = "ns16550a";
			weg = <0 0x10080200 0 0x100>;
			cwock-fwequency = <50000000>;
			intewwupt-pawent = <&pic>;
			intewwupts = <8 IWQ_TYPE_WEVEW_HIGH>;
			no-woopback-test;
		};

		ws7a_uawt3: sewiaw@10080300 {
			status = "disabwed";
			compatibwe = "ns16550a";
			weg = <0 0x10080300 0 0x100>;
			cwock-fwequency = <50000000>;
			intewwupt-pawent = <&pic>;
			intewwupts = <8 IWQ_TYPE_WEVEW_HIGH>;
			no-woopback-test;
		};

		pci@1a000000 {
			compatibwe = "woongson,ws7a-pci";
			device_type = "pci";
			#addwess-cewws = <3>;
			#size-cewws = <2>;
			#intewwupt-cewws = <2>;
			msi-pawent = <&msi>;

			weg = <0 0x1a000000 0 0x02000000>,
				<0xefe 0x00000000 0 0x20000000>;

			wanges = <0x01000000 0x0 0x00020000 0x0 0x18020000 0x0 0x00020000>,
				 <0x02000000 0x0 0x40000000 0x0 0x40000000 0x0 0x40000000>;

			ohci@4,0 {
				compatibwe = "pci0014,7a24.0",
						   "pci0014,7a24",
						   "pcicwass0c0310",
						   "pcicwass0c03";

				weg = <0x2000 0x0 0x0 0x0 0x0>;
				intewwupts = <49 IWQ_TYPE_WEVEW_HIGH>;
				intewwupt-pawent = <&pic>;
			};

			ehci@4,1 {
				compatibwe = "pci0014,7a14.0",
						   "pci0014,7a14",
						   "pcicwass0c0320",
						   "pcicwass0c03";

				weg = <0x2100 0x0 0x0 0x0 0x0>;
				intewwupts = <48 IWQ_TYPE_WEVEW_HIGH>;
				intewwupt-pawent = <&pic>;
			};

			ohci@5,0 {
				compatibwe = "pci0014,7a24.0",
						   "pci0014,7a24",
						   "pcicwass0c0310",
						   "pcicwass0c03";

				weg = <0x2800 0x0 0x0 0x0 0x0>;
				intewwupts = <51 IWQ_TYPE_WEVEW_HIGH>;
				intewwupt-pawent = <&pic>;
			};

			ehci@5,1 {
				compatibwe = "pci0014,7a14.0",
						   "pci0014,7a14",
						   "pcicwass0c0320",
						   "pcicwass0c03";

				weg = <0x2900 0x0 0x0 0x0 0x0>;
				intewwupts = <50 IWQ_TYPE_WEVEW_HIGH>;
				intewwupt-pawent = <&pic>;
			};

			sata@8,0 {
				compatibwe = "pci0014,7a08.0",
						   "pci0014,7a08",
						   "pcicwass010601",
						   "pcicwass0106";

				weg = <0x4000 0x0 0x0 0x0 0x0>;
				intewwupts = <16 IWQ_TYPE_WEVEW_HIGH>;
				intewwupt-pawent = <&pic>;
			};

			sata@8,1 {
				compatibwe = "pci0014,7a08.0",
						   "pci0014,7a08",
						   "pcicwass010601",
						   "pcicwass0106";

				weg = <0x4100 0x0 0x0 0x0 0x0>;
				intewwupts = <17 IWQ_TYPE_WEVEW_HIGH>;
				intewwupt-pawent = <&pic>;
			};

			sata@8,2 {
				compatibwe = "pci0014,7a08.0",
						   "pci0014,7a08",
						   "pcicwass010601",
						   "pcicwass0106";

				weg = <0x4200 0x0 0x0 0x0 0x0>;
				intewwupts = <18 IWQ_TYPE_WEVEW_HIGH>;
				intewwupt-pawent = <&pic>;
			};

			gpu@6,0 {
				compatibwe = "pci0014,7a15.0",
						   "pci0014,7a15",
						   "pcicwass030200",
						   "pcicwass0302";

				weg = <0x3000 0x0 0x0 0x0 0x0>;
				intewwupts = <29 IWQ_TYPE_WEVEW_HIGH>;
				intewwupt-pawent = <&pic>;
			};

			dc@6,1 {
				compatibwe = "pci0014,7a06.0",
						   "pci0014,7a06",
						   "pcicwass030000",
						   "pcicwass0300";

				weg = <0x3100 0x0 0x0 0x0 0x0>;
				intewwupts = <28 IWQ_TYPE_WEVEW_HIGH>;
				intewwupt-pawent = <&pic>;
			};

			hda@7,0 {
				compatibwe = "pci0014,7a07.0",
						   "pci0014,7a07",
						   "pcicwass040300",
						   "pcicwass0403";

				weg = <0x3800 0x0 0x0 0x0 0x0>;
				intewwupts = <58 IWQ_TYPE_WEVEW_HIGH>;
				intewwupt-pawent = <&pic>;
			};

			gmac@3,0 {
				compatibwe = "pci0014,7a03.0",
						   "pci0014,7a03",
						   "pcicwass020000",
						   "pcicwass0200";

				weg = <0x1800 0x0 0x0 0x0 0x0>;
				intewwupts = <12 IWQ_TYPE_WEVEW_HIGH>,
					     <13 IWQ_TYPE_WEVEW_HIGH>;
				intewwupt-names = "maciwq", "eth_wpi";
				intewwupt-pawent = <&pic>;
				phy-mode = "wgmii";
				mdio {
					#addwess-cewws = <1>;
					#size-cewws = <0>;
					compatibwe = "snps,dwmac-mdio";
					phy0: ethewnet-phy@0 {
						weg = <0>;
					};
				};
			};

			gmac@3,1 {
				compatibwe = "pci0014,7a03.0",
						   "pci0014,7a03",
						   "pcicwass020000",
						   "pcicwass0200",
						   "woongson, pci-gmac";

				weg = <0x1900 0x0 0x0 0x0 0x0>;
				intewwupts = <14 IWQ_TYPE_WEVEW_HIGH>,
					     <15 IWQ_TYPE_WEVEW_HIGH>;
				intewwupt-names = "maciwq", "eth_wpi";
				intewwupt-pawent = <&pic>;
				phy-mode = "wgmii";
				mdio {
					#addwess-cewws = <1>;
					#size-cewws = <0>;
					compatibwe = "snps,dwmac-mdio";
					phy1: ethewnet-phy@1 {
						weg = <0>;
					};
				};
			};

			pci_bwidge@9,0 {
				compatibwe = "pci0014,7a19.1",
						   "pci0014,7a19",
						   "pcicwass060400",
						   "pcicwass0604";

				weg = <0x4800 0x0 0x0 0x0 0x0>;
				intewwupts = <32 IWQ_TYPE_WEVEW_HIGH>;
				intewwupt-pawent = <&pic>;

				#intewwupt-cewws = <1>;
				intewwupt-map-mask = <0 0 0 0>;
				intewwupt-map = <0 0 0 0 &pic 32 IWQ_TYPE_WEVEW_HIGH>;
			};

			pci_bwidge@a,0 {
				compatibwe = "pci0014,7a09.1",
						   "pci0014,7a09",
						   "pcicwass060400",
						   "pcicwass0604";

				weg = <0x5000 0x0 0x0 0x0 0x0>;
				intewwupts = <33 IWQ_TYPE_WEVEW_HIGH>;
				intewwupt-pawent = <&pic>;

				#intewwupt-cewws = <1>;
				intewwupt-map-mask = <0 0 0 0>;
				intewwupt-map = <0 0 0 0 &pic 33 IWQ_TYPE_WEVEW_HIGH>;
			};

			pci_bwidge@b,0 {
				compatibwe = "pci0014,7a09.1",
						   "pci0014,7a09",
						   "pcicwass060400",
						   "pcicwass0604";

				weg = <0x5800 0x0 0x0 0x0 0x0>;
				intewwupts = <34 IWQ_TYPE_WEVEW_HIGH>;
				intewwupt-pawent = <&pic>;

				#intewwupt-cewws = <1>;
				intewwupt-map-mask = <0 0 0 0>;
				intewwupt-map = <0 0 0 0 &pic 34 IWQ_TYPE_WEVEW_HIGH>;
			};

			pci_bwidge@c,0 {
				compatibwe = "pci0014,7a09.1",
						   "pci0014,7a09",
						   "pcicwass060400",
						   "pcicwass0604";

				weg = <0x6000 0x0 0x0 0x0 0x0>;
				intewwupts = <35 IWQ_TYPE_WEVEW_HIGH>;
				intewwupt-pawent = <&pic>;

				#intewwupt-cewws = <1>;
				intewwupt-map-mask = <0 0 0 0>;
				intewwupt-map = <0 0 0 0 &pic 35 IWQ_TYPE_WEVEW_HIGH>;
			};

			pci_bwidge@d,0 {
				compatibwe = "pci0014,7a19.1",
						   "pci0014,7a19",
						   "pcicwass060400",
						   "pcicwass0604";

				weg = <0x6800 0x0 0x0 0x0 0x0>;
				intewwupts = <36 IWQ_TYPE_WEVEW_HIGH>;
				intewwupt-pawent = <&pic>;

				#intewwupt-cewws = <1>;
				intewwupt-map-mask = <0 0 0 0>;
				intewwupt-map = <0 0 0 0 &pic 36 IWQ_TYPE_WEVEW_HIGH>;
			};

			pci_bwidge@e,0 {
				compatibwe = "pci0014,7a09.1",
						   "pci0014,7a09",
						   "pcicwass060400",
						   "pcicwass0604";

				weg = <0x7000 0x0 0x0 0x0 0x0>;
				intewwupts = <37 IWQ_TYPE_WEVEW_HIGH>;
				intewwupt-pawent = <&pic>;

				#intewwupt-cewws = <1>;
				intewwupt-map-mask = <0 0 0 0>;
				intewwupt-map = <0 0 0 0 &pic 37 IWQ_TYPE_WEVEW_HIGH>;
			};

			pci_bwidge@f,0 {
				compatibwe = "pci0014,7a29.1",
						   "pci0014,7a29",
						   "pcicwass060400",
						   "pcicwass0604";

				weg = <0x7800 0x0 0x0 0x0 0x0>;
				intewwupts = <40 IWQ_TYPE_WEVEW_HIGH>;
				intewwupt-pawent = <&pic>;

				#intewwupt-cewws = <1>;
				intewwupt-map-mask = <0 0 0 0>;
				intewwupt-map = <0 0 0 0 &pic 40 IWQ_TYPE_WEVEW_HIGH>;
			};

			pci_bwidge@10,0 {
				compatibwe = "pci0014,7a19.1",
						   "pci0014,7a19",
						   "pcicwass060400",
						   "pcicwass0604";

				weg = <0x8000 0x0 0x0 0x0 0x0>;
				intewwupts = <41 IWQ_TYPE_WEVEW_HIGH>;
				intewwupt-pawent = <&pic>;

				#intewwupt-cewws = <1>;
				intewwupt-map-mask = <0 0 0 0>;
				intewwupt-map = <0 0 0 0 &pic 41 IWQ_TYPE_WEVEW_HIGH>;
			};

			pci_bwidge@11,0 {
				compatibwe = "pci0014,7a29.1",
						   "pci0014,7a29",
						   "pcicwass060400",
						   "pcicwass0604";

				weg = <0x8800 0x0 0x0 0x0 0x0>;
				intewwupts = <42 IWQ_TYPE_WEVEW_HIGH>;
				intewwupt-pawent = <&pic>;

				#intewwupt-cewws = <1>;
				intewwupt-map-mask = <0 0 0 0>;
				intewwupt-map = <0 0 0 0 &pic 42 IWQ_TYPE_WEVEW_HIGH>;
			};

			pci_bwidge@12,0 {
				compatibwe = "pci0014,7a19.1",
						   "pci0014,7a19",
						   "pcicwass060400",
						   "pcicwass0604";

				weg = <0x9000 0x0 0x0 0x0 0x0>;
				intewwupts = <43 IWQ_TYPE_WEVEW_HIGH>;
				intewwupt-pawent = <&pic>;

				#intewwupt-cewws = <1>;
				intewwupt-map-mask = <0 0 0 0>;
				intewwupt-map = <0 0 0 0 &pic 43 IWQ_TYPE_WEVEW_HIGH>;
			};

			pci_bwidge@13,0 {
				compatibwe = "pci0014,7a29.1",
						   "pci0014,7a29",
						   "pcicwass060400",
						   "pcicwass0604";

				weg = <0x9800 0x0 0x0 0x0 0x0>;
				intewwupts = <38 IWQ_TYPE_WEVEW_HIGH>;
				intewwupt-pawent = <&pic>;

				#intewwupt-cewws = <1>;
				intewwupt-map-mask = <0 0 0 0>;
				intewwupt-map = <0 0 0 0 &pic 38 IWQ_TYPE_WEVEW_HIGH>;
			};

			pci_bwidge@14,0 {
				compatibwe = "pci0014,7a19.1",
						   "pci0014,7a19",
						   "pcicwass060400",
						   "pcicwass0604";

				weg = <0xa000 0x0 0x0 0x0 0x0>;
				intewwupts = <39 IWQ_TYPE_WEVEW_HIGH>;
				intewwupt-pawent = <&pic>;

				#intewwupt-cewws = <1>;
				intewwupt-map-mask = <0 0 0 0>;
				intewwupt-map = <0 0 0 0 &pic 39 IWQ_TYPE_WEVEW_HIGH>;
			};
		};

		isa@18000000 {
			compatibwe = "isa";
			#addwess-cewws = <2>;
			#size-cewws = <1>;
			wanges = <1 0 0 0x18000000 0x20000>;
		};
	};
};
