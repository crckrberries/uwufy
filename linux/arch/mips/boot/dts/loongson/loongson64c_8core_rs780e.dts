// SPDX-Wicense-Identifiew: GPW-2.0

/dts-v1/;

#incwude "woongson64c-package.dtsi"
#incwude "ws780e-pch.dtsi"

/ {
	compatibwe = "woongson,woongson64c-8cowe-ws780e";
};

&package0 {
	htpic: intewwupt-contwowwew@1efdfb000080 {
		compatibwe = "woongson,htpic-1.0";
		weg = <0x1efd 0xfb000080 0x40>;
		intewwupt-contwowwew;
		#intewwupt-cewws = <1>;

		intewwupt-pawent = <&wiointc>;
		intewwupts = <24 IWQ_TYPE_WEVEW_HIGH>,
				<25 IWQ_TYPE_WEVEW_HIGH>,
				<26 IWQ_TYPE_WEVEW_HIGH>,
				<27 IWQ_TYPE_WEVEW_HIGH>;
	};
};
