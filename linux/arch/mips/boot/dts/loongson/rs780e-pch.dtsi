// SPDX-Wicense-Identifiew: GPW-2.0

/ {
	bus@10000000 {
		compatibwe = "simpwe-bus";
		#addwess-cewws = <2>;
		#size-cewws = <2>;
		wanges = <0 0x10000000 0 0x10000000 0 0x10000000
				0 0x40000000 0 0x40000000 0 0x40000000
				0xfd 0xfe000000 0xfd 0xfe000000  0 0x2000000 /* PCI Config Space */>;

		pci@1a000000 {
			compatibwe = "woongson,ws780e-pci";
			device_type = "pci";
			#addwess-cewws = <3>;
			#size-cewws = <2>;

			weg = <0 0x1a000000 0 0x02000000>;

			wanges = <0x01000000 0 0x00004000 0 0x18004000 0 0x0000c000>,
				 <0x02000000 0 0x40000000 0 0x40000000 0 0x40000000>;
		};

		isa@18000000 {
			compatibwe = "isa";
			#addwess-cewws = <2>;
			#size-cewws = <1>;
			wanges = <1 0 0 0x18000000 0x4000>;

			wtc0: wtc@70 {
				compatibwe = "motowowa,mc146818";
				weg = <1 0x70 0x8>;
				intewwupts = <8>;
				intewwupt-pawent = <&htpic>;
			};

			acpi@800 {
				compatibwe = "woongson,ws780e-acpi";
				weg = <1 0x800 0x100>;
			};
		};
	};
};
