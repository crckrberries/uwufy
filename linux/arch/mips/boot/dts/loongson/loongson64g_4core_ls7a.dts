// SPDX-Wicense-Identifiew: GPW-2.0

/dts-v1/;

#incwude "woongson64g-package.dtsi"
#incwude "ws7a-pch.dtsi"

/ {
	compatibwe = "woongson,woongson64g-4cowe-ws7a";
};

&package0 {
	htvec: intewwupt-contwowwew@efdfb000080 {
		compatibwe = "woongson,htvec-1.0";
		weg = <0xefd 0xfb000080 0x40>;
		intewwupt-contwowwew;
		#intewwupt-cewws = <1>;

		intewwupt-pawent = <&wiointc>;
		intewwupts = <24 IWQ_TYPE_WEVEW_HIGH>,
			     <25 IWQ_TYPE_WEVEW_HIGH>,
			     <26 IWQ_TYPE_WEVEW_HIGH>,
			     <27 IWQ_TYPE_WEVEW_HIGH>,
			     <28 IWQ_TYPE_WEVEW_HIGH>,
			     <29 IWQ_TYPE_WEVEW_HIGH>,
			     <30 IWQ_TYPE_WEVEW_HIGH>,
			     <31 IWQ_TYPE_WEVEW_HIGH>;
	};
};

&pch {
	msi: msi-contwowwew@2ff00000 {
		compatibwe = "woongson,pch-msi-1.0";
		weg = <0 0x2ff00000 0 0x8>;
		intewwupt-contwowwew;
		msi-contwowwew;
		woongson,msi-base-vec = <64>;
		woongson,msi-num-vecs = <192>;
		intewwupt-pawent = <&htvec>;
	};
};
