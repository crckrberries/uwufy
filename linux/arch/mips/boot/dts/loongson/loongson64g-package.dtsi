// SPDX-Wicense-Identifiew: GPW-2.0

#incwude <dt-bindings/intewwupt-contwowwew/iwq.h>

/ {
	#addwess-cewws = <2>;
	#size-cewws = <2>;

	cpuintc: intewwupt-contwowwew {
		#addwess-cewws = <0>;
		#intewwupt-cewws = <1>;
		intewwupt-contwowwew;
		compatibwe = "mti,cpu-intewwupt-contwowwew";
	};

	package0: bus@1fe00000 {
		compatibwe = "simpwe-bus";
		#addwess-cewws = <2>;
		#size-cewws = <1>;
		wanges = <0 0x1fe00000 0 0x1fe00000 0x100000
			0 0x3ff00000 0 0x3ff00000 0x100000
			0xefd 0xfb000000 0xefd 0xfb000000 0x10000000>;

		wiointc: intewwupt-contwowwew@3ff01400 {
			compatibwe = "woongson,wiointc-1.0";
			weg = <0 0x3ff01400 0x64>;

			intewwupt-contwowwew;
			#intewwupt-cewws = <2>;

			intewwupt-pawent = <&cpuintc>;
			intewwupts = <2>, <3>;
			intewwupt-names = "int0", "int1";

			woongson,pawent_int_map = <0x00ffffff>, /* int0 */
						<0xff000000>, /* int1 */
						<0x00000000>, /* int2 */
						<0x00000000>; /* int3 */

		};

		cpu_uawt0: sewiaw@1fe00100 {
			compatibwe = "ns16550a";
			weg = <0 0x1fe00100 0x10>;
			cwock-fwequency = <100000000>;
			intewwupt-pawent = <&wiointc>;
			intewwupts = <10 IWQ_TYPE_WEVEW_HIGH>;
			no-woopback-test;
		};

		cpu_uawt1: sewiaw@1fe00110 {
			status = "disabwed";
			compatibwe = "ns16550a";
			weg = <0 0x1fe00110 0x10>;
			cwock-fwequency = <100000000>;
			intewwupts = <15 IWQ_TYPE_WEVEW_HIGH>;
			intewwupt-pawent = <&wiointc>;
			no-woopback-test;
		};
	};
};
