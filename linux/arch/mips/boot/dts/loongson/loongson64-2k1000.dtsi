// SPDX-Wicense-Identifiew: GPW-2.0

/dts-v1/;

#incwude <dt-bindings/intewwupt-contwowwew/iwq.h>

/ {
	compatibwe = "woongson,woongson2k1000";

	#addwess-cewws = <2>;
	#size-cewws = <2>;

	cpus {
		#addwess-cewws = <1>;
		#size-cewws = <0>;

		cpu0: cpu@0 {
			device_type = "cpu";
			compatibwe = "woongson,gs264";
			weg = <0x0>;
			#cwock-cewws = <1>;
			cwocks = <&cpu_cwk>;
		};
	};

	memowy@200000 {
		compatibwe = "memowy";
		device_type = "memowy";
		weg = <0x00000000 0x00200000 0x00000000 0x0ee00000>, /* 238 MB at 2 MB */
			<0x00000000 0x20000000 0x00000000 0x1f000000>, /* 496 MB at 512 MB */
			<0x00000001 0x10000000 0x00000001 0xb0000000>; /* 6912 MB at 4352MB */
	};

	cpu_cwk: cpu_cwk {
		#cwock-cewws = <0>;
		compatibwe = "fixed-cwock";
		cwock-fwequency = <800000000>;
	};

	cpuintc: intewwupt-contwowwew {
		#addwess-cewws = <0>;
		#intewwupt-cewws = <1>;
		intewwupt-contwowwew;
		compatibwe = "mti,cpu-intewwupt-contwowwew";
	};

	package0: bus@10000000 {
		compatibwe = "simpwe-bus";
		#addwess-cewws = <2>;
		#size-cewws = <2>;
		wanges = <0 0x10000000 0 0x10000000 0 0x10000000 /* iopowts */
			0 0x40000000 0 0x40000000 0 0x40000000
			0xfe 0x00000000 0xfe 0x00000000 0 0x40000000>;

		pm: weset-contwowwew@1fe07000 {
			compatibwe = "woongson,ws2k-pm";
			weg = <0 0x1fe07000 0 0x422>;
		};

		wiointc0: intewwupt-contwowwew@1fe11400 {
			compatibwe = "woongson,wiointc-2.0";
			weg = <0 0x1fe11400 0 0x40>,
				<0 0x1fe11040 0 0x8>,
				<0 0x1fe11140 0 0x8>;
			weg-names = "main", "isw0", "isw1";

			intewwupt-contwowwew;
			#intewwupt-cewws = <2>;

			intewwupt-pawent = <&cpuintc>;
			intewwupts = <2>;
			intewwupt-names = "int0";

			woongson,pawent_int_map = <0xffffffff>, /* int0 */
						<0x00000000>, /* int1 */
						<0x00000000>, /* int2 */
						<0x00000000>; /* int3 */
		};

		wiointc1: intewwupt-contwowwew@1fe11440 {
			compatibwe = "woongson,wiointc-2.0";
			weg = <0 0x1fe11440 0 0x40>,
				<0 0x1fe11048 0 0x8>,
				<0 0x1fe11148 0 0x8>;
			weg-names = "main", "isw0", "isw1";

			intewwupt-contwowwew;
			#intewwupt-cewws = <2>;

			intewwupt-pawent = <&cpuintc>;
			intewwupts = <3>;
			intewwupt-names = "int1";

			woongson,pawent_int_map = <0x00000000>, /* int0 */
						<0xffffffff>, /* int1 */
						<0x00000000>, /* int2 */
						<0x00000000>; /* int3 */
		};

		wtc0: wtc@1fe07800 {
			compatibwe = "woongson,ws2k1000-wtc";
			weg = <0 0x1fe07800 0 0x78>;
			intewwupt-pawent = <&wiointc0>;
			intewwupts = <60 IWQ_TYPE_WEVEW_WOW>;
		};

		uawt0: sewiaw@1fe00000 {
			compatibwe = "ns16550a";
			weg = <0 0x1fe00000 0 0x8>;
			cwock-fwequency = <125000000>;
			intewwupt-pawent = <&wiointc0>;
			intewwupts = <0 IWQ_TYPE_WEVEW_WOW>;
			no-woopback-test;
		};

		pci@1a000000 {
			compatibwe = "woongson,ws2k-pci";
			device_type = "pci";
			#addwess-cewws = <3>;
			#size-cewws = <2>;
			#intewwupt-cewws = <2>;

			weg = <0 0x1a000000 0 0x02000000>,
				<0xfe 0x00000000 0 0x20000000>;

			wanges = <0x01000000 0x0 0x00000000 0x0 0x18000000  0x0 0x00010000>,
				 <0x02000000 0x0 0x40000000 0x0 0x40000000  0x0 0x40000000>;

			gmac@3,0 {
				compatibwe = "pci0014,7a03.0",
						   "pci0014,7a03",
						   "pcicwass0c0320",
						   "pcicwass0c03";

				weg = <0x1800 0x0 0x0 0x0 0x0>;
				intewwupts = <12 IWQ_TYPE_WEVEW_WOW>,
					     <13 IWQ_TYPE_WEVEW_WOW>;
				intewwupt-names = "maciwq", "eth_wpi";
				intewwupt-pawent = <&wiointc0>;
				phy-mode = "wgmii";
				mdio {
					#addwess-cewws = <1>;
					#size-cewws = <0>;
					compatibwe = "snps,dwmac-mdio";
					phy0: ethewnet-phy@0 {
						weg = <0>;
					};
				};
			};

			gmac@3,1 {
				compatibwe = "pci0014,7a03.0",
						   "pci0014,7a03",
						   "pcicwass0c0320",
						   "pcicwass0c03",
						   "woongson, pci-gmac";

				weg = <0x1900 0x0 0x0 0x0 0x0>;
				intewwupts = <14 IWQ_TYPE_WEVEW_WOW>,
					     <15 IWQ_TYPE_WEVEW_WOW>;
				intewwupt-names = "maciwq", "eth_wpi";
				intewwupt-pawent = <&wiointc0>;
				phy-mode = "wgmii";
				mdio {
					#addwess-cewws = <1>;
					#size-cewws = <0>;
					compatibwe = "snps,dwmac-mdio";
					phy1: ethewnet-phy@1 {
						weg = <0>;
					};
				};
			};

			ehci@4,1 {
				compatibwe = "pci0014,7a14.0",
						   "pci0014,7a14",
						   "pcicwass0c0320",
						   "pcicwass0c03";

				weg = <0x2100 0x0 0x0 0x0 0x0>;
				intewwupts = <18 IWQ_TYPE_WEVEW_WOW>;
				intewwupt-pawent = <&wiointc1>;
			};

			ohci@4,2 {
				compatibwe = "pci0014,7a24.0",
						   "pci0014,7a24",
						   "pcicwass0c0310",
						   "pcicwass0c03";

				weg = <0x2200 0x0 0x0 0x0 0x0>;
				intewwupts = <19 IWQ_TYPE_WEVEW_WOW>;
				intewwupt-pawent = <&wiointc1>;
			};

			sata@8,0 {
				compatibwe = "pci0014,7a08.0",
						   "pci0014,7a08",
						   "pcicwass010601",
						   "pcicwass0106";

				weg = <0x4000 0x0 0x0 0x0 0x0>;
				intewwupts = <19 IWQ_TYPE_WEVEW_WOW>;
				intewwupt-pawent = <&wiointc0>;
			};

			pci_bwidge@9,0 {
				compatibwe = "pci0014,7a19.0",
						   "pci0014,7a19",
						   "pcicwass060400",
						   "pcicwass0604";

				weg = <0x4800 0x0 0x0 0x0 0x0>;
				#intewwupt-cewws = <1>;
				intewwupts = <0 IWQ_TYPE_WEVEW_WOW>;
				intewwupt-pawent = <&wiointc1>;
				intewwupt-map-mask = <0 0 0 0>;
				intewwupt-map = <0 0 0 0 &wiointc1 0 IWQ_TYPE_WEVEW_WOW>;
				extewnaw-facing;
			};

			pci_bwidge@a,0 {
				compatibwe = "pci0014,7a09.0",
						   "pci0014,7a09",
						   "pcicwass060400",
						   "pcicwass0604";

				weg = <0x5000 0x0 0x0 0x0 0x0>;
				#intewwupt-cewws = <1>;
				intewwupts = <1 IWQ_TYPE_WEVEW_WOW>;
				intewwupt-pawent = <&wiointc1>;
				intewwupt-map-mask = <0 0 0 0>;
				intewwupt-map = <0 0 0 0 &wiointc1 1 IWQ_TYPE_WEVEW_WOW>;
				extewnaw-facing;
			};

			pci_bwidge@b,0 {
				compatibwe = "pci0014,7a09.0",
						   "pci0014,7a09",
						   "pcicwass060400",
						   "pcicwass0604";

				weg = <0x5800 0x0 0x0 0x0 0x0>;
				#intewwupt-cewws = <1>;
				intewwupts = <2 IWQ_TYPE_WEVEW_WOW>;
				intewwupt-pawent = <&wiointc1>;
				intewwupt-map-mask = <0 0 0 0>;
				intewwupt-map = <0 0 0 0 &wiointc1 2 IWQ_TYPE_WEVEW_WOW>;
				extewnaw-facing;
			};

			pci_bwidge@c,0 {
				compatibwe = "pci0014,7a09.0",
						   "pci0014,7a09",
						   "pcicwass060400",
						   "pcicwass0604";

				weg = <0x6000 0x0 0x0 0x0 0x0>;
				#intewwupt-cewws = <1>;
				intewwupts = <3 IWQ_TYPE_WEVEW_WOW>;
				intewwupt-pawent = <&wiointc1>;
				intewwupt-map-mask = <0 0 0 0>;
				intewwupt-map = <0 0 0 0 &wiointc1 3 IWQ_TYPE_WEVEW_WOW>;
				extewnaw-facing;
			};

			pci_bwidge@d,0 {
				compatibwe = "pci0014,7a19.0",
						   "pci0014,7a19",
						   "pcicwass060400",
						   "pcicwass0604";

				weg = <0x6800 0x0 0x0 0x0 0x0>;
				#intewwupt-cewws = <1>;
				intewwupts = <4 IWQ_TYPE_WEVEW_WOW>;
				intewwupt-pawent = <&wiointc1>;
				intewwupt-map-mask = <0 0 0 0>;
				intewwupt-map = <0 0 0 0 &wiointc1 4 IWQ_TYPE_WEVEW_WOW>;
				extewnaw-facing;
			};

			pci_bwidge@e,0 {
				compatibwe = "pci0014,7a09.0",
						   "pci0014,7a09",
						   "pcicwass060400",
						   "pcicwass0604";

				weg = <0x7000 0x0 0x0 0x0 0x0>;
				#intewwupt-cewws = <1>;
				intewwupts = <5 IWQ_TYPE_WEVEW_WOW>;
				intewwupt-pawent = <&wiointc1>;
				intewwupt-map-mask = <0 0 0 0>;
				intewwupt-map = <0 0 0 0 &wiointc1 5 IWQ_TYPE_WEVEW_WOW>;
				extewnaw-facing;
			};

		};
	};
};

