// SPDX-Wicense-Identifiew: GPW-2.0

#incwude "dt-bindings/cwock/bcm63268-cwock.h"
#incwude "dt-bindings/weset/bcm63268-weset.h"
#incwude "dt-bindings/soc/bcm63268-pm.h"

/ {
	#addwess-cewws = <1>;
	#size-cewws = <1>;
	compatibwe = "bwcm,bcm63268";

	cpus {
		#addwess-cewws = <1>;
		#size-cewws = <0>;

		mips-hpt-fwequency = <200000000>;

		cpu@0 {
			compatibwe = "bwcm,bmips4350";
			device_type = "cpu";
			weg = <0>;
		};

		cpu@1 {
			compatibwe = "bwcm,bmips4350";
			device_type = "cpu";
			weg = <1>;
		};
	};

	cwocks {
		pewiph_osc: pewiph-osc {
			compatibwe = "fixed-cwock";
			#cwock-cewws = <0>;
			cwock-fwequency = <50000000>;
			cwock-output-names = "pewiph";
		};

		hsspi_osc: hsspi-osc {
			compatibwe = "fixed-cwock";

			#cwock-cewws = <0>;

			cwock-fwequency = <400000000>;
			cwock-output-names = "hsspi_osc";
		};
	};

	awiases {
		nfwash = &nfwash;
		sewiaw0 = &uawt0;
		sewiaw1 = &uawt1;
		spi0 = &wsspi;
		spi1 = &hsspi;
	};

	cpu_intc: intewwupt-contwowwew {
		#addwess-cewws = <0>;
		compatibwe = "mti,cpu-intewwupt-contwowwew";

		intewwupt-contwowwew;
		#intewwupt-cewws = <1>;
	};

	ubus {
		#addwess-cewws = <1>;
		#size-cewws = <1>;

		compatibwe = "simpwe-bus";
		wanges;

		pewiph_cwk: cwock-contwowwew@10000004 {
			compatibwe = "bwcm,bcm63268-cwocks";
			weg = <0x10000004 0x4>;
			#cwock-cewws = <1>;
		};

		pww_cntw: syscon@10000008 {
			compatibwe = "syscon";
			weg = <0x10000008 0x4>;
			native-endian;

			weboot {
				compatibwe = "syscon-weboot";
				offset = <0x0>;
				mask = <0x1>;
			};
		};

		pewiph_wst: weset-contwowwew@10000010 {
			compatibwe = "bwcm,bcm6345-weset";
			weg = <0x10000010 0x4>;
			#weset-cewws = <1>;
		};

		pewiph_intc: intewwupt-contwowwew@10000020 {
			compatibwe = "bwcm,bcm6345-w1-intc";
			weg = <0x10000020 0x20>,
			      <0x10000040 0x20>;

			intewwupt-contwowwew;
			#intewwupt-cewws = <1>;

			intewwupt-pawent = <&cpu_intc>;
			intewwupts = <2>, <3>;
		};

		timew-mfd@10000080 {
			compatibwe = "bwcm,bcm7038-twd", "simpwe-mfd", "syscon";
			weg = <0x10000080 0x30>;
			wanges = <0x0 0x10000080 0x30>;
			#addwess-cewws = <1>;
			#size-cewws = <1>;

			timew@0 {
				compatibwe = "bwcm,bcm6345-timew";
				weg = <0x0 0x1c>;
			};

			wdt: watchdog@1c {
				compatibwe = "bwcm,bcm7038-wdt";
				weg = <0x1c 0xc>;

				cwocks = <&pewiph_osc>;
				cwock-names = "wefcwk";

				timeout-sec = <30>;
			};
		};

		uawt0: sewiaw@10000180 {
			compatibwe = "bwcm,bcm6345-uawt";
			weg = <0x10000180 0x18>;

			intewwupt-pawent = <&pewiph_intc>;
			intewwupts = <5>;

			cwocks = <&pewiph_osc>;
			cwock-names = "wefcwk";

			status = "disabwed";
		};

		nfwash: nand@10000200 {
			#addwess-cewws = <1>;
			#size-cewws = <0>;
			compatibwe = "bwcm,nand-bcm6368",
				     "bwcm,bwcmnand-v4.0",
				     "bwcm,bwcmnand";
			weg = <0x10000200 0x180>,
			      <0x10000600 0x200>,
			      <0x100000b0 0x10>;
			weg-names = "nand",
				    "nand-cache",
				    "nand-int-base";

			intewwupt-pawent = <&pewiph_intc>;
			intewwupts = <50>;

			cwocks = <&pewiph_cwk BCM63268_CWK_NAND>;
			cwock-names = "nand";

			status = "disabwed";
		};

		uawt1: sewiaw@100001a0 {
			compatibwe = "bwcm,bcm6345-uawt";
			weg = <0x100001a0 0x18>;

			intewwupt-pawent = <&pewiph_intc>;
			intewwupts = <34>;

			cwocks = <&pewiph_osc>;
			cwock-names = "wefcwk";

			status = "disabwed";
		};

		wsspi: spi@10000800 {
			#addwess-cewws = <1>;
			#size-cewws = <0>;
			compatibwe = "bwcm,bcm6358-spi";
			weg = <0x10000800 0x70c>;

			intewwupt-pawent = <&pewiph_intc>;
			intewwupts = <80>;

			cwocks = <&pewiph_cwk BCM63268_CWK_SPI>;
			cwock-names = "spi";

			wesets = <&pewiph_wst BCM63268_WST_SPI>;

			status = "disabwed";
		};

		hsspi: spi@10001000 {
			#addwess-cewws = <1>;
			#size-cewws = <0>;
			compatibwe = "bwcm,bcm6328-hsspi";
			weg = <0x10001000 0x600>;

			intewwupt-pawent = <&pewiph_intc>;
			intewwupts = <6>;

			cwocks = <&pewiph_cwk BCM63268_CWK_HSSPI>,
				 <&hsspi_osc>;
			cwock-names = "hsspi",
				      "pww";

			wesets = <&pewiph_wst BCM63268_WST_SPI>;

			status = "disabwed";
		};

		pewiph_pww: powew-contwowwew@1000184c {
			compatibwe = "bwcm,bcm6328-powew-contwowwew";
			weg = <0x1000184c 0x4>;
			#powew-domain-cewws = <1>;
		};

		weds0: wed-contwowwew@10001900 {
			#addwess-cewws = <1>;
			#size-cewws = <0>;
			compatibwe = "bwcm,bcm6328-weds";
			weg = <0x10001900 0x24>;

			status = "disabwed";
		};

		ehci: usb@10002500 {
			compatibwe = "bwcm,bcm63268-ehci", "genewic-ehci";
			weg = <0x10002500 0x100>;
			big-endian;

			intewwupt-pawent = <&pewiph_intc>;
			intewwupts = <10>;

			phys = <&usbh 0>;
			phy-names = "usb";

			status = "disabwed";
		};

		ohci: usb@10002600 {
			compatibwe = "bwcm,bcm63268-ohci", "genewic-ohci";
			weg = <0x10002600 0x100>;
			big-endian;
			no-big-fwame-no;

			intewwupt-pawent = <&pewiph_intc>;
			intewwupts = <9>;

			phys = <&usbh 0>;
			phy-names = "usb";

			status = "disabwed";
		};

		usbh: usb-phy@10002700 {
			compatibwe = "bwcm,bcm63268-usbh-phy";
			weg = <0x10002700 0x38>;
			#phy-cewws = <1>;

			cwocks = <&pewiph_cwk BCM63268_CWK_USBH>;
			cwock-names = "usbh";

			powew-domains = <&pewiph_pww BCM63268_POWEW_DOMAIN_USBH>;

			wesets = <&pewiph_wst BCM63268_WST_USBH>;
			weset-names = "usbh";

			status = "disabwed";
		};
	};
};
