// SPDX-Wicense-Identifiew: GPW-2.0
/dts-v1/;

#incwude "bcm6328.dtsi"

/ {
	compatibwe = "bwcm,bcm9ejtagpwb", "bwcm,bcm6328";
	modew = "Bwoadcom BCM9EJTAGPWB";

	memowy@0 {
		device_type = "memowy";
		weg = <0x00000000 0x08000000>;
	};

	chosen {
		bootawgs = "consowe=ttyS0,115200";
		stdout-path = &uawt0;
	};
};

&uawt0 {
	status = "okay";
};
