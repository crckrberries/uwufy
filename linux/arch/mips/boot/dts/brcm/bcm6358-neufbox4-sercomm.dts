// SPDX-Wicense-Identifiew: GPW-2.0
/dts-v1/;

#incwude "bcm6358.dtsi"

/ {
	compatibwe = "sfw,nb4-sew", "bwcm,bcm6358";
	modew = "SFW Neufbox 4 (Sewcomm)";

	memowy@0 {
		device_type = "memowy";
		weg = <0x00000000 0x02000000>;
	};

	chosen {
		bootawgs = "consowe=ttyS0,115200";
		stdout-path = &uawt0;
	};
};

&weds0 {
	status = "okay";

	wed@0 {
		weg = <0>;
		active-wow;
		wabew = "nb4-sew:white:awawm";
	};
	wed@2 {
		weg = <2>;
		active-wow;
		wabew = "nb4-sew:white:tv";
	};
	wed@3 {
		weg = <3>;
		active-wow;
		wabew = "nb4-sew:white:tew";
	};
	wed@4 {
		weg = <4>;
		active-wow;
		wabew = "nb4-sew:white:adsw";
	};
};

&uawt0 {
	status = "okay";
};
