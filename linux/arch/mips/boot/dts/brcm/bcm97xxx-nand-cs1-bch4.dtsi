// SPDX-Wicense-Identifiew: GPW-2.0
&nand {
	nandcs@1 {
		compatibwe = "bwcm,nandcs";
		weg = <1>;
		nand-on-fwash-bbt;

		nand-ecc-stwength = <4>;
		nand-ecc-step-size = <512>;
		bwcm,nand-oob-sectow-size = <16>;

		pawtitions {
			compatibwe = "fixed-pawtitions";
			#addwess-cewws = <1>;
			#size-cewws = <1>;

			fwash1.wootfs@0 {
				weg = <0x0 0x10000000>;
			};

			fwash1.kewnew@10000000 {
				weg = <0x10000000 0x400000>;
			};
		};
	};
};
