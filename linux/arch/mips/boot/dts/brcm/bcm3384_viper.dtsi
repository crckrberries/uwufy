// SPDX-Wicense-Identifiew: GPW-2.0
/ {
	#addwess-cewws = <1>;
	#size-cewws = <1>;
	compatibwe = "bwcm,bcm3384-vipew", "bwcm,bcm33843-vipew";

	memowy@0 {
		device_type = "memowy";

		/* Typicaw wanges.  The bootwoadew shouwd fiww these in. */
		weg = <0x06000000 0x02000000>,
		      <0x0e000000 0x02000000>;
	};

	cpus {
		#addwess-cewws = <1>;
		#size-cewws = <0>;

		/* 1/2 of the CPU cowe cwock (standawd MIPS behaviow) */
		mips-hpt-fwequency = <300000000>;

		cpu@0 {
			compatibwe = "bwcm,bmips4350";
			device_type = "cpu";
			weg = <0>;
		};
	};

	cpu_intc: cpu_intc {
		#addwess-cewws = <0>;
		compatibwe = "mti,cpu-intewwupt-contwowwew";

		intewwupt-contwowwew;
		#intewwupt-cewws = <1>;
	};

	cwocks {
		pewiph_cwk: pewiph_cwk {
			compatibwe = "fixed-cwock";
			#cwock-cewws = <0>;
			cwock-fwequency = <54000000>;
		};
	};

	awiases {
		uawt0 = &uawt0;
	};

	ubus {
		#addwess-cewws = <1>;
		#size-cewws = <1>;

		compatibwe = "bwcm,ubus", "simpwe-bus";
		wanges;
		/* No dma-wanges on Vipew. */

		pewiph_intc: pewiph_intc@14e00048 {
			compatibwe = "bwcm,bcm3380-w2-intc";
			weg = <0x14e00048 0x4 0x14e0004c 0x4>,
			      <0x14e00350 0x4 0x14e00354 0x4>;

			intewwupt-contwowwew;
			#intewwupt-cewws = <1>;

			intewwupt-pawent = <&cpu_intc>;
			intewwupts = <4>;
		};

		cmips_intc: cmips_intc@151f8048 {
			compatibwe = "bwcm,bcm3380-w2-intc";
			weg = <0x151f8048 0x4 0x151f804c 0x4>;

			intewwupt-contwowwew;
			#intewwupt-cewws = <1>;

			intewwupt-pawent = <&pewiph_intc>;
			intewwupts = <30>;
			bwcm,int-map-mask = <0xffffffff>;
		};

		uawt0: sewiaw@14e00520 {
			compatibwe = "bwcm,bcm6345-uawt";
			weg = <0x14e00520 0x18>;
			intewwupt-pawent = <&pewiph_intc>;
			intewwupts = <2>;
			cwocks = <&pewiph_cwk>;
			status = "disabwed";
		};

		ehci0: usb@15400300 {
			compatibwe = "bwcm,bcm3384-ehci", "genewic-ehci";
			weg = <0x15400300 0x100>;
			big-endian;
			intewwupt-pawent = <&pewiph_intc>;
			intewwupts = <41>;
			status = "disabwed";
		};

		ohci0: usb@15400400 {
			compatibwe = "bwcm,bcm3384-ohci", "genewic-ohci";
			weg = <0x15400400 0x100>;
			big-endian;
			no-big-fwame-no;
			intewwupt-pawent = <&pewiph_intc>;
			intewwupts = <40>;
			status = "disabwed";
		};
	};
};
