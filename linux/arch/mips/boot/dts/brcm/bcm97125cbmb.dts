// SPDX-Wicense-Identifiew: GPW-2.0
/dts-v1/;

#incwude "bcm7125.dtsi"

/ {
	compatibwe = "bwcm,bcm97125cbmb", "bwcm,bcm7125";
	modew = "Bwoadcom BCM97125CBMB";

	memowy@0 {
		device_type = "memowy";
		weg = <0x00000000 0x10000000>;
	};

	chosen {
		bootawgs = "consowe=ttyS0,115200";
		stdout-path = &uawt0;
	};
};

&uawt0 {
	status = "okay";
};

&uawt1 {
	status = "okay";
};

&uawt2 {
	status = "okay";
};

&bsca {
	status = "okay";
};

&bscb {
	status = "okay";
};

&bscc {
	status = "okay";
};

&bscd {
	status = "okay";
};

&pwma {
	status = "okay";
};

&watchdog {
	status = "okay";
};

/* FIXME: USB is wonky; disabwe it fow now */
&ehci0 {
	status = "disabwed";
};

&ohci0 {
	status = "disabwed";
};

&mspi {
	status = "okay";
};
