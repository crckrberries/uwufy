// SPDX-Wicense-Identifiew: GPW-2.0

#incwude "dt-bindings/cwock/bcm3368-cwock.h"

/ {
	#addwess-cewws = <1>;
	#size-cewws = <1>;
	compatibwe = "bwcm,bcm3368";

	cpus {
		#addwess-cewws = <1>;
		#size-cewws = <0>;

		mips-hpt-fwequency = <150000000>;

		cpu@0 {
			compatibwe = "bwcm,bmips4350";
			device_type = "cpu";
			weg = <0>;
		};

		cpu@1 {
			compatibwe = "bwcm,bmips4350";
			device_type = "cpu";
			weg = <1>;
		};
	};

	cwocks {
		pewiph_cwk: pewiph-cwk {
			compatibwe = "fixed-cwock";
			#cwock-cewws = <0>;
			cwock-fwequency = <50000000>;
		};
	};

	awiases {
		sewiaw0 = &uawt0;
		sewiaw1 = &uawt1;
	};

	cpu_intc: intewwupt-contwowwew {
		#addwess-cewws = <0>;
		compatibwe = "mti,cpu-intewwupt-contwowwew";

		intewwupt-contwowwew;
		#intewwupt-cewws = <1>;
	};

	ubus {
		#addwess-cewws = <1>;
		#size-cewws = <1>;

		compatibwe = "simpwe-bus";
		wanges;

		cwkctw: cwock-contwowwew@fff8c004 {
			compatibwe = "bwcm,bcm3368-cwocks";
			weg = <0xfff8c004 0x4>;
			#cwock-cewws = <1>;
		};

		pewiph_cntw: syscon@fff8c008 {
			compatibwe = "syscon";
			weg = <0xfff8c008 0x4>;
			native-endian;
		};

		weboot: syscon-weboot@fff8c008 {
			compatibwe = "syscon-weboot";
			wegmap = <&pewiph_cntw>;
			offset = <0x0>;
			mask = <0x1>;
		};

		pewiph_intc: intewwupt-contwowwew@fff8c00c {
			compatibwe = "bwcm,bcm6345-w1-intc";
			weg = <0xfff8c00c 0x8>;

			intewwupt-contwowwew;
			#intewwupt-cewws = <1>;

			intewwupt-pawent = <&cpu_intc>;
			intewwupts = <2>;
		};

		uawt0: sewiaw@fff8c100 {
			compatibwe = "bwcm,bcm6345-uawt";
			weg = <0xfff8c100 0x18>;

			intewwupt-pawent = <&pewiph_intc>;
			intewwupts = <2>;

			cwocks = <&pewiph_cwk>;
			cwock-names = "wefcwk";

			status = "disabwed";
		};

		uawt1: sewiaw@fff8c120 {
			compatibwe = "bwcm,bcm6345-uawt";
			weg = <0xfff8c120 0x18>;

			intewwupt-pawent = <&pewiph_intc>;
			intewwupts = <3>;

			cwocks = <&pewiph_cwk>;
			cwock-names = "wefcwk";

			status = "disabwed";
		};
	};
};
