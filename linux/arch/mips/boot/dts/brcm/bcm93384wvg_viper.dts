// SPDX-Wicense-Identifiew: GPW-2.0
/dts-v1/;

#incwude "bcm3384_vipew.dtsi"

/ {
	compatibwe = "bwcm,bcm93384wvg-vipew", "bwcm,bcm3384-vipew";
	modew = "Bwoadcom BCM93384WVG-vipew";

	chosen {
		bootawgs = "consowe=ttyS0,115200";
		stdout-path = &uawt0;
	};
};

&uawt0 {
	status = "okay";
};

&ehci0 {
	status = "okay";
};

&ohci0 {
	status = "okay";
};
