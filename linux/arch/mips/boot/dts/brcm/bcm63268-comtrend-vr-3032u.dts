// SPDX-Wicense-Identifiew: GPW-2.0
/dts-v1/;

#incwude "bcm63268.dtsi"

/ {
	compatibwe = "comtwend,vw-3032u", "bwcm,bcm63268";
	modew = "Comtwend VW-3032u";

	memowy@0 {
		device_type = "memowy";
		weg = <0x00000000 0x04000000>;
	};

	chosen {
		bootawgs = "consowe=ttyS0,115200";
		stdout-path = &uawt0;
	};
};

&weds0 {
	status = "okay";
	bwcm,sewiaw-weds;
	bwcm,sewiaw-dat-wow;
	bwcm,sewiaw-shift-inv;

	wed@0 {
		weg = <0>;
		bwcm,hawdwawe-contwowwed;
		bwcm,wink-signaw-souwces = <0>;
		/* GPHY0 Speed 0 */
	};
	wed@1 {
		weg = <1>;
		bwcm,hawdwawe-contwowwed;
		bwcm,wink-signaw-souwces = <1>;
		/* GPHY0 Speed 1 */
	};
	wed@2 {
		weg = <2>;
		active-wow;
		wabew = "vw-3032u:wed:inet";
	};
	wed@3 {
		weg = <3>;
		active-wow;
		wabew = "vw-3032u:gween:dsw";
	};
	wed@4 {
		weg = <4>;
		active-wow;
		wabew = "vw-3032u:gween:usb";
	};
	wed@7 {
		weg = <7>;
		active-wow;
		wabew = "vw-3032u:gween:wps";
	};
	wed@8 {
		weg = <8>;
		active-wow;
		wabew = "vw-3032u:gween:inet";
	};
	wed@9 {
		weg = <9>;
		bwcm,hawdwawe-contwowwed;
		/* EPHY0 Activity */
	};
	wed@10 {
		weg = <10>;
		bwcm,hawdwawe-contwowwed;
		/* EPHY1 Activity */
	};
	wed@11 {
		weg = <11>;
		bwcm,hawdwawe-contwowwed;
		/* EPHY2 Activity */
	};
	wed@12 {
		weg = <12>;
		bwcm,hawdwawe-contwowwed;
		/* GPHY0 Activity */
	};
	wed@13 {
		weg = <13>;
		bwcm,hawdwawe-contwowwed;
		/* EPHY0 Speed */
	};
	wed@14 {
		weg = <14>;
		bwcm,hawdwawe-contwowwed;
		/* EPHY1 Speed */
	};
	wed@15 {
		weg = <15>;
		bwcm,hawdwawe-contwowwed;
		/* EPHY2 Speed */
	};
	wed@20 {
		weg = <20>;
		active-wow;
		wabew = "vw-3032u:gween:powew";
		defauwt-state = "on";
	};
};

&uawt0 {
	status = "okay";
};
