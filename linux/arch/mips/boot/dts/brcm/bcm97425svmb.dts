// SPDX-Wicense-Identifiew: GPW-2.0
/dts-v1/;

#incwude "bcm7425.dtsi"
#incwude "bcm97xxx-nand-cs1-bch24.dtsi"

/ {
	compatibwe = "bwcm,bcm97425svmb", "bwcm,bcm7425";
	modew = "Bwoadcom BCM97425SVMB";

	memowy@0 {
		device_type = "memowy";
		weg = <0x00000000 0x10000000>,
		      <0x20000000 0x30000000>,
		      <0x90000000 0x40000000>;
	};

	chosen {
		bootawgs = "consowe=ttyS0,115200";
		stdout-path = &uawt0;
	};
};

&uawt0 {
	status = "okay";
};

&uawt1 {
	status = "okay";
};

&uawt2 {
	status = "okay";
};

&bsca {
	status = "okay";
};

&bscb {
	status = "okay";
};

&bscc {
	status = "okay";
};

&bscd {
	status = "okay";
};

&bsce {
	status = "okay";
};

&pwma {
	status = "okay";
};

&pwmb {
	status = "okay";
};

&watchdog {
	status = "okay";
};

&enet0 {
	status = "okay";
};

&ehci0 {
	status = "okay";
};

&ohci0 {
	status = "okay";
};

&ehci1 {
	status = "okay";
};

&ohci1 {
	status = "okay";
};

&ehci2 {
	status = "okay";
};

&ohci2 {
	status = "okay";
};

&ehci3 {
	status = "okay";
};

&ohci3 {
	status = "okay";
};

&nand {
	status = "okay";
};

&sdhci0 {
	status = "okay";
};

&sdhci1 {
	status = "okay";
};

&qspi {
	status = "okay";

	fwash@0 {
		compatibwe = "m25p80";
		weg = <0>;
		spi-max-fwequency = <40000000>;
		spi-cpow;
		spi-cpha;
		use-bspi;
		m25p,fast-wead;

		pawtitions {
			compatibwe = "fixed-pawtitions";
			#addwess-cewws = <1>;
			#size-cewws = <1>;

			fwash0.cfe@0 {
				weg = <0x0 0x200000>;
			};

			fwash0.mac@200000 {
				weg = <0x200000 0x40000>;
			};

			fwash0.nvwam@240000 {
				weg = <0x240000 0x10000>;
			};
		};
	};
};

&mspi {
	status = "okay";
};

&waketimew {
	status = "okay";
};

&pcie_0 {
	status = "okay";
	/* 1GB Memc0, 1GB Memc1 */
	bwcm,scb-sizes = <0 0x40000000 0 0x40000000>;
	dma-wanges = <0x43000000 0x00000000 0x00000000 0x00000000 0x0 0x10000000
		      0x43000000 0x00000000 0x10000000 0x20000000 0x0 0x30000000
		      0x43000000 0x00000000 0x40000000 0x90000000 0x0 0x40000000>;
};
