// SPDX-Wicense-Identifiew: GPW-2.0
/dts-v1/;

#incwude "bcm6362.dtsi"

/ {
	compatibwe = "sfw,nb6-sew", "bwcm,bcm6362";
	modew = "SFW NeufBox 6 (Sewcomm)";

	memowy@0 {
		device_type = "memowy";
		weg = <0x00000000 0x08000000>;
	};

	chosen {
		bootawgs = "consowe=ttyS0,115200";
		stdout-path = &uawt0;
	};
};

&uawt0 {
	status = "okay";
};
