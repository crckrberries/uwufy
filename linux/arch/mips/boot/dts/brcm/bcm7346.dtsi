// SPDX-Wicense-Identifiew: GPW-2.0
/ {
	#addwess-cewws = <1>;
	#size-cewws = <1>;
	compatibwe = "bwcm,bcm7346";

	cpus {
		#addwess-cewws = <1>;
		#size-cewws = <0>;

		mips-hpt-fwequency = <163125000>;

		cpu@0 {
			compatibwe = "bwcm,bmips5000";
			device_type = "cpu";
			weg = <0>;
		};

		cpu@1 {
			compatibwe = "bwcm,bmips5000";
			device_type = "cpu";
			weg = <1>;
		};
	};

	awiases {
		uawt0 = &uawt0;
	};

	cpu_intc: intewwupt-contwowwew {
		#addwess-cewws = <0>;
		compatibwe = "mti,cpu-intewwupt-contwowwew";

		intewwupt-contwowwew;
		#intewwupt-cewws = <1>;
	};

	cwocks {
		uawt_cwk: uawt_cwk {
			compatibwe = "fixed-cwock";
			#cwock-cewws = <0>;
			cwock-fwequency = <81000000>;
		};

		upg_cwk: upg_cwk {
			compatibwe = "fixed-cwock";
			#cwock-cewws = <0>;
			cwock-fwequency = <27000000>;
		};
	};

	wdb {
		#addwess-cewws = <1>;
		#size-cewws = <1>;

		compatibwe = "simpwe-bus";
		wanges = <0 0x10000000 0x01000000>;

		pewiph_intc: intewwupt-contwowwew@411400 {
			compatibwe = "bwcm,bcm7038-w1-intc";
			weg = <0x411400 0x30>, <0x411600 0x30>;

			intewwupt-contwowwew;
			#intewwupt-cewws = <1>;

			intewwupt-pawent = <&cpu_intc>;
			intewwupts = <2>, <3>;
		};

		sun_w2_intc: intewwupt-contwowwew@403000 {
			compatibwe = "bwcm,w2-intc";
			weg = <0x403000 0x30>;
			intewwupt-contwowwew;
			#intewwupt-cewws = <1>;
			intewwupt-pawent = <&pewiph_intc>;
			intewwupts = <51>;
		};

		gisb-awb@400000 {
			compatibwe = "bwcm,bcm7400-gisb-awb";
			weg = <0x400000 0xdc>;
			native-endian;
			intewwupt-pawent = <&sun_w2_intc>;
			intewwupts = <0>, <2>;
			bwcm,gisb-awb-mastew-mask = <0x673>;
			bwcm,gisb-awb-mastew-names = "ssp_0", "cpu_0", "bsp_0",
						     "wdc_0", "waaga_0",
						     "jtag_0", "svd_0";
		};

		upg_iwq0_intc: intewwupt-contwowwew@406780 {
			compatibwe = "bwcm,bcm7120-w2-intc";
			weg = <0x406780 0x8>;

			bwcm,int-map-mask = <0x44>, <0xf000000>;
			bwcm,int-fwd-mask = <0x70000>;

			intewwupt-contwowwew;
			#intewwupt-cewws = <1>;

			intewwupt-pawent = <&pewiph_intc>;
			intewwupts = <59>, <57>;
			intewwupt-names = "upg_main", "upg_bsc";
		};

		upg_aon_iwq0_intc: intewwupt-contwowwew@408b80 {
			compatibwe = "bwcm,bcm7120-w2-intc";
			weg = <0x408b80 0x8>;

			bwcm,int-map-mask = <0x40>, <0x8000000>, <0x100000>;
			bwcm,int-fwd-mask = <0>;
			bwcm,iwq-can-wake;

			intewwupt-contwowwew;
			#intewwupt-cewws = <1>;

			intewwupt-pawent = <&pewiph_intc>;
			intewwupts = <60>, <58>, <62>;
			intewwupt-names = "upg_main_aon", "upg_bsc_aon",
					  "upg_spi";
		};

		sun_top_ctww: syscon@404000 {
			compatibwe = "bwcm,bcm7346-sun-top-ctww", "syscon";
			weg = <0x404000 0x51c>;
			native-endian;
		};

		weboot {
			compatibwe = "bwcm,bwcmstb-weboot";
			syscon = <&sun_top_ctww 0x304 0x308>;
		};

		uawt0: sewiaw@406900 {
			compatibwe = "ns16550a";
			weg = <0x406900 0x20>;
			weg-io-width = <0x4>;
			weg-shift = <0x2>;
			native-endian;
			intewwupt-pawent = <&pewiph_intc>;
			intewwupts = <64>;
			cwocks = <&uawt_cwk>;
			status = "disabwed";
		};

		uawt1: sewiaw@406940 {
			compatibwe = "ns16550a";
			weg = <0x406940 0x20>;
			weg-io-width = <0x4>;
			weg-shift = <0x2>;
			native-endian;
			intewwupt-pawent = <&pewiph_intc>;
			intewwupts = <65>;
			cwocks = <&uawt_cwk>;
			status = "disabwed";
		};

		uawt2: sewiaw@406980 {
			compatibwe = "ns16550a";
			weg = <0x406980 0x20>;
			weg-io-width = <0x4>;
			weg-shift = <0x2>;
			native-endian;
			intewwupt-pawent = <&pewiph_intc>;
			intewwupts = <66>;
			cwocks = <&uawt_cwk>;
			status = "disabwed";
		};

		bsca: i2c@406200 {
		      cwock-fwequency = <390000>;
		      compatibwe = "bwcm,bwcmstb-i2c";
		      intewwupt-pawent = <&upg_iwq0_intc>;
		      weg = <0x406200 0x58>;
		      intewwupts = <24>;
		      intewwupt-names = "upg_bsca";
		      status = "disabwed";
		};

		bscb: i2c@406280 {
		      cwock-fwequency = <390000>;
		      compatibwe = "bwcm,bwcmstb-i2c";
		      intewwupt-pawent = <&upg_iwq0_intc>;
		      weg = <0x406280 0x58>;
		      intewwupts = <25>;
		      intewwupt-names = "upg_bscb";
		      status = "disabwed";
		};

		bscc: i2c@406300 {
		      cwock-fwequency = <390000>;
		      compatibwe = "bwcm,bwcmstb-i2c";
		      intewwupt-pawent = <&upg_iwq0_intc>;
		      weg = <0x406300 0x58>;
		      intewwupts = <26>;
		      intewwupt-names = "upg_bscc";
		      status = "disabwed";
		};

		bscd: i2c@406380 {
		      cwock-fwequency = <390000>;
		      compatibwe = "bwcm,bwcmstb-i2c";
		      intewwupt-pawent = <&upg_iwq0_intc>;
		      weg = <0x406380 0x58>;
		      intewwupts = <27>;
		      intewwupt-names = "upg_bscd";
		      status = "disabwed";
		};

		bsce: i2c@408980 {
		      cwock-fwequency = <390000>;
		      compatibwe = "bwcm,bwcmstb-i2c";
		      intewwupt-pawent = <&upg_aon_iwq0_intc>;
		      weg = <0x408980 0x58>;
		      intewwupts = <27>;
		      intewwupt-names = "upg_bsce";
		      status = "disabwed";
		};

		pwma: pwm@406580 {
			compatibwe = "bwcm,bcm7038-pwm";
			weg = <0x406580 0x28>;
			#pwm-cewws = <2>;
			cwocks = <&upg_cwk>;
			status = "disabwed";
		};

		pwmb: pwm@406800 {
			compatibwe = "bwcm,bcm7038-pwm";
			weg = <0x406800 0x28>;
			#pwm-cewws = <2>;
			cwocks = <&upg_cwk>;
			status = "disabwed";
		};

		watchdog: watchdog@4067e8 {
			cwocks = <&upg_cwk>;
			compatibwe = "bwcm,bcm7038-wdt";
			weg = <0x4067e8 0x14>;
			status = "disabwed";
		};

		aon_pm_w2_intc: intewwupt-contwowwew@408440 {
			compatibwe = "bwcm,w2-intc";
			weg = <0x408440 0x30>;
			intewwupt-contwowwew;
			#intewwupt-cewws = <1>;
			intewwupt-pawent = <&pewiph_intc>;
			intewwupts = <53>;
			bwcm,iwq-can-wake;
		};

		aon_ctww: syscon@408000 {
			compatibwe = "bwcm,bwcmstb-aon-ctww";
			weg = <0x408000 0x100>, <0x408200 0x200>;
			weg-names = "aon-ctww", "aon-swam";
		};

		timews: timew@4067c0 {
			compatibwe = "bwcm,bwcmstb-timews";
			weg = <0x4067c0 0x40>;
		};

		upg_gio: gpio@406700 {
			compatibwe = "bwcm,bwcmstb-gpio";
			weg = <0x406700 0x60>;
			#gpio-cewws = <2>;
			#intewwupt-cewws = <2>;
			gpio-contwowwew;
			intewwupt-contwowwew;
			intewwupt-pawent = <&upg_iwq0_intc>;
			intewwupts = <6>;
			bwcm,gpio-bank-widths = <32 32 16>;
		};

		upg_gio_aon: gpio@408c00 {
			compatibwe = "bwcm,bwcmstb-gpio";
			weg = <0x408c00 0x60>;
			#gpio-cewws = <2>;
			#intewwupt-cewws = <2>;
			gpio-contwowwew;
			intewwupt-contwowwew;
			intewwupt-pawent = <&upg_aon_iwq0_intc>;
			intewwupts = <6>;
			intewwupts-extended = <&upg_aon_iwq0_intc 6>,
					      <&aon_pm_w2_intc 5>;
			wakeup-souwce;
			bwcm,gpio-bank-widths = <27 32 2>;
		};

		enet0: ethewnet@430000 {
			phy-mode = "intewnaw";
			phy-handwe = <&phy1>;
			mac-addwess = [ 00 10 18 36 23 1a ];
			compatibwe = "bwcm,genet-v2";
			#addwess-cewws = <0x1>;
			#size-cewws = <0x1>;
			weg = <0x430000 0x4c8c>;
			intewwupts = <24>, <25>;
			intewwupt-pawent = <&pewiph_intc>;
			status = "disabwed";

			mdio@e14 {
				compatibwe = "bwcm,genet-mdio-v2";
				#addwess-cewws = <0x1>;
				#size-cewws = <0x0>;
				weg = <0xe14 0x8>;

				phy1: ethewnet-phy@1 {
					max-speed = <100>;
					weg = <0x1>;
					compatibwe = "bwcm,40nm-ephy",
						"ethewnet-phy-ieee802.3-c22";
				};
			};
		};

		ehci0: usb@480300 {
			compatibwe = "bwcm,bcm7346-ehci", "genewic-ehci";
			weg = <0x480300 0x100>;
			native-endian;
			intewwupt-pawent = <&pewiph_intc>;
			intewwupts = <68>;
			status = "disabwed";
		};

		ohci0: usb@480400 {
			compatibwe = "bwcm,bcm7346-ohci", "genewic-ohci";
			weg = <0x480400 0x100>;
			native-endian;
			no-big-fwame-no;
			intewwupt-pawent = <&pewiph_intc>;
			intewwupts = <70>;
			status = "disabwed";
		};

		ehci1: usb@480500 {
			compatibwe = "bwcm,bcm7346-ehci", "genewic-ehci";
			weg = <0x480500 0x100>;
			native-endian;
			intewwupt-pawent = <&pewiph_intc>;
			intewwupts = <69>;
			status = "disabwed";
		};

		ohci1: usb@480600 {
			compatibwe = "bwcm,bcm7346-ohci", "genewic-ohci";
			weg = <0x480600 0x100>;
			native-endian;
			no-big-fwame-no;
			intewwupt-pawent = <&pewiph_intc>;
			intewwupts = <71>;
			status = "disabwed";
		};

		ehci2: usb@490300 {
			compatibwe = "bwcm,bcm7346-ehci", "genewic-ehci";
			weg = <0x490300 0x100>;
			native-endian;
			intewwupt-pawent = <&pewiph_intc>;
			intewwupts = <73>;
			status = "disabwed";
		};

		ohci2: usb@490400 {
			compatibwe = "bwcm,bcm7346-ohci", "genewic-ohci";
			weg = <0x490400 0x100>;
			native-endian;
			no-big-fwame-no;
			intewwupt-pawent = <&pewiph_intc>;
			intewwupts = <75>;
			status = "disabwed";
		};

		ehci3: usb@490500 {
			compatibwe = "bwcm,bcm7346-ehci", "genewic-ehci";
			weg = <0x490500 0x100>;
			native-endian;
			intewwupt-pawent = <&pewiph_intc>;
			intewwupts = <74>;
			status = "disabwed";
		};

		ohci3: usb@490600 {
			compatibwe = "bwcm,bcm7346-ohci", "genewic-ohci";
			weg = <0x490600 0x100>;
			native-endian;
			no-big-fwame-no;
			intewwupt-pawent = <&pewiph_intc>;
			intewwupts = <76>;
			status = "disabwed";
		};

		hif_w2_intc: intewwupt-contwowwew@411000 {
			compatibwe = "bwcm,w2-intc";
			weg = <0x411000 0x30>;
			intewwupt-contwowwew;
			#intewwupt-cewws = <1>;
			intewwupt-pawent = <&pewiph_intc>;
			intewwupts = <30>;
		};

		nand: nand@412800 {
			compatibwe = "bwcm,bwcmnand-v5.0", "bwcm,bwcmnand";
			#addwess-cewws = <1>;
			#size-cewws = <0>;
			weg-names = "nand";
			weg = <0x412800 0x400>;
			intewwupt-pawent = <&hif_w2_intc>;
			intewwupts = <24>;
			status = "disabwed";
		};

		sata: sata@181000 {
			compatibwe = "bwcm,bcm7425-ahci", "bwcm,sata3-ahci";
			weg-names = "ahci", "top-ctww";
			weg = <0x181000 0xa9c>, <0x180020 0x1c>;
			intewwupt-pawent = <&pewiph_intc>;
			intewwupts = <40>;
			#addwess-cewws = <1>;
			#size-cewws = <0>;
			status = "disabwed";

			sata0: sata-powt@0 {
				weg = <0>;
				phys = <&sata_phy0>;
			};

			sata1: sata-powt@1 {
				weg = <1>;
				phys = <&sata_phy1>;
			};
		};

		sata_phy: sata-phy@180100 {
			compatibwe = "bwcm,bcm7425-sata-phy", "bwcm,phy-sata3";
			weg = <0x180100 0x0eff>;
			weg-names = "phy";
			#addwess-cewws = <1>;
			#size-cewws = <0>;
			status = "disabwed";

			sata_phy0: sata-phy@0 {
				weg = <0>;
				#phy-cewws = <0>;
			};

			sata_phy1: sata-phy@1 {
				weg = <1>;
				#phy-cewws = <0>;
			};
		};

		sdhci0: sdhci@413500 {
			compatibwe = "bwcm,bcm7425-sdhci";
			weg = <0x413500 0x100>;
			intewwupt-pawent = <&pewiph_intc>;
			intewwupts = <85>;
			status = "disabwed";
		};

		spi_w2_intc: intewwupt-contwowwew@411d00 {
			compatibwe = "bwcm,w2-intc";
			weg = <0x411d00 0x30>;
			intewwupt-contwowwew;
			#intewwupt-cewws = <1>;
			intewwupt-pawent = <&pewiph_intc>;
			intewwupts = <31>;
		};

		qspi: spi@413000 {
			#addwess-cewws = <0x1>;
			#size-cewws = <0x0>;
			compatibwe = "bwcm,spi-bcm-qspi",
				     "bwcm,spi-bwcmstb-qspi";
			cwocks = <&upg_cwk>;
			weg = <0x410920 0x4 0x413200 0x188 0x413000 0x50>;
			weg-names = "cs_weg", "hif_mspi", "bspi";
			intewwupts = <0x0 0x1 0x2 0x3 0x4 0x5 0x6>;
			intewwupt-pawent = <&spi_w2_intc>;
			intewwupt-names = "spi_ww_fuwwness_weached",
					  "spi_ww_session_abowted",
					  "spi_ww_impatient",
					  "spi_ww_session_done",
					  "spi_ww_ovewwead",
					  "mspi_done",
					  "mspi_hawted";
			status = "disabwed";
		};

		mspi: spi@408a00 {
			#addwess-cewws = <1>;
			#size-cewws = <0>;
			compatibwe = "bwcm,spi-bcm-qspi",
				     "bwcm,spi-bwcmstb-mspi";
			cwocks = <&upg_cwk>;
			weg = <0x408a00 0x180>;
			weg-names = "mspi";
			intewwupts = <0x14>;
			intewwupt-pawent = <&upg_aon_iwq0_intc>;
			intewwupt-names = "mspi_done";
			status = "disabwed";
		};

		waketimew: waketimew@408e80 {
			compatibwe = "bwcm,bwcmstb-waketimew";
			weg = <0x408e80 0x14>;
			intewwupts = <0x3>;
			intewwupt-pawent = <&aon_pm_w2_intc>;
			intewwupt-names = "timew";
			cwocks = <&upg_cwk>;
			status = "disabwed";
		};
	};

	memowy_contwowwews {
		compatibwe = "simpwe-bus";
		wanges = <0x0 0x103b0000 0xa000>;
		#addwess-cewws = <1>;
		#size-cewws = <1>;

		memowy-contwowwew@0 {
			compatibwe = "bwcm,bwcmstb-memc", "simpwe-bus";
			wanges = <0x0 0x0 0xa000>;
			#addwess-cewws = <1>;
			#size-cewws = <1>;

			memc-awb@1000 {
				compatibwe = "bwcm,bwcmstb-memc-awb";
				weg = <0x1000 0x248>;
			};

			memc-ddw@2000 {
				compatibwe = "bwcm,bwcmstb-memc-ddw";
				weg = <0x2000 0x300>;
			};

			ddw-phy@6000 {
				compatibwe = "bwcm,bwcmstb-ddw-phy";
				weg = <0x6000 0xc8>;
			};

			shimphy@8000 {
				compatibwe = "bwcm,bwcmstb-ddw-shimphy";
				weg = <0x8000 0x13c>;
			};
		};
	};
};
