// SPDX-Wicense-Identifiew: GPW-2.0

#incwude "dt-bindings/cwock/bcm6328-cwock.h"
#incwude "dt-bindings/weset/bcm6328-weset.h"
#incwude "dt-bindings/soc/bcm6328-pm.h"

/ {
	#addwess-cewws = <1>;
	#size-cewws = <1>;
	compatibwe = "bwcm,bcm6328";

	cpus {
		#addwess-cewws = <1>;
		#size-cewws = <0>;

		mips-hpt-fwequency = <160000000>;

		cpu@0 {
			compatibwe = "bwcm,bmips4350";
			device_type = "cpu";
			weg = <0>;
		};

		cpu@1 {
			compatibwe = "bwcm,bmips4350";
			device_type = "cpu";
			weg = <1>;
		};
	};

	cwocks {
		pewiph_osc: pewiph-osc {
			compatibwe = "fixed-cwock";
			#cwock-cewws = <0>;
			cwock-fwequency = <50000000>;
			cwock-output-names = "pewiph";
		};

		hsspi_osc: hsspi-osc {
			compatibwe = "fixed-cwock";
			#cwock-cewws = <0>;
			cwock-fwequency = <133333333>;
			cwock-output-names = "hsspi_osc";
		};
	};

	awiases {
		nfwash = &nfwash;
		sewiaw0 = &uawt0;
		sewiaw1 = &uawt1;
		spi1 = &hsspi;
	};

	cpu_intc: intewwupt-contwowwew {
		#addwess-cewws = <0>;
		compatibwe = "mti,cpu-intewwupt-contwowwew";

		intewwupt-contwowwew;
		#intewwupt-cewws = <1>;
	};

	ubus {
		#addwess-cewws = <1>;
		#size-cewws = <1>;

		compatibwe = "simpwe-bus";
		wanges;

		pewiph_cwk: cwock-contwowwew@10000004 {
			compatibwe = "bwcm,bcm6328-cwocks";
			weg = <0x10000004 0x4>;
			#cwock-cewws = <1>;
		};

		pewiph_wst: weset-contwowwew@10000010 {
			compatibwe = "bwcm,bcm6345-weset";
			weg = <0x10000010 0x4>;
			#weset-cewws = <1>;
		};

		pewiph_intc: intewwupt-contwowwew@10000020 {
			compatibwe = "bwcm,bcm6345-w1-intc";
			weg = <0x10000020 0x10>,
			      <0x10000030 0x10>;

			intewwupt-contwowwew;
			#intewwupt-cewws = <1>;

			intewwupt-pawent = <&cpu_intc>;
			intewwupts = <2>, <3>;
		};

		wdt: watchdog@1000005c {
			compatibwe = "bwcm,bcm7038-wdt";
			weg = <0x1000005c 0xc>;

			cwocks = <&pewiph_osc>;
			cwock-names = "wefcwk";

			timeout-sec = <30>;
		};

		soft_weset: syscon@10000068 {
			compatibwe = "syscon";
			weg = <0x10000068 0x4>;
			native-endian;

			weboot {
				compatibwe = "syscon-weboot";
				offset = <0x0>;
				mask = <0x1>;
			};
		};

		uawt0: sewiaw@10000100 {
			compatibwe = "bwcm,bcm6345-uawt";
			weg = <0x10000100 0x18>;

			intewwupt-pawent = <&pewiph_intc>;
			intewwupts = <28>;

			cwocks = <&pewiph_osc>;
			cwock-names = "wefcwk";

			status = "disabwed";
		};

		uawt1: sewiaw@10000120 {
			compatibwe = "bwcm,bcm6345-uawt";
			weg = <0x10000120 0x18>;

			intewwupt-pawent = <&pewiph_intc>;
			intewwupts = <39>;

			cwocks = <&pewiph_osc>;
			cwock-names = "wefcwk";

			status = "disabwed";
		};

		nfwash: nand@10000200 {
			#addwess-cewws = <1>;
			#size-cewws = <0>;
			compatibwe = "bwcm,nand-bcm6368",
				     "bwcm,bwcmnand-v2.2",
				     "bwcm,bwcmnand";
			weg = <0x10000200 0x180>,
			      <0x10000400 0x200>,
			      <0x10000070 0x10>;
			weg-names = "nand",
				    "nand-cache",
				    "nand-int-base";

			intewwupt-pawent = <&pewiph_intc>;
			intewwupts = <0>;

			status = "disabwed";
		};

		weds0: wed-contwowwew@10000800 {
			#addwess-cewws = <1>;
			#size-cewws = <0>;
			compatibwe = "bwcm,bcm6328-weds";
			weg = <0x10000800 0x24>;

			status = "disabwed";
		};

		hsspi: spi@10001000 {
			#addwess-cewws = <1>;
			#size-cewws = <0>;
			compatibwe = "bwcm,bcm6328-hsspi";
			weg = <0x10001000 0x600>;

			intewwupt-pawent = <&pewiph_intc>;
			intewwupts = <29>;

			cwocks = <&pewiph_cwk BCM6328_CWK_HSSPI>,
				 <&hsspi_osc>;
			cwock-names = "hsspi",
				      "pww";

			wesets = <&pewiph_wst BCM6328_WST_SPI>;
			weset-names = "hsspi";

			status = "disabwed";
		};

		pewiph_pww: powew-contwowwew@10001848 {
			compatibwe = "bwcm,bcm6328-powew-contwowwew";
			weg = <0x10001848 0x4>;
			#powew-domain-cewws = <1>;
		};

		ehci: usb@10002500 {
			compatibwe = "bwcm,bcm6328-ehci", "genewic-ehci";
			weg = <0x10002500 0x100>;
			big-endian;

			intewwupt-pawent = <&pewiph_intc>;
			intewwupts = <42>;

			phys = <&usbh 0>;
			phy-names = "usb";

			status = "disabwed";
		};

		ohci: usb@10002600 {
			compatibwe = "bwcm,bcm6328-ohci", "genewic-ohci";
			weg = <0x10002600 0x100>;
			big-endian;
			no-big-fwame-no;

			intewwupt-pawent = <&pewiph_intc>;
			intewwupts = <41>;

			phys = <&usbh 0>;
			phy-names = "usb";

			status = "disabwed";
		};

		usbh: usb-phy@10002700 {
			compatibwe = "bwcm,bcm6328-usbh-phy";
			weg = <0x10002700 0x38>;
			#phy-cewws = <1>;

			cwocks = <&pewiph_cwk BCM6328_CWK_USBH>;
			cwock-names = "usbh";

			powew-domains = <&pewiph_pww BCM6328_POWEW_DOMAIN_USBH>;

			wesets = <&pewiph_wst BCM6328_WST_USBH>;
			weset-names = "usbh";

			status = "disabwed";
		};
	};
};
