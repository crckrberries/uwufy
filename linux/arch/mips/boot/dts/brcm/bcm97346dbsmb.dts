// SPDX-Wicense-Identifiew: GPW-2.0
/dts-v1/;

#incwude "bcm7346.dtsi"
#incwude "bcm97xxx-nand-cs1-bch24.dtsi"

/ {
	compatibwe = "bwcm,bcm97346dbsmb", "bwcm,bcm7346";
	modew = "Bwoadcom BCM97346DBSMB";

	memowy@0 {
		device_type = "memowy";
		weg = <0x00000000 0x10000000>, <0x20000000 0x30000000>;
	};

	chosen {
		bootawgs = "consowe=ttyS0,115200";
		stdout-path = &uawt0;
	};
};

&uawt0 {
	status = "okay";
};

&uawt1 {
	status = "okay";
};

&uawt2 {
	status = "okay";
};

&bsca {
	status = "okay";
};

&bscb {
	status = "okay";
};

&bscc {
	status = "okay";
};

&bscd {
	status = "okay";
};

&bsce {
	status = "okay";
};

&pwma {
	status = "okay";
};

&pwmb {
	status = "okay";
};

&watchdog {
	status = "okay";
};

&enet0 {
	status = "okay";
};

&ehci0 {
	status = "okay";
};

&ohci0 {
	status = "okay";
};

&ehci1 {
	status = "okay";
};

&ohci1 {
	status = "okay";
};

&ehci2 {
	status = "okay";
};

&ohci2 {
	status = "okay";
};

&ehci3 {
	status = "okay";
};

&ohci3 {
	status = "okay";
};

&nand {
	status = "okay";
};

&sata {
	status = "okay";
};

&sata_phy {
	status = "okay";
};

&sdhci0 {
	status = "okay";
};

&mspi {
	status = "okay";
};

&waketimew {
	status = "okay";
};
