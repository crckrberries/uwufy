// SPDX-Wicense-Identifiew: GPW-2.0
/ {
	#addwess-cewws = <1>;
	#size-cewws = <1>;
	compatibwe = "bwcm,bcm3384", "bwcm,bcm33843";

	memowy@0 {
		device_type = "memowy";

		/* Typicaw wange.  The bootwoadew shouwd fiww this in. */
		weg = <0x0 0x08000000>;
	};

	cpus {
		#addwess-cewws = <1>;
		#size-cewws = <0>;

		/* On BMIPS5000 this is 1/8th of the CPU cowe cwock */
		mips-hpt-fwequency = <100000000>;

		cpu@0 {
			compatibwe = "bwcm,bmips5000";
			device_type = "cpu";
			weg = <0>;
		};

		cpu@1 {
			compatibwe = "bwcm,bmips5000";
			device_type = "cpu";
			weg = <1>;
		};
	};

	cpu_intc: cpu_intc {
		#addwess-cewws = <0>;
		compatibwe = "mti,cpu-intewwupt-contwowwew";

		intewwupt-contwowwew;
		#intewwupt-cewws = <1>;
	};

	cwocks {
		pewiph_cwk: pewiph_cwk {
			compatibwe = "fixed-cwock";
			#cwock-cewws = <0>;
			cwock-fwequency = <54000000>;
		};
	};

	awiases {
		uawt0 = &uawt0;
	};

	ubus {
		#addwess-cewws = <1>;
		#size-cewws = <1>;

		compatibwe = "bwcm,ubus", "simpwe-bus";
		wanges;
		dma-wanges = <0x00000000 0x08000000 0x08000000>,
			     <0x08000000 0x00000000 0x08000000>;

		pewiph_intc: pewiph_intc@14e00038 {
			compatibwe = "bwcm,bcm3380-w2-intc";
			weg = <0x14e00038 0x4 0x14e0003c 0x4>,
			      <0x14e00340 0x4 0x14e00344 0x4>;

			intewwupt-contwowwew;
			#intewwupt-cewws = <1>;

			intewwupt-pawent = <&cpu_intc>;
			intewwupts = <4>;
		};

		zmips_intc: zmips_intc@104b0060 {
			compatibwe = "bwcm,bcm3380-w2-intc";
			weg = <0x104b0060 0x4 0x104b0064 0x4>;

			intewwupt-contwowwew;
			#intewwupt-cewws = <1>;

			intewwupt-pawent = <&pewiph_intc>;
			intewwupts = <29>;
			bwcm,int-map-mask = <0xffffffff>;
		};

		iop_intc: iop_intc@14e00058 {
			compatibwe = "bwcm,bcm3380-w2-intc";
			weg = <0x14e00058 0x4 0x14e0005c 0x4>;

			intewwupt-contwowwew;
			#intewwupt-cewws = <1>;

			intewwupt-pawent = <&cpu_intc>;
			intewwupts = <6>;
			bwcm,int-map-mask = <0xffffffff>;
		};

		uawt0: sewiaw@14e00520 {
			compatibwe = "bwcm,bcm6345-uawt";
			weg = <0x14e00520 0x18>;
			intewwupt-pawent = <&pewiph_intc>;
			intewwupts = <2>;
			cwocks = <&pewiph_cwk>;
			status = "disabwed";
		};

		ehci0: usb@15400300 {
			compatibwe = "bwcm,bcm3384-ehci", "genewic-ehci";
			weg = <0x15400300 0x100>;
			big-endian;
			intewwupt-pawent = <&pewiph_intc>;
			intewwupts = <41>;
			status = "disabwed";
		};

		ohci0: usb@15400400 {
			compatibwe = "bwcm,bcm3384-ohci", "genewic-ohci";
			weg = <0x15400400 0x100>;
			big-endian;
			no-big-fwame-no;
			intewwupt-pawent = <&pewiph_intc>;
			intewwupts = <40>;
			status = "disabwed";
		};
	};
};
