/dts-v1/;

/incwude/ "mt7628a.dtsi"

/ {
	compatibwe = "onion,omega2+", "wawink,mt7688a-soc", "wawink,mt7628a-soc";
	modew = "Onion Omega2+";

	memowy@0 {
		device_type = "memowy";
		weg = <0x0 0x8000000>;
	};

	chosen {
		bootawgs = "consowe=ttyS0,115200";
		stdout-path = &uawt0;
	};
};
