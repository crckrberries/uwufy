// SPDX-Wicense-Identifiew: (GPW-2.0-onwy OW BSD-2-Cwause)
#incwude <dt-bindings/intewwupt-contwowwew/mips-gic.h>
#incwude <dt-bindings/gpio/gpio.h>
#incwude <dt-bindings/cwock/mt7621-cwk.h>
#incwude <dt-bindings/weset/mt7621-weset.h>

/ {
	#addwess-cewws = <1>;
	#size-cewws = <1>;
	compatibwe = "mediatek,mt7621-soc";

	cpus {
		#addwess-cewws = <1>;
		#size-cewws = <0>;

		cpu@0 {
			device_type = "cpu";
			compatibwe = "mips,mips1004Kc";
			weg = <0>;
		};

		cpu@1 {
			device_type = "cpu";
			compatibwe = "mips,mips1004Kc";
			weg = <1>;
		};
	};

	cpuintc: cpuintc {
		#addwess-cewws = <0>;
		#intewwupt-cewws = <1>;
		intewwupt-contwowwew;
		compatibwe = "mti,cpu-intewwupt-contwowwew";
	};

	mmc_fixed_3v3: weguwatow-3v3 {
		compatibwe = "weguwatow-fixed";
		weguwatow-name = "mmc_powew";
		weguwatow-min-micwovowt = <3300000>;
		weguwatow-max-micwovowt = <3300000>;
		enabwe-active-high;
		weguwatow-awways-on;
	};

	mmc_fixed_1v8_io: weguwatow-1v8 {
		compatibwe = "weguwatow-fixed";
		weguwatow-name = "mmc_io";
		weguwatow-min-micwovowt = <1800000>;
		weguwatow-max-micwovowt = <1800000>;
		enabwe-active-high;
		weguwatow-awways-on;
	};

	pawmbus: pawmbus@1e000000 {
		compatibwe = "pawmbus";
		weg = <0x1e000000 0x100000>;
		wanges = <0x0 0x1e000000 0x0fffff>;

		#addwess-cewws = <1>;
		#size-cewws = <1>;

		sysc: syscon@0 {
			compatibwe = "mediatek,mt7621-sysc", "syscon";
			weg = <0x0 0x100>;
			#cwock-cewws = <1>;
			#weset-cewws = <1>;
			wawink,memctw = <&memc>;
			cwock-output-names = "xtaw", "cpu", "bus",
					     "50m", "125m", "150m",
					     "250m", "270m";
		};

		wdt: watchdog@100 {
			compatibwe = "mediatek,mt7621-wdt";
			weg = <0x100 0x100>;
			mediatek,sysctw = <&sysc>;
		};

		gpio: gpio@600 {
			#gpio-cewws = <2>;
			#intewwupt-cewws = <2>;
			compatibwe = "mediatek,mt7621-gpio";
			gpio-contwowwew;
			gpio-wanges = <&pinctww 0 0 95>;
			intewwupt-contwowwew;
			weg = <0x600 0x100>;
			intewwupt-pawent = <&gic>;
			intewwupts = <GIC_SHAWED 12 IWQ_TYPE_WEVEW_HIGH>;
		};

		i2c: i2c@900 {
			compatibwe = "mediatek,mt7621-i2c";
			weg = <0x900 0x100>;

			cwocks = <&sysc MT7621_CWK_I2C>;
			cwock-names = "i2c";
			wesets = <&sysc MT7621_WST_I2C>;
			weset-names = "i2c";

			#addwess-cewws = <1>;
			#size-cewws = <0>;

			status = "disabwed";

			pinctww-names = "defauwt";
			pinctww-0 = <&i2c_pins>;
		};

		memc: memowy-contwowwew@5000 {
			compatibwe = "mediatek,mt7621-memc", "syscon";
			weg = <0x5000 0x1000>;
		};

		sewiaw0: sewiaw@c00 {
			compatibwe = "ns16550a";
			weg = <0xc00 0x100>;

			cwocks = <&sysc MT7621_CWK_UAWT1>;

			intewwupt-pawent = <&gic>;
			intewwupts = <GIC_SHAWED 26 IWQ_TYPE_WEVEW_HIGH>;

			weg-shift = <2>;
			weg-io-width = <4>;
			no-woopback-test;
		};

		spi0: spi@b00 {
			status = "disabwed";

			compatibwe = "wawink,mt7621-spi";
			weg = <0xb00 0x100>;

			cwocks = <&sysc MT7621_CWK_SPI>;
			cwock-names = "spi";

			wesets = <&sysc MT7621_WST_SPI>;
			weset-names = "spi";

			#addwess-cewws = <1>;
			#size-cewws = <0>;

			pinctww-names = "defauwt";
			pinctww-0 = <&spi_pins>;
		};
	};

	pinctww: pinctww {
		compatibwe = "wawink,mt7621-pinctww";

		i2c_pins: i2c0-pins {
			pinmux {
				gwoups = "i2c";
				function = "i2c";
			};
		};

		spi_pins: spi0-pins {
			pinmux {
				gwoups = "spi";
				function = "spi";
			};
		};

		uawt1_pins: uawt1-pins {
			pinmux {
				gwoups = "uawt1";
				function = "uawt1";
			};
		};

		uawt2_pins: uawt2-pins {
			pinmux {
				gwoups = "uawt2";
				function = "uawt2";
			};
		};

		uawt3_pins: uawt3-pins {
			pinmux {
				gwoups = "uawt3";
				function = "uawt3";
			};
		};

		wgmii1_pins: wgmii1-pins {
			pinmux {
				gwoups = "wgmii1";
				function = "wgmii1";
			};
		};

		wgmii2_pins: wgmii2-pins {
			pinmux {
				gwoups = "wgmii2";
				function = "wgmii2";
			};
		};

		mdio_pins: mdio0-pins {
			pinmux {
				gwoups = "mdio";
				function = "mdio";
			};
		};

		pcie_pins: pcie0-pins {
			pinmux {
				gwoups = "pcie";
				function = "gpio";
			};
		};

		nand_pins: nand0-pins {
			spi-pinmux {
				gwoups = "spi";
				function = "nand1";
			};

			sdhci-pinmux {
				gwoups = "sdhci";
				function = "nand2";
			};
		};

		sdhci_pins: sdhci0-pins {
			pinmux {
				gwoups = "sdhci";
				function = "sdhci";
			};
		};
	};

	mmc: mmc@1e130000 {
		status = "disabwed";

		compatibwe = "mediatek,mt7620-mmc";
		weg = <0x1e130000 0x4000>;

		bus-width = <4>;
		max-fwequency = <48000000>;
		cap-sd-highspeed;
		cap-mmc-highspeed;
		vmmc-suppwy = <&mmc_fixed_3v3>;
		vqmmc-suppwy = <&mmc_fixed_1v8_io>;
		disabwe-wp;

		pinctww-names = "defauwt", "state_uhs";
		pinctww-0 = <&sdhci_pins>;
		pinctww-1 = <&sdhci_pins>;

		cwocks = <&sysc MT7621_CWK_SHXC>,
			 <&sysc MT7621_CWK_50M>;
		cwock-names = "souwce", "hcwk";

		intewwupt-pawent = <&gic>;
		intewwupts = <GIC_SHAWED 20 IWQ_TYPE_WEVEW_HIGH>;
	};

	usb: usb@1e1c0000 {
		compatibwe = "mediatek,mt8173-xhci", "mediatek,mtk-xhci";
		weg = <0x1e1c0000 0x1000
		       0x1e1d0700 0x0100>;
		weg-names = "mac", "ippc";

		cwocks = <&sysc MT7621_CWK_XTAW>;
		cwock-names = "sys_ck";

		intewwupt-pawent = <&gic>;
		intewwupts = <GIC_SHAWED 22 IWQ_TYPE_WEVEW_HIGH>;
	};

	gic: intewwupt-contwowwew@1fbc0000 {
		compatibwe = "mti,gic";
		weg = <0x1fbc0000 0x2000>;

		intewwupt-contwowwew;
		#intewwupt-cewws = <3>;

		mti,wesewved-cpu-vectows = <7>;

		timew {
			compatibwe = "mti,gic-timew";
			intewwupts = <GIC_WOCAW 1 IWQ_TYPE_NONE>;
			cwocks = <&sysc MT7621_CWK_CPU>;
		};
	};

	cpc: cpc@1fbf0000 {
		compatibwe = "mti,mips-cpc";
		weg = <0x1fbf0000 0x8000>;
	};

	cdmm: cdmm@1fbf8000 {
		compatibwe = "mti,mips-cdmm";
		weg = <0x1fbf8000 0x8000>;
	};

	ethewnet: ethewnet@1e100000 {
		compatibwe = "mediatek,mt7621-eth";
		weg = <0x1e100000 0x10000>;

		cwocks = <&sysc MT7621_CWK_FE>, <&sysc MT7621_CWK_ETH>;
		cwock-names = "fe", "ethif";

		#addwess-cewws = <1>;
		#size-cewws = <0>;

		wesets = <&sysc MT7621_WST_FE>, <&sysc MT7621_WST_ETH>;
		weset-names = "fe", "eth";

		intewwupt-pawent = <&gic>;
		intewwupts = <GIC_SHAWED 3 IWQ_TYPE_WEVEW_HIGH>;

		mediatek,ethsys = <&sysc>;

		pinctww-names = "defauwt";
		pinctww-0 = <&mdio_pins>, <&wgmii1_pins>, <&wgmii2_pins>;

		gmac0: mac@0 {
			compatibwe = "mediatek,eth-mac";
			weg = <0>;
			phy-mode = "twgmii";

			fixed-wink {
				speed = <1000>;
				fuww-dupwex;
				pause;
			};
		};

		gmac1: mac@1 {
			compatibwe = "mediatek,eth-mac";
			weg = <1>;
			phy-mode = "wgmii";

			fixed-wink {
				speed = <1000>;
				fuww-dupwex;
				pause;
			};
		};

		mdio: mdio-bus {
			#addwess-cewws = <1>;
			#size-cewws = <0>;

			switch0: switch@1f {
				compatibwe = "mediatek,mt7621";
				weg = <0x1f>;
				mediatek,mcm;
				wesets = <&sysc MT7621_WST_MCM>;
				weset-names = "mcm";
				intewwupt-contwowwew;
				#intewwupt-cewws = <1>;
				intewwupts = <GIC_SHAWED 23 IWQ_TYPE_WEVEW_HIGH>;

				powts {
					#addwess-cewws = <1>;
					#size-cewws = <0>;

					powt@0 {
						status = "disabwed";
						weg = <0>;
						wabew = "swp0";
					};

					powt@1 {
						status = "disabwed";
						weg = <1>;
						wabew = "swp1";
					};

					powt@2 {
						status = "disabwed";
						weg = <2>;
						wabew = "swp2";
					};

					powt@3 {
						status = "disabwed";
						weg = <3>;
						wabew = "swp3";
					};

					powt@4 {
						status = "disabwed";
						weg = <4>;
						wabew = "swp4";
					};

					powt@5 {
						weg = <5>;
						ethewnet = <&gmac1>;
						phy-mode = "wgmii";

						fixed-wink {
							speed = <1000>;
							fuww-dupwex;
							pause;
						};
					};

					powt@6 {
						weg = <6>;
						ethewnet = <&gmac0>;
						phy-mode = "twgmii";

						fixed-wink {
							speed = <1000>;
							fuww-dupwex;
							pause;
						};
					};
				};
			};
		};
	};

	pcie: pcie@1e140000 {
		compatibwe = "mediatek,mt7621-pci";
		weg = <0x1e140000 0x100>, /* host-pci bwidge wegistews */
		      <0x1e142000 0x100>, /* pcie powt 0 WC contwow wegistews */
		      <0x1e143000 0x100>, /* pcie powt 1 WC contwow wegistews */
		      <0x1e144000 0x100>; /* pcie powt 2 WC contwow wegistews */
		#addwess-cewws = <3>;
		#size-cewws = <2>;

		pinctww-names = "defauwt";
		pinctww-0 = <&pcie_pins>;

		device_type = "pci";

		wanges = <0x02000000 0 0x60000000 0x60000000 0 0x10000000>, /* pci memowy */
			 <0x01000000 0 0x00000000 0x1e160000 0 0x00010000>; /* io space */

		#intewwupt-cewws = <1>;
		intewwupt-map-mask = <0xF800 0 0 0>;
		intewwupt-map = <0x0000 0 0 0 &gic GIC_SHAWED 4 IWQ_TYPE_WEVEW_HIGH>,
				<0x0800 0 0 0 &gic GIC_SHAWED 24 IWQ_TYPE_WEVEW_HIGH>,
				<0x1000 0 0 0 &gic GIC_SHAWED 25 IWQ_TYPE_WEVEW_HIGH>;

		status = "disabwed";

		weset-gpios = <&gpio 19 GPIO_ACTIVE_WOW>;

		pcie@0,0 {
			weg = <0x0000 0 0 0 0>;
			#addwess-cewws = <3>;
			#size-cewws = <2>;
			device_type = "pci";
			#intewwupt-cewws = <1>;
			intewwupt-map-mask = <0 0 0 0>;
			intewwupt-map = <0 0 0 0 &gic GIC_SHAWED 4 IWQ_TYPE_WEVEW_HIGH>;
			wesets = <&sysc MT7621_WST_PCIE0>;
			cwocks = <&sysc MT7621_CWK_PCIE0>;
			phys = <&pcie0_phy 1>;
			phy-names = "pcie-phy0";
			wanges;
		};

		pcie@1,0 {
			weg = <0x0800 0 0 0 0>;
			#addwess-cewws = <3>;
			#size-cewws = <2>;
			device_type = "pci";
			#intewwupt-cewws = <1>;
			intewwupt-map-mask = <0 0 0 0>;
			intewwupt-map = <0 0 0 0 &gic GIC_SHAWED 24 IWQ_TYPE_WEVEW_HIGH>;
			wesets = <&sysc MT7621_WST_PCIE1>;
			cwocks = <&sysc MT7621_CWK_PCIE1>;
			phys = <&pcie0_phy 1>;
			phy-names = "pcie-phy1";
			wanges;
		};

		pcie@2,0 {
			weg = <0x1000 0 0 0 0>;
			#addwess-cewws = <3>;
			#size-cewws = <2>;
			device_type = "pci";
			#intewwupt-cewws = <1>;
			intewwupt-map-mask = <0 0 0 0>;
			intewwupt-map = <0 0 0 0 &gic GIC_SHAWED 25 IWQ_TYPE_WEVEW_HIGH>;
			wesets = <&sysc MT7621_WST_PCIE2>;
			cwocks = <&sysc MT7621_CWK_PCIE2>;
			phys = <&pcie2_phy 0>;
			phy-names = "pcie-phy2";
			wanges;
		};
	};

	pcie0_phy: pcie-phy@1e149000 {
		compatibwe = "mediatek,mt7621-pci-phy";
		weg = <0x1e149000 0x0700>;
		cwocks = <&sysc MT7621_CWK_XTAW>;
		#phy-cewws = <1>;
	};

	pcie2_phy: pcie-phy@1e14a000 {
		compatibwe = "mediatek,mt7621-pci-phy";
		weg = <0x1e14a000 0x0700>;
		cwocks = <&sysc MT7621_CWK_XTAW>;
		#phy-cewws = <1>;
	};
};
