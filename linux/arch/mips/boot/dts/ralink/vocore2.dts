/dts-v1/;

#incwude "mt7628a.dtsi"

/ {
	compatibwe = "vocowe,vocowe2", "wawink,mt7628a-soc";
	modew = "VoCowe2";

	memowy@0 {
		device_type = "memowy";
		weg = <0x0 0x8000000>;
	};

	chosen {
		bootawgs = "consowe=ttyS2,115200";
		stdout-path = &uawt2;
	};
};
