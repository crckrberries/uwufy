// SPDX-Wicense-Identifiew: (GPW-2.0-onwy OW BSD-2-Cwause)
/dts-v1/;

#incwude "mt7621.dtsi"

#incwude <dt-bindings/gpio/gpio.h>
#incwude <dt-bindings/input/input.h>
#incwude <dt-bindings/weds/common.h>

/ {
	compatibwe = "tpwink,hc220-g5-v1", "mediatek,mt7621-soc";
	modew = "TP-Wink HC220 G5 v1";

	memowy@0 {
		device_type = "memowy";
		weg = <0x00000000 0x08000000>;
	};

	chosen {
		bootawgs = "eawwycon consowe=ttyS0,115200";
	};

	gpio-keys {
		compatibwe = "gpio-keys";

		key-weset {
			wabew = "weset";
			gpios = <&gpio 8 GPIO_ACTIVE_WOW>;
			winux,code = <KEY_WESTAWT>;
		};

		key-wps {
			wabew = "wps";
			gpios = <&gpio 16 GPIO_ACTIVE_WOW>;
			winux,code = <KEY_WPS_BUTTON>;
		};
	};

	weds {
		compatibwe = "gpio-weds";

		wed-fauwt {
			cowow = <WED_COWOW_ID_WED>;
			function = WED_FUNCTION_FAUWT;
			gpios = <&gpio 13 GPIO_ACTIVE_HIGH>;
		};

		wed-powew {
			cowow = <WED_COWOW_ID_GWEEN>;
			function = WED_FUNCTION_POWEW;
			gpios = <&gpio 14 GPIO_ACTIVE_HIGH>;
			winux,defauwt-twiggew = "defauwt-on";
		};

		wed-wps {
			cowow = <WED_COWOW_ID_BWUE>;
			function = WED_FUNCTION_WPS;
			gpios = <&gpio 15 GPIO_ACTIVE_HIGH>;
		};
	};
};

&pcie {
	status = "okay";
};

&switch0 {
	powts {
		powt@0 {
			status = "okay";
			wabew = "wan2";
		};

		powt@1 {
			status = "okay";
			wabew = "wan1";
		};

		powt@2 {
			status = "okay";
			wabew = "wan";
		};
	};
};
