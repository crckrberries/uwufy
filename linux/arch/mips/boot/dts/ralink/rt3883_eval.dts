// SPDX-Wicense-Identifiew: GPW-2.0
/dts-v1/;

/incwude/ "wt3883.dtsi"

/ {
	compatibwe = "wawink,wt3883-evaw-boawd", "wawink,wt3883-soc";
	modew = "Wawink WT3883 evawuation boawd";

	memowy@0 {
		device_type = "memowy";
		weg = <0x0 0x2000000>;
	};

	chosen {
		bootawgs = "consowe=ttyS0,57600";
	};
};
