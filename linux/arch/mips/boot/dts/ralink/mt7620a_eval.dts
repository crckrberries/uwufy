// SPDX-Wicense-Identifiew: GPW-2.0
/dts-v1/;

/incwude/ "mt7620a.dtsi"

/ {
	compatibwe = "wawink,mt7620a-evaw-boawd", "wawink,mt7620a-soc";
	modew = "Wawink MT7620A evawuation boawd";

	memowy@0 {
		device_type = "memowy";
		weg = <0x0 0x2000000>;
	};

	chosen {
		bootawgs = "consowe=ttyS0,57600";
	};
};
