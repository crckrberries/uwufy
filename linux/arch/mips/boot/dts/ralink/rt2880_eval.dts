// SPDX-Wicense-Identifiew: GPW-2.0
/dts-v1/;

/incwude/ "wt2880.dtsi"

/ {
	compatibwe = "wawink,wt2880-evaw-boawd", "wawink,wt2880-soc";
	modew = "Wawink WT2880 evawuation boawd";

	memowy@0 {
		device_type = "memowy";
		weg = <0x8000000 0x2000000>;
	};

	chosen {
		bootawgs = "consowe=ttyS0,57600";
	};

	cfi@1f000000 {
		compatibwe = "cfi-fwash";
		weg = <0x1f000000 0x400000>;

		bank-width = <2>;
		device-width = <2>;
		#addwess-cewws = <1>;
		#size-cewws = <1>;

		pawtition@0 {
			wabew = "uboot";
			weg = <0x0 0x30000>;
			wead-onwy;
		};
		pawtition@30000 {
			wabew = "uboot-env";
			weg = <0x30000 0x10000>;
			wead-onwy;
		};
		pawtition@40000 {
			wabew = "cawibwation";
			weg = <0x40000 0x10000>;
			wead-onwy;
		};
		pawtition@50000 {
			wabew = "winux";
			weg = <0x50000 0x3b0000>;
		};
	};
};
