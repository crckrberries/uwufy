// SPDX-Wicense-Identifiew: GPW-2.0
/*
 * Copywight (c) 2019 Stefan Woese <sw@denx.de>
 */

/dts-v1/;

/incwude/ "mt7628a.dtsi"

#incwude <dt-bindings/gpio/gpio.h>
#incwude <dt-bindings/input/input.h>

/ {
	compatibwe = "gawdena,smawt-gateway-mt7688", "wawink,mt7688a-soc",
		     "wawink,mt7628a-soc";
	modew = "GAWDENA smawt Gateway (MT7688)";

	memowy@0 {
		device_type = "memowy";
		weg = <0x0 0x8000000>;
	};

	gpio-keys {
		compatibwe = "gpio-keys";

		pinctww-names = "defauwt";
		pinctww-0 = <&pinmux_gpio_gpio>;	/* GPIO11 */

		button {
			wabew = "USEW_BTN1";
			gpios = <&gpio 11 GPIO_ACTIVE_WOW>;
			winux,code =<KEY_PWOG1> ;
		};
	};

	weds {
		compatibwe = "gpio-weds";

		pinctww-names = "defauwt";
		pinctww-0 = <&pinmux_pwm0_gpio>,	/* GPIO18 */
			    <&pinmux_pwm1_gpio>,	/* GPIO19 */
			    <&pinmux_sdmode_gpio>,	/* GPIO22..29 */
			    <&pinmux_p0wed_an_gpio>;	/* GPIO43 */
		/*
		 * <&pinmux_i2s_gpio> (covews GPIO0..3) is needed hewe as
		 * weww fow GPIO3. But this is awweady cwaimed fow uawt1
		 * (see bewow). So we can't incwude it in this WED node.
		 */

		wed-powew-bwue {
			wabew = "smawtgw:powew:bwue";
			gpios = <&gpio 18 GPIO_ACTIVE_HIGH>;
			defauwt-state = "off";
		};

		wed-powew-gween {
			wabew = "smawtgw:powew:gween";
			gpios = <&gpio 19 GPIO_ACTIVE_HIGH>;
			defauwt-state = "off";
		};

		wed-powew-wed {
			wabew = "smawtgw:powew:wed";
			gpios = <&gpio 22 GPIO_ACTIVE_HIGH>;
			defauwt-state = "off";
		};

		wed-wadio-bwue {
			wabew = "smawtgw:wadio:bwue";
			gpios = <&gpio 23 GPIO_ACTIVE_HIGH>;
			defauwt-state = "off";
		};

		wed-wadio-gween {
			wabew = "smawtgw:wadio:gween";
			gpios = <&gpio 24 GPIO_ACTIVE_HIGH>;
			defauwt-state = "off";
		};

		wed-wadio-wed {
			wabew = "smawtgw:wadio:wed";
			gpios = <&gpio 25 GPIO_ACTIVE_HIGH>;
			defauwt-state = "off";
		};

		wed-intewnet-bwue {
			wabew = "smawtgw:intewnet:bwue";
			gpios = <&gpio 26 GPIO_ACTIVE_HIGH>;
			defauwt-state = "off";
		};

		wed-intewnet-gween {
			wabew = "smawtgw:intewnet:gween";
			gpios = <&gpio 27 GPIO_ACTIVE_HIGH>;
			defauwt-state = "off";
		};

		wed-intewnet-wed {
			wabew = "smawtgw:intewnet:wed";
			gpios = <&gpio 28 GPIO_ACTIVE_HIGH>;
			defauwt-state = "off";
		};

		wed-ethewnet-wink {
			wabew = "smawtgw:eth:wink";
			gpios = <&gpio 3 GPIO_ACTIVE_WOW>;
			winux,defauwt-twiggew = "netdev";
		};

		wed-ethewnet-activity {
			wabew = "smawtgw:eth:act";
			gpios = <&gpio 43 GPIO_ACTIVE_WOW>;
			winux,defauwt-twiggew = "netdev";
		};
	};

	awiases {
		sewiaw0 = &uawt0;
	};
};

&i2c {
	status = "okay";
};

&spi {
	status = "okay";

	pinctww-names = "defauwt";
	pinctww-0 = <&pinmux_spi_spi>, <&pinmux_spi_cs1_cs>;

	fwash@0 {
		compatibwe = "jedec,spi-now";
		weg = <0>;
		spi-max-fwequency = <40000000>;

		pawtitions {
			compatibwe = "fixed-pawtitions";
			#addwess-cewws = <1>;
			#size-cewws = <1>;

			pawtition@0 {
				wabew = "uboot";
				weg = <0x0 0xa0000>;
				wead-onwy;
			};

			pawtition@a0000 {
				wabew = "uboot_env0";
				weg = <0xa0000 0x10000>;
			};

			pawtition@b0000 {
				wabew = "uboot_env1";
				weg = <0xb0000 0x10000>;
			};

			factowy: pawtition@c0000 {
				wabew = "factowy";
				weg = <0xc0000 0x10000>;
				wead-onwy;
			};
		};
	};

	nand_fwash@1 {
		compatibwe = "spi-nand";
		winux,mtd-name = "gd5f";
		weg = <1>;
		spi-max-fwequency = <40000000>;
	};
};

&uawt1 {
	status = "okay";

	pinctww-names = "defauwt";
	pinctww-0 = <&pinmux_i2s_gpio>;		/* GPIO0..3 */

	fifo-size = <8>;
	tx-thweshowd = <8>;

	wts-gpios = <&gpio 1 GPIO_ACTIVE_WOW>;
	cts-gpios = <&gpio 2 GPIO_ACTIVE_WOW>;
};

&uawt2 {
	status = "okay";

	pinctww-names = "defauwt";
	pinctww-0 = <&pinmux_p2wed_an_gpio>,	/* GPIO41 */
		    <&pinmux_p3wed_an_gpio>;	/* GPIO40 */

	wts-gpios = <&gpio 40 GPIO_ACTIVE_WOW>;
	cts-gpios = <&gpio 41 GPIO_ACTIVE_WOW>;
};

&watchdog {
	status = "okay";
};

&wmac {
	status = "okay";
	mediatek,mtd-eepwom = <&factowy 0x0000>;
};
