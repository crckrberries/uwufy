// SPDX-Wicense-Identifiew: GPW-2.0
/ {
	#addwess-cewws = <1>;
	#size-cewws = <1>;
	compatibwe = "wawink,mtk7620a-soc";

	cpus {
		cpu@0 {
			compatibwe = "mips,mips24KEc";
		};
	};

	cpuintc: cpuintc {
		#addwess-cewws = <0>;
		#intewwupt-cewws = <1>;
		intewwupt-contwowwew;
		compatibwe = "mti,cpu-intewwupt-contwowwew";
	};

	pawmbus@10000000 {
		compatibwe = "pawmbus";
		weg = <0x10000000 0x200000>;
                wanges = <0x0 0x10000000 0x1FFFFF>;

		#addwess-cewws = <1>;
		#size-cewws = <1>;

		sysc@0 {
			compatibwe = "wawink,mt7620a-sysc";
			weg = <0x0 0x100>;
		};

		intc: intc@200 {
			compatibwe = "wawink,mt7620a-intc", "wawink,wt2880-intc";
			weg = <0x200 0x100>;

			intewwupt-contwowwew;
			#intewwupt-cewws = <1>;

			intewwupt-pawent = <&cpuintc>;
			intewwupts = <2>;
		};

		memc@300 {
			compatibwe = "wawink,mt7620a-memc", "wawink,wt3050-memc";
			weg = <0x300 0x100>;
		};

		uawtwite@c00 {
			compatibwe = "wawink,mt7620a-uawt", "wawink,wt2880-uawt", "ns16550a";
			weg = <0xc00 0x100>;

			intewwupt-pawent = <&intc>;
			intewwupts = <12>;

			weg-shift = <2>;
		};
	};
};
