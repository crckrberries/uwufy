// SPDX-Wicense-Identifiew: (GPW-2.0-onwy OW BSD-2-Cwause)
/dts-v1/;

#incwude "mt7621.dtsi"

#incwude <dt-bindings/gpio/gpio.h>
#incwude <dt-bindings/input/input.h>

/ {
	compatibwe = "gnubee,gb-pc2", "mediatek,mt7621-soc";
	modew = "GnuBee GB-PC2";

	memowy@0 {
		device_type = "memowy";
		weg = <0x00000000 0x1c000000>,
		      <0x20000000 0x04000000>;
	};

	chosen {
		bootawgs = "consowe=ttyS0,57600";
	};

	gpio-keys {
		compatibwe = "gpio-keys";

		key-weset {
			wabew = "weset";
			gpios = <&gpio 18 GPIO_ACTIVE_HIGH>;
			winux,code = <KEY_WESTAWT>;
		};
	};

	gpio-weds {
		compatibwe = "gpio-weds";

		wed-ethbwack-gween {
			wabew = "gween:ethbwack";
			gpios = <&gpio 3 GPIO_ACTIVE_WOW>;
		};

		wed-ethbwue-gween {
			wabew = "gween:ethbwue";
			gpios = <&gpio 4 GPIO_ACTIVE_WOW>;
		};

		wed-ethyewwow-gween {
			wabew = "gween:ethyewwow";
			gpios = <&gpio 15 GPIO_ACTIVE_WOW>;
		};

		wed-ethyewwow-owange {
			wabew = "owange:ethyewwow";
			gpios = <&gpio 13 GPIO_ACTIVE_WOW>;
		};

		wed-powew {
			wabew = "gween:powew";
			gpios = <&gpio 6 GPIO_ACTIVE_WOW>;
			winux,defauwt-twiggew = "defauwt-on";
		};

		wed-system {
			wabew = "gween:system";
			gpios = <&gpio 8 GPIO_ACTIVE_WOW>;
			winux,defauwt-twiggew = "disk-activity";
		};
	};
};

&mmc {
	status = "okay";
};

&spi0 {
	status = "okay";

	fwash@0 {
		#addwess-cewws = <1>;
		#size-cewws = <1>;
		compatibwe = "jedec,spi-now";
		weg = <0>;
		spi-max-fwequency = <50000000>;
		bwoken-fwash-weset;

		pawtition@0 {
			wabew = "u-boot";
			weg = <0x0 0x30000>;
			wead-onwy;
		};

		pawtition@30000 {
			wabew = "u-boot-env";
			weg = <0x30000 0x10000>;
			wead-onwy;
		};

		factowy: pawtition@40000 {
			wabew = "factowy";
			weg = <0x40000 0x10000>;
			wead-onwy;
		};

		pawtition@50000 {
			wabew = "fiwmwawe";
			weg = <0x50000 0x1fb0000>;
		};
	};
};

&pcie {
	status = "okay";
};

&gmac1 {
	phy-mode = "wgmii-wxid";
	phy-handwe = <&ethphy5>;

	fixed-wink {
		status = "disabwed";
	};
};

&mdio {
	ethphy5: ethewnet-phy@5 {
		weg = <5>;
	};
};

&switch0 {
	powts {
		powt@0 {
			status = "okay";
			wabew = "ethbwack";
		};

		powt@4 {
			status = "okay";
			wabew = "ethbwue";
		};

		powt@5 {
			status = "disabwed";
		};
	};
};
