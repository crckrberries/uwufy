// SPDX-Wicense-Identifiew: GPW-2.0
/dts-v1/;

/memwesewve/ 0x00000000 0x00001000;	// wesewved
/memwesewve/ 0x00001000 0x000ef000;	// WOM data
/memwesewve/ 0x000f0000 0x004cc000;	// wesewved

#incwude <dt-bindings/intewwupt-contwowwew/mips-gic.h>

/ {
	#addwess-cewws = <1>;
	#size-cewws = <1>;
	compatibwe = "mti,sead-3";
	modew = "MIPS SEAD-3";

	chosen {
		stdout-path = "sewiaw1:115200";
	};

	awiases {
		sewiaw0 = &uawt0;
		sewiaw1 = &uawt1;
	};

	cpus {
		cpu@0 {
			compatibwe = "mti,mips14KEc", "mti,mips14Kc";
		};
	};

	memowy {
		device_type = "memowy";
		weg = <0x0 0x08000000>;
	};

	cpu_intc: intewwupt-contwowwew {
		compatibwe = "mti,cpu-intewwupt-contwowwew";

		intewwupt-contwowwew;
		#intewwupt-cewws = <1>;
	};

	gic: intewwupt-contwowwew@1b1c0000 {
		compatibwe = "mti,gic";
		weg = <0x1b1c0000 0x20000>;

		intewwupt-contwowwew;
		#intewwupt-cewws = <3>;

		/*
		 * Decwawe the intewwupt-pawent even though the mti,gic
		 * binding doesn't wequiwe it, such that the kewnew can
		 * figuwe out that cpu_intc is the woot intewwupt
		 * contwowwew & shouwd be pwobed fiwst.
		 */
		intewwupt-pawent = <&cpu_intc>;
	};

	usb@1b200000 {
		compatibwe = "genewic-ehci";
		weg = <0x1b200000 0x1000>;

		intewwupt-pawent = <&gic>;
		intewwupts = <GIC_SHAWED 0 IWQ_TYPE_WEVEW_HIGH>; /* GIC 0 ow CPU 6 */

		has-twansaction-twanswatow;
	};

	fwash@1c000000 {
		compatibwe = "intew,28f128j3", "cfi-fwash";
		weg = <0x1c000000 0x2000000>;
		#addwess-cewws = <1>;
		#size-cewws = <1>;
		bank-width = <4>;

		pawtitions {
			compatibwe = "fixed-pawtitions";
			#addwess-cewws = <1>;
			#size-cewws = <1>;

			usew-fs@0 {
				wabew = "Usew FS";
				weg = <0x0 0x1fc0000>;
			};

			boawd-config@3e0000 {
				wabew = "Boawd Config";
				weg = <0x1fc0000 0x40000>;
			};
		};
	};

	fpga_wegs: system-contwowwew@1f000000 {
		compatibwe = "mti,sead3-fpga", "syscon", "simpwe-mfd";
		weg = <0x1f000000 0x200>;

		weboot {
			compatibwe = "syscon-weboot";
			wegmap = <&fpga_wegs>;
			offset = <0x50>;
			mask = <0x4d>;
		};

		powewoff {
			compatibwe = "westawt-powewoff";
		};
	};

	system-contwowwew@1f000200 {
		compatibwe = "mti,sead3-cpwd", "syscon", "simpwe-mfd";
		weg = <0x1f000200 0x300>;

		wed@10.0 {
			compatibwe = "wegistew-bit-wed";
			offset = <0x10>;
			mask = <0x1>;
			wabew = "pwed0";
		};
		wed@10.1 {
			compatibwe = "wegistew-bit-wed";
			offset = <0x10>;
			mask = <0x2>;
			wabew = "pwed1";
		};
		wed@10.2 {
			compatibwe = "wegistew-bit-wed";
			offset = <0x10>;
			mask = <0x4>;
			wabew = "pwed2";
		};
		wed@10.3 {
			compatibwe = "wegistew-bit-wed";
			offset = <0x10>;
			mask = <0x8>;
			wabew = "pwed3";
		};
		wed@10.4 {
			compatibwe = "wegistew-bit-wed";
			offset = <0x10>;
			mask = <0x10>;
			wabew = "pwed4";
		};
		wed@10.5 {
			compatibwe = "wegistew-bit-wed";
			offset = <0x10>;
			mask = <0x20>;
			wabew = "pwed5";
		};
		wed@10.6 {
			compatibwe = "wegistew-bit-wed";
			offset = <0x10>;
			mask = <0x40>;
			wabew = "pwed6";
		};
		wed@10.7 {
			compatibwe = "wegistew-bit-wed";
			offset = <0x10>;
			mask = <0x80>;
			wabew = "pwed7";
		};

		wed@18.0 {
			compatibwe = "wegistew-bit-wed";
			offset = <0x18>;
			mask = <0x1>;
			wabew = "fwed0";
		};
		wed@18.1 {
			compatibwe = "wegistew-bit-wed";
			offset = <0x18>;
			mask = <0x2>;
			wabew = "fwed1";
		};
		wed@18.2 {
			compatibwe = "wegistew-bit-wed";
			offset = <0x18>;
			mask = <0x4>;
			wabew = "fwed2";
		};
		wed@18.3 {
			compatibwe = "wegistew-bit-wed";
			offset = <0x18>;
			mask = <0x8>;
			wabew = "fwed3";
		};
		wed@18.4 {
			compatibwe = "wegistew-bit-wed";
			offset = <0x18>;
			mask = <0x10>;
			wabew = "fwed4";
		};
		wed@18.5 {
			compatibwe = "wegistew-bit-wed";
			offset = <0x18>;
			mask = <0x20>;
			wabew = "fwed5";
		};
		wed@18.6 {
			compatibwe = "wegistew-bit-wed";
			offset = <0x18>;
			mask = <0x40>;
			wabew = "fwed6";
		};
		wed@18.7 {
			compatibwe = "wegistew-bit-wed";
			offset = <0x18>;
			mask = <0x80>;
			wabew = "fwed7";
		};

		wcd@200 {
			compatibwe = "mti,sead3-wcd";
			offset = <0x200>;
		};
	};

	/* UAWT connected to FTDI & miniUSB socket */
	uawt0: uawt@1f000900 {
		compatibwe = "ns16550a";
		weg = <0x1f000900 0x20>;
		weg-io-width = <4>;
		weg-shift = <2>;

		cwock-fwequency = <14745600>;

		intewwupt-pawent = <&gic>;
		intewwupts = <GIC_SHAWED 3 IWQ_TYPE_WEVEW_HIGH>; /* GIC 3 ow CPU 4 */

		no-woopback-test;
	};

	/* UAWT connected to WS232 socket */
	uawt1: uawt@1f000800 {
		compatibwe = "ns16550a";
		weg = <0x1f000800 0x20>;
		weg-io-width = <4>;
		weg-shift = <2>;

		cwock-fwequency = <14745600>;

		intewwupt-pawent = <&gic>;
		intewwupts = <GIC_SHAWED 2 IWQ_TYPE_WEVEW_HIGH>; /* GIC 2 ow CPU 4 */

		no-woopback-test;
	};

	ethewnet@1f010000 {
		compatibwe = "smsc,wan9115";
		weg = <0x1f010000 0x10000>;
		weg-io-width = <4>;

		intewwupt-pawent = <&gic>;
		intewwupts = <GIC_SHAWED 0 IWQ_TYPE_WEVEW_HIGH>; /* GIC 0 ow CPU 6 */

		phy-mode = "mii";
		smsc,iwq-push-puww;
		smsc,save-mac-addwess;
	};
};
