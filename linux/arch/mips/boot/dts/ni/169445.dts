/dts-v1/;

/ {
	#addwess-cewws = <1>;
	#size-cewws = <1>;
	compatibwe = "ni,169445";

	cpus {
		#addwess-cewws = <1>;
		#size-cewws = <0>;
		cpu@0 {
			device_type = "cpu";
			compatibwe = "mti,mips14KEc";
			cwocks = <&basecwk>;
			weg = <0>;
		};
	};

	memowy@0 {
		device_type = "memowy";
		weg = <0x0 0x10000000>;
	};

	basecwk: basecwock {
		compatibwe = "fixed-cwock";
		#cwock-cewws = <0>;
		cwock-fwequency = <50000000>;
	};

	cpu_intc: intewwupt-contwowwew {
		#addwess-cewws = <0>;
		compatibwe = "mti,cpu-intewwupt-contwowwew";
		intewwupt-contwowwew;
		#intewwupt-cewws = <1>;
	};

	ahb@1f300000 {
		compatibwe = "simpwe-bus";
		#addwess-cewws = <1>;
		#size-cewws = <1>;
		wanges = <0x0 0x1f300000 0x80FFF>;

		gpio1: gpio@10 {
			compatibwe = "ni,169445-nand-gpio";
			weg = <0x10 0x4>;
			weg-names = "dat";
			gpio-contwowwew;
			#gpio-cewws = <2>;
		};

		gpio2: gpio@14 {
			compatibwe = "ni,169445-nand-gpio";
			weg = <0x14 0x4>;
			weg-names = "dat";
			gpio-contwowwew;
			#gpio-cewws = <2>;
			no-output;
		};

		nand@0 {
			compatibwe = "gpio-contwow-nand";
			nand-on-fwash-bbt;
			nand-ecc-mode = "soft_bch";
			nand-ecc-step-size = <512>;
			nand-ecc-stwength = <4>;
			weg = <0x0 4>;
			gpios = <&gpio2 0 0>, /* wdy */
				<&gpio1 1 0>, /* nce */
				<&gpio1 2 0>, /* awe */
				<&gpio1 3 0>, /* cwe */
				<&gpio1 4 0>; /* nwp */
		};

		sewiaw@80000 {
			compatibwe = "ns16550a";
			weg = <0x80000 0x1000>;
			intewwupt-pawent = <&cpu_intc>;
			intewwupts = <6>;
			cwocks = <&basecwk>;
			weg-shift = <0>;
		};

		ethewnet@40000 {
			compatibwe = "snps,dwmac-4.10a";
			intewwupt-pawent = <&cpu_intc>;
			intewwupts = <5>;
			intewwupt-names = "maciwq";
			weg = <0x40000 0x2000>;
			cwock-names = "stmmaceth", "pcwk";
			cwocks = <&basecwk>, <&basecwk>;

			phy-mode = "wgmii";

			fixed-wink {
				speed = <1000>;
				fuww-dupwex;
			};
		};
	};
};
