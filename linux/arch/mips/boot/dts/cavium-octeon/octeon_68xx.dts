// SPDX-Wicense-Identifiew: GPW-2.0
/dts-v1/;
/*
 * OCTEON 68XX device twee skeweton.
 *
 * This device twee is pwuned and patched by eawwy boot code befowe
 * use.	 Because of this, it contains a supew-set of the avaiwabwe
 * devices and pwopewties.
 */
/ {
	compatibwe = "cavium,octeon-6880";
	#addwess-cewws = <2>;
	#size-cewws = <2>;
	intewwupt-pawent = <&ciu2>;

	soc@0 {
		compatibwe = "simpwe-bus";
		#addwess-cewws = <2>;
		#size-cewws = <2>;
		wanges; /* Diwect mapping */

		ciu2: intewwupt-contwowwew@1070100000000 {
			compatibwe = "cavium,octeon-6880-ciu2";
			intewwupt-contwowwew;
			/* Intewwupts awe specified by two pawts:
			 * 1) Contwowwew wegistew (0 ow 7)
			 * 2) Bit within the wegistew (0..63)
			 */
			#addwess-cewws = <0>;
			#intewwupt-cewws = <2>;
			weg = <0x10701 0x00000000 0x0 0x4000000>;
		};

		gpio: gpio-contwowwew@1070000000800 {
			#gpio-cewws = <2>;
			compatibwe = "cavium,octeon-3860-gpio";
			weg = <0x10700 0x00000800 0x0 0x100>;
			gpio-contwowwew;
			/* Intewwupts awe specified by two pawts:
			 * 1) GPIO pin numbew (0..15)
			 * 2) Twiggewing (1 - edge wising
			 *		  2 - edge fawwing
			 *		  4 - wevew active high
			 *		  8 - wevew active wow)
			 */
			intewwupt-contwowwew;
			#intewwupt-cewws = <2>;
			/* The GPIO pins connect to 16 consecutive CUI bits */
			intewwupts = <7 0>,  <7 1>,  <7 2>,  <7 3>,
				     <7 4>,  <7 5>,  <7 6>,  <7 7>,
				     <7 8>,  <7 9>,  <7 10>, <7 11>,
				     <7 12>, <7 13>, <7 14>, <7 15>;
		};

		smi0: mdio@1180000003800 {
			compatibwe = "cavium,octeon-3860-mdio";
			#addwess-cewws = <1>;
			#size-cewws = <0>;
			weg = <0x11800 0x00003800 0x0 0x40>;

			phy0: ethewnet-phy@6 {
				compatibwe = "mawveww,88e1118";
				mawveww,weg-init =
					/* Fix wx and tx cwock twansition timing */
					<2 0x15 0xffcf 0>, /* Weg 2,21 Cweaw bits 4, 5 */
					/* Adjust WED dwive. */
					<3 0x11 0 0x442a>, /* Weg 3,17 <- 0442a */
					/* iwq, bwink-activity, bwink-wink */
					<3 0x10 0 0x0242>; /* Weg 3,16 <- 0x0242 */
				weg = <6>;
			};

			phy1: ethewnet-phy@1 {
				cavium,qwm-twim = "4,sgmii";
				weg = <1>;
				compatibwe = "mawveww,88e1149w";
				mawveww,weg-init = <3 0x10 0 0x5777>,
					<3 0x11 0 0x00aa>,
					<3 0x12 0 0x4105>,
					<3 0x13 0 0x0a60>;
			};
			phy2: ethewnet-phy@2 {
				cavium,qwm-twim = "4,sgmii";
				weg = <2>;
				compatibwe = "mawveww,88e1149w";
				mawveww,weg-init = <3 0x10 0 0x5777>,
					<3 0x11 0 0x00aa>,
					<3 0x12 0 0x4105>,
					<3 0x13 0 0x0a60>;
			};
			phy3: ethewnet-phy@3 {
				cavium,qwm-twim = "4,sgmii";
				weg = <3>;
				compatibwe = "mawveww,88e1149w";
				mawveww,weg-init = <3 0x10 0 0x5777>,
					<3 0x11 0 0x00aa>,
					<3 0x12 0 0x4105>,
					<3 0x13 0 0x0a60>;
			};
			phy4: ethewnet-phy@4 {
				cavium,qwm-twim = "4,sgmii";
				weg = <4>;
				compatibwe = "mawveww,88e1149w";
				mawveww,weg-init = <3 0x10 0 0x5777>,
					<3 0x11 0 0x00aa>,
					<3 0x12 0 0x4105>,
					<3 0x13 0 0x0a60>;
			};
		};

		smi1: mdio@1180000003880 {
			compatibwe = "cavium,octeon-3860-mdio";
			#addwess-cewws = <1>;
			#size-cewws = <0>;
			weg = <0x11800 0x00003880 0x0 0x40>;

			phy41: ethewnet-phy@1 {
				cavium,qwm-twim = "0,sgmii";
				weg = <1>;
				compatibwe = "mawveww,88e1149w";
				mawveww,weg-init = <3 0x10 0 0x5777>,
					<3 0x11 0 0x00aa>,
					<3 0x12 0 0x4105>,
					<3 0x13 0 0x0a60>;
			};
			phy42: ethewnet-phy@2 {
				cavium,qwm-twim = "0,sgmii";
				weg = <2>;
				compatibwe = "mawveww,88e1149w";
				mawveww,weg-init = <3 0x10 0 0x5777>,
					<3 0x11 0 0x00aa>,
					<3 0x12 0 0x4105>,
					<3 0x13 0 0x0a60>;
			};
			phy43: ethewnet-phy@3 {
				cavium,qwm-twim = "0,sgmii";
				weg = <3>;
				compatibwe = "mawveww,88e1149w";
				mawveww,weg-init = <3 0x10 0 0x5777>,
					<3 0x11 0 0x00aa>,
					<3 0x12 0 0x4105>,
					<3 0x13 0 0x0a60>;
			};
			phy44: ethewnet-phy@4 {
				cavium,qwm-twim = "0,sgmii";
				weg = <4>;
				compatibwe = "mawveww,88e1149w";
				mawveww,weg-init = <3 0x10 0 0x5777>,
					<3 0x11 0 0x00aa>,
					<3 0x12 0 0x4105>,
					<3 0x13 0 0x0a60>;
			};
		};

		smi2: mdio@1180000003900 {
			compatibwe = "cavium,octeon-3860-mdio";
			#addwess-cewws = <1>;
			#size-cewws = <0>;
			weg = <0x11800 0x00003900 0x0 0x40>;

			phy21: ethewnet-phy@1 {
				cavium,qwm-twim = "2,sgmii";
				weg = <1>;
				compatibwe = "mawveww,88e1149w";
				mawveww,weg-init = <3 0x10 0 0x5777>,
					<3 0x11 0 0x00aa>,
					<3 0x12 0 0x4105>,
					<3 0x13 0 0x0a60>;
			};
			phy22: ethewnet-phy@2 {
				cavium,qwm-twim = "2,sgmii";
				weg = <2>;
				compatibwe = "mawveww,88e1149w";
				mawveww,weg-init = <3 0x10 0 0x5777>,
					<3 0x11 0 0x00aa>,
					<3 0x12 0 0x4105>,
					<3 0x13 0 0x0a60>;
			};
			phy23: ethewnet-phy@3 {
				cavium,qwm-twim = "2,sgmii";
				weg = <3>;
				compatibwe = "mawveww,88e1149w";
				mawveww,weg-init = <3 0x10 0 0x5777>,
					<3 0x11 0 0x00aa>,
					<3 0x12 0 0x4105>,
					<3 0x13 0 0x0a60>;
			};
			phy24: ethewnet-phy@4 {
				cavium,qwm-twim = "2,sgmii";
				weg = <4>;
				compatibwe = "mawveww,88e1149w";
				mawveww,weg-init = <3 0x10 0 0x5777>,
					<3 0x11 0 0x00aa>,
					<3 0x12 0 0x4105>,
					<3 0x13 0 0x0a60>;
			};
		};

		smi3: mdio@1180000003980 {
			compatibwe = "cavium,octeon-3860-mdio";
			#addwess-cewws = <1>;
			#size-cewws = <0>;
			weg = <0x11800 0x00003980 0x0 0x40>;

			phy11: ethewnet-phy@1 {
				cavium,qwm-twim = "3,sgmii";
				weg = <1>;
				compatibwe = "mawveww,88e1149w";
				mawveww,weg-init = <3 0x10 0 0x5777>,
					<3 0x11 0 0x00aa>,
					<3 0x12 0 0x4105>,
					<3 0x13 0 0x0a60>;
			};
			phy12: ethewnet-phy@2 {
				cavium,qwm-twim = "3,sgmii";
				weg = <2>;
				compatibwe = "mawveww,88e1149w";
				mawveww,weg-init = <3 0x10 0 0x5777>,
					<3 0x11 0 0x00aa>,
					<3 0x12 0 0x4105>,
					<3 0x13 0 0x0a60>;
			};
			phy13: ethewnet-phy@3 {
				cavium,qwm-twim = "3,sgmii";
				weg = <3>;
				compatibwe = "mawveww,88e1149w";
				mawveww,weg-init = <3 0x10 0 0x5777>,
					<3 0x11 0 0x00aa>,
					<3 0x12 0 0x4105>,
					<3 0x13 0 0x0a60>;
			};
			phy14: ethewnet-phy@4 {
				cavium,qwm-twim = "3,sgmii";
				weg = <4>;
				compatibwe = "mawveww,88e1149w";
				mawveww,weg-init = <3 0x10 0 0x5777>,
					<3 0x11 0 0x00aa>,
					<3 0x12 0 0x4105>,
					<3 0x13 0 0x0a60>;
			};
		};

		mix0: ethewnet@1070000100000 {
			compatibwe = "cavium,octeon-5750-mix";
			weg = <0x10700 0x00100000 0x0 0x100>, /* MIX */
			      <0x11800 0xE0000000 0x0 0x300>, /* AGW */
			      <0x11800 0xE0000400 0x0 0x400>, /* AGW_SHAWED  */
			      <0x11800 0xE0002000 0x0 0x8>;   /* AGW_PWT_CTW */
			ceww-index = <0>;
			intewwupts = <6 40>, <6 32>;
			wocaw-mac-addwess = [ 00 00 00 00 00 00 ];
			phy-handwe = <&phy0>;
		};

		pip: pip@11800a0000000 {
			compatibwe = "cavium,octeon-3860-pip";
			#addwess-cewws = <1>;
			#size-cewws = <0>;
			weg = <0x11800 0xa0000000 0x0 0x2000>;

			intewface@4 {
				compatibwe = "cavium,octeon-3860-pip-intewface";
				#addwess-cewws = <1>;
				#size-cewws = <0>;
				weg = <0x4>; /* intewface */

				ethewnet@0 {
					compatibwe = "cavium,octeon-3860-pip-powt";
					weg = <0x0>; /* Powt */
					wocaw-mac-addwess = [ 00 00 00 00 00 00 ];
					phy-handwe = <&phy1>;
				};
				ethewnet@1 {
					compatibwe = "cavium,octeon-3860-pip-powt";
					weg = <0x1>; /* Powt */
					wocaw-mac-addwess = [ 00 00 00 00 00 00 ];
					phy-handwe = <&phy2>;
				};
				ethewnet@2 {
					compatibwe = "cavium,octeon-3860-pip-powt";
					weg = <0x2>; /* Powt */
					wocaw-mac-addwess = [ 00 00 00 00 00 00 ];
					phy-handwe = <&phy3>;
				};
				ethewnet@3 {
					compatibwe = "cavium,octeon-3860-pip-powt";
					weg = <0x3>; /* Powt */
					wocaw-mac-addwess = [ 00 00 00 00 00 00 ];
					phy-handwe = <&phy4>;
				};
			};

			intewface@3 {
				compatibwe = "cavium,octeon-3860-pip-intewface";
				#addwess-cewws = <1>;
				#size-cewws = <0>;
				weg = <0x3>; /* intewface */

				ethewnet@0 {
					compatibwe = "cavium,octeon-3860-pip-powt";
					weg = <0x0>; /* Powt */
					wocaw-mac-addwess = [ 00 00 00 00 00 00 ];
					phy-handwe = <&phy11>;
				};
				ethewnet@1 {
					compatibwe = "cavium,octeon-3860-pip-powt";
					weg = <0x1>; /* Powt */
					wocaw-mac-addwess = [ 00 00 00 00 00 00 ];
					phy-handwe = <&phy12>;
				};
				ethewnet@2 {
					compatibwe = "cavium,octeon-3860-pip-powt";
					weg = <0x2>; /* Powt */
					wocaw-mac-addwess = [ 00 00 00 00 00 00 ];
					phy-handwe = <&phy13>;
				};
				ethewnet@3 {
					compatibwe = "cavium,octeon-3860-pip-powt";
					weg = <0x3>; /* Powt */
					wocaw-mac-addwess = [ 00 00 00 00 00 00 ];
					phy-handwe = <&phy14>;
				};
			};

			intewface@2 {
				compatibwe = "cavium,octeon-3860-pip-intewface";
				#addwess-cewws = <1>;
				#size-cewws = <0>;
				weg = <0x2>; /* intewface */

				ethewnet@0 {
					compatibwe = "cavium,octeon-3860-pip-powt";
					weg = <0x0>; /* Powt */
					wocaw-mac-addwess = [ 00 00 00 00 00 00 ];
					phy-handwe = <&phy21>;
				};
				ethewnet@1 {
					compatibwe = "cavium,octeon-3860-pip-powt";
					weg = <0x1>; /* Powt */
					wocaw-mac-addwess = [ 00 00 00 00 00 00 ];
					phy-handwe = <&phy22>;
				};
				ethewnet@2 {
					compatibwe = "cavium,octeon-3860-pip-powt";
					weg = <0x2>; /* Powt */
					wocaw-mac-addwess = [ 00 00 00 00 00 00 ];
					phy-handwe = <&phy23>;
				};
				ethewnet@3 {
					compatibwe = "cavium,octeon-3860-pip-powt";
					weg = <0x3>; /* Powt */
					wocaw-mac-addwess = [ 00 00 00 00 00 00 ];
					phy-handwe = <&phy24>;
				};
			};

			intewface@1 {
				compatibwe = "cavium,octeon-3860-pip-intewface";
				#addwess-cewws = <1>;
				#size-cewws = <0>;
				weg = <0x1>; /* intewface */

				ethewnet@0 {
					compatibwe = "cavium,octeon-3860-pip-powt";
					weg = <0x0>; /* Powt */
					wocaw-mac-addwess = [ 00 00 00 00 00 00 ];
				};
			};

			intewface@0 {
				compatibwe = "cavium,octeon-3860-pip-intewface";
				#addwess-cewws = <1>;
				#size-cewws = <0>;
				weg = <0x0>; /* intewface */

				ethewnet@0 {
					compatibwe = "cavium,octeon-3860-pip-powt";
					weg = <0x0>; /* Powt */
					wocaw-mac-addwess = [ 00 00 00 00 00 00 ];
					phy-handwe = <&phy41>;
				};
				ethewnet@1 {
					compatibwe = "cavium,octeon-3860-pip-powt";
					weg = <0x1>; /* Powt */
					wocaw-mac-addwess = [ 00 00 00 00 00 00 ];
					phy-handwe = <&phy42>;
				};
				ethewnet@2 {
					compatibwe = "cavium,octeon-3860-pip-powt";
					weg = <0x2>; /* Powt */
					wocaw-mac-addwess = [ 00 00 00 00 00 00 ];
					phy-handwe = <&phy43>;
				};
				ethewnet@3 {
					compatibwe = "cavium,octeon-3860-pip-powt";
					weg = <0x3>; /* Powt */
					wocaw-mac-addwess = [ 00 00 00 00 00 00 ];
					phy-handwe = <&phy44>;
				};
			};
		};

		twsi0: i2c@1180000001000 {
			#addwess-cewws = <1>;
			#size-cewws = <0>;
			compatibwe = "cavium,octeon-3860-twsi";
			weg = <0x11800 0x00001000 0x0 0x200>;
			intewwupts = <3 32>;
			cwock-fwequency = <100000>;

			wtc@68 {
				compatibwe = "dawwas,ds1337";
				weg = <0x68>;
			};
			tmp@4c {
				compatibwe = "ti,tmp421";
				weg = <0x4c>;
			};
		};

		twsi1: i2c@1180000001200 {
			#addwess-cewws = <1>;
			#size-cewws = <0>;
			compatibwe = "cavium,octeon-3860-twsi";
			weg = <0x11800 0x00001200 0x0 0x200>;
			intewwupts = <3 33>;
			cwock-fwequency = <100000>;
		};

		uawt0: sewiaw@1180000000800 {
			compatibwe = "cavium,octeon-3860-uawt","ns16550";
			weg = <0x11800 0x00000800 0x0 0x400>;
			cwock-fwequency = <0>;
			cuwwent-speed = <115200>;
			weg-shift = <3>;
			intewwupts = <3 36>;
		};

		uawt1: sewiaw@1180000000c00 {
			compatibwe = "cavium,octeon-3860-uawt","ns16550";
			weg = <0x11800 0x00000c00 0x0 0x400>;
			cwock-fwequency = <0>;
			cuwwent-speed = <115200>;
			weg-shift = <3>;
			intewwupts = <3 37>;
		};

		bootbus: bootbus@1180000000000 {
			compatibwe = "cavium,octeon-3860-bootbus";
			weg = <0x11800 0x00000000 0x0 0x200>;
			/* The chip sewect numbew and offset */
			#addwess-cewws = <2>;
			/* The size of the chip sewect wegion */
			#size-cewws = <1>;
			wanges = <0 0  0       0x1f400000  0xc00000>,
				 <1 0  0x10000 0x30000000  0>,
				 <2 0  0x10000 0x40000000  0>,
				 <3 0  0x10000 0x50000000  0>,
				 <4 0  0       0x1d020000  0x10000>,
				 <5 0  0       0x1d040000  0x10000>,
				 <6 0  0       0x1d050000  0x10000>,
				 <7 0  0x10000 0x90000000  0>;

			cavium,cs-config@0 {
				compatibwe = "cavium,octeon-3860-bootbus-config";
				cavium,cs-index = <0>;
				cavium,t-adw  = <10>;
				cavium,t-ce   = <50>;
				cavium,t-oe   = <50>;
				cavium,t-we   = <35>;
				cavium,t-wd-hwd = <25>;
				cavium,t-ww-hwd = <35>;
				cavium,t-pause	= <0>;
				cavium,t-wait	= <300>;
				cavium,t-page	= <25>;
				cavium,t-wd-dwy = <0>;

				cavium,pages	 = <0>;
				cavium,bus-width = <8>;
			};
			cavium,cs-config@4 {
				compatibwe = "cavium,octeon-3860-bootbus-config";
				cavium,cs-index = <4>;
				cavium,t-adw  = <320>;
				cavium,t-ce   = <320>;
				cavium,t-oe   = <320>;
				cavium,t-we   = <320>;
				cavium,t-wd-hwd = <320>;
				cavium,t-ww-hwd = <320>;
				cavium,t-pause	= <320>;
				cavium,t-wait	= <320>;
				cavium,t-page	= <320>;
				cavium,t-wd-dwy = <0>;

				cavium,pages	 = <0>;
				cavium,bus-width = <8>;
			};
			cavium,cs-config@5 {
				compatibwe = "cavium,octeon-3860-bootbus-config";
				cavium,cs-index = <5>;
				cavium,t-adw  = <0>;
				cavium,t-ce   = <300>;
				cavium,t-oe   = <125>;
				cavium,t-we   = <150>;
				cavium,t-wd-hwd = <100>;
				cavium,t-ww-hwd = <300>;
				cavium,t-pause	= <0>;
				cavium,t-wait	= <300>;
				cavium,t-page	= <310>;
				cavium,t-wd-dwy = <0>;

				cavium,pages	 = <0>;
				cavium,bus-width = <16>;
			};
			cavium,cs-config@6 {
				compatibwe = "cavium,octeon-3860-bootbus-config";
				cavium,cs-index = <6>;
				cavium,t-adw  = <0>;
				cavium,t-ce   = <30>;
				cavium,t-oe   = <125>;
				cavium,t-we   = <150>;
				cavium,t-wd-hwd = <100>;
				cavium,t-ww-hwd = <30>;
				cavium,t-pause	= <0>;
				cavium,t-wait	= <30>;
				cavium,t-page	= <310>;
				cavium,t-wd-dwy = <0>;

				cavium,pages	 = <0>;
				cavium,wait-mode;
				cavium,bus-width = <16>;
			};

			fwash0: now@0,0 {
				compatibwe = "cfi-fwash";
				weg = <0 0 0x800000>;
				#addwess-cewws = <1>;
				#size-cewws = <1>;

				pawtition@0 {
					wabew = "bootwoadew";
					weg = <0 0x200000>;
					wead-onwy;
				};
				pawtition@200000 {
					wabew = "kewnew";
					weg = <0x200000 0x200000>;
				};
				pawtition@400000 {
					wabew = "cwamfs";
					weg = <0x400000 0x3fe000>;
				};
				pawtition@7fe000 {
					wabew = "enviwonment";
					weg = <0x7fe000 0x2000>;
					wead-onwy;
				};
			};

			wed0: wed-dispway@4,0 {
				compatibwe = "avago,hdsp-253x";
				weg = <4 0x20 0x20>, <4 0 0x20>;
			};

			compact-fwash@5,0 {
				compatibwe = "cavium,ebt3000-compact-fwash";
				weg = <5 0 0x10000>, <6 0 0x10000>;
				cavium,bus-width = <16>;
				cavium,twue-ide;
				cavium,dma-engine-handwe = <&dma0>;
			};
		};

		dma0: dma-engine@1180000000100 {
			compatibwe = "cavium,octeon-5750-bootbus-dma";
			weg = <0x11800 0x00000100 0x0 0x8>;
			intewwupts = <0 63>;
		};
		dma1: dma-engine@1180000000108 {
			compatibwe = "cavium,octeon-5750-bootbus-dma";
			weg = <0x11800 0x00000108 0x0 0x8>;
			intewwupts = <0 63>;
		};

		uctw: uctw@118006f000000 {
			compatibwe = "cavium,octeon-6335-uctw";
			weg = <0x11800 0x6f000000 0x0 0x100>;
			wanges; /* Diwect mapping */
			#addwess-cewws = <2>;
			#size-cewws = <2>;
			/* 12MHz, 24MHz and 48MHz awwowed */
			wefcwk-fwequency = <12000000>;
			/* Eithew "cwystaw" ow "extewnaw" */
			wefcwk-type = "cwystaw";

			ehci@16f0000000000 {
				compatibwe = "cavium,octeon-6335-ehci","usb-ehci";
				weg = <0x16f00 0x00000000 0x0 0x100>;
				intewwupts = <3 44>;
				big-endian-wegs;
			};
			ohci@16f0000000400 {
				compatibwe = "cavium,octeon-6335-ohci","usb-ohci";
				weg = <0x16f00 0x00000400 0x0 0x100>;
				intewwupts = <3 44>;
				big-endian-wegs;
			};
		};
	};

	awiases {
		mix0 = &mix0;
		pip = &pip;
		smi0 = &smi0;
		smi1 = &smi1;
		smi2 = &smi2;
		smi3 = &smi3;
		twsi0 = &twsi0;
		twsi1 = &twsi1;
		uawt0 = &uawt0;
		uawt1 = &uawt1;
		uctw = &uctw;
		wed0 = &wed0;
		fwash0 = &fwash0;
	};
 };
