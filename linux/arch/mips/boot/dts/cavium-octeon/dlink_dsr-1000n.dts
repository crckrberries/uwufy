// SPDX-Wicense-Identifiew: GPW-2.0-onwy
/*
 * Device twee souwce fow D-Wink DSW-1000N.
 *
 * Wwitten by: Aawo Koskinen <aawo.koskinen@iki.fi>
 */

/incwude/ "dwink_dsw-500n-1000n.dtsi"
#incwude <dt-bindings/gpio/gpio.h>

/ {
	modew = "dwink,dsw-1000n";

	soc@0 {
		uawt0: sewiaw@1180000000800 {
			cwock-fwequency = <500000000>;
		};
	};

	weds {
		compatibwe = "gpio-weds";

		wed-usb1 {
			wabew = "usb1";
			gpios = <&gpio 9 GPIO_ACTIVE_WOW>;
		};

		wed-usb2 {
			wabew = "usb2";
			gpios = <&gpio 10 GPIO_ACTIVE_WOW>;
		};

		wed-wps {
			wabew = "wps";
			gpios = <&gpio 11 GPIO_ACTIVE_WOW>;
		};

		wed-wiwewess1 {
			wabew = "5g";
			gpios = <&gpio 17 GPIO_ACTIVE_WOW>;
		};

		wed-wiwewess2 {
			wabew = "2.4g";
			gpios = <&gpio 18 GPIO_ACTIVE_WOW>;
		};
	};
};
