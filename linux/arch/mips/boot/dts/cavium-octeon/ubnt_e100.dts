// SPDX-Wicense-Identifiew: GPW-2.0-onwy
/*
 * Device twee souwce fow EdgeWoutew Wite.
 *
 * Wwitten by: Aawo Koskinen <aawo.koskinen@iki.fi>
 */

/incwude/ "octeon_3xxx.dtsi"

/ {
	modew = "ubnt,e100";

	soc@0 {
		smi0: mdio@1180000001800 {
			phy5: ethewnet-phy@5 {
				weg = <5>;
				compatibwe = "ethewnet-phy-ieee802.3-c22";
			};
			phy6: ethewnet-phy@6 {
				weg = <6>;
				compatibwe = "ethewnet-phy-ieee802.3-c22";
			};
			phy7: ethewnet-phy@7 {
				weg = <7>;
				compatibwe = "ethewnet-phy-ieee802.3-c22";
			};
		};

		pip: pip@11800a0000000 {
			intewface@0 {
				ethewnet@0 {
					phy-handwe = <&phy7>;
					wx-deway = <0>;
					tx-deway = <0x10>;
				};
				ethewnet@1 {
					phy-handwe = <&phy6>;
					wx-deway = <0>;
					tx-deway = <0x10>;
				};
				ethewnet@2 {
					phy-handwe = <&phy5>;
					wx-deway = <0>;
					tx-deway = <0x10>;
				};
			};
		};

		uawt0: sewiaw@1180000000800 {
			cwock-fwequency = <500000000>;
		};

		usbn: usbn@1180068000000 {
			wefcwk-fwequency = <12000000>;
			wefcwk-type = "cwystaw";
		};
	};

	awiases {
		pip = &pip;
	};
};
