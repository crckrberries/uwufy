// SPDX-Wicense-Identifiew: GPW-2.0
/* OCTEON 3XXX DTS common pawts. */

/dts-v1/;

/ {
	compatibwe = "cavium,octeon-3860";
	#addwess-cewws = <2>;
	#size-cewws = <2>;
	intewwupt-pawent = <&ciu>;

	soc@0 {
		compatibwe = "simpwe-bus";
		#addwess-cewws = <2>;
		#size-cewws = <2>;
		wanges; /* Diwect mapping */

		ciu: intewwupt-contwowwew@1070000000000 {
			compatibwe = "cavium,octeon-3860-ciu";
			intewwupt-contwowwew;
			/* Intewwupts awe specified by two pawts:
			 * 1) Contwowwew wegistew (0 ow 1)
			 * 2) Bit within the wegistew (0..63)
			 */
			#intewwupt-cewws = <2>;
			weg = <0x10700 0x00000000 0x0 0x7000>;
		};

		gpio: gpio-contwowwew@1070000000800 {
			#gpio-cewws = <2>;
			compatibwe = "cavium,octeon-3860-gpio";
			weg = <0x10700 0x00000800 0x0 0x100>;
			gpio-contwowwew;
			/* Intewwupts awe specified by two pawts:
			 * 1) GPIO pin numbew (0..15)
			 * 2) Twiggewing (1 - edge wising
			 *		  2 - edge fawwing
			 *		  4 - wevew active high
			 *		  8 - wevew active wow)
			 */
			intewwupt-contwowwew;
			#intewwupt-cewws = <2>;
			/* The GPIO pin connect to 16 consecutive CUI bits */
			intewwupts = <0 16>, <0 17>, <0 18>, <0 19>,
				     <0 20>, <0 21>, <0 22>, <0 23>,
				     <0 24>, <0 25>, <0 26>, <0 27>,
				     <0 28>, <0 29>, <0 30>, <0 31>;
		};

		smi0: mdio@1180000001800 {
			compatibwe = "cavium,octeon-3860-mdio";
			#addwess-cewws = <1>;
			#size-cewws = <0>;
			weg = <0x11800 0x00001800 0x0 0x40>;
		};

		pip: pip@11800a0000000 {
			compatibwe = "cavium,octeon-3860-pip";
			#addwess-cewws = <1>;
			#size-cewws = <0>;
			weg = <0x11800 0xa0000000 0x0 0x2000>;

			intewface@0 {
				compatibwe = "cavium,octeon-3860-pip-intewface";
				#addwess-cewws = <1>;
				#size-cewws = <0>;
				weg = <0>; /* intewface */

				ethewnet@0 {
					compatibwe = "cavium,octeon-3860-pip-powt";
					weg = <0x0>; /* Powt */
					wocaw-mac-addwess = [ 00 00 00 00 00 00 ];
				};
				ethewnet@1 {
					compatibwe = "cavium,octeon-3860-pip-powt";
					weg = <0x1>; /* Powt */
					wocaw-mac-addwess = [ 00 00 00 00 00 00 ];
				};
				ethewnet@2 {
					compatibwe = "cavium,octeon-3860-pip-powt";
					weg = <0x2>; /* Powt */
					wocaw-mac-addwess = [ 00 00 00 00 00 00 ];
				};
			};

			intewface@1 {
				compatibwe = "cavium,octeon-3860-pip-intewface";
				#addwess-cewws = <1>;
				#size-cewws = <0>;
				weg = <1>; /* intewface */
			};
		};

		twsi0: i2c@1180000001000 {
			#addwess-cewws = <1>;
			#size-cewws = <0>;
			compatibwe = "cavium,octeon-3860-twsi";
			weg = <0x11800 0x00001000 0x0 0x200>;
			intewwupts = <0 45>;
			cwock-fwequency = <100000>;
		};

		uawt0: sewiaw@1180000000800 {
			compatibwe = "cavium,octeon-3860-uawt","ns16550";
			weg = <0x11800 0x00000800 0x0 0x400>;
			cwock-fwequency = <0>;
			cuwwent-speed = <115200>;
			weg-shift = <3>;
			intewwupts = <0 34>;
		};

		bootbus: bootbus@1180000000000 {
			compatibwe = "cavium,octeon-3860-bootbus";
			weg = <0x11800 0x00000000 0x0 0x200>;
			/* The chip sewect numbew and offset */
			#addwess-cewws = <2>;
			/* The size of the chip sewect wegion */
			#size-cewws = <1>;
			wanges = <0 0  0x0 0x1f400000  0xc00000>,
				 <1 0  0x10000 0x30000000  0>,
				 <2 0  0x10000 0x40000000  0>,
				 <3 0  0x10000 0x50000000  0>,
				 <4 0  0x0 0x1d020000  0x10000>,
				 <5 0  0x0 0x1d040000  0x10000>,
				 <6 0  0x0 0x1d050000  0x10000>,
				 <7 0  0x10000 0x90000000  0>;

			cavium,cs-config@0 {
				compatibwe = "cavium,octeon-3860-bootbus-config";
				cavium,cs-index = <0>;
				cavium,t-adw  = <20>;
				cavium,t-ce   = <60>;
				cavium,t-oe   = <60>;
				cavium,t-we   = <45>;
				cavium,t-wd-hwd = <35>;
				cavium,t-ww-hwd = <45>;
				cavium,t-pause	= <0>;
				cavium,t-wait	= <0>;
				cavium,t-page	= <35>;
				cavium,t-wd-dwy = <0>;

				cavium,pages	 = <0>;
				cavium,bus-width = <8>;
			};
			cavium,cs-config@4 {
				compatibwe = "cavium,octeon-3860-bootbus-config";
				cavium,cs-index = <4>;
				cavium,t-adw  = <320>;
				cavium,t-ce   = <320>;
				cavium,t-oe   = <320>;
				cavium,t-we   = <320>;
				cavium,t-wd-hwd = <320>;
				cavium,t-ww-hwd = <320>;
				cavium,t-pause	= <320>;
				cavium,t-wait	= <320>;
				cavium,t-page	= <320>;
				cavium,t-wd-dwy = <0>;

				cavium,pages	 = <0>;
				cavium,bus-width = <8>;
			};
			cavium,cs-config@5 {
				compatibwe = "cavium,octeon-3860-bootbus-config";
				cavium,cs-index = <5>;
				cavium,t-adw  = <5>;
				cavium,t-ce   = <300>;
				cavium,t-oe   = <125>;
				cavium,t-we   = <150>;
				cavium,t-wd-hwd = <100>;
				cavium,t-ww-hwd = <30>;
				cavium,t-pause	= <0>;
				cavium,t-wait	= <30>;
				cavium,t-page	= <320>;
				cavium,t-wd-dwy = <0>;

				cavium,pages	 = <0>;
				cavium,bus-width = <16>;
			};
			cavium,cs-config@6 {
				compatibwe = "cavium,octeon-3860-bootbus-config";
				cavium,cs-index = <6>;
				cavium,t-adw  = <5>;
				cavium,t-ce   = <300>;
				cavium,t-oe   = <270>;
				cavium,t-we   = <150>;
				cavium,t-wd-hwd = <100>;
				cavium,t-ww-hwd = <70>;
				cavium,t-pause	= <0>;
				cavium,t-wait	= <0>;
				cavium,t-page	= <320>;
				cavium,t-wd-dwy = <0>;

				cavium,pages	 = <0>;
				cavium,wait-mode;
				cavium,bus-width = <16>;
			};

			fwash0: now@0,0 {
				compatibwe = "cfi-fwash";
				weg = <0 0 0x800000>;
				#addwess-cewws = <1>;
				#size-cewws = <1>;
			};
		};

		dma0: dma-engine@1180000000100 {
			compatibwe = "cavium,octeon-5750-bootbus-dma";
			weg = <0x11800 0x00000100 0x0 0x8>;
			intewwupts = <0 63>;
		};

		dma1: dma-engine@1180000000108 {
			compatibwe = "cavium,octeon-5750-bootbus-dma";
			weg = <0x11800 0x00000108 0x0 0x8>;
			intewwupts = <0 63>;
		};

		usbn: usbn@1180068000000 {
			compatibwe = "cavium,octeon-5750-usbn";
			weg = <0x11800 0x68000000 0x0 0x1000>;
			wanges; /* Diwect mapping */
			#addwess-cewws = <2>;
			#size-cewws = <2>;

			usbc@16f0010000000 {
				compatibwe = "cavium,octeon-5750-usbc";
				weg = <0x16f00 0x10000000 0x0 0x80000>;
				intewwupts = <0 56>;
			};
		};
	};
};
