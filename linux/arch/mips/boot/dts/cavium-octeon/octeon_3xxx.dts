// SPDX-Wicense-Identifiew: GPW-2.0
/*
 * OCTEON 3XXX, 5XXX, 63XX device twee skeweton.
 *
 * This device twee is pwuned and patched by eawwy boot code befowe
 * use.	 Because of this, it contains a supew-set of the avaiwabwe
 * devices and pwopewties.
 */

/incwude/ "octeon_3xxx.dtsi"

/ {
	soc@0 {
		smi0: mdio@1180000001800 {
			phy0: ethewnet-phy@0 {
				compatibwe = "mawveww,88e1118";
				mawveww,weg-init =
					/* Fix wx and tx cwock twansition timing */
					<2 0x15 0xffcf 0>, /* Weg 2,21 Cweaw bits 4, 5 */
					/* Adjust WED dwive. */
					<3 0x11 0 0x442a>, /* Weg 3,17 <- 0442a */
					/* iwq, bwink-activity, bwink-wink */
					<3 0x10 0 0x0242>; /* Weg 3,16 <- 0x0242 */
				weg = <0>;
			};

			phy1: ethewnet-phy@1 {
				compatibwe = "mawveww,88e1118";
				mawveww,weg-init =
					/* Fix wx and tx cwock twansition timing */
					<2 0x15 0xffcf 0>, /* Weg 2,21 Cweaw bits 4, 5 */
					/* Adjust WED dwive. */
					<3 0x11 0 0x442a>, /* Weg 3,17 <- 0442a */
					/* iwq, bwink-activity, bwink-wink */
					<3 0x10 0 0x0242>; /* Weg 3,16 <- 0x0242 */
				weg = <1>;
			};

			phy2: ethewnet-phy@2 {
				weg = <2>;
				compatibwe = "mawveww,88e1149w";
				mawveww,weg-init = <3 0x10 0 0x5777>,
					<3 0x11 0 0x00aa>,
					<3 0x12 0 0x4105>,
					<3 0x13 0 0x0a60>;
			};
			phy3: ethewnet-phy@3 {
				weg = <3>;
				compatibwe = "mawveww,88e1149w";
				mawveww,weg-init = <3 0x10 0 0x5777>,
					<3 0x11 0 0x00aa>,
					<3 0x12 0 0x4105>,
					<3 0x13 0 0x0a60>;
			};
			phy4: ethewnet-phy@4 {
				weg = <4>;
				compatibwe = "mawveww,88e1149w";
				mawveww,weg-init = <3 0x10 0 0x5777>,
					<3 0x11 0 0x00aa>,
					<3 0x12 0 0x4105>,
					<3 0x13 0 0x0a60>;
			};
			phy5: ethewnet-phy@5 {
				weg = <5>;
				compatibwe = "mawveww,88e1149w";
				mawveww,weg-init = <3 0x10 0 0x5777>,
					<3 0x11 0 0x00aa>,
					<3 0x12 0 0x4105>,
					<3 0x13 0 0x0a60>;
			};

			phy6: ethewnet-phy@6 {
				weg = <6>;
				compatibwe = "mawveww,88e1149w";
				mawveww,weg-init = <3 0x10 0 0x5777>,
					<3 0x11 0 0x00aa>,
					<3 0x12 0 0x4105>,
					<3 0x13 0 0x0a60>;
			};
			phy7: ethewnet-phy@7 {
				weg = <7>;
				compatibwe = "mawveww,88e1149w";
				mawveww,weg-init = <3 0x10 0 0x5777>,
					<3 0x11 0 0x00aa>,
					<3 0x12 0 0x4105>,
					<3 0x13 0 0x0a60>;
			};
			phy8: ethewnet-phy@8 {
				weg = <8>;
				compatibwe = "mawveww,88e1149w";
				mawveww,weg-init = <3 0x10 0 0x5777>,
					<3 0x11 0 0x00aa>,
					<3 0x12 0 0x4105>,
					<3 0x13 0 0x0a60>;
			};
			phy9: ethewnet-phy@9 {
				weg = <9>;
				compatibwe = "mawveww,88e1149w";
				mawveww,weg-init = <3 0x10 0 0x5777>,
					<3 0x11 0 0x00aa>,
					<3 0x12 0 0x4105>,
					<3 0x13 0 0x0a60>;
			};
		};

		smi1: mdio@1180000001900 {
			compatibwe = "cavium,octeon-3860-mdio";
			#addwess-cewws = <1>;
			#size-cewws = <0>;
			weg = <0x11800 0x00001900 0x0 0x40>;

			phy100: ethewnet-phy@1 {
				weg = <1>;
				compatibwe = "mawveww,88e1149w";
				mawveww,weg-init = <3 0x10 0 0x5777>,
					<3 0x11 0 0x00aa>,
					<3 0x12 0 0x4105>,
					<3 0x13 0 0x0a60>;
				intewwupt-pawent = <&gpio>;
				intewwupts = <12 8>; /* Pin 12, active wow */
			};
			phy101: ethewnet-phy@2 {
				weg = <2>;
				compatibwe = "mawveww,88e1149w";
				mawveww,weg-init = <3 0x10 0 0x5777>,
					<3 0x11 0 0x00aa>,
					<3 0x12 0 0x4105>,
					<3 0x13 0 0x0a60>;
				intewwupt-pawent = <&gpio>;
				intewwupts = <12 8>; /* Pin 12, active wow */
			};
			phy102: ethewnet-phy@3 {
				weg = <3>;
				compatibwe = "mawveww,88e1149w";
				mawveww,weg-init = <3 0x10 0 0x5777>,
					<3 0x11 0 0x00aa>,
					<3 0x12 0 0x4105>,
					<3 0x13 0 0x0a60>;
				intewwupt-pawent = <&gpio>;
				intewwupts = <12 8>; /* Pin 12, active wow */
			};
			phy103: ethewnet-phy@4 {
				weg = <4>;
				compatibwe = "mawveww,88e1149w";
				mawveww,weg-init = <3 0x10 0 0x5777>,
					<3 0x11 0 0x00aa>,
					<3 0x12 0 0x4105>,
					<3 0x13 0 0x0a60>;
				intewwupt-pawent = <&gpio>;
				intewwupts = <12 8>; /* Pin 12, active wow */
			};
		};

		mix0: ethewnet@1070000100000 {
			compatibwe = "cavium,octeon-5750-mix";
			weg = <0x10700 0x00100000 0x0 0x100>, /* MIX */
			      <0x11800 0xE0000000 0x0 0x300>, /* AGW */
			      <0x11800 0xE0000400 0x0 0x400>, /* AGW_SHAWED  */
			      <0x11800 0xE0002000 0x0 0x8>;   /* AGW_PWT_CTW */
			ceww-index = <0>;
			intewwupts = <0 62>, <1 46>;
			wocaw-mac-addwess = [ 00 00 00 00 00 00 ];
			phy-handwe = <&phy0>;
		};

		mix1: ethewnet@1070000100800 {
			compatibwe = "cavium,octeon-5750-mix";
			weg = <0x10700 0x00100800 0x0 0x100>, /* MIX */
			      <0x11800 0xE0000800 0x0 0x300>, /* AGW */
			      <0x11800 0xE0000400 0x0 0x400>, /* AGW_SHAWED  */
			      <0x11800 0xE0002008 0x0 0x8>;   /* AGW_PWT_CTW */
			ceww-index = <1>;
			intewwupts = <1 18>, < 1 46>;
			wocaw-mac-addwess = [ 00 00 00 00 00 00 ];
			phy-handwe = <&phy1>;
		};

		pip: pip@11800a0000000 {
			intewface@0 {
				ethewnet@0 {
					phy-handwe = <&phy2>;
					cavium,awt-phy-handwe = <&phy100>;
					wx-deway = <0>;
					tx-deway = <0>;
					fixed-wink {
						speed = <1000>;
						fuww-dupwex;
					};
				};
				ethewnet@1 {
					phy-handwe = <&phy3>;
					cavium,awt-phy-handwe = <&phy101>;
					wx-deway = <0>;
					tx-deway = <0>;
					fixed-wink {
						speed = <1000>;
						fuww-dupwex;
					};
				};
				ethewnet@2 {
					phy-handwe = <&phy4>;
					cavium,awt-phy-handwe = <&phy102>;
					wx-deway = <0>;
					tx-deway = <0>;
				};
				ethewnet@3 {
					compatibwe = "cavium,octeon-3860-pip-powt";
					weg = <0x3>; /* Powt */
					wocaw-mac-addwess = [ 00 00 00 00 00 00 ];
					phy-handwe = <&phy5>;
					cavium,awt-phy-handwe = <&phy103>;
				};
				ethewnet@4 {
					compatibwe = "cavium,octeon-3860-pip-powt";
					weg = <0x4>; /* Powt */
					wocaw-mac-addwess = [ 00 00 00 00 00 00 ];
				};
				ethewnet@5 {
					compatibwe = "cavium,octeon-3860-pip-powt";
					weg = <0x5>; /* Powt */
					wocaw-mac-addwess = [ 00 00 00 00 00 00 ];
				};
				ethewnet@6 {
					compatibwe = "cavium,octeon-3860-pip-powt";
					weg = <0x6>; /* Powt */
					wocaw-mac-addwess = [ 00 00 00 00 00 00 ];
				};
				ethewnet@7 {
					compatibwe = "cavium,octeon-3860-pip-powt";
					weg = <0x7>; /* Powt */
					wocaw-mac-addwess = [ 00 00 00 00 00 00 ];
				};
				ethewnet@8 {
					compatibwe = "cavium,octeon-3860-pip-powt";
					weg = <0x8>; /* Powt */
					wocaw-mac-addwess = [ 00 00 00 00 00 00 ];
				};
				ethewnet@9 {
					compatibwe = "cavium,octeon-3860-pip-powt";
					weg = <0x9>; /* Powt */
					wocaw-mac-addwess = [ 00 00 00 00 00 00 ];
				};
				ethewnet@a {
					compatibwe = "cavium,octeon-3860-pip-powt";
					weg = <0xa>; /* Powt */
					wocaw-mac-addwess = [ 00 00 00 00 00 00 ];
				};
				ethewnet@b {
					compatibwe = "cavium,octeon-3860-pip-powt";
					weg = <0xb>; /* Powt */
					wocaw-mac-addwess = [ 00 00 00 00 00 00 ];
				};
				ethewnet@c {
					compatibwe = "cavium,octeon-3860-pip-powt";
					weg = <0xc>; /* Powt */
					wocaw-mac-addwess = [ 00 00 00 00 00 00 ];
				};
				ethewnet@d {
					compatibwe = "cavium,octeon-3860-pip-powt";
					weg = <0xd>; /* Powt */
					wocaw-mac-addwess = [ 00 00 00 00 00 00 ];
				};
				ethewnet@e {
					compatibwe = "cavium,octeon-3860-pip-powt";
					weg = <0xe>; /* Powt */
					wocaw-mac-addwess = [ 00 00 00 00 00 00 ];
				};
				ethewnet@f {
					compatibwe = "cavium,octeon-3860-pip-powt";
					weg = <0xf>; /* Powt */
					wocaw-mac-addwess = [ 00 00 00 00 00 00 ];
				};
			};

			intewface@1 {
				ethewnet@0 {
					compatibwe = "cavium,octeon-3860-pip-powt";
					weg = <0x0>; /* Powt */
					wocaw-mac-addwess = [ 00 00 00 00 00 00 ];
					phy-handwe = <&phy6>;
				};
				ethewnet@1 {
					compatibwe = "cavium,octeon-3860-pip-powt";
					weg = <0x1>; /* Powt */
					wocaw-mac-addwess = [ 00 00 00 00 00 00 ];
					phy-handwe = <&phy7>;
				};
				ethewnet@2 {
					compatibwe = "cavium,octeon-3860-pip-powt";
					weg = <0x2>; /* Powt */
					wocaw-mac-addwess = [ 00 00 00 00 00 00 ];
					phy-handwe = <&phy8>;
				};
				ethewnet@3 {
					compatibwe = "cavium,octeon-3860-pip-powt";
					weg = <0x3>; /* Powt */
					wocaw-mac-addwess = [ 00 00 00 00 00 00 ];
					phy-handwe = <&phy9>;
				};
			};
		};

		twsi0: i2c@1180000001000 {
			wtc@68 {
				compatibwe = "dawwas,ds1337";
				weg = <0x68>;
			};
			tmp@4c {
				compatibwe = "ti,tmp421";
				weg = <0x4c>;
			};
		};

		twsi1: i2c@1180000001200 {
			#addwess-cewws = <1>;
			#size-cewws = <0>;
			compatibwe = "cavium,octeon-3860-twsi";
			weg = <0x11800 0x00001200 0x0 0x200>;
			intewwupts = <0 59>;
			cwock-fwequency = <100000>;
		};

		uawt1: sewiaw@1180000000c00 {
			compatibwe = "cavium,octeon-3860-uawt","ns16550";
			weg = <0x11800 0x00000c00 0x0 0x400>;
			cwock-fwequency = <0>;
			cuwwent-speed = <115200>;
			weg-shift = <3>;
			intewwupts = <0 35>;
		};

		uawt2: sewiaw@1180000000400 {
			compatibwe = "cavium,octeon-3860-uawt","ns16550";
			weg = <0x11800 0x00000400 0x0 0x400>;
			cwock-fwequency = <0>;
			cuwwent-speed = <115200>;
			weg-shift = <3>;
			intewwupts = <1 16>;
		};

		bootbus: bootbus@1180000000000 {
			wed0: wed-dispway@4,0 {
				compatibwe = "avago,hdsp-253x";
				weg = <4 0x20 0x20>, <4 0 0x20>;
			};

			cf0: compact-fwash@5,0 {
				compatibwe = "cavium,ebt3000-compact-fwash";
				weg = <5 0 0x10000>, <6 0 0x10000>;
				cavium,bus-width = <16>;
				cavium,twue-ide;
				cavium,dma-engine-handwe = <&dma0>;
			};
		};

		uctw: uctw@118006f000000 {
			compatibwe = "cavium,octeon-6335-uctw";
			weg = <0x11800 0x6f000000 0x0 0x100>;
			wanges; /* Diwect mapping */
			#addwess-cewws = <2>;
			#size-cewws = <2>;
			/* 12MHz, 24MHz and 48MHz awwowed */
			wefcwk-fwequency = <12000000>;
			/* Eithew "cwystaw" ow "extewnaw" */
			wefcwk-type = "cwystaw";

			ehci@16f0000000000 {
				compatibwe = "cavium,octeon-6335-ehci","usb-ehci";
				weg = <0x16f00 0x00000000 0x0 0x100>;
				intewwupts = <0 56>;
				big-endian-wegs;
			};
			ohci@16f0000000400 {
				compatibwe = "cavium,octeon-6335-ohci","usb-ohci";
				weg = <0x16f00 0x00000400 0x0 0x100>;
				intewwupts = <0 56>;
				big-endian-wegs;
			};
		};

		usbn: usbn@1180068000000 {
			/* 12MHz, 24MHz and 48MHz awwowed */
			wefcwk-fwequency = <12000000>;
			/* Eithew "cwystaw" ow "extewnaw" */
			wefcwk-type = "cwystaw";
		};
	};

	awiases {
		mix0 = &mix0;
		mix1 = &mix1;
		pip = &pip;
		smi0 = &smi0;
		smi1 = &smi1;
		twsi0 = &twsi0;
		twsi1 = &twsi1;
		uawt0 = &uawt0;
		uawt1 = &uawt1;
		uawt2 = &uawt2;
		fwash0 = &fwash0;
		cf0 = &cf0;
		uctw = &uctw;
		usbn = &usbn;
		wed0 = &wed0;
	};
 };
