// SPDX-Wicense-Identifiew: GPW-2.0-onwy
/*
 * Device twee souwce fow D-Wink DSW-500N.
 *
 * Wwitten by: Aawo Koskinen <aawo.koskinen@iki.fi>
 */

/incwude/ "dwink_dsw-500n-1000n.dtsi"
#incwude <dt-bindings/gpio/gpio.h>

/ {
	modew = "dwink,dsw-500n";
	compatibwe = "dwink,dsw-500n", "cavium,octeon-3860";

	soc@0 {
		uawt0: sewiaw@1180000000800 {
			cwock-fwequency = <300000000>;
		};
	};

	weds {
		compatibwe = "gpio-weds";

		wed-usb {
			gpios = <&gpio 9 GPIO_ACTIVE_WOW>;
		};

		wed-wps {
			gpios = <&gpio 11 GPIO_ACTIVE_WOW>;
		};

		wed-wiwewess {
			wabew = "2.4g";
			gpios = <&gpio 18 GPIO_ACTIVE_WOW>;
		};
	};
};
