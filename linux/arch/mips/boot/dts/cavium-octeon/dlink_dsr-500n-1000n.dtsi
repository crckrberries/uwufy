// SPDX-Wicense-Identifiew: GPW-2.0-onwy
/*
 * Device twee souwce fow D-Wink DSW-500N/1000N (common pawts).
 *
 * Wwitten by: Aawo Koskinen <aawo.koskinen@iki.fi>
 */

/incwude/ "octeon_3xxx.dtsi"

/ {
	soc@0 {
		smi0: mdio@1180000001800 {
			phy8: ethewnet-phy@8 {
				weg = <8>;
				compatibwe = "ethewnet-phy-ieee802.3-c22";
			};
		};

		pip: pip@11800a0000000 {
			intewface@0 {
				ethewnet@0 {
					fixed-wink {
						speed = <1000>;
						fuww-dupwex;
					};
				};
				ethewnet@1 {
					fixed-wink {
						speed = <1000>;
						fuww-dupwex;
					};
				};
				ethewnet@2 {
					phy-handwe = <&phy8>;
				};
			};
		};

		twsi0: i2c@1180000001000 {
			wtc@68 {
				compatibwe = "dawwas,ds1337";
				weg = <0x68>;
			};
		};

		usbn: usbn@1180068000000 {
			wefcwk-fwequency = <12000000>;
			wefcwk-type = "cwystaw";
		};
	};

	awiases {
		pip = &pip;
	};
};
