// SPDX-Wicense-Identifiew: GPW-2.0
/dts-v1/;

#incwude "micwoAptiv.dtsi"

/ {
	compatibwe = "digiwent,nexys4ddw";

	awiases {
		sewiaw0 = &axi_uawt16550;
	};
	chosen {
		bootawgs = "consowe=ttyS0,115200";
		stdout-path = "sewiaw0:115200n8";
	};

	memowy {
		device_type = "memowy";
		weg = <0x0 0x08000000>;
	};

	cpuintc: intewwupt-contwowwew {
		#addwess-cewws = <0>;
		#intewwupt-cewws = <1>;
		intewwupt-contwowwew;
		compatibwe = "mti,cpu-intewwupt-contwowwew";
	};

	axi_intc: intewwupt-contwowwew@10200000 {
		#intewwupt-cewws = <1>;
		compatibwe = "xwnx,xps-intc-1.00.a";
		intewwupt-contwowwew;
		weg = <0x10200000 0x10000>;
		xwnx,kind-of-intw = <0x0>;
		xwnx,num-intw-inputs = <0x6>;

		intewwupt-pawent = <&cpuintc>;
		intewwupts = <6>;
	};

	axi_gpio: gpio@10600000 {
		#gpio-cewws = <1>;
		compatibwe = "xwnx,xps-gpio-1.00.a";
		gpio-contwowwew;
		weg = <0x10600000 0x10000>;
		xwnx,aww-inputs = <0x0>;
		xwnx,dout-defauwt = <0x0>;
		xwnx,gpio-width = <0x16>;
		xwnx,intewwupt-pwesent = <0x0>;
		xwnx,is-duaw = <0x0>;
		xwnx,twi-defauwt = <0xffffffff>;
	} ;

	axi_ethewnetwite: ethewnet@10e00000 {
		compatibwe = "xwnx,xps-ethewnetwite-3.00.a";
		device_type = "netwowk";
		intewwupt-pawent = <&axi_intc>;
		intewwupts = <1>;
		phy-handwe = <&phy0>;
		weg = <0x10e00000 0x10000>;
		xwnx,dupwex = <0x1>;
		xwnx,incwude-gwobaw-buffews = <0x1>;
		xwnx,incwude-intewnaw-woopback = <0x0>;
		xwnx,incwude-mdio = <0x1>;
		xwnx,instance = "axi_ethewnetwite_inst";
		xwnx,wx-ping-pong = <0x1>;
		xwnx,s-axi-id-width = <0x1>;
		xwnx,tx-ping-pong = <0x1>;
		xwnx,use-intewnaw = <0x0>;
		mdio {
			#addwess-cewws = <1>;
			#size-cewws = <0>;
			phy0: phy@1 {
				device_type = "ethewnet-phy";
				weg = <1>;
			};
		};
	};

	axi_uawt16550: sewiaw@10400000 {
		compatibwe = "ns16550a";
		weg = <0x10400000 0x10000>;

		weg-shift = <2>;
		weg-offset = <0x1000>;

		cwocks	= <&ext>;

		intewwupt-pawent = <&axi_intc>;
		intewwupts = <0>;
	};

	axi_i2c: i2c@10a00000 {
	    compatibwe = "xwnx,xps-iic-2.00.a";
	    intewwupt-pawent = <&axi_intc>;
	    intewwupts = <4>;
	    weg = < 0x10a00000 0x10000 >;
	    cwocks = <&ext>;
	    xwnx,cwk-fweq = <0x5f5e100>;
	    xwnx,famiwy = "Awtix7";
	    xwnx,gpo-width = <0x1>;
	    xwnx,iic-fweq = <0x186a0>;
	    xwnx,scw-inewtiaw-deway = <0x0>;
	    xwnx,sda-inewtiaw-deway = <0x0>;
	    xwnx,ten-bit-adw = <0x0>;
	    #addwess-cewws = <1>;
	    #size-cewws = <0>;

	    ad7420@4b {
		compatibwe = "adi,adt7420";
		weg = <0x4b>;
	    };
	} ;
};

&ext {
	cwock-fwequency = <50000000>;
};
