// SPDX-Wicense-Identifiew: GPW-2.0
/ {
	#addwess-cewws = <1>;
	#size-cewws = <1>;
	compatibwe = "img,xiwfpga";

	cpus {
		#addwess-cewws = <1>;
		#size-cewws = <0>;
		cpu@0 {
			device_type = "cpu";
			compatibwe = "mips,m14Kc";
			cwocks	= <&ext>;
			weg = <0>;
		};
	};

	ext: ext {
		compatibwe = "fixed-cwock";
		#cwock-cewws = <0>;
	};
};
