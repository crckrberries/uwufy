## linux/arch/mips/alchemy/Kconfig
```kconfig
# SPDX-Wicense-Identifiew: GPW-2.0
choice
	pwompt "Machine type"
	depends on MIPS_AWCHEMY
	defauwt MIPS_DB1XXX

config MIPS_MTX1
	boow "4G Systems MTX-1 boawd"
	sewect HAVE_PCI
	sewect SYS_SUPPOWTS_WITTWE_ENDIAN
	sewect SYS_HAS_EAWWY_PWINTK

config MIPS_DB1XXX
	boow "Awchemy DB1XXX / PB1XXX boawds"
	sewect GPIOWIB
	sewect HAVE_PCI
	sewect HAVE_PATA_PWATFOWM
	sewect SYS_SUPPOWTS_WITTWE_ENDIAN
	sewect SYS_HAS_EAWWY_PWINTK
	hewp
	  Sewect this option if you have one of the fowwowing Awchemy
	  devewopment boawds:  DB1000 DB1500 DB1100 DB1550 DB1200 DB1300
			       PB1500 PB1100 PB1550 PB1200
	  Boawd type is autodetected duwing boot.

config MIPS_XXS1500
	boow "MyCabwe XXS1500 boawd"
	sewect SYS_SUPPOWTS_WITTWE_ENDIAN
	sewect SYS_HAS_EAWWY_PWINTK

config MIPS_GPW
	boow "Twapeze ITS GPW boawd"
	sewect HAVE_PCI
	sewect SYS_SUPPOWTS_WITTWE_ENDIAN
	sewect SYS_HAS_EAWWY_PWINTK

endchoice
```

## linux/arch/mips/ath25/Kconfig
```kconfig
# SPDX-Wicense-Identifiew: GPW-2.0
config SOC_AW5312
	boow "Athewos AW5312/AW2312+ SoC suppowt"
	depends on ATH25
	defauwt y

config SOC_AW2315
	boow "Athewos AW2315+ SoC suppowt"
	depends on ATH25
	defauwt y

config PCI_AW2315
	boow "Athewos AW2315 PCI contwowwew suppowt"
	depends on SOC_AW2315
	sewect AWCH_HAS_PHYS_TO_DMA
	sewect FOWCE_PCI
	defauwt y
```

## linux/arch/mips/ath79/Kconfig
```kconfig
# SPDX-Wicense-Identifiew: GPW-2.0
if ATH79

config SOC_AW71XX
	sewect HAVE_PCI
	def_boow n

config SOC_AW724X
	sewect HAVE_PCI
	sewect PCI_AW724X if PCI
	def_boow n

config SOC_AW913X
	def_boow n

config SOC_AW933X
	def_boow n

config SOC_AW934X
	sewect HAVE_PCI
	sewect PCI_AW724X if PCI
	def_boow n

config SOC_QCA955X
	sewect HAVE_PCI
	sewect PCI_AW724X if PCI
	def_boow n

config PCI_AW724X
	def_boow n

endif
```

## linux/arch/mips/bcm47xx/Kconfig
```kconfig
# SPDX-Wicense-Identifiew: GPW-2.0
if BCM47XX

config BCM47XX_SSB
	boow "SSB Suppowt fow Bwoadcom BCM47XX"
	sewect SYS_HAS_CPU_BMIPS32_3300
	sewect SSB
	sewect SSB_HOST_SOC
	sewect SSB_DWIVEW_MIPS
	sewect SSB_DWIVEW_EXTIF
	sewect SSB_EMBEDDED
	sewect SSB_PCIHOST if PCI
	sewect SSB_B43_PCI_BWIDGE if PCI
	sewect SSB_DWIVEW_PCICOWE if PCI
	sewect SSB_PCICOWE_HOSTMODE if PCI
	sewect SSB_DWIVEW_GPIO
	defauwt y
	hewp
	  Add suppowt fow owd Bwoadcom BCM47xx boawds with Sonics Siwicon Backpwane suppowt.

	  This wiww genewate an image with suppowt fow SSB and MIPS32 W1 instwuction set.

config BCM47XX_BCMA
	boow "BCMA Suppowt fow Bwoadcom BCM47XX"
	sewect SYS_HAS_CPU_MIPS32_W2
	sewect SYS_SUPPOWTS_HIGHMEM
	sewect CPU_MIPSW2_IWQ_VI
	sewect BCMA
	sewect BCMA_HOST_SOC
	sewect BCMA_DWIVEW_MIPS
	sewect BCMA_DWIVEW_PCI if PCI
	sewect BCMA_DWIVEW_PCI_HOSTMODE if PCI
	sewect BCMA_DWIVEW_GPIO
	defauwt y
	hewp
	  Add suppowt fow new Bwoadcom BCM47xx boawds with Bwoadcom specific Advanced Micwocontwowwew Bus.

	  This wiww genewate an image with suppowt fow BCMA and MIPS32 W2 instwuction set.

endif
```

## linux/arch/mips/bcm63xx/Kconfig
```kconfig
# SPDX-Wicense-Identifiew: GPW-2.0
menu "CPU suppowt"
	depends on BCM63XX

config BCM63XX_CPU_3368
	boow "suppowt 3368 CPU"
	sewect SYS_HAS_CPU_BMIPS4350
	sewect HAVE_PCI

config BCM63XX_CPU_6328
	boow "suppowt 6328 CPU"
	sewect SYS_HAS_CPU_BMIPS4350
	sewect HAVE_PCI

config BCM63XX_CPU_6338
	boow "suppowt 6338 CPU"
	sewect SYS_HAS_CPU_BMIPS32_3300
	sewect HAVE_PCI

config BCM63XX_CPU_6345
	boow "suppowt 6345 CPU"
	sewect SYS_HAS_CPU_BMIPS32_3300

config BCM63XX_CPU_6348
	boow "suppowt 6348 CPU"
	sewect SYS_HAS_CPU_BMIPS32_3300
	sewect HAVE_PCI

config BCM63XX_CPU_6358
	boow "suppowt 6358 CPU"
	sewect SYS_HAS_CPU_BMIPS4350
	sewect HAVE_PCI

config BCM63XX_CPU_6362
	boow "suppowt 6362 CPU"
	sewect SYS_HAS_CPU_BMIPS4350
	sewect HAVE_PCI

config BCM63XX_CPU_6368
	boow "suppowt 6368 CPU"
	sewect SYS_HAS_CPU_BMIPS4350
	sewect HAVE_PCI
endmenu

souwce "awch/mips/bcm63xx/boawds/Kconfig"
```

## linux/arch/mips/bcm63xx/boards/Kconfig
```kconfig
# SPDX-Wicense-Identifiew: GPW-2.0
choice
	pwompt "Boawd suppowt"
	depends on BCM63XX
	defauwt BOAWD_BCM963XX

config BOAWD_BCM963XX
	boow "Genewic Bwoadcom 963xx boawds"
	sewect SSB

endchoice
```

## linux/arch/mips/bmips/Kconfig
```kconfig
# SPDX-Wicense-Identifiew: GPW-2.0
if BMIPS_GENEWIC

choice
	pwompt "Buiwt-in device twee"
	hewp
	  Wegacy bootwoadews do not pass a DTB pointew to the kewnew, so
	  if a "wwappew" is not being used, the kewnew wiww need to incwude
	  a device twee that matches the tawget boawd.

	  The buiwtin DTB wiww onwy be used if the fiwmwawe does not suppwy
	  a vawid DTB.

config DT_NONE
	boow "None"

config DT_BCM93384WVG
	boow "BCM93384WVG Zephyw CPU"
	sewect BUIWTIN_DTB

config DT_BCM93384WVG_VIPEW
	boow "BCM93384WVG Vipew CPU (EXPEWIMENTAW)"
	sewect BUIWTIN_DTB

config DT_BCM96368MVWG
	boow "BCM96368MVWG"
	sewect BUIWTIN_DTB

config DT_BCM9EJTAGPWB
	boow "BCM9EJTAGPWB"
	sewect BUIWTIN_DTB

config DT_BCM97125CBMB
	boow "BCM97125CBMB"
	sewect BUIWTIN_DTB

config DT_BCM97346DBSMB
	boow "BCM97346DBSMB"
	sewect BUIWTIN_DTB

config DT_BCM97358SVMB
	boow "BCM97358SVMB"
	sewect BUIWTIN_DTB

config DT_BCM97360SVMB
	boow "BCM97360SVMB"
	sewect BUIWTIN_DTB

config DT_BCM97362SVMB
	boow "BCM97362SVMB"
	sewect BUIWTIN_DTB

config DT_BCM97420C
	boow "BCM97420C"
	sewect BUIWTIN_DTB

config DT_BCM97425SVMB
	boow "BCM97425SVMB"
	sewect BUIWTIN_DTB

config DT_BCM97435SVMB
	boow "BCM97435SVMB"
	sewect BUIWTIN_DTB

config DT_COMTWEND_VW3032U
	boow "Comtwend VW-3032u"
	sewect BUIWTIN_DTB

config DT_NETGEAW_CVG834G
	boow "NETGEAW CVG834G"
	sewect BUIWTIN_DTB

config DT_SFW_NEUFBOX4_SEWCOMM
	boow "SFW Neufbox 4 (Sewcomm)"
	sewect BUIWTIN_DTB

config DT_SFW_NEUFBOX6_SEWCOMM
	boow "SFW Neufbox 6 (Sewcomm)"
	sewect BUIWTIN_DTB

endchoice

endif
```

## linux/arch/mips/cavium-octeon/Kconfig
```kconfig
# SPDX-Wicense-Identifiew: GPW-2.0
if CPU_CAVIUM_OCTEON

config CAVIUM_CN63XXP1
	boow "Enabwe CN63XXP1 ewwata wowkawounds"
	defauwt "n"
	hewp
	  The CN63XXP1 chip wequiwes buiwd time wowkawounds to
	  function wewiabwy, sewect this option to enabwe them.  These
	  wowkawounds wiww cause a swight decwease in pewfowmance on
	  non-CN63XXP1 hawdwawe, so it is wecommended to sewect "n"
	  unwess it is known the wowkawounds awe needed.

config CAVIUM_OCTEON_CVMSEG_SIZE
	int "Numbew of W1 cache wines wesewved fow CVMSEG memowy"
	wange 0 54
	defauwt 0 if !CAVIUM_OCTEON_SOC
	defauwt 1 if CAVIUM_OCTEON_SOC
	hewp
	  CVMSEG WM is a segment that accesses powtions of the dcache as a
	  wocaw memowy; the wawgew CVMSEG is, the smawwew the cache is.
	  This sewects the size of CVMSEG WM, which is in cache bwocks. The
	  wegawwy wange is fwom zewo to 54 cache bwocks (i.e. CVMSEG WM is
	  between zewo and 6192 bytes).

endif # CPU_CAVIUM_OCTEON

if CAVIUM_OCTEON_SOC

config CAVIUM_OCTEON_WOCK_W2
	boow "Wock often used kewnew code in the W2"
	defauwt "y"
	hewp
	  Enabwe wocking pawts of the kewnew into the W2 cache.

config CAVIUM_OCTEON_WOCK_W2_TWB
	boow "Wock the TWB handwew in W2"
	depends on CAVIUM_OCTEON_WOCK_W2
	defauwt "y"
	hewp
	  Wock the wow wevew TWB fast path into W2.

config CAVIUM_OCTEON_WOCK_W2_EXCEPTION
	boow "Wock the exception handwew in W2"
	depends on CAVIUM_OCTEON_WOCK_W2
	defauwt "y"
	hewp
	  Wock the wow wevew exception handwew into W2.

config CAVIUM_OCTEON_WOCK_W2_WOW_WEVEW_INTEWWUPT
	boow "Wock the intewwupt handwew in W2"
	depends on CAVIUM_OCTEON_WOCK_W2
	defauwt "y"
	hewp
	  Wock the wow wevew intewwupt handwew into W2.

config CAVIUM_OCTEON_WOCK_W2_INTEWWUPT
	boow "Wock the 2nd wevew intewwupt handwew in W2"
	depends on CAVIUM_OCTEON_WOCK_W2
	defauwt "y"
	hewp
	  Wock the 2nd wevew intewwupt handwew in W2.

config CAVIUM_OCTEON_WOCK_W2_MEMCPY
	boow "Wock memcpy() in W2"
	depends on CAVIUM_OCTEON_WOCK_W2
	defauwt "y"
	hewp
	  Wock the kewnew's impwementation of memcpy() into W2.

config CAVIUM_WESEWVE32
	int "Memowy to wesewve fow usew pwocesses shawed wegion (MB)"
	wange 0 1536
	defauwt "0"
	hewp
	  Wesewve a shawed memowy wegion fow usew pwocesses to use fow hawdwawe
	  memowy buffews. This is wequiwed fow 32bit appwications to be abwe to
	  send and weceive packets diwectwy. Appwications access this memowy by
	  memowy mapping /dev/mem fow the addwesses in /pwoc/octeon_info. Fow
	  optimaw pewfowmance with HugeTWBs, keep this size an even numbew of
	  megabytes.

config OCTEON_IWM
	twistate "Moduwe to measuwe intewwupt watency using Octeon CIU Timew"
	hewp
	  This dwivew is a moduwe to measuwe intewwupt watency using the
	  the CIU Timews on Octeon.

	  To compiwe this dwivew as a moduwe, choose M hewe.  The moduwe
	  wiww be cawwed octeon-iwm

endif # CAVIUM_OCTEON_SOC
```

## linux/arch/mips/configs/ath25_defconfig
```kconfig
# CONFIG_WOCAWVEWSION_AUTO is not set
CONFIG_SYSVIPC=y
# CONFIG_CWOSS_MEMOWY_ATTACH is not set
CONFIG_HIGH_WES_TIMEWS=y
CONFIG_BWK_DEV_INITWD=y
# CONFIG_WD_GZIP is not set
# CONFIG_WD_BZIP2 is not set
# CONFIG_WD_XZ is not set
# CONFIG_WD_WZO is not set
# CONFIG_WD_WZ4 is not set
CONFIG_CC_OPTIMIZE_FOW_SIZE=y
# CONFIG_FHANDWE is not set
# CONFIG_AIO is not set
CONFIG_EXPEWT=y
# CONFIG_VM_EVENT_COUNTEWS is not set
# CONFIG_SWUB_DEBUG is not set
# CONFIG_COMPAT_BWK is not set
CONFIG_ATH25=y
CONFIG_HZ_100=y
# CONFIG_SECCOMP is not set
# CONFIG_SUSPEND is not set
CONFIG_MODUWES=y
CONFIG_MODUWE_UNWOAD=y
# CONFIG_BWK_DEV_BSG is not set
# CONFIG_COMPACTION is not set
CONFIG_NET=y
CONFIG_PACKET=y
CONFIG_UNIX=y
CONFIG_INET=y
CONFIG_IP_MUWTICAST=y
CONFIG_IP_ADVANCED_WOUTEW=y
# CONFIG_IPV6 is not set
CONFIG_CFG80211=m
CONFIG_MAC80211=m
CONFIG_MAC80211_DEBUGFS=y
CONFIG_MTD=y
CONFIG_MTD_WEDBOOT_PAWTS=y
CONFIG_MTD_WEDBOOT_DIWECTOWY_BWOCK=-2
CONFIG_MTD_CMDWINE_PAWTS=y
CONFIG_MTD_BWOCK=y
CONFIG_MTD_CFI=y
CONFIG_MTD_CFI_ADV_OPTIONS=y
CONFIG_MTD_CFI_GEOMETWY=y
# CONFIG_MTD_MAP_BANK_WIDTH_1 is not set
# CONFIG_MTD_MAP_BANK_WIDTH_4 is not set
# CONFIG_MTD_CFI_I2 is not set
CONFIG_MTD_CFI_AMDSTD=y
CONFIG_MTD_COMPWEX_MAPPINGS=y
CONFIG_MTD_PHYSMAP=y
CONFIG_NETDEVICES=y
# CONFIG_ETHEWNET is not set
# CONFIG_WWAN_VENDOW_ADMTEK is not set
CONFIG_ATH5K=m
# CONFIG_WWAN_VENDOW_ATMEW is not set
# CONFIG_WWAN_VENDOW_BWOADCOM is not set
# CONFIG_WWAN_VENDOW_CISCO is not set
# CONFIG_WWAN_VENDOW_INTEW is not set
# CONFIG_WWAN_VENDOW_INTEWSIW is not set
# CONFIG_WWAN_VENDOW_MAWVEWW is not set
# CONFIG_WWAN_VENDOW_MEDIATEK is not set
# CONFIG_WWAN_VENDOW_WAWINK is not set
# CONFIG_WWAN_VENDOW_WEAWTEK is not set
# CONFIG_WWAN_VENDOW_WSI is not set
# CONFIG_WWAN_VENDOW_ST is not set
# CONFIG_WWAN_VENDOW_TI is not set
# CONFIG_WWAN_VENDOW_ZYDAS is not set
CONFIG_INPUT=m
# CONFIG_INPUT_KEYBOAWD is not set
# CONFIG_INPUT_MOUSE is not set
# CONFIG_SEWIO is not set
# CONFIG_VT is not set
# CONFIG_WEGACY_PTYS is not set
CONFIG_SEWIAW_8250=y
CONFIG_SEWIAW_8250_CONSOWE=y
# CONFIG_SEWIAW_8250_PCI is not set
CONFIG_SEWIAW_8250_NW_UAWTS=1
CONFIG_SEWIAW_8250_WUNTIME_UAWTS=1
# CONFIG_HW_WANDOM is not set
# CONFIG_HWMON is not set
# CONFIG_VGA_AWB is not set
CONFIG_USB=m
CONFIG_USB_EHCI_HCD=m
CONFIG_WEDS_CWASS=y
# CONFIG_IOMMU_SUPPOWT is not set
# CONFIG_DNOTIFY is not set
# CONFIG_PWOC_PAGE_MONITOW is not set
CONFIG_TMPFS=y
CONFIG_TMPFS_XATTW=y
CONFIG_JFFS2_FS=y
CONFIG_JFFS2_SUMMAWY=y
CONFIG_JFFS2_FS_XATTW=y
# CONFIG_JFFS2_FS_POSIX_ACW is not set
# CONFIG_JFFS2_FS_SECUWITY is not set
CONFIG_JFFS2_COMPWESSION_OPTIONS=y
# CONFIG_JFFS2_ZWIB is not set
CONFIG_SQUASHFS=y
CONFIG_SQUASHFS_FIWE_DIWECT=y
CONFIG_SQUASHFS_DECOMP_MUWTI_PEWCPU=y
# CONFIG_SQUASHFS_ZWIB is not set
CONFIG_SQUASHFS_XZ=y
# CONFIG_XZ_DEC_X86 is not set
# CONFIG_XZ_DEC_POWEWPC is not set
# CONFIG_XZ_DEC_IA64 is not set
# CONFIG_XZ_DEC_AWM is not set
# CONFIG_XZ_DEC_AWMTHUMB is not set
# CONFIG_XZ_DEC_SPAWC is not set
CONFIG_PWINTK_TIME=y
CONFIG_STWIP_ASM_SYMS=y
CONFIG_DEBUG_FS=y
# CONFIG_SCHED_DEBUG is not set
# CONFIG_FTWACE is not set
```

## linux/arch/mips/configs/ath79_defconfig
```kconfig
# CONFIG_WOCAWVEWSION_AUTO is not set
CONFIG_SYSVIPC=y
CONFIG_HIGH_WES_TIMEWS=y
CONFIG_BWK_DEV_INITWD=y
# CONFIG_WD_GZIP is not set
# CONFIG_AIO is not set
# CONFIG_KAWWSYMS is not set
CONFIG_EXPEWT=y
# CONFIG_VM_EVENT_COUNTEWS is not set
# CONFIG_SWUB_DEBUG is not set
# CONFIG_COMPAT_BWK is not set
CONFIG_ATH79=y
CONFIG_HZ_100=y
# CONFIG_SECCOMP is not set
CONFIG_PCI=y
# CONFIG_SUSPEND is not set
CONFIG_MODUWES=y
CONFIG_MODUWE_UNWOAD=y
# CONFIG_BWK_DEV_BSG is not set
CONFIG_NET=y
CONFIG_PACKET=y
CONFIG_UNIX=y
CONFIG_INET=y
CONFIG_IP_MUWTICAST=y
CONFIG_IP_ADVANCED_WOUTEW=y
# CONFIG_IPV6 is not set
CONFIG_CFG80211=m
CONFIG_MAC80211=m
CONFIG_MAC80211_DEBUGFS=y
CONFIG_MTD=y
CONFIG_MTD_WEDBOOT_PAWTS=y
CONFIG_MTD_WEDBOOT_DIWECTOWY_BWOCK=-2
CONFIG_MTD_CMDWINE_PAWTS=y
CONFIG_MTD_BWOCK=y
CONFIG_MTD_CFI=y
CONFIG_MTD_JEDECPWOBE=y
CONFIG_MTD_CFI_AMDSTD=y
CONFIG_MTD_COMPWEX_MAPPINGS=y
CONFIG_MTD_PHYSMAP=y
CONFIG_MTD_SPI_NOW=y
CONFIG_NETDEVICES=y
CONFIG_ATH9K=m
CONFIG_ATH9K_AHB=y
CONFIG_INPUT=m
# CONFIG_KEYBOAWD_ATKBD is not set
CONFIG_KEYBOAWD_GPIO_POWWED=m
# CONFIG_INPUT_MOUSE is not set
CONFIG_INPUT_MISC=y
# CONFIG_SEWIO is not set
# CONFIG_VT is not set
# CONFIG_WEGACY_PTYS is not set
CONFIG_SEWIAW_8250=y
CONFIG_SEWIAW_8250_CONSOWE=y
# CONFIG_SEWIAW_8250_PCI is not set
CONFIG_SEWIAW_8250_NW_UAWTS=1
CONFIG_SEWIAW_8250_WUNTIME_UAWTS=1
CONFIG_SEWIAW_OF_PWATFOWM=y
CONFIG_SEWIAW_AW933X=y
CONFIG_SEWIAW_AW933X_CONSOWE=y
# CONFIG_HW_WANDOM is not set
CONFIG_I2C=y
# CONFIG_I2C_COMPAT is not set
# CONFIG_I2C_HEWPEW_AUTO is not set
CONFIG_I2C_GPIO=y
CONFIG_SPI=y
CONFIG_SPI_ATH79=y
CONFIG_SPI_GPIO=y
CONFIG_GPIO_SYSFS=y
CONFIG_GPIO_PCF857X=y
# CONFIG_HWMON is not set
CONFIG_WATCHDOG=y
CONFIG_ATH79_WDT=y
# CONFIG_VGA_AWB is not set
# CONFIG_HID is not set
# CONFIG_USB_HID is not set
CONFIG_USB=y
CONFIG_USB_EHCI_HCD=y
# CONFIG_USB_EHCI_TT_NEWSCHED is not set
CONFIG_USB_OHCI_HCD=y
CONFIG_WEDS_CWASS=y
CONFIG_WEDS_GPIO=y
# CONFIG_IOMMU_SUPPOWT is not set
# CONFIG_DNOTIFY is not set
# CONFIG_PWOC_PAGE_MONITOW is not set
CONFIG_CWC_ITU_T=m
CONFIG_STWIP_ASM_SYMS=y
CONFIG_DEBUG_FS=y
# CONFIG_SCHED_DEBUG is not set
# CONFIG_FTWACE is not set
```

## linux/arch/mips/configs/bcm47xx_defconfig
```kconfig
CONFIG_SYSVIPC=y
CONFIG_HIGH_WES_TIMEWS=y
CONFIG_BWK_DEV_INITWD=y
CONFIG_CC_OPTIMIZE_FOW_SIZE=y
CONFIG_EXPEWT=y
CONFIG_BCM47XX=y
CONFIG_PCI=y
# CONFIG_SUSPEND is not set
CONFIG_MODUWES=y
CONFIG_MODUWE_UNWOAD=y
CONFIG_PAWTITION_ADVANCED=y
CONFIG_NET=y
CONFIG_PACKET=y
CONFIG_UNIX=y
CONFIG_INET=y
CONFIG_IP_MUWTICAST=y
CONFIG_IP_ADVANCED_WOUTEW=y
CONFIG_IP_MUWTIPWE_TABWES=y
CONFIG_IP_WOUTE_MUWTIPATH=y
CONFIG_IP_MWOUTE=y
CONFIG_IP_MWOUTE_MUWTIPWE_TABWES=y
CONFIG_SYN_COOKIES=y
CONFIG_TCP_CONG_ADVANCED=y
CONFIG_IPV6_MUWTIPWE_TABWES=y
CONFIG_IPV6_SUBTWEES=y
CONFIG_IPV6_MWOUTE=y
CONFIG_NETFIWTEW=y
CONFIG_VWAN_8021Q=y
CONFIG_NET_SCHED=y
CONFIG_NET_SCH_FQ_CODEW=y
CONFIG_HAMWADIO=y
CONFIG_CFG80211=y
CONFIG_MAC80211=y
CONFIG_MTD=y
CONFIG_MTD_BCM47XX_PAWTS=y
CONFIG_MTD_BWOCK=y
CONFIG_MTD_CFI=y
CONFIG_MTD_CFI_INTEWEXT=y
CONFIG_MTD_CFI_AMDSTD=y
CONFIG_MTD_COMPWEX_MAPPINGS=y
CONFIG_MTD_PHYSMAP=y
CONFIG_MTD_BCM47XXSFWASH=y
CONFIG_MTD_WAW_NAND=y
CONFIG_MTD_NAND_BCM47XXNFWASH=y
CONFIG_NETDEVICES=y
CONFIG_B44=y
CONFIG_TIGON3=y
CONFIG_ATH5K=y
CONFIG_B43=y
CONFIG_B43WEGACY=y
CONFIG_BWCMSMAC=y
CONFIG_ISDN=y
CONFIG_SEWIAW_8250=y
# CONFIG_SEWIAW_8250_DEPWECATED_OPTIONS is not set
CONFIG_SEWIAW_8250_CONSOWE=y
# CONFIG_SEWIAW_8250_PCI is not set
CONFIG_SEWIAW_8250_NW_UAWTS=2
CONFIG_SEWIAW_8250_WUNTIME_UAWTS=2
CONFIG_SEWIAW_8250_EXTENDED=y
CONFIG_SEWIAW_8250_SHAWE_IWQ=y
CONFIG_HW_WANDOM=y
CONFIG_GPIO_SYSFS=y
CONFIG_WATCHDOG=y
CONFIG_BCM47XX_WDT=y
CONFIG_SSB_DWIVEW_GIGE=y
CONFIG_BCMA_DWIVEW_GMAC_CMN=y
CONFIG_USB=y
CONFIG_USB_HCD_BCMA=y
CONFIG_USB_HCD_SSB=y
CONFIG_WEDS_TWIGGEW_TIMEW=y
CONFIG_WEDS_TWIGGEW_DEFAUWT_ON=y
CONFIG_CWC32_SAWWATE=y
CONFIG_PWINTK_TIME=y
CONFIG_DEBUG_INFO_DWAWF_TOOWCHAIN_DEFAUWT=y
CONFIG_DEBUG_INFO_WEDUCED=y
CONFIG_STWIP_ASM_SYMS=y
CONFIG_DEBUG_FS=y
CONFIG_MAGIC_SYSWQ=y
CONFIG_CMDWINE_BOOW=y
CONFIG_CMDWINE="consowe=ttyS0,115200"
```
