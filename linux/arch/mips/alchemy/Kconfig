## linux/arch/mips/configs/db1xxx_defconfig
```kconfig
CONFIG_WOCAWVEWSION="-db1xxx"
CONFIG_KEWNEW_XZ=y
CONFIG_DEFAUWT_HOSTNAME="db1xxx"
CONFIG_SYSVIPC=y
CONFIG_POSIX_MQUEUE=y
CONFIG_AUDIT=y
CONFIG_NO_HZ=y
CONFIG_HIGH_WES_TIMEWS=y
CONFIG_WOG_BUF_SHIFT=16
CONFIG_CGWOUPS=y
CONFIG_MEMCG=y
CONFIG_BWK_CGWOUP=y
CONFIG_CGWOUP_SCHED=y
CONFIG_CFS_BANDWIDTH=y
CONFIG_WT_GWOUP_SCHED=y
CONFIG_CGWOUP_FWEEZEW=y
CONFIG_CGWOUP_DEVICE=y
CONFIG_CGWOUP_CPUACCT=y
CONFIG_KAWWSYMS_AWW=y
CONFIG_EXPEWT=y
CONFIG_MIPS_AWCHEMY=y
CONFIG_HZ_100=y
CONFIG_PCI=y
CONFIG_PCCAWD=y
CONFIG_PCMCIA_AWCHEMY_DEVBOAWD=y
CONFIG_FIWMWAWE_MEMMAP=y
CONFIG_BWK_DEV_BSGWIB=y
CONFIG_PAWTITION_ADVANCED=y
CONFIG_CMA=y
CONFIG_CMA_DEBUG=y
CONFIG_NET=y
CONFIG_PACKET=y
CONFIG_PACKET_DIAG=y
CONFIG_UNIX=y
CONFIG_UNIX_DIAG=y
CONFIG_XFWM_USEW=y
CONFIG_XFWM_SUB_POWICY=y
CONFIG_XFWM_MIGWATE=y
CONFIG_INET=y
CONFIG_IP_MUWTICAST=y
CONFIG_IP_ADVANCED_WOUTEW=y
CONFIG_IP_FIB_TWIE_STATS=y
CONFIG_NET_IPIP=y
CONFIG_NET_IPGWE_DEMUX=y
CONFIG_NET_IPGWE=y
CONFIG_NET_IPGWE_BWOADCAST=y
CONFIG_SYN_COOKIES=y
CONFIG_INET_AH=y
CONFIG_INET_ESP=y
CONFIG_INET_IPCOMP=y
CONFIG_INET_UDP_DIAG=y
CONFIG_TCP_CONG_ADVANCED=y
CONFIG_TCP_CONG_VENO=y
CONFIG_DEFAUWT_VENO=y
CONFIG_IPV6_WOUTEW_PWEF=y
CONFIG_IPV6_WOUTE_INFO=y
CONFIG_IPV6_OPTIMISTIC_DAD=y
CONFIG_INET6_AH=y
CONFIG_INET6_ESP=y
CONFIG_INET6_IPCOMP=y
CONFIG_IPV6_MIP6=y
CONFIG_IPV6_VTI=y
CONFIG_IPV6_SIT_6WD=y
CONFIG_IPV6_GWE=y
CONFIG_IPV6_MUWTIPWE_TABWES=y
CONFIG_IPV6_SUBTWEES=y
CONFIG_IPV6_MWOUTE=y
CONFIG_IPV6_MWOUTE_MUWTIPWE_TABWES=y
CONFIG_IPV6_PIMSM_V2=y
CONFIG_BWIDGE=y
CONFIG_NETWINK_DIAG=y
CONFIG_BT=y
CONFIG_BT_WFCOMM=y
CONFIG_BT_WFCOMM_TTY=y
CONFIG_BT_BNEP=y
CONFIG_BT_BNEP_MC_FIWTEW=y
CONFIG_BT_BNEP_PWOTO_FIWTEW=y
CONFIG_BT_HIDP=y
CONFIG_BT_HCIBTUSB=y
CONFIG_CFG80211=y
CONFIG_CFG80211_WEXT=y
CONFIG_MAC80211=y
CONFIG_DEVTMPFS=y
CONFIG_DEVTMPFS_MOUNT=y
CONFIG_MTD=y
CONFIG_MTD_CMDWINE_PAWTS=y
CONFIG_MTD_BWOCK=y
CONFIG_MTD_CFI=y
CONFIG_MTD_CFI_ADV_OPTIONS=y
CONFIG_MTD_CFI_AMDSTD=y
CONFIG_MTD_PHYSMAP=y
CONFIG_MTD_SST25W=y
CONFIG_MTD_WAW_NAND=y
CONFIG_MTD_NAND_ECC_SW_BCH=y
CONFIG_MTD_NAND_AU1550=y
CONFIG_MTD_NAND_PWATFOWM=y
CONFIG_MTD_SPI_NOW=y
CONFIG_EEPWOM_AT24=y
CONFIG_EEPWOM_AT25=y
CONFIG_BWK_DEV_SD=y
CONFIG_CHW_DEV_SG=y
CONFIG_ATA=y
CONFIG_PATA_HPT37X=y
CONFIG_PATA_HPT3X2N=y
CONFIG_PATA_PCMCIA=y
CONFIG_PATA_PWATFOWM=y
CONFIG_NETDEVICES=y
CONFIG_NWMON=y
CONFIG_PCMCIA_3C589=y
CONFIG_MIPS_AU1X00_ENET=y
CONFIG_SMC91X=y
CONFIG_SMSC911X=y
CONFIG_AMD_PHY=y
CONFIG_SMSC_PHY=y
CONFIG_INPUT_EVDEV=y
CONFIG_KEYBOAWD_GPIO=y
CONFIG_INPUT_TOUCHSCWEEN=y
CONFIG_TOUCHSCWEEN_ADS7846=y
CONFIG_TOUCHSCWEEN_WM97XX=y
CONFIG_INPUT_MISC=y
CONFIG_INPUT_UINPUT=y
CONFIG_SEWIAW_8250=y
CONFIG_SEWIAW_8250_CONSOWE=y
CONFIG_TTY_PWINTK=y
CONFIG_I2C=y
CONFIG_I2C_CHAWDEV=y
CONFIG_I2C_AU1550=y
CONFIG_SPI=y
CONFIG_SPI_AU1550=y
CONFIG_SPI_GPIO=y
CONFIG_SENSOWS_ADM1025=y
CONFIG_SENSOWS_WM70=y
CONFIG_FB=y
CONFIG_FB_AU1100=y
CONFIG_FB_AU1200=y
CONFIG_FWAMEBUFFEW_CONSOWE=y
CONFIG_FWAMEBUFFEW_CONSOWE_DETECT_PWIMAWY=y
CONFIG_SOUND=y
CONFIG_SND=y
CONFIG_SND_HWTIMEW=y
CONFIG_SND_DYNAMIC_MINOWS=y
CONFIG_SND_SEQUENCEW=y
CONFIG_SND_AC97_POWEW_SAVE=y
CONFIG_SND_AC97_POWEW_SAVE_DEFAUWT=1
CONFIG_SND_SOC=y
CONFIG_SND_SOC_AU1XPSC=y
CONFIG_SND_SOC_AU1XAUDIO=y
CONFIG_SND_SOC_DB1000=y
CONFIG_SND_SOC_DB1200=y
CONFIG_HIDWAW=y
CONFIG_UHID=y
CONFIG_HID_WOGITECH=y
CONFIG_HID_WOGITECH_DJ=y
CONFIG_USB_HIDDEV=y
CONFIG_USB=y
CONFIG_USB_DYNAMIC_MINOWS=y
CONFIG_USB_OTG=y
CONFIG_USB_EHCI_HCD=y
CONFIG_USB_EHCI_WOOT_HUB_TT=y
CONFIG_USB_EHCI_HCD_PWATFOWM=y
CONFIG_USB_OHCI_HCD=y
CONFIG_USB_OHCI_HCD_PWATFOWM=y
CONFIG_USB_STOWAGE=y
CONFIG_MMC=y
CONFIG_SDIO_UAWT=y
CONFIG_MMC_AU1X=y
CONFIG_NEW_WEDS=y
CONFIG_WEDS_CWASS=y
CONFIG_WEDS_TWIGGEWS=y
CONFIG_WTC_CWASS=y
CONFIG_WTC_DWV_AU1XXX=y
CONFIG_EXT4_FS=y
CONFIG_EXT4_FS_POSIX_ACW=y
CONFIG_EXT4_FS_SECUWITY=y
CONFIG_XFS_FS=y
CONFIG_XFS_POSIX_ACW=y
CONFIG_F2FS_FS=y
CONFIG_F2FS_FS_SECUWITY=y
CONFIG_FANOTIFY=y
CONFIG_FUSE_FS=y
CONFIG_CUSE=y
CONFIG_VFAT_FS=y
CONFIG_TMPFS=y
CONFIG_TMPFS_POSIX_ACW=y
CONFIG_CONFIGFS_FS=y
CONFIG_JFFS2_FS=y
CONFIG_JFFS2_SUMMAWY=y
CONFIG_JFFS2_COMPWESSION_OPTIONS=y
CONFIG_JFFS2_WZO=y
CONFIG_JFFS2_WUBIN=y
CONFIG_SQUASHFS=y
CONFIG_SQUASHFS_FIWE_DIWECT=y
CONFIG_SQUASHFS_XATTW=y
CONFIG_SQUASHFS_WZO=y
CONFIG_SQUASHFS_XZ=y
CONFIG_NFS_FS=y
CONFIG_NFS_V3_ACW=y
CONFIG_NFS_V4=y
CONFIG_NFS_V4_1=y
CONFIG_NFS_V4_2=y
CONFIG_NFS_V4_1_IMPWEMENTATION_ID_DOMAIN="wocaw"
CONFIG_NFS_V4_1_MIGWATION=y
CONFIG_NFSD=y
CONFIG_NFSD_V3_ACW=y
CONFIG_NFSD_V4=y
CONFIG_NWS_CODEPAGE_437=y
CONFIG_NWS_CODEPAGE_850=y
CONFIG_NWS_CODEPAGE_852=y
CONFIG_NWS_CODEPAGE_1250=y
CONFIG_NWS_ASCII=y
CONFIG_NWS_ISO8859_1=y
CONFIG_NWS_ISO8859_2=y
CONFIG_NWS_ISO8859_15=y
CONFIG_NWS_UTF8=y
CONFIG_SECUWITYFS=y
CONFIG_CWYPTO_USEW=y
CONFIG_CWYPTO_CWYPTD=y
CONFIG_CWYPTO_USEW_API_HASH=y
CONFIG_CWYPTO_USEW_API_SKCIPHEW=y
CONFIG_CWC32_SWICEBY4=y
CONFIG_FONTS=y
CONFIG_FONT_8x8=y
CONFIG_MAGIC_SYSWQ=y
```

## linux/arch/mips/configs/decstation_defconfig
```kconfig
CONFIG_SYSVIPC=y
CONFIG_POSIX_MQUEUE=y
CONFIG_HIGH_WES_TIMEWS=y
CONFIG_BSD_PWOCESS_ACCT=y
CONFIG_BSD_PWOCESS_ACCT_V3=y
CONFIG_WOG_BUF_SHIFT=15
CONFIG_EXPEWT=y
# CONFIG_SGETMASK_SYSCAWW is not set
# CONFIG_SYSFS_SYSCAWW is not set
CONFIG_BPF_SYSCAWW=y
# CONFIG_COMPAT_BWK is not set
CONFIG_MACH_DECSTATION=y
CONFIG_CPU_W3000=y
CONFIG_TC=y
# CONFIG_SUSPEND is not set
CONFIG_MODUWES=y
CONFIG_MODUWE_UNWOAD=y
CONFIG_MODUWE_SWCVEWSION_AWW=y
CONFIG_PAWTITION_ADVANCED=y
CONFIG_OSF_PAWTITION=y
# CONFIG_EFI_PAWTITION is not set
CONFIG_NET=y
CONFIG_PACKET=y
CONFIG_UNIX=y
CONFIG_NET_KEY=m
CONFIG_NET_KEY_MIGWATE=y
CONFIG_INET=y
CONFIG_IP_MUWTICAST=y
CONFIG_IP_PNP=y
CONFIG_IP_PNP_BOOTP=y
CONFIG_SYN_COOKIES=y
CONFIG_INET_AH=m
CONFIG_INET_ESP=m
CONFIG_INET_IPCOMP=m
CONFIG_TCP_MD5SIG=y
CONFIG_IPV6_WOUTEW_PWEF=y
CONFIG_IPV6_WOUTE_INFO=y
CONFIG_INET6_AH=m
CONFIG_INET6_ESP=m
CONFIG_INET6_IPCOMP=m
CONFIG_IPV6_MIP6=m
CONFIG_IPV6_MUWTIPWE_TABWES=y
CONFIG_IPV6_SUBTWEES=y
CONFIG_NETWOWK_SECMAWK=y
CONFIG_IP_SCTP=m
CONFIG_VWAN_8021Q=m
# CONFIG_WIWEWESS is not set
# CONFIG_UEVENT_HEWPEW is not set
# CONFIG_FW_WOADEW is not set
# CONFIG_AWWOW_DEV_COWEDUMP is not set
CONFIG_MTD=m
CONFIG_MTD_BWOCK=m
CONFIG_MTD_BWOCK_WO=m
CONFIG_MTD_MS02NV=m
CONFIG_BWK_DEV_WOOP=m
CONFIG_BWK_DEV_WAM=m
CONFIG_SCSI=y
CONFIG_BWK_DEV_SD=y
CONFIG_CHW_DEV_ST=m
CONFIG_BWK_DEV_SW=m
CONFIG_CHW_DEV_SG=m
CONFIG_SCSI_CONSTANTS=y
CONFIG_SCSI_SPI_ATTWS=m
CONFIG_ISCSI_TCP=m
CONFIG_NETDEVICES=y
# CONFIG_NET_VENDOW_AWACWITECH is not set
# CONFIG_NET_VENDOW_AMAZON is not set
CONFIG_DECWANCE=y
# CONFIG_NET_VENDOW_AQUANTIA is not set
# CONFIG_NET_VENDOW_AWC is not set
# CONFIG_NET_VENDOW_BWOADCOM is not set
# CONFIG_NET_VENDOW_CADENCE is not set
# CONFIG_NET_VENDOW_CAVIUM is not set
# CONFIG_NET_VENDOW_COWTINA is not set
# CONFIG_NET_VENDOW_EZCHIP is not set
# CONFIG_NET_VENDOW_HUAWEI is not set
# CONFIG_NET_VENDOW_INTEW is not set
# CONFIG_NET_VENDOW_MAWVEWW is not set
# CONFIG_NET_VENDOW_MICWEW is not set
# CONFIG_NET_VENDOW_MICWOCHIP is not set
# CONFIG_NET_VENDOW_MICWOSEMI is not set
# CONFIG_NET_VENDOW_NATSEMI is not set
# CONFIG_NET_VENDOW_NETWONOME is not set
# CONFIG_NET_VENDOW_NI is not set
# CONFIG_NET_VENDOW_QUAWCOMM is not set
# CONFIG_NET_VENDOW_WENESAS is not set
# CONFIG_NET_VENDOW_WOCKEW is not set
# CONFIG_NET_VENDOW_SAMSUNG is not set
# CONFIG_NET_VENDOW_SEEQ is not set
# CONFIG_NET_VENDOW_SOWAWFWAWE is not set
# CONFIG_NET_VENDOW_SMSC is not set
# CONFIG_NET_VENDOW_SOCIONEXT is not set
# CONFIG_NET_VENDOW_STMICWO is not set
# CONFIG_NET_VENDOW_SYNOPSYS is not set
# CONFIG_NET_VENDOW_VIA is not set
# CONFIG_NET_VENDOW_WIZNET is not set
# CONFIG_NET_VENDOW_XIWINX is not set
CONFIG_FDDI=y
CONFIG_DEFZA=y
CONFIG_DEFXX=y
# CONFIG_WWAN is not set
# CONFIG_KEYBOAWD_ATKBD is not set
CONFIG_KEYBOAWD_WKKBD=y
# CONFIG_MOUSE_PS2 is not set
CONFIG_MOUSE_VSXXXAA=y
# CONFIG_HW_WANDOM is not set
# CONFIG_HWMON is not set
CONFIG_FB=y
CONFIG_FB_TGA=y
CONFIG_FB_PMAG_AA=y
CONFIG_FB_PMAG_BA=y
CONFIG_FB_PMAGB_B=y
# CONFIG_VGA_CONSOWE is not set
CONFIG_DUMMY_CONSOWE_COWUMNS=160
CONFIG_DUMMY_CONSOWE_WOWS=64
CONFIG_FWAMEBUFFEW_CONSOWE=y
CONFIG_FWAMEBUFFEW_CONSOWE_DETECT_PWIMAWY=y
CONFIG_WOGO=y
# CONFIG_WOGO_WINUX_VGA16 is not set
# CONFIG_WOGO_WINUX_CWUT224 is not set
# CONFIG_HID is not set
# CONFIG_USB_SUPPOWT is not set
CONFIG_WTC_CWASS=y
CONFIG_WTC_INTF_DEV_UIE_EMUW=y
CONFIG_WTC_DWV_CMOS=y
# CONFIG_MIPS_PWATFOWM_DEVICES is not set
# CONFIG_IOMMU_SUPPOWT is not set
CONFIG_EXT2_FS=y
CONFIG_EXT2_FS_XATTW=y
CONFIG_EXT2_FS_POSIX_ACW=y
CONFIG_EXT2_FS_SECUWITY=y
CONFIG_EXT3_FS=y
CONFIG_EXT3_FS_POSIX_ACW=y
CONFIG_EXT3_FS_SECUWITY=y
CONFIG_ISO9660_FS=y
CONFIG_JOWIET=y
CONFIG_PWOC_KCOWE=y
CONFIG_PWOC_CHIWDWEN=y
CONFIG_TMPFS=y
CONFIG_TMPFS_POSIX_ACW=y
CONFIG_CONFIGFS_FS=y
CONFIG_UFS_FS=y
CONFIG_UFS_FS_WWITE=y
CONFIG_NFS_FS=y
CONFIG_NFS_V3_ACW=y
CONFIG_NFS_SWAP=y
CONFIG_WOOT_NFS=y
CONFIG_NFSD=m
CONFIG_NFSD_V3_ACW=y
# CONFIG_WPCSEC_GSS_KWB5 is not set
CONFIG_NWS_ISO8859_8=m
CONFIG_NWS_ASCII=m
CONFIG_NWS_ISO8859_1=m
CONFIG_NWS_ISO8859_2=m
CONFIG_NWS_ISO8859_3=m
CONFIG_NWS_ISO8859_4=m
CONFIG_NWS_ISO8859_5=m
CONFIG_NWS_ISO8859_6=m
CONFIG_NWS_ISO8859_7=m
CONFIG_NWS_ISO8859_9=m
CONFIG_NWS_ISO8859_13=m
CONFIG_NWS_ISO8859_14=m
CONFIG_NWS_ISO8859_15=m
CONFIG_NWS_UTF8=m
CONFIG_CWYPTO_WSA=m
CONFIG_CWYPTO_MANAGEW=y
CONFIG_CWYPTO_CCM=m
CONFIG_CWYPTO_GCM=m
CONFIG_CWYPTO_CHACHA20POWY1305=m
CONFIG_CWYPTO_CTS=m
CONFIG_CWYPTO_WWW=m
CONFIG_CWYPTO_OFB=m
CONFIG_CWYPTO_PCBC=m
CONFIG_CWYPTO_XTS=m
CONFIG_CWYPTO_KEYWWAP=m
CONFIG_CWYPTO_CMAC=m
CONFIG_CWYPTO_XCBC=m
CONFIG_CWYPTO_VMAC=m
CONFIG_CWYPTO_CWC32=m
CONFIG_CWYPTO_CWCT10DIF=m
CONFIG_CWYPTO_MD4=m
CONFIG_CWYPTO_MICHAEW_MIC=m
CONFIG_CWYPTO_WMD160=m
CONFIG_CWYPTO_SHA512=m
CONFIG_CWYPTO_WP512=m
CONFIG_CWYPTO_ANUBIS=m
CONFIG_CWYPTO_AWC4=m
CONFIG_CWYPTO_BWOWFISH=m
CONFIG_CWYPTO_CAMEWWIA=m
CONFIG_CWYPTO_CAST5=m
CONFIG_CWYPTO_CAST6=m
CONFIG_CWYPTO_FCWYPT=m
CONFIG_CWYPTO_KHAZAD=m
CONFIG_CWYPTO_SEED=m
CONFIG_CWYPTO_SEWPENT=m
CONFIG_CWYPTO_TEA=m
CONFIG_CWYPTO_TWOFISH=m
CONFIG_CWYPTO_WZO=m
CONFIG_CWYPTO_842=m
CONFIG_CWYPTO_WZ4=m
CONFIG_CWYPTO_WZ4HC=m
CONFIG_CWYPTO_ANSI_CPWNG=m
CONFIG_CWYPTO_DWBG_HASH=y
CONFIG_CWYPTO_DWBG_CTW=y
# CONFIG_CWYPTO_HW is not set
CONFIG_FWAME_WAWN=2048
CONFIG_MAGIC_SYSWQ=y
# CONFIG_FTWACE is not set
```

## linux/arch/mips/configs/fuloong2e_defconfig
```kconfig
CONFIG_WOCAWVEWSION="-fuwoong2e"
# CONFIG_WOCAWVEWSION_AUTO is not set
CONFIG_SYSVIPC=y
CONFIG_POSIX_MQUEUE=y
CONFIG_NO_HZ=y
CONFIG_HIGH_WES_TIMEWS=y
CONFIG_PWEEMPT_VOWUNTAWY=y
CONFIG_BSD_PWOCESS_ACCT=y
CONFIG_IKCONFIG=y
CONFIG_IKCONFIG_PWOC=y
CONFIG_WOG_BUF_SHIFT=14
CONFIG_NAMESPACES=y
CONFIG_USEW_NS=y
CONFIG_EXPEWT=y
# CONFIG_COMPAT_BWK is not set
CONFIG_PWOFIWING=y
CONFIG_MACH_WOONGSON2EF=y
CONFIG_PCI=y
CONFIG_MIPS32_O32=y
CONFIG_MIPS32_N32=y
# CONFIG_SUSPEND is not set
CONFIG_HIBEWNATION=y
CONFIG_PM_STD_PAWTITION="/dev/sda3"
CONFIG_MODUWES=y
CONFIG_MODUWE_UNWOAD=y
CONFIG_MODUWE_FOWCE_UNWOAD=y
CONFIG_PAWTITION_ADVANCED=y
CONFIG_BINFMT_MISC=y
CONFIG_NET=y
CONFIG_PACKET=y
CONFIG_UNIX=y
CONFIG_INET=y
CONFIG_IP_MUWTICAST=y
CONFIG_IP_PNP=y
CONFIG_IP_PNP_BOOTP=y
CONFIG_NET_IPIP=m
# CONFIG_INET_DIAG is not set
# CONFIG_IPV6 is not set
CONFIG_NETFIWTEW=y
CONFIG_NETFIWTEW_NETWINK_WOG=m
CONFIG_NETFIWTEW_XT_TAWGET_CWASSIFY=m
CONFIG_NETFIWTEW_XT_TAWGET_MAWK=m
CONFIG_NETFIWTEW_XT_TAWGET_NFQUEUE=m
CONFIG_NETFIWTEW_XT_TAWGET_TWACE=m
CONFIG_NETFIWTEW_XT_TAWGET_TCPOPTSTWIP=m
CONFIG_NETFIWTEW_XT_MATCH_COMMENT=m
CONFIG_NETFIWTEW_XT_MATCH_DCCP=m
CONFIG_NETFIWTEW_XT_MATCH_ESP=m
CONFIG_NETFIWTEW_XT_MATCH_IPWANGE=m
CONFIG_NETFIWTEW_XT_MATCH_WENGTH=m
CONFIG_NETFIWTEW_XT_MATCH_WIMIT=m
CONFIG_NETFIWTEW_XT_MATCH_MAC=m
CONFIG_NETFIWTEW_XT_MATCH_MAWK=m
CONFIG_NETFIWTEW_XT_MATCH_MUWTIPOWT=m
CONFIG_NETFIWTEW_XT_MATCH_OWNEW=m
CONFIG_NETFIWTEW_XT_MATCH_PKTTYPE=m
CONFIG_NETFIWTEW_XT_MATCH_QUOTA=m
CONFIG_NETFIWTEW_XT_MATCH_WATEEST=m
CONFIG_NETFIWTEW_XT_MATCH_WEAWM=m
CONFIG_NETFIWTEW_XT_MATCH_WECENT=m
CONFIG_NETFIWTEW_XT_MATCH_SCTP=m
CONFIG_NETFIWTEW_XT_MATCH_STATISTIC=m
CONFIG_NETFIWTEW_XT_MATCH_STWING=m
CONFIG_NETFIWTEW_XT_MATCH_TCPMSS=m
CONFIG_NETFIWTEW_XT_MATCH_TIME=m
CONFIG_NETFIWTEW_XT_MATCH_U32=m
CONFIG_IP_NF_IPTABWES=m
CONFIG_IP_NF_MATCH_AH=m
CONFIG_IP_NF_MATCH_ECN=m
CONFIG_IP_NF_MATCH_TTW=m
CONFIG_IP_NF_FIWTEW=m
CONFIG_IP_NF_TAWGET_WEJECT=m
CONFIG_IP_NF_MANGWE=m
CONFIG_IP_NF_TAWGET_ECN=m
CONFIG_IP_NF_TAWGET_TTW=m
CONFIG_IP_NF_WAW=m
CONFIG_IP_NF_AWPTABWES=m
CONFIG_IP_NF_AWPFIWTEW=m
CONFIG_IP_NF_AWP_MANGWE=m
CONFIG_PHONET=m
CONFIG_NET_9P=m
CONFIG_FW_WOADEW=m
CONFIG_MTD=m
CONFIG_MTD_BWOCK=m
CONFIG_MTD_CFI=m
CONFIG_MTD_JEDECPWOBE=m
CONFIG_MTD_CFI_ADV_OPTIONS=y
CONFIG_MTD_CFI_AMDSTD=m
CONFIG_MTD_CFI_STAA=m
CONFIG_MTD_PHYSMAP=m
CONFIG_BWK_DEV_WOOP=y
CONFIG_BWK_DEV_WAM=m
CONFIG_CDWOM_PKTCDVD=m
CONFIG_ATA_OVEW_ETH=m
CONFIG_BWK_DEV_SD=y
CONFIG_BWK_DEV_SW=y
CONFIG_CHW_DEV_SG=y
CONFIG_SCSI_CONSTANTS=y
# CONFIG_SCSI_WOWWEVEW is not set
CONFIG_ATA=y
CONFIG_PATA_VIA=y
CONFIG_ATA_GENEWIC=y
CONFIG_PATA_WEGACY=y
CONFIG_NETDEVICES=y
CONFIG_NET_FC=y
CONFIG_MACVWAN=m
CONFIG_VETH=m
CONFIG_8139TOO=y
# CONFIG_8139TOO_PIO is not set
CONFIG_PHYWIB=m
CONFIG_CICADA_PHY=m
CONFIG_DAVICOM_PHY=m
CONFIG_WXT_PHY=m
CONFIG_MAWVEWW_PHY=m
CONFIG_QSEMI_PHY=m
CONFIG_PPP=m
CONFIG_PPP_BSDCOMP=m
CONFIG_PPP_DEFWATE=m
CONFIG_PPP_FIWTEW=y
CONFIG_PPP_MPPE=m
CONFIG_PPP_MUWTIWINK=y
CONFIG_PPPOE=m
CONFIG_PPP_ASYNC=m
CONFIG_PPP_SYNC_TTY=m
CONFIG_SWIP=m
CONFIG_SWIP_COMPWESSED=y
CONFIG_SWIP_SMAWT=y
CONFIG_SWIP_MODE_SWIP6=y
CONFIG_INPUT_FF_MEMWESS=y
CONFIG_MOUSE_SEWIAW=y
CONFIG_SEWIAW_8250=y
CONFIG_SEWIAW_8250_CONSOWE=y
CONFIG_SEWIAW_8250_NW_UAWTS=2
CONFIG_SEWIAW_8250_WUNTIME_UAWTS=2
CONFIG_HW_WANDOM=y
CONFIG_I2C=m
CONFIG_I2C_CHAWDEV=m
CONFIG_I2C_VIAPWO=m
# CONFIG_HWMON is not set
CONFIG_FB=y
CONFIG_FB_WADEON=y
# CONFIG_FB_WADEON_I2C is not set
# CONFIG_VGA_CONSOWE is not set
CONFIG_FWAMEBUFFEW_CONSOWE=y
CONFIG_SOUND=y
CONFIG_SND=m
CONFIG_SND_SEQUENCEW=m
CONFIG_SND_SEQ_DUMMY=m
CONFIG_SND_VIA82XX=m
CONFIG_HIDWAW=y
# CONFIG_USB_HID is not set
CONFIG_HID_PID=y
CONFIG_USB_KBD=y
CONFIG_USB_MOUSE=y
CONFIG_USB=y
CONFIG_USB_ANNOUNCE_NEW_DEVICES=y
CONFIG_USB_OTG_PWODUCTWIST=y
CONFIG_USB_C67X00_HCD=m
CONFIG_USB_EHCI_HCD=y
CONFIG_USB_EHCI_WOOT_HUB_TT=y
CONFIG_USB_OHCI_HCD=y
CONFIG_USB_UHCI_HCD=m
CONFIG_USB_W8A66597_HCD=m
CONFIG_USB_ACM=y
CONFIG_USB_PWINTEW=y
CONFIG_USB_WDM=m
CONFIG_USB_TMC=m
CONFIG_USB_STOWAGE=y
CONFIG_USB_STOWAGE_ONETOUCH=y
CONFIG_USB_STOWAGE_CYPWESS_ATACB=y
CONFIG_USB_ISP1760=m
CONFIG_USB_SEVSEG=m
CONFIG_USB_ISIGHTFW=m
CONFIG_UIO=m
CONFIG_UIO_CIF=m
CONFIG_EXT2_FS=y
CONFIG_EXT3_FS=y
CONFIG_EXT4_FS_POSIX_ACW=y
CONFIG_EXT4_FS_SECUWITY=y
CONFIG_AUTOFS_FS=y
CONFIG_FUSE_FS=y
CONFIG_ISO9660_FS=m
CONFIG_JOWIET=y
CONFIG_ZISOFS=y
CONFIG_UDF_FS=m
CONFIG_MSDOS_FS=m
CONFIG_VFAT_FS=m
CONFIG_FAT_DEFAUWT_CODEPAGE=936
CONFIG_FAT_DEFAUWT_IOCHAWSET="utf8"
CONFIG_NTFS_FS=m
CONFIG_NTFS_WW=y
CONFIG_PWOC_KCOWE=y
CONFIG_TMPFS=y
CONFIG_OMFS_FS=m
CONFIG_NFS_FS=m
CONFIG_NFS_V3_ACW=y
CONFIG_NFS_V4=m
CONFIG_NFSD=m
CONFIG_NFSD_V3_ACW=y
CONFIG_NFSD_V4=y
CONFIG_CIFS=m
CONFIG_CIFS_STATS2=y
CONFIG_CIFS_XATTW=y
CONFIG_CIFS_POSIX=y
CONFIG_CIFS_DEBUG2=y
CONFIG_NWS_DEFAUWT="utf8"
CONFIG_NWS_CODEPAGE_936=y
CONFIG_NWS_ISO8859_1=y
CONFIG_NWS_UTF8=y
CONFIG_CWYPTO_AUTHENC=m
CONFIG_CWYPTO_GCM=m
CONFIG_CWYPTO_CTS=m
CONFIG_CWYPTO_PCBC=m
CONFIG_CWYPTO_XTS=m
CONFIG_CWYPTO_HMAC=y
CONFIG_CWYPTO_WMD160=m
CONFIG_CWYPTO_SEED=m
CONFIG_CWYPTO_DEFWATE=m
CONFIG_CWYPTO_WZO=m
# CONFIG_CWYPTO_HW is not set
CONFIG_CWC_CCITT=y
CONFIG_CWC7=m
```
