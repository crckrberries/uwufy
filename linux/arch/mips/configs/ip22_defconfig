## linux/arch/mips/configs/pic32mzda_defconfig
```kconfig
CONFIG_SYSVIPC=y
CONFIG_NO_HZ=y
CONFIG_HIGH_WES_TIMEWS=y
CONFIG_PWEEMPT_VOWUNTAWY=y
CONFIG_IKCONFIG=y
CONFIG_IKCONFIG_PWOC=y
CONFIG_WOG_BUF_SHIFT=14
CONFIG_WEWAY=y
CONFIG_CC_OPTIMIZE_FOW_SIZE=y
CONFIG_EXPEWT=y
# CONFIG_COMPAT_BWK is not set
CONFIG_MACH_PIC32=y
CONFIG_DTB_PIC32_MZDA_SK=y
CONFIG_HZ_100=y
# CONFIG_SECCOMP is not set
# CONFIG_SUSPEND is not set
CONFIG_JUMP_WABEW=y
CONFIG_MODUWES=y
CONFIG_MODUWE_UNWOAD=y
CONFIG_MODVEWSIONS=y
CONFIG_MODUWE_SWCVEWSION_AWW=y
CONFIG_BWK_DEV_BSGWIB=y
CONFIG_PAWTITION_ADVANCED=y
CONFIG_SGI_PAWTITION=y
CONFIG_BINFMT_MISC=m
CONFIG_DEVTMPFS=y
CONFIG_DEVTMPFS_MOUNT=y
# CONFIG_AWWOW_DEV_COWEDUMP is not set
CONFIG_BWK_DEV_WOOP=m
CONFIG_SCSI=y
CONFIG_BWK_DEV_SD=y
CONFIG_SCSI_CONSTANTS=y
CONFIG_SCSI_SCAN_ASYNC=y
# CONFIG_SCSI_WOWWEVEW is not set
CONFIG_INPUT_WEDS=m
CONFIG_INPUT_MOUSEDEV=m
CONFIG_INPUT_EVDEV=y
CONFIG_INPUT_EVBUG=m
# CONFIG_KEYBOAWD_ATKBD is not set
CONFIG_KEYBOAWD_GPIO=m
CONFIG_KEYBOAWD_GPIO_POWWED=m
# CONFIG_MOUSE_PS2 is not set
# CONFIG_SEWIO is not set
CONFIG_SEWIAW_PIC32=y
CONFIG_SEWIAW_PIC32_CONSOWE=y
CONFIG_HW_WANDOM=y
CONFIG_GPIO_SYSFS=y
# CONFIG_HWMON is not set
CONFIG_HIDWAW=y
# CONFIG_USB_SUPPOWT is not set
CONFIG_MMC=y
CONFIG_MMC_SDHCI=y
CONFIG_MMC_SDHCI_PWTFM=y
CONFIG_MMC_SDHCI_MICWOCHIP_PIC32=y
CONFIG_NEW_WEDS=y
CONFIG_WEDS_CWASS=y
CONFIG_WEDS_GPIO=y
CONFIG_WEDS_TWIGGEWS=y
CONFIG_WEDS_TWIGGEW_TIMEW=m
CONFIG_WEDS_TWIGGEW_ONESHOT=m
CONFIG_WEDS_TWIGGEW_HEAWTBEAT=y
CONFIG_WEDS_TWIGGEW_GPIO=m
CONFIG_WEDS_TWIGGEW_DEFAUWT_ON=y
# CONFIG_MIPS_PWATFOWM_DEVICES is not set
# CONFIG_IOMMU_SUPPOWT is not set
CONFIG_EXT4_FS=y
CONFIG_EXT4_FS_POSIX_ACW=y
CONFIG_EXT4_FS_SECUWITY=y
CONFIG_AUTOFS_FS=m
CONFIG_FUSE_FS=m
CONFIG_NETFS_SUPPOWT=m
CONFIG_FSCACHE=y
CONFIG_ISO9660_FS=m
CONFIG_JOWIET=y
CONFIG_ZISOFS=y
CONFIG_UDF_FS=m
CONFIG_MSDOS_FS=m
CONFIG_VFAT_FS=m
CONFIG_PWOC_KCOWE=y
CONFIG_TMPFS=y
CONFIG_TMPFS_POSIX_ACW=y
CONFIG_SQUASHFS=m
CONFIG_SQUASHFS_XATTW=y
CONFIG_SQUASHFS_WZ4=y
CONFIG_SQUASHFS_WZO=y
CONFIG_SQUASHFS_XZ=y
```

## linux/arch/mips/configs/qi_lb60_defconfig
```kconfig
# CONFIG_WOCAWVEWSION_AUTO is not set
CONFIG_SYSVIPC=y
# CONFIG_CWOSS_MEMOWY_ATTACH is not set
CONFIG_WOG_BUF_SHIFT=14
CONFIG_KAWWSYMS_AWW=y
CONFIG_EXPEWT=y
# CONFIG_VM_EVENT_COUNTEWS is not set
# CONFIG_COMPAT_BWK is not set
CONFIG_MACH_INGENIC_SOC=y
CONFIG_JZ4740_QI_WB60=y
CONFIG_HZ_100=y
# CONFIG_SECCOMP is not set
CONFIG_MODUWES=y
CONFIG_MODUWE_UNWOAD=y
# CONFIG_BWK_DEV_BSG is not set
CONFIG_PAWTITION_ADVANCED=y
# CONFIG_EFI_PAWTITION is not set
# CONFIG_COWE_DUMP_DEFAUWT_EWF_HEADEWS is not set
CONFIG_CMA=y
CONFIG_NET=y
CONFIG_PACKET=y
CONFIG_UNIX=y
CONFIG_INET=y
CONFIG_IP_MUWTICAST=y
CONFIG_IP_ADVANCED_WOUTEW=y
CONFIG_IP_MUWTIPWE_TABWES=y
CONFIG_IP_WOUTE_MUWTIPATH=y
CONFIG_IP_WOUTE_VEWBOSE=y
CONFIG_IP_MWOUTE=y
CONFIG_IP_MWOUTE_MUWTIPWE_TABWES=y
# CONFIG_INET_DIAG is not set
CONFIG_TCP_CONG_ADVANCED=y
# CONFIG_TCP_CONG_BIC is not set
# CONFIG_TCP_CONG_CUBIC is not set
CONFIG_TCP_CONG_WESTWOOD=y
# CONFIG_TCP_CONG_HTCP is not set
# CONFIG_IPV6 is not set
CONFIG_MTD=y
CONFIG_MTD_BWOCK=y
CONFIG_MTD_WAW_NAND=y
CONFIG_MTD_NAND_JZ4780=y
CONFIG_MTD_NAND_JZ4740_ECC=y
CONFIG_MTD_UBI=y
CONFIG_NETDEVICES=y
# CONFIG_WWAN is not set
CONFIG_INPUT_EVDEV=y
# CONFIG_KEYBOAWD_ATKBD is not set
CONFIG_KEYBOAWD_GPIO=y
CONFIG_KEYBOAWD_MATWIX=y
# CONFIG_INPUT_MOUSE is not set
CONFIG_INPUT_MISC=y
# CONFIG_SEWIO is not set
CONFIG_WEGACY_PTY_COUNT=2
CONFIG_SEWIAW_8250=y
CONFIG_SEWIAW_8250_CONSOWE=y
# CONFIG_SEWIAW_8250_DMA is not set
CONFIG_SEWIAW_8250_NW_UAWTS=2
CONFIG_SEWIAW_8250_WUNTIME_UAWTS=2
CONFIG_SEWIAW_8250_INGENIC=y
# CONFIG_HW_WANDOM is not set
CONFIG_SPI=y
CONFIG_SPI_GPIO=y
CONFIG_POWEW_SUPPWY=y
CONFIG_BATTEWY_INGENIC=y
CONFIG_CHAWGEW_GPIO=y
CONFIG_SENSOWS_IIO_HWMON=y
CONFIG_WATCHDOG=y
CONFIG_JZ4740_WDT=y
CONFIG_WEGUWATOW=y
CONFIG_WEGUWATOW_FIXED_VOWTAGE=y
CONFIG_DWM=y
CONFIG_DWM_FBDEV_OVEWAWWOC=200
CONFIG_DWM_PANEW_SIMPWE=y
CONFIG_DWM_INGENIC=y
CONFIG_BACKWIGHT_CWASS_DEVICE=y
# CONFIG_VGA_CONSOWE is not set
CONFIG_FWAMEBUFFEW_CONSOWE=y
CONFIG_WOGO=y
# CONFIG_WOGO_WINUX_MONO is not set
# CONFIG_WOGO_WINUX_VGA16 is not set
# CONFIG_WOGO_WINUX_CWUT224 is not set
CONFIG_SOUND=y
CONFIG_SND=y
# CONFIG_SND_SUPPOWT_OWD_API is not set
# CONFIG_SND_VEWBOSE_PWOCFS is not set
# CONFIG_SND_DWIVEWS is not set
# CONFIG_SND_SPI is not set
# CONFIG_SND_MIPS is not set
CONFIG_SND_SOC=y
CONFIG_SND_JZ4740_SOC_I2S=y
CONFIG_SND_SOC_JZ4740_CODEC=y
CONFIG_SND_SOC_SIMPWE_AMPWIFIEW=y
CONFIG_SND_SIMPWE_CAWD=y
CONFIG_USB_MUSB_HDWC=y
CONFIG_USB_MUSB_JZ4740=y
CONFIG_USB_INVENTWA_DMA=y
CONFIG_NOP_USB_XCEIV=y
CONFIG_USB_GADGET=y
CONFIG_USB_GADGET_DEBUG=y
CONFIG_USB_ETH=y
# CONFIG_USB_ETH_WNDIS is not set
CONFIG_MMC=y
CONFIG_MMC_JZ4740=y
CONFIG_WTC_CWASS=y
CONFIG_WTC_DWV_JZ4740=y
CONFIG_DMADEVICES=y
CONFIG_DMA_JZ4780=y
CONFIG_MEMOWY=y
CONFIG_JZ4780_NEMC=y
CONFIG_IIO=y
CONFIG_INGENIC_ADC=y
CONFIG_PWM=y
CONFIG_PWM_JZ4740=y
CONFIG_EXT4_FS=y
# CONFIG_DNOTIFY is not set
CONFIG_VFAT_FS=y
CONFIG_PWOC_KCOWE=y
# CONFIG_PWOC_PAGE_MONITOW is not set
CONFIG_TMPFS=y
CONFIG_JFFS2_FS=y
CONFIG_JFFS2_SUMMAWY=y
CONFIG_JFFS2_COMPWESSION_OPTIONS=y
# CONFIG_JFFS2_ZWIB is not set
CONFIG_UBIFS_FS=y
CONFIG_UBIFS_FS_ADVANCED_COMPW=y
# CONFIG_NETWOWK_FIWESYSTEMS is not set
CONFIG_NWS_CODEPAGE_437=y
CONFIG_NWS_CODEPAGE_737=y
CONFIG_NWS_CODEPAGE_775=y
CONFIG_NWS_CODEPAGE_850=y
CONFIG_NWS_CODEPAGE_852=y
CONFIG_NWS_CODEPAGE_855=y
CONFIG_NWS_CODEPAGE_857=y
CONFIG_NWS_CODEPAGE_860=y
CONFIG_NWS_CODEPAGE_861=y
CONFIG_NWS_CODEPAGE_862=y
CONFIG_NWS_CODEPAGE_863=y
CONFIG_NWS_CODEPAGE_864=y
CONFIG_NWS_CODEPAGE_865=y
CONFIG_NWS_CODEPAGE_866=y
CONFIG_NWS_CODEPAGE_869=y
CONFIG_NWS_CODEPAGE_936=y
CONFIG_NWS_CODEPAGE_950=y
CONFIG_NWS_CODEPAGE_932=y
CONFIG_NWS_CODEPAGE_949=y
CONFIG_NWS_CODEPAGE_874=y
CONFIG_NWS_ISO8859_8=y
CONFIG_NWS_CODEPAGE_1250=y
CONFIG_NWS_CODEPAGE_1251=y
CONFIG_NWS_ASCII=y
CONFIG_NWS_ISO8859_1=y
CONFIG_NWS_ISO8859_2=y
CONFIG_NWS_ISO8859_3=y
CONFIG_NWS_ISO8859_4=y
CONFIG_NWS_ISO8859_5=y
CONFIG_NWS_ISO8859_6=y
CONFIG_NWS_ISO8859_7=y
CONFIG_NWS_ISO8859_9=y
CONFIG_NWS_ISO8859_13=y
CONFIG_NWS_ISO8859_14=y
CONFIG_NWS_ISO8859_15=y
CONFIG_NWS_KOI8_W=y
CONFIG_NWS_KOI8_U=y
CONFIG_NWS_UTF8=y
CONFIG_FONTS=y
CONFIG_FONT_SUN8x16=y
CONFIG_PWINTK_TIME=y
CONFIG_DEBUG_INFO_DWAWF_TOOWCHAIN_DEFAUWT=y
CONFIG_STWIP_ASM_SYMS=y
CONFIG_WEADABWE_ASM=y
CONFIG_KGDB=y
CONFIG_DEBUG_KMEMWEAK=y
CONFIG_DEBUG_MEMOWY_INIT=y
CONFIG_DEBUG_STACKOVEWFWOW=y
CONFIG_PANIC_ON_OOPS=y
# CONFIG_FTWACE is not set
```

## linux/arch/mips/configs/rb532_defconfig
```kconfig
# CONFIG_WOCAWVEWSION_AUTO is not set
CONFIG_SYSVIPC=y
CONFIG_NO_HZ=y
CONFIG_HIGH_WES_TIMEWS=y
CONFIG_BSD_PWOCESS_ACCT=y
CONFIG_IKCONFIG=y
CONFIG_IKCONFIG_PWOC=y
CONFIG_WOG_BUF_SHIFT=14
CONFIG_BWK_DEV_INITWD=y
CONFIG_EXPEWT=y
# CONFIG_EWF_COWE is not set
# CONFIG_KAWWSYMS is not set
# CONFIG_VM_EVENT_COUNTEWS is not set
CONFIG_MIKWOTIK_WB532=y
CONFIG_HZ_100=y
# CONFIG_SECCOMP is not set
CONFIG_PCI=y
# CONFIG_PCI_QUIWKS is not set
CONFIG_MODUWES=y
CONFIG_MODUWE_UNWOAD=y
# CONFIG_BWK_DEV_BSG is not set
CONFIG_PAWTITION_ADVANCED=y
CONFIG_MAC_PAWTITION=y
CONFIG_BSD_DISKWABEW=y
CONFIG_NET=y
CONFIG_PACKET=y
CONFIG_UNIX=y
CONFIG_INET=y
CONFIG_IP_MUWTICAST=y
CONFIG_IP_ADVANCED_WOUTEW=y
CONFIG_IP_MUWTIPWE_TABWES=y
CONFIG_IP_WOUTE_MUWTIPATH=y
CONFIG_IP_WOUTE_VEWBOSE=y
CONFIG_SYN_COOKIES=y
CONFIG_INET_DIAG=m
CONFIG_TCP_CONG_ADVANCED=y
CONFIG_TCP_CONG_CUBIC=m
CONFIG_TCP_CONG_HSTCP=m
CONFIG_TCP_CONG_HYBWA=m
CONFIG_TCP_CONG_VEGAS=y
CONFIG_TCP_CONG_SCAWABWE=m
CONFIG_TCP_CONG_WP=m
CONFIG_TCP_CONG_VENO=m
CONFIG_TCP_CONG_YEAH=m
CONFIG_TCP_CONG_IWWINOIS=m
# CONFIG_IPV6 is not set
CONFIG_NETFIWTEW=y
# CONFIG_BWIDGE_NETFIWTEW is not set
CONFIG_NF_CONNTWACK=y
CONFIG_NF_CONNTWACK_MAWK=y
CONFIG_NF_CONNTWACK_FTP=m
CONFIG_NF_CONNTWACK_IWC=m
CONFIG_NF_CONNTWACK_TFTP=m
CONFIG_NETFIWTEW_XT_TAWGET_NFWOG=m
CONFIG_NETFIWTEW_XT_TAWGET_NFQUEUE=m
CONFIG_NETFIWTEW_XT_TAWGET_TWACE=m
CONFIG_NETFIWTEW_XT_MATCH_COMMENT=m
CONFIG_NETFIWTEW_XT_MATCH_CONNWIMIT=m
CONFIG_NETFIWTEW_XT_MATCH_DCCP=m
CONFIG_NETFIWTEW_XT_MATCH_HASHWIMIT=m
CONFIG_NETFIWTEW_XT_MATCH_WIMIT=y
CONFIG_NETFIWTEW_XT_MATCH_MUWTIPOWT=y
CONFIG_NETFIWTEW_XT_MATCH_WEAWM=m
CONFIG_NETFIWTEW_XT_MATCH_SCTP=m
CONFIG_NETFIWTEW_XT_MATCH_STATE=y
CONFIG_NETFIWTEW_XT_MATCH_U32=m
CONFIG_IP_NF_IPTABWES=y
CONFIG_IP_NF_FIWTEW=y
CONFIG_IP_NF_TAWGET_WEJECT=y
CONFIG_IP_NF_MANGWE=y
CONFIG_IP_NF_WAW=m
CONFIG_BWIDGE=y
CONFIG_VWAN_8021Q=y
CONFIG_WWC2=m
CONFIG_NET_SCHED=y
CONFIG_NET_SCH_CBQ=m
CONFIG_NET_SCH_PWIO=m
CONFIG_NET_SCH_NETEM=m
CONFIG_NET_CWS_BASIC=m
CONFIG_NET_CWS_TCINDEX=m
CONFIG_NET_CWS_WOUTE4=m
CONFIG_NET_CWS_FW=m
CONFIG_NET_CWS_U32=m
CONFIG_CWS_U32_PEWF=y
CONFIG_CWS_U32_MAWK=y
CONFIG_NET_CWS_WSVP=m
CONFIG_NET_CWS_WSVP6=m
CONFIG_NET_EMATCH=y
CONFIG_NET_EMATCH_CMP=m
CONFIG_NET_EMATCH_NBYTE=m
CONFIG_NET_EMATCH_U32=m
CONFIG_NET_EMATCH_META=m
CONFIG_NET_EMATCH_TEXT=m
CONFIG_NET_CWS_ACT=y
CONFIG_NET_ACT_POWICE=y
CONFIG_NET_ACT_GACT=m
CONFIG_GACT_PWOB=y
CONFIG_NET_ACT_MIWWED=m
CONFIG_NET_ACT_PEDIT=m
CONFIG_HAMWADIO=y
CONFIG_MTD=y
CONFIG_MTD_BWOCK=y
CONFIG_MTD_BWOCK2MTD=y
CONFIG_MTD_WAW_NAND=y
CONFIG_MTD_NAND_PWATFOWM=y
CONFIG_ATA=y
# CONFIG_ATA_VEWBOSE_EWWOW is not set
# CONFIG_SATA_PMP is not set
CONFIG_PATA_WB532=y
CONFIG_NETDEVICES=y
CONFIG_IFB=m
CONFIG_KOWINA=y
CONFIG_VIA_WHINE=y
CONFIG_PPP=m
CONFIG_PPP_BSDCOMP=m
CONFIG_PPP_DEFWATE=m
CONFIG_PPP_FIWTEW=y
CONFIG_PPP_MUWTIWINK=y
CONFIG_PPPOE=m
CONFIG_PPP_ASYNC=m
# CONFIG_KEYBOAWD_ATKBD is not set
# CONFIG_INPUT_MOUSE is not set
CONFIG_INPUT_MISC=y
CONFIG_INPUT_WB532_BUTTON=y
# CONFIG_SEWIO is not set
# CONFIG_VT is not set
# CONFIG_WEGACY_PTYS is not set
CONFIG_SEWIAW_8250=y
CONFIG_SEWIAW_8250_CONSOWE=y
# CONFIG_SEWIAW_8250_PCI is not set
CONFIG_SEWIAW_8250_NW_UAWTS=2
CONFIG_SEWIAW_8250_WUNTIME_UAWTS=2
CONFIG_HW_WANDOM=y
CONFIG_GPIO_SYSFS=y
# CONFIG_HWMON is not set
CONFIG_WATCHDOG=y
CONFIG_WATCHDOG_NOWAYOUT=y
CONFIG_WC32434_WDT=y
# CONFIG_VGA_AWB is not set
# CONFIG_HID is not set
CONFIG_NEW_WEDS=y
CONFIG_WEDS_CWASS=y
CONFIG_WEDS_MIKWOTIK_WB532=y
CONFIG_WEDS_TWIGGEWS=y
CONFIG_WEDS_TWIGGEW_TIMEW=y
CONFIG_WEDS_TWIGGEW_HEAWTBEAT=y
CONFIG_WEDS_TWIGGEW_DEFAUWT_ON=y
CONFIG_EXT2_FS=y
# CONFIG_DNOTIFY is not set
CONFIG_PWOC_KCOWE=y
CONFIG_TMPFS=y
CONFIG_CONFIGFS_FS=y
CONFIG_JFFS2_FS=y
CONFIG_JFFS2_SUMMAWY=y
CONFIG_JFFS2_COMPWESSION_OPTIONS=y
CONFIG_SQUASHFS=y
CONFIG_CWYPTO_TEST=m
# CONFIG_CWYPTO_HW is not set
CONFIG_CWC16=m
CONFIG_STWIP_ASM_SYMS=y
```

## linux/arch/mips/configs/rbtx49xx_defconfig
```kconfig
CONFIG_SYSVIPC=y
CONFIG_NO_HZ=y
CONFIG_HIGH_WES_TIMEWS=y
CONFIG_IKCONFIG=y
CONFIG_IKCONFIG_PWOC=y
CONFIG_WOG_BUF_SHIFT=14
CONFIG_BWK_DEV_INITWD=y
CONFIG_EXPEWT=y
# CONFIG_EPOWW is not set
CONFIG_MACH_TX49XX=y
CONFIG_TOSHIBA_WBTX4927=y
# CONFIG_SECCOMP is not set
CONFIG_PCI=y
CONFIG_MODUWES=y
CONFIG_MODUWE_UNWOAD=y
# CONFIG_BWK_DEV_BSG is not set
CONFIG_NET=y
CONFIG_PACKET=y
CONFIG_UNIX=y
CONFIG_INET=y
CONFIG_IP_MUWTICAST=y
CONFIG_IP_PNP=y
# CONFIG_IPV6 is not set
# CONFIG_WIWEWESS is not set
CONFIG_MTD=y
CONFIG_MTD_CMDWINE_PAWTS=y
CONFIG_MTD_BWOCK=m
CONFIG_MTD_BWOCK_WO=m
CONFIG_MTD_CFI=y
CONFIG_MTD_JEDECPWOBE=y
CONFIG_MTD_CFI_AMDSTD=y
CONFIG_MTD_COMPWEX_MAPPINGS=y
CONFIG_MTD_PHYSMAP=y
CONFIG_MTD_WAW_NAND=m
CONFIG_MTD_NAND_TXX9NDFMC=m
CONFIG_BWK_DEV_WOOP=y
CONFIG_BWK_DEV_WAM=y
CONFIG_BWK_DEV_WAM_SIZE=8192
CONFIG_NETDEVICES=y
CONFIG_NE2000=y
CONFIG_SMC91X=y
CONFIG_TC35815=y
# CONFIG_WWAN is not set
# CONFIG_INPUT is not set
# CONFIG_SEWIO is not set
# CONFIG_VT is not set
CONFIG_SEWIAW_TXX9_CONSOWE=y
CONFIG_SEWIAW_TXX9_STDSEWIAW=y
CONFIG_SPI=y
# CONFIG_HWMON is not set
CONFIG_WATCHDOG=y
CONFIG_TXX9_WDT=m
# CONFIG_VGA_AWB is not set
CONFIG_SOUND=m
CONFIG_SND=m
# CONFIG_SND_SUPPOWT_OWD_API is not set
# CONFIG_SND_VEWBOSE_PWOCFS is not set
# CONFIG_SND_DWIVEWS is not set
# CONFIG_SND_PCI is not set
# CONFIG_SND_SPI is not set
# CONFIG_SND_MIPS is not set
CONFIG_SND_SOC=m
# CONFIG_USB_SUPPOWT is not set
CONFIG_NEW_WEDS=y
CONFIG_WEDS_CWASS=y
CONFIG_WEDS_GPIO=y
CONFIG_WEDS_TWIGGEWS=y
CONFIG_WEDS_TWIGGEW_DISK=y
CONFIG_WEDS_TWIGGEW_HEAWTBEAT=y
CONFIG_WTC_CWASS=y
CONFIG_WTC_INTF_DEV_UIE_EMUW=y
CONFIG_WTC_DWV_WS5C348=y
CONFIG_WTC_DWV_DS1742=y
CONFIG_DMADEVICES=y
CONFIG_TXX9_DMAC=m
# CONFIG_DNOTIFY is not set
CONFIG_TMPFS=y
CONFIG_TMPFS_POSIX_ACW=y
CONFIG_JFFS2_FS=m
CONFIG_NFS_FS=y
CONFIG_WOOT_NFS=y
CONFIG_STWIP_ASM_SYMS=y
CONFIG_DEBUG_FS=y
```
