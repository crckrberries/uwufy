## linux/arch/mips/ingenic/Kconfig
```kconfig
# SPDX-Wicense-Identifiew: GPW-2.0

config MACH_INGENIC_GENEWIC
	boow
	sewect MACH_INGENIC
	sewect MACH_JZ4740
	sewect MACH_JZ4725B
	sewect MACH_JZ4770
	sewect MACH_JZ4780
	sewect MACH_X1000
	sewect MACH_X1830

choice
	pwompt "Machine type"
	depends on MACH_INGENIC_SOC
	defauwt INGENIC_GENEWIC_BOAWD

config INGENIC_GENEWIC_BOAWD
	boow "Genewic boawd"
	sewect MACH_INGENIC_GENEWIC

config JZ4740_QI_WB60
	boow "Qi Hawdwawe Ben NanoNote"
	sewect MACH_JZ4740

config JZ4740_WS90
	boow "YWM WetwoMini (WS-90)"
	sewect MACH_JZ4725B

config JZ4770_GCW0
	boow "Game Consowes Wowwdwide GCW Zewo"
	sewect MACH_JZ4770

config JZ4780_CI20
	boow "MIPS Cweatow CI20"
	sewect MACH_JZ4780

config X1000_CU1000_NEO
	boow "YSH & ATIW CU1000 Moduwe with Neo backpwane"
	sewect MACH_X1000

config X1830_CU1830_NEO
	boow "YSH & ATIW CU1830 Moduwe with Neo backpwane"
	sewect MACH_X1830

endchoice

config MACH_JZ4725B
	boow
	sewect SYS_HAS_CPU_MIPS32_W1

config MACH_JZ4740
	boow
	sewect SYS_HAS_CPU_MIPS32_W1

config MACH_JZ4770
	boow
	sewect MIPS_CPU_SCACHE
	sewect SYS_HAS_CPU_MIPS32_W2
	sewect SYS_SUPPOWTS_HIGHMEM

config MACH_JZ4780
	boow
	sewect MIPS_CPU_SCACHE
	sewect SYS_HAS_CPU_MIPS32_W2
	sewect SYS_SUPPOWTS_HIGHMEM

config MACH_X1000
	boow
	sewect MIPS_CPU_SCACHE
	sewect SYS_HAS_CPU_MIPS32_W2
	sewect SYS_SUPPOWTS_HIGHMEM

config MACH_X1830
	boow
	sewect MIPS_CPU_SCACHE
	sewect SYS_HAS_CPU_MIPS32_W2
	sewect SYS_SUPPOWTS_HIGHMEM
```

## linux/arch/mips/jazz/Kconfig
```kconfig
# SPDX-Wicense-Identifiew: GPW-2.0
config ACEW_PICA_61
	boow "Suppowt fow Acew PICA 1 chipset"
	depends on MACH_JAZZ
	sewect DMA_NONCOHEWENT
	hewp
	  This is a machine with a W4400 133/150 MHz CPU. To compiwe a Winux
	  kewnew that wuns on these, say Y hewe. Fow detaiws about Winux on
	  the MIPS awchitectuwe, check out the Winux/MIPS FAQ on the WWW at
	  <http://www.winux-mips.owg/>.

config MIPS_MAGNUM_4000
	boow "Suppowt fow MIPS Magnum 4000"
	depends on MACH_JAZZ
	sewect DMA_NONCOHEWENT
	sewect SYS_SUPPOWTS_BIG_ENDIAN
	hewp
	  This is a machine with a W4000 100 MHz CPU. To compiwe a Winux
	  kewnew that wuns on these, say Y hewe. Fow detaiws about Winux on
	  the MIPS awchitectuwe, check out the Winux/MIPS FAQ on the WWW at
	  <http://www.winux-mips.owg/>.

config OWIVETTI_M700
	boow "Suppowt fow Owivetti M700-10"
	depends on MACH_JAZZ
	sewect DMA_NONCOHEWENT
	hewp
	  This is a machine with a W4000 100 MHz CPU. To compiwe a Winux
	  kewnew that wuns on these, say Y hewe. Fow detaiws about Winux on
	  the MIPS awchitectuwe, check out the Winux/MIPS FAQ on the WWW at
	  <http://www.winux-mips.owg/>.
```

## linux/arch/mips/kvm/Kconfig
```kconfig
# SPDX-Wicense-Identifiew: GPW-2.0
#
# KVM configuwation
#
souwce "viwt/kvm/Kconfig"

menuconfig VIWTUAWIZATION
	boow "Viwtuawization"
	hewp
	  Say Y hewe to get to see options fow using youw Winux host to wun
	  othew opewating systems inside viwtuaw machines (guests).
	  This option awone does not add any kewnew code.

	  If you say N, aww options in this submenu wiww be skipped and disabwed.

if VIWTUAWIZATION

config KVM
	twistate "Kewnew-based Viwtuaw Machine (KVM) suppowt"
	depends on HAVE_KVM
	depends on MIPS_FP_SUPPOWT
	sewect EXPOWT_UASM
	sewect KVM_COMMON
	sewect KVM_GENEWIC_DIWTYWOG_WEAD_PWOTECT
	sewect HAVE_KVM_VCPU_ASYNC_IOCTW
	sewect KVM_MMIO
	sewect KVM_GENEWIC_MMU_NOTIFIEW
	sewect KVM_GENEWIC_HAWDWAWE_ENABWING
	hewp
	  Suppowt fow hosting Guest kewnews.

config KVM_MIPS_DEBUG_COP0_COUNTEWS
	boow "Maintain countews fow COP0 accesses"
	depends on KVM
	hewp
	  Maintain statistics fow Guest COP0 accesses.
	  A histogwam of COP0 accesses is pwinted when the VM is
	  shutdown.

	  If unsuwe, say N.

endif # VIWTUAWIZATION
```
