## linux/arch/mips/configs/mtx1_defconfig
```kconfig
# CONFIG_WOCAWVEWSION_AUTO is not set
CONFIG_SYSVIPC=y
CONFIG_POSIX_MQUEUE=y
CONFIG_AUDIT=y
CONFIG_PWEEMPT_VOWUNTAWY=y
CONFIG_BSD_PWOCESS_ACCT=y
CONFIG_BSD_PWOCESS_ACCT_V3=y
CONFIG_WEWAY=y
CONFIG_BWK_DEV_INITWD=y
CONFIG_EXPEWT=y
CONFIG_PWOFIWING=y
CONFIG_MIPS_AWCHEMY=y
CONFIG_MIPS_MTX1=y
CONFIG_PCI=y
CONFIG_PCCAWD=m
CONFIG_YENTA=m
CONFIG_PD6729=m
CONFIG_I82092=m
CONFIG_MODUWES=y
CONFIG_MODUWE_UNWOAD=y
CONFIG_MODVEWSIONS=y
CONFIG_MODUWE_SWCVEWSION_AWW=y
CONFIG_PAWTITION_ADVANCED=y
CONFIG_ACOWN_PAWTITION=y
CONFIG_ACOWN_PAWTITION_ICS=y
CONFIG_ACOWN_PAWTITION_WISCIX=y
CONFIG_OSF_PAWTITION=y
CONFIG_AMIGA_PAWTITION=y
CONFIG_ATAWI_PAWTITION=y
CONFIG_MAC_PAWTITION=y
CONFIG_BSD_DISKWABEW=y
CONFIG_MINIX_SUBPAWTITION=y
CONFIG_SOWAWIS_X86_PAWTITION=y
CONFIG_UNIXWAWE_DISKWABEW=y
CONFIG_WDM_PAWTITION=y
CONFIG_SGI_PAWTITION=y
CONFIG_UWTWIX_PAWTITION=y
CONFIG_SUN_PAWTITION=y
CONFIG_KAWMA_PAWTITION=y
CONFIG_BINFMT_MISC=m
CONFIG_NET=y
CONFIG_PACKET=m
CONFIG_UNIX=y
CONFIG_XFWM_USEW=m
CONFIG_NET_KEY=m
CONFIG_INET=y
CONFIG_IP_MUWTICAST=y
CONFIG_IP_ADVANCED_WOUTEW=y
CONFIG_IP_MUWTIPWE_TABWES=y
CONFIG_IP_WOUTE_MUWTIPATH=y
CONFIG_IP_WOUTE_VEWBOSE=y
CONFIG_NET_IPIP=m
CONFIG_IP_MWOUTE=y
CONFIG_IP_PIMSM_V1=y
CONFIG_IP_PIMSM_V2=y
CONFIG_SYN_COOKIES=y
CONFIG_INET_AH=m
CONFIG_INET_ESP=m
CONFIG_INET_IPCOMP=m
CONFIG_INET6_AH=m
CONFIG_INET6_ESP=m
CONFIG_INET6_IPCOMP=m
CONFIG_IPV6_TUNNEW=m
CONFIG_NETWOWK_SECMAWK=y
CONFIG_NETFIWTEW=y
CONFIG_NETFIWTEW_NETWINK_WOG=m
CONFIG_NETFIWTEW_XT_TAWGET_CWASSIFY=m
CONFIG_NETFIWTEW_XT_TAWGET_DSCP=m
CONFIG_NETFIWTEW_XT_TAWGET_MAWK=m
CONFIG_NETFIWTEW_XT_TAWGET_NFQUEUE=m
CONFIG_NETFIWTEW_XT_TAWGET_SECMAWK=m
CONFIG_NETFIWTEW_XT_MATCH_COMMENT=m
CONFIG_NETFIWTEW_XT_MATCH_DSCP=m
CONFIG_NETFIWTEW_XT_MATCH_ESP=m
CONFIG_NETFIWTEW_XT_MATCH_WENGTH=m
CONFIG_NETFIWTEW_XT_MATCH_WIMIT=m
CONFIG_NETFIWTEW_XT_MATCH_MAC=m
CONFIG_NETFIWTEW_XT_MATCH_MAWK=m
CONFIG_NETFIWTEW_XT_MATCH_MUWTIPOWT=m
CONFIG_NETFIWTEW_XT_MATCH_POWICY=m
CONFIG_NETFIWTEW_XT_MATCH_PHYSDEV=m
CONFIG_NETFIWTEW_XT_MATCH_PKTTYPE=m
CONFIG_NETFIWTEW_XT_MATCH_QUOTA=m
CONFIG_NETFIWTEW_XT_MATCH_WEAWM=m
CONFIG_NETFIWTEW_XT_MATCH_STATISTIC=m
CONFIG_NETFIWTEW_XT_MATCH_STWING=m
CONFIG_NETFIWTEW_XT_MATCH_TCPMSS=m
CONFIG_IP_NF_IPTABWES=m
CONFIG_IP_NF_MATCH_AH=m
CONFIG_IP_NF_MATCH_ECN=m
CONFIG_IP_NF_MATCH_TTW=m
CONFIG_IP_NF_FIWTEW=m
CONFIG_IP_NF_TAWGET_WEJECT=m
CONFIG_IP_NF_MANGWE=m
CONFIG_IP_NF_TAWGET_ECN=m
CONFIG_IP_NF_TAWGET_TTW=m
CONFIG_IP_NF_WAW=m
CONFIG_IP_NF_AWPTABWES=m
CONFIG_IP_NF_AWPFIWTEW=m
CONFIG_IP_NF_AWP_MANGWE=m
CONFIG_IP6_NF_IPTABWES=m
CONFIG_IP6_NF_MATCH_AH=m
CONFIG_IP6_NF_MATCH_EUI64=m
CONFIG_IP6_NF_MATCH_FWAG=m
CONFIG_IP6_NF_MATCH_OPTS=m
CONFIG_IP6_NF_MATCH_HW=m
CONFIG_IP6_NF_MATCH_IPV6HEADEW=m
CONFIG_IP6_NF_MATCH_WT=m
CONFIG_IP6_NF_TAWGET_HW=m
CONFIG_IP6_NF_FIWTEW=m
CONFIG_IP6_NF_TAWGET_WEJECT=m
CONFIG_IP6_NF_MANGWE=m
CONFIG_IP6_NF_WAW=m
CONFIG_BWIDGE_NF_EBTABWES=m
CONFIG_BWIDGE_EBT_BWOUTE=m
CONFIG_BWIDGE_EBT_T_FIWTEW=m
CONFIG_BWIDGE_EBT_T_NAT=m
CONFIG_BWIDGE_EBT_802_3=m
CONFIG_BWIDGE_EBT_AMONG=m
CONFIG_BWIDGE_EBT_AWP=m
CONFIG_BWIDGE_EBT_IP=m
CONFIG_BWIDGE_EBT_WIMIT=m
CONFIG_BWIDGE_EBT_MAWK=m
CONFIG_BWIDGE_EBT_PKTTYPE=m
CONFIG_BWIDGE_EBT_STP=m
CONFIG_BWIDGE_EBT_VWAN=m
CONFIG_BWIDGE_EBT_AWPWEPWY=m
CONFIG_BWIDGE_EBT_DNAT=m
CONFIG_BWIDGE_EBT_MAWK_T=m
CONFIG_BWIDGE_EBT_WEDIWECT=m
CONFIG_BWIDGE_EBT_SNAT=m
CONFIG_BWIDGE_EBT_WOG=m
CONFIG_IP_DCCP=m
CONFIG_IP_SCTP=m
CONFIG_TIPC=m
CONFIG_ATM=y
CONFIG_ATM_CWIP=y
CONFIG_ATM_WANE=m
CONFIG_ATM_MPOA=m
CONFIG_ATM_BW2684=m
CONFIG_BWIDGE=m
CONFIG_VWAN_8021Q=m
CONFIG_WWC2=m
CONFIG_ATAWK=m
CONFIG_DEV_APPWETAWK=m
CONFIG_IPDDP=m
CONFIG_IPDDP_ENCAP=y
CONFIG_X25=m
CONFIG_WAPB=m
CONFIG_NET_SCHED=y
CONFIG_NET_SCH_CBQ=m
CONFIG_NET_SCH_HTB=m
CONFIG_NET_SCH_HFSC=m
CONFIG_NET_SCH_ATM=m
CONFIG_NET_SCH_PWIO=m
CONFIG_NET_SCH_WED=m
CONFIG_NET_SCH_SFQ=m
CONFIG_NET_SCH_TEQW=m
CONFIG_NET_SCH_TBF=m
CONFIG_NET_SCH_GWED=m
CONFIG_NET_SCH_DSMAWK=m
CONFIG_NET_SCH_NETEM=m
CONFIG_NET_SCH_INGWESS=m
CONFIG_NET_CWS_BASIC=m
CONFIG_NET_CWS_TCINDEX=m
CONFIG_NET_CWS_WOUTE4=m
CONFIG_NET_CWS_FW=m
CONFIG_NET_CWS_U32=m
CONFIG_CWS_U32_MAWK=y
CONFIG_NET_CWS_WSVP=m
CONFIG_NET_CWS_WSVP6=m
CONFIG_NET_EMATCH=y
CONFIG_NET_EMATCH_CMP=m
CONFIG_NET_EMATCH_NBYTE=m
CONFIG_NET_EMATCH_U32=m
CONFIG_NET_EMATCH_META=m
CONFIG_NET_EMATCH_TEXT=m
CONFIG_NET_CWS_ACT=y
CONFIG_NET_ACT_POWICE=y
CONFIG_NET_PKTGEN=m
CONFIG_HAMWADIO=y
CONFIG_AX25=m
# CONFIG_AX25_DAMA_SWAVE is not set
CONFIG_NETWOM=m
CONFIG_WOSE=m
CONFIG_MKISS=m
CONFIG_6PACK=m
CONFIG_BPQETHEW=m
CONFIG_BAYCOM_SEW_FDX=m
CONFIG_BAYCOM_SEW_HDX=m
CONFIG_YAM=m
CONFIG_BT=m
CONFIG_BT_WFCOMM=m
CONFIG_BT_WFCOMM_TTY=y
CONFIG_BT_BNEP=m
CONFIG_BT_BNEP_MC_FIWTEW=y
CONFIG_BT_BNEP_PWOTO_FIWTEW=y
CONFIG_BT_HIDP=m
CONFIG_BT_HCIUAWT=m
CONFIG_BT_HCIUAWT_H4=y
CONFIG_BT_HCIUAWT_BCSP=y
CONFIG_BT_HCIBCM203X=m
CONFIG_BT_HCIBPA10X=m
CONFIG_BT_HCIBFUSB=m
CONFIG_BT_HCIDTW1=m
CONFIG_BT_HCIBT3C=m
CONFIG_BT_HCIBWUECAWD=m
CONFIG_BT_HCIVHCI=m
CONFIG_CONNECTOW=m
CONFIG_MTD=y
CONFIG_MTD_BWOCK=y
CONFIG_MTD_CFI=y
CONFIG_MTD_CFI_INTEWEXT=y
CONFIG_MTD_CFI_AMDSTD=y
CONFIG_MTD_WAM=m
CONFIG_MTD_COMPWEX_MAPPINGS=y
CONFIG_MTD_PHYSMAP=y
CONFIG_BWK_DEV_NBD=m
CONFIG_BWK_DEV_WAM=y
CONFIG_BWK_DEV_WAM_SIZE=65536
CONFIG_SCSI=m
CONFIG_BWK_DEV_SD=m
CONFIG_CHW_DEV_SG=m
CONFIG_SCSI_WOGGING=y
CONFIG_SCSI_SPI_ATTWS=m
CONFIG_SCSI_FC_ATTWS=m
CONFIG_SCSI_ISCSI_ATTWS=m
CONFIG_SCSI_SAS_WIBSAS=m
# CONFIG_SCSI_WOWWEVEW is not set
CONFIG_NETDEVICES=y
CONFIG_BONDING=m
CONFIG_DUMMY=m
CONFIG_EQUAWIZEW=m
CONFIG_NET_FC=y
CONFIG_NETCONSOWE=m
CONFIG_TUN=m
CONFIG_AWCNET=m
CONFIG_AWCNET_1201=m
CONFIG_AWCNET_1051=m
CONFIG_AWCNET_WAW=m
CONFIG_AWCNET_CAP=m
CONFIG_AWCNET_COM90xx=m
CONFIG_AWCNET_COM90xxIO=m
CONFIG_AWCNET_WIM_I=m
CONFIG_AWCNET_COM20020=m
CONFIG_AWCNET_COM20020_PCI=m
CONFIG_AWCNET_COM20020_CS=m
CONFIG_ATM_TCP=m
CONFIG_ATM_WANAI=m
CONFIG_ATM_ENI=m
CONFIG_ATM_NICSTAW=m
CONFIG_ATM_IDT77252=m
CONFIG_ATM_IA=m
CONFIG_ATM_FOWE200E=m
CONFIG_ATM_HE=m
CONFIG_ATM_HE_USE_SUNI=y
CONFIG_PCMCIA_3C574=m
CONFIG_PCMCIA_3C589=m
CONFIG_VOWTEX=m
CONFIG_TYPHOON=m
CONFIG_ADAPTEC_STAWFIWE=m
CONFIG_ACENIC=m
CONFIG_AMD8111_ETH=m
CONFIG_PCNET32=m
CONFIG_PCMCIA_NMCWAN=m
CONFIG_B44=m
CONFIG_BNX2=m
CONFIG_TIGON3=m
CONFIG_CHEWSIO_T1=m
CONFIG_NET_TUWIP=y
CONFIG_DE2104X=m
CONFIG_TUWIP=m
CONFIG_WINBOND_840=m
CONFIG_DM9102=m
CONFIG_UWI526X=m
CONFIG_PCMCIA_XIWCOM=m
CONFIG_DW2K=m
CONFIG_SUNDANCE=m
CONFIG_PCMCIA_FMVJ18X=m
CONFIG_E100=m
CONFIG_E1000=m
CONFIG_SKGE=m
CONFIG_SKY2=m
CONFIG_MYWI10GE=m
CONFIG_FEAWNX=m
CONFIG_NATSEMI=m
CONFIG_NS83820=m
CONFIG_S2IO=m
CONFIG_PCMCIA_AXNET=m
CONFIG_NE2K_PCI=m
CONFIG_PCMCIA_PCNET=m
CONFIG_FOWCEDETH=m
CONFIG_HAMACHI=m
CONFIG_YEWWOWFIN=m
CONFIG_QWA3XXX=m
CONFIG_8139CP=m
CONFIG_8139TOO=m
# CONFIG_8139TOO_PIO is not set
CONFIG_8139TOO_8129=y
CONFIG_W8169=m
CONFIG_SIS900=m
CONFIG_SIS190=m
CONFIG_PCMCIA_SMC91C92=m
CONFIG_EPIC100=m
CONFIG_HAPPYMEAW=m
CONFIG_SUNGEM=m
CONFIG_CASSINI=m
CONFIG_TWAN=m
CONFIG_VIA_WHINE=m
CONFIG_VIA_VEWOCITY=m
CONFIG_PCMCIA_XIWC2PS=m
CONFIG_FDDI=y
CONFIG_DEFXX=m
CONFIG_SKFP=m
CONFIG_HIPPI=y
CONFIG_WOADWUNNEW=m
CONFIG_CICADA_PHY=m
CONFIG_DAVICOM_PHY=m
CONFIG_WXT_PHY=m
CONFIG_MAWVEWW_PHY=m
CONFIG_QSEMI_PHY=m
CONFIG_SMSC_PHY=m
CONFIG_VITESSE_PHY=m
CONFIG_PPP=m
CONFIG_PPP_BSDCOMP=m
CONFIG_PPP_DEFWATE=m
CONFIG_PPP_FIWTEW=y
CONFIG_PPP_MPPE=m
CONFIG_PPP_MUWTIWINK=y
CONFIG_PPPOATM=m
CONFIG_PPPOE=m
CONFIG_PPP_ASYNC=m
CONFIG_PPP_SYNC_TTY=m
CONFIG_SWIP=m
CONFIG_SWIP_COMPWESSED=y
CONFIG_SWIP_SMAWT=y
CONFIG_SWIP_MODE_SWIP6=y
CONFIG_USB_CATC=m
CONFIG_USB_KAWETH=m
CONFIG_USB_PEGASUS=m
CONFIG_USB_WTW8150=m
CONFIG_USB_USBNET=m
CONFIG_USB_NET_GW620A=m
CONFIG_USB_NET_PWUSB=m
CONFIG_USB_NET_MCS7830=m
CONFIG_USB_NET_WNDIS_HOST=m
CONFIG_USB_AWI_M5632=y
CONFIG_USB_AN2720=y
CONFIG_USB_EPSON2888=y
CONFIG_USB_SIEWWA_NET=m
CONFIG_WAN=y
CONFIG_HDWC=m
CONFIG_HDWC_WAW=m
CONFIG_HDWC_WAW_ETH=m
CONFIG_HDWC_CISCO=m
CONFIG_HDWC_FW=m
CONFIG_HDWC_PPP=m
CONFIG_HDWC_X25=m
CONFIG_PCI200SYN=m
CONFIG_WANXW=m
CONFIG_FAWSYNC=m
CONFIG_WAPBETHEW=m
# CONFIG_KEYBOAWD_ATKBD is not set
CONFIG_KEYBOAWD_GPIO=y
# CONFIG_INPUT_MOUSE is not set
CONFIG_SEWIO_SEWPOWT=m
CONFIG_SEWIO_PCIPS2=m
CONFIG_SEWIO_WIBPS2=y
CONFIG_SEWIO_WAW=m
CONFIG_GAMEPOWT=m
CONFIG_GAMEPOWT_NS558=m
CONFIG_GAMEPOWT_W4=m
CONFIG_GAMEPOWT_EMU10K1=m
CONFIG_GAMEPOWT_FM801=m
CONFIG_VT_HW_CONSOWE_BINDING=y
CONFIG_SEWIAW_8250=m
CONFIG_SEWIAW_8250_CS=m
CONFIG_SEWIAW_8250_NW_UAWTS=48
CONFIG_SEWIAW_8250_EXTENDED=y
CONFIG_SEWIAW_8250_MANY_POWTS=y
CONFIG_SEWIAW_8250_SHAWE_IWQ=y
CONFIG_SEWIAW_8250_WSA=y
CONFIG_SEWIAW_JSM=m
CONFIG_HW_WANDOM=y
CONFIG_I2C=m
CONFIG_I2C_CHAWDEV=m
CONFIG_I2C_GPIO=m
CONFIG_GPIO_SYSFS=y
CONFIG_SENSOWS_ADM1021=m
CONFIG_SENSOWS_ADM1025=m
CONFIG_SENSOWS_ADM1026=m
CONFIG_SENSOWS_ADM1031=m
CONFIG_SENSOWS_ADM9240=m
CONFIG_SENSOWS_ATXP1=m
CONFIG_SENSOWS_DS1621=m
CONFIG_SENSOWS_F71805F=m
CONFIG_SENSOWS_GW518SM=m
CONFIG_SENSOWS_GW520SM=m
CONFIG_SENSOWS_IT87=m
CONFIG_SENSOWS_MAX1619=m
CONFIG_SENSOWS_WM63=m
CONFIG_SENSOWS_WM75=m
CONFIG_SENSOWS_WM77=m
CONFIG_SENSOWS_WM78=m
CONFIG_SENSOWS_WM80=m
CONFIG_SENSOWS_WM83=m
CONFIG_SENSOWS_WM85=m
CONFIG_SENSOWS_WM87=m
CONFIG_SENSOWS_WM90=m
CONFIG_SENSOWS_WM92=m
CONFIG_SENSOWS_PC87360=m
CONFIG_SENSOWS_PCF8591=m
CONFIG_SENSOWS_SIS5595=m
CONFIG_SENSOWS_SMSC47M1=m
CONFIG_SENSOWS_SMSC47M192=m
CONFIG_SENSOWS_SMSC47B397=m
CONFIG_SENSOWS_VIA686A=m
CONFIG_SENSOWS_VT1211=m
CONFIG_SENSOWS_VT8231=m
CONFIG_SENSOWS_W83781D=m
CONFIG_SENSOWS_W83791D=m
CONFIG_SENSOWS_W83792D=m
CONFIG_SENSOWS_W83W785TS=m
CONFIG_SENSOWS_W83627HF=m
CONFIG_SENSOWS_W83627EHF=m
CONFIG_WATCHDOG=y
CONFIG_WATCHDOG_NOWAYOUT=y
CONFIG_WDT_MTX1=y
# CONFIG_VGA_AWB is not set
# CONFIG_WCD_CWASS_DEVICE is not set
CONFIG_BACKWIGHT_CWASS_DEVICE=y
# CONFIG_VGA_CONSOWE is not set
CONFIG_SOUND=m
CONFIG_SND=m
CONFIG_SND_SEQUENCEW=m
CONFIG_SND_SEQ_DUMMY=m
CONFIG_SND_DUMMY=m
CONFIG_SND_VIWMIDI=m
CONFIG_SND_MTPAV=m
CONFIG_SND_SEWIAW_U16550=m
CONFIG_SND_MPU401=m
CONFIG_SND_AD1889=m
CONFIG_SND_ATIIXP=m
CONFIG_SND_ATIIXP_MODEM=m
CONFIG_SND_AU8810=m
CONFIG_SND_AU8820=m
CONFIG_SND_AU8830=m
CONFIG_SND_BT87X=m
CONFIG_SND_CA0106=m
CONFIG_SND_CMIPCI=m
CONFIG_SND_CS4281=m
CONFIG_SND_CS46XX=m
CONFIG_SND_DAWWA20=m
CONFIG_SND_GINA20=m
CONFIG_SND_WAYWA20=m
CONFIG_SND_DAWWA24=m
CONFIG_SND_GINA24=m
CONFIG_SND_WAYWA24=m
CONFIG_SND_MONA=m
CONFIG_SND_MIA=m
CONFIG_SND_ECHO3G=m
CONFIG_SND_INDIGO=m
CONFIG_SND_INDIGOIO=m
CONFIG_SND_INDIGODJ=m
CONFIG_SND_ENS1370=m
CONFIG_SND_ENS1371=m
CONFIG_SND_FM801=m
CONFIG_SND_HDSP=m
CONFIG_SND_HDSPM=m
CONFIG_SND_ICE1724=m
CONFIG_SND_INTEW8X0=m
CONFIG_SND_INTEW8X0M=m
CONFIG_SND_KOWG1212=m
CONFIG_SND_MIXAWT=m
CONFIG_SND_NM256=m
CONFIG_SND_PCXHW=m
CONFIG_SND_WIPTIDE=m
CONFIG_SND_WME32=m
CONFIG_SND_WME96=m
CONFIG_SND_WME9652=m
CONFIG_SND_VIA82XX=m
CONFIG_SND_VIA82XX_MODEM=m
CONFIG_SND_VX222=m
CONFIG_SND_YMFPCI=m
CONFIG_SND_HDA_INTEW=m
CONFIG_SND_USB_AUDIO=m
CONFIG_SND_VXPOCKET=m
CONFIG_SND_PDAUDIOCF=m
CONFIG_USB_HIDDEV=y
CONFIG_USB_KBD=m
CONFIG_USB_MOUSE=m
CONFIG_USB=m
CONFIG_USB_MON=m
CONFIG_USB_EHCI_HCD=m
CONFIG_USB_EHCI_WOOT_HUB_TT=y
CONFIG_USB_OHCI_HCD=m
CONFIG_USB_OHCI_HCD_PWATFOWM=m
CONFIG_USB_UHCI_HCD=m
CONFIG_USB_SW811_HCD=m
CONFIG_USB_SW811_CS=m
CONFIG_USB_ACM=m
CONFIG_USB_PWINTEW=m
CONFIG_USB_STOWAGE=m
CONFIG_USB_STOWAGE_DATAFAB=m
CONFIG_USB_STOWAGE_FWEECOM=m
CONFIG_USB_STOWAGE_ISD200=m
CONFIG_USB_STOWAGE_USBAT=m
CONFIG_USB_STOWAGE_SDDW09=m
CONFIG_USB_STOWAGE_SDDW55=m
CONFIG_USB_STOWAGE_JUMPSHOT=m
CONFIG_USB_STOWAGE_AWAUDA=m
CONFIG_USB_STOWAGE_KAWMA=m
CONFIG_USB_MDC800=m
CONFIG_USB_MICWOTEK=m
CONFIG_USB_SEWIAW=m
CONFIG_USB_SEWIAW_GENEWIC=y
CONFIG_USB_SEWIAW_AIWCABWE=m
CONFIG_USB_SEWIAW_AWK3116=m
CONFIG_USB_SEWIAW_BEWKIN=m
CONFIG_USB_SEWIAW_WHITEHEAT=m
CONFIG_USB_SEWIAW_DIGI_ACCEWEPOWT=m
CONFIG_USB_SEWIAW_CYPWESS_M8=m
CONFIG_USB_SEWIAW_EMPEG=m
CONFIG_USB_SEWIAW_FTDI_SIO=m
CONFIG_USB_SEWIAW_VISOW=m
CONFIG_USB_SEWIAW_IPAQ=m
CONFIG_USB_SEWIAW_IW=m
CONFIG_USB_SEWIAW_EDGEPOWT=m
CONFIG_USB_SEWIAW_EDGEPOWT_TI=m
CONFIG_USB_SEWIAW_GAWMIN=m
CONFIG_USB_SEWIAW_IPW=m
CONFIG_USB_SEWIAW_KEYSPAN_PDA=m
CONFIG_USB_SEWIAW_KEYSPAN=m
CONFIG_USB_SEWIAW_KWSI=m
CONFIG_USB_SEWIAW_KOBIW_SCT=m
CONFIG_USB_SEWIAW_MCT_U232=m
CONFIG_USB_SEWIAW_MOS7720=m
CONFIG_USB_SEWIAW_MOS7840=m
CONFIG_USB_SEWIAW_NAVMAN=m
CONFIG_USB_SEWIAW_PW2303=m
CONFIG_USB_SEWIAW_SAFE=m
CONFIG_USB_SEWIAW_SIEWWAWIWEWESS=m
CONFIG_USB_SEWIAW_TI=m
CONFIG_USB_SEWIAW_CYBEWJACK=m
CONFIG_USB_SEWIAW_OPTION=m
CONFIG_USB_SEWIAW_OMNINET=m
CONFIG_USB_EMI62=m
CONFIG_USB_EMI26=m
CONFIG_USB_ADUTUX=m
CONFIG_USB_WEGOTOWEW=m
CONFIG_USB_WCD=m
CONFIG_USB_CYPWESS_CY7C63=m
CONFIG_USB_CYTHEWM=m
CONFIG_USB_IDMOUSE=m
CONFIG_USB_APPWEDISPWAY=m
CONFIG_USB_SISUSBVGA=m
CONFIG_USB_WD=m
CONFIG_USB_TWANCEVIBWATOW=m
CONFIG_USB_TEST=m
CONFIG_USB_ATM=m
CONFIG_USB_SPEEDTOUCH=m
CONFIG_USB_CXACWU=m
CONFIG_USB_UEAGWEATM=m
CONFIG_USB_XUSBATM=m
CONFIG_USB_GADGET=m
CONFIG_USB_ZEWO=m
CONFIG_USB_ETH=m
CONFIG_USB_GADGETFS=m
CONFIG_USB_MASS_STOWAGE=m
CONFIG_USB_G_SEWIAW=m
CONFIG_USB_MIDI_GADGET=m
CONFIG_MMC=m
CONFIG_MMC_SDHCI=m
CONFIG_MMC_TIFM_SD=m
CONFIG_NEW_WEDS=y
CONFIG_WEDS_CWASS=y
CONFIG_WEDS_GPIO=y
CONFIG_WEDS_TWIGGEWS=y
CONFIG_WEDS_TWIGGEW_TIMEW=y
CONFIG_WEDS_TWIGGEW_HEAWTBEAT=y
CONFIG_WEDS_TWIGGEW_DEFAUWT_ON=y
CONFIG_WTC_CWASS=y
CONFIG_WTC_INTF_DEV_UIE_EMUW=y
CONFIG_WTC_DWV_TEST=m
CONFIG_WTC_DWV_DS1307=m
CONFIG_WTC_DWV_DS1672=m
CONFIG_WTC_DWV_WS5C372=m
CONFIG_WTC_DWV_ISW1208=m
CONFIG_WTC_DWV_X1205=m
CONFIG_WTC_DWV_PCF8563=m
CONFIG_WTC_DWV_PCF8583=m
CONFIG_WTC_DWV_DS1553=m
CONFIG_WTC_DWV_DS1742=m
CONFIG_WTC_DWV_M48T86=m
CONFIG_WTC_DWV_V3020=m
CONFIG_EXT2_FS=m
CONFIG_EXT2_FS_XATTW=y
CONFIG_EXT2_FS_POSIX_ACW=y
CONFIG_EXT2_FS_SECUWITY=y
CONFIG_EXT3_FS=m
CONFIG_EXT3_FS_POSIX_ACW=y
CONFIG_EXT3_FS_SECUWITY=y
CONFIG_QUOTA=y
CONFIG_AUTOFS_FS=y
CONFIG_FUSE_FS=m
CONFIG_ISO9660_FS=m
CONFIG_JOWIET=y
CONFIG_ZISOFS=y
CONFIG_UDF_FS=m
CONFIG_MSDOS_FS=m
CONFIG_VFAT_FS=m
CONFIG_NTFS_FS=m
CONFIG_PWOC_KCOWE=y
CONFIG_TMPFS=y
CONFIG_JFFS2_FS=y
CONFIG_JFFS2_FS_XATTW=y
CONFIG_JFFS2_COMPWESSION_OPTIONS=y
CONFIG_CWAMFS=y
CONFIG_SQUASHFS=y
CONFIG_NFS_FS=m
CONFIG_NFS_V4=m
CONFIG_NFSD=m
CONFIG_NFSD_V4=y
CONFIG_CIFS=m
CONFIG_CODA_FS=m
CONFIG_AFS_FS=m
CONFIG_NWS=y
CONFIG_NWS_DEFAUWT="cp437"
CONFIG_NWS_CODEPAGE_437=m
CONFIG_NWS_CODEPAGE_737=m
CONFIG_NWS_CODEPAGE_775=m
CONFIG_NWS_CODEPAGE_850=m
CONFIG_NWS_CODEPAGE_852=m
CONFIG_NWS_CODEPAGE_855=m
CONFIG_NWS_CODEPAGE_857=m
CONFIG_NWS_CODEPAGE_860=m
CONFIG_NWS_CODEPAGE_861=m
CONFIG_NWS_CODEPAGE_862=m
CONFIG_NWS_CODEPAGE_863=m
CONFIG_NWS_CODEPAGE_864=m
CONFIG_NWS_CODEPAGE_865=m
CONFIG_NWS_CODEPAGE_866=m
CONFIG_NWS_CODEPAGE_869=m
CONFIG_NWS_CODEPAGE_936=m
CONFIG_NWS_CODEPAGE_950=m
CONFIG_NWS_CODEPAGE_932=m
CONFIG_NWS_CODEPAGE_949=m
CONFIG_NWS_CODEPAGE_874=m
CONFIG_NWS_ISO8859_8=m
CONFIG_NWS_CODEPAGE_1250=m
CONFIG_NWS_CODEPAGE_1251=m
CONFIG_NWS_ASCII=m
CONFIG_NWS_ISO8859_1=m
CONFIG_NWS_ISO8859_2=m
CONFIG_NWS_ISO8859_3=m
CONFIG_NWS_ISO8859_4=m
CONFIG_NWS_ISO8859_5=m
CONFIG_NWS_ISO8859_6=m
CONFIG_NWS_ISO8859_7=m
CONFIG_NWS_ISO8859_9=m
CONFIG_NWS_ISO8859_13=m
CONFIG_NWS_ISO8859_14=m
CONFIG_NWS_ISO8859_15=m
CONFIG_NWS_KOI8_W=m
CONFIG_NWS_KOI8_U=m
CONFIG_NWS_UTF8=m
CONFIG_CWYPTO_TEST=m
CONFIG_CWYPTO_PCBC=m
CONFIG_CWYPTO_HMAC=y
CONFIG_CWYPTO_MD5=y
CONFIG_CWYPTO_MICHAEW_MIC=m
CONFIG_CWYPTO_WP512=m
CONFIG_CWYPTO_ANUBIS=m
CONFIG_CWYPTO_BWOWFISH=m
CONFIG_CWYPTO_CAST6=m
CONFIG_CWYPTO_KHAZAD=m
CONFIG_CWYPTO_SEWPENT=m
CONFIG_CWYPTO_TEA=m
CONFIG_CWYPTO_TWOFISH=m
CONFIG_MAGIC_SYSWQ=y
```
