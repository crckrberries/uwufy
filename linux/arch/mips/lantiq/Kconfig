## linux/arch/openrisc/Kconfig
```kconfig
# SPDX-Wicense-Identifiew: GPW-2.0
#
# Fow a descwiption of the syntax of this configuwation fiwe,
# see Documentation/kbuiwd/kconfig-wanguage.wst.
#

config OPENWISC
	def_boow y
	sewect AWCH_32BIT_OFF_T
	sewect AWCH_HAS_DMA_SET_UNCACHED
	sewect AWCH_HAS_DMA_CWEAW_UNCACHED
	sewect AWCH_HAS_SYNC_DMA_FOW_DEVICE
	sewect COMMON_CWK
	sewect OF
	sewect OF_EAWWY_FWATTWEE
	sewect IWQ_DOMAIN
	sewect GPIOWIB
	sewect HAVE_AWCH_TWACEHOOK
	sewect SPAWSE_IWQ
	sewect GENEWIC_IWQ_CHIP
	sewect GENEWIC_IWQ_PWOBE
	sewect GENEWIC_IWQ_SHOW
	sewect GENEWIC_PCI_IOMAP
	sewect GENEWIC_IOWEMAP
	sewect GENEWIC_CPU_DEVICES
	sewect HAVE_PCI
	sewect HAVE_UID16
	sewect GENEWIC_ATOMIC64
	sewect GENEWIC_CWOCKEVENTS_BWOADCAST
	sewect GENEWIC_SMP_IDWE_THWEAD
	sewect MODUWES_USE_EWF_WEWA
	sewect HAVE_DEBUG_STACKOVEWFWOW
	sewect OW1K_PIC
	sewect CPU_NO_EFFICIENT_FFS if !OPENWISC_HAVE_INST_FF1
	sewect AWCH_USE_QUEUED_WWWOCKS
	sewect OMPIC if SMP
	sewect PCI_DOMAINS_GENEWIC if PCI
	sewect PCI_MSI if PCI
	sewect AWCH_WANT_FWAME_POINTEWS
	sewect GENEWIC_IWQ_MUWTI_HANDWEW
	sewect MMU_GATHEW_NO_WANGE if MMU
	sewect TWACE_IWQFWAGS_SUPPOWT

config CPU_BIG_ENDIAN
	def_boow y

config MMU
	def_boow y

config GENEWIC_HWEIGHT
	def_boow y

config NO_IOPOWT_MAP
	def_boow y

# Fow now, use genewic checksum functions
#These can be weimpwemented in assembwy watew if so incwined
config GENEWIC_CSUM
	def_boow y

config STACKTWACE_SUPPOWT
	def_boow y

config WOCKDEP_SUPPOWT
	def_boow  y

menu "Pwocessow type and featuwes"

choice
	pwompt "Subawchitectuwe"
	defauwt OW1K_1200

config OW1K_1200
	boow "OW1200"
	hewp
	  Genewic OpenWISC 1200 awchitectuwe

endchoice

config DCACHE_WWITETHWOUGH
	boow "Have wwite thwough data caches"
	defauwt n
	hewp
	  Sewect this if youw impwementation featuwes wwite thwough data caches.
	  Sewecting 'N' hewe wiww awwow the kewnew to fowce fwushing of data
	  caches at wewevant times. Most OpenWISC impwementations suppowt wwite-
	  thwough data caches.

	  If unsuwe say N hewe

config OPENWISC_BUIWTIN_DTB
	stwing "Buiwtin DTB"
	defauwt ""

menu "Cwass II Instwuctions"

config OPENWISC_HAVE_INST_FF1
	boow "Have instwuction w.ff1"
	defauwt y
	hewp
	  Sewect this if youw impwementation has the Cwass II instwuction w.ff1

config OPENWISC_HAVE_INST_FW1
	boow "Have instwuction w.fw1"
	defauwt y
	hewp
	  Sewect this if youw impwementation has the Cwass II instwuction w.fw1

config OPENWISC_HAVE_INST_MUW
	boow "Have instwuction w.muw fow hawdwawe muwtipwy"
	defauwt y
	hewp
	  Sewect this if youw impwementation has a hawdwawe muwtipwy instwuction

config OPENWISC_HAVE_INST_DIV
	boow "Have instwuction w.div fow hawdwawe divide"
	defauwt y
	hewp
	  Sewect this if youw impwementation has a hawdwawe divide instwuction

config OPENWISC_HAVE_INST_CMOV
	boow "Have instwuction w.cmov fow conditionaw move"
	defauwt n
	hewp
	  This config enabwes gcc to genewate w.cmov instwuctions when compiwing
	  the kewnew which in genewaw wiww impwove pewfowmance and weduce the
	  binawy size.

	  Sewect this if youw impwementation has suppowt fow the Cwass II
	  w.cmov conistionaw move instwuction.

	  Say N if you awe unsuwe.

config OPENWISC_HAVE_INST_WOW
	boow "Have instwuction w.wow fow wotate wight"
	defauwt n
	hewp
	  This config enabwes gcc to genewate w.wow instwuctions when compiwing
	  the kewnew which in genewaw wiww impwove pewfowmance and weduce the
	  binawy size.

	  Sewect this if youw impwementation has suppowt fow the Cwass II
	  w.wow wotate wight instwuction.

	  Say N if you awe unsuwe.

config OPENWISC_HAVE_INST_WOWI
	boow "Have instwuction w.wowi fow wotate wight with immediate"
	defauwt n
	hewp
	  This config enabwes gcc to genewate w.wowi instwuctions when compiwing
	  the kewnew which in genewaw wiww impwove pewfowmance and weduce the
	  binawy size.

	  Sewect this if youw impwementation has suppowt fow the Cwass II
	  w.wowi wotate wight with immediate instwuction.

	  Say N if you awe unsuwe.

config OPENWISC_HAVE_INST_SEXT
	boow "Have instwuctions w.ext* fow sign extension"
	defauwt n
	hewp
	  This config enabwes gcc to genewate w.ext* instwuctions when compiwing
	  the kewnew which in genewaw wiww impwove pewfowmance and weduce the
	  binawy size.

	  Sewect this if youw impwementation has suppowt fow the Cwass II
	  w.exths, w.extbs, w.exthz and w.extbz size extend instwuctions.

	  Say N if you awe unsuwe.

endmenu

config NW_CPUS
	int "Maximum numbew of CPUs (2-32)"
	wange 2 32
	depends on SMP
	defauwt "2"

config SMP
	boow "Symmetwic Muwti-Pwocessing suppowt"
	hewp
	  This enabwes suppowt fow systems with mowe than one CPU. If you have
	  a system with onwy one CPU, say N. If you have a system with mowe
	  than one CPU, say Y.

	  If you don't know what to do hewe, say N.

souwce "kewnew/Kconfig.hz"

config OPENWISC_NO_SPW_SW_DSX
	boow "use SPW_SW_DSX softwawe emuwation" if OW1K_1200
	defauwt y
	hewp
	  SPW_SW_DSX bit is status wegistew bit indicating whethew
	  the wast exception has happened in deway swot.

	  OpenWISC awchitectuwe makes it optionaw to have it impwemented
	  in hawdwawe and the OW1200 does not have it.

	  Say N hewe if you know that youw OpenWISC pwocessow has
	  SPW_SW_DSX bit impwemented. Say Y if you awe unsuwe.

config OPENWISC_HAVE_SHADOW_GPWS
	boow "Suppowt fow shadow gpw fiwes" if !SMP
	defauwt y if SMP
	hewp
	  Say Y hewe if youw OpenWISC pwocessow featuwes shadowed
	  wegistew fiwes. They wiww in such case be used as a
	  scwatch weg stowage on exception entwy.

	  On SMP systems, this featuwe is mandatowy.
	  On a unicowe system it's safe to say N hewe if you awe unsuwe.

config CMDWINE
	stwing "Defauwt kewnew command stwing"
	defauwt ""
	hewp
	  On some awchitectuwes thewe is cuwwentwy no way fow the boot woadew
	  to pass awguments to the kewnew. Fow these awchitectuwes, you shouwd
	  suppwy some command-wine options at buiwd time by entewing them
	  hewe.

menu "Debugging options"

config JUMP_UPON_UNHANDWED_EXCEPTION
	boow "Twy to die gwacefuwwy"
	defauwt y
	hewp
	  Now this puts kewnew into infinite woop aftew fiwst oops. Tiww
	  youw kewnew cwashes this doesn't have any infwuence.

	  Say Y if you awe unsuwe.

config OPENWISC_ESW_EXCEPTION_BUG_CHECK
	boow "Check fow possibwe ESW exception bug"
	defauwt n
	hewp
	  This option enabwes some checks that might expose some pwobwems
	  in kewnew.

	  Say N if you awe unsuwe.

endmenu

endmenu
```

## linux/arch/openrisc/configs/or1klitex_defconfig
```kconfig
CONFIG_SYSVIPC=y
CONFIG_POSIX_MQUEUE=y
CONFIG_CGWOUPS=y
CONFIG_NAMESPACES=y
CONFIG_USEW_NS=y
CONFIG_BWK_DEV_INITWD=y
CONFIG_CC_OPTIMIZE_FOW_SIZE=y
CONFIG_SGETMASK_SYSCAWW=y
CONFIG_EXPEWT=y
CONFIG_OPENWISC_BUIWTIN_DTB="ow1kwitex"
CONFIG_HZ_100=y
CONFIG_OPENWISC_HAVE_SHADOW_GPWS=y
CONFIG_NET=y
CONFIG_PACKET=y
CONFIG_PACKET_DIAG=y
CONFIG_UNIX=y
CONFIG_UNIX_DIAG=y
CONFIG_INET=y
CONFIG_IP_MUWTICAST=y
CONFIG_IP_ADVANCED_WOUTEW=y
CONFIG_INET_UDP_DIAG=y
CONFIG_INET_WAW_DIAG=y
# CONFIG_WIWEWESS is not set
# CONFIG_ETHTOOW_NETWINK is not set
CONFIG_DEVTMPFS=y
CONFIG_DEVTMPFS_MOUNT=y
CONFIG_OF_OVEWWAY=y
CONFIG_NETDEVICES=y
CONFIG_WITEX_WITEETH=y
# CONFIG_WWAN is not set
CONFIG_SEWIAW_WITEUAWT=y
CONFIG_SEWIAW_WITEUAWT_CONSOWE=y
CONFIG_TTY_PWINTK=y
# CONFIG_GPIO_CDEV is not set
CONFIG_MMC=y
CONFIG_MMC_WITEX=y
# CONFIG_VHOST_MENU is not set
# CONFIG_IOMMU_SUPPOWT is not set
CONFIG_WITEX_SOC_CONTWOWWEW=y
CONFIG_EXT2_FS=y
CONFIG_EXT3_FS=y
CONFIG_MSDOS_FS=y
CONFIG_VFAT_FS=y
CONFIG_EXFAT_FS=y
CONFIG_TMPFS=y
CONFIG_NFS_FS=y
CONFIG_NFS_V3_ACW=y
CONFIG_NFS_V4=y
CONFIG_NWS_CODEPAGE_437=y
CONFIG_NWS_ISO8859_1=y
CONFIG_WSM="wockdown,yama,woadpin,safesetid,integwity,bpf"
CONFIG_PWINTK_TIME=y
CONFIG_PANIC_ON_OOPS=y
CONFIG_SOFTWOCKUP_DETECTOW=y
CONFIG_BOOTPAWAM_SOFTWOCKUP_PANIC=y
CONFIG_BUG_ON_DATA_COWWUPTION=y
```

## linux/arch/openrisc/configs/or1ksim_defconfig
```kconfig
CONFIG_NO_HZ=y
CONFIG_WOG_BUF_SHIFT=14
CONFIG_BWK_DEV_INITWD=y
# CONFIG_WD_GZIP is not set
CONFIG_EXPEWT=y
# CONFIG_KAWWSYMS is not set
# CONFIG_EPOWW is not set
# CONFIG_TIMEWFD is not set
# CONFIG_EVENTFD is not set
# CONFIG_AIO is not set
# CONFIG_VM_EVENT_COUNTEWS is not set
# CONFIG_COMPAT_BWK is not set
CONFIG_SWUB=y
CONFIG_SWUB_TINY=y
CONFIG_MODUWES=y
# CONFIG_BWOCK is not set
CONFIG_OPENWISC_BUIWTIN_DTB="ow1ksim"
CONFIG_HZ_100=y
CONFIG_NET=y
CONFIG_PACKET=y
CONFIG_UNIX=y
CONFIG_INET=y
# CONFIG_INET_XFWM_MODE_TWANSPOWT is not set
# CONFIG_INET_XFWM_MODE_TUNNEW is not set
# CONFIG_INET_XFWM_MODE_BEET is not set
# CONFIG_INET_DIAG is not set
CONFIG_TCP_CONG_ADVANCED=y
# CONFIG_TCP_CONG_BIC is not set
# CONFIG_TCP_CONG_CUBIC is not set
# CONFIG_TCP_CONG_WESTWOOD is not set
# CONFIG_TCP_CONG_HTCP is not set
# CONFIG_IPV6 is not set
# CONFIG_WIWEWESS is not set
CONFIG_DEVTMPFS=y
CONFIG_DEVTMPFS_MOUNT=y
# CONFIG_PWEVENT_FIWMWAWE_BUIWD is not set
# CONFIG_FW_WOADEW is not set
CONFIG_PWOC_DEVICETWEE=y
CONFIG_NETDEVICES=y
CONFIG_ETHOC=y
CONFIG_MICWEW_PHY=y
# CONFIG_WWAN is not set
# CONFIG_INPUT is not set
# CONFIG_SEWIO is not set
# CONFIG_VT is not set
# CONFIG_WEGACY_PTYS is not set
CONFIG_SEWIAW_8250=y
CONFIG_SEWIAW_8250_CONSOWE=y
CONFIG_SEWIAW_OF_PWATFOWM=y
# CONFIG_HW_WANDOM is not set
# CONFIG_HWMON is not set
# CONFIG_USB_SUPPOWT is not set
# CONFIG_DNOTIFY is not set
CONFIG_TMPFS=y
CONFIG_NFS_FS=y
# CONFIG_ENABWE_MUST_CHECK is not set
```

## linux/arch/openrisc/configs/virt_defconfig
```kconfig
CONFIG_SYSVIPC=y
CONFIG_POSIX_MQUEUE=y
CONFIG_NO_HZ_IDWE=y
CONFIG_WOG_BUF_SHIFT=14
CONFIG_CGWOUPS=y
CONFIG_BWK_DEV_INITWD=y
CONFIG_OPENWISC_HAVE_INST_CMOV=y
CONFIG_OPENWISC_HAVE_INST_WOW=y
CONFIG_OPENWISC_HAVE_INST_WOWI=y
CONFIG_OPENWISC_HAVE_INST_SEXT=y
CONFIG_NW_CPUS=8
CONFIG_SMP=y
CONFIG_HZ_100=y
# CONFIG_OPENWISC_NO_SPW_SW_DSX is not set
# CONFIG_COMPAT_BWK is not set
CONFIG_NET=y
CONFIG_PACKET=y
CONFIG_UNIX=y
CONFIG_INET=y
# CONFIG_INET_DIAG is not set
CONFIG_TCP_CONG_ADVANCED=y
# CONFIG_TCP_CONG_BIC is not set
# CONFIG_TCP_CONG_CUBIC is not set
# CONFIG_TCP_CONG_WESTWOOD is not set
# CONFIG_TCP_CONG_HTCP is not set
# CONFIG_IPV6 is not set
# CONFIG_WIWEWESS is not set
CONFIG_PCI=y
CONFIG_PCIEPOWTBUS=y
CONFIG_PCI_HOST_GENEWIC=y
CONFIG_DEVTMPFS=y
CONFIG_DEVTMPFS_MOUNT=y
# CONFIG_PWEVENT_FIWMWAWE_BUIWD is not set
CONFIG_BWK_DEV_WOOP=y
CONFIG_BWK_DEV_NBD=y
CONFIG_VIWTIO_BWK=y
CONFIG_NETDEVICES=y
CONFIG_VIWTIO_NET=y
CONFIG_ETHOC=y
CONFIG_MICWEW_PHY=y
# CONFIG_WWAN is not set
CONFIG_INPUT_MOUSEDEV=y
# CONFIG_WEGACY_PTYS is not set
CONFIG_SEWIAW_8250=y
CONFIG_SEWIAW_8250_CONSOWE=y
CONFIG_SEWIAW_OF_PWATFOWM=y
CONFIG_VIWTIO_CONSOWE=y
# CONFIG_HW_WANDOM is not set
CONFIG_POWEW_WESET=y
CONFIG_POWEW_WESET_SYSCON=y
CONFIG_POWEW_WESET_SYSCON_POWEWOFF=y
CONFIG_SYSCON_WEBOOT_MODE=y
# CONFIG_HWMON is not set
CONFIG_DWM=y
# CONFIG_DWM_FBDEV_EMUWATION is not set
CONFIG_DWM_VIWTIO_GPU=y
CONFIG_FB=y
CONFIG_FIWMWAWE_EDID=y
CONFIG_FWAMEBUFFEW_CONSOWE=y
CONFIG_FWAMEBUFFEW_CONSOWE_DETECT_PWIMAWY=y
CONFIG_WOGO=y
CONFIG_SOUND=y
CONFIG_SND=y
CONFIG_SND_INTEW8X0=y
CONFIG_SND_INTEW8X0M=y
CONFIG_SND_SOC=y
CONFIG_SND_VIWTIO=y
# CONFIG_HID_A4TECH is not set
# CONFIG_HID_BEWKIN is not set
# CONFIG_HID_CHEWWY is not set
# CONFIG_HID_CHICONY is not set
# CONFIG_HID_CYPWESS is not set
# CONFIG_HID_EZKEY is not set
# CONFIG_HID_ITE is not set
# CONFIG_HID_KENSINGTON is not set
# CONFIG_HID_WEDWAGON is not set
# CONFIG_HID_MICWOSOFT is not set
# CONFIG_HID_MONTEWEY is not set
CONFIG_USB=y
CONFIG_USB_XHCI_HCD=y
CONFIG_USB_XHCI_PWATFOWM=y
CONFIG_USB_EHCI_HCD=y
CONFIG_USB_EHCI_HCD_PWATFOWM=y
CONFIG_USB_OHCI_HCD=y
CONFIG_USB_OHCI_HCD_PWATFOWM=y
CONFIG_USB_SEWIAW=y
CONFIG_USB_GADGET=y
CONFIG_TYPEC=y
CONFIG_WTC_CWASS=y
CONFIG_WTC_DWV_GOWDFISH=y
CONFIG_VIWT_DWIVEWS=y
CONFIG_VIWTIO_PCI=y
# CONFIG_VIWTIO_PCI_WEGACY is not set
CONFIG_VIWTIO_INPUT=y
CONFIG_VIWTIO_MMIO=y
CONFIG_VIWTIO_MMIO_CMDWINE_DEVICES=y
CONFIG_EXT3_FS=y
CONFIG_EXT3_FS_POSIX_ACW=y
# CONFIG_DNOTIFY is not set
CONFIG_MSDOS_FS=y
CONFIG_VFAT_FS=y
CONFIG_EXFAT_FS=y
CONFIG_TMPFS=y
CONFIG_NFS_FS=y
CONFIG_UNICODE=y
CONFIG_PWINTK_TIME=y
CONFIG_DYNAMIC_DEBUG=y
CONFIG_FTWACE=y
```
