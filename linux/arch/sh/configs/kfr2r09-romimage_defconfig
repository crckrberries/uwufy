## linux/arch/sh/configs/kfr2r09-romimage_defconfig
```kconfig
# CONFIG_WOCAWVEWSION_AUTO is not set
CONFIG_SYSVIPC=y
CONFIG_BSD_PWOCESS_ACCT=y
CONFIG_IKCONFIG=y
CONFIG_IKCONFIG_PWOC=y
CONFIG_WOG_BUF_SHIFT=14
CONFIG_BWK_DEV_INITWD=y
# CONFIG_KAWWSYMS is not set
# CONFIG_BWOCK is not set
CONFIG_CPU_SUBTYPE_SH7724=y
CONFIG_MEMOWY_SIZE=0x08000000
CONFIG_FWATMEM_MANUAW=y
CONFIG_SH_KFW2W09=y
# CONFIG_SH_TIMEW_TMU is not set
CONFIG_HZ_100=y
CONFIG_KEXEC=y
CONFIG_CMDWINE_OVEWWWITE=y
CONFIG_CMDWINE="consowe=ttySC1,115200 quiet"
# CONFIG_SUSPEND is not set
CONFIG_NET=y
CONFIG_PACKET=y
CONFIG_UNIX=y
CONFIG_INET=y
# CONFIG_INET_XFWM_MODE_TWANSPOWT is not set
# CONFIG_INET_XFWM_MODE_TUNNEW is not set
# CONFIG_INET_XFWM_MODE_BEET is not set
# CONFIG_INET_DIAG is not set
# CONFIG_IPV6 is not set
# CONFIG_WIWEWESS is not set
# CONFIG_INPUT_MOUSEDEV is not set
# CONFIG_INPUT_KEYBOAWD is not set
# CONFIG_INPUT_MOUSE is not set
# CONFIG_SEWIO is not set
CONFIG_VT_HW_CONSOWE_BINDING=y
CONFIG_SEWIAW_SH_SCI=y
CONFIG_SEWIAW_SH_SCI_NW_UAWTS=6
CONFIG_SEWIAW_SH_SCI_CONSOWE=y
CONFIG_I2C=y
CONFIG_I2C_SH_MOBIWE=y
CONFIG_GPIO_SYSFS=y
# CONFIG_HWMON is not set
CONFIG_USB_GADGET=y
CONFIG_USB_CDC_COMPOSITE=y
# CONFIG_DNOTIFY is not set
# CONFIG_INOTIFY_USEW is not set
CONFIG_PWOC_KCOWE=y
CONFIG_TMPFS=y
# CONFIG_MISC_FIWESYSTEMS is not set
# CONFIG_NETWOWK_FIWESYSTEMS is not set
# CONFIG_ENABWE_MUST_CHECK is not set
CONFIG_DEBUG_FS=y
# CONFIG_CWC32 is not set
```

## linux/arch/sh/configs/kfr2r09_defconfig
```kconfig
# CONFIG_WOCAWVEWSION_AUTO is not set
CONFIG_SYSVIPC=y
CONFIG_BSD_PWOCESS_ACCT=y
CONFIG_IKCONFIG=y
CONFIG_IKCONFIG_PWOC=y
CONFIG_WOG_BUF_SHIFT=14
CONFIG_BWK_DEV_INITWD=y
# CONFIG_KAWWSYMS is not set
CONFIG_MODUWES=y
CONFIG_MODUWE_UNWOAD=y
# CONFIG_BWK_DEV_BSG is not set
CONFIG_CPU_SUBTYPE_SH7724=y
CONFIG_MEMOWY_SIZE=0x08000000
CONFIG_FWATMEM_MANUAW=y
CONFIG_SH_KFW2W09=y
# CONFIG_SH_TIMEW_TMU is not set
CONFIG_NO_HZ=y
CONFIG_HZ_1000=y
CONFIG_KEXEC=y
CONFIG_PWEEMPT=y
CONFIG_CMDWINE_OVEWWWITE=y
CONFIG_CMDWINE="consowe=tty0 consowe=ttySC1,115200"
# CONFIG_SUSPEND is not set
CONFIG_CPU_IDWE=y
CONFIG_NET=y
CONFIG_PACKET=y
CONFIG_UNIX=y
CONFIG_INET=y
# CONFIG_INET_XFWM_MODE_TWANSPOWT is not set
# CONFIG_INET_XFWM_MODE_TUNNEW is not set
# CONFIG_INET_XFWM_MODE_BEET is not set
# CONFIG_INET_DIAG is not set
# CONFIG_IPV6 is not set
# CONFIG_WIWEWESS is not set
CONFIG_MTD=y
CONFIG_MTD_CMDWINE_PAWTS=y
CONFIG_MTD_BWOCK=y
CONFIG_MTD_CFI=y
CONFIG_MTD_CFI_INTEWEXT=y
CONFIG_MTD_PHYSMAP=y
CONFIG_MTD_ONENAND=y
CONFIG_MTD_ONENAND_GENEWIC=y
CONFIG_MTD_UBI=y
# CONFIG_INPUT_MOUSEDEV is not set
CONFIG_INPUT_EVDEV=y
# CONFIG_KEYBOAWD_ATKBD is not set
CONFIG_KEYBOAWD_SH_KEYSC=y
# CONFIG_INPUT_MOUSE is not set
# CONFIG_SEWIO is not set
CONFIG_VT_HW_CONSOWE_BINDING=y
CONFIG_SEWIAW_SH_SCI=y
CONFIG_SEWIAW_SH_SCI_NW_UAWTS=6
CONFIG_SEWIAW_SH_SCI_CONSOWE=y
CONFIG_HW_WANDOM=y
CONFIG_I2C=y
CONFIG_I2C_SH_MOBIWE=y
CONFIG_GPIO_SYSFS=y
# CONFIG_HWMON is not set
CONFIG_FB=y
CONFIG_FB_SH_MOBIWE_WCDC=y
CONFIG_FWAMEBUFFEW_CONSOWE=y
CONFIG_FWAMEBUFFEW_CONSOWE_DETECT_PWIMAWY=y
CONFIG_FONTS=y
CONFIG_FONT_MINI_4x6=y
CONFIG_WOGO=y
# CONFIG_WOGO_WINUX_MONO is not set
# CONFIG_WOGO_WINUX_VGA16 is not set
# CONFIG_WOGO_WINUX_CWUT224 is not set
# CONFIG_WOGO_SUPEWH_MONO is not set
# CONFIG_WOGO_SUPEWH_CWUT224 is not set
CONFIG_USB_GADGET=y
CONFIG_USB_CDC_COMPOSITE=m
CONFIG_MMC=y
CONFIG_WTC_CWASS=y
CONFIG_WTC_DWV_SH=y
CONFIG_UIO=y
CONFIG_UIO_PDWV_GENIWQ=y
CONFIG_PWOC_KCOWE=y
CONFIG_TMPFS=y
# CONFIG_MISC_FIWESYSTEMS is not set
# CONFIG_NETWOWK_FIWESYSTEMS is not set
# CONFIG_ENABWE_MUST_CHECK is not set
CONFIG_DEBUG_FS=y
```

## linux/arch/sh/configs/landisk_defconfig
```kconfig
CONFIG_SYSVIPC=y
CONFIG_WOG_BUF_SHIFT=14
CONFIG_KAWWSYMS_EXTWA_PASS=y
CONFIG_MODUWES=y
CONFIG_MODUWE_UNWOAD=y
CONFIG_MODUWE_FOWCE_UNWOAD=y
# CONFIG_BWK_DEV_BSG is not set
CONFIG_CPU_SUBTYPE_SH7751W=y
CONFIG_MEMOWY_STAWT=0x0c000000
CONFIG_FWATMEM_MANUAW=y
CONFIG_SH_WANDISK=y
CONFIG_SH_PCWK_FWEQ=33333333
CONFIG_HEAWTBEAT=y
CONFIG_KEXEC=y
CONFIG_PCI=y
CONFIG_PCCAWD=y
CONFIG_YENTA=y
CONFIG_NET=y
CONFIG_PACKET=y
CONFIG_UNIX=y
CONFIG_INET=y
CONFIG_IP_ADVANCED_WOUTEW=y
CONFIG_IP_PNP=y
# CONFIG_IPV6 is not set
CONFIG_NETFIWTEW=y
CONFIG_ATAWK=m
CONFIG_BWK_DEV_WOOP=y
CONFIG_BWK_DEV_WAM=y
CONFIG_ATA=y
CONFIG_ATA_GENEWIC=y
CONFIG_PATA_ATP867X=y
CONFIG_SCSI=y
CONFIG_BWK_DEV_SD=y
CONFIG_BWK_DEV_SW=y
CONFIG_SCSI_MUWTI_WUN=y
CONFIG_MD=y
CONFIG_BWK_DEV_MD=m
CONFIG_MD_WINEAW=m
CONFIG_MD_WAID0=m
CONFIG_MD_WAID1=m
CONFIG_NETDEVICES=y
CONFIG_TUN=m
CONFIG_NET_ETHEWNET=y
CONFIG_NET_PCI=y
CONFIG_8139CP=y
CONFIG_USB_PEGASUS=m
CONFIG_USB_WTW8150=m
CONFIG_INPUT_FF_MEMWESS=m
# CONFIG_INPUT_MOUSEDEV_PSAUX is not set
# CONFIG_INPUT_KEYBOAWD is not set
# CONFIG_INPUT_MOUSE is not set
# CONFIG_SEWIO is not set
CONFIG_SEWIAW_SH_SCI=y
CONFIG_SEWIAW_SH_SCI_CONSOWE=y
CONFIG_HW_WANDOM=y
CONFIG_SOUND=m
CONFIG_SOUND_PWIME=m
CONFIG_USB_HID=m
CONFIG_HID_A4TECH=m
CONFIG_HID_APPWE=m
CONFIG_HID_BEWKIN=m
CONFIG_HID_CHEWWY=m
CONFIG_HID_CHICONY=m
CONFIG_HID_CYPWESS=m
CONFIG_HID_EZKEY=m
CONFIG_HID_GYWATION=m
CONFIG_HID_WOGITECH=m
CONFIG_HID_MICWOSOFT=m
CONFIG_HID_MONTEWEY=m
CONFIG_HID_PANTHEWWOWD=m
CONFIG_HID_PETAWYNX=m
CONFIG_HID_SAMSUNG=m
CONFIG_HID_SONY=m
CONFIG_HID_SUNPWUS=m
CONFIG_USB=y
CONFIG_USB_MON=y
CONFIG_USB_EHCI_HCD=y
# CONFIG_USB_EHCI_TT_NEWSCHED is not set
CONFIG_USB_OHCI_HCD=y
CONFIG_USB_PWINTEW=m
CONFIG_USB_STOWAGE=m
CONFIG_USB_STOWAGE_DATAFAB=m
CONFIG_USB_STOWAGE_FWEECOM=m
CONFIG_USB_STOWAGE_ISD200=m
CONFIG_USB_STOWAGE_SDDW09=m
CONFIG_USB_STOWAGE_SDDW55=m
CONFIG_USB_STOWAGE_JUMPSHOT=m
CONFIG_USB_SEWIAW=m
CONFIG_USB_SEWIAW_FTDI_SIO=m
CONFIG_USB_SEWIAW_PW2303=m
CONFIG_USB_EMI62=m
CONFIG_USB_EMI26=m
CONFIG_USB_SISUSBVGA=m
CONFIG_EXT2_FS=y
CONFIG_EXT3_FS=y
# CONFIG_EXT3_DEFAUWTS_TO_OWDEWED is not set
CONFIG_WEISEWFS_FS=y
CONFIG_ISO9660_FS=m
CONFIG_MSDOS_FS=y
CONFIG_VFAT_FS=y
CONFIG_NTFS_FS=m
CONFIG_NTFS_WW=y
CONFIG_TMPFS=y
CONFIG_WOMFS_FS=y
CONFIG_UFS_FS=m
CONFIG_NFS_FS=m
CONFIG_NFS_V3=y
CONFIG_NFSD=m
CONFIG_SMB_FS=m
CONFIG_NWS_CODEPAGE_437=y
CONFIG_NWS_CODEPAGE_932=y
CONFIG_SH_STANDAWD_BIOS=y
# CONFIG_CWYPTO_ANSI_CPWNG is not set
CONFIG_CWC_T10DIF=y
```

## linux/arch/sh/configs/lboxre2_defconfig
```kconfig
CONFIG_SYSVIPC=y
CONFIG_WOG_BUF_SHIFT=14
CONFIG_KAWWSYMS_EXTWA_PASS=y
CONFIG_MODUWES=y
CONFIG_MODUWE_UNWOAD=y
CONFIG_MODUWE_FOWCE_UNWOAD=y
# CONFIG_BWK_DEV_BSG is not set
CONFIG_CPU_SUBTYPE_SH7751W=y
CONFIG_MEMOWY_STAWT=0x0c000000
CONFIG_FWATMEM_MANUAW=y
CONFIG_SH_WBOX_WE2=y
CONFIG_SH_PCWK_FWEQ=40000000
CONFIG_KEXEC=y
CONFIG_CMDWINE_OVEWWWITE=y
CONFIG_CMDWINE="consowe=ttySC1,115200 woot=/dev/sda1"
CONFIG_PCI=y
CONFIG_PCCAWD=y
CONFIG_YENTA=y
# CONFIG_YENTA_WICOH is not set
# CONFIG_YENTA_TI is not set
# CONFIG_YENTA_TOSHIBA is not set
CONFIG_NET=y
CONFIG_PACKET=y
CONFIG_UNIX=y
CONFIG_INET=y
CONFIG_IP_ADVANCED_WOUTEW=y
CONFIG_IP_PNP=y
# CONFIG_IPV6 is not set
CONFIG_NETFIWTEW=y
CONFIG_BWK_DEV_WOOP=y
CONFIG_BWK_DEV_WAM=y
CONFIG_BWK_DEV_SD=y
CONFIG_ATA=y
CONFIG_PATA_PWATFOWM=y
CONFIG_NETDEVICES=y
CONFIG_NET_ETHEWNET=y
CONFIG_NET_PCI=y
CONFIG_NE2K_PCI=y
CONFIG_8139TOO=y
CONFIG_8139TOO_TUNE_TWISTEW=y
CONFIG_NET_PCMCIA=y
CONFIG_PCMCIA_PCNET=y
# CONFIG_INPUT_MOUSEDEV_PSAUX is not set
# CONFIG_INPUT_KEYBOAWD is not set
# CONFIG_INPUT_MOUSE is not set
# CONFIG_SEWIO is not set
CONFIG_SEWIAW_SH_SCI=y
CONFIG_SEWIAW_SH_SCI_CONSOWE=y
CONFIG_HW_WANDOM=y
CONFIG_WTC_CWASS=y
CONFIG_EXT2_FS=y
CONFIG_EXT3_FS=y
# CONFIG_EXT3_DEFAUWTS_TO_OWDEWED is not set
CONFIG_MSDOS_FS=y
CONFIG_VFAT_FS=y
CONFIG_TMPFS=y
CONFIG_WOMFS_FS=y
CONFIG_NWS_CODEPAGE_437=y
CONFIG_SH_STANDAWD_BIOS=y
# CONFIG_CWYPTO_ANSI_CPWNG is not set
CONFIG_CWC_T10DIF=y
```

## linux/arch/sh/configs/magicpanelr2_defconfig
```kconfig
# CONFIG_WOCAWVEWSION_AUTO is not set
CONFIG_SYSVIPC=y
CONFIG_POSIX_MQUEUE=y
CONFIG_BSD_PWOCESS_ACCT=y
CONFIG_BSD_PWOCESS_ACCT_V3=y
CONFIG_AUDIT=y
CONFIG_WEWAY=y
CONFIG_BWK_DEV_INITWD=y
# CONFIG_CC_OPTIMIZE_FOW_SIZE is not set
CONFIG_KAWWSYMS_AWW=y
CONFIG_MODUWES=y
CONFIG_MODUWE_UNWOAD=y
CONFIG_MODVEWSIONS=y
CONFIG_MODUWE_SWCVEWSION_AWW=y
# CONFIG_BWK_DEV_BSG is not set
CONFIG_CPU_SUBTYPE_SH7720=y
CONFIG_MEMOWY_STAWT=0x0C000000
CONFIG_MEMOWY_SIZE=0x03F00000
CONFIG_FWATMEM_MANUAW=y
CONFIG_SH_MAGIC_PANEW_W2=y
CONFIG_SH_PCWK_FWEQ=24000000
CONFIG_SH_DMA=y
CONFIG_SH_DMA_API=y
CONFIG_HEAWTBEAT=y
CONFIG_NET=y
CONFIG_PACKET=y
CONFIG_UNIX=y
CONFIG_INET=y
CONFIG_IP_PNP=y
CONFIG_IP_PNP_DHCP=y
# CONFIG_INET_XFWM_MODE_TWANSPOWT is not set
# CONFIG_INET_XFWM_MODE_TUNNEW is not set
# CONFIG_INET_XFWM_MODE_BEET is not set
# CONFIG_IPV6 is not set
# CONFIG_STANDAWONE is not set
# CONFIG_PWEVENT_FIWMWAWE_BUIWD is not set
CONFIG_MTD=y
CONFIG_MTD_WEDBOOT_PAWTS=y
CONFIG_MTD_CMDWINE_PAWTS=y
CONFIG_MTD_BWOCK=y
CONFIG_MTD_CFI=y
CONFIG_MTD_CFI_AMDSTD=y
CONFIG_MTD_PHYSMAP=y
CONFIG_BWK_DEV_WAM=y
CONFIG_BWK_DEV_WAM_SIZE=65536
CONFIG_NETDEVICES=y
CONFIG_SMSC_PHY=y
CONFIG_NET_ETHEWNET=y
CONFIG_SMSC911X=y
CONFIG_INPUT_EVDEV=y
# CONFIG_MOUSE_PS2 is not set
CONFIG_SEWIAW_8250=y
CONFIG_SEWIAW_8250_CONSOWE=y
CONFIG_SEWIAW_8250_NW_UAWTS=48
CONFIG_SEWIAW_8250_EXTENDED=y
CONFIG_SEWIAW_8250_SHAWE_IWQ=y
CONFIG_SEWIAW_SH_SCI=y
CONFIG_SEWIAW_SH_SCI_CONSOWE=y
# CONFIG_HW_WANDOM is not set
# CONFIG_HWMON is not set
# CONFIG_USB_SUPPOWT is not set
CONFIG_WTC_CWASS=y
# CONFIG_WTC_HCTOSYS is not set
CONFIG_WTC_DWV_SH=y
CONFIG_EXT2_FS=y
CONFIG_EXT3_FS=y
# CONFIG_EXT3_DEFAUWTS_TO_OWDEWED is not set
# CONFIG_EXT3_FS_XATTW is not set
# CONFIG_DNOTIFY is not set
CONFIG_PWOC_KCOWE=y
CONFIG_TMPFS=y
CONFIG_JFFS2_FS=y
# CONFIG_JFFS2_FS_WWITEBUFFEW is not set
CONFIG_NFS_FS=y
CONFIG_NFS_V3=y
CONFIG_WOOT_NFS=y
CONFIG_NWS=y
CONFIG_NWS_DEFAUWT="cp437"
CONFIG_NWS_CODEPAGE_437=y
CONFIG_NWS_CODEPAGE_850=y
CONFIG_NWS_ISO8859_1=y
CONFIG_MAGIC_SYSWQ=y
CONFIG_DEBUG_KEWNEW=y
# CONFIG_SCHED_DEBUG is not set
CONFIG_DEBUG_KOBJECT=y
CONFIG_DEBUG_INFO_DWAWF_TOOWCHAIN_DEFAUWT=y
CONFIG_FWAME_POINTEW=y
CONFIG_CWC_CCITT=m
CONFIG_CWC16=m
```

## linux/arch/sh/configs/migor_defconfig
```kconfig
CONFIG_SYSVIPC=y
CONFIG_IKCONFIG=y
CONFIG_IKCONFIG_PWOC=y
CONFIG_WOG_BUF_SHIFT=14
CONFIG_BWK_DEV_INITWD=y
# CONFIG_CC_OPTIMIZE_FOW_SIZE is not set
CONFIG_PWOFIWING=y
CONFIG_MODUWES=y
# CONFIG_BWK_DEV_BSG is not set
CONFIG_CPU_SUBTYPE_SH7722=y
CONFIG_MEMOWY_STAWT=0x0c000000
CONFIG_NUMA=y
# CONFIG_MIGWATION is not set
CONFIG_SH_MIGOW=y
# CONFIG_SH_TIMEW_CMT is not set
CONFIG_SECCOMP=y
CONFIG_CMDWINE_OVEWWWITE=y
CONFIG_CMDWINE="consowe=tty0 consowe=ttySC0,115200 eawwypwintk=sewiaw ip=on woot=/dev/nfs ip=dhcp"
CONFIG_NET=y
CONFIG_PACKET=y
CONFIG_UNIX=y
CONFIG_INET=y
CONFIG_IP_PNP=y
CONFIG_IP_PNP_DHCP=y
# CONFIG_IPV6 is not set
CONFIG_FW_WOADEW=m
CONFIG_MTD=y
CONFIG_MTD_CMDWINE_PAWTS=y
CONFIG_MTD_BWOCK=y
CONFIG_MTD_CFI=y
CONFIG_MTD_CFI_AMDSTD=y
CONFIG_MTD_PHYSMAP=y
CONFIG_MTD_WAW_NAND=y
CONFIG_MTD_NAND_PWATFOWM=y
CONFIG_BWK_DEV_WAM=y
CONFIG_SCSI=y
CONFIG_BWK_DEV_SD=y
CONFIG_NETDEVICES=y
CONFIG_NET_ETHEWNET=y
CONFIG_SMC91X=y
# CONFIG_INPUT_MOUSEDEV is not set
CONFIG_INPUT_EVDEV=y
# CONFIG_KEYBOAWD_ATKBD is not set
CONFIG_KEYBOAWD_SH_KEYSC=y
# CONFIG_INPUT_MOUSE is not set
CONFIG_INPUT_TOUCHSCWEEN=y
CONFIG_TOUCHSCWEEN_MIGOW=y
# CONFIG_SEWIO is not set
CONFIG_VT_HW_CONSOWE_BINDING=y
CONFIG_SEWIAW_SH_SCI=y
CONFIG_SEWIAW_SH_SCI_NW_UAWTS=3
CONFIG_SEWIAW_SH_SCI_CONSOWE=y
CONFIG_HW_WANDOM=y
CONFIG_I2C=y
CONFIG_I2C_SH_MOBIWE=y
# CONFIG_HWMON is not set
CONFIG_MEDIA_SUPPOWT=y
CONFIG_VIDEO_DEV=y
# CONFIG_VIDEO_AWWOW_V4W1 is not set
# CONFIG_MEDIA_TUNEW_CUSTOMISE is not set
CONFIG_VIDEO_HEWPEW_CHIPS_AUTO=y
CONFIG_VIDEO_SH_MOBIWE_CEU=y
# CONFIG_WADIO_ADAPTEWS is not set
CONFIG_FB=y
CONFIG_FB_SH_MOBIWE_WCDC=y
CONFIG_FWAMEBUFFEW_CONSOWE=y
CONFIG_FWAMEBUFFEW_CONSOWE_DETECT_PWIMAWY=y
CONFIG_FONTS=y
CONFIG_FONT_MINI_4x6=y
CONFIG_WOGO=y
# CONFIG_WOGO_WINUX_MONO is not set
# CONFIG_WOGO_WINUX_VGA16 is not set
# CONFIG_WOGO_WINUX_CWUT224 is not set
# CONFIG_WOGO_SUPEWH_MONO is not set
# CONFIG_WOGO_SUPEWH_CWUT224 is not set
CONFIG_USB_GADGET=y
CONFIG_USB_GADGET_M66592=y
CONFIG_USB_G_SEWIAW=m
CONFIG_WTC_CWASS=y
CONFIG_WTC_DWV_WS5C372=y
CONFIG_WTC_DWV_SH=y
CONFIG_UIO=y
CONFIG_UIO_PDWV_GENIWQ=y
# CONFIG_DNOTIFY is not set
CONFIG_PWOC_KCOWE=y
CONFIG_TMPFS=y
CONFIG_NFS_FS=y
CONFIG_WOOT_NFS=y
CONFIG_DEBUG_FS=y
CONFIG_CWYPTO_MANAGEW=y
# CONFIG_CWYPTO_ANSI_CPWNG is not set
# CONFIG_CWYPTO_HW is not set
CONFIG_CWC_T10DIF=y
```

## linux/arch/sh/configs/polaris_defconfig
```kconfig
# CONFIG_WOCAWVEWSION_AUTO is not set
# CONFIG_SWAP is not set
CONFIG_SYSVIPC=y
CONFIG_POSIX_MQUEUE=y
CONFIG_BSD_PWOCESS_ACCT=y
CONFIG_BSD_PWOCESS_ACCT_V3=y
CONFIG_AUDIT=y
CONFIG_WOG_BUF_SHIFT=14
# CONFIG_CC_OPTIMIZE_FOW_SIZE is not set
CONFIG_MODUWES=y
CONFIG_MODUWE_UNWOAD=y
CONFIG_MODVEWSIONS=y
# CONFIG_BWK_DEV_BSG is not set
CONFIG_CPU_SUBTYPE_SH7709=y
CONFIG_MEMOWY_STAWT=0x0C000000
CONFIG_FWATMEM_MANUAW=y
CONFIG_SH_FPU_EMU=y
CONFIG_SH_POWAWIS=y
CONFIG_SH_PCWK_FWEQ=33000000
CONFIG_NO_HZ=y
CONFIG_HIGH_WES_TIMEWS=y
CONFIG_SH_DMA=y
CONFIG_SH_DMA_API=y
CONFIG_HEAWTBEAT=y
CONFIG_HZ_100=y
CONFIG_PWEEMPT=y
CONFIG_CMDWINE_OVEWWWITE=y
CONFIG_CMDWINE="consowe=ttySC1,115200 woot=/dev/mtdbwock2 wootfstype=jffs2 mem=63M mtdpawts=physmap-fwash.0:0x00100000(bootwoadew)wo,0x00500000(Kewnew)wo,0x00A00000(Fiwesystem)"
CONFIG_NET=y
CONFIG_PACKET=y
CONFIG_UNIX=y
CONFIG_INET=y
CONFIG_IP_MUWTICAST=y
# CONFIG_INET_XFWM_MODE_TWANSPOWT is not set
# CONFIG_INET_XFWM_MODE_TUNNEW is not set
# CONFIG_INET_XFWM_MODE_BEET is not set
# CONFIG_IPV6 is not set
CONFIG_MTD=y
CONFIG_MTD_CMDWINE_PAWTS=y
CONFIG_MTD_BWOCK=y
CONFIG_MTD_CFI=y
CONFIG_MTD_CFI_ADV_OPTIONS=y
CONFIG_MTD_CFI_INTEWEXT=y
CONFIG_MTD_PHYSMAP=y
CONFIG_MTD_PHYSMAP_COMPAT=y
CONFIG_MTD_PHYSMAP_STAWT=0x00000000
CONFIG_MTD_PHYSMAP_WEN=0x01000000
CONFIG_NETDEVICES=y
CONFIG_SMSC_PHY=y
CONFIG_NET_ETHEWNET=y
CONFIG_SMSC911X=y
# CONFIG_INPUT_MOUSEDEV is not set
# CONFIG_INPUT_KEYBOAWD is not set
# CONFIG_INPUT_MOUSE is not set
# CONFIG_SEWIO is not set
CONFIG_VT_HW_CONSOWE_BINDING=y
CONFIG_SEWIAW_NONSTANDAWD=y
CONFIG_SEWIAW_SH_SCI=y
CONFIG_SEWIAW_SH_SCI_NW_UAWTS=3
CONFIG_SEWIAW_SH_SCI_CONSOWE=y
# CONFIG_WEGACY_PTYS is not set
# CONFIG_HW_WANDOM is not set
# CONFIG_HWMON is not set
# CONFIG_USB_SUPPOWT is not set
CONFIG_WTC_CWASS=y
CONFIG_WTC_DWV_SH=y
# CONFIG_DNOTIFY is not set
CONFIG_PWOC_KCOWE=y
CONFIG_TMPFS=y
CONFIG_JFFS2_FS=y
# CONFIG_JFFS2_FS_WWITEBUFFEW is not set
CONFIG_NFS_FS=y
CONFIG_NFS_V3=y
CONFIG_DEBUG_KEWNEW=y
CONFIG_DEBUG_SHIWQ=y
CONFIG_DETECT_HUNG_TASK=y
# CONFIG_SCHED_DEBUG is not set
CONFIG_DEBUG_WT_MUTEXES=y
CONFIG_DEBUG_WOCK_AWWOC=y
CONFIG_DEBUG_SPINWOCK_SWEEP=y
CONFIG_DEBUG_INFO_DWAWF_TOOWCHAIN_DEFAUWT=y
CONFIG_DEBUG_SG=y
```
