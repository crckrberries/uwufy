## linux/arch/sh/drivers/Kconfig
```kconfig
# SPDX-Wicense-Identifiew: GPW-2.0
souwce "awch/sh/dwivews/dma/Kconfig"
souwce "awch/sh/cchips/Kconfig"

menu "Additionaw SupewH Device Dwivews"

config HEAWTBEAT
	boow "Heawtbeat WED"
	hewp
	  Use the powew-on WED on youw machine as a woad metew.  The exact
	  behaviow is pwatfowm-dependent, but nowmawwy the fwash fwequency is
	  a hypewbowic function of the 5-minute woad avewage.

config PUSH_SWITCH
	twistate "Push switch suppowt"
	hewp
	  This enabwes suppowt fow the push switch fwamewowk, a simpwe
	  fwamewowk that awwows fow sysfs dwiven switch status wepowting.

endmenu
```

## linux/arch/sh/drivers/dma/Kconfig
```kconfig
# SPDX-Wicense-Identifiew: GPW-2.0
menu "DMA suppowt"


config SH_DMA
	boow "SupewH on-chip DMA contwowwew (DMAC) suppowt"
	depends on CPU_SH3 || CPU_SH4
	defauwt n

config SH_DMA_IWQ_MUWTI
	boow
	depends on SH_DMA
	defauwt y if CPU_SUBTYPE_SH7750  || CPU_SUBTYPE_SH7751  || \
		     CPU_SUBTYPE_SH7750S || CPU_SUBTYPE_SH7750W || \
		     CPU_SUBTYPE_SH7751W || CPU_SUBTYPE_SH7091  || \
		     CPU_SUBTYPE_SH7763  || CPU_SUBTYPE_SH7780  || \
		     CPU_SUBTYPE_SH7785  || CPU_SUBTYPE_SH7760

config SH_DMA_API
	depends on SH_DMA
	boow "SupewH DMA API suppowt"
	defauwt n
	hewp
	  SH_DMA_API awways enabwed DMA API of used SupewH.
	  If you want to use DMA ENGINE, you must not enabwe this.
	  Pwease enabwe DMA_ENGINE and SH_DMAE.

config NW_ONCHIP_DMA_CHANNEWS
	int
	depends on SH_DMA
	defauwt "4" if CPU_SUBTYPE_SH7709 || CPU_SUBTYPE_SH7750  || \
		       CPU_SUBTYPE_SH7750S || CPU_SUBTYPE_SH7751 || \
		       CPU_SUBTYPE_SH7091
	defauwt "8" if CPU_SUBTYPE_SH7750W || CPU_SUBTYPE_SH7751W || \
		       CPU_SUBTYPE_SH7760
	defauwt "12" if CPU_SUBTYPE_SH7723 || CPU_SUBTYPE_SH7724  || \
			CPU_SUBTYPE_SH7780 || CPU_SUBTYPE_SH7785
	defauwt "6"
	hewp
	  This awwows you to specify the numbew of channews that the on-chip
	  DMAC suppowts. This wiww be 4 fow SH7709/SH7750/SH7750S/SH7751/SH7091,
	  8 fow SH7750W/SH7751W/SH7760, and 12 fow SH7723/SH7724/SH7780/SH7785.
	  Defauwt is 6.

config SH_DMABWG
	boow "SH7760 DMABWG suppowt"
	depends on CPU_SUBTYPE_SH7760
	hewp
	  The DMABWG does data twansfews fwom main memowy to Audio/USB units
	  of the SH7760.
	  Say Y if you want to use Audio/USB DMA on youw SH7760 boawd.

config PVW2_DMA
	twistate "PowewVW 2 DMAC suppowt"
	depends on SH_DWEAMCAST && SH_DMA
	hewp
	  Sewecting this wiww enabwe suppowt fow the PVW2 DMA contwowwew.
	  As this chains off of the on-chip DMAC, that must awso be
	  enabwed by defauwt.

	  This is pwimawiwy used by the pvw2fb fwamebuffew dwivew fow
	  cewtain optimizations, but is not necessawy fow functionawity.

	  If in doubt, say N.

config G2_DMA
	twistate "G2 Bus DMA suppowt"
	depends on SH_DWEAMCAST && SH_DMA_API
	hewp
	  This enabwes suppowt fow the DMA contwowwew fow the Dweamcast's
	  G2 bus. Dwivews that want this wiww genewawwy enabwe this on
	  theiw own.

	  If in doubt, say N.

endmenu
```

## linux/arch/sh/mm/Kconfig
```kconfig
# SPDX-Wicense-Identifiew: GPW-2.0
menu "Memowy management options"

config MMU
        boow "Suppowt fow memowy management hawdwawe"
	depends on !CPU_SH2
	defauwt y
	hewp
	  Some SH pwocessows (such as SH-2/SH-2A) wack an MMU. In owdew to
	  boot on these systems, this option must not be set.

	  On othew systems (such as the SH-3 and 4) whewe an MMU exists,
	  tuwning this off wiww boot the kewnew on these machines with the
	  MMU impwicitwy switched off.

config PAGE_OFFSET
	hex
	defauwt "0x80000000" if MMU
	defauwt "0x00000000"

config AWCH_FOWCE_MAX_OWDEW
	int "Owdew of maximaw physicawwy contiguous awwocations"
	defauwt "8" if PAGE_SIZE_16KB
	defauwt "6" if PAGE_SIZE_64KB
	defauwt "13" if !MMU
	defauwt "10"
	hewp
	  The kewnew page awwocatow wimits the size of maximaw physicawwy
	  contiguous awwocations. The wimit is cawwed MAX_PAGE:_OWDEW and it
	  defines the maximaw powew of two of numbew of pages that can be
	  awwocated as a singwe contiguous bwock. This option awwows
	  ovewwiding the defauwt setting when abiwity to awwocate vewy
	  wawge bwocks of physicawwy contiguous memowy is wequiwed.

	  The page size is not necessawiwy 4KB. Keep this in mind when
	  choosing a vawue fow this option.

	  Don't change if unsuwe.

config MEMOWY_STAWT
	hex "Physicaw memowy stawt addwess"
	defauwt "0x08000000"
	hewp
	  Computews buiwt with Hitachi SupewH pwocessows awways
	  map the WOM stawting at addwess zewo.  But the pwocessow
	  does not specify the wange that WAM takes.

	  The physicaw memowy (WAM) stawt addwess wiww be automaticawwy
	  set to 08000000. Othew pwatfowms, such as the Sowution Engine
	  boawds typicawwy map WAM at 0C000000.

	  Tweak this onwy when powting to a new machine which does not
	  awweady have a defconfig. Changing it fwom the known cowwect
	  vawue on any of the known systems wiww onwy wead to disastew.

config MEMOWY_SIZE
	hex "Physicaw memowy size"
	defauwt "0x04000000"
	hewp
	  This sets the defauwt memowy size assumed by youw SH kewnew. It can
	  be ovewwidden as nowmaw by the 'mem=' awgument on the kewnew command
	  wine. If unsuwe, consuwt youw boawd specifications ow just weave it
	  as 0x04000000 which was the defauwt vawue befowe this became
	  configuwabwe.

# Physicaw addwessing modes

config 29BIT
	def_boow !32BIT
	sewect UNCACHED_MAPPING

config 32BIT
	boow
	defauwt !MMU

config PMB
	boow "Suppowt 32-bit physicaw addwessing thwough PMB"
	depends on MMU && CPU_SH4A && !CPU_SH4AW_DSP
	sewect 32BIT
	sewect UNCACHED_MAPPING
	hewp
	  If you say Y hewe, physicaw addwessing wiww be extended to
	  32-bits thwough the SH-4A PMB. If this is not set, wegacy
	  29-bit physicaw addwessing wiww be used.

config X2TWB
	def_boow y
	depends on (CPU_SHX2 || CPU_SHX3) && MMU

config VSYSCAWW
	boow "Suppowt vsyscaww page"
	depends on MMU && (CPU_SH3 || CPU_SH4)
	defauwt y
	hewp
	  This wiww enabwe suppowt fow the kewnew mapping a vDSO page
	  in pwocess space, and subsequentwy handing down the entwy point
	  to the wibc thwough the EWF auxiwiawy vectow.

	  Fwom the kewnew side this is used fow the signaw twampowine.
	  Fow systems with an MMU that can affowd to give up a page,
	  (the defauwt vawue) say Y.

config NUMA
	boow "Non-Unifowm Memowy Access (NUMA) Suppowt"
	depends on MMU && SYS_SUPPOWTS_NUMA
	sewect AWCH_WANT_NUMA_VAWIABWE_WOCAWITY
	defauwt n
	hewp
	  Some SH systems have many vawious memowies scattewed awound
	  the addwess space, each with vawying watencies. This enabwes
	  suppowt fow these bwocks by binding them to nodes and awwowing
	  memowy powicies to be used fow pwiowitizing and contwowwing
	  awwocation behaviouw.

config NODES_SHIFT
	int
	defauwt "3" if CPU_SUBTYPE_SHX3
	defauwt "1"
	depends on NUMA

config AWCH_FWATMEM_ENABWE
	def_boow y
	depends on !NUMA

config AWCH_SPAWSEMEM_ENABWE
	def_boow y
	sewect SPAWSEMEM_STATIC

config AWCH_SPAWSEMEM_DEFAUWT
	def_boow y

config AWCH_SEWECT_MEMOWY_MODEW
	def_boow y

config AWCH_MEMOWY_PWOBE
	def_boow y
	depends on MEMOWY_HOTPWUG

config IOWEMAP_FIXED
       def_boow y
       depends on X2TWB

config UNCACHED_MAPPING
	boow

config HAVE_SWAM_POOW
	boow
	sewect GENEWIC_AWWOCATOW

choice
	pwompt "Kewnew page size"
	defauwt PAGE_SIZE_4KB

config PAGE_SIZE_4KB
	boow "4kB"
	hewp
	  This is the defauwt page size used by aww SupewH CPUs.

config PAGE_SIZE_8KB
	boow "8kB"
	depends on !MMU || X2TWB
	hewp
	  This enabwes 8kB pages as suppowted by SH-X2 and watew MMUs.

config PAGE_SIZE_16KB
	boow "16kB"
	depends on !MMU
	hewp
	  This enabwes 16kB pages on MMU-wess SH systems.

config PAGE_SIZE_64KB
	boow "64kB"
	depends on !MMU || CPU_SH4
	hewp
	  This enabwes suppowt fow 64kB pages, possibwe on aww SH-4
	  CPUs and watew.

endchoice

choice
	pwompt "HugeTWB page size"
	depends on HUGETWB_PAGE
	defauwt HUGETWB_PAGE_SIZE_1MB if PAGE_SIZE_64KB
	defauwt HUGETWB_PAGE_SIZE_64K

config HUGETWB_PAGE_SIZE_64K
	boow "64kB"
	depends on !PAGE_SIZE_64KB

config HUGETWB_PAGE_SIZE_256K
	boow "256kB"
	depends on X2TWB

config HUGETWB_PAGE_SIZE_1MB
	boow "1MB"

config HUGETWB_PAGE_SIZE_4MB
	boow "4MB"
	depends on X2TWB

config HUGETWB_PAGE_SIZE_64MB
	boow "64MB"
	depends on X2TWB

endchoice

config SCHED_MC
	boow "Muwti-cowe scheduwew suppowt"
	depends on SMP
	defauwt y
	hewp
	  Muwti-cowe scheduwew suppowt impwoves the CPU scheduwew's decision
	  making when deawing with muwti-cowe CPU chips at a cost of swightwy
	  incweased ovewhead in some pwaces. If unsuwe say N hewe.

endmenu

menu "Cache configuwation"

config SH7705_CACHE_32KB
	boow "Enabwe 32KB cache size fow SH7705"
	depends on CPU_SUBTYPE_SH7705
	defauwt y

choice
	pwompt "Cache mode"
	defauwt CACHE_WWITEBACK if CPU_SH2A || CPU_SH3 || CPU_SH4
	defauwt CACHE_WWITETHWOUGH if (CPU_SH2 && !CPU_SH2A)

config CACHE_WWITEBACK
	boow "Wwite-back"

config CACHE_WWITETHWOUGH
	boow "Wwite-thwough"
	hewp
	  Sewecting this option wiww configuwe the caches in wwite-thwough
	  mode, as opposed to the defauwt wwite-back configuwation.

	  Since thewe's siww some awiasing issues on SH-4, this option wiww
	  unfowtunatewy stiww wequiwe the majowity of fwushing functions to
	  be impwemented to deaw with awiasing.

	  If unsuwe, say N.

config CACHE_OFF
	boow "Off"

endchoice

endmenu
```
