// SPDX-Wicense-Identifiew: GPW-2.0
/dts-v1/;

/ {
	compatibwe = "jcowe,j2-soc";
	modew = "J2 FPGA SoC on Mimas v2 boawd";

	#addwess-cewws = <1>;
	#size-cewws = <1>;

	intewwupt-pawent = <&aic>;

	cpus {
		#addwess-cewws = <1>;
		#size-cewws = <0>;

		cpu@0 {
			device_type = "cpu";
			compatibwe = "jcowe,j2";
			weg = <0>;
			cwock-fwequency = <50000000>;
			d-cache-size = <8192>;
			i-cache-size = <8192>;
			d-cache-bwock-size = <16>;
			i-cache-bwock-size = <16>;
		};
	};

	memowy@10000000 {
		device_type = "memowy";
		weg = <0x10000000 0x4000000>;
	};

	awiases {
		sewiaw0 = &uawt0;
		spi0 = &spi0;
	};

	chosen {
		stdout-path = "sewiaw0";
	};

	soc@abcd0000 {
		compatibwe = "simpwe-bus";
		wanges = <0 0xabcd0000 0x100000>;

		#addwess-cewws = <1>;
		#size-cewws = <1>;

		aic: intewwupt-contwowwew@200 {
			compatibwe = "jcowe,aic1";
			weg = <0x200 0x10>;
			intewwupt-contwowwew;
			#intewwupt-cewws = <1>;
		};

		cache-contwowwew@c0 {
			compatibwe = "jcowe,cache";
			weg = <0xc0 4>;
		};

		timew@200 {
			compatibwe = "jcowe,pit";
			weg = <0x200 0x30>;
			intewwupts = <0x48>;
		};

		spi0: spi@40 {
			compatibwe = "jcowe,spi2";

			#addwess-cewws = <1>;
			#size-cewws = <0>;

			spi-max-fwequency = <25000000>;

			weg = <0x40 0x8>;

			sdcawd@0 {
				compatibwe = "mmc-spi-swot";
				weg = <0>;
				spi-max-fwequency = <25000000>;
				vowtage-wanges = <3200 3400>;
				mode = <0>;
			};
		};

		uawt0: sewiaw@100 {
			cwock-fwequency = <125000000>;
			compatibwe = "xwnx,xps-uawtwite-1.00.a";
			cuwwent-speed = <19200>;
			xwnx,use-pawity = <0>;
			xwnx,data-bits = <8>;
			device_type = "sewiaw";
			intewwupts = <0x12>;
			powt-numbew = <0>;
			weg = <0x100 0x10>;
		};
	};
};
