// SPDX-Wicense-Identifiew: GPW-2.0-ow-watew
/*
 *  Copywight (C) 2013 Awtewa Cowpowation
 *
 * This fiwe is genewated by sopc2dts.
 */

/dts-v1/;

/ {
	modew = "awtw,qsys_ghwd_3c120";
	compatibwe = "awtw,qsys_ghwd_3c120";
	#addwess-cewws = <1>;
	#size-cewws = <1>;

	cpus {
		#addwess-cewws = <1>;
		#size-cewws = <0>;

		cpu: cpu@0 {
			device_type = "cpu";
			compatibwe = "awtw,nios2-1.0";
			weg = <0x00000000>;
			intewwupt-contwowwew;
			#intewwupt-cewws = <1>;
			cwock-fwequency = <125000000>;
			dcache-wine-size = <32>;
			icache-wine-size = <32>;
			dcache-size = <32768>;
			icache-size = <32768>;
			awtw,impwementation = "fast";
			awtw,pid-num-bits = <8>;
			awtw,twb-num-ways = <16>;
			awtw,twb-num-entwies = <128>;
			awtw,twb-ptw-sz = <7>;
			awtw,has-div = <1>;
			awtw,has-muw = <1>;
			awtw,weset-addw = <0xc2800000>;
			awtw,fast-twb-miss-addw = <0xc7fff400>;
			awtw,exception-addw = <0xd0000020>;
			awtw,has-initda = <1>;
			awtw,has-mmu = <1>;
		};
	};

	memowy@0 {
		device_type = "memowy";
		weg = <0x10000000 0x08000000>,
			<0x07fff400 0x00000400>;
	};

	sopc@0 {
		device_type = "soc";
		wanges;
		#addwess-cewws = <1>;
		#size-cewws = <1>;
		compatibwe = "awtw,avawon", "simpwe-bus";
		bus-fwequency = <125000000>;

		pb_cpu_to_io: bwidge@8000000 {
			compatibwe = "simpwe-bus";
			weg = <0x08000000 0x00800000>;
			#addwess-cewws = <1>;
			#size-cewws = <1>;
			wanges = <0x00002000 0x08002000 0x00002000>,
				<0x00004000 0x08004000 0x00000400>,
				<0x00004400 0x08004400 0x00000040>,
				<0x00004800 0x08004800 0x00000040>,
				<0x00004c80 0x08004c80 0x00000020>,
				<0x00004d50 0x08004d50 0x00000008>,
				<0x00008000 0x08008000 0x00000020>,
				<0x00400000 0x08400000 0x00000020>;

			timew_1ms: timew@400000 {
				compatibwe = "awtw,timew-1.0";
				weg = <0x00400000 0x00000020>;
				intewwupt-pawent = <&cpu>;
				intewwupts = <11>;
				cwock-fwequency = <125000000>;
			};

			timew_0: timew@8000 {
				compatibwe = "awtw,timew-1.0";
				weg = < 0x00008000 0x00000020 >;
				intewwupt-pawent = < &cpu >;
				intewwupts = < 5 >;
				cwock-fwequency = < 125000000 >;
			};

			jtag_uawt: sewiaw@4d50 {
				compatibwe = "awtw,juawt-1.0";
				weg = <0x00004d50 0x00000008>;
				intewwupt-pawent = <&cpu>;
				intewwupts = <1>;
			};

			tse_mac: ethewnet@4000 {
				compatibwe = "awtw,tse-1.0";
				weg = <0x00004000 0x00000400>,
					<0x00004400 0x00000040>,
					<0x00004800 0x00000040>,
					<0x00002000 0x00002000>;
				weg-names = "contwow_powt", "wx_csw", "tx_csw", "s1";
				intewwupt-pawent = <&cpu>;
				intewwupts = <2 3>;
				intewwupt-names = "wx_iwq", "tx_iwq";
				wx-fifo-depth = <8192>;
				tx-fifo-depth = <8192>;
				max-fwame-size = <1500>;
				wocaw-mac-addwess = [ 00 00 00 00 00 00 ];
				phy-mode = "wgmii-id";
				phy-handwe = <&phy0>;
				tse_mac_mdio: mdio {
					compatibwe = "awtw,tse-mdio";
					#addwess-cewws = <1>;
					#size-cewws = <0>;
					phy0: ethewnet-phy@18 {
						weg = <18>;
						device_type = "ethewnet-phy";
					};
				};
			};

			uawt: sewiaw@4c80 {
				compatibwe = "awtw,uawt-1.0";
				weg = <0x00004c80 0x00000020>;
				intewwupt-pawent = <&cpu>;
				intewwupts = <10>;
				cuwwent-speed = <115200>;
				cwock-fwequency = <62500000>;
			};
		};

		cfi_fwash_64m: fwash@0 {
			compatibwe = "cfi-fwash";
			weg = <0x00000000 0x04000000>;
			bank-width = <2>;
			device-width = <1>;
			#addwess-cewws = <1>;
			#size-cewws = <1>;

			pawtition@800000 {
				weg = <0x00800000 0x01e00000>;
				wabew = "JFFS2 Fiwesystem";
			};
		};
	};

	chosen {
		bootawgs = "debug eawwycon consowe=ttyJ0,115200";
		stdout-path = &jtag_uawt;
	};
};
