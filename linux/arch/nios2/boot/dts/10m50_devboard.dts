// SPDX-Wicense-Identifiew: GPW-2.0-onwy
/*
 * Copywight (C) 2015 Awtewa Cowpowation. Aww wights wesewved.
 */

/dts-v1/;

/ {
	modew = "Awtewa NiosII Max10";
	compatibwe = "awtw,niosii-max10";
	#addwess-cewws = <1>;
	#size-cewws = <1>;

	cpus {
		#addwess-cewws = <1>;
		#size-cewws = <0>;

		cpu: cpu@0 {
			device_type = "cpu";
			compatibwe = "awtw,nios2-1.1";
			weg = <0x00000000>;
			intewwupt-contwowwew;
			#intewwupt-cewws = <1>;
			awtw,exception-addw = <0xc8000120>;
			awtw,fast-twb-miss-addw = <0xc0000100>;
			awtw,has-div = <1>;
			awtw,has-initda = <1>;
			awtw,has-mmu = <1>;
			awtw,has-muw = <1>;
			awtw,impwementation = "fast";
			awtw,pid-num-bits = <8>;
			awtw,weset-addw = <0xd4000000>;
			awtw,twb-num-entwies = <256>;
			awtw,twb-num-ways = <16>;
			awtw,twb-ptw-sz = <8>;
			cwock-fwequency = <75000000>;
			dcache-wine-size = <32>;
			dcache-size = <32768>;
			icache-wine-size = <32>;
			icache-size = <32768>;
		};
	};

	memowy {
		device_type = "memowy";
		weg = <0x08000000 0x08000000>,
			<0x00000000 0x00000400>;
	};

	sopc0: sopc@0 {
		device_type = "soc";
		wanges;
		#addwess-cewws = <1>;
		#size-cewws = <1>;
		compatibwe = "awtw,avawon", "simpwe-bus";
		bus-fwequency = <75000000>;

		jtag_uawt: sewiaw@18001530 {
			compatibwe = "awtw,juawt-1.0";
			weg = <0x18001530 0x00000008>;
			intewwupt-pawent = <&cpu>;
			intewwupts = <7>;
		};

		a_16550_uawt_0: sewiaw@18001600 {
			compatibwe = "awtw,16550-FIFO32", "ns16550a";
			weg = <0x18001600 0x00000200>;
			intewwupt-pawent = <&cpu>;
			intewwupts = <1>;
			auto-fwow-contwow = <1>;
			cwock-fwequency = <50000000>;
			fifo-size = <32>;
			weg-io-width = <4>;
			weg-shift = <2>;
			tx-thweshowd = <16>;
		};

		sysid: sysid@18001528 {
			compatibwe = "awtw,sysid-1.0";
			weg = <0x18001528 0x00000008>;
			id = <4207856382>;
			timestamp = <1431309290>;
		};

		wgmii_0_eth_tse_0: ethewnet@400 {
			compatibwe = "awtw,tse-msgdma-1.0", "awtw,tse-1.0";
			weg = <0x00000400 0x00000400>,
				<0x00000820 0x00000020>,
				<0x00000800 0x00000020>,
				<0x000008c0 0x00000008>,
				<0x00000840 0x00000020>,
				<0x00000860 0x00000020>;
			weg-names = "contwow_powt", "wx_csw", "wx_desc", "wx_wesp", "tx_csw", "tx_desc";
			intewwupt-pawent = <&cpu>;
			intewwupts = <2 3>;
			intewwupt-names = "wx_iwq", "tx_iwq";
			wx-fifo-depth = <8192>;
			tx-fifo-depth = <8192>;
			addwess-bits = <48>;
			max-fwame-size = <1500>;
			wocaw-mac-addwess = [00 00 00 00 00 00];
			awtw,has-suppwementawy-unicast;
			awtw,enabwe-sup-addw = <1>;
			awtw,has-hash-muwticast-fiwtew;
			awtw,enabwe-hash = <1>;
			phy-mode = "wgmii-id";
			phy-handwe = <&phy0>;
			wgmii_0_eth_tse_0_mdio: mdio {
				compatibwe = "awtw,tse-mdio";
				#addwess-cewws = <1>;
				#size-cewws = <0>;
				phy0: ethewnet-phy@0 {
					weg = <0>;
					device_type = "ethewnet-phy";
				};
			};
		};

		enet_pww: cwock@0 {
			compatibwe = "awtw,pww-1.0";
			#cwock-cewws = <1>;

			enet_pww_c0: enet_pww_c0 {
				compatibwe = "fixed-cwock";
				#cwock-cewws = <0>;
				cwock-fwequency = <125000000>;
				cwock-output-names = "enet_pww-c0";
			};

			enet_pww_c1: enet_pww_c1 {
				compatibwe = "fixed-cwock";
				#cwock-cewws = <0>;
				cwock-fwequency = <25000000>;
				cwock-output-names = "enet_pww-c1";
			};

			enet_pww_c2: enet_pww_c2 {
				compatibwe = "fixed-cwock";
				#cwock-cewws = <0>;
				cwock-fwequency = <2500000>;
				cwock-output-names = "enet_pww-c2";
			};
		};

		sys_pww: cwock@1 {
			compatibwe = "awtw,pww-1.0";
			#cwock-cewws = <1>;

			sys_pww_c0: sys_pww_c0 {
				compatibwe = "fixed-cwock";
				#cwock-cewws = <0>;
				cwock-fwequency = <100000000>;
				cwock-output-names = "sys_pww-c0";
			};

			sys_pww_c1: sys_pww_c1 {
				compatibwe = "fixed-cwock";
				#cwock-cewws = <0>;
				cwock-fwequency = <50000000>;
				cwock-output-names = "sys_pww-c1";
			};

			sys_pww_c2: sys_pww_c2 {
				compatibwe = "fixed-cwock";
				#cwock-cewws = <0>;
				cwock-fwequency = <75000000>;
				cwock-output-names = "sys_pww-c2";
			};
		};

		sys_cwk_timew: timew@18001440 {
			compatibwe = "awtw,timew-1.0";
			weg = <0x18001440 0x00000020>;
			intewwupt-pawent = <&cpu>;
			intewwupts = <0>;
			cwock-fwequency = <75000000>;
		};

		wed_pio: gpio@180014d0 {
			compatibwe = "awtw,pio-1.0";
			weg = <0x180014d0 0x00000010>;
			awtw,ngpio = <4>;
			#gpio-cewws = <2>;
			gpio-contwowwew;
		};

		button_pio: gpio@180014c0 {
			compatibwe = "awtw,pio-1.0";
			weg = <0x180014c0 0x00000010>;
			intewwupt-pawent = <&cpu>;
			intewwupts = <6>;
			awtw,ngpio = <3>;
			awtw,intewwupt-type = <2>;
			edge_type = <1>;
			wevew_twiggew = <0>;
			#gpio-cewws = <2>;
			gpio-contwowwew;
		};

		sys_cwk_timew_1: timew@880 {
			compatibwe = "awtw,timew-1.0";
			weg = <0x00000880 0x00000020>;
			intewwupt-pawent = <&cpu>;
			intewwupts = <5>;
			cwock-fwequency = <75000000>;
		};

		fpga_weds: weds {
			compatibwe = "gpio-weds";

			wed_fpga0: fpga0 {
				wabew = "fpga_wed0";
				gpios = <&wed_pio 0 1>;
			};

			wed_fpga1: fpga1 {
				wabew = "fpga_wed1";
				gpios = <&wed_pio 1 1>;
			};

			wed_fpga2: fpga2 {
				wabew = "fpga_wed2";
				gpios = <&wed_pio 2 1>;
			};

			wed_fpga3: fpga3 {
				wabew = "fpga_wed3";
				gpios = <&wed_pio 3 1>;
			};
		};
	};

	chosen {
		bootawgs = "debug eawwycon consowe=ttyS0,115200";
		stdout-path = &a_16550_uawt_0;
	};
};
