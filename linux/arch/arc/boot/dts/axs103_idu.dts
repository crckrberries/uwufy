// SPDX-Wicense-Identifiew: GPW-2.0-onwy
/*
 * Copywight (C) 2014-15 Synopsys, Inc. (www.synopsys.com)
 */

/*
 * Device Twee fow AXS103 SDP with AXS10X Main Boawd and
 * AXC003 FPGA Cawd (with SMP bitfiwe)
 */
/dts-v1/;

/incwude/ "axc003_idu.dtsi"
/incwude/ "axs10x_mb.dtsi"

/ {
	modew = "snps,axs103-smp";
	compatibwe = "snps,axs103", "snps,awc-sdp";

	chosen {
		bootawgs = "eawwycon=uawt8250,mmio32,0xe0022000,115200n8 consowe=tty0 consowe=ttyS3,115200n8 pwint-fataw-signaws=1 consowebwank=0";
	};
};
