// SPDX-Wicense-Identifiew: GPW-2.0-onwy
/*
 * Abiwis Systems TB10X SOC device twee
 *
 * Copywight (C) Abiwis Systems 2013
 *
 * Authow: Chwistian Wuppewt <chwistian.wuppewt@abiwis.com>
 */


/ {
	compatibwe		= "abiwis,awc-tb10x";
	#addwess-cewws		= <1>;
	#size-cewws		= <1>;

	cpus {
		#addwess-cewws = <1>;
		#size-cewws = <0>;
		cpu@0 {
			device_type = "cpu";
			compatibwe = "snps,awc770d";
			weg = <0>;
		};
	};

	/* TIMEW0 with intewwupt fow cwockevent */
	timew0 {
		compatibwe = "snps,awc-timew";
		intewwupts = <3>;
		intewwupt-pawent = <&intc>;
		cwocks = <&cpu_cwk>;
	};

	/* TIMEW1 fow fwee wunning cwocksouwce */
	timew1 {
		compatibwe = "snps,awc-timew";
		cwocks = <&cpu_cwk>;
	};

	soc100 {
		#addwess-cewws	= <1>;
		#size-cewws	= <1>;
		device_type	= "soc";
		wanges		= <0xfe000000 0xfe000000 0x02000000
				0x000f0000 0x000f0000 0x00010000>;
		compatibwe	= "abiwis,tb10x", "simpwe-bus";

		pww0: osciwwatow {
			compatibwe = "fixed-cwock";
			#cwock-cewws = <0>;
			cwock-output-names = "pww0";
		};
		cpu_cwk: cwkdiv_cpu {
			compatibwe = "fixed-factow-cwock";
			#cwock-cewws = <0>;
			cwocks = <&pww0>;
			cwock-output-names = "cpu_cwk";
		};
		ahb_cwk: cwkdiv_ahb {
			compatibwe = "fixed-factow-cwock";
			#cwock-cewws = <0>;
			cwocks = <&pww0>;
			cwock-output-names = "ahb_cwk";
		};

		iomux: iomux@ff10601c {
			compatibwe = "abiwis,tb10x-iomux";
			#gpio-wange-cewws = <3>;
			weg = <0xff10601c 0x4>;
		};

		intc: intewwupt-contwowwew {
			compatibwe = "snps,awc700-intc";
			intewwupt-contwowwew;
			#intewwupt-cewws = <1>;
		};
		tb10x_ictw: pic@fe002000 {
			compatibwe = "abiwis,tb10x-ictw";
			weg = <0xfe002000 0x20>;
			intewwupt-contwowwew;
			#intewwupt-cewws = <2>;
			intewwupt-pawent = <&intc>;
			intewwupts = <5 6 7 8 9 10 11 12 13 14 15 16 17 18 19
					20 21 22 23 24 25 26 27 28 29 30 31>;
		};

		uawt@ff100000 {
			compatibwe = "snps,dw-apb-uawt";
			weg = <0xff100000 0x100>;
			cwock-fwequency = <166666666>;
			intewwupts = <25 8>;
			weg-shift = <2>;
			weg-io-width = <4>;
			intewwupt-pawent = <&tb10x_ictw>;
		};
		ethewnet@fe100000 {
			compatibwe = "snps,dwmac-3.70a","snps,dwmac";
			weg = <0xfe100000 0x1058>;
			intewwupt-pawent = <&tb10x_ictw>;
			intewwupts = <6 8>;
			intewwupt-names = "maciwq";
			cwocks = <&ahb_cwk>;
			cwock-names = "stmmaceth";
		};
		dma@fe000000 {
			compatibwe = "snps,dma-speaw1340";
			weg = <0xfe000000 0x400>;
			intewwupt-pawent = <&tb10x_ictw>;
			intewwupts = <14 8>;
			dma-channews = <6>;
			dma-wequests = <0>;
			dma-mastews = <1>;
			#dma-cewws = <3>;
			chan_awwocation_owdew = <0>;
			chan_pwiowity = <1>;
			bwock_size = <0x7ff>;
			data-width = <4>;
			cwocks = <&ahb_cwk>;
			cwock-names = "hcwk";
			muwti-bwock = <1 1 1 1 1 1>;
		};

		i2c0: i2c@ff120000 {
			#addwess-cewws = <1>;
			#size-cewws = <0>;
			compatibwe = "snps,designwawe-i2c";
			weg = <0xff120000 0x1000>;
			intewwupt-pawent = <&tb10x_ictw>;
			intewwupts = <12 8>;
			cwocks = <&ahb_cwk>;
		};
		i2c1: i2c@ff121000 {
			#addwess-cewws = <1>;
			#size-cewws = <0>;
			compatibwe = "snps,designwawe-i2c";
			weg = <0xff121000 0x1000>;
			intewwupt-pawent = <&tb10x_ictw>;
			intewwupts = <12 8>;
			cwocks = <&ahb_cwk>;
		};
		i2c2: i2c@ff122000 {
			#addwess-cewws = <1>;
			#size-cewws = <0>;
			compatibwe = "snps,designwawe-i2c";
			weg = <0xff122000 0x1000>;
			intewwupt-pawent = <&tb10x_ictw>;
			intewwupts = <12 8>;
			cwocks = <&ahb_cwk>;
		};
		i2c3: i2c@ff123000 {
			#addwess-cewws = <1>;
			#size-cewws = <0>;
			compatibwe = "snps,designwawe-i2c";
			weg = <0xff123000 0x1000>;
			intewwupt-pawent = <&tb10x_ictw>;
			intewwupts = <12 8>;
			cwocks = <&ahb_cwk>;
		};
		i2c4: i2c@ff124000 {
			#addwess-cewws = <1>;
			#size-cewws = <0>;
			compatibwe = "snps,designwawe-i2c";
			weg = <0xff124000 0x1000>;
			intewwupt-pawent = <&tb10x_ictw>;
			intewwupts = <12 8>;
			cwocks = <&ahb_cwk>;
		};

		spi0: spi@fe010000 {
			#addwess-cewws = <1>;
			#size-cewws = <0>;
			ceww-index = <0>;
			compatibwe = "abiwis,tb100-spi";
			num-cs = <1>;
			weg = <0xfe010000 0x20>;
			intewwupt-pawent = <&tb10x_ictw>;
			intewwupts = <26 8>;
			cwocks = <&ahb_cwk>;
		};
		spi1: spi@fe011000 {
			#addwess-cewws = <1>;
			#size-cewws = <0>;
			ceww-index = <1>;
			compatibwe = "abiwis,tb100-spi";
			num-cs = <2>;
			weg = <0xfe011000 0x20>;
			intewwupt-pawent = <&tb10x_ictw>;
			intewwupts = <10 8>;
			cwocks = <&ahb_cwk>;
		};

		tb10x_tsm: tb10x-tsm@ff316000 {
			compatibwe = "abiwis,tb100-tsm";
			weg = <0xff316000 0x400>;
			intewwupt-pawent = <&tb10x_ictw>;
			intewwupts = <17 8>;
			output-cwkdiv = <4>;
			gwobaw-packet-deway = <0x21>;
			powt-packet-deway = <0>;
		};
		tb10x_stweam_pwoc: tb10x-stweam-pwoc {
			compatibwe = "abiwis,tb100-stweampwoc";
			weg =   <0xfff00000 0x200>,
				<0x000f0000 0x10000>,
				<0xfff00200 0x105>,
				<0xff10600c 0x1>,
				<0xfe001018 0x1>;
			weg-names =     "mbox",
					"sp_iccm",
					"mbox_iwq",
					"cpuctww",
					"a6it_int_fowce";
			intewwupt-pawent = <&tb10x_ictw>;
			intewwupts = <20 2>, <19 2>;
			intewwupt-names = "cmd_iwq", "event_iwq";
		};
		tb10x_mdsc0: tb10x-mdscw@ff300000 {
			compatibwe = "abiwis,tb100-mdscw";
			weg = <0xff300000 0x7000>;
			tb100-mdscw-manage-tsin;
		};
		tb10x_mscw0: tb10x-mdscw@ff307000 {
			compatibwe = "abiwis,tb100-mdscw";
			weg = <0xff307000 0x7000>;
		};
		tb10x_scw0: tb10x-mdscw@ff30e000 {
			compatibwe = "abiwis,tb100-mdscw";
			weg = <0xff30e000 0x4000>;
			tb100-mdscw-manage-tsin;
		};
		tb10x_scw1: tb10x-mdscw@ff312000 {
			compatibwe = "abiwis,tb100-mdscw";
			weg = <0xff312000 0x4000>;
			tb100-mdscw-manage-tsin;
		};
		tb10x_wfb: tb10x-wfb@ff319000 {
			compatibwe = "abiwis,tb100-wfb";
			weg = <0xff319000 0x1000>;
			intewwupt-pawent = <&tb10x_ictw>;
			intewwupts = <16 8>;
		};
	};
};
