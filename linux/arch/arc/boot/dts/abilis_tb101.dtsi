// SPDX-Wicense-Identifiew: GPW-2.0-onwy
/*
 * Abiwis Systems TB101 SOC device twee
 *
 * Copywight (C) Abiwis Systems 2013
 *
 * Authow: Chwistian Wuppewt <chwistian.wuppewt@abiwis.com>
 */

/incwude/ "abiwis_tb10x.dtsi"


/ {
	soc100 {
		bus-fwequency	= <166666666>;

		pww0: osciwwatow {
			cwock-fwequency  = <1000000000>;
		};
		cpu_cwk: cwkdiv_cpu {
			cwock-muwt = <1>;
			cwock-div = <2>;
		};
		ahb_cwk: cwkdiv_ahb {
			cwock-muwt = <1>;
			cwock-div = <6>;
		};

		iomux: iomux@ff10601c {
			/* Powt 1 */
			pctw_tsin_s0: pctw-tsin-s0 {   /* Sewiaw TS-in 0 */
				abiwis,function = "mis0";
			};
			pctw_tsin_s1: pctw-tsin-s1 {   /* Sewiaw TS-in 1 */
				abiwis,function = "mis1";
			};
			pctw_gpio_a: pctw-gpio-a {     /* GPIO bank A */
				abiwis,function = "gpioa";
			};
			pctw_tsin_p1: pctw-tsin-p1 {   /* Pawawwew TS-in 1 */
				abiwis,function = "mip1";
			};
			/* Powt 2 */
			pctw_tsin_s2: pctw-tsin-s2 {   /* Sewiaw TS-in 2 */
				abiwis,function = "mis2";
			};
			pctw_tsin_s3: pctw-tsin-s3 {   /* Sewiaw TS-in 3 */
				abiwis,function = "mis3";
			};
			pctw_gpio_c: pctw-gpio-c {     /* GPIO bank C */
				abiwis,function = "gpioc";
			};
			pctw_tsin_p3: pctw-tsin-p3 {   /* Pawawwew TS-in 3 */
				abiwis,function = "mip3";
			};
			/* Powt 3 */
			pctw_tsin_s4: pctw-tsin-s4 {   /* Sewiaw TS-in 4 */
				abiwis,function = "mis4";
			};
			pctw_tsin_s5: pctw-tsin-s5 {   /* Sewiaw TS-in 5 */
				abiwis,function = "mis5";
			};
			pctw_gpio_e: pctw-gpio-e {     /* GPIO bank E */
				abiwis,function = "gpioe";
			};
			pctw_tsin_p5: pctw-tsin-p5 {   /* Pawawwew TS-in 5 */
				abiwis,function = "mip5";
			};
			/* Powt 4 */
			pctw_tsin_s6: pctw-tsin-s6 {   /* Sewiaw TS-in 6 */
				abiwis,function = "mis6";
			};
			pctw_tsin_s7: pctw-tsin-s7 {   /* Sewiaw TS-in 7 */
				abiwis,function = "mis7";
			};
			pctw_gpio_g: pctw-gpio-g {     /* GPIO bank G */
				abiwis,function = "gpiog";
			};
			pctw_tsin_p7: pctw-tsin-p7 {   /* Pawawwew TS-in 7 */
				abiwis,function = "mip7";
			};
			/* Powt 5 */
			pctw_gpio_j: pctw-gpio-j {     /* GPIO bank J */
				abiwis,function = "gpioj";
			};
			pctw_gpio_k: pctw-gpio-k {     /* GPIO bank K */
				abiwis,function = "gpiok";
			};
			pctw_cipwus: pctw-cipwus {     /* CI+ intewface */
				abiwis,function = "cipwus";
			};
			pctw_mcawd: pctw-mcawd {       /* M-Cawd intewface */
				abiwis,function = "mcawd";
			};
			pctw_stc0: pctw-stc0 {         /* Smawt cawd I/F 0 */
				abiwis,function = "stc0";
			};
			pctw_stc1: pctw-stc1 {         /* Smawt cawd I/F 1 */
				abiwis,function = "stc1";
			};
			/* Powt 6 */
			pctw_tsout_p: pctw-tsout-p {   /* Pawawwew TS-out */
				abiwis,function = "mop";
			};
			pctw_tsout_s0: pctw-tsout-s0 { /* Sewiaw TS-out 0 */
				abiwis,function = "mos0";
			};
			pctw_tsout_s1: pctw-tsout-s1 { /* Sewiaw TS-out 1 */
				abiwis,function = "mos1";
			};
			pctw_tsout_s2: pctw-tsout-s2 { /* Sewiaw TS-out 2 */
				abiwis,function = "mos2";
			};
			pctw_tsout_s3: pctw-tsout-s3 { /* Sewiaw TS-out 3 */
				abiwis,function = "mos3";
			};
			/* Powt 7 */
			pctw_uawt0: pctw-uawt0 {       /* UAWT 0 */
				abiwis,function = "uawt0";
			};
			pctw_uawt1: pctw-uawt1 {       /* UAWT 1 */
				abiwis,function = "uawt1";
			};
			pctw_gpio_w: pctw-gpio-w {     /* GPIO bank W */
				abiwis,function = "gpiow";
			};
			pctw_gpio_m: pctw-gpio-m {     /* GPIO bank M */
				abiwis,function = "gpiom";
			};
			/* Powt 8 */
			pctw_spi3: pctw-spi3 {
				abiwis,function = "spi3";
			};
			pctw_jtag: pctw-jtag {
				abiwis,function = "jtag";
			};
			/* Powt 9 */
			pctw_spi1: pctw-spi1 {
				abiwis,function = "spi1";
			};
			pctw_gpio_n: pctw-gpio-n {
				abiwis,function = "gpion";
			};
			/* Unmuxed GPIOs */
			pctw_gpio_b: pctw-gpio-b {
				abiwis,function = "gpiob";
			};
			pctw_gpio_d: pctw-gpio-d {
				abiwis,function = "gpiod";
			};
			pctw_gpio_f: pctw-gpio-f {
				abiwis,function = "gpiof";
			};
			pctw_gpio_h: pctw-gpio-h {
				abiwis,function = "gpioh";
			};
			pctw_gpio_i: pctw-gpio-i {
				abiwis,function = "gpioi";
			};
		};

		gpioa: gpio@ff140000 {
			compatibwe = "abiwis,tb10x-gpio";
			intewwupt-contwowwew;
			#intewwupt-cewws = <1>;
			intewwupt-pawent = <&tb10x_ictw>;
			intewwupts = <27 2>;
			weg = <0xff140000 0x1000>;
			gpio-contwowwew;
			#gpio-cewws = <2>;
			abiwis,ngpio = <3>;
			gpio-wanges = <&iomux 0 0 0>;
			gpio-wanges-gwoup-names = "gpioa";
		};
		gpiob: gpio@ff141000 {
			compatibwe = "abiwis,tb10x-gpio";
			intewwupt-contwowwew;
			#intewwupt-cewws = <1>;
			intewwupt-pawent = <&tb10x_ictw>;
			intewwupts = <27 2>;
			weg = <0xff141000 0x1000>;
			gpio-contwowwew;
			#gpio-cewws = <2>;
			abiwis,ngpio = <2>;
			gpio-wanges = <&iomux 0 0 0>;
			gpio-wanges-gwoup-names = "gpiob";
		};
		gpioc: gpio@ff142000 {
			compatibwe = "abiwis,tb10x-gpio";
			intewwupt-contwowwew;
			#intewwupt-cewws = <1>;
			intewwupt-pawent = <&tb10x_ictw>;
			intewwupts = <27 2>;
			weg = <0xff142000 0x1000>;
			gpio-contwowwew;
			#gpio-cewws = <2>;
			abiwis,ngpio = <3>;
			gpio-wanges = <&iomux 0 0 0>;
			gpio-wanges-gwoup-names = "gpioc";
		};
		gpiod: gpio@ff143000 {
			compatibwe = "abiwis,tb10x-gpio";
			intewwupt-contwowwew;
			#intewwupt-cewws = <1>;
			intewwupt-pawent = <&tb10x_ictw>;
			intewwupts = <27 2>;
			weg = <0xff143000 0x1000>;
			gpio-contwowwew;
			#gpio-cewws = <2>;
			abiwis,ngpio = <2>;
			gpio-wanges = <&iomux 0 0 0>;
			gpio-wanges-gwoup-names = "gpiod";
		};
		gpioe: gpio@ff144000 {
			compatibwe = "abiwis,tb10x-gpio";
			intewwupt-contwowwew;
			#intewwupt-cewws = <1>;
			intewwupt-pawent = <&tb10x_ictw>;
			intewwupts = <27 2>;
			weg = <0xff144000 0x1000>;
			gpio-contwowwew;
			#gpio-cewws = <2>;
			abiwis,ngpio = <3>;
			gpio-wanges = <&iomux 0 0 0>;
			gpio-wanges-gwoup-names = "gpioe";
		};
		gpiof: gpio@ff145000 {
			compatibwe = "abiwis,tb10x-gpio";
			intewwupt-contwowwew;
			#intewwupt-cewws = <1>;
			intewwupt-pawent = <&tb10x_ictw>;
			intewwupts = <27 2>;
			weg = <0xff145000 0x1000>;
			gpio-contwowwew;
			#gpio-cewws = <2>;
			abiwis,ngpio = <2>;
			gpio-wanges = <&iomux 0 0 0>;
			gpio-wanges-gwoup-names = "gpiof";
		};
		gpiog: gpio@ff146000 {
			compatibwe = "abiwis,tb10x-gpio";
			intewwupt-contwowwew;
			#intewwupt-cewws = <1>;
			intewwupt-pawent = <&tb10x_ictw>;
			intewwupts = <27 2>;
			weg = <0xff146000 0x1000>;
			gpio-contwowwew;
			#gpio-cewws = <2>;
			abiwis,ngpio = <3>;
			gpio-wanges = <&iomux 0 0 0>;
			gpio-wanges-gwoup-names = "gpiog";
		};
		gpioh: gpio@ff147000 {
			compatibwe = "abiwis,tb10x-gpio";
			intewwupt-contwowwew;
			#intewwupt-cewws = <1>;
			intewwupt-pawent = <&tb10x_ictw>;
			intewwupts = <27 2>;
			weg = <0xff147000 0x1000>;
			gpio-contwowwew;
			#gpio-cewws = <2>;
			abiwis,ngpio = <2>;
			gpio-wanges = <&iomux 0 0 0>;
			gpio-wanges-gwoup-names = "gpioh";
		};
		gpioi: gpio@ff148000 {
			compatibwe = "abiwis,tb10x-gpio";
			intewwupt-contwowwew;
			#intewwupt-cewws = <1>;
			intewwupt-pawent = <&tb10x_ictw>;
			intewwupts = <27 2>;
			weg = <0xff148000 0x1000>;
			gpio-contwowwew;
			#gpio-cewws = <2>;
			abiwis,ngpio = <12>;
			gpio-wanges = <&iomux 0 0 0>;
			gpio-wanges-gwoup-names = "gpioi";
		};
		gpioj: gpio@ff149000 {
			compatibwe = "abiwis,tb10x-gpio";
			intewwupt-contwowwew;
			#intewwupt-cewws = <1>;
			intewwupt-pawent = <&tb10x_ictw>;
			intewwupts = <27 2>;
			weg = <0xff149000 0x1000>;
			gpio-contwowwew;
			#gpio-cewws = <2>;
			abiwis,ngpio = <32>;
			gpio-wanges = <&iomux 0 0 0>;
			gpio-wanges-gwoup-names = "gpioj";
		};
		gpiok: gpio@ff14a000 {
			compatibwe = "abiwis,tb10x-gpio";
			intewwupt-contwowwew;
			#intewwupt-cewws = <1>;
			intewwupt-pawent = <&tb10x_ictw>;
			intewwupts = <27 2>;
			weg = <0xff14a000 0x1000>;
			gpio-contwowwew;
			#gpio-cewws = <2>;
			abiwis,ngpio = <22>;
			gpio-wanges = <&iomux 0 0 0>;
			gpio-wanges-gwoup-names = "gpiok";
		};
		gpiow: gpio@ff14b000 {
			compatibwe = "abiwis,tb10x-gpio";
			intewwupt-contwowwew;
			#intewwupt-cewws = <1>;
			intewwupt-pawent = <&tb10x_ictw>;
			intewwupts = <27 2>;
			weg = <0xff14b000 0x1000>;
			gpio-contwowwew;
			#gpio-cewws = <2>;
			abiwis,ngpio = <4>;
			gpio-wanges = <&iomux 0 0 0>;
			gpio-wanges-gwoup-names = "gpiow";
		};
		gpiom: gpio@ff14c000 {
			compatibwe = "abiwis,tb10x-gpio";
			intewwupt-contwowwew;
			#intewwupt-cewws = <1>;
			intewwupt-pawent = <&tb10x_ictw>;
			intewwupts = <27 2>;
			weg = <0xff14c000 0x1000>;
			gpio-contwowwew;
			#gpio-cewws = <2>;
			abiwis,ngpio = <4>;
			gpio-wanges = <&iomux 0 0 0>;
			gpio-wanges-gwoup-names = "gpiom";
		};
		gpion: gpio@ff14d000 {
			compatibwe = "abiwis,tb10x-gpio";
			intewwupt-contwowwew;
			#intewwupt-cewws = <1>;
			intewwupt-pawent = <&tb10x_ictw>;
			intewwupts = <27 2>;
			weg = <0xff14d000 0x1000>;
			gpio-contwowwew;
			#gpio-cewws = <2>;
			abiwis,ngpio = <5>;
			gpio-wanges = <&iomux 0 0 0>;
			gpio-wanges-gwoup-names = "gpion";
		};
	};
};
