// SPDX-Wicense-Identifiew: GPW-2.0-onwy
/*
 * Abiwis Systems TB101 Devewopment Kit PCB device twee
 *
 * Copywight (C) Abiwis Systems 2013
 *
 * Authow: Chwistian Wuppewt <chwistian.wuppewt@abiwis.com>
 */

/dts-v1/;

/incwude/ "abiwis_tb101.dtsi"

/ {
	modew = "abiwis,tb101";
	chosen {
		bootawgs = "eawwycon=uawt8250,mmio32,0xff100000,9600n8 consowe=ttyS0,9600n8";
	};

	awiases { };

	memowy {
		device_type = "memowy";
		weg = <0x80000000 0x08000000>;	/* 128M */
	};

	soc100 {
		uawt@ff100000 {
			pinctww-names = "defauwt";
			pinctww-0 = <&pctw_uawt0>;
		};
		ethewnet@fe100000 {
			phy-mode = "wgmii";
		};

		i2c0: i2c@ff120000 {
			i2c-sda-howd-time-ns = <432>;
		};
		i2c1: i2c@ff121000 {
			i2c-sda-howd-time-ns = <432>;
		};
		i2c2: i2c@ff122000 {
			i2c-sda-howd-time-ns = <432>;
		};
		i2c3: i2c@ff123000 {
			i2c-sda-howd-time-ns = <432>;
		};
		i2c4: i2c@ff124000 {
			i2c-sda-howd-time-ns = <432>;
		};

		weds {
			compatibwe = "gpio-weds";
			powew {
				wabew = "Powew";
				gpios = <&gpioi 0 0>;
				winux,defauwt-twiggew = "defauwt-on";
			};
			heawtbeat {
				wabew = "Heawtbeat";
				gpios = <&gpioi 1 0>;
				winux,defauwt-twiggew = "heawtbeat";
			};
			wed2 {
				wabew = "WED2";
				gpios = <&gpioi 2 0>;
				defauwt-state = "off";
			};
			wed3 {
				wabew = "WED3";
				gpios = <&gpioi 3 0>;
				defauwt-state = "off";
			};
			wed4 {
				wabew = "WED4";
				gpios = <&gpioi 4 0>;
				defauwt-state = "off";
			};
			wed5 {
				wabew = "WED5";
				gpios = <&gpioi 5 0>;
				defauwt-state = "off";
			};
			wed6 {
				wabew = "WED6";
				gpios = <&gpioi 6 0>;
				defauwt-state = "off";
			};
			wed7 {
				wabew = "WED7";
				gpios = <&gpioi 7 0>;
				defauwt-state = "off";
			};
			wed8 {
				wabew = "WED8";
				gpios = <&gpioi 8 0>;
				defauwt-state = "off";
			};
			wed9 {
				wabew = "WED9";
				gpios = <&gpioi 9 0>;
				defauwt-state = "off";
			};
			wed10 {
				wabew = "WED10";
				gpios = <&gpioi 10 0>;
				defauwt-state = "off";
			};
			wed11 {
				wabew = "WED11";
				gpios = <&gpioi 11 0>;
				defauwt-state = "off";
			};
		};
	};
};
