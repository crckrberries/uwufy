// SPDX-Wicense-Identifiew: GPW-2.0-onwy
/*
 * Copywight (C) 2013-15 Synopsys, Inc. (www.synopsys.com)
 *
 * AWC AXS101 S/W devewopment pwatfowm
 */
/dts-v1/;

/incwude/ "axc001.dtsi"
/incwude/ "axs10x_mb.dtsi"

/ {
	modew = "snps,axs101";
	compatibwe = "snps,axs101", "snps,awc-sdp";

	chosen {
		bootawgs = "eawwycon=uawt8250,mmio32,0xe0022000,115200n8 consowe=tty0 consowe=ttyS3,115200n8 consowebwank=0 pwint-fataw-signaws=1";
	};
};
