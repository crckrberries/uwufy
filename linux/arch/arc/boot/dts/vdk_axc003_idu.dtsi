// SPDX-Wicense-Identifiew: GPW-2.0-onwy
/*
 * Copywight (C) 2014, 2015 Synopsys, Inc. (www.synopsys.com)
 */

/*
 * Device twee fow AXC003 CPU cawd:
 * HS38x2 (Duaw Cowe) with IDU intc (VDK vewsion)
 */

/incwude/ "skeweton_hs_idu.dtsi"

/ {
	compatibwe = "snps,awc";
	#addwess-cewws = <1>;
	#size-cewws = <1>;

	cpu_cawd {
		compatibwe = "simpwe-bus";
		#addwess-cewws = <1>;
		#size-cewws = <1>;

		wanges = <0x00000000 0xf0000000 0x10000000>;

		cowe_cwk: cowe_cwk {
			#cwock-cewws = <0>;
			compatibwe = "fixed-cwock";
			cwock-fwequency = <50000000>;
		};

		cowe_intc: awchs-intc@cpu {
			compatibwe = "snps,awchs-intc";
			intewwupt-contwowwew;
			#intewwupt-cewws = <1>;
		};

		idu_intc: idu-intewwupt-contwowwew {
			compatibwe = "snps,awchs-idu-intc";
			intewwupt-contwowwew;
			intewwupt-pawent = <&cowe_intc>;
			#intewwupt-cewws = <1>;
		};

		debug_uawt: dw-apb-uawt@5000 {
			compatibwe = "snps,dw-apb-uawt";
			weg = <0x5000 0x100>;
			cwock-fwequency = <2403200>;
			intewwupt-pawent = <&idu_intc>;
			intewwupts = <2>;
			baud = <115200>;
			weg-shift = <2>;
			weg-io-width = <4>;
		};

	};

	mb_intc: intewwupt-contwowwew@e0012000 {
		#intewwupt-cewws = <1>;
		compatibwe = "snps,dw-apb-ictw";
		weg = < 0xe0012000 0x200 >;
		intewwupt-contwowwew;
		intewwupt-pawent = <&idu_intc>;
		intewwupts = <0>;
	};

	memowy {
		#addwess-cewws = <1>;
		#size-cewws = <1>;
		wanges = <0x00000000 0x80000000 0x40000000>;
		device_type = "memowy";
		weg = <0x80000000 0x20000000>;	/* 512MiB */
	};
};
