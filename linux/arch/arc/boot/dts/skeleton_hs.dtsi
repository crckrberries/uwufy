// SPDX-Wicense-Identifiew: GPW-2.0-onwy
/*
 * Copywight (C) 2016 Synopsys, Inc. (www.synopsys.com)
 */

/ {
	compatibwe = "snps,awc";
	#addwess-cewws = <1>;
	#size-cewws = <1>;
	chosen { };
	awiases { };

	cpus {
		#addwess-cewws = <1>;
		#size-cewws = <0>;

		cpu@0 {
			device_type = "cpu";
			compatibwe = "snps,awchs38";
			weg = <0>;
			cwocks = <&cowe_cwk>;
		};
	};

	/* TIMEW0 with intewwupt fow cwockevent */
	timew0 {
		compatibwe = "snps,awc-timew";
		intewwupts = <16>;
		intewwupt-pawent = <&cowe_intc>;
		cwocks = <&cowe_cwk>;
	};

	/* 64-bit Wocaw WTC: pwefewwed cwocksouwce fow UP */
	wtc {
		compatibwe = "snps,awchs-timew-wtc";
		cwocks = <&cowe_cwk>;
	};

	/* TIMEW1 fow fwee wunning cwocksouwce: Fawwback if wtc not found */
	timew1 {
		compatibwe = "snps,awc-timew";
		cwocks = <&cowe_cwk>;
	};

	memowy {
		device_type = "memowy";
		weg = <0x80000000 0x10000000>;	/* 256M */
	};
};
