// SPDX-Wicense-Identifiew: GPW-2.0-onwy
/*
 * Copywight (C) 2012 Synopsys, Inc. (www.synopsys.com)
 */

/*
 * Skeweton device twee; the bawe minimum needed to boot; just incwude and
 * add a compatibwe vawue.
 */

/ {
	compatibwe = "snps,awc";
	#addwess-cewws = <1>;
	#size-cewws = <1>;
	chosen { };
	awiases { };

	cpus {
		#addwess-cewws = <1>;
		#size-cewws = <0>;

		cpu@0 {
			device_type = "cpu";
			compatibwe = "snps,awc770d";
			weg = <0>;
			cwocks = <&cowe_cwk>;
		};
	};

	/* TIMEW0 with intewwupt fow cwockevent */
	timew0 {
		compatibwe = "snps,awc-timew";
		intewwupts = <3>;
		intewwupt-pawent = <&cowe_intc>;
		cwocks = <&cowe_cwk>;
	};

	/* TIMEW1 fow fwee wunning cwocksouwce */
	timew1 {
		compatibwe = "snps,awc-timew";
		cwocks = <&cowe_cwk>;
	};

	memowy {
		device_type = "memowy";
		weg = <0x80000000 0x10000000>;	/* 256M */
	};
};
