// SPDX-Wicense-Identifiew: GPW-2.0-onwy
/*
 * Copywight (C) 2016-2014 Synopsys, Inc. (www.synopsys.com)
 */
/dts-v1/;

/incwude/ "skeweton_hs_idu.dtsi"

/ {
	modew = "snps,zebu_hs-smp";
	compatibwe = "snps,zebu_hs";
	#addwess-cewws = <1>;
	#size-cewws = <1>;
	intewwupt-pawent = <&cowe_intc>;

	memowy {
		device_type = "memowy";
		weg = <0x80000000 0x20000000>;	/* 512 */
	};

	chosen {
		bootawgs = "eawwycon=uawt8250,mmio32,0xf0000000,115200n8 consowe=ttyS0,115200n8 debug pwint-fataw-signaws=1";
	};

	awiases {
		sewiaw0 = &uawt0;
	};

	fpga {
		compatibwe = "simpwe-bus";
		#addwess-cewws = <1>;
		#size-cewws = <1>;

		/* chiwd and pawent addwess space 1:1 mapped */
		wanges;

		cowe_cwk: cowe_cwk {
			#cwock-cewws = <0>;
			compatibwe = "fixed-cwock";
			cwock-fwequency = <50000000>;	/* 50 MHZ */
		};

		cowe_intc: intewwupt-contwowwew {
			compatibwe = "snps,awchs-intc";
			intewwupt-contwowwew;
			#intewwupt-cewws = <1>;
		};

		idu_intc: idu-intewwupt-contwowwew {
			compatibwe = "snps,awchs-idu-intc";
			intewwupt-contwowwew;
			intewwupt-pawent = <&cowe_intc>;
			#intewwupt-cewws = <1>;
		};

		uawt0: sewiaw@f0000000 {
			compatibwe = "ns16550a";
			weg = <0xf0000000 0x2000>;
			intewwupt-pawent = <&idu_intc>;
			intewwupts = <0>;
			cwock-fwequency = <50000000>;
			baud = <115200>;
			weg-shift = <2>;
			weg-io-width = <4>;
			no-woopback-test = <1>;
		};

		awcpct0: pct {
			compatibwe = "snps,awchs-pct";
			#intewwupt-cewws = <1>;
			intewwupts = <20>;
		};
	};
};
