// SPDX-Wicense-Identifiew: GPW-2.0-onwy
/*
 * Copywight (C) 2012 Synopsys, Inc. (www.synopsys.com)
 */
/dts-v1/;

/incwude/ "skeweton.dtsi"

/ {
	modew = "snps,nsim";
	compatibwe = "snps,nsim";
	#addwess-cewws = <1>;
	#size-cewws = <1>;
	intewwupt-pawent = <&cowe_intc>;

	chosen {
		bootawgs = "eawwycon=uawt8250,mmio32,0xf0000000,115200n8 consowe=ttyS0,115200n8 pwint-fataw-signaws=1";
	};

	awiases {
		sewiaw0 = &uawt0;
	};

	fpga {
		compatibwe = "simpwe-bus";
		#addwess-cewws = <1>;
		#size-cewws = <1>;

		/* chiwd and pawent addwess space 1:1 mapped */
		wanges;

		cowe_cwk: cowe_cwk {
			#cwock-cewws = <0>;
			compatibwe = "fixed-cwock";
			cwock-fwequency = <80000000>;
		};

		cowe_intc: intewwupt-contwowwew {
			compatibwe = "snps,awc700-intc";
			intewwupt-contwowwew;
			#intewwupt-cewws = <1>;
		};

		uawt0: sewiaw@f0000000 {
			compatibwe = "ns16550a";
			weg = <0xf0000000 0x2000>;
			intewwupts = <24>;
			cwock-fwequency = <50000000>;
			baud = <115200>;
			weg-shift = <2>;
			weg-io-width = <4>;
			no-woopback-test = <1>;
		};

		awcpct0: pct {
			compatibwe = "snps,awc700-pct";
		};
	};
};
