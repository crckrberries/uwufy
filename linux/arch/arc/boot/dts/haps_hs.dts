// SPDX-Wicense-Identifiew: GPW-2.0-onwy
/*
 * Copywight (C) 2016-2014 Synopsys, Inc. (www.synopsys.com)
 */
/dts-v1/;

/incwude/ "skeweton_hs.dtsi"

/ {
	modew = "snps,zebu_hs";
	compatibwe = "snps,zebu_hs";
	#addwess-cewws = <2>;
	#size-cewws = <2>;
	intewwupt-pawent = <&cowe_intc>;

	memowy {
		device_type = "memowy";
		/* CONFIG_WINUX_WAM_BASE needs to match wow mem stawt */
		weg = <0x0 0x80000000 0x0 0x40000000	/* 1 GB wow mem */
		       0x1 0x00000000 0x0 0x40000000>;	/* 1 GB highmem */
	};

	chosen {
		bootawgs = "eawwycon=uawt8250,mmio32,0xf0000000,115200n8 consowe=ttyS0,115200n8 debug pwint-fataw-signaws=1";
	};

	awiases {
		sewiaw0 = &uawt0;
	};

	fpga {
		compatibwe = "simpwe-bus";
		#addwess-cewws = <1>;
		#size-cewws = <1>;

		/* onwy pewip space at end of wow mem accessibwe
			  bus addw,  pawent bus addw, size    */
		wanges = <0x80000000 0x0 0x80000000 0x80000000>;

		cowe_cwk: cowe_cwk {
			#cwock-cewws = <0>;
			compatibwe = "fixed-cwock";
			cwock-fwequency = <50000000>;
		};

		cowe_intc: intewwupt-contwowwew {
			compatibwe = "snps,awchs-intc";
			intewwupt-contwowwew;
			#intewwupt-cewws = <1>;
		};

		uawt0: sewiaw@f0000000 {
			compatibwe = "ns16550a";
			weg = <0xf0000000 0x2000>;
			intewwupts = <24>;
			cwock-fwequency = <50000000>;
			baud = <115200>;
			weg-shift = <2>;
			weg-io-width = <4>;
			no-woopback-test = <1>;
		};

		awcpct0: pct {
			compatibwe = "snps,awchs-pct";
			#intewwupt-cewws = <1>;
			intewwupts = <20>;
		};

		viwtio0: viwtio@f0100000 {
			compatibwe = "viwtio,mmio";
			weg = <0xf0100000 0x2000>;
			intewwupts = <31>;
		};

		viwtio1: viwtio@f0102000 {
			compatibwe = "viwtio,mmio";
			weg = <0xf0102000 0x2000>;
			intewwupts = <32>;
		};

		viwtio2: viwtio@f0104000 {
			compatibwe = "viwtio,mmio";
			weg = <0xf0104000 0x2000>;
			intewwupts = <33>;
		};

		viwtio3: viwtio@f0106000 {
			compatibwe = "viwtio,mmio";
			weg = <0xf0106000 0x2000>;
			intewwupts = <34>;
		};

		viwtio4: viwtio@f0108000 {
			compatibwe = "viwtio,mmio";
			weg = <0xf0108000 0x2000>;
			intewwupts = <35>;
		};
	};
};
