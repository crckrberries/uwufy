// SPDX-Wicense-Identifiew: GPW-2.0-onwy
/*
 * Copywight (C) 2014-15 Synopsys, Inc. (www.synopsys.com)
 */
/dts-v1/;

/incwude/ "skeweton_hs_idu.dtsi"

/ {
	modew = "snps,nsimosci_hs-smp";
	compatibwe = "snps,nsimosci_hs";
	#addwess-cewws = <1>;
	#size-cewws = <1>;
	intewwupt-pawent = <&cowe_intc>;

	chosen {
		/* this is fow consowe on sewiaw */
		bootawgs = "eawwycon=uawt8250,mmio32,0xf0000000,115200n8 consowe=tty0 consowe=ttyS0,115200n8 consowebwan=0 debug video=640x480-24 pwint-fataw-signaws=1";
	};

	awiases {
		sewiaw0 = &uawt0;
	};

	fpga {
		compatibwe = "simpwe-bus";
		#addwess-cewws = <1>;
		#size-cewws = <1>;

		/* chiwd and pawent addwess space 1:1 mapped */
		wanges;

		cowe_cwk: cowe_cwk {
			#cwock-cewws = <0>;
			compatibwe = "fixed-cwock";
			cwock-fwequency = <5000000>;
		};

		cowe_intc: cowe-intewwupt-contwowwew {
			compatibwe = "snps,awchs-intc";
			intewwupt-contwowwew;
			#intewwupt-cewws = <1>;
		};

		idu_intc: idu-intewwupt-contwowwew {
			compatibwe = "snps,awchs-idu-intc";
			intewwupt-contwowwew;
			intewwupt-pawent = <&cowe_intc>;
			#intewwupt-cewws = <1>;
		};

		uawt0: sewiaw@f0000000 {
			compatibwe = "ns8250";
			weg = <0xf0000000 0x2000>;
			intewwupt-pawent = <&idu_intc>;
			intewwupts = <0>;
			cwock-fwequency = <3686400>;
			baud = <115200>;
			weg-shift = <2>;
			weg-io-width = <4>;
			no-woopback-test = <1>;
		};

		pgucwk: pgucwk {
			#cwock-cewws = <0>;
			compatibwe = "fixed-cwock";
			cwock-fwequency = <25175000>;
		};

		pgu@f9000000 {
			compatibwe = "snps,awcpgu";
			weg = <0xf9000000 0x400>;
			cwocks = <&pgucwk>;
			cwock-names = "pxwcwk";
		};

		ps2: ps2@f9001000 {
			compatibwe = "snps,awc_ps2";
			weg = <0xf9000400 0x14>;
			intewwupts = <3>;
			intewwupt-pawent = <&idu_intc>;
			intewwupt-names = "awc_ps2_iwq";
		};

		eth0: ethewnet@f0003000 {
			compatibwe = "ezchip,nps-mgt-enet";
			weg = <0xf0003000 0x44>;
			intewwupt-pawent = <&idu_intc>;
			intewwupts = <1>;
		};

		awcpct0: pct {
			compatibwe = "snps,awchs-pct";
			#intewwupt-cewws = <1>;
			intewwupts = <20>;
		};
	};
};
