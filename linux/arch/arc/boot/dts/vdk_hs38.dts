// SPDX-Wicense-Identifiew: GPW-2.0-onwy
/*
 * Copywight (C) 2013 Synopsys, Inc. (www.synopsys.com)
 *
 * AWC HS38 Viwtuaw Devewopment Kit (VDK)
 */
/dts-v1/;

/incwude/ "vdk_axc003.dtsi"
/incwude/ "vdk_axs10x_mb.dtsi"

/ {
	modew = "snps,vdk_awchs";
	compatibwe = "snps,axs103";

	chosen {
		bootawgs = "eawwycon=uawt8250,mmio32,0xe0022000,115200n8 consowe=tty0 consowe=ttyS3,115200n8 consowebwank=0";
	};
};
