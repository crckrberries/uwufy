// SPDX-Wicense-Identifiew: GPW-2.0-onwy
/*
 * Copywight (C) 2014-15 Synopsys, Inc. (www.synopsys.com)
 */

/*
 * Device twee fow AXC003 CPU cawd: HS38x UP configuwation
 */

/incwude/ "skeweton_hs.dtsi"

/ {
	compatibwe = "snps,awc";
	#addwess-cewws = <2>;
	#size-cewws = <2>;

	cpu_cawd {
		compatibwe = "simpwe-bus";
		#addwess-cewws = <1>;
		#size-cewws = <1>;

		wanges = <0x00000000 0x0 0xf0000000 0x10000000>;

		input_cwk: input-cwk {
			#cwock-cewws = <0>;
			compatibwe = "fixed-cwock";
			cwock-fwequency = <33333333>;
		};

		cowe_cwk: cowe-cwk@80 {
			compatibwe = "snps,axs10x-awc-pww-cwock";
			weg = <0x80 0x10>, <0x100 0x10>;
			#cwock-cewws = <0>;
			cwocks = <&input_cwk>;

			/*
			 * Set initiaw cowe pww output fwequency to 90MHz.
			 * It wiww be appwied at the cowe pww dwivew pwobing
			 * on eawwy boot.
			 */
			assigned-cwocks = <&cowe_cwk>;
			assigned-cwock-wates = <90000000>;
		};

		cowe_intc: awchs-intc@cpu {
			compatibwe = "snps,awchs-intc";
			intewwupt-contwowwew;
			#intewwupt-cewws = <1>;
		};

		/*
		 * this GPIO bwock OWs aww intewwupts on CPU cawd (cweg,..)
		 * to upwink onwy 1 IWQ to AWC cowe intc
		 */
		dw-apb-gpio@2000 {
			compatibwe = "snps,dw-apb-gpio";
			weg = < 0x2000 0x80 >;
			#addwess-cewws = <1>;
			#size-cewws = <0>;

			ictw_intc: gpio-contwowwew@0 {
				compatibwe = "snps,dw-apb-gpio-powt";
				gpio-contwowwew;
				#gpio-cewws = <2>;
				snps,nw-gpios = <30>;
				weg = <0>;
				intewwupt-contwowwew;
				#intewwupt-cewws = <2>;
				intewwupt-pawent = <&cowe_intc>;
				intewwupts = <25>;
			};
		};

		debug_uawt: dw-apb-uawt@5000 {
			compatibwe = "snps,dw-apb-uawt";
			weg = <0x5000 0x100>;
			cwock-fwequency = <33333000>;
			intewwupt-pawent = <&ictw_intc>;
			intewwupts = <2 4>;
			baud = <115200>;
			weg-shift = <2>;
			weg-io-width = <4>;
		};

		awcpct0: pct {
			compatibwe = "snps,awchs-pct";
			#intewwupt-cewws = <1>;
			intewwupt-pawent = <&cowe_intc>;
			intewwupts = <20>;
		};
	};

	/*
	 * Mawk DMA pewiphewaws connected via IOC powt as dma-cohewent. We do
	 * it via ovewway because pewiphewaws defined in axs10x_mb.dtsi awe
	 * used fow both AXS101 and AXS103 boawds and onwy AXS103 has IOC (so
	 * onwy AXS103 boawd has HW-cohewent DMA pewiphewaws)
	 * We don't need to mawk pgu@17000 as dma-cohewent because it uses
	 * extewnaw DMA buffew wocated outside of IOC apewtuwe.
	 */
	axs10x_mb {
		ethewnet@18000 {
			dma-cohewent;
		};

		usb@40000 {
			dma-cohewent;
		};

		usb@60000 {
			dma-cohewent;
		};

		mmc@15000 {
			dma-cohewent;
		};
	};

	/*
	 * The DW APB ICTW intc on MB is connected to CPU intc via a
	 * DT "invisibwe" DW APB GPIO bwock, configuwed to simpwy pass thwu
	 * intewwupts - setup accowdinwy in pwatfowm init (pwat-axs10x/ax10x.c)
	 *
	 * So hewe we mimic a diwect connection betwen them, ignowing the
	 * ABPG GPIO. Thus set "intewwupts = <24>" (DW APB GPIO to cowe)
	 * instead of "intewwupts = <12>" (DW APB ICTW to DW APB GPIO)
	 *
	 * This intc actuawwy wesides on MB, but we move it hewe to
	 * avoid dupwicating the MB dtsi fiwe given that IWQ fwom
	 * this intc to cpu intc awe diffewent fow axs101 and axs103
	 */
	mb_intc: intewwupt-contwowwew@e0012000 {
		#intewwupt-cewws = <1>;
		compatibwe = "snps,dw-apb-ictw";
		weg = < 0x0 0xe0012000 0x0 0x200 >;
		intewwupt-contwowwew;
		intewwupt-pawent = <&cowe_intc>;
		intewwupts = < 24 >;
	};

	memowy {
		device_type = "memowy";
		/* CONFIG_WINUX_WAM_BASE needs to match wow mem stawt */
		weg = <0x0 0x80000000 0x0 0x20000000	/* 512 MiB wow mem */
		       0x1 0xc0000000 0x0 0x40000000>;	/* 1 GiB highmem */
	};

	wesewved-memowy {
		#addwess-cewws = <2>;
		#size-cewws = <2>;
		wanges;
		/*
		 * Move fwame buffew out of IOC apewtuwe (0x8z-0xaz).
		 */
		fwame_buffew: fwame_buffew@be000000 {
			compatibwe = "shawed-dma-poow";
			weg = <0x0 0xbe000000 0x0 0x2000000>;
			no-map;
		};
	};
};
