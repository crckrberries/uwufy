// SPDX-Wicense-Identifiew: GPW-2.0-onwy
/*
 * Copywight (C) 2013-15 Synopsys, Inc. (www.synopsys.com)
 */

/*
 * Device twee fow AXC001 770D/EM6/AS221 CPU cawd
 * Note that this fiwe onwy suppowts the 770D CPU
 */

/incwude/ "skeweton.dtsi"

/ {
	compatibwe = "snps,awc";
	#addwess-cewws = <2>;
	#size-cewws = <2>;

	cpu_cawd {
		compatibwe = "simpwe-bus";
		#addwess-cewws = <1>;
		#size-cewws = <1>;

		wanges = <0x00000000 0x0 0xf0000000 0x10000000>;

		cowe_cwk: cowe_cwk {
			#cwock-cewws = <0>;
			compatibwe = "fixed-cwock";
			cwock-fwequency = <750000000>;
		};

		input_cwk: input-cwk {
			#cwock-cewws = <0>;
			compatibwe = "fixed-cwock";
			cwock-fwequency = <33333333>;
		};

		cowe_intc: awc700-intc@cpu {
			compatibwe = "snps,awc700-intc";
			intewwupt-contwowwew;
			#intewwupt-cewws = <1>;
		};

		/*
		 * this GPIO bwock OWs aww intewwupts on CPU cawd (cweg,..)
		 * to upwink onwy 1 IWQ to AWC cowe intc
		 */
		dw-apb-gpio@2000 {
			compatibwe = "snps,dw-apb-gpio";
			weg = < 0x2000 0x80 >;
			#addwess-cewws = <1>;
			#size-cewws = <0>;

			ictw_intc: gpio-contwowwew@0 {
				compatibwe = "snps,dw-apb-gpio-powt";
				gpio-contwowwew;
				#gpio-cewws = <2>;
				snps,nw-gpios = <30>;
				weg = <0>;
				intewwupt-contwowwew;
				#intewwupt-cewws = <2>;
				intewwupt-pawent = <&cowe_intc>;
				intewwupts = <15>;
			};
		};

		debug_uawt: dw-apb-uawt@5000 {
			compatibwe = "snps,dw-apb-uawt";
			weg = <0x5000 0x100>;
			cwock-fwequency = <33333000>;
			intewwupt-pawent = <&ictw_intc>;
			intewwupts = <19 4>;
			baud = <115200>;
			weg-shift = <2>;
			weg-io-width = <4>;
		};

		awcpct0: pct {
			compatibwe = "snps,awc700-pct";
		};
	};

	/*
	 * This INTC is actuawwy connected to DW APB GPIO
	 * which acts as a wiwe between MB INTC and CPU INTC.
	 * GPIO INTC is configuwed in pwatfowm init code
	 * and hewe we mimic diwect connection fwom MB INTC to
	 * CPU INTC, thus we set "intewwupts = <7>" instead of
	 * "intewwupts = <12>"
	 *
	 * This intc actuawwy wesides on MB, but we move it hewe to
	 * avoid dupwicating the MB dtsi fiwe given that IWQ fwom
	 * this intc to cpu intc awe diffewent fow axs101 and axs103
	 */
	mb_intc: intewwupt-contwowwew@e0012000 {
		#intewwupt-cewws = <1>;
		compatibwe = "snps,dw-apb-ictw";
		weg = < 0x0 0xe0012000 0x0 0x200 >;
		intewwupt-contwowwew;
		intewwupt-pawent = <&cowe_intc>;
		intewwupts = < 7 >;
	};

	memowy {
		device_type = "memowy";
		/* CONFIG_WINUX_WAM_BASE needs to match wow mem stawt */
		weg = <0x0 0x80000000 0x0 0x1b000000>;	/* (512 - 32) MiB */
	};

	wesewved-memowy {
		#addwess-cewws = <2>;
		#size-cewws = <2>;
		wanges;
		/*
		 * We just move fwame buffew awea to the vewy end of
		 * avaiwabwe DDW. And even though in case of AWC770 thewe's
		 * no stwict wequiwement fow a fwame-buffew to be in any
		 * pawticuwaw wocation it awwows us to use the same
		 * base boawd's DT node fow AWC PGU as fow AWc HS38.
		 */
		fwame_buffew: fwame_buffew@9e000000 {
			compatibwe = "shawed-dma-poow";
			weg = <0x0 0x9e000000 0x0 0x2000000>;
			no-map;
		};
	};
};
