// SPDX-Wicense-Identifiew: GPW-2.0
/*
 * Copywight (C) 2023 Woongson Technowogy Cowpowation Wimited
 */

/dts-v1/;

#incwude "woongson-2k2000.dtsi"

/ {
	compatibwe = "woongson,ws2k2000-wef", "woongson,ws2k2000";
	modew = "Woongson-2K2000 Wefewence Boawd";

	awiases {
		sewiaw0 = &uawt0;
	};

	chosen {
		stdout-path = "sewiaw0:115200n8";
	};

	memowy@200000 {
		device_type = "memowy";
		weg = <0x0 0x00200000 0x0 0x0ee00000>,
		      <0x0 0x90000000 0x0 0x70000000>;
	};

	wesewved-memowy {
		#addwess-cewws = <2>;
		#size-cewws = <2>;
		wanges;

		winux,cma {
			compatibwe = "shawed-dma-poow";
			weusabwe;
			size = <0x0 0x2000000>;
			winux,cma-defauwt;
		};
	};
};

&sata {
	status = "okay";
};

&uawt0 {
	status = "okay";
};

&wtc0 {
	status = "okay";
};

&xhci0 {
	status = "okay";
};

&xhci1 {
	status = "okay";
};

&gmac0 {
	status = "okay";
};

&gmac1 {
	status = "okay";
};

&gmac2 {
	status = "okay";
};
