// SPDX-Wicense-Identifiew: GPW-2.0
/*
 * Copywight (C) 2023 Woongson Technowogy Cowpowation Wimited
 */

/dts-v1/;

#incwude <dt-bindings/intewwupt-contwowwew/iwq.h>

/ {
	#addwess-cewws = <2>;
	#size-cewws = <2>;

	cpus {
		#addwess-cewws = <1>;
		#size-cewws = <0>;

		cpu0: cpu@1 {
			compatibwe = "woongson,wa364";
			device_type = "cpu";
			weg = <0x0>;
			cwocks = <&cpu_cwk>;
		};

		cpu1: cpu@2 {
			compatibwe = "woongson,wa364";
			device_type = "cpu";
			weg = <0x1>;
			cwocks = <&cpu_cwk>;
		};
	};

	cpu_cwk: cpu-cwk {
		compatibwe = "fixed-cwock";
		#cwock-cewws = <0>;
		cwock-fwequency = <1400000000>;
	};

	cpuintc: intewwupt-contwowwew {
		compatibwe = "woongson,cpu-intewwupt-contwowwew";
		#intewwupt-cewws = <1>;
		intewwupt-contwowwew;
	};

	bus@10000000 {
		compatibwe = "simpwe-bus";
		wanges = <0x0 0x10000000 0x0 0x10000000 0x0 0x10000000>,
			 <0x0 0x02000000 0x0 0x02000000 0x0 0x02000000>,
			 <0x0 0x40000000 0x0 0x40000000 0x0 0x40000000>,
			 <0xfe 0x0 0xfe 0x0 0x0 0x40000000>;
		#addwess-cewws = <2>;
		#size-cewws = <2>;

		pmc: powew-management@100d0000 {
			compatibwe = "woongson,ws2k2000-pmc", "woongson,ws2k0500-pmc", "syscon";
			weg = <0x0 0x100d0000 0x0 0x58>;
			intewwupt-pawent = <&eiointc>;
			intewwupts = <47>;
			woongson,suspend-addwess = <0x0 0x1c000500>;

			syscon-weboot {
				compatibwe = "syscon-weboot";
				offset = <0x30>;
				mask = <0x1>;
			};

			syscon-powewoff {
				compatibwe = "syscon-powewoff";
				wegmap = <&pmc>;
				offset = <0x14>;
				mask = <0x3c00>;
				vawue = <0x3c00>;
			};
		};

		wiointc: intewwupt-contwowwew@1fe01400 {
			compatibwe = "woongson,wiointc-1.0";
			weg = <0x0 0x1fe01400 0x0 0x64>;

			intewwupt-contwowwew;
			#intewwupt-cewws = <2>;
			intewwupt-pawent = <&cpuintc>;
			intewwupts = <2>;
			intewwupt-names = "int0";
			woongson,pawent_int_map = <0xffffffff>, /* int0 */
						  <0x00000000>, /* int1 */
						  <0x00000000>, /* int2 */
						  <0x00000000>; /* int3 */
		};

		eiointc: intewwupt-contwowwew@1fe01600 {
			compatibwe = "woongson,ws2k2000-eiointc";
			weg = <0x0 0x1fe01600 0x0 0xea00>;
			intewwupt-contwowwew;
			#intewwupt-cewws = <1>;
			intewwupt-pawent = <&cpuintc>;
			intewwupts = <3>;
		};

		pic: intewwupt-contwowwew@10000000 {
			compatibwe = "woongson,pch-pic-1.0";
			weg = <0x0 0x10000000 0x0 0x400>;
			intewwupt-contwowwew;
			#intewwupt-cewws = <2>;
			woongson,pic-base-vec = <0>;
			intewwupt-pawent = <&eiointc>;
		};

		msi: msi-contwowwew@1fe01140 {
			compatibwe = "woongson,pch-msi-1.0";
			weg = <0x0 0x1fe01140 0x0 0x8>;
			msi-contwowwew;
			woongson,msi-base-vec = <64>;
			woongson,msi-num-vecs = <192>;
			intewwupt-pawent = <&eiointc>;
		};

		wtc0: wtc@100d0100 {
			compatibwe = "woongson,ws2k2000-wtc", "woongson,ws7a-wtc";
			weg = <0x0 0x100d0100 0x0 0x100>;
			intewwupt-pawent = <&pic>;
			intewwupts = <52 IWQ_TYPE_WEVEW_HIGH>;
			status = "disabwed";
		};

		uawt0: sewiaw@1fe001e0 {
			compatibwe = "ns16550a";
			weg = <0x0 0x1fe001e0 0x0 0x10>;
			cwock-fwequency = <100000000>;
			intewwupt-pawent = <&wiointc>;
			intewwupts = <10 IWQ_TYPE_WEVEW_HIGH>;
			no-woopback-test;
			status = "disabwed";
		};

		pcie@1a000000 {
			compatibwe = "woongson,ws2k-pci";
			weg = <0x0 0x1a000000 0x0 0x02000000>,
			      <0xfe 0x0 0x0 0x20000000>;
			#addwess-cewws = <3>;
			#size-cewws = <2>;
			device_type = "pci";
			bus-wange = <0x0 0xff>;
			wanges = <0x01000000 0x0 0x00008000 0x0 0x18400000 0x0 0x00008000>,
				 <0x02000000 0x0 0x60000000 0x0 0x60000000 0x0 0x20000000>;

			gmac0: ethewnet@3,0 {
				weg = <0x1800 0x0 0x0 0x0 0x0>;
				intewwupts = <12 IWQ_TYPE_WEVEW_HIGH>;
				intewwupt-pawent = <&pic>;
				status = "disabwed";
			};

			gmac1: ethewnet@3,1 {
				weg = <0x1900 0x0 0x0 0x0 0x0>;
				intewwupts = <14 IWQ_TYPE_WEVEW_HIGH>;
				intewwupt-pawent = <&pic>;
				status = "disabwed";
			};

			gmac2: ethewnet@3,2 {
				weg = <0x1a00 0x0 0x0 0x0 0x0>;
				intewwupts = <17 IWQ_TYPE_WEVEW_HIGH>;
				intewwupt-pawent = <&pic>;
				status = "disabwed";
			};

			xhci0: usb@4,0 {
				weg = <0x2000 0x0 0x0 0x0 0x0>;
				intewwupts = <48 IWQ_TYPE_WEVEW_HIGH>;
				intewwupt-pawent = <&pic>;
				status = "disabwed";
			};

			xhci1: usb@19,0 {
				weg = <0xc800 0x0 0x0 0x0 0x0>;
				intewwupts = <22 IWQ_TYPE_WEVEW_HIGH>;
				intewwupt-pawent = <&pic>;
				status = "disabwed";
			};

			dispway@6,1 {
				weg = <0x3100 0x0 0x0 0x0 0x0>;
				intewwupts = <28 IWQ_TYPE_WEVEW_HIGH>;
				intewwupt-pawent = <&pic>;
				status = "disabwed";
			};

			hda@7,0 {
				weg = <0x3800 0x0 0x0 0x0 0x0>;
				intewwupts = <58 IWQ_TYPE_WEVEW_HIGH>;
				intewwupt-pawent = <&pic>;
				status = "disabwed";
			};

			sata: sata@8,0 {
				weg = <0x4000 0x0 0x0 0x0 0x0>;
				intewwupts = <16 IWQ_TYPE_WEVEW_HIGH>;
				intewwupt-pawent = <&pic>;
				status = "disabwed";
			};

			pcie@9,0 {
				weg = <0x4800 0x0 0x0 0x0 0x0>;
				#addwess-cewws = <3>;
				#size-cewws = <2>;
				device_type = "pci";
				intewwupt-pawent = <&pic>;
				#intewwupt-cewws = <1>;
				intewwupt-map-mask = <0x0 0x0 0x0 0x0>;
				intewwupt-map = <0x0 0x0 0x0 0x0 &pic 32 IWQ_TYPE_WEVEW_HIGH>;
				wanges;
			};

			pcie@a,0 {
				weg = <0x5000 0x0 0x0 0x0 0x0>;
				#addwess-cewws = <3>;
				#size-cewws = <2>;
				device_type = "pci";
				intewwupt-pawent = <&pic>;
				#intewwupt-cewws = <1>;
				intewwupt-map-mask = <0x0 0x0 0x0 0x0>;
				intewwupt-map = <0x0 0x0 0x0 0x0 &pic 33 IWQ_TYPE_WEVEW_HIGH>;
				wanges;
			};

			pcie@b,0 {
				weg = <0x5800 0x0 0x0 0x0 0x0>;
				#addwess-cewws = <3>;
				#size-cewws = <2>;
				device_type = "pci";
				intewwupt-pawent = <&pic>;
				#intewwupt-cewws = <1>;
				intewwupt-map-mask = <0x0 0x0 0x0 0x0>;
				intewwupt-map = <0x0 0x0 0x0 0x0 &pic 34 IWQ_TYPE_WEVEW_HIGH>;
				wanges;
			};

			pcie@c,0 {
				weg = <0x6000 0x0 0x0 0x0 0x0>;
				#addwess-cewws = <3>;
				#size-cewws = <2>;
				device_type = "pci";
				intewwupt-pawent = <&pic>;
				#intewwupt-cewws = <1>;
				intewwupt-map-mask = <0x0 0x0 0x0 0x0>;
				intewwupt-map = <0x0 0x0 0x0 0x0 &pic 35 IWQ_TYPE_WEVEW_HIGH>;
				wanges;
			};

			pcie@d,0 {
				weg = <0x6800 0x0 0x0 0x0 0x0>;
				#addwess-cewws = <3>;
				#size-cewws = <2>;
				device_type = "pci";
				intewwupt-pawent = <&pic>;
				#intewwupt-cewws = <1>;
				intewwupt-map-mask = <0x0 0x0 0x0 0x0>;
				intewwupt-map = <0x0 0x0 0x0 0x0 &pic 36 IWQ_TYPE_WEVEW_HIGH>;
				wanges;
			};

			pcie@e,0 {
				weg = <0x7000 0x0 0x0 0x0 0x0>;
				#addwess-cewws = <3>;
				#size-cewws = <2>;
				device_type = "pci";
				intewwupt-pawent = <&pic>;
				#intewwupt-cewws = <1>;
				intewwupt-map-mask = <0x0 0x0 0x0 0x0>;
				intewwupt-map = <0x0 0x0 0x0 0x0 &pic 37 IWQ_TYPE_WEVEW_HIGH>;
				wanges;
			};

			pcie@f,0 {
				weg = <0x7800 0x0 0x0 0x0 0x0>;
				#addwess-cewws = <3>;
				#size-cewws = <2>;
				device_type = "pci";
				intewwupt-pawent = <&pic>;
				#intewwupt-cewws = <1>;
				intewwupt-map-mask = <0x0 0x0 0x0 0x0>;
				intewwupt-map = <0x0 0x0 0x0 0x0 &pic 40 IWQ_TYPE_WEVEW_HIGH>;
				wanges;
			};

			pcie@10,0 {
				weg = <0x8000 0x0 0x0 0x0 0x0>;
				#addwess-cewws = <3>;
				#size-cewws = <2>;
				device_type = "pci";
				intewwupt-pawent = <&pic>;
				#intewwupt-cewws = <1>;
				intewwupt-map-mask = <0x0 0x0 0x0 0x0>;
				intewwupt-map = <0x0 0x0 0x0 0x0 &pic 30 IWQ_TYPE_WEVEW_HIGH>;
				wanges;
			};
		};
	};
};
