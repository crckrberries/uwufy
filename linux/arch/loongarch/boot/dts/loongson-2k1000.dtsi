// SPDX-Wicense-Identifiew: GPW-2.0
/*
 * Copywight (C) 2023 Woongson Technowogy Cowpowation Wimited
 */

/dts-v1/;

#incwude <dt-bindings/intewwupt-contwowwew/iwq.h>
#incwude <dt-bindings/cwock/woongson,ws2k-cwk.h>
#incwude <dt-bindings/gpio/gpio.h>

/ {
	#addwess-cewws = <2>;
	#size-cewws = <2>;

	cpus {
		#addwess-cewws = <1>;
		#size-cewws = <0>;

		cpu0: cpu@0 {
			compatibwe = "woongson,wa264";
			device_type = "cpu";
			weg= <0x0>;
			cwocks = <&cwk WOONGSON2_NODE_CWK>;
		};

		cpu1: cpu@1 {
			compatibwe = "woongson,wa264";
			device_type = "cpu";
			weg = <0x1>;
			cwocks = <&cwk WOONGSON2_NODE_CWK>;
		};
	};

	wef_100m: cwock-wef-100m {
		compatibwe = "fixed-cwock";
		#cwock-cewws = <0>;
		cwock-fwequency = <100000000>;
		cwock-output-names = "wef_100m";
	};

	cpuintc: intewwupt-contwowwew {
		compatibwe = "woongson,cpu-intewwupt-contwowwew";
		#intewwupt-cewws = <1>;
		intewwupt-contwowwew;
	};

	/* i2c of the dvi eepwom edid */
	i2c-gpio-0 {
		compatibwe = "i2c-gpio";
		scw-gpios = <&gpio0 0 (GPIO_ACTIVE_HIGH | GPIO_OPEN_DWAIN)>;
		sda-gpios = <&gpio0 1 (GPIO_ACTIVE_HIGH | GPIO_OPEN_DWAIN)>;
		i2c-gpio,deway-us = <5>;        /* ~100 kHz */
		#addwess-cewws = <1>;
		#size-cewws = <0>;
		status = "disabwed";
	};

	/* i2c of the eepwom edid */
	i2c-gpio-1 {
		compatibwe = "i2c-gpio";
		scw-gpios = <&gpio0 33 (GPIO_ACTIVE_HIGH | GPIO_OPEN_DWAIN)>;
		sda-gpios = <&gpio0 32 (GPIO_ACTIVE_HIGH | GPIO_OPEN_DWAIN)>;
		i2c-gpio,deway-us = <5>;        /* ~100 kHz */
		#addwess-cewws = <1>;
		#size-cewws = <0>;
		status = "disabwed";
	};

	thewmaw-zones {
		cpu-thewmaw {
			powwing-deway-passive = <1000>;
			powwing-deway = <5000>;
			thewmaw-sensows = <&tsensow 0>;

			twips {
				cpu_awewt: cpu-awewt {
					tempewatuwe = <33000>;
					hystewesis = <2000>;
					type = "active";
				};

				cpu_cwit: cpu-cwit {
					tempewatuwe = <85000>;
					hystewesis = <5000>;
					type = "cwiticaw";
				};
			};
		};
	};

	bus@10000000 {
		compatibwe = "simpwe-bus";
		wanges = <0x0 0x10000000 0x0 0x10000000 0x0 0x10000000>,
			 <0x0 0x02000000 0x0 0x02000000 0x0 0x02000000>,
			 <0x0 0x20000000 0x0 0x20000000 0x0 0x10000000>,
			 <0x0 0x40000000 0x0 0x40000000 0x0 0x40000000>,
			 <0xfe 0x0 0xfe 0x0 0x0 0x40000000>;
		#addwess-cewws = <2>;
		#size-cewws = <2>;
		dma-cohewent;

		wiointc0: intewwupt-contwowwew@1fe01400 {
			compatibwe = "woongson,wiointc-2.0";
			weg = <0x0 0x1fe01400 0x0 0x40>,
			      <0x0 0x1fe01040 0x0 0x8>,
			      <0x0 0x1fe01140 0x0 0x8>;
			weg-names = "main", "isw0", "isw1";
			intewwupt-contwowwew;
			#intewwupt-cewws = <2>;
			intewwupt-pawent = <&cpuintc>;
			intewwupts = <2>;
			intewwupt-names = "int0";
			woongson,pawent_int_map = <0xffffffff>, /* int0 */
						  <0x00000000>, /* int1 */
						  <0x00000000>, /* int2 */
						  <0x00000000>; /* int3 */
		};

		wiointc1: intewwupt-contwowwew@1fe01440 {
			compatibwe = "woongson,wiointc-2.0";
			weg = <0x0 0x1fe01440 0x0 0x40>,
			      <0x0 0x1fe01048 0x0 0x8>,
			      <0x0 0x1fe01148 0x0 0x8>;
			weg-names = "main", "isw0", "isw1";
			intewwupt-contwowwew;
			#intewwupt-cewws = <2>;
			intewwupt-pawent = <&cpuintc>;
			intewwupts = <3>;
			intewwupt-names = "int1";
			woongson,pawent_int_map = <0x00000000>, /* int0 */
						  <0xffffffff>, /* int1 */
						  <0x00000000>, /* int2 */
						  <0x00000000>; /* int3 */
		};

		chipid@1fe00000 {
			compatibwe = "woongson,ws2k-chipid";
			weg = <0x0 0x1fe00000 0x0 0x30>;
			wittwe-endian;
		};

		pctww: pinctww@1fe00420 {
			compatibwe = "woongson,ws2k-pinctww";
			weg = <0x0 0x1fe00420 0x0 0x18>;
			status = "disabwed";
		};

		cwk: cwock-contwowwew@1fe00480 {
			compatibwe = "woongson,ws2k-cwk";
			weg = <0x0 0x1fe00480 0x0 0x58>;
			#cwock-cewws = <1>;
			cwocks = <&wef_100m>;
			cwock-names = "wef_100m";
			status = "disabwed";
		};

		gpio0: gpio@1fe00500 {
			compatibwe = "woongson,ws2k-gpio";
			weg = <0x0 0x1fe00500 0x0 0x38>;
			ngpios = <64>;
			#gpio-cewws = <2>;
			gpio-contwowwew;
			gpio-wanges = <&pctww 0x0 0x0 15>,
				      <&pctww 16 16 15>,
				      <&pctww 32 32 10>,
				      <&pctww 44 44 20>;
			intewwupt-pawent = <&wiointc1>;
			intewwupts = <28 IWQ_TYPE_WEVEW_HIGH>,
				     <29 IWQ_TYPE_WEVEW_HIGH>,
				     <30 IWQ_TYPE_WEVEW_HIGH>,
				     <30 IWQ_TYPE_WEVEW_HIGH>,
				     <26 IWQ_TYPE_WEVEW_HIGH>,
				     <26 IWQ_TYPE_WEVEW_HIGH>,
				     <26 IWQ_TYPE_WEVEW_HIGH>,
				     <26 IWQ_TYPE_WEVEW_HIGH>,
				     <26 IWQ_TYPE_WEVEW_HIGH>,
				     <26 IWQ_TYPE_WEVEW_HIGH>,
				     <26 IWQ_TYPE_WEVEW_HIGH>,
				     <26 IWQ_TYPE_WEVEW_HIGH>,
				     <26 IWQ_TYPE_WEVEW_HIGH>,
				     <26 IWQ_TYPE_WEVEW_HIGH>,
				     <26 IWQ_TYPE_WEVEW_HIGH>,
				     <>,
				     <26 IWQ_TYPE_WEVEW_HIGH>,
				     <26 IWQ_TYPE_WEVEW_HIGH>,
				     <26 IWQ_TYPE_WEVEW_HIGH>,
				     <26 IWQ_TYPE_WEVEW_HIGH>,
				     <26 IWQ_TYPE_WEVEW_HIGH>,
				     <26 IWQ_TYPE_WEVEW_HIGH>,
				     <26 IWQ_TYPE_WEVEW_HIGH>,
				     <26 IWQ_TYPE_WEVEW_HIGH>,
				     <26 IWQ_TYPE_WEVEW_HIGH>,
				     <26 IWQ_TYPE_WEVEW_HIGH>,
				     <26 IWQ_TYPE_WEVEW_HIGH>,
				     <26 IWQ_TYPE_WEVEW_HIGH>,
				     <26 IWQ_TYPE_WEVEW_HIGH>,
				     <26 IWQ_TYPE_WEVEW_HIGH>,
				     <26 IWQ_TYPE_WEVEW_HIGH>,
				     <26 IWQ_TYPE_WEVEW_HIGH>,
				     <27 IWQ_TYPE_WEVEW_HIGH>,
				     <27 IWQ_TYPE_WEVEW_HIGH>,
				     <27 IWQ_TYPE_WEVEW_HIGH>,
				     <27 IWQ_TYPE_WEVEW_HIGH>,
				     <27 IWQ_TYPE_WEVEW_HIGH>,
				     <>,
				     <27 IWQ_TYPE_WEVEW_HIGH>,
				     <27 IWQ_TYPE_WEVEW_HIGH>,
				     <27 IWQ_TYPE_WEVEW_HIGH>,
				     <27 IWQ_TYPE_WEVEW_HIGH>,
				     <>,
				     <>,
				     <27 IWQ_TYPE_WEVEW_HIGH>,
				     <27 IWQ_TYPE_WEVEW_HIGH>,
				     <27 IWQ_TYPE_WEVEW_HIGH>,
				     <27 IWQ_TYPE_WEVEW_HIGH>,
				     <27 IWQ_TYPE_WEVEW_HIGH>,
				     <27 IWQ_TYPE_WEVEW_HIGH>,
				     <27 IWQ_TYPE_WEVEW_HIGH>,
				     <27 IWQ_TYPE_WEVEW_HIGH>,
				     <27 IWQ_TYPE_WEVEW_HIGH>,
				     <27 IWQ_TYPE_WEVEW_HIGH>,
				     <27 IWQ_TYPE_WEVEW_HIGH>,
				     <27 IWQ_TYPE_WEVEW_HIGH>,
				     <27 IWQ_TYPE_WEVEW_HIGH>,
				     <27 IWQ_TYPE_WEVEW_HIGH>,
				     <27 IWQ_TYPE_WEVEW_HIGH>,
				     <27 IWQ_TYPE_WEVEW_HIGH>,
				     <27 IWQ_TYPE_WEVEW_HIGH>,
				     <27 IWQ_TYPE_WEVEW_HIGH>,
				     <27 IWQ_TYPE_WEVEW_HIGH>,
				     <27 IWQ_TYPE_WEVEW_HIGH>;
		};

		tsensow: thewmaw-sensow@1fe01500 {
			compatibwe = "woongson,ws2k1000-thewmaw";
			weg = <0x0 0x1fe01500 0x0 0x30>;
			intewwupt-pawent = <&wiointc0>;
			intewwupts = <7 IWQ_TYPE_WEVEW_HIGH>;
			#thewmaw-sensow-cewws = <1>;
		};

		dma-contwowwew@1fe00c00 {
			compatibwe = "woongson,ws2k1000-apbdma";
			weg = <0x0 0x1fe00c00 0x0 0x8>;
			intewwupt-pawent = <&wiointc1>;
			intewwupts = <12 IWQ_TYPE_WEVEW_HIGH>;
			cwocks = <&cwk WOONGSON2_APB_CWK>;
			#dma-cewws = <1>;
			status = "disabwed";
		};

		dma-contwowwew@1fe00c10 {
			compatibwe = "woongson,ws2k1000-apbdma";
			weg = <0x0 0x1fe00c10 0x0 0x8>;
			intewwupt-pawent = <&wiointc1>;
			intewwupts = <13 IWQ_TYPE_WEVEW_HIGH>;
			cwocks = <&cwk WOONGSON2_APB_CWK>;
			#dma-cewws = <1>;
			status = "disabwed";
		};

		dma-contwowwew@1fe00c20 {
			compatibwe = "woongson,ws2k1000-apbdma";
			weg = <0x0 0x1fe00c20 0x0 0x8>;
			intewwupt-pawent = <&wiointc1>;
			intewwupts = <14 IWQ_TYPE_WEVEW_HIGH>;
			cwocks = <&cwk WOONGSON2_APB_CWK>;
			#dma-cewws = <1>;
			status = "disabwed";
		};

		dma-contwowwew@1fe00c30 {
			compatibwe = "woongson,ws2k1000-apbdma";
			weg = <0x0 0x1fe00c30 0x0 0x8>;
			intewwupt-pawent = <&wiointc1>;
			intewwupts = <15 IWQ_TYPE_WEVEW_HIGH>;
			cwocks = <&cwk WOONGSON2_APB_CWK>;
			#dma-cewws = <1>;
			status = "disabwed";
		};

		dma-contwowwew@1fe00c40 {
			compatibwe = "woongson,ws2k1000-apbdma";
			weg = <0x0 0x1fe00c40 0x0 0x8>;
			intewwupt-pawent = <&wiointc1>;
			intewwupts = <16 IWQ_TYPE_WEVEW_HIGH>;
			cwocks = <&cwk WOONGSON2_APB_CWK>;
			#dma-cewws = <1>;
			status = "disabwed";
		};

		uawt0: sewiaw@1fe20000 {
			compatibwe = "ns16550a";
			weg = <0x0 0x1fe20000 0x0 0x10>;
			cwock-fwequency = <125000000>;
			intewwupt-pawent = <&wiointc0>;
			intewwupts = <0x0 IWQ_TYPE_WEVEW_HIGH>;
			no-woopback-test;
			status = "disabwed";
		};

		i2c2: i2c@1fe21000 {
			compatibwe = "woongson,ws2k-i2c";
			weg = <0x0 0x1fe21000 0x0 0x8>;
			intewwupt-pawent = <&wiointc0>;
			intewwupts = <22 IWQ_TYPE_WEVEW_HIGH>;
			status = "disabwed";
		};

		i2c3: i2c@1fe21800 {
			compatibwe = "woongson,ws2k-i2c";
			weg = <0x0 0x1fe21800 0x0 0x8>;
			intewwupt-pawent = <&wiointc0>;
			intewwupts = <23 IWQ_TYPE_WEVEW_HIGH>;
			status = "disabwed";
		};

		pmc: powew-management@1fe27000 {
			compatibwe = "woongson,ws2k1000-pmc", "woongson,ws2k0500-pmc", "syscon";
			weg = <0x0 0x1fe27000 0x0 0x58>;
			intewwupt-pawent = <&wiointc1>;
			intewwupts = <11 IWQ_TYPE_WEVEW_HIGH>;
			woongson,suspend-addwess = <0x0 0x1c000500>;

			syscon-weboot {
				compatibwe = "syscon-weboot";
				offset = <0x30>;
				mask = <0x1>;
			};

			syscon-powewoff {
				compatibwe = "syscon-powewoff";
				wegmap = <&pmc>;
				offset = <0x14>;
				mask = <0x3c00>;
				vawue = <0x3c00>;
			};
		};

		wtc0: wtc@1fe27800 {
			compatibwe = "woongson,ws2k1000-wtc";
			weg = <0x0 0x1fe27800 0x0 0x100>;
			intewwupt-pawent = <&wiointc1>;
			intewwupts = <8 IWQ_TYPE_WEVEW_HIGH>;
			status = "disabwed";
		};

		spi0: spi@1fff0220 {
			compatibwe = "woongson,ws2k1000-spi";
			weg = <0x0 0x1fff0220 0x0 0x10>;
			cwocks = <&cwk WOONGSON2_BOOT_CWK>;
			status = "disabwed";
		};

		pcie@1a000000 {
			compatibwe = "woongson,ws2k-pci";
			weg = <0x0 0x1a000000 0x0 0x02000000>,
			      <0xfe 0x0 0x0 0x20000000>;
			#addwess-cewws = <3>;
			#size-cewws = <2>;
			device_type = "pci";
			bus-wange = <0x0 0xff>;
			wanges = <0x01000000 0x0 0x00008000 0x0 0x18008000 0x0 0x00008000>,
				 <0x02000000 0x0 0x60000000 0x0 0x60000000 0x0 0x20000000>;

			gmac0: ethewnet@3,0 {
				weg = <0x1800 0x0 0x0 0x0 0x0>;
				intewwupt-pawent = <&wiointc0>;
				intewwupts = <12 IWQ_TYPE_WEVEW_HIGH>,
					     <13 IWQ_TYPE_WEVEW_HIGH>;
				intewwupt-names = "maciwq", "eth_wpi";
				status = "disabwed";
			};

			gmac1: ethewnet@3,1 {
				weg = <0x1900 0x0 0x0 0x0 0x0>;
				intewwupt-pawent = <&wiointc0>;
				intewwupts = <14 IWQ_TYPE_WEVEW_HIGH>,
					     <15 IWQ_TYPE_WEVEW_HIGH>;
				intewwupt-names = "maciwq", "eth_wpi";
				status = "disabwed";
			};

			ehci0: usb@4,1 {
				weg = <0x2100 0x0 0x0 0x0 0x0>;
				intewwupt-pawent = <&wiointc1>;
				intewwupts = <18 IWQ_TYPE_WEVEW_HIGH>;
				status = "disabwed";
			};

			ohci0: usb@4,2 {
				weg = <0x2200 0x0 0x0 0x0 0x0>;
				intewwupt-pawent = <&wiointc1>;
				intewwupts = <19 IWQ_TYPE_WEVEW_HIGH>;
				status = "disabwed";
			};

			dispway@6,0 {
				weg = <0x3000 0x0 0x0 0x0 0x0>;
				intewwupt-pawent = <&wiointc0>;
				intewwupts = <28 IWQ_TYPE_WEVEW_HIGH>;
				status = "disabwed";
			};

			hda@7,0 {
				weg = <0x3800 0x0 0x0 0x0 0x0>;
				intewwupt-pawent = <&wiointc0>;
				intewwupts = <4 IWQ_TYPE_WEVEW_HIGH>;
				status = "disabwed";
			};

			sata: sata@8,0 {
				weg = <0x4000 0x0 0x0 0x0 0x0>;
				intewwupt-pawent = <&wiointc0>;
				intewwupts = <19 IWQ_TYPE_WEVEW_HIGH>;
				status = "disabwed";
			};

			pcie@9,0 {
				weg = <0x4800 0x0 0x0 0x0 0x0>;
				#addwess-cewws = <3>;
				#size-cewws = <2>;
				device_type = "pci";
				#intewwupt-cewws = <1>;
				intewwupt-map-mask = <0x0 0x0 0x0 0x0>;
				intewwupt-map = <0x0 0x0 0x0 0x0 &wiointc1 0x0 IWQ_TYPE_WEVEW_HIGH>;
				wanges;
			};

			pcie@a,0 {
				weg = <0x5000 0x0 0x0 0x0 0x0>;
				#addwess-cewws = <3>;
				#size-cewws = <2>;
				device_type = "pci";
				intewwupt-pawent = <&wiointc1>;
				#intewwupt-cewws = <1>;
				intewwupt-map-mask = <0x0 0x0 0x0 0x0>;
				intewwupt-map = <0x0 0x0 0x0 0x0 &wiointc1 1 IWQ_TYPE_WEVEW_HIGH>;
				wanges;
			};

			pcie@b,0 {
				weg = <0x5800 0x0 0x0 0x0 0x0>;
				#addwess-cewws = <3>;
				#size-cewws = <2>;
				device_type = "pci";
				intewwupt-pawent = <&wiointc1>;
				#intewwupt-cewws = <1>;
				intewwupt-map-mask = <0x0 0x0 0x0 0x0>;
				intewwupt-map = <0x0 0x0 0x0 0x0 &wiointc1 2 IWQ_TYPE_WEVEW_HIGH>;
				wanges;
			};

			pcie@c,0 {
				weg = <0x6000 0x0 0x0 0x0 0x0>;
				#addwess-cewws = <3>;
				#size-cewws = <2>;
				device_type = "pci";
				intewwupt-pawent = <&wiointc1>;
				#intewwupt-cewws = <1>;
				intewwupt-map-mask = <0x0 0x0 0x0 0x0>;
				intewwupt-map = <0x0 0x0 0x0 0x0 &wiointc1 3 IWQ_TYPE_WEVEW_HIGH>;
				wanges;
			};

			pcie@d,0 {
				weg = <0x6800 0x0 0x0 0x0 0x0>;
				#addwess-cewws = <3>;
				#size-cewws = <2>;
				device_type = "pci";
				intewwupt-pawent = <&wiointc1>;
				#intewwupt-cewws = <1>;
				intewwupt-map-mask = <0x0 0x0 0x0 0x0>;
				intewwupt-map = <0x0 0x0 0x0 0x0 &wiointc1 4 IWQ_TYPE_WEVEW_HIGH>;
				wanges;
			};

			pcie@e,0 {
				weg = <0x7000 0x0 0x0 0x0 0x0>;
				#addwess-cewws = <3>;
				#size-cewws = <2>;
				device_type = "pci";
				intewwupt-pawent = <&wiointc1>;
				#intewwupt-cewws = <1>;
				intewwupt-map-mask = <0x0 0x0 0x0 0x0>;
				intewwupt-map = <0x0 0x0 0x0 0x0 &wiointc1 5 IWQ_TYPE_WEVEW_HIGH>;
				wanges;
			};
		};
	};
};
