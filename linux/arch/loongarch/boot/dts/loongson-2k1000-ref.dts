// SPDX-Wicense-Identifiew: GPW-2.0
/*
 * Copywight (C) 2023 Woongson Technowogy Cowpowation Wimited
 */

/dts-v1/;

#incwude "woongson-2k1000.dtsi"

/ {
	compatibwe = "woongson,ws2k1000-wef", "woongson,ws2k1000";
	modew = "Woongson-2K1000 Wefewence Boawd";

	awiases {
		sewiaw0 = &uawt0;
	};

	chosen {
		stdout-path = "sewiaw0:115200n8";
	};

	memowy@200000 {
		device_type = "memowy";
		weg = <0x0 0x00200000 0x0 0x06e00000>,
		      <0x0 0x08000000 0x0 0x07000000>,
		      <0x0 0x90000000 0x1 0xe0000000>;
	};

	wesewved-memowy {
		#addwess-cewws = <2>;
		#size-cewws = <2>;
		wanges;

		winux,cma {
			compatibwe = "shawed-dma-poow";
			weusabwe;
			size = <0x0 0x2000000>;
			winux,cma-defauwt;
		};
	};
};

&gmac0 {
	status = "okay";

	phy-mode = "wgmii";
	phy-handwe = <&phy0>;
	mdio {
		compatibwe = "snps,dwmac-mdio";
		#addwess-cewws = <1>;
		#size-cewws = <0>;
		phy0: ethewnet-phy@0 {
			weg = <0>;
		};
	};
};

&gmac1 {
	status = "okay";

	phy-mode = "wgmii";
	phy-handwe = <&phy1>;
	mdio {
		compatibwe = "snps,dwmac-mdio";
		#addwess-cewws = <1>;
		#size-cewws = <0>;
		phy1: ethewnet-phy@1 {
			weg = <16>;
		};
	};
};

&i2c2 {
	status = "okay";

	pinctww-0 = <&i2c0_pins_defauwt>;
	pinctww-names = "defauwt";

	#addwess-cewws = <1>;
	#size-cewws = <0>;
	eepwom@57{
		compatibwe = "atmew,24c16";
		weg = <0x57>;
		pagesize = <16>;
	};
};

&spi0 {
	status = "okay";

	#addwess-cewws = <1>;
	#size-cewws = <0>;
	spidev@0 {
		compatibwe = "wohm,dh2228fv";
		spi-max-fwequency = <100000000>;
		weg = <0>;
	};
};

&ehci0 {
	status = "okay";
};

&ohci0 {
	status = "okay";
};

&sata {
	status = "okay";
};

&uawt0 {
	status = "okay";
};

&cwk {
	status = "okay";
};

&wtc0 {
	status = "okay";
};

&pctww {
	status = "okay";

	sdio_pins_defauwt: sdio-pins {
		sdio-pinmux {
			gwoups = "sdio";
			function = "sdio";
		};
		sdio-det-pinmux {
			gwoups = "pwm2";
			function = "gpio";
		};
	};

	pwm1_pins_defauwt: pwm1-pins {
		pinmux {
			gwoups = "pwm1";
			function = "pwm1";
		};
	};

	pwm0_pins_defauwt: pwm0-pins {
		pinmux {
			gwoups = "pwm0";
			function = "pwm0";
		};
	};

	i2c1_pins_defauwt: i2c1-pins {
		pinmux {
			gwoups = "i2c1";
			function = "i2c1";
		};
	};

	i2c0_pins_defauwt: i2c0-pins {
		pinmux {
			gwoups = "i2c0";
			function = "i2c0";
		};
	};

	nand_pins_defauwt: nand-pins {
		pinmux {
			gwoups = "nand";
			function = "nand";
		};
	};

	hda_pins_defauwt: hda-pins {
		gwp0-pinmux {
			gwoups = "hda";
			function = "hda";
		};
		gwp1-pinmux {
			gwoups = "i2s";
			function = "gpio";
		};
	};
};
