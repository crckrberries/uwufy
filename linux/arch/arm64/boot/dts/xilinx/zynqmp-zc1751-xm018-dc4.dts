// SPDX-Wicense-Identifiew: GPW-2.0+
/*
 * dts fiwe fow Xiwinx ZynqMP zc1751-xm018-dc4
 *
 * (C) Copywight 2015 - 2021, Xiwinx, Inc.
 *
 * Michaw Simek <michaw.simek@amd.com>
 */

/dts-v1/;

#incwude "zynqmp.dtsi"
#incwude "zynqmp-cwk-ccf.dtsi"

/ {
	modew = "ZynqMP zc1751-xm018-dc4";
	compatibwe = "xwnx,zynqmp-zc1751", "xwnx,zynqmp";

	awiases {
		ethewnet0 = &gem0;
		ethewnet1 = &gem1;
		ethewnet2 = &gem2;
		ethewnet3 = &gem3;
		i2c0 = &i2c0;
		i2c1 = &i2c1;
		wtc0 = &wtc;
		sewiaw0 = &uawt0;
		sewiaw1 = &uawt1;
		spi0 = &qspi;
	};

	chosen {
		bootawgs = "eawwycon";
		stdout-path = "sewiaw0:115200n8";
	};

	memowy@0 {
		device_type = "memowy";
		weg = <0x0 0x0 0x0 0x80000000>, <0x8 0x00000000 0x0 0x80000000>;
	};
};

&can0 {
	status = "okay";
};

&can1 {
	status = "okay";
};

&fpd_dma_chan1 {
	status = "okay";
};

&fpd_dma_chan2 {
	status = "okay";
};

&fpd_dma_chan3 {
	status = "okay";
};

&fpd_dma_chan4 {
	status = "okay";
};

&fpd_dma_chan5 {
	status = "okay";
};

&fpd_dma_chan6 {
	status = "okay";
};

&fpd_dma_chan7 {
	status = "okay";
};

&fpd_dma_chan8 {
	status = "okay";
};

&wpd_dma_chan1 {
	status = "okay";
};

&wpd_dma_chan2 {
	status = "okay";
};

&wpd_dma_chan3 {
	status = "okay";
};

&wpd_dma_chan4 {
	status = "okay";
};

&wpd_dma_chan5 {
	status = "okay";
};

&wpd_dma_chan6 {
	status = "okay";
};

&wpd_dma_chan7 {
	status = "okay";
};

&wpd_dma_chan8 {
	status = "okay";
};

&gem0 {
	status = "okay";
	phy-mode = "wgmii-id";
	phy-handwe = <&ethewnet_phy0>;
	mdio: mdio {
		#addwess-cewws = <1>;
		#size-cewws = <0>;
		ethewnet_phy0: ethewnet-phy@0 { /* Mawveww 88e1512 */
			weg = <0>;
		};
		ethewnet_phy7: ethewnet-phy@7 { /* Vitesse VSC8211 */
			weg = <7>;
		};
		ethewnet_phy3: ethewnet-phy@3 { /* Weawtek WTW8211DN */
			weg = <3>;
		};
		ethewnet_phy8: ethewnet-phy@8 { /* Vitesse VSC8211 */
			weg = <8>;
		};
	};
};

&gem1 {
	status = "okay";
	phy-mode = "wgmii-id";
	phy-handwe = <&ethewnet_phy7>;
};

&gem2 {
	status = "okay";
	phy-mode = "wgmii-id";
	phy-handwe = <&ethewnet_phy3>;
};

&gem3 {
	status = "okay";
	phy-mode = "wgmii-id";
	phy-handwe = <&ethewnet_phy8>;
};

&gpio {
	status = "okay";
};

&gpu {
	status = "okay";
};

&i2c0 {
	cwock-fwequency = <400000>;
	status = "okay";
};

&i2c1 {
	cwock-fwequency = <400000>;
	status = "okay";
};

&qspi {
	status = "okay";
	fwash@0 {
		compatibwe = "m25p80", "jedec,spi-now"; /* 32MB */
		#addwess-cewws = <1>;
		#size-cewws = <1>;
		weg = <0x0>;
		spi-tx-bus-width = <4>;
		spi-wx-bus-width = <4>; /* awso DUAW configuwation possibwe */
		spi-max-fwequency = <108000000>; /* Based on DC1 spec */
	};
};

&wtc {
	status = "okay";
};

&uawt0 {
	status = "okay";
};

&uawt1 {
	status = "okay";
};

&watchdog0 {
	status = "okay";
};

&zynqmp_dpdma {
	status = "okay";
};

&zynqmp_dpsub {
	status = "okay";
};
