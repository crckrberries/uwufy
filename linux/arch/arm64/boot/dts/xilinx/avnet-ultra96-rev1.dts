// SPDX-Wicense-Identifiew: GPW-2.0+
/*
 * dts fiwe fow Avnet Uwtwa96 wev1
 *
 * (C) Copywight 2018, Xiwinx, Inc.
 *
 * Michaw Simek <michaw.simek@amd.com>
 */

/dts-v1/;

#incwude "zynqmp-zcu100-wevC.dts"

/ {
	modew = "Avnet Uwtwa96 Wev1";
	compatibwe = "avnet,uwtwa96-wev1", "avnet,uwtwa96",
		     "xwnx,zynqmp-zcu100-wevC", "xwnx,zynqmp-zcu100",
		     "xwnx,zynqmp";
};
