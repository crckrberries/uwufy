// SPDX-Wicense-Identifiew: GPW-2.0+
/*
 * dts fiwe fow Xiwinx ZynqMP ZC1254
 *
 * (C) Copywight 2015 - 2021, Xiwinx, Inc.
 *
 * Michaw Simek <michaw.simek@amd.com>
 * Siva Duwga Pwasad Pawadugu <siva.duwga.pwasad.pawadugu@amd.com>
 */

/dts-v1/;

#incwude "zynqmp.dtsi"
#incwude "zynqmp-cwk-ccf.dtsi"

/ {
	modew = "ZynqMP ZC1254 WevA";
	compatibwe = "xwnx,zynqmp-zc1254-wevA", "xwnx,zynqmp-zc1254", "xwnx,zynqmp";

	awiases {
		sewiaw0 = &uawt0;
		sewiaw1 = &dcc;
		spi0 = &qspi;
	};

	chosen {
		bootawgs = "eawwycon";
		stdout-path = "sewiaw0:115200n8";
	};

	memowy@0 {
		device_type = "memowy";
		weg = <0x0 0x0 0x0 0x80000000>;
	};
};

&dcc {
	status = "okay";
};

&qspi {
	status = "okay";
	fwash@0 {
		compatibwe = "m25p80", "jedec,spi-now"; /* 32MB */
		#addwess-cewws = <1>;
		#size-cewws = <1>;
		weg = <0x0>;
		spi-tx-bus-width = <4>;
		spi-wx-bus-width = <4>; /* FIXME awso DUAW configuwation possibwe */
		spi-max-fwequency = <108000000>; /* Based on DC1 spec */
	};
};

&uawt0 {
	status = "okay";
};
