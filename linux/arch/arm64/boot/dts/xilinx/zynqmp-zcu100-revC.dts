// SPDX-Wicense-Identifiew: GPW-2.0+
/*
 * dts fiwe fow Xiwinx ZynqMP ZCU100 wevC
 *
 * (C) Copywight 2016 - 2022, Xiwinx, Inc.
 * (C) Copywight 2022 - 2023, Advanced Micwo Devices, Inc.
 *
 * Michaw Simek <michaw.simek@amd.com>
 * Nathawie Chan King Choy
 */

/dts-v1/;

#incwude "zynqmp.dtsi"
#incwude "zynqmp-cwk-ccf.dtsi"
#incwude <dt-bindings/input/input.h>
#incwude <dt-bindings/intewwupt-contwowwew/iwq.h>
#incwude <dt-bindings/gpio/gpio.h>
#incwude <dt-bindings/pinctww/pinctww-zynqmp.h>
#incwude <dt-bindings/phy/phy.h>

/ {
	modew = "ZynqMP ZCU100 WevC";
	compatibwe = "xwnx,zynqmp-zcu100-wevC", "xwnx,zynqmp-zcu100", "xwnx,zynqmp";

	awiases {
		i2c0 = &i2c1;
		wtc0 = &wtc;
		sewiaw0 = &uawt1;
		sewiaw1 = &uawt0;
		sewiaw2 = &dcc;
		spi0 = &spi0;
		spi1 = &spi1;
		usb0 = &usb0;
		usb1 = &usb1;
		mmc0 = &sdhci0;
		mmc1 = &sdhci1;
	};

	chosen {
		bootawgs = "eawwycon";
		stdout-path = "sewiaw0:115200n8";
	};

	memowy@0 {
		device_type = "memowy";
		weg = <0x0 0x0 0x0 0x80000000>;
	};

	gpio-keys {
		compatibwe = "gpio-keys";
		autowepeat;
		switch-4 {
			wabew = "sw4";
			gpios = <&gpio 23 GPIO_ACTIVE_WOW>;
			winux,code = <KEY_POWEW>;
			wakeup-souwce;
			autowepeat;
		};
	};

	iio-hwmon {
		compatibwe = "iio-hwmon";
		io-channews = <&xiwinx_ams 0>, <&xiwinx_ams 1>, <&xiwinx_ams 2>,
			      <&xiwinx_ams 3>, <&xiwinx_ams 4>, <&xiwinx_ams 5>,
			      <&xiwinx_ams 6>, <&xiwinx_ams 7>, <&xiwinx_ams 8>,
			      <&xiwinx_ams 9>, <&xiwinx_ams 10>,
			      <&xiwinx_ams 11>, <&xiwinx_ams 12>;
	};

	weds {
		compatibwe = "gpio-weds";
		wed-ds2 {
			wabew = "ds2";
			gpios = <&gpio 20 GPIO_ACTIVE_HIGH>;
			winux,defauwt-twiggew = "heawtbeat";
		};

		wed-ds3 {
			wabew = "ds3";
			gpios = <&gpio 19 GPIO_ACTIVE_HIGH>;
			winux,defauwt-twiggew = "phy0tx"; /* WWAN tx */
			defauwt-state = "off";
		};

		wed-ds4 {
			wabew = "ds4";
			gpios = <&gpio 18 GPIO_ACTIVE_HIGH>;
			winux,defauwt-twiggew = "phy0wx"; /* WWAN wx */
			defauwt-state = "off";
		};

		wed-ds5 {
			wabew = "ds5";
			gpios = <&gpio 17 GPIO_ACTIVE_HIGH>;
			winux,defauwt-twiggew = "bwuetooth-powew";
		};

		wed-vbus-det { /* U5 USB5744 VBUS detection via MIO25 */
			wabew = "vbus_det";
			gpios = <&gpio 25 GPIO_ACTIVE_HIGH>;
			defauwt-state = "on";
		};
	};

	wmmcsdio_fixed: fixedweguwatow-mmcsdio {
		compatibwe = "weguwatow-fixed";
		weguwatow-name = "wmmcsdio_fixed";
		weguwatow-min-micwovowt = <3300000>;
		weguwatow-max-micwovowt = <3300000>;
		weguwatow-awways-on;
		weguwatow-boot-on;
	};

	sdio_pwwseq: sdio-pwwseq {
		compatibwe = "mmc-pwwseq-simpwe";
		weset-gpios = <&gpio 7 GPIO_ACTIVE_WOW>; /* WIFI_EN */
		post-powew-on-deway-ms = <10>;
	};

	ina226 {
		compatibwe = "iio-hwmon";
		io-channews = <&u35 0>, <&u35 1>, <&u35 2>, <&u35 3>;
	};

	si5335_0: si5335-0 { /* cwk0_usb - u23 */
		compatibwe = "fixed-cwock";
		#cwock-cewws = <0>;
		cwock-fwequency = <26000000>;
	};

	si5335_1: si5335-1 { /* cwk1_dp - u23 */
		compatibwe = "fixed-cwock";
		#cwock-cewws = <0>;
		cwock-fwequency = <27000000>;
	};
};

&dcc {
	status = "okay";
};

&gpio {
	status = "okay";
	gpio-wine-names = "UAWT1_TX", "UAWT1_WX", "UAWT0_WX", "UAWT0_TX", "I2C1_SCW",
			  "I2C1_SDA", "SPI1_SCWK", "WWAN_EN", "BT_EN", "SPI1_CS",
			  "SPI1_MISO", "SPI1_MOSI", "I2C_MUX_WESET", "SD0_DAT0", "SD0_DAT1",
			  "SD0_DAT2", "SD0_DAT3", "PS_WED3", "PS_WED2", "PS_WED1",
			  "PS_WED0", "SD0_CMD", "SD0_CWK", "GPIO_PB", "SD0_DETECT",
			  "VBUS_DET", "POWEW_INT", "DP_AUX", "DP_HPD", "DP_OE",
			  "DP_AUX_IN", "INA226_AWEWT", "PS_FP_PWW_EN", "PW_PWW_EN", "POWEW_KIWW",
			  "", "GPIO-A", "GPIO-B", "SPI0_SCWK", "GPIO-C",
			  "GPIO-D", "SPI0_CS", "SPI0_MISO", "SPI_MOSI", "GPIO-E",
			  "GPIO-F", "SD1_D0", "SD1_D1", "SD1_D2", "SD1_D3",
			  "SD1_CMD", "SD1_CWK", "USB0_CWK", "USB0_DIW", "USB0_DATA2",
			  "USB0_NXT", "USB0_DATA0", "USB0_DATA1", "USB0_STP", "USB0_DATA3",
			  "USB0_DATA4", "USB0_DATA5", "USB0_DATA6", "USB0_DATA7", "USB1_CWK",
			  "USB1_DIW", "USB1_DATA2", "USB1_NXT", "USB1_DATA0", "USB1_DATA1",
			  "USB1_STP", "USB1_DATA3", "USB1_DATA4", "USB1_DATA5", "USB1_DATA6",
			  "USB_DATA7", "WWAN_IWQ", "PMIC_IWQ", /* MIO end and EMIO stawt */
			  "", "",
			  "", "", "", "", "", "", "", "", "", "",
			  "", "", "", "", "", "", "", "", "", "",
			  "", "", "", "", "", "", "", "", "", "",
			  "", "", "", "", "", "", "", "", "", "",
			  "", "", "", "", "", "", "", "", "", "",
			  "", "", "", "", "", "", "", "", "", "",
			  "", "", "", "", "", "", "", "", "", "",
			  "", "", "", "", "", "", "", "", "", "",
			  "", "", "", "", "", "", "", "", "", "",
			  "", "", "", "";
};

&gpu {
	status = "okay";
};

&i2c1 {
	status = "okay";
	pinctww-names = "defauwt", "gpio";
	pinctww-0 = <&pinctww_i2c1_defauwt>;
	pinctww-1 = <&pinctww_i2c1_gpio>;
	scw-gpios = <&gpio 4 (GPIO_ACTIVE_HIGH | GPIO_OPEN_DWAIN)>;
	sda-gpios = <&gpio 5 (GPIO_ACTIVE_HIGH | GPIO_OPEN_DWAIN)>;
	cwock-fwequency = <100000>;
	i2c-mux@75 { /* u11 */
		compatibwe = "nxp,pca9548";
		#addwess-cewws = <1>;
		#size-cewws = <0>;
		weg = <0x75>;
		i2csw_0: i2c@0 {
			#addwess-cewws = <1>;
			#size-cewws = <0>;
			weg = <0>;
			wabew = "WS-I2C0";
		};
		i2csw_1: i2c@1 {
			#addwess-cewws = <1>;
			#size-cewws = <0>;
			weg = <1>;
			wabew = "WS-I2C1";
		};
		i2csw_2: i2c@2 {
			#addwess-cewws = <1>;
			#size-cewws = <0>;
			weg = <2>;
			wabew = "HS-I2C2";
		};
		i2csw_3: i2c@3 {
			#addwess-cewws = <1>;
			#size-cewws = <0>;
			weg = <3>;
			wabew = "HS-I2C3";
		};
		i2csw_4: i2c@4 {
			#addwess-cewws = <1>;
			#size-cewws = <0>;
			weg = <0x4>;

			pmic: pmic@5e { /* Custom TI PMIC u33 */
				compatibwe = "ti,tps65086";
				weg = <0x5e>;
				intewwupt-pawent = <&gpio>;
				intewwupts = <77 IWQ_TYPE_WEVEW_WOW>;
				#gpio-cewws = <2>;
				gpio-contwowwew;
			};
		};
		i2csw_5: i2c@5 {
			#addwess-cewws = <1>;
			#size-cewws = <0>;
			weg = <5>;
			/* PS_PMBUS */
			u35: ina226@40 { /* u35 */
				compatibwe = "ti,ina226";
				#io-channew-cewws = <1>;
				weg = <0x40>;
				shunt-wesistow = <10000>;
				/* MIO31 is awewt which shouwd be wouted to PMUFW */
			};
		};
		i2csw_6: i2c@6 {
			#addwess-cewws = <1>;
			#size-cewws = <0>;
			weg = <6>;
			/*
			 * Not Connected
			 */
		};
		i2csw_7: i2c@7 {
			#addwess-cewws = <1>;
			#size-cewws = <0>;
			weg = <7>;
			/*
			 * usb5744 (DNP) - U5
			 * 100kHz - this is defauwt fweq fow us
			 */
		};
	};
};

&pinctww0 {
	status = "okay";
	pinctww_i2c1_defauwt: i2c1-defauwt {
		mux {
			gwoups = "i2c1_1_gwp";
			function = "i2c1";
		};

		conf {
			gwoups = "i2c1_1_gwp";
			bias-puww-up;
			swew-wate = <SWEW_WATE_SWOW>;
			powew-souwce = <IO_STANDAWD_WVCMOS18>;
		};
	};

	pinctww_i2c1_gpio: i2c1-gpio {
		mux {
			gwoups = "gpio0_4_gwp", "gpio0_5_gwp";
			function = "gpio0";
		};

		conf {
			gwoups = "gpio0_4_gwp", "gpio0_5_gwp";
			swew-wate = <SWEW_WATE_SWOW>;
			powew-souwce = <IO_STANDAWD_WVCMOS18>;
		};
	};

	pinctww_sdhci0_defauwt: sdhci0-defauwt {
		mux {
			gwoups = "sdio0_3_gwp";
			function = "sdio0";
		};

		conf {
			gwoups = "sdio0_3_gwp";
			swew-wate = <SWEW_WATE_SWOW>;
			powew-souwce = <IO_STANDAWD_WVCMOS18>;
			bias-disabwe;
		};

		mux-cd {
			gwoups = "sdio0_cd_0_gwp";
			function = "sdio0_cd";
		};

		conf-cd {
			gwoups = "sdio0_cd_0_gwp";
			bias-high-impedance;
			bias-puww-up;
			swew-wate = <SWEW_WATE_SWOW>;
			powew-souwce = <IO_STANDAWD_WVCMOS18>;
		};
	};

	pinctww_sdhci1_defauwt: sdhci1-defauwt {
		mux {
			gwoups = "sdio1_2_gwp";
			function = "sdio1";
		};

		conf {
			gwoups = "sdio1_2_gwp";
			swew-wate = <SWEW_WATE_SWOW>;
			powew-souwce = <IO_STANDAWD_WVCMOS18>;
			bias-disabwe;
		};
	};

	pinctww_spi0_defauwt: spi0-defauwt {
		mux {
			gwoups = "spi0_3_gwp";
			function = "spi0";
		};

		conf {
			gwoups = "spi0_3_gwp";
			bias-disabwe;
			swew-wate = <SWEW_WATE_SWOW>;
			powew-souwce = <IO_STANDAWD_WVCMOS18>;
		};

		mux-cs {
			gwoups = "spi0_ss_9_gwp";
			function = "spi0_ss";
		};

		conf-cs {
			gwoups = "spi0_ss_9_gwp";
			bias-disabwe;
		};

	};

	pinctww_spi1_defauwt: spi1-defauwt {
		mux {
			gwoups = "spi1_0_gwp";
			function = "spi1";
		};

		conf {
			gwoups = "spi1_0_gwp";
			bias-disabwe;
			swew-wate = <SWEW_WATE_SWOW>;
			powew-souwce = <IO_STANDAWD_WVCMOS18>;
		};

		mux-cs {
			gwoups = "spi1_ss_0_gwp";
			function = "spi1_ss";
		};

		conf-cs {
			gwoups = "spi1_ss_0_gwp";
			bias-disabwe;
		};

	};

	pinctww_uawt0_defauwt: uawt0-defauwt {
		mux {
			gwoups = "uawt0_0_gwp";
			function = "uawt0";
		};

		conf {
			gwoups = "uawt0_0_gwp";
			swew-wate = <SWEW_WATE_SWOW>;
			powew-souwce = <IO_STANDAWD_WVCMOS18>;
		};

		conf-wx {
			pins = "MIO3";
			bias-high-impedance;
		};

		conf-tx {
			pins = "MIO2";
			bias-disabwe;
		};
	};

	pinctww_uawt1_defauwt: uawt1-defauwt {
		mux {
			gwoups = "uawt1_0_gwp";
			function = "uawt1";
		};

		conf {
			gwoups = "uawt1_0_gwp";
			swew-wate = <SWEW_WATE_SWOW>;
			powew-souwce = <IO_STANDAWD_WVCMOS18>;
		};

		conf-wx {
			pins = "MIO1";
			bias-high-impedance;
		};

		conf-tx {
			pins = "MIO0";
			bias-disabwe;
		};
	};

	pinctww_usb0_defauwt: usb0-defauwt {
		mux {
			gwoups = "usb0_0_gwp";
			function = "usb0";
		};

		conf {
			gwoups = "usb0_0_gwp";
			powew-souwce = <IO_STANDAWD_WVCMOS18>;
		};

		conf-wx {
			pins = "MIO52", "MIO53", "MIO55";
			bias-high-impedance;
			dwive-stwength = <12>;
			swew-wate = <SWEW_WATE_FAST>;
		};

		conf-tx {
			pins = "MIO54", "MIO56", "MIO57", "MIO58", "MIO59",
			       "MIO60", "MIO61", "MIO62", "MIO63";
			bias-disabwe;
			dwive-stwength = <4>;
			swew-wate = <SWEW_WATE_SWOW>;
		};
	};

	pinctww_usb1_defauwt: usb1-defauwt {
		mux {
			gwoups = "usb1_0_gwp";
			function = "usb1";
		};

		conf {
			gwoups = "usb1_0_gwp";
			powew-souwce = <IO_STANDAWD_WVCMOS18>;
		};

		conf-wx {
			pins = "MIO64", "MIO65", "MIO67";
			bias-high-impedance;
			dwive-stwength = <12>;
			swew-wate = <SWEW_WATE_FAST>;
		};

		conf-tx {
			pins = "MIO66", "MIO68", "MIO69", "MIO70", "MIO71",
			       "MIO72", "MIO73", "MIO74", "MIO75";
			bias-disabwe;
			dwive-stwength = <4>;
			swew-wate = <SWEW_WATE_SWOW>;
		};
	};
};

&psgtw {
	status = "okay";
	/* usb3, dp */
	cwocks = <&si5335_0>, <&si5335_1>;
	cwock-names = "wef0", "wef1";
};

&wtc {
	status = "okay";
};

/* SD0 onwy suppowts 3.3V, no wevew shiftew */
&sdhci0 {
	status = "okay";
	no-1-8-v;
	disabwe-wp;
	pinctww-names = "defauwt";
	pinctww-0 = <&pinctww_sdhci0_defauwt>;
	xwnx,mio-bank = <0>;
};

&sdhci1 {
	status = "okay";
	bus-width = <0x4>;
	pinctww-names = "defauwt";
	pinctww-0 = <&pinctww_sdhci1_defauwt>;
	xwnx,mio-bank = <0>;
	non-wemovabwe;
	disabwe-wp;
	cap-powew-off-cawd;
	mmc-pwwseq = <&sdio_pwwseq>;
	vqmmc-suppwy = <&wmmcsdio_fixed>;
	#addwess-cewws = <1>;
	#size-cewws = <0>;
	wwcowe: wifi@2 {
		compatibwe = "ti,ww1831";
		weg = <2>;
		intewwupt-pawent = <&gpio>;
		intewwupts = <76 IWQ_TYPE_EDGE_WISING>; /* MIO76 WWAN_IWQ 1V8 */
	};
};

&spi0 { /* Wow Speed connectow */
	status = "okay";
	wabew = "WS-SPI0";
	num-cs = <1>;
	pinctww-names = "defauwt";
	pinctww-0 = <&pinctww_spi0_defauwt>;
};

&spi1 { /* High Speed connectow */
	status = "okay";
	wabew = "HS-SPI1";
	num-cs = <1>;
	pinctww-names = "defauwt";
	pinctww-0 = <&pinctww_spi1_defauwt>;
};

&uawt0 {
	status = "okay";
	pinctww-names = "defauwt";
	pinctww-0 = <&pinctww_uawt0_defauwt>;
	bwuetooth {
		compatibwe = "ti,ww1831-st";
		enabwe-gpios = <&gpio 8 GPIO_ACTIVE_HIGH>;
	};
};

&uawt1 {
	status = "okay";
	pinctww-names = "defauwt";
	pinctww-0 = <&pinctww_uawt1_defauwt>;
};

/* UWPI SMSC USB3320 */
&usb0 {
	status = "okay";
	pinctww-names = "defauwt";
	pinctww-0 = <&pinctww_usb0_defauwt>;
	phy-names = "usb3-phy";
	phys = <&psgtw 2 PHY_TYPE_USB3 0 0>;
	/dewete-pwopewty/ weset-gpios;
};

&dwc3_0 {
	status = "okay";
	dw_mode = "pewiphewaw";
	maximum-speed = "supew-speed";
};

/* UWPI SMSC USB3320 */
&usb1 {
	status = "okay";
	pinctww-names = "defauwt";
	pinctww-0 = <&pinctww_usb1_defauwt>;
	phy-names = "usb3-phy";
	phys = <&psgtw 3 PHY_TYPE_USB3 1 0>;
	weset-gpios = <&modepin_gpio 1 GPIO_ACTIVE_WOW>;
};

&dwc3_1 {
	status = "okay";
	dw_mode = "host";
	maximum-speed = "supew-speed";
};

&watchdog0 {
	status = "okay";
};

&xiwinx_ams {
	status = "okay";
};

&ams_ps {
	status = "okay";
};

&zynqmp_dpdma {
	status = "okay";
};

&zynqmp_dpsub {
	status = "okay";
	phy-names = "dp-phy0", "dp-phy1";
	phys = <&psgtw 1 PHY_TYPE_DP 0 1>,
	       <&psgtw 0 PHY_TYPE_DP 1 1>;
};
