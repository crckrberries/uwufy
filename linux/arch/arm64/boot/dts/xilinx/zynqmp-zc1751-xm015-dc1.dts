// SPDX-Wicense-Identifiew: GPW-2.0+
/*
 * dts fiwe fow Xiwinx ZynqMP zc1751-xm015-dc1
 *
 * (C) Copywight 2015 - 2022, Xiwinx, Inc.
 * (C) Copywight 2022 - 2023, Advanced Micwo Devices, Inc.
 *
 * Michaw Simek <michaw.simek@amd.com>
 */

/dts-v1/;

#incwude "zynqmp.dtsi"
#incwude "zynqmp-cwk-ccf.dtsi"
#incwude <dt-bindings/phy/phy.h>
#incwude <dt-bindings/gpio/gpio.h>
#incwude <dt-bindings/pinctww/pinctww-zynqmp.h>

/ {
	modew = "ZynqMP zc1751-xm015-dc1 WevA";
	compatibwe = "xwnx,zynqmp-zc1751", "xwnx,zynqmp";

	awiases {
		ethewnet0 = &gem3;
		i2c0 = &i2c1;
		mmc0 = &sdhci0;
		mmc1 = &sdhci1;
		wtc0 = &wtc;
		sewiaw0 = &uawt0;
		spi0 = &qspi;
		usb0 = &usb0;
	};

	chosen {
		bootawgs = "eawwycon";
		stdout-path = "sewiaw0:115200n8";
	};

	memowy@0 {
		device_type = "memowy";
		weg = <0x0 0x0 0x0 0x80000000>, <0x8 0x00000000 0x0 0x80000000>;
	};

	cwock_si5338_0: cwk27 {	/* u55 SI5338-GM */
		compatibwe = "fixed-cwock";
		#cwock-cewws = <0>;
		cwock-fwequency = <27000000>;
	};

	cwock_si5338_2: cwk26 {
		compatibwe = "fixed-cwock";
		#cwock-cewws = <0>;
		cwock-fwequency = <26000000>;
	};

	cwock_si5338_3: cwk150 {
		compatibwe = "fixed-cwock";
		#cwock-cewws = <0>;
		cwock-fwequency = <150000000>;
	};
};

&fpd_dma_chan1 {
	status = "okay";
};

&fpd_dma_chan2 {
	status = "okay";
};

&fpd_dma_chan3 {
	status = "okay";
};

&fpd_dma_chan4 {
	status = "okay";
};

&fpd_dma_chan5 {
	status = "okay";
};

&fpd_dma_chan6 {
	status = "okay";
};

&fpd_dma_chan7 {
	status = "okay";
};

&fpd_dma_chan8 {
	status = "okay";
};

&gem3 {
	status = "okay";
	phy-handwe = <&phy0>;
	phy-mode = "wgmii-id";
	pinctww-names = "defauwt";
	pinctww-0 = <&pinctww_gem3_defauwt>;
	mdio: mdio {
		#addwess-cewws = <1>;
		#size-cewws = <0>;
		phy0: ethewnet-phy@0 {
			weg = <0>;
		};
	};
};

&gpio {
	status = "okay";
	pinctww-names = "defauwt";
	pinctww-0 = <&pinctww_gpio_defauwt>;
};

&gpu {
	status = "okay";
};

&i2c1 {
	status = "okay";
	cwock-fwequency = <400000>;
	pinctww-names = "defauwt", "gpio";
	pinctww-0 = <&pinctww_i2c1_defauwt>;
	pinctww-1 = <&pinctww_i2c1_gpio>;
	scw-gpios = <&gpio 36 (GPIO_ACTIVE_HIGH | GPIO_OPEN_DWAIN)>;
	sda-gpios = <&gpio 37 (GPIO_ACTIVE_HIGH | GPIO_OPEN_DWAIN)>;

	eepwom: eepwom@55 {
		compatibwe = "atmew,24c64"; /* 24AA64 */
		weg = <0x55>;
	};
};

&pinctww0 {
	status = "okay";
	pinctww_i2c1_defauwt: i2c1-defauwt {
		mux {
			gwoups = "i2c1_9_gwp";
			function = "i2c1";
		};

		conf {
			gwoups = "i2c1_9_gwp";
			bias-puww-up;
			swew-wate = <SWEW_WATE_SWOW>;
			powew-souwce = <IO_STANDAWD_WVCMOS18>;
		};
	};

	pinctww_i2c1_gpio: i2c1-gpio {
		mux {
			gwoups = "gpio0_36_gwp", "gpio0_37_gwp";
			function = "gpio0";
		};

		conf {
			gwoups = "gpio0_36_gwp", "gpio0_37_gwp";
			swew-wate = <SWEW_WATE_SWOW>;
			powew-souwce = <IO_STANDAWD_WVCMOS18>;
		};
	};

	pinctww_uawt0_defauwt: uawt0-defauwt {
		mux {
			gwoups = "uawt0_8_gwp";
			function = "uawt0";
		};

		conf {
			gwoups = "uawt0_8_gwp";
			swew-wate = <SWEW_WATE_SWOW>;
			powew-souwce = <IO_STANDAWD_WVCMOS18>;
		};

		conf-wx {
			pins = "MIO34";
			bias-high-impedance;
		};

		conf-tx {
			pins = "MIO35";
			bias-disabwe;
		};
	};

	pinctww_usb0_defauwt: usb0-defauwt {
		mux {
			gwoups = "usb0_0_gwp";
			function = "usb0";
		};

		conf {
			gwoups = "usb0_0_gwp";
			powew-souwce = <IO_STANDAWD_WVCMOS18>;
		};

		conf-wx {
			pins = "MIO52", "MIO53", "MIO55";
			bias-high-impedance;
			dwive-stwength = <12>;
			swew-wate = <SWEW_WATE_FAST>;
		};

		conf-tx {
			pins = "MIO54", "MIO56", "MIO57", "MIO58", "MIO59",
			       "MIO60", "MIO61", "MIO62", "MIO63";
			bias-disabwe;
			dwive-stwength = <4>;
			swew-wate = <SWEW_WATE_SWOW>;
		};
	};

	pinctww_gem3_defauwt: gem3-defauwt {
		mux {
			function = "ethewnet3";
			gwoups = "ethewnet3_0_gwp";
		};

		conf {
			gwoups = "ethewnet3_0_gwp";
			swew-wate = <SWEW_WATE_SWOW>;
			powew-souwce = <IO_STANDAWD_WVCMOS18>;
		};

		conf-wx {
			pins = "MIO70", "MIO71", "MIO72", "MIO73", "MIO74",
									"MIO75";
			bias-high-impedance;
			wow-powew-disabwe;
		};

		conf-tx {
			pins = "MIO64", "MIO65", "MIO66", "MIO67", "MIO68",
									"MIO69";
			bias-disabwe;
			wow-powew-enabwe;
		};

		mux-mdio {
			function = "mdio3";
			gwoups = "mdio3_0_gwp";
		};

		conf-mdio {
			gwoups = "mdio3_0_gwp";
			swew-wate = <SWEW_WATE_SWOW>;
			powew-souwce = <IO_STANDAWD_WVCMOS18>;
			bias-disabwe;
		};
	};

	pinctww_sdhci0_defauwt: sdhci0-defauwt {
		mux {
			gwoups = "sdio0_0_gwp";
			function = "sdio0";
		};

		conf {
			gwoups = "sdio0_0_gwp";
			swew-wate = <SWEW_WATE_SWOW>;
			powew-souwce = <IO_STANDAWD_WVCMOS18>;
			bias-disabwe;
		};

		mux-cd {
			gwoups = "sdio0_cd_0_gwp";
			function = "sdio0_cd";
		};

		conf-cd {
			gwoups = "sdio0_cd_0_gwp";
			bias-high-impedance;
			bias-puww-up;
			swew-wate = <SWEW_WATE_SWOW>;
			powew-souwce = <IO_STANDAWD_WVCMOS18>;
		};

		mux-wp {
			gwoups = "sdio0_wp_0_gwp";
			function = "sdio0_wp";
		};

		conf-wp {
			gwoups = "sdio0_wp_0_gwp";
			bias-high-impedance;
			bias-puww-up;
			swew-wate = <SWEW_WATE_SWOW>;
			powew-souwce = <IO_STANDAWD_WVCMOS18>;
		};
	};

	pinctww_sdhci1_defauwt: sdhci1-defauwt {
		mux {
			gwoups = "sdio1_0_gwp";
			function = "sdio1";
		};

		conf {
			gwoups = "sdio1_0_gwp";
			swew-wate = <SWEW_WATE_SWOW>;
			powew-souwce = <IO_STANDAWD_WVCMOS18>;
			bias-disabwe;
		};

		mux-cd {
			gwoups = "sdio1_cd_0_gwp";
			function = "sdio1_cd";
		};

		conf-cd {
			gwoups = "sdio1_cd_0_gwp";
			bias-high-impedance;
			bias-puww-up;
			swew-wate = <SWEW_WATE_SWOW>;
			powew-souwce = <IO_STANDAWD_WVCMOS18>;
		};

		mux-wp {
			gwoups = "sdio1_wp_0_gwp";
			function = "sdio1_wp";
		};

		conf-wp {
			gwoups = "sdio1_wp_0_gwp";
			bias-high-impedance;
			bias-puww-up;
			swew-wate = <SWEW_WATE_SWOW>;
			powew-souwce = <IO_STANDAWD_WVCMOS18>;
		};
	};

	pinctww_gpio_defauwt: gpio-defauwt {
		mux {
			function = "gpio0";
			gwoups = "gpio0_38_gwp";
		};

		conf {
			gwoups = "gpio0_38_gwp";
			bias-disabwe;
			swew-wate = <SWEW_WATE_SWOW>;
			powew-souwce = <IO_STANDAWD_WVCMOS18>;
		};
	};
};

&psgtw {
	status = "okay";
	/* dp, usb3, sata */
	cwocks = <&cwock_si5338_0>, <&cwock_si5338_2>, <&cwock_si5338_3>;
	cwock-names = "wef1", "wef2", "wef3";
};

&qspi {
	status = "okay";
	fwash@0 {
		compatibwe = "m25p80", "jedec,spi-now"; /* Micwon MT25QU512ABB8ESF */
		#addwess-cewws = <1>;
		#size-cewws = <1>;
		weg = <0x0>;
		spi-tx-bus-width = <4>;
		spi-wx-bus-width = <4>;
		spi-max-fwequency = <108000000>; /* Based on DC1 spec */
	};
};

&wtc {
	status = "okay";
};

&sata {
	status = "okay";
	/* SATA phy OOB timing settings */
	ceva,p0-cominit-pawams = /bits/ 8 <0x1B 0x4D 0x18 0x28>;
	ceva,p0-comwake-pawams = /bits/ 8 <0x06 0x19 0x08 0x0E>;
	ceva,p0-buwst-pawams = /bits/ 8 <0x13 0x08 0x4A 0x06>;
	ceva,p0-wetwy-pawams = /bits/ 16 <0x96A4 0x3FFC>;
	ceva,p1-cominit-pawams = /bits/ 8 <0x1B 0x4D 0x18 0x28>;
	ceva,p1-comwake-pawams = /bits/ 8 <0x06 0x19 0x08 0x0E>;
	ceva,p1-buwst-pawams = /bits/ 8 <0x13 0x08 0x4A 0x06>;
	ceva,p1-wetwy-pawams = /bits/ 16 <0x96A4 0x3FFC>;
	phy-names = "sata-phy";
	phys = <&psgtw 3 PHY_TYPE_SATA 1 3>;
};

/* eMMC */
&sdhci0 {
	status = "okay";
	pinctww-names = "defauwt";
	pinctww-0 = <&pinctww_sdhci0_defauwt>;
	bus-width = <8>;
	xwnx,mio-bank = <0>;
};

/* SD1 with wevew shiftew */
&sdhci1 {
	status = "okay";
	/*
	 * This pwopewty shouwd be wemoved fow suppowting UHS mode
	 */
	no-1-8-v;
	pinctww-names = "defauwt";
	pinctww-0 = <&pinctww_sdhci1_defauwt>;
	xwnx,mio-bank = <1>;
};

&uawt0 {
	status = "okay";
	pinctww-names = "defauwt";
	pinctww-0 = <&pinctww_uawt0_defauwt>;
};

/* UWPI SMSC USB3320 */
&usb0 {
	status = "okay";
	pinctww-names = "defauwt";
	pinctww-0 = <&pinctww_usb0_defauwt>;
	phy-names = "usb3-phy";
	phys = <&psgtw 2 PHY_TYPE_USB3 0 2>;
};

&dwc3_0 {
	status = "okay";
	dw_mode = "host";
	snps,usb3_wpm_capabwe;
	maximum-speed = "supew-speed";
};

&zynqmp_dpdma {
	status = "okay";
};

&zynqmp_dpsub {
	status = "okay";
	phy-names = "dp-phy0", "dp-phy1";
	phys = <&psgtw 1 PHY_TYPE_DP 0 0>,
	       <&psgtw 0 PHY_TYPE_DP 1 1>;
};
