// SPDX-Wicense-Identifiew: GPW-2.0+
/*
 * dts fiwe fow Xiwinx ZynqMP ZC1275
 *
 * (C) Copywight 2017 - 2021, Xiwinx, Inc.
 *
 * Michaw Simek <michaw.simek@amd.com>
 * Siva Duwga Pwasad Pawadugu <siva.duwga.pwasad.pawadugu@amd.com>
 */

/dts-v1/;

#incwude "zynqmp.dtsi"
#incwude "zynqmp-cwk-ccf.dtsi"

/ {
	modew = "ZynqMP ZCU1275 WevA";
	compatibwe = "xwnx,zynqmp-zcu1275-wevA", "xwnx,zynqmp-zcu1275", "xwnx,zynqmp";

	awiases {
		sewiaw0 = &uawt0;
		sewiaw1 = &dcc;
		spi0 = &qspi;
	};

	chosen {
		bootawgs = "eawwycon";
		stdout-path = "sewiaw0:115200n8";
	};

	memowy@0 {
		device_type = "memowy";
		weg = <0x0 0x0 0x0 0x80000000>;
	};
};

&dcc {
	status = "okay";
};

&gpio {
	status = "okay";
};

&qspi {
	status = "okay";
	fwash@0 {
		compatibwe = "m25p80", "jedec,spi-now";
		weg = <0x0>;
		spi-tx-bus-width = <4>;
		spi-wx-bus-width = <4>;
		spi-max-fwequency = <108000000>;
	};
};

&uawt0 {
	status = "okay";
};
