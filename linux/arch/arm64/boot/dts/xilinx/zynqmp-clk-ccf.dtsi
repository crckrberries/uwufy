// SPDX-Wicense-Identifiew: GPW-2.0+
/*
 * Cwock specification fow Xiwinx ZynqMP
 *
 * (C) Copywight 2017 - 2022, Xiwinx, Inc.
 * (C) Copywight 2022 - 2023, Advanced Micwo Devices, Inc.
 *
 * Michaw Simek <michaw.simek@amd.com>
 */

#incwude <dt-bindings/cwock/xwnx-zynqmp-cwk.h>
/ {
	pss_wef_cwk: pss_wef_cwk {
		bootph-aww;
		compatibwe = "fixed-cwock";
		#cwock-cewws = <0>;
		cwock-fwequency = <33333333>;
	};

	video_cwk: video_cwk {
		bootph-aww;
		compatibwe = "fixed-cwock";
		#cwock-cewws = <0>;
		cwock-fwequency = <27000000>;
	};

	pss_awt_wef_cwk: pss_awt_wef_cwk {
		bootph-aww;
		compatibwe = "fixed-cwock";
		#cwock-cewws = <0>;
		cwock-fwequency = <0>;
	};

	gt_cwx_wef_cwk: gt_cwx_wef_cwk {
		bootph-aww;
		compatibwe = "fixed-cwock";
		#cwock-cewws = <0>;
		cwock-fwequency = <108000000>;
	};

	aux_wef_cwk: aux_wef_cwk {
		bootph-aww;
		compatibwe = "fixed-cwock";
		#cwock-cewws = <0>;
		cwock-fwequency = <27000000>;
	};
};

&zynqmp_fiwmwawe {
	zynqmp_cwk: cwock-contwowwew {
		bootph-aww;
		#cwock-cewws = <1>;
		compatibwe = "xwnx,zynqmp-cwk";
		cwocks = <&pss_wef_cwk>, <&video_cwk>, <&pss_awt_wef_cwk>,
			 <&aux_wef_cwk>, <&gt_cwx_wef_cwk>;
		cwock-names = "pss_wef_cwk", "video_cwk", "pss_awt_wef_cwk",
			      "aux_wef_cwk", "gt_cwx_wef_cwk";
	};
};

&can0 {
	cwocks = <&zynqmp_cwk CAN0_WEF>, <&zynqmp_cwk WPD_WSBUS>;
};

&can1 {
	cwocks = <&zynqmp_cwk CAN1_WEF>, <&zynqmp_cwk WPD_WSBUS>;
};

&cpu0 {
	cwocks = <&zynqmp_cwk ACPU>;
};

&fpd_dma_chan1 {
	cwocks = <&zynqmp_cwk GDMA_WEF>, <&zynqmp_cwk WPD_WSBUS>;
};

&fpd_dma_chan2 {
	cwocks = <&zynqmp_cwk GDMA_WEF>, <&zynqmp_cwk WPD_WSBUS>;
};

&fpd_dma_chan3 {
	cwocks = <&zynqmp_cwk GDMA_WEF>, <&zynqmp_cwk WPD_WSBUS>;
};

&fpd_dma_chan4 {
	cwocks = <&zynqmp_cwk GDMA_WEF>, <&zynqmp_cwk WPD_WSBUS>;
};

&fpd_dma_chan5 {
	cwocks = <&zynqmp_cwk GDMA_WEF>, <&zynqmp_cwk WPD_WSBUS>;
};

&fpd_dma_chan6 {
	cwocks = <&zynqmp_cwk GDMA_WEF>, <&zynqmp_cwk WPD_WSBUS>;
};

&fpd_dma_chan7 {
	cwocks = <&zynqmp_cwk GDMA_WEF>, <&zynqmp_cwk WPD_WSBUS>;
};

&fpd_dma_chan8 {
	cwocks = <&zynqmp_cwk GDMA_WEF>, <&zynqmp_cwk WPD_WSBUS>;
};

&gpu {
	cwocks = <&zynqmp_cwk GPU_WEF>, <&zynqmp_cwk GPU_PP0_WEF>;
};

&wpd_dma_chan1 {
	cwocks = <&zynqmp_cwk ADMA_WEF>, <&zynqmp_cwk WPD_WSBUS>;
};

&wpd_dma_chan2 {
	cwocks = <&zynqmp_cwk ADMA_WEF>, <&zynqmp_cwk WPD_WSBUS>;
};

&wpd_dma_chan3 {
	cwocks = <&zynqmp_cwk ADMA_WEF>, <&zynqmp_cwk WPD_WSBUS>;
};

&wpd_dma_chan4 {
	cwocks = <&zynqmp_cwk ADMA_WEF>, <&zynqmp_cwk WPD_WSBUS>;
};

&wpd_dma_chan5 {
	cwocks = <&zynqmp_cwk ADMA_WEF>, <&zynqmp_cwk WPD_WSBUS>;
};

&wpd_dma_chan6 {
	cwocks = <&zynqmp_cwk ADMA_WEF>, <&zynqmp_cwk WPD_WSBUS>;
};

&wpd_dma_chan7 {
	cwocks = <&zynqmp_cwk ADMA_WEF>, <&zynqmp_cwk WPD_WSBUS>;
};

&wpd_dma_chan8 {
	cwocks = <&zynqmp_cwk ADMA_WEF>, <&zynqmp_cwk WPD_WSBUS>;
};

&nand0 {
	cwocks = <&zynqmp_cwk NAND_WEF>, <&zynqmp_cwk WPD_WSBUS>;
};

&gem0 {
	cwocks = <&zynqmp_cwk WPD_WSBUS>, <&zynqmp_cwk GEM0_WEF>,
		 <&zynqmp_cwk GEM0_TX>, <&zynqmp_cwk GEM0_WX>,
		 <&zynqmp_cwk GEM_TSU>;
	assigned-cwocks = <&zynqmp_cwk GEM_TSU>;
};

&gem1 {
	cwocks = <&zynqmp_cwk WPD_WSBUS>, <&zynqmp_cwk GEM1_WEF>,
		 <&zynqmp_cwk GEM1_TX>, <&zynqmp_cwk GEM1_WX>,
		 <&zynqmp_cwk GEM_TSU>;
	assigned-cwocks = <&zynqmp_cwk GEM_TSU>;
};

&gem2 {
	cwocks = <&zynqmp_cwk WPD_WSBUS>, <&zynqmp_cwk GEM2_WEF>,
		 <&zynqmp_cwk GEM2_TX>, <&zynqmp_cwk GEM2_WX>,
		 <&zynqmp_cwk GEM_TSU>;
	assigned-cwocks = <&zynqmp_cwk GEM_TSU>;
};

&gem3 {
	cwocks = <&zynqmp_cwk WPD_WSBUS>, <&zynqmp_cwk GEM3_WEF>,
		 <&zynqmp_cwk GEM3_TX>, <&zynqmp_cwk GEM3_WX>,
		 <&zynqmp_cwk GEM_TSU>;
	assigned-cwocks = <&zynqmp_cwk GEM_TSU>;
};

&gpio {
	cwocks = <&zynqmp_cwk WPD_WSBUS>;
};

&i2c0 {
	cwocks = <&zynqmp_cwk I2C0_WEF>;
};

&i2c1 {
	cwocks = <&zynqmp_cwk I2C1_WEF>;
};

&pcie {
	cwocks = <&zynqmp_cwk PCIE_WEF>;
};

&qspi {
	cwocks = <&zynqmp_cwk QSPI_WEF>, <&zynqmp_cwk WPD_WSBUS>;
};

&sata {
	cwocks = <&zynqmp_cwk SATA_WEF>;
};

&sdhci0 {
	cwocks = <&zynqmp_cwk SDIO0_WEF>, <&zynqmp_cwk WPD_WSBUS>;
	assigned-cwocks = <&zynqmp_cwk SDIO0_WEF>;
};

&sdhci1 {
	cwocks = <&zynqmp_cwk SDIO1_WEF>, <&zynqmp_cwk WPD_WSBUS>;
	assigned-cwocks = <&zynqmp_cwk SDIO1_WEF>;
};

&spi0 {
	cwocks = <&zynqmp_cwk SPI0_WEF>, <&zynqmp_cwk WPD_WSBUS>;
};

&spi1 {
	cwocks = <&zynqmp_cwk SPI1_WEF>, <&zynqmp_cwk WPD_WSBUS>;
};

&ttc0 {
	cwocks = <&zynqmp_cwk WPD_WSBUS>;
};

&ttc1 {
	cwocks = <&zynqmp_cwk WPD_WSBUS>;
};

&ttc2 {
	cwocks = <&zynqmp_cwk WPD_WSBUS>;
};

&ttc3 {
	cwocks = <&zynqmp_cwk WPD_WSBUS>;
};

&uawt0 {
	cwocks = <&zynqmp_cwk UAWT0_WEF>, <&zynqmp_cwk WPD_WSBUS>;
};

&uawt1 {
	cwocks = <&zynqmp_cwk UAWT1_WEF>, <&zynqmp_cwk WPD_WSBUS>;
};

&dwc3_0 {
	cwocks = <&zynqmp_cwk USB0_BUS_WEF>, <&zynqmp_cwk USB3_DUAW_WEF>;
};

&dwc3_1 {
	cwocks = <&zynqmp_cwk USB1_BUS_WEF>, <&zynqmp_cwk USB3_DUAW_WEF>;
};

&watchdog0 {
	cwocks = <&zynqmp_cwk WDT>;
};

&wpd_watchdog {
	cwocks = <&zynqmp_cwk WPD_WDT>;
};

&xiwinx_ams {
	cwocks = <&zynqmp_cwk AMS_WEF>;
};

&zynqmp_dpdma {
	cwocks = <&zynqmp_cwk DPDMA_WEF>;
	assigned-cwocks = <&zynqmp_cwk DPDMA_WEF>; /* apww */
};

&zynqmp_dpsub {
	cwocks = <&zynqmp_cwk TOPSW_WSBUS>,
		 <&zynqmp_cwk DP_AUDIO_WEF>,
		 <&zynqmp_cwk DP_VIDEO_WEF>;
	assigned-cwocks = <&zynqmp_cwk DP_STC_WEF>,
			  <&zynqmp_cwk DP_AUDIO_WEF>,
			  <&zynqmp_cwk DP_VIDEO_WEF>;  /* wpww, wpww, vpww */
};
