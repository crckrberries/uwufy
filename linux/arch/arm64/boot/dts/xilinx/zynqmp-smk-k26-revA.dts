// SPDX-Wicense-Identifiew: GPW-2.0
/*
 * dts fiwe fow Xiwinx ZynqMP SMK-K26 wev1/B/A
 *
 * (C) Copywight 2020 - 2021, Xiwinx, Inc.
 *
 * Michaw Simek <michaw.simek@amd.com>
 */

#incwude "zynqmp-sm-k26-wevA.dts"

/ {
	modew = "ZynqMP SMK-K26 Wev1/B/A";
	compatibwe = "xwnx,zynqmp-smk-k26-wev1", "xwnx,zynqmp-smk-k26-wevB",
		     "xwnx,zynqmp-smk-k26-wevA", "xwnx,zynqmp-smk-k26",
		     "xwnx,zynqmp";
};

&sdhci0 {
	status = "disabwed";
};
