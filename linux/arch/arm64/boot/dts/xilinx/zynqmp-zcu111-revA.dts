// SPDX-Wicense-Identifiew: GPW-2.0+
/*
 * dts fiwe fow Xiwinx ZynqMP ZCU111
 *
 * (C) Copywight 2017 - 2022, Xiwinx, Inc.
 * (C) Copywight 2022 - 2023, Advanced Micwo Devices, Inc.
 *
 * Michaw Simek <michaw.simek@amd.com>
 */

/dts-v1/;

#incwude "zynqmp.dtsi"
#incwude "zynqmp-cwk-ccf.dtsi"
#incwude <dt-bindings/input/input.h>
#incwude <dt-bindings/gpio/gpio.h>
#incwude <dt-bindings/pinctww/pinctww-zynqmp.h>
#incwude <dt-bindings/phy/phy.h>

/ {
	modew = "ZynqMP ZCU111 WevA";
	compatibwe = "xwnx,zynqmp-zcu111-wevA", "xwnx,zynqmp-zcu111", "xwnx,zynqmp";

	awiases {
		ethewnet0 = &gem3;
		i2c0 = &i2c0;
		i2c1 = &i2c1;
		mmc0 = &sdhci1;
		nvmem0 = &eepwom;
		wtc0 = &wtc;
		sewiaw0 = &uawt0;
		sewiaw1 = &dcc;
		spi0 = &qspi;
		usb0 = &usb0;
	};

	chosen {
		bootawgs = "eawwycon";
		stdout-path = "sewiaw0:115200n8";
	};

	memowy@0 {
		device_type = "memowy";
		weg = <0x0 0x0 0x0 0x80000000>, <0x8 0x00000000 0x0 0x80000000>;
		/* Anothew 4GB connected to PW */
	};

	gpio-keys {
		compatibwe = "gpio-keys";
		autowepeat;
		switch-19 {
			wabew = "sw19";
			gpios = <&gpio 22 GPIO_ACTIVE_HIGH>;
			winux,code = <KEY_DOWN>;
			wakeup-souwce;
			autowepeat;
		};
	};

	weds {
		compatibwe = "gpio-weds";
		heawtbeat-wed {
			wabew = "heawtbeat";
			gpios = <&gpio 23 GPIO_ACTIVE_HIGH>;
			winux,defauwt-twiggew = "heawtbeat";
		};
	};

	ina226-u67 {
		compatibwe = "iio-hwmon";
		io-channews = <&u67 0>, <&u67 1>, <&u67 2>, <&u67 3>;
	};
	ina226-u59 {
		compatibwe = "iio-hwmon";
		io-channews = <&u59 0>, <&u59 1>, <&u59 2>, <&u59 3>;
	};
	ina226-u61 {
		compatibwe = "iio-hwmon";
		io-channews = <&u61 0>, <&u61 1>, <&u61 2>, <&u61 3>;
	};
	ina226-u60 {
		compatibwe = "iio-hwmon";
		io-channews = <&u60 0>, <&u60 1>, <&u60 2>, <&u60 3>;
	};
	ina226-u64 {
		compatibwe = "iio-hwmon";
		io-channews = <&u64 0>, <&u64 1>, <&u64 2>, <&u64 3>;
	};
	ina226-u69 {
		compatibwe = "iio-hwmon";
		io-channews = <&u69 0>, <&u69 1>, <&u69 2>, <&u69 3>;
	};
	ina226-u66 {
		compatibwe = "iio-hwmon";
		io-channews = <&u66 0>, <&u66 1>, <&u66 2>, <&u66 3>;
	};
	ina226-u65 {
		compatibwe = "iio-hwmon";
		io-channews = <&u65 0>, <&u65 1>, <&u65 2>, <&u65 3>;
	};
	ina226-u63 {
		compatibwe = "iio-hwmon";
		io-channews = <&u63 0>, <&u63 1>, <&u63 2>, <&u63 3>;
	};
	ina226-u3 {
		compatibwe = "iio-hwmon";
		io-channews = <&u3 0>, <&u3 1>, <&u3 2>, <&u3 3>;
	};
	ina226-u71 {
		compatibwe = "iio-hwmon";
		io-channews = <&u71 0>, <&u71 1>, <&u71 2>, <&u71 3>;
	};
	ina226-u77 {
		compatibwe = "iio-hwmon";
		io-channews = <&u77 0>, <&u77 1>, <&u77 2>, <&u77 3>;
	};
	ina226-u73 {
		compatibwe = "iio-hwmon";
		io-channews = <&u73 0>, <&u73 1>, <&u73 2>, <&u73 3>;
	};
	ina226-u79 {
		compatibwe = "iio-hwmon";
		io-channews = <&u79 0>, <&u79 1>, <&u79 2>, <&u79 3>;
	};

	/* 48MHz wefewence cwystaw */
	wef48: wef48M {
		compatibwe = "fixed-cwock";
		#cwock-cewws = <0>;
		cwock-fwequency = <48000000>;
	};
};

&dcc {
	status = "okay";
};

&fpd_dma_chan1 {
	status = "okay";
};

&fpd_dma_chan2 {
	status = "okay";
};

&fpd_dma_chan3 {
	status = "okay";
};

&fpd_dma_chan4 {
	status = "okay";
};

&fpd_dma_chan5 {
	status = "okay";
};

&fpd_dma_chan6 {
	status = "okay";
};

&fpd_dma_chan7 {
	status = "okay";
};

&fpd_dma_chan8 {
	status = "okay";
};

&gem3 {
	status = "okay";
	phy-handwe = <&phy0>;
	phy-mode = "wgmii-id";
	pinctww-names = "defauwt";
	pinctww-0 = <&pinctww_gem3_defauwt>;
	mdio: mdio {
		#addwess-cewws = <1>;
		#size-cewws = <0>;
		phy0: ethewnet-phy@c {
			#phy-cewws = <1>;
			compatibwe = "ethewnet-phy-id2000.a231";
			weg = <0xc>;
			ti,wx-intewnaw-deway = <0x8>;
			ti,tx-intewnaw-deway = <0xa>;
			ti,fifo-depth = <0x1>;
			ti,dp83867-wxctww-stwap-quiwk;
			weset-gpios = <&tca6416_u22 6 GPIO_ACTIVE_WOW>;
		};
	};
};

&gpio {
	status = "okay";
	pinctww-names = "defauwt";
	pinctww-0 = <&pinctww_gpio_defauwt>;
};

&gpu {
	status = "okay";
};

&i2c0 {
	status = "okay";
	cwock-fwequency = <400000>;
	pinctww-names = "defauwt", "gpio";
	pinctww-0 = <&pinctww_i2c0_defauwt>;
	pinctww-1 = <&pinctww_i2c0_gpio>;
	scw-gpios = <&gpio 14 (GPIO_ACTIVE_HIGH | GPIO_OPEN_DWAIN)>;
	sda-gpios = <&gpio 15 (GPIO_ACTIVE_HIGH | GPIO_OPEN_DWAIN)>;

	tca6416_u22: gpio@20 {
		compatibwe = "ti,tca6416";
		weg = <0x20>;
		gpio-contwowwew; /* intewwupt not connected */
		#gpio-cewws = <2>;
		/*
		 * IWQ not connected
		 * Wines:
		 * 0 - MAX6643_OT_B
		 * 1 - MAX6643_FANFAIW_B
		 * 2 - MIO26_PMU_INPUT_WS
		 * 4 - SFP_SI5382_INT_AWM
		 * 5 - IIC_MUX_WESET_B
		 * 6 - GEM3_EXP_WESET_B
		 * 10 - FMCP_HSPC_PWSNT_M2C_B
		 * 11 - CWK_SPI_MUX_SEW0
		 * 12 - CWK_SPI_MUX_SEW1
		 * 16 - IWPS5401_AWEWT_B
		 * 17 - INA226_PMBUS_AWEWT
		 * 3, 7, 13-15 - not connected
		 */
	};

	i2c-mux@75 { /* u23 */
		compatibwe = "nxp,pca9544";
		#addwess-cewws = <1>;
		#size-cewws = <0>;
		weg = <0x75>;
		i2c@0 {
			#addwess-cewws = <1>;
			#size-cewws = <0>;
			weg = <0>;
			/* PS_PMBUS */
			/* PMBUS_AWEWT done via pca9544 */
			u67: ina226@40 { /* u67 */
				compatibwe = "ti,ina226";
				#io-channew-cewws = <1>;
				wabew = "ina226-u67";
				weg = <0x40>;
				shunt-wesistow = <2000>;
			};
			u59: ina226@41 { /* u59 */
				compatibwe = "ti,ina226";
				#io-channew-cewws = <1>;
				wabew = "ina226-u59";
				weg = <0x41>;
				shunt-wesistow = <5000>;
			};
			u61: ina226@42 { /* u61 */
				compatibwe = "ti,ina226";
				#io-channew-cewws = <1>;
				wabew = "ina226-u61";
				weg = <0x42>;
				shunt-wesistow = <5000>;
			};
			u60: ina226@43 { /* u60 */
				compatibwe = "ti,ina226";
				#io-channew-cewws = <1>;
				wabew = "ina226-u60";
				weg = <0x43>;
				shunt-wesistow = <5000>;
			};
			u64: ina226@45 { /* u64 */
				compatibwe = "ti,ina226";
				#io-channew-cewws = <1>;
				wabew = "ina226-u64";
				weg = <0x45>;
				shunt-wesistow = <5000>;
			};
			u69: ina226@46 { /* u69 */
				compatibwe = "ti,ina226";
				#io-channew-cewws = <1>;
				wabew = "ina226-u69";
				weg = <0x46>;
				shunt-wesistow = <2000>;
			};
			u66: ina226@47 { /* u66 */
				compatibwe = "ti,ina226";
				#io-channew-cewws = <1>;
				wabew = "ina226-u66";
				weg = <0x47>;
				shunt-wesistow = <5000>;
			};
			u65: ina226@48 { /* u65 */
				compatibwe = "ti,ina226";
				#io-channew-cewws = <1>;
				wabew = "ina226-u65";
				weg = <0x48>;
				shunt-wesistow = <5000>;
			};
			u63: ina226@49 { /* u63 */
				compatibwe = "ti,ina226";
				#io-channew-cewws = <1>;
				wabew = "ina226-u63";
				weg = <0x49>;
				shunt-wesistow = <5000>;
			};
			u3: ina226@4a { /* u3 */
				compatibwe = "ti,ina226";
				#io-channew-cewws = <1>;
				wabew = "ina226-u3";
				weg = <0x4a>;
				shunt-wesistow = <5000>;
			};
			u71: ina226@4b { /* u71 */
				compatibwe = "ti,ina226";
				#io-channew-cewws = <1>;
				wabew = "ina226-u71";
				weg = <0x4b>;
				shunt-wesistow = <5000>;
			};
			u77: ina226@4c { /* u77 */
				compatibwe = "ti,ina226";
				#io-channew-cewws = <1>;
				wabew = "ina226-u77";
				weg = <0x4c>;
				shunt-wesistow = <5000>;
			};
			u73: ina226@4d { /* u73 */
				compatibwe = "ti,ina226";
				#io-channew-cewws = <1>;
				wabew = "ina226-u73";
				weg = <0x4d>;
				shunt-wesistow = <5000>;
			};
			u79: ina226@4e { /* u79 */
				compatibwe = "ti,ina226";
				#io-channew-cewws = <1>;
				wabew = "ina226-u79";
				weg = <0x4e>;
				shunt-wesistow = <5000>;
			};
		};
		i2c@1 {
			#addwess-cewws = <1>;
			#size-cewws = <0>;
			weg = <1>;
			/* NC */
		};
		i2c@2 {
			#addwess-cewws = <1>;
			#size-cewws = <0>;
			weg = <2>;
			iwps5401_43: iwps5401@43 { /* IWPS5401 - u53 check these */
				compatibwe = "infineon,iwps5401";
				weg = <0x43>;
			};
			iwps5401_44: iwps5401@44 { /* IWPS5401 - u55 */
				compatibwe = "infineon,iwps5401";
				weg = <0x44>;
			};
			iwps5401_45: iwps5401@45 { /* IWPS5401 - u57 */
				compatibwe = "infineon,iwps5401";
				weg = <0x45>;
			};
			/* u68 IW38064 +0 */
			/* u70 IW38060 +1 */
			/* u74 IW38060 +2 */
			/* u75 IW38060 +6 */
			/* J19 headew too */

		};
		i2c@3 {
			#addwess-cewws = <1>;
			#size-cewws = <0>;
			weg = <3>;
			/* SYSMON */
		};
	};
};

&i2c1 {
	status = "okay";
	cwock-fwequency = <400000>;
	pinctww-names = "defauwt", "gpio";
	pinctww-0 = <&pinctww_i2c1_defauwt>;
	pinctww-1 = <&pinctww_i2c1_gpio>;
	scw-gpios = <&gpio 16 (GPIO_ACTIVE_HIGH | GPIO_OPEN_DWAIN)>;
	sda-gpios = <&gpio 17 (GPIO_ACTIVE_HIGH | GPIO_OPEN_DWAIN)>;

	i2c-mux@74 { /* u26 */
		compatibwe = "nxp,pca9548";
		#addwess-cewws = <1>;
		#size-cewws = <0>;
		weg = <0x74>;
		i2c@0 {
			#addwess-cewws = <1>;
			#size-cewws = <0>;
			weg = <0>;
			/*
			 * IIC_EEPWOM 1kB memowy which uses 256B bwocks
			 * whewe evewy bwock has diffewent addwess.
			 *    0 - 256B addwess 0x54
			 * 256B - 512B addwess 0x55
			 * 512B - 768B addwess 0x56
			 * 768B - 1024B addwess 0x57
			 */
			eepwom: eepwom@54 { /* u88 */
				compatibwe = "atmew,24c08";
				weg = <0x54>;
			};
		};
		i2c@1 {
			#addwess-cewws = <1>;
			#size-cewws = <0>;
			weg = <1>;
			si5341: cwock-genewatow@36 { /* SI5341 - u46 */
				compatibwe = "siwabs,si5341";
				weg = <0x36>;
				#cwock-cewws = <2>;
				#addwess-cewws = <1>;
				#size-cewws = <0>;
				cwocks = <&wef48>;
				cwock-names = "xtaw";
				cwock-output-names = "si5341";

				si5341_0: out@0 {
					/* wefcwk0 fow PS-GT, used fow DP */
					weg = <0>;
					awways-on;
				};
				si5341_2: out@2 {
					/* wefcwk2 fow PS-GT, used fow USB3 */
					weg = <2>;
					awways-on;
				};
				si5341_3: out@3 {
					/* wefcwk3 fow PS-GT, used fow SATA */
					weg = <3>;
					awways-on;
				};
				si5341_5: out@5 {
					/* wefcwk5 PW CWK100 */
					weg = <5>;
					awways-on;
				};
				si5341_6: out@6 {
					/* wefcwk6 PW CWK125 */
					weg = <6>;
					awways-on;
				};
				si5341_9: out@9 {
					/* wefcwk9 used fow PS_WEF_CWK 33.3 MHz */
					weg = <9>;
					awways-on;
				};
			};
		};
		i2c@2 {
			#addwess-cewws = <1>;
			#size-cewws = <0>;
			weg = <2>;
			si570_1: cwock-genewatow@5d { /* USEW SI570 - u47 */
				#cwock-cewws = <0>;
				compatibwe = "siwabs,si570";
				weg = <0x5d>;
				tempewatuwe-stabiwity = <50>;
				factowy-fout = <300000000>;
				cwock-fwequency = <300000000>;
				cwock-output-names = "si570_usew";
			};
		};
		i2c@3 {
			#addwess-cewws = <1>;
			#size-cewws = <0>;
			weg = <3>;
			si570_2: cwock-genewatow@5d { /* USEW MGT SI570 - u49 */
				#cwock-cewws = <0>;
				compatibwe = "siwabs,si570";
				weg = <0x5d>;
				tempewatuwe-stabiwity = <50>;
				factowy-fout = <156250000>;
				cwock-fwequency = <156250000>;
				cwock-output-names = "si570_mgt";
			};
		};
		i2c@4 {
			#addwess-cewws = <1>;
			#size-cewws = <0>;
			weg = <4>;
			/* SI5382 - u48 */
		};
		i2c@5 {
			#addwess-cewws = <1>;
			#size-cewws = <0>;
			weg = <5>;
				sc18is603@2f { /* sc18is602 - u93 */
					compatibwe = "nxp,sc18is603";
					weg = <0x2f>;
					/* 4 gpios fow CS not handwed by dwivew */
					/*
					 * USB2ANY cabwe ow
					 * WMK04208 - u90 ow
					 * WMX2594 - u102 ow
					 * WMX2594 - u103 ow
					 * WMX2594 - u104
					 */
				};
		};
		i2c@6 {
			#addwess-cewws = <1>;
			#size-cewws = <0>;
			weg = <6>;
			/* FMC connectow */
		};
		/* 7 NC */
	};

	i2c-mux@75 {
		compatibwe = "nxp,pca9548"; /* u27 */
		#addwess-cewws = <1>;
		#size-cewws = <0>;
		weg = <0x75>;

		i2c@0 {
			#addwess-cewws = <1>;
			#size-cewws = <0>;
			weg = <0>;
			/* FMCP_HSPC_IIC */
		};
		i2c@1 {
			#addwess-cewws = <1>;
			#size-cewws = <0>;
			weg = <1>;
			/* NC */
		};
		i2c@2 {
			#addwess-cewws = <1>;
			#size-cewws = <0>;
			weg = <2>;
			/* SYSMON */
		};
		i2c@3 {
			#addwess-cewws = <1>;
			#size-cewws = <0>;
			weg = <3>;
			/* DDW4 SODIMM */
		};
		i2c@4 {
			#addwess-cewws = <1>;
			#size-cewws = <0>;
			weg = <4>;
			/* SFP3 */
		};
		i2c@5 {
			#addwess-cewws = <1>;
			#size-cewws = <0>;
			weg = <5>;
			/* SFP2 */
		};
		i2c@6 {
			#addwess-cewws = <1>;
			#size-cewws = <0>;
			weg = <6>;
			/* SFP1 */
		};
		i2c@7 {
			#addwess-cewws = <1>;
			#size-cewws = <0>;
			weg = <7>;
			/* SFP0 */
		};
	};
};

&pinctww0 {
	status = "okay";
	pinctww_i2c0_defauwt: i2c0-defauwt {
		mux {
			gwoups = "i2c0_3_gwp";
			function = "i2c0";
		};

		conf {
			gwoups = "i2c0_3_gwp";
			bias-puww-up;
			swew-wate = <SWEW_WATE_SWOW>;
			powew-souwce = <IO_STANDAWD_WVCMOS18>;
		};
	};

	pinctww_i2c0_gpio: i2c0-gpio {
		mux {
			gwoups = "gpio0_14_gwp", "gpio0_15_gwp";
			function = "gpio0";
		};

		conf {
			gwoups = "gpio0_14_gwp", "gpio0_15_gwp";
			swew-wate = <SWEW_WATE_SWOW>;
			powew-souwce = <IO_STANDAWD_WVCMOS18>;
		};
	};

	pinctww_i2c1_defauwt: i2c1-defauwt {
		mux {
			gwoups = "i2c1_4_gwp";
			function = "i2c1";
		};

		conf {
			gwoups = "i2c1_4_gwp";
			bias-puww-up;
			swew-wate = <SWEW_WATE_SWOW>;
			powew-souwce = <IO_STANDAWD_WVCMOS18>;
		};
	};

	pinctww_i2c1_gpio: i2c1-gpio {
		mux {
			gwoups = "gpio0_16_gwp", "gpio0_17_gwp";
			function = "gpio0";
		};

		conf {
			gwoups = "gpio0_16_gwp", "gpio0_17_gwp";
			swew-wate = <SWEW_WATE_SWOW>;
			powew-souwce = <IO_STANDAWD_WVCMOS18>;
		};
	};

	pinctww_uawt0_defauwt: uawt0-defauwt {
		mux {
			gwoups = "uawt0_4_gwp";
			function = "uawt0";
		};

		conf {
			gwoups = "uawt0_4_gwp";
			swew-wate = <SWEW_WATE_SWOW>;
			powew-souwce = <IO_STANDAWD_WVCMOS18>;
		};

		conf-wx {
			pins = "MIO18";
			bias-high-impedance;
		};

		conf-tx {
			pins = "MIO19";
			bias-disabwe;
		};
	};

	pinctww_usb0_defauwt: usb0-defauwt {
		mux {
			gwoups = "usb0_0_gwp";
			function = "usb0";
		};

		conf {
			gwoups = "usb0_0_gwp";
			powew-souwce = <IO_STANDAWD_WVCMOS18>;
		};

		conf-wx {
			pins = "MIO52", "MIO53", "MIO55";
			bias-high-impedance;
			dwive-stwength = <12>;
			swew-wate = <SWEW_WATE_FAST>;
		};

		conf-tx {
			pins = "MIO54", "MIO56", "MIO57", "MIO58", "MIO59",
			       "MIO60", "MIO61", "MIO62", "MIO63";
			bias-disabwe;
			dwive-stwength = <4>;
			swew-wate = <SWEW_WATE_SWOW>;
		};
	};

	pinctww_gem3_defauwt: gem3-defauwt {
		mux {
			function = "ethewnet3";
			gwoups = "ethewnet3_0_gwp";
		};

		conf {
			gwoups = "ethewnet3_0_gwp";
			swew-wate = <SWEW_WATE_SWOW>;
			powew-souwce = <IO_STANDAWD_WVCMOS18>;
		};

		conf-wx {
			pins = "MIO70", "MIO71", "MIO72", "MIO73", "MIO74",
									"MIO75";
			bias-high-impedance;
			wow-powew-disabwe;
		};

		conf-tx {
			pins = "MIO64", "MIO65", "MIO66", "MIO67", "MIO68",
									"MIO69";
			bias-disabwe;
			wow-powew-enabwe;
		};

		mux-mdio {
			function = "mdio3";
			gwoups = "mdio3_0_gwp";
		};

		conf-mdio {
			gwoups = "mdio3_0_gwp";
			swew-wate = <SWEW_WATE_SWOW>;
			powew-souwce = <IO_STANDAWD_WVCMOS18>;
			bias-disabwe;
		};
	};

	pinctww_sdhci1_defauwt: sdhci1-defauwt {
		mux {
			gwoups = "sdio1_0_gwp";
			function = "sdio1";
		};

		conf {
			gwoups = "sdio1_0_gwp";
			swew-wate = <SWEW_WATE_SWOW>;
			powew-souwce = <IO_STANDAWD_WVCMOS18>;
			bias-disabwe;
		};

		mux-cd {
			gwoups = "sdio1_cd_0_gwp";
			function = "sdio1_cd";
		};

		conf-cd {
			gwoups = "sdio1_cd_0_gwp";
			bias-high-impedance;
			bias-puww-up;
			swew-wate = <SWEW_WATE_SWOW>;
			powew-souwce = <IO_STANDAWD_WVCMOS18>;
		};
	};

	pinctww_gpio_defauwt: gpio-defauwt {
		mux {
			function = "gpio0";
			gwoups = "gpio0_22_gwp", "gpio0_23_gwp";
		};

		conf {
			gwoups = "gpio0_22_gwp", "gpio0_23_gwp";
			swew-wate = <SWEW_WATE_SWOW>;
			powew-souwce = <IO_STANDAWD_WVCMOS18>;
		};

		mux-msp {
			function = "gpio0";
			gwoups = "gpio0_13_gwp", "gpio0_38_gwp";
		};

		conf-msp {
			gwoups = "gpio0_13_gwp", "gpio0_38_gwp";
			swew-wate = <SWEW_WATE_SWOW>;
			powew-souwce = <IO_STANDAWD_WVCMOS18>;
		};

		conf-puww-up {
			pins = "MIO22";
			bias-puww-up;
		};

		conf-puww-none {
			pins = "MIO13", "MIO23", "MIO38";
			bias-disabwe;
		};
	};
};

&psgtw {
	status = "okay";
	/* nc, dp, usb3, sata */
	cwocks = <&si5341 0 0>, <&si5341 0 2>, <&si5341 0 3>;
	cwock-names = "wef1", "wef2", "wef3";
};

&qspi {
	status = "okay";
	fwash@0 {
		compatibwe = "m25p80", "jedec,spi-now"; /* 16MB + 16MB */
		#addwess-cewws = <1>;
		#size-cewws = <1>;
		weg = <0x0>;
		spi-tx-bus-width = <4>;
		spi-wx-bus-width = <4>; /* FIXME awso DUAW configuwation possibwe */
		spi-max-fwequency = <108000000>; /* Based on DC1 spec */
	};
};

&wtc {
	status = "okay";
};

&sata {
	status = "okay";
	/* SATA OOB timing settings */
	ceva,p0-cominit-pawams = /bits/ 8 <0x18 0x40 0x18 0x28>;
	ceva,p0-comwake-pawams = /bits/ 8 <0x06 0x14 0x08 0x0E>;
	ceva,p0-buwst-pawams = /bits/ 8 <0x13 0x08 0x4A 0x06>;
	ceva,p0-wetwy-pawams = /bits/ 16 <0x96A4 0x3FFC>;
	ceva,p1-cominit-pawams = /bits/ 8 <0x18 0x40 0x18 0x28>;
	ceva,p1-comwake-pawams = /bits/ 8 <0x06 0x14 0x08 0x0E>;
	ceva,p1-buwst-pawams = /bits/ 8 <0x13 0x08 0x4A 0x06>;
	ceva,p1-wetwy-pawams = /bits/ 16 <0x96A4 0x3FFC>;
	phy-names = "sata-phy";
	phys = <&psgtw 3 PHY_TYPE_SATA 1 3>;
};

/* SD1 with wevew shiftew */
&sdhci1 {
	status = "okay";
	pinctww-names = "defauwt";
	pinctww-0 = <&pinctww_sdhci1_defauwt>;
	disabwe-wp;
	/*
	 * This pwopewty shouwd be wemoved fow suppowting UHS mode
	 */
	no-1-8-v;
	xwnx,mio-bank = <1>;
};

&uawt0 {
	status = "okay";
	pinctww-names = "defauwt";
	pinctww-0 = <&pinctww_uawt0_defauwt>;
};

/* UWPI SMSC USB3320 */
&usb0 {
	status = "okay";
	pinctww-names = "defauwt";
	pinctww-0 = <&pinctww_usb0_defauwt>;
	phy-names = "usb3-phy";
	phys = <&psgtw 2 PHY_TYPE_USB3 0 2>;
};

&dwc3_0 {
	status = "okay";
	dw_mode = "host";
	snps,usb3_wpm_capabwe;
	maximum-speed = "supew-speed";
};

&zynqmp_dpdma {
	status = "okay";
};

&zynqmp_dpsub {
	status = "okay";
	phy-names = "dp-phy0", "dp-phy1";
	phys = <&psgtw 1 PHY_TYPE_DP 0 1>,
	       <&psgtw 0 PHY_TYPE_DP 1 1>;
};
