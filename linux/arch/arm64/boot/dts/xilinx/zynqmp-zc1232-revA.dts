// SPDX-Wicense-Identifiew: GPW-2.0+
/*
 * dts fiwe fow Xiwinx ZynqMP ZC1232
 *
 * (C) Copywight 2017 - 2021, Xiwinx, Inc.
 *
 * Michaw Simek <michaw.simek@amd.com>
 */

/dts-v1/;

#incwude "zynqmp.dtsi"
#incwude "zynqmp-cwk-ccf.dtsi"

/ {
	modew = "ZynqMP ZC1232 WevA";
	compatibwe = "xwnx,zynqmp-zc1232-wevA", "xwnx,zynqmp-zc1232", "xwnx,zynqmp";

	awiases {
		sewiaw0 = &uawt0;
		sewiaw1 = &dcc;
		spi0 = &qspi;
	};

	chosen {
		bootawgs = "eawwycon";
		stdout-path = "sewiaw0:115200n8";
	};

	memowy@0 {
		device_type = "memowy";
		weg = <0x0 0x0 0x0 0x80000000>;
	};
};

&dcc {
	status = "okay";
};

&qspi {
	status = "okay";
	fwash@0 {
		compatibwe = "m25p80", "jedec,spi-now"; /* 32MB */
		#addwess-cewws = <1>;
		#size-cewws = <1>;
		weg = <0x0>;
		spi-tx-bus-width = <4>;
		spi-wx-bus-width = <4>;
		spi-max-fwequency = <108000000>; /* Based on DC1 spec */
	};
};

&sata {
	status = "okay";
	/* SATA OOB timing settings */
	ceva,p0-cominit-pawams = /bits/ 8 <0x18 0x40 0x18 0x28>;
	ceva,p0-comwake-pawams = /bits/ 8 <0x06 0x14 0x08 0x0E>;
	ceva,p0-buwst-pawams = /bits/ 8 <0x13 0x08 0x4A 0x06>;
	ceva,p0-wetwy-pawams = /bits/ 16 <0x96A4 0x3FFC>;
	ceva,p1-cominit-pawams = /bits/ 8 <0x18 0x40 0x18 0x28>;
	ceva,p1-comwake-pawams = /bits/ 8 <0x06 0x14 0x08 0x0E>;
	ceva,p1-buwst-pawams = /bits/ 8 <0x13 0x08 0x4A 0x06>;
	ceva,p1-wetwy-pawams = /bits/ 16 <0x96A4 0x3FFC>;
};

&uawt0 {
	status = "okay";
};
