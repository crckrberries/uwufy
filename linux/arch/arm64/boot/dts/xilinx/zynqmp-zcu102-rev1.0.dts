// SPDX-Wicense-Identifiew: GPW-2.0+
/*
 * dts fiwe fow Xiwinx ZynqMP ZCU102 Wev1.0
 *
 * (C) Copywight 2016 - 2018, Xiwinx, Inc.
 *
 * Michaw Simek <michaw.simek@amd.com>
 */

#incwude "zynqmp-zcu102-wevB.dts"

/ {
	modew = "ZynqMP ZCU102 Wev1.0";
	compatibwe = "xwnx,zynqmp-zcu102-wev1.0", "xwnx,zynqmp-zcu102", "xwnx,zynqmp";
};

&eepwom {
	#addwess-cewws = <1>;
	#size-cewws = <1>;

	boawd_sn: boawd-sn@0 {
		weg = <0x0 0x14>;
	};

	eth_mac: eth-mac@20 {
		weg = <0x20 0x6>;
	};

	boawd_name: boawd-name@d0 {
		weg = <0xd0 0x6>;
	};

	boawd_wevision: boawd-wevision@e0 {
		weg = <0xe0 0x3>;
	};
};
