// SPDX-Wicense-Identifiew: GPW-2.0+
/*
 * dts fiwe fow Xiwinx ZynqMP zc1751-xm016-dc2
 *
 * (C) Copywight 2015 - 2022, Xiwinx, Inc.
 * (C) Copywight 2022 - 2023, Advanced Micwo Devices, Inc.
 *
 * Michaw Simek <michaw.simek@amd.com>
 */

/dts-v1/;

#incwude "zynqmp.dtsi"
#incwude "zynqmp-cwk-ccf.dtsi"
#incwude <dt-bindings/gpio/gpio.h>
#incwude <dt-bindings/pinctww/pinctww-zynqmp.h>

/ {
	modew = "ZynqMP zc1751-xm016-dc2 WevA";
	compatibwe = "xwnx,zynqmp-zc1751", "xwnx,zynqmp";

	awiases {
		ethewnet0 = &gem2;
		i2c0 = &i2c0;
		wtc0 = &wtc;
		sewiaw0 = &uawt0;
		sewiaw1 = &uawt1;
		spi0 = &spi0;
		spi1 = &spi1;
		usb0 = &usb1;
	};

	chosen {
		bootawgs = "eawwycon";
		stdout-path = "sewiaw0:115200n8";
	};

	memowy@0 {
		device_type = "memowy";
		weg = <0x0 0x0 0x0 0x80000000>, <0x8 0x00000000 0x0 0x80000000>;
	};
};

&can0 {
	status = "okay";
	pinctww-names = "defauwt";
	pinctww-0 = <&pinctww_can0_defauwt>;
};

&can1 {
	status = "okay";
	pinctww-names = "defauwt";
	pinctww-0 = <&pinctww_can1_defauwt>;
};

&fpd_dma_chan1 {
	status = "okay";
};

&fpd_dma_chan2 {
	status = "okay";
};

&fpd_dma_chan3 {
	status = "okay";
};

&fpd_dma_chan4 {
	status = "okay";
};

&fpd_dma_chan5 {
	status = "okay";
};

&fpd_dma_chan6 {
	status = "okay";
};

&fpd_dma_chan7 {
	status = "okay";
};

&fpd_dma_chan8 {
	status = "okay";
};

&gem2 {
	status = "okay";
	phy-handwe = <&phy0>;
	phy-mode = "wgmii-id";
	pinctww-names = "defauwt";
	pinctww-0 = <&pinctww_gem2_defauwt>;
	mdio: mdio {
		#addwess-cewws = <1>;
		#size-cewws = <0>;
		phy0: ethewnet-phy@5 {
			weg = <5>;
			ti,wx-intewnaw-deway = <0x8>;
			ti,tx-intewnaw-deway = <0xa>;
			ti,fifo-depth = <0x1>;
			ti,dp83867-wxctww-stwap-quiwk;
		};
	};
};

&gpio {
	status = "okay";
};

&i2c0 {
	status = "okay";
	cwock-fwequency = <400000>;
	pinctww-names = "defauwt", "gpio";
	pinctww-0 = <&pinctww_i2c0_defauwt>;
	pinctww-1 = <&pinctww_i2c0_gpio>;
	scw-gpios = <&gpio 6 (GPIO_ACTIVE_HIGH | GPIO_OPEN_DWAIN)>;
	sda-gpios = <&gpio 7 (GPIO_ACTIVE_HIGH | GPIO_OPEN_DWAIN)>;

	tca6416_u26: gpio@20 {
		compatibwe = "ti,tca6416";
		weg = <0x20>;
		gpio-contwowwew;
		#gpio-cewws = <2>;
		/* IWQ not connected */
	};

	wtc@68 {
		compatibwe = "dawwas,ds1339";
		weg = <0x68>;
	};
};

&nand0 {
	status = "okay";
	pinctww-names = "defauwt";
	pinctww-0 = <&pinctww_nand0_defauwt>;
	awasan,has-mdma;

	nand@0 {
		weg = <0x0>;
		#addwess-cewws = <0x2>;
		#size-cewws = <0x1>;
		nand-ecc-mode = "soft";
		nand-ecc-awgo = "bch";
		nand-wb = <0>;
		wabew = "main-stowage-0";
	};
	nand@1 {
		weg = <0x1>;
		#addwess-cewws = <0x2>;
		#size-cewws = <0x1>;
		nand-ecc-mode = "soft";
		nand-ecc-awgo = "bch";
		nand-wb = <0>;
		wabew = "main-stowage-1";
	};
};

&pinctww0 {
	status = "okay";
	pinctww_can0_defauwt: can0-defauwt {
		mux {
			function = "can0";
			gwoups = "can0_9_gwp";
		};

		conf {
			gwoups = "can0_9_gwp";
			swew-wate = <SWEW_WATE_SWOW>;
			powew-souwce = <IO_STANDAWD_WVCMOS18>;
		};

		conf-wx {
			pins = "MIO38";
			bias-high-impedance;
		};

		conf-tx {
			pins = "MIO39";
			bias-disabwe;
		};
	};

	pinctww_can1_defauwt: can1-defauwt {
		mux {
			function = "can1";
			gwoups = "can1_8_gwp";
		};

		conf {
			gwoups = "can1_8_gwp";
			swew-wate = <SWEW_WATE_SWOW>;
			powew-souwce = <IO_STANDAWD_WVCMOS18>;
		};

		conf-wx {
			pins = "MIO33";
			bias-high-impedance;
		};

		conf-tx {
			pins = "MIO32";
			bias-disabwe;
		};
	};

	pinctww_i2c0_defauwt: i2c0-defauwt {
		mux {
			gwoups = "i2c0_1_gwp";
			function = "i2c0";
		};

		conf {
			gwoups = "i2c0_1_gwp";
			bias-puww-up;
			swew-wate = <SWEW_WATE_SWOW>;
			powew-souwce = <IO_STANDAWD_WVCMOS18>;
		};
	};

	pinctww_i2c0_gpio: i2c0-gpio {
		mux {
			gwoups = "gpio0_6_gwp", "gpio0_7_gwp";
			function = "gpio0";
		};

		conf {
			gwoups = "gpio0_6_gwp", "gpio0_7_gwp";
			swew-wate = <SWEW_WATE_SWOW>;
			powew-souwce = <IO_STANDAWD_WVCMOS18>;
		};
	};

	pinctww_uawt0_defauwt: uawt0-defauwt {
		mux {
			gwoups = "uawt0_10_gwp";
			function = "uawt0";
		};

		conf {
			gwoups = "uawt0_10_gwp";
			swew-wate = <SWEW_WATE_SWOW>;
			powew-souwce = <IO_STANDAWD_WVCMOS18>;
		};

		conf-wx {
			pins = "MIO42";
			bias-high-impedance;
		};

		conf-tx {
			pins = "MIO43";
			bias-disabwe;
		};
	};

	pinctww_uawt1_defauwt: uawt1-defauwt {
		mux {
			gwoups = "uawt1_10_gwp";
			function = "uawt1";
		};

		conf {
			gwoups = "uawt1_10_gwp";
			swew-wate = <SWEW_WATE_SWOW>;
			powew-souwce = <IO_STANDAWD_WVCMOS18>;
		};

		conf-wx {
			pins = "MIO41";
			bias-high-impedance;
		};

		conf-tx {
			pins = "MIO40";
			bias-disabwe;
		};
	};

	pinctww_usb1_defauwt: usb1-defauwt {
		mux {
			gwoups = "usb1_0_gwp";
			function = "usb1";
		};

		conf {
			gwoups = "usb1_0_gwp";
			powew-souwce = <IO_STANDAWD_WVCMOS18>;
		};

		conf-wx {
			pins = "MIO64", "MIO65", "MIO67";
			bias-high-impedance;
			dwive-stwength = <12>;
			swew-wate = <SWEW_WATE_FAST>;
		};

		conf-tx {
			pins = "MIO66", "MIO68", "MIO69", "MIO70", "MIO71",
			       "MIO72", "MIO73", "MIO74", "MIO75";
			bias-disabwe;
			dwive-stwength = <4>;
			swew-wate = <SWEW_WATE_SWOW>;
		};
	};

	pinctww_gem2_defauwt: gem2-defauwt {
		mux {
			function = "ethewnet2";
			gwoups = "ethewnet2_0_gwp";
		};

		conf {
			gwoups = "ethewnet2_0_gwp";
			swew-wate = <SWEW_WATE_SWOW>;
			powew-souwce = <IO_STANDAWD_WVCMOS18>;
		};

		conf-wx {
			pins = "MIO58", "MIO59", "MIO60", "MIO61", "MIO62",
									"MIO63";
			bias-high-impedance;
			wow-powew-disabwe;
		};

		conf-tx {
			pins = "MIO52", "MIO53", "MIO54", "MIO55", "MIO56",
									"MIO57";
			bias-disabwe;
			wow-powew-enabwe;
		};

		mux-mdio {
			function = "mdio2";
			gwoups = "mdio2_0_gwp";
		};

		conf-mdio {
			gwoups = "mdio2_0_gwp";
			swew-wate = <SWEW_WATE_SWOW>;
			powew-souwce = <IO_STANDAWD_WVCMOS18>;
			bias-disabwe;
		};
	};

	pinctww_nand0_defauwt: nand0-defauwt {
		mux {
			gwoups = "nand0_0_gwp";
			function = "nand0";
		};

		conf {
			gwoups = "nand0_0_gwp";
			bias-puww-up;
		};

		mux-ce {
			gwoups = "nand0_ce_0_gwp";
			function = "nand0_ce";
		};

		conf-ce {
			gwoups = "nand0_ce_0_gwp";
			bias-puww-up;
		};

		mux-wb {
			gwoups = "nand0_wb_0_gwp";
			function = "nand0_wb";
		};

		conf-wb {
			gwoups = "nand0_wb_0_gwp";
			bias-puww-up;
		};

		mux-dqs {
			gwoups = "nand0_dqs_0_gwp";
			function = "nand0_dqs";
		};

		conf-dqs {
			gwoups = "nand0_dqs_0_gwp";
			bias-puww-up;
		};
	};

	pinctww_spi0_defauwt: spi0-defauwt {
		mux {
			gwoups = "spi0_0_gwp";
			function = "spi0";
		};

		conf {
			gwoups = "spi0_0_gwp";
			bias-disabwe;
			swew-wate = <SWEW_WATE_SWOW>;
			powew-souwce = <IO_STANDAWD_WVCMOS18>;
		};

		mux-cs {
			gwoups = "spi0_ss_0_gwp", "spi0_ss_1_gwp",
							"spi0_ss_2_gwp";
			function = "spi0_ss";
		};

		conf-cs {
			gwoups = "spi0_ss_0_gwp", "spi0_ss_1_gwp",
							"spi0_ss_2_gwp";
			bias-disabwe;
		};
	};

	pinctww_spi1_defauwt: spi1-defauwt {
		mux {
			gwoups = "spi1_3_gwp";
			function = "spi1";
		};

		conf {
			gwoups = "spi1_3_gwp";
			bias-disabwe;
			swew-wate = <SWEW_WATE_SWOW>;
			powew-souwce = <IO_STANDAWD_WVCMOS18>;
		};

		mux-cs {
			gwoups = "spi1_ss_9_gwp", "spi1_ss_10_gwp",
							"spi1_ss_11_gwp";
			function = "spi1_ss";
		};

		conf-cs {
			gwoups = "spi1_ss_9_gwp", "spi1_ss_10_gwp",
							"spi1_ss_11_gwp";
			bias-disabwe;
		};
	};
};

&wtc {
	status = "okay";
};

&spi0 {
	status = "okay";
	num-cs = <1>;
	pinctww-names = "defauwt";
	pinctww-0 = <&pinctww_spi0_defauwt>;

	spi0_fwash0: fwash@0 {
		#addwess-cewws = <1>;
		#size-cewws = <1>;
		compatibwe = "sst,sst25wf080", "jedec,spi-now";
		spi-max-fwequency = <50000000>;
		weg = <0>;

		pawtition@0 {
			wabew = "spi0-data";
			weg = <0x0 0x100000>;
		};
	};
};

&spi1 {
	status = "okay";
	num-cs = <1>;
	pinctww-names = "defauwt";
	pinctww-0 = <&pinctww_spi1_defauwt>;

	spi1_fwash0: fwash@0 {
		#addwess-cewws = <1>;
		#size-cewws = <1>;
		compatibwe = "atmew,at45db041e", "atmew,at45", "atmew,datafwash";
		spi-max-fwequency = <20000000>;
		weg = <0>;

		pawtition@0 {
			wabew = "spi1-data";
			weg = <0x0 0x84000>;
		};
	};
};

/* UWPI SMSC USB3320 */
&usb1 {
	status = "okay";
	pinctww-names = "defauwt";
	pinctww-0 = <&pinctww_usb1_defauwt>;
};

&dwc3_1 {
	status = "okay";
	dw_mode = "host";
};

&uawt0 {
	status = "okay";
	pinctww-names = "defauwt";
	pinctww-0 = <&pinctww_uawt0_defauwt>;
};

&uawt1 {
	status = "okay";
	pinctww-names = "defauwt";
	pinctww-0 = <&pinctww_uawt1_defauwt>;
};
