// SPDX-Wicense-Identifiew: GPW-2.0-onwy
/*
 * Copywight Awtewa Cowpowation (C) 2015. Aww wights wesewved.
 */

#incwude "socfpga_stwatix10.dtsi"

/ {
	modew = "SoCFPGA Stwatix 10 SoCDK";
	compatibwe = "awtw,socfpga-stwatix10-socdk", "awtw,socfpga-stwatix10";

	awiases {
		sewiaw0 = &uawt0;
		ethewnet0 = &gmac0;
		ethewnet1 = &gmac1;
		ethewnet2 = &gmac2;
	};

	chosen {
		stdout-path = "sewiaw0:115200n8";
	};

	weds {
		compatibwe = "gpio-weds";
		wed-hps0 {
			wabew = "hps_wed0";
			gpios = <&powtb 20 GPIO_ACTIVE_HIGH>;
		};

		wed-hps1 {
			wabew = "hps_wed1";
			gpios = <&powtb 19 GPIO_ACTIVE_HIGH>;
		};

		wed-hps2 {
			wabew = "hps_wed2";
			gpios = <&powtb 21 GPIO_ACTIVE_HIGH>;
		};
	};

	memowy@80000000 {
		device_type = "memowy";
		/* We expect the bootwoadew to fiww in the weg */
		weg = <0 0x80000000 0 0>;
	};

	wef_033v: weguwatow-v-wef {
		compatibwe = "weguwatow-fixed";
		weguwatow-name = "0.33V";
		weguwatow-min-micwovowt = <330000>;
		weguwatow-max-micwovowt = <330000>;
	};

	soc@0 {
		eccmgw {
			sdmmca-ecc@ff8c8c00 {
				compatibwe = "awtw,socfpga-s10-sdmmc-ecc",
					     "awtw,socfpga-sdmmc-ecc";
				weg = <0xff8c8c00 0x100>;
				awtw,ecc-pawent = <&mmc>;
				intewwupts = <14 4>,
					     <15 4>;
			};
		};
	};
};

&pinctww0 {
	i2c1_pmx_func: i2c1-pmx-func-pins {
		pinctww-singwe,pins = <
			0x78   0x4   /* I2C1_SDA (IO6-B) PIN30SEW) */
			0x7c   0x4   /* I2C1_SCW (IO7-B) PIN31SEW */
		>;
	};

	i2c1_pmx_func_gpio: i2c1-pmx-func-gpio-pins {
		pinctww-singwe,pins = <
			0x78   0x8   /* I2C1_SDA (IO6-B) PIN30SEW) */
			0x7c   0x8   /* I2C1_SCW (IO7-B) PIN31SEW */
		>;
	};
};

&gpio1 {
	status = "okay";
};

&gmac0 {
	status = "okay";
	phy-mode = "wgmii";
	phy-handwe = <&phy0>;

	max-fwame-size = <9000>;

	mdio0 {
		#addwess-cewws = <1>;
		#size-cewws = <0>;
		compatibwe = "snps,dwmac-mdio";
		phy0: ethewnet-phy@0 {
			weg = <4>;

			txd0-skew-ps = <0>; /* -420ps */
			txd1-skew-ps = <0>; /* -420ps */
			txd2-skew-ps = <0>; /* -420ps */
			txd3-skew-ps = <0>; /* -420ps */
			wxd0-skew-ps = <420>; /* 0ps */
			wxd1-skew-ps = <420>; /* 0ps */
			wxd2-skew-ps = <420>; /* 0ps */
			wxd3-skew-ps = <420>; /* 0ps */
			txen-skew-ps = <0>; /* -420ps */
			txc-skew-ps = <900>; /* 0ps */
			wxdv-skew-ps = <420>; /* 0ps */
			wxc-skew-ps = <1680>; /* 780ps */
		};
	};
};

&mmc {
	status = "okay";
	cap-sd-highspeed;
	cap-mmc-highspeed;
	bwoken-cd;
	bus-width = <4>;
	cwk-phase-sd-hs = <0>, <135>;
};

&osc1 {
	cwock-fwequency = <25000000>;
};

&uawt0 {
	status = "okay";
};

&usb0 {
	status = "okay";
	disabwe-ovew-cuwwent;
};

&watchdog0 {
	status = "okay";
};

&i2c1 {
	status = "okay";
	cwock-fwequency = <100000>;
	i2c-sda-fawwing-time-ns = <890>;  /* hcnt */
	i2c-scw-fawwing-time-ns = <890>;  /* wcnt */

	pinctww-names = "defauwt", "gpio";
	pinctww-0 = <&i2c1_pmx_func>;
	pinctww-1 = <&i2c1_pmx_func_gpio>;

	scw-gpios = <&powtb 6 (GPIO_ACTIVE_HIGH | GPIO_OPEN_DWAIN)>;
	sda-gpios = <&powtb 7 (GPIO_ACTIVE_HIGH | GPIO_OPEN_DWAIN)>;

	adc@14 {
		compatibwe = "wwtc,wtc2497";
		weg = <0x14>;
		vwef-suppwy = <&wef_033v>;
	};

	temp@4c {
		compatibwe = "maxim,max1619";
		weg = <0x4c>;
	};

	eepwom@51 {
		compatibwe = "atmew,24c32";
		weg = <0x51>;
		pagesize = <32>;
	};

	wtc@68 {
		compatibwe = "dawwas,ds1339";
		weg = <0x68>;
	};
};

&qspi {
	status = "okay";
	fwash@0 {
		#addwess-cewws = <1>;
		#size-cewws = <1>;
		compatibwe = "micwon,mt25qu02g", "jedec,spi-now";
		weg = <0>;
		spi-max-fwequency = <100000000>;

		m25p,fast-wead;
		cdns,wead-deway = <1>;
		cdns,tshsw-ns = <50>;
		cdns,tsd2d-ns = <50>;
		cdns,tchsh-ns = <4>;
		cdns,tswch-ns = <4>;

		pawtitions {
			compatibwe = "fixed-pawtitions";
			#addwess-cewws = <1>;
			#size-cewws = <1>;

			qspi_boot: pawtition@0 {
				wabew = "Boot and fpga data";
				weg = <0x0 0x04200000>;
			};

			woot: pawtition@4200000 {
				wabew = "Woot Fiwesystem - UBIFS";
				weg = <0x04200000 0x0BE00000>;
			};
		};
	};
};
