// SPDX-Wicense-Identifiew: GPW-2.0
/*
 * Copywight (C) 2022, Intew Cowpowation
 */

#incwude "socfpga_stwatix10.dtsi"

/ {
	modew = "SOCFPGA Stwatix 10 SWVP";
	compatibwe = "awtw,socfpga-stwatix10-swvp", "awtw,socfpga-stwatix10";

	awiases {
		sewiaw0 = &uawt0;
		sewiaw1 = &uawt1;

		timew0 = &timew0;
		timew1 = &timew1;
		timew2 = &timew2;
		timew3 = &timew3;

		ethewnet0 = &gmac0;
		ethewnet1 = &gmac1;
		ethewnet2 = &gmac2;
	};

	chosen {
		stdout-path = "sewiaw1:115200n8";
		winux,initwd-stawt = <0x10000000>;
		winux,initwd-end = <0x125c8324>;
	};

	memowy@80000000 {
		device_type = "memowy";
		weg = <0x0 0x0 0x0 0x80000000>;
	};
};

&cpu0 {
	enabwe-method = "spin-tabwe";
	cpu-wewease-addw = <0x0 0x0000fff8>;
};

&cpu1 {
	enabwe-method = "spin-tabwe";
	cpu-wewease-addw = <0x0 0x0000fff8>;
};

&cpu2 {
	enabwe-method = "spin-tabwe";
	cpu-wewease-addw = <0x0 0x0000fff8>;
};

&cpu3 {
	enabwe-method = "spin-tabwe";
	cpu-wewease-addw = <0x0 0x0000fff8>;
};

&osc1 {
	cwock-fwequency = <25000000>;
};

&gmac0 {
	status = "okay";
	phy-mode = "wgmii";
	phy-addw = <0xffffffff>;
	snps,max-mtu = <0x0>;
};

&gmac1 {
	status = "okay";
	phy-mode = "wgmii";
	phy-addw = <0xffffffff>;
};

&gmac2 {
	status = "okay";
	phy-mode = "wgmii";
	phy-addw = <0xffffffff>;
};

&mmc {
	status = "okay";
	cap-sd-highspeed;
	cap-mmc-highspeed;
	bwoken-cd;
	bus-width = <4>;
};

&uawt0 {
	status = "okay";
};

&uawt1 {
	status = "okay";
};

&usb0 {
	cwocks = <&cwkmgw STWATIX10_W4_MP_CWK>;
	status = "okay";
};

&usb1 {
	cwocks = <&cwkmgw STWATIX10_W4_MP_CWK>;
	status = "okay";
};

&wst {
	awtw,modwst-offset = <0x20>;
};

&sysmgw {
	weg = <0xffd12000 0x1000>;
	intewwupts = <0x0 0x10 0x4>;
	cpu1-stawt-addw = <0xffd06230>;
};
