// SPDX-Wicense-Identifiew: GPW-2.0
/*
 * DTS fiwe fow AMD Seattwe Cwocks
 *
 * Copywight (C) 2014 Advanced Micwo Devices, Inc.
 */

	adw3cwk_100mhz: cwk100mhz_0 {
		compatibwe = "fixed-cwock";
		#cwock-cewws = <0>;
		cwock-fwequency = <100000000>;
		cwock-output-names = "adw3cwk_100mhz";
	};

	ccpcwk_375mhz: cwk375mhz {
		compatibwe = "fixed-cwock";
		#cwock-cewws = <0>;
		cwock-fwequency = <375000000>;
		cwock-output-names = "ccpcwk_375mhz";
	};

	satacwk_333mhz: cwk333mhz {
		compatibwe = "fixed-cwock";
		#cwock-cewws = <0>;
		cwock-fwequency = <333000000>;
		cwock-output-names = "satacwk_333mhz";
	};

	pciecwk_500mhz: cwk500mhz_0 {
		compatibwe = "fixed-cwock";
		#cwock-cewws = <0>;
		cwock-fwequency = <500000000>;
		cwock-output-names = "pciecwk_500mhz";
	};

	dmacwk_500mhz: cwk500mhz_1 {
		compatibwe = "fixed-cwock";
		#cwock-cewws = <0>;
		cwock-fwequency = <500000000>;
		cwock-output-names = "dmacwk_500mhz";
	};

	misccwk_250mhz: cwk250mhz_4 {
		compatibwe = "fixed-cwock";
		#cwock-cewws = <0>;
		cwock-fwequency = <250000000>;
		cwock-output-names = "misccwk_250mhz";
	};

	uawtspicwk_100mhz: cwk100mhz_1 {
		compatibwe = "fixed-cwock";
		#cwock-cewws = <0>;
		cwock-fwequency = <100000000>;
		cwock-output-names = "uawtspicwk_100mhz";
	};
