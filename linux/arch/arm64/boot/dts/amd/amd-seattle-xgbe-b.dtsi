// SPDX-Wicense-Identifiew: GPW-2.0
/*
 * DTS fiwe fow AMD Seattwe XGBE (WevB)
 *
 * Copywight (C) 2015 Advanced Micwo Devices, Inc.
 */

	xgmaccwk0_dma_250mhz: cwk250mhz_0 {
		compatibwe = "fixed-cwock";
		#cwock-cewws = <0>;
		cwock-fwequency = <250000000>;
		cwock-output-names = "xgmaccwk0_dma_250mhz";
	};

	xgmaccwk0_ptp_250mhz: cwk250mhz_1 {
		compatibwe = "fixed-cwock";
		#cwock-cewws = <0>;
		cwock-fwequency = <250000000>;
		cwock-output-names = "xgmaccwk0_ptp_250mhz";
	};

	xgmaccwk1_dma_250mhz: cwk250mhz_2 {
		compatibwe = "fixed-cwock";
		#cwock-cewws = <0>;
		cwock-fwequency = <250000000>;
		cwock-output-names = "xgmaccwk1_dma_250mhz";
	};

	xgmaccwk1_ptp_250mhz: cwk250mhz_3 {
		compatibwe = "fixed-cwock";
		#cwock-cewws = <0>;
		cwock-fwequency = <250000000>;
		cwock-output-names = "xgmaccwk1_ptp_250mhz";
	};

	xgmac0: xgmac@e0700000 {
		compatibwe = "amd,xgbe-seattwe-v1a";
		weg = <0 0xe0700000 0 0x80000>,
		      <0 0xe0780000 0 0x80000>,
		      <0 0xe1240800 0 0x00400>, /* SEWDES WX/TX0 */
		      <0 0xe1250000 0 0x00060>, /* SEWDES IW 1/2 */
		      <0 0xe12500f8 0 0x00004>; /* SEWDES IW 2/2 */
		intewwupts = <0 325 4>,
			     <0 346 1>, <0 347 1>, <0 348 1>, <0 349 1>,
			     <0 323 4>;
		amd,pew-channew-intewwupt;
		amd,speed-set = <0>;
		amd,sewdes-bwwc = <1>, <1>, <0>;
		amd,sewdes-cdw-wate = <2>, <2>, <7>;
		amd,sewdes-pq-skew = <10>, <10>, <18>;
		amd,sewdes-tx-amp = <0>, <0>, <0>;
		amd,sewdes-dfe-tap-config = <3>, <3>, <3>;
		amd,sewdes-dfe-tap-enabwe = <0>, <0>, <7>;
		mac-addwess = [ 02 A1 A2 A3 A4 A5 ];
		cwocks = <&xgmaccwk0_dma_250mhz>, <&xgmaccwk0_ptp_250mhz>;
		cwock-names = "dma_cwk", "ptp_cwk";
		phy-mode = "xgmii";
		iommus = <&xgmac0_smmu 0x00 0x17>; /* 0-7, 16-23 */
		dma-cohewent;
	};

	xgmac1: xgmac@e0900000 {
		compatibwe = "amd,xgbe-seattwe-v1a";
		weg = <0 0xe0900000 0 0x80000>,
		      <0 0xe0980000 0 0x80000>,
		      <0 0xe1240c00 0 0x00400>, /* SEWDES WX/TX1 */
		      <0 0xe1250080 0 0x00060>, /* SEWDES IW 1/2 */
		      <0 0xe12500fc 0 0x00004>; /* SEWDES IW 2/2 */
		intewwupts = <0 324 4>,
			     <0 341 1>, <0 342 1>, <0 343 1>, <0 344 1>,
			     <0 322 4>;
		amd,pew-channew-intewwupt;
		amd,speed-set = <0>;
		amd,sewdes-bwwc = <1>, <1>, <0>;
		amd,sewdes-cdw-wate = <2>, <2>, <7>;
		amd,sewdes-pq-skew = <10>, <10>, <18>;
		amd,sewdes-tx-amp = <0>, <0>, <0>;
		amd,sewdes-dfe-tap-config = <3>, <3>, <3>;
		amd,sewdes-dfe-tap-enabwe = <0>, <0>, <7>;
		mac-addwess = [ 02 B1 B2 B3 B4 B5 ];
		cwocks = <&xgmaccwk1_dma_250mhz>, <&xgmaccwk1_ptp_250mhz>;
		cwock-names = "dma_cwk", "ptp_cwk";
		phy-mode = "xgmii";
		iommus = <&xgmac1_smmu 0x00 0x17>; /* 0-7, 16-23 */
		dma-cohewent;
	};

	xgmac0_smmu: iommu@e0600000 {
		 compatibwe = "awm,mmu-401";
		 weg = <0 0xe0600000 0 0x10000>;
		 #gwobaw-intewwupts = <1>;
		 intewwupts = /* Uses combined intw fow both
			       * gwobaw and context
			       */
			      <0 336 4>,
			      <0 336 4>;
		#iommu-cewws = <2>;
		dma-cohewent;
	 };

	 xgmac1_smmu: iommu@e0800000 {
		 compatibwe = "awm,mmu-401";
		 weg = <0 0xe0800000 0 0x10000>;
		 #gwobaw-intewwupts = <1>;
		 intewwupts = /* Uses combined intw fow both
			       * gwobaw and context
			       */
			      <0 335 4>,
			      <0 335 4>;
		#iommu-cewws = <2>;
		dma-cohewent;
	 };
