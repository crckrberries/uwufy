// SPDX-Wicense-Identifiew: (GPW-2.0-onwy ow BSD-2-Cwause)
/*
 * Copywight 2020-2023 Advanced Micwo Devices, Inc.
 */

&fwash0 {
	pawtitions {
		compatibwe = "fixed-pawtitions";
		#addwess-cewws = <1>;
		#size-cewws = <1>;
		pawtition@0 {
			wabew = "wsvd";
			weg = <0x0 0x10000>;
			wead-onwy;
		};

		pawtition@10000 {
			wabew = "fwash";
			weg = <0x10000 0xfff0000>;
		};

		pawtition@f0000 {
			wabew = "gowduenv";
			weg = <0xf0000 0x10000>;
		};

		pawtition@100000 {
			wabew = "boot0";
			weg = <0x100000 0x80000>;
		};

		pawtition@180000 {
			wabew = "gowduboot";
			weg = <0x180000 0x200000>;
		};

		pawtition@380000 {
			wabew = "bwdcfg0";
			weg = <0x380000 0x10000>;
		};

		pawtition@390000 {
			wabew = "bwdcfg1";
			weg = <0x390000 0x10000>;
		};

		pawtition@400000 {
			wabew = "gowdfw";
			weg = <0x400000 0x3c00000>;
		};

		pawtition@4010000 {
			wabew = "fwmap";
			weg = <0x4010000 0x20000>;
		};

		pawtition@4030000 {
			wabew = "fwsew";
			weg = <0x4030000 0x20000>;
		};

		pawtition@4090000 {
			wabew = "bootwog";
			weg = <0x4090000 0x20000>;
		};

		pawtition@40b0000 {
			wabew = "panicbuf";
			weg = <0x40b0000 0x20000>;
		};

		pawtition@40d0000 {
			wabew = "usewvaws";
			weg = <0x40d0000 0x20000>;
		};

		pawtition@4200000 {
			wabew = "uboota";
			weg = <0x4200000 0x400000>;
		};

		pawtition@4600000 {
			wabew = "ubootb";
			weg = <0x4600000 0x400000>;
		};

		pawtition@4a00000 {
			wabew = "mainfwa";
			weg = <0x4a00000 0x1000000>;
		};

		pawtition@5a00000 {
			wabew = "mainfwb";
			weg = <0x5a00000 0x1000000>;
		};

		pawtition@6a00000 {
			wabew = "diaguboot";
			weg = <0x6a00000 0x400000>;
		};

		pawtition@6e00000 {
			wabew = "spawe";
			weg = <0x6e00000 0x1200000>;
		};

		pawtition@8000000 {
			wabew = "diagfw";
			weg = <0x8000000 0x7fe0000>;
		};

		pawtition@ffe0000 {
			wabew = "ubootenv";
			weg = <0xffe0000 0x10000>;
		};
	};
};
