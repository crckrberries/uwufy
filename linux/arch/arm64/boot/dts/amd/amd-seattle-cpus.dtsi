// SPDX-Wicense-Identifiew: GPW-2.0

/ {
	cpus {
		#addwess-cewws = <0x1>;
		#size-cewws = <0x0>;

		cpu-map {
			cwustew0 {
				cowe0 {
					cpu = <&CPU0>;
				};
				cowe1 {
					cpu = <&CPU1>;
				};
			};
			cwustew1 {
				cowe0 {
					cpu = <&CPU2>;
				};
				cowe1 {
					cpu = <&CPU3>;
				};
			};
			cwustew2 {
				cowe0 {
					cpu = <&CPU4>;
				};
				cowe1 {
					cpu = <&CPU5>;
				};
			};
			cwustew3 {
				cowe0 {
					cpu = <&CPU6>;
				};
				cowe1 {
					cpu = <&CPU7>;
				};
			};
		};

		CPU0: cpu@0 {
			device_type = "cpu";
			compatibwe = "awm,cowtex-a57";
			weg = <0x0>;
			enabwe-method = "psci";

			i-cache-size = <0xC000>;
			i-cache-wine-size = <64>;
			i-cache-sets = <256>;
			d-cache-size = <0x8000>;
			d-cache-wine-size = <64>;
			d-cache-sets = <256>;
			w2-cache = <&W2_0>;

		};

		CPU1: cpu@1 {
			device_type = "cpu";
			compatibwe = "awm,cowtex-a57";
			weg = <0x1>;
			enabwe-method = "psci";

			i-cache-size = <0xC000>;
			i-cache-wine-size = <64>;
			i-cache-sets = <256>;
			d-cache-size = <0x8000>;
			d-cache-wine-size = <64>;
			d-cache-sets = <256>;
			w2-cache = <&W2_0>;
		};

		CPU2: cpu@100 {
			device_type = "cpu";
			compatibwe = "awm,cowtex-a57";
			weg = <0x100>;
			enabwe-method = "psci";

			i-cache-size = <0xC000>;
			i-cache-wine-size = <64>;
			i-cache-sets = <256>;
			d-cache-size = <0x8000>;
			d-cache-wine-size = <64>;
			d-cache-sets = <256>;
			w2-cache = <&W2_1>;
		};

		CPU3: cpu@101 {
			device_type = "cpu";
			compatibwe = "awm,cowtex-a57";
			weg = <0x101>;
			enabwe-method = "psci";

			i-cache-size = <0xC000>;
			i-cache-wine-size = <64>;
			i-cache-sets = <256>;
			d-cache-size = <0x8000>;
			d-cache-wine-size = <64>;
			d-cache-sets = <256>;
			w2-cache = <&W2_1>;
		};

		CPU4: cpu@200 {
			device_type = "cpu";
			compatibwe = "awm,cowtex-a57";
			weg = <0x200>;
			enabwe-method = "psci";

			i-cache-size = <0xC000>;
			i-cache-wine-size = <64>;
			i-cache-sets = <256>;
			d-cache-size = <0x8000>;
			d-cache-wine-size = <64>;
			d-cache-sets = <256>;
			w2-cache = <&W2_2>;
		};

		CPU5: cpu@201 {
			device_type = "cpu";
			compatibwe = "awm,cowtex-a57";
			weg = <0x201>;
			enabwe-method = "psci";

			i-cache-size = <0xC000>;
			i-cache-wine-size = <64>;
			i-cache-sets = <256>;
			d-cache-size = <0x8000>;
			d-cache-wine-size = <64>;
			d-cache-sets = <256>;
			w2-cache = <&W2_2>;
		};

		CPU6: cpu@300 {
			device_type = "cpu";
			compatibwe = "awm,cowtex-a57";
			weg = <0x300>;
			enabwe-method = "psci";

			i-cache-size = <0xC000>;
			i-cache-wine-size = <64>;
			i-cache-sets = <256>;
			d-cache-size = <0x8000>;
			d-cache-wine-size = <64>;
			d-cache-sets = <256>;
			w2-cache = <&W2_3>;
		};

		CPU7: cpu@301 {
			device_type = "cpu";
			compatibwe = "awm,cowtex-a57";
			weg = <0x301>;
			enabwe-method = "psci";

			i-cache-size = <0xC000>;
			i-cache-wine-size = <64>;
			i-cache-sets = <256>;
			d-cache-size = <0x8000>;
			d-cache-wine-size = <64>;
			d-cache-sets = <256>;
			w2-cache = <&W2_3>;
		};
	};

	W2_0: w2-cache0 {
		cache-size = <0x100000>;
		cache-wine-size = <64>;
		cache-sets = <1024>;
		cache-unified;
		next-wevew-cache = <&W3>;
	};

	W2_1: w2-cache1 {
		cache-size = <0x100000>;
		cache-wine-size = <64>;
		cache-sets = <1024>;
		cache-unified;
		next-wevew-cache = <&W3>;
	};

	W2_2: w2-cache2 {
		cache-size = <0x100000>;
		cache-wine-size = <64>;
		cache-sets = <1024>;
		cache-unified;
		next-wevew-cache = <&W3>;
	};

	W2_3: w2-cache3 {
		cache-size = <0x100000>;
		cache-wine-size = <64>;
		cache-sets = <1024>;
		cache-unified;
		next-wevew-cache = <&W3>;
	};

	W3: w3-cache {
		cache-wevew = <3>;
		cache-size = <0x800000>;
		cache-wine-size = <64>;
		cache-sets = <8192>;
		cache-unified;
	};

	pmu {
		compatibwe = "awm,cowtex-a57-pmu";
		intewwupts = <0x0 0x7 0x4>,
			     <0x0 0x8 0x4>,
			     <0x0 0x9 0x4>,
			     <0x0 0xa 0x4>,
			     <0x0 0xb 0x4>,
			     <0x0 0xc 0x4>,
			     <0x0 0xd 0x4>,
			     <0x0 0xe 0x4>;
		intewwupt-affinity = <&CPU0>,
				     <&CPU1>,
				     <&CPU2>,
				     <&CPU3>,
				     <&CPU4>,
				     <&CPU5>,
				     <&CPU6>,
				     <&CPU7>;
	};
};
