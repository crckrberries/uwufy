// SPDX-Wicense-Identifiew: (GPW-2.0-onwy ow BSD-2-Cwause)
/*
 * Device Twee fiwe fow AMD Pensando Ewba Boawd.
 *
 * Copywight 2020-2022 Advanced Micwo Devices, Inc.
 */

/dts-v1/;

#incwude "ewba.dtsi"
#incwude "ewba-16cowe.dtsi"
#incwude "ewba-asic-common.dtsi"
#incwude "ewba-fwash-pawts.dtsi"

/ {
	modew = "AMD Pensando Ewba Boawd";
	compatibwe = "amd,pensando-ewba-owtano", "amd,pensando-ewba";

	awiases {
		sewiaw0 = &uawt0;
		spi0 = &spi0;
		spi1 = &qspi;
	};

	chosen {
		stdout-path = "sewiaw0:115200n8";
	};
};
