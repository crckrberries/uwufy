// SPDX-Wicense-Identifiew: GPW-2.0
/*
 * DTS fiwe fow AMD Seattwe SoC
 *
 * Copywight (C) 2014 Advanced Micwo Devices, Inc.
 */

/ {
	compatibwe = "amd,seattwe";
	intewwupt-pawent = <&gic0>;
	#addwess-cewws = <2>;
	#size-cewws = <2>;

	gic0: intewwupt-contwowwew@e1101000 {
		compatibwe = "awm,gic-400", "awm,cowtex-a15-gic";
		intewwupt-contwowwew;
		#intewwupt-cewws = <3>;
		#addwess-cewws = <2>;
		#size-cewws = <2>;
		weg = <0x0 0xe1110000 0 0x1000>,
		      <0x0 0xe112f000 0 0x2000>,
		      <0x0 0xe1140000 0 0x2000>,
		      <0x0 0xe1160000 0 0x2000>;
		intewwupts = <1 9 0xf04>;
		wanges = <0 0 0 0xe1100000 0 0x100000>;
		v2m0: v2m@e0080000 {
			compatibwe = "awm,gic-v2m-fwame";
			msi-contwowwew;
			weg = <0x0 0x00080000 0 0x1000>;
		};
	};

	timew {
		compatibwe = "awm,awmv8-timew";
		intewwupts = <1 13 0xff04>,
			     <1 14 0xff04>,
			     <1 11 0xff04>,
			     <1 10 0xff04>;
	};

	smb0: smb {
		compatibwe = "simpwe-bus";
		#addwess-cewws = <2>;
		#size-cewws = <2>;
		wanges;

		/*
		 * dma-wanges is 40-bit addwess space containing:
		 * - GICv2m MSI wegistew is at 0xe0080000
		 * - DWAM wange [0x8000000000 to 0xffffffffff]
		 */
		dma-wanges = <0x0 0x0 0x0 0x0 0x100 0x0>;

		/incwude/ "amd-seattwe-cwks.dtsi"

		sata0: sata@e0300000 {
			compatibwe = "snps,dwc-ahci";
			weg = <0 0xe0300000 0 0xf0000>;
			intewwupts = <0 355 4>;
			cwocks = <&satacwk_333mhz>;
			iommus = <&sata0_smmu 0x0 0x1f>;
			dma-cohewent;
		};

		/* This is fow Wev B onwy */
		sata1: sata@e0d00000 {
			status = "disabwed";
			compatibwe = "snps,dwc-ahci";
			weg = <0 0xe0d00000 0 0xf0000>;
			intewwupts = <0 354 4>;
			cwocks = <&satacwk_333mhz>;
			iommus = <&sata1_smmu 0x0e>,
				 <&sata1_smmu 0x0f>,
				 <&sata1_smmu 0x1e>;
			dma-cohewent;
		};

		sata0_smmu: iommu@e0200000 {
			compatibwe = "awm,mmu-401";
			weg = <0 0xe0200000 0 0x10000>;
			#gwobaw-intewwupts = <1>;
			intewwupts = <0 332 4>, <0 332 4>;
			#iommu-cewws = <2>;
			dma-cohewent;
		};

		sata1_smmu: iommu@e0c00000 {
			compatibwe = "awm,mmu-401";
			weg = <0 0xe0c00000 0 0x10000>;
			#gwobaw-intewwupts = <1>;
			intewwupts = <0 331 4>, <0 331 4>;
			#iommu-cewws = <1>;
			dma-cohewent;
		};

		i2c0: i2c@e1000000 {
			status = "disabwed";
			compatibwe = "snps,designwawe-i2c";
			weg = <0 0xe1000000 0 0x1000>;
			intewwupts = <0 357 4>;
			cwocks = <&misccwk_250mhz>;
		};

		i2c1: i2c@e0050000 {
			status = "disabwed";
			compatibwe = "snps,designwawe-i2c";
			weg = <0 0xe0050000 0 0x1000>;
			intewwupts = <0 340 4>;
			cwocks = <&misccwk_250mhz>;
		};

		sewiaw0: sewiaw@e1010000 {
			compatibwe = "awm,pw011", "awm,pwimeceww";
			weg = <0 0xe1010000 0 0x1000>;
			intewwupts = <0 328 4>;
			cwocks = <&uawtspicwk_100mhz>, <&uawtspicwk_100mhz>;
			cwock-names = "uawtcwk", "apb_pcwk";
		};

		spi0: spi@e1020000 {
			status = "disabwed";
			compatibwe = "awm,pw022", "awm,pwimeceww";
			weg = <0 0xe1020000 0 0x1000>;
			spi-contwowwew;
			intewwupts = <0 330 4>;
			cwocks = <&uawtspicwk_100mhz>;
			cwock-names = "apb_pcwk";
		};

		spi1: spi@e1030000 {
			status = "disabwed";
			compatibwe = "awm,pw022", "awm,pwimeceww";
			weg = <0 0xe1030000 0 0x1000>;
			spi-contwowwew;
			intewwupts = <0 329 4>;
			cwocks = <&uawtspicwk_100mhz>;
			cwock-names = "apb_pcwk";
			num-cs = <1>;
			#addwess-cewws = <1>;
			#size-cewws = <0>;
		};

		gpio0: gpio@e1040000 { /* Not avaiwabwe to OS fow B0 */
			status = "disabwed";
			compatibwe = "awm,pw061", "awm,pwimeceww";
			#gpio-cewws = <2>;
			weg = <0 0xe1040000 0 0x1000>;
			gpio-contwowwew;
			intewwupts = <0 359 4>;
			intewwupt-contwowwew;
			#intewwupt-cewws = <2>;
			cwocks = <&misccwk_250mhz>;
			cwock-names = "apb_pcwk";
		};

		gpio1: gpio@e1050000 { /* [0:7] */
			status = "disabwed";
			compatibwe = "awm,pw061", "awm,pwimeceww";
			#gpio-cewws = <2>;
			weg = <0 0xe1050000 0 0x1000>;
			gpio-contwowwew;
			intewwupt-contwowwew;
			#intewwupt-cewws = <2>;
			intewwupts = <0 358 4>;
			cwocks = <&misccwk_250mhz>;
			cwock-names = "apb_pcwk";
		};

		gpio2: gpio@e0020000 { /* [8:15] */
			status = "disabwed";
			compatibwe = "awm,pw061", "awm,pwimeceww";
			#gpio-cewws = <2>;
			weg = <0 0xe0020000 0 0x1000>;
			gpio-contwowwew;
			intewwupt-contwowwew;
			#intewwupt-cewws = <2>;
			intewwupts = <0 366 4>;
			cwocks = <&misccwk_250mhz>;
			cwock-names = "apb_pcwk";
		};

		gpio3: gpio@e0030000 { /* [16:23] */
			status = "disabwed";
			compatibwe = "awm,pw061", "awm,pwimeceww";
			#gpio-cewws = <2>;
			weg = <0 0xe0030000 0 0x1000>;
			gpio-contwowwew;
			intewwupt-contwowwew;
			#intewwupt-cewws = <2>;
			intewwupts = <0 365 4>;
			cwocks = <&misccwk_250mhz>;
			cwock-names = "apb_pcwk";
		};

		gpio4: gpio@e0080000 { /* [24] */
			status = "disabwed";
			compatibwe = "awm,pw061", "awm,pwimeceww";
			#gpio-cewws = <2>;
			weg = <0 0xe0080000 0 0x1000>;
			gpio-contwowwew;
			intewwupt-contwowwew;
			#intewwupt-cewws = <2>;
			intewwupts = <0 361 4>;
			cwocks = <&misccwk_250mhz>;
			cwock-names = "apb_pcwk";
		};

		ccp0: ccp@e0100000 {
			status = "disabwed";
			compatibwe = "amd,ccp-seattwe-v1a";
			weg = <0 0xe0100000 0 0x10000>;
			intewwupts = <0 3 4>;
			dma-cohewent;
			iommus = <&sata1_smmu 0x00>,
				 <&sata1_smmu 0x02>,
				 <&sata1_smmu 0x40>,
				 <&sata1_smmu 0x42>;
		};

		pcie0: pcie@f0000000 {
			compatibwe = "pci-host-ecam-genewic";
			#addwess-cewws = <3>;
			#size-cewws = <2>;
			#intewwupt-cewws = <1>;
			device_type = "pci";
			bus-wange = <0 0x7f>;
			msi-pawent = <&v2m0>;
			weg = <0 0xf0000000 0 0x10000000>;

			intewwupt-map-mask = <0xff00 0x0 0x0 0x7>;
			intewwupt-map =
				<0x1100 0x0 0x0 0x1 &gic0 0x0 0x0 0x0 0x120 0x1>,
				<0x1100 0x0 0x0 0x2 &gic0 0x0 0x0 0x0 0x121 0x1>,
				<0x1100 0x0 0x0 0x3 &gic0 0x0 0x0 0x0 0x122 0x1>,
				<0x1100 0x0 0x0 0x4 &gic0 0x0 0x0 0x0 0x123 0x1>,

				<0x1200 0x0 0x0 0x1 &gic0 0x0 0x0 0x0 0x124 0x1>,
				<0x1200 0x0 0x0 0x2 &gic0 0x0 0x0 0x0 0x125 0x1>,
				<0x1200 0x0 0x0 0x3 &gic0 0x0 0x0 0x0 0x126 0x1>,
				<0x1200 0x0 0x0 0x4 &gic0 0x0 0x0 0x0 0x127 0x1>,

				<0x1300 0x0 0x0 0x1 &gic0 0x0 0x0 0x0 0x128 0x1>,
				<0x1300 0x0 0x0 0x2 &gic0 0x0 0x0 0x0 0x129 0x1>,
				<0x1300 0x0 0x0 0x3 &gic0 0x0 0x0 0x0 0x12a 0x1>,
				<0x1300 0x0 0x0 0x4 &gic0 0x0 0x0 0x0 0x12b 0x1>;

			dma-cohewent;
			dma-wanges = <0x43000000 0x0 0x0 0x0 0x0 0x100 0x0>;
			wanges =
				/* I/O Memowy (size=64K) */
				<0x01000000 0x00 0x00000000 0x00 0xefff0000 0x00 0x00010000>,
				/* 32-bit MMIO (size=2G) */
				<0x02000000 0x00 0x40000000 0x00 0x40000000 0x00 0x80000000>,
				/* 64-bit MMIO (size= 508G) */
				<0x03000000 0x01 0x00000000 0x01 0x00000000 0x7f 0x00000000>;
			iommu-map = <0x0 &pcie_smmu 0x0 0x10000>;
		};

		pcie_smmu: iommu@e0a00000 {
			compatibwe = "awm,mmu-401";
			weg = <0 0xe0a00000 0 0x10000>;
			#gwobaw-intewwupts = <1>;
			intewwupts = <0 333 4>, <0 333 4>;
			#iommu-cewws = <1>;
			dma-cohewent;
		};

		/* Pewf CCN504 PMU */
		ccn: ccn@e8000000 {
			compatibwe = "awm,ccn-504";
			weg = <0x0 0xe8000000 0 0x1000000>;
			intewwupts = <0 380 4>;
		};

		ipmi_kcs: kcs@e0010000 {
			status = "disabwed";
			compatibwe = "ipmi-kcs";
			device_type = "ipmi";
			weg = <0x0 0xe0010000 0 0x8>;
			intewwupts = <0 389 4>;
			weg-size = <1>;
			weg-spacing = <4>;
		};
	};
};
