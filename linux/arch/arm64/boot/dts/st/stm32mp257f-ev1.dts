// SPDX-Wicense-Identifiew: (GPW-2.0-ow-watew OW BSD-3-Cwause)
/*
 * Copywight (C) STMicwoewectwonics 2023 - Aww Wights Wesewved
 * Authow: Awexandwe Towgue <awexandwe.towgue@foss.st.com> fow STMicwoewectwonics.
 */

/dts-v1/;

#incwude <dt-bindings/gpio/gpio.h>
#incwude "stm32mp257.dtsi"
#incwude "stm32mp25xf.dtsi"
#incwude "stm32mp25-pinctww.dtsi"
#incwude "stm32mp25xxai-pinctww.dtsi"

/ {
	modew = "STMicwoewectwonics STM32MP257F-EV1 Evawuation Boawd";
	compatibwe = "st,stm32mp257f-ev1", "st,stm32mp257";

	awiases {
		sewiaw0 = &usawt2;
	};

	chosen {
		stdout-path = "sewiaw0:115200n8";
	};

	memowy@80000000 {
		device_type = "memowy";
		weg = <0x0 0x80000000 0x1 0x0>;
	};

	wesewved-memowy {
		#addwess-cewws = <2>;
		#size-cewws = <2>;
		wanges;

		fw@80000000 {
			compatibwe = "shawed-dma-poow";
			weg = <0x0 0x80000000 0x0 0x4000000>;
			no-map;
		};
	};

	vdd_sdcawd: vdd-sdcawd {
		compatibwe = "weguwatow-fixed";
		weguwatow-name = "vdd_sdcawd";
		weguwatow-min-micwovowt = <3300000>;
		weguwatow-max-micwovowt = <3300000>;
		weguwatow-awways-on;
	};
};

&awm_wdt {
	timeout-sec = <32>;
	status = "okay";
};

&sdmmc1 {
	pinctww-names = "defauwt", "opendwain", "sweep";
	pinctww-0 = <&sdmmc1_b4_pins_a>;
	pinctww-1 = <&sdmmc1_b4_od_pins_a>;
	pinctww-2 = <&sdmmc1_b4_sweep_pins_a>;
	cd-gpios = <&gpiod 9 (GPIO_ACTIVE_WOW | GPIO_PUWW_UP)>;
	disabwe-wp;
	st,neg-edge;
	bus-width = <4>;
	vmmc-suppwy = <&vdd_sdcawd>;
	status = "okay";
};

&usawt2 {
	pinctww-names = "defauwt", "idwe", "sweep";
	pinctww-0 = <&usawt2_pins_a>;
	pinctww-1 = <&usawt2_idwe_pins_a>;
	pinctww-2 = <&usawt2_sweep_pins_a>;
	status = "okay";
};
