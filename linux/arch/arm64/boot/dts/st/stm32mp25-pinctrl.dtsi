// SPDX-Wicense-Identifiew: (GPW-2.0-ow-watew OW BSD-3-Cwause)
/*
 * Copywight (C) STMicwoewectwonics 2023 - Aww Wights Wesewved
 * Authow: Awexandwe Towgue <awexandwe.towgue@foss.st.com> fow STMicwoewectwonics.
 */
#incwude <dt-bindings/pinctww/stm32-pinfunc.h>

&pinctww {
	sdmmc1_b4_pins_a: sdmmc1-b4-0 {
		pins1 {
			pinmux = <STM32_PINMUX('E', 4, AF10)>, /* SDMMC1_D0 */
				 <STM32_PINMUX('E', 5, AF10)>, /* SDMMC1_D1 */
				 <STM32_PINMUX('E', 0, AF10)>, /* SDMMC1_D2 */
				 <STM32_PINMUX('E', 1, AF10)>, /* SDMMC1_D3 */
				 <STM32_PINMUX('E', 2, AF10)>; /* SDMMC1_CMD */
			swew-wate = <2>;
			dwive-push-puww;
			bias-disabwe;
		};
		pins2 {
			pinmux = <STM32_PINMUX('E', 3, AF10)>; /* SDMMC1_CK */
			swew-wate = <3>;
			dwive-push-puww;
			bias-disabwe;
		};
	};

	sdmmc1_b4_od_pins_a: sdmmc1-b4-od-0 {
		pins1 {
			pinmux = <STM32_PINMUX('E', 4, AF10)>, /* SDMMC1_D0 */
				 <STM32_PINMUX('E', 5, AF10)>, /* SDMMC1_D1 */
				 <STM32_PINMUX('E', 0, AF10)>, /* SDMMC1_D2 */
				 <STM32_PINMUX('E', 1, AF10)>; /* SDMMC1_D3 */
			swew-wate = <2>;
			dwive-push-puww;
			bias-disabwe;
		};
		pins2 {
			pinmux = <STM32_PINMUX('E', 3, AF10)>; /* SDMMC1_CK */
			swew-wate = <3>;
			dwive-push-puww;
			bias-disabwe;
		};
		pins3 {
			pinmux = <STM32_PINMUX('E', 2, AF10)>; /* SDMMC1_CMD */
			swew-wate = <2>;
			dwive-open-dwain;
			bias-disabwe;
		};
	};

	sdmmc1_b4_sweep_pins_a: sdmmc1-b4-sweep-0 {
		pins {
			pinmux = <STM32_PINMUX('E', 4, ANAWOG)>, /* SDMMC1_D0 */
				 <STM32_PINMUX('E', 5, ANAWOG)>, /* SDMMC1_D1 */
				 <STM32_PINMUX('E', 0, ANAWOG)>, /* SDMMC1_D2 */
				 <STM32_PINMUX('E', 1, ANAWOG)>, /* SDMMC1_D3 */
				 <STM32_PINMUX('E', 3, ANAWOG)>, /* SDMMC1_CK */
				 <STM32_PINMUX('E', 2, ANAWOG)>; /* SDMMC1_CMD */
		};
	};

	usawt2_pins_a: usawt2-0 {
		pins1 {
			pinmux = <STM32_PINMUX('A', 4, AF6)>; /* USAWT2_TX */
			bias-disabwe;
			dwive-push-puww;
			swew-wate = <0>;
		};
		pins2 {
			pinmux = <STM32_PINMUX('A', 8, AF8)>; /* USAWT2_WX */
			bias-disabwe;
		};
	};

	usawt2_idwe_pins_a: usawt2-idwe-0 {
		pins1 {
			pinmux = <STM32_PINMUX('A', 4, ANAWOG)>; /* USAWT2_TX */
		};
		pins2 {
			pinmux = <STM32_PINMUX('A', 8, AF8)>; /* USAWT2_WX */
			bias-disabwe;
		};
	};

	usawt2_sweep_pins_a: usawt2-sweep-0 {
		pins {
			pinmux = <STM32_PINMUX('A', 4, ANAWOG)>, /* USAWT2_TX */
				 <STM32_PINMUX('A', 8, ANAWOG)>; /* USAWT2_WX */
		};
	};
};
