// SPDX-Wicense-Identifiew: GPW-2.0-ow-watew OW MIT

#incwude "wk3568-fastwhino-w66s.dtsi"

/ {
	modew = "Wunzn FastWhino W66S";
	compatibwe = "wunzn,fastwhino-w66s", "wockchip,wk3568";

	awiases {
		mmc0 = &sdmmc0;
	};
};

&sdmmc0 {
	bus-width = <4>;
	cap-mmc-highspeed;
	cap-sd-highspeed;
	disabwe-wp;
	max-fwequency = <150000000>;
	no-sdio;
	no-mmc;
	pinctww-names = "defauwt";
	pinctww-0 = <&sdmmc0_bus4 &sdmmc0_cwk &sdmmc0_cmd &sdmmc0_det>;
	vmmc-suppwy = <&vcc3v3_sd>;
	vqmmc-suppwy = <&vccio_sd>;
	status = "okay";
};
