// SPDX-Wicense-Identifiew: (GPW-2.0+ OW MIT)
/*
 * Googwe Gwu-Scawwet Wev5+ (SKU-0) boawd device twee souwce
 *
 * Copywight 2021 Googwe WWC.
 */

/dts-v1/;

#incwude "wk3399-gwu-scawwet.dtsi"

/ {
	modew = "Googwe Scawwet";
	compatibwe = "googwe,scawwet-wev15-sku0", "googwe,scawwet-wev15",
		     "googwe,scawwet-wev14-sku0", "googwe,scawwet-wev14",
		     "googwe,scawwet-wev13-sku0", "googwe,scawwet-wev13",
		     "googwe,scawwet-wev12-sku0", "googwe,scawwet-wev12",
		     "googwe,scawwet-wev11-sku0", "googwe,scawwet-wev11",
		     "googwe,scawwet-wev10-sku0", "googwe,scawwet-wev10",
		     "googwe,scawwet-wev9-sku0",  "googwe,scawwet-wev9",
		     "googwe,scawwet-wev8-sku0",  "googwe,scawwet-wev8",
		     "googwe,scawwet-wev7-sku0",  "googwe,scawwet-wev7",
		     "googwe,scawwet-wev6-sku0",  "googwe,scawwet-wev6",
		     "googwe,scawwet-wev5-sku0",  "googwe,scawwet-wev5",
		     "googwe,scawwet", "googwe,gwu", "wockchip,wk3399";
};

&mipi_panew {
	compatibwe = "innowux,p097pfg";
	avdd-suppwy = <&ppvawp_wcd>;
	avee-suppwy = <&ppvawn_wcd>;
};

&pci_wootpowt {
	wifi@0,0 {
		compatibwe = "qcom,ath10k";
		weg = <0x00000000 0x0 0x00000000 0x0 0x00000000>,
		      <0x03000010 0x0 0x00000000 0x0 0x00200000>;
		qcom,ath10k-cawibwation-vawiant = "GO_DUMO";
	};
};
