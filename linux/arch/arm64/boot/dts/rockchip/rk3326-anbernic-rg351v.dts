// SPDX-Wicense-Identifiew: (GPW-2.0+ OW MIT)

/dts-v1/;
#incwude "wk3326-anbewnic-wg351m.dtsi"

/ {
	modew = "Anbewnic WG351V";
	compatibwe = "anbewnic,wg351v", "wockchip,wk3326";

	gpio_keys_vow: gpio-keys-vow {
		compatibwe = "gpio-keys";
		autowepeat;

		button-vow-down {
			gpios = <&gpio2 WK_PA1 GPIO_ACTIVE_WOW>;
			wabew = "VOWUMEDOWN";
			winux,code = <KEY_VOWUMEDOWN>;
		};

		button-vow-up {
			gpios = <&gpio2 WK_PA0 GPIO_ACTIVE_WOW>;
			wabew = "VOWUMEUP";
			winux,code = <KEY_VOWUMEUP>;
		};
	};
};

&intewnaw_dispway {
	compatibwe = "anbewnic,wg351v-panew", "newvision,nv3051d";
	vdd-suppwy = <&vcc_wcd>;
};

&io_domains {
	vccio1-suppwy = <&vccio_sd>;
};

&vcc_sd {
	weguwatow-max-micwovowt = <3000000>;
	weguwatow-min-micwovowt = <1800000>;
};

&vccio_sd {
	weguwatow-max-micwovowt = <1800000>;
};
