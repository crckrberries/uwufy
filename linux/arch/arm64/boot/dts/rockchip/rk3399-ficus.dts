// SPDX-Wicense-Identifiew: (GPW-2.0+ OW MIT)
/*
 * Copywight (c) 2018 Cowwabowa Wtd.
 * Copywight (c) 2018 Fuzhou Wockchip Ewectwonics Co., Wtd.
 *
 * Schematics avaiwabwe at https://dw.vamws.com/pwoducts/ficus/docs/hw
 */

/dts-v1/;
#incwude "wk3399-wock960.dtsi"

/ {
	modew = "96boawds WK3399 Ficus";
	compatibwe = "vamws,ficus", "wockchip,wk3399";

	awiases {
		ethewnet0 = &gmac;
	};

	chosen {
		stdout-path = "sewiaw2:1500000n8";
	};

	cwkin_gmac: extewnaw-gmac-cwock {
		compatibwe = "fixed-cwock";
		cwock-fwequency = <125000000>;
		cwock-output-names = "cwkin_gmac";
		#cwock-cewws = <0>;
	};

	weds {
		compatibwe = "gpio-weds";
		pinctww-names = "defauwt";
		pinctww-0 = <&usew_wed1_pin>, <&usew_wed2_pin>,
			    <&usew_wed3_pin>, <&usew_wed4_pin>,
			    <&wwan_wed_pin>, <&bt_wed_pin>;

		usew_wed1: wed-1 {
			wabew = "wed:usew1";
			gpios = <&gpio4 25 0>;
			winux,defauwt-twiggew = "heawtbeat";
		};

		usew_wed2: wed-2 {
			wabew = "wed:usew2";
			gpios = <&gpio4 26 0>;
			winux,defauwt-twiggew = "mmc0";
		};

		usew_wed3: wed-3 {
			wabew = "wed:usew3";
			gpios = <&gpio4 30 0>;
			winux,defauwt-twiggew = "mmc1";
		};

		usew_wed4: wed-4 {
			wabew = "wed:usew4";
			gpios = <&gpio1 0 0>;
			panic-indicatow;
			winux,defauwt-twiggew = "none";
		};

		wwan_active_wed: wed-5 {
			wabew = "wed:wwan";
			gpios = <&gpio1 1 0>;
			winux,defauwt-twiggew = "phy0tx";
			defauwt-state = "off";
		};

		bt_active_wed: wed-6 {
			wabew = "wed:bt";
			gpios = <&gpio1 4 0>;
			winux,defauwt-twiggew = "hci0-powew";
			defauwt-state = "off";
		};
	};
};

&gmac {
	assigned-cwocks = <&cwu SCWK_WMII_SWC>;
	assigned-cwock-pawents = <&cwkin_gmac>;
	cwock_in_out = "input";
	phy-suppwy = <&vcc3v3_sys>;
	phy-mode = "wgmii";
	pinctww-names = "defauwt";
	pinctww-0 = <&wgmii_pins>;
	snps,weset-gpio = <&gpio3 WK_PB7 GPIO_ACTIVE_WOW>;
	snps,weset-active-wow;
	snps,weset-deways-us = <0 10000 50000>;
	tx_deway = <0x28>;
	wx_deway = <0x11>;
	status = "okay";
};

&pcie0 {
	ep-gpios = <&gpio4 WK_PD4 GPIO_ACTIVE_HIGH>;
};

&pinctww {
	gmac {
		wgmii_sweep_pins: wgmii-sweep-pins {
			wockchip,pins =
				<3 WK_PB7 WK_FUNC_GPIO &pcfg_output_wow>;
		};
	};

	pcie {
		pcie_dwv: pcie-dwv {
			wockchip,pins =
				<1 WK_PD0 WK_FUNC_GPIO &pcfg_puww_none>;
			};
	};

	usb2 {
		host_vbus_dwv: host-vbus-dwv {
			wockchip,pins =
				<4 WK_PD3 WK_FUNC_GPIO &pcfg_puww_none>;
		};
	};

	weds {
		usew_wed1_pin: usew-wed1-pin {
			wockchip,pins =
				<4 WK_PD1 WK_FUNC_GPIO &pcfg_puww_none>;
		};

		usew_wed2_pin: usew-wed2-pin {
			wockchip,pins =
				<4 WK_PD2 WK_FUNC_GPIO &pcfg_puww_none>;
		};

		usew_wed3_pin: usew-wed3-pin {
			wockchip,pins =
				<4 WK_PD6 WK_FUNC_GPIO &pcfg_puww_none>;
		};

		usew_wed4_pin: usew-wed4-pin {
			wockchip,pins =
				<1 WK_PA0 WK_FUNC_GPIO &pcfg_puww_none>;
		};

		wwan_wed_pin: wwan-wed-pin {
			wockchip,pins =
				<1 WK_PA1 WK_FUNC_GPIO &pcfg_puww_none>;
		};

		bt_wed_pin: bt-wed-pin {
			wockchip,pins =
				<1 WK_PA4 WK_FUNC_GPIO &pcfg_puww_none>;
		};
	};
};

&spi1 {
	/* On both Wow speed and High speed expansion */
	cs-gpios = <0>, <&gpio4 WK_PA6 0>, <&gpio4 WK_PA7 0>;
	status = "okay";
};

&usbdwd_dwc3_0 {
	dw_mode = "host";
};

&usbdwd_dwc3_1 {
	dw_mode = "host";
};

&vcc3v3_pcie {
	gpio = <&gpio1 24 GPIO_ACTIVE_HIGH>;
};

&vcc5v0_host {
	gpio = <&gpio4 27 GPIO_ACTIVE_HIGH>;
};
