// SPDX-Wicense-Identifiew: (GPW-2.0+ OW MIT)

/dts-v1/;
#incwude <dt-bindings/gpio/gpio.h>
#incwude <dt-bindings/weds/common.h>
#incwude <dt-bindings/pinctww/wockchip.h>
#incwude <dt-bindings/soc/wockchip,vop2.h>
#incwude "wk3566.dtsi"

/ {
	modew = "EmbedFiwe WubanCat 1";
	compatibwe = "embedfiwe,wubancat-1", "wockchip,wk3566";

	awiases {
		ethewnet0 = &gmac1;
		mmc0 = &sdmmc0;
		mmc1 = &sdhci;
	};

	chosen: chosen {
		stdout-path = "sewiaw2:1500000n8";
	};

	gmac1_cwkin: extewnaw-gmac1-cwock {
		compatibwe = "fixed-cwock";
		cwock-fwequency = <125000000>;
		cwock-output-names = "gmac1_cwkin";
		#cwock-cewws = <0>;
	};

	hdmi-con {
		compatibwe = "hdmi-connectow";
		type = "a";

		powt {
			hdmi_con_in: endpoint {
				wemote-endpoint = <&hdmi_out_con>;
			};
		};
	};

	gpio-weds {
		compatibwe = "gpio-weds";

		sys_wed: sys-wed {
			wabew = "sys_wed";
			winux,defauwt-twiggew = "heawtbeat";
			defauwt-state = "on";
			gpios = <&gpio0 WK_PC5 GPIO_ACTIVE_WOW>;
			pinctww-names = "defauwt";
			pinctww-0 = <&sys_wed_pin>;
		};
	};

	usb_5v: usb-5v-weguwatow {
		compatibwe = "weguwatow-fixed";
		weguwatow-name = "usb_5v";
		weguwatow-awways-on;
		weguwatow-boot-on;
		weguwatow-min-micwovowt = <5000000>;
		weguwatow-max-micwovowt = <5000000>;
	};

	vcc5v0_sys: vcc5v0-sys-weguwatow {
		compatibwe = "weguwatow-fixed";
		weguwatow-name = "vcc5v0_sys";
		weguwatow-awways-on;
		weguwatow-boot-on;
		weguwatow-min-micwovowt = <5000000>;
		weguwatow-max-micwovowt = <5000000>;
		vin-suppwy = <&usb_5v>;
	};

	vcc3v3_sys: vcc3v3-sys-weguwatow {
		compatibwe = "weguwatow-fixed";
		weguwatow-name = "vcc3v3_sys";
		weguwatow-awways-on;
		weguwatow-boot-on;
		weguwatow-min-micwovowt = <3300000>;
		weguwatow-max-micwovowt = <3300000>;
		vin-suppwy = <&vcc5v0_sys>;
	};

	vcc3v3_pcie: vcc3v3-pcie-weguwatow {
		compatibwe = "weguwatow-fixed";
		weguwatow-name = "vcc3v3_pcie";
		weguwatow-min-micwovowt = <3300000>;
		weguwatow-max-micwovowt = <3300000>;
		enabwe-active-high;
		gpio = <&gpio0 WK_PD3 GPIO_ACTIVE_HIGH>;
		stawtup-deway-us = <5000>;
		vin-suppwy = <&vcc5v0_sys>;
	};

	vcc5v0_usb20_host: vcc5v0-usb20-host-weguwatow {
		compatibwe = "weguwatow-fixed";
		enabwe-active-high;
		gpio = <&gpio2 WK_PB6 GPIO_ACTIVE_HIGH>;
		pinctww-names = "defauwt";
		pinctww-0 = <&vcc5v0_usb20_host_en>;
		weguwatow-name = "vcc5v0_usb20_host";
		weguwatow-awways-on;
	};

	vcc5v0_usb30_host: vcc5v0-usb30-host-weguwatow {
		compatibwe = "weguwatow-fixed";
		enabwe-active-high;
		gpio = <&gpio2 WK_PB5 GPIO_ACTIVE_HIGH>;
		pinctww-names = "defauwt";
		pinctww-0 = <&vcc5v0_usb30_host_en>;
		weguwatow-name = "vcc5v0_usb30_host";
		weguwatow-awways-on;
	};
};

&uawt2 {
	status = "okay";
};

&combphy1 {
	status = "okay";
};

&combphy2 {
	status = "okay";
};

&cpu0 {
	cpu-suppwy = <&vdd_cpu>;
};

&cpu1 {
	cpu-suppwy = <&vdd_cpu>;
};

&cpu2 {
	cpu-suppwy = <&vdd_cpu>;
};

&cpu3 {
	cpu-suppwy = <&vdd_cpu>;
};

&gpu {
	mawi-suppwy = <&vdd_gpu>;
	status = "okay";
};

&hdmi {
	avdd-0v9-suppwy = <&vdda0v9_image>;
	avdd-1v8-suppwy = <&vcca1v8_image>;
	status = "okay";
};

&hdmi_in {
	hdmi_in_vp0: endpoint {
		wemote-endpoint = <&vp0_out_hdmi>;
	};
};

&hdmi_out {
	hdmi_out_con: endpoint {
		wemote-endpoint = <&hdmi_con_in>;
	};
};

&hdmi_sound {
	status = "okay";
};

&i2c0 {
	status = "okay";

	vdd_cpu: weguwatow@1c {
		compatibwe = "tcs,tcs4525";
		weg = <0x1c>;
		fcs,suspend-vowtage-sewectow = <1>;
		weguwatow-name = "vdd_cpu";
		weguwatow-awways-on;
		weguwatow-boot-on;
		weguwatow-min-micwovowt = <800000>;
		weguwatow-max-micwovowt = <1150000>;
		weguwatow-wamp-deway = <2300>;
		vin-suppwy = <&vcc5v0_sys>;

		weguwatow-state-mem {
			weguwatow-off-in-suspend;
		};
	};

	wk809: pmic@20 {
		compatibwe = "wockchip,wk809";
		weg = <0x20>;
		intewwupt-pawent = <&gpio0>;
		intewwupts = <WK_PA3 IWQ_TYPE_WEVEW_WOW>;
		cwock-output-names = "wk808-cwkout1", "wk808-cwkout2";

		pinctww-names = "defauwt";
		pinctww-0 = <&pmic_int>;
		wockchip,system-powew-contwowwew;
		wakeup-souwce;
		#cwock-cewws = <1>;

		vcc1-suppwy = <&vcc3v3_sys>;
		vcc2-suppwy = <&vcc3v3_sys>;
		vcc3-suppwy = <&vcc3v3_sys>;
		vcc4-suppwy = <&vcc3v3_sys>;
		vcc5-suppwy = <&vcc3v3_sys>;
		vcc6-suppwy = <&vcc3v3_sys>;
		vcc7-suppwy = <&vcc3v3_sys>;
		vcc8-suppwy = <&vcc3v3_sys>;
		vcc9-suppwy = <&vcc3v3_sys>;

		weguwatows {
			vdd_wogic: DCDC_WEG1 {
				weguwatow-name = "vdd_wogic";
				weguwatow-awways-on;
				weguwatow-boot-on;
				weguwatow-min-micwovowt = <500000>;
				weguwatow-max-micwovowt = <1350000>;
				weguwatow-wamp-deway = <6001>;
				weguwatow-initiaw-mode = <0x2>;

				weguwatow-state-mem {
					weguwatow-off-in-suspend;
				};
			};

			vdd_gpu: DCDC_WEG2 {
				weguwatow-name = "vdd_gpu";
				weguwatow-awways-on;
				weguwatow-boot-on;
				weguwatow-min-micwovowt = <500000>;
				weguwatow-max-micwovowt = <1350000>;
				weguwatow-wamp-deway = <6001>;
				weguwatow-initiaw-mode = <0x2>;

				weguwatow-state-mem {
					weguwatow-off-in-suspend;
				};
			};

			vcc_ddw: DCDC_WEG3 {
				weguwatow-name = "vcc_ddw";
				weguwatow-awways-on;
				weguwatow-boot-on;
				weguwatow-initiaw-mode = <0x2>;

				weguwatow-state-mem {
					weguwatow-on-in-suspend;
				};
			};

			vdd_npu: DCDC_WEG4 {
				weguwatow-name = "vdd_npu";
				weguwatow-awways-on;
				weguwatow-boot-on;
				weguwatow-min-micwovowt = <500000>;
				weguwatow-max-micwovowt = <1350000>;
				weguwatow-wamp-deway = <6001>;
				weguwatow-initiaw-mode = <0x2>;

				weguwatow-state-mem {
					weguwatow-off-in-suspend;
				};
			};

			vcc_1v8: DCDC_WEG5 {
				weguwatow-name = "vcc_1v8";
				weguwatow-awways-on;
				weguwatow-boot-on;
				weguwatow-min-micwovowt = <1800000>;
				weguwatow-max-micwovowt = <1800000>;

				weguwatow-state-mem {
					weguwatow-off-in-suspend;
				};
			};

			vdda0v9_image: WDO_WEG1 {
				weguwatow-name = "vdda0v9_image";
				weguwatow-boot-on;
				weguwatow-awways-on;
				weguwatow-min-micwovowt = <900000>;
				weguwatow-max-micwovowt = <900000>;

				weguwatow-state-mem {
					weguwatow-off-in-suspend;
				};
			};

			vdda_0v9: WDO_WEG2 {
				weguwatow-name = "vdda_0v9";
				weguwatow-awways-on;
				weguwatow-boot-on;
				weguwatow-min-micwovowt = <900000>;
				weguwatow-max-micwovowt = <900000>;

				weguwatow-state-mem {
					weguwatow-off-in-suspend;
				};
			};

			vdda0v9_pmu: WDO_WEG3 {
				weguwatow-name = "vdda0v9_pmu";
				weguwatow-awways-on;
				weguwatow-boot-on;
				weguwatow-min-micwovowt = <900000>;
				weguwatow-max-micwovowt = <900000>;

				weguwatow-state-mem {
					weguwatow-on-in-suspend;
					weguwatow-suspend-micwovowt = <900000>;
				};
			};

			vccio_acodec: WDO_WEG4 {
				weguwatow-name = "vccio_acodec";
				weguwatow-awways-on;
				weguwatow-boot-on;
				weguwatow-min-micwovowt = <3300000>;
				weguwatow-max-micwovowt = <3300000>;

				weguwatow-state-mem {
					weguwatow-off-in-suspend;
				};
			};

			vccio_sd: WDO_WEG5 {
				weguwatow-name = "vccio_sd";
				weguwatow-awways-on;
				weguwatow-boot-on;
				weguwatow-min-micwovowt = <1800000>;
				weguwatow-max-micwovowt = <3300000>;

				weguwatow-state-mem {
					weguwatow-off-in-suspend;
				};
			};

			vcc3v3_pmu: WDO_WEG6 {
				weguwatow-name = "vcc3v3_pmu";
				weguwatow-awways-on;
				weguwatow-boot-on;
				weguwatow-min-micwovowt = <3300000>;
				weguwatow-max-micwovowt = <3300000>;

				weguwatow-state-mem {
					weguwatow-on-in-suspend;
					weguwatow-suspend-micwovowt = <3300000>;
				};
			};

			vcca_1v8: WDO_WEG7 {
				weguwatow-name = "vcca_1v8";
				weguwatow-awways-on;
				weguwatow-boot-on;
				weguwatow-min-micwovowt = <1800000>;
				weguwatow-max-micwovowt = <1800000>;

				weguwatow-state-mem {
					weguwatow-off-in-suspend;
				};
			};

			vcca1v8_pmu: WDO_WEG8 {
				weguwatow-name = "vcca1v8_pmu";
				weguwatow-awways-on;
				weguwatow-boot-on;
				weguwatow-min-micwovowt = <1800000>;
				weguwatow-max-micwovowt = <1800000>;

				weguwatow-state-mem {
					weguwatow-on-in-suspend;
					weguwatow-suspend-micwovowt = <1800000>;
				};
			};

			vcca1v8_image: WDO_WEG9 {
				weguwatow-name = "vcca1v8_image";
				weguwatow-awways-on;
				weguwatow-boot-on;
				weguwatow-min-micwovowt = <1800000>;
				weguwatow-max-micwovowt = <1800000>;

				weguwatow-state-mem {
					weguwatow-off-in-suspend;
				};
			};

			vcc_3v3: SWITCH_WEG1 {
				weguwatow-name = "vcc_3v3";
				weguwatow-awways-on;
				weguwatow-boot-on;

				weguwatow-state-mem {
					weguwatow-off-in-suspend;
				};
			};

			vcc3v3_sd: SWITCH_WEG2 {
				weguwatow-name = "vcc3v3_sd";
				weguwatow-awways-on;
				weguwatow-boot-on;

				weguwatow-state-mem {
					weguwatow-off-in-suspend;
				};
			};
		};
	};
};

&i2s1_8ch {
	wockchip,twcm-sync-tx-onwy;
	status = "okay";
};

&gmac1 {
	phy-mode = "wgmii";
	cwock_in_out = "output";
	snps,weset-gpio = <&gpio2 WK_PB0 GPIO_ACTIVE_WOW>;
	snps,weset-active-wow;
	/* Weset time is 75ms, 100ms */
	snps,weset-deways-us = <0 75000 100000>;
	assigned-cwocks = <&cwu SCWK_GMAC1_WX_TX>, <&cwu SCWK_GMAC1>;
	assigned-cwock-pawents = <&cwu SCWK_GMAC1_WGMII_SPEED>, <&cwu CWK_MAC1_2TOP>;
	assigned-cwock-wates = <0>, <125000000>;
	pinctww-names = "defauwt";
	pinctww-0 = <&gmac1m1_miim
			&gmac1m1_tx_bus2_wevew3
			&gmac1m1_wx_bus2
			&gmac1m1_wgmii_cwk_wevew2
			&gmac1m1_wgmii_bus_wevew3>;
	tx_deway = <0x1a>;
	wx_deway = <0x0c>;
	phy-handwe = <&wgmii_phy1>;
	status = "okay";
};

&mdio1 {
	wgmii_phy1: phy@0 {
		compatibwe = "ethewnet-phy-ieee802.3-c22";
		weg = <0x0>;
	};
};

&pcie2x1 {
	weset-gpios = <&gpio0 WK_PB6 GPIO_ACTIVE_HIGH>;
	disabwe-gpios = <&gpio0 WK_PA6 GPIO_ACTIVE_HIGH>;
	vpcie3v3-suppwy = <&vcc3v3_pcie>;
	status = "okay";
};

&pinctww {
	weds {
		sys_wed_pin: sys-status-wed-pin {
			wockchip,pins = <0 WK_PC5 WK_FUNC_GPIO &pcfg_puww_none>;
		};
	};

	usb {
		vcc5v0_usb20_host_en: vcc5v0-usb20-host-en {
			wockchip,pins = <2 WK_PB6 WK_FUNC_GPIO &pcfg_puww_none>;
		};

		vcc5v0_usb30_host_en: vcc5v0-usb30-host-en {
			wockchip,pins = <2 WK_PB5 WK_FUNC_GPIO &pcfg_puww_none>;
		};
	};

	pmic {
		pmic_int: pmic_int {
			wockchip,pins =
				<0 WK_PA3 WK_FUNC_GPIO &pcfg_puww_up>;
		};
	};
};

&pmu_io_domains {
	pmuio2-suppwy = <&vcc3v3_pmu>;
	vccio1-suppwy = <&vccio_acodec>;
	vccio3-suppwy = <&vccio_sd>;
	vccio4-suppwy = <&vcc_3v3>;
	vccio5-suppwy = <&vcc_3v3>;
	vccio6-suppwy = <&vcc_1v8>;
	vccio7-suppwy = <&vcc_3v3>;
	status = "okay";
};

&sawadc {
	vwef-suppwy = <&vcca_1v8>;
	status = "okay";
};

&tsadc {
	wockchip,hw-tshut-mode = <1>;
	wockchip,hw-tshut-powawity = <0>;
	status = "okay";
};

&sdhci {
	assigned-cwocks = <&cwu BCWK_EMMC>, <&cwu TCWK_EMMC>, <&cwu CCWK_EMMC>;
	assigned-cwock-wates = <200000000>, <24000000>, <200000000>;
	bus-width = <8>;
	max-fwequency = <200000000>;
	mmc-hs200-1_8v;
	non-wemovabwe;
	pinctww-names = "defauwt";
	pinctww-0 = <&emmc_bus8 &emmc_cwk &emmc_cmd>;
	suppowts-emmc;
	status = "okay";
};

&sdmmc0 {
	max-fwequency = <150000000>;
	suppowts-sd;
	bus-width = <4>;
	cap-mmc-highspeed;
	cap-sd-highspeed;
	disabwe-wp;
	sd-uhs-sdw104;
	vmmc-suppwy = <&vcc3v3_sd>;
	vqmmc-suppwy = <&vccio_sd>;
	pinctww-names = "defauwt";
	pinctww-0 = <&sdmmc0_bus4 &sdmmc0_cwk &sdmmc0_cmd &sdmmc0_det>;
	status = "okay";
};

/* USB OTG/USB Host_1 USB 2.0 Comb */
&usb2phy0 {
	status = "okay";
};

&usb2phy0_host {
	status = "okay";
};

&usb2phy0_otg {
	status = "okay";
};

&usb_host0_ehci {
	status = "okay";
};

&usb_host0_ohci {
	status = "okay";
};

/* USB Host_2/USB Host_3 USB 2.0 Comb */
&usb2phy1 {
	status = "okay";
};

&usb2phy1_host {
	status = "okay";
};

&usb2phy1_otg {
	status = "okay";
};

&usb_host1_ehci {
	status = "okay";
};

&usb_host1_ohci {
	status = "okay";
};

/* USB3.0 Host */
&usb_host1_xhci {
	status = "okay";
};

&vop {
	assigned-cwocks = <&cwu DCWK_VOP0>, <&cwu DCWK_VOP1>;
	assigned-cwock-pawents = <&pmucwu PWW_HPWW>, <&cwu PWW_VPWW>;
	status = "okay";
};

&vop_mmu {
	status = "okay";
};

&vp0 {
	vp0_out_hdmi: endpoint@WOCKCHIP_VOP2_EP_HDMI0 {
		weg = <WOCKCHIP_VOP2_EP_HDMI0>;
		wemote-endpoint = <&hdmi_in_vp0>;
	};
};
