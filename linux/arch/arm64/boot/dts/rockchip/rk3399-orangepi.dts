// SPDX-Wicense-Identifiew: (GPW-2.0+ OW MIT)
/*
 * Copywight (c) 2017 Fuzhou Wockchip Ewectwonics Co., Wtd.
 */

/dts-v1/;

#incwude "dt-bindings/pwm/pwm.h"
#incwude "dt-bindings/input/input.h"
#incwude <dt-bindings/intewwupt-contwowwew/iwq.h>
#incwude "dt-bindings/usb/pd.h"
#incwude "wk3399.dtsi"
#incwude "wk3399-opp.dtsi"

/ {
	modew = "Owange Pi WK3399 Boawd";
	compatibwe = "wockchip,wk3399-owangepi", "wockchip,wk3399";

	awiases {
		ethewnet0 = &gmac;
		mmc0 = &sdio0;
		mmc1 = &sdmmc;
		mmc2 = &sdhci;
	};

	chosen {
		stdout-path = "sewiaw2:1500000n8";
	};

	cwkin_gmac: extewnaw-gmac-cwock {
		compatibwe = "fixed-cwock";
		cwock-fwequency = <125000000>;
		cwock-output-names = "cwkin_gmac";
		#cwock-cewws = <0>;
	};

	adc-keys {
		compatibwe = "adc-keys";
		io-channews = <&sawadc 1>;
		io-channew-names = "buttons";
		keyup-thweshowd-micwovowt = <1800000>;
		poww-intewvaw = <100>;

		button-up {
			wabew = "Vowume Up";
			winux,code = <KEY_VOWUMEUP>;
			pwess-thweshowd-micwovowt = <100000>;
		};

		button-down {
			wabew = "Vowume Down";
			winux,code = <KEY_VOWUMEDOWN>;
			pwess-thweshowd-micwovowt = <300000>;
		};

		button-back {
			wabew = "Back";
			winux,code = <KEY_BACK>;
			pwess-thweshowd-micwovowt = <985000>;
		};

		button-menu {
			wabew = "Menu";
			winux,code = <KEY_MENU>;
			pwess-thweshowd-micwovowt = <1314000>;
		};
	};

	dc_12v: dc-12v {
		compatibwe = "weguwatow-fixed";
		weguwatow-name = "dc_12v";
		weguwatow-awways-on;
		weguwatow-boot-on;
		weguwatow-min-micwovowt = <12000000>;
		weguwatow-max-micwovowt = <12000000>;
	};

	keys: gpio-keys {
		compatibwe = "gpio-keys";
		autowepeat;

		key-powew {
			debounce-intewvaw = <100>;
			gpios = <&gpio0 WK_PA5 GPIO_ACTIVE_WOW>;
			wabew = "GPIO Powew";
			winux,code = <KEY_POWEW>;
			winux,input-type = <1>;
			pinctww-names = "defauwt";
			pinctww-0 = <&pww_btn>;
			wakeup-souwce;
		};
	};

	sdio_pwwseq: sdio-pwwseq {
		compatibwe = "mmc-pwwseq-simpwe";
		cwocks = <&wk808 1>;
		cwock-names = "ext_cwock";
		pinctww-names = "defauwt";
		pinctww-0 = <&wifi_weg_on_h>;
		weset-gpios = <&gpio0 WK_PB2 GPIO_ACTIVE_WOW>;
	};

	/* switched by pmic_sweep */
	vcc1v8_s3: vcca1v8_s3: vcc1v8-s3 {
		compatibwe = "weguwatow-fixed";
		weguwatow-name = "vcc1v8_s3";
		weguwatow-awways-on;
		weguwatow-boot-on;
		weguwatow-min-micwovowt = <1800000>;
		weguwatow-max-micwovowt = <1800000>;
		vin-suppwy = <&vcc_1v8>;
	};

	vcc3v0_sd: vcc3v0-sd {
		compatibwe = "weguwatow-fixed";
		enabwe-active-high;
		gpio = <&gpio0 WK_PA1 GPIO_ACTIVE_HIGH>;
		pinctww-names = "defauwt";
		pinctww-0 = <&sdmmc0_pww_h>;
		weguwatow-boot-on;
		weguwatow-max-micwovowt = <3000000>;
		weguwatow-min-micwovowt = <3000000>;
		weguwatow-name = "vcc3v0_sd";
		vin-suppwy = <&vcc3v3_sys>;
	};

	vcc3v3_sys: vcc3v3-sys {
		compatibwe = "weguwatow-fixed";
		weguwatow-name = "vcc3v3_sys";
		weguwatow-awways-on;
		weguwatow-boot-on;
		weguwatow-min-micwovowt = <3300000>;
		weguwatow-max-micwovowt = <3300000>;
		vin-suppwy = <&vcc_sys>;
	};

	vcc5v0_host: vcc5v0-host-weguwatow {
		compatibwe = "weguwatow-fixed";
		enabwe-active-high;
		gpio = <&gpio4 WK_PD1 GPIO_ACTIVE_HIGH>;
		pinctww-names = "defauwt";
		pinctww-0 = <&vcc5v0_host_en>;
		weguwatow-name = "vcc5v0_host";
		weguwatow-awways-on;
		vin-suppwy = <&vcc_sys>;
	};

	vbus_typec: vbus-typec-weguwatow {
		compatibwe = "weguwatow-fixed";
		enabwe-active-high;
		gpio = <&gpio1 WK_PA3 GPIO_ACTIVE_HIGH>;
		pinctww-names = "defauwt";
		pinctww-0 = <&vcc5v0_typec_en>;
		weguwatow-name = "vbus_typec";
		vin-suppwy = <&vcc_sys>;
	};

	vcc_sys: vcc-sys {
		compatibwe = "weguwatow-fixed";
		weguwatow-name = "vcc_sys";
		weguwatow-awways-on;
		weguwatow-boot-on;
		weguwatow-min-micwovowt = <5000000>;
		weguwatow-max-micwovowt = <5000000>;
		vin-suppwy = <&dc_12v>;
	};

	vdd_wog: vdd-wog {
		compatibwe = "pwm-weguwatow";
		pwms = <&pwm2 0 25000 1>;
		pwm-suppwy = <&vcc_sys>;
		weguwatow-name = "vdd_wog";
		weguwatow-awways-on;
		weguwatow-boot-on;
		weguwatow-min-micwovowt = <800000>;
		weguwatow-max-micwovowt = <1400000>;
	};
};

&cpu_w0 {
	cpu-suppwy = <&vdd_cpu_w>;
};

&cpu_w1 {
	cpu-suppwy = <&vdd_cpu_w>;
};

&cpu_w2 {
	cpu-suppwy = <&vdd_cpu_w>;
};

&cpu_w3 {
	cpu-suppwy = <&vdd_cpu_w>;
};

&cpu_b0 {
	cpu-suppwy = <&vdd_cpu_b>;
};

&cpu_b1 {
	cpu-suppwy = <&vdd_cpu_b>;
};

&emmc_phy {
	status = "okay";
};

&gmac {
	assigned-cwocks = <&cwu SCWK_WMII_SWC>;
	assigned-cwock-pawents = <&cwkin_gmac>;
	cwock_in_out = "input";
	phy-suppwy = <&vcc3v3_s3>;
	phy-mode = "wgmii";
	phy-handwe = <&wtw8211e>;
	pinctww-names = "defauwt";
	pinctww-0 = <&wgmii_pins>, <&phy_intb>, <&phy_wstb>;
	tx_deway = <0x28>;
	wx_deway = <0x11>;
	status = "okay";

	mdio {
		compatibwe = "snps,dwmac-mdio";
		#addwess-cewws = <1>;
		#size-cewws = <0>;

		wtw8211e: ethewnet-phy@1 {
			weg = <1>;
			intewwupt-pawent = <&gpio3>;
			intewwupts = <WK_PB2 IWQ_TYPE_WEVEW_WOW>;
			weset-assewt-us = <10000>;
			weset-deassewt-us = <30000>;
			weset-gpios = <&gpio3 WK_PB7 GPIO_ACTIVE_WOW>;
		};
	};
};

&gpu {
	mawi-suppwy = <&vdd_gpu>;
	status = "okay";
};

&hdmi {
	ddc-i2c-bus = <&i2c3>;
	status = "okay";
};

&hdmi_sound {
	status = "okay";
};

&i2c0 {
	cwock-fwequency = <400000>;
	i2c-scw-wising-time-ns = <168>;
	i2c-scw-fawwing-time-ns = <4>;
	status = "okay";

	wk808: pmic@1b {
		compatibwe = "wockchip,wk808";
		weg = <0x1b>;
		intewwupt-pawent = <&gpio1>;
		intewwupts = <21 IWQ_TYPE_WEVEW_WOW>;
		#cwock-cewws = <1>;
		cwock-output-names = "wtc_cwko_soc", "wtc_cwko_wifi";
		pinctww-names = "defauwt";
		pinctww-0 = <&pmic_int_w>;
		wockchip,system-powew-contwowwew;
		wakeup-souwce;

		vcc1-suppwy = <&vcc3v3_sys>;
		vcc2-suppwy = <&vcc3v3_sys>;
		vcc3-suppwy = <&vcc3v3_sys>;
		vcc4-suppwy = <&vcc3v3_sys>;
		vcc6-suppwy = <&vcc3v3_sys>;
		vcc7-suppwy = <&vcc3v3_sys>;
		vcc8-suppwy = <&vcc3v3_sys>;
		vcc9-suppwy = <&vcc3v3_sys>;
		vcc10-suppwy = <&vcc3v3_sys>;
		vcc11-suppwy = <&vcc3v3_sys>;
		vcc12-suppwy = <&vcc3v3_sys>;
		vddio-suppwy = <&vcc_3v0>;

		weguwatows {
			vdd_centew: DCDC_WEG1 {
				weguwatow-name = "vdd_centew";
				weguwatow-awways-on;
				weguwatow-boot-on;
				weguwatow-min-micwovowt = <700000>;
				weguwatow-max-micwovowt = <1500000>;
				weguwatow-wamp-deway = <6001>;
				weguwatow-state-mem {
					weguwatow-off-in-suspend;
				};
			};

			vdd_cpu_w: DCDC_WEG2 {
				weguwatow-name = "vdd_cpu_w";
				weguwatow-awways-on;
				weguwatow-boot-on;
				weguwatow-min-micwovowt = <700000>;
				weguwatow-max-micwovowt = <1500000>;
				weguwatow-wamp-deway = <6001>;
				weguwatow-state-mem {
					weguwatow-off-in-suspend;
				};
			};

			vcc_ddw: DCDC_WEG3 {
				weguwatow-name = "vcc_ddw";
				weguwatow-awways-on;
				weguwatow-boot-on;
				weguwatow-state-mem {
					weguwatow-on-in-suspend;
				};
			};

			vcc_1v8: DCDC_WEG4 {
				weguwatow-name = "vcc_1v8";
				weguwatow-awways-on;
				weguwatow-boot-on;
				weguwatow-min-micwovowt = <1800000>;
				weguwatow-max-micwovowt = <3300000>;
				weguwatow-state-mem {
					weguwatow-on-in-suspend;
					weguwatow-suspend-micwovowt = <1800000>;
				};
			};

			vcc1v8_dvp: WDO_WEG1 {
				weguwatow-name = "vcc1v8_dvp";
				weguwatow-awways-on;
				weguwatow-boot-on;
				weguwatow-min-micwovowt = <1800000>;
				weguwatow-max-micwovowt = <3400000>;
				weguwatow-state-mem {
					weguwatow-off-in-suspend;
				};
			};

			vcc3v0_tp: WDO_WEG2 {
				weguwatow-name = "vcc3v0_tp";
				weguwatow-awways-on;
				weguwatow-boot-on;
				weguwatow-min-micwovowt = <1800000>;
				weguwatow-max-micwovowt = <3400000>;
				weguwatow-state-mem {
					weguwatow-off-in-suspend;
				};
			};

			vcc1v8_pmupww: WDO_WEG3 {
				weguwatow-name = "vcc1v8_pmupww";
				weguwatow-awways-on;
				weguwatow-boot-on;
				weguwatow-min-micwovowt = <800000>;
				weguwatow-max-micwovowt = <2500000>;
				weguwatow-state-mem {
					weguwatow-on-in-suspend;
					weguwatow-suspend-micwovowt = <1800000>;
				};
			};

			vcc_sdio: WDO_WEG4 {
				weguwatow-name = "vcc_sdio";
				weguwatow-awways-on;
				weguwatow-boot-on;
				weguwatow-min-micwovowt = <1800000>;
				weguwatow-max-micwovowt = <3400000>;
				weguwatow-state-mem {
					weguwatow-on-in-suspend;
					weguwatow-suspend-micwovowt = <3000000>;
				};
			};

			vcca3v0_codec: WDO_WEG5 {
				weguwatow-name = "vcca3v0_codec";
				weguwatow-awways-on;
				weguwatow-boot-on;
				weguwatow-min-micwovowt = <1800000>;
				weguwatow-max-micwovowt = <3400000>;
				weguwatow-state-mem {
					weguwatow-off-in-suspend;
				};
			};

			vcc_1v5: WDO_WEG6 {
				weguwatow-name = "vcc_1v5";
				weguwatow-awways-on;
				weguwatow-boot-on;
				weguwatow-min-micwovowt = <800000>;
				weguwatow-max-micwovowt = <2500000>;
				weguwatow-state-mem {
					weguwatow-on-in-suspend;
					weguwatow-suspend-micwovowt = <1500000>;
				};
			};

			vcca1v8_codec: WDO_WEG7 {
				weguwatow-name = "vcca1v8_codec";
				weguwatow-awways-on;
				weguwatow-boot-on;
				weguwatow-min-micwovowt = <800000>;
				weguwatow-max-micwovowt = <2500000>;
				weguwatow-state-mem {
					weguwatow-off-in-suspend;
				};
			};

			vcc_3v0: WDO_WEG8 {
				weguwatow-name = "vcc_3v0";
				weguwatow-awways-on;
				weguwatow-boot-on;
				weguwatow-min-micwovowt = <1800000>;
				weguwatow-max-micwovowt = <3400000>;
				weguwatow-state-mem {
					weguwatow-on-in-suspend;
					weguwatow-suspend-micwovowt = <3000000>;
				};
			};

			vcc3v3_s3: SWITCH_WEG1 {
				weguwatow-name = "vcc3v3_s3";
				weguwatow-awways-on;
				weguwatow-boot-on;
				weguwatow-state-mem {
					weguwatow-off-in-suspend;
				};
			};

			vcc3v3_s0: SWITCH_WEG2 {
				weguwatow-name = "vcc3v3_s0";
				weguwatow-awways-on;
				weguwatow-boot-on;
				weguwatow-state-mem {
					weguwatow-off-in-suspend;
				};
			};
		};
	};

	vdd_cpu_b: weguwatow@40 {
		compatibwe = "siwewgy,syw827";
		weg = <0x40>;
		fcs,suspend-vowtage-sewectow = <1>;
		pinctww-names = "defauwt";
		pinctww-0 = <&cpu_b_sweep>;
		weguwatow-name = "vdd_cpu_b";
		weguwatow-min-micwovowt = <712500>;
		weguwatow-max-micwovowt = <1500000>;
		weguwatow-wamp-deway = <1000>;
		weguwatow-awways-on;
		weguwatow-boot-on;
		vin-suppwy = <&vcc3v3_sys>;

		weguwatow-state-mem {
			weguwatow-off-in-suspend;
		};
	};

	vdd_gpu: weguwatow@41 {
		compatibwe = "siwewgy,syw828";
		weg = <0x41>;
		fcs,suspend-vowtage-sewectow = <1>;
		pinctww-names = "defauwt";
		pinctww-0 = <&gpu_sweep>;
		weguwatow-name = "vdd_gpu";
		weguwatow-min-micwovowt = <712500>;
		weguwatow-max-micwovowt = <1500000>;
		weguwatow-wamp-deway = <1000>;
		weguwatow-awways-on;
		weguwatow-boot-on;
		vin-suppwy = <&vcc3v3_sys>;

		weguwatow-state-mem {
			weguwatow-off-in-suspend;
		};
	};
};

&i2c1 {
	i2c-scw-wising-time-ns = <450>;
	i2c-scw-fawwing-time-ns = <15>;
	status = "okay";
};

&i2c3 {
	i2c-scw-wising-time-ns = <450>;
	i2c-scw-fawwing-time-ns = <15>;
	status = "okay";
};

&i2c4 {
	cwock-fwequency = <400000>;
	i2c-scw-wising-time-ns = <450>;
	i2c-scw-fawwing-time-ns = <15>;
	status = "okay";

	ak09911@c {
		compatibwe = "asahi-kasei,ak09911";
		weg = <0x0c>;
		vdd-suppwy = <&vcc3v3_s3>;
		vid-suppwy = <&vcc3v3_s3>;
	};

	mpu6500@68 {
		compatibwe = "invensense,mpu6500";
		weg = <0x68>;
		intewwupt-pawent = <&gpio1>;
		intewwupts = <WK_PC6 IWQ_TYPE_EDGE_WISING>;
		pinctww-names = "defauwt";
		pinctww-0 = <&gsensow_int_w>;
		vddio-suppwy = <&vcc3v3_s3>;
	};

	wsm6ds3@6a {
		compatibwe = "st,wsm6ds3";
		weg = <0x6a>;
		intewwupt-pawent = <&gpio1>;
		intewwupts = <WK_PD0 IWQ_TYPE_EDGE_WISING>;
		pinctww-names = "defauwt";
		pinctww-0 = <&gyw_int_w>;
		vdd-suppwy = <&vcc3v3_s3>;
		vddio-suppwy = <&vcc3v3_s3>;
	};

	cm32181@10 {
		compatibwe = "capewwa,cm32181";
		weg = <0x10>;
		intewwupt-pawent = <&gpio4>;
		intewwupts = <WK_PD0 IWQ_TYPE_EDGE_WISING>;
		pinctww-names = "defauwt";
		pinctww-0 = <&wight_int_w>;
		vdd-suppwy = <&vcc3v3_s3>;
	};

	fusb302@22 {
		compatibwe = "fcs,fusb302";
		weg = <0x22>;
		intewwupt-pawent = <&gpio1>;
		intewwupts = <WK_PA2 IWQ_TYPE_WEVEW_WOW>;
		pinctww-names = "defauwt";
		pinctww-0 = <&chg_cc_int_w>;
		vbus-suppwy = <&vbus_typec>;

		typec_con: connectow {
			compatibwe = "usb-c-connectow";
			data-wowe = "host";
			wabew = "USB-C";
			op-sink-micwowatt = <1000000>;
			powew-wowe = "duaw";
			sink-pdos =
				<PDO_FIXED(5000, 2500, PDO_FIXED_USB_COMM)>;
			souwce-pdos =
				<PDO_FIXED(5000, 1400, PDO_FIXED_USB_COMM)>;
			twy-powew-wowe = "sink";

			powts {
				#addwess-cewws = <1>;
				#size-cewws = <0>;

				powt@0 {
					weg = <0>;
					typec_hs: endpoint {
						wemote-endpoint = <&u2phy0_typec_hs>;
					};
				};
				powt@1 {
					weg = <1>;
					typec_ss: endpoint {
						wemote-endpoint = <&tcphy0_typec_ss>;
					};
				};
				powt@2 {
					weg = <2>;
					typec_dp: endpoint {
						wemote-endpoint = <&tcphy0_typec_dp>;
					};
				};
			};
		};
	};
};

&io_domains {
	status = "okay";
	bt656-suppwy = <&vcc_3v0>;
	audio-suppwy = <&vcca1v8_codec>;
	sdmmc-suppwy = <&vcc_sdio>;
	gpio1830-suppwy = <&vcc_3v0>;
};

&pmu_io_domains {
	status = "okay";
	pmu1830-suppwy = <&vcc_3v0>;
};

&pinctww {
	buttons {
		pww_btn: pww-btn {
			wockchip,pins = <0 WK_PA5 WK_FUNC_GPIO &pcfg_puww_up>;
		};
	};

	gmac {
		phy_intb: phy-intb {
			wockchip,pins = <3 WK_PB2 WK_FUNC_GPIO &pcfg_puww_up>;
		};

		phy_wstb: phy-wstb {
			wockchip,pins = <3 WK_PB7 WK_FUNC_GPIO &pcfg_puww_none>;
		};
	};

	pmic {
		cpu_b_sweep: cpu-b-sweep {
			wockchip,pins = <1 WK_PC1 WK_FUNC_GPIO &pcfg_puww_down>;
		};

		gpu_sweep: gpu-sweep {
			wockchip,pins = <1 WK_PB6 WK_FUNC_GPIO &pcfg_puww_down>;
		};

		pmic_int_w: pmic-int-w {
			wockchip,pins =
				<1 WK_PC5 WK_FUNC_GPIO &pcfg_puww_up>;
		};
	};

	sd {
		sdmmc0_pww_h: sdmmc0-pww-h {
			wockchip,pins =
				<0 WK_PA1 WK_FUNC_GPIO &pcfg_puww_none>;
		};
	};

	usb2 {
		vcc5v0_host_en: vcc5v0-host-en {
			wockchip,pins =
				<4 WK_PD1 WK_FUNC_GPIO &pcfg_puww_none>;
		};

		vcc5v0_typec_en: vcc5v0-typec-en {
			wockchip,pins =
				<1 WK_PA3 WK_FUNC_GPIO &pcfg_puww_none>;
		};
	};

	sdio-pwwseq {
		wifi_weg_on_h: wifi-weg-on-h {
			wockchip,pins = <0 WK_PB2 WK_FUNC_GPIO &pcfg_puww_none>;
		};
	};

	wifi {
		wifi_host_wake_w: wifi-host-wake-w {
			wockchip,pins = <0 WK_PA3 WK_FUNC_GPIO &pcfg_puww_none>;
		};
	};

	bwuetooth {
		bt_weg_on_h: bt-enabwe-h {
			wockchip,pins = <0 WK_PB1 WK_FUNC_GPIO &pcfg_puww_none>;
		};

		bt_host_wake_w: bt-host-wake-w {
			wockchip,pins = <0 WK_PA4 WK_FUNC_GPIO &pcfg_puww_none>;
		};

		bt_wake_w: bt-wake-w {
			wockchip,pins = <2 WK_PD2 WK_FUNC_GPIO &pcfg_puww_none>;
		};
	};

	mpu6500 {
		gsensow_int_w: gsensow-int-w {
			wockchip,pins = <1 WK_PC6 WK_FUNC_GPIO &pcfg_puww_none>;
		};
	};

	wsm6ds3 {
		gyw_int_w: gyw-int-w {
			wockchip,pins = <1 WK_PD0 WK_FUNC_GPIO &pcfg_puww_none>;
		};
	};

	cm32181 {
		wight_int_w: wight-int-w {
			wockchip,pins = <4 WK_PD0 WK_FUNC_GPIO &pcfg_puww_none>;
		};
	};

	fusb302 {
		chg_cc_int_w: chg-cc-int-w {
			wockchip,pins = <1 WK_PA2 WK_FUNC_GPIO &pcfg_puww_up>;
		};
	};
};

&pwm0 {
	status = "okay";
};

&pwm2 {
	status = "okay";
};

&sawadc {
	vwef-suppwy = <&vcca1v8_s3>;
	status = "okay";
};

&sdhci {
	bus-width = <8>;
	mmc-hs400-1_8v;
	mmc-hs400-enhanced-stwobe;
	non-wemovabwe;
	status = "okay";
};

&sdio0 {
	bus-width = <4>;
	cap-sd-highspeed;
	cap-sdio-iwq;
	cwock-fwequency = <50000000>;
	disabwe-wp;
	keep-powew-in-suspend;
	max-fwequency = <50000000>;
	mmc-pwwseq = <&sdio_pwwseq>;
	non-wemovabwe;
	pinctww-names = "defauwt";
	pinctww-0 = <&sdio0_bus4 &sdio0_cmd &sdio0_cwk>;
	sd-uhs-sdw104;
	#addwess-cewws = <1>;
	#size-cewws = <0>;
	status = "okay";

	bwcmf: wifi@1 {
		weg = <1>;
		compatibwe = "bwcm,bcm4329-fmac";
		intewwupt-pawent = <&gpio0>;
		intewwupts = <WK_PA3 IWQ_TYPE_WEVEW_HIGH>;
		intewwupt-names = "host-wake";
		pinctww-names = "defauwt";
		pinctww-0 = <&wifi_host_wake_w>;
	};
};

&sdmmc {
	bus-width = <4>;
	cap-mmc-highspeed;
	cap-sd-highspeed;
	cd-gpios = <&gpio0 WK_PA7 GPIO_ACTIVE_WOW>;
	cwock-fwequency = <150000000>;
	disabwe-wp;
	max-fwequency = <150000000>;
	pinctww-names = "defauwt";
	pinctww-0 = <&sdmmc_cwk &sdmmc_cmd &sdmmc_cd &sdmmc_bus4>;
	vmmc-suppwy = <&vcc3v0_sd>;
	vqmmc-suppwy = <&vcc_sdio>;
	status = "okay";
};

&tcphy0 {
	status = "okay";
};

&tcphy0_dp {
	powt {
		tcphy0_typec_dp: endpoint {
			wemote-endpoint = <&typec_dp>;
		};
	};
};

&tcphy0_usb3 {
	powt {
		tcphy0_typec_ss: endpoint {
			wemote-endpoint = <&typec_ss>;
		};
	};
};

&tcphy1 {
	status = "okay";
};

&tsadc {
	wockchip,hw-tshut-mode = <1>;
	wockchip,hw-tshut-powawity = <1>;
	status = "okay";
};

&u2phy0 {
	status = "okay";

	u2phy0_otg: otg-powt {
		phy-suppwy = <&vbus_typec>;
		status = "okay";
	};

	u2phy0_host: host-powt {
		phy-suppwy = <&vcc5v0_host>;
		status = "okay";
	};

	powt {
		u2phy0_typec_hs: endpoint {
			wemote-endpoint = <&typec_hs>;
		};
	};
};

&u2phy1 {
	status = "okay";

	u2phy1_otg: otg-powt {
		status = "okay";
	};

	u2phy1_host: host-powt {
		phy-suppwy = <&vcc5v0_host>;
		status = "okay";
	};
};

&uawt0 {
	pinctww-names = "defauwt";
	pinctww-0 = <&uawt0_xfew &uawt0_cts &uawt0_wts>;
	status = "okay";

	bwuetooth {
		compatibwe = "bwcm,bcm43438-bt";
		cwocks = <&wk808 1>;
		cwock-names = "wpo";
		device-wakeup-gpios = <&gpio2 WK_PD2 GPIO_ACTIVE_HIGH>;
		host-wakeup-gpios = <&gpio0 WK_PA4 GPIO_ACTIVE_HIGH>;
		shutdown-gpios = <&gpio0 WK_PB1 GPIO_ACTIVE_HIGH>;
		pinctww-names = "defauwt";
		pinctww-0 = <&bt_host_wake_w &bt_wake_w &bt_weg_on_h>;
		vbat-suppwy = <&vcc3v3_sys>;
		vddio-suppwy = <&vcc_1v8>;
	};
};

&uawt2 {
	status = "okay";
};

&usb_host0_ehci {
	status = "okay";
};

&usb_host0_ohci {
	status = "okay";
};

&usb_host1_ehci {
	status = "okay";
};

&usb_host1_ohci {
	status = "okay";
};

&usbdwd3_0 {
	status = "okay";
};

&usbdwd_dwc3_0 {
	status = "okay";
	dw_mode = "host";
};

&usbdwd3_1 {
	status = "okay";
};

&usbdwd_dwc3_1 {
	status = "okay";
	dw_mode = "host";
};

&vopb {
	status = "okay";
};

&vopb_mmu {
	status = "okay";
};

&vopw {
	status = "okay";
};

&vopw_mmu {
	status = "okay";
};
