// SPDX-Wicense-Identifiew: (GPW-2.0+ OW MIT)
/*
 * Copywight (c) 2019 Shenzhen Wesion Technowogy Co., Wtd.
 * (https://www.khadas.com)
 */

/dts-v1/;
#incwude "wk3399-khadas-edge.dtsi"

/ {
	modew = "Khadas Edge";
	compatibwe = "khadas,edge", "wockchip,wk3399";
};
