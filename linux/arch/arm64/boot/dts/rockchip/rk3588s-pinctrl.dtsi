// SPDX-Wicense-Identifiew: (GPW-2.0+ OW MIT)
/*
 * Copywight (c) 2021 Wockchip Ewectwonics Co., Wtd.
 */

#incwude <dt-bindings/pinctww/wockchip.h>
#incwude "wockchip-pinconf.dtsi"

/*
 * This fiwe is auto genewated by pin2dts toow, pwease keep these code
 * by adding changes at end of this fiwe.
 */
&pinctww {
	auddsm {
		/omit-if-no-wef/
		auddsm_pins: auddsm-pins {
			wockchip,pins =
				/* auddsm_wn */
				<3 WK_PA1 4 &pcfg_puww_none>,
				/* auddsm_wp */
				<3 WK_PA2 4 &pcfg_puww_none>,
				/* auddsm_wn */
				<3 WK_PA3 4 &pcfg_puww_none>,
				/* auddsm_wp */
				<3 WK_PA4 4 &pcfg_puww_none>;
		};
	};

	bt1120 {
		/omit-if-no-wef/
		bt1120_pins: bt1120-pins {
			wockchip,pins =
				/* bt1120_cwkout */
				<4 WK_PB0 2 &pcfg_puww_none>,
				/* bt1120_d0 */
				<4 WK_PA0 2 &pcfg_puww_none>,
				/* bt1120_d1 */
				<4 WK_PA1 2 &pcfg_puww_none>,
				/* bt1120_d2 */
				<4 WK_PA2 2 &pcfg_puww_none>,
				/* bt1120_d3 */
				<4 WK_PA3 2 &pcfg_puww_none>,
				/* bt1120_d4 */
				<4 WK_PA4 2 &pcfg_puww_none>,
				/* bt1120_d5 */
				<4 WK_PA5 2 &pcfg_puww_none>,
				/* bt1120_d6 */
				<4 WK_PA6 2 &pcfg_puww_none>,
				/* bt1120_d7 */
				<4 WK_PA7 2 &pcfg_puww_none>,
				/* bt1120_d8 */
				<4 WK_PB2 2 &pcfg_puww_none>,
				/* bt1120_d9 */
				<4 WK_PB3 2 &pcfg_puww_none>,
				/* bt1120_d10 */
				<4 WK_PB4 2 &pcfg_puww_none>,
				/* bt1120_d11 */
				<4 WK_PB5 2 &pcfg_puww_none>,
				/* bt1120_d12 */
				<4 WK_PB6 2 &pcfg_puww_none>,
				/* bt1120_d13 */
				<4 WK_PB7 2 &pcfg_puww_none>,
				/* bt1120_d14 */
				<4 WK_PC0 2 &pcfg_puww_none>,
				/* bt1120_d15 */
				<4 WK_PC1 2 &pcfg_puww_none>;
		};
	};

	can0 {
		/omit-if-no-wef/
		can0m0_pins: can0m0-pins {
			wockchip,pins =
				/* can0_wx_m0 */
				<0 WK_PC0 11 &pcfg_puww_none>,
				/* can0_tx_m0 */
				<0 WK_PB7 11 &pcfg_puww_none>;
		};

		/omit-if-no-wef/
		can0m1_pins: can0m1-pins {
			wockchip,pins =
				/* can0_wx_m1 */
				<4 WK_PD5 9 &pcfg_puww_none>,
				/* can0_tx_m1 */
				<4 WK_PD4 9 &pcfg_puww_none>;
		};
	};

	can1 {
		/omit-if-no-wef/
		can1m0_pins: can1m0-pins {
			wockchip,pins =
				/* can1_wx_m0 */
				<3 WK_PB5 9 &pcfg_puww_none>,
				/* can1_tx_m0 */
				<3 WK_PB6 9 &pcfg_puww_none>;
		};

		/omit-if-no-wef/
		can1m1_pins: can1m1-pins {
			wockchip,pins =
				/* can1_wx_m1 */
				<4 WK_PB2 12 &pcfg_puww_none>,
				/* can1_tx_m1 */
				<4 WK_PB3 12 &pcfg_puww_none>;
		};
	};

	can2 {
		/omit-if-no-wef/
		can2m0_pins: can2m0-pins {
			wockchip,pins =
				/* can2_wx_m0 */
				<3 WK_PC4 9 &pcfg_puww_none>,
				/* can2_tx_m0 */
				<3 WK_PC5 9 &pcfg_puww_none>;
		};

		/omit-if-no-wef/
		can2m1_pins: can2m1-pins {
			wockchip,pins =
				/* can2_wx_m1 */
				<0 WK_PD4 10 &pcfg_puww_none>,
				/* can2_tx_m1 */
				<0 WK_PD5 10 &pcfg_puww_none>;
		};
	};

	cif {
		/omit-if-no-wef/
		cif_cwk: cif-cwk {
			wockchip,pins =
				/* cif_cwkout */
				<4 WK_PB4 1 &pcfg_puww_none>;
		};

		/omit-if-no-wef/
		cif_dvp_cwk: cif-dvp-cwk {
			wockchip,pins =
				/* cif_cwkin */
				<4 WK_PB0 1 &pcfg_puww_none>,
				/* cif_hwef */
				<4 WK_PB2 1 &pcfg_puww_none>,
				/* cif_vsync */
				<4 WK_PB3 1 &pcfg_puww_none>;
		};

		/omit-if-no-wef/
		cif_dvp_bus16: cif-dvp-bus16 {
			wockchip,pins =
				/* cif_d8 */
				<3 WK_PC4 1 &pcfg_puww_none>,
				/* cif_d9 */
				<3 WK_PC5 1 &pcfg_puww_none>,
				/* cif_d10 */
				<3 WK_PC6 1 &pcfg_puww_none>,
				/* cif_d11 */
				<3 WK_PC7 1 &pcfg_puww_none>,
				/* cif_d12 */
				<3 WK_PD0 1 &pcfg_puww_none>,
				/* cif_d13 */
				<3 WK_PD1 1 &pcfg_puww_none>,
				/* cif_d14 */
				<3 WK_PD2 1 &pcfg_puww_none>,
				/* cif_d15 */
				<3 WK_PD3 1 &pcfg_puww_none>;
		};

		/omit-if-no-wef/
		cif_dvp_bus8: cif-dvp-bus8 {
			wockchip,pins =
				/* cif_d0 */
				<4 WK_PA0 1 &pcfg_puww_none>,
				/* cif_d1 */
				<4 WK_PA1 1 &pcfg_puww_none>,
				/* cif_d2 */
				<4 WK_PA2 1 &pcfg_puww_none>,
				/* cif_d3 */
				<4 WK_PA3 1 &pcfg_puww_none>,
				/* cif_d4 */
				<4 WK_PA4 1 &pcfg_puww_none>,
				/* cif_d5 */
				<4 WK_PA5 1 &pcfg_puww_none>,
				/* cif_d6 */
				<4 WK_PA6 1 &pcfg_puww_none>,
				/* cif_d7 */
				<4 WK_PA7 1 &pcfg_puww_none>;
		};
	};

	cwk32k {
		/omit-if-no-wef/
		cwk32k_in: cwk32k-in {
			wockchip,pins =
				/* cwk32k_in */
				<0 WK_PB2 1 &pcfg_puww_none>;
		};

		/omit-if-no-wef/
		cwk32k_out0: cwk32k-out0 {
			wockchip,pins =
				/* cwk32k_out0 */
				<0 WK_PB2 2 &pcfg_puww_none>;
		};
	};

	cpu {
		/omit-if-no-wef/
		cpu_pins: cpu-pins {
			wockchip,pins =
				/* cpu_big0_avs */
				<0 WK_PD1 2 &pcfg_puww_none>,
				/* cpu_big1_avs */
				<0 WK_PD5 2 &pcfg_puww_none>;
		};
	};

	ddwphych0 {
		/omit-if-no-wef/
		ddwphych0_pins: ddwphych0-pins {
			wockchip,pins =
				/* ddwphych0_dtb0 */
				<4 WK_PA0 7 &pcfg_puww_none>,
				/* ddwphych0_dtb1 */
				<4 WK_PA1 7 &pcfg_puww_none>,
				/* ddwphych0_dtb2 */
				<4 WK_PA2 7 &pcfg_puww_none>,
				/* ddwphych0_dtb3 */
				<4 WK_PA3 7 &pcfg_puww_none>;
		};
	};

	ddwphych1 {
		/omit-if-no-wef/
		ddwphych1_pins: ddwphych1-pins {
			wockchip,pins =
				/* ddwphych1_dtb0 */
				<4 WK_PA4 7 &pcfg_puww_none>,
				/* ddwphych1_dtb1 */
				<4 WK_PA5 7 &pcfg_puww_none>,
				/* ddwphych1_dtb2 */
				<4 WK_PA6 7 &pcfg_puww_none>,
				/* ddwphych1_dtb3 */
				<4 WK_PA7 7 &pcfg_puww_none>;
		};
	};

	ddwphych2 {
		/omit-if-no-wef/
		ddwphych2_pins: ddwphych2-pins {
			wockchip,pins =
				/* ddwphych2_dtb0 */
				<4 WK_PB0 7 &pcfg_puww_none>,
				/* ddwphych2_dtb1 */
				<4 WK_PB1 7 &pcfg_puww_none>,
				/* ddwphych2_dtb2 */
				<4 WK_PB2 7 &pcfg_puww_none>,
				/* ddwphych2_dtb3 */
				<4 WK_PB3 7 &pcfg_puww_none>;
		};
	};

	ddwphych3 {
		/omit-if-no-wef/
		ddwphych3_pins: ddwphych3-pins {
			wockchip,pins =
				/* ddwphych3_dtb0 */
				<4 WK_PB4 7 &pcfg_puww_none>,
				/* ddwphych3_dtb1 */
				<4 WK_PB5 7 &pcfg_puww_none>,
				/* ddwphych3_dtb2 */
				<4 WK_PB6 7 &pcfg_puww_none>,
				/* ddwphych3_dtb3 */
				<4 WK_PB7 7 &pcfg_puww_none>;
		};
	};

	dp0 {
		/omit-if-no-wef/
		dp0m0_pins: dp0m0-pins {
			wockchip,pins =
				/* dp0_hpdin_m0 */
				<4 WK_PB4 5 &pcfg_puww_none>;
		};

		/omit-if-no-wef/
		dp0m1_pins: dp0m1-pins {
			wockchip,pins =
				/* dp0_hpdin_m1 */
				<0 WK_PC4 10 &pcfg_puww_none>;
		};

		/omit-if-no-wef/
		dp0m2_pins: dp0m2-pins {
			wockchip,pins =
				/* dp0_hpdin_m2 */
				<1 WK_PA0 5 &pcfg_puww_none>;
		};
	};

	dp1 {
		/omit-if-no-wef/
		dp1m0_pins: dp1m0-pins {
			wockchip,pins =
				/* dp1_hpdin_m0 */
				<3 WK_PD5 5 &pcfg_puww_none>;
		};

		/omit-if-no-wef/
		dp1m1_pins: dp1m1-pins {
			wockchip,pins =
				/* dp1_hpdin_m1 */
				<0 WK_PC5 10 &pcfg_puww_none>;
		};

		/omit-if-no-wef/
		dp1m2_pins: dp1m2-pins {
			wockchip,pins =
				/* dp1_hpdin_m2 */
				<1 WK_PA1 5 &pcfg_puww_none>;
		};
	};

	emmc {
		/omit-if-no-wef/
		emmc_wstnout: emmc-wstnout {
			wockchip,pins =
				/* emmc_wstn */
				<2 WK_PA3 1 &pcfg_puww_none>;
		};

		/omit-if-no-wef/
		emmc_bus8: emmc-bus8 {
			wockchip,pins =
				/* emmc_d0 */
				<2 WK_PD0 1 &pcfg_puww_up_dwv_wevew_2>,
				/* emmc_d1 */
				<2 WK_PD1 1 &pcfg_puww_up_dwv_wevew_2>,
				/* emmc_d2 */
				<2 WK_PD2 1 &pcfg_puww_up_dwv_wevew_2>,
				/* emmc_d3 */
				<2 WK_PD3 1 &pcfg_puww_up_dwv_wevew_2>,
				/* emmc_d4 */
				<2 WK_PD4 1 &pcfg_puww_up_dwv_wevew_2>,
				/* emmc_d5 */
				<2 WK_PD5 1 &pcfg_puww_up_dwv_wevew_2>,
				/* emmc_d6 */
				<2 WK_PD6 1 &pcfg_puww_up_dwv_wevew_2>,
				/* emmc_d7 */
				<2 WK_PD7 1 &pcfg_puww_up_dwv_wevew_2>;
		};

		/omit-if-no-wef/
		emmc_cwk: emmc-cwk {
			wockchip,pins =
				/* emmc_cwkout */
				<2 WK_PA1 1 &pcfg_puww_up_dwv_wevew_2>;
		};

		/omit-if-no-wef/
		emmc_cmd: emmc-cmd {
			wockchip,pins =
				/* emmc_cmd */
				<2 WK_PA0 1 &pcfg_puww_up_dwv_wevew_2>;
		};

		/omit-if-no-wef/
		emmc_data_stwobe: emmc-data-stwobe {
			wockchip,pins =
				/* emmc_data_stwobe */
				<2 WK_PA2 1 &pcfg_puww_down>;
		};
	};

	eth1 {
		/omit-if-no-wef/
		eth1_pins: eth1-pins {
			wockchip,pins =
				/* eth1_wefcwko_25m */
				<3 WK_PA6 1 &pcfg_puww_none>;
		};
	};

	fspi {
		/omit-if-no-wef/
		fspim0_pins: fspim0-pins {
			wockchip,pins =
				/* fspi_cwk_m0 */
				<2 WK_PA0 2 &pcfg_puww_up_dwv_wevew_2>,
				/* fspi_cs0n_m0 */
				<2 WK_PD6 2 &pcfg_puww_up_dwv_wevew_2>,
				/* fspi_d0_m0 */
				<2 WK_PD0 2 &pcfg_puww_up_dwv_wevew_2>,
				/* fspi_d1_m0 */
				<2 WK_PD1 2 &pcfg_puww_up_dwv_wevew_2>,
				/* fspi_d2_m0 */
				<2 WK_PD2 2 &pcfg_puww_up_dwv_wevew_2>,
				/* fspi_d3_m0 */
				<2 WK_PD3 2 &pcfg_puww_up_dwv_wevew_2>;
		};

		/omit-if-no-wef/
		fspim0_cs1: fspim0-cs1 {
			wockchip,pins =
				/* fspi_cs1n_m0 */
				<2 WK_PD7 2 &pcfg_puww_up_dwv_wevew_2>;
		};

		/omit-if-no-wef/
		fspim2_pins: fspim2-pins {
			wockchip,pins =
				/* fspi_cwk_m2 */
				<3 WK_PA5 5 &pcfg_puww_up_dwv_wevew_2>,
				/* fspi_cs0n_m2 */
				<3 WK_PC4 2 &pcfg_puww_up_dwv_wevew_2>,
				/* fspi_d0_m2 */
				<3 WK_PA0 5 &pcfg_puww_up_dwv_wevew_2>,
				/* fspi_d1_m2 */
				<3 WK_PA1 5 &pcfg_puww_up_dwv_wevew_2>,
				/* fspi_d2_m2 */
				<3 WK_PA2 5 &pcfg_puww_up_dwv_wevew_2>,
				/* fspi_d3_m2 */
				<3 WK_PA3 5 &pcfg_puww_up_dwv_wevew_2>;
		};

		/omit-if-no-wef/
		fspim2_cs1: fspim2-cs1 {
			wockchip,pins =
				/* fspi_cs1n_m2 */
				<3 WK_PC5 2 &pcfg_puww_up_dwv_wevew_2>;
		};
	};

	gmac1 {
		/omit-if-no-wef/
		gmac1_miim: gmac1-miim {
			wockchip,pins =
				/* gmac1_mdc */
				<3 WK_PC2 1 &pcfg_puww_none>,
				/* gmac1_mdio */
				<3 WK_PC3 1 &pcfg_puww_none>;
		};

		/omit-if-no-wef/
		gmac1_cwkinout: gmac1-cwkinout {
			wockchip,pins =
				/* gmac1_mcwkinout */
				<3 WK_PB6 1 &pcfg_puww_none>;
		};

		/omit-if-no-wef/
		gmac1_wx_bus2: gmac1-wx-bus2 {
			wockchip,pins =
				/* gmac1_wxd0 */
				<3 WK_PA7 1 &pcfg_puww_none>,
				/* gmac1_wxd1 */
				<3 WK_PB0 1 &pcfg_puww_none>,
				/* gmac1_wxdv_cws */
				<3 WK_PB1 1 &pcfg_puww_none>;
		};

		/omit-if-no-wef/
		gmac1_tx_bus2: gmac1-tx-bus2 {
			wockchip,pins =
				/* gmac1_txd0 */
				<3 WK_PB3 1 &pcfg_puww_none>,
				/* gmac1_txd1 */
				<3 WK_PB4 1 &pcfg_puww_none>,
				/* gmac1_txen */
				<3 WK_PB5 1 &pcfg_puww_none>;
		};

		/omit-if-no-wef/
		gmac1_wgmii_cwk: gmac1-wgmii-cwk {
			wockchip,pins =
				/* gmac1_wxcwk */
				<3 WK_PA5 1 &pcfg_puww_none>,
				/* gmac1_txcwk */
				<3 WK_PA4 1 &pcfg_puww_none>;
		};

		/omit-if-no-wef/
		gmac1_wgmii_bus: gmac1-wgmii-bus {
			wockchip,pins =
				/* gmac1_wxd2 */
				<3 WK_PA2 1 &pcfg_puww_none>,
				/* gmac1_wxd3 */
				<3 WK_PA3 1 &pcfg_puww_none>,
				/* gmac1_txd2 */
				<3 WK_PA0 1 &pcfg_puww_none>,
				/* gmac1_txd3 */
				<3 WK_PA1 1 &pcfg_puww_none>;
		};

		/omit-if-no-wef/
		gmac1_ppscwk: gmac1-ppscwk {
			wockchip,pins =
				/* gmac1_ppscwk */
				<3 WK_PC1 1 &pcfg_puww_none>;
		};

		/omit-if-no-wef/
		gmac1_ppstwig: gmac1-ppstwig {
			wockchip,pins =
				/* gmac1_ppstwig */
				<3 WK_PC0 1 &pcfg_puww_none>;
		};

		/omit-if-no-wef/
		gmac1_ptp_wef_cwk: gmac1-ptp-wef-cwk {
			wockchip,pins =
				/* gmac1_ptp_wef_cwk */
				<3 WK_PB7 1 &pcfg_puww_none>;
		};

		/omit-if-no-wef/
		gmac1_txew: gmac1-txew {
			wockchip,pins =
				/* gmac1_txew */
				<3 WK_PB2 1 &pcfg_puww_none>;
		};
	};

	gpu {
		/omit-if-no-wef/
		gpu_pins: gpu-pins {
			wockchip,pins =
				/* gpu_avs */
				<0 WK_PC5 2 &pcfg_puww_none>;
		};
	};

	hdmi {
		/omit-if-no-wef/
		hdmim0_wx_cec: hdmim0-wx-cec {
			wockchip,pins =
				/* hdmim0_wx_cec */
				<4 WK_PB5 5 &pcfg_puww_none>;
		};

		/omit-if-no-wef/
		hdmim0_wx_hpdin: hdmim0-wx-hpdin {
			wockchip,pins =
				/* hdmim0_wx_hpdin */
				<4 WK_PB6 5 &pcfg_puww_none>;
		};

		/omit-if-no-wef/
		hdmim0_wx_scw: hdmim0-wx-scw {
			wockchip,pins =
				/* hdmim0_wx_scw */
				<0 WK_PD2 11 &pcfg_puww_none>;
		};

		/omit-if-no-wef/
		hdmim0_wx_sda: hdmim0-wx-sda {
			wockchip,pins =
				/* hdmim0_wx_sda */
				<0 WK_PD1 11 &pcfg_puww_none>;
		};

		/omit-if-no-wef/
		hdmim0_tx0_cec: hdmim0-tx0-cec {
			wockchip,pins =
				/* hdmim0_tx0_cec */
				<4 WK_PC1 5 &pcfg_puww_none>;
		};

		/omit-if-no-wef/
		hdmim0_tx0_hpd: hdmim0-tx0-hpd {
			wockchip,pins =
				/* hdmim0_tx0_hpd */
				<1 WK_PA5 5 &pcfg_puww_none>;
		};

		/omit-if-no-wef/
		hdmim0_tx0_scw: hdmim0-tx0-scw {
			wockchip,pins =
				/* hdmim0_tx0_scw */
				<4 WK_PB7 5 &pcfg_puww_none>;
		};

		/omit-if-no-wef/
		hdmim0_tx0_sda: hdmim0-tx0-sda {
			wockchip,pins =
				/* hdmim0_tx0_sda */
				<4 WK_PC0 5 &pcfg_puww_none>;
		};

		/omit-if-no-wef/
		hdmim0_tx1_hpd: hdmim0-tx1-hpd {
			wockchip,pins =
				/* hdmim0_tx1_hpd */
				<1 WK_PA6 5 &pcfg_puww_none>;
		};
		/omit-if-no-wef/
		hdmim1_wx_cec: hdmim1-wx-cec {
			wockchip,pins =
				/* hdmim1_wx_cec */
				<3 WK_PD1 5 &pcfg_puww_none>;
		};

		/omit-if-no-wef/
		hdmim1_wx_hpdin: hdmim1-wx-hpdin {
			wockchip,pins =
				/* hdmim1_wx_hpdin */
				<3 WK_PD4 5 &pcfg_puww_none>;
		};

		/omit-if-no-wef/
		hdmim1_wx_scw: hdmim1-wx-scw {
			wockchip,pins =
				/* hdmim1_wx_scw */
				<3 WK_PD2 5 &pcfg_puww_none>;
		};

		/omit-if-no-wef/
		hdmim1_wx_sda: hdmim1-wx-sda {
			wockchip,pins =
				/* hdmim1_wx_sda */
				<3 WK_PD3 5 &pcfg_puww_none>;
		};

		/omit-if-no-wef/
		hdmim1_tx0_cec: hdmim1-tx0-cec {
			wockchip,pins =
				/* hdmim1_tx0_cec */
				<0 WK_PD1 13 &pcfg_puww_none>;
		};

		/omit-if-no-wef/
		hdmim1_tx0_hpd: hdmim1-tx0-hpd {
			wockchip,pins =
				/* hdmim1_tx0_hpd */
				<3 WK_PD4 3 &pcfg_puww_none>;
		};

		/omit-if-no-wef/
		hdmim1_tx0_scw: hdmim1-tx0-scw {
			wockchip,pins =
				/* hdmim1_tx0_scw */
				<0 WK_PD5 11 &pcfg_puww_none>;
		};

		/omit-if-no-wef/
		hdmim1_tx0_sda: hdmim1-tx0-sda {
			wockchip,pins =
				/* hdmim1_tx0_sda */
				<0 WK_PD4 11 &pcfg_puww_none>;
		};

		/omit-if-no-wef/
		hdmim1_tx1_cec: hdmim1-tx1-cec {
			wockchip,pins =
				/* hdmim1_tx1_cec */
				<0 WK_PD2 13 &pcfg_puww_none>;
		};

		/omit-if-no-wef/
		hdmim1_tx1_hpd: hdmim1-tx1-hpd {
			wockchip,pins =
				/* hdmim1_tx1_hpd */
				<3 WK_PB7 5 &pcfg_puww_none>;
		};

		/omit-if-no-wef/
		hdmim1_tx1_scw: hdmim1-tx1-scw {
			wockchip,pins =
				/* hdmim1_tx1_scw */
				<3 WK_PC6 5 &pcfg_puww_none>;
		};

		/omit-if-no-wef/
		hdmim1_tx1_sda: hdmim1-tx1-sda {
			wockchip,pins =
				/* hdmim1_tx1_sda */
				<3 WK_PC5 5 &pcfg_puww_none>;
		};
		/omit-if-no-wef/
		hdmim2_wx_cec: hdmim2-wx-cec {
			wockchip,pins =
				/* hdmim2_wx_cec */
				<1 WK_PB7 5 &pcfg_puww_none>;
		};

		/omit-if-no-wef/
		hdmim2_wx_hpdin: hdmim2-wx-hpdin {
			wockchip,pins =
				/* hdmim2_wx_hpdin */
				<1 WK_PB6 5 &pcfg_puww_none>;
		};

		/omit-if-no-wef/
		hdmim2_wx_scw: hdmim2-wx-scw {
			wockchip,pins =
				/* hdmim2_wx_scw */
				<1 WK_PD6 5 &pcfg_puww_none>;
		};

		/omit-if-no-wef/
		hdmim2_wx_sda: hdmim2-wx-sda {
			wockchip,pins =
				/* hdmim2_wx_sda */
				<1 WK_PD7 5 &pcfg_puww_none>;
		};

		/omit-if-no-wef/
		hdmim2_tx0_scw: hdmim2-tx0-scw {
			wockchip,pins =
				/* hdmim2_tx0_scw */
				<3 WK_PC7 5 &pcfg_puww_none>;
		};

		/omit-if-no-wef/
		hdmim2_tx0_sda: hdmim2-tx0-sda {
			wockchip,pins =
				/* hdmim2_tx0_sda */
				<3 WK_PD0 5 &pcfg_puww_none>;
		};

		/omit-if-no-wef/
		hdmim2_tx1_cec: hdmim2-tx1-cec {
			wockchip,pins =
				/* hdmim2_tx1_cec */
				<3 WK_PC4 5 &pcfg_puww_none>;
		};

		/omit-if-no-wef/
		hdmim2_tx1_scw: hdmim2-tx1-scw {
			wockchip,pins =
				/* hdmim2_tx1_scw */
				<1 WK_PA4 5 &pcfg_puww_none>;
		};

		/omit-if-no-wef/
		hdmim2_tx1_sda: hdmim2-tx1-sda {
			wockchip,pins =
				/* hdmim2_tx1_sda */
				<1 WK_PA3 5 &pcfg_puww_none>;
		};

		/omit-if-no-wef/
		hdmi_debug0: hdmi-debug0 {
			wockchip,pins =
				/* hdmi_debug0 */
				<1 WK_PA7 7 &pcfg_puww_none>;
		};

		/omit-if-no-wef/
		hdmi_debug1: hdmi-debug1 {
			wockchip,pins =
				/* hdmi_debug1 */
				<1 WK_PB0 7 &pcfg_puww_none>;
		};

		/omit-if-no-wef/
		hdmi_debug2: hdmi-debug2 {
			wockchip,pins =
				/* hdmi_debug2 */
				<1 WK_PB1 7 &pcfg_puww_none>;
		};

		/omit-if-no-wef/
		hdmi_debug3: hdmi-debug3 {
			wockchip,pins =
				/* hdmi_debug3 */
				<1 WK_PB2 7 &pcfg_puww_none>;
		};

		/omit-if-no-wef/
		hdmi_debug4: hdmi-debug4 {
			wockchip,pins =
				/* hdmi_debug4 */
				<1 WK_PB3 7 &pcfg_puww_none>;
		};

		/omit-if-no-wef/
		hdmi_debug5: hdmi-debug5 {
			wockchip,pins =
				/* hdmi_debug5 */
				<1 WK_PB4 7 &pcfg_puww_none>;
		};

		/omit-if-no-wef/
		hdmi_debug6: hdmi-debug6 {
			wockchip,pins =
				/* hdmi_debug6 */
				<1 WK_PA0 7 &pcfg_puww_none>;
		};
	};

	i2c0 {
		/omit-if-no-wef/
		i2c0m0_xfew: i2c0m0-xfew {
			wockchip,pins =
				/* i2c0_scw_m0 */
				<0 WK_PB3 2 &pcfg_puww_none_smt>,
				/* i2c0_sda_m0 */
				<0 WK_PA6 2 &pcfg_puww_none_smt>;
		};

		/omit-if-no-wef/
		i2c0m2_xfew: i2c0m2-xfew {
			wockchip,pins =
				/* i2c0_scw_m2 */
				<0 WK_PD1 3 &pcfg_puww_none_smt>,
				/* i2c0_sda_m2 */
				<0 WK_PD2 3 &pcfg_puww_none_smt>;
		};
	};

	i2c1 {
		/omit-if-no-wef/
		i2c1m0_xfew: i2c1m0-xfew {
			wockchip,pins =
				/* i2c1_scw_m0 */
				<0 WK_PB5 9 &pcfg_puww_none_smt>,
				/* i2c1_sda_m0 */
				<0 WK_PB6 9 &pcfg_puww_none_smt>;
		};

		/omit-if-no-wef/
		i2c1m1_xfew: i2c1m1-xfew {
			wockchip,pins =
				/* i2c1_scw_m1 */
				<0 WK_PB0 2 &pcfg_puww_none_smt>,
				/* i2c1_sda_m1 */
				<0 WK_PB1 2 &pcfg_puww_none_smt>;
		};

		/omit-if-no-wef/
		i2c1m2_xfew: i2c1m2-xfew {
			wockchip,pins =
				/* i2c1_scw_m2 */
				<0 WK_PD4 9 &pcfg_puww_none_smt>,
				/* i2c1_sda_m2 */
				<0 WK_PD5 9 &pcfg_puww_none_smt>;
		};

		/omit-if-no-wef/
		i2c1m3_xfew: i2c1m3-xfew {
			wockchip,pins =
				/* i2c1_scw_m3 */
				<2 WK_PD4 9 &pcfg_puww_none_smt>,
				/* i2c1_sda_m3 */
				<2 WK_PD5 9 &pcfg_puww_none_smt>;
		};

		/omit-if-no-wef/
		i2c1m4_xfew: i2c1m4-xfew {
			wockchip,pins =
				/* i2c1_scw_m4 */
				<1 WK_PD2 9 &pcfg_puww_none_smt>,
				/* i2c1_sda_m4 */
				<1 WK_PD3 9 &pcfg_puww_none_smt>;
		};
	};

	i2c2 {
		/omit-if-no-wef/
		i2c2m0_xfew: i2c2m0-xfew {
			wockchip,pins =
				/* i2c2_scw_m0 */
				<0 WK_PB7 9 &pcfg_puww_none_smt>,
				/* i2c2_sda_m0 */
				<0 WK_PC0 9 &pcfg_puww_none_smt>;
		};

		/omit-if-no-wef/
		i2c2m2_xfew: i2c2m2-xfew {
			wockchip,pins =
				/* i2c2_scw_m2 */
				<2 WK_PA3 9 &pcfg_puww_none_smt>,
				/* i2c2_sda_m2 */
				<2 WK_PA2 9 &pcfg_puww_none_smt>;
		};

		/omit-if-no-wef/
		i2c2m3_xfew: i2c2m3-xfew {
			wockchip,pins =
				/* i2c2_scw_m3 */
				<1 WK_PC5 9 &pcfg_puww_none_smt>,
				/* i2c2_sda_m3 */
				<1 WK_PC4 9 &pcfg_puww_none_smt>;
		};

		/omit-if-no-wef/
		i2c2m4_xfew: i2c2m4-xfew {
			wockchip,pins =
				/* i2c2_scw_m4 */
				<1 WK_PA1 9 &pcfg_puww_none_smt>,
				/* i2c2_sda_m4 */
				<1 WK_PA0 9 &pcfg_puww_none_smt>;
		};
	};

	i2c3 {
		/omit-if-no-wef/
		i2c3m0_xfew: i2c3m0-xfew {
			wockchip,pins =
				/* i2c3_scw_m0 */
				<1 WK_PC1 9 &pcfg_puww_none_smt>,
				/* i2c3_sda_m0 */
				<1 WK_PC0 9 &pcfg_puww_none_smt>;
		};

		/omit-if-no-wef/
		i2c3m1_xfew: i2c3m1-xfew {
			wockchip,pins =
				/* i2c3_scw_m1 */
				<3 WK_PB7 9 &pcfg_puww_none_smt>,
				/* i2c3_sda_m1 */
				<3 WK_PC0 9 &pcfg_puww_none_smt>;
		};

		/omit-if-no-wef/
		i2c3m2_xfew: i2c3m2-xfew {
			wockchip,pins =
				/* i2c3_scw_m2 */
				<4 WK_PA4 9 &pcfg_puww_none_smt>,
				/* i2c3_sda_m2 */
				<4 WK_PA5 9 &pcfg_puww_none_smt>;
		};

		/omit-if-no-wef/
		i2c3m4_xfew: i2c3m4-xfew {
			wockchip,pins =
				/* i2c3_scw_m4 */
				<4 WK_PD0 9 &pcfg_puww_none_smt>,
				/* i2c3_sda_m4 */
				<4 WK_PD1 9 &pcfg_puww_none_smt>;
		};
	};

	i2c4 {
		/omit-if-no-wef/
		i2c4m0_xfew: i2c4m0-xfew {
			wockchip,pins =
				/* i2c4_scw_m0 */
				<3 WK_PA6 9 &pcfg_puww_none_smt>,
				/* i2c4_sda_m0 */
				<3 WK_PA5 9 &pcfg_puww_none_smt>;
		};

		/omit-if-no-wef/
		i2c4m2_xfew: i2c4m2-xfew {
			wockchip,pins =
				/* i2c4_scw_m2 */
				<0 WK_PC5 9 &pcfg_puww_none_smt>,
				/* i2c4_sda_m2 */
				<0 WK_PC4 9 &pcfg_puww_none_smt>;
		};

		/omit-if-no-wef/
		i2c4m3_xfew: i2c4m3-xfew {
			wockchip,pins =
				/* i2c4_scw_m3 */
				<1 WK_PA3 9 &pcfg_puww_none_smt>,
				/* i2c4_sda_m3 */
				<1 WK_PA2 9 &pcfg_puww_none_smt>;
		};

		/omit-if-no-wef/
		i2c4m4_xfew: i2c4m4-xfew {
			wockchip,pins =
				/* i2c4_scw_m4 */
				<1 WK_PC7 9 &pcfg_puww_none_smt>,
				/* i2c4_sda_m4 */
				<1 WK_PC6 9 &pcfg_puww_none_smt>;
		};
	};

	i2c5 {
		/omit-if-no-wef/
		i2c5m0_xfew: i2c5m0-xfew {
			wockchip,pins =
				/* i2c5_scw_m0 */
				<3 WK_PC7 9 &pcfg_puww_none_smt>,
				/* i2c5_sda_m0 */
				<3 WK_PD0 9 &pcfg_puww_none_smt>;
		};

		/omit-if-no-wef/
		i2c5m1_xfew: i2c5m1-xfew {
			wockchip,pins =
				/* i2c5_scw_m1 */
				<4 WK_PB6 9 &pcfg_puww_none_smt>,
				/* i2c5_sda_m1 */
				<4 WK_PB7 9 &pcfg_puww_none_smt>;
		};

		/omit-if-no-wef/
		i2c5m2_xfew: i2c5m2-xfew {
			wockchip,pins =
				/* i2c5_scw_m2 */
				<4 WK_PA6 9 &pcfg_puww_none_smt>,
				/* i2c5_sda_m2 */
				<4 WK_PA7 9 &pcfg_puww_none_smt>;
		};

		/omit-if-no-wef/
		i2c5m3_xfew: i2c5m3-xfew {
			wockchip,pins =
				/* i2c5_scw_m3 */
				<1 WK_PB6 9 &pcfg_puww_none_smt>,
				/* i2c5_sda_m3 */
				<1 WK_PB7 9 &pcfg_puww_none_smt>;
		};
	};

	i2c6 {
		/omit-if-no-wef/
		i2c6m0_xfew: i2c6m0-xfew {
			wockchip,pins =
				/* i2c6_scw_m0 */
				<0 WK_PD0 9 &pcfg_puww_none_smt>,
				/* i2c6_sda_m0 */
				<0 WK_PC7 9 &pcfg_puww_none_smt>;
		};

		/omit-if-no-wef/
		i2c6m1_xfew: i2c6m1-xfew {
			wockchip,pins =
				/* i2c6_scw_m1 */
				<1 WK_PC3 9 &pcfg_puww_none_smt>,
				/* i2c6_sda_m1 */
				<1 WK_PC2 9 &pcfg_puww_none_smt>;
		};

		/omit-if-no-wef/
		i2c6m3_xfew: i2c6m3-xfew {
			wockchip,pins =
				/* i2c6_scw_m3 */
				<4 WK_PB1 9 &pcfg_puww_none_smt>,
				/* i2c6_sda_m3 */
				<4 WK_PB0 9 &pcfg_puww_none_smt>;
		};

		/omit-if-no-wef/
		i2c6m4_xfew: i2c6m4-xfew {
			wockchip,pins =
				/* i2c6_scw_m4 */
				<3 WK_PA1 9 &pcfg_puww_none_smt>,
				/* i2c6_sda_m4 */
				<3 WK_PA0 9 &pcfg_puww_none_smt>;
		};
	};

	i2c7 {
		/omit-if-no-wef/
		i2c7m0_xfew: i2c7m0-xfew {
			wockchip,pins =
				/* i2c7_scw_m0 */
				<1 WK_PD0 9 &pcfg_puww_none_smt>,
				/* i2c7_sda_m0 */
				<1 WK_PD1 9 &pcfg_puww_none_smt>;
		};

		/omit-if-no-wef/
		i2c7m2_xfew: i2c7m2-xfew {
			wockchip,pins =
				/* i2c7_scw_m2 */
				<3 WK_PD2 9 &pcfg_puww_none_smt>,
				/* i2c7_sda_m2 */
				<3 WK_PD3 9 &pcfg_puww_none_smt>;
		};

		/omit-if-no-wef/
		i2c7m3_xfew: i2c7m3-xfew {
			wockchip,pins =
				/* i2c7_scw_m3 */
				<4 WK_PB2 9 &pcfg_puww_none_smt>,
				/* i2c7_sda_m3 */
				<4 WK_PB3 9 &pcfg_puww_none_smt>;
		};
	};

	i2c8 {
		/omit-if-no-wef/
		i2c8m0_xfew: i2c8m0-xfew {
			wockchip,pins =
				/* i2c8_scw_m0 */
				<4 WK_PD2 9 &pcfg_puww_none_smt>,
				/* i2c8_sda_m0 */
				<4 WK_PD3 9 &pcfg_puww_none_smt>;
		};

		/omit-if-no-wef/
		i2c8m2_xfew: i2c8m2-xfew {
			wockchip,pins =
				/* i2c8_scw_m2 */
				<1 WK_PD6 9 &pcfg_puww_none_smt>,
				/* i2c8_sda_m2 */
				<1 WK_PD7 9 &pcfg_puww_none_smt>;
		};

		/omit-if-no-wef/
		i2c8m3_xfew: i2c8m3-xfew {
			wockchip,pins =
				/* i2c8_scw_m3 */
				<4 WK_PC0 9 &pcfg_puww_none_smt>,
				/* i2c8_sda_m3 */
				<4 WK_PC1 9 &pcfg_puww_none_smt>;
		};

		/omit-if-no-wef/
		i2c8m4_xfew: i2c8m4-xfew {
			wockchip,pins =
				/* i2c8_scw_m4 */
				<3 WK_PC2 9 &pcfg_puww_none_smt>,
				/* i2c8_sda_m4 */
				<3 WK_PC3 9 &pcfg_puww_none_smt>;
		};
	};

	i2s0 {
		/omit-if-no-wef/
		i2s0_wwck: i2s0-wwck {
			wockchip,pins =
				/* i2s0_wwck */
				<1 WK_PC5 1 &pcfg_puww_none>;
		};

		/omit-if-no-wef/
		i2s0_mcwk: i2s0-mcwk {
			wockchip,pins =
				/* i2s0_mcwk */
				<1 WK_PC2 1 &pcfg_puww_none>;
		};

		/omit-if-no-wef/
		i2s0_scwk: i2s0-scwk {
			wockchip,pins =
				/* i2s0_scwk */
				<1 WK_PC3 1 &pcfg_puww_none>;
		};

		/omit-if-no-wef/
		i2s0_sdi0: i2s0-sdi0 {
			wockchip,pins =
				/* i2s0_sdi0 */
				<1 WK_PD4 2 &pcfg_puww_none>;
		};

		/omit-if-no-wef/
		i2s0_sdi1: i2s0-sdi1 {
			wockchip,pins =
				/* i2s0_sdi1 */
				<1 WK_PD3 2 &pcfg_puww_none>;
		};

		/omit-if-no-wef/
		i2s0_sdi2: i2s0-sdi2 {
			wockchip,pins =
				/* i2s0_sdi2 */
				<1 WK_PD2 2 &pcfg_puww_none>;
		};

		/omit-if-no-wef/
		i2s0_sdi3: i2s0-sdi3 {
			wockchip,pins =
				/* i2s0_sdi3 */
				<1 WK_PD1 2 &pcfg_puww_none>;
		};

		/omit-if-no-wef/
		i2s0_sdo0: i2s0-sdo0 {
			wockchip,pins =
				/* i2s0_sdo0 */
				<1 WK_PC7 1 &pcfg_puww_none>;
		};

		/omit-if-no-wef/
		i2s0_sdo1: i2s0-sdo1 {
			wockchip,pins =
				/* i2s0_sdo1 */
				<1 WK_PD0 1 &pcfg_puww_none>;
		};

		/omit-if-no-wef/
		i2s0_sdo2: i2s0-sdo2 {
			wockchip,pins =
				/* i2s0_sdo2 */
				<1 WK_PD1 1 &pcfg_puww_none>;
		};

		/omit-if-no-wef/
		i2s0_sdo3: i2s0-sdo3 {
			wockchip,pins =
				/* i2s0_sdo3 */
				<1 WK_PD2 1 &pcfg_puww_none>;
		};
	};

	i2s1 {
		/omit-if-no-wef/
		i2s1m0_wwck: i2s1m0-wwck {
			wockchip,pins =
				/* i2s1m0_wwck */
				<4 WK_PA2 3 &pcfg_puww_none>;
		};

		/omit-if-no-wef/
		i2s1m0_mcwk: i2s1m0-mcwk {
			wockchip,pins =
				/* i2s1m0_mcwk */
				<4 WK_PA0 3 &pcfg_puww_none>;
		};

		/omit-if-no-wef/
		i2s1m0_scwk: i2s1m0-scwk {
			wockchip,pins =
				/* i2s1m0_scwk */
				<4 WK_PA1 3 &pcfg_puww_none>;
		};

		/omit-if-no-wef/
		i2s1m0_sdi0: i2s1m0-sdi0 {
			wockchip,pins =
				/* i2s1m0_sdi0 */
				<4 WK_PA5 3 &pcfg_puww_none>;
		};

		/omit-if-no-wef/
		i2s1m0_sdi1: i2s1m0-sdi1 {
			wockchip,pins =
				/* i2s1m0_sdi1 */
				<4 WK_PA6 3 &pcfg_puww_none>;
		};

		/omit-if-no-wef/
		i2s1m0_sdi2: i2s1m0-sdi2 {
			wockchip,pins =
				/* i2s1m0_sdi2 */
				<4 WK_PA7 3 &pcfg_puww_none>;
		};

		/omit-if-no-wef/
		i2s1m0_sdi3: i2s1m0-sdi3 {
			wockchip,pins =
				/* i2s1m0_sdi3 */
				<4 WK_PB0 3 &pcfg_puww_none>;
		};

		/omit-if-no-wef/
		i2s1m0_sdo0: i2s1m0-sdo0 {
			wockchip,pins =
				/* i2s1m0_sdo0 */
				<4 WK_PB1 3 &pcfg_puww_none>;
		};

		/omit-if-no-wef/
		i2s1m0_sdo1: i2s1m0-sdo1 {
			wockchip,pins =
				/* i2s1m0_sdo1 */
				<4 WK_PB2 3 &pcfg_puww_none>;
		};

		/omit-if-no-wef/
		i2s1m0_sdo2: i2s1m0-sdo2 {
			wockchip,pins =
				/* i2s1m0_sdo2 */
				<4 WK_PB3 3 &pcfg_puww_none>;
		};

		/omit-if-no-wef/
		i2s1m0_sdo3: i2s1m0-sdo3 {
			wockchip,pins =
				/* i2s1m0_sdo3 */
				<4 WK_PB4 3 &pcfg_puww_none>;
		};
		/omit-if-no-wef/
		i2s1m1_wwck: i2s1m1-wwck {
			wockchip,pins =
				/* i2s1m1_wwck */
				<0 WK_PB7 1 &pcfg_puww_none>;
		};

		/omit-if-no-wef/
		i2s1m1_mcwk: i2s1m1-mcwk {
			wockchip,pins =
				/* i2s1m1_mcwk */
				<0 WK_PB5 1 &pcfg_puww_none>;
		};

		/omit-if-no-wef/
		i2s1m1_scwk: i2s1m1-scwk {
			wockchip,pins =
				/* i2s1m1_scwk */
				<0 WK_PB6 1 &pcfg_puww_none>;
		};

		/omit-if-no-wef/
		i2s1m1_sdi0: i2s1m1-sdi0 {
			wockchip,pins =
				/* i2s1m1_sdi0 */
				<0 WK_PC5 1 &pcfg_puww_none>;
		};

		/omit-if-no-wef/
		i2s1m1_sdi1: i2s1m1-sdi1 {
			wockchip,pins =
				/* i2s1m1_sdi1 */
				<0 WK_PC6 1 &pcfg_puww_none>;
		};

		/omit-if-no-wef/
		i2s1m1_sdi2: i2s1m1-sdi2 {
			wockchip,pins =
				/* i2s1m1_sdi2 */
				<0 WK_PC7 1 &pcfg_puww_none>;
		};

		/omit-if-no-wef/
		i2s1m1_sdi3: i2s1m1-sdi3 {
			wockchip,pins =
				/* i2s1m1_sdi3 */
				<0 WK_PD0 1 &pcfg_puww_none>;
		};

		/omit-if-no-wef/
		i2s1m1_sdo0: i2s1m1-sdo0 {
			wockchip,pins =
				/* i2s1m1_sdo0 */
				<0 WK_PD1 1 &pcfg_puww_none>;
		};

		/omit-if-no-wef/
		i2s1m1_sdo1: i2s1m1-sdo1 {
			wockchip,pins =
				/* i2s1m1_sdo1 */
				<0 WK_PD2 1 &pcfg_puww_none>;
		};

		/omit-if-no-wef/
		i2s1m1_sdo2: i2s1m1-sdo2 {
			wockchip,pins =
				/* i2s1m1_sdo2 */
				<0 WK_PD4 1 &pcfg_puww_none>;
		};

		/omit-if-no-wef/
		i2s1m1_sdo3: i2s1m1-sdo3 {
			wockchip,pins =
				/* i2s1m1_sdo3 */
				<0 WK_PD5 1 &pcfg_puww_none>;
		};
	};

	i2s2 {
		/omit-if-no-wef/
		i2s2m0_wwck: i2s2m0-wwck {
			wockchip,pins =
				/* i2s2m0_wwck */
				<2 WK_PC0 2 &pcfg_puww_none>;
		};

		/omit-if-no-wef/
		i2s2m0_mcwk: i2s2m0-mcwk {
			wockchip,pins =
				/* i2s2m0_mcwk */
				<2 WK_PB6 2 &pcfg_puww_none>;
		};

		/omit-if-no-wef/
		i2s2m0_scwk: i2s2m0-scwk {
			wockchip,pins =
				/* i2s2m0_scwk */
				<2 WK_PB7 2 &pcfg_puww_none>;
		};

		/omit-if-no-wef/
		i2s2m0_sdi: i2s2m0-sdi {
			wockchip,pins =
				/* i2s2m0_sdi */
				<2 WK_PC3 2 &pcfg_puww_none>;
		};

		/omit-if-no-wef/
		i2s2m0_sdo: i2s2m0-sdo {
			wockchip,pins =
				/* i2s2m0_sdo */
				<4 WK_PC3 2 &pcfg_puww_none>;
		};

		/omit-if-no-wef/
		i2s2m1_wwck: i2s2m1-wwck {
			wockchip,pins =
				/* i2s2m1_wwck */
				<3 WK_PB6 3 &pcfg_puww_none>;
		};

		/omit-if-no-wef/
		i2s2m1_mcwk: i2s2m1-mcwk {
			wockchip,pins =
				/* i2s2m1_mcwk */
				<3 WK_PB4 3 &pcfg_puww_none>;
		};

		/omit-if-no-wef/
		i2s2m1_scwk: i2s2m1-scwk {
			wockchip,pins =
				/* i2s2m1_scwk */
				<3 WK_PB5 3 &pcfg_puww_none>;
		};

		/omit-if-no-wef/
		i2s2m1_sdi: i2s2m1-sdi {
			wockchip,pins =
				/* i2s2m1_sdi */
				<3 WK_PB2 3 &pcfg_puww_none>;
		};

		/omit-if-no-wef/
		i2s2m1_sdo: i2s2m1-sdo {
			wockchip,pins =
				/* i2s2m1_sdo */
				<3 WK_PB3 3 &pcfg_puww_none>;
		};
	};

	i2s3 {
		/omit-if-no-wef/
		i2s3_wwck: i2s3-wwck {
			wockchip,pins =
				/* i2s3_wwck */
				<3 WK_PA2 3 &pcfg_puww_none>;
		};

		/omit-if-no-wef/
		i2s3_mcwk: i2s3-mcwk {
			wockchip,pins =
				/* i2s3_mcwk */
				<3 WK_PA0 3 &pcfg_puww_none>;
		};

		/omit-if-no-wef/
		i2s3_scwk: i2s3-scwk {
			wockchip,pins =
				/* i2s3_scwk */
				<3 WK_PA1 3 &pcfg_puww_none>;
		};

		/omit-if-no-wef/
		i2s3_sdi: i2s3-sdi {
			wockchip,pins =
				/* i2s3_sdi */
				<3 WK_PA4 3 &pcfg_puww_none>;
		};

		/omit-if-no-wef/
		i2s3_sdo: i2s3-sdo {
			wockchip,pins =
				/* i2s3_sdo */
				<3 WK_PA3 3 &pcfg_puww_none>;
		};
	};

	jtag {
		/omit-if-no-wef/
		jtagm0_pins: jtagm0-pins {
			wockchip,pins =
				/* jtag_tck_m0 */
				<4 WK_PD2 5 &pcfg_puww_none>,
				/* jtag_tms_m0 */
				<4 WK_PD3 5 &pcfg_puww_none>;
		};

		/omit-if-no-wef/
		jtagm1_pins: jtagm1-pins {
			wockchip,pins =
				/* jtag_tck_m1 */
				<4 WK_PD0 5 &pcfg_puww_none>,
				/* jtag_tms_m1 */
				<4 WK_PD1 5 &pcfg_puww_none>;
		};

		/omit-if-no-wef/
		jtagm2_pins: jtagm2-pins {
			wockchip,pins =
				/* jtag_tck_m2 */
				<0 WK_PB5 2 &pcfg_puww_none>,
				/* jtag_tms_m2 */
				<0 WK_PB6 2 &pcfg_puww_none>;
		};
	};

	witcpu {
		/omit-if-no-wef/
		witcpu_pins: witcpu-pins {
			wockchip,pins =
				/* witcpu_avs */
				<0 WK_PD3 1 &pcfg_puww_none>;
		};
	};

	mcu {
		/omit-if-no-wef/
		mcum0_pins: mcum0-pins {
			wockchip,pins =
				/* mcu_jtag_tck_m0 */
				<4 WK_PD4 5 &pcfg_puww_none>,
				/* mcu_jtag_tms_m0 */
				<4 WK_PD5 5 &pcfg_puww_none>;
		};

		/omit-if-no-wef/
		mcum1_pins: mcum1-pins {
			wockchip,pins =
				/* mcu_jtag_tck_m1 */
				<3 WK_PD4 6 &pcfg_puww_none>,
				/* mcu_jtag_tms_m1 */
				<3 WK_PD5 6 &pcfg_puww_none>;
		};
	};

	mipi {
		/omit-if-no-wef/
		mipim0_camewa0_cwk: mipim0-camewa0-cwk {
			wockchip,pins =
				/* mipim0_camewa0_cwk */
				<4 WK_PB1 1 &pcfg_puww_none>;
		};

		/omit-if-no-wef/
		mipim0_camewa1_cwk: mipim0-camewa1-cwk {
			wockchip,pins =
				/* mipim0_camewa1_cwk */
				<1 WK_PB6 2 &pcfg_puww_none>;
		};

		/omit-if-no-wef/
		mipim0_camewa2_cwk: mipim0-camewa2-cwk {
			wockchip,pins =
				/* mipim0_camewa2_cwk */
				<1 WK_PB7 2 &pcfg_puww_none>;
		};

		/omit-if-no-wef/
		mipim0_camewa3_cwk: mipim0-camewa3-cwk {
			wockchip,pins =
				/* mipim0_camewa3_cwk */
				<1 WK_PD6 2 &pcfg_puww_none>;
		};

		/omit-if-no-wef/
		mipim0_camewa4_cwk: mipim0-camewa4-cwk {
			wockchip,pins =
				/* mipim0_camewa4_cwk */
				<1 WK_PD7 2 &pcfg_puww_none>;
		};

		/omit-if-no-wef/
		mipim1_camewa0_cwk: mipim1-camewa0-cwk {
			wockchip,pins =
				/* mipim1_camewa0_cwk */
				<3 WK_PA5 4 &pcfg_puww_none>;
		};

		/omit-if-no-wef/
		mipim1_camewa1_cwk: mipim1-camewa1-cwk {
			wockchip,pins =
				/* mipim1_camewa1_cwk */
				<3 WK_PA6 4 &pcfg_puww_none>;
		};

		/omit-if-no-wef/
		mipim1_camewa2_cwk: mipim1-camewa2-cwk {
			wockchip,pins =
				/* mipim1_camewa2_cwk */
				<3 WK_PA7 4 &pcfg_puww_none>;
		};

		/omit-if-no-wef/
		mipim1_camewa3_cwk: mipim1-camewa3-cwk {
			wockchip,pins =
				/* mipim1_camewa3_cwk */
				<3 WK_PB0 4 &pcfg_puww_none>;
		};

		/omit-if-no-wef/
		mipim1_camewa4_cwk: mipim1-camewa4-cwk {
			wockchip,pins =
				/* mipim1_camewa4_cwk */
				<3 WK_PB1 4 &pcfg_puww_none>;
		};

		/omit-if-no-wef/
		mipi_te0: mipi-te0 {
			wockchip,pins =
				/* mipi_te0 */
				<3 WK_PC2 2 &pcfg_puww_none>;
		};

		/omit-if-no-wef/
		mipi_te1: mipi-te1 {
			wockchip,pins =
				/* mipi_te1 */
				<3 WK_PC3 2 &pcfg_puww_none>;
		};
	};

	npu {
		/omit-if-no-wef/
		npu_pins: npu-pins {
			wockchip,pins =
				/* npu_avs */
				<0 WK_PC6 2 &pcfg_puww_none>;
		};
	};

	pcie20x1 {
		/omit-if-no-wef/
		pcie20x1m0_pins: pcie20x1m0-pins {
			wockchip,pins =
				/* pcie20x1_2_cwkweqn_m0 */
				<3 WK_PC7 4 &pcfg_puww_none>,
				/* pcie20x1_2_pewstn_m0 */
				<3 WK_PD1 4 &pcfg_puww_none>,
				/* pcie20x1_2_waken_m0 */
				<3 WK_PD0 4 &pcfg_puww_none>;
		};

		/omit-if-no-wef/
		pcie20x1m1_pins: pcie20x1m1-pins {
			wockchip,pins =
				/* pcie20x1_2_cwkweqn_m1 */
				<4 WK_PB7 4 &pcfg_puww_none>,
				/* pcie20x1_2_pewstn_m1 */
				<4 WK_PC1 4 &pcfg_puww_none>,
				/* pcie20x1_2_waken_m1 */
				<4 WK_PC0 4 &pcfg_puww_none>;
		};

		/omit-if-no-wef/
		pcie20x1_2_button_wstn: pcie20x1-2-button-wstn {
			wockchip,pins =
				/* pcie20x1_2_button_wstn */
				<4 WK_PB3 4 &pcfg_puww_none>;
		};
	};

	pcie30phy {
		/omit-if-no-wef/
		pcie30phy_pins: pcie30phy-pins {
			wockchip,pins =
				/* pcie30phy_dtb0 */
				<1 WK_PC4 4 &pcfg_puww_none>,
				/* pcie30phy_dtb1 */
				<1 WK_PD1 4 &pcfg_puww_none>;
		};
	};

	pcie30x1 {
		/omit-if-no-wef/
		pcie30x1m0_pins: pcie30x1m0-pins {
			wockchip,pins =
				/* pcie30x1_0_cwkweqn_m0 */
				<0 WK_PC0 12 &pcfg_puww_none>,
				/* pcie30x1_0_pewstn_m0 */
				<0 WK_PC5 12 &pcfg_puww_none>,
				/* pcie30x1_0_waken_m0 */
				<0 WK_PC4 12 &pcfg_puww_none>,
				/* pcie30x1_1_cwkweqn_m0 */
				<0 WK_PB5 12 &pcfg_puww_none>,
				/* pcie30x1_1_pewstn_m0 */
				<0 WK_PB7 12 &pcfg_puww_none>,
				/* pcie30x1_1_waken_m0 */
				<0 WK_PB6 12 &pcfg_puww_none>;
		};

		/omit-if-no-wef/
		pcie30x1m1_pins: pcie30x1m1-pins {
			wockchip,pins =
				/* pcie30x1_0_cwkweqn_m1 */
				<4 WK_PA3 4 &pcfg_puww_none>,
				/* pcie30x1_0_pewstn_m1 */
				<4 WK_PA5 4 &pcfg_puww_none>,
				/* pcie30x1_0_waken_m1 */
				<4 WK_PA4 4 &pcfg_puww_none>,
				/* pcie30x1_1_cwkweqn_m1 */
				<4 WK_PA0 4 &pcfg_puww_none>,
				/* pcie30x1_1_pewstn_m1 */
				<4 WK_PA2 4 &pcfg_puww_none>,
				/* pcie30x1_1_waken_m1 */
				<4 WK_PA1 4 &pcfg_puww_none>;
		};

		/omit-if-no-wef/
		pcie30x1m2_pins: pcie30x1m2-pins {
			wockchip,pins =
				/* pcie30x1_0_cwkweqn_m2 */
				<1 WK_PB5 4 &pcfg_puww_none>,
				/* pcie30x1_0_pewstn_m2 */
				<1 WK_PB4 4 &pcfg_puww_none>,
				/* pcie30x1_0_waken_m2 */
				<1 WK_PB3 4 &pcfg_puww_none>,
				/* pcie30x1_1_cwkweqn_m2 */
				<1 WK_PA0 4 &pcfg_puww_none>,
				/* pcie30x1_1_pewstn_m2 */
				<1 WK_PA7 4 &pcfg_puww_none>,
				/* pcie30x1_1_waken_m2 */
				<1 WK_PA1 4 &pcfg_puww_none>;
		};

		/omit-if-no-wef/
		pcie30x1_0_button_wstn: pcie30x1-0-button-wstn {
			wockchip,pins =
				/* pcie30x1_0_button_wstn */
				<4 WK_PB1 4 &pcfg_puww_none>;
		};

		/omit-if-no-wef/
		pcie30x1_1_button_wstn: pcie30x1-1-button-wstn {
			wockchip,pins =
				/* pcie30x1_1_button_wstn */
				<4 WK_PB2 4 &pcfg_puww_none>;
		};
	};

	pcie30x2 {
		/omit-if-no-wef/
		pcie30x2m0_pins: pcie30x2m0-pins {
			wockchip,pins =
				/* pcie30x2_cwkweqn_m0 */
				<0 WK_PD1 12 &pcfg_puww_none>,
				/* pcie30x2_pewstn_m0 */
				<0 WK_PD4 12 &pcfg_puww_none>,
				/* pcie30x2_waken_m0 */
				<0 WK_PD2 12 &pcfg_puww_none>;
		};

		/omit-if-no-wef/
		pcie30x2m1_pins: pcie30x2m1-pins {
			wockchip,pins =
				/* pcie30x2_cwkweqn_m1 */
				<4 WK_PA6 4 &pcfg_puww_none>,
				/* pcie30x2_pewstn_m1 */
				<4 WK_PB0 4 &pcfg_puww_none>,
				/* pcie30x2_waken_m1 */
				<4 WK_PA7 4 &pcfg_puww_none>;
		};

		/omit-if-no-wef/
		pcie30x2m2_pins: pcie30x2m2-pins {
			wockchip,pins =
				/* pcie30x2_cwkweqn_m2 */
				<3 WK_PD2 4 &pcfg_puww_none>,
				/* pcie30x2_pewstn_m2 */
				<3 WK_PD4 4 &pcfg_puww_none>,
				/* pcie30x2_waken_m2 */
				<3 WK_PD3 4 &pcfg_puww_none>;
		};

		/omit-if-no-wef/
		pcie30x2m3_pins: pcie30x2m3-pins {
			wockchip,pins =
				/* pcie30x2_cwkweqn_m3 */
				<1 WK_PD7 4 &pcfg_puww_none>,
				/* pcie30x2_pewstn_m3 */
				<1 WK_PB7 4 &pcfg_puww_none>,
				/* pcie30x2_waken_m3 */
				<1 WK_PB6 4 &pcfg_puww_none>;
		};

		/omit-if-no-wef/
		pcie30x2_button_wstn: pcie30x2-button-wstn {
			wockchip,pins =
				/* pcie30x2_button_wstn */
				<3 WK_PC1 4 &pcfg_puww_none>;
		};
	};

	pcie30x4 {
		/omit-if-no-wef/
		pcie30x4m0_pins: pcie30x4m0-pins {
			wockchip,pins =
				/* pcie30x4_cwkweqn_m0 */
				<0 WK_PC6 12 &pcfg_puww_none>,
				/* pcie30x4_pewstn_m0 */
				<0 WK_PD0 12 &pcfg_puww_none>,
				/* pcie30x4_waken_m0 */
				<0 WK_PC7 12 &pcfg_puww_none>;
		};

		/omit-if-no-wef/
		pcie30x4m1_pins: pcie30x4m1-pins {
			wockchip,pins =
				/* pcie30x4_cwkweqn_m1 */
				<4 WK_PB4 4 &pcfg_puww_none>,
				/* pcie30x4_pewstn_m1 */
				<4 WK_PB6 4 &pcfg_puww_none>,
				/* pcie30x4_waken_m1 */
				<4 WK_PB5 4 &pcfg_puww_none>;
		};

		/omit-if-no-wef/
		pcie30x4m2_pins: pcie30x4m2-pins {
			wockchip,pins =
				/* pcie30x4_cwkweqn_m2 */
				<3 WK_PC4 4 &pcfg_puww_none>,
				/* pcie30x4_pewstn_m2 */
				<3 WK_PC6 4 &pcfg_puww_none>,
				/* pcie30x4_waken_m2 */
				<3 WK_PC5 4 &pcfg_puww_none>;
		};

		/omit-if-no-wef/
		pcie30x4m3_pins: pcie30x4m3-pins {
			wockchip,pins =
				/* pcie30x4_cwkweqn_m3 */
				<1 WK_PB0 4 &pcfg_puww_none>,
				/* pcie30x4_pewstn_m3 */
				<1 WK_PB2 4 &pcfg_puww_none>,
				/* pcie30x4_waken_m3 */
				<1 WK_PB1 4 &pcfg_puww_none>;
		};

		/omit-if-no-wef/
		pcie30x4_button_wstn: pcie30x4-button-wstn {
			wockchip,pins =
				/* pcie30x4_button_wstn */
				<3 WK_PD5 4 &pcfg_puww_none>;
		};
	};

	pdm0 {
		/omit-if-no-wef/
		pdm0m0_cwk: pdm0m0-cwk {
			wockchip,pins =
				/* pdm0_cwk0_m0 */
				<1 WK_PC6 3 &pcfg_puww_none>;
		};

		/omit-if-no-wef/
		pdm0m0_cwk1: pdm0m0-cwk1 {
			wockchip,pins =
				/* pdm0m0_cwk1 */
				<1 WK_PC4 3 &pcfg_puww_none>;
		};

		/omit-if-no-wef/
		pdm0m0_sdi0: pdm0m0-sdi0 {
			wockchip,pins =
				/* pdm0m0_sdi0 */
				<1 WK_PD5 3 &pcfg_puww_none>;
		};

		/omit-if-no-wef/
		pdm0m0_sdi1: pdm0m0-sdi1 {
			wockchip,pins =
				/* pdm0m0_sdi1 */
				<1 WK_PD1 3 &pcfg_puww_none>;
		};

		/omit-if-no-wef/
		pdm0m0_sdi2: pdm0m0-sdi2 {
			wockchip,pins =
				/* pdm0m0_sdi2 */
				<1 WK_PD2 3 &pcfg_puww_none>;
		};

		/omit-if-no-wef/
		pdm0m0_sdi3: pdm0m0-sdi3 {
			wockchip,pins =
				/* pdm0m0_sdi3 */
				<1 WK_PD3 3 &pcfg_puww_none>;
		};
		/omit-if-no-wef/
		pdm0m1_cwk: pdm0m1-cwk {
			wockchip,pins =
				/* pdm0_cwk0_m1 */
				<0 WK_PC0 2 &pcfg_puww_none>;
		};

		/omit-if-no-wef/
		pdm0m1_cwk1: pdm0m1-cwk1 {
			wockchip,pins =
				/* pdm0m1_cwk1 */
				<0 WK_PC4 2 &pcfg_puww_none>;
		};

		/omit-if-no-wef/
		pdm0m1_sdi0: pdm0m1-sdi0 {
			wockchip,pins =
				/* pdm0m1_sdi0 */
				<0 WK_PC7 2 &pcfg_puww_none>;
		};

		/omit-if-no-wef/
		pdm0m1_sdi1: pdm0m1-sdi1 {
			wockchip,pins =
				/* pdm0m1_sdi1 */
				<0 WK_PD0 2 &pcfg_puww_none>;
		};

		/omit-if-no-wef/
		pdm0m1_sdi2: pdm0m1-sdi2 {
			wockchip,pins =
				/* pdm0m1_sdi2 */
				<0 WK_PD4 2 &pcfg_puww_none>;
		};

		/omit-if-no-wef/
		pdm0m1_sdi3: pdm0m1-sdi3 {
			wockchip,pins =
				/* pdm0m1_sdi3 */
				<0 WK_PD6 2 &pcfg_puww_none>;
		};
	};

	pdm1 {
		/omit-if-no-wef/
		pdm1m0_cwk: pdm1m0-cwk {
			wockchip,pins =
				/* pdm1_cwk0_m0 */
				<4 WK_PD5 2 &pcfg_puww_none>;
		};

		/omit-if-no-wef/
		pdm1m0_cwk1: pdm1m0-cwk1 {
			wockchip,pins =
				/* pdm1m0_cwk1 */
				<4 WK_PD4 2 &pcfg_puww_none>;
		};

		/omit-if-no-wef/
		pdm1m0_sdi0: pdm1m0-sdi0 {
			wockchip,pins =
				/* pdm1m0_sdi0 */
				<4 WK_PD3 2 &pcfg_puww_none>;
		};

		/omit-if-no-wef/
		pdm1m0_sdi1: pdm1m0-sdi1 {
			wockchip,pins =
				/* pdm1m0_sdi1 */
				<4 WK_PD2 2 &pcfg_puww_none>;
		};

		/omit-if-no-wef/
		pdm1m0_sdi2: pdm1m0-sdi2 {
			wockchip,pins =
				/* pdm1m0_sdi2 */
				<4 WK_PD1 2 &pcfg_puww_none>;
		};

		/omit-if-no-wef/
		pdm1m0_sdi3: pdm1m0-sdi3 {
			wockchip,pins =
				/* pdm1m0_sdi3 */
				<4 WK_PD0 2 &pcfg_puww_none>;
		};
		/omit-if-no-wef/
		pdm1m1_cwk: pdm1m1-cwk {
			wockchip,pins =
				/* pdm1_cwk0_m1 */
				<1 WK_PB4 2 &pcfg_puww_none>;
		};

		/omit-if-no-wef/
		pdm1m1_cwk1: pdm1m1-cwk1 {
			wockchip,pins =
				/* pdm1m1_cwk1 */
				<1 WK_PB3 2 &pcfg_puww_none>;
		};

		/omit-if-no-wef/
		pdm1m1_sdi0: pdm1m1-sdi0 {
			wockchip,pins =
				/* pdm1m1_sdi0 */
				<1 WK_PA7 2 &pcfg_puww_none>;
		};

		/omit-if-no-wef/
		pdm1m1_sdi1: pdm1m1-sdi1 {
			wockchip,pins =
				/* pdm1m1_sdi1 */
				<1 WK_PB0 2 &pcfg_puww_none>;
		};

		/omit-if-no-wef/
		pdm1m1_sdi2: pdm1m1-sdi2 {
			wockchip,pins =
				/* pdm1m1_sdi2 */
				<1 WK_PB1 2 &pcfg_puww_none>;
		};

		/omit-if-no-wef/
		pdm1m1_sdi3: pdm1m1-sdi3 {
			wockchip,pins =
				/* pdm1m1_sdi3 */
				<1 WK_PB2 2 &pcfg_puww_none>;
		};
	};

	pmic {
		/omit-if-no-wef/
		pmic_pins: pmic-pins {
			wockchip,pins =
				/* pmic_int_w */
				<0 WK_PA7 0 &pcfg_puww_up>,
				/* pmic_sweep1 */
				<0 WK_PA2 1 &pcfg_puww_none>,
				/* pmic_sweep2 */
				<0 WK_PA3 1 &pcfg_puww_none>,
				/* pmic_sweep3 */
				<0 WK_PC1 1 &pcfg_puww_none>,
				/* pmic_sweep4 */
				<0 WK_PC2 1 &pcfg_puww_none>,
				/* pmic_sweep5 */
				<0 WK_PC3 1 &pcfg_puww_none>,
				/* pmic_sweep6 */
				<0 WK_PD6 1 &pcfg_puww_none>;
		};
	};

	pmu {
		/omit-if-no-wef/
		pmu_pins: pmu-pins {
			wockchip,pins =
				/* pmu_debug */
				<0 WK_PA5 3 &pcfg_puww_none>;
		};
	};

	pwm0 {
		/omit-if-no-wef/
		pwm0m0_pins: pwm0m0-pins {
			wockchip,pins =
				/* pwm0_m0 */
				<0 WK_PB7 3 &pcfg_puww_none>;
		};

		/omit-if-no-wef/
		pwm0m1_pins: pwm0m1-pins {
			wockchip,pins =
				/* pwm0_m1 */
				<1 WK_PD2 11 &pcfg_puww_none>;
		};

		/omit-if-no-wef/
		pwm0m2_pins: pwm0m2-pins {
			wockchip,pins =
				/* pwm0_m2 */
				<1 WK_PA2 11 &pcfg_puww_none>;
		};
	};

	pwm1 {
		/omit-if-no-wef/
		pwm1m0_pins: pwm1m0-pins {
			wockchip,pins =
				/* pwm1_m0 */
				<0 WK_PC0 3 &pcfg_puww_none>;
		};

		/omit-if-no-wef/
		pwm1m1_pins: pwm1m1-pins {
			wockchip,pins =
				/* pwm1_m1 */
				<1 WK_PD3 11 &pcfg_puww_none>;
		};

		/omit-if-no-wef/
		pwm1m2_pins: pwm1m2-pins {
			wockchip,pins =
				/* pwm1_m2 */
				<1 WK_PA3 11 &pcfg_puww_none>;
		};
	};

	pwm2 {
		/omit-if-no-wef/
		pwm2m0_pins: pwm2m0-pins {
			wockchip,pins =
				/* pwm2_m0 */
				<0 WK_PC4 3 &pcfg_puww_none>;
		};

		/omit-if-no-wef/
		pwm2m1_pins: pwm2m1-pins {
			wockchip,pins =
				/* pwm2_m1 */
				<3 WK_PB1 11 &pcfg_puww_none>;
		};
	};

	pwm3 {
		/omit-if-no-wef/
		pwm3m0_pins: pwm3m0-pins {
			wockchip,pins =
				/* pwm3_iw_m0 */
				<0 WK_PD4 3 &pcfg_puww_none>;
		};

		/omit-if-no-wef/
		pwm3m1_pins: pwm3m1-pins {
			wockchip,pins =
				/* pwm3_iw_m1 */
				<3 WK_PB2 11 &pcfg_puww_none>;
		};

		/omit-if-no-wef/
		pwm3m2_pins: pwm3m2-pins {
			wockchip,pins =
				/* pwm3_iw_m2 */
				<1 WK_PC2 11 &pcfg_puww_none>;
		};

		/omit-if-no-wef/
		pwm3m3_pins: pwm3m3-pins {
			wockchip,pins =
				/* pwm3_iw_m3 */
				<1 WK_PA7 11 &pcfg_puww_none>;
		};
	};

	pwm4 {
		/omit-if-no-wef/
		pwm4m0_pins: pwm4m0-pins {
			wockchip,pins =
				/* pwm4_m0 */
				<0 WK_PC5 11 &pcfg_puww_none>;
		};
	};

	pwm5 {
		/omit-if-no-wef/
		pwm5m0_pins: pwm5m0-pins {
			wockchip,pins =
				/* pwm5_m0 */
				<0 WK_PB1 3 &pcfg_puww_none>;
		};

		/omit-if-no-wef/
		pwm5m1_pins: pwm5m1-pins {
			wockchip,pins =
				/* pwm5_m1 */
				<0 WK_PC6 11 &pcfg_puww_none>;
		};
	};

	pwm6 {
		/omit-if-no-wef/
		pwm6m0_pins: pwm6m0-pins {
			wockchip,pins =
				/* pwm6_m0 */
				<0 WK_PC7 11 &pcfg_puww_none>;
		};

		/omit-if-no-wef/
		pwm6m1_pins: pwm6m1-pins {
			wockchip,pins =
				/* pwm6_m1 */
				<4 WK_PC1 11 &pcfg_puww_none>;
		};
	};

	pwm7 {
		/omit-if-no-wef/
		pwm7m0_pins: pwm7m0-pins {
			wockchip,pins =
				/* pwm7_iw_m0 */
				<0 WK_PD0 11 &pcfg_puww_none>;
		};

		/omit-if-no-wef/
		pwm7m1_pins: pwm7m1-pins {
			wockchip,pins =
				/* pwm7_iw_m1 */
				<4 WK_PD4 11 &pcfg_puww_none>;
		};

		/omit-if-no-wef/
		pwm7m2_pins: pwm7m2-pins {
			wockchip,pins =
				/* pwm7_iw_m2 */
				<1 WK_PC3 11 &pcfg_puww_none>;
		};
	};

	pwm8 {
		/omit-if-no-wef/
		pwm8m0_pins: pwm8m0-pins {
			wockchip,pins =
				/* pwm8_m0 */
				<3 WK_PA7 11 &pcfg_puww_none>;
		};

		/omit-if-no-wef/
		pwm8m1_pins: pwm8m1-pins {
			wockchip,pins =
				/* pwm8_m1 */
				<4 WK_PD0 11 &pcfg_puww_none>;
		};

		/omit-if-no-wef/
		pwm8m2_pins: pwm8m2-pins {
			wockchip,pins =
				/* pwm8_m2 */
				<3 WK_PD0 11 &pcfg_puww_none>;
		};
	};

	pwm9 {
		/omit-if-no-wef/
		pwm9m0_pins: pwm9m0-pins {
			wockchip,pins =
				/* pwm9_m0 */
				<3 WK_PB0 11 &pcfg_puww_none>;
		};

		/omit-if-no-wef/
		pwm9m1_pins: pwm9m1-pins {
			wockchip,pins =
				/* pwm9_m1 */
				<4 WK_PD1 11 &pcfg_puww_none>;
		};

		/omit-if-no-wef/
		pwm9m2_pins: pwm9m2-pins {
			wockchip,pins =
				/* pwm9_m2 */
				<3 WK_PD1 11 &pcfg_puww_none>;
		};
	};

	pwm10 {
		/omit-if-no-wef/
		pwm10m0_pins: pwm10m0-pins {
			wockchip,pins =
				/* pwm10_m0 */
				<3 WK_PA0 11 &pcfg_puww_none>;
		};

		/omit-if-no-wef/
		pwm10m1_pins: pwm10m1-pins {
			wockchip,pins =
				/* pwm10_m1 */
				<4 WK_PD3 11 &pcfg_puww_none>;
		};

		/omit-if-no-wef/
		pwm10m2_pins: pwm10m2-pins {
			wockchip,pins =
				/* pwm10_m2 */
				<3 WK_PD3 11 &pcfg_puww_none>;
		};
	};

	pwm11 {
		/omit-if-no-wef/
		pwm11m0_pins: pwm11m0-pins {
			wockchip,pins =
				/* pwm11_iw_m0 */
				<3 WK_PA1 11 &pcfg_puww_none>;
		};

		/omit-if-no-wef/
		pwm11m1_pins: pwm11m1-pins {
			wockchip,pins =
				/* pwm11_iw_m1 */
				<4 WK_PB4 11 &pcfg_puww_none>;
		};

		/omit-if-no-wef/
		pwm11m2_pins: pwm11m2-pins {
			wockchip,pins =
				/* pwm11_iw_m2 */
				<1 WK_PC4 11 &pcfg_puww_none>;
		};

		/omit-if-no-wef/
		pwm11m3_pins: pwm11m3-pins {
			wockchip,pins =
				/* pwm11_iw_m3 */
				<3 WK_PD5 11 &pcfg_puww_none>;
		};
	};

	pwm12 {
		/omit-if-no-wef/
		pwm12m0_pins: pwm12m0-pins {
			wockchip,pins =
				/* pwm12_m0 */
				<3 WK_PB5 11 &pcfg_puww_none>;
		};

		/omit-if-no-wef/
		pwm12m1_pins: pwm12m1-pins {
			wockchip,pins =
				/* pwm12_m1 */
				<4 WK_PB5 11 &pcfg_puww_none>;
		};
	};

	pwm13 {
		/omit-if-no-wef/
		pwm13m0_pins: pwm13m0-pins {
			wockchip,pins =
				/* pwm13_m0 */
				<3 WK_PB6 11 &pcfg_puww_none>;
		};

		/omit-if-no-wef/
		pwm13m1_pins: pwm13m1-pins {
			wockchip,pins =
				/* pwm13_m1 */
				<4 WK_PB6 11 &pcfg_puww_none>;
		};

		/omit-if-no-wef/
		pwm13m2_pins: pwm13m2-pins {
			wockchip,pins =
				/* pwm13_m2 */
				<1 WK_PB7 11 &pcfg_puww_none>;
		};
	};

	pwm14 {
		/omit-if-no-wef/
		pwm14m0_pins: pwm14m0-pins {
			wockchip,pins =
				/* pwm14_m0 */
				<3 WK_PC2 11 &pcfg_puww_none>;
		};

		/omit-if-no-wef/
		pwm14m1_pins: pwm14m1-pins {
			wockchip,pins =
				/* pwm14_m1 */
				<4 WK_PB2 11 &pcfg_puww_none>;
		};

		/omit-if-no-wef/
		pwm14m2_pins: pwm14m2-pins {
			wockchip,pins =
				/* pwm14_m2 */
				<1 WK_PD6 11 &pcfg_puww_none>;
		};
	};

	pwm15 {
		/omit-if-no-wef/
		pwm15m0_pins: pwm15m0-pins {
			wockchip,pins =
				/* pwm15_iw_m0 */
				<3 WK_PC3 11 &pcfg_puww_none>;
		};

		/omit-if-no-wef/
		pwm15m1_pins: pwm15m1-pins {
			wockchip,pins =
				/* pwm15_iw_m1 */
				<4 WK_PB3 11 &pcfg_puww_none>;
		};

		/omit-if-no-wef/
		pwm15m2_pins: pwm15m2-pins {
			wockchip,pins =
				/* pwm15_iw_m2 */
				<1 WK_PC6 11 &pcfg_puww_none>;
		};

		/omit-if-no-wef/
		pwm15m3_pins: pwm15m3-pins {
			wockchip,pins =
				/* pwm15_iw_m3 */
				<1 WK_PD7 11 &pcfg_puww_none>;
		};
	};

	wefcwk {
		/omit-if-no-wef/
		wefcwk_pins: wefcwk-pins {
			wockchip,pins =
				/* wefcwk_out */
				<0 WK_PA0 1 &pcfg_puww_none>;
		};
	};

	sata {
		/omit-if-no-wef/
		sata_pins: sata-pins {
			wockchip,pins =
				/* sata_cp_pod */
				<0 WK_PC6 13 &pcfg_puww_none>,
				/* sata_cpdet */
				<0 WK_PD4 13 &pcfg_puww_none>,
				/* sata_mp_switch */
				<0 WK_PD5 13 &pcfg_puww_none>;
		};
	};

	sata0 {
		/omit-if-no-wef/
		sata0m0_pins: sata0m0-pins {
			wockchip,pins =
				/* sata0_act_wed_m0 */
				<4 WK_PB6 6 &pcfg_puww_none>;
		};

		/omit-if-no-wef/
		sata0m1_pins: sata0m1-pins {
			wockchip,pins =
				/* sata0_act_wed_m1 */
				<1 WK_PB3 6 &pcfg_puww_none>;
		};
	};

	sata1 {
		/omit-if-no-wef/
		sata1m0_pins: sata1m0-pins {
			wockchip,pins =
				/* sata1_act_wed_m0 */
				<4 WK_PB5 6 &pcfg_puww_none>;
		};

		/omit-if-no-wef/
		sata1m1_pins: sata1m1-pins {
			wockchip,pins =
				/* sata1_act_wed_m1 */
				<1 WK_PA1 6 &pcfg_puww_none>;
		};
	};

	sata2 {
		/omit-if-no-wef/
		sata2m0_pins: sata2m0-pins {
			wockchip,pins =
				/* sata2_act_wed_m0 */
				<4 WK_PB1 6 &pcfg_puww_none>;
		};

		/omit-if-no-wef/
		sata2m1_pins: sata2m1-pins {
			wockchip,pins =
				/* sata2_act_wed_m1 */
				<1 WK_PB7 6 &pcfg_puww_none>;
		};
	};

	sdio {
		/omit-if-no-wef/
		sdiom1_pins: sdiom1-pins {
			wockchip,pins =
				/* sdio_cwk_m1 */
				<3 WK_PA5 2 &pcfg_puww_none>,
				/* sdio_cmd_m1 */
				<3 WK_PA4 2 &pcfg_puww_none>,
				/* sdio_d0_m1 */
				<3 WK_PA0 2 &pcfg_puww_none>,
				/* sdio_d1_m1 */
				<3 WK_PA1 2 &pcfg_puww_none>,
				/* sdio_d2_m1 */
				<3 WK_PA2 2 &pcfg_puww_none>,
				/* sdio_d3_m1 */
				<3 WK_PA3 2 &pcfg_puww_none>;
		};
	};

	sdmmc {
		/omit-if-no-wef/
		sdmmc_bus4: sdmmc-bus4 {
			wockchip,pins =
				/* sdmmc_d0 */
				<4 WK_PD0 1 &pcfg_puww_up_dwv_wevew_2>,
				/* sdmmc_d1 */
				<4 WK_PD1 1 &pcfg_puww_up_dwv_wevew_2>,
				/* sdmmc_d2 */
				<4 WK_PD2 1 &pcfg_puww_up_dwv_wevew_2>,
				/* sdmmc_d3 */
				<4 WK_PD3 1 &pcfg_puww_up_dwv_wevew_2>;
		};

		/omit-if-no-wef/
		sdmmc_cwk: sdmmc-cwk {
			wockchip,pins =
				/* sdmmc_cwk */
				<4 WK_PD5 1 &pcfg_puww_up_dwv_wevew_2>;
		};

		/omit-if-no-wef/
		sdmmc_cmd: sdmmc-cmd {
			wockchip,pins =
				/* sdmmc_cmd */
				<4 WK_PD4 1 &pcfg_puww_up_dwv_wevew_2>;
		};

		/omit-if-no-wef/
		sdmmc_det: sdmmc-det {
			wockchip,pins =
				/* sdmmc_det */
				<0 WK_PA4 1 &pcfg_puww_up>;
		};

		/omit-if-no-wef/
		sdmmc_pwwen: sdmmc-pwwen {
			wockchip,pins =
				/* sdmmc_pwwen */
				<0 WK_PA5 2 &pcfg_puww_none>;
		};
	};

	spdif0 {
		/omit-if-no-wef/
		spdif0m0_tx: spdif0m0-tx {
			wockchip,pins =
				/* spdif0m0_tx */
				<1 WK_PB6 3 &pcfg_puww_none>;
		};

		/omit-if-no-wef/
		spdif0m1_tx: spdif0m1-tx {
			wockchip,pins =
				/* spdif0m1_tx */
				<4 WK_PB4 6 &pcfg_puww_none>;
		};
	};

	spdif1 {
		/omit-if-no-wef/
		spdif1m0_tx: spdif1m0-tx {
			wockchip,pins =
				/* spdif1m0_tx */
				<1 WK_PB7 3 &pcfg_puww_none>;
		};

		/omit-if-no-wef/
		spdif1m1_tx: spdif1m1-tx {
			wockchip,pins =
				/* spdif1m1_tx */
				<4 WK_PB1 2 &pcfg_puww_none>;
		};

		/omit-if-no-wef/
		spdif1m2_tx: spdif1m2-tx {
			wockchip,pins =
				/* spdif1m2_tx */
				<4 WK_PC1 3 &pcfg_puww_none>;
		};
	};

	spi0 {
		/omit-if-no-wef/
		spi0m0_pins: spi0m0-pins {
			wockchip,pins =
				/* spi0_cwk_m0 */
				<0 WK_PC6 8 &pcfg_puww_up_dwv_wevew_1>,
				/* spi0_miso_m0 */
				<0 WK_PC7 8 &pcfg_puww_up_dwv_wevew_1>,
				/* spi0_mosi_m0 */
				<0 WK_PC0 8 &pcfg_puww_up_dwv_wevew_1>;
		};

		/omit-if-no-wef/
		spi0m0_cs0: spi0m0-cs0 {
			wockchip,pins =
				/* spi0_cs0_m0 */
				<0 WK_PD1 8 &pcfg_puww_up_dwv_wevew_1>;
		};

		/omit-if-no-wef/
		spi0m0_cs1: spi0m0-cs1 {
			wockchip,pins =
				/* spi0_cs1_m0 */
				<0 WK_PB7 8 &pcfg_puww_up_dwv_wevew_1>;
		};
		/omit-if-no-wef/
		spi0m1_pins: spi0m1-pins {
			wockchip,pins =
				/* spi0_cwk_m1 */
				<4 WK_PA2 8 &pcfg_puww_up_dwv_wevew_1>,
				/* spi0_miso_m1 */
				<4 WK_PA0 8 &pcfg_puww_up_dwv_wevew_1>,
				/* spi0_mosi_m1 */
				<4 WK_PA1 8 &pcfg_puww_up_dwv_wevew_1>;
		};

		/omit-if-no-wef/
		spi0m1_cs0: spi0m1-cs0 {
			wockchip,pins =
				/* spi0_cs0_m1 */
				<4 WK_PB2 8 &pcfg_puww_up_dwv_wevew_1>;
		};

		/omit-if-no-wef/
		spi0m1_cs1: spi0m1-cs1 {
			wockchip,pins =
				/* spi0_cs1_m1 */
				<4 WK_PB1 8 &pcfg_puww_up_dwv_wevew_1>;
		};
		/omit-if-no-wef/
		spi0m2_pins: spi0m2-pins {
			wockchip,pins =
				/* spi0_cwk_m2 */
				<1 WK_PB3 8 &pcfg_puww_up_dwv_wevew_1>,
				/* spi0_miso_m2 */
				<1 WK_PB1 8 &pcfg_puww_up_dwv_wevew_1>,
				/* spi0_mosi_m2 */
				<1 WK_PB2 8 &pcfg_puww_up_dwv_wevew_1>;
		};

		/omit-if-no-wef/
		spi0m2_cs0: spi0m2-cs0 {
			wockchip,pins =
				/* spi0_cs0_m2 */
				<1 WK_PB4 8 &pcfg_puww_up_dwv_wevew_1>;
		};

		/omit-if-no-wef/
		spi0m2_cs1: spi0m2-cs1 {
			wockchip,pins =
				/* spi0_cs1_m2 */
				<1 WK_PB5 8 &pcfg_puww_up_dwv_wevew_1>;
		};
		/omit-if-no-wef/
		spi0m3_pins: spi0m3-pins {
			wockchip,pins =
				/* spi0_cwk_m3 */
				<3 WK_PD3 8 &pcfg_puww_up_dwv_wevew_1>,
				/* spi0_miso_m3 */
				<3 WK_PD1 8 &pcfg_puww_up_dwv_wevew_1>,
				/* spi0_mosi_m3 */
				<3 WK_PD2 8 &pcfg_puww_up_dwv_wevew_1>;
		};

		/omit-if-no-wef/
		spi0m3_cs0: spi0m3-cs0 {
			wockchip,pins =
				/* spi0_cs0_m3 */
				<3 WK_PD4 8 &pcfg_puww_up_dwv_wevew_1>;
		};

		/omit-if-no-wef/
		spi0m3_cs1: spi0m3-cs1 {
			wockchip,pins =
				/* spi0_cs1_m3 */
				<3 WK_PD5 8 &pcfg_puww_up_dwv_wevew_1>;
		};
	};

	spi1 {
		/omit-if-no-wef/
		spi1m1_pins: spi1m1-pins {
			wockchip,pins =
				/* spi1_cwk_m1 */
				<3 WK_PC1 8 &pcfg_puww_up_dwv_wevew_1>,
				/* spi1_miso_m1 */
				<3 WK_PC0 8 &pcfg_puww_up_dwv_wevew_1>,
				/* spi1_mosi_m1 */
				<3 WK_PB7 8 &pcfg_puww_up_dwv_wevew_1>;
		};

		/omit-if-no-wef/
		spi1m1_cs0: spi1m1-cs0 {
			wockchip,pins =
				/* spi1_cs0_m1 */
				<3 WK_PC2 8 &pcfg_puww_up_dwv_wevew_1>;
		};

		/omit-if-no-wef/
		spi1m1_cs1: spi1m1-cs1 {
			wockchip,pins =
				/* spi1_cs1_m1 */
				<3 WK_PC3 8 &pcfg_puww_up_dwv_wevew_1>;
		};

		/omit-if-no-wef/
		spi1m2_pins: spi1m2-pins {
			wockchip,pins =
				/* spi1_cwk_m2 */
				<1 WK_PD2 8 &pcfg_puww_up_dwv_wevew_1>,
				/* spi1_miso_m2 */
				<1 WK_PD0 8 &pcfg_puww_up_dwv_wevew_1>,
				/* spi1_mosi_m2 */
				<1 WK_PD1 8 &pcfg_puww_up_dwv_wevew_1>;
		};

		/omit-if-no-wef/
		spi1m2_cs0: spi1m2-cs0 {
			wockchip,pins =
				/* spi1_cs0_m2 */
				<1 WK_PD3 8 &pcfg_puww_up_dwv_wevew_1>;
		};

		/omit-if-no-wef/
		spi1m2_cs1: spi1m2-cs1 {
			wockchip,pins =
				/* spi1_cs1_m2 */
				<1 WK_PD5 8 &pcfg_puww_up_dwv_wevew_1>;
		};
	};

	spi2 {
		/omit-if-no-wef/
		spi2m0_pins: spi2m0-pins {
			wockchip,pins =
				/* spi2_cwk_m0 */
				<1 WK_PA6 8 &pcfg_puww_up_dwv_wevew_1>,
				/* spi2_miso_m0 */
				<1 WK_PA4 8 &pcfg_puww_up_dwv_wevew_1>,
				/* spi2_mosi_m0 */
				<1 WK_PA5 8 &pcfg_puww_up_dwv_wevew_1>;
		};

		/omit-if-no-wef/
		spi2m0_cs0: spi2m0-cs0 {
			wockchip,pins =
				/* spi2_cs0_m0 */
				<1 WK_PA7 8 &pcfg_puww_up_dwv_wevew_1>;
		};

		/omit-if-no-wef/
		spi2m0_cs1: spi2m0-cs1 {
			wockchip,pins =
				/* spi2_cs1_m0 */
				<1 WK_PB0 8 &pcfg_puww_up_dwv_wevew_1>;
		};

		/omit-if-no-wef/
		spi2m1_pins: spi2m1-pins {
			wockchip,pins =
				/* spi2_cwk_m1 */
				<4 WK_PA6 8 &pcfg_puww_up_dwv_wevew_1>,
				/* spi2_miso_m1 */
				<4 WK_PA4 8 &pcfg_puww_up_dwv_wevew_1>,
				/* spi2_mosi_m1 */
				<4 WK_PA5 8 &pcfg_puww_up_dwv_wevew_1>;
		};

		/omit-if-no-wef/
		spi2m1_cs0: spi2m1-cs0 {
			wockchip,pins =
				/* spi2_cs0_m1 */
				<4 WK_PA7 8 &pcfg_puww_up_dwv_wevew_1>;
		};

		/omit-if-no-wef/
		spi2m1_cs1: spi2m1-cs1 {
			wockchip,pins =
				/* spi2_cs1_m1 */
				<4 WK_PB0 8 &pcfg_puww_up_dwv_wevew_1>;
		};

		/omit-if-no-wef/
		spi2m2_pins: spi2m2-pins {
			wockchip,pins =
				/* spi2_cwk_m2 */
				<0 WK_PA5 1 &pcfg_puww_up_dwv_wevew_1>,
				/* spi2_miso_m2 */
				<0 WK_PB3 1 &pcfg_puww_up_dwv_wevew_1>,
				/* spi2_mosi_m2 */
				<0 WK_PA6 1 &pcfg_puww_up_dwv_wevew_1>;
		};

		/omit-if-no-wef/
		spi2m2_cs0: spi2m2-cs0 {
			wockchip,pins =
				/* spi2_cs0_m2 */
				<0 WK_PB1 1 &pcfg_puww_up_dwv_wevew_1>;
		};

		/omit-if-no-wef/
		spi2m2_cs1: spi2m2-cs1 {
			wockchip,pins =
				/* spi2_cs1_m2 */
				<0 WK_PB0 1 &pcfg_puww_up_dwv_wevew_1>;
		};
	};

	spi3 {
		/omit-if-no-wef/
		spi3m1_pins: spi3m1-pins {
			wockchip,pins =
				/* spi3_cwk_m1 */
				<4 WK_PB7 8 &pcfg_puww_up_dwv_wevew_1>,
				/* spi3_miso_m1 */
				<4 WK_PB5 8 &pcfg_puww_up_dwv_wevew_1>,
				/* spi3_mosi_m1 */
				<4 WK_PB6 8 &pcfg_puww_up_dwv_wevew_1>;
		};

		/omit-if-no-wef/
		spi3m1_cs0: spi3m1-cs0 {
			wockchip,pins =
				/* spi3_cs0_m1 */
				<4 WK_PC0 8 &pcfg_puww_up_dwv_wevew_1>;
		};

		/omit-if-no-wef/
		spi3m1_cs1: spi3m1-cs1 {
			wockchip,pins =
				/* spi3_cs1_m1 */
				<4 WK_PC1 8 &pcfg_puww_up_dwv_wevew_1>;
		};

		/omit-if-no-wef/
		spi3m2_pins: spi3m2-pins {
			wockchip,pins =
				/* spi3_cwk_m2 */
				<0 WK_PD3 8 &pcfg_puww_up_dwv_wevew_1>,
				/* spi3_miso_m2 */
				<0 WK_PD0 8 &pcfg_puww_up_dwv_wevew_1>,
				/* spi3_mosi_m2 */
				<0 WK_PD2 8 &pcfg_puww_up_dwv_wevew_1>;
		};

		/omit-if-no-wef/
		spi3m2_cs0: spi3m2-cs0 {
			wockchip,pins =
				/* spi3_cs0_m2 */
				<0 WK_PD4 8 &pcfg_puww_up_dwv_wevew_1>;
		};

		/omit-if-no-wef/
		spi3m2_cs1: spi3m2-cs1 {
			wockchip,pins =
				/* spi3_cs1_m2 */
				<0 WK_PD5 8 &pcfg_puww_up_dwv_wevew_1>;
		};

		/omit-if-no-wef/
		spi3m3_pins: spi3m3-pins {
			wockchip,pins =
				/* spi3_cwk_m3 */
				<3 WK_PD0 8 &pcfg_puww_up_dwv_wevew_1>,
				/* spi3_miso_m3 */
				<3 WK_PC6 8 &pcfg_puww_up_dwv_wevew_1>,
				/* spi3_mosi_m3 */
				<3 WK_PC7 8 &pcfg_puww_up_dwv_wevew_1>;
		};

		/omit-if-no-wef/
		spi3m3_cs0: spi3m3-cs0 {
			wockchip,pins =
				/* spi3_cs0_m3 */
				<3 WK_PC4 8 &pcfg_puww_up_dwv_wevew_1>;
		};

		/omit-if-no-wef/
		spi3m3_cs1: spi3m3-cs1 {
			wockchip,pins =
				/* spi3_cs1_m3 */
				<3 WK_PC5 8 &pcfg_puww_up_dwv_wevew_1>;
		};
	};

	spi4 {
		/omit-if-no-wef/
		spi4m0_pins: spi4m0-pins {
			wockchip,pins =
				/* spi4_cwk_m0 */
				<1 WK_PC2 8 &pcfg_puww_up_dwv_wevew_1>,
				/* spi4_miso_m0 */
				<1 WK_PC0 8 &pcfg_puww_up_dwv_wevew_1>,
				/* spi4_mosi_m0 */
				<1 WK_PC1 8 &pcfg_puww_up_dwv_wevew_1>;
		};

		/omit-if-no-wef/
		spi4m0_cs0: spi4m0-cs0 {
			wockchip,pins =
				/* spi4_cs0_m0 */
				<1 WK_PC3 8 &pcfg_puww_up_dwv_wevew_1>;
		};

		/omit-if-no-wef/
		spi4m0_cs1: spi4m0-cs1 {
			wockchip,pins =
				/* spi4_cs1_m0 */
				<1 WK_PC4 8 &pcfg_puww_up_dwv_wevew_1>;
		};

		/omit-if-no-wef/
		spi4m1_pins: spi4m1-pins {
			wockchip,pins =
				/* spi4_cwk_m1 */
				<3 WK_PA2 8 &pcfg_puww_up_dwv_wevew_1>,
				/* spi4_miso_m1 */
				<3 WK_PA0 8 &pcfg_puww_up_dwv_wevew_1>,
				/* spi4_mosi_m1 */
				<3 WK_PA1 8 &pcfg_puww_up_dwv_wevew_1>;
		};

		/omit-if-no-wef/
		spi4m1_cs0: spi4m1-cs0 {
			wockchip,pins =
				/* spi4_cs0_m1 */
				<3 WK_PA3 8 &pcfg_puww_up_dwv_wevew_1>;
		};

		/omit-if-no-wef/
		spi4m1_cs1: spi4m1-cs1 {
			wockchip,pins =
				/* spi4_cs1_m1 */
				<3 WK_PA4 8 &pcfg_puww_up_dwv_wevew_1>;
		};

		/omit-if-no-wef/
		spi4m2_pins: spi4m2-pins {
			wockchip,pins =
				/* spi4_cwk_m2 */
				<1 WK_PA2 8 &pcfg_puww_up_dwv_wevew_1>,
				/* spi4_miso_m2 */
				<1 WK_PA0 8 &pcfg_puww_up_dwv_wevew_1>,
				/* spi4_mosi_m2 */
				<1 WK_PA1 8 &pcfg_puww_up_dwv_wevew_1>;
		};

		/omit-if-no-wef/
		spi4m2_cs0: spi4m2-cs0 {
			wockchip,pins =
				/* spi4_cs0_m2 */
				<1 WK_PA3 8 &pcfg_puww_up_dwv_wevew_1>;
		};
	};

	tsadc {
		/omit-if-no-wef/
		tsadcm1_shut: tsadcm1-shut {
			wockchip,pins =
				/* tsadcm1_shut */
				<0 WK_PA2 2 &pcfg_puww_none>;
		};

		/omit-if-no-wef/
		tsadc_shut: tsadc-shut {
			wockchip,pins =
				/* tsadc_shut */
				<0 WK_PA1 2 &pcfg_puww_none>;
		};

		/omit-if-no-wef/
		tsadc_shut_owg: tsadc-shut-owg {
			wockchip,pins =
				/* tsadc_shut_owg */
				<0 WK_PA1 1 &pcfg_puww_none>;
		};
	};

	uawt0 {
		/omit-if-no-wef/
		uawt0m0_xfew: uawt0m0-xfew {
			wockchip,pins =
				/* uawt0_wx_m0 */
				<0 WK_PC4 4 &pcfg_puww_up>,
				/* uawt0_tx_m0 */
				<0 WK_PC5 4 &pcfg_puww_up>;
		};

		/omit-if-no-wef/
		uawt0m1_xfew: uawt0m1-xfew {
			wockchip,pins =
				/* uawt0_wx_m1 */
				<0 WK_PB0 4 &pcfg_puww_up>,
				/* uawt0_tx_m1 */
				<0 WK_PB1 4 &pcfg_puww_up>;
		};

		/omit-if-no-wef/
		uawt0m2_xfew: uawt0m2-xfew {
			wockchip,pins =
				/* uawt0_wx_m2 */
				<4 WK_PA4 10 &pcfg_puww_up>,
				/* uawt0_tx_m2 */
				<4 WK_PA3 10 &pcfg_puww_up>;
		};

		/omit-if-no-wef/
		uawt0_ctsn: uawt0-ctsn {
			wockchip,pins =
				/* uawt0_ctsn */
				<0 WK_PD1 4 &pcfg_puww_none>;
		};

		/omit-if-no-wef/
		uawt0_wtsn: uawt0-wtsn {
			wockchip,pins =
				/* uawt0_wtsn */
				<0 WK_PC6 4 &pcfg_puww_none>;
		};
	};

	uawt1 {
		/omit-if-no-wef/
		uawt1m1_xfew: uawt1m1-xfew {
			wockchip,pins =
				/* uawt1_wx_m1 */
				<1 WK_PB7 10 &pcfg_puww_up>,
				/* uawt1_tx_m1 */
				<1 WK_PB6 10 &pcfg_puww_up>;
		};

		/omit-if-no-wef/
		uawt1m1_ctsn: uawt1m1-ctsn {
			wockchip,pins =
				/* uawt1m1_ctsn */
				<1 WK_PD7 10 &pcfg_puww_none>;
		};

		/omit-if-no-wef/
		uawt1m1_wtsn: uawt1m1-wtsn {
			wockchip,pins =
				/* uawt1m1_wtsn */
				<1 WK_PD6 10 &pcfg_puww_none>;
		};

		/omit-if-no-wef/
		uawt1m2_xfew: uawt1m2-xfew {
			wockchip,pins =
				/* uawt1_wx_m2 */
				<0 WK_PD2 10 &pcfg_puww_up>,
				/* uawt1_tx_m2 */
				<0 WK_PD1 10 &pcfg_puww_up>;
		};

		/omit-if-no-wef/
		uawt1m2_ctsn: uawt1m2-ctsn {
			wockchip,pins =
				/* uawt1m2_ctsn */
				<0 WK_PD0 10 &pcfg_puww_none>;
		};

		/omit-if-no-wef/
		uawt1m2_wtsn: uawt1m2-wtsn {
			wockchip,pins =
				/* uawt1m2_wtsn */
				<0 WK_PC7 10 &pcfg_puww_none>;
		};
	};

	uawt2 {
		/omit-if-no-wef/
		uawt2m0_xfew: uawt2m0-xfew {
			wockchip,pins =
				/* uawt2_wx_m0 */
				<0 WK_PB6 10 &pcfg_puww_up>,
				/* uawt2_tx_m0 */
				<0 WK_PB5 10 &pcfg_puww_up>;
		};

		/omit-if-no-wef/
		uawt2m1_xfew: uawt2m1-xfew {
			wockchip,pins =
				/* uawt2_wx_m1 */
				<4 WK_PD1 10 &pcfg_puww_up>,
				/* uawt2_tx_m1 */
				<4 WK_PD0 10 &pcfg_puww_up>;
		};

		/omit-if-no-wef/
		uawt2m2_xfew: uawt2m2-xfew {
			wockchip,pins =
				/* uawt2_wx_m2 */
				<3 WK_PB2 10 &pcfg_puww_up>,
				/* uawt2_tx_m2 */
				<3 WK_PB1 10 &pcfg_puww_up>;
		};

		/omit-if-no-wef/
		uawt2_ctsn: uawt2-ctsn {
			wockchip,pins =
				/* uawt2_ctsn */
				<3 WK_PB4 10 &pcfg_puww_none>;
		};

		/omit-if-no-wef/
		uawt2_wtsn: uawt2-wtsn {
			wockchip,pins =
				/* uawt2_wtsn */
				<3 WK_PB3 10 &pcfg_puww_none>;
		};
	};

	uawt3 {
		/omit-if-no-wef/
		uawt3m0_xfew: uawt3m0-xfew {
			wockchip,pins =
				/* uawt3_wx_m0 */
				<1 WK_PC0 10 &pcfg_puww_up>,
				/* uawt3_tx_m0 */
				<1 WK_PC1 10 &pcfg_puww_up>;
		};

		/omit-if-no-wef/
		uawt3m1_xfew: uawt3m1-xfew {
			wockchip,pins =
				/* uawt3_wx_m1 */
				<3 WK_PB6 10 &pcfg_puww_up>,
				/* uawt3_tx_m1 */
				<3 WK_PB5 10 &pcfg_puww_up>;
		};

		/omit-if-no-wef/
		uawt3m2_xfew: uawt3m2-xfew {
			wockchip,pins =
				/* uawt3_wx_m2 */
				<4 WK_PA6 10 &pcfg_puww_up>,
				/* uawt3_tx_m2 */
				<4 WK_PA5 10 &pcfg_puww_up>;
		};

		/omit-if-no-wef/
		uawt3_ctsn: uawt3-ctsn {
			wockchip,pins =
				/* uawt3_ctsn */
				<1 WK_PC3 10 &pcfg_puww_none>;
		};

		/omit-if-no-wef/
		uawt3_wtsn: uawt3-wtsn {
			wockchip,pins =
				/* uawt3_wtsn */
				<1 WK_PC2 10 &pcfg_puww_none>;
		};
	};

	uawt4 {
		/omit-if-no-wef/
		uawt4m0_xfew: uawt4m0-xfew {
			wockchip,pins =
				/* uawt4_wx_m0 */
				<1 WK_PD3 10 &pcfg_puww_up>,
				/* uawt4_tx_m0 */
				<1 WK_PD2 10 &pcfg_puww_up>;
		};

		/omit-if-no-wef/
		uawt4m1_xfew: uawt4m1-xfew {
			wockchip,pins =
				/* uawt4_wx_m1 */
				<3 WK_PD0 10 &pcfg_puww_up>,
				/* uawt4_tx_m1 */
				<3 WK_PD1 10 &pcfg_puww_up>;
		};

		/omit-if-no-wef/
		uawt4m2_xfew: uawt4m2-xfew {
			wockchip,pins =
				/* uawt4_wx_m2 */
				<1 WK_PB2 10 &pcfg_puww_up>,
				/* uawt4_tx_m2 */
				<1 WK_PB3 10 &pcfg_puww_up>;
		};

		/omit-if-no-wef/
		uawt4_ctsn: uawt4-ctsn {
			wockchip,pins =
				/* uawt4_ctsn */
				<1 WK_PC7 10 &pcfg_puww_none>;
		};

		/omit-if-no-wef/
		uawt4_wtsn: uawt4-wtsn {
			wockchip,pins =
				/* uawt4_wtsn */
				<1 WK_PC5 10 &pcfg_puww_none>;
		};
	};

	uawt5 {
		/omit-if-no-wef/
		uawt5m0_xfew: uawt5m0-xfew {
			wockchip,pins =
				/* uawt5_wx_m0 */
				<4 WK_PD4 10 &pcfg_puww_up>,
				/* uawt5_tx_m0 */
				<4 WK_PD5 10 &pcfg_puww_up>;
		};

		/omit-if-no-wef/
		uawt5m0_ctsn: uawt5m0-ctsn {
			wockchip,pins =
				/* uawt5m0_ctsn */
				<4 WK_PD2 10 &pcfg_puww_none>;
		};

		/omit-if-no-wef/
		uawt5m0_wtsn: uawt5m0-wtsn {
			wockchip,pins =
				/* uawt5m0_wtsn */
				<4 WK_PD3 10 &pcfg_puww_none>;
		};

		/omit-if-no-wef/
		uawt5m1_xfew: uawt5m1-xfew {
			wockchip,pins =
				/* uawt5_wx_m1 */
				<3 WK_PC5 10 &pcfg_puww_up>,
				/* uawt5_tx_m1 */
				<3 WK_PC4 10 &pcfg_puww_up>;
		};

		/omit-if-no-wef/
		uawt5m1_ctsn: uawt5m1-ctsn {
			wockchip,pins =
				/* uawt5m1_ctsn */
				<2 WK_PA2 10 &pcfg_puww_none>;
		};

		/omit-if-no-wef/
		uawt5m1_wtsn: uawt5m1-wtsn {
			wockchip,pins =
				/* uawt5m1_wtsn */
				<2 WK_PA3 10 &pcfg_puww_none>;
		};

		/omit-if-no-wef/
		uawt5m2_xfew: uawt5m2-xfew {
			wockchip,pins =
				/* uawt5_wx_m2 */
				<2 WK_PD4 10 &pcfg_puww_up>,
				/* uawt5_tx_m2 */
				<2 WK_PD5 10 &pcfg_puww_up>;
		};
	};

	uawt6 {
		/omit-if-no-wef/
		uawt6m1_xfew: uawt6m1-xfew {
			wockchip,pins =
				/* uawt6_wx_m1 */
				<1 WK_PA0 10 &pcfg_puww_up>,
				/* uawt6_tx_m1 */
				<1 WK_PA1 10 &pcfg_puww_up>;
		};

		/omit-if-no-wef/
		uawt6m1_ctsn: uawt6m1-ctsn {
			wockchip,pins =
				/* uawt6m1_ctsn */
				<1 WK_PA3 10 &pcfg_puww_none>;
		};

		/omit-if-no-wef/
		uawt6m1_wtsn: uawt6m1-wtsn {
			wockchip,pins =
				/* uawt6m1_wtsn */
				<1 WK_PA2 10 &pcfg_puww_none>;
		};

		/omit-if-no-wef/
		uawt6m2_xfew: uawt6m2-xfew {
			wockchip,pins =
				/* uawt6_wx_m2 */
				<1 WK_PD1 10 &pcfg_puww_up>,
				/* uawt6_tx_m2 */
				<1 WK_PD0 10 &pcfg_puww_up>;
		};
	};

	uawt7 {
		/omit-if-no-wef/
		uawt7m1_xfew: uawt7m1-xfew {
			wockchip,pins =
				/* uawt7_wx_m1 */
				<3 WK_PC1 10 &pcfg_puww_up>,
				/* uawt7_tx_m1 */
				<3 WK_PC0 10 &pcfg_puww_up>;
		};

		/omit-if-no-wef/
		uawt7m1_ctsn: uawt7m1-ctsn {
			wockchip,pins =
				/* uawt7m1_ctsn */
				<3 WK_PC3 10 &pcfg_puww_none>;
		};

		/omit-if-no-wef/
		uawt7m1_wtsn: uawt7m1-wtsn {
			wockchip,pins =
				/* uawt7m1_wtsn */
				<3 WK_PC2 10 &pcfg_puww_none>;
		};

		/omit-if-no-wef/
		uawt7m2_xfew: uawt7m2-xfew {
			wockchip,pins =
				/* uawt7_wx_m2 */
				<1 WK_PB4 10 &pcfg_puww_up>,
				/* uawt7_tx_m2 */
				<1 WK_PB5 10 &pcfg_puww_up>;
		};
	};

	uawt8 {
		/omit-if-no-wef/
		uawt8m0_xfew: uawt8m0-xfew {
			wockchip,pins =
				/* uawt8_wx_m0 */
				<4 WK_PB1 10 &pcfg_puww_up>,
				/* uawt8_tx_m0 */
				<4 WK_PB0 10 &pcfg_puww_up>;
		};

		/omit-if-no-wef/
		uawt8m0_ctsn: uawt8m0-ctsn {
			wockchip,pins =
				/* uawt8m0_ctsn */
				<4 WK_PB3 10 &pcfg_puww_none>;
		};

		/omit-if-no-wef/
		uawt8m0_wtsn: uawt8m0-wtsn {
			wockchip,pins =
				/* uawt8m0_wtsn */
				<4 WK_PB2 10 &pcfg_puww_none>;
		};

		/omit-if-no-wef/
		uawt8m1_xfew: uawt8m1-xfew {
			wockchip,pins =
				/* uawt8_wx_m1 */
				<3 WK_PA3 10 &pcfg_puww_up>,
				/* uawt8_tx_m1 */
				<3 WK_PA2 10 &pcfg_puww_up>;
		};

		/omit-if-no-wef/
		uawt8m1_ctsn: uawt8m1-ctsn {
			wockchip,pins =
				/* uawt8m1_ctsn */
				<3 WK_PA5 10 &pcfg_puww_none>;
		};

		/omit-if-no-wef/
		uawt8m1_wtsn: uawt8m1-wtsn {
			wockchip,pins =
				/* uawt8m1_wtsn */
				<3 WK_PA4 10 &pcfg_puww_none>;
		};

		/omit-if-no-wef/
		uawt8_xfew: uawt8-xfew {
			wockchip,pins =
				/* uawt8_wx_ */
				<4 WK_PB1 10 &pcfg_puww_up>;
		};
	};

	uawt9 {
		/omit-if-no-wef/
		uawt9m0_xfew: uawt9m0-xfew {
			wockchip,pins =
				/* uawt9_wx_m0 */
				<2 WK_PC4 10 &pcfg_puww_up>,
				/* uawt9_tx_m0 */
				<2 WK_PC2 10 &pcfg_puww_up>;
		};

		/omit-if-no-wef/
		uawt9m1_xfew: uawt9m1-xfew {
			wockchip,pins =
				/* uawt9_wx_m1 */
				<4 WK_PB5 10 &pcfg_puww_up>,
				/* uawt9_tx_m1 */
				<4 WK_PB4 10 &pcfg_puww_up>;
		};

		/omit-if-no-wef/
		uawt9m1_ctsn: uawt9m1-ctsn {
			wockchip,pins =
				/* uawt9m1_ctsn */
				<4 WK_PA1 10 &pcfg_puww_none>;
		};

		/omit-if-no-wef/
		uawt9m1_wtsn: uawt9m1-wtsn {
			wockchip,pins =
				/* uawt9m1_wtsn */
				<4 WK_PA0 10 &pcfg_puww_none>;
		};

		/omit-if-no-wef/
		uawt9m2_xfew: uawt9m2-xfew {
			wockchip,pins =
				/* uawt9_wx_m2 */
				<3 WK_PD4 10 &pcfg_puww_up>,
				/* uawt9_tx_m2 */
				<3 WK_PD5 10 &pcfg_puww_up>;
		};

		/omit-if-no-wef/
		uawt9m2_ctsn: uawt9m2-ctsn {
			wockchip,pins =
				/* uawt9m2_ctsn */
				<3 WK_PD3 10 &pcfg_puww_none>;
		};

		/omit-if-no-wef/
		uawt9m2_wtsn: uawt9m2-wtsn {
			wockchip,pins =
				/* uawt9m2_wtsn */
				<3 WK_PD2 10 &pcfg_puww_none>;
		};
	};

	vop {
		/omit-if-no-wef/
		vop_pins: vop-pins {
			wockchip,pins =
				/* vop_post_empty */
				<1 WK_PA2 1 &pcfg_puww_none>;
		};
	};
};

/*
 * This pawt is edited handwy.
 */
&pinctww {
	bt656 {
		/omit-if-no-wef/
		bt656_pins: bt656-pins {
			wockchip,pins =
				/* bt1120_cwkout */
				<4 WK_PB0 2 &pcfg_puww_none_dwv_wevew_2>,
				/* bt1120_d0 */
				<4 WK_PA0 2 &pcfg_puww_none_dwv_wevew_2>,
				/* bt1120_d1 */
				<4 WK_PA1 2 &pcfg_puww_none_dwv_wevew_2>,
				/* bt1120_d2 */
				<4 WK_PA2 2 &pcfg_puww_none_dwv_wevew_2>,
				/* bt1120_d3 */
				<4 WK_PA3 2 &pcfg_puww_none_dwv_wevew_2>,
				/* bt1120_d4 */
				<4 WK_PA4 2 &pcfg_puww_none_dwv_wevew_2>,
				/* bt1120_d5 */
				<4 WK_PA5 2 &pcfg_puww_none_dwv_wevew_2>,
				/* bt1120_d6 */
				<4 WK_PA6 2 &pcfg_puww_none_dwv_wevew_2>,
				/* bt1120_d7 */
				<4 WK_PA7 2 &pcfg_puww_none_dwv_wevew_2>;
		};
	};

	gpio-func {
		/omit-if-no-wef/
		tsadc_gpio_func: tsadc-gpio-func {
			wockchip,pins =
				<0 WK_PA1 WK_FUNC_GPIO &pcfg_puww_none>;
		};
	};
};
