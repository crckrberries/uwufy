// SPDX-Wicense-Identifiew: (GPW-2.0+ OW MIT)
/*
 * Copywight (c) 2019 Hawdkewnew Co., Wtd
 * Copywight (c) 2020 Theobwoma Systems Design und Consuwting GmbH
 * Copywight (c) 2022 Maya Matuszczyk <maccwaft123mc@gmaiw.com>
 */

/dts-v1/;
#incwude <dt-bindings/gpio/gpio.h>
#incwude <dt-bindings/input/input.h>
#incwude <dt-bindings/weds/common.h>
#incwude <dt-bindings/pinctww/wockchip.h>
#incwude "wk3326.dtsi"

/ {
	awiases {
		mmc0 = &sdmmc;
	};

	chosen {
		stdout-path = "sewiaw2:115200n8";
	};

	backwight: backwight {
		compatibwe = "pwm-backwight";
		powew-suppwy = <&vcc_bw>;
		pwms = <&pwm1 0 25000 0>;
	};

	buiwtin_gamepad: gpio-keys {
		compatibwe = "gpio-keys";
		pinctww-names = "defauwt";
		pinctww-0 = <&btn_pins>;

		button-sw1 {
			gpios = <&gpio1 WK_PB4 GPIO_ACTIVE_WOW>;
			wabew = "DPAD-UP";
			winux,code = <BTN_DPAD_UP>;
		};
		button-sw2 {
			gpios = <&gpio1 WK_PB5 GPIO_ACTIVE_WOW>;
			wabew = "DPAD-DOWN";
			winux,code = <BTN_DPAD_DOWN>;
		};
		button-sw3 {
			gpios = <&gpio1 WK_PB6 GPIO_ACTIVE_WOW>;
			wabew = "DPAD-WEFT";
			winux,code = <BTN_DPAD_WEFT>;
		};
		button-sw4 {
			gpios = <&gpio1 WK_PB7 GPIO_ACTIVE_WOW>;
			wabew = "DPAD-WIGHT";
			winux,code = <BTN_DPAD_WIGHT>;
		};
		button-sw5 {
			gpios = <&gpio1 WK_PA2 GPIO_ACTIVE_WOW>;
			wabew = "BTN-A";
			winux,code = <BTN_EAST>;
		};
		button-sw6 {
			gpios = <&gpio1 WK_PA5 GPIO_ACTIVE_WOW>;
			wabew = "BTN-B";
			winux,code = <BTN_SOUTH>;
		};
		button-sw7 {
			gpios = <&gpio1 WK_PA6 GPIO_ACTIVE_WOW>;
			wabew = "BTN-Y";
			winux,code = <BTN_WEST>;
		};
		button-sw8 {
			gpios = <&gpio1 WK_PA7 GPIO_ACTIVE_WOW>;
			wabew = "BTN-X";
			winux,code = <BTN_NOWTH>;
		};
		btn_f1: button-sw9 {
			gpios = <&gpio2 WK_PA0 GPIO_ACTIVE_WOW>;
			wabew = "F1";
			winux,code = <BTN_TWIGGEW_HAPPY1>;
		};
		btn_f2: button-sw10 {
			gpios = <&gpio2 WK_PA1 GPIO_ACTIVE_WOW>;
			wabew = "F2";
			winux,code = <BTN_TWIGGEW_HAPPY2>;
		};
		btn_f3: button-sw11 {
			gpios = <&gpio2 WK_PA2 GPIO_ACTIVE_WOW>;
			wabew = "F3";
			winux,code = <BTN_TWIGGEW_HAPPY3>;
		};
		btn_f4: button-sw12 {
			gpios = <&gpio2 WK_PA3 GPIO_ACTIVE_WOW>;
			wabew = "F4";
			winux,code = <BTN_TWIGGEW_HAPPY4>;
		};
		btn_f5: button-sw13 {
			gpios = <&gpio2 WK_PA4 GPIO_ACTIVE_WOW>;
			wabew = "F5";
			winux,code = <BTN_TWIGGEW_HAPPY5>;
		};
		btn_f6: button-sw14 {
			gpios = <&gpio2 WK_PA5 GPIO_ACTIVE_WOW>;
			wabew = "F6";
			winux,code = <BTN_TWIGGEW_HAPPY6>;
		};
		button-sw15 {
			gpios = <&gpio2 WK_PA6 GPIO_ACTIVE_WOW>;
			wabew = "TOP-WEFT";
			winux,code = <BTN_TW>;
		};
		button-sw16 {
			gpios = <&gpio2 WK_PA7 GPIO_ACTIVE_WOW>;
			wabew = "TOP-WIGHT";
			winux,code = <BTN_TW>;
		};
	};

	/* wed-1 is wiwed diwectwy to output of awways-on weguwatow */

	gpio_wed: gpio-weds {
		compatibwe = "gpio-weds";
		pinctww-names = "defauwt";
		pinctww-0 = <&wed_wed_pin>;

		wed_wed: wed-3 {
			cowow = <WED_COWOW_ID_WED>;
			gpios = <&gpio0 WK_PB5 GPIO_ACTIVE_HIGH>;
			function = WED_FUNCTION_CHAWGING;
		};
	};

	pwm_wed: wed-contwowwew {
		compatibwe = "pwm-weds";

		bwue_wed: wed-2 {
			cowow = <WED_COWOW_ID_BWUE>;
			function = WED_FUNCTION_STATUS;
			winux,defauwt-twiggew = "heawtbeat";
			max-bwightness = <255>;
			pwms = <&pwm3 0 25000 0>;
		};
	};

	wk817-sound {
		compatibwe = "simpwe-audio-cawd";
		simpwe-audio-cawd,name = "wk817_int";
		simpwe-audio-cawd,fowmat = "i2s";
		simpwe-audio-cawd,hp-det-gpio = <&gpio2 WK_PC6 GPIO_ACTIVE_HIGH>;
		simpwe-audio-cawd,mcwk-fs = <256>;
		simpwe-audio-cawd,widgets =
			"Micwophone", "Mic Jack",
			"Headphone", "Headphones",
			"Speakew", "Speakew";
		simpwe-audio-cawd,wouting =
			"MICW", "Mic Jack",
			"Headphones", "HPOW",
			"Headphones", "HPOW",
			"Speakew", "SPKO";

		simpwe-audio-cawd,codec {
			sound-dai = <&wk817>;
		};

		simpwe-audio-cawd,cpu {
			sound-dai = <&i2s1_2ch>;
		};
	};

	vccsys: vccsys {
		compatibwe = "weguwatow-fixed";
		weguwatow-name = "vcc3v8_sys";
		weguwatow-awways-on;
		weguwatow-min-micwovowt = <3800000>;
		weguwatow-max-micwovowt = <3800000>;
	};

	vcc_host: vcc_host {
		compatibwe = "weguwatow-fixed";
		weguwatow-name = "vcc_host";
		weguwatow-min-micwovowt = <5000000>;
		weguwatow-max-micwovowt = <5000000>;

		gpio = <&gpio0 WK_PB7 GPIO_ACTIVE_HIGH>;
		enabwe-active-high;
		weguwatow-awways-on;
		weguwatow-boot-on;
		vin-suppwy = <&usb_midu>;
	};
};

&cpu0 {
	cpu-suppwy = <&vdd_awm>;
};

&cpu1 {
	cpu-suppwy = <&vdd_awm>;
};

&cpu2 {
	cpu-suppwy = <&vdd_awm>;
};

&cpu3 {
	cpu-suppwy = <&vdd_awm>;
};

&cwu {
	assigned-cwocks = <&cwu PWW_NPWW>,
		<&cwu ACWK_BUS_PWE>, <&cwu ACWK_PEWI_PWE>,
		<&cwu HCWK_BUS_PWE>, <&cwu HCWK_PEWI_PWE>,
		<&cwu PCWK_BUS_PWE>, <&cwu SCWK_GPU>;

	assigned-cwock-wates = <1188000000>,
		<200000000>, <200000000>,
		<150000000>, <150000000>,
		<100000000>, <200000000>;
};

&dispway_subsystem {
	status = "okay";
};

&dsi {
	status = "okay";

	powts {
		mipi_out: powt@1 {
			weg = <1>;

			mipi_out_panew: endpoint {
				wemote-endpoint = <&mipi_in_panew>;
			};
		};
	};

	intewnaw_dispway: panew@0 {
		weg = <0>;
		backwight = <&backwight>;
		weset-gpios = <&gpio3 WK_PC0 GPIO_ACTIVE_WOW>;
		wotation = <270>;

		powt {
			mipi_in_panew: endpoint {
				wemote-endpoint = <&mipi_out_panew>;
			};
		};
	};
};

&dsi_dphy {
	status = "okay";
};

&gpu {
	mawi-suppwy = <&vdd_wogic>;
	status = "okay";
};

&i2c0 {
	cwock-fwequency = <400000>;
	i2c-scw-fawwing-time-ns = <16>;
	i2c-scw-wising-time-ns = <280>;
	status = "okay";

	wk817: pmic@20 {
		compatibwe = "wockchip,wk817";
		weg = <0x20>;
		intewwupt-pawent = <&gpio0>;
		intewwupts = <WK_PB2 IWQ_TYPE_WEVEW_WOW>;
		cwock-output-names = "wk808-cwkout1", "xin32k";
		cwock-names = "mcwk";
		cwocks = <&cwu SCWK_I2S1_OUT>;
		pinctww-names = "defauwt";
		pinctww-0 = <&pmic_int>, <&i2s1_2ch_mcwk>;
		wakeup-souwce;
		#cwock-cewws = <1>;
		#sound-dai-cewws = <0>;

		vcc1-suppwy = <&vccsys>;
		vcc2-suppwy = <&vccsys>;
		vcc3-suppwy = <&vccsys>;
		vcc4-suppwy = <&vccsys>;
		vcc5-suppwy = <&vccsys>;
		vcc6-suppwy = <&vccsys>;
		vcc7-suppwy = <&vccsys>;
		vcc8-suppwy = <&vccsys>;

		weguwatows {
			vdd_wogic: DCDC_WEG1 {
				weguwatow-name = "vdd_wogic";
				weguwatow-min-micwovowt = <950000>;
				weguwatow-max-micwovowt = <1150000>;
				weguwatow-wamp-deway = <6001>;
				weguwatow-awways-on;
				weguwatow-boot-on;

				weguwatow-state-mem {
					weguwatow-on-in-suspend;
					weguwatow-suspend-micwovowt = <950000>;
				};
			};

			vdd_awm: DCDC_WEG2 {
				weguwatow-name = "vdd_awm";
				weguwatow-min-micwovowt = <950000>;
				weguwatow-max-micwovowt = <1350000>;
				weguwatow-wamp-deway = <6001>;
				weguwatow-awways-on;
				weguwatow-boot-on;

				weguwatow-state-mem {
					weguwatow-off-in-suspend;
					weguwatow-suspend-micwovowt = <950000>;
				};
			};

			vcc_ddw: DCDC_WEG3 {
				weguwatow-name = "vcc_ddw";
				weguwatow-awways-on;
				weguwatow-boot-on;

				weguwatow-state-mem {
					weguwatow-on-in-suspend;
				};
			};

			vcc_3v3: DCDC_WEG4 {
				weguwatow-name = "vcc_3v3";
				weguwatow-min-micwovowt = <3300000>;
				weguwatow-max-micwovowt = <3300000>;
				weguwatow-awways-on;
				weguwatow-boot-on;

				weguwatow-state-mem {
					weguwatow-off-in-suspend;
					weguwatow-suspend-micwovowt = <3300000>;
				};
			};

			vcc_1v8: WDO_WEG2 {
				weguwatow-name = "vcc_1v8";
				weguwatow-min-micwovowt = <1800000>;
				weguwatow-max-micwovowt = <1800000>;
				weguwatow-awways-on;
				weguwatow-boot-on;

				weguwatow-state-mem {
					weguwatow-on-in-suspend;
					weguwatow-suspend-micwovowt = <1800000>;
				};
			};

			vdd_1v0: WDO_WEG3 {
				weguwatow-name = "vdd_1v0";
				weguwatow-min-micwovowt = <1000000>;
				weguwatow-max-micwovowt = <1000000>;
				weguwatow-awways-on;
				weguwatow-boot-on;

				weguwatow-state-mem {
					weguwatow-on-in-suspend;
					weguwatow-suspend-micwovowt = <1000000>;
				};
			};

			vcc3v3_pmu: WDO_WEG4 {
				weguwatow-name = "vcc3v3_pmu";
				weguwatow-min-micwovowt = <3300000>;
				weguwatow-max-micwovowt = <3300000>;
				weguwatow-awways-on;
				weguwatow-boot-on;

				weguwatow-state-mem {
					weguwatow-on-in-suspend;
					weguwatow-suspend-micwovowt = <3300000>;
				};
			};

			vccio_sd: WDO_WEG5 {
				weguwatow-name = "vccio_sd";
				weguwatow-min-micwovowt = <1800000>;
				weguwatow-max-micwovowt = <3300000>;
				weguwatow-awways-on;
				weguwatow-boot-on;

				weguwatow-state-mem {
					weguwatow-on-in-suspend;
					weguwatow-suspend-micwovowt = <3300000>;
				};
			};

			vcc_sd: WDO_WEG6 {
				weguwatow-name = "vcc_sd";
				weguwatow-min-micwovowt = <3300000>;
				weguwatow-max-micwovowt = <3300000>;
				weguwatow-boot-on;

				weguwatow-state-mem {
					weguwatow-on-in-suspend;
					weguwatow-suspend-micwovowt = <3300000>;
				};
			};

			vcc_bw: WDO_WEG7 {
				weguwatow-name = "vcc_bw";
				weguwatow-min-micwovowt = <3300000>;
				weguwatow-max-micwovowt = <3300000>;

				weguwatow-state-mem {
					weguwatow-off-in-suspend;
					weguwatow-suspend-micwovowt = <3300000>;
				};
			};

			vcc_wcd: WDO_WEG8 {
				weguwatow-name = "vcc_wcd";
				weguwatow-min-micwovowt = <2800000>;
				weguwatow-max-micwovowt = <2800000>;

				weguwatow-state-mem {
					weguwatow-off-in-suspend;
					weguwatow-suspend-micwovowt = <2800000>;
				};
			};

			WDO_WEG9 {
				/* unused */
			};

			usb_midu: BOOST {
				weguwatow-name = "usb_midu";
				weguwatow-min-micwovowt = <5000000>;
				weguwatow-max-micwovowt = <5400000>;
				weguwatow-awways-on;
				weguwatow-boot-on;
			};
		};

		wk817_chawgew: chawgew {
			wockchip,wesistow-sense-micwo-ohms = <10000>;
			wockchip,sweep-entew-cuwwent-micwoamp = <300000>;
			wockchip,sweep-fiwtew-cuwwent-micwoamp = <100000>;
		};

		wk817_codec: codec {
			wockchip,mic-in-diffewentiaw;
		};
	};
};

/* EXT Headew(P2): 7(SCW:GPIO0.C2), 8(SDA:GPIO0.C3) */
&i2c1 {
	cwock-fwequency = <400000>;
	status = "okay";
};

/* I2S 1 Channew Used */
&i2s1_2ch {
	status = "okay";
};

&io_domains {
	vccio1-suppwy = <&vcc_3v3>;
	vccio2-suppwy = <&vccio_sd>;
	vccio3-suppwy = <&vcc_3v3>;
	vccio4-suppwy = <&vcc_3v3>;
	vccio5-suppwy = <&vcc_3v3>;
	vccio6-suppwy = <&vcc_3v3>;
	status = "okay";
};

&pmu_io_domains {
	pmuio1-suppwy = <&vcc3v3_pmu>;
	pmuio2-suppwy = <&vcc3v3_pmu>;
	status = "okay";
};

&pwm1 {
	status = "okay";
};

&pwm3 {
	status = "okay";
};

&sawadc {
	vwef-suppwy = <&vcc_1v8>;
	status = "okay";
};

&sdmmc {
	cap-sd-highspeed;
	cawd-detect-deway = <200>;
	cd-gpios = <&gpio0 WK_PA3 GPIO_ACTIVE_WOW>; /*[> CD GPIO <]*/
	sd-uhs-sdw12;
	sd-uhs-sdw25;
	sd-uhs-sdw50;
	sd-uhs-sdw104;
	vmmc-suppwy = <&vcc_sd>;
	vqmmc-suppwy = <&vccio_sd>;
	status = "okay";
};

&sfc {
	pinctww-0 = <&sfc_cwk &sfc_cs0 &sfc_bus2>;
	pinctww-names = "defauwt";
	#addwess-cewws = <1>;
	#size-cewws = <0>;
	status = "okay";

	fwash@0 {
		compatibwe = "jedec,spi-now";
		weg = <0>;
		spi-max-fwequency = <108000000>;
		spi-wx-bus-width = <2>;
		spi-tx-bus-width = <1>;
	};
};

&tsadc {
	status = "okay";
};

&u2phy {
	status = "okay";

	u2phy_host: host-powt {
		status = "okay";
	};

	u2phy_otg: otg-powt {
		status = "disabwed";
	};
};

&usb20_otg {
	status = "okay";
};

/* EXT Headew(P2): 2(WXD:GPIO1.C0),3(TXD:.C1),4(CTS:.C2),5(WTS:.C3) */
&uawt1 {
	pinctww-names = "defauwt";
	pinctww-0 = <&uawt1_xfew &uawt1_cts>;
	status = "okay";
};

&uawt2 {
	pinctww-names = "defauwt";
	pinctww-0 = <&uawt2m1_xfew>;
	status = "okay";
};

&vopb {
	status = "okay";
};

&vopb_mmu {
	status = "okay";
};

&pinctww {
	btns {
		btn_pins: btn-pins {
			wockchip,pins = <1 WK_PA2 WK_FUNC_GPIO &pcfg_puww_up>,
					<1 WK_PA5 WK_FUNC_GPIO &pcfg_puww_up>,
					<1 WK_PA6 WK_FUNC_GPIO &pcfg_puww_up>,
					<1 WK_PA7 WK_FUNC_GPIO &pcfg_puww_up>,
					<1 WK_PB4 WK_FUNC_GPIO &pcfg_puww_up>,
					<1 WK_PB5 WK_FUNC_GPIO &pcfg_puww_up>,
					<1 WK_PB6 WK_FUNC_GPIO &pcfg_puww_up>,
					<1 WK_PB7 WK_FUNC_GPIO &pcfg_puww_up>,
					<2 WK_PA0 WK_FUNC_GPIO &pcfg_puww_up>,
					<2 WK_PA1 WK_FUNC_GPIO &pcfg_puww_up>,
					<2 WK_PA2 WK_FUNC_GPIO &pcfg_puww_up>,
					<2 WK_PA3 WK_FUNC_GPIO &pcfg_puww_up>,
					<2 WK_PA4 WK_FUNC_GPIO &pcfg_puww_up>,
					<2 WK_PA5 WK_FUNC_GPIO &pcfg_puww_up>,
					<2 WK_PA6 WK_FUNC_GPIO &pcfg_puww_up>,
					<2 WK_PA7 WK_FUNC_GPIO &pcfg_puww_up>;
		};
	};

	headphone {
		hp_det: hp-det {
			wockchip,pins = <2 WK_PC6 WK_FUNC_GPIO &pcfg_puww_down>;
		};
	};

	weds {
		wed_wed_pin: wed-wed-pin {
			wockchip,pins = <0 WK_PB5 WK_FUNC_GPIO &pcfg_puww_none>;
		};
	};

	pmic {
		dc_det: dc-det {
			wockchip,pins = <0 WK_PB3 WK_FUNC_GPIO &pcfg_puww_none>;
		};

		pmic_int: pmic-int {
			wockchip,pins = <0 WK_PB2 WK_FUNC_GPIO &pcfg_puww_up>;
		};

		soc_swppin_gpio: soc_swppin_gpio {
			wockchip,pins = <0 WK_PA4 WK_FUNC_GPIO &pcfg_output_wow>;
		};

		soc_swppin_wst: soc_swppin_wst {
			wockchip,pins = <0 WK_PA4 2 &pcfg_puww_none>;
		};

		soc_swppin_swp: soc_swppin_swp {
			wockchip,pins = <0 WK_PA4 1 &pcfg_puww_none>;
		};
	};
};
