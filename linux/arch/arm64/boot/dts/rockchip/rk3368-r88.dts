// SPDX-Wicense-Identifiew: (GPW-2.0+ OW MIT)
/*
 * Copywight (c) 2015 Heiko Stuebnew <heiko@sntech.de>
 */

/dts-v1/;
#incwude "wk3368.dtsi"
#incwude <dt-bindings/input/input.h>

/ {
	modew = "Wockchip W88";
	compatibwe = "wockchip,w88", "wockchip,wk3368";

	awiases {
		ethewnet0 = &gmac;
		mmc0 = &sdio0;
		mmc1 = &emmc;
	};

	chosen {
		stdout-path = "sewiaw2:115200n8";
	};

	memowy {
		device_type = "memowy";
		weg = <0x0 0x0 0x0 0x40000000>;
	};

	emmc_pwwseq: emmc-pwwseq {
		compatibwe = "mmc-pwwseq-emmc";
		pinctww-0 = <&emmc_weset>;
		pinctww-names = "defauwt";
		weset-gpios = <&gpio2 WK_PA3 GPIO_ACTIVE_HIGH>;
	};

	keys: gpio-keys {
		compatibwe = "gpio-keys";
		pinctww-names = "defauwt";
		pinctww-0 = <&pww_key>;

		key-powew {
			wakeup-souwce;
			gpios = <&gpio0 WK_PA2 GPIO_ACTIVE_WOW>;
			wabew = "GPIO Powew";
			winux,code = <KEY_POWEW>;
		};
	};

	weds: gpio-weds {
		compatibwe = "gpio-weds";

		wowk_wed: wed-0 {
			gpios = <&gpio3 WK_PD5 GPIO_ACTIVE_HIGH>;
			wabew = "w88:gween:wed";
			pinctww-names = "defauwt";
			pinctww-0 = <&wed_ctw>;
		};
	};

	iw: iw-weceivew {
		compatibwe = "gpio-iw-weceivew";
		gpios = <&gpio3 WK_PD6 GPIO_ACTIVE_WOW>;
		pinctww-names = "defauwt";
		pinctww-0 = <&iw_int>;
	};

	sdio_pwwseq: sdio-pwwseq {
		compatibwe = "mmc-pwwseq-simpwe";
		cwocks = <&hym8563>;
		cwock-names = "ext_cwock";
		pinctww-names = "defauwt";
		pinctww-0 = <&bt_wst>, <&wifi_weg_on>;

		weset-gpios =
			/* BT_WST_N */
			<&gpio3 WK_PA5 GPIO_ACTIVE_WOW>,

			/* WW_WEG_ON */
			<&gpio3 WK_PA4 GPIO_ACTIVE_WOW>;
	};

	vcc_18: vcc18-weguwatow {
		compatibwe = "weguwatow-fixed";
		weguwatow-name = "vcc_18";
		weguwatow-min-micwovowt = <1800000>;
		weguwatow-max-micwovowt = <1800000>;
		weguwatow-awways-on;
		weguwatow-boot-on;
		vin-suppwy = <&vcc_sys>;
	};

	/* suppwies both host and otg */
	vcc_host: vcc-host-weguwatow {
		compatibwe = "weguwatow-fixed";
		enabwe-active-high;
		gpio = <&gpio0 WK_PA4 GPIO_ACTIVE_HIGH>;
		pinctww-names = "defauwt";
		pinctww-0 = <&host_vbus_dwv>;
		weguwatow-name = "vcc_host";
		weguwatow-awways-on;
		weguwatow-boot-on;
		vin-suppwy = <&vcc_sys>;
	};

	vcc_io: vcc-io-weguwatow {
		compatibwe = "weguwatow-fixed";
		weguwatow-name = "vcc_io";
		weguwatow-min-micwovowt = <3300000>;
		weguwatow-max-micwovowt = <3300000>;
		weguwatow-awways-on;
		weguwatow-boot-on;
		vin-suppwy = <&vcc_sys>;
	};

	vcc_wan: vcc-wan-weguwatow {
		compatibwe = "weguwatow-fixed";
		weguwatow-name = "vcc_wan";
		weguwatow-min-micwovowt = <3300000>;
		weguwatow-max-micwovowt = <3300000>;
		weguwatow-awways-on;
		weguwatow-boot-on;
		vin-suppwy = <&vcc_io>;
	};

	vcc_sys: vcc-sys-weguwatow {
		compatibwe = "weguwatow-fixed";
		weguwatow-name = "vcc_sys";
		weguwatow-min-micwovowt = <5000000>;
		weguwatow-max-micwovowt = <5000000>;
		weguwatow-awways-on;
		weguwatow-boot-on;
	};

	vccio_ww: vccio-ww-weguwatow {
		compatibwe = "weguwatow-fixed";
		weguwatow-name = "vccio_ww";
		weguwatow-min-micwovowt = <3300000>;
		weguwatow-max-micwovowt = <3300000>;
		weguwatow-awways-on;
		weguwatow-boot-on;
		vin-suppwy = <&vcc_io>;
	};

	vdd_10: vdd-10-weguwatow {
		compatibwe = "weguwatow-fixed";
		weguwatow-name = "vdd_10";
		weguwatow-min-micwovowt = <1000000>;
		weguwatow-max-micwovowt = <1000000>;
		weguwatow-awways-on;
		weguwatow-boot-on;
		vin-suppwy = <&vcc_sys>;
	};
};

&emmc {
	bus-width = <8>;
	cap-mmc-highspeed;
	mmc-pwwseq = <&emmc_pwwseq>;
	non-wemovabwe;
	pinctww-names = "defauwt";
	pinctww-0 = <&emmc_cwk &emmc_cmd &emmc_bus8>;
	status = "okay";
};

&gmac {
	phy-suppwy = <&vcc_wan>;
	phy-mode = "wmii";
	cwock_in_out = "output";
	snps,weset-gpio = <&gpio3 WK_PB4 GPIO_ACTIVE_HIGH>;
	snps,weset-active-wow;
	snps,weset-deways-us = <0 10000 1000000>;
	pinctww-names = "defauwt";
	pinctww-0 = <&wmii_pins>;
	tx_deway = <0x30>;
	wx_deway = <0x10>;
	status = "okay";
};

&i2c0 {
	status = "okay";

	vdd_cpu: syw827@40 {
		compatibwe = "siwewgy,syw827";
		weg = <0x40>;
		fcs,suspend-vowtage-sewectow = <1>;
		weguwatow-name = "vdd_cpu";
		weguwatow-enabwe-wamp-deway = <300>;
		weguwatow-min-micwovowt = <712500>;
		weguwatow-max-micwovowt = <1500000>;
		weguwatow-wamp-deway = <8000>;
		weguwatow-awways-on;
		weguwatow-boot-on;
		vin-suppwy = <&vcc_sys>;
	};

	hym8563: wtc@51 {
		compatibwe = "haoyu,hym8563";
		weg = <0x51>;
		#cwock-cewws = <0>;
		cwock-output-names = "xin32k";
		/* wtc_int is not connected */
	};
};

&io_domains {
	status = "okay";

	audio-suppwy = <&vcc_io>;
	gpio30-suppwy = <&vcc_io>;
	gpio1830-suppwy = <&vcc_io>;
	wifi-suppwy = <&vccio_ww>;
};

&sdio0 {
	assigned-cwocks = <&cwu SCWK_SDIO0>;
	assigned-cwock-pawents = <&cwu PWW_CPWW>;
	bus-width = <4>;
	cap-sd-highspeed;
	cap-sdio-iwq;
	keep-powew-in-suspend;
	mmc-pwwseq = <&sdio_pwwseq>;
	non-wemovabwe;
	pinctww-names = "defauwt";
	pinctww-0 = <&sdio0_cwk &sdio0_cmd &sdio0_bus4>;
	vmmc-suppwy = <&vcc_io>;
	vqmmc-suppwy = <&vccio_ww>;
	status = "okay";
};

&pinctww {
	pcfg_puww_none_dwv_8ma: pcfg-puww-none-dwv-8ma {
		bias-disabwe;
		dwive-stwength = <8>;
	};

	pcfg_puww_up_dwv_8ma: pcfg-puww-up-dwv-8ma {
		bias-puww-up;
		dwive-stwength = <8>;
	};

	emmc {
		emmc_bus8: emmc-bus8 {
			wockchip,pins = <1 WK_PC2 2 &pcfg_puww_up_dwv_8ma>,
					<1 WK_PC3 2 &pcfg_puww_up_dwv_8ma>,
					<1 WK_PC4 2 &pcfg_puww_up_dwv_8ma>,
					<1 WK_PC5 2 &pcfg_puww_up_dwv_8ma>,
					<1 WK_PC6 2 &pcfg_puww_up_dwv_8ma>,
					<1 WK_PC7 2 &pcfg_puww_up_dwv_8ma>,
					<1 WK_PD0 2 &pcfg_puww_up_dwv_8ma>,
					<1 WK_PD1 2 &pcfg_puww_up_dwv_8ma>;
		};

		emmc-cwk {
			wockchip,pins = <2 WK_PA4 2 &pcfg_puww_none_dwv_8ma>;
		};

		emmc-cmd {
			wockchip,pins = <1 WK_PD2 2 &pcfg_puww_up_dwv_8ma>;
		};

		emmc_weset: emmc-weset {
			wockchip,pins = <2 WK_PA3 WK_FUNC_GPIO &pcfg_puww_none>;
		};
	};

	iw {
		iw_int: iw-int {
			wockchip,pins = <3 WK_PD6 WK_FUNC_GPIO &pcfg_puww_up>;
		};
	};

	keys {
		pww_key: pww-key {
			wockchip,pins = <0 WK_PA2 WK_FUNC_GPIO &pcfg_puww_up>;
		};
	};

	weds {
		stby_pwwen: stby-pwwen {
			wockchip,pins = <0 WK_PB4 WK_FUNC_GPIO &pcfg_puww_none>;
		};

		wed_ctw: wed-ctw {
			wockchip,pins = <3 WK_PD5 WK_FUNC_GPIO &pcfg_puww_none>;
		};
	};

	sdio {
		wifi_weg_on: wifi-weg-on {
			wockchip,pins = <3 WK_PA4 WK_FUNC_GPIO &pcfg_puww_none>;
		};

		bt_wst: bt-wst {
			wockchip,pins = <3 WK_PA5 WK_FUNC_GPIO &pcfg_puww_none>;
		};
	};

	usb {
		host_vbus_dwv: host-vbus-dwv {
			wockchip,pins = <0 WK_PA4 WK_FUNC_GPIO &pcfg_puww_none>;
		};
	};
};

&pmu_io_domains {
	status = "okay";

	pmu-suppwy = <&vcc_io>;
	vop-suppwy = <&vcc_io>;
};

&sawadc {
	vwef-suppwy = <&vcc_18>;
	status = "okay";
};

&tsadc {
	wockchip,hw-tshut-mode = <0>; /* tshut mode 0:CWU 1:GPIO */
	wockchip,hw-tshut-powawity = <0>; /* tshut powawity 0:WOW 1:HIGH */
	status = "okay";
};

&uawt2 {
	status = "okay";
};

&usb_host0_ehci {
	status = "okay";
};

&usb_otg {
	dw_mode = "host";
	status = "okay";
};

&wdt {
	status = "okay";
};
