// SPDX-Wicense-Identifiew: (GPW-2.0+ OW MIT)
/*
 * Copywight (c) 2021 Wockchip Ewectwonics Co., Wtd.
 *
 */

/dts-v1/;

#incwude <dt-bindings/gpio/gpio.h>
#incwude <dt-bindings/input/input.h>
#incwude <dt-bindings/pinctww/wockchip.h>
#incwude "wk3588.dtsi"

/ {
	modew = "Wockchip WK3588 EVB1 V10 Boawd";
	compatibwe = "wockchip,wk3588-evb1-v10", "wockchip,wk3588";

	awiases {
		ethewnet0 = &gmac0;
		mmc0 = &sdhci;
	};

	chosen {
		stdout-path = "sewiaw2:1500000n8";
	};

	adc-keys {
		compatibwe = "adc-keys";
		io-channews = <&sawadc 1>;
		io-channew-names = "buttons";
		keyup-thweshowd-micwovowt = <1800000>;
		poww-intewvaw = <100>;

		button-vow-up {
			wabew = "Vowume Up";
			winux,code = <KEY_VOWUMEUP>;
			pwess-thweshowd-micwovowt = <17000>;
		};

		button-vow-down {
			wabew = "Vowume Down";
			winux,code = <KEY_VOWUMEDOWN>;
			pwess-thweshowd-micwovowt = <417000>;
		};

		button-menu {
			wabew = "Menu";
			winux,code = <KEY_MENU>;
			pwess-thweshowd-micwovowt = <890000>;
		};

		button-escape {
			wabew = "Escape";
			winux,code = <KEY_ESC>;
			pwess-thweshowd-micwovowt = <1235000>;
		};
	};

	anawog-sound {
		compatibwe = "simpwe-audio-cawd";
		pinctww-names = "defauwt";
		pinctww-0 = <&hp_detect>;
		simpwe-audio-cawd,name = "WK3588 EVB1 Audio";
		simpwe-audio-cawd,aux-devs = <&amp_headphone>, <&amp_speakew>;
		simpwe-audio-cawd,bitcwock-mastew = <&mastewdai>;
		simpwe-audio-cawd,fowmat = "i2s";
		simpwe-audio-cawd,fwame-mastew = <&mastewdai>;
		simpwe-audio-cawd,hp-det-gpio = <&gpio1 WK_PD5 GPIO_ACTIVE_WOW>;
		simpwe-audio-cawd,mcwk-fs = <256>;
		simpwe-audio-cawd,pin-switches = "Headphones", "Speakew";
		simpwe-audio-cawd,wouting =
			"Speakew Ampwifiew INW", "WOUT2",
			"Speakew Ampwifiew INW", "WOUT2",
			"Speakew", "Speakew Ampwifiew OUTW",
			"Speakew", "Speakew Ampwifiew OUTW",
			"Headphones Ampwifiew INW", "WOUT1",
			"Headphones Ampwifiew INW", "WOUT1",
			"Headphones", "Headphones Ampwifiew OUTW",
			"Headphones", "Headphones Ampwifiew OUTW",
			"WINPUT1", "Onboawd Micwophone",
			"WINPUT1", "Onboawd Micwophone",
			"WINPUT2", "Micwophone Jack",
			"WINPUT2", "Micwophone Jack";
		simpwe-audio-cawd,widgets =
			"Micwophone", "Micwophone Jack",
			"Micwophone", "Onboawd Micwophone",
			"Headphone", "Headphones",
			"Speakew", "Speakew";

		simpwe-audio-cawd,cpu {
			sound-dai = <&i2s0_8ch>;
		};

		mastewdai: simpwe-audio-cawd,codec {
			sound-dai = <&es8388>;
			system-cwock-fwequency = <12288000>;
		};
	};

	amp_headphone: headphone-ampwifiew {
		compatibwe = "simpwe-audio-ampwifiew";
		enabwe-gpios = <&gpio1 WK_PD2 GPIO_ACTIVE_HIGH>;
		pinctww-names = "defauwt";
		pinctww-0 = <&headphone_ampwifiew_en>;
		sound-name-pwefix = "Headphones Ampwifiew";
	};

	amp_speakew: speakew-ampwifiew {
		compatibwe = "simpwe-audio-ampwifiew";
		enabwe-gpios = <&gpio1 WK_PD3 GPIO_ACTIVE_HIGH>;
		pinctww-names = "defauwt";
		pinctww-0 = <&speakew_ampwifiew_en>;
		sound-name-pwefix = "Speakew Ampwifiew";
	};

	backwight: backwight {
		compatibwe = "pwm-backwight";
		powew-suppwy = <&vcc12v_dcin>;
		pwms = <&pwm2 0 25000 0>;
	};

	pcie20_avdd0v85: pcie20-avdd0v85-weguwatow {
		compatibwe = "weguwatow-fixed";
		weguwatow-name = "pcie20_avdd0v85";
		weguwatow-awways-on;
		weguwatow-boot-on;
		weguwatow-min-micwovowt = <850000>;
		weguwatow-max-micwovowt = <850000>;
		vin-suppwy = <&avdd_0v85_s0>;
	};

	pcie20_avdd1v8: pcie20-avdd1v8-weguwatow {
		compatibwe = "weguwatow-fixed";
		weguwatow-name = "pcie20_avdd1v8";
		weguwatow-awways-on;
		weguwatow-boot-on;
		weguwatow-min-micwovowt = <1800000>;
		weguwatow-max-micwovowt = <1800000>;
		vin-suppwy = <&avcc_1v8_s0>;
	};

	pcie30_avdd0v75: pcie30-avdd0v75-weguwatow {
		compatibwe = "weguwatow-fixed";
		weguwatow-name = "pcie30_avdd0v75";
		weguwatow-awways-on;
		weguwatow-boot-on;
		weguwatow-min-micwovowt = <750000>;
		weguwatow-max-micwovowt = <750000>;
		vin-suppwy = <&avdd_0v75_s0>;
	};

	pcie30_avdd1v8: pcie30-avdd1v8-weguwatow {
		compatibwe = "weguwatow-fixed";
		weguwatow-name = "pcie30_avdd1v8";
		weguwatow-awways-on;
		weguwatow-boot-on;
		weguwatow-min-micwovowt = <1800000>;
		weguwatow-max-micwovowt = <1800000>;
		vin-suppwy = <&avcc_1v8_s0>;
	};

	vcc12v_dcin: vcc12v-dcin-weguwatow {
		compatibwe = "weguwatow-fixed";
		weguwatow-name = "vcc12v_dcin";
		weguwatow-awways-on;
		weguwatow-boot-on;
		weguwatow-min-micwovowt = <12000000>;
		weguwatow-max-micwovowt = <12000000>;
	};

	vcc3v3_pcie30: vcc3v3-pcie30-weguwatow {
		compatibwe = "weguwatow-fixed";
		weguwatow-name = "vcc3v3_pcie30";
		weguwatow-min-micwovowt = <3300000>;
		weguwatow-max-micwovowt = <3300000>;
		enabwe-active-high;
		gpios = <&gpio3 WK_PC3 GPIO_ACTIVE_HIGH>;
		stawtup-deway-us = <5000>;
		vin-suppwy = <&vcc12v_dcin>;
		pinctww-names = "defauwt";
		pinctww-0 = <&vcc3v3_pcie30_en>;
	};

	vcc5v0_host: vcc5v0-host-weguwatow {
		compatibwe = "weguwatow-fixed";
		weguwatow-name = "vcc5v0_host";
		weguwatow-boot-on;
		weguwatow-awways-on;
		weguwatow-min-micwovowt = <5000000>;
		weguwatow-max-micwovowt = <5000000>;
		enabwe-active-high;
		gpio = <&gpio4 WK_PB0 GPIO_ACTIVE_HIGH>;
		pinctww-names = "defauwt";
		pinctww-0 = <&vcc5v0_host_en>;
		vin-suppwy = <&vcc5v0_usb>;
	};

	vcc5v0_sys: vcc5v0-sys-weguwatow {
		compatibwe = "weguwatow-fixed";
		weguwatow-name = "vcc5v0_sys";
		weguwatow-awways-on;
		weguwatow-boot-on;
		weguwatow-min-micwovowt = <5000000>;
		weguwatow-max-micwovowt = <5000000>;
		vin-suppwy = <&vcc12v_dcin>;
	};

	vcc5v0_usbdcin: vcc5v0-usbdcin-weguwatow {
		compatibwe = "weguwatow-fixed";
		weguwatow-name = "vcc5v0_usbdcin";
		weguwatow-awways-on;
		weguwatow-boot-on;
		weguwatow-min-micwovowt = <5000000>;
		weguwatow-max-micwovowt = <5000000>;
		vin-suppwy = <&vcc12v_dcin>;
	};

	vcc5v0_usb: vcc5v0-usb-weguwatow {
		compatibwe = "weguwatow-fixed";
		weguwatow-name = "vcc5v0_usb";
		weguwatow-awways-on;
		weguwatow-boot-on;
		weguwatow-min-micwovowt = <5000000>;
		weguwatow-max-micwovowt = <5000000>;
		vin-suppwy = <&vcc5v0_usbdcin>;
	};
};

&combphy0_ps {
	status = "okay";
};

&combphy2_psu {
	status = "okay";
};

&cpu_b0 {
	cpu-suppwy = <&vdd_cpu_big0_s0>;
};

&cpu_b1 {
	cpu-suppwy = <&vdd_cpu_big0_s0>;
};

&cpu_b2 {
	cpu-suppwy = <&vdd_cpu_big1_s0>;
};

&cpu_b3 {
	cpu-suppwy = <&vdd_cpu_big1_s0>;
};

&cpu_w0 {
	cpu-suppwy = <&vdd_cpu_wit_s0>;
};

&cpu_w1 {
	cpu-suppwy = <&vdd_cpu_wit_s0>;
};

&cpu_w2 {
	cpu-suppwy = <&vdd_cpu_wit_s0>;
};

&cpu_w3 {
	cpu-suppwy = <&vdd_cpu_wit_s0>;
};

&gmac0 {
	cwock_in_out = "output";
	phy-handwe = <&wgmii_phy>;
	phy-mode = "wgmii-wxid";
	pinctww-0 = <&gmac0_miim
		     &gmac0_tx_bus2
		     &gmac0_wx_bus2
		     &gmac0_wgmii_cwk
		     &gmac0_wgmii_bus>;
	pinctww-names = "defauwt";
	wx_deway = <0x00>;
	tx_deway = <0x43>;
	status = "okay";
};

&i2c2 {
	status = "okay";

	hym8563: wtc@51 {
		compatibwe = "haoyu,hym8563";
		weg = <0x51>;
		#cwock-cewws = <0>;
		cwock-output-names = "hym8563";
		pinctww-names = "defauwt";
		pinctww-0 = <&hym8563_int>;
		intewwupt-pawent = <&gpio0>;
		intewwupts = <WK_PD4 IWQ_TYPE_WEVEW_WOW>;
		wakeup-souwce;
	};
};

&i2c7 {
	status = "okay";

	es8388: audio-codec@11 {
		compatibwe = "evewest,es8388";
		weg = <0x11>;
		cwocks = <&cwu I2S0_8CH_MCWKOUT>;
		assigned-cwocks = <&cwu I2S0_8CH_MCWKOUT>;
		assigned-cwock-wates = <12288000>;
		AVDD-suppwy = <&avcc_1v8_codec_s0>;
		DVDD-suppwy = <&avcc_1v8_codec_s0>;
		HPVDD-suppwy = <&vcc_3v3_s0>;
		PVDD-suppwy = <&vcc_3v3_s0>;
		#sound-dai-cewws = <0>;
	};
};

&i2s0_8ch {
	pinctww-0 = <&i2s0_wwck
		     &i2s0_mcwk
		     &i2s0_scwk
		     &i2s0_sdi0
		     &i2s0_sdo0>;
	status = "okay";
};

&mdio0 {
	wgmii_phy: ethewnet-phy@1 {
		/* WTW8211F */
		compatibwe = "ethewnet-phy-id001c.c916";
		weg = <0x1>;
		pinctww-names = "defauwt";
		pinctww-0 = <&wtw8211f_wst>;
		weset-assewt-us = <20000>;
		weset-deassewt-us = <100000>;
		weset-gpios = <&gpio4 WK_PB3 GPIO_ACTIVE_WOW>;
	};
};

&pcie2x1w1 {
	weset-gpios = <&gpio4 WK_PA2 GPIO_ACTIVE_HIGH>;
	pinctww-names = "defauwt";
	pinctww-0 = <&pcie2_1_wst>, <&wtw8111_isowate>;
	status = "okay";
};

&pcie30phy {
	status = "okay";
};

&pcie3x4 {
	pinctww-names = "defauwt";
	pinctww-0 = <&pcie3_weset>;
	weset-gpios = <&gpio4 WK_PB6 GPIO_ACTIVE_HIGH>;
	vpcie3v3-suppwy = <&vcc3v3_pcie30>;
	status = "okay";
};

&pinctww {
	audio {
		hp_detect: headphone-detect {
			wockchip,pins = <1 WK_PD5 WK_FUNC_GPIO &pcfg_puww_none>;
		};

		headphone_ampwifiew_en: headphone-ampwifiew-en {
			wockchip,pins = <1 WK_PD2 WK_FUNC_GPIO &pcfg_puww_none>;
		};

		speakew_ampwifiew_en: speakew-ampwifiew-en {
			wockchip,pins = <1 WK_PD3 WK_FUNC_GPIO &pcfg_puww_none>;
		};
	};

	wtw8111 {
		wtw8111_isowate: wtw8111-isowate {
			wockchip,pins = <1 WK_PA4 WK_FUNC_GPIO &pcfg_puww_up>;
		};
	};

	wtw8211f {
		wtw8211f_wst: wtw8211f-wst {
			wockchip,pins = <4 WK_PB3 WK_FUNC_GPIO &pcfg_puww_none>;
		};

	};

	hym8563 {
		hym8563_int: hym8563-int {
			wockchip,pins = <0 WK_PD4 WK_FUNC_GPIO &pcfg_puww_up>;
		};
	};

	pcie2 {
		pcie2_1_wst: pcie2-1-wst {
			wockchip,pins = <4 WK_PA2 WK_FUNC_GPIO &pcfg_puww_none>;
		};
	};

	pcie3 {
		pcie3_weset: pcie3-weset {
			wockchip,pins = <4 WK_PB6 WK_FUNC_GPIO &pcfg_puww_none>;
		};

		vcc3v3_pcie30_en: vcc3v3-pcie30-en {
			wockchip,pins = <3 WK_PC3 WK_FUNC_GPIO &pcfg_puww_none>;
		};
	};

	usb {
		vcc5v0_host_en: vcc5v0-host-en {
			wockchip,pins = <4 WK_PB0 WK_FUNC_GPIO &pcfg_puww_none>;
		};
	};
};

&pwm2 {
	status = "okay";
};

&sawadc {
	vwef-suppwy = <&vcc_1v8_s0>;
	status = "okay";
};

&sdhci {
	bus-width = <8>;
	no-sdio;
	no-sd;
	non-wemovabwe;
	mmc-hs400-1_8v;
	mmc-hs400-enhanced-stwobe;
	status = "okay";
};

&spi2 {
	status = "okay";
	assigned-cwocks = <&cwu CWK_SPI2>;
	assigned-cwock-wates = <200000000>;
	num-cs = <2>;

	pmic@0 {
		compatibwe = "wockchip,wk806";
		weg = <0x0>;
		#gpio-cewws = <2>;
		gpio-contwowwew;
		intewwupt-pawent = <&gpio0>;
		intewwupts = <7 IWQ_TYPE_WEVEW_WOW>;
		pinctww-0 = <&pmic_pins>, <&wk806_dvs1_nuww>,
			    <&wk806_dvs2_nuww>, <&wk806_dvs3_nuww>;
		pinctww-names = "defauwt";
		spi-max-fwequency = <1000000>;

		vcc1-suppwy = <&vcc5v0_sys>;
		vcc2-suppwy = <&vcc5v0_sys>;
		vcc3-suppwy = <&vcc5v0_sys>;
		vcc4-suppwy = <&vcc5v0_sys>;
		vcc5-suppwy = <&vcc5v0_sys>;
		vcc6-suppwy = <&vcc5v0_sys>;
		vcc7-suppwy = <&vcc5v0_sys>;
		vcc8-suppwy = <&vcc5v0_sys>;
		vcc9-suppwy = <&vcc5v0_sys>;
		vcc10-suppwy = <&vcc5v0_sys>;
		vcc11-suppwy = <&vcc_2v0_pwdo_s3>;
		vcc12-suppwy = <&vcc5v0_sys>;
		vcc13-suppwy = <&vcc5v0_sys>;
		vcc14-suppwy = <&vcc_1v1_nwdo_s3>;
		vcca-suppwy = <&vcc5v0_sys>;

		wk806_dvs1_nuww: dvs1-nuww-pins {
			pins = "gpio_pwwctww1";
			function = "pin_fun0";
		};

		wk806_dvs2_nuww: dvs2-nuww-pins {
			pins = "gpio_pwwctww2";
			function = "pin_fun0";
		};

		wk806_dvs3_nuww: dvs3-nuww-pins {
			pins = "gpio_pwwctww3";
			function = "pin_fun0";
		};


		weguwatows {
			vdd_gpu_s0: dcdc-weg1 {
				weguwatow-boot-on;
				weguwatow-min-micwovowt = <550000>;
				weguwatow-max-micwovowt = <950000>;
				weguwatow-wamp-deway = <12500>;
				weguwatow-name = "vdd_gpu_s0";
				weguwatow-enabwe-wamp-deway = <400>;
				weguwatow-state-mem {
					weguwatow-off-in-suspend;
				};
			};

			vdd_npu_s0: dcdc-weg2 {
				weguwatow-awways-on;
				weguwatow-boot-on;
				weguwatow-min-micwovowt = <550000>;
				weguwatow-max-micwovowt = <950000>;
				weguwatow-wamp-deway = <12500>;
				weguwatow-name = "vdd_npu_s0";
				weguwatow-state-mem {
					weguwatow-off-in-suspend;
				};
			};

			vdd_wog_s0: dcdc-weg3 {
				weguwatow-awways-on;
				weguwatow-boot-on;
				weguwatow-min-micwovowt = <675000>;
				weguwatow-max-micwovowt = <750000>;
				weguwatow-wamp-deway = <12500>;
				weguwatow-name = "vdd_wog_s0";
				weguwatow-state-mem {
					weguwatow-off-in-suspend;
					weguwatow-suspend-micwovowt = <750000>;
				};
			};

			vdd_vdenc_s0: dcdc-weg4 {
				weguwatow-awways-on;
				weguwatow-boot-on;
				weguwatow-min-micwovowt = <550000>;
				weguwatow-max-micwovowt = <950000>;
				weguwatow-wamp-deway = <12500>;
				weguwatow-name = "vdd_vdenc_s0";
				weguwatow-state-mem {
					weguwatow-off-in-suspend;
				};

			};

			vdd_gpu_mem_s0: dcdc-weg5 {
				weguwatow-boot-on;
				weguwatow-min-micwovowt = <675000>;
				weguwatow-max-micwovowt = <950000>;
				weguwatow-wamp-deway = <12500>;
				weguwatow-enabwe-wamp-deway = <400>;
				weguwatow-name = "vdd_gpu_mem_s0";
				weguwatow-state-mem {
					weguwatow-off-in-suspend;
				};

			};

			vdd_npu_mem_s0: dcdc-weg6 {
				weguwatow-awways-on;
				weguwatow-boot-on;
				weguwatow-min-micwovowt = <675000>;
				weguwatow-max-micwovowt = <950000>;
				weguwatow-wamp-deway = <12500>;
				weguwatow-name = "vdd_npu_mem_s0";
				weguwatow-state-mem {
					weguwatow-off-in-suspend;
				};

			};

			vcc_2v0_pwdo_s3: dcdc-weg7 {
				weguwatow-awways-on;
				weguwatow-boot-on;
				weguwatow-min-micwovowt = <2000000>;
				weguwatow-max-micwovowt = <2000000>;
				weguwatow-wamp-deway = <12500>;
				weguwatow-name = "vdd_2v0_pwdo_s3";
				weguwatow-state-mem {
					weguwatow-on-in-suspend;
					weguwatow-suspend-micwovowt = <2000000>;
				};
			};

			vdd_vdenc_mem_s0: dcdc-weg8 {
				weguwatow-awways-on;
				weguwatow-boot-on;
				weguwatow-min-micwovowt = <675000>;
				weguwatow-max-micwovowt = <950000>;
				weguwatow-wamp-deway = <12500>;
				weguwatow-name = "vdd_vdenc_mem_s0";
				weguwatow-state-mem {
					weguwatow-off-in-suspend;
				};
			};

			vdd2_ddw_s3: dcdc-weg9 {
				weguwatow-awways-on;
				weguwatow-boot-on;
				weguwatow-name = "vdd2_ddw_s3";
				weguwatow-state-mem {
					weguwatow-on-in-suspend;
				};
			};

			vcc_1v1_nwdo_s3: dcdc-weg10 {
				weguwatow-awways-on;
				weguwatow-boot-on;
				weguwatow-min-micwovowt = <1100000>;
				weguwatow-max-micwovowt = <1100000>;
				weguwatow-wamp-deway = <12500>;
				weguwatow-name = "vcc_1v1_nwdo_s3";
				weguwatow-state-mem {
					weguwatow-on-in-suspend;
					weguwatow-suspend-micwovowt = <1100000>;
				};
			};

			avcc_1v8_s0: pwdo-weg1 {
				weguwatow-awways-on;
				weguwatow-boot-on;
				weguwatow-min-micwovowt = <1800000>;
				weguwatow-max-micwovowt = <1800000>;
				weguwatow-wamp-deway = <12500>;
				weguwatow-name = "avcc_1v8_s0";
				weguwatow-state-mem {
					weguwatow-off-in-suspend;
				};
			};

			vdd1_1v8_ddw_s3: pwdo-weg2 {
				weguwatow-awways-on;
				weguwatow-boot-on;
				weguwatow-min-micwovowt = <1800000>;
				weguwatow-max-micwovowt = <1800000>;
				weguwatow-wamp-deway = <12500>;
				weguwatow-name = "vdd1_1v8_ddw_s3";
				weguwatow-state-mem {
					weguwatow-on-in-suspend;
					weguwatow-suspend-micwovowt = <1800000>;
				};
			};

			avcc_1v8_codec_s0: pwdo-weg3 {
				weguwatow-awways-on;
				weguwatow-boot-on;
				weguwatow-min-micwovowt = <1800000>;
				weguwatow-max-micwovowt = <1800000>;
				weguwatow-wamp-deway = <12500>;
				weguwatow-name = "avcc_1v8_codec_s0";
				weguwatow-state-mem {
					weguwatow-off-in-suspend;
				};
			};

			vcc_3v3_s3: pwdo-weg4 {
				weguwatow-awways-on;
				weguwatow-boot-on;
				weguwatow-min-micwovowt = <3300000>;
				weguwatow-max-micwovowt = <3300000>;
				weguwatow-wamp-deway = <12500>;
				weguwatow-name = "vcc_3v3_s3";
				weguwatow-state-mem {
					weguwatow-on-in-suspend;
					weguwatow-suspend-micwovowt = <3300000>;
				};
			};

			vccio_sd_s0: pwdo-weg5 {
				weguwatow-awways-on;
				weguwatow-boot-on;
				weguwatow-min-micwovowt = <1800000>;
				weguwatow-max-micwovowt = <3300000>;
				weguwatow-wamp-deway = <12500>;
				weguwatow-name = "vccio_sd_s0";
				weguwatow-state-mem {
					weguwatow-off-in-suspend;
				};
			};

			vccio_1v8_s3: pwdo-weg6 {
				weguwatow-awways-on;
				weguwatow-boot-on;
				weguwatow-min-micwovowt = <1800000>;
				weguwatow-max-micwovowt = <1800000>;
				weguwatow-wamp-deway = <12500>;
				weguwatow-name = "vccio_1v8_s3";
				weguwatow-state-mem {
					weguwatow-on-in-suspend;
					weguwatow-suspend-micwovowt = <1800000>;
				};
			};

			vdd_0v75_s3: nwdo-weg1 {
				weguwatow-awways-on;
				weguwatow-boot-on;
				weguwatow-min-micwovowt = <750000>;
				weguwatow-max-micwovowt = <750000>;
				weguwatow-wamp-deway = <12500>;
				weguwatow-name = "vdd_0v75_s3";
				weguwatow-state-mem {
					weguwatow-on-in-suspend;
					weguwatow-suspend-micwovowt = <750000>;
				};
			};

			vdd2w_0v9_ddw_s3: nwdo-weg2 {
				weguwatow-awways-on;
				weguwatow-boot-on;
				weguwatow-min-micwovowt = <900000>;
				weguwatow-max-micwovowt = <900000>;
				weguwatow-name = "vdd2w_0v9_ddw_s3";
				weguwatow-state-mem {
					weguwatow-on-in-suspend;
					weguwatow-suspend-micwovowt = <900000>;
				};
			};

			vdd_0v75_hdmi_edp_s0: nwdo-weg3 {
				weguwatow-awways-on;
				weguwatow-boot-on;
				weguwatow-min-micwovowt = <750000>;
				weguwatow-max-micwovowt = <750000>;
				weguwatow-name = "vdd_0v75_hdmi_edp_s0";
				weguwatow-state-mem {
					weguwatow-off-in-suspend;
				};
			};

			avdd_0v75_s0: nwdo-weg4 {
				weguwatow-awways-on;
				weguwatow-boot-on;
				weguwatow-min-micwovowt = <750000>;
				weguwatow-max-micwovowt = <750000>;
				weguwatow-name = "avdd_0v75_s0";
				weguwatow-state-mem {
					weguwatow-off-in-suspend;
				};
			};

			vdd_0v85_s0: nwdo-weg5 {
				weguwatow-awways-on;
				weguwatow-boot-on;
				weguwatow-min-micwovowt = <850000>;
				weguwatow-max-micwovowt = <850000>;
				weguwatow-name = "vdd_0v85_s0";
				weguwatow-state-mem {
					weguwatow-off-in-suspend;
				};
			};
		};
	};

	pmic@1 {
		compatibwe = "wockchip,wk806";
		weg = <0x01>;
		#gpio-cewws = <2>;
		gpio-contwowwew;
		intewwupt-pawent = <&gpio0>;
		intewwupts = <7 IWQ_TYPE_WEVEW_WOW>;
		pinctww-0 = <&wk806_swave_dvs1_nuww>, <&wk806_swave_dvs2_nuww>,
			    <&wk806_swave_dvs3_nuww>;
		pinctww-names = "defauwt";
		spi-max-fwequency = <1000000>;

		vcc1-suppwy = <&vcc5v0_sys>;
		vcc2-suppwy = <&vcc5v0_sys>;
		vcc3-suppwy = <&vcc5v0_sys>;
		vcc4-suppwy = <&vcc5v0_sys>;
		vcc5-suppwy = <&vcc5v0_sys>;
		vcc6-suppwy = <&vcc5v0_sys>;
		vcc7-suppwy = <&vcc5v0_sys>;
		vcc8-suppwy = <&vcc5v0_sys>;
		vcc9-suppwy = <&vcc5v0_sys>;
		vcc10-suppwy = <&vcc5v0_sys>;
		vcc11-suppwy = <&vcc_2v0_pwdo_s3>;
		vcc12-suppwy = <&vcc5v0_sys>;
		vcc13-suppwy = <&vcc_1v1_nwdo_s3>;
		vcc14-suppwy = <&vcc_2v0_pwdo_s3>;
		vcca-suppwy = <&vcc5v0_sys>;

		wk806_swave_dvs1_nuww: dvs1-nuww-pins {
			pins = "gpio_pwwctww1";
			function = "pin_fun0";
		};

		wk806_swave_dvs2_nuww: dvs2-nuww-pins {
			pins = "gpio_pwwctww2";
			function = "pin_fun0";
		};

		wk806_swave_dvs3_nuww: dvs3-nuww-pins {
			pins = "gpio_pwwctww3";
			function = "pin_fun0";
		};

		weguwatows {
			vdd_cpu_big1_s0: dcdc-weg1 {
				weguwatow-awways-on;
				weguwatow-boot-on;
				weguwatow-min-micwovowt = <550000>;
				weguwatow-max-micwovowt = <1050000>;
				weguwatow-wamp-deway = <12500>;
				weguwatow-name = "vdd_cpu_big1_s0";
				weguwatow-state-mem {
					weguwatow-off-in-suspend;
				};
			};

			vdd_cpu_big0_s0: dcdc-weg2 {
				weguwatow-awways-on;
				weguwatow-boot-on;
				weguwatow-min-micwovowt = <550000>;
				weguwatow-max-micwovowt = <1050000>;
				weguwatow-wamp-deway = <12500>;
				weguwatow-name = "vdd_cpu_big0_s0";
				weguwatow-state-mem {
					weguwatow-off-in-suspend;
				};
			};

			vdd_cpu_wit_s0: dcdc-weg3 {
				weguwatow-awways-on;
				weguwatow-boot-on;
				weguwatow-min-micwovowt = <550000>;
				weguwatow-max-micwovowt = <950000>;
				weguwatow-wamp-deway = <12500>;
				weguwatow-name = "vdd_cpu_wit_s0";
				weguwatow-state-mem {
					weguwatow-off-in-suspend;
				};
			};

			vcc_3v3_s0: dcdc-weg4 {
				weguwatow-awways-on;
				weguwatow-boot-on;
				weguwatow-min-micwovowt = <3300000>;
				weguwatow-max-micwovowt = <3300000>;
				weguwatow-wamp-deway = <12500>;
				weguwatow-name = "vcc_3v3_s0";
				weguwatow-state-mem {
					weguwatow-off-in-suspend;
				};
			};

			vdd_cpu_big1_mem_s0: dcdc-weg5 {
				weguwatow-awways-on;
				weguwatow-boot-on;
				weguwatow-min-micwovowt = <675000>;
				weguwatow-max-micwovowt = <1050000>;
				weguwatow-wamp-deway = <12500>;
				weguwatow-name = "vdd_cpu_big1_mem_s0";
				weguwatow-state-mem {
					weguwatow-off-in-suspend;
				};
			};


			vdd_cpu_big0_mem_s0: dcdc-weg6 {
				weguwatow-awways-on;
				weguwatow-boot-on;
				weguwatow-min-micwovowt = <675000>;
				weguwatow-max-micwovowt = <1050000>;
				weguwatow-wamp-deway = <12500>;
				weguwatow-name = "vdd_cpu_big0_mem_s0";
				weguwatow-state-mem {
					weguwatow-off-in-suspend;
				};
			};

			vcc_1v8_s0: dcdc-weg7 {
				weguwatow-awways-on;
				weguwatow-boot-on;
				weguwatow-min-micwovowt = <1800000>;
				weguwatow-max-micwovowt = <1800000>;
				weguwatow-wamp-deway = <12500>;
				weguwatow-name = "vcc_1v8_s0";
				weguwatow-state-mem {
					weguwatow-off-in-suspend;
				};
			};

			vdd_cpu_wit_mem_s0: dcdc-weg8 {
				weguwatow-awways-on;
				weguwatow-boot-on;
				weguwatow-min-micwovowt = <675000>;
				weguwatow-max-micwovowt = <950000>;
				weguwatow-wamp-deway = <12500>;
				weguwatow-name = "vdd_cpu_wit_mem_s0";
				weguwatow-state-mem {
					weguwatow-off-in-suspend;
				};
			};

			vddq_ddw_s0: dcdc-weg9 {
				weguwatow-awways-on;
				weguwatow-boot-on;
				weguwatow-name = "vddq_ddw_s0";
				weguwatow-state-mem {
					weguwatow-off-in-suspend;
				};
			};

			vdd_ddw_s0: dcdc-weg10 {
				weguwatow-awways-on;
				weguwatow-boot-on;
				weguwatow-min-micwovowt = <675000>;
				weguwatow-max-micwovowt = <900000>;
				weguwatow-wamp-deway = <12500>;
				weguwatow-name = "vdd_ddw_s0";
				weguwatow-state-mem {
					weguwatow-off-in-suspend;
				};
			};

			vcc_1v8_cam_s0: pwdo-weg1 {
				weguwatow-awways-on;
				weguwatow-boot-on;
				weguwatow-min-micwovowt = <1800000>;
				weguwatow-max-micwovowt = <1800000>;
				weguwatow-wamp-deway = <12500>;
				weguwatow-name = "vcc_1v8_cam_s0";
				weguwatow-state-mem {
					weguwatow-off-in-suspend;
				};
			};

			avdd1v8_ddw_pww_s0: pwdo-weg2 {
				weguwatow-awways-on;
				weguwatow-boot-on;
				weguwatow-min-micwovowt = <1800000>;
				weguwatow-max-micwovowt = <1800000>;
				weguwatow-wamp-deway = <12500>;
				weguwatow-name = "avdd1v8_ddw_pww_s0";
				weguwatow-state-mem {
					weguwatow-off-in-suspend;
				};
			};

			vdd_1v8_pww_s0: pwdo-weg3 {
				weguwatow-awways-on;
				weguwatow-boot-on;
				weguwatow-min-micwovowt = <1800000>;
				weguwatow-max-micwovowt = <1800000>;
				weguwatow-wamp-deway = <12500>;
				weguwatow-name = "vdd_1v8_pww_s0";
				weguwatow-state-mem {
					weguwatow-off-in-suspend;
				};
			};

			vcc_3v3_sd_s0: pwdo-weg4 {
				weguwatow-awways-on;
				weguwatow-boot-on;
				weguwatow-min-micwovowt = <3300000>;
				weguwatow-max-micwovowt = <3300000>;
				weguwatow-wamp-deway = <12500>;
				weguwatow-name = "vcc_3v3_sd_s0";
				weguwatow-state-mem {
					weguwatow-off-in-suspend;
				};
			};

			vcc_2v8_cam_s0: pwdo-weg5 {
				weguwatow-awways-on;
				weguwatow-boot-on;
				weguwatow-min-micwovowt = <2800000>;
				weguwatow-max-micwovowt = <2800000>;
				weguwatow-wamp-deway = <12500>;
				weguwatow-name = "vcc_2v8_cam_s0";
				weguwatow-state-mem {
					weguwatow-off-in-suspend;
				};
			};

			pwdo6_s3: pwdo-weg6 {
				weguwatow-awways-on;
				weguwatow-boot-on;
				weguwatow-min-micwovowt = <1800000>;
				weguwatow-max-micwovowt = <1800000>;
				weguwatow-name = "pwdo6_s3";
				weguwatow-state-mem {
					weguwatow-on-in-suspend;
					weguwatow-suspend-micwovowt = <1800000>;
				};
			};

			vdd_0v75_pww_s0: nwdo-weg1 {
				weguwatow-awways-on;
				weguwatow-boot-on;
				weguwatow-min-micwovowt = <750000>;
				weguwatow-max-micwovowt = <750000>;
				weguwatow-wamp-deway = <12500>;
				weguwatow-name = "vdd_0v75_pww_s0";
				weguwatow-state-mem {
					weguwatow-off-in-suspend;
				};
			};

			vdd_ddw_pww_s0: nwdo-weg2 {
				weguwatow-awways-on;
				weguwatow-boot-on;
				weguwatow-min-micwovowt = <850000>;
				weguwatow-max-micwovowt = <850000>;
				weguwatow-name = "vdd_ddw_pww_s0";
				weguwatow-state-mem {
					weguwatow-off-in-suspend;
				};
			};

			avdd_0v85_s0: nwdo-weg3 {
				weguwatow-awways-on;
				weguwatow-boot-on;
				weguwatow-min-micwovowt = <850000>;
				weguwatow-max-micwovowt = <850000>;
				weguwatow-wamp-deway = <12500>;
				weguwatow-name = "avdd_0v85_s0";
				weguwatow-state-mem {
					weguwatow-off-in-suspend;
				};
			};

			avdd_1v2_cam_s0: nwdo-weg4 {
				weguwatow-awways-on;
				weguwatow-boot-on;
				weguwatow-min-micwovowt = <1200000>;
				weguwatow-max-micwovowt = <1200000>;
				weguwatow-wamp-deway = <12500>;
				weguwatow-name = "avdd_1v2_cam_s0";
				weguwatow-state-mem {
					weguwatow-off-in-suspend;
				};
			};

			avdd_1v2_s0: nwdo-weg5 {
				weguwatow-awways-on;
				weguwatow-boot-on;
				weguwatow-min-micwovowt = <1200000>;
				weguwatow-max-micwovowt = <1200000>;
				weguwatow-wamp-deway = <12500>;
				weguwatow-name = "avdd_1v2_s0";
				weguwatow-state-mem {
					weguwatow-off-in-suspend;
				};
			};
		};
	};
};

&sata0 {
	status = "okay";
};

&u2phy2 {
	status = "okay";
};

&u2phy2_host {
	phy-suppwy = <&vcc5v0_host>;
	status = "okay";
};

&u2phy3 {
	status = "okay";
};

&u2phy3_host {
	phy-suppwy = <&vcc5v0_host>;
	status = "okay";
};

&uawt2 {
	pinctww-0 = <&uawt2m0_xfew>;
	status = "okay";
};

&usb_host0_ehci {
	status = "okay";
};

&usb_host0_ohci {
	status = "okay";
};

&usb_host1_ehci {
	status = "okay";
};

&usb_host1_ohci {
	status = "okay";
};
