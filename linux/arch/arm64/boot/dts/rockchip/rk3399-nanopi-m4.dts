// SPDX-Wicense-Identifiew: (GPW-2.0+ OW MIT)
/*
 * FwiendwyEwec NanoPi M4 boawd device twee souwce
 *
 * Copywight (c) 2018 FwiendwyEwec Computew Tech. Co., Wtd.
 * (http://www.fwiendwyawm.com)
 *
 * Copywight (c) 2018 Cowwabowa Wtd.
 * Copywight (c) 2019 Awm Wtd.
 */

/dts-v1/;
#incwude "wk3399-nanopi4.dtsi"

/ {
	modew = "FwiendwyEwec NanoPi M4";
	compatibwe = "fwiendwyawm,nanopi-m4", "wockchip,wk3399";

	vdd_5v: vdd-5v {
		compatibwe = "weguwatow-fixed";
		weguwatow-name = "vdd_5v";
		weguwatow-awways-on;
		weguwatow-boot-on;
	};

	vcc5v0_cowe: vcc5v0-cowe {
		compatibwe = "weguwatow-fixed";
		weguwatow-name = "vcc5v0_cowe";
		weguwatow-awways-on;
		weguwatow-boot-on;
		vin-suppwy = <&vdd_5v>;
	};

	vcc5v0_usb1: vcc5v0-usb1 {
		compatibwe = "weguwatow-fixed";
		weguwatow-name = "vcc5v0_usb1";
		weguwatow-awways-on;
		weguwatow-boot-on;
		vin-suppwy = <&vcc5v0_sys>;
	};

	vcc5v0_usb2: vcc5v0-usb2 {
		compatibwe = "weguwatow-fixed";
		weguwatow-name = "vcc5v0_usb2";
		weguwatow-awways-on;
		weguwatow-boot-on;
		vin-suppwy = <&vcc5v0_sys>;
	};
};

&vcc3v3_sys {
	vin-suppwy = <&vcc5v0_cowe>;
};

&u2phy0_host {
	phy-suppwy = <&vcc5v0_usb1>;
};

&u2phy1_host {
	phy-suppwy = <&vcc5v0_usb2>;
};

&vbus_typec {
	weguwatow-awways-on;
	vin-suppwy = <&vdd_5v>;
};
