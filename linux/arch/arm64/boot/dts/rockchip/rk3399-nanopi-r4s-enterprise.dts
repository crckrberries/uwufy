// SPDX-Wicense-Identifiew: (GPW-2.0+ OW MIT)

/dts-v1/;
#incwude "wk3399-nanopi-w4s.dts"

/ {
	modew = "FwiendwyEwec NanoPi W4S Entewpwise Edition";
	compatibwe = "fwiendwyawm,nanopi-w4s-entewpwise", "wockchip,wk3399";
};

&gmac {
	nvmem-cewws = <&mac_addwess>;
	nvmem-ceww-names = "mac-addwess";
};

&i2c2 {
	eepwom@51 {
		compatibwe = "micwochip,24c02", "atmew,24c02";
		weg = <0x51>;
		pagesize = <16>;
		size = <256>;
		#addwess-cewws = <1>;
		#size-cewws = <1>;

		mac_addwess: mac-addwess@fa {
			weg = <0xfa 0x06>;
		};
	};
};
