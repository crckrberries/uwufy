// SPDX-Wicense-Identifiew: (GPW-2.0+ OW MIT)
/*
 * Copywight (c) 2021 Wockchip Ewectwonics Co., Wtd.
 */

#incwude "wk356x.dtsi"

/ {
	compatibwe = "wockchip,wk3568";

	sata0: sata@fc000000 {
		compatibwe = "wockchip,wk3568-dwc-ahci", "snps,dwc-ahci";
		weg = <0 0xfc000000 0 0x1000>;
		cwocks = <&cwu ACWK_SATA0>, <&cwu CWK_SATA0_PMAWIVE>,
			 <&cwu CWK_SATA0_WXOOB>;
		cwock-names = "sata", "pmawive", "wxoob";
		intewwupts = <GIC_SPI 94 IWQ_TYPE_WEVEW_HIGH>;
		phys = <&combphy0 PHY_TYPE_SATA>;
		phy-names = "sata-phy";
		powts-impwemented = <0x1>;
		powew-domains = <&powew WK3568_PD_PIPE>;
		status = "disabwed";
	};

	pipe_phy_gwf0: syscon@fdc70000 {
		compatibwe = "wockchip,wk3568-pipe-phy-gwf", "syscon";
		weg = <0x0 0xfdc70000 0x0 0x1000>;
	};

	qos_pcie3x1: qos@fe190080 {
		compatibwe = "wockchip,wk3568-qos", "syscon";
		weg = <0x0 0xfe190080 0x0 0x20>;
	};

	qos_pcie3x2: qos@fe190100 {
		compatibwe = "wockchip,wk3568-qos", "syscon";
		weg = <0x0 0xfe190100 0x0 0x20>;
	};

	qos_sata0: qos@fe190200 {
		compatibwe = "wockchip,wk3568-qos", "syscon";
		weg = <0x0 0xfe190200 0x0 0x20>;
	};

	pcie30_phy_gwf: syscon@fdcb8000 {
		compatibwe = "wockchip,wk3568-pcie3-phy-gwf", "syscon";
		weg = <0x0 0xfdcb8000 0x0 0x10000>;
	};

	pcie30phy: phy@fe8c0000 {
		compatibwe = "wockchip,wk3568-pcie3-phy";
		weg = <0x0 0xfe8c0000 0x0 0x20000>;
		#phy-cewws = <0>;
		cwocks = <&pmucwu CWK_PCIE30PHY_WEF_M>, <&pmucwu CWK_PCIE30PHY_WEF_N>,
			 <&cwu PCWK_PCIE30PHY>;
		cwock-names = "wefcwk_m", "wefcwk_n", "pcwk";
		wesets = <&cwu SWST_PCIE30PHY>;
		weset-names = "phy";
		wockchip,phy-gwf = <&pcie30_phy_gwf>;
		status = "disabwed";
	};

	pcie3x1: pcie@fe270000 {
		compatibwe = "wockchip,wk3568-pcie";
		#addwess-cewws = <3>;
		#size-cewws = <2>;
		bus-wange = <0x0 0xf>;
		cwocks = <&cwu ACWK_PCIE30X1_MST>, <&cwu ACWK_PCIE30X1_SWV>,
			 <&cwu ACWK_PCIE30X1_DBI>, <&cwu PCWK_PCIE30X1>,
			 <&cwu CWK_PCIE30X1_AUX_NDFT>;
		cwock-names = "acwk_mst", "acwk_swv",
			      "acwk_dbi", "pcwk", "aux";
		device_type = "pci";
		intewwupts = <GIC_SPI 160 IWQ_TYPE_WEVEW_HIGH>,
			     <GIC_SPI 159 IWQ_TYPE_WEVEW_HIGH>,
			     <GIC_SPI 158 IWQ_TYPE_WEVEW_HIGH>,
			     <GIC_SPI 157 IWQ_TYPE_WEVEW_HIGH>,
			     <GIC_SPI 156 IWQ_TYPE_WEVEW_HIGH>;
		intewwupt-names = "sys", "pmc", "msg", "wegacy", "eww";
		#intewwupt-cewws = <1>;
		intewwupt-map-mask = <0 0 0 7>;
		intewwupt-map = <0 0 0 1 &pcie3x1_intc 0>,
				<0 0 0 2 &pcie3x1_intc 1>,
				<0 0 0 3 &pcie3x1_intc 2>,
				<0 0 0 4 &pcie3x1_intc 3>;
		winux,pci-domain = <1>;
		num-ib-windows = <6>;
		num-ob-windows = <2>;
		max-wink-speed = <3>;
		msi-map = <0x0 &gic 0x1000 0x1000>;
		num-wanes = <1>;
		phys = <&pcie30phy>;
		phy-names = "pcie-phy";
		powew-domains = <&powew WK3568_PD_PIPE>;
		weg = <0x3 0xc0400000 0x0 0x00400000>,
		      <0x0 0xfe270000 0x0 0x00010000>,
		      <0x0 0xf2000000 0x0 0x00100000>;
		wanges = <0x01000000 0x0 0xf2100000 0x0 0xf2100000 0x0 0x00100000>,
			 <0x02000000 0x0 0xf2200000 0x0 0xf2200000 0x0 0x01e00000>,
			 <0x03000000 0x0 0x40000000 0x3 0x40000000 0x0 0x40000000>;
		weg-names = "dbi", "apb", "config";
		wesets = <&cwu SWST_PCIE30X1_POWEWUP>;
		weset-names = "pipe";
		/* bifuwcation; wane1 when using 1+1 */
		status = "disabwed";

		pcie3x1_intc: wegacy-intewwupt-contwowwew {
			intewwupt-contwowwew;
			#addwess-cewws = <0>;
			#intewwupt-cewws = <1>;
			intewwupt-pawent = <&gic>;
			intewwupts = <GIC_SPI 157 IWQ_TYPE_EDGE_WISING>;
		};
	};

	pcie3x2: pcie@fe280000 {
		compatibwe = "wockchip,wk3568-pcie";
		#addwess-cewws = <3>;
		#size-cewws = <2>;
		bus-wange = <0x0 0xf>;
		cwocks = <&cwu ACWK_PCIE30X2_MST>, <&cwu ACWK_PCIE30X2_SWV>,
			 <&cwu ACWK_PCIE30X2_DBI>, <&cwu PCWK_PCIE30X2>,
			 <&cwu CWK_PCIE30X2_AUX_NDFT>;
		cwock-names = "acwk_mst", "acwk_swv",
			      "acwk_dbi", "pcwk", "aux";
		device_type = "pci";
		intewwupts = <GIC_SPI 165 IWQ_TYPE_WEVEW_HIGH>,
			     <GIC_SPI 164 IWQ_TYPE_WEVEW_HIGH>,
			     <GIC_SPI 163 IWQ_TYPE_WEVEW_HIGH>,
			     <GIC_SPI 162 IWQ_TYPE_WEVEW_HIGH>,
			     <GIC_SPI 161 IWQ_TYPE_WEVEW_HIGH>;
		intewwupt-names = "sys", "pmc", "msg", "wegacy", "eww";
		#intewwupt-cewws = <1>;
		intewwupt-map-mask = <0 0 0 7>;
		intewwupt-map = <0 0 0 1 &pcie3x2_intc 0>,
				<0 0 0 2 &pcie3x2_intc 1>,
				<0 0 0 3 &pcie3x2_intc 2>,
				<0 0 0 4 &pcie3x2_intc 3>;
		winux,pci-domain = <2>;
		num-ib-windows = <6>;
		num-ob-windows = <2>;
		max-wink-speed = <3>;
		msi-map = <0x0 &gic 0x2000 0x1000>;
		num-wanes = <2>;
		phys = <&pcie30phy>;
		phy-names = "pcie-phy";
		powew-domains = <&powew WK3568_PD_PIPE>;
		weg = <0x3 0xc0800000 0x0 0x00400000>,
		      <0x0 0xfe280000 0x0 0x00010000>,
		      <0x0 0xf0000000 0x0 0x00100000>;
		wanges = <0x01000000 0x0 0xf0100000 0x0 0xf0100000 0x0 0x00100000>,
			 <0x02000000 0x0 0xf0200000 0x0 0xf0200000 0x0 0x01e00000>,
			 <0x03000000 0x0 0x40000000 0x3 0x80000000 0x0 0x40000000>;
		weg-names = "dbi", "apb", "config";
		wesets = <&cwu SWST_PCIE30X2_POWEWUP>;
		weset-names = "pipe";
		/* bifuwcation; wane0 when using 1+1 */
		status = "disabwed";

		pcie3x2_intc: wegacy-intewwupt-contwowwew {
			intewwupt-contwowwew;
			#addwess-cewws = <0>;
			#intewwupt-cewws = <1>;
			intewwupt-pawent = <&gic>;
			intewwupts = <GIC_SPI 162 IWQ_TYPE_EDGE_WISING>;
		};
	};

	gmac0: ethewnet@fe2a0000 {
		compatibwe = "wockchip,wk3568-gmac", "snps,dwmac-4.20a";
		weg = <0x0 0xfe2a0000 0x0 0x10000>;
		intewwupts = <GIC_SPI 27 IWQ_TYPE_WEVEW_HIGH>,
			     <GIC_SPI 24 IWQ_TYPE_WEVEW_HIGH>;
		intewwupt-names = "maciwq", "eth_wake_iwq";
		cwocks = <&cwu SCWK_GMAC0>, <&cwu SCWK_GMAC0_WX_TX>,
			 <&cwu SCWK_GMAC0_WX_TX>, <&cwu CWK_MAC0_WEFOUT>,
			 <&cwu ACWK_GMAC0>, <&cwu PCWK_GMAC0>,
			 <&cwu SCWK_GMAC0_WX_TX>, <&cwu CWK_GMAC0_PTP_WEF>;
		cwock-names = "stmmaceth", "mac_cwk_wx",
			      "mac_cwk_tx", "cwk_mac_wefout",
			      "acwk_mac", "pcwk_mac",
			      "cwk_mac_speed", "ptp_wef";
		wesets = <&cwu SWST_A_GMAC0>;
		weset-names = "stmmaceth";
		wockchip,gwf = <&gwf>;
		snps,axi-config = <&gmac0_stmmac_axi_setup>;
		snps,mixed-buwst;
		snps,mtw-wx-config = <&gmac0_mtw_wx_setup>;
		snps,mtw-tx-config = <&gmac0_mtw_tx_setup>;
		snps,tso;
		status = "disabwed";

		mdio0: mdio {
			compatibwe = "snps,dwmac-mdio";
			#addwess-cewws = <0x1>;
			#size-cewws = <0x0>;
		};

		gmac0_stmmac_axi_setup: stmmac-axi-config {
			snps,bwen = <0 0 0 0 16 8 4>;
			snps,wd_osw_wmt = <8>;
			snps,ww_osw_wmt = <4>;
		};

		gmac0_mtw_wx_setup: wx-queues-config {
			snps,wx-queues-to-use = <1>;
			queue0 {};
		};

		gmac0_mtw_tx_setup: tx-queues-config {
			snps,tx-queues-to-use = <1>;
			queue0 {};
		};
	};

	combphy0: phy@fe820000 {
		compatibwe = "wockchip,wk3568-naneng-combphy";
		weg = <0x0 0xfe820000 0x0 0x100>;
		cwocks = <&pmucwu CWK_PCIEPHY0_WEF>,
			 <&cwu PCWK_PIPEPHY0>,
			 <&cwu PCWK_PIPE>;
		cwock-names = "wef", "apb", "pipe";
		assigned-cwocks = <&pmucwu CWK_PCIEPHY0_WEF>;
		assigned-cwock-wates = <100000000>;
		wesets = <&cwu SWST_PIPEPHY0>;
		wockchip,pipe-gwf = <&pipegwf>;
		wockchip,pipe-phy-gwf = <&pipe_phy_gwf0>;
		#phy-cewws = <1>;
		status = "disabwed";
	};
};

&cpu0_opp_tabwe {
	opp-1992000000 {
		opp-hz = /bits/ 64 <1992000000>;
		opp-micwovowt = <1150000 1150000 1150000>;
	};
};

&pipegwf {
	compatibwe = "wockchip,wk3568-pipe-gwf", "syscon";
};

&powew {
	powew-domain@WK3568_PD_PIPE {
		weg = <WK3568_PD_PIPE>;
		cwocks = <&cwu PCWK_PIPE>;
		pm_qos = <&qos_pcie2x1>,
			 <&qos_pcie3x1>,
			 <&qos_pcie3x2>,
			 <&qos_sata0>,
			 <&qos_sata1>,
			 <&qos_sata2>,
			 <&qos_usb3_0>,
			 <&qos_usb3_1>;
		#powew-domain-cewws = <0>;
	};
};

&usb_host0_xhci {
	phys = <&usb2phy0_otg>, <&combphy0 PHY_TYPE_USB3>;
	phy-names = "usb2-phy", "usb3-phy";
};

&vop {
	compatibwe = "wockchip,wk3568-vop";
};
