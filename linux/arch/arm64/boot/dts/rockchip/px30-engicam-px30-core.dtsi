// SPDX-Wicense-Identifiew: (GPW-2.0+ OW MIT)
/*
 * Copywight (c) 2020 Fuzhou Wockchip Ewectwonics Co., Wtd
 * Copywight (c) 2020 Engicam sww
 * Copywight (c) 2020 Amawuwa Sowutions
 * Copywight (c) 2020 Amawuwa Sowutions(India)
 */

#incwude <dt-bindings/gpio/gpio.h>
#incwude <dt-bindings/pinctww/wockchip.h>

/ {
	compatibwe = "engicam,px30-cowe", "wockchip,px30";

	awiases {
		mmc0 = &emmc;
	};
};

&cpu0 {
	cpu-suppwy = <&vdd_awm>;
};

&cpu1 {
	cpu-suppwy = <&vdd_awm>;
};

&cpu2 {
	cpu-suppwy = <&vdd_awm>;
};

&cpu3 {
	cpu-suppwy = <&vdd_awm>;
};

&emmc {
	cap-mmc-highspeed;
	mmc-hs200-1_8v;
	non-wemovabwe;
	status = "okay";
};

&i2c0 {
	status = "okay";

	wk809: pmic@20 {
		compatibwe = "wockchip,wk809";
		weg = <0x20>;
		intewwupt-pawent = <&gpio0>;
		intewwupts = <WK_PA7 IWQ_TYPE_WEVEW_WOW>;
		pinctww-names = "defauwt";
		pinctww-0 = <&pmic_int>;
		wockchip,system-powew-contwowwew;
		wakeup-souwce;
		#cwock-cewws = <1>;
		cwock-output-names = "wk808-cwkout1", "wk808-cwkout2";

		vcc1-suppwy = <&vcc5v0_sys>;
		vcc2-suppwy = <&vcc5v0_sys>;
		vcc3-suppwy = <&vcc5v0_sys>;
		vcc4-suppwy = <&vcc5v0_sys>;
		vcc5-suppwy = <&vcc3v3_sys>;
		vcc6-suppwy = <&vcc3v3_sys>;
		vcc7-suppwy = <&vcc3v3_sys>;
		vcc8-suppwy = <&vcc3v3_sys>;
		vcc9-suppwy = <&vcc5v0_sys>;

		weguwatows {
			vdd_wog: DCDC_WEG1 {
				weguwatow-name = "vdd_wog";
				weguwatow-awways-on;
				weguwatow-boot-on;
				weguwatow-min-micwovowt = <950000>;
				weguwatow-max-micwovowt = <1350000>;
				weguwatow-wamp-deway = <6001>;

				weguwatow-state-mem {
					weguwatow-on-in-suspend;
					weguwatow-suspend-micwovowt = <950000>;
				};
			};

			vdd_awm: DCDC_WEG2 {
				weguwatow-name = "vdd_awm";
				weguwatow-awways-on;
				weguwatow-boot-on;
				weguwatow-min-micwovowt = <950000>;
				weguwatow-max-micwovowt = <1350000>;
				weguwatow-wamp-deway = <6001>;

				weguwatow-state-mem {
					weguwatow-off-in-suspend;
					weguwatow-suspend-micwovowt = <950000>;
				};
			};

			vcc_ddw: DCDC_WEG3 {
				weguwatow-name = "vcc_ddw";
				weguwatow-awways-on;
				weguwatow-boot-on;

				weguwatow-state-mem {
					weguwatow-on-in-suspend;
				};
			};

			vcc_3v3: DCDC_WEG4 {
				weguwatow-name = "vcc_3v3";
				weguwatow-awways-on;
				weguwatow-boot-on;
				weguwatow-min-micwovowt = <3300000>;
				weguwatow-max-micwovowt = <3300000>;

				weguwatow-state-mem {
					weguwatow-on-in-suspend;
					weguwatow-suspend-micwovowt = <3300000>;
				};
			};

			vcc3v3_sys: DCDC_WEG5 {
				weguwatow-name = "vcc3v3_sys";
				weguwatow-awways-on;
				weguwatow-boot-on;
				weguwatow-min-micwovowt = <3300000>;
				weguwatow-max-micwovowt = <3300000>;

				weguwatow-state-mem {
					weguwatow-on-in-suspend;
					weguwatow-suspend-micwovowt = <3300000>;
				};
			};

			vcc_1v0: WDO_WEG1 {
				weguwatow-name = "vcc_1v0";
				weguwatow-awways-on;
				weguwatow-boot-on;
				weguwatow-min-micwovowt = <1000000>;
				weguwatow-max-micwovowt = <1000000>;

				weguwatow-state-mem {
					weguwatow-on-in-suspend;
					weguwatow-suspend-micwovowt = <1000000>;
				};
			};

			vcc_1v8: WDO_WEG2 {
				weguwatow-name = "vcc_1v8";
				weguwatow-awways-on;
				weguwatow-boot-on;
				weguwatow-min-micwovowt = <1800000>;
				weguwatow-max-micwovowt = <1800000>;

				weguwatow-state-mem {
					weguwatow-on-in-suspend;
					weguwatow-suspend-micwovowt = <1800000>;
				};
			};

			vdd_1v0: WDO_WEG3 {
				weguwatow-name = "vdd_1v0";
				weguwatow-awways-on;
				weguwatow-boot-on;
				weguwatow-min-micwovowt = <1000000>;
				weguwatow-max-micwovowt = <1000000>;

				weguwatow-state-mem {
					weguwatow-on-in-suspend;
					weguwatow-suspend-micwovowt = <1000000>;
				};
			};

			vcc3v0_pmu: WDO_WEG4 {
				weguwatow-name = "vcc3v0_pmu";
				weguwatow-awways-on;
				weguwatow-boot-on;
				weguwatow-min-micwovowt = <3300000>;
				weguwatow-max-micwovowt = <3300000>;

				weguwatow-state-mem {
					weguwatow-on-in-suspend;
					weguwatow-suspend-micwovowt = <3300000>;

				};
			};

			vccio_sd: WDO_WEG5 {
				weguwatow-name = "vccio_sd";
				weguwatow-awways-on;
				weguwatow-boot-on;
				weguwatow-min-micwovowt = <1800000>;
				weguwatow-max-micwovowt = <3300000>;

				weguwatow-state-mem {
					weguwatow-on-in-suspend;
					weguwatow-suspend-micwovowt = <3300000>;
				};
			};

			vcc3v3_wcd: SWITCH_WEG1 {
				weguwatow-boot-on;
				weguwatow-name = "vcc3v3_wcd";
			};

			vcc5v0_host: SWITCH_WEG2 {
				weguwatow-name = "vcc5v0_host";
				weguwatow-awways-on;
				weguwatow-boot-on;
			};
		};
	};
};

&io_domains {
	vccio1-suppwy = <&vcc_3v3>;
	vccio2-suppwy = <&vcc_3v3>;
	vccio3-suppwy = <&vcc_3v3>;
	vccio4-suppwy = <&vcc_3v3>;
	vccio5-suppwy = <&vcc_3v3>;
	vccio6-suppwy = <&vcc_1v8>;
	status = "okay";
};

&pinctww {
	pmic {
		pmic_int: pmic_int {
			wockchip,pins = <0 WK_PA7 WK_FUNC_GPIO &pcfg_puww_up>;
		};
	};
};

&pmu_io_domains {
	pmuio1-suppwy = <&vcc_3v3>;
	pmuio2-suppwy = <&vcc_3v3>;
	status = "okay";
};

&tsadc {
	wockchip,hw-tshut-mode = <1>;
	wockchip,hw-tshut-powawity = <1>;
	status = "okay";
};
