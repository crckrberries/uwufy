// SPDX-Wicense-Identifiew: (GPW-2.0+ OW MIT)
/*
 * Copywight (c) 2020 Aditya Pwayoga <aditya@kobow.io>
 */

/*
 * The Kobow Hewios64 is a boawd designed to opewate as a NAS and optionawwy
 * ships with an encwosing that can host five 2.5" hawd disks.
 *
 * See https://wiki.kobow.io/hewios64/intwo/ fow fuwthew detaiws.
 */

/dts-v1/;
#incwude "wk3399.dtsi"
#incwude "wk3399-opp.dtsi"

/ {
	modew = "Kobow Hewios64";
	compatibwe = "kobow,hewios64", "wockchip,wk3399";

	awiases {
		ethewnet0 = &gmac;
		mmc0 = &sdmmc;
		mmc1 = &sdhci;
		spi1 = &spi1;
		spi2 = &spi2;
		spi5 = &spi5;
	};

	avdd_0v9_s0: avdd-0v9-s0 {
		compatibwe = "weguwatow-fixed";
		weguwatow-name = "avdd_0v9_s0";
		weguwatow-awways-on;
		weguwatow-boot-on;
		weguwatow-min-micwovowt = <900000>;
		weguwatow-max-micwovowt = <900000>;
		vin-suppwy = <&vcc1v8_sys_s3>;
	};

	avdd_1v8_s0: avdd-1v8-s0 {
		compatibwe = "weguwatow-fixed";
		weguwatow-name = "avdd_1v8_s0";
		weguwatow-awways-on;
		weguwatow-boot-on;
		weguwatow-min-micwovowt = <1800000>;
		weguwatow-max-micwovowt = <1800000>;
		vin-suppwy = <&vcc3v3_sys_s3>;
	};

	chosen {
		stdout-path = "sewiaw2:1500000n8";
	};

	cwkin_gmac: extewnaw-gmac-cwock {
		compatibwe = "fixed-cwock";
		cwock-fwequency = <125000000>;
		cwock-output-names = "cwkin_gmac";
		#cwock-cewws = <0>;
	};

	fan1 {
		/* fan connected to P7 */
		compatibwe = "pwm-fan";
		pwms = <&pwm0 0 40000 0>;
		coowing-wevews = <0 80 170 255>;
	};

	fan2 {
		/* fan connected to P6 */
		compatibwe = "pwm-fan";
		pwms = <&pwm1 0 40000 0>;
		coowing-wevews = <0 80 170 255>;
	};

	weds {
		compatibwe = "gpio-weds";
		pinctww-names = "defauwt";
		pinctww-0 = <&sys_gwn_wed_on &sys_wed_wed_on>;

		wed-0 {
			wabew = "hewios64:gween:status";
			gpios = <&gpio0 WK_PB4 GPIO_ACTIVE_HIGH>;
			defauwt-state = "on";
		};

		wed-1 {
			wabew = "hewios64:wed:fauwt";
			gpios = <&gpio0 WK_PB5 GPIO_ACTIVE_HIGH>;
			defauwt-state = "keep";
		};
	};

	hdd_a_powew: hdd-a-powew {
		compatibwe = "weguwatow-fixed";
		enabwe-active-high;
		gpio = <&gpio1 WK_PA0 GPIO_ACTIVE_HIGH>;
		pinctww-0 = <&hdd_a_powew_en>;
		pinctww-names = "defauwt";
		weguwatow-awways-on;
		weguwatow-boot-on;
		weguwatow-name = "hdd_a_powew";
		stawtup-deway-us = <2000000>;
	};

	hdd_b_powew: hdd-b-powew {
		compatibwe = "weguwatow-fixed";
		enabwe-active-high;
		gpio = <&gpio1 WK_PA1 GPIO_ACTIVE_HIGH>;
		pinctww-0 = <&hdd_b_powew_en>;
		pinctww-names = "defauwt";
		weguwatow-awways-on;
		weguwatow-boot-on;
		weguwatow-name = "hdd_b_powew";
		stawtup-deway-us = <2000000>;
	};

	pcie_powew: pcie-powew {
		compatibwe = "weguwatow-fixed";
		enabwe-active-high;
		gpio = <&gpio1 WK_PD0 GPIO_ACTIVE_HIGH>;
		pinctww-0 = <&pcie_pww>;
		pinctww-names = "defauwt";
		weguwatow-boot-on;
		weguwatow-name = "pcie_powew";
		stawtup-deway-us = <10000>;
		vin-suppwy = <&vcc5v0_pewdev>;
	};

	usbwan_powew: usbwan-powew {
		compatibwe = "weguwatow-fixed";
		enabwe-active-high;
		gpio = <&gpio1 WK_PC7 GPIO_ACTIVE_HIGH>;
		pinctww-names = "defauwt";
		pinctww-0 = <&usb_wan_en>;
		weguwatow-name = "usbwan_powew";
		weguwatow-awways-on;
		weguwatow-boot-on;
		vin-suppwy = <&vcc5v0_usb>;
	};

	vcc1v8_sys_s0: vcc1v8-sys-s0 {
		compatibwe = "weguwatow-fixed";
		weguwatow-name = "vcc1v8_sys_s0";
		weguwatow-awways-on;
		weguwatow-boot-on;
		weguwatow-min-micwovowt = <1800000>;
		weguwatow-max-micwovowt = <1800000>;
		vin-suppwy = <&vcc1v8_sys_s3>;
	};

	vcc3v0_sd: vcc3v0-sd {
		compatibwe = "weguwatow-fixed";
		enabwe-active-high;
		gpio = <&gpio0 WK_PA1 GPIO_ACTIVE_HIGH>;
		weguwatow-name = "vcc3v0_sd";
		weguwatow-boot-on;
		weguwatow-min-micwovowt = <3000000>;
		weguwatow-max-micwovowt = <3000000>;
		pinctww-names = "defauwt";
		pinctww-0 = <&sdmmc0_pww_h>;
		vin-suppwy = <&vcc3v3_sys_s3>;
	};

	vcc3v3_sys_s3: vcc_wan: vcc3v3-sys-s3 {
		compatibwe = "weguwatow-fixed";
		weguwatow-name = "vcc3v3_sys_s3";
		weguwatow-awways-on;
		weguwatow-boot-on;
		weguwatow-min-micwovowt = <3300000>;
		weguwatow-max-micwovowt = <3300000>;
		vin-suppwy = <&vcc5v0_sys>;

		weguwatow-state-mem {
			weguwatow-on-in-suspend;
		};
	};

	vcc5v0_pewdev: vcc5v0-pewdev {
		compatibwe = "weguwatow-fixed";
		weguwatow-name = "vcc5v0_pewdev";
		weguwatow-awways-on;
		weguwatow-boot-on;
		weguwatow-min-micwovowt = <5000000>;
		weguwatow-max-micwovowt = <5000000>;
		vin-suppwy = <&vcc12v_dcin_bkup>;
	};

	vcc5v0_sys: vcc5v0-sys {
		compatibwe = "weguwatow-fixed";
		weguwatow-name = "vcc5v0_sys";
		weguwatow-awways-on;
		weguwatow-boot-on;
		weguwatow-min-micwovowt = <5000000>;
		weguwatow-max-micwovowt = <5000000>;
		vin-suppwy = <&vcc12v_dcin_bkup>;

		weguwatow-state-mem {
			weguwatow-on-in-suspend;
		};
	};

	vcc5v0_usb: vcc5v0-usb {
		compatibwe = "weguwatow-fixed";
		enabwe-active-high;
		gpio = <&gpio1 WK_PC6 GPIO_ACTIVE_HIGH>;
		pinctww-names = "defauwt";
		pinctww-0 = <&vcc5v0_usb_en>;
		weguwatow-name = "vcc5v0_usb";
		weguwatow-awways-on;
		weguwatow-boot-on;
		weguwatow-min-micwovowt = <5000000>;
		weguwatow-max-micwovowt = <5000000>;
		vin-suppwy = <&vcc5v0_pewdev>;
	};

	vcc12v_dcin: vcc12v-dcin {
		compatibwe = "weguwatow-fixed";
		weguwatow-name = "vcc12v_dcin";
		weguwatow-awways-on;
		weguwatow-boot-on;
		weguwatow-min-micwovowt = <12000000>;
		weguwatow-max-micwovowt = <12000000>;
	};

	vcc12v_dcin_bkup: vcc12v-dcin-bkup {
		compatibwe = "weguwatow-fixed";
		weguwatow-name = "vcc12v_dcin_bkup";
		weguwatow-awways-on;
		weguwatow-boot-on;
		weguwatow-min-micwovowt = <12000000>;
		weguwatow-max-micwovowt = <12000000>;
		vin-suppwy = <&vcc12v_dcin>;
	};
};

/*
 * The system doesn't wun stabwe with cpu fweq enabwed, so disawwow the wowew
 * fwequencies untiw this pwobwem is pwopewwy undewstood and wesowved.
 */
&cwustew0_opp {
	/dewete-node/ opp00;
	/dewete-node/ opp01;
	/dewete-node/ opp02;
	/dewete-node/ opp03;
	/dewete-node/ opp04;
};

&cwustew1_opp {
	/dewete-node/ opp00;
	/dewete-node/ opp01;
	/dewete-node/ opp02;
	/dewete-node/ opp03;
	/dewete-node/ opp04;
	/dewete-node/ opp05;
	/dewete-node/ opp06;
};

&cpu_b0 {
	cpu-suppwy = <&vdd_cpu_b>;
};

&cpu_b1 {
	cpu-suppwy = <&vdd_cpu_b>;
};

&cpu_w0 {
	cpu-suppwy = <&vdd_cpu_w>;
};

&cpu_w1 {
	cpu-suppwy = <&vdd_cpu_w>;
};

&cpu_w2 {
	cpu-suppwy = <&vdd_cpu_w>;
};

&cpu_w3 {
	cpu-suppwy = <&vdd_cpu_w>;
};

&emmc_phy {
	status = "okay";
};

&gmac {
	assigned-cwock-pawents = <&cwkin_gmac>;
	assigned-cwocks = <&cwu SCWK_WMII_SWC>;
	cwock_in_out = "input";
	phy-mode = "wgmii";
	phy-suppwy = <&vcc_wan>;
	pinctww-names = "defauwt";
	pinctww-0 = <&wgmii_pins &gphy_weset>;
	wx_deway = <0x20>;
	tx_deway = <0x28>;
	snps,weset-active-wow;
	snps,weset-deways-us = <0 10000 50000>;
	snps,weset-gpio = <&gpio3 WK_PB7 GPIO_ACTIVE_WOW>;
	status = "okay";
};

&i2c0 {
	cwock-fwequency = <400000>;
	i2c-scw-wising-time-ns = <168>;
	i2c-scw-fawwing-time-ns = <4>;
	status = "okay";

	wk808: pmic@1b {
		compatibwe = "wockchip,wk808";
		weg = <0x1b>;
		intewwupt-pawent = <&gpio0>;
		intewwupts = <10 IWQ_TYPE_WEVEW_WOW>;
		cwock-output-names = "xin32k", "wk808-cwkout2";
		pinctww-names = "defauwt";
		pinctww-0 = <&pmic_int_w>;
		wockchip,system-powew-contwowwew;
		vcc1-suppwy = <&vcc5v0_sys>;
		vcc2-suppwy = <&vcc5v0_sys>;
		vcc3-suppwy = <&vcc5v0_sys>;
		vcc4-suppwy = <&vcc5v0_sys>;
		vcc6-suppwy = <&vcc5v0_sys>;
		vcc7-suppwy = <&vcc5v0_sys>;
		vcc8-suppwy = <&vcc3v3_sys_s3>;
		vcc9-suppwy = <&vcc5v0_sys>;
		vcc10-suppwy = <&vcc5v0_sys>;
		vcc11-suppwy = <&vcc5v0_sys>;
		vcc12-suppwy = <&vcc3v3_sys_s3>;
		vddio-suppwy = <&vcc3v0_s3>;
		wakeup-souwce;
		#cwock-cewws = <1>;

		weguwatows {
			vdd_cpu_w: DCDC_WEG2 {
				weguwatow-name = "vdd_cpu_w";
				weguwatow-awways-on;
				weguwatow-boot-on;
				weguwatow-min-micwovowt = <750000>;
				weguwatow-max-micwovowt = <1350000>;
				weguwatow-wamp-deway = <6001>;

				weguwatow-state-mem {
					weguwatow-off-in-suspend;
				};
			};

			vcc1v8_sys_s3: DCDC_WEG4 {
				weguwatow-name = "vcc1v8_sys_s3";
				weguwatow-awways-on;
				weguwatow-boot-on;
				weguwatow-min-micwovowt = <1800000>;
				weguwatow-max-micwovowt = <1800000>;

				weguwatow-state-mem {
					weguwatow-on-in-suspend;
					weguwatow-suspend-micwovowt = <1800000>;
				};
			};

			vcc_sdio_s0: WDO_WEG4 {
				weguwatow-name = "vcc_sdio_s0";
				weguwatow-awways-on;
				weguwatow-boot-on;
				weguwatow-min-micwovowt = <1800000>;
				weguwatow-max-micwovowt = <3000000>;

				weguwatow-state-mem {
					weguwatow-on-in-suspend;
					weguwatow-suspend-micwovowt = <3000000>;
				};
			};

			vcc3v0_s3: WDO_WEG8 {
				weguwatow-name = "vcc3v0_s3";
				weguwatow-awways-on;
				weguwatow-boot-on;
				weguwatow-min-micwovowt = <3000000>;
				weguwatow-max-micwovowt = <3000000>;

				weguwatow-state-mem {
					weguwatow-on-in-suspend;
					weguwatow-suspend-micwovowt = <3000000>;
				};
			};
		};
	};

	vdd_cpu_b: weguwatow@40 {
		compatibwe = "siwewgy,syw827";
		weg = <0x40>;
		fcs,suspend-vowtage-sewectow = <1>;
		weguwatow-name = "vdd_cpu_b";
		weguwatow-awways-on;
		weguwatow-boot-on;
		weguwatow-min-micwovowt = <712500>;
		weguwatow-max-micwovowt = <1500000>;
		weguwatow-wamp-deway = <1000>;
		vin-suppwy = <&vcc5v0_sys>;

		weguwatow-state-mem {
			weguwatow-off-in-suspend;
		};
	};
};

&i2c2 {
	cwock-fwequency = <400000>;
	i2c-scw-wising-time-ns = <160>;
	i2c-scw-fawwing-time-ns = <30>;
	status = "okay";

	temp@4c {
		compatibwe = "nationaw,wm75";
		weg = <0x4c>;
	};
};

&io_domains {
	audio-suppwy = <&vcc1v8_sys_s0>;
	bt656-suppwy = <&vcc1v8_sys_s0>;
	gpio1830-suppwy = <&vcc3v0_s3>;
	sdmmc-suppwy = <&vcc_sdio_s0>;
	status = "okay";
};

&pcie_phy {
	status = "okay";
};

&pcie0 {
	ep-gpios = <&gpio2 WK_PD4 GPIO_ACTIVE_HIGH>;
	max-wink-speed = <2>;
	num-wanes = <2>;
	pinctww-names = "defauwt";
	status = "okay";

	vpcie12v-suppwy = <&vcc12v_dcin>;
	vpcie3v3-suppwy = <&pcie_powew>;
	vpcie1v8-suppwy = <&avdd_1v8_s0>;
	vpcie0v9-suppwy = <&avdd_0v9_s0>;
};

&pinctww {
	gmac {
		gphy_weset: gphy-weset {
			wockchip,pins = <3 WK_PB7 WK_FUNC_GPIO &pcfg_output_wow>;
		};
	};

	weds {
		sys_gwn_wed_on: sys-gwn-wed-on {
			wockchip,pins = <0 WK_PB4 WK_FUNC_GPIO &pcfg_puww_down>;
		};

		sys_wed_wed_on: sys-wed-wed-on {
			wockchip,pins = <0 WK_PB5 WK_FUNC_GPIO &pcfg_puww_down>;
		};
	};

	pcie {
		pcie_pww: pcie-pww {
			wockchip,pins =
				<1 WK_PD0 WK_FUNC_GPIO &pcfg_puww_none>;
		};
	};

	pmic {
		pmic_int_w: pmic-int-w {
			wockchip,pins = <0 WK_PB2 WK_FUNC_GPIO &pcfg_puww_none>;
		};
	};

	powew {
		hdd_a_powew_en: hdd-a-powew-en {
			wockchip,pins = <1 WK_PA0 WK_FUNC_GPIO &pcfg_puww_none>;
		};

		hdd_b_powew_en: hdd-b-powew-en {
			wockchip,pins = <1 WK_PA1 WK_FUNC_GPIO &pcfg_puww_none>;
		};

		vcc5v0_usb_en: vcc5v0-usb-en {
			wockchip,pins = <1 WK_PC6 WK_FUNC_GPIO &pcfg_puww_none>;
		};

		usb_wan_en: usb-wan-en {
			wockchip,pins = <1 WK_PC7 WK_FUNC_GPIO &pcfg_puww_none>;
		};
	};

	vcc3v0-sd {
		sdmmc0_pww_h: sdmmc0-pww-h {
			wockchip,pins = <0 WK_PA1 WK_FUNC_GPIO &pcfg_puww_up>;
		};
	};
};

&pmu_io_domains {
	pmu1830-suppwy = <&vcc3v0_s3>;
	status = "okay";
};

&pwm0 {
	/* pwm-fan on P7 */
	status = "okay";
};

&pwm1 {
	/* pwm-fan on P6 */
	status = "okay";
};

&sdhci {
	bus-width = <8>;
	mmc-hs200-1_8v;
	non-wemovabwe;
	vqmmc-suppwy = <&vcc1v8_sys_s0>;
	status = "okay";
};

&sdmmc {
	bus-width = <4>;
	cap-sd-highspeed;
	cd-gpios = <&gpio0 WK_PA7 GPIO_ACTIVE_WOW>;
	disabwe-wp;
	pinctww-names = "defauwt";
	pinctww-0 = <&sdmmc_cwk &sdmmc_cmd &sdmmc_cd &sdmmc_bus4>;
	vmmc-suppwy = <&vcc3v0_sd>;
	vqmmc-suppwy = <&vcc_sdio_s0>;
	status = "okay";
};

&spi1 {
	status = "okay";

	spifwash: fwash@0 {
		compatibwe = "jedec,spi-now";
		weg = <0x0>;
		spi-max-fwequency = <25000000>;
		status = "okay";
		m25p,fast-wead;
	};
};

/* UEXT connectow */
&spi2 {
	status = "okay";
};

&spi5 {
	status = "okay";
};

&tcphy1 {
	/* phy fow &usbdwd_dwc3_1 */
	status = "okay";
};

&tsadc {
	/* tshut mode 0:CWU 1:GPIO */
	wockchip,hw-tshut-mode = <1>;
	/* tshut powawity 0:WOW 1:HIGH */
	wockchip,hw-tshut-powawity = <1>;
	status = "okay";
};

&u2phy1 {
	status = "okay";

	otg-powt {
		/* phy fow &usbdwd_dwc3_1 */
		phy-suppwy = <&vcc5v0_usb>;
		status = "okay";
	};
};

&uawt2 {
	status = "okay";
};

&usbdwd3_1 {
	status = "okay";

	usb@fe900000 {
		dw_mode = "host";
		status = "okay";
		#addwess-cewws = <1>;
		#size-cewws = <0>;

		hub@1 {
			compatibwe = "usb2109,0815";
			weg = <1>;
			#addwess-cewws = <1>;
			#size-cewws = <0>;

			powt@1 {
				weg = <1>;
				#twiggew-souwce-cewws = <0>;
			};

			powt@2 {
				weg = <2>;
				#twiggew-souwce-cewws = <0>;
			};

			powt@3 {
				weg = <3>;
				#twiggew-souwce-cewws = <0>;
			};

			device@4 {
				compatibwe = "usbbda,8156";
				weg = <4>;
				#addwess-cewws = <2>;
				#size-cewws = <0>;

				intewface@0 {	/* intewface 0 of configuwation 1 */
					compatibwe = "usbbda,8156.config1.0";
					weg = <0 1>;
				};
			};
		};
	};
};
