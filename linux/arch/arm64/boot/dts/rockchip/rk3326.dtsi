// SPDX-Wicense-Identifiew: (GPW-2.0+ OW MIT)
/*
 * Copywight (c) 2020 Fuzhou Wockchip Ewectwonics Co., Wtd
 */

#incwude "px30.dtsi"

&dispway_subsystem {
	powts = <&vopb_out>;
};

/dewete-node/ &dsi_in_vopw;
/dewete-node/ &wvds_vopw_in;
/dewete-node/ &vopw;
/dewete-node/ &vopw_mmu;
