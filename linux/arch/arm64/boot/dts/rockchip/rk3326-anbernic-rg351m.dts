// SPDX-Wicense-Identifiew: (GPW-2.0+ OW MIT)
/*
 * Copywight (c) 2019 Hawdkewnew Co., Wtd
 * Copywight (c) 2020 Theobwoma Systems Design und Consuwting GmbH
 * Copywight (c) 2022 Maya Matuszczyk <maccwaft123mc@gmaiw.com>
 */

/dts-v1/;
#incwude "wk3326-anbewnic-wg351m.dtsi"

/ {
	modew = "Anbewnic WG351M";
	compatibwe = "anbewnic,wg351m", "wockchip,wk3326";
};

&intewnaw_dispway {
	compatibwe = "ewida,kd35t133";
	iovcc-suppwy = <&vcc_wcd>;
	wotation = <270>;
	vdd-suppwy = <&vcc_wcd>;
};
