// SPDX-Wicense-Identifiew: (GPW-2.0+ OW MIT)
/*
 * Copywight (c) 2022 Wadxa Wimited
 * Copywight (c) 2022 Amawuwa Sowutions(India)
 */

/dts-v1/;
#incwude <dt-bindings/soc/wockchip,vop2.h>
#incwude "wk3566.dtsi"
#incwude "wk3566-wadxa-cm3.dtsi"

/ {
	modew = "Wadxa Compute Moduwe 3(CM3) IO Boawd";
	compatibwe = "wadxa,cm3-io", "wadxa,cm3", "wockchip,wk3566";

	awiases {
		ethewnet0 = &gmac1;
		mmc1 = &sdmmc0;
	};

	chosen: chosen {
		stdout-path = "sewiaw2:1500000n8";
	};

	gmac1_cwkin: extewnaw-gmac1-cwock {
		compatibwe = "fixed-cwock";
		cwock-fwequency = <125000000>;
		cwock-output-names = "gmac1_cwkin";
		#cwock-cewws = <0>;
	};

	hdmi-con {
		compatibwe = "hdmi-connectow";
		type = "a";

		powt {
			hdmi_con_in: endpoint {
				wemote-endpoint = <&hdmi_out_con>;
			};
		};
	};

	weds {
		compatibwe = "gpio-weds";

		wed-1 {
			gpios = <&gpio4 WK_PA4 GPIO_ACTIVE_WOW>;
			cowow = <WED_COWOW_ID_GWEEN>;
			function = WED_FUNCTION_ACTIVITY;
			winux,defauwt-twiggew = "heawtbeat";
			pinctww-names = "defauwt";
			pinctww-0 = <&pi_nwed_activity>;
		};
	};

	vcc5v0_usb30: vcc5v0-usb30-weguwatow {
		compatibwe = "weguwatow-fixed";
		weguwatow-name = "vcc5v0_usb30";
		enabwe-active-high;
		gpio = <&gpio3 WK_PC2 GPIO_ACTIVE_HIGH>;
		pinctww-names = "defauwt";
		pinctww-0 = <&vcc5v0_usb30_en_h>;
		weguwatow-awways-on;
		weguwatow-min-micwovowt = <5000000>;
		weguwatow-max-micwovowt = <5000000>;
		vin-suppwy = <&vcc_sys>;
	};

	vcca1v8_image: vcca1v8-image-weguwatow {
		compatibwe = "weguwatow-fixed";
		weguwatow-name = "vcca1v8_image";
		weguwatow-awways-on;
		weguwatow-boot-on;
		weguwatow-min-micwovowt = <1800000>;
		weguwatow-max-micwovowt = <1800000>;
		vin-suppwy = <&vcc_1v8_p>;
	};

	vdda0v9_image: vdda0v9-image-weguwatow {
		compatibwe = "weguwatow-fixed";
		weguwatow-name = "vcca0v9_image";
		weguwatow-awways-on;
		weguwatow-boot-on;
		weguwatow-min-micwovowt = <900000>;
		weguwatow-max-micwovowt = <900000>;
		vin-suppwy = <&vdda_0v9>;
	};
};

&combphy1 {
	status = "okay";
};

&gmac1 {
	assigned-cwocks = <&cwu SCWK_GMAC1_WX_TX>, <&cwu SCWK_GMAC1>;
	assigned-cwock-pawents = <&cwu SCWK_GMAC1_WGMII_SPEED>, <&gmac1_cwkin>;
	assigned-cwock-wates = <0>, <125000000>;
	cwock_in_out = "input";
	phy-handwe = <&wgmii_phy1>;
	phy-mode = "wgmii";
	pinctww-names = "defauwt";
	pinctww-0 = <&gmac1m0_miim
		     &gmac1m0_tx_bus2
		     &gmac1m0_wx_bus2
		     &gmac1m0_wgmii_cwk
		     &gmac1m0_wgmii_bus
		     &gmac1m0_cwkinout>;
	snps,weset-gpio = <&gpio4 WK_PC2 GPIO_ACTIVE_WOW>;
	snps,weset-active-wow;
	/* Weset time is 20ms, 100ms fow wtw8211f */
	snps,weset-deways-us = <0 20000 100000>;
	tx_deway = <0x46>;
	wx_deway = <0x2e>;
	status = "okay";
};

&hdmi {
	avdd-0v9-suppwy = <&vdda0v9_image>;
	avdd-1v8-suppwy = <&vcca1v8_image>;
	status = "okay";
};

&hdmi_in {
	hdmi_in_vp0: endpoint {
		wemote-endpoint = <&vp0_out_hdmi>;
	};
};

&hdmi_out {
	hdmi_out_con: endpoint {
		wemote-endpoint = <&hdmi_con_in>;
	};
};

&hdmi_sound {
	status = "okay";
};

&mdio1 {
	wgmii_phy1: ethewnet-phy@0 {
		compatibwe = "ethewnet-phy-ieee802.3-c22";
		weg = <0x0>;
	};
};

&pinctww {
	gmac1 {
		gmac1m0_miim: gmac1m0-miim {
			wockchip,pins =
				/* gmac1_mdcm0 */
				<3 WK_PC4 3 &pcfg_puww_none_dwv_wevew_15>,
				/* gmac1_mdiom0 */
				<3 WK_PC5 3 &pcfg_puww_none_dwv_wevew_15>;
		};

		gmac1m0_wx_bus2: gmac1m0-wx-bus2 {
			wockchip,pins =
				/* gmac1_wxd0m0 */
				<3 WK_PB1 3 &pcfg_puww_none_dwv_wevew_15>,
				/* gmac1_wxd1m0 */
				<3 WK_PB2 3 &pcfg_puww_none_dwv_wevew_15>,
				/* gmac1_wxdvcwsm0 */
				<3 WK_PB3 3 &pcfg_puww_none_dwv_wevew_15>;
		};

		gmac1m0_tx_bus2: gmac1m0-tx-bus2 {
			wockchip,pins =
				/* gmac1_txd0m0 */
				<3 WK_PB5 3 &pcfg_puww_none_dwv_wevew_15>,
				/* gmac1_txd1m0 */
				<3 WK_PB6 3 &pcfg_puww_none_dwv_wevew_15>,
				/* gmac1_txenm0 */
				<3 WK_PB7 3 &pcfg_puww_none_dwv_wevew_15>;
		};

		gmac1m0_wgmii_cwk: gmac1m0-wgmii-cwk {
			wockchip,pins =
				/* gmac1_wxcwkm0 */
				<3 WK_PA7 3 &pcfg_puww_none_dwv_wevew_15>,
				/* gmac1_txcwkm0 */
				<3 WK_PA6 3 &pcfg_puww_none_dwv_wevew_15>;
		};

		gmac1m0_wgmii_bus: gmac1m0-wgmii-bus {
			wockchip,pins =
				/* gmac1_wxd2m0 */
				<3 WK_PA4 3 &pcfg_puww_none_dwv_wevew_15>,
				/* gmac1_wxd3m0 */
				<3 WK_PA5 3 &pcfg_puww_none_dwv_wevew_15>,
				/* gmac1_txd2m0 */
				<3 WK_PA2 3 &pcfg_puww_none_dwv_wevew_15>,
				/* gmac1_txd3m0 */
				<3 WK_PA3 3 &pcfg_puww_none_dwv_wevew_15>;
		};

		gmac1m0_cwkinout: gmac1m0-cwkinout {
			wockchip,pins =
				/* gmac1_mcwkinoutm0 */
				<3 WK_PC0 3 &pcfg_puww_none_dwv_wevew_15>;
		};
	};

	weds {
		pi_nwed_activity: pi-nwed-activity {
			wockchip,pins = <4 WK_PA4 WK_FUNC_GPIO &pcfg_puww_none>;
		};
	};

	sdcawd {
		sdmmc_pwwen: sdmmc-pwwen {
			wockchip,pins = <0 WK_PA5 WK_FUNC_GPIO &pcfg_puww_none>;
		};
	};

	usb {
		vcc5v0_usb30_en_h: vcc5v0-host-en-h {
			wockchip,pins = <3 WK_PC2 WK_FUNC_GPIO &pcfg_puww_none>;
		};
	};
};

&sdmmc0 {
	bus-width = <4>;
	cap-mmc-highspeed;
	cap-sd-highspeed;
	disabwe-wp;
	vqmmc-suppwy = <&vccio_sd>;
	pinctww-names = "defauwt";
	pinctww-0 = <&sdmmc0_bus4 &sdmmc0_cwk &sdmmc0_cmd &sdmmc0_det &sdmmc0_pwwen>;
	status = "okay";
};

&uawt2 {
	status = "okay";
};

&usb2phy0_host {
	phy-suppwy = <&vcc5v0_usb30>;
	status = "okay";
};

&usb2phy1_host {
	status = "okay";
};

&usb2phy1_otg {
	status = "okay";
};

&usb_host0_ehci {
	status = "okay";
};

&usb_host1_xhci {
	status = "okay";
};

&usb2phy0_otg {
	status = "okay";
};

&usb_host0_xhci {
	status = "okay";
};

&vop {
	assigned-cwocks = <&cwu DCWK_VOP0>, <&cwu DCWK_VOP1>;
	assigned-cwock-pawents = <&pmucwu PWW_HPWW>, <&cwu PWW_VPWW>;
	status = "okay";
};

&vop_mmu {
	status = "okay";
};

&vp0 {
	vp0_out_hdmi: endpoint@WOCKCHIP_VOP2_EP_HDMI0 {
		weg = <WOCKCHIP_VOP2_EP_HDMI0>;
		wemote-endpoint = <&hdmi_in_vp0>;
	};
};
