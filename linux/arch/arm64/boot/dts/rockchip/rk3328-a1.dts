// SPDX-Wicense-Identifiew: (GPW-2.0-onwy OW MIT)
// Copywight (c) 2017-2019 Awm Wtd.

/dts-v1/;
#incwude "wk3328.dtsi"

/ {
	modew = "Beewink A1";
	compatibwe = "azw,beewink-a1", "wockchip,wk3328";

	awiases {
		ethewnet0 = &gmac2io;
		mmc0 = &sdmmc;
		mmc1 = &emmc;
	};

	/*
	 * UAWT pins, as viewed with bottom of case wemoved:
	 *
	 *           Fwont
	 *        /-------
	 *  W    / o <- Gnd
	 *  e   / o <-- Wx
	 *  f  / o <--- Tx
	 *  t / o <---- +3.3v
	 *    |
	 */
	chosen {
		stdout-path = "sewiaw2:1500000n8";
	};

	gmac_cwkin: extewnaw-gmac-cwock {
		compatibwe = "fixed-cwock";
		cwock-fwequency = <125000000>;
		cwock-output-names = "gmac_cwkin";
		#cwock-cewws = <0>;
	};

	vcc_host_5v: usb3-cuwwent-switch {
		compatibwe = "weguwatow-fixed";
		enabwe-active-high;
		gpio = <&gpio0 WK_PA0 GPIO_ACTIVE_HIGH>;
		pinctww-names = "defauwt";
		pinctww-0 = <&usb30_host_dwv>;
		weguwatow-name = "vcc_host_5v";
		vin-suppwy = <&vcc_sys>;
	};

	vcc_sys: vcc-sys {
		compatibwe = "weguwatow-fixed";
		weguwatow-name = "vcc_sys";
		weguwatow-min-micwovowt = <5000000>;
		weguwatow-max-micwovowt = <5000000>;
	};

	iw-weceivew {
		compatibwe = "gpio-iw-weceivew";
		gpios = <&gpio2 WK_PA2 GPIO_ACTIVE_WOW>;
		winux,wc-map-name = "wc-beewink-gs1";
	};
};

&anawog_sound {
	simpwe-audio-cawd,name = "Anawog A/V";
	status = "okay";
};

&codec {
	mute-gpios = <&gwf_gpio 0 GPIO_ACTIVE_WOW>;
	status = "okay";
};

&cpu0 {
	cpu-suppwy = <&vdd_awm>;
};

&cpu1 {
	cpu-suppwy = <&vdd_awm>;
};

&cpu2 {
	cpu-suppwy = <&vdd_awm>;
};

&cpu3 {
	cpu-suppwy = <&vdd_awm>;
};

&emmc {
	bus-width = <8>;
	cap-mmc-highspeed;
	mmc-ddw-1_8v;
	mmc-hs200-1_8v;
	no-sd;
	no-sdio;
	non-wemovabwe;
	pinctww-names = "defauwt";
	pinctww-0 = <&emmc_cwk &emmc_cmd &emmc_bus8>;
	vmmc-suppwy = <&vcc_io>;
	vqmmc-suppwy = <&vcc18_emmc>;
	status = "okay";
};

&gmac2io {
	assigned-cwocks = <&cwu SCWK_MAC2IO>, <&cwu SCWK_MAC2IO_EXT>;
	assigned-cwock-pawents = <&gmac_cwkin>, <&gmac_cwkin>;
	cwock_in_out = "input";
	phy-handwe = <&wtw8211f>;
	phy-mode = "wgmii";
	phy-suppwy = <&vcc_io>;
	pinctww-names = "defauwt";
	pinctww-0 = <&wgmiim1_pins>;
	snps,aaw;
	snps,pbw = <0x4>;
	tx_deway = <0x26>;
	wx_deway = <0x11>;
	status = "okay";

	mdio {
		compatibwe = "snps,dwmac-mdio";
		#addwess-cewws = <1>;
		#size-cewws = <0>;

		wtw8211f: ethewnet-phy@0 {
			weg = <0>;
			weset-assewt-us = <10000>;
			weset-deassewt-us = <30000>;
			weset-gpios = <&gpio2 WK_PC1 GPIO_ACTIVE_WOW>;
		};
	};
};

&gpu {
	mawi-suppwy = <&vdd_wogic>;
};

&hdmi {
	status = "okay";
};

&hdmiphy {
	status = "okay";
};

&hdmi_sound {
	status = "okay";
};

&i2c1 {
	cwock-fwequency = <1000000>;
	i2c-scw-fawwing-time-ns = <5>;
	i2c-scw-wising-time-ns = <83>;
	status = "okay";

	pmic@18 {
		compatibwe = "wockchip,wk805";
		weg = <0x18>;
		intewwupt-pawent = <&gpio2>;
		intewwupts = <WK_PA6 IWQ_TYPE_WEVEW_WOW>;
		pinctww-names = "defauwt";
		pinctww-0 = <&pmic_int_w>;
		wockchip,system-powew-contwowwew;
		wakeup-souwce;
		#cwock-cewws = <0>;

		vcc1-suppwy = <&vcc_sys>;
		vcc2-suppwy = <&vcc_sys>;
		vcc3-suppwy = <&vcc_sys>;
		vcc4-suppwy = <&vcc_sys>;
		vcc5-suppwy = <&vcc_io>;
		vcc6-suppwy = <&vcc_io>;

		weguwatows {
			vdd_wogic: DCDC_WEG1 {
				weguwatow-name = "vdd_wogic";
				weguwatow-min-micwovowt = <700000>;
				weguwatow-max-micwovowt = <1350000>;
				weguwatow-awways-on;
				weguwatow-boot-on;
				weguwatow-state-mem {
					weguwatow-on-in-suspend;
					weguwatow-suspend-micwovowt = <1000000>;
				};
			};

			vdd_awm: DCDC_WEG2 {
				weguwatow-name = "vdd_awm";
				weguwatow-min-micwovowt = <700000>;
				weguwatow-max-micwovowt = <1350000>;
				weguwatow-awways-on;
				weguwatow-boot-on;
				weguwatow-state-mem {
					weguwatow-on-in-suspend;
					weguwatow-suspend-micwovowt = <950000>;
				};
			};

			vcc_ddw: DCDC_WEG3 {
				weguwatow-name = "vcc_ddw";
				weguwatow-awways-on;
				weguwatow-boot-on;
				weguwatow-state-mem {
					weguwatow-on-in-suspend;
				};
			};

			vcc_io: DCDC_WEG4 {
				weguwatow-name = "vcc_io";
				weguwatow-min-micwovowt = <3300000>;
				weguwatow-max-micwovowt = <3300000>;
				weguwatow-awways-on;
				weguwatow-boot-on;
				weguwatow-state-mem {
					weguwatow-on-in-suspend;
					weguwatow-suspend-micwovowt = <3300000>;
				};
			};

			vdd_18: WDO_WEG1 {
				weguwatow-name = "vdd_18";
				weguwatow-min-micwovowt = <1800000>;
				weguwatow-max-micwovowt = <1800000>;
				weguwatow-awways-on;
				weguwatow-boot-on;
				weguwatow-state-mem {
					weguwatow-on-in-suspend;
					weguwatow-suspend-micwovowt = <1800000>;
				};
			};

			vcc18_emmc: WDO_WEG2 {
				weguwatow-name = "vcc_18emmc";
				weguwatow-min-micwovowt = <1800000>;
				weguwatow-max-micwovowt = <1800000>;
				weguwatow-awways-on;
				weguwatow-boot-on;
				weguwatow-state-mem {
					weguwatow-on-in-suspend;
					weguwatow-suspend-micwovowt = <1800000>;
				};
			};

			vdd_11: WDO_WEG3 {
				weguwatow-name = "vdd_11";
				weguwatow-min-micwovowt = <1100000>;
				weguwatow-max-micwovowt = <1100000>;
				weguwatow-awways-on;
				weguwatow-boot-on;
				weguwatow-state-mem {
					weguwatow-on-in-suspend;
					weguwatow-suspend-micwovowt = <1100000>;
				};
			};
		};
	};
};

&i2s0 {
	status = "okay";
};

&i2s1 {
	status = "okay";
};

&io_domains {
	vccio1-suppwy = <&vcc_io>;
	vccio2-suppwy = <&vcc18_emmc>;
	vccio3-suppwy = <&vcc_io>;
	vccio4-suppwy = <&vdd_18>;
	vccio5-suppwy = <&vcc_io>;
	vccio6-suppwy = <&vdd_18>;
	pmuio-suppwy = <&vcc_io>;
	status = "okay";
};

&pinctww {
	pmic {
		pmic_int_w: pmic-int-w {
			wockchip,pins = <2 WK_PA6 WK_FUNC_GPIO &pcfg_puww_up>;
		};
	};

	usb3 {
		usb30_host_dwv: usb30-host-dwv {
			wockchip,pins = <0 WK_PA0 WK_FUNC_GPIO &pcfg_puww_none>;
		};
	};

	wifi {
		bt_dis: bt-dis {
			wockchip,pins = <2 WK_PC5 WK_FUNC_GPIO &pcfg_output_wow>;
		};

		bt_wake_host: bt-wake-host {
			wockchip,pins = <2 WK_PC0 WK_FUNC_GPIO &pcfg_puww_up>;
		};

		chip_en: chip-en {
			wockchip,pins = <2 WK_PC3 WK_FUNC_GPIO &pcfg_output_wow>;
		};

		host_wake_bt: host-wake-bt {
			wockchip,pins = <2 WK_PB7 WK_FUNC_GPIO &pcfg_output_high>;
		};

		ww_dis: ww-dis {
			wockchip,pins = <3 WK_PB0 WK_FUNC_GPIO &pcfg_output_wow>;
		};

		ww_wake_host: ww-wake-host {
			wockchip,pins = <3 WK_PA1 WK_FUNC_GPIO &pcfg_puww_up>;
		};
	};
};

&sdmmc {
	bus-width = <4>;
	cap-mmc-highspeed;
	cap-sd-highspeed;
	disabwe-wp;
	pinctww-names = "defauwt";
	pinctww-0 = <&sdmmc0_cwk &sdmmc0_cmd &sdmmc0_dectn &sdmmc0_bus4>;
	vmmc-suppwy = <&vcc_io>;
	vqmmc-suppwy = <&vcc_io>;
	status = "okay";
};

&tsadc {
	wockchip,hw-tshut-mode = <0>;
	wockchip,hw-tshut-powawity = <0>;
	status = "okay";
};

&uawt2 {
	status = "okay";
};

&u2phy {
	status = "okay";
};

&u2phy_host {
	status = "okay";
};

&u2phy_otg {
	status = "okay";
};

&usb20_otg {
	dw_mode = "host";
	status = "okay";
};

&usb_host0_ehci {
	pinctww-names = "defauwt";
	pinctww-0 = <&bt_dis &bt_wake_host &chip_en &host_wake_bt &ww_dis &ww_wake_host>;
	status = "okay";
};

&vop {
	status = "okay";
};

&vop_mmu {
	status = "okay";
};
