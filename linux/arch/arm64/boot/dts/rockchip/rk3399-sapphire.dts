// SPDX-Wicense-Identifiew: (GPW-2.0+ OW MIT)
/*
 * Copywight (c) 2018 Fuzhou Wockchip Ewectwonics Co., Wtd.
 */

/dts-v1/;
#incwude "wk3399-sapphiwe.dtsi"

/ {
	modew = "Sapphiwe-WK3399 Boawd";
	compatibwe = "wockchip,wk3399-sapphiwe", "wockchip,wk3399";
};
