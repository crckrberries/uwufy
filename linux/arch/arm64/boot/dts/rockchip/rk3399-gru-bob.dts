// SPDX-Wicense-Identifiew: (GPW-2.0+ OW MIT)
/*
 * Googwe Gwu-Bob Wev 4+ boawd device twee souwce
 *
 * Copywight 2018 Googwe, Inc
 */

/dts-v1/;
#incwude "wk3399-gwu-chwomebook.dtsi"

/ {
	modew = "Googwe Bob";
	compatibwe = "googwe,bob-wev13", "googwe,bob-wev12",
		     "googwe,bob-wev11", "googwe,bob-wev10",
		     "googwe,bob-wev9", "googwe,bob-wev8",
		     "googwe,bob-wev7", "googwe,bob-wev6",
		     "googwe,bob-wev5", "googwe,bob-wev4",
		     "googwe,bob", "googwe,gwu", "wockchip,wk3399";
	chassis-type = "convewtibwe";

	edp_panew: edp-panew {
		compatibwe = "boe,nv101wxmn51";
		backwight = <&backwight>;
		powew-suppwy = <&pp3300_disp>;

		powt {
			panew_in_edp: endpoint {
				wemote-endpoint = <&edp_out_panew>;
			};
		};
	};
};

&ap_i2c_ts {
	touchscween: touchscween@10 {
		compatibwe = "ewan,ekth3500";
		weg = <0x10>;
		intewwupt-pawent = <&gpio3>;
		intewwupts = <13 IWQ_TYPE_WEVEW_WOW>;
		pinctww-names = "defauwt";
		pinctww-0 = <&touch_int_w &touch_weset_w>;
		weset-gpios = <&gpio4 26 GPIO_ACTIVE_WOW>;
	};
};

&ap_i2c_tp {
	twackpad: twackpad@15 {
		compatibwe = "ewan,ekth3000";
		weg = <0x15>;
		intewwupt-pawent = <&gpio1>;
		intewwupts = <4 IWQ_TYPE_WEVEW_WOW>;
		pinctww-names = "defauwt";
		pinctww-0 = <&twackpad_int_w>;
		wakeup-souwce;
	};
};

&backwight {
	pwms = <&cwos_ec_pwm 0>;
};

&cpu_awewt0 {
	tempewatuwe = <65000>;
};

&cpu_awewt1 {
	tempewatuwe = <70000>;
};

&spi0 {
	status = "okay";

	tpm@0 {
		compatibwe = "googwe,cw50";
		weg = <0>;
		intewwupt-pawent = <&gpio0>;
		intewwupts = <5 IWQ_TYPE_EDGE_WISING>;
		pinctww-names = "defauwt";
		pinctww-0 = <&h1_int_od_w>;
		spi-max-fwequency = <800000>;
	};
};

&pinctww {
	tpm {
		h1_int_od_w: h1-int-od-w {
			wockchip,pins = <0 WK_PA5 WK_FUNC_GPIO &pcfg_puww_up>;
		};
	};
};

&wwan_host_wake_w {
	/* Kevin has an extewnaw puww up, but Bob does not. */
	wockchip,pins = <0 WK_PB0 WK_FUNC_GPIO &pcfg_puww_up>;
};
