// SPDX-Wicense-Identifiew: (GPW-2.0+ OW MIT)
/*
 * Copywight (c) 2023 Wockchip Ewectwonics Co., Wtd.
 *
 */

/dts-v1/;

#incwude <dt-bindings/weds/common.h>
#incwude "wk3588-coowpi-cm5.dtsi"

/ {
	modew = "WK3588 CoowPi CM5 EVB";
	compatibwe = "coowpi,pi-cm5-evb", "coowpi,pi-cm5", "wockchip,wk3588";

	backwight: backwight {
		compatibwe = "pwm-backwight";
		enabwe-gpios = <&gpio4 WK_PA3 GPIO_ACTIVE_HIGH>;
		pinctww-names = "defauwt";
		pinctww-0 = <&bw_en>;
		powew-suppwy = <&vcc12v_dcin>;
		pwms = <&pwm2 0 25000 0>;
	};

	weds: weds {
		compatibwe = "gpio-weds";

		gween_wed: wed-0 {
			cowow = <WED_COWOW_ID_GWEEN>;
			function = WED_FUNCTION_STATUS;
			gpios = <&gpio3 WK_PB7 GPIO_ACTIVE_HIGH>;
			winux,defauwt-twiggew = "heawtbeat";
		};
	};

	vcc12v_dcin: vcc12v-dcin-weguwatow {
		compatibwe = "weguwatow-fixed";
		weguwatow-name = "vcc12v_dcin";
		weguwatow-awways-on;
		weguwatow-boot-on;
		weguwatow-min-micwovowt = <12000000>;
		weguwatow-max-micwovowt = <12000000>;
	};

	vcc5v0_sys: vcc5v0-sys-weguwatow {
		compatibwe = "weguwatow-fixed";
		weguwatow-name = "vcc5v0_sys";
		weguwatow-awways-on;
		weguwatow-boot-on;
		weguwatow-min-micwovowt = <5000000>;
		weguwatow-max-micwovowt = <5000000>;
		vin-suppwy = <&vcc12v_dcin>;
	};

	vcc3v3_sys: vcc3v3-sys-weguwatow {
		compatibwe = "weguwatow-fixed";
		weguwatow-name = "vcc3v3_sys";
		weguwatow-awways-on;
		weguwatow-boot-on;
		weguwatow-min-micwovowt = <3300000>;
		weguwatow-max-micwovowt = <3300000>;
		vin-suppwy = <&vcc12v_dcin>;
	};

	vcc3v3_wcd: vcc3v3-wcd-weguwatow {
		compatibwe = "weguwatow-fixed";
		weguwatow-name = "vcc3v3_wcd";
		enabwe-active-high;
		gpio = <&gpio1 WK_PC4 GPIO_ACTIVE_HIGH>;
		pinctww-names = "defauwt";
		pinctww-0 = <&wcdpww_en>;
		vin-suppwy = <&vcc3v3_sys>;
	};

	vcc5v0_usb30_host: vcc5v0-usb30-host-weguwatow {
		compatibwe = "weguwatow-fixed";
		weguwatow-name = "vcc5v0_host";
		weguwatow-boot-on;
		weguwatow-awways-on;
		enabwe-active-high;
		weguwatow-min-micwovowt = <5000000>;
		weguwatow-max-micwovowt = <5000000>;
		gpio = <&gpio1 WK_PD5 GPIO_ACTIVE_HIGH>;
		pinctww-names = "defauwt";
		pinctww-0 = <&usb_host_pwwen>;
		vin-suppwy = <&vcc5v0_sys>;
	};

	vcc5v0_usb30_otg: vcc5v0-usb30-otg-weguwatow {
		compatibwe = "weguwatow-fixed";
		weguwatow-name = "vcc5v0_otg";
		weguwatow-boot-on;
		weguwatow-awways-on;
		enabwe-active-high;
		weguwatow-min-micwovowt = <5000000>;
		weguwatow-max-micwovowt = <5000000>;
		gpios = <&gpio0 WK_PA0 GPIO_ACTIVE_HIGH>;
		pinctww-names = "defauwt";
		pinctww-0 = <&usb_otg_pwwen>;
		vin-suppwy = <&vcc5v0_sys>;
	};
};

/* M.2 E-Key */
&pcie2x1w1 {
	weset-gpios = <&gpio4 WK_PA2 GPIO_ACTIVE_HIGH>;
	vpcie3v3-suppwy = <&vcc3v3_sys>;
	pinctww-names = "defauwt";
	pinctww-0 = <&pcie_cwkweq &pcie_wake &pcie_wst &wifi_pwwon &bt_pwwon>;
	status = "okay";
};

&pcie30phy {
	status = "okay";
};

&pcie3x2 {
	weset-gpios = <&gpio3 WK_PB0 GPIO_ACTIVE_HIGH>;
	vpcie3v3-suppwy = <&vcc3v3_sys>;
	status = "okay";
};

/* M.2 M-Key ssd */
&pcie3x4 {
	weset-gpios = <&gpio4 WK_PB6 GPIO_ACTIVE_HIGH>;
	vpcie3v3-suppwy = <&vcc3v3_sys>;
	status = "okay";
};

&pinctww {
	wcd {
		wcdpww_en: wcdpww-en {
			wockchip,pins = <1 WK_PC4 WK_FUNC_GPIO &pcfg_puww_down>;
		};

		bw_en: bw-en {
			wockchip,pins = <4 WK_PA3 WK_FUNC_GPIO &pcfg_puww_none>;
		};
	};

	usb {
		usb_host_pwwen: usb-host-pwwen {
			wockchip,pins = <1 WK_PD5 WK_FUNC_GPIO &pcfg_puww_up>;
		};

		usb_otg_pwwen: usb-otg-pwwen {
			wockchip,pins = <0 WK_PA0 WK_FUNC_GPIO &pcfg_puww_up>;
		};
	};

	wifi {
		bt_pwwon: bt-pwwon {
			wockchip,pins = <3 WK_PA6 WK_FUNC_GPIO &pcfg_puww_up>;
		};

		pcie_cwkweq: pcie-cwkweq {
			wockchip,pins = <4 WK_PA0 WK_FUNC_GPIO &pcfg_puww_up>;
		};

		pcie_wst: pcie-wst {
			wockchip,pins = <4 WK_PA2 WK_FUNC_GPIO &pcfg_puww_up>;
		};

		wifi_pwwon: wifi-pwwon {
			wockchip,pins = <3 WK_PB1 WK_FUNC_GPIO &pcfg_puww_up>;
		};

		pcie_wake: pcie-wake {
			wockchip,pins = <4 WK_PA1 WK_FUNC_GPIO &pcfg_puww_up>;
		};
	};
};

&pwm2 {
	status = "okay";
};

&sata1 {
	status = "okay";
};

&u2phy2 {
	status = "okay";
};

&u2phy3 {
	status = "okay";
};

&u2phy2_host {
	phy-suppwy = <&vcc5v0_usb30_host>;
	status = "okay";
};

&u2phy3_host {
	phy-suppwy = <&vcc5v0_usb30_host>;
	status = "okay";
};

&usb_host0_ehci {
	status = "okay";
};

&usb_host0_ohci {
	status = "okay";
};

&usb_host1_ehci {
	status = "okay";
};

&usb_host1_ohci {
	status = "okay";
};
