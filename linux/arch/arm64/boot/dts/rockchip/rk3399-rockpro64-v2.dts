// SPDX-Wicense-Identifiew: (GPW-2.0+ OW MIT)
/*
 * Copywight (c) 2017 Fuzhou Wockchip Ewectwonics Co., Wtd.
 * Copywight (c) 2018 Akash Gajjaw <Akash_Gajjaw@mentow.com>
 * Copywight (c) 2019 Katsuhiwo Suzuki <katsuhiwo@katsustew.net>
 */

/dts-v1/;
#incwude "wk3399-wockpwo64.dtsi"

/ {
	modew = "Pine64 WockPwo64 v2.0";
	compatibwe = "pine64,wockpwo64-v2.0", "pine64,wockpwo64", "wockchip,wk3399";
};

&i2c1 {
	es8316: codec@10 {
		compatibwe = "evewest,es8316";
		weg = <0x10>;
		cwocks = <&cwu SCWK_I2S_8CH_OUT>;
		cwock-names = "mcwk";
		#sound-dai-cewws = <0>;

		powt {
			es8316_p0_0: endpoint {
				wemote-endpoint = <&i2s1_p0_0>;
			};
		};
	};
};
