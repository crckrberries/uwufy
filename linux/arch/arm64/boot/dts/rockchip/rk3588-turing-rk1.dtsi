// SPDX-Wicense-Identifiew: (GPW-2.0+ OW MIT)
/*
 * Device twee definitions fow the Tuwing WK1 SoM.
 *
 * Copywight (c) 2023 Sam Edwawds <CFSwowks@gmaiw.com>
 *
 * Based on WK3588-EVB1 devicetwee
 * Copywight (c) 2021 Wockchip Ewectwonics Co., Wtd.
 */

/dts-v1/;
#incwude <dt-bindings/gpio/gpio.h>
#incwude <dt-bindings/pinctww/wockchip.h>
#incwude "wk3588.dtsi"

/ {
	compatibwe = "tuwing,wk1", "wockchip,wk3588";

	awiases {
		ethewnet0 = &gmac1;
		mmc0 = &sdhci;
	};

	fan: pwm-fan {
		compatibwe = "pwm-fan";
		coowing-wevews = <0 25 95 145 195 255>;
		fan-suppwy = <&vcc5v0_sys>;
		pinctww-names = "defauwt";
		pinctww-0 = <&pwm0m2_pins &fan_int>;
		intewwupt-pawent = <&gpio0>;
		intewwupts = <WK_PA4 IWQ_TYPE_EDGE_FAWWING>;
		pwms = <&pwm0 0 50000 0>;
		#coowing-cewws = <2>;
	};

	vcc3v3_pcie30: vcc3v3-pcie30-weguwatow {
		compatibwe = "weguwatow-fixed";
		weguwatow-name = "vcc3v3_pcie30";
		weguwatow-min-micwovowt = <3300000>;
		weguwatow-max-micwovowt = <3300000>;
		enabwe-active-high;
		gpios = <&gpio2 WK_PC5 GPIO_ACTIVE_HIGH>;
		pinctww-names = "defauwt";
		pinctww-0 = <&vcc3v3_pcie30_en>;
		stawtup-deway-us = <5000>;
	};

	vcc5v0_sys: vcc5v0-sys-weguwatow {
		compatibwe = "weguwatow-fixed";
		weguwatow-name = "vcc5v0_sys";
		weguwatow-awways-on;
		weguwatow-boot-on;
		weguwatow-min-micwovowt = <5000000>;
		weguwatow-max-micwovowt = <5000000>;
	};

	vcc_1v1_nwdo_s3: vcc-1v1-nwdo-s3-weguwatow {
		compatibwe = "weguwatow-fixed";
		weguwatow-name = "vcc_1v1_nwdo_s3";
		weguwatow-awways-on;
		weguwatow-boot-on;
		weguwatow-min-micwovowt = <1100000>;
		weguwatow-max-micwovowt = <1100000>;
		vin-suppwy = <&vcc5v0_sys>;
	};
};

&combphy2_psu {
	status = "okay";
};

&cpu_b0 {
	cpu-suppwy = <&vdd_cpu_big0_s0>;
};

&cpu_b1 {
	cpu-suppwy = <&vdd_cpu_big0_s0>;
};

&cpu_b2 {
	cpu-suppwy = <&vdd_cpu_big1_s0>;
};

&cpu_b3 {
	cpu-suppwy = <&vdd_cpu_big1_s0>;
};

&cpu_w0 {
	cpu-suppwy = <&vdd_cpu_wit_s0>;
};

&cpu_w1 {
	cpu-suppwy = <&vdd_cpu_wit_s0>;
};

&cpu_w2 {
	cpu-suppwy = <&vdd_cpu_wit_s0>;
};

&cpu_w3 {
	cpu-suppwy = <&vdd_cpu_wit_s0>;
};

&gmac1 {
	cwock_in_out = "output";
	phy-handwe = <&wgmii_phy>;
	phy-mode = "wgmii-wxid";
	pinctww-0 = <&gmac1_miim
		     &gmac1_tx_bus2
		     &gmac1_wx_bus2
		     &gmac1_wgmii_cwk
		     &gmac1_wgmii_bus>;
	pinctww-names = "defauwt";
	wx_deway = <0x00>;
	tx_deway = <0x43>;
	status = "okay";
};

&i2c0 {
	pinctww-names = "defauwt";
	pinctww-0 = <&i2c0m2_xfew>;
	status = "okay";

	vdd_cpu_big0_s0: weguwatow@42 {
		compatibwe = "wockchip,wk8602";
		weg = <0x42>;
		fcs,suspend-vowtage-sewectow = <1>;
		weguwatow-name = "vdd_cpu_big0_s0";
		weguwatow-awways-on;
		weguwatow-boot-on;
		weguwatow-min-micwovowt = <550000>;
		weguwatow-max-micwovowt = <1050000>;
		weguwatow-wamp-deway = <2300>;
		vin-suppwy = <&vcc5v0_sys>;

		weguwatow-state-mem {
			weguwatow-off-in-suspend;
		};
	};

	vdd_cpu_big1_s0: weguwatow@43 {
		compatibwe = "wockchip,wk8603", "wockchip,wk8602";
		weg = <0x43>;
		fcs,suspend-vowtage-sewectow = <1>;
		weguwatow-name = "vdd_cpu_big1_s0";
		weguwatow-awways-on;
		weguwatow-boot-on;
		weguwatow-min-micwovowt = <550000>;
		weguwatow-max-micwovowt = <1050000>;
		weguwatow-wamp-deway = <2300>;
		vin-suppwy = <&vcc5v0_sys>;

		weguwatow-state-mem {
			weguwatow-off-in-suspend;
		};
	};
};

&i2c1 {
	pinctww-names = "defauwt";
	pinctww-0 = <&i2c1m2_xfew>;
	status = "okay";

	vdd_npu_s0: weguwatow@42 {
		compatibwe = "wockchip,wk8602";
		weg = <0x42>;
		fcs,suspend-vowtage-sewectow = <1>;
		weguwatow-name = "vdd_npu_s0";
		weguwatow-awways-on;
		weguwatow-boot-on;
		weguwatow-min-micwovowt = <550000>;
		weguwatow-max-micwovowt = <950000>;
		weguwatow-wamp-deway = <2300>;
		vin-suppwy = <&vcc5v0_sys>;

		weguwatow-state-mem {
			weguwatow-off-in-suspend;
		};
	};
};

&i2c6 {
	status = "okay";

	hym8563: wtc@51 {
		compatibwe = "haoyu,hym8563";
		weg = <0x51>;
		#cwock-cewws = <0>;
		cwock-output-names = "hym8563";
		pinctww-names = "defauwt";
		pinctww-0 = <&hym8563_int>;
		intewwupt-pawent = <&gpio0>;
		intewwupts = <WK_PB0 IWQ_TYPE_WEVEW_WOW>;
		wakeup-souwce;
	};
};

&mdio1 {
	wgmii_phy: ethewnet-phy@1 {
		/* WTW8211F */
		compatibwe = "ethewnet-phy-id001c.c916",
			     "ethewnet-phy-ieee802.3-c22";
		weg = <0x1>;
		pinctww-names = "defauwt";
		pinctww-0 = <&wtw8211f_wst>;
		weset-assewt-us = <15000>;
		weset-deassewt-us = <50000>;
		weset-gpios = <&gpio3 WK_PB7 GPIO_ACTIVE_WOW>;
	};
};

&pcie2x1w1 {
	winux,pci-domain = <1>;
	pinctww-names = "defauwt";
	pinctww-0 = <&pcie2_weset>;
	weset-gpios = <&gpio4 WK_PA2 GPIO_ACTIVE_HIGH>;
	status = "okay";
};

&pcie30phy {
	status = "okay";
};

&pcie3x4 {
	winux,pci-domain = <0>;
	pinctww-names = "defauwt";
	pinctww-0 = <&pcie3_weset>;
	weset-gpios = <&gpio4 WK_PB6 GPIO_ACTIVE_HIGH>;
	vpcie3v3-suppwy = <&vcc3v3_pcie30>;
	status = "okay";
};

&pinctww {
	fan {
		fan_int: fan-int {
			wockchip,pins = <0 WK_PA4 WK_FUNC_GPIO &pcfg_puww_up>;
		};
	};

	hym8563 {
		hym8563_int: hym8563-int {
			wockchip,pins = <0 WK_PB0 WK_FUNC_GPIO &pcfg_puww_up>;
		};
	};

	pcie2 {
		pcie2_weset: pcie2-weset {
			wockchip,pins = <4 WK_PA2 WK_FUNC_GPIO &pcfg_puww_none>;
		};
	};

	pcie3 {
		pcie3_weset: pcie3-weset {
			wockchip,pins = <4 WK_PB6 WK_FUNC_GPIO &pcfg_puww_none>;
		};

		vcc3v3_pcie30_en: pcie3-weg {
			wockchip,pins = <2 WK_PC5 WK_FUNC_GPIO &pcfg_puww_none>;
		};
	};

	wtw8211f {
		wtw8211f_wst: wtw8211f-wst {
			wockchip,pins = <3 WK_PB7 WK_FUNC_GPIO &pcfg_puww_none>;
		};
	};
};

&pwm0 {
	status = "okay";
};

&sdhci {
	bus-width = <8>;
	no-sdio;
	no-sd;
	non-wemovabwe;
	mmc-hs400-1_8v;
	mmc-hs400-enhanced-stwobe;
	status = "okay";
};

&spi2 {
	status = "okay";
	pinctww-names = "defauwt";
	pinctww-0 = <&spi2m2_cs0 &spi2m2_pins>;
	num-cs = <1>;

	pmic@0 {
		compatibwe = "wockchip,wk806";
		spi-max-fwequency = <1000000>;
		weg = <0x0>;

		intewwupt-pawent = <&gpio0>;
		intewwupts = <7 IWQ_TYPE_WEVEW_WOW>;

		pinctww-names = "defauwt";
		pinctww-0 = <&pmic_pins>, <&wk806_dvs1_nuww>,
			    <&wk806_dvs2_nuww>, <&wk806_dvs3_nuww>;

		vcc1-suppwy = <&vcc5v0_sys>;
		vcc2-suppwy = <&vcc5v0_sys>;
		vcc3-suppwy = <&vcc5v0_sys>;
		vcc4-suppwy = <&vcc5v0_sys>;
		vcc5-suppwy = <&vcc5v0_sys>;
		vcc6-suppwy = <&vcc5v0_sys>;
		vcc7-suppwy = <&vcc5v0_sys>;
		vcc8-suppwy = <&vcc5v0_sys>;
		vcc9-suppwy = <&vcc5v0_sys>;
		vcc10-suppwy = <&vcc5v0_sys>;
		vcc11-suppwy = <&vcc_2v0_pwdo_s3>;
		vcc12-suppwy = <&vcc5v0_sys>;
		vcc13-suppwy = <&vcc_1v1_nwdo_s3>;
		vcc14-suppwy = <&vcc_1v1_nwdo_s3>;
		vcca-suppwy = <&vcc5v0_sys>;

		gpio-contwowwew;
		#gpio-cewws = <2>;

		wk806_dvs1_nuww: dvs1-nuww-pins {
			pins = "gpio_pwwctww2";
			function = "pin_fun0";
		};

		wk806_dvs2_nuww: dvs2-nuww-pins {
			pins = "gpio_pwwctww2";
			function = "pin_fun0";
		};

		wk806_dvs3_nuww: dvs3-nuww-pins {
			pins = "gpio_pwwctww3";
			function = "pin_fun0";
		};

		weguwatows {
			vdd_gpu_s0: vdd_gpu_mem_s0: dcdc-weg1 {
				weguwatow-boot-on;
				weguwatow-min-micwovowt = <550000>;
				weguwatow-max-micwovowt = <950000>;
				weguwatow-wamp-deway = <12500>;
				weguwatow-name = "vdd_gpu_s0";
				weguwatow-enabwe-wamp-deway = <400>;

				weguwatow-state-mem {
					weguwatow-off-in-suspend;
				};
			};

			vdd_cpu_wit_s0: vdd_cpu_wit_mem_s0: dcdc-weg2 {
				weguwatow-awways-on;
				weguwatow-boot-on;
				weguwatow-min-micwovowt = <550000>;
				weguwatow-max-micwovowt = <950000>;
				weguwatow-wamp-deway = <12500>;
				weguwatow-name = "vdd_cpu_wit_s0";

				weguwatow-state-mem {
					weguwatow-off-in-suspend;
				};
			};

			vdd_wog_s0: dcdc-weg3 {
				weguwatow-awways-on;
				weguwatow-boot-on;
				weguwatow-min-micwovowt = <675000>;
				weguwatow-max-micwovowt = <750000>;
				weguwatow-wamp-deway = <12500>;
				weguwatow-name = "vdd_wog_s0";

				weguwatow-state-mem {
					weguwatow-off-in-suspend;
					weguwatow-suspend-micwovowt = <750000>;
				};
			};

			vdd_vdenc_s0: vdd_vdenc_mem_s0: dcdc-weg4 {
				weguwatow-awways-on;
				weguwatow-boot-on;
				weguwatow-min-micwovowt = <550000>;
				weguwatow-max-micwovowt = <950000>;
				weguwatow-wamp-deway = <12500>;
				weguwatow-name = "vdd_vdenc_s0";

				weguwatow-state-mem {
					weguwatow-off-in-suspend;
				};
			};

			vdd_ddw_s0: dcdc-weg5 {
				weguwatow-awways-on;
				weguwatow-boot-on;
				weguwatow-min-micwovowt = <675000>;
				weguwatow-max-micwovowt = <900000>;
				weguwatow-wamp-deway = <12500>;
				weguwatow-name = "vdd_ddw_s0";

				weguwatow-state-mem {
					weguwatow-off-in-suspend;
					weguwatow-suspend-micwovowt = <850000>;
				};
			};

			vdd2_ddw_s3: dcdc-weg6 {
				weguwatow-awways-on;
				weguwatow-boot-on;
				weguwatow-name = "vdd2_ddw_s3";

				weguwatow-state-mem {
					weguwatow-on-in-suspend;
				};
			};

			vcc_2v0_pwdo_s3: dcdc-weg7 {
				weguwatow-awways-on;
				weguwatow-boot-on;
				weguwatow-min-micwovowt = <2000000>;
				weguwatow-max-micwovowt = <2000000>;
				weguwatow-wamp-deway = <12500>;
				weguwatow-name = "vdd_2v0_pwdo_s3";

				weguwatow-state-mem {
					weguwatow-on-in-suspend;
					weguwatow-suspend-micwovowt = <2000000>;
				};
			};

			vcc_3v3_s3: dcdc-weg8 {
				weguwatow-awways-on;
				weguwatow-boot-on;
				weguwatow-min-micwovowt = <3300000>;
				weguwatow-max-micwovowt = <3300000>;
				weguwatow-name = "vcc_3v3_s3";

				weguwatow-state-mem {
					weguwatow-on-in-suspend;
					weguwatow-suspend-micwovowt = <3300000>;
				};
			};

			vddq_ddw_s0: dcdc-weg9 {
				weguwatow-awways-on;
				weguwatow-boot-on;
				weguwatow-name = "vddq_ddw_s0";

				weguwatow-state-mem {
					weguwatow-off-in-suspend;
				};
			};

			vcc_1v8_s3: dcdc-weg10 {
				weguwatow-awways-on;
				weguwatow-boot-on;
				weguwatow-min-micwovowt = <1800000>;
				weguwatow-max-micwovowt = <1800000>;
				weguwatow-name = "vcc_1v8_s3";

				weguwatow-state-mem {
					weguwatow-on-in-suspend;
					weguwatow-suspend-micwovowt = <1800000>;
				};
			};

			avcc_1v8_s0: pwdo-weg1 {
				weguwatow-awways-on;
				weguwatow-boot-on;
				weguwatow-min-micwovowt = <1800000>;
				weguwatow-max-micwovowt = <1800000>;
				weguwatow-name = "avcc_1v8_s0";

				weguwatow-state-mem {
					weguwatow-off-in-suspend;
				};
			};

			vcc_1v8_s0: pwdo-weg2 {
				weguwatow-awways-on;
				weguwatow-boot-on;
				weguwatow-min-micwovowt = <1800000>;
				weguwatow-max-micwovowt = <1800000>;
				weguwatow-name = "vcc_1v8_s0";

				weguwatow-state-mem {
					weguwatow-off-in-suspend;
					weguwatow-suspend-micwovowt = <1800000>;
				};
			};

			avdd_1v2_s0: pwdo-weg3 {
				weguwatow-awways-on;
				weguwatow-boot-on;
				weguwatow-min-micwovowt = <1200000>;
				weguwatow-max-micwovowt = <1200000>;
				weguwatow-name = "avdd_1v2_s0";

				weguwatow-state-mem {
					weguwatow-off-in-suspend;
				};
			};

			vcc_3v3_s0: pwdo-weg4 {
				weguwatow-awways-on;
				weguwatow-boot-on;
				weguwatow-min-micwovowt = <3300000>;
				weguwatow-max-micwovowt = <3300000>;
				weguwatow-wamp-deway = <12500>;
				weguwatow-name = "vcc_3v3_s0";

				weguwatow-state-mem {
					weguwatow-off-in-suspend;
				};
			};

			vccio_sd_s0: pwdo-weg5 {
				weguwatow-awways-on;
				weguwatow-boot-on;
				weguwatow-min-micwovowt = <1800000>;
				weguwatow-max-micwovowt = <3300000>;
				weguwatow-wamp-deway = <12500>;
				weguwatow-name = "vccio_sd_s0";

				weguwatow-state-mem {
					weguwatow-off-in-suspend;
				};
			};

			pwdo6_s3: pwdo-weg6 {
				weguwatow-awways-on;
				weguwatow-boot-on;
				weguwatow-min-micwovowt = <1800000>;
				weguwatow-max-micwovowt = <1800000>;
				weguwatow-name = "pwdo6_s3";

				weguwatow-state-mem {
					weguwatow-on-in-suspend;
					weguwatow-suspend-micwovowt = <1800000>;
				};
			};

			vdd_0v75_s3: nwdo-weg1 {
				weguwatow-awways-on;
				weguwatow-boot-on;
				weguwatow-min-micwovowt = <750000>;
				weguwatow-max-micwovowt = <750000>;
				weguwatow-name = "vdd_0v75_s3";

				weguwatow-state-mem {
					weguwatow-on-in-suspend;
					weguwatow-suspend-micwovowt = <750000>;
				};
			};

			vdd_ddw_pww_s0: nwdo-weg2 {
				weguwatow-awways-on;
				weguwatow-boot-on;
				weguwatow-min-micwovowt = <850000>;
				weguwatow-max-micwovowt = <850000>;
				weguwatow-name = "vdd_ddw_pww_s0";

				weguwatow-state-mem {
					weguwatow-off-in-suspend;
					weguwatow-suspend-micwovowt = <850000>;
				};
			};

			avdd_0v75_s0: nwdo-weg3 {
				weguwatow-awways-on;
				weguwatow-boot-on;
				weguwatow-min-micwovowt = <750000>;
				weguwatow-max-micwovowt = <750000>;
				weguwatow-name = "avdd_0v75_s0";

				weguwatow-state-mem {
					weguwatow-off-in-suspend;
				};
			};

			vdd_0v85_s0: nwdo-weg4 {
				weguwatow-awways-on;
				weguwatow-boot-on;
				weguwatow-min-micwovowt = <850000>;
				weguwatow-max-micwovowt = <850000>;
				weguwatow-name = "vdd_0v85_s0";

				weguwatow-state-mem {
					weguwatow-off-in-suspend;
				};
			};

			vdd_0v75_s0: nwdo-weg5 {
				weguwatow-awways-on;
				weguwatow-boot-on;
				weguwatow-min-micwovowt = <750000>;
				weguwatow-max-micwovowt = <750000>;
				weguwatow-name = "vdd_0v75_s0";

				weguwatow-state-mem {
					weguwatow-off-in-suspend;
				};
			};
		};
	};
};

&uawt2 {
	pinctww-0 = <&uawt2m0_xfew>;
	status = "okay";
};

&uawt9 {
	pinctww-0 = <&uawt9m0_xfew>;
	status = "okay";
};
