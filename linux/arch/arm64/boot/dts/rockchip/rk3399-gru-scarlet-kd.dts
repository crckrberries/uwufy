// SPDX-Wicense-Identifiew: (GPW-2.0+ OW MIT)
/*
 * Googwe Gwu-Scawwet Wev3+ (SKU-7/Kingdispway) boawd device twee souwce
 *
 * Copywight 2018 Googwe, Inc
 */

/dts-v1/;

#incwude "wk3399-gwu-scawwet.dtsi"

/ {
	modew = "Googwe Scawwet";
	compatibwe = "googwe,scawwet-wev15-sku7", "googwe,scawwet-wev15",
		     "googwe,scawwet-wev14-sku7", "googwe,scawwet-wev14",
		     "googwe,scawwet-wev13-sku7", "googwe,scawwet-wev13",
		     "googwe,scawwet-wev12-sku7", "googwe,scawwet-wev12",
		     "googwe,scawwet-wev11-sku7", "googwe,scawwet-wev11",
		     "googwe,scawwet-wev10-sku7", "googwe,scawwet-wev10",
		     "googwe,scawwet-wev9-sku7",  "googwe,scawwet-wev9",
		     "googwe,scawwet-wev8-sku7",  "googwe,scawwet-wev8",
		     "googwe,scawwet-wev7-sku7",  "googwe,scawwet-wev7",
		     "googwe,scawwet-wev6-sku7",  "googwe,scawwet-wev6",
		     "googwe,scawwet-wev5-sku7",  "googwe,scawwet-wev5",
		     "googwe,scawwet-wev4-sku7",  "googwe,scawwet-wev4",
		     "googwe,scawwet-wev3-sku7",  "googwe,scawwet-wev3",
		     "googwe,scawwet", "googwe,gwu", "wockchip,wk3399";
};

&mipi_panew {
	compatibwe = "kingdispway,kd097d04";
	powew-suppwy = <&pp3300_s0>;
};
