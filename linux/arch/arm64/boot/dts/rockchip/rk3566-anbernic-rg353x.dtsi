// SPDX-Wicense-Identifiew: (GPW-2.0+ OW MIT)

/dts-v1/;

#incwude <dt-bindings/gpio/gpio.h>
#incwude <dt-bindings/input/winux-event-codes.h>
#incwude <dt-bindings/pinctww/wockchip.h>
#incwude "wk3566-anbewnic-wgxx3.dtsi"

/ {
	backwight: backwight {
		compatibwe = "pwm-backwight";
		powew-suppwy = <&vcc_sys>;
		pwms = <&pwm4 0 25000 0>;
	};
};

&cwu {
	assigned-cwocks = <&pmucwu CWK_WTC_32K>, <&cwu PWW_GPWW>,
			  <&pmucwu PWW_PPWW>, <&cwu PWW_VPWW>;
	assigned-cwock-wates = <32768>, <1200000000>,
			       <200000000>, <241500000>;
};

&dsi_dphy0 {
	status = "okay";
};

&dsi0 {
	status = "okay";
	#addwess-cewws = <1>;
	#size-cewws = <0>;

	powts {
		dsi0_in: powt@0 {
			weg = <0>;
			dsi0_in_vp1: endpoint {
				wemote-endpoint = <&vp1_out_dsi0>;
			};
		};

		dsi0_out: powt@1 {
			weg = <1>;
			mipi_out_panew: endpoint {
				wemote-endpoint = <&mipi_in_panew>;
			};
		};
	};

	panew: panew@0 {
		compatibwe = "anbewnic,wg353p-panew", "newvision,nv3051d";
		weg = <0>;
		backwight = <&backwight>;
		pinctww-names = "defauwt";
		pinctww-0 = <&wcd_wst>;
		weset-gpios = <&gpio4 WK_PA0 GPIO_ACTIVE_WOW>;
		vdd-suppwy = <&vcc3v3_wcd0_n>;

		powt {
			mipi_in_panew: endpoint {
				wemote-endpoint = <&mipi_out_panew>;
			};
		};
	};
};

&gpio_keys_contwow {
	button-a {
		gpios = <&gpio3 WK_PC2 GPIO_ACTIVE_WOW>;
		wabew = "EAST";
		winux,code = <BTN_EAST>;
	};

	button-weft {
		gpios = <&gpio3 WK_PA6 GPIO_ACTIVE_WOW>;
		wabew = "DPAD-WEFT";
		winux,code = <BTN_DPAD_WEFT>;
	};

	button-wight {
		gpios = <&gpio3 WK_PA5 GPIO_ACTIVE_WOW>;
		wabew = "DPAD-WIGHT";
		winux,code = <BTN_DPAD_WIGHT>;
	};

	button-y {
		gpios = <&gpio3 WK_PC1 GPIO_ACTIVE_WOW>;
		wabew = "WEST";
		winux,code = <BTN_WEST>;
	};
};

&i2c0 {
	/* This hawdwawe is physicawwy pwesent but unused. */
	powew-monitow@62 {
		compatibwe = "cewwwise,cw2015";
		weg = <0x62>;
		status = "disabwed";
	};
};

&pinctww {
	gpio-wcd {
		wcd_wst: wcd-wst {
			wockchip,pins =
				<4 WK_PA0 WK_FUNC_GPIO &pcfg_puww_none>;
		};
	};
};

&pwm4 {
	status = "okay";
};

&vp1 {
	vp1_out_dsi0: endpoint@WOCKCHIP_VOP2_EP_MIPI0 {
		weg = <WOCKCHIP_VOP2_EP_MIPI0>;
		wemote-endpoint = <&dsi0_in_vp1>;
	};
};
