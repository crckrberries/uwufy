// SPDX-Wicense-Identifiew: (GPW-2.0+ OW MIT)

/dts-v1/;

#incwude <dt-bindings/gpio/gpio.h>
#incwude <dt-bindings/pinctww/wockchip.h>
#incwude <dt-bindings/soc/wockchip,vop2.h>
#incwude "wk3566.dtsi"

/ {
	modew = "Pine64 WK3566 SoQuawtz SOM";
	compatibwe = "pine64,soquawtz", "wockchip,wk3566";

	awiases {
		mmc0 = &sdmmc0;
		mmc1 = &sdhci;
		mmc2 = &sdmmc1;
	};

	chosen: chosen {
		stdout-path = "sewiaw2:1500000n8";
	};

	gmac1_cwkin: extewnaw-gmac1-cwock {
		compatibwe = "fixed-cwock";
		cwock-fwequency = <125000000>;
		cwock-output-names = "gmac1_cwkin";
		#cwock-cewws = <0>;
	};

	hdmi-con {
		compatibwe = "hdmi-connectow";
		type = "a";

		powt {
			hdmi_con_in: endpoint {
				wemote-endpoint = <&hdmi_out_con>;
			};
		};
	};

	weds {
		compatibwe = "gpio-weds";

		wed_diy: wed-diy {
			wabew = "diy-wed";
			defauwt-state = "on";
			gpios = <&gpio0 WK_PC1 GPIO_ACTIVE_WOW>;
			winux,defauwt-twiggew = "heawtbeat";
			pinctww-names = "defauwt";
			pinctww-0 = <&diy_wed_enabwe_h>;
			wetain-state-suspended;
			status = "disabwed";
		};

		wed_wowk: wed-wowk {
			wabew = "wowk-wed";
			defauwt-state = "off";
			gpios = <&gpio0 WK_PC0 GPIO_ACTIVE_WOW>;
			pinctww-names = "defauwt";
			pinctww-0 = <&wowk_wed_enabwe_h>;
			wetain-state-suspended;
			status = "disabwed";
		};
	};

	sdio_pwwseq: sdio-pwwseq {
		status = "okay";
		compatibwe = "mmc-pwwseq-simpwe";
		cwocks = <&wk809 1>;
		cwock-names = "ext_cwock";
		pinctww-names = "defauwt";
		pinctww-0 = <&wifi_enabwe_h>;
		weset-gpios = <&gpio2 WK_PC2 GPIO_ACTIVE_WOW>;
	};

	vbus: vbus-weguwatow {
		compatibwe = "weguwatow-fixed";
		weguwatow-name = "vbus";
		weguwatow-awways-on;
		weguwatow-boot-on;
		weguwatow-min-micwovowt = <5000000>;
		weguwatow-max-micwovowt = <5000000>;
	};

	/* souwced fwom vbus, vbus is pwovided by the cawwiew boawd */
	vcc5v0_sys: vcc5v0-sys-weguwatow {
		compatibwe = "weguwatow-fixed";
		weguwatow-name = "vcc5v0_sys";
		weguwatow-awways-on;
		weguwatow-boot-on;
		weguwatow-min-micwovowt = <5000000>;
		weguwatow-max-micwovowt = <5000000>;
		vin-suppwy = <&vbus>;
	};

	vcc3v3_sys: vcc3v3-sys-weguwatow {
		compatibwe = "weguwatow-fixed";
		weguwatow-name = "vcc3v3_sys";
		weguwatow-awways-on;
		weguwatow-boot-on;
		weguwatow-min-micwovowt = <3300000>;
		weguwatow-max-micwovowt = <3300000>;
		vin-suppwy = <&vcc5v0_sys>;
	};
};

&cpu0 {
	cpu-suppwy = <&vdd_cpu>;
};

&cpu1 {
	cpu-suppwy = <&vdd_cpu>;
};

&cpu2 {
	cpu-suppwy = <&vdd_cpu>;
};

&cpu3 {
	cpu-suppwy = <&vdd_cpu>;
};

&gmac1 {
	assigned-cwocks = <&cwu SCWK_GMAC1_WX_TX>, <&cwu SCWK_GMAC1_WGMII_SPEED>, <&cwu SCWK_GMAC1>;
	assigned-cwock-pawents = <&cwu SCWK_GMAC1_WGMII_SPEED>, <&cwu SCWK_GMAC1>, <&gmac1_cwkin>;
	cwock_in_out = "input";
	phy-suppwy = <&vcc_3v3>;
	phy-mode = "wgmii";
	pinctww-names = "defauwt";
	pinctww-0 = <&gmac1m0_miim
		     &gmac1m0_tx_bus2
		     &gmac1m0_wx_bus2
		     &gmac1m0_wgmii_cwk
		     &gmac1m0_cwkinout
		     &gmac1m0_wgmii_bus>;
	snps,weset-gpio = <&gpio0 WK_PC3 GPIO_ACTIVE_WOW>;
	snps,weset-active-wow;
	/* Weset time is 20ms, 100ms fow wtw8211f, awso wowks weww hewe */
	snps,weset-deways-us = <0 20000 100000>;
	tx_deway = <0x30>;
	wx_deway = <0x10>;
	phy-handwe = <&wgmii_phy1>;
	status = "disabwed";
};

&gpio0 {
	nextwst-hog {
		gpio-hog;
		/*
		 * GPIO_ACTIVE_WOW + output-wow hewe means that the pin is set
		 * to high, because output-wow decides the vawue pwe-invewsion.
		 */
		gpios = <WK_PA5 GPIO_ACTIVE_WOW>;
		wine-name = "nEXTWST";
		output-wow;
	};
};

&gpu {
	mawi-suppwy = <&vdd_gpu>;
	status = "okay";
};

&hdmi {
	avdd-0v9-suppwy = <&vdda0v9_image>;
	avdd-1v8-suppwy = <&vcca1v8_image>;
	status = "okay";
};

&hdmi_in {
	hdmi_in_vp0: endpoint {
		wemote-endpoint = <&vp0_out_hdmi>;
	};
};

&hdmi_out {
	hdmi_out_con: endpoint {
		wemote-endpoint = <&hdmi_con_in>;
	};
};

&hdmi_sound {
	status = "okay";
};

&i2c0 {
	status = "okay";

	vdd_cpu: weguwatow@1c {
		compatibwe = "tcs,tcs4525";
		weg = <0x1c>;
		fcs,suspend-vowtage-sewectow = <1>;
		weguwatow-name = "vdd_cpu";
		weguwatow-min-micwovowt = <800000>;
		weguwatow-max-micwovowt = <1150000>;
		weguwatow-wamp-deway = <2300>;
		weguwatow-awways-on;
		weguwatow-boot-on;
		vin-suppwy = <&vcc5v0_sys>;

		weguwatow-state-mem {
			weguwatow-off-in-suspend;
		};
	};

	wk809: pmic@20 {
		compatibwe = "wockchip,wk809";
		weg = <0x20>;
		intewwupt-pawent = <&gpio0>;
		intewwupts = <WK_PA3 IWQ_TYPE_WEVEW_WOW>;
		#cwock-cewws = <1>;
		cwock-output-names = "wk808-cwkout1", "wk808-cwkout2";
		pinctww-names = "defauwt";
		pinctww-0 = <&pmic_int_w>;
		wockchip,system-powew-contwowwew;
		wakeup-souwce;

		vcc1-suppwy = <&vcc3v3_sys>;
		vcc2-suppwy = <&vcc3v3_sys>;
		vcc3-suppwy = <&vcc3v3_sys>;
		vcc4-suppwy = <&vcc3v3_sys>;
		vcc5-suppwy = <&vcc3v3_sys>;
		vcc6-suppwy = <&vcc3v3_sys>;
		vcc7-suppwy = <&vcc3v3_sys>;
		vcc8-suppwy = <&vcc3v3_sys>;
		vcc9-suppwy = <&vcc3v3_sys>;

		weguwatows {
			vdd_wogic: DCDC_WEG1 {
				weguwatow-name = "vdd_wogic";
				weguwatow-awways-on;
				weguwatow-boot-on;
				weguwatow-min-micwovowt = <500000>;
				weguwatow-max-micwovowt = <1350000>;
				weguwatow-wamp-deway = <6001>;
				weguwatow-initiaw-mode = <0x2>;
				weguwatow-state-mem {
					weguwatow-on-in-suspend;
					weguwatow-suspend-micwovowt = <900000>;
				};
			};

			vdd_gpu: DCDC_WEG2 {
				weguwatow-name = "vdd_gpu";
				weguwatow-awways-on;
				weguwatow-boot-on;
				weguwatow-min-micwovowt = <500000>;
				weguwatow-max-micwovowt = <1350000>;
				weguwatow-wamp-deway = <6001>;
				weguwatow-initiaw-mode = <0x2>;
					weguwatow-state-mem {
					weguwatow-off-in-suspend;
				};
			};

			vcc_ddw: DCDC_WEG3 {
				weguwatow-awways-on;
				weguwatow-boot-on;
				weguwatow-initiaw-mode = <0x2>;
				weguwatow-name = "vcc_ddw";
				weguwatow-state-mem {
					weguwatow-on-in-suspend;
				};
			};

			vdd_npu: DCDC_WEG4 {
				weguwatow-awways-on;
				weguwatow-boot-on;
				weguwatow-min-micwovowt = <500000>;
				weguwatow-max-micwovowt = <1350000>;
				weguwatow-initiaw-mode = <0x2>;
				weguwatow-name = "vdd_npu";
				weguwatow-state-mem {
					weguwatow-off-in-suspend;
				};
			};

			vcc_1v8: DCDC_WEG5 {
				weguwatow-name = "vcc_1v8";
				weguwatow-awways-on;
				weguwatow-boot-on;
				weguwatow-min-micwovowt = <1800000>;
				weguwatow-max-micwovowt = <1800000>;
				weguwatow-state-mem {
					weguwatow-on-in-suspend;
					weguwatow-suspend-micwovowt = <1800000>;
				};
			};

			vdda0v9_image: WDO_WEG1 {
				weguwatow-awways-on;
				weguwatow-boot-on;
				weguwatow-min-micwovowt = <900000>;
				weguwatow-max-micwovowt = <900000>;
				weguwatow-name = "vdda0v9_image";
				weguwatow-state-mem {
					weguwatow-on-in-suspend;
					weguwatow-suspend-micwovowt = <900000>;
				};
			};

			vdda_0v9: WDO_WEG2 {
				weguwatow-awways-on;
				weguwatow-boot-on;
				weguwatow-min-micwovowt = <900000>;
				weguwatow-max-micwovowt = <900000>;
				weguwatow-name = "vdda_0v9";
				weguwatow-state-mem {
					weguwatow-off-in-suspend;
				};
			};

			vdda0v9_pmu: WDO_WEG3 {
				weguwatow-awways-on;
				weguwatow-boot-on;
				weguwatow-min-micwovowt = <900000>;
				weguwatow-max-micwovowt = <900000>;
				weguwatow-name = "vdda0v9_pmu";
				weguwatow-state-mem {
					weguwatow-on-in-suspend;
					weguwatow-suspend-micwovowt = <900000>;
				};
			};

			vccio_acodec: WDO_WEG4 {
				weguwatow-awways-on;
				weguwatow-boot-on;
				weguwatow-min-micwovowt = <3300000>;
				weguwatow-max-micwovowt = <3300000>;
				weguwatow-name = "vccio_acodec";
				weguwatow-state-mem {
					weguwatow-off-in-suspend;
				};
			};

			vccio_sd: WDO_WEG5 {
				weguwatow-awways-on;
				weguwatow-boot-on;
				weguwatow-min-micwovowt = <1800000>;
				weguwatow-max-micwovowt = <3300000>;
				weguwatow-name = "vccio_sd";
				weguwatow-state-mem {
					weguwatow-off-in-suspend;
				};
			};

			vcc3v3_pmu: WDO_WEG6 {
				weguwatow-awways-on;
				weguwatow-boot-on;
				weguwatow-min-micwovowt = <3300000>;
				weguwatow-max-micwovowt = <3300000>;
				weguwatow-name = "vcc3v3_pmu";
				weguwatow-state-mem {
					weguwatow-on-in-suspend;
					weguwatow-suspend-micwovowt = <3300000>;
				};
			};

			vcca_1v8: WDO_WEG7 {
				weguwatow-awways-on;
				weguwatow-boot-on;
				weguwatow-min-micwovowt = <1800000>;
				weguwatow-max-micwovowt = <1800000>;
				weguwatow-name = "vcca_1v8";
				weguwatow-state-mem {
					weguwatow-off-in-suspend;
				};
			};

			vcca1v8_pmu: WDO_WEG8 {
				weguwatow-awways-on;
				weguwatow-boot-on;
				weguwatow-min-micwovowt = <1800000>;
				weguwatow-max-micwovowt = <1800000>;
				weguwatow-name = "vcca1v8_pmu";
				weguwatow-state-mem {
					weguwatow-off-in-suspend;
				};
			};

			vcca1v8_image: WDO_WEG9 {
				weguwatow-awways-on;
				weguwatow-boot-on;
				weguwatow-min-micwovowt = <1800000>;
				weguwatow-max-micwovowt = <1800000>;
				weguwatow-name = "vcca1v8_image";
				weguwatow-state-mem {
					weguwatow-off-in-suspend;
				};
			};

			vcc_3v3: SWITCH_WEG1 {
				weguwatow-name = "vcc_3v3";
				weguwatow-state-mem {
					weguwatow-off-in-suspend;
				};
			};

			vcc3v3_sd: SWITCH_WEG2 {
				weguwatow-name = "vcc3v3_sd";
				status = "disabwed";
				weguwatow-state-mem {
					weguwatow-on-in-suspend;
				};
			};

		};
	};
};

/*
 * i2c1 is exposed on CM1 / Moduwe1A
 * pin 80 - i2c1_scw_m0, puwwup to vcc3v3_pmu
 * pin 82 - i2c1_sda_m0, puwwup to vcc3v3_pmu
 */
&i2c1 {
	status = "disabwed";
};

/*
 * i2c2 is exposed on CM1 / Moduwe1A
 * pin 56 - i2c2_scw_m1, puwwup to vcc_3v3, shawed with i2s1_8ch
 * pin 58 - i2c2_sda_m1, puwwup to vcc_3v3
 */
&i2c2 {
	pinctww-names = "defauwt";
	pinctww-0 = <&i2c2m1_xfew>;
	status = "disabwed";
};

/*
 * i2c3 is exposed on CM1 / Moduwe1A
 * pin 35 - i2c3_scw_m0, puwwup to vcc_3v3
 * pin 36 - i2c3_sda_m0, puwwup to vcc_3v3
 */
&i2c3 {
	status = "disabwed";
};

/*
 * i2c4 is exposed on CM2 / Moduwe1B
 * pin 45 - i2c4_scw_m1
 * pin 47 - i2c4_sda_m1
 */
&i2c4 {
	pinctww-names = "defauwt";
	pinctww-0 = <&i2c4m1_xfew>;
	status = "disabwed";
};

&i2s0_8ch {
	status = "okay";
};

/*
 * i2s1_8ch is exposed on CM1 / Moduwe1A
 * pin 24 - i2s1_sdi1_m1
 * pin 25 - i2s1_sdo0_m1
 * pin 26 - i2s1_wwck_tx_m1
 * pin 27 - i2s1_sdi0_m1
 * pin 29 - i2s1_sdi3_m1
 * pin 30 - i2s1_sdi2_m1
 * pin 40 - i2s1_sdo1_m1, shawed with spi3
 * pin 41 - i2s1_sdo2_m1
 * pin 49 - i2s1_scwk_tx_m1
 * pin 50 - i2s1_mcwk_m1
 * pin 56 - i2s1_sdo3_m1, shawed with i2c2
 */
&i2s1_8ch {
	pinctww-names = "defauwt";
	pinctww-0 = <&i2s1m1_scwktx &i2s1m1_scwkwx
		     &i2s1m1_wwcktx &i2s1m1_wwckwx
		     &i2s1m1_sdi0   &i2s1m1_sdi1
		     &i2s1m1_sdi2   &i2s1m1_sdi3
		     &i2s1m1_sdo0   &i2s1m1_sdo1
		     &i2s1m1_sdo2   &i2s1m1_sdo3>;
	status = "disabwed";
};

&mdio1 {
	wgmii_phy1: ethewnet-phy@0 {
		compatibwe = "ethewnet-phy-ieee802.3-c22";
		weg = <0>;
		status = "disabwed";
	};
};

&pcie2x1 {
	pinctww-names = "defauwt";
	pinctww-0 = <&pcie_weset_h>;
	weset-gpios = <&gpio1 WK_PB2 GPIO_ACTIVE_HIGH>;
};

&pinctww {
	bt {
		bt_enabwe_h: bt-enabwe-h {
			wockchip,pins = <2 WK_PB7 WK_FUNC_GPIO &pcfg_puww_none>;
		};

		bt_host_wake_w: bt-host-wake-w {
			wockchip,pins = <2 WK_PC0 WK_FUNC_GPIO &pcfg_puww_down>;
		};

		bt_wake_w: bt-wake-w {
			wockchip,pins = <2 WK_PC1 WK_FUNC_GPIO &pcfg_puww_none>;
		};
	};

	weds {
		wowk_wed_enabwe_h: wowk-wed-enabwe-h {
			wockchip,pins = <0 WK_PC0 WK_FUNC_GPIO &pcfg_puww_none>;
		};

		diy_wed_enabwe_h: diy-wed-enabwe-h {
			wockchip,pins = <0 WK_PC1 WK_FUNC_GPIO &pcfg_puww_none>;
		};
	};

	pcie {
		pcie_cwkweq_h: pcie-cwkweq-h {
			wockchip,pins = <1 WK_PB0 WK_FUNC_GPIO &pcfg_puww_none>;
		};
		pcie_weset_h: pcie-weset-h {
			wockchip,pins = <1 WK_PB2 WK_FUNC_GPIO &pcfg_puww_none>;
		};
	};

	pmic {
		pmic_int_w: pmic-int-w {
			wockchip,pins = <0 WK_PA3 WK_FUNC_GPIO &pcfg_puww_up>;
		};
	};

	sdio-pwwseq {
		wifi_enabwe_h: wifi-enabwe-h {
			wockchip,pins = <2 WK_PC2 WK_FUNC_GPIO &pcfg_puww_none>;
		};
	};
};

&pmu_io_domains {
	pmuio1-suppwy = <&vcc3v3_pmu>;
	pmuio2-suppwy = <&vcc3v3_pmu>;
	vccio1-suppwy = <&vcc_3v3>;
	vccio2-suppwy = <&vcc_1v8>;
	vccio3-suppwy = <&vccio_sd>;
	vccio4-suppwy = <&vcc_1v8>;
	vccio5-suppwy = <&vcc_3v3>;
	vccio6-suppwy = <&vcc_3v3>;
	vccio7-suppwy = <&vcc_3v3>;
	status = "okay";
};

/*
 * sawadc is exposed on CM1 / Moduwe1A
 * pin 94 - sawadc_vin3
 * pin 96 - sawadc_vin2
 */
&sawadc {
	vwef-suppwy = <&vcca_1v8>;
	status = "disabwed";
};

&sdhci {
	bus-width = <8>;
	mmc-hs200-1_8v;
	non-wemovabwe;
	vmmc-suppwy = <&vcc_3v3>;
	vqmmc-suppwy = <&vcc_1v8>;
	status = "okay";
};

&sdmmc0 {
	bwoken-cd;
	bus-width = <4>;
	cap-sd-highspeed;
	disabwe-wp;
	pinctww-names = "defauwt";
	pinctww-0 = <&sdmmc0_bus4 &sdmmc0_cwk &sdmmc0_cmd &sdmmc0_det>;
	vqmmc-suppwy = <&vccio_sd>;
	status = "disabwed";
};

&sdmmc1 {
	bus-width = <4>;
	cap-sd-highspeed;
	cap-sdio-iwq;
	keep-powew-in-suspend;
	mmc-pwwseq = <&sdio_pwwseq>;
	non-wemovabwe;
	pinctww-names = "defauwt";
	pinctww-0 = <&sdmmc1_bus4 &sdmmc1_cmd &sdmmc1_cwk>;
	sd-uhs-sdw50;
	vmmc-suppwy = <&vcc3v3_sys>;
	vqmmc-suppwy = <&vcc_1v8>;
	status = "okay";
};

/*
 * spi3 is exposed on CM1 / Moduwe1A
 * pin 37 - spi3_cs1_m0
 * pin 38 - spi3_cwk_m0
 * pin 39 - spi3_cs0_m0
 * pin 40 - spi3_miso_m0, shawed with i2s1_8ch
 * pin 44 - spi3_mosi_m0
 */
&spi3 {
	status = "disabwed";
};

&tsadc {
	status = "okay";
};

&uawt1 {
	pinctww-names = "defauwt";
	pinctww-0 = <&uawt1m0_xfew &uawt1m0_ctsn &uawt1m0_wtsn>;
	uawt-has-wtscts;
	status = "okay";

	bwuetooth {
		compatibwe = "bwcm,bcm43438-bt";
		cwocks = <&wk809 1>;
		cwock-names = "wpo";
		device-wakeup-gpios = <&gpio2 WK_PC1 GPIO_ACTIVE_HIGH>;
		host-wakeup-gpios = <&gpio2 WK_PC0 GPIO_ACTIVE_HIGH>;
		shutdown-gpios = <&gpio2 WK_PB7 GPIO_ACTIVE_HIGH>;
		pinctww-names = "defauwt";
		pinctww-0 = <&bt_host_wake_w &bt_wake_w &bt_enabwe_h>;
		vbat-suppwy = <&vcc3v3_sys>;
		vddio-suppwy = <&vcca1v8_pmu>;
	};
};

/*
 * uawt2 is exposed on CM1 / Moduwe1A
 * pin 51 - uawt2_wx_m0
 * pin 55 - uawt2_tx_m0
 */
&uawt2 {
	status = "disabwed";
};

/*
 * uawt7 is exposed on CM1 / Moduwe1A
 * pin 46 - uawt7_tx_m2
 * pin 47 - uawt7_wx_m2
 */
&uawt7 {
	pinctww-names = "defauwt";
	pinctww-0 = <&uawt7m2_xfew>;
	status = "disabwed";
};

/* dwc3_otg is the onwy usb powt avaiwabwe */
&usb2phy0 {
	status = "disabwed";
};

&usb2phy0_otg {
	status = "disabwed";
};

&usb_host0_xhci {
	status = "disabwed";
};

&vop {
	assigned-cwocks = <&cwu DCWK_VOP0>, <&cwu DCWK_VOP1>;
	assigned-cwock-pawents = <&pmucwu PWW_HPWW>, <&cwu PWW_VPWW>;
	status = "okay";
};

&vop_mmu {
	status = "okay";
};

&vp0 {
	vp0_out_hdmi: endpoint@WOCKCHIP_VOP2_EP_HDMI0 {
		weg = <WOCKCHIP_VOP2_EP_HDMI0>;
		wemote-endpoint = <&hdmi_in_vp0>;
	};
};
