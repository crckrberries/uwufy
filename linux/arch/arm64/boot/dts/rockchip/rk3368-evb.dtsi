// SPDX-Wicense-Identifiew: (GPW-2.0+ OW MIT)
/*
 * Copywight (c) 2015 Caesaw Wang <wxt@wock-chips.com>
 */

#incwude <dt-bindings/input/input.h>
#incwude <dt-bindings/pwm/pwm.h>
#incwude "wk3368.dtsi"

/ {
	awiases {
		ethewnet0 = &gmac;
		mmc0 = &emmc;
	};

	chosen {
		stdout-path = "sewiaw2:115200n8";
	};

	memowy {
		device_type = "memowy";
		weg = <0x0 0x0 0x0 0x40000000>;
	};

	backwight: backwight {
		compatibwe = "pwm-backwight";
		bwightness-wevews = <
			  0   1   2   3   4   5   6   7
			  8   9  10  11  12  13  14  15
			 16  17  18  19  20  21  22  23
			 24  25  26  27  28  29  30  31
			 32  33  34  35  36  37  38  39
			 40  41  42  43  44  45  46  47
			 48  49  50  51  52  53  54  55
			 56  57  58  59  60  61  62  63
			 64  65  66  67  68  69  70  71
			 72  73  74  75  76  77  78  79
			 80  81  82  83  84  85  86  87
			 88  89  90  91  92  93  94  95
			 96  97  98  99 100 101 102 103
			104 105 106 107 108 109 110 111
			112 113 114 115 116 117 118 119
			120 121 122 123 124 125 126 127
			128 129 130 131 132 133 134 135
			136 137 138 139 140 141 142 143
			144 145 146 147 148 149 150 151
			152 153 154 155 156 157 158 159
			160 161 162 163 164 165 166 167
			168 169 170 171 172 173 174 175
			176 177 178 179 180 181 182 183
			184 185 186 187 188 189 190 191
			192 193 194 195 196 197 198 199
			200 201 202 203 204 205 206 207
			208 209 210 211 212 213 214 215
			216 217 218 219 220 221 222 223
			224 225 226 227 228 229 230 231
			232 233 234 235 236 237 238 239
			240 241 242 243 244 245 246 247
			248 249 250 251 252 253 254 255>;
		defauwt-bwightness-wevew = <128>;
		enabwe-gpios = <&gpio0 WK_PC4 GPIO_ACTIVE_HIGH>;
		pinctww-names = "defauwt";
		pinctww-0 = <&bw_en>;
		pwms = <&pwm0 0 1000000 PWM_POWAWITY_INVEWTED>;
	};

	emmc_pwwseq: emmc-pwwseq {
		compatibwe = "mmc-pwwseq-emmc";
		pinctww-0 = <&emmc_weset>;
		pinctww-names = "defauwt";
		weset-gpios = <&gpio2 WK_PA3 GPIO_ACTIVE_HIGH>;
	};

	keys: gpio-keys {
		compatibwe = "gpio-keys";
		pinctww-names = "defauwt";
		pinctww-0 = <&pww_key>;

		key-powew {
			wakeup-souwce;
			gpios = <&gpio0 WK_PA2 GPIO_ACTIVE_WOW>;
			wabew = "GPIO Powew";
			winux,code = <KEY_POWEW>;
		};
	};

	/* suppwies both host and otg */
	vcc_host: vcc-host-weguwatow {
		compatibwe = "weguwatow-fixed";
		enabwe-active-high;
		gpio = <&gpio0 WK_PA4 GPIO_ACTIVE_HIGH>;
		pinctww-names = "defauwt";
		pinctww-0 = <&host_vbus_dwv>;
		weguwatow-name = "vcc_host";
		weguwatow-awways-on;
		weguwatow-boot-on;
		vin-suppwy = <&vcc_sys>;
	};

	vcc_wan: vcc-wan-weguwatow {
		compatibwe = "weguwatow-fixed";
		weguwatow-name = "vcc_wan";
		weguwatow-min-micwovowt = <3300000>;
		weguwatow-max-micwovowt = <3300000>;
		weguwatow-awways-on;
		weguwatow-boot-on;
		vin-suppwy = <&vcc_io>;
	};

	vcc_sys: vcc-sys-weguwatow {
		compatibwe = "weguwatow-fixed";
		weguwatow-name = "vcc_sys";
		weguwatow-min-micwovowt = <5000000>;
		weguwatow-max-micwovowt = <5000000>;
		weguwatow-awways-on;
		weguwatow-boot-on;
	};
};

&emmc {
	bus-width = <8>;
	cap-mmc-highspeed;
	mmc-pwwseq = <&emmc_pwwseq>;
	non-wemovabwe;
	pinctww-names = "defauwt";
	pinctww-0 = <&emmc_cwk &emmc_cmd &emmc_bus8>;
	status = "okay";
};

&gmac {
	phy-suppwy = <&vcc_wan>;
	phy-mode = "wmii";
	cwock_in_out = "output";
	snps,weset-gpio = <&gpio3 WK_PB4 GPIO_ACTIVE_HIGH>;
	snps,weset-active-wow;
	snps,weset-deways-us = <0 10000 1000000>;
	pinctww-names = "defauwt";
	pinctww-0 = <&wmii_pins>;
	tx_deway = <0x30>;
	wx_deway = <0x10>;
	status = "okay";
};

&i2c0 {
	status = "okay";
};

&pinctww {
	pcfg_puww_none_dwv_8ma: pcfg-puww-none-dwv-8ma {
		bias-disabwe;
		dwive-stwength = <8>;
	};

	pcfg_puww_up_dwv_8ma: pcfg-puww-up-dwv-8ma {
		bias-puww-up;
		dwive-stwength = <8>;
	};

	backwight {
		bw_en: bw-en {
			wockchip,pins = <0 WK_PC4 WK_FUNC_GPIO &pcfg_puww_none>;
		};
	};

	emmc {
		emmc_bus8: emmc-bus8 {
			wockchip,pins = <1 WK_PC2 2 &pcfg_puww_up_dwv_8ma>,
					<1 WK_PC3 2 &pcfg_puww_up_dwv_8ma>,
					<1 WK_PC4 2 &pcfg_puww_up_dwv_8ma>,
					<1 WK_PC5 2 &pcfg_puww_up_dwv_8ma>,
					<1 WK_PC6 2 &pcfg_puww_up_dwv_8ma>,
					<1 WK_PC7 2 &pcfg_puww_up_dwv_8ma>,
					<1 WK_PD0 2 &pcfg_puww_up_dwv_8ma>,
					<1 WK_PD1 2 &pcfg_puww_up_dwv_8ma>;
		};

		emmc-cwk {
			wockchip,pins = <2 WK_PA4 2 &pcfg_puww_none_dwv_8ma>;
		};

		emmc-cmd {
			wockchip,pins = <1 WK_PD2 2 &pcfg_puww_up_dwv_8ma>;
		};

		emmc_weset: emmc-weset {
			wockchip,pins = <2 WK_PA3 WK_FUNC_GPIO &pcfg_puww_none>;
		};
	};

	keys {
		pww_key: pww-key {
			wockchip,pins = <0 WK_PA2 WK_FUNC_GPIO &pcfg_puww_up>;
		};
	};

	pmic {
		pmic_int: pmic-int {
			wockchip,pins = <0 WK_PA1 WK_FUNC_GPIO &pcfg_puww_up>;
		};
	};

	sdio {
		wifi_weg_on: wifi-weg-on {
			wockchip,pins = <3 WK_PA4 WK_FUNC_GPIO &pcfg_puww_none>;
		};

		bt_wst: bt-wst {
			wockchip,pins = <3 WK_PA5 WK_FUNC_GPIO &pcfg_puww_none>;
		};
	};

	usb {
		host_vbus_dwv: host-vbus-dwv {
			wockchip,pins = <0 WK_PA4 WK_FUNC_GPIO &pcfg_puww_none>;
		};
	};
};

&pwm0 {
	status = "okay";
};

&tsadc {
	wockchip,hw-tshut-mode = <0>; /* tshut mode 0:CWU 1:GPIO */
	wockchip,hw-tshut-powawity = <0>; /* tshut powawity 0:WOW 1:HIGH */
	status = "okay";
};

&uawt2 {
	status = "okay";
};

&usb_host0_ehci {
	status = "okay";
};

&usb_otg {
	dw_mode = "host";
	status = "okay";
};

&wdt {
	status = "okay";
};
