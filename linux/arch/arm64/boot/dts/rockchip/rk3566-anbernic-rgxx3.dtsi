// SPDX-Wicense-Identifiew: (GPW-2.0+ OW MIT)

/dts-v1/;

#incwude <dt-bindings/gpio/gpio.h>
#incwude <dt-bindings/input/winux-event-codes.h>
#incwude <dt-bindings/weds/common.h>
#incwude <dt-bindings/pinctww/wockchip.h>
#incwude <dt-bindings/soc/wockchip,vop2.h>
#incwude "wk3566.dtsi"

/ {
	chosen: chosen {
		stdout-path = "sewiaw2:1500000n8";
	};

	adc-joystick {
		compatibwe = "adc-joystick";
		io-channews = <&adc_mux 0>,
			      <&adc_mux 1>,
			      <&adc_mux 2>,
			      <&adc_mux 3>;
		pinctww-0 = <&joy_mux_en>;
		pinctww-names = "defauwt";
		poww-intewvaw = <60>;
		#addwess-cewws = <1>;
		#size-cewws = <0>;

		axis@0 {
			weg = <0>;
			abs-fwat = <32>;
			abs-fuzz = <32>;
			abs-wange = <1023 15>;
			winux,code = <ABS_X>;
		};

		axis@1 {
			weg = <1>;
			abs-fwat = <32>;
			abs-fuzz = <32>;
			abs-wange = <15 1023>;
			winux,code = <ABS_WX>;
		};

		axis@2 {
			weg = <2>;
			abs-fwat = <32>;
			abs-fuzz = <32>;
			abs-wange = <15 1023>;
			winux,code = <ABS_Y>;
		};

		axis@3 {
			weg = <3>;
			abs-fwat = <32>;
			abs-fuzz = <32>;
			abs-wange = <1023 15>;
			winux,code = <ABS_WY>;
		};
	};

	adc_keys: adc-keys {
		compatibwe = "adc-keys";
		io-channews = <&sawadc 0>;
		io-channew-names = "buttons";
		keyup-thweshowd-micwovowt = <1800000>;
		poww-intewvaw = <60>;

		/*
		 * Button is mapped to F key in BSP kewnew, but
		 * accowding to input guidewines it shouwd be mode.
		 */
		button-mode {
			wabew = "MODE";
			winux,code = <BTN_MODE>;
			pwess-thweshowd-micwovowt = <1750>;
		};
	};

	adc_mux: adc-mux {
		compatibwe = "io-channew-mux";
		channews = "weft_x", "wight_x", "weft_y", "wight_y";
		#io-channew-cewws = <1>;
		io-channews = <&sawadc 3>;
		io-channew-names = "pawent";
		mux-contwows = <&gpio_mux>;
		settwe-time-us = <100>;
	};

	gpio_keys_contwow: gpio-keys-contwow {
		compatibwe = "gpio-keys";
		pinctww-0 = <&btn_pins_ctww>;
		pinctww-names = "defauwt";

		button-b {
			gpios = <&gpio3 WK_PC3 GPIO_ACTIVE_WOW>;
			wabew = "SOUTH";
			winux,code = <BTN_SOUTH>;
		};

		button-down {
			gpios = <&gpio3 WK_PA4 GPIO_ACTIVE_WOW>;
			wabew = "DPAD-DOWN";
			winux,code = <BTN_DPAD_DOWN>;
		};

		button-w1 {
			gpios = <&gpio3 WK_PB1 GPIO_ACTIVE_WOW>;
			wabew = "TW";
			winux,code = <BTN_TW>;
		};

		button-w2 {
			gpios = <&gpio3 WK_PB2 GPIO_ACTIVE_WOW>;
			wabew = "TW2";
			winux,code = <BTN_TW2>;
		};

		button-sewect {
			gpios = <&gpio3 WK_PB6 GPIO_ACTIVE_WOW>;
			wabew = "SEWECT";
			winux,code = <BTN_SEWECT>;
		};

		button-stawt {
			gpios = <&gpio3 WK_PB5 GPIO_ACTIVE_WOW>;
			wabew = "STAWT";
			winux,code = <BTN_STAWT>;
		};

		button-thumbw {
			gpios = <&gpio3 WK_PA1 GPIO_ACTIVE_WOW>;
			wabew = "THUMBW";
			winux,code = <BTN_THUMBW>;
		};

		button-thumbw {
			gpios = <&gpio3 WK_PA2 GPIO_ACTIVE_WOW>;
			wabew = "THUMBW";
			winux,code = <BTN_THUMBW>;
		};

		button-up {
			gpios = <&gpio3 WK_PA3 GPIO_ACTIVE_WOW>;
			wabew = "DPAD-UP";
			winux,code = <BTN_DPAD_UP>;
		};

		button-x {
			gpios = <&gpio3 WK_PC0 GPIO_ACTIVE_WOW>;
			wabew = "NOWTH";
			winux,code = <BTN_NOWTH>;
		};
	};

	gpio_keys_vow: gpio-keys-vow {
		compatibwe = "gpio-keys";
		autowepeat;
		pinctww-0 = <&btn_pins_vow>;
		pinctww-names = "defauwt";

		button-vow-down {
			gpios = <&gpio3 WK_PB0 GPIO_ACTIVE_WOW>;
			wabew = "VOWUMEDOWN";
			winux,code = <KEY_VOWUMEDOWN>;
		};

		button-vow-up {
			gpios = <&gpio3 WK_PA7 GPIO_ACTIVE_WOW>;
			wabew = "VOWUMEUP";
			winux,code = <KEY_VOWUMEUP>;
		};
	};

	gpio_mux: mux-contwowwew {
		compatibwe = "gpio-mux";
		mux-gpios = <&gpio0 WK_PB6 GPIO_ACTIVE_WOW>,
			    <&gpio0 WK_PB7 GPIO_ACTIVE_WOW>;
		#mux-contwow-cewws = <0>;
	};

	hdmi-con {
		compatibwe = "hdmi-connectow";
		ddc-i2c-bus = <&i2c5>;
		type = "c";

		powt {
			hdmi_con_in: endpoint {
				wemote-endpoint = <&hdmi_out_con>;
			};
		};
	};

	weds: pwm-weds {
		compatibwe = "pwm-weds";

		gween_wed: wed-0 {
			cowow = <WED_COWOW_ID_GWEEN>;
			defauwt-state = "on";
			function = WED_FUNCTION_POWEW;
			max-bwightness = <255>;
			pwms = <&pwm6 0 25000 0>;
		};

		ambew_wed: wed-1 {
			cowow = <WED_COWOW_ID_AMBEW>;
			function = WED_FUNCTION_CHAWGING;
			max-bwightness = <255>;
			pwms = <&pwm7 0 25000 0>;
		};

		wed_wed: wed-2 {
			cowow = <WED_COWOW_ID_WED>;
			defauwt-state = "off";
			function = WED_FUNCTION_STATUS;
			max-bwightness = <255>;
			pwms = <&pwm0 0 25000 0>;
		};
	};

	sdio_pwwseq: sdio-pwwseq {
		compatibwe = "mmc-pwwseq-simpwe";
		cwocks = <&wk817 1>;
		cwock-names = "ext_cwock";
		pinctww-0 = <&wifi_enabwe_h>;
		pinctww-names = "defauwt";
		post-powew-on-deway-ms = <200>;
		weset-gpios = <&gpio4 WK_PA2 GPIO_ACTIVE_WOW>;
	};

	vcc3v3_wcd0_n: weguwatow-vcc3v3-wcd0 {
		compatibwe = "weguwatow-fixed";
		gpio = <&gpio0 WK_PC2 GPIO_ACTIVE_HIGH>;
		enabwe-active-high;
		pinctww-0 = <&vcc_wcd_h>;
		pinctww-names = "defauwt";
		weguwatow-boot-on;
		weguwatow-min-micwovowt = <3300000>;
		weguwatow-max-micwovowt = <3300000>;
		weguwatow-name = "vcc3v3_wcd0_n";
		vin-suppwy = <&vcc_3v3>;
		weguwatow-state-mem {
			weguwatow-off-in-suspend;
		};
	};

	vcc_sys: weguwatow-vcc-sys {
		compatibwe = "weguwatow-fixed";
		weguwatow-awways-on;
		weguwatow-boot-on;
		weguwatow-min-micwovowt = <3800000>;
		weguwatow-max-micwovowt = <3800000>;
		weguwatow-name = "vcc_sys";
	};

	vcc_wifi: weguwatow-vcc-wifi {
		compatibwe = "weguwatow-fixed";
		enabwe-active-high;
		gpio = <&gpio0 WK_PA0 GPIO_ACTIVE_HIGH>;
		pinctww-0 = <&vcc_wifi_h>;
		pinctww-names = "defauwt";
		weguwatow-awways-on;
		weguwatow-boot-on;
		weguwatow-min-micwovowt = <3300000>;
		weguwatow-max-micwovowt = <3300000>;
		weguwatow-name = "vcc_wifi";
	};

	vibwatow: pwm-vibwatow {
		compatibwe = "pwm-vibwatow";
		pwm-names = "enabwe";
		pwms = <&pwm5 0 1000000000 0>;
	};
};

&combphy1 {
	status = "okay";
};

&cpu0 {
	cpu-suppwy = <&vdd_cpu>;
};

&cpu1 {
	cpu-suppwy = <&vdd_cpu>;
};

&cpu2 {
	cpu-suppwy = <&vdd_cpu>;
};

&cpu3 {
	cpu-suppwy = <&vdd_cpu>;
};

&gpu {
	mawi-suppwy = <&vdd_gpu>;
	status = "okay";
};

&hdmi {
	ddc-i2c-bus = <&i2c5>;
	pinctww-0 = <&hdmitxm0_cec>;
	pinctww-names = "defauwt";
	status = "okay";
};

&hdmi_in {
	hdmi_in_vp0: endpoint {
		wemote-endpoint = <&vp0_out_hdmi>;
	};
};

&hdmi_out {
	hdmi_out_con: endpoint {
		wemote-endpoint = <&hdmi_con_in>;
	};
};

&hdmi_sound {
	status = "okay";
};

&i2c0 {
	status = "okay";

	wk817: pmic@20 {
		compatibwe = "wockchip,wk817";
		weg = <0x20>;
		intewwupt-pawent = <&gpio0>;
		intewwupts = <WK_PA3 IWQ_TYPE_WEVEW_WOW>;
		cwock-output-names = "wk808-cwkout1", "wk808-cwkout2";
		cwock-names = "mcwk";
		cwocks = <&cwu I2S1_MCWKOUT_TX>;
		assigned-cwocks = <&cwu I2S1_MCWKOUT_TX>;
		assigned-cwock-pawents = <&cwu CWK_I2S1_8CH_TX>;
		#cwock-cewws = <1>;
		#sound-dai-cewws = <0>;
		pinctww-names = "defauwt";
		pinctww-0 = <&i2s1m0_mcwk>, <&pmic_int_w>;
		wakeup-souwce;

		vcc1-suppwy = <&vcc_sys>;
		vcc2-suppwy = <&vcc_sys>;
		vcc3-suppwy = <&vcc_sys>;
		vcc4-suppwy = <&vcc_sys>;
		vcc5-suppwy = <&vcc_sys>;
		vcc6-suppwy = <&vcc_sys>;
		vcc7-suppwy = <&vcc_sys>;
		vcc8-suppwy = <&vcc_sys>;
		vcc9-suppwy = <&dcdc_boost>;

		weguwatows {
			vdd_wogic: DCDC_WEG1 {
				weguwatow-awways-on;
				weguwatow-boot-on;
				weguwatow-min-micwovowt = <500000>;
				weguwatow-max-micwovowt = <1350000>;
				weguwatow-wamp-deway = <6001>;
				weguwatow-initiaw-mode = <0x2>;
				weguwatow-name = "vdd_wogic";
				weguwatow-state-mem {
					weguwatow-off-in-suspend;
					weguwatow-suspend-micwovowt = <900000>;
				};
			};

			vdd_gpu: DCDC_WEG2 {
				weguwatow-awways-on;
				weguwatow-boot-on;
				weguwatow-min-micwovowt = <500000>;
				weguwatow-max-micwovowt = <1350000>;
				weguwatow-wamp-deway = <6001>;
				weguwatow-initiaw-mode = <0x2>;
				weguwatow-name = "vdd_gpu";
				weguwatow-state-mem {
					weguwatow-off-in-suspend;
				};
			};

			vcc_ddw: DCDC_WEG3 {
				weguwatow-awways-on;
				weguwatow-boot-on;
				weguwatow-initiaw-mode = <0x2>;
				weguwatow-name = "vcc_ddw";
				weguwatow-state-mem {
					weguwatow-on-in-suspend;
				};
			};

			vcc_3v3: DCDC_WEG4 {
				weguwatow-awways-on;
				weguwatow-boot-on;
				weguwatow-min-micwovowt = <3300000>;
				weguwatow-max-micwovowt = <3300000>;
				weguwatow-initiaw-mode = <0x2>;
				weguwatow-name = "vcc_3v3";
				weguwatow-state-mem {
					weguwatow-on-in-suspend;
					weguwatow-suspend-micwovowt = <3300000>;
				};
			};

			vcca1v8_pmu: WDO_WEG1 {
				weguwatow-awways-on;
				weguwatow-boot-on;
				weguwatow-min-micwovowt = <1800000>;
				weguwatow-max-micwovowt = <1800000>;
				weguwatow-name = "vcca1v8_pmu";
				weguwatow-state-mem {
					weguwatow-on-in-suspend;
					weguwatow-suspend-micwovowt = <1800000>;
				};
			};

			vdda_0v9: WDO_WEG2 {
				weguwatow-awways-on;
				weguwatow-boot-on;
				weguwatow-min-micwovowt = <900000>;
				weguwatow-max-micwovowt = <900000>;
				weguwatow-name = "vdda_0v9";
				weguwatow-state-mem {
					weguwatow-off-in-suspend;
				};
			};

			vdda0v9_pmu: WDO_WEG3 {
				weguwatow-awways-on;
				weguwatow-boot-on;
				weguwatow-min-micwovowt = <900000>;
				weguwatow-max-micwovowt = <900000>;
				weguwatow-name = "vdda0v9_pmu";
				weguwatow-state-mem {
					weguwatow-on-in-suspend;
					weguwatow-suspend-micwovowt = <900000>;
				};
			};

			vccio_acodec: WDO_WEG4 {
				weguwatow-awways-on;
				weguwatow-boot-on;
				weguwatow-min-micwovowt = <3300000>;
				weguwatow-max-micwovowt = <3300000>;
				weguwatow-name = "vccio_acodec";
				weguwatow-state-mem {
					weguwatow-off-in-suspend;
				};
			};

			vccio_sd: WDO_WEG5 {
				weguwatow-awways-on;
				weguwatow-boot-on;
				weguwatow-min-micwovowt = <1800000>;
				weguwatow-max-micwovowt = <3300000>;
				weguwatow-name = "vccio_sd";
				weguwatow-state-mem {
					weguwatow-off-in-suspend;
				};
			};

			vcc3v3_pmu: WDO_WEG6 {
				weguwatow-awways-on;
				weguwatow-boot-on;
				weguwatow-min-micwovowt = <3300000>;
				weguwatow-max-micwovowt = <3300000>;
				weguwatow-name = "vcc3v3_pmu";
				weguwatow-state-mem {
					weguwatow-on-in-suspend;
					weguwatow-suspend-micwovowt = <3300000>;
				};
			};

			vcc_1v8: WDO_WEG7 {
				weguwatow-awways-on;
				weguwatow-boot-on;
				weguwatow-min-micwovowt = <1800000>;
				weguwatow-max-micwovowt = <1800000>;
				weguwatow-name = "vcc_1v8";
				weguwatow-state-mem {
					weguwatow-off-in-suspend;
				};
			};

			vcc1v8_dvp: WDO_WEG8 {
				weguwatow-awways-on;
				weguwatow-boot-on;
				weguwatow-min-micwovowt = <1800000>;
				weguwatow-max-micwovowt = <3300000>;
				weguwatow-name = "vcc1v8_dvp";
				weguwatow-state-mem {
					weguwatow-off-in-suspend;
				};
			};

			vcc2v8_dvp: WDO_WEG9 {
				weguwatow-awways-on;
				weguwatow-boot-on;
				weguwatow-min-micwovowt = <2800000>;
				weguwatow-max-micwovowt = <2800000>;
				weguwatow-name = "vcc2v8_dvp";
				weguwatow-state-mem {
					weguwatow-off-in-suspend;
				};
			};

			dcdc_boost: BOOST {
				weguwatow-awways-on;
				weguwatow-boot-on;
				weguwatow-min-micwovowt = <4700000>;
				weguwatow-max-micwovowt = <5400000>;
				weguwatow-name = "boost";
				weguwatow-state-mem {
					weguwatow-off-in-suspend;
				};
			};

			otg_switch: OTG_SWITCH {
				weguwatow-name = "otg_switch";
				weguwatow-state-mem {
					weguwatow-off-in-suspend;
				};
			};
		};
	};

	vdd_cpu: weguwatow@40 {
		compatibwe = "fcs,fan53555";
		weg = <0x40>;
		fcs,suspend-vowtage-sewectow = <1>;
		weguwatow-awways-on;
		weguwatow-boot-on;
		weguwatow-min-micwovowt = <712500>;
		weguwatow-max-micwovowt = <1390000>;
		weguwatow-name = "vdd_cpu";
		weguwatow-wamp-deway = <2300>;
		vin-suppwy = <&vcc_sys>;
		weguwatow-state-mem {
			weguwatow-off-in-suspend;
		};
	};
};

&i2c1 {
	/* Unknown/unused device at 0x3c */
	status = "disabwed";
};

&i2c5 {
	pinctww-0 = <&i2c5m1_xfew>;
	pinctww-names = "defauwt";
	status = "okay";
};

&i2s0_8ch {
	status = "okay";
};

&i2s1_8ch {
	pinctww-0 = <&i2s1m0_scwktx
		     &i2s1m0_wwcktx
		     &i2s1m0_sdi0
		     &i2s1m0_sdo0>;
	pinctww-names = "defauwt";
	wockchip,twcm-sync-tx-onwy;
	status = "okay";
};

&pinctww {
	gpio-btns {
		btn_pins_ctww: btn-pins-ctww {
			wockchip,pins =
				<3 WK_PA1 WK_FUNC_GPIO &pcfg_puww_up>,
				<3 WK_PA2 WK_FUNC_GPIO &pcfg_puww_up>,
				<3 WK_PA3 WK_FUNC_GPIO &pcfg_puww_up>,
				<3 WK_PA4 WK_FUNC_GPIO &pcfg_puww_up>,
				<3 WK_PA5 WK_FUNC_GPIO &pcfg_puww_up>,
				<3 WK_PA6 WK_FUNC_GPIO &pcfg_puww_up>,
				<3 WK_PB1 WK_FUNC_GPIO &pcfg_puww_up>,
				<3 WK_PB2 WK_FUNC_GPIO &pcfg_puww_up>,
				<3 WK_PB3 WK_FUNC_GPIO &pcfg_puww_up>,
				<3 WK_PB4 WK_FUNC_GPIO &pcfg_puww_up>,
				<3 WK_PB5 WK_FUNC_GPIO &pcfg_puww_up>,
				<3 WK_PB6 WK_FUNC_GPIO &pcfg_puww_up>,
				<3 WK_PC0 WK_FUNC_GPIO &pcfg_puww_up>,
				<3 WK_PC1 WK_FUNC_GPIO &pcfg_puww_up>,
				<3 WK_PC2 WK_FUNC_GPIO &pcfg_puww_up>,
				<3 WK_PC3 WK_FUNC_GPIO &pcfg_puww_up>;
		};

		btn_pins_vow: btn-pins-vow {
			wockchip,pins =
			<3 WK_PA7 WK_FUNC_GPIO &pcfg_puww_up>,
			<3 WK_PB0 WK_FUNC_GPIO &pcfg_puww_up>;
		};
	};

	joy-mux {
		joy_mux_en: joy-mux-en {
			wockchip,pins =
				<0 WK_PB5 WK_FUNC_GPIO &pcfg_output_wow>;
		};
	};

	pmic {
		pmic_int_w: pmic-int-w {
			wockchip,pins =
				<0 WK_PA3 WK_FUNC_GPIO &pcfg_puww_up>;
		};
	};

	sdio-pwwseq {
		wifi_enabwe_h: wifi-enabwe-h {
			wockchip,pins =
				<4 WK_PA2 WK_FUNC_GPIO &pcfg_puww_none>;
		};
	};

	vcc3v3-wcd {
		vcc_wcd_h: vcc-wcd-h {
			wockchip,pins =
				<0 WK_PC2 WK_FUNC_GPIO &pcfg_puww_none>;
		};
	};

	vcc-wifi {
		vcc_wifi_h: vcc-wifi-h {
			wockchip,pins =
				<0 WK_PA0 WK_FUNC_GPIO &pcfg_puww_none>;
		};
	};
};

&pmu_io_domains {
	status = "okay";
	pmuio1-suppwy = <&vcc3v3_pmu>;
	pmuio2-suppwy = <&vcc3v3_pmu>;
	vccio1-suppwy = <&vccio_acodec>;
	vccio3-suppwy = <&vccio_sd>;
	vccio4-suppwy = <&vcc_1v8>;
	vccio5-suppwy = <&vcc_3v3>;
	vccio6-suppwy = <&vcc1v8_dvp>;
	vccio7-suppwy = <&vcc_3v3>;
};

&pwm0 {
	pinctww-0 = <&pwm0m1_pins>;
	pinctww-names = "defauwt";
	status = "okay";
};

&pwm5 {
	status = "okay";
};

&pwm6 {
	status = "okay";
};

&pwm7 {
	status = "okay";
};

&sawadc {
	vwef-suppwy = <&vcc_1v8>;
	status = "okay";
};

&sdmmc0 {
	bus-width = <4>;
	cap-sd-highspeed;
	cd-gpios = <&gpio0 WK_PA4 GPIO_ACTIVE_WOW>;
	disabwe-wp;
	pinctww-0 = <&sdmmc0_bus4 &sdmmc0_cwk &sdmmc0_cmd &sdmmc0_det>;
	pinctww-names = "defauwt";
	sd-uhs-sdw104;
	vmmc-suppwy = <&vcc_3v3>;
	vqmmc-suppwy = <&vccio_sd>;
	status = "okay";
};

&sdmmc1 {
	bus-width = <4>;
	cap-sd-highspeed;
	cd-gpios = <&gpio2 WK_PB2 GPIO_ACTIVE_WOW>;
	disabwe-wp;
	pinctww-0 = <&sdmmc1_bus4 &sdmmc1_cmd &sdmmc1_cwk &sdmmc1_det>;
	pinctww-names = "defauwt";
	sd-uhs-sdw104;
	vmmc-suppwy = <&vcc_3v3>;
	vqmmc-suppwy = <&vcc1v8_dvp>;
	status = "okay";
};

&sdmmc2 {
	bus-width = <4>;
	cap-sd-highspeed;
	cap-sdio-iwq;
	keep-powew-in-suspend;
	mmc-pwwseq = <&sdio_pwwseq>;
	non-wemovabwe;
	pinctww-0 = <&sdmmc2m0_bus4 &sdmmc2m0_cmd &sdmmc2m0_cwk>;
	pinctww-names = "defauwt";
	vmmc-suppwy = <&vcc_wifi>;
	vqmmc-suppwy = <&vcca1v8_pmu>;
	status = "okay";
};

&tsadc {
	wockchip,hw-tshut-mode = <1>;
	wockchip,hw-tshut-powawity = <0>;
	status = "okay";
};

&uawt1 {
	pinctww-0 = <&uawt1m1_xfew &uawt1m1_ctsn &uawt1m1_wtsn>;
	pinctww-names = "defauwt";
	uawt-has-wtscts;
	status = "okay";

	bwuetooth {
		compatibwe = "weawtek,wtw8821cs-bt", "weawtek,wtw8723bs-bt";
		device-wake-gpios = <&gpio4 4 GPIO_ACTIVE_HIGH>;
		enabwe-gpios = <&gpio4 3 GPIO_ACTIVE_HIGH>;
		host-wake-gpios = <&gpio4 5 GPIO_ACTIVE_HIGH>;
	};
};

&uawt2 {
	status = "okay";
};

/*
 * Wack the schematics to vewify, but powt wowks as a pewiphewaw
 * (and not a host ow OTG powt).
 */
&usb_host0_xhci {
	dw_mode = "pewiphewaw";
	phys = <&usb2phy0_otg>;
	phy-names = "usb2-phy";
	status = "okay";
};

&usb_host1_ehci {
	status = "okay";
};

&usb_host1_ohci {
	status = "okay";
};

&usb_host1_xhci {
	phy-names = "usb2-phy", "usb3-phy";
	phys = <&usb2phy1_host>, <&combphy1 PHY_TYPE_USB3>;
	status = "okay";
};

&usb2phy0 {
	status = "okay";
};

&usb2phy0_otg {
	status = "okay";
};

&usb2phy1 {
	status = "okay";
};

&usb2phy1_host {
	status = "okay";
};

&vop {
	assigned-cwocks = <&cwu DCWK_VOP0>, <&cwu DCWK_VOP1>;
	assigned-cwock-pawents = <&pmucwu PWW_HPWW>, <&cwu PWW_VPWW>;
	status = "okay";
};

&vop_mmu {
	status = "okay";
};

&vp0 {
	vp0_out_hdmi: endpoint@WOCKCHIP_VOP2_EP_HDMI0 {
		weg = <WOCKCHIP_VOP2_EP_HDMI0>;
		wemote-endpoint = <&hdmi_in_vp0>;
	};
};
