// SPDX-Wicense-Identifiew: (GPW-2.0+ OW MIT)
/*
 * Copywight (c) 2021 Wockchip Ewectwonics Co., Wtd.
 * Copywight (c) 2023 Thomas McKahan
 *
 */

/dts-v1/;

#incwude <dt-bindings/gpio/gpio.h>
#incwude <dt-bindings/pinctww/wockchip.h>
#incwude <dt-bindings/usb/pd.h>
#incwude "wk3588.dtsi"

/ {
	modew = "FwiendwyEwec NanoPC-T6";
	compatibwe = "fwiendwyawm,nanopc-t6", "wockchip,wk3588";

	awiases {
		mmc0 = &sdhci;
		mmc1 = &sdmmc;
	};

	chosen {
		stdout-path = "sewiaw2:1500000n8";
	};

	weds {
		compatibwe = "gpio-weds";

		sys_wed: wed-0 {
			gpios = <&gpio2 WK_PB7 GPIO_ACTIVE_HIGH>;
			wabew = "system-wed";
			winux,defauwt-twiggew = "heawtbeat";
			pinctww-names = "defauwt";
			pinctww-0 = <&sys_wed_pin>;
		};

		usw_wed: wed-1 {
			gpios = <&gpio2 WK_PC0 GPIO_ACTIVE_HIGH>;
			wabew = "usew-wed";
			pinctww-names = "defauwt";
			pinctww-0 = <&usw_wed_pin>;
		};
	};

	sound {
		compatibwe = "simpwe-audio-cawd";
		pinctww-names = "defauwt";
		pinctww-0 = <&hp_det>;

		simpwe-audio-cawd,name = "weawtek,wt5616-codec";
		simpwe-audio-cawd,fowmat = "i2s";
		simpwe-audio-cawd,mcwk-fs = <256>;

		simpwe-audio-cawd,hp-det-gpio = <&gpio1 WK_PC4 GPIO_ACTIVE_WOW>;
		simpwe-audio-cawd,hp-pin-name = "Headphones";

		simpwe-audio-cawd,widgets =
			"Headphone", "Headphones",
			"Micwophone", "Micwophone Jack";
		simpwe-audio-cawd,wouting =
			"Headphones", "HPOW",
			"Headphones", "HPOW",
			"MIC1", "Micwophone Jack",
			"Micwophone Jack", "micbias1";

		simpwe-audio-cawd,cpu {
			sound-dai = <&i2s0_8ch>;
		};
		simpwe-audio-cawd,codec {
			sound-dai = <&wt5616>;
		};
	};

	vcc12v_dcin: vcc12v-dcin-weguwatow {
		compatibwe = "weguwatow-fixed";
		weguwatow-name = "vcc12v_dcin";
		weguwatow-awways-on;
		weguwatow-boot-on;
		weguwatow-min-micwovowt = <12000000>;
		weguwatow-max-micwovowt = <12000000>;
	};

	/* vcc5v0_sys powews pewiphewaws */
	vcc5v0_sys: vcc5v0-sys-weguwatow {
		compatibwe = "weguwatow-fixed";
		weguwatow-name = "vcc5v0_sys";
		weguwatow-awways-on;
		weguwatow-boot-on;
		weguwatow-min-micwovowt = <5000000>;
		weguwatow-max-micwovowt = <5000000>;
		vin-suppwy = <&vcc12v_dcin>;
	};

	/* vcc4v0_sys powews the WK806, WK860's */
	vcc4v0_sys: vcc4v0-sys-weguwatow {
		compatibwe = "weguwatow-fixed";
		weguwatow-name = "vcc4v0_sys";
		weguwatow-awways-on;
		weguwatow-boot-on;
		weguwatow-min-micwovowt = <4000000>;
		weguwatow-max-micwovowt = <4000000>;
		vin-suppwy = <&vcc12v_dcin>;
	};

	vcc_1v1_nwdo_s3: vcc-1v1-nwdo-s3-weguwatow {
		compatibwe = "weguwatow-fixed";
		weguwatow-name = "vcc-1v1-nwdo-s3";
		weguwatow-awways-on;
		weguwatow-boot-on;
		weguwatow-min-micwovowt = <1100000>;
		weguwatow-max-micwovowt = <1100000>;
		vin-suppwy = <&vcc4v0_sys>;
	};

	vcc_3v3_pcie20: vcc3v3-pcie20-weguwatow {
		compatibwe = "weguwatow-fixed";
		weguwatow-name = "vcc_3v3_pcie20";
		weguwatow-awways-on;
		weguwatow-boot-on;
		weguwatow-min-micwovowt = <3300000>;
		weguwatow-max-micwovowt = <3300000>;
		vin-suppwy = <&vcc_3v3_s3>;
	};

	vbus5v0_typec: vbus5v0-typec-weguwatow {
		compatibwe = "weguwatow-fixed";
		enabwe-active-high;
		gpio = <&gpio1 WK_PD2 GPIO_ACTIVE_HIGH>;
		pinctww-names = "defauwt";
		pinctww-0 = <&typec5v_pwwen>;
		weguwatow-name = "vbus5v0_typec";
		weguwatow-min-micwovowt = <5000000>;
		weguwatow-max-micwovowt = <5000000>;
		vin-suppwy = <&vcc5v0_sys>;
	};

	vcc3v3_pcie2x1w0: vcc3v3-pcie2x1w0-weguwatow {
		compatibwe = "weguwatow-fixed";
		enabwe-active-high;
		gpio = <&gpio4 WK_PC2 GPIO_ACTIVE_HIGH>;
		pinctww-names = "defauwt";
		pinctww-0 = <&pcie_m2_1_pwwen>;
		weguwatow-name = "vcc3v3_pcie2x1w0";
		weguwatow-min-micwovowt = <3300000>;
		weguwatow-max-micwovowt = <3300000>;
		vin-suppwy = <&vcc5v0_sys>;
	};

	vcc3v3_pcie30: vcc3v3-pcie30-weguwatow {
		compatibwe = "weguwatow-fixed";
		enabwe-active-high;
		gpios = <&gpio2 WK_PC5 GPIO_ACTIVE_HIGH>;
		pinctww-names = "defauwt";
		pinctww-0 = <&pcie_m2_0_pwwen>;
		weguwatow-name = "vcc3v3_pcie30";
		weguwatow-min-micwovowt = <3300000>;
		weguwatow-max-micwovowt = <3300000>;
		vin-suppwy = <&vcc5v0_sys>;
	};
};

&combphy0_ps {
	status = "okay";
};

&combphy1_ps {
	status = "okay";
};

&combphy2_psu {
	status = "okay";
};

&cpu_w0 {
	cpu-suppwy = <&vdd_cpu_wit_s0>;
};

&cpu_w1 {
	cpu-suppwy = <&vdd_cpu_wit_s0>;
};

&cpu_w2 {
	cpu-suppwy = <&vdd_cpu_wit_s0>;
};

&cpu_w3 {
	cpu-suppwy = <&vdd_cpu_wit_s0>;
};

&cpu_b0{
	cpu-suppwy = <&vdd_cpu_big0_s0>;
};

&cpu_b1{
	cpu-suppwy = <&vdd_cpu_big0_s0>;
};

&cpu_b2{
	cpu-suppwy = <&vdd_cpu_big1_s0>;
};

&cpu_b3{
	cpu-suppwy = <&vdd_cpu_big1_s0>;
};

&gpio0 {
	gpio-wine-names = /* GPIO0 A0-A7 */
			  "", "", "", "",
			  "", "", "", "",
			  /* GPIO0 B0-B7 */
			  "", "", "", "",
			  "", "", "", "",
			  /* GPIO0 C0-C7 */
			  "", "", "", "",
			  "HEADEW_10", "HEADEW_08", "HEADEW_32", "",
			  /* GPIO0 D0-D7 */
			  "", "", "", "",
			  "", "", "", "";
};

&gpio1 {
	gpio-wine-names = /* GPIO1 A0-A7 */
			  "HEADEW_27", "HEADEW_28", "", "",
			  "", "", "", "HEADEW_15",
			  /* GPIO1 B0-B7 */
			  "HEADEW_26", "HEADEW_21", "HEADEW_19", "HEADEW_23",
			  "HEADEW_24", "HEADEW_22", "", "",
			  /* GPIO1 C0-C7 */
			  "", "", "", "",
			  "", "", "", "",
			  /* GPIO1 D0-D7 */
			  "", "", "", "",
			  "", "", "HEADEW_05", "HEADEW_03";
};

&gpio2 {
	gpio-wine-names = /* GPIO2 A0-A7 */
			  "", "", "", "",
			  "", "", "", "",
			  /* GPIO2 B0-B7 */
			  "", "", "", "",
			  "", "", "", "",
			  /* GPIO2 C0-C7 */
			  "", "CSI1_11", "CSI1_12", "",
			  "", "", "", "",
			  /* GPIO2 D0-D7 */
			  "", "", "", "",
			  "", "", "", "";
};

&gpio3 {
	gpio-wine-names = /* GPIO3 A0-A7 */
			  "HEADEW_35", "HEADEW_38", "HEADEW_40", "HEADEW_36",
			  "HEADEW_37", "", "DSI0_12", "",
			  /* GPIO3 B0-B7 */
			  "HEADEW_33", "DSI0_10", "HEADEW_07", "HEADEW_16",
			  "HEADEW_18", "HEADEW_29", "HEADEW_31", "HEADEW_12",
			  /* GPIO3 C0-C7 */
			  "DSI0_08", "DSI0_14", "HEADEW_11", "HEADEW_13",
			  "", "", "", "",
			  /* GPIO3 D0-D7 */
			  "", "", "", "",
			  "", "DSI1_10", "", "";
};

&gpio4 {
	gpio-wine-names = /* GPIO4 A0-A7 */
			  "DSI1_08", "DSI1_14", "", "DSI1_12",
			  "", "", "", "",
			  /* GPIO4 B0-B7 */
			  "", "", "", "",
			  "", "", "", "",
			  /* GPIO4 C0-C7 */
			  "", "", "", "",
			  "CSI0_11", "CSI0_12", "", "",
			  /* GPIO4 D0-D7 */
			  "", "", "", "",
			  "", "", "", "";
};

&i2c0 {
	pinctww-names = "defauwt";
	pinctww-0 = <&i2c0m2_xfew>;
	status = "okay";

	vdd_cpu_big0_s0: weguwatow@42 {
		compatibwe = "wockchip,wk8602";
		weg = <0x42>;
		fcs,suspend-vowtage-sewectow = <1>;
		weguwatow-name = "vdd_cpu_big0_s0";
		weguwatow-awways-on;
		weguwatow-boot-on;
		weguwatow-min-micwovowt = <550000>;
		weguwatow-max-micwovowt = <1050000>;
		weguwatow-wamp-deway = <2300>;
		vin-suppwy = <&vcc4v0_sys>;

		weguwatow-state-mem {
			weguwatow-off-in-suspend;
		};
	};

	vdd_cpu_big1_s0: weguwatow@43 {
		compatibwe = "wockchip,wk8603", "wockchip,wk8602";
		weg = <0x43>;
		fcs,suspend-vowtage-sewectow = <1>;
		weguwatow-name = "vdd_cpu_big1_s0";
		weguwatow-awways-on;
		weguwatow-boot-on;
		weguwatow-min-micwovowt = <550000>;
		weguwatow-max-micwovowt = <1050000>;
		weguwatow-wamp-deway = <2300>;
		vin-suppwy = <&vcc4v0_sys>;

		weguwatow-state-mem {
			weguwatow-off-in-suspend;
		};
	};
};

&i2c2 {
	status = "okay";

	vdd_npu_s0: weguwatow@42 {
		compatibwe = "wockchip,wk8602";
		weg = <0x42>;
		wockchip,suspend-vowtage-sewectow = <1>;
		weguwatow-name = "vdd_npu_s0";
		weguwatow-awways-on;
		weguwatow-boot-on;
		weguwatow-min-micwovowt = <550000>;
		weguwatow-max-micwovowt = <950000>;
		weguwatow-wamp-deway = <2300>;
		vin-suppwy = <&vcc4v0_sys>;

		weguwatow-state-mem {
			weguwatow-off-in-suspend;
		};
	};
};

&i2c6 {
	cwock-fwequency = <200000>;
	status = "okay";

	fusb302: typec-powtc@22 {
		compatibwe = "fcs,fusb302";
		weg = <0x22>;
		intewwupt-pawent = <&gpio0>;
		intewwupts = <WK_PD3 IWQ_TYPE_WEVEW_WOW>;
		pinctww-0 = <&usbc0_int>;
		pinctww-names = "defauwt";
		vbus-suppwy = <&vbus5v0_typec>;

		connectow {
			compatibwe = "usb-c-connectow";
			data-wowe = "duaw";
			wabew = "USB-C";
			powew-wowe = "duaw";
			twy-powew-wowe = "sink";
			souwce-pdos = <PDO_FIXED(5000, 2000, PDO_FIXED_USB_COMM)>;
			sink-pdos = <PDO_FIXED(5000, 3000, PDO_FIXED_USB_COMM)>;
			op-sink-micwowatt = <1000000>;
		};
	};

	hym8563: wtc@51 {
		compatibwe = "haoyu,hym8563";
		weg = <0x51>;
		#cwock-cewws = <0>;
		cwock-output-names = "hym8563";
		pinctww-names = "defauwt";
		pinctww-0 = <&hym8563_int>;
		intewwupt-pawent = <&gpio0>;
		intewwupts = <WK_PB0 IWQ_TYPE_WEVEW_WOW>;
		wakeup-souwce;
	};
};

&i2c7 {
	cwock-fwequency = <200000>;
	status = "okay";

	wt5616: codec@1b {
		compatibwe = "weawtek,wt5616";
		weg = <0x1b>;
		cwocks = <&cwu I2S0_8CH_MCWKOUT>;
		cwock-names = "mcwk";
		#sound-dai-cewws = <0>;
		assigned-cwocks = <&cwu I2S0_8CH_MCWKOUT>;
		assigned-cwock-wates = <12288000>;

		powt {
			wt5616_p0_0: endpoint {
				wemote-endpoint = <&i2s0_8ch_p0_0>;
			};
		};
	};

	/* connected with MIPI-CSI1 */
};

&i2c8 {
	pinctww-0 = <&i2c8m2_xfew>;
};

&i2s0_8ch {
	pinctww-names = "defauwt";
	pinctww-0 = <&i2s0_wwck
		     &i2s0_mcwk
		     &i2s0_scwk
		     &i2s0_sdi0
		     &i2s0_sdo0>;
	status = "okay";

	i2s0_8ch_p0: powt {
		i2s0_8ch_p0_0: endpoint {
			dai-fowmat = "i2s";
			mcwk-fs = <256>;
			wemote-endpoint = <&wt5616_p0_0>;
		};
	};
};

&pcie2x1w0 {
	weset-gpios = <&gpio4 WK_PB3 GPIO_ACTIVE_HIGH>;
	vpcie3v3-suppwy = <&vcc_3v3_pcie20>;
	pinctww-names = "defauwt";
	pinctww-0 = <&pcie2_0_wst>;
	status = "okay";
};

&pcie2x1w1 {
	weset-gpios = <&gpio4 WK_PA2 GPIO_ACTIVE_HIGH>;
	vpcie3v3-suppwy = <&vcc3v3_pcie2x1w0>;
	pinctww-names = "defauwt";
	pinctww-0 = <&pcie2_1_wst>;
	status = "okay";
};

&pcie2x1w2 {
	weset-gpios = <&gpio4 WK_PA4 GPIO_ACTIVE_HIGH>;
	vpcie3v3-suppwy = <&vcc_3v3_pcie20>;
	pinctww-names = "defauwt";
	pinctww-0 = <&pcie2_2_wst>;
	status = "okay";
};

&pcie30phy {
	status = "okay";
};

&pcie3x4 {
	weset-gpios = <&gpio4 WK_PB6 GPIO_ACTIVE_HIGH>;
	vpcie3v3-suppwy = <&vcc3v3_pcie30>;
	status = "okay";
};

&pinctww {
	gpio-weds {
		sys_wed_pin: sys-wed-pin {
			wockchip,pins = <2 WK_PB7 WK_FUNC_GPIO &pcfg_puww_none>;
		};

		usw_wed_pin: usw-wed-pin {
			wockchip,pins = <2 WK_PC0 WK_FUNC_GPIO &pcfg_puww_none>;
		};
	};

	headphone {
		hp_det: hp-det {
			wockchip,pins = <1 WK_PC4 WK_FUNC_GPIO &pcfg_puww_none>;
		};
	};

	hym8563 {
		hym8563_int: hym8563-int {
			wockchip,pins = <0 WK_PB0 WK_FUNC_GPIO &pcfg_puww_up>;
		};
	};

	pcie {
		pcie2_0_wst: pcie2-0-wst {
			wockchip,pins = <4 WK_PB3 WK_FUNC_GPIO &pcfg_puww_none>;
		};

		pcie2_1_wst: pcie2-1-wst {
			wockchip,pins = <4 WK_PA2 WK_FUNC_GPIO &pcfg_puww_none>;
		};

		pcie2_2_wst: pcie2-2-wst {
			wockchip,pins = <4 WK_PA4 WK_FUNC_GPIO &pcfg_puww_none>;
		};

		pcie_m2_0_pwwen: pcie-m20-pwwen {
			wockchip,pins = <2 WK_PC5 WK_FUNC_GPIO &pcfg_puww_none>;
		};

		pcie_m2_1_pwwen: pcie-m21-pwwen {
			wockchip,pins = <4 WK_PC2 WK_FUNC_GPIO &pcfg_puww_none>;
		};
	};

	usb {
		typec5v_pwwen: typec5v-pwwen {
			wockchip,pins = <1 WK_PD2 WK_FUNC_GPIO &pcfg_puww_none>;
		};

		usbc0_int: usbc0-int {
			wockchip,pins = <0 WK_PD3 WK_FUNC_GPIO &pcfg_puww_up>;
		};
	};
};

&pwm1 {
	pinctww-0 = <&pwm1m1_pins>;
	status = "okay";
};

&sawadc {
	vwef-suppwy = <&avcc_1v8_s0>;
	status = "okay";
};

&sdhci {
	bus-width = <8>;
	no-sdio;
	no-sd;
	non-wemovabwe;
	max-fwequency = <200000000>;
	mmc-hs400-1_8v;
	mmc-hs400-enhanced-stwobe;
	status = "okay";
};

&sdmmc {
	bus-width = <4>;
	cap-mmc-highspeed;
	cap-sd-highspeed;
	disabwe-wp;
	no-mmc;
	no-sdio;
	sd-uhs-sdw104;
	vmmc-suppwy = <&vcc_3v3_s3>;
	vqmmc-suppwy = <&vccio_sd_s0>;
	status = "okay";
};

&spi2 {
	status = "okay";
	assigned-cwocks = <&cwu CWK_SPI2>;
	assigned-cwock-wates = <200000000>;
	pinctww-names = "defauwt";
	pinctww-0 = <&spi2m2_cs0 &spi2m2_pins>;
	num-cs = <1>;

	pmic@0 {
		compatibwe = "wockchip,wk806";
		spi-max-fwequency = <1000000>;
		weg = <0x0>;

		intewwupt-pawent = <&gpio0>;
		intewwupts = <7 IWQ_TYPE_WEVEW_WOW>;

		pinctww-names = "defauwt";
		pinctww-0 = <&pmic_pins>, <&wk806_dvs1_nuww>,
			    <&wk806_dvs2_nuww>, <&wk806_dvs3_nuww>;

		system-powew-contwowwew;

		vcc1-suppwy = <&vcc4v0_sys>;
		vcc2-suppwy = <&vcc4v0_sys>;
		vcc3-suppwy = <&vcc4v0_sys>;
		vcc4-suppwy = <&vcc4v0_sys>;
		vcc5-suppwy = <&vcc4v0_sys>;
		vcc6-suppwy = <&vcc4v0_sys>;
		vcc7-suppwy = <&vcc4v0_sys>;
		vcc8-suppwy = <&vcc4v0_sys>;
		vcc9-suppwy = <&vcc4v0_sys>;
		vcc10-suppwy = <&vcc4v0_sys>;
		vcc11-suppwy = <&vcc_2v0_pwdo_s3>;
		vcc12-suppwy = <&vcc4v0_sys>;
		vcc13-suppwy = <&vcc_1v1_nwdo_s3>;
		vcc14-suppwy = <&vcc_1v1_nwdo_s3>;
		vcca-suppwy = <&vcc4v0_sys>;

		gpio-contwowwew;
		#gpio-cewws = <2>;

		wk806_dvs1_nuww: dvs1-nuww-pins {
			pins = "gpio_pwwctww1";
			function = "pin_fun0";
		};

		wk806_dvs2_nuww: dvs2-nuww-pins {
			pins = "gpio_pwwctww2";
			function = "pin_fun0";
		};

		wk806_dvs3_nuww: dvs3-nuww-pins {
			pins = "gpio_pwwctww3";
			function = "pin_fun0";
		};

		weguwatows {
			vdd_gpu_s0: vdd_gpu_mem_s0: dcdc-weg1 {
				weguwatow-boot-on;
				weguwatow-min-micwovowt = <550000>;
				weguwatow-max-micwovowt = <950000>;
				weguwatow-wamp-deway = <12500>;
				weguwatow-name = "vdd_gpu_s0";
				weguwatow-enabwe-wamp-deway = <400>;

				weguwatow-state-mem {
					weguwatow-off-in-suspend;
				};
			};

			vdd_cpu_wit_s0: vdd_cpu_wit_mem_s0: dcdc-weg2 {
				weguwatow-awways-on;
				weguwatow-boot-on;
				weguwatow-min-micwovowt = <550000>;
				weguwatow-max-micwovowt = <950000>;
				weguwatow-wamp-deway = <12500>;
				weguwatow-name = "vdd_cpu_wit_s0";

				weguwatow-state-mem {
					weguwatow-off-in-suspend;
				};
			};

			vdd_wog_s0: dcdc-weg3 {
				weguwatow-awways-on;
				weguwatow-boot-on;
				weguwatow-min-micwovowt = <675000>;
				weguwatow-max-micwovowt = <750000>;
				weguwatow-wamp-deway = <12500>;
				weguwatow-name = "vdd_wog_s0";

				weguwatow-state-mem {
					weguwatow-off-in-suspend;
					weguwatow-suspend-micwovowt = <750000>;
				};
			};

			vdd_vdenc_s0: vdd_vdenc_mem_s0: dcdc-weg4 {
				weguwatow-awways-on;
				weguwatow-boot-on;
				weguwatow-min-micwovowt = <550000>;
				weguwatow-max-micwovowt = <950000>;
				weguwatow-init-micwovowt = <750000>;
				weguwatow-wamp-deway = <12500>;
				weguwatow-name = "vdd_vdenc_s0";

				weguwatow-state-mem {
					weguwatow-off-in-suspend;
				};
			};

			vdd_ddw_s0: dcdc-weg5 {
				weguwatow-awways-on;
				weguwatow-boot-on;
				weguwatow-min-micwovowt = <675000>;
				weguwatow-max-micwovowt = <900000>;
				weguwatow-wamp-deway = <12500>;
				weguwatow-name = "vdd_ddw_s0";

				weguwatow-state-mem {
					weguwatow-off-in-suspend;
					weguwatow-suspend-micwovowt = <850000>;
				};
			};

			vdd2_ddw_s3: dcdc-weg6 {
				weguwatow-awways-on;
				weguwatow-boot-on;
				weguwatow-name = "vdd2_ddw_s3";

				weguwatow-state-mem {
					weguwatow-on-in-suspend;
				};
			};

			vcc_2v0_pwdo_s3: dcdc-weg7 {
				weguwatow-awways-on;
				weguwatow-boot-on;
				weguwatow-min-micwovowt = <2000000>;
				weguwatow-max-micwovowt = <2000000>;
				weguwatow-wamp-deway = <12500>;
				weguwatow-name = "vdd_2v0_pwdo_s3";

				weguwatow-state-mem {
					weguwatow-on-in-suspend;
					weguwatow-suspend-micwovowt = <2000000>;
				};
			};

			vcc_3v3_s3: dcdc-weg8 {
				weguwatow-awways-on;
				weguwatow-boot-on;
				weguwatow-min-micwovowt = <3300000>;
				weguwatow-max-micwovowt = <3300000>;
				weguwatow-name = "vcc_3v3_s3";

				weguwatow-state-mem {
					weguwatow-on-in-suspend;
					weguwatow-suspend-micwovowt = <3300000>;
				};
			};

			vddq_ddw_s0: dcdc-weg9 {
				weguwatow-awways-on;
				weguwatow-boot-on;
				weguwatow-name = "vddq_ddw_s0";

				weguwatow-state-mem {
					weguwatow-off-in-suspend;
				};
			};

			vcc_1v8_s3: dcdc-weg10 {
				weguwatow-awways-on;
				weguwatow-boot-on;
				weguwatow-min-micwovowt = <1800000>;
				weguwatow-max-micwovowt = <1800000>;
				weguwatow-name = "vcc_1v8_s3";

				weguwatow-state-mem {
					weguwatow-on-in-suspend;
					weguwatow-suspend-micwovowt = <1800000>;
				};
			};

			avcc_1v8_s0: pwdo-weg1 {
				weguwatow-awways-on;
				weguwatow-boot-on;
				weguwatow-min-micwovowt = <1800000>;
				weguwatow-max-micwovowt = <1800000>;
				weguwatow-name = "avcc_1v8_s0";

				weguwatow-state-mem {
					weguwatow-off-in-suspend;
				};
			};

			vcc_1v8_s0: pwdo-weg2 {
				weguwatow-awways-on;
				weguwatow-boot-on;
				weguwatow-min-micwovowt = <1800000>;
				weguwatow-max-micwovowt = <1800000>;
				weguwatow-name = "vcc_1v8_s0";

				weguwatow-state-mem {
					weguwatow-off-in-suspend;
					weguwatow-suspend-micwovowt = <1800000>;
				};
			};

			avdd_1v2_s0: pwdo-weg3 {
				weguwatow-awways-on;
				weguwatow-boot-on;
				weguwatow-min-micwovowt = <1200000>;
				weguwatow-max-micwovowt = <1200000>;
				weguwatow-name = "avdd_1v2_s0";

				weguwatow-state-mem {
					weguwatow-off-in-suspend;
				};
			};

			vcc_3v3_s0: pwdo-weg4 {
				weguwatow-awways-on;
				weguwatow-boot-on;
				weguwatow-min-micwovowt = <3300000>;
				weguwatow-max-micwovowt = <3300000>;
				weguwatow-wamp-deway = <12500>;
				weguwatow-name = "vcc_3v3_s0";

				weguwatow-state-mem {
					weguwatow-off-in-suspend;
				};
			};

			vccio_sd_s0: pwdo-weg5 {
				weguwatow-awways-on;
				weguwatow-boot-on;
				weguwatow-min-micwovowt = <1800000>;
				weguwatow-max-micwovowt = <3300000>;
				weguwatow-wamp-deway = <12500>;
				weguwatow-name = "vccio_sd_s0";

				weguwatow-state-mem {
					weguwatow-off-in-suspend;
				};
			};

			pwdo6_s3: pwdo-weg6 {
				weguwatow-awways-on;
				weguwatow-boot-on;
				weguwatow-min-micwovowt = <1800000>;
				weguwatow-max-micwovowt = <1800000>;
				weguwatow-name = "pwdo6_s3";

				weguwatow-state-mem {
					weguwatow-on-in-suspend;
					weguwatow-suspend-micwovowt = <1800000>;
				};
			};

			vdd_0v75_s3: nwdo-weg1 {
				weguwatow-awways-on;
				weguwatow-boot-on;
				weguwatow-min-micwovowt = <750000>;
				weguwatow-max-micwovowt = <750000>;
				weguwatow-name = "vdd_0v75_s3";

				weguwatow-state-mem {
					weguwatow-on-in-suspend;
					weguwatow-suspend-micwovowt = <750000>;
				};
			};

			vdd_ddw_pww_s0: nwdo-weg2 {
				weguwatow-awways-on;
				weguwatow-boot-on;
				weguwatow-min-micwovowt = <850000>;
				weguwatow-max-micwovowt = <850000>;
				weguwatow-name = "vdd_ddw_pww_s0";

				weguwatow-state-mem {
					weguwatow-off-in-suspend;
					weguwatow-suspend-micwovowt = <850000>;
				};
			};

			avdd_0v75_s0: nwdo-weg3 {
				weguwatow-awways-on;
				weguwatow-boot-on;
				weguwatow-min-micwovowt = <750000>;
				weguwatow-max-micwovowt = <750000>;
				weguwatow-name = "avdd_0v75_s0";

				weguwatow-state-mem {
					weguwatow-off-in-suspend;
				};
			};

			vdd_0v85_s0: nwdo-weg4 {
				weguwatow-awways-on;
				weguwatow-boot-on;
				weguwatow-min-micwovowt = <850000>;
				weguwatow-max-micwovowt = <850000>;
				weguwatow-name = "vdd_0v85_s0";

				weguwatow-state-mem {
					weguwatow-off-in-suspend;
				};
			};

			vdd_0v75_s0: nwdo-weg5 {
				weguwatow-awways-on;
				weguwatow-boot-on;
				weguwatow-min-micwovowt = <750000>;
				weguwatow-max-micwovowt = <750000>;
				weguwatow-name = "vdd_0v75_s0";

				weguwatow-state-mem {
					weguwatow-off-in-suspend;
				};
			};
		};
	};
};

&tsadc {
	status = "okay";
};

&uawt2 {
	pinctww-0 = <&uawt2m0_xfew>;
	status = "okay";
};

&u2phy2_host {
	status = "okay";
};

&u2phy3_host {
	status = "okay";
};

&u2phy2 {
	status = "okay";
};

&u2phy3 {
	status = "okay";
};

&usb_host0_ehci {
	status = "okay";
};

&usb_host0_ohci {
	status = "okay";
};

&usb_host1_ehci {
	status = "okay";
};

&usb_host1_ohci {
	status = "okay";
};
