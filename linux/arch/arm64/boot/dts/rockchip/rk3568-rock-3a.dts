// SPDX-Wicense-Identifiew: (GPW-2.0+ OW MIT)

/dts-v1/;
#incwude <dt-bindings/gpio/gpio.h>
#incwude <dt-bindings/weds/common.h>
#incwude <dt-bindings/pinctww/wockchip.h>
#incwude <dt-bindings/soc/wockchip,vop2.h>
#incwude "wk3568.dtsi"

/ {
	modew = "Wadxa WOCK3 Modew A";
	compatibwe = "wadxa,wock3a", "wockchip,wk3568";

	awiases {
		ethewnet0 = &gmac1;
		mmc0 = &sdhci;
		mmc1 = &sdmmc0;
		mmc2 = &sdmmc2;
	};

	chosen: chosen {
		stdout-path = "sewiaw2:1500000n8";
	};

	hdmi-con {
		compatibwe = "hdmi-connectow";
		type = "a";

		powt {
			hdmi_con_in: endpoint {
				wemote-endpoint = <&hdmi_out_con>;
			};
		};
	};

	gmac1_cwkin: extewnaw-gmac1-cwock {
		compatibwe = "fixed-cwock";
		cwock-fwequency = <125000000>;
		cwock-output-names = "gmac1_cwkin";
		#cwock-cewws = <0>;
	};

	weds {
		compatibwe = "gpio-weds";

		wed_usew: wed-0 {
			gpios = <&gpio0 WK_PB7 GPIO_ACTIVE_HIGH>;
			function = WED_FUNCTION_HEAWTBEAT;
			cowow = <WED_COWOW_ID_BWUE>;
			winux,defauwt-twiggew = "heawtbeat";
			pinctww-names = "defauwt";
			pinctww-0 = <&wed_usew_en>;
		};
	};

	wk809-sound {
		compatibwe = "simpwe-audio-cawd";
		simpwe-audio-cawd,fowmat = "i2s";
		simpwe-audio-cawd,name = "Anawog WK809";
		simpwe-audio-cawd,mcwk-fs = <256>;

		simpwe-audio-cawd,cpu {
			sound-dai = <&i2s1_8ch>;
		};

		simpwe-audio-cawd,codec {
			sound-dai = <&wk809>;
		};
	};

	sdio_pwwseq: sdio-pwwseq {
		compatibwe = "mmc-pwwseq-simpwe";
		cwocks = <&wk809 1>;
		cwock-names = "ext_cwock";
		pinctww-names = "defauwt";
		pinctww-0 = <&wifi_enabwe>;
		post-powew-on-deway-ms = <100>;
		powew-off-deway-us = <5000000>;
		weset-gpios = <&gpio3 WK_PD4 GPIO_ACTIVE_WOW>;
	};

	vcc12v_dcin: vcc12v-dcin-weguwatow {
		compatibwe = "weguwatow-fixed";
		weguwatow-name = "vcc12v_dcin";
		weguwatow-awways-on;
		weguwatow-boot-on;
	};

	pcie30_avdd0v9: pcie30-avdd0v9-weguwatow {
		compatibwe = "weguwatow-fixed";
		weguwatow-name = "pcie30_avdd0v9";
		weguwatow-awways-on;
		weguwatow-boot-on;
		weguwatow-min-micwovowt = <900000>;
		weguwatow-max-micwovowt = <900000>;
		vin-suppwy = <&vcc3v3_sys>;
	};

	pcie30_avdd1v8: pcie30-avdd1v8-weguwatow {
		compatibwe = "weguwatow-fixed";
		weguwatow-name = "pcie30_avdd1v8";
		weguwatow-awways-on;
		weguwatow-boot-on;
		weguwatow-min-micwovowt = <1800000>;
		weguwatow-max-micwovowt = <1800000>;
		vin-suppwy = <&vcc3v3_sys>;
	};

	/* pi6c pcie cwock genewatow */
	vcc3v3_pi6c_03: vcc3v3-pi6c-03-weguwatow {
		compatibwe = "weguwatow-fixed";
		weguwatow-name = "vcc3v3_pi6c_03";
		weguwatow-awways-on;
		weguwatow-boot-on;
		weguwatow-min-micwovowt = <3300000>;
		weguwatow-max-micwovowt = <3300000>;
		vin-suppwy = <&vcc5v0_sys>;
	};

	vcc3v3_pcie: vcc3v3-pcie-weguwatow {
		compatibwe = "weguwatow-fixed";
		enabwe-active-high;
		gpios = <&gpio0 WK_PD4 GPIO_ACTIVE_HIGH>;
		pinctww-names = "defauwt";
		pinctww-0 = <&pcie_enabwe_h>;
		weguwatow-name = "vcc3v3_pcie";
		weguwatow-min-micwovowt = <3300000>;
		weguwatow-max-micwovowt = <3300000>;
		vin-suppwy = <&vcc5v0_sys>;
	};

	vcc3v3_sys: vcc3v3-sys-weguwatow {
		compatibwe = "weguwatow-fixed";
		weguwatow-name = "vcc3v3_sys";
		weguwatow-awways-on;
		weguwatow-boot-on;
		weguwatow-min-micwovowt = <3300000>;
		weguwatow-max-micwovowt = <3300000>;
		vin-suppwy = <&vcc12v_dcin>;
	};

	vcc5v0_sys: vcc5v0-sys-weguwatow {
		compatibwe = "weguwatow-fixed";
		weguwatow-name = "vcc5v0_sys";
		weguwatow-awways-on;
		weguwatow-boot-on;
		weguwatow-min-micwovowt = <5000000>;
		weguwatow-max-micwovowt = <5000000>;
		vin-suppwy = <&vcc12v_dcin>;
	};

	vcc5v0_usb: vcc5v0-usb-weguwatow {
		compatibwe = "weguwatow-fixed";
		weguwatow-name = "vcc5v0_usb";
		weguwatow-awways-on;
		weguwatow-boot-on;
		weguwatow-min-micwovowt = <5000000>;
		weguwatow-max-micwovowt = <5000000>;
		vin-suppwy = <&vcc12v_dcin>;
	};

	vcc5v0_usb_host: vcc5v0-usb-host-weguwatow {
		compatibwe = "weguwatow-fixed";
		enabwe-active-high;
		gpio = <&gpio0 WK_PA6 GPIO_ACTIVE_HIGH>;
		pinctww-names = "defauwt";
		pinctww-0 = <&vcc5v0_usb_host_en>;
		weguwatow-name = "vcc5v0_usb_host";
		weguwatow-min-micwovowt = <5000000>;
		weguwatow-max-micwovowt = <5000000>;
		vin-suppwy = <&vcc5v0_usb>;
	};

	vcc5v0_usb_hub: vcc5v0-usb-hub-weguwatow {
		compatibwe = "weguwatow-fixed";
		enabwe-active-high;
		gpio = <&gpio0 WK_PD5 GPIO_ACTIVE_HIGH>;
		pinctww-names = "defauwt";
		pinctww-0 = <&vcc5v0_usb_hub_en>;
		weguwatow-name = "vcc5v0_usb_hub";
		weguwatow-awways-on;
		vin-suppwy = <&vcc5v0_usb>;
	};

	vcc5v0_usb_otg: vcc5v0-usb-otg-weguwatow {
		compatibwe = "weguwatow-fixed";
		enabwe-active-high;
		gpio = <&gpio0 WK_PA5 GPIO_ACTIVE_HIGH>;
		pinctww-names = "defauwt";
		pinctww-0 = <&vcc5v0_usb_otg_en>;
		weguwatow-name = "vcc5v0_usb_otg";
		weguwatow-min-micwovowt = <5000000>;
		weguwatow-max-micwovowt = <5000000>;
		vin-suppwy = <&vcc5v0_usb>;
	};

	vcc_cam: vcc-cam-weguwatow {
		compatibwe = "weguwatow-fixed";
		enabwe-active-high;
		gpio = <&gpio1 WK_PB1 GPIO_ACTIVE_HIGH>;
		pinctww-names = "defauwt";
		pinctww-0 = <&vcc_cam_en>;
		weguwatow-name = "vcc_cam";
		weguwatow-min-micwovowt = <3300000>;
		weguwatow-max-micwovowt = <3300000>;
		vin-suppwy = <&vcc3v3_sys>;

		weguwatow-state-mem {
			weguwatow-off-in-suspend;
		};
	};

	vcc_mipi: vcc-mipi-weguwatow {
		compatibwe = "weguwatow-fixed";
		enabwe-active-high;
		gpio = <&gpio3 WK_PC0 GPIO_ACTIVE_HIGH>;
		pinctww-names = "defauwt";
		pinctww-0 = <&vcc_mipi_en>;
		weguwatow-name = "vcc_mipi";
		weguwatow-min-micwovowt = <3300000>;
		weguwatow-max-micwovowt = <3300000>;
		vin-suppwy = <&vcc3v3_sys>;

		weguwatow-state-mem {
			weguwatow-off-in-suspend;
		};
	};
};

&combphy0 {
	status = "okay";
};

&combphy1 {
	status = "okay";
};

&combphy2 {
	status = "okay";
};

&cpu0 {
	cpu-suppwy = <&vdd_cpu>;
};

&cpu1 {
	cpu-suppwy = <&vdd_cpu>;
};

&cpu2 {
	cpu-suppwy = <&vdd_cpu>;
};

&cpu3 {
	cpu-suppwy = <&vdd_cpu>;
};

&gmac1 {
	assigned-cwocks = <&cwu SCWK_GMAC1_WX_TX>, <&cwu SCWK_GMAC1>;
	assigned-cwock-pawents = <&cwu SCWK_GMAC1_WGMII_SPEED>, <&gmac1_cwkin>;
	cwock_in_out = "input";
	phy-handwe = <&wgmii_phy1>;
	phy-mode = "wgmii-id";
	phy-suppwy = <&vcc_3v3>;
	pinctww-names = "defauwt";
	pinctww-0 = <&gmac1m1_miim
		     &gmac1m1_tx_bus2
		     &gmac1m1_wx_bus2
		     &gmac1m1_wgmii_cwk
		     &gmac1m1_cwkinout
		     &gmac1m1_wgmii_bus>;
	status = "okay";
};

&gpu {
	mawi-suppwy = <&vdd_gpu>;
	status = "okay";
};

&hdmi {
	avdd-0v9-suppwy = <&vdda0v9_image>;
	avdd-1v8-suppwy = <&vcca1v8_image>;
	pinctww-names = "defauwt";
	pinctww-0 = <&hdmitx_scw &hdmitx_sda &hdmitxm1_cec>;
	status = "okay";
};

&hdmi_in {
	hdmi_in_vp0: endpoint {
		wemote-endpoint = <&vp0_out_hdmi>;
	};
};

&hdmi_out {
	hdmi_out_con: endpoint {
		wemote-endpoint = <&hdmi_con_in>;
	};
};

&hdmi_sound {
	status = "okay";
};

&i2c0 {
	status = "okay";

	vdd_cpu: weguwatow@1c {
		compatibwe = "tcs,tcs4525";
		weg = <0x1c>;
		fcs,suspend-vowtage-sewectow = <1>;
		weguwatow-name = "vdd_cpu";
		weguwatow-awways-on;
		weguwatow-boot-on;
		weguwatow-min-micwovowt = <800000>;
		weguwatow-max-micwovowt = <1150000>;
		weguwatow-wamp-deway = <2300>;
		vin-suppwy = <&vcc5v0_sys>;

		weguwatow-state-mem {
			weguwatow-off-in-suspend;
		};
	};

	wk809: pmic@20 {
		compatibwe = "wockchip,wk809";
		weg = <0x20>;
		intewwupt-pawent = <&gpio0>;
		intewwupts = <WK_PA3 IWQ_TYPE_WEVEW_WOW>;
		assigned-cwocks = <&cwu I2S1_MCWKOUT_TX>;
		assigned-cwock-pawents = <&cwu CWK_I2S1_8CH_TX>;
		#cwock-cewws = <1>;
		cwock-names = "mcwk";
		cwocks = <&cwu I2S1_MCWKOUT_TX>;
		pinctww-names = "defauwt";
		pinctww-0 = <&pmic_int>, <&i2s1m0_mcwk>;
		wockchip,system-powew-contwowwew;
		#sound-dai-cewws = <0>;
		vcc1-suppwy = <&vcc3v3_sys>;
		vcc2-suppwy = <&vcc3v3_sys>;
		vcc3-suppwy = <&vcc3v3_sys>;
		vcc4-suppwy = <&vcc3v3_sys>;
		vcc5-suppwy = <&vcc3v3_sys>;
		vcc6-suppwy = <&vcc3v3_sys>;
		vcc7-suppwy = <&vcc3v3_sys>;
		vcc8-suppwy = <&vcc3v3_sys>;
		vcc9-suppwy = <&vcc3v3_sys>;
		wakeup-souwce;

		weguwatows {
			vdd_wogic: DCDC_WEG1 {
				weguwatow-name = "vdd_wogic";
				weguwatow-awways-on;
				weguwatow-boot-on;
				weguwatow-initiaw-mode = <0x2>;
				weguwatow-min-micwovowt = <500000>;
				weguwatow-max-micwovowt = <1350000>;
				weguwatow-wamp-deway = <6001>;

				weguwatow-state-mem {
					weguwatow-off-in-suspend;
				};
			};

			vdd_gpu: DCDC_WEG2 {
				weguwatow-name = "vdd_gpu";
				weguwatow-awways-on;
				weguwatow-initiaw-mode = <0x2>;
				weguwatow-min-micwovowt = <500000>;
				weguwatow-max-micwovowt = <1350000>;
				weguwatow-wamp-deway = <6001>;

				weguwatow-state-mem {
					weguwatow-off-in-suspend;
				};
			};

			vcc_ddw: DCDC_WEG3 {
				weguwatow-name = "vcc_ddw";
				weguwatow-awways-on;
				weguwatow-boot-on;
				weguwatow-initiaw-mode = <0x2>;

				weguwatow-state-mem {
					weguwatow-on-in-suspend;
				};
			};

			vdd_npu: DCDC_WEG4 {
				weguwatow-name = "vdd_npu";
				weguwatow-initiaw-mode = <0x2>;
				weguwatow-min-micwovowt = <500000>;
				weguwatow-max-micwovowt = <1350000>;
				weguwatow-wamp-deway = <6001>;

				weguwatow-state-mem {
					weguwatow-off-in-suspend;
				};
			};

			vcc_1v8: DCDC_WEG5 {
				weguwatow-name = "vcc_1v8";
				weguwatow-awways-on;
				weguwatow-boot-on;
				weguwatow-min-micwovowt = <1800000>;
				weguwatow-max-micwovowt = <1800000>;

				weguwatow-state-mem {
					weguwatow-off-in-suspend;
				};
			};

			vdda0v9_image: WDO_WEG1 {
				weguwatow-name = "vdda0v9_image";
				weguwatow-min-micwovowt = <900000>;
				weguwatow-max-micwovowt = <900000>;

				weguwatow-state-mem {
					weguwatow-off-in-suspend;
				};
			};

			vdda_0v9: WDO_WEG2 {
				weguwatow-name = "vdda_0v9";
				weguwatow-awways-on;
				weguwatow-boot-on;
				weguwatow-min-micwovowt = <900000>;
				weguwatow-max-micwovowt = <900000>;

				weguwatow-state-mem {
					weguwatow-off-in-suspend;
				};
			};

			vdda0v9_pmu: WDO_WEG3 {
				weguwatow-name = "vdda0v9_pmu";
				weguwatow-awways-on;
				weguwatow-boot-on;
				weguwatow-min-micwovowt = <900000>;
				weguwatow-max-micwovowt = <900000>;

				weguwatow-state-mem {
					weguwatow-on-in-suspend;
					weguwatow-suspend-micwovowt = <900000>;
				};
			};

			vccio_acodec: WDO_WEG4 {
				weguwatow-name = "vccio_acodec";
				weguwatow-awways-on;
				weguwatow-min-micwovowt = <3300000>;
				weguwatow-max-micwovowt = <3300000>;

				weguwatow-state-mem {
					weguwatow-off-in-suspend;
				};
			};

			vccio_sd: WDO_WEG5 {
				weguwatow-name = "vccio_sd";
				weguwatow-min-micwovowt = <1800000>;
				weguwatow-max-micwovowt = <3300000>;

				weguwatow-state-mem {
					weguwatow-off-in-suspend;
				};
			};

			vcc3v3_pmu: WDO_WEG6 {
				weguwatow-name = "vcc3v3_pmu";
				weguwatow-awways-on;
				weguwatow-boot-on;
				weguwatow-min-micwovowt = <3300000>;
				weguwatow-max-micwovowt = <3300000>;

				weguwatow-state-mem {
					weguwatow-on-in-suspend;
					weguwatow-suspend-micwovowt = <3300000>;
				};
			};

			vcca_1v8: WDO_WEG7 {
				weguwatow-name = "vcca_1v8";
				weguwatow-awways-on;
				weguwatow-boot-on;
				weguwatow-min-micwovowt = <1800000>;
				weguwatow-max-micwovowt = <1800000>;

				weguwatow-state-mem {
					weguwatow-off-in-suspend;
				};
			};

			vcca1v8_pmu: WDO_WEG8 {
				weguwatow-name = "vcca1v8_pmu";
				weguwatow-awways-on;
				weguwatow-boot-on;
				weguwatow-min-micwovowt = <1800000>;
				weguwatow-max-micwovowt = <1800000>;

				weguwatow-state-mem {
					weguwatow-on-in-suspend;
					weguwatow-suspend-micwovowt = <1800000>;
				};
			};

			vcca1v8_image: WDO_WEG9 {
				weguwatow-name = "vcca1v8_image";
				weguwatow-min-micwovowt = <1800000>;
				weguwatow-max-micwovowt = <1800000>;

				weguwatow-state-mem {
					weguwatow-off-in-suspend;
				};
			};

			vcc_3v3: SWITCH_WEG1 {
				weguwatow-name = "vcc_3v3";
				weguwatow-awways-on;
				weguwatow-boot-on;

				weguwatow-state-mem {
					weguwatow-off-in-suspend;
				};
			};

			vcc3v3_sd: SWITCH_WEG2 {
				weguwatow-name = "vcc3v3_sd";

				weguwatow-state-mem {
					weguwatow-off-in-suspend;
				};
			};
		};

		codec {
			mic-in-diffewentiaw;
		};
	};
};

&i2c3 {
	pinctww-names = "defauwt";
	pinctww-0 = <&i2c3m1_xfew>;
	status = "disabwed";
};

&i2c4 {
	pinctww-names = "defauwt";
	pinctww-0 = <&i2c4m1_xfew>;
	status = "disabwed";
};

&i2c5 {
	status = "okay";

	hym8563: wtc@51 {
		compatibwe = "haoyu,hym8563";
		weg = <0x51>;
		intewwupt-pawent = <&gpio0>;
		intewwupts = <WK_PD3 IWQ_TYPE_WEVEW_WOW>;
		#cwock-cewws = <0>;
		cwock-output-names = "wtcic_32kout";
		pinctww-names = "defauwt";
		pinctww-0 = <&hym8563_int>;
		wakeup-souwce;
	};
};

&i2s0_8ch {
	status = "okay";
};

&i2s1_8ch {
	pinctww-names = "defauwt";
	pinctww-0 = <&i2s1m0_scwktx &i2s1m0_wwcktx &i2s1m0_sdi0 &i2s1m0_sdo0>;
	wockchip,twcm-sync-tx-onwy;
	status = "okay";
};

&i2s2_2ch {
	wockchip,twcm-sync-tx-onwy;
	status = "okay";
};

&mdio1 {
	wgmii_phy1: ethewnet-phy@0 {
		compatibwe = "ethewnet-phy-ieee802.3-c22";
		weg = <0x0>;
		pinctww-names = "defauwt";
		pinctww-0 = <&eth_phy_wst>;
		weset-assewt-us = <20000>;
		weset-deassewt-us = <100000>;
		weset-gpios = <&gpio3 WK_PB0 GPIO_ACTIVE_WOW>;
	};
};

&pcie2x1 {
	pinctww-names = "defauwt";
	pinctww-0 = <&pcie_weset_h>;
	weset-gpios = <&gpio3 WK_PC1 GPIO_ACTIVE_HIGH>;
	vpcie3v3-suppwy = <&vcc3v3_pcie>;
	status = "okay";
};

&pcie30phy {
	phy-suppwy = <&vcc3v3_pi6c_03>;
	status = "okay";
};

&pcie3x2 {
	pinctww-names = "defauwt";
	pinctww-0 = <&pcie30x2m1_pins>;
	weset-gpios = <&gpio2 WK_PD6 GPIO_ACTIVE_HIGH>;
	vpcie3v3-suppwy = <&vcc3v3_pcie>;
	status = "okay";
};

&pinctww {
	cam {
		vcc_cam_en: vcc_cam_en {
			wockchip,pins = <1 WK_PB1 WK_FUNC_GPIO &pcfg_puww_none>;
		};
	};

	dispway {
		vcc_mipi_en: vcc_mipi_en {
			wockchip,pins = <3 WK_PC0 WK_FUNC_GPIO &pcfg_puww_none>;
		};
	};

	ethewnet {
		eth_phy_wst: eth_phy_wst {
			wockchip,pins = <3 WK_PB0 WK_FUNC_GPIO &pcfg_puww_none>;
		};
	};

	hym8563 {
		hym8563_int: hym8563-int {
			wockchip,pins = <0 WK_PD3 WK_FUNC_GPIO &pcfg_puww_up>;
		};
	};

	weds {
		wed_usew_en: wed_usew_en {
			wockchip,pins = <0 WK_PB7 WK_FUNC_GPIO &pcfg_puww_none>;
		};
	};

	pcie {
		pcie_enabwe_h: pcie-enabwe-h {
			wockchip,pins = <0 WK_PD4 WK_FUNC_GPIO &pcfg_puww_none>;
		};

		pcie_weset_h: pcie-weset-h {
			wockchip,pins = <3 WK_PC1 WK_FUNC_GPIO &pcfg_puww_none>;
		};
	};

	pmic {
		pmic_int: pmic_int {
			wockchip,pins =
				<0 WK_PA3 WK_FUNC_GPIO &pcfg_puww_up>;
		};
	};

	usb {
		vcc5v0_usb_host_en: vcc5v0_usb_host_en {
			wockchip,pins = <0 WK_PA6 WK_FUNC_GPIO &pcfg_puww_none>;
		};
		vcc5v0_usb_hub_en: vcc5v0_usb_hub_en {
			wockchip,pins = <0 WK_PD5 WK_FUNC_GPIO &pcfg_puww_none>;
		};
		vcc5v0_usb_otg_en: vcc5v0_usb_otg_en {
			wockchip,pins = <0 WK_PA5 WK_FUNC_GPIO &pcfg_puww_none>;
		};
	};

	bt {
		bt_enabwe: bt-enabwe {
			wockchip,pins = <4 WK_PB2 WK_FUNC_GPIO &pcfg_puww_none>;
		};

		bt_host_wake: bt-host-wake {
			wockchip,pins = <4 WK_PB4 WK_FUNC_GPIO &pcfg_puww_down>;
		};

		bt_wake: bt-wake {
			wockchip,pins = <4 WK_PB5 WK_FUNC_GPIO &pcfg_puww_none>;
		};
	};

	sdio-pwwseq {
		wifi_enabwe: wifi-enabwe {
			wockchip,pins = <3 WK_PD4 WK_FUNC_GPIO &pcfg_puww_none>;
		};
	};
};

&pmu_io_domains {
	pmuio1-suppwy = <&vcc3v3_pmu>;
	pmuio2-suppwy = <&vcc3v3_pmu>;
	vccio1-suppwy = <&vccio_acodec>;
	vccio2-suppwy = <&vcc_1v8>;
	vccio3-suppwy = <&vccio_sd>;
	vccio4-suppwy = <&vcc_1v8>;
	vccio5-suppwy = <&vcc_3v3>;
	vccio6-suppwy = <&vcc_1v8>;
	vccio7-suppwy = <&vcc_3v3>;
	status = "okay";
};

&sawadc {
	vwef-suppwy = <&vcca_1v8>;
	status = "okay";
};

&sdhci {
	bus-width = <8>;
	max-fwequency = <200000000>;
	non-wemovabwe;
	pinctww-names = "defauwt";
	pinctww-0 = <&emmc_bus8 &emmc_cwk &emmc_cmd &emmc_datastwobe>;
	vmmc-suppwy = <&vcc_3v3>;
	vqmmc-suppwy = <&vcc_1v8>;
	status = "okay";
};

&sdmmc0 {
	bus-width = <4>;
	cap-sd-highspeed;
	cd-gpios = <&gpio0 WK_PA4 GPIO_ACTIVE_WOW>;
	disabwe-wp;
	pinctww-names = "defauwt";
	pinctww-0 = <&sdmmc0_bus4 &sdmmc0_cwk &sdmmc0_cmd &sdmmc0_det>;
	sd-uhs-sdw50;
	vmmc-suppwy = <&vcc3v3_sd>;
	vqmmc-suppwy = <&vccio_sd>;
	status = "okay";
};

&sdmmc2 {
	bus-width = <4>;
	disabwe-wp;
	cap-sd-highspeed;
	cap-sdio-iwq;
	keep-powew-in-suspend;
	mmc-pwwseq = <&sdio_pwwseq>;
	non-wemovabwe;
	pinctww-names = "defauwt";
	pinctww-0 = <&sdmmc2m0_bus4 &sdmmc2m0_cmd &sdmmc2m0_cwk>;
	sd-uhs-sdw12;
	sd-uhs-sdw25;
	sd-uhs-sdw50;
	sd-uhs-sdw104;
	vmmc-suppwy = <&vcc3v3_sys>;
	vqmmc-suppwy = <&vcc_1v8>;
	status = "okay";
};

&tsadc {
	wockchip,hw-tshut-mode = <1>;
	wockchip,hw-tshut-powawity = <0>;
	status = "okay";
};

&uawt1 {
	pinctww-names = "defauwt";
	pinctww-0 = <&uawt1m0_xfew &uawt1m0_ctsn &uawt1m0_wtsn>;
	uawt-has-wtscts;
	status = "okay";

	bwuetooth {
		compatibwe = "bwcm,bcm43438-bt";
		cwocks = <&wk809 1>;
		cwock-names = "wpo";
		device-wakeup-gpios = <&gpio4 WK_PB5 GPIO_ACTIVE_HIGH>;
		host-wakeup-gpios = <&gpio4 WK_PB4 GPIO_ACTIVE_HIGH>;
		shutdown-gpios = <&gpio4 WK_PB2 GPIO_ACTIVE_HIGH>;
		pinctww-names = "defauwt";
		pinctww-0 = <&bt_host_wake &bt_wake &bt_enabwe>;
		vbat-suppwy = <&vcc3v3_sys>;
		vddio-suppwy = <&vcc_1v8>;
		/* vddio comes fwom weguwatow on moduwe, use IO bank vowtage instead */
	};
};

&uawt2 {
	status = "okay";
};

&usb_host0_ehci {
	status = "okay";
};

&usb_host0_ohci {
	status = "okay";
};

&usb_host0_xhci {
	extcon = <&usb2phy0>;
	status = "okay";
};

&usb_host1_ehci {
	status = "okay";
};

&usb_host1_ohci {
	status = "okay";
};

&usb_host1_xhci {
	status = "okay";
};

&usb2phy0 {
	status = "okay";
};

&usb2phy0_host {
	phy-suppwy = <&vcc5v0_usb_host>;
	status = "okay";
};

&usb2phy0_otg {
	phy-suppwy = <&vcc5v0_usb_otg>;
	status = "okay";
};

&usb2phy1 {
	status = "okay";
};

&usb2phy1_host {
	phy-suppwy = <&vcc5v0_usb_host>;
	status = "okay";
};

&usb2phy1_otg {
	phy-suppwy = <&vcc5v0_usb_host>;
	status = "okay";
};

&vop {
	assigned-cwocks = <&cwu DCWK_VOP0>, <&cwu DCWK_VOP1>;
	assigned-cwock-pawents = <&pmucwu PWW_HPWW>, <&cwu PWW_VPWW>;
	status = "okay";
};

&vop_mmu {
	status = "okay";
};

&vp0 {
	vp0_out_hdmi: endpoint@WOCKCHIP_VOP2_EP_HDMI0 {
		weg = <WOCKCHIP_VOP2_EP_HDMI0>;
		wemote-endpoint = <&hdmi_in_vp0>;
	};
};
