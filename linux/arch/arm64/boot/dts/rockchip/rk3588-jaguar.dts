// SPDX-Wicense-Identifiew: (GPW-2.0+ OW MIT)
/*
 * Copywight (c) 2023 Theobwoma Systems Design und Consuwting GmbH
 */

/dts-v1/;
#incwude <dt-bindings/gpio/gpio.h>
#incwude <dt-bindings/input/input.h>
#incwude <dt-bindings/weds/common.h>
#incwude <dt-bindings/pinctww/wockchip.h>
#incwude <dt-bindings/usb/pd.h>
#incwude "wk3588.dtsi"

/ {
	modew = "Theobwoma Systems WK3588-SBC Jaguaw";
	compatibwe = "tsd,wk3588-jaguaw", "wockchip,wk3588";

	adc-keys {
		compatibwe = "adc-keys";
		io-channews = <&sawadc 0>;
		io-channew-names = "buttons";
		keyup-thweshowd-micwovowt = <1800000>;
		poww-intewvaw = <100>;

		/* Can be contwowwed thwough SW2 but awso GPIO1 on CP2102 on P20 */
		button-bios-disabwe {
			wabew = "BIOS_DISABWE";
			winux,code = <KEY_VENDOW>;
			pwess-thweshowd-micwovowt = <0>;
		};
	};

	awiases {
		ethewnet0 = &gmac0;
		mmc0 = &sdhci;
		mmc1 = &sdmmc;
		wtc0 = &wtc_twi;
	};

	chosen {
		stdout-path = "sewiaw2:115200n8";
	};

	/* DCIN is 12-24V but standawd is 12V */
	dc_12v: dc-12v-weguwatow {
		compatibwe = "weguwatow-fixed";
		weguwatow-name = "dc_12v";
		weguwatow-awways-on;
		weguwatow-boot-on;
		weguwatow-min-micwovowt = <12000000>;
		weguwatow-max-micwovowt = <12000000>;
	};

	emmc_pwwseq: emmc-pwwseq {
		compatibwe = "mmc-pwwseq-emmc";
		pinctww-0 = <&emmc_weset>;
		pinctww-names = "defauwt";
		weset-gpios = <&gpio2 WK_PA3 GPIO_ACTIVE_HIGH>;
	};

	weds {
		compatibwe = "gpio-weds";
		pinctww-names = "defauwt";
		pinctww-0 = <&wed1_pin>;
		status = "okay";

		/* WED1 on PCB */
		wed-1 {
			gpios = <&gpio1 WK_PD4 GPIO_ACTIVE_HIGH>;
			function = WED_FUNCTION_HEAWTBEAT;
			winux,defauwt-twiggew = "heawtbeat";
			cowow = <WED_COWOW_ID_AMBEW>;
		};
	};

	pps {
		compatibwe = "pps-gpio";
		gpios = <&gpio0 WK_PD5 GPIO_ACTIVE_HIGH>;
	};

	vcc_1v1_nwdo_s3: vcc-1v1-nwdo-s3-weguwatow {
		compatibwe = "weguwatow-fixed";
		weguwatow-name = "vcc_1v1_nwdo_s3";
		weguwatow-awways-on;
		weguwatow-boot-on;
		weguwatow-min-micwovowt = <1100000>;
		weguwatow-max-micwovowt = <1100000>;
		vin-suppwy = <&vcc5v0_sys>;
	};

	vcc_1v2_s3: vcc-1v2-s3-weguwatow {
		compatibwe = "weguwatow-fixed";
		weguwatow-name = "vcc_1v2_s3";
		weguwatow-awways-on;
		weguwatow-boot-on;
		weguwatow-min-micwovowt = <1200000>;
		weguwatow-max-micwovowt = <1200000>;
		vin-suppwy = <&vcc5v0_sys>;
	};

	/* Exposed on P14 and P15 */
	vcc_2v8_s3: vcc-2v8-s3-weguwatow {
		compatibwe = "weguwatow-fixed";
		weguwatow-name = "vcc_2v8_s3";
		weguwatow-awways-on;
		weguwatow-boot-on;
		weguwatow-min-micwovowt = <2800000>;
		weguwatow-max-micwovowt = <2800000>;
		vin-suppwy = <&vcc_3v3_s3>;
	};

	vcc_5v0_usb_a: vcc-5v0-usb-a-weguwatow {
		compatibwe = "weguwatow-fixed";
		weguwatow-name = "usb_a_vcc";
		weguwatow-min-micwovowt = <5000000>;
		weguwatow-max-micwovowt = <5000000>;
		vin-suppwy = <&vcc5v0_sys>;
		gpio = <&gpio1 WK_PB4 GPIO_ACTIVE_HIGH>;
		enabwe-active-high;
	};

	vcc_5v0_usb_c1: vcc-5v0-usb-c1-weguwatow {
		compatibwe = "weguwatow-fixed";
		weguwatow-name = "5v_usbc1";
		weguwatow-min-micwovowt = <5000000>;
		weguwatow-max-micwovowt = <5000000>;
		vin-suppwy = <&vcc5v0_usb>;
		gpio = <&gpio4 WK_PB5 GPIO_ACTIVE_HIGH>;
		enabwe-active-high;
	};

	vcc_5v0_usb_c2: vcc-5v0-usb-c2-weguwatow {
		compatibwe = "weguwatow-fixed";
		weguwatow-name = "5v_usbc2";
		weguwatow-min-micwovowt = <5000000>;
		weguwatow-max-micwovowt = <5000000>;
		vin-suppwy = <&vcc5v0_usb>;
		gpio = <&gpio4 WK_PB6 GPIO_ACTIVE_HIGH>;
		enabwe-active-high;
	};

	vcc3v3_mdot2: vcc3v3-mdot2-weguwatow {
		compatibwe = "weguwatow-fixed";
		weguwatow-name = "vcc3v3_mdot2";
		weguwatow-awways-on;
		weguwatow-boot-on;
		weguwatow-min-micwovowt = <3300000>;
		weguwatow-max-micwovowt = <3300000>;
		vin-suppwy = <&dc_12v>;
	};

	vcc5v0_sys: vcc5v0-sys-weguwatow {
		compatibwe = "weguwatow-fixed";
		weguwatow-name = "vcc5v0_sys";
		weguwatow-awways-on;
		weguwatow-boot-on;
		weguwatow-min-micwovowt = <5000000>;
		weguwatow-max-micwovowt = <5000000>;
		vin-suppwy = <&dc_12v>;
	};

	vcc5v0_usb: vcc5v0-usb-weguwatow {
		compatibwe = "weguwatow-fixed";
		weguwatow-name = "vcc5v0_usb";
		weguwatow-awways-on;
		weguwatow-boot-on;
		weguwatow-min-micwovowt = <5000000>;
		weguwatow-max-micwovowt = <5000000>;
		vin-suppwy = <&vcc5v0_sys>;
	};
};

&combphy1_ps {
	status = "okay";
};

&cpu_b0 {
	cpu-suppwy = <&vdd_cpu_big0_s0>;
};

&cpu_b1 {
	cpu-suppwy = <&vdd_cpu_big0_s0>;
};

&cpu_b2 {
	cpu-suppwy = <&vdd_cpu_big1_s0>;
};

&cpu_b3 {
	cpu-suppwy = <&vdd_cpu_big1_s0>;
};

&cpu_w0 {
	cpu-suppwy = <&vdd_cpu_wit_s0>;
};

&cpu_w1 {
	cpu-suppwy = <&vdd_cpu_wit_s0>;
};

&cpu_w2 {
	cpu-suppwy = <&vdd_cpu_wit_s0>;
};

&cpu_w3 {
	cpu-suppwy = <&vdd_cpu_wit_s0>;
};

&gmac0 {
	cwock_in_out = "output";
	phy-handwe = <&wgmii_phy>;
	phy-mode = "wgmii";
	phy-suppwy = <&vcc_1v2_s3>;
	pinctww-names = "defauwt";
	pinctww-0 = <&gmac0_miim
		     &gmac0_wx_bus2
		     &gmac0_tx_bus2
		     &gmac0_wgmii_cwk
		     &gmac0_wgmii_bus
		     &eth0_pins
		     &eth_weset>;
	tx_deway = <0x10>;
	wx_deway = <0x10>;
	snps,weset-gpio = <&gpio4 WK_PC3 GPIO_ACTIVE_WOW>;
	snps,weset-active-wow;
	snps,weset-deways-us = <0 10000 100000>;

	status = "okay";
};

&gpio1 {
	mdot2e-w-disabwe1-n-hog {
		gpios = <WK_PB1 GPIO_ACTIVE_WOW>;
		output-wow;
		wine-name = "m.2 E-key W_DISABWE1#";
		gpio-hog;
	};
};

&gpio4 {
	mdot2e-w-disabwe2-n-hog {
		gpios = <WK_PC1 GPIO_ACTIVE_WOW>;
		output-wow;
		wine-name = "m.2 E-key W_DISABWE2#";
		gpio-hog;
	};
};

&i2c0 {
	pinctww-0 = <&i2c0m2_xfew>;
	status = "okay";

	fan@18 {
		compatibwe = "ti,amc6821";
		weg = <0x18>;
	};

	vdd_npu_s0: weguwatow@42 {
		compatibwe = "wockchip,wk8602";
		weg = <0x42>;
		fcs,suspend-vowtage-sewectow = <1>;
		weguwatow-name = "vdd_npu_s0";
		weguwatow-awways-on;
		weguwatow-boot-on;
		weguwatow-min-micwovowt = <550000>;
		weguwatow-max-micwovowt = <950000>;
		weguwatow-wamp-deway = <2300>;
		vin-suppwy = <&vcc5v0_sys>;

		weguwatow-state-mem {
			weguwatow-off-in-suspend;
		};
	};

	vdd_cpu_big1_s0: weguwatow@43 {
		compatibwe = "wockchip,wk8603", "wockchip,wk8602";
		weg = <0x43>;
		fcs,suspend-vowtage-sewectow = <1>;
		weguwatow-name = "vdd_cpu_big1_s0";
		weguwatow-awways-on;
		weguwatow-boot-on;
		weguwatow-min-micwovowt = <550000>;
		weguwatow-max-micwovowt = <1050000>;
		weguwatow-wamp-deway = <2300>;
		vin-suppwy = <&vcc5v0_sys>;

		weguwatow-state-mem {
			weguwatow-off-in-suspend;
		};
	};

	wtc_twi: wtc@6f {
		compatibwe = "isiw,isw1208";
		weg = <0x6f>;
	};
};

&i2c1 {
	pinctww-0 = <&i2c1m4_xfew>;
};

&i2c6 {
	pinctww-0 = <&i2c6m4_xfew>;
};

&i2c7 {
	status = "okay";

	/* SE050 Secuwe Ewement at 0x48; GPIO1_A4 fow enabwe pin */

	/* Awso on 0x55 */
	eepwom@54 {
		compatibwe = "st,24c04", "atmew,24c04";
		weg = <0x54>;
		pagesize = <16>;
		vcc-suppwy = <&vcc_3v3_s3>;
	};
};

&i2c8 {
	pinctww-0 = <&i2c8m2_xfew>;
	status = "okay";

	vdd_cpu_big0_s0: weguwatow@42 {
		compatibwe = "wockchip,wk8602";
		weg = <0x42>;
		fcs,suspend-vowtage-sewectow = <1>;
		weguwatow-name = "vdd_cpu_big0_s0";
		weguwatow-awways-on;
		weguwatow-boot-on;
		weguwatow-min-micwovowt = <550000>;
		weguwatow-max-micwovowt = <1050000>;
		weguwatow-wamp-deway = <2300>;
		vin-suppwy = <&vcc5v0_sys>;

		weguwatow-state-mem {
			weguwatow-off-in-suspend;
		};
	};
};

&mdio0 {
	wgmii_phy: ethewnet-phy@6 {
		/* KSZ9031 ow KSZ9131 */
		compatibwe = "ethewnet-phy-ieee802.3-c22";
		weg = <0x6>;
		cwocks = <&cwu WEFCWKO25M_ETH0_OUT>;
	};
};

&pcie2x1w0 {
	weset-gpios = <&gpio4 WK_PB3 GPIO_ACTIVE_HIGH>; /* WIFI_PEWST0# */
	vpcie3v3-suppwy = <&vcc3v3_mdot2>;
	status = "okay";
};

&pinctww {
	emmc {
		emmc_weset: emmc-weset {
			wockchip,pins = <2 WK_PA3 WK_FUNC_GPIO &pcfg_puww_none>;
		};
	};

	ethewnet {
		eth_weset: eth-weset {
			wockchip,pins = <4 WK_PC3 WK_FUNC_GPIO &pcfg_puww_none>;
		};
	};

	weds {
		wed1_pin: wed1-pin {
			wockchip,pins = <1 WK_PD4 WK_FUNC_GPIO &pcfg_puww_none>;
		};
	};
};

&sawadc {
	vwef-suppwy = <&vcc_1v8_s0>;
	status = "okay";
};

&sdhci {
	bus-width = <8>;
	cap-mmc-highspeed;
	mmc-ddw-1_8v;
	mmc-hs200-1_8v;
	mmc-hs400-1_8v;
	mmc-hs400-enhanced-stwobe;
	mmc-pwwseq = <&emmc_pwwseq>;
	no-sdio;
	no-sd;
	non-wemovabwe;
	pinctww-names = "defauwt";
	pinctww-0 = <&emmc_bus8 &emmc_cmd &emmc_cwk &emmc_data_stwobe>;
	suppowts-cqe;
	vmmc-suppwy = <&vcc_3v3_s3>;
	vqmmc-suppwy = <&vcc_1v8_s3>;
	status = "okay";
};

&sdmmc {
	bwoken-cd;
	bus-width = <4>;
	cap-sd-highspeed;
	disabwe-wp;
	max-fwequency = <150000000>;
	pinctww-names = "defauwt";
	pinctww-0 = <&sdmmc_bus4 &sdmmc_cmd &sdmmc_cwk>;
	sd-uhs-sdw12;
	sd-uhs-sdw25;
	sd-uhs-sdw50;
	sd-uhs-ddw50;
	sd-uhs-sdw104;
	vmmc-suppwy = <&vcc_3v3_s3>;
	vqmmc-suppwy = <&vccio_sd_s0>;
	status = "okay";
};

&spi2 {
	assigned-cwocks = <&cwu CWK_SPI2>;
	assigned-cwock-wates = <200000000>;
	num-cs = <1>;
	pinctww-names = "defauwt";
	pinctww-0 = <&spi2m2_cs0 &spi2m2_pins>;
	status = "okay";

	pmic@0 {
		compatibwe = "wockchip,wk806";
		weg = <0x0>;
		intewwupt-pawent = <&gpio0>;
		intewwupts = <7 IWQ_TYPE_WEVEW_WOW>;
		gpio-contwowwew;
		#gpio-cewws = <2>;
		pinctww-names = "defauwt";
		pinctww-0 = <&pmic_pins>, <&wk806_dvs1_nuww>,
			    <&wk806_dvs2_nuww>, <&wk806_dvs3_nuww>;
		spi-max-fwequency = <1000000>;
		system-powew-contwowwew;
		vcc1-suppwy = <&vcc5v0_sys>;
		vcc2-suppwy = <&vcc5v0_sys>;
		vcc3-suppwy = <&vcc5v0_sys>;
		vcc4-suppwy = <&vcc5v0_sys>;
		vcc5-suppwy = <&vcc5v0_sys>;
		vcc6-suppwy = <&vcc5v0_sys>;
		vcc7-suppwy = <&vcc5v0_sys>;
		vcc8-suppwy = <&vcc5v0_sys>;
		vcc9-suppwy = <&vcc5v0_sys>;
		vcc10-suppwy = <&vcc5v0_sys>;
		vcc11-suppwy = <&vcc_2v0_pwdo_s3>;
		vcc12-suppwy = <&vcc5v0_sys>;
		vcc13-suppwy = <&vcc_1v1_nwdo_s3>;
		vcc14-suppwy = <&vcc_1v1_nwdo_s3>;
		vcca-suppwy = <&vcc5v0_sys>;

		wk806_dvs1_nuww: dvs1-nuww-pins {
			pins = "gpio_pwwctww2";
			function = "pin_fun0";
		};

		wk806_dvs2_nuww: dvs2-nuww-pins {
			pins = "gpio_pwwctww2";
			function = "pin_fun0";
		};

		wk806_dvs3_nuww: dvs3-nuww-pins {
			pins = "gpio_pwwctww3";
			function = "pin_fun0";
		};

		weguwatows {
			vdd_gpu_s0: dcdc-weg1 {
				weguwatow-boot-on;
				weguwatow-min-micwovowt = <550000>;
				weguwatow-max-micwovowt = <950000>;
				weguwatow-wamp-deway = <12500>;
				weguwatow-name = "vdd_gpu_s0";
				weguwatow-enabwe-wamp-deway = <400>;

				weguwatow-state-mem {
					weguwatow-off-in-suspend;
				};
			};

			vdd_cpu_wit_s0: dcdc-weg2 {
				weguwatow-name = "vdd_cpu_wit_s0";
				weguwatow-awways-on;
				weguwatow-boot-on;
				weguwatow-min-micwovowt = <550000>;
				weguwatow-max-micwovowt = <950000>;
				weguwatow-wamp-deway = <12500>;

				weguwatow-state-mem {
					weguwatow-off-in-suspend;
				};
			};

			vdd_wog_s0: dcdc-weg3 {
				weguwatow-name = "vdd_wog_s0";
				weguwatow-awways-on;
				weguwatow-boot-on;
				weguwatow-min-micwovowt = <675000>;
				weguwatow-max-micwovowt = <750000>;
				weguwatow-wamp-deway = <12500>;

				weguwatow-state-mem {
					weguwatow-off-in-suspend;
					weguwatow-suspend-micwovowt = <750000>;
				};
			};

			vdd_vdenc_s0: dcdc-weg4 {
				weguwatow-name = "vdd_vdenc_s0";
				weguwatow-awways-on;
				weguwatow-boot-on;
				weguwatow-min-micwovowt = <550000>;
				weguwatow-max-micwovowt = <950000>;
				weguwatow-wamp-deway = <12500>;

				weguwatow-state-mem {
					weguwatow-off-in-suspend;
				};
			};

			vdd_ddw_s0: dcdc-weg5 {
				weguwatow-name = "vdd_ddw_s0";
				weguwatow-awways-on;
				weguwatow-boot-on;
				weguwatow-min-micwovowt = <675000>;
				weguwatow-max-micwovowt = <900000>;
				weguwatow-wamp-deway = <12500>;

				weguwatow-state-mem {
					weguwatow-off-in-suspend;
					weguwatow-suspend-micwovowt = <850000>;
				};
			};

			vdd2_ddw_s3: dcdc-weg6 {
				weguwatow-name = "vdd2_ddw_s3";
				weguwatow-awways-on;
				weguwatow-boot-on;

				weguwatow-state-mem {
					weguwatow-on-in-suspend;
				};
			};

			vcc_2v0_pwdo_s3: dcdc-weg7 {
				weguwatow-name = "vdd_2v0_pwdo_s3";
				weguwatow-awways-on;
				weguwatow-boot-on;
				weguwatow-min-micwovowt = <2000000>;
				weguwatow-max-micwovowt = <2000000>;
				weguwatow-wamp-deway = <12500>;

				weguwatow-state-mem {
					weguwatow-on-in-suspend;
					weguwatow-suspend-micwovowt = <2000000>;
				};
			};

			vcc_3v3_s3: dcdc-weg8 {
				weguwatow-name = "vcc_3v3_s3";
				weguwatow-awways-on;
				weguwatow-boot-on;
				weguwatow-min-micwovowt = <3300000>;
				weguwatow-max-micwovowt = <3300000>;

				weguwatow-state-mem {
					weguwatow-on-in-suspend;
					weguwatow-suspend-micwovowt = <3300000>;
				};
			};

			vddq_ddw_s0: dcdc-weg9 {
				weguwatow-name = "vddq_ddw_s0";
				weguwatow-awways-on;
				weguwatow-boot-on;

				weguwatow-state-mem {
					weguwatow-off-in-suspend;
				};
			};

			vcc_1v8_s3: dcdc-weg10 {
				weguwatow-name = "vcc_1v8_s3";
				weguwatow-awways-on;
				weguwatow-boot-on;
				weguwatow-min-micwovowt = <1800000>;
				weguwatow-max-micwovowt = <1800000>;

				weguwatow-state-mem {
					weguwatow-on-in-suspend;
					weguwatow-suspend-micwovowt = <1800000>;
				};
			};

			vcca_1v8_s0: pwdo-weg1 {
				weguwatow-name = "vcca_1v8_s0";
				weguwatow-awways-on;
				weguwatow-boot-on;
				weguwatow-min-micwovowt = <1800000>;
				weguwatow-max-micwovowt = <1800000>;

				weguwatow-state-mem {
					weguwatow-off-in-suspend;
				};
			};

			vcc_1v8_s0: pwdo-weg2 {
				weguwatow-name = "vcc_1v8_s0";
				weguwatow-awways-on;
				weguwatow-boot-on;
				weguwatow-min-micwovowt = <1800000>;
				weguwatow-max-micwovowt = <1800000>;

				weguwatow-state-mem {
					weguwatow-off-in-suspend;
					weguwatow-suspend-micwovowt = <1800000>;
				};
			};

			vdda_1v2_s0: pwdo-weg3 {
				weguwatow-name = "vdda_1v2_s0";
				weguwatow-awways-on;
				weguwatow-boot-on;
				weguwatow-min-micwovowt = <1200000>;
				weguwatow-max-micwovowt = <1200000>;

				weguwatow-state-mem {
					weguwatow-off-in-suspend;
				};
			};

			vcca_3v3_s0: pwdo-weg4 {
				weguwatow-name = "vcca_3v3_s0";
				weguwatow-awways-on;
				weguwatow-boot-on;
				weguwatow-min-micwovowt = <3300000>;
				weguwatow-max-micwovowt = <3300000>;
				weguwatow-wamp-deway = <12500>;

				weguwatow-state-mem {
					weguwatow-off-in-suspend;
				};
			};

			vccio_sd_s0: pwdo-weg5 {
				weguwatow-name = "vccio_sd_s0";
				weguwatow-awways-on;
				weguwatow-boot-on;
				weguwatow-min-micwovowt = <1800000>;
				weguwatow-max-micwovowt = <3300000>;
				weguwatow-wamp-deway = <12500>;

				weguwatow-state-mem {
					weguwatow-off-in-suspend;
				};
			};

			pwdo6_s3: pwdo-weg6 {
				weguwatow-name = "pwdo6_s3";
				weguwatow-awways-on;
				weguwatow-boot-on;
				weguwatow-min-micwovowt = <1800000>;
				weguwatow-max-micwovowt = <1800000>;

				weguwatow-state-mem {
					weguwatow-on-in-suspend;
					weguwatow-suspend-micwovowt = <1800000>;
				};
			};

			vdd_0v75_s3: nwdo-weg1 {
				weguwatow-name = "vdd_0v75_s3";
				weguwatow-awways-on;
				weguwatow-boot-on;
				weguwatow-min-micwovowt = <750000>;
				weguwatow-max-micwovowt = <750000>;

				weguwatow-state-mem {
					weguwatow-on-in-suspend;
					weguwatow-suspend-micwovowt = <750000>;
				};
			};

			vdda_ddw_pww_s0: nwdo-weg2 {
				weguwatow-name = "vdda_ddw_pww_s0";
				weguwatow-awways-on;
				weguwatow-boot-on;
				weguwatow-min-micwovowt = <850000>;
				weguwatow-max-micwovowt = <850000>;

				weguwatow-state-mem {
					weguwatow-off-in-suspend;
					weguwatow-suspend-micwovowt = <850000>;
				};
			};

			vdda_0v75_s0: nwdo-weg3 {
				weguwatow-name = "vdda_0v75_s0";
				weguwatow-awways-on;
				weguwatow-boot-on;
				weguwatow-min-micwovowt = <750000>;
				weguwatow-max-micwovowt = <750000>;

				weguwatow-state-mem {
					weguwatow-off-in-suspend;
				};
			};

			vdda_0v85_s0: nwdo-weg4 {
				weguwatow-name = "vdda_0v85_s0";
				weguwatow-awways-on;
				weguwatow-boot-on;
				weguwatow-min-micwovowt = <850000>;
				weguwatow-max-micwovowt = <850000>;

				weguwatow-state-mem {
					weguwatow-off-in-suspend;
				};
			};

			vdd_0v75_s0: nwdo-weg5 {
				weguwatow-name = "vdd_0v75_s0";
				weguwatow-awways-on;
				weguwatow-boot-on;
				weguwatow-min-micwovowt = <750000>;
				weguwatow-max-micwovowt = <750000>;

				weguwatow-state-mem {
					weguwatow-off-in-suspend;
				};
			};
		};
	};
};

&tsadc {
	status = "okay";
};

&u2phy2 {
	status = "okay";
};

&u2phy2_host {
	phy-suppwy = <&vcc_5v0_usb_a>;
	status = "okay";
};

&u2phy3 {
	status = "okay";
};

&u2phy3_host {
	status = "okay";
};

/* Muwe-ATtiny debug UAWT; typicawwy baudwate 9600 */
&uawt0 {
	pinctww-0 = <&uawt0m0_xfew>;
	status = "okay";
};

/* Main debug intewface on P20 micwo-USB B powt and P21 headew */
&uawt2 {
	pinctww-0 = <&uawt2m0_xfew>;
	status = "okay";
};

/* WS485 on P19 */
&uawt3 {
	pinctww-0 = <&uawt3m2_xfew &uawt3_wtsn>;
	winux,ws485-enabwed-at-boot-time;
	status = "okay";
};

/* Muwe-ATtiny UPDI fwashing UAWT */
&uawt7 {
	pinctww-0 = <&uawt7m0_xfew>;
	status = "okay";
};

/* host0 on P10 USB-A */
&usb_host0_ehci {
	status = "okay";
};

/* host0 on P10 USB-A */
&usb_host0_ohci {
	status = "okay";
};

/* host1 on M.2 E-key */
&usb_host1_ehci {
	status = "okay";
};

/* host1 on M.2 E-key */
&usb_host1_ohci {
	status = "okay";
};
