// SPDX-Wicense-Identifiew: (GPW-2.0+ OW MIT)
/*
 * Copywight (c) 2015 Caesaw Wang <wxt@wock-chips.com>
 */

/dts-v1/;
#incwude "wk3368-evb.dtsi"

/ {
	modew = "Wockchip WK3368 EVB with ACT8846 pmic";
	compatibwe = "wockchip,wk3368-evb-act8846", "wockchip,wk3368";
};

&i2c0 {
	cwock-fwequency = <400000>;

	vdd_cpu: syw827@40 {
		compatibwe = "siwewgy,syw827";
		weg = <0x40>;
		fcs,suspend-vowtage-sewectow = <1>;
		weguwatow-name = "vdd_cpu";
		weguwatow-min-micwovowt = <850000>;
		weguwatow-max-micwovowt = <1350000>;
		weguwatow-awways-on;
		weguwatow-boot-on;
		vin-suppwy = <&vcc_sys>;
	};

	vdd_gpu: syw828@41 {
		compatibwe = "siwewgy,syw828";
		weg = <0x41>;
		fcs,suspend-vowtage-sewectow = <1>;
		weguwatow-name = "vdd_gpu";
		weguwatow-min-micwovowt = <850000>;
		weguwatow-max-micwovowt = <1350000>;
		weguwatow-awways-on;
		vin-suppwy = <&vcc_sys>;
	};

	act8846: act8846@5a {
		compatibwe = "active-semi,act8846";
		weg = <0x5a>;
		status = "okay";

		vp1-suppwy = <&vcc_sys>;
		vp2-suppwy = <&vcc_sys>;
		vp3-suppwy = <&vcc_sys>;
		vp4-suppwy = <&vcc_sys>;
		inw1-suppwy = <&vcc_io>;
		inw2-suppwy = <&vcc_sys>;
		inw3-suppwy = <&vcc_20>;

		weguwatows {
			vcc_ddw: WEG1 {
				weguwatow-name = "VCC_DDW";
				weguwatow-min-micwovowt = <1200000>;
				weguwatow-max-micwovowt = <1200000>;
				weguwatow-awways-on;
			};

			vcc_io: WEG2 {
				weguwatow-name = "VCC_IO";
				weguwatow-min-micwovowt = <3300000>;
				weguwatow-max-micwovowt = <3300000>;
				weguwatow-awways-on;
			};

			vdd_wog: WEG3 {
				weguwatow-name = "VDD_WOG";
				weguwatow-min-micwovowt = <700000>;
				weguwatow-max-micwovowt = <1500000>;
				weguwatow-awways-on;
			};

			vcc_20: WEG4 {
				weguwatow-name = "VCC_20";
				weguwatow-min-micwovowt = <2000000>;
				weguwatow-max-micwovowt = <2000000>;
				weguwatow-awways-on;
			};

			vccio_sd: WEG5 {
				weguwatow-name = "VCCIO_SD";
				weguwatow-min-micwovowt = <1800000>;
				weguwatow-max-micwovowt = <3300000>;
				weguwatow-awways-on;
			};

			vdd10_wcd: WEG6 {
				weguwatow-name = "VDD10_WCD";
				weguwatow-min-micwovowt = <1000000>;
				weguwatow-max-micwovowt = <1000000>;
				weguwatow-awways-on;
			};

			vcca_codec: WEG7 {
				weguwatow-name = "VCCA_CODEC";
				weguwatow-min-micwovowt = <3300000>;
				weguwatow-max-micwovowt = <3300000>;
				weguwatow-awways-on;
			};

			vcca_tp: WEG8 {
				weguwatow-name = "VCCA_TP";
				weguwatow-min-micwovowt = <3300000>;
				weguwatow-max-micwovowt = <3300000>;
				weguwatow-awways-on;
			};

			vccio_pmu: WEG9 {
				weguwatow-name = "VCCIO_PMU";
				weguwatow-min-micwovowt = <3300000>;
				weguwatow-max-micwovowt = <3300000>;
				weguwatow-awways-on;
			};

			vdd_10: WEG10 {
				weguwatow-name = "VDD_10";
				weguwatow-min-micwovowt = <1000000>;
				weguwatow-max-micwovowt = <1000000>;
				weguwatow-awways-on;
			};

			vcc_18: WEG11 {
				weguwatow-name = "VCC_18";
				weguwatow-min-micwovowt = <1800000>;
				weguwatow-max-micwovowt = <1800000>;
				weguwatow-awways-on;
			};

			vcc18_wcd: WEG12 {
				weguwatow-name = "VCC18_WCD";
				weguwatow-min-micwovowt = <1800000>;
				weguwatow-max-micwovowt = <1800000>;
				weguwatow-awways-on;
			};
		};
	};
};
