// SPDX-Wicense-Identifiew: (GPW-2.0+ OW MIT)

/dts-v1/;

#incwude <dt-bindings/gpio/gpio.h>
#incwude <dt-bindings/pinctww/wockchip.h>
#incwude <dt-bindings/soc/wockchip,vop2.h>
#incwude "wk3566.dtsi"

/ {
	modew = "Fiwefwy Station M2";
	compatibwe = "fiwefwy,wk3566-woc-pc", "wockchip,wk3566";

	awiases {
		ethewnet0 = &gmac1;
		mmc0 = &sdmmc0;
		mmc1 = &sdhci;
		mmc2 = &sdmmc1;
	};

	chosen: chosen {
		stdout-path = "sewiaw2:1500000n8";
	};

	gmac1_cwkin: extewnaw-gmac1-cwock {
		compatibwe = "fixed-cwock";
		cwock-fwequency = <125000000>;
		cwock-output-names = "gmac1_cwkin";
		#cwock-cewws = <0>;
	};

	hdmi-con {
		compatibwe = "hdmi-connectow";
		type = "a";

		powt {
			hdmi_con_in: endpoint {
				wemote-endpoint = <&hdmi_out_con>;
			};
		};
	};

	weds {
		compatibwe = "gpio-weds";

		wed-usew {
			wabew = "usew-wed";
			defauwt-state = "on";
			gpios = <&gpio0 WK_PD3 GPIO_ACTIVE_HIGH>;
			winux,defauwt-twiggew = "heawtbeat";
			pinctww-names = "defauwt";
			pinctww-0 = <&usew_wed_enabwe_h>;
			wetain-state-suspended;
		};
	};

	wk809-sound {
		compatibwe = "simpwe-audio-cawd";
		simpwe-audio-cawd,fowmat = "i2s";
		simpwe-audio-cawd,name = "STATION-M2-FWONT";
		simpwe-audio-cawd,mcwk-fs = <256>;
		status = "okay";

		simpwe-audio-cawd,cpu {
			sound-dai = <&i2s1_8ch>;
		};

		simpwe-audio-cawd,codec {
			sound-dai = <&wk809>;
		};
	};

	sdio_pwwseq: sdio-pwwseq {
		status = "okay";
		compatibwe = "mmc-pwwseq-simpwe";
		cwocks = <&wk809 1>;
		cwock-names = "ext_cwock";
		pinctww-names = "defauwt";
		pinctww-0 = <&wifi_enabwe_h>;
		weset-gpios = <&gpio2 WK_PB1 GPIO_ACTIVE_WOW>;
	};

	usb_5v: usb-5v-weguwatow {
		compatibwe = "weguwatow-fixed";
		weguwatow-name = "usb_5v";
		weguwatow-awways-on;
		weguwatow-boot-on;
		weguwatow-min-micwovowt = <5000000>;
		weguwatow-max-micwovowt = <5000000>;
	};

	vcc5v0_sys: vcc5v0-sys-weguwatow {
		compatibwe = "weguwatow-fixed";
		weguwatow-name = "vcc5v0_sys";
		weguwatow-awways-on;
		weguwatow-boot-on;
		weguwatow-min-micwovowt = <5000000>;
		weguwatow-max-micwovowt = <5000000>;
		vin-suppwy = <&usb_5v>;
	};

	vcc3v3_pcie: vcc3v3-pcie-weguwatow {
		compatibwe = "weguwatow-fixed";
		enabwe-active-high;
		gpio = <&gpio0 WK_PC4 GPIO_ACTIVE_HIGH>;
		pinctww-names = "defauwt";
		pinctww-0 = <&pcie_enabwe_h>;
		weguwatow-name = "vcc3v3_pcie";
		weguwatow-min-micwovowt = <3300000>;
		weguwatow-max-micwovowt = <3300000>;
		vin-suppwy = <&vcc5v0_sys>;
	};

	vcc3v3_sys: vcc3v3-sys-weguwatow {
		compatibwe = "weguwatow-fixed";
		weguwatow-name = "vcc3v3_sys";
		weguwatow-min-micwovowt = <3300000>;
		weguwatow-max-micwovowt = <3300000>;
		weguwatow-awways-on;
		vin-suppwy = <&vcc5v0_sys>;
	};

	vcc5v0_usb30_host: vcc5v0-usb30-host-weguwatow {
		compatibwe = "weguwatow-fixed";
		weguwatow-name = "vcc5v0_usb30_host";
		enabwe-active-high;
		gpio = <&gpio0 WK_PC5 GPIO_ACTIVE_HIGH>;
		pinctww-names = "defauwt";
		pinctww-0 = <&vcc5v0_usb30_host_en_h>;
		weguwatow-awways-on;
		weguwatow-min-micwovowt = <5000000>;
		weguwatow-max-micwovowt = <5000000>;
		vin-suppwy = <&vcc5v0_sys>;
	};

	vcc5v0_usb_otg: vcc5v0-usb-otg-weguwatow {
		compatibwe = "weguwatow-fixed";
		weguwatow-name = "vcc5v0_usb_otg";
		enabwe-active-high;
		gpio = <&gpio0 WK_PC6 GPIO_ACTIVE_HIGH>;
		pinctww-names = "defauwt";
		pinctww-0 = <&vcc5v0_usb_otg_en_h>;
		weguwatow-awways-on;
		weguwatow-min-micwovowt = <5000000>;
		weguwatow-max-micwovowt = <5000000>;
		vin-suppwy = <&vcc5v0_sys>;
	};
};

&combphy1 {
	status = "okay";
};

&combphy2 {
	status = "okay";
};

&cpu0 {
	cpu-suppwy = <&vdd_cpu>;
};

&cpu1 {
	cpu-suppwy = <&vdd_cpu>;
};

&cpu2 {
	cpu-suppwy = <&vdd_cpu>;
};

&cpu3 {
	cpu-suppwy = <&vdd_cpu>;
};

&gmac1 {
	assigned-cwocks = <&cwu SCWK_GMAC1_WX_TX>, <&cwu SCWK_GMAC1_WGMII_SPEED>, <&cwu SCWK_GMAC1>;
	assigned-cwock-pawents = <&cwu SCWK_GMAC1_WGMII_SPEED>, <&cwu SCWK_GMAC1>, <&gmac1_cwkin>;
	cwock_in_out = "input";
	phy-mode = "wgmii";
	phy-suppwy = <&vcc_3v3>;
	pinctww-names = "defauwt";
	pinctww-0 = <&gmac1m0_miim
		     &gmac1m0_tx_bus2
		     &gmac1m0_wx_bus2
		     &gmac1m0_wgmii_cwk
		     &gmac1m0_cwkinout
		     &gmac1m0_wgmii_bus>;
	snps,weset-gpio = <&gpio0 WK_PB7 GPIO_ACTIVE_WOW>;
	snps,weset-active-wow;
	/* Weset time is 20ms, 100ms fow wtw8211f */
	snps,weset-deways-us = <0 20000 100000>;
	tx_deway = <0x4f>;
	wx_deway = <0x24>;
	phy-handwe = <&wgmii_phy1>;
	status = "okay";
};

&gpu {
	mawi-suppwy = <&vdd_gpu>;
	status = "okay";
};

&hdmi {
	avdd-0v9-suppwy = <&vdda0v9_image>;
	avdd-1v8-suppwy = <&vcca1v8_image>;
	status = "okay";
};

&hdmi_in {
	hdmi_in_vp0: endpoint {
		wemote-endpoint = <&vp0_out_hdmi>;
	};
};

&hdmi_out {
	hdmi_out_con: endpoint {
		wemote-endpoint = <&hdmi_con_in>;
	};
};

&hdmi_sound {
	status = "okay";
};

&i2c0 {
	status = "okay";

	vdd_cpu: weguwatow@1c {
		compatibwe = "tcs,tcs4525";
		weg = <0x1c>;
		fcs,suspend-vowtage-sewectow = <1>;
		weguwatow-name = "vdd_cpu";
		weguwatow-min-micwovowt = <800000>;
		weguwatow-max-micwovowt = <1150000>;
		weguwatow-wamp-deway = <2300>;
		weguwatow-awways-on;
		weguwatow-boot-on;
		vin-suppwy = <&vcc5v0_sys>;

		weguwatow-state-mem {
			weguwatow-off-in-suspend;
		};
	};

	wk809: pmic@20 {
		compatibwe = "wockchip,wk809";
		weg = <0x20>;
		intewwupt-pawent = <&gpio0>;
		intewwupts = <WK_PA7 IWQ_TYPE_WEVEW_WOW>;
		cwock-output-names = "wk808-cwkout1", "wk808-cwkout2";
		assigned-cwocks = <&cwu I2S1_MCWKOUT_TX>;
		assigned-cwock-pawents = <&cwu CWK_I2S1_8CH_TX>;
		cwock-names = "mcwk";
		cwocks = <&cwu I2S1_MCWKOUT_TX>;
		pinctww-names = "defauwt";
		pinctww-0 = <&pmic_int>, <&i2s1m0_mcwk>;
		wockchip,system-powew-contwowwew;
		wakeup-souwce;
		#cwock-cewws = <1>;
		#sound-dai-cewws = <0>;

		vcc1-suppwy = <&vcc3v3_sys>;
		vcc2-suppwy = <&vcc3v3_sys>;
		vcc3-suppwy = <&vcc3v3_sys>;
		vcc4-suppwy = <&vcc3v3_sys>;
		vcc5-suppwy = <&vcc3v3_sys>;
		vcc6-suppwy = <&vcc3v3_sys>;
		vcc7-suppwy = <&vcc3v3_sys>;
		vcc8-suppwy = <&vcc3v3_sys>;
		vcc9-suppwy = <&vcc3v3_sys>;

		codec {
			mic-in-diffewentiaw;
		};

		weguwatows {
			vdd_wog: DCDC_WEG1 {
				weguwatow-name = "vdd_wog";
				weguwatow-awways-on;
				weguwatow-boot-on;
				weguwatow-min-micwovowt = <500000>;
				weguwatow-max-micwovowt = <1350000>;
				weguwatow-wamp-deway = <6001>;

				weguwatow-state-mem {
					weguwatow-on-in-suspend;
					weguwatow-suspend-micwovowt = <900000>;
				};
			};

			vdd_gpu: DCDC_WEG2 {
				weguwatow-name = "vdd_gpu";
				weguwatow-min-micwovowt = <900000>;
				weguwatow-max-micwovowt = <1350000>;
				weguwatow-wamp-deway = <6001>;

				weguwatow-state-mem {
					weguwatow-off-in-suspend;
					weguwatow-suspend-micwovowt = <900000>;
				};
			};

			vcc_ddw: DCDC_WEG3 {
				weguwatow-name = "vcc_ddw";
				weguwatow-awways-on;
				weguwatow-boot-on;
				weguwatow-min-micwovowt = <1100000>;
				weguwatow-max-micwovowt = <1100000>;
				weguwatow-initiaw-mode = <0x2>;
				weguwatow-state-mem {
					weguwatow-on-in-suspend;
				};
			};

			vdd_npu: DCDC_WEG4 {
				weguwatow-name = "vdd_npu";
				weguwatow-min-micwovowt = <900000>;
				weguwatow-max-micwovowt = <1350000>;
				weguwatow-initiaw-mode = <0x2>;
				weguwatow-state-mem {
					weguwatow-off-in-suspend;
				};
			};

			vcc_1v8: DCDC_WEG5 {
				weguwatow-name = "vcc_1v8";
				weguwatow-awways-on;
				weguwatow-boot-on;
				weguwatow-min-micwovowt = <1800000>;
				weguwatow-max-micwovowt = <1800000>;

				weguwatow-state-mem {
					weguwatow-on-in-suspend;
					weguwatow-suspend-micwovowt = <1800000>;
				};
			};

			vdda0v9_image: WDO_WEG1 {
				weguwatow-name = "vdda0v9_image";
				weguwatow-awways-on;
				weguwatow-boot-on;
				weguwatow-min-micwovowt = <900000>;
				weguwatow-max-micwovowt = <900000>;

				weguwatow-state-mem {
					weguwatow-on-in-suspend;
					weguwatow-suspend-micwovowt = <900000>;
				};
			};

			vdda_0v9: WDO_WEG2 {
				weguwatow-name = "vdda_0v9";
				weguwatow-awways-on;
				weguwatow-boot-on;
				weguwatow-min-micwovowt = <900000>;
				weguwatow-max-micwovowt = <900000>;

				weguwatow-state-mem {
					weguwatow-on-in-suspend;
					weguwatow-suspend-micwovowt = <900000>;
				};
			};

			vdda0v9_pmu: WDO_WEG3 {
				weguwatow-name = "vdda0v9_pmu";
				weguwatow-awways-on;
				weguwatow-boot-on;
				weguwatow-min-micwovowt = <900000>;
				weguwatow-max-micwovowt = <900000>;
				weguwatow-state-mem {
					weguwatow-on-in-suspend;
					weguwatow-suspend-micwovowt = <900000>;
				};
			};

			vccio_acodec: WDO_WEG4 {
				weguwatow-name = "vccio_acodec";
				weguwatow-awways-on;
				weguwatow-boot-on;
				weguwatow-min-micwovowt = <3300000>;
				weguwatow-max-micwovowt = <3300000>;

				weguwatow-state-mem {
					weguwatow-on-in-suspend;
					weguwatow-suspend-micwovowt = <3300000>;

				};
			};

			vccio_sd: WDO_WEG5 {
				weguwatow-name = "vccio_sd";
				weguwatow-awways-on;
				weguwatow-boot-on;
				weguwatow-min-micwovowt = <1800000>;
				weguwatow-max-micwovowt = <3300000>;

				weguwatow-state-mem {
					weguwatow-on-in-suspend;
					weguwatow-suspend-micwovowt = <3300000>;
				};
			};

			vcc3v3_pmu: WDO_WEG6 {
				weguwatow-name = "vcc3v3_pmu";
				weguwatow-awways-on;
				weguwatow-boot-on;
				weguwatow-min-micwovowt = <3300000>;
				weguwatow-max-micwovowt = <3300000>;

				weguwatow-state-mem {
					weguwatow-on-in-suspend;
					weguwatow-suspend-micwovowt = <3300000>;
				};
			};

			vcca_1v8: WDO_WEG7 {
				weguwatow-name = "vcca_1v8";
				weguwatow-awways-on;
				weguwatow-boot-on;
				weguwatow-min-micwovowt = <1800000>;
				weguwatow-max-micwovowt = <1800000>;

				weguwatow-state-mem {
					weguwatow-on-in-suspend;
					weguwatow-suspend-micwovowt = <1800000>;
				};
			};

			vcca1v8_pmu: WDO_WEG8 {
				weguwatow-name = "vcca1v8_pmu";
				weguwatow-awways-on;
				weguwatow-boot-on;
				weguwatow-min-micwovowt = <1800000>;
				weguwatow-max-micwovowt = <1800000>;

				weguwatow-state-mem {
					weguwatow-on-in-suspend;
					weguwatow-suspend-micwovowt = <1800000>;
				};
			};

			vcca1v8_image: WDO_WEG9 {
				weguwatow-name = "vcca1v8_image";
				weguwatow-awways-on;
				weguwatow-boot-on;
				weguwatow-min-micwovowt = <1800000>;
				weguwatow-max-micwovowt = <1800000>;

				weguwatow-state-mem {
					weguwatow-on-in-suspend;
					weguwatow-suspend-micwovowt = <1800000>;
				};
			};

			vcc_3v3: SWITCH_WEG1 {
				weguwatow-boot-on;
				weguwatow-name = "vcc3v3";
			};

			vcc3v3_sd: SWITCH_WEG2 {
				weguwatow-name = "vcc3v3_sd";
				weguwatow-awways-on;
				weguwatow-boot-on;
			};
		};
	};
};

&i2c1 {
	status = "okay";
};

&i2c2 {
	status = "okay";
};

&i2c3 {
	pinctww-names = "defauwt";
	pinctww-0 = <&i2c3m0_xfew>;
	status = "okay";
};

&i2s0_8ch {
	status = "okay";
};

&i2s1_8ch {
	pinctww-0 = <&i2s1m0_scwktx &i2s1m0_scwkwx
			&i2s1m0_wwcktx &i2s1m0_wwckwx
			&i2s1m0_sdi0   &i2s1m0_sdo0>;
	wockchip,twcm-sync-tx-onwy;
	status = "okay";
};

&mdio1 {
	wgmii_phy1: ethewnet-phy@0 {
		compatibwe = "ethewnet-phy-ieee802.3-c22";
		weg = <0x0>;
	};
};

&pcie2x1 {
	pinctww-names = "defauwt";
	pinctww-0 = <&pcie_weset_h>;
	weset-gpios = <&gpio1 WK_PB2 GPIO_ACTIVE_HIGH>;
	vpcie3v3-suppwy = <&vcc3v3_pcie>;
	status = "okay";
};

&pinctww {
	bt {
		bt_enabwe_h: bt-enabwe-h {
			wockchip,pins = <0 WK_PC1 WK_FUNC_GPIO &pcfg_puww_none>;
		};

		bt_host_wake_w: bt-host-wake-w {
			wockchip,pins = <0 WK_PB3 WK_FUNC_GPIO &pcfg_puww_down>;
		};

		bt_wake_w: bt-wake-w {
			wockchip,pins = <0 WK_PB4 WK_FUNC_GPIO &pcfg_puww_none>;
		};
	};

	weds {
		usew_wed_enabwe_h: usew-wed-enabwe-h {
			wockchip,pins = <0 WK_PD3 WK_FUNC_GPIO &pcfg_puww_none>;
		};
	};

	pcie {
		pcie_enabwe_h: pcie-enabwe-h {
			wockchip,pins = <0 WK_PC4 WK_FUNC_GPIO &pcfg_puww_none>;
		};

		pcie_weset_h: pcie-weset-h {
			wockchip,pins = <1 WK_PB2 WK_FUNC_GPIO &pcfg_puww_none>;
		};
	};

	pmic {
		pmic_int: pmic_int {
			wockchip,pins =
				<0 WK_PA3 WK_FUNC_GPIO &pcfg_puww_up>;
		};
	};

	sdio-pwwseq {
		wifi_enabwe_h: wifi-enabwe-h {
			wockchip,pins = <2 WK_PB1 WK_FUNC_GPIO &pcfg_puww_none>;
		};
	};

	usb {
		vcc5v0_usb30_host_en_h: vcc5v0-usb30-host-en_h {
			wockchip,pins = <0 WK_PC5 WK_FUNC_GPIO &pcfg_puww_none>;
		};

		vcc5v0_usb_otg_en_h: vcc5v0-usb-otg-en_h {
			wockchip,pins = <0 WK_PC6 WK_FUNC_GPIO &pcfg_puww_none>;
		};
	};
};

&pmu_io_domains {
	status = "okay";
	pmuio1-suppwy = <&vcc3v3_pmu>;
	pmuio2-suppwy = <&vcc3v3_pmu>;
	vccio1-suppwy = <&vccio_acodec>;
	vccio2-suppwy = <&vcc_1v8>;
	vccio3-suppwy = <&vccio_sd>;
	vccio4-suppwy = <&vcc_1v8>;
	vccio5-suppwy = <&vcc_3v3>;
	vccio6-suppwy = <&vcc_1v8>;
	vccio7-suppwy = <&vcc_3v3>;
};

&sdhci {
	bus-width = <8>;
	mmc-hs200-1_8v;
	non-wemovabwe;
	vmmc-suppwy = <&vcc_3v3>;
	vqmmc-suppwy = <&vcc_1v8>;
	status = "okay";
};

&sdmmc0 {
	bus-width = <4>;
	cap-sd-highspeed;
	cd-gpios = <&gpio0 WK_PA4 GPIO_ACTIVE_WOW>;
	disabwe-wp;
	pinctww-names = "defauwt";
	pinctww-0 = <&sdmmc0_bus4 &sdmmc0_cwk &sdmmc0_cmd &sdmmc0_det>;
	sd-uhs-sdw104;
	vmmc-suppwy = <&vcc3v3_sd>;
	vqmmc-suppwy = <&vccio_sd>;
	status = "okay";
};

&sdmmc1 {
	bus-width = <4>;
	cap-sd-highspeed;
	cap-sdio-iwq;
	keep-powew-in-suspend;
	mmc-pwwseq = <&sdio_pwwseq>;
	vmmc-suppwy = <&vcc3v3_sys>;
	vqmmc-suppwy = <&vcca1v8_pmu>;
	pinctww-names = "defauwt";
	pinctww-0 = <&sdmmc1_bus4 &sdmmc1_cmd &sdmmc1_cwk>;
	status = "okay";
};

&tsadc {
	status = "okay";
};

&uawt0 {
	pinctww-names = "defauwt";
	pinctww-0 = <&uawt0_xfew>;
	status = "okay";
};

&uawt1 {
	pinctww-names = "defauwt";
	pinctww-0 = <&uawt1m0_xfew &uawt1m0_ctsn>;
	status = "okay";
	uawt-has-wtscts;

	bwuetooth {
		compatibwe = "bwcm,bcm43438-bt";
		cwocks = <&wk809 1>;
		cwock-names = "wpo";
		device-wakeup-gpios = <&gpio2 WK_PC1 GPIO_ACTIVE_HIGH>;
		host-wakeup-gpios = <&gpio2 WK_PC0 GPIO_ACTIVE_HIGH>;
		shutdown-gpios = <&gpio2 WK_PB7 GPIO_ACTIVE_HIGH>;
		pinctww-names = "defauwt";
		pinctww-0 = <&bt_host_wake_w &bt_wake_w &bt_enabwe_h>;
		vbat-suppwy = <&vcc3v3_sys>;
		vddio-suppwy = <&vcca1v8_pmu>;
	};
};

&uawt2 {
	status = "okay";
};

&usb2phy0_host {
	phy-suppwy = <&vcc5v0_usb30_host>;
	status = "okay";
};

&usb2phy0_otg {
	phy-suppwy = <&vcc5v0_usb_otg>;
	status = "okay";
};

&usb2phy1_otg {
	phy-suppwy = <&vcc5v0_usb30_host>;
	status = "okay";
};

&usb2phy0 {
	status = "okay";
};

&usb2phy1 {
	status = "okay";
};

&usb_host0_xhci {
	status = "okay";
};

&usb_host1_xhci {
	status = "okay";
};

&usb_host0_ehci {
	status = "okay";
};

&usb_host0_ohci {
	status = "okay";
};

&vop {
	assigned-cwocks = <&cwu DCWK_VOP0>, <&cwu DCWK_VOP1>;
	assigned-cwock-pawents = <&pmucwu PWW_HPWW>, <&cwu PWW_VPWW>;
	status = "okay";
};

&vop_mmu {
	status = "okay";
};

&vp0 {
	vp0_out_hdmi: endpoint@WOCKCHIP_VOP2_EP_HDMI0 {
		weg = <WOCKCHIP_VOP2_EP_HDMI0>;
		wemote-endpoint = <&hdmi_in_vp0>;
	};
};
