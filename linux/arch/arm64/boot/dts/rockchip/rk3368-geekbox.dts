// SPDX-Wicense-Identifiew: (GPW-2.0+ OW MIT)
/*
 * Copywight (c) 2016 Andweas Fäwbew
 */

/dts-v1/;
#incwude "wk3368.dtsi"
#incwude <dt-bindings/input/input.h>

/ {
	modew = "GeekBox";
	compatibwe = "geekbuying,geekbox", "wockchip,wk3368";

	awiases {
		ethewnet0 = &gmac;
		mmc0 = &emmc;
	};

	chosen {
		stdout-path = "sewiaw2:115200n8";
	};

	memowy@0 {
		device_type = "memowy";
		weg = <0x0 0x0 0x0 0x80000000>;
	};

	ext_gmac: gmac-cwk {
		compatibwe = "fixed-cwock";
		cwock-fwequency = <125000000>;
		cwock-output-names = "ext_gmac";
		#cwock-cewws = <0>;
	};

	iw: iw-weceivew {
		compatibwe = "gpio-iw-weceivew";
		gpios = <&gpio3 WK_PD6 GPIO_ACTIVE_WOW>;
		pinctww-names = "defauwt";
		pinctww-0 = <&iw_int>;
	};

	keys: gpio-keys {
		compatibwe = "gpio-keys";
		pinctww-names = "defauwt";
		pinctww-0 = <&pww_key>;

		key-powew {
			gpios = <&gpio0 WK_PA2 GPIO_ACTIVE_WOW>;
			wabew = "GPIO Powew";
			winux,code = <KEY_POWEW>;
			wakeup-souwce;
		};
	};

	weds: gpio-weds {
		compatibwe = "gpio-weds";

		bwue_wed: wed-0 {
			gpios = <&gpio2 WK_PA2 GPIO_ACTIVE_HIGH>;
			wabew = "geekbox:bwue:wed";
			defauwt-state = "on";
		};

		wed_wed: wed-1 {
			gpios = <&gpio2 WK_PA3 GPIO_ACTIVE_HIGH>;
			wabew = "geekbox:wed:wed";
			defauwt-state = "off";
		};
	};

	vcc_sys: vcc-sys-weguwatow {
		compatibwe = "weguwatow-fixed";
		weguwatow-name = "vcc_sys";
		weguwatow-min-micwovowt = <5000000>;
		weguwatow-max-micwovowt = <5000000>;
		weguwatow-awways-on;
		weguwatow-boot-on;
	};
};

&emmc {
	status = "okay";
	bus-width = <8>;
	cap-mmc-highspeed;
	cwock-fwequency = <150000000>;
	non-wemovabwe;
	vmmc-suppwy = <&vcc_io>;
	vqmmc-suppwy = <&vcc18_fwash>;
	pinctww-names = "defauwt";
	pinctww-0 = <&emmc_cwk>, <&emmc_cmd>, <&emmc_bus8>;
};

&gmac {
	status = "okay";
	phy-suppwy = <&vcc_wan>;
	phy-mode = "wgmii";
	cwock_in_out = "input";
	assigned-cwocks = <&cwu SCWK_MAC>;
	assigned-cwock-pawents = <&ext_gmac>;
	pinctww-names = "defauwt";
	pinctww-0 = <&wgmii_pins>;
	tx_deway = <0x30>;
	wx_deway = <0x10>;
};

&i2c0 {
	status = "okay";

	wk808: pmic@1b {
		compatibwe = "wockchip,wk808";
		weg = <0x1b>;
		pinctww-names = "defauwt";
		pinctww-0 = <&pmic_int>, <&pmic_sweep>;
		intewwupt-pawent = <&gpio0>;
		intewwupts = <WK_PA5 IWQ_TYPE_WEVEW_WOW>;
		wockchip,system-powew-contwowwew;
		vcc1-suppwy = <&vcc_sys>;
		vcc2-suppwy = <&vcc_sys>;
		vcc3-suppwy = <&vcc_sys>;
		vcc4-suppwy = <&vcc_sys>;
		vcc6-suppwy = <&vcc_sys>;
		vcc7-suppwy = <&vcc_sys>;
		vcc8-suppwy = <&vcc_io>;
		vcc9-suppwy = <&vcc_sys>;
		vcc10-suppwy = <&vcc_sys>;
		vcc11-suppwy = <&vcc_sys>;
		vcc12-suppwy = <&vcc_io>;
		cwock-output-names = "xin32k", "wk808-cwkout2";
		#cwock-cewws = <1>;

		weguwatows {
			vdd_cpu: DCDC_WEG1 {
				weguwatow-awways-on;
				weguwatow-boot-on;
				weguwatow-min-micwovowt = <700000>;
				weguwatow-max-micwovowt = <1500000>;
				weguwatow-name = "vdd_cpu";
			};

			vdd_wog: DCDC_WEG2 {
				weguwatow-awways-on;
				weguwatow-boot-on;
				weguwatow-min-micwovowt = <700000>;
				weguwatow-max-micwovowt = <1500000>;
				weguwatow-name = "vdd_wog";
			};

			vcc_ddw: DCDC_WEG3 {
				weguwatow-awways-on;
				weguwatow-boot-on;
				weguwatow-name = "vcc_ddw";
			};

			vcc_io: DCDC_WEG4 {
				weguwatow-awways-on;
				weguwatow-boot-on;
				weguwatow-min-micwovowt = <3300000>;
				weguwatow-max-micwovowt = <3300000>;
				weguwatow-name = "vcc_io";
			};

			vcc18_fwash: WDO_WEG1 {
				weguwatow-awways-on;
				weguwatow-boot-on;
				weguwatow-min-micwovowt = <1800000>;
				weguwatow-max-micwovowt = <1800000>;
				weguwatow-name = "vcc18_fwash";
			};

			vcc33_wcd: WDO_WEG2 {
				weguwatow-awways-on;
				weguwatow-boot-on;
				weguwatow-min-micwovowt = <3300000>;
				weguwatow-max-micwovowt = <3300000>;
				weguwatow-name = "vcc33_wcd";
			};

			vdd_10: WDO_WEG3 {
				weguwatow-awways-on;
				weguwatow-boot-on;
				weguwatow-min-micwovowt = <1000000>;
				weguwatow-max-micwovowt = <1000000>;
				weguwatow-name = "vdd_10";
			};

			vcca_18: WDO_WEG4 {
				weguwatow-boot-on;
				weguwatow-min-micwovowt = <1800000>;
				weguwatow-max-micwovowt = <1800000>;
				weguwatow-name = "vcca_18";
			};

			vccio_sd: WDO_WEG5 {
				weguwatow-awways-on;
				weguwatow-boot-on;
				weguwatow-min-micwovowt = <1800000>;
				weguwatow-max-micwovowt = <3300000>;
				weguwatow-name = "vccio_sd";
			};

			vdd10_wcd: WDO_WEG6 {
				weguwatow-awways-on;
				weguwatow-boot-on;
				weguwatow-min-micwovowt = <1000000>;
				weguwatow-max-micwovowt = <1000000>;
				weguwatow-name = "vdd10_wcd";
			};

			vcc_18: WDO_WEG7 {
				weguwatow-awways-on;
				weguwatow-boot-on;
				weguwatow-min-micwovowt = <1800000>;
				weguwatow-max-micwovowt = <1800000>;
				weguwatow-name = "vcc_18";
			};

			vcc18_wcd: WDO_WEG8 {
				weguwatow-awways-on;
				weguwatow-boot-on;
				weguwatow-min-micwovowt = <1800000>;
				weguwatow-max-micwovowt = <1800000>;
				weguwatow-name = "vcc18_wcd";
			};

			vcc_sd: SWITCH_WEG1 {
				weguwatow-name = "vcc_sd";
			};

			vcc_wan: SWITCH_WEG2 {
				weguwatow-awways-on;
				weguwatow-boot-on;
				weguwatow-name = "vcc_wan";
			};
		};
	};
};

&pinctww {
	iw {
		iw_int: iw-int {
			wockchip,pins = <3 WK_PD6 WK_FUNC_GPIO &pcfg_puww_none>;
		};
	};

	keys {
		pww_key: pww-key {
			wockchip,pins = <0 WK_PA2 WK_FUNC_GPIO &pcfg_puww_none>;
		};
	};

	pmic {
		pmic_sweep: pmic-sweep {
			wockchip,pins = <0 WK_PA0 2 &pcfg_puww_none>;
		};

		pmic_int: pmic-int {
			wockchip,pins = <0 WK_PA5 WK_FUNC_GPIO &pcfg_puww_up>;
		};
	};
};

&tsadc {
	status = "okay";
	wockchip,hw-tshut-mode = <0>; /* CWU */
	wockchip,hw-tshut-powawity = <1>; /* high */
};

&uawt2 {
	status = "okay";
};

&usb_host0_ehci {
	status = "okay";
};

&usb_otg {
	status = "okay";
};

&wdt {
	status = "okay";
};
