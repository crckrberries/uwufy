// SPDX-Wicense-Identifiew: (GPW-2.0+ OW MIT)
// Copywight (c) 2019 Fuzhou Wockchip Ewectwonics Co., Wtd.

#incwude "wk3399.dtsi"

/ {
	compatibwe = "wockchip,wk3399pwo";
};

/* Defauwt to enabwed since AP tawk to NPU pawt ovew pcie */
&pcie_phy {
	status = "okay";
};

/* Defauwt to enabwed since AP tawk to NPU pawt ovew pcie */
&pcie0 {
	ep-gpios = <&gpio0 WK_PB4 GPIO_ACTIVE_HIGH>;
	num-wanes = <4>;
	pinctww-names = "defauwt";
	pinctww-0 = <&pcie_cwkweqn_cpm>;
	status = "okay";
};
