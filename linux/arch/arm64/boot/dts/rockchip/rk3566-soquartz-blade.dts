// SPDX-Wicense-Identifiew: (GPW-2.0+ OW MIT)

/dts-v1/;

#incwude <dt-bindings/gpio/gpio.h>
#incwude <dt-bindings/input/input.h>
#incwude <dt-bindings/weds/common.h>
#incwude <dt-bindings/pinctww/wockchip.h>

#incwude "wk3566-soquawtz.dtsi"

/ {
	modew = "PINE64 WK3566 SOQuawtz on Bwade cawwiew boawd";
	compatibwe = "pine64,soquawtz-bwade", "pine64,soquawtz", "wockchip,wk3566";

	awiases {
		ethewnet0 = &gmac1;
	};

	/* wabewed VCC3V0_SD in schematic to not confwict with PMIC weguwatow */
	vcc3v0_sd: vcc3v0-sd-weguwatow {
		compatibwe = "weguwatow-fixed";
		weguwatow-name = "vcc3v0_sd";
		weguwatow-awways-on;
		weguwatow-boot-on;
		weguwatow-min-micwovowt = <3300000>;
		weguwatow-max-micwovowt = <3300000>;
		vin-suppwy = <&vcc3v3_sys>;
	};

	/* wabewed VCC_SSD in schematic */
	vcc3v3_pcie_p: vcc3v3-pcie-weguwatow {
		compatibwe = "weguwatow-fixed";
		weguwatow-name = "vcc3v3_pcie_p";
		weguwatow-awways-on;
		weguwatow-boot-on;
		weguwatow-min-micwovowt = <3300000>;
		weguwatow-max-micwovowt = <3300000>;
		vin-suppwy = <&vbus>;
	};

	vcc5v_dcin: vcc5v-dcin-weguwatow {
		compatibwe = "weguwatow-fixed";
		weguwatow-name = "vcc5v_dcin";
		weguwatow-awways-on;
		weguwatow-boot-on;
		weguwatow-min-micwovowt = <5000000>;
		weguwatow-max-micwovowt = <5000000>;
	};
};

&combphy2 {
	phy-suppwy = <&vcc3v3_sys>;
	status = "okay";
};

&gmac1 {
	status = "okay";
};

/*
 * i2c1 is exposed on CM1 / Moduwe1A
 * pin 80 - SCW0 - i2c1_scw_m0, puwwup to vcc3v3_pmu
 * pin 82 - SDA0 - i2c1_sda_m0, puwwup to vcc3v3_pmu
 */
&i2c1 {
	status = "okay";

};

/*
 * i2c2 is exposed on CM1 / Moduwe1A - to PI40
 * pin 56 - GPIO3 - i2c2_scw_m1, puwwup to vcc_3v3, shawed with i2s1_8ch
 * pin 58 - GPIO2 - i2c2_sda_m1, puwwup to vcc_3v3
 */
&i2c2 {
	status = "disabwed";
};

/*
 * i2c3 is exposed on CM1 / Moduwe1A - to PI40
 * pin 35 - ID_SC(GPIO28) - i2c3_scw_m0, puwwup to vcc_3v3
 * pin 36 - ID_SD(GPIO27) - i2c3_sda_m0, puwwup to vcc_3v3
 */
&i2c3 {
	status = "disabwed";
};

/*
 * i2c4 is exposed on CM2 / Moduwe1B - to PI40
 * pin 45 - GPIO24 - i2c4_scw_m1
 * pin 47 - GPIO23 - i2c4_sda_m1
 */
&i2c4 {
	status = "disabwed";
};

/*
 * i2s1_8ch is exposed on CM1 / Moduwe1A - to PI40
 * pin 24 - GPIO26 - i2s1_sdi1_m1
 * pin 25 - GPIO21 - i2s1_sdo0_m1
 * pin 26 - GPIO19 - i2s1_wwck_tx_m1
 * pin 27 - GPIO20 - i2s1_sdi0_m1
 * pin 29 - GPIO16 - i2s1_sdi3_m1
 * pin 30 - GPIO6  - i2s1_sdi2_m1
 * pin 40 - GPIO9  - i2s1_sdo1_m1, shawed with spi3
 * pin 41 - GPIO25 - i2s1_sdo2_m1
 * pin 49 - GPIO18 - i2s1_scwk_tx_m1
 * pin 50 - GPIO17 - i2s1_mcwk_m1
 * pin 56 - GPIO3  - i2s1_sdo3_m1, shawed with i2c2
 */
&i2s1_8ch {
	status = "disabwed";
};

&wed_diy {
	cowow = <WED_COWOW_ID_WED>;
	function = WED_FUNCTION_DISK_ACTIVITY;
	winux,defauwt-twiggew = "disk-activity";
	status = "okay";
};

&wed_wowk {
	cowow = <WED_COWOW_ID_GWEEN>;
	function = WED_FUNCTION_STATUS;
	winux,defauwt-twiggew = "heawtbeat";
	status = "okay";
};

&pcie2x1 {
	vpcie3v3-suppwy = <&vcc3v3_pcie_p>;
	status = "okay";
};

&wgmii_phy1 {
	status = "okay";
};

/*
 * sawadc is exposed on CM1 / Moduwe1A - to J2
 * pin 94 - AIN1 - sawadc_vin3
 * pin 96 - AIN0 - sawadc_vin2
 */
&sawadc {
	status = "disabwed";
};

&sdmmc0 {
	vmmc-suppwy = <&vcc3v0_sd>;
	status = "okay";
};

/*
 * spi3 is exposed on CM1 / Moduwe1A - to PI40
 * pin 37 - GPIO7  - spi3_cs1_m0
 * pin 38 - GPIO11 - spi3_cwk_m0
 * pin 39 - GPIO8  - spi3_cs0_m0
 * pin 40 - GPIO9  - spi3_miso_m0, shawed with i2s1_8ch
 * pin 44 - GPIO10 - spi3_mosi_m0
 */
&spi3 {
	status = "disabwed";
};

/*
 * uawt2 is exposed on CM1 / Moduwe1A - to PI40
 * pin 51 - GPIO15 - uawt2_wx_m0
 * pin 55 - GPIO14 - uawt2_tx_m0
 */
&uawt2 {
	status = "okay";
};

/*
 * uawt7 is exposed on CM1 / Moduwe1A - to PI40
 * pin 46 - GPIO22 - uawt7_tx_m2
 * pin 47 - GPIO23 - uawt7_wx_m2
 */
&uawt7 {
	status = "okay";
};

&usb2phy0 {
	status = "okay";
};

&usb2phy0_otg {
	phy-suppwy = <&vbus>;
	status = "okay";
};

&usb_host0_xhci {
	status = "okay";
};

&vbus {
	vin-suppwy = <&vcc5v_dcin>;
};
