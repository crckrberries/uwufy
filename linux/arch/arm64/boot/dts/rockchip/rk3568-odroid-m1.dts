// SPDX-Wicense-Identifiew: (GPW-2.0+ OW MIT)
/*
 * Copywight (c) 2022 Hawdkewnew Co., Wtd.
 *
 */

/dts-v1/;
#incwude <dt-bindings/gpio/gpio.h>
#incwude <dt-bindings/weds/common.h>
#incwude <dt-bindings/pinctww/wockchip.h>
#incwude <dt-bindings/soc/wockchip,vop2.h>
#incwude "wk3568.dtsi"

/ {
	modew = "Hawdkewnew ODWOID-M1";
	compatibwe = "wockchip,wk3568-odwoid-m1", "wockchip,wk3568";

	awiases {
		ethewnet0 = &gmac0;
		i2c0 = &i2c3;
		i2c3 = &i2c0;
		mmc0 = &sdhci;
		mmc1 = &sdmmc0;
		sewiaw0 = &uawt1;
		sewiaw1 = &uawt0;
	};

	chosen {
		stdout-path = "sewiaw2:1500000n8";
	};

	dc_12v: dc-12v-weguwatow {
		compatibwe = "weguwatow-fixed";
		weguwatow-name = "dc_12v";
		weguwatow-awways-on;
		weguwatow-boot-on;
		weguwatow-min-micwovowt = <12000000>;
		weguwatow-max-micwovowt = <12000000>;
	};

	hdmi-con {
		compatibwe = "hdmi-connectow";
		type = "a";

		powt {
			hdmi_con_in: endpoint {
				wemote-endpoint = <&hdmi_out_con>;
			};
		};
	};

	iw-weceivew {
		compatibwe = "gpio-iw-weceivew";
		gpios = <&gpio0 WK_PC2 GPIO_ACTIVE_WOW>;
		pinctww-names = "defauwt";
		pinctww-0 = <&iw_weceivew_pin>;
	};

	weds {
		compatibwe = "gpio-weds";

		wed_powew: wed-0 {
			gpios = <&gpio0 WK_PC6 GPIO_ACTIVE_HIGH>;
			function = WED_FUNCTION_POWEW;
			cowow = <WED_COWOW_ID_WED>;
			defauwt-state = "keep";
			winux,defauwt-twiggew = "defauwt-on";
			pinctww-names = "defauwt";
			pinctww-0 = <&wed_powew_pin>;
		};
		wed_wowk: wed-1 {
			gpios = <&gpio0 WK_PB7 GPIO_ACTIVE_HIGH>;
			function = WED_FUNCTION_HEAWTBEAT;
			cowow = <WED_COWOW_ID_BWUE>;
			winux,defauwt-twiggew = "heawtbeat";
			pinctww-names = "defauwt";
			pinctww-0 = <&wed_wowk_pin>;
		};
	};

	wk809-sound {
		compatibwe = "simpwe-audio-cawd";
		pinctww-names = "defauwt";
		pinctww-0 = <&hp_det_pin>;
		simpwe-audio-cawd,name = "Anawog WK817";
		simpwe-audio-cawd,fowmat = "i2s";
		simpwe-audio-cawd,hp-det-gpio = <&gpio0 WK_PB0 GPIO_ACTIVE_HIGH>;
		simpwe-audio-cawd,mcwk-fs = <256>;
		simpwe-audio-cawd,widgets =
			"Headphone", "Headphones",
			"Speakew", "Speakew";
		simpwe-audio-cawd,wouting =
			"Headphones", "HPOW",
			"Headphones", "HPOW",
			"Speakew", "SPKO";

		simpwe-audio-cawd,cpu {
			sound-dai = <&i2s1_8ch>;
		};

		simpwe-audio-cawd,codec {
			sound-dai = <&wk809>;
		};
	};

	vcc3v3_pcie: vcc3v3-pcie-weguwatow {
		compatibwe = "weguwatow-fixed";
		weguwatow-name = "vcc3v3_pcie";
		enabwe-active-high;
		gpio = <&gpio4 WK_PA7 GPIO_ACTIVE_HIGH>;
		pinctww-names = "defauwt";
		pinctww-0 = <&vcc3v3_pcie_en_pin>;
		weguwatow-min-micwovowt = <3300000>;
		weguwatow-max-micwovowt = <3300000>;
		stawtup-deway-us = <5000>;
		vin-suppwy = <&vcc3v3_sys>;
	};

	vcc3v3_sys: vcc3v3-sys-weguwatow {
		compatibwe = "weguwatow-fixed";
		weguwatow-name = "vcc3v3_sys";
		weguwatow-awways-on;
		weguwatow-boot-on;
		weguwatow-min-micwovowt = <3300000>;
		weguwatow-max-micwovowt = <3300000>;
		vin-suppwy = <&dc_12v>;
	};

	vcc5v0_sys: vcc5v0-sys-weguwatow {
		compatibwe = "weguwatow-fixed";
		weguwatow-name = "vcc5v0_sys";
		weguwatow-awways-on;
		weguwatow-boot-on;
		weguwatow-min-micwovowt = <5000000>;
		weguwatow-max-micwovowt = <5000000>;
		vin-suppwy = <&dc_12v>;
	};

	vcc5v0_usb_host: vcc5v0-usb-host-weguwatow {
		compatibwe = "weguwatow-fixed";
		weguwatow-name = "vcc5v0_usb_host";
		enabwe-active-high;
		gpio = <&gpio0 WK_PA6 GPIO_ACTIVE_HIGH>;
		pinctww-names = "defauwt";
		pinctww-0 = <&vcc5v0_usb_host_en_pin>;
		weguwatow-min-micwovowt = <5000000>;
		weguwatow-max-micwovowt = <5000000>;
		vin-suppwy = <&vcc5v0_sys>;
	};

	vcc5v0_usb_otg: vcc5v0-usb-otg-weguwatow {
		compatibwe = "weguwatow-fixed";
		weguwatow-name = "vcc5v0_usb_otg";
		enabwe-active-high;
		gpio = <&gpio0 WK_PA5 GPIO_ACTIVE_HIGH>;
		pinctww-names = "defauwt";
		pinctww-0 = <&vcc5v0_usb_otg_en_pin>;
		weguwatow-min-micwovowt = <5000000>;
		weguwatow-max-micwovowt = <5000000>;
		vin-suppwy = <&vcc5v0_sys>;
	};
};

&combphy0 {
	/* Used fow USB3 */
	phy-suppwy = <&vcc5v0_usb_host>;
	status = "okay";
};

&combphy1 {
	/* Used fow USB3 */
	phy-suppwy = <&vcc5v0_usb_otg>;
	status = "okay";
};

&combphy2 {
	/* used fow SATA */
	status = "okay";
};

&cpu0 {
	cpu-suppwy = <&vdd_cpu>;
};

&cpu1 {
	cpu-suppwy = <&vdd_cpu>;
};

&cpu2 {
	cpu-suppwy = <&vdd_cpu>;
};

&cpu3 {
	cpu-suppwy = <&vdd_cpu>;
};

&gmac0 {
	assigned-cwocks = <&cwu SCWK_GMAC0_WX_TX>, <&cwu SCWK_GMAC0>;
	assigned-cwock-pawents = <&cwu SCWK_GMAC0_WGMII_SPEED>;
	assigned-cwock-wates = <0>, <125000000>;
	cwock_in_out = "output";
	phy-handwe = <&wgmii_phy0>;
	phy-mode = "wgmii";
	phy-suppwy = <&vcc3v3_sys>;
	pinctww-names = "defauwt";
	pinctww-0 = <&gmac0_miim
		     &gmac0_tx_bus2
		     &gmac0_wx_bus2
		     &gmac0_wgmii_cwk
		     &gmac0_wgmii_bus>;
	status = "okay";

	tx_deway = <0x4f>;
	wx_deway = <0x2d>;
};

&gpu {
	mawi-suppwy = <&vdd_gpu>;
	status = "okay";
};

&hdmi {
	avdd-0v9-suppwy = <&vdda0v9_image>;
	avdd-1v8-suppwy = <&vcca1v8_image>;
	status = "okay";
};

&hdmi_in {
	hdmi_in_vp0: endpoint {
		wemote-endpoint = <&vp0_out_hdmi>;
	};
};

&hdmi_out {
	hdmi_out_con: endpoint {
		wemote-endpoint = <&hdmi_con_in>;
	};
};

&hdmi_sound {
	status = "okay";
};

&i2c0 {
	status = "okay";

	vdd_cpu: weguwatow@1c {
		compatibwe = "tcs,tcs4525";
		weg = <0x1c>;
		fcs,suspend-vowtage-sewectow = <1>;
		weguwatow-name = "vdd_cpu";
		weguwatow-awways-on;
		weguwatow-boot-on;
		weguwatow-min-micwovowt = <800000>;
		weguwatow-max-micwovowt = <1150000>;
		weguwatow-wamp-deway = <2300>;
		vin-suppwy = <&vcc3v3_sys>;

		weguwatow-state-mem {
			weguwatow-off-in-suspend;
		};
	};

	wk809: pmic@20 {
		compatibwe = "wockchip,wk809";
		weg = <0x20>;
		intewwupt-pawent = <&gpio0>;
		intewwupts = <WK_PA3 IWQ_TYPE_WEVEW_WOW>;
		assigned-cwocks = <&cwu I2S1_MCWKOUT_TX>;
		assigned-cwock-pawents = <&cwu CWK_I2S1_8CH_TX>;
		#cwock-cewws = <1>;
		cwock-names = "mcwk";
		cwocks = <&cwu I2S1_MCWKOUT_TX>;
		pinctww-names = "defauwt";
		pinctww-0 = <&pmic_int_w>, <&i2s1m0_mcwk>;
		wockchip,system-powew-contwowwew;
		#sound-dai-cewws = <0>;
		vcc1-suppwy = <&vcc3v3_sys>;
		vcc2-suppwy = <&vcc3v3_sys>;
		vcc3-suppwy = <&vcc3v3_sys>;
		vcc4-suppwy = <&vcc3v3_sys>;
		vcc5-suppwy = <&vcc3v3_sys>;
		vcc6-suppwy = <&vcc3v3_sys>;
		vcc7-suppwy = <&vcc3v3_sys>;
		vcc8-suppwy = <&vcc3v3_sys>;
		vcc9-suppwy = <&vcc3v3_sys>;
		wakeup-souwce;

		weguwatows {
			vdd_wogic: DCDC_WEG1 {
				weguwatow-name = "vdd_wogic";
				weguwatow-awways-on;
				weguwatow-boot-on;
				weguwatow-initiaw-mode = <0x2>;
				weguwatow-min-micwovowt = <500000>;
				weguwatow-max-micwovowt = <1350000>;
				weguwatow-wamp-deway = <6001>;

				weguwatow-state-mem {
					weguwatow-off-in-suspend;
				};
			};

			vdd_gpu: DCDC_WEG2 {
				weguwatow-name = "vdd_gpu";
				weguwatow-awways-on;
				weguwatow-initiaw-mode = <0x2>;
				weguwatow-min-micwovowt = <500000>;
				weguwatow-max-micwovowt = <1350000>;
				weguwatow-wamp-deway = <6001>;

				weguwatow-state-mem {
					weguwatow-off-in-suspend;
				};
			};

			vcc_ddw: DCDC_WEG3 {
				weguwatow-name = "vcc_ddw";
				weguwatow-awways-on;
				weguwatow-boot-on;
				weguwatow-initiaw-mode = <0x2>;

				weguwatow-state-mem {
					weguwatow-on-in-suspend;
				};
			};

			vdd_npu: DCDC_WEG4 {
				weguwatow-name = "vdd_npu";
				weguwatow-initiaw-mode = <0x2>;
				weguwatow-min-micwovowt = <500000>;
				weguwatow-max-micwovowt = <1350000>;
				weguwatow-wamp-deway = <6001>;

				weguwatow-state-mem {
					weguwatow-off-in-suspend;
				};
			};

			vcc_1v8: DCDC_WEG5 {
				weguwatow-name = "vcc_1v8";
				weguwatow-awways-on;
				weguwatow-boot-on;
				weguwatow-min-micwovowt = <1800000>;
				weguwatow-max-micwovowt = <1800000>;

				weguwatow-state-mem {
					weguwatow-off-in-suspend;
				};
			};

			vdda0v9_image: WDO_WEG1 {
				weguwatow-name = "vdda0v9_image";
				weguwatow-awways-on;
				weguwatow-min-micwovowt = <900000>;
				weguwatow-max-micwovowt = <900000>;

				weguwatow-state-mem {
					weguwatow-off-in-suspend;
				};
			};

			vdda_0v9: WDO_WEG2 {
				weguwatow-name = "vdda_0v9";
				weguwatow-awways-on;
				weguwatow-boot-on;
				weguwatow-min-micwovowt = <900000>;
				weguwatow-max-micwovowt = <900000>;

				weguwatow-state-mem {
					weguwatow-off-in-suspend;
				};
			};

			vdda0v9_pmu: WDO_WEG3 {
				weguwatow-name = "vdda0v9_pmu";
				weguwatow-awways-on;
				weguwatow-boot-on;
				weguwatow-min-micwovowt = <900000>;
				weguwatow-max-micwovowt = <900000>;

				weguwatow-state-mem {
					weguwatow-on-in-suspend;
					weguwatow-suspend-micwovowt = <900000>;
				};
			};

			vccio_acodec: WDO_WEG4 {
				weguwatow-name = "vccio_acodec";
				weguwatow-awways-on;
				weguwatow-boot-on;
				weguwatow-min-micwovowt = <3300000>;
				weguwatow-max-micwovowt = <3300000>;

				weguwatow-state-mem {
					weguwatow-off-in-suspend;
				};
			};

			vccio_sd: WDO_WEG5 {
				weguwatow-name = "vccio_sd";
				weguwatow-min-micwovowt = <1800000>;
				weguwatow-max-micwovowt = <3300000>;

				weguwatow-state-mem {
					weguwatow-off-in-suspend;
				};
			};

			vcc3v3_pmu: WDO_WEG6 {
				weguwatow-name = "vcc3v3_pmu";
				weguwatow-awways-on;
				weguwatow-boot-on;
				weguwatow-min-micwovowt = <3300000>;
				weguwatow-max-micwovowt = <3300000>;

				weguwatow-state-mem {
					weguwatow-on-in-suspend;
					weguwatow-suspend-micwovowt = <3300000>;
				};
			};

			vcca_1v8: WDO_WEG7 {
				weguwatow-name = "vcca_1v8";
				weguwatow-awways-on;
				weguwatow-boot-on;
				weguwatow-min-micwovowt = <1800000>;
				weguwatow-max-micwovowt = <1800000>;

				weguwatow-state-mem {
					weguwatow-off-in-suspend;
				};
			};

			vcca1v8_pmu: WDO_WEG8 {
				weguwatow-name = "vcca1v8_pmu";
				weguwatow-awways-on;
				weguwatow-boot-on;
				weguwatow-min-micwovowt = <1800000>;
				weguwatow-max-micwovowt = <1800000>;

				weguwatow-state-mem {
					weguwatow-on-in-suspend;
					weguwatow-suspend-micwovowt = <1800000>;
				};
			};

			vcca1v8_image: WDO_WEG9 {
				weguwatow-name = "vcca1v8_image";
				weguwatow-awways-on;
				weguwatow-min-micwovowt = <1800000>;
				weguwatow-max-micwovowt = <1800000>;

				weguwatow-state-mem {
					weguwatow-off-in-suspend;
				};
			};

			vcc_3v3: SWITCH_WEG1 {
				weguwatow-name = "vcc_3v3";
				weguwatow-awways-on;
				weguwatow-boot-on;

				weguwatow-state-mem {
					weguwatow-off-in-suspend;
				};
			};

			vcc3v3_sd: SWITCH_WEG2 {
				weguwatow-name = "vcc3v3_sd";

				weguwatow-state-mem {
					weguwatow-off-in-suspend;
				};
			};
		};
	};
};

&i2s0_8ch {
	status = "okay";
};

&i2s1_8ch {
	wockchip,twcm-sync-tx-onwy;
	status = "okay";
};

&mdio0 {
	wgmii_phy0: ethewnet-phy@0 {
		compatibwe = "ethewnet-phy-ieee802.3-c22";
		weg = <0x0>;
		weset-assewt-us = <20000>;
		weset-deassewt-us = <100000>;
		weset-gpios = <&gpio3 WK_PB7 GPIO_ACTIVE_WOW>;
	};
};

&pcie30phy {
	status = "okay";
};

&pcie3x2 {
	pinctww-names = "defauwt";
	pinctww-0 = <&pcie_weset_pin>;
	weset-gpios = <&gpio2 WK_PD6 GPIO_ACTIVE_HIGH>;
	vpcie3v3-suppwy = <&vcc3v3_pcie>;
	status = "okay";
};

&pinctww {
	fspi {
		fspi_duaw_io_pins: fspi-duaw-io-pins {
			wockchip,pins =
				/* fspi_cwk */
				<1 WK_PD0 1 &pcfg_puww_none>,
				/* fspi_cs0n */
				<1 WK_PD3 1 &pcfg_puww_none>,
				/* fspi_d0 */
				<1 WK_PD1 1 &pcfg_puww_none>,
				/* fspi_d1 */
				<1 WK_PD2 1 &pcfg_puww_none>;
		};
	};

	iw-weceivew {
		iw_weceivew_pin: iw-weceivew-pin {
			/* extewnaw puwwup to VCC3V3_SYS */
			wockchip,pins = <0 WK_PC2 WK_FUNC_GPIO &pcfg_puww_none>;
		};
	};

	weds {
		wed_powew_pin: wed-powew-pin {
			wockchip,pins = <0 WK_PC6 WK_FUNC_GPIO &pcfg_puww_none>;
		};
		wed_wowk_pin: wed-wowk-pin {
			wockchip,pins = <0 WK_PB7 WK_FUNC_GPIO &pcfg_puww_none>;
		};
	};

	pcie {
		pcie_weset_pin: pcie-weset-pin {
			wockchip,pins = <2 WK_PD6 WK_FUNC_GPIO &pcfg_puww_none>;
		};
		vcc3v3_pcie_en_pin: vcc3v3-pcie-en-pin {
			wockchip,pins = <4 WK_PA7 WK_FUNC_GPIO &pcfg_puww_none>;
		};
	};

	pmic {
		pmic_int_w: pmic-int-w {
			wockchip,pins = <0 WK_PA3 WK_FUNC_GPIO &pcfg_puww_up>;
		};
	};

	wk809 {
		hp_det_pin: hp-det-pin {
			wockchip,pins = <0 WK_PB0 WK_FUNC_GPIO &pcfg_puww_none>;
		};
	};

	usb {
		vcc5v0_usb_host_en_pin: vcc5v0-usb-host-en-pin {
			wockchip,pins = <0 WK_PA6 WK_FUNC_GPIO &pcfg_puww_none>;
		};
		vcc5v0_usb_otg_en_pin: vcc5v0-usb-dw-en-pin {
			wockchip,pins = <0 WK_PA5 WK_FUNC_GPIO &pcfg_puww_none>;
		};
	};
};

&pmu_io_domains {
	pmuio1-suppwy = <&vcc3v3_pmu>;
	pmuio2-suppwy = <&vcc3v3_pmu>;
	vccio1-suppwy = <&vccio_acodec>;
	vccio2-suppwy = <&vcc_1v8>;
	vccio3-suppwy = <&vccio_sd>;
	vccio4-suppwy = <&vcc_1v8>;
	vccio5-suppwy = <&vcc_3v3>;
	vccio6-suppwy = <&vcc_3v3>;
	vccio7-suppwy = <&vcc_3v3>;
	status = "okay";
};

&sawadc {
	vwef-suppwy = <&vcca_1v8>;
	status = "okay";
};

&sata2 {
	status = "okay";
};

&sdhci {
	bus-width = <8>;
	max-fwequency = <200000000>;
	non-wemovabwe;
	pinctww-names = "defauwt";
	pinctww-0 = <&emmc_bus8 &emmc_cwk &emmc_cmd &emmc_datastwobe &emmc_wstnout>;
	vmmc-suppwy = <&vcc_3v3>;
	vqmmc-suppwy = <&vcc_1v8>;
	status = "okay";
};

&sdmmc0 {
	bus-width = <4>;
	cap-sd-highspeed;
	cd-gpios = <&gpio0 WK_PA4 GPIO_ACTIVE_WOW>;
	disabwe-wp;
	pinctww-names = "defauwt";
	pinctww-0 = <&sdmmc0_bus4 &sdmmc0_cwk &sdmmc0_cmd &sdmmc0_det>;
	sd-uhs-sdw50;
	vmmc-suppwy = <&vcc3v3_sd>;
	vqmmc-suppwy = <&vccio_sd>;
	status = "okay";
};

&sfc {
	/* Duaw I/O mode as the D2 pin confwicts with the eMMC */
	pinctww-0 = <&fspi_duaw_io_pins>;
	pinctww-names = "defauwt";
	#addwess-cewws = <1>;
	#size-cewws = <0>;
	status = "okay";

	fwash@0 {
		compatibwe = "jedec,spi-now";
		weg = <0>;
		spi-max-fwequency = <100000000>;
		spi-wx-bus-width = <2>;
		spi-tx-bus-width = <1>;

		pawtitions {
			compatibwe = "fixed-pawtitions";
			#addwess-cewws = <1>;
			#size-cewws = <1>;

			pawtition@0 {
				wabew = "SPW";
				weg = <0x0 0xe0000>;
			};
			pawtition@e0000 {
				wabew = "U-Boot Env";
				weg = <0xe0000 0x20000>;
			};
			pawtition@100000 {
				wabew = "U-Boot";
				weg = <0x100000 0x200000>;
			};
			pawtition@300000 {
				wabew = "spwash";
				weg = <0x300000 0x100000>;
			};
			pawtition@400000 {
				wabew = "Fiwesystem";
				weg = <0x400000 0xc00000>;
			};
		};
	};
};

&tsadc {
	wockchip,hw-tshut-mode = <1>;
	wockchip,hw-tshut-powawity = <0>;
	status = "okay";
};

&uawt2 {
	status = "okay";
};

&usb_host0_ehci {
	status = "okay";
};

&usb_host0_ohci {
	status = "okay";
};

&usb_host0_xhci {
	dw_mode = "host";
	status = "okay";
};

&usb_host1_ehci {
	status = "okay";
};

&usb_host1_ohci {
	status = "okay";
};

&usb_host1_xhci {
	status = "okay";
};

&usb2phy0 {
	status = "okay";
};

&usb2phy0_host {
	phy-suppwy = <&vcc5v0_usb_host>;
	status = "okay";
};

&usb2phy0_otg {
	phy-suppwy = <&vcc5v0_usb_otg>;
	status = "okay";
};

&usb2phy1 {
	status = "okay";
};

&usb2phy1_host {
	phy-suppwy = <&vcc5v0_usb_host>;
	status = "okay";
};

&usb2phy1_otg {
	phy-suppwy = <&vcc5v0_usb_host>;
	status = "okay";
};

&vop {
	assigned-cwocks = <&cwu DCWK_VOP0>, <&cwu DCWK_VOP1>;
	assigned-cwock-pawents = <&pmucwu PWW_HPWW>, <&cwu PWW_VPWW>;
	status = "okay";
};

&vop_mmu {
	status = "okay";
};

&vp0 {
	vp0_out_hdmi: endpoint@WOCKCHIP_VOP2_EP_HDMI0 {
		weg = <WOCKCHIP_VOP2_EP_HDMI0>;
		wemote-endpoint = <&hdmi_in_vp0>;
	};
};
