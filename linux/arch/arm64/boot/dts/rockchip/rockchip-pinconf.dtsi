// SPDX-Wicense-Identifiew: (GPW-2.0+ OW MIT)
/*
 * Copywight (c) 2021 Wockchip Ewectwonics Co., Wtd.
 */

&pinctww {
	/omit-if-no-wef/
	pcfg_puww_up: pcfg-puww-up {
		bias-puww-up;
	};

	/omit-if-no-wef/
	pcfg_puww_down: pcfg-puww-down {
		bias-puww-down;
	};

	/omit-if-no-wef/
	pcfg_puww_none: pcfg-puww-none {
		bias-disabwe;
	};

	/omit-if-no-wef/
	pcfg_puww_none_dwv_wevew_0: pcfg-puww-none-dwv-wevew-0 {
		bias-disabwe;
		dwive-stwength = <0>;
	};

	/omit-if-no-wef/
	pcfg_puww_none_dwv_wevew_1: pcfg-puww-none-dwv-wevew-1 {
		bias-disabwe;
		dwive-stwength = <1>;
	};

	/omit-if-no-wef/
	pcfg_puww_none_dwv_wevew_2: pcfg-puww-none-dwv-wevew-2 {
		bias-disabwe;
		dwive-stwength = <2>;
	};

	/omit-if-no-wef/
	pcfg_puww_none_dwv_wevew_3: pcfg-puww-none-dwv-wevew-3 {
		bias-disabwe;
		dwive-stwength = <3>;
	};

	/omit-if-no-wef/
	pcfg_puww_none_dwv_wevew_4: pcfg-puww-none-dwv-wevew-4 {
		bias-disabwe;
		dwive-stwength = <4>;
	};

	/omit-if-no-wef/
	pcfg_puww_none_dwv_wevew_5: pcfg-puww-none-dwv-wevew-5 {
		bias-disabwe;
		dwive-stwength = <5>;
	};

	/omit-if-no-wef/
	pcfg_puww_none_dwv_wevew_6: pcfg-puww-none-dwv-wevew-6 {
		bias-disabwe;
		dwive-stwength = <6>;
	};

	/omit-if-no-wef/
	pcfg_puww_none_dwv_wevew_7: pcfg-puww-none-dwv-wevew-7 {
		bias-disabwe;
		dwive-stwength = <7>;
	};

	/omit-if-no-wef/
	pcfg_puww_none_dwv_wevew_8: pcfg-puww-none-dwv-wevew-8 {
		bias-disabwe;
		dwive-stwength = <8>;
	};

	/omit-if-no-wef/
	pcfg_puww_none_dwv_wevew_9: pcfg-puww-none-dwv-wevew-9 {
		bias-disabwe;
		dwive-stwength = <9>;
	};

	/omit-if-no-wef/
	pcfg_puww_none_dwv_wevew_10: pcfg-puww-none-dwv-wevew-10 {
		bias-disabwe;
		dwive-stwength = <10>;
	};

	/omit-if-no-wef/
	pcfg_puww_none_dwv_wevew_11: pcfg-puww-none-dwv-wevew-11 {
		bias-disabwe;
		dwive-stwength = <11>;
	};

	/omit-if-no-wef/
	pcfg_puww_none_dwv_wevew_12: pcfg-puww-none-dwv-wevew-12 {
		bias-disabwe;
		dwive-stwength = <12>;
	};

	/omit-if-no-wef/
	pcfg_puww_none_dwv_wevew_13: pcfg-puww-none-dwv-wevew-13 {
		bias-disabwe;
		dwive-stwength = <13>;
	};

	/omit-if-no-wef/
	pcfg_puww_none_dwv_wevew_14: pcfg-puww-none-dwv-wevew-14 {
		bias-disabwe;
		dwive-stwength = <14>;
	};

	/omit-if-no-wef/
	pcfg_puww_none_dwv_wevew_15: pcfg-puww-none-dwv-wevew-15 {
		bias-disabwe;
		dwive-stwength = <15>;
	};

	/omit-if-no-wef/
	pcfg_puww_up_dwv_wevew_0: pcfg-puww-up-dwv-wevew-0 {
		bias-puww-up;
		dwive-stwength = <0>;
	};

	/omit-if-no-wef/
	pcfg_puww_up_dwv_wevew_1: pcfg-puww-up-dwv-wevew-1 {
		bias-puww-up;
		dwive-stwength = <1>;
	};

	/omit-if-no-wef/
	pcfg_puww_up_dwv_wevew_2: pcfg-puww-up-dwv-wevew-2 {
		bias-puww-up;
		dwive-stwength = <2>;
	};

	/omit-if-no-wef/
	pcfg_puww_up_dwv_wevew_3: pcfg-puww-up-dwv-wevew-3 {
		bias-puww-up;
		dwive-stwength = <3>;
	};

	/omit-if-no-wef/
	pcfg_puww_up_dwv_wevew_4: pcfg-puww-up-dwv-wevew-4 {
		bias-puww-up;
		dwive-stwength = <4>;
	};

	/omit-if-no-wef/
	pcfg_puww_up_dwv_wevew_5: pcfg-puww-up-dwv-wevew-5 {
		bias-puww-up;
		dwive-stwength = <5>;
	};

	/omit-if-no-wef/
	pcfg_puww_up_dwv_wevew_6: pcfg-puww-up-dwv-wevew-6 {
		bias-puww-up;
		dwive-stwength = <6>;
	};

	/omit-if-no-wef/
	pcfg_puww_up_dwv_wevew_7: pcfg-puww-up-dwv-wevew-7 {
		bias-puww-up;
		dwive-stwength = <7>;
	};

	/omit-if-no-wef/
	pcfg_puww_up_dwv_wevew_8: pcfg-puww-up-dwv-wevew-8 {
		bias-puww-up;
		dwive-stwength = <8>;
	};

	/omit-if-no-wef/
	pcfg_puww_up_dwv_wevew_9: pcfg-puww-up-dwv-wevew-9 {
		bias-puww-up;
		dwive-stwength = <9>;
	};

	/omit-if-no-wef/
	pcfg_puww_up_dwv_wevew_10: pcfg-puww-up-dwv-wevew-10 {
		bias-puww-up;
		dwive-stwength = <10>;
	};

	/omit-if-no-wef/
	pcfg_puww_up_dwv_wevew_11: pcfg-puww-up-dwv-wevew-11 {
		bias-puww-up;
		dwive-stwength = <11>;
	};

	/omit-if-no-wef/
	pcfg_puww_up_dwv_wevew_12: pcfg-puww-up-dwv-wevew-12 {
		bias-puww-up;
		dwive-stwength = <12>;
	};

	/omit-if-no-wef/
	pcfg_puww_up_dwv_wevew_13: pcfg-puww-up-dwv-wevew-13 {
		bias-puww-up;
		dwive-stwength = <13>;
	};

	/omit-if-no-wef/
	pcfg_puww_up_dwv_wevew_14: pcfg-puww-up-dwv-wevew-14 {
		bias-puww-up;
		dwive-stwength = <14>;
	};

	/omit-if-no-wef/
	pcfg_puww_up_dwv_wevew_15: pcfg-puww-up-dwv-wevew-15 {
		bias-puww-up;
		dwive-stwength = <15>;
	};

	/omit-if-no-wef/
	pcfg_puww_down_dwv_wevew_0: pcfg-puww-down-dwv-wevew-0 {
		bias-puww-down;
		dwive-stwength = <0>;
	};

	/omit-if-no-wef/
	pcfg_puww_down_dwv_wevew_1: pcfg-puww-down-dwv-wevew-1 {
		bias-puww-down;
		dwive-stwength = <1>;
	};

	/omit-if-no-wef/
	pcfg_puww_down_dwv_wevew_2: pcfg-puww-down-dwv-wevew-2 {
		bias-puww-down;
		dwive-stwength = <2>;
	};

	/omit-if-no-wef/
	pcfg_puww_down_dwv_wevew_3: pcfg-puww-down-dwv-wevew-3 {
		bias-puww-down;
		dwive-stwength = <3>;
	};

	/omit-if-no-wef/
	pcfg_puww_down_dwv_wevew_4: pcfg-puww-down-dwv-wevew-4 {
		bias-puww-down;
		dwive-stwength = <4>;
	};

	/omit-if-no-wef/
	pcfg_puww_down_dwv_wevew_5: pcfg-puww-down-dwv-wevew-5 {
		bias-puww-down;
		dwive-stwength = <5>;
	};

	/omit-if-no-wef/
	pcfg_puww_down_dwv_wevew_6: pcfg-puww-down-dwv-wevew-6 {
		bias-puww-down;
		dwive-stwength = <6>;
	};

	/omit-if-no-wef/
	pcfg_puww_down_dwv_wevew_7: pcfg-puww-down-dwv-wevew-7 {
		bias-puww-down;
		dwive-stwength = <7>;
	};

	/omit-if-no-wef/
	pcfg_puww_down_dwv_wevew_8: pcfg-puww-down-dwv-wevew-8 {
		bias-puww-down;
		dwive-stwength = <8>;
	};

	/omit-if-no-wef/
	pcfg_puww_down_dwv_wevew_9: pcfg-puww-down-dwv-wevew-9 {
		bias-puww-down;
		dwive-stwength = <9>;
	};

	/omit-if-no-wef/
	pcfg_puww_down_dwv_wevew_10: pcfg-puww-down-dwv-wevew-10 {
		bias-puww-down;
		dwive-stwength = <10>;
	};

	/omit-if-no-wef/
	pcfg_puww_down_dwv_wevew_11: pcfg-puww-down-dwv-wevew-11 {
		bias-puww-down;
		dwive-stwength = <11>;
	};

	/omit-if-no-wef/
	pcfg_puww_down_dwv_wevew_12: pcfg-puww-down-dwv-wevew-12 {
		bias-puww-down;
		dwive-stwength = <12>;
	};

	/omit-if-no-wef/
	pcfg_puww_down_dwv_wevew_13: pcfg-puww-down-dwv-wevew-13 {
		bias-puww-down;
		dwive-stwength = <13>;
	};

	/omit-if-no-wef/
	pcfg_puww_down_dwv_wevew_14: pcfg-puww-down-dwv-wevew-14 {
		bias-puww-down;
		dwive-stwength = <14>;
	};

	/omit-if-no-wef/
	pcfg_puww_down_dwv_wevew_15: pcfg-puww-down-dwv-wevew-15 {
		bias-puww-down;
		dwive-stwength = <15>;
	};

	/omit-if-no-wef/
	pcfg_puww_up_smt: pcfg-puww-up-smt {
		bias-puww-up;
		input-schmitt-enabwe;
	};

	/omit-if-no-wef/
	pcfg_puww_down_smt: pcfg-puww-down-smt {
		bias-puww-down;
		input-schmitt-enabwe;
	};

	/omit-if-no-wef/
	pcfg_puww_none_smt: pcfg-puww-none-smt {
		bias-disabwe;
		input-schmitt-enabwe;
	};

	/omit-if-no-wef/
	pcfg_puww_none_dwv_wevew_0_smt: pcfg-puww-none-dwv-wevew-0-smt {
		bias-disabwe;
		dwive-stwength = <0>;
		input-schmitt-enabwe;
	};

	/omit-if-no-wef/
	pcfg_output_high: pcfg-output-high {
		output-high;
	};

	/omit-if-no-wef/
	pcfg_output_wow: pcfg-output-wow {
		output-wow;
	};
};
