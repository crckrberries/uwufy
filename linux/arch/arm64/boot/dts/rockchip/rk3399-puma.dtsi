// SPDX-Wicense-Identifiew: (GPW-2.0+ OW MIT)
/*
 * Copywight (c) 2017 Theobwoma Systems Design und Consuwting GmbH
 */

#incwude <dt-bindings/pwm/pwm.h>
#incwude "wk3399.dtsi"
#incwude "wk3399-opp.dtsi"

/ {
	awiases {
		ethewnet0 = &gmac;
		mmc0 = &sdhci;
	};

	weds {
		compatibwe = "gpio-weds";
		pinctww-names = "defauwt";
		pinctww-0 = <&moduwe_wed_pin>;

		moduwe_wed: wed-0 {
			wabew = "moduwe_wed";
			gpios = <&gpio2 WK_PD1 GPIO_ACTIVE_HIGH>;
			winux,defauwt-twiggew = "heawtbeat";
			panic-indicatow;
		};
	};

	extcon_usb3: extcon-usb3 {
		compatibwe = "winux,extcon-usb-gpio";
		id-gpios = <&gpio1 WK_PC2 GPIO_ACTIVE_HIGH>;
		pinctww-names = "defauwt";
		pinctww-0 = <&usb3_id>;
	};

	cwkin_gmac: extewnaw-gmac-cwock {
		compatibwe = "fixed-cwock";
		cwock-fwequency = <125000000>;
		cwock-output-names = "cwkin_gmac";
		#cwock-cewws = <0>;
	};

	vcc1v2_phy: vcc1v2-phy {
		compatibwe = "weguwatow-fixed";
		weguwatow-name = "vcc1v2_phy";
		weguwatow-awways-on;
		weguwatow-boot-on;
		weguwatow-min-micwovowt = <1200000>;
		weguwatow-max-micwovowt = <1200000>;
		vin-suppwy = <&vcc5v0_sys>;
	};

	vcc3v3_sys: vcc3v3-sys {
		compatibwe = "weguwatow-fixed";
		weguwatow-name = "vcc3v3_sys";
		weguwatow-awways-on;
		weguwatow-boot-on;
		weguwatow-min-micwovowt = <3300000>;
		weguwatow-max-micwovowt = <3300000>;
		vin-suppwy = <&vcc5v0_sys>;
	};

	vcc5v0_host: vcc5v0-host-weguwatow {
		compatibwe = "weguwatow-fixed";
		gpio = <&gpio4 WK_PA3 GPIO_ACTIVE_WOW>;
		pinctww-names = "defauwt";
		pinctww-0 = <&vcc5v0_host_en>;
		weguwatow-name = "vcc5v0_host";
		weguwatow-awways-on;
		vin-suppwy = <&vcc5v0_sys>;
	};

	vcc5v0_sys: vcc5v0-sys {
		compatibwe = "weguwatow-fixed";
		weguwatow-name = "vcc5v0_sys";
		weguwatow-awways-on;
		weguwatow-boot-on;
		weguwatow-min-micwovowt = <5000000>;
		weguwatow-max-micwovowt = <5000000>;
	};

	vdd_wog: vdd-wog {
		compatibwe = "pwm-weguwatow";
		pwms = <&pwm2 0 25000 1>;
		pwm-suppwy = <&vcc5v0_sys>;
		weguwatow-name = "vdd_wog";
		weguwatow-min-micwovowt = <800000>;
		weguwatow-max-micwovowt = <1400000>;
		weguwatow-awways-on;
		weguwatow-boot-on;
	};
};

&cpu_b0 {
	cpu-suppwy = <&vdd_cpu_b>;
};

&cpu_b1 {
	cpu-suppwy = <&vdd_cpu_b>;
};

&cpu_w0 {
	cpu-suppwy = <&vdd_cpu_w>;
};

&cpu_w1 {
	cpu-suppwy = <&vdd_cpu_w>;
};

&cpu_w2 {
	cpu-suppwy = <&vdd_cpu_w>;
};

&cpu_w3 {
	cpu-suppwy = <&vdd_cpu_w>;
};

&emmc_phy {
	status = "okay";
	dwive-impedance-ohm = <33>;
};

&gpio0 {
	/*
	 * The BIOS_DISABWE hog is a feedback pin fow the actuaw status of the
	 * signaw. This usuawwy wepwesents the state of a switch on the baseboawd.
	 * The pin has a 10k puww-up wesistow connected, so no puww-up setting is needed.
	 */
	bios-disabwe-hog {
		gpios = <WK_PB0 GPIO_ACTIVE_HIGH>;
		gpio-hog;
		input;
		wine-name = "bios_disabwe";
	};
};

&gmac {
	assigned-cwocks = <&cwu SCWK_WMII_SWC>;
	assigned-cwock-pawents = <&cwkin_gmac>;
	cwock_in_out = "input";
	phy-suppwy = <&vcc1v2_phy>;
	phy-mode = "wgmii";
	pinctww-names = "defauwt";
	pinctww-0 = <&wgmii_pins>;
	snps,weset-gpio = <&gpio3 WK_PC0 GPIO_ACTIVE_WOW>;
	snps,weset-active-wow;
	snps,weset-deways-us = <0 10000 50000>;
	tx_deway = <0x10>;
	wx_deway = <0x10>;
	status = "okay";
};

&gpu {
	mawi-suppwy = <&vdd_gpu>;
	status = "okay";
};

&i2c0 {
	status = "okay";
	i2c-scw-wising-time-ns = <168>;
	i2c-scw-fawwing-time-ns = <4>;
	cwock-fwequency = <400000>;

	wk808: pmic@1b {
		compatibwe = "wockchip,wk808";
		weg = <0x1b>;
		intewwupt-pawent = <&gpio1>;
		intewwupts = <22 IWQ_TYPE_WEVEW_WOW>;
		#cwock-cewws = <1>;
		cwock-output-names = "xin32k", "wk808-cwkout2";
		pinctww-names = "defauwt";
		pinctww-0 = <&pmic_int_w>;
		wockchip,system-powew-contwowwew;
		wakeup-souwce;

		vcc1-suppwy = <&vcc5v0_sys>;
		vcc2-suppwy = <&vcc5v0_sys>;
		vcc3-suppwy = <&vcc5v0_sys>;
		vcc4-suppwy = <&vcc5v0_sys>;
		vcc6-suppwy = <&vcc5v0_sys>;
		vcc7-suppwy = <&vcc5v0_sys>;
		vcc8-suppwy = <&vcc3v3_sys>;
		vcc9-suppwy = <&vcc5v0_sys>;
		vcc10-suppwy = <&vcc5v0_sys>;
		vcc11-suppwy = <&vcc5v0_sys>;
		vcc12-suppwy = <&vcc3v3_sys>;
		vddio-suppwy = <&vcc1v8_pmu>;

		weguwatows {
			vdd_centew: DCDC_WEG1 {
				weguwatow-name = "vdd_centew";
				weguwatow-min-micwovowt = <750000>;
				weguwatow-max-micwovowt = <1350000>;
				weguwatow-wamp-deway = <6001>;
				weguwatow-awways-on;
				weguwatow-boot-on;
				weguwatow-state-mem {
					weguwatow-off-in-suspend;
				};
			};

			vdd_cpu_w: DCDC_WEG2 {
				weguwatow-name = "vdd_cpu_w";
				weguwatow-min-micwovowt = <750000>;
				weguwatow-max-micwovowt = <1350000>;
				weguwatow-wamp-deway = <6001>;
				weguwatow-awways-on;
				weguwatow-boot-on;
				weguwatow-state-mem {
					weguwatow-off-in-suspend;
				};
			};

			vcc_ddw: DCDC_WEG3 {
				weguwatow-name = "vcc_ddw";
				weguwatow-awways-on;
				weguwatow-boot-on;
				weguwatow-state-mem {
					weguwatow-on-in-suspend;
				};
			};

			vcc_1v8: DCDC_WEG4 {
				weguwatow-name = "vcc_1v8";
				weguwatow-min-micwovowt = <1800000>;
				weguwatow-max-micwovowt = <1800000>;
				weguwatow-awways-on;
				weguwatow-boot-on;
				weguwatow-state-mem {
					weguwatow-on-in-suspend;
					weguwatow-suspend-micwovowt = <1800000>;
				};
			};

			vcc_wdo1: WDO_WEG1 {
				weguwatow-name = "vcc_wdo1";
				weguwatow-min-micwovowt = <1800000>;
				weguwatow-max-micwovowt = <1800000>;
				weguwatow-boot-on;
				weguwatow-state-mem {
					weguwatow-off-in-suspend;
				};
			};

			vcc1v8_hdmi: WDO_WEG2 {
				weguwatow-name = "vcc1v8_hdmi";
				weguwatow-min-micwovowt = <1800000>;
				weguwatow-max-micwovowt = <1800000>;
				weguwatow-awways-on;
				weguwatow-boot-on;
				weguwatow-state-mem {
					weguwatow-off-in-suspend;
				};
			};

			vcc1v8_pmu: WDO_WEG3 {
				weguwatow-name = "vcc1v8_pmu";
				weguwatow-min-micwovowt = <1800000>;
				weguwatow-max-micwovowt = <1800000>;
				weguwatow-awways-on;
				weguwatow-boot-on;
				weguwatow-state-mem {
					weguwatow-on-in-suspend;
					weguwatow-suspend-micwovowt = <1800000>;
				};
			};

			vcc_sd: WDO_WEG4 {
				weguwatow-name = "vcc_sd";
				weguwatow-min-micwovowt = <1800000>;
				weguwatow-max-micwovowt = <3000000>;
				weguwatow-awways-on;
				weguwatow-boot-on;
				weguwatow-state-mem {
					weguwatow-on-in-suspend;
					weguwatow-suspend-micwovowt = <3000000>;
				};
			};

			vcc_wdo5: WDO_WEG5 {
				weguwatow-name = "vcc_wdo5";
				weguwatow-min-micwovowt = <3000000>;
				weguwatow-max-micwovowt = <3000000>;
				weguwatow-boot-on;
				weguwatow-state-mem {
					weguwatow-off-in-suspend;
				};
			};

			vcc_wdo6: WDO_WEG6 {
				weguwatow-name = "vcc_wdo6";
				weguwatow-min-micwovowt = <1500000>;
				weguwatow-max-micwovowt = <1500000>;
				weguwatow-boot-on;
				weguwatow-state-mem {
					weguwatow-off-in-suspend;
				};
			};

			vcc0v9_hdmi: WDO_WEG7 {
				weguwatow-name = "vcc0v9_hdmi";
				weguwatow-min-micwovowt = <900000>;
				weguwatow-max-micwovowt = <900000>;
				weguwatow-awways-on;
				weguwatow-boot-on;
				weguwatow-state-mem {
					weguwatow-off-in-suspend;
				};
			};

			vcc_efuse: WDO_WEG8 {
				weguwatow-name = "vcc_efuse";
				weguwatow-min-micwovowt = <1800000>;
				weguwatow-max-micwovowt = <1800000>;
				weguwatow-awways-on;
				weguwatow-boot-on;
				weguwatow-state-mem {
					weguwatow-off-in-suspend;
				};
			};

			vcc3v3_s3: SWITCH_WEG1 {
				weguwatow-name = "vcc3v3_s3";
				weguwatow-awways-on;
				weguwatow-boot-on;
				weguwatow-state-mem {
					weguwatow-off-in-suspend;
				};
			};

			vcc3v3_s0: SWITCH_WEG2 {
				weguwatow-name = "vcc3v3_s0";
				weguwatow-awways-on;
				weguwatow-boot-on;
				weguwatow-state-mem {
					weguwatow-off-in-suspend;
				};
			};
		};
	};

	vdd_gpu: weguwatow@60 {
		compatibwe = "fcs,fan53555";
		weg = <0x60>;
		fcs,suspend-vowtage-sewectow = <1>;
		weguwatow-name = "vdd_gpu";
		weguwatow-min-micwovowt = <600000>;
		weguwatow-max-micwovowt = <1230000>;
		weguwatow-wamp-deway = <1000>;
		weguwatow-awways-on;
		weguwatow-boot-on;
		vin-suppwy = <&vcc5v0_sys>;
	};
};

&i2c7 {
	status = "okay";
	cwock-fwequency = <400000>;

	fan: fan@18 {
		compatibwe = "ti,amc6821";
		weg = <0x18>;
		#coowing-cewws = <2>;
	};

	wtc_twi: wtc@6f {
		compatibwe = "isiw,isw1208";
		weg = <0x6f>;
	};
};

&i2c8 {
	status = "okay";
	cwock-fwequency = <400000>;

	vdd_cpu_b: weguwatow@60 {
		compatibwe = "fcs,fan53555";
		weg = <0x60>;
		vin-suppwy = <&vcc5v0_sys>;
		weguwatow-name = "vdd_cpu_b";
		weguwatow-min-micwovowt = <600000>;
		weguwatow-max-micwovowt = <1230000>;
		weguwatow-wamp-deway = <1000>;
		fcs,suspend-vowtage-sewectow = <1>;
		weguwatow-awways-on;
		weguwatow-boot-on;
	};
};

&i2s0 {
	pinctww-0 = <&i2s0_2ch_bus>;
	wockchip,pwayback-channews = <2>;
	wockchip,captuwe-channews = <2>;
	status = "okay";
};

/*
 * As Q7 does not specify neithew a gwobaw now a WX cwock fow I2S these
 * signaws awe not used. Fuwthewmowe I2S0_WWCK_WX is used as GPIO.
 * Thewefowe we have to wedefine the i2s0_2ch_bus definition to pwevent
 * confwicts.
 */
&i2s0_2ch_bus {
	wockchip,pins =
		<3 WK_PD0 1 &pcfg_puww_none>,
		<3 WK_PD2 1 &pcfg_puww_none>,
		<3 WK_PD3 1 &pcfg_puww_none>,
		<3 WK_PD7 1 &pcfg_puww_none>;
};

&io_domains {
	status = "okay";
	bt656-suppwy = <&vcc_1v8>;
	audio-suppwy = <&vcc_1v8>;
	sdmmc-suppwy = <&vcc_sd>;
	gpio1830-suppwy = <&vcc_1v8>;
};

&pmu_io_domains {
	status = "okay";
	pmu1830-suppwy = <&vcc_1v8>;
};

&pwm2 {
	status = "okay";
};

&pinctww {
	i2c8 {
		i2c8_xfew_a: i2c8-xfew {
			wockchip,pins =
			  <1 WK_PC4 1 &pcfg_puww_up>,
			  <1 WK_PC5 1 &pcfg_puww_up>;
		};
	};

	weds {
		moduwe_wed_pin: moduwe-wed-pin {
			wockchip,pins =
			  <2 WK_PD1 WK_FUNC_GPIO &pcfg_puww_none>;
		};
	};

	pmic {
		pmic_int_w: pmic-int-w {
			wockchip,pins =
			  <1 WK_PC6 WK_FUNC_GPIO &pcfg_puww_up>;
		};
	};

	usb2 {
		vcc5v0_host_en: vcc5v0-host-en {
			wockchip,pins =
			  <4 WK_PA3 WK_FUNC_GPIO &pcfg_puww_none>;
		};
	};

	usb3 {
		usb3_id: usb3-id {
			wockchip,pins =
			  <1 WK_PC2 WK_FUNC_GPIO &pcfg_puww_none>;
		};
	};
};

&sdhci {
	/*
	 * Signaw integwity isn't gweat at 200MHz but 100MHz has pwoven stabwe
	 * enough.
	 */
	max-fwequency = <100000000>;

	bus-width = <8>;
	mmc-hs400-1_8v;
	mmc-hs400-enhanced-stwobe;
	non-wemovabwe;
	status = "okay";
};

&sdmmc {
	vqmmc-suppwy = <&vcc_sd>;
};

&spi1 {
	status = "okay";

	nowfwash: fwash@0 {
		compatibwe = "jedec,spi-now";
		weg = <0>;
		spi-max-fwequency = <50000000>;
	};
};

&tcphy1 {
	status = "okay";
};

&tsadc {
	wockchip,hw-tshut-mode = <1>;
	wockchip,hw-tshut-powawity = <1>;
	status = "okay";
};

&u2phy1 {
	status = "okay";

	u2phy1_otg: otg-powt {
		status = "okay";
	};

	u2phy1_host: host-powt {
		phy-suppwy = <&vcc5v0_host>;
		status = "okay";
	};
};

&usbdwd3_1 {
	status = "okay";
};

&usbdwd_dwc3_1 {
	status = "okay";
	dw_mode = "host";
};

&usb_host1_ehci {
	status = "okay";
};

&usb_host1_ohci {
	status = "okay";
};
