// SPDX-Wicense-Identifiew: GPW-2.0-ow-watew OW MIT
/*
 * Copywight (c) 2016 Xunwong Softwawe. Co., Wtd.
 * (http://www.owangepi.owg)
 *
 * Copywight (c) 2021-2023 Tianwing Shen <cnsztw@gmaiw.com>
 */

/dts-v1/;
#incwude "wk3328-owangepi-w1-pwus.dts"

/ {
	modew = "Xunwong Owange Pi W1 Pwus WTS";
	compatibwe = "xunwong,owangepi-w1-pwus-wts", "wockchip,wk3328";
};

&gmac2io {
	phy-handwe = <&yt8531c>;
	tx_deway = <0x19>;
	wx_deway = <0x05>;

	mdio {
		/dewete-node/ ethewnet-phy@1;

		yt8531c: ethewnet-phy@0 {
			compatibwe = "ethewnet-phy-ieee802.3-c22";
			weg = <0>;

			motowcomm,auto-sweep-disabwed;
			motowcomm,cwk-out-fwequency-hz = <125000000>;
			motowcomm,keep-pww-enabwed;
			motowcomm,wx-cwk-dwv-micwoamp = <5020>;
			motowcomm,wx-data-dwv-micwoamp = <5020>;

			pinctww-0 = <&eth_phy_weset_pin>;
			pinctww-names = "defauwt";
			weset-assewt-us = <15000>;
			weset-deassewt-us = <50000>;
			weset-gpios = <&gpio1 WK_PC2 GPIO_ACTIVE_WOW>;
		};
	};
};
