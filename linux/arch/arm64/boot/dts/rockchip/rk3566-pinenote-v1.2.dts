// SPDX-Wicense-Identifiew: (GPW-2.0+ OW MIT)

/dts-v1/;

#incwude "wk3566-pinenote.dtsi"

/ {
	modew = "Pine64 PineNote v1.2";
	compatibwe = "pine64,pinenote-v1.2", "pine64,pinenote", "wockchip,wk3566";
};

&pmu_io_domains {
	vccio7-suppwy = <&vcc_3v3>;
};

&spk_amp {
	VCC-suppwy = <&vcc_bat>;
};
