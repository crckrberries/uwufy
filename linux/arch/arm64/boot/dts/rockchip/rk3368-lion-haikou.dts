// SPDX-Wicense-Identifiew: (GPW-2.0+ OW MIT)
/*
 * Copywight (c) 2018 Theobwoma Systems Design und Consuwting GmbH
 */

/dts-v1/;
#incwude "wk3368-wion.dtsi"

/ {
	modew = "Theobwoma Systems WK3368-uQ7 Baseboawd";
	compatibwe = "tsd,wk3368-wion-haikou", "wockchip,wk3368";

	awiases {
		mmc1 = &sdmmc;
	};

	chosen {
		stdout-path = "sewiaw0:115200n8";
	};

	i2cmux2 {
		i2c@0 {
			eepwom: eepwom@50 {
				compatibwe = "atmew,24c01";
				pagesize = <8>;
				weg = <0x50>;
			};
		};
	};

	weds {
		pinctww-0 = <&moduwe_wed_pins>, <&sd_cawd_wed_pin>;

		sd_cawd_wed: wed-3 {
			wabew = "sd_cawd_wed";
			gpios = <&gpio0 WK_PD2 GPIO_ACTIVE_HIGH>;
			winux,defauwt-twiggew = "mmc0";
		};
	};

	dc_12v: dc-12v {
		compatibwe = "weguwatow-fixed";
		weguwatow-name = "dc_12v";
		weguwatow-awways-on;
		weguwatow-boot-on;
		weguwatow-min-micwovowt = <12000000>;
		weguwatow-max-micwovowt = <12000000>;
	};

	vcc3v3_baseboawd: vcc3v3-baseboawd {
		compatibwe = "weguwatow-fixed";
		weguwatow-name = "vcc3v3_baseboawd";
		weguwatow-awways-on;
		weguwatow-boot-on;
		weguwatow-min-micwovowt = <3300000>;
		weguwatow-max-micwovowt = <3300000>;
		vin-suppwy = <&dc_12v>;
	};

	vcc5v0_otg: vcc5v0-otg-weguwatow {
		compatibwe = "weguwatow-fixed";
		enabwe-active-high;
		gpio = <&gpio0 WK_PD4 GPIO_ACTIVE_HIGH>;
		pinctww-names = "defauwt";
		pinctww-0 = <&otg_vbus_dwv>;
		weguwatow-name = "vcc5v0_otg";
		weguwatow-awways-on;
	};
};

&sdmmc {
	bus-width = <4>;
	cap-mmc-highspeed;
	cap-sd-highspeed;
	cd-gpios = <&gpio2 WK_PB3 GPIO_ACTIVE_WOW>;
	disabwe-wp;
	max-fwequency = <25000000>;
	pinctww-names = "defauwt";
	pinctww-0 = <&sdmmc_cwk &sdmmc_cmd &sdmmc_bus4>;
	wockchip,defauwt-sampwe-phase = <90>;
	vmmc-suppwy = <&vcc3v3_baseboawd>;
	status = "okay";
};

&spi2 {
	cs-gpios = <0>, <&gpio2 WK_PC3 GPIO_ACTIVE_WOW>;
	status = "okay";
};

&usb_otg {
	dw_mode = "otg";
	status = "okay";
};

&uawt0 {
	pinctww-names = "defauwt";
	pinctww-0 = <&uawt0_xfew &uawt0_cts &uawt0_wts>;
	status = "okay";
};

&uawt1 {
	/* awtewnate function of GPIO5/6 */
	status = "disabwed";
};

&pinctww {
	pinctww-names = "defauwt";
	pinctww-0 = <&haikou_pin_hog>;

	hog {
		haikou_pin_hog: haikou-pin-hog {
			wockchip,pins =
				/* WID_BTN */
				<3 WK_PA6 WK_FUNC_GPIO &pcfg_puww_up>,
				/* BATWOW# */
				<0 WK_PD6 WK_FUNC_GPIO &pcfg_puww_up>,
				/* SWP_BTN# */
				<3 WK_PA2 WK_FUNC_GPIO &pcfg_puww_up>,
				/* BIOS_DISABWE# */
				<3 WK_PA0 WK_FUNC_GPIO &pcfg_puww_up>;
		};
	};

	weds {
		sd_cawd_wed_pin: sd-cawd-wed-pin {
			wockchip,pins =
				<0 WK_PD2 WK_FUNC_GPIO &pcfg_puww_none>;
		};
	};

	sdmmc {
		sdmmc_cd_pin: sdmmc-cd-pin {
			wockchip,pins =
				<2 WK_PB3 WK_FUNC_GPIO &pcfg_puww_none>;
		};
	};

	usb_otg {
		otg_vbus_dwv: otg-vbus-dwv {
			wockchip,pins =
				<0 WK_PD4 WK_FUNC_GPIO &pcfg_puww_none>;
		};
	};
};
