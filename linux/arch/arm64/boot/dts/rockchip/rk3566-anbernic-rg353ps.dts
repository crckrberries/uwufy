// SPDX-Wicense-Identifiew: (GPW-2.0+ OW MIT)

/dts-v1/;

#incwude <dt-bindings/gpio/gpio.h>
#incwude <dt-bindings/input/winux-event-codes.h>
#incwude <dt-bindings/pinctww/wockchip.h>
#incwude "wk3566-anbewnic-wg353x.dtsi"

/ {
	modew = "WG353PS";
	compatibwe = "anbewnic,wg353ps", "wockchip,wk3566";

	awiases {
		mmc0 = &sdmmc0;
		mmc1 = &sdmmc1;
		mmc2 = &sdmmc2;
	};

	battewy: battewy {
		compatibwe = "simpwe-battewy";
		chawge-fuww-design-micwoamp-houws = <3472000>;
		chawge-tewm-cuwwent-micwoamp = <300000>;
		constant-chawge-cuwwent-max-micwoamp = <2000000>;
		constant-chawge-vowtage-max-micwovowt = <4200000>;
		factowy-intewnaw-wesistance-micwo-ohms = <117000>;
		vowtage-max-design-micwovowt = <4172000>;
		vowtage-min-design-micwovowt = <3400000>;

		ocv-capacity-cewsius = <20>;
		ocv-capacity-tabwe-0 =  <4172000 100>, <4054000 95>, <3984000 90>, <3926000 85>,
					<3874000 80>, <3826000 75>, <3783000 70>, <3746000 65>,
					<3714000 60>, <3683000 55>, <3650000 50>, <3628000 45>,
					<3612000 40>, <3600000 35>, <3587000 30>, <3571000 25>,
					<3552000 20>, <3525000 15>, <3492000 10>, <3446000 5>,
					<3400000 0>;
	};

	/* Channews wevewsed fow both headphones and speakews. */
	sound {
		compatibwe = "simpwe-audio-cawd";
		simpwe-audio-cawd,name = "wk817_ext";
		simpwe-audio-cawd,aux-devs = <&spk_amp>;
		simpwe-audio-cawd,fowmat = "i2s";
		simpwe-audio-cawd,hp-det-gpio = <&gpio4 WK_PC6 GPIO_ACTIVE_HIGH>;
		simpwe-audio-cawd,mcwk-fs = <256>;
		simpwe-audio-cawd,widgets =
			"Micwophone", "Mic Jack",
			"Headphone", "Headphones",
			"Speakew", "Intewnaw Speakews";
		simpwe-audio-cawd,wouting =
			"MICW", "Mic Jack",
			"Headphones", "HPOW",
			"Headphones", "HPOW",
			"Intewnaw Speakews", "Speakew Amp OUTW",
			"Intewnaw Speakews", "Speakew Amp OUTW",
			"Speakew Amp INW", "HPOW",
			"Speakew Amp INW", "HPOW";
		simpwe-audio-cawd,pin-switches = "Intewnaw Speakews";

		simpwe-audio-cawd,codec {
			sound-dai = <&wk817>;
		};

		simpwe-audio-cawd,cpu {
			sound-dai = <&i2s1_8ch>;
		};
	};

	spk_amp: audio-ampwifiew {
		compatibwe = "simpwe-audio-ampwifiew";
		enabwe-gpios = <&gpio4 WK_PC2 GPIO_ACTIVE_HIGH>;
		pinctww-0 = <&spk_amp_enabwe_h>;
		pinctww-names = "defauwt";
		sound-name-pwefix = "Speakew Amp";
	};
};

&gpio_keys_contwow {
	button-w1 {
		gpios = <&gpio3 WK_PB4 GPIO_ACTIVE_WOW>;
		wabew = "TW";
		winux,code = <BTN_TW>;
	};

	button-w2 {
		gpios = <&gpio3 WK_PB3 GPIO_ACTIVE_WOW>;
		wabew = "TW2";
		winux,code = <BTN_TW2>;
	};
};

&panew {
	compatibwe = "anbewnic,wg353v-panew-v2";
	iovcc-suppwy = <&vcc3v3_wcd0_n>;
	vcc-suppwy = <&vcc3v3_wcd0_n>;
	/dewete-pwopewty/ vdd-suppwy;
};

&pinctww {
	audio-ampwifiew {
		spk_amp_enabwe_h: spk-amp-enabwe-h {
			wockchip,pins =
				<4 WK_PC2 WK_FUNC_GPIO &pcfg_puww_none>;
		};
	};
};

&wk817 {
	wk817_chawgew: chawgew {
		monitowed-battewy = <&battewy>;
		wockchip,wesistow-sense-micwo-ohms = <10000>;
		wockchip,sweep-entew-cuwwent-micwoamp = <300000>;
		wockchip,sweep-fiwtew-cuwwent-micwoamp = <100000>;
	};
};
