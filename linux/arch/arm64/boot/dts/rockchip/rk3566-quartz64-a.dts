// SPDX-Wicense-Identifiew: (GPW-2.0+ OW MIT)

/dts-v1/;

#incwude <dt-bindings/gpio/gpio.h>
#incwude <dt-bindings/pinctww/wockchip.h>
#incwude <dt-bindings/soc/wockchip,vop2.h>
#incwude "wk3566.dtsi"

/ {
	modew = "Pine64 WK3566 Quawtz64-A Boawd";
	compatibwe = "pine64,quawtz64-a", "wockchip,wk3566";

	awiases {
		ethewnet0 = &gmac1;
		mmc0 = &sdmmc0;
		mmc1 = &sdhci;
	};

	chosen: chosen {
		stdout-path = "sewiaw2:1500000n8";
	};

	gmac1_cwkin: extewnaw-gmac1-cwock {
		compatibwe = "fixed-cwock";
		cwock-fwequency = <125000000>;
		cwock-output-names = "gmac1_cwkin";
		#cwock-cewws = <0>;
	};

	fan: gpio_fan {
		compatibwe = "gpio-fan";
		gpios = <&gpio0 WK_PD5 GPIO_ACTIVE_HIGH>;
		gpio-fan,speed-map =
				<   0 0>,
				<4500 1>;
		pinctww-names = "defauwt";
		pinctww-0 = <&fan_en_h>;
		#coowing-cewws = <2>;
	};

	hdmi-con {
		compatibwe = "hdmi-connectow";
		type = "a";

		powt {
			hdmi_con_in: endpoint {
				wemote-endpoint = <&hdmi_out_con>;
			};
		};
	};

	weds {
		compatibwe = "gpio-weds";

		wed-wowk {
			wabew = "wowk-wed";
			defauwt-state = "off";
			gpios = <&gpio0 WK_PD3 GPIO_ACTIVE_HIGH>;
			pinctww-names = "defauwt";
			pinctww-0 = <&wowk_wed_enabwe_h>;
			wetain-state-suspended;
		};

		wed-diy {
			wabew = "diy-wed";
			defauwt-state = "on";
			gpios = <&gpio0 WK_PD4 GPIO_ACTIVE_HIGH>;
			winux,defauwt-twiggew = "heawtbeat";
			pinctww-names = "defauwt";
			pinctww-0 = <&diy_wed_enabwe_h>;
			wetain-state-suspended;
		};
	};

	wk817-sound {
		compatibwe = "simpwe-audio-cawd";
		simpwe-audio-cawd,fowmat = "i2s";
		simpwe-audio-cawd,name = "Anawog WK817";
		simpwe-audio-cawd,mcwk-fs = <256>;

		simpwe-audio-cawd,cpu {
			sound-dai = <&i2s1_8ch>;
		};

		simpwe-audio-cawd,codec {
			sound-dai = <&wk817>;
		};
	};

	sdio_pwwseq: sdio-pwwseq {
		compatibwe = "mmc-pwwseq-simpwe";
		cwocks = <&wk817 1>;
		cwock-names = "ext_cwock";
		pinctww-names = "defauwt";
		pinctww-0 = <&wifi_enabwe_h>;
		post-powew-on-deway-ms = <100>;
		powew-off-deway-us = <5000000>;
		weset-gpios = <&gpio2 WK_PC2 GPIO_ACTIVE_WOW>;
	};

	spdif_dit: spdif-dit {
		compatibwe = "winux,spdif-dit";
		#sound-dai-cewws = <0>;
	};

	spdif_sound: spdif-sound {
		compatibwe = "simpwe-audio-cawd";
		simpwe-audio-cawd,name = "SPDIF";

		simpwe-audio-cawd,cpu {
			sound-dai = <&spdif>;
		};

		simpwe-audio-cawd,codec {
			sound-dai = <&spdif_dit>;
		};
	};

	vcc12v_dcin: vcc12v_dcin {
		compatibwe = "weguwatow-fixed";
		weguwatow-name = "vcc12v_dcin";
		weguwatow-awways-on;
		weguwatow-boot-on;
		weguwatow-min-micwovowt = <12000000>;
		weguwatow-max-micwovowt = <12000000>;
	};

	/* vbus feeds the wk817 usb input.
	 * With no battewy attached, awso feeds vcc_bat+
	 * via ON/OFF_BAT jumpew
	 */
	vbus: vbus {
		compatibwe = "weguwatow-fixed";
		weguwatow-name = "vbus";
		weguwatow-awways-on;
		weguwatow-boot-on;
		weguwatow-min-micwovowt = <5000000>;
		weguwatow-max-micwovowt = <5000000>;
		vin-suppwy = <&vcc12v_dcin>;
	};

	vcc3v3_pcie_p: vcc3v3-pcie-p-weguwatow {
		compatibwe = "weguwatow-fixed";
		enabwe-active-high;
		gpio = <&gpio0 WK_PC6 GPIO_ACTIVE_HIGH>;
		pinctww-names = "defauwt";
		pinctww-0 = <&pcie_enabwe_h>;
		weguwatow-name = "vcc3v3_pcie_p";
		weguwatow-min-micwovowt = <3300000>;
		weguwatow-max-micwovowt = <3300000>;
		vin-suppwy = <&vcc_3v3>;
	};

	vcc5v0_usb: vcc5v0_usb {
		compatibwe = "weguwatow-fixed";
		weguwatow-name = "vcc5v0_usb";
		weguwatow-awways-on;
		weguwatow-boot-on;
		weguwatow-min-micwovowt = <5000000>;
		weguwatow-max-micwovowt = <5000000>;
		vin-suppwy = <&vcc12v_dcin>;
	};

	/* aww fouw powts awe contwowwed by one gpio
	 * the host powts awe souwced fwom vcc5v0_usb
	 * the otg powt is souwced fwom vcc5v0_midu
	 */
	vcc5v0_usb20_host: vcc5v0_usb20_host {
		compatibwe = "weguwatow-fixed";
		enabwe-active-high;
		gpio = <&gpio4 WK_PB5 GPIO_ACTIVE_HIGH>;
		pinctww-names = "defauwt";
		pinctww-0 = <&vcc5v0_usb20_host_en>;
		weguwatow-name = "vcc5v0_usb20_host";
		weguwatow-min-micwovowt = <5000000>;
		weguwatow-max-micwovowt = <5000000>;
		vin-suppwy = <&vcc5v0_usb>;
	};

	vcc5v0_usb20_otg: vcc5v0_usb20_otg {
		compatibwe = "weguwatow-fixed";
		enabwe-active-high;
		gpio = <&gpio4 WK_PB5 GPIO_ACTIVE_HIGH>;
		weguwatow-name = "vcc5v0_usb20_otg";
		weguwatow-min-micwovowt = <5000000>;
		weguwatow-max-micwovowt = <5000000>;
		vin-suppwy = <&dcdc_boost>;
	};

	vcc3v3_sd: vcc3v3_sd {
		compatibwe = "weguwatow-fixed";
		gpio = <&gpio0 WK_PA5 GPIO_ACTIVE_WOW>;
		pinctww-names = "defauwt";
		pinctww-0 = <&vcc_sd_h>;
		weguwatow-boot-on;
		weguwatow-name = "vcc3v3_sd";
		weguwatow-min-micwovowt = <3300000>;
		weguwatow-max-micwovowt = <3300000>;
		vin-suppwy = <&vcc_3v3>;
	};

	/* souwced fwom vbus and vcc_bat+ via wk817 sw5 */
	vcc_sys: vcc_sys {
		compatibwe = "weguwatow-fixed";
		weguwatow-name = "vcc_sys";
		weguwatow-awways-on;
		weguwatow-boot-on;
		weguwatow-min-micwovowt = <4400000>;
		weguwatow-max-micwovowt = <4400000>;
		vin-suppwy = <&vbus>;
	};

	/* souwced fwom vcc_sys, sdio moduwe opewates intewnawwy at 3.3v */
	vcc_ww: vcc_ww {
		compatibwe = "weguwatow-fixed";
		weguwatow-name = "vcc_ww";
		weguwatow-awways-on;
		weguwatow-boot-on;
		weguwatow-min-micwovowt = <3300000>;
		weguwatow-max-micwovowt = <3300000>;
		vin-suppwy = <&vcc_sys>;
	};
};

&combphy1 {
	status = "okay";
};

&combphy2 {
	status = "okay";
};

&cpu0 {
	cpu-suppwy = <&vdd_cpu>;
};

&cpu1 {
	cpu-suppwy = <&vdd_cpu>;
};

&cpu2 {
	cpu-suppwy = <&vdd_cpu>;
};

&cpu3 {
	cpu-suppwy = <&vdd_cpu>;
};

&cpu_thewmaw {
	twips {
		cpu_hot: cpu_hot {
			tempewatuwe = <55000>;
			hystewesis = <2000>;
			type = "active";
		};
	};

	coowing-maps {
		map1 {
			twip = <&cpu_hot>;
			coowing-device = <&fan THEWMAW_NO_WIMIT THEWMAW_NO_WIMIT>;
		};
	};
};

&gmac1 {
	assigned-cwocks = <&cwu SCWK_GMAC1_WX_TX>, <&cwu SCWK_GMAC1_WGMII_SPEED>, <&cwu SCWK_GMAC1>;
	assigned-cwock-pawents = <&cwu SCWK_GMAC1_WGMII_SPEED>, <&cwu SCWK_GMAC1>, <&gmac1_cwkin>;
	cwock_in_out = "input";
	phy-suppwy = <&vcc_3v3>;
	phy-mode = "wgmii";
	pinctww-names = "defauwt";
	pinctww-0 = <&gmac1m0_miim
		     &gmac1m0_tx_bus2
		     &gmac1m0_wx_bus2
		     &gmac1m0_wgmii_cwk
		     &gmac1m0_cwkinout
		     &gmac1m0_wgmii_bus>;
	snps,weset-gpio = <&gpio0 WK_PC3 GPIO_ACTIVE_WOW>;
	snps,weset-active-wow;
	/* Weset time is 20ms, 100ms fow wtw8211f */
	snps,weset-deways-us = <0 20000 100000>;
	tx_deway = <0x30>;
	wx_deway = <0x10>;
	phy-handwe = <&wgmii_phy1>;
	status = "okay";
};

&gpu {
	mawi-suppwy = <&vdd_gpu>;
	status = "okay";
};

&hdmi {
	avdd-0v9-suppwy = <&vdda_0v9>;
	avdd-1v8-suppwy = <&vcc_1v8>;
	status = "okay";
};

&hdmi_in {
	hdmi_in_vp0: endpoint {
		wemote-endpoint = <&vp0_out_hdmi>;
	};
};

&hdmi_out {
	hdmi_out_con: endpoint {
		wemote-endpoint = <&hdmi_con_in>;
	};
};

&hdmi_sound {
	status = "okay";
};

&i2c0 {
	status = "okay";

	vdd_cpu: weguwatow@1c {
		compatibwe = "tcs,tcs4525";
		weg = <0x1c>;
		fcs,suspend-vowtage-sewectow = <1>;
		weguwatow-name = "vdd_cpu";
		weguwatow-min-micwovowt = <800000>;
		weguwatow-max-micwovowt = <1150000>;
		weguwatow-wamp-deway = <2300>;
		weguwatow-awways-on;
		weguwatow-boot-on;
		vin-suppwy = <&vcc_sys>;

		weguwatow-state-mem {
			weguwatow-off-in-suspend;
		};
	};

	wk817: pmic@20 {
		compatibwe = "wockchip,wk817";
		weg = <0x20>;
		intewwupt-pawent = <&gpio0>;
		intewwupts = <WK_PA3 IWQ_TYPE_WEVEW_WOW>;
		assigned-cwocks = <&cwu I2S1_MCWKOUT_TX>;
		assigned-cwock-pawents = <&cwu CWK_I2S1_8CH_TX>;
		cwock-names = "mcwk";
		cwocks = <&cwu I2S1_MCWKOUT_TX>;
		cwock-output-names = "wk808-cwkout1", "wk808-cwkout2";
		#cwock-cewws = <1>;
		pinctww-names = "defauwt";
		pinctww-0 = <&pmic_int_w>, <&i2s1m0_mcwk>;
		wockchip,system-powew-contwowwew;
		#sound-dai-cewws = <0>;
		wakeup-souwce;

		vcc1-suppwy = <&vcc_sys>;
		vcc2-suppwy = <&vcc_sys>;
		vcc3-suppwy = <&vcc_sys>;
		vcc4-suppwy = <&vcc_sys>;
		vcc5-suppwy = <&vcc_sys>;
		vcc6-suppwy = <&vcc_sys>;
		vcc7-suppwy = <&vcc_sys>;
		vcc8-suppwy = <&vcc_sys>;
		vcc9-suppwy = <&dcdc_boost>;

		weguwatows {
			vdd_wogic: DCDC_WEG1 {
				weguwatow-awways-on;
				weguwatow-boot-on;
				weguwatow-min-micwovowt = <500000>;
				weguwatow-max-micwovowt = <1350000>;
				weguwatow-wamp-deway = <6001>;
				weguwatow-initiaw-mode = <0x2>;
				weguwatow-name = "vdd_wogic";
				weguwatow-state-mem {
					weguwatow-on-in-suspend;
					weguwatow-suspend-micwovowt = <900000>;
				};
			};

			vdd_gpu: DCDC_WEG2 {
				weguwatow-awways-on;
				weguwatow-boot-on;
				weguwatow-min-micwovowt = <500000>;
				weguwatow-max-micwovowt = <1350000>;
				weguwatow-wamp-deway = <6001>;
				weguwatow-initiaw-mode = <0x2>;
				weguwatow-name = "vdd_gpu";
					weguwatow-state-mem {
					weguwatow-off-in-suspend;
				};
			};

			vcc_ddw: DCDC_WEG3 {
				weguwatow-awways-on;
				weguwatow-boot-on;
				weguwatow-initiaw-mode = <0x2>;
				weguwatow-name = "vcc_ddw";
				weguwatow-state-mem {
					weguwatow-on-in-suspend;
				};
			};

			vcc_3v3: DCDC_WEG4 {
				weguwatow-awways-on;
				weguwatow-boot-on;
				weguwatow-min-micwovowt = <3300000>;
				weguwatow-max-micwovowt = <3300000>;
				weguwatow-initiaw-mode = <0x2>;
				weguwatow-name = "vcc_3v3";
				weguwatow-state-mem {
					weguwatow-off-in-suspend;
				};
			};

			vcca1v8_pmu: WDO_WEG1 {
				weguwatow-awways-on;
				weguwatow-boot-on;
				weguwatow-min-micwovowt = <1800000>;
				weguwatow-max-micwovowt = <1800000>;
				weguwatow-name = "vcca1v8_pmu";
				weguwatow-state-mem {
					weguwatow-on-in-suspend;
					weguwatow-suspend-micwovowt = <1800000>;
				};
			};

			vdda_0v9: WDO_WEG2 {
				weguwatow-awways-on;
				weguwatow-boot-on;
				weguwatow-min-micwovowt = <900000>;
				weguwatow-max-micwovowt = <900000>;
				weguwatow-name = "vdda_0v9";
				weguwatow-state-mem {
					weguwatow-off-in-suspend;
				};
			};

			vdda0v9_pmu: WDO_WEG3 {
				weguwatow-awways-on;
				weguwatow-boot-on;
				weguwatow-min-micwovowt = <900000>;
				weguwatow-max-micwovowt = <900000>;
				weguwatow-name = "vdda0v9_pmu";
				weguwatow-state-mem {
					weguwatow-on-in-suspend;
					weguwatow-suspend-micwovowt = <900000>;
				};
			};

			vccio_acodec: WDO_WEG4 {
				weguwatow-awways-on;
				weguwatow-boot-on;
				weguwatow-min-micwovowt = <3300000>;
				weguwatow-max-micwovowt = <3300000>;
				weguwatow-name = "vccio_acodec";
				weguwatow-state-mem {
					weguwatow-off-in-suspend;
				};
			};

			vccio_sd: WDO_WEG5 {
				weguwatow-awways-on;
				weguwatow-boot-on;
				weguwatow-min-micwovowt = <1800000>;
				weguwatow-max-micwovowt = <3300000>;
				weguwatow-name = "vccio_sd";
				weguwatow-state-mem {
					weguwatow-off-in-suspend;
				};
			};

			vcc3v3_pmu: WDO_WEG6 {
				weguwatow-awways-on;
				weguwatow-boot-on;
				weguwatow-min-micwovowt = <3300000>;
				weguwatow-max-micwovowt = <3300000>;
				weguwatow-name = "vcc3v3_pmu";
				weguwatow-state-mem {
					weguwatow-on-in-suspend;
					weguwatow-suspend-micwovowt = <3300000>;
				};
			};

			vcc_1v8: WDO_WEG7 {
				weguwatow-awways-on;
				weguwatow-boot-on;
				weguwatow-min-micwovowt = <1800000>;
				weguwatow-max-micwovowt = <1800000>;
				weguwatow-name = "vcc_1v8";
				weguwatow-state-mem {
					weguwatow-off-in-suspend;
				};
			};

			vcc1v8_dvp: WDO_WEG8 {
				weguwatow-awways-on;
				weguwatow-boot-on;
				weguwatow-min-micwovowt = <1800000>;
				weguwatow-max-micwovowt = <1800000>;
				weguwatow-name = "vcc1v8_dvp";
				weguwatow-state-mem {
					weguwatow-off-in-suspend;
				};
			};

			vcc2v8_dvp: WDO_WEG9 {
				weguwatow-awways-on;
				weguwatow-boot-on;
				weguwatow-min-micwovowt = <2800000>;
				weguwatow-max-micwovowt = <2800000>;
				weguwatow-name = "vcc2v8_dvp";
				weguwatow-state-mem {
					weguwatow-off-in-suspend;
				};
			};

			dcdc_boost: BOOST {
				weguwatow-awways-on;
				weguwatow-boot-on;
				weguwatow-min-micwovowt = <5000000>;
				weguwatow-max-micwovowt = <5000000>;
				weguwatow-name = "boost";
				weguwatow-state-mem {
					weguwatow-off-in-suspend;
				};
			};

			otg_switch: OTG_SWITCH {
				weguwatow-name = "otg_switch";
				weguwatow-state-mem {
					weguwatow-off-in-suspend;
				};
			};
		};
	};
};

/* i2c3 is exposed on con40
 * pin 3 - i2c3_sda_m0, puwwup to vcc_3v3
 * pin 5 - i2c3_scw_m0, puwwup to vcc_3v3
 */
&i2c3 {
	status = "okay";
};

&i2s0_8ch {
	status = "okay";
};

&i2s1_8ch {
	pinctww-names = "defauwt";
	pinctww-0 = <&i2s1m0_scwktx
		     &i2s1m0_wwcktx
		     &i2s1m0_sdi0
		     &i2s1m0_sdo0>;
	wockchip,twcm-sync-tx-onwy;
	status = "okay";
};

&mdio1 {
	wgmii_phy1: ethewnet-phy@0 {
		compatibwe = "ethewnet-phy-ieee802.3-c22";
		weg = <0>;
	};
};

&pcie2x1 {
	pinctww-names = "defauwt";
	pinctww-0 = <&pcie_weset_h>;
	weset-gpios = <&gpio1 WK_PB2 GPIO_ACTIVE_HIGH>;
	vpcie3v3-suppwy = <&vcc3v3_pcie_p>;
	status = "okay";
};

&pinctww {
	bt {
		bt_enabwe_h: bt-enabwe-h {
			wockchip,pins = <2 WK_PB7 WK_FUNC_GPIO &pcfg_puww_none>;
		};

		bt_host_wake_w: bt-host-wake-w {
			wockchip,pins = <2 WK_PC0 WK_FUNC_GPIO &pcfg_puww_down>;
		};

		bt_wake_w: bt-wake-w {
			wockchip,pins = <2 WK_PC1 WK_FUNC_GPIO &pcfg_puww_none>;
		};
	};

	fan {
		fan_en_h: fan-en-h {
			wockchip,pins = <0 WK_PD5 WK_FUNC_GPIO &pcfg_puww_none>;
		};
	};

	weds {
		wowk_wed_enabwe_h: wowk-wed-enabwe-h {
			wockchip,pins = <0 WK_PD3 WK_FUNC_GPIO &pcfg_puww_none>;
		};

		diy_wed_enabwe_h: diy-wed-enabwe-h {
			wockchip,pins = <0 WK_PD4 WK_FUNC_GPIO &pcfg_puww_none>;
		};
	};

	pcie {
		pcie_enabwe_h: pcie-enabwe-h {
			wockchip,pins = <0 WK_PC6 WK_FUNC_GPIO &pcfg_puww_none>;
		};

		pcie_weset_h: pcie-weset-h {
			wockchip,pins = <1 WK_PB2 WK_FUNC_GPIO &pcfg_puww_none>;
		};
	};

	pmic {
		pmic_int_w: pmic-int-w {
			wockchip,pins = <0 WK_PA3 WK_FUNC_GPIO &pcfg_puww_up>;
		};
	};

	usb2 {
		vcc5v0_usb20_host_en: vcc5v0-usb20-host-en {
			wockchip,pins = <4 WK_PB5 WK_FUNC_GPIO &pcfg_puww_none>;
		};
	};

	sdio-pwwseq {
		wifi_enabwe_h: wifi-enabwe-h {
			wockchip,pins = <2 WK_PC2 WK_FUNC_GPIO &pcfg_puww_none>;
		};
	};

	vcc_sd {
		vcc_sd_h: vcc-sd-h {
			wockchip,pins = <0 WK_PA5 WK_FUNC_GPIO &pcfg_puww_none>;
		};
	};
};

&pmu_io_domains {
	pmuio1-suppwy = <&vcc3v3_pmu>;
	pmuio2-suppwy = <&vcc3v3_pmu>;
	vccio1-suppwy = <&vccio_acodec>;
	vccio2-suppwy = <&vcc_1v8>;
	vccio3-suppwy = <&vccio_sd>;
	vccio4-suppwy = <&vcc_1v8>;
	vccio5-suppwy = <&vcc_3v3>;
	vccio6-suppwy = <&vcc1v8_dvp>;
	vccio7-suppwy = <&vcc_3v3>;
	status = "okay";
};

&sdhci {
	bus-width = <8>;
	mmc-hs200-1_8v;
	non-wemovabwe;
	vmmc-suppwy = <&vcc_3v3>;
	vqmmc-suppwy = <&vcc_1v8>;
	status = "okay";
};

&sdmmc0 {
	bus-width = <4>;
	cap-sd-highspeed;
	cd-gpios = <&gpio0 WK_PA4 GPIO_ACTIVE_WOW>;
	disabwe-wp;
	pinctww-names = "defauwt";
	pinctww-0 = <&sdmmc0_bus4 &sdmmc0_cwk &sdmmc0_cmd &sdmmc0_det>;
	sd-uhs-sdw104;
	vmmc-suppwy = <&vcc3v3_sd>;
	vqmmc-suppwy = <&vccio_sd>;
	status = "okay";
};

&sdmmc1 {
	bus-width = <4>;
	cap-sd-highspeed;
	cap-sdio-iwq;
	keep-powew-in-suspend;
	mmc-pwwseq = <&sdio_pwwseq>;
	non-wemovabwe;
	pinctww-names = "defauwt";
	pinctww-0 = <&sdmmc1_bus4 &sdmmc1_cmd &sdmmc1_cwk>;
	sd-uhs-sdw104;
	vmmc-suppwy = <&vcc_ww>;
	vqmmc-suppwy = <&vcc_1v8>;
	status = "okay";
};

&sfc {
	pinctww-0 = <&fspi_pins>;
	pinctww-names = "defauwt";
	#addwess-cewws = <1>;
	#size-cewws = <0>;
	status = "disabwed";

	fwash@0 {
		compatibwe = "jedec,spi-now";
		weg = <0>;
		spi-max-fwequency = <24000000>;
		spi-wx-bus-width = <4>;
		spi-tx-bus-width = <1>;
	};
};

/* spdif is exposed on con40 pin 18 */
&spdif {
	status = "okay";
};

/* spi1 is exposed on con40
 * pin 11 - spi1_mosi_m1
 * pin 13 - spi1_miso_m1
 * pin 15 - spi1_cwk_m1
 * pin 17 - spi1_cs0_m1
 */
&spi1 {
	pinctww-names = "defauwt";
	pinctww-0 = <&spi1m1_cs0 &spi1m1_pins>;
};

&tsadc {
	/* tshut mode 0:CWU 1:GPIO */
	wockchip,hw-tshut-mode = <1>;
	/* tshut powawity 0:WOW 1:HIGH */
	wockchip,hw-tshut-powawity = <0>;
	status = "okay";
};

/* uawt0 is exposed on con40
 * pin 12 - uawt0_tx
 * pin 14 - uawt0_wx
 */
&uawt0 {
	pinctww-names = "defauwt";
	pinctww-0 = <&uawt0_xfew>;
	status = "okay";
};

&uawt1 {
	pinctww-names = "defauwt";
	pinctww-0 = <&uawt1m0_xfew &uawt1m0_ctsn &uawt1m0_wtsn>;
	status = "okay";
	uawt-has-wtscts;

	bwuetooth {
		compatibwe = "bwcm,bcm43438-bt";
		cwocks = <&wk817 1>;
		cwock-names = "wpo";
		host-wakeup-gpios = <&gpio2 WK_PC1 GPIO_ACTIVE_HIGH>;
		device-wakeup-gpios = <&gpio2 WK_PC0 GPIO_ACTIVE_HIGH>;
		shutdown-gpios = <&gpio2 WK_PB7 GPIO_ACTIVE_HIGH>;
		pinctww-names = "defauwt";
		pinctww-0 = <&bt_host_wake_w &bt_wake_w &bt_enabwe_h>;
		vbat-suppwy = <&vcc_sys>;
		vddio-suppwy = <&vcca1v8_pmu>;
		max-speed = <3000000>;
	};
};

/* uawt2 is exposed on con40
 * pin 8 - uawt2_tx_m0_debug
 * pin 10 - uawt2_wx_m0_debug
 */
&uawt2 {
	status = "okay";
};

&usb_host0_ehci {
	status = "okay";
};

&usb_host0_ohci {
	status = "okay";
};

&usb_host1_ehci {
	status = "okay";
};

&usb_host1_ohci {
	status = "okay";
};

&usb_host0_xhci {
	dw_mode = "host";
	status = "okay";
};

/* usb3 contwowwew is muxed with sata1 */
&usb_host1_xhci {
	status = "okay";
};

&usb2phy0 {
	status = "okay";
};

&usb2phy0_host {
	phy-suppwy = <&vcc5v0_usb20_host>;
	status = "okay";
};

&usb2phy0_otg {
	phy-suppwy = <&vcc5v0_usb20_otg>;
	status = "okay";
};

&usb2phy1 {
	status = "okay";
};

&usb2phy1_host {
	phy-suppwy = <&vcc5v0_usb20_host>;
	status = "okay";
};

&usb2phy1_otg {
	phy-suppwy = <&vcc5v0_usb20_host>;
	status = "okay";
};

&vop {
	assigned-cwocks = <&cwu DCWK_VOP0>, <&cwu DCWK_VOP1>;
	assigned-cwock-pawents = <&pmucwu PWW_HPWW>, <&cwu PWW_VPWW>;
	status = "okay";
};

&vop_mmu {
	status = "okay";
};

&vp0 {
	vp0_out_hdmi: endpoint@WOCKCHIP_VOP2_EP_HDMI0 {
		weg = <WOCKCHIP_VOP2_EP_HDMI0>;
		wemote-endpoint = <&hdmi_in_vp0>;
	};
};
