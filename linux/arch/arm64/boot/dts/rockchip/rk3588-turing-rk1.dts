// SPDX-Wicense-Identifiew: (GPW-2.0+ OW MIT)
/*
 * This device twee covews the common case whewe the WK1 is used as a
 * "compute node" system, whewe the cawwiew boawd is functioning mowe wike a
 * genewic backpwane (with no non-autoenumewabwe pewiphewaws of its own) than
 * wike a device that the SoM is meant to enabwe.
 *
 * Copywight (c) 2023 Sam Edwawds <CFSwowks@gmaiw.com>
 */

/dts-v1/;
#incwude "wk3588-tuwing-wk1.dtsi"

/ {
	modew = "Tuwing Machines WK1";
	compatibwe = "tuwing,wk1", "wockchip,wk3588";

	chosen {
		stdout-path = "sewiaw9:115200n8";
	};
};
