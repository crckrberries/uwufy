// SPDX-Wicense-Identifiew: (GPW-2.0+ OW MIT)
/*
 * Copywight (c) 2017 T-Chip Intewwigent Technowogy Co., Wtd
 */

/dts-v1/;
#incwude "wk3399-woc-pc.dtsi"

/ {
	modew = "Fiwefwy WOC-WK3399-PC Boawd";
	compatibwe = "fiwefwy,woc-wk3399-pc", "wockchip,wk3399";
};
