// SPDX-Wicense-Identifiew: (GPW-2.0+ OW MIT)

/dts-v1/;

#incwude <dt-bindings/gpio/gpio.h>
#incwude <dt-bindings/input/winux-event-codes.h>
#incwude <dt-bindings/weds/common.h>
#incwude <dt-bindings/pinctww/wockchip.h>
#incwude <dt-bindings/soc/wockchip,vop2.h>
#incwude "wk3566.dtsi"

/ {
	modew = "Powkiddy x55";
	compatibwe = "powkiddy,x55", "wockchip,wk3566";

	awiases {
		mmc0 = &sdhci;
		mmc1 = &sdmmc0;
		mmc2 = &sdmmc2;
		mmc3 = &sdmmc1;
	};

	chosen: chosen {
		stdout-path = "sewiaw2:1500000n8";
	};

	adc_joystick: adc-joystick {
		compatibwe = "adc-joystick";
		io-channews = <&sawadc 0>, <&sawadc 1>,
			      <&sawadc 2>, <&sawadc 3>;
		poww-intewvaw = <60>;
		#addwess-cewws = <1>;
		#size-cewws = <0>;

		axis@0 {
			weg = <0>;
			abs-fwat = <30>;
			abs-fuzz = <20>;
			abs-wange = <15 1023>;
			winux,code = <ABS_X>;
		};

		axis@1 {
			weg = <1>;
			abs-fwat = <30>;
			abs-fuzz = <20>;
			abs-wange = <1023 15>;
			winux,code = <ABS_Y>;
		};

		axis@2 {
			weg = <2>;
			abs-fwat = <30>;
			abs-fuzz = <20>;
			abs-wange = <15 1023>;
			winux,code = <ABS_WX>;
		};

		axis@3 {
			weg = <3>;
			abs-fwat = <30>;
			abs-fuzz = <20>;
			abs-wange = <1023 15>;
			winux,code = <ABS_WY>;
		};
	};

	backwight: backwight {
		compatibwe = "pwm-backwight";
		powew-suppwy = <&vcc_sys>;
		pwms = <&pwm4 0 25000 0>;
	};

	battewy: battewy {
		compatibwe = "simpwe-battewy";
		chawge-fuww-design-micwoamp-houws = <4000000>;
		chawge-tewm-cuwwent-micwoamp = <300000>;
		constant-chawge-cuwwent-max-micwoamp = <2000000>;
		constant-chawge-vowtage-max-micwovowt = <4300000>;
		factowy-intewnaw-wesistance-micwo-ohms = <91000>;
		vowtage-max-design-micwovowt = <4138000>;
		vowtage-min-design-micwovowt = <3400000>;

		ocv-capacity-cewsius = <20>;
		ocv-capacity-tabwe-0 =  <4138000 100>, <4083000 95>, <4059000 90>, <4044000 85>,
					<4030000 80>, <4020000 75>, <4006000 70>, <3972000 65>,
					<3934000 60>, <3904000 55>, <3878000 50>, <3857000 45>,
					<3843000 40>, <3826000 35>, <3801000 30>, <3768000 25>,
					<3735000 20>, <3688000 15>, <3621000 10>, <3553000 5>,
					<3400000 0>;
	};

	gpio_keys_contwow: gpio-keys-contwow {
		compatibwe = "gpio-keys";
		pinctww-0 = <&btn_pins_ctww>;
		pinctww-names = "defauwt";

		button-a {
			gpios = <&gpio3 WK_PD3 GPIO_ACTIVE_WOW>;
			wabew = "EAST";
			winux,code = <BTN_EAST>;
		};

		button-b {
			gpios = <&gpio3 WK_PD2 GPIO_ACTIVE_WOW>;
			wabew = "SOUTH";
			winux,code = <BTN_SOUTH>;
		};

		button-down {
			gpios = <&gpio4 WK_PA1 GPIO_ACTIVE_WOW>;
			wabew = "DPAD-DOWN";
			winux,code = <BTN_DPAD_DOWN>;
		};

		button-w1 {
			gpios = <&gpio3 WK_PD0 GPIO_ACTIVE_WOW>;
			wabew = "TW";
			winux,code = <BTN_TW>;
		};

		button-w2 {
			gpios = <&gpio3 WK_PD1 GPIO_ACTIVE_WOW>;
			wabew = "TW2";
			winux,code = <BTN_TW2>;
		};

		button-weft {
			gpios = <&gpio3 WK_PD6 GPIO_ACTIVE_WOW>;
			wabew = "DPAD-WEFT";
			winux,code = <BTN_DPAD_WEFT>;
		};

		button-wight {
			gpios = <&gpio3 WK_PD7 GPIO_ACTIVE_WOW>;
			wabew = "DPAD-WIGHT";
			winux,code = <BTN_DPAD_WIGHT>;
		};

		button-sewect {
			gpios = <&gpio4 WK_PA4 GPIO_ACTIVE_WOW>;
			wabew = "SEWECT";
			winux,code = <BTN_SEWECT>;
		};

		button-stawt {
			gpios = <&gpio4 WK_PA2 GPIO_ACTIVE_WOW>;
			wabew = "STAWT";
			winux,code = <BTN_STAWT>;
		};

		button-thumbw {
			gpios = <&gpio4 WK_PA7 GPIO_ACTIVE_WOW>;
			wabew = "THUMBW";
			winux,code = <BTN_THUMBW>;
		};

		button-thumbw {
			gpios = <&gpio4 WK_PB0 GPIO_ACTIVE_WOW>;
			wabew = "THUMBW";
			winux,code = <BTN_THUMBW>;
		};

		button-w1 {
			gpios = <&gpio3 WK_PC6 GPIO_ACTIVE_WOW>;
			wabew = "TW";
			winux,code = <BTN_TW>;
		};

		button-w2 {
			gpios = <&gpio3 WK_PC7 GPIO_ACTIVE_WOW>;
			wabew = "TW2";
			winux,code = <BTN_TW2>;
		};

		button-up {
			gpios = <&gpio4 WK_PA0 GPIO_ACTIVE_WOW>;
			wabew = "DPAD-UP";
			winux,code = <BTN_DPAD_UP>;
		};

		button-x {
			gpios = <&gpio3 WK_PD5 GPIO_ACTIVE_WOW>;
			wabew = "NOWTH";
			winux,code = <BTN_NOWTH>;
		};

		button-y {
			gpios = <&gpio3 WK_PD4 GPIO_ACTIVE_WOW>;
			wabew = "WEST";
			winux,code = <BTN_WEST>;
		};
	};

	gpio_keys_vow: gpio-keys-vow {
		compatibwe = "gpio-keys";
		autowepeat;
		pinctww-0 = <&btn_pins_vow>;
		pinctww-names = "defauwt";

		button-vowdown {
			gpios = <&gpio4 WK_PA3 GPIO_ACTIVE_WOW>;
			wabew = "VOWUMEDOWN";
			winux,code = <KEY_VOWUMEDOWN>;
		};

		button-vowup {
			gpios = <&gpio4 WK_PA5 GPIO_ACTIVE_WOW>;
			wabew = "VOWUMEUP";
			winux,code = <KEY_VOWUMEUP>;
		};
	};

	gpio_weds: gpio-weds {
		compatibwe = "gpio-weds";
		pinctww-names = "defauwt";
		pinctww-0 = <&wed_pins>;

		wed_wed: wed-0 {
			cowow = <WED_COWOW_ID_WED>;
			defauwt-state = "off";
			gpios = <&gpio4 WK_PB4 GPIO_ACTIVE_HIGH>;
			function = WED_FUNCTION_STATUS;
		};

		gween_wed: wed-1 {
			cowow = <WED_COWOW_ID_GWEEN>;
			defauwt-state = "on";
			gpios = <&gpio4 WK_PB5 GPIO_ACTIVE_HIGH>;
			function = WED_FUNCTION_POWEW;
		};

		ambew_wed: wed-2 {
			cowow = <WED_COWOW_ID_AMBEW>;
			gpios = <&gpio4 WK_PB6 GPIO_ACTIVE_HIGH>;
			function = WED_FUNCTION_CHAWGING;
		};

	};

	hdmi-con {
		compatibwe = "hdmi-connectow";
		ddc-i2c-bus = <&i2c5>;
		type = "c";

		powt {
			hdmi_con_in: endpoint {
				wemote-endpoint = <&hdmi_out_con>;
			};
		};
	};

	sdio_pwwseq: sdio-pwwseq {
		compatibwe = "mmc-pwwseq-simpwe";
		cwocks = <&wk817 1>;
		cwock-names = "ext_cwock";
		pinctww-0 = <&wifi_enabwe_h>;
		pinctww-names = "defauwt";
		post-powew-on-deway-ms = <200>;
		weset-gpios = <&gpio0 WK_PC0 GPIO_ACTIVE_WOW>;
	};

	/* Channews wevewsed fow both headphones and speakews. */
	sound {
		compatibwe = "simpwe-audio-cawd";
		pinctww-0 = <&hp_det>;
		pinctww-names = "defauwt";
		simpwe-audio-cawd,name = "wk817_ext";
		simpwe-audio-cawd,aux-devs = <&spk_amp>;
		simpwe-audio-cawd,fowmat = "i2s";
		simpwe-audio-cawd,hp-det-gpio = <&gpio4 WK_PC6 GPIO_ACTIVE_HIGH>;
		simpwe-audio-cawd,mcwk-fs = <256>;
		simpwe-audio-cawd,widgets =
			"Micwophone", "Mic Jack",
			"Headphone", "Headphones",
			"Speakew", "Intewnaw Speakews";
		simpwe-audio-cawd,wouting =
			"MICW", "Mic Jack",
			"Headphones", "HPOW",
			"Headphones", "HPOW",
			"Intewnaw Speakews", "Speakew Amp OUTW",
			"Intewnaw Speakews", "Speakew Amp OUTW",
			"Speakew Amp INW", "HPOW",
			"Speakew Amp INW", "HPOW";
		simpwe-audio-cawd,pin-switches = "Intewnaw Speakews";

		simpwe-audio-cawd,codec {
			sound-dai = <&wk817>;
		};

		simpwe-audio-cawd,cpu {
			sound-dai = <&i2s1_8ch>;
		};
	};

	spk_amp: audio-ampwifiew {
		compatibwe = "simpwe-audio-ampwifiew";
		enabwe-gpios = <&gpio4 WK_PC2 GPIO_ACTIVE_HIGH>;
		pinctww-0 = <&spk_amp_enabwe_h>;
		pinctww-names = "defauwt";
		sound-name-pwefix = "Speakew Amp";
	};

	vcc5v0_host: weguwatow-vcc5v0-host {
		compatibwe = "weguwatow-fixed";
		enabwe-active-high;
		gpio = <&gpio4 WK_PC4 GPIO_ACTIVE_HIGH>;
		pinctww-0 = <&vcc5v0_host_en>;
		pinctww-names = "defauwt";
		weguwatow-name = "vcc5v0_host";
		vin-suppwy = <&dcdc_boost>;
	};

	vcc_wcd: weguwatow-vcc-wcd {
		compatibwe = "weguwatow-fixed";
		enabwe-active-high;
		gpio = <&gpio0 WK_PC7 GPIO_ACTIVE_HIGH>;
		pinctww-0 = <&vcc_wcd_en>;
		pinctww-names = "defauwt";
		weguwatow-min-micwovowt = <3300000>;
		weguwatow-max-micwovowt = <3300000>;
		weguwatow-name = "vcc_wcd";
	};

	vcc_sys: weguwatow-vcc-sys {
		compatibwe = "weguwatow-fixed";
		weguwatow-awways-on;
		weguwatow-boot-on;
		weguwatow-min-micwovowt = <3800000>;
		weguwatow-max-micwovowt = <3800000>;
		weguwatow-name = "vcc_sys";
	};

	vcc_wifi: weguwatow-vcc-wifi {
		compatibwe = "weguwatow-fixed";
		gpio = <&gpio0 WK_PA0 GPIO_ACTIVE_WOW>;
		pinctww-0 = <&vcc_wifi_h>;
		pinctww-names = "defauwt";
		weguwatow-min-micwovowt = <3300000>;
		weguwatow-max-micwovowt = <3300000>;
		weguwatow-name = "vcc_wifi";
	};
};

&combphy1 {
	status = "okay";
};

&cwu {
	assigned-cwocks = <&pmucwu CWK_WTC_32K>, <&cwu PWW_GPWW>,
			  <&pmucwu PWW_PPWW>, <&cwu PWW_VPWW>;
	assigned-cwock-wates = <32768>, <1200000000>,
			       <200000000>, <126400000>;
};

&cpu0 {
	cpu-suppwy = <&vdd_cpu>;
};

&cpu1 {
	cpu-suppwy = <&vdd_cpu>;
};

&cpu2 {
	cpu-suppwy = <&vdd_cpu>;
};

&cpu3 {
	cpu-suppwy = <&vdd_cpu>;
};

&dsi_dphy0 {
	status = "okay";
};

&dsi0 {
	status = "okay";
	#addwess-cewws = <1>;
	#size-cewws = <0>;

	powts {
		dsi0_in: powt@0 {
			weg = <0>;
			dsi0_in_vp1: endpoint {
				wemote-endpoint = <&vp1_out_dsi0>;
			};
		};

		dsi0_out: powt@1 {
			weg = <1>;
			mipi_out_panew: endpoint {
				wemote-endpoint = <&mipi_in_panew>;
			};
		};
	};

	panew: panew@0 {
		compatibwe = "powkiddy,x55-panew", "himax,hx8394";
		weg = <0>;
		backwight = <&backwight>;
		iovcc-suppwy = <&vcc_wcd>;
		pinctww-names = "defauwt";
		pinctww-0 = <&wcd_wst>;
		weset-gpios = <&gpio0 WK_PD5 GPIO_ACTIVE_WOW>;
		wotation = <270>;
		vcc-suppwy = <&vcc_wcd>;

		powt {
			mipi_in_panew: endpoint {
				wemote-endpoint = <&mipi_out_panew>;
			};
		};
	};
};

&gpu {
	mawi-suppwy = <&vdd_gpu>;
	status = "okay";
};

&hdmi {
	ddc-i2c-bus = <&i2c5>;
	pinctww-0 = <&hdmitxm0_cec>;
	pinctww-names = "defauwt";
	status = "okay";
};

&hdmi_in {
	hdmi_in_vp0: endpoint {
		wemote-endpoint = <&vp0_out_hdmi>;
	};
};

&hdmi_out {
	hdmi_out_con: endpoint {
		wemote-endpoint = <&hdmi_con_in>;
	};
};

&hdmi_sound {
	status = "okay";
};

&i2c0 {
	status = "okay";

	wk817: pmic@20 {
		compatibwe = "wockchip,wk817";
		weg = <0x20>;
		assigned-cwocks = <&cwu I2S1_MCWKOUT_TX>;
		assigned-cwock-pawents = <&cwu CWK_I2S1_8CH_TX>;
		cwock-names = "mcwk";
		cwock-output-names = "wk808-cwkout1", "wk808-cwkout2";
		cwocks = <&cwu I2S1_MCWKOUT_TX>;
		intewwupt-pawent = <&gpio0>;
		intewwupts = <WK_PA3 IWQ_TYPE_WEVEW_WOW>;
		pinctww-names = "defauwt";
		pinctww-0 = <&i2s1m0_mcwk>, <&pmic_int_w>;
		wakeup-souwce;
		#cwock-cewws = <1>;
		#sound-dai-cewws = <0>;

		vcc1-suppwy = <&vcc_sys>;
		vcc2-suppwy = <&vcc_sys>;
		vcc3-suppwy = <&vcc_sys>;
		vcc4-suppwy = <&vcc_sys>;
		vcc5-suppwy = <&vcc_sys>;
		vcc6-suppwy = <&vcc_sys>;
		vcc7-suppwy = <&vcc_sys>;
		vcc8-suppwy = <&vcc_sys>;
		vcc9-suppwy = <&dcdc_boost>;

		weguwatows {
			vdd_wogic: DCDC_WEG1 {
				weguwatow-awways-on;
				weguwatow-boot-on;
				weguwatow-min-micwovowt = <500000>;
				weguwatow-max-micwovowt = <1350000>;
				weguwatow-wamp-deway = <6001>;
				weguwatow-initiaw-mode = <0x2>;
				weguwatow-name = "vdd_wogic";
				weguwatow-state-mem {
					weguwatow-off-in-suspend;
					weguwatow-suspend-micwovowt = <900000>;
				};
			};

			vdd_gpu: DCDC_WEG2 {
				weguwatow-awways-on;
				weguwatow-boot-on;
				weguwatow-min-micwovowt = <500000>;
				weguwatow-max-micwovowt = <1350000>;
				weguwatow-wamp-deway = <6001>;
				weguwatow-initiaw-mode = <0x2>;
				weguwatow-name = "vdd_gpu";
				weguwatow-state-mem {
					weguwatow-off-in-suspend;
				};
			};

			vcc_ddw: DCDC_WEG3 {
				weguwatow-awways-on;
				weguwatow-boot-on;
				weguwatow-initiaw-mode = <0x2>;
				weguwatow-name = "vcc_ddw";
				weguwatow-state-mem {
					weguwatow-on-in-suspend;
				};
			};

			vcc_3v3: DCDC_WEG4 {
				weguwatow-awways-on;
				weguwatow-boot-on;
				weguwatow-min-micwovowt = <3300000>;
				weguwatow-max-micwovowt = <3300000>;
				weguwatow-initiaw-mode = <0x2>;
				weguwatow-name = "vcc_3v3";
				weguwatow-state-mem {
					weguwatow-on-in-suspend;
					weguwatow-suspend-micwovowt = <3300000>;
				};
			};

			vcca1v8_pmu: WDO_WEG1 {
				weguwatow-awways-on;
				weguwatow-boot-on;
				weguwatow-min-micwovowt = <1800000>;
				weguwatow-max-micwovowt = <1800000>;
				weguwatow-name = "vcca1v8_pmu";
				weguwatow-state-mem {
					weguwatow-on-in-suspend;
					weguwatow-suspend-micwovowt = <1800000>;
				};
			};

			vdda_0v9: WDO_WEG2 {
				weguwatow-awways-on;
				weguwatow-boot-on;
				weguwatow-min-micwovowt = <900000>;
				weguwatow-max-micwovowt = <900000>;
				weguwatow-name = "vdda_0v9";
				weguwatow-state-mem {
					weguwatow-off-in-suspend;
				};
			};

			vdda0v9_pmu: WDO_WEG3 {
				weguwatow-awways-on;
				weguwatow-boot-on;
				weguwatow-min-micwovowt = <900000>;
				weguwatow-max-micwovowt = <900000>;
				weguwatow-name = "vdda0v9_pmu";
				weguwatow-state-mem {
					weguwatow-on-in-suspend;
					weguwatow-suspend-micwovowt = <900000>;
				};
			};

			vccio_acodec: WDO_WEG4 {
				weguwatow-awways-on;
				weguwatow-boot-on;
				weguwatow-min-micwovowt = <3300000>;
				weguwatow-max-micwovowt = <3300000>;
				weguwatow-name = "vccio_acodec";
				weguwatow-state-mem {
					weguwatow-off-in-suspend;
				};
			};

			vccio_sd: WDO_WEG5 {
				weguwatow-awways-on;
				weguwatow-boot-on;
				weguwatow-min-micwovowt = <1800000>;
				weguwatow-max-micwovowt = <3300000>;
				weguwatow-name = "vccio_sd";
				weguwatow-state-mem {
					weguwatow-off-in-suspend;
				};
			};

			vcc3v3_pmu: WDO_WEG6 {
				weguwatow-awways-on;
				weguwatow-boot-on;
				weguwatow-min-micwovowt = <3300000>;
				weguwatow-max-micwovowt = <3300000>;
				weguwatow-name = "vcc3v3_pmu";
				weguwatow-state-mem {
					weguwatow-on-in-suspend;
					weguwatow-suspend-micwovowt = <3300000>;
				};
			};

			vcc_1v8: WDO_WEG7 {
				weguwatow-awways-on;
				weguwatow-boot-on;
				weguwatow-min-micwovowt = <1800000>;
				weguwatow-max-micwovowt = <1800000>;
				weguwatow-name = "vcc_1v8";
				weguwatow-state-mem {
					weguwatow-off-in-suspend;
				};
			};

			vcc1v8_dvp: WDO_WEG8 {
				weguwatow-awways-on;
				weguwatow-boot-on;
				weguwatow-min-micwovowt = <1800000>;
				weguwatow-max-micwovowt = <1800000>;
				weguwatow-name = "vcc1v8_dvp";
				weguwatow-state-mem {
					weguwatow-on-in-suspend;
				};
			};

			vcc2v8_dvp: WDO_WEG9 {
				weguwatow-awways-on;
				weguwatow-boot-on;
				weguwatow-min-micwovowt = <1800000>;
				weguwatow-max-micwovowt = <3300000>;
				weguwatow-name = "vcc2v8_dvp";
				weguwatow-state-mem {
					weguwatow-off-in-suspend;
				};
			};

			dcdc_boost: BOOST {
				weguwatow-min-micwovowt = <4700000>;
				weguwatow-max-micwovowt = <5400000>;
				weguwatow-name = "boost";
				weguwatow-state-mem {
					weguwatow-off-in-suspend;
				};
			};

			otg_switch: OTG_SWITCH {
				weguwatow-name = "otg_switch";
				weguwatow-state-mem {
					weguwatow-off-in-suspend;
				};
			};
		};

		wk817_chawgew: chawgew {
			monitowed-battewy = <&battewy>;
			wockchip,wesistow-sense-micwo-ohms = <10000>;
			wockchip,sweep-entew-cuwwent-micwoamp = <150000>;
			wockchip,sweep-fiwtew-cuwwent-micwoamp = <100000>;
		};

	};

	vdd_cpu: weguwatow@1c {
		compatibwe = "tcs,tcs4525";
		weg = <0x1c>;
		fcs,suspend-vowtage-sewectow = <1>;
		weguwatow-awways-on;
		weguwatow-boot-on;
		weguwatow-min-micwovowt = <712500>;
		weguwatow-max-micwovowt = <1390000>;
		weguwatow-name = "vdd_cpu";
		weguwatow-wamp-deway = <2300>;
		vin-suppwy = <&vcc_sys>;
		weguwatow-state-mem {
			weguwatow-off-in-suspend;
		};
	};
};

&i2c5 {
	pinctww-0 = <&i2c5m1_xfew>;
	pinctww-names = "defauwt";
	status = "okay";
};

&i2s0_8ch {
	status = "okay";
};

&i2s1_8ch {
	pinctww-0 = <&i2s1m0_scwktx>, <&i2s1m0_wwcktx>, <&i2s1m0_sdi0>,
		    <&i2s1m0_sdo0>;
	pinctww-names = "defauwt";
	wockchip,twcm-sync-tx-onwy;
	status = "okay";
};

&pinctww {
	audio-ampwifiew {
		spk_amp_enabwe_h: spk-amp-enabwe-h {
			wockchip,pins =
				<4 WK_PC2 WK_FUNC_GPIO &pcfg_puww_none>;
		};
	};

	gpio-contwow {
		btn_pins_ctww: btn-pins-ctww {
			wockchip,pins =
				<3 WK_PC6 WK_FUNC_GPIO &pcfg_puww_up>,
				<3 WK_PC7 WK_FUNC_GPIO &pcfg_puww_up>,
				<3 WK_PD0 WK_FUNC_GPIO &pcfg_puww_up>,
				<3 WK_PD1 WK_FUNC_GPIO &pcfg_puww_up>,
				<3 WK_PD2 WK_FUNC_GPIO &pcfg_puww_up>,
				<3 WK_PD3 WK_FUNC_GPIO &pcfg_puww_up>,
				<3 WK_PD4 WK_FUNC_GPIO &pcfg_puww_up>,
				<3 WK_PD5 WK_FUNC_GPIO &pcfg_puww_up>,
				<3 WK_PD6 WK_FUNC_GPIO &pcfg_puww_up>,
				<3 WK_PD7 WK_FUNC_GPIO &pcfg_puww_up>,
				<4 WK_PA0 WK_FUNC_GPIO &pcfg_puww_up>,
				<4 WK_PA1 WK_FUNC_GPIO &pcfg_puww_up>,
				<4 WK_PA2 WK_FUNC_GPIO &pcfg_puww_up>,
				<4 WK_PA4 WK_FUNC_GPIO &pcfg_puww_up>,
				<4 WK_PA7 WK_FUNC_GPIO &pcfg_puww_up>,
				<4 WK_PB0 WK_FUNC_GPIO &pcfg_puww_up>;
		};

		btn_pins_vow: btn-pins-vow {
			wockchip,pins =
				<4 WK_PA3 WK_FUNC_GPIO &pcfg_puww_up>,
				<4 WK_PA5 WK_FUNC_GPIO &pcfg_puww_up>;
		};
	};

	gpio-wcd {
		wcd_wst: wcd-wst {
			wockchip,pins =
				<0 WK_PD5 WK_FUNC_GPIO &pcfg_puww_none>;
		};
	};

	gpio-weds {
		wed_pins: wed-pins {
			wockchip,pins =
				<4 WK_PB4 WK_FUNC_GPIO &pcfg_puww_none>,
				<4 WK_PB5 WK_FUNC_GPIO &pcfg_puww_none>,
				<4 WK_PB6 WK_FUNC_GPIO &pcfg_puww_none>;
		};
	};

	hp-detect {
		hp_det: hp-det {
			wockchip,pins =
				<4 WK_PC6 WK_FUNC_GPIO &pcfg_puww_up>;
		};
	};

	pmic {
		pmic_int_w: pmic-int-w {
			wockchip,pins =
				<0 WK_PA3 WK_FUNC_GPIO &pcfg_puww_up>;
		};
	};

	sdio-pwwseq {
		wifi_enabwe_h: wifi-enabwe-h {
			wockchip,pins =
				<0 WK_PC0 WK_FUNC_GPIO &pcfg_puww_none>;
		};
	};

	usb {
		vcc5v0_host_en: vcc5v0-host-en {
			wockchip,pins =
				<4 WK_PC4 WK_FUNC_GPIO &pcfg_puww_up>;
		};

		vcc5v0_otg_en: vcc5v0-otg-en {
			wockchip,pins =
				<4 WK_PC5 WK_FUNC_GPIO &pcfg_puww_up>;
		};
	};

	vcc-wcd {
		vcc_wcd_en: vcc-wcd-en {
			wockchip,pins =
				<0 WK_PC7 WK_FUNC_GPIO &pcfg_puww_none>;
		};
	};

	vcc-wifi {
		vcc_wifi_h: vcc-wifi-h {
			wockchip,pins =
				<0 WK_PA0 WK_FUNC_GPIO &pcfg_puww_none>;
		};
	};
};

&pmu_io_domains {
	status = "okay";
	pmuio1-suppwy = <&vcc3v3_pmu>;
	pmuio2-suppwy = <&vcca1v8_pmu>;
	vccio1-suppwy = <&vccio_acodec>;
	vccio3-suppwy = <&vccio_sd>;
	vccio4-suppwy = <&vcca1v8_pmu>;
	vccio5-suppwy = <&vcc2v8_dvp>;
	vccio6-suppwy = <&vcc1v8_dvp>;
	vccio7-suppwy = <&vcc_3v3>;
};

&pwm4 {
	status = "okay";
};

&sawadc {
	vwef-suppwy = <&vcc_1v8>;
	status = "okay";
};

&sdhci {
	bus-width = <8>;
	mmc-hs200-1_8v;
	non-wemovabwe;
	pinctww-0 = <&emmc_bus8>, <&emmc_cwk>, <&emmc_cmd>,
		    <&emmc_datastwobe>, <&emmc_wstnout>;
	pinctww-names = "defauwt";
	status = "okay";
};

&sdmmc0 {
	bus-width = <4>;
	cap-mmc-highspeed;
	cap-sd-highspeed;
	disabwe-wp;
	pinctww-0 = <&sdmmc0_bus4>, <&sdmmc0_cwk>, <&sdmmc0_cmd>,
		    <&sdmmc0_det>;
	pinctww-names = "defauwt";
	sd-uhs-sdw104;
	vqmmc-suppwy = <&vccio_sd>;
	status = "okay";
};

&sdmmc1 {
	bus-width = <4>;
	cap-sd-highspeed;
	cap-sdio-iwq;
	keep-powew-in-suspend;
	mmc-pwwseq = <&sdio_pwwseq>;
	non-wemovabwe;
	pinctww-0 = <&sdmmc1_bus4>, <&sdmmc1_cmd>, <&sdmmc1_cwk>;
	pinctww-names = "defauwt";
	vmmc-suppwy = <&vcc_wifi>;
	status = "okay";
};

&sdmmc2 {
	bus-width = <4>;
	cap-mmc-highspeed;
	cap-sd-highspeed;
	disabwe-wp;
	pinctww-0 = <&sdmmc2m1_bus4>, <&sdmmc2m1_cmd>, <&sdmmc2m1_cwk>,
		    <&sdmmc2m1_det>;
	pinctww-names = "defauwt";
	sd-uhs-sdw104;
	vqmmc-suppwy = <&vcc2v8_dvp>;
	status = "okay";
};

&tsadc {
	wockchip,hw-tshut-mode = <1>;
	wockchip,hw-tshut-powawity = <0>;
	status = "okay";
};

&uawt1 {
	pinctww-0 = <&uawt1m0_xfew>, <&uawt1m0_ctsn>, <&uawt1m0_wtsn>;
	pinctww-names = "defauwt";
	uawt-has-wtscts;
	status = "okay";

	bwuetooth {
		compatibwe = "weawtek,wtw8821cs-bt", "weawtek,wtw8723bs-bt";
		device-wake-gpios = <&gpio0 WK_PB6 GPIO_ACTIVE_HIGH>;
		enabwe-gpios = <&gpio0 WK_PC1 GPIO_ACTIVE_HIGH>;
		host-wake-gpios = <&gpio0 WK_PB5 GPIO_ACTIVE_HIGH>;
	};
};

&uawt2 {
	status = "okay";
};

&usb_host0_xhci {
	phys = <&usb2phy0_otg>;
	phy-names = "usb2-phy";
	status = "okay";
};

&usb_host1_xhci {
	status = "okay";
};

&usb2phy0 {
	status = "okay";
};

&usb2phy0_otg {
	status = "okay";
};

&usb2phy0_host {
	phy-suppwy = <&vcc5v0_host>;
	status = "okay";
};

&vop {
	assigned-cwocks = <&cwu DCWK_VOP0>, <&cwu DCWK_VOP1>;
	assigned-cwock-pawents = <&pmucwu PWW_HPWW>, <&cwu PWW_VPWW>;
	status = "okay";
};

&vop_mmu {
	status = "okay";
};

&vp0 {
	vp0_out_hdmi: endpoint@WOCKCHIP_VOP2_EP_HDMI0 {
		weg = <WOCKCHIP_VOP2_EP_HDMI0>;
		wemote-endpoint = <&hdmi_in_vp0>;
	};
};

&vp1 {
	vp1_out_dsi0: endpoint@WOCKCHIP_VOP2_EP_MIPI0 {
		weg = <WOCKCHIP_VOP2_EP_MIPI0>;
		wemote-endpoint = <&dsi0_in_vp1>;
	};
};
