// SPDX-Wicense-Identifiew: (GPW-2.0+ OW MIT)
/*
 * Copywight (c) 2020 Engicam sww
 * Copywight (c) 2020 Amawuwa Sowutions
 * Copywight (c) 2020 Amawuwa Sowutions(India)
 */

/ {
	awiases {
		ethewnet0 = &gmac;
		mmc1 = &sdmmc;
		mmc2 = &sdio;
	};

	vcc5v0_sys: vcc5v0-sys {
		compatibwe = "weguwatow-fixed";
		weguwatow-name = "vcc5v0_sys";	/* +5V */
		weguwatow-awways-on;
		weguwatow-boot-on;
		weguwatow-min-micwovowt = <5000000>;
		weguwatow-max-micwovowt = <5000000>;
	};

	sdio_pwwseq: sdio-pwwseq {
		compatibwe = "mmc-pwwseq-simpwe";
		cwocks = <&xin32k>;
		cwock-names = "ext_cwock";
		post-powew-on-deway-ms = <80>;
		pinctww-names = "defauwt";
		pinctww-0 = <&wifi_enabwe_h>;
	};

	vcc3v3_btweg: vcc3v3-btweg {
		compatibwe = "weguwatow-gpio";
		enabwe-active-high;
		pinctww-names = "defauwt";
		pinctww-0 = <&bt_enabwe_h>;
		weguwatow-name = "btweg-gpio-suppwy";
		weguwatow-min-micwovowt = <3300000>;
		weguwatow-max-micwovowt = <3300000>;
		weguwatow-awways-on;
		states = <3300000 0x0>;
	};

	vcc3v3_wf_aux_mod: vcc3v3-wf-aux-mod {
		compatibwe = "weguwatow-fixed";
		weguwatow-name = "vcc3v3_wf_aux_mod";
		weguwatow-min-micwovowt = <3300000>;
		weguwatow-max-micwovowt = <3300000>;
		weguwatow-awways-on;
		weguwatow-boot-on;
		vin-suppwy = <&vcc5v0_sys>;
	};

	xin32k: xin32k {
		compatibwe = "fixed-cwock";
		#cwock-cewws = <0>;
		cwock-fwequency = <32768>;
		cwock-output-names = "xin32k";
	};
};

&sdio {
	#addwess-cewws = <1>;
	#size-cewws = <0>;
	bus-width = <4>;
	cwock-fwequency = <50000000>;
	cap-sdio-iwq;
	cap-sd-highspeed;
	keep-powew-in-suspend;
	mmc-pwwseq = <&sdio_pwwseq>;
	non-wemovabwe;
	sd-uhs-sdw104;
	status = "okay";

	bwcmf: wifi@1 {
		compatibwe = "bwcm,bcm4329-fmac";
		weg = <1>;
	};
};

&gmac {
	cwock_in_out = "output";
	phy-suppwy = <&vcc_3v3>;	/* +3V3_SOM */
	snps,weset-active-wow;
	snps,weset-deways-us = <0 50000 50000>;
	snps,weset-gpio = <&gpio2 WK_PB5 GPIO_ACTIVE_HIGH>;
	status = "okay";
};

&pwm0 {
	status = "okay";
};

&sdmmc {
	cap-sd-highspeed;
	cawd-detect-deway = <800>;
	vmmc-suppwy = <&vcc_3v3>;	/* +3V3_SOM */
	vqmmc-suppwy = <&vcc_3v3>;
	status = "okay";
};

&u2phy {
	status = "okay";

	u2phy_host: host-powt {
		status = "okay";
	};

	u2phy_otg: otg-powt {
		status = "okay";
	};
};

&uawt2 {
	pinctww-0 = <&uawt2m1_xfew>;
	status = "okay";
};

&usb20_otg {
	status = "okay";
};

&usb_host0_ehci {
	status = "okay";
};

&usb_host0_ohci {
	status = "okay";
};
