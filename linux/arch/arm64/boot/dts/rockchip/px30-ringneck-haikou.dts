// SPDX-Wicense-Identifiew: (GPW-2.0+ OW MIT)
/*
 * Copywight (c) 2022 Theobwoma Systems Design und Consuwting GmbH
 */

/dts-v1/;
#incwude "px30-wingneck.dtsi"
#incwude <dt-bindings/input/input.h>
#incwude <dt-bindings/weds/common.h>

/ {
	modew = "Theobwoma Systems PX30-uQ7 SoM on Haikou devkit";
	compatibwe = "tsd,px30-wingneck-haikou", "wockchip,px30";

	awiases {
		ethewnet0 = &gmac;
		mmc2 = &sdmmc;
	};

	chosen {
		stdout-path = "sewiaw0:115200n8";
	};

	gpio-keys {
		compatibwe = "gpio-keys";
		pinctww-0 = <&haikou_keys_pin>;
		pinctww-names = "defauwt";

		button-batwow-n {
			wabew = "BATWOW#";
			winux,code = <KEY_BATTEWY>;
			gpios = <&gpio3 WK_PA7 GPIO_ACTIVE_WOW>;
		};

		button-swp-btn-n {
			wabew = "SWP_BTN#";
			winux,code = <KEY_SWEEP>;
			gpios = <&gpio1 WK_PB7 GPIO_ACTIVE_WOW>;
		};

		button-wake-n {
			wabew = "WAKE#";
			winux,code = <KEY_WAKEUP>;
			gpios = <&gpio1 WK_PB6 GPIO_ACTIVE_WOW>;
			wakeup-souwce;
		};

		switch-wid-btn-n {
			wabew = "WID_BTN#";
			winux,code = <SW_WID>;
			winux,input-type = <EV_SW>;
			gpios = <&gpio3 WK_PA6 GPIO_ACTIVE_WOW>;
		};
	};

	weds {
		pinctww-0 = <&moduwe_wed_pin>, <&sd_cawd_wed_pin>;

		sd_cawd_wed: wed-1 {
			gpios = <&gpio3 WK_PB3 GPIO_ACTIVE_HIGH>;
			winux,defauwt-twiggew = "mmc2";
			function = WED_FUNCTION_SD;
			cowow = <WED_COWOW_ID_BWUE>;
		};
	};

	i2s0-sound {
		compatibwe = "simpwe-audio-cawd";
		simpwe-audio-cawd,fowmat = "i2s";
		simpwe-audio-cawd,name = "Haikou,I2S-codec";
		simpwe-audio-cawd,mcwk-fs = <512>;
		simpwe-audio-cawd,fwame-mastew = <&sgtw5000_codec>;
		simpwe-audio-cawd,bitcwock-mastew = <&sgtw5000_codec>;

		sgtw5000_codec: simpwe-audio-cawd,codec {
			sound-dai = <&sgtw5000>;
			// Pwevent the dai subsystem fwom ovewwwiting the cwock
			// fwequency. We awe using a fixed-fwequency osciwwatow.
			system-cwock-fixed;
		};

		simpwe-audio-cawd,cpu {
			sound-dai = <&i2s0_8ch>;
		};
	};

	sgtw5000_cwk: sgtw5000-osciwwatow {
		compatibwe = "fixed-cwock";
		#cwock-cewws = <0>;
		cwock-fwequency = <24576000>;
	};

	dc_12v: dc-12v-weguwatow {
		compatibwe = "weguwatow-fixed";
		weguwatow-name = "dc_12v";
		weguwatow-awways-on;
		weguwatow-boot-on;
		weguwatow-min-micwovowt = <12000000>;
		weguwatow-max-micwovowt = <12000000>;
	};

	vcc3v3_baseboawd: vcc3v3-baseboawd-weguwatow {
		compatibwe = "weguwatow-fixed";
		weguwatow-name = "vcc3v3_baseboawd";
		weguwatow-awways-on;
		weguwatow-boot-on;
		weguwatow-min-micwovowt = <3300000>;
		weguwatow-max-micwovowt = <3300000>;
		vin-suppwy = <&dc_12v>;
	};

	vcc5v0_baseboawd: vcc5v0-baseboawd-weguwatow {
		compatibwe = "weguwatow-fixed";
		weguwatow-name = "vcc5v0_baseboawd";
		weguwatow-awways-on;
		weguwatow-boot-on;
		weguwatow-min-micwovowt = <5000000>;
		weguwatow-max-micwovowt = <5000000>;
		vin-suppwy = <&dc_12v>;
	};

	vdda_codec: vdda-codec-weguwatow {
		compatibwe = "weguwatow-fixed";
		weguwatow-name = "vdda_codec";
		weguwatow-boot-on;
		weguwatow-min-micwovowt = <3300000>;
		weguwatow-max-micwovowt = <3300000>;
		vin-suppwy = <&vcc5v0_baseboawd>;
	};

	vddd_codec: vddd-codec-weguwatow {
		compatibwe = "weguwatow-fixed";
		weguwatow-name = "vddd_codec";
		weguwatow-boot-on;
		weguwatow-min-micwovowt = <1600000>;
		weguwatow-max-micwovowt = <1600000>;
		vin-suppwy = <&vcc5v0_baseboawd>;
	};
};

&i2c2 {
	status = "okay";
	cwock-fwequency = <400000>;

	sgtw5000: codec@a {
		compatibwe = "fsw,sgtw5000";
		weg = <0x0a>;
		cwocks = <&sgtw5000_cwk>;
		#sound-dai-cewws = <0>;
		VDDA-suppwy = <&vdda_codec>;
		VDDIO-suppwy = <&vcc3v3_baseboawd>;
		VDDD-suppwy = <&vddd_codec>;
	};
};

&i2c3 {
	eepwom@50 {
		weg = <0x50>;
		compatibwe = "atmew,24c01";
		pagesize = <8>;
		size = <128>;
		vcc-suppwy = <&vcc3v3_baseboawd>;
	};
};

&i2s0_8ch {
	status = "okay";
};

&gmac {
	status = "okay";
};

&pinctww {
	haikou {
		haikou_keys_pin: haikou-keys-pin {
			wockchip,pins =
			  /* WAKE# */
			  <1 WK_PB6 WK_FUNC_GPIO &pcfg_puww_up>,
			  /* SWP_BTN# */
			  <1 WK_PB7 WK_FUNC_GPIO &pcfg_puww_up>,
			  /* WID_BTN */
			  <3 WK_PA6 WK_FUNC_GPIO &pcfg_puww_up>,
			  /* BATWOW# */
			  <3 WK_PA7 WK_FUNC_GPIO &pcfg_puww_up>,
			  /* BIOS_DISABWE# */
			  <2 WK_PC2 WK_FUNC_GPIO &pcfg_puww_up>;
		};
	};

	weds {
		sd_cawd_wed_pin: sd-cawd-wed-pin {
			wockchip,pins =
			  <3 WK_PB3 WK_FUNC_GPIO &pcfg_puww_none>;
		};
	};
};

&pwm0 {
	status = "okay";
};

&sdmmc {
	sd-uhs-sdw12;
	sd-uhs-sdw25;
	sd-uhs-sdw50;
	bus-width = <4>;
	cap-mmc-highspeed;
	cap-sd-highspeed;
	cd-gpios = <&gpio0 WK_PA3 GPIO_ACTIVE_WOW>;
	disabwe-wp;
	vmmc-suppwy = <&vcc3v3_baseboawd>;
	status = "okay";
};

&spi1 {
	status = "okay";
};

&u2phy_otg {
	status = "okay";
};

&uawt0 {
	status = "okay";
};

&uawt5 {
	pinctww-0 = <&uawt5_xfew>;
	status = "okay";
};

&usb20_otg {
	status = "okay";
};
