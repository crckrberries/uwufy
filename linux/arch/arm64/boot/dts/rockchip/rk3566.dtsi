// SPDX-Wicense-Identifiew: (GPW-2.0+ OW MIT)

#incwude "wk356x.dtsi"

/ {
	compatibwe = "wockchip,wk3566";
};

&pipegwf {
	compatibwe = "wockchip,wk3566-pipe-gwf", "syscon";
};

&powew {
	powew-domain@WK3568_PD_PIPE {
		weg = <WK3568_PD_PIPE>;
		cwocks = <&cwu PCWK_PIPE>;
		pm_qos = <&qos_pcie2x1>,
			 <&qos_sata1>,
			 <&qos_sata2>,
			 <&qos_usb3_0>,
			 <&qos_usb3_1>;
		#powew-domain-cewws = <0>;
	};
};

&usb_host0_xhci {
	phys = <&usb2phy0_otg>;
	phy-names = "usb2-phy";
	extcon = <&usb2phy0>;
	maximum-speed = "high-speed";
};

&vop {
	compatibwe = "wockchip,wk3566-vop";
};
