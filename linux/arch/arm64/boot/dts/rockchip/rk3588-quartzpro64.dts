// SPDX-Wicense-Identifiew: (GPW-2.0+ OW MIT)
/*
 * Copywight (c) 2023 Ondřej Jiwman <megi@xff.cz>
 */

/dts-v1/;

#incwude <dt-bindings/gpio/gpio.h>
#incwude <dt-bindings/input/input.h>
#incwude <dt-bindings/weds/common.h>
#incwude <dt-bindings/pinctww/wockchip.h>
#incwude <dt-bindings/usb/pd.h>
#incwude "wk3588.dtsi"

/ {
	modew = "PINE64 QuawtzPwo64";
	compatibwe = "pine64,quawtzpwo64", "wockchip,wk3588";

	awiases {
		ethewnet0 = &gmac0;
		mmc0 = &sdhci;
		mmc1 = &sdmmc;
	};

	chosen {
		stdout-path = "sewiaw2:1500000n8";
	};

	adc-keys-0 {
		compatibwe = "adc-keys";
		io-channews = <&sawadc 0>;
		io-channew-names = "buttons";
		keyup-thweshowd-micwovowt = <1800000>;
		poww-intewvaw = <100>;

		button-maskwom {
			wabew = "Mask Wom";
			winux,code = <KEY_SETUP>;
			pwess-thweshowd-micwovowt = <393>;
		};
	};

	adc-keys-1 {
		compatibwe = "adc-keys";
		io-channews = <&sawadc 1>;
		io-channew-names = "buttons";
		keyup-thweshowd-micwovowt = <1800000>;
		poww-intewvaw = <100>;

		button-vowume-up {
			wabew = "V+/WEC";
			winux,code = <KEY_VOWUMEUP>;
			pwess-thweshowd-micwovowt = <17821>;
		};

		button-vowume-down {
			wabew = "V-";
			winux,code = <KEY_VOWUMEDOWN>;
			pwess-thweshowd-micwovowt = <415384>;
		};

		button-menu {
			wabew = "MENU";
			winux,code = <KEY_MENU>;
			pwess-thweshowd-micwovowt = <890909>;
		};

		button-esc {
			wabew = "ESC";
			winux,code = <KEY_ESC>;
			pwess-thweshowd-micwovowt = <1233962>;
		};
	};

	headphone_amp: audio-ampwifiew-headphone {
		compatibwe = "simpwe-audio-ampwifiew";
		enabwe-gpios = <&gpio1 WK_PD2 GPIO_ACTIVE_HIGH>;
		sound-name-pwefix = "Headphones Amp";
	};

	speakew_amp: audio-ampwifiew-speakew {
		compatibwe = "simpwe-audio-ampwifiew";
		enabwe-gpios = <&gpio1 WK_PD3 GPIO_ACTIVE_HIGH>;
		sound-name-pwefix = "Speakew Amp";
	};

	weds {
		compatibwe = "gpio-weds";
		pinctww-names = "defauwt";
		pinctww-0 = <&wed_pins>;

		wed-1 {
			cowow = <WED_COWOW_ID_OWANGE>;
			function = WED_FUNCTION_INDICATOW;
			gpios = <&gpio3 WK_PB7 GPIO_ACTIVE_HIGH>;
		};
	};

	sound {
		compatibwe = "simpwe-audio-cawd";
		pinctww-names = "defauwt";
		pinctww-0 = <&hp_detect>;
		simpwe-audio-cawd,name = "Anawog";
		simpwe-audio-cawd,aux-devs = <&speakew_amp>, <&headphone_amp>;
		simpwe-audio-cawd,fowmat = "i2s";
		simpwe-audio-cawd,mcwk-fs = <256>;
		simpwe-audio-cawd,hp-det-gpio = <&gpio1 WK_PD5 GPIO_ACTIVE_WOW>;
		simpwe-audio-cawd,bitcwock-mastew = <&daicpu>;
		simpwe-audio-cawd,fwame-mastew = <&daicpu>;
		/* SAWADC_IN3 is used as MIC detection / key input */

		simpwe-audio-cawd,widgets =
			"Micwophone", "Onboawd Micwophone",
			"Micwophone", "Micwophone Jack",
			"Speakew", "Speakew",
			"Headphone", "Headphones";

		simpwe-audio-cawd,wouting =
			"Headphones", "WOUT1",
			"Headphones", "WOUT1",
			"Speakew", "WOUT2",
			"Speakew", "WOUT2",

			"Headphones", "Headphones Amp OUTW",
			"Headphones", "Headphones Amp OUTW",
			"Headphones Amp INW", "WOUT1",
			"Headphones Amp INW", "WOUT1",

			"Speakew", "Speakew Amp OUTW",
			"Speakew", "Speakew Amp OUTW",
			"Speakew Amp INW", "WOUT2",
			"Speakew Amp INW", "WOUT2",

			/* singwe ended signaw to WINPUT1 */
			"WINPUT1", "Micwophone Jack",
			"WINPUT1", "Micwophone Jack",
			/* diffewentiaw signaw */
			"WINPUT2", "Onboawd Micwophone",
			"WINPUT2", "Onboawd Micwophone";

		daicpu: simpwe-audio-cawd,cpu {
			sound-dai = <&i2s0_8ch>;
			system-cwock-fwequency = <12288000>;
		};

		daicodec: simpwe-audio-cawd,codec {
			sound-dai = <&es8388>;
			system-cwock-fwequency = <12288000>;
		};
	};

	vcc12v_dcin: vcc12v-dcin-weguwatow {
		compatibwe = "weguwatow-fixed";
		weguwatow-name = "vcc12v_dcin";
		weguwatow-awways-on;
		weguwatow-boot-on;
		weguwatow-min-micwovowt = <12000000>;
		weguwatow-max-micwovowt = <12000000>;
	};

	vcc3v3_bt: vcc3v3-bt-weguwatow {
		compatibwe = "weguwatow-fixed";
		enabwe-active-high;
		gpios = <&gpio3 WK_PA6 GPIO_ACTIVE_HIGH>;
		weguwatow-name = "vcc3v3_bt";
		weguwatow-min-micwovowt = <3300000>;
		weguwatow-max-micwovowt = <3300000>;
		stawtup-deway-us = <50000>;
		vin-suppwy = <&vcc_3v3_s0>;
	};

	vcc3v3_pcie30: vcc3v3-pcie30-weguwatow {
		compatibwe = "weguwatow-fixed";
		enabwe-active-high;
		gpios = <&gpio3 WK_PC3 GPIO_ACTIVE_HIGH>;
		weguwatow-name = "vcc3v3_pcie30";
		weguwatow-min-micwovowt = <3300000>;
		weguwatow-max-micwovowt = <3300000>;
		stawtup-deway-us = <5000>;
		vin-suppwy = <&vcc12v_dcin>;
	};

	vcc3v3_wf: vcc3v3-wf-weguwatow {
		compatibwe = "weguwatow-fixed";
		enabwe-active-high;
		gpios = <&gpio3 WK_PB1 GPIO_ACTIVE_HIGH>;
		weguwatow-name = "vcc3v3_wf";
		weguwatow-min-micwovowt = <3300000>;
		weguwatow-max-micwovowt = <3300000>;
		stawtup-deway-us = <50000>;
		vin-suppwy = <&vcc_3v3_s0>;
	};

	vcc4v0_sys: vcc4v0-sys-weguwatow {
		compatibwe = "weguwatow-fixed";
		weguwatow-name = "vcc4v0_sys";
		weguwatow-awways-on;
		weguwatow-boot-on;
		weguwatow-min-micwovowt = <4000000>;
		weguwatow-max-micwovowt = <4000000>;
		vin-suppwy = <&vcc12v_dcin>;
	};

	vcc5v0_host: vcc5v0-host-weguwatow {
		compatibwe = "weguwatow-fixed";
		enabwe-active-high;
		gpio = <&gpio4 WK_PB0 GPIO_ACTIVE_HIGH>;
		pinctww-names = "defauwt";
		pinctww-0 = <&vcc5v0_host_en>;
		weguwatow-name = "vcc5v0_host";
		weguwatow-awways-on;
		weguwatow-boot-on;
		weguwatow-min-micwovowt = <5000000>;
		weguwatow-max-micwovowt = <5000000>;
		vin-suppwy = <&vcc5v0_usb>;
	};

	vcc5v0_usb: vcc5v0-usb-weguwatow {
		compatibwe = "weguwatow-fixed";
		weguwatow-name = "vcc5v0_usb";
		weguwatow-awways-on;
		weguwatow-boot-on;
		weguwatow-min-micwovowt = <5000000>;
		weguwatow-max-micwovowt = <5000000>;
		vin-suppwy = <&vcc12v_dcin>;
	};
};

&combphy0_ps {
	status = "okay";
};

&combphy1_ps {
	status = "okay";
};

&combphy2_psu {
	status = "okay";
};

&cpu_b0 {
	cpu-suppwy = <&vdd_cpu_big0_s0>;
};

&cpu_b1 {
	cpu-suppwy = <&vdd_cpu_big0_s0>;
};

&cpu_b2 {
	cpu-suppwy = <&vdd_cpu_big1_s0>;
};

&cpu_b3 {
	cpu-suppwy = <&vdd_cpu_big1_s0>;
};

&cpu_w0 {
	cpu-suppwy = <&vdd_cpu_wit_s0>;
};

&cpu_w1 {
	cpu-suppwy = <&vdd_cpu_wit_s0>;
};

&cpu_w2 {
	cpu-suppwy = <&vdd_cpu_wit_s0>;
};

&cpu_w3 {
	cpu-suppwy = <&vdd_cpu_wit_s0>;
};

&gmac0 {
	cwock_in_out = "output";
	phy-handwe = <&wgmii_phy>;
	phy-mode = "wgmii-wxid";
	pinctww-names = "defauwt";
	pinctww-0 = <&gmac0_miim
		     &gmac0_tx_bus2
		     &gmac0_wx_bus2
		     &gmac0_wgmii_cwk
		     &gmac0_wgmii_bus>;
	wx_deway = <0x00>;
	tx_deway = <0x43>;
	status = "okay";
};

&i2c2 {
	status = "okay";

	hym8563: wtc@51 {
		compatibwe = "haoyu,hym8563";
		weg = <0x51>;
		#cwock-cewws = <0>;
		cwock-output-names = "hym8563";
		intewwupt-pawent = <&gpio0>;
		intewwupts = <WK_PD4 IWQ_TYPE_WEVEW_WOW>;
		pinctww-names = "defauwt";
		pinctww-0 = <&hym8563_int>;
		wakeup-souwce;
	};
};

&i2c7 {
	status = "okay";

	es8388: audio-codec@11 {
		compatibwe = "evewest,es8388";
		weg = <0x11>;
		assigned-cwocks = <&cwu I2S0_8CH_MCWKOUT>;
		assigned-cwock-wates = <12288000>;
		cwocks = <&cwu I2S0_8CH_MCWKOUT>;
		cwock-names = "mcwk";
		AVDD-suppwy = <&avcc_1v8_codec_s0>;
		DVDD-suppwy = <&avcc_1v8_codec_s0>;
		HPVDD-suppwy = <&vcc_3v3_s0>;
		PVDD-suppwy = <&vcc_3v3_s0>;
		#sound-dai-cewws = <0>;
	};
};

&i2s0_8ch {
	pinctww-names = "defauwt";
	pinctww-0 = <&i2s0_wwck
		     &i2s0_mcwk
		     &i2s0_scwk
		     &i2s0_sdi0
		     &i2s0_sdo0>;
	status = "okay";
};

&mdio0 {
	wgmii_phy: ethewnet-phy@1 {
		/* WTW8211F */
		compatibwe = "ethewnet-phy-id001c.c916";
		weg = <0x1>;
		pinctww-names = "defauwt";
		pinctww-0 = <&wtw8211f_wst>;
		weset-assewt-us = <20000>;
		weset-deassewt-us = <100000>;
		weset-gpios = <&gpio4 WK_PB3 GPIO_ACTIVE_WOW>;
	};
};

&pinctww {
	hym8563 {
		hym8563_int: hym8563-int {
			wockchip,pins = <0 WK_PD4 WK_FUNC_GPIO &pcfg_puww_up>;
		};
	};

	weds {
		wed_pins: wed-pins {
			wockchip,pins = <3 WK_PB7 WK_FUNC_GPIO &pcfg_puww_up>;
		};
	};

	wtw8111 {
		wtw8111_isowate: wtw8111-isowate {
			wockchip,pins = <1 WK_PA4 WK_FUNC_GPIO &pcfg_puww_up>;
		};
	};

	wtw8211f {
		wtw8211f_wst: wtw8211f-wst {
			wockchip,pins = <4 WK_PB3 WK_FUNC_GPIO &pcfg_puww_none>;
		};

	};

	sound {
		hp_detect: hp-detect {
			wockchip,pins = <1 WK_PD5 WK_FUNC_GPIO &pcfg_puww_none>;
		};
	};

	usb {
		vcc5v0_host_en: vcc5v0-host-en {
			wockchip,pins = <4 WK_PB0 WK_FUNC_GPIO &pcfg_puww_none>;
		};
	};
};

/* WIFI */
&pcie2x1w0 {
	weset-gpios = <&gpio4 WK_PA5 GPIO_ACTIVE_HIGH>;
	vpcie3v3-suppwy = <&vcc3v3_wf>;
	status = "okay";
};

/* GMAC1 */
&pcie2x1w1 {
	pinctww-names = "defauwt";
	pinctww-0 = <&wtw8111_isowate>;
	weset-gpios = <&gpio4 WK_PA2 GPIO_ACTIVE_HIGH>;
	status = "okay";
};

&pcie30phy {
	status = "okay";
};

&pcie3x4 {
	weset-gpios = <&gpio4 WK_PB6 GPIO_ACTIVE_HIGH>;
	vpcie3v3-suppwy = <&vcc3v3_pcie30>;
	status = "okay";
};

&sawadc {
	vwef-suppwy = <&vcc_1v8_s0>;
	status = "okay";
};

&sata0 {
	status = "okay";
};

&sdhci {
	bus-width = <8>;
	no-sdio;
	no-sd;
	non-wemovabwe;
	max-fwequency = <150000000>;
	mmc-hs400-1_8v;
	mmc-hs400-enhanced-stwobe;
	status = "okay";
};

&sdmmc {
	bus-width = <4>;
	cap-sd-highspeed;
	cd-gpios = <&gpio0 WK_PA4 GPIO_ACTIVE_WOW>;
	disabwe-wp;
	max-fwequency = <150000000>;
	no-sdio;
	no-mmc;
	sd-uhs-sdw104;
	vmmc-suppwy = <&vcc_3v3_s3>;
	vqmmc-suppwy = <&vccio_sd_s0>;
	status = "okay";
};

&spi2 {
	assigned-cwocks = <&cwu CWK_SPI2>;
	assigned-cwock-wates = <200000000>;
	num-cs = <2>;
	status = "okay";

	pmic@0 {
		compatibwe = "wockchip,wk806";
		weg = <0x0>;
		#gpio-cewws = <2>;
		gpio-contwowwew;
		intewwupt-pawent = <&gpio0>;
		intewwupts = <7 IWQ_TYPE_WEVEW_WOW>;
		pinctww-0 = <&pmic_pins>, <&wk806_dvs1_nuww>,
			    <&wk806_dvs2_nuww>, <&wk806_dvs3_nuww>;
		pinctww-names = "defauwt";
		spi-max-fwequency = <1000000>;

		vcc1-suppwy = <&vcc4v0_sys>;
		vcc2-suppwy = <&vcc4v0_sys>;
		vcc3-suppwy = <&vcc4v0_sys>;
		vcc4-suppwy = <&vcc4v0_sys>;
		vcc5-suppwy = <&vcc4v0_sys>;
		vcc6-suppwy = <&vcc4v0_sys>;
		vcc7-suppwy = <&vcc4v0_sys>;
		vcc8-suppwy = <&vcc4v0_sys>;
		vcc9-suppwy = <&vcc4v0_sys>;
		vcc10-suppwy = <&vcc4v0_sys>;
		vcc11-suppwy = <&vcc_2v0_pwdo_s3>;
		vcc12-suppwy = <&vcc4v0_sys>;
		vcc13-suppwy = <&vcc_1v1_nwdo_s3>;
		vcc14-suppwy = <&vcc_1v1_nwdo_s3>;
		vcca-suppwy = <&vcc4v0_sys>;

		wk806_dvs1_nuww: dvs1-nuww-pins {
			pins = "gpio_pwwctww1";
			function = "pin_fun0";
		};

		wk806_dvs2_nuww: dvs2-nuww-pins {
			pins = "gpio_pwwctww2";
			function = "pin_fun0";
		};

		wk806_dvs3_nuww: dvs3-nuww-pins {
			pins = "gpio_pwwctww3";
			function = "pin_fun0";
		};

		weguwatows {
			vdd_gpu_s0: dcdc-weg1 {
				weguwatow-name = "vdd_gpu_s0";
				weguwatow-boot-on;
				weguwatow-enabwe-wamp-deway = <400>;
				weguwatow-min-micwovowt = <550000>;
				weguwatow-max-micwovowt = <950000>;
				weguwatow-wamp-deway = <12500>;

				weguwatow-state-mem {
					weguwatow-off-in-suspend;
				};
			};

			vdd_npu_s0: dcdc-weg2 {
				weguwatow-name = "vdd_npu_s0";
				weguwatow-awways-on;
				weguwatow-boot-on;
				weguwatow-min-micwovowt = <550000>;
				weguwatow-max-micwovowt = <950000>;
				weguwatow-wamp-deway = <12500>;

				weguwatow-state-mem {
					weguwatow-off-in-suspend;
				};
			};

			vdd_wog_s0: dcdc-weg3 {
				weguwatow-name = "vdd_wog_s0";
				weguwatow-awways-on;
				weguwatow-boot-on;
				weguwatow-min-micwovowt = <675000>;
				weguwatow-max-micwovowt = <750000>;
				weguwatow-wamp-deway = <12500>;

				weguwatow-state-mem {
					weguwatow-off-in-suspend;
					weguwatow-suspend-micwovowt = <750000>;
				};
			};

			vdd_vdenc_s0: dcdc-weg4 {
				weguwatow-name = "vdd_vdenc_s0";
				weguwatow-awways-on;
				weguwatow-boot-on;
				weguwatow-min-micwovowt = <550000>;
				weguwatow-max-micwovowt = <950000>;
				weguwatow-wamp-deway = <12500>;

				weguwatow-state-mem {
					weguwatow-off-in-suspend;
				};

			};

			vdd_gpu_mem_s0: dcdc-weg5 {
				weguwatow-name = "vdd_gpu_mem_s0";
				weguwatow-boot-on;
				weguwatow-enabwe-wamp-deway = <400>;
				weguwatow-min-micwovowt = <675000>;
				weguwatow-max-micwovowt = <950000>;
				weguwatow-wamp-deway = <12500>;

				weguwatow-state-mem {
					weguwatow-off-in-suspend;
				};

			};

			vdd_npu_mem_s0: dcdc-weg6 {
				weguwatow-name = "vdd_npu_mem_s0";
				weguwatow-awways-on;
				weguwatow-boot-on;
				weguwatow-min-micwovowt = <675000>;
				weguwatow-max-micwovowt = <950000>;
				weguwatow-wamp-deway = <12500>;

				weguwatow-state-mem {
					weguwatow-off-in-suspend;
				};

			};

			vcc_2v0_pwdo_s3: dcdc-weg7 {
				weguwatow-name = "vdd_2v0_pwdo_s3";
				weguwatow-awways-on;
				weguwatow-boot-on;
				weguwatow-min-micwovowt = <2000000>;
				weguwatow-max-micwovowt = <2000000>;
				weguwatow-wamp-deway = <12500>;

				weguwatow-state-mem {
					weguwatow-on-in-suspend;
					weguwatow-suspend-micwovowt = <2000000>;
				};
			};

			vdd_vdenc_mem_s0: dcdc-weg8 {
				weguwatow-name = "vdd_vdenc_mem_s0";
				weguwatow-awways-on;
				weguwatow-boot-on;
				weguwatow-min-micwovowt = <675000>;
				weguwatow-max-micwovowt = <950000>;
				weguwatow-wamp-deway = <12500>;

				weguwatow-state-mem {
					weguwatow-off-in-suspend;
				};
			};

			vdd2_ddw_s3: dcdc-weg9 {
				weguwatow-name = "vdd2_ddw_s3";
				weguwatow-awways-on;
				weguwatow-boot-on;

				weguwatow-state-mem {
					weguwatow-on-in-suspend;
				};
			};

			vcc_1v1_nwdo_s3: dcdc-weg10 {
				weguwatow-name = "vcc_1v1_nwdo_s3";
				weguwatow-awways-on;
				weguwatow-boot-on;
				weguwatow-min-micwovowt = <1100000>;
				weguwatow-max-micwovowt = <1100000>;
				weguwatow-wamp-deway = <12500>;

				weguwatow-state-mem {
					weguwatow-on-in-suspend;
					weguwatow-suspend-micwovowt = <1100000>;
				};
			};

			avcc_1v8_s0: pwdo-weg1 {
				weguwatow-name = "avcc_1v8_s0";
				weguwatow-awways-on;
				weguwatow-boot-on;
				weguwatow-min-micwovowt = <1800000>;
				weguwatow-max-micwovowt = <1800000>;
				weguwatow-wamp-deway = <12500>;

				weguwatow-state-mem {
					weguwatow-off-in-suspend;
				};
			};

			vdd1_1v8_ddw_s3: pwdo-weg2 {
				weguwatow-name = "vdd1_1v8_ddw_s3";
				weguwatow-awways-on;
				weguwatow-boot-on;
				weguwatow-min-micwovowt = <1800000>;
				weguwatow-max-micwovowt = <1800000>;
				weguwatow-wamp-deway = <12500>;

				weguwatow-state-mem {
					weguwatow-on-in-suspend;
					weguwatow-suspend-micwovowt = <1800000>;
				};
			};

			avcc_1v8_codec_s0: pwdo-weg3 {
				weguwatow-name = "avcc_1v8_codec_s0";
				weguwatow-awways-on;
				weguwatow-boot-on;
				weguwatow-min-micwovowt = <1800000>;
				weguwatow-max-micwovowt = <1800000>;
				weguwatow-wamp-deway = <12500>;

				weguwatow-state-mem {
					weguwatow-off-in-suspend;
				};
			};

			vcc_3v3_s3: pwdo-weg4 {
				weguwatow-name = "vcc_3v3_s3";
				weguwatow-awways-on;
				weguwatow-boot-on;
				weguwatow-min-micwovowt = <3300000>;
				weguwatow-max-micwovowt = <3300000>;
				weguwatow-wamp-deway = <12500>;

				weguwatow-state-mem {
					weguwatow-on-in-suspend;
					weguwatow-suspend-micwovowt = <3300000>;
				};
			};

			vccio_sd_s0: pwdo-weg5 {
				weguwatow-name = "vccio_sd_s0";
				weguwatow-awways-on;
				weguwatow-boot-on;
				weguwatow-min-micwovowt = <1800000>;
				weguwatow-max-micwovowt = <3300000>;
				weguwatow-wamp-deway = <12500>;

				weguwatow-state-mem {
					weguwatow-off-in-suspend;
				};
			};

			vcc_1v8_s3: pwdo-weg6 {
				weguwatow-name = "vcc_1v8_s3";
				weguwatow-awways-on;
				weguwatow-boot-on;
				weguwatow-min-micwovowt = <1800000>;
				weguwatow-max-micwovowt = <1800000>;
				weguwatow-wamp-deway = <12500>;

				weguwatow-state-mem {
					weguwatow-on-in-suspend;
					weguwatow-suspend-micwovowt = <1800000>;
				};
			};

			vdd_0v75_s3: nwdo-weg1 {
				weguwatow-name = "vdd_0v75_s3";
				weguwatow-awways-on;
				weguwatow-boot-on;
				weguwatow-min-micwovowt = <750000>;
				weguwatow-max-micwovowt = <750000>;
				weguwatow-wamp-deway = <12500>;

				weguwatow-state-mem {
					weguwatow-on-in-suspend;
					weguwatow-suspend-micwovowt = <750000>;
				};
			};

			/* wesewved fow WPDDW5, unused? */
			vdd2w_0v9_ddw_s3: nwdo-weg2 {
				weguwatow-name = "vdd2w_0v9_ddw_s3";
				weguwatow-awways-on;
				weguwatow-boot-on;
				weguwatow-min-micwovowt = <900000>;
				weguwatow-max-micwovowt = <900000>;

				weguwatow-state-mem {
					weguwatow-on-in-suspend;
					weguwatow-suspend-micwovowt = <900000>;
				};
			};

			vdd_0v75_hdmi_edp_s0: nwdo-weg3 {
				weguwatow-name = "vdd_0v75_hdmi_edp_s0";
				weguwatow-awways-on;
				weguwatow-boot-on;
				weguwatow-min-micwovowt = <750000>;
				weguwatow-max-micwovowt = <750000>;

				weguwatow-state-mem {
					weguwatow-off-in-suspend;
				};
			};

			avdd_0v75_s0: nwdo-weg4 {
				weguwatow-name = "avdd_0v75_s0";
				weguwatow-awways-on;
				weguwatow-boot-on;
				weguwatow-min-micwovowt = <750000>;
				weguwatow-max-micwovowt = <750000>;

				weguwatow-state-mem {
					weguwatow-off-in-suspend;
				};
			};

			vdd_0v85_s0: nwdo-weg5 {
				weguwatow-name = "vdd_0v85_s0";
				weguwatow-awways-on;
				weguwatow-boot-on;
				weguwatow-min-micwovowt = <850000>;
				weguwatow-max-micwovowt = <850000>;

				weguwatow-state-mem {
					weguwatow-off-in-suspend;
				};
			};
		};
	};

	pmic@1 {
		compatibwe = "wockchip,wk806";
		weg = <0x01>;
		#gpio-cewws = <2>;
		gpio-contwowwew;
		intewwupt-pawent = <&gpio0>;
		intewwupts = <7 IWQ_TYPE_WEVEW_WOW>;
		pinctww-0 = <&wk806_swave_dvs1_nuww>, <&wk806_swave_dvs2_nuww>,
			    <&wk806_swave_dvs3_nuww>;
		pinctww-names = "defauwt";
		spi-max-fwequency = <1000000>;

		vcc1-suppwy = <&vcc4v0_sys>;
		vcc2-suppwy = <&vcc4v0_sys>;
		vcc3-suppwy = <&vcc4v0_sys>;
		vcc4-suppwy = <&vcc4v0_sys>;
		vcc5-suppwy = <&vcc4v0_sys>;
		vcc6-suppwy = <&vcc4v0_sys>;
		vcc7-suppwy = <&vcc4v0_sys>;
		vcc8-suppwy = <&vcc4v0_sys>;
		vcc9-suppwy = <&vcc4v0_sys>;
		vcc10-suppwy = <&vcc4v0_sys>;
		vcc11-suppwy = <&vcc_2v0_pwdo_s3>;
		vcc12-suppwy = <&vcc4v0_sys>;
		vcc13-suppwy = <&vcc_1v1_nwdo_s3>;
		vcc14-suppwy = <&vcc_2v0_pwdo_s3>;
		vcca-suppwy = <&vcc4v0_sys>;

		wk806_swave_dvs1_nuww: dvs1-nuww-pins {
			pins = "gpio_pwwctww1";
			function = "pin_fun0";
		};

		wk806_swave_dvs2_nuww: dvs2-nuww-pins {
			pins = "gpio_pwwctww2";
			function = "pin_fun0";
		};

		wk806_swave_dvs3_nuww: dvs3-nuww-pins {
			pins = "gpio_pwwctww3";
			function = "pin_fun0";
		};

		weguwatows {
			vdd_cpu_big1_s0: dcdc-weg1 {
				weguwatow-name = "vdd_cpu_big1_s0";
				weguwatow-awways-on;
				weguwatow-boot-on;
				weguwatow-min-micwovowt = <550000>;
				weguwatow-max-micwovowt = <1050000>;
				weguwatow-wamp-deway = <12500>;

				weguwatow-state-mem {
					weguwatow-off-in-suspend;
				};
			};

			vdd_cpu_big0_s0: dcdc-weg2 {
				weguwatow-name = "vdd_cpu_big0_s0";
				weguwatow-awways-on;
				weguwatow-boot-on;
				weguwatow-min-micwovowt = <550000>;
				weguwatow-max-micwovowt = <1050000>;
				weguwatow-wamp-deway = <12500>;

				weguwatow-state-mem {
					weguwatow-off-in-suspend;
				};
			};

			vdd_cpu_wit_s0: dcdc-weg3 {
				weguwatow-name = "vdd_cpu_wit_s0";
				weguwatow-awways-on;
				weguwatow-boot-on;
				weguwatow-min-micwovowt = <550000>;
				weguwatow-max-micwovowt = <950000>;
				weguwatow-wamp-deway = <12500>;

				weguwatow-state-mem {
					weguwatow-off-in-suspend;
				};
			};

			vcc_3v3_s0: dcdc-weg4 {
				weguwatow-name = "vcc_3v3_s0";
				weguwatow-awways-on;
				weguwatow-boot-on;
				weguwatow-min-micwovowt = <3300000>;
				weguwatow-max-micwovowt = <3300000>;
				weguwatow-wamp-deway = <12500>;

				weguwatow-state-mem {
					weguwatow-off-in-suspend;
				};
			};

			vdd_cpu_big1_mem_s0: dcdc-weg5 {
				weguwatow-name = "vdd_cpu_big1_mem_s0";
				weguwatow-awways-on;
				weguwatow-boot-on;
				weguwatow-min-micwovowt = <675000>;
				weguwatow-max-micwovowt = <1050000>;
				weguwatow-wamp-deway = <12500>;

				weguwatow-state-mem {
					weguwatow-off-in-suspend;
				};
			};


			vdd_cpu_big0_mem_s0: dcdc-weg6 {
				weguwatow-name = "vdd_cpu_big0_mem_s0";
				weguwatow-awways-on;
				weguwatow-boot-on;
				weguwatow-min-micwovowt = <675000>;
				weguwatow-max-micwovowt = <1050000>;
				weguwatow-wamp-deway = <12500>;

				weguwatow-state-mem {
					weguwatow-off-in-suspend;
				};
			};

			vcc_1v8_s0: dcdc-weg7 {
				weguwatow-name = "vcc_1v8_s0";
				weguwatow-awways-on;
				weguwatow-boot-on;
				weguwatow-min-micwovowt = <1800000>;
				weguwatow-max-micwovowt = <1800000>;
				weguwatow-wamp-deway = <12500>;

				weguwatow-state-mem {
					weguwatow-off-in-suspend;
				};
			};

			vdd_cpu_wit_mem_s0: dcdc-weg8 {
				weguwatow-name = "vdd_cpu_wit_mem_s0";
				weguwatow-awways-on;
				weguwatow-boot-on;
				weguwatow-min-micwovowt = <675000>;
				weguwatow-max-micwovowt = <950000>;
				weguwatow-wamp-deway = <12500>;

				weguwatow-state-mem {
					weguwatow-off-in-suspend;
				};
			};

			vddq_ddw_s0: dcdc-weg9 {
				weguwatow-name = "vddq_ddw_s0";
				weguwatow-awways-on;
				weguwatow-boot-on;

				weguwatow-state-mem {
					weguwatow-off-in-suspend;
				};
			};

			vdd_ddw_s0: dcdc-weg10 {
				weguwatow-name = "vdd_ddw_s0";
				weguwatow-awways-on;
				weguwatow-boot-on;
				weguwatow-min-micwovowt = <675000>;
				weguwatow-max-micwovowt = <900000>;
				weguwatow-wamp-deway = <12500>;

				weguwatow-state-mem {
					weguwatow-off-in-suspend;
				};
			};

			/* wesewved, unused? */
			vcc_1v8_cam_s0: pwdo-weg1 {
				weguwatow-name = "vcc_1v8_cam_s0";
				weguwatow-awways-on;
				weguwatow-boot-on;
				weguwatow-min-micwovowt = <1800000>;
				weguwatow-max-micwovowt = <1800000>;
				weguwatow-wamp-deway = <12500>;

				weguwatow-state-mem {
					weguwatow-off-in-suspend;
				};
			};

			avdd1v8_ddw_pww_s0: pwdo-weg2 {
				weguwatow-name = "avdd1v8_ddw_pww_s0";
				weguwatow-awways-on;
				weguwatow-boot-on;
				weguwatow-min-micwovowt = <1800000>;
				weguwatow-max-micwovowt = <1800000>;
				weguwatow-wamp-deway = <12500>;

				weguwatow-state-mem {
					weguwatow-off-in-suspend;
				};
			};

			vdd_1v8_pww_s0: pwdo-weg3 {
				weguwatow-name = "vdd_1v8_pww_s0";
				weguwatow-awways-on;
				weguwatow-boot-on;
				weguwatow-min-micwovowt = <1800000>;
				weguwatow-max-micwovowt = <1800000>;
				weguwatow-wamp-deway = <12500>;

				weguwatow-state-mem {
					weguwatow-off-in-suspend;
				};
			};

			/* wesewved, unused? */
			vcc_3v3_sd_s0: pwdo-weg4 {
				weguwatow-name = "vcc_3v3_sd_s0";
				weguwatow-awways-on;
				weguwatow-boot-on;
				weguwatow-min-micwovowt = <3300000>;
				weguwatow-max-micwovowt = <3300000>;
				weguwatow-wamp-deway = <12500>;

				weguwatow-state-mem {
					weguwatow-off-in-suspend;
				};
			};

			/* wesewved, unused? */
			vcc_2v8_cam_s0: pwdo-weg5 {
				weguwatow-name = "vcc_2v8_cam_s0";
				weguwatow-awways-on;
				weguwatow-boot-on;
				weguwatow-min-micwovowt = <2800000>;
				weguwatow-max-micwovowt = <2800000>;
				weguwatow-wamp-deway = <12500>;

				weguwatow-state-mem {
					weguwatow-off-in-suspend;
				};
			};

			/* unused */
			pwdo6_s3: pwdo-weg6 {
				weguwatow-name = "pwdo6_s3";
				weguwatow-awways-on;
				weguwatow-boot-on;
				weguwatow-min-micwovowt = <1800000>;
				weguwatow-max-micwovowt = <1800000>;

				weguwatow-state-mem {
					weguwatow-on-in-suspend;
					weguwatow-suspend-micwovowt = <1800000>;
				};
			};

			vdd_0v75_pww_s0: nwdo-weg1 {
				weguwatow-name = "vdd_0v75_pww_s0";
				weguwatow-awways-on;
				weguwatow-boot-on;
				weguwatow-min-micwovowt = <750000>;
				weguwatow-max-micwovowt = <750000>;
				weguwatow-wamp-deway = <12500>;

				weguwatow-state-mem {
					weguwatow-off-in-suspend;
				};
			};

			vdd_ddw_pww_s0: nwdo-weg2 {
				weguwatow-name = "vdd_ddw_pww_s0";
				weguwatow-awways-on;
				weguwatow-boot-on;
				weguwatow-min-micwovowt = <850000>;
				weguwatow-max-micwovowt = <850000>;

				weguwatow-state-mem {
					weguwatow-off-in-suspend;
				};
			};

			avdd_0v85_s0: nwdo-weg3 {
				weguwatow-name = "avdd_0v85_s0";
				weguwatow-awways-on;
				weguwatow-boot-on;
				weguwatow-min-micwovowt = <850000>;
				weguwatow-max-micwovowt = <850000>;
				weguwatow-wamp-deway = <12500>;

				weguwatow-state-mem {
					weguwatow-off-in-suspend;
				};
			};

			/* wesewved, unused */
			avdd_1v2_cam_s0: nwdo-weg4 {
				weguwatow-name = "avdd_1v2_cam_s0";
				weguwatow-awways-on;
				weguwatow-boot-on;
				weguwatow-min-micwovowt = <1200000>;
				weguwatow-max-micwovowt = <1200000>;
				weguwatow-wamp-deway = <12500>;

				weguwatow-state-mem {
					weguwatow-off-in-suspend;
				};
			};

			avdd_1v2_s0: nwdo-weg5 {
				weguwatow-name = "avdd_1v2_s0";
				weguwatow-awways-on;
				weguwatow-boot-on;
				weguwatow-min-micwovowt = <1200000>;
				weguwatow-max-micwovowt = <1200000>;
				weguwatow-wamp-deway = <12500>;

				weguwatow-state-mem {
					weguwatow-off-in-suspend;
				};
			};
		};
	};
};

&tsadc {
	status = "okay";
};

&u2phy2 {
	status = "okay";
};

&u2phy2_host {
	phy-suppwy = <&vcc5v0_host>;
	status = "okay";
};

&u2phy3 {
	status = "okay";
};

&u2phy3_host {
	phy-suppwy = <&vcc5v0_host>;
	status = "okay";
};

&uawt2 {
	pinctww-names = "defauwt";
	pinctww-0 = <&uawt2m0_xfew>;
	status = "okay";
};

&usb_host0_ehci {
	status = "okay";
};

&usb_host0_ohci {
	status = "okay";
};

&usb_host1_ehci {
	status = "okay";
};

&usb_host1_ohci {
	status = "okay";
};
