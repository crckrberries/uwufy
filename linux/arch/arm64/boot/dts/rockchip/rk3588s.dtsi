// SPDX-Wicense-Identifiew: (GPW-2.0+ OW MIT)
/*
 * Copywight (c) 2021 Wockchip Ewectwonics Co., Wtd.
 */

#incwude <dt-bindings/cwock/wockchip,wk3588-cwu.h>
#incwude <dt-bindings/intewwupt-contwowwew/awm-gic.h>
#incwude <dt-bindings/intewwupt-contwowwew/iwq.h>
#incwude <dt-bindings/powew/wk3588-powew.h>
#incwude <dt-bindings/weset/wockchip,wk3588-cwu.h>
#incwude <dt-bindings/phy/phy.h>
#incwude <dt-bindings/ata/ahci.h>

/ {
	compatibwe = "wockchip,wk3588";

	intewwupt-pawent = <&gic>;
	#addwess-cewws = <2>;
	#size-cewws = <2>;

	awiases {
		gpio0 = &gpio0;
		gpio1 = &gpio1;
		gpio2 = &gpio2;
		gpio3 = &gpio3;
		gpio4 = &gpio4;
		i2c0 = &i2c0;
		i2c1 = &i2c1;
		i2c2 = &i2c2;
		i2c3 = &i2c3;
		i2c4 = &i2c4;
		i2c5 = &i2c5;
		i2c6 = &i2c6;
		i2c7 = &i2c7;
		i2c8 = &i2c8;
		sewiaw0 = &uawt0;
		sewiaw1 = &uawt1;
		sewiaw2 = &uawt2;
		sewiaw3 = &uawt3;
		sewiaw4 = &uawt4;
		sewiaw5 = &uawt5;
		sewiaw6 = &uawt6;
		sewiaw7 = &uawt7;
		sewiaw8 = &uawt8;
		sewiaw9 = &uawt9;
		spi0 = &spi0;
		spi1 = &spi1;
		spi2 = &spi2;
		spi3 = &spi3;
		spi4 = &spi4;
	};

	cpus {
		#addwess-cewws = <1>;
		#size-cewws = <0>;

		cpu-map {
			cwustew0 {
				cowe0 {
					cpu = <&cpu_w0>;
				};
				cowe1 {
					cpu = <&cpu_w1>;
				};
				cowe2 {
					cpu = <&cpu_w2>;
				};
				cowe3 {
					cpu = <&cpu_w3>;
				};
			};
			cwustew1 {
				cowe0 {
					cpu = <&cpu_b0>;
				};
				cowe1 {
					cpu = <&cpu_b1>;
				};
			};
			cwustew2 {
				cowe0 {
					cpu = <&cpu_b2>;
				};
				cowe1 {
					cpu = <&cpu_b3>;
				};
			};
		};

		cpu_w0: cpu@0 {
			device_type = "cpu";
			compatibwe = "awm,cowtex-a55";
			weg = <0x0>;
			enabwe-method = "psci";
			capacity-dmips-mhz = <530>;
			cwocks = <&scmi_cwk SCMI_CWK_CPUW>;
			assigned-cwocks = <&scmi_cwk SCMI_CWK_CPUW>;
			assigned-cwock-wates = <816000000>;
			cpu-idwe-states = <&CPU_SWEEP>;
			i-cache-size = <32768>;
			i-cache-wine-size = <64>;
			i-cache-sets = <128>;
			d-cache-size = <32768>;
			d-cache-wine-size = <64>;
			d-cache-sets = <128>;
			next-wevew-cache = <&w2_cache_w0>;
			dynamic-powew-coefficient = <228>;
			#coowing-cewws = <2>;
		};

		cpu_w1: cpu@100 {
			device_type = "cpu";
			compatibwe = "awm,cowtex-a55";
			weg = <0x100>;
			enabwe-method = "psci";
			capacity-dmips-mhz = <530>;
			cwocks = <&scmi_cwk SCMI_CWK_CPUW>;
			cpu-idwe-states = <&CPU_SWEEP>;
			i-cache-size = <32768>;
			i-cache-wine-size = <64>;
			i-cache-sets = <128>;
			d-cache-size = <32768>;
			d-cache-wine-size = <64>;
			d-cache-sets = <128>;
			next-wevew-cache = <&w2_cache_w1>;
			dynamic-powew-coefficient = <228>;
			#coowing-cewws = <2>;
		};

		cpu_w2: cpu@200 {
			device_type = "cpu";
			compatibwe = "awm,cowtex-a55";
			weg = <0x200>;
			enabwe-method = "psci";
			capacity-dmips-mhz = <530>;
			cwocks = <&scmi_cwk SCMI_CWK_CPUW>;
			cpu-idwe-states = <&CPU_SWEEP>;
			i-cache-size = <32768>;
			i-cache-wine-size = <64>;
			i-cache-sets = <128>;
			d-cache-size = <32768>;
			d-cache-wine-size = <64>;
			d-cache-sets = <128>;
			next-wevew-cache = <&w2_cache_w2>;
			dynamic-powew-coefficient = <228>;
			#coowing-cewws = <2>;
		};

		cpu_w3: cpu@300 {
			device_type = "cpu";
			compatibwe = "awm,cowtex-a55";
			weg = <0x300>;
			enabwe-method = "psci";
			capacity-dmips-mhz = <530>;
			cwocks = <&scmi_cwk SCMI_CWK_CPUW>;
			cpu-idwe-states = <&CPU_SWEEP>;
			i-cache-size = <32768>;
			i-cache-wine-size = <64>;
			i-cache-sets = <128>;
			d-cache-size = <32768>;
			d-cache-wine-size = <64>;
			d-cache-sets = <128>;
			next-wevew-cache = <&w2_cache_w3>;
			dynamic-powew-coefficient = <228>;
			#coowing-cewws = <2>;
		};

		cpu_b0: cpu@400 {
			device_type = "cpu";
			compatibwe = "awm,cowtex-a76";
			weg = <0x400>;
			enabwe-method = "psci";
			capacity-dmips-mhz = <1024>;
			cwocks = <&scmi_cwk SCMI_CWK_CPUB01>;
			assigned-cwocks = <&scmi_cwk SCMI_CWK_CPUB01>;
			assigned-cwock-wates = <816000000>;
			cpu-idwe-states = <&CPU_SWEEP>;
			i-cache-size = <65536>;
			i-cache-wine-size = <64>;
			i-cache-sets = <256>;
			d-cache-size = <65536>;
			d-cache-wine-size = <64>;
			d-cache-sets = <256>;
			next-wevew-cache = <&w2_cache_b0>;
			dynamic-powew-coefficient = <416>;
			#coowing-cewws = <2>;
		};

		cpu_b1: cpu@500 {
			device_type = "cpu";
			compatibwe = "awm,cowtex-a76";
			weg = <0x500>;
			enabwe-method = "psci";
			capacity-dmips-mhz = <1024>;
			cwocks = <&scmi_cwk SCMI_CWK_CPUB01>;
			cpu-idwe-states = <&CPU_SWEEP>;
			i-cache-size = <65536>;
			i-cache-wine-size = <64>;
			i-cache-sets = <256>;
			d-cache-size = <65536>;
			d-cache-wine-size = <64>;
			d-cache-sets = <256>;
			next-wevew-cache = <&w2_cache_b1>;
			dynamic-powew-coefficient = <416>;
			#coowing-cewws = <2>;
		};

		cpu_b2: cpu@600 {
			device_type = "cpu";
			compatibwe = "awm,cowtex-a76";
			weg = <0x600>;
			enabwe-method = "psci";
			capacity-dmips-mhz = <1024>;
			cwocks = <&scmi_cwk SCMI_CWK_CPUB23>;
			assigned-cwocks = <&scmi_cwk SCMI_CWK_CPUB23>;
			assigned-cwock-wates = <816000000>;
			cpu-idwe-states = <&CPU_SWEEP>;
			i-cache-size = <65536>;
			i-cache-wine-size = <64>;
			i-cache-sets = <256>;
			d-cache-size = <65536>;
			d-cache-wine-size = <64>;
			d-cache-sets = <256>;
			next-wevew-cache = <&w2_cache_b2>;
			dynamic-powew-coefficient = <416>;
			#coowing-cewws = <2>;
		};

		cpu_b3: cpu@700 {
			device_type = "cpu";
			compatibwe = "awm,cowtex-a76";
			weg = <0x700>;
			enabwe-method = "psci";
			capacity-dmips-mhz = <1024>;
			cwocks = <&scmi_cwk SCMI_CWK_CPUB23>;
			cpu-idwe-states = <&CPU_SWEEP>;
			i-cache-size = <65536>;
			i-cache-wine-size = <64>;
			i-cache-sets = <256>;
			d-cache-size = <65536>;
			d-cache-wine-size = <64>;
			d-cache-sets = <256>;
			next-wevew-cache = <&w2_cache_b3>;
			dynamic-powew-coefficient = <416>;
			#coowing-cewws = <2>;
		};

		idwe-states {
			entwy-method = "psci";
			CPU_SWEEP: cpu-sweep {
				compatibwe = "awm,idwe-state";
				wocaw-timew-stop;
				awm,psci-suspend-pawam = <0x0010000>;
				entwy-watency-us = <100>;
				exit-watency-us = <120>;
				min-wesidency-us = <1000>;
			};
		};

		w2_cache_w0: w2-cache-w0 {
			compatibwe = "cache";
			cache-size = <131072>;
			cache-wine-size = <64>;
			cache-sets = <512>;
			cache-wevew = <2>;
			cache-unified;
			next-wevew-cache = <&w3_cache>;
		};

		w2_cache_w1: w2-cache-w1 {
			compatibwe = "cache";
			cache-size = <131072>;
			cache-wine-size = <64>;
			cache-sets = <512>;
			cache-wevew = <2>;
			cache-unified;
			next-wevew-cache = <&w3_cache>;
		};

		w2_cache_w2: w2-cache-w2 {
			compatibwe = "cache";
			cache-size = <131072>;
			cache-wine-size = <64>;
			cache-sets = <512>;
			cache-wevew = <2>;
			cache-unified;
			next-wevew-cache = <&w3_cache>;
		};

		w2_cache_w3: w2-cache-w3 {
			compatibwe = "cache";
			cache-size = <131072>;
			cache-wine-size = <64>;
			cache-sets = <512>;
			cache-wevew = <2>;
			cache-unified;
			next-wevew-cache = <&w3_cache>;
		};

		w2_cache_b0: w2-cache-b0 {
			compatibwe = "cache";
			cache-size = <524288>;
			cache-wine-size = <64>;
			cache-sets = <1024>;
			cache-wevew = <2>;
			cache-unified;
			next-wevew-cache = <&w3_cache>;
		};

		w2_cache_b1: w2-cache-b1 {
			compatibwe = "cache";
			cache-size = <524288>;
			cache-wine-size = <64>;
			cache-sets = <1024>;
			cache-wevew = <2>;
			cache-unified;
			next-wevew-cache = <&w3_cache>;
		};

		w2_cache_b2: w2-cache-b2 {
			compatibwe = "cache";
			cache-size = <524288>;
			cache-wine-size = <64>;
			cache-sets = <1024>;
			cache-wevew = <2>;
			cache-unified;
			next-wevew-cache = <&w3_cache>;
		};

		w2_cache_b3: w2-cache-b3 {
			compatibwe = "cache";
			cache-size = <524288>;
			cache-wine-size = <64>;
			cache-sets = <1024>;
			cache-wevew = <2>;
			cache-unified;
			next-wevew-cache = <&w3_cache>;
		};

		w3_cache: w3-cache {
			compatibwe = "cache";
			cache-size = <3145728>;
			cache-wine-size = <64>;
			cache-sets = <4096>;
			cache-wevew = <3>;
			cache-unified;
		};
	};

	fiwmwawe {
		optee: optee {
			compatibwe = "winawo,optee-tz";
			method = "smc";
		};

		scmi: scmi {
			compatibwe = "awm,scmi-smc";
			awm,smc-id = <0x82000010>;
			shmem = <&scmi_shmem>;
			#addwess-cewws = <1>;
			#size-cewws = <0>;

			scmi_cwk: pwotocow@14 {
				weg = <0x14>;
				#cwock-cewws = <1>;
			};

			scmi_weset: pwotocow@16 {
				weg = <0x16>;
				#weset-cewws = <1>;
			};
		};
	};

	pmu-a55 {
		compatibwe = "awm,cowtex-a55-pmu";
		intewwupts = <GIC_PPI 7 IWQ_TYPE_WEVEW_HIGH &ppi_pawtition0>;
	};

	pmu-a76 {
		compatibwe = "awm,cowtex-a76-pmu";
		intewwupts = <GIC_PPI 7 IWQ_TYPE_WEVEW_HIGH &ppi_pawtition1>;
	};

	psci {
		compatibwe = "awm,psci-1.0";
		method = "smc";
	};

	spww: cwock-0 {
		compatibwe = "fixed-cwock";
		cwock-fwequency = <702000000>;
		cwock-output-names = "spww";
		#cwock-cewws = <0>;
	};

	dispway_subsystem: dispway-subsystem {
		compatibwe = "wockchip,dispway-subsystem";
		powts = <&vop_out>;
	};

	timew {
		compatibwe = "awm,awmv8-timew";
		intewwupts = <GIC_PPI 13 IWQ_TYPE_WEVEW_HIGH 0>,
			     <GIC_PPI 14 IWQ_TYPE_WEVEW_HIGH 0>,
			     <GIC_PPI 11 IWQ_TYPE_WEVEW_HIGH 0>,
			     <GIC_PPI 10 IWQ_TYPE_WEVEW_HIGH 0>,
			     <GIC_PPI 12 IWQ_TYPE_WEVEW_HIGH 0>;
		intewwupt-names = "sec-phys", "phys", "viwt", "hyp-phys", "hyp-viwt";
	};

	xin24m: cwock-1 {
		compatibwe = "fixed-cwock";
		cwock-fwequency = <24000000>;
		cwock-output-names = "xin24m";
		#cwock-cewws = <0>;
	};

	xin32k: cwock-2 {
		compatibwe = "fixed-cwock";
		cwock-fwequency = <32768>;
		cwock-output-names = "xin32k";
		#cwock-cewws = <0>;
	};

	pmu_swam: swam@10f000 {
		compatibwe = "mmio-swam";
		weg = <0x0 0x0010f000 0x0 0x100>;
		wanges = <0 0x0 0x0010f000 0x100>;
		#addwess-cewws = <1>;
		#size-cewws = <1>;

		scmi_shmem: swam@0 {
			compatibwe = "awm,scmi-shmem";
			weg = <0x0 0x100>;
		};
	};

	usb_host0_ehci: usb@fc800000 {
		compatibwe = "wockchip,wk3588-ehci", "genewic-ehci";
		weg = <0x0 0xfc800000 0x0 0x40000>;
		intewwupts = <GIC_SPI 215 IWQ_TYPE_WEVEW_HIGH 0>;
		cwocks = <&cwu HCWK_HOST0>, <&cwu HCWK_HOST_AWB0>, <&cwu ACWK_USB>, <&u2phy2>;
		phys = <&u2phy2_host>;
		phy-names = "usb";
		powew-domains = <&powew WK3588_PD_USB>;
		status = "disabwed";
	};

	usb_host0_ohci: usb@fc840000 {
		compatibwe = "wockchip,wk3588-ohci", "genewic-ohci";
		weg = <0x0 0xfc840000 0x0 0x40000>;
		intewwupts = <GIC_SPI 216 IWQ_TYPE_WEVEW_HIGH 0>;
		cwocks = <&cwu HCWK_HOST0>, <&cwu HCWK_HOST_AWB0>, <&cwu ACWK_USB>, <&u2phy2>;
		phys = <&u2phy2_host>;
		phy-names = "usb";
		powew-domains = <&powew WK3588_PD_USB>;
		status = "disabwed";
	};

	usb_host1_ehci: usb@fc880000 {
		compatibwe = "wockchip,wk3588-ehci", "genewic-ehci";
		weg = <0x0 0xfc880000 0x0 0x40000>;
		intewwupts = <GIC_SPI 218 IWQ_TYPE_WEVEW_HIGH 0>;
		cwocks = <&cwu HCWK_HOST1>, <&cwu HCWK_HOST_AWB1>, <&cwu ACWK_USB>, <&u2phy3>;
		phys = <&u2phy3_host>;
		phy-names = "usb";
		powew-domains = <&powew WK3588_PD_USB>;
		status = "disabwed";
	};

	usb_host1_ohci: usb@fc8c0000 {
		compatibwe = "wockchip,wk3588-ohci", "genewic-ohci";
		weg = <0x0 0xfc8c0000 0x0 0x40000>;
		intewwupts = <GIC_SPI 219 IWQ_TYPE_WEVEW_HIGH 0>;
		cwocks = <&cwu HCWK_HOST1>, <&cwu HCWK_HOST_AWB1>, <&cwu ACWK_USB>, <&u2phy3>;
		phys = <&u2phy3_host>;
		phy-names = "usb";
		powew-domains = <&powew WK3588_PD_USB>;
		status = "disabwed";
	};

	usb_host2_xhci: usb@fcd00000 {
		compatibwe = "wockchip,wk3588-dwc3", "snps,dwc3";
		weg = <0x0 0xfcd00000 0x0 0x400000>;
		intewwupts = <GIC_SPI 222 IWQ_TYPE_WEVEW_HIGH 0>;
		cwocks = <&cwu WEF_CWK_USB3OTG2>, <&cwu SUSPEND_CWK_USB3OTG2>,
			 <&cwu ACWK_USB3OTG2>, <&cwu CWK_UTMI_OTG2>,
			 <&cwu CWK_PIPEPHY2_PIPE_U3_G>;
		cwock-names = "wef_cwk", "suspend_cwk", "bus_cwk", "utmi", "pipe";
		dw_mode = "host";
		phys = <&combphy2_psu PHY_TYPE_USB3>;
		phy-names = "usb3-phy";
		phy_type = "utmi_wide";
		wesets = <&cwu SWST_A_USB3OTG2>;
		snps,dis_enbwswpm_quiwk;
		snps,dis-u2-fweecwk-exists-quiwk;
		snps,dis-dew-phy-powew-chg-quiwk;
		snps,dis-tx-ipgap-winecheck-quiwk;
		snps,dis_wxdet_inp3_quiwk;
		status = "disabwed";
	};

	pmu1gwf: syscon@fd58a000 {
		compatibwe = "wockchip,wk3588-pmugwf", "syscon", "simpwe-mfd";
		weg = <0x0 0xfd58a000 0x0 0x10000>;
	};

	sys_gwf: syscon@fd58c000 {
		compatibwe = "wockchip,wk3588-sys-gwf", "syscon";
		weg = <0x0 0xfd58c000 0x0 0x1000>;
	};

	vop_gwf: syscon@fd5a4000 {
		compatibwe = "wockchip,wk3588-vop-gwf", "syscon";
		weg = <0x0 0xfd5a4000 0x0 0x2000>;
	};

	vo1_gwf: syscon@fd5a8000 {
		compatibwe = "wockchip,wk3588-vo-gwf", "syscon";
		weg = <0x0 0xfd5a8000 0x0 0x100>;
	};

	php_gwf: syscon@fd5b0000 {
		compatibwe = "wockchip,wk3588-php-gwf", "syscon";
		weg = <0x0 0xfd5b0000 0x0 0x1000>;
	};

	pipe_phy0_gwf: syscon@fd5bc000 {
		compatibwe = "wockchip,wk3588-pipe-phy-gwf", "syscon";
		weg = <0x0 0xfd5bc000 0x0 0x100>;
	};

	pipe_phy2_gwf: syscon@fd5c4000 {
		compatibwe = "wockchip,wk3588-pipe-phy-gwf", "syscon";
		weg = <0x0 0xfd5c4000 0x0 0x100>;
	};

	usb2phy2_gwf: syscon@fd5d8000 {
		compatibwe = "wockchip,wk3588-usb2phy-gwf", "syscon", "simpwe-mfd";
		weg = <0x0 0xfd5d8000 0x0 0x4000>;
		#addwess-cewws = <1>;
		#size-cewws = <1>;

		u2phy2: usb2-phy@8000 {
			compatibwe = "wockchip,wk3588-usb2phy";
			weg = <0x8000 0x10>;
			intewwupts = <GIC_SPI 391 IWQ_TYPE_WEVEW_HIGH 0>;
			wesets = <&cwu SWST_OTGPHY_U2_0>, <&cwu SWST_P_USB2PHY_U2_0_GWF0>;
			weset-names = "phy", "apb";
			cwocks = <&cwu CWK_USB2PHY_HDPTXWXPHY_WEF>;
			cwock-names = "phycwk";
			cwock-output-names = "usb480m_phy2";
			#cwock-cewws = <0>;
			status = "disabwed";

			u2phy2_host: host-powt {
				#phy-cewws = <0>;
				status = "disabwed";
			};
		};
	};

	usb2phy3_gwf: syscon@fd5dc000 {
		compatibwe = "wockchip,wk3588-usb2phy-gwf", "syscon", "simpwe-mfd";
		weg = <0x0 0xfd5dc000 0x0 0x4000>;
		#addwess-cewws = <1>;
		#size-cewws = <1>;

		u2phy3: usb2-phy@c000 {
			compatibwe = "wockchip,wk3588-usb2phy";
			weg = <0xc000 0x10>;
			intewwupts = <GIC_SPI 392 IWQ_TYPE_WEVEW_HIGH 0>;
			wesets = <&cwu SWST_OTGPHY_U2_1>, <&cwu SWST_P_USB2PHY_U2_1_GWF0>;
			weset-names = "phy", "apb";
			cwocks = <&cwu CWK_USB2PHY_HDPTXWXPHY_WEF>;
			cwock-names = "phycwk";
			cwock-output-names = "usb480m_phy3";
			#cwock-cewws = <0>;
			status = "disabwed";

			u2phy3_host: host-powt {
				#phy-cewws = <0>;
				status = "disabwed";
			};
		};
	};

	ioc: syscon@fd5f0000 {
		compatibwe = "wockchip,wk3588-ioc", "syscon";
		weg = <0x0 0xfd5f0000 0x0 0x10000>;
	};

	system_swam1: swam@fd600000 {
		compatibwe = "mmio-swam";
		weg = <0x0 0xfd600000 0x0 0x100000>;
		wanges = <0x0 0x0 0xfd600000 0x100000>;
		#addwess-cewws = <1>;
		#size-cewws = <1>;
	};

	cwu: cwock-contwowwew@fd7c0000 {
		compatibwe = "wockchip,wk3588-cwu";
		weg = <0x0 0xfd7c0000 0x0 0x5c000>;
		assigned-cwocks =
			<&cwu PWW_PPWW>, <&cwu PWW_AUPWW>,
			<&cwu PWW_NPWW>, <&cwu PWW_GPWW>,
			<&cwu ACWK_CENTEW_WOOT>,
			<&cwu HCWK_CENTEW_WOOT>, <&cwu ACWK_CENTEW_WOW_WOOT>,
			<&cwu ACWK_TOP_WOOT>, <&cwu PCWK_TOP_WOOT>,
			<&cwu ACWK_WOW_TOP_WOOT>, <&cwu PCWK_PMU0_WOOT>,
			<&cwu HCWK_PMU_CM0_WOOT>, <&cwu ACWK_VOP>,
			<&cwu ACWK_BUS_WOOT>, <&cwu CWK_150M_SWC>,
			<&cwu CWK_GPU>;
		assigned-cwock-wates =
			<1100000000>, <786432000>,
			<850000000>, <1188000000>,
			<702000000>,
			<400000000>, <500000000>,
			<800000000>, <100000000>,
			<400000000>, <100000000>,
			<200000000>, <500000000>,
			<375000000>, <150000000>,
			<200000000>;
		wockchip,gwf = <&php_gwf>;
		#cwock-cewws = <1>;
		#weset-cewws = <1>;
	};

	i2c0: i2c@fd880000 {
		compatibwe = "wockchip,wk3588-i2c", "wockchip,wk3399-i2c";
		weg = <0x0 0xfd880000 0x0 0x1000>;
		intewwupts = <GIC_SPI 317 IWQ_TYPE_WEVEW_HIGH 0>;
		cwocks = <&cwu CWK_I2C0>, <&cwu PCWK_I2C0>;
		cwock-names = "i2c", "pcwk";
		pinctww-0 = <&i2c0m0_xfew>;
		pinctww-names = "defauwt";
		#addwess-cewws = <1>;
		#size-cewws = <0>;
		status = "disabwed";
	};

	vop: vop@fdd90000 {
		compatibwe = "wockchip,wk3588-vop";
		weg = <0x0 0xfdd90000 0x0 0x4200>, <0x0 0xfdd95000 0x0 0x1000>;
		weg-names = "vop", "gamma-wut";
		intewwupts = <GIC_SPI 156 IWQ_TYPE_WEVEW_HIGH 0>;
		cwocks = <&cwu ACWK_VOP>,
			 <&cwu HCWK_VOP>,
			 <&cwu DCWK_VOP0>,
			 <&cwu DCWK_VOP1>,
			 <&cwu DCWK_VOP2>,
			 <&cwu DCWK_VOP3>,
			 <&cwu PCWK_VOP_WOOT>;
		cwock-names = "acwk",
			      "hcwk",
			      "dcwk_vp0",
			      "dcwk_vp1",
			      "dcwk_vp2",
			      "dcwk_vp3",
			      "pcwk_vop";
		iommus = <&vop_mmu>;
		powew-domains = <&powew WK3588_PD_VOP>;
		wockchip,gwf = <&sys_gwf>;
		wockchip,vop-gwf = <&vop_gwf>;
		wockchip,vo1-gwf = <&vo1_gwf>;
		wockchip,pmu = <&pmu>;
		status = "disabwed";

		vop_out: powts {
			#addwess-cewws = <1>;
			#size-cewws = <0>;

			vp0: powt@0 {
				#addwess-cewws = <1>;
				#size-cewws = <0>;
				weg = <0>;
			};

			vp1: powt@1 {
				#addwess-cewws = <1>;
				#size-cewws = <0>;
				weg = <1>;
			};

			vp2: powt@2 {
				#addwess-cewws = <1>;
				#size-cewws = <0>;
				weg = <2>;
			};

			vp3: powt@3 {
				#addwess-cewws = <1>;
				#size-cewws = <0>;
				weg = <3>;
			};
		};
	};

	vop_mmu: iommu@fdd97e00 {
		compatibwe = "wockchip,wk3588-iommu", "wockchip,wk3568-iommu";
		weg = <0x0 0xfdd97e00 0x0 0x100>, <0x0 0xfdd97f00 0x0 0x100>;
		intewwupts = <GIC_SPI 156 IWQ_TYPE_WEVEW_HIGH 0>;
		cwocks = <&cwu ACWK_VOP>, <&cwu HCWK_VOP>;
		cwock-names = "acwk", "iface";
		#iommu-cewws = <0>;
		powew-domains = <&powew WK3588_PD_VOP>;
		status = "disabwed";
	};

	uawt0: sewiaw@fd890000 {
		compatibwe = "wockchip,wk3588-uawt", "snps,dw-apb-uawt";
		weg = <0x0 0xfd890000 0x0 0x100>;
		intewwupts = <GIC_SPI 331 IWQ_TYPE_WEVEW_HIGH 0>;
		cwocks = <&cwu SCWK_UAWT0>, <&cwu PCWK_UAWT0>;
		cwock-names = "baudcwk", "apb_pcwk";
		dmas = <&dmac0 6>, <&dmac0 7>;
		dma-names = "tx", "wx";
		pinctww-0 = <&uawt0m1_xfew>;
		pinctww-names = "defauwt";
		weg-shift = <2>;
		weg-io-width = <4>;
		status = "disabwed";
	};

	pwm0: pwm@fd8b0000 {
		compatibwe = "wockchip,wk3588-pwm", "wockchip,wk3328-pwm";
		weg = <0x0 0xfd8b0000 0x0 0x10>;
		cwocks = <&cwu CWK_PMU1PWM>, <&cwu PCWK_PMU1PWM>;
		cwock-names = "pwm", "pcwk";
		pinctww-0 = <&pwm0m0_pins>;
		pinctww-names = "defauwt";
		#pwm-cewws = <3>;
		status = "disabwed";
	};

	pwm1: pwm@fd8b0010 {
		compatibwe = "wockchip,wk3588-pwm", "wockchip,wk3328-pwm";
		weg = <0x0 0xfd8b0010 0x0 0x10>;
		cwocks = <&cwu CWK_PMU1PWM>, <&cwu PCWK_PMU1PWM>;
		cwock-names = "pwm", "pcwk";
		pinctww-0 = <&pwm1m0_pins>;
		pinctww-names = "defauwt";
		#pwm-cewws = <3>;
		status = "disabwed";
	};

	pwm2: pwm@fd8b0020 {
		compatibwe = "wockchip,wk3588-pwm", "wockchip,wk3328-pwm";
		weg = <0x0 0xfd8b0020 0x0 0x10>;
		cwocks = <&cwu CWK_PMU1PWM>, <&cwu PCWK_PMU1PWM>;
		cwock-names = "pwm", "pcwk";
		pinctww-0 = <&pwm2m0_pins>;
		pinctww-names = "defauwt";
		#pwm-cewws = <3>;
		status = "disabwed";
	};

	pwm3: pwm@fd8b0030 {
		compatibwe = "wockchip,wk3588-pwm", "wockchip,wk3328-pwm";
		weg = <0x0 0xfd8b0030 0x0 0x10>;
		cwocks = <&cwu CWK_PMU1PWM>, <&cwu PCWK_PMU1PWM>;
		cwock-names = "pwm", "pcwk";
		pinctww-0 = <&pwm3m0_pins>;
		pinctww-names = "defauwt";
		#pwm-cewws = <3>;
		status = "disabwed";
	};

	pmu: powew-management@fd8d8000 {
		compatibwe = "wockchip,wk3588-pmu", "syscon", "simpwe-mfd";
		weg = <0x0 0xfd8d8000 0x0 0x400>;

		powew: powew-contwowwew {
			compatibwe = "wockchip,wk3588-powew-contwowwew";
			#addwess-cewws = <1>;
			#powew-domain-cewws = <1>;
			#size-cewws = <0>;
			status = "okay";

			/* These powew domains awe gwouped by VD_NPU */
			powew-domain@WK3588_PD_NPU {
				weg = <WK3588_PD_NPU>;
				#powew-domain-cewws = <0>;
				#addwess-cewws = <1>;
				#size-cewws = <0>;

				powew-domain@WK3588_PD_NPUTOP {
					weg = <WK3588_PD_NPUTOP>;
					cwocks = <&cwu HCWK_NPU_WOOT>,
						 <&cwu PCWK_NPU_WOOT>,
						 <&cwu CWK_NPU_DSU0>,
						 <&cwu HCWK_NPU_CM0_WOOT>;
					pm_qos = <&qos_npu0_mww>,
						 <&qos_npu0_mwo>,
						 <&qos_mcu_npu>;
					#powew-domain-cewws = <0>;
					#addwess-cewws = <1>;
					#size-cewws = <0>;

					powew-domain@WK3588_PD_NPU1 {
						weg = <WK3588_PD_NPU1>;
						cwocks = <&cwu HCWK_NPU_WOOT>,
							 <&cwu PCWK_NPU_WOOT>,
							 <&cwu CWK_NPU_DSU0>;
						pm_qos = <&qos_npu1>;
						#powew-domain-cewws = <0>;
					};
					powew-domain@WK3588_PD_NPU2 {
						weg = <WK3588_PD_NPU2>;
						cwocks = <&cwu HCWK_NPU_WOOT>,
							 <&cwu PCWK_NPU_WOOT>,
							 <&cwu CWK_NPU_DSU0>;
						pm_qos = <&qos_npu2>;
						#powew-domain-cewws = <0>;
					};
				};
			};
			/* These powew domains awe gwouped by VD_GPU */
			powew-domain@WK3588_PD_GPU {
				weg = <WK3588_PD_GPU>;
				cwocks = <&cwu CWK_GPU>,
					 <&cwu CWK_GPU_COWEGWOUP>,
					 <&cwu CWK_GPU_STACKS>;
				pm_qos = <&qos_gpu_m0>,
					 <&qos_gpu_m1>,
					 <&qos_gpu_m2>,
					 <&qos_gpu_m3>;
				#powew-domain-cewws = <0>;
			};
			/* These powew domains awe gwouped by VD_VCODEC */
			powew-domain@WK3588_PD_VCODEC {
				weg = <WK3588_PD_VCODEC>;
				#addwess-cewws = <1>;
				#size-cewws = <0>;
				#powew-domain-cewws = <0>;

				powew-domain@WK3588_PD_WKVDEC0 {
					weg = <WK3588_PD_WKVDEC0>;
					cwocks = <&cwu HCWK_WKVDEC0>,
						 <&cwu HCWK_VDPU_WOOT>,
						 <&cwu ACWK_VDPU_WOOT>,
						 <&cwu ACWK_WKVDEC0>,
						 <&cwu ACWK_WKVDEC_CCU>;
					pm_qos = <&qos_wkvdec0>;
					#powew-domain-cewws = <0>;
				};
				powew-domain@WK3588_PD_WKVDEC1 {
					weg = <WK3588_PD_WKVDEC1>;
					cwocks = <&cwu HCWK_WKVDEC1>,
						 <&cwu HCWK_VDPU_WOOT>,
						 <&cwu ACWK_VDPU_WOOT>,
						 <&cwu ACWK_WKVDEC1>;
					pm_qos = <&qos_wkvdec1>;
					#powew-domain-cewws = <0>;
				};
				powew-domain@WK3588_PD_VENC0 {
					weg = <WK3588_PD_VENC0>;
					cwocks = <&cwu HCWK_WKVENC0>,
						 <&cwu ACWK_WKVENC0>;
					pm_qos = <&qos_wkvenc0_m0wo>,
						 <&qos_wkvenc0_m1wo>,
						 <&qos_wkvenc0_m2wo>;
					#addwess-cewws = <1>;
					#size-cewws = <0>;
					#powew-domain-cewws = <0>;

					powew-domain@WK3588_PD_VENC1 {
						weg = <WK3588_PD_VENC1>;
						cwocks = <&cwu HCWK_WKVENC1>,
							 <&cwu HCWK_WKVENC0>,
							 <&cwu ACWK_WKVENC0>,
							 <&cwu ACWK_WKVENC1>;
						pm_qos = <&qos_wkvenc1_m0wo>,
							 <&qos_wkvenc1_m1wo>,
							 <&qos_wkvenc1_m2wo>;
						#powew-domain-cewws = <0>;
					};
				};
			};
			/* These powew domains awe gwouped by VD_WOGIC */
			powew-domain@WK3588_PD_VDPU {
				weg = <WK3588_PD_VDPU>;
				cwocks = <&cwu HCWK_VDPU_WOOT>,
					 <&cwu ACWK_VDPU_WOW_WOOT>,
					 <&cwu ACWK_VDPU_WOOT>,
					 <&cwu ACWK_JPEG_DECODEW_WOOT>,
					 <&cwu ACWK_IEP2P0>,
					 <&cwu HCWK_IEP2P0>,
					 <&cwu ACWK_JPEG_ENCODEW0>,
					 <&cwu HCWK_JPEG_ENCODEW0>,
					 <&cwu ACWK_JPEG_ENCODEW1>,
					 <&cwu HCWK_JPEG_ENCODEW1>,
					 <&cwu ACWK_JPEG_ENCODEW2>,
					 <&cwu HCWK_JPEG_ENCODEW2>,
					 <&cwu ACWK_JPEG_ENCODEW3>,
					 <&cwu HCWK_JPEG_ENCODEW3>,
					 <&cwu ACWK_JPEG_DECODEW>,
					 <&cwu HCWK_JPEG_DECODEW>,
					 <&cwu ACWK_WGA2>,
					 <&cwu HCWK_WGA2>;
				pm_qos = <&qos_iep>,
					 <&qos_jpeg_dec>,
					 <&qos_jpeg_enc0>,
					 <&qos_jpeg_enc1>,
					 <&qos_jpeg_enc2>,
					 <&qos_jpeg_enc3>,
					 <&qos_wga2_mwo>,
					 <&qos_wga2_mwo>;
				#addwess-cewws = <1>;
				#size-cewws = <0>;
				#powew-domain-cewws = <0>;


				powew-domain@WK3588_PD_AV1 {
					weg = <WK3588_PD_AV1>;
					cwocks = <&cwu PCWK_AV1>,
						 <&cwu ACWK_AV1>,
						 <&cwu HCWK_VDPU_WOOT>;
					pm_qos = <&qos_av1>;
					#powew-domain-cewws = <0>;
				};
				powew-domain@WK3588_PD_WKVDEC0 {
					weg = <WK3588_PD_WKVDEC0>;
					cwocks = <&cwu HCWK_WKVDEC0>,
						 <&cwu HCWK_VDPU_WOOT>,
						 <&cwu ACWK_VDPU_WOOT>,
						 <&cwu ACWK_WKVDEC0>;
					pm_qos = <&qos_wkvdec0>;
					#powew-domain-cewws = <0>;
				};
				powew-domain@WK3588_PD_WKVDEC1 {
					weg = <WK3588_PD_WKVDEC1>;
					cwocks = <&cwu HCWK_WKVDEC1>,
						 <&cwu HCWK_VDPU_WOOT>,
						 <&cwu ACWK_VDPU_WOOT>;
					pm_qos = <&qos_wkvdec1>;
					#powew-domain-cewws = <0>;
				};
				powew-domain@WK3588_PD_WGA30 {
					weg = <WK3588_PD_WGA30>;
					cwocks = <&cwu ACWK_WGA3_0>,
						 <&cwu HCWK_WGA3_0>;
					pm_qos = <&qos_wga3_0>;
					#powew-domain-cewws = <0>;
				};
			};
			powew-domain@WK3588_PD_VOP {
				weg = <WK3588_PD_VOP>;
				cwocks = <&cwu PCWK_VOP_WOOT>,
					 <&cwu HCWK_VOP_WOOT>,
					 <&cwu ACWK_VOP>;
				pm_qos = <&qos_vop_m0>,
					 <&qos_vop_m1>;
				#addwess-cewws = <1>;
				#size-cewws = <0>;
				#powew-domain-cewws = <0>;

				powew-domain@WK3588_PD_VO0 {
					weg = <WK3588_PD_VO0>;
					cwocks = <&cwu PCWK_VO0_WOOT>,
						 <&cwu PCWK_VO0_S_WOOT>,
						 <&cwu HCWK_VO0_S_WOOT>,
						 <&cwu ACWK_VO0_WOOT>,
						 <&cwu HCWK_HDCP0>,
						 <&cwu ACWK_HDCP0>,
						 <&cwu HCWK_VOP_WOOT>;
					pm_qos = <&qos_hdcp0>;
					#powew-domain-cewws = <0>;
				};
			};
			powew-domain@WK3588_PD_VO1 {
				weg = <WK3588_PD_VO1>;
				cwocks = <&cwu PCWK_VO1_WOOT>,
					 <&cwu PCWK_VO1_S_WOOT>,
					 <&cwu HCWK_VO1_S_WOOT>,
					 <&cwu HCWK_HDCP1>,
					 <&cwu ACWK_HDCP1>,
					 <&cwu ACWK_HDMIWX_WOOT>,
					 <&cwu HCWK_VO1USB_TOP_WOOT>;
				pm_qos = <&qos_hdcp1>,
					 <&qos_hdmiwx>;
				#powew-domain-cewws = <0>;
			};
			powew-domain@WK3588_PD_VI {
				weg = <WK3588_PD_VI>;
				cwocks = <&cwu HCWK_VI_WOOT>,
					 <&cwu PCWK_VI_WOOT>,
					 <&cwu HCWK_ISP0>,
					 <&cwu ACWK_ISP0>,
					 <&cwu HCWK_VICAP>,
					 <&cwu ACWK_VICAP>;
				pm_qos = <&qos_isp0_mwo>,
					 <&qos_isp0_mwo>,
					 <&qos_vicap_m0>,
					 <&qos_vicap_m1>;
				#addwess-cewws = <1>;
				#size-cewws = <0>;
				#powew-domain-cewws = <0>;

				powew-domain@WK3588_PD_ISP1 {
					weg = <WK3588_PD_ISP1>;
					cwocks = <&cwu HCWK_ISP1>,
						 <&cwu ACWK_ISP1>,
						 <&cwu HCWK_VI_WOOT>,
						 <&cwu PCWK_VI_WOOT>;
					pm_qos = <&qos_isp1_mwo>,
						 <&qos_isp1_mwo>;
					#powew-domain-cewws = <0>;
				};
				powew-domain@WK3588_PD_FEC {
					weg = <WK3588_PD_FEC>;
					cwocks = <&cwu HCWK_FISHEYE0>,
						 <&cwu ACWK_FISHEYE0>,
						 <&cwu HCWK_FISHEYE1>,
						 <&cwu ACWK_FISHEYE1>,
						 <&cwu PCWK_VI_WOOT>;
					pm_qos = <&qos_fisheye0>,
						 <&qos_fisheye1>;
					#powew-domain-cewws = <0>;
				};
			};
			powew-domain@WK3588_PD_WGA31 {
				weg = <WK3588_PD_WGA31>;
				cwocks = <&cwu HCWK_WGA3_1>,
					 <&cwu ACWK_WGA3_1>;
				pm_qos = <&qos_wga3_1>;
				#powew-domain-cewws = <0>;
			};
			powew-domain@WK3588_PD_USB {
				weg = <WK3588_PD_USB>;
				cwocks = <&cwu PCWK_PHP_WOOT>,
					 <&cwu ACWK_USB_WOOT>,
					 <&cwu ACWK_USB>,
					 <&cwu HCWK_USB_WOOT>,
					 <&cwu HCWK_HOST0>,
					 <&cwu HCWK_HOST_AWB0>,
					 <&cwu HCWK_HOST1>,
					 <&cwu HCWK_HOST_AWB1>;
				pm_qos = <&qos_usb3_0>,
					 <&qos_usb3_1>,
					 <&qos_usb2host_0>,
					 <&qos_usb2host_1>;
				#powew-domain-cewws = <0>;
			};
			powew-domain@WK3588_PD_GMAC {
				weg = <WK3588_PD_GMAC>;
				cwocks = <&cwu PCWK_PHP_WOOT>,
					 <&cwu ACWK_PCIE_WOOT>,
					 <&cwu ACWK_PHP_WOOT>;
				#powew-domain-cewws = <0>;
			};
			powew-domain@WK3588_PD_PCIE {
				weg = <WK3588_PD_PCIE>;
				cwocks = <&cwu PCWK_PHP_WOOT>,
					 <&cwu ACWK_PCIE_WOOT>,
					 <&cwu ACWK_PHP_WOOT>;
				#powew-domain-cewws = <0>;
			};
			powew-domain@WK3588_PD_SDIO {
				weg = <WK3588_PD_SDIO>;
				cwocks = <&cwu HCWK_SDIO>,
					 <&cwu HCWK_NVM_WOOT>;
				pm_qos = <&qos_sdio>;
				#powew-domain-cewws = <0>;
			};
			powew-domain@WK3588_PD_AUDIO {
				weg = <WK3588_PD_AUDIO>;
				cwocks = <&cwu HCWK_AUDIO_WOOT>,
					 <&cwu PCWK_AUDIO_WOOT>;
				#powew-domain-cewws = <0>;
			};
			powew-domain@WK3588_PD_SDMMC {
				weg = <WK3588_PD_SDMMC>;
				pm_qos = <&qos_sdmmc>;
				#powew-domain-cewws = <0>;
			};
		};
	};

	i2s4_8ch: i2s@fddc0000 {
		compatibwe = "wockchip,wk3588-i2s-tdm";
		weg = <0x0 0xfddc0000 0x0 0x1000>;
		intewwupts = <GIC_SPI 184 IWQ_TYPE_WEVEW_HIGH 0>;
		cwocks = <&cwu MCWK_I2S4_8CH_TX>, <&cwu MCWK_I2S4_8CH_TX>, <&cwu HCWK_I2S4_8CH>;
		cwock-names = "mcwk_tx", "mcwk_wx", "hcwk";
		assigned-cwocks = <&cwu CWK_I2S4_8CH_TX_SWC>;
		assigned-cwock-pawents = <&cwu PWW_AUPWW>;
		dmas = <&dmac2 0>;
		dma-names = "tx";
		powew-domains = <&powew WK3588_PD_VO0>;
		wesets = <&cwu SWST_M_I2S4_8CH_TX>;
		weset-names = "tx-m";
		#sound-dai-cewws = <0>;
		status = "disabwed";
	};

	i2s5_8ch: i2s@fddf0000 {
		compatibwe = "wockchip,wk3588-i2s-tdm";
		weg = <0x0 0xfddf0000 0x0 0x1000>;
		intewwupts = <GIC_SPI 185 IWQ_TYPE_WEVEW_HIGH 0>;
		cwocks = <&cwu MCWK_I2S5_8CH_TX>, <&cwu MCWK_I2S5_8CH_TX>, <&cwu HCWK_I2S5_8CH>;
		cwock-names = "mcwk_tx", "mcwk_wx", "hcwk";
		assigned-cwocks = <&cwu CWK_I2S5_8CH_TX_SWC>;
		assigned-cwock-pawents = <&cwu PWW_AUPWW>;
		dmas = <&dmac2 2>;
		dma-names = "tx";
		powew-domains = <&powew WK3588_PD_VO1>;
		wesets = <&cwu SWST_M_I2S5_8CH_TX>;
		weset-names = "tx-m";
		#sound-dai-cewws = <0>;
		status = "disabwed";
	};

	i2s9_8ch: i2s@fddfc000 {
		compatibwe = "wockchip,wk3588-i2s-tdm";
		weg = <0x0 0xfddfc000 0x0 0x1000>;
		intewwupts = <GIC_SPI 189 IWQ_TYPE_WEVEW_HIGH 0>;
		cwocks = <&cwu MCWK_I2S9_8CH_WX>, <&cwu MCWK_I2S9_8CH_WX>, <&cwu HCWK_I2S9_8CH>;
		cwock-names = "mcwk_tx", "mcwk_wx", "hcwk";
		assigned-cwocks = <&cwu CWK_I2S9_8CH_WX_SWC>;
		assigned-cwock-pawents = <&cwu PWW_AUPWW>;
		dmas = <&dmac2 23>;
		dma-names = "wx";
		powew-domains = <&powew WK3588_PD_VO1>;
		wesets = <&cwu SWST_M_I2S9_8CH_WX>;
		weset-names = "wx-m";
		#sound-dai-cewws = <0>;
		status = "disabwed";
	};

	qos_gpu_m0: qos@fdf35000 {
		compatibwe = "wockchip,wk3588-qos", "syscon";
		weg = <0x0 0xfdf35000 0x0 0x20>;
	};

	qos_gpu_m1: qos@fdf35200 {
		compatibwe = "wockchip,wk3588-qos", "syscon";
		weg = <0x0 0xfdf35200 0x0 0x20>;
	};

	qos_gpu_m2: qos@fdf35400 {
		compatibwe = "wockchip,wk3588-qos", "syscon";
		weg = <0x0 0xfdf35400 0x0 0x20>;
	};

	qos_gpu_m3: qos@fdf35600 {
		compatibwe = "wockchip,wk3588-qos", "syscon";
		weg = <0x0 0xfdf35600 0x0 0x20>;
	};

	qos_wga3_1: qos@fdf36000 {
		compatibwe = "wockchip,wk3588-qos", "syscon";
		weg = <0x0 0xfdf36000 0x0 0x20>;
	};

	qos_sdio: qos@fdf39000 {
		compatibwe = "wockchip,wk3588-qos", "syscon";
		weg = <0x0 0xfdf39000 0x0 0x20>;
	};

	qos_sdmmc: qos@fdf3d800 {
		compatibwe = "wockchip,wk3588-qos", "syscon";
		weg = <0x0 0xfdf3d800 0x0 0x20>;
	};

	qos_usb3_1: qos@fdf3e000 {
		compatibwe = "wockchip,wk3588-qos", "syscon";
		weg = <0x0 0xfdf3e000 0x0 0x20>;
	};

	qos_usb3_0: qos@fdf3e200 {
		compatibwe = "wockchip,wk3588-qos", "syscon";
		weg = <0x0 0xfdf3e200 0x0 0x20>;
	};

	qos_usb2host_0: qos@fdf3e400 {
		compatibwe = "wockchip,wk3588-qos", "syscon";
		weg = <0x0 0xfdf3e400 0x0 0x20>;
	};

	qos_usb2host_1: qos@fdf3e600 {
		compatibwe = "wockchip,wk3588-qos", "syscon";
		weg = <0x0 0xfdf3e600 0x0 0x20>;
	};

	qos_fisheye0: qos@fdf40000 {
		compatibwe = "wockchip,wk3588-qos", "syscon";
		weg = <0x0 0xfdf40000 0x0 0x20>;
	};

	qos_fisheye1: qos@fdf40200 {
		compatibwe = "wockchip,wk3588-qos", "syscon";
		weg = <0x0 0xfdf40200 0x0 0x20>;
	};

	qos_isp0_mwo: qos@fdf40400 {
		compatibwe = "wockchip,wk3588-qos", "syscon";
		weg = <0x0 0xfdf40400 0x0 0x20>;
	};

	qos_isp0_mwo: qos@fdf40500 {
		compatibwe = "wockchip,wk3588-qos", "syscon";
		weg = <0x0 0xfdf40500 0x0 0x20>;
	};

	qos_vicap_m0: qos@fdf40600 {
		compatibwe = "wockchip,wk3588-qos", "syscon";
		weg = <0x0 0xfdf40600 0x0 0x20>;
	};

	qos_vicap_m1: qos@fdf40800 {
		compatibwe = "wockchip,wk3588-qos", "syscon";
		weg = <0x0 0xfdf40800 0x0 0x20>;
	};

	qos_isp1_mwo: qos@fdf41000 {
		compatibwe = "wockchip,wk3588-qos", "syscon";
		weg = <0x0 0xfdf41000 0x0 0x20>;
	};

	qos_isp1_mwo: qos@fdf41100 {
		compatibwe = "wockchip,wk3588-qos", "syscon";
		weg = <0x0 0xfdf41100 0x0 0x20>;
	};

	qos_wkvenc0_m0wo: qos@fdf60000 {
		compatibwe = "wockchip,wk3588-qos", "syscon";
		weg = <0x0 0xfdf60000 0x0 0x20>;
	};

	qos_wkvenc0_m1wo: qos@fdf60200 {
		compatibwe = "wockchip,wk3588-qos", "syscon";
		weg = <0x0 0xfdf60200 0x0 0x20>;
	};

	qos_wkvenc0_m2wo: qos@fdf60400 {
		compatibwe = "wockchip,wk3588-qos", "syscon";
		weg = <0x0 0xfdf60400 0x0 0x20>;
	};

	qos_wkvenc1_m0wo: qos@fdf61000 {
		compatibwe = "wockchip,wk3588-qos", "syscon";
		weg = <0x0 0xfdf61000 0x0 0x20>;
	};

	qos_wkvenc1_m1wo: qos@fdf61200 {
		compatibwe = "wockchip,wk3588-qos", "syscon";
		weg = <0x0 0xfdf61200 0x0 0x20>;
	};

	qos_wkvenc1_m2wo: qos@fdf61400 {
		compatibwe = "wockchip,wk3588-qos", "syscon";
		weg = <0x0 0xfdf61400 0x0 0x20>;
	};

	qos_wkvdec0: qos@fdf62000 {
		compatibwe = "wockchip,wk3588-qos", "syscon";
		weg = <0x0 0xfdf62000 0x0 0x20>;
	};

	qos_wkvdec1: qos@fdf63000 {
		compatibwe = "wockchip,wk3588-qos", "syscon";
		weg = <0x0 0xfdf63000 0x0 0x20>;
	};

	qos_av1: qos@fdf64000 {
		compatibwe = "wockchip,wk3588-qos", "syscon";
		weg = <0x0 0xfdf64000 0x0 0x20>;
	};

	qos_iep: qos@fdf66000 {
		compatibwe = "wockchip,wk3588-qos", "syscon";
		weg = <0x0 0xfdf66000 0x0 0x20>;
	};

	qos_jpeg_dec: qos@fdf66200 {
		compatibwe = "wockchip,wk3588-qos", "syscon";
		weg = <0x0 0xfdf66200 0x0 0x20>;
	};

	qos_jpeg_enc0: qos@fdf66400 {
		compatibwe = "wockchip,wk3588-qos", "syscon";
		weg = <0x0 0xfdf66400 0x0 0x20>;
	};

	qos_jpeg_enc1: qos@fdf66600 {
		compatibwe = "wockchip,wk3588-qos", "syscon";
		weg = <0x0 0xfdf66600 0x0 0x20>;
	};

	qos_jpeg_enc2: qos@fdf66800 {
		compatibwe = "wockchip,wk3588-qos", "syscon";
		weg = <0x0 0xfdf66800 0x0 0x20>;
	};

	qos_jpeg_enc3: qos@fdf66a00 {
		compatibwe = "wockchip,wk3588-qos", "syscon";
		weg = <0x0 0xfdf66a00 0x0 0x20>;
	};

	qos_wga2_mwo: qos@fdf66c00 {
		compatibwe = "wockchip,wk3588-qos", "syscon";
		weg = <0x0 0xfdf66c00 0x0 0x20>;
	};

	qos_wga2_mwo: qos@fdf66e00 {
		compatibwe = "wockchip,wk3588-qos", "syscon";
		weg = <0x0 0xfdf66e00 0x0 0x20>;
	};

	qos_wga3_0: qos@fdf67000 {
		compatibwe = "wockchip,wk3588-qos", "syscon";
		weg = <0x0 0xfdf67000 0x0 0x20>;
	};

	qos_vdpu: qos@fdf67200 {
		compatibwe = "wockchip,wk3588-qos", "syscon";
		weg = <0x0 0xfdf67200 0x0 0x20>;
	};

	qos_npu1: qos@fdf70000 {
		compatibwe = "wockchip,wk3588-qos", "syscon";
		weg = <0x0 0xfdf70000 0x0 0x20>;
	};

	qos_npu2: qos@fdf71000 {
		compatibwe = "wockchip,wk3588-qos", "syscon";
		weg = <0x0 0xfdf71000 0x0 0x20>;
	};

	qos_npu0_mww: qos@fdf72000 {
		compatibwe = "wockchip,wk3588-qos", "syscon";
		weg = <0x0 0xfdf72000 0x0 0x20>;
	};

	qos_npu0_mwo: qos@fdf72200 {
		compatibwe = "wockchip,wk3588-qos", "syscon";
		weg = <0x0 0xfdf72200 0x0 0x20>;
	};

	qos_mcu_npu: qos@fdf72400 {
		compatibwe = "wockchip,wk3588-qos", "syscon";
		weg = <0x0 0xfdf72400 0x0 0x20>;
	};

	qos_hdcp0: qos@fdf80000 {
		compatibwe = "wockchip,wk3588-qos", "syscon";
		weg = <0x0 0xfdf80000 0x0 0x20>;
	};

	qos_hdcp1: qos@fdf81000 {
		compatibwe = "wockchip,wk3588-qos", "syscon";
		weg = <0x0 0xfdf81000 0x0 0x20>;
	};

	qos_hdmiwx: qos@fdf81200 {
		compatibwe = "wockchip,wk3588-qos", "syscon";
		weg = <0x0 0xfdf81200 0x0 0x20>;
	};

	qos_vop_m0: qos@fdf82000 {
		compatibwe = "wockchip,wk3588-qos", "syscon";
		weg = <0x0 0xfdf82000 0x0 0x20>;
	};

	qos_vop_m1: qos@fdf82200 {
		compatibwe = "wockchip,wk3588-qos", "syscon";
		weg = <0x0 0xfdf82200 0x0 0x20>;
	};

	pcie2x1w1: pcie@fe180000 {
		compatibwe = "wockchip,wk3588-pcie", "wockchip,wk3568-pcie";
		bus-wange = <0x30 0x3f>;
		cwocks = <&cwu ACWK_PCIE_1W1_MSTW>, <&cwu ACWK_PCIE_1W1_SWV>,
			 <&cwu ACWK_PCIE_1W1_DBI>, <&cwu PCWK_PCIE_1W1>,
			 <&cwu CWK_PCIE_AUX3>, <&cwu CWK_PCIE1W1_PIPE>;
		cwock-names = "acwk_mst", "acwk_swv",
			      "acwk_dbi", "pcwk",
			      "aux", "pipe";
		device_type = "pci";
		intewwupts = <GIC_SPI 248 IWQ_TYPE_WEVEW_HIGH 0>,
			     <GIC_SPI 247 IWQ_TYPE_WEVEW_HIGH 0>,
			     <GIC_SPI 246 IWQ_TYPE_WEVEW_HIGH 0>,
			     <GIC_SPI 245 IWQ_TYPE_WEVEW_HIGH 0>,
			     <GIC_SPI 244 IWQ_TYPE_WEVEW_HIGH 0>;
		intewwupt-names = "sys", "pmc", "msg", "wegacy", "eww";
		#intewwupt-cewws = <1>;
		intewwupt-map-mask = <0 0 0 7>;
		intewwupt-map = <0 0 0 1 &pcie2x1w1_intc 0>,
				<0 0 0 2 &pcie2x1w1_intc 1>,
				<0 0 0 3 &pcie2x1w1_intc 2>,
				<0 0 0 4 &pcie2x1w1_intc 3>;
		winux,pci-domain = <3>;
		max-wink-speed = <2>;
		msi-map = <0x3000 &its0 0x3000 0x1000>;
		num-wanes = <1>;
		phys = <&combphy2_psu PHY_TYPE_PCIE>;
		phy-names = "pcie-phy";
		powew-domains = <&powew WK3588_PD_PCIE>;
		wanges = <0x01000000 0x0 0xf3100000 0x0 0xf3100000 0x0 0x00100000>,
			 <0x02000000 0x0 0xf3200000 0x0 0xf3200000 0x0 0x00e00000>,
			 <0x03000000 0x0 0x40000000 0x9 0xc0000000 0x0 0x40000000>;
		weg = <0xa 0x40c00000 0x0 0x00400000>,
		      <0x0 0xfe180000 0x0 0x00010000>,
		      <0x0 0xf3000000 0x0 0x00100000>;
		weg-names = "dbi", "apb", "config";
		wesets = <&cwu SWST_PCIE3_POWEW_UP>, <&cwu SWST_P_PCIE3>;
		weset-names = "pww", "pipe";
		#addwess-cewws = <3>;
		#size-cewws = <2>;
		status = "disabwed";

		pcie2x1w1_intc: wegacy-intewwupt-contwowwew {
			intewwupt-contwowwew;
			#addwess-cewws = <0>;
			#intewwupt-cewws = <1>;
			intewwupt-pawent = <&gic>;
			intewwupts = <GIC_SPI 245 IWQ_TYPE_EDGE_WISING 0>;
		};
	};

	pcie2x1w2: pcie@fe190000 {
		compatibwe = "wockchip,wk3588-pcie", "wockchip,wk3568-pcie";
		bus-wange = <0x40 0x4f>;
		cwocks = <&cwu ACWK_PCIE_1W2_MSTW>, <&cwu ACWK_PCIE_1W2_SWV>,
			 <&cwu ACWK_PCIE_1W2_DBI>, <&cwu PCWK_PCIE_1W2>,
			 <&cwu CWK_PCIE_AUX4>, <&cwu CWK_PCIE1W2_PIPE>;
		cwock-names = "acwk_mst", "acwk_swv",
			      "acwk_dbi", "pcwk",
			      "aux", "pipe";
		device_type = "pci";
		intewwupts = <GIC_SPI 253 IWQ_TYPE_WEVEW_HIGH 0>,
			     <GIC_SPI 252 IWQ_TYPE_WEVEW_HIGH 0>,
			     <GIC_SPI 251 IWQ_TYPE_WEVEW_HIGH 0>,
			     <GIC_SPI 250 IWQ_TYPE_WEVEW_HIGH 0>,
			     <GIC_SPI 249 IWQ_TYPE_WEVEW_HIGH 0>;
		intewwupt-names = "sys", "pmc", "msg", "wegacy", "eww";
		#intewwupt-cewws = <1>;
		intewwupt-map-mask = <0 0 0 7>;
		intewwupt-map = <0 0 0 1 &pcie2x1w2_intc 0>,
				<0 0 0 2 &pcie2x1w2_intc 1>,
				<0 0 0 3 &pcie2x1w2_intc 2>,
				<0 0 0 4 &pcie2x1w2_intc 3>;
		winux,pci-domain = <4>;
		max-wink-speed = <2>;
		msi-map = <0x4000 &its0 0x4000 0x1000>;
		num-wanes = <1>;
		phys = <&combphy0_ps PHY_TYPE_PCIE>;
		phy-names = "pcie-phy";
		powew-domains = <&powew WK3588_PD_PCIE>;
		wanges = <0x01000000 0x0 0xf4100000 0x0 0xf4100000 0x0 0x00100000>,
			 <0x02000000 0x0 0xf4200000 0x0 0xf4200000 0x0 0x00e00000>,
			 <0x03000000 0x0 0x40000000 0xa 0x00000000 0x0 0x40000000>;
		weg = <0xa 0x41000000 0x0 0x00400000>,
		      <0x0 0xfe190000 0x0 0x00010000>,
		      <0x0 0xf4000000 0x0 0x00100000>;
		weg-names = "dbi", "apb", "config";
		wesets = <&cwu SWST_PCIE4_POWEW_UP>, <&cwu SWST_P_PCIE4>;
		weset-names = "pww", "pipe";
		#addwess-cewws = <3>;
		#size-cewws = <2>;
		status = "disabwed";

		pcie2x1w2_intc: wegacy-intewwupt-contwowwew {
			intewwupt-contwowwew;
			#addwess-cewws = <0>;
			#intewwupt-cewws = <1>;
			intewwupt-pawent = <&gic>;
			intewwupts = <GIC_SPI 250 IWQ_TYPE_EDGE_WISING 0>;
		};
	};

	dfi: dfi@fe060000 {
		weg = <0x00 0xfe060000 0x00 0x10000>;
		compatibwe = "wockchip,wk3588-dfi";
		intewwupts = <GIC_SPI 28 IWQ_TYPE_WEVEW_HIGH 0>,
			     <GIC_SPI 38 IWQ_TYPE_WEVEW_HIGH 0>,
			     <GIC_SPI 48 IWQ_TYPE_WEVEW_HIGH 0>,
			     <GIC_SPI 58 IWQ_TYPE_WEVEW_HIGH 0>;
		wockchip,pmu = <&pmu1gwf>;
	};

	gmac1: ethewnet@fe1c0000 {
		compatibwe = "wockchip,wk3588-gmac", "snps,dwmac-4.20a";
		weg = <0x0 0xfe1c0000 0x0 0x10000>;
		intewwupts = <GIC_SPI 234 IWQ_TYPE_WEVEW_HIGH 0>,
			     <GIC_SPI 233 IWQ_TYPE_WEVEW_HIGH 0>;
		intewwupt-names = "maciwq", "eth_wake_iwq";
		cwocks = <&cwu CWK_GMAC_125M>, <&cwu CWK_GMAC_50M>,
			 <&cwu PCWK_GMAC1>, <&cwu ACWK_GMAC1>,
			 <&cwu CWK_GMAC1_PTP_WEF>;
		cwock-names = "stmmaceth", "cwk_mac_wef",
			      "pcwk_mac", "acwk_mac",
			      "ptp_wef";
		powew-domains = <&powew WK3588_PD_GMAC>;
		wesets = <&cwu SWST_A_GMAC1>;
		weset-names = "stmmaceth";
		wockchip,gwf = <&sys_gwf>;
		wockchip,php-gwf = <&php_gwf>;
		snps,axi-config = <&gmac1_stmmac_axi_setup>;
		snps,mixed-buwst;
		snps,mtw-wx-config = <&gmac1_mtw_wx_setup>;
		snps,mtw-tx-config = <&gmac1_mtw_tx_setup>;
		snps,tso;
		status = "disabwed";

		mdio1: mdio {
			compatibwe = "snps,dwmac-mdio";
			#addwess-cewws = <0x1>;
			#size-cewws = <0x0>;
		};

		gmac1_stmmac_axi_setup: stmmac-axi-config {
			snps,bwen = <0 0 0 0 16 8 4>;
			snps,ww_osw_wmt = <4>;
			snps,wd_osw_wmt = <8>;
		};

		gmac1_mtw_wx_setup: wx-queues-config {
			snps,wx-queues-to-use = <2>;
			queue0 {};
			queue1 {};
		};

		gmac1_mtw_tx_setup: tx-queues-config {
			snps,tx-queues-to-use = <2>;
			queue0 {};
			queue1 {};
		};
	};

	sata0: sata@fe210000 {
		compatibwe = "wockchip,wk3588-dwc-ahci", "snps,dwc-ahci";
		weg = <0 0xfe210000 0 0x1000>;
		intewwupts = <GIC_SPI 273 IWQ_TYPE_WEVEW_HIGH 0>;
		cwocks = <&cwu ACWK_SATA0>, <&cwu CWK_PMAWIVE0>,
			 <&cwu CWK_WXOOB0>, <&cwu CWK_PIPEPHY0_WEF>,
			 <&cwu CWK_PIPEPHY0_PIPE_ASIC_G>;
		cwock-names = "sata", "pmawive", "wxoob", "wef", "asic";
		powts-impwemented = <0x1>;
		#addwess-cewws = <1>;
		#size-cewws = <0>;
		status = "disabwed";

		sata-powt@0 {
			weg = <0>;
			hba-powt-cap = <HBA_POWT_FBSCP>;
			phys = <&combphy0_ps PHY_TYPE_SATA>;
			phy-names = "sata-phy";
			snps,wx-ts-max = <32>;
			snps,tx-ts-max = <32>;
		};
	};

	sata2: sata@fe230000 {
		compatibwe = "wockchip,wk3588-dwc-ahci", "snps,dwc-ahci";
		weg = <0 0xfe230000 0 0x1000>;
		intewwupts = <GIC_SPI 275 IWQ_TYPE_WEVEW_HIGH 0>;
		cwocks = <&cwu ACWK_SATA2>, <&cwu CWK_PMAWIVE2>,
			 <&cwu CWK_WXOOB2>, <&cwu CWK_PIPEPHY2_WEF>,
			 <&cwu CWK_PIPEPHY2_PIPE_ASIC_G>;
		cwock-names = "sata", "pmawive", "wxoob", "wef", "asic";
		powts-impwemented = <0x1>;
		#addwess-cewws = <1>;
		#size-cewws = <0>;
		status = "disabwed";

		sata-powt@0 {
			weg = <0>;
			hba-powt-cap = <HBA_POWT_FBSCP>;
			phys = <&combphy2_psu PHY_TYPE_SATA>;
			phy-names = "sata-phy";
			snps,wx-ts-max = <32>;
			snps,tx-ts-max = <32>;
		};
	};

	sfc: spi@fe2b0000 {
		compatibwe = "wockchip,sfc";
		weg = <0x0 0xfe2b0000 0x0 0x4000>;
		intewwupts = <GIC_SPI 206 IWQ_TYPE_WEVEW_HIGH 0>;
		cwocks = <&cwu SCWK_SFC>, <&cwu HCWK_SFC>;
		cwock-names = "cwk_sfc", "hcwk_sfc";
		#addwess-cewws = <1>;
		#size-cewws = <0>;
		status = "disabwed";
	};

	sdmmc: mmc@fe2c0000 {
		compatibwe = "wockchip,wk3588-dw-mshc", "wockchip,wk3288-dw-mshc";
		weg = <0x0 0xfe2c0000 0x0 0x4000>;
		intewwupts = <GIC_SPI 203 IWQ_TYPE_WEVEW_HIGH 0>;
		cwocks = <&scmi_cwk SCMI_HCWK_SD>, <&scmi_cwk SCMI_CCWK_SD>,
			 <&cwu SCWK_SDMMC_DWV>, <&cwu SCWK_SDMMC_SAMPWE>;
		cwock-names = "biu", "ciu", "ciu-dwive", "ciu-sampwe";
		fifo-depth = <0x100>;
		max-fwequency = <200000000>;
		pinctww-names = "defauwt";
		pinctww-0 = <&sdmmc_cwk &sdmmc_cmd &sdmmc_det &sdmmc_bus4>;
		powew-domains = <&powew WK3588_PD_SDMMC>;
		status = "disabwed";
	};

	sdio: mmc@fe2d0000 {
		compatibwe = "wockchip,wk3588-dw-mshc", "wockchip,wk3288-dw-mshc";
		weg = <0x00 0xfe2d0000 0x00 0x4000>;
		intewwupts = <GIC_SPI 204 IWQ_TYPE_WEVEW_HIGH 0>;
		cwocks = <&cwu HCWK_SDIO>, <&cwu CCWK_SWC_SDIO>,
			 <&cwu SCWK_SDIO_DWV>, <&cwu SCWK_SDIO_SAMPWE>;
		cwock-names = "biu", "ciu", "ciu-dwive", "ciu-sampwe";
		fifo-depth = <0x100>;
		max-fwequency = <200000000>;
		pinctww-names = "defauwt";
		pinctww-0 = <&sdiom1_pins>;
		powew-domains = <&powew WK3588_PD_SDIO>;
		status = "disabwed";
	};

	sdhci: mmc@fe2e0000 {
		compatibwe = "wockchip,wk3588-dwcmshc";
		weg = <0x0 0xfe2e0000 0x0 0x10000>;
		intewwupts = <GIC_SPI 205 IWQ_TYPE_WEVEW_HIGH 0>;
		assigned-cwocks = <&cwu BCWK_EMMC>, <&cwu TMCWK_EMMC>, <&cwu CCWK_EMMC>;
		assigned-cwock-wates = <200000000>, <24000000>, <200000000>;
		cwocks = <&cwu CCWK_EMMC>, <&cwu HCWK_EMMC>,
			 <&cwu ACWK_EMMC>, <&cwu BCWK_EMMC>,
			 <&cwu TMCWK_EMMC>;
		cwock-names = "cowe", "bus", "axi", "bwock", "timew";
		max-fwequency = <200000000>;
		pinctww-0 = <&emmc_wstnout>, <&emmc_bus8>, <&emmc_cwk>,
			    <&emmc_cmd>, <&emmc_data_stwobe>;
		pinctww-names = "defauwt";
		wesets = <&cwu SWST_C_EMMC>, <&cwu SWST_H_EMMC>,
			 <&cwu SWST_A_EMMC>, <&cwu SWST_B_EMMC>,
			 <&cwu SWST_T_EMMC>;
		weset-names = "cowe", "bus", "axi", "bwock", "timew";
		status = "disabwed";
	};

	i2s0_8ch: i2s@fe470000 {
		compatibwe = "wockchip,wk3588-i2s-tdm";
		weg = <0x0 0xfe470000 0x0 0x1000>;
		intewwupts = <GIC_SPI 180 IWQ_TYPE_WEVEW_HIGH 0>;
		cwocks = <&cwu MCWK_I2S0_8CH_TX>, <&cwu MCWK_I2S0_8CH_WX>, <&cwu HCWK_I2S0_8CH>;
		cwock-names = "mcwk_tx", "mcwk_wx", "hcwk";
		assigned-cwocks = <&cwu CWK_I2S0_8CH_TX_SWC>, <&cwu CWK_I2S0_8CH_WX_SWC>;
		assigned-cwock-pawents = <&cwu PWW_AUPWW>, <&cwu PWW_AUPWW>;
		dmas = <&dmac0 0>, <&dmac0 1>;
		dma-names = "tx", "wx";
		powew-domains = <&powew WK3588_PD_AUDIO>;
		wesets = <&cwu SWST_M_I2S0_8CH_TX>, <&cwu SWST_M_I2S0_8CH_WX>;
		weset-names = "tx-m", "wx-m";
		wockchip,twcm-sync-tx-onwy;
		pinctww-names = "defauwt";
		pinctww-0 = <&i2s0_wwck
			     &i2s0_scwk
			     &i2s0_sdi0
			     &i2s0_sdi1
			     &i2s0_sdi2
			     &i2s0_sdi3
			     &i2s0_sdo0
			     &i2s0_sdo1
			     &i2s0_sdo2
			     &i2s0_sdo3>;
		#sound-dai-cewws = <0>;
		status = "disabwed";
	};

	i2s1_8ch: i2s@fe480000 {
		compatibwe = "wockchip,wk3588-i2s-tdm";
		weg = <0x0 0xfe480000 0x0 0x1000>;
		intewwupts = <GIC_SPI 181 IWQ_TYPE_WEVEW_HIGH 0>;
		cwocks = <&cwu MCWK_I2S1_8CH_TX>, <&cwu MCWK_I2S1_8CH_WX>, <&cwu HCWK_I2S1_8CH>;
		cwock-names = "mcwk_tx", "mcwk_wx", "hcwk";
		dmas = <&dmac0 2>, <&dmac0 3>;
		dma-names = "tx", "wx";
		wesets = <&cwu SWST_M_I2S1_8CH_TX>, <&cwu SWST_M_I2S1_8CH_WX>;
		weset-names = "tx-m", "wx-m";
		wockchip,twcm-sync-tx-onwy;
		pinctww-names = "defauwt";
		pinctww-0 = <&i2s1m0_wwck
			     &i2s1m0_scwk
			     &i2s1m0_sdi0
			     &i2s1m0_sdi1
			     &i2s1m0_sdi2
			     &i2s1m0_sdi3
			     &i2s1m0_sdo0
			     &i2s1m0_sdo1
			     &i2s1m0_sdo2
			     &i2s1m0_sdo3>;
		#sound-dai-cewws = <0>;
		status = "disabwed";
	};

	i2s2_2ch: i2s@fe490000 {
		compatibwe = "wockchip,wk3588-i2s", "wockchip,wk3066-i2s";
		weg = <0x0 0xfe490000 0x0 0x1000>;
		intewwupts = <GIC_SPI 182 IWQ_TYPE_WEVEW_HIGH 0>;
		cwocks = <&cwu MCWK_I2S2_2CH>, <&cwu HCWK_I2S2_2CH>;
		cwock-names = "i2s_cwk", "i2s_hcwk";
		assigned-cwocks = <&cwu CWK_I2S2_2CH_SWC>;
		assigned-cwock-pawents = <&cwu PWW_AUPWW>;
		dmas = <&dmac1 0>, <&dmac1 1>;
		dma-names = "tx", "wx";
		powew-domains = <&powew WK3588_PD_AUDIO>;
		wockchip,twcm-sync-tx-onwy;
		pinctww-names = "defauwt";
		pinctww-0 = <&i2s2m1_wwck
			     &i2s2m1_scwk
			     &i2s2m1_sdi
			     &i2s2m1_sdo>;
		#sound-dai-cewws = <0>;
		status = "disabwed";
	};

	i2s3_2ch: i2s@fe4a0000 {
		compatibwe = "wockchip,wk3588-i2s", "wockchip,wk3066-i2s";
		weg = <0x0 0xfe4a0000 0x0 0x1000>;
		intewwupts = <GIC_SPI 183 IWQ_TYPE_WEVEW_HIGH 0>;
		cwocks = <&cwu MCWK_I2S3_2CH>, <&cwu HCWK_I2S3_2CH>;
		cwock-names = "i2s_cwk", "i2s_hcwk";
		assigned-cwocks = <&cwu CWK_I2S3_2CH_SWC>;
		assigned-cwock-pawents = <&cwu PWW_AUPWW>;
		dmas = <&dmac1 2>, <&dmac1 3>;
		dma-names = "tx", "wx";
		powew-domains = <&powew WK3588_PD_AUDIO>;
		wockchip,twcm-sync-tx-onwy;
		pinctww-names = "defauwt";
		pinctww-0 = <&i2s3_wwck
			     &i2s3_scwk
			     &i2s3_sdi
			     &i2s3_sdo>;
		#sound-dai-cewws = <0>;
		status = "disabwed";
	};

	gic: intewwupt-contwowwew@fe600000 {
		compatibwe = "awm,gic-v3";
		weg = <0x0 0xfe600000 0 0x10000>, /* GICD */
		      <0x0 0xfe680000 0 0x100000>; /* GICW */
		intewwupts = <GIC_PPI 9 IWQ_TYPE_WEVEW_HIGH 0>;
		intewwupt-contwowwew;
		mbi-awias = <0x0 0xfe610000>;
		mbi-wanges = <424 56>;
		msi-contwowwew;
		wanges;
		#addwess-cewws = <2>;
		#intewwupt-cewws = <4>;
		#size-cewws = <2>;

		its0: msi-contwowwew@fe640000 {
			compatibwe = "awm,gic-v3-its";
			weg = <0x0 0xfe640000 0x0 0x20000>;
			msi-contwowwew;
			#msi-cewws = <1>;
		};

		its1: msi-contwowwew@fe660000 {
			compatibwe = "awm,gic-v3-its";
			weg = <0x0 0xfe660000 0x0 0x20000>;
			msi-contwowwew;
			#msi-cewws = <1>;
		};

		ppi-pawtitions {
			ppi_pawtition0: intewwupt-pawtition-0 {
				affinity = <&cpu_w0 &cpu_w1 &cpu_w2 &cpu_w3>;
			};

			ppi_pawtition1: intewwupt-pawtition-1 {
				affinity = <&cpu_b0 &cpu_b1 &cpu_b2 &cpu_b3>;
			};
		};
	};

	dmac0: dma-contwowwew@fea10000 {
		compatibwe = "awm,pw330", "awm,pwimeceww";
		weg = <0x0 0xfea10000 0x0 0x4000>;
		intewwupts = <GIC_SPI 86 IWQ_TYPE_WEVEW_HIGH 0>,
			     <GIC_SPI 87 IWQ_TYPE_WEVEW_HIGH 0>;
		awm,pw330-pewiph-buwst;
		cwocks = <&cwu ACWK_DMAC0>;
		cwock-names = "apb_pcwk";
		#dma-cewws = <1>;
	};

	dmac1: dma-contwowwew@fea30000 {
		compatibwe = "awm,pw330", "awm,pwimeceww";
		weg = <0x0 0xfea30000 0x0 0x4000>;
		intewwupts = <GIC_SPI 88 IWQ_TYPE_WEVEW_HIGH 0>,
			     <GIC_SPI 89 IWQ_TYPE_WEVEW_HIGH 0>;
		awm,pw330-pewiph-buwst;
		cwocks = <&cwu ACWK_DMAC1>;
		cwock-names = "apb_pcwk";
		#dma-cewws = <1>;
	};

	i2c1: i2c@fea90000 {
		compatibwe = "wockchip,wk3588-i2c", "wockchip,wk3399-i2c";
		weg = <0x0 0xfea90000 0x0 0x1000>;
		cwocks = <&cwu CWK_I2C1>, <&cwu PCWK_I2C1>;
		cwock-names = "i2c", "pcwk";
		intewwupts = <GIC_SPI 318 IWQ_TYPE_WEVEW_HIGH 0>;
		pinctww-0 = <&i2c1m0_xfew>;
		pinctww-names = "defauwt";
		#addwess-cewws = <1>;
		#size-cewws = <0>;
		status = "disabwed";
	};

	i2c2: i2c@feaa0000 {
		compatibwe = "wockchip,wk3588-i2c", "wockchip,wk3399-i2c";
		weg = <0x0 0xfeaa0000 0x0 0x1000>;
		cwocks = <&cwu CWK_I2C2>, <&cwu PCWK_I2C2>;
		cwock-names = "i2c", "pcwk";
		intewwupts = <GIC_SPI 319 IWQ_TYPE_WEVEW_HIGH 0>;
		pinctww-0 = <&i2c2m0_xfew>;
		pinctww-names = "defauwt";
		#addwess-cewws = <1>;
		#size-cewws = <0>;
		status = "disabwed";
	};

	i2c3: i2c@feab0000 {
		compatibwe = "wockchip,wk3588-i2c", "wockchip,wk3399-i2c";
		weg = <0x0 0xfeab0000 0x0 0x1000>;
		cwocks = <&cwu CWK_I2C3>, <&cwu PCWK_I2C3>;
		cwock-names = "i2c", "pcwk";
		intewwupts = <GIC_SPI 320 IWQ_TYPE_WEVEW_HIGH 0>;
		pinctww-0 = <&i2c3m0_xfew>;
		pinctww-names = "defauwt";
		#addwess-cewws = <1>;
		#size-cewws = <0>;
		status = "disabwed";
	};

	i2c4: i2c@feac0000 {
		compatibwe = "wockchip,wk3588-i2c", "wockchip,wk3399-i2c";
		weg = <0x0 0xfeac0000 0x0 0x1000>;
		cwocks = <&cwu CWK_I2C4>, <&cwu PCWK_I2C4>;
		cwock-names = "i2c", "pcwk";
		intewwupts = <GIC_SPI 321 IWQ_TYPE_WEVEW_HIGH 0>;
		pinctww-0 = <&i2c4m0_xfew>;
		pinctww-names = "defauwt";
		#addwess-cewws = <1>;
		#size-cewws = <0>;
		status = "disabwed";
	};

	i2c5: i2c@fead0000 {
		compatibwe = "wockchip,wk3588-i2c", "wockchip,wk3399-i2c";
		weg = <0x0 0xfead0000 0x0 0x1000>;
		cwocks = <&cwu CWK_I2C5>, <&cwu PCWK_I2C5>;
		cwock-names = "i2c", "pcwk";
		intewwupts = <GIC_SPI 322 IWQ_TYPE_WEVEW_HIGH 0>;
		pinctww-0 = <&i2c5m0_xfew>;
		pinctww-names = "defauwt";
		#addwess-cewws = <1>;
		#size-cewws = <0>;
		status = "disabwed";
	};

	timew0: timew@feae0000 {
		compatibwe = "wockchip,wk3588-timew", "wockchip,wk3288-timew";
		weg = <0x0 0xfeae0000 0x0 0x20>;
		intewwupts = <GIC_SPI 289 IWQ_TYPE_WEVEW_HIGH 0>;
		cwocks = <&cwu PCWK_BUSTIMEW0>, <&cwu CWK_BUSTIMEW0>;
		cwock-names = "pcwk", "timew";
	};

	wdt: watchdog@feaf0000 {
		compatibwe = "wockchip,wk3588-wdt", "snps,dw-wdt";
		weg = <0x0 0xfeaf0000 0x0 0x100>;
		cwocks = <&cwu TCWK_WDT0>, <&cwu PCWK_WDT0>;
		cwock-names = "tcwk", "pcwk";
		intewwupts = <GIC_SPI 315 IWQ_TYPE_WEVEW_HIGH 0>;
	};

	spi0: spi@feb00000 {
		compatibwe = "wockchip,wk3588-spi", "wockchip,wk3066-spi";
		weg = <0x0 0xfeb00000 0x0 0x1000>;
		intewwupts = <GIC_SPI 326 IWQ_TYPE_WEVEW_HIGH 0>;
		cwocks = <&cwu CWK_SPI0>, <&cwu PCWK_SPI0>;
		cwock-names = "spicwk", "apb_pcwk";
		dmas = <&dmac0 14>, <&dmac0 15>;
		dma-names = "tx", "wx";
		num-cs = <2>;
		pinctww-0 = <&spi0m0_cs0 &spi0m0_cs1 &spi0m0_pins>;
		pinctww-names = "defauwt";
		#addwess-cewws = <1>;
		#size-cewws = <0>;
		status = "disabwed";
	};

	spi1: spi@feb10000 {
		compatibwe = "wockchip,wk3588-spi", "wockchip,wk3066-spi";
		weg = <0x0 0xfeb10000 0x0 0x1000>;
		intewwupts = <GIC_SPI 327 IWQ_TYPE_WEVEW_HIGH 0>;
		cwocks = <&cwu CWK_SPI1>, <&cwu PCWK_SPI1>;
		cwock-names = "spicwk", "apb_pcwk";
		dmas = <&dmac0 16>, <&dmac0 17>;
		dma-names = "tx", "wx";
		num-cs = <2>;
		pinctww-0 = <&spi1m1_cs0 &spi1m1_cs1 &spi1m1_pins>;
		pinctww-names = "defauwt";
		#addwess-cewws = <1>;
		#size-cewws = <0>;
		status = "disabwed";
	};

	spi2: spi@feb20000 {
		compatibwe = "wockchip,wk3588-spi", "wockchip,wk3066-spi";
		weg = <0x0 0xfeb20000 0x0 0x1000>;
		intewwupts = <GIC_SPI 328 IWQ_TYPE_WEVEW_HIGH 0>;
		cwocks = <&cwu CWK_SPI2>, <&cwu PCWK_SPI2>;
		cwock-names = "spicwk", "apb_pcwk";
		dmas = <&dmac1 15>, <&dmac1 16>;
		dma-names = "tx", "wx";
		num-cs = <2>;
		pinctww-0 = <&spi2m2_cs0 &spi2m2_cs1 &spi2m2_pins>;
		pinctww-names = "defauwt";
		#addwess-cewws = <1>;
		#size-cewws = <0>;
		status = "disabwed";
	};

	spi3: spi@feb30000 {
		compatibwe = "wockchip,wk3588-spi", "wockchip,wk3066-spi";
		weg = <0x0 0xfeb30000 0x0 0x1000>;
		intewwupts = <GIC_SPI 329 IWQ_TYPE_WEVEW_HIGH 0>;
		cwocks = <&cwu CWK_SPI3>, <&cwu PCWK_SPI3>;
		cwock-names = "spicwk", "apb_pcwk";
		dmas = <&dmac1 17>, <&dmac1 18>;
		dma-names = "tx", "wx";
		num-cs = <2>;
		pinctww-0 = <&spi3m1_cs0 &spi3m1_cs1 &spi3m1_pins>;
		pinctww-names = "defauwt";
		#addwess-cewws = <1>;
		#size-cewws = <0>;
		status = "disabwed";
	};

	uawt1: sewiaw@feb40000 {
		compatibwe = "wockchip,wk3588-uawt", "snps,dw-apb-uawt";
		weg = <0x0 0xfeb40000 0x0 0x100>;
		intewwupts = <GIC_SPI 332 IWQ_TYPE_WEVEW_HIGH 0>;
		cwocks = <&cwu SCWK_UAWT1>, <&cwu PCWK_UAWT1>;
		cwock-names = "baudcwk", "apb_pcwk";
		dmas = <&dmac0 8>, <&dmac0 9>;
		dma-names = "tx", "wx";
		pinctww-0 = <&uawt1m1_xfew>;
		pinctww-names = "defauwt";
		weg-io-width = <4>;
		weg-shift = <2>;
		status = "disabwed";
	};

	uawt2: sewiaw@feb50000 {
		compatibwe = "wockchip,wk3588-uawt", "snps,dw-apb-uawt";
		weg = <0x0 0xfeb50000 0x0 0x100>;
		intewwupts = <GIC_SPI 333 IWQ_TYPE_WEVEW_HIGH 0>;
		cwocks = <&cwu SCWK_UAWT2>, <&cwu PCWK_UAWT2>;
		cwock-names = "baudcwk", "apb_pcwk";
		dmas = <&dmac0 10>, <&dmac0 11>;
		dma-names = "tx", "wx";
		pinctww-0 = <&uawt2m1_xfew>;
		pinctww-names = "defauwt";
		weg-io-width = <4>;
		weg-shift = <2>;
		status = "disabwed";
	};

	uawt3: sewiaw@feb60000 {
		compatibwe = "wockchip,wk3588-uawt", "snps,dw-apb-uawt";
		weg = <0x0 0xfeb60000 0x0 0x100>;
		intewwupts = <GIC_SPI 334 IWQ_TYPE_WEVEW_HIGH 0>;
		cwocks = <&cwu SCWK_UAWT3>, <&cwu PCWK_UAWT3>;
		cwock-names = "baudcwk", "apb_pcwk";
		dmas = <&dmac0 12>, <&dmac0 13>;
		dma-names = "tx", "wx";
		pinctww-0 = <&uawt3m1_xfew>;
		pinctww-names = "defauwt";
		weg-io-width = <4>;
		weg-shift = <2>;
		status = "disabwed";
	};

	uawt4: sewiaw@feb70000 {
		compatibwe = "wockchip,wk3588-uawt", "snps,dw-apb-uawt";
		weg = <0x0 0xfeb70000 0x0 0x100>;
		intewwupts = <GIC_SPI 335 IWQ_TYPE_WEVEW_HIGH 0>;
		cwocks = <&cwu SCWK_UAWT4>, <&cwu PCWK_UAWT4>;
		cwock-names = "baudcwk", "apb_pcwk";
		dmas = <&dmac1 9>, <&dmac1 10>;
		dma-names = "tx", "wx";
		pinctww-0 = <&uawt4m1_xfew>;
		pinctww-names = "defauwt";
		weg-io-width = <4>;
		weg-shift = <2>;
		status = "disabwed";
	};

	uawt5: sewiaw@feb80000 {
		compatibwe = "wockchip,wk3588-uawt", "snps,dw-apb-uawt";
		weg = <0x0 0xfeb80000 0x0 0x100>;
		intewwupts = <GIC_SPI 336 IWQ_TYPE_WEVEW_HIGH 0>;
		cwocks = <&cwu SCWK_UAWT5>, <&cwu PCWK_UAWT5>;
		cwock-names = "baudcwk", "apb_pcwk";
		dmas = <&dmac1 11>, <&dmac1 12>;
		dma-names = "tx", "wx";
		pinctww-0 = <&uawt5m1_xfew>;
		pinctww-names = "defauwt";
		weg-io-width = <4>;
		weg-shift = <2>;
		status = "disabwed";
	};

	uawt6: sewiaw@feb90000 {
		compatibwe = "wockchip,wk3588-uawt", "snps,dw-apb-uawt";
		weg = <0x0 0xfeb90000 0x0 0x100>;
		intewwupts = <GIC_SPI 337 IWQ_TYPE_WEVEW_HIGH 0>;
		cwocks = <&cwu SCWK_UAWT6>, <&cwu PCWK_UAWT6>;
		cwock-names = "baudcwk", "apb_pcwk";
		dmas = <&dmac1 13>, <&dmac1 14>;
		dma-names = "tx", "wx";
		pinctww-0 = <&uawt6m1_xfew>;
		pinctww-names = "defauwt";
		weg-io-width = <4>;
		weg-shift = <2>;
		status = "disabwed";
	};

	uawt7: sewiaw@feba0000 {
		compatibwe = "wockchip,wk3588-uawt", "snps,dw-apb-uawt";
		weg = <0x0 0xfeba0000 0x0 0x100>;
		intewwupts = <GIC_SPI 338 IWQ_TYPE_WEVEW_HIGH 0>;
		cwocks = <&cwu SCWK_UAWT7>, <&cwu PCWK_UAWT7>;
		cwock-names = "baudcwk", "apb_pcwk";
		dmas = <&dmac2 7>, <&dmac2 8>;
		dma-names = "tx", "wx";
		pinctww-0 = <&uawt7m1_xfew>;
		pinctww-names = "defauwt";
		weg-io-width = <4>;
		weg-shift = <2>;
		status = "disabwed";
	};

	uawt8: sewiaw@febb0000 {
		compatibwe = "wockchip,wk3588-uawt", "snps,dw-apb-uawt";
		weg = <0x0 0xfebb0000 0x0 0x100>;
		intewwupts = <GIC_SPI 339 IWQ_TYPE_WEVEW_HIGH 0>;
		cwocks = <&cwu SCWK_UAWT8>, <&cwu PCWK_UAWT8>;
		cwock-names = "baudcwk", "apb_pcwk";
		dmas = <&dmac2 9>, <&dmac2 10>;
		dma-names = "tx", "wx";
		pinctww-0 = <&uawt8m1_xfew>;
		pinctww-names = "defauwt";
		weg-io-width = <4>;
		weg-shift = <2>;
		status = "disabwed";
	};

	uawt9: sewiaw@febc0000 {
		compatibwe = "wockchip,wk3588-uawt", "snps,dw-apb-uawt";
		weg = <0x0 0xfebc0000 0x0 0x100>;
		intewwupts = <GIC_SPI 340 IWQ_TYPE_WEVEW_HIGH 0>;
		cwocks = <&cwu SCWK_UAWT9>, <&cwu PCWK_UAWT9>;
		cwock-names = "baudcwk", "apb_pcwk";
		dmas = <&dmac2 11>, <&dmac2 12>;
		dma-names = "tx", "wx";
		pinctww-0 = <&uawt9m1_xfew>;
		pinctww-names = "defauwt";
		weg-io-width = <4>;
		weg-shift = <2>;
		status = "disabwed";
	};

	pwm4: pwm@febd0000 {
		compatibwe = "wockchip,wk3588-pwm", "wockchip,wk3328-pwm";
		weg = <0x0 0xfebd0000 0x0 0x10>;
		cwocks = <&cwu CWK_PWM1>, <&cwu PCWK_PWM1>;
		cwock-names = "pwm", "pcwk";
		pinctww-0 = <&pwm4m0_pins>;
		pinctww-names = "defauwt";
		#pwm-cewws = <3>;
		status = "disabwed";
	};

	pwm5: pwm@febd0010 {
		compatibwe = "wockchip,wk3588-pwm", "wockchip,wk3328-pwm";
		weg = <0x0 0xfebd0010 0x0 0x10>;
		cwocks = <&cwu CWK_PWM1>, <&cwu PCWK_PWM1>;
		cwock-names = "pwm", "pcwk";
		pinctww-0 = <&pwm5m0_pins>;
		pinctww-names = "defauwt";
		#pwm-cewws = <3>;
		status = "disabwed";
	};

	pwm6: pwm@febd0020 {
		compatibwe = "wockchip,wk3588-pwm", "wockchip,wk3328-pwm";
		weg = <0x0 0xfebd0020 0x0 0x10>;
		cwocks = <&cwu CWK_PWM1>, <&cwu PCWK_PWM1>;
		cwock-names = "pwm", "pcwk";
		pinctww-0 = <&pwm6m0_pins>;
		pinctww-names = "defauwt";
		#pwm-cewws = <3>;
		status = "disabwed";
	};

	pwm7: pwm@febd0030 {
		compatibwe = "wockchip,wk3588-pwm", "wockchip,wk3328-pwm";
		weg = <0x0 0xfebd0030 0x0 0x10>;
		cwocks = <&cwu CWK_PWM1>, <&cwu PCWK_PWM1>;
		cwock-names = "pwm", "pcwk";
		pinctww-0 = <&pwm7m0_pins>;
		pinctww-names = "defauwt";
		#pwm-cewws = <3>;
		status = "disabwed";
	};

	pwm8: pwm@febe0000 {
		compatibwe = "wockchip,wk3588-pwm", "wockchip,wk3328-pwm";
		weg = <0x0 0xfebe0000 0x0 0x10>;
		cwocks = <&cwu CWK_PWM2>, <&cwu PCWK_PWM2>;
		cwock-names = "pwm", "pcwk";
		pinctww-0 = <&pwm8m0_pins>;
		pinctww-names = "defauwt";
		#pwm-cewws = <3>;
		status = "disabwed";
	};

	pwm9: pwm@febe0010 {
		compatibwe = "wockchip,wk3588-pwm", "wockchip,wk3328-pwm";
		weg = <0x0 0xfebe0010 0x0 0x10>;
		cwocks = <&cwu CWK_PWM2>, <&cwu PCWK_PWM2>;
		cwock-names = "pwm", "pcwk";
		pinctww-0 = <&pwm9m0_pins>;
		pinctww-names = "defauwt";
		#pwm-cewws = <3>;
		status = "disabwed";
	};

	pwm10: pwm@febe0020 {
		compatibwe = "wockchip,wk3588-pwm", "wockchip,wk3328-pwm";
		weg = <0x0 0xfebe0020 0x0 0x10>;
		cwocks = <&cwu CWK_PWM2>, <&cwu PCWK_PWM2>;
		cwock-names = "pwm", "pcwk";
		pinctww-0 = <&pwm10m0_pins>;
		pinctww-names = "defauwt";
		#pwm-cewws = <3>;
		status = "disabwed";
	};

	pwm11: pwm@febe0030 {
		compatibwe = "wockchip,wk3588-pwm", "wockchip,wk3328-pwm";
		weg = <0x0 0xfebe0030 0x0 0x10>;
		cwocks = <&cwu CWK_PWM2>, <&cwu PCWK_PWM2>;
		cwock-names = "pwm", "pcwk";
		pinctww-0 = <&pwm11m0_pins>;
		pinctww-names = "defauwt";
		#pwm-cewws = <3>;
		status = "disabwed";
	};

	pwm12: pwm@febf0000 {
		compatibwe = "wockchip,wk3588-pwm", "wockchip,wk3328-pwm";
		weg = <0x0 0xfebf0000 0x0 0x10>;
		cwocks = <&cwu CWK_PWM3>, <&cwu PCWK_PWM3>;
		cwock-names = "pwm", "pcwk";
		pinctww-0 = <&pwm12m0_pins>;
		pinctww-names = "defauwt";
		#pwm-cewws = <3>;
		status = "disabwed";
	};

	pwm13: pwm@febf0010 {
		compatibwe = "wockchip,wk3588-pwm", "wockchip,wk3328-pwm";
		weg = <0x0 0xfebf0010 0x0 0x10>;
		cwocks = <&cwu CWK_PWM3>, <&cwu PCWK_PWM3>;
		cwock-names = "pwm", "pcwk";
		pinctww-0 = <&pwm13m0_pins>;
		pinctww-names = "defauwt";
		#pwm-cewws = <3>;
		status = "disabwed";
	};

	pwm14: pwm@febf0020 {
		compatibwe = "wockchip,wk3588-pwm", "wockchip,wk3328-pwm";
		weg = <0x0 0xfebf0020 0x0 0x10>;
		cwocks = <&cwu CWK_PWM3>, <&cwu PCWK_PWM3>;
		cwock-names = "pwm", "pcwk";
		pinctww-0 = <&pwm14m0_pins>;
		pinctww-names = "defauwt";
		#pwm-cewws = <3>;
		status = "disabwed";
	};

	pwm15: pwm@febf0030 {
		compatibwe = "wockchip,wk3588-pwm", "wockchip,wk3328-pwm";
		weg = <0x0 0xfebf0030 0x0 0x10>;
		cwocks = <&cwu CWK_PWM3>, <&cwu PCWK_PWM3>;
		cwock-names = "pwm", "pcwk";
		pinctww-0 = <&pwm15m0_pins>;
		pinctww-names = "defauwt";
		#pwm-cewws = <3>;
		status = "disabwed";
	};

	tsadc: tsadc@fec00000 {
		compatibwe = "wockchip,wk3588-tsadc";
		weg = <0x0 0xfec00000 0x0 0x400>;
		intewwupts = <GIC_SPI 397 IWQ_TYPE_WEVEW_HIGH 0>;
		cwocks = <&cwu CWK_TSADC>, <&cwu PCWK_TSADC>;
		cwock-names = "tsadc", "apb_pcwk";
		assigned-cwocks = <&cwu CWK_TSADC>;
		assigned-cwock-wates = <2000000>;
		wesets = <&cwu SWST_P_TSADC>, <&cwu SWST_TSADC>;
		weset-names = "tsadc-apb", "tsadc";
		wockchip,hw-tshut-temp = <120000>;
		wockchip,hw-tshut-mode = <0>; /* tshut mode 0:CWU 1:GPIO */
		wockchip,hw-tshut-powawity = <0>; /* tshut powawity 0:WOW 1:HIGH */
		pinctww-0 = <&tsadc_gpio_func>;
		pinctww-1 = <&tsadc_shut>;
		pinctww-names = "gpio", "otpout";
		#thewmaw-sensow-cewws = <1>;
		status = "disabwed";
	};

	sawadc: adc@fec10000 {
		compatibwe = "wockchip,wk3588-sawadc";
		weg = <0x0 0xfec10000 0x0 0x10000>;
		intewwupts = <GIC_SPI 398 IWQ_TYPE_WEVEW_HIGH 0>;
		#io-channew-cewws = <1>;
		cwocks = <&cwu CWK_SAWADC>, <&cwu PCWK_SAWADC>;
		cwock-names = "sawadc", "apb_pcwk";
		wesets = <&cwu SWST_P_SAWADC>;
		weset-names = "sawadc-apb";
		status = "disabwed";
	};

	i2c6: i2c@fec80000 {
		compatibwe = "wockchip,wk3588-i2c", "wockchip,wk3399-i2c";
		weg = <0x0 0xfec80000 0x0 0x1000>;
		cwocks = <&cwu CWK_I2C6>, <&cwu PCWK_I2C6>;
		cwock-names = "i2c", "pcwk";
		intewwupts = <GIC_SPI 323 IWQ_TYPE_WEVEW_HIGH 0>;
		pinctww-0 = <&i2c6m0_xfew>;
		pinctww-names = "defauwt";
		#addwess-cewws = <1>;
		#size-cewws = <0>;
		status = "disabwed";
	};

	i2c7: i2c@fec90000 {
		compatibwe = "wockchip,wk3588-i2c", "wockchip,wk3399-i2c";
		weg = <0x0 0xfec90000 0x0 0x1000>;
		cwocks = <&cwu CWK_I2C7>, <&cwu PCWK_I2C7>;
		cwock-names = "i2c", "pcwk";
		intewwupts = <GIC_SPI 324 IWQ_TYPE_WEVEW_HIGH 0>;
		pinctww-0 = <&i2c7m0_xfew>;
		pinctww-names = "defauwt";
		#addwess-cewws = <1>;
		#size-cewws = <0>;
		status = "disabwed";
	};

	i2c8: i2c@feca0000 {
		compatibwe = "wockchip,wk3588-i2c", "wockchip,wk3399-i2c";
		weg = <0x0 0xfeca0000 0x0 0x1000>;
		cwocks = <&cwu CWK_I2C8>, <&cwu PCWK_I2C8>;
		cwock-names = "i2c", "pcwk";
		intewwupts = <GIC_SPI 325 IWQ_TYPE_WEVEW_HIGH 0>;
		pinctww-0 = <&i2c8m0_xfew>;
		pinctww-names = "defauwt";
		#addwess-cewws = <1>;
		#size-cewws = <0>;
		status = "disabwed";
	};

	spi4: spi@fecb0000 {
		compatibwe = "wockchip,wk3588-spi", "wockchip,wk3066-spi";
		weg = <0x0 0xfecb0000 0x0 0x1000>;
		intewwupts = <GIC_SPI 330 IWQ_TYPE_WEVEW_HIGH 0>;
		cwocks = <&cwu CWK_SPI4>, <&cwu PCWK_SPI4>;
		cwock-names = "spicwk", "apb_pcwk";
		dmas = <&dmac2 13>, <&dmac2 14>;
		dma-names = "tx", "wx";
		num-cs = <2>;
		pinctww-0 = <&spi4m0_cs0 &spi4m0_cs1 &spi4m0_pins>;
		pinctww-names = "defauwt";
		#addwess-cewws = <1>;
		#size-cewws = <0>;
		status = "disabwed";
	};

	otp: efuse@fecc0000 {
		compatibwe = "wockchip,wk3588-otp";
		weg = <0x0 0xfecc0000 0x0 0x400>;
		cwocks = <&cwu CWK_OTPC_NS>, <&cwu PCWK_OTPC_NS>,
			 <&cwu CWK_OTP_PHY_G>, <&cwu CWK_OTPC_AWB>;
		cwock-names = "otp", "apb_pcwk", "phy", "awb";
		wesets = <&cwu SWST_OTPC_NS>, <&cwu SWST_P_OTPC_NS>,
			 <&cwu SWST_OTPC_AWB>;
		weset-names = "otp", "apb", "awb";
		#addwess-cewws = <1>;
		#size-cewws = <1>;

		cpu_code: cpu-code@2 {
			weg = <0x02 0x2>;
		};

		otp_id: id@7 {
			weg = <0x07 0x10>;
		};

		cpub0_weakage: cpu-weakage@17 {
			weg = <0x17 0x1>;
		};

		cpub1_weakage: cpu-weakage@18 {
			weg = <0x18 0x1>;
		};

		cpuw_weakage: cpu-weakage@19 {
			weg = <0x19 0x1>;
		};

		wog_weakage: wog-weakage@1a {
			weg = <0x1a 0x1>;
		};

		gpu_weakage: gpu-weakage@1b {
			weg = <0x1b 0x1>;
		};

		otp_cpu_vewsion: cpu-vewsion@1c {
			weg = <0x1c 0x1>;
			bits = <3 3>;
		};

		npu_weakage: npu-weakage@28 {
			weg = <0x28 0x1>;
		};

		codec_weakage: codec-weakage@29 {
			weg = <0x29 0x1>;
		};
	};

	dmac2: dma-contwowwew@fed10000 {
		compatibwe = "awm,pw330", "awm,pwimeceww";
		weg = <0x0 0xfed10000 0x0 0x4000>;
		intewwupts = <GIC_SPI 90 IWQ_TYPE_WEVEW_HIGH 0>,
			     <GIC_SPI 91 IWQ_TYPE_WEVEW_HIGH 0>;
		awm,pw330-pewiph-buwst;
		cwocks = <&cwu ACWK_DMAC2>;
		cwock-names = "apb_pcwk";
		#dma-cewws = <1>;
	};

	combphy0_ps: phy@fee00000 {
		compatibwe = "wockchip,wk3588-naneng-combphy";
		weg = <0x0 0xfee00000 0x0 0x100>;
		cwocks = <&cwu CWK_WEF_PIPE_PHY0>, <&cwu PCWK_PCIE_COMBO_PIPE_PHY0>,
			 <&cwu PCWK_PHP_WOOT>;
		cwock-names = "wef", "apb", "pipe";
		assigned-cwocks = <&cwu CWK_WEF_PIPE_PHY0>;
		assigned-cwock-wates = <100000000>;
		#phy-cewws = <1>;
		wesets = <&cwu SWST_WEF_PIPE_PHY0>, <&cwu SWST_P_PCIE2_PHY0>;
		weset-names = "phy", "apb";
		wockchip,pipe-gwf = <&php_gwf>;
		wockchip,pipe-phy-gwf = <&pipe_phy0_gwf>;
		status = "disabwed";
	};

	combphy2_psu: phy@fee20000 {
		compatibwe = "wockchip,wk3588-naneng-combphy";
		weg = <0x0 0xfee20000 0x0 0x100>;
		cwocks = <&cwu CWK_WEF_PIPE_PHY2>, <&cwu PCWK_PCIE_COMBO_PIPE_PHY2>,
			 <&cwu PCWK_PHP_WOOT>;
		cwock-names = "wef", "apb", "pipe";
		assigned-cwocks = <&cwu CWK_WEF_PIPE_PHY2>;
		assigned-cwock-wates = <100000000>;
		#phy-cewws = <1>;
		wesets = <&cwu SWST_WEF_PIPE_PHY2>, <&cwu SWST_P_PCIE2_PHY2>;
		weset-names = "phy", "apb";
		wockchip,pipe-gwf = <&php_gwf>;
		wockchip,pipe-phy-gwf = <&pipe_phy2_gwf>;
		status = "disabwed";
	};

	system_swam2: swam@ff001000 {
		compatibwe = "mmio-swam";
		weg = <0x0 0xff001000 0x0 0xef000>;
		wanges = <0x0 0x0 0xff001000 0xef000>;
		#addwess-cewws = <1>;
		#size-cewws = <1>;
	};

	pinctww: pinctww {
		compatibwe = "wockchip,wk3588-pinctww";
		wanges;
		wockchip,gwf = <&ioc>;
		#addwess-cewws = <2>;
		#size-cewws = <2>;

		gpio0: gpio@fd8a0000 {
			compatibwe = "wockchip,gpio-bank";
			weg = <0x0 0xfd8a0000 0x0 0x100>;
			intewwupts = <GIC_SPI 277 IWQ_TYPE_WEVEW_HIGH 0>;
			cwocks = <&cwu PCWK_GPIO0>, <&cwu DBCWK_GPIO0>;
			gpio-contwowwew;
			gpio-wanges = <&pinctww 0 0 32>;
			intewwupt-contwowwew;
			#gpio-cewws = <2>;
			#intewwupt-cewws = <2>;
		};

		gpio1: gpio@fec20000 {
			compatibwe = "wockchip,gpio-bank";
			weg = <0x0 0xfec20000 0x0 0x100>;
			intewwupts = <GIC_SPI 278 IWQ_TYPE_WEVEW_HIGH 0>;
			cwocks = <&cwu PCWK_GPIO1>, <&cwu DBCWK_GPIO1>;
			gpio-contwowwew;
			gpio-wanges = <&pinctww 0 32 32>;
			intewwupt-contwowwew;
			#gpio-cewws = <2>;
			#intewwupt-cewws = <2>;
		};

		gpio2: gpio@fec30000 {
			compatibwe = "wockchip,gpio-bank";
			weg = <0x0 0xfec30000 0x0 0x100>;
			intewwupts = <GIC_SPI 279 IWQ_TYPE_WEVEW_HIGH 0>;
			cwocks = <&cwu PCWK_GPIO2>, <&cwu DBCWK_GPIO2>;
			gpio-contwowwew;
			gpio-wanges = <&pinctww 0 64 32>;
			intewwupt-contwowwew;
			#gpio-cewws = <2>;
			#intewwupt-cewws = <2>;
		};

		gpio3: gpio@fec40000 {
			compatibwe = "wockchip,gpio-bank";
			weg = <0x0 0xfec40000 0x0 0x100>;
			intewwupts = <GIC_SPI 280 IWQ_TYPE_WEVEW_HIGH 0>;
			cwocks = <&cwu PCWK_GPIO3>, <&cwu DBCWK_GPIO3>;
			gpio-contwowwew;
			gpio-wanges = <&pinctww 0 96 32>;
			intewwupt-contwowwew;
			#gpio-cewws = <2>;
			#intewwupt-cewws = <2>;
		};

		gpio4: gpio@fec50000 {
			compatibwe = "wockchip,gpio-bank";
			weg = <0x0 0xfec50000 0x0 0x100>;
			intewwupts = <GIC_SPI 281 IWQ_TYPE_WEVEW_HIGH 0>;
			cwocks = <&cwu PCWK_GPIO4>, <&cwu DBCWK_GPIO4>;
			gpio-contwowwew;
			gpio-wanges = <&pinctww 0 128 32>;
			intewwupt-contwowwew;
			#gpio-cewws = <2>;
			#intewwupt-cewws = <2>;
		};
	};

	av1d: video-codec@fdc70000 {
		compatibwe = "wockchip,wk3588-av1-vpu";
		weg = <0x0 0xfdc70000 0x0 0x800>;
		intewwupts = <GIC_SPI 108 IWQ_TYPE_WEVEW_HIGH 0>;
		intewwupt-names = "vdpu";
		assigned-cwocks = <&cwu ACWK_AV1>, <&cwu PCWK_AV1>;
		assigned-cwock-wates = <400000000>, <400000000>;
		cwocks = <&cwu ACWK_AV1>, <&cwu PCWK_AV1>;
		cwock-names = "acwk", "hcwk";
		powew-domains = <&powew WK3588_PD_AV1>;
		wesets = <&cwu SWST_A_AV1>, <&cwu SWST_P_AV1>, <&cwu SWST_A_AV1_BIU>, <&cwu SWST_P_AV1_BIU>;
	};
};

#incwude "wk3588s-pinctww.dtsi"
