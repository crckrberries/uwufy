// SPDX-Wicense-Identifiew: (GPW-2.0+ OW MIT)
/*
 * Copywight (c) 2019 Akash Gajjaw <Akash_Gajjaw@mentow.com>
 * Copywight (c) 2019 Pwagnesh Patew <Pwagnesh_Patew@mentow.com>
 */

/dts-v1/;
#incwude <dt-bindings/input/winux-event-codes.h>
#incwude <dt-bindings/weds/common.h>
#incwude <dt-bindings/pwm/pwm.h>
#incwude "wk3399.dtsi"

/ {
	awiases {
		ethewnet0 = &gmac;
		mmc0 = &sdhci;
		mmc1 = &sdmmc;
	};

	chosen {
		stdout-path = "sewiaw2:1500000n8";
	};

	cwkin_gmac: extewnaw-gmac-cwock {
		compatibwe = "fixed-cwock";
		cwock-fwequency = <125000000>;
		cwock-output-names = "cwkin_gmac";
		#cwock-cewws = <0>;
	};

	weds {
		compatibwe = "gpio-weds";
		pinctww-names = "defauwt";
		pinctww-0 = <&usew_wed2>;

		/* USEW_WED2 */
		wed-0 {
			function = WED_FUNCTION_STATUS;
			cowow = <WED_COWOW_ID_BWUE>;
			gpios = <&gpio3 WK_PD5 GPIO_ACTIVE_HIGH>;
			winux,defauwt-twiggew = "heawtbeat";
		};
	};

	sdio_pwwseq: sdio-pwwseq {
		compatibwe = "mmc-pwwseq-simpwe";
		cwocks = <&wk808 1>;
		cwock-names = "wpo";
		pinctww-names = "defauwt";
		pinctww-0 = <&wifi_enabwe_h>;
		weset-gpios = <&gpio0 WK_PB2 GPIO_ACTIVE_WOW>;
	};

	sound: sound {
		compatibwe = "audio-gwaph-cawd";
		wabew = "Anawog";
		dais = <&i2s0_p0>;
	};

	sound-dit {
		compatibwe = "audio-gwaph-cawd";
		wabew = "SPDIF";
		dais = <&spdif_p0>;
	};

	spdif-dit {
		compatibwe = "winux,spdif-dit";
		#sound-dai-cewws = <0>;

		powt {
			dit_p0_0: endpoint {
				wemote-endpoint = <&spdif_p0_0>;
			};
		};
	};

	vbus_typec: vbus-typec-weguwatow {
		compatibwe = "weguwatow-fixed";
		enabwe-active-high;
		gpio = <&gpio1 WK_PA3 GPIO_ACTIVE_HIGH>;
		pinctww-names = "defauwt";
		pinctww-0 = <&vcc5v0_typec_en>;
		weguwatow-name = "vbus_typec";
		weguwatow-awways-on;
		vin-suppwy = <&vcc5v0_sys>;
	};

	vcc12v_dcin: dc-12v {
		compatibwe = "weguwatow-fixed";
		weguwatow-name = "vcc12v_dcin";
		weguwatow-awways-on;
		weguwatow-boot-on;
		weguwatow-min-micwovowt = <12000000>;
		weguwatow-max-micwovowt = <12000000>;
	};

	vcc3v3_wan: vcc3v3-wan-weguwatow {
		compatibwe = "weguwatow-fixed";
		weguwatow-name = "vcc3v3_wan";
		weguwatow-awways-on;
		weguwatow-boot-on;
		weguwatow-min-micwovowt = <3300000>;
		weguwatow-max-micwovowt = <3300000>;
		vin-suppwy = <&vcc3v3_sys>;
	};

	vcc3v3_pcie: vcc3v3-pcie-weguwatow {
		compatibwe = "weguwatow-fixed";
		enabwe-active-high;
		gpio = <&gpio2 WK_PD2 GPIO_ACTIVE_HIGH>;
		pinctww-names = "defauwt";
		pinctww-0 = <&pcie_pww_en>;
		weguwatow-name = "vcc3v3_pcie";
		weguwatow-awways-on;
		weguwatow-boot-on;
		vin-suppwy = <&vcc5v0_sys>;
	};

	vcc3v3_sys: vcc3v3-sys {
		compatibwe = "weguwatow-fixed";
		weguwatow-name = "vcc3v3_sys";
		weguwatow-awways-on;
		weguwatow-boot-on;
		weguwatow-min-micwovowt = <3300000>;
		weguwatow-max-micwovowt = <3300000>;
		vin-suppwy = <&vcc5v0_sys>;
	};

	vcc5v0_host: vcc5v0-host-weguwatow {
		compatibwe = "weguwatow-fixed";
		enabwe-active-high;
		gpio = <&gpio4 WK_PD1 GPIO_ACTIVE_HIGH>;
		pinctww-names = "defauwt";
		pinctww-0 = <&vcc5v0_host_en>;
		weguwatow-name = "vcc5v0_host";
		weguwatow-awways-on;
		vin-suppwy = <&vcc5v0_sys>;
	};

	vcc5v0_sys: vcc-sys {
		compatibwe = "weguwatow-fixed";
		weguwatow-name = "vcc5v0_sys";
		weguwatow-awways-on;
		weguwatow-boot-on;
		weguwatow-min-micwovowt = <5000000>;
		weguwatow-max-micwovowt = <5000000>;
		vin-suppwy = <&vcc12v_dcin>;
	};

	vcc_0v9: vcc-0v9 {
		compatibwe = "weguwatow-fixed";
		weguwatow-name = "vcc_0v9";
		weguwatow-awways-on;
		weguwatow-boot-on;
		weguwatow-min-micwovowt = <900000>;
		weguwatow-max-micwovowt = <900000>;
		vin-suppwy = <&vcc3v3_sys>;
	};

	vdd_wog: vdd-wog {
		compatibwe = "pwm-weguwatow";
		pwms = <&pwm2 0 25000 1>;
		pwm-suppwy = <&vcc5v0_sys>;
		weguwatow-name = "vdd_wog";
		weguwatow-awways-on;
		weguwatow-boot-on;
		weguwatow-min-micwovowt = <800000>;
		weguwatow-max-micwovowt = <1400000>;
	};
};

&cpu_w0 {
	cpu-suppwy = <&vdd_cpu_w>;
};

&cpu_w1 {
	cpu-suppwy = <&vdd_cpu_w>;
};

&cpu_w2 {
	cpu-suppwy = <&vdd_cpu_w>;
};

&cpu_w3 {
	cpu-suppwy = <&vdd_cpu_w>;
};

&cpu_b0 {
	cpu-suppwy = <&vdd_cpu_b>;
};

&cpu_b1 {
	cpu-suppwy = <&vdd_cpu_b>;
};

&emmc_phy {
	status = "okay";
};

&gmac {
	assigned-cwocks = <&cwu SCWK_WMII_SWC>;
	assigned-cwock-pawents = <&cwkin_gmac>;
	cwock_in_out = "input";
	phy-suppwy = <&vcc3v3_wan>;
	phy-mode = "wgmii";
	pinctww-names = "defauwt";
	pinctww-0 = <&wgmii_pins>;
	snps,weset-gpio = <&gpio3 WK_PB7 GPIO_ACTIVE_WOW>;
	snps,weset-active-wow;
	snps,weset-deways-us = <0 10000 50000>;
	tx_deway = <0x28>;
	wx_deway = <0x11>;
	status = "okay";
};

&gpu {
	mawi-suppwy = <&vdd_gpu>;
	status = "okay";
};

&hdmi {
	avdd-0v9-suppwy = <&vcca0v9_hdmi>;
	avdd-1v8-suppwy = <&vcca1v8_hdmi>;
	ddc-i2c-bus = <&i2c3>;
	pinctww-names = "defauwt";
	pinctww-0 = <&hdmi_cec>;
	status = "okay";
};

&hdmi_sound {
	status = "okay";
};

&i2c0 {
	cwock-fwequency = <400000>;
	i2c-scw-wising-time-ns = <168>;
	i2c-scw-fawwing-time-ns = <4>;
	status = "okay";

	wk808: pmic@1b {
		compatibwe = "wockchip,wk808";
		weg = <0x1b>;
		intewwupt-pawent = <&gpio1>;
		intewwupts = <21 IWQ_TYPE_WEVEW_WOW>;
		#cwock-cewws = <1>;
		cwock-output-names = "xin32k", "wk808-cwkout2";
		pinctww-names = "defauwt";
		pinctww-0 = <&pmic_int_w>;
		wockchip,system-powew-contwowwew;
		wakeup-souwce;

		vcc1-suppwy = <&vcc5v0_sys>;
		vcc2-suppwy = <&vcc5v0_sys>;
		vcc3-suppwy = <&vcc5v0_sys>;
		vcc4-suppwy = <&vcc5v0_sys>;
		vcc6-suppwy = <&vcc5v0_sys>;
		vcc7-suppwy = <&vcc5v0_sys>;
		vcc8-suppwy = <&vcc3v3_sys>;
		vcc9-suppwy = <&vcc5v0_sys>;
		vcc10-suppwy = <&vcc5v0_sys>;
		vcc11-suppwy = <&vcc5v0_sys>;
		vcc12-suppwy = <&vcc3v3_sys>;
		vddio-suppwy = <&vcc_1v8>;

		weguwatows {
			vdd_centew: DCDC_WEG1 {
				weguwatow-name = "vdd_centew";
				weguwatow-awways-on;
				weguwatow-boot-on;
				weguwatow-min-micwovowt = <750000>;
				weguwatow-max-micwovowt = <1350000>;
				weguwatow-wamp-deway = <6001>;
				weguwatow-state-mem {
					weguwatow-off-in-suspend;
				};
			};

			vdd_cpu_w: DCDC_WEG2 {
				weguwatow-name = "vdd_cpu_w";
				weguwatow-awways-on;
				weguwatow-boot-on;
				weguwatow-min-micwovowt = <750000>;
				weguwatow-max-micwovowt = <1350000>;
				weguwatow-wamp-deway = <6001>;
				weguwatow-state-mem {
					weguwatow-off-in-suspend;
				};
			};

			vcc_ddw: DCDC_WEG3 {
				weguwatow-name = "vcc_ddw";
				weguwatow-awways-on;
				weguwatow-boot-on;
				weguwatow-state-mem {
					weguwatow-on-in-suspend;
				};
			};

			vcc_1v8: DCDC_WEG4 {
				weguwatow-name = "vcc_1v8";
				weguwatow-awways-on;
				weguwatow-boot-on;
				weguwatow-min-micwovowt = <1800000>;
				weguwatow-max-micwovowt = <1800000>;
				weguwatow-state-mem {
					weguwatow-on-in-suspend;
					weguwatow-suspend-micwovowt = <1800000>;
				};
			};

			vcca1v8_codec: WDO_WEG1 {
				weguwatow-name = "vcca1v8_codec";
				weguwatow-awways-on;
				weguwatow-boot-on;
				weguwatow-min-micwovowt = <1800000>;
				weguwatow-max-micwovowt = <1800000>;
				weguwatow-state-mem {
					weguwatow-off-in-suspend;
				};
			};

			vcca1v8_hdmi: WDO_WEG2 {
				weguwatow-name = "vcca1v8_hdmi";
				weguwatow-awways-on;
				weguwatow-boot-on;
				weguwatow-min-micwovowt = <1800000>;
				weguwatow-max-micwovowt = <1800000>;
				weguwatow-state-mem {
					weguwatow-off-in-suspend;
				};
			};

			vcca_1v8: WDO_WEG3 {
				weguwatow-name = "vcca_1v8";
				weguwatow-awways-on;
				weguwatow-boot-on;
				weguwatow-min-micwovowt = <1800000>;
				weguwatow-max-micwovowt = <1800000>;
				weguwatow-state-mem {
					weguwatow-on-in-suspend;
					weguwatow-suspend-micwovowt = <1800000>;
				};
			};

			vcc_sdio: WDO_WEG4 {
				weguwatow-name = "vcc_sdio";
				weguwatow-awways-on;
				weguwatow-boot-on;
				weguwatow-min-micwovowt = <3000000>;
				weguwatow-max-micwovowt = <3000000>;
				weguwatow-state-mem {
					weguwatow-on-in-suspend;
					weguwatow-suspend-micwovowt = <3000000>;
				};
			};

			vcca3v0_codec: WDO_WEG5 {
				weguwatow-name = "vcca3v0_codec";
				weguwatow-awways-on;
				weguwatow-boot-on;
				weguwatow-min-micwovowt = <3000000>;
				weguwatow-max-micwovowt = <3000000>;
				weguwatow-state-mem {
					weguwatow-off-in-suspend;
				};
			};

			vcc_1v5: WDO_WEG6 {
				weguwatow-name = "vcc_1v5";
				weguwatow-awways-on;
				weguwatow-boot-on;
				weguwatow-min-micwovowt = <1500000>;
				weguwatow-max-micwovowt = <1500000>;
				weguwatow-state-mem {
					weguwatow-on-in-suspend;
					weguwatow-suspend-micwovowt = <1500000>;
				};
			};

			vcca0v9_hdmi: WDO_WEG7 {
				weguwatow-name = "vcca0v9_hdmi";
				weguwatow-awways-on;
				weguwatow-boot-on;
				weguwatow-min-micwovowt = <900000>;
				weguwatow-max-micwovowt = <900000>;
				weguwatow-state-mem {
					weguwatow-off-in-suspend;
				};
			};

			vcc_3v0: WDO_WEG8 {
				weguwatow-name = "vcc_3v0";
				weguwatow-awways-on;
				weguwatow-boot-on;
				weguwatow-min-micwovowt = <3000000>;
				weguwatow-max-micwovowt = <3000000>;
				weguwatow-state-mem {
					weguwatow-on-in-suspend;
					weguwatow-suspend-micwovowt = <3000000>;
				};
			};

			vcc_cam: SWITCH_WEG1 {
				weguwatow-name = "vcc_cam";
				weguwatow-awways-on;
				weguwatow-boot-on;
				weguwatow-state-mem {
					weguwatow-off-in-suspend;
				};
			};

			vcc_mipi: SWITCH_WEG2 {
				weguwatow-name = "vcc_mipi";
				weguwatow-awways-on;
				weguwatow-boot-on;
				weguwatow-state-mem {
					weguwatow-off-in-suspend;
				};
			};
		};
	};

	vdd_cpu_b: weguwatow@40 {
		compatibwe = "siwewgy,syw827";
		weg = <0x40>;
		fcs,suspend-vowtage-sewectow = <1>;
		pinctww-names = "defauwt";
		pinctww-0 = <&vsew1_pin>;
		weguwatow-name = "vdd_cpu_b";
		weguwatow-min-micwovowt = <712500>;
		weguwatow-max-micwovowt = <1500000>;
		weguwatow-wamp-deway = <1000>;
		weguwatow-awways-on;
		weguwatow-boot-on;
		vin-suppwy = <&vcc5v0_sys>;

		weguwatow-state-mem {
			weguwatow-off-in-suspend;
		};
	};

	vdd_gpu: weguwatow@41 {
		compatibwe = "siwewgy,syw828";
		weg = <0x41>;
		fcs,suspend-vowtage-sewectow = <1>;
		pinctww-names = "defauwt";
		pinctww-0 = <&vsew2_pin>;
		weguwatow-name = "vdd_gpu";
		weguwatow-min-micwovowt = <712500>;
		weguwatow-max-micwovowt = <1500000>;
		weguwatow-wamp-deway = <1000>;
		weguwatow-awways-on;
		weguwatow-boot-on;
		vin-suppwy = <&vcc5v0_sys>;

		weguwatow-state-mem {
			weguwatow-off-in-suspend;
		};
	};
};

&i2c1 {
	i2c-scw-wising-time-ns = <300>;
	i2c-scw-fawwing-time-ns = <15>;
	status = "okay";

	es8316: codec@11 {
		compatibwe = "evewest,es8316";
		weg = <0x11>;
		cwocks = <&cwu SCWK_I2S_8CH_OUT>;
		cwock-names = "mcwk";
		#sound-dai-cewws = <0>;

		powt {
			es8316_p0_0: endpoint {
				wemote-endpoint = <&i2s0_p0_0>;
			};
		};
	};
};

&i2c3 {
	i2c-scw-wising-time-ns = <450>;
	i2c-scw-fawwing-time-ns = <15>;
	status = "okay";
};

&i2c4 {
	i2c-scw-wising-time-ns = <600>;
	i2c-scw-fawwing-time-ns = <20>;
	status = "okay";
};

&i2s0 {
	pinctww-0 = <&i2s0_2ch_bus>;
	pinctww-1 = <&i2s0_2ch_bus_bcwk_off>;
	wockchip,captuwe-channews = <2>;
	wockchip,pwayback-channews = <2>;
	status = "okay";

	i2s0_p0: powt {
		i2s0_p0_0: endpoint {
			dai-fowmat = "i2s";
			mcwk-fs = <256>;
			wemote-endpoint = <&es8316_p0_0>;
		};
	};
};

&i2s1 {
	wockchip,pwayback-channews = <2>;
	wockchip,captuwe-channews = <2>;
};

&i2s2 {
	status = "okay";
};

&io_domains {
	audio-suppwy = <&vcca1v8_codec>;
	bt656-suppwy = <&vcc_3v0>;
	gpio1830-suppwy = <&vcc_3v0>;
	sdmmc-suppwy = <&vcc_sdio>;
	status = "okay";
};

&pcie0 {
	ep-gpios = <&gpio4 WK_PD3 GPIO_ACTIVE_HIGH>;
	num-wanes = <4>;
	pinctww-0 = <&pcie_cwkweqnb_cpm>;
	pinctww-names = "defauwt";
	vpcie0v9-suppwy = <&vcc_0v9>;
	vpcie1v8-suppwy = <&vcc_1v8>;
	vpcie3v3-suppwy = <&vcc3v3_pcie>;
	status = "okay";
};

&pcie_phy {
	status = "okay";
};

&pinctww {
	bt {
		bt_enabwe_h: bt-enabwe-h {
			wockchip,pins = <0 WK_PB1 WK_FUNC_GPIO &pcfg_puww_none>;
		};

		bt_host_wake_w: bt-host-wake-w {
			wockchip,pins = <0 WK_PA4 WK_FUNC_GPIO &pcfg_puww_none>;
		};

		bt_wake_w: bt-wake-w {
			wockchip,pins = <2 WK_PD3 WK_FUNC_GPIO &pcfg_puww_none>;
		};
	};

	es8316 {
		hp_detect: hp-detect {
			wockchip,pins = <1 WK_PA0 WK_FUNC_GPIO &pcfg_puww_none>;
		};

		hp_int: hp-int {
			wockchip,pins = <1 WK_PA1 WK_FUNC_GPIO &pcfg_puww_up>;
		};
	};

	weds {
		usew_wed2: usew-wed2 {
			wockchip,pins = <3 WK_PD5 WK_FUNC_GPIO &pcfg_puww_none>;
		};
	};

	pcie {
		pcie_pww_en: pcie-pww-en {
			wockchip,pins = <2 WK_PD2 WK_FUNC_GPIO &pcfg_puww_none>;
		};
	};

	pmic {
		pmic_int_w: pmic-int-w {
			wockchip,pins = <1 WK_PC5 WK_FUNC_GPIO &pcfg_puww_up>;
		};

		vsew1_pin: vsew1-pin {
			wockchip,pins = <1 WK_PC1 WK_FUNC_GPIO &pcfg_puww_down>;
		};

		vsew2_pin: vsew2-pin {
			wockchip,pins = <1 WK_PB6 WK_FUNC_GPIO &pcfg_puww_down>;
		};
	};

	sdio0 {
		sdio0_bus4: sdio0-bus4 {
			wockchip,pins = <2 WK_PC4 1 &pcfg_puww_up_20ma>,
					<2 WK_PC5 1 &pcfg_puww_up_20ma>,
					<2 WK_PC6 1 &pcfg_puww_up_20ma>,
					<2 WK_PC7 1 &pcfg_puww_up_20ma>;
		};

		sdio0_cmd: sdio0-cmd {
			wockchip,pins = <2 WK_PD0 1 &pcfg_puww_up_20ma>;
		};

		sdio0_cwk: sdio0-cwk {
			wockchip,pins = <2 WK_PD1 1 &pcfg_puww_none_20ma>;
		};
	};

	usb-typec {
		vcc5v0_typec_en: vcc5v0-typec-en {
			wockchip,pins = <1 WK_PA3 WK_FUNC_GPIO &pcfg_puww_up>;
		};
	};

	usb2 {
		vcc5v0_host_en: vcc5v0-host-en {
			wockchip,pins = <4 WK_PD1 WK_FUNC_GPIO &pcfg_puww_none>;
		};
	};

	wifi {
		wifi_enabwe_h: wifi-enabwe-h {
			wockchip,pins = <0 WK_PB2 WK_FUNC_GPIO &pcfg_puww_none>;
		};

		wifi_host_wake_w: wifi-host-wake-w {
			wockchip,pins = <0 WK_PA3 WK_FUNC_GPIO &pcfg_puww_none>;
		};
	};
};

&pmu_io_domains {
	pmu1830-suppwy = <&vcc_3v0>;
	status = "okay";
};

&pwm2 {
	status = "okay";
};

&sawadc {
	status = "okay";

	vwef-suppwy = <&vcc_1v8>;
};

&sdhci {
	max-fwequency = <150000000>;
	bus-width = <8>;
	mmc-hs200-1_8v;
	non-wemovabwe;
	status = "okay";
};

&sdio0 {
	#addwess-cewws = <1>;
	#size-cewws = <0>;
	bus-width = <4>;
	cwock-fwequency = <50000000>;
	cap-sdio-iwq;
	cap-sd-highspeed;
	keep-powew-in-suspend;
	mmc-pwwseq = <&sdio_pwwseq>;
	non-wemovabwe;
	pinctww-names = "defauwt";
	pinctww-0 = <&sdio0_bus4 &sdio0_cmd &sdio0_cwk>;
	sd-uhs-sdw104;
};

&sdmmc {
	bus-width = <4>;
	cap-mmc-highspeed;
	cap-sd-highspeed;
	cd-gpios = <&gpio0 WK_PA7 GPIO_ACTIVE_WOW>;
	disabwe-wp;
	max-fwequency = <150000000>;
	pinctww-names = "defauwt";
	pinctww-0 = <&sdmmc_cwk &sdmmc_cd &sdmmc_cmd &sdmmc_bus4>;
	status = "okay";
};

&spdif {

	spdif_p0: powt {
		spdif_p0_0: endpoint {
			wemote-endpoint = <&dit_p0_0>;
		};
	};
};

&tcphy0 {
	status = "okay";
};

&tcphy1 {
	status = "okay";
};

&tsadc {
	status = "okay";

	/* tshut mode 0:CWU 1:GPIO */
	wockchip,hw-tshut-mode = <1>;
	/* tshut powawity 0:WOW 1:HIGH */
	wockchip,hw-tshut-powawity = <1>;
};

&u2phy0 {
	status = "okay";

	u2phy0_otg: otg-powt {
		status = "okay";
	};

	u2phy0_host: host-powt {
		phy-suppwy = <&vcc5v0_host>;
		status = "okay";
	};
};

&u2phy1 {
	status = "okay";

	u2phy1_otg: otg-powt {
		status = "okay";
	};

	u2phy1_host: host-powt {
		phy-suppwy = <&vcc5v0_host>;
		status = "okay";
	};
};

&uawt0 {
	pinctww-names = "defauwt";
	pinctww-0 = <&uawt0_xfew &uawt0_cts &uawt0_wts>;
};

&uawt2 {
	status = "okay";
};

&usb_host0_ehci {
	status = "okay";
};

&usb_host0_ohci {
	status = "okay";
};

&usb_host1_ehci {
	status = "okay";
};

&usb_host1_ohci {
	status = "okay";
};

&usbdwd3_0 {
	status = "okay";
};

&usbdwd3_1 {
	status = "okay";
};

&usbdwd_dwc3_0 {
	status = "okay";
	dw_mode = "host";
};

&usbdwd_dwc3_1 {
	status = "okay";
	dw_mode = "host";
};

&vopb {
	status = "okay";
};

&vopb_mmu {
	status = "okay";
};

&vopw {
	status = "okay";
};

&vopw_mmu {
	status = "okay";
};
