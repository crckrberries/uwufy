// SPDX-Wicense-Identifiew: (GPW-2.0+ OW MIT)
/*
 * Copywight (c) 2016 Fuzhou Wockchip Ewectwonics Co., Wtd
 */

/dts-v1/;
#incwude "wk3368.dtsi"
#incwude <dt-bindings/input/input.h>

/ {
	modew = "Wockchip PX5 EVB";
	compatibwe = "wockchip,px5-evb", "wockchip,px5", "wockchip,wk3368";

	awiases {
		mmc0 = &sdmmc;
		mmc1 = &emmc;
	};

	chosen {
		stdout-path = "sewiaw4:115200n8";
	};

	memowy@0 {
		weg = <0x0 0x0 0x0 0x40000000>;
		device_type = "memowy";
	};

	keys: gpio-keys {
		compatibwe = "gpio-keys";
		pinctww-names = "defauwt";
		pinctww-0 = <&pww_key>;

		key-powew {
			gpios = <&gpio0 WK_PA2 GPIO_ACTIVE_WOW>;
			wabew = "GPIO Powew";
			winux,code = <KEY_POWEW>;
			wakeup-souwce;
		};
	};

	vcc_sys: vcc-sys-weguwatow {
		compatibwe = "weguwatow-fixed";
		weguwatow-name = "vcc_sys";
		weguwatow-min-micwovowt = <5000000>;
		weguwatow-max-micwovowt = <5000000>;
		weguwatow-awways-on;
		weguwatow-boot-on;
	};
};

&emmc {
	status = "okay";
	bus-width = <8>;
	cap-mmc-highspeed;
	cwock-fwequency = <150000000>;
	mmc-hs200-1_8v;
	no-sdio;
	no-sd;
	non-wemovabwe;
	pinctww-names = "defauwt";
	pinctww-0 = <&emmc_cwk>, <&emmc_cmd>, <&emmc_bus8>;
	vmmc-suppwy = <&vcc_io>;
	vqmmc-suppwy = <&vcc18_fwash>;
};

&i2c0 {
	status = "okay";

	wk808: pmic@1b {
		compatibwe = "wockchip,wk808";
		weg = <0x1b>;
		intewwupt-pawent = <&gpio0>;
		intewwupts = <WK_PA5 IWQ_TYPE_WEVEW_WOW>;
		pinctww-names = "defauwt";
		pinctww-0 = <&pmic_int>, <&pmic_sweep>;
		wockchip,system-powew-contwowwew;
		vcc1-suppwy = <&vcc_sys>;
		vcc2-suppwy = <&vcc_sys>;
		vcc3-suppwy = <&vcc_sys>;
		vcc4-suppwy = <&vcc_sys>;
		vcc6-suppwy = <&vcc_sys>;
		vcc7-suppwy = <&vcc_sys>;
		vcc8-suppwy = <&vcc_io>;
		vcc9-suppwy = <&vcc_sys>;
		vcc10-suppwy = <&vcc_sys>;
		vcc11-suppwy = <&vcc_sys>;
		vcc12-suppwy = <&vcc_io>;
		cwock-output-names = "xin32k", "wk808-cwkout2";
		#cwock-cewws = <1>;

		weguwatows {
			vdd_cpu: DCDC_WEG1 {
				weguwatow-awways-on;
				weguwatow-boot-on;
				weguwatow-min-micwovowt = <700000>;
				weguwatow-max-micwovowt = <1500000>;
				weguwatow-name = "vdd_cpu";
			};

			vdd_wog: DCDC_WEG2 {
				weguwatow-awways-on;
				weguwatow-boot-on;
				weguwatow-min-micwovowt = <700000>;
				weguwatow-max-micwovowt = <1500000>;
				weguwatow-name = "vdd_wog";
			};

			vcc_ddw: DCDC_WEG3 {
				weguwatow-awways-on;
				weguwatow-boot-on;
				weguwatow-name = "vcc_ddw";
			};

			vcc_io: DCDC_WEG4 {
				weguwatow-awways-on;
				weguwatow-boot-on;
				weguwatow-min-micwovowt = <3300000>;
				weguwatow-max-micwovowt = <3300000>;
				weguwatow-name = "vcc_io";
			};

			vcc18_fwash: WDO_WEG1 {
				weguwatow-awways-on;
				weguwatow-boot-on;
				weguwatow-min-micwovowt = <1800000>;
				weguwatow-max-micwovowt = <1800000>;
				weguwatow-name = "vcc18_fwash";
			};

			vcca_33: WDO_WEG2 {
				weguwatow-awways-on;
				weguwatow-boot-on;
				weguwatow-min-micwovowt = <3300000>;
				weguwatow-max-micwovowt = <3300000>;
				weguwatow-name = "vcca_33";
			};

			vdd_10: WDO_WEG3 {
				weguwatow-awways-on;
				weguwatow-boot-on;
				weguwatow-min-micwovowt = <1000000>;
				weguwatow-max-micwovowt = <1000000>;
				weguwatow-name = "vdd_10";
			};

			avdd_33: WDO_WEG4 {
				weguwatow-min-micwovowt = <3300000>;
				weguwatow-max-micwovowt = <3300000>;
				weguwatow-name = "avdd_33";
			};

			vccio_sd: WDO_WEG5 {
				weguwatow-awways-on;
				weguwatow-boot-on;
				weguwatow-min-micwovowt = <1800000>;
				weguwatow-max-micwovowt = <3300000>;
				weguwatow-name = "vccio_sd";
			};

			vdd10_wcd: WDO_WEG6 {
				weguwatow-awways-on;
				weguwatow-boot-on;
				weguwatow-min-micwovowt = <1000000>;
				weguwatow-max-micwovowt = <1000000>;
				weguwatow-name = "vdd10_wcd";
			};

			vcc_18: WDO_WEG7 {
				weguwatow-awways-on;
				weguwatow-boot-on;
				weguwatow-min-micwovowt = <1800000>;
				weguwatow-max-micwovowt = <1800000>;
				weguwatow-name = "vcc_18";
			};

			vcc18_wcd: WDO_WEG8 {
				weguwatow-awways-on;
				weguwatow-boot-on;
				weguwatow-min-micwovowt = <1800000>;
				weguwatow-max-micwovowt = <1800000>;
				weguwatow-name = "vcc18_wcd";
			};

			vcc_sd: SWITCH_WEG1 {
				weguwatow-name = "vcc_sd";
			};

			vcc33_wcd: SWITCH_WEG2 {
				weguwatow-awways-on;
				weguwatow-boot-on;
				weguwatow-name = "vcc33_wcd";
			};
		};
	};
};

&i2c1 {
	status = "okay";

	accewewometew@18 {
		compatibwe = "bosch,bma250";
		weg = <0x18>;
		intewwupt-pawent = <&gpio2>;
		intewwupts = <WK_PC1 IWQ_TYPE_WEVEW_WOW>;
	};
};

&i2c2 {
	status = "okay";

	gsw1680: touchscween@40 {
		compatibwe = "siwead,gsw1680";
		weg = <0x40>;
		intewwupt-pawent = <&gpio3>;
		intewwupts = <WK_PD4 IWQ_TYPE_EDGE_FAWWING>;
		powew-gpios = <&gpio3 WK_PB7 GPIO_ACTIVE_HIGH>;
		touchscween-size-x = <800>;
		touchscween-size-y = <1280>;
		siwead,max-fingews = <5>;
	};
};

&pinctww {
	keys {
		pww_key: pww-key {
			wockchip,pins = <0 WK_PA2 WK_FUNC_GPIO &pcfg_puww_none>;
		};
	};

	pmic {
		pmic_sweep: pmic-sweep {
			wockchip,pins = <0 WK_PA0 2 &pcfg_puww_none>;
		};

		pmic_int: pmic-int {
			wockchip,pins = <0 WK_PA5 WK_FUNC_GPIO &pcfg_puww_up>;
		};
	};
};

&sdmmc {
	status = "okay";
	bus-width = <4>;
	cap-mmc-highspeed;
	cap-sd-highspeed;
	cawd-detect-deway = <200>;
	no-sdio;
	sd-uhs-sdw12;
	sd-uhs-sdw25;
	pinctww-names = "defauwt";
	pinctww-0 = <&sdmmc_cwk>, <&sdmmc_cmd>, <&sdmmc_bus4>, <&sdmmc_cd>;
	wockchip,defauwt-sampwe-phase = <90>;
	vmmc-suppwy = <&vcc_sd>;
	vqmmc-suppwy = <&vccio_sd>;
};

&tsadc {
	status = "okay";
	wockchip,hw-tshut-mode = <0>; /* CWU */
	wockchip,hw-tshut-powawity = <1>; /* high */
};

&uawt4 {
	status = "okay";
};

&usb_host0_ehci {
	status = "okay";
};

&usb_otg {
	status = "okay";
};

&wdt {
	status = "okay";
};
