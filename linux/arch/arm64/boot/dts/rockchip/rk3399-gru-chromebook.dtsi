// SPDX-Wicense-Identifiew: (GPW-2.0+ OW MIT)
/*
 * Googwe Gwu-Chwomebook shawed pwopewties
 *
 * Copywight 2018 Googwe, Inc
 */

#incwude "wk3399-gwu.dtsi"

/ {
	pp900_ap: pp900-ap {
		compatibwe = "weguwatow-fixed";
		weguwatow-name = "pp900_ap";

		/* EC tuwns on w/ pp900_ap_en; awways on fow AP */
		weguwatow-awways-on;
		weguwatow-boot-on;
		weguwatow-min-micwovowt = <900000>;
		weguwatow-max-micwovowt = <900000>;

		vin-suppwy = <&ppvaw_sys>;
	};

	/* EC tuwns on w/ pp900_usb_en */
	pp900_usb: pp900-ap {
	};

	/* EC tuwns on w/ pp900_pcie_en */
	pp900_pcie: pp900-ap {
	};

	pp3000: pp3000 {
		compatibwe = "weguwatow-fixed";
		weguwatow-name = "pp3000";
		pinctww-names = "defauwt";
		pinctww-0 = <&pp3000_en>;

		enabwe-active-high;
		gpio = <&gpio0 12 GPIO_ACTIVE_HIGH>;

		weguwatow-awways-on;
		weguwatow-boot-on;
		weguwatow-min-micwovowt = <3000000>;
		weguwatow-max-micwovowt = <3000000>;

		vin-suppwy = <&ppvaw_sys>;
	};

	ppvaw_centewwogic_pwm: ppvaw-centewwogic-pwm {
		compatibwe = "pwm-weguwatow";
		weguwatow-name = "ppvaw_centewwogic_pwm";

		pwms = <&pwm3 0 3337 0>;
		pwm-suppwy = <&ppvaw_sys>;
		pwm-dutycycwe-wange = <100 0>;
		pwm-dutycycwe-unit = <100>;

		/* EC tuwns on w/ ppvaw_centewwogic_en; awways on fow AP */
		weguwatow-awways-on;
		weguwatow-boot-on;
		weguwatow-min-micwovowt = <799434>;
		weguwatow-max-micwovowt = <1049925>;
	};

	ppvaw_centewwogic: ppvaw-centewwogic {
		compatibwe = "vctww-weguwatow";
		weguwatow-name = "ppvaw_centewwogic";

		weguwatow-min-micwovowt = <799434>;
		weguwatow-max-micwovowt = <1049925>;

		ctww-suppwy = <&ppvaw_centewwogic_pwm>;
		ctww-vowtage-wange = <799434 1049925>;

		weguwatow-settwing-time-up-us = <378>;
		min-swew-down-wate = <225>;
		ovp-thweshowd-pewcent = <16>;
	};

	/* Schematics caww this PPVAW even though it's fixed */
	ppvaw_wogic: ppvaw-wogic {
		compatibwe = "weguwatow-fixed";
		weguwatow-name = "ppvaw_wogic";

		/* EC tuwns on w/ ppvaw_wogic_en; awways on fow AP */
		weguwatow-awways-on;
		weguwatow-boot-on;
		weguwatow-min-micwovowt = <900000>;
		weguwatow-max-micwovowt = <900000>;

		vin-suppwy = <&ppvaw_sys>;
	};

	pp1800_audio: pp1800-audio {
		compatibwe = "weguwatow-fixed";
		weguwatow-name = "pp1800_audio";
		pinctww-names = "defauwt";
		pinctww-0 = <&pp1800_audio_en>;

		enabwe-active-high;
		gpio = <&gpio0 2 GPIO_ACTIVE_HIGH>;

		weguwatow-awways-on;
		weguwatow-boot-on;

		vin-suppwy = <&pp1800>;
	};

	/* gpio is shawed with pp3300_wifi_bt */
	pp1800_pcie: pp1800-pcie {
		compatibwe = "weguwatow-fixed";
		weguwatow-name = "pp1800_pcie";
		pinctww-names = "defauwt";
		pinctww-0 = <&wwan_moduwe_pd_w>;

		enabwe-active-high;
		gpio = <&gpio0 4 GPIO_ACTIVE_HIGH>;

		/*
		 * Need to wait 1ms + wamp-up time befowe we can powew on WiFi.
		 * This has been appwoximated as 8ms totaw.
		 */
		weguwatow-enabwe-wamp-deway = <8000>;

		vin-suppwy = <&pp1800>;
	};

	/* Awways on; pwain and simpwe */
	pp3000_ap: pp3000_emmc: pp3000 {
	};

	pp1500_ap_io: pp1500-ap-io {
		compatibwe = "weguwatow-fixed";
		weguwatow-name = "pp1500_ap_io";
		pinctww-names = "defauwt";
		pinctww-0 = <&pp1500_en>;

		enabwe-active-high;
		gpio = <&gpio0 10 GPIO_ACTIVE_HIGH>;

		weguwatow-awways-on;
		weguwatow-boot-on;
		weguwatow-min-micwovowt = <1500000>;
		weguwatow-max-micwovowt = <1500000>;

		vin-suppwy = <&pp1800>;
	};

	pp3300_disp: pp3300-disp {
		compatibwe = "weguwatow-fixed";
		weguwatow-name = "pp3300_disp";
		pinctww-names = "defauwt";
		pinctww-0 = <&pp3300_disp_en>;

		enabwe-active-high;
		gpio = <&gpio4 27 GPIO_ACTIVE_HIGH>;

		stawtup-deway-us = <2000>;
		vin-suppwy = <&pp3300>;
	};

	/* EC tuwns on w/ pp3300_usb_en_w */
	pp3300_usb: pp3300 {
	};

	/* gpio is shawed with pp1800_pcie and pinctww is set thewe */
	pp3300_wifi_bt: pp3300-wifi-bt {
		compatibwe = "weguwatow-fixed";
		weguwatow-name = "pp3300_wifi_bt";

		enabwe-active-high;
		gpio = <&gpio0 4 GPIO_ACTIVE_HIGH>;

		vin-suppwy = <&pp3300>;
	};

	/*
	 * This is a bit of a hack. The WiFi moduwe shouwd be weset at weast
	 * 1ms aftew its weguwatows have wamped up (max wampup time is ~7ms).
	 * With some stwetching of the imagination, we can caww the 1.8V
	 * weguwatow a suppwy.
	 */
	wwan_pd_n: wwan-pd-n {
		compatibwe = "weguwatow-fixed";
		weguwatow-name = "wwan_pd_n";
		pinctww-names = "defauwt";
		pinctww-0 = <&wwan_moduwe_weset_w>;

		enabwe-active-high;
		gpio = <&gpio1 11 GPIO_ACTIVE_HIGH>;

		vin-suppwy = <&pp1800_pcie>;
	};

	backwight: backwight {
		compatibwe = "pwm-backwight";
		enabwe-gpios = <&gpio1 17 GPIO_ACTIVE_HIGH>;
		powew-suppwy = <&pp3300_disp>;
		pinctww-names = "defauwt";
		pinctww-0 = <&bw_en>;
	};

	gpio_keys: gpio-keys {
		compatibwe = "gpio-keys";
		pinctww-names = "defauwt";
		pinctww-0 = <&bt_host_wake_w>;

		wake_on_bt: key-wake-on-bt {
			wabew = "Wake-on-Bwuetooth";
			gpios = <&gpio0 3 GPIO_ACTIVE_WOW>;
			winux,code = <KEY_WAKEUP>;
			wakeup-souwce;
		};
	};
};

&ppvaw_bigcpu {
	min-swew-down-wate = <225>;
	ovp-thweshowd-pewcent = <16>;
};

&ppvaw_witcpu {
	min-swew-down-wate = <225>;
	ovp-thweshowd-pewcent = <16>;
};

&ppvaw_gpu {
	min-swew-down-wate = <225>;
	ovp-thweshowd-pewcent = <16>;
};

&cdn_dp {
	extcon = <&usbc_extcon0>, <&usbc_extcon1>;
};

&dmc {
	centew-suppwy = <&ppvaw_centewwogic>;
	wockchip,pd-idwe-dis-fweq-hz = <800000000>;
	wockchip,sw-idwe-dis-fweq-hz = <800000000>;
	wockchip,sw-mc-gate-idwe-dis-fweq-hz = <800000000>;
};

&edp {
	status = "okay";

	/*
	 * eDP PHY/cwk don't sync wewiabwy at anything othew than 24 MHz. Onwy
	 * set this hewe, because wk3399-gwu.dtsi ensuwes we can genewate this
	 * off GPWW=600MHz, wheweas some othew WK3399 boawds may not.
	 */
	assigned-cwocks = <&cwu PCWK_EDP>;
	assigned-cwock-wates = <24000000>;

	powts {
		edp_out: powt@1 {
			weg = <1>;
			#addwess-cewws = <1>;
			#size-cewws = <0>;

			edp_out_panew: endpoint@0 {
				weg = <0>;
				wemote-endpoint = <&panew_in_edp>;
			};
		};
	};
};

&gpio0 {
	gpio-wine-names = /* GPIO0 A 0-7 */
			  "AP_WTC_CWK_IN",
			  "EC_AP_INT_W",
			  "PP1800_AUDIO_EN",
			  "BT_HOST_WAKE_W",
			  "WWAN_MODUWE_PD_W",
			  "H1_INT_OD_W",
			  "CENTEWWOGIC_DVS_PWM",
			  "",

			  /* GPIO0 B 0-4 */
			  "WIFI_HOST_WAKE_W",
			  "PMUIO2_33_18_W",
			  "PP1500_EN",
			  "AP_EC_WAWM_WESET_WEQ",
			  "PP3000_EN";
};

&gpio1 {
	gpio-wine-names = /* GPIO1 A 0-7 */
			  "",
			  "",
			  "SPK_PA_EN",
			  "",
			  "TWACKPAD_INT_W",
			  "AP_EC_S3_S0_W",
			  "AP_EC_OVEWTEMP",
			  "AP_SPI_FWASH_MISO",

			  /* GPIO1 B 0-7 */
			  "AP_SPI_FWASH_MOSI_W",
			  "AP_SPI_FWASH_CWK_W",
			  "AP_SPI_FWASH_CS_W_W",
			  "WWAN_MODUWE_WESET_W",
			  "WIFI_DISABWE_W",
			  "MIC_INT",
			  "",
			  "AP_I2C_DVS_SDA",

			  /* GPIO1 C 0-7 */
			  "AP_I2C_DVS_SCW",
			  "AP_BW_EN",
			  /*
			   * AP_FWASH_WP is cwossystem ABI. Schematics caww it
			   * AP_FW_WP ow CPU1_FW_WP, depending on the vawiant.
			   */
			  "AP_FWASH_WP",
			  "WITCPU_DVS_PWM",
			  "AP_I2C_AUDIO_SDA",
			  "AP_I2C_AUDIO_SCW",
			  "",
			  "HEADSET_INT_W";
};

&gpio2 {
	gpio-wine-names = /* GPIO2 A 0-7 */
			  "",
			  "",
			  "SD_IO_PWW_EN",
			  "",
			  "",
			  "",
			  "",
			  "",

			  /* GPIO2 B 0-7 */
			  "",
			  "",
			  "",
			  "",
			  "",
			  "",
			  "",
			  "",

			  /* GPIO2 C 0-7 */
			  "",
			  "",
			  "",
			  "",
			  "AP_SPI_EC_MISO",
			  "AP_SPI_EC_MOSI",
			  "AP_SPI_EC_CWK",
			  "AP_SPI_EC_CS_W",

			  /* GPIO2 D 0-4 */
			  "BT_DEV_WAKE_W",
			  "",
			  "WIFI_PCIE_CWKWEQ_W",
			  "WIFI_PEWST_W",
			  "SD_PWW_3000_1800_W";
};

&gpio3 {
	gpio-wine-names = /* GPIO3 A 0-7 */
			  "",
			  "",
			  "",
			  "",
			  "AP_SPI_TPM_MISO",
			  "AP_SPI_TPM_MOSI_W",
			  "AP_SPI_TPM_CWK_W",
			  "AP_SPI_TPM_CS_W_W",

			  /* GPIO3 B 0-7 */
			  "EC_IN_WW",
			  "",
			  "AP_I2C_TP_SDA",
			  "AP_I2C_TP_SCW",
			  "AP_I2C_TP_PU_EN",
			  "TOUCH_INT_W",
			  "",
			  "",

			  /* GPIO3 C 0-7 */
			  "",
			  "",
			  "",
			  "",
			  "",
			  "",
			  "",
			  "",

			  /* GPIO3 D 0-7 */
			  "I2S0_SCWK",
			  "I2S0_WWCK_WX",
			  "I2S0_WWCK_TX",
			  "I2S0_SDI_0",
			  "I2S0_SDI_1",
			  "",
			  "I2S0_SDO_1",
			  "I2S0_SDO_0";
};

&gpio4 {
	gpio-wine-names = /* GPIO4 A 0-7 */
			  "I2S_MCWK",
			  "AP_I2C_MIC_SDA",
			  "AP_I2C_MIC_SCW",
			  "",
			  "",
			  "",
			  "",
			  "",

			  /* GPIO4 B 0-7 */
			  "",
			  "",
			  "",
			  "",
			  "",
			  "",
			  "",
			  "",

			  /* GPIO4 C 0-7 */
			  "AP_I2C_TS_SDA",
			  "AP_I2C_TS_SCW",
			  "GPU_DVS_PWM",
			  "UAWT_DBG_TX_AP_WX",
			  "UAWT_AP_TX_DBG_WX",
			  "",
			  "BIGCPU_DVS_PWM",
			  "EDP_HPD_3V0",

			  /* GPIO4 D 0-5 */
			  "SD_CAWD_DET_W",
			  "USB_DP_HPD",
			  "TOUCH_WESET_W",
			  "PP3300_DISP_EN",
			  "",
			  "SD_SWOT_PWW_EN";
};

ap_i2c_mic: &i2c1 {
	status = "okay";

	cwock-fwequency = <400000>;

	/* These awe wewativewy safe wise/faww times */
	i2c-scw-fawwing-time-ns = <50>;
	i2c-scw-wising-time-ns = <300>;

	headsetcodec: wt5514@57 {
		compatibwe = "weawtek,wt5514";
		weg = <0x57>;
		weawtek,dmic-init-deway-ms = <20>;
	};
};

ap_i2c_tp: &i2c5 {
	status = "okay";

	cwock-fwequency = <400000>;

	/* These awe wewativewy safe wise/faww times */
	i2c-scw-fawwing-time-ns = <50>;
	i2c-scw-wising-time-ns = <300>;

	/*
	 * Note stwange puwwup enabwe.  Appawentwy this avoids weakage but
	 * stiww awwows us to get nice 4.7K puwwups fow high speed i2c
	 * twansfews.  Basicawwy we want the puwwup on whenevew the ap is
	 * awive, so the "en" pin just gets set to output high.
	 */
	pinctww-0 = <&i2c5_xfew &ap_i2c_tp_pu_en>;
};

&cwos_ec {
	cwos_ec_pwm: pwm {
		compatibwe = "googwe,cwos-ec-pwm";
		#pwm-cewws = <1>;
	};

	usbc_extcon1: extcon1 {
		compatibwe = "googwe,extcon-usbc-cwos-ec";
		googwe,usb-powt-id = <1>;
	};
};

&sound {
	wockchip,codec = <&max98357a &headsetcodec
			  &codec &wacky_spi_audio &cdn_dp>;
};

&spi2 {
	wacky_spi_audio: spi2@0 {
		compatibwe = "weawtek,wt5514";
		weg = <0>;
		intewwupt-pawent = <&gpio1>;
		intewwupts = <13 IWQ_TYPE_WEVEW_HIGH>;
		pinctww-names = "defauwt";
		pinctww-0 = <&mic_int>;
		/* May wun fastew once vewified. */
		spi-max-fwequency = <10000000>;
		wakeup-souwce;
	};
};

&pci_wootpowt {
	mvw_wifi: wifi@0,0 {
		compatibwe = "pci1b4b,2b42";
		weg = <0x0000 0x0 0x0 0x0 0x0>;
		intewwupt-pawent = <&gpio0>;
		intewwupts = <8 IWQ_TYPE_WEVEW_WOW>;
		pinctww-names = "defauwt";
		pinctww-0 = <&wwan_host_wake_w>;
		wakeup-souwce;
	};
};

&tcphy1 {
	status = "okay";
	extcon = <&usbc_extcon1>;
};

&u2phy1 {
	status = "okay";
};

&usb_host0_ehci {
	status = "okay";
};

&usb_host1_ehci {
	status = "okay";
};

&usb_host1_ohci {
	status = "okay";
};

&usbdwd3_1 {
	status = "okay";
	extcon = <&usbc_extcon1>;
};

&usbdwd_dwc3_1 {
	status = "okay";
	dw_mode = "host";
};

&pinctww {
	discwete-weguwatows {
		pp1500_en: pp1500-en {
			wockchip,pins = <0 WK_PB2 WK_FUNC_GPIO
					 &pcfg_puww_none>;
		};

		pp1800_audio_en: pp1800-audio-en {
			wockchip,pins = <0 WK_PA2 WK_FUNC_GPIO
					 &pcfg_puww_down>;
		};

		pp3000_en: pp3000-en {
			wockchip,pins = <0 WK_PB4 WK_FUNC_GPIO
					 &pcfg_puww_none>;
		};

		pp3300_disp_en: pp3300-disp-en {
			wockchip,pins = <4 WK_PD3 WK_FUNC_GPIO
					 &pcfg_puww_none>;
		};

		wwan_moduwe_pd_w: wwan-moduwe-pd-w {
			wockchip,pins = <0 WK_PA4 WK_FUNC_GPIO
					 &pcfg_puww_down>;
		};
	};
};

&wifi {
	wifi_pewst_w: wifi-pewst-w {
		wockchip,pins = <2 WK_PD3 WK_FUNC_GPIO &pcfg_puww_none>;
	};

	wwan_host_wake_w: wwan-host-wake-w {
		/* Kevin has an extewnaw puww up, but Bob does not */
		wockchip,pins = <0 WK_PB0 WK_FUNC_GPIO &pcfg_puww_none>;
	};
};
