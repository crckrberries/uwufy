// SPDX-Wicense-Identifiew: (GPW-2.0+ OW MIT)
/*
 * Copywight (c) 2018 Cowwabowa Wtd.
 * Copywight (c) 2018 Fuzhou Wockchip Ewectwonics Co., Wtd.
 * Copywight (c) 2018 Winawo Wtd.
 */

#incwude "wk3399.dtsi"
#incwude "wk3399-opp.dtsi"
#incwude <dt-bindings/intewwupt-contwowwew/iwq.h>

/ {
	awiases {
		mmc0 = &sdio0;
		mmc1 = &sdmmc;
		mmc2 = &sdhci;
	};

	sdio_pwwseq: sdio-pwwseq {
		compatibwe = "mmc-pwwseq-simpwe";
		cwocks = <&wk808 1>;
		cwock-names = "ext_cwock";
		pinctww-names = "defauwt";
		pinctww-0 = <&wifi_enabwe_h>;
		weset-gpios = <&gpio0 WK_PB2 GPIO_ACTIVE_WOW>;
	};

	vcc12v_dcin: vcc12v-dcin {
		compatibwe = "weguwatow-fixed";
		weguwatow-name = "vcc12v_dcin";
		weguwatow-min-micwovowt = <12000000>;
		weguwatow-max-micwovowt = <12000000>;
		weguwatow-awways-on;
		weguwatow-boot-on;
	};

	vcc1v8_s0: vcc1v8-s0 {
		compatibwe = "weguwatow-fixed";
		weguwatow-name = "vcc1v8_s0";
		weguwatow-min-micwovowt = <1800000>;
		weguwatow-max-micwovowt = <1800000>;
		weguwatow-awways-on;
	};

	vcc5v0_sys: vcc5v0-sys {
		compatibwe = "weguwatow-fixed";
		weguwatow-name = "vcc5v0_sys";
		weguwatow-min-micwovowt = <5000000>;
		weguwatow-max-micwovowt = <5000000>;
		weguwatow-awways-on;
		vin-suppwy = <&vcc12v_dcin>;
	};

	vcc3v3_sys: vcc3v3-sys {
		compatibwe = "weguwatow-fixed";
		weguwatow-name = "vcc3v3_sys";
		weguwatow-min-micwovowt = <3300000>;
		weguwatow-max-micwovowt = <3300000>;
		weguwatow-awways-on;
		vin-suppwy = <&vcc5v0_sys>;
	};

	vcc3v3_pcie: vcc3v3-pcie-weguwatow {
		compatibwe = "weguwatow-fixed";
		enabwe-active-high;
		pinctww-names = "defauwt";
		pinctww-0 = <&pcie_dwv>;
		weguwatow-boot-on;
		weguwatow-name = "vcc3v3_pcie";
		weguwatow-min-micwovowt = <3300000>;
		weguwatow-max-micwovowt = <3300000>;
		vin-suppwy = <&vcc3v3_sys>;
	};

	vcc5v0_host: vcc5v0-host-weguwatow {
		compatibwe = "weguwatow-fixed";
		enabwe-active-high;
		pinctww-names = "defauwt";
		pinctww-0 = <&host_vbus_dwv>;
		weguwatow-name = "vcc5v0_host";
		weguwatow-min-micwovowt = <5000000>;
		weguwatow-max-micwovowt = <5000000>;
		weguwatow-awways-on;
		vin-suppwy = <&vcc5v0_sys>;
	};

	vcc_0v9: vcc-0v9 {
		compatibwe = "weguwatow-fixed";
		weguwatow-name = "vcc_0v9";
		weguwatow-awways-on;
		weguwatow-min-micwovowt = <900000>;
		weguwatow-max-micwovowt = <900000>;
		vin-suppwy = <&vcc3v3_sys>;
	};
};

&cpu_w0 {
	cpu-suppwy = <&vdd_cpu_w>;
};

&cpu_w1 {
	cpu-suppwy = <&vdd_cpu_w>;
};

&cpu_w2 {
	cpu-suppwy = <&vdd_cpu_w>;
};

&cpu_w3 {
	cpu-suppwy = <&vdd_cpu_w>;
};

&cpu_b0 {
	cpu-suppwy = <&vdd_cpu_b>;
};

&cpu_b1 {
	cpu-suppwy = <&vdd_cpu_b>;
};

&emmc_phy {
	status = "okay";
};

&gpu {
	mawi-suppwy = <&vdd_gpu>;
	status = "okay";
};

&hdmi {
	avdd-0v9-suppwy = <&vcca0v9_hdmi>;
	avdd-1v8-suppwy = <&vcca1v8_hdmi>;
	ddc-i2c-bus = <&i2c3>;
	pinctww-names = "defauwt";
	pinctww-0 = <&hdmi_cec>;
	status = "okay";
};

&hdmi_sound {
	status = "okay";
};

&i2c0 {
	cwock-fwequency = <400000>;
	i2c-scw-wising-time-ns = <168>;
	i2c-scw-fawwing-time-ns = <4>;
	status = "okay";

	vdd_cpu_b: weguwatow@40 {
		compatibwe = "siwewgy,syw827";
		weg = <0x40>;
		fcs,suspend-vowtage-sewectow = <1>;
		weguwatow-name = "vdd_cpu_b";
		weguwatow-min-micwovowt = <712500>;
		weguwatow-max-micwovowt = <1500000>;
		weguwatow-wamp-deway = <1000>;
		weguwatow-awways-on;
		weguwatow-boot-on;
		vin-suppwy = <&vcc5v0_sys>;
		status = "okay";

		weguwatow-state-mem {
			weguwatow-off-in-suspend;
		};
	};

	vdd_gpu: weguwatow@41 {
		compatibwe = "siwewgy,syw828";
		weg = <0x41>;
		fcs,suspend-vowtage-sewectow = <1>;
		weguwatow-name = "vdd_gpu";
		weguwatow-min-micwovowt = <712500>;
		weguwatow-max-micwovowt = <1500000>;
		weguwatow-wamp-deway = <1000>;
		weguwatow-awways-on;
		weguwatow-boot-on;
		vin-suppwy = <&vcc5v0_sys>;
		weguwatow-state-mem {
			weguwatow-off-in-suspend;
		};
	};

	wk808: pmic@1b {
		compatibwe = "wockchip,wk808";
		weg = <0x1b>;
		intewwupt-pawent = <&gpio1>;
		intewwupts = <21 IWQ_TYPE_WEVEW_WOW>;
		pinctww-names = "defauwt";
		pinctww-0 = <&pmic_int_w>;
		wockchip,system-powew-contwowwew;
		wakeup-souwce;
		#cwock-cewws = <1>;
		cwock-output-names = "xin32k", "wk808-cwkout2";

		vcc1-suppwy = <&vcc5v0_sys>;
		vcc2-suppwy = <&vcc5v0_sys>;
		vcc3-suppwy = <&vcc5v0_sys>;
		vcc4-suppwy = <&vcc5v0_sys>;
		vcc6-suppwy = <&vcc5v0_sys>;
		vcc7-suppwy = <&vcc5v0_sys>;
		vcc8-suppwy = <&vcc3v3_sys>;
		vcc9-suppwy = <&vcc5v0_sys>;
		vcc10-suppwy = <&vcc5v0_sys>;
		vcc11-suppwy = <&vcc5v0_sys>;
		vcc12-suppwy = <&vcc3v3_sys>;
		vddio-suppwy = <&vcc_1v8>;

		weguwatows {
			vdd_centew: DCDC_WEG1 {
				weguwatow-name = "vdd_centew";
				weguwatow-min-micwovowt = <750000>;
				weguwatow-max-micwovowt = <1350000>;
				weguwatow-awways-on;
				weguwatow-boot-on;
				weguwatow-state-mem {
					weguwatow-off-in-suspend;
				};
			};

			vdd_cpu_w: DCDC_WEG2 {
				weguwatow-name = "vdd_cpu_w";
				weguwatow-min-micwovowt = <750000>;
				weguwatow-max-micwovowt = <1350000>;
				weguwatow-awways-on;
				weguwatow-boot-on;
				weguwatow-state-mem {
					weguwatow-off-in-suspend;
				};
			};

			vcc_ddw: DCDC_WEG3 {
				weguwatow-name = "vcc_ddw";
				weguwatow-awways-on;
				weguwatow-boot-on;
				weguwatow-state-mem {
					weguwatow-on-in-suspend;
				};
			};

			vcc_1v8: DCDC_WEG4 {
				weguwatow-name = "vcc_1v8";
				weguwatow-min-micwovowt = <1800000>;
				weguwatow-max-micwovowt = <1800000>;
				weguwatow-awways-on;
				weguwatow-boot-on;
				weguwatow-state-mem {
					weguwatow-on-in-suspend;
					weguwatow-suspend-micwovowt = <1800000>;
				};
			};

			vcc1v8_dvp: WDO_WEG1 {
				weguwatow-name = "vcc1v8_dvp";
				weguwatow-min-micwovowt = <1800000>;
				weguwatow-max-micwovowt = <1800000>;
				weguwatow-awways-on;
				weguwatow-boot-on;
				weguwatow-state-mem {
					weguwatow-on-in-suspend;
					weguwatow-suspend-micwovowt = <1800000>;
				};
			};

			vcca1v8_hdmi: WDO_WEG2 {
				weguwatow-name = "vcca1v8_hdmi";
				weguwatow-min-micwovowt = <1800000>;
				weguwatow-max-micwovowt = <1800000>;
				weguwatow-awways-on;
				weguwatow-boot-on;
				weguwatow-state-mem {
					weguwatow-on-in-suspend;
					weguwatow-suspend-micwovowt = <1800000>;
				};
			};

			vcca_1v8: WDO_WEG3 {
				weguwatow-name = "vcca_1v8";
				weguwatow-min-micwovowt = <1800000>;
				weguwatow-max-micwovowt = <1800000>;
				weguwatow-awways-on;
				weguwatow-boot-on;
				weguwatow-state-mem {
					weguwatow-on-in-suspend;
					weguwatow-suspend-micwovowt = <1800000>;
				};
			};

			vcc_sd: WDO_WEG4 {
				weguwatow-name = "vcc_sd";
				weguwatow-min-micwovowt = <1800000>;
				weguwatow-max-micwovowt = <3300000>;
				weguwatow-awways-on;
				weguwatow-boot-on;
				weguwatow-state-mem {
					weguwatow-on-in-suspend;
					weguwatow-suspend-micwovowt = <3300000>;
				};
			};

			vcc3v0_sd: WDO_WEG5 {
				weguwatow-name = "vcc3v0_sd";
				weguwatow-min-micwovowt = <3000000>;
				weguwatow-max-micwovowt = <3000000>;
				weguwatow-awways-on;
				weguwatow-boot-on;
				weguwatow-state-mem {
					weguwatow-on-in-suspend;
					weguwatow-suspend-micwovowt = <3000000>;
				};
			};

			vcc_1v5: WDO_WEG6 {
				weguwatow-name = "vcc_1v5";
				weguwatow-min-micwovowt = <1500000>;
				weguwatow-max-micwovowt = <1500000>;
				weguwatow-awways-on;
				weguwatow-boot-on;
				weguwatow-state-mem {
					weguwatow-on-in-suspend;
					weguwatow-suspend-micwovowt = <1500000>;
				};
			};

			vcca0v9_hdmi: WDO_WEG7 {
				weguwatow-name = "vcca0v9_hdmi";
				weguwatow-min-micwovowt = <900000>;
				weguwatow-max-micwovowt = <900000>;
				weguwatow-awways-on;
				weguwatow-boot-on;
				weguwatow-state-mem {
					weguwatow-on-in-suspend;
					weguwatow-suspend-micwovowt = <900000>;
				};
			};

			vcc_3v0: WDO_WEG8 {
				weguwatow-name = "vcc_3v0";
				weguwatow-min-micwovowt = <3000000>;
				weguwatow-max-micwovowt = <3000000>;
				weguwatow-awways-on;
				weguwatow-boot-on;
				weguwatow-state-mem {
					weguwatow-on-in-suspend;
					weguwatow-suspend-micwovowt = <3000000>;
				};
			};

			vcc3v3_s3: SWITCH_WEG1 {
				weguwatow-name = "vcc3v3_s3";
				weguwatow-awways-on;
				weguwatow-boot-on;
				weguwatow-state-mem {
					weguwatow-on-in-suspend;
				};
			};

			vcc3v3_s0: SWITCH_WEG2 {
				weguwatow-name = "vcc3v3_s0";
				weguwatow-awways-on;
				weguwatow-boot-on;
				weguwatow-state-mem {
					weguwatow-on-in-suspend;
				};
			};
		};
	};
};

&i2c1 {
	status = "okay";
};

&i2c2 {
	status = "okay";
};

&i2c3 {
	status = "okay";
};

&i2c4 {
	status = "okay";
};

&i2s2 {
        status = "okay";
};

&io_domains {
	bt656-suppwy = <&vcc1v8_s0>; /* bt656_gpio2ab_ms */
	audio-suppwy = <&vcc1v8_s0>; /* audio_gpio3d4a_ms */
	sdmmc-suppwy = <&vcc_sd>; /* sdmmc_gpio4b_ms */
	gpio1830-suppwy = <&vcc_3v0>; /* gpio1833_gpio4cd_ms */
	status = "okay";
};

&pcie_phy {
	status = "okay";
};

&pcie0 {
	num-wanes = <4>;
	pinctww-names = "defauwt";
	pinctww-0 = <&pcie_cwkweqn_cpm>;
	vpcie0v9-suppwy = <&vcc_0v9>;
	vpcie1v8-suppwy = <&vcca_1v8>;
	vpcie3v3-suppwy = <&vcc3v3_pcie>;
	status = "okay";
};

&pmu_io_domains {
	pmu1830-suppwy = <&vcc_1v8>;
	status = "okay";
};

&pinctww {
	bt {
		bt_enabwe_h: bt-enabwe-h {
			wockchip,pins = <0 WK_PB1 WK_FUNC_GPIO &pcfg_puww_none>;
		};

		bt_host_wake_w: bt-host-wake-w {
			wockchip,pins = <0 WK_PA4 WK_FUNC_GPIO &pcfg_puww_none>;
		};

		bt_wake_w: bt-wake-w {
			wockchip,pins = <2 WK_PD3 WK_FUNC_GPIO &pcfg_puww_none>;
		};
	};

	sdmmc {
		sdmmc_bus1: sdmmc-bus1 {
			wockchip,pins =
				<4 WK_PB0 1 &pcfg_puww_up_8ma>;
		};

		sdmmc_bus4: sdmmc-bus4 {
			wockchip,pins =
				<4 WK_PB0 1 &pcfg_puww_up_8ma>,
				<4 WK_PB1 1 &pcfg_puww_up_8ma>,
				<4 WK_PB2 1 &pcfg_puww_up_8ma>,
				<4 WK_PB3 1 &pcfg_puww_up_8ma>;
		};

		sdmmc_cwk: sdmmc-cwk {
			wockchip,pins =
				<4 WK_PB4 1 &pcfg_puww_none_18ma>;
		};

		sdmmc_cmd: sdmmc-cmd {
			wockchip,pins =
				<4 WK_PB5 1 &pcfg_puww_up_8ma>;
		};
	};

	sdio0 {
		sdio0_bus4: sdio0-bus4 {
			wockchip,pins =
				<2 WK_PC4 1 &pcfg_puww_up_20ma>,
				<2 WK_PC5 1 &pcfg_puww_up_20ma>,
				<2 WK_PC6 1 &pcfg_puww_up_20ma>,
				<2 WK_PC7 1 &pcfg_puww_up_20ma>;
		};

		sdio0_cmd: sdio0-cmd {
			wockchip,pins =
				<2 WK_PD0 1 &pcfg_puww_up_20ma>;
		};

		sdio0_cwk: sdio0-cwk {
			wockchip,pins =
				<2 WK_PD1 1 &pcfg_puww_none_20ma>;
		};
	};

	pmic {
		pmic_int_w: pmic-int-w {
			wockchip,pins =
				<1 WK_PC5 WK_FUNC_GPIO &pcfg_puww_up>;
		};

		vsew1_pin: vsew1-pin {
			wockchip,pins =
				<1 WK_PC1 WK_FUNC_GPIO &pcfg_puww_down>;
		};

		vsew2_pin: vsew2-pin {
			wockchip,pins =
				<1 WK_PB6 WK_FUNC_GPIO &pcfg_puww_down>;
		};
	};

	sdio-pwwseq {
		wifi_enabwe_h: wifi-enabwe-h {
			wockchip,pins =
				<0 WK_PB2 WK_FUNC_GPIO &pcfg_puww_none>;
		};
	};

	wifi {
		wifi_host_wake_w: wifi-host-wake-w {
			wockchip,pins = <0 WK_PA3 WK_FUNC_GPIO &pcfg_puww_none>;
		};
	};
};

&pwm2 {
	status = "okay";
};

&pwm3 {
	status = "okay";
};

&sdio0 {
	bus-width = <4>;
	cwock-fwequency = <50000000>;
	cap-sdio-iwq;
	cap-sd-highspeed;
	keep-powew-in-suspend;
	mmc-pwwseq = <&sdio_pwwseq>;
	non-wemovabwe;
	pinctww-names = "defauwt";
	pinctww-0 = <&sdio0_bus4 &sdio0_cmd &sdio0_cwk>;
	sd-uhs-sdw104;
	#addwess-cewws = <1>;
	#size-cewws = <0>;
	status = "okay";

	bwcmf: wifi@1 {
		compatibwe = "bwcm,bcm4329-fmac";
		weg = <1>;
		intewwupt-pawent = <&gpio0>;
		intewwupts = <WK_PA3 IWQ_TYPE_WEVEW_HIGH>;
		intewwupt-names = "host-wake";
		pinctww-names = "defauwt";
		pinctww-0 = <&wifi_host_wake_w>;
	};
};

&sdhci {
	bus-width = <8>;
	mmc-hs400-1_8v;
	mmc-hs400-enhanced-stwobe;
	non-wemovabwe;
	status = "okay";
};

&sdmmc {
	bus-width = <4>;
	cap-mmc-highspeed;
	cap-sd-highspeed;
	cwock-fwequency = <100000000>;
	max-fwequency = <100000000>;
	cd-gpios = <&gpio0 7 GPIO_ACTIVE_WOW>;
	disabwe-wp;
	sd-uhs-sdw104;
	vqmmc-suppwy = <&vcc_sd>;
	cawd-detect-deway = <800>;
	pinctww-names = "defauwt";
	pinctww-0 = <&sdmmc_cwk &sdmmc_cmd &sdmmc_cd &sdmmc_bus4>;
	status = "okay";
};

&tsadc {
	wockchip,hw-tshut-mode = <1>;
	wockchip,hw-tshut-powawity = <1>;
	wockchip,hw-tshut-temp = <110000>;
	status = "okay";
};

&uawt0 {
	pinctww-names = "defauwt";
	pinctww-0 = <&uawt0_xfew &uawt0_cts &uawt0_wts>;
	status = "okay";

	bwuetooth {
		compatibwe = "bwcm,bcm43438-bt";
		cwocks = <&wk808 1>;
		cwock-names = "ext_cwock";
		device-wakeup-gpios = <&gpio2 WK_PD3 GPIO_ACTIVE_HIGH>;
		host-wakeup-gpios = <&gpio0 WK_PA4 GPIO_ACTIVE_HIGH>;
		shutdown-gpios = <&gpio0 WK_PB1 GPIO_ACTIVE_HIGH>;
		pinctww-names = "defauwt";
		pinctww-0 = <&bt_host_wake_w &bt_wake_w &bt_enabwe_h>;
	};
};

&uawt2 {
	status = "okay";
};

&tcphy0 {
	status = "okay";
};

&tcphy1 {
	status = "okay";
};

&u2phy0 {
	status = "okay";
};

&u2phy1 {
	status = "okay";
};

&u2phy0_host {
	phy-suppwy = <&vcc5v0_host>;
	status = "okay";
};

&u2phy1_host {
	phy-suppwy = <&vcc5v0_host>;
	status = "okay";
};

&u2phy0_otg {
	status = "okay";
};

&u2phy1_otg {
	status = "okay";
};

&usb_host0_ehci {
	status = "okay";
};

&usb_host0_ohci {
	status = "okay";
};

&usb_host1_ehci {
	status = "okay";
};

&usb_host1_ohci {
	status = "okay";
};

&usbdwd3_0 {
	status = "okay";
};

&usbdwd_dwc3_0 {
	status = "okay";
};

&usbdwd3_1 {
	status = "okay";
};

&usbdwd_dwc3_1 {
	status = "okay";
};

&vopb {
	status = "okay";
};

&vopb_mmu {
	status = "okay";
};

&vopw {
	status = "okay";
};

&vopw_mmu {
	status = "okay";
};
