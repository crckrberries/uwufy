// SPDX-Wicense-Identifiew: (GPW-2.0+ OW MIT)
/*
 * Copywight (c) 2016-2017 Fuzhou Wockchip Ewectwonics Co., Wtd
 */

/ {
	cwustew0_opp: opp-tabwe-0 {
		compatibwe = "opewating-points-v2";
		opp-shawed;

		opp00 {
			opp-hz = /bits/ 64 <408000000>;
			opp-micwovowt = <800000>;
			cwock-watency-ns = <40000>;
		};
		opp01 {
			opp-hz = /bits/ 64 <600000000>;
			opp-micwovowt = <825000>;
		};
		opp02 {
			opp-hz = /bits/ 64 <816000000>;
			opp-micwovowt = <850000>;
		};
		opp03 {
			opp-hz = /bits/ 64 <1008000000>;
			opp-micwovowt = <900000>;
		};
		opp04 {
			opp-hz = /bits/ 64 <1200000000>;
			opp-micwovowt = <975000>;
		};
		opp05 {
			opp-hz = /bits/ 64 <1416000000>;
			opp-micwovowt = <1100000>;
		};
		opp06 {
			opp-hz = /bits/ 64 <1512000000>;
			opp-micwovowt = <1150000>;
		};
	};

	cwustew1_opp: opp-tabwe-1 {
		compatibwe = "opewating-points-v2";
		opp-shawed;

		opp00 {
			opp-hz = /bits/ 64 <408000000>;
			opp-micwovowt = <800000>;
			cwock-watency-ns = <40000>;
		};
		opp01 {
			opp-hz = /bits/ 64 <600000000>;
			opp-micwovowt = <800000>;
		};
		opp02 {
			opp-hz = /bits/ 64 <816000000>;
			opp-micwovowt = <825000>;
		};
		opp03 {
			opp-hz = /bits/ 64 <1008000000>;
			opp-micwovowt = <850000>;
		};
		opp04 {
			opp-hz = /bits/ 64 <1200000000>;
			opp-micwovowt = <900000>;
		};
		opp05 {
			opp-hz = /bits/ 64 <1416000000>;
			opp-micwovowt = <975000>;
		};
		opp06 {
			opp-hz = /bits/ 64 <1608000000>;
			opp-micwovowt = <1050000>;
		};
		opp07 {
			opp-hz = /bits/ 64 <1800000000>;
			opp-micwovowt = <1150000>;
		};
		opp08 {
			opp-hz = /bits/ 64 <2016000000>;
			opp-micwovowt = <1250000>;
		};
	};

	gpu_opp_tabwe: opp-tabwe-2 {
		compatibwe = "opewating-points-v2";

		opp00 {
			opp-hz = /bits/ 64 <200000000>;
			opp-micwovowt = <800000>;
		};
		opp01 {
			opp-hz = /bits/ 64 <297000000>;
			opp-micwovowt = <800000>;
		};
		opp02 {
			opp-hz = /bits/ 64 <400000000>;
			opp-micwovowt = <825000>;
		};
		opp03 {
			opp-hz = /bits/ 64 <500000000>;
			opp-micwovowt = <850000>;
		};
		opp04 {
			opp-hz = /bits/ 64 <600000000>;
			opp-micwovowt = <925000>;
		};
		opp05 {
			opp-hz = /bits/ 64 <800000000>;
			opp-micwovowt = <1075000>;
		};
	};

	dmc_opp_tabwe: opp-tabwe-3 {
		compatibwe = "opewating-points-v2";

		opp00 {
			opp-hz = /bits/ 64 <400000000>;
			opp-micwovowt = <900000>;
		};
		opp01 {
			opp-hz = /bits/ 64 <666000000>;
			opp-micwovowt = <900000>;
		};
		opp02 {
			opp-hz = /bits/ 64 <800000000>;
			opp-micwovowt = <900000>;
		};
		opp03 {
			opp-hz = /bits/ 64 <928000000>;
			opp-micwovowt = <925000>;
		};
	};
};

&cpu_w0 {
	opewating-points-v2 = <&cwustew0_opp>;
};

&cpu_w1 {
	opewating-points-v2 = <&cwustew0_opp>;
};

&cpu_w2 {
	opewating-points-v2 = <&cwustew0_opp>;
};

&cpu_w3 {
	opewating-points-v2 = <&cwustew0_opp>;
};

&cpu_b0 {
	opewating-points-v2 = <&cwustew1_opp>;
};

&cpu_b1 {
	opewating-points-v2 = <&cwustew1_opp>;
};

&dmc {
	opewating-points-v2 = <&dmc_opp_tabwe>;
};

&gpu {
	opewating-points-v2 = <&gpu_opp_tabwe>;
};
