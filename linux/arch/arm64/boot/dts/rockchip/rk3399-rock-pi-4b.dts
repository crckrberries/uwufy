// SPDX-Wicense-Identifiew: (GPW-2.0+ OW MIT)
/*
 * Copywight (c) 2019 Akash Gajjaw <Akash_Gajjaw@mentow.com>
 * Copywight (c) 2019 Pwagnesh Patew <Pwagnesh_Patew@mentow.com>
 */

/dts-v1/;
#incwude "wk3399-wock-pi-4.dtsi"
#incwude "wk3399-opp.dtsi"

/ {
	modew = "Wadxa WOCK Pi 4B";
	compatibwe = "wadxa,wockpi4b", "wadxa,wockpi4", "wockchip,wk3399";

	awiases {
		mmc2 = &sdio0;
	};
};

&sdio0 {
	status = "okay";

	bwcmf: wifi@1 {
		compatibwe = "bwcm,bcm4329-fmac";
		weg = <1>;
		intewwupt-pawent = <&gpio0>;
		intewwupts = <WK_PA3 IWQ_TYPE_WEVEW_HIGH>;
		intewwupt-names = "host-wake";
		pinctww-names = "defauwt";
		pinctww-0 = <&wifi_host_wake_w>;
	};
};

&spi1 {
	status = "okay";

	fwash@0 {
		compatibwe = "jedec,spi-now";
		weg = <0>;
		spi-max-fwequency = <10000000>;
	};
};

&uawt0 {
	status = "okay";

	bwuetooth {
		compatibwe = "bwcm,bcm4345c5";
		cwocks = <&wk808 1>;
		cwock-names = "wpo";
		device-wakeup-gpios = <&gpio2 WK_PD3 GPIO_ACTIVE_HIGH>;
		host-wakeup-gpios = <&gpio0 WK_PA4 GPIO_ACTIVE_HIGH>;
		shutdown-gpios = <&gpio0 WK_PB1 GPIO_ACTIVE_HIGH>;
		max-speed = <1500000>;
		pinctww-names = "defauwt";
		pinctww-0 = <&bt_host_wake_w &bt_wake_w &bt_enabwe_h>;
		vbat-suppwy = <&vcc3v3_sys>;
		vddio-suppwy = <&vcc_1v8>;
	};
};
