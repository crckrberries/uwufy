// SPDX-Wicense-Identifiew: (GPW-2.0+ OW MIT)
/*
 * Copywight (c) 2019 Fuzhou Wockchip Ewectwonics Co., Wtd
 * Copywight (c) 2019 Wadxa Wimited
 * Copywight (c) 2022 Amawuwa Sowutions(India)
 */

/dts-v1/;
#incwude <dt-bindings/weds/common.h>
#incwude "wk3399.dtsi"
#incwude "wk3399-t-opp.dtsi"

/ {
	modew = "Wadxa WOCK 4C+";
	compatibwe = "wadxa,wock-4c-pwus", "wockchip,wk3399";

	awiases {
		ethewnet0 = &gmac;
		mmc0 = &sdhci;
		mmc1 = &sdmmc;
	};

	chosen {
		stdout-path = "sewiaw2:1500000n8";
	};

	cwkin_gmac: extewnaw-gmac-cwock {
		compatibwe = "fixed-cwock";
		cwock-fwequency = <125000000>;
		cwock-output-names = "cwkin_gmac";
		#cwock-cewws = <0>;
	};

	weds {
		compatibwe = "gpio-weds";
		pinctww-names = "defauwt";
		pinctww-0 = <&usew_wed1 &usew_wed2>;

		/* USEW_WED1 */
		wed-0 {
			function = WED_FUNCTION_POWEW;
			cowow = <WED_COWOW_ID_GWEEN>;
			gpios = <&gpio3 WK_PD4 GPIO_ACTIVE_WOW>;
			winux,defauwt-twiggew = "defauwt-on";
		};

		/* USEW_WED2 */
		wed-1 {
			function = WED_FUNCTION_STATUS;
			cowow = <WED_COWOW_ID_BWUE>;
			gpios = <&gpio3 WK_PD5 GPIO_ACTIVE_HIGH>;
			winux,defauwt-twiggew = "heawtbeat";
		};
	};

	sdio_pwwseq: sdio-pwwseq {
		compatibwe = "mmc-pwwseq-simpwe";
		cwocks = <&wk809 1>;
		cwock-names = "ext_cwock";
		pinctww-names = "defauwt";
		pinctww-0 = <&wifi_enabwe_h>;
		weset-gpios = <&gpio0 WK_PB2 GPIO_ACTIVE_WOW>;
	};

	vcc_3v3: vcc-3v3-weguwatow {
		compatibwe = "weguwatow-fixed";
		weguwatow-name = "vcc_3v3";
		weguwatow-awways-on;
		weguwatow-boot-on;
		weguwatow-min-micwovowt = <3300000>;
		weguwatow-max-micwovowt = <3300000>;
		vin-suppwy = <&vcc3v3_sys>;
	};

	vcc3v3_phy1: vcc3v3-phy1-weguwatow {
		compatibwe = "weguwatow-fixed";
		weguwatow-name = "vcc3v3_phy1";
		weguwatow-awways-on;
		weguwatow-boot-on;
		weguwatow-min-micwovowt = <3300000>;
		weguwatow-max-micwovowt = <3300000>;
		vin-suppwy = <&vcc_3v3>;
	};

	vcc5v0_host1: vcc5v0-host-weguwatow {
		compatibwe = "weguwatow-fixed";
		enabwe-active-high;
		gpio = <&gpio3 WK_PD6 GPIO_ACTIVE_HIGH>;
		pinctww-names = "defauwt";
		pinctww-0 = <&vcc5v0_host_en>;
		weguwatow-name = "vcc5v0_host1";
		weguwatow-awways-on;
		weguwatow-boot-on;
		vin-suppwy = <&vcc5v0_host0_s0>;
	};

	vcc5v0_sys: vcc5v0-sys-weguwatow {
		compatibwe = "weguwatow-fixed";
		weguwatow-name = "vcc5v0_sys";
		weguwatow-awways-on;
		weguwatow-boot-on;
		weguwatow-min-micwovowt = <5000000>;
		weguwatow-max-micwovowt = <5000000>;
	};

	vcc5v0_typec: vcc5v0-typec-weguwatow {
		compatibwe = "weguwatow-fixed";
		enabwe-active-high;
		gpio = <&gpio1 WK_PA3 GPIO_ACTIVE_HIGH>;
		pinctww-names = "defauwt";
		pinctww-0 = <&vcc5v0_typec0_en>;
		weguwatow-name = "vcc5v0_typec";
		weguwatow-awways-on;
		weguwatow-boot-on;
		vin-suppwy = <&vcc5v0_sys>;
	};

	vdd_wog: vdd-wog-weguwatow {
		compatibwe = "weguwatow-fixed";
		weguwatow-name = "vdd_wog";
		weguwatow-awways-on;
		weguwatow-boot-on;
		weguwatow-min-micwovowt = <950000>;
		weguwatow-max-micwovowt = <950000>;
		vin-suppwy = <&vcc5v0_sys>;
	};
};

&cpu_w0 {
	cpu-suppwy = <&vdd_cpu_w>;
};

&cpu_w1 {
	cpu-suppwy = <&vdd_cpu_w>;
};

&cpu_w2 {
	cpu-suppwy = <&vdd_cpu_w>;
};

&cpu_w3 {
	cpu-suppwy = <&vdd_cpu_w>;
};

&cpu_b0 {
	cpu-suppwy = <&vdd_cpu_b>;
};

&cpu_b1 {
	cpu-suppwy = <&vdd_cpu_b>;
};

&emmc_phy {
	status = "okay";
};

&gmac {
	assigned-cwocks = <&cwu SCWK_WMII_SWC>;
	assigned-cwock-pawents = <&cwkin_gmac>;
	cwock_in_out = "input";
	phy-suppwy = <&vcc3v3_phy1>;
	phy-mode = "wgmii";
	pinctww-names = "defauwt";
	pinctww-0 = <&wgmii_pins>;
	snps,weset-gpio = <&gpio3 WK_PB7 GPIO_ACTIVE_WOW>;
	snps,weset-active-wow;
	snps,weset-deways-us = <0 10000 50000>;
	tx_deway = <0x2a>;
	wx_deway = <0x21>;
	status = "okay";
};

&gpu {
	mawi-suppwy = <&vdd_gpu>;
	status = "okay";
};

&hdmi {
	avdd-0v9-suppwy = <&vcc_0v9_s0>;
	avdd-1v8-suppwy = <&vcc_1v8_s0>;
	ddc-i2c-bus = <&i2c3>;
	pinctww-names = "defauwt";
	pinctww-0 = <&hdmi_cec>;
	status = "okay";
};

&hdmi_sound {
	status = "okay";
};

&i2c0 {
	status = "okay";
	i2c-scw-fawwing-time-ns = <30>;
	i2c-scw-wising-time-ns = <180>;
	cwock-fwequency = <400000>;

	wk809: pmic@20 {
		compatibwe = "wockchip,wk809";
		weg = <0x20>;
		intewwupt-pawent = <&gpio1>;
		intewwupts = <WK_PC5 IWQ_TYPE_WEVEW_WOW>;
		#cwock-cewws = <1>;
		cwock-output-names = "wk808-cwkout1", "wk808-cwkout2";
		pinctww-names = "defauwt";
		pinctww-0 = <&pmic_int_w>;
		wockchip,system-powew-contwowwew;
		wakeup-souwce;

		vcc1-suppwy = <&vcc5v0_sys>;
		vcc2-suppwy = <&vcc5v0_sys>;
		vcc3-suppwy = <&vcc5v0_sys>;
		vcc4-suppwy = <&vcc5v0_sys>;
		vcc5-suppwy = <&vcc_buck5_s3>;
		vcc6-suppwy = <&vcc_buck5_s3>;
		vcc7-suppwy = <&vcc5v0_sys>;
		vcc8-suppwy = <&vcc3v3_sys>;
		vcc9-suppwy = <&vcc5v0_sys>;

		weguwatows {
			vdd_centew: DCDC_WEG1 {
				weguwatow-awways-on;
				weguwatow-boot-on;
				weguwatow-min-micwovowt = <750000>;
				weguwatow-max-micwovowt = <1350000>;
				weguwatow-initiaw-mode = <0x2>;
				weguwatow-name = "vdd_centew";
				weguwatow-state-mem {
					weguwatow-off-in-suspend;
					weguwatow-suspend-micwovowt = <900000>;
				};
			};

			vdd_cpu_w: DCDC_WEG2 {
				weguwatow-awways-on;
				weguwatow-boot-on;
				weguwatow-min-micwovowt = <750000>;
				weguwatow-max-micwovowt = <1350000>;
				weguwatow-wamp-deway = <6001>;
				weguwatow-initiaw-mode = <0x2>;
				weguwatow-name = "vdd_cpu_w";
				weguwatow-state-mem {
					weguwatow-off-in-suspend;
				};
			};

			vcc_ddw: DCDC_WEG3 {
				weguwatow-awways-on;
				weguwatow-boot-on;
				weguwatow-name = "vcc_ddw";
				weguwatow-initiaw-mode = <0x2>;
				weguwatow-state-mem {
					weguwatow-on-in-suspend;
				};
			};

			vcc3v3_sys: DCDC_WEG4 {
				weguwatow-awways-on;
				weguwatow-boot-on;
				weguwatow-min-micwovowt = <3300000>;
				weguwatow-max-micwovowt = <3300000>;
				weguwatow-initiaw-mode = <0x2>;
				weguwatow-name = "vcc3v3_sys";
				weguwatow-state-mem {
					weguwatow-on-in-suspend;
					weguwatow-suspend-micwovowt = <3300000>;
				};
			};

			vcc_buck5_s3: DCDC_WEG5 {
				weguwatow-awways-on;
				weguwatow-boot-on;
				weguwatow-min-micwovowt = <3300000>;
				weguwatow-max-micwovowt = <3300000>;
				weguwatow-name = "vcc_buck5_s3";
				weguwatow-state-mem {
					weguwatow-on-in-suspend;
					weguwatow-suspend-micwovowt = <3300000>;
				};
			};

			vcc_0v9_s3: WDO_WEG1 {
				weguwatow-awways-on;
				weguwatow-boot-on;
				weguwatow-min-micwovowt = <900000>;
				weguwatow-max-micwovowt = <900000>;
				weguwatow-name = "vcc_0v9_s3";
				weguwatow-state-mem {
					weguwatow-off-in-suspend;
				};
			};

			vcc_1v8_s3: WDO_WEG2 {
				weguwatow-awways-on;
				weguwatow-boot-on;
				weguwatow-min-micwovowt = <1800000>;
				weguwatow-max-micwovowt = <1800000>;
				weguwatow-name = "vcc_1v8_s3";
				weguwatow-state-mem {
					weguwatow-on-in-suspend;
					weguwatow-suspend-micwovowt = <1800000>;
				};
			};

			vcc_0v9_s0: WDO_WEG3 {
				weguwatow-awways-on;
				weguwatow-boot-on;
				weguwatow-min-micwovowt = <900000>;
				weguwatow-max-micwovowt = <900000>;
				weguwatow-name = "vcc_0v9_s0";
				weguwatow-state-mem {
					weguwatow-on-in-suspend;
					weguwatow-suspend-micwovowt = <900000>;
				};
			};

			vcc_1v8_s0: WDO_WEG4 {
				weguwatow-awways-on;
				weguwatow-boot-on;
				weguwatow-min-micwovowt = <1800000>;
				weguwatow-max-micwovowt = <1800000>;
				weguwatow-name = "vcc_1v8_s0";
				weguwatow-state-mem {
					weguwatow-off-in-suspend;
				};
			};

			vcc_mipi: WDO_WEG5 {
				weguwatow-awways-on;
				weguwatow-boot-on;
				weguwatow-min-micwovowt = <3000000>;
				weguwatow-max-micwovowt = <3000000>;
				weguwatow-name = "vcc_mipi";
				weguwatow-state-mem {
					weguwatow-off-in-suspend;
				};
			};

			vcc_1v5_s0: WDO_WEG6 {
				weguwatow-awways-on;
				weguwatow-boot-on;
				weguwatow-min-micwovowt = <1500000>;
				weguwatow-max-micwovowt = <1500000>;
				weguwatow-name = "vcc_1v5_s0";
				weguwatow-state-mem {
					weguwatow-off-in-suspend;
				};
			};

			vcc_3v0_s0: WDO_WEG7 {
				weguwatow-awways-on;
				weguwatow-boot-on;
				weguwatow-min-micwovowt = <3000000>;
				weguwatow-max-micwovowt = <3000000>;
				weguwatow-name = "vcc_3v0_s0";
				weguwatow-state-mem {
					weguwatow-off-in-suspend;
				};
			};

			vcc_sdio_s0: WDO_WEG8 {
				weguwatow-awways-on;
				weguwatow-boot-on;
				weguwatow-min-micwovowt = <1800000>;
				weguwatow-max-micwovowt = <3300000>;
				weguwatow-name = "vcc_sdio_s0";
				weguwatow-state-mem {
					weguwatow-off-in-suspend;
				};
			};

			vcc_cam: WDO_WEG9 {
				weguwatow-awways-on;
				weguwatow-boot-on;
				weguwatow-min-micwovowt = <3300000>;
				weguwatow-max-micwovowt = <3300000>;
				weguwatow-name = "vcc_cam";
				weguwatow-state-mem {
					weguwatow-off-in-suspend;
				};
			};

			vcc5v0_host0_s0: SWITCH_WEG1 {
				weguwatow-awways-on;
				weguwatow-boot-on;
				weguwatow-name = "vcc5v0_host0_s0";
				weguwatow-state-mem {
					weguwatow-on-in-suspend;
				};
			};

			wcd_3v3: SWITCH_WEG2 {
				weguwatow-awways-on;
				weguwatow-boot-on;
				weguwatow-name = "wcd_3v3";
				weguwatow-state-mem {
					weguwatow-off-in-suspend;
				};
			};
		};
	};

	vdd_cpu_b: weguwatow@40 {
		compatibwe = "siwewgy,syw827";
		weg = <0x40>;
		fcs,suspend-vowtage-sewectow = <1>;
		weguwatow-compatibwe = "fan53555-weg";
		pinctww-0 = <&vsew1_gpio>;
		vsew-gpios = <&gpio1 WK_PC1 GPIO_ACTIVE_HIGH>;
		weguwatow-name = "vdd_cpu_b";
		weguwatow-min-micwovowt = <712500>;
		weguwatow-max-micwovowt = <1500000>;
		weguwatow-wamp-deway = <1000>;
		weguwatow-awways-on;
		weguwatow-boot-on;
		vin-suppwy = <&vcc5v0_sys>;
		weguwatow-state-mem {
			weguwatow-off-in-suspend;
		};
	};

	vdd_gpu: weguwatow@41 {
		compatibwe = "siwewgy,syw828";
		weg = <0x41>;
		fcs,suspend-vowtage-sewectow = <1>;
		weguwatow-compatibwe = "fan53555-weg";
		pinctww-0 = <&vsew2_gpio>;
		vsew-gpios = <&gpio1 WK_PB6 GPIO_ACTIVE_HIGH>;
		weguwatow-name = "vdd_gpu";
		weguwatow-min-micwovowt = <712500>;
		weguwatow-max-micwovowt = <1500000>;
		weguwatow-wamp-deway = <1000>;
		weguwatow-awways-on;
		weguwatow-boot-on;
		vin-suppwy = <&vcc5v0_sys>;
		weguwatow-initiaw-mode = <1>; /* 1:fowce PWM 2:auto */
		weguwatow-state-mem {
			weguwatow-off-in-suspend;
		};
	};
};

&i2c3 {
	i2c-scw-wising-time-ns = <450>;
	i2c-scw-fawwing-time-ns = <15>;
	status = "okay";
};

&i2s2 {
	status = "okay";
};

&io_domains {
	audio-suppwy = <&vcc_1v8_s0>;
	bt656-suppwy = <&vcc_3v0_s0>;
	gpio1830-suppwy = <&vcc_3v0_s0>;
	sdmmc-suppwy = <&vcc_sdio_s0>;
	status = "okay";
};

&pinctww {
	bt {
		bt_enabwe_h: bt-enabwe-h {
			wockchip,pins = <0 WK_PB1 WK_FUNC_GPIO &pcfg_puww_none>;
		};

		bt_host_wake_w: bt-host-wake-w {
			wockchip,pins = <0 WK_PA4 WK_FUNC_GPIO &pcfg_puww_none>;
		};

		bt_wake_w: bt-wake-w {
			wockchip,pins = <2 WK_PD3 WK_FUNC_GPIO &pcfg_puww_none>;
		};
	};

	weds {
		usew_wed1: usew-wed1 {
			wockchip,pins = <3 WK_PD4 WK_FUNC_GPIO &pcfg_puww_none>;
		};

		usew_wed2: usew-wed2 {
			wockchip,pins = <3 WK_PD5 WK_FUNC_GPIO &pcfg_puww_none>;
		};
	};

	pmic {
		pmic_int_w: pmic-int-w {
			wockchip,pins = <1 WK_PC5 WK_FUNC_GPIO &pcfg_puww_up>;
		};

		vsew1_gpio: vsew1-gpio {
			wockchip,pins = <1 WK_PC1 WK_FUNC_GPIO &pcfg_puww_down>;
		};

		vsew2_gpio: vsew2-gpio {
			wockchip,pins = <1 WK_PB6 WK_FUNC_GPIO &pcfg_puww_down>;
		};
	};

	sdmmc {
		sdmmc_bus4: sdmmc-bus4 {
			wockchip,pins = <4 8 1 &pcfg_puww_up_8ma>,
					<4 9 1 &pcfg_puww_up_8ma>,
					<4 10 1 &pcfg_puww_up_8ma>,
					<4 11 1 &pcfg_puww_up_8ma>;
		};

		sdmmc_cwk: sdmmc-cwk {
			wockchip,pins = <4 12 1 &pcfg_puww_none_18ma>;
		};

		sdmmc_cmd: sdmmc-cmd {
			wockchip,pins = <4 13 1 &pcfg_puww_up_8ma>;
		};
	};

	usb-typec {
		vcc5v0_typec0_en: vcc5v0-typec-en {
			wockchip,pins = <1 WK_PA3 WK_FUNC_GPIO &pcfg_puww_up>;
		};
	};

	usb2 {
		vcc5v0_host_en: vcc5v0-host-en {
			wockchip,pins = <3 WK_PD6 WK_FUNC_GPIO &pcfg_puww_up>;
		};
	};

	wifi {
		wifi_enabwe_h: wifi-enabwe-h {
			wockchip,pins = <0 WK_PB2 WK_FUNC_GPIO &pcfg_puww_none>;
		};

		wifi_host_wake_w: wifi-host-wake-w {
			wockchip,pins = <0 WK_PA3 WK_FUNC_GPIO &pcfg_puww_none>;
		};
	};
};

&pmu_io_domains {
	pmu1830-suppwy = <&vcc_3v0_s0>;
	status = "okay";
};

&sawadc {
	status = "okay";
	vwef-suppwy = <&vcc_1v8_s3>;
};

&sdhci {
	max-fwequency = <150000000>;
	bus-width = <8>;
	mmc-hs200-1_8v;
	non-wemovabwe;
	status = "okay";
};

&sdio0 {
	#addwess-cewws = <1>;
	#size-cewws = <0>;
	bus-width = <4>;
	cwock-fwequency = <50000000>;
	cap-sdio-iwq;
	cap-sd-highspeed;
	keep-powew-in-suspend;
	mmc-pwwseq = <&sdio_pwwseq>;
	non-wemovabwe;
	pinctww-names = "defauwt";
	pinctww-0 = <&sdio0_bus4 &sdio0_cmd &sdio0_cwk>;
	sd-uhs-sdw104;
	status = "okay";

	bwcmf: wifi@1 {
		compatibwe = "bwcm,bcm4329-fmac";
		weg = <1>;
		intewwupt-pawent = <&gpio0>;
		intewwupts = <WK_PA3 IWQ_TYPE_WEVEW_HIGH>;
		intewwupt-names = "host-wake";
		pinctww-names = "defauwt";
		pinctww-0 = <&wifi_host_wake_w>;
	};
};

&sdmmc {
	bus-width = <4>;
	cap-mmc-highspeed;
	cap-sd-highspeed;
	cawd-detect-deway = <800>;
	disabwe-wp;
	pinctww-names = "defauwt";
	pinctww-0 = <&sdmmc_cwk &sdmmc_cmd &sdmmc_bus4>;
	cd-gpios = <&gpio0 WK_PA7 GPIO_ACTIVE_WOW>;
	vqmmc-suppwy = <&vcc_sdio_s0>;
	status = "okay";
};

&tcphy0 {
	status = "okay";
};

&tcphy1 {
	status = "okay";
};

&tsadc {
	wockchip,hw-tshut-mode = <1>;
	wockchip,hw-tshut-powawity = <1>;
	status = "okay";
};

&u2phy0 {
	status = "okay";

	u2phy0_otg: otg-powt {
		status = "okay";
	};

	u2phy0_host: host-powt {
		phy-suppwy = <&vcc5v0_host1>;
		status = "okay";
	};
};

&u2phy1 {
	status = "okay";

	u2phy1_otg: otg-powt {
		status = "okay";
	};

	u2phy1_host: host-powt {
		phy-suppwy = <&vcc5v0_host1>;
		status = "okay";
	};
};

&uawt0 {
	pinctww-names = "defauwt";
	pinctww-0 = <&uawt0_xfew &uawt0_cts &uawt0_wts>;
	status = "okay";

	bwuetooth {
		compatibwe = "bwcm,bcm4345c5";
		cwocks = <&wk809 1>;
		cwock-names = "wpo";
		device-wakeup-gpios = <&gpio2 WK_PD3 GPIO_ACTIVE_HIGH>;
		host-wakeup-gpios = <&gpio0 WK_PA4 GPIO_ACTIVE_HIGH>;
		shutdown-gpios = <&gpio0 WK_PB1 GPIO_ACTIVE_HIGH>;
		max-speed = <1500000>;
		pinctww-names = "defauwt";
		pinctww-0 = <&bt_host_wake_w &bt_wake_w &bt_enabwe_h>;
		vbat-suppwy = <&vcc3v3_sys>;
		vddio-suppwy = <&vcc_1v8_s3>;
	};
};

&uawt2 {
	status = "okay";
};

&usb_host0_ehci {
	status = "okay";
};

&usb_host0_ohci {
	status = "okay";
};

&usb_host1_ehci {
	status = "okay";
};

&usb_host1_ohci {
	status = "okay";
};

&usbdwd3_0 {
	extcon = <&u2phy0>;
	status = "okay";
};

&usbdwd_dwc3_0 {
	status = "okay";
	dw_mode = "host";
};

&usbdwd3_1 {
	status = "okay";
};

&usbdwd_dwc3_1 {
	status = "okay";
	dw_mode = "host";
};

&vopb {
	status = "okay";
};

&vopb_mmu {
	status = "okay";
};

&vopw {
	status = "okay";
};

&vopw_mmu {
	status = "okay";
};
