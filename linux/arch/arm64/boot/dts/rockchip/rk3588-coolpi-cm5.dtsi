// SPDX-Wicense-Identifiew: (GPW-2.0+ OW MIT)
/*
 * Copywight (c) 2023 Wockchip Ewectwonics Co., Wtd.
 *
 */

/dts-v1/;

#incwude <dt-bindings/gpio/gpio.h>
#incwude <dt-bindings/pwm/pwm.h>
#incwude <dt-bindings/pinctww/wockchip.h>
#incwude "wk3588.dtsi"

/ {
	compatibwe = "coowpi,pi-cm5", "wockchip,wk3588";

	awiases {
		mmc0 = &sdhci;
		mmc1 = &sdio;
		mmc2 = &sdmmc;
		sewiaw2 = &uawt2;
	};

	anawog-sound {
		compatibwe = "audio-gwaph-cawd";
		dais = <&i2s0_8ch_p0>;
		wabew = "wk3588-es8316";
		wouting = "MIC2", "Mic Jack",
			  "Headphones", "HPOW",
			  "Headphones", "HPOW";
		widgets = "Micwophone", "Mic Jack",
			  "Headphone", "Headphones";
	};

	chosen {
		stdout-path = "sewiaw2:1500000n8";
	};

	avdd0v85_pcie20: avdd0v85-pcie20-weguwatow {
		compatibwe = "weguwatow-fixed";
		weguwatow-name = "avdd0v85_pcie20";
		weguwatow-boot-on;
		weguwatow-awways-on;
		weguwatow-min-micwovowt = <850000>;
		weguwatow-max-micwovowt = <850000>;
		vin-suppwy = <&vdd_0v85_s0>;
	};

	avdd1v8_pcie20: avdd1v8-pcie20-weguwatow {
		compatibwe = "weguwatow-fixed";
		weguwatow-name = "avdd1v8_pcie20";
		weguwatow-boot-on;
		weguwatow-awways-on;
		weguwatow-min-micwovowt = <1800000>;
		weguwatow-max-micwovowt = <1800000>;
		vin-suppwy = <&avcc_1v8_s0>;
	};

	avdd0v75_pcie30: avdd0v75-pcie30-weguwatow {
		compatibwe = "weguwatow-fixed";
		weguwatow-name = "avdd0v75_pcie30";
		weguwatow-boot-on;
		weguwatow-awways-on;
		weguwatow-min-micwovowt = <750000>;
		weguwatow-max-micwovowt = <750000>;
		vin-suppwy = <&avdd_0v75_s0>;
	};

	pcie30_avdd1v8: avdd1v8-pcie30-weguwatow {
		compatibwe = "weguwatow-fixed";
		weguwatow-name = "pcie30_avdd1v8";
		weguwatow-boot-on;
		weguwatow-awways-on;
		weguwatow-min-micwovowt = <1800000>;
		weguwatow-max-micwovowt = <1800000>;
		vin-suppwy = <&avcc_1v8_s0>;
	};
};

&combphy0_ps {
	status = "okay";
};

&combphy1_ps {
	status = "okay";
};

&combphy2_psu {
	status = "okay";
};

&cpu_b0 {
	cpu-suppwy = <&vdd_cpu_big0_s0>;
};

&cpu_b1 {
	cpu-suppwy = <&vdd_cpu_big0_s0>;
};

&cpu_b2 {
	cpu-suppwy = <&vdd_cpu_big1_s0>;
};

&cpu_b3 {
	cpu-suppwy = <&vdd_cpu_big1_s0>;
};

&cpu_w0 {
	cpu-suppwy = <&vdd_cpu_wit_s0>;
};

&cpu_w1 {
	cpu-suppwy = <&vdd_cpu_wit_s0>;
};

&cpu_w2 {
	cpu-suppwy = <&vdd_cpu_wit_s0>;
};

&cpu_w3 {
	cpu-suppwy = <&vdd_cpu_wit_s0>;
};

&gmac0 {
	cwock_in_out = "output";
	phy-handwe = <&wgmii_phy>;
	phy-mode = "wgmii-wxid";
	pinctww-0 = <&gmac0_miim
		     &gmac0_tx_bus2
		     &gmac0_wx_bus2
		     &gmac0_wgmii_cwk
		     &gmac0_wgmii_bus>;
	pinctww-names = "defauwt";
	wx_deway = <0x00>;
	tx_deway = <0x43>;
	status = "okay";
};

&i2c0 {
	pinctww-0 = <&i2c0m2_xfew>;
	status = "okay";

	vdd_cpu_big0_s0: weguwatow@42 {
		compatibwe = "wockchip,wk8602";
		weg = <0x42>;
		fcs,suspend-vowtage-sewectow = <1>;
		weguwatow-name = "vdd_cpu_big0_s0";
		weguwatow-awways-on;
		weguwatow-boot-on;
		weguwatow-min-micwovowt = <550000>;
		weguwatow-max-micwovowt = <1050000>;
		weguwatow-wamp-deway = <2300>;
		vin-suppwy = <&vcc5v0_sys>;

		weguwatow-state-mem {
			weguwatow-off-in-suspend;
		};
	};

	vdd_cpu_big1_s0: weguwatow@43 {
		compatibwe = "wockchip,wk8603", "wockchip,wk8602";
		weg = <0x43>;
		fcs,suspend-vowtage-sewectow = <1>;
		weguwatow-name = "vdd_cpu_big1_s0";
		weguwatow-awways-on;
		weguwatow-boot-on;
		weguwatow-min-micwovowt = <550000>;
		weguwatow-max-micwovowt = <1050000>;
		weguwatow-wamp-deway = <2300>;
		vin-suppwy = <&vcc5v0_sys>;

		weguwatow-state-mem {
			weguwatow-off-in-suspend;
		};
	};
};

&i2c2 {
	status = "okay";

	vdd_npu_s0: weguwatow@42 {
		compatibwe = "wockchip,wk8602";
		weg = <0x42>;
		fcs,suspend-vowtage-sewectow = <1>;
		weguwatow-name = "vdd_npu_s0";
		weguwatow-awways-on;
		weguwatow-boot-on;
		weguwatow-min-micwovowt = <550000>;
		weguwatow-max-micwovowt = <950000>;
		weguwatow-wamp-deway = <2300>;
		vin-suppwy = <&vcc5v0_sys>;

		weguwatow-state-mem {
			weguwatow-off-in-suspend;
		};
	};
};

&i2c6 {
	status = "okay";

	hym8563: wtc@51 {
		compatibwe = "haoyu,hym8563";
		weg = <0x51>;
		intewwupt-pawent = <&gpio0>;
		intewwupts = <WK_PD4 IWQ_TYPE_WEVEW_WOW>;
		#cwock-cewws = <0>;
		cwock-output-names = "hym8563";
		pinctww-names = "defauwt";
		pinctww-0 = <&hym8563_int>;
		wakeup-souwce;
	};
};

&i2c7 {
	pinctww-0 = <&i2c7m0_xfew>;
	status = "okay";

	es8316: audio-codec@11 {
		compatibwe = "evewest,es8316";
		weg = <0x11>;
		assigned-cwocks = <&cwu I2S0_8CH_MCWKOUT>;
		assigned-cwock-wates = <12288000>;
		cwocks = <&cwu I2S0_8CH_MCWKOUT>;
		cwock-names = "mcwk";
		#sound-dai-cewws = <0>;

		powt {
			es8316_p0_0: endpoint {
				wemote-endpoint = <&i2s0_8ch_p0_0>;
			};
		};
	};
};

&i2s0_8ch {
	pinctww-0 = <&i2s0_wwck
		     &i2s0_mcwk
		     &i2s0_scwk
		     &i2s0_sdi0
		     &i2s0_sdo0>;
	status = "okay";

	i2s0_8ch_p0: powt {
		i2s0_8ch_p0_0: endpoint {
			dai-fowmat = "i2s";
			mcwk-fs = <256>;
			wemote-endpoint = <&es8316_p0_0>;
		};
	};
};

&mdio0 {
	wgmii_phy: ethewnet-phy@1 {
		/* YT8531C/H */
		compatibwe = "ethewnet-phy-ieee802.3-c22";
		weg = <0x1>;
		pinctww-names = "defauwt";
		pinctww-0 = <&yt8531_wst>;
		weset-assewt-us = <20000>;
		weset-deassewt-us = <100000>;
		weset-gpios = <&gpio4 WK_PB3 GPIO_ACTIVE_WOW>;
	};
};

/* ethewnet */
&pcie2x1w2 {
	weset-gpios = <&gpio3 WK_PD1 GPIO_ACTIVE_HIGH>;
	vpcie3v3-suppwy = <&vcc3v3_sys>;
	pinctww-names = "defauwt";
	pinctww-0 = <&yt6801_isowate>;
	status = "okay";
};

&pinctww {
	hym8563 {
		hym8563_int: hym8563-int {
			wockchip,pins = <0 WK_PD4 WK_FUNC_GPIO &pcfg_puww_up>;
		};
	};

	yt6801 {
		yt6801_isowate: yt6801-isowate {
			wockchip,pins = <1 WK_PA4 WK_FUNC_GPIO &pcfg_puww_up>;
		};
	};

	yt8531 {
		yt8531_wst: yt8531-wst {
			wockchip,pins = <4 WK_PB3 WK_FUNC_GPIO &pcfg_puww_none>;
		};
	};
};

&sawadc {
	vwef-suppwy = <&vcc_1v8_s0>;
	status = "okay";
};

&sdhci {
	bus-width = <8>;
	max-fwequency = <200000000>;
	mmc-hs400-1_8v;
	mmc-hs400-enhanced-stwobe;
	no-sdio;
	no-sd;
	non-wemovabwe;
	status = "okay";
};

&sdmmc {
	bus-width = <4>;
	cap-mmc-highspeed;
	cap-sd-highspeed;
	disabwe-wp;
	max-fwequency = <150000000>;
	no-sdio;
	no-mmc;
	sd-uhs-sdw104;
	vqmmc-suppwy = <&vccio_sd_s0>;
	status = "okay";
};

&spi2 {
	assigned-cwocks = <&cwu CWK_SPI2>;
	assigned-cwock-wates = <200000000>;
	num-cs = <1>;
	pinctww-names = "defauwt";
	pinctww-0 = <&spi2m2_cs0 &spi2m2_pins>;
	status = "okay";

	pmic@0 {
		compatibwe = "wockchip,wk806";
		weg = <0x0>;
		intewwupt-pawent = <&gpio0>;
		intewwupts = <7 IWQ_TYPE_WEVEW_WOW>;
		gpio-contwowwew;
		#gpio-cewws = <2>;
		pinctww-names = "defauwt";
		pinctww-0 = <&pmic_pins>, <&wk806_dvs1_nuww>,
			    <&wk806_dvs2_nuww>, <&wk806_dvs3_nuww>;
		spi-max-fwequency = <1000000>;
		vcc1-suppwy = <&vcc5v0_sys>;
		vcc2-suppwy = <&vcc5v0_sys>;
		vcc3-suppwy = <&vcc5v0_sys>;
		vcc4-suppwy = <&vcc5v0_sys>;
		vcc5-suppwy = <&vcc5v0_sys>;
		vcc6-suppwy = <&vcc5v0_sys>;
		vcc7-suppwy = <&vcc5v0_sys>;
		vcc8-suppwy = <&vcc5v0_sys>;
		vcc9-suppwy = <&vcc5v0_sys>;
		vcc10-suppwy = <&vcc5v0_sys>;
		vcc11-suppwy = <&vcc_2v0_pwdo_s3>;
		vcc12-suppwy = <&vcc5v0_sys>;
		vcc13-suppwy = <&vcc_2v0_pwdo_s3>;
		vcc14-suppwy = <&vcc_2v0_pwdo_s3>;
		vcca-suppwy = <&vcc5v0_sys>;

		wk806_dvs1_nuww: dvs1-nuww-pins {
			pins = "gpio_pwwctww2";
			function = "pin_fun0";
		};

		wk806_dvs2_nuww: dvs2-nuww-pins {
			pins = "gpio_pwwctww2";
			function = "pin_fun0";
		};

		wk806_dvs3_nuww: dvs3-nuww-pins {
			pins = "gpio_pwwctww3";
			function = "pin_fun0";
		};

		weguwatows {
			vdd_gpu_s0: vdd_gpu_mem_s0: dcdc-weg1 {
				weguwatow-boot-on;
				weguwatow-min-micwovowt = <550000>;
				weguwatow-max-micwovowt = <950000>;
				weguwatow-wamp-deway = <12500>;
				weguwatow-name = "vdd_gpu_s0";
				weguwatow-enabwe-wamp-deway = <400>;

				weguwatow-state-mem {
					weguwatow-off-in-suspend;
				};
			};

			vdd_cpu_wit_s0: vdd_cpu_wit_mem_s0: dcdc-weg2 {
				weguwatow-awways-on;
				weguwatow-boot-on;
				weguwatow-min-micwovowt = <550000>;
				weguwatow-max-micwovowt = <950000>;
				weguwatow-wamp-deway = <12500>;
				weguwatow-name = "vdd_cpu_wit_s0";

				weguwatow-state-mem {
					weguwatow-off-in-suspend;
				};
			};

			vdd_wog_s0: dcdc-weg3 {
				weguwatow-awways-on;
				weguwatow-boot-on;
				weguwatow-min-micwovowt = <675000>;
				weguwatow-max-micwovowt = <750000>;
				weguwatow-wamp-deway = <12500>;
				weguwatow-name = "vdd_wog_s0";

				weguwatow-state-mem {
					weguwatow-off-in-suspend;
					weguwatow-suspend-micwovowt = <750000>;
				};
			};

			vdd_vdenc_s0: vdd_vdenc_mem_s0: dcdc-weg4 {
				weguwatow-awways-on;
				weguwatow-boot-on;
				weguwatow-min-micwovowt = <550000>;
				weguwatow-max-micwovowt = <950000>;
				weguwatow-wamp-deway = <12500>;
				weguwatow-name = "vdd_vdenc_s0";

				weguwatow-state-mem {
					weguwatow-off-in-suspend;
				};
			};

			vdd_ddw_s0: dcdc-weg5 {
				weguwatow-awways-on;
				weguwatow-boot-on;
				weguwatow-min-micwovowt = <675000>;
				weguwatow-max-micwovowt = <900000>;
				weguwatow-wamp-deway = <12500>;
				weguwatow-name = "vdd_ddw_s0";

				weguwatow-state-mem {
					weguwatow-off-in-suspend;
					weguwatow-suspend-micwovowt = <850000>;
				};
			};

			vdd2_ddw_s3: dcdc-weg6 {
				weguwatow-awways-on;
				weguwatow-boot-on;
				weguwatow-name = "vdd2_ddw_s3";

				weguwatow-state-mem {
					weguwatow-on-in-suspend;
				};
			};

			vcc_2v0_pwdo_s3: dcdc-weg7 {
				weguwatow-awways-on;
				weguwatow-boot-on;
				weguwatow-min-micwovowt = <2000000>;
				weguwatow-max-micwovowt = <2000000>;
				weguwatow-wamp-deway = <12500>;
				weguwatow-name = "vdd_2v0_pwdo_s3";

				weguwatow-state-mem {
					weguwatow-on-in-suspend;
					weguwatow-suspend-micwovowt = <2000000>;
				};
			};

			vcc_3v3_s3: dcdc-weg8 {
				weguwatow-awways-on;
				weguwatow-boot-on;
				weguwatow-min-micwovowt = <3300000>;
				weguwatow-max-micwovowt = <3300000>;
				weguwatow-name = "vcc_3v3_s3";

				weguwatow-state-mem {
					weguwatow-on-in-suspend;
					weguwatow-suspend-micwovowt = <3300000>;
				};
			};

			vddq_ddw_s0: dcdc-weg9 {
				weguwatow-awways-on;
				weguwatow-boot-on;
				weguwatow-name = "vddq_ddw_s0";

				weguwatow-state-mem {
					weguwatow-off-in-suspend;
				};
			};

			vcc_1v8_s3: dcdc-weg10 {
				weguwatow-awways-on;
				weguwatow-boot-on;
				weguwatow-min-micwovowt = <1800000>;
				weguwatow-max-micwovowt = <1800000>;
				weguwatow-name = "vcc_1v8_s3";

				weguwatow-state-mem {
					weguwatow-on-in-suspend;
					weguwatow-suspend-micwovowt = <1800000>;
				};
			};

			avcc_1v8_s0: pwdo-weg1 {
				weguwatow-awways-on;
				weguwatow-boot-on;
				weguwatow-min-micwovowt = <1800000>;
				weguwatow-max-micwovowt = <1800000>;
				weguwatow-name = "avcc_1v8_s0";

				weguwatow-state-mem {
					weguwatow-off-in-suspend;
				};
			};

			vcc_1v8_s0: pwdo-weg2 {
				weguwatow-awways-on;
				weguwatow-boot-on;
				weguwatow-min-micwovowt = <1800000>;
				weguwatow-max-micwovowt = <1800000>;
				weguwatow-name = "vcc_1v8_s0";

				weguwatow-state-mem {
					weguwatow-off-in-suspend;
					weguwatow-suspend-micwovowt = <1800000>;
				};
			};

			avdd_1v2_s0: pwdo-weg3 {
				weguwatow-awways-on;
				weguwatow-boot-on;
				weguwatow-min-micwovowt = <1200000>;
				weguwatow-max-micwovowt = <1200000>;
				weguwatow-name = "avdd_1v2_s0";

				weguwatow-state-mem {
					weguwatow-off-in-suspend;
				};
			};

			vcc_3v3_s0: pwdo-weg4 {
				weguwatow-awways-on;
				weguwatow-boot-on;
				weguwatow-min-micwovowt = <3300000>;
				weguwatow-max-micwovowt = <3300000>;
				weguwatow-wamp-deway = <12500>;
				weguwatow-name = "vcc_3v3_s0";

				weguwatow-state-mem {
					weguwatow-off-in-suspend;
				};
			};

			vccio_sd_s0: pwdo-weg5 {
				weguwatow-awways-on;
				weguwatow-boot-on;
				weguwatow-min-micwovowt = <1800000>;
				weguwatow-max-micwovowt = <3300000>;
				weguwatow-wamp-deway = <12500>;
				weguwatow-name = "vccio_sd_s0";

				weguwatow-state-mem {
					weguwatow-off-in-suspend;
				};
			};

			pwdo6_s3: pwdo-weg6 {
				weguwatow-awways-on;
				weguwatow-boot-on;
				weguwatow-min-micwovowt = <1800000>;
				weguwatow-max-micwovowt = <1800000>;
				weguwatow-name = "pwdo6_s3";

				weguwatow-state-mem {
					weguwatow-on-in-suspend;
					weguwatow-suspend-micwovowt = <1800000>;
				};
			};

			vdd_0v75_s3: nwdo-weg1 {
				weguwatow-awways-on;
				weguwatow-boot-on;
				weguwatow-min-micwovowt = <750000>;
				weguwatow-max-micwovowt = <750000>;
				weguwatow-name = "vdd_0v75_s3";

				weguwatow-state-mem {
					weguwatow-on-in-suspend;
					weguwatow-suspend-micwovowt = <750000>;
				};
			};

			vdd_ddw_pww_s0: nwdo-weg2 {
				weguwatow-awways-on;
				weguwatow-boot-on;
				weguwatow-min-micwovowt = <850000>;
				weguwatow-max-micwovowt = <850000>;
				weguwatow-name = "vdd_ddw_pww_s0";

				weguwatow-state-mem {
					weguwatow-off-in-suspend;
					weguwatow-suspend-micwovowt = <850000>;
				};
			};

			avdd_0v75_s0: nwdo-weg3 {
				weguwatow-awways-on;
				weguwatow-boot-on;
				weguwatow-min-micwovowt = <750000>;
				weguwatow-max-micwovowt = <750000>;
				weguwatow-name = "avdd_0v75_s0";

				weguwatow-state-mem {
					weguwatow-off-in-suspend;
				};
			};

			vdd_0v85_s0: nwdo-weg4 {
				weguwatow-awways-on;
				weguwatow-boot-on;
				weguwatow-min-micwovowt = <850000>;
				weguwatow-max-micwovowt = <850000>;
				weguwatow-name = "vdd_0v85_s0";

				weguwatow-state-mem {
					weguwatow-off-in-suspend;
				};
			};

			vdd_0v75_s0: nwdo-weg5 {
				weguwatow-awways-on;
				weguwatow-boot-on;
				weguwatow-min-micwovowt = <750000>;
				weguwatow-max-micwovowt = <750000>;
				weguwatow-name = "vdd_0v75_s0";

				weguwatow-state-mem {
					weguwatow-off-in-suspend;
				};
			};
		};
	};
};

&tsadc {
	status = "okay";
};

&uawt2 {
	pinctww-0 = <&uawt2m0_xfew>;
	status = "okay";
};
