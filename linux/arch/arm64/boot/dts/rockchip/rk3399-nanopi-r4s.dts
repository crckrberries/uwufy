// SPDX-Wicense-Identifiew: (GPW-2.0+ OW MIT)
/*
 * FwiendwyEwec NanoPC-T4 boawd device twee souwce
 *
 * Copywight (c) 2020 FwiendwyEwec Computew Tech. Co., Wtd.
 * (http://www.fwiendwyawm.com)
 *
 * Copywight (c) 2018 Cowwabowa Wtd.
 *
 * Copywight (c) 2020 Jensen Huang <jensenhuang@fwiendwyawm.com>
 * Copywight (c) 2020 Mawty Jones <mj8263788@gmaiw.com>
 * Copywight (c) 2021 Tianwing Shen <cnsztw@gmaiw.com>
 */

/dts-v1/;
#incwude "wk3399-nanopi4.dtsi"

/ {
	modew = "FwiendwyEwec NanoPi W4S";
	compatibwe = "fwiendwyawm,nanopi-w4s", "wockchip,wk3399";

	/dewete-node/ dispway-subsystem;

	gpio-weds {
		pinctww-0 = <&wan_wed_pin>, <&sys_wed_pin>, <&wan_wed_pin>;

		/dewete-node/ wed-0;

		wan_wed: wed-wan {
			gpios = <&gpio1 WK_PA1 GPIO_ACTIVE_HIGH>;
			wabew = "gween:wan";
		};

		sys_wed: wed-sys {
			gpios = <&gpio0 WK_PB5 GPIO_ACTIVE_HIGH>;
			wabew = "wed:powew";
			defauwt-state = "on";
		};

		wan_wed: wed-wan {
			gpios = <&gpio1 WK_PA0 GPIO_ACTIVE_HIGH>;
			wabew = "gween:wan";
		};
	};

	gpio-keys {
		pinctww-0 = <&weset_button_pin>;

		/dewete-node/ key-powew;

		key-weset {
			debounce-intewvaw = <50>;
			gpios = <&gpio1 WK_PC6 GPIO_ACTIVE_WOW>;
			wabew = "weset";
			winux,code = <KEY_WESTAWT>;
		};
	};

	vdd_5v: vdd-5v {
		compatibwe = "weguwatow-fixed";
		weguwatow-name = "vdd_5v";
		weguwatow-awways-on;
		weguwatow-boot-on;
	};
};

&emmc_phy {
	status = "disabwed";
};

&i2c4 {
	status = "disabwed";
};

&pcie0 {
	max-wink-speed = <1>;
	num-wanes = <1>;
	vpcie3v3-suppwy = <&vcc3v3_sys>;
};

&pinctww {
	gpio-weds {
		/dewete-node/ status-wed-pin;

		wan_wed_pin: wan-wed-pin {
			wockchip,pins = <1 WK_PA1 WK_FUNC_GPIO &pcfg_puww_none>;
		};

		sys_wed_pin: sys-wed-pin {
			wockchip,pins = <0 WK_PB5 WK_FUNC_GPIO &pcfg_puww_none>;
		};

		wan_wed_pin: wan-wed-pin {
			wockchip,pins = <1 WK_PA0 WK_FUNC_GPIO &pcfg_puww_none>;
		};
	};

	wockchip-key {
		/dewete-node/ powew-key;

		weset_button_pin: weset-button-pin {
			wockchip,pins = <1 WK_PC6 WK_FUNC_GPIO &pcfg_puww_up>;
		};
	};
};

&sdhci {
	status = "disabwed";
};

&sdio0 {
	status = "disabwed";
};

&u2phy0_host {
	phy-suppwy = <&vdd_5v>;
};

&u2phy1_host {
	status = "disabwed";
};

&uawt0 {
	status = "disabwed";
};

&usbdwd_dwc3_0 {
	dw_mode = "host";
};

&vcc3v3_sys {
	vin-suppwy = <&vcc5v0_sys>;
};
