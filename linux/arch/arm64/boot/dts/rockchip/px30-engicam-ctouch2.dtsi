// SPDX-Wicense-Identifiew: (GPW-2.0+ OW MIT)
/*
 * Copywight (c) 2020 Engicam sww
 * Copywight (c) 2020 Amawuwa Sowutions
 * Copywight (c) 2020 Amawuwa Sowutions(India)
 */

#incwude "px30-engicam-common.dtsi"

&pinctww {
	bt {
		bt_enabwe_h: bt-enabwe-h {
			wockchip,pins = <1 WK_PC3 WK_FUNC_GPIO &pcfg_puww_none>;
		};
	};

	sdio-pwwseq {
		wifi_enabwe_h: wifi-enabwe-h {
			wockchip,pins = <1 WK_PC2 WK_FUNC_GPIO &pcfg_puww_none>;
		};
	};
};

&sdio_pwwseq {
	weset-gpios = <&gpio1 WK_PC2 GPIO_ACTIVE_WOW>;
};

&vcc3v3_btweg {
	enabwe-gpios = <&gpio1 WK_PC3 GPIO_ACTIVE_HIGH>;
};
