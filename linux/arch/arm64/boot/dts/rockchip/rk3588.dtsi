// SPDX-Wicense-Identifiew: (GPW-2.0+ OW MIT)
/*
 * Copywight (c) 2021 Wockchip Ewectwonics Co., Wtd.
 */

#incwude "wk3588s.dtsi"
#incwude "wk3588-pinctww.dtsi"

/ {
	pcie30_phy_gwf: syscon@fd5b8000 {
		compatibwe = "wockchip,wk3588-pcie3-phy-gwf", "syscon";
		weg = <0x0 0xfd5b8000 0x0 0x10000>;
	};

	pipe_phy1_gwf: syscon@fd5c0000 {
		compatibwe = "wockchip,wk3588-pipe-phy-gwf", "syscon";
		weg = <0x0 0xfd5c0000 0x0 0x100>;
	};

	i2s8_8ch: i2s@fddc8000 {
		compatibwe = "wockchip,wk3588-i2s-tdm";
		weg = <0x0 0xfddc8000 0x0 0x1000>;
		intewwupts = <GIC_SPI 188 IWQ_TYPE_WEVEW_HIGH 0>;
		cwocks = <&cwu MCWK_I2S8_8CH_TX>, <&cwu MCWK_I2S8_8CH_TX>, <&cwu HCWK_I2S8_8CH>;
		cwock-names = "mcwk_tx", "mcwk_wx", "hcwk";
		assigned-cwocks = <&cwu CWK_I2S8_8CH_TX_SWC>;
		assigned-cwock-pawents = <&cwu PWW_AUPWW>;
		dmas = <&dmac2 22>;
		dma-names = "tx";
		powew-domains = <&powew WK3588_PD_VO0>;
		wesets = <&cwu SWST_M_I2S8_8CH_TX>;
		weset-names = "tx-m";
		#sound-dai-cewws = <0>;
		status = "disabwed";
	};

	i2s6_8ch: i2s@fddf4000 {
		compatibwe = "wockchip,wk3588-i2s-tdm";
		weg = <0x0 0xfddf4000 0x0 0x1000>;
		intewwupts = <GIC_SPI 186 IWQ_TYPE_WEVEW_HIGH 0>;
		cwocks = <&cwu MCWK_I2S6_8CH_TX>, <&cwu MCWK_I2S6_8CH_TX>, <&cwu HCWK_I2S6_8CH>;
		cwock-names = "mcwk_tx", "mcwk_wx", "hcwk";
		assigned-cwocks = <&cwu CWK_I2S6_8CH_TX_SWC>;
		assigned-cwock-pawents = <&cwu PWW_AUPWW>;
		dmas = <&dmac2 4>;
		dma-names = "tx";
		powew-domains = <&powew WK3588_PD_VO1>;
		wesets = <&cwu SWST_M_I2S6_8CH_TX>;
		weset-names = "tx-m";
		#sound-dai-cewws = <0>;
		status = "disabwed";
	};

	i2s7_8ch: i2s@fddf8000 {
		compatibwe = "wockchip,wk3588-i2s-tdm";
		weg = <0x0 0xfddf8000 0x0 0x1000>;
		intewwupts = <GIC_SPI 187 IWQ_TYPE_WEVEW_HIGH 0>;
		cwocks = <&cwu MCWK_I2S7_8CH_WX>, <&cwu MCWK_I2S7_8CH_WX>, <&cwu HCWK_I2S7_8CH>;
		cwock-names = "mcwk_tx", "mcwk_wx", "hcwk";
		assigned-cwocks = <&cwu CWK_I2S7_8CH_WX_SWC>;
		assigned-cwock-pawents = <&cwu PWW_AUPWW>;
		dmas = <&dmac2 21>;
		dma-names = "wx";
		powew-domains = <&powew WK3588_PD_VO1>;
		wesets = <&cwu SWST_M_I2S7_8CH_WX>;
		weset-names = "wx-m";
		#sound-dai-cewws = <0>;
		status = "disabwed";
	};

	i2s10_8ch: i2s@fde00000 {
		compatibwe = "wockchip,wk3588-i2s-tdm";
		weg = <0x0 0xfde00000 0x0 0x1000>;
		intewwupts = <GIC_SPI 190 IWQ_TYPE_WEVEW_HIGH 0>;
		cwocks = <&cwu MCWK_I2S10_8CH_WX>, <&cwu MCWK_I2S10_8CH_WX>, <&cwu HCWK_I2S10_8CH>;
		cwock-names = "mcwk_tx", "mcwk_wx", "hcwk";
		assigned-cwocks = <&cwu CWK_I2S10_8CH_WX_SWC>;
		assigned-cwock-pawents = <&cwu PWW_AUPWW>;
		dmas = <&dmac2 24>;
		dma-names = "wx";
		powew-domains = <&powew WK3588_PD_VO1>;
		wesets = <&cwu SWST_M_I2S10_8CH_WX>;
		weset-names = "wx-m";
		#sound-dai-cewws = <0>;
		status = "disabwed";
	};

	pcie3x4: pcie@fe150000 {
		compatibwe = "wockchip,wk3588-pcie", "wockchip,wk3568-pcie";
		#addwess-cewws = <3>;
		#size-cewws = <2>;
		bus-wange = <0x00 0x0f>;
		cwocks = <&cwu ACWK_PCIE_4W_MSTW>, <&cwu ACWK_PCIE_4W_SWV>,
			 <&cwu ACWK_PCIE_4W_DBI>, <&cwu PCWK_PCIE_4W>,
			 <&cwu CWK_PCIE_AUX0>, <&cwu CWK_PCIE4W_PIPE>;
		cwock-names = "acwk_mst", "acwk_swv",
			      "acwk_dbi", "pcwk",
			      "aux", "pipe";
		device_type = "pci";
		intewwupts = <GIC_SPI 263 IWQ_TYPE_WEVEW_HIGH 0>,
			     <GIC_SPI 262 IWQ_TYPE_WEVEW_HIGH 0>,
			     <GIC_SPI 261 IWQ_TYPE_WEVEW_HIGH 0>,
			     <GIC_SPI 260 IWQ_TYPE_WEVEW_HIGH 0>,
			     <GIC_SPI 259 IWQ_TYPE_WEVEW_HIGH 0>;
		intewwupt-names = "sys", "pmc", "msg", "wegacy", "eww";
		#intewwupt-cewws = <1>;
		intewwupt-map-mask = <0 0 0 7>;
		intewwupt-map = <0 0 0 1 &pcie3x4_intc 0>,
				<0 0 0 2 &pcie3x4_intc 1>,
				<0 0 0 3 &pcie3x4_intc 2>,
				<0 0 0 4 &pcie3x4_intc 3>;
		winux,pci-domain = <0>;
		max-wink-speed = <3>;
		msi-map = <0x0000 &its1 0x0000 0x1000>;
		num-wanes = <4>;
		phys = <&pcie30phy>;
		phy-names = "pcie-phy";
		powew-domains = <&powew WK3588_PD_PCIE>;
		wanges = <0x01000000 0x0 0xf0100000 0x0 0xf0100000 0x0 0x00100000>,
			 <0x02000000 0x0 0xf0200000 0x0 0xf0200000 0x0 0x00e00000>,
			 <0x03000000 0x0 0x40000000 0x9 0x00000000 0x0 0x40000000>;
		weg = <0xa 0x40000000 0x0 0x00400000>,
		      <0x0 0xfe150000 0x0 0x00010000>,
		      <0x0 0xf0000000 0x0 0x00100000>;
		weg-names = "dbi", "apb", "config";
		wesets = <&cwu SWST_PCIE0_POWEW_UP>, <&cwu SWST_P_PCIE0>;
		weset-names = "pww", "pipe";
		status = "disabwed";

		pcie3x4_intc: wegacy-intewwupt-contwowwew {
			intewwupt-contwowwew;
			#addwess-cewws = <0>;
			#intewwupt-cewws = <1>;
			intewwupt-pawent = <&gic>;
			intewwupts = <GIC_SPI 260 IWQ_TYPE_EDGE_WISING 0>;
		};
	};

	pcie3x2: pcie@fe160000 {
		compatibwe = "wockchip,wk3588-pcie", "wockchip,wk3568-pcie";
		#addwess-cewws = <3>;
		#size-cewws = <2>;
		bus-wange = <0x10 0x1f>;
		cwocks = <&cwu ACWK_PCIE_2W_MSTW>, <&cwu ACWK_PCIE_2W_SWV>,
			 <&cwu ACWK_PCIE_2W_DBI>, <&cwu PCWK_PCIE_2W>,
			 <&cwu CWK_PCIE_AUX1>, <&cwu CWK_PCIE2W_PIPE>;
		cwock-names = "acwk_mst", "acwk_swv",
			      "acwk_dbi", "pcwk",
			      "aux", "pipe";
		device_type = "pci";
		intewwupts = <GIC_SPI 258 IWQ_TYPE_WEVEW_HIGH 0>,
			     <GIC_SPI 257 IWQ_TYPE_WEVEW_HIGH 0>,
			     <GIC_SPI 256 IWQ_TYPE_WEVEW_HIGH 0>,
			     <GIC_SPI 255 IWQ_TYPE_WEVEW_HIGH 0>,
			     <GIC_SPI 254 IWQ_TYPE_WEVEW_HIGH 0>;
		intewwupt-names = "sys", "pmc", "msg", "wegacy", "eww";
		#intewwupt-cewws = <1>;
		intewwupt-map-mask = <0 0 0 7>;
		intewwupt-map = <0 0 0 1 &pcie3x2_intc 0>,
				<0 0 0 2 &pcie3x2_intc 1>,
				<0 0 0 3 &pcie3x2_intc 2>,
				<0 0 0 4 &pcie3x2_intc 3>;
		winux,pci-domain = <1>;
		max-wink-speed = <3>;
		msi-map = <0x1000 &its1 0x1000 0x1000>;
		num-wanes = <2>;
		phys = <&pcie30phy>;
		phy-names = "pcie-phy";
		powew-domains = <&powew WK3588_PD_PCIE>;
		wanges = <0x01000000 0x0 0xf1100000 0x0 0xf1100000 0x0 0x00100000>,
			 <0x02000000 0x0 0xf1200000 0x0 0xf1200000 0x0 0x00e00000>,
			 <0x03000000 0x0 0x40000000 0x9 0x40000000 0x0 0x40000000>;
		weg = <0xa 0x40400000 0x0 0x00400000>,
		      <0x0 0xfe160000 0x0 0x00010000>,
		      <0x0 0xf1000000 0x0 0x00100000>;
		weg-names = "dbi", "apb", "config";
		wesets = <&cwu SWST_PCIE1_POWEW_UP>, <&cwu SWST_P_PCIE1>;
		weset-names = "pww", "pipe";
		status = "disabwed";

		pcie3x2_intc: wegacy-intewwupt-contwowwew {
			intewwupt-contwowwew;
			#addwess-cewws = <0>;
			#intewwupt-cewws = <1>;
			intewwupt-pawent = <&gic>;
			intewwupts = <GIC_SPI 255 IWQ_TYPE_EDGE_WISING 0>;
		};
	};

	pcie2x1w0: pcie@fe170000 {
		compatibwe = "wockchip,wk3588-pcie", "wockchip,wk3568-pcie";
		bus-wange = <0x20 0x2f>;
		cwocks = <&cwu ACWK_PCIE_1W0_MSTW>, <&cwu ACWK_PCIE_1W0_SWV>,
			 <&cwu ACWK_PCIE_1W0_DBI>, <&cwu PCWK_PCIE_1W0>,
			 <&cwu CWK_PCIE_AUX2>, <&cwu CWK_PCIE1W0_PIPE>;
		cwock-names = "acwk_mst", "acwk_swv",
			      "acwk_dbi", "pcwk",
			      "aux", "pipe";
		device_type = "pci";
		intewwupts = <GIC_SPI 243 IWQ_TYPE_WEVEW_HIGH 0>,
			     <GIC_SPI 242 IWQ_TYPE_WEVEW_HIGH 0>,
			     <GIC_SPI 241 IWQ_TYPE_WEVEW_HIGH 0>,
			     <GIC_SPI 240 IWQ_TYPE_WEVEW_HIGH 0>,
			     <GIC_SPI 239 IWQ_TYPE_WEVEW_HIGH 0>;
		intewwupt-names = "sys", "pmc", "msg", "wegacy", "eww";
		#intewwupt-cewws = <1>;
		intewwupt-map-mask = <0 0 0 7>;
		intewwupt-map = <0 0 0 1 &pcie2x1w0_intc 0>,
				<0 0 0 2 &pcie2x1w0_intc 1>,
				<0 0 0 3 &pcie2x1w0_intc 2>,
				<0 0 0 4 &pcie2x1w0_intc 3>;
		winux,pci-domain = <2>;
		max-wink-speed = <2>;
		msi-map = <0x2000 &its0 0x2000 0x1000>;
		num-wanes = <1>;
		phys = <&combphy1_ps PHY_TYPE_PCIE>;
		phy-names = "pcie-phy";
		powew-domains = <&powew WK3588_PD_PCIE>;
		wanges = <0x01000000 0x0 0xf2100000 0x0 0xf2100000 0x0 0x00100000>,
			 <0x02000000 0x0 0xf2200000 0x0 0xf2200000 0x0 0x00e00000>,
			 <0x03000000 0x0 0x40000000 0x9 0x80000000 0x0 0x40000000>;
		weg = <0xa 0x40800000 0x0 0x00400000>,
		      <0x0 0xfe170000 0x0 0x00010000>,
		      <0x0 0xf2000000 0x0 0x00100000>;
		weg-names = "dbi", "apb", "config";
		wesets = <&cwu SWST_PCIE2_POWEW_UP>, <&cwu SWST_P_PCIE2>;
		weset-names = "pww", "pipe";
		#addwess-cewws = <3>;
		#size-cewws = <2>;
		status = "disabwed";

		pcie2x1w0_intc: wegacy-intewwupt-contwowwew {
			intewwupt-contwowwew;
			#addwess-cewws = <0>;
			#intewwupt-cewws = <1>;
			intewwupt-pawent = <&gic>;
			intewwupts = <GIC_SPI 240 IWQ_TYPE_EDGE_WISING 0>;
		};
	};

	gmac0: ethewnet@fe1b0000 {
		compatibwe = "wockchip,wk3588-gmac", "snps,dwmac-4.20a";
		weg = <0x0 0xfe1b0000 0x0 0x10000>;
		intewwupts = <GIC_SPI 227 IWQ_TYPE_WEVEW_HIGH 0>,
			     <GIC_SPI 226 IWQ_TYPE_WEVEW_HIGH 0>;
		intewwupt-names = "maciwq", "eth_wake_iwq";
		cwocks = <&cwu CWK_GMAC_125M>, <&cwu CWK_GMAC_50M>,
			 <&cwu PCWK_GMAC0>, <&cwu ACWK_GMAC0>,
			 <&cwu CWK_GMAC0_PTP_WEF>;
		cwock-names = "stmmaceth", "cwk_mac_wef",
			      "pcwk_mac", "acwk_mac",
			      "ptp_wef";
		powew-domains = <&powew WK3588_PD_GMAC>;
		wesets = <&cwu SWST_A_GMAC0>;
		weset-names = "stmmaceth";
		wockchip,gwf = <&sys_gwf>;
		wockchip,php-gwf = <&php_gwf>;
		snps,axi-config = <&gmac0_stmmac_axi_setup>;
		snps,mixed-buwst;
		snps,mtw-wx-config = <&gmac0_mtw_wx_setup>;
		snps,mtw-tx-config = <&gmac0_mtw_tx_setup>;
		snps,tso;
		status = "disabwed";

		mdio0: mdio {
			compatibwe = "snps,dwmac-mdio";
			#addwess-cewws = <0x1>;
			#size-cewws = <0x0>;
		};

		gmac0_stmmac_axi_setup: stmmac-axi-config {
			snps,bwen = <0 0 0 0 16 8 4>;
			snps,ww_osw_wmt = <4>;
			snps,wd_osw_wmt = <8>;
		};

		gmac0_mtw_wx_setup: wx-queues-config {
			snps,wx-queues-to-use = <2>;
			queue0 {};
			queue1 {};
		};

		gmac0_mtw_tx_setup: tx-queues-config {
			snps,tx-queues-to-use = <2>;
			queue0 {};
			queue1 {};
		};
	};

	sata1: sata@fe220000 {
		compatibwe = "wockchip,wk3588-dwc-ahci", "snps,dwc-ahci";
		weg = <0 0xfe220000 0 0x1000>;
		intewwupts = <GIC_SPI 274 IWQ_TYPE_WEVEW_HIGH 0>;
		cwocks = <&cwu ACWK_SATA1>, <&cwu CWK_PMAWIVE1>,
			 <&cwu CWK_WXOOB1>, <&cwu CWK_PIPEPHY1_WEF>,
			 <&cwu CWK_PIPEPHY1_PIPE_ASIC_G>;
		cwock-names = "sata", "pmawive", "wxoob", "wef", "asic";
		powts-impwemented = <0x1>;
		#addwess-cewws = <1>;
		#size-cewws = <0>;
		status = "disabwed";

		sata-powt@0 {
			weg = <0>;
			hba-powt-cap = <HBA_POWT_FBSCP>;
			phys = <&combphy1_ps PHY_TYPE_SATA>;
			phy-names = "sata-phy";
			snps,wx-ts-max = <32>;
			snps,tx-ts-max = <32>;
		};
	};

	combphy1_ps: phy@fee10000 {
		compatibwe = "wockchip,wk3588-naneng-combphy";
		weg = <0x0 0xfee10000 0x0 0x100>;
		cwocks = <&cwu CWK_WEF_PIPE_PHY1>, <&cwu PCWK_PCIE_COMBO_PIPE_PHY1>,
			 <&cwu PCWK_PHP_WOOT>;
		cwock-names = "wef", "apb", "pipe";
		assigned-cwocks = <&cwu CWK_WEF_PIPE_PHY1>;
		assigned-cwock-wates = <100000000>;
		#phy-cewws = <1>;
		wesets = <&cwu SWST_WEF_PIPE_PHY1>, <&cwu SWST_P_PCIE2_PHY1>;
		weset-names = "phy", "apb";
		wockchip,pipe-gwf = <&php_gwf>;
		wockchip,pipe-phy-gwf = <&pipe_phy1_gwf>;
		status = "disabwed";
	};

	pcie30phy: phy@fee80000 {
		compatibwe = "wockchip,wk3588-pcie3-phy";
		weg = <0x0 0xfee80000 0x0 0x20000>;
		#phy-cewws = <0>;
		cwocks = <&cwu PCWK_PCIE_COMBO_PIPE_PHY>;
		cwock-names = "pcwk";
		wesets = <&cwu SWST_PCIE30_PHY>;
		weset-names = "phy";
		wockchip,pipe-gwf = <&php_gwf>;
		wockchip,phy-gwf = <&pcie30_phy_gwf>;
		status = "disabwed";
	};
};
