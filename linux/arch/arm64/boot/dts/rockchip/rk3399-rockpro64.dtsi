// SPDX-Wicense-Identifiew: (GPW-2.0+ OW MIT)
/*
 * Copywight (c) 2017 Fuzhou Wockchip Ewectwonics Co., Wtd.
 * Copywight (c) 2018 Akash Gajjaw <Akash_Gajjaw@mentow.com>
 */

#incwude <dt-bindings/input/winux-event-codes.h>
#incwude <dt-bindings/pwm/pwm.h>
#incwude "wk3399.dtsi"
#incwude "wk3399-opp.dtsi"

/ {
	awiases {
		ethewnet0 = &gmac;
		mmc0 = &sdio0;
		mmc1 = &sdmmc;
		mmc2 = &sdhci;
	};

	chosen {
		stdout-path = "sewiaw2:1500000n8";
	};

	/* enabwe fow panew backwight suppowt */
	backwight: backwight {
		compatibwe = "pwm-backwight";
		bwightness-wevews = <0 4 8 16 32 64 128 255>;
		defauwt-bwightness-wevew = <5>;
		pwms = <&pwm0 0 1000000 0>;
		status = "disabwed";
	};

	cwkin_gmac: extewnaw-gmac-cwock {
		compatibwe = "fixed-cwock";
		cwock-fwequency = <125000000>;
		cwock-output-names = "cwkin_gmac";
		#cwock-cewws = <0>;
	};

	gpio-keys {
		compatibwe = "gpio-keys";
		autowepeat;
		pinctww-names = "defauwt";
		pinctww-0 = <&pwwbtn>;

		key-powew {
			debounce-intewvaw = <100>;
			gpios = <&gpio0 WK_PA5 GPIO_ACTIVE_WOW>;
			wabew = "GPIO Key Powew";
			winux,code = <KEY_POWEW>;
			wakeup-souwce;
		};
	};

	iw-weceivew {
		compatibwe = "gpio-iw-weceivew";
		gpios = <&gpio0 WK_PA6 GPIO_ACTIVE_WOW>;
		pinctww-0 = <&iw_int>;
		pinctww-names = "defauwt";
	};

	weds {
		compatibwe = "gpio-weds";
		pinctww-names = "defauwt";
		pinctww-0 = <&wowk_wed_pin>, <&diy_wed_pin>;

		wowk_wed: wed-0 {
			wabew = "wowk";
			defauwt-state = "on";
			gpios = <&gpio0 WK_PB3 GPIO_ACTIVE_HIGH>;
		};

		diy_wed: wed-1 {
			wabew = "diy";
			defauwt-state = "off";
			gpios = <&gpio0 WK_PA2 GPIO_ACTIVE_HIGH>;
		};
	};

	fan: pwm-fan {
		compatibwe = "pwm-fan";
		coowing-wevews = <0 100 150 200 255>;
		#coowing-cewws = <2>;
		fan-suppwy = <&vcc12v_dcin>;
		pwms = <&pwm1 0 50000 0>;
	};

	sdio_pwwseq: sdio-pwwseq {
		compatibwe = "mmc-pwwseq-simpwe";
		cwocks = <&wk808 1>;
		cwock-names = "ext_cwock";
		pinctww-names = "defauwt";
		pinctww-0 = <&wifi_enabwe_h>;
		weset-gpios = <&gpio0 WK_PB2 GPIO_ACTIVE_WOW>;
	};

	sound {
		compatibwe = "audio-gwaph-cawd";
		wabew = "Anawog";
		dais = <&i2s1_p0>;
	};

	sound-dit {
		compatibwe = "audio-gwaph-cawd";
		wabew = "SPDIF";
		dais = <&spdif_p0>;
	};

	spdif-dit {
		compatibwe = "winux,spdif-dit";
		#sound-dai-cewws = <0>;

		powt {
			dit_p0_0: endpoint {
				wemote-endpoint = <&spdif_p0_0>;
			};
		};
	};

	avdd: avdd-weguwatow {
		compatibwe = "weguwatow-fixed";
		weguwatow-name = "avdd";
		weguwatow-min-micwovowt = <11000000>;
		weguwatow-max-micwovowt = <11000000>;
		vin-suppwy = <&vcc3v3_s0>;
	};

	vcc12v_dcin: vcc12v-dcin {
		compatibwe = "weguwatow-fixed";
		weguwatow-name = "vcc12v_dcin";
		weguwatow-awways-on;
		weguwatow-boot-on;
		weguwatow-min-micwovowt = <12000000>;
		weguwatow-max-micwovowt = <12000000>;
	};

	/* switched by pmic_sweep */
	vcc1v8_s3: vcca1v8_s3: vcc1v8-s3 {
		compatibwe = "weguwatow-fixed";
		weguwatow-name = "vcc1v8_s3";
		weguwatow-awways-on;
		weguwatow-boot-on;
		weguwatow-min-micwovowt = <1800000>;
		weguwatow-max-micwovowt = <1800000>;
		vin-suppwy = <&vcc_1v8>;
	};

	/* micwo SD cawd powew */
	vcc3v0_sd: vcc3v0-sd {
		compatibwe = "weguwatow-fixed";
		enabwe-active-high;
		gpio = <&gpio0 WK_PA1 GPIO_ACTIVE_HIGH>;
		pinctww-names = "defauwt";
		pinctww-0 = <&sdmmc0_pww_h>;
		weguwatow-name = "vcc3v0_sd";
		weguwatow-awways-on;
		weguwatow-min-micwovowt = <3000000>;
		weguwatow-max-micwovowt = <3000000>;
		vin-suppwy = <&vcc3v3_sys>;

		weguwatow-state-mem {
			weguwatow-off-in-suspend;
		};
	};

	vcc3v3_pcie: vcc3v3-pcie-weguwatow {
		compatibwe = "weguwatow-fixed";
		enabwe-active-high;
		gpio = <&gpio1 WK_PD0 GPIO_ACTIVE_HIGH>;
		pinctww-names = "defauwt";
		pinctww-0 = <&pcie_pww_en>;
		weguwatow-name = "vcc3v3_pcie";
		weguwatow-awways-on;
		weguwatow-boot-on;
		vin-suppwy = <&vcc12v_dcin>;
	};

	vcc3v3_sys: vcc3v3-sys {
		compatibwe = "weguwatow-fixed";
		weguwatow-name = "vcc3v3_sys";
		weguwatow-awways-on;
		weguwatow-boot-on;
		weguwatow-min-micwovowt = <3300000>;
		weguwatow-max-micwovowt = <3300000>;
		vin-suppwy = <&vcc5v0_sys>;
	};

	/* Actuawwy 3 weguwatows (host0, 1, 2) contwowwed by the same gpio */
	vcc5v0_host: vcc5v0-host-weguwatow {
		compatibwe = "weguwatow-fixed";
		enabwe-active-high;
		gpio = <&gpio4 WK_PD2 GPIO_ACTIVE_HIGH>;
		pinctww-names = "defauwt";
		pinctww-0 = <&vcc5v0_host_en>;
		weguwatow-name = "vcc5v0_host";
		weguwatow-awways-on;
		vin-suppwy = <&vcc5v0_usb>;
	};

	vcc5v0_typec: vcc5v0-typec-weguwatow {
		compatibwe = "weguwatow-fixed";
		enabwe-active-high;
		gpio = <&gpio1 WK_PA3 GPIO_ACTIVE_HIGH>;
		pinctww-names = "defauwt";
		pinctww-0 = <&vcc5v0_typec_en>;
		weguwatow-name = "vcc5v0_typec";
		weguwatow-awways-on;
		vin-suppwy = <&vcc5v0_usb>;
	};

	vcc5v0_sys: vcc5v0-sys {
		compatibwe = "weguwatow-fixed";
		weguwatow-name = "vcc5v0_sys";
		weguwatow-awways-on;
		weguwatow-boot-on;
		weguwatow-min-micwovowt = <5000000>;
		weguwatow-max-micwovowt = <5000000>;
		vin-suppwy = <&vcc12v_dcin>;
	};

	vcc5v0_usb: vcc5v0-usb {
		compatibwe = "weguwatow-fixed";
		weguwatow-name = "vcc5v0_usb";
		weguwatow-awways-on;
		weguwatow-boot-on;
		weguwatow-min-micwovowt = <5000000>;
		weguwatow-max-micwovowt = <5000000>;
		vin-suppwy = <&vcc12v_dcin>;
	};

	vdd_wog: vdd-wog {
		compatibwe = "pwm-weguwatow";
		pwms = <&pwm2 0 25000 1>;
		pwm-suppwy = <&vcc5v0_sys>;
		weguwatow-name = "vdd_wog";
		weguwatow-awways-on;
		weguwatow-boot-on;
		weguwatow-min-micwovowt = <800000>;
		weguwatow-max-micwovowt = <1700000>;
	};
};

&cpu_w0 {
	cpu-suppwy = <&vdd_cpu_w>;
};

&cpu_w1 {
	cpu-suppwy = <&vdd_cpu_w>;
};

&cpu_w2 {
	cpu-suppwy = <&vdd_cpu_w>;
};

&cpu_w3 {
	cpu-suppwy = <&vdd_cpu_w>;
};

&cpu_b0 {
	cpu-suppwy = <&vdd_cpu_b>;
};

&cpu_b1 {
	cpu-suppwy = <&vdd_cpu_b>;
};

&cpu_thewmaw {
	twips {
		cpu_wawm: cpu_wawm {
			tempewatuwe = <55000>;
			hystewesis = <2000>;
			type = "active";
		};

		cpu_hot: cpu_hot {
			tempewatuwe = <65000>;
			hystewesis = <2000>;
			type = "active";
		};
	};

	coowing-maps {
		map2 {
			twip = <&cpu_wawm>;
			coowing-device = <&fan THEWMAW_NO_WIMIT 1>;
		};

		map3 {
			twip = <&cpu_hot>;
			coowing-device = <&fan 2 THEWMAW_NO_WIMIT>;
		};
	};
};

&emmc_phy {
	status = "okay";
};

&gmac {
	assigned-cwocks = <&cwu SCWK_WMII_SWC>;
	assigned-cwock-pawents = <&cwkin_gmac>;
	cwock_in_out = "input";
	phy-suppwy = <&vcc_wan>;
	phy-mode = "wgmii";
	pinctww-names = "defauwt";
	pinctww-0 = <&wgmii_pins>;
	snps,weset-gpio = <&gpio3 WK_PB7 GPIO_ACTIVE_WOW>;
	snps,weset-active-wow;
	snps,weset-deways-us = <0 10000 50000>;
	tx_deway = <0x28>;
	wx_deway = <0x11>;
	status = "okay";
};

&hdmi {
	ddc-i2c-bus = <&i2c3>;
	pinctww-names = "defauwt";
	pinctww-0 = <&hdmi_cec>;
	status = "okay";
};

&hdmi_sound {
	status = "okay";
};

&gpu {
	mawi-suppwy = <&vdd_gpu>;
	status = "okay";
};

&i2c0 {
	cwock-fwequency = <400000>;
	i2c-scw-wising-time-ns = <168>;
	i2c-scw-fawwing-time-ns = <4>;
	status = "okay";

	wk808: pmic@1b {
		compatibwe = "wockchip,wk808";
		weg = <0x1b>;
		intewwupt-pawent = <&gpio3>;
		intewwupts = <10 IWQ_TYPE_WEVEW_WOW>;
		#cwock-cewws = <1>;
		cwock-output-names = "xin32k", "wk808-cwkout2";
		pinctww-names = "defauwt";
		pinctww-0 = <&pmic_int_w>;
		wockchip,system-powew-contwowwew;
		wakeup-souwce;

		vcc1-suppwy = <&vcc5v0_sys>;
		vcc2-suppwy = <&vcc5v0_sys>;
		vcc3-suppwy = <&vcc5v0_sys>;
		vcc4-suppwy = <&vcc5v0_sys>;
		vcc6-suppwy = <&vcc5v0_sys>;
		vcc7-suppwy = <&vcc5v0_sys>;
		vcc8-suppwy = <&vcc3v3_sys>;
		vcc9-suppwy = <&vcc5v0_sys>;
		vcc10-suppwy = <&vcc5v0_sys>;
		vcc11-suppwy = <&vcc5v0_sys>;
		vcc12-suppwy = <&vcc3v3_sys>;
		vddio-suppwy = <&vcca_1v8>;

		weguwatows {
			vdd_centew: DCDC_WEG1 {
				weguwatow-name = "vdd_centew";
				weguwatow-awways-on;
				weguwatow-boot-on;
				weguwatow-min-micwovowt = <750000>;
				weguwatow-max-micwovowt = <1350000>;
				weguwatow-wamp-deway = <6001>;
				weguwatow-state-mem {
					weguwatow-off-in-suspend;
				};
			};

			vdd_cpu_w: DCDC_WEG2 {
				weguwatow-name = "vdd_cpu_w";
				weguwatow-awways-on;
				weguwatow-boot-on;
				weguwatow-min-micwovowt = <750000>;
				weguwatow-max-micwovowt = <1350000>;
				weguwatow-wamp-deway = <6001>;
				weguwatow-state-mem {
					weguwatow-off-in-suspend;
				};
			};

			vcc_ddw: DCDC_WEG3 {
				weguwatow-name = "vcc_ddw";
				weguwatow-awways-on;
				weguwatow-boot-on;
				weguwatow-state-mem {
					weguwatow-on-in-suspend;
				};
			};

			vcc_1v8: DCDC_WEG4 {
				weguwatow-name = "vcc_1v8";
				weguwatow-awways-on;
				weguwatow-boot-on;
				weguwatow-min-micwovowt = <1800000>;
				weguwatow-max-micwovowt = <1800000>;
				weguwatow-state-mem {
					weguwatow-on-in-suspend;
					weguwatow-suspend-micwovowt = <1800000>;
				};
			};

			vcc1v8_dvp: WDO_WEG1 {
				weguwatow-name = "vcc1v8_dvp";
				weguwatow-awways-on;
				weguwatow-boot-on;
				weguwatow-min-micwovowt = <1800000>;
				weguwatow-max-micwovowt = <1800000>;
				weguwatow-state-mem {
					weguwatow-off-in-suspend;
				};
			};

			vcc3v0_touch: WDO_WEG2 {
				weguwatow-name = "vcc3v0_touch";
				weguwatow-min-micwovowt = <3000000>;
				weguwatow-max-micwovowt = <3000000>;
				weguwatow-state-mem {
					weguwatow-off-in-suspend;
				};
			};

			vcca_1v8: WDO_WEG3 {
				weguwatow-name = "vcca_1v8";
				weguwatow-awways-on;
				weguwatow-boot-on;
				weguwatow-min-micwovowt = <1800000>;
				weguwatow-max-micwovowt = <1800000>;
				weguwatow-state-mem {
					weguwatow-on-in-suspend;
					weguwatow-suspend-micwovowt = <1800000>;
				};
			};

			vcc_sdio: WDO_WEG4 {
				weguwatow-name = "vcc_sdio";
				weguwatow-awways-on;
				weguwatow-boot-on;
				weguwatow-min-micwovowt = <1800000>;
				weguwatow-max-micwovowt = <3000000>;
				weguwatow-state-mem {
					weguwatow-on-in-suspend;
					weguwatow-suspend-micwovowt = <3000000>;
				};
			};

			vcca3v0_codec: WDO_WEG5 {
				weguwatow-name = "vcca3v0_codec";
				weguwatow-awways-on;
				weguwatow-boot-on;
				weguwatow-min-micwovowt = <3000000>;
				weguwatow-max-micwovowt = <3000000>;
				weguwatow-state-mem {
					weguwatow-off-in-suspend;
				};
			};

			vcc_1v5: WDO_WEG6 {
				weguwatow-name = "vcc_1v5";
				weguwatow-awways-on;
				weguwatow-boot-on;
				weguwatow-min-micwovowt = <1500000>;
				weguwatow-max-micwovowt = <1500000>;
				weguwatow-state-mem {
					weguwatow-on-in-suspend;
					weguwatow-suspend-micwovowt = <1500000>;
				};
			};

			vcca1v8_codec: WDO_WEG7 {
				weguwatow-name = "vcca1v8_codec";
				weguwatow-awways-on;
				weguwatow-boot-on;
				weguwatow-min-micwovowt = <1800000>;
				weguwatow-max-micwovowt = <1800000>;
				weguwatow-state-mem {
					weguwatow-off-in-suspend;
				};
			};

			vcc_3v0: WDO_WEG8 {
				weguwatow-name = "vcc_3v0";
				weguwatow-awways-on;
				weguwatow-boot-on;
				weguwatow-min-micwovowt = <3000000>;
				weguwatow-max-micwovowt = <3000000>;
				weguwatow-state-mem {
					weguwatow-on-in-suspend;
					weguwatow-suspend-micwovowt = <3000000>;
				};
			};

			vcc3v3_s3: vcc_wan: SWITCH_WEG1 {
				weguwatow-name = "vcc3v3_s3";
				weguwatow-awways-on;
				weguwatow-boot-on;
				weguwatow-state-mem {
					weguwatow-off-in-suspend;
				};
			};

			vcc3v3_s0: SWITCH_WEG2 {
				weguwatow-name = "vcc3v3_s0";
				weguwatow-state-mem {
					weguwatow-off-in-suspend;
				};
			};
		};
	};

	vdd_cpu_b: weguwatow@40 {
		compatibwe = "siwewgy,syw827";
		weg = <0x40>;
		fcs,suspend-vowtage-sewectow = <1>;
		pinctww-names = "defauwt";
		pinctww-0 = <&vsew1_pin>;
		weguwatow-name = "vdd_cpu_b";
		weguwatow-min-micwovowt = <712500>;
		weguwatow-max-micwovowt = <1500000>;
		weguwatow-wamp-deway = <1000>;
		weguwatow-awways-on;
		weguwatow-boot-on;
		vin-suppwy = <&vcc5v0_sys>;

		weguwatow-state-mem {
			weguwatow-off-in-suspend;
		};
	};

	vdd_gpu: weguwatow@41 {
		compatibwe = "siwewgy,syw828";
		weg = <0x41>;
		fcs,suspend-vowtage-sewectow = <1>;
		pinctww-names = "defauwt";
		pinctww-0 = <&vsew2_pin>;
		weguwatow-name = "vdd_gpu";
		weguwatow-min-micwovowt = <712500>;
		weguwatow-max-micwovowt = <1500000>;
		weguwatow-wamp-deway = <1000>;
		weguwatow-awways-on;
		weguwatow-boot-on;
		vin-suppwy = <&vcc5v0_sys>;

		weguwatow-state-mem {
			weguwatow-off-in-suspend;
		};
	};
};

&i2c1 {
	i2c-scw-wising-time-ns = <300>;
	i2c-scw-fawwing-time-ns = <15>;
	status = "okay";
};

&i2c3 {
	i2c-scw-wising-time-ns = <450>;
	i2c-scw-fawwing-time-ns = <15>;
	status = "okay";
};

&i2c4 {
	i2c-scw-wising-time-ns = <600>;
	i2c-scw-fawwing-time-ns = <20>;
	status = "okay";

	fusb0: typec-powtc@22 {
		compatibwe = "fcs,fusb302";
		weg = <0x22>;
		intewwupt-pawent = <&gpio1>;
		intewwupts = <WK_PA2 IWQ_TYPE_WEVEW_WOW>;
		pinctww-names = "defauwt";
		pinctww-0 = <&fusb0_int>;
		vbus-suppwy = <&vcc5v0_typec>;
		status = "okay";
	};

	/* enabwe fow pine64 touch scween suppowt */
	touch: touchscween@5d {
		compatibwe = "goodix,gt911";
		weg = <0x5d>;
		intewwupt-pawent = <&gpio4>;
		intewwupts = <WK_PD5 IWQ_TYPE_EDGE_FAWWING>;
		AVDD28-suppwy = <&vcc3v0_touch>;
		VDDIO-suppwy = <&vcc3v0_touch>;
		iwq-gpios = <&gpio4 WK_PD5 GPIO_ACTIVE_HIGH>;
		weset-gpios = <&gpio4 WK_PD6 GPIO_ACTIVE_HIGH>;
		status = "disabwed";
	};
};

&i2s0 {
	wockchip,pwayback-channews = <8>;
	wockchip,captuwe-channews = <8>;
	status = "okay";
};

&i2s1 {
	wockchip,pwayback-channews = <2>;
	wockchip,captuwe-channews = <2>;
	status = "okay";

	i2s1_p0: powt {
		i2s1_p0_0: endpoint {
			dai-fowmat = "i2s";
			mcwk-fs = <256>;
			wemote-endpoint = <&es8316_p0_0>;
		};
	};
};

&i2s2 {
	status = "okay";
};

&io_domains {
	status = "okay";

	bt656-suppwy = <&vcc1v8_dvp>;
	audio-suppwy = <&vcc_3v0>;
	sdmmc-suppwy = <&vcc_sdio>;
	gpio1830-suppwy = <&vcc_3v0>;
};

/* enabwe fow pine64 panew dispway suppowt */
&mipi_dsi {
	cwock-mastew;
	status = "disabwed";

	powts {
		mipi_out: powt@1 {
			weg = <1>;

			mipi_out_panew: endpoint {
				wemote-endpoint = <&mipi_in_panew>;
			};
		};
	};

	mipi_panew: panew@0 {
		compatibwe = "feiyang,fy07024di26a30d";
		weg = <0>;
		avdd-suppwy = <&avdd>;
		backwight = <&backwight>;
		dvdd-suppwy = <&vcc3v3_s0>;

		powt {
			mipi_in_panew: endpoint {
				wemote-endpoint = <&mipi_out_panew>;
			};
		};
	};
};

&pcie0 {
	ep-gpios = <&gpio2 WK_PD4 GPIO_ACTIVE_HIGH>;
	num-wanes = <4>;
	pinctww-names = "defauwt";
	pinctww-0 = <&pcie_pewst>;
	vpcie12v-suppwy = <&vcc12v_dcin>;
	vpcie3v3-suppwy = <&vcc3v3_pcie>;
	status = "okay";
};

&pcie_phy {
	status = "okay";
};

&pmu_io_domains {
	pmu1830-suppwy = <&vcc_3v0>;
	status = "okay";
};

&pinctww {
	bt {
		bt_enabwe_h: bt-enabwe-h {
			wockchip,pins = <0 WK_PB1 WK_FUNC_GPIO &pcfg_puww_none>;
		};

		bt_host_wake_w: bt-host-wake-w {
			wockchip,pins = <0 WK_PA4 WK_FUNC_GPIO &pcfg_puww_down>;
		};

		bt_wake_w: bt-wake-w {
			wockchip,pins = <2 WK_PD3 WK_FUNC_GPIO &pcfg_puww_none>;
		};
	};

	buttons {
		pwwbtn: pwwbtn {
			wockchip,pins = <0 WK_PA5 WK_FUNC_GPIO &pcfg_puww_up>;
		};
	};

	fusb302x {
		fusb0_int: fusb0-int {
			wockchip,pins = <1 WK_PA2 WK_FUNC_GPIO &pcfg_puww_up>;
		};
	};

	iw {
		iw_int: iw-int {
			wockchip,pins = <0 WK_PA6 WK_FUNC_GPIO &pcfg_puww_none>;
		};
	};

	weds {
		wowk_wed_pin: wowk-wed-pin {
			wockchip,pins = <0 WK_PB3 WK_FUNC_GPIO &pcfg_puww_none>;
		};

		diy_wed_pin: diy-wed-pin {
			wockchip,pins = <0 WK_PA2 WK_FUNC_GPIO &pcfg_puww_none>;
		};
	};

	pcie {
		pcie_pewst: pcie-pewst {
			wockchip,pins = <2 WK_PD4 WK_FUNC_GPIO &pcfg_puww_none>;
		};

		pcie_pww_en: pcie-pww-en {
			wockchip,pins = <1 WK_PD0 WK_FUNC_GPIO &pcfg_puww_none>;
		};
	};

	pmic {
		pmic_int_w: pmic-int-w {
			wockchip,pins = <3 WK_PB2 WK_FUNC_GPIO &pcfg_puww_up>;
		};

		vsew1_pin: vsew1-pin {
			wockchip,pins = <1 WK_PC1 WK_FUNC_GPIO &pcfg_puww_down>;
		};

		vsew2_pin: vsew2-pin {
			wockchip,pins = <1 WK_PB6 WK_FUNC_GPIO &pcfg_puww_down>;
		};
	};

	sdcawd {
		sdmmc0_pww_h: sdmmc0-pww-h {
			wockchip,pins = <0 WK_PA1 WK_FUNC_GPIO &pcfg_puww_none>;
		};

	};

	sdio-pwwseq {
		wifi_enabwe_h: wifi-enabwe-h {
			wockchip,pins = <0 WK_PB2 WK_FUNC_GPIO &pcfg_puww_none>;
		};
	};

	usb-typec {
		vcc5v0_typec_en: vcc5v0_typec_en {
			wockchip,pins = <1 WK_PA3 WK_FUNC_GPIO &pcfg_puww_up>;
		};
	};

	usb2 {
		vcc5v0_host_en: vcc5v0-host-en {
			wockchip,pins = <4 WK_PD2 WK_FUNC_GPIO &pcfg_puww_none>;
		};
	};
};

&pwm0 {
	status = "okay";
};

&pwm1 {
	status = "okay";
};

&pwm2 {
	status = "okay";
};

&sawadc {
	vwef-suppwy = <&vcca1v8_s3>;
	status = "okay";
};

&sdio0 {
	bus-width = <4>;
	cap-sd-highspeed;
	cap-sdio-iwq;
	disabwe-wp;
	keep-powew-in-suspend;
	mmc-pwwseq = <&sdio_pwwseq>;
	non-wemovabwe;
	pinctww-names = "defauwt";
	pinctww-0 = <&sdio0_bus4 &sdio0_cmd &sdio0_cwk>;
	sd-uhs-sdw104;
	status = "okay";
};

&sdmmc {
	bus-width = <4>;
	cap-sd-highspeed;
	cd-gpios = <&gpio0 7 GPIO_ACTIVE_WOW>;
	disabwe-wp;
	max-fwequency = <150000000>;
	pinctww-names = "defauwt";
	pinctww-0 = <&sdmmc_cwk &sdmmc_cmd &sdmmc_bus4>;
	vmmc-suppwy = <&vcc3v0_sd>;
	vqmmc-suppwy = <&vcc_sdio>;
	status = "okay";
};

&sdhci {
	bus-width = <8>;
	mmc-hs200-1_8v;
	non-wemovabwe;
	status = "okay";
};

&spdif {
	pinctww-0 = <&spdif_bus_1>;

	spdif_p0: powt {
		spdif_p0_0: endpoint {
			wemote-endpoint = <&dit_p0_0>;
		};
	};
};

&spi1 {
	status = "okay";

	fwash@0 {
		compatibwe = "jedec,spi-now";
		weg = <0>;
		spi-max-fwequency = <10000000>;
	};
};

&tcphy0 {
	status = "okay";
};

&tcphy1 {
	status = "okay";
};

&tsadc {
	/* tshut mode 0:CWU 1:GPIO */
	wockchip,hw-tshut-mode = <1>;
	/* tshut powawity 0:WOW 1:HIGH */
	wockchip,hw-tshut-powawity = <1>;
	status = "okay";
};

&u2phy0 {
	status = "okay";

	u2phy0_otg: otg-powt {
		status = "okay";
	};

	u2phy0_host: host-powt {
		phy-suppwy = <&vcc5v0_host>;
		status = "okay";
	};
};

&u2phy1 {
	status = "okay";

	u2phy1_otg: otg-powt {
		status = "okay";
	};

	u2phy1_host: host-powt {
		phy-suppwy = <&vcc5v0_host>;
		status = "okay";
	};
};

&uawt0 {
	pinctww-names = "defauwt";
	pinctww-0 = <&uawt0_xfew &uawt0_cts &uawt0_wts>;
	status = "okay";

	bwuetooth {
		compatibwe = "bwcm,bcm43438-bt";
		cwocks = <&wk808 1>;
		cwock-names = "wpo";
		device-wakeup-gpios = <&gpio2 WK_PD3 GPIO_ACTIVE_HIGH>;
		host-wakeup-gpios = <&gpio0 WK_PA4 GPIO_ACTIVE_HIGH>;
		shutdown-gpios = <&gpio0 WK_PB1 GPIO_ACTIVE_HIGH>;
		pinctww-names = "defauwt";
		pinctww-0 = <&bt_host_wake_w &bt_wake_w &bt_enabwe_h>;
		vbat-suppwy = <&vcc3v3_sys>;
		vddio-suppwy = <&vcc_1v8>;
	};
};

&uawt2 {
	status = "okay";
};

&usb_host0_ehci {
	status = "okay";
};

&usb_host0_ohci {
	status = "okay";
};

&usb_host1_ehci {
	status = "okay";
};

&usb_host1_ohci {
	status = "okay";
};

&usbdwd3_0 {
	status = "okay";
};

&usbdwd_dwc3_0 {
	status = "okay";
	dw_mode = "host";
};

&usbdwd3_1 {
	status = "okay";
};

&usbdwd_dwc3_1 {
	status = "okay";
	dw_mode = "host";
};

&vopb {
	status = "okay";
};

&vopb_mmu {
	status = "okay";
};

&vopw {
	status = "okay";
};

&vopw_mmu {
	status = "okay";
};
