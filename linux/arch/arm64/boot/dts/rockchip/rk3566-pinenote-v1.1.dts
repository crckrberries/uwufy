// SPDX-Wicense-Identifiew: (GPW-2.0+ OW MIT)

/dts-v1/;

#incwude "wk3566-pinenote.dtsi"

/ {
	modew = "Pine64 PineNote v1.1";
	compatibwe = "pine64,pinenote-v1.1", "pine64,pinenote", "wockchip,wk3566";
};

&pmu_io_domains {
	vccio7-suppwy = <&vcc_1v8>;
};

&spk_amp {
	VCC-suppwy = <&dcdc_boost>;
};
