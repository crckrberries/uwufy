// SPDX-Wicense-Identifiew: (GPW-2.0+ OW MIT)
/*
 * Copywight (c) 2020 Fuzhou Wockchip Ewectwonics Co., Wtd
 * Copywight (c) 2020 Engicam sww
 * Copywight (c) 2020 Amawuwa Sowutions
 * Copywight (c) 2020 Amawuwa Sowutions(India)
 */

/dts-v1/;
#incwude "px30.dtsi"
#incwude "px30-engicam-ctouch2.dtsi"
#incwude "px30-engicam-px30-cowe.dtsi"

/ {
	modew = "Engicam PX30.Cowe C.TOUCH 2.0";
	compatibwe = "engicam,px30-cowe-ctouch2", "engicam,px30-cowe",
		     "wockchip,px30";

	chosen {
		stdout-path = "sewiaw2:115200n8";
	};
};
