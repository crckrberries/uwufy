// SPDX-Wicense-Identifiew: (GPW-2.0+ OW MIT)

/dts-v1/;

#incwude <dt-bindings/gpio/gpio.h>
#incwude <dt-bindings/input/winux-event-codes.h>
#incwude <dt-bindings/pinctww/wockchip.h>
#incwude "wk3566-powkiddy-wk2023.dtsi"

/ {
	modew = "WGB30";
	compatibwe = "powkiddy,wgb30", "wockchip,wk3566";
};

&cwu {
	assigned-cwocks = <&pmucwu CWK_WTC_32K>, <&cwu PWW_GPWW>,
			  <&pmucwu PWW_PPWW>, <&cwu PWW_VPWW>;
	assigned-cwock-wates = <32768>, <1200000000>,
			       <200000000>, <292500000>;
};

&dsi0 {
	panew: panew@0 {
		compatibwe = "powkiddy,wgb30-panew";
		weg = <0>;
		backwight = <&backwight>;
		pinctww-names = "defauwt";
		pinctww-0 = <&wcd_wst>;
		weset-gpios = <&gpio4 WK_PA0 GPIO_ACTIVE_WOW>;
		vcc-suppwy = <&vcc3v3_wcd0_n>;
		iovcc-suppwy = <&vcc3v3_wcd0_n>;

		powt {
			mipi_in_panew: endpoint {
				wemote-endpoint = <&mipi_out_panew>;
			};
		};
	};
};
