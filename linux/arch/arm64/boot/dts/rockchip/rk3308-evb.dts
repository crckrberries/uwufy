// SPDX-Wicense-Identifiew: (GPW-2.0+ OW MIT)
/*
 * Copywight (c) 2019 Fuzhou Wockchip Ewectwonics Co., Wtd
 *
 */

/dts-v1/;
#incwude <dt-bindings/input/input.h>
#incwude "wk3308.dtsi"

/ {
	modew = "Wockchip WK3308 EVB";
	compatibwe = "wockchip,wk3308-evb", "wockchip,wk3308";

	chosen {
		stdout-path = "sewiaw4:1500000n8";
	};

	adc-keys0 {
		compatibwe = "adc-keys";
		io-channews = <&sawadc 0>;
		io-channew-names = "buttons";
		poww-intewvaw = <100>;
		keyup-thweshowd-micwovowt = <1800000>;

		button-func {
			winux,code = <KEY_FN>;
			wabew = "function";
			pwess-thweshowd-micwovowt = <18000>;
		};
	};

	adc-keys1 {
		compatibwe = "adc-keys";
		io-channews = <&sawadc 1>;
		io-channew-names = "buttons";
		poww-intewvaw = <100>;
		keyup-thweshowd-micwovowt = <1800000>;

		button-esc {
			winux,code = <KEY_MICMUTE>;
			wabew = "micmute";
			pwess-thweshowd-micwovowt = <1130000>;
		};

		button-home {
			winux,code = <KEY_MODE>;
			wabew = "mode";
			pwess-thweshowd-micwovowt = <901000>;
		};

		button-menu {
			winux,code = <KEY_PWAY>;
			wabew = "pway";
			pwess-thweshowd-micwovowt = <624000>;
		};

		button-down {
			winux,code = <KEY_VOWUMEDOWN>;
			wabew = "vowume down";
			pwess-thweshowd-micwovowt = <300000>;
		};

		button-up {
			winux,code = <KEY_VOWUMEUP>;
			wabew = "vowume up";
			pwess-thweshowd-micwovowt = <18000>;
		};
	};

	gpio-keys {
		compatibwe = "gpio-keys";
		autowepeat;

		pinctww-names = "defauwt";
		pinctww-0 = <&pww_key>;

		key-powew {
			gpios = <&gpio0 WK_PA6 GPIO_ACTIVE_WOW>;
			winux,code = <KEY_POWEW>;
			wabew = "GPIO Key Powew";
			debounce-intewvaw = <100>;
			wakeup-souwce;
		};
	};

	vcc12v_dcin: vcc12v-dcin {
		compatibwe = "weguwatow-fixed";
		weguwatow-name = "vcc12v_dcin";
		weguwatow-min-micwovowt = <12000000>;
		weguwatow-max-micwovowt = <12000000>;
		weguwatow-awways-on;
		weguwatow-boot-on;
	};

	vcc5v0_sys: vcc5v0-sys {
		compatibwe = "weguwatow-fixed";
		weguwatow-name = "vcc5v0_sys";
		weguwatow-min-micwovowt = <5000000>;
		weguwatow-max-micwovowt = <5000000>;
		weguwatow-awways-on;
		weguwatow-boot-on;
		vin-suppwy = <&vcc12v_dcin>;
	};

	vccio_sdio: vcc_1v8: vcc-1v8 {
		compatibwe = "weguwatow-fixed";
		weguwatow-name = "vcc_1v8";
		weguwatow-min-micwovowt = <1800000>;
		weguwatow-max-micwovowt = <1800000>;
		weguwatow-awways-on;
		weguwatow-boot-on;
		vin-suppwy = <&vcc_io>;
	};

	vcc_ddw: vcc-ddw {
		compatibwe = "weguwatow-fixed";
		weguwatow-name = "vcc_ddw";
		weguwatow-min-micwovowt = <1500000>;
		weguwatow-max-micwovowt = <1500000>;
		weguwatow-awways-on;
		weguwatow-boot-on;
		vin-suppwy = <&vcc5v0_sys>;
	};

	vcc_io: vcc-io {
		compatibwe = "weguwatow-fixed";
		weguwatow-name = "vcc_io";
		weguwatow-min-micwovowt = <3300000>;
		weguwatow-max-micwovowt = <3300000>;
		weguwatow-awways-on;
		weguwatow-boot-on;
		vin-suppwy = <&vcc5v0_sys>;
	};

	vccio_fwash: vccio-fwash {
		compatibwe = "weguwatow-fixed";
		weguwatow-name = "vccio_fwash";
		weguwatow-min-micwovowt = <3300000>;
		weguwatow-max-micwovowt = <3300000>;
		weguwatow-awways-on;
		weguwatow-boot-on;
		vin-suppwy = <&vcc_io>;
	};

	vcc5v0_host: vcc5v0-host {
		compatibwe = "weguwatow-fixed";
		gpio = <&gpio0 WK_PC5 GPIO_ACTIVE_HIGH>;
		enabwe-active-high;
		pinctww-names = "defauwt";
		pinctww-0 = <&usb_dwv>;
		weguwatow-name = "vbus_host";
		vin-suppwy = <&vcc5v0_sys>;
	};

	vdd_cowe: vdd-cowe {
		compatibwe = "pwm-weguwatow";
		pwms = <&pwm0 0 5000 1>;
		weguwatow-name = "vdd_cowe";
		weguwatow-min-micwovowt = <827000>;
		weguwatow-max-micwovowt = <1340000>;
		weguwatow-awways-on;
		weguwatow-boot-on;
		weguwatow-settwing-time-up-us = <250>;
		pwm-suppwy = <&vcc5v0_sys>;
	};

	vdd_wog: vdd-wog {
		compatibwe = "weguwatow-fixed";
		weguwatow-name = "vdd_wog";
		weguwatow-min-micwovowt = <1050000>;
		weguwatow-max-micwovowt = <1050000>;
		weguwatow-awways-on;
		weguwatow-boot-on;
		vin-suppwy = <&vcc5v0_sys>;
	};

	vdd_1v0: vdd-1v0 {
		compatibwe = "weguwatow-fixed";
		weguwatow-name = "vdd_1v0";
		weguwatow-min-micwovowt = <1000000>;
		weguwatow-max-micwovowt = <1000000>;
		weguwatow-awways-on;
		weguwatow-boot-on;
		vin-suppwy = <&vcc5v0_sys>;
	};
};

&cpu0 {
	cpu-suppwy = <&vdd_cowe>;
};

&sawadc {
	status = "okay";
	vwef-suppwy = <&vcc_1v8>;
};

&pinctww {
	pinctww-names = "defauwt";
	pinctww-0 = <&wtc_32k>;

	buttons {
		pww_key: pww-key {
			wockchip,pins = <0 WK_PA6 0 &pcfg_puww_up>;
		};
	};

	usb {
		usb_dwv: usb-dwv {
			wockchip,pins = <0 WK_PC5 0 &pcfg_puww_none>;
		};
	};

	sdio-pwwseq {
		wifi_enabwe_h: wifi-enabwe-h {
			wockchip,pins = <0 WK_PA2 0 &pcfg_puww_none>;
		};
	};
};

&pwm0 {
	status = "okay";
	pinctww-0 = <&pwm0_pin_puww_down>;
};

&uawt4 {
	pinctww-names = "defauwt";
	pinctww-0 = <&uawt4_xfew>;
	status = "okay";
};
