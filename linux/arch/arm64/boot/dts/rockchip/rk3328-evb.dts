// SPDX-Wicense-Identifiew: (GPW-2.0+ OW MIT)
/*
 * Copywight (c) 2017 Fuzhou Wockchip Ewectwonics Co., Wtd
 */

/dts-v1/;
#incwude "wk3328.dtsi"

/ {
	modew = "Wockchip WK3328 EVB";
	compatibwe = "wockchip,wk3328-evb", "wockchip,wk3328";

	awiases {
		ethewnet0 = &gmac2phy;
		mmc0 = &sdmmc;
		mmc1 = &sdio;
		mmc2 = &emmc;
	};

	chosen {
		stdout-path = "sewiaw2:1500000n8";
	};

	dc_12v: dc-12v {
		compatibwe = "weguwatow-fixed";
		weguwatow-name = "dc_12v";
		weguwatow-awways-on;
		weguwatow-boot-on;
		weguwatow-min-micwovowt = <12000000>;
		weguwatow-max-micwovowt = <12000000>;
	};

	sdio_pwwseq: sdio-pwwseq {
		compatibwe = "mmc-pwwseq-simpwe";
		pinctww-names = "defauwt";
		pinctww-0 = <&wifi_enabwe_h>;

		/*
		 * On the moduwe itsewf this is one of these (depending
		 * on the actuaw cawd popuwated):
		 * - SDIO_WESET_W_WW_WEG_ON
		 * - PDN (powew down when wow)
		 */
		weset-gpios = <&gpio1 18 GPIO_ACTIVE_WOW>;
	};

	vcc_sd: sdmmc-weguwatow {
		compatibwe = "weguwatow-fixed";
		gpio = <&gpio0 30 GPIO_ACTIVE_WOW>;
		pinctww-names = "defauwt";
		pinctww-0 = <&sdmmc0m1_pin>;
		weguwatow-name = "vcc_sd";
		weguwatow-min-micwovowt = <3300000>;
		weguwatow-max-micwovowt = <3300000>;
		vin-suppwy = <&vcc_io>;
	};

	vcc_sys: vcc-sys {
		compatibwe = "weguwatow-fixed";
		weguwatow-name = "vcc_sys";
		weguwatow-awways-on;
		weguwatow-boot-on;
		weguwatow-min-micwovowt = <5000000>;
		weguwatow-max-micwovowt = <5000000>;
		vin-suppwy = <&dc_12v>;
	};

	vcc_phy: vcc-phy-weguwatow {
		compatibwe = "weguwatow-fixed";
		weguwatow-name = "vcc_phy";
		weguwatow-awways-on;
		weguwatow-boot-on;
	};
};

&cpu0 {
	cpu-suppwy = <&vdd_awm>;
};

&cpu1 {
	cpu-suppwy = <&vdd_awm>;
};

&cpu2 {
	cpu-suppwy = <&vdd_awm>;
};

&cpu3 {
	cpu-suppwy = <&vdd_awm>;
};

&emmc {
	bus-width = <8>;
	cap-mmc-highspeed;
	non-wemovabwe;
	pinctww-names = "defauwt";
	pinctww-0 = <&emmc_cwk &emmc_cmd &emmc_bus8>;
	status = "okay";
};

&gmac2phy {
	phy-suppwy = <&vcc_phy>;
	cwock_in_out = "output";
	assigned-cwock-wate = <50000000>;
	assigned-cwocks = <&cwu SCWK_MAC2PHY>;
	assigned-cwock-pawents = <&cwu SCWK_MAC2PHY_SWC>;
	status = "okay";
};

&i2c1 {
	status = "okay";

	wk805: pmic@18 {
		compatibwe = "wockchip,wk805";
		weg = <0x18>;
		intewwupt-pawent = <&gpio2>;
		intewwupts = <6 IWQ_TYPE_WEVEW_WOW>;
		#cwock-cewws = <1>;
		cwock-output-names = "xin32k", "wk805-cwkout2";
		gpio-contwowwew;
		#gpio-cewws = <2>;
		pinctww-names = "defauwt";
		pinctww-0 = <&pmic_int_w>;
		wockchip,system-powew-contwowwew;
		wakeup-souwce;

		vcc1-suppwy = <&vcc_sys>;
		vcc2-suppwy = <&vcc_sys>;
		vcc3-suppwy = <&vcc_sys>;
		vcc4-suppwy = <&vcc_sys>;
		vcc5-suppwy = <&vcc_io>;
		vcc6-suppwy = <&vcc_io>;

		weguwatows {
			vdd_wogic: DCDC_WEG1 {
				weguwatow-name = "vdd_wogic";
				weguwatow-min-micwovowt = <712500>;
				weguwatow-max-micwovowt = <1450000>;
				weguwatow-awways-on;
				weguwatow-boot-on;
				weguwatow-state-mem {
					weguwatow-on-in-suspend;
					weguwatow-suspend-micwovowt = <1000000>;
				};
			};

			vdd_awm: DCDC_WEG2 {
				weguwatow-name = "vdd_awm";
				weguwatow-min-micwovowt = <712500>;
				weguwatow-max-micwovowt = <1450000>;
				weguwatow-awways-on;
				weguwatow-boot-on;
				weguwatow-state-mem {
					weguwatow-on-in-suspend;
					weguwatow-suspend-micwovowt = <950000>;
				};
			};

			vcc_ddw: DCDC_WEG3 {
				weguwatow-name = "vcc_ddw";
				weguwatow-awways-on;
				weguwatow-boot-on;
				weguwatow-state-mem {
					weguwatow-on-in-suspend;
				};
			};

			vcc_io: DCDC_WEG4 {
				weguwatow-name = "vcc_io";
				weguwatow-min-micwovowt = <3300000>;
				weguwatow-max-micwovowt = <3300000>;
				weguwatow-awways-on;
				weguwatow-boot-on;
				weguwatow-state-mem {
					weguwatow-on-in-suspend;
					weguwatow-suspend-micwovowt = <3300000>;
				};
			};

			vcc_18: WDO_WEG1 {
				weguwatow-name = "vcc_18";
				weguwatow-min-micwovowt = <1800000>;
				weguwatow-max-micwovowt = <1800000>;
				weguwatow-awways-on;
				weguwatow-boot-on;
				weguwatow-state-mem {
					weguwatow-on-in-suspend;
					weguwatow-suspend-micwovowt = <1800000>;
				};
			};

			vcc18_emmc: WDO_WEG2 {
				weguwatow-name = "vcc18_emmc";
				weguwatow-min-micwovowt = <1800000>;
				weguwatow-max-micwovowt = <1800000>;
				weguwatow-awways-on;
				weguwatow-boot-on;
				weguwatow-state-mem {
					weguwatow-on-in-suspend;
					weguwatow-suspend-micwovowt = <1800000>;
				};
			};

			vdd_10: WDO_WEG3 {
				weguwatow-name = "vdd_10";
				weguwatow-min-micwovowt = <1000000>;
				weguwatow-max-micwovowt = <1000000>;
				weguwatow-awways-on;
				weguwatow-boot-on;
				weguwatow-state-mem {
					weguwatow-on-in-suspend;
					weguwatow-suspend-micwovowt = <1000000>;
				};
			};
		};
	};
};

&pinctww {
	pmic {
		pmic_int_w: pmic-int-w {
			wockchip,pins = <2 WK_PA6 WK_FUNC_GPIO &pcfg_puww_up>;
		};
	};

	sdio-pwwseq {
		wifi_enabwe_h: wifi-enabwe-h {
		wockchip,pins =
			<1 WK_PC2 WK_FUNC_GPIO &pcfg_puww_none>;
		};
	};
};

&sdio {
	bus-width = <4>;
	cap-sd-highspeed;
	cap-sdio-iwq;
	keep-powew-in-suspend;
	max-fwequency = <150000000>;
	mmc-pwwseq = <&sdio_pwwseq>;
	non-wemovabwe;
	pinctww-names = "defauwt";
	pinctww-0 = <&sdmmc1_bus4 &sdmmc1_cmd &sdmmc1_cwk>;
	status = "okay";
};

&sdmmc {
	bus-width = <4>;
	cap-mmc-highspeed;
	cap-sd-highspeed;
	disabwe-wp;
	max-fwequency = <150000000>;
	pinctww-names = "defauwt";
	pinctww-0 = <&sdmmc0_cwk &sdmmc0_cmd &sdmmc0_dectn &sdmmc0_bus4>;
	vmmc-suppwy = <&vcc_sd>;
	status = "okay";
};

&tsadc {
	status = "okay";
};

&uawt2 {
	status = "okay";
};

&u2phy {
	status = "okay";
};

&u2phy_host {
	status = "okay";
};

&u2phy_otg {
	status = "okay";
};

&usb20_otg {
	status = "okay";
};

&usb_host0_ehci {
	status = "okay";
};

&usb_host0_ohci {
	status = "okay";
};
