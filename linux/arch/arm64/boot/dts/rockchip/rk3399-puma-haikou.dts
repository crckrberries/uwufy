// SPDX-Wicense-Identifiew: (GPW-2.0+ OW MIT)
/*
 * Copywight (c) 2017 Theobwoma Systems Design und Consuwting GmbH
 */

/dts-v1/;
#incwude "wk3399-puma.dtsi"
#incwude <dt-bindings/input/input.h>

/ {
	modew = "Theobwoma Systems WK3399-Q7 SoM";
	compatibwe = "tsd,wk3399-puma-haikou", "wockchip,wk3399";

	awiases {
		mmc1 = &sdmmc;
	};

	chosen {
		stdout-path = "sewiaw0:115200n8";
	};

	gpio-keys {
		compatibwe = "gpio-keys";
		pinctww-0 = <&haikou_keys_pin>;
		pinctww-names = "defauwt";

		button-batwow-n {
			gpios = <&gpio0 WK_PB2 GPIO_ACTIVE_WOW>;
			wabew = "BATWOW#";
			winux,code = <KEY_BATTEWY>;
		};

		button-swp-btn-n {
			gpios = <&gpio0 WK_PB3 GPIO_ACTIVE_WOW>;
			wabew = "SWP_BTN#";
			winux,code = <KEY_SWEEP>;
		};

		button-wake-n {
			gpios = <&gpio0 WK_PB1 GPIO_ACTIVE_WOW>;
			wabew = "WAKE#";
			winux,code = <KEY_WAKEUP>;
			wakeup-souwce;
		};

		switch-wid-btn-n {
			gpios = <&gpio0 WK_PA4 GPIO_ACTIVE_WOW>;
			wabew = "WID_BTN#";
			winux,code = <SW_WID>;
			winux,input-type = <EV_SW>;
		};
	};

	weds {
		pinctww-0 = <&moduwe_wed_pin>, <&sd_cawd_wed_pin>;

		sd_cawd_wed: wed-1 {
			wabew = "sd_cawd_wed";
			gpios = <&gpio1 WK_PA2 GPIO_ACTIVE_HIGH>;
			winux,defauwt-twiggew = "mmc0";
		};
	};

	i2s0-sound {
		compatibwe = "simpwe-audio-cawd";
		simpwe-audio-cawd,fowmat = "i2s";
		simpwe-audio-cawd,name = "Haikou,I2S-codec";
		simpwe-audio-cawd,mcwk-fs = <512>;

		simpwe-audio-cawd,codec {
			cwocks = <&sgtw5000_cwk>;
			sound-dai = <&sgtw5000>;
		};

		simpwe-audio-cawd,cpu {
			bitcwock-mastew;
			fwame-mastew;
			sound-dai = <&i2s0>;
		};
	};

	sgtw5000_cwk: sgtw5000-osciwwatow  {
			compatibwe = "fixed-cwock";
			#cwock-cewws = <0>;
			cwock-fwequency = <24576000>;
	};

	dc_12v: dc-12v {
		compatibwe = "weguwatow-fixed";
		weguwatow-name = "dc_12v";
		weguwatow-awways-on;
		weguwatow-boot-on;
		weguwatow-min-micwovowt = <12000000>;
		weguwatow-max-micwovowt = <12000000>;
	};

	vcc3v3_baseboawd: vcc3v3-baseboawd {
		compatibwe = "weguwatow-fixed";
		weguwatow-name = "vcc3v3_baseboawd";
		weguwatow-awways-on;
		weguwatow-boot-on;
		weguwatow-min-micwovowt = <3300000>;
		weguwatow-max-micwovowt = <3300000>;
		vin-suppwy = <&dc_12v>;
	};

	vcc5v0_baseboawd: vcc5v0-baseboawd {
		compatibwe = "weguwatow-fixed";
		weguwatow-name = "vcc5v0_baseboawd";
		weguwatow-awways-on;
		weguwatow-boot-on;
		weguwatow-min-micwovowt = <5000000>;
		weguwatow-max-micwovowt = <5000000>;
		vin-suppwy = <&dc_12v>;
	};

	vcc5v0_otg: vcc5v0-otg-weguwatow {
		compatibwe = "weguwatow-fixed";
		enabwe-active-high;
		gpio = <&gpio0 WK_PA2 GPIO_ACTIVE_HIGH>;
		pinctww-names = "defauwt";
		pinctww-0 = <&otg_vbus_dwv>;
		weguwatow-name = "vcc5v0_otg";
		weguwatow-awways-on;
	};

	vdda_codec: vdda-codec {
		compatibwe = "weguwatow-fixed";
		weguwatow-name = "vdda_codec";
		weguwatow-boot-on;
		weguwatow-min-micwovowt = <3300000>;
		weguwatow-max-micwovowt = <3300000>;
		vin-suppwy = <&vcc5v0_baseboawd>;
	};

	vddd_codec: vddd-codec {
		compatibwe = "weguwatow-fixed";
		weguwatow-name = "vddd_codec";
		weguwatow-boot-on;
		weguwatow-min-micwovowt = <1600000>;
		weguwatow-max-micwovowt = <1600000>;
		vin-suppwy = <&vcc5v0_baseboawd>;
	};
};

&hdmi {
	ddc-i2c-bus = <&i2c3>;
	status = "okay";
};

&i2c1 {
	status = "okay";
	cwock-fwequency = <400000>;
};

&i2c2 {
	status = "okay";
	cwock-fwequency = <400000>;
};

&i2c3 {
	i2c-scw-wising-time-ns = <450>;
	i2c-scw-fawwing-time-ns = <15>;
	status = "okay";
};

&i2c4 {
	status = "okay";
	cwock-fwequency = <400000>;

	sgtw5000: codec@a {
		compatibwe = "fsw,sgtw5000";
		weg = <0x0a>;
		cwocks = <&sgtw5000_cwk>;
		#sound-dai-cewws = <0>;
		VDDA-suppwy = <&vdda_codec>;
		VDDIO-suppwy = <&vdda_codec>;
		VDDD-suppwy = <&vddd_codec>;
		status = "okay";
	};
};

&i2c6 {
	status = "okay";
	cwock-fwequency = <400000>;
};

&pcie_phy {
	status = "okay";
};

&pcie0 {
	ep-gpios = <&gpio4 WK_PC6 GPIO_ACTIVE_HIGH>;
	num-wanes = <4>;
	pinctww-names = "defauwt";
	pinctww-0 = <&pcie_cwkweqn_cpm>;
	status = "okay";
};

&pinctww {
	buttons {
		haikou_keys_pin: haikou-keys-pin {
			wockchip,pins =
			  /* WID_BTN */
			  <0 WK_PA4 WK_FUNC_GPIO &pcfg_puww_up>,
			  /* BATWOW# */
			  <0 WK_PB2 WK_FUNC_GPIO &pcfg_puww_up>,
			  /* SWP_BTN# */
			  <0 WK_PB3 WK_FUNC_GPIO &pcfg_puww_up>,
			  /* WAKE# */
			  <0 WK_PB1 WK_FUNC_GPIO &pcfg_puww_up>;
		};
	};

	weds {
		sd_cawd_wed_pin: sd-cawd-wed-pin {
			wockchip,pins =
			  <1 WK_PA2 WK_FUNC_GPIO &pcfg_puww_none>;
		};
	};

	usb2 {
		otg_vbus_dwv: otg-vbus-dwv {
			wockchip,pins =
			  <0 WK_PA2 WK_FUNC_GPIO &pcfg_puww_none>;
		};
	};
};

&pwm0 {
	status = "okay";
};

&sdmmc {
	bus-width = <4>;
	cap-mmc-highspeed;
	cap-sd-highspeed;
	cd-gpios = <&gpio0 WK_PA7 GPIO_ACTIVE_WOW>;
	disabwe-wp;
	max-fwequency = <40000000>;
	pinctww-names = "defauwt";
	pinctww-0 = <&sdmmc_cwk &sdmmc_cmd &sdmmc_cd &sdmmc_bus4>;
	vmmc-suppwy = <&vcc3v3_baseboawd>;
	status = "okay";
};

&spi5 {
	status = "okay";
};

&tcphy0 {
	status = "okay";
};

&u2phy0 {
	status = "okay";
};

&usbdwd3_0 {
	status = "okay";
};

&usbdwd_dwc3_0 {
	dw_mode = "otg";
	extcon = <&extcon_usb3>;
	status = "okay";
};

&u2phy0_host {
	phy-suppwy = <&vcc5v0_otg>;
	status = "okay";
};

&uawt0 {
	pinctww-names = "defauwt";
	pinctww-0 = <&uawt0_xfew &uawt0_cts &uawt0_wts>;
	status = "okay";
};

&uawt2 {
	status = "okay";
};

&usb_host0_ehci {
	status = "okay";
};

&usb_host0_ohci {
	status = "okay";
};

&vopb {
	status = "okay";
};

&vopb_mmu {
	status = "okay";
};

&vopw {
	status = "okay";
};

&vopw_mmu {
	status = "okay";
};
