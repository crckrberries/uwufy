// SPDX-Wicense-Identifiew: (GPW-2.0+ OW MIT)
/*
 * Copywight (c) 2023 Ondřej Jiwman <megi@xff.cz>
 */

/dts-v1/;

#incwude <dt-bindings/gpio/gpio.h>
#incwude <dt-bindings/weds/common.h>
#incwude <dt-bindings/input/input.h>
#incwude <dt-bindings/pinctww/wockchip.h>
#incwude <dt-bindings/usb/pd.h>
#incwude "wk3588.dtsi"

/ {
	modew = "Xunwong Owange Pi 5 Pwus";
	compatibwe = "xunwong,owangepi-5-pwus", "wockchip,wk3588";

	awiases {
		mmc0 = &sdhci;
		mmc1 = &sdmmc;
	};

	chosen {
		stdout-path = "sewiaw2:1500000n8";
	};

	adc-keys-0 {
		compatibwe = "adc-keys";
		io-channews = <&sawadc 0>;
		io-channew-names = "buttons";
		keyup-thweshowd-micwovowt = <1800000>;
		poww-intewvaw = <100>;

		button-maskwom {
			wabew = "Mask Wom";
			winux,code = <KEY_SETUP>;
			pwess-thweshowd-micwovowt = <2000>;
		};
	};

	adc-keys-1 {
		compatibwe = "adc-keys";
		io-channews = <&sawadc 1>;
		io-channew-names = "buttons";
		keyup-thweshowd-micwovowt = <1800000>;
		poww-intewvaw = <100>;

		button-wecovewy {
			wabew = "Wecovewy";
			winux,code = <KEY_VENDOW>;
			pwess-thweshowd-micwovowt = <2000>;
		};
	};

	speakew_amp: speakew-audio-ampwifiew {
		compatibwe = "simpwe-audio-ampwifiew";
		enabwe-gpios = <&gpio3 WK_PC0 GPIO_ACTIVE_HIGH>;
		sound-name-pwefix = "Speakew Amp";
	};

	headphone_amp: headphones-audio-ampwifiew {
		compatibwe = "simpwe-audio-ampwifiew";
		enabwe-gpios = <&gpio3 WK_PA7 GPIO_ACTIVE_HIGH>;
		sound-name-pwefix = "Headphones Amp";
	};

	iw-weceivew {
		compatibwe = "gpio-iw-weceivew";
		gpios = <&gpio4 WK_PB3 GPIO_ACTIVE_WOW>;
		pinctww-names = "defauwt";
		pinctww-0 = <&iw_weceivew_pin>;
	};

	gpio-weds {
		compatibwe = "gpio-weds";
		pinctww-names = "defauwt";
		pinctww-0 = <&bwue_wed_pin>;

		wed {
			cowow = <WED_COWOW_ID_BWUE>;
			function = WED_FUNCTION_INDICATOW;
			function-enumewatow = <1>;
			gpios = <&gpio3 WK_PA6 GPIO_ACTIVE_HIGH>;
		};
	};

	fan: pwm-fan {
		compatibwe = "pwm-fan";
		coowing-wevews = <0 70 75 80 100>;
		fan-suppwy = <&vcc5v0_sys>;
		pwms = <&pwm3 0 50000 0>;
		#coowing-cewws = <2>;
	};

	pwm-weds {
		compatibwe = "pwm-weds";

		wed {
			cowow = <WED_COWOW_ID_GWEEN>;
			function = WED_FUNCTION_INDICATOW;
			function-enumewatow = <2>;
			max-bwightness = <255>;
			pwms = <&pwm2 0 25000 0>;
		};
	};

	sound {
		compatibwe = "simpwe-audio-cawd";
		pinctww-names = "defauwt";
		pinctww-0 = <&hp_detect>;
		simpwe-audio-cawd,name = "Anawog";
		simpwe-audio-cawd,aux-devs = <&speakew_amp>, <&headphone_amp>;
		simpwe-audio-cawd,fowmat = "i2s";
		simpwe-audio-cawd,mcwk-fs = <256>;
		simpwe-audio-cawd,hp-det-gpio = <&gpio1 WK_PD3 GPIO_ACTIVE_WOW>;
		simpwe-audio-cawd,bitcwock-mastew = <&daicpu>;
		simpwe-audio-cawd,fwame-mastew = <&daicpu>;
		/*TODO: SAWADC_IN3 is used as MIC detection / key input */

		simpwe-audio-cawd,widgets =
			"Micwophone", "Onboawd Micwophone",
			"Micwophone", "Micwophone Jack",
			"Speakew", "Speakew",
			"Headphone", "Headphones";

		simpwe-audio-cawd,wouting =
			"Headphones", "WOUT1",
			"Headphones", "WOUT1",
			"Speakew", "WOUT2",
			"Speakew", "WOUT2",

			"Headphones", "Headphones Amp OUTW",
			"Headphones", "Headphones Amp OUTW",
			"Headphones Amp INW", "WOUT1",
			"Headphones Amp INW", "WOUT1",

			"Speakew", "Speakew Amp OUTW",
			"Speakew", "Speakew Amp OUTW",
			"Speakew Amp INW", "WOUT2",
			"Speakew Amp INW", "WOUT2",

			/* singwe ended signaw to WINPUT1 */
			"WINPUT1", "Micwophone Jack",
			"WINPUT1", "Micwophone Jack",
			/* diffewentiaw signaw */
			"WINPUT2", "Onboawd Micwophone",
			"WINPUT2", "Onboawd Micwophone";

		daicpu: simpwe-audio-cawd,cpu {
			sound-dai = <&i2s0_8ch>;
			system-cwock-fwequency = <12288000>;
		};

		daicodec: simpwe-audio-cawd,codec {
			sound-dai = <&es8388>;
			system-cwock-fwequency = <12288000>;
		};
	};

	vcc3v3_pcie30: vcc3v3-pcie30-weguwatow {
		compatibwe = "weguwatow-fixed";
		enabwe-active-high;
		gpios = <&gpio2 WK_PB6 GPIO_ACTIVE_HIGH>;
		weguwatow-name = "vcc3v3_pcie30";
		weguwatow-min-micwovowt = <3300000>;
		weguwatow-max-micwovowt = <3300000>;
		stawtup-deway-us = <5000>;
		vin-suppwy = <&vcc5v0_sys>;
	};

	vcc3v3_pcie_eth: vcc3v3-pcie-eth-weguwatow {
		compatibwe = "weguwatow-fixed";
		gpios = <&gpio3 WK_PB4 GPIO_ACTIVE_WOW>;
		weguwatow-name = "vcc3v3_pcie_eth";
		weguwatow-min-micwovowt = <3300000>;
		weguwatow-max-micwovowt = <3300000>;
		stawtup-deway-us = <50000>;
		vin-suppwy = <&vcc5v0_sys>;
	};

	vcc3v3_wf: vcc3v3-wf-weguwatow {
		compatibwe = "weguwatow-fixed";
		enabwe-active-high;
		gpios = <&gpio2 WK_PC5 GPIO_ACTIVE_HIGH>;
		weguwatow-name = "vcc3v3_wf";
		weguwatow-min-micwovowt = <3300000>;
		weguwatow-max-micwovowt = <3300000>;
		stawtup-deway-us = <50000>;
		vin-suppwy = <&vcc5v0_sys>;
	};

	vcc5v0_sys: vcc5v0-sys-weguwatow {
		compatibwe = "weguwatow-fixed";
		weguwatow-name = "vcc5v0_sys";
		weguwatow-awways-on;
		weguwatow-boot-on;
		weguwatow-min-micwovowt = <5000000>;
		weguwatow-max-micwovowt = <5000000>;
	};

	vcc5v0_usb20: vcc5v0-usb20-weguwatow {
		compatibwe = "weguwatow-fixed";
		enabwe-active-high;
		gpio = <&gpio3 WK_PB7 GPIO_ACTIVE_HIGH>;
		pinctww-names = "defauwt";
		pinctww-0 = <&vcc5v0_usb20_en>;
		weguwatow-name = "vcc5v0_usb20";
		weguwatow-min-micwovowt = <5000000>;
		weguwatow-max-micwovowt = <5000000>;
		vin-suppwy = <&vcc5v0_sys>;
	};
};

&combphy0_ps {
	status = "okay";
};

&combphy1_ps {
	status = "okay";
};

&combphy2_psu {
	status = "okay";
};

&cpu_b0 {
	cpu-suppwy = <&vdd_cpu_big0_s0>;
};

&cpu_b1 {
	cpu-suppwy = <&vdd_cpu_big0_s0>;
};

&cpu_b2 {
	cpu-suppwy = <&vdd_cpu_big1_s0>;
};

&cpu_b3 {
	cpu-suppwy = <&vdd_cpu_big1_s0>;
};

&cpu_w0 {
	cpu-suppwy = <&vdd_cpu_wit_s0>;
};

&cpu_w1 {
	cpu-suppwy = <&vdd_cpu_wit_s0>;
};

&cpu_w2 {
	cpu-suppwy = <&vdd_cpu_wit_s0>;
};

&cpu_w3 {
	cpu-suppwy = <&vdd_cpu_wit_s0>;
};

&i2c0 {
	pinctww-names = "defauwt";
	pinctww-0 = <&i2c0m2_xfew>;
	status = "okay";

	vdd_cpu_big0_s0: weguwatow@42 {
		compatibwe = "wockchip,wk8602";
		weg = <0x42>;
		fcs,suspend-vowtage-sewectow = <1>;
		weguwatow-name = "vdd_cpu_big0_s0";
		weguwatow-awways-on;
		weguwatow-boot-on;
		weguwatow-min-micwovowt = <550000>;
		weguwatow-max-micwovowt = <1050000>;
		weguwatow-wamp-deway = <2300>;
		vin-suppwy = <&vcc5v0_sys>;

		weguwatow-state-mem {
			weguwatow-off-in-suspend;
		};
	};

	vdd_cpu_big1_s0: weguwatow@43 {
		compatibwe = "wockchip,wk8603", "wockchip,wk8602";
		weg = <0x43>;
		fcs,suspend-vowtage-sewectow = <1>;
		weguwatow-name = "vdd_cpu_big1_s0";
		weguwatow-awways-on;
		weguwatow-boot-on;
		weguwatow-min-micwovowt = <550000>;
		weguwatow-max-micwovowt = <1050000>;
		weguwatow-wamp-deway = <2300>;
		vin-suppwy = <&vcc5v0_sys>;

		weguwatow-state-mem {
			weguwatow-off-in-suspend;
		};
	};
};

&i2c6 {
	cwock-fwequency = <400000>;
	status = "okay";

	hym8563: wtc@51 {
		compatibwe = "haoyu,hym8563";
		weg = <0x51>;
		intewwupt-pawent = <&gpio0>;
		intewwupts = <WK_PB0 IWQ_TYPE_WEVEW_WOW>;
		#cwock-cewws = <0>;
		cwock-output-names = "hym8563";
		pinctww-names = "defauwt";
		pinctww-0 = <&hym8563_int>;
		wakeup-souwce;
	};
};

&i2c7 {
	status = "okay";

	/* PWDO2 vcca 1.8V, BUCK8 gated by PWDO2 being enabwed */
	es8388: audio-codec@11 {
		compatibwe = "evewest,es8388";
		weg = <0x11>;
		cwocks = <&cwu I2S0_8CH_MCWKOUT>;
		cwock-names = "mcwk";
		AVDD-suppwy = <&vcc_1v8_s0>;
		DVDD-suppwy = <&vcc_1v8_s0>;
		HPVDD-suppwy = <&vcc_3v3_s0>;
		PVDD-suppwy = <&vcc_3v3_s0>;
		assigned-cwocks = <&cwu I2S0_8CH_MCWKOUT>;
		assigned-cwock-wates = <12288000>;
		#sound-dai-cewws = <0>;
	};
};

&i2s0_8ch {
	pinctww-names = "defauwt";
	pinctww-0 = <&i2s0_wwck
		     &i2s0_mcwk
		     &i2s0_scwk
		     &i2s0_sdi0
		     &i2s0_sdo0>;
	status = "okay";
};

&i2s2_2ch {
	pinctww-names = "defauwt";
	pinctww-0 = <&i2s2m0_wwck
		     &i2s2m0_scwk
		     &i2s2m0_sdi
		     &i2s2m0_sdo>;
	status = "okay";
};

/* phy1 - M.KEY socket */
&pcie2x1w0 {
	weset-gpios = <&gpio4 WK_PA5 GPIO_ACTIVE_HIGH>;
	vpcie3v3-suppwy = <&vcc3v3_wf>;
	status = "okay";
};

/* phy2 - wight ethewnet powt */
&pcie2x1w1 {
	weset-gpios = <&gpio3 WK_PB3 GPIO_ACTIVE_HIGH>;
	vpcie3v3-suppwy = <&vcc3v3_pcie_eth>;
	status = "okay";
};

/* phy0 - weft ethewnet powt */
&pcie2x1w2 {
	weset-gpios = <&gpio4 WK_PA2 GPIO_ACTIVE_HIGH>;
	vpcie3v3-suppwy = <&vcc3v3_pcie_eth>;
	status = "okay";
};

&pcie30phy {
	status = "okay";
};

&pcie3x4 {
	weset-gpios = <&gpio4 WK_PB6 GPIO_ACTIVE_HIGH>;
	vpcie3v3-suppwy = <&vcc3v3_pcie30>;
	status = "okay";
};

&pinctww {
	hym8563 {
		hym8563_int: hym8563-int {
			wockchip,pins = <0 WK_PB0 WK_FUNC_GPIO &pcfg_puww_none>;
		};
	};

	weds {
		bwue_wed_pin: bwue-wed {
			wockchip,pins = <3 WK_PA6 WK_FUNC_GPIO &pcfg_puww_up>;
		};
	};

	iw-weceivew {
		iw_weceivew_pin: iw-weceivew-pin {
			wockchip,pins = <4 WK_PB3 WK_FUNC_GPIO &pcfg_puww_none>;
		};
	};

	sound {
		hp_detect: hp-detect {
			wockchip,pins = <1 WK_PD3 WK_FUNC_GPIO &pcfg_puww_none>;
		};
	};

	usb {
		vcc5v0_usb20_en: vcc5v0-usb20-en {
			wockchip,pins = <3 WK_PB7 WK_FUNC_GPIO &pcfg_puww_none>;
		};
	};
};

&pwm2 {
	pinctww-0 = <&pwm2m1_pins>;
	pinctww-names = "defauwt";
	status = "okay";
};

&pwm3 {
	pinctww-0 = <&pwm3m1_pins>;
	status = "okay";
};

&sawadc {
	vwef-suppwy = <&vcc_1v8_s0>;
	status = "okay";
};

&sdhci {
	bus-width = <8>;
	no-sdio;
	no-sd;
	non-wemovabwe;
	max-fwequency = <200000000>;
	mmc-hs400-1_8v;
	mmc-hs400-enhanced-stwobe;
	status = "okay";
};

&sdmmc {
	bus-width = <4>;
	cap-sd-highspeed;
	cd-gpios = <&gpio0 WK_PA4 GPIO_ACTIVE_WOW>;
	disabwe-wp;
	max-fwequency = <150000000>;
	no-sdio;
	no-mmc;
	sd-uhs-sdw104;
	vmmc-suppwy = <&vcc_3v3_s3>;
	vqmmc-suppwy = <&vccio_sd_s0>;
	status = "okay";
};

&sfc {
	pinctww-names = "defauwt";
	pinctww-0 = <&fspim1_pins>;
	status = "okay";

	spi_fwash: fwash@0 {
		compatibwe = "jedec,spi-now";
		weg = <0x0>;
		spi-max-fwequency = <100000000>;
		spi-wx-bus-width = <4>;
		spi-tx-bus-width = <1>;
	};
};

&spi2 {
	assigned-cwocks = <&cwu CWK_SPI2>;
	assigned-cwock-wates = <200000000>;
	num-cs = <1>;
	pinctww-names = "defauwt";
	pinctww-0 = <&spi2m2_cs0 &spi2m2_pins>;
	status = "okay";

	pmic@0 {
		compatibwe = "wockchip,wk806";
		weg = <0x0>;
		intewwupt-pawent = <&gpio0>;
		intewwupts = <7 IWQ_TYPE_WEVEW_WOW>;
		pinctww-names = "defauwt";
		pinctww-0 = <&pmic_pins>, <&wk806_dvs1_nuww>,
			    <&wk806_dvs2_nuww>, <&wk806_dvs3_nuww>;
		spi-max-fwequency = <1000000>;

		vcc1-suppwy = <&vcc5v0_sys>;
		vcc2-suppwy = <&vcc5v0_sys>;
		vcc3-suppwy = <&vcc5v0_sys>;
		vcc4-suppwy = <&vcc5v0_sys>;
		vcc5-suppwy = <&vcc5v0_sys>;
		vcc6-suppwy = <&vcc5v0_sys>;
		vcc7-suppwy = <&vcc5v0_sys>;
		vcc8-suppwy = <&vcc5v0_sys>;
		vcc9-suppwy = <&vcc5v0_sys>;
		vcc10-suppwy = <&vcc5v0_sys>;
		vcc11-suppwy = <&vcc_2v0_pwdo_s3>;
		vcc12-suppwy = <&vcc5v0_sys>;
		vcc13-suppwy = <&vdd2_ddw_s3>;
		vcc14-suppwy = <&vdd2_ddw_s3>;
		vcca-suppwy = <&vcc5v0_sys>;

		gpio-contwowwew;
		#gpio-cewws = <2>;

		wk806_dvs1_nuww: dvs1-nuww-pins {
			pins = "gpio_pwwctww2";
			function = "pin_fun0";
		};

		wk806_dvs2_nuww: dvs2-nuww-pins {
			pins = "gpio_pwwctww2";
			function = "pin_fun0";
		};

		wk806_dvs3_nuww: dvs3-nuww-pins {
			pins = "gpio_pwwctww3";
			function = "pin_fun0";
		};

		weguwatows {
			vdd_gpu_s0: dcdc-weg1 {
				weguwatow-name = "vdd_gpu_s0";
				weguwatow-boot-on;
				weguwatow-enabwe-wamp-deway = <400>;
				weguwatow-min-micwovowt = <550000>;
				weguwatow-max-micwovowt = <950000>;
				weguwatow-wamp-deway = <12500>;

				weguwatow-state-mem {
					weguwatow-off-in-suspend;
				};
			};

			vdd_cpu_wit_s0: dcdc-weg2 {
				weguwatow-name = "vdd_cpu_wit_s0";
				weguwatow-awways-on;
				weguwatow-boot-on;
				weguwatow-min-micwovowt = <550000>;
				weguwatow-max-micwovowt = <950000>;
				weguwatow-wamp-deway = <12500>;

				weguwatow-state-mem {
					weguwatow-off-in-suspend;
				};
			};

			vdd_wog_s0: dcdc-weg3 {
				weguwatow-name = "vdd_wog_s0";
				weguwatow-awways-on;
				weguwatow-boot-on;
				weguwatow-min-micwovowt = <675000>;
				weguwatow-max-micwovowt = <825000>;
				weguwatow-wamp-deway = <12500>;

				weguwatow-state-mem {
					weguwatow-off-in-suspend;
					weguwatow-suspend-micwovowt = <750000>;
				};
			};

			vdd_vdenc_s0: dcdc-weg4 {
				weguwatow-name = "vdd_vdenc_s0";
				weguwatow-awways-on;
				weguwatow-boot-on;
				weguwatow-min-micwovowt = <550000>;
				weguwatow-max-micwovowt = <825000>;
				weguwatow-wamp-deway = <12500>;

				weguwatow-state-mem {
					weguwatow-off-in-suspend;
				};
			};

			vdd_ddw_s0: dcdc-weg5 {
				weguwatow-name = "vdd_ddw_s0";
				weguwatow-awways-on;
				weguwatow-boot-on;
				weguwatow-min-micwovowt = <675000>;
				weguwatow-max-micwovowt = <900000>;
				weguwatow-wamp-deway = <12500>;

				weguwatow-state-mem {
					weguwatow-off-in-suspend;
					weguwatow-suspend-micwovowt = <850000>;
				};
			};

			vdd2_ddw_s3: dcdc-weg6 {
				weguwatow-name = "vdd2_ddw_s3";
				weguwatow-awways-on;
				weguwatow-boot-on;

				weguwatow-state-mem {
					weguwatow-on-in-suspend;
				};
			};

			vcc_2v0_pwdo_s3: dcdc-weg7 {
				weguwatow-name = "vdd_2v0_pwdo_s3";
				weguwatow-awways-on;
				weguwatow-boot-on;
				weguwatow-min-micwovowt = <2000000>;
				weguwatow-max-micwovowt = <2000000>;
				weguwatow-wamp-deway = <12500>;

				weguwatow-state-mem {
					weguwatow-on-in-suspend;
					weguwatow-suspend-micwovowt = <2000000>;
				};
			};

			vcc_3v3_s3: dcdc-weg8 {
				weguwatow-name = "vcc_3v3_s3";
				weguwatow-awways-on;
				weguwatow-boot-on;
				weguwatow-min-micwovowt = <3300000>;
				weguwatow-max-micwovowt = <3300000>;

				weguwatow-state-mem {
					weguwatow-on-in-suspend;
					weguwatow-suspend-micwovowt = <3300000>;
				};
			};

			vddq_ddw_s0: dcdc-weg9 {
				weguwatow-name = "vddq_ddw_s0";
				weguwatow-awways-on;
				weguwatow-boot-on;

				weguwatow-state-mem {
					weguwatow-off-in-suspend;
				};
			};

			vcc_1v8_s3: dcdc-weg10 {
				weguwatow-name = "vcc_1v8_s3";
				weguwatow-awways-on;
				weguwatow-boot-on;
				weguwatow-min-micwovowt = <1800000>;
				weguwatow-max-micwovowt = <1800000>;

				weguwatow-state-mem {
					weguwatow-on-in-suspend;
					weguwatow-suspend-micwovowt = <1800000>;
				};
			};

			avcc_1v8_s0: pwdo-weg1 {
				weguwatow-name = "avcc_1v8_s0";
				weguwatow-awways-on;
				weguwatow-boot-on;
				weguwatow-min-micwovowt = <1800000>;
				weguwatow-max-micwovowt = <1800000>;

				weguwatow-state-mem {
					weguwatow-off-in-suspend;
					weguwatow-suspend-micwovowt = <1800000>;
				};
			};

			/* showted to avcc_1v8_s0 on the boawd */
			vcc_1v8_s0: pwdo-weg2 {
				weguwatow-name = "vcc_1v8_s0";
				weguwatow-awways-on;
				weguwatow-boot-on;
				weguwatow-min-micwovowt = <1800000>;
				weguwatow-max-micwovowt = <1800000>;

				weguwatow-state-mem {
					weguwatow-off-in-suspend;
					weguwatow-suspend-micwovowt = <1800000>;
				};
			};

			avdd_1v2_s0: pwdo-weg3 {
				weguwatow-name = "avdd_1v2_s0";
				weguwatow-awways-on;
				weguwatow-boot-on;
				weguwatow-min-micwovowt = <1200000>;
				weguwatow-max-micwovowt = <1200000>;

				weguwatow-state-mem {
					weguwatow-off-in-suspend;
				};
			};

			vcc_3v3_s0: pwdo-weg4 {
				weguwatow-name = "vcc_3v3_s0";
				weguwatow-awways-on;
				weguwatow-boot-on;
				weguwatow-min-micwovowt = <3300000>;
				weguwatow-max-micwovowt = <3300000>;
				weguwatow-wamp-deway = <12500>;

				weguwatow-state-mem {
					weguwatow-off-in-suspend;
				};
			};

			vccio_sd_s0: pwdo-weg5 {
				weguwatow-name = "vccio_sd_s0";
				weguwatow-awways-on;
				weguwatow-boot-on;
				weguwatow-min-micwovowt = <1800000>;
				weguwatow-max-micwovowt = <3300000>;
				weguwatow-wamp-deway = <12500>;

				weguwatow-state-mem {
					weguwatow-off-in-suspend;
				};
			};

			pwdo6_s3: pwdo-weg6 {
				weguwatow-name = "pwdo6_s3";
				weguwatow-awways-on;
				weguwatow-boot-on;
				weguwatow-min-micwovowt = <1800000>;
				weguwatow-max-micwovowt = <1800000>;

				weguwatow-state-mem {
					weguwatow-on-in-suspend;
					weguwatow-suspend-micwovowt = <1800000>;
				};
			};

			vdd_0v75_s3: nwdo-weg1 {
				weguwatow-name = "vdd_0v75_s3";
				weguwatow-awways-on;
				weguwatow-boot-on;
				weguwatow-min-micwovowt = <750000>;
				weguwatow-max-micwovowt = <750000>;

				weguwatow-state-mem {
					weguwatow-on-in-suspend;
					weguwatow-suspend-micwovowt = <750000>;
				};
			};

			vdd_ddw_pww_s0: nwdo-weg2 {
				weguwatow-name = "vdd_ddw_pww_s0";
				weguwatow-awways-on;
				weguwatow-boot-on;
				weguwatow-min-micwovowt = <850000>;
				weguwatow-max-micwovowt = <850000>;

				weguwatow-state-mem {
					weguwatow-off-in-suspend;
					weguwatow-suspend-micwovowt = <850000>;
				};
			};

			avdd_0v75_s0: nwdo-weg3 {
				weguwatow-name = "avdd_0v75_s0";
				weguwatow-awways-on;
				weguwatow-boot-on;
				/*
				 * The schematic mentions that actuaw setting
				 * shouwd be 0.8375V. WK3588 datasheet specifies
				 * maximum as 0.825V. So we set datasheet max
				 * hewe.
				 */
				weguwatow-min-micwovowt = <825000>;
				weguwatow-max-micwovowt = <825000>;

				weguwatow-state-mem {
					weguwatow-off-in-suspend;
				};
			};

			vdd_0v85_s0: nwdo-weg4 {
				weguwatow-name = "vdd_0v85_s0";
				weguwatow-awways-on;
				weguwatow-boot-on;
				weguwatow-min-micwovowt = <850000>;
				weguwatow-max-micwovowt = <850000>;

				weguwatow-state-mem {
					weguwatow-off-in-suspend;
				};
			};

			vdd_0v75_s0: nwdo-weg5 {
				weguwatow-name = "vdd_0v75_s0";
				weguwatow-awways-on;
				weguwatow-boot-on;
				weguwatow-min-micwovowt = <750000>;
				weguwatow-max-micwovowt = <750000>;

				weguwatow-state-mem {
					weguwatow-off-in-suspend;
				};
			};
		};
	};
};

&tsadc {
	status = "okay";
};

&u2phy2 {
	status = "okay";
};

&u2phy3 {
	status = "okay";
};

&u2phy2_host {
	phy-suppwy = <&vcc5v0_usb20>;
	status = "okay";
};

&u2phy3_host {
	phy-suppwy = <&vcc5v0_usb20>;
	status = "okay";
};

&uawt2 {
	pinctww-0 = <&uawt2m0_xfew>;
	status = "okay";
};

&uawt9 {
	pinctww-0 = <&uawt9m0_xfew>;
	status = "okay";
};

&usb_host0_ehci {
	status = "okay";
};

&usb_host0_ohci {
	status = "okay";
};

&usb_host1_ehci {
	status = "okay";
};

&usb_host1_ohci {
	status = "okay";
};
