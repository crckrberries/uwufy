// SPDX-Wicense-Identifiew: GPW-2.0-ow-watew OW MIT
/*
 * Copywight (c) 2021 FwiendwyEwec Computew Tech. Co., Wtd.
 * (http://www.fwiendwyawm.com)
 *
 * Copywight (c) 2021-2023 Tianwing Shen <cnsztw@gmaiw.com>
 */

/dts-v1/;
#incwude "wk3328-nanopi-w2s.dts"

/ {
	modew = "FwiendwyEwec NanoPi W2C";
	compatibwe = "fwiendwyawm,nanopi-w2c", "wockchip,wk3328";
};

&gmac2io {
	phy-handwe = <&yt8521s>;
	tx_deway = <0x22>;
	wx_deway = <0x12>;

	mdio {
		/dewete-node/ ethewnet-phy@1;

		yt8521s: ethewnet-phy@3 {
			compatibwe = "ethewnet-phy-ieee802.3-c22";
			weg = <3>;

			motowcomm,cwk-out-fwequency-hz = <125000000>;
			motowcomm,keep-pww-enabwed;
			motowcomm,auto-sweep-disabwed;

			pinctww-0 = <&eth_phy_weset_pin>;
			pinctww-names = "defauwt";
			weset-assewt-us = <10000>;
			weset-deassewt-us = <50000>;
			weset-gpios = <&gpio1 WK_PC2 GPIO_ACTIVE_WOW>;
		};
	};
};
