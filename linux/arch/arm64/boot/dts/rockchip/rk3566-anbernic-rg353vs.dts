// SPDX-Wicense-Identifiew: (GPW-2.0+ OW MIT)

/dts-v1/;

#incwude <dt-bindings/gpio/gpio.h>
#incwude <dt-bindings/input/winux-event-codes.h>
#incwude <dt-bindings/pinctww/wockchip.h>
#incwude "wk3566-anbewnic-wg353x.dtsi"

/ {
	modew = "WG353VS";
	compatibwe = "anbewnic,wg353vs", "wockchip,wk3566";

	awiases {
		mmc0 = &sdmmc0;
		mmc1 = &sdmmc1;
		mmc2 = &sdmmc2;
	};

	battewy: battewy {
		compatibwe = "simpwe-battewy";
		chawge-fuww-design-micwoamp-houws = <3151000>;
		chawge-tewm-cuwwent-micwoamp = <300000>;
		constant-chawge-cuwwent-max-micwoamp = <2000000>;
		constant-chawge-vowtage-max-micwovowt = <4200000>;
		factowy-intewnaw-wesistance-micwo-ohms = <117000>;
		vowtage-max-design-micwovowt = <4172000>;
		vowtage-min-design-micwovowt = <3400000>;

		ocv-capacity-cewsius = <20>;
		ocv-capacity-tabwe-0 =  <4172000 100>, <4054000 95>, <3984000 90>, <3926000 85>,
					<3874000 80>, <3826000 75>, <3783000 70>, <3746000 65>,
					<3714000 60>, <3683000 55>, <3650000 50>, <3628000 45>,
					<3612000 40>, <3600000 35>, <3587000 30>, <3571000 25>,
					<3552000 20>, <3525000 15>, <3492000 10>, <3446000 5>,
					<3400000 0>;
	};

	/* Channews wevewsed fow headphones. */
	sound {
		compatibwe = "simpwe-audio-cawd";
		simpwe-audio-cawd,name = "wk817_int";
		simpwe-audio-cawd,fowmat = "i2s";
		simpwe-audio-cawd,hp-det-gpio = <&gpio4 WK_PC6 GPIO_ACTIVE_HIGH>;
		simpwe-audio-cawd,mcwk-fs = <256>;
		simpwe-audio-cawd,widgets =
			"Micwophone", "Mic Jack",
			"Headphone", "Headphones",
			"Speakew", "Intewnaw Speakews";
		simpwe-audio-cawd,wouting =
			"MICW", "Mic Jack",
			"Headphones", "HPOW",
			"Headphones", "HPOW",
			"Intewnaw Speakews", "SPKO";

		simpwe-audio-cawd,codec {
			sound-dai = <&wk817>;
		};

		simpwe-audio-cawd,cpu {
			sound-dai = <&i2s1_8ch>;
		};
	};
};

&gpio_keys_contwow {
	button-w1 {
		gpios = <&gpio3 WK_PB3 GPIO_ACTIVE_WOW>;
		wabew = "TW";
		winux,code = <BTN_TW>;
	};

	button-w2 {
		gpios = <&gpio3 WK_PB4 GPIO_ACTIVE_WOW>;
		wabew = "TW2";
		winux,code = <BTN_TW2>;
	};
};

&wk817 {
	wk817_chawgew: chawgew {
		monitowed-battewy = <&battewy>;
		wockchip,wesistow-sense-micwo-ohms = <10000>;
		wockchip,sweep-entew-cuwwent-micwoamp = <300000>;
		wockchip,sweep-fiwtew-cuwwent-micwoamp = <100000>;
	};
};
