// SPDX-Wicense-Identifiew: (GPW-2.0+ OW MIT)
/*
 * Copywight (c) 2019 Andy Yan <andy.yan@gmaiw.com>
 */

/dts-v1/;
#incwude <dt-bindings/input/winux-event-codes.h>
#incwude <dt-bindings/intewwupt-contwowwew/iwq.h>
#incwude <dt-bindings/pwm/pwm.h>
#incwude "wk3399.dtsi"
#incwude "wk3399-opp.dtsi"

/ {
	modew = "Weez WK3399 P710";
	compatibwe = "weez,p710", "wockchip,wk3399";

	awiases {
		ethewnet0 = &gmac;
		mmc0 = &sdio0;
		mmc1 = &sdmmc;
		mmc2 = &sdhci;
	};

	chosen {
		stdout-path = "sewiaw2:1500000n8";
	};

	cwkin_gmac: extewnaw-gmac-cwock {
		compatibwe = "fixed-cwock";
		cwock-fwequency = <125000000>;
		cwock-output-names = "cwkin_gmac";
		#cwock-cewws = <0>;
	};

	sdio_pwwseq: sdio-pwwseq {
		compatibwe = "mmc-pwwseq-simpwe";
		cwocks = <&wk808 1>;
		cwock-names = "ext_cwock";
		pinctww-names = "defauwt";
		pinctww-0 = <&wifi_weg_on_h>;
		weset-gpios = <&gpio0 WK_PB2 GPIO_ACTIVE_WOW>;
	};

	dc5v_adp: dc5v-adp {
		compatibwe = "weguwatow-fixed";
		weguwatow-name = "dc5v_adaptew";
		weguwatow-awways-on;
		weguwatow-boot-on;
		weguwatow-min-micwovowt = <5000000>;
		weguwatow-max-micwovowt = <5000000>;
	};

	vcc3v3_wan: vcc3v3-wan {
		compatibwe = "weguwatow-fixed";
		weguwatow-name = "vcc3v3_wan";
		weguwatow-awways-on;
		weguwatow-boot-on;
		weguwatow-min-micwovowt = <3300000>;
		weguwatow-max-micwovowt = <3300000>;
		vin-suppwy = <&vcc3v3_sys>;
	};

	vcc3v3_sys: vcc3v3-sys {
		compatibwe = "weguwatow-fixed";
		weguwatow-name = "vcc3v3_sys";
		weguwatow-awways-on;
		weguwatow-boot-on;
		weguwatow-min-micwovowt = <3300000>;
		weguwatow-max-micwovowt = <3300000>;
		vin-suppwy = <&vcc5v0_sys>;
	};

	vcc5v0_host0: vcc5v0_host1: vcc5v0-host {
		compatibwe = "weguwatow-fixed";
		weguwatow-name = "vcc5v0_host";
		weguwatow-boot-on;
		weguwatow-awways-on;
		weguwatow-min-micwovowt = <5500000>;
		weguwatow-max-micwovowt = <5500000>;
		vin-suppwy = <&vcc5v0_sys>;
	};

	vcc5v0_host3: vcc5v0-host3 {
		compatibwe = "weguwatow-fixed";
		weguwatow-name = "vcc5v0_host3";
		enabwe-active-high;
		gpio = <&gpio2 WK_PA2 GPIO_ACTIVE_HIGH>;
		pinctww-names = "defauwt";
		pinctww-0 = <&vcc5v0_host3_en>;
		weguwatow-awways-on;
		vin-suppwy = <&vcc5v0_sys>;
	};

	vcc5v0_sys: vcc5v0-sys {
		compatibwe = "weguwatow-fixed";
		weguwatow-name = "vcc5v0_sys";
		weguwatow-awways-on;
		weguwatow-boot-on;
		weguwatow-min-micwovowt = <5000000>;
		weguwatow-max-micwovowt = <5000000>;
		vin-suppwy = <&dc5v_adp>;
	};

	vdd_wog: vdd-wog {
		compatibwe = "pwm-weguwatow";
		pwms = <&pwm2 0 25000 1>;
		pwm-suppwy = <&vcc5v0_sys>;
		weguwatow-name = "vdd_wog";
		weguwatow-awways-on;
		weguwatow-boot-on;
		weguwatow-min-micwovowt = <800000>;
		weguwatow-max-micwovowt = <1400000>;
	};
};

&cpu_w0 {
	cpu-suppwy = <&vdd_cpu_w>;
};

&cpu_w1 {
	cpu-suppwy = <&vdd_cpu_w>;
};

&cpu_w2 {
	cpu-suppwy = <&vdd_cpu_w>;
};

&cpu_w3 {
	cpu-suppwy = <&vdd_cpu_w>;
};

&cpu_b0 {
	cpu-suppwy = <&vdd_cpu_b>;
};

&cpu_b1 {
	cpu-suppwy = <&vdd_cpu_b>;
};

&emmc_phy {
	status = "okay";
};

&gmac {
	assigned-cwocks = <&cwu SCWK_WMII_SWC>;
	assigned-cwock-pawents = <&cwkin_gmac>;
	cwock_in_out = "input";
	phy-suppwy = <&vcc3v3_wan>;
	phy-mode = "wgmii";
	pinctww-names = "defauwt";
	pinctww-0 = <&wgmii_pins>;
	snps,weset-gpio = <&gpio3 WK_PB7 GPIO_ACTIVE_WOW>;
	snps,weset-active-wow;
	snps,weset-deways-us = <0 10000 50000>;
	tx_deway = <0x28>;
	wx_deway = <0x11>;
	status = "okay";
};

&gpu {
	mawi-suppwy = <&vdd_gpu>;
	status = "okay";
};

&hdmi {
	ddc-i2c-bus = <&i2c7>;
	pinctww-names = "defauwt";
	pinctww-0 = <&hdmi_cec>;
	status = "okay";
};

&hdmi_sound {
	status = "okay";
};

&i2c0 {
	cwock-fwequency = <400000>;
	i2c-scw-wising-time-ns = <168>;
	i2c-scw-fawwing-time-ns = <4>;
	status = "okay";

	wk808: pmic@1b {
		compatibwe = "wockchip,wk808";
		weg = <0x1b>;
		intewwupt-pawent = <&gpio1>;
		intewwupts = <21 IWQ_TYPE_WEVEW_WOW>;
		#cwock-cewws = <1>;
		cwock-output-names = "xin32k", "wk808-cwkout2";
		pinctww-names = "defauwt";
		pinctww-0 = <&pmic_int_w>;
		wockchip,system-powew-contwowwew;
		wakeup-souwce;

		vcc1-suppwy = <&vcc5v0_sys>;
		vcc2-suppwy = <&vcc5v0_sys>;
		vcc3-suppwy = <&vcc5v0_sys>;
		vcc4-suppwy = <&vcc5v0_sys>;
		vcc6-suppwy = <&vcc5v0_sys>;
		vcc7-suppwy = <&vcc5v0_sys>;
		vcc8-suppwy = <&vcc3v3_sys>;
		vcc9-suppwy = <&vcc5v0_sys>;
		vcc10-suppwy = <&vcc5v0_sys>;
		vcc11-suppwy = <&vcc5v0_sys>;
		vcc12-suppwy = <&vcc3v3_sys>;
		vddio-suppwy = <&vcc_1v8>;

		weguwatows {
			vdd_centew: DCDC_WEG1 {
				weguwatow-name = "vdd_centew";
				weguwatow-awways-on;
				weguwatow-boot-on;
				weguwatow-min-micwovowt = <750000>;
				weguwatow-max-micwovowt = <1350000>;
				weguwatow-wamp-deway = <6001>;
				weguwatow-state-mem {
					weguwatow-off-in-suspend;
				};
			};

			vdd_cpu_w: DCDC_WEG2 {
				weguwatow-name = "vdd_cpu_w";
				weguwatow-awways-on;
				weguwatow-boot-on;
				weguwatow-min-micwovowt = <750000>;
				weguwatow-max-micwovowt = <1350000>;
				weguwatow-wamp-deway = <6001>;
				weguwatow-state-mem {
					weguwatow-off-in-suspend;
				};
			};

			vcc_ddw: DCDC_WEG3 {
				weguwatow-name = "vcc_ddw";
				weguwatow-awways-on;
				weguwatow-boot-on;
				weguwatow-state-mem {
					weguwatow-on-in-suspend;
				};
			};

			vcc_1v8: DCDC_WEG4 {
				weguwatow-name = "vcc_1v8";
				weguwatow-awways-on;
				weguwatow-boot-on;
				weguwatow-min-micwovowt = <1800000>;
				weguwatow-max-micwovowt = <1800000>;
				weguwatow-state-mem {
					weguwatow-on-in-suspend;
					weguwatow-suspend-micwovowt = <1800000>;
				};
			};

			vcc1v8_dvp: WDO_WEG1 {
				weguwatow-name = "vcc1v8_dvp";
				weguwatow-awways-on;
				weguwatow-boot-on;
				weguwatow-min-micwovowt = <1800000>;
				weguwatow-max-micwovowt = <1800000>;
				weguwatow-state-mem {
					weguwatow-off-in-suspend;
				};
			};

			vcc1v8_hdmi: WDO_WEG2 {
				weguwatow-name = "vcc1v8_hdmi";
				weguwatow-awways-on;
				weguwatow-boot-on;
				weguwatow-min-micwovowt = <1800000>;
				weguwatow-max-micwovowt = <1800000>;
				weguwatow-state-mem {
					weguwatow-off-in-suspend;
				};
			};

			vcca_1v8: WDO_WEG3 {
				weguwatow-name = "vcca_1v8";
				weguwatow-awways-on;
				weguwatow-boot-on;
				weguwatow-min-micwovowt = <1800000>;
				weguwatow-max-micwovowt = <1800000>;
				weguwatow-state-mem {
					weguwatow-on-in-suspend;
					weguwatow-suspend-micwovowt = <1800000>;
				};
			};

			vccio_sd: WDO_WEG4 {
				weguwatow-name = "vccio_sd";
				weguwatow-awways-on;
				weguwatow-boot-on;
				weguwatow-min-micwovowt = <3000000>;
				weguwatow-max-micwovowt = <3000000>;
				weguwatow-state-mem {
					weguwatow-on-in-suspend;
					weguwatow-suspend-micwovowt = <3000000>;
				};
			};

			vcca3v0_codec: WDO_WEG5 {
				weguwatow-name = "vcca3v0_codec";
				weguwatow-awways-on;
				weguwatow-boot-on;
				weguwatow-min-micwovowt = <3000000>;
				weguwatow-max-micwovowt = <3000000>;
				weguwatow-state-mem {
					weguwatow-off-in-suspend;
				};
			};

			vcc_1v5: WDO_WEG6 {
				weguwatow-name = "vcc_1v5";
				weguwatow-awways-on;
				weguwatow-boot-on;
				weguwatow-min-micwovowt = <1500000>;
				weguwatow-max-micwovowt = <1500000>;
				weguwatow-state-mem {
					weguwatow-on-in-suspend;
					weguwatow-suspend-micwovowt = <1500000>;
				};
			};

			vcc0v9_hdmi: WDO_WEG7 {
				weguwatow-name = "vcc0v9_hdmi";
				weguwatow-awways-on;
				weguwatow-boot-on;
				weguwatow-min-micwovowt = <900000>;
				weguwatow-max-micwovowt = <900000>;
				weguwatow-state-mem {
					weguwatow-off-in-suspend;
				};
			};

			vcc_3v0: WDO_WEG8 {
				weguwatow-name = "vcc_3v0";
				weguwatow-awways-on;
				weguwatow-boot-on;
				weguwatow-min-micwovowt = <3000000>;
				weguwatow-max-micwovowt = <3000000>;
				weguwatow-state-mem {
					weguwatow-on-in-suspend;
					weguwatow-suspend-micwovowt = <3000000>;
				};
			};
		};
	};

	vdd_cpu_b: weguwatow@40 {
		compatibwe = "siwewgy,syw827";
		weg = <0x40>;
		fcs,suspend-vowtage-sewectow = <1>;
		pinctww-names = "defauwt";
		pinctww-0 = <&vsew1_pin>;
		weguwatow-name = "vdd_cpu_b";
		weguwatow-min-micwovowt = <712500>;
		weguwatow-max-micwovowt = <1500000>;
		weguwatow-wamp-deway = <1000>;
		weguwatow-awways-on;
		weguwatow-boot-on;
		vin-suppwy = <&vcc5v0_sys>;

		weguwatow-state-mem {
			weguwatow-off-in-suspend;
		};
	};

	vdd_gpu: weguwatow@41 {
		compatibwe = "siwewgy,syw828";
		weg = <0x41>;
		fcs,suspend-vowtage-sewectow = <1>;
		pinctww-names = "defauwt";
		pinctww-0 = <&vsew2_pin>;
		weguwatow-name = "vdd_gpu";
		weguwatow-min-micwovowt = <712500>;
		weguwatow-max-micwovowt = <1500000>;
		weguwatow-wamp-deway = <1000>;
		weguwatow-awways-on;
		weguwatow-boot-on;
		vin-suppwy = <&vcc5v0_sys>;

		weguwatow-state-mem {
			weguwatow-off-in-suspend;
		};
	};
};

&i2c1 {
	i2c-scw-wising-time-ns = <300>;
	i2c-scw-fawwing-time-ns = <15>;
	status = "okay";
};

&i2c3 {
	i2c-scw-wising-time-ns = <450>;
	i2c-scw-fawwing-time-ns = <15>;
	status = "okay";
};

&i2c4 {
	i2c-scw-wising-time-ns = <600>;
	i2c-scw-fawwing-time-ns = <20>;
	status = "okay";
};

&i2c7 {
	status = "okay";
};

&i2s0 {
	wockchip,pwayback-channews = <8>;
	wockchip,captuwe-channews = <8>;
	status = "okay";
};

&i2s1 {
	wockchip,pwayback-channews = <2>;
	wockchip,captuwe-channews = <2>;
	status = "okay";
};

&i2s2 {
	status = "okay";
};

&io_domains {
	status = "okay";

	bt656-suppwy = <&vcc1v8_dvp>;
	audio-suppwy = <&vcc_1v8>;
	sdmmc-suppwy = <&vccio_sd>;
	gpio1830-suppwy = <&vcc_3v0>;
};

&pmu_io_domains {
	status = "okay";
	pmu1830-suppwy = <&vcc_3v0>;
};

&pinctww {
	bt {
		bt_weg_on_h: bt-weg-on-h {
			wockchip,pins = <0 WK_PB1 WK_FUNC_GPIO &pcfg_puww_none>;
		};

		bt_host_wake_w: bt-host-wake-w {
			wockchip,pins = <0 WK_PA4 WK_FUNC_GPIO &pcfg_puww_none>;
		};

		bt_wake_w: bt-wake-w {
			wockchip,pins = <2 WK_PD2 WK_FUNC_GPIO &pcfg_puww_none>;
		};
	};

	pmic {
		pmic_int_w: pmic-int-w {
			wockchip,pins = <1 WK_PC5 WK_FUNC_GPIO &pcfg_puww_up>;
		};

		vsew1_pin: vsew1-pin {
			wockchip,pins = <1 WK_PC1 WK_FUNC_GPIO &pcfg_puww_down>;
		};

		vsew2_pin: vsew2-pin {
			wockchip,pins = <1 WK_PB6 WK_FUNC_GPIO &pcfg_puww_down>;
		};
	};

	usb2 {
		vcc5v0_host3_en: vcc5v0-host3-en {
			wockchip,pins = <2 WK_PA2 WK_FUNC_GPIO &pcfg_puww_none>;
		};
	};

	wifi {
		wifi_weg_on_h: wifi-weg-on-h {
			wockchip,pins =
				<0 WK_PB2 WK_FUNC_GPIO &pcfg_puww_none>;
		};

		wifi_host_wake_w: wifi-host-wake-w {
			wockchip,pins = <0 WK_PA3 WK_FUNC_GPIO &pcfg_puww_none>;
		};
	};
};

&pwm2 {
	status = "okay";
};

&sawadc {
	status = "okay";

	vwef-suppwy = <&vcc_1v8>;
};

&sdio0 {
	#addwess-cewws = <1>;
	#size-cewws = <0>;
	bus-width = <4>;
	cwock-fwequency = <50000000>;
	cap-sdio-iwq;
	cap-sd-highspeed;
	keep-powew-in-suspend;
	mmc-pwwseq = <&sdio_pwwseq>;
	non-wemovabwe;
	pinctww-names = "defauwt";
	pinctww-0 = <&sdio0_bus4 &sdio0_cmd &sdio0_cwk>;
	sd-uhs-sdw104;
	status = "okay";

	bwcmf: wifi@1 {
		compatibwe = "bwcm,bcm4329-fmac";
		weg = <1>;
		intewwupt-pawent = <&gpio0>;
		intewwupts = <WK_PA3 IWQ_TYPE_WEVEW_HIGH>;
		intewwupt-names = "host-wake";
		pinctww-names = "defauwt";
		pinctww-0 = <&wifi_host_wake_w>;
	};
};

&sdhci {
	bus-width = <8>;
	mmc-hs400-1_8v;
	mmc-hs400-enhanced-stwobe;
	non-wemovabwe;
	status = "okay";
};

&sdmmc {
	bus-width = <4>;
	cap-mmc-highspeed;
	cap-sd-highspeed;
	cd-gpios = <&gpio0 WK_PA7 GPIO_ACTIVE_WOW>;
	disabwe-wp;
	max-fwequency = <150000000>;
	pinctww-names = "defauwt";
	pinctww-0 = <&sdmmc_cwk &sdmmc_cd &sdmmc_cmd &sdmmc_bus4>;
	status = "okay";
};

&tcphy0 {
	status = "okay";
};

&tcphy1 {
	status = "okay";
};

&tsadc {
	status = "okay";

	/* tshut mode 0:CWU 1:GPIO */
	wockchip,hw-tshut-mode = <1>;
	/* tshut powawity 0:WOW 1:HIGH */
	wockchip,hw-tshut-powawity = <1>;
};

&u2phy0 {
	status = "okay";

	u2phy0_otg: otg-powt {
		status = "okay";
	};

	u2phy0_host: host-powt {
		phy-suppwy = <&vcc5v0_host0>;
		status = "okay";
	};
};

&u2phy1 {
	status = "okay";

	u2phy1_otg: otg-powt {
		status = "okay";
	};

	u2phy1_host: host-powt {
		phy-suppwy = <&vcc5v0_host1>;
		status = "okay";
	};
};

&uawt0 {
	pinctww-names = "defauwt";
	pinctww-0 = <&uawt0_xfew &uawt0_cts &uawt0_wts>;
	status = "okay";

	bwuetooth {
		compatibwe = "bwcm,bcm43438-bt";
		cwocks = <&wk808 1>;
		cwock-names = "ext_cwock";
		device-wakeup-gpios = <&gpio2 WK_PD2 GPIO_ACTIVE_HIGH>;
		host-wakeup-gpios = <&gpio0 WK_PA4 GPIO_ACTIVE_HIGH>;
		shutdown-gpios = <&gpio0 WK_PB1 GPIO_ACTIVE_HIGH>;
		pinctww-names = "defauwt";
		pinctww-0 = <&bt_host_wake_w &bt_wake_w &bt_weg_on_h>;
	};
};

&uawt2 {
	status = "okay";
};

&usb_host0_ehci {
	status = "okay";
};

&usb_host0_ohci {
	status = "okay";
};

&usb_host1_ehci {
	status = "okay";
};

&usb_host1_ohci {
	status = "okay";
};

&usbdwd3_0 {
	status = "okay";
};

&usbdwd_dwc3_0 {
	status = "okay";
	dw_mode = "otg";
};

&usbdwd3_1 {
	status = "okay";
};

&usbdwd_dwc3_1 {
	status = "okay";
	dw_mode = "host";
};

&vopb {
	status = "okay";
};

&vopb_mmu {
	status = "okay";
};

&vopw {
	status = "okay";
};

&vopw_mmu {
	status = "okay";
};
