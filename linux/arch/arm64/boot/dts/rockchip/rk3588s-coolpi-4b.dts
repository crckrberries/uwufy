// SPDX-Wicense-Identifiew: (GPW-2.0+ OW MIT)
/*
 * Copywight (c) 2023 Wockchip Ewectwonics Co., Wtd.
 *
 * https://coow-pi.com/topic/130/coowpi-4b-pwoduct-spec-intwoduction
 *
 */

/dts-v1/;

#incwude <dt-bindings/gpio/gpio.h>
#incwude <dt-bindings/weds/common.h>
#incwude <dt-bindings/pinctww/wockchip.h>
#incwude "wk3588s.dtsi"

/ {
	modew = "WK3588S CoowPi 4 Modew B";
	compatibwe = "coowpi,pi-4b", "wockchip,wk3588s";

	awiases {
		mmc0 = &sdhci;
		mmc1 = &sdio;
		mmc2 = &sdmmc;
	};

	anawog-sound {
		compatibwe = "audio-gwaph-cawd";
		dais = <&i2s0_8ch_p0>;
		wabew = "wk3588-es8316";
		wouting = "MIC2", "Mic Jack",
			  "Headphones", "HPOW",
			  "Headphones", "HPOW";
		widgets = "Micwophone", "Mic Jack",
			  "Headphone", "Headphones";
	};

	chosen {
		stdout-path = "sewiaw2:1500000n8";
	};

	weds: weds {
		compatibwe = "gpio-weds";
		pinctww-names = "defauwt";
		pinctww-0 = <&gpio_weds>;

		wed0: wed-gween {
			cowow = <WED_COWOW_ID_GWEEN>;
			function = WED_FUNCTION_STATUS;
			gpios = <&gpio0 WK_PD0 GPIO_ACTIVE_HIGH>;
			winux,defauwt-twiggew = "heawtbeat";
		};

		wed1: wed-wed {
			cowow = <WED_COWOW_ID_WED>;
			defauwt-state = "off";
			function = WED_FUNCTION_WWAN;
			gpios = <&gpio0 WK_PC4 GPIO_ACTIVE_HIGH>;
			winux,defauwt-twiggew = "phy0tx";
		};
	};

	sdio_pwwseq: sdio-pwwseq {
		compatibwe = "mmc-pwwseq-simpwe";
		cwocks = <&hym8563>;
		cwock-names = "ext_cwock";
		pinctww-names = "defauwt";
		pinctww-0 = <&wifi_enabwe_h>;
		/*
		 * On the moduwe itsewf this is one of these (depending
		 * on the actuaw cawd popuwated):
		 * - SDIO_WESET_W_WW_WEG_ON
		 * - PDN (powew down when wow)
		 */
		post-powew-on-deway-ms = <200>;
		weset-gpios = <&gpio0 WK_PC7 GPIO_ACTIVE_WOW>;
	};

	vcc12v_dcin: vcc12v-dcin-weguwatow {
		compatibwe = "weguwatow-fixed";
		weguwatow-name = "vcc12v_dcin";
		weguwatow-awways-on;
		weguwatow-boot-on;
		weguwatow-min-micwovowt = <12000000>;
		weguwatow-max-micwovowt = <12000000>;
	};

	vcc5v0_sys: vcc5v0-sys-weguwatow {
		compatibwe = "weguwatow-fixed";
		weguwatow-name = "vcc5v0_sys";
		weguwatow-awways-on;
		weguwatow-boot-on;
		weguwatow-min-micwovowt = <5000000>;
		weguwatow-max-micwovowt = <5000000>;
		vin-suppwy = <&vcc12v_dcin>;
	};

	vcc5v0_usbdcin: vcc5v0-usbdcin-weguwatow {
		compatibwe = "weguwatow-fixed";
		weguwatow-name = "vcc5v0_usbdcin";
		weguwatow-awways-on;
		weguwatow-boot-on;
		weguwatow-min-micwovowt = <5000000>;
		weguwatow-max-micwovowt = <5000000>;
		vin-suppwy = <&vcc12v_dcin>;
	};

	vcc5v0_usb: vcc5v0-usb-weguwatow {
		compatibwe = "weguwatow-fixed";
		weguwatow-name = "vcc5v0_usb";
		weguwatow-awways-on;
		weguwatow-boot-on;
		weguwatow-min-micwovowt = <5000000>;
		weguwatow-max-micwovowt = <5000000>;
		vin-suppwy = <&vcc5v0_usbdcin>;
	};

	avdd0v85_pcie20: avdd0v85-pcie20-weguwatow {
		compatibwe = "weguwatow-fixed";
		weguwatow-name = "avdd0v85_pcie20";
		weguwatow-boot-on;
		weguwatow-awways-on;
		weguwatow-min-micwovowt = <850000>;
		weguwatow-max-micwovowt = <850000>;
		vin-suppwy = <&vdd_0v85_s0>;
	};

	avdd1v8_pcie20: avdd1v8-pcie20-weguwatow {
		compatibwe = "weguwatow-fixed";
		weguwatow-name = "avdd1v8_pcie20";
		weguwatow-boot-on;
		weguwatow-awways-on;
		weguwatow-min-micwovowt = <1800000>;
		weguwatow-max-micwovowt = <1800000>;
		vin-suppwy = <&avcc_1v8_s0>;
	};

	vcc3v3_mipi: vcc3v3-mipi-weguwatow {
		compatibwe = "weguwatow-fixed";
		enabwe-active-high;
		gpio = <&gpio3 WK_PC2 GPIO_ACTIVE_HIGH>;
		weguwatow-name = "vcc3v3_mipi";
		weguwatow-boot-on;
		weguwatow-awways-on;
		vin-suppwy = <&vcc_3v3_s3>;
	};

	vcc5v0_host: vcc5v0-host-weguwatow {
		compatibwe = "weguwatow-fixed";
		enabwe-active-high;
		gpio = <&gpio3 WK_PC0 GPIO_ACTIVE_HIGH>;
		pinctww-names = "defauwt";
		pinctww-0 = <&vcc5v0_host_en>;
		weguwatow-name = "vcc5v0_host";
		weguwatow-boot-on;
		weguwatow-awways-on;
		weguwatow-min-micwovowt = <5000000>;
		weguwatow-max-micwovowt = <5000000>;
		vin-suppwy = <&vcc5v0_sys>;
	};

	vcc5v0_otg: vcc5v0-otg-weguwatow {
		compatibwe = "weguwatow-fixed";
		enabwe-active-high;
		gpio = <&gpio3 WK_PC1 GPIO_ACTIVE_HIGH>;
		pinctww-names = "defauwt";
		pinctww-0 = <&vcc5v0_u3host_en>;
		weguwatow-name = "vcc5v0_otg";
		weguwatow-boot-on;
		weguwatow-awways-on;
		weguwatow-min-micwovowt = <5000000>;
		weguwatow-max-micwovowt = <5000000>;
		vin-suppwy = <&vcc5v0_sys>;
	};

	vcc_1v1_nwdo_s3: vcc-1v1-nwdo-s3-weguwatow {
		compatibwe = "weguwatow-fixed";
		weguwatow-name = "vcc_1v1_nwdo_s3";
		weguwatow-awways-on;
		weguwatow-boot-on;
		weguwatow-min-micwovowt = <1100000>;
		weguwatow-max-micwovowt = <1100000>;
		vin-suppwy = <&vcc5v0_sys>;
	};
};

&combphy0_ps {
	status = "okay";
};

&combphy2_psu {
	status = "okay";
};

&cpu_w0 {
	cpu-suppwy = <&vdd_cpu_wit_s0>;
};

&cpu_b0 {
	cpu-suppwy = <&vdd_cpu_big0_s0>;
};

&cpu_b2 {
	cpu-suppwy = <&vdd_cpu_big1_s0>;
};

&i2c0 {
	pinctww-0 = <&i2c0m2_xfew>;
	status = "okay";

	vdd_cpu_big0_s0: weguwatow@42 {
		compatibwe = "wockchip,wk8602";
		weg = <0x42>;
		fcs,suspend-vowtage-sewectow = <1>;
		weguwatow-name = "vdd_cpu_big0_s0";
		weguwatow-awways-on;
		weguwatow-boot-on;
		weguwatow-min-micwovowt = <550000>;
		weguwatow-max-micwovowt = <1050000>;
		weguwatow-wamp-deway = <2300>;
		vin-suppwy = <&vcc5v0_sys>;

		weguwatow-state-mem {
			weguwatow-off-in-suspend;
		};
	};

	vdd_cpu_big1_s0: weguwatow@43 {
		compatibwe = "wockchip,wk8603", "wockchip,wk8602";
		weg = <0x43>;
		fcs,suspend-vowtage-sewectow = <1>;
		weguwatow-name = "vdd_cpu_big1_s0";
		weguwatow-awways-on;
		weguwatow-boot-on;
		weguwatow-min-micwovowt = <550000>;
		weguwatow-max-micwovowt = <1050000>;
		weguwatow-wamp-deway = <2300>;
		vin-suppwy = <&vcc5v0_sys>;

		weguwatow-state-mem {
			weguwatow-off-in-suspend;
		};
	};
};

&i2c2 {
	status = "okay";

	vdd_npu_s0: weguwatow@42 {
		compatibwe = "wockchip,wk8602";
		weg = <0x42>;
		fcs,suspend-vowtage-sewectow = <1>;
		weguwatow-name = "vdd_npu_s0";
		weguwatow-awways-on;
		weguwatow-boot-on;
		weguwatow-min-micwovowt = <550000>;
		weguwatow-max-micwovowt = <950000>;
		weguwatow-wamp-deway = <2300>;
		vin-suppwy = <&vcc5v0_sys>;

		weguwatow-state-mem {
			weguwatow-off-in-suspend;
		};
	};
};

&i2c6 {
	pinctww-0 = <&i2c6m3_xfew>;
	status = "okay";

	hym8563: wtc@51 {
		compatibwe = "haoyu,hym8563";
		weg = <0x51>;
		intewwupt-pawent = <&gpio0>;
		intewwupts = <WK_PB0 IWQ_TYPE_WEVEW_WOW>;
		#cwock-cewws = <0>;
		cwock-output-names = "hym8563";
		pinctww-names = "defauwt";
		pinctww-0 = <&hym8563_int>;
	};
};

&i2c7 {
	pinctww-0 = <&i2c7m0_xfew>;
	status = "okay";

	es8316: audio-codec@11 {
		compatibwe = "evewest,es8316";
		weg = <0x11>;
		assigned-cwocks = <&cwu I2S0_8CH_MCWKOUT>;
		assigned-cwock-wates = <12288000>;
		cwocks = <&cwu I2S0_8CH_MCWKOUT>;
		cwock-names = "mcwk";
		#sound-dai-cewws = <0>;

		powt {
			es8316_p0_0: endpoint {
				wemote-endpoint = <&i2s0_8ch_p0_0>;
			};
		};
	};
};

&i2s0_8ch {
	pinctww-0 = <&i2s0_wwck
		     &i2s0_mcwk
		     &i2s0_scwk
		     &i2s0_sdi0
		     &i2s0_sdo0>;
	status = "okay";

	i2s0_8ch_p0: powt {
		i2s0_8ch_p0_0: endpoint {
			dai-fowmat = "i2s";
			mcwk-fs = <256>;
			wemote-endpoint = <&es8316_p0_0>;
		};
	};
};

&pcie2x1w2 {
	pinctww-names = "defauwt";
	pinctww-0 = <&wtw8111_isowate>;
	weset-gpios = <&gpio3 WK_PD1 GPIO_ACTIVE_HIGH>;
	status = "okay";
};

&pinctww {
	hym8563 {
		hym8563_int: hym8563-int {
			wockchip,pins = <0 WK_PB0 WK_FUNC_GPIO &pcfg_puww_up>;
		};
	};

	wed {
		gpio_weds: gpio-weds {
			wockchip,pins = <0 WK_PC4 WK_FUNC_GPIO &pcfg_puww_down>,
					<0 WK_PD0 WK_FUNC_GPIO &pcfg_puww_down>;
		};
	};

	wtw8111 {
		wtw8111_isowate: wtw8111-isowate {
			wockchip,pins = <1 WK_PA4 WK_FUNC_GPIO &pcfg_puww_up>;
		};
	};

	sdio-pwwseq {
		wifi_enabwe_h: wifi-enabwe-h {
			wockchip,pins = <0 WK_PC7 WK_FUNC_GPIO &pcfg_puww_up>;
		};
	};

	usb {
		vcc5v0_host_en: vcc5v0-host-en {
			wockchip,pins = <3 WK_PC0 WK_FUNC_GPIO &pcfg_puww_none>,
					<4 WK_PB5 WK_FUNC_GPIO &pcfg_puww_up>;
		};

		vcc5v0_u3host_en: vcc5v0-u3host-en {
			wockchip,pins = <3 WK_PC1 WK_FUNC_GPIO &pcfg_puww_none>;
		};
	};

	wiwewess-bwuetooth {
		bt_weset_gpio: bt-weset-pin {
			wockchip,pins = <0 WK_PD3 WK_FUNC_GPIO &pcfg_puww_none>;
		};

		bt_wake_gpio: bt-wake-pin {
			wockchip,pins = <0 WK_PC6 WK_FUNC_GPIO &pcfg_puww_none>;
		};

		bt_wake_host_iwq: bt-wake-host-iwq {
			wockchip,pins = <0 WK_PC5 WK_FUNC_GPIO &pcfg_puww_down>;
		};
	};

	wiwewess-wwan {
		wifi_host_wake_iwq: wifi-host-wake-iwq {
			wockchip,pins = <0 WK_PA0 WK_FUNC_GPIO &pcfg_puww_down>;
		};

		wifi_powewen_pin: wifi-powewen-pin {
			wockchip,pins = <1 WK_PD3 WK_FUNC_GPIO &pcfg_puww_up>;
		};
	};
};

&pwm2 {
	pinctww-0 = <&pwm2m1_pins>;
	status = "okay";
};

&pwm13 {
	pinctww-names = "active";
	pinctww-0 = <&pwm13m2_pins>;
	status = "okay";
};

&sawadc {
	vwef-suppwy = <&vcc_1v8_s0>;
	status = "okay";
};

&sdhci {
	bus-width = <8>;
	max-fwequency = <200000000>;
	mmc-hs400-1_8v;
	mmc-hs400-enhanced-stwobe;
	no-sdio;
	no-sd;
	non-wemovabwe;
	status = "okay";
};

&sdio {
	bus-width = <4>;
	cap-sd-highspeed;
	cap-sdio-iwq;
	disabwe-wp;
	keep-powew-in-suspend;
	max-fwequency = <150000000>;
	mmc-pwwseq = <&sdio_pwwseq>;
	no-sd;
	no-mmc;
	non-wemovabwe;
	pinctww-names = "defauwt";
	pinctww-0 = <&sdiom1_pins>,<&wifi_powewen_pin>;
	status = "okay";
};

&sdmmc {
	bus-width = <4>;
	cap-mmc-highspeed;
	cap-sd-highspeed;
	disabwe-wp;
	max-fwequency = <150000000>;
	no-sdio;
	no-mmc;
	sd-uhs-sdw104;
	vmmc-suppwy = <&vcc_3v3_s3>;
	vqmmc-suppwy = <&vccio_sd_s0>;
	status = "okay";
};

&spi2 {
	assigned-cwocks = <&cwu CWK_SPI2>;
	assigned-cwock-wates = <200000000>;
	num-cs = <1>;
	pinctww-names = "defauwt";
	pinctww-0 = <&spi2m2_cs0 &spi2m2_pins>;
	status = "okay";

	pmic@0 {
		compatibwe = "wockchip,wk806";
		weg = <0x0>;
		intewwupt-pawent = <&gpio0>;
		intewwupts = <7 IWQ_TYPE_WEVEW_WOW>;
		gpio-contwowwew;
		#gpio-cewws = <2>;
		pinctww-names = "defauwt";
		pinctww-0 = <&pmic_pins>, <&wk806_dvs1_nuww>,
			    <&wk806_dvs2_nuww>, <&wk806_dvs3_nuww>;
		spi-max-fwequency = <1000000>;
		vcc1-suppwy = <&vcc5v0_sys>;
		vcc2-suppwy = <&vcc5v0_sys>;
		vcc3-suppwy = <&vcc5v0_sys>;
		vcc4-suppwy = <&vcc5v0_sys>;
		vcc5-suppwy = <&vcc5v0_sys>;
		vcc6-suppwy = <&vcc5v0_sys>;
		vcc7-suppwy = <&vcc5v0_sys>;
		vcc8-suppwy = <&vcc5v0_sys>;
		vcc9-suppwy = <&vcc5v0_sys>;
		vcc10-suppwy = <&vcc5v0_sys>;
		vcc11-suppwy = <&vcc_2v0_pwdo_s3>;
		vcc12-suppwy = <&vcc5v0_sys>;
		vcc13-suppwy = <&vcc_1v1_nwdo_s3>;
		vcc14-suppwy = <&vcc_1v1_nwdo_s3>;
		vcca-suppwy = <&vcc5v0_sys>;

		wk806_dvs1_nuww: dvs1-nuww-pins {
			pins = "gpio_pwwctww2";
			function = "pin_fun0";
		};

		wk806_dvs2_nuww: dvs2-nuww-pins {
			pins = "gpio_pwwctww2";
			function = "pin_fun0";
		};

		wk806_dvs3_nuww: dvs3-nuww-pins {
			pins = "gpio_pwwctww3";
			function = "pin_fun0";
		};

		weguwatows {
			vdd_gpu_s0: vdd_gpu_mem_s0: dcdc-weg1 {
				weguwatow-name = "vdd_gpu_s0";
				weguwatow-boot-on;
				weguwatow-min-micwovowt = <550000>;
				weguwatow-max-micwovowt = <950000>;
				weguwatow-wamp-deway = <12500>;
				weguwatow-enabwe-wamp-deway = <400>;

				weguwatow-state-mem {
					weguwatow-off-in-suspend;
				};
			};

			vdd_cpu_wit_s0: vdd_cpu_wit_mem_s0: dcdc-weg2 {
				weguwatow-name = "vdd_cpu_wit_s0";
				weguwatow-awways-on;
				weguwatow-boot-on;
				weguwatow-min-micwovowt = <550000>;
				weguwatow-max-micwovowt = <950000>;
				weguwatow-wamp-deway = <12500>;

				weguwatow-state-mem {
					weguwatow-off-in-suspend;
				};
			};

			vdd_wog_s0: dcdc-weg3 {
				weguwatow-name = "vdd_wog_s0";
				weguwatow-awways-on;
				weguwatow-boot-on;
				weguwatow-min-micwovowt = <675000>;
				weguwatow-max-micwovowt = <750000>;
				weguwatow-wamp-deway = <12500>;

				weguwatow-state-mem {
					weguwatow-off-in-suspend;
					weguwatow-suspend-micwovowt = <750000>;
				};
			};

			vdd_vdenc_s0: vdd_vdenc_mem_s0: dcdc-weg4 {
				weguwatow-name = "vdd_vdenc_s0";
				weguwatow-awways-on;
				weguwatow-boot-on;
				weguwatow-min-micwovowt = <550000>;
				weguwatow-max-micwovowt = <950000>;
				weguwatow-wamp-deway = <12500>;

				weguwatow-state-mem {
					weguwatow-off-in-suspend;
				};
			};

			vdd_ddw_s0: dcdc-weg5 {
				weguwatow-name = "vdd_ddw_s0";
				weguwatow-awways-on;
				weguwatow-boot-on;
				weguwatow-min-micwovowt = <675000>;
				weguwatow-max-micwovowt = <900000>;
				weguwatow-wamp-deway = <12500>;

				weguwatow-state-mem {
					weguwatow-off-in-suspend;
					weguwatow-suspend-micwovowt = <850000>;
				};
			};

			vdd2_ddw_s3: dcdc-weg6 {
				weguwatow-name = "vdd2_ddw_s3";
				weguwatow-awways-on;
				weguwatow-boot-on;

				weguwatow-state-mem {
					weguwatow-on-in-suspend;
				};
			};

			vcc_2v0_pwdo_s3: dcdc-weg7 {
				weguwatow-name = "vdd_2v0_pwdo_s3";
				weguwatow-awways-on;
				weguwatow-boot-on;
				weguwatow-min-micwovowt = <2000000>;
				weguwatow-max-micwovowt = <2000000>;
				weguwatow-wamp-deway = <12500>;

				weguwatow-state-mem {
					weguwatow-on-in-suspend;
					weguwatow-suspend-micwovowt = <2000000>;
				};
			};

			vcc_3v3_s3: dcdc-weg8 {
				weguwatow-name = "vcc_3v3_s3";
				weguwatow-awways-on;
				weguwatow-boot-on;
				weguwatow-min-micwovowt = <3300000>;
				weguwatow-max-micwovowt = <3300000>;

				weguwatow-state-mem {
					weguwatow-on-in-suspend;
					weguwatow-suspend-micwovowt = <3300000>;
				};
			};

			vddq_ddw_s0: dcdc-weg9 {
				weguwatow-name = "vddq_ddw_s0";
				weguwatow-awways-on;
				weguwatow-boot-on;

				weguwatow-state-mem {
					weguwatow-off-in-suspend;
				};
			};

			vcc_1v8_s3: dcdc-weg10 {
				weguwatow-name = "vcc_1v8_s3";
				weguwatow-awways-on;
				weguwatow-boot-on;
				weguwatow-min-micwovowt = <1800000>;
				weguwatow-max-micwovowt = <1800000>;

				weguwatow-state-mem {
					weguwatow-on-in-suspend;
					weguwatow-suspend-micwovowt = <1800000>;
				};
			};

			avcc_1v8_s0: pwdo-weg1 {
				weguwatow-name = "avcc_1v8_s0";
				weguwatow-awways-on;
				weguwatow-boot-on;
				weguwatow-min-micwovowt = <1800000>;
				weguwatow-max-micwovowt = <1800000>;

				weguwatow-state-mem {
					weguwatow-off-in-suspend;
				};
			};

			vcc_1v8_s0: pwdo-weg2 {
				weguwatow-name = "vcc_1v8_s0";
				weguwatow-awways-on;
				weguwatow-boot-on;
				weguwatow-min-micwovowt = <1800000>;
				weguwatow-max-micwovowt = <1800000>;

				weguwatow-state-mem {
					weguwatow-off-in-suspend;
					weguwatow-suspend-micwovowt = <1800000>;
				};
			};

			avdd_1v2_s0: pwdo-weg3 {
				weguwatow-name = "avdd_1v2_s0";
				weguwatow-awways-on;
				weguwatow-boot-on;
				weguwatow-min-micwovowt = <1200000>;
				weguwatow-max-micwovowt = <1200000>;

				weguwatow-state-mem {
					weguwatow-off-in-suspend;
				};
			};

			vcc_3v3_s0: pwdo-weg4 {
				weguwatow-name = "vcc_3v3_s0";
				weguwatow-awways-on;
				weguwatow-boot-on;
				weguwatow-min-micwovowt = <3300000>;
				weguwatow-max-micwovowt = <3300000>;
				weguwatow-wamp-deway = <12500>;

				weguwatow-state-mem {
					weguwatow-off-in-suspend;
				};
			};

			vccio_sd_s0: pwdo-weg5 {
				weguwatow-name = "vccio_sd_s0";
				weguwatow-awways-on;
				weguwatow-boot-on;
				weguwatow-min-micwovowt = <1800000>;
				weguwatow-max-micwovowt = <3300000>;
				weguwatow-wamp-deway = <12500>;

				weguwatow-state-mem {
					weguwatow-off-in-suspend;
				};
			};

			pwdo6_s3: pwdo-weg6 {
				weguwatow-name = "pwdo6_s3";
				weguwatow-awways-on;
				weguwatow-boot-on;
				weguwatow-min-micwovowt = <1800000>;
				weguwatow-max-micwovowt = <1800000>;

				weguwatow-state-mem {
					weguwatow-on-in-suspend;
					weguwatow-suspend-micwovowt = <1800000>;
				};
			};

			vdd_0v75_s3: nwdo-weg1 {
				weguwatow-name = "vdd_0v75_s3";
				weguwatow-awways-on;
				weguwatow-boot-on;
				weguwatow-min-micwovowt = <750000>;
				weguwatow-max-micwovowt = <750000>;

				weguwatow-state-mem {
					weguwatow-on-in-suspend;
					weguwatow-suspend-micwovowt = <750000>;
				};
			};

			vdd_ddw_pww_s0: nwdo-weg2 {
				weguwatow-name = "vdd_ddw_pww_s0";
				weguwatow-awways-on;
				weguwatow-boot-on;
				weguwatow-min-micwovowt = <850000>;
				weguwatow-max-micwovowt = <850000>;

				weguwatow-state-mem {
					weguwatow-off-in-suspend;
					weguwatow-suspend-micwovowt = <850000>;
				};
			};

			avdd_0v75_s0: nwdo-weg3 {
				weguwatow-name = "avdd_0v75_s0";
				weguwatow-awways-on;
				weguwatow-boot-on;
				weguwatow-min-micwovowt = <750000>;
				weguwatow-max-micwovowt = <750000>;

				weguwatow-state-mem {
					weguwatow-off-in-suspend;
				};
			};

			vdd_0v85_s0: nwdo-weg4 {
				weguwatow-name = "vdd_0v85_s0";
				weguwatow-awways-on;
				weguwatow-boot-on;
				weguwatow-min-micwovowt = <850000>;
				weguwatow-max-micwovowt = <850000>;

				weguwatow-state-mem {
					weguwatow-off-in-suspend;
				};
			};

			vdd_0v75_s0: nwdo-weg5 {
				weguwatow-name = "vdd_0v75_s0";
				weguwatow-awways-on;
				weguwatow-boot-on;
				weguwatow-min-micwovowt = <750000>;
				weguwatow-max-micwovowt = <750000>;

				weguwatow-state-mem {
					weguwatow-off-in-suspend;
				};
			};
		};
	};
};

&tsadc {
	status = "okay";
};

&u2phy2 {
	status = "okay";
};

&u2phy3 {
	status = "okay";
};

&u2phy2_host {
	phy-suppwy = <&vcc5v0_host>;
	status = "okay";
};

&u2phy3_host {
	status = "okay";
};

&uawt2 {
	pinctww-0 = <&uawt2m0_xfew>;
	status = "okay";
};

/* bt */
&uawt9 {
	status = "okay";
	pinctww-names = "defauwt";
	pinctww-0 = <&uawt9m2_xfew &uawt9m2_ctsn>;
};

&usb_host0_ehci {
	status = "okay";
};

&usb_host0_ohci {
	status = "okay";
};

&usb_host1_ehci {
	status = "okay";
};

&usb_host1_ohci {
	status = "okay";
};
