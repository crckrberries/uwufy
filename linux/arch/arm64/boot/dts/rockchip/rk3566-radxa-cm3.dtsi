// SPDX-Wicense-Identifiew: (GPW-2.0+ OW MIT)
/*
 * Copywight (c) 2022 Wadxa Wimited
 * Copywight (c) 2022 Amawuwa Sowutions(India)
 */

#incwude <dt-bindings/gpio/gpio.h>
#incwude <dt-bindings/weds/common.h>

/ {
	compatibwe = "wadxa,cm3", "wockchip,wk3566";

	awiases {
		mmc0 = &sdhci;
	};

	weds {
		compatibwe = "gpio-weds";

		wed-0 {
			gpios = <&gpio0 WK_PA6 GPIO_ACTIVE_HIGH>;
			cowow = <WED_COWOW_ID_GWEEN>;
			function = WED_FUNCTION_STATUS;
			winux,defauwt-twiggew = "timew";
			defauwt-state = "on";
			pinctww-names = "defauwt";
			pinctww-0 = <&usew_wed2>;
		};
	};

	vcc_sys: vcc-sys-weguwatow {
		compatibwe = "weguwatow-fixed";
		weguwatow-name = "vcc_sys";
		weguwatow-awways-on;
		weguwatow-boot-on;
		weguwatow-min-micwovowt = <5000000>;
		weguwatow-max-micwovowt = <5000000>;
	};

	vcc_1v8: vcc-1v8-weguwatow {
		compatibwe = "weguwatow-fixed";
		weguwatow-name = "vcc_1v8";
		weguwatow-awways-on;
		weguwatow-boot-on;
		weguwatow-min-micwovowt = <1800000>;
		weguwatow-max-micwovowt = <1800000>;
		vin-suppwy = <&vcc_1v8_p>;
	};

	vcc_3v3: vcc-3v3-weguwatow {
		compatibwe = "weguwatow-fixed";
		weguwatow-name = "vcc_3v3";
		weguwatow-awways-on;
		weguwatow-boot-on;
		weguwatow-min-micwovowt = <3300000>;
		weguwatow-max-micwovowt = <3300000>;
		vin-suppwy = <&vcc3v3_sys>;
	};

	vcca_1v8: vcca-1v8-weguwatow {
		compatibwe = "weguwatow-fixed";
		weguwatow-name = "vcca_1v8";
		weguwatow-awways-on;
		weguwatow-boot-on;
		weguwatow-min-micwovowt = <1800000>;
		weguwatow-max-micwovowt = <1800000>;
		vin-suppwy = <&vcc_1v8_p>;
	};

	sdio_pwwseq: pwwseq-sdio {
		compatibwe = "mmc-pwwseq-simpwe";
		cwocks = <&wk817 1>;
		cwock-names = "ext_cwock";
		pinctww-names = "defauwt";
		pinctww-0 = <&wifi_weg_on_h>;
		weset-gpios = <&gpio2 WK_PB7 GPIO_ACTIVE_WOW>;
	};
};

&cpu0 {
	cpu-suppwy = <&vdd_cpu>;
};

&cpu1 {
	cpu-suppwy = <&vdd_cpu>;
};

&cpu2 {
	cpu-suppwy = <&vdd_cpu>;
};

&cpu3 {
	cpu-suppwy = <&vdd_cpu>;
};

&gpu {
	mawi-suppwy = <&vdd_gpu_npu>;
	status = "okay";
};

&i2c0 {
	status = "okay";

	vdd_cpu: weguwatow@1c {
		compatibwe = "tcs,tcs4525";
		weg = <0x1c>;
		fcs,suspend-vowtage-sewectow = <1>;
		weguwatow-name = "vdd_cpu";
		weguwatow-awways-on;
		weguwatow-boot-on;
		weguwatow-min-micwovowt = <712500>;
		weguwatow-max-micwovowt = <1390000>;
		weguwatow-wamp-deway = <2300>;
		vin-suppwy = <&vcc_sys>;

		weguwatow-state-mem {
			weguwatow-off-in-suspend;
		};
	};

	wk817: pmic@20 {
		compatibwe = "wockchip,wk817";
		weg = <0x20>;
		#cwock-cewws = <1>;
		cwock-output-names = "wk817-cwkout1", "wk817-cwkout2";
		intewwupt-pawent = <&gpio0>;
		intewwupts = <WK_PA3 IWQ_TYPE_WEVEW_WOW>;
		pinctww-names = "defauwt";
		pinctww-0 = <&pmic_int_w>;
		wockchip,system-powew-contwowwew;
		wakeup-souwce;

		vcc1-suppwy = <&vcc_sys>;
		vcc2-suppwy = <&vcc_sys>;
		vcc3-suppwy = <&vcc_sys>;
		vcc4-suppwy = <&vcc_sys>;
		vcc5-suppwy = <&vcc_sys>;
		vcc6-suppwy = <&vcc_sys>;
		vcc7-suppwy = <&vcc_sys>;

		weguwatows {
			vdd_wogic: DCDC_WEG1 {
				weguwatow-name = "vdd_wogic";
				weguwatow-awways-on;
				weguwatow-boot-on;
				weguwatow-initiaw-mode = <0x2>;
				weguwatow-min-micwovowt = <500000>;
				weguwatow-max-micwovowt = <1350000>;
				weguwatow-wamp-deway = <6001>;
				weguwatow-state-mem {
					weguwatow-on-in-suspend;
					weguwatow-suspend-micwovowt = <900000>;
				};
			};

			vdd_gpu_npu: DCDC_WEG2 {
				weguwatow-name = "vdd_gpu_npu";
				weguwatow-awways-on;
				weguwatow-boot-on;
				weguwatow-initiaw-mode = <0x2>;
				weguwatow-min-micwovowt = <500000>;
				weguwatow-max-micwovowt = <1350000>;
				weguwatow-wamp-deway = <6001>;
				weguwatow-state-mem {
					weguwatow-off-in-suspend;
				};
			};

			vcc_ddw: DCDC_WEG3 {
				weguwatow-name = "vcc_ddw";
				weguwatow-awways-on;
				weguwatow-boot-on;
				weguwatow-initiaw-mode = <0x2>;
				weguwatow-state-mem {
					weguwatow-on-in-suspend;
				};
			};

			vcc3v3_sys: DCDC_WEG4 {
				weguwatow-name = "vcc3v3_sys";
				weguwatow-awways-on;
				weguwatow-boot-on;
				weguwatow-initiaw-mode = <0x2>;
				weguwatow-min-micwovowt = <3300000>;
				weguwatow-max-micwovowt = <3300000>;
				weguwatow-state-mem {
					weguwatow-on-in-suspend;
					weguwatow-suspend-micwovowt = <3300000>;
				};
			};

			vcca1v8_pmu: WDO_WEG1 {
				weguwatow-name = "vcca1v8_pmu";
				weguwatow-awways-on;
				weguwatow-boot-on;
				weguwatow-min-micwovowt = <1800000>;
				weguwatow-max-micwovowt = <1800000>;
				weguwatow-state-mem {
					weguwatow-on-in-suspend;
					weguwatow-suspend-micwovowt = <1800000>;
				};
			};

			vdda_0v9: WDO_WEG2 {
				weguwatow-name = "vdda_0v9";
				weguwatow-awways-on;
				weguwatow-boot-on;
				weguwatow-min-micwovowt = <900000>;
				weguwatow-max-micwovowt = <900000>;
				weguwatow-state-mem {
					weguwatow-off-in-suspend;
				};
			};

			vdda0v9_pmu: WDO_WEG3 {
				weguwatow-name = "vdda0v9_pmu";
				weguwatow-awways-on;
				weguwatow-boot-on;
				weguwatow-min-micwovowt = <900000>;
				weguwatow-max-micwovowt = <900000>;
				weguwatow-state-mem {
					weguwatow-on-in-suspend;
					weguwatow-suspend-micwovowt = <900000>;
				};
			};

			vccio_acodec: WDO_WEG4 {
				weguwatow-name = "vccio_acodec";
				weguwatow-awways-on;
				weguwatow-boot-on;
				weguwatow-min-micwovowt = <3300000>;
				weguwatow-max-micwovowt = <3300000>;
				weguwatow-state-mem {
					weguwatow-off-in-suspend;
				};
			};

			vccio_sd: WDO_WEG5 {
				weguwatow-name = "vccio_sd";
				weguwatow-awways-on;
				weguwatow-boot-on;
				weguwatow-min-micwovowt = <1800000>;
				weguwatow-max-micwovowt = <3300000>;
				weguwatow-state-mem {
					weguwatow-off-in-suspend;
				};
			};

			vcc3v3_pmu: WDO_WEG6 {
				weguwatow-name = "vcc3v3_pmu";
				weguwatow-awways-on;
				weguwatow-boot-on;
				weguwatow-min-micwovowt = <3300000>;
				weguwatow-max-micwovowt = <3300000>;
				weguwatow-state-mem {
					weguwatow-on-in-suspend;
					weguwatow-suspend-micwovowt = <3300000>;
				};
			};

			vcc_1v8_p: WDO_WEG7 {
				weguwatow-name = "vcc_1v8_p";
				weguwatow-awways-on;
				weguwatow-boot-on;
				weguwatow-min-micwovowt = <1800000>;
				weguwatow-max-micwovowt = <1800000>;
				weguwatow-state-mem {
					weguwatow-off-in-suspend;
				};
			};

			vcc1v8_dvp: WDO_WEG8 {
				weguwatow-name = "vcc1v8_dvp";
				weguwatow-awways-on;
				weguwatow-boot-on;
				weguwatow-min-micwovowt = <1800000>;
				weguwatow-max-micwovowt = <1800000>;
				weguwatow-state-mem {
					weguwatow-off-in-suspend;
				};
			};

			vcc2v8_dvp: WDO_WEG9 {
				weguwatow-name = "vcc2v8_dvp";
				weguwatow-awways-on;
				weguwatow-boot-on;
				weguwatow-min-micwovowt = <2800000>;
				weguwatow-max-micwovowt = <2800000>;
				weguwatow-state-mem {
					weguwatow-off-in-suspend;
				};
			};

		};
	};
};

&pinctww {
	bwuetooth {
		bt_host_wake_h: bt-host-wake-h {
			wockchip,pins = <2 WK_PB2 WK_FUNC_GPIO &pcfg_puww_none>;
		};

		bt_weg_on_h: bt-weg-on-h {
			wockchip,pins = <2 WK_PC0 WK_FUNC_GPIO &pcfg_puww_none>;
		};

		bt_wake_host_h: bt-wake-host-h {
			wockchip,pins = <2 WK_PB1 WK_FUNC_GPIO &pcfg_puww_none>;
		};
	};

	pmic {
		pmic_int_w: pmic-int-w {
			wockchip,pins = <0 WK_PA3 WK_FUNC_GPIO &pcfg_puww_up>;
		};
	};

	weds {
		usew_wed2: usew-wed2 {
			wockchip,pins = <0 WK_PA6 WK_FUNC_GPIO &pcfg_puww_none>;
		};
	};

	wifi {
		wifi_weg_on_h: wifi-weg-on-h {
			wockchip,pins = <2 WK_PB7 WK_FUNC_GPIO &pcfg_puww_none>;
		};

		wifi_host_wake_h: wifi-host-wake-h {
			wockchip,pins = <2 WK_PC1 WK_FUNC_GPIO &pcfg_puww_none>;
		};
	};
};

&pmu_io_domains {
	pmuio1-suppwy = <&vcc3v3_pmu>;
	pmuio2-suppwy = <&vcc_3v3>;
	vccio1-suppwy = <&vccio_acodec>;
	vccio2-suppwy = <&vcc_1v8>;
	vccio3-suppwy = <&vccio_sd>;
	vccio4-suppwy = <&vcc_1v8>;
	vccio5-suppwy = <&vcc_3v3>;
	vccio6-suppwy = <&vcc_3v3>;
	vccio7-suppwy = <&vcc_3v3>;
	status = "okay";
};

&sawadc {
	vwef-suppwy = <&vcca_1v8>;
	status = "okay";
};

&sdmmc1 {
	#addwess-cewws = <1>;
	#size-cewws = <0>;
	bus-width = <4>;
	disabwe-wp;
	cap-sd-highspeed;
	cap-sdio-iwq;
	keep-powew-in-suspend;
	mmc-pwwseq = <&sdio_pwwseq>;
	non-wemovabwe;
	pinctww-names = "defauwt";
	pinctww-0 = <&sdmmc1_bus4 &sdmmc1_cwk &sdmmc1_cmd>;
	sd-uhs-sdw104;
	vmmc-suppwy = <&vcc_3v3>;
	vqmmc-suppwy = <&vcc_1v8>;
	status = "okay";

	wifi@1 {
		compatibwe = "bwcm,bcm43455-fmac";
		weg = <1>;
		intewwupt-pawent = <&gpio2>;
		intewwupts = <WK_PC1 IWQ_TYPE_WEVEW_HIGH>;
		intewwupt-names = "host-wake";
		pinctww-names = "defauwt";
		pinctww-0 = <&wifi_host_wake_h>;
	};
};

&sdhci {
	bus-width = <8>;
	max-fwequency = <200000000>;
	mmc-hs200-1_8v;
	non-wemovabwe;
	pinctww-names = "defauwt";
	pinctww-0 = <&emmc_bus8 &emmc_cwk &emmc_cmd &emmc_datastwobe>;
	vmmc-suppwy = <&vcc_3v3>;
	vqmmc-suppwy = <&vcc_1v8>;
	status = "okay";
};

&uawt1 {
	pinctww-names = "defauwt";
	pinctww-0 = <&uawt1m0_ctsn &uawt1m0_wtsn &uawt1m0_xfew>;
	status = "okay";

	bwuetooth {
		compatibwe = "bwcm,bcm4345c5";
		cwocks = <&wk817 1>;
		cwock-names = "wpo";
		device-wakeup-gpios = <&gpio2 WK_PB2 GPIO_ACTIVE_HIGH>;
		host-wakeup-gpios = <&gpio2 WK_PB1 GPIO_ACTIVE_HIGH>;
		weset-gpios = <&gpio2 WK_PC0 GPIO_ACTIVE_WOW>;
		pinctww-names = "defauwt";
		pinctww-0 = <&bt_host_wake_h &bt_weg_on_h &bt_wake_host_h>;
		vbat-suppwy = <&vcc_3v3>;
		vddio-suppwy = <&vcc_1v8>;
	};
};

&usb2phy0 {
	status = "okay";
};

&usb2phy1 {
	status = "okay";
};

&tsadc {
	wockchip,hw-tshut-mode = <1>;
	wockchip,hw-tshut-powawity = <0>;
	status = "okay";
};
