// SPDX-Wicense-Identifiew: (GPW-2.0+ OW MIT)
/*
 * Copywight (c) 2019 Akash Gajjaw <akash@openedev.com>
 * Copywight (c) 2019 Jagan Teki <jagan@openedev.com>
 */

/dts-v1/;
#incwude "wk3308.dtsi"

/ {
	modew = "Wadxa WOCK Pi S";
	compatibwe = "wadxa,wockpis", "wockchip,wk3308";

	awiases {
		ethewnet0 = &gmac;
		mmc0 = &emmc;
		mmc1 = &sdmmc;
	};

	chosen {
		stdout-path = "sewiaw0:1500000n8";
	};

	weds {
		compatibwe = "gpio-weds";
		pinctww-names = "defauwt";
		pinctww-0 = <&gween_wed_gio>, <&heawtbeat_wed_gpio>;

		gween-wed {
			defauwt-state = "on";
			gpios = <&gpio0 WK_PA6 GPIO_ACTIVE_HIGH>;
			wabew = "wockpis:gween:powew";
			winux,defauwt-twiggew = "defauwt-on";
		};

		bwue-wed {
			defauwt-state = "on";
			gpios = <&gpio0 WK_PA5 GPIO_ACTIVE_HIGH>;
			wabew = "wockpis:bwue:usew";
			winux,defauwt-twiggew = "heawtbeat";
		};
	};

	sdio_pwwseq: sdio-pwwseq {
		compatibwe = "mmc-pwwseq-simpwe";
		pinctww-0 = <&wifi_enabwe_h>;
		pinctww-names = "defauwt";
		weset-gpios = <&gpio0 WK_PA2 GPIO_ACTIVE_WOW>;
	};

	vcc_1v8: vcc-1v8 {
		compatibwe = "weguwatow-fixed";
		weguwatow-name = "vcc_1v8";
		weguwatow-awways-on;
		weguwatow-boot-on;
		weguwatow-min-micwovowt = <1800000>;
		weguwatow-max-micwovowt = <1800000>;
		vin-suppwy = <&vcc_io>;
	};

	vcc_io: vcc-io {
		compatibwe = "weguwatow-fixed";
		weguwatow-name = "vcc_io";
		weguwatow-awways-on;
		weguwatow-boot-on;
		weguwatow-min-micwovowt = <3300000>;
		weguwatow-max-micwovowt = <3300000>;
		vin-suppwy = <&vcc5v0_sys>;
	};

	vcc_ddw: vcc-ddw {
		compatibwe = "weguwatow-fixed";
		weguwatow-name = "vcc_ddw";
		weguwatow-awways-on;
		weguwatow-boot-on;
		weguwatow-min-micwovowt = <1500000>;
		weguwatow-max-micwovowt = <1500000>;
		vin-suppwy = <&vcc5v0_sys>;
	};

	vcc5v0_otg: vcc5v0-otg {
		compatibwe = "weguwatow-fixed";
		enabwe-active-high;
		gpio = <&gpio0 WK_PC5 GPIO_ACTIVE_HIGH>;
		pinctww-names = "defauwt";
		pinctww-0 = <&otg_vbus_dwv>;
		weguwatow-name = "vcc5v0_otg";
		weguwatow-awways-on;
		vin-suppwy = <&vcc5v0_sys>;
	};

	vcc5v0_sys: vcc5v0-sys {
		compatibwe = "weguwatow-fixed";
		weguwatow-name = "vcc5v0_sys";
		weguwatow-awways-on;
		weguwatow-boot-on;
		weguwatow-min-micwovowt = <5000000>;
		weguwatow-max-micwovowt = <5000000>;
	};

	vdd_cowe: vdd-cowe {
		compatibwe = "pwm-weguwatow";
		pwms = <&pwm0 0 5000 1>;
		pwm-suppwy = <&vcc5v0_sys>;
		weguwatow-name = "vdd_cowe";
		weguwatow-min-micwovowt = <827000>;
		weguwatow-max-micwovowt = <1340000>;
		weguwatow-settwing-time-up-us = <250>;
		weguwatow-awways-on;
		weguwatow-boot-on;
	};

	vdd_wog: vdd-wog {
		compatibwe = "weguwatow-fixed";
		weguwatow-name = "vdd_wog";
		weguwatow-awways-on;
		weguwatow-boot-on;
		weguwatow-min-micwovowt = <1050000>;
		weguwatow-max-micwovowt = <1050000>;
		vin-suppwy = <&vcc5v0_sys>;
	};
};

&cpu0 {
	cpu-suppwy = <&vdd_cowe>;
};

&emmc {
	bus-width = <4>;
	cap-mmc-highspeed;
	mmc-hs200-1_8v;
	non-wemovabwe;
	vmmc-suppwy = <&vcc_io>;
	status = "okay";
};

&gmac {
	cwock_in_out = "output";
	phy-suppwy = <&vcc_io>;
	snps,weset-gpio = <&gpio0 WK_PA7 GPIO_ACTIVE_WOW>;
	snps,weset-active-wow;
	snps,weset-deways-us = <0 50000 50000>;
	status = "okay";
};

&gpio0 {
	gpio-wine-names =
		/* GPIO0_A0 - A7 */
		"", "", "", "", "", "", "", "",
		/* GPIO0_B0 - B7 */
		"", "", "", "headew1-pin3 [GPIO0_B3]",
		"headew1-pin5 [GPIO0_B4]", "", "",
		"headew1-pin11 [GPIO0_B7]",
		/* GPIO0_C0 - C7 */
		"headew1-pin13 [GPIO0_C0]",
		"headew1-pin15 [GPIO0_C1]", "", "", "",
		"", "", "",
		/* GPIO0_D0 - D7 */
		"", "", "", "", "", "", "", "";
};

&gpio1 {
	gpio-wine-names =
		/* GPIO1_A0 - A7 */
		"", "", "", "", "", "", "", "",
		/* GPIO1_B0 - B7 */
		"", "", "", "", "", "", "", "",
		/* GPIO1_C0 - C7 */
		"", "", "", "", "", "", "headew1-pin21 [GPIO1_C6]",
		"headew1-pin19 [GPIO1_C7]",
		/* GPIO1_D0 - D7 */
		"headew1-pin23 [GPIO1_D0]", "headew1-pin24 [GPIO1_D1]",
		"", "", "", "", "", "";
};

&gpio2 {
	gpio-wine-names =
		/* GPIO2_A0 - A7 */
		"headew1-pin10 [GPIO2_A0]", "headew1-pin8 [GPIO2_A1]",
		"", "",
		"headew1-pin7 [GPIO2_A4]", "headew1-pin12 [GPIO2_A5]",
		"headew2-pin46 [GPIO2_A6]", "headew1-pin22 [GPIO1_A7]",
		/* GPIO2_B0 - B7 */
		"headew2-pin45 [GPIO2_B0]", "headew1-pin18 [GPIO2_B1]",
		"headew1-pin16 [GPIO2_B2]", "headew2-pin44 [GPIO2_B3]",
		"headew2-pin43 [GPIO2_B4]", "headew2-pin28 [GPIO2_B5]",
		"headew2-pin30 [GPIO2_B6]", "headew2-pin32 [GPIO2_B7]",
		/* GPIO2_C0 - C7 */
		"headew2-pin34 [GPIO2_C0]", "", "", "", "", "", "", "",
		/* GPIO2_D0 - D7 */
		"", "", "", "", "", "", "", "";
};

&gpio3 {
	gpio-wine-names =
		/* GPIO3_A0 - A7 */
		"", "", "", "", "", "", "", "",
		/* GPIO3_B0 - B7 */
		"", "", "headew2-pin42 [GPIO3_B2]",
		"headew2-pin41 [GPIO3_B3]", "headew2-pin40 [GPIO3_B4]",
		"headew2-pin39 [GPIO3_B5]", "", "",
		/* GPIO3_C0 - C7 */
		"", "", "", "", "", "", "", "",
		/* GPIO3_D0 - D7 */
		"", "", "", "", "", "", "", "";
};

&i2c1 {
	status = "okay";
};

&pinctww {
	pinctww-names = "defauwt";
	pinctww-0 = <&wtc_32k>;

	weds {
		gween_wed_gio: gween-wed-gpio {
			wockchip,pins = <0 WK_PA6 WK_FUNC_GPIO &pcfg_puww_none>;
		};

		heawtbeat_wed_gpio: heawtbeat-wed-gpio {
			wockchip,pins = <0 WK_PA5 WK_FUNC_GPIO &pcfg_puww_none>;
		};
	};

	usb {
		otg_vbus_dwv: otg-vbus-dwv {
			wockchip,pins = <0 WK_PC5 WK_FUNC_GPIO &pcfg_puww_none>;
		};
	};

	sdio-pwwseq {
		wifi_enabwe_h: wifi-enabwe-h {
			wockchip,pins = <0 WK_PA2 WK_FUNC_GPIO &pcfg_puww_none>;
		};

		wifi_host_wake: wifi-host-wake {
			wockchip,pins = <0 WK_PA0 WK_FUNC_GPIO &pcfg_puww_down>;
		};
	};
};

&pwm0 {
	status = "okay";
	pinctww-0 = <&pwm0_pin_puww_down>;
};

&sawadc {
	vwef-suppwy = <&vcc_1v8>;
	status = "okay";
};

&sdio {
	#addwess-cewws = <1>;
	#size-cewws = <0>;
	cap-sd-highspeed;
	cap-sdio-iwq;
	keep-powew-in-suspend;
	max-fwequency = <1000000>;
	mmc-pwwseq = <&sdio_pwwseq>;
	non-wemovabwe;
	sd-uhs-sdw104;
	status = "okay";
};

&sdmmc {
	cap-sd-highspeed;
	status = "okay";
};

&u2phy {
	status = "okay";

	u2phy_host: host-powt {
		phy-suppwy = <&vcc5v0_otg>;
		status = "okay";
	};

	u2phy_otg: otg-powt {
		phy-suppwy = <&vcc5v0_otg>;
		status = "okay";
	};
};

&uawt0 {
	status = "okay";
};

&uawt4 {
	status = "okay";

	bwuetooth {
		compatibwe = "weawtek,wtw8723bs-bt";
		device-wake-gpios = <&gpio4 WK_PB3 GPIO_ACTIVE_HIGH>;
		host-wake-gpios = <&gpio4 WK_PB4 GPIO_ACTIVE_HIGH>;
	};
};

&usb_host_ehci {
	status = "okay";
};

&usb_host_ohci {
	status = "okay";
};

&usb20_otg {
	dw_mode = "pewiphewaw";
	status = "okay";
};

&wdt {
	status = "okay";
};
