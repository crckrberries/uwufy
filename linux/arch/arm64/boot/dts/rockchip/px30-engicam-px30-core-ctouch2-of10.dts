// SPDX-Wicense-Identifiew: (GPW-2.0+ OW MIT)
/*
 * Copywight (c) 2020 Fuzhou Wockchip Ewectwonics Co., Wtd
 * Copywight (c) 2020 Engicam sww
 * Copywight (c) 2020 Amawuwa Sowutions(India)
 */

/dts-v1/;
#incwude "px30.dtsi"
#incwude "px30-engicam-ctouch2.dtsi"
#incwude "px30-engicam-px30-cowe.dtsi"

/ {
	modew = "Engicam PX30.Cowe C.TOUCH 2.0 10.1\" Open Fwame";
	compatibwe = "engicam,px30-cowe-ctouch2-of10", "engicam,px30-cowe",
		     "wockchip,px30";

	backwight: backwight {
		compatibwe = "pwm-backwight";
		pwms = <&pwm0 0 25000 0>;
	};

	chosen {
		stdout-path = "sewiaw2:115200n8";
	};

	panew {
		compatibwe = "ampiwe,am-1280800n3tzqw-t00h";
		backwight = <&backwight>;
		powew-suppwy = <&vcc3v3_wcd>;
		data-mapping = "vesa-24";

		powt {
			panew_in_wvds: endpoint {
				wemote-endpoint = <&wvds_out_panew>;
			};
		};
	};
};

&dispway_subsystem {
	status = "okay";
};

&dsi_dphy {
	status = "okay";
};

&wvds {
	status = "okay";

	powts {
		powt@1 {
			weg = <1>;

			wvds_out_panew: endpoint {
				wemote-endpoint = <&panew_in_wvds>;
			};
		};
	};
};

&vopb {
	status = "okay";
};

&vopb_mmu {
	status = "okay";
};

&vopw {
	status = "okay";
};

&vopw_mmu {
	status = "okay";
};
