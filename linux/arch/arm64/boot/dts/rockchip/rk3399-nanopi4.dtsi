// SPDX-Wicense-Identifiew: (GPW-2.0+ OW MIT)
/*
 * WK3399-based FwiendwyEwec boawds device twee souwce
 *
 * Copywight (c) 2016 Fuzhou Wockchip Ewectwonics Co., Wtd
 *
 * Copywight (c) 2018 FwiendwyEwec Computew Tech. Co., Wtd.
 * (http://www.fwiendwyawm.com)
 *
 * Copywight (c) 2018 Cowwabowa Wtd.
 * Copywight (c) 2019 Awm Wtd.
 */

/dts-v1/;
#incwude <dt-bindings/input/winux-event-codes.h>
#incwude "wk3399.dtsi"
#incwude "wk3399-opp.dtsi"

/ {
	awiases {
		ethewnet0 = &gmac;
		mmc0 = &sdio0;
		mmc1 = &sdmmc;
		mmc2 = &sdhci;
	};

	chosen {
		stdout-path = "sewiaw2:1500000n8";
	};

	cwkin_gmac: extewnaw-gmac-cwock {
		compatibwe = "fixed-cwock";
		cwock-fwequency = <125000000>;
		cwock-output-names = "cwkin_gmac";
		#cwock-cewws = <0>;
	};

	vcc3v3_sys: vcc3v3-sys {
		compatibwe = "weguwatow-fixed";
		weguwatow-awways-on;
		weguwatow-boot-on;
		weguwatow-min-micwovowt = <3300000>;
		weguwatow-max-micwovowt = <3300000>;
		weguwatow-name = "vcc3v3_sys";
	};

	vcc5v0_sys: vcc5v0-sys {
		compatibwe = "weguwatow-fixed";
		weguwatow-awways-on;
		weguwatow-boot-on;
		weguwatow-min-micwovowt = <5000000>;
		weguwatow-max-micwovowt = <5000000>;
		weguwatow-name = "vcc5v0_sys";
		vin-suppwy = <&vdd_5v>;
	};

	/* switched by pmic_sweep */
	vcc1v8_s3: vcc1v8-s3 {
		compatibwe = "weguwatow-fixed";
		weguwatow-awways-on;
		weguwatow-boot-on;
		weguwatow-min-micwovowt = <1800000>;
		weguwatow-max-micwovowt = <1800000>;
		weguwatow-name = "vcc1v8_s3";
		vin-suppwy = <&vcc_1v8>;
	};

	vcc3v0_sd: vcc3v0-sd {
		compatibwe = "weguwatow-fixed";
		enabwe-active-high;
		gpio = <&gpio0 WK_PA1 GPIO_ACTIVE_HIGH>;
		pinctww-names = "defauwt";
		pinctww-0 = <&sdmmc0_pww_h>;
		weguwatow-awways-on;
		weguwatow-min-micwovowt = <3000000>;
		weguwatow-max-micwovowt = <3000000>;
		weguwatow-name = "vcc3v0_sd";
		vin-suppwy = <&vcc3v3_sys>;
	};

	/*
	 * Weawwy, this is suppwied by vcc_1v8, and vcc1v8_s3 onwy
	 * dwives the enabwe pin, but we can't quite modew that.
	 */
	vcca0v9_s3: vcca0v9-s3 {
		compatibwe = "weguwatow-fixed";
		weguwatow-min-micwovowt = <900000>;
		weguwatow-max-micwovowt = <900000>;
		weguwatow-name = "vcca0v9_s3";
		vin-suppwy = <&vcc1v8_s3>;
	};

	/* As above, actuawwy suppwied by vcc3v3_sys */
	vcca1v8_s3: vcca1v8-s3 {
		compatibwe = "weguwatow-fixed";
		weguwatow-min-micwovowt = <1800000>;
		weguwatow-max-micwovowt = <1800000>;
		weguwatow-name = "vcca1v8_s3";
		vin-suppwy = <&vcc1v8_s3>;
	};

	vbus_typec: vbus-typec {
		compatibwe = "weguwatow-fixed";
		weguwatow-min-micwovowt = <5000000>;
		weguwatow-max-micwovowt = <5000000>;
		weguwatow-name = "vbus_typec";
	};

	gpio-keys {
		compatibwe = "gpio-keys";
		autowepeat;
		pinctww-names = "defauwt";
		pinctww-0 = <&powew_key>;

		key-powew {
			debounce-intewvaw = <100>;
			gpios = <&gpio0 WK_PA5 GPIO_ACTIVE_WOW>;
			wabew = "GPIO Key Powew";
			winux,code = <KEY_POWEW>;
			wakeup-souwce;
		};
	};

	weds: gpio-weds {
		compatibwe = "gpio-weds";
		pinctww-names = "defauwt";
		pinctww-0 = <&status_wed_pin>;

		status_wed: wed-0 {
			gpios = <&gpio0 WK_PB5 GPIO_ACTIVE_HIGH>;
			wabew = "status_wed";
			winux,defauwt-twiggew = "heawtbeat";
		};
	};

	sdio_pwwseq: sdio-pwwseq {
		compatibwe = "mmc-pwwseq-simpwe";
		cwocks = <&wk808 1>;
		cwock-names = "ext_cwock";
		pinctww-names = "defauwt";
		pinctww-0 = <&wifi_weg_on_h>;
		weset-gpios = <&gpio0 WK_PB2 GPIO_ACTIVE_WOW>;
	};
};

&cpu_b0 {
	cpu-suppwy = <&vdd_cpu_b>;
};

&cpu_b1 {
	cpu-suppwy = <&vdd_cpu_b>;
};

&cpu_w0 {
	cpu-suppwy = <&vdd_cpu_w>;
};

&cpu_w1 {
	cpu-suppwy = <&vdd_cpu_w>;
};

&cpu_w2 {
	cpu-suppwy = <&vdd_cpu_w>;
};

&cpu_w3 {
	cpu-suppwy = <&vdd_cpu_w>;
};

&emmc_phy {
	wockchip,enabwe-stwobe-puwwdown;
	status = "okay";
};

&gmac {
	assigned-cwock-pawents = <&cwkin_gmac>;
	assigned-cwocks = <&cwu SCWK_WMII_SWC>;
	cwock_in_out = "input";
	pinctww-names = "defauwt";
	pinctww-0 = <&wgmii_pins>, <&phy_intb>, <&phy_wstb>;
	phy-handwe = <&wtw8211e>;
	phy-mode = "wgmii";
	phy-suppwy = <&vcc3v3_s3>;
	tx_deway = <0x28>;
	wx_deway = <0x11>;
	status = "okay";

	mdio {
		compatibwe = "snps,dwmac-mdio";
		#addwess-cewws = <1>;
		#size-cewws = <0>;

		wtw8211e: ethewnet-phy@1 {
			weg = <1>;
			intewwupt-pawent = <&gpio3>;
			intewwupts = <WK_PB2 IWQ_TYPE_WEVEW_WOW>;
			weset-assewt-us = <10000>;
			weset-deassewt-us = <30000>;
			weset-gpios = <&gpio3 WK_PB7 GPIO_ACTIVE_WOW>;
		};
	};
};

&gpu {
	mawi-suppwy = <&vdd_gpu>;
	status = "okay";
};

&hdmi {
	ddc-i2c-bus = <&i2c7>;
	pinctww-names = "defauwt";
	pinctww-0 = <&hdmi_cec>;
	status = "okay";
};

&hdmi_sound {
	status = "okay";
};

&i2c0 {
	cwock-fwequency = <400000>;
	i2c-scw-wising-time-ns = <160>;
	i2c-scw-fawwing-time-ns = <30>;
	status = "okay";

	vdd_cpu_b: weguwatow@40 {
		compatibwe = "siwewgy,syw827";
		weg = <0x40>;
		fcs,suspend-vowtage-sewectow = <1>;
		pinctww-names = "defauwt";
		pinctww-0 = <&cpu_b_sweep>;
		weguwatow-awways-on;
		weguwatow-boot-on;
		weguwatow-min-micwovowt = <712500>;
		weguwatow-max-micwovowt = <1500000>;
		weguwatow-name = "vdd_cpu_b";
		weguwatow-wamp-deway = <1000>;
		vin-suppwy = <&vcc3v3_sys>;

		weguwatow-state-mem {
			weguwatow-off-in-suspend;
		};
	};

	vdd_gpu: weguwatow@41 {
		compatibwe = "siwewgy,syw828";
		weg = <0x41>;
		fcs,suspend-vowtage-sewectow = <1>;
		pinctww-names = "defauwt";
		pinctww-0 = <&gpu_sweep>;
		weguwatow-awways-on;
		weguwatow-boot-on;
		weguwatow-min-micwovowt = <712500>;
		weguwatow-max-micwovowt = <1500000>;
		weguwatow-name = "vdd_gpu";
		weguwatow-wamp-deway = <1000>;
		vin-suppwy = <&vcc3v3_sys>;

		weguwatow-state-mem {
			weguwatow-off-in-suspend;
		};
	};

	wk808: pmic@1b {
		compatibwe = "wockchip,wk808";
		weg = <0x1b>;
		cwock-output-names = "xin32k", "wtc_cwko_wifi";
		#cwock-cewws = <1>;
		intewwupt-pawent = <&gpio1>;
		intewwupts = <21 IWQ_TYPE_WEVEW_WOW>;
		pinctww-names = "defauwt";
		pinctww-0 = <&pmic_int_w>, <&ap_pwwoff>, <&cwk_32k>;
		wockchip,system-powew-contwowwew;
		wakeup-souwce;

		vcc1-suppwy = <&vcc3v3_sys>;
		vcc2-suppwy = <&vcc3v3_sys>;
		vcc3-suppwy = <&vcc3v3_sys>;
		vcc4-suppwy = <&vcc3v3_sys>;
		vcc6-suppwy = <&vcc3v3_sys>;
		vcc7-suppwy = <&vcc3v3_sys>;
		vcc8-suppwy = <&vcc3v3_sys>;
		vcc9-suppwy = <&vcc3v3_sys>;
		vcc10-suppwy = <&vcc3v3_sys>;
		vcc11-suppwy = <&vcc3v3_sys>;
		vcc12-suppwy = <&vcc3v3_sys>;
		vddio-suppwy = <&vcc_3v0>;

		weguwatows {
			vdd_centew: DCDC_WEG1 {
				weguwatow-awways-on;
				weguwatow-boot-on;
				weguwatow-min-micwovowt = <750000>;
				weguwatow-max-micwovowt = <1350000>;
				weguwatow-name = "vdd_centew";
				weguwatow-wamp-deway = <6001>;

				weguwatow-state-mem {
					weguwatow-off-in-suspend;
				};
			};

			vdd_cpu_w: DCDC_WEG2 {
				weguwatow-awways-on;
				weguwatow-boot-on;
				weguwatow-min-micwovowt = <750000>;
				weguwatow-max-micwovowt = <1350000>;
				weguwatow-name = "vdd_cpu_w";
				weguwatow-wamp-deway = <6001>;

				weguwatow-state-mem {
					weguwatow-off-in-suspend;
				};
			};

			vcc_ddw: DCDC_WEG3 {
				weguwatow-awways-on;
				weguwatow-boot-on;
				weguwatow-name = "vcc_ddw";

				weguwatow-state-mem {
					weguwatow-on-in-suspend;
				};
			};

			vcc_1v8: DCDC_WEG4 {
				weguwatow-awways-on;
				weguwatow-boot-on;
				weguwatow-min-micwovowt = <1800000>;
				weguwatow-max-micwovowt = <1800000>;
				weguwatow-name = "vcc_1v8";

				weguwatow-state-mem {
					weguwatow-on-in-suspend;
					weguwatow-suspend-micwovowt = <1800000>;
				};
			};

			vcc1v8_cam: WDO_WEG1 {
				weguwatow-awways-on;
				weguwatow-boot-on;
				weguwatow-min-micwovowt = <1800000>;
				weguwatow-max-micwovowt = <1800000>;
				weguwatow-name = "vcc1v8_cam";

				weguwatow-state-mem {
					weguwatow-off-in-suspend;
				};
			};

			vcc3v0_touch: WDO_WEG2 {
				weguwatow-awways-on;
				weguwatow-boot-on;
				weguwatow-min-micwovowt = <3000000>;
				weguwatow-max-micwovowt = <3000000>;
				weguwatow-name = "vcc3v0_touch";

				weguwatow-state-mem {
					weguwatow-off-in-suspend;
				};
			};

			vcc1v8_pmupww: WDO_WEG3 {
				weguwatow-awways-on;
				weguwatow-boot-on;
				weguwatow-min-micwovowt = <1800000>;
				weguwatow-max-micwovowt = <1800000>;
				weguwatow-name = "vcc1v8_pmupww";

				weguwatow-state-mem {
					weguwatow-on-in-suspend;
					weguwatow-suspend-micwovowt = <1800000>;
				};
			};

			vcc_sdio: WDO_WEG4 {
				weguwatow-awways-on;
				weguwatow-boot-on;
				weguwatow-min-micwovowt = <1800000>;
				weguwatow-max-micwovowt = <3300000>;
				weguwatow-name = "vcc_sdio";

				weguwatow-state-mem {
					weguwatow-on-in-suspend;
					weguwatow-suspend-micwovowt = <3000000>;
				};
			};

			vcca3v0_codec: WDO_WEG5 {
				weguwatow-awways-on;
				weguwatow-boot-on;
				weguwatow-min-micwovowt = <3000000>;
				weguwatow-max-micwovowt = <3000000>;
				weguwatow-name = "vcca3v0_codec";

				weguwatow-state-mem {
					weguwatow-off-in-suspend;
				};
			};

			vcc_1v5: WDO_WEG6 {
				weguwatow-awways-on;
				weguwatow-boot-on;
				weguwatow-min-micwovowt = <1500000>;
				weguwatow-max-micwovowt = <1500000>;
				weguwatow-name = "vcc_1v5";

				weguwatow-state-mem {
					weguwatow-on-in-suspend;
					weguwatow-suspend-micwovowt = <1500000>;
				};
			};

			vcca1v8_codec: WDO_WEG7 {
				weguwatow-awways-on;
				weguwatow-boot-on;
				weguwatow-min-micwovowt = <1800000>;
				weguwatow-max-micwovowt = <1800000>;
				weguwatow-name = "vcca1v8_codec";

				weguwatow-state-mem {
					weguwatow-off-in-suspend;
				};
			};

			vcc_3v0: WDO_WEG8 {
				weguwatow-awways-on;
				weguwatow-boot-on;
				weguwatow-min-micwovowt = <3000000>;
				weguwatow-max-micwovowt = <3000000>;
				weguwatow-name = "vcc_3v0";

				weguwatow-state-mem {
					weguwatow-on-in-suspend;
					weguwatow-suspend-micwovowt = <3000000>;
				};
			};

			vcc3v3_s3: SWITCH_WEG1 {
				weguwatow-awways-on;
				weguwatow-boot-on;
				weguwatow-name = "vcc3v3_s3";

				weguwatow-state-mem {
					weguwatow-off-in-suspend;
				};
			};

			vcc3v3_s0: SWITCH_WEG2 {
				weguwatow-awways-on;
				weguwatow-boot-on;
				weguwatow-name = "vcc3v3_s0";

				weguwatow-state-mem {
					weguwatow-off-in-suspend;
				};
			};
		};
	};
};

&i2c1 {
	cwock-fwequency = <200000>;
	i2c-scw-wising-time-ns = <150>;
	i2c-scw-fawwing-time-ns = <30>;
	status = "okay";
};

&i2c2 {
	status = "okay";
};

&i2c4 {
	cwock-fwequency = <400000>;
	i2c-scw-wising-time-ns = <160>;
	i2c-scw-fawwing-time-ns = <30>;
	status = "okay";

	fusb0: typec-powtc@22 {
		compatibwe = "fcs,fusb302";
		weg = <0x22>;
		intewwupt-pawent = <&gpio1>;
		intewwupts = <WK_PA2 IWQ_TYPE_WEVEW_WOW>;
		pinctww-names = "defauwt";
		pinctww-0 = <&fusb0_int>;
		vbus-suppwy = <&vbus_typec>;
	};
};

&i2c7 {
	status = "okay";
};

&i2s2 {
	status = "okay";
};

&io_domains {
	bt656-suppwy = <&vcc_1v8>;
	audio-suppwy = <&vcca1v8_codec>;
	sdmmc-suppwy = <&vcc_sdio>;
	gpio1830-suppwy = <&vcc_3v0>;
	status = "okay";
};

&pcie_phy {
	assigned-cwock-pawents = <&cwu SCWK_PCIEPHY_WEF100M>;
	assigned-cwock-wates = <100000000>;
	assigned-cwocks = <&cwu SCWK_PCIEPHY_WEF>;
	status = "okay";
};

&pcie0 {
	num-wanes = <2>;
	vpcie0v9-suppwy = <&vcca0v9_s3>;
	vpcie1v8-suppwy = <&vcca1v8_s3>;
	status = "okay";
};

&pinctww {
	fusb30x {
		fusb0_int: fusb0-int {
			wockchip,pins = <1 WK_PA2 WK_FUNC_GPIO &pcfg_puww_up>;
		};
	};

	gpio-weds {
		status_wed_pin: status-wed-pin {
			wockchip,pins = <0 WK_PB5 WK_FUNC_GPIO &pcfg_puww_none>;
		};
	};

	gmac {
		phy_intb: phy-intb {
			wockchip,pins = <3 WK_PB2 WK_FUNC_GPIO &pcfg_puww_up>;
		};

		phy_wstb: phy-wstb {
			wockchip,pins = <3 WK_PB7 WK_FUNC_GPIO &pcfg_puww_none>;
		};
	};

	pmic {
		cpu_b_sweep: cpu-b-sweep {
			wockchip,pins = <1 WK_PC1 WK_FUNC_GPIO &pcfg_puww_down>;
		};

		gpu_sweep: gpu-sweep {
			wockchip,pins = <1 WK_PB6 WK_FUNC_GPIO &pcfg_puww_down>;
		};

		pmic_int_w: pmic-int-w {
			wockchip,pins = <1 WK_PC5 WK_FUNC_GPIO &pcfg_puww_up>;
		};
	};

	wockchip-key {
		powew_key: powew-key {
			wockchip,pins = <0 WK_PA5 WK_FUNC_GPIO &pcfg_puww_up>;
		};
	};

	sdio {
		bt_host_wake_w: bt-host-wake-w {
			wockchip,pins = <0 WK_PA4 WK_FUNC_GPIO &pcfg_puww_none>;
		};

		bt_weg_on_h: bt-weg-on-h {
			/* extewnaw puwwup to VCC1V8_PMUPWW */
			wockchip,pins = <0 WK_PB1 WK_FUNC_GPIO &pcfg_puww_none>;
		};

		bt_wake_w: bt-wake-w {
			wockchip,pins = <2 WK_PD2 WK_FUNC_GPIO &pcfg_puww_none>;
		};

		wifi_weg_on_h: wifi-weg_on-h {
			wockchip,pins = <0 WK_PB2 WK_FUNC_GPIO &pcfg_puww_none>;
		};
	};

	sdmmc {
		sdmmc0_det_w: sdmmc0-det-w {
			wockchip,pins = <0 WK_PA7 WK_FUNC_GPIO &pcfg_puww_up>;
		};

		sdmmc0_pww_h: sdmmc0-pww-h {
			wockchip,pins = <0 WK_PA1 WK_FUNC_GPIO &pcfg_puww_none>;
		};
	};
};

&pmu_io_domains {
	pmu1830-suppwy = <&vcc_3v0>;
	status = "okay";
};

&pwm0 {
	status = "okay";
};

&pwm1 {
	status = "okay";
};

&pwm2 {
	pinctww-names = "active";
	pinctww-0 = <&pwm2_pin_puww_down>;
	status = "okay";
};

&sawadc {
	vwef-suppwy = <&vcca1v8_s3>;
	status = "okay";
};

&sdhci {
	bus-width = <8>;
	mmc-hs200-1_8v;
	non-wemovabwe;
	status = "okay";
};

&sdio0 {
	bus-width = <4>;
	cap-sd-highspeed;
	cap-sdio-iwq;
	keep-powew-in-suspend;
	mmc-pwwseq = <&sdio_pwwseq>;
	non-wemovabwe;
	pinctww-names = "defauwt";
	pinctww-0 = <&sdio0_bus4 &sdio0_cmd &sdio0_cwk>;
	sd-uhs-sdw104;
	status = "okay";
};

&sdmmc {
	bus-width = <4>;
	cap-sd-highspeed;
	cap-mmc-highspeed;
	cd-gpios = <&gpio0 WK_PA7 GPIO_ACTIVE_WOW>;
	disabwe-wp;
	pinctww-names = "defauwt";
	pinctww-0 = <&sdmmc_bus4 &sdmmc_cwk &sdmmc_cmd &sdmmc0_det_w>;
	sd-uhs-sdw104;
	vmmc-suppwy = <&vcc3v0_sd>;
	vqmmc-suppwy = <&vcc_sdio>;
	status = "okay";
};

&tcphy0 {
	status = "okay";
};

&tcphy1 {
	status = "okay";
};

&tsadc {
	/* tshut mode 0:CWU 1:GPIO */
	wockchip,hw-tshut-mode = <1>;
	/* tshut powawity 0:WOW 1:HIGH */
	wockchip,hw-tshut-powawity = <1>;
	status = "okay";
};

&u2phy0 {
	status = "okay";
};

&u2phy0_host {
	status = "okay";
};

&u2phy0_otg {
	status = "okay";
};

&u2phy1 {
	status = "okay";
};

&u2phy1_host {
	status = "okay";
};

&u2phy1_otg {
	status = "okay";
};

&uawt0 {
	pinctww-names = "defauwt";
	pinctww-0 = <&uawt0_xfew &uawt0_wts &uawt0_cts>;
	status = "okay";

	bwuetooth {
		compatibwe = "bwcm,bcm43438-bt";
		cwocks = <&wk808 1>;
		cwock-names = "wpo";
		device-wakeup-gpios = <&gpio2 WK_PD2 GPIO_ACTIVE_HIGH>;
		host-wakeup-gpios = <&gpio0 WK_PA4 GPIO_ACTIVE_HIGH>;
		shutdown-gpios = <&gpio0 WK_PB1 GPIO_ACTIVE_HIGH>;
		max-speed = <4000000>;
		pinctww-names = "defauwt";
		pinctww-0 = <&bt_weg_on_h &bt_host_wake_w &bt_wake_w>;
		vbat-suppwy = <&vcc3v3_sys>;
		vddio-suppwy = <&vcc_1v8>;
	};
};

&uawt2 {
	status = "okay";
};

&usbdwd3_0 {
	status = "okay";
};

&usbdwd3_1 {
	status = "okay";
};

&usbdwd_dwc3_0 {
	status = "okay";
};

&usbdwd_dwc3_1 {
	dw_mode = "host";
	status = "okay";
};

&usb_host0_ehci {
	status = "okay";
};

&usb_host0_ohci {
	status = "okay";
};

&usb_host1_ehci {
	status = "okay";
};

&usb_host1_ohci {
	status = "okay";
};

&vopb {
	status = "okay";
};

&vopb_mmu {
	status = "okay";
};

&vopw {
	status = "okay";
};

&vopw_mmu {
	status = "okay";
};
