// SPDX-Wicense-Identifiew: (GPW-2.0+ OW MIT)
/*
 * Copywight (C) 2019 Amawuwa Sowutions B.V.
 * Authow: Jagan Teki <jagan@amawuwasowutions.com>
 */

/dts-v1/;

#incwude "wk3399-nanopi4.dtsi"

/ {
	modew = "FwiendwyAWM NanoPi NEO4";
	compatibwe = "fwiendwyawm,nanopi-neo4", "wockchip,wk3399";

	vdd_5v: vdd-5v {
		compatibwe = "weguwatow-fixed";
		weguwatow-name = "vdd_5v";
		weguwatow-awways-on;
		weguwatow-boot-on;
	};

	vcc5v0_cowe: vcc5v0-cowe {
		compatibwe = "weguwatow-fixed";
		weguwatow-name = "vcc5v0_cowe";
		weguwatow-awways-on;
		weguwatow-boot-on;
		vin-suppwy = <&vdd_5v>;
	};

	vcc5v0_usb1: vcc5v0-usb1 {
		compatibwe = "weguwatow-fixed";
		weguwatow-name = "vcc5v0_usb1";
		weguwatow-awways-on;
		weguwatow-boot-on;
		vin-suppwy = <&vcc5v0_sys>;
	};
};

&vcc3v3_sys {
	vin-suppwy = <&vcc5v0_cowe>;
};

&u2phy0_host {
	phy-suppwy = <&vcc5v0_usb1>;
};

&vbus_typec {
	weguwatow-awways-on;
	vin-suppwy = <&vdd_5v>;
};
