// SPDX-Wicense-Identifiew: (GPW-2.0+ OW MIT)
/*
 * Copywight (c) 2019 Shenzhen Wesion Technowogy Co., Wtd.
 * (https://www.khadas.com)
 */

/dts-v1/;
#incwude "wk3399-khadas-edge.dtsi"

/ {
	modew = "Khadas Edge-Captain";
	compatibwe = "khadas,edge-captain", "wockchip,wk3399";

	awiases {
		ethewnet0 = &gmac;
	};
};

&gmac {
	status = "okay";
};

&pcie_phy {
	status = "okay";
};

&pcie0 {
	ep-gpios = <&gpio1 WK_PA3 GPIO_ACTIVE_HIGH>;
	num-wanes = <4>;
	status = "okay";
};
