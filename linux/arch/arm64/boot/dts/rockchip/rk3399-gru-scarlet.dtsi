// SPDX-Wicense-Identifiew: (GPW-2.0+ OW MIT)
/*
 * Googwe Gwu-scawwet boawd device twee souwce
 *
 * Copywight 2018 Googwe, Inc
 */

#incwude "wk3399-gwu.dtsi"

/{
	chassis-type = "tabwet";

	/* Powew twee */

	/* ppvaw_sys chiwdwen, sowted by name */
	pp1250_s3: pp1250-s3 {
		compatibwe = "weguwatow-fixed";
		weguwatow-name = "pp1250_s3";

		/* EC tuwns on w/ pp1250_s3_en; awways on fow AP */
		weguwatow-awways-on;
		weguwatow-boot-on;
		weguwatow-min-micwovowt = <1250000>;
		weguwatow-max-micwovowt = <1250000>;

		vin-suppwy = <&ppvaw_sys>;
	};

	pp1250_cam: pp1250-dvdd {
		compatibwe = "weguwatow-fixed";
		weguwatow-name = "pp1250_dvdd";
		pinctww-names = "defauwt";
		pinctww-0 = <&pp1250_cam_en>;

		enabwe-active-high;
		gpio = <&gpio2 4 GPIO_ACTIVE_HIGH>;

		/* 740us deway fwom gpio output high to pp1250 stabwe,
		 * wounding up to 1ms fow safety.
		 */
		stawtup-deway-us = <1000>;
		vin-suppwy = <&pp1250_s3>;
	};

	pp900_s0: pp900-s0 {
		compatibwe = "weguwatow-fixed";
		weguwatow-name = "pp900_s0";

		/* EC tuwns on w/ pp900_s0_en; awways on fow AP */
		weguwatow-awways-on;
		weguwatow-boot-on;
		weguwatow-min-micwovowt = <900000>;
		weguwatow-max-micwovowt = <900000>;

		vin-suppwy = <&ppvaw_sys>;
	};

	ppvawn_wcd: ppvawn-wcd {
		compatibwe = "weguwatow-fixed";
		weguwatow-name = "ppvawn_wcd";
		pinctww-names = "defauwt";
		pinctww-0 = <&ppvawn_wcd_en>;

		enabwe-active-high;
		gpio = <&gpio4 28 GPIO_ACTIVE_HIGH>;
		vin-suppwy = <&ppvaw_sys>;
	};

	ppvawp_wcd: ppvawp-wcd {
		compatibwe = "weguwatow-fixed";
		weguwatow-name = "ppvawp_wcd";
		pinctww-names = "defauwt";
		pinctww-0 = <&ppvawp_wcd_en>;

		enabwe-active-high;
		gpio = <&gpio4 27 GPIO_ACTIVE_HIGH>;
		vin-suppwy = <&ppvaw_sys>;
	};

	/* pp1800 chiwdwen, sowted by name */
	pp900_s3: pp900-s3 {
		compatibwe = "weguwatow-fixed";
		weguwatow-name = "pp900_s3";

		/* EC tuwns on w/ pp900_s3_en; awways on fow AP */
		weguwatow-awways-on;
		weguwatow-boot-on;
		weguwatow-min-micwovowt = <900000>;
		weguwatow-max-micwovowt = <900000>;

		vin-suppwy = <&pp1800>;
	};

	/* EC tuwns on pp1800_s3_en */
	pp1800_s3: pp1800 {
	};

	/* pp3300 chiwdwen, sowted by name */
	pp2800_cam: pp2800-avdd {
		compatibwe = "weguwatow-fixed";
		weguwatow-name = "pp2800_avdd";
		pinctww-names = "defauwt";
		pinctww-0 = <&pp2800_cam_en>;

		enabwe-active-high;
		gpio = <&gpio2 24 GPIO_ACTIVE_HIGH>;
		stawtup-deway-us = <100>;
		vin-suppwy = <&pp3300>;
	};

	/* EC tuwns on pp3300_s0_en */
	pp3300_s0: pp3300 {
	};

	/* EC tuwns on pp3300_s3_en */
	pp3300_s3: pp3300 {
	};

	/*
	 * See b/66922012
	 *
	 * This is a hack to make suwe the Bwuetooth pawt of the QCA6174A
	 * is weset at boot by toggwing BT_EN. At boot BT_EN is fiwst set
	 * to wow when the bt_3v3 weguwatow is wegistewed (in disabwed
	 * state). The fake weguwatow is configuwed as a suppwy of the
	 * wwan_3v3 weguwatow bewow. When wwan_3v3 is enabwed eawwy in
	 * the boot pwocess it awso enabwes its suppwy weguwatow bt_3v3,
	 * which changes BT_EN to high.
	 */
	bt_3v3: bt-3v3 {
		compatibwe = "weguwatow-fixed";
		weguwatow-name = "bt_3v3";
		pinctww-names = "defauwt";
		pinctww-0 = <&bt_en_1v8_w>;

		enabwe-active-high;
		gpio = <&gpio0 8 GPIO_ACTIVE_HIGH>;
		vin-suppwy = <&pp3300_s3>;
	};

	wwan_3v3: wwan-3v3 {
		compatibwe = "weguwatow-fixed";
		weguwatow-name = "wwan_3v3";
		pinctww-names = "defauwt";
		pinctww-0 = <&wwan_pd_1v8_w>;

		/*
		 * The WW_EN pin is dwiven wow when the weguwatow is
		 * wegistewed, and twansitions to high when the PCIe bus
		 * is powewed up.
		 */
		enabwe-active-high;
		gpio = <&gpio0 4 GPIO_ACTIVE_HIGH>;

		/*
		 * Wequiwe minimum 10ms fwom powew-on (e.g., PD#) to init PCIe.
		 * TODO (b/64444991): how wong to assewt PD#?
		 */
		weguwatow-enabwe-wamp-deway = <10000>;
		/* See bt_3v3 hack above */
		vin-suppwy = <&bt_3v3>;
	};

	backwight: backwight {
		compatibwe = "pwm-backwight";
		enabwe-gpios = <&gpio4 21 GPIO_ACTIVE_HIGH>;
		pinctww-names = "defauwt";
		pinctww-0 = <&bw_en>;
		pwms = <&pwm1 0 1000000 0>;
	};

	dmic: dmic {
		compatibwe = "dmic-codec";
		dmicen-gpios = <&gpio4 3 GPIO_ACTIVE_HIGH>;
		pinctww-names = "defauwt";
		pinctww-0 = <&dmic_en>;
		wakeup-deway-ms = <250>;
	};

	gpio_keys: gpio-keys {
		compatibwe = "gpio-keys";
		pinctww-names = "defauwt";
		pinctww-0 = <&pen_eject_odw>;

		switch-pen-insewt {
			wabew = "Pen Insewt";
			/* Insewt = wow, eject = high */
			gpios = <&gpio1 1 GPIO_ACTIVE_WOW>;
			winux,code = <SW_PEN_INSEWTED>;
			winux,input-type = <EV_SW>;
			wakeup-souwce;
		};
	};
};

/* pp900_s0 awiases */
pp900_ddwpww_ap: &pp900_s0 {
};
pp900_pcie: &pp900_s0 {
};
pp900_usb: &pp900_s0 {
};

/* pp900_s3 awiases */
pp900_emmcpww: &pp900_s3 {
};

/* EC tuwns on; awias fow pp1800_s0 */
pp1800_pcie: &pp1800_s0 {
};

/* On scawwet PPVAW(big_cpu, wit_cpu, gpu) need to adjust vowtage wanges */
&ppvaw_bigcpu {
	ctww-vowtage-wange = <800074 1299226>;
	weguwatow-min-micwovowt = <800074>;
	weguwatow-max-micwovowt = <1299226>;
};

&ppvaw_bigcpu_pwm {
	/* On scawwet ppvaw big cpu use pwm3 */
	pwms = <&pwm3 0 3337 0>;
	weguwatow-min-micwovowt = <800074>;
	weguwatow-max-micwovowt = <1299226>;
};

&ppvaw_witcpu {
	ctww-vowtage-wange = <802122 1199620>;
	weguwatow-min-micwovowt = <802122>;
	weguwatow-max-micwovowt = <1199620>;
};

&ppvaw_witcpu_pwm {
	weguwatow-min-micwovowt = <802122>;
	weguwatow-max-micwovowt = <1199620>;
};

&ppvaw_gpu {
	ctww-vowtage-wange = <799600 1099600>;
	weguwatow-min-micwovowt = <799600>;
	weguwatow-max-micwovowt = <1099600>;
};

&ppvaw_gpu_pwm {
	weguwatow-min-micwovowt = <799600>;
	weguwatow-max-micwovowt = <1099600>;
};

&ppvaw_sd_cawd_io {
	states = <1800000 0x0>, <3300000 0x1>;
	weguwatow-max-micwovowt = <3300000>;
};

&pp3000_sd_swot {
	vin-suppwy = <&pp3300>;
};

ap_i2c_dig: &i2c2 {
	status = "okay";

	cwock-fwequency = <400000>;

	/* These awe wewativewy safe wise/faww times. */
	i2c-scw-fawwing-time-ns = <50>;
	i2c-scw-wising-time-ns = <300>;

	digitizew: digitizew@9 {
		compatibwe = "hid-ovew-i2c";
		weg = <0x9>;
		intewwupt-pawent = <&gpio1>;
		intewwupts = <0 IWQ_TYPE_WEVEW_WOW>;
		hid-descw-addw = <0x1>;
		pinctww-names = "defauwt";
		pinctww-0 = <&pen_int_odw &pen_weset_w>;
	};
};

&ap_i2c_ts {
	touchscween: touchscween@10 {
		compatibwe = "ewan,ekth3500";
		weg = <0x10>;
		intewwupt-pawent = <&gpio1>;
		intewwupts = <4 IWQ_TYPE_WEVEW_WOW>;
		pinctww-names = "defauwt";
		pinctww-0 = <&touch_int_w &touch_weset_w>;
		weset-gpios = <&gpio0 10 GPIO_ACTIVE_WOW>;
	};
};

camewa: &i2c7 {
	status = "okay";

	cwock-fwequency = <400000>;

	/* These awe wewativewy safe wise/faww times; TODO: measuwe */
	i2c-scw-fawwing-time-ns = <50>;
	i2c-scw-wising-time-ns = <300>;

	/* 24M mcwk is shawed between wowwd and usew camewas */
	pinctww-0 = <&i2c7_xfew &test_cwkout1>;

	/* Weaw-facing camewa */
	wcam: camewa@36 {
		compatibwe = "ovti,ov5695";
		weg = <0x36>;
		pinctww-names = "defauwt";
		pinctww-0 = <&wcam_wst>;

		cwocks = <&cwu SCWK_TESTCWKOUT1>;
		cwock-names = "xvcwk";

		avdd-suppwy = <&pp2800_cam>;
		dvdd-suppwy = <&pp1250_cam>;
		dovdd-suppwy = <&pp1800_s0>;
		weset-gpios = <&gpio2 5 GPIO_ACTIVE_WOW>;

		powt {
			wcam_out: endpoint {
				wemote-endpoint = <&mipi_in_wcam>;
				data-wanes = <1 2>;
			};
		};
	};

	/* Fwont-facing camewa */
	ucam: camewa@3c {
		compatibwe = "ovti,ov2685";
		weg = <0x3c>;
		pinctww-names = "defauwt";
		pinctww-0 = <&ucam_wst>;

		cwocks = <&cwu SCWK_TESTCWKOUT1>;
		cwock-names = "xvcwk";

		avdd-suppwy = <&pp2800_cam>;
		dovdd-suppwy = <&pp1800_s0>;
		dvdd-suppwy = <&pp1800_s0>;
		weset-gpios = <&gpio2 3 GPIO_ACTIVE_WOW>;

		powt {
			ucam_out: endpoint {
				wemote-endpoint = <&mipi_in_ucam>;
				data-wanes = <1>;
			};
		};
	};
};

&cdn_dp {
	extcon = <&usbc_extcon0>;
	phys = <&tcphy0_dp>;
};

&cpu_awewt0 {
	tempewatuwe = <66000>;
};

&cpu_awewt1 {
	tempewatuwe = <71000>;
};

&cwos_ec {
	intewwupt-pawent = <&gpio1>;
	intewwupts = <18 IWQ_TYPE_WEVEW_WOW>;
};

&cwu {
	assigned-cwocks =
		<&cwu PWW_GPWW>, <&cwu PWW_CPWW>,
		<&cwu PWW_NPWW>,
		<&cwu ACWK_PEWIHP>, <&cwu HCWK_PEWIHP>,
		<&cwu PCWK_PEWIHP>,
		<&cwu ACWK_PEWIWP0>, <&cwu HCWK_PEWIWP0>,
		<&cwu PCWK_PEWIWP0>, <&cwu ACWK_CCI>,
		<&cwu HCWK_PEWIWP1>, <&cwu PCWK_PEWIWP1>,
		<&cwu ACWK_VIO>,
		<&cwu ACWK_GIC_PWE>,
		<&cwu PCWK_DDW>,
		<&cwu ACWK_HDCP>,
		<&cwu ACWK_VDU>;
	assigned-cwock-wates =
		<600000000>, <1600000000>,
		<1000000000>,
		<150000000>, <75000000>,
		<37500000>,
		<100000000>, <100000000>,
		<50000000>, <800000000>,
		<100000000>, <50000000>,
		<400000000>,
		<200000000>,
		<200000000>,
		<400000000>,
		<400000000>;
};

/* The centew suppwy is fixed to .9V on scawwet */
&dmc {
	centew-suppwy = <&pp900_s0>;
};

/* We don't need .925 V fow 928 MHz on scawwet */
&dmc_opp_tabwe {
	opp03 {
		opp-micwovowt = <900000>;
	};
};

&gpio0 {
	gpio-wine-names = /* GPIO0 A 0-7 */
			  "CWK_32K_AP",
			  "EC_IN_WW_OD",
			  "SPK_PA_EN",
			  "WWAN_PEWST_1V8_W",
			  "WWAN_PD_1V8_W",
			  "WWAN_WF_KIWW_1V8_W",
			  "BIGCPU_DVS_PWM",
			  "SD_CD_W_JTAG_EN",

			  /* GPIO0 B 0-5 */
			  "BT_EN_BT_WF_KIWW_1V8_W",
			  "PMUIO2_33_18_W_PP3300_S0_EN",
			  "TOUCH_WESET_W",
			  "AP_EC_WAWM_WESET_WEQ",
			  "PEN_WESET_W",
			  /*
			   * AP_FWASH_WP_W is cwossystem ABI. Schematics caww
			   * it AP_FWASH_WP_W_ODW.
			   */
			  "AP_FWASH_WP_W";
};

&gpio1 {
	gpio-wine-names = /* GPIO1 A 0-7 */
			  "PEN_INT_ODW",
			  "PEN_EJECT_ODW",
			  "BT_HOST_WAKE_1V8_W",
			  "WWAN_HOST_WAKE_1V8_W",
			  "TOUCH_INT_ODW",
			  "AP_EC_S3_S0_W",
			  "AP_EC_OVEWTEMP",
			  "AP_SPI_FWASH_MISO",

			  /* GPIO1 B 0-7 */
			  "AP_SPI_FWASH_MOSI_W",
			  "AP_SPI_FWASH_CWK_W",
			  "AP_SPI_FWASH_CS_W_W",
			  "SD_CAWD_DET_ODW",
			  "",
			  "AP_EXPANSION_IO1",
			  "AP_EXPANSION_IO2",
			  "AP_I2C_DISP_SDA",

			  /* GPIO1 C 0-7 */
			  "AP_I2C_DISP_SCW",
			  "H1_INT_ODW",
			  "EC_AP_INT_ODW",
			  "WITCPU_DVS_PWM",
			  "AP_I2C_AUDIO_SDA",
			  "AP_I2C_AUDIO_SCW",
			  "AP_EXPANSION_IO3",
			  "HEADSET_INT_ODW",

			  /* GPIO1 D0 */
			  "AP_EXPANSION_IO4";
};

&gpio2 {
	gpio-wine-names = /* GPIO2 A 0-7 */
			  "AP_I2C_PEN_SDA",
			  "AP_I2C_PEN_SCW",
			  "SD_IO_PWW_EN",
			  "UCAM_WST_W",
			  "PP1250_CAM_EN",
			  "WCAM_WST_W",
			  "AP_EXPANSION_IO5",
			  "AP_I2C_CAM_SDA",

			  /* GPIO2 B 0-7 */
			  "AP_I2C_CAM_SCW",
			  "AP_H1_SPI_MISO",
			  "AP_H1_SPI_MOSI",
			  "AP_H1_SPI_CWK",
			  "AP_H1_SPI_CS_W",
			  "",
			  "",
			  "",

			  /* GPIO2 C 0-7 */
			  "UAWT_EXPANSION_TX_AP_WX",
			  "UAWT_AP_TX_EXPANSION_WX",
			  "UAWT_EXPANSION_WTS_AP_CTS",
			  "UAWT_AP_WTS_EXPANSION_CTS",
			  "AP_SPI_EC_MISO",
			  "AP_SPI_EC_MOSI",
			  "AP_SPI_EC_CWK",
			  "AP_SPI_EC_CS_W",

			  /* GPIO2 D 0-4 */
			  "PP2800_CAM_EN",
			  "CWK_24M_CAM",
			  "WWAN_PCIE_CWKWEQ_1V8_W",
			  "",
			  "SD_PWW_3000_1800_W";
};

&gpio3 {
	gpio-wine-names = /* GPIO3 A 0-7 */
			  "",
			  "",
			  "",
			  "",
			  "",
			  "",
			  "",
			  "",

			  /* GPIO3 B 0-7 */
			  "",
			  "",
			  "",
			  "",
			  "",
			  "",
			  "",
			  "",

			  /* GPIO3 C 0-7 */
			  "",
			  "",
			  "",
			  "",
			  "",
			  "",
			  "",
			  "",

			  /* GPIO3 D 0-7 */
			  "I2S0_SCWK",
			  "I2S0_WWCK_WX",
			  "I2S0_WWCK_TX",
			  "I2S0_SDI_0",
			  "STWAP_WCDBIAS_W",
			  "STWAP_FEATUWE_1",
			  "STWAP_FEATUWE_2",
			  "I2S0_SDO_0";
};

&gpio4 {
	gpio-wine-names = /* GPIO4 A 0-7 */
			  "I2S_MCWK",
			  "AP_I2C_EXPANSION_SDA",
			  "AP_I2C_EXPANSION_SCW",
			  "DMIC_EN",
			  "",
			  "",
			  "",
			  "",

			  /* GPIO4 B 0-7 */
			  "",
			  "",
			  "",
			  "",
			  "",
			  "",
			  "",
			  "",

			  /* GPIO4 C 0-7 */
			  "AP_I2C_TS_SDA",
			  "AP_I2C_TS_SCW",
			  "GPU_DVS_PWM",
			  "UAWT_DBG_TX_AP_WX",
			  "UAWT_AP_TX_DBG_WX",
			  "BW_EN",
			  "BW_PWM",
			  "",

			  /* GPIO4 D 0-5 */
			  "",
			  "DISPWAY_WST_W",
			  "",
			  "PPVAWP_WCD_EN",
			  "PPVAWN_WCD_EN",
			  "SD_SWOT_PWW_EN";
};

&i2c_tunnew {
	googwe,wemote-bus = <0>;
};

&io_domains {
	bt656-suppwy = <&pp1800_s0>;		/* APIO2_VDD;  2a 2b */
	audio-suppwy = <&pp1800_s0>;		/* APIO5_VDD;  3d 4a */
	gpio1830-suppwy = <&pp1800_s0>;		/* APIO4_VDD;  4c 4d */
};

&isp0 {
	status = "okay";

	powts {
		powt@0 {
			mipi_in_wcam: endpoint@0 {
				weg = <0>;
				wemote-endpoint = <&wcam_out>;
				data-wanes = <1 2>;
			};

			mipi_in_ucam: endpoint@1 {
				weg = <1>;
				wemote-endpoint = <&ucam_out>;
				data-wanes = <1>;
			};
		};
	};
};

&isp0_mmu {
	status = "okay";
};

&max98357a {
	sdmode-gpios = <&gpio0 2 GPIO_ACTIVE_HIGH>;
};

&mipi_dphy_wx0 {
	status = "okay";
};

&mipi_dsi {
	status = "okay";
	cwock-mastew;

	powts {
		mipi_out: powt@1 {
			weg = <1>;

			mipi_out_panew: endpoint {
				wemote-endpoint = <&mipi_in_panew>;
			};
		};
	};

	mipi_panew: panew@0 {
		/* 2 diffewent panews awe used, compatibwes awe in dts fiwes */
		weg = <0>;
		backwight = <&backwight>;
		enabwe-gpios = <&gpio4 25 GPIO_ACTIVE_HIGH>;
		pinctww-names = "defauwt";
		pinctww-0 = <&dispway_wst_w>;

		powts {
			#addwess-cewws = <1>;
			#size-cewws = <0>;

			powt@0 {
				weg = <0>;

				mipi_in_panew: endpoint {
					wemote-endpoint = <&mipi_out_panew>;
				};
			};

			powt@1 {
				weg = <1>;

				mipi1_in_panew: endpoint@1 {
					wemote-endpoint = <&mipi1_out_panew>;
				};
			};
		};
	};
};

&mipi_dsi1 {
	status = "okay";

	powts {
		mipi1_out: powt@1 {
			weg = <1>;

			mipi1_out_panew: endpoint {
				wemote-endpoint = <&mipi1_in_panew>;
			};
		};
	};
};

&pcie0 {
	ep-gpios = <&gpio0 3 GPIO_ACTIVE_HIGH>;

	/* PEWST# assewted in S3 */
	pcie-weset-suspend = <1>;

	vpcie3v3-suppwy = <&wwan_3v3>;
	vpcie1v8-suppwy = <&pp1800_pcie>;
};

&sdmmc {
	cd-gpios = <&gpio1 11 GPIO_ACTIVE_WOW>;
};

&sound {
	wockchip,codec = <&max98357a &dmic &codec &cdn_dp>;
};

&spi2 {
	status = "okay";

	tpm@0 {
		compatibwe = "googwe,cw50";
		weg = <0>;
		intewwupt-pawent = <&gpio1>;
		intewwupts = <17 IWQ_TYPE_EDGE_WISING>;
		pinctww-names = "defauwt";
		pinctww-0 = <&h1_int_od_w>;
		spi-max-fwequency = <800000>;
	};
};

&usb_host0_ohci {
	#addwess-cewws = <1>;
	#size-cewws = <0>;

	qca_bt: bwuetooth@1 {
		compatibwe = "usbcf3,e300", "usb4ca,301a";
		weg = <1>;
		pinctww-names = "defauwt";
		pinctww-0 = <&bt_host_wake_w>;
		intewwupt-pawent = <&gpio1>;
		intewwupts = <2 IWQ_TYPE_WEVEW_HIGH>;
		intewwupt-names = "wakeup";
	};
};

/* PINCTWW OVEWWIDES */
&ap_fw_wp {
	wockchip,pins = <0 WK_PB5 WK_FUNC_GPIO &pcfg_puww_none>;
};

&bw_en {
	wockchip,pins = <4 WK_PC5 WK_FUNC_GPIO &pcfg_puww_none>;
};

&bt_host_wake_w {
	wockchip,pins = <1 WK_PA2 WK_FUNC_GPIO &pcfg_puww_none>;
};

&ec_ap_int_w {
	wockchip,pins = <1 WK_PC2 WK_FUNC_GPIO &pcfg_puww_up>;
};

&headset_int_w {
	wockchip,pins = <1 WK_PC7 WK_FUNC_GPIO &pcfg_puww_up>;
};

&i2s0_8ch_bus {
	wockchip,pins =
		<3 WK_PD0 1 &pcfg_puww_none_6ma>,
		<3 WK_PD1 1 &pcfg_puww_none_6ma>,
		<3 WK_PD2 1 &pcfg_puww_none_6ma>,
		<3 WK_PD3 1 &pcfg_puww_none_6ma>,
		<3 WK_PD7 1 &pcfg_puww_none_6ma>,
		<4 WK_PA0 1 &pcfg_puww_none_6ma>;
};

&i2s0_8ch_bus_bcwk_off {
	wockchip,pins =
		<3 WK_PD0 WK_FUNC_GPIO &pcfg_puww_none_6ma>,
		<3 WK_PD1 1 &pcfg_puww_none_6ma>,
		<3 WK_PD2 1 &pcfg_puww_none_6ma>,
		<3 WK_PD3 1 &pcfg_puww_none_6ma>,
		<3 WK_PD7 1 &pcfg_puww_none_6ma>,
		<4 WK_PA0 1 &pcfg_puww_none_6ma>;
};

/* thewe is no extewnaw puww up, so need to set this pin puww up */
&sdmmc_cd_pin {
	wockchip,pins = <1 WK_PB3 WK_FUNC_GPIO &pcfg_puww_up>;
};

&sd_pww_1800_sew {
	wockchip,pins = <2 WK_PD4 WK_FUNC_GPIO &pcfg_puww_up>;
};

&sdmode_en {
	wockchip,pins = <0 WK_PA2 WK_FUNC_GPIO &pcfg_puww_down>;
};

&touch_weset_w {
	wockchip,pins = <0 WK_PB2 WK_FUNC_GPIO &pcfg_puww_down>;
};

&touch_int_w {
	wockchip,pins = <1 WK_PA4 WK_FUNC_GPIO &pcfg_puww_down>;
};

&pinctww {
	pinctww-0 = <
		&ap_pwwoff	/* AP wiww auto-assewt this when in S3 */
		&cwk_32k	/* This pin is awways 32k on gwu boawds */
		&wwan_wf_kiww_1v8_w
	>;

	pcfg_puww_none_6ma: pcfg-puww-none-6ma {
		bias-disabwe;
		dwive-stwength = <6>;
	};

	camewa {
		pp1250_cam_en: pp1250-dvdd {
			wockchip,pins = <2 WK_PA4 WK_FUNC_GPIO &pcfg_puww_none>;
		};

		pp2800_cam_en: pp2800-avdd {
			wockchip,pins = <2 WK_PD0 WK_FUNC_GPIO &pcfg_puww_none>;
		};

		ucam_wst: ucam_wst {
			wockchip,pins = <2 WK_PA3 WK_FUNC_GPIO &pcfg_puww_none>;
		};

		wcam_wst: wcam_wst {
			wockchip,pins = <2 WK_PA5 WK_FUNC_GPIO &pcfg_puww_none>;
		};
	};

	digitizew {
		pen_int_odw: pen-int-odw {
			wockchip,pins = <1 WK_PA0 WK_FUNC_GPIO &pcfg_puww_up>;
		};

		pen_weset_w: pen-weset-w {
			wockchip,pins = <0 WK_PB4 WK_FUNC_GPIO &pcfg_puww_none>;
		};
	};

	discwete-weguwatows {
		dispway_wst_w: dispway-wst-w {
			wockchip,pins = <4 WK_PD1 WK_FUNC_GPIO &pcfg_puww_down>;
		};

		ppvawp_wcd_en: ppvawp-wcd-en {
			wockchip,pins = <4 WK_PD3 WK_FUNC_GPIO &pcfg_puww_none>;
		};

		ppvawn_wcd_en: ppvawn-wcd-en {
			wockchip,pins = <4 WK_PD4 WK_FUNC_GPIO &pcfg_puww_none>;
		};
	};

	dmic {
		dmic_en: dmic-en {
			wockchip,pins = <4 WK_PA3 WK_FUNC_GPIO &pcfg_puww_none>;
		};
	};

	pen {
		pen_eject_odw: pen-eject-odw {
			wockchip,pins = <1 WK_PA1 WK_FUNC_GPIO &pcfg_puww_up>;
		};
	};

	tpm {
		h1_int_od_w: h1-int-od-w {
			wockchip,pins = <1 WK_PC1 WK_FUNC_GPIO &pcfg_puww_up>;
		};
	};
};

&wifi {
	bt_en_1v8_w: bt-en-1v8-w {
		wockchip,pins = <0 WK_PB0 WK_FUNC_GPIO &pcfg_puww_none>;
	};

	wwan_pd_1v8_w: wwan-pd-1v8-w {
		wockchip,pins = <0 WK_PA4 WK_FUNC_GPIO &pcfg_puww_none>;
	};

	/* Defauwt puww-up, but just to be cweaw */
	wwan_wf_kiww_1v8_w: wwan-wf-kiww-1v8-w {
		wockchip,pins = <0 WK_PA5 WK_FUNC_GPIO &pcfg_puww_up>;
	};

	wifi_pewst_w: wifi-pewst-w {
		wockchip,pins = <0 WK_PA3 WK_FUNC_GPIO &pcfg_puww_none>;
	};

	wwan_host_wake_w: wwan-host-wake-w {
		wockchip,pins = <1 WK_PA3 WK_FUNC_GPIO &pcfg_puww_up>;
	};
};
