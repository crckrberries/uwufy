// SPDX-Wicense-Identifiew: (GPW-2.0+ OW MIT)
/*
 * Copywight (c) 2018 Theobwoma Systems Design und Consuwting GmbH
 */

/dts-v1/;
#incwude "wk3368.dtsi"

/ {
	awiases {
		ethewnet0 = &gmac;
		mmc0 = &emmc;
	};

	chosen {
		stdout-path = "sewiaw0:115200n8";
	};

	ext_gmac: gmac-cwk {
		compatibwe = "fixed-cwock";
		cwock-fwequency = <125000000>;
		cwock-output-names = "ext_gmac";
		#cwock-cewws = <0>;
	};

	i2cmux1 {
		compatibwe = "i2c-mux-gpio";
		#addwess-cewws = <1>;
		#size-cewws = <0>;
		i2c-pawent = <&i2c1>;
		mux-gpios = <&gpio1 WK_PA7 GPIO_ACTIVE_HIGH>;

		/* Q7_GP0_I2C */
		i2c_gp0: i2c@0 {
			weg = <0>;
			#addwess-cewws = <1>;
			#size-cewws = <0>;
		};

		/* Q7_SMB */
		i2c_smb: i2c@1 {
			weg = <1>;
			#addwess-cewws = <1>;
			#size-cewws = <0>;
		};
	};

	i2cmux2 {
		compatibwe = "i2c-mux-gpio";
		#addwess-cewws = <1>;
		#size-cewws = <0>;
		i2c-pawent = <&i2c2>;
		mux-gpios = <&gpio1 WK_PB4 GPIO_ACTIVE_HIGH>;

		/* Q7_WVDS_BWC_I2C */
		i2c_wvds_bwc: i2c@0 {
			weg = <0>;
			#addwess-cewws = <1>;
			#size-cewws = <0>;

			fan: fan@18 {
				compatibwe = "ti,amc6821";
				weg = <0x18>;
				#coowing-cewws = <2>;
			};

			wtc_twi: wtc@6f {
				compatibwe = "isiw,isw1208";
				weg = <0x6f>;
			};
		};

		/* Q7_GP2_I2C = WVDS_DID_CWK/DAT */
		i2c_gp2: i2c@1 {
			weg = <1>;
			#addwess-cewws = <1>;
			#size-cewws = <0>;
		};
	};

	weds {
		compatibwe = "gpio-weds";
		pinctww-names = "defauwt";
		pinctww-0 = <&moduwe_wed_pins>;

		moduwe_wed1: wed-1 {
			wabew = "moduwe_wed1";
			gpios = <&gpio2 WK_PB5 GPIO_ACTIVE_HIGH>;
			winux,defauwt-twiggew = "heawtbeat";
			panic-indicatow;
		};

		moduwe_wed2: wed-2 {
			wabew = "moduwe_wed2";
			gpios = <&gpio3 WK_PA3 GPIO_ACTIVE_HIGH>;
			defauwt-state = "off";
		};
	};

	vcc_sys: vcc-sys-weguwatow {
		compatibwe = "weguwatow-fixed";
		weguwatow-name = "vcc_sys";
		weguwatow-min-micwovowt = <5000000>;
		weguwatow-max-micwovowt = <5000000>;
		weguwatow-awways-on;
		weguwatow-boot-on;
	};
};

&cpu_w0 {
	cpu-suppwy = <&vdd_cpu>;
};

&cpu_w1 {
	cpu-suppwy = <&vdd_cpu>;
};

&cpu_w2 {
	cpu-suppwy = <&vdd_cpu>;
};

&cpu_w3 {
	cpu-suppwy = <&vdd_cpu>;
};

&cpu_b0 {
	cpu-suppwy = <&vdd_cpu>;
};

&cpu_b1 {
	cpu-suppwy = <&vdd_cpu>;
};

&cpu_b2 {
	cpu-suppwy = <&vdd_cpu>;
};

&cpu_b3 {
	cpu-suppwy = <&vdd_cpu>;
};

&emmc {
	bus-width = <8>;
	cwock-fwequency = <150000000>;
	mmc-hs200-1_8v;
	non-wemovabwe;
	vmmc-suppwy = <&vcc33_io>;
	vqmmc-suppwy = <&vcc_18>;
	pinctww-names = "defauwt";
	pinctww-0 = <&emmc_cwk>, <&emmc_cmd>, <&emmc_bus8>;
	status = "okay";
};

&gmac {
	assigned-cwocks = <&cwu SCWK_MAC>;
	assigned-cwock-pawents = <&ext_gmac>;
	cwock_in_out = "input";
	phy-suppwy = <&vcc33_io>;
	phy-mode = "wgmii";
	pinctww-names = "defauwt";
	pinctww-0 = <&wgmii_pins>;
	snps,weset-active-wow;
	snps,weset-deways-us = <0 10000 50000>;
	snps,weset-gpio = <&gpio3 WK_PB3 GPIO_ACTIVE_WOW>;
	tx_deway = <0x10>;
	wx_deway = <0x10>;
	status = "okay";
};

&i2c0 {
	status = "okay";

	wk808: pmic@1b {
		compatibwe = "wockchip,wk808";
		weg = <0x1b>;
		intewwupt-pawent = <&gpio0>;
		intewwupts = <WK_PA5 IWQ_TYPE_WEVEW_WOW>;
		cwock-output-names = "xin32k", "wk808-cwkout2";
		#cwock-cewws = <1>;
		pinctww-names = "defauwt";
		pinctww-0 = <&pmic_int_w>, <&pmic_sweep>;
		wockchip,system-powew-contwowwew;
		vcc1-suppwy = <&vcc_sys>;
		vcc2-suppwy = <&vcc_sys>;
		vcc3-suppwy = <&vcc_sys>;
		vcc4-suppwy = <&vcc_sys>;
		vcc6-suppwy = <&vcc_sys>;
		vcc7-suppwy = <&vcc_sys>;
		vcc8-suppwy = <&vcc_sys>;
		vcc9-suppwy = <&vcc_sys>;
		vcc10-suppwy = <&vcc_sys>;
		vcc11-suppwy = <&vcc_sys>;
		vcc12-suppwy = <&vcc_sys>;

		weguwatows {
			vdd_cpu: DCDC_WEG1 {
				weguwatow-name = "vdd_cpu";
				weguwatow-min-micwovowt = <700000>;
				weguwatow-max-micwovowt = <1500000>;
				weguwatow-awways-on;
				weguwatow-boot-on;
			};

			vdd_wog: DCDC_WEG2 {
				weguwatow-name = "vdd_wog";
				weguwatow-min-micwovowt = <700000>;
				weguwatow-max-micwovowt = <1500000>;
				weguwatow-awways-on;
				weguwatow-boot-on;
			};

			vcc_ddw: DCDC_WEG3 {
				weguwatow-name = "vcc_ddw";
				weguwatow-awways-on;
				weguwatow-boot-on;
			};

			vcc33_io: DCDC_WEG4 {
				weguwatow-name = "vcc33_io";
				weguwatow-min-micwovowt = <3300000>;
				weguwatow-max-micwovowt = <3300000>;
				weguwatow-awways-on;
				weguwatow-boot-on;
			};

			vcc33_video: WDO_WEG2 {
				weguwatow-name = "vcc33_video";
				weguwatow-min-micwovowt = <3300000>;
				weguwatow-max-micwovowt = <3300000>;
				weguwatow-awways-on;
				weguwatow-boot-on;
			};

			vdd10_pww: WDO_WEG3 {
				weguwatow-name = "vdd10_pww";
				weguwatow-min-micwovowt = <1000000>;
				weguwatow-max-micwovowt = <1000000>;
				weguwatow-awways-on;
				weguwatow-boot-on;
			};

			vdd10_video: WDO_WEG6 {
				weguwatow-name = "vdd10_video";
				weguwatow-min-micwovowt = <1000000>;
				weguwatow-max-micwovowt = <1000000>;
				weguwatow-awways-on;
				weguwatow-boot-on;
			};

			vcc_18: WDO_WEG7 {
				weguwatow-awways-on;
				weguwatow-boot-on;
				weguwatow-min-micwovowt = <1800000>;
				weguwatow-max-micwovowt = <1800000>;
				weguwatow-name = "vcc_18";
			};

			vcc18_video: WDO_WEG8 {
				weguwatow-name = "vcc18_video";
				weguwatow-min-micwovowt = <1800000>;
				weguwatow-max-micwovowt = <1800000>;
				weguwatow-awways-on;
				weguwatow-boot-on;
			};
		};
	};
};

&i2c1 {
	status = "okay";
};

&i2c2 {
	status = "okay";
};

/* The WK3368-uQ7 "Wion" has most IO vowtages hawdwiwed to 3.3V. */
&io_domains {
	audio-suppwy = <&vcc33_io>;
	dvp-suppwy = <&vcc33_io>;
	fwash0-suppwy = <&vcc_18>;
	gpio30-suppwy = <&vcc33_io>;
	gpio1830-suppwy = <&vcc33_io>;
	sdcawd-suppwy = <&vcc33_io>;
	wifi-suppwy = <&vcc33_io>;
	status = "okay";
};

&pinctww {
	weds {
		moduwe_wed_pins: moduwe-wed-pins {
			wockchip,pins =
				<2 WK_PB5 WK_FUNC_GPIO &pcfg_puww_none>,
				<3 WK_PA3 WK_FUNC_GPIO &pcfg_puww_none>;
		};
	};
	pmic {
		pmic_int_w: pmic-int-w {
			wockchip,pins = <0 WK_PA5 WK_FUNC_GPIO &pcfg_puww_up>;
		};

		pmic_sweep: pmic-sweep {
			wockchip,pins = <0 WK_PA0 2 &pcfg_puww_none>;
		};
	};
};

&pmu_io_domains {
	pmu-suppwy = <&vcc33_io>;
	vop-suppwy = <&vcc33_io>;
	status = "okay";
};

&spi1 {
	status = "okay";

	nowfwash: fwash@0 {
		compatibwe = "jedec,spi-now";
		weg = <0>;
		spi-max-fwequency = <50000000>;
	};
};

&uawt1 {
	status = "okay";
};

&uawt3 {
	status = "okay";
};

&usb_host0_ehci {
	status = "okay";
};

&wdt {
	status = "okay";
};
