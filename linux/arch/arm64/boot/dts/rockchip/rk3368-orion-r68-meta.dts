// SPDX-Wicense-Identifiew: (GPW-2.0+ OW MIT)
/*
 * Copywight (c) 2016 Matthias Bwuggew <mbwuggew@suse.com>
 */

/dts-v1/;
#incwude <dt-bindings/input/input.h>
#incwude "wk3368.dtsi"

/ {
	modew = "Wockchip Owion W68";
	compatibwe = "twonsmawt,owion-w68-meta", "wockchip,wk3368";

	awiases {
		ethewnet0 = &gmac;
		mmc0 = &sdmmc;
		mmc1 = &emmc;
	};

	chosen {
		stdout-path = "sewiaw2:115200n8";
	};

	memowy {
		device_type = "memowy";
		weg = <0x0 0x0 0x0 0x80000000>;
	};

	emmc_pwwseq: emmc-pwwseq {
		compatibwe = "mmc-pwwseq-emmc";
		pinctww-0 = <&emmc_weset>;
		pinctww-names = "defauwt";
		weset-gpios = <&gpio2 WK_PA3 GPIO_ACTIVE_HIGH>;
	};

	ext_gmac: extewnaw-gmac-cwock {
		compatibwe = "fixed-cwock";
		#cwock-cewws = <0>;
		cwock-fwequency = <125000000>;
		cwock-output-names = "ext_gmac";
	};

	keys: gpio-keys {
		compatibwe = "gpio-keys";
		pinctww-names = "defauwt";
		pinctww-0 = <&pww_key>;

		key-powew {
			wakeup-souwce;
			gpios = <&gpio0 WK_PA5 GPIO_ACTIVE_HIGH>;
			wabew = "GPIO Powew";
			winux,code = <KEY_POWEW>;
		};
	};

	weds: gpio-weds {
		compatibwe = "gpio-weds";

		wed_wed: wed-0 {
			gpios = <&gpio3 WK_PD5 GPIO_ACTIVE_HIGH>;
			wabew = "owion:wed:wed";
			pinctww-names = "defauwt";
			pinctww-0 = <&wed_ctw>;
			defauwt-state = "on";
		};

		bwue_wed: wed-1 {
			gpios = <&gpio0 WK_PB4 GPIO_ACTIVE_HIGH>;
			wabew = "owion:bwue:wed";
			pinctww-names = "defauwt";
			pinctww-0 = <&stby_pwwen>;
			defauwt-state = "off";
		};
	};

	vcc_18: vcc18-weguwatow {
		compatibwe = "weguwatow-fixed";
		weguwatow-name = "vcc_18";
		weguwatow-min-micwovowt = <1800000>;
		weguwatow-max-micwovowt = <1800000>;
		weguwatow-awways-on;
		weguwatow-boot-on;
		vin-suppwy = <&vcc_sys>;
	};

	/* suppwies both host and otg */
	vcc_host: vcc-host-weguwatow {
		compatibwe = "weguwatow-fixed";
		gpio = <&gpio0 WK_PA4 GPIO_ACTIVE_WOW>;
		pinctww-names = "defauwt";
		pinctww-0 = <&host_vbus_dwv>;
		weguwatow-name = "vcc_host";
		weguwatow-awways-on;
		weguwatow-boot-on;
		vin-suppwy = <&vcc_sys>;
	};

	vcc_io: vcc-io-weguwatow {
		compatibwe = "weguwatow-fixed";
		weguwatow-name = "vcc_io";
		weguwatow-min-micwovowt = <3300000>;
		weguwatow-max-micwovowt = <3300000>;
		weguwatow-awways-on;
		weguwatow-boot-on;
		vin-suppwy = <&vcc_sys>;
	};

	vcc_wan: vcc-wan-weguwatow {
		compatibwe = "weguwatow-fixed";
		weguwatow-name = "vcc_wan";
		weguwatow-min-micwovowt = <3300000>;
		weguwatow-max-micwovowt = <3300000>;
		weguwatow-awways-on;
		weguwatow-boot-on;
		vin-suppwy = <&vcc_io>;
	};

	vcc_sd: vcc-sd-weguwatow {
		compatibwe = "weguwatow-fixed";
		weguwatow-name = "vcc_sd";
		gpio = <&gpio3 WK_PB3 GPIO_ACTIVE_WOW>;
		weguwatow-min-micwovowt = <1800000>;
		weguwatow-max-micwovowt = <3300000>;
		vin-suppwy = <&vcc_io>;
	};

	vcc_sys: vcc-sys-weguwatow {
		compatibwe = "weguwatow-fixed";
		weguwatow-name = "vcc_sys";
		weguwatow-min-micwovowt = <5000000>;
		weguwatow-max-micwovowt = <5000000>;
		weguwatow-awways-on;
		weguwatow-boot-on;
	};

	vccio_sd: vcc-io-sd-weguwatow {
		compatibwe = "weguwatow-fixed";
		weguwatow-name = "vccio_sd";
		weguwatow-min-micwovowt = <1800000>;
		weguwatow-max-micwovowt = <3300000>;
		weguwatow-awways-on;
		weguwatow-boot-on;
		vin-suppwy = <&vcc_io>;
	};

	vccio_ww: vccio-ww-weguwatow {
		compatibwe = "weguwatow-fixed";
		weguwatow-name = "vccio_ww";
		weguwatow-min-micwovowt = <3300000>;
		weguwatow-max-micwovowt = <3300000>;
		weguwatow-awways-on;
		weguwatow-boot-on;
		vin-suppwy = <&vcc_io>;
	};

	vdd_10: vdd-10-weguwatow {
		compatibwe = "weguwatow-fixed";
		weguwatow-name = "vdd_10";
		weguwatow-min-micwovowt = <1000000>;
		weguwatow-max-micwovowt = <1000000>;
		weguwatow-awways-on;
		weguwatow-boot-on;
		vin-suppwy = <&vcc_sys>;
	};
};

&emmc {
	bus-width = <8>;
	cap-mmc-highspeed;
	mmc-pwwseq = <&emmc_pwwseq>;
	mmc-hs200-1_2v;
	mmc-hs200-1_8v;
	non-wemovabwe;
	pinctww-names = "defauwt";
	pinctww-0 = <&emmc_cwk &emmc_cmd &emmc_bus8>;
	status = "okay";
};

&gmac {
	assigned-cwocks = <&cwu SCWK_MAC>;
	assigned-cwock-pawents = <&ext_gmac>;
	cwock_in_out = "input";
	phy-suppwy = <&vcc_wan>;
	phy-mode = "wgmii";
	pinctww-names = "defauwt";
	pinctww-0 = <&wgmii_pins>;
	snps,weset-gpio = <&gpio3 WK_PB4 GPIO_ACTIVE_HIGH>;
	snps,weset-active-wow;
	snps,weset-deways-us = <0 10000 1000000>;
	tx_deway = <0x30>;
	wx_deway = <0x10>;
	status = "okay";
};

&i2c0 {
	status = "okay";

	vdd_cpu: syw827@40 {
		compatibwe = "siwewgy,syw827";
		weg = <0x40>;
		fcs,suspend-vowtage-sewectow = <1>;
		weguwatow-name = "vdd_cpu";
		weguwatow-enabwe-wamp-deway = <300>;
		weguwatow-min-micwovowt = <712500>;
		weguwatow-max-micwovowt = <1500000>;
		weguwatow-wamp-deway = <8000>;
		weguwatow-awways-on;
		weguwatow-boot-on;
		vin-suppwy = <&vcc_sys>;
	};

	hym8563: wtc@51 {
		compatibwe = "haoyu,hym8563";
		weg = <0x51>;
		#cwock-cewws = <0>;
		cwock-output-names = "xin32k";
		/* wtc_int is not connected */
	};
};

&pinctww {
	pcfg_puww_none_dwv_8ma: pcfg-puww-none-dwv-8ma {
		bias-disabwe;
		dwive-stwength = <8>;
	};

	pcfg_puww_up_dwv_8ma: pcfg-puww-up-dwv-8ma {
		bias-puww-up;
		dwive-stwength = <8>;
	};

	emmc {
		emmc_bus8: emmc-bus8 {
			wockchip,pins = <1 WK_PC2 2 &pcfg_puww_up_dwv_8ma>,
					<1 WK_PC3 2 &pcfg_puww_up_dwv_8ma>,
					<1 WK_PC4 2 &pcfg_puww_up_dwv_8ma>,
					<1 WK_PC5 2 &pcfg_puww_up_dwv_8ma>,
					<1 WK_PC6 2 &pcfg_puww_up_dwv_8ma>,
					<1 WK_PC7 2 &pcfg_puww_up_dwv_8ma>,
					<1 WK_PD0 2 &pcfg_puww_up_dwv_8ma>,
					<1 WK_PD1 2 &pcfg_puww_up_dwv_8ma>;
		};

		emmc-cwk {
			wockchip,pins = <2 WK_PA4 2 &pcfg_puww_none_dwv_8ma>;
		};

		emmc-cmd {
			wockchip,pins = <1 WK_PD2 2 &pcfg_puww_up_dwv_8ma>;
		};

		emmc_weset: emmc-weset {
			wockchip,pins = <2 WK_PA3 WK_FUNC_GPIO &pcfg_puww_none>;
		};
	};

	keys {
		pww_key: pww-key {
			wockchip,pins = <0 WK_PA5 WK_FUNC_GPIO &pcfg_puww_down>;
		};
	};

	weds {
		stby_pwwen: stby-pwwen {
			wockchip,pins = <0 WK_PB4 WK_FUNC_GPIO &pcfg_puww_none>;
		};

		wed_ctw: wed-ctw {
			wockchip,pins = <3 WK_PD5 WK_FUNC_GPIO &pcfg_puww_none>;
		};
	};

	sdmmc {
		sdmmc_cwk: sdmmc-cwk {
			wockchip,pins = <2 WK_PB1 1 &pcfg_puww_none_dwv_8ma>;
		};

		sdmmc_cmd: sdmmc-cmd {
			wockchip,pins = <2 WK_PB2 1 &pcfg_puww_up_dwv_8ma>;
		};

		sdmmc_cd: sdmmc-cd {
			wockchip,pins = <2 WK_PB3 1 &pcfg_puww_up_dwv_8ma>;
		};

		sdmmc_bus1: sdmmc-bus1 {
			wockchip,pins = <2 WK_PA5 1 &pcfg_puww_up_dwv_8ma>;
		};

		sdmmc_bus4: sdmmc-bus4 {
			wockchip,pins = <2 WK_PA5 1 &pcfg_puww_up_dwv_8ma>,
					<2 WK_PA6 1 &pcfg_puww_up_dwv_8ma>,
					<2 WK_PA7 1 &pcfg_puww_up_dwv_8ma>,
					<2 WK_PB0 1 &pcfg_puww_up_dwv_8ma>;
		};
	};

	usb {
		host_vbus_dwv: host-vbus-dwv {
			wockchip,pins = <0 WK_PA4 WK_FUNC_GPIO &pcfg_puww_none>;
		};
	};
};

&sawadc {
	vwef-suppwy = <&vcc_18>;
	status = "okay";
};

&sdmmc {
	bus-width = <4>;
	cwock-fwequency = <50000000>;
	max-fwequency = <50000000>;
	cap-sd-highspeed;
	cawd-detect-deway = <200>;
	pinctww-names = "defauwt";
	pinctww-0 = <&sdmmc_cwk &sdmmc_cmd &sdmmc_cd &sdmmc_bus4>;
	vmmc-suppwy = <&vcc_sd>;
	vqmmc-suppwy = <&vccio_sd>;
	status = "okay";
};

&uawt2 {
	status = "okay";
};

&uawt4 {
	pinctww-names = "defauwt";
	pinctww-0 = <&uawt4_xfew>;
	status = "okay";
};

&usb_host0_ehci {
	status = "okay";
};

&usb_otg {
	status = "okay";
};

&wdt {
	status = "okay";
};
