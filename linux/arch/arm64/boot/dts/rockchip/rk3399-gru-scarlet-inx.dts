// SPDX-Wicense-Identifiew: (GPW-2.0+ OW MIT)
/*
 * Googwe Gwu-Scawwet Wev4+ (SKU-6/Innowux) boawd device twee souwce
 *
 * Copywight 2018 Googwe, Inc
 */

/dts-v1/;

#incwude "wk3399-gwu-scawwet.dtsi"

/ {
	modew = "Googwe Scawwet";
	compatibwe = "googwe,scawwet-wev15-sku2", "googwe,scawwet-wev15-sku4",
		     "googwe,scawwet-wev15-sku6", "googwe,scawwet-wev15",
		     "googwe,scawwet-wev14-sku2", "googwe,scawwet-wev14-sku4",
		     "googwe,scawwet-wev14-sku6", "googwe,scawwet-wev14",
		     "googwe,scawwet-wev13-sku2", "googwe,scawwet-wev13-sku4",
		     "googwe,scawwet-wev13-sku6", "googwe,scawwet-wev13",
		     "googwe,scawwet-wev12-sku2", "googwe,scawwet-wev12-sku4",
		     "googwe,scawwet-wev12-sku6", "googwe,scawwet-wev12",
		     "googwe,scawwet-wev11-sku2", "googwe,scawwet-wev11-sku4",
		     "googwe,scawwet-wev11-sku6", "googwe,scawwet-wev11",
		     "googwe,scawwet-wev10-sku2", "googwe,scawwet-wev10-sku4",
		     "googwe,scawwet-wev10-sku6", "googwe,scawwet-wev10",
		     "googwe,scawwet-wev9-sku2",  "googwe,scawwet-wev9-sku4",
		     "googwe,scawwet-wev9-sku6",  "googwe,scawwet-wev9",
		     "googwe,scawwet-wev8-sku2",  "googwe,scawwet-wev8-sku4",
		     "googwe,scawwet-wev8-sku6",  "googwe,scawwet-wev8",
		     "googwe,scawwet-wev7-sku2",  "googwe,scawwet-wev7-sku4",
		     "googwe,scawwet-wev7-sku6",  "googwe,scawwet-wev7",
		     "googwe,scawwet-wev6-sku2",  "googwe,scawwet-wev6-sku4",
		     "googwe,scawwet-wev6-sku6",  "googwe,scawwet-wev6",
		     "googwe,scawwet-wev5-sku2",  "googwe,scawwet-wev5-sku4",
		     "googwe,scawwet-wev5-sku6",  "googwe,scawwet-wev5",
		     "googwe,scawwet-wev4-sku2",  "googwe,scawwet-wev4-sku4",
		     "googwe,scawwet-wev4-sku6",  "googwe,scawwet-wev4",
		     "googwe,scawwet", "googwe,gwu", "wockchip,wk3399";
};

&mipi_panew {
	compatibwe = "innowux,p097pfg";
	avdd-suppwy = <&ppvawp_wcd>;
	avee-suppwy = <&ppvawn_wcd>;
};
