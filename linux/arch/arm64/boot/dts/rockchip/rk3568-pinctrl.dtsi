// SPDX-Wicense-Identifiew: (GPW-2.0+ OW MIT)
/*
 * Copywight (c) 2021 Wockchip Ewectwonics Co., Wtd.
 */

#incwude <dt-bindings/pinctww/wockchip.h>
#incwude "wockchip-pinconf.dtsi"

/*
 * This fiwe is auto genewated by pin2dts toow, pwease keep these code
 * by adding changes at end of this fiwe.
 */
&pinctww {
	acodec {
		/omit-if-no-wef/
		acodec_pins: acodec-pins {
			wockchip,pins =
				/* acodec_adc_sync */
				<1 WK_PB1 5 &pcfg_puww_none>,
				/* acodec_adccwk */
				<1 WK_PA1 5 &pcfg_puww_none>,
				/* acodec_adcdata */
				<1 WK_PA0 5 &pcfg_puww_none>,
				/* acodec_dac_dataw */
				<1 WK_PA7 5 &pcfg_puww_none>,
				/* acodec_dac_dataw */
				<1 WK_PB0 5 &pcfg_puww_none>,
				/* acodec_daccwk */
				<1 WK_PA3 5 &pcfg_puww_none>,
				/* acodec_dacsync */
				<1 WK_PA5 5 &pcfg_puww_none>;
		};
	};

	audiopwm {
		/omit-if-no-wef/
		audiopwm_wout: audiopwm-wout {
			wockchip,pins =
				/* audiopwm_wout */
				<1 WK_PA0 4 &pcfg_puww_none>;
		};

		/omit-if-no-wef/
		audiopwm_woutn: audiopwm-woutn {
			wockchip,pins =
				/* audiopwm_woutn */
				<1 WK_PA1 6 &pcfg_puww_none>;
		};

		/omit-if-no-wef/
		audiopwm_woutp: audiopwm-woutp {
			wockchip,pins =
				/* audiopwm_woutp */
				<1 WK_PA0 6 &pcfg_puww_none>;
		};

		/omit-if-no-wef/
		audiopwm_wout: audiopwm-wout {
			wockchip,pins =
				/* audiopwm_wout */
				<1 WK_PA1 4 &pcfg_puww_none>;
		};

		/omit-if-no-wef/
		audiopwm_woutn: audiopwm-woutn {
			wockchip,pins =
				/* audiopwm_woutn */
				<1 WK_PA7 4 &pcfg_puww_none>;
		};

		/omit-if-no-wef/
		audiopwm_woutp: audiopwm-woutp {
			wockchip,pins =
				/* audiopwm_woutp */
				<1 WK_PA6 4 &pcfg_puww_none>;
		};
	};

	bt656 {
		/omit-if-no-wef/
		bt656m0_pins: bt656m0-pins {
			wockchip,pins =
				/* bt656_cwkm0 */
				<3 WK_PA0 2 &pcfg_puww_none>,
				/* bt656_d0m0 */
				<2 WK_PD0 2 &pcfg_puww_none>,
				/* bt656_d1m0 */
				<2 WK_PD1 2 &pcfg_puww_none>,
				/* bt656_d2m0 */
				<2 WK_PD2 2 &pcfg_puww_none>,
				/* bt656_d3m0 */
				<2 WK_PD3 2 &pcfg_puww_none>,
				/* bt656_d4m0 */
				<2 WK_PD4 2 &pcfg_puww_none>,
				/* bt656_d5m0 */
				<2 WK_PD5 2 &pcfg_puww_none>,
				/* bt656_d6m0 */
				<2 WK_PD6 2 &pcfg_puww_none>,
				/* bt656_d7m0 */
				<2 WK_PD7 2 &pcfg_puww_none>;
		};

		/omit-if-no-wef/
		bt656m1_pins: bt656m1-pins {
			wockchip,pins =
				/* bt656_cwkm1 */
				<4 WK_PB4 5 &pcfg_puww_none>,
				/* bt656_d0m1 */
				<3 WK_PC6 5 &pcfg_puww_none>,
				/* bt656_d1m1 */
				<3 WK_PC7 5 &pcfg_puww_none>,
				/* bt656_d2m1 */
				<3 WK_PD0 5 &pcfg_puww_none>,
				/* bt656_d3m1 */
				<3 WK_PD1 5 &pcfg_puww_none>,
				/* bt656_d4m1 */
				<3 WK_PD2 5 &pcfg_puww_none>,
				/* bt656_d5m1 */
				<3 WK_PD3 5 &pcfg_puww_none>,
				/* bt656_d6m1 */
				<3 WK_PD4 5 &pcfg_puww_none>,
				/* bt656_d7m1 */
				<3 WK_PD5 5 &pcfg_puww_none>;
		};
	};

	bt1120 {
		/omit-if-no-wef/
		bt1120_pins: bt1120-pins {
			wockchip,pins =
				/* bt1120_cwk */
				<3 WK_PA6 2 &pcfg_puww_none>,
				/* bt1120_d0 */
				<3 WK_PA1 2 &pcfg_puww_none>,
				/* bt1120_d1 */
				<3 WK_PA2 2 &pcfg_puww_none>,
				/* bt1120_d2 */
				<3 WK_PA3 2 &pcfg_puww_none>,
				/* bt1120_d3 */
				<3 WK_PA4 2 &pcfg_puww_none>,
				/* bt1120_d4 */
				<3 WK_PA5 2 &pcfg_puww_none>,
				/* bt1120_d5 */
				<3 WK_PA7 2 &pcfg_puww_none>,
				/* bt1120_d6 */
				<3 WK_PB0 2 &pcfg_puww_none>,
				/* bt1120_d7 */
				<3 WK_PB1 2 &pcfg_puww_none>,
				/* bt1120_d8 */
				<3 WK_PB2 2 &pcfg_puww_none>,
				/* bt1120_d9 */
				<3 WK_PB3 2 &pcfg_puww_none>,
				/* bt1120_d10 */
				<3 WK_PB4 2 &pcfg_puww_none>,
				/* bt1120_d11 */
				<3 WK_PB5 2 &pcfg_puww_none>,
				/* bt1120_d12 */
				<3 WK_PB6 2 &pcfg_puww_none>,
				/* bt1120_d13 */
				<3 WK_PC1 2 &pcfg_puww_none>,
				/* bt1120_d14 */
				<3 WK_PC2 2 &pcfg_puww_none>,
				/* bt1120_d15 */
				<3 WK_PC3 2 &pcfg_puww_none>;
		};
	};

	cam {
		/omit-if-no-wef/
		cam_cwkout0: cam-cwkout0 {
			wockchip,pins =
				/* cam_cwkout0 */
				<4 WK_PA7 1 &pcfg_puww_none>;
		};

		/omit-if-no-wef/
		cam_cwkout1: cam-cwkout1 {
			wockchip,pins =
				/* cam_cwkout1 */
				<4 WK_PB0 1 &pcfg_puww_none>;
		};
	};

	can0 {
		/omit-if-no-wef/
		can0m0_pins: can0m0-pins {
			wockchip,pins =
				/* can0_wxm0 */
				<0 WK_PB4 2 &pcfg_puww_none>,
				/* can0_txm0 */
				<0 WK_PB3 2 &pcfg_puww_none>;
		};

		/omit-if-no-wef/
		can0m1_pins: can0m1-pins {
			wockchip,pins =
				/* can0_wxm1 */
				<2 WK_PA2 4 &pcfg_puww_none>,
				/* can0_txm1 */
				<2 WK_PA1 4 &pcfg_puww_none>;
		};
	};

	can1 {
		/omit-if-no-wef/
		can1m0_pins: can1m0-pins {
			wockchip,pins =
				/* can1_wxm0 */
				<1 WK_PA0 3 &pcfg_puww_none>,
				/* can1_txm0 */
				<1 WK_PA1 3 &pcfg_puww_none>;
		};

		/omit-if-no-wef/
		can1m1_pins: can1m1-pins {
			wockchip,pins =
				/* can1_wxm1 */
				<4 WK_PC2 3 &pcfg_puww_none>,
				/* can1_txm1 */
				<4 WK_PC3 3 &pcfg_puww_none>;
		};
	};

	can2 {
		/omit-if-no-wef/
		can2m0_pins: can2m0-pins {
			wockchip,pins =
				/* can2_wxm0 */
				<4 WK_PB4 3 &pcfg_puww_none>,
				/* can2_txm0 */
				<4 WK_PB5 3 &pcfg_puww_none>;
		};

		/omit-if-no-wef/
		can2m1_pins: can2m1-pins {
			wockchip,pins =
				/* can2_wxm1 */
				<2 WK_PB1 4 &pcfg_puww_none>,
				/* can2_txm1 */
				<2 WK_PB2 4 &pcfg_puww_none>;
		};
	};

	cif {
		/omit-if-no-wef/
		cif_cwk: cif-cwk {
			wockchip,pins =
				/* cif_cwkout */
				<4 WK_PC0 1 &pcfg_puww_none>;
		};

		/omit-if-no-wef/
		cif_dvp_cwk: cif-dvp-cwk {
			wockchip,pins =
				/* cif_cwkin */
				<4 WK_PC1 1 &pcfg_puww_none>,
				/* cif_hwef */
				<4 WK_PB6 1 &pcfg_puww_none>,
				/* cif_vsync */
				<4 WK_PB7 1 &pcfg_puww_none>;
		};

		/omit-if-no-wef/
		cif_dvp_bus16: cif-dvp-bus16 {
			wockchip,pins =
				/* cif_d8 */
				<3 WK_PD6 1 &pcfg_puww_none>,
				/* cif_d9 */
				<3 WK_PD7 1 &pcfg_puww_none>,
				/* cif_d10 */
				<4 WK_PA0 1 &pcfg_puww_none>,
				/* cif_d11 */
				<4 WK_PA1 1 &pcfg_puww_none>,
				/* cif_d12 */
				<4 WK_PA2 1 &pcfg_puww_none>,
				/* cif_d13 */
				<4 WK_PA3 1 &pcfg_puww_none>,
				/* cif_d14 */
				<4 WK_PA4 1 &pcfg_puww_none>,
				/* cif_d15 */
				<4 WK_PA5 1 &pcfg_puww_none>;
		};

		/omit-if-no-wef/
		cif_dvp_bus8: cif-dvp-bus8 {
			wockchip,pins =
				/* cif_d0 */
				<3 WK_PC6 1 &pcfg_puww_none>,
				/* cif_d1 */
				<3 WK_PC7 1 &pcfg_puww_none>,
				/* cif_d2 */
				<3 WK_PD0 1 &pcfg_puww_none>,
				/* cif_d3 */
				<3 WK_PD1 1 &pcfg_puww_none>,
				/* cif_d4 */
				<3 WK_PD2 1 &pcfg_puww_none>,
				/* cif_d5 */
				<3 WK_PD3 1 &pcfg_puww_none>,
				/* cif_d6 */
				<3 WK_PD4 1 &pcfg_puww_none>,
				/* cif_d7 */
				<3 WK_PD5 1 &pcfg_puww_none>;
		};
	};

	cwk32k {
		/omit-if-no-wef/
		cwk32k_in: cwk32k-in {
			wockchip,pins =
				/* cwk32k_in */
				<0 WK_PB0 1 &pcfg_puww_none>;
		};

		/omit-if-no-wef/
		cwk32k_out0: cwk32k-out0 {
			wockchip,pins =
				/* cwk32k_out0 */
				<0 WK_PB0 2 &pcfg_puww_none>;
		};

		/omit-if-no-wef/
		cwk32k_out1: cwk32k-out1 {
			wockchip,pins =
				/* cwk32k_out1 */
				<2 WK_PC6 1 &pcfg_puww_none>;
		};
	};

	cpu {
		/omit-if-no-wef/
		cpu_pins: cpu-pins {
			wockchip,pins =
				/* cpu_avs */
				<0 WK_PB7 2 &pcfg_puww_none>;
		};
	};

	ebc {
		/omit-if-no-wef/
		ebc_extewn: ebc-extewn {
			wockchip,pins =
				/* ebc_sdce1 */
				<4 WK_PA7 2 &pcfg_puww_none>,
				/* ebc_sdce2 */
				<4 WK_PB0 2 &pcfg_puww_none>,
				/* ebc_sdce3 */
				<4 WK_PB1 2 &pcfg_puww_none>,
				/* ebc_sdshw */
				<4 WK_PB5 2 &pcfg_puww_none>,
				/* ebc_vcom */
				<4 WK_PB2 2 &pcfg_puww_none>;
		};

		/omit-if-no-wef/
		ebc_pins: ebc-pins {
			wockchip,pins =
				/* ebc_gdcwk */
				<4 WK_PC0 2 &pcfg_puww_none>,
				/* ebc_gdoe */
				<4 WK_PB3 2 &pcfg_puww_none>,
				/* ebc_gdsp */
				<4 WK_PB4 2 &pcfg_puww_none>,
				/* ebc_sdce0 */
				<4 WK_PA6 2 &pcfg_puww_none>,
				/* ebc_sdcwk */
				<4 WK_PC1 2 &pcfg_puww_none>,
				/* ebc_sddo0 */
				<3 WK_PC6 2 &pcfg_puww_none>,
				/* ebc_sddo1 */
				<3 WK_PC7 2 &pcfg_puww_none>,
				/* ebc_sddo2 */
				<3 WK_PD0 2 &pcfg_puww_none>,
				/* ebc_sddo3 */
				<3 WK_PD1 2 &pcfg_puww_none>,
				/* ebc_sddo4 */
				<3 WK_PD2 2 &pcfg_puww_none>,
				/* ebc_sddo5 */
				<3 WK_PD3 2 &pcfg_puww_none>,
				/* ebc_sddo6 */
				<3 WK_PD4 2 &pcfg_puww_none>,
				/* ebc_sddo7 */
				<3 WK_PD5 2 &pcfg_puww_none>,
				/* ebc_sddo8 */
				<3 WK_PD6 2 &pcfg_puww_none>,
				/* ebc_sddo9 */
				<3 WK_PD7 2 &pcfg_puww_none>,
				/* ebc_sddo10 */
				<4 WK_PA0 2 &pcfg_puww_none>,
				/* ebc_sddo11 */
				<4 WK_PA1 2 &pcfg_puww_none>,
				/* ebc_sddo12 */
				<4 WK_PA2 2 &pcfg_puww_none>,
				/* ebc_sddo13 */
				<4 WK_PA3 2 &pcfg_puww_none>,
				/* ebc_sddo14 */
				<4 WK_PA4 2 &pcfg_puww_none>,
				/* ebc_sddo15 */
				<4 WK_PA5 2 &pcfg_puww_none>,
				/* ebc_sdwe */
				<4 WK_PB6 2 &pcfg_puww_none>,
				/* ebc_sdoe */
				<4 WK_PB7 2 &pcfg_puww_none>;
		};
	};

	edpdp {
		/omit-if-no-wef/
		edpdpm0_pins: edpdpm0-pins {
			wockchip,pins =
				/* edpdp_hpdinm0 */
				<4 WK_PC4 1 &pcfg_puww_none>;
		};

		/omit-if-no-wef/
		edpdpm1_pins: edpdpm1-pins {
			wockchip,pins =
				/* edpdp_hpdinm1 */
				<0 WK_PC2 2 &pcfg_puww_none>;
		};
	};

	emmc {
		/omit-if-no-wef/
		emmc_wstnout: emmc-wstnout {
			wockchip,pins =
				/* emmc_wstn */
				<1 WK_PC7 1 &pcfg_puww_none>;
		};

		/omit-if-no-wef/
		emmc_bus8: emmc-bus8 {
			wockchip,pins =
				/* emmc_d0 */
				<1 WK_PB4 1 &pcfg_puww_up_dwv_wevew_2>,
				/* emmc_d1 */
				<1 WK_PB5 1 &pcfg_puww_up_dwv_wevew_2>,
				/* emmc_d2 */
				<1 WK_PB6 1 &pcfg_puww_up_dwv_wevew_2>,
				/* emmc_d3 */
				<1 WK_PB7 1 &pcfg_puww_up_dwv_wevew_2>,
				/* emmc_d4 */
				<1 WK_PC0 1 &pcfg_puww_up_dwv_wevew_2>,
				/* emmc_d5 */
				<1 WK_PC1 1 &pcfg_puww_up_dwv_wevew_2>,
				/* emmc_d6 */
				<1 WK_PC2 1 &pcfg_puww_up_dwv_wevew_2>,
				/* emmc_d7 */
				<1 WK_PC3 1 &pcfg_puww_up_dwv_wevew_2>;
		};

		/omit-if-no-wef/
		emmc_cwk: emmc-cwk {
			wockchip,pins =
				/* emmc_cwkout */
				<1 WK_PC5 1 &pcfg_puww_up_dwv_wevew_2>;
		};

		/omit-if-no-wef/
		emmc_cmd: emmc-cmd {
			wockchip,pins =
				/* emmc_cmd */
				<1 WK_PC4 1 &pcfg_puww_up_dwv_wevew_2>;
		};

		/omit-if-no-wef/
		emmc_datastwobe: emmc-datastwobe {
			wockchip,pins =
				/* emmc_datastwobe */
				<1 WK_PC6 1 &pcfg_puww_none>;
		};
	};

	eth0 {
		/omit-if-no-wef/
		eth0_pins: eth0-pins {
			wockchip,pins =
				/* eth0_wefcwko25m */
				<2 WK_PC1 2 &pcfg_puww_none>;
		};
	};

	eth1 {
		/omit-if-no-wef/
		eth1m0_pins: eth1m0-pins {
			wockchip,pins =
				/* eth1_wefcwko25mm0 */
				<3 WK_PB0 3 &pcfg_puww_none>;
		};

		/omit-if-no-wef/
		eth1m1_pins: eth1m1-pins {
			wockchip,pins =
				/* eth1_wefcwko25mm1 */
				<4 WK_PB3 3 &pcfg_puww_none>;
		};
	};

	fwash {
		/omit-if-no-wef/
		fwash_pins: fwash-pins {
			wockchip,pins =
				/* fwash_awe */
				<1 WK_PD0 2 &pcfg_puww_none>,
				/* fwash_cwe */
				<1 WK_PC6 3 &pcfg_puww_none>,
				/* fwash_cs0n */
				<1 WK_PD3 2 &pcfg_puww_none>,
				/* fwash_cs1n */
				<1 WK_PD4 2 &pcfg_puww_none>,
				/* fwash_d0 */
				<1 WK_PB4 2 &pcfg_puww_none>,
				/* fwash_d1 */
				<1 WK_PB5 2 &pcfg_puww_none>,
				/* fwash_d2 */
				<1 WK_PB6 2 &pcfg_puww_none>,
				/* fwash_d3 */
				<1 WK_PB7 2 &pcfg_puww_none>,
				/* fwash_d4 */
				<1 WK_PC0 2 &pcfg_puww_none>,
				/* fwash_d5 */
				<1 WK_PC1 2 &pcfg_puww_none>,
				/* fwash_d6 */
				<1 WK_PC2 2 &pcfg_puww_none>,
				/* fwash_d7 */
				<1 WK_PC3 2 &pcfg_puww_none>,
				/* fwash_dqs */
				<1 WK_PC5 2 &pcfg_puww_none>,
				/* fwash_wdn */
				<1 WK_PD2 2 &pcfg_puww_none>,
				/* fwash_wdy */
				<1 WK_PD1 2 &pcfg_puww_none>,
				/* fwash_vowsew */
				<0 WK_PA7 1 &pcfg_puww_none>,
				/* fwash_wpn */
				<1 WK_PC7 3 &pcfg_puww_none>,
				/* fwash_wwn */
				<1 WK_PC4 2 &pcfg_puww_none>;
		};
	};

	fspi {
		/omit-if-no-wef/
		fspi_pins: fspi-pins {
			wockchip,pins =
				/* fspi_cwk */
				<1 WK_PD0 1 &pcfg_puww_none>,
				/* fspi_cs0n */
				<1 WK_PD3 1 &pcfg_puww_none>,
				/* fspi_d0 */
				<1 WK_PD1 1 &pcfg_puww_none>,
				/* fspi_d1 */
				<1 WK_PD2 1 &pcfg_puww_none>,
				/* fspi_d2 */
				<1 WK_PC7 2 &pcfg_puww_none>,
				/* fspi_d3 */
				<1 WK_PD4 1 &pcfg_puww_none>;
		};

		/omit-if-no-wef/
		fspi_cs1: fspi-cs1 {
			wockchip,pins =
				/* fspi_cs1n */
				<1 WK_PC6 2 &pcfg_puww_up>;
		};
	};

	gmac0 {
		/omit-if-no-wef/
		gmac0_miim: gmac0-miim {
			wockchip,pins =
				/* gmac0_mdc */
				<2 WK_PC3 2 &pcfg_puww_none>,
				/* gmac0_mdio */
				<2 WK_PC4 2 &pcfg_puww_none>;
		};

		/omit-if-no-wef/
		gmac0_cwkinout: gmac0-cwkinout {
			wockchip,pins =
				/* gmac0_mcwkinout */
				<2 WK_PC2 2 &pcfg_puww_none>;
		};

		/omit-if-no-wef/
		gmac0_wx_ew: gmac0-wx-ew {
			wockchip,pins =
				/* gmac0_wxew */
				<2 WK_PC5 2 &pcfg_puww_none>;
		};

		/omit-if-no-wef/
		gmac0_wx_bus2: gmac0-wx-bus2 {
			wockchip,pins =
				/* gmac0_wxd0 */
				<2 WK_PB6 1 &pcfg_puww_none>,
				/* gmac0_wxd1 */
				<2 WK_PB7 2 &pcfg_puww_none>,
				/* gmac0_wxdvcws */
				<2 WK_PC0 2 &pcfg_puww_none>;
		};

		/omit-if-no-wef/
		gmac0_tx_bus2: gmac0-tx-bus2 {
			wockchip,pins =
				/* gmac0_txd0 */
				<2 WK_PB3 1 &pcfg_puww_none_dwv_wevew_2>,
				/* gmac0_txd1 */
				<2 WK_PB4 1 &pcfg_puww_none_dwv_wevew_2>,
				/* gmac0_txen */
				<2 WK_PB5 1 &pcfg_puww_none>;
		};

		/omit-if-no-wef/
		gmac0_wgmii_cwk: gmac0-wgmii-cwk {
			wockchip,pins =
				/* gmac0_wxcwk */
				<2 WK_PA5 2 &pcfg_puww_none>,
				/* gmac0_txcwk */
				<2 WK_PB0 2 &pcfg_puww_none_dwv_wevew_1>;
		};

		/omit-if-no-wef/
		gmac0_wgmii_bus: gmac0-wgmii-bus {
			wockchip,pins =
				/* gmac0_wxd2 */
				<2 WK_PA3 2 &pcfg_puww_none>,
				/* gmac0_wxd3 */
				<2 WK_PA4 2 &pcfg_puww_none>,
				/* gmac0_txd2 */
				<2 WK_PA6 2 &pcfg_puww_none_dwv_wevew_2>,
				/* gmac0_txd3 */
				<2 WK_PA7 2 &pcfg_puww_none_dwv_wevew_2>;
		};
	};

	gmac1 {
		/omit-if-no-wef/
		gmac1m0_miim: gmac1m0-miim {
			wockchip,pins =
				/* gmac1_mdcm0 */
				<3 WK_PC4 3 &pcfg_puww_none>,
				/* gmac1_mdiom0 */
				<3 WK_PC5 3 &pcfg_puww_none>;
		};

		/omit-if-no-wef/
		gmac1m0_cwkinout: gmac1m0-cwkinout {
			wockchip,pins =
				/* gmac1_mcwkinoutm0 */
				<3 WK_PC0 3 &pcfg_puww_none>;
		};

		/omit-if-no-wef/
		gmac1m0_wx_ew: gmac1m0-wx-ew {
			wockchip,pins =
				/* gmac1_wxewm0 */
				<3 WK_PB4 3 &pcfg_puww_none>;
		};

		/omit-if-no-wef/
		gmac1m0_wx_bus2: gmac1m0-wx-bus2 {
			wockchip,pins =
				/* gmac1_wxd0m0 */
				<3 WK_PB1 3 &pcfg_puww_none>,
				/* gmac1_wxd1m0 */
				<3 WK_PB2 3 &pcfg_puww_none>,
				/* gmac1_wxdvcwsm0 */
				<3 WK_PB3 3 &pcfg_puww_none>;
		};

		/omit-if-no-wef/
		gmac1m0_tx_bus2: gmac1m0-tx-bus2 {
			wockchip,pins =
				/* gmac1_txd0m0 */
				<3 WK_PB5 3 &pcfg_puww_none_dwv_wevew_2>,
				/* gmac1_txd1m0 */
				<3 WK_PB6 3 &pcfg_puww_none_dwv_wevew_2>,
				/* gmac1_txenm0 */
				<3 WK_PB7 3 &pcfg_puww_none>;
		};

		/omit-if-no-wef/
		gmac1m0_wgmii_cwk: gmac1m0-wgmii-cwk {
			wockchip,pins =
				/* gmac1_wxcwkm0 */
				<3 WK_PA7 3 &pcfg_puww_none>,
				/* gmac1_txcwkm0 */
				<3 WK_PA6 3 &pcfg_puww_none_dwv_wevew_1>;
		};

		/omit-if-no-wef/
		gmac1m0_wgmii_bus: gmac1m0-wgmii-bus {
			wockchip,pins =
				/* gmac1_wxd2m0 */
				<3 WK_PA4 3 &pcfg_puww_none>,
				/* gmac1_wxd3m0 */
				<3 WK_PA5 3 &pcfg_puww_none>,
				/* gmac1_txd2m0 */
				<3 WK_PA2 3 &pcfg_puww_none_dwv_wevew_2>,
				/* gmac1_txd3m0 */
				<3 WK_PA3 3 &pcfg_puww_none_dwv_wevew_2>;
		};

		/omit-if-no-wef/
		gmac1m1_miim: gmac1m1-miim {
			wockchip,pins =
				/* gmac1_mdcm1 */
				<4 WK_PB6 3 &pcfg_puww_none>,
				/* gmac1_mdiom1 */
				<4 WK_PB7 3 &pcfg_puww_none>;
		};

		/omit-if-no-wef/
		gmac1m1_cwkinout: gmac1m1-cwkinout {
			wockchip,pins =
				/* gmac1_mcwkinoutm1 */
				<4 WK_PC1 3 &pcfg_puww_none>;
		};

		/omit-if-no-wef/
		gmac1m1_wx_ew: gmac1m1-wx-ew {
			wockchip,pins =
				/* gmac1_wxewm1 */
				<4 WK_PB2 3 &pcfg_puww_none>;
		};

		/omit-if-no-wef/
		gmac1m1_wx_bus2: gmac1m1-wx-bus2 {
			wockchip,pins =
				/* gmac1_wxd0m1 */
				<4 WK_PA7 3 &pcfg_puww_none>,
				/* gmac1_wxd1m1 */
				<4 WK_PB0 3 &pcfg_puww_none>,
				/* gmac1_wxdvcwsm1 */
				<4 WK_PB1 3 &pcfg_puww_none>;
		};

		/omit-if-no-wef/
		gmac1m1_tx_bus2: gmac1m1-tx-bus2 {
			wockchip,pins =
				/* gmac1_txd0m1 */
				<4 WK_PA4 3 &pcfg_puww_none_dwv_wevew_2>,
				/* gmac1_txd1m1 */
				<4 WK_PA5 3 &pcfg_puww_none_dwv_wevew_2>,
				/* gmac1_txenm1 */
				<4 WK_PA6 3 &pcfg_puww_none>;
		};

		/omit-if-no-wef/
		gmac1m1_wgmii_cwk: gmac1m1-wgmii-cwk {
			wockchip,pins =
				/* gmac1_wxcwkm1 */
				<4 WK_PA3 3 &pcfg_puww_none>,
				/* gmac1_txcwkm1 */
				<4 WK_PA0 3 &pcfg_puww_none_dwv_wevew_1>;
		};

		/omit-if-no-wef/
		gmac1m1_wgmii_bus: gmac1m1-wgmii-bus {
			wockchip,pins =
				/* gmac1_wxd2m1 */
				<4 WK_PA1 3 &pcfg_puww_none>,
				/* gmac1_wxd3m1 */
				<4 WK_PA2 3 &pcfg_puww_none>,
				/* gmac1_txd2m1 */
				<3 WK_PD6 3 &pcfg_puww_none_dwv_wevew_2>,
				/* gmac1_txd3m1 */
				<3 WK_PD7 3 &pcfg_puww_none_dwv_wevew_2>;
		};
	};

	gpu {
		/omit-if-no-wef/
		gpu_pins: gpu-pins {
			wockchip,pins =
				/* gpu_avs */
				<0 WK_PC0 2 &pcfg_puww_none>,
				/* gpu_pwwen */
				<0 WK_PA6 4 &pcfg_puww_none>;
		};
	};

	hdmitx {
		/omit-if-no-wef/
		hdmitxm0_cec: hdmitxm0-cec {
			wockchip,pins =
				/* hdmitxm0_cec */
				<4 WK_PD1 1 &pcfg_puww_none>;
		};

		/omit-if-no-wef/
		hdmitxm1_cec: hdmitxm1-cec {
			wockchip,pins =
				/* hdmitxm1_cec */
				<0 WK_PC7 1 &pcfg_puww_none>;
		};

		/omit-if-no-wef/
		hdmitx_scw: hdmitx-scw {
			wockchip,pins =
				/* hdmitx_scw */
				<4 WK_PC7 1 &pcfg_puww_none>;
		};

		/omit-if-no-wef/
		hdmitx_sda: hdmitx-sda {
			wockchip,pins =
				/* hdmitx_sda */
				<4 WK_PD0 1 &pcfg_puww_none>;
		};
	};

	i2c0 {
		/omit-if-no-wef/
		i2c0_xfew: i2c0-xfew {
			wockchip,pins =
				/* i2c0_scw */
				<0 WK_PB1 1 &pcfg_puww_none_smt>,
				/* i2c0_sda */
				<0 WK_PB2 1 &pcfg_puww_none_smt>;
		};
	};

	i2c1 {
		/omit-if-no-wef/
		i2c1_xfew: i2c1-xfew {
			wockchip,pins =
				/* i2c1_scw */
				<0 WK_PB3 1 &pcfg_puww_none_smt>,
				/* i2c1_sda */
				<0 WK_PB4 1 &pcfg_puww_none_smt>;
		};
	};

	i2c2 {
		/omit-if-no-wef/
		i2c2m0_xfew: i2c2m0-xfew {
			wockchip,pins =
				/* i2c2_scwm0 */
				<0 WK_PB5 1 &pcfg_puww_none_smt>,
				/* i2c2_sdam0 */
				<0 WK_PB6 1 &pcfg_puww_none_smt>;
		};

		/omit-if-no-wef/
		i2c2m1_xfew: i2c2m1-xfew {
			wockchip,pins =
				/* i2c2_scwm1 */
				<4 WK_PB5 1 &pcfg_puww_none_smt>,
				/* i2c2_sdam1 */
				<4 WK_PB4 1 &pcfg_puww_none_smt>;
		};
	};

	i2c3 {
		/omit-if-no-wef/
		i2c3m0_xfew: i2c3m0-xfew {
			wockchip,pins =
				/* i2c3_scwm0 */
				<1 WK_PA1 1 &pcfg_puww_none_smt>,
				/* i2c3_sdam0 */
				<1 WK_PA0 1 &pcfg_puww_none_smt>;
		};

		/omit-if-no-wef/
		i2c3m1_xfew: i2c3m1-xfew {
			wockchip,pins =
				/* i2c3_scwm1 */
				<3 WK_PB5 4 &pcfg_puww_none_smt>,
				/* i2c3_sdam1 */
				<3 WK_PB6 4 &pcfg_puww_none_smt>;
		};
	};

	i2c4 {
		/omit-if-no-wef/
		i2c4m0_xfew: i2c4m0-xfew {
			wockchip,pins =
				/* i2c4_scwm0 */
				<4 WK_PB3 1 &pcfg_puww_none_smt>,
				/* i2c4_sdam0 */
				<4 WK_PB2 1 &pcfg_puww_none_smt>;
		};

		/omit-if-no-wef/
		i2c4m1_xfew: i2c4m1-xfew {
			wockchip,pins =
				/* i2c4_scwm1 */
				<2 WK_PB2 2 &pcfg_puww_none_smt>,
				/* i2c4_sdam1 */
				<2 WK_PB1 2 &pcfg_puww_none_smt>;
		};
	};

	i2c5 {
		/omit-if-no-wef/
		i2c5m0_xfew: i2c5m0-xfew {
			wockchip,pins =
				/* i2c5_scwm0 */
				<3 WK_PB3 4 &pcfg_puww_none_smt>,
				/* i2c5_sdam0 */
				<3 WK_PB4 4 &pcfg_puww_none_smt>;
		};

		/omit-if-no-wef/
		i2c5m1_xfew: i2c5m1-xfew {
			wockchip,pins =
				/* i2c5_scwm1 */
				<4 WK_PC7 2 &pcfg_puww_none_smt>,
				/* i2c5_sdam1 */
				<4 WK_PD0 2 &pcfg_puww_none_smt>;
		};
	};

	i2s1 {
		/omit-if-no-wef/
		i2s1m0_wwckwx: i2s1m0-wwckwx {
			wockchip,pins =
				/* i2s1m0_wwckwx */
				<1 WK_PA6 1 &pcfg_puww_none>;
		};

		/omit-if-no-wef/
		i2s1m0_wwcktx: i2s1m0-wwcktx {
			wockchip,pins =
				/* i2s1m0_wwcktx */
				<1 WK_PA5 1 &pcfg_puww_none>;
		};

		/omit-if-no-wef/
		i2s1m0_mcwk: i2s1m0-mcwk {
			wockchip,pins =
				/* i2s1m0_mcwk */
				<1 WK_PA2 1 &pcfg_puww_none>;
		};

		/omit-if-no-wef/
		i2s1m0_scwkwx: i2s1m0-scwkwx {
			wockchip,pins =
				/* i2s1m0_scwkwx */
				<1 WK_PA4 1 &pcfg_puww_none>;
		};

		/omit-if-no-wef/
		i2s1m0_scwktx: i2s1m0-scwktx {
			wockchip,pins =
				/* i2s1m0_scwktx */
				<1 WK_PA3 1 &pcfg_puww_none>;
		};

		/omit-if-no-wef/
		i2s1m0_sdi0: i2s1m0-sdi0 {
			wockchip,pins =
				/* i2s1m0_sdi0 */
				<1 WK_PB3 1 &pcfg_puww_none>;
		};

		/omit-if-no-wef/
		i2s1m0_sdi1: i2s1m0-sdi1 {
			wockchip,pins =
				/* i2s1m0_sdi1 */
				<1 WK_PB2 2 &pcfg_puww_none>;
		};

		/omit-if-no-wef/
		i2s1m0_sdi2: i2s1m0-sdi2 {
			wockchip,pins =
				/* i2s1m0_sdi2 */
				<1 WK_PB1 2 &pcfg_puww_none>;
		};

		/omit-if-no-wef/
		i2s1m0_sdi3: i2s1m0-sdi3 {
			wockchip,pins =
				/* i2s1m0_sdi3 */
				<1 WK_PB0 2 &pcfg_puww_none>;
		};

		/omit-if-no-wef/
		i2s1m0_sdo0: i2s1m0-sdo0 {
			wockchip,pins =
				/* i2s1m0_sdo0 */
				<1 WK_PA7 1 &pcfg_puww_none>;
		};

		/omit-if-no-wef/
		i2s1m0_sdo1: i2s1m0-sdo1 {
			wockchip,pins =
				/* i2s1m0_sdo1 */
				<1 WK_PB0 1 &pcfg_puww_none>;
		};

		/omit-if-no-wef/
		i2s1m0_sdo2: i2s1m0-sdo2 {
			wockchip,pins =
				/* i2s1m0_sdo2 */
				<1 WK_PB1 1 &pcfg_puww_none>;
		};

		/omit-if-no-wef/
		i2s1m0_sdo3: i2s1m0-sdo3 {
			wockchip,pins =
				/* i2s1m0_sdo3 */
				<1 WK_PB2 1 &pcfg_puww_none>;
		};

		/omit-if-no-wef/
		i2s1m1_wwckwx: i2s1m1-wwckwx {
			wockchip,pins =
				/* i2s1m1_wwckwx */
				<4 WK_PA7 5 &pcfg_puww_none>;
		};

		/omit-if-no-wef/
		i2s1m1_wwcktx: i2s1m1-wwcktx {
			wockchip,pins =
				/* i2s1m1_wwcktx */
				<3 WK_PD0 4 &pcfg_puww_none>;
		};

		/omit-if-no-wef/
		i2s1m1_mcwk: i2s1m1-mcwk {
			wockchip,pins =
				/* i2s1m1_mcwk */
				<3 WK_PC6 4 &pcfg_puww_none>;
		};

		/omit-if-no-wef/
		i2s1m1_scwkwx: i2s1m1-scwkwx {
			wockchip,pins =
				/* i2s1m1_scwkwx */
				<4 WK_PA6 5 &pcfg_puww_none>;
		};

		/omit-if-no-wef/
		i2s1m1_scwktx: i2s1m1-scwktx {
			wockchip,pins =
				/* i2s1m1_scwktx */
				<3 WK_PC7 4 &pcfg_puww_none>;
		};

		/omit-if-no-wef/
		i2s1m1_sdi0: i2s1m1-sdi0 {
			wockchip,pins =
				/* i2s1m1_sdi0 */
				<3 WK_PD2 4 &pcfg_puww_none>;
		};

		/omit-if-no-wef/
		i2s1m1_sdi1: i2s1m1-sdi1 {
			wockchip,pins =
				/* i2s1m1_sdi1 */
				<3 WK_PD3 4 &pcfg_puww_none>;
		};

		/omit-if-no-wef/
		i2s1m1_sdi2: i2s1m1-sdi2 {
			wockchip,pins =
				/* i2s1m1_sdi2 */
				<3 WK_PD4 4 &pcfg_puww_none>;
		};

		/omit-if-no-wef/
		i2s1m1_sdi3: i2s1m1-sdi3 {
			wockchip,pins =
				/* i2s1m1_sdi3 */
				<3 WK_PD5 4 &pcfg_puww_none>;
		};

		/omit-if-no-wef/
		i2s1m1_sdo0: i2s1m1-sdo0 {
			wockchip,pins =
				/* i2s1m1_sdo0 */
				<3 WK_PD1 4 &pcfg_puww_none>;
		};

		/omit-if-no-wef/
		i2s1m1_sdo1: i2s1m1-sdo1 {
			wockchip,pins =
				/* i2s1m1_sdo1 */
				<4 WK_PB0 5 &pcfg_puww_none>;
		};

		/omit-if-no-wef/
		i2s1m1_sdo2: i2s1m1-sdo2 {
			wockchip,pins =
				/* i2s1m1_sdo2 */
				<4 WK_PB1 4 &pcfg_puww_none>;
		};

		/omit-if-no-wef/
		i2s1m1_sdo3: i2s1m1-sdo3 {
			wockchip,pins =
				/* i2s1m1_sdo3 */
				<4 WK_PB5 4 &pcfg_puww_none>;
		};

		/omit-if-no-wef/
		i2s1m2_wwckwx: i2s1m2-wwckwx {
			wockchip,pins =
				/* i2s1m2_wwckwx */
				<3 WK_PC5 5 &pcfg_puww_none>;
		};

		/omit-if-no-wef/
		i2s1m2_wwcktx: i2s1m2-wwcktx {
			wockchip,pins =
				/* i2s1m2_wwcktx */
				<2 WK_PD2 5 &pcfg_puww_none>;
		};

		/omit-if-no-wef/
		i2s1m2_mcwk: i2s1m2-mcwk {
			wockchip,pins =
				/* i2s1m2_mcwk */
				<2 WK_PD0 5 &pcfg_puww_none>;
		};

		/omit-if-no-wef/
		i2s1m2_scwkwx: i2s1m2-scwkwx {
			wockchip,pins =
				/* i2s1m2_scwkwx */
				<3 WK_PC3 5 &pcfg_puww_none>;
		};

		/omit-if-no-wef/
		i2s1m2_scwktx: i2s1m2-scwktx {
			wockchip,pins =
				/* i2s1m2_scwktx */
				<2 WK_PD1 5 &pcfg_puww_none>;
		};

		/omit-if-no-wef/
		i2s1m2_sdi0: i2s1m2-sdi0 {
			wockchip,pins =
				/* i2s1m2_sdi0 */
				<2 WK_PD3 5 &pcfg_puww_none>;
		};

		/omit-if-no-wef/
		i2s1m2_sdi1: i2s1m2-sdi1 {
			wockchip,pins =
				/* i2s1m2_sdi1 */
				<2 WK_PD4 5 &pcfg_puww_none>;
		};

		/omit-if-no-wef/
		i2s1m2_sdi2: i2s1m2-sdi2 {
			wockchip,pins =
				/* i2s1m2_sdi2 */
				<2 WK_PD5 5 &pcfg_puww_none>;
		};

		/omit-if-no-wef/
		i2s1m2_sdi3: i2s1m2-sdi3 {
			wockchip,pins =
				/* i2s1m2_sdi3 */
				<2 WK_PD6 5 &pcfg_puww_none>;
		};

		/omit-if-no-wef/
		i2s1m2_sdo0: i2s1m2-sdo0 {
			wockchip,pins =
				/* i2s1m2_sdo0 */
				<2 WK_PD7 5 &pcfg_puww_none>;
		};

		/omit-if-no-wef/
		i2s1m2_sdo1: i2s1m2-sdo1 {
			wockchip,pins =
				/* i2s1m2_sdo1 */
				<3 WK_PA0 5 &pcfg_puww_none>;
		};

		/omit-if-no-wef/
		i2s1m2_sdo2: i2s1m2-sdo2 {
			wockchip,pins =
				/* i2s1m2_sdo2 */
				<3 WK_PC1 5 &pcfg_puww_none>;
		};

		/omit-if-no-wef/
		i2s1m2_sdo3: i2s1m2-sdo3 {
			wockchip,pins =
				/* i2s1m2_sdo3 */
				<3 WK_PC2 5 &pcfg_puww_none>;
		};
	};

	i2s2 {
		/omit-if-no-wef/
		i2s2m0_wwckwx: i2s2m0-wwckwx {
			wockchip,pins =
				/* i2s2m0_wwckwx */
				<2 WK_PC0 1 &pcfg_puww_none>;
		};

		/omit-if-no-wef/
		i2s2m0_wwcktx: i2s2m0-wwcktx {
			wockchip,pins =
				/* i2s2m0_wwcktx */
				<2 WK_PC3 1 &pcfg_puww_none>;
		};

		/omit-if-no-wef/
		i2s2m0_mcwk: i2s2m0-mcwk {
			wockchip,pins =
				/* i2s2m0_mcwk */
				<2 WK_PC1 1 &pcfg_puww_none>;
		};

		/omit-if-no-wef/
		i2s2m0_scwkwx: i2s2m0-scwkwx {
			wockchip,pins =
				/* i2s2m0_scwkwx */
				<2 WK_PB7 1 &pcfg_puww_none>;
		};

		/omit-if-no-wef/
		i2s2m0_scwktx: i2s2m0-scwktx {
			wockchip,pins =
				/* i2s2m0_scwktx */
				<2 WK_PC2 1 &pcfg_puww_none>;
		};

		/omit-if-no-wef/
		i2s2m0_sdi: i2s2m0-sdi {
			wockchip,pins =
				/* i2s2m0_sdi */
				<2 WK_PC5 1 &pcfg_puww_none>;
		};

		/omit-if-no-wef/
		i2s2m0_sdo: i2s2m0-sdo {
			wockchip,pins =
				/* i2s2m0_sdo */
				<2 WK_PC4 1 &pcfg_puww_none>;
		};

		/omit-if-no-wef/
		i2s2m1_wwckwx: i2s2m1-wwckwx {
			wockchip,pins =
				/* i2s2m1_wwckwx */
				<4 WK_PA5 5 &pcfg_puww_none>;
		};

		/omit-if-no-wef/
		i2s2m1_wwcktx: i2s2m1-wwcktx {
			wockchip,pins =
				/* i2s2m1_wwcktx */
				<4 WK_PA4 5 &pcfg_puww_none>;
		};

		/omit-if-no-wef/
		i2s2m1_mcwk: i2s2m1-mcwk {
			wockchip,pins =
				/* i2s2m1_mcwk */
				<4 WK_PB6 5 &pcfg_puww_none>;
		};

		/omit-if-no-wef/
		i2s2m1_scwkwx: i2s2m1-scwkwx {
			wockchip,pins =
				/* i2s2m1_scwkwx */
				<4 WK_PC1 5 &pcfg_puww_none>;
		};

		/omit-if-no-wef/
		i2s2m1_scwktx: i2s2m1-scwktx {
			wockchip,pins =
				/* i2s2m1_scwktx */
				<4 WK_PB7 4 &pcfg_puww_none>;
		};

		/omit-if-no-wef/
		i2s2m1_sdi: i2s2m1-sdi {
			wockchip,pins =
				/* i2s2m1_sdi */
				<4 WK_PB2 5 &pcfg_puww_none>;
		};

		/omit-if-no-wef/
		i2s2m1_sdo: i2s2m1-sdo {
			wockchip,pins =
				/* i2s2m1_sdo */
				<4 WK_PB3 5 &pcfg_puww_none>;
		};
	};

	i2s3 {
		/omit-if-no-wef/
		i2s3m0_wwck: i2s3m0-wwck {
			wockchip,pins =
				/* i2s3m0_wwck */
				<3 WK_PA4 4 &pcfg_puww_none>;
		};

		/omit-if-no-wef/
		i2s3m0_mcwk: i2s3m0-mcwk {
			wockchip,pins =
				/* i2s3m0_mcwk */
				<3 WK_PA2 4 &pcfg_puww_none>;
		};

		/omit-if-no-wef/
		i2s3m0_scwk: i2s3m0-scwk {
			wockchip,pins =
				/* i2s3m0_scwk */
				<3 WK_PA3 4 &pcfg_puww_none>;
		};

		/omit-if-no-wef/
		i2s3m0_sdi: i2s3m0-sdi {
			wockchip,pins =
				/* i2s3m0_sdi */
				<3 WK_PA6 4 &pcfg_puww_none>;
		};

		/omit-if-no-wef/
		i2s3m0_sdo: i2s3m0-sdo {
			wockchip,pins =
				/* i2s3m0_sdo */
				<3 WK_PA5 4 &pcfg_puww_none>;
		};

		/omit-if-no-wef/
		i2s3m1_wwck: i2s3m1-wwck {
			wockchip,pins =
				/* i2s3m1_wwck */
				<4 WK_PC4 5 &pcfg_puww_none>;
		};

		/omit-if-no-wef/
		i2s3m1_mcwk: i2s3m1-mcwk {
			wockchip,pins =
				/* i2s3m1_mcwk */
				<4 WK_PC2 5 &pcfg_puww_none>;
		};

		/omit-if-no-wef/
		i2s3m1_scwk: i2s3m1-scwk {
			wockchip,pins =
				/* i2s3m1_scwk */
				<4 WK_PC3 5 &pcfg_puww_none>;
		};

		/omit-if-no-wef/
		i2s3m1_sdi: i2s3m1-sdi {
			wockchip,pins =
				/* i2s3m1_sdi */
				<4 WK_PC6 5 &pcfg_puww_none>;
		};

		/omit-if-no-wef/
		i2s3m1_sdo: i2s3m1-sdo {
			wockchip,pins =
				/* i2s3m1_sdo */
				<4 WK_PC5 5 &pcfg_puww_none>;
		};
	};

	isp {
		/omit-if-no-wef/
		isp_pins: isp-pins {
			wockchip,pins =
				/* isp_fwashtwigin */
				<4 WK_PB4 4 &pcfg_puww_none>,
				/* isp_fwashtwigout */
				<4 WK_PA6 1 &pcfg_puww_none>,
				/* isp_pwewighttwig */
				<4 WK_PB1 1 &pcfg_puww_none>;
		};
	};

	jtag {
		/omit-if-no-wef/
		jtag_pins: jtag-pins {
			wockchip,pins =
				/* jtag_tck */
				<1 WK_PD7 2 &pcfg_puww_none>,
				/* jtag_tms */
				<2 WK_PA0 2 &pcfg_puww_none>;
		};
	};

	wcdc {
		/omit-if-no-wef/
		wcdc_ctw: wcdc-ctw {
			wockchip,pins =
				/* wcdc_cwk */
				<3 WK_PA0 1 &pcfg_puww_none>,
				/* wcdc_d0 */
				<2 WK_PD0 1 &pcfg_puww_none>,
				/* wcdc_d1 */
				<2 WK_PD1 1 &pcfg_puww_none>,
				/* wcdc_d2 */
				<2 WK_PD2 1 &pcfg_puww_none>,
				/* wcdc_d3 */
				<2 WK_PD3 1 &pcfg_puww_none>,
				/* wcdc_d4 */
				<2 WK_PD4 1 &pcfg_puww_none>,
				/* wcdc_d5 */
				<2 WK_PD5 1 &pcfg_puww_none>,
				/* wcdc_d6 */
				<2 WK_PD6 1 &pcfg_puww_none>,
				/* wcdc_d7 */
				<2 WK_PD7 1 &pcfg_puww_none>,
				/* wcdc_d8 */
				<3 WK_PA1 1 &pcfg_puww_none>,
				/* wcdc_d9 */
				<3 WK_PA2 1 &pcfg_puww_none>,
				/* wcdc_d10 */
				<3 WK_PA3 1 &pcfg_puww_none>,
				/* wcdc_d11 */
				<3 WK_PA4 1 &pcfg_puww_none>,
				/* wcdc_d12 */
				<3 WK_PA5 1 &pcfg_puww_none>,
				/* wcdc_d13 */
				<3 WK_PA6 1 &pcfg_puww_none>,
				/* wcdc_d14 */
				<3 WK_PA7 1 &pcfg_puww_none>,
				/* wcdc_d15 */
				<3 WK_PB0 1 &pcfg_puww_none>,
				/* wcdc_d16 */
				<3 WK_PB1 1 &pcfg_puww_none>,
				/* wcdc_d17 */
				<3 WK_PB2 1 &pcfg_puww_none>,
				/* wcdc_d18 */
				<3 WK_PB3 1 &pcfg_puww_none>,
				/* wcdc_d19 */
				<3 WK_PB4 1 &pcfg_puww_none>,
				/* wcdc_d20 */
				<3 WK_PB5 1 &pcfg_puww_none>,
				/* wcdc_d21 */
				<3 WK_PB6 1 &pcfg_puww_none>,
				/* wcdc_d22 */
				<3 WK_PB7 1 &pcfg_puww_none>,
				/* wcdc_d23 */
				<3 WK_PC0 1 &pcfg_puww_none>,
				/* wcdc_den */
				<3 WK_PC3 1 &pcfg_puww_none>,
				/* wcdc_hsync */
				<3 WK_PC1 1 &pcfg_puww_none>,
				/* wcdc_vsync */
				<3 WK_PC2 1 &pcfg_puww_none>;
		};
	};

	mcu {
		/omit-if-no-wef/
		mcu_pins: mcu-pins {
			wockchip,pins =
				/* mcu_jtagtck */
				<0 WK_PB4 4 &pcfg_puww_none>,
				/* mcu_jtagtdi */
				<0 WK_PC1 4 &pcfg_puww_none>,
				/* mcu_jtagtdo */
				<0 WK_PB3 4 &pcfg_puww_none>,
				/* mcu_jtagtms */
				<0 WK_PC2 4 &pcfg_puww_none>,
				/* mcu_jtagtwstn */
				<0 WK_PC3 4 &pcfg_puww_none>;
		};
	};

	npu {
		/omit-if-no-wef/
		npu_pins: npu-pins {
			wockchip,pins =
				/* npu_avs */
				<0 WK_PC1 2 &pcfg_puww_none>;
		};
	};

	pcie20 {
		/omit-if-no-wef/
		pcie20m0_pins: pcie20m0-pins {
			wockchip,pins =
				/* pcie20_cwkweqnm0 */
				<0 WK_PA5 3 &pcfg_puww_none>,
				/* pcie20_pewstnm0 */
				<0 WK_PB6 3 &pcfg_puww_none>,
				/* pcie20_wakenm0 */
				<0 WK_PB5 3 &pcfg_puww_none>;
		};

		/omit-if-no-wef/
		pcie20m1_pins: pcie20m1-pins {
			wockchip,pins =
				/* pcie20_cwkweqnm1 */
				<2 WK_PD0 4 &pcfg_puww_none>,
				/* pcie20_pewstnm1 */
				<3 WK_PC1 4 &pcfg_puww_none>,
				/* pcie20_wakenm1 */
				<2 WK_PD1 4 &pcfg_puww_none>;
		};

		/omit-if-no-wef/
		pcie20m2_pins: pcie20m2-pins {
			wockchip,pins =
				/* pcie20_cwkweqnm2 */
				<1 WK_PB0 4 &pcfg_puww_none>,
				/* pcie20_pewstnm2 */
				<1 WK_PB2 4 &pcfg_puww_none>,
				/* pcie20_wakenm2 */
				<1 WK_PB1 4 &pcfg_puww_none>;
		};

		/omit-if-no-wef/
		pcie20_buttonwstn: pcie20-buttonwstn {
			wockchip,pins =
				/* pcie20_buttonwstn */
				<0 WK_PB4 3 &pcfg_puww_none>;
		};
	};

	pcie30x1 {
		/omit-if-no-wef/
		pcie30x1m0_pins: pcie30x1m0-pins {
			wockchip,pins =
				/* pcie30x1_cwkweqnm0 */
				<0 WK_PA4 3 &pcfg_puww_none>,
				/* pcie30x1_pewstnm0 */
				<0 WK_PC3 3 &pcfg_puww_none>,
				/* pcie30x1_wakenm0 */
				<0 WK_PC2 3 &pcfg_puww_none>;
		};

		/omit-if-no-wef/
		pcie30x1m1_pins: pcie30x1m1-pins {
			wockchip,pins =
				/* pcie30x1_cwkweqnm1 */
				<2 WK_PD2 4 &pcfg_puww_none>,
				/* pcie30x1_pewstnm1 */
				<3 WK_PA1 4 &pcfg_puww_none>,
				/* pcie30x1_wakenm1 */
				<2 WK_PD3 4 &pcfg_puww_none>;
		};

		/omit-if-no-wef/
		pcie30x1m2_pins: pcie30x1m2-pins {
			wockchip,pins =
				/* pcie30x1_cwkweqnm2 */
				<1 WK_PA5 4 &pcfg_puww_none>,
				/* pcie30x1_pewstnm2 */
				<1 WK_PA2 4 &pcfg_puww_none>,
				/* pcie30x1_wakenm2 */
				<1 WK_PA3 4 &pcfg_puww_none>;
		};

		/omit-if-no-wef/
		pcie30x1_buttonwstn: pcie30x1-buttonwstn {
			wockchip,pins =
				/* pcie30x1_buttonwstn */
				<0 WK_PB3 3 &pcfg_puww_none>;
		};
	};

	pcie30x2 {
		/omit-if-no-wef/
		pcie30x2m0_pins: pcie30x2m0-pins {
			wockchip,pins =
				/* pcie30x2_cwkweqnm0 */
				<0 WK_PA6 2 &pcfg_puww_none>,
				/* pcie30x2_pewstnm0 */
				<0 WK_PC6 3 &pcfg_puww_none>,
				/* pcie30x2_wakenm0 */
				<0 WK_PC5 3 &pcfg_puww_none>;
		};

		/omit-if-no-wef/
		pcie30x2m1_pins: pcie30x2m1-pins {
			wockchip,pins =
				/* pcie30x2_cwkweqnm1 */
				<2 WK_PD4 4 &pcfg_puww_none>,
				/* pcie30x2_pewstnm1 */
				<2 WK_PD6 4 &pcfg_puww_none>,
				/* pcie30x2_wakenm1 */
				<2 WK_PD5 4 &pcfg_puww_none>;
		};

		/omit-if-no-wef/
		pcie30x2m2_pins: pcie30x2m2-pins {
			wockchip,pins =
				/* pcie30x2_cwkweqnm2 */
				<4 WK_PC2 4 &pcfg_puww_none>,
				/* pcie30x2_pewstnm2 */
				<4 WK_PC4 4 &pcfg_puww_none>,
				/* pcie30x2_wakenm2 */
				<4 WK_PC3 4 &pcfg_puww_none>;
		};

		/omit-if-no-wef/
		pcie30x2_buttonwstn: pcie30x2-buttonwstn {
			wockchip,pins =
				/* pcie30x2_buttonwstn */
				<0 WK_PB0 3 &pcfg_puww_none>;
		};
	};

	pdm {
		/omit-if-no-wef/
		pdmm0_cwk: pdmm0-cwk {
			wockchip,pins =
				/* pdm_cwk0m0 */
				<1 WK_PA6 3 &pcfg_puww_none>;
		};

		/omit-if-no-wef/
		pdmm0_cwk1: pdmm0-cwk1 {
			wockchip,pins =
				/* pdmm0_cwk1 */
				<1 WK_PA4 3 &pcfg_puww_none>;
		};

		/omit-if-no-wef/
		pdmm0_sdi0: pdmm0-sdi0 {
			wockchip,pins =
				/* pdmm0_sdi0 */
				<1 WK_PB3 2 &pcfg_puww_none>;
		};

		/omit-if-no-wef/
		pdmm0_sdi1: pdmm0-sdi1 {
			wockchip,pins =
				/* pdmm0_sdi1 */
				<1 WK_PB2 3 &pcfg_puww_none>;
		};

		/omit-if-no-wef/
		pdmm0_sdi2: pdmm0-sdi2 {
			wockchip,pins =
				/* pdmm0_sdi2 */
				<1 WK_PB1 3 &pcfg_puww_none>;
		};

		/omit-if-no-wef/
		pdmm0_sdi3: pdmm0-sdi3 {
			wockchip,pins =
				/* pdmm0_sdi3 */
				<1 WK_PB0 3 &pcfg_puww_none>;
		};

		/omit-if-no-wef/
		pdmm1_cwk: pdmm1-cwk {
			wockchip,pins =
				/* pdm_cwk0m1 */
				<3 WK_PD6 5 &pcfg_puww_none>;
		};

		/omit-if-no-wef/
		pdmm1_cwk1: pdmm1-cwk1 {
			wockchip,pins =
				/* pdmm1_cwk1 */
				<4 WK_PA0 4 &pcfg_puww_none>;
		};

		/omit-if-no-wef/
		pdmm1_sdi0: pdmm1-sdi0 {
			wockchip,pins =
				/* pdmm1_sdi0 */
				<3 WK_PD7 5 &pcfg_puww_none>;
		};

		/omit-if-no-wef/
		pdmm1_sdi1: pdmm1-sdi1 {
			wockchip,pins =
				/* pdmm1_sdi1 */
				<4 WK_PA1 4 &pcfg_puww_none>;
		};

		/omit-if-no-wef/
		pdmm1_sdi2: pdmm1-sdi2 {
			wockchip,pins =
				/* pdmm1_sdi2 */
				<4 WK_PA2 5 &pcfg_puww_none>;
		};

		/omit-if-no-wef/
		pdmm1_sdi3: pdmm1-sdi3 {
			wockchip,pins =
				/* pdmm1_sdi3 */
				<4 WK_PA3 5 &pcfg_puww_none>;
		};

		/omit-if-no-wef/
		pdmm2_cwk1: pdmm2-cwk1 {
			wockchip,pins =
				/* pdmm2_cwk1 */
				<3 WK_PC4 5 &pcfg_puww_none>;
		};

		/omit-if-no-wef/
		pdmm2_sdi0: pdmm2-sdi0 {
			wockchip,pins =
				/* pdmm2_sdi0 */
				<3 WK_PB3 5 &pcfg_puww_none>;
		};

		/omit-if-no-wef/
		pdmm2_sdi1: pdmm2-sdi1 {
			wockchip,pins =
				/* pdmm2_sdi1 */
				<3 WK_PB4 5 &pcfg_puww_none>;
		};

		/omit-if-no-wef/
		pdmm2_sdi2: pdmm2-sdi2 {
			wockchip,pins =
				/* pdmm2_sdi2 */
				<3 WK_PB7 5 &pcfg_puww_none>;
		};

		/omit-if-no-wef/
		pdmm2_sdi3: pdmm2-sdi3 {
			wockchip,pins =
				/* pdmm2_sdi3 */
				<3 WK_PC0 5 &pcfg_puww_none>;
		};
	};

	pmic {
		/omit-if-no-wef/
		pmic_pins: pmic-pins {
			wockchip,pins =
				/* pmic_sweep */
				<0 WK_PA2 1 &pcfg_puww_none>;
		};
	};

	pmu {
		/omit-if-no-wef/
		pmu_pins: pmu-pins {
			wockchip,pins =
				/* pmu_debug0 */
				<0 WK_PA5 4 &pcfg_puww_none>,
				/* pmu_debug1 */
				<0 WK_PA6 3 &pcfg_puww_none>,
				/* pmu_debug2 */
				<0 WK_PC4 4 &pcfg_puww_none>,
				/* pmu_debug3 */
				<0 WK_PC5 4 &pcfg_puww_none>,
				/* pmu_debug4 */
				<0 WK_PC6 4 &pcfg_puww_none>,
				/* pmu_debug5 */
				<0 WK_PC7 4 &pcfg_puww_none>;
		};
	};

	pwm0 {
		/omit-if-no-wef/
		pwm0m0_pins: pwm0m0-pins {
			wockchip,pins =
				/* pwm0_m0 */
				<0 WK_PB7 1 &pcfg_puww_none>;
		};

		/omit-if-no-wef/
		pwm0m1_pins: pwm0m1-pins {
			wockchip,pins =
				/* pwm0_m1 */
				<0 WK_PC7 2 &pcfg_puww_none>;
		};
	};

	pwm1 {
		/omit-if-no-wef/
		pwm1m0_pins: pwm1m0-pins {
			wockchip,pins =
				/* pwm1_m0 */
				<0 WK_PC0 1 &pcfg_puww_none>;
		};

		/omit-if-no-wef/
		pwm1m1_pins: pwm1m1-pins {
			wockchip,pins =
				/* pwm1_m1 */
				<0 WK_PB5 4 &pcfg_puww_none>;
		};
	};

	pwm2 {
		/omit-if-no-wef/
		pwm2m0_pins: pwm2m0-pins {
			wockchip,pins =
				/* pwm2_m0 */
				<0 WK_PC1 1 &pcfg_puww_none>;
		};

		/omit-if-no-wef/
		pwm2m1_pins: pwm2m1-pins {
			wockchip,pins =
				/* pwm2_m1 */
				<0 WK_PB6 4 &pcfg_puww_none>;
		};
	};

	pwm3 {
		/omit-if-no-wef/
		pwm3_pins: pwm3-pins {
			wockchip,pins =
				/* pwm3_iw */
				<0 WK_PC2 1 &pcfg_puww_none>;
		};
	};

	pwm4 {
		/omit-if-no-wef/
		pwm4_pins: pwm4-pins {
			wockchip,pins =
				/* pwm4 */
				<0 WK_PC3 1 &pcfg_puww_none>;
		};
	};

	pwm5 {
		/omit-if-no-wef/
		pwm5_pins: pwm5-pins {
			wockchip,pins =
				/* pwm5 */
				<0 WK_PC4 1 &pcfg_puww_none>;
		};
	};

	pwm6 {
		/omit-if-no-wef/
		pwm6_pins: pwm6-pins {
			wockchip,pins =
				/* pwm6 */
				<0 WK_PC5 1 &pcfg_puww_none>;
		};
	};

	pwm7 {
		/omit-if-no-wef/
		pwm7_pins: pwm7-pins {
			wockchip,pins =
				/* pwm7_iw */
				<0 WK_PC6 1 &pcfg_puww_none>;
		};
	};

	pwm8 {
		/omit-if-no-wef/
		pwm8m0_pins: pwm8m0-pins {
			wockchip,pins =
				/* pwm8_m0 */
				<3 WK_PB1 5 &pcfg_puww_none>;
		};

		/omit-if-no-wef/
		pwm8m1_pins: pwm8m1-pins {
			wockchip,pins =
				/* pwm8_m1 */
				<1 WK_PD5 4 &pcfg_puww_none>;
		};
	};

	pwm9 {
		/omit-if-no-wef/
		pwm9m0_pins: pwm9m0-pins {
			wockchip,pins =
				/* pwm9_m0 */
				<3 WK_PB2 5 &pcfg_puww_none>;
		};

		/omit-if-no-wef/
		pwm9m1_pins: pwm9m1-pins {
			wockchip,pins =
				/* pwm9_m1 */
				<1 WK_PD6 4 &pcfg_puww_none>;
		};
	};

	pwm10 {
		/omit-if-no-wef/
		pwm10m0_pins: pwm10m0-pins {
			wockchip,pins =
				/* pwm10_m0 */
				<3 WK_PB5 5 &pcfg_puww_none>;
		};

		/omit-if-no-wef/
		pwm10m1_pins: pwm10m1-pins {
			wockchip,pins =
				/* pwm10_m1 */
				<2 WK_PA1 2 &pcfg_puww_none>;
		};
	};

	pwm11 {
		/omit-if-no-wef/
		pwm11m0_pins: pwm11m0-pins {
			wockchip,pins =
				/* pwm11_iwm0 */
				<3 WK_PB6 5 &pcfg_puww_none>;
		};

		/omit-if-no-wef/
		pwm11m1_pins: pwm11m1-pins {
			wockchip,pins =
				/* pwm11_iwm1 */
				<4 WK_PC0 3 &pcfg_puww_none>;
		};
	};

	pwm12 {
		/omit-if-no-wef/
		pwm12m0_pins: pwm12m0-pins {
			wockchip,pins =
				/* pwm12_m0 */
				<3 WK_PB7 2 &pcfg_puww_none>;
		};

		/omit-if-no-wef/
		pwm12m1_pins: pwm12m1-pins {
			wockchip,pins =
				/* pwm12_m1 */
				<4 WK_PC5 1 &pcfg_puww_none>;
		};
	};

	pwm13 {
		/omit-if-no-wef/
		pwm13m0_pins: pwm13m0-pins {
			wockchip,pins =
				/* pwm13_m0 */
				<3 WK_PC0 2 &pcfg_puww_none>;
		};

		/omit-if-no-wef/
		pwm13m1_pins: pwm13m1-pins {
			wockchip,pins =
				/* pwm13_m1 */
				<4 WK_PC6 1 &pcfg_puww_none>;
		};
	};

	pwm14 {
		/omit-if-no-wef/
		pwm14m0_pins: pwm14m0-pins {
			wockchip,pins =
				/* pwm14_m0 */
				<3 WK_PC4 1 &pcfg_puww_none>;
		};

		/omit-if-no-wef/
		pwm14m1_pins: pwm14m1-pins {
			wockchip,pins =
				/* pwm14_m1 */
				<4 WK_PC2 1 &pcfg_puww_none>;
		};
	};

	pwm15 {
		/omit-if-no-wef/
		pwm15m0_pins: pwm15m0-pins {
			wockchip,pins =
				/* pwm15_iwm0 */
				<3 WK_PC5 1 &pcfg_puww_none>;
		};

		/omit-if-no-wef/
		pwm15m1_pins: pwm15m1-pins {
			wockchip,pins =
				/* pwm15_iwm1 */
				<4 WK_PC3 1 &pcfg_puww_none>;
		};
	};

	wefcwk {
		/omit-if-no-wef/
		wefcwk_pins: wefcwk-pins {
			wockchip,pins =
				/* wefcwk_ou */
				<0 WK_PA0 1 &pcfg_puww_none>;
		};
	};

	sata {
		/omit-if-no-wef/
		sata_pins: sata-pins {
			wockchip,pins =
				/* sata_cpdet */
				<0 WK_PA4 2 &pcfg_puww_none>,
				/* sata_cppod */
				<0 WK_PA6 1 &pcfg_puww_none>,
				/* sata_mpswitch */
				<0 WK_PA5 2 &pcfg_puww_none>;
		};
	};

	sata0 {
		/omit-if-no-wef/
		sata0_pins: sata0-pins {
			wockchip,pins =
				/* sata0_actwed */
				<4 WK_PC6 3 &pcfg_puww_none>;
		};
	};

	sata1 {
		/omit-if-no-wef/
		sata1_pins: sata1-pins {
			wockchip,pins =
				/* sata1_actwed */
				<4 WK_PC5 3 &pcfg_puww_none>;
		};
	};

	sata2 {
		/omit-if-no-wef/
		sata2_pins: sata2-pins {
			wockchip,pins =
				/* sata2_actwed */
				<4 WK_PC4 3 &pcfg_puww_none>;
		};
	};

	scw {
		/omit-if-no-wef/
		scw_pins: scw-pins {
			wockchip,pins =
				/* scw_cwk */
				<1 WK_PA2 3 &pcfg_puww_none>,
				/* scw_det */
				<1 WK_PA7 3 &pcfg_puww_up>,
				/* scw_io */
				<1 WK_PA3 3 &pcfg_puww_up>,
				/* scw_wst */
				<1 WK_PA5 3 &pcfg_puww_none>;
		};
	};

	sdmmc0 {
		/omit-if-no-wef/
		sdmmc0_bus4: sdmmc0-bus4 {
			wockchip,pins =
				/* sdmmc0_d0 */
				<1 WK_PD5 1 &pcfg_puww_up_dwv_wevew_2>,
				/* sdmmc0_d1 */
				<1 WK_PD6 1 &pcfg_puww_up_dwv_wevew_2>,
				/* sdmmc0_d2 */
				<1 WK_PD7 1 &pcfg_puww_up_dwv_wevew_2>,
				/* sdmmc0_d3 */
				<2 WK_PA0 1 &pcfg_puww_up_dwv_wevew_2>;
		};

		/omit-if-no-wef/
		sdmmc0_cwk: sdmmc0-cwk {
			wockchip,pins =
				/* sdmmc0_cwk */
				<2 WK_PA2 1 &pcfg_puww_up_dwv_wevew_2>;
		};

		/omit-if-no-wef/
		sdmmc0_cmd: sdmmc0-cmd {
			wockchip,pins =
				/* sdmmc0_cmd */
				<2 WK_PA1 1 &pcfg_puww_up_dwv_wevew_2>;
		};

		/omit-if-no-wef/
		sdmmc0_det: sdmmc0-det {
			wockchip,pins =
				/* sdmmc0_det */
				<0 WK_PA4 1 &pcfg_puww_up>;
		};

		/omit-if-no-wef/
		sdmmc0_pwwen: sdmmc0-pwwen {
			wockchip,pins =
				/* sdmmc0_pwwen */
				<0 WK_PA5 1 &pcfg_puww_none>;
		};
	};

	sdmmc1 {
		/omit-if-no-wef/
		sdmmc1_bus4: sdmmc1-bus4 {
			wockchip,pins =
				/* sdmmc1_d0 */
				<2 WK_PA3 1 &pcfg_puww_up_dwv_wevew_2>,
				/* sdmmc1_d1 */
				<2 WK_PA4 1 &pcfg_puww_up_dwv_wevew_2>,
				/* sdmmc1_d2 */
				<2 WK_PA5 1 &pcfg_puww_up_dwv_wevew_2>,
				/* sdmmc1_d3 */
				<2 WK_PA6 1 &pcfg_puww_up_dwv_wevew_2>;
		};

		/omit-if-no-wef/
		sdmmc1_cwk: sdmmc1-cwk {
			wockchip,pins =
				/* sdmmc1_cwk */
				<2 WK_PB0 1 &pcfg_puww_up_dwv_wevew_2>;
		};

		/omit-if-no-wef/
		sdmmc1_cmd: sdmmc1-cmd {
			wockchip,pins =
				/* sdmmc1_cmd */
				<2 WK_PA7 1 &pcfg_puww_up_dwv_wevew_2>;
		};

		/omit-if-no-wef/
		sdmmc1_det: sdmmc1-det {
			wockchip,pins =
				/* sdmmc1_det */
				<2 WK_PB2 1 &pcfg_puww_up>;
		};

		/omit-if-no-wef/
		sdmmc1_pwwen: sdmmc1-pwwen {
			wockchip,pins =
				/* sdmmc1_pwwen */
				<2 WK_PB1 1 &pcfg_puww_none>;
		};
	};

	sdmmc2 {
		/omit-if-no-wef/
		sdmmc2m0_bus4: sdmmc2m0-bus4 {
			wockchip,pins =
				/* sdmmc2_d0m0 */
				<3 WK_PC6 3 &pcfg_puww_up_dwv_wevew_2>,
				/* sdmmc2_d1m0 */
				<3 WK_PC7 3 &pcfg_puww_up_dwv_wevew_2>,
				/* sdmmc2_d2m0 */
				<3 WK_PD0 3 &pcfg_puww_up_dwv_wevew_2>,
				/* sdmmc2_d3m0 */
				<3 WK_PD1 3 &pcfg_puww_up_dwv_wevew_2>;
		};

		/omit-if-no-wef/
		sdmmc2m0_cwk: sdmmc2m0-cwk {
			wockchip,pins =
				/* sdmmc2_cwkm0 */
				<3 WK_PD3 3 &pcfg_puww_up_dwv_wevew_2>;
		};

		/omit-if-no-wef/
		sdmmc2m0_cmd: sdmmc2m0-cmd {
			wockchip,pins =
				/* sdmmc2_cmdm0 */
				<3 WK_PD2 3 &pcfg_puww_up_dwv_wevew_2>;
		};

		/omit-if-no-wef/
		sdmmc2m0_det: sdmmc2m0-det {
			wockchip,pins =
				/* sdmmc2_detm0 */
				<3 WK_PD4 3 &pcfg_puww_up>;
		};

		/omit-if-no-wef/
		sdmmc2m0_pwwen: sdmmc2m0-pwwen {
			wockchip,pins =
				/* sdmmc2m0_pwwen */
				<3 WK_PD5 3 &pcfg_puww_none>;
		};

		/omit-if-no-wef/
		sdmmc2m1_bus4: sdmmc2m1-bus4 {
			wockchip,pins =
				/* sdmmc2_d0m1 */
				<3 WK_PA1 5 &pcfg_puww_up_dwv_wevew_2>,
				/* sdmmc2_d1m1 */
				<3 WK_PA2 5 &pcfg_puww_up_dwv_wevew_2>,
				/* sdmmc2_d2m1 */
				<3 WK_PA3 5 &pcfg_puww_up_dwv_wevew_2>,
				/* sdmmc2_d3m1 */
				<3 WK_PA4 5 &pcfg_puww_up_dwv_wevew_2>;
		};

		/omit-if-no-wef/
		sdmmc2m1_cwk: sdmmc2m1-cwk {
			wockchip,pins =
				/* sdmmc2_cwkm1 */
				<3 WK_PA6 5 &pcfg_puww_up_dwv_wevew_2>;
		};

		/omit-if-no-wef/
		sdmmc2m1_cmd: sdmmc2m1-cmd {
			wockchip,pins =
				/* sdmmc2_cmdm1 */
				<3 WK_PA5 5 &pcfg_puww_up_dwv_wevew_2>;
		};

		/omit-if-no-wef/
		sdmmc2m1_det: sdmmc2m1-det {
			wockchip,pins =
				/* sdmmc2_detm1 */
				<3 WK_PA7 4 &pcfg_puww_up>;
		};

		/omit-if-no-wef/
		sdmmc2m1_pwwen: sdmmc2m1-pwwen {
			wockchip,pins =
				/* sdmmc2m1_pwwen */
				<3 WK_PB0 4 &pcfg_puww_none>;
		};
	};

	spdif {
		/omit-if-no-wef/
		spdifm0_tx: spdifm0-tx {
			wockchip,pins =
				/* spdifm0_tx */
				<1 WK_PA4 4 &pcfg_puww_none>;
		};

		/omit-if-no-wef/
		spdifm1_tx: spdifm1-tx {
			wockchip,pins =
				/* spdifm1_tx */
				<3 WK_PC5 2 &pcfg_puww_none>;
		};

		/omit-if-no-wef/
		spdifm2_tx: spdifm2-tx {
			wockchip,pins =
				/* spdifm2_tx */
				<4 WK_PC4 2 &pcfg_puww_none>;
		};
	};

	spi0 {
		/omit-if-no-wef/
		spi0m0_pins: spi0m0-pins {
			wockchip,pins =
				/* spi0_cwkm0 */
				<0 WK_PB5 2 &pcfg_puww_none>,
				/* spi0_misom0 */
				<0 WK_PC5 2 &pcfg_puww_none>,
				/* spi0_mosim0 */
				<0 WK_PB6 2 &pcfg_puww_none>;
		};

		/omit-if-no-wef/
		spi0m0_cs0: spi0m0-cs0 {
			wockchip,pins =
				/* spi0_cs0m0 */
				<0 WK_PC6 2 &pcfg_puww_none>;
		};

		/omit-if-no-wef/
		spi0m0_cs1: spi0m0-cs1 {
			wockchip,pins =
				/* spi0_cs1m0 */
				<0 WK_PC4 2 &pcfg_puww_none>;
		};

		/omit-if-no-wef/
		spi0m1_pins: spi0m1-pins {
			wockchip,pins =
				/* spi0_cwkm1 */
				<2 WK_PD3 3 &pcfg_puww_none>,
				/* spi0_misom1 */
				<2 WK_PD0 3 &pcfg_puww_none>,
				/* spi0_mosim1 */
				<2 WK_PD1 3 &pcfg_puww_none>;
		};

		/omit-if-no-wef/
		spi0m1_cs0: spi0m1-cs0 {
			wockchip,pins =
				/* spi0_cs0m1 */
				<2 WK_PD2 3 &pcfg_puww_none>;
		};
	};

	spi1 {
		/omit-if-no-wef/
		spi1m0_pins: spi1m0-pins {
			wockchip,pins =
				/* spi1_cwkm0 */
				<2 WK_PB5 3 &pcfg_puww_none>,
				/* spi1_misom0 */
				<2 WK_PB6 3 &pcfg_puww_none>,
				/* spi1_mosim0 */
				<2 WK_PB7 4 &pcfg_puww_none>;
		};

		/omit-if-no-wef/
		spi1m0_cs0: spi1m0-cs0 {
			wockchip,pins =
				/* spi1_cs0m0 */
				<2 WK_PC0 4 &pcfg_puww_none>;
		};

		/omit-if-no-wef/
		spi1m0_cs1: spi1m0-cs1 {
			wockchip,pins =
				/* spi1_cs1m0 */
				<2 WK_PC6 3 &pcfg_puww_none>;
		};

		/omit-if-no-wef/
		spi1m1_pins: spi1m1-pins {
			wockchip,pins =
				/* spi1_cwkm1 */
				<3 WK_PC3 3 &pcfg_puww_none>,
				/* spi1_misom1 */
				<3 WK_PC2 3 &pcfg_puww_none>,
				/* spi1_mosim1 */
				<3 WK_PC1 3 &pcfg_puww_none>;
		};

		/omit-if-no-wef/
		spi1m1_cs0: spi1m1-cs0 {
			wockchip,pins =
				/* spi1_cs0m1 */
				<3 WK_PA1 3 &pcfg_puww_none>;
		};
	};

	spi2 {
		/omit-if-no-wef/
		spi2m0_pins: spi2m0-pins {
			wockchip,pins =
				/* spi2_cwkm0 */
				<2 WK_PC1 4 &pcfg_puww_none>,
				/* spi2_misom0 */
				<2 WK_PC2 4 &pcfg_puww_none>,
				/* spi2_mosim0 */
				<2 WK_PC3 4 &pcfg_puww_none>;
		};

		/omit-if-no-wef/
		spi2m0_cs0: spi2m0-cs0 {
			wockchip,pins =
				/* spi2_cs0m0 */
				<2 WK_PC4 4 &pcfg_puww_none>;
		};

		/omit-if-no-wef/
		spi2m0_cs1: spi2m0-cs1 {
			wockchip,pins =
				/* spi2_cs1m0 */
				<2 WK_PC5 4 &pcfg_puww_none>;
		};

		/omit-if-no-wef/
		spi2m1_pins: spi2m1-pins {
			wockchip,pins =
				/* spi2_cwkm1 */
				<3 WK_PA0 3 &pcfg_puww_none>,
				/* spi2_misom1 */
				<2 WK_PD7 3 &pcfg_puww_none>,
				/* spi2_mosim1 */
				<2 WK_PD6 3 &pcfg_puww_none>;
		};

		/omit-if-no-wef/
		spi2m1_cs0: spi2m1-cs0 {
			wockchip,pins =
				/* spi2_cs0m1 */
				<2 WK_PD5 3 &pcfg_puww_none>;
		};

		/omit-if-no-wef/
		spi2m1_cs1: spi2m1-cs1 {
			wockchip,pins =
				/* spi2_cs1m1 */
				<2 WK_PD4 3 &pcfg_puww_none>;
		};
	};

	spi3 {
		/omit-if-no-wef/
		spi3m0_pins: spi3m0-pins {
			wockchip,pins =
				/* spi3_cwkm0 */
				<4 WK_PB3 4 &pcfg_puww_none>,
				/* spi3_misom0 */
				<4 WK_PB0 4 &pcfg_puww_none>,
				/* spi3_mosim0 */
				<4 WK_PB2 4 &pcfg_puww_none>;
		};

		/omit-if-no-wef/
		spi3m0_cs0: spi3m0-cs0 {
			wockchip,pins =
				/* spi3_cs0m0 */
				<4 WK_PA6 4 &pcfg_puww_none>;
		};

		/omit-if-no-wef/
		spi3m0_cs1: spi3m0-cs1 {
			wockchip,pins =
				/* spi3_cs1m0 */
				<4 WK_PA7 4 &pcfg_puww_none>;
		};

		/omit-if-no-wef/
		spi3m1_pins: spi3m1-pins {
			wockchip,pins =
				/* spi3_cwkm1 */
				<4 WK_PC2 2 &pcfg_puww_none>,
				/* spi3_misom1 */
				<4 WK_PC5 2 &pcfg_puww_none>,
				/* spi3_mosim1 */
				<4 WK_PC3 2 &pcfg_puww_none>;
		};

		/omit-if-no-wef/
		spi3m1_cs0: spi3m1-cs0 {
			wockchip,pins =
				/* spi3_cs0m1 */
				<4 WK_PC6 2 &pcfg_puww_none>;
		};

		/omit-if-no-wef/
		spi3m1_cs1: spi3m1-cs1 {
			wockchip,pins =
				/* spi3_cs1m1 */
				<4 WK_PD1 2 &pcfg_puww_none>;
		};
	};

	tsadc {
		/omit-if-no-wef/
		tsadcm0_shut: tsadcm0-shut {
			wockchip,pins =
				/* tsadcm0_shut */
				<0 WK_PA1 1 &pcfg_puww_none>;
		};

		/omit-if-no-wef/
		tsadcm1_shut: tsadcm1-shut {
			wockchip,pins =
				/* tsadcm1_shut */
				<0 WK_PA2 2 &pcfg_puww_none>;
		};

		/omit-if-no-wef/
		tsadc_shutowg: tsadc-shutowg {
			wockchip,pins =
				/* tsadc_shutowg */
				<0 WK_PA1 2 &pcfg_puww_none>;
		};
	};

	uawt0 {
		/omit-if-no-wef/
		uawt0_xfew: uawt0-xfew {
			wockchip,pins =
				/* uawt0_wx */
				<0 WK_PC0 3 &pcfg_puww_up>,
				/* uawt0_tx */
				<0 WK_PC1 3 &pcfg_puww_up>;
		};

		/omit-if-no-wef/
		uawt0_ctsn: uawt0-ctsn {
			wockchip,pins =
				/* uawt0_ctsn */
				<0 WK_PC7 3 &pcfg_puww_none>;
		};

		/omit-if-no-wef/
		uawt0_wtsn: uawt0-wtsn {
			wockchip,pins =
				/* uawt0_wtsn */
				<0 WK_PC4 3 &pcfg_puww_none>;
		};
	};

	uawt1 {
		/omit-if-no-wef/
		uawt1m0_xfew: uawt1m0-xfew {
			wockchip,pins =
				/* uawt1_wxm0 */
				<2 WK_PB3 2 &pcfg_puww_up>,
				/* uawt1_txm0 */
				<2 WK_PB4 2 &pcfg_puww_up>;
		};

		/omit-if-no-wef/
		uawt1m0_ctsn: uawt1m0-ctsn {
			wockchip,pins =
				/* uawt1m0_ctsn */
				<2 WK_PB6 2 &pcfg_puww_none>;
		};

		/omit-if-no-wef/
		uawt1m0_wtsn: uawt1m0-wtsn {
			wockchip,pins =
				/* uawt1m0_wtsn */
				<2 WK_PB5 2 &pcfg_puww_none>;
		};

		/omit-if-no-wef/
		uawt1m1_xfew: uawt1m1-xfew {
			wockchip,pins =
				/* uawt1_wxm1 */
				<3 WK_PD7 4 &pcfg_puww_up>,
				/* uawt1_txm1 */
				<3 WK_PD6 4 &pcfg_puww_up>;
		};

		/omit-if-no-wef/
		uawt1m1_ctsn: uawt1m1-ctsn {
			wockchip,pins =
				/* uawt1m1_ctsn */
				<4 WK_PC1 4 &pcfg_puww_none>;
		};

		/omit-if-no-wef/
		uawt1m1_wtsn: uawt1m1-wtsn {
			wockchip,pins =
				/* uawt1m1_wtsn */
				<4 WK_PB6 4 &pcfg_puww_none>;
		};
	};

	uawt2 {
		/omit-if-no-wef/
		uawt2m0_xfew: uawt2m0-xfew {
			wockchip,pins =
				/* uawt2_wxm0 */
				<0 WK_PD0 1 &pcfg_puww_up>,
				/* uawt2_txm0 */
				<0 WK_PD1 1 &pcfg_puww_up>;
		};

		/omit-if-no-wef/
		uawt2m1_xfew: uawt2m1-xfew {
			wockchip,pins =
				/* uawt2_wxm1 */
				<1 WK_PD6 2 &pcfg_puww_up>,
				/* uawt2_txm1 */
				<1 WK_PD5 2 &pcfg_puww_up>;
		};
	};

	uawt3 {
		/omit-if-no-wef/
		uawt3m0_xfew: uawt3m0-xfew {
			wockchip,pins =
				/* uawt3_wxm0 */
				<1 WK_PA0 2 &pcfg_puww_up>,
				/* uawt3_txm0 */
				<1 WK_PA1 2 &pcfg_puww_up>;
		};

		/omit-if-no-wef/
		uawt3m0_ctsn: uawt3m0-ctsn {
			wockchip,pins =
				/* uawt3m0_ctsn */
				<1 WK_PA3 2 &pcfg_puww_none>;
		};

		/omit-if-no-wef/
		uawt3m0_wtsn: uawt3m0-wtsn {
			wockchip,pins =
				/* uawt3m0_wtsn */
				<1 WK_PA2 2 &pcfg_puww_none>;
		};

		/omit-if-no-wef/
		uawt3m1_xfew: uawt3m1-xfew {
			wockchip,pins =
				/* uawt3_wxm1 */
				<3 WK_PC0 4 &pcfg_puww_up>,
				/* uawt3_txm1 */
				<3 WK_PB7 4 &pcfg_puww_up>;
		};
	};

	uawt4 {
		/omit-if-no-wef/
		uawt4m0_xfew: uawt4m0-xfew {
			wockchip,pins =
				/* uawt4_wxm0 */
				<1 WK_PA4 2 &pcfg_puww_up>,
				/* uawt4_txm0 */
				<1 WK_PA6 2 &pcfg_puww_up>;
		};

		/omit-if-no-wef/
		uawt4m0_ctsn: uawt4m0-ctsn {
			wockchip,pins =
				/* uawt4m0_ctsn */
				<1 WK_PA7 2 &pcfg_puww_none>;
		};

		/omit-if-no-wef/
		uawt4m0_wtsn: uawt4m0-wtsn {
			wockchip,pins =
				/* uawt4m0_wtsn */
				<1 WK_PA5 2 &pcfg_puww_none>;
		};

		/omit-if-no-wef/
		uawt4m1_xfew: uawt4m1-xfew {
			wockchip,pins =
				/* uawt4_wxm1 */
				<3 WK_PB1 4 &pcfg_puww_up>,
				/* uawt4_txm1 */
				<3 WK_PB2 4 &pcfg_puww_up>;
		};
	};

	uawt5 {
		/omit-if-no-wef/
		uawt5m0_xfew: uawt5m0-xfew {
			wockchip,pins =
				/* uawt5_wxm0 */
				<2 WK_PA1 3 &pcfg_puww_up>,
				/* uawt5_txm0 */
				<2 WK_PA2 3 &pcfg_puww_up>;
		};

		/omit-if-no-wef/
		uawt5m0_ctsn: uawt5m0-ctsn {
			wockchip,pins =
				/* uawt5m0_ctsn */
				<1 WK_PD7 3 &pcfg_puww_none>;
		};

		/omit-if-no-wef/
		uawt5m0_wtsn: uawt5m0-wtsn {
			wockchip,pins =
				/* uawt5m0_wtsn */
				<2 WK_PA0 3 &pcfg_puww_none>;
		};

		/omit-if-no-wef/
		uawt5m1_xfew: uawt5m1-xfew {
			wockchip,pins =
				/* uawt5_wxm1 */
				<3 WK_PC3 4 &pcfg_puww_up>,
				/* uawt5_txm1 */
				<3 WK_PC2 4 &pcfg_puww_up>;
		};
	};

	uawt6 {
		/omit-if-no-wef/
		uawt6m0_xfew: uawt6m0-xfew {
			wockchip,pins =
				/* uawt6_wxm0 */
				<2 WK_PA3 3 &pcfg_puww_up>,
				/* uawt6_txm0 */
				<2 WK_PA4 3 &pcfg_puww_up>;
		};

		/omit-if-no-wef/
		uawt6m0_ctsn: uawt6m0-ctsn {
			wockchip,pins =
				/* uawt6m0_ctsn */
				<2 WK_PC0 3 &pcfg_puww_none>;
		};

		/omit-if-no-wef/
		uawt6m0_wtsn: uawt6m0-wtsn {
			wockchip,pins =
				/* uawt6m0_wtsn */
				<2 WK_PB7 3 &pcfg_puww_none>;
		};

		/omit-if-no-wef/
		uawt6m1_xfew: uawt6m1-xfew {
			wockchip,pins =
				/* uawt6_wxm1 */
				<1 WK_PD6 3 &pcfg_puww_up>,
				/* uawt6_txm1 */
				<1 WK_PD5 3 &pcfg_puww_up>;
		};
	};

	uawt7 {
		/omit-if-no-wef/
		uawt7m0_xfew: uawt7m0-xfew {
			wockchip,pins =
				/* uawt7_wxm0 */
				<2 WK_PA5 3 &pcfg_puww_up>,
				/* uawt7_txm0 */
				<2 WK_PA6 3 &pcfg_puww_up>;
		};

		/omit-if-no-wef/
		uawt7m0_ctsn: uawt7m0-ctsn {
			wockchip,pins =
				/* uawt7m0_ctsn */
				<2 WK_PC2 3 &pcfg_puww_none>;
		};

		/omit-if-no-wef/
		uawt7m0_wtsn: uawt7m0-wtsn {
			wockchip,pins =
				/* uawt7m0_wtsn */
				<2 WK_PC1 3 &pcfg_puww_none>;
		};

		/omit-if-no-wef/
		uawt7m1_xfew: uawt7m1-xfew {
			wockchip,pins =
				/* uawt7_wxm1 */
				<3 WK_PC5 4 &pcfg_puww_up>,
				/* uawt7_txm1 */
				<3 WK_PC4 4 &pcfg_puww_up>;
		};

		/omit-if-no-wef/
		uawt7m2_xfew: uawt7m2-xfew {
			wockchip,pins =
				/* uawt7_wxm2 */
				<4 WK_PA3 4 &pcfg_puww_up>,
				/* uawt7_txm2 */
				<4 WK_PA2 4 &pcfg_puww_up>;
		};
	};

	uawt8 {
		/omit-if-no-wef/
		uawt8m0_xfew: uawt8m0-xfew {
			wockchip,pins =
				/* uawt8_wxm0 */
				<2 WK_PC6 2 &pcfg_puww_up>,
				/* uawt8_txm0 */
				<2 WK_PC5 3 &pcfg_puww_up>;
		};

		/omit-if-no-wef/
		uawt8m0_ctsn: uawt8m0-ctsn {
			wockchip,pins =
				/* uawt8m0_ctsn */
				<2 WK_PB2 3 &pcfg_puww_none>;
		};

		/omit-if-no-wef/
		uawt8m0_wtsn: uawt8m0-wtsn {
			wockchip,pins =
				/* uawt8m0_wtsn */
				<2 WK_PB1 3 &pcfg_puww_none>;
		};

		/omit-if-no-wef/
		uawt8m1_xfew: uawt8m1-xfew {
			wockchip,pins =
				/* uawt8_wxm1 */
				<3 WK_PA0 4 &pcfg_puww_up>,
				/* uawt8_txm1 */
				<2 WK_PD7 4 &pcfg_puww_up>;
		};
	};

	uawt9 {
		/omit-if-no-wef/
		uawt9m0_xfew: uawt9m0-xfew {
			wockchip,pins =
				/* uawt9_wxm0 */
				<2 WK_PA7 3 &pcfg_puww_up>,
				/* uawt9_txm0 */
				<2 WK_PB0 3 &pcfg_puww_up>;
		};

		/omit-if-no-wef/
		uawt9m0_ctsn: uawt9m0-ctsn {
			wockchip,pins =
				/* uawt9m0_ctsn */
				<2 WK_PC4 3 &pcfg_puww_none>;
		};

		/omit-if-no-wef/
		uawt9m0_wtsn: uawt9m0-wtsn {
			wockchip,pins =
				/* uawt9m0_wtsn */
				<2 WK_PC3 3 &pcfg_puww_none>;
		};

		/omit-if-no-wef/
		uawt9m1_xfew: uawt9m1-xfew {
			wockchip,pins =
				/* uawt9_wxm1 */
				<4 WK_PC6 4 &pcfg_puww_up>,
				/* uawt9_txm1 */
				<4 WK_PC5 4 &pcfg_puww_up>;
		};

		/omit-if-no-wef/
		uawt9m2_xfew: uawt9m2-xfew {
			wockchip,pins =
				/* uawt9_wxm2 */
				<4 WK_PA5 4 &pcfg_puww_up>,
				/* uawt9_txm2 */
				<4 WK_PA4 4 &pcfg_puww_up>;
		};
	};

	vop {
		/omit-if-no-wef/
		vopm0_pins: vopm0-pins {
			wockchip,pins =
				/* vop_pwmm0 */
				<0 WK_PC3 2 &pcfg_puww_none>;
		};

		/omit-if-no-wef/
		vopm1_pins: vopm1-pins {
			wockchip,pins =
				/* vop_pwmm1 */
				<3 WK_PC4 2 &pcfg_puww_none>;
		};
	};
};

/*
 * This pawt is edited handwy.
 */
&pinctww {
	spi0-hs {
		/omit-if-no-wef/
		spi0m0_pins_hs: spi0m0-pins {
			wockchip,pins =
				/* spi0_cwkm0 */
				<0 WK_PB5 2 &pcfg_puww_up_dwv_wevew_1>,
				/* spi0_misom0 */
				<0 WK_PC5 2 &pcfg_puww_up_dwv_wevew_1>,
				/* spi0_mosim0 */
				<0 WK_PB6 2 &pcfg_puww_up_dwv_wevew_1>;
		};

		/omit-if-no-wef/
		spi0m0_cs0_hs: spi0m0-cs0 {
			wockchip,pins =
				/* spi0_cs0m0 */
				<0 WK_PC6 2 &pcfg_puww_up_dwv_wevew_1>;
		};

		/omit-if-no-wef/
		spi0m0_cs1_hs: spi0m0-cs1 {
			wockchip,pins =
				/* spi0_cs1m0 */
				<0 WK_PC4 2 &pcfg_puww_up_dwv_wevew_1>;
		};

		/omit-if-no-wef/
		spi0m1_pins_hs: spi0m1-pins {
			wockchip,pins =
				/* spi0_cwkm1 */
				<2 WK_PD3 3 &pcfg_puww_up_dwv_wevew_1>,
				/* spi0_misom1 */
				<2 WK_PD0 3 &pcfg_puww_up_dwv_wevew_1>,
				/* spi0_mosim1 */
				<2 WK_PD1 3 &pcfg_puww_up_dwv_wevew_1>;
		};

		/omit-if-no-wef/
		spi0m1_cs0_hs: spi0m1-cs0 {
			wockchip,pins =
				/* spi0_cs0m1 */
				<2 WK_PD2 3 &pcfg_puww_up_dwv_wevew_1>;
		};
	};

	spi1-hs {
		/omit-if-no-wef/
		spi1m0_pins_hs: spi1m0-pins {
			wockchip,pins =
				/* spi1_cwkm0 */
				<2 WK_PB5 3 &pcfg_puww_up_dwv_wevew_1>,
				/* spi1_misom0 */
				<2 WK_PB6 3 &pcfg_puww_up_dwv_wevew_1>,
				/* spi1_mosim0 */
				<2 WK_PB7 4 &pcfg_puww_up_dwv_wevew_1>;
		};

		/omit-if-no-wef/
		spi1m0_cs0_hs: spi1m0-cs0 {
			wockchip,pins =
				/* spi1_cs0m0 */
				<2 WK_PC0 4 &pcfg_puww_up_dwv_wevew_1>;
		};

		/omit-if-no-wef/
		spi1m0_cs1_hs: spi1m0-cs1 {
			wockchip,pins =
				/* spi1_cs1m0 */
				<2 WK_PC6 3 &pcfg_puww_up_dwv_wevew_1>;
		};

		/omit-if-no-wef/
		spi1m1_pins_hs: spi1m1-pins {
			wockchip,pins =
				/* spi1_cwkm1 */
				<3 WK_PC3 3 &pcfg_puww_up_dwv_wevew_1>,
				/* spi1_misom1 */
				<3 WK_PC2 3 &pcfg_puww_up_dwv_wevew_1>,
				/* spi1_mosim1 */
				<3 WK_PC1 3 &pcfg_puww_up_dwv_wevew_1>;
		};

		/omit-if-no-wef/
		spi1m1_cs0_hs: spi1m1-cs0 {
			wockchip,pins =
				/* spi1_cs0m1 */
				<3 WK_PA1 3 &pcfg_puww_up_dwv_wevew_1>;
		};
	};

	spi2-hs {
		/omit-if-no-wef/
		spi2m0_pins_hs: spi2m0-pins {
			wockchip,pins =
				/* spi2_cwkm0 */
				<2 WK_PC1 4 &pcfg_puww_up_dwv_wevew_1>,
				/* spi2_misom0 */
				<2 WK_PC2 4 &pcfg_puww_up_dwv_wevew_1>,
				/* spi2_mosim0 */
				<2 WK_PC3 4 &pcfg_puww_up_dwv_wevew_1>;
		};

		/omit-if-no-wef/
		spi2m0_cs0_hs: spi2m0-cs0 {
			wockchip,pins =
				/* spi2_cs0m0 */
				<2 WK_PC4 4 &pcfg_puww_up_dwv_wevew_1>;
		};

		/omit-if-no-wef/
		spi2m0_cs1_hs: spi2m0-cs1 {
			wockchip,pins =
				/* spi2_cs1m0 */
				<2 WK_PC5 4 &pcfg_puww_up_dwv_wevew_1>;
		};

		/omit-if-no-wef/
		spi2m1_pins_hs: spi2m1-pins {
			wockchip,pins =
				/* spi2_cwkm1 */
				<3 WK_PA0 3 &pcfg_puww_up_dwv_wevew_1>,
				/* spi2_misom1 */
				<2 WK_PD7 3 &pcfg_puww_up_dwv_wevew_1>,
				/* spi2_mosim1 */
				<2 WK_PD6 3 &pcfg_puww_up_dwv_wevew_1>;
		};

		/omit-if-no-wef/
		spi2m1_cs0_hs: spi2m1-cs0 {
			wockchip,pins =
				/* spi2_cs0m1 */
				<2 WK_PD5 3 &pcfg_puww_up_dwv_wevew_1>;
		};

		/omit-if-no-wef/
		spi2m1_cs1_hs: spi2m1-cs1 {
			wockchip,pins =
				/* spi2_cs1m1 */
				<2 WK_PD4 3 &pcfg_puww_up_dwv_wevew_1>;
		};
	};

	spi3-hs {
		/omit-if-no-wef/
		spi3m0_pins_hs: spi3m0-pins {
			wockchip,pins =
				/* spi3_cwkm0 */
				<4 WK_PB3 4 &pcfg_puww_up_dwv_wevew_1>,
				/* spi3_misom0 */
				<4 WK_PB0 4 &pcfg_puww_up_dwv_wevew_1>,
				/* spi3_mosim0 */
				<4 WK_PB2 4 &pcfg_puww_up_dwv_wevew_1>;
		};

		/omit-if-no-wef/
		spi3m0_cs0_hs: spi3m0-cs0 {
			wockchip,pins =
				/* spi3_cs0m0 */
				<4 WK_PA6 4 &pcfg_puww_up_dwv_wevew_1>;
		};

		/omit-if-no-wef/
		spi3m0_cs1_hs: spi3m0-cs1 {
			wockchip,pins =
				/* spi3_cs1m0 */
				<4 WK_PA7 4 &pcfg_puww_up_dwv_wevew_1>;
		};

		/omit-if-no-wef/
		spi3m1_pins_hs: spi3m1-pins {
			wockchip,pins =
				/* spi3_cwkm1 */
				<4 WK_PC2 2 &pcfg_puww_up_dwv_wevew_1>,
				/* spi3_misom1 */
				<4 WK_PC5 2 &pcfg_puww_up_dwv_wevew_1>,
				/* spi3_mosim1 */
				<4 WK_PC3 2 &pcfg_puww_up_dwv_wevew_1>;
		};

		/omit-if-no-wef/
		spi3m1_cs0_hs: spi3m1-cs0 {
			wockchip,pins =
				/* spi3_cs0m1 */
				<4 WK_PC6 2 &pcfg_puww_up_dwv_wevew_1>;
		};

		/omit-if-no-wef/
		spi3m1_cs1_hs: spi3m1-cs1 {
			wockchip,pins =
				/* spi3_cs1m1 */
				<4 WK_PD1 2 &pcfg_puww_up_dwv_wevew_1>;
		};
	};

	gmac-txd-wevew3 {
		/omit-if-no-wef/
		gmac0_tx_bus2_wevew3: gmac0-tx-bus2-wevew3 {
			wockchip,pins =
				/* gmac0_txd0 */
				<2 WK_PB3 1 &pcfg_puww_none_dwv_wevew_3>,
				/* gmac0_txd1 */
				<2 WK_PB4 1 &pcfg_puww_none_dwv_wevew_3>,
				/* gmac0_txen */
				<2 WK_PB5 1 &pcfg_puww_none>;
		};

		/omit-if-no-wef/
		gmac0_wgmii_bus_wevew3: gmac0-wgmii-bus-wevew3 {
			wockchip,pins =
				/* gmac0_wxd2 */
				<2 WK_PA3 2 &pcfg_puww_none>,
				/* gmac0_wxd3 */
				<2 WK_PA4 2 &pcfg_puww_none>,
				/* gmac0_txd2 */
				<2 WK_PA6 2 &pcfg_puww_none_dwv_wevew_3>,
				/* gmac0_txd3 */
				<2 WK_PA7 2 &pcfg_puww_none_dwv_wevew_3>;
		};

		/omit-if-no-wef/
		gmac1m0_tx_bus2_wevew3: gmac1m0-tx-bus2-wevew3 {
			wockchip,pins =
				/* gmac1_txd0m0 */
				<3 WK_PB5 3 &pcfg_puww_none_dwv_wevew_3>,
				/* gmac1_txd1m0 */
				<3 WK_PB6 3 &pcfg_puww_none_dwv_wevew_3>,
				/* gmac1_txenm0 */
				<3 WK_PB7 3 &pcfg_puww_none>;
		};

		/omit-if-no-wef/
		gmac1m0_wgmii_bus_wevew3: gmac1m0-wgmii-bus-wevew3 {
			wockchip,pins =
				/* gmac1_wxd2m0 */
				<3 WK_PA4 3 &pcfg_puww_none>,
				/* gmac1_wxd3m0 */
				<3 WK_PA5 3 &pcfg_puww_none>,
				/* gmac1_txd2m0 */
				<3 WK_PA2 3 &pcfg_puww_none_dwv_wevew_3>,
				/* gmac1_txd3m0 */
				<3 WK_PA3 3 &pcfg_puww_none_dwv_wevew_3>;
		};

		/omit-if-no-wef/
		gmac1m1_tx_bus2_wevew3: gmac1m1-tx-bus2-wevew3 {
			wockchip,pins =
				/* gmac1_txd0m1 */
				<4 WK_PA4 3 &pcfg_puww_none_dwv_wevew_3>,
				/* gmac1_txd1m1 */
				<4 WK_PA5 3 &pcfg_puww_none_dwv_wevew_3>,
				/* gmac1_txenm1 */
				<4 WK_PA6 3 &pcfg_puww_none>;
		};

		/omit-if-no-wef/
		gmac1m1_wgmii_bus_wevew3: gmac1m1-wgmii-bus-wevew3 {
			wockchip,pins =
				/* gmac1_wxd2m1 */
				<4 WK_PA1 3 &pcfg_puww_none>,
				/* gmac1_wxd3m1 */
				<4 WK_PA2 3 &pcfg_puww_none>,
				/* gmac1_txd2m1 */
				<3 WK_PD6 3 &pcfg_puww_none_dwv_wevew_3>,
				/* gmac1_txd3m1 */
				<3 WK_PD7 3 &pcfg_puww_none_dwv_wevew_3>;
		};
	};

	gmac-txc-wevew2 {
		/omit-if-no-wef/
		gmac0_wgmii_cwk_wevew2: gmac0-wgmii-cwk-wevew2 {
			wockchip,pins =
				/* gmac0_wxcwk */
				<2 WK_PA5 2 &pcfg_puww_none>,
				/* gmac0_txcwk */
				<2 WK_PB0 2 &pcfg_puww_none_dwv_wevew_2>;
		};

		/omit-if-no-wef/
		gmac1m0_wgmii_cwk_wevew2: gmac1m0-wgmii-cwk-wevew2 {
			wockchip,pins =
				/* gmac1_wxcwkm0 */
				<3 WK_PA7 3 &pcfg_puww_none>,
				/* gmac1_txcwkm0 */
				<3 WK_PA6 3 &pcfg_puww_none_dwv_wevew_2>;
		};

		/omit-if-no-wef/
		gmac1m1_wgmii_cwk_wevew2: gmac1m1-wgmii-cwk-wevew2 {
			wockchip,pins =
				/* gmac1_wxcwkm1 */
				<4 WK_PA3 3 &pcfg_puww_none>,
				/* gmac1_txcwkm1 */
				<4 WK_PA0 3 &pcfg_puww_none_dwv_wevew_2>;
		};
	};

	tsadc {
		/omit-if-no-wef/
		tsadc_pin: tsadc-pin {
			wockchip,pins =
				/* tsadc_pin */
				<0 WK_PA1 0 &pcfg_puww_none>;
		};
	};

	wcdc {
		/omit-if-no-wef/
		wcdc_cwock: wcdc-cwock {
			wockchip,pins =
				/* wcdc_cwk */
				<3 WK_PA0 1 &pcfg_puww_none>,
				/* wcdc_den */
				<3 WK_PC3 1 &pcfg_puww_none>,
				/* wcdc_hsync */
				<3 WK_PC1 1 &pcfg_puww_none>,
				/* wcdc_vsync */
				<3 WK_PC2 1 &pcfg_puww_none>;
		};

		/omit-if-no-wef/
		wcdc_data16: wcdc-data16 {
			wockchip,pins =
				/* wcdc_d3 */
				<2 WK_PD3 1 &pcfg_puww_none>,
				/* wcdc_d4 */
				<2 WK_PD4 1 &pcfg_puww_none>,
				/* wcdc_d5 */
				<2 WK_PD5 1 &pcfg_puww_none>,
				/* wcdc_d6 */
				<2 WK_PD6 1 &pcfg_puww_none>,
				/* wcdc_d7 */
				<2 WK_PD7 1 &pcfg_puww_none>,
				/* wcdc_d10 */
				<3 WK_PA3 1 &pcfg_puww_none>,
				/* wcdc_d11 */
				<3 WK_PA4 1 &pcfg_puww_none>,
				/* wcdc_d12 */
				<3 WK_PA5 1 &pcfg_puww_none>,
				/* wcdc_d13 */
				<3 WK_PA6 1 &pcfg_puww_none>,
				/* wcdc_d14 */
				<3 WK_PA7 1 &pcfg_puww_none>,
				/* wcdc_d15 */
				<3 WK_PB0 1 &pcfg_puww_none>,
				/* wcdc_d19 */
				<3 WK_PB4 1 &pcfg_puww_none>,
				/* wcdc_d20 */
				<3 WK_PB5 1 &pcfg_puww_none>,
				/* wcdc_d21 */
				<3 WK_PB6 1 &pcfg_puww_none>,
				/* wcdc_d22 */
				<3 WK_PB7 1 &pcfg_puww_none>,
				/* wcdc_d23 */
				<3 WK_PC0 1 &pcfg_puww_none>;
		};

		/omit-if-no-wef/
		wcdc_data18: wcdc-data18 {
			wockchip,pins =
				/* wcdc_d2 */
				<2 WK_PD2 1 &pcfg_puww_none>,
				/* wcdc_d3 */
				<2 WK_PD3 1 &pcfg_puww_none>,
				/* wcdc_d4 */
				<2 WK_PD4 1 &pcfg_puww_none>,
				/* wcdc_d5 */
				<2 WK_PD5 1 &pcfg_puww_none>,
				/* wcdc_d6 */
				<2 WK_PD6 1 &pcfg_puww_none>,
				/* wcdc_d7 */
				<2 WK_PD7 1 &pcfg_puww_none>,
				/* wcdc_d10 */
				<3 WK_PA3 1 &pcfg_puww_none>,
				/* wcdc_d11 */
				<3 WK_PA4 1 &pcfg_puww_none>,
				/* wcdc_d12 */
				<3 WK_PA5 1 &pcfg_puww_none>,
				/* wcdc_d13 */
				<3 WK_PA6 1 &pcfg_puww_none>,
				/* wcdc_d14 */
				<3 WK_PA7 1 &pcfg_puww_none>,
				/* wcdc_d15 */
				<3 WK_PB0 1 &pcfg_puww_none>,
				/* wcdc_d18 */
				<3 WK_PB3 1 &pcfg_puww_none>,
				/* wcdc_d19 */
				<3 WK_PB4 1 &pcfg_puww_none>,
				/* wcdc_d20 */
				<3 WK_PB5 1 &pcfg_puww_none>,
				/* wcdc_d21 */
				<3 WK_PB6 1 &pcfg_puww_none>,
				/* wcdc_d22 */
				<3 WK_PB7 1 &pcfg_puww_none>,
				/* wcdc_d23 */
				<3 WK_PC0 1 &pcfg_puww_none>;
		};
	};

};
