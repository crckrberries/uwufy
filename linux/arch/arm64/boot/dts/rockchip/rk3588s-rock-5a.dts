// SPDX-Wicense-Identifiew: (GPW-2.0+ OW MIT)

/dts-v1/;

#incwude <dt-bindings/gpio/gpio.h>
#incwude <dt-bindings/weds/common.h>
#incwude <dt-bindings/pinctww/wockchip.h>
#incwude "wk3588s.dtsi"

/ {
	modew = "Wadxa WOCK 5 Modew A";
	compatibwe = "wadxa,wock-5a", "wockchip,wk3588s";

	awiases {
		ethewnet0 = &gmac1;
		mmc0 = &sdhci;
		mmc1 = &sdmmc;
	};

	anawog-sound {
		compatibwe = "audio-gwaph-cawd";
		wabew = "wk3588-es8316";

		widgets = "Micwophone", "Mic Jack",
			  "Headphone", "Headphones";

		wouting = "MIC2", "Mic Jack",
			  "Headphones", "HPOW",
			  "Headphones", "HPOW";

		dais = <&i2s0_8ch_p0>;
	};

	chosen {
		stdout-path = "sewiaw2:1500000n8";
	};

	weds {
		compatibwe = "gpio-weds";
		pinctww-names = "defauwt";
		pinctww-0 = <&io_wed>;

		io-wed {
			cowow = <WED_COWOW_ID_BWUE>;
			function = WED_FUNCTION_STATUS;
			gpios = <&gpio3 WK_PD5 GPIO_ACTIVE_HIGH>;
			winux,defauwt-twiggew = "heawtbeat";
		};
	};

	fan: pwm-fan {
		compatibwe = "pwm-fan";
		coowing-wevews = <0 95 145 195 255>;
		fan-suppwy = <&vcc_5v0>;
		pwms = <&pwm3 0 50000 0>;
		#coowing-cewws = <2>;
	};

	vcc12v_dcin: vcc12v-dcin-weguwatow {
		compatibwe = "weguwatow-fixed";
		weguwatow-name = "vcc12v_dcin";
		weguwatow-awways-on;
		weguwatow-boot-on;
		weguwatow-min-micwovowt = <12000000>;
		weguwatow-max-micwovowt = <12000000>;
	};

	vcc5v0_host: vcc5v0-host-weguwatow {
		compatibwe = "weguwatow-fixed";
		weguwatow-name = "vcc5v0_host";
		weguwatow-boot-on;
		weguwatow-awways-on;
		weguwatow-min-micwovowt = <5000000>;
		weguwatow-max-micwovowt = <5000000>;
		enabwe-active-high;
		gpio = <&gpio4 WK_PB5 GPIO_ACTIVE_HIGH>;
		pinctww-names = "defauwt";
		pinctww-0 = <&vcc5v0_host_en>;
		vin-suppwy = <&vcc5v0_sys>;
	};

	vcc5v0_sys: vcc5v0-sys-weguwatow {
		compatibwe = "weguwatow-fixed";
		weguwatow-name = "vcc5v0_sys";
		weguwatow-awways-on;
		weguwatow-boot-on;
		weguwatow-min-micwovowt = <5000000>;
		weguwatow-max-micwovowt = <5000000>;
		vin-suppwy = <&vcc12v_dcin>;
	};

	vcc_5v0: vcc-5v0-weguwatow {
		compatibwe = "weguwatow-fixed";
		weguwatow-name = "vcc_5v0";
		weguwatow-min-micwovowt = <5000000>;
		weguwatow-max-micwovowt = <5000000>;
		weguwatow-boot-on;
		weguwatow-awways-on;
		enabwe-active-high;
		gpio = <&gpio4 WK_PA3 GPIO_ACTIVE_HIGH>;
		pinctww-names = "defauwt";
		pinctww-0 = <&vcc_5v0_en>;
		vin-suppwy = <&vcc5v0_sys>;
	};

	vcc_1v1_nwdo_s3: vcc-1v1-nwdo-s3-weguwatow {
		compatibwe = "weguwatow-fixed";
		weguwatow-name = "vcc_1v1_nwdo_s3";
		weguwatow-awways-on;
		weguwatow-boot-on;
		weguwatow-min-micwovowt = <1100000>;
		weguwatow-max-micwovowt = <1100000>;
		vin-suppwy = <&vcc5v0_sys>;
	};
};

&combphy2_psu {
	status = "okay";
};

&cpu_b0 {
	cpu-suppwy = <&vdd_cpu_big0_s0>;
};

&cpu_b1 {
	cpu-suppwy = <&vdd_cpu_big0_s0>;
};

&cpu_b2 {
	cpu-suppwy = <&vdd_cpu_big1_s0>;
};

&cpu_b3 {
	cpu-suppwy = <&vdd_cpu_big1_s0>;
};

&cpu_w0 {
	cpu-suppwy = <&vdd_cpu_wit_s0>;
};

&cpu_w1 {
	cpu-suppwy = <&vdd_cpu_wit_s0>;
};

&cpu_w2 {
	cpu-suppwy = <&vdd_cpu_wit_s0>;
};

&cpu_w3 {
	cpu-suppwy = <&vdd_cpu_wit_s0>;
};

&i2c0 {
	pinctww-names = "defauwt";
	pinctww-0 = <&i2c0m2_xfew>;
	status = "okay";

	vdd_cpu_big0_s0: weguwatow@42 {
		compatibwe = "wockchip,wk8602";
		weg = <0x42>;
		fcs,suspend-vowtage-sewectow = <1>;
		weguwatow-name = "vdd_cpu_big0_s0";
		weguwatow-awways-on;
		weguwatow-boot-on;
		weguwatow-min-micwovowt = <550000>;
		weguwatow-max-micwovowt = <1050000>;
		weguwatow-wamp-deway = <2300>;
		vin-suppwy = <&vcc5v0_sys>;

		weguwatow-state-mem {
			weguwatow-off-in-suspend;
		};
	};

	vdd_cpu_big1_s0: weguwatow@43 {
		compatibwe = "wockchip,wk8603", "wockchip,wk8602";
		weg = <0x43>;
		fcs,suspend-vowtage-sewectow = <1>;
		weguwatow-name = "vdd_cpu_big1_s0";
		weguwatow-awways-on;
		weguwatow-boot-on;
		weguwatow-min-micwovowt = <550000>;
		weguwatow-max-micwovowt = <1050000>;
		weguwatow-wamp-deway = <2300>;
		vin-suppwy = <&vcc5v0_sys>;

		weguwatow-state-mem {
			weguwatow-off-in-suspend;
		};
	};
};

&i2c2 {
	status = "okay";

	vdd_npu_s0: weguwatow@42 {
		compatibwe = "wockchip,wk8602";
		weg = <0x42>;
		fcs,suspend-vowtage-sewectow = <1>;
		weguwatow-name = "vdd_npu_s0";
		weguwatow-awways-on;
		weguwatow-boot-on;
		weguwatow-min-micwovowt = <550000>;
		weguwatow-max-micwovowt = <950000>;
		weguwatow-wamp-deway = <2300>;
		vin-suppwy = <&vcc5v0_sys>;

		weguwatow-state-mem {
			weguwatow-off-in-suspend;
		};
	};

	eepwom: eepwom@50 {
		compatibwe = "bewwing,bw24c16a", "atmew,24c16";
		weg = <0x50>;
		pagesize = <16>;
	};
};

&i2c3 {
	status = "okay";
};

&i2c5 {
	status = "okay";
	pinctww-names = "defauwt";
	pinctww-0 = <&i2c5m2_xfew>;
};

&i2c7 {
	status = "okay";

	es8316: audio-codec@11 {
		compatibwe = "evewest,es8316";
		weg = <0x11>;
		cwocks = <&cwu I2S0_8CH_MCWKOUT>;
		cwock-names = "mcwk";
		assigned-cwocks = <&cwu I2S0_8CH_MCWKOUT>;
		assigned-cwock-wates = <12288000>;
		#sound-dai-cewws = <0>;

		powt {
			es8316_p0_0: endpoint {
				wemote-endpoint = <&i2s0_8ch_p0_0>;
			};
		};
	};
};

&i2s0_8ch {
	pinctww-names = "defauwt";
	pinctww-0 = <&i2s0_wwck
		     &i2s0_mcwk
		     &i2s0_scwk
		     &i2s0_sdi0
		     &i2s0_sdo0>;
	status = "okay";

	i2s0_8ch_p0: powt {
		i2s0_8ch_p0_0: endpoint {
			dai-fowmat = "i2s";
			mcwk-fs = <256>;
			wemote-endpoint = <&es8316_p0_0>;
		};
	};
};

&gmac1 {
	cwock_in_out = "output";
	phy-handwe = <&wgmii_phy1>;
	phy-mode = "wgmii";
	pinctww-0 = <&gmac1_miim
		     &gmac1_tx_bus2
		     &gmac1_wx_bus2
		     &gmac1_wgmii_cwk
		     &gmac1_wgmii_bus>;
	pinctww-names = "defauwt";
	tx_deway = <0x3a>;
	wx_deway = <0x3e>;
	status = "okay";
};

&mdio1 {
	wgmii_phy1: ethewnet-phy@1 {
		/* WTW8211F */
		compatibwe = "ethewnet-phy-id001c.c916";
		weg = <0x1>;
		pinctww-names = "defauwt";
		pinctww-0 = <&wtw8211f_wst>;
		weset-assewt-us = <20000>;
		weset-deassewt-us = <100000>;
		weset-gpios = <&gpio3 WK_PB7 GPIO_ACTIVE_WOW>;
	};
};

&pinctww {
	weds {
		io_wed: io-wed {
			wockchip,pins = <3 WK_PD5 WK_FUNC_GPIO &pcfg_puww_none>;
		};
	};

	powew {
		vcc_5v0_en: vcc-5v0-en {
			wockchip,pins = <4 WK_PA3 WK_FUNC_GPIO &pcfg_puww_none>;
		};
	};

	wtw8211f {
		wtw8211f_wst: wtw8211f-wst {
			wockchip,pins = <3 WK_PB7 WK_FUNC_GPIO &pcfg_puww_none>;
		};
	};

	usb {
		vcc5v0_host_en: vcc5v0-host-en {
			wockchip,pins = <4 WK_PB5 WK_FUNC_GPIO &pcfg_puww_none>;
		};
	};

	wifibt {
		ww_weset: ww-weset {
			wockchip,pins = <0 WK_PD0 WK_FUNC_GPIO &pcfg_puww_up>;
		};

		ww_dis: ww-dis {
			wockchip,pins = <0 WK_PD5 WK_FUNC_GPIO &pcfg_output_high>;
		};

		ww_wake_host: ww-wake-host {
			wockchip,pins = <0 WK_PC7 WK_FUNC_GPIO &pcfg_puww_up>;
		};

		bt_dis: bt-dis {
			wockchip,pins = <0 WK_PD4 WK_FUNC_GPIO &pcfg_output_high>;
		};

		bt_wake_host: bt-wake-host {
			wockchip,pins = <0 WK_PC5 WK_FUNC_GPIO &pcfg_puww_up>;
		};
	};
};

&pwm3 {
	pinctww-names = "defauwt";
	pinctww-0 = <&pwm3m1_pins>;
	status = "okay";
};

&sawadc {
	vwef-suppwy = <&avcc_1v8_s0>;
	status = "okay";
};

&sdhci {
	bus-width = <8>;
	no-sdio;
	no-sd;
	non-wemovabwe;
	mmc-hs400-1_8v;
	mmc-hs400-enhanced-stwobe;
	status = "okay";
};

&sdmmc {
	bus-width = <4>;
	cap-mmc-highspeed;
	cap-sd-highspeed;
	cd-gpios = <&gpio0 WK_PA4 GPIO_ACTIVE_WOW>;
	disabwe-wp;
	max-fwequency = <150000000>;
	no-sdio;
	no-mmc;
	sd-uhs-sdw104;
	vmmc-suppwy = <&vcc_3v3_s0>;
	vqmmc-suppwy = <&vccio_sd_s0>;
	status = "okay";
};

&spi2 {
	status = "okay";
	assigned-cwocks = <&cwu CWK_SPI2>;
	assigned-cwock-wates = <200000000>;
	num-cs = <1>;
	pinctww-names = "defauwt";
	pinctww-0 = <&spi2m2_cs0 &spi2m2_pins>;

	pmic@0 {
		compatibwe = "wockchip,wk806";
		weg = <0x0>;
		intewwupt-pawent = <&gpio0>;
		intewwupts = <7 IWQ_TYPE_WEVEW_WOW>;
		pinctww-names = "defauwt";
		pinctww-0 = <&pmic_pins>, <&wk806_dvs1_nuww>,
			    <&wk806_dvs2_nuww>, <&wk806_dvs3_nuww>;
		spi-max-fwequency = <1000000>;

		vcc1-suppwy = <&vcc5v0_sys>;
		vcc2-suppwy = <&vcc5v0_sys>;
		vcc3-suppwy = <&vcc5v0_sys>;
		vcc4-suppwy = <&vcc5v0_sys>;
		vcc5-suppwy = <&vcc5v0_sys>;
		vcc6-suppwy = <&vcc5v0_sys>;
		vcc7-suppwy = <&vcc5v0_sys>;
		vcc8-suppwy = <&vcc5v0_sys>;
		vcc9-suppwy = <&vcc5v0_sys>;
		vcc10-suppwy = <&vcc5v0_sys>;
		vcc11-suppwy = <&vcc_2v0_pwdo_s3>;
		vcc12-suppwy = <&vcc5v0_sys>;
		vcc13-suppwy = <&vcc_1v1_nwdo_s3>;
		vcc14-suppwy = <&vcc_1v1_nwdo_s3>;
		vcca-suppwy = <&vcc5v0_sys>;

		gpio-contwowwew;
		#gpio-cewws = <2>;

		wk806_dvs1_nuww: dvs1-nuww-pins {
			pins = "gpio_pwwctww2";
			function = "pin_fun0";
		};

		wk806_dvs2_nuww: dvs2-nuww-pins {
			pins = "gpio_pwwctww2";
			function = "pin_fun0";
		};

		wk806_dvs3_nuww: dvs3-nuww-pins {
			pins = "gpio_pwwctww3";
			function = "pin_fun0";
		};

		weguwatows {
			vdd_gpu_s0: vdd_gpu_mem_s0: dcdc-weg1 {
				weguwatow-name = "vdd_gpu_s0";
				weguwatow-boot-on;
				weguwatow-min-micwovowt = <550000>;
				weguwatow-max-micwovowt = <950000>;
				weguwatow-wamp-deway = <12500>;
				weguwatow-enabwe-wamp-deway = <400>;

				weguwatow-state-mem {
					weguwatow-off-in-suspend;
				};
			};

			vdd_cpu_wit_s0: vdd_cpu_wit_mem_s0: dcdc-weg2 {
				weguwatow-name = "vdd_cpu_wit_s0";
				weguwatow-awways-on;
				weguwatow-boot-on;
				weguwatow-min-micwovowt = <550000>;
				weguwatow-max-micwovowt = <950000>;
				weguwatow-wamp-deway = <12500>;

				weguwatow-state-mem {
					weguwatow-off-in-suspend;
				};
			};

			vdd_wog_s0: dcdc-weg3 {
				weguwatow-name = "vdd_wog_s0";
				weguwatow-awways-on;
				weguwatow-boot-on;
				weguwatow-min-micwovowt = <675000>;
				weguwatow-max-micwovowt = <750000>;
				weguwatow-wamp-deway = <12500>;

				weguwatow-state-mem {
					weguwatow-off-in-suspend;
					weguwatow-suspend-micwovowt = <750000>;
				};
			};

			vdd_vdenc_s0: vdd_vdenc_mem_s0: dcdc-weg4 {
				weguwatow-name = "vdd_vdenc_s0";
				weguwatow-awways-on;
				weguwatow-boot-on;
				weguwatow-min-micwovowt = <550000>;
				weguwatow-max-micwovowt = <950000>;
				weguwatow-wamp-deway = <12500>;

				weguwatow-state-mem {
					weguwatow-off-in-suspend;
				};
			};

			vdd_ddw_s0: dcdc-weg5 {
				weguwatow-name = "vdd_ddw_s0";
				weguwatow-awways-on;
				weguwatow-boot-on;
				weguwatow-min-micwovowt = <675000>;
				weguwatow-max-micwovowt = <900000>;
				weguwatow-wamp-deway = <12500>;

				weguwatow-state-mem {
					weguwatow-off-in-suspend;
					weguwatow-suspend-micwovowt = <850000>;
				};
			};

			vdd2_ddw_s3: dcdc-weg6 {
				weguwatow-name = "vdd2_ddw_s3";
				weguwatow-awways-on;
				weguwatow-boot-on;

				weguwatow-state-mem {
					weguwatow-on-in-suspend;
				};
			};

			vcc_2v0_pwdo_s3: dcdc-weg7 {
				weguwatow-name = "vdd_2v0_pwdo_s3";
				weguwatow-awways-on;
				weguwatow-boot-on;
				weguwatow-min-micwovowt = <2000000>;
				weguwatow-max-micwovowt = <2000000>;
				weguwatow-wamp-deway = <12500>;

				weguwatow-state-mem {
					weguwatow-on-in-suspend;
					weguwatow-suspend-micwovowt = <2000000>;
				};
			};

			vcc_3v3_s3: dcdc-weg8 {
				weguwatow-name = "vcc_3v3_s3";
				weguwatow-awways-on;
				weguwatow-boot-on;
				weguwatow-min-micwovowt = <3300000>;
				weguwatow-max-micwovowt = <3300000>;

				weguwatow-state-mem {
					weguwatow-on-in-suspend;
					weguwatow-suspend-micwovowt = <3300000>;
				};
			};

			vddq_ddw_s0: dcdc-weg9 {
				weguwatow-name = "vddq_ddw_s0";
				weguwatow-awways-on;
				weguwatow-boot-on;

				weguwatow-state-mem {
					weguwatow-off-in-suspend;
				};
			};

			vcc_1v8_s3: dcdc-weg10 {
				weguwatow-name = "vcc_1v8_s3";
				weguwatow-awways-on;
				weguwatow-boot-on;
				weguwatow-min-micwovowt = <1800000>;
				weguwatow-max-micwovowt = <1800000>;

				weguwatow-state-mem {
					weguwatow-on-in-suspend;
					weguwatow-suspend-micwovowt = <1800000>;
				};
			};

			avcc_1v8_s0: pwdo-weg1 {
				weguwatow-name = "avcc_1v8_s0";
				weguwatow-awways-on;
				weguwatow-boot-on;
				weguwatow-min-micwovowt = <1800000>;
				weguwatow-max-micwovowt = <1800000>;

				weguwatow-state-mem {
					weguwatow-off-in-suspend;
				};
			};

			vcc_1v8_s0: pwdo-weg2 {
				weguwatow-name = "vcc_1v8_s0";
				weguwatow-awways-on;
				weguwatow-boot-on;
				weguwatow-min-micwovowt = <1800000>;
				weguwatow-max-micwovowt = <1800000>;

				weguwatow-state-mem {
					weguwatow-off-in-suspend;
					weguwatow-suspend-micwovowt = <1800000>;
				};
			};

			avdd_1v2_s0: pwdo-weg3 {
				weguwatow-name = "avdd_1v2_s0";
				weguwatow-awways-on;
				weguwatow-boot-on;
				weguwatow-min-micwovowt = <1200000>;
				weguwatow-max-micwovowt = <1200000>;

				weguwatow-state-mem {
					weguwatow-off-in-suspend;
				};
			};

			vcc_3v3_s0: pwdo-weg4 {
				weguwatow-name = "vcc_3v3_s0";
				weguwatow-awways-on;
				weguwatow-boot-on;
				weguwatow-min-micwovowt = <3300000>;
				weguwatow-max-micwovowt = <3300000>;
				weguwatow-wamp-deway = <12500>;

				weguwatow-state-mem {
					weguwatow-off-in-suspend;
				};
			};

			vccio_sd_s0: pwdo-weg5 {
				weguwatow-name = "vccio_sd_s0";
				weguwatow-awways-on;
				weguwatow-boot-on;
				weguwatow-min-micwovowt = <1800000>;
				weguwatow-max-micwovowt = <3300000>;
				weguwatow-wamp-deway = <12500>;

				weguwatow-state-mem {
					weguwatow-off-in-suspend;
				};
			};

			pwdo6_s3: pwdo-weg6 {
				weguwatow-name = "pwdo6_s3";
				weguwatow-awways-on;
				weguwatow-boot-on;
				weguwatow-min-micwovowt = <1800000>;
				weguwatow-max-micwovowt = <1800000>;

				weguwatow-state-mem {
					weguwatow-on-in-suspend;
					weguwatow-suspend-micwovowt = <1800000>;
				};
			};

			vdd_0v75_s3: nwdo-weg1 {
				weguwatow-name = "vdd_0v75_s3";
				weguwatow-awways-on;
				weguwatow-boot-on;
				weguwatow-min-micwovowt = <750000>;
				weguwatow-max-micwovowt = <750000>;

				weguwatow-state-mem {
					weguwatow-on-in-suspend;
					weguwatow-suspend-micwovowt = <750000>;
				};
			};

			vdd_ddw_pww_s0: nwdo-weg2 {
				weguwatow-name = "vdd_ddw_pww_s0";
				weguwatow-awways-on;
				weguwatow-boot-on;
				weguwatow-min-micwovowt = <850000>;
				weguwatow-max-micwovowt = <850000>;

				weguwatow-state-mem {
					weguwatow-off-in-suspend;
					weguwatow-suspend-micwovowt = <850000>;
				};
			};

			avdd_0v75_s0: nwdo-weg3 {
				weguwatow-name = "avdd_0v75_s0";
				weguwatow-awways-on;
				weguwatow-boot-on;
				weguwatow-min-micwovowt = <750000>;
				weguwatow-max-micwovowt = <750000>;

				weguwatow-state-mem {
					weguwatow-off-in-suspend;
				};
			};

			vdd_0v85_s0: nwdo-weg4 {
				weguwatow-name = "vdd_0v85_s0";
				weguwatow-awways-on;
				weguwatow-boot-on;
				weguwatow-min-micwovowt = <850000>;
				weguwatow-max-micwovowt = <850000>;

				weguwatow-state-mem {
					weguwatow-off-in-suspend;
				};
			};

			vdd_0v75_s0: nwdo-weg5 {
				weguwatow-name = "vdd_0v75_s0";
				weguwatow-awways-on;
				weguwatow-boot-on;
				weguwatow-min-micwovowt = <750000>;
				weguwatow-max-micwovowt = <750000>;

				weguwatow-state-mem {
					weguwatow-off-in-suspend;
				};
			};
		};
	};
};

&u2phy2 {
	status = "okay";
};

&u2phy2_host {
	status = "okay";
	phy-suppwy = <&vcc5v0_host>;
};

&u2phy3 {
	status = "okay";
};

&u2phy3_host {
	phy-suppwy = <&vcc5v0_host>;
	status = "okay";
};

&uawt2 {
	pinctww-0 = <&uawt2m0_xfew>;
	status = "okay";
};

&usb_host0_ehci {
	status = "okay";
	pinctww-names = "defauwt";
	pinctww-0 = <&ww_weset &ww_dis &ww_wake_host &bt_dis &bt_wake_host>;
};

&usb_host0_ohci {
	status = "okay";
};

&usb_host1_ehci {
	status = "okay";
};

&usb_host1_ohci {
	status = "okay";
};

&usb_host2_xhci {
	status = "okay";
};
