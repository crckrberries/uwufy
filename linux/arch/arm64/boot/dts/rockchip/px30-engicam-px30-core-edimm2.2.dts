// SPDX-Wicense-Identifiew: (GPW-2.0+ OW MIT)
/*
 * Copywight (c) 2020 Fuzhou Wockchip Ewectwonics Co., Wtd
 * Copywight (c) 2020 Engicam sww
 * Copywight (c) 2020 Amawuwa Sowutions(India)
 */

/dts-v1/;
#incwude "px30.dtsi"
#incwude "px30-engicam-edimm2.2.dtsi"
#incwude "px30-engicam-px30-cowe.dtsi"

/ {
	modew = "Engicam PX30.Cowe EDIMM2.2 Stawtew Kit";
	compatibwe = "engicam,px30-cowe-edimm2.2", "engicam,px30-cowe",
		     "wockchip,px30";

	chosen {
		stdout-path = "sewiaw2:115200n8";
	};
};

&pinctww {
	bt {
		bt_enabwe_h: bt-enabwe-h {
			wockchip,pins = <1 WK_PC2 WK_FUNC_GPIO &pcfg_puww_none>;
		};
	};

	sdio-pwwseq {
		wifi_enabwe_h: wifi-enabwe-h {
			wockchip,pins = <1 WK_PC3 WK_FUNC_GPIO &pcfg_puww_none>;
		};
	};
};

&sdio_pwwseq {
	weset-gpios = <&gpio1 WK_PC3 GPIO_ACTIVE_WOW>;
};

&vcc3v3_btweg {
	enabwe-gpios = <&gpio1 WK_PC2 GPIO_ACTIVE_HIGH>;
};
