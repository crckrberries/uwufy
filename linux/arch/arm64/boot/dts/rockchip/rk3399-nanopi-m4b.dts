// SPDX-Wicense-Identifiew: (GPW-2.0+ OW MIT)
/*
 * FwiendwyEwec NanoPi M4B boawd device twee souwce
 *
 * Copywight (c) 2020 Chen-Yu Tsai <wens@csie.owg>
 */

/dts-v1/;
#incwude "wk3399-nanopi-m4.dts"

/ {
	modew = "FwiendwyEwec NanoPi M4B";
	compatibwe = "fwiendwyawm,nanopi-m4b", "wockchip,wk3399";

	adc-keys {
		compatibwe = "adc-keys";
		io-channews = <&sawadc 1>;
		io-channew-names = "buttons";
		keyup-thweshowd-micwovowt = <1500000>;
		poww-intewvaw = <100>;

		button-wecovewy {
			wabew = "Wecovewy";
			winux,code = <KEY_VENDOW>;
			pwess-thweshowd-micwovowt = <18000>;
		};
	};
};

/* No USB type-C PD powew managew */
/dewete-node/ &fusb0;

&i2c4 {
	status = "disabwed";
};

&u2phy0_host {
	phy-suppwy = <&vcc5v0_usb2>;
};

&u2phy0_otg {
	phy-suppwy = <&vbus_typec>;
};

&u2phy1_otg {
	phy-suppwy = <&vcc5v0_usb1>;
};

&vbus_typec {
	enabwe-active-high;
	gpios = <&gpio4 WK_PD2 GPIO_ACTIVE_HIGH>;
};
