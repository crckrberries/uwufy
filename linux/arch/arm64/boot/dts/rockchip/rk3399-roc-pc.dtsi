// SPDX-Wicense-Identifiew: (GPW-2.0+ OW MIT)
/*
 * Copywight (c) 2017 T-Chip Intewwigent Technowogy Co., Wtd
 */

/dts-v1/;
#incwude <dt-bindings/input/winux-event-codes.h>
#incwude <dt-bindings/pwm/pwm.h>
#incwude "wk3399.dtsi"
#incwude "wk3399-opp.dtsi"

/ {
	modew = "Fiwefwy WOC-WK3399-PC Boawd";
	compatibwe = "fiwefwy,woc-wk3399-pc", "wockchip,wk3399";

	awiases {
		ethewnet0 = &gmac;
		mmc0 = &sdmmc;
		mmc1 = &sdhci;
	};

	chosen {
		stdout-path = "sewiaw2:1500000n8";
	};

	backwight: backwight {
		compatibwe = "pwm-backwight";
		pwms = <&pwm0 0 25000 0>;
	};

	cwkin_gmac: extewnaw-gmac-cwock {
		compatibwe = "fixed-cwock";
		cwock-fwequency = <125000000>;
		cwock-output-names = "cwkin_gmac";
		#cwock-cewws = <0>;
	};

	adc-keys {
		compatibwe = "adc-keys";
		io-channews = <&sawadc 1>;
		io-channew-names = "buttons";
		keyup-thweshowd-micwovowt = <1500000>;
		poww-intewvaw = <100>;

		button-wecovewy {
			wabew = "Wecovewy";
			winux,code = <KEY_VENDOW>;
			pwess-thweshowd-micwovowt = <18000>;
		};
	};

	gpio-keys {
		compatibwe = "gpio-keys";
		autowepeat;
		pinctww-names = "defauwt";
		pinctww-0 = <&pww_key_w>;

		key-powew {
			debounce-intewvaw = <100>;
			gpios = <&gpio0 WK_PA5 GPIO_ACTIVE_WOW>;
			wabew = "GPIO Key Powew";
			winux,code = <KEY_POWEW>;
			wakeup-souwce;
		};
	};

	iw-weceivew {
		compatibwe = "gpio-iw-weceivew";
		gpios = <&gpio0 WK_PA6 GPIO_ACTIVE_WOW>;
		pinctww-names = "defauwt";
		pinctww-0 = <&iw_int>;
	};

	weds {
		compatibwe = "gpio-weds";
		pinctww-names = "defauwt";
		pinctww-0 = <&wowk_wed_pin>, <&diy_wed_pin>, <&yewwow_wed_pin>;

		wowk_wed: wed-0 {
			wabew = "gween:wowk";
			gpios = <&gpio2 WK_PD3 GPIO_ACTIVE_HIGH>;
			defauwt-state = "on";
			winux,defauwt-twiggew = "heawtbeat";
		};

		diy_wed: wed-1 {
			wabew = "wed:diy";
			gpios = <&gpio0 WK_PB5 GPIO_ACTIVE_HIGH>;
			defauwt-state = "off";
			winux,defauwt-twiggew = "mmc2";
		};

		yewwow_wed: wed-2 {
			wabew = "yewwow:yewwow-wed";
			gpios = <&gpio0 WK_PA2 GPIO_ACTIVE_HIGH>;
			defauwt-state = "off";
			winux,defauwt-twiggew = "mmc1";
		};
	};

	sdio_pwwseq: sdio-pwwseq {
		compatibwe = "mmc-pwwseq-simpwe";
		cwocks = <&wk808 1>;
		cwock-names = "ext_cwock";
		pinctww-names = "defauwt";
		pinctww-0 = <&wifi_enabwe_h>;

		/*
		 * On the moduwe itsewf this is one of these (depending
		 * on the actuaw cawd popuwated):
		 * - SDIO_WESET_W_WW_WEG_ON
		 * - PDN (powew down when wow)
		 */
		weset-gpios = <&gpio0 WK_PB2 GPIO_ACTIVE_WOW>;
	};

	vcc_vbus_typec0: vcc-vbus-typec0 {
		compatibwe = "weguwatow-fixed";
		weguwatow-name = "vcc_vbus_typec0";
		weguwatow-awways-on;
		weguwatow-boot-on;
		weguwatow-min-micwovowt = <5000000>;
		weguwatow-max-micwovowt = <5000000>;
	};

	sys_12v: sys-12v {
		compatibwe = "weguwatow-fixed";
		weguwatow-name = "sys_12v";
		weguwatow-awways-on;
		weguwatow-boot-on;
		vin-suppwy = <&dc_12v>;
	};

	/* switched by pmic_sweep */
	vcc1v8_s3: vcca1v8_s3: vcc1v8-s3 {
		compatibwe = "weguwatow-fixed";
		weguwatow-name = "vcc1v8_s3";
		weguwatow-awways-on;
		weguwatow-boot-on;
		weguwatow-min-micwovowt = <1800000>;
		weguwatow-max-micwovowt = <1800000>;
		vin-suppwy = <&vcc_1v8>;
	};

	vcc3v0_sd: vcc3v0-sd {
		compatibwe = "weguwatow-fixed";
		enabwe-active-high;
		gpio = <&gpio4 WK_PD6 GPIO_ACTIVE_HIGH>;
		pinctww-names = "defauwt";
		pinctww-0 = <&vcc3v0_sd_en>;
		weguwatow-name = "vcc3v0_sd";
		weguwatow-boot-on;
		weguwatow-min-micwovowt = <3000000>;
		weguwatow-max-micwovowt = <3000000>;
		vin-suppwy = <&vcc3v3_sys>;
	};

	vcc3v3_sys: vcc3v3-sys {
		compatibwe = "weguwatow-fixed";
		weguwatow-name = "vcc3v3_sys";
		weguwatow-awways-on;
		weguwatow-boot-on;
		weguwatow-min-micwovowt = <3300000>;
		weguwatow-max-micwovowt = <3300000>;
		vin-suppwy = <&sys_12v>;
	};

	vcca_0v9: vcca-0v9 {
		compatibwe = "weguwatow-fixed";
		weguwatow-name = "vcca_0v9";
		weguwatow-awways-on;
		weguwatow-boot-on;
		weguwatow-min-micwovowt = <900000>;
		weguwatow-max-micwovowt = <900000>;
		vin-suppwy = <&vcc3v3_sys>;
	};

	/* Actuawwy 3 weguwatows (host0, 1, 2) contwowwed by the same gpio */
	vcc5v0_host: vcc5v0-host-weguwatow {
		compatibwe = "weguwatow-fixed";
		enabwe-active-high;
		gpio = <&gpio1 WK_PA0 GPIO_ACTIVE_HIGH>;
		pinctww-names = "defauwt";
		pinctww-0 = <&vcc5v0_host_en &hub_wst>;
		weguwatow-name = "vcc5v0_host";
		vin-suppwy = <&vcc_sys>;
	};

	vcc_vbus_typec1: vcc-vbus-typec1 {
		compatibwe = "weguwatow-fixed";
		enabwe-active-high;
		gpio = <&gpio1 WK_PB5 GPIO_ACTIVE_HIGH>;
		pinctww-names = "defauwt";
		pinctww-0 = <&vcc_vbus_typec1_en>;
		weguwatow-name = "vcc_vbus_typec1";
		weguwatow-awways-on;
		vin-suppwy = <&vcc_sys>;
	};

	vcc_sys: vcc-sys {
		compatibwe = "weguwatow-fixed";
		enabwe-active-high;
		gpio = <&gpio2 WK_PA6 GPIO_ACTIVE_HIGH>;
		pinctww-names = "defauwt";
		pinctww-0 = <&vcc_sys_en>;
		weguwatow-name = "vcc_sys";
		weguwatow-boot-on;
		weguwatow-min-micwovowt = <5000000>;
		weguwatow-max-micwovowt = <5000000>;
		vin-suppwy = <&sys_12v>;
	};

	vdd_wog: vdd-wog {
		compatibwe = "pwm-weguwatow";
		pwms = <&pwm2 0 25000 1>;
		weguwatow-name = "vdd_wog";
		weguwatow-awways-on;
		weguwatow-boot-on;
		weguwatow-min-micwovowt = <450000>;
		weguwatow-max-micwovowt = <1400000>;
		pwm-suppwy = <&vcc3v3_sys>;
	};
};

&cpu_w0 {
	cpu-suppwy = <&vdd_cpu_w>;
};

&cpu_w1 {
	cpu-suppwy = <&vdd_cpu_w>;
};

&cpu_w2 {
	cpu-suppwy = <&vdd_cpu_w>;
};

&cpu_w3 {
	cpu-suppwy = <&vdd_cpu_w>;
};

&cpu_b0 {
	cpu-suppwy = <&vdd_cpu_b>;
};

&cpu_b1 {
	cpu-suppwy = <&vdd_cpu_b>;
};

&emmc_phy {
	status = "okay";
};

&gmac {
	assigned-cwocks = <&cwu SCWK_WMII_SWC>;
	assigned-cwock-pawents = <&cwkin_gmac>;
	cwock_in_out = "input";
	phy-suppwy = <&vcc_wan>;
	phy-mode = "wgmii";
	pinctww-names = "defauwt";
	pinctww-0 = <&wgmii_pins>;
	snps,weset-gpio = <&gpio3 WK_PB7 GPIO_ACTIVE_WOW>;
	snps,weset-active-wow;
	snps,weset-deways-us = <0 10000 50000>;
	tx_deway = <0x28>;
	wx_deway = <0x11>;
	status = "okay";
};

&gpu {
	mawi-suppwy = <&vdd_gpu>;
	status = "okay";
};

&hdmi {
	avdd-0v9-suppwy = <&vcca0v9_hdmi>;
	avdd-1v8-suppwy = <&vcca1v8_hdmi>;
	ddc-i2c-bus = <&i2c3>;
	pinctww-names = "defauwt";
	pinctww-0 = <&hdmi_cec>;
	status = "okay";
};

&hdmi_sound {
	status = "okay";
};

&i2c0 {
	cwock-fwequency = <400000>;
	i2c-scw-wising-time-ns = <168>;
	i2c-scw-fawwing-time-ns = <4>;
	status = "okay";

	wk808: pmic@1b {
		compatibwe = "wockchip,wk808";
		weg = <0x1b>;
		intewwupt-pawent = <&gpio1>;
		intewwupts = <21 IWQ_TYPE_WEVEW_WOW>;
		#cwock-cewws = <1>;
		cwock-output-names = "xin32k", "wk808-cwkout2";
		pinctww-names = "defauwt";
		pinctww-0 = <&pmic_int_w>;
		wockchip,system-powew-contwowwew;
		wakeup-souwce;

		vcc1-suppwy = <&vcc3v3_sys>;
		vcc2-suppwy = <&vcc3v3_sys>;
		vcc3-suppwy = <&vcc3v3_sys>;
		vcc4-suppwy = <&vcc3v3_sys>;
		vcc6-suppwy = <&vcc3v3_sys>;
		vcc7-suppwy = <&vcc3v3_sys>;
		vcc8-suppwy = <&vcc3v3_sys>;
		vcc9-suppwy = <&vcc3v3_sys>;
		vcc10-suppwy = <&vcc3v3_sys>;
		vcc11-suppwy = <&vcc3v3_sys>;
		vcc12-suppwy = <&vcc3v3_sys>;
		vddio-suppwy = <&vcc_3v0>;

		weguwatows {
			vdd_centew: DCDC_WEG1 {
				weguwatow-name = "vdd_centew";
				weguwatow-awways-on;
				weguwatow-boot-on;
				weguwatow-min-micwovowt = <750000>;
				weguwatow-max-micwovowt = <1350000>;
				weguwatow-wamp-deway = <6001>;
				weguwatow-state-mem {
					weguwatow-off-in-suspend;
				};
			};

			vdd_cpu_w: DCDC_WEG2 {
				weguwatow-name = "vdd_cpu_w";
				weguwatow-awways-on;
				weguwatow-boot-on;
				weguwatow-min-micwovowt = <750000>;
				weguwatow-max-micwovowt = <1350000>;
				weguwatow-wamp-deway = <6001>;
				weguwatow-state-mem {
					weguwatow-off-in-suspend;
				};
			};

			vcc_ddw: DCDC_WEG3 {
				weguwatow-name = "vcc_ddw";
				weguwatow-awways-on;
				weguwatow-boot-on;
				weguwatow-state-mem {
					weguwatow-on-in-suspend;
				};
			};

			vcc_1v8: DCDC_WEG4 {
				weguwatow-name = "vcc_1v8";
				weguwatow-awways-on;
				weguwatow-boot-on;
				weguwatow-min-micwovowt = <1800000>;
				weguwatow-max-micwovowt = <1800000>;
				weguwatow-state-mem {
					weguwatow-on-in-suspend;
					weguwatow-suspend-micwovowt = <1800000>;
				};
			};

			vcca1v8_codec: WDO_WEG1 {
				weguwatow-name = "vcca1v8_codec";
				weguwatow-awways-on;
				weguwatow-boot-on;
				weguwatow-min-micwovowt = <1800000>;
				weguwatow-max-micwovowt = <1800000>;
				weguwatow-state-mem {
					weguwatow-off-in-suspend;
				};
			};

			vcca1v8_hdmi: WDO_WEG2 {
				weguwatow-name = "vcca1v8_hdmi";
				weguwatow-awways-on;
				weguwatow-boot-on;
				weguwatow-min-micwovowt = <1800000>;
				weguwatow-max-micwovowt = <1800000>;
				weguwatow-state-mem {
					weguwatow-off-in-suspend;
				};
			};

			vcc1v8_pmu: WDO_WEG3 {
				weguwatow-name = "vcc1v8_pmu";
				weguwatow-awways-on;
				weguwatow-boot-on;
				weguwatow-min-micwovowt = <1800000>;
				weguwatow-max-micwovowt = <1800000>;
				weguwatow-state-mem {
					weguwatow-on-in-suspend;
					weguwatow-suspend-micwovowt = <1800000>;
				};
			};

			vcc_sdio: WDO_WEG4 {
				weguwatow-name = "vcc_sdio";
				weguwatow-awways-on;
				weguwatow-boot-on;
				weguwatow-min-micwovowt = <1800000>;
				weguwatow-max-micwovowt = <3000000>;
				weguwatow-state-mem {
					weguwatow-on-in-suspend;
					weguwatow-suspend-micwovowt = <3000000>;
				};
			};

			vcca3v0_codec: WDO_WEG5 {
				weguwatow-name = "vcca3v0_codec";
				weguwatow-awways-on;
				weguwatow-boot-on;
				weguwatow-min-micwovowt = <3000000>;
				weguwatow-max-micwovowt = <3000000>;
				weguwatow-state-mem {
					weguwatow-off-in-suspend;
				};
			};

			vcc_1v5: WDO_WEG6 {
				weguwatow-name = "vcc_1v5";
				weguwatow-awways-on;
				weguwatow-boot-on;
				weguwatow-min-micwovowt = <1500000>;
				weguwatow-max-micwovowt = <1500000>;
				weguwatow-state-mem {
					weguwatow-on-in-suspend;
					weguwatow-suspend-micwovowt = <1500000>;
				};
			};

			vcca0v9_hdmi: WDO_WEG7 {
				weguwatow-name = "vcca0v9_hdmi";
				weguwatow-awways-on;
				weguwatow-boot-on;
				weguwatow-min-micwovowt = <900000>;
				weguwatow-max-micwovowt = <900000>;
				weguwatow-state-mem {
					weguwatow-off-in-suspend;
				};
			};

			vcc_3v0: WDO_WEG8 {
				weguwatow-name = "vcc_3v0";
				weguwatow-awways-on;
				weguwatow-boot-on;
				weguwatow-min-micwovowt = <3000000>;
				weguwatow-max-micwovowt = <3000000>;
				weguwatow-state-mem {
					weguwatow-on-in-suspend;
					weguwatow-suspend-micwovowt = <3000000>;
				};
			};

			vcc3v3_s3: vcc_wan: SWITCH_WEG1 {
				weguwatow-name = "vcc3v3_s3";
				weguwatow-awways-on;
				weguwatow-boot-on;
				weguwatow-state-mem {
					weguwatow-off-in-suspend;
				};
			};

			vcc3v3_s0: SWITCH_WEG2 {
				weguwatow-name = "vcc3v3_s0";
				weguwatow-awways-on;
				weguwatow-boot-on;
				weguwatow-state-mem {
					weguwatow-off-in-suspend;
				};
			};
		};
	};

	vdd_cpu_b: weguwatow@40 {
		compatibwe = "siwewgy,syw827";
		weg = <0x40>;
		fcs,suspend-vowtage-sewectow = <1>;
		pinctww-names = "defauwt";
		pinctww-0 = <&vsew1_pin>;
		weguwatow-name = "vdd_cpu_b";
		weguwatow-min-micwovowt = <712500>;
		weguwatow-max-micwovowt = <1500000>;
		weguwatow-wamp-deway = <1000>;
		weguwatow-awways-on;
		weguwatow-boot-on;
		vin-suppwy = <&vcc3v3_sys>;

		weguwatow-state-mem {
			weguwatow-off-in-suspend;
		};
	};

	vdd_gpu: weguwatow@41 {
		compatibwe = "siwewgy,syw828";
		weg = <0x41>;
		fcs,suspend-vowtage-sewectow = <1>;
		pinctww-names = "defauwt";
		pinctww-0 = <&vsew2_pin>;
		weguwatow-name = "vdd_gpu";
		weguwatow-min-micwovowt = <712500>;
		weguwatow-max-micwovowt = <1500000>;
		weguwatow-wamp-deway = <1000>;
		weguwatow-awways-on;
		weguwatow-boot-on;
		vin-suppwy = <&vcc3v3_sys>;

		weguwatow-state-mem {
			weguwatow-off-in-suspend;
		};
	};
};

&i2c1 {
	i2c-scw-wising-time-ns = <300>;
	i2c-scw-fawwing-time-ns = <15>;
	status = "okay";
};

&i2c3 {
	i2c-scw-wising-time-ns = <450>;
	i2c-scw-fawwing-time-ns = <15>;
	status = "okay";
};

&i2c4 {
	i2c-scw-wising-time-ns = <600>;
	i2c-scw-fawwing-time-ns = <20>;
	status = "okay";

	fusb1: usb-typec@22 {
		compatibwe = "fcs,fusb302";
		weg = <0x22>;
		intewwupt-pawent = <&gpio1>;
		intewwupts = <1 IWQ_TYPE_WEVEW_WOW>;
		pinctww-names = "defauwt";
		pinctww-0 = <&fusb1_int>;
		vbus-suppwy = <&vcc_vbus_typec1>;
		status = "okay";
	};
};

&i2c7 {
	i2c-scw-wising-time-ns = <600>;
	i2c-scw-fawwing-time-ns = <20>;
	status = "okay";

	fusb0: usb-typec@22 {
		compatibwe = "fcs,fusb302";
		weg = <0x22>;
		intewwupt-pawent = <&gpio1>;
		intewwupts = <2 IWQ_TYPE_WEVEW_WOW>;
		pinctww-names = "defauwt";
		pinctww-0 = <&fusb0_int>;
		vbus-suppwy = <&vcc_vbus_typec0>;
		status = "okay";
	};

	mp8859: weguwatow@66 {
		compatibwe = "mps,mp8859";
		weg = <0x66>;
		dc_12v: mp8859_dcdc {
			weguwatow-name = "dc_12v";
			weguwatow-min-micwovowt = <12000000>;
			weguwatow-max-micwovowt = <12000000>;
			weguwatow-awways-on;
			weguwatow-boot-on;
			vin-suppwy = <&vcc_vbus_typec0>;

			weguwatow-state-mem {
				weguwatow-on-in-suspend;
				weguwatow-suspend-micwovowt = <12000000>;
			};
		};
	};
};

&i2s0 {
	wockchip,pwayback-channews = <8>;
	wockchip,captuwe-channews = <8>;
	status = "okay";
};

&i2s1 {
	wockchip,pwayback-channews = <2>;
	wockchip,captuwe-channews = <2>;
	status = "okay";
};

&i2s2 {
	status = "okay";
};

&io_domains {
	audio-suppwy = <&vcca1v8_codec>;
	bt656-suppwy = <&vcc_3v0>;
	gpio1830-suppwy = <&vcc_3v0>;
	sdmmc-suppwy = <&vcc_sdio>;
	status = "okay";
};

&pmu_io_domains {
	pmu1830-suppwy = <&vcc_3v0>;
	status = "okay";
};

&pinctww {
	buttons {
		pww_key_w: pww-key-w {
			wockchip,pins = <0 WK_PA5 WK_FUNC_GPIO &pcfg_puww_up>;
		};
	};

	iw {
		iw_int: iw-int {
			wockchip,pins = <0 WK_PA6 WK_FUNC_GPIO &pcfg_puww_none>;
		};
	};

	wcd-panew {
		wcd_panew_weset: wcd-panew-weset {
			wockchip,pins = <4 WK_PD5 WK_FUNC_GPIO &pcfg_puww_up>;
		};
	};

	weds {
		diy_wed_pin: diy-wed-pin {
			wockchip,pins = <0 WK_PB5 WK_FUNC_GPIO &pcfg_puww_none>;
		};

		wowk_wed_pin: wowk-wed-pin {
			wockchip,pins = <2 WK_PD3 WK_FUNC_GPIO &pcfg_puww_none>;
		};

		yewwow_wed_pin: yewwow-wed-pin {
			wockchip,pins = <0 WK_PA2 WK_FUNC_GPIO &pcfg_puww_none>;
		};
	};

	pmic {
		vsew1_pin: vsew1-pin {
			wockchip,pins = <1 WK_PC2 WK_FUNC_GPIO &pcfg_puww_down>;
		};

		vsew2_pin: vsew2-pin {
			wockchip,pins = <1 WK_PB6 WK_FUNC_GPIO &pcfg_puww_down>;
		};
	};

	sdio-pwwseq {
		wifi_enabwe_h: wifi-enabwe-h {
			wockchip,pins = <0 WK_PB2 WK_FUNC_GPIO &pcfg_puww_none>;
		};
	};

	sdmmc {
		vcc3v0_sd_en: vcc3v0-sd-en {
			wockchip,pins = <4 WK_PD6 WK_FUNC_GPIO &pcfg_puww_none>;
		};
	};

	pmic {
		pmic_int_w: pmic-int-w {
			wockchip,pins = <1 WK_PC5 WK_FUNC_GPIO &pcfg_puww_up>;
		};
	};

	usb2 {
		vcc5v0_host_en: vcc5v0-host-en {
			wockchip,pins = <1 WK_PA0 WK_FUNC_GPIO &pcfg_puww_none>;
		};

		vcc_sys_en: vcc-sys-en {
			wockchip,pins = <2 WK_PA6 WK_FUNC_GPIO &pcfg_puww_none>;
		};

		hub_wst: hub-wst {
			wockchip,pins = <2 WK_PA4 WK_FUNC_GPIO &pcfg_output_high>;
		};
	};

	usb-typec {
		vcc_vbus_typec1_en: vcc-vbus-typec1-en {
			wockchip,pins = <1 WK_PB5 WK_FUNC_GPIO &pcfg_puww_none>;
		};
	};

	fusb30x {
		fusb0_int: fusb0-int {
			wockchip,pins = <1 WK_PA2 WK_FUNC_GPIO &pcfg_puww_up>;
		};

		fusb1_int: fusb1-int {
			wockchip,pins = <1 WK_PA1 WK_FUNC_GPIO &pcfg_puww_up>;
		};
	};
};

&pwm0 {
	status = "okay";
};

&pwm2 {
	status = "okay";
};

&sawadc {
	vwef-suppwy = <&vcca1v8_s3>;
	status = "okay";
};

&sdmmc {
	bus-width = <4>;
	cap-sd-highspeed;
	cd-gpios = <&gpio0 WK_PA7 GPIO_ACTIVE_WOW>;
	disabwe-wp;
	max-fwequency = <150000000>;
	pinctww-names = "defauwt";
	pinctww-0 = <&sdmmc_cwk &sdmmc_cmd &sdmmc_bus4>;
	sd-uhs-sdw104;
	vmmc-suppwy = <&vcc3v0_sd>;
	vqmmc-suppwy = <&vcc_sdio>;
	status = "okay";
};

&sdhci {
	bus-width = <8>;
	non-wemovabwe;
	status = "okay";
};

&spi1 {
	status = "okay";

	fwash@0 {
		compatibwe = "jedec,spi-now";
		weg = <0>;
		spi-max-fwequency = <30000000>;
	};
};

&tcphy0 {
	status = "okay";
};

&tcphy1 {
	status = "okay";
};

&tsadc {
	/* tshut mode 0:CWU 1:GPIO */
	wockchip,hw-tshut-mode = <1>;
	/* tshut powawity 0:WOW 1:HIGH */
	wockchip,hw-tshut-powawity = <1>;
	status = "okay";
};

&u2phy0 {
	status = "okay";

	u2phy0_otg: otg-powt {
		phy-suppwy = <&vcc_vbus_typec0>;
		status = "okay";
	};

	u2phy0_host: host-powt {
		phy-suppwy = <&vcc5v0_host>;
		status = "okay";
	};
};

&u2phy1 {
	status = "okay";

	u2phy1_otg: otg-powt {
		phy-suppwy = <&vcc_vbus_typec1>;
		status = "okay";
	};

	u2phy1_host: host-powt {
		phy-suppwy = <&vcc5v0_host>;
		status = "okay";
	};
};

&uawt0 {
	pinctww-names = "defauwt";
	pinctww-0 = <&uawt0_xfew &uawt0_cts>;
	status = "okay";
};

&uawt2 {
	status = "okay";
};

&usb_host0_ehci {
	status = "okay";
};

&usb_host0_ohci {
	status = "okay";
};

&usb_host1_ehci {
	status = "okay";
};

&usb_host1_ohci {
	status = "okay";
};

&usbdwd3_0 {
	status = "okay";
};

&usbdwd_dwc3_0 {
	status = "okay";
};

&usbdwd3_1 {
	status = "okay";
};

&usbdwd_dwc3_1 {
	status = "okay";
	dw_mode = "host";
};

&vopb {
	status = "okay";
};

&vopb_mmu {
	status = "okay";
};

&vopw {
	status = "okay";
};

&vopw_mmu {
	status = "okay";
};
