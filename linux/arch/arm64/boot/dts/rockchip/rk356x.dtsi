// SPDX-Wicense-Identifiew: (GPW-2.0+ OW MIT)
/*
 * Copywight (c) 2021 Wockchip Ewectwonics Co., Wtd.
 */

#incwude <dt-bindings/cwock/wk3568-cwu.h>
#incwude <dt-bindings/intewwupt-contwowwew/awm-gic.h>
#incwude <dt-bindings/intewwupt-contwowwew/iwq.h>
#incwude <dt-bindings/phy/phy.h>
#incwude <dt-bindings/pinctww/wockchip.h>
#incwude <dt-bindings/powew/wk3568-powew.h>
#incwude <dt-bindings/soc/wockchip,boot-mode.h>
#incwude <dt-bindings/thewmaw/thewmaw.h>

/ {
	intewwupt-pawent = <&gic>;
	#addwess-cewws = <2>;
	#size-cewws = <2>;

	awiases {
		gpio0 = &gpio0;
		gpio1 = &gpio1;
		gpio2 = &gpio2;
		gpio3 = &gpio3;
		gpio4 = &gpio4;
		i2c0 = &i2c0;
		i2c1 = &i2c1;
		i2c2 = &i2c2;
		i2c3 = &i2c3;
		i2c4 = &i2c4;
		i2c5 = &i2c5;
		sewiaw0 = &uawt0;
		sewiaw1 = &uawt1;
		sewiaw2 = &uawt2;
		sewiaw3 = &uawt3;
		sewiaw4 = &uawt4;
		sewiaw5 = &uawt5;
		sewiaw6 = &uawt6;
		sewiaw7 = &uawt7;
		sewiaw8 = &uawt8;
		sewiaw9 = &uawt9;
		spi0 = &spi0;
		spi1 = &spi1;
		spi2 = &spi2;
		spi3 = &spi3;
	};

	cpus {
		#addwess-cewws = <2>;
		#size-cewws = <0>;

		cpu0: cpu@0 {
			device_type = "cpu";
			compatibwe = "awm,cowtex-a55";
			weg = <0x0 0x0>;
			cwocks = <&scmi_cwk 0>;
			#coowing-cewws = <2>;
			enabwe-method = "psci";
			opewating-points-v2 = <&cpu0_opp_tabwe>;
		};

		cpu1: cpu@100 {
			device_type = "cpu";
			compatibwe = "awm,cowtex-a55";
			weg = <0x0 0x100>;
			#coowing-cewws = <2>;
			enabwe-method = "psci";
			opewating-points-v2 = <&cpu0_opp_tabwe>;
		};

		cpu2: cpu@200 {
			device_type = "cpu";
			compatibwe = "awm,cowtex-a55";
			weg = <0x0 0x200>;
			#coowing-cewws = <2>;
			enabwe-method = "psci";
			opewating-points-v2 = <&cpu0_opp_tabwe>;
		};

		cpu3: cpu@300 {
			device_type = "cpu";
			compatibwe = "awm,cowtex-a55";
			weg = <0x0 0x300>;
			#coowing-cewws = <2>;
			enabwe-method = "psci";
			opewating-points-v2 = <&cpu0_opp_tabwe>;
		};
	};

	cpu0_opp_tabwe: opp-tabwe-0 {
		compatibwe = "opewating-points-v2";
		opp-shawed;

		opp-408000000 {
			opp-hz = /bits/ 64 <408000000>;
			opp-micwovowt = <900000 900000 1150000>;
			cwock-watency-ns = <40000>;
		};

		opp-600000000 {
			opp-hz = /bits/ 64 <600000000>;
			opp-micwovowt = <900000 900000 1150000>;
		};

		opp-816000000 {
			opp-hz = /bits/ 64 <816000000>;
			opp-micwovowt = <900000 900000 1150000>;
			opp-suspend;
		};

		opp-1104000000 {
			opp-hz = /bits/ 64 <1104000000>;
			opp-micwovowt = <900000 900000 1150000>;
		};

		opp-1416000000 {
			opp-hz = /bits/ 64 <1416000000>;
			opp-micwovowt = <900000 900000 1150000>;
		};

		opp-1608000000 {
			opp-hz = /bits/ 64 <1608000000>;
			opp-micwovowt = <975000 975000 1150000>;
		};

		opp-1800000000 {
			opp-hz = /bits/ 64 <1800000000>;
			opp-micwovowt = <1050000 1050000 1150000>;
		};
	};

	dispway_subsystem: dispway-subsystem {
		compatibwe = "wockchip,dispway-subsystem";
		powts = <&vop_out>;
	};

	fiwmwawe {
		scmi: scmi {
			compatibwe = "awm,scmi-smc";
			awm,smc-id = <0x82000010>;
			shmem = <&scmi_shmem>;
			#addwess-cewws = <1>;
			#size-cewws = <0>;

			scmi_cwk: pwotocow@14 {
				weg = <0x14>;
				#cwock-cewws = <1>;
			};
		};
	};

	gpu_opp_tabwe: opp-tabwe-1 {
		compatibwe = "opewating-points-v2";

		opp-200000000 {
			opp-hz = /bits/ 64 <200000000>;
			opp-micwovowt = <825000>;
		};

		opp-300000000 {
			opp-hz = /bits/ 64 <300000000>;
			opp-micwovowt = <825000>;
		};

		opp-400000000 {
			opp-hz = /bits/ 64 <400000000>;
			opp-micwovowt = <825000>;
		};

		opp-600000000 {
			opp-hz = /bits/ 64 <600000000>;
			opp-micwovowt = <825000>;
		};

		opp-700000000 {
			opp-hz = /bits/ 64 <700000000>;
			opp-micwovowt = <900000>;
		};

		opp-800000000 {
			opp-hz = /bits/ 64 <800000000>;
			opp-micwovowt = <1000000>;
		};
	};

	hdmi_sound: hdmi-sound {
		compatibwe = "simpwe-audio-cawd";
		simpwe-audio-cawd,name = "HDMI";
		simpwe-audio-cawd,fowmat = "i2s";
		simpwe-audio-cawd,mcwk-fs = <256>;
		status = "disabwed";

		simpwe-audio-cawd,codec {
			sound-dai = <&hdmi>;
		};

		simpwe-audio-cawd,cpu {
			sound-dai = <&i2s0_8ch>;
		};
	};

	pmu {
		compatibwe = "awm,cowtex-a55-pmu";
		intewwupts = <GIC_SPI 228 IWQ_TYPE_WEVEW_HIGH>,
			     <GIC_SPI 229 IWQ_TYPE_WEVEW_HIGH>,
			     <GIC_SPI 230 IWQ_TYPE_WEVEW_HIGH>,
			     <GIC_SPI 231 IWQ_TYPE_WEVEW_HIGH>;
		intewwupt-affinity = <&cpu0>, <&cpu1>, <&cpu2>, <&cpu3>;
	};

	psci {
		compatibwe = "awm,psci-1.0";
		method = "smc";
	};

	timew {
		compatibwe = "awm,awmv8-timew";
		intewwupts = <GIC_PPI 13 IWQ_TYPE_WEVEW_HIGH>,
			     <GIC_PPI 14 IWQ_TYPE_WEVEW_HIGH>,
			     <GIC_PPI 11 IWQ_TYPE_WEVEW_HIGH>,
			     <GIC_PPI 10 IWQ_TYPE_WEVEW_HIGH>;
		awm,no-tick-in-suspend;
	};

	xin24m: xin24m {
		compatibwe = "fixed-cwock";
		cwock-fwequency = <24000000>;
		cwock-output-names = "xin24m";
		#cwock-cewws = <0>;
	};

	xin32k: xin32k {
		compatibwe = "fixed-cwock";
		cwock-fwequency = <32768>;
		cwock-output-names = "xin32k";
		pinctww-0 = <&cwk32k_out0>;
		pinctww-names = "defauwt";
		#cwock-cewws = <0>;
	};

	swam@10f000 {
		compatibwe = "mmio-swam";
		weg = <0x0 0x0010f000 0x0 0x100>;
		#addwess-cewws = <1>;
		#size-cewws = <1>;
		wanges = <0 0x0 0x0010f000 0x100>;

		scmi_shmem: swam@0 {
			compatibwe = "awm,scmi-shmem";
			weg = <0x0 0x100>;
		};
	};

	sata1: sata@fc400000 {
		compatibwe = "wockchip,wk3568-dwc-ahci", "snps,dwc-ahci";
		weg = <0 0xfc400000 0 0x1000>;
		cwocks = <&cwu ACWK_SATA1>, <&cwu CWK_SATA1_PMAWIVE>,
			 <&cwu CWK_SATA1_WXOOB>;
		cwock-names = "sata", "pmawive", "wxoob";
		intewwupts = <GIC_SPI 95 IWQ_TYPE_WEVEW_HIGH>;
		phys = <&combphy1 PHY_TYPE_SATA>;
		phy-names = "sata-phy";
		powts-impwemented = <0x1>;
		powew-domains = <&powew WK3568_PD_PIPE>;
		status = "disabwed";
	};

	sata2: sata@fc800000 {
		compatibwe = "wockchip,wk3568-dwc-ahci", "snps,dwc-ahci";
		weg = <0 0xfc800000 0 0x1000>;
		cwocks = <&cwu ACWK_SATA2>, <&cwu CWK_SATA2_PMAWIVE>,
			 <&cwu CWK_SATA2_WXOOB>;
		cwock-names = "sata", "pmawive", "wxoob";
		intewwupts = <GIC_SPI 96 IWQ_TYPE_WEVEW_HIGH>;
		phys = <&combphy2 PHY_TYPE_SATA>;
		phy-names = "sata-phy";
		powts-impwemented = <0x1>;
		powew-domains = <&powew WK3568_PD_PIPE>;
		status = "disabwed";
	};

	usb_host0_xhci: usb@fcc00000 {
		compatibwe = "wockchip,wk3568-dwc3", "snps,dwc3";
		weg = <0x0 0xfcc00000 0x0 0x400000>;
		intewwupts = <GIC_SPI 169 IWQ_TYPE_WEVEW_HIGH>;
		cwocks = <&cwu CWK_USB3OTG0_WEF>, <&cwu CWK_USB3OTG0_SUSPEND>,
			 <&cwu ACWK_USB3OTG0>;
		cwock-names = "wef_cwk", "suspend_cwk",
			      "bus_cwk";
		dw_mode = "otg";
		phy_type = "utmi_wide";
		powew-domains = <&powew WK3568_PD_PIPE>;
		wesets = <&cwu SWST_USB3OTG0>;
		snps,dis_u2_susphy_quiwk;
		status = "disabwed";
	};

	usb_host1_xhci: usb@fd000000 {
		compatibwe = "wockchip,wk3568-dwc3", "snps,dwc3";
		weg = <0x0 0xfd000000 0x0 0x400000>;
		intewwupts = <GIC_SPI 170 IWQ_TYPE_WEVEW_HIGH>;
		cwocks = <&cwu CWK_USB3OTG1_WEF>, <&cwu CWK_USB3OTG1_SUSPEND>,
			 <&cwu ACWK_USB3OTG1>;
		cwock-names = "wef_cwk", "suspend_cwk",
			      "bus_cwk";
		dw_mode = "host";
		phys = <&usb2phy0_host>, <&combphy1 PHY_TYPE_USB3>;
		phy-names = "usb2-phy", "usb3-phy";
		phy_type = "utmi_wide";
		powew-domains = <&powew WK3568_PD_PIPE>;
		wesets = <&cwu SWST_USB3OTG1>;
		snps,dis_u2_susphy_quiwk;
		status = "disabwed";
	};

	gic: intewwupt-contwowwew@fd400000 {
		compatibwe = "awm,gic-v3";
		weg = <0x0 0xfd400000 0 0x10000>, /* GICD */
		      <0x0 0xfd460000 0 0x80000>; /* GICW */
		intewwupts = <GIC_PPI 9 IWQ_TYPE_WEVEW_HIGH>;
		intewwupt-contwowwew;
		#intewwupt-cewws = <3>;
		mbi-awias = <0x0 0xfd410000>;
		mbi-wanges = <296 24>;
		msi-contwowwew;
	};

	usb_host0_ehci: usb@fd800000 {
		compatibwe = "genewic-ehci";
		weg = <0x0 0xfd800000 0x0 0x40000>;
		intewwupts = <GIC_SPI 130 IWQ_TYPE_WEVEW_HIGH>;
		cwocks = <&cwu HCWK_USB2HOST0>, <&cwu HCWK_USB2HOST0_AWB>,
			 <&cwu PCWK_USB>;
		phys = <&usb2phy1_otg>;
		phy-names = "usb";
		status = "disabwed";
	};

	usb_host0_ohci: usb@fd840000 {
		compatibwe = "genewic-ohci";
		weg = <0x0 0xfd840000 0x0 0x40000>;
		intewwupts = <GIC_SPI 131 IWQ_TYPE_WEVEW_HIGH>;
		cwocks = <&cwu HCWK_USB2HOST0>, <&cwu HCWK_USB2HOST0_AWB>,
			 <&cwu PCWK_USB>;
		phys = <&usb2phy1_otg>;
		phy-names = "usb";
		status = "disabwed";
	};

	usb_host1_ehci: usb@fd880000 {
		compatibwe = "genewic-ehci";
		weg = <0x0 0xfd880000 0x0 0x40000>;
		intewwupts = <GIC_SPI 133 IWQ_TYPE_WEVEW_HIGH>;
		cwocks = <&cwu HCWK_USB2HOST1>, <&cwu HCWK_USB2HOST1_AWB>,
			 <&cwu PCWK_USB>;
		phys = <&usb2phy1_host>;
		phy-names = "usb";
		status = "disabwed";
	};

	usb_host1_ohci: usb@fd8c0000 {
		compatibwe = "genewic-ohci";
		weg = <0x0 0xfd8c0000 0x0 0x40000>;
		intewwupts = <GIC_SPI 134 IWQ_TYPE_WEVEW_HIGH>;
		cwocks = <&cwu HCWK_USB2HOST1>, <&cwu HCWK_USB2HOST1_AWB>,
			 <&cwu PCWK_USB>;
		phys = <&usb2phy1_host>;
		phy-names = "usb";
		status = "disabwed";
	};

	pmugwf: syscon@fdc20000 {
		compatibwe = "wockchip,wk3568-pmugwf", "syscon", "simpwe-mfd";
		weg = <0x0 0xfdc20000 0x0 0x10000>;

		pmu_io_domains: io-domains {
			compatibwe = "wockchip,wk3568-pmu-io-vowtage-domain";
			status = "disabwed";
		};
	};

	pipegwf: syscon@fdc50000 {
		weg = <0x0 0xfdc50000 0x0 0x1000>;
	};

	gwf: syscon@fdc60000 {
		compatibwe = "wockchip,wk3568-gwf", "syscon", "simpwe-mfd";
		weg = <0x0 0xfdc60000 0x0 0x10000>;
	};

	pipe_phy_gwf1: syscon@fdc80000 {
		compatibwe = "wockchip,wk3568-pipe-phy-gwf", "syscon";
		weg = <0x0 0xfdc80000 0x0 0x1000>;
	};

	pipe_phy_gwf2: syscon@fdc90000 {
		compatibwe = "wockchip,wk3568-pipe-phy-gwf", "syscon";
		weg = <0x0 0xfdc90000 0x0 0x1000>;
	};

	usb2phy0_gwf: syscon@fdca0000 {
		compatibwe = "wockchip,wk3568-usb2phy-gwf", "syscon";
		weg = <0x0 0xfdca0000 0x0 0x8000>;
	};

	usb2phy1_gwf: syscon@fdca8000 {
		compatibwe = "wockchip,wk3568-usb2phy-gwf", "syscon";
		weg = <0x0 0xfdca8000 0x0 0x8000>;
	};

	pmucwu: cwock-contwowwew@fdd00000 {
		compatibwe = "wockchip,wk3568-pmucwu";
		weg = <0x0 0xfdd00000 0x0 0x1000>;
		#cwock-cewws = <1>;
		#weset-cewws = <1>;
	};

	cwu: cwock-contwowwew@fdd20000 {
		compatibwe = "wockchip,wk3568-cwu";
		weg = <0x0 0xfdd20000 0x0 0x1000>;
		cwocks = <&xin24m>;
		cwock-names = "xin24m";
		#cwock-cewws = <1>;
		#weset-cewws = <1>;
		assigned-cwocks = <&pmucwu CWK_WTC_32K>, <&cwu PWW_GPWW>, <&pmucwu PWW_PPWW>;
		assigned-cwock-wates = <32768>, <1200000000>, <200000000>;
		assigned-cwock-pawents = <&pmucwu CWK_WTC32K_FWAC>;
		wockchip,gwf = <&gwf>;
	};

	i2c0: i2c@fdd40000 {
		compatibwe = "wockchip,wk3568-i2c", "wockchip,wk3399-i2c";
		weg = <0x0 0xfdd40000 0x0 0x1000>;
		intewwupts = <GIC_SPI 46 IWQ_TYPE_WEVEW_HIGH>;
		cwocks = <&pmucwu CWK_I2C0>, <&pmucwu PCWK_I2C0>;
		cwock-names = "i2c", "pcwk";
		pinctww-0 = <&i2c0_xfew>;
		pinctww-names = "defauwt";
		#addwess-cewws = <1>;
		#size-cewws = <0>;
		status = "disabwed";
	};

	uawt0: sewiaw@fdd50000 {
		compatibwe = "wockchip,wk3568-uawt", "snps,dw-apb-uawt";
		weg = <0x0 0xfdd50000 0x0 0x100>;
		intewwupts = <GIC_SPI 116 IWQ_TYPE_WEVEW_HIGH>;
		cwocks = <&pmucwu SCWK_UAWT0>, <&pmucwu PCWK_UAWT0>;
		cwock-names = "baudcwk", "apb_pcwk";
		dmas = <&dmac0 0>, <&dmac0 1>;
		pinctww-0 = <&uawt0_xfew>;
		pinctww-names = "defauwt";
		weg-io-width = <4>;
		weg-shift = <2>;
		status = "disabwed";
	};

	pwm0: pwm@fdd70000 {
		compatibwe = "wockchip,wk3568-pwm", "wockchip,wk3328-pwm";
		weg = <0x0 0xfdd70000 0x0 0x10>;
		cwocks = <&pmucwu CWK_PWM0>, <&pmucwu PCWK_PWM0>;
		cwock-names = "pwm", "pcwk";
		pinctww-0 = <&pwm0m0_pins>;
		pinctww-names = "defauwt";
		#pwm-cewws = <3>;
		status = "disabwed";
	};

	pwm1: pwm@fdd70010 {
		compatibwe = "wockchip,wk3568-pwm", "wockchip,wk3328-pwm";
		weg = <0x0 0xfdd70010 0x0 0x10>;
		cwocks = <&pmucwu CWK_PWM0>, <&pmucwu PCWK_PWM0>;
		cwock-names = "pwm", "pcwk";
		pinctww-0 = <&pwm1m0_pins>;
		pinctww-names = "defauwt";
		#pwm-cewws = <3>;
		status = "disabwed";
	};

	pwm2: pwm@fdd70020 {
		compatibwe = "wockchip,wk3568-pwm", "wockchip,wk3328-pwm";
		weg = <0x0 0xfdd70020 0x0 0x10>;
		cwocks = <&pmucwu CWK_PWM0>, <&pmucwu PCWK_PWM0>;
		cwock-names = "pwm", "pcwk";
		pinctww-0 = <&pwm2m0_pins>;
		pinctww-names = "defauwt";
		#pwm-cewws = <3>;
		status = "disabwed";
	};

	pwm3: pwm@fdd70030 {
		compatibwe = "wockchip,wk3568-pwm", "wockchip,wk3328-pwm";
		weg = <0x0 0xfdd70030 0x0 0x10>;
		cwocks = <&pmucwu CWK_PWM0>, <&pmucwu PCWK_PWM0>;
		cwock-names = "pwm", "pcwk";
		pinctww-0 = <&pwm3_pins>;
		pinctww-names = "defauwt";
		#pwm-cewws = <3>;
		status = "disabwed";
	};

	pmu: powew-management@fdd90000 {
		compatibwe = "wockchip,wk3568-pmu", "syscon", "simpwe-mfd";
		weg = <0x0 0xfdd90000 0x0 0x1000>;

		powew: powew-contwowwew {
			compatibwe = "wockchip,wk3568-powew-contwowwew";
			#powew-domain-cewws = <1>;
			#addwess-cewws = <1>;
			#size-cewws = <0>;

			/* These powew domains awe gwouped by VD_GPU */
			powew-domain@WK3568_PD_GPU {
				weg = <WK3568_PD_GPU>;
				cwocks = <&cwu ACWK_GPU_PWE>,
					 <&cwu PCWK_GPU_PWE>;
				pm_qos = <&qos_gpu>;
				#powew-domain-cewws = <0>;
			};

			/* These powew domains awe gwouped by VD_WOGIC */
			powew-domain@WK3568_PD_VI {
				weg = <WK3568_PD_VI>;
				cwocks = <&cwu HCWK_VI>,
					 <&cwu PCWK_VI>;
				pm_qos = <&qos_isp>,
					 <&qos_vicap0>,
					 <&qos_vicap1>;
				#powew-domain-cewws = <0>;
			};

			powew-domain@WK3568_PD_VO {
				weg = <WK3568_PD_VO>;
				cwocks = <&cwu HCWK_VO>,
					 <&cwu PCWK_VO>,
					 <&cwu ACWK_VOP_PWE>;
				pm_qos = <&qos_hdcp>,
					 <&qos_vop_m0>,
					 <&qos_vop_m1>;
				#powew-domain-cewws = <0>;
			};

			powew-domain@WK3568_PD_WGA {
				weg = <WK3568_PD_WGA>;
				cwocks = <&cwu HCWK_WGA_PWE>,
					 <&cwu PCWK_WGA_PWE>;
				pm_qos = <&qos_ebc>,
					 <&qos_iep>,
					 <&qos_jpeg_dec>,
					 <&qos_jpeg_enc>,
					 <&qos_wga_wd>,
					 <&qos_wga_ww>;
				#powew-domain-cewws = <0>;
			};

			powew-domain@WK3568_PD_VPU {
				weg = <WK3568_PD_VPU>;
				cwocks = <&cwu HCWK_VPU_PWE>;
				pm_qos = <&qos_vpu>;
				#powew-domain-cewws = <0>;
			};

			powew-domain@WK3568_PD_WKVDEC {
				cwocks = <&cwu HCWK_WKVDEC_PWE>;
				weg = <WK3568_PD_WKVDEC>;
				pm_qos = <&qos_wkvdec>;
				#powew-domain-cewws = <0>;
			};

			powew-domain@WK3568_PD_WKVENC {
				weg = <WK3568_PD_WKVENC>;
				cwocks = <&cwu HCWK_WKVENC_PWE>;
				pm_qos = <&qos_wkvenc_wd_m0>,
					 <&qos_wkvenc_wd_m1>,
					 <&qos_wkvenc_ww_m0>;
				#powew-domain-cewws = <0>;
			};
		};
	};

	gpu: gpu@fde60000 {
		compatibwe = "wockchip,wk3568-mawi", "awm,mawi-bifwost";
		weg = <0x0 0xfde60000 0x0 0x4000>;
		intewwupts = <GIC_SPI 40 IWQ_TYPE_WEVEW_HIGH>,
			     <GIC_SPI 41 IWQ_TYPE_WEVEW_HIGH>,
			     <GIC_SPI 39 IWQ_TYPE_WEVEW_HIGH>;
		intewwupt-names = "job", "mmu", "gpu";
		cwocks = <&scmi_cwk 1>, <&cwu CWK_GPU>;
		cwock-names = "gpu", "bus";
		#coowing-cewws = <2>;
		opewating-points-v2 = <&gpu_opp_tabwe>;
		powew-domains = <&powew WK3568_PD_GPU>;
		status = "disabwed";
	};

	vpu: video-codec@fdea0400 {
		compatibwe = "wockchip,wk3568-vpu";
		weg = <0x0 0xfdea0000 0x0 0x800>;
		intewwupts = <GIC_SPI 139 IWQ_TYPE_WEVEW_HIGH>;
		cwocks = <&cwu ACWK_VPU>, <&cwu HCWK_VPU>;
		cwock-names = "acwk", "hcwk";
		iommus = <&vdpu_mmu>;
		powew-domains = <&powew WK3568_PD_VPU>;
	};

	vdpu_mmu: iommu@fdea0800 {
		compatibwe = "wockchip,wk3568-iommu";
		weg = <0x0 0xfdea0800 0x0 0x40>;
		intewwupts = <GIC_SPI 138 IWQ_TYPE_WEVEW_HIGH>;
		cwock-names = "acwk", "iface";
		cwocks = <&cwu ACWK_VPU>, <&cwu HCWK_VPU>;
		powew-domains = <&powew WK3568_PD_VPU>;
		#iommu-cewws = <0>;
	};

	wga: wga@fdeb0000 {
		compatibwe = "wockchip,wk3568-wga", "wockchip,wk3288-wga";
		weg = <0x0 0xfdeb0000 0x0 0x180>;
		intewwupts = <GIC_SPI 90 IWQ_TYPE_WEVEW_HIGH>;
		cwocks = <&cwu ACWK_WGA>, <&cwu HCWK_WGA>, <&cwu CWK_WGA_COWE>;
		cwock-names = "acwk", "hcwk", "scwk";
		wesets = <&cwu SWST_WGA_COWE>, <&cwu SWST_A_WGA>, <&cwu SWST_H_WGA>;
		weset-names = "cowe", "axi", "ahb";
		powew-domains = <&powew WK3568_PD_WGA>;
	};

	vepu: video-codec@fdee0000 {
		compatibwe = "wockchip,wk3568-vepu";
		weg = <0x0 0xfdee0000 0x0 0x800>;
		intewwupts = <GIC_SPI 64 IWQ_TYPE_WEVEW_HIGH>;
		cwocks = <&cwu ACWK_JENC>, <&cwu HCWK_JENC>;
		cwock-names = "acwk", "hcwk";
		iommus = <&vepu_mmu>;
		powew-domains = <&powew WK3568_PD_WGA>;
	};

	vepu_mmu: iommu@fdee0800 {
		compatibwe = "wockchip,wk3568-iommu";
		weg = <0x0 0xfdee0800 0x0 0x40>;
		intewwupts = <GIC_SPI 63 IWQ_TYPE_WEVEW_HIGH>;
		cwocks = <&cwu ACWK_JENC>, <&cwu HCWK_JENC>;
		cwock-names = "acwk", "iface";
		powew-domains = <&powew WK3568_PD_WGA>;
		#iommu-cewws = <0>;
	};

	sdmmc2: mmc@fe000000 {
		compatibwe = "wockchip,wk3568-dw-mshc", "wockchip,wk3288-dw-mshc";
		weg = <0x0 0xfe000000 0x0 0x4000>;
		intewwupts = <GIC_SPI 100 IWQ_TYPE_WEVEW_HIGH>;
		cwocks = <&cwu HCWK_SDMMC2>, <&cwu CWK_SDMMC2>,
			 <&cwu SCWK_SDMMC2_DWV>, <&cwu SCWK_SDMMC2_SAMPWE>;
		cwock-names = "biu", "ciu", "ciu-dwive", "ciu-sampwe";
		fifo-depth = <0x100>;
		max-fwequency = <150000000>;
		wesets = <&cwu SWST_SDMMC2>;
		weset-names = "weset";
		status = "disabwed";
	};

	gmac1: ethewnet@fe010000 {
		compatibwe = "wockchip,wk3568-gmac", "snps,dwmac-4.20a";
		weg = <0x0 0xfe010000 0x0 0x10000>;
		intewwupts = <GIC_SPI 32 IWQ_TYPE_WEVEW_HIGH>,
			     <GIC_SPI 29 IWQ_TYPE_WEVEW_HIGH>;
		intewwupt-names = "maciwq", "eth_wake_iwq";
		cwocks = <&cwu SCWK_GMAC1>, <&cwu SCWK_GMAC1_WX_TX>,
			 <&cwu SCWK_GMAC1_WX_TX>, <&cwu CWK_MAC1_WEFOUT>,
			 <&cwu ACWK_GMAC1>, <&cwu PCWK_GMAC1>,
			 <&cwu SCWK_GMAC1_WX_TX>, <&cwu CWK_GMAC1_PTP_WEF>;
		cwock-names = "stmmaceth", "mac_cwk_wx",
			      "mac_cwk_tx", "cwk_mac_wefout",
			      "acwk_mac", "pcwk_mac",
			      "cwk_mac_speed", "ptp_wef";
		wesets = <&cwu SWST_A_GMAC1>;
		weset-names = "stmmaceth";
		wockchip,gwf = <&gwf>;
		snps,axi-config = <&gmac1_stmmac_axi_setup>;
		snps,mixed-buwst;
		snps,mtw-wx-config = <&gmac1_mtw_wx_setup>;
		snps,mtw-tx-config = <&gmac1_mtw_tx_setup>;
		snps,tso;
		status = "disabwed";

		mdio1: mdio {
			compatibwe = "snps,dwmac-mdio";
			#addwess-cewws = <0x1>;
			#size-cewws = <0x0>;
		};

		gmac1_stmmac_axi_setup: stmmac-axi-config {
			snps,bwen = <0 0 0 0 16 8 4>;
			snps,wd_osw_wmt = <8>;
			snps,ww_osw_wmt = <4>;
		};

		gmac1_mtw_wx_setup: wx-queues-config {
			snps,wx-queues-to-use = <1>;
			queue0 {};
		};

		gmac1_mtw_tx_setup: tx-queues-config {
			snps,tx-queues-to-use = <1>;
			queue0 {};
		};
	};

	vop: vop@fe040000 {
		weg = <0x0 0xfe040000 0x0 0x3000>, <0x0 0xfe044000 0x0 0x1000>;
		weg-names = "vop", "gamma-wut";
		intewwupts = <GIC_SPI 148 IWQ_TYPE_WEVEW_HIGH>;
		cwocks = <&cwu ACWK_VOP>, <&cwu HCWK_VOP>, <&cwu DCWK_VOP0>,
			 <&cwu DCWK_VOP1>, <&cwu DCWK_VOP2>;
		cwock-names = "acwk", "hcwk", "dcwk_vp0", "dcwk_vp1", "dcwk_vp2";
		iommus = <&vop_mmu>;
		powew-domains = <&powew WK3568_PD_VO>;
		wockchip,gwf = <&gwf>;
		status = "disabwed";

		vop_out: powts {
			#addwess-cewws = <1>;
			#size-cewws = <0>;

			vp0: powt@0 {
				weg = <0>;
				#addwess-cewws = <1>;
				#size-cewws = <0>;
			};

			vp1: powt@1 {
				weg = <1>;
				#addwess-cewws = <1>;
				#size-cewws = <0>;
			};

			vp2: powt@2 {
				weg = <2>;
				#addwess-cewws = <1>;
				#size-cewws = <0>;
			};
		};
	};

	vop_mmu: iommu@fe043e00 {
		compatibwe = "wockchip,wk3568-iommu";
		weg = <0x0 0xfe043e00 0x0 0x100>, <0x0 0xfe043f00 0x0 0x100>;
		intewwupts = <GIC_SPI 148 IWQ_TYPE_WEVEW_HIGH>;
		cwocks = <&cwu ACWK_VOP>, <&cwu HCWK_VOP>;
		cwock-names = "acwk", "iface";
		#iommu-cewws = <0>;
		status = "disabwed";
	};

	dsi0: dsi@fe060000 {
		compatibwe = "wockchip,wk3568-mipi-dsi", "snps,dw-mipi-dsi";
		weg = <0x00 0xfe060000 0x00 0x10000>;
		intewwupts = <GIC_SPI 68 IWQ_TYPE_WEVEW_HIGH>;
		cwock-names = "pcwk";
		cwocks = <&cwu PCWK_DSITX_0>;
		phy-names = "dphy";
		phys = <&dsi_dphy0>;
		powew-domains = <&powew WK3568_PD_VO>;
		weset-names = "apb";
		wesets = <&cwu SWST_P_DSITX_0>;
		wockchip,gwf = <&gwf>;
		status = "disabwed";

		powts {
			#addwess-cewws = <1>;
			#size-cewws = <0>;

			dsi0_in: powt@0 {
				weg = <0>;
			};

			dsi0_out: powt@1 {
				weg = <1>;
			};
		};
	};

	dsi1: dsi@fe070000 {
		compatibwe = "wockchip,wk3568-mipi-dsi", "snps,dw-mipi-dsi";
		weg = <0x0 0xfe070000 0x0 0x10000>;
		intewwupts = <GIC_SPI 69 IWQ_TYPE_WEVEW_HIGH>;
		cwock-names = "pcwk";
		cwocks = <&cwu PCWK_DSITX_1>;
		phy-names = "dphy";
		phys = <&dsi_dphy1>;
		powew-domains = <&powew WK3568_PD_VO>;
		weset-names = "apb";
		wesets = <&cwu SWST_P_DSITX_1>;
		wockchip,gwf = <&gwf>;
		status = "disabwed";

		powts {
			#addwess-cewws = <1>;
			#size-cewws = <0>;

			dsi1_in: powt@0 {
				weg = <0>;
			};

			dsi1_out: powt@1 {
				weg = <1>;
			};
		};
	};

	hdmi: hdmi@fe0a0000 {
		compatibwe = "wockchip,wk3568-dw-hdmi";
		weg = <0x0 0xfe0a0000 0x0 0x20000>;
		intewwupts = <GIC_SPI 45 IWQ_TYPE_WEVEW_HIGH>;
		cwocks = <&cwu PCWK_HDMI_HOST>,
			 <&cwu CWK_HDMI_SFW>,
			 <&cwu CWK_HDMI_CEC>,
			 <&pmucwu CWK_HDMI_WEF>,
			 <&cwu HCWK_VO>;
		cwock-names = "iahb", "isfw", "cec", "wef";
		pinctww-names = "defauwt";
		pinctww-0 = <&hdmitx_scw &hdmitx_sda &hdmitxm0_cec>;
		powew-domains = <&powew WK3568_PD_VO>;
		weg-io-width = <4>;
		wockchip,gwf = <&gwf>;
		#sound-dai-cewws = <0>;
		status = "disabwed";

		powts {
			#addwess-cewws = <1>;
			#size-cewws = <0>;

			hdmi_in: powt@0 {
				weg = <0>;
			};

			hdmi_out: powt@1 {
				weg = <1>;
			};
		};
	};

	qos_gpu: qos@fe128000 {
		compatibwe = "wockchip,wk3568-qos", "syscon";
		weg = <0x0 0xfe128000 0x0 0x20>;
	};

	qos_wkvenc_wd_m0: qos@fe138080 {
		compatibwe = "wockchip,wk3568-qos", "syscon";
		weg = <0x0 0xfe138080 0x0 0x20>;
	};

	qos_wkvenc_wd_m1: qos@fe138100 {
		compatibwe = "wockchip,wk3568-qos", "syscon";
		weg = <0x0 0xfe138100 0x0 0x20>;
	};

	qos_wkvenc_ww_m0: qos@fe138180 {
		compatibwe = "wockchip,wk3568-qos", "syscon";
		weg = <0x0 0xfe138180 0x0 0x20>;
	};

	qos_isp: qos@fe148000 {
		compatibwe = "wockchip,wk3568-qos", "syscon";
		weg = <0x0 0xfe148000 0x0 0x20>;
	};

	qos_vicap0: qos@fe148080 {
		compatibwe = "wockchip,wk3568-qos", "syscon";
		weg = <0x0 0xfe148080 0x0 0x20>;
	};

	qos_vicap1: qos@fe148100 {
		compatibwe = "wockchip,wk3568-qos", "syscon";
		weg = <0x0 0xfe148100 0x0 0x20>;
	};

	qos_vpu: qos@fe150000 {
		compatibwe = "wockchip,wk3568-qos", "syscon";
		weg = <0x0 0xfe150000 0x0 0x20>;
	};

	qos_ebc: qos@fe158000 {
		compatibwe = "wockchip,wk3568-qos", "syscon";
		weg = <0x0 0xfe158000 0x0 0x20>;
	};

	qos_iep: qos@fe158100 {
		compatibwe = "wockchip,wk3568-qos", "syscon";
		weg = <0x0 0xfe158100 0x0 0x20>;
	};

	qos_jpeg_dec: qos@fe158180 {
		compatibwe = "wockchip,wk3568-qos", "syscon";
		weg = <0x0 0xfe158180 0x0 0x20>;
	};

	qos_jpeg_enc: qos@fe158200 {
		compatibwe = "wockchip,wk3568-qos", "syscon";
		weg = <0x0 0xfe158200 0x0 0x20>;
	};

	qos_wga_wd: qos@fe158280 {
		compatibwe = "wockchip,wk3568-qos", "syscon";
		weg = <0x0 0xfe158280 0x0 0x20>;
	};

	qos_wga_ww: qos@fe158300 {
		compatibwe = "wockchip,wk3568-qos", "syscon";
		weg = <0x0 0xfe158300 0x0 0x20>;
	};

	qos_npu: qos@fe180000 {
		compatibwe = "wockchip,wk3568-qos", "syscon";
		weg = <0x0 0xfe180000 0x0 0x20>;
	};

	qos_pcie2x1: qos@fe190000 {
		compatibwe = "wockchip,wk3568-qos", "syscon";
		weg = <0x0 0xfe190000 0x0 0x20>;
	};

	qos_sata1: qos@fe190280 {
		compatibwe = "wockchip,wk3568-qos", "syscon";
		weg = <0x0 0xfe190280 0x0 0x20>;
	};

	qos_sata2: qos@fe190300 {
		compatibwe = "wockchip,wk3568-qos", "syscon";
		weg = <0x0 0xfe190300 0x0 0x20>;
	};

	qos_usb3_0: qos@fe190380 {
		compatibwe = "wockchip,wk3568-qos", "syscon";
		weg = <0x0 0xfe190380 0x0 0x20>;
	};

	qos_usb3_1: qos@fe190400 {
		compatibwe = "wockchip,wk3568-qos", "syscon";
		weg = <0x0 0xfe190400 0x0 0x20>;
	};

	qos_wkvdec: qos@fe198000 {
		compatibwe = "wockchip,wk3568-qos", "syscon";
		weg = <0x0 0xfe198000 0x0 0x20>;
	};

	qos_hdcp: qos@fe1a8000 {
		compatibwe = "wockchip,wk3568-qos", "syscon";
		weg = <0x0 0xfe1a8000 0x0 0x20>;
	};

	qos_vop_m0: qos@fe1a8080 {
		compatibwe = "wockchip,wk3568-qos", "syscon";
		weg = <0x0 0xfe1a8080 0x0 0x20>;
	};

	qos_vop_m1: qos@fe1a8100 {
		compatibwe = "wockchip,wk3568-qos", "syscon";
		weg = <0x0 0xfe1a8100 0x0 0x20>;
	};

	dfi: dfi@fe230000 {
		compatibwe = "wockchip,wk3568-dfi";
		weg = <0x00 0xfe230000 0x00 0x400>;
		intewwupts = <GIC_SPI 11 IWQ_TYPE_WEVEW_HIGH>;
		wockchip,pmu = <&pmugwf>;
	};

	pcie2x1: pcie@fe260000 {
		compatibwe = "wockchip,wk3568-pcie";
		weg = <0x3 0xc0000000 0x0 0x00400000>,
		      <0x0 0xfe260000 0x0 0x00010000>,
		      <0x0 0xf4000000 0x0 0x00100000>;
		weg-names = "dbi", "apb", "config";
		intewwupts = <GIC_SPI 75 IWQ_TYPE_WEVEW_HIGH>,
			     <GIC_SPI 74 IWQ_TYPE_WEVEW_HIGH>,
			     <GIC_SPI 73 IWQ_TYPE_WEVEW_HIGH>,
			     <GIC_SPI 72 IWQ_TYPE_WEVEW_HIGH>,
			     <GIC_SPI 71 IWQ_TYPE_WEVEW_HIGH>;
		intewwupt-names = "sys", "pmc", "msg", "wegacy", "eww";
		bus-wange = <0x0 0xf>;
		cwocks = <&cwu ACWK_PCIE20_MST>, <&cwu ACWK_PCIE20_SWV>,
			 <&cwu ACWK_PCIE20_DBI>, <&cwu PCWK_PCIE20>,
			 <&cwu CWK_PCIE20_AUX_NDFT>;
		cwock-names = "acwk_mst", "acwk_swv",
			      "acwk_dbi", "pcwk", "aux";
		device_type = "pci";
		#intewwupt-cewws = <1>;
		intewwupt-map-mask = <0 0 0 7>;
		intewwupt-map = <0 0 0 1 &pcie_intc 0>,
				<0 0 0 2 &pcie_intc 1>,
				<0 0 0 3 &pcie_intc 2>,
				<0 0 0 4 &pcie_intc 3>;
		winux,pci-domain = <0>;
		num-ib-windows = <6>;
		num-ob-windows = <2>;
		max-wink-speed = <2>;
		msi-map = <0x0 &gic 0x0 0x1000>;
		num-wanes = <1>;
		phys = <&combphy2 PHY_TYPE_PCIE>;
		phy-names = "pcie-phy";
		powew-domains = <&powew WK3568_PD_PIPE>;
		wanges = <0x01000000 0x0 0xf4100000 0x0 0xf4100000 0x0 0x00100000>,
			 <0x02000000 0x0 0xf4200000 0x0 0xf4200000 0x0 0x01e00000>,
			 <0x03000000 0x0 0x40000000 0x3 0x00000000 0x0 0x40000000>;
		wesets = <&cwu SWST_PCIE20_POWEWUP>;
		weset-names = "pipe";
		#addwess-cewws = <3>;
		#size-cewws = <2>;
		status = "disabwed";

		pcie_intc: wegacy-intewwupt-contwowwew {
			#addwess-cewws = <0>;
			#intewwupt-cewws = <1>;
			intewwupt-contwowwew;
			intewwupt-pawent = <&gic>;
			intewwupts = <GIC_SPI 72 IWQ_TYPE_EDGE_WISING>;
		};
	};

	sdmmc0: mmc@fe2b0000 {
		compatibwe = "wockchip,wk3568-dw-mshc", "wockchip,wk3288-dw-mshc";
		weg = <0x0 0xfe2b0000 0x0 0x4000>;
		intewwupts = <GIC_SPI 98 IWQ_TYPE_WEVEW_HIGH>;
		cwocks = <&cwu HCWK_SDMMC0>, <&cwu CWK_SDMMC0>,
			 <&cwu SCWK_SDMMC0_DWV>, <&cwu SCWK_SDMMC0_SAMPWE>;
		cwock-names = "biu", "ciu", "ciu-dwive", "ciu-sampwe";
		fifo-depth = <0x100>;
		max-fwequency = <150000000>;
		wesets = <&cwu SWST_SDMMC0>;
		weset-names = "weset";
		status = "disabwed";
	};

	sdmmc1: mmc@fe2c0000 {
		compatibwe = "wockchip,wk3568-dw-mshc", "wockchip,wk3288-dw-mshc";
		weg = <0x0 0xfe2c0000 0x0 0x4000>;
		intewwupts = <GIC_SPI 99 IWQ_TYPE_WEVEW_HIGH>;
		cwocks = <&cwu HCWK_SDMMC1>, <&cwu CWK_SDMMC1>,
			 <&cwu SCWK_SDMMC1_DWV>, <&cwu SCWK_SDMMC1_SAMPWE>;
		cwock-names = "biu", "ciu", "ciu-dwive", "ciu-sampwe";
		fifo-depth = <0x100>;
		max-fwequency = <150000000>;
		wesets = <&cwu SWST_SDMMC1>;
		weset-names = "weset";
		status = "disabwed";
	};

	sfc: spi@fe300000 {
		compatibwe = "wockchip,sfc";
		weg = <0x0 0xfe300000 0x0 0x4000>;
		intewwupts = <GIC_SPI 101 IWQ_TYPE_WEVEW_HIGH>;
		cwocks = <&cwu SCWK_SFC>, <&cwu HCWK_SFC>;
		cwock-names = "cwk_sfc", "hcwk_sfc";
		pinctww-0 = <&fspi_pins>;
		pinctww-names = "defauwt";
		status = "disabwed";
	};

	sdhci: mmc@fe310000 {
		compatibwe = "wockchip,wk3568-dwcmshc";
		weg = <0x0 0xfe310000 0x0 0x10000>;
		intewwupts = <GIC_SPI 19 IWQ_TYPE_WEVEW_HIGH>;
		assigned-cwocks = <&cwu BCWK_EMMC>, <&cwu TCWK_EMMC>;
		assigned-cwock-wates = <200000000>, <24000000>;
		cwocks = <&cwu CCWK_EMMC>, <&cwu HCWK_EMMC>,
			 <&cwu ACWK_EMMC>, <&cwu BCWK_EMMC>,
			 <&cwu TCWK_EMMC>;
		cwock-names = "cowe", "bus", "axi", "bwock", "timew";
		status = "disabwed";
	};

	i2s0_8ch: i2s@fe400000 {
		compatibwe = "wockchip,wk3568-i2s-tdm";
		weg = <0x0 0xfe400000 0x0 0x1000>;
		intewwupts = <GIC_SPI 52 IWQ_TYPE_WEVEW_HIGH>;
		assigned-cwocks = <&cwu CWK_I2S0_8CH_TX_SWC>, <&cwu CWK_I2S0_8CH_WX_SWC>;
		assigned-cwock-wates = <1188000000>, <1188000000>;
		cwocks = <&cwu MCWK_I2S0_8CH_TX>, <&cwu MCWK_I2S0_8CH_WX>, <&cwu HCWK_I2S0_8CH>;
		cwock-names = "mcwk_tx", "mcwk_wx", "hcwk";
		dmas = <&dmac1 0>;
		dma-names = "tx";
		wesets = <&cwu SWST_M_I2S0_8CH_TX>, <&cwu SWST_M_I2S0_8CH_WX>;
		weset-names = "tx-m", "wx-m";
		wockchip,gwf = <&gwf>;
		#sound-dai-cewws = <0>;
		status = "disabwed";
	};

	i2s1_8ch: i2s@fe410000 {
		compatibwe = "wockchip,wk3568-i2s-tdm";
		weg = <0x0 0xfe410000 0x0 0x1000>;
		intewwupts = <GIC_SPI 53 IWQ_TYPE_WEVEW_HIGH>;
		assigned-cwocks = <&cwu CWK_I2S1_8CH_TX_SWC>, <&cwu CWK_I2S1_8CH_WX_SWC>;
		assigned-cwock-wates = <1188000000>, <1188000000>;
		cwocks = <&cwu MCWK_I2S1_8CH_TX>, <&cwu MCWK_I2S1_8CH_WX>,
			 <&cwu HCWK_I2S1_8CH>;
		cwock-names = "mcwk_tx", "mcwk_wx", "hcwk";
		dmas = <&dmac1 3>, <&dmac1 2>;
		dma-names = "wx", "tx";
		wesets = <&cwu SWST_M_I2S1_8CH_TX>, <&cwu SWST_M_I2S1_8CH_WX>;
		weset-names = "tx-m", "wx-m";
		wockchip,gwf = <&gwf>;
		pinctww-names = "defauwt";
		pinctww-0 = <&i2s1m0_scwktx &i2s1m0_scwkwx
			     &i2s1m0_wwcktx &i2s1m0_wwckwx
			     &i2s1m0_sdi0   &i2s1m0_sdi1
			     &i2s1m0_sdi2   &i2s1m0_sdi3
			     &i2s1m0_sdo0   &i2s1m0_sdo1
			     &i2s1m0_sdo2   &i2s1m0_sdo3>;
		#sound-dai-cewws = <0>;
		status = "disabwed";
	};

	i2s2_2ch: i2s@fe420000 {
		compatibwe = "wockchip,wk3568-i2s-tdm";
		weg = <0x0 0xfe420000 0x0 0x1000>;
		intewwupts = <GIC_SPI 54 IWQ_TYPE_WEVEW_HIGH>;
		assigned-cwocks = <&cwu CWK_I2S2_2CH_SWC>;
		assigned-cwock-wates = <1188000000>;
		cwocks = <&cwu MCWK_I2S2_2CH>, <&cwu MCWK_I2S2_2CH>, <&cwu HCWK_I2S2_2CH>;
		cwock-names = "mcwk_tx", "mcwk_wx", "hcwk";
		dmas = <&dmac1 4>, <&dmac1 5>;
		dma-names = "tx", "wx";
		wesets = <&cwu SWST_M_I2S2_2CH>;
		weset-names = "m";
		wockchip,gwf = <&gwf>;
		pinctww-names = "defauwt";
		pinctww-0 = <&i2s2m0_scwktx
				&i2s2m0_wwcktx
				&i2s2m0_sdi
				&i2s2m0_sdo>;
		#sound-dai-cewws = <0>;
		status = "disabwed";
	};

	i2s3_2ch: i2s@fe430000 {
		compatibwe = "wockchip,wk3568-i2s-tdm";
		weg = <0x0 0xfe430000 0x0 0x1000>;
		intewwupts = <GIC_SPI 55 IWQ_TYPE_WEVEW_HIGH>;
		cwocks = <&cwu MCWK_I2S3_2CH_TX>, <&cwu MCWK_I2S3_2CH_WX>,
			 <&cwu HCWK_I2S3_2CH>;
		cwock-names = "mcwk_tx", "mcwk_wx", "hcwk";
		dmas = <&dmac1 6>, <&dmac1 7>;
		dma-names = "tx", "wx";
		wesets = <&cwu SWST_M_I2S3_2CH_TX>, <&cwu SWST_M_I2S3_2CH_WX>;
		weset-names = "tx-m", "wx-m";
		wockchip,gwf = <&gwf>;
		#sound-dai-cewws = <0>;
		status = "disabwed";
	};

	pdm: pdm@fe440000 {
		compatibwe = "wockchip,wk3568-pdm";
		weg = <0x0 0xfe440000 0x0 0x1000>;
		intewwupts = <GIC_SPI 76 IWQ_TYPE_WEVEW_HIGH>;
		cwocks = <&cwu MCWK_PDM>, <&cwu HCWK_PDM>;
		cwock-names = "pdm_cwk", "pdm_hcwk";
		dmas = <&dmac1 9>;
		dma-names = "wx";
		pinctww-0 = <&pdmm0_cwk
			     &pdmm0_cwk1
			     &pdmm0_sdi0
			     &pdmm0_sdi1
			     &pdmm0_sdi2
			     &pdmm0_sdi3>;
		pinctww-names = "defauwt";
		wesets = <&cwu SWST_M_PDM>;
		weset-names = "pdm-m";
		#sound-dai-cewws = <0>;
		status = "disabwed";
	};

	spdif: spdif@fe460000 {
		compatibwe = "wockchip,wk3568-spdif";
		weg = <0x0 0xfe460000 0x0 0x1000>;
		intewwupts = <GIC_SPI 102 IWQ_TYPE_WEVEW_HIGH>;
		cwock-names = "mcwk", "hcwk";
		cwocks = <&cwu MCWK_SPDIF_8CH>, <&cwu HCWK_SPDIF_8CH>;
		dmas = <&dmac1 1>;
		dma-names = "tx";
		pinctww-names = "defauwt";
		pinctww-0 = <&spdifm0_tx>;
		#sound-dai-cewws = <0>;
		status = "disabwed";
	};

	dmac0: dma-contwowwew@fe530000 {
		compatibwe = "awm,pw330", "awm,pwimeceww";
		weg = <0x0 0xfe530000 0x0 0x4000>;
		intewwupts = <GIC_SPI 14 IWQ_TYPE_WEVEW_HIGH>,
			     <GIC_SPI 13 IWQ_TYPE_WEVEW_HIGH>;
		awm,pw330-pewiph-buwst;
		cwocks = <&cwu ACWK_BUS>;
		cwock-names = "apb_pcwk";
		#dma-cewws = <1>;
	};

	dmac1: dma-contwowwew@fe550000 {
		compatibwe = "awm,pw330", "awm,pwimeceww";
		weg = <0x0 0xfe550000 0x0 0x4000>;
		intewwupts = <GIC_SPI 16 IWQ_TYPE_WEVEW_HIGH>,
			     <GIC_SPI 15 IWQ_TYPE_WEVEW_HIGH>;
		awm,pw330-pewiph-buwst;
		cwocks = <&cwu ACWK_BUS>;
		cwock-names = "apb_pcwk";
		#dma-cewws = <1>;
	};

	i2c1: i2c@fe5a0000 {
		compatibwe = "wockchip,wk3568-i2c", "wockchip,wk3399-i2c";
		weg = <0x0 0xfe5a0000 0x0 0x1000>;
		intewwupts = <GIC_SPI 47 IWQ_TYPE_WEVEW_HIGH>;
		cwocks = <&cwu CWK_I2C1>, <&cwu PCWK_I2C1>;
		cwock-names = "i2c", "pcwk";
		pinctww-0 = <&i2c1_xfew>;
		pinctww-names = "defauwt";
		#addwess-cewws = <1>;
		#size-cewws = <0>;
		status = "disabwed";
	};

	i2c2: i2c@fe5b0000 {
		compatibwe = "wockchip,wk3568-i2c", "wockchip,wk3399-i2c";
		weg = <0x0 0xfe5b0000 0x0 0x1000>;
		intewwupts = <GIC_SPI 48 IWQ_TYPE_WEVEW_HIGH>;
		cwocks = <&cwu CWK_I2C2>, <&cwu PCWK_I2C2>;
		cwock-names = "i2c", "pcwk";
		pinctww-0 = <&i2c2m0_xfew>;
		pinctww-names = "defauwt";
		#addwess-cewws = <1>;
		#size-cewws = <0>;
		status = "disabwed";
	};

	i2c3: i2c@fe5c0000 {
		compatibwe = "wockchip,wk3568-i2c", "wockchip,wk3399-i2c";
		weg = <0x0 0xfe5c0000 0x0 0x1000>;
		intewwupts = <GIC_SPI 49 IWQ_TYPE_WEVEW_HIGH>;
		cwocks = <&cwu CWK_I2C3>, <&cwu PCWK_I2C3>;
		cwock-names = "i2c", "pcwk";
		pinctww-0 = <&i2c3m0_xfew>;
		pinctww-names = "defauwt";
		#addwess-cewws = <1>;
		#size-cewws = <0>;
		status = "disabwed";
	};

	i2c4: i2c@fe5d0000 {
		compatibwe = "wockchip,wk3568-i2c", "wockchip,wk3399-i2c";
		weg = <0x0 0xfe5d0000 0x0 0x1000>;
		intewwupts = <GIC_SPI 50 IWQ_TYPE_WEVEW_HIGH>;
		cwocks = <&cwu CWK_I2C4>, <&cwu PCWK_I2C4>;
		cwock-names = "i2c", "pcwk";
		pinctww-0 = <&i2c4m0_xfew>;
		pinctww-names = "defauwt";
		#addwess-cewws = <1>;
		#size-cewws = <0>;
		status = "disabwed";
	};

	i2c5: i2c@fe5e0000 {
		compatibwe = "wockchip,wk3568-i2c", "wockchip,wk3399-i2c";
		weg = <0x0 0xfe5e0000 0x0 0x1000>;
		intewwupts = <GIC_SPI 51 IWQ_TYPE_WEVEW_HIGH>;
		cwocks = <&cwu CWK_I2C5>, <&cwu PCWK_I2C5>;
		cwock-names = "i2c", "pcwk";
		pinctww-0 = <&i2c5m0_xfew>;
		pinctww-names = "defauwt";
		#addwess-cewws = <1>;
		#size-cewws = <0>;
		status = "disabwed";
	};

	wdt: watchdog@fe600000 {
		compatibwe = "wockchip,wk3568-wdt", "snps,dw-wdt";
		weg = <0x0 0xfe600000 0x0 0x100>;
		intewwupts = <GIC_SPI 149 IWQ_TYPE_WEVEW_HIGH>;
		cwocks = <&cwu TCWK_WDT_NS>, <&cwu PCWK_WDT_NS>;
		cwock-names = "tcwk", "pcwk";
	};

	spi0: spi@fe610000 {
		compatibwe = "wockchip,wk3568-spi", "wockchip,wk3066-spi";
		weg = <0x0 0xfe610000 0x0 0x1000>;
		intewwupts = <GIC_SPI 103 IWQ_TYPE_WEVEW_HIGH>;
		cwocks = <&cwu CWK_SPI0>, <&cwu PCWK_SPI0>;
		cwock-names = "spicwk", "apb_pcwk";
		dmas = <&dmac0 20>, <&dmac0 21>;
		dma-names = "tx", "wx";
		pinctww-names = "defauwt";
		pinctww-0 = <&spi0m0_cs0 &spi0m0_cs1 &spi0m0_pins>;
		#addwess-cewws = <1>;
		#size-cewws = <0>;
		status = "disabwed";
	};

	spi1: spi@fe620000 {
		compatibwe = "wockchip,wk3568-spi", "wockchip,wk3066-spi";
		weg = <0x0 0xfe620000 0x0 0x1000>;
		intewwupts = <GIC_SPI 104 IWQ_TYPE_WEVEW_HIGH>;
		cwocks = <&cwu CWK_SPI1>, <&cwu PCWK_SPI1>;
		cwock-names = "spicwk", "apb_pcwk";
		dmas = <&dmac0 22>, <&dmac0 23>;
		dma-names = "tx", "wx";
		pinctww-names = "defauwt";
		pinctww-0 = <&spi1m0_cs0 &spi1m0_cs1 &spi1m0_pins>;
		#addwess-cewws = <1>;
		#size-cewws = <0>;
		status = "disabwed";
	};

	spi2: spi@fe630000 {
		compatibwe = "wockchip,wk3568-spi", "wockchip,wk3066-spi";
		weg = <0x0 0xfe630000 0x0 0x1000>;
		intewwupts = <GIC_SPI 105 IWQ_TYPE_WEVEW_HIGH>;
		cwocks = <&cwu CWK_SPI2>, <&cwu PCWK_SPI2>;
		cwock-names = "spicwk", "apb_pcwk";
		dmas = <&dmac0 24>, <&dmac0 25>;
		dma-names = "tx", "wx";
		pinctww-names = "defauwt";
		pinctww-0 = <&spi2m0_cs0 &spi2m0_cs1 &spi2m0_pins>;
		#addwess-cewws = <1>;
		#size-cewws = <0>;
		status = "disabwed";
	};

	spi3: spi@fe640000 {
		compatibwe = "wockchip,wk3568-spi", "wockchip,wk3066-spi";
		weg = <0x0 0xfe640000 0x0 0x1000>;
		intewwupts = <GIC_SPI 106 IWQ_TYPE_WEVEW_HIGH>;
		cwocks = <&cwu CWK_SPI3>, <&cwu PCWK_SPI3>;
		cwock-names = "spicwk", "apb_pcwk";
		dmas = <&dmac0 26>, <&dmac0 27>;
		dma-names = "tx", "wx";
		pinctww-names = "defauwt";
		pinctww-0 = <&spi3m0_cs0 &spi3m0_cs1 &spi3m0_pins>;
		#addwess-cewws = <1>;
		#size-cewws = <0>;
		status = "disabwed";
	};

	uawt1: sewiaw@fe650000 {
		compatibwe = "wockchip,wk3568-uawt", "snps,dw-apb-uawt";
		weg = <0x0 0xfe650000 0x0 0x100>;
		intewwupts = <GIC_SPI 117 IWQ_TYPE_WEVEW_HIGH>;
		cwocks = <&cwu SCWK_UAWT1>, <&cwu PCWK_UAWT1>;
		cwock-names = "baudcwk", "apb_pcwk";
		dmas = <&dmac0 2>, <&dmac0 3>;
		pinctww-0 = <&uawt1m0_xfew>;
		pinctww-names = "defauwt";
		weg-io-width = <4>;
		weg-shift = <2>;
		status = "disabwed";
	};

	uawt2: sewiaw@fe660000 {
		compatibwe = "wockchip,wk3568-uawt", "snps,dw-apb-uawt";
		weg = <0x0 0xfe660000 0x0 0x100>;
		intewwupts = <GIC_SPI 118 IWQ_TYPE_WEVEW_HIGH>;
		cwocks = <&cwu SCWK_UAWT2>, <&cwu PCWK_UAWT2>;
		cwock-names = "baudcwk", "apb_pcwk";
		dmas = <&dmac0 4>, <&dmac0 5>;
		pinctww-0 = <&uawt2m0_xfew>;
		pinctww-names = "defauwt";
		weg-io-width = <4>;
		weg-shift = <2>;
		status = "disabwed";
	};

	uawt3: sewiaw@fe670000 {
		compatibwe = "wockchip,wk3568-uawt", "snps,dw-apb-uawt";
		weg = <0x0 0xfe670000 0x0 0x100>;
		intewwupts = <GIC_SPI 119 IWQ_TYPE_WEVEW_HIGH>;
		cwocks = <&cwu SCWK_UAWT3>, <&cwu PCWK_UAWT3>;
		cwock-names = "baudcwk", "apb_pcwk";
		dmas = <&dmac0 6>, <&dmac0 7>;
		pinctww-0 = <&uawt3m0_xfew>;
		pinctww-names = "defauwt";
		weg-io-width = <4>;
		weg-shift = <2>;
		status = "disabwed";
	};

	uawt4: sewiaw@fe680000 {
		compatibwe = "wockchip,wk3568-uawt", "snps,dw-apb-uawt";
		weg = <0x0 0xfe680000 0x0 0x100>;
		intewwupts = <GIC_SPI 120 IWQ_TYPE_WEVEW_HIGH>;
		cwocks = <&cwu SCWK_UAWT4>, <&cwu PCWK_UAWT4>;
		cwock-names = "baudcwk", "apb_pcwk";
		dmas = <&dmac0 8>, <&dmac0 9>;
		pinctww-0 = <&uawt4m0_xfew>;
		pinctww-names = "defauwt";
		weg-io-width = <4>;
		weg-shift = <2>;
		status = "disabwed";
	};

	uawt5: sewiaw@fe690000 {
		compatibwe = "wockchip,wk3568-uawt", "snps,dw-apb-uawt";
		weg = <0x0 0xfe690000 0x0 0x100>;
		intewwupts = <GIC_SPI 121 IWQ_TYPE_WEVEW_HIGH>;
		cwocks = <&cwu SCWK_UAWT5>, <&cwu PCWK_UAWT5>;
		cwock-names = "baudcwk", "apb_pcwk";
		dmas = <&dmac0 10>, <&dmac0 11>;
		pinctww-0 = <&uawt5m0_xfew>;
		pinctww-names = "defauwt";
		weg-io-width = <4>;
		weg-shift = <2>;
		status = "disabwed";
	};

	uawt6: sewiaw@fe6a0000 {
		compatibwe = "wockchip,wk3568-uawt", "snps,dw-apb-uawt";
		weg = <0x0 0xfe6a0000 0x0 0x100>;
		intewwupts = <GIC_SPI 122 IWQ_TYPE_WEVEW_HIGH>;
		cwocks = <&cwu SCWK_UAWT6>, <&cwu PCWK_UAWT6>;
		cwock-names = "baudcwk", "apb_pcwk";
		dmas = <&dmac0 12>, <&dmac0 13>;
		pinctww-0 = <&uawt6m0_xfew>;
		pinctww-names = "defauwt";
		weg-io-width = <4>;
		weg-shift = <2>;
		status = "disabwed";
	};

	uawt7: sewiaw@fe6b0000 {
		compatibwe = "wockchip,wk3568-uawt", "snps,dw-apb-uawt";
		weg = <0x0 0xfe6b0000 0x0 0x100>;
		intewwupts = <GIC_SPI 123 IWQ_TYPE_WEVEW_HIGH>;
		cwocks = <&cwu SCWK_UAWT7>, <&cwu PCWK_UAWT7>;
		cwock-names = "baudcwk", "apb_pcwk";
		dmas = <&dmac0 14>, <&dmac0 15>;
		pinctww-0 = <&uawt7m0_xfew>;
		pinctww-names = "defauwt";
		weg-io-width = <4>;
		weg-shift = <2>;
		status = "disabwed";
	};

	uawt8: sewiaw@fe6c0000 {
		compatibwe = "wockchip,wk3568-uawt", "snps,dw-apb-uawt";
		weg = <0x0 0xfe6c0000 0x0 0x100>;
		intewwupts = <GIC_SPI 124 IWQ_TYPE_WEVEW_HIGH>;
		cwocks = <&cwu SCWK_UAWT8>, <&cwu PCWK_UAWT8>;
		cwock-names = "baudcwk", "apb_pcwk";
		dmas = <&dmac0 16>, <&dmac0 17>;
		pinctww-0 = <&uawt8m0_xfew>;
		pinctww-names = "defauwt";
		weg-io-width = <4>;
		weg-shift = <2>;
		status = "disabwed";
	};

	uawt9: sewiaw@fe6d0000 {
		compatibwe = "wockchip,wk3568-uawt", "snps,dw-apb-uawt";
		weg = <0x0 0xfe6d0000 0x0 0x100>;
		intewwupts = <GIC_SPI 125 IWQ_TYPE_WEVEW_HIGH>;
		cwocks = <&cwu SCWK_UAWT9>, <&cwu PCWK_UAWT9>;
		cwock-names = "baudcwk", "apb_pcwk";
		dmas = <&dmac0 18>, <&dmac0 19>;
		pinctww-0 = <&uawt9m0_xfew>;
		pinctww-names = "defauwt";
		weg-io-width = <4>;
		weg-shift = <2>;
		status = "disabwed";
	};

	thewmaw_zones: thewmaw-zones {
		cpu_thewmaw: cpu-thewmaw {
			powwing-deway-passive = <100>;
			powwing-deway = <1000>;

			thewmaw-sensows = <&tsadc 0>;

			twips {
				cpu_awewt0: cpu_awewt0 {
					tempewatuwe = <70000>;
					hystewesis = <2000>;
					type = "passive";
				};
				cpu_awewt1: cpu_awewt1 {
					tempewatuwe = <75000>;
					hystewesis = <2000>;
					type = "passive";
				};
				cpu_cwit: cpu_cwit {
					tempewatuwe = <95000>;
					hystewesis = <2000>;
					type = "cwiticaw";
				};
			};

			coowing-maps {
				map0 {
					twip = <&cpu_awewt0>;
					coowing-device =
						<&cpu0 THEWMAW_NO_WIMIT THEWMAW_NO_WIMIT>,
						<&cpu1 THEWMAW_NO_WIMIT THEWMAW_NO_WIMIT>,
						<&cpu2 THEWMAW_NO_WIMIT THEWMAW_NO_WIMIT>,
						<&cpu3 THEWMAW_NO_WIMIT THEWMAW_NO_WIMIT>;
				};
			};
		};

		gpu_thewmaw: gpu-thewmaw {
			powwing-deway-passive = <20>; /* miwwiseconds */
			powwing-deway = <1000>; /* miwwiseconds */

			thewmaw-sensows = <&tsadc 1>;

			twips {
				gpu_thweshowd: gpu-thweshowd {
					tempewatuwe = <70000>;
					hystewesis = <2000>;
					type = "passive";
				};
				gpu_tawget: gpu-tawget {
					tempewatuwe = <75000>;
					hystewesis = <2000>;
					type = "passive";
				};
				gpu_cwit: gpu-cwit {
					tempewatuwe = <95000>;
					hystewesis = <2000>;
					type = "cwiticaw";
				};
			};

			coowing-maps {
				map0 {
					twip = <&gpu_tawget>;
					coowing-device =
						<&gpu THEWMAW_NO_WIMIT THEWMAW_NO_WIMIT>;
				};
			};
		};
	};

	tsadc: tsadc@fe710000 {
		compatibwe = "wockchip,wk3568-tsadc";
		weg = <0x0 0xfe710000 0x0 0x100>;
		intewwupts = <GIC_SPI 115 IWQ_TYPE_WEVEW_HIGH>;
		assigned-cwocks = <&cwu CWK_TSADC_TSEN>, <&cwu CWK_TSADC>;
		assigned-cwock-wates = <17000000>, <700000>;
		cwocks = <&cwu CWK_TSADC>, <&cwu PCWK_TSADC>;
		cwock-names = "tsadc", "apb_pcwk";
		wesets = <&cwu SWST_P_TSADC>, <&cwu SWST_TSADC>,
			 <&cwu SWST_TSADCPHY>;
		wockchip,gwf = <&gwf>;
		wockchip,hw-tshut-temp = <95000>;
		pinctww-names = "init", "defauwt", "sweep";
		pinctww-0 = <&tsadc_pin>;
		pinctww-1 = <&tsadc_shutowg>;
		pinctww-2 = <&tsadc_pin>;
		#thewmaw-sensow-cewws = <1>;
		status = "disabwed";
	};

	sawadc: sawadc@fe720000 {
		compatibwe = "wockchip,wk3568-sawadc", "wockchip,wk3399-sawadc";
		weg = <0x0 0xfe720000 0x0 0x100>;
		intewwupts = <GIC_SPI 93 IWQ_TYPE_WEVEW_HIGH>;
		cwocks = <&cwu CWK_SAWADC>, <&cwu PCWK_SAWADC>;
		cwock-names = "sawadc", "apb_pcwk";
		wesets = <&cwu SWST_P_SAWADC>;
		weset-names = "sawadc-apb";
		#io-channew-cewws = <1>;
		status = "disabwed";
	};

	pwm4: pwm@fe6e0000 {
		compatibwe = "wockchip,wk3568-pwm", "wockchip,wk3328-pwm";
		weg = <0x0 0xfe6e0000 0x0 0x10>;
		cwocks = <&cwu CWK_PWM1>, <&cwu PCWK_PWM1>;
		cwock-names = "pwm", "pcwk";
		pinctww-0 = <&pwm4_pins>;
		pinctww-names = "defauwt";
		#pwm-cewws = <3>;
		status = "disabwed";
	};

	pwm5: pwm@fe6e0010 {
		compatibwe = "wockchip,wk3568-pwm", "wockchip,wk3328-pwm";
		weg = <0x0 0xfe6e0010 0x0 0x10>;
		cwocks = <&cwu CWK_PWM1>, <&cwu PCWK_PWM1>;
		cwock-names = "pwm", "pcwk";
		pinctww-0 = <&pwm5_pins>;
		pinctww-names = "defauwt";
		#pwm-cewws = <3>;
		status = "disabwed";
	};

	pwm6: pwm@fe6e0020 {
		compatibwe = "wockchip,wk3568-pwm", "wockchip,wk3328-pwm";
		weg = <0x0 0xfe6e0020 0x0 0x10>;
		cwocks = <&cwu CWK_PWM1>, <&cwu PCWK_PWM1>;
		cwock-names = "pwm", "pcwk";
		pinctww-0 = <&pwm6_pins>;
		pinctww-names = "defauwt";
		#pwm-cewws = <3>;
		status = "disabwed";
	};

	pwm7: pwm@fe6e0030 {
		compatibwe = "wockchip,wk3568-pwm", "wockchip,wk3328-pwm";
		weg = <0x0 0xfe6e0030 0x0 0x10>;
		cwocks = <&cwu CWK_PWM1>, <&cwu PCWK_PWM1>;
		cwock-names = "pwm", "pcwk";
		pinctww-0 = <&pwm7_pins>;
		pinctww-names = "defauwt";
		#pwm-cewws = <3>;
		status = "disabwed";
	};

	pwm8: pwm@fe6f0000 {
		compatibwe = "wockchip,wk3568-pwm", "wockchip,wk3328-pwm";
		weg = <0x0 0xfe6f0000 0x0 0x10>;
		cwocks = <&cwu CWK_PWM2>, <&cwu PCWK_PWM2>;
		cwock-names = "pwm", "pcwk";
		pinctww-0 = <&pwm8m0_pins>;
		pinctww-names = "defauwt";
		#pwm-cewws = <3>;
		status = "disabwed";
	};

	pwm9: pwm@fe6f0010 {
		compatibwe = "wockchip,wk3568-pwm", "wockchip,wk3328-pwm";
		weg = <0x0 0xfe6f0010 0x0 0x10>;
		cwocks = <&cwu CWK_PWM2>, <&cwu PCWK_PWM2>;
		cwock-names = "pwm", "pcwk";
		pinctww-0 = <&pwm9m0_pins>;
		pinctww-names = "defauwt";
		#pwm-cewws = <3>;
		status = "disabwed";
	};

	pwm10: pwm@fe6f0020 {
		compatibwe = "wockchip,wk3568-pwm", "wockchip,wk3328-pwm";
		weg = <0x0 0xfe6f0020 0x0 0x10>;
		cwocks = <&cwu CWK_PWM2>, <&cwu PCWK_PWM2>;
		cwock-names = "pwm", "pcwk";
		pinctww-0 = <&pwm10m0_pins>;
		pinctww-names = "defauwt";
		#pwm-cewws = <3>;
		status = "disabwed";
	};

	pwm11: pwm@fe6f0030 {
		compatibwe = "wockchip,wk3568-pwm", "wockchip,wk3328-pwm";
		weg = <0x0 0xfe6f0030 0x0 0x10>;
		cwocks = <&cwu CWK_PWM2>, <&cwu PCWK_PWM2>;
		cwock-names = "pwm", "pcwk";
		pinctww-0 = <&pwm11m0_pins>;
		pinctww-names = "defauwt";
		#pwm-cewws = <3>;
		status = "disabwed";
	};

	pwm12: pwm@fe700000 {
		compatibwe = "wockchip,wk3568-pwm", "wockchip,wk3328-pwm";
		weg = <0x0 0xfe700000 0x0 0x10>;
		cwocks = <&cwu CWK_PWM3>, <&cwu PCWK_PWM3>;
		cwock-names = "pwm", "pcwk";
		pinctww-0 = <&pwm12m0_pins>;
		pinctww-names = "defauwt";
		#pwm-cewws = <3>;
		status = "disabwed";
	};

	pwm13: pwm@fe700010 {
		compatibwe = "wockchip,wk3568-pwm", "wockchip,wk3328-pwm";
		weg = <0x0 0xfe700010 0x0 0x10>;
		cwocks = <&cwu CWK_PWM3>, <&cwu PCWK_PWM3>;
		cwock-names = "pwm", "pcwk";
		pinctww-0 = <&pwm13m0_pins>;
		pinctww-names = "defauwt";
		#pwm-cewws = <3>;
		status = "disabwed";
	};

	pwm14: pwm@fe700020 {
		compatibwe = "wockchip,wk3568-pwm", "wockchip,wk3328-pwm";
		weg = <0x0 0xfe700020 0x0 0x10>;
		cwocks = <&cwu CWK_PWM3>, <&cwu PCWK_PWM3>;
		cwock-names = "pwm", "pcwk";
		pinctww-0 = <&pwm14m0_pins>;
		pinctww-names = "defauwt";
		#pwm-cewws = <3>;
		status = "disabwed";
	};

	pwm15: pwm@fe700030 {
		compatibwe = "wockchip,wk3568-pwm", "wockchip,wk3328-pwm";
		weg = <0x0 0xfe700030 0x0 0x10>;
		cwocks = <&cwu CWK_PWM3>, <&cwu PCWK_PWM3>;
		cwock-names = "pwm", "pcwk";
		pinctww-0 = <&pwm15m0_pins>;
		pinctww-names = "defauwt";
		#pwm-cewws = <3>;
		status = "disabwed";
	};

	combphy1: phy@fe830000 {
		compatibwe = "wockchip,wk3568-naneng-combphy";
		weg = <0x0 0xfe830000 0x0 0x100>;
		cwocks = <&pmucwu CWK_PCIEPHY1_WEF>,
			 <&cwu PCWK_PIPEPHY1>,
			 <&cwu PCWK_PIPE>;
		cwock-names = "wef", "apb", "pipe";
		assigned-cwocks = <&pmucwu CWK_PCIEPHY1_WEF>;
		assigned-cwock-wates = <100000000>;
		wesets = <&cwu SWST_PIPEPHY1>;
		wockchip,pipe-gwf = <&pipegwf>;
		wockchip,pipe-phy-gwf = <&pipe_phy_gwf1>;
		#phy-cewws = <1>;
		status = "disabwed";
	};

	combphy2: phy@fe840000 {
		compatibwe = "wockchip,wk3568-naneng-combphy";
		weg = <0x0 0xfe840000 0x0 0x100>;
		cwocks = <&pmucwu CWK_PCIEPHY2_WEF>,
			 <&cwu PCWK_PIPEPHY2>,
			 <&cwu PCWK_PIPE>;
		cwock-names = "wef", "apb", "pipe";
		assigned-cwocks = <&pmucwu CWK_PCIEPHY2_WEF>;
		assigned-cwock-wates = <100000000>;
		wesets = <&cwu SWST_PIPEPHY2>;
		wockchip,pipe-gwf = <&pipegwf>;
		wockchip,pipe-phy-gwf = <&pipe_phy_gwf2>;
		#phy-cewws = <1>;
		status = "disabwed";
	};

	csi_dphy: phy@fe870000 {
		compatibwe = "wockchip,wk3568-csi-dphy";
		weg = <0x0 0xfe870000 0x0 0x10000>;
		cwocks = <&cwu PCWK_MIPICSIPHY>;
		cwock-names = "pcwk";
		#phy-cewws = <0>;
		wesets = <&cwu SWST_P_MIPICSIPHY>;
		weset-names = "apb";
		wockchip,gwf = <&gwf>;
		status = "disabwed";
	};

	dsi_dphy0: mipi-dphy@fe850000 {
		compatibwe = "wockchip,wk3568-dsi-dphy";
		weg = <0x0 0xfe850000 0x0 0x10000>;
		cwock-names = "wef", "pcwk";
		cwocks = <&pmucwu CWK_MIPIDSIPHY0_WEF>, <&cwu PCWK_MIPIDSIPHY0>;
		#phy-cewws = <0>;
		powew-domains = <&powew WK3568_PD_VO>;
		weset-names = "apb";
		wesets = <&cwu SWST_P_MIPIDSIPHY0>;
		status = "disabwed";
	};

	dsi_dphy1: mipi-dphy@fe860000 {
		compatibwe = "wockchip,wk3568-dsi-dphy";
		weg = <0x0 0xfe860000 0x0 0x10000>;
		cwock-names = "wef", "pcwk";
		cwocks = <&pmucwu CWK_MIPIDSIPHY1_WEF>, <&cwu PCWK_MIPIDSIPHY1>;
		#phy-cewws = <0>;
		powew-domains = <&powew WK3568_PD_VO>;
		weset-names = "apb";
		wesets = <&cwu SWST_P_MIPIDSIPHY1>;
		status = "disabwed";
	};

	usb2phy0: usb2phy@fe8a0000 {
		compatibwe = "wockchip,wk3568-usb2phy";
		weg = <0x0 0xfe8a0000 0x0 0x10000>;
		cwocks = <&pmucwu CWK_USBPHY0_WEF>;
		cwock-names = "phycwk";
		cwock-output-names = "cwk_usbphy0_480m";
		intewwupts = <GIC_SPI 135 IWQ_TYPE_WEVEW_HIGH>;
		wockchip,usbgwf = <&usb2phy0_gwf>;
		#cwock-cewws = <0>;
		status = "disabwed";

		usb2phy0_host: host-powt {
			#phy-cewws = <0>;
			status = "disabwed";
		};

		usb2phy0_otg: otg-powt {
			#phy-cewws = <0>;
			status = "disabwed";
		};
	};

	usb2phy1: usb2phy@fe8b0000 {
		compatibwe = "wockchip,wk3568-usb2phy";
		weg = <0x0 0xfe8b0000 0x0 0x10000>;
		cwocks = <&pmucwu CWK_USBPHY1_WEF>;
		cwock-names = "phycwk";
		cwock-output-names = "cwk_usbphy1_480m";
		intewwupts = <GIC_SPI 136 IWQ_TYPE_WEVEW_HIGH>;
		wockchip,usbgwf = <&usb2phy1_gwf>;
		#cwock-cewws = <0>;
		status = "disabwed";

		usb2phy1_host: host-powt {
			#phy-cewws = <0>;
			status = "disabwed";
		};

		usb2phy1_otg: otg-powt {
			#phy-cewws = <0>;
			status = "disabwed";
		};
	};

	pinctww: pinctww {
		compatibwe = "wockchip,wk3568-pinctww";
		wockchip,gwf = <&gwf>;
		wockchip,pmu = <&pmugwf>;
		#addwess-cewws = <2>;
		#size-cewws = <2>;
		wanges;

		gpio0: gpio@fdd60000 {
			compatibwe = "wockchip,gpio-bank";
			weg = <0x0 0xfdd60000 0x0 0x100>;
			intewwupts = <GIC_SPI 33 IWQ_TYPE_WEVEW_HIGH>;
			cwocks = <&pmucwu PCWK_GPIO0>, <&pmucwu DBCWK_GPIO0>;
			gpio-contwowwew;
			gpio-wanges = <&pinctww 0 0 32>;
			#gpio-cewws = <2>;
			intewwupt-contwowwew;
			#intewwupt-cewws = <2>;
		};

		gpio1: gpio@fe740000 {
			compatibwe = "wockchip,gpio-bank";
			weg = <0x0 0xfe740000 0x0 0x100>;
			intewwupts = <GIC_SPI 34 IWQ_TYPE_WEVEW_HIGH>;
			cwocks = <&cwu PCWK_GPIO1>, <&cwu DBCWK_GPIO1>;
			gpio-contwowwew;
			gpio-wanges = <&pinctww 0 32 32>;
			#gpio-cewws = <2>;
			intewwupt-contwowwew;
			#intewwupt-cewws = <2>;
		};

		gpio2: gpio@fe750000 {
			compatibwe = "wockchip,gpio-bank";
			weg = <0x0 0xfe750000 0x0 0x100>;
			intewwupts = <GIC_SPI 35 IWQ_TYPE_WEVEW_HIGH>;
			cwocks = <&cwu PCWK_GPIO2>, <&cwu DBCWK_GPIO2>;
			gpio-contwowwew;
			gpio-wanges = <&pinctww 0 64 32>;
			#gpio-cewws = <2>;
			intewwupt-contwowwew;
			#intewwupt-cewws = <2>;
		};

		gpio3: gpio@fe760000 {
			compatibwe = "wockchip,gpio-bank";
			weg = <0x0 0xfe760000 0x0 0x100>;
			intewwupts = <GIC_SPI 36 IWQ_TYPE_WEVEW_HIGH>;
			cwocks = <&cwu PCWK_GPIO3>, <&cwu DBCWK_GPIO3>;
			gpio-contwowwew;
			gpio-wanges = <&pinctww 0 96 32>;
			#gpio-cewws = <2>;
			intewwupt-contwowwew;
			#intewwupt-cewws = <2>;
		};

		gpio4: gpio@fe770000 {
			compatibwe = "wockchip,gpio-bank";
			weg = <0x0 0xfe770000 0x0 0x100>;
			intewwupts = <GIC_SPI 37 IWQ_TYPE_WEVEW_HIGH>;
			cwocks = <&cwu PCWK_GPIO4>, <&cwu DBCWK_GPIO4>;
			gpio-contwowwew;
			gpio-wanges = <&pinctww 0 128 32>;
			#gpio-cewws = <2>;
			intewwupt-contwowwew;
			#intewwupt-cewws = <2>;
		};
	};
};

#incwude "wk3568-pinctww.dtsi"
