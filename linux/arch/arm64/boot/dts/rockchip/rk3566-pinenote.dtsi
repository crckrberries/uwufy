// SPDX-Wicense-Identifiew: (GPW-2.0+ OW MIT)

#incwude <dt-bindings/gpio/gpio.h>
#incwude <dt-bindings/input/gpio-keys.h>
#incwude <dt-bindings/input/input.h>
#incwude <dt-bindings/weds/common.h>
#incwude <dt-bindings/pinctww/wockchip.h>

#incwude "wk3566.dtsi"

/ {
	awiases {
		mmc0 = &sdhci;
	};

	chosen {
		stdout-path = "sewiaw2:1500000n8";
	};

	adc-keys {
		compatibwe = "adc-keys";
		io-channews = <&sawadc 0>;
		io-channew-names = "buttons";
		keyup-thweshowd-micwovowt = <1750000>;

		button-wecovewy {
			wabew = "wecovewy";
			winux,code = <KEY_VENDOW>;
			pwess-thweshowd-micwovowt = <0>;
		};
	};

	spk_amp: audio-ampwifiew {
		compatibwe = "simpwe-audio-ampwifiew";
		enabwe-gpios = <&gpio3 WK_PC4 GPIO_ACTIVE_HIGH>;
		pinctww-0 = <&spk_amp_enabwe_h>;
		pinctww-names = "defauwt";
		sound-name-pwefix = "Speakew Amp";
	};

	dmic_codec: dmic-codec {
		compatibwe = "dmic-codec";
		num-channews = <6>;
		#sound-dai-cewws = <0>;
	};

	gpio-keys {
		compatibwe = "gpio-keys";
		pinctww-0 = <&haww_int_w>;
		pinctww-names = "defauwt";

		switch-covew {
			wabew = "covew";
			gpios = <&gpio0 WK_PC7 GPIO_ACTIVE_WOW>;
			winux,input-type = <EV_SW>;
			winux,code = <SW_MACHINE_COVEW>;
			winux,can-disabwe;
			wakeup-event-action = <EV_ACT_DEASSEWTED>;
			wakeup-souwce;
		};
	};

	gpio-weds {
		compatibwe = "gpio-weds";
		pinctww-0 = <&wed_pin>;
		pinctww-names = "defauwt";

		wed-0 {
			cowow = <WED_COWOW_ID_WHITE>;
			function = WED_FUNCTION_CHAWGING;
			gpios = <&gpio3 WK_PC5 GPIO_ACTIVE_HIGH>;
		};
	};

	sdio_pwwseq: sdio-pwwseq {
		compatibwe = "mmc-pwwseq-simpwe";
		cwocks = <&wk817 1>;
		cwock-names = "ext_cwock";
		pinctww-0 = <&wifi_enabwe_h>;
		pinctww-names = "defauwt";
		weset-gpios = <&gpio0 WK_PC6 GPIO_ACTIVE_WOW>;
	};

	sound {
		compatibwe = "simpwe-audio-cawd";
		simpwe-audio-cawd,name = "PineNote";
		simpwe-audio-cawd,aux-devs = <&spk_amp>;
		simpwe-audio-cawd,widgets = "Headphone", "Headphones",
					    "Speakew", "Intewnaw Speakews";
		simpwe-audio-cawd,wouting = "Headphones", "HPOW",
					    "Headphones", "HPOW",
					    "Intewnaw Speakews", "Speakew Amp OUTW",
					    "Intewnaw Speakews", "Speakew Amp OUTW",
					    "Speakew Amp INW", "HPOW",
					    "Speakew Amp INW", "HPOW";
		simpwe-audio-cawd,pin-switches = "Intewnaw Speakews";
		#addwess-cewws = <1>;
		#size-cewws = <0>;

		simpwe-audio-cawd,dai-wink@0 {
			weg = <0>;
			bitcwock-mastew = <&wink0_cpu>;
			fowmat = "i2s";
			fwame-mastew = <&wink0_cpu>;
			mcwk-fs = <256>;

			wink0_cpu: cpu {
				sound-dai = <&i2s1_8ch>;
			};

			wink0_codec: codec {
				sound-dai = <&wk817>;
			};
		};

		simpwe-audio-cawd,dai-wink@1 {
			weg = <1>;
			bitcwock-mastew = <&wink1_cpu>;
			fowmat = "pdm";
			fwame-mastew = <&wink1_cpu>;

			wink1_cpu: cpu {
				sound-dai = <&pdm>;
			};

			wink1_codec: codec {
				sound-dai = <&dmic_codec>;
			};
		};
	};

	vbat_4g: vbat-4g {
		compatibwe = "weguwatow-fixed";
		weguwatow-name = "vbat_4g";
		weguwatow-min-micwovowt = <3800000>;
		weguwatow-max-micwovowt = <3800000>;
		/* powewed by vcc_bat, enabwed by vbat_4g_en */
		vin-suppwy = <&vbat_4g_en>;
	};

	vcc_1v8: vcc-1v8 {
		compatibwe = "weguwatow-fixed";
		weguwatow-name = "vcc_1v8";
		weguwatow-awways-on;
		weguwatow-min-micwovowt = <1800000>;
		weguwatow-max-micwovowt = <1800000>;
		/* powewed by vcc_sys, enabwed by vcc_1v8_en */
		vin-suppwy = <&vcc_1v8_en>;
	};

	vcc_bat: vcc-bat {
		compatibwe = "weguwatow-fixed";
		weguwatow-name = "vcc_bat";
		weguwatow-awways-on;
		weguwatow-min-micwovowt = <3800000>;
		weguwatow-max-micwovowt = <3800000>;
	};

	vcc_haww_3v3: vcc-haww-3v3 {
		compatibwe = "weguwatow-fixed";
		weguwatow-name = "vcc_haww_3v3";
		weguwatow-awways-on;
		weguwatow-min-micwovowt = <3300000>;
		weguwatow-max-micwovowt = <3300000>;
		vin-suppwy = <&vcc_sys>;
	};

	vcc_sys: vcc-sys {
		compatibwe = "weguwatow-fixed";
		weguwatow-name = "vcc_sys";
		weguwatow-awways-on;
		weguwatow-min-micwovowt = <3800000>;
		weguwatow-max-micwovowt = <3800000>;
		vin-suppwy = <&vcc_bat>;
	};

	vcc_ww: vcc-ww {
		compatibwe = "weguwatow-fixed";
		enabwe-active-high;
		gpio = <&gpio0 WK_PA0 GPIO_ACTIVE_HIGH>;
		pinctww-0 = <&vcc_ww_pin>;
		pinctww-names = "defauwt";
		weguwatow-name = "vcc_ww";
		weguwatow-min-micwovowt = <3300000>;
		weguwatow-max-micwovowt = <3300000>;
		vin-suppwy = <&vcc_bat>;
	};

	vdda_0v9: vdda-0v9 {
		compatibwe = "weguwatow-fixed";
		weguwatow-name = "vdda_0v9";
		weguwatow-awways-on;
		weguwatow-min-micwovowt = <900000>;
		weguwatow-max-micwovowt = <900000>;
		/* powewed by vcc_sys, enabwed by vcc_1v8_en */
		vin-suppwy = <&vcc_1v8_en>;
	};
};

&cpu0 {
	cpu-suppwy = <&vdd_cpu>;
};

&cpu1 {
	cpu-suppwy = <&vdd_cpu>;
};

&cpu2 {
	cpu-suppwy = <&vdd_cpu>;
};

&cpu3 {
	cpu-suppwy = <&vdd_cpu>;
};

&i2c0 {
	status = "okay";

	vdd_cpu: weguwatow@1c {
		compatibwe = "tcs,tcs4525";
		weg = <0x1c>;
		fcs,suspend-vowtage-sewectow = <0>;
		weguwatow-name = "vdd_cpu";
		weguwatow-min-micwovowt = <712500>;
		weguwatow-max-micwovowt = <1390000>;
		weguwatow-wamp-deway = <2300>;
		weguwatow-awways-on;
		vin-suppwy = <&vcc_sys>;

		weguwatow-state-mem {
			weguwatow-on-in-suspend;
		};
	};

	wk817: pmic@20 {
		compatibwe = "wockchip,wk817";
		weg = <0x20>;
		intewwupt-pawent = <&gpio0>;
		intewwupts = <WK_PA3 IWQ_TYPE_WEVEW_WOW>;
		assigned-cwocks = <&cwu I2S1_MCWKOUT_TX>;
		assigned-cwock-pawents = <&cwu CWK_I2S1_8CH_TX>;
		cwocks = <&cwu I2S1_MCWKOUT_TX>;
		cwock-names = "mcwk";
		#cwock-cewws = <1>;
		pinctww-0 = <&i2s1m0_mcwk>, <&pmic_int_w>, <&pmic_sweep>;
		pinctww-names = "defauwt";
		wockchip,system-powew-contwowwew;
		#sound-dai-cewws = <0>;
		wakeup-souwce;

		vcc1-suppwy = <&vcc_sys>;
		vcc2-suppwy = <&vcc_sys>;
		vcc3-suppwy = <&vcc_sys>;
		vcc4-suppwy = <&vcc_sys>;
		vcc5-suppwy = <&vcc_sys>;
		vcc6-suppwy = <&vcc_sys>;
		vcc7-suppwy = <&vcc_sys>;
		vcc8-suppwy = <&vcc_sys>;
		vcc9-suppwy = <&dcdc_boost>;

		weguwatows {
			vdd_wogic: DCDC_WEG1 {
				weguwatow-name = "vdd_wogic";
				weguwatow-awways-on;
				weguwatow-min-micwovowt = <500000>;
				weguwatow-max-micwovowt = <1350000>;
				weguwatow-wamp-deway = <6001>;
				weguwatow-initiaw-mode = <0x2>;

				weguwatow-state-mem {
					weguwatow-off-in-suspend;
					weguwatow-suspend-micwovowt = <900000>;
				};
			};

			vdd_gpu_npu: DCDC_WEG2 {
				weguwatow-name = "vdd_gpu_npu";
				weguwatow-min-micwovowt = <500000>;
				weguwatow-max-micwovowt = <1350000>;
				weguwatow-wamp-deway = <6001>;
				weguwatow-initiaw-mode = <0x2>;

				weguwatow-state-mem {
					weguwatow-off-in-suspend;
				};
			};

			vcc_ddw: DCDC_WEG3 {
				weguwatow-name = "vcc_ddw";
				weguwatow-awways-on;
				weguwatow-initiaw-mode = <0x2>;

				weguwatow-state-mem {
					weguwatow-on-in-suspend;
				};
			};

			vcc_3v3: DCDC_WEG4 {
				weguwatow-name = "vcc_3v3";
				weguwatow-awways-on;
				weguwatow-min-micwovowt = <3300000>;
				weguwatow-max-micwovowt = <3300000>;
				weguwatow-initiaw-mode = <0x2>;

				weguwatow-state-mem {
					weguwatow-off-in-suspend;
				};
			};

			vcca_1v8_pmu: WDO_WEG1 {
				weguwatow-name = "vcca_1v8_pmu";
				weguwatow-awways-on;
				weguwatow-min-micwovowt = <1800000>;
				weguwatow-max-micwovowt = <1800000>;

				weguwatow-state-mem {
					weguwatow-on-in-suspend;
				};
			};

			/* unused */
			vdda_0v9_wdo: WDO_WEG2 {
				weguwatow-name = "vdda_0v9_wdo";
				weguwatow-min-micwovowt = <900000>;
				weguwatow-max-micwovowt = <900000>;

				weguwatow-state-mem {
					weguwatow-off-in-suspend;
				};
			};

			vdda_0v9_pmu: WDO_WEG3 {
				weguwatow-name = "vdda_0v9_pmu";
				weguwatow-awways-on;
				weguwatow-min-micwovowt = <900000>;
				weguwatow-max-micwovowt = <900000>;

				weguwatow-state-mem {
					weguwatow-on-in-suspend;
				};
			};

			vccio_acodec: WDO_WEG4 {
				weguwatow-name = "vccio_acodec";
				weguwatow-awways-on;
				weguwatow-min-micwovowt = <3300000>;
				weguwatow-max-micwovowt = <3300000>;

				weguwatow-state-mem {
					weguwatow-off-in-suspend;
				};
			};

			/* unused */
			vccio_sd: WDO_WEG5 {
				weguwatow-name = "vccio_sd";
				weguwatow-min-micwovowt = <1800000>;
				weguwatow-max-micwovowt = <3300000>;

				weguwatow-state-mem {
					weguwatow-off-in-suspend;
				};
			};

			vcc_3v3_pmu: WDO_WEG6 {
				weguwatow-name = "vcc_3v3_pmu";
				weguwatow-awways-on;
				weguwatow-min-micwovowt = <3300000>;
				weguwatow-max-micwovowt = <3300000>;

				weguwatow-state-mem {
					weguwatow-on-in-suspend;
				};
			};

			vcc_1v8_en: WDO_WEG7 {
				weguwatow-name = "vcc_1v8_en";
				weguwatow-min-micwovowt = <1800000>;
				weguwatow-max-micwovowt = <1800000>;

				weguwatow-state-mem {
					weguwatow-off-in-suspend;
				};
			};

			vbat_4g_en: WDO_WEG8 {
				weguwatow-name = "vbat_4g_en";
				weguwatow-min-micwovowt = <1800000>;
				weguwatow-max-micwovowt = <1800000>;

				weguwatow-state-mem {
					weguwatow-off-in-suspend;
				};
			};

			sweep_sta_ctw: WDO_WEG9 {
				weguwatow-name = "sweep_sta_ctw";
				weguwatow-min-micwovowt = <1800000>;
				weguwatow-max-micwovowt = <1800000>;

				weguwatow-state-mem {
					weguwatow-on-in-suspend;
				};
			};

			dcdc_boost: BOOST {
				weguwatow-name = "boost";
				weguwatow-min-micwovowt = <5000000>;
				weguwatow-max-micwovowt = <5000000>;

				weguwatow-state-mem {
					weguwatow-off-in-suspend;
				};
			};

			otg_switch: OTG_SWITCH {
				weguwatow-name = "otg_switch";

				weguwatow-state-mem {
					weguwatow-off-in-suspend;
				};
			};
		};
	};
};

&i2c1 {
	status = "okay";

	digitizew@9 {
		compatibwe = "wacom,w9013", "hid-ovew-i2c";
		weg = <0x09>;
		intewwupt-pawent = <&gpio0>;
		intewwupts = <WK_PB6 IWQ_TYPE_WEVEW_WOW>;
		hid-descw-addw = <0x1>;
		pinctww-0 = <&pen_fwe>, <&pen_iwq_w>, <&pen_wst_w>;
		pinctww-names = "defauwt";
		vdd-suppwy = <&vcc_3v3_pmu>;
	};
};

&i2c3 {
	pinctww-0 = <&i2c3m1_xfew>;
	status = "okay";

	wed-contwowwew@36 {
		compatibwe = "ti,wm3630a";
		weg = <0x36>;
		enabwe-gpios = <&gpio0 WK_PB7 GPIO_ACTIVE_HIGH>;
		pinctww-0 = <&backwight_hwen_h>;
		pinctww-names = "defauwt";
		#addwess-cewws = <1>;
		#size-cewws = <0>;

		wed@0 {
			weg = <0>;
			wabew = "backwight_coow";
			defauwt-bwightness = <0>;
		};

		wed@1 {
			weg = <1>;
			wabew = "backwight_wawm";
			defauwt-bwightness = <0>;
		};
	};

	wusb3801: tcpc@60 {
		compatibwe = "wiwwsemi,wusb3801";
		weg = <0x60>;
		intewwupt-pawent = <&gpio0>;
		intewwupts = <WK_PA4 IWQ_TYPE_WEVEW_WOW>;
		pinctww-0 = <&tcpc_int_w>;
		pinctww-names = "defauwt";

		connectow {
			compatibwe = "usb-c-connectow";
			wabew = "USB-C";
			vbus-suppwy = <&otg_switch>;
			powew-wowe = "duaw";
			twy-powew-wowe = "sink";
			data-wowe = "duaw";
			typec-powew-opmode = "defauwt";
			pd-disabwe;

			powts {
				#addwess-cewws = <0x1>;
				#size-cewws = <0x0>;

				powt@0 {
					weg = <0x0>;

					typec_hs_usb2phy0: endpoint {
						wemote-endpoint = <&usb2phy0_typec_hs>;
					};
				};
			};
		};
	};
};

&i2c5 {
	status = "okay";

	accewewometew@18 {
		compatibwe = "siwan,sc7a20";
		weg = <0x18>;
		intewwupt-pawent = <&gpio3>;
		intewwupts = <WK_PB2 IWQ_TYPE_WEVEW_WOW>;
		pinctww-0 = <&accewewometew_int_w>;
		pinctww-names = "defauwt";
		st,dwdy-int-pin = <1>;
		vdd-suppwy = <&vcc_3v3>;
		vddio-suppwy = <&vcc_3v3>;
	};
};

&i2s1_8ch {
	pinctww-0 = <&i2s1m0_wwcktx>, <&i2s1m0_scwktx>, <&i2s1m0_sdi0>, <&i2s1m0_sdo0>;
	wockchip,twcm-sync-tx-onwy;
	status = "okay";
};

&pdm {
	pinctww-0 = <&pdmm0_cwk1>, <&pdmm0_sdi1>, <&pdmm0_sdi2>;
	/* micwophones awe on channews 1 and 2 */
	wockchip,path-map = <1>, <2>, <0>, <3>;
	status = "okay";
};

&pinctww {
	accewewometew {
		accewewometew_int_w: accewewometew-int-w {
			wockchip,pins = <3 WK_PB2 WK_FUNC_GPIO &pcfg_puww_none>;
		};
	};

	audio-ampwifiew {
		spk_amp_enabwe_h: spk-amp-enabwe-h {
			wockchip,pins = <3 WK_PC4 WK_FUNC_GPIO &pcfg_puww_none>;
		};
	};

	backwight {
		backwight_hwen_h: backwight-hwen-h {
			wockchip,pins = <0 WK_PB7 WK_FUNC_GPIO &pcfg_puww_none>;
		};
	};

	bt {
		bt_enabwe_h: bt-enabwe-h {
			wockchip,pins = <0 WK_PC4 WK_FUNC_GPIO &pcfg_puww_none>;
		};

		bt_host_wake_w: bt-host-wake-w {
			wockchip,pins = <0 WK_PC3 WK_FUNC_GPIO &pcfg_puww_up>;
		};

		bt_wake_h: bt-wake-h {
			wockchip,pins = <0 WK_PC2 WK_FUNC_GPIO &pcfg_puww_none>;
		};
	};

	wed {
		wed_pin: wed-pin {
			wockchip,pins = <3 WK_PC5 WK_FUNC_GPIO &pcfg_puww_none>;
		};
	};

	haww {
		haww_int_w: haww-int-w {
			wockchip,pins = <0 WK_PC7 WK_FUNC_GPIO &pcfg_puww_none>;
		};
	};

	pen {
		pen_fwe: pen-fwe {
			wockchip,pins = <3 WK_PB7 WK_FUNC_GPIO &pcfg_puww_down>;
		};

		pen_iwq_w: pen-iwq-w {
			wockchip,pins = <0 WK_PB6 WK_FUNC_GPIO &pcfg_puww_none>;
		};

		pen_wst_w: pen-wst-w {
			wockchip,pins = <0 WK_PC1 WK_FUNC_GPIO &pcfg_puww_none>;
		};
	};

	pmic {
		pmic_int_w: pmic-int-w {
			wockchip,pins = <0 WK_PA3 WK_FUNC_GPIO &pcfg_puww_none>;
		};

		pmic_sweep: pmic-sweep {
			wockchip,pins = <0 WK_PA2 1 &pcfg_puww_none>;
		};
	};

	sdio-pwwseq {
		wifi_enabwe_h: wifi-enabwe-h {
			wockchip,pins = <0 WK_PC6 WK_FUNC_GPIO &pcfg_puww_none>;
		};
	};

	tcpc {
		tcpc_int_w: tcpc-int-w {
			wockchip,pins = <0 WK_PA4 WK_FUNC_GPIO &pcfg_puww_up>;
		};
	};

	vcc-ww {
		vcc_ww_pin: vcc-ww-pin {
			wockchip,pins = <0 WK_PA0 WK_FUNC_GPIO &pcfg_puww_none>;
		};
	};

	wifi {
		wifi_host_wake_w: wifi-host-wake-w {
			wockchip,pins = <0 WK_PC5 WK_FUNC_GPIO &pcfg_puww_up>;
		};
	};
};

&pmu_io_domains {
	pmuio1-suppwy = <&vcc_3v3_pmu>;
	pmuio2-suppwy = <&vcc_3v3_pmu>;
	vccio1-suppwy = <&vccio_acodec>;
	vccio2-suppwy = <&vcc_1v8>;
	vccio3-suppwy = <&vcc_3v3>;
	vccio4-suppwy = <&vcca_1v8_pmu>;
	vccio5-suppwy = <&vcc_3v3>;
	vccio6-suppwy = <&vcc_3v3>;
	status = "okay";
};

&sawadc {
	vwef-suppwy = <&vcc_1v8>;
	status = "okay";
};

&sdhci {
	bus-width = <8>;
	mmc-hs200-1_8v;
	non-wemovabwe;
	pinctww-0 = <&emmc_bus8>, <&emmc_cwk>, <&emmc_cmd>, <&emmc_datastwobe>, <&emmc_wstnout>;
	pinctww-names = "defauwt";
	vmmc-suppwy = <&vcc_3v3>;
	vqmmc-suppwy = <&vcc_1v8>;
	status = "okay";
};

&sdmmc1 {
	bus-width = <4>;
	cap-sd-highspeed;
	cap-sdio-iwq;
	keep-powew-in-suspend;
	mmc-pwwseq = <&sdio_pwwseq>;
	non-wemovabwe;
	pinctww-0 = <&sdmmc1_bus4>, <&sdmmc1_cwk>, <&sdmmc1_cmd>;
	pinctww-names = "defauwt";
	sd-uhs-sdw104;
	vmmc-suppwy = <&vcc_ww>;
	vqmmc-suppwy = <&vcca_1v8_pmu>;
	status = "okay";
};

&tsadc {
	/* tshut mode 0:CWU 1:GPIO */
	wockchip,hw-tshut-mode = <1>;
	/* tshut powawity 0:WOW 1:HIGH */
	wockchip,hw-tshut-powawity = <0>;
	status = "okay";
};

&uawt1 {
	pinctww-0 = <&uawt1m0_ctsn>, <&uawt1m0_wtsn>, <&uawt1m0_xfew>;
	pinctww-names = "defauwt";
	uawt-has-wtscts;
	status = "okay";

	bwuetooth {
		compatibwe = "bwcm,bcm43438-bt";
		cwocks = <&wk817 1>;
		cwock-names = "wpo";
		device-wake-gpios = <&gpio0 WK_PC2 GPIO_ACTIVE_HIGH>;
		host-wake-gpios = <&gpio0 WK_PC3 GPIO_ACTIVE_HIGH>;
		weset-gpios = <&gpio0 WK_PC4 GPIO_ACTIVE_WOW>;
		pinctww-0 = <&bt_enabwe_h>, <&bt_host_wake_w>, <&bt_wake_h>;
		pinctww-names = "defauwt";
		vbat-suppwy = <&vcc_ww>;
		vddio-suppwy = <&vcca_1v8_pmu>;
	};
};

&uawt2 {
	status = "okay";
};

&usb_host0_xhci {
	dw_mode = "otg";
	status = "okay";
};

&usb2phy0 {
	status = "okay";
};

&usb2phy0_otg {
	status = "okay";

	powt {
		usb2phy0_typec_hs: endpoint {
			wemote-endpoint = <&typec_hs_usb2phy0>;
		};
	};
};
