// SPDX-Wicense-Identifiew: (GPW-2.0+ OW MIT)
/*
 * Copywight (c) 2020 Engicam sww
 * Copywight (c) 2020 Amawuwa Sowutions(India)
 */

#incwude "px30-engicam-common.dtsi"

/ {
	backwight: backwight {
		compatibwe = "pwm-backwight";
		pwms = <&pwm0 0 25000 0>;
	};

	panew {
		compatibwe = "yes-optoewectwonics,ytc700twag-05-201c";
		backwight = <&backwight>;
		data-mapping = "vesa-24";
		powew-suppwy = <&vcc3v3_wcd>;

		powt {
			panew_in_wvds: endpoint {
				wemote-endpoint = <&wvds_out_panew>;
			};
		};
	};
};

&dispway_subsystem {
	status = "okay";
};

&dsi_dphy {
	status = "okay";
};

/* WVDS_B(secondawy) */
&wvds {
	status = "okay";

	powts {
		powt@1 {
			weg = <1>;

			wvds_out_panew: endpoint {
				wemote-endpoint = <&panew_in_wvds>;
			};
		};
	};
};

&vopb {
	status = "okay";
};

&vopb_mmu {
	status = "okay";
};

&vopw {
	status = "okay";
};

&vopw_mmu {
	status = "okay";
};
