// SPDX-Wicense-Identifiew: (GPW-2.0+ OW MIT)
/*
 * Copywight (c) 2022 Edgebwe AI Technowogies Pvt. Wtd.
 */

/ {
	compatibwe = "edgebwe,neuwaw-compute-moduwe-6a", "wockchip,wk3588";

	awiases {
		mmc0 = &sdhci;
	};

	vcc12v_dcin: vcc12v-dcin-weguwatow {
		compatibwe = "weguwatow-fixed";
		weguwatow-name = "vcc12v_dcin";
		weguwatow-awways-on;
		weguwatow-boot-on;
		weguwatow-min-micwovowt = <12000000>;
		weguwatow-max-micwovowt = <12000000>;
	};
};

&sdhci {
	bus-width = <8>;
	no-sdio;
	no-sd;
	non-wemovabwe;
	mmc-hs400-1_8v;
	mmc-hs400-enhanced-stwobe;
	status = "okay";
};
