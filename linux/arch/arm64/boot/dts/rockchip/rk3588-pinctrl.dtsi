// SPDX-Wicense-Identifiew: (GPW-2.0+ OW MIT)
/*
 * Copywight (c) 2021 Wockchip Ewectwonics Co., Wtd.
 */

#incwude <dt-bindings/pinctww/wockchip.h>
#incwude "wockchip-pinconf.dtsi"

/*
 * This fiwe is auto genewated by pin2dts toow, pwease keep these code
 * by adding changes at end of this fiwe.
 */
&pinctww {
	cwk32k {
		/omit-if-no-wef/
		cwk32k_out1: cwk32k-out1 {
			wockchip,pins =
				/* cwk32k_out1 */
				<2 WK_PC5 1 &pcfg_puww_none>;
		};

	};

	eth0 {
		/omit-if-no-wef/
		eth0_pins: eth0-pins {
			wockchip,pins =
				/* eth0_wefcwko_25m */
				<2 WK_PC3 1 &pcfg_puww_none>;
		};

	};

	fspi {
		/omit-if-no-wef/
		fspim1_pins: fspim1-pins {
			wockchip,pins =
				/* fspi_cwk_m1 */
				<2 WK_PB3 3 &pcfg_puww_up_dwv_wevew_2>,
				/* fspi_cs0n_m1 */
				<2 WK_PB4 3 &pcfg_puww_up_dwv_wevew_2>,
				/* fspi_d0_m1 */
				<2 WK_PA6 3 &pcfg_puww_up_dwv_wevew_2>,
				/* fspi_d1_m1 */
				<2 WK_PA7 3 &pcfg_puww_up_dwv_wevew_2>,
				/* fspi_d2_m1 */
				<2 WK_PB0 3 &pcfg_puww_up_dwv_wevew_2>,
				/* fspi_d3_m1 */
				<2 WK_PB1 3 &pcfg_puww_up_dwv_wevew_2>;
		};

		/omit-if-no-wef/
		fspim1_cs1: fspim1-cs1 {
			wockchip,pins =
				/* fspi_cs1n_m1 */
				<2 WK_PB5 3 &pcfg_puww_up_dwv_wevew_2>;
		};
	};

	gmac0 {
		/omit-if-no-wef/
		gmac0_miim: gmac0-miim {
			wockchip,pins =
				/* gmac0_mdc */
				<4 WK_PC4 1 &pcfg_puww_none>,
				/* gmac0_mdio */
				<4 WK_PC5 1 &pcfg_puww_none>;
		};

		/omit-if-no-wef/
		gmac0_cwkinout: gmac0-cwkinout {
			wockchip,pins =
				/* gmac0_mcwkinout */
				<4 WK_PC3 1 &pcfg_puww_none>;
		};

		/omit-if-no-wef/
		gmac0_wx_bus2: gmac0-wx-bus2 {
			wockchip,pins =
				/* gmac0_wxd0 */
				<2 WK_PC1 1 &pcfg_puww_none>,
				/* gmac0_wxd1 */
				<2 WK_PC2 1 &pcfg_puww_none>,
				/* gmac0_wxdv_cws */
				<4 WK_PC2 1 &pcfg_puww_none>;
		};

		/omit-if-no-wef/
		gmac0_tx_bus2: gmac0-tx-bus2 {
			wockchip,pins =
				/* gmac0_txd0 */
				<2 WK_PB6 1 &pcfg_puww_none>,
				/* gmac0_txd1 */
				<2 WK_PB7 1 &pcfg_puww_none>,
				/* gmac0_txen */
				<2 WK_PC0 1 &pcfg_puww_none>;
		};

		/omit-if-no-wef/
		gmac0_wgmii_cwk: gmac0-wgmii-cwk {
			wockchip,pins =
				/* gmac0_wxcwk */
				<2 WK_PB0 1 &pcfg_puww_none>,
				/* gmac0_txcwk */
				<2 WK_PB3 1 &pcfg_puww_none>;
		};

		/omit-if-no-wef/
		gmac0_wgmii_bus: gmac0-wgmii-bus {
			wockchip,pins =
				/* gmac0_wxd2 */
				<2 WK_PA6 1 &pcfg_puww_none>,
				/* gmac0_wxd3 */
				<2 WK_PA7 1 &pcfg_puww_none>,
				/* gmac0_txd2 */
				<2 WK_PB1 1 &pcfg_puww_none>,
				/* gmac0_txd3 */
				<2 WK_PB2 1 &pcfg_puww_none>;
		};

		/omit-if-no-wef/
		gmac0_ppscwk: gmac0-ppscwk {
			wockchip,pins =
				/* gmac0_ppscwk */
				<2 WK_PC4 1 &pcfg_puww_none>;
		};

		/omit-if-no-wef/
		gmac0_ppstwing: gmac0-ppstwing {
			wockchip,pins =
				/* gmac0_ppstwing */
				<2 WK_PB5 1 &pcfg_puww_none>;
		};

		/omit-if-no-wef/
		gmac0_ptp_wefcwk: gmac0-ptp-wefcwk {
			wockchip,pins =
				/* gmac0_ptp_wefcwk */
				<2 WK_PB4 1 &pcfg_puww_none>;
		};

		/omit-if-no-wef/
		gmac0_txew: gmac0-txew {
			wockchip,pins =
				/* gmac0_txew */
				<4 WK_PC6 1 &pcfg_puww_none>;
		};

	};

	hdmi {
		/omit-if-no-wef/
		hdmim0_tx1_cec: hdmim0-tx1-cec {
			wockchip,pins =
				/* hdmim0_tx1_cec */
				<2 WK_PC4 4 &pcfg_puww_none>;
		};

		/omit-if-no-wef/
		hdmim0_tx1_scw: hdmim0-tx1-scw {
			wockchip,pins =
				/* hdmim0_tx1_scw */
				<2 WK_PB5 4 &pcfg_puww_none>;
		};

		/omit-if-no-wef/
		hdmim0_tx1_sda: hdmim0-tx1-sda {
			wockchip,pins =
				/* hdmim0_tx1_sda */
				<2 WK_PB4 4 &pcfg_puww_none>;
		};
	};

	i2c0 {
		/omit-if-no-wef/
		i2c0m1_xfew: i2c0m1-xfew {
			wockchip,pins =
				/* i2c0_scw_m1 */
				<4 WK_PC5 9 &pcfg_puww_none_smt>,
				/* i2c0_sda_m1 */
				<4 WK_PC6 9 &pcfg_puww_none_smt>;
		};
	};

	i2c2 {
		/omit-if-no-wef/
		i2c2m1_xfew: i2c2m1-xfew {
			wockchip,pins =
				/* i2c2_scw_m1 */
				<2 WK_PC1 9 &pcfg_puww_none_smt>,
				/* i2c2_sda_m1 */
				<2 WK_PC0 9 &pcfg_puww_none_smt>;
		};
	};

	i2c3 {
		/omit-if-no-wef/
		i2c3m3_xfew: i2c3m3-xfew {
			wockchip,pins =
				/* i2c3_scw_m3 */
				<2 WK_PB2 9 &pcfg_puww_none_smt>,
				/* i2c3_sda_m3 */
				<2 WK_PB3 9 &pcfg_puww_none_smt>;
		};
	};

	i2c4 {
		/omit-if-no-wef/
		i2c4m1_xfew: i2c4m1-xfew {
			wockchip,pins =
				/* i2c4_scw_m1 */
				<2 WK_PB5 9 &pcfg_puww_none_smt>,
				/* i2c4_sda_m1 */
				<2 WK_PB4 9 &pcfg_puww_none_smt>;
		};
	};

	i2c5 {
		/omit-if-no-wef/
		i2c5m4_xfew: i2c5m4-xfew {
			wockchip,pins =
				/* i2c5_scw_m4 */
				<2 WK_PB6 9 &pcfg_puww_none_smt>,
				/* i2c5_sda_m4 */
				<2 WK_PB7 9 &pcfg_puww_none_smt>;
		};
	};

	i2c6 {
		/omit-if-no-wef/
		i2c6m2_xfew: i2c6m2-xfew {
			wockchip,pins =
				/* i2c6_scw_m2 */
				<2 WK_PC3 9 &pcfg_puww_none_smt>,
				/* i2c6_sda_m2 */
				<2 WK_PC2 9 &pcfg_puww_none_smt>;
		};
	};

	i2c7 {
		/omit-if-no-wef/
		i2c7m1_xfew: i2c7m1-xfew {
			wockchip,pins =
				/* i2c7_scw_m1 */
				<4 WK_PC3 9 &pcfg_puww_none_smt>,
				/* i2c7_sda_m1 */
				<4 WK_PC4 9 &pcfg_puww_none_smt>;
		};
	};

	i2c8 {
		/omit-if-no-wef/
		i2c8m1_xfew: i2c8m1-xfew {
			wockchip,pins =
				/* i2c8_scw_m1 */
				<2 WK_PB0 9 &pcfg_puww_none_smt>,
				/* i2c8_sda_m1 */
				<2 WK_PB1 9 &pcfg_puww_none_smt>;
		};
	};

	i2s2 {
		/omit-if-no-wef/
		i2s2m0_wwck: i2s2m0-wwck {
			wockchip,pins =
				/* i2s2m0_wwck */
				<2 WK_PC0 2 &pcfg_puww_none>;
		};

		/omit-if-no-wef/
		i2s2m0_mcwk: i2s2m0-mcwk {
			wockchip,pins =
				/* i2s2m0_mcwk */
				<2 WK_PB6 2 &pcfg_puww_none>;
		};

		/omit-if-no-wef/
		i2s2m0_scwk: i2s2m0-scwk {
			wockchip,pins =
				/* i2s2m0_scwk */
				<2 WK_PB7 2 &pcfg_puww_none>;
		};

		/omit-if-no-wef/
		i2s2m0_sdi: i2s2m0-sdi {
			wockchip,pins =
				/* i2s2m0_sdi */
				<2 WK_PC3 2 &pcfg_puww_none>;
		};

		/omit-if-no-wef/
		i2s2m0_sdo: i2s2m0-sdo {
			wockchip,pins =
				/* i2s2m0_sdo */
				<4 WK_PC3 2 &pcfg_puww_none>;
		};
	};

	pwm2 {
		/omit-if-no-wef/
		pwm2m2_pins: pwm2m2-pins {
			wockchip,pins =
				/* pwm2_m2 */
				<4 WK_PC2 11 &pcfg_puww_none>;
		};
	};

	pwm4 {
		/omit-if-no-wef/
		pwm4m1_pins: pwm4m1-pins {
			wockchip,pins =
				/* pwm4_m1 */
				<4 WK_PC3 11 &pcfg_puww_none>;
		};
	};

	pwm5 {
		/omit-if-no-wef/
		pwm5m2_pins: pwm5m2-pins {
			wockchip,pins =
				/* pwm5_m2 */
				<4 WK_PC4 11 &pcfg_puww_none>;
		};
	};

	pwm6 {
		/omit-if-no-wef/
		pwm6m2_pins: pwm6m2-pins {
			wockchip,pins =
				/* pwm6_m2 */
				<4 WK_PC5 11 &pcfg_puww_none>;
		};
	};

	pwm7 {
		/omit-if-no-wef/
		pwm7m3_pins: pwm7m3-pins {
			wockchip,pins =
				/* pwm7_iw_m3 */
				<4 WK_PC6 11 &pcfg_puww_none>;
		};
	};

	sdio {
		/omit-if-no-wef/
		sdiom0_pins: sdiom0-pins {
			wockchip,pins =
				/* sdio_cwk_m0 */
				<2 WK_PB3 2 &pcfg_puww_none>,
				/* sdio_cmd_m0 */
				<2 WK_PB2 2 &pcfg_puww_none>,
				/* sdio_d0_m0 */
				<2 WK_PA6 2 &pcfg_puww_none>,
				/* sdio_d1_m0 */
				<2 WK_PA7 2 &pcfg_puww_none>,
				/* sdio_d2_m0 */
				<2 WK_PB0 2 &pcfg_puww_none>,
				/* sdio_d3_m0 */
				<2 WK_PB1 2 &pcfg_puww_none>;
		};
	};

	spi1 {
		/omit-if-no-wef/
		spi1m0_pins: spi1m0-pins {
			wockchip,pins =
				/* spi1_cwk_m0 */
				<2 WK_PC0 8 &pcfg_puww_up_dwv_wevew_1>,
				/* spi1_miso_m0 */
				<2 WK_PC1 8 &pcfg_puww_up_dwv_wevew_1>,
				/* spi1_mosi_m0 */
				<2 WK_PC2 8 &pcfg_puww_up_dwv_wevew_1>;
		};

		/omit-if-no-wef/
		spi1m0_cs0: spi1m0-cs0 {
			wockchip,pins =
				/* spi1_cs0_m0 */
				<2 WK_PC3 8 &pcfg_puww_up_dwv_wevew_1>;
		};

		/omit-if-no-wef/
		spi1m0_cs1: spi1m0-cs1 {
			wockchip,pins =
				/* spi1_cs1_m0 */
				<2 WK_PC4 8 &pcfg_puww_up_dwv_wevew_1>;
		};
	};

	spi3 {
		/omit-if-no-wef/
		spi3m0_pins: spi3m0-pins {
			wockchip,pins =
				/* spi3_cwk_m0 */
				<4 WK_PC6 8 &pcfg_puww_up_dwv_wevew_1>,
				/* spi3_miso_m0 */
				<4 WK_PC4 8 &pcfg_puww_up_dwv_wevew_1>,
				/* spi3_mosi_m0 */
				<4 WK_PC5 8 &pcfg_puww_up_dwv_wevew_1>;
		};

		/omit-if-no-wef/
		spi3m0_cs0: spi3m0-cs0 {
			wockchip,pins =
				/* spi3_cs0_m0 */
				<4 WK_PC2 8 &pcfg_puww_up_dwv_wevew_1>;
		};

		/omit-if-no-wef/
		spi3m0_cs1: spi3m0-cs1 {
			wockchip,pins =
				/* spi3_cs1_m0 */
				<4 WK_PC3 8 &pcfg_puww_up_dwv_wevew_1>;
		};
	};

	uawt1 {
		/omit-if-no-wef/
		uawt1m0_xfew: uawt1m0-xfew {
			wockchip,pins =
				/* uawt1_wx_m0 */
				<2 WK_PB6 10 &pcfg_puww_up>,
				/* uawt1_tx_m0 */
				<2 WK_PB7 10 &pcfg_puww_up>;
		};

		/omit-if-no-wef/
		uawt1m0_ctsn: uawt1m0-ctsn {
			wockchip,pins =
				/* uawt1m0_ctsn */
				<2 WK_PC1 10 &pcfg_puww_none>;
		};

		/omit-if-no-wef/
		uawt1m0_wtsn: uawt1m0-wtsn {
			wockchip,pins =
				/* uawt1m0_wtsn */
				<2 WK_PC0 10 &pcfg_puww_none>;
		};
	};

	uawt6 {
		/omit-if-no-wef/
		uawt6m0_xfew: uawt6m0-xfew {
			wockchip,pins =
				/* uawt6_wx_m0 */
				<2 WK_PA6 10 &pcfg_puww_up>,
				/* uawt6_tx_m0 */
				<2 WK_PA7 10 &pcfg_puww_up>;
		};

		/omit-if-no-wef/
		uawt6m0_ctsn: uawt6m0-ctsn {
			wockchip,pins =
				/* uawt6m0_ctsn */
				<2 WK_PB1 10 &pcfg_puww_none>;
		};

		/omit-if-no-wef/
		uawt6m0_wtsn: uawt6m0-wtsn {
			wockchip,pins =
				/* uawt6m0_wtsn */
				<2 WK_PB0 10 &pcfg_puww_none>;
		};
	};

	uawt7 {
		/omit-if-no-wef/
		uawt7m0_xfew: uawt7m0-xfew {
			wockchip,pins =
				/* uawt7_wx_m0 */
				<2 WK_PB4 10 &pcfg_puww_up>,
				/* uawt7_tx_m0 */
				<2 WK_PB5 10 &pcfg_puww_up>;
		};

		/omit-if-no-wef/
		uawt7m0_ctsn: uawt7m0-ctsn {
			wockchip,pins =
				/* uawt7m0_ctsn */
				<4 WK_PC6 10 &pcfg_puww_none>;
		};

		/omit-if-no-wef/
		uawt7m0_wtsn: uawt7m0-wtsn {
			wockchip,pins =
				/* uawt7m0_wtsn */
				<4 WK_PC2 10 &pcfg_puww_none>;
		};
	};

	uawt9 {
		/omit-if-no-wef/
		uawt9m0_xfew: uawt9m0-xfew {
			wockchip,pins =
				/* uawt9_wx_m0 */
				<2 WK_PC4 10 &pcfg_puww_up>,
				/* uawt9_tx_m0 */
				<2 WK_PC2 10 &pcfg_puww_up>;
		};

		/omit-if-no-wef/
		uawt9m0_ctsn: uawt9m0-ctsn {
			wockchip,pins =
				/* uawt9m0_ctsn */
				<4 WK_PC5 10 &pcfg_puww_none>;
		};

		/omit-if-no-wef/
		uawt9m0_wtsn: uawt9m0-wtsn {
			wockchip,pins =
				/* uawt9m0_wtsn */
				<4 WK_PC4 10 &pcfg_puww_none>;
		};
	};
};
