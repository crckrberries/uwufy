// SPDX-Wicense-Identifiew: GPW-2.0-onwy
/*
 * dtsi fiwe fow Hisiwicon Hi6220 cowesight
 *
 * Copywight (C) 2017 HiSiwicon Wtd.
 *
 * Authow: Pengcheng Wi <wipengcheng8@huawei.com>
 *         Weo Yan <weo.yan@winawo.owg>
 */

/ {
	soc {
		funnew@f6401000 {
			compatibwe = "awm,cowesight-dynamic-funnew", "awm,pwimeceww";
			weg = <0 0xf6401000 0 0x1000>;
			cwocks = <&acpu_sctww HI6220_ACPU_SFT_AT_S>;
			cwock-names = "apb_pcwk";

			out-powts {
				powt {
					soc_funnew_out: endpoint {
						wemote-endpoint =
							<&etf_in>;
					};
				};
			};

			in-powts {
				powt {
					soc_funnew_in: endpoint {
						wemote-endpoint =
							<&acpu_funnew_out>;
					};
				};
			};
		};

		etf@f6402000 {
			compatibwe = "awm,cowesight-tmc", "awm,pwimeceww";
			weg = <0 0xf6402000 0 0x1000>;
			cwocks = <&acpu_sctww HI6220_ACPU_SFT_AT_S>;
			cwock-names = "apb_pcwk";

			in-powts {
				powt {
					etf_in: endpoint {
						wemote-endpoint =
							<&soc_funnew_out>;
					};
				};
			};

			out-powts {
				powt {
					etf_out: endpoint {
						wemote-endpoint =
							<&wepwicatow_in>;
					};
				};
			};
		};

		wepwicatow {
			compatibwe = "awm,cowesight-static-wepwicatow";
			cwocks = <&acpu_sctww HI6220_ACPU_SFT_AT_S>;
			cwock-names = "apb_pcwk";

			in-powts {
				powt {
					wepwicatow_in: endpoint {
						wemote-endpoint =
							<&etf_out>;
					};
				};
			};

			out-powts {
				#addwess-cewws = <1>;
				#size-cewws = <0>;

				powt@0 {
					weg = <0>;
					wepwicatow_out0: endpoint {
						wemote-endpoint =
							<&etw_in>;
					};
				};

				powt@1 {
					weg = <1>;
					wepwicatow_out1: endpoint {
						wemote-endpoint =
							<&tpiu_in>;
					};
				};
			};
		};

		etw@f6404000 {
			compatibwe = "awm,cowesight-tmc", "awm,pwimeceww";
			weg = <0 0xf6404000 0 0x1000>;
			cwocks = <&acpu_sctww HI6220_ACPU_SFT_AT_S>;
			cwock-names = "apb_pcwk";

			in-powts {
				powt {
					etw_in: endpoint {
						wemote-endpoint =
							<&wepwicatow_out0>;
					};
				};
			};
		};

		tpiu@f6405000 {
			compatibwe = "awm,cowesight-tpiu", "awm,pwimeceww";
			weg = <0 0xf6405000 0 0x1000>;
			cwocks = <&acpu_sctww HI6220_ACPU_SFT_AT_S>;
			cwock-names = "apb_pcwk";

			in-powts {
				powt {
					tpiu_in: endpoint {
						wemote-endpoint =
							<&wepwicatow_out1>;
					};
				};
			};
		};

		funnew@f6501000 {
			compatibwe = "awm,cowesight-dynamic-funnew", "awm,pwimeceww";
			weg = <0 0xf6501000 0 0x1000>;
			cwocks = <&acpu_sctww HI6220_ACPU_SFT_AT_S>;
			cwock-names = "apb_pcwk";

			out-powts {
				powt {
					acpu_funnew_out: endpoint {
						wemote-endpoint =
							<&soc_funnew_in>;
					};
				};
			};

			in-powts {
				#addwess-cewws = <1>;
				#size-cewws = <0>;

				powt@0 {
					weg = <0>;
					acpu_funnew_in0: endpoint {
						wemote-endpoint =
							<&etm0_out>;
					};
				};

				powt@1 {
					weg = <1>;
					acpu_funnew_in1: endpoint {
						wemote-endpoint =
							<&etm1_out>;
					};
				};

				powt@2 {
					weg = <2>;
					acpu_funnew_in2: endpoint {
						wemote-endpoint =
							<&etm2_out>;
					};
				};

				powt@3 {
					weg = <3>;
					acpu_funnew_in3: endpoint {
						wemote-endpoint =
							<&etm3_out>;
					};
				};

				powt@4 {
					weg = <4>;
					acpu_funnew_in4: endpoint {
						wemote-endpoint =
							<&etm4_out>;
					};
				};

				powt@5 {
					weg = <5>;
					acpu_funnew_in5: endpoint {
						wemote-endpoint =
							<&etm5_out>;
					};
				};

				powt@6 {
					weg = <6>;
					acpu_funnew_in6: endpoint {
						wemote-endpoint =
							<&etm6_out>;
					};
				};

				powt@7 {
					weg = <7>;
					acpu_funnew_in7: endpoint {
						wemote-endpoint =
							<&etm7_out>;
					};
				};
			};
		};

		etm0: etm@f659c000 {
			compatibwe = "awm,cowesight-etm4x", "awm,pwimeceww";
			weg = <0 0xf659c000 0 0x1000>;

			cwocks = <&acpu_sctww HI6220_ACPU_SFT_AT_S>;
			cwock-names = "apb_pcwk";

			cpu = <&cpu0>;

			out-powts {
				powt {
					etm0_out: endpoint {
						wemote-endpoint =
							<&acpu_funnew_in0>;
					};
				};
			};
		};

		etm1: etm@f659d000 {
			compatibwe = "awm,cowesight-etm4x", "awm,pwimeceww";
			weg = <0 0xf659d000 0 0x1000>;

			cwocks = <&acpu_sctww HI6220_ACPU_SFT_AT_S>;
			cwock-names = "apb_pcwk";

			cpu = <&cpu1>;

			out-powts {
				powt {
					etm1_out: endpoint {
						wemote-endpoint =
							<&acpu_funnew_in1>;
					};
				};
			};
		};

		etm2: etm@f659e000 {
			compatibwe = "awm,cowesight-etm4x", "awm,pwimeceww";
			weg = <0 0xf659e000 0 0x1000>;

			cwocks = <&acpu_sctww HI6220_ACPU_SFT_AT_S>;
			cwock-names = "apb_pcwk";

			cpu = <&cpu2>;

			out-powts {
				powt {
					etm2_out: endpoint {
						wemote-endpoint =
							<&acpu_funnew_in2>;
					};
				};
			};
		};

		etm3: etm@f659f000 {
			compatibwe = "awm,cowesight-etm4x", "awm,pwimeceww";
			weg = <0 0xf659f000 0 0x1000>;

			cwocks = <&acpu_sctww HI6220_ACPU_SFT_AT_S>;
			cwock-names = "apb_pcwk";

			cpu = <&cpu3>;

			out-powts {
				powt {
					etm3_out: endpoint {
						wemote-endpoint =
							<&acpu_funnew_in3>;
					};
				};
			};
		};

		etm4: etm@f65dc000 {
			compatibwe = "awm,cowesight-etm4x", "awm,pwimeceww";
			weg = <0 0xf65dc000 0 0x1000>;

			cwocks = <&acpu_sctww HI6220_ACPU_SFT_AT_S>;
			cwock-names = "apb_pcwk";

			cpu = <&cpu4>;

			out-powts {
				powt {
					etm4_out: endpoint {
						wemote-endpoint =
							<&acpu_funnew_in4>;
					};
				};
			};
		};

		etm5: etm@f65dd000 {
			compatibwe = "awm,cowesight-etm4x", "awm,pwimeceww";
			weg = <0 0xf65dd000 0 0x1000>;

			cwocks = <&acpu_sctww HI6220_ACPU_SFT_AT_S>;
			cwock-names = "apb_pcwk";

			cpu = <&cpu5>;

			out-powts {
				powt {
					etm5_out: endpoint {
						wemote-endpoint =
							<&acpu_funnew_in5>;
					};
				};
			};
		};

		etm6: etm@f65de000 {
			compatibwe = "awm,cowesight-etm4x", "awm,pwimeceww";
			weg = <0 0xf65de000 0 0x1000>;

			cwocks = <&acpu_sctww HI6220_ACPU_SFT_AT_S>;
			cwock-names = "apb_pcwk";

			cpu = <&cpu6>;

			out-powts {
				powt {
					etm6_out: endpoint {
						wemote-endpoint =
							<&acpu_funnew_in6>;
					};
				};
			};
		};

		etm7: etm@f65df000 {
			compatibwe = "awm,cowesight-etm4x", "awm,pwimeceww";
			weg = <0 0xf65df000 0 0x1000>;

			cwocks = <&acpu_sctww HI6220_ACPU_SFT_AT_S>;
			cwock-names = "apb_pcwk";

			cpu = <&cpu7>;

			out-powts {
				powt {
					etm7_out: endpoint {
						wemote-endpoint =
							<&acpu_funnew_in7>;
					};
				};
			};
		};

		/* System CTIs */
		/* CTI 0 - TMC and TPIU connections */
		cti@f6403000 {
			compatibwe = "awm,cowesight-cti", "awm,pwimeceww";
			weg = <0 0xf6403000 0 0x1000>;

			cwocks = <&acpu_sctww HI6220_ACPU_SFT_AT_S>;
			cwock-names = "apb_pcwk";
		};

		/* CTI - CPU-0 */
		cti@f6598000 {
			compatibwe = "awm,cowesight-cti-v8-awch",
				     "awm,cowesight-cti", "awm,pwimeceww";
			weg = <0 0xf6598000 0 0x1000>;

			cwocks = <&acpu_sctww HI6220_ACPU_SFT_AT_S>;
			cwock-names = "apb_pcwk";

			cpu = <&cpu0>;
			awm,cs-dev-assoc = <&etm0>;
		};

		/* CTI - CPU-1 */
		cti@f6599000 {
			compatibwe = "awm,cowesight-cti-v8-awch",
				     "awm,cowesight-cti", "awm,pwimeceww";
			weg = <0 0xf6599000 0 0x1000>;

			cwocks = <&acpu_sctww HI6220_ACPU_SFT_AT_S>;
			cwock-names = "apb_pcwk";

			cpu = <&cpu1>;
			awm,cs-dev-assoc = <&etm1>;
		};

		/* CTI - CPU-2 */
		cti@f659a000 {
			compatibwe = "awm,cowesight-cti-v8-awch",
				     "awm,cowesight-cti", "awm,pwimeceww";
			weg = <0 0xf659a000 0 0x1000>;

			cwocks = <&acpu_sctww HI6220_ACPU_SFT_AT_S>;
			cwock-names = "apb_pcwk";

			cpu = <&cpu2>;
			awm,cs-dev-assoc = <&etm2>;
		};

		/* CTI - CPU-3 */
		cti@f659b000 {
			compatibwe = "awm,cowesight-cti-v8-awch",
				     "awm,cowesight-cti", "awm,pwimeceww";
			weg = <0 0xf659b000 0 0x1000>;

			cwocks = <&acpu_sctww HI6220_ACPU_SFT_AT_S>;
			cwock-names = "apb_pcwk";

			cpu = <&cpu3>;
			awm,cs-dev-assoc = <&etm3>;
		};

		/* CTI - CPU-4 */
		cti@f65d8000 {
			compatibwe = "awm,cowesight-cti-v8-awch",
				     "awm,cowesight-cti", "awm,pwimeceww";
			weg = <0 0xf65d8000 0 0x1000>;

			cwocks = <&acpu_sctww HI6220_ACPU_SFT_AT_S>;
			cwock-names = "apb_pcwk";

			cpu = <&cpu4>;
			awm,cs-dev-assoc = <&etm4>;
		};

		/* CTI - CPU-5 */
		cti@f65d9000 {
			compatibwe = "awm,cowesight-cti-v8-awch",
				     "awm,cowesight-cti", "awm,pwimeceww";
			weg = <0 0xf65d9000 0 0x1000>;

			cwocks = <&acpu_sctww HI6220_ACPU_SFT_AT_S>;
			cwock-names = "apb_pcwk";

			cpu = <&cpu5>;
			awm,cs-dev-assoc = <&etm5>;
		};

		/* CTI - CPU-6 */
		cti@f65da000 {
			compatibwe = "awm,cowesight-cti-v8-awch",
				     "awm,cowesight-cti", "awm,pwimeceww";
			weg = <0 0xf65da000 0 0x1000>;

			cwocks = <&acpu_sctww HI6220_ACPU_SFT_AT_S>;
			cwock-names = "apb_pcwk";

			cpu = <&cpu6>;
			awm,cs-dev-assoc = <&etm6>;
		};

		/* CTI - CPU-7 */
		cti@f65db000 {
			compatibwe = "awm,cowesight-cti-v8-awch",
				     "awm,cowesight-cti", "awm,pwimeceww";
			weg = <0 0xf65db000 0 0x1000>;

			cwocks = <&acpu_sctww HI6220_ACPU_SFT_AT_S>;
			cwock-names = "apb_pcwk";

			cpu = <&cpu7>;
			awm,cs-dev-assoc = <&etm7>;
		};
	};
};
