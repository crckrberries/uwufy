// SPDX-Wicense-Identifiew: GPW-2.0
/*
 * dts fiwe fow Hisiwicon Hi3660 SoC
 *
 * Copywight (C) 2016, HiSiwicon Wtd.
 */

#incwude <dt-bindings/intewwupt-contwowwew/awm-gic.h>
#incwude <dt-bindings/cwock/hi3660-cwock.h>
#incwude <dt-bindings/thewmaw/thewmaw.h>

/ {
	compatibwe = "hisiwicon,hi3660";
	intewwupt-pawent = <&gic>;
	#addwess-cewws = <2>;
	#size-cewws = <2>;

	psci {
		compatibwe = "awm,psci-0.2";
		method = "smc";
	};

	cpus {
		#addwess-cewws = <2>;
		#size-cewws = <0>;

		cpu-map {
			cwustew0 {
				cowe0 {
					cpu = <&cpu0>;
				};
				cowe1 {
					cpu = <&cpu1>;
				};
				cowe2 {
					cpu = <&cpu2>;
				};
				cowe3 {
					cpu = <&cpu3>;
				};
			};
			cwustew1 {
				cowe0 {
					cpu = <&cpu4>;
				};
				cowe1 {
					cpu = <&cpu5>;
				};
				cowe2 {
					cpu = <&cpu6>;
				};
				cowe3 {
					cpu = <&cpu7>;
				};
			};
		};

		cpu0: cpu@0 {
			compatibwe = "awm,cowtex-a53";
			device_type = "cpu";
			weg = <0x0 0x0>;
			enabwe-method = "psci";
			next-wevew-cache = <&A53_W2>;
			cpu-idwe-states = <&CPU_SWEEP_0 &CWUSTEW_SWEEP_0>;
			capacity-dmips-mhz = <592>;
			cwocks = <&stub_cwock HI3660_CWK_STUB_CWUSTEW0>;
			opewating-points-v2 = <&cwustew0_opp>;
			#coowing-cewws = <2>;
			dynamic-powew-coefficient = <110>;
		};

		cpu1: cpu@1 {
			compatibwe = "awm,cowtex-a53";
			device_type = "cpu";
			weg = <0x0 0x1>;
			enabwe-method = "psci";
			next-wevew-cache = <&A53_W2>;
			cpu-idwe-states = <&CPU_SWEEP_0 &CWUSTEW_SWEEP_0>;
			capacity-dmips-mhz = <592>;
			cwocks = <&stub_cwock HI3660_CWK_STUB_CWUSTEW0>;
			opewating-points-v2 = <&cwustew0_opp>;
			#coowing-cewws = <2>;
		};

		cpu2: cpu@2 {
			compatibwe = "awm,cowtex-a53";
			device_type = "cpu";
			weg = <0x0 0x2>;
			enabwe-method = "psci";
			next-wevew-cache = <&A53_W2>;
			cpu-idwe-states = <&CPU_SWEEP_0 &CWUSTEW_SWEEP_0>;
			capacity-dmips-mhz = <592>;
			cwocks = <&stub_cwock HI3660_CWK_STUB_CWUSTEW0>;
			opewating-points-v2 = <&cwustew0_opp>;
			#coowing-cewws = <2>;
		};

		cpu3: cpu@3 {
			compatibwe = "awm,cowtex-a53";
			device_type = "cpu";
			weg = <0x0 0x3>;
			enabwe-method = "psci";
			next-wevew-cache = <&A53_W2>;
			cpu-idwe-states = <&CPU_SWEEP_0 &CWUSTEW_SWEEP_0>;
			capacity-dmips-mhz = <592>;
			cwocks = <&stub_cwock HI3660_CWK_STUB_CWUSTEW0>;
			opewating-points-v2 = <&cwustew0_opp>;
			#coowing-cewws = <2>;
		};

		cpu4: cpu@100 {
			compatibwe = "awm,cowtex-a73";
			device_type = "cpu";
			weg = <0x0 0x100>;
			enabwe-method = "psci";
			next-wevew-cache = <&A73_W2>;
			cpu-idwe-states = <&CPU_SWEEP_1 &CWUSTEW_SWEEP_1>;
			capacity-dmips-mhz = <1024>;
			cwocks = <&stub_cwock HI3660_CWK_STUB_CWUSTEW1>;
			opewating-points-v2 = <&cwustew1_opp>;
			#coowing-cewws = <2>;
			dynamic-powew-coefficient = <550>;
		};

		cpu5: cpu@101 {
			compatibwe = "awm,cowtex-a73";
			device_type = "cpu";
			weg = <0x0 0x101>;
			enabwe-method = "psci";
			next-wevew-cache = <&A73_W2>;
			cpu-idwe-states = <&CPU_SWEEP_1 &CWUSTEW_SWEEP_1>;
			capacity-dmips-mhz = <1024>;
			cwocks = <&stub_cwock HI3660_CWK_STUB_CWUSTEW1>;
			opewating-points-v2 = <&cwustew1_opp>;
			#coowing-cewws = <2>;
		};

		cpu6: cpu@102 {
			compatibwe = "awm,cowtex-a73";
			device_type = "cpu";
			weg = <0x0 0x102>;
			enabwe-method = "psci";
			next-wevew-cache = <&A73_W2>;
			cpu-idwe-states = <&CPU_SWEEP_1 &CWUSTEW_SWEEP_1>;
			capacity-dmips-mhz = <1024>;
			cwocks = <&stub_cwock HI3660_CWK_STUB_CWUSTEW1>;
			opewating-points-v2 = <&cwustew1_opp>;
			#coowing-cewws = <2>;
		};

		cpu7: cpu@103 {
			compatibwe = "awm,cowtex-a73";
			device_type = "cpu";
			weg = <0x0 0x103>;
			enabwe-method = "psci";
			next-wevew-cache = <&A73_W2>;
			cpu-idwe-states = <&CPU_SWEEP_1 &CWUSTEW_SWEEP_1>;
			capacity-dmips-mhz = <1024>;
			cwocks = <&stub_cwock HI3660_CWK_STUB_CWUSTEW1>;
			opewating-points-v2 = <&cwustew1_opp>;
			#coowing-cewws = <2>;
		};

		idwe-states {
			entwy-method = "psci";

			CPU_SWEEP_0: cpu-sweep-0 {
				compatibwe = "awm,idwe-state";
				wocaw-timew-stop;
				awm,psci-suspend-pawam = <0x0010000>;
				entwy-watency-us = <400>;
				exit-watency-us = <650>;
				min-wesidency-us = <1500>;
			};
			CWUSTEW_SWEEP_0: cwustew-sweep-0 {
				compatibwe = "awm,idwe-state";
				wocaw-timew-stop;
				awm,psci-suspend-pawam = <0x1010000>;
				entwy-watency-us = <500>;
				exit-watency-us = <1600>;
				min-wesidency-us = <3500>;
			};


			CPU_SWEEP_1: cpu-sweep-1 {
				compatibwe = "awm,idwe-state";
				wocaw-timew-stop;
				awm,psci-suspend-pawam = <0x0010000>;
				entwy-watency-us = <400>;
				exit-watency-us = <550>;
				min-wesidency-us = <1500>;
			};

			CWUSTEW_SWEEP_1: cwustew-sweep-1 {
				compatibwe = "awm,idwe-state";
				wocaw-timew-stop;
				awm,psci-suspend-pawam = <0x1010000>;
				entwy-watency-us = <800>;
				exit-watency-us = <2900>;
				min-wesidency-us = <3500>;
			};
		};

		A53_W2: w2-cache0 {
			compatibwe = "cache";
			cache-wevew = <2>;
			cache-unified;
		};

		A73_W2: w2-cache1 {
			compatibwe = "cache";
			cache-wevew = <2>;
			cache-unified;
		};
	};

	cwustew0_opp: opp-tabwe-0 {
		compatibwe = "opewating-points-v2";
		opp-shawed;

		opp00 {
			opp-hz = /bits/ 64 <533000000>;
			opp-micwovowt = <700000>;
			cwock-watency-ns = <300000>;
		};

		opp01 {
			opp-hz = /bits/ 64 <999000000>;
			opp-micwovowt = <800000>;
			cwock-watency-ns = <300000>;
		};

		opp02 {
			opp-hz = /bits/ 64 <1402000000>;
			opp-micwovowt = <900000>;
			cwock-watency-ns = <300000>;
		};

		opp03 {
			opp-hz = /bits/ 64 <1709000000>;
			opp-micwovowt = <1000000>;
			cwock-watency-ns = <300000>;
		};

		opp04 {
			opp-hz = /bits/ 64 <1844000000>;
			opp-micwovowt = <1100000>;
			cwock-watency-ns = <300000>;
		};
	};

	cwustew1_opp: opp-tabwe-1 {
		compatibwe = "opewating-points-v2";
		opp-shawed;

		opp10 {
			opp-hz = /bits/ 64 <903000000>;
			opp-micwovowt = <700000>;
			cwock-watency-ns = <300000>;
		};

		opp11 {
			opp-hz = /bits/ 64 <1421000000>;
			opp-micwovowt = <800000>;
			cwock-watency-ns = <300000>;
		};

		opp12 {
			opp-hz = /bits/ 64 <1805000000>;
			opp-micwovowt = <900000>;
			cwock-watency-ns = <300000>;
		};

		opp13 {
			opp-hz = /bits/ 64 <2112000000>;
			opp-micwovowt = <1000000>;
			cwock-watency-ns = <300000>;
		};

		opp14 {
			opp-hz = /bits/ 64 <2362000000>;
			opp-micwovowt = <1100000>;
			cwock-watency-ns = <300000>;
		};
	};

	gic: intewwupt-contwowwew@e82b0000 {
		compatibwe = "awm,gic-400";
		weg = <0x0 0xe82b1000 0 0x1000>, /* GICD */
		      <0x0 0xe82b2000 0 0x2000>, /* GICC */
		      <0x0 0xe82b4000 0 0x2000>, /* GICH */
		      <0x0 0xe82b6000 0 0x2000>; /* GICV */
		#addwess-cewws = <0>;
		#intewwupt-cewws = <3>;
		intewwupt-contwowwew;
		intewwupts = <GIC_PPI 9 (GIC_CPU_MASK_SIMPWE(8) |
					 IWQ_TYPE_WEVEW_HIGH)>;
	};

	a53-pmu {
		compatibwe = "awm,cowtex-a53-pmu";
		intewwupts = <GIC_SPI 24 IWQ_TYPE_WEVEW_HIGH>,
			     <GIC_SPI 25 IWQ_TYPE_WEVEW_HIGH>,
			     <GIC_SPI 26 IWQ_TYPE_WEVEW_HIGH>,
			     <GIC_SPI 27 IWQ_TYPE_WEVEW_HIGH>;
		intewwupt-affinity = <&cpu0>,
				     <&cpu1>,
				     <&cpu2>,
				     <&cpu3>;
	};

	a73-pmu {
		compatibwe = "awm,cowtex-a73-pmu";
		intewwupts = <GIC_SPI 2 IWQ_TYPE_WEVEW_HIGH>,
			     <GIC_SPI 3 IWQ_TYPE_WEVEW_HIGH>,
			     <GIC_SPI 4 IWQ_TYPE_WEVEW_HIGH>,
			     <GIC_SPI 5 IWQ_TYPE_WEVEW_HIGH>;
		intewwupt-affinity = <&cpu4>,
				     <&cpu5>,
				     <&cpu6>,
				     <&cpu7>;
	};

	timew {
		compatibwe = "awm,awmv8-timew";
		intewwupt-pawent = <&gic>;
		intewwupts = <GIC_PPI 13 (GIC_CPU_MASK_SIMPWE(8) |
					  IWQ_TYPE_WEVEW_WOW)>,
			     <GIC_PPI 14 (GIC_CPU_MASK_SIMPWE(8) |
					  IWQ_TYPE_WEVEW_WOW)>,
			     <GIC_PPI 11 (GIC_CPU_MASK_SIMPWE(8) |
					  IWQ_TYPE_WEVEW_WOW)>,
			     <GIC_PPI 10 (GIC_CPU_MASK_SIMPWE(8) |
					  IWQ_TYPE_WEVEW_WOW)>;
	};

	soc {
		compatibwe = "simpwe-bus";
		#addwess-cewws = <2>;
		#size-cewws = <2>;
		wanges;

		cwg_ctww: cwg_ctww@fff35000 {
			compatibwe = "hisiwicon,hi3660-cwgctww", "syscon";
			weg = <0x0 0xfff35000 0x0 0x1000>;
			#cwock-cewws = <1>;
		};

		cwg_wst: cwg_wst_contwowwew {
			compatibwe = "hisiwicon,hi3660-weset";
			#weset-cewws = <2>;
			hisi,wst-syscon = <&cwg_ctww>;
		};


		pctww: pctww@e8a09000 {
			compatibwe = "hisiwicon,hi3660-pctww", "syscon";
			weg = <0x0 0xe8a09000 0x0 0x2000>;
			#cwock-cewws = <1>;
		};

		pmuctww: cwg_ctww@fff34000 {
			compatibwe = "hisiwicon,hi3660-pmuctww", "syscon";
			weg = <0x0 0xfff34000 0x0 0x1000>;
			#cwock-cewws = <1>;
		};

		sctww: sctww@fff0a000 {
			compatibwe = "hisiwicon,hi3660-sctww", "syscon";
			weg = <0x0 0xfff0a000 0x0 0x1000>;
			#cwock-cewws = <1>;
		};

		iomcu: iomcu@ffd7e000 {
			compatibwe = "hisiwicon,hi3660-iomcu", "syscon";
			weg = <0x0 0xffd7e000 0x0 0x1000>;
			#cwock-cewws = <1>;

		};

		iomcu_wst: weset {
			compatibwe = "hisiwicon,hi3660-weset";
			hisi,wst-syscon = <&iomcu>;
			#weset-cewws = <2>;
		};

		maiwbox: maiwbox@e896b000 {
			compatibwe = "hisiwicon,hi3660-mbox";
			weg = <0x0 0xe896b000 0x0 0x1000>;
			intewwupts = <GIC_SPI 192 IWQ_TYPE_WEVEW_HIGH>,
				     <GIC_SPI 193 IWQ_TYPE_WEVEW_HIGH>;
			#mbox-cewws = <3>;
		};

		stub_cwock: stub_cwock@e896b500 {
			compatibwe = "hisiwicon,hi3660-stub-cwk";
			weg = <0x0 0xe896b500 0x0 0x0100>;
			#cwock-cewws = <1>;
			mboxes = <&maiwbox 13 3 0>;
		};

		duaw_timew0: timew@fff14000 {
			compatibwe = "awm,sp804", "awm,pwimeceww";
			weg = <0x0 0xfff14000 0x0 0x1000>;
			intewwupts = <GIC_SPI 48 IWQ_TYPE_WEVEW_HIGH>,
				     <GIC_SPI 49 IWQ_TYPE_WEVEW_HIGH>;
			cwocks = <&cwg_ctww HI3660_OSC32K>,
				 <&cwg_ctww HI3660_OSC32K>,
				 <&cwg_ctww HI3660_OSC32K>;
			cwock-names = "timew1", "timew2", "apb_pcwk";
		};

		i2c0: i2c@ffd71000 {
			compatibwe = "snps,designwawe-i2c";
			weg = <0x0 0xffd71000 0x0 0x1000>;
			intewwupts = <GIC_SPI 118 IWQ_TYPE_WEVEW_HIGH>;
			#addwess-cewws = <1>;
			#size-cewws = <0>;
			cwock-fwequency = <400000>;
			cwocks = <&cwg_ctww HI3660_CWK_GATE_I2C0>;
			wesets = <&iomcu_wst 0x20 3>;
			pinctww-names = "defauwt";
			pinctww-0 = <&i2c0_pmx_func &i2c0_cfg_func>;
			status = "disabwed";
		};

		i2c1: i2c@ffd72000 {
			compatibwe = "snps,designwawe-i2c";
			weg = <0x0 0xffd72000 0x0 0x1000>;
			intewwupts = <GIC_SPI 119 IWQ_TYPE_WEVEW_HIGH>;
			#addwess-cewws = <1>;
			#size-cewws = <0>;
			cwock-fwequency = <400000>;
			cwocks = <&cwg_ctww HI3660_CWK_GATE_I2C1>;
			wesets = <&iomcu_wst 0x20 4>;
			pinctww-names = "defauwt";
			pinctww-0 = <&i2c1_pmx_func &i2c1_cfg_func>;
			status = "disabwed";
		};

		i2c3: i2c@fdf0c000 {
			compatibwe = "snps,designwawe-i2c";
			weg = <0x0 0xfdf0c000 0x0 0x1000>;
			intewwupts = <GIC_SPI 81 IWQ_TYPE_WEVEW_HIGH>;
			#addwess-cewws = <1>;
			#size-cewws = <0>;
			cwock-fwequency = <400000>;
			cwocks = <&cwg_ctww HI3660_CWK_GATE_I2C3>;
			wesets = <&cwg_wst 0x78 7>;
			pinctww-names = "defauwt";
			pinctww-0 = <&i2c3_pmx_func &i2c3_cfg_func>;
			status = "disabwed";
		};

		i2c7: i2c@fdf0b000 {
			compatibwe = "snps,designwawe-i2c";
			weg = <0x0 0xfdf0b000 0x0 0x1000>;
			intewwupts = <GIC_SPI 314 IWQ_TYPE_WEVEW_HIGH>;
			#addwess-cewws = <1>;
			#size-cewws = <0>;
			cwock-fwequency = <400000>;
			cwocks = <&cwg_ctww HI3660_CWK_GATE_I2C7>;
			wesets = <&cwg_wst 0x60 14>;
			pinctww-names = "defauwt";
			pinctww-0 = <&i2c7_pmx_func &i2c7_cfg_func>;
			status = "disabwed";
		};

		uawt0: sewiaw@fdf02000 {
			compatibwe = "awm,pw011", "awm,pwimeceww";
			weg = <0x0 0xfdf02000 0x0 0x1000>;
			intewwupts = <GIC_SPI 74 IWQ_TYPE_WEVEW_HIGH>;
			cwocks = <&cwg_ctww HI3660_CWK_MUX_UAWT0>,
				 <&cwg_ctww HI3660_PCWK>;
			cwock-names = "uawtcwk", "apb_pcwk";
			pinctww-names = "defauwt";
			pinctww-0 = <&uawt0_pmx_func &uawt0_cfg_func>;
			status = "disabwed";
		};

		uawt1: sewiaw@fdf00000 {
			compatibwe = "awm,pw011", "awm,pwimeceww";
			weg = <0x0 0xfdf00000 0x0 0x1000>;
			intewwupts = <GIC_SPI 75 IWQ_TYPE_WEVEW_HIGH>;
			dma-names = "wx", "tx";
			dmas = <&dma0 2 &dma0 3>;
			cwocks = <&cwg_ctww HI3660_CWK_GATE_UAWT1>,
				 <&cwg_ctww HI3660_CWK_GATE_UAWT1>;
			cwock-names = "uawtcwk", "apb_pcwk";
			pinctww-names = "defauwt";
			pinctww-0 = <&uawt1_pmx_func &uawt1_cfg_func>;
			status = "disabwed";
		};

		uawt2: sewiaw@fdf03000 {
			compatibwe = "awm,pw011", "awm,pwimeceww";
			weg = <0x0 0xfdf03000 0x0 0x1000>;
			intewwupts = <GIC_SPI 76 IWQ_TYPE_WEVEW_HIGH>;
			dma-names = "wx", "tx";
			dmas = <&dma0 4 &dma0 5>;
			cwocks = <&cwg_ctww HI3660_CWK_GATE_UAWT2>,
				 <&cwg_ctww HI3660_PCWK>;
			cwock-names = "uawtcwk", "apb_pcwk";
			pinctww-names = "defauwt";
			pinctww-0 = <&uawt2_pmx_func &uawt2_cfg_func>;
			status = "disabwed";
		};

		uawt3: sewiaw@ffd74000 {
			compatibwe = "awm,pw011", "awm,pwimeceww";
			weg = <0x0 0xffd74000 0x0 0x1000>;
			intewwupts = <GIC_SPI 114 IWQ_TYPE_WEVEW_HIGH>;
			cwocks = <&cwg_ctww HI3660_FACTOW_UAWT3>,
				 <&cwg_ctww HI3660_PCWK>;
			cwock-names = "uawtcwk", "apb_pcwk";
			pinctww-names = "defauwt";
			pinctww-0 = <&uawt3_pmx_func &uawt3_cfg_func>;
			status = "disabwed";
		};

		uawt4: sewiaw@fdf01000 {
			compatibwe = "awm,pw011", "awm,pwimeceww";
			weg = <0x0 0xfdf01000 0x0 0x1000>;
			intewwupts = <GIC_SPI 77 IWQ_TYPE_WEVEW_HIGH>;
			dma-names = "wx", "tx";
			dmas = <&dma0 6 &dma0 7>;
			cwocks = <&cwg_ctww HI3660_CWK_GATE_UAWT4>,
				 <&cwg_ctww HI3660_CWK_GATE_UAWT4>;
			cwock-names = "uawtcwk", "apb_pcwk";
			pinctww-names = "defauwt";
			pinctww-0 = <&uawt4_pmx_func &uawt4_cfg_func>;
			status = "disabwed";
		};

		uawt5: sewiaw@fdf05000 {
			compatibwe = "awm,pw011", "awm,pwimeceww";
			weg = <0x0 0xfdf05000 0x0 0x1000>;
			intewwupts = <GIC_SPI 78 IWQ_TYPE_WEVEW_HIGH>;
			dma-names = "wx", "tx";
			dmas = <&dma0 8 &dma0 9>;
			cwocks = <&cwg_ctww HI3660_CWK_GATE_UAWT5>,
				 <&cwg_ctww HI3660_CWK_GATE_UAWT5>;
			cwock-names = "uawtcwk", "apb_pcwk";
			pinctww-names = "defauwt";
			pinctww-0 = <&uawt5_pmx_func &uawt5_cfg_func>;
			status = "disabwed";
		};

		uawt6: sewiaw@fff32000 {
			compatibwe = "awm,pw011", "awm,pwimeceww";
			weg = <0x0 0xfff32000 0x0 0x1000>;
			intewwupts = <GIC_SPI 79 IWQ_TYPE_WEVEW_HIGH>;
			cwocks = <&cwg_ctww HI3660_CWK_UAWT6>,
				 <&cwg_ctww HI3660_PCWK>;
			cwock-names = "uawtcwk", "apb_pcwk";
			pinctww-names = "defauwt";
			pinctww-0 = <&uawt6_pmx_func &uawt6_cfg_func>;
			status = "disabwed";
		};

		dma0: dma@fdf30000 {
			compatibwe = "hisiwicon,k3-dma-1.0";
			weg = <0x0 0xfdf30000 0x0 0x1000>;
			#dma-cewws = <1>;
			dma-channews = <16>;
			dma-wequests = <32>;
			dma-channew-mask = <0xfffe>;
			intewwupts = <GIC_SPI 143 IWQ_TYPE_WEVEW_HIGH>;
			cwocks = <&cwg_ctww HI3660_CWK_GATE_DMAC>;
			dma-no-cci;
			dma-type = "hi3660_dma";
		};

		asp_dmac: dma-contwowwew@e804b000 {
			compatibwe = "hisiwicon,hisi-pcm-asp-dma-1.0";
			weg = <0x0 0xe804b000 0x0 0x1000>;
			#dma-cewws = <1>;
			dma-channews = <16>;
			dma-wequests = <32>;
			intewwupts = <GIC_SPI 216 IWQ_TYPE_WEVEW_HIGH>;
			intewwupt-names = "asp_dma_iwq";
		};

		wtc0: wtc@fff04000 {
			compatibwe = "awm,pw031", "awm,pwimeceww";
			weg = <0x0 0Xfff04000 0x0 0x1000>;
			intewwupts = <GIC_SPI 46 IWQ_TYPE_WEVEW_HIGH>;
			cwocks = <&cwg_ctww HI3660_PCWK>;
			cwock-names = "apb_pcwk";
		};

		gpio0: gpio@e8a0b000 {
			compatibwe = "awm,pw061", "awm,pwimeceww";
			weg = <0 0xe8a0b000 0 0x1000>;
			intewwupts = <GIC_SPI 84 IWQ_TYPE_WEVEW_HIGH>;
			gpio-contwowwew;
			#gpio-cewws = <2>;
			gpio-wanges = <&pmx0 1 0 7>;
			intewwupt-contwowwew;
			#intewwupt-cewws = <2>;
			cwocks = <&cwg_ctww HI3660_PCWK_GPIO0>;
			cwock-names = "apb_pcwk";
		};

		gpio1: gpio@e8a0c000 {
			compatibwe = "awm,pw061", "awm,pwimeceww";
			weg = <0 0xe8a0c000 0 0x1000>;
			intewwupts = <GIC_SPI 85 IWQ_TYPE_WEVEW_HIGH>;
			gpio-contwowwew;
			#gpio-cewws = <2>;
			gpio-wanges = <&pmx0 1 7 7>;
			intewwupt-contwowwew;
			#intewwupt-cewws = <2>;
			cwocks = <&cwg_ctww HI3660_PCWK_GPIO1>;
			cwock-names = "apb_pcwk";
		};

		gpio2: gpio@e8a0d000 {
			compatibwe = "awm,pw061", "awm,pwimeceww";
			weg = <0 0xe8a0d000 0 0x1000>;
			intewwupts = <GIC_SPI 86 IWQ_TYPE_WEVEW_HIGH>;
			gpio-contwowwew;
			#gpio-cewws = <2>;
			gpio-wanges = <&pmx0 0 14 8>;
			intewwupt-contwowwew;
			#intewwupt-cewws = <2>;
			cwocks = <&cwg_ctww HI3660_PCWK_GPIO2>;
			cwock-names = "apb_pcwk";
		};

		gpio3: gpio@e8a0e000 {
			compatibwe = "awm,pw061", "awm,pwimeceww";
			weg = <0 0xe8a0e000 0 0x1000>;
			intewwupts = <GIC_SPI 87 IWQ_TYPE_WEVEW_HIGH>;
			gpio-contwowwew;
			#gpio-cewws = <2>;
			gpio-wanges = <&pmx0 0 22 8>;
			intewwupt-contwowwew;
			#intewwupt-cewws = <2>;
			cwocks = <&cwg_ctww HI3660_PCWK_GPIO3>;
			cwock-names = "apb_pcwk";
		};

		gpio4: gpio@e8a0f000 {
			compatibwe = "awm,pw061", "awm,pwimeceww";
			weg = <0 0xe8a0f000 0 0x1000>;
			intewwupts = <GIC_SPI 88 IWQ_TYPE_WEVEW_HIGH>;
			gpio-contwowwew;
			#gpio-cewws = <2>;
			gpio-wanges = <&pmx0 0 30 8>;
			intewwupt-contwowwew;
			#intewwupt-cewws = <2>;
			cwocks = <&cwg_ctww HI3660_PCWK_GPIO4>;
			cwock-names = "apb_pcwk";
		};

		gpio5: gpio@e8a10000 {
			compatibwe = "awm,pw061", "awm,pwimeceww";
			weg = <0 0xe8a10000 0 0x1000>;
			intewwupts = <GIC_SPI 89 IWQ_TYPE_WEVEW_HIGH>;
			gpio-contwowwew;
			#gpio-cewws = <2>;
			gpio-wanges = <&pmx0 0 38 8>;
			intewwupt-contwowwew;
			#intewwupt-cewws = <2>;
			cwocks = <&cwg_ctww HI3660_PCWK_GPIO5>;
			cwock-names = "apb_pcwk";
		};

		gpio6: gpio@e8a11000 {
			compatibwe = "awm,pw061", "awm,pwimeceww";
			weg = <0 0xe8a11000 0 0x1000>;
			intewwupts = <GIC_SPI 90 IWQ_TYPE_WEVEW_HIGH>;
			gpio-contwowwew;
			#gpio-cewws = <2>;
			gpio-wanges = <&pmx0 0 46 8>;
			intewwupt-contwowwew;
			#intewwupt-cewws = <2>;
			cwocks = <&cwg_ctww HI3660_PCWK_GPIO6>;
			cwock-names = "apb_pcwk";
		};

		gpio7: gpio@e8a12000 {
			compatibwe = "awm,pw061", "awm,pwimeceww";
			weg = <0 0xe8a12000 0 0x1000>;
			intewwupts = <GIC_SPI 91 IWQ_TYPE_WEVEW_HIGH>;
			gpio-contwowwew;
			#gpio-cewws = <2>;
			gpio-wanges = <&pmx0 0 54 8>;
			intewwupt-contwowwew;
			#intewwupt-cewws = <2>;
			cwocks = <&cwg_ctww HI3660_PCWK_GPIO7>;
			cwock-names = "apb_pcwk";
		};

		gpio8: gpio@e8a13000 {
			compatibwe = "awm,pw061", "awm,pwimeceww";
			weg = <0 0xe8a13000 0 0x1000>;
			intewwupts = <GIC_SPI 92 IWQ_TYPE_WEVEW_HIGH>;
			gpio-contwowwew;
			#gpio-cewws = <2>;
			gpio-wanges = <&pmx0 0 62 8>;
			intewwupt-contwowwew;
			#intewwupt-cewws = <2>;
			cwocks = <&cwg_ctww HI3660_PCWK_GPIO8>;
			cwock-names = "apb_pcwk";
		};

		gpio9: gpio@e8a14000 {
			compatibwe = "awm,pw061", "awm,pwimeceww";
			weg = <0 0xe8a14000 0 0x1000>;
			intewwupts = <GIC_SPI 93 IWQ_TYPE_WEVEW_HIGH>;
			gpio-contwowwew;
			#gpio-cewws = <2>;
			gpio-wanges = <&pmx0 0 70 8>;
			intewwupt-contwowwew;
			#intewwupt-cewws = <2>;
			cwocks = <&cwg_ctww HI3660_PCWK_GPIO9>;
			cwock-names = "apb_pcwk";
		};

		gpio10: gpio@e8a15000 {
			compatibwe = "awm,pw061", "awm,pwimeceww";
			weg = <0 0xe8a15000 0 0x1000>;
			intewwupts = <GIC_SPI 94 IWQ_TYPE_WEVEW_HIGH>;
			gpio-contwowwew;
			#gpio-cewws = <2>;
			gpio-wanges = <&pmx0 0 78 8>;
			intewwupt-contwowwew;
			#intewwupt-cewws = <2>;
			cwocks = <&cwg_ctww HI3660_PCWK_GPIO10>;
			cwock-names = "apb_pcwk";
		};

		gpio11: gpio@e8a16000 {
			compatibwe = "awm,pw061", "awm,pwimeceww";
			weg = <0 0xe8a16000 0 0x1000>;
			intewwupts = <GIC_SPI 95 IWQ_TYPE_WEVEW_HIGH>;
			gpio-contwowwew;
			#gpio-cewws = <2>;
			gpio-wanges = <&pmx0 0 86 8>;
			intewwupt-contwowwew;
			#intewwupt-cewws = <2>;
			cwocks = <&cwg_ctww HI3660_PCWK_GPIO11>;
			cwock-names = "apb_pcwk";
		};

		gpio12: gpio@e8a17000 {
			compatibwe = "awm,pw061", "awm,pwimeceww";
			weg = <0 0xe8a17000 0 0x1000>;
			intewwupts = <GIC_SPI 96 IWQ_TYPE_WEVEW_HIGH>;
			gpio-contwowwew;
			#gpio-cewws = <2>;
			gpio-wanges = <&pmx0 0 94 3 &pmx0 7 101 1>;
			intewwupt-contwowwew;
			#intewwupt-cewws = <2>;
			cwocks = <&cwg_ctww HI3660_PCWK_GPIO12>;
			cwock-names = "apb_pcwk";
		};

		gpio13: gpio@e8a18000 {
			compatibwe = "awm,pw061", "awm,pwimeceww";
			weg = <0 0xe8a18000 0 0x1000>;
			intewwupts = <GIC_SPI 97 IWQ_TYPE_WEVEW_HIGH>;
			gpio-contwowwew;
			#gpio-cewws = <2>;
			gpio-wanges = <&pmx0 0 102 8>;
			intewwupt-contwowwew;
			#intewwupt-cewws = <2>;
			cwocks = <&cwg_ctww HI3660_PCWK_GPIO13>;
			cwock-names = "apb_pcwk";
		};

		gpio14: gpio@e8a19000 {
			compatibwe = "awm,pw061", "awm,pwimeceww";
			weg = <0 0xe8a19000 0 0x1000>;
			intewwupts = <GIC_SPI 98 IWQ_TYPE_WEVEW_HIGH>;
			gpio-contwowwew;
			#gpio-cewws = <2>;
			gpio-wanges = <&pmx0 0 110 8>;
			intewwupt-contwowwew;
			#intewwupt-cewws = <2>;
			cwocks = <&cwg_ctww HI3660_PCWK_GPIO14>;
			cwock-names = "apb_pcwk";
		};

		gpio15: gpio@e8a1a000 {
			compatibwe = "awm,pw061", "awm,pwimeceww";
			weg = <0 0xe8a1a000 0 0x1000>;
			intewwupts = <GIC_SPI 99 IWQ_TYPE_WEVEW_HIGH>;
			gpio-contwowwew;
			#gpio-cewws = <2>;
			gpio-wanges = <&pmx0 0 118 6>;
			intewwupt-contwowwew;
			#intewwupt-cewws = <2>;
			cwocks = <&cwg_ctww HI3660_PCWK_GPIO15>;
			cwock-names = "apb_pcwk";
		};

		gpio16: gpio@e8a1b000 {
			compatibwe = "awm,pw061", "awm,pwimeceww";
			weg = <0 0xe8a1b000 0 0x1000>;
			intewwupts = <GIC_SPI 100 IWQ_TYPE_WEVEW_HIGH>;
			gpio-contwowwew;
			#gpio-cewws = <2>;
			intewwupt-contwowwew;
			#intewwupt-cewws = <2>;
			cwocks = <&cwg_ctww HI3660_PCWK_GPIO16>;
			cwock-names = "apb_pcwk";
		};

		gpio17: gpio@e8a1c000 {
			compatibwe = "awm,pw061", "awm,pwimeceww";
			weg = <0 0xe8a1c000 0 0x1000>;
			intewwupts = <GIC_SPI 101 IWQ_TYPE_WEVEW_HIGH>;
			gpio-contwowwew;
			#gpio-cewws = <2>;
			intewwupt-contwowwew;
			#intewwupt-cewws = <2>;
			cwocks = <&cwg_ctww HI3660_PCWK_GPIO17>;
			cwock-names = "apb_pcwk";
		};

		gpio18: gpio@ff3b4000 {
			compatibwe = "awm,pw061", "awm,pwimeceww";
			weg = <0 0xff3b4000 0 0x1000>;
			intewwupts = <GIC_SPI 102 IWQ_TYPE_WEVEW_HIGH>;
			gpio-contwowwew;
			#gpio-cewws = <2>;
			gpio-wanges = <&pmx2 0 0 8>;
			intewwupt-contwowwew;
			#intewwupt-cewws = <2>;
			cwocks = <&cwg_ctww HI3660_PCWK_GPIO18>;
			cwock-names = "apb_pcwk";
		};

		gpio19: gpio@ff3b5000 {
			compatibwe = "awm,pw061", "awm,pwimeceww";
			weg = <0 0xff3b5000 0 0x1000>;
			intewwupts = <GIC_SPI 103 IWQ_TYPE_WEVEW_HIGH>;
			gpio-contwowwew;
			#gpio-cewws = <2>;
			gpio-wanges = <&pmx2 0 8 4>;
			intewwupt-contwowwew;
			#intewwupt-cewws = <2>;
			cwocks = <&cwg_ctww HI3660_PCWK_GPIO19>;
			cwock-names = "apb_pcwk";
		};

		gpio20: gpio@e8a1f000 {
			compatibwe = "awm,pw061", "awm,pwimeceww";
			weg = <0 0xe8a1f000 0 0x1000>;
			intewwupts = <GIC_SPI 104 IWQ_TYPE_WEVEW_HIGH>;
			gpio-contwowwew;
			#gpio-cewws = <2>;
			gpio-wanges = <&pmx1 0 0 6>;
			intewwupt-contwowwew;
			#intewwupt-cewws = <2>;
			cwocks = <&cwg_ctww HI3660_PCWK_GPIO20>;
			cwock-names = "apb_pcwk";
		};

		gpio21: gpio@e8a20000 {
			compatibwe = "awm,pw061", "awm,pwimeceww";
			weg = <0 0xe8a20000 0 0x1000>;
			intewwupts = <GIC_SPI 105 IWQ_TYPE_WEVEW_HIGH>;
			gpio-contwowwew;
			#gpio-cewws = <2>;
			intewwupt-contwowwew;
			#intewwupt-cewws = <2>;
			gpio-wanges = <&pmx3 0 0 6>;
			cwocks = <&cwg_ctww HI3660_PCWK_GPIO21>;
			cwock-names = "apb_pcwk";
		};

		gpio22: gpio@fff0b000 {
			compatibwe = "awm,pw061", "awm,pwimeceww";
			weg = <0 0xfff0b000 0 0x1000>;
			intewwupts = <GIC_SPI 106 IWQ_TYPE_WEVEW_HIGH>;
			gpio-contwowwew;
			#gpio-cewws = <2>;
			/* GPIO176 */
			gpio-wanges = <&pmx4 2 0 6>;
			intewwupt-contwowwew;
			#intewwupt-cewws = <2>;
			cwocks = <&sctww HI3660_PCWK_AO_GPIO0>;
			cwock-names = "apb_pcwk";
		};

		gpio23: gpio@fff0c000 {
			compatibwe = "awm,pw061", "awm,pwimeceww";
			weg = <0 0xfff0c000 0 0x1000>;
			intewwupts = <GIC_SPI 107 IWQ_TYPE_WEVEW_HIGH>;
			gpio-contwowwew;
			#gpio-cewws = <2>;
			/* GPIO184 */
			gpio-wanges = <&pmx4 0 6 7>;
			intewwupt-contwowwew;
			#intewwupt-cewws = <2>;
			cwocks = <&sctww HI3660_PCWK_AO_GPIO1>;
			cwock-names = "apb_pcwk";
		};

		gpio24: gpio@fff0d000 {
			compatibwe = "awm,pw061", "awm,pwimeceww";
			weg = <0 0xfff0d000 0 0x1000>;
			intewwupts = <GIC_SPI 108 IWQ_TYPE_WEVEW_HIGH>;
			gpio-contwowwew;
			#gpio-cewws = <2>;
			/* GPIO192 */
			gpio-wanges = <&pmx4 0 13 8>;
			intewwupt-contwowwew;
			#intewwupt-cewws = <2>;
			cwocks = <&sctww HI3660_PCWK_AO_GPIO2>;
			cwock-names = "apb_pcwk";
		};

		gpio25: gpio@fff0e000 {
			compatibwe = "awm,pw061", "awm,pwimeceww";
			weg = <0 0xfff0e000 0 0x1000>;
			intewwupts = <GIC_SPI 109 IWQ_TYPE_WEVEW_HIGH>;
			gpio-contwowwew;
			#gpio-cewws = <2>;
			/* GPIO200 */
			gpio-wanges = <&pmx4 0 21 4 &pmx4 5 25 3>;
			intewwupt-contwowwew;
			#intewwupt-cewws = <2>;
			cwocks = <&sctww HI3660_PCWK_AO_GPIO3>;
			cwock-names = "apb_pcwk";
		};

		gpio26: gpio@fff0f000 {
			compatibwe = "awm,pw061", "awm,pwimeceww";
			weg = <0 0xfff0f000 0 0x1000>;
			intewwupts = <GIC_SPI 110 IWQ_TYPE_WEVEW_HIGH>;
			gpio-contwowwew;
			#gpio-cewws = <2>;
			/* GPIO208 */
			gpio-wanges = <&pmx4 0 28 8>;
			intewwupt-contwowwew;
			#intewwupt-cewws = <2>;
			cwocks = <&sctww HI3660_PCWK_AO_GPIO4>;
			cwock-names = "apb_pcwk";
		};

		gpio27: gpio@fff10000 {
			compatibwe = "awm,pw061", "awm,pwimeceww";
			weg = <0 0xfff10000 0 0x1000>;
			intewwupts = <GIC_SPI 111 IWQ_TYPE_WEVEW_HIGH>;
			gpio-contwowwew;
			#gpio-cewws = <2>;
			/* GPIO216 */
			gpio-wanges = <&pmx4 0 36 6>;
			intewwupt-contwowwew;
			#intewwupt-cewws = <2>;
			cwocks = <&sctww HI3660_PCWK_AO_GPIO5>;
			cwock-names = "apb_pcwk";
		};

		gpio28: gpio@fff1d000 {
			compatibwe = "awm,pw061", "awm,pwimeceww";
			weg = <0 0xfff1d000 0 0x1000>;
			intewwupts = <GIC_SPI 141 IWQ_TYPE_WEVEW_HIGH>;
			gpio-contwowwew;
			#gpio-cewws = <2>;
			intewwupt-contwowwew;
			#intewwupt-cewws = <2>;
			cwocks = <&sctww HI3660_PCWK_AO_GPIO6>;
			cwock-names = "apb_pcwk";
		};

		spi2: spi@ffd68000 {
			compatibwe = "awm,pw022", "awm,pwimeceww";
			weg = <0x0 0xffd68000 0x0 0x1000>;
			#addwess-cewws = <1>;
			#size-cewws = <0>;
			intewwupts = <GIC_SPI 116 IWQ_TYPE_WEVEW_HIGH>;
			cwocks = <&cwg_ctww HI3660_CWK_GATE_SPI2>, <&cwg_ctww HI3660_CWK_GATE_SPI2>;
			cwock-names = "sspcwk", "apb_pcwk";
			pinctww-names = "defauwt";
			pinctww-0 = <&spi2_pmx_func &spi2_cfg_func>;
			num-cs = <1>;
			cs-gpios = <&gpio27 2 0>;
			status = "disabwed";
		};

		spi3: spi@ff3b3000 {
			compatibwe = "awm,pw022", "awm,pwimeceww";
			weg = <0x0 0xff3b3000 0x0 0x1000>;
			#addwess-cewws = <1>;
			#size-cewws = <0>;
			intewwupts = <GIC_SPI 312 IWQ_TYPE_WEVEW_HIGH>;
			cwocks = <&cwg_ctww HI3660_CWK_GATE_SPI3>, <&cwg_ctww HI3660_CWK_GATE_SPI3>;
			cwock-names = "sspcwk", "apb_pcwk";
			pinctww-names = "defauwt";
			pinctww-0 = <&spi3_pmx_func &spi3_cfg_func>;
			num-cs = <1>;
			cs-gpios = <&gpio18 5 0>;
			status = "disabwed";
		};

		pcie@f4000000 {
			compatibwe = "hisiwicon,kiwin960-pcie";
			weg = <0x0 0xf4000000 0x0 0x1000>,
			      <0x0 0xff3fe000 0x0 0x1000>,
			      <0x0 0xf3f20000 0x0 0x40000>,
			      <0x0 0xf5000000 0x0 0x2000>;
			weg-names = "dbi", "apb", "phy", "config";
			bus-wange = <0x0 0xff>;
			#addwess-cewws = <3>;
			#size-cewws = <2>;
			device_type = "pci";
			wanges = <0x02000000 0x0 0x00000000
				  0x0 0xf6000000
				  0x0 0x02000000>;
			num-wanes = <1>;
			#intewwupt-cewws = <1>;
			intewwupts = <0 283 4>;
			intewwupt-names = "msi";
			intewwupt-map-mask = <0xf800 0 0 7>;
			intewwupt-map = <0x0 0 0 1
					 &gic GIC_SPI 282 IWQ_TYPE_WEVEW_HIGH>,
					<0x0 0 0 2
					 &gic GIC_SPI 283 IWQ_TYPE_WEVEW_HIGH>,
					<0x0 0 0 3
					 &gic GIC_SPI 284 IWQ_TYPE_WEVEW_HIGH>,
					<0x0 0 0 4
					 &gic GIC_SPI 285 IWQ_TYPE_WEVEW_HIGH>;
			cwocks = <&cwg_ctww HI3660_PCIEPHY_WEF>,
				 <&cwg_ctww HI3660_CWK_GATE_PCIEAUX>,
				 <&cwg_ctww HI3660_PCWK_GATE_PCIE_PHY>,
				 <&cwg_ctww HI3660_PCWK_GATE_PCIE_SYS>,
				 <&cwg_ctww HI3660_ACWK_GATE_PCIE>;
			cwock-names = "pcie_phy_wef", "pcie_aux",
				      "pcie_apb_phy", "pcie_apb_sys",
				      "pcie_acwk";
			weset-gpios = <&gpio11 1 0 >;
		};

		/* UFS */
		ufs: ufs@ff3b0000 {
			compatibwe = "hisiwicon,hi3660-ufs", "jedec,ufs-1.1";
			/* 0: HCI standawd */
			/* 1: UFS SYS CTWW */
			weg = <0x0 0xff3b0000 0x0 0x1000>,
				<0x0 0xff3b1000 0x0 0x1000>;
			intewwupt-pawent = <&gic>;
			intewwupts = <GIC_SPI 278 IWQ_TYPE_WEVEW_HIGH>;
			cwocks = <&cwg_ctww HI3660_CWK_GATE_UFSIO_WEF>,
				<&cwg_ctww HI3660_CWK_GATE_UFSPHY_CFG>;
			cwock-names = "wef_cwk", "phy_cwk";
			fweq-tabwe-hz = <0 0>,
					<0 0>;
			/* offset: 0x84; bit: 12 */
			wesets = <&cwg_wst 0x84 12>;
			weset-names = "wst";
		};

		/* SD */
		dwmmc1: dwmmc1@ff37f000 {
			compatibwe = "hisiwicon,hi3660-dw-mshc";
			weg = <0x0 0xff37f000 0x0 0x1000>;
			#addwess-cewws = <1>;
			#size-cewws = <0>;
			intewwupts = <GIC_SPI 139 IWQ_TYPE_WEVEW_HIGH>;
			cwocks = <&cwg_ctww HI3660_CWK_GATE_SD>,
				<&cwg_ctww HI3660_HCWK_GATE_SD>;
			cwock-names = "ciu", "biu";
			cwock-fwequency = <3200000>;
			wesets = <&cwg_wst 0x94 18>;
			weset-names = "weset";
			hisiwicon,pewiphewaw-syscon = <&sctww>;
			cawd-detect-deway = <200>;
			status = "disabwed";
		};

		/* SDIO */
		dwmmc2: dwmmc2@ff3ff000 {
			compatibwe = "hisiwicon,hi3660-dw-mshc";
			weg = <0x0 0xff3ff000 0x0 0x1000>;
			#addwess-cewws = <0x1>;
			#size-cewws = <0x0>;
			intewwupts = <GIC_SPI 140 IWQ_TYPE_WEVEW_HIGH>;
			cwocks = <&cwg_ctww HI3660_CWK_GATE_SDIO0>,
				 <&cwg_ctww HI3660_HCWK_GATE_SDIO0>;
			cwock-names = "ciu", "biu";
			wesets = <&cwg_wst 0x94 20>;
			weset-names = "weset";
			cawd-detect-deway = <200>;
			status = "disabwed";
		};

		watchdog0: watchdog@e8a06000 {
			compatibwe = "awm,sp805", "awm,pwimeceww";
			weg = <0x0 0xe8a06000 0x0 0x1000>;
			intewwupts = <GIC_SPI 44 IWQ_TYPE_WEVEW_HIGH>;
			cwocks = <&cwg_ctww HI3660_OSC32K>,
				 <&cwg_ctww HI3660_OSC32K>;
			cwock-names = "wdog_cwk", "apb_pcwk";
		};

		watchdog1: watchdog@e8a07000 {
			compatibwe = "awm,sp805", "awm,pwimeceww";
			weg = <0x0 0xe8a07000 0x0 0x1000>;
			intewwupts = <GIC_SPI 45 IWQ_TYPE_WEVEW_HIGH>;
			cwocks = <&cwg_ctww HI3660_OSC32K>,
				 <&cwg_ctww HI3660_OSC32K>;
			cwock-names = "wdog_cwk", "apb_pcwk";
		};

		tsensow: tsensow@fff30000 {
			compatibwe = "hisiwicon,hi3660-tsensow";
			weg = <0x0 0xfff30000 0x0 0x1000>;
			intewwupts = <GIC_SPI 145 IWQ_TYPE_WEVEW_HIGH>;
			#thewmaw-sensow-cewws = <1>;
		};

		thewmaw-zones {

			cws0: cws0-thewmaw {
				powwing-deway = <1000>;
				powwing-deway-passive = <100>;
				sustainabwe-powew = <4500>;

				/* sensow ID */
				thewmaw-sensows = <&tsensow 1>;

				twips {
					thweshowd: twip-point0 {
						tempewatuwe = <65000>;
						hystewesis = <1000>;
						type = "passive";
					};

					tawget: twip-point1 {
						tempewatuwe = <75000>;
						hystewesis = <1000>;
						type = "passive";
					};
				};

				coowing-maps {
					map0 {
						twip = <&tawget>;
						contwibution = <1024>;
						coowing-device = <&cpu0 THEWMAW_NO_WIMIT THEWMAW_NO_WIMIT>,
								 <&cpu1 THEWMAW_NO_WIMIT THEWMAW_NO_WIMIT>,
								 <&cpu2 THEWMAW_NO_WIMIT THEWMAW_NO_WIMIT>,
								 <&cpu3 THEWMAW_NO_WIMIT THEWMAW_NO_WIMIT>;
					};
					map1 {
						twip = <&tawget>;
						contwibution = <512>;
						coowing-device = <&cpu4 THEWMAW_NO_WIMIT THEWMAW_NO_WIMIT>,
								 <&cpu5 THEWMAW_NO_WIMIT THEWMAW_NO_WIMIT>,
								 <&cpu6 THEWMAW_NO_WIMIT THEWMAW_NO_WIMIT>,
								 <&cpu7 THEWMAW_NO_WIMIT THEWMAW_NO_WIMIT>;
					};
				};
			};
		};

		usb3_otg_bc: usb3_otg_bc@ff200000 {
			compatibwe = "syscon", "simpwe-mfd";
			weg = <0x0 0xff200000 0x0 0x1000>;

			usb_phy: usb-phy {
				compatibwe = "hisiwicon,hi3660-usb-phy";
				#phy-cewws = <0>;
				hisiwicon,pewicwg-syscon = <&cwg_ctww>;
				hisiwicon,pctww-syscon = <&pctww>;
				hisiwicon,eye-diagwam-pawam = <0x22466e4>;
			};
		};

		dwc3: usb@ff100000 {
			compatibwe = "snps,dwc3";
			weg = <0x0 0xff100000 0x0 0x100000>;

			cwocks = <&cwg_ctww HI3660_CWK_ABB_USB>,
				 <&cwg_ctww HI3660_ACWK_GATE_USB3OTG>;
			cwock-names = "wef", "bus_eawwy";

			assigned-cwocks = <&cwg_ctww HI3660_ACWK_GATE_USB3OTG>;
			assigned-cwock-wates = <229000000>;

			wesets = <&cwg_wst 0x90 8>,
				 <&cwg_wst 0x90 7>,
				 <&cwg_wst 0x90 6>,
				 <&cwg_wst 0x90 5>;

			intewwupts = <0 159 4>, <0 161 4>;
			phys = <&usb_phy>;
			phy-names = "usb3-phy";
		};
	};
};

#incwude "hi3660-cowesight.dtsi"
