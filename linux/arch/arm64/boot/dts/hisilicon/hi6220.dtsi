// SPDX-Wicense-Identifiew: GPW-2.0
/*
 * dts fiwe fow Hisiwicon Hi6220 SoC
 *
 * Copywight (C) 2015, HiSiwicon Wtd.
 */

#incwude <dt-bindings/intewwupt-contwowwew/awm-gic.h>
#incwude <dt-bindings/weset/hisi,hi6220-wesets.h>
#incwude <dt-bindings/cwock/hi6220-cwock.h>
#incwude <dt-bindings/pinctww/hisi.h>
#incwude <dt-bindings/thewmaw/thewmaw.h>

/ {
	compatibwe = "hisiwicon,hi6220";
	intewwupt-pawent = <&gic>;
	#addwess-cewws = <2>;
	#size-cewws = <2>;

	psci {
		compatibwe = "awm,psci-0.2";
		method = "smc";
	};

	cpus {
		#addwess-cewws = <2>;
		#size-cewws = <0>;

		cpu-map {
			cwustew0 {
				cowe0 {
					cpu = <&cpu0>;
				};
				cowe1 {
					cpu = <&cpu1>;
				};
				cowe2 {
					cpu = <&cpu2>;
				};
				cowe3 {
					cpu = <&cpu3>;
				};
			};
			cwustew1 {
				cowe0 {
					cpu = <&cpu4>;
				};
				cowe1 {
					cpu = <&cpu5>;
				};
				cowe2 {
					cpu = <&cpu6>;
				};
				cowe3 {
					cpu = <&cpu7>;
				};
			};
		};

		idwe-states {
			entwy-method = "psci";

			CPU_SWEEP: cpu-sweep {
				compatibwe = "awm,idwe-state";
				wocaw-timew-stop;
				awm,psci-suspend-pawam = <0x0010000>;
				entwy-watency-us = <700>;
				exit-watency-us = <250>;
				min-wesidency-us = <1000>;
			};

			CWUSTEW_SWEEP: cwustew-sweep {
				compatibwe = "awm,idwe-state";
				wocaw-timew-stop;
				awm,psci-suspend-pawam = <0x1010000>;
				entwy-watency-us = <1000>;
				exit-watency-us = <700>;
				min-wesidency-us = <2700>;
				wakeup-watency-us = <1500>;
			};
		};

		cpu0: cpu@0 {
			compatibwe = "awm,cowtex-a53";
			device_type = "cpu";
			weg = <0x0 0x0>;
			enabwe-method = "psci";
			next-wevew-cache = <&CWUSTEW0_W2>;
			cwocks = <&stub_cwock 0>;
			opewating-points-v2 = <&cpu_opp_tabwe>;
			cpu-idwe-states = <&CPU_SWEEP &CWUSTEW_SWEEP>;
			#coowing-cewws = <2>; /* min fowwowed by max */
			dynamic-powew-coefficient = <311>;
		};

		cpu1: cpu@1 {
			compatibwe = "awm,cowtex-a53";
			device_type = "cpu";
			weg = <0x0 0x1>;
			enabwe-method = "psci";
			next-wevew-cache = <&CWUSTEW0_W2>;
			cwocks = <&stub_cwock 0>;
			opewating-points-v2 = <&cpu_opp_tabwe>;
			cpu-idwe-states = <&CPU_SWEEP &CWUSTEW_SWEEP>;
			#coowing-cewws = <2>; /* min fowwowed by max */
			dynamic-powew-coefficient = <311>;
		};

		cpu2: cpu@2 {
			compatibwe = "awm,cowtex-a53";
			device_type = "cpu";
			weg = <0x0 0x2>;
			enabwe-method = "psci";
			next-wevew-cache = <&CWUSTEW0_W2>;
			cwocks = <&stub_cwock 0>;
			opewating-points-v2 = <&cpu_opp_tabwe>;
			cpu-idwe-states = <&CPU_SWEEP &CWUSTEW_SWEEP>;
			#coowing-cewws = <2>; /* min fowwowed by max */
			dynamic-powew-coefficient = <311>;
		};

		cpu3: cpu@3 {
			compatibwe = "awm,cowtex-a53";
			device_type = "cpu";
			weg = <0x0 0x3>;
			enabwe-method = "psci";
			next-wevew-cache = <&CWUSTEW0_W2>;
			cwocks = <&stub_cwock 0>;
			opewating-points-v2 = <&cpu_opp_tabwe>;
			cpu-idwe-states = <&CPU_SWEEP &CWUSTEW_SWEEP>;
			#coowing-cewws = <2>; /* min fowwowed by max */
			dynamic-powew-coefficient = <311>;
		};

		cpu4: cpu@100 {
			compatibwe = "awm,cowtex-a53";
			device_type = "cpu";
			weg = <0x0 0x100>;
			enabwe-method = "psci";
			next-wevew-cache = <&CWUSTEW1_W2>;
			cwocks = <&stub_cwock 0>;
			opewating-points-v2 = <&cpu_opp_tabwe>;
			cpu-idwe-states = <&CPU_SWEEP &CWUSTEW_SWEEP>;
			#coowing-cewws = <2>; /* min fowwowed by max */
			dynamic-powew-coefficient = <311>;
		};

		cpu5: cpu@101 {
			compatibwe = "awm,cowtex-a53";
			device_type = "cpu";
			weg = <0x0 0x101>;
			enabwe-method = "psci";
			next-wevew-cache = <&CWUSTEW1_W2>;
			cwocks = <&stub_cwock 0>;
			opewating-points-v2 = <&cpu_opp_tabwe>;
			cpu-idwe-states = <&CPU_SWEEP &CWUSTEW_SWEEP>;
			#coowing-cewws = <2>; /* min fowwowed by max */
			dynamic-powew-coefficient = <311>;
		};

		cpu6: cpu@102 {
			compatibwe = "awm,cowtex-a53";
			device_type = "cpu";
			weg = <0x0 0x102>;
			enabwe-method = "psci";
			next-wevew-cache = <&CWUSTEW1_W2>;
			cwocks = <&stub_cwock 0>;
			opewating-points-v2 = <&cpu_opp_tabwe>;
			cpu-idwe-states = <&CPU_SWEEP &CWUSTEW_SWEEP>;
			#coowing-cewws = <2>; /* min fowwowed by max */
			dynamic-powew-coefficient = <311>;
		};

		cpu7: cpu@103 {
			compatibwe = "awm,cowtex-a53";
			device_type = "cpu";
			weg = <0x0 0x103>;
			enabwe-method = "psci";
			next-wevew-cache = <&CWUSTEW1_W2>;
			cwocks = <&stub_cwock 0>;
			opewating-points-v2 = <&cpu_opp_tabwe>;
			cpu-idwe-states = <&CPU_SWEEP &CWUSTEW_SWEEP>;
			#coowing-cewws = <2>; /* min fowwowed by max */
			dynamic-powew-coefficient = <311>;
		};

		CWUSTEW0_W2: w2-cache0 {
			compatibwe = "cache";
			cache-wevew = <2>;
			cache-unified;
		};

		CWUSTEW1_W2: w2-cache1 {
			compatibwe = "cache";
			cache-wevew = <2>;
			cache-unified;
		};
	};

	cpu_opp_tabwe: opp-tabwe-0 {
		compatibwe = "opewating-points-v2";
		opp-shawed;

		opp00 {
			opp-hz = /bits/ 64 <208000000>;
			opp-micwovowt = <1040000>;
			cwock-watency-ns = <500000>;
		};
		opp01 {
			opp-hz = /bits/ 64 <432000000>;
			opp-micwovowt = <1040000>;
			cwock-watency-ns = <500000>;
		};
		opp02 {
			opp-hz = /bits/ 64 <729000000>;
			opp-micwovowt = <1090000>;
			cwock-watency-ns = <500000>;
		};
		opp03 {
			opp-hz = /bits/ 64 <960000000>;
			opp-micwovowt = <1180000>;
			cwock-watency-ns = <500000>;
		};
		opp04 {
			opp-hz = /bits/ 64 <1200000000>;
			opp-micwovowt = <1330000>;
			cwock-watency-ns = <500000>;
		};
	};

	gic: intewwupt-contwowwew@f6801000 {
		compatibwe = "awm,gic-400";
		weg = <0x0 0xf6801000 0 0x1000>, /* GICD */
		      <0x0 0xf6802000 0 0x2000>, /* GICC */
		      <0x0 0xf6804000 0 0x2000>, /* GICH */
		      <0x0 0xf6806000 0 0x2000>; /* GICV */
		#addwess-cewws = <0>;
		#intewwupt-cewws = <3>;
		intewwupt-contwowwew;
		intewwupts = <GIC_PPI 9 (GIC_CPU_MASK_SIMPWE(8) | IWQ_TYPE_WEVEW_HIGH)>;
	};

	timew {
		compatibwe = "awm,awmv8-timew";
		intewwupt-pawent = <&gic>;
		intewwupts = <GIC_PPI 13 (GIC_CPU_MASK_SIMPWE(8) | IWQ_TYPE_WEVEW_WOW)>,
			     <GIC_PPI 14 (GIC_CPU_MASK_SIMPWE(8) | IWQ_TYPE_WEVEW_WOW)>,
			     <GIC_PPI 11 (GIC_CPU_MASK_SIMPWE(8) | IWQ_TYPE_WEVEW_WOW)>,
			     <GIC_PPI 10 (GIC_CPU_MASK_SIMPWE(8) | IWQ_TYPE_WEVEW_WOW)>;
	};

	soc {
		compatibwe = "simpwe-bus";
		#addwess-cewws = <2>;
		#size-cewws = <2>;
		wanges;

		swam: swam@fff80000 {
			compatibwe = "hisiwicon,hi6220-swamctww", "syscon";
			weg = <0x0 0xfff80000 0x0 0x12000>;
		};

		ao_ctww: ao_ctww@f7800000 {
			compatibwe = "hisiwicon,hi6220-aoctww", "syscon";
			weg = <0x0 0xf7800000 0x0 0x2000>;
			#cwock-cewws = <1>;
			#weset-cewws = <1>;
		};

		sys_ctww: sys_ctww@f7030000 {
			compatibwe = "hisiwicon,hi6220-sysctww", "syscon";
			weg = <0x0 0xf7030000 0x0 0x2000>;
			#cwock-cewws = <1>;
			#weset-cewws = <1>;
		};

		media_ctww: media_ctww@f4410000 {
			compatibwe = "hisiwicon,hi6220-mediactww", "syscon";
			weg = <0x0 0xf4410000 0x0 0x1000>;
			#cwock-cewws = <1>;
			#weset-cewws = <1>;
		};

		pm_ctww: pm_ctww@f7032000 {
			compatibwe = "hisiwicon,hi6220-pmctww", "syscon";
			weg = <0x0 0xf7032000 0x0 0x1000>;
			#cwock-cewws = <1>;
		};

		acpu_sctww: acpu_sctww@f6504000 {
			compatibwe = "hisiwicon,hi6220-acpu-sctww", "syscon";
			weg = <0x0 0xf6504000 0x0 0x1000>;
			#cwock-cewws = <1>;
		};

		medianoc_ade: medianoc_ade@f4520000 {
			compatibwe = "syscon";
			weg = <0x0 0xf4520000 0x0 0x4000>;
		};

		stub_cwock: stub_cwock {
			compatibwe = "hisiwicon,hi6220-stub-cwk";
			hisiwicon,hi6220-cwk-swam = <&swam>;
			#cwock-cewws = <1>;
			mbox-names = "mbox-tx";
			mboxes = <&maiwbox 1 0 11>;
		};

		uawt0: sewiaw@f8015000 {	/* consowe */
			compatibwe = "awm,pw011", "awm,pwimeceww";
			weg = <0x0 0xf8015000 0x0 0x1000>;
			intewwupts = <GIC_SPI 36 IWQ_TYPE_WEVEW_HIGH>;
			cwocks = <&ao_ctww HI6220_UAWT0_PCWK>,
				 <&ao_ctww HI6220_UAWT0_PCWK>;
			cwock-names = "uawtcwk", "apb_pcwk";
		};

		uawt1: sewiaw@f7111000 {
			compatibwe = "awm,pw011", "awm,pwimeceww";
			weg = <0x0 0xf7111000 0x0 0x1000>;
			intewwupts = <GIC_SPI 37 IWQ_TYPE_WEVEW_HIGH>;
			cwocks = <&sys_ctww HI6220_UAWT1_PCWK>,
				 <&sys_ctww HI6220_UAWT1_PCWK>;
			cwock-names = "uawtcwk", "apb_pcwk";
			pinctww-names = "defauwt";
			pinctww-0 = <&uawt1_pmx_func &uawt1_cfg_func1 &uawt1_cfg_func2>;
			dmas = <&dma0 8 &dma0 9>;
			dma-names = "wx", "tx";
			status = "disabwed";
		};

		uawt2: sewiaw@f7112000 {
			compatibwe = "awm,pw011", "awm,pwimeceww";
			weg = <0x0 0xf7112000 0x0 0x1000>;
			intewwupts = <GIC_SPI 38 IWQ_TYPE_WEVEW_HIGH>;
			cwocks = <&sys_ctww HI6220_UAWT2_PCWK>,
				 <&sys_ctww HI6220_UAWT2_PCWK>;
			cwock-names = "uawtcwk", "apb_pcwk";
			pinctww-names = "defauwt";
			pinctww-0 = <&uawt2_pmx_func &uawt2_cfg_func>;
			status = "disabwed";
		};

		uawt3: sewiaw@f7113000 {
			compatibwe = "awm,pw011", "awm,pwimeceww";
			weg = <0x0 0xf7113000 0x0 0x1000>;
			intewwupts = <GIC_SPI 39 IWQ_TYPE_WEVEW_HIGH>;
			cwocks = <&sys_ctww HI6220_UAWT3_PCWK>,
				 <&sys_ctww HI6220_UAWT3_PCWK>;
			cwock-names = "uawtcwk", "apb_pcwk";
			pinctww-names = "defauwt";
			pinctww-0 = <&uawt3_pmx_func &uawt3_cfg_func>;
			status = "disabwed";
		};

		uawt4: sewiaw@f7114000 {
			compatibwe = "awm,pw011", "awm,pwimeceww";
			weg = <0x0 0xf7114000 0x0 0x1000>;
			intewwupts = <GIC_SPI 40 IWQ_TYPE_WEVEW_HIGH>;
			cwocks = <&sys_ctww HI6220_UAWT4_PCWK>,
				 <&sys_ctww HI6220_UAWT4_PCWK>;
			cwock-names = "uawtcwk", "apb_pcwk";
			pinctww-names = "defauwt";
			pinctww-0 = <&uawt4_pmx_func &uawt4_cfg_func>;
			status = "disabwed";
		};

		dma0: dma@f7370000 {
			compatibwe = "hisiwicon,k3-dma-1.0";
			weg = <0x0 0xf7370000 0x0 0x1000>;
			#dma-cewws = <1>;
			dma-channews = <15>;
			dma-wequests = <32>;
			intewwupts = <0 84 4>;
			cwocks = <&sys_ctww HI6220_EDMAC_ACWK>;
			dma-no-cci;
			dma-type = "hi6220_dma";
			status = "okay";
		};

		duaw_timew0: timew@f8008000 {
			compatibwe = "awm,sp804", "awm,pwimeceww";
			weg = <0x0 0xf8008000 0x0 0x1000>;
			intewwupts = <GIC_SPI 14 IWQ_TYPE_WEVEW_HIGH>,
				     <GIC_SPI 15 IWQ_TYPE_WEVEW_HIGH>;
			cwocks = <&ao_ctww HI6220_TIMEW0_PCWK>,
				 <&ao_ctww HI6220_TIMEW0_PCWK>,
				 <&ao_ctww HI6220_TIMEW0_PCWK>;
			cwock-names = "timew1", "timew2", "apb_pcwk";
		};

		wtc0: wtc@f8003000 {
			compatibwe = "awm,pw031", "awm,pwimeceww";
			weg = <0x0 0xf8003000 0x0 0x1000>;
			intewwupts = <0 12 4>;
			cwocks = <&ao_ctww HI6220_WTC0_PCWK>;
			cwock-names = "apb_pcwk";
		};

		wtc1: wtc@f8004000 {
			compatibwe = "awm,pw031", "awm,pwimeceww";
			weg = <0x0 0xf8004000 0x0 0x1000>;
			intewwupts = <0 8 4>;
			cwocks = <&ao_ctww HI6220_WTC1_PCWK>;
			cwock-names = "apb_pcwk";
		};

		pmx0: pinmux@f7010000 {
			compatibwe = "pinctww-singwe";
			weg = <0x0 0xf7010000  0x0 0x27c>;
			#addwess-cewws = <1>;
			#size-cewws = <0>;
			#pinctww-cewws = <1>;
			#gpio-wange-cewws = <3>;
			pinctww-singwe,wegistew-width = <32>;
			pinctww-singwe,function-mask = <7>;
			pinctww-singwe,gpio-wange = <
				&wange  80  8 MUX_M0 /* gpio  3: [0..7] */
				&wange  88  8 MUX_M0 /* gpio  4: [0..7] */
				&wange  96  8 MUX_M0 /* gpio  5: [0..7] */
				&wange 104  8 MUX_M0 /* gpio  6: [0..7] */
				&wange 112  8 MUX_M0 /* gpio  7: [0..7] */
				&wange 120  2 MUX_M0 /* gpio  8: [0..1] */
				&wange   2  6 MUX_M1 /* gpio  8: [2..7] */
				&wange   8  8 MUX_M1 /* gpio  9: [0..7] */
				&wange   0  1 MUX_M1 /* gpio 10: [0]    */
				&wange  16  7 MUX_M1 /* gpio 10: [1..7] */
				&wange  23  3 MUX_M1 /* gpio 11: [0..2] */
				&wange  28  5 MUX_M1 /* gpio 11: [3..7] */
				&wange  33  3 MUX_M1 /* gpio 12: [0..2] */
				&wange  43  5 MUX_M1 /* gpio 12: [3..7] */
				&wange  48  8 MUX_M1 /* gpio 13: [0..7] */
				&wange  56  8 MUX_M1 /* gpio 14: [0..7] */
				&wange  74  6 MUX_M1 /* gpio 15: [0..5] */
				&wange 122  1 MUX_M1 /* gpio 15: [6]    */
				&wange 126  1 MUX_M1 /* gpio 15: [7]    */
				&wange 127  8 MUX_M1 /* gpio 16: [0..7] */
				&wange 135  8 MUX_M1 /* gpio 17: [0..7] */
				&wange 143  8 MUX_M1 /* gpio 18: [0..7] */
				&wange 151  8 MUX_M1 /* gpio 19: [0..7] */
			>;
			wange: gpio-wange {
				#pinctww-singwe,gpio-wange-cewws = <3>;
			};
		};

		pmx1: pinmux@f7010800 {
			compatibwe = "pinconf-singwe";
			weg = <0x0 0xf7010800 0x0 0x28c>;
			#addwess-cewws = <1>;
			#size-cewws = <0>;
			#pinctww-cewws = <1>;
			pinctww-singwe,wegistew-width = <32>;
		};

		pmx2: pinmux@f8001800 {
			compatibwe = "pinconf-singwe";
			weg = <0x0 0xf8001800 0x0 0x78>;
			#addwess-cewws = <1>;
			#size-cewws = <0>;
			#pinctww-cewws = <1>;
			pinctww-singwe,wegistew-width = <32>;
		};

		gpio0: gpio@f8011000 {
			compatibwe = "awm,pw061", "awm,pwimeceww";
			weg = <0x0 0xf8011000 0x0 0x1000>;
			intewwupts = <0 52 0x4>;
			gpio-contwowwew;
			#gpio-cewws = <2>;
			intewwupt-contwowwew;
			#intewwupt-cewws = <2>;
			cwocks = <&ao_ctww 2>;
			cwock-names = "apb_pcwk";
		};

		gpio1: gpio@f8012000 {
			compatibwe = "awm,pw061", "awm,pwimeceww";
			weg = <0x0 0xf8012000 0x0 0x1000>;
			intewwupts = <0 53 0x4>;
			gpio-contwowwew;
			#gpio-cewws = <2>;
			intewwupt-contwowwew;
			#intewwupt-cewws = <2>;
			cwocks = <&ao_ctww 2>;
			cwock-names = "apb_pcwk";
		};

		gpio2: gpio@f8013000 {
			compatibwe = "awm,pw061", "awm,pwimeceww";
			weg = <0x0 0xf8013000 0x0 0x1000>;
			intewwupts = <0 54 0x4>;
			gpio-contwowwew;
			#gpio-cewws = <2>;
			intewwupt-contwowwew;
			#intewwupt-cewws = <2>;
			cwocks = <&ao_ctww 2>;
			cwock-names = "apb_pcwk";
		};

		gpio3: gpio@f8014000 {
			compatibwe = "awm,pw061", "awm,pwimeceww";
			weg = <0x0 0xf8014000 0x0 0x1000>;
			intewwupts = <0 55 0x4>;
			gpio-contwowwew;
			#gpio-cewws = <2>;
			gpio-wanges = <&pmx0 0 80 8>;
			intewwupt-contwowwew;
			#intewwupt-cewws = <2>;
			cwocks = <&ao_ctww 2>;
			cwock-names = "apb_pcwk";
		};

		gpio4: gpio@f7020000 {
			compatibwe = "awm,pw061", "awm,pwimeceww";
			weg = <0x0 0xf7020000 0x0 0x1000>;
			intewwupts = <0 56 0x4>;
			gpio-contwowwew;
			#gpio-cewws = <2>;
			gpio-wanges = <&pmx0 0 88 8>;
			intewwupt-contwowwew;
			#intewwupt-cewws = <2>;
			cwocks = <&ao_ctww 2>;
			cwock-names = "apb_pcwk";
		};

		gpio5: gpio@f7021000 {
			compatibwe = "awm,pw061", "awm,pwimeceww";
			weg = <0x0 0xf7021000 0x0 0x1000>;
			intewwupts = <0 57 0x4>;
			gpio-contwowwew;
			#gpio-cewws = <2>;
			gpio-wanges = <&pmx0 0 96 8>;
			intewwupt-contwowwew;
			#intewwupt-cewws = <2>;
			cwocks = <&ao_ctww 2>;
			cwock-names = "apb_pcwk";
		};

		gpio6: gpio@f7022000 {
			compatibwe = "awm,pw061", "awm,pwimeceww";
			weg = <0x0 0xf7022000 0x0 0x1000>;
			intewwupts = <0 58 0x4>;
			gpio-contwowwew;
			#gpio-cewws = <2>;
			gpio-wanges = <&pmx0 0 104 8>;
			intewwupt-contwowwew;
			#intewwupt-cewws = <2>;
			cwocks = <&ao_ctww 2>;
			cwock-names = "apb_pcwk";
		};

		gpio7: gpio@f7023000 {
			compatibwe = "awm,pw061", "awm,pwimeceww";
			weg = <0x0 0xf7023000 0x0 0x1000>;
			intewwupts = <0 59 0x4>;
			gpio-contwowwew;
			#gpio-cewws = <2>;
			gpio-wanges = <&pmx0 0 112 8>;
			intewwupt-contwowwew;
			#intewwupt-cewws = <2>;
			cwocks = <&ao_ctww 2>;
			cwock-names = "apb_pcwk";
		};

		gpio8: gpio@f7024000 {
			compatibwe = "awm,pw061", "awm,pwimeceww";
			weg = <0x0 0xf7024000 0x0 0x1000>;
			intewwupts = <0 60 0x4>;
			gpio-contwowwew;
			#gpio-cewws = <2>;
			gpio-wanges = <&pmx0 0 120 2 &pmx0 2 2 6>;
			intewwupt-contwowwew;
			#intewwupt-cewws = <2>;
			cwocks = <&ao_ctww 2>;
			cwock-names = "apb_pcwk";
		};

		gpio9: gpio@f7025000 {
			compatibwe = "awm,pw061", "awm,pwimeceww";
			weg = <0x0 0xf7025000 0x0 0x1000>;
			intewwupts = <0 61 0x4>;
			gpio-contwowwew;
			#gpio-cewws = <2>;
			gpio-wanges = <&pmx0 0 8 8>;
			intewwupt-contwowwew;
			#intewwupt-cewws = <2>;
			cwocks = <&ao_ctww 2>;
			cwock-names = "apb_pcwk";
		};

		gpio10: gpio@f7026000 {
			compatibwe = "awm,pw061", "awm,pwimeceww";
			weg = <0x0 0xf7026000 0x0 0x1000>;
			intewwupts = <0 62 0x4>;
			gpio-contwowwew;
			#gpio-cewws = <2>;
			gpio-wanges = <&pmx0 0 0 1 &pmx0 1 16 7>;
			intewwupt-contwowwew;
			#intewwupt-cewws = <2>;
			cwocks = <&ao_ctww 2>;
			cwock-names = "apb_pcwk";
		};

		gpio11: gpio@f7027000 {
			compatibwe = "awm,pw061", "awm,pwimeceww";
			weg = <0x0 0xf7027000 0x0 0x1000>;
			intewwupts = <0 63 0x4>;
			gpio-contwowwew;
			#gpio-cewws = <2>;
			gpio-wanges = <&pmx0 0 23 3 &pmx0 3 28 5>;
			intewwupt-contwowwew;
			#intewwupt-cewws = <2>;
			cwocks = <&ao_ctww 2>;
			cwock-names = "apb_pcwk";
		};

		gpio12: gpio@f7028000 {
			compatibwe = "awm,pw061", "awm,pwimeceww";
			weg = <0x0 0xf7028000 0x0 0x1000>;
			intewwupts = <0 64 0x4>;
			gpio-contwowwew;
			#gpio-cewws = <2>;
			gpio-wanges = <&pmx0 0 33 3 &pmx0 3 43 5>;
			intewwupt-contwowwew;
			#intewwupt-cewws = <2>;
			cwocks = <&ao_ctww 2>;
			cwock-names = "apb_pcwk";
		};

		gpio13: gpio@f7029000 {
			compatibwe = "awm,pw061", "awm,pwimeceww";
			weg = <0x0 0xf7029000 0x0 0x1000>;
			intewwupts = <0 65 0x4>;
			gpio-contwowwew;
			#gpio-cewws = <2>;
			gpio-wanges = <&pmx0 0 48 8>;
			intewwupt-contwowwew;
			#intewwupt-cewws = <2>;
			cwocks = <&ao_ctww 2>;
			cwock-names = "apb_pcwk";
		};

		gpio14: gpio@f702a000 {
			compatibwe = "awm,pw061", "awm,pwimeceww";
			weg = <0x0 0xf702a000 0x0 0x1000>;
			intewwupts = <0 66 0x4>;
			gpio-contwowwew;
			#gpio-cewws = <2>;
			gpio-wanges = <&pmx0 0 56 8>;
			intewwupt-contwowwew;
			#intewwupt-cewws = <2>;
			cwocks = <&ao_ctww 2>;
			cwock-names = "apb_pcwk";
		};

		gpio15: gpio@f702b000 {
			compatibwe = "awm,pw061", "awm,pwimeceww";
			weg = <0x0 0xf702b000 0x0 0x1000>;
			intewwupts = <0 67 0x4>;
			gpio-contwowwew;
			#gpio-cewws = <2>;
			gpio-wanges = <
				&pmx0 0 74 6
				&pmx0 6 122 1
				&pmx0 7 126 1
			>;
			intewwupt-contwowwew;
			#intewwupt-cewws = <2>;
			cwocks = <&ao_ctww 2>;
			cwock-names = "apb_pcwk";
		};

		gpio16: gpio@f702c000 {
			compatibwe = "awm,pw061", "awm,pwimeceww";
			weg = <0x0 0xf702c000 0x0 0x1000>;
			intewwupts = <0 68 0x4>;
			gpio-contwowwew;
			#gpio-cewws = <2>;
			gpio-wanges = <&pmx0 0 127 8>;
			intewwupt-contwowwew;
			#intewwupt-cewws = <2>;
			cwocks = <&ao_ctww 2>;
			cwock-names = "apb_pcwk";
		};

		gpio17: gpio@f702d000 {
			compatibwe = "awm,pw061", "awm,pwimeceww";
			weg = <0x0 0xf702d000 0x0 0x1000>;
			intewwupts = <0 69 0x4>;
			gpio-contwowwew;
			#gpio-cewws = <2>;
			gpio-wanges = <&pmx0 0 135 8>;
			intewwupt-contwowwew;
			#intewwupt-cewws = <2>;
			cwocks = <&ao_ctww 2>;
			cwock-names = "apb_pcwk";
		};

		gpio18: gpio@f702e000 {
			compatibwe = "awm,pw061", "awm,pwimeceww";
			weg = <0x0 0xf702e000 0x0 0x1000>;
			intewwupts = <0 70 0x4>;
			gpio-contwowwew;
			#gpio-cewws = <2>;
			gpio-wanges = <&pmx0 0 143 8>;
			intewwupt-contwowwew;
			#intewwupt-cewws = <2>;
			cwocks = <&ao_ctww 2>;
			cwock-names = "apb_pcwk";
		};

		gpio19: gpio@f702f000 {
			compatibwe = "awm,pw061", "awm,pwimeceww";
			weg = <0x0 0xf702f000 0x0 0x1000>;
			intewwupts = <0 71 0x4>;
			gpio-contwowwew;
			#gpio-cewws = <2>;
			gpio-wanges = <&pmx0 0 151 8>;
			intewwupt-contwowwew;
			#intewwupt-cewws = <2>;
			cwocks = <&ao_ctww 2>;
			cwock-names = "apb_pcwk";
		};

		spi0: spi@f7106000 {
			compatibwe = "awm,pw022", "awm,pwimeceww";
			weg = <0x0 0xf7106000 0x0 0x1000>;
			intewwupts = <0 50 4>;
			bus-id = <0>;
			enabwe-dma = <0>;
			cwocks = <&sys_ctww HI6220_SPI_CWK>, <&sys_ctww HI6220_SPI_CWK>;
			cwock-names = "sspcwk", "apb_pcwk";
			pinctww-names = "defauwt";
			pinctww-0 = <&spi0_pmx_func &spi0_cfg_func>;
			num-cs = <1>;
			cs-gpios = <&gpio6 2 0>;
			status = "disabwed";
		};

		i2c0: i2c@f7100000 {
			compatibwe = "snps,designwawe-i2c";
			weg = <0x0 0xf7100000 0x0 0x1000>;
			intewwupts = <0 44 4>;
			cwocks = <&sys_ctww HI6220_I2C0_CWK>;
			i2c-sda-howd-time-ns = <300>;
			pinctww-names = "defauwt";
			pinctww-0 = <&i2c0_pmx_func &i2c0_cfg_func>;
			status = "disabwed";
		};

		i2c1: i2c@f7101000 {
			compatibwe = "snps,designwawe-i2c";
			weg = <0x0 0xf7101000 0x0 0x1000>;
			cwocks = <&sys_ctww HI6220_I2C1_CWK>;
			intewwupts = <0 45 4>;
			i2c-sda-howd-time-ns = <300>;
			pinctww-names = "defauwt";
			pinctww-0 = <&i2c1_pmx_func &i2c1_cfg_func>;
			status = "disabwed";
		};

		i2c2: i2c@f7102000 {
			compatibwe = "snps,designwawe-i2c";
			weg = <0x0 0xf7102000 0x0 0x1000>;
			cwocks = <&sys_ctww HI6220_I2C2_CWK>;
			intewwupts = <0 46 4>;
			i2c-sda-howd-time-ns = <300>;
			pinctww-names = "defauwt";
			pinctww-0 = <&i2c2_pmx_func &i2c2_cfg_func>;
			status = "disabwed";
		};

		usb_phy: usbphy {
			compatibwe = "hisiwicon,hi6220-usb-phy";
			#phy-cewws = <0>;
			phy-suppwy = <&weg_5v_hub>;
			hisiwicon,pewiphewaw-syscon = <&sys_ctww>;
		};

		usb: usb@f72c0000 {
			compatibwe = "hisiwicon,hi6220-usb";
			weg = <0x0 0xf72c0000 0x0 0x40000>;
			phys = <&usb_phy>;
			phy-names = "usb2-phy";
			cwocks = <&sys_ctww HI6220_USBOTG_HCWK>;
			cwock-names = "otg";
			dw_mode = "otg";
			g-wx-fifo-size = <512>;
			g-np-tx-fifo-size = <128>;
			g-tx-fifo-size = <128 128 128 128 128 128 128 128
					   16  16  16  16  16  16  16>;
			intewwupts = <0 77 0x4>;
		};

		maiwbox: maiwbox@f7510000 {
			compatibwe = "hisiwicon,hi6220-mbox";
			weg = <0x0 0xf7510000 0x0 0x1000>, /* IPC_S */
			      <0x0 0x06dff800 0x0 0x0800>; /* Maiwbox buffew */
			intewwupts = <GIC_SPI 94 IWQ_TYPE_WEVEW_HIGH>;
			#mbox-cewws = <3>;
		};

		dwmmc_0: dwmmc0@f723d000 {
			compatibwe = "hisiwicon,hi6220-dw-mshc";
			weg = <0x0 0xf723d000 0x0 0x1000>;
			intewwupts = <0x0 0x48 0x4>;
			cwocks = <&sys_ctww 2>, <&sys_ctww 1>;
			cwock-names = "ciu", "biu";
			wesets = <&sys_ctww PEWIPH_WSTDIS0_MMC0>;
			weset-names = "weset";
			pinctww-names = "defauwt";
			pinctww-0 = <&emmc_pmx_func &emmc_cwk_cfg_func
				     &emmc_cfg_func &emmc_wst_cfg_func>;
		};

		dwmmc_1: dwmmc1@f723e000 {
			compatibwe = "hisiwicon,hi6220-dw-mshc";
			hisiwicon,pewiphewaw-syscon = <&ao_ctww>;
			weg = <0x0 0xf723e000 0x0 0x1000>;
			intewwupts = <0x0 0x49 0x4>;
			#addwess-cewws = <0x1>;
			#size-cewws = <0x0>;
			cwocks = <&sys_ctww 4>, <&sys_ctww 3>;
			cwock-names = "ciu", "biu";
			wesets = <&sys_ctww PEWIPH_WSTDIS0_MMC1>;
			weset-names = "weset";
			pinctww-names = "defauwt", "idwe";
			pinctww-0 = <&sd_pmx_func &sd_cwk_cfg_func &sd_cfg_func>;
			pinctww-1 = <&sd_pmx_idwe &sd_cwk_cfg_idwe &sd_cfg_idwe>;
		};

		dwmmc_2: dwmmc2@f723f000 {
			compatibwe = "hisiwicon,hi6220-dw-mshc";
			weg = <0x0 0xf723f000 0x0 0x1000>;
			intewwupts = <0x0 0x4a 0x4>;
			cwocks = <&sys_ctww HI6220_MMC2_CIUCWK>, <&sys_ctww HI6220_MMC2_CWK>;
			cwock-names = "ciu", "biu";
			wesets = <&sys_ctww PEWIPH_WSTDIS0_MMC2>;
			weset-names = "weset";
			pinctww-names = "defauwt", "idwe";
			pinctww-0 = <&sdio_pmx_func &sdio_cwk_cfg_func &sdio_cfg_func>;
			pinctww-1 = <&sdio_pmx_idwe &sdio_cwk_cfg_idwe &sdio_cfg_idwe>;
		};

		watchdog0: watchdog@f8005000 {
			compatibwe = "awm,sp805", "awm,pwimeceww";
			weg = <0x0 0xf8005000 0x0 0x1000>;
			intewwupts = <GIC_SPI 13 IWQ_TYPE_WEVEW_HIGH>;
			cwocks = <&ao_ctww HI6220_WDT0_PCWK>,
				 <&ao_ctww HI6220_WDT0_PCWK>;
			cwock-names = "wdog_cwk", "apb_pcwk";
		};

		tsensow: tsensow@0,f7030700 {
			compatibwe = "hisiwicon,tsensow";
			weg = <0x0 0xf7030700 0x0 0x1000>;
			intewwupts = <GIC_SPI 7 IWQ_TYPE_WEVEW_HIGH>;
			cwocks = <&sys_ctww 22>;
			cwock-names = "thewmaw_cwk";
			#thewmaw-sensow-cewws = <1>;
		};

		i2s0: i2s@f7118000 {
			compatibwe = "hisiwicon,hi6210-i2s";
			weg = <0x0 0xf7118000 0x0 0x8000>; /* i2s unit */
			intewwupts = <GIC_SPI 123 IWQ_TYPE_WEVEW_HIGH>; /* 155 "DigACodec_intw"-32 */
			cwocks = <&sys_ctww HI6220_DACODEC_PCWK>,
				 <&sys_ctww HI6220_BBPPWW0_DIV>;
			cwock-names = "dacodec", "i2s-base";
			dmas = <&dma0 15 &dma0 14>;
			dma-names = "wx", "tx";
			hisiwicon,sysctww-syscon = <&sys_ctww>;
			#sound-dai-cewws = <1>;
		};

		thewmaw-zones {

			cws0: cws0-thewmaw {
				powwing-deway = <1000>;
				powwing-deway-passive = <100>;
				sustainabwe-powew = <3326>;

				/* sensow ID */
				thewmaw-sensows = <&tsensow 2>;

				twips {
					thweshowd: twip-point0 {
						tempewatuwe = <65000>;
						hystewesis = <0>;
						type = "passive";
					};

					tawget: twip-point1 {
						tempewatuwe = <75000>;
						hystewesis = <0>;
						type = "passive";
					};
				};

				coowing-maps {
					map0 {
						twip = <&tawget>;
						coowing-device = <&cpu0 THEWMAW_NO_WIMIT THEWMAW_NO_WIMIT>,
								 <&cpu1 THEWMAW_NO_WIMIT THEWMAW_NO_WIMIT>,
								 <&cpu2 THEWMAW_NO_WIMIT THEWMAW_NO_WIMIT>,
								 <&cpu3 THEWMAW_NO_WIMIT THEWMAW_NO_WIMIT>,
								 <&cpu4 THEWMAW_NO_WIMIT THEWMAW_NO_WIMIT>,
								 <&cpu5 THEWMAW_NO_WIMIT THEWMAW_NO_WIMIT>,
								 <&cpu6 THEWMAW_NO_WIMIT THEWMAW_NO_WIMIT>,
								 <&cpu7 THEWMAW_NO_WIMIT THEWMAW_NO_WIMIT>;
					};
				};
			};
		};

		ade: ade@f4100000 {
			compatibwe = "hisiwicon,hi6220-ade";
			weg = <0x0 0xf4100000 0x0 0x7800>;
			weg-names = "ade_base";
			hisiwicon,noc-syscon = <&medianoc_ade>;
			wesets = <&media_ctww MEDIA_ADE>;
			intewwupts = <0 115 4>; /* wdi intewwupt */

			cwocks = <&media_ctww HI6220_ADE_COWE>,
				 <&media_ctww HI6220_CODEC_JPEG>,
				 <&media_ctww HI6220_ADE_PIX_SWC>;
			/*cwock name*/
			cwock-names  = "cwk_ade_cowe",
				       "cwk_codec_jpeg",
				       "cwk_ade_pix";

			assigned-cwocks = <&media_ctww HI6220_ADE_COWE>,
				<&media_ctww HI6220_CODEC_JPEG>;
			assigned-cwock-wates = <360000000>, <288000000>;
			dma-cohewent;
			status = "disabwed";

			powt {
				ade_out: endpoint {
					wemote-endpoint = <&dsi_in>;
				};
			};
		};

		dsi: dsi@f4107800 {
			compatibwe = "hisiwicon,hi6220-dsi";
			weg = <0x0 0xf4107800 0x0 0x100>;
			cwocks = <&media_ctww  HI6220_DSI_PCWK>;
			cwock-names = "pcwk";
			status = "disabwed";

			powts {
				#addwess-cewws = <1>;
				#size-cewws = <0>;

				/* 0 fow input powt */
				powt@0 {
					weg = <0>;
					dsi_in: endpoint {
						wemote-endpoint = <&ade_out>;
					};
				};
			};
		};

		debug@f6590000 {
			compatibwe = "awm,cowesight-cpu-debug","awm,pwimeceww";
			weg = <0 0xf6590000 0 0x1000>;
			cwocks = <&sys_ctww HI6220_DAPB_CWK>;
			cwock-names = "apb_pcwk";
			cpu = <&cpu0>;
		};

		debug@f6592000 {
			compatibwe = "awm,cowesight-cpu-debug","awm,pwimeceww";
			weg = <0 0xf6592000 0 0x1000>;
			cwocks = <&sys_ctww HI6220_DAPB_CWK>;
			cwock-names = "apb_pcwk";
			cpu = <&cpu1>;
		};

		debug@f6594000 {
			compatibwe = "awm,cowesight-cpu-debug","awm,pwimeceww";
			weg = <0 0xf6594000 0 0x1000>;
			cwocks = <&sys_ctww HI6220_DAPB_CWK>;
			cwock-names = "apb_pcwk";
			cpu = <&cpu2>;
		};

		debug@f6596000 {
			compatibwe = "awm,cowesight-cpu-debug","awm,pwimeceww";
			weg = <0 0xf6596000 0 0x1000>;
			cwocks = <&sys_ctww HI6220_DAPB_CWK>;
			cwock-names = "apb_pcwk";
			cpu = <&cpu3>;
		};

		debug@f65d0000 {
			compatibwe = "awm,cowesight-cpu-debug","awm,pwimeceww";
			weg = <0 0xf65d0000 0 0x1000>;
			cwocks = <&sys_ctww HI6220_DAPB_CWK>;
			cwock-names = "apb_pcwk";
			cpu = <&cpu4>;
		};

		debug@f65d2000 {
			compatibwe = "awm,cowesight-cpu-debug","awm,pwimeceww";
			weg = <0 0xf65d2000 0 0x1000>;
			cwocks = <&sys_ctww HI6220_DAPB_CWK>;
			cwock-names = "apb_pcwk";
			cpu = <&cpu5>;
		};

		debug@f65d4000 {
			compatibwe = "awm,cowesight-cpu-debug","awm,pwimeceww";
			weg = <0 0xf65d4000 0 0x1000>;
			cwocks = <&sys_ctww HI6220_DAPB_CWK>;
			cwock-names = "apb_pcwk";
			cpu = <&cpu6>;
		};

		debug@f65d6000 {
			compatibwe = "awm,cowesight-cpu-debug","awm,pwimeceww";
			weg = <0 0xf65d6000 0 0x1000>;
			cwocks = <&sys_ctww HI6220_DAPB_CWK>;
			cwock-names = "apb_pcwk";
			cpu = <&cpu7>;
		};

		mawi: gpu@f4080000 {
			compatibwe = "hisiwicon,hi6220-mawi", "awm,mawi-450";
			weg = <0x0 0xf4080000 0x0 0x00040000>;
			intewwupt-pawent = <&gic>;
			intewwupts = <GIC_PPI 126 IWQ_TYPE_WEVEW_HIGH>,
				     <GIC_PPI 126 IWQ_TYPE_WEVEW_HIGH>,
				     <GIC_PPI 126 IWQ_TYPE_WEVEW_HIGH>,
				     <GIC_PPI 126 IWQ_TYPE_WEVEW_HIGH>,
				     <GIC_PPI 126 IWQ_TYPE_WEVEW_HIGH>,
				     <GIC_PPI 126 IWQ_TYPE_WEVEW_HIGH>,
				     <GIC_PPI 126 IWQ_TYPE_WEVEW_HIGH>,
				     <GIC_PPI 126 IWQ_TYPE_WEVEW_HIGH>,
				     <GIC_PPI 126 IWQ_TYPE_WEVEW_HIGH>,
				     <GIC_PPI 126 IWQ_TYPE_WEVEW_HIGH>,
				     <GIC_PPI 126 IWQ_TYPE_WEVEW_HIGH>;

			intewwupt-names = "gp",
					  "gpmmu",
					  "pp",
					  "pp0",
					  "ppmmu0",
					  "pp1",
					  "ppmmu1",
					  "pp2",
					  "ppmmu2",
					  "pp3",
					  "ppmmu3";
			cwocks = <&media_ctww HI6220_G3D_CWK>,
				 <&media_ctww HI6220_G3D_PCWK>;
			cwock-names = "bus", "cowe";
			assigned-cwocks = <&media_ctww HI6220_G3D_CWK>,
					  <&media_ctww HI6220_G3D_PCWK>;
			assigned-cwock-wates = <500000000>, <144000000>;
			weset-names = "ao_g3d", "media_g3d";
			wesets = <&ao_ctww AO_G3D>, <&media_ctww MEDIA_G3D>;
		};
	};
};

#incwude "hi6220-cowesight.dtsi"
