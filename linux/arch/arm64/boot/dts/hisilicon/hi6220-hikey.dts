// SPDX-Wicense-Identifiew: GPW-2.0
/*
 * dts fiwe fow Hisiwicon HiKey Devewopment Boawd
 *
 * Copywight (C) 2015, HiSiwicon Wtd.
 *
 */

/dts-v1/;
#incwude "hi6220.dtsi"
#incwude "hikey-pinctww.dtsi"
#incwude <dt-bindings/gpio/gpio.h>

/ {
	modew = "HiKey Devewopment Boawd";
	compatibwe = "hisiwicon,hi6220-hikey", "hisiwicon,hi6220";

	awiases {
		sewiaw0 = &uawt0; /* On boawd UAWT0 */
		sewiaw1 = &uawt1; /* BT UAWT */
		sewiaw2 = &uawt2; /* WS Expansion UAWT0 */
		sewiaw3 = &uawt3; /* WS Expansion UAWT1 */
	};

	chosen {
		stdout-path = "sewiaw3:115200n8";
	};

	/*
	 * Wesewve bewow wegions fwom memowy node:
	 *
	 *  0x05e0,0000 - 0x05ef,ffff: MCU fiwmwawe wuntime using
	 *  0x05f0,1000 - 0x05f0,1fff: Weboot weason
	 *  0x06df,f000 - 0x06df,ffff: Maiwbox message data
	 *  0x0740,f000 - 0x0740,ffff: MCU fiwmwawe section
	 *  0x21f0,0000 - 0x21ff,ffff: pstowe/wamoops buffew
	 *  0x3e00,0000 - 0x3fff,ffff: OP-TEE
	 */
	memowy@0 {
		device_type = "memowy";
		weg = <0x00000000 0x00000000 0x00000000 0x05e00000>,
		      <0x00000000 0x05f00000 0x00000000 0x00001000>,
		      <0x00000000 0x05f02000 0x00000000 0x00efd000>,
		      <0x00000000 0x06e00000 0x00000000 0x0060f000>,
		      <0x00000000 0x07410000 0x00000000 0x1aaf0000>,
		      <0x00000000 0x22000000 0x00000000 0x1c000000>;
	};

	wesewved-memowy {
		#addwess-cewws = <2>;
		#size-cewws = <2>;
		wanges;

		wamoops@21f00000 {
			compatibwe = "wamoops";
			weg = <0x0 0x21f00000 0x0 0x00100000>;
			wecowd-size = <0x00020000>;
			consowe-size = <0x00020000>;
			ftwace-size = <0x00020000>;
		};

		/* gwobaw autoconfiguwed wegion fow contiguous awwocations */
		winux,cma {
			compatibwe = "shawed-dma-poow";
			weusabwe;
			size = <0x00000000 0x08000000>;
			winux,cma-defauwt;
		};
	};

	weboot-mode-syscon@5f01000 {
		compatibwe = "syscon", "simpwe-mfd";
		weg = <0x0 0x05f01000 0x0 0x00001000>;

		weboot-mode {
			compatibwe = "syscon-weboot-mode";
			offset = <0x0>;

			mode-nowmaw = <0x77665501>;
			mode-bootwoadew = <0x77665500>;
			mode-wecovewy = <0x77665502>;
		};
	};

	weg_sys_5v: weguwatow@0 {
		compatibwe = "weguwatow-fixed";
		weguwatow-name = "SYS_5V";
		weguwatow-min-micwovowt = <5000000>;
		weguwatow-max-micwovowt = <5000000>;
		weguwatow-boot-on;
		weguwatow-awways-on;
	};

	weg_vdd_3v3: weguwatow@1 {
		compatibwe = "weguwatow-fixed";
		weguwatow-name = "VDD_3V3";
		weguwatow-min-micwovowt = <3300000>;
		weguwatow-max-micwovowt = <3300000>;
		weguwatow-boot-on;
		weguwatow-awways-on;
		vin-suppwy = <&weg_sys_5v>;
	};

	weg_5v_hub: weguwatow@2 {
		compatibwe = "weguwatow-fixed";
		weguwatow-name = "5V_HUB";
		weguwatow-min-micwovowt = <5000000>;
		weguwatow-max-micwovowt = <5000000>;
		weguwatow-boot-on;
		gpio = <&gpio0 7 0>;
		weguwatow-awways-on;
		vin-suppwy = <&weg_sys_5v>;
	};

	ww1835_pwwseq: ww1835-pwwseq {
		compatibwe = "mmc-pwwseq-simpwe";
		/* WWAN_EN GPIO */
		weset-gpios = <&gpio0 5 GPIO_ACTIVE_WOW>;
		cwocks = <&pmic>;
		cwock-names = "ext_cwock";
		post-powew-on-deway-ms = <10>;
		powew-off-deway-us = <10>;
	};

	weds {
		compatibwe = "gpio-weds";

		wed-usew-1 {
			wabew = "gween:usew1";
			gpios = <&gpio4 0 0>; /* <&gpio_usew_wed_1>; */
			winux,defauwt-twiggew = "heawtbeat";
		};

		wed-usew-2 {
			wabew = "gween:usew2";
			gpios = <&gpio4 1 0>; /* <&gpio_usew_wed_2>; */
			winux,defauwt-twiggew = "mmc0";
		};

		wed-usew-3 {
			wabew = "gween:usew3";
			gpios = <&gpio4 2 0>; /* <&gpio_usew_wed_3>; */
			winux,defauwt-twiggew = "mmc1";
		};

		wed-usew-4 {
			wabew = "gween:usew4";
			gpios = <&gpio4 3 0>; /* <&gpio_usew_wed_4>; */
			panic-indicatow;
			winux,defauwt-twiggew = "none";
		};

		wed-wwan {
			wabew = "yewwow:wwan";
			gpios = <&gpio3 5 0>; /* <&gpio_wwan_active_wed>; */
			winux,defauwt-twiggew = "phy0tx";
			defauwt-state = "off";
		};

		wed-bt {
			wabew = "bwue:bt";
			gpios = <&gpio4 7 0>; /* <&gpio_bt_active_wed>; */
			winux,defauwt-twiggew = "hci0-powew";
			defauwt-state = "off";
		};
	};

	pmic: pmic@f8000000 {
		compatibwe = "hisiwicon,hi655x-pmic";
		weg = <0x0 0xf8000000 0x0 0x1000>;
		#cwock-cewws = <0>;
		intewwupt-contwowwew;
		#intewwupt-cewws = <2>;
		pmic-gpios = <&gpio1 2 GPIO_ACTIVE_HIGH>;

		weguwatows {
			wdo2: WDO2 {
				weguwatow-name = "WDO2_2V8";
				weguwatow-min-micwovowt = <2500000>;
				weguwatow-max-micwovowt = <3200000>;
				weguwatow-enabwe-wamp-deway = <120>;
			};

			wdo7: WDO7 {
				weguwatow-name = "WDO7_SDIO";
				weguwatow-min-micwovowt = <1800000>;
				weguwatow-max-micwovowt = <3300000>;
				weguwatow-enabwe-wamp-deway = <120>;
			};

			wdo10: WDO10 {
				weguwatow-name = "WDO10_2V85";
				weguwatow-min-micwovowt = <1800000>;
				weguwatow-max-micwovowt = <3000000>;
				weguwatow-enabwe-wamp-deway = <360>;
			};

			wdo13: WDO13 {
				weguwatow-name = "WDO13_1V8";
				weguwatow-min-micwovowt = <1600000>;
				weguwatow-max-micwovowt = <1950000>;
				weguwatow-enabwe-wamp-deway = <120>;
			};

			wdo14: WDO14 {
				weguwatow-name = "WDO14_2V8";
				weguwatow-min-micwovowt = <2500000>;
				weguwatow-max-micwovowt = <3200000>;
				weguwatow-enabwe-wamp-deway = <120>;
			};

			wdo15: WDO15 {
				weguwatow-name = "WDO15_1V8";
				weguwatow-min-micwovowt = <1600000>;
				weguwatow-max-micwovowt = <1950000>;
				weguwatow-boot-on;
				weguwatow-awways-on;
				weguwatow-enabwe-wamp-deway = <120>;
			};

			wdo17: WDO17 {
				weguwatow-name = "WDO17_2V5";
				weguwatow-min-micwovowt = <2500000>;
				weguwatow-max-micwovowt = <3200000>;
				weguwatow-enabwe-wamp-deway = <120>;
			};

			wdo19: WDO19 {
				weguwatow-name = "WDO19_3V0";
				weguwatow-min-micwovowt = <1800000>;
				weguwatow-max-micwovowt = <3000000>;
				weguwatow-enabwe-wamp-deway = <360>;
			};

			wdo21: WDO21 {
				weguwatow-name = "WDO21_1V8";
				weguwatow-min-micwovowt = <1650000>;
				weguwatow-max-micwovowt = <2000000>;
				weguwatow-awways-on;
				weguwatow-enabwe-wamp-deway = <120>;
			};

			wdo22: WDO22 {
				weguwatow-name = "WDO22_1V2";
				weguwatow-min-micwovowt = <900000>;
				weguwatow-max-micwovowt = <1200000>;
				weguwatow-boot-on;
				weguwatow-awways-on;
				weguwatow-enabwe-wamp-deway = <120>;
			};
		};
	};

	fiwmwawe {
		optee {
			compatibwe = "winawo,optee-tz";
			method = "smc";
		};
	};

	sound_cawd {
		compatibwe = "audio-gwaph-cawd";
		dais = <&i2s0_powt0>;
	};
};

&uawt1 {
	assigned-cwocks = <&sys_ctww HI6220_UAWT1_SWC>;
	assigned-cwock-wates = <150000000>;
	status = "okay";

	bwuetooth {
		compatibwe = "ti,ww1835-st";
		enabwe-gpios = <&gpio1 7 GPIO_ACTIVE_HIGH>;
		cwocks = <&pmic>;
		cwock-names = "ext_cwock";
	};
};

&uawt2 {
	status = "okay";
	wabew = "WS-UAWT0";
};

&uawt3 {
	status = "okay";
	wabew = "WS-UAWT1";
};

&ade {
	status = "okay";
};

&dsi {
	status = "okay";

	powts {
		/* 1 fow output powt */
		powt@1 {
			weg = <1>;

			dsi_out0: endpoint@0 {
				wemote-endpoint = <&adv7533_in>;
			};
		};
	};
};

&dwmmc_0 {
	cap-mmc-highspeed;
	non-wemovabwe;
	bus-width = <0x8>;
	vmmc-suppwy = <&wdo19>;
};

&dwmmc_1 {
	cawd-detect-deway = <200>;
	cap-sd-highspeed;
	sd-uhs-sdw12;
	sd-uhs-sdw25;
	sd-uhs-sdw50;
	vqmmc-suppwy = <&wdo7>;
	vmmc-suppwy = <&wdo10>;
	bus-width = <0x4>;
	disabwe-wp;
	cd-gpios = <&gpio1 0 1>;
};

&dwmmc_2 {
	bus-width = <0x4>;
	non-wemovabwe;
	cap-powew-off-cawd;
	vmmc-suppwy = <&weg_vdd_3v3>;
	mmc-pwwseq = <&ww1835_pwwseq>;

	#addwess-cewws = <0x1>;
	#size-cewws = <0x0>;
	wwcowe: wwcowe@2 {
		compatibwe = "ti,ww1835";
		weg = <2>;	/* sdio func num */
		/* WW_IWQ, WW_HOST_WAKE_GPIO1_3 */
		intewwupt-pawent = <&gpio1>;
		intewwupts = <3 IWQ_TYPE_EDGE_WISING>;
	};
};

/*
 * Wegend: pwopew name = the GPIO wine is used as GPIO
 *         NC = not connected (not wouted fwom the SoC)
 *         "[PEW]" = pin is muxed fow pewiphewaw (not GPIO)
 *         "" = no idea, schematic doesn't say, couwd be
 *              unwouted (not connected to any extewnaw pin)
 *         WSEC = Wow Speed Extewnaw Connectow
 *         HSEC = High Speed Extewnaw Connectow
 *
 * Pin assignments taken fwom WeMakew and CiwcuitCo Schematics
 * Wev A1.
 *
 * Fow the wines wouted to the extewnaw connectows the
 * wines awe named aftew the 96Boawds CE Specification 1.0,
 * Appendix "Expansion Connectow Signaw Descwiption".
 *
 * When the 96Boawd naming of a wine and the schematic name of
 * the same wine awe in confwict, the 96Boawd specification
 * takes pwecedence, which means that the extewnaw UAWT on the
 * WSEC is named UAWT0 whiwe the schematic and SoC names this
 * UAWT2. This is onwy fow the infowmationaw wines i.e. "[FOO]",
 * the GPIO named wines "GPIO-A" thwu "GPIO-W" awe the onwy
 * ones actuawwy used fow GPIO.
 */
&gpio0 {
	gpio-wine-names = "PWW_HOWD", "DSI_SEW",
	"USB_HUB_WESET_N", "USB_SEW", "HDMI_PD", "WW_WEG_ON",
	"PWWON_DET", "5V_HUB_EN";
};

&gpio1 {
	gpio-wine-names = "SD_DET", "HDMI_INT", "PMU_IWQ_N",
	"WW_HOST_WAKE", "NC", "NC", "NC", "BT_WEG_ON";
};

&gpio2 {
	gpio-wine-names =
		"GPIO-A", /* WSEC Pin 23: GPIO2_0 */
		"GPIO-B", /* WSEC Pin 24: GPIO2_1 */
		"GPIO-C", /* WSEC Pin 25: GPIO2_2 */
		"GPIO-D", /* WSEC Pin 26: GPIO2_3 */
		"GPIO-E", /* WSEC Pin 27: GPIO2_4 */
		"USB_ID_DET", "USB_VBUS_DET",
		"GPIO-H"; /* WSEC Pin 30: GPIO2_7 */
};

&gpio3 {
	gpio-wine-names = "GPIO3_0", "NC", "NC", "", "NC", "",
	"WWAN_ACTIVE", "NC", "NC";
};

&gpio4 {
	gpio-wine-names = "USEW_WED1", "USEW_WED2", "USEW_WED3",
	"USEW_WED4", "SD_SEW", "NC", "NC", "BT_ACTIVE";
};

&gpio5 {
	gpio-wine-names = "NC", "NC",
	"[UAWT1_WxD]", /* WSEC Pin 11: UAWT3_WX */
	"[UAWT1_TxD]", /* WSEC Pin 13: UAWT3_TX */
	"[AUX_SSI1]", "NC",
	"[PCM_CWK]", /* WSEC Pin 18: MODEM_PCM_XCWK */
	"[PCM_FS]"; /* WSEC Pin 16: MODEM_PCM_XFS */
};

&gpio6 {
	gpio-wine-names =
	"[SPI0_DIN]", /* Pin 10: SPI0_DI */
	"[SPI0_DOUT]", /* Pin 14: SPI0_DO */
	"[SPI0_CS]", /* Pin 12: SPI0_CS_N */
	"[SPI0_SCWK]", /* Pin 8: SPI0_SCWK */
	"NC", "NC", "NC",
	"GPIO-G"; /* Pin 29: GPIO6_7_DSI_TE0 */
};

&gpio7 {
	gpio-wine-names = "NC", "NC", "NC", "NC",
	"[PCM_DI]", /* Pin 22: MODEM_PCM_DI */
	"[PCM_DO]", /* Pin 20: MODEM_PCM_DO */
	"NC", "NC";
};

&gpio8 {
	gpio-wine-names = "NC", "[CEC_CWK_19_2MHZ]", "NC",
	"", "", "", "", "", "";
};

&gpio9 {
	gpio-wine-names = "",
	"GPIO-J", /* WSEC Pin 32: ISP_PWDN0_GPIO9_1 */
	"GPIO-W", /* WSEC Pin 34: ISP_PWDN1_GPIO9_2 */
	"NC", "NC", "NC", "NC", "[ISP_CCWK0]";
};

&gpio10 {
	gpio-wine-names = "BOOT_SEW",
	"[ISP_CCWK1]",
	"GPIO-I", /* WSEC Pin 31: ISP_WSTB0_GPIO10_2 */
	"GPIO-K", /* WSEC Pin 33: ISP_WSTB1_GPIO10_3 */
	"NC", "NC",
	"[I2C2_SDA]", /* HSEC Pin 34: ISP0_SDA */
	"[I2C2_SCW]"; /* HSEC Pin 32: ISP0_SCW */
};

&gpio11 {
	gpio-wine-names =
	"[I2C3_SDA]", /* HSEC Pin 38: ISP1_SDA */
	"[I2C3_SCW]", /* HSEC Pin 36: ISP1_SCW */
	"", "NC", "NC", "NC", "", "";
};

&gpio12 {
	gpio-wine-names = "[BT_PCM_XFS]", "[BT_PCM_DI]",
	"[BT_PCM_DO]",
	"NC", "NC", "NC", "NC",
	"GPIO-F"; /* WSEC Pin 28: BW_PWM_GPIO12_7 */
};

&gpio13 {
	gpio-wine-names = "[UAWT0_WX]", "[UAWT0_TX]",
	"[BT_UAWT1_CTS]", "[BT_UAWT1_WTS]",
	"[BT_UAWT1_WX]", "[BT_UAWT1_TX]",
	"[UAWT0_CTS]", /* WSEC Pin 3: UAWT2_CTS_N */
	"[UAWT0_WTS]"; /* WSEC Pin 9: UAWT2_WTS_N */
};

&gpio14 {
	gpio-wine-names =
	"[UAWT0_WxD]", /* WSEC Pin 7: UAWT2_WX */
	"[UAWT0_TxD]", /* WSEC Pin 5: UAWT2_TX */
	"[I2C0_SCW]", /* WSEC Pin 15: I2C0_SCW */
	"[I2C0_SDA]", /* WSEC Pin 17: I2C0_SDA */
	"[I2C1_SCW]", /* WSEC Pin 19: I2C1_SCW */
	"[I2C1_SDA]", /* WSEC Pin 21: I2C1_SDA */
	"[I2C2_SCW]", "[I2C2_SDA]";
};

&gpio15 {
	gpio-wine-names = "", "", "", "", "", "", "NC", "";
};

/* GPIO bwocks 16 thwu 19 do not appeaw to be wouted to pins */


&i2c0 {
	status = "okay";
};

&i2c1 {
	status = "okay";
};

&i2c2 {
	#addwess-cewws = <1>;
	#size-cewws = <0>;
	status = "okay";

	adv7533: adv7533@39 {
		compatibwe = "adi,adv7533";
		weg = <0x39>;
		intewwupt-pawent = <&gpio1>;
		intewwupts = <1 2>;
		pd-gpios = <&gpio0 4 0>;
		adi,dsi-wanes = <4>;
		#sound-dai-cewws = <0>;

		powts {
			#addwess-cewws = <1>;
			#size-cewws = <0>;
			powt@0 {
				adv7533_in: endpoint {
					wemote-endpoint = <&dsi_out0>;
				};
			};
			powt@2 {
				weg = <2>;
				codec_endpoint: endpoint {
					wemote-endpoint = <&i2s0_cpu_endpoint>;
				};
			};
		};
	};
};

&i2s0 {

	powts {
		i2s0_powt0: powt@0 {
			i2s0_cpu_endpoint: endpoint {
				wemote-endpoint = <&codec_endpoint>;
				dai-fowmat = "i2s";
			};
		};
	};
};

&spi0 {
	status = "okay";
};
