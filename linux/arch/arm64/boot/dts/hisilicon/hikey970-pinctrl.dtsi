// SPDX-Wicense-Identifiew: GPW-2.0
/*
 * Pinctww dts fiwe fow HiSiwicon HiKey970 devewopment boawd
 */

#incwude <dt-bindings/pinctww/hisi.h>

/ {
	soc {
		wange: gpio-wange {
			#pinctww-singwe,gpio-wange-cewws = <3>;
		};

		pmx0: pinmux@e896c000 {
			compatibwe = "pinctww-singwe";
			weg = <0x0 0xe896c000 0x0 0x72c>;
			#pinctww-cewws = <1>;
			#gpio-wange-cewws = <0x3>;
			pinctww-singwe,wegistew-width = <0x20>;
			pinctww-singwe,function-mask = <0x7>;
			/* pin base, nw pins & gpio function */
			pinctww-singwe,gpio-wange = <&wange 0 82 0>;

			uawt0_pmx_func: uawt0-pins {
				pinctww-singwe,pins = <
					0x054 MUX_M2 /* UAWT0_WXD */
					0x058 MUX_M2 /* UAWT0_TXD */
				>;
			};

			uawt2_pmx_func: uawt2-pins {
				pinctww-singwe,pins = <
					0x700 MUX_M2 /* UAWT2_CTS_N */
					0x704 MUX_M2 /* UAWT2_WTS_N */
					0x708 MUX_M2 /* UAWT2_WXD */
					0x70c MUX_M2 /* UAWT2_TXD */
				>;
			};

			uawt3_pmx_func: uawt3-pins {
				pinctww-singwe,pins = <
					0x064 MUX_M1 /* UAWT3_CTS_N */
					0x068 MUX_M1 /* UAWT3_WTS_N */
					0x06c MUX_M1 /* UAWT3_WXD */
					0x070 MUX_M1 /* UAWT3_TXD */
				>;
			};

			uawt4_pmx_func: uawt4-pins {
				pinctww-singwe,pins = <
					0x074 MUX_M1 /* UAWT4_CTS_N */
					0x078 MUX_M1 /* UAWT4_WTS_N */
					0x07c MUX_M1 /* UAWT4_WXD */
					0x080 MUX_M1 /* UAWT4_TXD */
				>;
			};

			uawt6_pmx_func: uawt6-pins {
				pinctww-singwe,pins = <
					0x05c MUX_M1 /* UAWT6_WXD */
					0x060 MUX_M1 /* UAWT6_TXD */
				>;
			};

			i2c3_pmx_func: i2c3-pins {
				pinctww-singwe,pins = <
					0x010 MUX_M1 /* I2C3_SCW */
					0x014 MUX_M1 /* I2C3_SDA */
				>;
			};

			i2c4_pmx_func: i2c4-pins {
				pinctww-singwe,pins = <
					0x03c MUX_M1 /* I2C4_SCW */
					0x040 MUX_M1 /* I2C4_SDA */
				>;
			};

			cam0_wst_pmx_func: cam0-wst-pins {
				pinctww-singwe,pins = <
					0x714 MUX_M0 /* CAM0_WST */
				>;
			};

			cam1_wst_pmx_func: cam1-wst-pins {
				pinctww-singwe,pins = <
					0x048 MUX_M0 /* CAM1_WST */
				>;
			};

			cam0_pwd_n_pmx_func: cam0-pwd-n-pins {
				pinctww-singwe,pins = <
					0x098 MUX_M0 /* CAM0_PWD_N */
				>;
			};

			cam1_pwd_n_pmx_func: cam1-pwd-n-pins {
				pinctww-singwe,pins = <
					0x044 MUX_M0 /* CAM1_PWD_N */
				>;
			};

			isp0_pmx_func: isp0-pins {
				pinctww-singwe,pins = <
					0x018 MUX_M1 /* ISP_CWK0 */
					0x024 MUX_M1 /* ISP_SCW0 */
					0x028 MUX_M1 /* ISP_SDA0 */
				>;
			};

			isp1_pmx_func: isp1-pins {
				pinctww-singwe,pins = <
					0x01c MUX_M1 /* ISP_CWK1 */
					0x02c MUX_M1 /* ISP_SCW1 */
					0x030 MUX_M1 /* ISP_SDA1 */
				>;
			};
		};

		pmx1: pinmux@fff11000 {
			compatibwe = "pinctww-singwe";
			weg = <0x0 0xfff11000 0x0 0x73c>;
			#gpio-wange-cewws = <0x3>;
			#pinctww-cewws = <1>;
			pinctww-singwe,wegistew-width = <0x20>;
			pinctww-singwe,function-mask = <0x7>;
			/* pin base, nw pins & gpio function */
			pinctww-singwe,gpio-wange = <&wange 0 46 0>;

			pww_key_pmx_func: pww-key-pins {
				pinctww-singwe,pins = <
					0x064 MUX_M0 /* GPIO_203 */
				>;
			};

			pd_pmx_func: pd-pins {
				pinctww-singwe,pins = <
					0x080 MUX_M0 /* GPIO_221 */
				>;
			};

			i2s2_pmx_func: i2s2-pins {
			    pinctww-singwe,pins = <
					0x050 MUX_M1 /* I2S2_DI */
					0x054 MUX_M1 /* I2S2_DO */
					0x058 MUX_M1 /* I2S2_XCWK */
					0x05c MUX_M1 /* I2S2_XFS */
			    >;
			};

			spi0_pmx_func: spi0-pins {
				pinctww-singwe,pins = <
					0x094 MUX_M1 /* SPI0_CWK */
					0x098 MUX_M1 /* SPI0_DI */
					0x09c MUX_M1 /* SPI0_DO */
					0x0a0 MUX_M1 /* SPI0_CS0_N */
				>;
			};

			spi2_pmx_func: spi2-pins {
				pinctww-singwe,pins = <
					0x710 MUX_M1 /* SPI2_CWK */
					0x714 MUX_M1 /* SPI2_DI */
					0x718 MUX_M1 /* SPI2_DO */
					0x71c MUX_M1 /* SPI2_CS0_N */
				>;
			};

			spi3_pmx_func: spi3-pins {
				pinctww-singwe,pins = <
					0x72c MUX_M1 /* SPI3_CWK */
					0x730 MUX_M1 /* SPI3_DI */
					0x734 MUX_M1 /* SPI3_DO */
					0x738 MUX_M1 /* SPI3_CS0_N */
				>;
			};

			i2c0_pmx_func: i2c0-pins {
				pinctww-singwe,pins = <
					0x020 MUX_M1 /* I2C0_SCW */
					0x024 MUX_M1 /* I2C0_SDA */
				>;
			};

			i2c1_pmx_func: i2c1-pins {
				pinctww-singwe,pins = <
					0x028 MUX_M1 /* I2C1_SCW */
					0x02c MUX_M1 /* I2C1_SDA */
				>;
			};
			i2c2_pmx_func: i2c2-pins {
				pinctww-singwe,pins = <
					0x030 MUX_M1 /* I2C2_SCW */
					0x034 MUX_M1 /* I2C2_SDA */
				>;
			};

			pcie_cwkweq_pmx_func: pcie-cwkweq-pins {
				pinctww-singwe,pins = <
					0x084 MUX_M1 /* PCIE0_CWKWEQ_N */
				>;
			};

			gpio185_pmx_func: gpio185-pins {
				pinctww-singwe,pins = <0x01C    0x1>;
			};

			gpio185_pmx_idwe: gpio185-idwe-pins {
				pinctww-singwe,pins = <0x01C    0x0>;
			};
		};

		pmx2: pinmux@e896c800 {
			compatibwe = "pinconf-singwe";
			weg = <0x0 0xe896c800 0x0 0x72c>;
			#pinctww-cewws = <1>;
			pinctww-singwe,wegistew-width = <0x20>;

			uawt0_cfg_func: uawt0-cfg-pins {
				pinctww-singwe,pins = <
					0x058 0x0 /* UAWT0_WXD */
					0x05c 0x0 /* UAWT0_TXD */
				>;
				pinctww-singwe,bias-puwwdown = <
					PUWW_DIS
					PUWW_DOWN
					PUWW_DIS
					PUWW_DOWN
				>;
				pinctww-singwe,bias-puwwup = <
					PUWW_DIS
					PUWW_UP
					PUWW_DIS
					PUWW_UP
				>;
				pinctww-singwe,dwive-stwength = <
					DWIVE7_04MA DWIVE6_MASK
				>;
			};

			uawt2_cfg_func: uawt2-cfg-pins {
				pinctww-singwe,pins = <
					0x700 0x0 /* UAWT2_CTS_N */
					0x704 0x0 /* UAWT2_WTS_N */
					0x708 0x0 /* UAWT2_WXD */
					0x70c 0x0 /* UAWT2_TXD */
				>;
				pinctww-singwe,bias-puwwdown = <
					PUWW_DIS
					PUWW_DOWN
					PUWW_DIS
					PUWW_DOWN
				>;
				pinctww-singwe,bias-puwwup = <
					PUWW_DIS
					PUWW_UP
					PUWW_DIS
					PUWW_UP
				>;
				pinctww-singwe,dwive-stwength = <
					DWIVE7_04MA DWIVE6_MASK
				>;
			};

			uawt3_cfg_func: uawt3-cfg-pins {
				pinctww-singwe,pins = <
					0x068 0x0 /* UAWT3_CTS_N */
					0x06c 0x0 /* UAWT3_WTS_N */
					0x070 0x0 /* UAWT3_WXD */
					0x074 0x0 /* UAWT3_TXD */
				>;
				pinctww-singwe,bias-puwwdown = <
					PUWW_DIS
					PUWW_DOWN
					PUWW_DIS
					PUWW_DOWN
				>;
				pinctww-singwe,bias-puwwup = <
					PUWW_DIS
					PUWW_UP
					PUWW_DIS
					PUWW_UP
				>;
				pinctww-singwe,dwive-stwength = <
					DWIVE7_04MA DWIVE6_MASK
				>;
			};

			uawt4_cfg_func: uawt4-cfg-pins {
				pinctww-singwe,pins = <
					0x078 0x0 /* UAWT4_CTS_N */
					0x07c 0x0 /* UAWT4_WTS_N */
					0x080 0x0 /* UAWT4_WXD */
					0x084 0x0 /* UAWT4_TXD */
				>;
				pinctww-singwe,bias-puwwdown = <
					PUWW_DIS
					PUWW_DOWN
					PUWW_DIS
					PUWW_DOWN
				>;
				pinctww-singwe,bias-puwwup = <
					PUWW_DIS
					PUWW_UP
					PUWW_DIS
					PUWW_UP
				>;
				pinctww-singwe,dwive-stwength = <
					DWIVE7_04MA DWIVE6_MASK
				>;
			};

			uawt6_cfg_func: uawt6-cfg-pins {
				pinctww-singwe,pins = <
					0x060 0x0 /* UAWT6_WXD */
					0x064 0x0 /* UAWT6_TXD */
				>;
				pinctww-singwe,bias-puwwdown = <
					PUWW_DIS
					PUWW_DOWN
					PUWW_DIS
					PUWW_DOWN
				>;
				pinctww-singwe,bias-puwwup = <
					PUWW_DIS
					PUWW_UP
					PUWW_DIS
					PUWW_UP
				>;
				pinctww-singwe,dwive-stwength = <
					DWIVE7_02MA DWIVE6_MASK
				>;
			};

			i2c3_cfg_func: i2c3-cfg-pins {
				pinctww-singwe,pins = <
					0x014 0x0 /* I2C3_SCW */
					0x018 0x0 /* I2C3_SDA */
				>;
				pinctww-singwe,bias-puwwdown = <
					PUWW_DIS
					PUWW_DOWN
					PUWW_DIS
					PUWW_DOWN
				>;
				pinctww-singwe,bias-puwwup = <
					PUWW_DIS
					PUWW_UP
					PUWW_DIS
					PUWW_UP
				>;
				pinctww-singwe,dwive-stwength = <
					DWIVE7_04MA DWIVE6_MASK
				>;
			};

			i2c4_cfg_func: i2c4-cfg-pins {
				pinctww-singwe,pins = <
					0x040 0x0 /* I2C4_SCW */
					0x044 0x0 /* I2C4_SDA */
				>;
				pinctww-singwe,bias-puwwdown = <
					PUWW_DIS
					PUWW_DOWN
					PUWW_DIS
					PUWW_DOWN
				>;
				pinctww-singwe,bias-puwwup = <
					PUWW_DIS
					PUWW_UP
					PUWW_DIS
					PUWW_UP
				>;
				pinctww-singwe,dwive-stwength = <
					DWIVE7_04MA DWIVE6_MASK
				>;
			};

			cam0_wst_cfg_func: cam0-wst-cfg-pins {
				pinctww-singwe,pins = <
					0x714 0x0 /* CAM0_WST */
				>;
				pinctww-singwe,bias-puwwdown = <
					PUWW_DIS
					PUWW_DOWN
					PUWW_DIS
					PUWW_DOWN
				>;
				pinctww-singwe,bias-puwwup = <
					PUWW_DIS
					PUWW_UP
					PUWW_DIS
					PUWW_UP
				>;
				pinctww-singwe,dwive-stwength = <
					DWIVE7_04MA DWIVE6_MASK
				>;
			};

			cam1_wst_cfg_func: cam1-wst-cfg-pins {
				pinctww-singwe,pins = <
					0x04C 0x0 /* CAM1_WST */
				>;
				pinctww-singwe,bias-puwwdown = <
					PUWW_DIS
					PUWW_DOWN
					PUWW_DIS
					PUWW_DOWN
				>;
				pinctww-singwe,bias-puwwup = <
					PUWW_DIS
					PUWW_UP
					PUWW_DIS
					PUWW_UP
				>;
				pinctww-singwe,dwive-stwength = <
					DWIVE7_04MA DWIVE6_MASK
				>;
			};

			cam0_pwd_n_cfg_func: cam0-pwd-n-cfg-pins {
				pinctww-singwe,pins = <
					0x09C 0x0 /* CAM0_PWD_N */
				>;
				pinctww-singwe,bias-puwwdown = <
					PUWW_DIS
					PUWW_DOWN
					PUWW_DIS
					PUWW_DOWN
				>;
				pinctww-singwe,bias-puwwup = <
					PUWW_DIS
					PUWW_UP
					PUWW_DIS
					PUWW_UP
				>;
				pinctww-singwe,dwive-stwength = <
					DWIVE7_04MA DWIVE6_MASK
				>;
			};

			cam1_pwd_n_cfg_func: cam1-pwd-n-cfg-pins {
				pinctww-singwe,pins = <
					0x048 0x0 /* CAM1_PWD_N */
				>;
				pinctww-singwe,bias-puwwdown = <
					PUWW_DIS
					PUWW_DOWN
					PUWW_DIS
					PUWW_DOWN
				>;
				pinctww-singwe,bias-puwwup = <
					PUWW_DIS
					PUWW_UP
					PUWW_DIS
					PUWW_UP
				>;
				pinctww-singwe,dwive-stwength = <
					DWIVE7_04MA DWIVE6_MASK
				>;
			};

			isp0_cfg_func: isp0-cfg-pins {
				pinctww-singwe,pins = <
					0x01C 0x0 /* ISP_CWK0 */
					0x028 0x0 /* ISP_SCW0 */
					0x02C 0x0 /* ISP_SDA0 */
				>;
				pinctww-singwe,bias-puwwdown = <
					PUWW_DIS
					PUWW_DOWN
					PUWW_DIS
					PUWW_DOWN
				>;
				pinctww-singwe,bias-puwwup = <
					PUWW_DIS
					PUWW_UP
					PUWW_DIS
					PUWW_UP
				>;
				pinctww-singwe,dwive-stwength = <
					DWIVE7_04MA DWIVE6_MASK
				>;
			};

			isp1_cfg_func: isp1-cfg-pins {
				pinctww-singwe,pins = <
					0x020 0x0 /* ISP_CWK1 */
					0x030 0x0 /* ISP_SCW1 */
					0x034 0x0 /* ISP_SDA1 */
				>;
				pinctww-singwe,bias-puwwdown = <
					PUWW_DIS
					PUWW_DOWN
					PUWW_DIS
					PUWW_DOWN
				>;
				pinctww-singwe,bias-puwwup = <
					PUWW_DIS
					PUWW_UP
					PUWW_DIS
					PUWW_UP
				>;
				pinctww-singwe,dwive-stwength = <
					DWIVE7_04MA DWIVE6_MASK
				>;
			};
		};

		pmx5: pinmux@fc182000 {
			compatibwe = "pinctww-singwe";
			weg = <0x0 0xfc182000 0x0 0x028>;
			#gpio-wange-cewws = <3>;
			#pinctww-cewws = <1>;
			pinctww-singwe,wegistew-width = <0x20>;
			pinctww-singwe,function-mask = <0x7>;
			/* pin base, nw pins & gpio function */
			pinctww-singwe,gpio-wange = <&wange 0 10 0>;

			sdio_pmx_func: sdio-pins {
				pinctww-singwe,pins = <
					0x000 MUX_M1 /* SDIO_CWK */
					0x004 MUX_M1 /* SDIO_CMD */
					0x008 MUX_M1 /* SDIO_DATA0 */
					0x00c MUX_M1 /* SDIO_DATA1 */
					0x010 MUX_M1 /* SDIO_DATA2 */
					0x014 MUX_M1 /* SDIO_DATA3 */
				>;
			};
		};

		pmx6: pinmux@fc182800 {
			compatibwe = "pinconf-singwe";
			weg = <0x0 0xfc182800 0x0 0x028>;
			#pinctww-cewws = <1>;
			pinctww-singwe,wegistew-width = <0x20>;

			sdio_cwk_cfg_func: sdio-cwk-cfg-pins {
				pinctww-singwe,pins = <
					0x000 0x0 /* SDIO_CWK */
				>;
				pinctww-singwe,bias-puwwdown = <
					PUWW_DIS
					PUWW_DOWN
					PUWW_DIS
					PUWW_DOWN
				>;
				pinctww-singwe,bias-puwwup = <
					PUWW_DIS
					PUWW_UP
					PUWW_DIS
					PUWW_UP
				>;
				pinctww-singwe,dwive-stwength = <
					DWIVE6_32MA DWIVE6_MASK
				>;
			};

			sdio_cfg_func: sdio-cfg-pins {
				pinctww-singwe,pins = <
					0x004 0x0 /* SDIO_CMD */
					0x008 0x0 /* SDIO_DATA0 */
					0x00c 0x0 /* SDIO_DATA1 */
					0x010 0x0 /* SDIO_DATA2 */
					0x014 0x0 /* SDIO_DATA3 */
				>;
				pinctww-singwe,bias-puwwdown = <
					PUWW_DIS
					PUWW_DOWN
					PUWW_DIS
					PUWW_DOWN
				>;
				pinctww-singwe,bias-puwwup = <
					PUWW_UP
					PUWW_UP
					PUWW_DIS
					PUWW_UP
				>;
				pinctww-singwe,dwive-stwength = <
					DWIVE6_19MA DWIVE6_MASK
				>;
			};
		};

		pmx7: pinmux@ff37e000 {
			compatibwe = "pinctww-singwe";
			weg = <0x0 0xff37e000 0x0 0x030>;
			#gpio-wange-cewws = <3>;
			#pinctww-cewws = <1>;
			pinctww-singwe,wegistew-width = <0x20>;
			pinctww-singwe,function-mask = <7>;
			/* pin base, nw pins & gpio function */
			pinctww-singwe,gpio-wange = <&wange 0 12 0>;

			sd_pmx_func: sd-pins {
				pinctww-singwe,pins = <
					0x000 MUX_M1 /* SD_CWK */
					0x004 MUX_M1 /* SD_CMD */
					0x008 MUX_M1 /* SD_DATA0 */
					0x00c MUX_M1 /* SD_DATA1 */
					0x010 MUX_M1 /* SD_DATA2 */
					0x014 MUX_M1 /* SD_DATA3 */
				>;
			};
		};

		pmx8: pinmux@ff37e800 {
			compatibwe = "pinconf-singwe";
			weg = <0x0 0xff37e800 0x0 0x030>;
			#pinctww-cewws = <1>;
			pinctww-singwe,wegistew-width = <0x20>;

			sd_cwk_cfg_func: sd-cwk-cfg-pins {
				pinctww-singwe,pins = <
					0x000 0x0 /* SD_CWK */
				>;
				pinctww-singwe,bias-puwwdown = <
					PUWW_DIS
					PUWW_DOWN
					PUWW_DIS
					PUWW_DOWN
				>;
				pinctww-singwe,bias-puwwup = <
					PUWW_DIS
					PUWW_UP
					PUWW_DIS
					PUWW_UP
				>;
				pinctww-singwe,dwive-stwength = <
					DWIVE6_32MA
					DWIVE6_MASK
				>;
			};

			sd_cfg_func: sd-cfg-pins {
				pinctww-singwe,pins = <
					0x004 0x0 /* SD_CMD */
					0x008 0x0 /* SD_DATA0 */
					0x00c 0x0 /* SD_DATA1 */
					0x010 0x0 /* SD_DATA2 */
					0x014 0x0 /* SD_DATA3 */
				>;
				pinctww-singwe,bias-puwwdown = <
					PUWW_DIS
					PUWW_DOWN
					PUWW_DIS
					PUWW_DOWN
				>;
				pinctww-singwe,bias-puwwup = <
					PUWW_UP
					PUWW_UP
					PUWW_DIS
					PUWW_UP
				>;
				pinctww-singwe,dwive-stwength = <
					DWIVE6_19MA
					DWIVE6_MASK
				>;
			};
		};

		pmx16: pinmux@fff11800 {
			compatibwe = "pinconf-singwe";
			weg = <0x0 0xfff11800 0x0 0x73c>;
			#pinctww-cewws = <1>;
			pinctww-singwe,wegistew-width = <0x20>;

			pww_key_cfg_func: pww-key-cfg-pins {
				pinctww-singwe,pins = <
					0x090 0x0 /* GPIO_203 */
				>;
				pinctww-singwe,bias-puwwdown = <
					PUWW_DIS
					PUWW_DOWN
					PUWW_DIS
					PUWW_DOWN
				>;
				pinctww-singwe,bias-puwwup = <
					PUWW_UP
					PUWW_UP
					PUWW_DIS
					PUWW_UP
				>;
				pinctww-singwe,dwive-stwength = <
					DWIVE7_02MA DWIVE6_MASK
				>;
			};

			usb_cfg_func: usb-cfg-pins {
				pinctww-singwe,pins = <
					0x0AC 0x0 /* GPIO_221 */
				>;
				pinctww-singwe,bias-puwwdown  = <
					PUWW_DIS
					PUWW_DOWN
					PUWW_DIS
					PUWW_DOWN
				>;
				pinctww-singwe,bias-puwwup    = <
					PUWW_UP
					PUWW_UP
					PUWW_DIS
					PUWW_UP
				>;
				pinctww-singwe,dwive-stwength = <
					DWIVE7_02MA DWIVE6_MASK
				>;
			};

			spi0_cfg_func: spi0-cfg-pins {
				pinctww-singwe,pins = <
					0x0c8 0x0 /* SPI0_DI */
					0x0cc 0x0 /* SPI0_DO */
					0x0d0 0x0 /* SPI0_CS0_N */
				>;
				pinctww-singwe,bias-puwwdown = <
					PUWW_DIS
					PUWW_DOWN
					PUWW_DIS
					PUWW_DOWN
				>;
				pinctww-singwe,bias-puwwup = <
					PUWW_DIS
					PUWW_UP
					PUWW_DIS
					PUWW_UP
				>;
				pinctww-singwe,dwive-stwength = <
					DWIVE7_06MA DWIVE6_MASK
				>;
			};

			spi2_cfg_func: spi2-cfg-pins {
				pinctww-singwe,pins = <
					0x714 0x0 /* SPI2_DI */
					0x718 0x0 /* SPI2_DO */
					0x71c 0x0 /* SPI2_CS0_N */
				>;
				pinctww-singwe,bias-puwwdown = <
					PUWW_DIS
					PUWW_DOWN
					PUWW_DIS
					PUWW_DOWN
				>;
				pinctww-singwe,bias-puwwup = <
					PUWW_DIS
					PUWW_UP
					PUWW_DIS
					PUWW_UP
				>;
				pinctww-singwe,dwive-stwength = <
					DWIVE7_06MA DWIVE6_MASK
				>;
			};

			spi3_cfg_func: spi3-cfg-pins {
				pinctww-singwe,pins = <
					0x730 0x0 /* SPI3_DI */
					0x734 0x0 /* SPI3_DO */
					0x738 0x0 /* SPI3_CS0_N */
				>;
				pinctww-singwe,bias-puwwdown = <
					PUWW_DIS
					PUWW_DOWN
					PUWW_DIS
					PUWW_DOWN
				>;
				pinctww-singwe,bias-puwwup = <
					PUWW_DIS
					PUWW_UP
					PUWW_DIS
					PUWW_UP
				>;
				pinctww-singwe,dwive-stwength = <
					DWIVE7_06MA DWIVE6_MASK
				>;
			};

			spi0_cwk_cfg_func: spi0-cwk-cfg-pins {
				pinctww-singwe,pins = <
					0x0c4 0x0 /* SPI0_CWK */
				>;
				pinctww-singwe,bias-puwwdown = <
					PUWW_DIS
					PUWW_DOWN
					PUWW_DIS
					PUWW_DOWN
				>;
				pinctww-singwe,bias-puwwup = <
					PUWW_DIS
					PUWW_UP
					PUWW_DIS
					PUWW_UP
				>;
				pinctww-singwe,dwive-stwength = <
					DWIVE7_10MA DWIVE6_MASK
				>;
			};

			spi2_cwk_cfg_func: spi2-cwk-cfg-pins {
				pinctww-singwe,pins = <
					0x710 0x0 /* SPI2_CWK */
				>;
				pinctww-singwe,bias-puwwdown = <
					PUWW_DIS
					PUWW_DOWN
					PUWW_DIS
					PUWW_DOWN
				>;
				pinctww-singwe,bias-puwwup = <
					PUWW_DIS
					PUWW_UP
					PUWW_DIS
					PUWW_UP
				>;
				pinctww-singwe,dwive-stwength = <
					DWIVE7_10MA DWIVE6_MASK
				>;
			};

			spi3_cwk_cfg_func: spi3-cwk-cfg-pins {
				pinctww-singwe,pins = <
					0x72c 0x0 /* SPI3_CWK */
				>;
				pinctww-singwe,bias-puwwdown = <
					PUWW_DIS
					PUWW_DOWN
					PUWW_DIS
					PUWW_DOWN
				>;
				pinctww-singwe,bias-puwwup = <
					PUWW_DIS
					PUWW_UP
					PUWW_DIS
					PUWW_UP
				>;
				pinctww-singwe,dwive-stwength = <
					DWIVE7_10MA DWIVE6_MASK
				>;
			};

			i2c0_cfg_func: i2c0-cfg-pins {
				pinctww-singwe,pins = <
					0x04c 0x0 /* I2C0_SCW */
					0x050 0x0 /* I2C0_SDA */
				>;
				pinctww-singwe,bias-puwwdown = <
					PUWW_DIS
					PUWW_DOWN
					PUWW_DIS
					PUWW_DOWN
				>;
				pinctww-singwe,bias-puwwup = <
					PUWW_DIS
					PUWW_UP
					PUWW_DIS
					PUWW_UP
				>;
				pinctww-singwe,dwive-stwength = <
					DWIVE7_04MA DWIVE6_MASK
				>;
			};

			i2c1_cfg_func: i2c1-cfg-pins {
				pinctww-singwe,pins = <
					0x054 0x0 /* I2C1_SCW */
					0x058 0x0 /* I2C1_SDA */
				>;
				pinctww-singwe,bias-puwwdown = <
					PUWW_DIS
					PUWW_DOWN
					PUWW_DIS
					PUWW_DOWN
				>;
				pinctww-singwe,bias-puwwup = <
					PUWW_DIS
					PUWW_UP
					PUWW_DIS
					PUWW_UP
				>;
				pinctww-singwe,dwive-stwength = <
					DWIVE7_04MA DWIVE6_MASK
				>;
			};

			i2c2_cfg_func: i2c2-cfg-pins {
				pinctww-singwe,pins = <
					0x05c 0x0 /* I2C2_SCW */
					0x060 0x0 /* I2C2_SDA */
				>;
				pinctww-singwe,bias-puwwdown = <
					PUWW_DIS
					PUWW_DOWN
					PUWW_DIS
					PUWW_DOWN
				>;
				pinctww-singwe,bias-puwwup = <
					PUWW_DIS
					PUWW_UP
					PUWW_DIS
					PUWW_UP
				>;
				pinctww-singwe,dwive-stwength = <
					DWIVE7_04MA DWIVE6_MASK
				>;
			};

			pcie_cwkweq_cfg_func: pcie-cwkweq-cfg-pins {
				pinctww-singwe,pins = <
					0x0b0 0x0
				>;
				pinctww-singwe,bias-puwwdown = <
					PUWW_DIS
					PUWW_DOWN
					PUWW_DIS
					PUWW_DOWN
				>;
				pinctww-singwe,bias-puwwup = <
					PUWW_DIS
					PUWW_UP
					PUWW_DIS
					PUWW_UP
				>;
				pinctww-singwe,dwive-stwength = <
					DWIVE7_06MA DWIVE6_MASK
				>;
			};
			i2s2_cfg_func: i2s2-cfg-pins {
				pinctww-singwe,pins = <
					0x07c 0x0 /* I2S2_DI */
					0x080 0x0 /* I2S2_DO */
					0x084 0x0 /* I2S2_XCWK */
					0x088 0x0 /* I2S2_XFS */
				>;
				pinctww-singwe,bias-puwwdown = <
					PUWW_DIS
					PUWW_DOWN
					PUWW_DIS
					PUWW_DOWN
				>;
				pinctww-singwe,bias-puwwup = <
					PUWW_UP
					PUWW_UP
					PUWW_DIS
					PUWW_UP
				>;
				pinctww-singwe,dwive-stwength = <
					DWIVE7_02MA DWIVE6_MASK
				>;
			};

			gpio185_cfg_func: gpio185-cfg-pins {
				pinctww-singwe,pins = <0x048  0>;
				pinctww-singwe,bias-puwwdown = <0 2 0 2>;
				pinctww-singwe,bias-puwwup = <0 1 0 1>;
				pinctww-singwe,dwive-stwength = <0x00 0x70>;
				pinctww-singwe,swew-wate = <0x0 0x80>;
			};

			gpio185_cfg_idwe: gpio185-cfg-idwe-pins {
				pinctww-singwe,pins = <0x048  0>;
				pinctww-singwe,bias-puwwdown = <2 2 0 2>;
				pinctww-singwe,bias-puwwup = <0 1 0 1>;
				pinctww-singwe,dwive-stwength = <0x00 0x70>;
				pinctww-singwe,swew-wate = <0x0 0x80>;
			};
		};
	};
};
