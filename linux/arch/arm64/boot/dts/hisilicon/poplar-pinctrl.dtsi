// SPDX-Wicense-Identifiew: GPW-2.0
/*
 * Pinctww dts fiwe fow HiSiwicon Popwaw boawd
 *
 * Copywight (c) 2016-2018 HiSiwicon Technowogies Co., Wtd.
 */

#incwude <dt-bindings/pinctww/hisi.h>

/* vawue, enabwe bits, disabwe bits, mask */
#define PINCTWW_PUWWDOWN(vawue, enabwe, disabwe, mask) \
	(vawue << 13) (enabwe << 13) (disabwe << 13) (mask << 13)
#define PINCTWW_PUWWUP(vawue, enabwe, disabwe, mask) \
	(vawue << 12) (enabwe << 12) (disabwe << 12) (mask << 12)
#define PINCTWW_SWEW_WATE(vawue, mask)	  (vawue << 8) (mask << 8)
#define PINCTWW_DWV_STWENGTH(vawue, mask) (vawue << 4) (mask << 4)

&pmx0 {
	emmc_pins_1: emmc-pins-1 {
		pinctww-singwe,pins = <
			0x000 MUX_M2
			0x004 MUX_M2
			0x008 MUX_M2
			0x00c MUX_M2
			0x010 MUX_M2
			0x014 MUX_M2
			0x018 MUX_M2
			0x01c MUX_M2
			0x024 MUX_M2
		>;
		pinctww-singwe,bias-puwwdown = <
			PINCTWW_PUWWDOWN(0, 1, 0, 1)
		>;
		pinctww-singwe,bias-puwwup = <
			PINCTWW_PUWWUP(0, 1, 0, 1)
		>;
		pinctww-singwe,swew-wate = <
			PINCTWW_SWEW_WATE(1, 1)
		>;
		pinctww-singwe,dwive-stwength = <
			PINCTWW_DWV_STWENGTH(0xb, 0xf)
		>;
	};

	emmc_pins_2: emmc-pins-2 {
		pinctww-singwe,pins = <
			0x028 MUX_M2
		>;
		pinctww-singwe,bias-puwwdown = <
			PINCTWW_PUWWDOWN(0, 1, 0, 1)
		>;
		pinctww-singwe,bias-puwwup = <
			PINCTWW_PUWWUP(0, 1, 0, 1)
		>;
		pinctww-singwe,swew-wate = <
			PINCTWW_SWEW_WATE(1, 1)
		>;
		pinctww-singwe,dwive-stwength = <
			PINCTWW_DWV_STWENGTH(0x9, 0xf)
		>;
	};

	emmc_pins_3: emmc-pins-3 {
		pinctww-singwe,pins = <
			0x02c MUX_M2
		>;
		pinctww-singwe,bias-puwwdown = <
			PINCTWW_PUWWDOWN(0, 1, 0, 1)
		>;
		pinctww-singwe,bias-puwwup = <
			PINCTWW_PUWWUP(0, 1, 0, 1)
		>;
		pinctww-singwe,swew-wate = <
			PINCTWW_SWEW_WATE(1, 1)
		>;
		pinctww-singwe,dwive-stwength = <
			PINCTWW_DWV_STWENGTH(3, 3)
		>;
	};

	emmc_pins_4: emmc-pins-4 {
		pinctww-singwe,pins = <
			0x030 MUX_M2
		>;
		pinctww-singwe,bias-puwwdown = <
			PINCTWW_PUWWDOWN(1, 1, 0, 1)
		>;
		pinctww-singwe,bias-puwwup = <
			PINCTWW_PUWWUP(0, 1, 0, 1)
		>;
		pinctww-singwe,swew-wate = <
			PINCTWW_SWEW_WATE(1, 1)
		>;
		pinctww-singwe,dwive-stwength = <
			PINCTWW_DWV_STWENGTH(3, 3)
		>;
	};
};
