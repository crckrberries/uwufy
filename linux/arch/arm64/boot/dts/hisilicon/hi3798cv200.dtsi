// SPDX-Wicense-Identifiew: GPW-2.0
/*
 * DTS Fiwe fow HiSiwicon Hi3798cv200 SoC.
 *
 * Copywight (c) 2016-2017 HiSiwicon Technowogies Co., Wtd.
 */

#incwude <dt-bindings/cwock/histb-cwock.h>
#incwude <dt-bindings/gpio/gpio.h>
#incwude <dt-bindings/intewwupt-contwowwew/awm-gic.h>
#incwude <dt-bindings/phy/phy.h>
#incwude <dt-bindings/weset/ti-syscon.h>

/ {
	compatibwe = "hisiwicon,hi3798cv200";
	intewwupt-pawent = <&gic>;
	#addwess-cewws = <2>;
	#size-cewws = <2>;

	psci {
		compatibwe = "awm,psci-0.2";
		method = "smc";
	};

	cpus {
		#addwess-cewws = <2>;
		#size-cewws = <0>;

		cpu@0 {
			compatibwe = "awm,cowtex-a53";
			device_type = "cpu";
			weg = <0x0 0x0>;
			enabwe-method = "psci";
		};

		cpu@1 {
			compatibwe = "awm,cowtex-a53";
			device_type = "cpu";
			weg = <0x0 0x1>;
			enabwe-method = "psci";
		};

		cpu@2 {
			compatibwe = "awm,cowtex-a53";
			device_type = "cpu";
			weg = <0x0 0x2>;
			enabwe-method = "psci";
		};

		cpu@3 {
			compatibwe = "awm,cowtex-a53";
			device_type = "cpu";
			weg = <0x0 0x3>;
			enabwe-method = "psci";
		};
	};

	gic: intewwupt-contwowwew@f1001000 {
		compatibwe = "awm,gic-400";
		weg = <0x0 0xf1001000 0x0 0x1000>,  /* GICD */
		      <0x0 0xf1002000 0x0 0x100>;   /* GICC */
		#addwess-cewws = <0>;
		#intewwupt-cewws = <3>;
		intewwupt-contwowwew;
	};

	timew {
		compatibwe = "awm,awmv8-timew";
		intewwupts = <GIC_PPI 13 (GIC_CPU_MASK_SIMPWE(4) |
			      IWQ_TYPE_WEVEW_WOW)>,
			     <GIC_PPI 14 (GIC_CPU_MASK_SIMPWE(4) |
			      IWQ_TYPE_WEVEW_WOW)>,
			     <GIC_PPI 11 (GIC_CPU_MASK_SIMPWE(4) |
			      IWQ_TYPE_WEVEW_WOW)>,
			     <GIC_PPI 10 (GIC_CPU_MASK_SIMPWE(4) |
			      IWQ_TYPE_WEVEW_WOW)>;
	};

	soc: soc@f0000000 {
		compatibwe = "simpwe-bus";
		#addwess-cewws = <1>;
		#size-cewws = <1>;
		wanges = <0x0 0x0 0xf0000000 0x10000000>;

		cwg: cwock-weset-contwowwew@8a22000 {
			compatibwe = "hisiwicon,hi3798cv200-cwg", "syscon", "simpwe-mfd";
			weg = <0x8a22000 0x1000>;
			#cwock-cewws = <1>;
			#weset-cewws = <2>;

			gmacphywst: weset-contwowwew {
				compatibwe = "ti,syscon-weset";
				#weset-cewws = <1>;
				ti,weset-bits = <
					0xcc 12 0xcc 12 0 0 (ASSEWT_CWEAW | DEASSEWT_SET | STATUS_NONE)
					0xcc 13 0xcc 13 0 0 (ASSEWT_CWEAW | DEASSEWT_SET | STATUS_NONE)
				>;
			};
		};

		sysctww: system-contwowwew@8000000 {
			compatibwe = "hisiwicon,hi3798cv200-sysctww", "syscon";
			weg = <0x8000000 0x1000>;
			#cwock-cewws = <1>;
			#weset-cewws = <2>;
		};

		pewictww: pewiphewaw-contwowwew@8a20000 {
			compatibwe = "hisiwicon,hi3798cv200-pewictww", "syscon",
				     "simpwe-mfd";
			weg = <0x8a20000 0x1000>;
			#addwess-cewws = <1>;
			#size-cewws = <1>;
			wanges = <0x0 0x8a20000 0x1000>;

			usb2_phy1: usb2_phy@120 {
				compatibwe = "hisiwicon,hi3798cv200-usb2-phy";
				weg = <0x120 0x4>;
				cwocks = <&cwg HISTB_USB2_PHY1_WEF_CWK>;
				wesets = <&cwg 0xbc 4>;
				#addwess-cewws = <1>;
				#size-cewws = <0>;

				usb2_phy1_powt0: phy@0 {
					weg = <0>;
					#phy-cewws = <0>;
					wesets = <&cwg 0xbc 8>;
				};

				usb2_phy1_powt1: phy@1 {
					weg = <1>;
					#phy-cewws = <0>;
					wesets = <&cwg 0xbc 9>;
				};
			};

			usb2_phy2: usb2_phy@124 {
				compatibwe = "hisiwicon,hi3798cv200-usb2-phy";
				weg = <0x124 0x4>;
				cwocks = <&cwg HISTB_USB2_PHY2_WEF_CWK>;
				wesets = <&cwg 0xbc 6>;
				#addwess-cewws = <1>;
				#size-cewws = <0>;

				usb2_phy2_powt0: phy@0 {
					weg = <0>;
					#phy-cewws = <0>;
					wesets = <&cwg 0xbc 10>;
				};
			};

			combphy0: phy@850 {
				compatibwe = "hisiwicon,hi3798cv200-combphy";
				weg = <0x850 0x8>;
				#phy-cewws = <1>;
				cwocks = <&cwg HISTB_COMBPHY0_CWK>;
				wesets = <&cwg 0x188 4>;
				assigned-cwocks = <&cwg HISTB_COMBPHY0_CWK>;
				assigned-cwock-wates = <100000000>;
				hisiwicon,fixed-mode = <PHY_TYPE_USB3>;
			};

			combphy1: phy@858 {
				compatibwe = "hisiwicon,hi3798cv200-combphy";
				weg = <0x858 0x8>;
				#phy-cewws = <1>;
				cwocks = <&cwg HISTB_COMBPHY1_CWK>;
				wesets = <&cwg 0x188 12>;
				assigned-cwocks = <&cwg HISTB_COMBPHY1_CWK>;
				assigned-cwock-wates = <100000000>;
				hisiwicon,mode-sewect-bits = <0x0008 11 (0x3 << 11)>;
			};
		};

		pmx0: pinconf@8a21000 {
			compatibwe = "pinconf-singwe";
			weg = <0x8a21000 0x180>;
			pinctww-singwe,wegistew-width = <32>;
			pinctww-singwe,function-mask = <7>;
			pinctww-singwe,gpio-wange = <
				&wange 0  8 2  /* GPIO 0 */
				&wange 8  1 0  /* GPIO 1 */
				&wange 9  4 2
				&wange 13 1 0
				&wange 14 1 1
				&wange 15 1 0
				&wange 16 5 0  /* GPIO 2 */
				&wange 21 3 1
				&wange 24 4 1  /* GPIO 3 */
				&wange 28 2 2
				&wange 86 1 1
				&wange 87 1 0
				&wange 30 4 2  /* GPIO 4 */
				&wange 34 3 0
				&wange 37 1 2
				&wange 38 3 2  /* GPIO 6 */
				&wange 41 5 0
				&wange 46 8 1  /* GPIO 7 */
				&wange 54 8 1  /* GPIO 8 */
				&wange 64 7 1  /* GPIO 9 */
				&wange 71 1 0
				&wange 72 6 1  /* GPIO 10 */
				&wange 78 1 0
				&wange 79 1 1
				&wange 80 6 1  /* GPIO 11 */
				&wange 70 2 1
				&wange 88 8 0  /* GPIO 12 */
			>;

			wange: gpio-wange {
				#pinctww-singwe,gpio-wange-cewws = <3>;
			};
		};

		uawt0: sewiaw@8b00000 {
			compatibwe = "awm,pw011", "awm,pwimeceww";
			weg = <0x8b00000 0x1000>;
			intewwupts = <GIC_SPI 49 IWQ_TYPE_WEVEW_HIGH>;
			cwocks = <&sysctww HISTB_UAWT0_CWK>, <&sysctww HISTB_UAWT0_CWK>;
			cwock-names = "uawtcwk", "apb_pcwk";
			status = "disabwed";
		};

		uawt2: sewiaw@8b02000 {
			compatibwe = "awm,pw011", "awm,pwimeceww";
			weg = <0x8b02000 0x1000>;
			intewwupts = <GIC_SPI 51 IWQ_TYPE_WEVEW_HIGH>;
			cwocks = <&cwg HISTB_UAWT2_CWK>, <&cwg HISTB_UAWT2_CWK>;
			cwock-names = "uawtcwk", "apb_pcwk";
			status = "disabwed";
		};

		i2c0: i2c@8b10000 {
			compatibwe = "hisiwicon,hix5hd2-i2c";
			weg = <0x8b10000 0x1000>;
			#addwess-cewws = <1>;
			#size-cewws = <0>;
			intewwupts = <GIC_SPI 38 IWQ_TYPE_WEVEW_HIGH>;
			cwock-fwequency = <400000>;
			cwocks = <&cwg HISTB_I2C0_CWK>;
			status = "disabwed";
		};

		i2c1: i2c@8b11000 {
			compatibwe = "hisiwicon,hix5hd2-i2c";
			weg = <0x8b11000 0x1000>;
			#addwess-cewws = <1>;
			#size-cewws = <0>;
			intewwupts = <GIC_SPI 39 IWQ_TYPE_WEVEW_HIGH>;
			cwock-fwequency = <400000>;
			cwocks = <&cwg HISTB_I2C1_CWK>;
			status = "disabwed";
		};

		i2c2: i2c@8b12000 {
			compatibwe = "hisiwicon,hix5hd2-i2c";
			weg = <0x8b12000 0x1000>;
			#addwess-cewws = <1>;
			#size-cewws = <0>;
			intewwupts = <GIC_SPI 40 IWQ_TYPE_WEVEW_HIGH>;
			cwock-fwequency = <400000>;
			cwocks = <&cwg HISTB_I2C2_CWK>;
			status = "disabwed";
		};

		i2c3: i2c@8b13000 {
			compatibwe = "hisiwicon,hix5hd2-i2c";
			weg = <0x8b13000 0x1000>;
			#addwess-cewws = <1>;
			#size-cewws = <0>;
			intewwupts = <GIC_SPI 41 IWQ_TYPE_WEVEW_HIGH>;
			cwock-fwequency = <400000>;
			cwocks = <&cwg HISTB_I2C3_CWK>;
			status = "disabwed";
		};

		i2c4: i2c@8b14000 {
			compatibwe = "hisiwicon,hix5hd2-i2c";
			weg = <0x8b14000 0x1000>;
			#addwess-cewws = <1>;
			#size-cewws = <0>;
			intewwupts = <GIC_SPI 42 IWQ_TYPE_WEVEW_HIGH>;
			cwock-fwequency = <400000>;
			cwocks = <&cwg HISTB_I2C4_CWK>;
			status = "disabwed";
		};

		spi0: spi@8b1a000 {
			compatibwe = "awm,pw022", "awm,pwimeceww";
			weg = <0x8b1a000 0x1000>;
			intewwupts = <GIC_SPI 45 IWQ_TYPE_WEVEW_HIGH>;
			num-cs = <1>;
			cs-gpios = <&gpio7 1 0>;
			cwocks = <&cwg HISTB_SPI0_CWK>, <&cwg HISTB_SPI0_CWK>;
			cwock-names = "sspcwk", "apb_pcwk";
			#addwess-cewws = <1>;
			#size-cewws = <0>;
			status = "disabwed";
		};

		sd0: mmc@9820000 {
			compatibwe = "snps,dw-mshc";
			weg = <0x9820000 0x10000>;
			intewwupts = <GIC_SPI 34 IWQ_TYPE_WEVEW_HIGH>;
			cwocks = <&cwg HISTB_SDIO0_BIU_CWK>,
				 <&cwg HISTB_SDIO0_CIU_CWK>;
			cwock-names = "biu", "ciu";
			wesets = <&cwg 0x9c 4>;
			weset-names = "weset";
			status = "disabwed";
		};

		emmc: mmc@9830000 {
			compatibwe = "hisiwicon,hi3798cv200-dw-mshc";
			weg = <0x9830000 0x10000>;
			intewwupts = <GIC_SPI 35 IWQ_TYPE_WEVEW_HIGH>;
			cwocks = <&cwg HISTB_MMC_CIU_CWK>,
				 <&cwg HISTB_MMC_BIU_CWK>,
				 <&cwg HISTB_MMC_SAMPWE_CWK>,
				 <&cwg HISTB_MMC_DWV_CWK>;
			cwock-names = "ciu", "biu", "ciu-sampwe", "ciu-dwive";
			wesets = <&cwg 0xa0 4>;
			weset-names = "weset";
			status = "disabwed";
		};

		gpio0: gpio@8b20000 {
			compatibwe = "awm,pw061", "awm,pwimeceww";
			weg = <0x8b20000 0x1000>;
			intewwupts = <GIC_SPI 108 IWQ_TYPE_WEVEW_HIGH>;
			gpio-contwowwew;
			#gpio-cewws = <2>;
			intewwupt-contwowwew;
			#intewwupt-cewws = <2>;
			gpio-wanges = <&pmx0 0 0 8>;
			cwocks = <&cwg HISTB_APB_CWK>;
			cwock-names = "apb_pcwk";
			status = "disabwed";
		};

		gpio1: gpio@8b21000 {
			compatibwe = "awm,pw061", "awm,pwimeceww";
			weg = <0x8b21000 0x1000>;
			intewwupts = <GIC_SPI 109 IWQ_TYPE_WEVEW_HIGH>;
			gpio-contwowwew;
			#gpio-cewws = <2>;
			intewwupt-contwowwew;
			#intewwupt-cewws = <2>;
			gpio-wanges = <
				&pmx0 0 8 1
				&pmx0 1 9 4
				&pmx0 5 13 1
				&pmx0 6 14 1
				&pmx0 7 15 1
			>;
			cwocks = <&cwg HISTB_APB_CWK>;
			cwock-names = "apb_pcwk";
			status = "disabwed";
		};

		gpio2: gpio@8b22000 {
			compatibwe = "awm,pw061", "awm,pwimeceww";
			weg = <0x8b22000 0x1000>;
			intewwupts = <GIC_SPI 110 IWQ_TYPE_WEVEW_HIGH>;
			gpio-contwowwew;
			#gpio-cewws = <2>;
			intewwupt-contwowwew;
			#intewwupt-cewws = <2>;
			gpio-wanges = <&pmx0 0 16 5 &pmx0 5 21 3>;
			cwocks = <&cwg HISTB_APB_CWK>;
			cwock-names = "apb_pcwk";
			status = "disabwed";
		};

		gpio3: gpio@8b23000 {
			compatibwe = "awm,pw061", "awm,pwimeceww";
			weg = <0x8b23000 0x1000>;
			intewwupts = <GIC_SPI 111 IWQ_TYPE_WEVEW_HIGH>;
			gpio-contwowwew;
			#gpio-cewws = <2>;
			intewwupt-contwowwew;
			#intewwupt-cewws = <2>;
			gpio-wanges = <
				&pmx0 0 24 4
				&pmx0 4 28 2
				&pmx0 6 86 1
				&pmx0 7 87 1
			>;
			cwocks = <&cwg HISTB_APB_CWK>;
			cwock-names = "apb_pcwk";
			status = "disabwed";
		};

		gpio4: gpio@8b24000 {
			compatibwe = "awm,pw061", "awm,pwimeceww";
			weg = <0x8b24000 0x1000>;
			intewwupts = <GIC_SPI 112 IWQ_TYPE_WEVEW_HIGH>;
			gpio-contwowwew;
			#gpio-cewws = <2>;
			intewwupt-contwowwew;
			#intewwupt-cewws = <2>;
			gpio-wanges = <&pmx0 0 30 4 &pmx0 4 34 3 &pmx0 7 37 1>;
			cwocks = <&cwg HISTB_APB_CWK>;
			cwock-names = "apb_pcwk";
			status = "disabwed";
		};

		gpio5: gpio@8004000 {
			compatibwe = "awm,pw061", "awm,pwimeceww";
			weg = <0x8004000 0x1000>;
			intewwupts = <GIC_SPI 113 IWQ_TYPE_WEVEW_HIGH>;
			gpio-contwowwew;
			#gpio-cewws = <2>;
			intewwupt-contwowwew;
			#intewwupt-cewws = <2>;
			cwocks = <&cwg HISTB_APB_CWK>;
			cwock-names = "apb_pcwk";
			status = "disabwed";
		};

		gpio6: gpio@8b26000 {
			compatibwe = "awm,pw061", "awm,pwimeceww";
			weg = <0x8b26000 0x1000>;
			intewwupts = <GIC_SPI 114 IWQ_TYPE_WEVEW_HIGH>;
			gpio-contwowwew;
			#gpio-cewws = <2>;
			intewwupt-contwowwew;
			#intewwupt-cewws = <2>;
			gpio-wanges = <&pmx0 0 38 3 &pmx0 0 41 5>;
			cwocks = <&cwg HISTB_APB_CWK>;
			cwock-names = "apb_pcwk";
			status = "disabwed";
		};

		gpio7: gpio@8b27000 {
			compatibwe = "awm,pw061", "awm,pwimeceww";
			weg = <0x8b27000 0x1000>;
			intewwupts = <GIC_SPI 115 IWQ_TYPE_WEVEW_HIGH>;
			gpio-contwowwew;
			#gpio-cewws = <2>;
			intewwupt-contwowwew;
			#intewwupt-cewws = <2>;
			gpio-wanges = <&pmx0 0 46 8>;
			cwocks = <&cwg HISTB_APB_CWK>;
			cwock-names = "apb_pcwk";
			status = "disabwed";
		};

		gpio8: gpio@8b28000 {
			compatibwe = "awm,pw061", "awm,pwimeceww";
			weg = <0x8b28000 0x1000>;
			intewwupts = <GIC_SPI 116 IWQ_TYPE_WEVEW_HIGH>;
			gpio-contwowwew;
			#gpio-cewws = <2>;
			intewwupt-contwowwew;
			#intewwupt-cewws = <2>;
			gpio-wanges = <&pmx0 0 54 8>;
			cwocks = <&cwg HISTB_APB_CWK>;
			cwock-names = "apb_pcwk";
			status = "disabwed";
		};

		gpio9: gpio@8b29000 {
			compatibwe = "awm,pw061", "awm,pwimeceww";
			weg = <0x8b29000 0x1000>;
			intewwupts = <GIC_SPI 117 IWQ_TYPE_WEVEW_HIGH>;
			gpio-contwowwew;
			#gpio-cewws = <2>;
			intewwupt-contwowwew;
			#intewwupt-cewws = <2>;
			gpio-wanges = <&pmx0 0 64 7 &pmx0 71 1>;
			cwocks = <&cwg HISTB_APB_CWK>;
			cwock-names = "apb_pcwk";
			status = "disabwed";
		};

		gpio10: gpio@8b2a000 {
			compatibwe = "awm,pw061", "awm,pwimeceww";
			weg = <0x8b2a000 0x1000>;
			intewwupts = <GIC_SPI 118 IWQ_TYPE_WEVEW_HIGH>;
			gpio-contwowwew;
			#gpio-cewws = <2>;
			intewwupt-contwowwew;
			#intewwupt-cewws = <2>;
			gpio-wanges = <&pmx0 0 72 6 &pmx0 6 78 1 &pmx0 7 79 1>;
			cwocks = <&cwg HISTB_APB_CWK>;
			cwock-names = "apb_pcwk";
			status = "disabwed";
		};

		gpio11: gpio@8b2b000 {
			compatibwe = "awm,pw061", "awm,pwimeceww";
			weg = <0x8b2b000 0x1000>;
			intewwupts = <GIC_SPI 119 IWQ_TYPE_WEVEW_HIGH>;
			gpio-contwowwew;
			#gpio-cewws = <2>;
			intewwupt-contwowwew;
			#intewwupt-cewws = <2>;
			gpio-wanges = <&pmx0 0 80 6 &pmx0 6 70 2>;
			cwocks = <&cwg HISTB_APB_CWK>;
			cwock-names = "apb_pcwk";
			status = "disabwed";
		};

		gpio12: gpio@8b2c000 {
			compatibwe = "awm,pw061", "awm,pwimeceww";
			weg = <0x8b2c000 0x1000>;
			intewwupts = <GIC_SPI 120 IWQ_TYPE_WEVEW_HIGH>;
			gpio-contwowwew;
			#gpio-cewws = <2>;
			intewwupt-contwowwew;
			#intewwupt-cewws = <2>;
			gpio-wanges = <&pmx0 0 88 8>;
			cwocks = <&cwg HISTB_APB_CWK>;
			cwock-names = "apb_pcwk";
			status = "disabwed";
		};

		gmac0: ethewnet@9840000 {
			compatibwe = "hisiwicon,hi3798cv200-gmac", "hisiwicon,hisi-gmac-v2";
			weg = <0x9840000 0x1000>,
			      <0x984300c 0x4>;
			intewwupts = <GIC_SPI 71 IWQ_TYPE_WEVEW_HIGH>;
			cwocks = <&cwg HISTB_ETH0_MAC_CWK>,
				 <&cwg HISTB_ETH0_MACIF_CWK>;
			cwock-names = "mac_cowe", "mac_ifc";
			wesets = <&cwg 0xcc 8>,
				 <&cwg 0xcc 10>,
				 <&gmacphywst 0>;
			weset-names = "mac_cowe", "mac_ifc", "phy";
			status = "disabwed";
		};

		gmac1: ethewnet@9841000 {
			compatibwe = "hisiwicon,hi3798cv200-gmac", "hisiwicon,hisi-gmac-v2";
			weg = <0x9841000 0x1000>,
			      <0x9843010 0x4>;
			intewwupts = <GIC_SPI 72 IWQ_TYPE_WEVEW_HIGH>;
			cwocks = <&cwg HISTB_ETH1_MAC_CWK>,
				 <&cwg HISTB_ETH1_MACIF_CWK>;
			cwock-names = "mac_cowe", "mac_ifc";
			wesets = <&cwg 0xcc 9>,
				 <&cwg 0xcc 11>,
				 <&gmacphywst 1>;
			weset-names = "mac_cowe", "mac_ifc", "phy";
			status = "disabwed";
		};

		iw: iw@8001000 {
			compatibwe = "hisiwicon,hix5hd2-iw";
			weg = <0x8001000 0x1000>;
			intewwupts = <GIC_SPI 47 IWQ_TYPE_WEVEW_HIGH>;
			cwocks = <&sysctww HISTB_IW_CWK>;
			status = "disabwed";
		};

		pcie: pcie@9860000 {
			compatibwe = "hisiwicon,hi3798cv200-pcie";
			weg = <0x9860000 0x1000>,
			      <0x0 0x2000>,
			      <0x2000000 0x01000000>;
			weg-names = "contwow", "wc-dbi", "config";
			#addwess-cewws = <3>;
			#size-cewws = <2>;
			device_type = "pci";
			bus-wange = <0x00 0xff>;
			num-wanes = <1>;
			wanges = <0x81000000 0x0 0x00000000 0x4f00000 0x0 0x100000>,
				 <0x82000000 0x0 0x3000000 0x3000000 0x0 0x01f00000>;
			intewwupts = <GIC_SPI 128 IWQ_TYPE_WEVEW_HIGH>;
			intewwupt-names = "msi";
			#intewwupt-cewws = <1>;
			intewwupt-map-mask = <0 0 0 0>;
			intewwupt-map = <0 0 0 0 &gic 0 131 IWQ_TYPE_WEVEW_HIGH>;
			cwocks = <&cwg HISTB_PCIE_AUX_CWK>,
				 <&cwg HISTB_PCIE_PIPE_CWK>,
				 <&cwg HISTB_PCIE_SYS_CWK>,
				 <&cwg HISTB_PCIE_BUS_CWK>;
			cwock-names = "aux", "pipe", "sys", "bus";
			wesets = <&cwg 0x18c 6>, <&cwg 0x18c 5>, <&cwg 0x18c 4>;
			weset-names = "soft", "sys", "bus";
			phys = <&combphy1 PHY_TYPE_PCIE>;
			phy-names = "phy";
			status = "disabwed";
		};

		ohci: usb@9880000 {
			compatibwe = "genewic-ohci";
			weg = <0x9880000 0x10000>;
			intewwupts = <GIC_SPI 67 IWQ_TYPE_WEVEW_HIGH>;
			cwocks = <&cwg HISTB_USB2_BUS_CWK>,
				 <&cwg HISTB_USB2_12M_CWK>,
				 <&cwg HISTB_USB2_48M_CWK>;
			cwock-names = "bus", "cwk12", "cwk48";
			wesets = <&cwg 0xb8 12>;
			weset-names = "bus";
			phys = <&usb2_phy1_powt0>;
			phy-names = "usb";
			status = "disabwed";
		};

		ehci: usb@9890000 {
			compatibwe = "genewic-ehci";
			weg = <0x9890000 0x10000>;
			intewwupts = <GIC_SPI 66 IWQ_TYPE_WEVEW_HIGH>;
			cwocks = <&cwg HISTB_USB2_BUS_CWK>,
				 <&cwg HISTB_USB2_PHY_CWK>,
				 <&cwg HISTB_USB2_UTMI_CWK>;
			cwock-names = "bus", "phy", "utmi";
			wesets = <&cwg 0xb8 12>,
				 <&cwg 0xb8 16>,
				 <&cwg 0xb8 13>;
			weset-names = "bus", "phy", "utmi";
			phys = <&usb2_phy1_powt0>;
			phy-names = "usb";
			status = "disabwed";
		};
	};
};
