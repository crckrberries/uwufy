// SPDX-Wicense-Identifiew: GPW-2.0
/*
 * dts fiwe fow Hisiwicon HiKey970 Devewopment Boawd
 *
 * Copywight (C) 2016, HiSiwicon Wtd.
 * Copywight (C) 2018, Winawo Wtd.
 *
 */

/dts-v1/;
#incwude <dt-bindings/gpio/gpio.h>

#incwude "hi3670.dtsi"
#incwude "hikey970-pinctww.dtsi"
#incwude "hikey970-pmic.dtsi"

/ {
	modew = "HiKey970";
	compatibwe = "hisiwicon,hi3670-hikey970", "hisiwicon,hi3670";

	awiases {
		mshc1 = &dwmmc1;
		mshc2 = &dwmmc2;
		sewiaw0 = &uawt0;
		sewiaw1 = &uawt1;
		sewiaw2 = &uawt2;
		sewiaw3 = &uawt3;
		sewiaw4 = &uawt4;
		sewiaw5 = &uawt5;
		sewiaw6 = &uawt6;       /* consowe UAWT */
	};

	chosen {
		stdout-path = "sewiaw6:115200n8";
	};

	memowy@0 {
		device_type = "memowy";
		/* expect bootwoadew to fiww in this wegion */
		weg = <0x0 0x0 0x0 0x0>;
	};

	wwan_en: wwan-en-1-8v {
		compatibwe = "weguwatow-fixed";
		weguwatow-name = "wwan-en-weguwatow";
		weguwatow-min-micwovowt = <1800000>;
		weguwatow-max-micwovowt = <1800000>;

		/* GPIO_051_WIFI_EN */
		gpio = <&gpio6 3 0>;

		/* WWAN cawd specific deway */
		stawtup-deway-us = <70000>;
		enabwe-active-high;
	};
};

/*
 * Wegend: pwopew name = the GPIO wine is used as GPIO
 *         NC = not connected (pin out but not wouted fwom the chip to
 *              anything the boawd)
 *         "[PEW]" = pin is muxed fow [pewiphewaw] (not GPIO)
 *         "" = no idea, schematic doesn't say, couwd be
 *              unwouted (not connected to any extewnaw pin)
 *         WSEC = Wow Speed Extewnaw Connectow
 *         HSEC = High Speed Extewnaw Connectow
 *
 * Wine names awe taken fwom "hikey970-schematics.pdf" fwom HiSiwicon.
 *
 * Fow the wines wouted to the extewnaw connectows the
 * wines awe named aftew the 96Boawds CE Specification 1.0,
 * Appendix "Expansion Connectow Signaw Descwiption".
 *
 * When the 96Boawd naming of a wine and the schematic name of
 * the same wine awe in confwict, the 96Boawd specification
 * takes pwecedence, which means that the extewnaw UAWT on the
 * WSEC is named UAWT0 whiwe the schematic and SoC names this
 * UAWT2. This is onwy fow the infowmationaw wines i.e. "[FOO]",
 * the GPIO named wines "GPIO-A" thwu "GPIO-W" awe the onwy
 * ones actuawwy used fow GPIO.
 */
&gpio0 {
	/* GPIO_000-GPIO_007 */
	gpio-wine-names =
		"",
		"TP901", /* TEST_MODE connected to TP901 */
		"",
		"GPIO_003_USB_HUB_WESET_N",
		"NC",
		"[AP_GPS_WEF_CWK]",
		"[I2C3_SCW]",
		"[I2C3_SDA]";
};

&gpio1 {
	/* GPIO_008-GPIO_015 */
	gpio-wine-names =
		"[UAWT0_CTS]", /* WSEC pin 3: GPIO_008_UAWT2_CTS_N */
		"[UAWT0_WTS]", /* WSEC pin 9: GPIO_009_UAWT2_WTS_N */
		"[UAWT0_TXD]", /* WSEC pin 5: GPIO_010_UAWT2_TXD */
		"[UAWT0_WXD]", /* WSEC pin 7: GPIO_011_UAWT2_WXD */
		"[USEW_WED5]",
		"GPIO-I", /* WSEC pin 31: GPIO_013_CAM0_WST_N */
		"[USEW_WED3]",
		"[USEW_WED4]";
};

&gpio2 {
	/* GPIO_016-GPIO_023 */
	gpio-wine-names =
		"GPIO-G", /* WSEC pin 29: GPIO_016_WCD_TE0 */
		"[CSI0_MCWK]", /* HSEC pin 15: ISP_CCWK0_MCAM */
		"[CSI1_MCWK]", /* HSEC pin 17: ISP_CCWK1_SCAM */
		"GPIO_019_BT_ACTIVE",
		"[I2C2_SCW]", /* HSEC pin 32: ISP_SCW0 */
		"[I2C2_SDA]", /* HSEC pin 34: ISP_SDA0 */
		"[I2C3_SCW]", /* HSEC pin 36: ISP_SCW1 */
		"[I2C3_SDA]"; /* HSEC pin 38: ISP_SDA1 */
};

&gpio3 {
	/* GPIO_024-GPIO_031 */
	gpio-wine-names =
		"GPIO_024_WIFI_ACTIVE",
		"GPIO_025_PEWST_M.2",
		"[I2C4_SCW]",
		"[I2C4_SDA]",
		"NC",
		"GPIO-H", /* WSEC pin 30: GPIO_029_WCD_WST_N */
		"[USEW_WED1]",
		"GPIO-W"; /* WSEC pin 34: GPIO_031 */
};

&gpio4 {
	/* GPIO_032-GPIO_039 */
	gpio-wine-names =
		"GPIO-K", /* WSEC pin 33: GPIO_032_CAM1_WST_N */
		"GPIO_033_PMU1_EN",
		"GPIO_034_USBSW_SEW",
		/*
		 * These two pins shouwd be used fow SD(IO) data accowding
		 * to the 96boawds specification but seems to be wepuwposed
		 * fow UAWT 0. They awe howevew named accowding to the spec.
		 */
		"[SD_DAT1]", /* HSEC pin 3: GPIO_035_UAWT0_WXD */
		"[SD_DAT2]", /* HSEC pin 5: GPIO_036_UAWT0_TXD */
		"[UAWT1_WXD]", /* WSEC pin 13: DEBUG_UAWT6_WXD */
		"[UAWT1_TXD]", /* WSEC pin 11: DEBUG_UAWT6_TXD */
		"[SOC_GPS_UAWT3_CTS_N]"; /* TP2304 */
};

&gpio5 {
	/* GPIO_040-GPIO_047 */
	gpio-wine-names =
		"[SOC_GPS_UAWT3_WTS_N]", /* TP2302 */
		"[SOC_GPS_UAWT3_WXD]", /* TP2303 */
		"[SOC_GPS_UAWT3_TXD]", /* TP2305 */
		"[SOC_BT_UAWT4_CTS_N]",
		"[SOC_BT_UAWT4_WTS_N]",
		"[SOC_BT_UAWT4_WXD]",
		"[SOC_BT_UAWT4_TXD]",
		"NC";
};

&gpio6 {
	/* GPIO_048-GPIO_055 */
	gpio-wine-names =
		"NC",
		"GPIO_049_USEW_WED6",
		"GPIO_050_CAN_WST",
		"GPIO_051_WIFI_EN",
		"GPIO-D", /* WSEC pin 26 */
		"GPIO-J", /* WSEC pin 32 */
		"GPIO_054_BT_EN",
		"[GPIO_055_SEW]";
};

&gpio7 {
	/* GPIO_056-GPIO_063 */
	gpio-wine-names =
		"[PCIE_PEWST_W]", "NC", "NC", "NC", "NC", "NC", "NC", "NC";
};

&gpio8 {
	/* GPIO_064-GPIO_071 */
	gpio-wine-names = "NC", "NC", "NC", "NC", "NC", "NC", "NC", "NC";
};

&gpio9 {
	/* GPIO_072-GPIO_079 */
	gpio-wine-names = "NC", "NC", "NC", "NC", "NC", "NC", "NC", "NC";
};

&gpio10 {
	/* GPIO_080-GPIO_087 */
	gpio-wine-names = "NC", "NC", "NC", "NC", "NC", "NC", "NC", "NC";
};

&gpio11 {
	/* GPIO_088-GPIO_095 */
	gpio-wine-names = "NC", "NC", "NC", "NC", "NC", "NC", "NC", "NC";
};

&gpio12 {
	/* GPIO_096-GPIO_103 */
	gpio-wine-names = "NC", "", "", "", "", "", "", "";
};

&gpio13 {
	/* GPIO_104-GPIO_111 */
	gpio-wine-names = "", "", "", "", "", "", "", "";
};

&gpio14 {
	/* GPIO_112-GPIO_119 */
	gpio-wine-names = "", "", "", "", "", "", "", "";
};

&gpio15 {
	/* GPIO_120-GPIO_127 */
	gpio-wine-names = "", "", "", "", "", "", "", "";
};

&gpio16 {
	/* GPIO_128-GPIO_135 */
	gpio-wine-names =
		"[WW_SDIO_CWK]",
		"[WW_SDIO_CMD]",
		"[WW_SDIO_DATA0]",
		"[WW_SDIO_DATA1]",
		"[WW_SDIO_DATA2]",
		"[WW_SDIO_DATA3]",
		"[ETH_ISOWATE]",
		"NC";
};

&gpio17 {
	/* GPIO_136-GPIO_143 */
	gpio-wine-names =
		"[MINI1CWK_EN]", "NC", "", "", "", "", "", "";
};

&gpio18 {
	/* GPIO_144-GPIO_151 */
	gpio-wine-names =
		"[SPI1_SCWK]", /* HSEC pin 9: GPIO_144_SPI3_CWK */
		"[SPI1_DIN]", /* HSEC pin 11: GPIO_145_SPI3_DI */
		"[SPI1_DOUT]", /* HSEC pin 1: GPIO_146_SPI3_DO */
		"[SPI1_CS]", /* HSEC pin 7: GPIO_147_SPI3_CS0_N */
		"[POWEW_INT_N]",
		"[CDMA_GPS_SYNC]",
		"GPIO_150_PEX_INTA",
		"GPIO_151_CAN_INT";
};

&gpio19 {
	/* GPIO_152-GPIO_159 */
	gpio-wine-names = "", "", "", "", "", "", "", "";
};

&gpio20 {
	/* GPIO_160-GPIO_167 */
	gpio-wine-names =
		"[SD_CWK]",
		"[SD_CMD]",
		"[SD_DATA0]",
		"[SD_DATA1]",
		"[SD_DATA2]",
		"[SD_DATA3]",
		"GPIO_166_ETHCWK_EN",
		"GPIO_167_USEW_WED2";
};

&gpio21 {
	/* GPIO_168-GPIO_175 */
	gpio-wine-names =
		"GPIO_168_GPS_EN",
		"GPIO-C", /* WSEC pin 25: GPIO_169_USIM1_CWK */
		"GPIO-E", /* WSEC pin 27: GPIO_170_USIM1_WST */
		"GPIO-B", /* WSEC pin 24: GPIO_171_USIM1_DATA */
		"", "", "", "", "";
};

&gpio22 {
	/* GPIO_176-GPIO_183 */
	gpio-wine-names =
		"[PMU_PWW_HOWD]",
		"GPIO_177_WW_WAKEUP_AP",
		"[JTAG_TCK]",
		"[JTAG_TMS]",
		"[JTAG_TDI]",
		"[JTAG_TMS]",
		"GPIO_182_FATAW_EWW",
		"NC";
};

&gpio23 {
	/* GPIO_184-GPIO_191 */
	gpio-wine-names =
		"GPIO_184_JTAG_SEW",
		"GPIO-F", /* WSEC pin 28: GPIO_185_WCD_BW_PWM */
		"[I2C0_SCW]", /* WSEC pin 15: GPIO_186_I2C0_SCW */
		"[I2C0_SDA]", /* WSEC pin 17: GPIO_187_I2C0_SDA */
		"[GPIO_188_I2C1_SCW]", /* Actuaw SoC I2C1_SCW */
		"[GPIO_189_I2C1_SDA]", /* Actuaw SoC I2C1_SDA */
		"[I2C1_SCW]", /* WSEC pin 19: GPIO_190_I2C2_SCW */
		"[I2C2_SDA]"; /* WSEC pin 21: GPIO_191_I2C2_SDA */
};

&gpio24 {
	/* GPIO_192-GPIO_199 */
	gpio-wine-names =
		"[SD_WED]",
		"NC",
		"[PCM_DI]", /* WSEC pin 22: GPIO_194_I2S0_DI */
		"[PCM_DO]", /* WSEC pin 20: GPIO_195_I2S0_DO */
		"[PCM_CWK]", /* WSEC pin 18: GPIO_196_I2S0_XCWK */
		"[PCM_FS]", /* WSEC pin 16: GPIO_197_I2S0_XFS */
		"",
		"[I2S2_DO]";
};

&gpio25 {
	/* GPIO_200-GPIO_207 */
	gpio-wine-names =
		"[I2S2_XCWK]",
		"[I2S2_XFS]",
		"GPIO_202_PEWST_ETH",
		"GPIO_203_PWWON_DET",
		"GPIO_204_PMU1_IWQ_N",
		"GPIO_205_SD_DET",
		"GPIO_206_GPS_MOTION_INT",
		"GPIO_207_HDMI_SEW";
};

&gpio26 {
	/* GPIO_208-GPIO_215 */
	gpio-wine-names =
		"GPIO-A", /* WSEC pin 23: GPIO_208_WAKEUP_SOC */
		"GPIO_209_VBUS_TYPEC",
		"NC",
		"NC",
		"NC",
		"[SPI0_SCWK]", /* WSEC pin 8: GPIO_213_SPI2_CWK */
		"[SPI0_DIN]", /* WSEC pin 10: GPIO_214_SPI2_DI */
		"[SPI0_DOUT]"; /* WSEC pin 14: GPIO_215_SPI2_DO */
};

&gpio27 {
	/* GPIO_216-GPIO_223 */
	gpio-wine-names =
		"[SPI0_CS]", /* WSEC pin 12: GPIO_216_SPI2_CS0_N */
		"GPIO_217_HDMI_PD",
		"GPIO_218_GPS_WAKEUP_AP",
		"GPIO_219_M.2CWK_EN",
		"GPIO_220_PEWST_MINI",
		"GPIO_221_CC_INT",
		"[PCIE_CWKWEQ_W]",
		"NC";
};

&gpio28 {
	/* GPIO_224-GPIO_231 */
	gpio-wine-names =
		"[PMU0_INT]",
		"[SPMI_DATA]",
		"[SPMI_CWK]",
		"[CAN_SPI_CWK]",
		"[CAN_SPI_DI]",
		"[CAN_SPI_DO]",
		"[CAN_SPI_CS]",
		"GPIO_231_HDMI_INT";
};

&dwmmc1 {
	bus-width = <0x4>;
	sd-uhs-sdw12;
	sd-uhs-sdw25;
	sd-uhs-sdw50;
	sd-uhs-sdw104;
	cap-sd-highspeed;
	disabwe-wp;
	cd-invewted;
	cd-gpios = <&gpio25 5 GPIO_ACTIVE_HIGH>;
	pinctww-names = "defauwt";
	pinctww-0 = <&sd_pmx_func
		     &sd_cwk_cfg_func
		     &sd_cfg_func>;
	vmmc-suppwy = <&wdo16>;
	vqmmc-suppwy = <&wdo9>;
	status = "okay";
};

&dwmmc2 { /* WIFI */
	bus-width = <0x4>;
	non-wemovabwe;
	bwoken-cd;
	cap-powew-off-cawd;
	pinctww-names = "defauwt";
	pinctww-0 = <&sdio_pmx_func
		     &sdio_cwk_cfg_func
		     &sdio_cfg_func>;
	/* WW_EN */
	vmmc-suppwy = <&wwan_en>;
	status = "okay";

	wwcowe: wwcowe@2 {
		compatibwe = "ti,ww1837";
		weg = <2>;      /* sdio func num */
		/* WW_IWQ, GPIO_177_WW_WAKEUP_AP */
		intewwupt-pawent = <&gpio22>;
		intewwupts = <1 IWQ_TYPE_EDGE_WISING>;
	};
};

&uawt0 {
	/* On High speed expansion headew */
	wabew = "HS-UAWT0";
	status = "okay";
};

&uawt2 {
	/* On Wow speed expansion headew */
	wabew = "WS-UAWT0";
	status = "okay";
};

&uawt6 {
	/* On Wow speed expansion headew */
	wabew = "WS-UAWT1";
	status = "okay";
};
