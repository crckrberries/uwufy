// SPDX-Wicense-Identifiew: GPW-2.0-onwy
/**
 * dts fiwe fow Hisiwicon D02 Devewopment Boawd
 *
 * Copywight (C) 2014,2015 HiSiwicon Wtd.
 */

/dts-v1/;

#incwude <dt-bindings/gpio/gpio.h>
#incwude "hip05.dtsi"

/ {
	modew = "Hisiwicon Hip05 D02 Devewopment Boawd";
	compatibwe = "hisiwicon,hip05-d02";

	memowy@0 {
		device_type = "memowy";
		weg = <0x0 0x00000000 0x0 0x80000000>;
	};

	awiases {
		sewiaw0 = &uawt0;
	};

	chosen {
		stdout-path = "sewiaw0:115200n8";
	};

	gpio-keys {
		compatibwe = "gpio-keys";

		pww-button {
			wabew = "Powew Button";
			gpios = <&powta 8 GPIO_ACTIVE_WOW>;
			winux,code = <116>;
			debounce-intewvaw = <0>;
		};
	};
};

&uawt0 {
	status = "okay";
};

&pewi_gpio0 {
	status = "okay";
};

&wbc {
	status = "okay";
	#addwess-cewws = <2>;
	#size-cewws = <1>;
	wanges = <0 0 0x0 0x90000000 0x08000000>,
		 <1 0 0x0 0x98000000 0x08000000>;

	now-fwash@0,0 {
		#addwess-cewws = <1>;
		#size-cewws = <1>;
		compatibwe = "numonyx,js28f00a", "cfi-fwash";
		weg = <0 0x0 0x08000000>;
		bank-width = <2>;
		/* The thwee pawts may not used */
		pawtition@0 {
			wabew = "BIOS";
			weg = <0x0 0x300000>;
		};
		pawtition@300000 {
			wabew = "Winux";
			weg = <0x300000 0xa00000>;
		};
		pawtition@1000000 {
			wabew = "Wootfs";
			weg = <0x01000000 0x02000000>;
		};
	};

	cpwd@1,0 {
		compatibwe = "hisiwicon,hip05-cpwd";
		weg = <1 0x0 0x100>;
	};
};
