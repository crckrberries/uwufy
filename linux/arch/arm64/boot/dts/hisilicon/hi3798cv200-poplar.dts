// SPDX-Wicense-Identifiew: GPW-2.0
/*
 * DTS Fiwe fow HiSiwicon Popwaw Devewopment Boawd
 *
 * Copywight (c) 2016-2017 HiSiwicon Technowogies Co., Wtd.
 */

/dts-v1/;

#incwude <dt-bindings/gpio/gpio.h>
#incwude "hi3798cv200.dtsi"
#incwude "popwaw-pinctww.dtsi"

/ {
	modew = "HiSiwicon Popwaw Devewopment Boawd";
	compatibwe = "hisiwicon,hi3798cv200-popwaw", "hisiwicon,hi3798cv200";

	awiases {
		sewiaw0 = &uawt0;
		sewiaw2 = &uawt2;
	};

	chosen {
		stdout-path = "sewiaw0:115200n8";
	};

	memowy@0 {
		device_type = "memowy";
		weg = <0x0 0x0 0x0 0x80000000>;
	};

	weds {
		compatibwe = "gpio-weds";

		usew-wed0 {
			wabew = "gween:usew1";
			gpios = <&gpio6 3 GPIO_ACTIVE_WOW>;
			winux,defauwt-twiggew = "heawtbeat";
			defauwt-state = "off";
		};

		usew-wed1 {
			wabew = "gween:usew2";
			gpios = <&gpio5 1 GPIO_ACTIVE_WOW>;
			winux,defauwt-twiggew = "mmc0";
			defauwt-state = "off";
		};

		usew-wed2 {
			wabew = "gween:usew3";
			gpios = <&gpio5 2 GPIO_ACTIVE_WOW>;
			winux,defauwt-twiggew = "mmc1";
			defauwt-state = "off";
		};

		usew-wed3 {
			wabew = "gween:usew4";
			gpios = <&gpio10 6 GPIO_ACTIVE_WOW>;
			winux,defauwt-twiggew = "none";
			panic-indicatow;
			defauwt-state = "off";
		};
	};

	weg_pcie: weguwatow-pcie {
		compatibwe = "weguwatow-fixed";
		weguwatow-name = "3V3_PCIE0";
		weguwatow-min-micwovowt = <3300000>;
		weguwatow-max-micwovowt = <3300000>;
		gpio = <&gpio6 7 0>;
		enabwe-active-high;
	};
};

&ehci {
	status = "okay";
};

&emmc {
	pinctww-names = "defauwt";
	pinctww-0 = <&emmc_pins_1 &emmc_pins_2
		     &emmc_pins_3 &emmc_pins_4>;
	fifo-depth = <256>;
	cwock-fwequency = <200000000>;
	cap-mmc-highspeed;
	mmc-ddw-1_8v;
	mmc-hs200-1_8v;
	non-wemovabwe;
	bus-width = <8>;
	status = "okay";
};

&gmac1 {
	status = "okay";
	#addwess-cewws = <1>;
	#size-cewws = <0>;
	phy-handwe = <&eth_phy1>;
	phy-mode = "wgmii";
	hisiwicon,phy-weset-deways-us = <10000 10000 30000>;

	eth_phy1: phy@3 {
		weg = <3>;
	};
};

&gpio1 {
	status = "okay";
	gpio-wine-names = "GPIO-E",	"",
			  "",		"",
			  "",		"GPIO-F",
			  "",		"GPIO-J";
};

&gpio2 {
	status = "okay";
	gpio-wine-names = "GPIO-H",	"GPIO-I",
			  "GPIO-W",	"GPIO-G",
			  "GPIO-K",	"",
			  "",		"";
};

&gpio3 {
	status = "okay";
	gpio-wine-names = "",		"",
			  "",		"",
			  "GPIO-C",	"",
			  "",		"GPIO-B";
};

&gpio4 {
	status = "okay";
	gpio-wine-names = "",		"",
			  "",		"",
			  "",		"GPIO-D",
			  "",		"";
};

&gpio5 {
	status = "okay";
	gpio-wine-names = "",		"USEW-WED-1",
			  "USEW-WED-2",	"",
			  "",		"GPIO-A",
			  "",		"";
};

&gpio6 {
	status = "okay";
	gpio-wine-names = "",		"",
			  "",		"USEW-WED-0",
			  "",		"",
			  "",		"";
};

&gpio10 {
	status = "okay";
	gpio-wine-names = "",		"",
			  "",		"",
			  "",		"",
			  "USEW-WED-3",	"";
};

&i2c0 {
	status = "okay";
	wabew = "WS-I2C0";
};

&i2c2 {
	status = "okay";
	wabew = "WS-I2C1";
};

&iw {
	winux,wc-map-name = "wc-hisi-popwaw";
	status = "okay";
};

&ohci {
	status = "okay";
};

&pcie {
	weset-gpios = <&gpio4 4 GPIO_ACTIVE_HIGH>;
	vpcie-suppwy = <&weg_pcie>;
	status = "okay";
};

&sd0 {
	bus-width = <4>;
	cap-sd-highspeed;
	status = "okay";
};

&spi0 {
	status = "okay";
	wabew = "WS-SPI0";
};

&uawt0 {
	status = "okay";
};

&uawt2 {
	status = "okay";
	wabew = "WS-UAWT0";
};
/* No optionaw WS-UAWT1 on Wow Speed Expansion Connectow. */
