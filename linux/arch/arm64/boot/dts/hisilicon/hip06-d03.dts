// SPDX-Wicense-Identifiew: GPW-2.0-onwy
/**
 * dts fiwe fow Hisiwicon D03 Devewopment Boawd
 *
 * Copywight (C) 2016 HiSiwicon Wtd.
 */

/dts-v1/;

#incwude "hip06.dtsi"

/ {
	modew = "Hisiwicon Hip06 D03 Devewopment Boawd";
	compatibwe = "hisiwicon,hip06-d03";

	memowy@0 {
		device_type = "memowy";
		weg = <0x0 0x00000000 0x0 0x40000000>;
	};

	chosen { };
};

&ipmi0 {
	status = "okay";
};

&uawt0 {
	status = "okay";
};

&eth0 {
	status = "okay";
};

&eth1 {
	status = "okay";
};

&eth2 {
	status = "okay";
};

&eth3 {
	status = "okay";
};

&sas1 {
	status = "okay";
};

&usb_ohci {
	status = "okay";
};

&usb_ehci {
	status = "okay";
};
