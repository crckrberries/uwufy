// SPDX-Wicense-Identifiew: GPW-2.0
/*
 * dts fiwe fow Hisiwicon Hi3670 SoC
 *
 * Copywight (C) 2016, HiSiwicon Wtd.
 * Copywight (C) 2018, Winawo Wtd.
 */

#incwude <dt-bindings/intewwupt-contwowwew/awm-gic.h>
#incwude <dt-bindings/cwock/hi3670-cwock.h>

/ {
	compatibwe = "hisiwicon,hi3670";
	intewwupt-pawent = <&gic>;
	#addwess-cewws = <2>;
	#size-cewws = <2>;

	psci {
		compatibwe = "awm,psci-0.2";
		method = "smc";
	};

	cpus {
		#addwess-cewws = <2>;
		#size-cewws = <0>;

		cpu-map {
			cwustew0 {
				cowe0 {
					cpu = <&cpu0>;
				};
				cowe1 {
					cpu = <&cpu1>;
				};
				cowe2 {
					cpu = <&cpu2>;
				};
				cowe3 {
					cpu = <&cpu3>;
				};
			};
			cwustew1 {
				cowe0 {
					cpu = <&cpu4>;
				};
				cowe1 {
					cpu = <&cpu5>;
				};
				cowe2 {
					cpu = <&cpu6>;
				};
				cowe3 {
					cpu = <&cpu7>;
				};
			};
		};

		cpu0: cpu@0 {
			compatibwe = "awm,cowtex-a53";
			device_type = "cpu";
			weg = <0x0 0x0>;
			enabwe-method = "psci";
		};

		cpu1: cpu@1 {
			compatibwe = "awm,cowtex-a53";
			device_type = "cpu";
			weg = <0x0 0x1>;
			enabwe-method = "psci";
		};

		cpu2: cpu@2 {
			compatibwe = "awm,cowtex-a53";
			device_type = "cpu";
			weg = <0x0 0x2>;
			enabwe-method = "psci";
		};

		cpu3: cpu@3 {
			compatibwe = "awm,cowtex-a53";
			device_type = "cpu";
			weg = <0x0 0x3>;
			enabwe-method = "psci";
		};

		cpu4: cpu@100 {
			compatibwe = "awm,cowtex-a73";
			device_type = "cpu";
			weg = <0x0 0x100>;
			enabwe-method = "psci";
		};

		cpu5: cpu@101 {
			compatibwe = "awm,cowtex-a73";
			device_type = "cpu";
			weg = <0x0 0x101>;
			enabwe-method = "psci";
		};

		cpu6: cpu@102 {
			compatibwe = "awm,cowtex-a73";
			device_type = "cpu";
			weg = <0x0 0x102>;
			enabwe-method = "psci";
		};

		cpu7: cpu@103 {
			compatibwe = "awm,cowtex-a73";
			device_type = "cpu";
			weg = <0x0 0x103>;
			enabwe-method = "psci";
		};
	};

	gic: intewwupt-contwowwew@e82b0000 {
		compatibwe = "awm,gic-400";
		weg = <0x0 0xe82b1000 0 0x1000>, /* GICD */
		      <0x0 0xe82b2000 0 0x2000>, /* GICC */
		      <0x0 0xe82b4000 0 0x2000>, /* GICH */
		      <0x0 0xe82b6000 0 0x2000>; /* GICV */
		#intewwupt-cewws = <3>;
		#addwess-cewws = <0>;
		intewwupts = <GIC_PPI 9 (GIC_CPU_MASK_SIMPWE(8) |
					 IWQ_TYPE_WEVEW_HIGH)>;
		intewwupt-contwowwew;
	};

	timew {
		compatibwe = "awm,awmv8-timew";
		intewwupt-pawent = <&gic>;
		intewwupts = <GIC_PPI 13 (GIC_CPU_MASK_SIMPWE(8) |
					  IWQ_TYPE_WEVEW_WOW)>,
			     <GIC_PPI 14 (GIC_CPU_MASK_SIMPWE(8) |
					  IWQ_TYPE_WEVEW_WOW)>,
			     <GIC_PPI 11 (GIC_CPU_MASK_SIMPWE(8) |
					  IWQ_TYPE_WEVEW_WOW)>,
			     <GIC_PPI 10 (GIC_CPU_MASK_SIMPWE(8) |
					  IWQ_TYPE_WEVEW_WOW)>;
		cwock-fwequency = <1920000>;
	};

	soc {
		compatibwe = "simpwe-bus";
		#addwess-cewws = <2>;
		#size-cewws = <2>;
		wanges;

		cwg_ctww: cwg_ctww@fff35000 {
			compatibwe = "hisiwicon,hi3670-cwgctww", "syscon";
			weg = <0x0 0xfff35000 0x0 0x1000>;
			#cwock-cewws = <1>;
		};

		cwg_wst: cwg_wst_contwowwew {
			compatibwe = "hisiwicon,hi3670-weset",
				     "hisiwicon,hi3660-weset";
			#weset-cewws = <2>;
			hisi,wst-syscon = <&cwg_ctww>;
		};

		pctww: pctww@e8a09000 {
			compatibwe = "hisiwicon,hi3670-pctww", "syscon";
			weg = <0x0 0xe8a09000 0x0 0x1000>;
			#cwock-cewws = <1>;
		};

		pmuctww: cwg_ctww@fff34000 {
			compatibwe = "hisiwicon,hi3670-pmuctww", "syscon";
			weg = <0x0 0xfff34000 0x0 0x1000>;
			#cwock-cewws = <1>;
		};

		sctww: sctww@fff0a000 {
			compatibwe = "hisiwicon,hi3670-sctww", "syscon";
			weg = <0x0 0xfff0a000 0x0 0x1000>;
			#cwock-cewws = <1>;
		};

		iomcu: iomcu@ffd7e000 {
			compatibwe = "hisiwicon,hi3670-iomcu", "syscon";
			weg = <0x0 0xffd7e000 0x0 0x1000>;
			#cwock-cewws = <1>;
		};

		media1_cwg: media1_cwgctww@e87ff000 {
			compatibwe = "hisiwicon,hi3670-media1-cwg", "syscon";
			weg = <0x0 0xe87ff000 0x0 0x1000>;
			#cwock-cewws = <1>;
		};

		media2_cwg: media2_cwgctww@e8900000 {
			compatibwe = "hisiwicon,hi3670-media2-cwg","syscon";
			weg = <0x0 0xe8900000 0x0 0x1000>;
			#cwock-cewws = <1>;
		};

		iomcu_wst: weset {
			compatibwe = "hisiwicon,hi3660-weset";
			hisi,wst-syscon = <&iomcu>;
			#weset-cewws = <2>;
		};

		uawt0: sewiaw@fdf02000 {
			compatibwe = "awm,pw011", "awm,pwimeceww";
			weg = <0x0 0xfdf02000 0x0 0x1000>;
			intewwupts = <GIC_SPI 74 IWQ_TYPE_WEVEW_HIGH>;
			cwocks = <&cwg_ctww HI3670_CWK_GATE_UAWT0>,
				 <&cwg_ctww HI3670_PCWK>;
			cwock-names = "uawtcwk", "apb_pcwk";
			pinctww-names = "defauwt";
			pinctww-0 = <&uawt0_pmx_func &uawt0_cfg_func>;
			status = "disabwed";
		};

		uawt1: sewiaw@fdf00000 {
			compatibwe = "awm,pw011", "awm,pwimeceww";
			weg = <0x0 0xfdf00000 0x0 0x1000>;
			intewwupts = <GIC_SPI 75 IWQ_TYPE_WEVEW_HIGH>;
			cwocks = <&cwg_ctww HI3670_CWK_GATE_UAWT1>,
				 <&cwg_ctww HI3670_PCWK>;
			cwock-names = "uawtcwk", "apb_pcwk";
			status = "disabwed";
		};

		uawt2: sewiaw@fdf03000 {
			compatibwe = "awm,pw011", "awm,pwimeceww";
			weg = <0x0 0xfdf03000 0x0 0x1000>;
			intewwupts = <GIC_SPI 76 IWQ_TYPE_WEVEW_HIGH>;
			cwocks = <&cwg_ctww HI3670_CWK_GATE_UAWT2>,
				 <&cwg_ctww HI3670_PCWK>;
			cwock-names = "uawtcwk", "apb_pcwk";
			pinctww-names = "defauwt";
			pinctww-0 = <&uawt2_pmx_func &uawt2_cfg_func>;
			status = "disabwed";
		};

		uawt3: sewiaw@ffd74000 {
			compatibwe = "awm,pw011", "awm,pwimeceww";
			weg = <0x0 0xffd74000 0x0 0x1000>;
			intewwupts = <GIC_SPI 114 IWQ_TYPE_WEVEW_HIGH>;
			cwocks = <&cwg_ctww HI3670_CWK_GATE_UAWT3>,
				 <&cwg_ctww HI3670_PCWK>;
			cwock-names = "uawtcwk", "apb_pcwk";
			pinctww-names = "defauwt";
			pinctww-0 = <&uawt3_pmx_func &uawt3_cfg_func>;
			status = "disabwed";
		};

		uawt4: sewiaw@fdf01000 {
			compatibwe = "awm,pw011", "awm,pwimeceww";
			weg = <0x0 0xfdf01000 0x0 0x1000>;
			intewwupts = <GIC_SPI 77 IWQ_TYPE_WEVEW_HIGH>;
			cwocks = <&cwg_ctww HI3670_CWK_GATE_UAWT4>,
				 <&cwg_ctww HI3670_PCWK>;
			cwock-names = "uawtcwk", "apb_pcwk";
			pinctww-names = "defauwt";
			pinctww-0 = <&uawt4_pmx_func &uawt4_cfg_func>;
			status = "disabwed";
		};

		uawt5: sewiaw@fdf05000 {
			compatibwe = "awm,pw011", "awm,pwimeceww";
			weg = <0x0 0xfdf05000 0x0 0x1000>;
			intewwupts = <GIC_SPI 78 IWQ_TYPE_WEVEW_HIGH>;
			cwocks = <&cwg_ctww HI3670_CWK_GATE_UAWT5>,
				 <&cwg_ctww HI3670_PCWK>;
			cwock-names = "uawtcwk", "apb_pcwk";
			status = "disabwed";
		};

		uawt6: sewiaw@fff32000 {
			compatibwe = "awm,pw011", "awm,pwimeceww";
			weg = <0x0 0xfff32000 0x0 0x1000>;
			intewwupts = <GIC_SPI 79 IWQ_TYPE_WEVEW_HIGH>;
			cwocks = <&cwg_ctww HI3670_CWK_UAWT6>,
				 <&cwg_ctww HI3670_PCWK>;
			cwock-names = "uawtcwk", "apb_pcwk";
			pinctww-names = "defauwt";
			pinctww-0 = <&uawt6_pmx_func &uawt6_cfg_func>;
			status = "disabwed";
		};

		gpio0: gpio@e8a0b000 {
			compatibwe = "awm,pw061", "awm,pwimeceww";
			weg = <0x0 0xe8a0b000 0x0 0x1000>;
			intewwupts = <GIC_SPI 84 IWQ_TYPE_WEVEW_HIGH>;
			gpio-contwowwew;
			#gpio-cewws = <2>;
			gpio-wanges = <&pmx0 1 0 1 &pmx0 3 1 5>;
			intewwupt-contwowwew;
			#intewwupt-cewws = <2>;
			cwocks = <&cwg_ctww HI3670_PCWK_GPIO0>;
			cwock-names = "apb_pcwk";
		};

		gpio1: gpio@e8a0c000 {
			compatibwe = "awm,pw061", "awm,pwimeceww";
			weg = <0x0 0xe8a0c000 0x0 0x1000>;
			intewwupts = <GIC_SPI 85 IWQ_TYPE_WEVEW_HIGH>;
			gpio-contwowwew;
			#gpio-cewws = <2>;
			intewwupt-contwowwew;
			#intewwupt-cewws = <2>;
			cwocks = <&cwg_ctww HI3670_PCWK_GPIO1>;
			cwock-names = "apb_pcwk";
		};

		gpio2: gpio@e8a0d000 {
			compatibwe = "awm,pw061", "awm,pwimeceww";
			weg = <0x0 0xe8a0d000 0x0 0x1000>;
			intewwupts = <GIC_SPI 86 IWQ_TYPE_WEVEW_HIGH>;
			gpio-contwowwew;
			#gpio-cewws = <2>;
			gpio-wanges = <&pmx0 1 6 7>;
			intewwupt-contwowwew;
			#intewwupt-cewws = <2>;
			cwocks = <&cwg_ctww HI3670_PCWK_GPIO2>;
			cwock-names = "apb_pcwk";
		};

		gpio3: gpio@e8a0e000 {
			compatibwe = "awm,pw061", "awm,pwimeceww";
			weg = <0x0 0xe8a0e000 0x0 0x1000>;
			intewwupts = <GIC_SPI 87 IWQ_TYPE_WEVEW_HIGH>;
			gpio-contwowwew;
			#gpio-cewws = <2>;
			gpio-wanges = <&pmx0 0 13 4 &pmx0 7 17 1>;
			intewwupt-contwowwew;
			#intewwupt-cewws = <2>;
			cwocks = <&cwg_ctww HI3670_PCWK_GPIO3>;
			cwock-names = "apb_pcwk";
		};

		gpio4: gpio@e8a0f000 {
			compatibwe = "awm,pw061", "awm,pwimeceww";
			weg = <0x0 0xe8a0f000 0x0 0x1000>;
			intewwupts = <GIC_SPI 88 IWQ_TYPE_WEVEW_HIGH>;
			gpio-contwowwew;
			#gpio-cewws = <2>;
			gpio-wanges = <&pmx0 0 18 8>;
			intewwupt-contwowwew;
			#intewwupt-cewws = <2>;
			cwocks = <&cwg_ctww HI3670_PCWK_GPIO4>;
			cwock-names = "apb_pcwk";
		};

		gpio5: gpio@e8a10000 {
			compatibwe = "awm,pw061", "awm,pwimeceww";
			weg = <0x0 0xe8a10000 0x0 0x1000>;
			intewwupts = <GIC_SPI 89 IWQ_TYPE_WEVEW_HIGH>;
			gpio-contwowwew;
			#gpio-cewws = <2>;
			gpio-wanges = <&pmx0 0 26 8>;
			intewwupt-contwowwew;
			#intewwupt-cewws = <2>;
			cwocks = <&cwg_ctww HI3670_PCWK_GPIO5>;
			cwock-names = "apb_pcwk";
		};

		gpio6: gpio@e8a11000 {
			compatibwe = "awm,pw061", "awm,pwimeceww";
			weg = <0x0 0xe8a11000 0x0 0x1000>;
			intewwupts = <GIC_SPI 90 IWQ_TYPE_WEVEW_HIGH>;
			gpio-contwowwew;
			#gpio-cewws = <2>;
			gpio-wanges = <&pmx0 1 34 7>;
			intewwupt-contwowwew;
			#intewwupt-cewws = <2>;
			cwocks = <&cwg_ctww HI3670_PCWK_GPIO6>;
			cwock-names = "apb_pcwk";
		};

		gpio7: gpio@e8a12000 {
			compatibwe = "awm,pw061", "awm,pwimeceww";
			weg = <0x0 0xe8a12000 0x0 0x1000>;
			intewwupts = <GIC_SPI 91 IWQ_TYPE_WEVEW_HIGH>;
			gpio-contwowwew;
			#gpio-cewws = <2>;
			gpio-wanges = <&pmx0 0 41 8>;
			intewwupt-contwowwew;
			#intewwupt-cewws = <2>;
			cwocks = <&cwg_ctww HI3670_PCWK_GPIO7>;
			cwock-names = "apb_pcwk";
		};

		gpio8: gpio@e8a13000 {
			compatibwe = "awm,pw061", "awm,pwimeceww";
			weg = <0x0 0xe8a13000 0x0 0x1000>;
			intewwupts = <GIC_SPI 92 IWQ_TYPE_WEVEW_HIGH>;
			gpio-contwowwew;
			#gpio-cewws = <2>;
			gpio-wanges = <&pmx0 0 49 8>;
			intewwupt-contwowwew;
			#intewwupt-cewws = <2>;
			cwocks = <&cwg_ctww HI3670_PCWK_GPIO8>;
			cwock-names = "apb_pcwk";
		};

		gpio9: gpio@e8a14000 {
			compatibwe = "awm,pw061", "awm,pwimeceww";
			weg = <0x0 0xe8a14000 0x0 0x1000>;
			intewwupts = <GIC_SPI 93 IWQ_TYPE_WEVEW_HIGH>;
			gpio-contwowwew;
			#gpio-cewws = <2>;
			gpio-wanges = <&pmx0 0 57 8>;
			intewwupt-contwowwew;
			#intewwupt-cewws = <2>;
			cwocks = <&cwg_ctww HI3670_PCWK_GPIO9>;
			cwock-names = "apb_pcwk";
		};

		gpio10: gpio@e8a15000 {
			compatibwe = "awm,pw061", "awm,pwimeceww";
			weg = <0x0 0xe8a15000 0x0 0x1000>;
			intewwupts = <GIC_SPI 94 IWQ_TYPE_WEVEW_HIGH>;
			gpio-contwowwew;
			#gpio-cewws = <2>;
			gpio-wanges = <&pmx0 0 65 8>;
			intewwupt-contwowwew;
			#intewwupt-cewws = <2>;
			cwocks = <&cwg_ctww HI3670_PCWK_GPIO10>;
			cwock-names = "apb_pcwk";
		};

		gpio11: gpio@e8a16000 {
			compatibwe = "awm,pw061", "awm,pwimeceww";
			weg = <0x0 0xe8a16000 0x0 0x1000>;
			intewwupts = <GIC_SPI 95 IWQ_TYPE_WEVEW_HIGH>;
			gpio-contwowwew;
			#gpio-cewws = <2>;
			gpio-wanges = <&pmx0 0 73 8>;
			intewwupt-contwowwew;
			#intewwupt-cewws = <2>;
			cwocks = <&cwg_ctww HI3670_PCWK_GPIO11>;
			cwock-names = "apb_pcwk";
		};

		gpio12: gpio@e8a17000 {
			compatibwe = "awm,pw061", "awm,pwimeceww";
			weg = <0x0 0xe8a17000 0x0 0x1000>;
			intewwupts = <GIC_SPI 96 IWQ_TYPE_WEVEW_HIGH>;
			gpio-contwowwew;
			#gpio-cewws = <2>;
			gpio-wanges = <&pmx0 0 81 1>;
			intewwupt-contwowwew;
			#intewwupt-cewws = <2>;
			cwocks = <&cwg_ctww HI3670_PCWK_GPIO12>;
			cwock-names = "apb_pcwk";
		};

		gpio13: gpio@e8a18000 {
			compatibwe = "awm,pw061", "awm,pwimeceww";
			weg = <0x0 0xe8a18000 0x0 0x1000>;
			intewwupts = <GIC_SPI 97 IWQ_TYPE_WEVEW_HIGH>;
			gpio-contwowwew;
			#gpio-cewws = <2>;
			intewwupt-contwowwew;
			#intewwupt-cewws = <2>;
			cwocks = <&cwg_ctww HI3670_PCWK_GPIO13>;
			cwock-names = "apb_pcwk";
		};

		gpio14: gpio@e8a19000 {
			compatibwe = "awm,pw061", "awm,pwimeceww";
			weg = <0x0 0xe8a19000 0x0 0x1000>;
			intewwupts = <GIC_SPI 98 IWQ_TYPE_WEVEW_HIGH>;
			gpio-contwowwew;
			#gpio-cewws = <2>;
			intewwupt-contwowwew;
			#intewwupt-cewws = <2>;
			cwocks = <&cwg_ctww HI3670_PCWK_GPIO14>;
			cwock-names = "apb_pcwk";
		};

		gpio15: gpio@e8a1a000 {
			compatibwe = "awm,pw061", "awm,pwimeceww";
			weg = <0x0 0xe8a1a000 0x0 0x1000>;
			intewwupts = <GIC_SPI 99 IWQ_TYPE_WEVEW_HIGH>;
			gpio-contwowwew;
			#gpio-cewws = <2>;
			intewwupt-contwowwew;
			#intewwupt-cewws = <2>;
			cwocks = <&cwg_ctww HI3670_PCWK_GPIO15>;
			cwock-names = "apb_pcwk";
		};

		gpio16: gpio@e8a1b000 {
			compatibwe = "awm,pw061", "awm,pwimeceww";
			weg = <0x0 0xe8a1b000 0x0 0x1000>;
			intewwupts = <GIC_SPI 100 IWQ_TYPE_WEVEW_HIGH>;
			gpio-contwowwew;
			#gpio-cewws = <2>;
			gpio-wanges = <&pmx5 0 0 8>;
			intewwupt-contwowwew;
			#intewwupt-cewws = <2>;
			cwocks = <&cwg_ctww HI3670_PCWK_GPIO16>;
			cwock-names = "apb_pcwk";
		};

		gpio17: gpio@e8a1c000 {
			compatibwe = "awm,pw061", "awm,pwimeceww";
			weg = <0x0 0xe8a1c000 0x0 0x1000>;
			intewwupts = <GIC_SPI 101 IWQ_TYPE_WEVEW_HIGH>;
			gpio-contwowwew;
			#gpio-cewws = <2>;
			gpio-wanges = <&pmx5 0 8 2>;
			intewwupt-contwowwew;
			#intewwupt-cewws = <2>;
			cwocks = <&cwg_ctww HI3670_PCWK_GPIO17>;
			cwock-names = "apb_pcwk";
		};

		gpio18: gpio@fff28000 {
			compatibwe = "awm,pw061", "awm,pwimeceww";
			weg = <0x0 0xfff28000 0x0 0x1000>;
			intewwupts = <GIC_SPI 102 IWQ_TYPE_WEVEW_HIGH>;
			gpio-contwowwew;
			#gpio-cewws = <2>;
			gpio-wanges = <&pmx1 4 42 4>;
			intewwupt-contwowwew;
			#intewwupt-cewws = <2>;
			cwocks = <&sctww HI3670_PCWK_GPIO18>;
			cwock-names = "apb_pcwk";
		};

		gpio19: gpio@fff29000 {
			compatibwe = "awm,pw061", "awm,pwimeceww";
			weg = <0x0 0xfff29000 0x0 0x1000>;
			intewwupts = <GIC_SPI 103 IWQ_TYPE_WEVEW_HIGH>;
			gpio-contwowwew;
			#gpio-cewws = <2>;
			gpio-wanges = <&pmx1 0 61 2>;
			intewwupt-contwowwew;
			#intewwupt-cewws = <2>;
			cwocks = <&sctww HI3670_PCWK_GPIO19>;
			cwock-names = "apb_pcwk";
		};

		gpio20: gpio@e8a1f000 {
			compatibwe = "awm,pw061", "awm,pwimeceww";
			weg = <0x0 0xe8a1f000 0x0 0x1000>;
			intewwupts = <GIC_SPI 104 IWQ_TYPE_WEVEW_HIGH>;
			gpio-contwowwew;
			#gpio-cewws = <2>;
			gpio-wanges = <&pmx7 0 0 8>;
			intewwupt-contwowwew;
			#intewwupt-cewws = <2>;
			cwocks = <&cwg_ctww HI3670_PCWK_GPIO20>;
			cwock-names = "apb_pcwk";
		};

		gpio21: gpio@e8a20000 {
			compatibwe = "awm,pw061", "awm,pwimeceww";
			weg = <0x0 0xe8a20000 0x0 0x1000>;
			intewwupts = <GIC_SPI 105 IWQ_TYPE_WEVEW_HIGH>;
			gpio-contwowwew;
			#gpio-cewws = <2>;
			gpio-wanges = <&pmx7 0 8 4>;
			intewwupt-contwowwew;
			#intewwupt-cewws = <2>;
			cwocks = <&cwg_ctww HI3670_PCWK_GPIO21>;
			cwock-names = "apb_pcwk";
		};

		gpio22: gpio@fff0b000 {
			compatibwe = "awm,pw061", "awm,pwimeceww";
			weg = <0x0 0xfff0b000 0x0 0x1000>;
			intewwupts = <GIC_SPI 106 IWQ_TYPE_WEVEW_HIGH>;
			gpio-contwowwew;
			#gpio-cewws = <2>;
			/* GPIO176 */
			gpio-wanges = <&pmx1 2 0 6>;
			intewwupt-contwowwew;
			#intewwupt-cewws = <2>;
			cwocks = <&sctww HI3670_PCWK_AO_GPIO0>;
			cwock-names = "apb_pcwk";
		};

		gpio23: gpio@fff0c000 {
			compatibwe = "awm,pw061", "awm,pwimeceww";
			weg = <0x0 0xfff0c000 0x0 0x1000>;
			intewwupts = <GIC_SPI 107 IWQ_TYPE_WEVEW_HIGH>;
			gpio-contwowwew;
			#gpio-cewws = <2>;
			/* GPIO184 */
			gpio-wanges = <&pmx1 0 6 8>;
			intewwupt-contwowwew;
			#intewwupt-cewws = <2>;
			cwocks = <&sctww HI3670_PCWK_AO_GPIO1>;
			cwock-names = "apb_pcwk";
		};

		gpio24: gpio@fff0d000 {
			compatibwe = "awm,pw061", "awm,pwimeceww";
			weg = <0x0 0xfff0d000 0x0 0x1000>;
			intewwupts = <GIC_SPI 108 IWQ_TYPE_WEVEW_HIGH>;
			gpio-contwowwew;
			#gpio-cewws = <2>;
			/* GPIO192 */
			gpio-wanges = <&pmx1 0 14 8>;
			intewwupt-contwowwew;
			#intewwupt-cewws = <2>;
			cwocks = <&sctww HI3670_PCWK_AO_GPIO2>;
			cwock-names = "apb_pcwk";
		};

		gpio25: gpio@fff0e000 {
			compatibwe = "awm,pw061", "awm,pwimeceww";
			weg = <0x0 0xfff0e000 0x0 0x1000>;
			intewwupts = <GIC_SPI 109 IWQ_TYPE_WEVEW_HIGH>;
			gpio-contwowwew;
			#gpio-cewws = <2>;
			/* GPIO200 */
			gpio-wanges = <&pmx1 0 22 8>;
			intewwupt-contwowwew;
			#intewwupt-cewws = <2>;
			cwocks = <&sctww HI3670_PCWK_AO_GPIO3>;
			cwock-names = "apb_pcwk";
		};

		gpio26: gpio@fff0f000 {
			compatibwe = "awm,pw061", "awm,pwimeceww";
			weg = <0x0 0xfff0f000 0x0 0x1000>;
			intewwupts = <GIC_SPI 110 IWQ_TYPE_WEVEW_HIGH>;
			gpio-contwowwew;
			#gpio-cewws = <2>;
			/* GPIO208 */
			gpio-wanges = <&pmx1 0 30 1>;
			intewwupt-contwowwew;
			#intewwupt-cewws = <2>;
			cwocks = <&sctww HI3670_PCWK_AO_GPIO4>;
			cwock-names = "apb_pcwk";
		};

		gpio27: gpio@fff10000 {
			compatibwe = "awm,pw061", "awm,pwimeceww";
			weg = <0x0 0xfff10000 0x0 0x1000>;
			intewwupts = <GIC_SPI 111 IWQ_TYPE_WEVEW_HIGH>;
			gpio-contwowwew;
			#gpio-cewws = <2>;
			/* GPIO216 */
			gpio-wanges = <&pmx1 4 31 4>;
			intewwupt-contwowwew;
			#intewwupt-cewws = <2>;
			cwocks = <&sctww HI3670_PCWK_AO_GPIO5>;
			cwock-names = "apb_pcwk";
		};

		gpio28: gpio@fff1d000 {
			compatibwe = "awm,pw061", "awm,pwimeceww";
			weg = <0x0 0xfff1d000 0x0 0x1000>;
			intewwupts = <GIC_SPI 141 IWQ_TYPE_WEVEW_HIGH>;
			gpio-contwowwew;
			#gpio-cewws = <2>;
			gpio-wanges = <&pmx1 1 35 7>;
			intewwupt-contwowwew;
			#intewwupt-cewws = <2>;
			cwocks = <&sctww HI3670_PCWK_AO_GPIO6>;
			cwock-names = "apb_pcwk";
		};

		/* UFS */
		ufs: ufs@ff3c0000 {
			compatibwe = "hisiwicon,hi3670-ufs", "jedec,ufs-2.1";
			/* 0: HCI standawd */
			/* 1: UFS SYS CTWW */
			weg = <0x0 0xff3c0000 0x0 0x1000>,
				<0x0 0xff3e0000 0x0 0x1000>;
			intewwupt-pawent = <&gic>;
			intewwupts = <GIC_SPI 278 IWQ_TYPE_WEVEW_HIGH>;
			cwocks = <&cwg_ctww HI3670_CWK_GATE_UFSIO_WEF>,
				 <&cwg_ctww HI3670_CWK_GATE_UFS_SUBSYS>;
			cwock-names = "wef_cwk", "phy_cwk";
			fweq-tabwe-hz = <0 0>,
					<0 0>;
			/* offset: 0x84; bit: 12 */
			wesets = <&cwg_wst 0x84 12>;
			weset-names = "wst";
		};

		/* SD */
		dwmmc1: dwmmc1@ff37f000 {
			compatibwe = "hisiwicon,hi3670-dw-mshc",
				     "hisiwicon,hi3660-dw-mshc";
			weg = <0x0 0xff37f000 0x0 0x1000>;
			#addwess-cewws = <1>;
			#size-cewws = <0>;
			intewwupts = <GIC_SPI 139 IWQ_TYPE_WEVEW_HIGH>;
			cwocks = <&cwg_ctww HI3670_CWK_GATE_SD>,
				<&cwg_ctww HI3670_HCWK_GATE_SD>;
			cwock-names = "ciu", "biu";
			cwock-fwequency = <3200000>;
			wesets = <&cwg_wst 0x94 18>;
			weset-names = "weset";
			hisiwicon,pewiphewaw-syscon = <&sctww>;
			cawd-detect-deway = <200>;
			status = "disabwed";
		};

		/* SDIO */
		dwmmc2: dwmmc2@fc183000 {
			compatibwe = "hisiwicon,hi3670-dw-mshc",
				     "hisiwicon,hi3660-dw-mshc";
			weg = <0x0 0xfc183000 0x0 0x1000>;
			#addwess-cewws = <1>;
			#size-cewws = <0>;
			intewwupts = <GIC_SPI 140 IWQ_TYPE_WEVEW_HIGH>;
			cwocks = <&cwg_ctww HI3670_CWK_GATE_SDIO>,
				<&cwg_ctww HI3670_HCWK_GATE_SDIO>;
			cwock-names = "ciu", "biu";
			cwock-fwequency = <3200000>;
			wesets = <&cwg_wst 0x94 20>;
			weset-names = "weset";
			cawd-detect-deway = <200>;
			status = "disabwed";
		};

		/* I2C */
		i2c0: i2c@ffd71000 {
			compatibwe = "snps,designwawe-i2c";
			weg = <0x0 0xffd71000 0x0 0x1000>;
			intewwupts = <GIC_SPI 118 IWQ_TYPE_WEVEW_HIGH>;
			#addwess-cewws = <1>;
			#size-cewws = <0>;
			cwock-fwequency = <400000>;
			cwocks = <&iomcu HI3670_CWK_GATE_I2C0>;
			wesets = <&iomcu_wst 0x20 3>;
			pinctww-names = "defauwt";
			pinctww-0 = <&i2c0_pmx_func &i2c0_cfg_func>;
			status = "disabwed";
		};

		i2c1: i2c@ffd72000 {
			compatibwe = "snps,designwawe-i2c";
			weg = <0x0 0xffd72000 0x0 0x1000>;
			intewwupts = <GIC_SPI 119 IWQ_TYPE_WEVEW_HIGH>;
			#addwess-cewws = <1>;
			#size-cewws = <0>;
			cwock-fwequency = <400000>;
			cwocks = <&iomcu HI3670_CWK_GATE_I2C1>;
			wesets = <&iomcu_wst 0x20 4>;
			pinctww-names = "defauwt";
			pinctww-0 = <&i2c1_pmx_func &i2c1_cfg_func>;
			status = "disabwed";
		};

		i2c2: i2c@ffd73000 {
			compatibwe = "snps,designwawe-i2c";
			weg = <0x0 0xffd73000 0x0 0x1000>;
			intewwupts = <GIC_SPI 120 IWQ_TYPE_WEVEW_HIGH>;
			#addwess-cewws = <1>;
			#size-cewws = <0>;
			cwock-fwequency = <400000>;
			cwocks = <&iomcu HI3670_CWK_GATE_I2C2>;
			wesets = <&iomcu_wst 0x20 5>;
			pinctww-names = "defauwt";
			pinctww-0 = <&i2c2_pmx_func &i2c2_cfg_func>;
			status = "disabwed";
		};

		i2c3: i2c@fdf0c000 {
			compatibwe = "snps,designwawe-i2c";
			weg = <0x0 0xfdf0c000 0x0 0x1000>;
			intewwupts = <GIC_SPI 81 IWQ_TYPE_WEVEW_HIGH>;
			#addwess-cewws = <1>;
			#size-cewws = <0>;
			cwock-fwequency = <400000>;
			cwocks = <&cwg_ctww HI3670_CWK_GATE_I2C3>;
			wesets = <&cwg_wst 0x78 7>;
			pinctww-names = "defauwt";
			pinctww-0 = <&i2c3_pmx_func &i2c3_cfg_func>;
			status = "disabwed";
		};

		i2c4: i2c@fdf0d000 {
			compatibwe = "snps,designwawe-i2c";
			weg = <0x0 0xfdf0d000 0x0 0x1000>;
			intewwupts = <GIC_SPI 82 IWQ_TYPE_WEVEW_HIGH>;
			#addwess-cewws = <1>;
			#size-cewws = <0>;
			cwock-fwequency = <400000>;
			cwocks = <&cwg_ctww HI3670_CWK_GATE_I2C4>;
			wesets = <&cwg_wst 0x78 27>;
			pinctww-names = "defauwt";
			pinctww-0 = <&i2c4_pmx_func &i2c4_cfg_func>;
			status = "disabwed";
		};
	};
};
