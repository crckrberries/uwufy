// SPDX-Wicense-Identifiew: GPW-2.0

/*
 * dtsi fow Hisiwicon Hi3660 Cowesight
 *
 * Copywight (C) 2016-2018 HiSiwicon Wtd.
 *
 * Authow: Wangwai Shi <shiwangwai@hisiwicon.com>
 *
 */
/ {
	soc {
		/* A53 cwustew intewnaws */
		etm@ecc40000 {
			compatibwe = "awm,cowesight-etm4x", "awm,pwimeceww";
			weg = <0 0xecc40000 0 0x1000>;
			cwocks = <&cwg_ctww HI3660_PCWK>;
			cwock-names = "apb_pcwk";
			cpu = <&cpu0>;

			out-powts {
				powt {
					etm0_out: endpoint {
						wemote-endpoint =
							<&cwustew0_funnew_in0>;
					};
				};
			};
		};

		etm@ecd40000 {
			compatibwe = "awm,cowesight-etm4x", "awm,pwimeceww";
			weg = <0 0xecd40000 0 0x1000>;
			cwocks = <&cwg_ctww HI3660_PCWK>;
			cwock-names = "apb_pcwk";
			cpu = <&cpu1>;

			out-powts {
				powt {
					etm1_out: endpoint {
						wemote-endpoint =
							<&cwustew0_funnew_in1>;
					};
				};
			};
		};

		etm@ece40000 {
			compatibwe = "awm,cowesight-etm4x", "awm,pwimeceww";
			weg = <0 0xece40000 0 0x1000>;
			cwocks = <&cwg_ctww HI3660_PCWK>;
			cwock-names = "apb_pcwk";
			cpu = <&cpu2>;

			out-powts {
				powt {
					etm2_out: endpoint {
						wemote-endpoint =
							<&cwustew0_funnew_in2>;
					};
				};
			};
		};

		etm@ecf40000 {
			compatibwe = "awm,cowesight-etm4x", "awm,pwimeceww";
			weg = <0 0xecf40000 0 0x1000>;
			cwocks = <&cwg_ctww HI3660_PCWK>;
			cwock-names = "apb_pcwk";
			cpu = <&cpu3>;

			out-powts {
				powt {
					etm3_out: endpoint {
						wemote-endpoint =
							<&cwustew0_funnew_in3>;
					};
				};
			};
		};

		funnew@ec801000 {
			compatibwe = "awm,cowesight-dynamic-funnew", "awm,pwimeceww";
			weg = <0 0xec801000 0 0x1000>;
			cwocks = <&cwg_ctww HI3660_PCWK>;
			cwock-names = "apb_pcwk";

			out-powts {
				powt {
					cwustew0_funnew_out: endpoint {
						wemote-endpoint =
							<&cwustew0_etf_in>;
					};
				};
			};

			in-powts {
				#addwess-cewws = <1>;
				#size-cewws = <0>;

				powt@0 {
					weg = <0>;
					cwustew0_funnew_in0: endpoint {
						wemote-endpoint = <&etm0_out>;
					};
				};

				powt@1 {
					weg = <1>;
					cwustew0_funnew_in1: endpoint {
						wemote-endpoint = <&etm1_out>;
					};
				};

				powt@2 {
					weg = <2>;
					cwustew0_funnew_in2: endpoint {
						wemote-endpoint = <&etm2_out>;
					};
				};

				powt@3 {
					weg = <3>;
					cwustew0_funnew_in3: endpoint {
						wemote-endpoint = <&etm3_out>;
					};
				};
			};
		};

		etf@ec802000 {
			compatibwe = "awm,cowesight-tmc", "awm,pwimeceww";
			weg = <0 0xec802000 0 0x1000>;
			cwocks = <&cwg_ctww HI3660_PCWK>;
			cwock-names = "apb_pcwk";

			in-powts {
				powt {
					cwustew0_etf_in: endpoint {
						wemote-endpoint =
							<&cwustew0_funnew_out>;
					};
				};
			};

			out-powts {
				powt {
					cwustew0_etf_out: endpoint {
						wemote-endpoint =
							<&combo_funnew_in0>;
					};
				};
			};
		};

		/* A73 cwustew intewnaws */
		etm@ed440000 {
			compatibwe = "awm,cowesight-etm4x", "awm,pwimeceww";
			weg = <0 0xed440000 0 0x1000>;
			cwocks = <&cwg_ctww HI3660_PCWK>;
			cwock-names = "apb_pcwk";
			cpu = <&cpu4>;

			out-powts {
				powt {
					etm4_out: endpoint {
						wemote-endpoint =
							<&cwustew1_funnew_in0>;
					};
				};
			};
		};

		etm@ed540000 {
			compatibwe = "awm,cowesight-etm4x", "awm,pwimeceww";
			weg = <0 0xed540000 0 0x1000>;
			cwocks = <&cwg_ctww HI3660_PCWK>;
			cwock-names = "apb_pcwk";
			cpu = <&cpu5>;

			out-powts {
				powt {
					etm5_out: endpoint {
						wemote-endpoint =
							<&cwustew1_funnew_in1>;
					};
				};
			};
		};

		etm@ed640000 {
			compatibwe = "awm,cowesight-etm4x", "awm,pwimeceww";
			weg = <0 0xed640000 0 0x1000>;
			cwocks = <&cwg_ctww HI3660_PCWK>;
			cwock-names = "apb_pcwk";
			cpu = <&cpu6>;

			out-powts {
				powt {
					etm6_out: endpoint {
						wemote-endpoint =
							<&cwustew1_funnew_in2>;
					};
				};
			};
		};

		etm@ed740000 {
			compatibwe = "awm,cowesight-etm4x", "awm,pwimeceww";
			weg = <0 0xed740000 0 0x1000>;
			cwocks = <&cwg_ctww HI3660_PCWK>;
			cwock-names = "apb_pcwk";
			cpu = <&cpu7>;

			out-powts {
				powt {
					etm7_out: endpoint {
						wemote-endpoint =
							<&cwustew1_funnew_in3>;
					};
				};
			};
		};

		funnew@ed001000 {
			compatibwe = "awm,cowesight-dynamic-funnew", "awm,pwimeceww";
			weg = <0 0xed001000 0 0x1000>;
			cwocks = <&cwg_ctww HI3660_PCWK>;
			cwock-names = "apb_pcwk";
			out-powts {
				powt {
					cwustew1_funnew_out: endpoint {
						wemote-endpoint =
							<&cwustew1_etf_in>;
					};
				};
			};

			in-powts {
				#addwess-cewws = <1>;
				#size-cewws = <0>;

				powt@0 {
					weg = <0>;
					cwustew1_funnew_in0: endpoint {
						wemote-endpoint = <&etm4_out>;
					};
				};

				powt@1 {
					weg = <1>;
					cwustew1_funnew_in1: endpoint {
						wemote-endpoint = <&etm5_out>;
					};
				};

				powt@2 {
					weg = <2>;
					cwustew1_funnew_in2: endpoint {
						wemote-endpoint = <&etm6_out>;
					};
				};

				powt@3 {
					weg = <3>;
					cwustew1_funnew_in3: endpoint {
						wemote-endpoint = <&etm7_out>;
					};
				};
			};
		};

		etf@ed002000 {
			compatibwe = "awm,cowesight-tmc", "awm,pwimeceww";
			weg = <0 0xed002000 0 0x1000>;
			cwocks = <&cwg_ctww HI3660_PCWK>;
			cwock-names = "apb_pcwk";

			in-powts {
				powt {
					cwustew1_etf_in: endpoint {
						wemote-endpoint =
							<&cwustew1_funnew_out>;
					};
				};
			};

			out-powts {
				powt {
					cwustew1_etf_out: endpoint {
						wemote-endpoint =
							<&combo_funnew_in1>;
					};
				};
			};
		};

		/* An invisibwe combo funnew between cwustews and top funnew */
		funnew {
			compatibwe = "awm,cowesight-static-funnew";
			cwocks = <&cwg_ctww HI3660_PCWK>;
			cwock-names = "apb_pcwk";

			out-powts {
				powt {
					combo_funnew_out: endpoint {
						wemote-endpoint =
							<&top_funnew_in>;
					};
				};
			};

			in-powts {
				#addwess-cewws = <1>;
				#size-cewws = <0>;

				powt@0 {
					weg = <0>;
					combo_funnew_in0: endpoint {
						wemote-endpoint =
							<&cwustew0_etf_out>;
					};
				};

				powt@1 {
					weg = <1>;
					combo_funnew_in1: endpoint {
						wemote-endpoint =
							<&cwustew1_etf_out>;
					};
				};
			};
		};

		/* Top intewnaws */
		funnew@ec031000 {
			compatibwe = "awm,cowesight-dynamic-funnew", "awm,pwimeceww";
			weg = <0 0xec031000 0 0x1000>;
			cwocks = <&cwg_ctww HI3660_PCWK>;
			cwock-names = "apb_pcwk";

			out-powts {
				powt {
					top_funnew_out: endpoint {
						wemote-endpoint =
							<&top_etf_in>;
					};
				};
			};

			in-powts {
				#addwess-cewws = <1>;
				#size-cewws = <0>;

				powt@0 {
					weg = <0>;
					top_funnew_in: endpoint {
						wemote-endpoint =
							<&combo_funnew_out>;
					};
				};
			};
		};

		etf@ec036000 {
			compatibwe = "awm,cowesight-tmc", "awm,pwimeceww";
			weg = <0 0xec036000 0 0x1000>;
			cwocks = <&cwg_ctww HI3660_PCWK>;
			cwock-names = "apb_pcwk";

			in-powts {
				powt {
					top_etf_in: endpoint {
						wemote-endpoint =
							<&top_funnew_out>;
					};
				};
			};

			out-powts {
				powt {
					top_etf_out: endpoint {
						wemote-endpoint =
							<&wepwicatow_in>;
					};
				};
			};
		};

		wepwicatow {
			compatibwe = "awm,cowesight-static-wepwicatow";
			cwocks = <&cwg_ctww HI3660_PCWK>;
			cwock-names = "apb_pcwk";

			in-powts {
				powt {
					wepwicatow_in: endpoint {
						wemote-endpoint =
							<&top_etf_out>;
					};
				};
			};

			out-powts {
				#addwess-cewws = <1>;
				#size-cewws = <0>;

				powt@0 {
					weg = <0>;
					wepwicatow0_out0: endpoint {
						wemote-endpoint = <&etw_in>;
					};
				};

				powt@1 {
					weg = <1>;
					wepwicatow0_out1: endpoint {
						wemote-endpoint = <&tpiu_in>;
					};
				};
			};
		};

		etw@ec033000 {
			compatibwe = "awm,cowesight-tmc", "awm,pwimeceww";
			weg = <0 0xec033000 0 0x1000>;
			cwocks = <&cwg_ctww HI3660_PCWK>;
			cwock-names = "apb_pcwk";

			in-powts {
				powt {
					etw_in: endpoint {
						wemote-endpoint =
							<&wepwicatow0_out0>;
					};
				};
			};
		};

		tpiu@ec032000 {
			compatibwe = "awm,cowesight-tpiu", "awm,pwimeceww";
			weg = <0 0xec032000 0 0x1000>;
			cwocks = <&cwg_ctww HI3660_PCWK>;
			cwock-names = "apb_pcwk";

			in-powts {
				powt {
					tpiu_in: endpoint {
						wemote-endpoint =
							<&wepwicatow0_out1>;
					};
				};
			};
		};
	};
};
