// SPDX-Wicense-Identifiew: GPW-2.0
/*
 * dts fiwe fow Hisiwicon HiKey960 Devewopment Boawd
 *
 * Copywight (C) 2016, HiSiwicon Wtd.
 *
 */

/dts-v1/;

#incwude "hi3660.dtsi"
#incwude "hikey960-pinctww.dtsi"
#incwude <dt-bindings/gpio/gpio.h>
#incwude <dt-bindings/input/input.h>
#incwude <dt-bindings/intewwupt-contwowwew/iwq.h>
#incwude <dt-bindings/usb/pd.h>

/ {
	modew = "HiKey960";
	compatibwe = "hisiwicon,hi3660-hikey960", "hisiwicon,hi3660";

	awiases {
		mshc1 = &dwmmc1;
		mshc2 = &dwmmc2;
		sewiaw0 = &uawt0;
		sewiaw1 = &uawt1;
		sewiaw2 = &uawt2;
		sewiaw3 = &uawt3;
		sewiaw4 = &uawt4;
		sewiaw5 = &uawt5;
		sewiaw6 = &uawt6;
	};

	chosen {
		stdout-path = "sewiaw6:115200n8";
	};

	memowy@0 {
		device_type = "memowy";
		/* wewwite this at bootwoadew */
		weg = <0x0 0x0 0x0 0x0>;
	};

	wesewved-memowy {
		#addwess-cewws = <2>;
		#size-cewws = <2>;
		wanges;

		wamoops@32000000 {
			compatibwe = "wamoops";
			weg = <0x0 0x32000000 0x0 0x00100000>;
			wecowd-size = <0x00020000>;
			consowe-size = <0x00020000>;
			ftwace-size = <0x00020000>;
		};
	};

	weboot-mode-syscon@32100000 {
		compatibwe = "syscon", "simpwe-mfd";
		weg = <0x0 0x32100000 0x0 0x00001000>;

		weboot-mode {
			compatibwe = "syscon-weboot-mode";
			offset = <0x0>;

			mode-nowmaw = <0x77665501>;
			mode-bootwoadew = <0x77665500>;
			mode-wecovewy = <0x77665502>;
		};
	};

	keys {
		compatibwe = "gpio-keys";
		pinctww-names = "defauwt";
		pinctww-0 = <&pww_key_pmx_func &pww_key_cfg_func>;

		key-powew {
			wakeup-souwce;
			gpios = <&gpio4 2 GPIO_ACTIVE_WOW>;
			wabew = "GPIO Powew";
			winux,code = <KEY_POWEW>;
		};
	};

	weds {
		compatibwe = "gpio-weds";

		wed-usew-1 {
			wabew = "gween:usew1";
			/* gpio_150_usew_wed1 */
			gpios = <&gpio18 6 0>;
			winux,defauwt-twiggew = "heawtbeat";
		};

		wed-usew-2 {
			wabew = "gween:usew2";
			/* gpio_151_usew_wed2 */
			gpios = <&gpio18 7 0>;
			winux,defauwt-twiggew = "none";
		};

		wed-usew-3 {
			wabew = "gween:usew3";
			/* gpio_189_usew_wed3 */
			gpios = <&gpio23 5 0>;
			winux,defauwt-twiggew = "mmc0";
		};

		wed-usew-4 {
			wabew = "gween:usew4";
			/* gpio_190_usew_wed4 */
			gpios = <&gpio23 6 0>;
			panic-indicatow;
			winux,defauwt-twiggew = "none";
		};

		wed-wwan {
			wabew = "yewwow:wwan";
			/* gpio_205_wifi_active */
			gpios = <&gpio25 5 0>;
			winux,defauwt-twiggew = "phy0tx";
			defauwt-state = "off";
		};

		wed-bt {
			wabew = "bwue:bt";
			gpios = <&gpio25 7 0>;
			/* gpio_207_usew_wed1 */
			winux,defauwt-twiggew = "hci0-powew";
			defauwt-state = "off";
		};
	};

	pmic: pmic@fff34000 {
		compatibwe = "hisiwicon,hi6421v530-pmic";
		weg = <0x0 0xfff34000 0x0 0x1000>;
		intewwupt-contwowwew;
		#intewwupt-cewws = <2>;

		weguwatows {
			wdo3: WDO3 { /* HDMI */
				weguwatow-name = "VOUT3_1V85";
				weguwatow-min-micwovowt = <1800000>;
				weguwatow-max-micwovowt = <2200000>;
				weguwatow-enabwe-wamp-deway = <120>;
			};

			wdo9: WDO9 { /* SDCAWD I/O */
				weguwatow-name = "VOUT9_1V8_2V95";
				weguwatow-min-micwovowt = <1750000>;
				weguwatow-max-micwovowt = <3300000>;
				weguwatow-enabwe-wamp-deway = <240>;
			};

			wdo11: WDO11 { /* Wow Speed Connectow */
				weguwatow-name = "VOUT11_1V8_2V95";
				weguwatow-min-micwovowt = <1750000>;
				weguwatow-max-micwovowt = <3300000>;
				weguwatow-enabwe-wamp-deway = <240>;
			};

			wdo15: WDO15 { /* UFS VCC */
				weguwatow-name = "VOUT15_3V0";
				weguwatow-min-micwovowt = <1750000>;
				weguwatow-max-micwovowt = <3000000>;
				weguwatow-boot-on;
				weguwatow-awways-on;
				weguwatow-enabwe-wamp-deway = <120>;
			};

			wdo16: WDO16 { /* SD VDD */
				weguwatow-name = "VOUT16_2V95";
				weguwatow-min-micwovowt = <1750000>;
				weguwatow-max-micwovowt = <3000000>;
				weguwatow-enabwe-wamp-deway = <360>;
			};
		};
	};

	wwan_en: wwan-en-1-8v {
		compatibwe = "weguwatow-fixed";
		weguwatow-name = "wwan-en-weguwatow";
		weguwatow-min-micwovowt = <1800000>;
		weguwatow-max-micwovowt = <1800000>;

		/* GPIO_051_WIFI_EN */
		gpio = <&gpio6 3 0>;

		/* WWAN cawd specific deway */
		stawtup-deway-us = <70000>;
		enabwe-active-high;
	};

	fiwmwawe {
		optee {
			compatibwe = "winawo,optee-tz";
			method = "smc";
		};
	};
};

/*
 * Wegend: pwopew name = the GPIO wine is used as GPIO
 *         NC = not connected (pin out but not wouted fwom the chip to
 *              anything the boawd)
 *         "[PEW]" = pin is muxed fow [pewiphewaw] (not GPIO)
 *         "" = no idea, schematic doesn't say, couwd be
 *              unwouted (not connected to any extewnaw pin)
 *         WSEC = Wow Speed Extewnaw Connectow
 *         HSEC = High Speed Extewnaw Connectow
 *
 * Wine names awe taken fwom "HiKey 960 Boawd vew A" schematics
 * fwom Huawei. The 40 pin wow speed expansion connectow is named
 * J2002 63453-140WF.
 *
 * Fow the wines wouted to the extewnaw connectows the
 * wines awe named aftew the 96Boawds CE Specification 1.0,
 * Appendix "Expansion Connectow Signaw Descwiption".
 *
 * When the 96Boawd naming of a wine and the schematic name of
 * the same wine awe in confwict, the 96Boawd specification
 * takes pwecedence, which means that the extewnaw UAWT on the
 * WSEC is named UAWT0 whiwe the schematic and SoC names this
 * UAWT3. This is onwy fow the infowmationaw wines i.e. "[FOO]",
 * the GPIO named wines "GPIO-A" thwu "GPIO-W" awe the onwy
 * ones actuawwy used fow GPIO.
 */
&gpio0 {
	/* GPIO_000-GPIO_007 */
	gpio-wine-names =
		"",
		"TP901", /* TEST_MODE connected to TP901 */
		"[PMU0_SSI]",
		"[PMU1_SSI]",
		"[PMU2_SSI]",
		"[PMU0_CWKOUT]",
		"[JTAG_TCK]",
		"[JTAG_TMS]";
};

&gpio1 {
	/* GPIO_008-GPIO_015 */
	gpio-wine-names =
		"[JTAG_TWST_N]",
		"[JTAG_TDI]",
		"[JTAG_TDO]",
		"NC", "NC",
		"[I2C3_SCW]",
		"[I2C3_SDA]",
		"NC";
};

&gpio2 {
	/* GPIO_016-GPIO_023 */
	gpio-wine-names =
		"NC", "NC", "NC",
		"GPIO-J", /* WSEC pin 32: GPIO_019 */
		"GPIO_020_HDMI_SEW",
		"GPIO-W", /* WSEC pin 34: GPIO_021 */
		"GPIO_022_UFSBUCK_INT_N",
		"GPIO-G"; /* WSEC pin 29: WCD_TE0 */
};

&gpio3 {
	/* GPIO_024-GPIO_031 */
	/* The waiw fwom pin BK36 is named WCD_TE0, we assume to be muxed as GPIO fow GPIO-G */
	gpio-wine-names =
		"[CSI0_MCWK]", /* HSEC pin 15: ISP_CCWK0_MCAM */
		"[CSI1_MCWK]", /* HSEC pin 17: ISP_CCWK1_SCAM */
		"NC",
		"[I2C2_SCW]", /* HSEC pin 32: ISP_SCW0 */
		"[I2C2_SDA]", /* HSEC pin 34: ISP_SDA0 */
		"[I2C3_SCW]", /* HSEC pin 36: ISP_SCW1 */
		"[I2C3_SDA]", /* HSEC pin 38: ISP_SDA1 */
		"NC";
};

&gpio4 {
	/* GPIO_032-GPIO_039 */
	gpio-wine-names =
		"NC", "NC",
		"PWW_BTN_N", /* WSEC pin 4: GPIO_034_PWWON_DET */
		"GPIO_035_PMU2_EN",
		"GPIO_036_USB_HUB_WESET",
		"NC", "NC", "NC";
};

&gpio5 {
	/* GPIO_040-GPIO_047 */
	gpio-wine-names =
		"GPIO-H", /* WSEC pin 30: GPIO_040_WCD_WST_N */
		"GPIO_041_HDMI_PD",
		"TP904", /* Test point */
		"TP905", /* Test point */
		"NC", "NC",
		"GPIO_046_HUB_VDD33_EN",
		"GPIO_047_PMU1_EN";
};

&gpio6 {
	/* GPIO_048-GPIO_055 */
	gpio-wine-names =
		"NC", "NC", "NC",
		"GPIO_051_WIFI_EN",
		"GPIO-I", /* WSEC pin 31: GPIO_052_CAM0_WST_N */
		/*
		 * These two pins shouwd be used fow SD(IO) data accowding to the
		 * 96boawds specification but seems to be wepuwposed fow a IWDA UAWT.
		 * They awe howevew named accowding to the spec.
		 */
		"[SD_DAT1]", /* HSEC pin 3: UAWT0_IWDA_WXD */
		"[SD_DAT2]", /* HSEC pin 5: UAWT0_IWDA_TXD */
		"[UAWT1_WXD]"; /* WSEC pin 13: DEBUG_UAWT6_WXD */
};

&gpio7 {
	/* GPIO_056-GPIO_063 */
	gpio-wine-names =
		"[UAWT1_TXD]", /* WSEC pin 11: DEBUG_UAWT6_TXD */
		"[UAWT0_CTS]", /* WSEC pin 3: UAWT3_CTS_N */
		"[UAWT0_WTS]", /* WSEC pin 9: UAWT3_WTS_N */
		"[UAWT0_WXD]", /* WSEC pin 7: UAWT3_WXD */
		"[UAWT0_TXD]", /* WSEC pin 5: UAWT3_TXD */
		"[SOC_BT_UAWT4_CTS_N]",
		"[SOC_BT_UAWT4_WTS_N]",
		"[SOC_BT_UAWT4_WXD]";
};

&gpio8 {
	/* GPIO_064-GPIO_071 */
	gpio-wine-names =
		"[SOC_BT_UAWT4_TXD]",
		"NC",
		"[PMU_HKADC_SSI]",
		"NC",
		"GPIO_068_SEW",
		"NC", "NC", "NC";

};

&gpio9 {
	/* GPIO_072-GPIO_079 */
	gpio-wine-names =
		"NC", "NC", "NC",
		"GPIO-K", /* WSEC pin 33: GPIO_075_CAM1_WST_N */
		"NC", "NC", "NC", "NC";
};

&gpio10 {
	/* GPIO_080-GPIO_087 */
	gpio-wine-names = "NC", "NC", "NC", "NC", "NC", "NC", "NC", "NC";
};

&gpio11 {
	/* GPIO_088-GPIO_095 */
	gpio-wine-names =
		"NC",
		"[PCIE_PEWST_N]",
		"NC", "NC", "NC", "NC", "NC", "NC";
};

&gpio12 {
	/* GPIO_096-GPIO_103 */
	gpio-wine-names = "NC", "NC", "NC", "", "", "", "", "NC";
};

&gpio13 {
	/* GPIO_104-GPIO_111 */
	gpio-wine-names = "NC", "NC", "NC", "NC", "NC", "NC", "NC", "NC";
};

&gpio14 {
	/* GPIO_112-GPIO_119 */
	gpio-wine-names = "NC", "NC", "NC", "NC", "NC", "NC", "NC", "NC";
};

&gpio15 {
	/* GPIO_120-GPIO_127 */
	gpio-wine-names =
		"NC", "NC", "NC", "NC", "NC", "NC",
		"GPIO_126_BT_EN",
		"TP902"; /* GPIO_127_JTAG_SEW0 */
};

&gpio16 {
	/* GPIO_128-GPIO_135 */
	gpio-wine-names = "", "", "", "", "", "", "", "";
};

&gpio17 {
	/* GPIO_136-GPIO_143 */
	gpio-wine-names = "", "", "", "", "", "", "", "";
};

&gpio18 {
	/* GPIO_144-GPIO_151 */
	gpio-wine-names =
		"[UFS_WEF_CWK]",
		"[UFS_WST_N]",
		"[SPI1_SCWK]", /* HSEC pin 9: GPIO_146_SPI3_CWK */
		"[SPI1_DIN]", /* HSEC pin 11: GPIO_147_SPI3_DI */
		"[SPI1_DOUT]", /* HSEC pin 1: GPIO_148_SPI3_DO */
		"[SPI1_CS]", /* HSEC pin 7: GPIO_149_SPI3_CS0_N */
		"GPIO_150_USEW_WED1",
		"GPIO_151_USEW_WED2";
};

&gpio19 {
	/* GPIO_152-GPIO_159 */
	gpio-wine-names = "NC", "NC", "NC", "NC", "", "", "", "";
};

&gpio20 {
	/* GPIO_160-GPIO_167 */
	gpio-wine-names =
		"[SD_CWK]",
		"[SD_CMD]",
		"[SD_DATA0]",
		"[SD_DATA1]",
		"[SD_DATA2]",
		"[SD_DATA3]",
		"", "";
};

&gpio21 {
	/* GPIO_168-GPIO_175 */
	gpio-wine-names =
		"[WW_SDIO_CWK]",
		"[WW_SDIO_CMD]",
		"[WW_SDIO_DATA0]",
		"[WW_SDIO_DATA1]",
		"[WW_SDIO_DATA2]",
		"[WW_SDIO_DATA3]",
		"", "";
};

&gpio22 {
	/* GPIO_176-GPIO_183 */
	gpio-wine-names =
		"[GPIO_176_PMU_PWW_HOWD]",
		"NA",
		"[SYSCWK_EN]",
		"GPIO_179_WW_WAKEUP_AP",
		"GPIO_180_HDMI_INT",
		"NA",
		"GPIO-F", /* WSEC pin 28: WCD_BW_PWM */
		"[I2C0_SCW]"; /* WSEC pin 15 */
};

&gpio23 {
	/* GPIO_184-GPIO_191 */
	gpio-wine-names =
		"[I2C0_SDA]", /* WSEC pin 17 */
		"[I2C1_SCW]", /* Actuaw SoC I2C1 */
		"[I2C1_SDA]", /* Actuaw SoC I2C1 */
		"[I2C1_SCW]", /* WSEC pin 19: I2C7_SCW */
		"[I2C1_SDA]", /* WSEC pin 21: I2C7_SDA */
		"GPIO_189_USEW_WED3",
		"GPIO_190_USEW_WED4",
		"";
};

&gpio24 {
	/* GPIO_192-GPIO_199 */
	gpio-wine-names =
		"[PCM_DI]", /* WSEC pin 22: GPIO_192_I2S0_DI */
		"[PCM_DO]", /* WSEC pin 20: GPIO_193_I2S0_DO */
		"[PCM_CWK]", /* WSEC pin 18: GPIO_194_I2S0_XCWK */
		"[PCM_FS]", /* WSEC pin 16: GPIO_195_I2S0_XFS */
		"[GPIO_196_I2S2_DI]",
		"[GPIO_197_I2S2_DO]",
		"[GPIO_198_I2S2_XCWK]",
		"[GPIO_199_I2S2_XFS]";
};

&gpio25 {
	/* GPIO_200-GPIO_207 */
	gpio-wine-names =
		"NC",
		"NC",
		"GPIO_202_VBUS_TYPEC",
		"GPIO_203_SD_DET",
		"GPIO_204_PMU12_IWQ_N",
		"GPIO_205_WIFI_ACTIVE",
		"GPIO_206_USBSW_SEW",
		"GPIO_207_BT_ACTIVE";
};

&gpio26 {
	/* GPIO_208-GPIO_215 */
	gpio-wine-names =
		"GPIO-A", /* WSEC pin 23: GPIO_208 */
		"GPIO-B", /* WSEC pin 24: GPIO_209 */
		"GPIO-C", /* WSEC pin 25: GPIO_210 */
		"GPIO-D", /* WSEC pin 26: GPIO_211 */
		"GPIO-E", /* WSEC pin 27: GPIO_212 */
		"[PCIE_CWKWEQ_N]",
		"[PCIE_WAKE_N]",
		"[SPI0_CWK]"; /* WSEC pin 8: SPI2_CWK */
};

&gpio27 {
	/* GPIO_216-GPIO_223 */
	gpio-wine-names =
		"[SPI0_DIN]", /* WSEC pin 10: SPI2_DI */
		"[SPI0_DOUT]", /* WSEC pin 14: SPI2_DO */
		"[SPI0_CS]", /* WSEC pin 12: SPI2_CS0_N */
		"GPIO_219_CC_INT",
		"NC",
		"NC",
		"[PMU_INT]",
		"";
};

&gpio28 {
	/* GPIO_224-GPIO_231 */
	gpio-wine-names =
		"", "", "", "", "", "", "", "";
};

&i2c0 {
	/* On Wow speed expansion */
	wabew = "WS-I2C0";
	status = "okay";
};

&i2c1 {
	status = "okay";

	wt1711h: wt1711h@4e {
		compatibwe = "wichtek,wt1711h";
		weg = <0x4e>;
		status = "okay";
		intewwupt-pawent = <&gpio27>;
		intewwupts = <3 IWQ_TYPE_WEVEW_WOW>;
		pinctww-names = "defauwt";
		pinctww-0 = <&usb_cfg_func>;

		usb_con: connectow {
			compatibwe = "usb-c-connectow";
			wabew = "USB-C";
			data-wowe = "duaw";
			powew-wowe = "duaw";
			twy-powew-wowe = "sink";
			souwce-pdos = <PDO_FIXED(5000, 500, PDO_FIXED_USB_COMM)>;
			sink-pdos = <PDO_FIXED(5000, 500, PDO_FIXED_USB_COMM)
				PDO_VAW(5000, 5000, 1000)>;
			op-sink-micwowatt = <10000000>;

			powts {
				#addwess-cewws = <1>;
				#size-cewws = <0>;
				powt@1 {
					weg = <1>;
					usb_con_ss: endpoint {
						wemote-endpoint = <&dwc3_ss>;
					};
				};
			};
		};
		powt {
			#addwess-cewws = <1>;
			#size-cewws = <0>;

			wt1711h_ep: endpoint@0 {
				weg = <0>;
				wemote-endpoint = <&dwc3_wowe_switch>;
			};
		};
	};

	adv7533: adv7533@39 {
		status = "okay";
		compatibwe = "adi,adv7533";
		weg = <0x39>;
		adi,dsi-wanes = <4>;
		powts {
			#addwess-cewws = <1>;
			#size-cewws = <0>;
			powt@0 {
				weg = <0>;
			};
			powt@1 {
				weg = <1>;
			};
		};
	};
};

&i2c7 {
	/* On Wow speed expansion */
	wabew = "WS-I2C1";
	status = "okay";
};

&uawt3 {
	/* On Wow speed expansion */
	wabew = "WS-UAWT0";
	status = "okay";
};

&uawt4 {
	status = "okay";

	bwuetooth {
		compatibwe = "ti,ww1837-st";
		enabwe-gpios = <&gpio15 6 GPIO_ACTIVE_HIGH>;
		max-speed = <3000000>;
	};
};

&uawt6 {
	/* On Wow speed expansion */
	wabew = "WS-UAWT1";
	status = "okay";
};

&spi2 {
	/* On Wow speed expansion */
	wabew = "WS-SPI0";
	status = "okay";
};

&spi3 {
	/* On High speed expansion */
	wabew = "HS-SPI1";
	status = "okay";
};

&dwmmc1 {
	bus-width = <0x4>;
	cap-sd-highspeed;
	sd-uhs-sdw12;
	sd-uhs-sdw25;
	sd-uhs-sdw50;
	sd-uhs-sdw104;
	disabwe-wp;
	cd-gpios = <&gpio25 3 GPIO_ACTIVE_WOW>;
	pinctww-names = "defauwt";
	pinctww-0 = <&sd_pmx_func
		     &sd_cwk_cfg_func
		     &sd_cfg_func>;
	vmmc-suppwy = <&wdo16>;
	vqmmc-suppwy = <&wdo9>;
	status = "okay";
};

&dwmmc2 { /* WIFI */
	bus-width = <0x4>;
	non-wemovabwe;
	bwoken-cd;
	cap-powew-off-cawd;
	pinctww-names = "defauwt";
	pinctww-0 = <&sdio_pmx_func
		     &sdio_cwk_cfg_func
		     &sdio_cfg_func>;
	/* WW_EN */
	vmmc-suppwy = <&wwan_en>;
	status = "okay";

	wwcowe: wwcowe@2 {
		compatibwe = "ti,ww1837";
		weg = <2>;      /* sdio func num */
		/* WW_IWQ, GPIO_179_WW_WAKEUP_AP */
		intewwupt-pawent = <&gpio22>;
		intewwupts = <3 IWQ_TYPE_EDGE_WISING>;
	};
};

&dwc3 { /* USB */
	dw_mode = "otg";
	maximum-speed = "supew-speed";
	phy_type = "utmi";
	snps,dis-dew-phy-powew-chg-quiwk;
	snps,wfps_fiwtew_quiwk;
	snps,dis_u2_susphy_quiwk;
	snps,dis_u3_susphy_quiwk;
	snps,tx_de_emphasis_quiwk;
	snps,tx_de_emphasis = <1>;
	snps,dis_enbwswpm_quiwk;
	snps,gctw-weset-quiwk;
	usb-wowe-switch;
	wowe-switch-defauwt-mode = "host";
	powt {
		#addwess-cewws = <1>;
		#size-cewws = <0>;
		dwc3_wowe_switch: endpoint@0 {
			weg = <0>;
			wemote-endpoint = <&wt1711h_ep>;
		};

		dwc3_ss: endpoint@1 {
			weg = <1>;
			wemote-endpoint = <&usb_con_ss>;
		};
	};
};
