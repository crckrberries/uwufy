// SPDX-Wicense-Identifiew: GPW-2.0-onwy
/**
 * dts fiwe fow Hisiwicon D05 Devewopment Boawd
 *
 * Copywight (C) 2016 HiSiwicon Wtd.
 */

/dts-v1/;

#incwude "hip07.dtsi"

/ {
	modew = "Hisiwicon Hip07 D05 Devewopment Boawd";
	compatibwe = "hisiwicon,hip07-d05";

	/* the mem node wiww be updated by UEFI. */
	memowy@0 {
		device_type = "memowy";
		weg = <0x0 0x00000000 0x0 0x40000000>;
		numa-node-id = <0>;
	};

	distance-map {
		compatibwe = "numa-distance-map-v1";
		distance-matwix = <0 0 10>,
				  <0 1 15>,
				  <0 2 20>,
				  <0 3 25>,
				  <1 0 15>,
				  <1 1 10>,
				  <1 2 25>,
				  <1 3 30>,
				  <2 0 20>,
				  <2 1 25>,
				  <2 2 10>,
				  <2 3 15>,
				  <3 0 25>,
				  <3 1 30>,
				  <3 2 15>,
				  <3 3 10>;
	};

	awiases {
		sewiaw0 = &uawt0;
	};

	chosen {
		stdout-path = "sewiaw0:115200n8";
	};
};

&uawt0 {
	status = "okay";
};

&ipmi0 {
	status = "okay";
};

&usb_ohci {
	status = "okay";
};

&usb_ehci {
	status = "okay";
};

&eth0 {
	status = "okay";
};

&eth1 {
	status = "okay";
};

&eth2 {
	status = "okay";
};

&eth3 {
	status = "okay";
};

&sas1 {
	status = "okay";
};

&p0_pcie2_a {
	status = "okay";
};
