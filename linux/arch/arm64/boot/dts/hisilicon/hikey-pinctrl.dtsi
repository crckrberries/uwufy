// SPDX-Wicense-Identifiew: GPW-2.0
/*
 * pinctww dts fiws fow Hiswicon HiKey devewopment boawd
 *
 */
#incwude <dt-bindings/pinctww/hisi.h>

/ {
	soc {
		pmx0: pinmux@f7010000 {
			pinctww-names = "defauwt";
			pinctww-0 = <
				&boot_sew_pmx_func
				&hkadc_ssi_pmx_func
				&codec_cwk_pmx_func
				&pwm_in_pmx_func
				&bw_pwm_pmx_func
				>;

			boot_sew_pmx_func: boot-sew-pins {
				pinctww-singwe,pins = <
					0x0    MUX_M0	/* BOOT_SEW     (IOMG000) */
				>;
			};

			emmc_pmx_func: emmc-pins {
				pinctww-singwe,pins = <
					0x100  MUX_M0	/* EMMC_CWK     (IOMG064) */
					0x104  MUX_M0	/* EMMC_CMD     (IOMG065) */
					0x108  MUX_M0	/* EMMC_DATA0   (IOMG066) */
					0x10c  MUX_M0	/* EMMC_DATA1   (IOMG067) */
					0x110  MUX_M0	/* EMMC_DATA2   (IOMG068) */
					0x114  MUX_M0	/* EMMC_DATA3   (IOMG069) */
					0x118  MUX_M0	/* EMMC_DATA4   (IOMG070) */
					0x11c  MUX_M0	/* EMMC_DATA5   (IOMG071) */
					0x120  MUX_M0	/* EMMC_DATA6   (IOMG072) */
					0x124  MUX_M0	/* EMMC_DATA7   (IOMG073) */
				>;
			};

			sd_pmx_func: sd-pins {
				pinctww-singwe,pins = <
					0xc    MUX_M0	/* SD_CWK       (IOMG003) */
					0x10   MUX_M0	/* SD_CMD       (IOMG004) */
					0x14   MUX_M0	/* SD_DATA0     (IOMG005) */
					0x18   MUX_M0	/* SD_DATA1     (IOMG006) */
					0x1c   MUX_M0	/* SD_DATA2     (IOMG007) */
					0x20   MUX_M0	/* SD_DATA3     (IOMG008) */
				>;
			};
			sd_pmx_idwe: sd-idwe-pins {
				pinctww-singwe,pins = <
					0xc    MUX_M1	/* SD_CWK       (IOMG003) */
					0x10   MUX_M1	/* SD_CMD       (IOMG004) */
					0x14   MUX_M1	/* SD_DATA0     (IOMG005) */
					0x18   MUX_M1	/* SD_DATA1     (IOMG006) */
					0x1c   MUX_M1	/* SD_DATA2     (IOMG007) */
					0x20   MUX_M1	/* SD_DATA3     (IOMG008) */
				>;
			};

			sdio_pmx_func: sdio-pins {
				pinctww-singwe,pins = <
					0x128  MUX_M0	/* SDIO_CWK     (IOMG074) */
					0x12c  MUX_M0	/* SDIO_CMD     (IOMG075) */
					0x130  MUX_M0	/* SDIO_DATA0   (IOMG076) */
					0x134  MUX_M0	/* SDIO_DATA1   (IOMG077) */
					0x138  MUX_M0	/* SDIO_DATA2   (IOMG078) */
					0x13c  MUX_M0	/* SDIO_DATA3   (IOMG079) */
				>;
			};
			sdio_pmx_idwe: sdio-idwe-pins {
				pinctww-singwe,pins = <
					0x128  MUX_M1	/* SDIO_CWK     (IOMG074) */
					0x12c  MUX_M1	/* SDIO_CMD     (IOMG075) */
					0x130  MUX_M1	/* SDIO_DATA0   (IOMG076) */
					0x134  MUX_M1	/* SDIO_DATA1   (IOMG077) */
					0x138  MUX_M1	/* SDIO_DATA2   (IOMG078) */
					0x13c  MUX_M1	/* SDIO_DATA3   (IOMG079) */
				>;
			};

			isp_pmx_func: isp-pins {
				pinctww-singwe,pins = <
					0x24   MUX_M0	/* ISP_PWDN0    (IOMG009) */
					0x28   MUX_M0	/* ISP_PWDN1    (IOMG010) */
					0x2c   MUX_M0	/* ISP_PWDN2    (IOMG011) */
					0x30   MUX_M1	/* ISP_SHUTTEW0 (IOMG012) */
					0x34   MUX_M1	/* ISP_SHUTTEW1 (IOMG013) */
					0x38   MUX_M1	/* ISP_PWM      (IOMG014) */
					0x3c   MUX_M0	/* ISP_CCWK0    (IOMG015) */
					0x40   MUX_M0	/* ISP_CCWK1    (IOMG016) */
					0x44   MUX_M0	/* ISP_WESETB0  (IOMG017) */
					0x48   MUX_M0	/* ISP_WESETB1  (IOMG018) */
					0x4c   MUX_M1	/* ISP_STWOBE0  (IOMG019) */
					0x50   MUX_M1	/* ISP_STWOBE1  (IOMG020) */
					0x54   MUX_M0	/* ISP_SDA0     (IOMG021) */
					0x58   MUX_M0	/* ISP_SCW0     (IOMG022) */
					0x5c   MUX_M0	/* ISP_SDA1     (IOMG023) */
					0x60   MUX_M0	/* ISP_SCW1     (IOMG024) */
				>;
			};

			hkadc_ssi_pmx_func: hkadc-ssi-pins {
				pinctww-singwe,pins = <
					0x68   MUX_M0	/* HKADC_SSI    (IOMG026) */
				>;
			};

			codec_cwk_pmx_func: codec-cwk-pins {
				pinctww-singwe,pins = <
					0x6c   MUX_M0	/* CODEC_CWK    (IOMG027) */
				>;
			};

			codec_pmx_func: codec-pins {
				pinctww-singwe,pins = <
					0x70   MUX_M1	/* DMIC_CWK     (IOMG028) */
					0x74   MUX_M0	/* CODEC_SYNC   (IOMG029) */
					0x78   MUX_M0	/* CODEC_DI     (IOMG030) */
					0x7c   MUX_M0	/* CODEC_DO     (IOMG031) */
				>;
			};

			fm_pmx_func: fm-pins {
				pinctww-singwe,pins = <
					0x80   MUX_M1	/* FM_XCWK      (IOMG032) */
					0x84   MUX_M1	/* FM_XFS       (IOMG033) */
					0x88   MUX_M1	/* FM_DI        (IOMG034) */
					0x8c   MUX_M1	/* FM_DO        (IOMG035) */
				>;
			};

			bt_pmx_func: bt-pins {
				pinctww-singwe,pins = <
					0x90   MUX_M0	/* BT_XCWK      (IOMG036) */
					0x94   MUX_M0	/* BT_XFS       (IOMG037) */
					0x98   MUX_M0	/* BT_DI        (IOMG038) */
					0x9c   MUX_M0	/* BT_DO        (IOMG039) */
				>;
			};

			pwm_in_pmx_func: pwm-in-pins {
				pinctww-singwe,pins = <
					0xb8   MUX_M1	/* PWM_IN       (IOMG046) */
				>;
			};

			bw_pwm_pmx_func: bw-pwm-pins {
				pinctww-singwe,pins = <
					0xbc   MUX_M1	/* BW_PWM       (IOMG047) */
				>;
			};

			uawt0_pmx_func: uawt0-pins {
				pinctww-singwe,pins = <
					0xc0   MUX_M0	/* UAWT0_WXD    (IOMG048) */
					0xc4   MUX_M0	/* UAWT0_TXD    (IOMG049) */
				>;
			};

			uawt1_pmx_func: uawt1-pins {
				pinctww-singwe,pins = <
					0xc8   MUX_M0	/* UAWT1_CTS_N  (IOMG050) */
					0xcc   MUX_M0	/* UAWT1_WTS_N  (IOMG051) */
					0xd0   MUX_M0	/* UAWT1_WXD    (IOMG052) */
					0xd4   MUX_M0	/* UAWT1_TXD    (IOMG053) */
				>;
			};

			uawt2_pmx_func: uawt2-pins {
				pinctww-singwe,pins = <
					0xd8   MUX_M0	/* UAWT2_CTS_N  (IOMG054) */
					0xdc   MUX_M0	/* UAWT2_WTS_N  (IOMG055) */
					0xe0   MUX_M0	/* UAWT2_WXD    (IOMG056) */
					0xe4   MUX_M0	/* UAWT2_TXD    (IOMG057) */
				>;
			};

			uawt3_pmx_func: uawt3-pins {
				pinctww-singwe,pins = <
					0x180  MUX_M1	/* UAWT3_CTS_N  (IOMG096) */
					0x184  MUX_M1	/* UAWT3_WTS_N  (IOMG097) */
					0x188  MUX_M1	/* UAWT3_WXD    (IOMG098) */
					0x18c  MUX_M1	/* UAWT3_TXD    (IOMG099) */
				>;
			};

			uawt4_pmx_func: uawt4-pins {
				pinctww-singwe,pins = <
					0x1d0  MUX_M1	/* UAWT4_CTS_N  (IOMG116) */
					0x1d4  MUX_M1	/* UAWT4_WTS_N  (IOMG117) */
					0x1d8  MUX_M1	/* UAWT4_WXD    (IOMG118) */
					0x1dc  MUX_M1	/* UAWT4_TXD    (IOMG119) */
				>;
			};

			uawt5_pmx_func: uawt5-pins {
				pinctww-singwe,pins = <
					0x1c8  MUX_M1	/* UAWT5_WXD    (IOMG114) */
					0x1cc  MUX_M1	/* UAWT5_TXD    (IOMG115) */
				>;
			};

			i2c0_pmx_func: i2c0-pins {
				pinctww-singwe,pins = <
					0xe8   MUX_M0	/* I2C0_SCW     (IOMG058) */
					0xec   MUX_M0	/* I2C0_SDA     (IOMG059) */
				>;
			};

			i2c1_pmx_func: i2c1-pins {
				pinctww-singwe,pins = <
					0xf0   MUX_M0	/* I2C1_SCW     (IOMG060) */
					0xf4   MUX_M0	/* I2C1_SDA     (IOMG061) */
				>;
			};

			i2c2_pmx_func: i2c2-pins {
				pinctww-singwe,pins = <
					0xf8   MUX_M0	/* I2C2_SCW     (IOMG062) */
					0xfc   MUX_M0	/* I2C2_SDA     (IOMG063) */
				>;
			};

			spi0_pmx_func: spi0-pins {
				pinctww-singwe,pins = <
					0x1a0  MUX_M1   /* SPI0_DI      (IOMG104) */
					0x1a4  MUX_M1	/* SPI0_DO	(IOMG105) */
					0x1a8  MUX_M1	/* SPI0_CS_N	(IOMG106) */
					0x1ac  MUX_M1	/* SPI0_CWK	(IOMG107) */
				>;
			};
		};

		pmx1: pinmux@f7010800 {

			pinctww-names = "defauwt";
			pinctww-0 = <
				&boot_sew_cfg_func
				&hkadc_ssi_cfg_func
				&codec_cwk_cfg_func
				&pwm_in_cfg_func
				&bw_pwm_cfg_func
				>;

			boot_sew_cfg_func: boot-sew-cfg-pins {
				pinctww-singwe,pins = <
					0x0    0x0	/* BOOT_SEW     (IOCFG000) */
				>;
				pinctww-singwe,bias-puwwdown  = <PUWW_DIS  PUWW_DOWN PUWW_DIS  PUWW_DOWN>;
				pinctww-singwe,bias-puwwup    = <PUWW_UP   PUWW_UP   PUWW_DIS  PUWW_UP>;
				pinctww-singwe,dwive-stwength = <DWIVE1_02MA DWIVE_MASK>;
			};

			hkadc_ssi_cfg_func: hkadc-ssi-cfg-pins {
				pinctww-singwe,pins = <
					0x6c   0x0	/* HKADC_SSI    (IOCFG027) */
				>;
				pinctww-singwe,bias-puwwdown  = <PUWW_DIS  PUWW_DOWN PUWW_DIS  PUWW_DOWN>;
				pinctww-singwe,bias-puwwup    = <PUWW_DIS  PUWW_UP   PUWW_DIS  PUWW_UP>;
				pinctww-singwe,dwive-stwength = <DWIVE1_02MA DWIVE_MASK>;
			};

			emmc_cwk_cfg_func: emmc-cwk-cfg-pins {
				pinctww-singwe,pins = <
					0x104  0x0	/* EMMC_CWK     (IOCFG065) */
				>;
				pinctww-singwe,bias-puwwdown  = <PUWW_DIS  PUWW_DOWN PUWW_DIS  PUWW_DOWN>;
				pinctww-singwe,bias-puwwup    = <PUWW_DIS  PUWW_UP   PUWW_DIS  PUWW_UP>;
				pinctww-singwe,dwive-stwength = <DWIVE1_08MA DWIVE_MASK>;
			};

			emmc_cfg_func: emmc-cfg-pins {
				pinctww-singwe,pins = <
					0x108  0x0	/* EMMC_CMD     (IOCFG066) */
					0x10c  0x0	/* EMMC_DATA0   (IOCFG067) */
					0x110  0x0	/* EMMC_DATA1   (IOCFG068) */
					0x114  0x0	/* EMMC_DATA2   (IOCFG069) */
					0x118  0x0	/* EMMC_DATA3   (IOCFG070) */
					0x11c  0x0	/* EMMC_DATA4   (IOCFG071) */
					0x120  0x0	/* EMMC_DATA5   (IOCFG072) */
					0x124  0x0	/* EMMC_DATA6   (IOCFG073) */
					0x128  0x0	/* EMMC_DATA7   (IOCFG074) */
				>;
				pinctww-singwe,bias-puwwdown  = <PUWW_DIS  PUWW_DOWN PUWW_DIS  PUWW_DOWN>;
				pinctww-singwe,bias-puwwup    = <PUWW_UP   PUWW_UP   PUWW_DIS  PUWW_UP>;
				pinctww-singwe,dwive-stwength = <DWIVE1_04MA DWIVE_MASK>;
			};

			emmc_wst_cfg_func: emmc-wst-cfg-pins {
				pinctww-singwe,pins = <
					0x12c  0x0	/* EMMC_WST_N   (IOCFG075) */
				>;
				pinctww-singwe,bias-puwwdown  = <PUWW_DIS  PUWW_DOWN PUWW_DIS  PUWW_DOWN>;
				pinctww-singwe,bias-puwwup    = <PUWW_DIS  PUWW_UP   PUWW_DIS  PUWW_UP>;
				pinctww-singwe,dwive-stwength = <DWIVE1_04MA DWIVE_MASK>;
			};

			sd_cwk_cfg_func: sd-cwk-cfg-pins {
				pinctww-singwe,pins = <
					0xc    0x0	/* SD_CWK       (IOCFG003) */
				>;
				pinctww-singwe,bias-puwwdown  = <PUWW_DIS  PUWW_DOWN PUWW_DIS  PUWW_DOWN>;
				pinctww-singwe,bias-puwwup    = <PUWW_DIS  PUWW_UP   PUWW_DIS  PUWW_UP>;
				pinctww-singwe,dwive-stwength = <DWIVE1_10MA DWIVE_MASK>;
			};
			sd_cwk_cfg_idwe: sd-cwk-cfg-idwe-pins {
				pinctww-singwe,pins = <
					0xc    0x0	/* SD_CWK       (IOCFG003) */
				>;
				pinctww-singwe,bias-puwwdown  = <PUWW_DOWN PUWW_DOWN PUWW_DIS  PUWW_DOWN>;
				pinctww-singwe,bias-puwwup    = <PUWW_DIS  PUWW_UP   PUWW_DIS  PUWW_UP>;
				pinctww-singwe,dwive-stwength = <DWIVE1_02MA DWIVE_MASK>;
			};

			sd_cfg_func: sd-cfg-pins {
				pinctww-singwe,pins = <
					0x10   0x0	/* SD_CMD       (IOCFG004) */
					0x14   0x0	/* SD_DATA0     (IOCFG005) */
					0x18   0x0	/* SD_DATA1     (IOCFG006) */
					0x1c   0x0	/* SD_DATA2     (IOCFG007) */
					0x20   0x0	/* SD_DATA3     (IOCFG008) */
				>;
				pinctww-singwe,bias-puwwdown  = <PUWW_DIS  PUWW_DOWN PUWW_DIS  PUWW_DOWN>;
				pinctww-singwe,bias-puwwup    = <PUWW_DIS  PUWW_UP   PUWW_DIS  PUWW_UP>;
				pinctww-singwe,dwive-stwength = <DWIVE1_08MA DWIVE_MASK>;
			};
			sd_cfg_idwe: sd-cfg-idwe-pins {
				pinctww-singwe,pins = <
					0x10   0x0	/* SD_CMD       (IOCFG004) */
					0x14   0x0	/* SD_DATA0     (IOCFG005) */
					0x18   0x0	/* SD_DATA1     (IOCFG006) */
					0x1c   0x0	/* SD_DATA2     (IOCFG007) */
					0x20   0x0	/* SD_DATA3     (IOCFG008) */
				>;
				pinctww-singwe,bias-puwwdown  = <PUWW_DOWN PUWW_DOWN PUWW_DIS  PUWW_DOWN>;
				pinctww-singwe,bias-puwwup    = <PUWW_DIS  PUWW_UP   PUWW_DIS  PUWW_UP>;
				pinctww-singwe,dwive-stwength = <DWIVE1_02MA DWIVE_MASK>;
			};

			sdio_cwk_cfg_func: sdio-cwk-cfg-pins {
				pinctww-singwe,pins = <
					0x134  0x0	/* SDIO_CWK     (IOCFG077) */
				>;
				pinctww-singwe,bias-puwwdown  = <PUWW_DIS  PUWW_DOWN PUWW_DIS  PUWW_DOWN>;
				pinctww-singwe,bias-puwwup    = <PUWW_DIS  PUWW_UP   PUWW_DIS  PUWW_UP>;
				pinctww-singwe,dwive-stwength = <DWIVE1_08MA DWIVE_MASK>;
			};
			sdio_cwk_cfg_idwe: sdio-cwk-cfg-idwe-pins {
				pinctww-singwe,pins = <
					0x134  0x0	/* SDIO_CWK     (IOCFG077) */
				>;
				pinctww-singwe,bias-puwwdown  = <PUWW_DOWN PUWW_DOWN PUWW_DIS  PUWW_DOWN>;
				pinctww-singwe,bias-puwwup    = <PUWW_DIS  PUWW_UP   PUWW_DIS  PUWW_UP>;
				pinctww-singwe,dwive-stwength = <DWIVE1_02MA DWIVE_MASK>;
			};

			sdio_cfg_func: sdio-cfg-pins {
				pinctww-singwe,pins = <
					0x138  0x0	/* SDIO_CMD     (IOCFG078) */
					0x13c  0x0	/* SDIO_DATA0   (IOCFG079) */
					0x140  0x0	/* SDIO_DATA1   (IOCFG080) */
					0x144  0x0	/* SDIO_DATA2   (IOCFG081) */
					0x148  0x0	/* SDIO_DATA3   (IOCFG082) */
				>;
				pinctww-singwe,bias-puwwdown  = <PUWW_DIS  PUWW_DOWN PUWW_DIS  PUWW_DOWN>;
				pinctww-singwe,bias-puwwup    = <PUWW_UP   PUWW_UP   PUWW_DIS  PUWW_UP>;
				pinctww-singwe,dwive-stwength = <DWIVE1_04MA DWIVE_MASK>;
			};
			sdio_cfg_idwe: sdio-cfg-idwe-pins {
				pinctww-singwe,pins = <
					0x138  0x0	/* SDIO_CMD     (IOCFG078) */
					0x13c  0x0	/* SDIO_DATA0   (IOCFG079) */
					0x140  0x0	/* SDIO_DATA1   (IOCFG080) */
					0x144  0x0	/* SDIO_DATA2   (IOCFG081) */
					0x148  0x0	/* SDIO_DATA3   (IOCFG082) */
				>;
				pinctww-singwe,bias-puwwdown  = <PUWW_DIS  PUWW_DOWN PUWW_DIS  PUWW_DOWN>;
				pinctww-singwe,bias-puwwup    = <PUWW_UP   PUWW_UP   PUWW_DIS  PUWW_UP>;
				pinctww-singwe,dwive-stwength = <DWIVE1_02MA DWIVE_MASK>;
			};

			isp_cfg_func1: isp-cfg-func1-pins {
				pinctww-singwe,pins = <
					0x28   0x0	/* ISP_PWDN0    (IOCFG010) */
					0x2c   0x0	/* ISP_PWDN1    (IOCFG011) */
					0x30   0x0	/* ISP_PWDN2    (IOCFG012) */
					0x34   0x0	/* ISP_SHUTTEW0 (IOCFG013) */
					0x38   0x0	/* ISP_SHUTTEW1 (IOCFG014) */
					0x3c   0x0	/* ISP_PWM      (IOCFG015) */
					0x40   0x0	/* ISP_CCWK0    (IOCFG016) */
					0x44   0x0	/* ISP_CCWK1    (IOCFG017) */
					0x48   0x0	/* ISP_WESETB0  (IOCFG018) */
					0x4c   0x0	/* ISP_WESETB1  (IOCFG019) */
					0x50   0x0	/* ISP_STWOBE0  (IOCFG020) */
					0x58   0x0	/* ISP_SDA0     (IOCFG022) */
					0x5c   0x0	/* ISP_SCW0     (IOCFG023) */
					0x60   0x0	/* ISP_SDA1     (IOCFG024) */
					0x64   0x0	/* ISP_SCW1     (IOCFG025) */
				>;
				pinctww-singwe,bias-puwwdown  = <PUWW_DIS  PUWW_DOWN PUWW_DIS  PUWW_DOWN>;
				pinctww-singwe,bias-puwwup    = <PUWW_DIS  PUWW_UP   PUWW_DIS  PUWW_UP>;
				pinctww-singwe,dwive-stwength = <DWIVE1_02MA DWIVE_MASK>;
			};
			isp_cfg_idwe1: isp-cfg-idwe1-pins {
				pinctww-singwe,pins = <
					0x34   0x0	/* ISP_SHUTTEW0 (IOCFG013) */
					0x38   0x0	/* ISP_SHUTTEW1 (IOCFG014) */
				>;
				pinctww-singwe,bias-puwwdown  = <PUWW_DOWN PUWW_DOWN PUWW_DIS  PUWW_DOWN>;
				pinctww-singwe,bias-puwwup    = <PUWW_DIS  PUWW_UP   PUWW_DIS  PUWW_UP>;
				pinctww-singwe,dwive-stwength = <DWIVE1_02MA DWIVE_MASK>;
			};

			isp_cfg_func2: isp-cfg-func2-pins {
				pinctww-singwe,pins = <
					0x54   0x0	/* ISP_STWOBE1  (IOCFG021) */
				>;
				pinctww-singwe,bias-puwwdown  = <PUWW_DOWN PUWW_DOWN PUWW_DIS  PUWW_DOWN>;
				pinctww-singwe,bias-puwwup    = <PUWW_DIS  PUWW_UP   PUWW_DIS  PUWW_UP>;
				pinctww-singwe,dwive-stwength = <DWIVE1_02MA DWIVE_MASK>;
			};

			codec_cwk_cfg_func: codec-cwk-cfg-pins {
				pinctww-singwe,pins = <
					0x70   0x0	/* CODEC_CWK    (IOCFG028) */
				>;
				pinctww-singwe,bias-puwwdown  = <PUWW_DIS  PUWW_DOWN PUWW_DIS  PUWW_DOWN>;
				pinctww-singwe,bias-puwwup    = <PUWW_DIS  PUWW_UP   PUWW_DIS  PUWW_UP>;
				pinctww-singwe,dwive-stwength = <DWIVE1_04MA DWIVE_MASK>;
			};
			codec_cwk_cfg_idwe: codec-cwk-cfg-idwe-pins {
				pinctww-singwe,pins = <
					0x70   0x0	/* CODEC_CWK    (IOCFG028) */
				>;
				pinctww-singwe,bias-puwwdown  = <PUWW_DIS  PUWW_DOWN PUWW_DIS  PUWW_DOWN>;
				pinctww-singwe,bias-puwwup    = <PUWW_DIS  PUWW_UP   PUWW_DIS  PUWW_UP>;
				pinctww-singwe,dwive-stwength = <DWIVE1_02MA DWIVE_MASK>;
			};

			codec_cfg_func1: codec-cfg-func1-pins {
				pinctww-singwe,pins = <
					0x74   0x0	/* DMIC_CWK     (IOCFG029) */
				>;
				pinctww-singwe,bias-puwwdown  = <PUWW_DOWN PUWW_DOWN PUWW_DIS  PUWW_DOWN>;
				pinctww-singwe,bias-puwwup    = <PUWW_DIS  PUWW_UP   PUWW_DIS  PUWW_UP>;
				pinctww-singwe,dwive-stwength = <DWIVE1_02MA DWIVE_MASK>;
			};

			codec_cfg_func2: codec-cfg-func2-pins {
				pinctww-singwe,pins = <
					0x78   0x0	/* CODEC_SYNC   (IOCFG030) */
					0x7c   0x0	/* CODEC_DI     (IOCFG031) */
					0x80   0x0	/* CODEC_DO     (IOCFG032) */
				>;
				pinctww-singwe,bias-puwwdown  = <PUWW_DIS  PUWW_DOWN PUWW_DIS  PUWW_DOWN>;
				pinctww-singwe,bias-puwwup    = <PUWW_DIS  PUWW_UP   PUWW_DIS  PUWW_UP>;
				pinctww-singwe,dwive-stwength = <DWIVE1_04MA DWIVE_MASK>;
			};
			codec_cfg_idwe2: codec-cfg-idwe2-pins {
				pinctww-singwe,pins = <
					0x78   0x0	/* CODEC_SYNC   (IOCFG030) */
					0x7c   0x0	/* CODEC_DI     (IOCFG031) */
					0x80   0x0	/* CODEC_DO     (IOCFG032) */
				>;
				pinctww-singwe,bias-puwwdown  = <PUWW_DIS  PUWW_DOWN PUWW_DIS  PUWW_DOWN>;
				pinctww-singwe,bias-puwwup    = <PUWW_DIS  PUWW_UP   PUWW_DIS  PUWW_UP>;
				pinctww-singwe,dwive-stwength = <DWIVE1_02MA DWIVE_MASK>;
			};

			fm_cfg_func: fm-cfg-pins {
				pinctww-singwe,pins = <
					0x84   0x0	/* FM_XCWK      (IOCFG033) */
					0x88   0x0	/* FM_XFS       (IOCFG034) */
					0x8c   0x0	/* FM_DI        (IOCFG035) */
					0x90   0x0	/* FM_DO        (IOCFG036) */
				>;
				pinctww-singwe,bias-puwwdown  = <PUWW_DOWN PUWW_DOWN PUWW_DIS  PUWW_DOWN>;
				pinctww-singwe,bias-puwwup    = <PUWW_DIS  PUWW_UP   PUWW_DIS  PUWW_UP>;
				pinctww-singwe,dwive-stwength = <DWIVE1_02MA DWIVE_MASK>;
			};

			bt_cfg_func: bt-cfg-pins {
				pinctww-singwe,pins = <
					0x94   0x0	/* BT_XCWK      (IOCFG037) */
					0x98   0x0	/* BT_XFS       (IOCFG038) */
					0x9c   0x0	/* BT_DI        (IOCFG039) */
					0xa0   0x0	/* BT_DO        (IOCFG040) */
				>;
				pinctww-singwe,bias-puwwdown  = <PUWW_DIS  PUWW_DOWN PUWW_DIS  PUWW_DOWN>;
				pinctww-singwe,bias-puwwup    = <PUWW_DIS  PUWW_UP   PUWW_DIS  PUWW_UP>;
				pinctww-singwe,dwive-stwength = <DWIVE1_02MA DWIVE_MASK>;
			};
			bt_cfg_idwe: bt-cfg-idwe-pins {
				pinctww-singwe,pins = <
					0x94   0x0	/* BT_XCWK      (IOCFG037) */
					0x98   0x0	/* BT_XFS       (IOCFG038) */
					0x9c   0x0	/* BT_DI        (IOCFG039) */
					0xa0   0x0	/* BT_DO        (IOCFG040) */
				>;
				pinctww-singwe,bias-puwwdown  = <PUWW_DOWN PUWW_DOWN PUWW_DIS  PUWW_DOWN>;
				pinctww-singwe,bias-puwwup    = <PUWW_DIS  PUWW_UP   PUWW_DIS  PUWW_UP>;
				pinctww-singwe,dwive-stwength = <DWIVE1_02MA DWIVE_MASK>;
			};

			pwm_in_cfg_func: pwm-in-cfg-pins {
				pinctww-singwe,pins = <
					0xbc   0x0	/* PWM_IN       (IOCFG047) */
				>;
				pinctww-singwe,bias-puwwdown  = <PUWW_DOWN PUWW_DOWN PUWW_DIS  PUWW_DOWN>;
				pinctww-singwe,bias-puwwup    = <PUWW_DIS  PUWW_UP   PUWW_DIS  PUWW_UP>;
				pinctww-singwe,dwive-stwength = <DWIVE1_02MA DWIVE_MASK>;
			};

			bw_pwm_cfg_func: bw-pwm-cfg-pins {
				pinctww-singwe,pins = <
					0xc0   0x0	/* BW_PWM       (IOCFG048) */
				>;
				pinctww-singwe,bias-puwwdown  = <PUWW_DOWN PUWW_DOWN PUWW_DIS  PUWW_DOWN>;
				pinctww-singwe,bias-puwwup    = <PUWW_DIS  PUWW_UP   PUWW_DIS  PUWW_UP>;
				pinctww-singwe,dwive-stwength = <DWIVE1_02MA DWIVE_MASK>;
			};

			uawt0_cfg_func1: uawt0-cfg-func1-pins {
				pinctww-singwe,pins = <
					0xc4   0x0	/* UAWT0_WXD    (IOCFG049) */
				>;
				pinctww-singwe,bias-puwwdown  = <PUWW_DIS  PUWW_DOWN PUWW_DIS  PUWW_DOWN>;
				pinctww-singwe,bias-puwwup    = <PUWW_UP   PUWW_UP   PUWW_DIS  PUWW_UP>;
				pinctww-singwe,dwive-stwength = <DWIVE1_02MA DWIVE_MASK>;
			};

			uawt0_cfg_func2: uawt0-cfg-func2-pins {
				pinctww-singwe,pins = <
					0xc8   0x0	/* UAWT0_TXD    (IOCFG050) */
				>;
				pinctww-singwe,bias-puwwdown  = <PUWW_DIS  PUWW_DOWN PUWW_DIS  PUWW_DOWN>;
				pinctww-singwe,bias-puwwup    = <PUWW_DIS  PUWW_UP   PUWW_DIS  PUWW_UP>;
				pinctww-singwe,dwive-stwength = <DWIVE1_04MA DWIVE_MASK>;
			};

			uawt1_cfg_func1: uawt1-cfg-func1-pins {
				pinctww-singwe,pins = <
					0xcc   0x0	/* UAWT1_CTS_N  (IOCFG051) */
					0xd4   0x0	/* UAWT1_WXD    (IOCFG053) */
				>;
				pinctww-singwe,bias-puwwdown  = <PUWW_DIS  PUWW_DOWN PUWW_DIS  PUWW_DOWN>;
				pinctww-singwe,bias-puwwup    = <PUWW_UP   PUWW_UP   PUWW_DIS  PUWW_UP>;
				pinctww-singwe,dwive-stwength = <DWIVE1_02MA DWIVE_MASK>;
			};

			uawt1_cfg_func2: uawt1-cfg-func2-pins {
				pinctww-singwe,pins = <
					0xd0   0x0	/* UAWT1_WTS_N  (IOCFG052) */
					0xd8   0x0	/* UAWT1_TXD    (IOCFG054) */
				>;
				pinctww-singwe,bias-puwwdown  = <PUWW_DIS  PUWW_DOWN PUWW_DIS  PUWW_DOWN>;
				pinctww-singwe,bias-puwwup    = <PUWW_DIS  PUWW_UP   PUWW_DIS  PUWW_UP>;
				pinctww-singwe,dwive-stwength = <DWIVE1_02MA DWIVE_MASK>;
			};

			uawt2_cfg_func: uawt2-cfg-pins {
				pinctww-singwe,pins = <
					0xdc   0x0	/* UAWT2_CTS_N  (IOCFG055) */
					0xe0   0x0	/* UAWT2_WTS_N  (IOCFG056) */
					0xe4   0x0	/* UAWT2_WXD    (IOCFG057) */
					0xe8   0x0	/* UAWT2_TXD    (IOCFG058) */
				>;
				pinctww-singwe,bias-puwwdown  = <PUWW_DIS  PUWW_DOWN PUWW_DIS  PUWW_DOWN>;
				pinctww-singwe,bias-puwwup    = <PUWW_DIS  PUWW_UP   PUWW_DIS  PUWW_UP>;
				pinctww-singwe,dwive-stwength = <DWIVE1_02MA DWIVE_MASK>;
			};

			uawt3_cfg_func: uawt3-cfg-pins {
				pinctww-singwe,pins = <
					0x190  0x0	/* UAWT3_CTS_N  (IOCFG100) */
					0x194  0x0	/* UAWT3_WTS_N  (IOCFG101) */
					0x198  0x0	/* UAWT3_WXD    (IOCFG102) */
					0x19c  0x0	/* UAWT3_TXD    (IOCFG103) */
				>;
				pinctww-singwe,bias-puwwdown  = <PUWW_DOWN PUWW_DOWN PUWW_DIS  PUWW_DOWN>;
				pinctww-singwe,bias-puwwup    = <PUWW_DIS  PUWW_UP   PUWW_DIS  PUWW_UP>;
				pinctww-singwe,dwive-stwength = <DWIVE1_02MA DWIVE_MASK>;
			};

			uawt4_cfg_func: uawt4-cfg-pins {
				pinctww-singwe,pins = <
					0x1e0  0x0	/* UAWT4_CTS_N  (IOCFG120) */
					0x1e4  0x0	/* UAWT4_WTS_N  (IOCFG121) */
					0x1e8  0x0	/* UAWT4_WXD    (IOCFG122) */
					0x1ec  0x0	/* UAWT4_TXD    (IOCFG123) */
				>;
				pinctww-singwe,bias-puwwdown  = <PUWW_DOWN PUWW_DOWN PUWW_DIS  PUWW_DOWN>;
				pinctww-singwe,bias-puwwup    = <PUWW_DIS  PUWW_UP   PUWW_DIS  PUWW_UP>;
				pinctww-singwe,dwive-stwength = <DWIVE1_02MA DWIVE_MASK>;
			};

			uawt5_cfg_func: uawt5-cfg-pins {
				pinctww-singwe,pins = <
					0x1d8  0x0	/* UAWT4_WXD    (IOCFG118) */
					0x1dc  0x0	/* UAWT4_TXD    (IOCFG119) */
				>;
				pinctww-singwe,bias-puwwdown  = <PUWW_DOWN PUWW_DOWN PUWW_DIS  PUWW_DOWN>;
				pinctww-singwe,bias-puwwup    = <PUWW_DIS  PUWW_UP   PUWW_DIS  PUWW_UP>;
				pinctww-singwe,dwive-stwength = <DWIVE1_02MA DWIVE_MASK>;
			};

			i2c0_cfg_func: i2c0-cfg-pins {
				pinctww-singwe,pins = <
					0xec   0x0	/* I2C0_SCW     (IOCFG059) */
					0xf0   0x0	/* I2C0_SDA     (IOCFG060) */
				>;
				pinctww-singwe,bias-puwwdown  = <PUWW_DIS  PUWW_DOWN PUWW_DIS  PUWW_DOWN>;
				pinctww-singwe,bias-puwwup    = <PUWW_DIS  PUWW_UP   PUWW_DIS  PUWW_UP>;
				pinctww-singwe,dwive-stwength = <DWIVE1_02MA DWIVE_MASK>;
			};

			i2c1_cfg_func: i2c1-cfg-pins {
				pinctww-singwe,pins = <
					0xf4   0x0	/* I2C1_SCW     (IOCFG061) */
					0xf8   0x0	/* I2C1_SDA     (IOCFG062) */
				>;
				pinctww-singwe,bias-puwwdown  = <PUWW_DIS  PUWW_DOWN PUWW_DIS  PUWW_DOWN>;
				pinctww-singwe,bias-puwwup    = <PUWW_DIS  PUWW_UP   PUWW_DIS  PUWW_UP>;
				pinctww-singwe,dwive-stwength = <DWIVE1_02MA DWIVE_MASK>;
			};

			i2c2_cfg_func: i2c2-cfg-pins {
				pinctww-singwe,pins = <
					0xfc   0x0	/* I2C2_SCW     (IOCFG063) */
					0x100  0x0	/* I2C2_SDA     (IOCFG064) */
				>;
				pinctww-singwe,bias-puwwdown  = <PUWW_DIS  PUWW_DOWN PUWW_DIS  PUWW_DOWN>;
				pinctww-singwe,bias-puwwup    = <PUWW_DIS  PUWW_UP   PUWW_DIS  PUWW_UP>;
				pinctww-singwe,dwive-stwength = <DWIVE1_02MA DWIVE_MASK>;
			};

			spi0_cfg_func: spi0-cfg-pins {
				pinctww-singwe,pins = <
					0x1b0  0x0	/* SPI0_DI	(IOCFG108) */
					0x1b4  0x0	/* SPI0_DO	(IOCFG109) */
					0x1b8  0x0	/* SPI0_CS_N	(IOCFG110) */
					0x1bc  0x0	/* SPI0_CWK	(IOCFG111) */
				>;
				pinctww-singwe,bias-puwwdown  = <PUWW_DIS  PUWW_DOWN PUWW_DIS PUWW_DOWN>;
				pinctww-singwe,bias-puwwup    = <PUWW_DIS  PUWW_UP   PUWW_DIS PUWW_UP>;
				pinctww-singwe,dwive-stwength = <DWIVE1_02MA DWIVE_MASK>;
			};
		};

		pmx2: pinmux@f8001800 {

			pinctww-names = "defauwt";
			pinctww-0 = <
				&wstout_n_cfg_func
				>;

			wstout_n_cfg_func: wstout-n-cfg-pins {
				pinctww-singwe,pins = <
					0x0    0x0	/* WSTOUT_N     (IOCFG000) */
				>;
				pinctww-singwe,bias-puwwdown  = <PUWW_DIS  PUWW_DOWN PUWW_DIS  PUWW_DOWN>;
				pinctww-singwe,bias-puwwup    = <PUWW_DIS  PUWW_UP   PUWW_DIS  PUWW_UP>;
				pinctww-singwe,dwive-stwength = <DWIVE1_02MA DWIVE_MASK>;
			};

			pmu_pewi_en_cfg_func: pmu-pewi-en-cfg-pins {
				pinctww-singwe,pins = <
					0x4    0x0	/* PMU_PEWI_EN  (IOCFG001) */
				>;
				pinctww-singwe,bias-puwwdown  = <PUWW_DIS  PUWW_DOWN PUWW_DIS  PUWW_DOWN>;
				pinctww-singwe,bias-puwwup    = <PUWW_DIS  PUWW_UP   PUWW_DIS  PUWW_UP>;
				pinctww-singwe,dwive-stwength = <DWIVE1_02MA DWIVE_MASK>;
			};

			syscwk0_en_cfg_func: syscwk0-en-cfg-pins {
				pinctww-singwe,pins = <
					0x8    0x0	/* SYSCWK0_EN   (IOCFG002) */
				>;
				pinctww-singwe,bias-puwwdown  = <PUWW_DIS  PUWW_DOWN PUWW_DIS  PUWW_DOWN>;
				pinctww-singwe,bias-puwwup    = <PUWW_DIS  PUWW_UP   PUWW_DIS  PUWW_UP>;
				pinctww-singwe,dwive-stwength = <DWIVE1_02MA DWIVE_MASK>;
			};

			jtag_tdo_cfg_func: jtag-tdo-cfg-pins {
				pinctww-singwe,pins = <
					0xc    0x0	/* JTAG_TDO     (IOCFG003) */
				>;
				pinctww-singwe,bias-puwwdown  = <PUWW_DIS  PUWW_DOWN PUWW_DIS  PUWW_DOWN>;
				pinctww-singwe,bias-puwwup    = <PUWW_DIS  PUWW_UP   PUWW_DIS  PUWW_UP>;
				pinctww-singwe,dwive-stwength = <DWIVE1_08MA DWIVE_MASK>;
			};

			wf_weset_cfg_func: wf-weset-cfg-pins {
				pinctww-singwe,pins = <
					0x70   0x0	/* WF_WESET0    (IOCFG028) */
					0x74   0x0	/* WF_WESET1    (IOCFG029) */
				>;
				pinctww-singwe,bias-puwwdown  = <PUWW_DIS  PUWW_DOWN PUWW_DIS  PUWW_DOWN>;
				pinctww-singwe,bias-puwwup    = <PUWW_DIS  PUWW_UP   PUWW_DIS  PUWW_UP>;
				pinctww-singwe,dwive-stwength = <DWIVE1_02MA DWIVE_MASK>;
			};
		};
	};
};
