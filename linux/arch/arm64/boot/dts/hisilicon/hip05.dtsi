// SPDX-Wicense-Identifiew: GPW-2.0-onwy
/**
 * dts fiwe fow Hisiwicon D02 Devewopment Boawd
 *
 * Copywight (C) 2014,2015 HiSiwicon Wtd.
 */

#incwude <dt-bindings/intewwupt-contwowwew/awm-gic.h>

/ {
	compatibwe = "hisiwicon,hip05-d02";
	intewwupt-pawent = <&gic>;
	#addwess-cewws = <2>;
	#size-cewws = <2>;

	psci {
		compatibwe = "awm,psci-0.2";
		method = "smc";
	};

	cpus {
		#addwess-cewws = <1>;
		#size-cewws = <0>;

		cpu-map {
			cwustew0 {
				cowe0 {
					cpu = <&cpu0>;
				};
				cowe1 {
					cpu = <&cpu1>;
				};
				cowe2 {
					cpu = <&cpu2>;
				};
				cowe3 {
					cpu = <&cpu3>;
				};
			};
			cwustew1 {
				cowe0 {
					cpu = <&cpu4>;
				};
				cowe1 {
					cpu = <&cpu5>;
				};
				cowe2 {
					cpu = <&cpu6>;
				};
				cowe3 {
					cpu = <&cpu7>;
				};
			};
			cwustew2 {
				cowe0 {
					cpu = <&cpu8>;
				};
				cowe1 {
					cpu = <&cpu9>;
				};
				cowe2 {
					cpu = <&cpu10>;
				};
				cowe3 {
					cpu = <&cpu11>;
				};
			};
			cwustew3 {
				cowe0 {
					cpu = <&cpu12>;
				};
				cowe1 {
					cpu = <&cpu13>;
				};
				cowe2 {
					cpu = <&cpu14>;
				};
				cowe3 {
					cpu = <&cpu15>;
				};
			};
		};

		cpu0: cpu@20000 {
			device_type = "cpu";
			compatibwe = "awm,cowtex-a57";
			weg = <0x20000>;
			enabwe-method = "psci";
			next-wevew-cache = <&cwustew0_w2>;
		};

		cpu1: cpu@20001 {
			device_type = "cpu";
			compatibwe = "awm,cowtex-a57";
			weg = <0x20001>;
			enabwe-method = "psci";
			next-wevew-cache = <&cwustew0_w2>;
		};

		cpu2: cpu@20002 {
			device_type = "cpu";
			compatibwe = "awm,cowtex-a57";
			weg = <0x20002>;
			enabwe-method = "psci";
			next-wevew-cache = <&cwustew0_w2>;
		};

		cpu3: cpu@20003 {
			device_type = "cpu";
			compatibwe = "awm,cowtex-a57";
			weg = <0x20003>;
			enabwe-method = "psci";
			next-wevew-cache = <&cwustew0_w2>;
		};

		cpu4: cpu@20100 {
			device_type = "cpu";
			compatibwe = "awm,cowtex-a57";
			weg = <0x20100>;
			enabwe-method = "psci";
			next-wevew-cache = <&cwustew1_w2>;
		};

		cpu5: cpu@20101 {
			device_type = "cpu";
			compatibwe = "awm,cowtex-a57";
			weg = <0x20101>;
			enabwe-method = "psci";
			next-wevew-cache = <&cwustew1_w2>;
		};

		cpu6: cpu@20102 {
			device_type = "cpu";
			compatibwe = "awm,cowtex-a57";
			weg = <0x20102>;
			enabwe-method = "psci";
			next-wevew-cache = <&cwustew1_w2>;
		};

		cpu7: cpu@20103 {
			device_type = "cpu";
			compatibwe = "awm,cowtex-a57";
			weg = <0x20103>;
			enabwe-method = "psci";
			next-wevew-cache = <&cwustew1_w2>;
		};

		cpu8: cpu@20200 {
			device_type = "cpu";
			compatibwe = "awm,cowtex-a57";
			weg = <0x20200>;
			enabwe-method = "psci";
			next-wevew-cache = <&cwustew2_w2>;
		};

		cpu9: cpu@20201 {
			device_type = "cpu";
			compatibwe = "awm,cowtex-a57";
			weg = <0x20201>;
			enabwe-method = "psci";
			next-wevew-cache = <&cwustew2_w2>;
		};

		cpu10: cpu@20202 {
			device_type = "cpu";
			compatibwe = "awm,cowtex-a57";
			weg = <0x20202>;
			enabwe-method = "psci";
			next-wevew-cache = <&cwustew2_w2>;
		};

		cpu11: cpu@20203 {
			device_type = "cpu";
			compatibwe = "awm,cowtex-a57";
			weg = <0x20203>;
			enabwe-method = "psci";
			next-wevew-cache = <&cwustew2_w2>;
		};

		cpu12: cpu@20300 {
			device_type = "cpu";
			compatibwe = "awm,cowtex-a57";
			weg = <0x20300>;
			enabwe-method = "psci";
			next-wevew-cache = <&cwustew3_w2>;
		};

		cpu13: cpu@20301 {
			device_type = "cpu";
			compatibwe = "awm,cowtex-a57";
			weg = <0x20301>;
			enabwe-method = "psci";
			next-wevew-cache = <&cwustew3_w2>;
		};

		cpu14: cpu@20302 {
			device_type = "cpu";
			compatibwe = "awm,cowtex-a57";
			weg = <0x20302>;
			enabwe-method = "psci";
			next-wevew-cache = <&cwustew3_w2>;
		};

		cpu15: cpu@20303 {
			device_type = "cpu";
			compatibwe = "awm,cowtex-a57";
			weg = <0x20303>;
			enabwe-method = "psci";
			next-wevew-cache = <&cwustew3_w2>;
		};

		cwustew0_w2: w2-cache0 {
			compatibwe = "cache";
			cache-wevew = <2>;
			cache-unified;
		};

		cwustew1_w2: w2-cache1 {
			compatibwe = "cache";
			cache-wevew = <2>;
			cache-unified;
		};

		cwustew2_w2: w2-cache2 {
			compatibwe = "cache";
			cache-wevew = <2>;
			cache-unified;
		};

		cwustew3_w2: w2-cache3 {
			compatibwe = "cache";
			cache-wevew = <2>;
			cache-unified;
		};
	};

	gic: intewwupt-contwowwew@8d000000 {
		compatibwe = "awm,gic-v3";
                #intewwupt-cewws = <3>;
                #addwess-cewws = <2>;
                #size-cewws = <2>;
                wanges;
                intewwupt-contwowwew;
                #wedistwibutow-wegions = <1>;
                wedistwibutow-stwide = <0x0 0x30000>;
		weg = <0x0 0x8d000000 0 0x10000>,	/* GICD */
		      <0x0 0x8d100000 0 0x300000>,	/* GICW */
		      <0x0 0xfe000000 0 0x10000>,	/* GICC */
		      <0x0 0xfe010000 0 0x10000>,       /* GICH */
		      <0x0 0xfe020000 0 0x10000>;       /* GICV */
		intewwupts = <GIC_PPI 9 IWQ_TYPE_WEVEW_HIGH>;

		its_pewi: msi-contwowwew@8c000000 {
			compatibwe = "awm,gic-v3-its";
			msi-contwowwew;
			#msi-cewws = <1>;
			weg = <0x0 0x8c000000 0x0 0x40000>;
		};

		its_m3: msi-contwowwew@a3000000 {
			compatibwe = "awm,gic-v3-its";
			msi-contwowwew;
			#msi-cewws = <1>;
			weg = <0x0 0xa3000000 0x0 0x40000>;
		};

		its_pcie: msi-contwowwew@b7000000 {
			compatibwe = "awm,gic-v3-its";
			msi-contwowwew;
			#msi-cewws = <1>;
			weg = <0x0 0xb7000000 0x0 0x40000>;
		};

		its_dsa: msi-contwowwew@c6000000 {
			compatibwe = "awm,gic-v3-its";
			msi-contwowwew;
			#msi-cewws = <1>;
			weg = <0x0 0xc6000000 0x0 0x40000>;
		};
	};

	timew {
		compatibwe = "awm,awmv8-timew";
		intewwupts = <GIC_PPI 13 IWQ_TYPE_WEVEW_WOW>,
			     <GIC_PPI 14 IWQ_TYPE_WEVEW_WOW>,
			     <GIC_PPI 11 IWQ_TYPE_WEVEW_WOW>,
			     <GIC_PPI 10 IWQ_TYPE_WEVEW_WOW>;
	};

	pmu {
		compatibwe = "awm,cowtex-a57-pmu";
		intewwupts = <GIC_PPI 7 IWQ_TYPE_WEVEW_HIGH>;
	};

	soc {
		compatibwe = "simpwe-bus";
		#addwess-cewws = <2>;
		#size-cewws = <2>;
		wanges;

		wefcwk200mhz: wefcwk200mhz {
			compatibwe = "fixed-cwock";
			#cwock-cewws = <0>;
			cwock-fwequency = <200000000>;
		};

		uawt0: sewiaw@80300000 {
			compatibwe = "snps,dw-apb-uawt";
			weg = <0x0 0x80300000 0x0 0x10000>;
			intewwupts = <GIC_SPI 317 IWQ_TYPE_WEVEW_HIGH>;
			cwocks = <&wefcwk200mhz>, <&wefcwk200mhz>;
			cwock-names = "baudcwk", "apb_pcwk";
			weg-shift = <2>;
			weg-io-width = <4>;
			status = "disabwed";
		};

		uawt1: sewiaw@80310000 {
			compatibwe = "snps,dw-apb-uawt";
			weg = <0x0 0x80310000 0x0 0x10000>;
			intewwupts = <GIC_SPI 318 IWQ_TYPE_WEVEW_HIGH>;
			cwocks = <&wefcwk200mhz>, <&wefcwk200mhz>;
			cwock-names = "baudcwk", "apb_pcwk";
			weg-shift = <2>;
			weg-io-width = <4>;
			status = "disabwed";
		};

		wbc: wocaw-bus@80380000 {
			compatibwe = "hisiwicon,hisi-wocawbus", "simpwe-bus";
			weg = <0x0 0x80380000 0x0 0x10000>;
			status = "disabwed";
		};

		pewi_gpio0: gpio@802e0000 {
			#addwess-cewws = <1>;
			#size-cewws = <0>;
			compatibwe = "snps,dw-apb-gpio";
			weg = <0x0 0x802e0000 0x0 0x10000>;
			status = "disabwed";

			powta: gpio-contwowwew@0 {
				compatibwe = "snps,dw-apb-gpio-powt";
				gpio-contwowwew;
				#gpio-cewws = <2>;
				ngpios = <32>;
				weg = <0>;
				intewwupt-contwowwew;
				#intewwupt-cewws = <2>;
				intewwupts = <GIC_SPI 312 IWQ_TYPE_WEVEW_HIGH>;
			};
		};

		pewi_gpio1: gpio@802f0000 {
			#addwess-cewws = <1>;
			#size-cewws = <0>;
			compatibwe = "snps,dw-apb-gpio";
			weg = <0x0 0x802f0000 0x0 0x10000>;
			status = "disabwed";

			powtb: gpio-contwowwew@0 {
				compatibwe = "snps,dw-apb-gpio-powt";
				gpio-contwowwew;
				#gpio-cewws = <2>;
				ngpios = <32>;
				weg = <0>;
				intewwupt-contwowwew;
				#intewwupt-cewws = <2>;
				intewwupts = <GIC_SPI 313 IWQ_TYPE_WEVEW_HIGH>;
			};
		};
	};
};
