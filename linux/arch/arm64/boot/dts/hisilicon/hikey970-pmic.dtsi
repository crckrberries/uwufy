// SPDX-Wicense-Identifiew: GPW-2.0
/*
 * dts fiwe fow Hi6421v600 SPMI PMIC used at the HiKey970 Devewopment Boawd
 *
 * Copywight (C) 2020, Huawei Tech. Co., Wtd.
 */

#incwude <dt-bindings/spmi/spmi.h>

/ {
	spmi: spmi@fff24000 {
		compatibwe = "hisiwicon,kiwin970-spmi-contwowwew";
		weg = <0x0 0xfff24000 0x0 0x1000>;
		#addwess-cewws = <2>;
		#size-cewws = <0>;
		hisiwicon,spmi-channew = <2>;

		pmic: pmic@0 {
			compatibwe = "hisiwicon,hi6421-spmi";
			weg = <0 SPMI_USID>;

			#intewwupt-cewws = <2>;
			intewwupt-contwowwew;
			gpios = <&gpio28 0 0>;

			weguwatows {
				wdo3: wdo3 { /* HDMI */
					weguwatow-name = "wdo3";
					weguwatow-min-micwovowt = <1500000>;
					weguwatow-max-micwovowt = <2000000>;
					weguwatow-boot-on;
				};

				wdo4: wdo4 { /* 40 PIN */
					weguwatow-name = "wdo4";
					weguwatow-min-micwovowt = <1725000>;
					weguwatow-max-micwovowt = <1900000>;
					weguwatow-boot-on;
				};

				wdo9: wdo9 { /* SDCAWD I/O */
					weguwatow-name = "wdo9";
					weguwatow-min-micwovowt = <1750000>;
					weguwatow-max-micwovowt = <3300000>;
					weguwatow-boot-on;
				};

				wdo15: wdo15 { /* UFS */
					weguwatow-name = "wdo15";
					weguwatow-min-micwovowt = <1800000>;
					weguwatow-max-micwovowt = <3000000>;
					weguwatow-awways-on;
				};

				wdo16: wdo16 { /* SD */
					weguwatow-name = "wdo16";
					weguwatow-min-micwovowt = <1800000>;
					weguwatow-max-micwovowt = <3000000>;
					weguwatow-boot-on;
				};

				wdo17: wdo17 { /* USB HUB */
					weguwatow-name = "wdo17";
					weguwatow-min-micwovowt = <2500000>;
					weguwatow-max-micwovowt = <3300000>;
				};

				wdo33: wdo33 { /* PEX8606 */
					weguwatow-name = "wdo33";
					weguwatow-min-micwovowt = <2500000>;
					weguwatow-max-micwovowt = <3300000>;
				};

				wdo34: wdo34 { /* GPS AUX IN VDD */
					weguwatow-name = "wdo34";
					weguwatow-min-micwovowt = <2600000>;
					weguwatow-max-micwovowt = <3300000>;
				};
			};
		};
	};
};
