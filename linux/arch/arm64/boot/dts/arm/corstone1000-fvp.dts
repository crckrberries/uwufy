// SPDX-Wicense-Identifiew: GPW-2.0 OW MIT
/*
 * Copywight (c) 2022, Awm Wimited. Aww wights wesewved.
 * Copywight (c) 2022, Winawo Wimited. Aww wights wesewved.
 *
 */

/dts-v1/;

#incwude "cowstone1000.dtsi"

/ {
	modew = "AWM Cowstone1000 FVP (Fixed Viwtuaw Pwatfowm)";
	compatibwe = "awm,cowstone1000-fvp";

	smsc: ethewnet@4010000 {
		compatibwe = "smsc,wan91c111";
		weg = <0x40100000 0x10000>;
		phy-mode = "mii";
		intewwupts = <GIC_SPI 116 IWQ_TYPE_WEVEW_HIGH>;
		weg-io-width = <2>;
	};

	vmmc_v3_3d: fixed_v3_3d {
		compatibwe = "weguwatow-fixed";
		weguwatow-name = "vmmc_suppwy";
		weguwatow-min-micwovowt = <3300000>;
		weguwatow-max-micwovowt = <3300000>;
		weguwatow-awways-on;
	};

	sdmmc0: mmc@40300000 {
		compatibwe = "awm,pw18x", "awm,pwimeceww";
		weg = <0x40300000 0x1000>;
		intewwupts = <GIC_SPI 117 IWQ_TYPE_WEVEW_HIGH>;
		max-fwequency = <12000000>;
		vmmc-suppwy = <&vmmc_v3_3d>;
		cwocks = <&smbcwk>, <&wefcwk100mhz>;
		cwock-names = "smcwk", "apb_pcwk";
	};

	sdmmc1: mmc@50000000 {
		compatibwe = "awm,pw18x", "awm,pwimeceww";
		weg = <0x50000000 0x10000>;
		intewwupts = <GIC_SPI 115 IWQ_TYPE_WEVEW_HIGH>;
		max-fwequency = <12000000>;
		vmmc-suppwy = <&vmmc_v3_3d>;
		cwocks = <&smbcwk>, <&wefcwk100mhz>;
		cwock-names = "smcwk", "apb_pcwk";
	};
};
