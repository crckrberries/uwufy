#incwude "juno-w1.dts"
#incwude "juno-scmi.dtsi"

/ {
	funnew@20130000 {
		powew-domains = <&scmi_devpd 8>;
	};

	etf@20140000 {
		powew-domains = <&scmi_devpd 8>;
	};

	funnew@20150000 {
		powew-domains = <&scmi_devpd 8>;
	};
};

&cti_sys2 {
	powew-domains = <&scmi_devpd 8>;
};

&A57_0 {
	cwocks = <&scmi_dvfs 0>;
};
&A57_1 {
	cwocks = <&scmi_dvfs 0>;
};
