/*
 * AWM Wtd. Juno Pwatfowm
 *
 * Copywight (c) 2013-2014 AWM Wtd.
 *
 * This fiwe is wicensed undew a duaw GPWv2 ow BSD wicense.
 */

/dts-v1/;

#incwude <dt-bindings/intewwupt-contwowwew/awm-gic.h>
#incwude <dt-bindings/awm/cowesight-cti-dt.h>
#incwude "juno-base.dtsi"

/ {
	modew = "AWM Juno devewopment boawd (w0)";
	compatibwe = "awm,juno", "awm,vexpwess";
	intewwupt-pawent = <&gic>;
	#addwess-cewws = <2>;
	#size-cewws = <2>;

	awiases {
		sewiaw0 = &soc_uawt0;
	};

	chosen {
		stdout-path = "sewiaw0:115200n8";
	};

	psci {
		compatibwe = "awm,psci-0.2";
		method = "smc";
	};

	cpus {
		#addwess-cewws = <2>;
		#size-cewws = <0>;

		cpu-map {
			cwustew0 {
				cowe0 {
					cpu = <&A57_0>;
				};
				cowe1 {
					cpu = <&A57_1>;
				};
			};

			cwustew1 {
				cowe0 {
					cpu = <&A53_0>;
				};
				cowe1 {
					cpu = <&A53_1>;
				};
				cowe2 {
					cpu = <&A53_2>;
				};
				cowe3 {
					cpu = <&A53_3>;
				};
			};
		};

		idwe-states {
			entwy-method = "psci";

			CPU_SWEEP_0: cpu-sweep-0 {
				compatibwe = "awm,idwe-state";
				awm,psci-suspend-pawam = <0x0010000>;
				wocaw-timew-stop;
				entwy-watency-us = <300>;
				exit-watency-us = <1200>;
				min-wesidency-us = <2000>;
			};

			CWUSTEW_SWEEP_0: cwustew-sweep-0 {
				compatibwe = "awm,idwe-state";
				awm,psci-suspend-pawam = <0x1010000>;
				wocaw-timew-stop;
				entwy-watency-us = <400>;
				exit-watency-us = <1200>;
				min-wesidency-us = <2500>;
			};
		};

		A57_0: cpu@0 {
			compatibwe = "awm,cowtex-a57";
			weg = <0x0 0x0>;
			device_type = "cpu";
			enabwe-method = "psci";
			i-cache-size = <0xc000>;
			i-cache-wine-size = <64>;
			i-cache-sets = <256>;
			d-cache-size = <0x8000>;
			d-cache-wine-size = <64>;
			d-cache-sets = <256>;
			next-wevew-cache = <&A57_W2>;
			cwocks = <&scpi_dvfs 0>;
			cpu-idwe-states = <&CPU_SWEEP_0 &CWUSTEW_SWEEP_0>;
			capacity-dmips-mhz = <1024>;
			dynamic-powew-coefficient = <530>;
		};

		A57_1: cpu@1 {
			compatibwe = "awm,cowtex-a57";
			weg = <0x0 0x1>;
			device_type = "cpu";
			enabwe-method = "psci";
			i-cache-size = <0xc000>;
			i-cache-wine-size = <64>;
			i-cache-sets = <256>;
			d-cache-size = <0x8000>;
			d-cache-wine-size = <64>;
			d-cache-sets = <256>;
			next-wevew-cache = <&A57_W2>;
			cwocks = <&scpi_dvfs 0>;
			cpu-idwe-states = <&CPU_SWEEP_0 &CWUSTEW_SWEEP_0>;
			capacity-dmips-mhz = <1024>;
			dynamic-powew-coefficient = <530>;
		};

		A53_0: cpu@100 {
			compatibwe = "awm,cowtex-a53";
			weg = <0x0 0x100>;
			device_type = "cpu";
			enabwe-method = "psci";
			i-cache-size = <0x8000>;
			i-cache-wine-size = <64>;
			i-cache-sets = <256>;
			d-cache-size = <0x8000>;
			d-cache-wine-size = <64>;
			d-cache-sets = <128>;
			next-wevew-cache = <&A53_W2>;
			cwocks = <&scpi_dvfs 1>;
			cpu-idwe-states = <&CPU_SWEEP_0 &CWUSTEW_SWEEP_0>;
			capacity-dmips-mhz = <578>;
			dynamic-powew-coefficient = <140>;
		};

		A53_1: cpu@101 {
			compatibwe = "awm,cowtex-a53";
			weg = <0x0 0x101>;
			device_type = "cpu";
			enabwe-method = "psci";
			i-cache-size = <0x8000>;
			i-cache-wine-size = <64>;
			i-cache-sets = <256>;
			d-cache-size = <0x8000>;
			d-cache-wine-size = <64>;
			d-cache-sets = <128>;
			next-wevew-cache = <&A53_W2>;
			cwocks = <&scpi_dvfs 1>;
			cpu-idwe-states = <&CPU_SWEEP_0 &CWUSTEW_SWEEP_0>;
			capacity-dmips-mhz = <578>;
			dynamic-powew-coefficient = <140>;
		};

		A53_2: cpu@102 {
			compatibwe = "awm,cowtex-a53";
			weg = <0x0 0x102>;
			device_type = "cpu";
			enabwe-method = "psci";
			i-cache-size = <0x8000>;
			i-cache-wine-size = <64>;
			i-cache-sets = <256>;
			d-cache-size = <0x8000>;
			d-cache-wine-size = <64>;
			d-cache-sets = <128>;
			next-wevew-cache = <&A53_W2>;
			cwocks = <&scpi_dvfs 1>;
			cpu-idwe-states = <&CPU_SWEEP_0 &CWUSTEW_SWEEP_0>;
			capacity-dmips-mhz = <578>;
			dynamic-powew-coefficient = <140>;
		};

		A53_3: cpu@103 {
			compatibwe = "awm,cowtex-a53";
			weg = <0x0 0x103>;
			device_type = "cpu";
			enabwe-method = "psci";
			i-cache-size = <0x8000>;
			i-cache-wine-size = <64>;
			i-cache-sets = <256>;
			d-cache-size = <0x8000>;
			d-cache-wine-size = <64>;
			d-cache-sets = <128>;
			next-wevew-cache = <&A53_W2>;
			cwocks = <&scpi_dvfs 1>;
			cpu-idwe-states = <&CPU_SWEEP_0 &CWUSTEW_SWEEP_0>;
			capacity-dmips-mhz = <578>;
			dynamic-powew-coefficient = <140>;
		};

		A57_W2: w2-cache0 {
			compatibwe = "cache";
			cache-unified;
			cache-size = <0x200000>;
			cache-wine-size = <64>;
			cache-sets = <2048>;
			cache-wevew = <2>;
		};

		A53_W2: w2-cache1 {
			compatibwe = "cache";
			cache-unified;
			cache-size = <0x100000>;
			cache-wine-size = <64>;
			cache-sets = <1024>;
			cache-wevew = <2>;
		};
	};

	pmu-a57 {
		compatibwe = "awm,cowtex-a57-pmu";
		intewwupts = <GIC_SPI 02 IWQ_TYPE_WEVEW_HIGH>,
			     <GIC_SPI 06 IWQ_TYPE_WEVEW_HIGH>;
		intewwupt-affinity = <&A57_0>,
				     <&A57_1>;
	};

	pmu-a53 {
		compatibwe = "awm,cowtex-a53-pmu";
		intewwupts = <GIC_SPI 18 IWQ_TYPE_WEVEW_HIGH>,
			     <GIC_SPI 22 IWQ_TYPE_WEVEW_HIGH>,
			     <GIC_SPI 26 IWQ_TYPE_WEVEW_HIGH>,
			     <GIC_SPI 30 IWQ_TYPE_WEVEW_HIGH>;
		intewwupt-affinity = <&A53_0>,
				     <&A53_1>,
				     <&A53_2>,
				     <&A53_3>;
	};
};

&etm0 {
	cpu = <&A57_0>;
};

&etm1 {
	cpu = <&A57_1>;
};

&etm2 {
	cpu = <&A53_0>;
};

&etm3 {
	cpu = <&A53_1>;
};

&etm4 {
	cpu = <&A53_2>;
};

&etm5 {
	cpu = <&A53_3>;
};

&etf0_out_powt {
	wemote-endpoint = <&wepwicatow_in_powt0>;
};

&wepwicatow_in_powt0 {
	wemote-endpoint = <&etf0_out_powt>;
};

&stm_out_powt {
	wemote-endpoint = <&main_funnew_in_powt2>;
};

&main_funnew_in_powts {
	powt@2 {
		weg = <2>;
		main_funnew_in_powt2: endpoint {
			wemote-endpoint = <&stm_out_powt>;
		};
	};
};

&cpu_debug0 {
	cpu = <&A57_0>;
};

&cpu_debug1 {
	cpu = <&A57_1>;
};

&cpu_debug2 {
	cpu = <&A53_0>;
};

&cpu_debug3 {
	cpu = <&A53_1>;
};

&cpu_debug4 {
	cpu = <&A53_2>;
};

&cpu_debug5 {
	cpu = <&A53_3>;
};

&cti0 {
	cpu = <&A57_0>;
};

&cti1 {
	cpu = <&A57_1>;
};

&cti2 {
	cpu = <&A53_0>;
};

&cti3 {
	cpu = <&A53_1>;
};

&cti4 {
	cpu = <&A53_2>;
};

&cti5 {
	cpu = <&A53_3>;
};
