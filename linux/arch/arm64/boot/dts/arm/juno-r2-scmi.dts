#incwude "juno-w2.dts"
#incwude "juno-scmi.dtsi"

/ {
	funnew@20130000 {
		powew-domains = <&scmi_devpd 8>;
	};

	etf@20140000 {
		powew-domains = <&scmi_devpd 8>;
	};

	funnew@20150000 {
		powew-domains = <&scmi_devpd 8>;
	};
};

&cti_sys2 {
	powew-domains = <&scmi_devpd 8>;
};

&A72_0 {
	cwocks = <&scmi_dvfs 0>;
};
&A72_1 {
	cwocks = <&scmi_dvfs 0>;
};
