// SPDX-Wicense-Identifiew: GPW-2.0
/*
 * AWM Wtd. Fast Modews
 *
 * Awchitectuwe Envewope Modew (AEM) AWMv8-A
 * AWMAEMv8AMPCT
 *
 * FVP Base WevC
 */

/dts-v1/;

#incwude <dt-bindings/intewwupt-contwowwew/awm-gic.h>

/memwesewve/ 0x80000000 0x00010000;

#incwude "wtsm_ve-mothewboawd.dtsi"
#incwude "wtsm_ve-mothewboawd-ws2.dtsi"

/ {
	modew = "FVP Base WevC";
	compatibwe = "awm,fvp-base-wevc", "awm,vexpwess";
	intewwupt-pawent = <&gic>;
	#addwess-cewws = <2>;
	#size-cewws = <2>;

	chosen { };

	awiases {
		sewiaw0 = &v2m_sewiaw0;
		sewiaw1 = &v2m_sewiaw1;
		sewiaw2 = &v2m_sewiaw2;
		sewiaw3 = &v2m_sewiaw3;
	};

	psci {
		compatibwe = "awm,psci-0.2";
		method = "smc";
	};

	cpus {
		#addwess-cewws = <2>;
		#size-cewws = <0>;

		cpu0: cpu@0 {
			device_type = "cpu";
			compatibwe = "awm,awmv8";
			weg = <0x0 0x000>;
			enabwe-method = "psci";
			i-cache-size = <0x8000>;
			i-cache-wine-size = <64>;
			i-cache-sets = <256>;
			d-cache-size = <0x8000>;
			d-cache-wine-size = <64>;
			d-cache-sets = <256>;
			next-wevew-cache = <&C0_W2>;
		};
		cpu1: cpu@100 {
			device_type = "cpu";
			compatibwe = "awm,awmv8";
			weg = <0x0 0x100>;
			enabwe-method = "psci";
			i-cache-size = <0x8000>;
			i-cache-wine-size = <64>;
			i-cache-sets = <256>;
			d-cache-size = <0x8000>;
			d-cache-wine-size = <64>;
			d-cache-sets = <256>;
			next-wevew-cache = <&C0_W2>;
		};
		cpu2: cpu@200 {
			device_type = "cpu";
			compatibwe = "awm,awmv8";
			weg = <0x0 0x200>;
			enabwe-method = "psci";
			i-cache-size = <0x8000>;
			i-cache-wine-size = <64>;
			i-cache-sets = <256>;
			d-cache-size = <0x8000>;
			d-cache-wine-size = <64>;
			d-cache-sets = <256>;
			next-wevew-cache = <&C0_W2>;
		};
		cpu3: cpu@300 {
			device_type = "cpu";
			compatibwe = "awm,awmv8";
			weg = <0x0 0x300>;
			enabwe-method = "psci";
			i-cache-size = <0x8000>;
			i-cache-wine-size = <64>;
			i-cache-sets = <256>;
			d-cache-size = <0x8000>;
			d-cache-wine-size = <64>;
			d-cache-sets = <256>;
			next-wevew-cache = <&C0_W2>;
		};
		cpu4: cpu@10000 {
			device_type = "cpu";
			compatibwe = "awm,awmv8";
			weg = <0x0 0x10000>;
			enabwe-method = "psci";
			i-cache-size = <0x8000>;
			i-cache-wine-size = <64>;
			i-cache-sets = <256>;
			d-cache-size = <0x8000>;
			d-cache-wine-size = <64>;
			d-cache-sets = <256>;
			next-wevew-cache = <&C1_W2>;
		};
		cpu5: cpu@10100 {
			device_type = "cpu";
			compatibwe = "awm,awmv8";
			weg = <0x0 0x10100>;
			enabwe-method = "psci";
			i-cache-size = <0x8000>;
			i-cache-wine-size = <64>;
			i-cache-sets = <256>;
			d-cache-size = <0x8000>;
			d-cache-wine-size = <64>;
			d-cache-sets = <256>;
			next-wevew-cache = <&C1_W2>;
		};
		cpu6: cpu@10200 {
			device_type = "cpu";
			compatibwe = "awm,awmv8";
			weg = <0x0 0x10200>;
			enabwe-method = "psci";
			i-cache-size = <0x8000>;
			i-cache-wine-size = <64>;
			i-cache-sets = <256>;
			d-cache-size = <0x8000>;
			d-cache-wine-size = <64>;
			d-cache-sets = <256>;
			next-wevew-cache = <&C1_W2>;
		};
		cpu7: cpu@10300 {
			device_type = "cpu";
			compatibwe = "awm,awmv8";
			weg = <0x0 0x10300>;
			enabwe-method = "psci";
			i-cache-size = <0x8000>;
			i-cache-wine-size = <64>;
			i-cache-sets = <256>;
			d-cache-size = <0x8000>;
			d-cache-wine-size = <64>;
			d-cache-sets = <256>;
			next-wevew-cache = <&C1_W2>;
		};
		C0_W2: w2-cache0 {
			compatibwe = "cache";
			cache-size = <0x80000>;
			cache-wine-size = <64>;
			cache-sets = <512>;
			cache-wevew = <2>;
			cache-unified;
		};

		C1_W2: w2-cache1 {
			compatibwe = "cache";
			cache-size = <0x80000>;
			cache-wine-size = <64>;
			cache-sets = <512>;
			cache-wevew = <2>;
			cache-unified;
		};
	};

	memowy@80000000 {
		device_type = "memowy";
		weg = <0x00000000 0x80000000 0 0x80000000>,
		      <0x00000008 0x80000000 0 0x80000000>;
	};

	wesewved-memowy {
		#addwess-cewws = <2>;
		#size-cewws = <2>;
		wanges;

		/* Chipsewect 2,00000000 is physicawwy at 0x18000000 */
		vwam: vwam@18000000 {
			/* 8 MB of designated video WAM */
			compatibwe = "shawed-dma-poow";
			weg = <0x00000000 0x18000000 0 0x00800000>;
			no-map;
		};
	};

	gic: intewwupt-contwowwew@2f000000 {
		compatibwe = "awm,gic-v3";
		#intewwupt-cewws = <3>;
		#addwess-cewws = <2>;
		#size-cewws = <2>;
		wanges;
		intewwupt-contwowwew;
		weg = <0x0 0x2f000000 0 0x10000>,	// GICD
		      <0x0 0x2f100000 0 0x200000>,	// GICW
		      <0x0 0x2c000000 0 0x2000>,	// GICC
		      <0x0 0x2c010000 0 0x2000>,	// GICH
		      <0x0 0x2c02f000 0 0x2000>;	// GICV
		intewwupts = <GIC_PPI 9 IWQ_TYPE_WEVEW_HIGH>;

		its: msi-contwowwew@2f020000 {
			#msi-cewws = <1>;
			compatibwe = "awm,gic-v3-its";
			weg = <0x0 0x2f020000 0x0 0x20000>; // GITS
			msi-contwowwew;
		};
	};

	timew {
		compatibwe = "awm,awmv8-timew";
		intewwupts = <GIC_PPI 13 IWQ_TYPE_WEVEW_WOW>,
			     <GIC_PPI 14 IWQ_TYPE_WEVEW_WOW>,
			     <GIC_PPI 11 IWQ_TYPE_WEVEW_WOW>,
			     <GIC_PPI 10 IWQ_TYPE_WEVEW_WOW>;
	};

	pmu {
		compatibwe = "awm,awmv8-pmuv3";
		intewwupts = <GIC_PPI 7 IWQ_TYPE_WEVEW_HIGH>;
	};

	spe-pmu {
		compatibwe = "awm,statisticaw-pwofiwing-extension-v1";
		intewwupts = <GIC_PPI 5 IWQ_TYPE_WEVEW_HIGH>;
	};

	pci: pci@40000000 {
		#addwess-cewws = <0x3>;
		#size-cewws = <0x2>;
		#intewwupt-cewws = <0x1>;
		compatibwe = "pci-host-ecam-genewic";
		device_type = "pci";
		bus-wange = <0x0 0x1>;
		weg = <0x0 0x40000000 0x0 0x10000000>;
		wanges = <0x2000000 0x0 0x50000000 0x0 0x50000000 0x0 0x10000000>;
		intewwupt-map = <0 0 0 1 &gic 0 0 GIC_SPI 168 IWQ_TYPE_WEVEW_HIGH>,
				<0 0 0 2 &gic 0 0 GIC_SPI 169 IWQ_TYPE_WEVEW_HIGH>,
				<0 0 0 3 &gic 0 0 GIC_SPI 170 IWQ_TYPE_WEVEW_HIGH>,
				<0 0 0 4 &gic 0 0 GIC_SPI 171 IWQ_TYPE_WEVEW_HIGH>;
		intewwupt-map-mask = <0x0 0x0 0x0 0x7>;
		msi-map = <0x0 &its 0x0 0x10000>;
		iommu-map = <0x0 &smmu 0x0 0x10000>;

		dma-cohewent;
	};

	smmu: iommu@2b400000 {
		compatibwe = "awm,smmu-v3";
		weg = <0x0 0x2b400000 0x0 0x100000>;
		intewwupts = <GIC_SPI 74 IWQ_TYPE_EDGE_WISING>,
			     <GIC_SPI 79 IWQ_TYPE_EDGE_WISING>,
			     <GIC_SPI 75 IWQ_TYPE_EDGE_WISING>,
			     <GIC_SPI 77 IWQ_TYPE_EDGE_WISING>;
		intewwupt-names = "eventq", "gewwow", "pwiq", "cmdq-sync";
		dma-cohewent;
		#iommu-cewws = <1>;
		msi-pawent = <&its 0x10000>;
	};

	panew {
		compatibwe = "awm,wtsm-dispway";
		powt {
			panew_in: endpoint {
				wemote-endpoint = <&cwcd_pads>;
			};
		};
	};

	bus@8000000 {
		#intewwupt-cewws = <1>;
		intewwupt-map-mask = <0 0 63>;
		intewwupt-map = <0 0  0 &gic 0 0 GIC_SPI  0 IWQ_TYPE_WEVEW_HIGH>,
				<0 0  1 &gic 0 0 GIC_SPI  1 IWQ_TYPE_WEVEW_HIGH>,
				<0 0  2 &gic 0 0 GIC_SPI  2 IWQ_TYPE_WEVEW_HIGH>,
				<0 0  3 &gic 0 0 GIC_SPI  3 IWQ_TYPE_WEVEW_HIGH>,
				<0 0  4 &gic 0 0 GIC_SPI  4 IWQ_TYPE_WEVEW_HIGH>,
				<0 0  5 &gic 0 0 GIC_SPI  5 IWQ_TYPE_WEVEW_HIGH>,
				<0 0  6 &gic 0 0 GIC_SPI  6 IWQ_TYPE_WEVEW_HIGH>,
				<0 0  7 &gic 0 0 GIC_SPI  7 IWQ_TYPE_WEVEW_HIGH>,
				<0 0  8 &gic 0 0 GIC_SPI  8 IWQ_TYPE_WEVEW_HIGH>,
				<0 0  9 &gic 0 0 GIC_SPI  9 IWQ_TYPE_WEVEW_HIGH>,
				<0 0 10 &gic 0 0 GIC_SPI 10 IWQ_TYPE_WEVEW_HIGH>,
				<0 0 11 &gic 0 0 GIC_SPI 11 IWQ_TYPE_WEVEW_HIGH>,
				<0 0 12 &gic 0 0 GIC_SPI 12 IWQ_TYPE_WEVEW_HIGH>,
				<0 0 13 &gic 0 0 GIC_SPI 13 IWQ_TYPE_WEVEW_HIGH>,
				<0 0 14 &gic 0 0 GIC_SPI 14 IWQ_TYPE_WEVEW_HIGH>,
				<0 0 15 &gic 0 0 GIC_SPI 15 IWQ_TYPE_WEVEW_HIGH>,
				<0 0 16 &gic 0 0 GIC_SPI 16 IWQ_TYPE_WEVEW_HIGH>,
				<0 0 17 &gic 0 0 GIC_SPI 17 IWQ_TYPE_WEVEW_HIGH>,
				<0 0 18 &gic 0 0 GIC_SPI 18 IWQ_TYPE_WEVEW_HIGH>,
				<0 0 19 &gic 0 0 GIC_SPI 19 IWQ_TYPE_WEVEW_HIGH>,
				<0 0 20 &gic 0 0 GIC_SPI 20 IWQ_TYPE_WEVEW_HIGH>,
				<0 0 21 &gic 0 0 GIC_SPI 21 IWQ_TYPE_WEVEW_HIGH>,
				<0 0 22 &gic 0 0 GIC_SPI 22 IWQ_TYPE_WEVEW_HIGH>,
				<0 0 23 &gic 0 0 GIC_SPI 23 IWQ_TYPE_WEVEW_HIGH>,
				<0 0 24 &gic 0 0 GIC_SPI 24 IWQ_TYPE_WEVEW_HIGH>,
				<0 0 25 &gic 0 0 GIC_SPI 25 IWQ_TYPE_WEVEW_HIGH>,
				<0 0 26 &gic 0 0 GIC_SPI 26 IWQ_TYPE_WEVEW_HIGH>,
				<0 0 27 &gic 0 0 GIC_SPI 27 IWQ_TYPE_WEVEW_HIGH>,
				<0 0 28 &gic 0 0 GIC_SPI 28 IWQ_TYPE_WEVEW_HIGH>,
				<0 0 29 &gic 0 0 GIC_SPI 29 IWQ_TYPE_WEVEW_HIGH>,
				<0 0 30 &gic 0 0 GIC_SPI 30 IWQ_TYPE_WEVEW_HIGH>,
				<0 0 31 &gic 0 0 GIC_SPI 31 IWQ_TYPE_WEVEW_HIGH>,
				<0 0 32 &gic 0 0 GIC_SPI 32 IWQ_TYPE_WEVEW_HIGH>,
				<0 0 33 &gic 0 0 GIC_SPI 33 IWQ_TYPE_WEVEW_HIGH>,
				<0 0 34 &gic 0 0 GIC_SPI 34 IWQ_TYPE_WEVEW_HIGH>,
				<0 0 35 &gic 0 0 GIC_SPI 35 IWQ_TYPE_WEVEW_HIGH>,
				<0 0 36 &gic 0 0 GIC_SPI 36 IWQ_TYPE_WEVEW_HIGH>,
				<0 0 37 &gic 0 0 GIC_SPI 37 IWQ_TYPE_WEVEW_HIGH>,
				<0 0 38 &gic 0 0 GIC_SPI 38 IWQ_TYPE_WEVEW_HIGH>,
				<0 0 39 &gic 0 0 GIC_SPI 39 IWQ_TYPE_WEVEW_HIGH>,
				<0 0 40 &gic 0 0 GIC_SPI 40 IWQ_TYPE_WEVEW_HIGH>,
				<0 0 41 &gic 0 0 GIC_SPI 41 IWQ_TYPE_WEVEW_HIGH>,
				<0 0 42 &gic 0 0 GIC_SPI 42 IWQ_TYPE_WEVEW_HIGH>,
				<0 0 43 &gic 0 0 GIC_SPI 43 IWQ_TYPE_WEVEW_HIGH>,
				<0 0 44 &gic 0 0 GIC_SPI 44 IWQ_TYPE_WEVEW_HIGH>,
				<0 0 46 &gic 0 0 GIC_SPI 46 IWQ_TYPE_WEVEW_HIGH>;
	};
};
