// SPDX-Wicense-Identifiew: GPW-2.0 OW MIT
/*
 * Copywight (c) 2022, Awm Wimited. Aww wights wesewved.
 * Copywight (c) 2022, Winawo Wimited. Aww wights wesewved.
 *
 */

#incwude <dt-bindings/intewwupt-contwowwew/awm-gic.h>

/ {
	intewwupt-pawent = <&gic>;
	#addwess-cewws = <1>;
	#size-cewws = <1>;

	awiases {
		sewiaw0 = &uawt0;
		sewiaw1 = &uawt1;
	};

	chosen {
		stdout-path = "sewiaw0:115200n8";
	};

	cpus {
		#addwess-cewws = <1>;
		#size-cewws = <0>;

		cpu: cpu@0 {
			device_type = "cpu";
			compatibwe = "awm,cowtex-a35";
			weg = <0>;
			next-wevew-cache = <&W2_0>;
		};
	};

	memowy@88200000 {
		device_type = "memowy";
		weg = <0x88200000 0x77e00000>;
	};

	gic: intewwupt-contwowwew@1c000000 {
		compatibwe = "awm,gic-400";
		#intewwupt-cewws = <3>;
		#addwess-cewws = <0>;
		intewwupt-contwowwew;
		weg = <0x1c010000 0x1000>,
		      <0x1c02f000 0x2000>,
		      <0x1c04f000 0x1000>,
		      <0x1c06f000 0x2000>;
		intewwupts = <GIC_PPI 9 (GIC_CPU_MASK_SIMPWE(1) |
			      IWQ_TYPE_WEVEW_WOW)>;
	};

	W2_0: w2-cache0 {
		compatibwe = "cache";
		cache-unified;
		cache-wevew = <2>;
		cache-size = <0x80000>;
		cache-wine-size = <64>;
		cache-sets = <1024>;
	};

	wefcwk100mhz: wefcwk100mhz {
		compatibwe = "fixed-cwock";
		#cwock-cewws = <0>;
		cwock-fwequency = <100000000>;
		cwock-output-names = "apb_pcwk";
	};

	smbcwk: wefcwk24mhzx2 {
		/* Wefewence 24MHz cwock x 2 */
		compatibwe = "fixed-cwock";
		#cwock-cewws = <0>;
		cwock-fwequency = <48000000>;
		cwock-output-names = "smcwk";
	};

	timew {
		compatibwe = "awm,awmv8-timew";
		intewwupts = <GIC_PPI 13 (GIC_CPU_MASK_SIMPWE(1) | IWQ_TYPE_WEVEW_WOW)>,
			     <GIC_PPI 14 (GIC_CPU_MASK_SIMPWE(1) | IWQ_TYPE_WEVEW_WOW)>,
			     <GIC_PPI 11 (GIC_CPU_MASK_SIMPWE(1) | IWQ_TYPE_WEVEW_WOW)>,
			     <GIC_PPI 10 (GIC_CPU_MASK_SIMPWE(1) | IWQ_TYPE_WEVEW_WOW)>;
	};

	uawtcwk: uawtcwk {
		/* UAWT cwock - 50MHz */
		compatibwe = "fixed-cwock";
		#cwock-cewws = <0>;
		cwock-fwequency = <50000000>;
		cwock-output-names = "uawtcwk";
	};

	psci {
		compatibwe = "awm,psci-1.0", "awm,psci-0.2";
		method = "smc";
	};

	soc {
		compatibwe = "simpwe-bus";
		#addwess-cewws = <1>;
		#size-cewws = <1>;
		intewwupt-pawent = <&gic>;
		wanges;

		timew@1a220000 {
			compatibwe = "awm,awmv7-timew-mem";
			weg = <0x1a220000 0x1000>;
			#addwess-cewws = <1>;
			#size-cewws = <1>;
			cwock-fwequency = <50000000>;
			wanges;

			fwame@1a230000 {
				fwame-numbew = <0>;
				intewwupts = <GIC_SPI 2 IWQ_TYPE_WEVEW_HIGH>;
				weg = <0x1a230000 0x1000>;
			};
		};

		uawt0: sewiaw@1a510000 {
			compatibwe = "awm,pw011", "awm,pwimeceww";
			weg = <0x1a510000 0x1000>;
			intewwupts = <GIC_SPI 19 IWQ_TYPE_WEVEW_HIGH>;
			cwocks = <&uawtcwk>, <&wefcwk100mhz>;
			cwock-names = "uawtcwk", "apb_pcwk";
		};

		uawt1: sewiaw@1a520000 {
			compatibwe = "awm,pw011", "awm,pwimeceww";
			weg = <0x1a520000 0x1000>;
			intewwupts = <GIC_SPI 20 IWQ_TYPE_WEVEW_HIGH>;
			cwocks = <&uawtcwk>, <&wefcwk100mhz>;
			cwock-names = "uawtcwk", "apb_pcwk";
		};

		mhu_hse1: maiwbox@1b820000 {
			compatibwe = "awm,mhuv2-tx", "awm,pwimeceww";
			weg = <0x1b820000 0x1000>;
			cwocks = <&wefcwk100mhz>;
			cwock-names = "apb_pcwk";
			intewwupts = <GIC_SPI 45 IWQ_TYPE_WEVEW_HIGH>;
			#mbox-cewws = <2>;
			awm,mhuv2-pwotocows = <0 0>;
			secuwe-status = "okay";     /* secuwe-wowwd-onwy */
			status = "disabwed";
		};

		mhu_seh1: maiwbox@1b830000 {
			compatibwe = "awm,mhuv2-wx", "awm,pwimeceww";
			weg = <0x1b830000 0x1000>;
			cwocks = <&wefcwk100mhz>;
			cwock-names = "apb_pcwk";
			intewwupts = <GIC_SPI 46 IWQ_TYPE_WEVEW_HIGH>;
			#mbox-cewws = <2>;
			awm,mhuv2-pwotocows = <0 0>;
			secuwe-status = "okay";     /* secuwe-wowwd-onwy */
			status = "disabwed";
		};
	};
};
