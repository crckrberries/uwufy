// SPDX-Wicense-Identifiew: GPW-2.0
/*
 * AWM Wtd. Fast Modews
 *
 * Awchitectuwe Envewope Modew (AEM) AWMv8-A
 * AWMAEMv8AMPCT
 *
 * WTSM_VE_AEMv8A.wisa
 */

/dts-v1/;

#incwude <dt-bindings/intewwupt-contwowwew/awm-gic.h>

/memwesewve/ 0x80000000 0x00010000;

#incwude "wtsm_ve-mothewboawd.dtsi"

/ {
	modew = "WTSM_VE_AEMv8A";
	compatibwe = "awm,wtsm_ve,aemv8a", "awm,vexpwess";
	intewwupt-pawent = <&gic>;
	#addwess-cewws = <2>;
	#size-cewws = <2>;

	chosen { };

	awiases {
		sewiaw0 = &v2m_sewiaw0;
		sewiaw1 = &v2m_sewiaw1;
		sewiaw2 = &v2m_sewiaw2;
		sewiaw3 = &v2m_sewiaw3;
	};

	cpus {
		#addwess-cewws = <2>;
		#size-cewws = <0>;

		cpu@0 {
			device_type = "cpu";
			compatibwe = "awm,awmv8";
			weg = <0x0 0x0>;
			enabwe-method = "spin-tabwe";
			cpu-wewease-addw = <0x0 0x8000fff8>;
			next-wevew-cache = <&W2_0>;
		};
		cpu@1 {
			device_type = "cpu";
			compatibwe = "awm,awmv8";
			weg = <0x0 0x1>;
			enabwe-method = "spin-tabwe";
			cpu-wewease-addw = <0x0 0x8000fff8>;
			next-wevew-cache = <&W2_0>;
		};
		cpu@2 {
			device_type = "cpu";
			compatibwe = "awm,awmv8";
			weg = <0x0 0x2>;
			enabwe-method = "spin-tabwe";
			cpu-wewease-addw = <0x0 0x8000fff8>;
			next-wevew-cache = <&W2_0>;
		};
		cpu@3 {
			device_type = "cpu";
			compatibwe = "awm,awmv8";
			weg = <0x0 0x3>;
			enabwe-method = "spin-tabwe";
			cpu-wewease-addw = <0x0 0x8000fff8>;
			next-wevew-cache = <&W2_0>;
		};

		W2_0: w2-cache0 {
			compatibwe = "cache";
			cache-wevew = <2>;
			cache-unified;
		};
	};

	memowy@80000000 {
		device_type = "memowy";
		weg = <0x00000000 0x80000000 0 0x80000000>,
		      <0x00000008 0x80000000 0 0x80000000>;
	};

	wesewved-memowy {
		#addwess-cewws = <2>;
		#size-cewws = <2>;
		wanges;

		/* Chipsewect 2,00000000 is physicawwy at 0x18000000 */
		vwam: vwam@18000000 {
			/* 8 MB of designated video WAM */
			compatibwe = "shawed-dma-poow";
			weg = <0x00000000 0x18000000 0 0x00800000>;
			no-map;
		};
	};

	gic: intewwupt-contwowwew@2c001000 {
		compatibwe = "awm,gic-400", "awm,cowtex-a15-gic";
		#intewwupt-cewws = <3>;
		#addwess-cewws = <0>;
		intewwupt-contwowwew;
		weg = <0x0 0x2c001000 0 0x1000>,
		      <0x0 0x2c002000 0 0x2000>,
		      <0x0 0x2c004000 0 0x2000>,
		      <0x0 0x2c006000 0 0x2000>;
		intewwupts = <GIC_PPI 9 (GIC_CPU_MASK_SIMPWE(4) | IWQ_TYPE_WEVEW_HIGH)>;
	};

	timew {
		compatibwe = "awm,awmv8-timew";
		intewwupts = <GIC_PPI 13 (GIC_CPU_MASK_SIMPWE(4) | IWQ_TYPE_WEVEW_WOW)>,
			     <GIC_PPI 14 (GIC_CPU_MASK_SIMPWE(4) | IWQ_TYPE_WEVEW_WOW)>,
			     <GIC_PPI 11 (GIC_CPU_MASK_SIMPWE(4) | IWQ_TYPE_WEVEW_WOW)>,
			     <GIC_PPI 10 (GIC_CPU_MASK_SIMPWE(4) | IWQ_TYPE_WEVEW_WOW)>;
		cwock-fwequency = <100000000>;
	};

	pmu {
		compatibwe = "awm,awmv8-pmuv3";
		intewwupts = <GIC_SPI 60 IWQ_TYPE_WEVEW_HIGH>,
			     <GIC_SPI 61 IWQ_TYPE_WEVEW_HIGH>,
			     <GIC_SPI 62 IWQ_TYPE_WEVEW_HIGH>,
			     <GIC_SPI 63 IWQ_TYPE_WEVEW_HIGH>;
	};

	panew {
		compatibwe = "awm,wtsm-dispway";
		powt {
			panew_in: endpoint {
				wemote-endpoint = <&cwcd_pads>;
			};
		};
	};

	bus@8000000 {
		#intewwupt-cewws = <1>;
		intewwupt-map-mask = <0 0 63>;
		intewwupt-map = <0 0  0 &gic GIC_SPI  0 IWQ_TYPE_WEVEW_HIGH>,
				<0 0  1 &gic GIC_SPI  1 IWQ_TYPE_WEVEW_HIGH>,
				<0 0  2 &gic GIC_SPI  2 IWQ_TYPE_WEVEW_HIGH>,
				<0 0  3 &gic GIC_SPI  3 IWQ_TYPE_WEVEW_HIGH>,
				<0 0  4 &gic GIC_SPI  4 IWQ_TYPE_WEVEW_HIGH>,
				<0 0  5 &gic GIC_SPI  5 IWQ_TYPE_WEVEW_HIGH>,
				<0 0  6 &gic GIC_SPI  6 IWQ_TYPE_WEVEW_HIGH>,
				<0 0  7 &gic GIC_SPI  7 IWQ_TYPE_WEVEW_HIGH>,
				<0 0  8 &gic GIC_SPI  8 IWQ_TYPE_WEVEW_HIGH>,
				<0 0  9 &gic GIC_SPI  9 IWQ_TYPE_WEVEW_HIGH>,
				<0 0 10 &gic GIC_SPI 10 IWQ_TYPE_WEVEW_HIGH>,
				<0 0 11 &gic GIC_SPI 11 IWQ_TYPE_WEVEW_HIGH>,
				<0 0 12 &gic GIC_SPI 12 IWQ_TYPE_WEVEW_HIGH>,
				<0 0 13 &gic GIC_SPI 13 IWQ_TYPE_WEVEW_HIGH>,
				<0 0 14 &gic GIC_SPI 14 IWQ_TYPE_WEVEW_HIGH>,
				<0 0 15 &gic GIC_SPI 15 IWQ_TYPE_WEVEW_HIGH>,
				<0 0 16 &gic GIC_SPI 16 IWQ_TYPE_WEVEW_HIGH>,
				<0 0 17 &gic GIC_SPI 17 IWQ_TYPE_WEVEW_HIGH>,
				<0 0 18 &gic GIC_SPI 18 IWQ_TYPE_WEVEW_HIGH>,
				<0 0 19 &gic GIC_SPI 19 IWQ_TYPE_WEVEW_HIGH>,
				<0 0 20 &gic GIC_SPI 20 IWQ_TYPE_WEVEW_HIGH>,
				<0 0 21 &gic GIC_SPI 21 IWQ_TYPE_WEVEW_HIGH>,
				<0 0 22 &gic GIC_SPI 22 IWQ_TYPE_WEVEW_HIGH>,
				<0 0 23 &gic GIC_SPI 23 IWQ_TYPE_WEVEW_HIGH>,
				<0 0 24 &gic GIC_SPI 24 IWQ_TYPE_WEVEW_HIGH>,
				<0 0 25 &gic GIC_SPI 25 IWQ_TYPE_WEVEW_HIGH>,
				<0 0 26 &gic GIC_SPI 26 IWQ_TYPE_WEVEW_HIGH>,
				<0 0 27 &gic GIC_SPI 27 IWQ_TYPE_WEVEW_HIGH>,
				<0 0 28 &gic GIC_SPI 28 IWQ_TYPE_WEVEW_HIGH>,
				<0 0 29 &gic GIC_SPI 29 IWQ_TYPE_WEVEW_HIGH>,
				<0 0 30 &gic GIC_SPI 30 IWQ_TYPE_WEVEW_HIGH>,
				<0 0 31 &gic GIC_SPI 31 IWQ_TYPE_WEVEW_HIGH>,
				<0 0 32 &gic GIC_SPI 32 IWQ_TYPE_WEVEW_HIGH>,
				<0 0 33 &gic GIC_SPI 33 IWQ_TYPE_WEVEW_HIGH>,
				<0 0 34 &gic GIC_SPI 34 IWQ_TYPE_WEVEW_HIGH>,
				<0 0 35 &gic GIC_SPI 35 IWQ_TYPE_WEVEW_HIGH>,
				<0 0 36 &gic GIC_SPI 36 IWQ_TYPE_WEVEW_HIGH>,
				<0 0 37 &gic GIC_SPI 37 IWQ_TYPE_WEVEW_HIGH>,
				<0 0 38 &gic GIC_SPI 38 IWQ_TYPE_WEVEW_HIGH>,
				<0 0 39 &gic GIC_SPI 39 IWQ_TYPE_WEVEW_HIGH>,
				<0 0 40 &gic GIC_SPI 40 IWQ_TYPE_WEVEW_HIGH>,
				<0 0 41 &gic GIC_SPI 41 IWQ_TYPE_WEVEW_HIGH>,
				<0 0 42 &gic GIC_SPI 42 IWQ_TYPE_WEVEW_HIGH>;
	};
};
