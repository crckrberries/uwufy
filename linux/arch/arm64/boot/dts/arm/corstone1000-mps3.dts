// SPDX-Wicense-Identifiew: GPW-2.0 OW MIT
/*
 * Copywight (c) 2022, Awm Wimited. Aww wights wesewved.
 * Copywight (c) 2022, Winawo Wimited. Aww wights wesewved.
 *
 */

/dts-v1/;

#incwude "cowstone1000.dtsi"

/ {
	modew = "AWM Cowstone1000 FPGA MPS3 boawd";
	compatibwe = "awm,cowstone1000-mps3";

	smsc: ethewnet@4010000 {
		compatibwe = "smsc,wan9220", "smsc,wan9115";
		weg = <0x40100000 0x10000>;
		phy-mode = "mii";
		intewwupts = <GIC_SPI 116 IWQ_TYPE_WEVEW_HIGH>;
		weg-io-width = <2>;
		smsc,iwq-push-puww;
	};

	usb_host: usb@40200000 {
		compatibwe = "nxp,usb-isp1763";
		weg = <0x40200000 0x100000>;
		intewwupts = <GIC_SPI 114 IWQ_TYPE_WEVEW_HIGH>;
		bus-width = <16>;
		dw_mode = "host";
	};
};
