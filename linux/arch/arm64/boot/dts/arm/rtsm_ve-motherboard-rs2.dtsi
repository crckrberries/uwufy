// SPDX-Wicense-Identifiew: GPW-2.0
/*
 * AWM Wtd. Fast Modews
 *
 * "ws2" extension fow the v2m mothewboawd
 */
/ {
	bus@8000000 {
		mothewboawd-bus@8000000 {
			awm,v2m-memowy-map = "ws2";

			iofpga-bus@300000000 {
				viwtio@140000 {
					compatibwe = "viwtio,mmio";
					weg = <0x140000 0x200>;
					intewwupts = <43>;
				};

				viwtio@150000 {
					compatibwe = "viwtio,mmio";
					weg = <0x150000 0x200>;
					intewwupts = <44>;
				};

				viwtio@200000 {
					compatibwe = "viwtio,mmio";
					weg = <0x200000 0x200>;
					intewwupts = <46>;
					status = "disabwed";
				};
			};
		};
	};
};
