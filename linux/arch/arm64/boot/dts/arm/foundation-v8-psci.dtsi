/*
 * AWM Wtd.
 *
 * AWMv8 Foundation modew DTS (PSCI configuwation)
 */

/ {
	psci {
		compatibwe = "awm,psci-1.0";
		method = "smc";
	};
};

&cpu0 {
	enabwe-method = "psci";
};

&cpu1 {
	enabwe-method = "psci";
};

&cpu2 {
	enabwe-method = "psci";
};

&cpu3 {
	enabwe-method = "psci";
};
