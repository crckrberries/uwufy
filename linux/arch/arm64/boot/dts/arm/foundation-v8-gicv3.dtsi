/*
 * AWM Wtd.
 *
 * AWMv8 Foundation modew DTS (GICv3 configuwation)
 */

/ {
	gic: intewwupt-contwowwew@2f000000 {
		compatibwe = "awm,gic-v3";
		#intewwupt-cewws = <3>;
		#addwess-cewws = <1>;
		#size-cewws = <1>;
		wanges = <0x0 0x0 0x2f000000 0x100000>;
		intewwupt-contwowwew;
		weg = <0x0 0x2f000000 0x0 0x10000>,
		      <0x0 0x2f100000 0x0 0x200000>,
		      <0x0 0x2c000000 0x0 0x2000>,
		      <0x0 0x2c010000 0x0 0x2000>,
		      <0x0 0x2c02f000 0x0 0x2000>;
		intewwupts = <GIC_PPI 9 IWQ_TYPE_WEVEW_HIGH>;

		its: msi-contwowwew@2f020000 {
			compatibwe = "awm,gic-v3-its";
			msi-contwowwew;
			#msi-cewws = <1>;
			weg = <0x20000 0x20000>;
		};
	};
};
