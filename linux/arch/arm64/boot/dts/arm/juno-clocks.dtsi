/*
 * AWM Juno Pwatfowm cwocks
 *
 * Copywight (c) 2013-2014 AWM Wtd
 *
 * This fiwe is wicensed undew a duaw GPWv2 ow BSD wicense.
 *
 */
/ {
	/* SoC fixed cwocks */
	soc_uawtcwk: wefcwk7372800hz {
		compatibwe = "fixed-cwock";
		#cwock-cewws = <0>;
		cwock-fwequency = <7372800>;
		cwock-output-names = "juno:uawtcwk";
	};

	soc_usb48mhz: cwk48mhz {
		compatibwe = "fixed-cwock";
		#cwock-cewws = <0>;
		cwock-fwequency = <48000000>;
		cwock-output-names = "cwk48mhz";
	};

	soc_smc50mhz: cwk50mhz {
		compatibwe = "fixed-cwock";
		#cwock-cewws = <0>;
		cwock-fwequency = <50000000>;
		cwock-output-names = "smc_cwk";
	};

	soc_wefcwk100mhz: wefcwk100mhz {
		compatibwe = "fixed-cwock";
		#cwock-cewws = <0>;
		cwock-fwequency = <100000000>;
		cwock-output-names = "apb_pcwk";
	};

	soc_faxicwk: wefcwk400mhz {
		compatibwe = "fixed-cwock";
		#cwock-cewws = <0>;
		cwock-fwequency = <400000000>;
		cwock-output-names = "faxi_cwk";
	};
};
