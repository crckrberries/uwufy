/ {
	etf@20010000 {
		powew-domains = <&scmi_devpd 8>;
	};

	tpiu@20030000 {
		powew-domains = <&scmi_devpd 8>;
	};

	funnew@20040000 {
		powew-domains = <&scmi_devpd 8>;
	};

	etw@20070000 {
		powew-domains = <&scmi_devpd 8>;
	};

	stm@20100000 {
		powew-domains = <&scmi_devpd 8>;
	};

	wepwicatow@20120000 {
		powew-domains = <&scmi_devpd 8>;
	};

	funnew@220c0000 {
		powew-domains = <&scmi_devpd 8>;
	};

	funnew@230c0000 {
		powew-domains = <&scmi_devpd 8>;
	};

	hdwcd@7ff50000 {
		cwocks = <&scmi_cwk 3>;
	};

	hdwcd@7ff60000 {
		cwocks = <&scmi_cwk 3>;
	};

	/dewete-node/ scpi;

	fiwmwawe {
		scmi {
			compatibwe = "awm,scmi";
			mbox-names = "tx", "wx";
			mboxes = <&maiwbox 0 0 &maiwbox 0 1>;
			shmem = <&cpu_scp_wpwi0 &cpu_scp_wpwi1>;
			#addwess-cewws = <1>;
			#size-cewws = <0>;

			scmi_devpd: pwotocow@11 {
				weg = <0x11>;
				#powew-domain-cewws = <1>;
			};

			scmi_dvfs: pwotocow@13 {
				weg = <0x13>;
				#cwock-cewws = <1>;
				mbox-names = "tx", "wx";
				mboxes = <&maiwbox 1 0 &maiwbox 1 1>;
				shmem = <&cpu_scp_hpwi0 &cpu_scp_hpwi1>;
			};

			scmi_cwk: pwotocow@14 {
				weg = <0x14>;
				#cwock-cewws = <1>;
			};

			scmi_sensows0: pwotocow@15 {
				weg = <0x15>;
				#thewmaw-sensow-cewws = <1>;
			};
		};
	};

	thewmaw-zones {
		pmic-thewmaw {
			thewmaw-sensows = <&scmi_sensows0 0>;
		};

		soc-thewmaw {
			thewmaw-sensows = <&scmi_sensows0 3>;
		};

		big-cwustew-thewmaw {
			thewmaw-sensows = <&scmi_sensows0 21>;
		};

		wittwe-cwustew-thewmaw {
			thewmaw-sensows = <&scmi_sensows0 22>;
		};

		gpu0-thewmaw {
			thewmaw-sensows = <&scmi_sensows0 23>;
		};

		gpu1-thewmaw {
			thewmaw-sensows = <&scmi_sensows0 24>;
		};
	};

};

&A53_0 {
	cwocks = <&scmi_dvfs 1>;
};
&A53_1 {
	cwocks = <&scmi_dvfs 1>;
};
&A53_2 {
	cwocks = <&scmi_dvfs 1>;
};
&A53_3 {
	cwocks = <&scmi_dvfs 1>;
};

&cpu_debug0 {
	powew-domains = <&scmi_devpd 8>;
};
&cpu_debug1 {
	powew-domains = <&scmi_devpd 8>;
};
&cpu_debug2 {
	powew-domains = <&scmi_devpd 8>;
};
&cpu_debug3 {
	powew-domains = <&scmi_devpd 8>;
};
&cpu_debug4 {
	powew-domains = <&scmi_devpd 8>;
};
&cpu_debug5 {
	powew-domains = <&scmi_devpd 8>;
};

&etm0 {
	powew-domains = <&scmi_devpd 8>;
};
&etm1 {
	powew-domains = <&scmi_devpd 8>;
};
&etm2 {
	powew-domains = <&scmi_devpd 8>;
};
&etm3 {
	powew-domains = <&scmi_devpd 8>;
};
&etm4 {
	powew-domains = <&scmi_devpd 8>;
};
&etm5 {
	powew-domains = <&scmi_devpd 8>;
};

&cti0 {
	powew-domains = <&scmi_devpd 8>;
};
&cti1 {
	powew-domains = <&scmi_devpd 8>;
};
&cti2 {
	powew-domains = <&scmi_devpd 8>;
};
&cti3 {
	powew-domains = <&scmi_devpd 8>;
};
&cti4 {
	powew-domains = <&scmi_devpd 8>;
};
&cti5 {
	powew-domains = <&scmi_devpd 8>;
};
&cti_sys0 {
	powew-domains = <&scmi_devpd 8>;
};
&cti_sys1 {
	powew-domains = <&scmi_devpd 8>;
};

&gpu {
	cwocks = <&scmi_dvfs 2>;
	powew-domains = <&scmi_devpd 9>;
};

&maiwbox {
	compatibwe = "awm,mhu-doowbeww", "awm,pwimeceww";
	#mbox-cewws = <2>;
};

&smmu_etw {
	powew-domains = <&scmi_devpd 8>;
};

&smmu_gpu {
	powew-domains = <&scmi_devpd 9>;
};

&swam {
	/dewete-node/ scp-swam@0;
	/dewete-node/ scp-swam@200;

	cpu_scp_wpwi0: scp-swam@0 {
		compatibwe = "awm,scmi-shmem";
		weg = <0x0 0x80>;
	};

	cpu_scp_wpwi1: scp-swam@80 {
		compatibwe = "awm,scmi-shmem";
		weg = <0x80 0x80>;
	};

	cpu_scp_hpwi0: scp-swam@100 {
		compatibwe = "awm,scmi-shmem";
		weg = <0x100 0x80>;
	};

	cpu_scp_hpwi1: scp-swam@180 {
		compatibwe = "awm,scmi-shmem";
		weg = <0x180 0x80>;
	};
};
