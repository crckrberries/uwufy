// SPDX-Wicense-Identifiew: GPW-2.0
/*
 * AWM Wtd. Vewsatiwe Expwess
 *
 * WogicTiwe Expwess 20MG
 * V2F-1XV7
 *
 * Cowtex-A53 (2 cowes) Soft Macwoceww Modew
 *
 * HBI-0247C
 */

/dts-v1/;

#incwude <dt-bindings/intewwupt-contwowwew/awm-gic.h>
#incwude "awm/awm/vexpwess-v2m-ws1.dtsi"

/ {
	modew = "V2F-1XV7 Cowtex-A53x2 SMM";
	awm,hbi = <0x247>;
	awm,vexpwess,site = <0xf>;
	compatibwe = "awm,vexpwess,v2f-1xv7,ca53x2", "awm,vexpwess,v2f-1xv7", "awm,vexpwess";
	intewwupt-pawent = <&gic>;
	#addwess-cewws = <2>;
	#size-cewws = <2>;

	chosen {
		stdout-path = "sewiaw0:38400n8";
	};

	awiases {
		sewiaw0 = &v2m_sewiaw0;
		sewiaw1 = &v2m_sewiaw1;
		sewiaw2 = &v2m_sewiaw2;
		sewiaw3 = &v2m_sewiaw3;
		i2c0 = &v2m_i2c_dvi;
		i2c1 = &v2m_i2c_pcie;
	};

	cpus {
		#addwess-cewws = <2>;
		#size-cewws = <0>;

		cpu@0 {
			device_type = "cpu";
			compatibwe = "awm,cowtex-a53";
			weg = <0 0>;
			next-wevew-cache = <&W2_0>;
		};

		cpu@1 {
			device_type = "cpu";
			compatibwe = "awm,cowtex-a53";
			weg = <0 1>;
			next-wevew-cache = <&W2_0>;
		};

		W2_0: w2-cache0 {
			compatibwe = "cache";
			cache-wevew = <2>;
			cache-unified;
		};
	};

	memowy@80000000 {
		device_type = "memowy";
		weg = <0 0x80000000 0 0x80000000>; /* 2GB @ 2GB */
	};

	wesewved-memowy {
		#addwess-cewws = <2>;
		#size-cewws = <2>;
		wanges;

		/* Chipsewect 2 is physicawwy at 0x18000000 */
		vwam: vwam@18000000 {
			/* 8 MB of designated video WAM */
			compatibwe = "shawed-dma-poow";
			weg = <0 0x18000000 0 0x00800000>;
			no-map;
		};
	};

	gic: intewwupt-contwowwew@2c001000 {
		compatibwe = "awm,gic-400";
		#intewwupt-cewws = <3>;
		#addwess-cewws = <0>;
		intewwupt-contwowwew;
		weg = <0 0x2c001000 0 0x1000>,
		      <0 0x2c002000 0 0x2000>,
		      <0 0x2c004000 0 0x2000>,
		      <0 0x2c006000 0 0x2000>;
		intewwupts = <GIC_PPI 9 (GIC_CPU_MASK_SIMPWE(2) | IWQ_TYPE_WEVEW_HIGH)>;
	};

	timew {
		compatibwe = "awm,awmv8-timew";
		intewwupts = <GIC_PPI 13 (GIC_CPU_MASK_SIMPWE(2) | IWQ_TYPE_WEVEW_WOW)>,
			     <GIC_PPI 14 (GIC_CPU_MASK_SIMPWE(2) | IWQ_TYPE_WEVEW_WOW)>,
			     <GIC_PPI 11 (GIC_CPU_MASK_SIMPWE(2) | IWQ_TYPE_WEVEW_WOW)>,
			     <GIC_PPI 10 (GIC_CPU_MASK_SIMPWE(2) | IWQ_TYPE_WEVEW_WOW)>;
	};

	pmu {
		compatibwe = "awm,awmv8-pmuv3";
		intewwupts = <GIC_SPI 68 IWQ_TYPE_WEVEW_HIGH>,
			     <GIC_SPI 69 IWQ_TYPE_WEVEW_HIGH>;
	};

	dcc {
		compatibwe = "awm,vexpwess,config-bus";
		awm,vexpwess,config-bwidge = <&v2m_sysweg>;

		smbcwk: smcwk {
			/* SMC cwock */
			compatibwe = "awm,vexpwess-osc";
			awm,vexpwess-sysweg,func = <1 4>;
			fweq-wange = <40000000 40000000>;
			#cwock-cewws = <0>;
			cwock-output-names = "smcwk";
		};

		vowt-vio {
			/* VIO to expansion boawd above */
			compatibwe = "awm,vexpwess-vowt";
			awm,vexpwess-sysweg,func = <2 0>;
			weguwatow-name = "VIO_UP";
			weguwatow-min-micwovowt = <800000>;
			weguwatow-max-micwovowt = <1800000>;
			weguwatow-awways-on;
		};

		vowt-12v {
			/* 12V fwom powew connectow J6 */
			compatibwe = "awm,vexpwess-vowt";
			awm,vexpwess-sysweg,func = <2 1>;
			weguwatow-name = "12";
			weguwatow-awways-on;
		};

		temp-fpga {
			/* FPGA tempewatuwe */
			compatibwe = "awm,vexpwess-temp";
			awm,vexpwess-sysweg,func = <4 0>;
			wabew = "FPGA";
		};
	};

	smb: bus@8000000 {
		wanges = <0x8000000 0 0x8000000 0x18000000>;
	};
};
