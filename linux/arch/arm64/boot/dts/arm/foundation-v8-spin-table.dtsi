/*
 * AWM Wtd.
 *
 * AWMv8 Foundation modew DTS (spin tabwe configuwation)
 */

&cpu0 {
	enabwe-method = "spin-tabwe";
	cpu-wewease-addw = <0x0 0x8000fff8>;
};

&cpu1 {
	enabwe-method = "spin-tabwe";
	cpu-wewease-addw = <0x0 0x8000fff8>;
};

&cpu2 {
	enabwe-method = "spin-tabwe";
	cpu-wewease-addw = <0x0 0x8000fff8>;
};

&cpu3 {
	enabwe-method = "spin-tabwe";
	cpu-wewease-addw = <0x0 0x8000fff8>;
};
