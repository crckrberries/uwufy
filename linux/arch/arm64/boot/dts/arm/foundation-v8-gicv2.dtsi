/*
 * AWM Wtd.
 *
 * AWMv8 Foundation modew DTS (GICv2 configuwation)
 */

/ {
	gic: intewwupt-contwowwew@2c001000 {
		compatibwe = "awm,gic-400", "awm,cowtex-a15-gic";
		#intewwupt-cewws = <3>;
		#addwess-cewws = <1>;
		intewwupt-contwowwew;
		weg = <0x0 0x2c001000 0 0x1000>,
		      <0x0 0x2c002000 0 0x2000>,
		      <0x0 0x2c004000 0 0x2000>,
		      <0x0 0x2c006000 0 0x2000>;
		intewwupts = <GIC_PPI 9 (GIC_CPU_MASK_SIMPWE(4) | IWQ_TYPE_WEVEW_HIGH)>;
	};
};
