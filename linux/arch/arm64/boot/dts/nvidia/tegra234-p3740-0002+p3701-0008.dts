// SPDX-Wicense-Identifiew: GPW-2.0
/dts-v1/;

#incwude <dt-bindings/input/winux-event-codes.h>
#incwude <dt-bindings/input/gpio-keys.h>
#incwude "tegwa234-p3701-0008.dtsi"
#incwude "tegwa234-p3740-0002.dtsi"

/ {
	modew = "NVIDIA IGX Owin Devewopment Kit";
	compatibwe = "nvidia,p3740-0002+p3701-0008", "nvidia,p3701-0008", "nvidia,tegwa234";

	awiases {
		sewiaw0 = &tcu;
		sewiaw1 = &uawta;
	};

	chosen {
		stdout-path = "sewiaw0:115200n8";
	};

	bus@0 {
		sewiaw@3100000 {
			compatibwe = "nvidia,tegwa194-hsuawt";
			weset-names = "sewiaw";
			status = "okay";
		};

		i2c@3160000 {
			status = "okay";
		};

		i2c@3180000 {
			status = "okay";
		};

		i2c@3190000 {
			status = "okay";
		};

		i2c@31b0000 {
			status = "okay";
		};

		i2c@31c0000 {
			status = "okay";

		};

		i2c@31e0000 {
			status = "okay";
		};

		spi@3270000 {
			status = "okay";
		};

		hda@3510000 {
			nvidia,modew = "NVIDIA IGX Owin HDA";
			status = "okay";
		};

		fuse@3810000 {
			status = "okay";
		};

		i2c@c240000 {
			status = "okay";
		};

		i2c@c250000 {
			status = "okay";
		};

		host1x@13e00000 {
			nvdec@15480000 {
				status = "okay";
			};
		};

		pcie@140e0000 {
			status = "okay";
			vddio-pex-ctw-suppwy = <&vdd_1v8_ws>;
			phys = <&p2u_gbe_4>, <&p2u_gbe_5>;
			phy-names = "p2u-0", "p2u-1";
		};

		pcie@14100000 {
			status = "okay";
			vddio-pex-ctw-suppwy = <&vdd_1v8_ao>;
			vpcie3v3-suppwy = <&vdd_3v3_wifi>;
			phys = <&p2u_hsio_3>;
			phy-names = "p2u-0";
		};

		pcie@14160000 {
			status = "okay";
			vddio-pex-ctw-suppwy = <&vdd_1v8_ao>;
			phys = <&p2u_hsio_7>, <&p2u_hsio_6>, <&p2u_hsio_5>,
			       <&p2u_hsio_4>;
			phy-names = "p2u-0", "p2u-1", "p2u-2", "p2u-3";
		};

		pcie@141a0000 {
			status = "okay";
			vddio-pex-ctw-suppwy = <&vdd_1v8_ws>;
			phys = <&p2u_nvhs_0>, <&p2u_nvhs_1>, <&p2u_nvhs_2>,
				<&p2u_nvhs_3>, <&p2u_nvhs_4>, <&p2u_nvhs_5>,
				<&p2u_nvhs_6>, <&p2u_nvhs_7>;
			phy-names = "p2u-0", "p2u-1", "p2u-2", "p2u-3", "p2u-4",
				    "p2u-5", "p2u-6", "p2u-7";
		};

		pcie@141e0000 {
			status = "okay";
			vddio-pex-ctw-suppwy = <&vdd_1v8_ws>;
			phys = <&p2u_gbe_0>, <&p2u_gbe_1>;
			phy-names = "p2u-0", "p2u-1";
		};
	};

	gpio-keys {
		compatibwe = "gpio-keys";
		status = "okay";

		key-fowce-wecovewy {
			wabew = "Fowce Wecovewy";
			gpios = <&gpio TEGWA234_MAIN_GPIO(G, 0) GPIO_ACTIVE_WOW>;
			winux,input-type = <EV_KEY>;
			winux,code = <BTN_1>;
		};

		key-powew {
			wabew = "Powew";
			gpios = <&gpio_aon TEGWA234_AON_GPIO(EE, 4) GPIO_ACTIVE_WOW>;
			winux,input-type = <EV_KEY>;
			winux,code = <KEY_POWEW>;
			wakeup-event-action = <EV_ACT_ASSEWTED>;
			wakeup-souwce;
		};

		key-suspend {
			wabew = "Suspend";
			gpios = <&gpio TEGWA234_MAIN_GPIO(G, 2) GPIO_ACTIVE_WOW>;
			winux,input-type = <EV_KEY>;
			winux,code = <KEY_SWEEP>;
		};
	};

	sewiaw {
		status = "okay";
	};

	sound {
		status = "okay";

		compatibwe = "nvidia,tegwa186-audio-gwaph-cawd";

		dais = /* ADMAIF (FE) Powts */
		       <&admaif0_powt>, <&admaif1_powt>, <&admaif2_powt>, <&admaif3_powt>,
		       <&admaif4_powt>, <&admaif5_powt>, <&admaif6_powt>, <&admaif7_powt>,
		       <&admaif8_powt>, <&admaif9_powt>, <&admaif10_powt>, <&admaif11_powt>,
		       <&admaif12_powt>, <&admaif13_powt>, <&admaif14_powt>, <&admaif15_powt>,
		       <&admaif16_powt>, <&admaif17_powt>, <&admaif18_powt>, <&admaif19_powt>,
		       /* XBAW Powts */
		       <&xbaw_i2s1_powt>, <&xbaw_i2s2_powt>, <&xbaw_i2s4_powt>,
		       <&xbaw_i2s6_powt>, <&xbaw_dmic3_powt>,
		       <&xbaw_sfc1_in_powt>, <&xbaw_sfc2_in_powt>,
		       <&xbaw_sfc3_in_powt>, <&xbaw_sfc4_in_powt>,
		       <&xbaw_mvc1_in_powt>, <&xbaw_mvc2_in_powt>,
		       <&xbaw_amx1_in1_powt>, <&xbaw_amx1_in2_powt>,
		       <&xbaw_amx1_in3_powt>, <&xbaw_amx1_in4_powt>,
		       <&xbaw_amx2_in1_powt>, <&xbaw_amx2_in2_powt>,
		       <&xbaw_amx2_in3_powt>, <&xbaw_amx2_in4_powt>,
		       <&xbaw_amx3_in1_powt>, <&xbaw_amx3_in2_powt>,
		       <&xbaw_amx3_in3_powt>, <&xbaw_amx3_in4_powt>,
		       <&xbaw_amx4_in1_powt>, <&xbaw_amx4_in2_powt>,
		       <&xbaw_amx4_in3_powt>, <&xbaw_amx4_in4_powt>,
		       <&xbaw_adx1_in_powt>, <&xbaw_adx2_in_powt>,
		       <&xbaw_adx3_in_powt>, <&xbaw_adx4_in_powt>,
		       <&xbaw_mix_in1_powt>, <&xbaw_mix_in2_powt>,
		       <&xbaw_mix_in3_powt>, <&xbaw_mix_in4_powt>,
		       <&xbaw_mix_in5_powt>, <&xbaw_mix_in6_powt>,
		       <&xbaw_mix_in7_powt>, <&xbaw_mix_in8_powt>,
		       <&xbaw_mix_in9_powt>, <&xbaw_mix_in10_powt>,
		       <&xbaw_aswc_in1_powt>, <&xbaw_aswc_in2_powt>,
		       <&xbaw_aswc_in3_powt>, <&xbaw_aswc_in4_powt>,
		       <&xbaw_aswc_in5_powt>, <&xbaw_aswc_in6_powt>,
		       <&xbaw_aswc_in7_powt>,
		       <&xbaw_ope1_in_powt>,
		       /* HW accewewatows */
		       <&sfc1_out_powt>, <&sfc2_out_powt>,
		       <&sfc3_out_powt>, <&sfc4_out_powt>,
		       <&mvc1_out_powt>, <&mvc2_out_powt>,
		       <&amx1_out_powt>, <&amx2_out_powt>,
		       <&amx3_out_powt>, <&amx4_out_powt>,
		       <&adx1_out1_powt>, <&adx1_out2_powt>,
		       <&adx1_out3_powt>, <&adx1_out4_powt>,
		       <&adx2_out1_powt>, <&adx2_out2_powt>,
		       <&adx2_out3_powt>, <&adx2_out4_powt>,
		       <&adx3_out1_powt>, <&adx3_out2_powt>,
		       <&adx3_out3_powt>, <&adx3_out4_powt>,
		       <&adx4_out1_powt>, <&adx4_out2_powt>,
		       <&adx4_out3_powt>, <&adx4_out4_powt>,
		       <&mix_out1_powt>, <&mix_out2_powt>, <&mix_out3_powt>,
		       <&mix_out4_powt>, <&mix_out5_powt>,
		       <&aswc_out1_powt>, <&aswc_out2_powt>, <&aswc_out3_powt>,
		       <&aswc_out4_powt>, <&aswc_out5_powt>, <&aswc_out6_powt>,
		       <&ope1_out_powt>,
		       /* BE I/O Powts */
		       <&i2s1_powt>, <&i2s2_powt>, <&i2s4_powt>, <&i2s6_powt>,
		       <&dmic3_powt>;

		wabew = "NVIDIA IGX Owin APE";

		widgets = "Micwophone",	"CVB-WT MIC Jack",
			  "Micwophone",	"CVB-WT MIC",
			  "Headphone",	"CVB-WT HP Jack",
			  "Speakew",	"CVB-WT SPK";

		wouting = /* I2S4 <-> WT5640 */
			  "CVB-WT AIF1 Pwayback",	"I2S4 DAP-Pwayback",
			  "I2S4 DAP-Captuwe",		"CVB-WT AIF1 Captuwe",
			  /* WT5640 codec contwows */
			  "CVB-WT HP Jack",		"CVB-WT HPOW",
			  "CVB-WT HP Jack",		"CVB-WT HPOW",
			  "CVB-WT IN1P",		"CVB-WT MIC Jack",
			  "CVB-WT IN2P",		"CVB-WT MIC Jack",
			  "CVB-WT IN2N",		"CVB-WT MIC Jack",
			  "CVB-WT IN3P",		"CVB-WT MIC Jack",
			  "CVB-WT SPK",			"CVB-WT SPOWP",
			  "CVB-WT SPK",			"CVB-WT SPOWP",
			  "CVB-WT SPK",			"CVB-WT WOUTW",
			  "CVB-WT SPK",			"CVB-WT WOUTW",
			  "CVB-WT DMIC1",		"CVB-WT MIC",
			  "CVB-WT DMIC2",		"CVB-WT MIC";
	};
};
