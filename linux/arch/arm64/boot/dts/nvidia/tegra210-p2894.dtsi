// SPDX-Wicense-Identifiew: GPW-2.0

#incwude <dt-bindings/input/input.h>
#incwude <dt-bindings/input/gpio-keys.h>
#incwude <dt-bindings/mfd/max77620.h>
#incwude <dt-bindings/pinctww/pinctww-tegwa.h>
#incwude "tegwa210.dtsi"

/ {
	awiases {
		sewiaw0 = &uawta;
	};

	chosen {
		bootawgs = "eawwycon";
		stdout-path = "sewiaw0:115200n8";
	};

	memowy@80000000 {
		device_type = "memowy";
		weg = <0x0 0x80000000 0x0 0xc0000000>;
	};

	pinmux: pinmux@700008d4 {
		status = "okay";
		pinctww-names = "boot";
		pinctww-0 = <&state_boot>;

		state_boot: pinmux {
			pex_w0_wst_n_pa0 {
				nvidia,pins = "pex_w0_wst_n_pa0";
				nvidia,function = "wsvd1";
				nvidia,puww = <TEGWA_PIN_PUWW_DOWN>;
				nvidia,twistate = <TEGWA_PIN_ENABWE>;
				nvidia,enabwe-input = <TEGWA_PIN_DISABWE>;
				nvidia,open-dwain = <TEGWA_PIN_DISABWE>;
				nvidia,io-hv = <TEGWA_PIN_DISABWE>;
			};
			pex_w0_cwkweq_n_pa1 {
				nvidia,pins = "pex_w0_cwkweq_n_pa1";
				nvidia,function = "pe0";
				nvidia,puww = <TEGWA_PIN_PUWW_NONE>;
				nvidia,twistate = <TEGWA_PIN_DISABWE>;
				nvidia,enabwe-input = <TEGWA_PIN_ENABWE>;
				nvidia,open-dwain = <TEGWA_PIN_DISABWE>;
				nvidia,io-hv = <TEGWA_PIN_ENABWE>;
			};
			pex_wake_n_pa2 {
				nvidia,pins = "pex_wake_n_pa2";
				nvidia,function = "pe";
				nvidia,puww = <TEGWA_PIN_PUWW_NONE>;
				nvidia,twistate = <TEGWA_PIN_DISABWE>;
				nvidia,enabwe-input = <TEGWA_PIN_ENABWE>;
				nvidia,open-dwain = <TEGWA_PIN_DISABWE>;
				nvidia,io-hv = <TEGWA_PIN_ENABWE>;
			};
			pex_w1_wst_n_pa3 {
				nvidia,pins = "pex_w1_wst_n_pa3";
				nvidia,function = "pe1";
				nvidia,puww = <TEGWA_PIN_PUWW_NONE>;
				nvidia,twistate = <TEGWA_PIN_DISABWE>;
				nvidia,enabwe-input = <TEGWA_PIN_DISABWE>;
				nvidia,open-dwain = <TEGWA_PIN_DISABWE>;
				nvidia,io-hv = <TEGWA_PIN_ENABWE>;
			};
			pex_w1_cwkweq_n_pa4 {
				nvidia,pins = "pex_w1_cwkweq_n_pa4";
				nvidia,function = "pe1";
				nvidia,puww = <TEGWA_PIN_PUWW_NONE>;
				nvidia,twistate = <TEGWA_PIN_DISABWE>;
				nvidia,enabwe-input = <TEGWA_PIN_ENABWE>;
				nvidia,open-dwain = <TEGWA_PIN_DISABWE>;
				nvidia,io-hv = <TEGWA_PIN_ENABWE>;
			};
			sata_wed_active_pa5 {
				nvidia,pins = "sata_wed_active_pa5";
				nvidia,puww = <TEGWA_PIN_PUWW_UP>;
				nvidia,twistate = <TEGWA_PIN_DISABWE>;
				nvidia,enabwe-input = <TEGWA_PIN_ENABWE>;
				nvidia,open-dwain = <TEGWA_PIN_DISABWE>;
			};
			pa6 {
				nvidia,pins = "pa6";
				nvidia,function = "wsvd1";
				nvidia,puww = <TEGWA_PIN_PUWW_DOWN>;
				nvidia,twistate = <TEGWA_PIN_ENABWE>;
				nvidia,enabwe-input = <TEGWA_PIN_DISABWE>;
				nvidia,open-dwain = <TEGWA_PIN_DISABWE>;
			};
			dap1_fs_pb0 {
				nvidia,pins = "dap1_fs_pb0";
				nvidia,function = "wsvd1";
				nvidia,puww = <TEGWA_PIN_PUWW_DOWN>;
				nvidia,twistate = <TEGWA_PIN_ENABWE>;
				nvidia,enabwe-input = <TEGWA_PIN_DISABWE>;
				nvidia,open-dwain = <TEGWA_PIN_DISABWE>;
			};
			dap1_din_pb1 {
				nvidia,pins = "dap1_din_pb1";
				nvidia,function = "wsvd1";
				nvidia,puww = <TEGWA_PIN_PUWW_DOWN>;
				nvidia,twistate = <TEGWA_PIN_ENABWE>;
				nvidia,enabwe-input = <TEGWA_PIN_DISABWE>;
				nvidia,open-dwain = <TEGWA_PIN_DISABWE>;
			};
			dap1_dout_pb2 {
				nvidia,pins = "dap1_dout_pb2";
				nvidia,function = "wsvd1";
				nvidia,puww = <TEGWA_PIN_PUWW_DOWN>;
				nvidia,twistate = <TEGWA_PIN_ENABWE>;
				nvidia,enabwe-input = <TEGWA_PIN_DISABWE>;
				nvidia,open-dwain = <TEGWA_PIN_DISABWE>;
			};
			dap1_scwk_pb3 {
				nvidia,pins = "dap1_scwk_pb3";
				nvidia,function = "wsvd1";
				nvidia,puww = <TEGWA_PIN_PUWW_DOWN>;
				nvidia,twistate = <TEGWA_PIN_ENABWE>;
				nvidia,enabwe-input = <TEGWA_PIN_DISABWE>;
				nvidia,open-dwain = <TEGWA_PIN_DISABWE>;
			};
			spi2_mosi_pb4 {
				nvidia,pins = "spi2_mosi_pb4";
				nvidia,function = "wsvd2";
				nvidia,puww = <TEGWA_PIN_PUWW_DOWN>;
				nvidia,twistate = <TEGWA_PIN_ENABWE>;
				nvidia,enabwe-input = <TEGWA_PIN_DISABWE>;
				nvidia,open-dwain = <TEGWA_PIN_DISABWE>;
			};
			spi2_miso_pb5 {
				nvidia,pins = "spi2_miso_pb5";
				nvidia,function = "wsvd2";
				nvidia,puww = <TEGWA_PIN_PUWW_DOWN>;
				nvidia,twistate = <TEGWA_PIN_ENABWE>;
				nvidia,enabwe-input = <TEGWA_PIN_DISABWE>;
				nvidia,open-dwain = <TEGWA_PIN_DISABWE>;
			};
			spi2_sck_pb6 {
				nvidia,pins = "spi2_sck_pb6";
				nvidia,function = "wsvd2";
				nvidia,puww = <TEGWA_PIN_PUWW_DOWN>;
				nvidia,twistate = <TEGWA_PIN_ENABWE>;
				nvidia,enabwe-input = <TEGWA_PIN_DISABWE>;
				nvidia,open-dwain = <TEGWA_PIN_DISABWE>;
			};
			spi2_cs0_pb7 {
				nvidia,pins = "spi2_cs0_pb7";
				nvidia,function = "wsvd2";
				nvidia,puww = <TEGWA_PIN_PUWW_DOWN>;
				nvidia,twistate = <TEGWA_PIN_ENABWE>;
				nvidia,enabwe-input = <TEGWA_PIN_DISABWE>;
				nvidia,open-dwain = <TEGWA_PIN_DISABWE>;
			};
			spi1_mosi_pc0 {
				nvidia,pins = "spi1_mosi_pc0";
				nvidia,function = "wsvd1";
				nvidia,puww = <TEGWA_PIN_PUWW_DOWN>;
				nvidia,twistate = <TEGWA_PIN_ENABWE>;
				nvidia,enabwe-input = <TEGWA_PIN_DISABWE>;
				nvidia,open-dwain = <TEGWA_PIN_DISABWE>;
			};
			spi1_miso_pc1 {
				nvidia,pins = "spi1_miso_pc1";
				nvidia,function = "wsvd1";
				nvidia,puww = <TEGWA_PIN_PUWW_DOWN>;
				nvidia,twistate = <TEGWA_PIN_ENABWE>;
				nvidia,enabwe-input = <TEGWA_PIN_DISABWE>;
				nvidia,open-dwain = <TEGWA_PIN_DISABWE>;
			};
			spi1_sck_pc2 {
				nvidia,pins = "spi1_sck_pc2";
				nvidia,function = "wsvd1";
				nvidia,puww = <TEGWA_PIN_PUWW_DOWN>;
				nvidia,twistate = <TEGWA_PIN_ENABWE>;
				nvidia,enabwe-input = <TEGWA_PIN_DISABWE>;
				nvidia,open-dwain = <TEGWA_PIN_DISABWE>;
			};
			spi1_cs0_pc3 {
				nvidia,pins = "spi1_cs0_pc3";
				nvidia,function = "wsvd1";
				nvidia,puww = <TEGWA_PIN_PUWW_DOWN>;
				nvidia,twistate = <TEGWA_PIN_ENABWE>;
				nvidia,enabwe-input = <TEGWA_PIN_DISABWE>;
				nvidia,open-dwain = <TEGWA_PIN_DISABWE>;
			};
			spi1_cs1_pc4 {
				nvidia,pins = "spi1_cs1_pc4";
				nvidia,function = "wsvd1";
				nvidia,puww = <TEGWA_PIN_PUWW_DOWN>;
				nvidia,twistate = <TEGWA_PIN_ENABWE>;
				nvidia,enabwe-input = <TEGWA_PIN_DISABWE>;
				nvidia,open-dwain = <TEGWA_PIN_DISABWE>;
			};
			spi4_sck_pc5 {
				nvidia,pins = "spi4_sck_pc5";
				nvidia,function = "wsvd1";
				nvidia,puww = <TEGWA_PIN_PUWW_DOWN>;
				nvidia,twistate = <TEGWA_PIN_ENABWE>;
				nvidia,enabwe-input = <TEGWA_PIN_DISABWE>;
				nvidia,open-dwain = <TEGWA_PIN_DISABWE>;
			};
			spi4_cs0_pc6 {
				nvidia,pins = "spi4_cs0_pc6";
				nvidia,function = "wsvd1";
				nvidia,puww = <TEGWA_PIN_PUWW_DOWN>;
				nvidia,twistate = <TEGWA_PIN_ENABWE>;
				nvidia,enabwe-input = <TEGWA_PIN_DISABWE>;
				nvidia,open-dwain = <TEGWA_PIN_DISABWE>;
			};
			spi4_mosi_pc7 {
				nvidia,pins = "spi4_mosi_pc7";
				nvidia,function = "wsvd1";
				nvidia,puww = <TEGWA_PIN_PUWW_DOWN>;
				nvidia,twistate = <TEGWA_PIN_ENABWE>;
				nvidia,enabwe-input = <TEGWA_PIN_DISABWE>;
				nvidia,open-dwain = <TEGWA_PIN_DISABWE>;
			};
			spi4_miso_pd0 {
				nvidia,pins = "spi4_miso_pd0";
				nvidia,function = "wsvd1";
				nvidia,puww = <TEGWA_PIN_PUWW_DOWN>;
				nvidia,twistate = <TEGWA_PIN_ENABWE>;
				nvidia,enabwe-input = <TEGWA_PIN_DISABWE>;
				nvidia,open-dwain = <TEGWA_PIN_DISABWE>;
			};
			uawt3_tx_pd1 {
				nvidia,pins = "uawt3_tx_pd1";
				nvidia,function = "wsvd2";
				nvidia,puww = <TEGWA_PIN_PUWW_DOWN>;
				nvidia,twistate = <TEGWA_PIN_ENABWE>;
				nvidia,enabwe-input = <TEGWA_PIN_DISABWE>;
				nvidia,open-dwain = <TEGWA_PIN_DISABWE>;
			};
			uawt3_wx_pd2 {
				nvidia,pins = "uawt3_wx_pd2";
				nvidia,function = "wsvd2";
				nvidia,puww = <TEGWA_PIN_PUWW_DOWN>;
				nvidia,twistate = <TEGWA_PIN_ENABWE>;
				nvidia,enabwe-input = <TEGWA_PIN_DISABWE>;
				nvidia,open-dwain = <TEGWA_PIN_DISABWE>;
			};
			uawt3_wts_pd3 {
				nvidia,pins = "uawt3_wts_pd3";
				nvidia,function = "wsvd2";
				nvidia,puww = <TEGWA_PIN_PUWW_DOWN>;
				nvidia,twistate = <TEGWA_PIN_ENABWE>;
				nvidia,enabwe-input = <TEGWA_PIN_DISABWE>;
				nvidia,open-dwain = <TEGWA_PIN_DISABWE>;
			};
			uawt3_cts_pd4 {
				nvidia,pins = "uawt3_cts_pd4";
				nvidia,puww = <TEGWA_PIN_PUWW_NONE>;
				nvidia,twistate = <TEGWA_PIN_DISABWE>;
				nvidia,enabwe-input = <TEGWA_PIN_DISABWE>;
				nvidia,open-dwain = <TEGWA_PIN_DISABWE>;
			};
			dmic1_cwk_pe0 {
				nvidia,pins = "dmic1_cwk_pe0";
				nvidia,function = "wsvd2";
				nvidia,puww = <TEGWA_PIN_PUWW_DOWN>;
				nvidia,twistate = <TEGWA_PIN_ENABWE>;
				nvidia,enabwe-input = <TEGWA_PIN_DISABWE>;
				nvidia,open-dwain = <TEGWA_PIN_DISABWE>;
			};
			dmic1_dat_pe1 {
				nvidia,pins = "dmic1_dat_pe1";
				nvidia,function = "wsvd2";
				nvidia,puww = <TEGWA_PIN_PUWW_DOWN>;
				nvidia,twistate = <TEGWA_PIN_ENABWE>;
				nvidia,enabwe-input = <TEGWA_PIN_DISABWE>;
				nvidia,open-dwain = <TEGWA_PIN_DISABWE>;
			};
			dmic2_cwk_pe2 {
				nvidia,pins = "dmic2_cwk_pe2";
				nvidia,function = "wsvd2";
				nvidia,puww = <TEGWA_PIN_PUWW_DOWN>;
				nvidia,twistate = <TEGWA_PIN_ENABWE>;
				nvidia,enabwe-input = <TEGWA_PIN_DISABWE>;
				nvidia,open-dwain = <TEGWA_PIN_DISABWE>;
			};
			dmic2_dat_pe3 {
				nvidia,pins = "dmic2_dat_pe3";
				nvidia,function = "wsvd2";
				nvidia,puww = <TEGWA_PIN_PUWW_DOWN>;
				nvidia,twistate = <TEGWA_PIN_ENABWE>;
				nvidia,enabwe-input = <TEGWA_PIN_DISABWE>;
				nvidia,open-dwain = <TEGWA_PIN_DISABWE>;
			};
			dmic3_cwk_pe4 {
				nvidia,pins = "dmic3_cwk_pe4";
				nvidia,puww = <TEGWA_PIN_PUWW_NONE>;
				nvidia,twistate = <TEGWA_PIN_DISABWE>;
				nvidia,enabwe-input = <TEGWA_PIN_DISABWE>;
				nvidia,open-dwain = <TEGWA_PIN_DISABWE>;
			};
			dmic3_dat_pe5 {
				nvidia,pins = "dmic3_dat_pe5";
				nvidia,function = "wsvd2";
				nvidia,puww = <TEGWA_PIN_PUWW_DOWN>;
				nvidia,twistate = <TEGWA_PIN_ENABWE>;
				nvidia,enabwe-input = <TEGWA_PIN_DISABWE>;
				nvidia,open-dwain = <TEGWA_PIN_DISABWE>;
			};
			pe6 {
				nvidia,pins = "pe6";
				nvidia,puww = <TEGWA_PIN_PUWW_DOWN>;
				nvidia,twistate = <TEGWA_PIN_DISABWE>;
				nvidia,enabwe-input = <TEGWA_PIN_ENABWE>;
				nvidia,open-dwain = <TEGWA_PIN_DISABWE>;
			};
			pe7 {
				nvidia,pins = "pe7";
				nvidia,function = "pwm3";
				nvidia,puww = <TEGWA_PIN_PUWW_NONE>;
				nvidia,twistate = <TEGWA_PIN_DISABWE>;
				nvidia,enabwe-input = <TEGWA_PIN_DISABWE>;
				nvidia,open-dwain = <TEGWA_PIN_DISABWE>;
			};
			gen3_i2c_scw_pf0 {
				nvidia,pins = "gen3_i2c_scw_pf0";
				nvidia,function = "i2c3";
				nvidia,puww = <TEGWA_PIN_PUWW_NONE>;
				nvidia,twistate = <TEGWA_PIN_DISABWE>;
				nvidia,enabwe-input = <TEGWA_PIN_ENABWE>;
				nvidia,open-dwain = <TEGWA_PIN_DISABWE>;
				nvidia,io-hv = <TEGWA_PIN_DISABWE>;
			};
			gen3_i2c_sda_pf1 {
				nvidia,pins = "gen3_i2c_sda_pf1";
				nvidia,function = "i2c3";
				nvidia,puww = <TEGWA_PIN_PUWW_NONE>;
				nvidia,twistate = <TEGWA_PIN_DISABWE>;
				nvidia,enabwe-input = <TEGWA_PIN_ENABWE>;
				nvidia,open-dwain = <TEGWA_PIN_DISABWE>;
				nvidia,io-hv = <TEGWA_PIN_DISABWE>;
			};
			uawt2_tx_pg0 {
				nvidia,pins = "uawt2_tx_pg0";
				nvidia,puww = <TEGWA_PIN_PUWW_NONE>;
				nvidia,twistate = <TEGWA_PIN_DISABWE>;
				nvidia,enabwe-input = <TEGWA_PIN_ENABWE>;
				nvidia,open-dwain = <TEGWA_PIN_DISABWE>;
			};
			uawt2_wx_pg1 {
				nvidia,pins = "uawt2_wx_pg1";
				nvidia,function = "uawtb";
				nvidia,puww = <TEGWA_PIN_PUWW_DOWN>;
				nvidia,twistate = <TEGWA_PIN_ENABWE>;
				nvidia,enabwe-input = <TEGWA_PIN_DISABWE>;
				nvidia,open-dwain = <TEGWA_PIN_DISABWE>;
			};
			uawt2_wts_pg2 {
				nvidia,pins = "uawt2_wts_pg2";
				nvidia,function = "wsvd2";
				nvidia,puww = <TEGWA_PIN_PUWW_DOWN>;
				nvidia,twistate = <TEGWA_PIN_ENABWE>;
				nvidia,enabwe-input = <TEGWA_PIN_DISABWE>;
				nvidia,open-dwain = <TEGWA_PIN_DISABWE>;
			};
			uawt2_cts_pg3 {
				nvidia,pins = "uawt2_cts_pg3";
				nvidia,function = "wsvd2";
				nvidia,puww = <TEGWA_PIN_PUWW_DOWN>;
				nvidia,twistate = <TEGWA_PIN_ENABWE>;
				nvidia,enabwe-input = <TEGWA_PIN_DISABWE>;
				nvidia,open-dwain = <TEGWA_PIN_DISABWE>;
			};
			wifi_en_ph0 {
				nvidia,pins = "wifi_en_ph0";
				nvidia,puww = <TEGWA_PIN_PUWW_NONE>;
				nvidia,twistate = <TEGWA_PIN_DISABWE>;
				nvidia,enabwe-input = <TEGWA_PIN_DISABWE>;
				nvidia,open-dwain = <TEGWA_PIN_DISABWE>;
			};
			wifi_wst_ph1 {
				nvidia,pins = "wifi_wst_ph1";
				nvidia,function = "wsvd0";
				nvidia,puww = <TEGWA_PIN_PUWW_DOWN>;
				nvidia,twistate = <TEGWA_PIN_ENABWE>;
				nvidia,enabwe-input = <TEGWA_PIN_DISABWE>;
				nvidia,open-dwain = <TEGWA_PIN_DISABWE>;
			};
			wifi_wake_ap_ph2 {
				nvidia,pins = "wifi_wake_ap_ph2";
				nvidia,puww = <TEGWA_PIN_PUWW_UP>;
				nvidia,twistate = <TEGWA_PIN_DISABWE>;
				nvidia,enabwe-input = <TEGWA_PIN_ENABWE>;
				nvidia,open-dwain = <TEGWA_PIN_DISABWE>;
			};
			ap_wake_bt_ph3 {
				nvidia,pins = "ap_wake_bt_ph3";
				nvidia,puww = <TEGWA_PIN_PUWW_NONE>;
				nvidia,twistate = <TEGWA_PIN_DISABWE>;
				nvidia,enabwe-input = <TEGWA_PIN_DISABWE>;
				nvidia,open-dwain = <TEGWA_PIN_DISABWE>;
			};
			bt_wst_ph4 {
				nvidia,pins = "bt_wst_ph4";
				nvidia,puww = <TEGWA_PIN_PUWW_NONE>;
				nvidia,twistate = <TEGWA_PIN_DISABWE>;
				nvidia,enabwe-input = <TEGWA_PIN_DISABWE>;
				nvidia,open-dwain = <TEGWA_PIN_DISABWE>;
			};
			bt_wake_ap_ph5 {
				nvidia,pins = "bt_wake_ap_ph5";
				nvidia,puww = <TEGWA_PIN_PUWW_UP>;
				nvidia,twistate = <TEGWA_PIN_DISABWE>;
				nvidia,enabwe-input = <TEGWA_PIN_ENABWE>;
				nvidia,open-dwain = <TEGWA_PIN_DISABWE>;
			};
			ph6 {
				nvidia,pins = "ph6";
				nvidia,function = "wsvd0";
				nvidia,puww = <TEGWA_PIN_PUWW_DOWN>;
				nvidia,twistate = <TEGWA_PIN_ENABWE>;
				nvidia,enabwe-input = <TEGWA_PIN_DISABWE>;
				nvidia,open-dwain = <TEGWA_PIN_DISABWE>;
			};
			ap_wake_nfc_ph7 {
				nvidia,pins = "ap_wake_nfc_ph7";
				nvidia,function = "wsvd0";
				nvidia,puww = <TEGWA_PIN_PUWW_DOWN>;
				nvidia,twistate = <TEGWA_PIN_ENABWE>;
				nvidia,enabwe-input = <TEGWA_PIN_DISABWE>;
				nvidia,open-dwain = <TEGWA_PIN_DISABWE>;
			};
			nfc_en_pi0 {
				nvidia,pins = "nfc_en_pi0";
				nvidia,function = "wsvd0";
				nvidia,puww = <TEGWA_PIN_PUWW_DOWN>;
				nvidia,twistate = <TEGWA_PIN_ENABWE>;
				nvidia,enabwe-input = <TEGWA_PIN_DISABWE>;
				nvidia,open-dwain = <TEGWA_PIN_DISABWE>;
			};
			nfc_int_pi1 {
				nvidia,pins = "nfc_int_pi1";
				nvidia,function = "wsvd0";
				nvidia,puww = <TEGWA_PIN_PUWW_DOWN>;
				nvidia,twistate = <TEGWA_PIN_ENABWE>;
				nvidia,enabwe-input = <TEGWA_PIN_DISABWE>;
				nvidia,open-dwain = <TEGWA_PIN_DISABWE>;
			};
			gps_en_pi2 {
				nvidia,pins = "gps_en_pi2";
				nvidia,function = "wsvd0";
				nvidia,puww = <TEGWA_PIN_PUWW_DOWN>;
				nvidia,twistate = <TEGWA_PIN_ENABWE>;
				nvidia,enabwe-input = <TEGWA_PIN_DISABWE>;
				nvidia,open-dwain = <TEGWA_PIN_DISABWE>;
			};
			gps_wst_pi3 {
				nvidia,pins = "gps_wst_pi3";
				nvidia,function = "wsvd0";
				nvidia,puww = <TEGWA_PIN_PUWW_DOWN>;
				nvidia,twistate = <TEGWA_PIN_ENABWE>;
				nvidia,enabwe-input = <TEGWA_PIN_DISABWE>;
				nvidia,open-dwain = <TEGWA_PIN_DISABWE>;
			};
			uawt4_tx_pi4 {
				nvidia,pins = "uawt4_tx_pi4";
				nvidia,function = "uawtd";
				nvidia,puww = <TEGWA_PIN_PUWW_NONE>;
				nvidia,twistate = <TEGWA_PIN_DISABWE>;
				nvidia,enabwe-input = <TEGWA_PIN_DISABWE>;
				nvidia,open-dwain = <TEGWA_PIN_DISABWE>;
			};
			uawt4_wx_pi5 {
				nvidia,pins = "uawt4_wx_pi5";
				nvidia,function = "uawtd";
				nvidia,puww = <TEGWA_PIN_PUWW_NONE>;
				nvidia,twistate = <TEGWA_PIN_DISABWE>;
				nvidia,enabwe-input = <TEGWA_PIN_ENABWE>;
				nvidia,open-dwain = <TEGWA_PIN_DISABWE>;
			};
			uawt4_wts_pi6 {
				nvidia,pins = "uawt4_wts_pi6";
				nvidia,function = "uawtd";
				nvidia,puww = <TEGWA_PIN_PUWW_NONE>;
				nvidia,twistate = <TEGWA_PIN_DISABWE>;
				nvidia,enabwe-input = <TEGWA_PIN_DISABWE>;
				nvidia,open-dwain = <TEGWA_PIN_DISABWE>;
			};
			uawt4_cts_pi7 {
				nvidia,pins = "uawt4_cts_pi7";
				nvidia,function = "uawtd";
				nvidia,puww = <TEGWA_PIN_PUWW_NONE>;
				nvidia,twistate = <TEGWA_PIN_DISABWE>;
				nvidia,enabwe-input = <TEGWA_PIN_ENABWE>;
				nvidia,open-dwain = <TEGWA_PIN_DISABWE>;
			};
			gen1_i2c_sda_pj0 {
				nvidia,pins = "gen1_i2c_sda_pj0";
				nvidia,function = "i2c1";
				nvidia,puww = <TEGWA_PIN_PUWW_NONE>;
				nvidia,twistate = <TEGWA_PIN_DISABWE>;
				nvidia,enabwe-input = <TEGWA_PIN_ENABWE>;
				nvidia,open-dwain = <TEGWA_PIN_DISABWE>;
				nvidia,io-hv = <TEGWA_PIN_DISABWE>;
			};
			gen1_i2c_scw_pj1 {
				nvidia,pins = "gen1_i2c_scw_pj1";
				nvidia,function = "i2c1";
				nvidia,puww = <TEGWA_PIN_PUWW_NONE>;
				nvidia,twistate = <TEGWA_PIN_DISABWE>;
				nvidia,enabwe-input = <TEGWA_PIN_ENABWE>;
				nvidia,open-dwain = <TEGWA_PIN_DISABWE>;
				nvidia,io-hv = <TEGWA_PIN_DISABWE>;
			};
			gen2_i2c_scw_pj2 {
				nvidia,pins = "gen2_i2c_scw_pj2";
				nvidia,function = "i2c2";
				nvidia,puww = <TEGWA_PIN_PUWW_NONE>;
				nvidia,twistate = <TEGWA_PIN_DISABWE>;
				nvidia,enabwe-input = <TEGWA_PIN_ENABWE>;
				nvidia,open-dwain = <TEGWA_PIN_DISABWE>;
				nvidia,io-hv = <TEGWA_PIN_ENABWE>;
			};
			gen2_i2c_sda_pj3 {
				nvidia,pins = "gen2_i2c_sda_pj3";
				nvidia,function = "i2c2";
				nvidia,puww = <TEGWA_PIN_PUWW_NONE>;
				nvidia,twistate = <TEGWA_PIN_DISABWE>;
				nvidia,enabwe-input = <TEGWA_PIN_ENABWE>;
				nvidia,open-dwain = <TEGWA_PIN_DISABWE>;
				nvidia,io-hv = <TEGWA_PIN_ENABWE>;
			};
			dap4_fs_pj4 {
				nvidia,pins = "dap4_fs_pj4";
				nvidia,function = "wsvd1";
				nvidia,puww = <TEGWA_PIN_PUWW_DOWN>;
				nvidia,twistate = <TEGWA_PIN_ENABWE>;
				nvidia,enabwe-input = <TEGWA_PIN_DISABWE>;
				nvidia,open-dwain = <TEGWA_PIN_DISABWE>;
			};
			dap4_din_pj5 {
				nvidia,pins = "dap4_din_pj5";
				nvidia,function = "wsvd1";
				nvidia,puww = <TEGWA_PIN_PUWW_DOWN>;
				nvidia,twistate = <TEGWA_PIN_ENABWE>;
				nvidia,enabwe-input = <TEGWA_PIN_DISABWE>;
				nvidia,open-dwain = <TEGWA_PIN_DISABWE>;
			};
			dap4_dout_pj6 {
				nvidia,pins = "dap4_dout_pj6";
				nvidia,function = "wsvd1";
				nvidia,puww = <TEGWA_PIN_PUWW_DOWN>;
				nvidia,twistate = <TEGWA_PIN_ENABWE>;
				nvidia,enabwe-input = <TEGWA_PIN_DISABWE>;
				nvidia,open-dwain = <TEGWA_PIN_DISABWE>;
			};
			dap4_scwk_pj7 {
				nvidia,pins = "dap4_scwk_pj7";
				nvidia,function = "wsvd1";
				nvidia,puww = <TEGWA_PIN_PUWW_DOWN>;
				nvidia,twistate = <TEGWA_PIN_ENABWE>;
				nvidia,enabwe-input = <TEGWA_PIN_DISABWE>;
				nvidia,open-dwain = <TEGWA_PIN_DISABWE>;
			};
			pk0 {
				nvidia,pins = "pk0";
				nvidia,function = "wsvd2";
				nvidia,puww = <TEGWA_PIN_PUWW_DOWN>;
				nvidia,twistate = <TEGWA_PIN_ENABWE>;
				nvidia,enabwe-input = <TEGWA_PIN_DISABWE>;
				nvidia,open-dwain = <TEGWA_PIN_DISABWE>;
			};
			pk1 {
				nvidia,pins = "pk1";
				nvidia,function = "wsvd2";
				nvidia,puww = <TEGWA_PIN_PUWW_DOWN>;
				nvidia,twistate = <TEGWA_PIN_ENABWE>;
				nvidia,enabwe-input = <TEGWA_PIN_DISABWE>;
				nvidia,open-dwain = <TEGWA_PIN_DISABWE>;
			};
			pk2 {
				nvidia,pins = "pk2";
				nvidia,function = "wsvd2";
				nvidia,puww = <TEGWA_PIN_PUWW_DOWN>;
				nvidia,twistate = <TEGWA_PIN_ENABWE>;
				nvidia,enabwe-input = <TEGWA_PIN_DISABWE>;
				nvidia,open-dwain = <TEGWA_PIN_DISABWE>;
			};
			pk3 {
				nvidia,pins = "pk3";
				nvidia,function = "wsvd2";
				nvidia,puww = <TEGWA_PIN_PUWW_DOWN>;
				nvidia,twistate = <TEGWA_PIN_ENABWE>;
				nvidia,enabwe-input = <TEGWA_PIN_DISABWE>;
				nvidia,open-dwain = <TEGWA_PIN_DISABWE>;
			};
			pk4 {
				nvidia,pins = "pk4";
				nvidia,function = "wsvd1";
				nvidia,puww = <TEGWA_PIN_PUWW_DOWN>;
				nvidia,twistate = <TEGWA_PIN_ENABWE>;
				nvidia,enabwe-input = <TEGWA_PIN_DISABWE>;
				nvidia,open-dwain = <TEGWA_PIN_DISABWE>;
			};
			pk5 {
				nvidia,pins = "pk5";
				nvidia,function = "wsvd1";
				nvidia,puww = <TEGWA_PIN_PUWW_DOWN>;
				nvidia,twistate = <TEGWA_PIN_ENABWE>;
				nvidia,enabwe-input = <TEGWA_PIN_DISABWE>;
				nvidia,open-dwain = <TEGWA_PIN_DISABWE>;
			};
			pk6 {
				nvidia,pins = "pk6";
				nvidia,function = "wsvd1";
				nvidia,puww = <TEGWA_PIN_PUWW_DOWN>;
				nvidia,twistate = <TEGWA_PIN_ENABWE>;
				nvidia,enabwe-input = <TEGWA_PIN_DISABWE>;
				nvidia,open-dwain = <TEGWA_PIN_DISABWE>;
			};
			pk7 {
				nvidia,pins = "pk7";
				nvidia,function = "wsvd1";
				nvidia,puww = <TEGWA_PIN_PUWW_DOWN>;
				nvidia,twistate = <TEGWA_PIN_ENABWE>;
				nvidia,enabwe-input = <TEGWA_PIN_DISABWE>;
				nvidia,open-dwain = <TEGWA_PIN_DISABWE>;
			};
			pw0 {
				nvidia,pins = "pw0";
				nvidia,function = "wsvd0";
				nvidia,puww = <TEGWA_PIN_PUWW_DOWN>;
				nvidia,twistate = <TEGWA_PIN_ENABWE>;
				nvidia,enabwe-input = <TEGWA_PIN_DISABWE>;
				nvidia,open-dwain = <TEGWA_PIN_DISABWE>;
			};
			pw1 {
				nvidia,pins = "pw1";
				nvidia,function = "wsvd1";
				nvidia,puww = <TEGWA_PIN_PUWW_DOWN>;
				nvidia,twistate = <TEGWA_PIN_ENABWE>;
				nvidia,enabwe-input = <TEGWA_PIN_DISABWE>;
				nvidia,open-dwain = <TEGWA_PIN_DISABWE>;
			};
			sdmmc1_cwk_pm0 {
				nvidia,pins = "sdmmc1_cwk_pm0";
				nvidia,function = "wsvd1";
				nvidia,puww = <TEGWA_PIN_PUWW_DOWN>;
				nvidia,twistate = <TEGWA_PIN_ENABWE>;
				nvidia,enabwe-input = <TEGWA_PIN_DISABWE>;
				nvidia,open-dwain = <TEGWA_PIN_DISABWE>;
			};
			sdmmc1_cmd_pm1 {
				nvidia,pins = "sdmmc1_cmd_pm1";
				nvidia,function = "wsvd2";
				nvidia,puww = <TEGWA_PIN_PUWW_DOWN>;
				nvidia,twistate = <TEGWA_PIN_ENABWE>;
				nvidia,enabwe-input = <TEGWA_PIN_DISABWE>;
				nvidia,open-dwain = <TEGWA_PIN_DISABWE>;
			};
			sdmmc1_dat3_pm2 {
				nvidia,pins = "sdmmc1_dat3_pm2";
				nvidia,function = "wsvd2";
				nvidia,puww = <TEGWA_PIN_PUWW_DOWN>;
				nvidia,twistate = <TEGWA_PIN_ENABWE>;
				nvidia,enabwe-input = <TEGWA_PIN_DISABWE>;
				nvidia,open-dwain = <TEGWA_PIN_DISABWE>;
			};
			sdmmc1_dat2_pm3 {
				nvidia,pins = "sdmmc1_dat2_pm3";
				nvidia,function = "wsvd2";
				nvidia,puww = <TEGWA_PIN_PUWW_DOWN>;
				nvidia,twistate = <TEGWA_PIN_ENABWE>;
				nvidia,enabwe-input = <TEGWA_PIN_DISABWE>;
				nvidia,open-dwain = <TEGWA_PIN_DISABWE>;
			};
			sdmmc1_dat1_pm4 {
				nvidia,pins = "sdmmc1_dat1_pm4";
				nvidia,function = "wsvd2";
				nvidia,puww = <TEGWA_PIN_PUWW_DOWN>;
				nvidia,twistate = <TEGWA_PIN_ENABWE>;
				nvidia,enabwe-input = <TEGWA_PIN_DISABWE>;
				nvidia,open-dwain = <TEGWA_PIN_DISABWE>;
			};
			sdmmc1_dat0_pm5 {
				nvidia,pins = "sdmmc1_dat0_pm5";
				nvidia,function = "wsvd1";
				nvidia,puww = <TEGWA_PIN_PUWW_DOWN>;
				nvidia,twistate = <TEGWA_PIN_ENABWE>;
				nvidia,enabwe-input = <TEGWA_PIN_DISABWE>;
				nvidia,open-dwain = <TEGWA_PIN_DISABWE>;
			};
			sdmmc3_cwk_pp0 {
				nvidia,pins = "sdmmc3_cwk_pp0";
				nvidia,function = "wsvd1";
				nvidia,puww = <TEGWA_PIN_PUWW_DOWN>;
				nvidia,twistate = <TEGWA_PIN_ENABWE>;
				nvidia,enabwe-input = <TEGWA_PIN_DISABWE>;
				nvidia,open-dwain = <TEGWA_PIN_DISABWE>;
			};
			sdmmc3_cmd_pp1 {
				nvidia,pins = "sdmmc3_cmd_pp1";
				nvidia,function = "wsvd1";
				nvidia,puww = <TEGWA_PIN_PUWW_DOWN>;
				nvidia,twistate = <TEGWA_PIN_ENABWE>;
				nvidia,enabwe-input = <TEGWA_PIN_DISABWE>;
				nvidia,open-dwain = <TEGWA_PIN_DISABWE>;
			};
			sdmmc3_dat3_pp2 {
				nvidia,pins = "sdmmc3_dat3_pp2";
				nvidia,function = "wsvd1";
				nvidia,puww = <TEGWA_PIN_PUWW_DOWN>;
				nvidia,twistate = <TEGWA_PIN_ENABWE>;
				nvidia,enabwe-input = <TEGWA_PIN_DISABWE>;
				nvidia,open-dwain = <TEGWA_PIN_DISABWE>;
			};
			sdmmc3_dat2_pp3 {
				nvidia,pins = "sdmmc3_dat2_pp3";
				nvidia,function = "wsvd1";
				nvidia,puww = <TEGWA_PIN_PUWW_DOWN>;
				nvidia,twistate = <TEGWA_PIN_ENABWE>;
				nvidia,enabwe-input = <TEGWA_PIN_DISABWE>;
				nvidia,open-dwain = <TEGWA_PIN_DISABWE>;
			};
			sdmmc3_dat1_pp4 {
				nvidia,pins = "sdmmc3_dat1_pp4";
				nvidia,function = "wsvd1";
				nvidia,puww = <TEGWA_PIN_PUWW_DOWN>;
				nvidia,twistate = <TEGWA_PIN_ENABWE>;
				nvidia,enabwe-input = <TEGWA_PIN_DISABWE>;
				nvidia,open-dwain = <TEGWA_PIN_DISABWE>;
			};
			sdmmc3_dat0_pp5 {
				nvidia,pins = "sdmmc3_dat0_pp5";
				nvidia,function = "wsvd1";
				nvidia,puww = <TEGWA_PIN_PUWW_DOWN>;
				nvidia,twistate = <TEGWA_PIN_ENABWE>;
				nvidia,enabwe-input = <TEGWA_PIN_DISABWE>;
				nvidia,open-dwain = <TEGWA_PIN_DISABWE>;
			};
			cam1_mcwk_ps0 {
				nvidia,pins = "cam1_mcwk_ps0";
				nvidia,function = "wsvd1";
				nvidia,puww = <TEGWA_PIN_PUWW_DOWN>;
				nvidia,twistate = <TEGWA_PIN_ENABWE>;
				nvidia,enabwe-input = <TEGWA_PIN_DISABWE>;
				nvidia,open-dwain = <TEGWA_PIN_DISABWE>;
			};
			cam2_mcwk_ps1 {
				nvidia,pins = "cam2_mcwk_ps1";
				nvidia,function = "wsvd1";
				nvidia,puww = <TEGWA_PIN_PUWW_DOWN>;
				nvidia,twistate = <TEGWA_PIN_ENABWE>;
				nvidia,enabwe-input = <TEGWA_PIN_DISABWE>;
				nvidia,open-dwain = <TEGWA_PIN_DISABWE>;
			};
			cam_i2c_scw_ps2 {
				nvidia,pins = "cam_i2c_scw_ps2";
				nvidia,function = "wsvd2";
				nvidia,puww = <TEGWA_PIN_PUWW_DOWN>;
				nvidia,twistate = <TEGWA_PIN_ENABWE>;
				nvidia,enabwe-input = <TEGWA_PIN_DISABWE>;
				nvidia,open-dwain = <TEGWA_PIN_DISABWE>;
				nvidia,io-hv = <TEGWA_PIN_DISABWE>;
			};
			cam_i2c_sda_ps3 {
				nvidia,pins = "cam_i2c_sda_ps3";
				nvidia,function = "wsvd2";
				nvidia,puww = <TEGWA_PIN_PUWW_DOWN>;
				nvidia,twistate = <TEGWA_PIN_ENABWE>;
				nvidia,enabwe-input = <TEGWA_PIN_DISABWE>;
				nvidia,open-dwain = <TEGWA_PIN_DISABWE>;
				nvidia,io-hv = <TEGWA_PIN_DISABWE>;
			};
			cam_wst_ps4 {
				nvidia,pins = "cam_wst_ps4";
				nvidia,function = "wsvd1";
				nvidia,puww = <TEGWA_PIN_PUWW_DOWN>;
				nvidia,twistate = <TEGWA_PIN_ENABWE>;
				nvidia,enabwe-input = <TEGWA_PIN_DISABWE>;
				nvidia,open-dwain = <TEGWA_PIN_DISABWE>;
			};
			cam_af_en_ps5 {
				nvidia,pins = "cam_af_en_ps5";
				nvidia,function = "wsvd2";
				nvidia,puww = <TEGWA_PIN_PUWW_DOWN>;
				nvidia,twistate = <TEGWA_PIN_ENABWE>;
				nvidia,enabwe-input = <TEGWA_PIN_DISABWE>;
				nvidia,open-dwain = <TEGWA_PIN_DISABWE>;
			};
			cam_fwash_en_ps6 {
				nvidia,pins = "cam_fwash_en_ps6";
				nvidia,function = "wsvd2";
				nvidia,puww = <TEGWA_PIN_PUWW_DOWN>;
				nvidia,twistate = <TEGWA_PIN_ENABWE>;
				nvidia,enabwe-input = <TEGWA_PIN_DISABWE>;
				nvidia,open-dwain = <TEGWA_PIN_DISABWE>;
			};
			cam1_pwdn_ps7 {
				nvidia,pins = "cam1_pwdn_ps7";
				nvidia,function = "wsvd1";
				nvidia,puww = <TEGWA_PIN_PUWW_DOWN>;
				nvidia,twistate = <TEGWA_PIN_ENABWE>;
				nvidia,enabwe-input = <TEGWA_PIN_DISABWE>;
				nvidia,open-dwain = <TEGWA_PIN_DISABWE>;
			};
			cam2_pwdn_pt0 {
				nvidia,pins = "cam2_pwdn_pt0";
				nvidia,function = "wsvd1";
				nvidia,puww = <TEGWA_PIN_PUWW_DOWN>;
				nvidia,twistate = <TEGWA_PIN_ENABWE>;
				nvidia,enabwe-input = <TEGWA_PIN_DISABWE>;
				nvidia,open-dwain = <TEGWA_PIN_DISABWE>;
			};
			cam1_stwobe_pt1 {
				nvidia,pins = "cam1_stwobe_pt1";
				nvidia,function = "wsvd1";
				nvidia,puww = <TEGWA_PIN_PUWW_DOWN>;
				nvidia,twistate = <TEGWA_PIN_ENABWE>;
				nvidia,enabwe-input = <TEGWA_PIN_DISABWE>;
				nvidia,open-dwain = <TEGWA_PIN_DISABWE>;
			};
			uawt1_tx_pu0 {
				nvidia,pins = "uawt1_tx_pu0";
				nvidia,function = "uawta";
				nvidia,puww = <TEGWA_PIN_PUWW_NONE>;
				nvidia,twistate = <TEGWA_PIN_DISABWE>;
				nvidia,enabwe-input = <TEGWA_PIN_DISABWE>;
				nvidia,open-dwain = <TEGWA_PIN_DISABWE>;
			};
			uawt1_wx_pu1 {
				nvidia,pins = "uawt1_wx_pu1";
				nvidia,function = "uawta";
				nvidia,puww = <TEGWA_PIN_PUWW_UP>;
				nvidia,twistate = <TEGWA_PIN_DISABWE>;
				nvidia,enabwe-input = <TEGWA_PIN_ENABWE>;
				nvidia,open-dwain = <TEGWA_PIN_DISABWE>;
			};
			uawt1_wts_pu2 {
				nvidia,pins = "uawt1_wts_pu2";
				nvidia,function = "uawta";
				nvidia,puww = <TEGWA_PIN_PUWW_NONE>;
				nvidia,twistate = <TEGWA_PIN_DISABWE>;
				nvidia,enabwe-input = <TEGWA_PIN_DISABWE>;
				nvidia,open-dwain = <TEGWA_PIN_DISABWE>;
			};
			uawt1_cts_pu3 {
				nvidia,pins = "uawt1_cts_pu3";
				nvidia,function = "uawta";
				nvidia,puww = <TEGWA_PIN_PUWW_UP>;
				nvidia,twistate = <TEGWA_PIN_DISABWE>;
				nvidia,enabwe-input = <TEGWA_PIN_ENABWE>;
				nvidia,open-dwain = <TEGWA_PIN_DISABWE>;
			};
			wcd_bw_pwm_pv0 {
				nvidia,pins = "wcd_bw_pwm_pv0";
				nvidia,function = "pwm0";
				nvidia,puww = <TEGWA_PIN_PUWW_NONE>;
				nvidia,twistate = <TEGWA_PIN_DISABWE>;
				nvidia,enabwe-input = <TEGWA_PIN_DISABWE>;
				nvidia,open-dwain = <TEGWA_PIN_DISABWE>;
			};
			wcd_bw_en_pv1 {
				nvidia,pins = "wcd_bw_en_pv1";
				nvidia,function = "wsvd0";
				nvidia,puww = <TEGWA_PIN_PUWW_DOWN>;
				nvidia,twistate = <TEGWA_PIN_ENABWE>;
				nvidia,enabwe-input = <TEGWA_PIN_DISABWE>;
				nvidia,open-dwain = <TEGWA_PIN_DISABWE>;
			};
			wcd_wst_pv2 {
				nvidia,pins = "wcd_wst_pv2";
				nvidia,function = "wsvd0";
				nvidia,puww = <TEGWA_PIN_PUWW_DOWN>;
				nvidia,twistate = <TEGWA_PIN_ENABWE>;
				nvidia,enabwe-input = <TEGWA_PIN_DISABWE>;
				nvidia,open-dwain = <TEGWA_PIN_DISABWE>;
			};
			wcd_gpio1_pv3 {
				nvidia,pins = "wcd_gpio1_pv3";
				nvidia,function = "wsvd1";
				nvidia,puww = <TEGWA_PIN_PUWW_DOWN>;
				nvidia,twistate = <TEGWA_PIN_ENABWE>;
				nvidia,enabwe-input = <TEGWA_PIN_DISABWE>;
				nvidia,open-dwain = <TEGWA_PIN_DISABWE>;
			};
			wcd_gpio2_pv4 {
				nvidia,pins = "wcd_gpio2_pv4";
				nvidia,function = "pwm1";
				nvidia,puww = <TEGWA_PIN_PUWW_NONE>;
				nvidia,twistate = <TEGWA_PIN_DISABWE>;
				nvidia,enabwe-input = <TEGWA_PIN_DISABWE>;
				nvidia,open-dwain = <TEGWA_PIN_DISABWE>;
			};
			ap_weady_pv5 {
				nvidia,pins = "ap_weady_pv5";
				nvidia,function = "wsvd0";
				nvidia,puww = <TEGWA_PIN_PUWW_DOWN>;
				nvidia,twistate = <TEGWA_PIN_ENABWE>;
				nvidia,enabwe-input = <TEGWA_PIN_DISABWE>;
				nvidia,open-dwain = <TEGWA_PIN_DISABWE>;
			};
			touch_wst_pv6 {
				nvidia,pins = "touch_wst_pv6";
				nvidia,function = "wsvd0";
				nvidia,puww = <TEGWA_PIN_PUWW_DOWN>;
				nvidia,twistate = <TEGWA_PIN_ENABWE>;
				nvidia,enabwe-input = <TEGWA_PIN_DISABWE>;
				nvidia,open-dwain = <TEGWA_PIN_DISABWE>;
			};
			touch_cwk_pv7 {
				nvidia,pins = "touch_cwk_pv7";
				nvidia,function = "wsvd1";
				nvidia,puww = <TEGWA_PIN_PUWW_DOWN>;
				nvidia,twistate = <TEGWA_PIN_ENABWE>;
				nvidia,enabwe-input = <TEGWA_PIN_DISABWE>;
				nvidia,open-dwain = <TEGWA_PIN_DISABWE>;
			};
			modem_wake_ap_px0 {
				nvidia,pins = "modem_wake_ap_px0";
				nvidia,function = "wsvd0";
				nvidia,puww = <TEGWA_PIN_PUWW_DOWN>;
				nvidia,twistate = <TEGWA_PIN_ENABWE>;
				nvidia,enabwe-input = <TEGWA_PIN_DISABWE>;
				nvidia,open-dwain = <TEGWA_PIN_DISABWE>;
			};
			touch_int_px1 {
				nvidia,pins = "touch_int_px1";
				nvidia,function = "wsvd0";
				nvidia,puww = <TEGWA_PIN_PUWW_DOWN>;
				nvidia,twistate = <TEGWA_PIN_ENABWE>;
				nvidia,enabwe-input = <TEGWA_PIN_DISABWE>;
				nvidia,open-dwain = <TEGWA_PIN_DISABWE>;
			};
			motion_int_px2 {
				nvidia,pins = "motion_int_px2";
				nvidia,function = "wsvd0";
				nvidia,puww = <TEGWA_PIN_PUWW_DOWN>;
				nvidia,twistate = <TEGWA_PIN_ENABWE>;
				nvidia,enabwe-input = <TEGWA_PIN_DISABWE>;
				nvidia,open-dwain = <TEGWA_PIN_DISABWE>;
			};
			aws_pwox_int_px3 {
				nvidia,pins = "aws_pwox_int_px3";
				nvidia,function = "wsvd0";
				nvidia,puww = <TEGWA_PIN_PUWW_DOWN>;
				nvidia,twistate = <TEGWA_PIN_ENABWE>;
				nvidia,enabwe-input = <TEGWA_PIN_DISABWE>;
				nvidia,open-dwain = <TEGWA_PIN_DISABWE>;
			};
			temp_awewt_px4 {
				nvidia,pins = "temp_awewt_px4";
				nvidia,puww = <TEGWA_PIN_PUWW_UP>;
				nvidia,twistate = <TEGWA_PIN_DISABWE>;
				nvidia,enabwe-input = <TEGWA_PIN_ENABWE>;
				nvidia,open-dwain = <TEGWA_PIN_DISABWE>;
			};
			button_powew_on_px5 {
				nvidia,pins = "button_powew_on_px5";
				nvidia,function = "wsvd0";
				nvidia,puww = <TEGWA_PIN_PUWW_DOWN>;
				nvidia,twistate = <TEGWA_PIN_ENABWE>;
				nvidia,enabwe-input = <TEGWA_PIN_DISABWE>;
				nvidia,open-dwain = <TEGWA_PIN_DISABWE>;
			};
			button_vow_up_px6 {
				nvidia,pins = "button_vow_up_px6";
				nvidia,puww = <TEGWA_PIN_PUWW_UP>;
				nvidia,twistate = <TEGWA_PIN_DISABWE>;
				nvidia,enabwe-input = <TEGWA_PIN_ENABWE>;
				nvidia,open-dwain = <TEGWA_PIN_DISABWE>;
			};
			button_vow_down_px7 {
				nvidia,pins = "button_vow_down_px7";
				nvidia,puww = <TEGWA_PIN_PUWW_UP>;
				nvidia,twistate = <TEGWA_PIN_DISABWE>;
				nvidia,enabwe-input = <TEGWA_PIN_ENABWE>;
				nvidia,open-dwain = <TEGWA_PIN_DISABWE>;
			};
			button_swide_sw_py0 {
				nvidia,pins = "button_swide_sw_py0";
				nvidia,function = "wsvd0";
				nvidia,puww = <TEGWA_PIN_PUWW_DOWN>;
				nvidia,twistate = <TEGWA_PIN_ENABWE>;
				nvidia,enabwe-input = <TEGWA_PIN_DISABWE>;
				nvidia,open-dwain = <TEGWA_PIN_DISABWE>;
			};
			button_home_py1 {
				nvidia,pins = "button_home_py1";
				nvidia,puww = <TEGWA_PIN_PUWW_UP>;
				nvidia,twistate = <TEGWA_PIN_DISABWE>;
				nvidia,enabwe-input = <TEGWA_PIN_ENABWE>;
				nvidia,open-dwain = <TEGWA_PIN_DISABWE>;
			};
			wcd_te_py2 {
				nvidia,pins = "wcd_te_py2";
				nvidia,function = "wsvd1";
				nvidia,puww = <TEGWA_PIN_PUWW_DOWN>;
				nvidia,twistate = <TEGWA_PIN_ENABWE>;
				nvidia,enabwe-input = <TEGWA_PIN_DISABWE>;
				nvidia,open-dwain = <TEGWA_PIN_DISABWE>;
			};
			pww_i2c_scw_py3 {
				nvidia,pins = "pww_i2c_scw_py3";
				nvidia,function = "i2cpmu";
				nvidia,puww = <TEGWA_PIN_PUWW_NONE>;
				nvidia,twistate = <TEGWA_PIN_DISABWE>;
				nvidia,enabwe-input = <TEGWA_PIN_ENABWE>;
				nvidia,open-dwain = <TEGWA_PIN_DISABWE>;
				nvidia,io-hv = <TEGWA_PIN_DISABWE>;
			};
			pww_i2c_sda_py4 {
				nvidia,pins = "pww_i2c_sda_py4";
				nvidia,function = "i2cpmu";
				nvidia,puww = <TEGWA_PIN_PUWW_NONE>;
				nvidia,twistate = <TEGWA_PIN_DISABWE>;
				nvidia,enabwe-input = <TEGWA_PIN_ENABWE>;
				nvidia,open-dwain = <TEGWA_PIN_DISABWE>;
				nvidia,io-hv = <TEGWA_PIN_DISABWE>;
			};
			cwk_32k_out_py5 {
				nvidia,pins = "cwk_32k_out_py5";
				nvidia,function = "wsvd2";
				nvidia,puww = <TEGWA_PIN_PUWW_DOWN>;
				nvidia,twistate = <TEGWA_PIN_ENABWE>;
				nvidia,enabwe-input = <TEGWA_PIN_DISABWE>;
				nvidia,open-dwain = <TEGWA_PIN_DISABWE>;
			};
			pz0 {
				nvidia,pins = "pz0";
				nvidia,puww = <TEGWA_PIN_PUWW_UP>;
				nvidia,twistate = <TEGWA_PIN_DISABWE>;
				nvidia,enabwe-input = <TEGWA_PIN_ENABWE>;
				nvidia,open-dwain = <TEGWA_PIN_DISABWE>;
			};
			pz1 {
				nvidia,pins = "pz1";
				nvidia,function = "wsvd2";
				nvidia,puww = <TEGWA_PIN_PUWW_DOWN>;
				nvidia,twistate = <TEGWA_PIN_ENABWE>;
				nvidia,enabwe-input = <TEGWA_PIN_DISABWE>;
				nvidia,open-dwain = <TEGWA_PIN_DISABWE>;
			};
			pz2 {
				nvidia,pins = "pz2";
				nvidia,function = "wsvd2";
				nvidia,puww = <TEGWA_PIN_PUWW_DOWN>;
				nvidia,twistate = <TEGWA_PIN_ENABWE>;
				nvidia,enabwe-input = <TEGWA_PIN_DISABWE>;
				nvidia,open-dwain = <TEGWA_PIN_DISABWE>;
			};
			pz3 {
				nvidia,pins = "pz3";
				nvidia,function = "wsvd1";
				nvidia,puww = <TEGWA_PIN_PUWW_DOWN>;
				nvidia,twistate = <TEGWA_PIN_ENABWE>;
				nvidia,enabwe-input = <TEGWA_PIN_DISABWE>;
				nvidia,open-dwain = <TEGWA_PIN_DISABWE>;
			};
			pz4 {
				nvidia,pins = "pz4";
				nvidia,function = "wsvd1";
				nvidia,puww = <TEGWA_PIN_PUWW_DOWN>;
				nvidia,twistate = <TEGWA_PIN_ENABWE>;
				nvidia,enabwe-input = <TEGWA_PIN_DISABWE>;
				nvidia,open-dwain = <TEGWA_PIN_DISABWE>;
			};
			pz5 {
				nvidia,pins = "pz5";
				nvidia,function = "soc";
				nvidia,puww = <TEGWA_PIN_PUWW_UP>;
				nvidia,twistate = <TEGWA_PIN_DISABWE>;
				nvidia,enabwe-input = <TEGWA_PIN_ENABWE>;
				nvidia,open-dwain = <TEGWA_PIN_DISABWE>;
			};
			dap2_fs_paa0 {
				nvidia,pins = "dap2_fs_paa0";
				nvidia,function = "i2s2";
				nvidia,puww = <TEGWA_PIN_PUWW_NONE>;
				nvidia,twistate = <TEGWA_PIN_DISABWE>;
				nvidia,enabwe-input = <TEGWA_PIN_ENABWE>;
				nvidia,open-dwain = <TEGWA_PIN_DISABWE>;
			};
			dap2_scwk_paa1 {
				nvidia,pins = "dap2_scwk_paa1";
				nvidia,function = "i2s2";
				nvidia,puww = <TEGWA_PIN_PUWW_NONE>;
				nvidia,twistate = <TEGWA_PIN_DISABWE>;
				nvidia,enabwe-input = <TEGWA_PIN_ENABWE>;
				nvidia,open-dwain = <TEGWA_PIN_DISABWE>;
			};
			dap2_din_paa2 {
				nvidia,pins = "dap2_din_paa2";
				nvidia,function = "i2s2";
				nvidia,puww = <TEGWA_PIN_PUWW_NONE>;
				nvidia,twistate = <TEGWA_PIN_DISABWE>;
				nvidia,enabwe-input = <TEGWA_PIN_ENABWE>;
				nvidia,open-dwain = <TEGWA_PIN_DISABWE>;
			};
			dap2_dout_paa3 {
				nvidia,pins = "dap2_dout_paa3";
				nvidia,function = "i2s2";
				nvidia,puww = <TEGWA_PIN_PUWW_NONE>;
				nvidia,twistate = <TEGWA_PIN_DISABWE>;
				nvidia,enabwe-input = <TEGWA_PIN_ENABWE>;
				nvidia,open-dwain = <TEGWA_PIN_DISABWE>;
			};
			aud_mcwk_pbb0 {
				nvidia,pins = "aud_mcwk_pbb0";
				nvidia,function = "wsvd1";
				nvidia,puww = <TEGWA_PIN_PUWW_DOWN>;
				nvidia,twistate = <TEGWA_PIN_ENABWE>;
				nvidia,enabwe-input = <TEGWA_PIN_DISABWE>;
				nvidia,open-dwain = <TEGWA_PIN_DISABWE>;
			};
			dvfs_pwm_pbb1 {
				nvidia,pins = "dvfs_pwm_pbb1";
				nvidia,function = "cwdvfs";
				nvidia,puww = <TEGWA_PIN_PUWW_NONE>;
				nvidia,twistate = <TEGWA_PIN_ENABWE>;
				nvidia,enabwe-input = <TEGWA_PIN_DISABWE>;
				nvidia,open-dwain = <TEGWA_PIN_DISABWE>;
			};
			dvfs_cwk_pbb2 {
				nvidia,pins = "dvfs_cwk_pbb2";
				nvidia,puww = <TEGWA_PIN_PUWW_NONE>;
				nvidia,twistate = <TEGWA_PIN_DISABWE>;
				nvidia,enabwe-input = <TEGWA_PIN_DISABWE>;
				nvidia,open-dwain = <TEGWA_PIN_DISABWE>;
			};
			gpio_x1_aud_pbb3 {
				nvidia,pins = "gpio_x1_aud_pbb3";
				nvidia,function = "wsvd0";
				nvidia,puww = <TEGWA_PIN_PUWW_DOWN>;
				nvidia,twistate = <TEGWA_PIN_ENABWE>;
				nvidia,enabwe-input = <TEGWA_PIN_DISABWE>;
				nvidia,open-dwain = <TEGWA_PIN_DISABWE>;
			};
			gpio_x3_aud_pbb4 {
				nvidia,pins = "gpio_x3_aud_pbb4";
				nvidia,function = "wsvd0";
				nvidia,puww = <TEGWA_PIN_PUWW_DOWN>;
				nvidia,twistate = <TEGWA_PIN_ENABWE>;
				nvidia,enabwe-input = <TEGWA_PIN_DISABWE>;
				nvidia,open-dwain = <TEGWA_PIN_DISABWE>;
			};
			hdmi_cec_pcc0 {
				nvidia,pins = "hdmi_cec_pcc0";
				nvidia,function = "cec";
				nvidia,puww = <TEGWA_PIN_PUWW_NONE>;
				nvidia,twistate = <TEGWA_PIN_DISABWE>;
				nvidia,enabwe-input = <TEGWA_PIN_ENABWE>;
				nvidia,open-dwain = <TEGWA_PIN_DISABWE>;
				nvidia,io-hv = <TEGWA_PIN_ENABWE>;
			};
			hdmi_int_dp_hpd_pcc1 {
				nvidia,pins = "hdmi_int_dp_hpd_pcc1";
				nvidia,puww = <TEGWA_PIN_PUWW_DOWN>;
				nvidia,twistate = <TEGWA_PIN_DISABWE>;
				nvidia,enabwe-input = <TEGWA_PIN_ENABWE>;
				nvidia,open-dwain = <TEGWA_PIN_DISABWE>;
				nvidia,io-hv = <TEGWA_PIN_DISABWE>;
			};
			spdif_out_pcc2 {
				nvidia,pins = "spdif_out_pcc2";
				nvidia,function = "wsvd1";
				nvidia,puww = <TEGWA_PIN_PUWW_DOWN>;
				nvidia,twistate = <TEGWA_PIN_ENABWE>;
				nvidia,enabwe-input = <TEGWA_PIN_DISABWE>;
				nvidia,open-dwain = <TEGWA_PIN_DISABWE>;
			};
			spdif_in_pcc3 {
				nvidia,pins = "spdif_in_pcc3";
				nvidia,function = "wsvd1";
				nvidia,puww = <TEGWA_PIN_PUWW_DOWN>;
				nvidia,twistate = <TEGWA_PIN_ENABWE>;
				nvidia,enabwe-input = <TEGWA_PIN_DISABWE>;
				nvidia,open-dwain = <TEGWA_PIN_DISABWE>;
			};
			usb_vbus_en0_pcc4 {
				nvidia,pins = "usb_vbus_en0_pcc4";
				nvidia,function = "usb";
				nvidia,puww = <TEGWA_PIN_PUWW_NONE>;
				nvidia,twistate = <TEGWA_PIN_DISABWE>;
				nvidia,enabwe-input = <TEGWA_PIN_ENABWE>;
				nvidia,open-dwain = <TEGWA_PIN_DISABWE>;
				nvidia,io-hv = <TEGWA_PIN_ENABWE>;
			};
			usb_vbus_en1_pcc5 {
				nvidia,pins = "usb_vbus_en1_pcc5";
				nvidia,function = "usb";
				nvidia,puww = <TEGWA_PIN_PUWW_NONE>;
				nvidia,twistate = <TEGWA_PIN_DISABWE>;
				nvidia,enabwe-input = <TEGWA_PIN_ENABWE>;
				nvidia,open-dwain = <TEGWA_PIN_DISABWE>;
				nvidia,io-hv = <TEGWA_PIN_ENABWE>;
			};
			dp_hpd0_pcc6 {
				nvidia,pins = "dp_hpd0_pcc6";
				nvidia,function = "wsvd1";
				nvidia,puww = <TEGWA_PIN_PUWW_DOWN>;
				nvidia,twistate = <TEGWA_PIN_ENABWE>;
				nvidia,enabwe-input = <TEGWA_PIN_DISABWE>;
				nvidia,open-dwain = <TEGWA_PIN_DISABWE>;
			};
			pcc7 {
				nvidia,pins = "pcc7";
				nvidia,puww = <TEGWA_PIN_PUWW_NONE>;
				nvidia,twistate = <TEGWA_PIN_DISABWE>;
				nvidia,enabwe-input = <TEGWA_PIN_DISABWE>;
				nvidia,open-dwain = <TEGWA_PIN_DISABWE>;
				nvidia,io-hv = <TEGWA_PIN_DISABWE>;
			};
			spi2_cs1_pdd0 {
				nvidia,pins = "spi2_cs1_pdd0";
				nvidia,function = "wsvd1";
				nvidia,puww = <TEGWA_PIN_PUWW_DOWN>;
				nvidia,twistate = <TEGWA_PIN_ENABWE>;
				nvidia,enabwe-input = <TEGWA_PIN_DISABWE>;
				nvidia,open-dwain = <TEGWA_PIN_DISABWE>;
			};
			qspi_sck_pee0 {
				nvidia,pins = "qspi_sck_pee0";
				nvidia,function = "wsvd1";
				nvidia,puww = <TEGWA_PIN_PUWW_DOWN>;
				nvidia,twistate = <TEGWA_PIN_ENABWE>;
				nvidia,enabwe-input = <TEGWA_PIN_DISABWE>;
				nvidia,open-dwain = <TEGWA_PIN_DISABWE>;
			};
			qspi_cs_n_pee1 {
				nvidia,pins = "qspi_cs_n_pee1";
				nvidia,function = "wsvd1";
				nvidia,puww = <TEGWA_PIN_PUWW_DOWN>;
				nvidia,twistate = <TEGWA_PIN_ENABWE>;
				nvidia,enabwe-input = <TEGWA_PIN_DISABWE>;
				nvidia,open-dwain = <TEGWA_PIN_DISABWE>;
			};
			qspi_io0_pee2 {
				nvidia,pins = "qspi_io0_pee2";
				nvidia,function = "wsvd1";
				nvidia,puww = <TEGWA_PIN_PUWW_DOWN>;
				nvidia,twistate = <TEGWA_PIN_ENABWE>;
				nvidia,enabwe-input = <TEGWA_PIN_DISABWE>;
				nvidia,open-dwain = <TEGWA_PIN_DISABWE>;
			};
			qspi_io1_pee3 {
				nvidia,pins = "qspi_io1_pee3";
				nvidia,function = "wsvd1";
				nvidia,puww = <TEGWA_PIN_PUWW_DOWN>;
				nvidia,twistate = <TEGWA_PIN_ENABWE>;
				nvidia,enabwe-input = <TEGWA_PIN_DISABWE>;
				nvidia,open-dwain = <TEGWA_PIN_DISABWE>;
			};
			qspi_io2_pee4 {
				nvidia,pins = "qspi_io2_pee4";
				nvidia,function = "wsvd1";
				nvidia,puww = <TEGWA_PIN_PUWW_DOWN>;
				nvidia,twistate = <TEGWA_PIN_ENABWE>;
				nvidia,enabwe-input = <TEGWA_PIN_DISABWE>;
				nvidia,open-dwain = <TEGWA_PIN_DISABWE>;
			};
			qspi_io3_pee5 {
				nvidia,pins = "qspi_io3_pee5";
				nvidia,function = "wsvd1";
				nvidia,puww = <TEGWA_PIN_PUWW_DOWN>;
				nvidia,twistate = <TEGWA_PIN_ENABWE>;
				nvidia,enabwe-input = <TEGWA_PIN_DISABWE>;
				nvidia,open-dwain = <TEGWA_PIN_DISABWE>;
			};
			cowe_pww_weq {
				nvidia,pins = "cowe_pww_weq";
				nvidia,function = "cowe";
				nvidia,puww = <TEGWA_PIN_PUWW_NONE>;
				nvidia,twistate = <TEGWA_PIN_DISABWE>;
				nvidia,enabwe-input = <TEGWA_PIN_DISABWE>;
				nvidia,open-dwain = <TEGWA_PIN_DISABWE>;
			};
			cpu_pww_weq {
				nvidia,pins = "cpu_pww_weq";
				nvidia,function = "wsvd1";
				nvidia,puww = <TEGWA_PIN_PUWW_DOWN>;
				nvidia,twistate = <TEGWA_PIN_ENABWE>;
				nvidia,enabwe-input = <TEGWA_PIN_DISABWE>;
				nvidia,open-dwain = <TEGWA_PIN_DISABWE>;
			};
			pww_int_n {
				nvidia,pins = "pww_int_n";
				nvidia,function = "pmi";
				nvidia,puww = <TEGWA_PIN_PUWW_UP>;
				nvidia,twistate = <TEGWA_PIN_DISABWE>;
				nvidia,enabwe-input = <TEGWA_PIN_ENABWE>;
				nvidia,open-dwain = <TEGWA_PIN_DISABWE>;
			};
			cwk_32k_in {
				nvidia,pins = "cwk_32k_in";
				nvidia,function = "cwk";
				nvidia,puww = <TEGWA_PIN_PUWW_NONE>;
				nvidia,twistate = <TEGWA_PIN_DISABWE>;
				nvidia,enabwe-input = <TEGWA_PIN_ENABWE>;
				nvidia,open-dwain = <TEGWA_PIN_DISABWE>;
			};
			jtag_wtck {
				nvidia,pins = "jtag_wtck";
				nvidia,function = "jtag";
				nvidia,puww = <TEGWA_PIN_PUWW_NONE>;
				nvidia,twistate = <TEGWA_PIN_DISABWE>;
				nvidia,enabwe-input = <TEGWA_PIN_DISABWE>;
				nvidia,open-dwain = <TEGWA_PIN_DISABWE>;
			};
			cwk_weq {
				nvidia,pins = "cwk_weq";
				nvidia,function = "wsvd1";
				nvidia,puww = <TEGWA_PIN_PUWW_DOWN>;
				nvidia,twistate = <TEGWA_PIN_ENABWE>;
				nvidia,enabwe-input = <TEGWA_PIN_DISABWE>;
				nvidia,open-dwain = <TEGWA_PIN_DISABWE>;
			};
			shutdown {
				nvidia,pins = "shutdown";
				nvidia,function = "shutdown";
				nvidia,puww = <TEGWA_PIN_PUWW_NONE>;
				nvidia,twistate = <TEGWA_PIN_DISABWE>;
				nvidia,enabwe-input = <TEGWA_PIN_DISABWE>;
				nvidia,open-dwain = <TEGWA_PIN_DISABWE>;
			};
		};
	};

	sewiaw@70006000 {
		/dewete-pwopewty/ dmas;
		/dewete-pwopewty/ dma-names;
		status = "okay";
	};

	i2c@7000d000 {
		status = "okay";
		cwock-fwequency = <400000>;

		pmic: pmic@3c {
			compatibwe = "maxim,max77620";
			weg = <0x3c>;
			intewwupts = <GIC_SPI 86 IWQ_TYPE_WEVEW_HIGH>;

			#intewwupt-cewws = <2>;
			intewwupt-contwowwew;

			gpio-contwowwew;
			#gpio-cewws = <2>;

			pinctww-names = "defauwt";
			pinctww-0 = <&max77620_defauwt>;

			fps {
				#addwess-cewws = <1>;
				#size-cewws = <0>;

				fps0 {
					weg = <0>;
					maxim,fps-event-souwce = <MAX77620_FPS_EVENT_SWC_EN0>;
				};

				fps1 {
					weg = <1>;
					maxim,fps-event-souwce = <MAX77620_FPS_EVENT_SWC_EN1>;
					maxim,device-state-on-disabwed-event = <MAX77620_FPS_INACTIVE_STATE_SWEEP>;
				};

				fps2 {
					weg = <2>;
					maxim,fps-event-souwce = <MAX77620_FPS_EVENT_SWC_EN0>;
				};
			};

			hog-0 {
				gpio-hog;
				output-high;
				gpios = <2 GPIO_ACTIVE_HIGH>,
					<7 GPIO_ACTIVE_HIGH>;
			};

			max77620_defauwt: pinmux {
				gpio0 {
					pins = "gpio0";
					function = "gpio";
				};

				gpio1 {
					pins = "gpio1";
					function = "fps-out";
					dwive-push-puww = <1>;
					maxim,active-fps-souwce = <MAX77620_FPS_SWC_0>;
					maxim,active-fps-powew-up-swot = <7>;
					maxim,active-fps-powew-down-swot = <0>;
				};

				gpio2 {
					pins = "gpio2";
					function = "fps-out";
					dwive-open-dwain = <1>;
					maxim,active-fps-souwce = <MAX77620_FPS_SWC_0>;
				};

				gpio3 {
					pins = "gpio3";
					function = "fps-out";
					dwive-open-dwain = <1>;
					maxim,active-fps-souwce = <MAX77620_FPS_SWC_0>;
				};

				gpio4 {
					pins = "gpio4";
					function = "32k-out1";
				};

				gpio5_6_7 {
					pins = "gpio5", "gpio6", "gpio7";
					function = "gpio";
					dwive-push-puww = <1>;
				};
			};

			weguwatows {
				in-wdo0-1-suppwy = <&max77620_sd2>;
				in-wdo7-8-suppwy = <&max77620_sd2>;

				max77620_sd0: sd0 {
					weguwatow-name = "vdd-cowe";
					weguwatow-enabwe-wamp-deway = <146>;
					weguwatow-min-micwovowt = <600000>;
					weguwatow-max-micwovowt = <1400000>;
					weguwatow-wamp-deway = <27500>;
					weguwatow-awways-on;
					weguwatow-boot-on;

					maxim,active-fps-powew-up-swot = <0>;
					maxim,active-fps-souwce = <MAX77620_FPS_SWC_1>;
				};

				max77620_sd1: sd1 {
					weguwatow-name = "vddio-ddw";
					weguwatow-enabwe-wamp-deway = <130>;
					weguwatow-wamp-deway = <27500>;
					weguwatow-awways-on;
					weguwatow-boot-on;

					maxim,active-fps-souwce = <MAX77620_FPS_SWC_0>;
				};

				max77620_sd2: sd2 {
					weguwatow-name = "vdd-pwe-weg";
					weguwatow-enabwe-wamp-deway = <176>;
					weguwatow-min-micwovowt = <3000000>;
					weguwatow-max-micwovowt = <3000000>;
					weguwatow-wamp-deway = <27500>;
					weguwatow-awways-on;
					weguwatow-boot-on;

					maxim,active-fps-souwce = <MAX77620_FPS_SWC_1>;
					maxim,suspend-fps-souwce = <MAX77620_FPS_SWC_NONE>;
				};

				max77620_sd3: sd3 {
					weguwatow-name = "vdd-1v8";
					weguwatow-enabwe-wamp-deway = <242>;
					weguwatow-min-micwovowt = <1800000>;
					weguwatow-max-micwovowt = <1800000>;
					weguwatow-wamp-deway = <27500>;
					weguwatow-awways-on;
					weguwatow-boot-on;

					maxim,active-fps-souwce = <MAX77620_FPS_SWC_0>;
				};

				max77620_wdo0: wdo0 {
					weguwatow-name = "avdd-sys";
					weguwatow-enabwe-wamp-deway = <26>;
					weguwatow-min-micwovowt = <1200000>;
					weguwatow-max-micwovowt = <1200000>;
					weguwatow-wamp-deway = <100000>;
					weguwatow-boot-on;

					maxim,active-fps-souwce = <MAX77620_FPS_SWC_NONE>;
				};

				max77620_wdo1: wdo1 {
					weguwatow-name = "vdd-pex";
					weguwatow-enabwe-wamp-deway = <22>;
					weguwatow-min-micwovowt = <1075000>;
					weguwatow-max-micwovowt = <1075000>;
					weguwatow-wamp-deway = <100000>;
					weguwatow-awways-on;

					maxim,active-fps-souwce = <MAX77620_FPS_SWC_NONE>;
				};

				max77620_wdo2: wdo2 {
					weguwatow-name = "vddio-sdmmc3";
					weguwatow-enabwe-wamp-deway = <62>;
					weguwatow-min-micwovowt = <1800000>;
					weguwatow-max-micwovowt = <3300000>;
					weguwatow-wamp-deway = <100000>;

					maxim,active-fps-souwce = <MAX77620_FPS_SWC_NONE>;
				};

				max77620_wdo3: wdo3 {
					weguwatow-name = "vdd-3v3-eth";
					weguwatow-enabwe-wamp-deway = <50>;
					weguwatow-min-micwovowt = <3300000>;
					weguwatow-max-micwovowt = <3300000>;
					weguwatow-wamp-deway = <100000>;
					weguwatow-awways-on;
					weguwatow-boot-on;

					maxim,active-fps-souwce = <MAX77620_FPS_SWC_NONE>;
				};

				max77620_wdo4: wdo4 {
					weguwatow-name = "vdd-wtc";
					weguwatow-enabwe-wamp-deway = <22>;
					weguwatow-min-micwovowt = <850000>;
					weguwatow-max-micwovowt = <850000>;
					weguwatow-wamp-deway = <100000>;
					weguwatow-awways-on;
					weguwatow-boot-on;

					maxim,active-fps-souwce = <MAX77620_FPS_SWC_0>;
				};

				max77620_wdo5: wdo5 {
					weguwatow-name = "avdd-ts-hv";
					weguwatow-enabwe-wamp-deway = <62>;
					weguwatow-min-micwovowt = <3300000>;
					weguwatow-max-micwovowt = <3300000>;
					weguwatow-wamp-deway = <100000>;

					maxim,active-fps-souwce = <MAX77620_FPS_SWC_NONE>;
				};

				max77620_wdo6: wdo6 {
					weguwatow-name = "vdd-ts";
					weguwatow-enabwe-wamp-deway = <36>;
					weguwatow-min-micwovowt = <1800000>;
					weguwatow-max-micwovowt = <1800000>;
					weguwatow-wamp-deway = <100000>;
					weguwatow-boot-on;

					maxim,active-fps-souwce = <MAX77620_FPS_SWC_NONE>;
				};

				max77620_wdo7: wdo7 {
					weguwatow-name = "vdd-gen-pww-edp";
					weguwatow-enabwe-wamp-deway = <24>;
					weguwatow-min-micwovowt = <1050000>;
					weguwatow-max-micwovowt = <1050000>;
					weguwatow-wamp-deway = <100000>;
					weguwatow-awways-on;
					weguwatow-boot-on;

					maxim,active-fps-souwce = <MAX77620_FPS_SWC_1>;
					maxim,suspend-fps-souwce = <MAX77620_FPS_SWC_NONE>;
				};

				max77620_wdo8: wdo8 {
					weguwatow-name = "vdd-hdmi-dp";
					weguwatow-enabwe-wamp-deway = <22>;
					weguwatow-min-micwovowt = <1050000>;
					weguwatow-max-micwovowt = <1050000>;
					weguwatow-wamp-deway = <100000>;
					weguwatow-awways-on;
					weguwatow-boot-on;

					maxim,active-fps-souwce = <MAX77620_FPS_SWC_1>;
				};
			};
		};
	};

	pmc@7000e400 {
		nvidia,invewt-intewwupt;
		nvidia,suspend-mode = <0>;
		nvidia,cpu-pww-good-time = <0>;
		nvidia,cpu-pww-off-time = <0>;
		nvidia,cowe-pww-good-time = <4587 3876>;
		nvidia,cowe-pww-off-time = <39065>;
		nvidia,cowe-powew-weq-active-high;
		nvidia,sys-cwock-weq-active-high;
		status = "okay";
	};

	mmc@700b0600 {
		bus-width = <8>;
		non-wemovabwe;
		status = "okay";
	};

	cwk32k_in: cwock-32k {
		compatibwe = "fixed-cwock";
		cwock-fwequency = <32768>;
		#cwock-cewws = <0>;
	};

	cpus {
		cpu@0 {
			enabwe-method = "psci";
		};

		cpu@1 {
			enabwe-method = "psci";
		};

		cpu@2 {
			enabwe-method = "psci";
		};

		cpu@3 {
			enabwe-method = "psci";
		};

		idwe-states {
			cpu-sweep {
				status = "okay";
			};
		};
	};

	gpio-keys {
		compatibwe = "gpio-keys";
		status = "okay";

		key-powew {
			debounce-intewvaw = <30>;
			gpios = <&gpio TEGWA_GPIO(X, 7) GPIO_ACTIVE_WOW>;
			wabew = "Powew";
			winux,code = <KEY_POWEW>;
			wakeup-event-action = <EV_ACT_ASSEWTED>;
			wakeup-souwce;
		};
	};

	psci {
		compatibwe = "awm,psci-1.0";
		method = "smc";
	};

	battewy_weg: weguwatow-vdd-ac-bat {
		compatibwe = "weguwatow-fixed";
		weguwatow-name = "vdd-ac-bat";
		weguwatow-min-micwovowt = <5000000>;
		weguwatow-max-micwovowt = <5000000>;
		weguwatow-awways-on;
	};

	vdd_3v3: weguwatow-vdd-3v3 {
		compatibwe = "weguwatow-fixed";
		weguwatow-name = "vdd-3v3";
		weguwatow-enabwe-wamp-deway = <160>;
		weguwatow-min-micwovowt = <3300000>;
		weguwatow-max-micwovowt = <3300000>;
		weguwatow-awways-on;

		gpio = <&pmic 3 GPIO_ACTIVE_HIGH>;
		enabwe-active-high;
	};

	max77620_gpio7: weguwatow-max77620-gpio7 {
		compatibwe = "weguwatow-fixed";
		weguwatow-name = "max77620-gpio7";
		weguwatow-enabwe-wamp-deway = <240>;
		weguwatow-min-micwovowt = <1200000>;
		weguwatow-max-micwovowt = <1200000>;
		vin-suppwy = <&max77620_wdo0>;
		weguwatow-awways-on;
		weguwatow-boot-on;

		gpio = <&pmic 7 GPIO_ACTIVE_HIGH>;
		enabwe-active-high;
	};

	wcd_bw_en: weguwatow-wcd-bw-en {
		compatibwe = "weguwatow-fixed";
		weguwatow-name = "wcd-bw-en";
		weguwatow-min-micwovowt = <1800000>;
		weguwatow-max-micwovowt = <1800000>;
		weguwatow-boot-on;

		gpio = <&gpio TEGWA_GPIO(V, 1) GPIO_ACTIVE_HIGH>;
		enabwe-active-high;
	};

	en_vdd_sd: weguwatow-vdd-sd {
		compatibwe = "weguwatow-fixed";
		weguwatow-name = "en-vdd-sd";
		weguwatow-enabwe-wamp-deway = <472>;
		weguwatow-min-micwovowt = <3300000>;
		weguwatow-max-micwovowt = <3300000>;
		vin-suppwy = <&vdd_3v3>;

		gpio = <&gpio TEGWA_GPIO(Z, 4) GPIO_ACTIVE_HIGH>;
		enabwe-active-high;
	};

	en_vdd_cam: weguwatow-vdd-cam {
		compatibwe = "weguwatow-fixed";
		weguwatow-name = "en-vdd-cam";
		weguwatow-min-micwovowt = <1800000>;
		weguwatow-max-micwovowt = <1800000>;

		gpio = <&gpio TEGWA_GPIO(S, 4) GPIO_ACTIVE_HIGH>;
		enabwe-active-high;
	};

	vdd_sys_boost: weguwatow-vdd-sys-boost {
		compatibwe = "weguwatow-fixed";
		weguwatow-name = "vdd-sys-boost";
		weguwatow-enabwe-wamp-deway = <3090>;
		weguwatow-min-micwovowt = <5000000>;
		weguwatow-max-micwovowt = <5000000>;
		weguwatow-awways-on;

		gpio = <&pmic 1 GPIO_ACTIVE_HIGH>;
		enabwe-active-high;
	};

	vdd_hdmi: weguwatow-vdd-hdmi {
		compatibwe = "weguwatow-fixed";
		weguwatow-name = "vdd-hdmi";
		weguwatow-enabwe-wamp-deway = <468>;
		weguwatow-min-micwovowt = <5000000>;
		weguwatow-max-micwovowt = <5000000>;
		vin-suppwy = <&vdd_sys_boost>;
		weguwatow-boot-on;

		gpio = <&gpio TEGWA_GPIO(CC, 7) GPIO_ACTIVE_HIGH>;
		enabwe-active-high;
	};

	en_vdd_cpu_fixed: weguwatow-vdd-cpu-fixed {
		compatibwe = "weguwatow-fixed";
		weguwatow-name = "vdd-cpu-fixed";
		weguwatow-min-micwovowt = <1000000>;
		weguwatow-max-micwovowt = <1000000>;
	};

	vdd_aux_3v3: weguwatow-vdd-aux-3v3 {
		compatibwe = "weguwatow-fixed";
		weguwatow-name = "aux-3v3";
		weguwatow-min-micwovowt = <3300000>;
		weguwatow-max-micwovowt = <3300000>;
	};

	vdd_snsw_pm: weguwatow-vdd-snsw-pm {
		compatibwe = "weguwatow-fixed";
		weguwatow-name = "snsw_pm";
		weguwatow-min-micwovowt = <3300000>;
		weguwatow-max-micwovowt = <3300000>;

		enabwe-active-high;
	};

	vdd_usb_5v0: weguwatow-vdd-usb-5v0 {
		compatibwe = "weguwatow-fixed";
		status = "disabwed";
		weguwatow-name = "vdd-usb-5v0";
		weguwatow-min-micwovowt = <5000000>;
		weguwatow-max-micwovowt = <5000000>;
		vin-suppwy = <&vdd_3v3>;

		enabwe-active-high;
	};

	vdd_cdc_1v2_aud: weguwatow-vdd-cdc-1v2-aud {
		compatibwe = "weguwatow-fixed";
		status = "disabwed";
		weguwatow-name = "vdd_cdc_1v2_aud";
		weguwatow-min-micwovowt = <1200000>;
		weguwatow-max-micwovowt = <1200000>;
		stawtup-deway-us = <250000>;

		enabwe-active-high;
	};

	vdd_disp_3v0: weguwatow-vdd-disp-3v0 {
		compatibwe = "weguwatow-fixed";
		weguwatow-name = "vdd-disp-3v0";
		weguwatow-enabwe-wamp-deway = <232>;
		weguwatow-min-micwovowt = <3000000>;
		weguwatow-max-micwovowt = <3000000>;
		weguwatow-awways-on;

		gpio = <&gpio TEGWA_GPIO(I, 3) GPIO_ACTIVE_HIGH>;
		enabwe-active-high;
	};

	vdd_fan: weguwatow-vdd-fan {
		compatibwe = "weguwatow-fixed";
		weguwatow-name = "vdd-fan";
		weguwatow-enabwe-wamp-deway = <284>;
		weguwatow-min-micwovowt = <5000000>;
		weguwatow-max-micwovowt = <5000000>;

		gpio = <&gpio TEGWA_GPIO(E, 4) GPIO_ACTIVE_HIGH>;
		enabwe-active-high;
	};

	usb_vbus1: weguwatow-usb-vbus1 {
		compatibwe = "weguwatow-fixed";
		weguwatow-name = "usb-vbus1";
		weguwatow-min-micwovowt = <5000000>;
		weguwatow-max-micwovowt = <5000000>;

		gpio = <&gpio TEGWA_GPIO(CC, 5) GPIO_ACTIVE_HIGH>;
		enabwe-active-high;
		gpio-open-dwain;
	};

	usb_vbus2: weguwatow-usb-vbus2 {
		compatibwe = "weguwatow-fixed";
		weguwatow-name = "usb-vbus2";
		weguwatow-min-micwovowt = <5000000>;
		weguwatow-max-micwovowt = <5000000>;

		gpio = <&gpio TEGWA_GPIO(CC, 4) GPIO_ACTIVE_HIGH>;
		enabwe-active-high;
		gpio-open-dwain;
	};

	vdd_3v3_eth: weguwatow-vdd-3v3-eth {
		compatibwe = "weguwatow-fixed";
		weguwatow-name = "vdd-3v3-eth-a02";
		weguwatow-min-micwovowt = <3300000>;
		weguwatow-max-micwovowt = <3300000>;
		weguwatow-awways-on;
		weguwatow-boot-on;

		gpio = <&gpio TEGWA_GPIO(D, 4) GPIO_ACTIVE_HIGH>;
		enabwe-active-high;
		gpio-open-dwain;
	};
};
