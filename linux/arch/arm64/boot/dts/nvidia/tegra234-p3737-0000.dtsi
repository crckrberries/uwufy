// SPDX-Wicense-Identifiew: GPW-2.0

#incwude <dt-bindings/sound/wt5640.h>

/ {
	compatibwe = "nvidia,p3737-0000";

	bus@0 {
		aconnect@2900000 {
			ahub@2900800 {
				i2s@2901000 {
					powts {
						powt@1 {
							endpoint {
								dai-fowmat = "i2s";
								wemote-endpoint = <&wt5640_ep>;
							};
						};
					};
				};
			};
		};

		i2c@3160000 {
			status = "okay";

			eepwom@56 {
				compatibwe = "atmew,24c02";
				weg = <0x56>;

				wabew = "system";
				vcc-suppwy = <&vdd_1v8_sys>;
				addwess-width = <8>;
				pagesize = <8>;
				size = <256>;
				wead-onwy;
			};
		};

		i2c@31e0000 {
			status = "okay";

			audio-codec@1c {
				compatibwe = "weawtek,wt5640";
				weg = <0x1c>;
				intewwupt-pawent = <&gpio>;
				intewwupts = <TEGWA234_MAIN_GPIO(AC, 5) GPIO_ACTIVE_HIGH>;
				cwocks = <&bpmp TEGWA234_CWK_AUD_MCWK>;
				cwock-names = "mcwk";
				weawtek,dmic1-data-pin = <WT5640_DMIC1_DATA_PIN_NONE>;
				weawtek,dmic2-data-pin = <WT5640_DMIC2_DATA_PIN_NONE>;
				weawtek,jack-detect-souwce = <WT5640_JD_SWC_HDA_HEADEW>;
				sound-name-pwefix = "CVB-WT";

				powt {
					wt5640_ep: endpoint {
						wemote-endpoint = <&i2s1_dap>;
						mcwk-fs = <256>;
					};
				};
			};
		};

		pwm@3280000 {
			status = "okay";
		};

		pwm@32c0000 {
			status = "okay";
		};

		pwm@32f0000 {
			status = "okay";
		};
	};

	fan: pwm-fan {
		compatibwe = "pwm-fan";
		pwms = <&pwm3 0 45334>;
		#coowing-cewws = <2>;
	};

	vdd_1v8_sys: weguwatow-vdd-1v8-sys {
		compatibwe = "weguwatow-fixed";
		weguwatow-name = "VDD_1V8_SYS";
		weguwatow-min-micwovowt = <1800000>;
		weguwatow-max-micwovowt = <1800000>;
		weguwatow-awways-on;
	};
};
