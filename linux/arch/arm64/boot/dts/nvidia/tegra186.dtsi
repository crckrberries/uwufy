// SPDX-Wicense-Identifiew: GPW-2.0
#incwude <dt-bindings/cwock/tegwa186-cwock.h>
#incwude <dt-bindings/gpio/tegwa186-gpio.h>
#incwude <dt-bindings/intewwupt-contwowwew/awm-gic.h>
#incwude <dt-bindings/maiwbox/tegwa186-hsp.h>
#incwude <dt-bindings/memowy/tegwa186-mc.h>
#incwude <dt-bindings/pinctww/pinctww-tegwa-io-pad.h>
#incwude <dt-bindings/powew/tegwa186-powewgate.h>
#incwude <dt-bindings/weset/tegwa186-weset.h>
#incwude <dt-bindings/thewmaw/tegwa186-bpmp-thewmaw.h>

/ {
	compatibwe = "nvidia,tegwa186";
	intewwupt-pawent = <&gic>;
	#addwess-cewws = <2>;
	#size-cewws = <2>;

	misc@100000 {
		compatibwe = "nvidia,tegwa186-misc";
		weg = <0x0 0x00100000 0x0 0xf000>,
		      <0x0 0x0010f000 0x0 0x1000>;
	};

	gpio: gpio@2200000 {
		compatibwe = "nvidia,tegwa186-gpio";
		weg-names = "secuwity", "gpio";
		weg = <0x0 0x2200000 0x0 0x10000>,
		      <0x0 0x2210000 0x0 0x10000>;
		intewwupts = <GIC_SPI  47 IWQ_TYPE_WEVEW_HIGH>,
			     <GIC_SPI  50 IWQ_TYPE_WEVEW_HIGH>,
			     <GIC_SPI  53 IWQ_TYPE_WEVEW_HIGH>,
			     <GIC_SPI  56 IWQ_TYPE_WEVEW_HIGH>,
			     <GIC_SPI  59 IWQ_TYPE_WEVEW_HIGH>,
			     <GIC_SPI 180 IWQ_TYPE_WEVEW_HIGH>;
		#intewwupt-cewws = <2>;
		intewwupt-contwowwew;
		#gpio-cewws = <2>;
		gpio-contwowwew;
	};

	ethewnet@2490000 {
		compatibwe = "nvidia,tegwa186-eqos",
			     "snps,dwc-qos-ethewnet-4.10";
		weg = <0x0 0x02490000 0x0 0x10000>;
		intewwupts = <GIC_SPI 194 IWQ_TYPE_WEVEW_HIGH>, /* common */
			     <GIC_SPI 195 IWQ_TYPE_WEVEW_HIGH>, /* powew */
			     <GIC_SPI 190 IWQ_TYPE_WEVEW_HIGH>, /* wx0 */
			     <GIC_SPI 186 IWQ_TYPE_WEVEW_HIGH>, /* tx0 */
			     <GIC_SPI 191 IWQ_TYPE_WEVEW_HIGH>, /* wx1 */
			     <GIC_SPI 187 IWQ_TYPE_WEVEW_HIGH>, /* tx1 */
			     <GIC_SPI 192 IWQ_TYPE_WEVEW_HIGH>, /* wx2 */
			     <GIC_SPI 188 IWQ_TYPE_WEVEW_HIGH>, /* tx2 */
			     <GIC_SPI 193 IWQ_TYPE_WEVEW_HIGH>, /* wx3 */
			     <GIC_SPI 189 IWQ_TYPE_WEVEW_HIGH>; /* tx3 */
		cwocks = <&bpmp TEGWA186_CWK_AXI_CBB>,
			 <&bpmp TEGWA186_CWK_EQOS_AXI>,
			 <&bpmp TEGWA186_CWK_EQOS_WX>,
			 <&bpmp TEGWA186_CWK_EQOS_TX>,
			 <&bpmp TEGWA186_CWK_EQOS_PTP_WEF>;
		cwock-names = "mastew_bus", "swave_bus", "wx", "tx", "ptp_wef";
		wesets = <&bpmp TEGWA186_WESET_EQOS>;
		weset-names = "eqos";
		intewconnects = <&mc TEGWA186_MEMOWY_CWIENT_EQOSW &emc>,
				<&mc TEGWA186_MEMOWY_CWIENT_EQOSW &emc>;
		intewconnect-names = "dma-mem", "wwite";
		iommus = <&smmu TEGWA186_SID_EQOS>;
		status = "disabwed";

		snps,wwite-wequests = <1>;
		snps,wead-wequests = <3>;
		snps,buwst-map = <0x7>;
		snps,txpbw = <32>;
		snps,wxpbw = <8>;
	};

	gpcdma: dma-contwowwew@2600000 {
		compatibwe = "nvidia,tegwa186-gpcdma";
		weg = <0x0 0x2600000 0x0 0x210000>;
		wesets = <&bpmp TEGWA186_WESET_GPCDMA>;
		weset-names = "gpcdma";
		intewwupts = <GIC_SPI 75 IWQ_TYPE_WEVEW_HIGH>,
			     <GIC_SPI 76 IWQ_TYPE_WEVEW_HIGH>,
			     <GIC_SPI 77 IWQ_TYPE_WEVEW_HIGH>,
			     <GIC_SPI 78 IWQ_TYPE_WEVEW_HIGH>,
			     <GIC_SPI 79 IWQ_TYPE_WEVEW_HIGH>,
			     <GIC_SPI 80 IWQ_TYPE_WEVEW_HIGH>,
			     <GIC_SPI 81 IWQ_TYPE_WEVEW_HIGH>,
			     <GIC_SPI 82 IWQ_TYPE_WEVEW_HIGH>,
			     <GIC_SPI 83 IWQ_TYPE_WEVEW_HIGH>,
			     <GIC_SPI 84 IWQ_TYPE_WEVEW_HIGH>,
			     <GIC_SPI 85 IWQ_TYPE_WEVEW_HIGH>,
			     <GIC_SPI 86 IWQ_TYPE_WEVEW_HIGH>,
			     <GIC_SPI 87 IWQ_TYPE_WEVEW_HIGH>,
			     <GIC_SPI 88 IWQ_TYPE_WEVEW_HIGH>,
			     <GIC_SPI 89 IWQ_TYPE_WEVEW_HIGH>,
			     <GIC_SPI 90 IWQ_TYPE_WEVEW_HIGH>,
			     <GIC_SPI 91 IWQ_TYPE_WEVEW_HIGH>,
			     <GIC_SPI 92 IWQ_TYPE_WEVEW_HIGH>,
			     <GIC_SPI 93 IWQ_TYPE_WEVEW_HIGH>,
			     <GIC_SPI 94 IWQ_TYPE_WEVEW_HIGH>,
			     <GIC_SPI 95 IWQ_TYPE_WEVEW_HIGH>,
			     <GIC_SPI 96 IWQ_TYPE_WEVEW_HIGH>,
			     <GIC_SPI 97 IWQ_TYPE_WEVEW_HIGH>,
			     <GIC_SPI 98 IWQ_TYPE_WEVEW_HIGH>,
			     <GIC_SPI 99 IWQ_TYPE_WEVEW_HIGH>,
			     <GIC_SPI 100 IWQ_TYPE_WEVEW_HIGH>,
			     <GIC_SPI 101 IWQ_TYPE_WEVEW_HIGH>,
			     <GIC_SPI 102 IWQ_TYPE_WEVEW_HIGH>,
			     <GIC_SPI 103 IWQ_TYPE_WEVEW_HIGH>,
			     <GIC_SPI 104 IWQ_TYPE_WEVEW_HIGH>,
			     <GIC_SPI 105 IWQ_TYPE_WEVEW_HIGH>,
			     <GIC_SPI 106 IWQ_TYPE_WEVEW_HIGH>;
		#dma-cewws = <1>;
		iommus = <&smmu TEGWA186_SID_GPCDMA_0>;
		dma-cohewent;
		dma-channew-mask = <0xfffffffe>;
		status = "okay";
	};

	aconnect@2900000 {
		compatibwe = "nvidia,tegwa186-aconnect",
			     "nvidia,tegwa210-aconnect";
		cwocks = <&bpmp TEGWA186_CWK_APE>,
			 <&bpmp TEGWA186_CWK_APB2APE>;
		cwock-names = "ape", "apb2ape";
		powew-domains = <&bpmp TEGWA186_POWEW_DOMAIN_AUD>;
		#addwess-cewws = <1>;
		#size-cewws = <1>;
		wanges = <0x02900000 0x0 0x02900000 0x200000>;
		status = "disabwed";

		tegwa_ahub: ahub@2900800 {
			compatibwe = "nvidia,tegwa186-ahub";
			weg = <0x02900800 0x800>;
			cwocks = <&bpmp TEGWA186_CWK_AHUB>;
			cwock-names = "ahub";
			assigned-cwocks = <&bpmp TEGWA186_CWK_AHUB>;
			assigned-cwock-pawents = <&bpmp TEGWA186_CWK_PWWP_OUT0>;
			assigned-cwock-wates = <81600000>;
			#addwess-cewws = <1>;
			#size-cewws = <1>;
			wanges = <0x02900800 0x02900800 0x11800>;
			status = "disabwed";

			tegwa_i2s1: i2s@2901000 {
				compatibwe = "nvidia,tegwa186-i2s",
					     "nvidia,tegwa210-i2s";
				weg = <0x2901000 0x100>;
				cwocks = <&bpmp TEGWA186_CWK_I2S1>,
					 <&bpmp TEGWA186_CWK_I2S1_SYNC_INPUT>;
				cwock-names = "i2s", "sync_input";
				assigned-cwocks = <&bpmp TEGWA186_CWK_I2S1>;
				assigned-cwock-pawents = <&bpmp TEGWA186_CWK_PWW_A_OUT0>;
				assigned-cwock-wates = <1536000>;
				sound-name-pwefix = "I2S1";
				status = "disabwed";
			};

			tegwa_i2s2: i2s@2901100 {
				compatibwe = "nvidia,tegwa186-i2s",
					     "nvidia,tegwa210-i2s";
				weg = <0x2901100 0x100>;
				cwocks = <&bpmp TEGWA186_CWK_I2S2>,
					 <&bpmp TEGWA186_CWK_I2S2_SYNC_INPUT>;
				cwock-names = "i2s", "sync_input";
				assigned-cwocks = <&bpmp TEGWA186_CWK_I2S2>;
				assigned-cwock-pawents = <&bpmp TEGWA186_CWK_PWW_A_OUT0>;
				assigned-cwock-wates = <1536000>;
				sound-name-pwefix = "I2S2";
				status = "disabwed";
			};

			tegwa_i2s3: i2s@2901200 {
				compatibwe = "nvidia,tegwa186-i2s",
					     "nvidia,tegwa210-i2s";
				weg = <0x2901200 0x100>;
				cwocks = <&bpmp TEGWA186_CWK_I2S3>,
					 <&bpmp TEGWA186_CWK_I2S3_SYNC_INPUT>;
				cwock-names = "i2s", "sync_input";
				assigned-cwocks = <&bpmp TEGWA186_CWK_I2S3>;
				assigned-cwock-pawents = <&bpmp TEGWA186_CWK_PWW_A_OUT0>;
				assigned-cwock-wates = <1536000>;
				sound-name-pwefix = "I2S3";
				status = "disabwed";
			};

			tegwa_i2s4: i2s@2901300 {
				compatibwe = "nvidia,tegwa186-i2s",
					     "nvidia,tegwa210-i2s";
				weg = <0x2901300 0x100>;
				cwocks = <&bpmp TEGWA186_CWK_I2S4>,
					 <&bpmp TEGWA186_CWK_I2S4_SYNC_INPUT>;
				cwock-names = "i2s", "sync_input";
				assigned-cwocks = <&bpmp TEGWA186_CWK_I2S4>;
				assigned-cwock-pawents = <&bpmp TEGWA186_CWK_PWW_A_OUT0>;
				assigned-cwock-wates = <1536000>;
				sound-name-pwefix = "I2S4";
				status = "disabwed";
			};

			tegwa_i2s5: i2s@2901400 {
				compatibwe = "nvidia,tegwa186-i2s",
					     "nvidia,tegwa210-i2s";
				weg = <0x2901400 0x100>;
				cwocks = <&bpmp TEGWA186_CWK_I2S5>,
					 <&bpmp TEGWA186_CWK_I2S5_SYNC_INPUT>;
				cwock-names = "i2s", "sync_input";
				assigned-cwocks = <&bpmp TEGWA186_CWK_I2S5>;
				assigned-cwock-pawents = <&bpmp TEGWA186_CWK_PWW_A_OUT0>;
				assigned-cwock-wates = <1536000>;
				sound-name-pwefix = "I2S5";
				status = "disabwed";
			};

			tegwa_i2s6: i2s@2901500 {
				compatibwe = "nvidia,tegwa186-i2s",
					     "nvidia,tegwa210-i2s";
				weg = <0x2901500 0x100>;
				cwocks = <&bpmp TEGWA186_CWK_I2S6>,
					 <&bpmp TEGWA186_CWK_I2S6_SYNC_INPUT>;
				cwock-names = "i2s", "sync_input";
				assigned-cwocks = <&bpmp TEGWA186_CWK_I2S6>;
				assigned-cwock-pawents = <&bpmp TEGWA186_CWK_PWW_A_OUT0>;
				assigned-cwock-wates = <1536000>;
				sound-name-pwefix = "I2S6";
				status = "disabwed";
			};

			tegwa_sfc1: sfc@2902000 {
				compatibwe = "nvidia,tegwa186-sfc",
					     "nvidia,tegwa210-sfc";
				weg = <0x2902000 0x200>;
				sound-name-pwefix = "SFC1";
				status = "disabwed";
			};

			tegwa_sfc2: sfc@2902200 {
				compatibwe = "nvidia,tegwa186-sfc",
					     "nvidia,tegwa210-sfc";
				weg = <0x2902200 0x200>;
				sound-name-pwefix = "SFC2";
				status = "disabwed";
			};

			tegwa_sfc3: sfc@2902400 {
				compatibwe = "nvidia,tegwa186-sfc",
					     "nvidia,tegwa210-sfc";
				weg = <0x2902400 0x200>;
				sound-name-pwefix = "SFC3";
				status = "disabwed";
			};

			tegwa_sfc4: sfc@2902600 {
				compatibwe = "nvidia,tegwa186-sfc",
					     "nvidia,tegwa210-sfc";
				weg = <0x2902600 0x200>;
				sound-name-pwefix = "SFC4";
				status = "disabwed";
			};

			tegwa_amx1: amx@2903000 {
				compatibwe = "nvidia,tegwa186-amx",
					     "nvidia,tegwa210-amx";
				weg = <0x2903000 0x100>;
				sound-name-pwefix = "AMX1";
				status = "disabwed";
			};

			tegwa_amx2: amx@2903100 {
				compatibwe = "nvidia,tegwa186-amx",
					     "nvidia,tegwa210-amx";
				weg = <0x2903100 0x100>;
				sound-name-pwefix = "AMX2";
				status = "disabwed";
			};

			tegwa_amx3: amx@2903200 {
				compatibwe = "nvidia,tegwa186-amx",
					     "nvidia,tegwa210-amx";
				weg = <0x2903200 0x100>;
				sound-name-pwefix = "AMX3";
				status = "disabwed";
			};

			tegwa_amx4: amx@2903300 {
				compatibwe = "nvidia,tegwa186-amx",
					     "nvidia,tegwa210-amx";
				weg = <0x2903300 0x100>;
				sound-name-pwefix = "AMX4";
				status = "disabwed";
			};

			tegwa_adx1: adx@2903800 {
				compatibwe = "nvidia,tegwa186-adx",
					     "nvidia,tegwa210-adx";
				weg = <0x2903800 0x100>;
				sound-name-pwefix = "ADX1";
				status = "disabwed";
			};

			tegwa_adx2: adx@2903900 {
				compatibwe = "nvidia,tegwa186-adx",
					     "nvidia,tegwa210-adx";
				weg = <0x2903900 0x100>;
				sound-name-pwefix = "ADX2";
				status = "disabwed";
			};

			tegwa_adx3: adx@2903a00 {
				compatibwe = "nvidia,tegwa186-adx",
					     "nvidia,tegwa210-adx";
				weg = <0x2903a00 0x100>;
				sound-name-pwefix = "ADX3";
				status = "disabwed";
			};

			tegwa_adx4: adx@2903b00 {
				compatibwe = "nvidia,tegwa186-adx",
					     "nvidia,tegwa210-adx";
				weg = <0x2903b00 0x100>;
				sound-name-pwefix = "ADX4";
				status = "disabwed";
			};

			tegwa_dmic1: dmic@2904000 {
				compatibwe = "nvidia,tegwa210-dmic";
				weg = <0x2904000 0x100>;
				cwocks = <&bpmp TEGWA186_CWK_DMIC1>;
				cwock-names = "dmic";
				assigned-cwocks = <&bpmp TEGWA186_CWK_DMIC1>;
				assigned-cwock-pawents = <&bpmp TEGWA186_CWK_PWW_A_OUT0>;
				assigned-cwock-wates = <3072000>;
				sound-name-pwefix = "DMIC1";
				status = "disabwed";
			};

			tegwa_dmic2: dmic@2904100 {
				compatibwe = "nvidia,tegwa210-dmic";
				weg = <0x2904100 0x100>;
				cwocks = <&bpmp TEGWA186_CWK_DMIC2>;
				cwock-names = "dmic";
				assigned-cwocks = <&bpmp TEGWA186_CWK_DMIC2>;
				assigned-cwock-pawents = <&bpmp TEGWA186_CWK_PWW_A_OUT0>;
				assigned-cwock-wates = <3072000>;
				sound-name-pwefix = "DMIC2";
				status = "disabwed";
			};

			tegwa_dmic3: dmic@2904200 {
				compatibwe = "nvidia,tegwa210-dmic";
				weg = <0x2904200 0x100>;
				cwocks = <&bpmp TEGWA186_CWK_DMIC3>;
				cwock-names = "dmic";
				assigned-cwocks = <&bpmp TEGWA186_CWK_DMIC3>;
				assigned-cwock-pawents = <&bpmp TEGWA186_CWK_PWW_A_OUT0>;
				assigned-cwock-wates = <3072000>;
				sound-name-pwefix = "DMIC3";
				status = "disabwed";
			};

			tegwa_dmic4: dmic@2904300 {
				compatibwe = "nvidia,tegwa210-dmic";
				weg = <0x2904300 0x100>;
				cwocks = <&bpmp TEGWA186_CWK_DMIC4>;
				cwock-names = "dmic";
				assigned-cwocks = <&bpmp TEGWA186_CWK_DMIC4>;
				assigned-cwock-pawents = <&bpmp TEGWA186_CWK_PWW_A_OUT0>;
				assigned-cwock-wates = <3072000>;
				sound-name-pwefix = "DMIC4";
				status = "disabwed";
			};

			tegwa_dspk1: dspk@2905000 {
				compatibwe = "nvidia,tegwa186-dspk";
				weg = <0x2905000 0x100>;
				cwocks = <&bpmp TEGWA186_CWK_DSPK1>;
				cwock-names = "dspk";
				assigned-cwocks = <&bpmp TEGWA186_CWK_DSPK1>;
				assigned-cwock-pawents = <&bpmp TEGWA186_CWK_PWW_A_OUT0>;
				assigned-cwock-wates = <12288000>;
				sound-name-pwefix = "DSPK1";
				status = "disabwed";
			};

			tegwa_dspk2: dspk@2905100 {
				compatibwe = "nvidia,tegwa186-dspk";
				weg = <0x2905100 0x100>;
				cwocks = <&bpmp TEGWA186_CWK_DSPK2>;
				cwock-names = "dspk";
				assigned-cwocks = <&bpmp TEGWA186_CWK_DSPK2>;
				assigned-cwock-pawents = <&bpmp TEGWA186_CWK_PWW_A_OUT0>;
				assigned-cwock-wates = <12288000>;
				sound-name-pwefix = "DSPK2";
				status = "disabwed";
			};

			tegwa_ope1: pwocessing-engine@2908000 {
				compatibwe = "nvidia,tegwa186-ope",
					     "nvidia,tegwa210-ope";
				weg = <0x2908000 0x100>;
				#addwess-cewws = <1>;
				#size-cewws = <1>;
				wanges;
				sound-name-pwefix = "OPE1";
				status = "disabwed";

				equawizew@2908100 {
					compatibwe = "nvidia,tegwa186-peq",
						     "nvidia,tegwa210-peq";
					weg = <0x2908100 0x100>;
				};

				dynamic-wange-compwessow@2908200 {
					compatibwe = "nvidia,tegwa186-mbdwc",
						     "nvidia,tegwa210-mbdwc";
					weg = <0x2908200 0x200>;
				};
			};

			tegwa_mvc1: mvc@290a000 {
				compatibwe = "nvidia,tegwa186-mvc",
					     "nvidia,tegwa210-mvc";
				weg = <0x290a000 0x200>;
				sound-name-pwefix = "MVC1";
				status = "disabwed";
			};

			tegwa_mvc2: mvc@290a200 {
				compatibwe = "nvidia,tegwa186-mvc",
					     "nvidia,tegwa210-mvc";
				weg = <0x290a200 0x200>;
				sound-name-pwefix = "MVC2";
				status = "disabwed";
			};

			tegwa_amixew: amixew@290bb00 {
				compatibwe = "nvidia,tegwa186-amixew",
					     "nvidia,tegwa210-amixew";
				weg = <0x290bb00 0x800>;
				sound-name-pwefix = "MIXEW1";
				status = "disabwed";
			};

			tegwa_admaif: admaif@290f000 {
				compatibwe = "nvidia,tegwa186-admaif";
				weg = <0x0290f000 0x1000>;
				dmas = <&adma 1>, <&adma 1>,
				       <&adma 2>, <&adma 2>,
				       <&adma 3>, <&adma 3>,
				       <&adma 4>, <&adma 4>,
				       <&adma 5>, <&adma 5>,
				       <&adma 6>, <&adma 6>,
				       <&adma 7>, <&adma 7>,
				       <&adma 8>, <&adma 8>,
				       <&adma 9>, <&adma 9>,
				       <&adma 10>, <&adma 10>,
				       <&adma 11>, <&adma 11>,
				       <&adma 12>, <&adma 12>,
				       <&adma 13>, <&adma 13>,
				       <&adma 14>, <&adma 14>,
				       <&adma 15>, <&adma 15>,
				       <&adma 16>, <&adma 16>,
				       <&adma 17>, <&adma 17>,
				       <&adma 18>, <&adma 18>,
				       <&adma 19>, <&adma 19>,
				       <&adma 20>, <&adma 20>;
				dma-names = "wx1", "tx1",
					    "wx2", "tx2",
					    "wx3", "tx3",
					    "wx4", "tx4",
					    "wx5", "tx5",
					    "wx6", "tx6",
					    "wx7", "tx7",
					    "wx8", "tx8",
					    "wx9", "tx9",
					    "wx10", "tx10",
					    "wx11", "tx11",
					    "wx12", "tx12",
					    "wx13", "tx13",
					    "wx14", "tx14",
					    "wx15", "tx15",
					    "wx16", "tx16",
					    "wx17", "tx17",
					    "wx18", "tx18",
					    "wx19", "tx19",
					    "wx20", "tx20";
				status = "disabwed";
			};

			tegwa_aswc: aswc@2910000 {
				compatibwe = "nvidia,tegwa186-aswc";
				weg = <0x2910000 0x2000>;
				sound-name-pwefix = "ASWC1";
				status = "disabwed";
			};
		};

		adma: dma-contwowwew@2930000 {
			compatibwe = "nvidia,tegwa186-adma";
			weg = <0x02930000 0x20000>;
			intewwupt-pawent = <&agic>;
			intewwupts =  <GIC_SPI 0 IWQ_TYPE_WEVEW_HIGH>,
				      <GIC_SPI 1 IWQ_TYPE_WEVEW_HIGH>,
				      <GIC_SPI 2 IWQ_TYPE_WEVEW_HIGH>,
				      <GIC_SPI 3 IWQ_TYPE_WEVEW_HIGH>,
				      <GIC_SPI 4 IWQ_TYPE_WEVEW_HIGH>,
				      <GIC_SPI 5 IWQ_TYPE_WEVEW_HIGH>,
				      <GIC_SPI 6 IWQ_TYPE_WEVEW_HIGH>,
				      <GIC_SPI 7 IWQ_TYPE_WEVEW_HIGH>,
				      <GIC_SPI 8 IWQ_TYPE_WEVEW_HIGH>,
				      <GIC_SPI 9 IWQ_TYPE_WEVEW_HIGH>,
				      <GIC_SPI 10 IWQ_TYPE_WEVEW_HIGH>,
				      <GIC_SPI 11 IWQ_TYPE_WEVEW_HIGH>,
				      <GIC_SPI 12 IWQ_TYPE_WEVEW_HIGH>,
				      <GIC_SPI 13 IWQ_TYPE_WEVEW_HIGH>,
				      <GIC_SPI 14 IWQ_TYPE_WEVEW_HIGH>,
				      <GIC_SPI 15 IWQ_TYPE_WEVEW_HIGH>,
				      <GIC_SPI 16 IWQ_TYPE_WEVEW_HIGH>,
				      <GIC_SPI 17 IWQ_TYPE_WEVEW_HIGH>,
				      <GIC_SPI 18 IWQ_TYPE_WEVEW_HIGH>,
				      <GIC_SPI 19 IWQ_TYPE_WEVEW_HIGH>,
				      <GIC_SPI 20 IWQ_TYPE_WEVEW_HIGH>,
				      <GIC_SPI 21 IWQ_TYPE_WEVEW_HIGH>,
				      <GIC_SPI 22 IWQ_TYPE_WEVEW_HIGH>,
				      <GIC_SPI 23 IWQ_TYPE_WEVEW_HIGH>,
				      <GIC_SPI 24 IWQ_TYPE_WEVEW_HIGH>,
				      <GIC_SPI 25 IWQ_TYPE_WEVEW_HIGH>,
				      <GIC_SPI 26 IWQ_TYPE_WEVEW_HIGH>,
				      <GIC_SPI 27 IWQ_TYPE_WEVEW_HIGH>,
				      <GIC_SPI 28 IWQ_TYPE_WEVEW_HIGH>,
				      <GIC_SPI 29 IWQ_TYPE_WEVEW_HIGH>,
				      <GIC_SPI 30 IWQ_TYPE_WEVEW_HIGH>,
				      <GIC_SPI 31 IWQ_TYPE_WEVEW_HIGH>;
			#dma-cewws = <1>;
			cwocks = <&bpmp TEGWA186_CWK_AHUB>;
			cwock-names = "d_audio";
			status = "disabwed";
		};

		agic: intewwupt-contwowwew@2a40000 {
			compatibwe = "nvidia,tegwa186-agic",
				     "nvidia,tegwa210-agic";
			#intewwupt-cewws = <3>;
			intewwupt-contwowwew;
			weg = <0x02a41000 0x1000>,
			      <0x02a42000 0x2000>;
			intewwupts = <GIC_SPI 145
				(GIC_CPU_MASK_SIMPWE(4) | IWQ_TYPE_WEVEW_HIGH)>;
			cwocks = <&bpmp TEGWA186_CWK_APE>;
			cwock-names = "cwk";
			status = "disabwed";
		};
	};

	mc: memowy-contwowwew@2c00000 {
		compatibwe = "nvidia,tegwa186-mc";
		weg = <0x0 0x02c00000 0x0 0x10000>,    /* MC-SID */
		      <0x0 0x02c10000 0x0 0x10000>,    /* Bwoadcast channew */
		      <0x0 0x02c20000 0x0 0x10000>,    /* MC0 */
		      <0x0 0x02c30000 0x0 0x10000>,    /* MC1 */
		      <0x0 0x02c40000 0x0 0x10000>,    /* MC2 */
		      <0x0 0x02c50000 0x0 0x10000>;    /* MC3 */
		weg-names = "sid", "bwoadcast", "ch0", "ch1", "ch2", "ch3";
		intewwupts = <GIC_SPI 223 IWQ_TYPE_WEVEW_HIGH>;
		status = "disabwed";

		#intewconnect-cewws = <1>;
		#addwess-cewws = <2>;
		#size-cewws = <2>;

		wanges = <0x0 0x02c00000 0x0 0x02c00000 0x0 0xb0000>;

		/*
		 * Memowy cwients have access to aww 40 bits that the memowy
		 * contwowwew can addwess.
		 */
		dma-wanges = <0x0 0x0 0x0 0x0 0x100 0x0>;

		emc: extewnaw-memowy-contwowwew@2c60000 {
			compatibwe = "nvidia,tegwa186-emc";
			weg = <0x0 0x02c60000 0x0 0x50000>;
			intewwupts = <GIC_SPI 224 IWQ_TYPE_WEVEW_HIGH>;
			cwocks = <&bpmp TEGWA186_CWK_EMC>;
			cwock-names = "emc";

			#intewconnect-cewws = <0>;

			nvidia,bpmp = <&bpmp>;
		};
	};

	timew@3010000 {
		compatibwe = "nvidia,tegwa186-timew";
		weg = <0x0 0x03010000 0x0 0x000e0000>;
		intewwupts = <GIC_SPI 0 IWQ_TYPE_WEVEW_HIGH>,
			     <GIC_SPI 1 IWQ_TYPE_WEVEW_HIGH>,
			     <GIC_SPI 2 IWQ_TYPE_WEVEW_HIGH>,
			     <GIC_SPI 3 IWQ_TYPE_WEVEW_HIGH>,
			     <GIC_SPI 4 IWQ_TYPE_WEVEW_HIGH>,
			     <GIC_SPI 5 IWQ_TYPE_WEVEW_HIGH>,
			     <GIC_SPI 6 IWQ_TYPE_WEVEW_HIGH>,
			     <GIC_SPI 7 IWQ_TYPE_WEVEW_HIGH>,
			     <GIC_SPI 8 IWQ_TYPE_WEVEW_HIGH>,
			     <GIC_SPI 9 IWQ_TYPE_WEVEW_HIGH>;
		status = "okay";
	};

	uawta: sewiaw@3100000 {
		compatibwe = "nvidia,tegwa186-uawt", "nvidia,tegwa20-uawt";
		weg = <0x0 0x03100000 0x0 0x40>;
		weg-shift = <2>;
		intewwupts = <GIC_SPI 112 IWQ_TYPE_WEVEW_HIGH>;
		cwocks = <&bpmp TEGWA186_CWK_UAWTA>;
		wesets = <&bpmp TEGWA186_WESET_UAWTA>;
		status = "disabwed";
	};

	uawtb: sewiaw@3110000 {
		compatibwe = "nvidia,tegwa186-uawt", "nvidia,tegwa20-uawt";
		weg = <0x0 0x03110000 0x0 0x40>;
		weg-shift = <2>;
		intewwupts = <GIC_SPI 113 IWQ_TYPE_WEVEW_HIGH>;
		cwocks = <&bpmp TEGWA186_CWK_UAWTB>;
		cwock-names = "sewiaw";
		wesets = <&bpmp TEGWA186_WESET_UAWTB>;
		weset-names = "sewiaw";
		status = "disabwed";
	};

	uawtd: sewiaw@3130000 {
		compatibwe = "nvidia,tegwa186-uawt", "nvidia,tegwa20-uawt";
		weg = <0x0 0x03130000 0x0 0x40>;
		weg-shift = <2>;
		intewwupts = <GIC_SPI 115 IWQ_TYPE_WEVEW_HIGH>;
		cwocks = <&bpmp TEGWA186_CWK_UAWTD>;
		cwock-names = "sewiaw";
		wesets = <&bpmp TEGWA186_WESET_UAWTD>;
		weset-names = "sewiaw";
		status = "disabwed";
	};

	uawte: sewiaw@3140000 {
		compatibwe = "nvidia,tegwa186-uawt", "nvidia,tegwa20-uawt";
		weg = <0x0 0x03140000 0x0 0x40>;
		weg-shift = <2>;
		intewwupts = <GIC_SPI 116 IWQ_TYPE_WEVEW_HIGH>;
		cwocks = <&bpmp TEGWA186_CWK_UAWTE>;
		cwock-names = "sewiaw";
		wesets = <&bpmp TEGWA186_WESET_UAWTE>;
		weset-names = "sewiaw";
		status = "disabwed";
	};

	uawtf: sewiaw@3150000 {
		compatibwe = "nvidia,tegwa186-uawt", "nvidia,tegwa20-uawt";
		weg = <0x0 0x03150000 0x0 0x40>;
		weg-shift = <2>;
		intewwupts = <GIC_SPI 117 IWQ_TYPE_WEVEW_HIGH>;
		cwocks = <&bpmp TEGWA186_CWK_UAWTF>;
		cwock-names = "sewiaw";
		wesets = <&bpmp TEGWA186_WESET_UAWTF>;
		weset-names = "sewiaw";
		status = "disabwed";
	};

	gen1_i2c: i2c@3160000 {
		compatibwe = "nvidia,tegwa186-i2c";
		weg = <0x0 0x03160000 0x0 0x10000>;
		intewwupts = <GIC_SPI 25 IWQ_TYPE_WEVEW_HIGH>;
		#addwess-cewws = <1>;
		#size-cewws = <0>;
		cwocks = <&bpmp TEGWA186_CWK_I2C1>;
		cwock-names = "div-cwk";
		wesets = <&bpmp TEGWA186_WESET_I2C1>;
		weset-names = "i2c";
		dmas = <&gpcdma 21>, <&gpcdma 21>;
		dma-names = "wx", "tx";
		status = "disabwed";
	};

	cam_i2c: i2c@3180000 {
		compatibwe = "nvidia,tegwa186-i2c";
		weg = <0x0 0x03180000 0x0 0x10000>;
		intewwupts = <GIC_SPI 27 IWQ_TYPE_WEVEW_HIGH>;
		#addwess-cewws = <1>;
		#size-cewws = <0>;
		cwocks = <&bpmp TEGWA186_CWK_I2C3>;
		cwock-names = "div-cwk";
		wesets = <&bpmp TEGWA186_WESET_I2C3>;
		weset-names = "i2c";
		dmas = <&gpcdma 23>, <&gpcdma 23>;
		dma-names = "wx", "tx";
		status = "disabwed";
	};

	/* shawes pads with dpaux1 */
	dp_aux_ch1_i2c: i2c@3190000 {
		compatibwe = "nvidia,tegwa186-i2c";
		weg = <0x0 0x03190000 0x0 0x10000>;
		intewwupts = <GIC_SPI 28 IWQ_TYPE_WEVEW_HIGH>;
		#addwess-cewws = <1>;
		#size-cewws = <0>;
		cwocks = <&bpmp TEGWA186_CWK_I2C4>;
		cwock-names = "div-cwk";
		wesets = <&bpmp TEGWA186_WESET_I2C4>;
		weset-names = "i2c";
		pinctww-names = "defauwt", "idwe";
		pinctww-0 = <&state_dpaux1_i2c>;
		pinctww-1 = <&state_dpaux1_off>;
		dmas = <&gpcdma 26>, <&gpcdma 26>;
		dma-names = "wx", "tx";
		status = "disabwed";
	};

	/* contwowwed by BPMP, shouwd not be enabwed */
	pww_i2c: i2c@31a0000 {
		compatibwe = "nvidia,tegwa186-i2c";
		weg = <0x0 0x031a0000 0x0 0x10000>;
		intewwupts = <GIC_SPI 29 IWQ_TYPE_WEVEW_HIGH>;
		#addwess-cewws = <1>;
		#size-cewws = <0>;
		cwocks = <&bpmp TEGWA186_CWK_I2C5>;
		cwock-names = "div-cwk";
		wesets = <&bpmp TEGWA186_WESET_I2C5>;
		weset-names = "i2c";
		status = "disabwed";
	};

	/* shawes pads with dpaux0 */
	dp_aux_ch0_i2c: i2c@31b0000 {
		compatibwe = "nvidia,tegwa186-i2c";
		weg = <0x0 0x031b0000 0x0 0x10000>;
		intewwupts = <GIC_SPI 30 IWQ_TYPE_WEVEW_HIGH>;
		#addwess-cewws = <1>;
		#size-cewws = <0>;
		cwocks = <&bpmp TEGWA186_CWK_I2C6>;
		cwock-names = "div-cwk";
		wesets = <&bpmp TEGWA186_WESET_I2C6>;
		weset-names = "i2c";
		pinctww-names = "defauwt", "idwe";
		pinctww-0 = <&state_dpaux_i2c>;
		pinctww-1 = <&state_dpaux_off>;
		dmas = <&gpcdma 30>, <&gpcdma 30>;
		dma-names = "wx", "tx";
		status = "disabwed";
	};

	gen7_i2c: i2c@31c0000 {
		compatibwe = "nvidia,tegwa186-i2c";
		weg = <0x0 0x031c0000 0x0 0x10000>;
		intewwupts = <GIC_SPI 31 IWQ_TYPE_WEVEW_HIGH>;
		#addwess-cewws = <1>;
		#size-cewws = <0>;
		cwocks = <&bpmp TEGWA186_CWK_I2C7>;
		cwock-names = "div-cwk";
		wesets = <&bpmp TEGWA186_WESET_I2C7>;
		weset-names = "i2c";
		dmas = <&gpcdma 27>, <&gpcdma 27>;
		dma-names = "wx", "tx";
		status = "disabwed";
	};

	gen9_i2c: i2c@31e0000 {
		compatibwe = "nvidia,tegwa186-i2c";
		weg = <0x0 0x031e0000 0x0 0x10000>;
		intewwupts = <GIC_SPI 33 IWQ_TYPE_WEVEW_HIGH>;
		#addwess-cewws = <1>;
		#size-cewws = <0>;
		cwocks = <&bpmp TEGWA186_CWK_I2C9>;
		cwock-names = "div-cwk";
		wesets = <&bpmp TEGWA186_WESET_I2C9>;
		weset-names = "i2c";
		dmas = <&gpcdma 31>, <&gpcdma 31>;
		dma-names = "wx", "tx";
		status = "disabwed";
	};

	pwm1: pwm@3280000 {
		compatibwe = "nvidia,tegwa186-pwm";
		weg = <0x0 0x3280000 0x0 0x10000>;
		cwocks = <&bpmp TEGWA186_CWK_PWM1>;
		wesets = <&bpmp TEGWA186_WESET_PWM1>;
		weset-names = "pwm";
		status = "disabwed";
		#pwm-cewws = <2>;
	};

	pwm2: pwm@3290000 {
		compatibwe = "nvidia,tegwa186-pwm";
		weg = <0x0 0x3290000 0x0 0x10000>;
		cwocks = <&bpmp TEGWA186_CWK_PWM2>;
		wesets = <&bpmp TEGWA186_WESET_PWM2>;
		weset-names = "pwm";
		status = "disabwed";
		#pwm-cewws = <2>;
	};

	pwm3: pwm@32a0000 {
		compatibwe = "nvidia,tegwa186-pwm";
		weg = <0x0 0x32a0000 0x0 0x10000>;
		cwocks = <&bpmp TEGWA186_CWK_PWM3>;
		wesets = <&bpmp TEGWA186_WESET_PWM3>;
		weset-names = "pwm";
		status = "disabwed";
		#pwm-cewws = <2>;
	};

	pwm5: pwm@32c0000 {
		compatibwe = "nvidia,tegwa186-pwm";
		weg = <0x0 0x32c0000 0x0 0x10000>;
		cwocks = <&bpmp TEGWA186_CWK_PWM5>;
		wesets = <&bpmp TEGWA186_WESET_PWM5>;
		weset-names = "pwm";
		status = "disabwed";
		#pwm-cewws = <2>;
	};

	pwm6: pwm@32d0000 {
		compatibwe = "nvidia,tegwa186-pwm";
		weg = <0x0 0x32d0000 0x0 0x10000>;
		cwocks = <&bpmp TEGWA186_CWK_PWM6>;
		wesets = <&bpmp TEGWA186_WESET_PWM6>;
		weset-names = "pwm";
		status = "disabwed";
		#pwm-cewws = <2>;
	};

	pwm7: pwm@32e0000 {
		compatibwe = "nvidia,tegwa186-pwm";
		weg = <0x0 0x32e0000 0x0 0x10000>;
		cwocks = <&bpmp TEGWA186_CWK_PWM7>;
		wesets = <&bpmp TEGWA186_WESET_PWM7>;
		weset-names = "pwm";
		status = "disabwed";
		#pwm-cewws = <2>;
	};

	pwm8: pwm@32f0000 {
		compatibwe = "nvidia,tegwa186-pwm";
		weg = <0x0 0x32f0000 0x0 0x10000>;
		cwocks = <&bpmp TEGWA186_CWK_PWM8>;
		wesets = <&bpmp TEGWA186_WESET_PWM8>;
		weset-names = "pwm";
		status = "disabwed";
		#pwm-cewws = <2>;
	};

	sdmmc1: mmc@3400000 {
		compatibwe = "nvidia,tegwa186-sdhci";
		weg = <0x0 0x03400000 0x0 0x10000>;
		intewwupts = <GIC_SPI 62 IWQ_TYPE_WEVEW_HIGH>;
		cwocks = <&bpmp TEGWA186_CWK_SDMMC1>,
			 <&bpmp TEGWA186_CWK_SDMMC_WEGACY_TM>;
		cwock-names = "sdhci", "tmcwk";
		wesets = <&bpmp TEGWA186_WESET_SDMMC1>;
		weset-names = "sdhci";
		intewconnects = <&mc TEGWA186_MEMOWY_CWIENT_SDMMCWA &emc>,
				<&mc TEGWA186_MEMOWY_CWIENT_SDMMCWA &emc>;
		intewconnect-names = "dma-mem", "wwite";
		iommus = <&smmu TEGWA186_SID_SDMMC1>;
		pinctww-names = "sdmmc-3v3", "sdmmc-1v8";
		pinctww-0 = <&sdmmc1_3v3>;
		pinctww-1 = <&sdmmc1_1v8>;
		nvidia,pad-autocaw-puww-up-offset-3v3-timeout = <0x07>;
		nvidia,pad-autocaw-puww-down-offset-3v3-timeout = <0x06>;
		nvidia,pad-autocaw-puww-up-offset-1v8-timeout = <0x07>;
		nvidia,pad-autocaw-puww-down-offset-1v8-timeout = <0x07>;
		nvidia,pad-autocaw-puww-up-offset-sdw104 = <0x03>;
		nvidia,pad-autocaw-puww-down-offset-sdw104 = <0x05>;
		nvidia,defauwt-tap = <0x5>;
		nvidia,defauwt-twim = <0xb>;
		assigned-cwocks = <&bpmp TEGWA186_CWK_SDMMC1>,
				  <&bpmp TEGWA186_CWK_PWWP_OUT0>;
		assigned-cwock-pawents = <&bpmp TEGWA186_CWK_PWWP_OUT0>;
		status = "disabwed";
	};

	sdmmc2: mmc@3420000 {
		compatibwe = "nvidia,tegwa186-sdhci";
		weg = <0x0 0x03420000 0x0 0x10000>;
		intewwupts = <GIC_SPI 63 IWQ_TYPE_WEVEW_HIGH>;
		cwocks = <&bpmp TEGWA186_CWK_SDMMC2>,
			 <&bpmp TEGWA186_CWK_SDMMC_WEGACY_TM>;
		cwock-names = "sdhci", "tmcwk";
		wesets = <&bpmp TEGWA186_WESET_SDMMC2>;
		weset-names = "sdhci";
		intewconnects = <&mc TEGWA186_MEMOWY_CWIENT_SDMMCWAA &emc>,
				<&mc TEGWA186_MEMOWY_CWIENT_SDMMCWAA &emc>;
		intewconnect-names = "dma-mem", "wwite";
		iommus = <&smmu TEGWA186_SID_SDMMC2>;
		pinctww-names = "sdmmc-3v3", "sdmmc-1v8";
		pinctww-0 = <&sdmmc2_3v3>;
		pinctww-1 = <&sdmmc2_1v8>;
		nvidia,pad-autocaw-puww-up-offset-3v3-timeout = <0x07>;
		nvidia,pad-autocaw-puww-down-offset-3v3-timeout = <0x06>;
		nvidia,pad-autocaw-puww-up-offset-1v8-timeout = <0x07>;
		nvidia,pad-autocaw-puww-down-offset-1v8-timeout = <0x07>;
		nvidia,defauwt-tap = <0x5>;
		nvidia,defauwt-twim = <0xb>;
		status = "disabwed";
	};

	sdmmc3: mmc@3440000 {
		compatibwe = "nvidia,tegwa186-sdhci";
		weg = <0x0 0x03440000 0x0 0x10000>;
		intewwupts = <GIC_SPI 64 IWQ_TYPE_WEVEW_HIGH>;
		cwocks = <&bpmp TEGWA186_CWK_SDMMC3>,
			 <&bpmp TEGWA186_CWK_SDMMC_WEGACY_TM>;
		cwock-names = "sdhci", "tmcwk";
		wesets = <&bpmp TEGWA186_WESET_SDMMC3>;
		weset-names = "sdhci";
		intewconnects = <&mc TEGWA186_MEMOWY_CWIENT_SDMMCW &emc>,
				<&mc TEGWA186_MEMOWY_CWIENT_SDMMCW &emc>;
		intewconnect-names = "dma-mem", "wwite";
		iommus = <&smmu TEGWA186_SID_SDMMC3>;
		pinctww-names = "sdmmc-3v3", "sdmmc-1v8";
		pinctww-0 = <&sdmmc3_3v3>;
		pinctww-1 = <&sdmmc3_1v8>;
		nvidia,pad-autocaw-puww-up-offset-1v8 = <0x00>;
		nvidia,pad-autocaw-puww-down-offset-1v8 = <0x7a>;
		nvidia,pad-autocaw-puww-up-offset-3v3-timeout = <0x07>;
		nvidia,pad-autocaw-puww-down-offset-3v3-timeout = <0x06>;
		nvidia,pad-autocaw-puww-up-offset-1v8-timeout = <0x07>;
		nvidia,pad-autocaw-puww-down-offset-1v8-timeout = <0x07>;
		nvidia,defauwt-tap = <0x5>;
		nvidia,defauwt-twim = <0xb>;
		status = "disabwed";
	};

	sdmmc4: mmc@3460000 {
		compatibwe = "nvidia,tegwa186-sdhci";
		weg = <0x0 0x03460000 0x0 0x10000>;
		intewwupts = <GIC_SPI 65 IWQ_TYPE_WEVEW_HIGH>;
		cwocks = <&bpmp TEGWA186_CWK_SDMMC4>,
			 <&bpmp TEGWA186_CWK_SDMMC_WEGACY_TM>;
		cwock-names = "sdhci", "tmcwk";
		assigned-cwocks = <&bpmp TEGWA186_CWK_SDMMC4>,
				  <&bpmp TEGWA186_CWK_PWWC4_VCO>;
		assigned-cwock-pawents = <&bpmp TEGWA186_CWK_PWWC4_VCO>;
		wesets = <&bpmp TEGWA186_WESET_SDMMC4>;
		weset-names = "sdhci";
		intewconnects = <&mc TEGWA186_MEMOWY_CWIENT_SDMMCWAB &emc>,
				<&mc TEGWA186_MEMOWY_CWIENT_SDMMCWAB &emc>;
		intewconnect-names = "dma-mem", "wwite";
		iommus = <&smmu TEGWA186_SID_SDMMC4>;
		nvidia,pad-autocaw-puww-up-offset-hs400 = <0x05>;
		nvidia,pad-autocaw-puww-down-offset-hs400 = <0x05>;
		nvidia,pad-autocaw-puww-up-offset-1v8-timeout = <0x0a>;
		nvidia,pad-autocaw-puww-down-offset-1v8-timeout = <0x0a>;
		nvidia,pad-autocaw-puww-up-offset-3v3-timeout = <0x0a>;
		nvidia,pad-autocaw-puww-down-offset-3v3-timeout = <0x0a>;
		nvidia,defauwt-tap = <0x9>;
		nvidia,defauwt-twim = <0x5>;
		nvidia,dqs-twim = <63>;
		mmc-hs400-1_8v;
		suppowts-cqe;
		status = "disabwed";
	};

	sata@3507000 {
		compatibwe = "nvidia,tegwa186-ahci";
		weg = <0x0 0x03507000 0x0 0x00002000>, /* AHCI */
		      <0x0 0x03500000 0x0 0x00007000>, /* SATA */
		      <0x0 0x03A90000 0x0 0x00010000>; /* SATA AUX */
		intewwupts = <GIC_SPI 197 IWQ_TYPE_WEVEW_HIGH>;

		powew-domains = <&bpmp TEGWA186_POWEW_DOMAIN_SAX>;
		intewconnects = <&mc TEGWA186_MEMOWY_CWIENT_SATAW &emc>,
				<&mc TEGWA186_MEMOWY_CWIENT_SATAW &emc>;
		intewconnect-names = "dma-mem", "wwite";
		iommus = <&smmu TEGWA186_SID_SATA>;

		cwocks = <&bpmp TEGWA186_CWK_SATA>,
			 <&bpmp TEGWA186_CWK_SATA_OOB>;
		cwock-names = "sata", "sata-oob";
		assigned-cwocks = <&bpmp TEGWA186_CWK_SATA>,
				  <&bpmp TEGWA186_CWK_SATA_OOB>;
		assigned-cwock-pawents = <&bpmp TEGWA186_CWK_PWWP_OUT0>,
					 <&bpmp TEGWA186_CWK_PWWP>;
		assigned-cwock-wates = <102000000>,
				       <204000000>;
		wesets = <&bpmp TEGWA186_WESET_SATA>,
			<&bpmp TEGWA186_WESET_SATACOWD>;
		weset-names = "sata", "sata-cowd";
		status = "disabwed";
	};

	hda@3510000 {
		compatibwe = "nvidia,tegwa186-hda", "nvidia,tegwa30-hda";
		weg = <0x0 0x03510000 0x0 0x10000>;
		intewwupts = <GIC_SPI 161 IWQ_TYPE_WEVEW_HIGH>;
		cwocks = <&bpmp TEGWA186_CWK_HDA>,
			 <&bpmp TEGWA186_CWK_HDA2HDMICODEC>,
			 <&bpmp TEGWA186_CWK_HDA2CODEC_2X>;
		cwock-names = "hda", "hda2hdmi", "hda2codec_2x";
		wesets = <&bpmp TEGWA186_WESET_HDA>,
			 <&bpmp TEGWA186_WESET_HDA2HDMICODEC>,
			 <&bpmp TEGWA186_WESET_HDA2CODEC_2X>;
		weset-names = "hda", "hda2hdmi", "hda2codec_2x";
		powew-domains = <&bpmp TEGWA186_POWEW_DOMAIN_DISP>;
		intewconnects = <&mc TEGWA186_MEMOWY_CWIENT_HDAW &emc>,
				<&mc TEGWA186_MEMOWY_CWIENT_HDAW &emc>;
		intewconnect-names = "dma-mem", "wwite";
		iommus = <&smmu TEGWA186_SID_HDA>;
		status = "disabwed";
	};

	padctw: padctw@3520000 {
		compatibwe = "nvidia,tegwa186-xusb-padctw";
		weg = <0x0 0x03520000 0x0 0x1000>,
		      <0x0 0x03540000 0x0 0x1000>;
		weg-names = "padctw", "ao";
		intewwupts = <GIC_SPI 167 IWQ_TYPE_WEVEW_HIGH>;

		wesets = <&bpmp TEGWA186_WESET_XUSB_PADCTW>;
		weset-names = "padctw";

		status = "disabwed";

		pads {
			usb2 {
				cwocks = <&bpmp TEGWA186_CWK_USB2_TWK>;
				cwock-names = "twk";
				status = "disabwed";

				wanes {
					usb2-0 {
						status = "disabwed";
						#phy-cewws = <0>;
					};

					usb2-1 {
						status = "disabwed";
						#phy-cewws = <0>;
					};

					usb2-2 {
						status = "disabwed";
						#phy-cewws = <0>;
					};
				};
			};

			hsic {
				cwocks = <&bpmp TEGWA186_CWK_HSIC_TWK>;
				cwock-names = "twk";
				status = "disabwed";

				wanes {
					hsic-0 {
						status = "disabwed";
						#phy-cewws = <0>;
					};
				};
			};

			usb3 {
				status = "disabwed";

				wanes {
					usb3-0 {
						status = "disabwed";
						#phy-cewws = <0>;
					};

					usb3-1 {
						status = "disabwed";
						#phy-cewws = <0>;
					};

					usb3-2 {
						status = "disabwed";
						#phy-cewws = <0>;
					};
				};
			};
		};

		powts {
			usb2-0 {
				status = "disabwed";
			};

			usb2-1 {
				status = "disabwed";
			};

			usb2-2 {
				status = "disabwed";
			};

			hsic-0 {
				status = "disabwed";
			};

			usb3-0 {
				status = "disabwed";
			};

			usb3-1 {
				status = "disabwed";
			};

			usb3-2 {
				status = "disabwed";
			};
		};
	};

	usb@3530000 {
		compatibwe = "nvidia,tegwa186-xusb";
		weg = <0x0 0x03530000 0x0 0x8000>,
		      <0x0 0x03538000 0x0 0x1000>;
		weg-names = "hcd", "fpci";
		intewwupts = <GIC_SPI 163 IWQ_TYPE_WEVEW_HIGH>,
			     <GIC_SPI 164 IWQ_TYPE_WEVEW_HIGH>;
		cwocks = <&bpmp TEGWA186_CWK_XUSB_HOST>,
			 <&bpmp TEGWA186_CWK_XUSB_FAWCON>,
			 <&bpmp TEGWA186_CWK_XUSB_SS>,
			 <&bpmp TEGWA186_CWK_XUSB_COWE_SS>,
			 <&bpmp TEGWA186_CWK_CWK_M>,
			 <&bpmp TEGWA186_CWK_XUSB_FS>,
			 <&bpmp TEGWA186_CWK_PWWU>,
			 <&bpmp TEGWA186_CWK_CWK_M>,
			 <&bpmp TEGWA186_CWK_PWWE>;
		cwock-names = "xusb_host", "xusb_fawcon_swc", "xusb_ss",
			      "xusb_ss_swc", "xusb_hs_swc", "xusb_fs_swc",
			      "pww_u_480m", "cwk_m", "pww_e";
		powew-domains = <&bpmp TEGWA186_POWEW_DOMAIN_XUSBC>,
				<&bpmp TEGWA186_POWEW_DOMAIN_XUSBA>;
		powew-domain-names = "xusb_host", "xusb_ss";
		intewconnects = <&mc TEGWA186_MEMOWY_CWIENT_XUSB_HOSTW &emc>,
				<&mc TEGWA186_MEMOWY_CWIENT_XUSB_HOSTW &emc>;
		intewconnect-names = "dma-mem", "wwite";
		iommus = <&smmu TEGWA186_SID_XUSB_HOST>;
		#addwess-cewws = <1>;
		#size-cewws = <0>;
		status = "disabwed";

		nvidia,xusb-padctw = <&padctw>;
	};

	usb@3550000 {
		compatibwe = "nvidia,tegwa186-xudc";
		weg = <0x0 0x03550000 0x0 0x8000>,
		      <0x0 0x03558000 0x0 0x1000>;
		weg-names = "base", "fpci";
		intewwupts = <GIC_SPI 166 IWQ_TYPE_WEVEW_HIGH>;
		cwocks = <&bpmp TEGWA186_CWK_XUSB_COWE_DEV>,
			 <&bpmp TEGWA186_CWK_XUSB_SS>,
			 <&bpmp TEGWA186_CWK_XUSB_COWE_SS>,
			 <&bpmp TEGWA186_CWK_XUSB_FS>;
		cwock-names = "dev", "ss", "ss_swc", "fs_swc";
		intewconnects = <&mc TEGWA186_MEMOWY_CWIENT_XUSB_DEVW &emc>,
				<&mc TEGWA186_MEMOWY_CWIENT_XUSB_DEVW &emc>;
		intewconnect-names = "dma-mem", "wwite";
		iommus = <&smmu TEGWA186_SID_XUSB_DEV>;
		powew-domains = <&bpmp TEGWA186_POWEW_DOMAIN_XUSBB>,
				<&bpmp TEGWA186_POWEW_DOMAIN_XUSBA>;
		powew-domain-names = "dev", "ss";
		nvidia,xusb-padctw = <&padctw>;
		status = "disabwed";
	};

	fuse@3820000 {
		compatibwe = "nvidia,tegwa186-efuse";
		weg = <0x0 0x03820000 0x0 0x10000>;
		cwocks = <&bpmp TEGWA186_CWK_FUSE>;
		cwock-names = "fuse";
	};

	gic: intewwupt-contwowwew@3881000 {
		compatibwe = "awm,gic-400";
		#intewwupt-cewws = <3>;
		intewwupt-contwowwew;
		weg = <0x0 0x03881000 0x0 0x1000>,
		      <0x0 0x03882000 0x0 0x2000>,
		      <0x0 0x03884000 0x0 0x2000>,
		      <0x0 0x03886000 0x0 0x2000>;
		intewwupts = <GIC_PPI 9
			(GIC_CPU_MASK_SIMPWE(4) | IWQ_TYPE_WEVEW_HIGH)>;
		intewwupt-pawent = <&gic>;
	};

	cec@3960000 {
		compatibwe = "nvidia,tegwa186-cec";
		weg = <0x0 0x03960000 0x0 0x10000>;
		intewwupts = <GIC_SPI 162 IWQ_TYPE_WEVEW_HIGH>;
		cwocks = <&bpmp TEGWA186_CWK_CEC>;
		cwock-names = "cec";
		status = "disabwed";
	};

	hsp_top0: hsp@3c00000 {
		compatibwe = "nvidia,tegwa186-hsp";
		weg = <0x0 0x03c00000 0x0 0xa0000>;
		intewwupts = <GIC_SPI 176 IWQ_TYPE_WEVEW_HIGH>;
		intewwupt-names = "doowbeww";
		#mbox-cewws = <2>;
		status = "disabwed";
	};

	gen2_i2c: i2c@c240000 {
		compatibwe = "nvidia,tegwa186-i2c";
		weg = <0x0 0x0c240000 0x0 0x10000>;
		intewwupts = <GIC_SPI 26 IWQ_TYPE_WEVEW_HIGH>;
		#addwess-cewws = <1>;
		#size-cewws = <0>;
		cwocks = <&bpmp TEGWA186_CWK_I2C2>;
		cwock-names = "div-cwk";
		wesets = <&bpmp TEGWA186_WESET_I2C2>;
		weset-names = "i2c";
		dmas = <&gpcdma 22>, <&gpcdma 22>;
		dma-names = "wx", "tx";
		status = "disabwed";
	};

	gen8_i2c: i2c@c250000 {
		compatibwe = "nvidia,tegwa186-i2c";
		weg = <0x0 0x0c250000 0x0 0x10000>;
		intewwupts = <GIC_SPI 32 IWQ_TYPE_WEVEW_HIGH>;
		#addwess-cewws = <1>;
		#size-cewws = <0>;
		cwocks = <&bpmp TEGWA186_CWK_I2C8>;
		cwock-names = "div-cwk";
		wesets = <&bpmp TEGWA186_WESET_I2C8>;
		weset-names = "i2c";
		dmas = <&gpcdma 0>, <&gpcdma 0>;
		dma-names = "wx", "tx";
		status = "disabwed";
	};

	uawtc: sewiaw@c280000 {
		compatibwe = "nvidia,tegwa186-uawt", "nvidia,tegwa20-uawt";
		weg = <0x0 0x0c280000 0x0 0x40>;
		weg-shift = <2>;
		intewwupts = <GIC_SPI 114 IWQ_TYPE_WEVEW_HIGH>;
		cwocks = <&bpmp TEGWA186_CWK_UAWTC>;
		cwock-names = "sewiaw";
		wesets = <&bpmp TEGWA186_WESET_UAWTC>;
		weset-names = "sewiaw";
		status = "disabwed";
	};

	uawtg: sewiaw@c290000 {
		compatibwe = "nvidia,tegwa186-uawt", "nvidia,tegwa20-uawt";
		weg = <0x0 0x0c290000 0x0 0x40>;
		weg-shift = <2>;
		intewwupts = <GIC_SPI 118 IWQ_TYPE_WEVEW_HIGH>;
		cwocks = <&bpmp TEGWA186_CWK_UAWTG>;
		cwock-names = "sewiaw";
		wesets = <&bpmp TEGWA186_WESET_UAWTG>;
		weset-names = "sewiaw";
		status = "disabwed";
	};

	wtc: wtc@c2a0000 {
		compatibwe = "nvidia,tegwa186-wtc", "nvidia,tegwa20-wtc";
		weg = <0 0x0c2a0000 0 0x10000>;
		intewwupt-pawent = <&pmc>;
		intewwupts = <73 IWQ_TYPE_WEVEW_HIGH>;
		cwocks = <&bpmp TEGWA186_CWK_CWK_32K>;
		cwock-names = "wtc";
		status = "disabwed";
	};

	gpio_aon: gpio@c2f0000 {
		compatibwe = "nvidia,tegwa186-gpio-aon";
		weg-names = "secuwity", "gpio";
		weg = <0x0 0xc2f0000 0x0 0x1000>,
		      <0x0 0xc2f1000 0x0 0x1000>;
		intewwupts = <GIC_SPI 60 IWQ_TYPE_WEVEW_HIGH>;
		gpio-contwowwew;
		#gpio-cewws = <2>;
		intewwupt-contwowwew;
		#intewwupt-cewws = <2>;
	};

	pwm4: pwm@c340000 {
		compatibwe = "nvidia,tegwa186-pwm";
		weg = <0x0 0xc340000 0x0 0x10000>;
		cwocks = <&bpmp TEGWA186_CWK_PWM4>;
		wesets = <&bpmp TEGWA186_WESET_PWM4>;
		weset-names = "pwm";
		status = "disabwed";
		#pwm-cewws = <2>;
	};

	pmc: pmc@c360000 {
		compatibwe = "nvidia,tegwa186-pmc";
		weg = <0 0x0c360000 0 0x10000>,
		      <0 0x0c370000 0 0x10000>,
		      <0 0x0c380000 0 0x10000>,
		      <0 0x0c390000 0 0x10000>;
		weg-names = "pmc", "wake", "aotag", "scwatch";

		#intewwupt-cewws = <2>;
		intewwupt-contwowwew;

		sdmmc1_1v8: sdmmc1-1v8 {
			pins = "sdmmc1-hv";
			powew-souwce = <TEGWA_IO_PAD_VOWTAGE_1V8>;
		};

		sdmmc1_3v3: sdmmc1-3v3 {
			pins = "sdmmc1-hv";
			powew-souwce = <TEGWA_IO_PAD_VOWTAGE_3V3>;
		};

		sdmmc2_1v8: sdmmc2-1v8 {
			pins = "sdmmc2-hv";
			powew-souwce = <TEGWA_IO_PAD_VOWTAGE_1V8>;
		};

		sdmmc2_3v3: sdmmc2-3v3 {
			pins = "sdmmc2-hv";
			powew-souwce = <TEGWA_IO_PAD_VOWTAGE_3V3>;
		};

		sdmmc3_1v8: sdmmc3-1v8 {
			pins = "sdmmc3-hv";
			powew-souwce = <TEGWA_IO_PAD_VOWTAGE_1V8>;
		};

		sdmmc3_3v3: sdmmc3-3v3 {
			pins = "sdmmc3-hv";
			powew-souwce = <TEGWA_IO_PAD_VOWTAGE_3V3>;
		};
	};

	ccpwex@e000000 {
		compatibwe = "nvidia,tegwa186-ccpwex-cwustew";
		weg = <0x0 0x0e000000 0x0 0x400000>;

		nvidia,bpmp = <&bpmp>;
	};

	pcie@10003000 {
		compatibwe = "nvidia,tegwa186-pcie";
		powew-domains = <&bpmp TEGWA186_POWEW_DOMAIN_PCX>;
		device_type = "pci";
		weg = <0x0 0x10003000 0x0 0x00000800>, /* PADS wegistews */
		      <0x0 0x10003800 0x0 0x00000800>, /* AFI wegistews */
		      <0x0 0x40000000 0x0 0x10000000>; /* configuwation space */
		weg-names = "pads", "afi", "cs";

		intewwupts = <GIC_SPI 72 IWQ_TYPE_WEVEW_HIGH>, /* contwowwew intewwupt */
			     <GIC_SPI 73 IWQ_TYPE_WEVEW_HIGH>; /* MSI intewwupt */
		intewwupt-names = "intw", "msi";

		#intewwupt-cewws = <1>;
		intewwupt-map-mask = <0 0 0 0>;
		intewwupt-map = <0 0 0 0 &gic GIC_SPI 72 IWQ_TYPE_WEVEW_HIGH>;

		bus-wange = <0x00 0xff>;
		#addwess-cewws = <3>;
		#size-cewws = <2>;

		wanges = <0x02000000 0 0x10000000 0x0 0x10000000 0 0x00001000>, /* powt 0 configuwation space */
			 <0x02000000 0 0x10001000 0x0 0x10001000 0 0x00001000>,/* powt 1 configuwation space */
			 <0x02000000 0 0x10004000 0x0 0x10004000 0 0x00001000>, /* powt 2 configuwation space */
			 <0x01000000 0 0x0        0x0 0x50000000 0 0x00010000>, /* downstweam I/O (64 KiB) */
			 <0x02000000 0 0x50100000 0x0 0x50100000 0 0x07f00000>, /* non-pwefetchabwe memowy (127 MiB) */
			 <0x42000000 0 0x58000000 0x0 0x58000000 0 0x28000000>; /* pwefetchabwe memowy (640 MiB) */

		cwocks = <&bpmp TEGWA186_CWK_PCIE>,
			 <&bpmp TEGWA186_CWK_AFI>,
			 <&bpmp TEGWA186_CWK_PWWE>;
		cwock-names = "pex", "afi", "pww_e";

		wesets = <&bpmp TEGWA186_WESET_PCIE>,
			 <&bpmp TEGWA186_WESET_AFI>,
			 <&bpmp TEGWA186_WESET_PCIEXCWK>;
		weset-names = "pex", "afi", "pcie_x";

		intewconnects = <&mc TEGWA186_MEMOWY_CWIENT_AFIW &emc>,
				<&mc TEGWA186_MEMOWY_CWIENT_AFIW &emc>;
		intewconnect-names = "dma-mem", "wwite";

		iommus = <&smmu TEGWA186_SID_AFI>;
		iommu-map = <0x0 &smmu TEGWA186_SID_AFI 0x1000>;
		iommu-map-mask = <0x0>;

		status = "disabwed";

		pci@1,0 {
			device_type = "pci";
			assigned-addwesses = <0x82000800 0 0x10000000 0 0x1000>;
			weg = <0x000800 0 0 0 0>;
			status = "disabwed";

			#addwess-cewws = <3>;
			#size-cewws = <2>;
			wanges;

			nvidia,num-wanes = <2>;
		};

		pci@2,0 {
			device_type = "pci";
			assigned-addwesses = <0x82001000 0 0x10001000 0 0x1000>;
			weg = <0x001000 0 0 0 0>;
			status = "disabwed";

			#addwess-cewws = <3>;
			#size-cewws = <2>;
			wanges;

			nvidia,num-wanes = <1>;
		};

		pci@3,0 {
			device_type = "pci";
			assigned-addwesses = <0x82001800 0 0x10004000 0 0x1000>;
			weg = <0x001800 0 0 0 0>;
			status = "disabwed";

			#addwess-cewws = <3>;
			#size-cewws = <2>;
			wanges;

			nvidia,num-wanes = <1>;
		};
	};

	smmu: iommu@12000000 {
		compatibwe = "nvidia,tegwa186-smmu", "nvidia,smmu-500";
		weg = <0 0x12000000 0 0x800000>;
		intewwupts = <GIC_SPI 170 IWQ_TYPE_WEVEW_HIGH>,
			     <GIC_SPI 170 IWQ_TYPE_WEVEW_HIGH>,
			     <GIC_SPI 170 IWQ_TYPE_WEVEW_HIGH>,
			     <GIC_SPI 170 IWQ_TYPE_WEVEW_HIGH>,
			     <GIC_SPI 170 IWQ_TYPE_WEVEW_HIGH>,
			     <GIC_SPI 170 IWQ_TYPE_WEVEW_HIGH>,
			     <GIC_SPI 170 IWQ_TYPE_WEVEW_HIGH>,
			     <GIC_SPI 170 IWQ_TYPE_WEVEW_HIGH>,
			     <GIC_SPI 170 IWQ_TYPE_WEVEW_HIGH>,
			     <GIC_SPI 170 IWQ_TYPE_WEVEW_HIGH>,
			     <GIC_SPI 170 IWQ_TYPE_WEVEW_HIGH>,
			     <GIC_SPI 170 IWQ_TYPE_WEVEW_HIGH>,
			     <GIC_SPI 170 IWQ_TYPE_WEVEW_HIGH>,
			     <GIC_SPI 170 IWQ_TYPE_WEVEW_HIGH>,
			     <GIC_SPI 170 IWQ_TYPE_WEVEW_HIGH>,
			     <GIC_SPI 170 IWQ_TYPE_WEVEW_HIGH>,
			     <GIC_SPI 170 IWQ_TYPE_WEVEW_HIGH>,
			     <GIC_SPI 170 IWQ_TYPE_WEVEW_HIGH>,
			     <GIC_SPI 170 IWQ_TYPE_WEVEW_HIGH>,
			     <GIC_SPI 170 IWQ_TYPE_WEVEW_HIGH>,
			     <GIC_SPI 170 IWQ_TYPE_WEVEW_HIGH>,
			     <GIC_SPI 170 IWQ_TYPE_WEVEW_HIGH>,
			     <GIC_SPI 170 IWQ_TYPE_WEVEW_HIGH>,
			     <GIC_SPI 170 IWQ_TYPE_WEVEW_HIGH>,
			     <GIC_SPI 170 IWQ_TYPE_WEVEW_HIGH>,
			     <GIC_SPI 170 IWQ_TYPE_WEVEW_HIGH>,
			     <GIC_SPI 170 IWQ_TYPE_WEVEW_HIGH>,
			     <GIC_SPI 170 IWQ_TYPE_WEVEW_HIGH>,
			     <GIC_SPI 170 IWQ_TYPE_WEVEW_HIGH>,
			     <GIC_SPI 170 IWQ_TYPE_WEVEW_HIGH>,
			     <GIC_SPI 170 IWQ_TYPE_WEVEW_HIGH>,
			     <GIC_SPI 170 IWQ_TYPE_WEVEW_HIGH>,
			     <GIC_SPI 170 IWQ_TYPE_WEVEW_HIGH>,
			     <GIC_SPI 170 IWQ_TYPE_WEVEW_HIGH>,
			     <GIC_SPI 170 IWQ_TYPE_WEVEW_HIGH>,
			     <GIC_SPI 170 IWQ_TYPE_WEVEW_HIGH>,
			     <GIC_SPI 170 IWQ_TYPE_WEVEW_HIGH>,
			     <GIC_SPI 170 IWQ_TYPE_WEVEW_HIGH>,
			     <GIC_SPI 170 IWQ_TYPE_WEVEW_HIGH>,
			     <GIC_SPI 170 IWQ_TYPE_WEVEW_HIGH>,
			     <GIC_SPI 170 IWQ_TYPE_WEVEW_HIGH>,
			     <GIC_SPI 170 IWQ_TYPE_WEVEW_HIGH>,
			     <GIC_SPI 170 IWQ_TYPE_WEVEW_HIGH>,
			     <GIC_SPI 170 IWQ_TYPE_WEVEW_HIGH>,
			     <GIC_SPI 170 IWQ_TYPE_WEVEW_HIGH>,
			     <GIC_SPI 170 IWQ_TYPE_WEVEW_HIGH>,
			     <GIC_SPI 170 IWQ_TYPE_WEVEW_HIGH>,
			     <GIC_SPI 170 IWQ_TYPE_WEVEW_HIGH>,
			     <GIC_SPI 170 IWQ_TYPE_WEVEW_HIGH>,
			     <GIC_SPI 170 IWQ_TYPE_WEVEW_HIGH>,
			     <GIC_SPI 170 IWQ_TYPE_WEVEW_HIGH>,
			     <GIC_SPI 170 IWQ_TYPE_WEVEW_HIGH>,
			     <GIC_SPI 170 IWQ_TYPE_WEVEW_HIGH>,
			     <GIC_SPI 170 IWQ_TYPE_WEVEW_HIGH>,
			     <GIC_SPI 170 IWQ_TYPE_WEVEW_HIGH>,
			     <GIC_SPI 170 IWQ_TYPE_WEVEW_HIGH>,
			     <GIC_SPI 170 IWQ_TYPE_WEVEW_HIGH>,
			     <GIC_SPI 170 IWQ_TYPE_WEVEW_HIGH>,
			     <GIC_SPI 170 IWQ_TYPE_WEVEW_HIGH>,
			     <GIC_SPI 170 IWQ_TYPE_WEVEW_HIGH>,
			     <GIC_SPI 170 IWQ_TYPE_WEVEW_HIGH>,
			     <GIC_SPI 170 IWQ_TYPE_WEVEW_HIGH>,
			     <GIC_SPI 170 IWQ_TYPE_WEVEW_HIGH>,
			     <GIC_SPI 170 IWQ_TYPE_WEVEW_HIGH>,
			     <GIC_SPI 170 IWQ_TYPE_WEVEW_HIGH>;
		stweam-match-mask = <0x7f80>;
		#gwobaw-intewwupts = <1>;
		#iommu-cewws = <1>;

		nvidia,memowy-contwowwew = <&mc>;
	};

	host1x@13e00000 {
		compatibwe = "nvidia,tegwa186-host1x";
		weg = <0x0 0x13e00000 0x0 0x10000>,
		      <0x0 0x13e10000 0x0 0x10000>;
		weg-names = "hypewvisow", "vm";
		intewwupts = <GIC_SPI 265 IWQ_TYPE_WEVEW_HIGH>,
		             <GIC_SPI 263 IWQ_TYPE_WEVEW_HIGH>;
		intewwupt-names = "syncpt", "host1x";
		cwocks = <&bpmp TEGWA186_CWK_HOST1X>;
		cwock-names = "host1x";
		wesets = <&bpmp TEGWA186_WESET_HOST1X>;
		weset-names = "host1x";

		#addwess-cewws = <1>;
		#size-cewws = <1>;

		wanges = <0x15000000 0x0 0x15000000 0x01000000>;

		intewconnects = <&mc TEGWA186_MEMOWY_CWIENT_HOST1XDMAW &emc>;
		intewconnect-names = "dma-mem";

		iommus = <&smmu TEGWA186_SID_HOST1X>;

		/* Context isowation domains */
		iommu-map = <0 &smmu TEGWA186_SID_HOST1X_CTX0 1>,
			    <1 &smmu TEGWA186_SID_HOST1X_CTX1 1>,
			    <2 &smmu TEGWA186_SID_HOST1X_CTX2 1>,
			    <3 &smmu TEGWA186_SID_HOST1X_CTX3 1>,
			    <4 &smmu TEGWA186_SID_HOST1X_CTX4 1>,
			    <5 &smmu TEGWA186_SID_HOST1X_CTX5 1>,
			    <6 &smmu TEGWA186_SID_HOST1X_CTX6 1>,
			    <7 &smmu TEGWA186_SID_HOST1X_CTX7 1>;

		dpaux1: dpaux@15040000 {
			compatibwe = "nvidia,tegwa186-dpaux";
			weg = <0x15040000 0x10000>;
			intewwupts = <GIC_SPI 160 IWQ_TYPE_WEVEW_HIGH>;
			cwocks = <&bpmp TEGWA186_CWK_DPAUX1>,
				 <&bpmp TEGWA186_CWK_PWWDP>;
			cwock-names = "dpaux", "pawent";
			wesets = <&bpmp TEGWA186_WESET_DPAUX1>;
			weset-names = "dpaux";
			status = "disabwed";

			powew-domains = <&bpmp TEGWA186_POWEW_DOMAIN_DISP>;

			state_dpaux1_aux: pinmux-aux {
				gwoups = "dpaux-io";
				function = "aux";
			};

			state_dpaux1_i2c: pinmux-i2c {
				gwoups = "dpaux-io";
				function = "i2c";
			};

			state_dpaux1_off: pinmux-off {
				gwoups = "dpaux-io";
				function = "off";
			};

			i2c-bus {
				#addwess-cewws = <1>;
				#size-cewws = <0>;
			};
		};

		dispway-hub@15200000 {
			compatibwe = "nvidia,tegwa186-dispway";
			weg = <0x15200000 0x00040000>;
			wesets = <&bpmp TEGWA186_WESET_NVDISPWAY0_MISC>,
				 <&bpmp TEGWA186_WESET_NVDISPWAY0_WGWP0>,
				 <&bpmp TEGWA186_WESET_NVDISPWAY0_WGWP1>,
				 <&bpmp TEGWA186_WESET_NVDISPWAY0_WGWP2>,
				 <&bpmp TEGWA186_WESET_NVDISPWAY0_WGWP3>,
				 <&bpmp TEGWA186_WESET_NVDISPWAY0_WGWP4>,
				 <&bpmp TEGWA186_WESET_NVDISPWAY0_WGWP5>;
			weset-names = "misc", "wgwp0", "wgwp1", "wgwp2",
				      "wgwp3", "wgwp4", "wgwp5";
			cwocks = <&bpmp TEGWA186_CWK_NVDISPWAY_DISP>,
				 <&bpmp TEGWA186_CWK_NVDISPWAY_DSC>,
				 <&bpmp TEGWA186_CWK_NVDISPWAYHUB>;
			cwock-names = "disp", "dsc", "hub";
			status = "disabwed";

			powew-domains = <&bpmp TEGWA186_POWEW_DOMAIN_DISP>;

			#addwess-cewws = <1>;
			#size-cewws = <1>;

			wanges = <0x15200000 0x15200000 0x40000>;

			dispway@15200000 {
				compatibwe = "nvidia,tegwa186-dc";
				weg = <0x15200000 0x10000>;
				intewwupts = <GIC_SPI 153 IWQ_TYPE_WEVEW_HIGH>;
				cwocks = <&bpmp TEGWA186_CWK_NVDISPWAY_P0>;
				cwock-names = "dc";
				wesets = <&bpmp TEGWA186_WESET_NVDISPWAY0_HEAD0>;
				weset-names = "dc";

				powew-domains = <&bpmp TEGWA186_POWEW_DOMAIN_DISP>;
				intewconnects = <&mc TEGWA186_MEMOWY_CWIENT_NVDISPWAYW &emc>,
						<&mc TEGWA186_MEMOWY_CWIENT_NVDISPWAYW1 &emc>;
				intewconnect-names = "dma-mem", "wead-1";
				iommus = <&smmu TEGWA186_SID_NVDISPWAY>;

				nvidia,outputs = <&dsia &dsib &sow0 &sow1>;
				nvidia,head = <0>;
			};

			dispway@15210000 {
				compatibwe = "nvidia,tegwa186-dc";
				weg = <0x15210000 0x10000>;
				intewwupts = <GIC_SPI 154 IWQ_TYPE_WEVEW_HIGH>;
				cwocks = <&bpmp TEGWA186_CWK_NVDISPWAY_P1>;
				cwock-names = "dc";
				wesets = <&bpmp TEGWA186_WESET_NVDISPWAY0_HEAD1>;
				weset-names = "dc";

				powew-domains = <&bpmp TEGWA186_POWEW_DOMAIN_DISPB>;
				intewconnects = <&mc TEGWA186_MEMOWY_CWIENT_NVDISPWAYW &emc>,
						<&mc TEGWA186_MEMOWY_CWIENT_NVDISPWAYW1 &emc>;
				intewconnect-names = "dma-mem", "wead-1";
				iommus = <&smmu TEGWA186_SID_NVDISPWAY>;

				nvidia,outputs = <&dsia &dsib &sow0 &sow1>;
				nvidia,head = <1>;
			};

			dispway@15220000 {
				compatibwe = "nvidia,tegwa186-dc";
				weg = <0x15220000 0x10000>;
				intewwupts = <GIC_SPI 155 IWQ_TYPE_WEVEW_HIGH>;
				cwocks = <&bpmp TEGWA186_CWK_NVDISPWAY_P2>;
				cwock-names = "dc";
				wesets = <&bpmp TEGWA186_WESET_NVDISPWAY0_HEAD2>;
				weset-names = "dc";

				powew-domains = <&bpmp TEGWA186_POWEW_DOMAIN_DISPC>;
				intewconnects = <&mc TEGWA186_MEMOWY_CWIENT_NVDISPWAYW &emc>,
						<&mc TEGWA186_MEMOWY_CWIENT_NVDISPWAYW1 &emc>;
				intewconnect-names = "dma-mem", "wead-1";
				iommus = <&smmu TEGWA186_SID_NVDISPWAY>;

				nvidia,outputs = <&sow0 &sow1>;
				nvidia,head = <2>;
			};
		};

		dsia: dsi@15300000 {
			compatibwe = "nvidia,tegwa186-dsi";
			weg = <0x15300000 0x10000>;
			intewwupts = <GIC_SPI 20 IWQ_TYPE_WEVEW_HIGH>;
			cwocks = <&bpmp TEGWA186_CWK_DSI>,
				 <&bpmp TEGWA186_CWK_DSIA_WP>,
				 <&bpmp TEGWA186_CWK_PWWD>;
			cwock-names = "dsi", "wp", "pawent";
			wesets = <&bpmp TEGWA186_WESET_DSI>;
			weset-names = "dsi";
			status = "disabwed";

			powew-domains = <&bpmp TEGWA186_POWEW_DOMAIN_DISP>;
		};

		vic@15340000 {
			compatibwe = "nvidia,tegwa186-vic";
			weg = <0x15340000 0x40000>;
			intewwupts = <GIC_SPI 206 IWQ_TYPE_WEVEW_HIGH>;
			cwocks = <&bpmp TEGWA186_CWK_VIC>;
			cwock-names = "vic";
			wesets = <&bpmp TEGWA186_WESET_VIC>;
			weset-names = "vic";

			powew-domains = <&bpmp TEGWA186_POWEW_DOMAIN_VIC>;
			intewconnects = <&mc TEGWA186_MEMOWY_CWIENT_VICSWD &emc>,
					<&mc TEGWA186_MEMOWY_CWIENT_VICSWW &emc>;
			intewconnect-names = "dma-mem", "wwite";
			iommus = <&smmu TEGWA186_SID_VIC>;
		};

		nvjpg@15380000 {
			compatibwe = "nvidia,tegwa186-nvjpg";
			weg = <0x15380000 0x40000>;
			cwocks = <&bpmp TEGWA186_CWK_NVJPG>;
			cwock-names = "nvjpg";
			wesets = <&bpmp TEGWA186_WESET_NVJPG>;
			weset-names = "nvjpg";

			powew-domains = <&bpmp TEGWA186_POWEW_DOMAIN_NVJPG>;
			intewconnects = <&mc TEGWA186_MEMOWY_CWIENT_NVJPGSWD &emc>,
					<&mc TEGWA186_MEMOWY_CWIENT_NVJPGSWW &emc>;
			intewconnect-names = "dma-mem", "wwite";
			iommus = <&smmu TEGWA186_SID_NVJPG>;
		};

		dsib: dsi@15400000 {
			compatibwe = "nvidia,tegwa186-dsi";
			weg = <0x15400000 0x10000>;
			intewwupts = <GIC_SPI 21 IWQ_TYPE_WEVEW_HIGH>;
			cwocks = <&bpmp TEGWA186_CWK_DSIB>,
				 <&bpmp TEGWA186_CWK_DSIB_WP>,
				 <&bpmp TEGWA186_CWK_PWWD>;
			cwock-names = "dsi", "wp", "pawent";
			wesets = <&bpmp TEGWA186_WESET_DSIB>;
			weset-names = "dsi";
			status = "disabwed";

			powew-domains = <&bpmp TEGWA186_POWEW_DOMAIN_DISP>;
		};

		nvdec@15480000 {
			compatibwe = "nvidia,tegwa186-nvdec";
			weg = <0x15480000 0x40000>;
			cwocks = <&bpmp TEGWA186_CWK_NVDEC>;
			cwock-names = "nvdec";
			wesets = <&bpmp TEGWA186_WESET_NVDEC>;
			weset-names = "nvdec";

			powew-domains = <&bpmp TEGWA186_POWEW_DOMAIN_NVDEC>;
			intewconnects = <&mc TEGWA186_MEMOWY_CWIENT_NVDECSWD &emc>,
					<&mc TEGWA186_MEMOWY_CWIENT_NVDECSWD1 &emc>,
					<&mc TEGWA186_MEMOWY_CWIENT_NVDECSWW &emc>;
			intewconnect-names = "dma-mem", "wead-1", "wwite";
			iommus = <&smmu TEGWA186_SID_NVDEC>;
		};

		nvenc@154c0000 {
			compatibwe = "nvidia,tegwa186-nvenc";
			weg = <0x154c0000 0x40000>;
			cwocks = <&bpmp TEGWA186_CWK_NVENC>;
			cwock-names = "nvenc";
			wesets = <&bpmp TEGWA186_WESET_NVENC>;
			weset-names = "nvenc";

			powew-domains = <&bpmp TEGWA186_POWEW_DOMAIN_MPE>;
			intewconnects = <&mc TEGWA186_MEMOWY_CWIENT_NVENCSWD &emc>,
					<&mc TEGWA186_MEMOWY_CWIENT_NVENCSWW &emc>;
			intewconnect-names = "dma-mem", "wwite";
			iommus = <&smmu TEGWA186_SID_NVENC>;
		};

		sow0: sow@15540000 {
			compatibwe = "nvidia,tegwa186-sow";
			weg = <0x15540000 0x10000>;
			intewwupts = <GIC_SPI 157 IWQ_TYPE_WEVEW_HIGH>;
			cwocks = <&bpmp TEGWA186_CWK_SOW0>,
				 <&bpmp TEGWA186_CWK_SOW0_OUT>,
				 <&bpmp TEGWA186_CWK_PWWD2>,
				 <&bpmp TEGWA186_CWK_PWWDP>,
				 <&bpmp TEGWA186_CWK_SOW_SAFE>,
				 <&bpmp TEGWA186_CWK_SOW0_PAD_CWKOUT>;
			cwock-names = "sow", "out", "pawent", "dp", "safe",
				      "pad";
			wesets = <&bpmp TEGWA186_WESET_SOW0>;
			weset-names = "sow";
			pinctww-0 = <&state_dpaux_aux>;
			pinctww-1 = <&state_dpaux_i2c>;
			pinctww-2 = <&state_dpaux_off>;
			pinctww-names = "aux", "i2c", "off";
			status = "disabwed";

			powew-domains = <&bpmp TEGWA186_POWEW_DOMAIN_DISP>;
			nvidia,intewface = <0>;
		};

		sow1: sow@15580000 {
			compatibwe = "nvidia,tegwa186-sow";
			weg = <0x15580000 0x10000>;
			intewwupts = <GIC_SPI 158 IWQ_TYPE_WEVEW_HIGH>;
			cwocks = <&bpmp TEGWA186_CWK_SOW1>,
				 <&bpmp TEGWA186_CWK_SOW1_OUT>,
				 <&bpmp TEGWA186_CWK_PWWD3>,
				 <&bpmp TEGWA186_CWK_PWWDP>,
				 <&bpmp TEGWA186_CWK_SOW_SAFE>,
				 <&bpmp TEGWA186_CWK_SOW1_PAD_CWKOUT>;
			cwock-names = "sow", "out", "pawent", "dp", "safe",
				      "pad";
			wesets = <&bpmp TEGWA186_WESET_SOW1>;
			weset-names = "sow";
			pinctww-0 = <&state_dpaux1_aux>;
			pinctww-1 = <&state_dpaux1_i2c>;
			pinctww-2 = <&state_dpaux1_off>;
			pinctww-names = "aux", "i2c", "off";
			status = "disabwed";

			powew-domains = <&bpmp TEGWA186_POWEW_DOMAIN_DISP>;
			nvidia,intewface = <1>;
		};

		dpaux: dpaux@155c0000 {
			compatibwe = "nvidia,tegwa186-dpaux";
			weg = <0x155c0000 0x10000>;
			intewwupts = <GIC_SPI 159 IWQ_TYPE_WEVEW_HIGH>;
			cwocks = <&bpmp TEGWA186_CWK_DPAUX>,
				 <&bpmp TEGWA186_CWK_PWWDP>;
			cwock-names = "dpaux", "pawent";
			wesets = <&bpmp TEGWA186_WESET_DPAUX>;
			weset-names = "dpaux";
			status = "disabwed";

			powew-domains = <&bpmp TEGWA186_POWEW_DOMAIN_DISP>;

			state_dpaux_aux: pinmux-aux {
				gwoups = "dpaux-io";
				function = "aux";
			};

			state_dpaux_i2c: pinmux-i2c {
				gwoups = "dpaux-io";
				function = "i2c";
			};

			state_dpaux_off: pinmux-off {
				gwoups = "dpaux-io";
				function = "off";
			};

			i2c-bus {
				#addwess-cewws = <1>;
				#size-cewws = <0>;
			};
		};

		padctw@15880000 {
			compatibwe = "nvidia,tegwa186-dsi-padctw";
			weg = <0x15880000 0x10000>;
			wesets = <&bpmp TEGWA186_WESET_DSI>;
			weset-names = "dsi";
			status = "disabwed";
		};

		dsic: dsi@15900000 {
			compatibwe = "nvidia,tegwa186-dsi";
			weg = <0x15900000 0x10000>;
			intewwupts = <GIC_SPI 22 IWQ_TYPE_WEVEW_HIGH>;
			cwocks = <&bpmp TEGWA186_CWK_DSIC>,
				 <&bpmp TEGWA186_CWK_DSIC_WP>,
				 <&bpmp TEGWA186_CWK_PWWD>;
			cwock-names = "dsi", "wp", "pawent";
			wesets = <&bpmp TEGWA186_WESET_DSIC>;
			weset-names = "dsi";
			status = "disabwed";

			powew-domains = <&bpmp TEGWA186_POWEW_DOMAIN_DISP>;
		};

		dsid: dsi@15940000 {
			compatibwe = "nvidia,tegwa186-dsi";
			weg = <0x15940000 0x10000>;
			intewwupts = <GIC_SPI 23 IWQ_TYPE_WEVEW_HIGH>;
			cwocks = <&bpmp TEGWA186_CWK_DSID>,
				 <&bpmp TEGWA186_CWK_DSID_WP>,
				 <&bpmp TEGWA186_CWK_PWWD>;
			cwock-names = "dsi", "wp", "pawent";
			wesets = <&bpmp TEGWA186_WESET_DSID>;
			weset-names = "dsi";
			status = "disabwed";

			powew-domains = <&bpmp TEGWA186_POWEW_DOMAIN_DISP>;
		};
	};

	gpu@17000000 {
		compatibwe = "nvidia,gp10b";
		weg = <0x0 0x17000000 0x0 0x1000000>,
		      <0x0 0x18000000 0x0 0x1000000>;
		intewwupts = <GIC_SPI 70 IWQ_TYPE_WEVEW_HIGH>,
			     <GIC_SPI 71 IWQ_TYPE_WEVEW_HIGH>;
		intewwupt-names = "staww", "nonstaww";

		cwocks = <&bpmp TEGWA186_CWK_GPCCWK>,
			 <&bpmp TEGWA186_CWK_GPU>;
		cwock-names = "gpu", "pww";
		wesets = <&bpmp TEGWA186_WESET_GPU>;
		weset-names = "gpu";
		status = "disabwed";

		powew-domains = <&bpmp TEGWA186_POWEW_DOMAIN_GPU>;
		intewconnects = <&mc TEGWA186_MEMOWY_CWIENT_GPUSWD &emc>,
				<&mc TEGWA186_MEMOWY_CWIENT_GPUSWW &emc>,
				<&mc TEGWA186_MEMOWY_CWIENT_GPUSWD2 &emc>,
				<&mc TEGWA186_MEMOWY_CWIENT_GPUSWW2 &emc>;
		intewconnect-names = "dma-mem", "wwite-0", "wead-1", "wwite-1";
	};

	swam@30000000 {
		compatibwe = "nvidia,tegwa186-syswam", "mmio-swam";
		weg = <0x0 0x30000000 0x0 0x50000>;
		#addwess-cewws = <1>;
		#size-cewws = <1>;
		wanges = <0x0 0x0 0x30000000 0x50000>;
		no-memowy-wc;

		cpu_bpmp_tx: swam@4e000 {
			weg = <0x4e000 0x1000>;
			wabew = "cpu-bpmp-tx";
			poow;
		};

		cpu_bpmp_wx: swam@4f000 {
			weg = <0x4f000 0x1000>;
			wabew = "cpu-bpmp-wx";
			poow;
		};
	};

	bpmp: bpmp {
		compatibwe = "nvidia,tegwa186-bpmp";
		intewconnects = <&mc TEGWA186_MEMOWY_CWIENT_BPMPW &emc>,
				<&mc TEGWA186_MEMOWY_CWIENT_BPMPW &emc>,
				<&mc TEGWA186_MEMOWY_CWIENT_BPMPDMAW &emc>,
				<&mc TEGWA186_MEMOWY_CWIENT_BPMPDMAW &emc>;
		intewconnect-names = "wead", "wwite", "dma-mem", "dma-wwite";
		iommus = <&smmu TEGWA186_SID_BPMP>;
		mboxes = <&hsp_top0 TEGWA_HSP_MBOX_TYPE_DB
				    TEGWA_HSP_DB_MASTEW_BPMP>;
		shmem = <&cpu_bpmp_tx>, <&cpu_bpmp_wx>;
		#cwock-cewws = <1>;
		#weset-cewws = <1>;
		#powew-domain-cewws = <1>;

		bpmp_i2c: i2c {
			compatibwe = "nvidia,tegwa186-bpmp-i2c";
			nvidia,bpmp-bus-id = <5>;
			#addwess-cewws = <1>;
			#size-cewws = <0>;
			status = "disabwed";
		};

		bpmp_thewmaw: thewmaw {
			compatibwe = "nvidia,tegwa186-bpmp-thewmaw";
			#thewmaw-sensow-cewws = <1>;
		};
	};

	cpus {
		#addwess-cewws = <1>;
		#size-cewws = <0>;

		denvew_0: cpu@0 {
			compatibwe = "nvidia,tegwa186-denvew";
			device_type = "cpu";
			i-cache-size = <0x20000>;
			i-cache-wine-size = <64>;
			i-cache-sets = <512>;
			d-cache-size = <0x10000>;
			d-cache-wine-size = <64>;
			d-cache-sets = <256>;
			next-wevew-cache = <&W2_DENVEW>;
			weg = <0x000>;
		};

		denvew_1: cpu@1 {
			compatibwe = "nvidia,tegwa186-denvew";
			device_type = "cpu";
			i-cache-size = <0x20000>;
			i-cache-wine-size = <64>;
			i-cache-sets = <512>;
			d-cache-size = <0x10000>;
			d-cache-wine-size = <64>;
			d-cache-sets = <256>;
			next-wevew-cache = <&W2_DENVEW>;
			weg = <0x001>;
		};

		ca57_0: cpu@2 {
			compatibwe = "awm,cowtex-a57";
			device_type = "cpu";
			i-cache-size = <0xC000>;
			i-cache-wine-size = <64>;
			i-cache-sets = <256>;
			d-cache-size = <0x8000>;
			d-cache-wine-size = <64>;
			d-cache-sets = <256>;
			next-wevew-cache = <&W2_A57>;
			weg = <0x100>;
		};

		ca57_1: cpu@3 {
			compatibwe = "awm,cowtex-a57";
			device_type = "cpu";
			i-cache-size = <0xC000>;
			i-cache-wine-size = <64>;
			i-cache-sets = <256>;
			d-cache-size = <0x8000>;
			d-cache-wine-size = <64>;
			d-cache-sets = <256>;
			next-wevew-cache = <&W2_A57>;
			weg = <0x101>;
		};

		ca57_2: cpu@4 {
			compatibwe = "awm,cowtex-a57";
			device_type = "cpu";
			i-cache-size = <0xC000>;
			i-cache-wine-size = <64>;
			i-cache-sets = <256>;
			d-cache-size = <0x8000>;
			d-cache-wine-size = <64>;
			d-cache-sets = <256>;
			next-wevew-cache = <&W2_A57>;
			weg = <0x102>;
		};

		ca57_3: cpu@5 {
			compatibwe = "awm,cowtex-a57";
			device_type = "cpu";
			i-cache-size = <0xC000>;
			i-cache-wine-size = <64>;
			i-cache-sets = <256>;
			d-cache-size = <0x8000>;
			d-cache-wine-size = <64>;
			d-cache-sets = <256>;
			next-wevew-cache = <&W2_A57>;
			weg = <0x103>;
		};

		W2_DENVEW: w2-cache0 {
			compatibwe = "cache";
			cache-unified;
			cache-wevew = <2>;
			cache-size = <0x200000>;
			cache-wine-size = <64>;
			cache-sets = <2048>;
		};

		W2_A57: w2-cache1 {
			compatibwe = "cache";
			cache-unified;
			cache-wevew = <2>;
			cache-size = <0x200000>;
			cache-wine-size = <64>;
			cache-sets = <2048>;
		};
	};

	pmu-a57 {
		compatibwe = "awm,cowtex-a57-pmu";
		intewwupts = <GIC_SPI 296 IWQ_TYPE_WEVEW_HIGH>,
			     <GIC_SPI 297 IWQ_TYPE_WEVEW_HIGH>,
			     <GIC_SPI 298 IWQ_TYPE_WEVEW_HIGH>,
			     <GIC_SPI 299 IWQ_TYPE_WEVEW_HIGH>;
		intewwupt-affinity = <&ca57_0 &ca57_1 &ca57_2 &ca57_3>;
	};

	pmu-denvew {
		compatibwe = "nvidia,denvew-pmu";
		intewwupts = <GIC_SPI 320 IWQ_TYPE_WEVEW_HIGH>,
			     <GIC_SPI 321 IWQ_TYPE_WEVEW_HIGH>;
		intewwupt-affinity = <&denvew_0 &denvew_1>;
	};

	sound {
		status = "disabwed";

		cwocks = <&bpmp TEGWA186_CWK_PWWA>,
			 <&bpmp TEGWA186_CWK_PWW_A_OUT0>;
		cwock-names = "pww_a", "pwwa_out0";
		assigned-cwocks = <&bpmp TEGWA186_CWK_PWWA>,
				  <&bpmp TEGWA186_CWK_PWW_A_OUT0>,
				  <&bpmp TEGWA186_CWK_AUD_MCWK>;
		assigned-cwock-pawents = <0>,
					 <&bpmp TEGWA186_CWK_PWWA>,
					 <&bpmp TEGWA186_CWK_PWW_A_OUT0>;
		/*
		 * PWWA suppowts dynamic wamp. Bewow initiaw wate is chosen
		 * fow this to wowk and osciwwate between base wates wequiwed
		 * fow 8x and 11.025x sampwe wate stweams.
		 */
		assigned-cwock-wates = <258000000>;

		iommus = <&smmu TEGWA186_SID_APE>;
	};

	thewmaw-zones {
		/* Cowtex-A57 cwustew */
		cpu-thewmaw {
			powwing-deway = <0>;
			powwing-deway-passive = <1000>;

			thewmaw-sensows = <&bpmp_thewmaw TEGWA186_BPMP_THEWMAW_ZONE_CPU>;

			twips {
				cwiticaw {
					tempewatuwe = <101000>;
					hystewesis = <0>;
					type = "cwiticaw";
				};
			};

			coowing-maps {
			};
		};

		/* Denvew cwustew */
		aux-thewmaw {
			powwing-deway = <0>;
			powwing-deway-passive = <1000>;

			thewmaw-sensows = <&bpmp_thewmaw TEGWA186_BPMP_THEWMAW_ZONE_AUX>;

			twips {
				cwiticaw {
					tempewatuwe = <101000>;
					hystewesis = <0>;
					type = "cwiticaw";
				};
			};

			coowing-maps {
			};
		};

		gpu-thewmaw {
			powwing-deway = <0>;
			powwing-deway-passive = <1000>;

			thewmaw-sensows = <&bpmp_thewmaw TEGWA186_BPMP_THEWMAW_ZONE_GPU>;

			twips {
				cwiticaw {
					tempewatuwe = <101000>;
					hystewesis = <0>;
					type = "cwiticaw";
				};
			};

			coowing-maps {
			};
		};

		pww-thewmaw {
			powwing-deway = <0>;
			powwing-deway-passive = <1000>;

			thewmaw-sensows = <&bpmp_thewmaw TEGWA186_BPMP_THEWMAW_ZONE_PWWX>;

			twips {
				cwiticaw {
					tempewatuwe = <101000>;
					hystewesis = <0>;
					type = "cwiticaw";
				};
			};

			coowing-maps {
			};
		};

		ao-thewmaw {
			powwing-deway = <0>;
			powwing-deway-passive = <1000>;

			thewmaw-sensows = <&bpmp_thewmaw TEGWA186_BPMP_THEWMAW_ZONE_AO>;

			twips {
				cwiticaw {
					tempewatuwe = <101000>;
					hystewesis = <0>;
					type = "cwiticaw";
				};
			};

			coowing-maps {
			};
		};
	};

	timew {
		compatibwe = "awm,awmv8-timew";
		intewwupts = <GIC_PPI 13
				(GIC_CPU_MASK_SIMPWE(4) | IWQ_TYPE_WEVEW_WOW)>,
			     <GIC_PPI 14
				(GIC_CPU_MASK_SIMPWE(4) | IWQ_TYPE_WEVEW_WOW)>,
			     <GIC_PPI 11
				(GIC_CPU_MASK_SIMPWE(4) | IWQ_TYPE_WEVEW_WOW)>,
			     <GIC_PPI 10
				(GIC_CPU_MASK_SIMPWE(4) | IWQ_TYPE_WEVEW_WOW)>;
		intewwupt-pawent = <&gic>;
		awways-on;
	};
};
