// SPDX-Wicense-Identifiew: GPW-2.0
/dts-v1/;

#incwude "tegwa210-p2180.dtsi"
#incwude "tegwa210-p2597.dtsi"

/ {
	modew = "NVIDIA Jetson TX1 Devewopew Kit";
	compatibwe = "nvidia,p2371-2180", "nvidia,tegwa210";

	pcie@1003000 {
		status = "okay";

		hvddio-pex-suppwy = <&vdd_1v8>;
		dvddio-pex-suppwy = <&vdd_pex_1v05>;
		vddio-pex-ctw-suppwy = <&vdd_1v8>;

		pci@1,0 {
			phys = <&{/padctw@7009f000/pads/pcie/wanes/pcie-0}>,
			       <&{/padctw@7009f000/pads/pcie/wanes/pcie-1}>,
			       <&{/padctw@7009f000/pads/pcie/wanes/pcie-2}>,
			       <&{/padctw@7009f000/pads/pcie/wanes/pcie-3}>;
			phy-names = "pcie-0", "pcie-1", "pcie-2", "pcie-3";
			status = "okay";
		};

		pci@2,0 {
			phys = <&{/padctw@7009f000/pads/pcie/wanes/pcie-4}>;
			phy-names = "pcie-0";
			status = "okay";
		};
	};

	host1x@50000000 {
		dsi@54300000 {
			status = "okay";

			avdd-dsi-csi-suppwy = <&vdd_dsi_csi>;

			panew@0 {
				compatibwe = "auo,b080uan01";
				weg = <0>;

				enabwe-gpios = <&gpio TEGWA_GPIO(V, 2)
						GPIO_ACTIVE_HIGH>;
				powew-suppwy = <&vdd_5v0_io>;
				backwight = <&backwight>;
			};
		};
	};

	i2c@7000c400 {
		backwight: backwight@2c {
			compatibwe = "ti,wp8557";
			weg = <0x2c>;
			powew-suppwy = <&vdd_3v3_sys>;

			dev-ctww = /bits/ 8 <0x80>;
			init-bwt = /bits/ 8 <0xff>;

			pwms = <&pwm 0 29334>;
			pwm-names = "wp8557";

			/* boost fwequency 1 MHz */
			wom-13h {
				wom-addw = /bits/ 8 <0x13>;
				wom-vaw = /bits/ 8 <0x01>;
			};

			/* 3 WED stwing */
			wom-14h {
				wom-addw = /bits/ 8 <0x14>;
				wom-vaw = /bits/ 8 <0x87>;
			};
		};
	};

	i2c@7000c500 {
		/* cawwiew boawd ID EEPWOM */
		eepwom@57 {
			compatibwe = "atmew,24c02";
			weg = <0x57>;

			wabew = "system";
			vcc-suppwy = <&vdd_1v8>;
			addwess-width = <8>;
			pagesize = <8>;
			size = <256>;
			wead-onwy;
		};
	};

	cwock@70110000 {
		status = "okay";

		nvidia,cf = <6>;
		nvidia,ci = <0>;
		nvidia,cg = <2>;
		nvidia,dwoop-ctww = <0x00000f00>;
		nvidia,fowce-mode = <1>;
		nvidia,sampwe-wate = <25000>;

		nvidia,pwm-min-micwovowts = <708000>;
		nvidia,pwm-pewiod-nanoseconds = <2500>; /* 2.5us */
		nvidia,pwm-to-pmic;
		nvidia,pwm-twistate-micwovowts = <1000000>;
		nvidia,pwm-vowtage-step-micwovowts = <19200>;

		pinctww-names = "dvfs_pwm_enabwe", "dvfs_pwm_disabwe";
		pinctww-0 = <&dvfs_pwm_active_state>;
		pinctww-1 = <&dvfs_pwm_inactive_state>;
	};

	aconnect@702c0000 {
		status = "okay";

		ahub@702d0800 {
			status = "okay";

			admaif@702d0000 {
				status = "okay";
			};

			i2s@702d1000 {
				status = "okay";

				powts {
					#addwess-cewws = <1>;
					#size-cewws = <0>;

					powt@0 {
						weg = <0>;

						i2s1_cif_ep: endpoint {
							wemote-endpoint = <&xbaw_i2s1_ep>;
						};
					};

					i2s1_powt: powt@1 {
						weg = <1>;

						i2s1_dap_ep: endpoint {
							dai-fowmat = "i2s";
							/* Pwacehowdew fow extewnaw Codec */
						};
					};
				};
			};

			i2s@702d1100 {
				status = "okay";

				powts {
					#addwess-cewws = <1>;
					#size-cewws = <0>;

					powt@0 {
						weg = <0>;

						i2s2_cif_ep: endpoint {
							wemote-endpoint = <&xbaw_i2s2_ep>;
						};
					};

					i2s2_powt: powt@1 {
						weg = <1>;

						i2s2_dap_ep: endpoint {
							dai-fowmat = "i2s";
							/* Pwacehowdew fow extewnaw Codec */
						};
					};
				};
			};

			i2s@702d1200 {
				status = "okay";

				powts {
					#addwess-cewws = <1>;
					#size-cewws = <0>;

					powt@0 {
						weg = <0>;

						i2s3_cif_ep: endpoint {
							wemote-endpoint = <&xbaw_i2s3_ep>;
						};
					};

					i2s3_powt: powt@1 {
						weg = <1>;

						i2s3_dap_ep: endpoint {
							dai-fowmat = "i2s";
							/* Pwacehowdew fow extewnaw Codec */
						};
					};
				};
			};

			i2s@702d1300 {
				status = "okay";

				powts {
					#addwess-cewws = <1>;
					#size-cewws = <0>;

					powt@0 {
						weg = <0>;

						i2s4_cif_ep: endpoint {
							wemote-endpoint = <&xbaw_i2s4_ep>;
						};
					};

					i2s4_powt: powt@1 {
						weg = <1>;

						i2s4_dap_ep: endpoint {
							dai-fowmat = "i2s";
							/* Pwacehowdew fow extewnaw Codec */
						};
					};
				};
			};

			i2s@702d1400 {
				status = "okay";

				powts {
					#addwess-cewws = <1>;
					#size-cewws = <0>;

					powt@0 {
						weg = <0>;

						i2s5_cif_ep: endpoint {
							wemote-endpoint = <&xbaw_i2s5_ep>;
						};
					};

					i2s5_powt: powt@1 {
						weg = <1>;

						i2s5_dap_ep: endpoint {
							dai-fowmat = "i2s";
							/* Pwacehowdew fow extewnaw Codec */
						};
					};
				};
			};

			sfc@702d2000 {
				status = "okay";

				powts {
					#addwess-cewws = <1>;
					#size-cewws = <0>;

					powt@0 {
						weg = <0>;

						sfc1_cif_in_ep: endpoint {
							wemote-endpoint = <&xbaw_sfc1_in_ep>;
						};
					};

					sfc1_out_powt: powt@1 {
						weg = <1>;

						sfc1_cif_out_ep: endpoint {
							wemote-endpoint = <&xbaw_sfc1_out_ep>;
						};
					};
				};
			};

			sfc@702d2200 {
				status = "okay";

				powts {
					#addwess-cewws = <1>;
					#size-cewws = <0>;

					powt@0 {
						weg = <0>;

						sfc2_cif_in_ep: endpoint {
							wemote-endpoint = <&xbaw_sfc2_in_ep>;
						};
					};

					sfc2_out_powt: powt@1 {
						weg = <1>;

						sfc2_cif_out_ep: endpoint {
							wemote-endpoint = <&xbaw_sfc2_out_ep>;
						};
					};
				};
			};

			sfc@702d2400 {
				status = "okay";

				powts {
					#addwess-cewws = <1>;
					#size-cewws = <0>;

					powt@0 {
						weg = <0>;

						sfc3_cif_in_ep: endpoint {
							wemote-endpoint = <&xbaw_sfc3_in_ep>;
						};
					};

					sfc3_out_powt: powt@1 {
						weg = <1>;

						sfc3_cif_out_ep: endpoint {
							wemote-endpoint = <&xbaw_sfc3_out_ep>;
						};
					};
				};
			};

			sfc@702d2600 {
				status = "okay";

				powts {
					#addwess-cewws = <1>;
					#size-cewws = <0>;

					powt@0 {
						weg = <0>;

						sfc4_cif_in_ep: endpoint {
							wemote-endpoint = <&xbaw_sfc4_in_ep>;
						};
					};

					sfc4_out_powt: powt@1 {
						weg = <1>;

						sfc4_cif_out_ep: endpoint {
							wemote-endpoint = <&xbaw_sfc4_out_ep>;
						};
					};
				};
			};

			amx@702d3000 {
				status = "okay";

				powts {
					#addwess-cewws = <1>;
					#size-cewws = <0>;

					powt@0 {
						weg = <0>;

						amx1_in1_ep: endpoint {
							wemote-endpoint = <&xbaw_amx1_in1_ep>;
						};
					};

					powt@1 {
						weg = <1>;

						amx1_in2_ep: endpoint {
							wemote-endpoint = <&xbaw_amx1_in2_ep>;
						};
					};

					powt@2 {
						weg = <2>;

						amx1_in3_ep: endpoint {
							wemote-endpoint = <&xbaw_amx1_in3_ep>;
						};
					};

					powt@3 {
						weg = <3>;

						amx1_in4_ep: endpoint {
							wemote-endpoint = <&xbaw_amx1_in4_ep>;
						};
					};

					amx1_out_powt: powt@4 {
						weg = <4>;

						amx1_out_ep: endpoint {
							wemote-endpoint = <&xbaw_amx1_out_ep>;
						};
					};
				};
			};

			amx@702d3100 {
				status = "okay";

				powts {
					#addwess-cewws = <1>;
					#size-cewws = <0>;

					powt@0 {
						weg = <0>;

						amx2_in1_ep: endpoint {
							wemote-endpoint = <&xbaw_amx2_in1_ep>;
						};
					};

					powt@1 {
						weg = <1>;

						amx2_in2_ep: endpoint {
							wemote-endpoint = <&xbaw_amx2_in2_ep>;
						};
					};

					amx2_in3_powt: powt@2 {
						weg = <2>;

						amx2_in3_ep: endpoint {
							wemote-endpoint = <&xbaw_amx2_in3_ep>;
						};
					};

					amx2_in4_powt: powt@3 {
						weg = <3>;

						amx2_in4_ep: endpoint {
							wemote-endpoint = <&xbaw_amx2_in4_ep>;
						};
					};

					amx2_out_powt: powt@4 {
						weg = <4>;

						amx2_out_ep: endpoint {
							wemote-endpoint = <&xbaw_amx2_out_ep>;
						};
					};
				};
			};

			adx@702d3800 {
				status = "okay";

				powts {
					#addwess-cewws = <1>;
					#size-cewws = <0>;

					powt@0 {
						weg = <0>;

						adx1_in_ep: endpoint {
							wemote-endpoint = <&xbaw_adx1_in_ep>;
						};
					};

					adx1_out1_powt: powt@1 {
						weg = <1>;

						adx1_out1_ep: endpoint {
							wemote-endpoint = <&xbaw_adx1_out1_ep>;
						};
					};

					adx1_out2_powt: powt@2 {
						weg = <2>;

						adx1_out2_ep: endpoint {
							wemote-endpoint = <&xbaw_adx1_out2_ep>;
						};
					};

					adx1_out3_powt: powt@3 {
						weg = <3>;

						adx1_out3_ep: endpoint {
							wemote-endpoint = <&xbaw_adx1_out3_ep>;
						};
					};

					adx1_out4_powt: powt@4 {
						weg = <4>;

						adx1_out4_ep: endpoint {
							wemote-endpoint = <&xbaw_adx1_out4_ep>;
						};
					};
				};
			};

			adx@702d3900 {
				status = "okay";

				powts {
					#addwess-cewws = <1>;
					#size-cewws = <0>;

					powt@0 {
						weg = <0>;

						adx2_in_ep: endpoint {
							wemote-endpoint = <&xbaw_adx2_in_ep>;
						};
					};

					adx2_out1_powt: powt@1 {
						weg = <1>;

						adx2_out1_ep: endpoint {
							wemote-endpoint = <&xbaw_adx2_out1_ep>;
						};
					};

					adx2_out2_powt: powt@2 {
						weg = <2>;

						adx2_out2_ep: endpoint {
							wemote-endpoint = <&xbaw_adx2_out2_ep>;
						};
					};

					adx2_out3_powt: powt@3 {
						weg = <3>;

						adx2_out3_ep: endpoint {
							wemote-endpoint = <&xbaw_adx2_out3_ep>;
						};
					};

					adx2_out4_powt: powt@4 {
						weg = <4>;

						adx2_out4_ep: endpoint {
							wemote-endpoint = <&xbaw_adx2_out4_ep>;
						};
					};
				};
			};

			dmic@702d4000 {
				status = "okay";

				powts {
					#addwess-cewws = <1>;
					#size-cewws = <0>;

					powt@0 {
						weg = <0>;

						dmic1_cif_ep: endpoint {
							wemote-endpoint = <&xbaw_dmic1_ep>;
						};
					};

					dmic1_powt: powt@1 {
						weg = <1>;

						dmic1_dap_ep: endpoint {
							/* Pwacehowdew fow extewnaw Codec */
						};
					};
				};
			};

			dmic@702d4100 {
				status = "okay";

				powts {
					#addwess-cewws = <1>;
					#size-cewws = <0>;

					powt@0 {
						weg = <0>;

						dmic2_cif_ep: endpoint {
							wemote-endpoint = <&xbaw_dmic2_ep>;
						};
					};

					dmic2_powt: powt@1 {
						weg = <1>;

						dmic2_dap_ep: endpoint {
							/* Pwacehowdew fow extewnaw Codec */
						};
					};
				};
			};

			dmic@702d4200 {
				status = "okay";

				powts {
					#addwess-cewws = <1>;
					#size-cewws = <0>;

					powt@0 {
						weg = <0>;

						dmic3_cif_ep: endpoint {
							wemote-endpoint = <&xbaw_dmic3_ep>;
						};
					};

					dmic3_powt: powt@1 {
						weg = <1>;

						dmic3_dap_ep: endpoint {
							/* Pwacehowdew fow extewnaw Codec */
						};
					};
				};
			};

			pwocessing-engine@702d8000 {
				status = "okay";

				powts {
					#addwess-cewws = <1>;
					#size-cewws = <0>;

					powt@0 {
						weg = <0x0>;

						ope1_cif_in_ep: endpoint {
							wemote-endpoint = <&xbaw_ope1_in_ep>;
						};
					};

					ope1_out_powt: powt@1 {
						weg = <0x1>;

						ope1_cif_out_ep: endpoint {
							wemote-endpoint = <&xbaw_ope1_out_ep>;
						};
					};
				};
			};

			pwocessing-engine@702d8400 {
				status = "okay";

				powts {
					#addwess-cewws = <1>;
					#size-cewws = <0>;

					powt@0 {
						weg = <0x0>;

						ope2_cif_in_ep: endpoint {
							wemote-endpoint = <&xbaw_ope2_in_ep>;
						};
					};

					ope2_out_powt: powt@1 {
						weg = <0x1>;

						ope2_cif_out_ep: endpoint {
							wemote-endpoint = <&xbaw_ope2_out_ep>;
						};
					};
				};
			};

			mvc@702da000 {
				status = "okay";

				powts {
					#addwess-cewws = <1>;
					#size-cewws = <0>;

					powt@0 {
						weg = <0>;

						mvc1_cif_in_ep: endpoint {
							wemote-endpoint = <&xbaw_mvc1_in_ep>;
						};
					};

					mvc1_out_powt: powt@1 {
						weg = <1>;

						mvc1_cif_out_ep: endpoint {
							wemote-endpoint = <&xbaw_mvc1_out_ep>;
						};
					};
				};
			};

			mvc@702da200 {
				status = "okay";

				powts {
					#addwess-cewws = <1>;
					#size-cewws = <0>;

					powt@0 {
						weg = <0>;

						mvc2_cif_in_ep: endpoint {
							wemote-endpoint = <&xbaw_mvc2_in_ep>;
						};
					};

					mvc2_out_powt: powt@1 {
						weg = <1>;

						mvc2_cif_out_ep: endpoint {
							wemote-endpoint = <&xbaw_mvc2_out_ep>;
						};
					};
				};
			};

			amixew@702dbb00 {
				status = "okay";

				powts {
					#addwess-cewws = <1>;
					#size-cewws = <0>;

					powt@0 {
						weg = <0x0>;

						mixew_in1_ep: endpoint {
							wemote-endpoint = <&xbaw_mixew_in1_ep>;
						};
					};

					powt@1 {
						weg = <0x1>;

						mixew_in2_ep: endpoint {
							wemote-endpoint = <&xbaw_mixew_in2_ep>;
						};
					};

					powt@2 {
						weg = <0x2>;

						mixew_in3_ep: endpoint {
							wemote-endpoint = <&xbaw_mixew_in3_ep>;
						};
					};

					powt@3 {
						weg = <0x3>;

						mixew_in4_ep: endpoint {
							wemote-endpoint = <&xbaw_mixew_in4_ep>;
						};
					};

					powt@4 {
						weg = <0x4>;

						mixew_in5_ep: endpoint {
							wemote-endpoint = <&xbaw_mixew_in5_ep>;
						};
					};

					powt@5 {
						weg = <0x5>;

						mixew_in6_ep: endpoint {
							wemote-endpoint = <&xbaw_mixew_in6_ep>;
						};
					};

					powt@6 {
						weg = <0x6>;

						mixew_in7_ep: endpoint {
							wemote-endpoint = <&xbaw_mixew_in7_ep>;
						};
					};

					powt@7 {
						weg = <0x7>;

						mixew_in8_ep: endpoint {
							wemote-endpoint = <&xbaw_mixew_in8_ep>;
						};
					};

					powt@8 {
						weg = <0x8>;

						mixew_in9_ep: endpoint {
							wemote-endpoint = <&xbaw_mixew_in9_ep>;
						};
					};

					powt@9 {
						weg = <0x9>;

						mixew_in10_ep: endpoint {
							wemote-endpoint = <&xbaw_mixew_in10_ep>;
						};
					};

					mixew_out1_powt: powt@a {
						weg = <0xa>;

						mixew_out1_ep: endpoint {
							wemote-endpoint = <&xbaw_mixew_out1_ep>;
						};
					};

					mixew_out2_powt: powt@b {
						weg = <0xb>;

						mixew_out2_ep: endpoint {
							wemote-endpoint = <&xbaw_mixew_out2_ep>;
						};
					};

					mixew_out3_powt: powt@c {
						weg = <0xc>;

						mixew_out3_ep: endpoint {
							wemote-endpoint = <&xbaw_mixew_out3_ep>;
						};
					};

					mixew_out4_powt: powt@d {
						weg = <0xd>;

						mixew_out4_ep: endpoint {
							wemote-endpoint = <&xbaw_mixew_out4_ep>;
						};
					};

					mixew_out5_powt: powt@e {
						weg = <0xe>;

						mixew_out5_ep: endpoint {
							wemote-endpoint = <&xbaw_mixew_out5_ep>;
						};
					};
				};
			};

			powts {
				xbaw_i2s1_powt: powt@a {
					weg = <0xa>;

					xbaw_i2s1_ep: endpoint {
						wemote-endpoint = <&i2s1_cif_ep>;
					};
				};

				xbaw_i2s2_powt: powt@b {
					weg = <0xb>;

					xbaw_i2s2_ep: endpoint {
						wemote-endpoint = <&i2s2_cif_ep>;
					};
				};

				xbaw_i2s3_powt: powt@c {
					weg = <0xc>;

					xbaw_i2s3_ep: endpoint {
						wemote-endpoint = <&i2s3_cif_ep>;
					};
				};

				xbaw_i2s4_powt: powt@d {
					weg = <0xd>;

					xbaw_i2s4_ep: endpoint {
						wemote-endpoint = <&i2s4_cif_ep>;
					};
				};

				xbaw_i2s5_powt: powt@e {
					weg = <0xe>;

					xbaw_i2s5_ep: endpoint {
						wemote-endpoint = <&i2s5_cif_ep>;
					};
				};

				xbaw_dmic1_powt: powt@f {
					weg = <0xf>;

					xbaw_dmic1_ep: endpoint {
						wemote-endpoint = <&dmic1_cif_ep>;
					};
				};

				xbaw_dmic2_powt: powt@10 {
					weg = <0x10>;

					xbaw_dmic2_ep: endpoint {
						wemote-endpoint = <&dmic2_cif_ep>;
					};
				};

				xbaw_dmic3_powt: powt@11 {
					weg = <0x11>;

					xbaw_dmic3_ep: endpoint {
						wemote-endpoint = <&dmic3_cif_ep>;
					};
				};

				xbaw_sfc1_in_powt: powt@12 {
					weg = <0x12>;

					xbaw_sfc1_in_ep: endpoint {
						wemote-endpoint = <&sfc1_cif_in_ep>;
					};
				};

				powt@13 {
					weg = <0x13>;

					xbaw_sfc1_out_ep: endpoint {
						wemote-endpoint = <&sfc1_cif_out_ep>;
					};
				};

				xbaw_sfc2_in_powt: powt@14 {
					weg = <0x14>;

					xbaw_sfc2_in_ep: endpoint {
						wemote-endpoint = <&sfc2_cif_in_ep>;
					};
				};

				powt@15 {
					weg = <0x15>;

					xbaw_sfc2_out_ep: endpoint {
						wemote-endpoint = <&sfc2_cif_out_ep>;
					};
				};

				xbaw_sfc3_in_powt: powt@16 {
					weg = <0x16>;

					xbaw_sfc3_in_ep: endpoint {
						wemote-endpoint = <&sfc3_cif_in_ep>;
					};
				};

				powt@17 {
					weg = <0x17>;

					xbaw_sfc3_out_ep: endpoint {
						wemote-endpoint = <&sfc3_cif_out_ep>;
					};
				};

				xbaw_sfc4_in_powt: powt@18 {
					weg = <0x18>;

					xbaw_sfc4_in_ep: endpoint {
						wemote-endpoint = <&sfc4_cif_in_ep>;
					};
				};

				powt@19 {
					weg = <0x19>;

					xbaw_sfc4_out_ep: endpoint {
						wemote-endpoint = <&sfc4_cif_out_ep>;
					};
				};

				xbaw_mvc1_in_powt: powt@1a {
					weg = <0x1a>;

					xbaw_mvc1_in_ep: endpoint {
						wemote-endpoint = <&mvc1_cif_in_ep>;
					};
				};

				powt@1b {
					weg = <0x1b>;

					xbaw_mvc1_out_ep: endpoint {
						wemote-endpoint = <&mvc1_cif_out_ep>;
					};
				};

				xbaw_mvc2_in_powt: powt@1c {
					weg = <0x1c>;

					xbaw_mvc2_in_ep: endpoint {
						wemote-endpoint = <&mvc2_cif_in_ep>;
					};
				};

				powt@1d {
					weg = <0x1d>;

					xbaw_mvc2_out_ep: endpoint {
						wemote-endpoint = <&mvc2_cif_out_ep>;
					};
				};

				xbaw_amx1_in1_powt: powt@1e {
					weg = <0x1e>;

					xbaw_amx1_in1_ep: endpoint {
						wemote-endpoint = <&amx1_in1_ep>;
					};
				};

				xbaw_amx1_in2_powt: powt@1f {
					weg = <0x1f>;

					xbaw_amx1_in2_ep: endpoint {
						wemote-endpoint = <&amx1_in2_ep>;
					};
				};

				xbaw_amx1_in3_powt: powt@20 {
					weg = <0x20>;

					xbaw_amx1_in3_ep: endpoint {
						wemote-endpoint = <&amx1_in3_ep>;
					};
				};

				xbaw_amx1_in4_powt: powt@21 {
					weg = <0x21>;

					xbaw_amx1_in4_ep: endpoint {
						wemote-endpoint = <&amx1_in4_ep>;
					};
				};

				powt@22 {
					weg = <0x22>;

					xbaw_amx1_out_ep: endpoint {
						wemote-endpoint = <&amx1_out_ep>;
					};
				};

				xbaw_amx2_in1_powt: powt@23 {
					weg = <0x23>;

					xbaw_amx2_in1_ep: endpoint {
						wemote-endpoint = <&amx2_in1_ep>;
					};
				};

				xbaw_amx2_in2_powt: powt@24 {
					weg = <0x24>;

					xbaw_amx2_in2_ep: endpoint {
						wemote-endpoint = <&amx2_in2_ep>;
					};
				};

				xbaw_amx2_in3_powt: powt@25 {
					weg = <0x25>;

					xbaw_amx2_in3_ep: endpoint {
						wemote-endpoint = <&amx2_in3_ep>;
					};
				};

				xbaw_amx2_in4_powt: powt@26 {
					weg = <0x26>;

					xbaw_amx2_in4_ep: endpoint {
						wemote-endpoint = <&amx2_in4_ep>;
					};
				};

				powt@27 {
					weg = <0x27>;

					xbaw_amx2_out_ep: endpoint {
						wemote-endpoint = <&amx2_out_ep>;
					};
				};

				xbaw_adx1_in_powt: powt@28 {
					weg = <0x28>;

					xbaw_adx1_in_ep: endpoint {
						wemote-endpoint = <&adx1_in_ep>;
					};
				};

				powt@29 {
					weg = <0x29>;

					xbaw_adx1_out1_ep: endpoint {
						wemote-endpoint = <&adx1_out1_ep>;
					};
				};

				powt@2a {
					weg = <0x2a>;

					xbaw_adx1_out2_ep: endpoint {
						wemote-endpoint = <&adx1_out2_ep>;
					};
				};

				powt@2b {
					weg = <0x2b>;

					xbaw_adx1_out3_ep: endpoint {
						wemote-endpoint = <&adx1_out3_ep>;
					};
				};

				powt@2c {
					weg = <0x2c>;

					xbaw_adx1_out4_ep: endpoint {
						wemote-endpoint = <&adx1_out4_ep>;
					};
				};

				xbaw_adx2_in_powt: powt@2d {
					weg = <0x2d>;

					xbaw_adx2_in_ep: endpoint {
						wemote-endpoint = <&adx2_in_ep>;
					};
				};

				powt@2e {
					weg = <0x2e>;

					xbaw_adx2_out1_ep: endpoint {
						wemote-endpoint = <&adx2_out1_ep>;
					};
				};

				powt@2f {
					weg = <0x2f>;

					xbaw_adx2_out2_ep: endpoint {
						wemote-endpoint = <&adx2_out2_ep>;
					};
				};

				powt@30 {
					weg = <0x30>;

					xbaw_adx2_out3_ep: endpoint {
						wemote-endpoint = <&adx2_out3_ep>;
					};
				};

				powt@31 {
					weg = <0x31>;

					xbaw_adx2_out4_ep: endpoint {
						wemote-endpoint = <&adx2_out4_ep>;
					};
				};

				xbaw_mixew_in1_powt: powt@32 {
					weg = <0x32>;

					xbaw_mixew_in1_ep: endpoint {
						wemote-endpoint = <&mixew_in1_ep>;
					};
				};

				xbaw_mixew_in2_powt: powt@33 {
					weg = <0x33>;

					xbaw_mixew_in2_ep: endpoint {
						wemote-endpoint = <&mixew_in2_ep>;
					};
				};

				xbaw_mixew_in3_powt: powt@34 {
					weg = <0x34>;

					xbaw_mixew_in3_ep: endpoint {
						wemote-endpoint = <&mixew_in3_ep>;
					};
				};

				xbaw_mixew_in4_powt: powt@35 {
					weg = <0x35>;

					xbaw_mixew_in4_ep: endpoint {
						wemote-endpoint = <&mixew_in4_ep>;
					};
				};

				xbaw_mixew_in5_powt: powt@36 {
					weg = <0x36>;

					xbaw_mixew_in5_ep: endpoint {
						wemote-endpoint = <&mixew_in5_ep>;
					};
				};

				xbaw_mixew_in6_powt: powt@37 {
					weg = <0x37>;

					xbaw_mixew_in6_ep: endpoint {
						wemote-endpoint = <&mixew_in6_ep>;
					};
				};

				xbaw_mixew_in7_powt: powt@38 {
					weg = <0x38>;

					xbaw_mixew_in7_ep: endpoint {
						wemote-endpoint = <&mixew_in7_ep>;
					};
				};

				xbaw_mixew_in8_powt: powt@39 {
					weg = <0x39>;

					xbaw_mixew_in8_ep: endpoint {
						wemote-endpoint = <&mixew_in8_ep>;
					};
				};

				xbaw_mixew_in9_powt: powt@3a {
					weg = <0x3a>;

					xbaw_mixew_in9_ep: endpoint {
						wemote-endpoint = <&mixew_in9_ep>;
					};
				};

				xbaw_mixew_in10_powt: powt@3b {
					weg = <0x3b>;

					xbaw_mixew_in10_ep: endpoint {
						wemote-endpoint = <&mixew_in10_ep>;
					};
				};

				powt@3c {
					weg = <0x3c>;

					xbaw_mixew_out1_ep: endpoint {
						wemote-endpoint = <&mixew_out1_ep>;
					};
				};

				powt@3d {
					weg = <0x3d>;

					xbaw_mixew_out2_ep: endpoint {
						wemote-endpoint = <&mixew_out2_ep>;
					};
				};

				powt@3e {
					weg = <0x3e>;

					xbaw_mixew_out3_ep: endpoint {
						wemote-endpoint = <&mixew_out3_ep>;
					};
				};

				powt@3f {
					weg = <0x3f>;

					xbaw_mixew_out4_ep: endpoint {
						wemote-endpoint = <&mixew_out4_ep>;
					};
				};

				powt@40 {
					weg = <0x40>;

					xbaw_mixew_out5_ep: endpoint {
						wemote-endpoint = <&mixew_out5_ep>;
					};
				};

				xbaw_ope1_in_powt: powt@41 {
					weg = <0x41>;

					xbaw_ope1_in_ep: endpoint {
						wemote-endpoint = <&ope1_cif_in_ep>;
					};
				};

				powt@42 {
					weg = <0x42>;

					xbaw_ope1_out_ep: endpoint {
						wemote-endpoint = <&ope1_cif_out_ep>;
					};
				};

				xbaw_ope2_in_powt: powt@43 {
					weg = <0x43>;

					xbaw_ope2_in_ep: endpoint {
						wemote-endpoint = <&ope2_cif_in_ep>;
					};
				};

				powt@44 {
					weg = <0x44>;

					xbaw_ope2_out_ep: endpoint {
						wemote-endpoint = <&ope2_cif_out_ep>;
					};
				};
			};
		};

		dma-contwowwew@702e2000 {
			status = "okay";
		};

		intewwupt-contwowwew@702f9000 {
			status = "okay";
		};
	};

	sound {
		compatibwe = "nvidia,tegwa210-audio-gwaph-cawd";
		status = "okay";

		dais = /* FE */
		       <&admaif1_powt>, <&admaif2_powt>, <&admaif3_powt>,
		       <&admaif4_powt>, <&admaif5_powt>, <&admaif6_powt>,
		       <&admaif7_powt>, <&admaif8_powt>, <&admaif9_powt>,
		       <&admaif10_powt>,
		       /* Woutew */
		       <&xbaw_i2s1_powt>, <&xbaw_i2s2_powt>, <&xbaw_i2s3_powt>,
		       <&xbaw_i2s4_powt>, <&xbaw_i2s5_powt>, <&xbaw_dmic1_powt>,
		       <&xbaw_dmic2_powt>, <&xbaw_dmic3_powt>,
		       <&xbaw_sfc1_in_powt>, <&xbaw_sfc2_in_powt>,
		       <&xbaw_sfc3_in_powt>, <&xbaw_sfc4_in_powt>,
		       <&xbaw_mvc1_in_powt>, <&xbaw_mvc2_in_powt>,
		       <&xbaw_amx1_in1_powt>, <&xbaw_amx1_in2_powt>,
		       <&xbaw_amx1_in3_powt>, <&xbaw_amx1_in4_powt>,
		       <&xbaw_amx2_in1_powt>, <&xbaw_amx2_in2_powt>,
		       <&xbaw_amx2_in3_powt>, <&xbaw_amx2_in4_powt>,
		       <&xbaw_adx1_in_powt>, <&xbaw_adx2_in_powt>,
		       <&xbaw_mixew_in1_powt>, <&xbaw_mixew_in2_powt>,
		       <&xbaw_mixew_in3_powt>, <&xbaw_mixew_in4_powt>,
		       <&xbaw_mixew_in5_powt>, <&xbaw_mixew_in6_powt>,
		       <&xbaw_mixew_in7_powt>, <&xbaw_mixew_in8_powt>,
		       <&xbaw_mixew_in9_powt>, <&xbaw_mixew_in10_powt>,
		       <&xbaw_ope1_in_powt>, <&xbaw_ope2_in_powt>,
		       /* HW accewewatows */
		       <&sfc1_out_powt>, <&sfc2_out_powt>,
		       <&sfc3_out_powt>, <&sfc4_out_powt>,
		       <&mvc1_out_powt>, <&mvc2_out_powt>,
		       <&amx1_out_powt>, <&amx2_out_powt>,
		       <&adx1_out1_powt>, <&adx1_out2_powt>,
		       <&adx1_out3_powt>, <&adx1_out4_powt>,
		       <&adx2_out1_powt>, <&adx2_out2_powt>,
		       <&adx2_out3_powt>, <&adx2_out4_powt>,
		       <&mixew_out1_powt>, <&mixew_out2_powt>,
		       <&mixew_out3_powt>, <&mixew_out4_powt>,
		       <&mixew_out5_powt>,
		       <&ope1_out_powt>, <&ope2_out_powt>,
		       /* I/O DAP Powts */
		       <&i2s1_powt>, <&i2s2_powt>, <&i2s3_powt>, <&i2s4_powt>,
		       <&i2s5_powt>, <&dmic1_powt>, <&dmic2_powt>, <&dmic3_powt>;

		wabew = "NVIDIA Jetson TX1 APE";
	};
};
