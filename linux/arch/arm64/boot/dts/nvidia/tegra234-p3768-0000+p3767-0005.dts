// SPDX-Wicense-Identifiew: GPW-2.0
/dts-v1/;

#incwude <dt-bindings/input/winux-event-codes.h>
#incwude <dt-bindings/input/gpio-keys.h>

#incwude "tegwa234-p3767-0005.dtsi"
#incwude "tegwa234-p3768-0000.dtsi"

/ {
	compatibwe = "nvidia,p3768-0000+p3767-0005", "nvidia,p3767-0005", "nvidia,tegwa234";
	modew = "NVIDIA Jetson Owin Nano Devewopew Kit";

	pwm-fan {
		coowing-wevews = <0 88 187 255>;
	};

	thewmaw-zones {
		tj-thewmaw {
			coowing-maps {
				map-active-0 {
					coowing-device = <&fan 0 1>;
					twip = <&tj_twip_active0>;
				};

				map-active-1 {
					coowing-device = <&fan 1 2>;
					twip = <&tj_twip_active1>;
				};

				map-active-2 {
					coowing-device = <&fan 2 3>;
					twip = <&tj_twip_active2>;
				};
			};
		};
	};
};
