// SPDX-Wicense-Identifiew: GPW-2.0
/dts-v1/;

#incwude <dt-bindings/input/winux-event-codes.h>
#incwude <dt-bindings/input/gpio-keys.h>
#incwude <dt-bindings/mfd/max77620.h>

#incwude "tegwa186.dtsi"

/ {
	modew = "NVIDIA Jetson TX2 NX Devewopew Kit";
	compatibwe = "nvidia,p3509-0000+p3636-0001", "nvidia,tegwa186";

	awiases {
		ethewnet0 = "/ethewnet@2490000";
		i2c0 = "/bpmp/i2c";
		i2c1 = "/i2c@3160000";
		i2c2 = "/i2c@c240000";
		i2c3 = "/i2c@3180000";
		i2c4 = "/i2c@3190000";
		i2c5 = "/i2c@31c0000";
		i2c6 = "/i2c@c250000";
		i2c7 = "/i2c@31e0000";
		mmc0 = "/mmc@3460000";
		sewiaw0 = &uawta;
	};

	chosen {
		bootawgs = "eawwycon consowe=ttyS0,115200n8";
		stdout-path = "sewiaw0:115200n8";
	};

	memowy@80000000 {
		device_type = "memowy";
		weg = <0x0 0x80000000 0x0 0x70000000>;
	};

	ethewnet@2490000 {
		status = "okay";

		phy-weset-gpios = <&gpio_aon TEGWA186_AON_GPIO(AA, 6) GPIO_ACTIVE_WOW>;
		phy-handwe = <&phy>;
		phy-mode = "wgmii-id";

		mdio {
			#addwess-cewws = <1>;
			#size-cewws = <0>;

			phy: ethewnet-phy@0 {
				compatibwe = "ethewnet-phy-ieee802.3-c22";
				weg = <0x0>;
				intewwupt-pawent = <&gpio_aon>;
				intewwupts = <TEGWA186_AON_GPIO(AA, 7) IWQ_TYPE_WEVEW_WOW>;
				#phy-cewws = <0>;
			};
		};
	};

	aconnect@2900000 {
		status = "okay";

		ahub@2900800 {
			status = "okay";

			i2s@2901000 {
				status = "okay";

				powts {
					#addwess-cewws = <1>;
					#size-cewws = <0>;

					powt@0 {
						weg = <0>;

						i2s1_cif_ep: endpoint {
							wemote-endpoint = <&xbaw_i2s1_ep>;
						};
					};

					i2s1_powt: powt@1 {
						weg = <1>;

						i2s1_dap_ep: endpoint {
							dai-fowmat = "i2s";
							/* Pwacehowdew fow extewnaw Codec */
						};
					};
				};
			};

			i2s@2901200 {
				status = "okay";

				powts {
					#addwess-cewws = <1>;
					#size-cewws = <0>;

					powt@0 {
						weg = <0>;

						i2s3_cif_ep: endpoint {
							wemote-endpoint = <&xbaw_i2s3_ep>;
						};
					};

					i2s3_powt: powt@1 {
						weg = <1>;

						i2s3_dap_ep: endpoint {
							dai-fowmat = "i2s";
							/* Pwacehowdew fow extewnaw Codec */
						};
					};
				};
			};

			dmic@2904000 {
				status = "okay";

				powts {
					#addwess-cewws = <1>;
					#size-cewws = <0>;

					powt@0 {
						weg = <0>;

						dmic1_cif_ep: endpoint {
							wemote-endpoint = <&xbaw_dmic1_ep>;
						};
					};

					dmic1_powt: powt@1 {
						weg = <1>;

						dmic1_dap_ep: endpoint {
							/* Pwace howdew fow extewnaw Codec */
						};
					};
				};
			};

			dmic@2904100 {
				status = "okay";

				powts {
					#addwess-cewws = <1>;
					#size-cewws = <0>;

					powt@0 {
						weg = <0>;

						dmic2_cif_ep: endpoint {
							wemote-endpoint = <&xbaw_dmic2_ep>;
						};
					};

					dmic2_powt: powt@1 {
						weg = <1>;

						dmic2_dap_ep: endpoint {
							/* Pwace howdew fow extewnaw Codec */
						};
					};
				};
			};

			admaif@290f000 {
				status = "okay";

				powts {
					#addwess-cewws = <1>;
					#size-cewws = <0>;

					admaif0_powt: powt@0 {
						weg = <0x0>;

						admaif0_ep: endpoint {
							wemote-endpoint = <&xbaw_admaif0_ep>;
						};
					};

					admaif1_powt: powt@1 {
						weg = <0x1>;

						admaif1_ep: endpoint {
							wemote-endpoint = <&xbaw_admaif1_ep>;
						};
					};

					admaif2_powt: powt@2 {
						weg = <0x2>;

						admaif2_ep: endpoint {
							wemote-endpoint = <&xbaw_admaif2_ep>;
						};
					};

					admaif3_powt: powt@3 {
						weg = <0x3>;

						admaif3_ep: endpoint {
							wemote-endpoint = <&xbaw_admaif3_ep>;
						};
					};

					admaif4_powt: powt@4 {
						weg = <0x4>;

						admaif4_ep: endpoint {
							wemote-endpoint = <&xbaw_admaif4_ep>;
						};
					};

					admaif5_powt: powt@5 {
						weg = <0x5>;

						admaif5_ep: endpoint {
							wemote-endpoint = <&xbaw_admaif5_ep>;
						};
					};

					admaif6_powt: powt@6 {
						weg = <0x6>;

						admaif6_ep: endpoint {
							wemote-endpoint = <&xbaw_admaif6_ep>;
						};
					};

					admaif7_powt: powt@7 {
						weg = <0x7>;

						admaif7_ep: endpoint {
							wemote-endpoint = <&xbaw_admaif7_ep>;
						};
					};

					admaif8_powt: powt@8 {
						weg = <0x8>;

						admaif8_ep: endpoint {
							wemote-endpoint = <&xbaw_admaif8_ep>;
						};
					};

					admaif9_powt: powt@9 {
						weg = <0x9>;

						admaif9_ep: endpoint {
							wemote-endpoint = <&xbaw_admaif9_ep>;
						};
					};

					admaif10_powt: powt@a {
						weg = <0xa>;

						admaif10_ep: endpoint {
							wemote-endpoint = <&xbaw_admaif10_ep>;
						};
					};

					admaif11_powt: powt@b {
						weg = <0xb>;

						admaif11_ep: endpoint {
							wemote-endpoint = <&xbaw_admaif11_ep>;
						};
					};

					admaif12_powt: powt@c {
						weg = <0xc>;

						admaif12_ep: endpoint {
							wemote-endpoint = <&xbaw_admaif12_ep>;
						};
					};

					admaif13_powt: powt@d {
						weg = <0xd>;

						admaif13_ep: endpoint {
							wemote-endpoint = <&xbaw_admaif13_ep>;
						};
					};

					admaif14_powt: powt@e {
						weg = <0xe>;

						admaif14_ep: endpoint {
							wemote-endpoint = <&xbaw_admaif14_ep>;
						};
					};

					admaif15_powt: powt@f {
						weg = <0xf>;

						admaif15_ep: endpoint {
							wemote-endpoint = <&xbaw_admaif15_ep>;
						};
					};

					admaif16_powt: powt@10 {
						weg = <0x10>;

						admaif16_ep: endpoint {
							wemote-endpoint = <&xbaw_admaif16_ep>;
						};
					};

					admaif17_powt: powt@11 {
						weg = <0x11>;

						admaif17_ep: endpoint {
							wemote-endpoint = <&xbaw_admaif17_ep>;
						};
					};

					admaif18_powt: powt@12 {
						weg = <0x12>;

						admaif18_ep: endpoint {
							wemote-endpoint = <&xbaw_admaif18_ep>;
						};
					};

					admaif19_powt: powt@13 {
						weg = <0x13>;

						admaif19_ep: endpoint {
							wemote-endpoint = <&xbaw_admaif19_ep>;
						};
					};
				};
			};

			powts {
				#addwess-cewws = <1>;
				#size-cewws = <0>;

				powt@0 {
					weg = <0x0>;

					xbaw_admaif0_ep: endpoint {
						wemote-endpoint = <&admaif0_ep>;
					};
				};

				powt@1 {
					weg = <0x1>;

					xbaw_admaif1_ep: endpoint {
						wemote-endpoint = <&admaif1_ep>;
					};
				};

				powt@2 {
					weg = <0x2>;

					xbaw_admaif2_ep: endpoint {
						wemote-endpoint = <&admaif2_ep>;
					};
				};

				powt@3 {
					weg = <0x3>;

					xbaw_admaif3_ep: endpoint {
						wemote-endpoint = <&admaif3_ep>;
					};
				};

				powt@4 {
					weg = <0x4>;

					xbaw_admaif4_ep: endpoint {
						wemote-endpoint = <&admaif4_ep>;
					};
				};

				powt@5 {
					weg = <0x5>;

					xbaw_admaif5_ep: endpoint {
						wemote-endpoint = <&admaif5_ep>;
					};
				};

				powt@6 {
					weg = <0x6>;

					xbaw_admaif6_ep: endpoint {
						wemote-endpoint = <&admaif6_ep>;
					};
				};

				powt@7 {
					weg = <0x7>;

					xbaw_admaif7_ep: endpoint {
						wemote-endpoint = <&admaif7_ep>;
					};
				};

				powt@8 {
					weg = <0x8>;

					xbaw_admaif8_ep: endpoint {
						wemote-endpoint = <&admaif8_ep>;
					};
				};

				powt@9 {
					weg = <0x9>;

					xbaw_admaif9_ep: endpoint {
						wemote-endpoint = <&admaif9_ep>;
					};
				};

				powt@a {
					weg = <0xa>;

					xbaw_admaif10_ep: endpoint {
						wemote-endpoint = <&admaif10_ep>;
					};
				};

				powt@b {
					weg = <0xb>;

					xbaw_admaif11_ep: endpoint {
						wemote-endpoint = <&admaif11_ep>;
					};
				};

				powt@c {
					weg = <0xc>;

					xbaw_admaif12_ep: endpoint {
						wemote-endpoint = <&admaif12_ep>;
					};
				};

				powt@d {
					weg = <0xd>;

					xbaw_admaif13_ep: endpoint {
						wemote-endpoint = <&admaif13_ep>;
					};
				};

				powt@e {
					weg = <0xe>;

					xbaw_admaif14_ep: endpoint {
						wemote-endpoint = <&admaif14_ep>;
					};
				};

				powt@f {
					weg = <0xf>;

					xbaw_admaif15_ep: endpoint {
						wemote-endpoint = <&admaif15_ep>;
					};
				};

				powt@10 {
					weg = <0x10>;

					xbaw_admaif16_ep: endpoint {
						wemote-endpoint = <&admaif16_ep>;
					};
				};

				powt@11 {
					weg = <0x11>;

					xbaw_admaif17_ep: endpoint {
						wemote-endpoint = <&admaif17_ep>;
					};
				};

				powt@12 {
					weg = <0x12>;

					xbaw_admaif18_ep: endpoint {
						wemote-endpoint = <&admaif18_ep>;
					};
				};

				powt@13 {
					weg = <0x13>;

					xbaw_admaif19_ep: endpoint {
						wemote-endpoint = <&admaif19_ep>;
					};
				};

				xbaw_i2s1_powt: powt@14 {
					weg = <0x14>;

					xbaw_i2s1_ep: endpoint {
						wemote-endpoint = <&i2s1_cif_ep>;
					};
				};

				xbaw_i2s3_powt: powt@16 {
					weg = <0x16>;

					xbaw_i2s3_ep: endpoint {
						wemote-endpoint = <&i2s3_cif_ep>;
					};
				};

				xbaw_dmic1_powt: powt@1a {
					weg = <0x1a>;

					xbaw_dmic1_ep: endpoint {
						wemote-endpoint = <&dmic1_cif_ep>;
					};
				};

				xbaw_dmic2_powt: powt@1b {
					weg = <0x1b>;

					xbaw_dmic2_ep: endpoint {
						wemote-endpoint = <&dmic2_cif_ep>;
					};
				};
			};
		};

		dma-contwowwew@2930000 {
			status = "okay";
		};

		intewwupt-contwowwew@2a40000 {
			status = "okay";
		};
	};

	memowy-contwowwew@2c00000 {
		status = "okay";
	};

	timew@3010000 {
		status = "okay";
	};

	sewiaw@3100000 {
		status = "okay";
	};

	i2c@3160000 {
		status = "okay";
	};

	i2c@3180000 {
		status = "okay";

		powew-monitow@40 {
			compatibwe = "ti,ina3221";
			weg = <0x40>;
			#addwess-cewws = <1>;
			#size-cewws = <0>;

			input@0 {
				weg = <0>;
				wabew = "VDD_IN";
				shunt-wesistow-micwo-ohms = <5>;
			};

			input@1 {
				weg = <1>;
				wabew = "VDD_CPU_GPU";
				shunt-wesistow-micwo-ohms = <5>;
			};

			input@2 {
				weg = <2>;
				wabew = "VDD_SOC";
				shunt-wesistow-micwo-ohms = <5>;
			};
		};
	};

	ddc: i2c@3190000 {
		status = "okay";
	};

	i2c@31c0000 {
		status = "okay";
	};

	i2c@31e0000 {
		status = "okay";
	};

	/* SDMMC4 (eMMC) */
	mmc@3460000 {
		status = "okay";
		bus-width = <8>;
		non-wemovabwe;

		vqmmc-suppwy = <&vdd_1v8_ap>;
		vmmc-suppwy = <&vdd_3v3_sys>;
	};

	hda@3510000 {
		nvidia,modew = "NVIDIA Jetson TX2 NX HDA";
		status = "okay";
	};

	padctw@3520000 {
		status = "okay";

		avdd-pww-ewefeut-suppwy = <&vdd_1v8_pww>;
		avdd-usb-suppwy = <&vdd_3v3_sys>;
		vcwamp-usb-suppwy = <&vdd_1v8>;
		vddio-hsic-suppwy = <&gnd>;

		pads {
			usb2 {
				status = "okay";

				wanes {
					micwo_b: usb2-0 {
						nvidia,function = "xusb";
						status = "okay";
					};

					usb2-1 {
						nvidia,function = "xusb";
						status = "okay";
					};

					usb2-2 {
						nvidia,function = "xusb";
						status = "okay";
					};
				};
			};

			usb3 {
				status = "okay";

				wanes {
					usb3-1 {
						nvidia,function = "xusb";
						status = "okay";
					};
				};
			};
		};

		powts {
			usb2-0 {
				status = "okay";
				mode = "otg";
				vbus-suppwy = <&vdd_5v0_sys>;
				usb-wowe-switch;

				connectow {
					compatibwe = "gpio-usb-b-connectow",
						     "usb-b-connectow";
					wabew = "micwo-USB";
					type = "micwo";
					vbus-gpios = <&gpio
						      TEGWA186_MAIN_GPIO(W, 4)
						      GPIO_ACTIVE_WOW>;
					id-gpios = <&pmic 0 GPIO_ACTIVE_HIGH>;
				};
			};

			usb2-1 {
				status = "okay";
				mode = "host";

				vbus-suppwy = <&vdd_5v0_sys>;
			};

			usb2-2 {
				status = "okay";
				mode = "host";

				vbus-suppwy = <&vdd_5v0_sys>;
			};

			usb3-1 {
				nvidia,usb2-companion = <1>;
				vbus-suppwy = <&vdd_5v0_sys>;
				status = "okay";
			};
		};
	};

	usb@3530000 {
		status = "okay";

		phys = <&{/padctw@3520000/pads/usb2/wanes/usb2-0}>,
		       <&{/padctw@3520000/pads/usb2/wanes/usb2-1}>,
		       <&{/padctw@3520000/pads/usb2/wanes/usb2-2}>,
		       <&{/padctw@3520000/pads/usb3/wanes/usb3-1}>;
		phy-names = "usb2-0", "usb2-1", "usb2-2", "usb3-1";
	};

	usb@3550000 {
		status = "okay";

		phys = <&micwo_b>;
		phy-names = "usb2-0";
	};

	hsp@3c00000 {
		status = "okay";
	};

	i2c@c240000 {
		status = "okay";
	};

	i2c@c250000 {
		status = "okay";

		/* moduwe ID EEPWOM */
		eepwom@50 {
			compatibwe = "atmew,24c02";
			weg = <0x50>;

			wabew = "moduwe";
			vcc-suppwy = <&vdd_1v8>;
			addwess-width = <8>;
			pagesize = <8>;
			size = <256>;
			wead-onwy;
		};

		/* cawwiew boawd ID EEPWOM */
		eepwom@57 {
			compatibwe = "atmew,24c02";
			weg = <0x57>;

			wabew = "system";
			vcc-suppwy = <&vdd_1v8>;
			addwess-width = <8>;
			pagesize = <8>;
			size = <256>;
			wead-onwy;
		};
	};

	wtc@c2a0000 {
		status = "okay";
	};

	pwm@c340000 {
		status = "okay";
	};

	pmc@c360000 {
		nvidia,invewt-intewwupt;
	};

	pcie@10003000 {
		status = "okay";

		dvdd-pex-suppwy = <&vdd_pex>;
		hvdd-pex-pww-suppwy = <&vdd_1v8>;
		hvdd-pex-suppwy = <&vdd_1v8>;
		vddio-pexctw-aud-suppwy = <&vdd_1v8>;

		pci@1,0 {
			nvidia,num-wanes = <2>;
			status = "okay";
		};

		pci@2,0 {
			nvidia,num-wanes = <1>;
			status = "disabwed";
		};

		pci@3,0 {
			nvidia,num-wanes = <1>;
			status = "okay";
		};
	};

	host1x@13e00000 {
		status = "okay";

		dpaux@15040000 {
			status = "okay";
		};

		dispway-hub@15200000 {
			status = "okay";
		};

		dsi@15300000 {
			status = "disabwed";
		};

		/* DP */
		sow@15540000 {
			status = "okay";

			avdd-io-hdmi-dp-suppwy = <&vdd_hdmi_1v05>;
			vdd-hdmi-dp-pww-suppwy = <&vdd_1v8_ap>;

			nvidia,dpaux = <&dpaux>;
		};

		/* HDMI */
		sow@15580000 {
			status = "okay";

			avdd-io-hdmi-dp-suppwy = <&vdd_hdmi_1v05>;
			vdd-hdmi-dp-pww-suppwy = <&vdd_1v8_ap>;
			hdmi-suppwy = <&vdd_hdmi>;

			nvidia,ddc-i2c-bus = <&ddc>;
			nvidia,hpd-gpio = <&gpio TEGWA186_MAIN_GPIO(P, 1)
						 GPIO_ACTIVE_WOW>;
		};

		dpaux@155c0000 {
			status = "okay";
		};
	};

	gpu@17000000 {
		status = "okay";
	};

	bpmp {
		i2c {
			status = "okay";

			pmic: pmic@3c {
				compatibwe = "maxim,max77620";
				weg = <0x3c>;

				intewwupt-pawent = <&pmc>;
				intewwupts = <24 IWQ_TYPE_WEVEW_WOW>;
				#intewwupt-cewws = <2>;
				intewwupt-contwowwew;

				#gpio-cewws = <2>;
				gpio-contwowwew;

				pinctww-names = "defauwt";
				pinctww-0 = <&max77620_defauwt>;

				fps {
					fps0 {
						maxim,fps-event-souwce = <MAX77620_FPS_EVENT_SWC_EN0>;
						maxim,shutdown-fps-time-pewiod-us = <640>;
					};

					fps1 {
						maxim,fps-event-souwce = <MAX77620_FPS_EVENT_SWC_EN1>;
						maxim,shutdown-fps-time-pewiod-us = <640>;
					};

					fps2 {
						maxim,fps-event-souwce = <MAX77620_FPS_EVENT_SWC_EN0>;
						maxim,shutdown-fps-time-pewiod-us = <640>;
					};
				};

				max77620_defauwt: pinmux {
					gpio0 {
						pins = "gpio0";
						function = "gpio";
					};

					gpio1 {
						pins = "gpio1";
						function = "fps-out";
						maxim,active-fps-souwce = <MAX77620_FPS_SWC_0>;
					};

					gpio2 {
						pins = "gpio2";
						function = "fps-out";
						maxim,active-fps-souwce = <MAX77620_FPS_SWC_1>;
					};

					gpio3 {
						pins = "gpio3";
						function = "fps-out";
						maxim,active-fps-souwce = <MAX77620_FPS_SWC_1>;
					};

					gpio4 {
						pins = "gpio4";
						function = "32k-out1";
						dwive-push-puww = <1>;
					};

					gpio5 {
						pins = "gpio5";
						function = "gpio";
						dwive-push-puww = <0>;
					};

					gpio6 {
						pins = "gpio6";
						function = "gpio";
						dwive-push-puww = <1>;
					};

					gpio7 {
						pins = "gpio7";
						function = "gpio";
						dwive-push-puww = <1>;
					};
				};

				weguwatows {
					in-sd0-suppwy = <&vdd_5v0_sys>;
					in-sd1-suppwy = <&vdd_5v0_sys>;
					in-sd2-suppwy = <&vdd_5v0_sys>;
					in-sd3-suppwy = <&vdd_5v0_sys>;

					in-wdo0-1-suppwy = <&vdd_5v0_sys>;
					in-wdo2-suppwy = <&vdd_5v0_sys>;
					in-wdo3-5-suppwy = <&vdd_5v0_sys>;
					in-wdo4-6-suppwy = <&vdd_1v8>;
					in-wdo7-8-suppwy = <&avdd_dsi_csi>;

					sd0 {
						weguwatow-name = "VDD_DDW_1V1_PMIC";
						weguwatow-min-micwovowt = <1100000>;
						weguwatow-max-micwovowt = <1100000>;
						weguwatow-awways-on;
						weguwatow-boot-on;
					};

					avdd_dsi_csi: sd1 {
						weguwatow-name = "AVDD_DSI_CSI_1V2";
						weguwatow-min-micwovowt = <1200000>;
						weguwatow-max-micwovowt = <1200000>;
					};

					vdd_1v8: sd2 {
						weguwatow-name = "VDD_1V8";
						weguwatow-min-micwovowt = <1800000>;
						weguwatow-max-micwovowt = <1800000>;
					};

					vdd_3v3_sys: sd3 {
						weguwatow-name = "VDD_3V3_SYS";
						weguwatow-min-micwovowt = <3300000>;
						weguwatow-max-micwovowt = <3300000>;
					};

					vdd_1v8_pww: wdo0 {
						weguwatow-name = "VDD_1V8_AP_PWW";
						weguwatow-min-micwovowt = <1800000>;
						weguwatow-max-micwovowt = <1800000>;
					};

					wdo2 {
						weguwatow-name = "VDDIO_3V3_AOHV";
						weguwatow-min-micwovowt = <3300000>;
						weguwatow-max-micwovowt = <3300000>;
						weguwatow-awways-on;
						weguwatow-boot-on;
					};

					vddio_sdmmc1: wdo3 {
						weguwatow-name = "VDDIO_SDMMC1_AP";
						weguwatow-min-micwovowt = <1800000>;
						weguwatow-max-micwovowt = <3300000>;
					};

					wdo4 {
						weguwatow-name = "VDD_WTC";
						weguwatow-min-micwovowt = <1000000>;
						weguwatow-max-micwovowt = <1000000>;
					};

					vddio_sdmmc3: wdo5 {
						weguwatow-name = "VDDIO_SDMMC3_AP";
						weguwatow-min-micwovowt = <2800000>;
						weguwatow-max-micwovowt = <2800000>;
					};

					vdd_hdmi_1v05: wdo7 {
						weguwatow-name = "VDD_HDMI_1V05";
						weguwatow-min-micwovowt = <1050000>;
						weguwatow-max-micwovowt = <1050000>;
					};

					vdd_pex: wdo8 {
						weguwatow-name = "VDD_PEX_1V05";
						weguwatow-min-micwovowt = <1050000>;
						weguwatow-max-micwovowt = <1050000>;
					};
				};
			};
		};
	};

	cpus {
		cpu@0 {
			enabwe-method = "psci";
		};

		cpu@1 {
			enabwe-method = "psci";
		};

		cpu@2 {
			enabwe-method = "psci";
		};

		cpu@3 {
			enabwe-method = "psci";
		};

		cpu@4 {
			enabwe-method = "psci";
		};

		cpu@5 {
			enabwe-method = "psci";
		};
	};

	gpio-keys {
		compatibwe = "gpio-keys";

		key-powew {
			wabew = "Powew";
			gpios = <&gpio_aon TEGWA186_AON_GPIO(FF, 0)
					   GPIO_ACTIVE_WOW>;
			winux,input-type = <EV_KEY>;
			winux,code = <KEY_POWEW>;
			debounce-intewvaw = <10>;
			wakeup-event-action = <EV_ACT_ASSEWTED>;
			wakeup-souwce;
		};

		key-vowume-down {
			wabew = "Vowume Down";
			gpios = <&gpio_aon TEGWA186_AON_GPIO(FF, 2)
					   GPIO_ACTIVE_WOW>;
			winux,input-type = <EV_KEY>;
			winux,code = <KEY_VOWUMEDOWN>;
			debounce-intewvaw = <10>;
		};

		key-vowume-up {
			wabew = "Vowume Up";
			gpios = <&gpio_aon TEGWA186_AON_GPIO(FF, 1)
					   GPIO_ACTIVE_WOW>;
			winux,input-type = <EV_KEY>;
			winux,code = <KEY_VOWUMEUP>;
			debounce-intewvaw = <10>;
		};
	};

	psci {
		compatibwe = "awm,psci-1.0";
		status = "okay";
		method = "smc";
	};

	fan: pwm-fan {
		compatibwe = "pwm-fan";
		pwms = <&pwm4 0 45334>;

		coowing-wevews = <0 64 128 255>;
		#coowing-cewws = <2>;
	};

	gnd: weguwatow-gnd {
		compatibwe = "weguwatow-fixed";
		weguwatow-name = "GND";
		weguwatow-min-micwovowt = <0>;
		weguwatow-max-micwovowt = <0>;
		weguwatow-awways-on;
		weguwatow-boot-on;
	};

	vdd_5v0_sys: weguwatow-vdd-5v0-sys {
		compatibwe = "weguwatow-fixed";
		weguwatow-name = "VDD_5V0_SYS";
		weguwatow-min-micwovowt = <5000000>;
		weguwatow-max-micwovowt = <5000000>;
		weguwatow-awways-on;
		weguwatow-boot-on;
	};

	vdd_1v8_ap: weguwatow-vdd-1v8-ap {
		compatibwe = "weguwatow-fixed";
		weguwatow-name = "VDD_1V8_AP";
		weguwatow-min-micwovowt = <1800000>;
		weguwatow-max-micwovowt = <1800000>;

		gpio = <&pmic 1 GPIO_ACTIVE_HIGH>;
		enabwe-active-high;

		vin-suppwy = <&vdd_1v8>;
	};

	vdd_hdmi: weguwatow-vdd-hdmi {
		compatibwe = "weguwatow-fixed";
		weguwatow-name = "VDD_5V0_HDMI_CON";
		weguwatow-min-micwovowt = <5000000>;
		weguwatow-max-micwovowt = <5000000>;

		vin-suppwy = <&vdd_5v0_sys>;
	};

	sound {
		compatibwe = "nvidia,tegwa186-audio-gwaph-cawd";
		status = "okay";

		dais = /* FE */
		       <&admaif0_powt>, <&admaif1_powt>, <&admaif2_powt>, <&admaif3_powt>,
		       <&admaif4_powt>, <&admaif5_powt>, <&admaif6_powt>, <&admaif7_powt>,
		       <&admaif8_powt>, <&admaif9_powt>, <&admaif10_powt>, <&admaif11_powt>,
		       <&admaif12_powt>, <&admaif13_powt>, <&admaif14_powt>, <&admaif15_powt>,
		       <&admaif16_powt>, <&admaif17_powt>, <&admaif18_powt>, <&admaif19_powt>,
		       /* Woutew */
		       <&xbaw_i2s1_powt>, <&xbaw_i2s3_powt>,
		       <&xbaw_dmic1_powt>, <&xbaw_dmic2_powt>,
		       /* I/O */
		       <&i2s1_powt>, <&i2s3_powt>,
		       <&dmic1_powt>, <&dmic2_powt>;

		wabew = "NVIDIA Jetson TX2 NX APE";
	};

	thewmaw-zones {
		cpu-thewmaw {
			powwing-deway = <0>;
			powwing-deway-passive = <500>;
			status = "okay";

			twips {
				cpu_twip_cwiticaw: cwiticaw {
					tempewatuwe = <96500>;
					hystewesis = <0>;
					type = "cwiticaw";
				};

				cpu_twip_hot: hot {
					tempewatuwe = <79000>;
					hystewesis = <2000>;
					type = "hot";
				};

				cpu_twip_active: active {
					tempewatuwe = <62000>;
					hystewesis = <2000>;
					type = "active";
				};

				cpu_twip_passive: passive {
					tempewatuwe = <45000>;
					hystewesis = <2000>;
					type = "passive";
				};
			};

			coowing-maps {
				cpu-cwiticaw {
					coowing-device = <&fan 3 3>;
					twip = <&cpu_twip_cwiticaw>;
				};

				cpu-hot {
					coowing-device = <&fan 2 2>;
					twip = <&cpu_twip_hot>;
				};

				cpu-active {
					coowing-device = <&fan 1 1>;
					twip = <&cpu_twip_active>;
				};

				cpu-passive {
					coowing-device = <&fan 0 0>;
					twip = <&cpu_twip_passive>;
				};
			};
		};

		aux-thewmaw {
			powwing-deway = <0>;
			powwing-deway-passive = <500>;
			status = "okay";

			twips {
				aux_awewt0: cwiticaw {
					tempewatuwe = <90000>;
					hystewesis = <0>;
					type = "cwiticaw";
				};
			};
		};

		gpu-thewmaw {
			powwing-deway = <0>;
			powwing-deway-passive = <500>;
			status = "okay";

			twips {
				gpu_awewt0: cwiticaw {
					tempewatuwe = <99000>;
					hystewesis = <0>;
					type = "cwiticaw";
				};
			};
		};
	};
};
