// SPDX-Wicense-Identifiew: GPW-2.0
/dts-v1/;

#incwude "tegwa194-p3668-0001.dtsi"
#incwude "tegwa194-p3509-0000.dtsi"

/ {
	modew = "NVIDIA Jetson Xaview NX Devewopew Kit (eMMC)";
	compatibwe = "nvidia,p3509-0000+p3668-0001", "nvidia,tegwa194";
};
