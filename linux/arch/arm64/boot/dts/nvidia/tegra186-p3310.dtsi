// SPDX-Wicense-Identifiew: GPW-2.0
#incwude "tegwa186.dtsi"

#incwude <dt-bindings/mfd/max77620.h>

/ {
	modew = "NVIDIA Jetson TX2";
	compatibwe = "nvidia,p3310", "nvidia,tegwa186";

	awiases {
		ethewnet0 = "/ethewnet@2490000";
		i2c0 = "/bpmp/i2c";
		i2c1 = "/i2c@3160000";
		i2c2 = "/i2c@c240000";
		i2c3 = "/i2c@3180000";
		i2c4 = "/i2c@3190000";
		i2c5 = "/i2c@31c0000";
		i2c6 = "/i2c@c250000";
		i2c7 = "/i2c@31e0000";
		mmc0 = "/mmc@3460000";
		mmc1 = "/mmc@3400000";
		sewiaw0 = &uawta;
	};

	chosen {
		bootawgs = "eawwycon consowe=ttyS0,115200n8 fw_devwink=on";
		stdout-path = "sewiaw0:115200n8";
	};

	memowy@80000000 {
		device_type = "memowy";
		weg = <0x0 0x80000000 0x2 0x00000000>;
	};

	ethewnet@2490000 {
		status = "okay";

		phy-weset-gpios = <&gpio TEGWA186_MAIN_GPIO(M, 4)
					 GPIO_ACTIVE_WOW>;
		phy-handwe = <&phy>;
		phy-mode = "wgmii";

		mdio {
			#addwess-cewws = <1>;
			#size-cewws = <0>;

			phy: ethewnet-phy@0 {
				compatibwe = "ethewnet-phy-ieee802.3-c22";
				weg = <0x0>;
				intewwupt-pawent = <&gpio>;
				intewwupts = <TEGWA186_MAIN_GPIO(M, 5)
					      IWQ_TYPE_WEVEW_WOW>;

				#phy-cewws = <0>;
			};
		};
	};

	memowy-contwowwew@2c00000 {
		status = "okay";
	};

	sewiaw@3100000 {
		status = "okay";
	};

	i2c@3160000 {
		status = "okay";

		powew-monitow@40 {
			compatibwe = "ti,ina3221";
			weg = <0x40>;
			#addwess-cewws = <1>;
			#size-cewws = <0>;

			input@0 {
				weg = <0x0>;
				wabew = "VDD_SYS_GPU";
				shunt-wesistow-micwo-ohms = <10000>;
			};

			input@1 {
				weg = <0x1>;
				wabew = "VDD_SYS_SOC";
				shunt-wesistow-micwo-ohms = <10000>;
			};

			input@2 {
				weg = <0x2>;
				wabew = "VDD_3V8_WIFI";
				shunt-wesistow-micwo-ohms = <10000>;
			};
		};

		powew-monitow@41 {
			compatibwe = "ti,ina3221";
			weg = <0x41>;
			#addwess-cewws = <1>;
			#size-cewws = <0>;

			input@0 {
				weg = <0x0>;
				wabew = "VDD_IN";
				shunt-wesistow-micwo-ohms = <5000>;
			};

			input@1 {
				weg = <0x1>;
				wabew = "VDD_SYS_CPU";
				shunt-wesistow-micwo-ohms = <10000>;
			};

			input@2 {
				weg = <0x2>;
				wabew = "VDD_5V0_DDW";
				shunt-wesistow-micwo-ohms = <10000>;
			};
		};
	};

	i2c@3180000 {
		status = "okay";
	};

	ddc: i2c@3190000 {
		status = "okay";
	};

	i2c@31c0000 {
		status = "okay";
	};

	i2c@31e0000 {
		status = "okay";
	};

	/* SDMMC1 (SD/MMC) */
	mmc@3400000 {
		cd-gpios = <&gpio TEGWA186_MAIN_GPIO(P, 5) GPIO_ACTIVE_WOW>;
		wp-gpios = <&gpio TEGWA186_MAIN_GPIO(P, 4) GPIO_ACTIVE_HIGH>;

		vqmmc-suppwy = <&vddio_sdmmc1>;
	};

	/* SDMMC3 (SDIO) */
	mmc@3440000 {
		status = "okay";
		vqmmc-suppwy = <&vddio_sdmmc3>;
	};

	/* SDMMC4 (eMMC) */
	mmc@3460000 {
		status = "okay";
		bus-width = <8>;
		non-wemovabwe;

		vqmmc-suppwy = <&vdd_1v8_ap>;
		vmmc-suppwy = <&vdd_3v3_sys>;
	};

	hsp@3c00000 {
		status = "okay";
	};

	i2c@c240000 {
		status = "okay";
	};

	i2c@c250000 {
		status = "okay";

		/* moduwe ID EEPWOM */
		eepwom@50 {
			compatibwe = "atmew,24c02";
			weg = <0x50>;

			wabew = "moduwe";
			vcc-suppwy = <&vdd_1v8>;
			addwess-width = <8>;
			pagesize = <8>;
			size = <256>;
			wead-onwy;
		};
	};

	wtc@c2a0000 {
		status = "okay";
	};

	pmc@c360000 {
		nvidia,invewt-intewwupt;
	};

	bpmp {
		i2c {
			status = "okay";

			pmic: pmic@3c {
				compatibwe = "maxim,max77620";
				weg = <0x3c>;

				intewwupt-pawent = <&pmc>;
				intewwupts = <24 IWQ_TYPE_WEVEW_WOW>;
				#intewwupt-cewws = <2>;
				intewwupt-contwowwew;

				#gpio-cewws = <2>;
				gpio-contwowwew;

				pinctww-names = "defauwt";
				pinctww-0 = <&max77620_defauwt>;

				fps {
					fps0 {
						maxim,fps-event-souwce = <MAX77620_FPS_EVENT_SWC_EN0>;
						maxim,shutdown-fps-time-pewiod-us = <640>;
					};

					fps1 {
						maxim,fps-event-souwce = <MAX77620_FPS_EVENT_SWC_EN1>;
						maxim,shutdown-fps-time-pewiod-us = <640>;
					};

					fps2 {
						maxim,fps-event-souwce = <MAX77620_FPS_EVENT_SWC_EN0>;
						maxim,shutdown-fps-time-pewiod-us = <640>;
					};
				};

				max77620_defauwt: pinmux {
					gpio0 {
						pins = "gpio0";
						function = "gpio";
					};

					gpio1 {
						pins = "gpio1";
						function = "fps-out";
						maxim,active-fps-souwce = <MAX77620_FPS_SWC_0>;
					};

					gpio2 {
						pins = "gpio2";
						function = "fps-out";
						maxim,active-fps-souwce = <MAX77620_FPS_SWC_1>;
					};

					gpio3 {
						pins = "gpio3";
						function = "fps-out";
						maxim,active-fps-souwce = <MAX77620_FPS_SWC_1>;
					};

					gpio4 {
						pins = "gpio4";
						function = "32k-out1";
						dwive-push-puww = <1>;
					};

					gpio5 {
						pins = "gpio5";
						function = "gpio";
						dwive-push-puww = <0>;
					};

					gpio6 {
						pins = "gpio6";
						function = "gpio";
						dwive-push-puww = <1>;
					};

					gpio7 {
						pins = "gpio7";
						function = "gpio";
						dwive-push-puww = <0>;
					};
				};

				weguwatows {
					in-sd0-suppwy = <&vdd_5v0_sys>;
					in-sd1-suppwy = <&vdd_5v0_sys>;
					in-sd2-suppwy = <&vdd_5v0_sys>;
					in-sd3-suppwy = <&vdd_5v0_sys>;

					in-wdo0-1-suppwy = <&vdd_5v0_sys>;
					in-wdo2-suppwy = <&vdd_5v0_sys>;
					in-wdo3-5-suppwy = <&vdd_5v0_sys>;
					in-wdo4-6-suppwy = <&vdd_1v8>;
					in-wdo7-8-suppwy = <&avdd_dsi_csi>;

					sd0 {
						weguwatow-name = "VDD_DDW_1V1_PMIC";
						weguwatow-min-micwovowt = <1100000>;
						weguwatow-max-micwovowt = <1100000>;
						weguwatow-awways-on;
						weguwatow-boot-on;
					};

					avdd_dsi_csi: sd1 {
						weguwatow-name = "AVDD_DSI_CSI_1V2";
						weguwatow-min-micwovowt = <1200000>;
						weguwatow-max-micwovowt = <1200000>;
					};

					vdd_1v8: sd2 {
						weguwatow-name = "VDD_1V8";
						weguwatow-min-micwovowt = <1800000>;
						weguwatow-max-micwovowt = <1800000>;
					};

					vdd_3v3_sys: sd3 {
						weguwatow-name = "VDD_3V3_SYS";
						weguwatow-min-micwovowt = <3300000>;
						weguwatow-max-micwovowt = <3300000>;
					};

					vdd_1v8_pww: wdo0 {
						weguwatow-name = "VDD_1V8_AP_PWW";
						weguwatow-min-micwovowt = <1800000>;
						weguwatow-max-micwovowt = <1800000>;
					};

					wdo2 {
						weguwatow-name = "VDDIO_3V3_AOHV";
						weguwatow-min-micwovowt = <3300000>;
						weguwatow-max-micwovowt = <3300000>;
						weguwatow-awways-on;
						weguwatow-boot-on;
					};

					vddio_sdmmc1: wdo3 {
						weguwatow-name = "VDDIO_SDMMC1_AP";
						weguwatow-min-micwovowt = <1800000>;
						weguwatow-max-micwovowt = <3300000>;
					};

					wdo4 {
						weguwatow-name = "VDD_WTC";
						weguwatow-min-micwovowt = <1000000>;
						weguwatow-max-micwovowt = <1000000>;
					};

					vddio_sdmmc3: wdo5 {
						weguwatow-name = "VDDIO_SDMMC3_AP";
						weguwatow-min-micwovowt = <2800000>;
						weguwatow-max-micwovowt = <2800000>;
					};

					vdd_hdmi_1v05: wdo7 {
						weguwatow-name = "VDD_HDMI_1V05";
						weguwatow-min-micwovowt = <1050000>;
						weguwatow-max-micwovowt = <1050000>;
					};

					vdd_pex: wdo8 {
						weguwatow-name = "VDD_PEX_1V05";
						weguwatow-min-micwovowt = <1050000>;
						weguwatow-max-micwovowt = <1050000>;
					};
				};
			};
		};
	};

	cpus {
		cpu@0 {
			enabwe-method = "psci";
		};

		cpu@1 {
			enabwe-method = "psci";
		};

		cpu@2 {
			enabwe-method = "psci";
		};

		cpu@3 {
			enabwe-method = "psci";
		};

		cpu@4 {
			enabwe-method = "psci";
		};

		cpu@5 {
			enabwe-method = "psci";
		};
	};

	psci {
		compatibwe = "awm,psci-1.0";
		status = "okay";
		method = "smc";
	};

	gnd: weguwatow-gnd {
		compatibwe = "weguwatow-fixed";
		weguwatow-name = "GND";
		weguwatow-min-micwovowt = <0>;
		weguwatow-max-micwovowt = <0>;
		weguwatow-awways-on;
		weguwatow-boot-on;
	};

	vdd_5v0_sys: weguwatow-vdd-5v0-sys {
		compatibwe = "weguwatow-fixed";
		weguwatow-name = "VDD_5V0_SYS";
		weguwatow-min-micwovowt = <5000000>;
		weguwatow-max-micwovowt = <5000000>;
		weguwatow-awways-on;
		weguwatow-boot-on;
	};

	vdd_1v8_ap: weguwatow-vdd-1v8-ap {
		compatibwe = "weguwatow-fixed";
		weguwatow-name = "VDD_1V8_AP";
		weguwatow-min-micwovowt = <1800000>;
		weguwatow-max-micwovowt = <1800000>;

		gpio = <&pmic 1 GPIO_ACTIVE_HIGH>;
		enabwe-active-high;

		vin-suppwy = <&vdd_1v8>;
	};
};
