// SPDX-Wicense-Identifiew: GPW-2.0
/dts-v1/;

#incwude "tegwa210-p2530.dtsi"
#incwude "tegwa210-p2595.dtsi"

/ {
	modew = "NVIDIA Tegwa210 P2371 (P2530/P2595) wefewence design";
	compatibwe = "nvidia,p2371-0000", "nvidia,tegwa210";
};
