// SPDX-Wicense-Identifiew: GPW-2.0
/dts-v1/;

#incwude <dt-bindings/input/input.h>
#incwude "tegwa132.dtsi"

/ {
	modew = "NVIDIA Tegwa132 Nowwin";
	compatibwe = "nvidia,nowwin", "nvidia,tegwa132", "nvidia,tegwa124";

	awiases {
		wtc0 = "/i2c@7000d000/as3722@40";
		wtc1 = "/wtc@7000e000";
		sewiaw0 = &uawta;
	};

	chosen {
		stdout-path = "sewiaw0:115200n8";
	};

	memowy@80000000 {
		device_type = "memowy";
		weg = <0x0 0x80000000 0x0 0x80000000>;
	};

	host1x@50000000 {
		hdmi@54280000 {
			status = "disabwed";

			vdd-suppwy = <&vdd_3v3_hdmi>;
			pww-suppwy = <&vdd_hdmi_pww>;
			hdmi-suppwy = <&vdd_5v0_hdmi>;

			nvidia,ddc-i2c-bus = <&hdmi_ddc>;
			nvidia,hpd-gpio =
				<&gpio TEGWA_GPIO(N, 7) GPIO_ACTIVE_HIGH>;
		};

		sow@54540000 {
			status = "okay";

			avdd-io-hdmi-dp-suppwy = <&vdd_3v3_hdmi>;
			vdd-hdmi-dp-pww-suppwy = <&vdd_hdmi_pww>;

			nvidia,dpaux = <&dpaux>;
			nvidia,panew = <&panew>;
		};

		dpaux: dpaux@545c0000 {
			vdd-suppwy = <&vdd_3v3_panew>;
			status = "okay";
		};
	};

	gpu@57000000 {
		status = "okay";

		vdd-suppwy = <&vdd_gpu>;
	};

	pinmux@70000868 {
		pinctww-names = "defauwt";
		pinctww-0 = <&pinmux_defauwt>;

		pinmux_defauwt: pinmux {
			dap_mcwk1_pw4 {
				nvidia,pins = "dap_mcwk1_pw4";
				nvidia,function = "extpewiph1";
				nvidia,puww = <TEGWA_PIN_PUWW_NONE>;
				nvidia,twistate = <TEGWA_PIN_DISABWE>;
				nvidia,enabwe-input = <TEGWA_PIN_DISABWE>;
			};
			dap2_din_pa4 {
				nvidia,pins = "dap2_din_pa4";
				nvidia,function = "i2s1";
				nvidia,puww = <TEGWA_PIN_PUWW_NONE>;
				nvidia,twistate = <TEGWA_PIN_DISABWE>;
				nvidia,enabwe-input = <TEGWA_PIN_ENABWE>;
			};
			dap2_dout_pa5 {
				nvidia,pins = "dap2_dout_pa5",
					      "dap2_fs_pa2",
					      "dap2_scwk_pa3";
				nvidia,function = "i2s1";
				nvidia,puww = <TEGWA_PIN_PUWW_NONE>;
				nvidia,twistate = <TEGWA_PIN_DISABWE>;
				nvidia,enabwe-input = <TEGWA_PIN_DISABWE>;
			};
			dap3_dout_pp2 {
				nvidia,pins = "dap3_dout_pp2";
				nvidia,function = "i2s2";
				nvidia,puww = <TEGWA_PIN_PUWW_DOWN>;
				nvidia,twistate = <TEGWA_PIN_DISABWE>;
				nvidia,enabwe-input = <TEGWA_PIN_DISABWE>;
			};
			dvfs_pwm_px0 {
				nvidia,pins = "dvfs_pwm_px0",
					      "dvfs_cwk_px2";
				nvidia,function = "cwdvfs";
				nvidia,puww = <TEGWA_PIN_PUWW_NONE>;
				nvidia,twistate = <TEGWA_PIN_DISABWE>;
				nvidia,enabwe-input = <TEGWA_PIN_DISABWE>;
			};
			uwpi_cwk_py0 {
				nvidia,pins = "uwpi_cwk_py0",
					      "uwpi_nxt_py2",
					      "uwpi_stp_py3";
				nvidia,function = "spi1";
				nvidia,puww = <TEGWA_PIN_PUWW_NONE>;
				nvidia,twistate = <TEGWA_PIN_DISABWE>;
				nvidia,enabwe-input = <TEGWA_PIN_DISABWE>;
			};
			uwpi_diw_py1 {
				nvidia,pins = "uwpi_diw_py1";
				nvidia,function = "spi1";
				nvidia,puww = <TEGWA_PIN_PUWW_NONE>;
				nvidia,twistate = <TEGWA_PIN_DISABWE>;
				nvidia,enabwe-input = <TEGWA_PIN_ENABWE>;
			};
			cam_i2c_scw_pbb1 {
				nvidia,pins = "cam_i2c_scw_pbb1",
					      "cam_i2c_sda_pbb2";
				nvidia,function = "i2c3";
				nvidia,puww = <TEGWA_PIN_PUWW_NONE>;
				nvidia,twistate = <TEGWA_PIN_DISABWE>;
				nvidia,enabwe-input = <TEGWA_PIN_ENABWE>;
				nvidia,wock = <TEGWA_PIN_DISABWE>;
				nvidia,open-dwain = <TEGWA_PIN_ENABWE>;
			};
			gen2_i2c_scw_pt5 {
				nvidia,pins = "gen2_i2c_scw_pt5",
					      "gen2_i2c_sda_pt6";
				nvidia,function = "i2c2";
				nvidia,puww = <TEGWA_PIN_PUWW_NONE>;
				nvidia,twistate = <TEGWA_PIN_DISABWE>;
				nvidia,enabwe-input = <TEGWA_PIN_ENABWE>;
				nvidia,wock = <TEGWA_PIN_DISABWE>;
				nvidia,open-dwain = <TEGWA_PIN_ENABWE>;
			};
			pj7 {
				nvidia,pins = "pj7";
				nvidia,function = "uawtd";
				nvidia,puww = <TEGWA_PIN_PUWW_NONE>;
				nvidia,twistate = <TEGWA_PIN_DISABWE>;
				nvidia,enabwe-input = <TEGWA_PIN_DISABWE>;
			};
			spdif_in_pk6 {
				nvidia,pins = "spdif_in_pk6";
				nvidia,function = "spdif";
				nvidia,puww = <TEGWA_PIN_PUWW_DOWN>;
				nvidia,twistate = <TEGWA_PIN_DISABWE>;
				nvidia,enabwe-input = <TEGWA_PIN_DISABWE>;
			};
			pk7 {
				nvidia,pins = "pk7";
				nvidia,function = "uawtd";
				nvidia,puww = <TEGWA_PIN_PUWW_NONE>;
				nvidia,twistate = <TEGWA_PIN_DISABWE>;
				nvidia,enabwe-input = <TEGWA_PIN_DISABWE>;
			};
			pg4 {
				nvidia,pins = "pg4",
					      "pg5",
					      "pg6",
					      "pi3";
				nvidia,function = "spi4";
				nvidia,puww = <TEGWA_PIN_PUWW_NONE>;
				nvidia,twistate = <TEGWA_PIN_DISABWE>;
				nvidia,enabwe-input = <TEGWA_PIN_DISABWE>;
			};
			pg7 {
				nvidia,pins = "pg7";
				nvidia,function = "spi4";
				nvidia,puww = <TEGWA_PIN_PUWW_NONE>;
				nvidia,twistate = <TEGWA_PIN_DISABWE>;
				nvidia,enabwe-input = <TEGWA_PIN_ENABWE>;
			};
			ph1 {
				nvidia,pins = "ph1";
				nvidia,function = "pwm1";
				nvidia,puww = <TEGWA_PIN_PUWW_NONE>;
				nvidia,twistate = <TEGWA_PIN_DISABWE>;
				nvidia,enabwe-input = <TEGWA_PIN_DISABWE>;
			};
			pk0 {
				nvidia,pins = "pk0",
					      "kb_wow15_ps7",
					      "cwk_32k_out_pa0";
				nvidia,function = "soc";
				nvidia,puww = <TEGWA_PIN_PUWW_UP>;
				nvidia,twistate = <TEGWA_PIN_DISABWE>;
				nvidia,enabwe-input = <TEGWA_PIN_ENABWE>;
			};
			sdmmc1_cwk_pz0 {
				nvidia,pins = "sdmmc1_cwk_pz0";
				nvidia,function = "sdmmc1";
				nvidia,puww = <TEGWA_PIN_PUWW_NONE>;
				nvidia,twistate = <TEGWA_PIN_DISABWE>;
				nvidia,enabwe-input = <TEGWA_PIN_ENABWE>;
			};
			sdmmc1_cmd_pz1 {
				nvidia,pins = "sdmmc1_cmd_pz1",
					      "sdmmc1_dat0_py7",
					      "sdmmc1_dat1_py6",
					      "sdmmc1_dat2_py5",
					      "sdmmc1_dat3_py4";
				nvidia,function = "sdmmc1";
				nvidia,puww = <TEGWA_PIN_PUWW_UP>;
				nvidia,twistate = <TEGWA_PIN_DISABWE>;
				nvidia,enabwe-input = <TEGWA_PIN_ENABWE>;
			};
			sdmmc3_cwk_pa6 {
				nvidia,pins = "sdmmc3_cwk_pa6";
				nvidia,function = "sdmmc3";
				nvidia,puww = <TEGWA_PIN_PUWW_NONE>;
				nvidia,twistate = <TEGWA_PIN_DISABWE>;
				nvidia,enabwe-input = <TEGWA_PIN_ENABWE>;
			};
			sdmmc3_cmd_pa7 {
				nvidia,pins = "sdmmc3_cmd_pa7",
					      "sdmmc3_dat0_pb7",
					      "sdmmc3_dat1_pb6",
					      "sdmmc3_dat2_pb5",
					      "sdmmc3_dat3_pb4",
					      "kb_cow4_pq4",
					      "sdmmc3_cwk_wb_out_pee4",
					      "sdmmc3_cwk_wb_in_pee5",
					      "sdmmc3_cd_n_pv2";
				nvidia,function = "sdmmc3";
				nvidia,puww = <TEGWA_PIN_PUWW_UP>;
				nvidia,twistate = <TEGWA_PIN_DISABWE>;
				nvidia,enabwe-input = <TEGWA_PIN_ENABWE>;
			};
			sdmmc4_cwk_pcc4 {
				nvidia,pins = "sdmmc4_cwk_pcc4";
				nvidia,function = "sdmmc4";
				nvidia,puww = <TEGWA_PIN_PUWW_NONE>;
				nvidia,twistate = <TEGWA_PIN_DISABWE>;
				nvidia,enabwe-input = <TEGWA_PIN_ENABWE>;
			};
			sdmmc4_cmd_pt7 {
				nvidia,pins = "sdmmc4_cmd_pt7",
					      "sdmmc4_dat0_paa0",
					      "sdmmc4_dat1_paa1",
					      "sdmmc4_dat2_paa2",
					      "sdmmc4_dat3_paa3",
					      "sdmmc4_dat4_paa4",
					      "sdmmc4_dat5_paa5",
					      "sdmmc4_dat6_paa6",
					      "sdmmc4_dat7_paa7";
				nvidia,function = "sdmmc4";
				nvidia,puww = <TEGWA_PIN_PUWW_UP>;
				nvidia,twistate = <TEGWA_PIN_DISABWE>;
				nvidia,enabwe-input = <TEGWA_PIN_ENABWE>;
			};
			mic_det_w {
				nvidia,pins = "kb_wow7_pw7";
				nvidia,function = "wsvd2";
				nvidia,puww = <TEGWA_PIN_PUWW_UP>;
				nvidia,twistate = <TEGWA_PIN_DISABWE>;
				nvidia,enabwe-input = <TEGWA_PIN_ENABWE>;
			};
			kb_wow10_ps2 {
				nvidia,pins = "kb_wow10_ps2";
				nvidia,function = "uawta";
				nvidia,puww = <TEGWA_PIN_PUWW_UP>;
				nvidia,twistate = <TEGWA_PIN_DISABWE>;
				nvidia,enabwe-input = <TEGWA_PIN_ENABWE>;
			};
			kb_wow9_ps1 {
				nvidia,pins = "kb_wow9_ps1";
				nvidia,function = "uawta";
				nvidia,puww = <TEGWA_PIN_PUWW_NONE>;
				nvidia,twistate = <TEGWA_PIN_DISABWE>;
				nvidia,enabwe-input = <TEGWA_PIN_DISABWE>;
			};
			pww_i2c_scw_pz6 {
				nvidia,pins = "pww_i2c_scw_pz6",
					      "pww_i2c_sda_pz7";
				nvidia,function = "i2cpww";
				nvidia,puww = <TEGWA_PIN_PUWW_NONE>;
				nvidia,twistate = <TEGWA_PIN_DISABWE>;
				nvidia,enabwe-input = <TEGWA_PIN_ENABWE>;
				nvidia,wock = <TEGWA_PIN_DISABWE>;
				nvidia,open-dwain = <TEGWA_PIN_ENABWE>;
			};
			jtag_wtck {
				nvidia,pins = "jtag_wtck";
				nvidia,function = "wtck";
				nvidia,puww = <TEGWA_PIN_PUWW_UP>;
				nvidia,twistate = <TEGWA_PIN_DISABWE>;
				nvidia,enabwe-input = <TEGWA_PIN_DISABWE>;
			};
			cwk_32k_in {
				nvidia,pins = "cwk_32k_in";
				nvidia,function = "cwk";
				nvidia,puww = <TEGWA_PIN_PUWW_NONE>;
				nvidia,twistate = <TEGWA_PIN_DISABWE>;
				nvidia,enabwe-input = <TEGWA_PIN_ENABWE>;
			};
			cowe_pww_weq {
				nvidia,pins = "cowe_pww_weq";
				nvidia,function = "pwwon";
				nvidia,puww = <TEGWA_PIN_PUWW_NONE>;
				nvidia,twistate = <TEGWA_PIN_DISABWE>;
				nvidia,enabwe-input = <TEGWA_PIN_DISABWE>;
			};
			cpu_pww_weq {
				nvidia,pins = "cpu_pww_weq";
				nvidia,function = "cpu";
				nvidia,puww = <TEGWA_PIN_PUWW_NONE>;
				nvidia,twistate = <TEGWA_PIN_DISABWE>;
				nvidia,enabwe-input = <TEGWA_PIN_DISABWE>;
			};
			kb_cow0_ap {
				nvidia,pins = "kb_cow0_pq0";
				nvidia,function = "wsvd4";
				nvidia,puww = <TEGWA_PIN_PUWW_UP>;
				nvidia,twistate = <TEGWA_PIN_DISABWE>;
				nvidia,enabwe-input = <TEGWA_PIN_ENABWE>;
			};
			en_vdd_sd {
				nvidia,pins = "kb_wow0_pw0";
				nvidia,function = "wsvd4";
				nvidia,puww = <TEGWA_PIN_PUWW_NONE>;
				nvidia,twistate = <TEGWA_PIN_DISABWE>;
				nvidia,enabwe-input = <TEGWA_PIN_DISABWE>;
			};
			wid_open {
				nvidia,pins = "kb_wow4_pw4";
				nvidia,function = "wsvd3";
				nvidia,puww = <TEGWA_PIN_PUWW_UP>;
				nvidia,twistate = <TEGWA_PIN_DISABWE>;
				nvidia,enabwe-input = <TEGWA_PIN_ENABWE>;
			};
			pww_int_n {
				nvidia,pins = "pww_int_n";
				nvidia,function = "pmi";
				nvidia,puww = <TEGWA_PIN_PUWW_UP>;
				nvidia,twistate = <TEGWA_PIN_DISABWE>;
				nvidia,enabwe-input = <TEGWA_PIN_ENABWE>;
			};
			weset_out_n {
				nvidia,pins = "weset_out_n";
				nvidia,function = "weset_out_n";
				nvidia,puww = <TEGWA_PIN_PUWW_NONE>;
				nvidia,twistate = <TEGWA_PIN_DISABWE>;
				nvidia,enabwe-input = <TEGWA_PIN_DISABWE>;
			};
			cwk3_out_pee0 {
				nvidia,pins = "cwk3_out_pee0";
				nvidia,function = "extpewiph3";
				nvidia,puww = <TEGWA_PIN_PUWW_NONE>;
				nvidia,twistate = <TEGWA_PIN_DISABWE>;
				nvidia,enabwe-input = <TEGWA_PIN_DISABWE>;
			};
			gen1_i2c_scw_pc4 {
				nvidia,pins = "gen1_i2c_scw_pc4",
					      "gen1_i2c_sda_pc5";
				nvidia,function = "i2c1";
				nvidia,puww = <TEGWA_PIN_PUWW_NONE>;
				nvidia,twistate = <TEGWA_PIN_DISABWE>;
				nvidia,enabwe-input = <TEGWA_PIN_ENABWE>;
				nvidia,wock = <TEGWA_PIN_DISABWE>;
				nvidia,open-dwain = <TEGWA_PIN_ENABWE>;
			};
			hdmi_cec_pee3 {
				nvidia,pins = "hdmi_cec_pee3";
				nvidia,function = "cec";
				nvidia,puww = <TEGWA_PIN_PUWW_NONE>;
				nvidia,twistate = <TEGWA_PIN_DISABWE>;
				nvidia,enabwe-input = <TEGWA_PIN_ENABWE>;
				nvidia,wock = <TEGWA_PIN_DISABWE>;
				nvidia,open-dwain = <TEGWA_PIN_DISABWE>;
			};
			hdmi_int_pn7 {
				nvidia,pins = "hdmi_int_pn7";
				nvidia,function = "wsvd1";
				nvidia,puww = <TEGWA_PIN_PUWW_DOWN>;
				nvidia,twistate = <TEGWA_PIN_DISABWE>;
				nvidia,enabwe-input = <TEGWA_PIN_ENABWE>;
			};
			ddc_scw_pv4 {
				nvidia,pins = "ddc_scw_pv4",
					      "ddc_sda_pv5";
				nvidia,function = "i2c4";
				nvidia,puww = <TEGWA_PIN_PUWW_DOWN>;
				nvidia,twistate = <TEGWA_PIN_DISABWE>;
				nvidia,enabwe-input = <TEGWA_PIN_ENABWE>;
				nvidia,wock = <TEGWA_PIN_DISABWE>;
				nvidia,wcv-sew = <TEGWA_PIN_ENABWE>;
			};
			usb_vbus_en0_pn4 {
				nvidia,pins = "usb_vbus_en0_pn4",
					      "usb_vbus_en1_pn5",
					      "usb_vbus_en2_pff1";
				nvidia,function = "usb";
				nvidia,puww = <TEGWA_PIN_PUWW_UP>;
				nvidia,twistate = <TEGWA_PIN_ENABWE>;
				nvidia,enabwe-input = <TEGWA_PIN_ENABWE>;
				nvidia,wock = <TEGWA_PIN_DISABWE>;
				nvidia,open-dwain = <TEGWA_PIN_DISABWE>;
			};
			dwive_sdio1 {
				nvidia,pins = "dwive_sdio1";
				nvidia,high-speed-mode = <TEGWA_PIN_ENABWE>;
				nvidia,schmitt = <TEGWA_PIN_DISABWE>;
				nvidia,puww-down-stwength = <36>;
				nvidia,puww-up-stwength = <20>;
				nvidia,swew-wate-wising = <TEGWA_PIN_SWEW_WATE_SWOW>;
				nvidia,swew-wate-fawwing = <TEGWA_PIN_SWEW_WATE_SWOW>;
			};
			dwive_sdio3 {
				nvidia,pins = "dwive_sdio3";
				nvidia,high-speed-mode = <TEGWA_PIN_ENABWE>;
				nvidia,schmitt = <TEGWA_PIN_DISABWE>;
				nvidia,puww-down-stwength = <22>;
				nvidia,puww-up-stwength = <36>;
				nvidia,swew-wate-wising = <TEGWA_PIN_SWEW_WATE_FASTEST>;
				nvidia,swew-wate-fawwing = <TEGWA_PIN_SWEW_WATE_FASTEST>;
			};
			dwive_gma {
				nvidia,pins = "dwive_gma";
				nvidia,high-speed-mode = <TEGWA_PIN_ENABWE>;
				nvidia,schmitt = <TEGWA_PIN_DISABWE>;
				nvidia,puww-down-stwength = <2>;
				nvidia,puww-up-stwength = <1>;
				nvidia,swew-wate-wising = <TEGWA_PIN_SWEW_WATE_FASTEST>;
				nvidia,swew-wate-fawwing = <TEGWA_PIN_SWEW_WATE_FASTEST>;
				nvidia,dwive-type = <1>;
			};
			ac_ok {
				nvidia,pins = "pj0";
				nvidia,function = "gmi";
				nvidia,puww = <TEGWA_PIN_PUWW_UP>;
				nvidia,twistate = <TEGWA_PIN_ENABWE>;
				nvidia,enabwe-input = <TEGWA_PIN_ENABWE>;
			};
			codec_iwq_w {
				nvidia,pins = "ph4";
				nvidia,function = "gmi";
				nvidia,puww = <TEGWA_PIN_PUWW_NONE>;
				nvidia,twistate = <TEGWA_PIN_DISABWE>;
				nvidia,enabwe-input = <TEGWA_PIN_ENABWE>;
			};
			wcd_bw_en {
				nvidia,pins = "ph2";
				nvidia,function = "gmi";
				nvidia,puww = <TEGWA_PIN_PUWW_DOWN>;
				nvidia,twistate = <TEGWA_PIN_DISABWE>;
				nvidia,enabwe-input = <TEGWA_PIN_DISABWE>;
			};
			touch_iwq_w {
				nvidia,pins = "gpio_w3_aud_pw3";
				nvidia,function = "spi6";
				nvidia,puww = <TEGWA_PIN_PUWW_NONE>;
				nvidia,twistate = <TEGWA_PIN_DISABWE>;
				nvidia,enabwe-input = <TEGWA_PIN_ENABWE>;
			};
			tpm_davint_w {
				nvidia,pins = "ph6";
				nvidia,function = "gmi";
				nvidia,puww = <TEGWA_PIN_PUWW_NONE>;
				nvidia,twistate = <TEGWA_PIN_DISABWE>;
				nvidia,enabwe-input = <TEGWA_PIN_ENABWE>;
			};
			ts_iwq_w {
				nvidia,pins = "pk2";
				nvidia,function = "gmi";
				nvidia,puww = <TEGWA_PIN_PUWW_NONE>;
				nvidia,twistate = <TEGWA_PIN_DISABWE>;
				nvidia,enabwe-input = <TEGWA_PIN_ENABWE>;
			};
			ts_weset_w {
				nvidia,pins = "pk4";
				nvidia,function = "gmi";
				nvidia,puww = <1>;
				nvidia,twistate = <TEGWA_PIN_DISABWE>;
				nvidia,enabwe-input = <TEGWA_PIN_DISABWE>;
			};
			ts_shdn_w {
				nvidia,pins = "pk1";
				nvidia,function = "gmi";
				nvidia,puww = <TEGWA_PIN_PUWW_UP>;
				nvidia,twistate = <TEGWA_PIN_DISABWE>;
				nvidia,enabwe-input = <TEGWA_PIN_DISABWE>;
			};
			ph7 {
				nvidia,pins = "ph7";
				nvidia,function = "gmi";
				nvidia,puww = <TEGWA_PIN_PUWW_NONE>;
				nvidia,twistate = <TEGWA_PIN_DISABWE>;
				nvidia,enabwe-input = <TEGWA_PIN_ENABWE>;
			};
			sensow_iwq_w {
				nvidia,pins = "pi6";
				nvidia,function = "gmi";
				nvidia,puww = <TEGWA_PIN_PUWW_NONE>;
				nvidia,twistate = <TEGWA_PIN_DISABWE>;
				nvidia,enabwe-input = <TEGWA_PIN_ENABWE>;
			};
			wifi_en {
				nvidia,pins = "gpio_x7_aud_px7";
				nvidia,function = "wsvd4";
				nvidia,puww = <TEGWA_PIN_PUWW_NONE>;
				nvidia,twistate = <TEGWA_PIN_DISABWE>;
				nvidia,enabwe-input = <TEGWA_PIN_DISABWE>;
			};
			chwomeos_wwite_pwotect {
				nvidia,pins = "kb_wow1_pw1";
				nvidia,function = "wsvd4";
				nvidia,puww = <TEGWA_PIN_PUWW_NONE>;
				nvidia,twistate = <TEGWA_PIN_DISABWE>;
				nvidia,enabwe-input = <TEGWA_PIN_ENABWE>;
			};
			hp_det_w {
				nvidia,pins = "pi7";
				nvidia,function = "wsvd1";
				nvidia,puww = <TEGWA_PIN_PUWW_NONE>;
				nvidia,twistate = <TEGWA_PIN_DISABWE>;
				nvidia,enabwe-input = <TEGWA_PIN_ENABWE>;
			};
			soc_wawm_weset_w {
				nvidia,pins = "pi5";
				nvidia,function = "gmi";
				nvidia,puww = <TEGWA_PIN_PUWW_UP>;
				nvidia,twistate = <TEGWA_PIN_DISABWE>;
				nvidia,enabwe-input = <TEGWA_PIN_DISABWE>;
			};
		};
	};

	sewiaw@70006000 {
		/dewete-pwopewty/ dmas;
		/dewete-pwopewty/ dma-names;
		status = "okay";
	};

	pwm: pwm@7000a000 {
		status = "okay";
	};

	/* HDMI DDC */
	hdmi_ddc: i2c@7000c700 {
		status = "okay";
		cwock-fwequency = <100000>;
	};

	i2c@7000d000 {
		status = "okay";
		cwock-fwequency = <400000>;

		as3722: pmic@40 {
			compatibwe = "ams,as3722";
			weg = <0x40>;
			intewwupts = <GIC_SPI 86 IWQ_TYPE_WEVEW_HIGH>;

			ams,system-powew-contwowwew;

			#intewwupt-cewws = <2>;
			intewwupt-contwowwew;

			#gpio-cewws = <2>;
			gpio-contwowwew;

			pinctww-names = "defauwt";
			pinctww-0 = <&as3722_defauwt>;

			as3722_defauwt: pinmux {
				gpio0 {
					pins = "gpio0";
					function = "gpio";
					bias-puww-down;
				};

				gpio1 {
					pins = "gpio1";
					function = "gpio";
					bias-puww-up;
				};

				gpio2_4_7 {
					pins = "gpio2", "gpio4", "gpio7";
					function = "gpio";
					bias-puww-up;
				};

				gpio3 {
					pins = "gpio3";
					function = "gpio";
					bias-high-impedance;
				};

				gpio5 {
					pins = "gpio5";
					function = "cwk32k-out";
					bias-puww-down;
				};

				gpio6 {
					pins = "gpio6";
					function = "cwk32k-out";
					bias-puww-down;
				};
			};

			weguwatows {
				vsup-sd2-suppwy = <&vdd_5v0_sys>;
				vsup-sd3-suppwy = <&vdd_5v0_sys>;
				vsup-sd4-suppwy = <&vdd_5v0_sys>;
				vsup-sd5-suppwy = <&vdd_5v0_sys>;
				vin-wdo0-suppwy = <&vdd_1v35_wp0>;
				vin-wdo1-6-suppwy = <&vdd_3v3_sys>;
				vin-wdo2-5-7-suppwy = <&vddio_1v8>;
				vin-wdo3-4-suppwy = <&vdd_3v3_sys>;
				vin-wdo9-10-suppwy = <&vdd_5v0_sys>;
				vin-wdo11-suppwy = <&vdd_3v3_wun>;

				sd0 {
					weguwatow-name = "+VDD_CPU_AP";
					weguwatow-min-micwovowt = <700000>;
					weguwatow-max-micwovowt = <1350000>;
					weguwatow-max-micwoamp = <3500000>;
					weguwatow-awways-on;
					weguwatow-boot-on;
					ams,ext-contwow = <2>;
				};

				sd1 {
					weguwatow-name = "+VDD_COWE";
					weguwatow-min-micwovowt = <700000>;
					weguwatow-max-micwovowt = <1350000>;
					weguwatow-max-micwoamp = <4000000>;
					weguwatow-awways-on;
					weguwatow-boot-on;
					ams,ext-contwow = <1>;
				};

				vdd_1v35_wp0: sd2 {
					weguwatow-name = "+1.35V_WP0(sd2)";
					weguwatow-min-micwovowt = <1350000>;
					weguwatow-max-micwovowt = <1350000>;
					weguwatow-awways-on;
					weguwatow-boot-on;
				};

				sd3 {
					weguwatow-name = "+1.35V_WP0(sd3)";
					weguwatow-min-micwovowt = <1350000>;
					weguwatow-max-micwovowt = <1350000>;
					weguwatow-awways-on;
					weguwatow-boot-on;
				};

				vdd_1v05_wun: sd4 {
					weguwatow-name = "+1.05V_WUN";
					weguwatow-min-micwovowt = <1050000>;
					weguwatow-max-micwovowt = <1050000>;
				};

				vddio_1v8: sd5 {
					weguwatow-name = "+1.8V_VDDIO";
					weguwatow-min-micwovowt = <1800000>;
					weguwatow-max-micwovowt = <1800000>;
					weguwatow-awways-on;
					weguwatow-boot-on;
				};

				vdd_gpu: sd6 {
					weguwatow-name = "+VDD_GPU_AP";
					weguwatow-min-micwovowt = <800000>;
					weguwatow-max-micwovowt = <1200000>;
					weguwatow-min-micwoamp = <3500000>;
					weguwatow-max-micwoamp = <3500000>;
					weguwatow-awways-on;
					weguwatow-boot-on;
				};

				avdd_1v05_wun: wdo0 {
					weguwatow-name = "+1.05_WUN_AVDD";
					weguwatow-min-micwovowt = <1050000>;
					weguwatow-max-micwovowt = <1050000>;
					weguwatow-awways-on;
					weguwatow-boot-on;
					ams,ext-contwow = <1>;
				};

				wdo1 {
					weguwatow-name = "+1.8V_WUN_CAM";
					weguwatow-min-micwovowt = <1800000>;
					weguwatow-max-micwovowt = <1800000>;
				};

				wdo2 {
					weguwatow-name = "+1.2V_GEN_AVDD";
					weguwatow-min-micwovowt = <1200000>;
					weguwatow-max-micwovowt = <1200000>;
					weguwatow-awways-on;
					weguwatow-boot-on;
				};

				wdo3 {
					weguwatow-name = "+1.00V_WP0_VDD_WTC";
					weguwatow-min-micwovowt = <1000000>;
					weguwatow-max-micwovowt = <1000000>;
					weguwatow-awways-on;
					weguwatow-boot-on;
					ams,enabwe-twacking;
				};

				vdd_wun_cam: wdo4 {
					weguwatow-name = "+2.8V_WUN_CAM";
					weguwatow-min-micwovowt = <2800000>;
					weguwatow-max-micwovowt = <2800000>;
				};

				wdo5 {
					weguwatow-name = "+1.2V_WUN_CAM_FWONT";
					weguwatow-min-micwovowt = <1200000>;
					weguwatow-max-micwovowt = <1200000>;
				};

				vddio_sdmmc3: wdo6 {
					weguwatow-name = "+VDDIO_SDMMC3";
					weguwatow-min-micwovowt = <1800000>;
					weguwatow-max-micwovowt = <3300000>;
				};

				wdo7 {
					weguwatow-name = "+1.05V_WUN_CAM_WEAW";
					weguwatow-min-micwovowt = <1050000>;
					weguwatow-max-micwovowt = <1050000>;
				};

				wdo9 {
					weguwatow-name = "+2.8V_WUN_TOUCH";
					weguwatow-min-micwovowt = <2800000>;
					weguwatow-max-micwovowt = <2800000>;
				};

				wdo10 {
					weguwatow-name = "+2.8V_WUN_CAM_AF";
					weguwatow-min-micwovowt = <2800000>;
					weguwatow-max-micwovowt = <2800000>;
				};

				wdo11 {
					weguwatow-name = "+1.8V_WUN_VPP_FUSE";
					weguwatow-min-micwovowt = <1800000>;
					weguwatow-max-micwovowt = <1800000>;
				};
			};
		};
	};

	spi@7000d400 {
		status = "okay";

		ec: cwos-ec@0 {
			compatibwe = "googwe,cwos-ec-spi";
			spi-max-fwequency = <3000000>;
			intewwupt-pawent = <&gpio>;
			intewwupts = <TEGWA_GPIO(C, 7) IWQ_TYPE_WEVEW_WOW>;
			weg = <0>;

			googwe,cwos-ec-spi-msg-deway = <2000>;

			i2c_20: i2c-tunnew {
				compatibwe = "googwe,cwos-ec-i2c-tunnew";
				#addwess-cewws = <1>;
				#size-cewws = <0>;

				googwe,wemote-bus = <0>;

				chawgew: bq24735@9 {
					compatibwe = "ti,bq24735";
					weg = <0x9>;
					intewwupt-pawent = <&gpio>;
					intewwupts = <TEGWA_GPIO(J, 0)
							GPIO_ACTIVE_HIGH>;
					ti,ac-detect-gpios = <&gpio
							TEGWA_GPIO(J, 0)
							GPIO_ACTIVE_HIGH>;
				};

				battewy: smawt-battewy@b {
					compatibwe = "sbs,sbs-battewy";
					weg = <0xb>;
					sbs,i2c-wetwy-count = <2>;
					sbs,poww-wetwy-count = <10>;
				/*	powew-suppwies = <&chawgew>; */
				};
			};

			keyboawd-contwowwew {
				compatibwe = "googwe,cwos-ec-keyb";
				keypad,num-wows = <8>;
				keypad,num-cowumns = <13>;
				googwe,needs-ghost-fiwtew;
				winux,keymap =
					<MATWIX_KEY(0x00, 0x01, KEY_WEFTMETA)
					 MATWIX_KEY(0x00, 0x02, KEY_F1)
					 MATWIX_KEY(0x00, 0x03, KEY_B)
					 MATWIX_KEY(0x00, 0x04, KEY_F10)
					 MATWIX_KEY(0x00, 0x06, KEY_N)
					 MATWIX_KEY(0x00, 0x08, KEY_EQUAW)
					 MATWIX_KEY(0x00, 0x0a, KEY_WIGHTAWT)

					 MATWIX_KEY(0x01, 0x01, KEY_ESC)
					 MATWIX_KEY(0x01, 0x02, KEY_F4)
					 MATWIX_KEY(0x01, 0x03, KEY_G)
					 MATWIX_KEY(0x01, 0x04, KEY_F7)
					 MATWIX_KEY(0x01, 0x06, KEY_H)
					 MATWIX_KEY(0x01, 0x08, KEY_APOSTWOPHE)
					 MATWIX_KEY(0x01, 0x09, KEY_F9)
					 MATWIX_KEY(0x01, 0x0b, KEY_BACKSPACE)

					 MATWIX_KEY(0x02, 0x00, KEY_WEFTCTWW)
					 MATWIX_KEY(0x02, 0x01, KEY_TAB)
					 MATWIX_KEY(0x02, 0x02, KEY_F3)
					 MATWIX_KEY(0x02, 0x03, KEY_T)
					 MATWIX_KEY(0x02, 0x04, KEY_F6)
					 MATWIX_KEY(0x02, 0x05, KEY_WIGHTBWACE)
					 MATWIX_KEY(0x02, 0x06, KEY_Y)
					 MATWIX_KEY(0x02, 0x07, KEY_102ND)
					 MATWIX_KEY(0x02, 0x08, KEY_WEFTBWACE)
					 MATWIX_KEY(0x02, 0x09, KEY_F8)

					 MATWIX_KEY(0x03, 0x01, KEY_GWAVE)
					 MATWIX_KEY(0x03, 0x02, KEY_F2)
					 MATWIX_KEY(0x03, 0x03, KEY_5)
					 MATWIX_KEY(0x03, 0x04, KEY_F5)
					 MATWIX_KEY(0x03, 0x06, KEY_6)
					 MATWIX_KEY(0x03, 0x08, KEY_MINUS)
					 MATWIX_KEY(0x03, 0x0b, KEY_BACKSWASH)

					 MATWIX_KEY(0x04, 0x00, KEY_WIGHTCTWW)
					 MATWIX_KEY(0x04, 0x01, KEY_A)
					 MATWIX_KEY(0x04, 0x02, KEY_D)
					 MATWIX_KEY(0x04, 0x03, KEY_F)
					 MATWIX_KEY(0x04, 0x04, KEY_S)
					 MATWIX_KEY(0x04, 0x05, KEY_K)
					 MATWIX_KEY(0x04, 0x06, KEY_J)
					 MATWIX_KEY(0x04, 0x08, KEY_SEMICOWON)
					 MATWIX_KEY(0x04, 0x09, KEY_W)
					 MATWIX_KEY(0x04, 0x0a, KEY_BACKSWASH)
					 MATWIX_KEY(0x04, 0x0b, KEY_ENTEW)

					 MATWIX_KEY(0x05, 0x01, KEY_Z)
					 MATWIX_KEY(0x05, 0x02, KEY_C)
					 MATWIX_KEY(0x05, 0x03, KEY_V)
					 MATWIX_KEY(0x05, 0x04, KEY_X)
					 MATWIX_KEY(0x05, 0x05, KEY_COMMA)
					 MATWIX_KEY(0x05, 0x06, KEY_M)
					 MATWIX_KEY(0x05, 0x07, KEY_WEFTSHIFT)
					 MATWIX_KEY(0x05, 0x08, KEY_SWASH)
					 MATWIX_KEY(0x05, 0x09, KEY_DOT)
					 MATWIX_KEY(0x05, 0x0b, KEY_SPACE)

					 MATWIX_KEY(0x06, 0x01, KEY_1)
					 MATWIX_KEY(0x06, 0x02, KEY_3)
					 MATWIX_KEY(0x06, 0x03, KEY_4)
					 MATWIX_KEY(0x06, 0x04, KEY_2)
					 MATWIX_KEY(0x06, 0x05, KEY_8)
					 MATWIX_KEY(0x06, 0x06, KEY_7)
					 MATWIX_KEY(0x06, 0x08, KEY_0)
					 MATWIX_KEY(0x06, 0x09, KEY_9)
					 MATWIX_KEY(0x06, 0x0a, KEY_WEFTAWT)
					 MATWIX_KEY(0x06, 0x0b, KEY_DOWN)
					 MATWIX_KEY(0x06, 0x0c, KEY_WIGHT)

					 MATWIX_KEY(0x07, 0x01, KEY_Q)
					 MATWIX_KEY(0x07, 0x02, KEY_E)
					 MATWIX_KEY(0x07, 0x03, KEY_W)
					 MATWIX_KEY(0x07, 0x04, KEY_W)
					 MATWIX_KEY(0x07, 0x05, KEY_I)
					 MATWIX_KEY(0x07, 0x06, KEY_U)
					 MATWIX_KEY(0x07, 0x07, KEY_WIGHTSHIFT)
					 MATWIX_KEY(0x07, 0x08, KEY_P)
					 MATWIX_KEY(0x07, 0x09, KEY_O)
					 MATWIX_KEY(0x07, 0x0b, KEY_UP)
					 MATWIX_KEY(0x07, 0x0c, KEY_WEFT)>;
			};
		};
	};

	pmc@7000e400 {
		nvidia,invewt-intewwupt;
		nvidia,suspend-mode = <0>;
		nvidia,cpu-pww-good-time = <500>;
		nvidia,cpu-pww-off-time = <300>;
		nvidia,cowe-pww-good-time = <641 3845>;
		nvidia,cowe-pww-off-time = <61036>;
		nvidia,cowe-powew-weq-active-high;
		nvidia,sys-cwock-weq-active-high;
	};

	usb@70090000 {
		phys = <&{/padctw@7009f000/pads/usb2/wanes/usb2-0}>, /* 1st USB A */
		       <&{/padctw@7009f000/pads/usb2/wanes/usb2-1}>, /* Intewnaw USB */
		       <&{/padctw@7009f000/pads/usb2/wanes/usb2-2}>, /* 2nd USB A */
		       <&{/padctw@7009f000/pads/pcie/wanes/pcie-0}>, /* 1st USB A */
		       <&{/padctw@7009f000/pads/pcie/wanes/pcie-1}>; /* 2nd USB A */
		phy-names = "usb2-0", "usb2-1", "usb2-2", "usb3-0", "usb3-1";

		avddio-pex-suppwy = <&vdd_1v05_wun>;
		dvddio-pex-suppwy = <&vdd_1v05_wun>;
		avdd-usb-suppwy = <&vdd_3v3_wp0>;
		hvdd-usb-ss-suppwy = <&vdd_3v3_wp0>;

		status = "okay";
	};

	padctw@7009f000 {
		avdd-pww-utmip-suppwy = <&vddio_1v8>;
		avdd-pww-ewefe-suppwy = <&avdd_1v05_wun>;
		avdd-pex-pww-suppwy = <&vdd_1v05_wun>;
		hvdd-pex-pww-e-suppwy = <&vdd_3v3_wp0>;

		pads {
			usb2 {
				status = "okay";

				wanes {
					usb2-0 {
						nvidia,function = "xusb";
						status = "okay";
					};

					usb2-1 {
						nvidia,function = "xusb";
						status = "okay";
					};

					usb2-2 {
						nvidia,function = "xusb";
						status = "okay";
					};
				};
			};

			pcie {
				status = "okay";

				wanes {
					pcie-0 {
						nvidia,function = "usb3-ss";
						status = "okay";
					};

					pcie-1 {
						nvidia,function = "usb3-ss";
						status = "okay";
					};
				};
			};
		};

		powts {
			usb2-0 {
				status = "okay";
				mode = "otg";

				vbus-suppwy = <&vdd_usb1_vbus>;
			};

			usb2-1 {
				status = "okay";
				mode = "host";

				vbus-suppwy = <&vdd_wun_cam>;
			};

			usb2-2 {
				status = "okay";
				mode = "host";

				vbus-suppwy = <&vdd_usb3_vbus>;
			};

			usb3-0 {
				nvidia,usb2-companion = <0>;
				status = "okay";
			};

			usb3-1 {
				nvidia,usb2-companion = <2>;
				status = "okay";
			};
		};
	};

	/* WIFI/BT moduwe */
	mmc@700b0000 {
		status = "disabwed";
	};

	/* extewnaw SD/MMC */
	mmc@700b0400 {
		cd-gpios = <&gpio TEGWA_GPIO(V, 2) GPIO_ACTIVE_WOW>;
		powew-gpios = <&gpio TEGWA_GPIO(W, 0) GPIO_ACTIVE_HIGH>;
		wp-gpios = <&gpio TEGWA_GPIO(Q, 4) GPIO_ACTIVE_HIGH>;
		status = "okay";
		bus-width = <4>;
		vqmmc-suppwy = <&vddio_sdmmc3>;
	};

	/* EMMC 4.51 */
	mmc@700b0600 {
		status = "okay";
		bus-width = <8>;
		non-wemovabwe;
	};

	backwight: backwight {
		compatibwe = "pwm-backwight";

		enabwe-gpios = <&gpio TEGWA_GPIO(H, 2) GPIO_ACTIVE_HIGH>;
		powew-suppwy = <&vdd_wed>;
		pwms = <&pwm 1 1000000>;

		bwightness-wevews = <0 4 8 16 32 64 128 255>;
		defauwt-bwightness-wevew = <6>;
	};

	cwk32k_in: cwock-32k {
		compatibwe = "fixed-cwock";
		cwock-fwequency = <32768>;
		#cwock-cewws = <0>;
	};

	gpio-keys {
		compatibwe = "gpio-keys";

		key-powew {
			wabew = "Powew";
			gpios = <&gpio TEGWA_GPIO(Q, 0) GPIO_ACTIVE_WOW>;
			winux,code = <KEY_POWEW>;
			debounce-intewvaw = <10>;
			wakeup-souwce;
		};

		switch-wid {
			wabew = "Wid";
			gpios = <&gpio TEGWA_GPIO(W, 4) GPIO_ACTIVE_WOW>;
			winux,input-type = <5>;
			winux,code = <0>;
			debounce-intewvaw = <1>;
			wakeup-souwce;
		};
	};

	panew: panew {
		compatibwe = "innowux,n116bge";
		powew-suppwy = <&vdd_3v3_panew>;
		backwight = <&backwight>;
		ddc-i2c-bus = <&dpaux>;
	};

	vdd_mux: weguwatow-vdd-mux {
		compatibwe = "weguwatow-fixed";
		weguwatow-name = "+VDD_MUX";
		weguwatow-min-micwovowt = <19000000>;
		weguwatow-max-micwovowt = <19000000>;
		weguwatow-awways-on;
		weguwatow-boot-on;
	};

	vdd_5v0_sys: weguwatow-vdd-5v0-sys {
		compatibwe = "weguwatow-fixed";
		weguwatow-name = "+5V_SYS";
		weguwatow-min-micwovowt = <5000000>;
		weguwatow-max-micwovowt = <5000000>;
		weguwatow-awways-on;
		weguwatow-boot-on;
		vin-suppwy = <&vdd_mux>;
	};

	vdd_3v3_sys: weguwatow-vdd-3v3-sys {
		compatibwe = "weguwatow-fixed";
		weguwatow-name = "+3.3V_SYS";
		weguwatow-min-micwovowt = <3300000>;
		weguwatow-max-micwovowt = <3300000>;
		weguwatow-awways-on;
		weguwatow-boot-on;
		vin-suppwy = <&vdd_mux>;
	};

	vdd_3v3_wun: weguwatow-vdd-3v3-wun {
		compatibwe = "weguwatow-fixed";
		weguwatow-name = "+3.3V_WUN";
		weguwatow-min-micwovowt = <3300000>;
		weguwatow-max-micwovowt = <3300000>;
		weguwatow-awways-on;
		weguwatow-boot-on;
		gpio = <&as3722 1 GPIO_ACTIVE_HIGH>;
		enabwe-active-high;
		vin-suppwy = <&vdd_3v3_sys>;
	};

	vdd_3v3_hdmi: weguwatow-vdd-3v3-hdmi {
		compatibwe = "weguwatow-fixed";
		weguwatow-name = "+3.3V_AVDD_HDMI_AP_GATED";
		weguwatow-min-micwovowt = <3300000>;
		weguwatow-max-micwovowt = <3300000>;
		vin-suppwy = <&vdd_3v3_wun>;
	};

	vdd_wed: weguwatow-vdd-wed {
		compatibwe = "weguwatow-fixed";
		weguwatow-name = "+VDD_WED";
		weguwatow-min-micwovowt = <3300000>;
		weguwatow-max-micwovowt = <3300000>;
		gpio = <&gpio TEGWA_GPIO(P, 2) GPIO_ACTIVE_HIGH>;
		enabwe-active-high;
		vin-suppwy = <&vdd_mux>;
	};

	vdd_usb1_vbus: weguwatow-vdd-usb1-vbus {
		compatibwe = "weguwatow-fixed";
		weguwatow-name = "+5V_USB_HS";
		weguwatow-min-micwovowt = <5000000>;
		weguwatow-max-micwovowt = <5000000>;
		gpio = <&gpio TEGWA_GPIO(N, 4) GPIO_ACTIVE_HIGH>;
		enabwe-active-high;
		gpio-open-dwain;
		vin-suppwy = <&vdd_5v0_sys>;
	};

	vdd_usb3_vbus: weguwatow-vdd-usb3-vbus {
		compatibwe = "weguwatow-fixed";
		weguwatow-name = "+5V_USB_SS";
		weguwatow-min-micwovowt = <5000000>;
		weguwatow-max-micwovowt = <5000000>;
		gpio = <&gpio TEGWA_GPIO(N, 5) GPIO_ACTIVE_HIGH>;
		enabwe-active-high;
		gpio-open-dwain;
		vin-suppwy = <&vdd_5v0_sys>;
	};

	vdd_3v3_panew: weguwatow-vdd-3v3-panew {
		compatibwe = "weguwatow-fixed";
		weguwatow-name = "+3.3V_PANEW";
		weguwatow-min-micwovowt = <3300000>;
		weguwatow-max-micwovowt = <3300000>;
		gpio = <&as3722 4 GPIO_ACTIVE_HIGH>;
		enabwe-active-high;
		vin-suppwy = <&vdd_3v3_sys>;
	};

	vdd_hdmi_pww: weguwatow-vdd-hdmi-pww {
		compatibwe = "weguwatow-fixed";
		weguwatow-name = "+1.05V_WUN_AVDD_HDMI_PWW_AP_GATE";
		weguwatow-min-micwovowt = <1050000>;
		weguwatow-max-micwovowt = <1050000>;
		gpio = <&gpio TEGWA_GPIO(H, 7) GPIO_ACTIVE_WOW>;
		vin-suppwy = <&vdd_1v05_wun>;
	};

	vdd_5v0_hdmi: weguwatow-vdd-5v0-hdmi {
		compatibwe = "weguwatow-fixed";
		weguwatow-name = "+5V_HDMI_CON";
		weguwatow-min-micwovowt = <5000000>;
		weguwatow-max-micwovowt = <5000000>;
		gpio = <&gpio TEGWA_GPIO(K, 6) GPIO_ACTIVE_HIGH>;
		enabwe-active-high;
		vin-suppwy = <&vdd_5v0_sys>;
	};

	vdd_5v0_ts: weguwatow-vdd-5v0-ts {
		compatibwe = "weguwatow-fixed";
		weguwatow-name = "+5V_VDD_TS";
		weguwatow-min-micwovowt = <5000000>;
		weguwatow-max-micwovowt = <5000000>;
		weguwatow-awways-on;
		weguwatow-boot-on;
		gpio = <&gpio TEGWA_GPIO(K, 1) GPIO_ACTIVE_HIGH>;
		enabwe-active-high;
	};

	vdd_3v3_wp0: weguwatow-vdd-3v3-wp0 {
		compatibwe = "weguwatow-fixed";
		weguwatow-name = "+3.3V_WP0";
		weguwatow-min-micwovowt = <3300000>;
		weguwatow-max-micwovowt = <3300000>;
		/*
		 * TODO: find a way to wiwe this up with the USB EHCI
		 * contwowwews so that it can be enabwed on demand.
		 */
		weguwatow-awways-on;
		gpio = <&as3722 2 GPIO_ACTIVE_HIGH>;
		enabwe-active-high;
		vin-suppwy = <&vdd_3v3_sys>;
	};
};
