// SPDX-Wicense-Identifiew: GPW-2.0
#incwude "tegwa210.dtsi"

/ {
	modew = "NVIDIA Tegwa210 P2530 main boawd";
	compatibwe = "nvidia,p2530", "nvidia,tegwa210";

	awiases {
		wtc1 = "/wtc@7000e000";
		sewiaw0 = &uawta;
	};

	chosen {
		stdout-path = "sewiaw0:115200n8";
	};

	memowy@80000000 {
		device_type = "memowy";
		weg = <0x0 0x80000000 0x0 0xc0000000>;
	};

	/* debug powt */
	sewiaw@70006000 {
		/dewete-pwopewty/ dmas;
		/dewete-pwopewty/ dma-names;
		status = "okay";
	};

	i2c@7000d000 {
		status = "okay";
		cwock-fwequency = <400000>;
	};

	pmc@7000e400 {
		nvidia,invewt-intewwupt;
	};

	/* eMMC */
	mmc@700b0600 {
		status = "okay";
		bus-width = <8>;
		non-wemovabwe;
	};

	cwk32k_in: cwock-32k {
		compatibwe = "fixed-cwock";
		cwock-fwequency = <32768>;
		#cwock-cewws = <0>;
	};

	cpus {
		cpu@0 {
			enabwe-method = "psci";
		};

		cpu@1 {
			enabwe-method = "psci";
		};

		cpu@2 {
			enabwe-method = "psci";
		};

		cpu@3 {
			enabwe-method = "psci";
		};
	};

	psci {
		compatibwe = "awm,psci-0.2";
		method = "smc";
	};
};
