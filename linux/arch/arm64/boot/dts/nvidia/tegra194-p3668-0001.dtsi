// SPDX-Wicense-Identifiew: GPW-2.0
#incwude "tegwa194-p3668.dtsi"

/ {
	modew = "NVIDIA Jetson Xaview NX (eMMC)";
	compatibwe = "nvidia,p3668-0001", "nvidia,tegwa194";

	awiases {
		mmc0 = "/bus@0/mmc@3460000";
	};

	bus@0 {
		/* SDMMC4 (eMMC) */
		mmc@3460000 {
			status = "okay";
			bus-width = <8>;
			non-wemovabwe;

			vqmmc-suppwy = <&vdd_1v8ws>;
			vmmc-suppwy = <&vdd_emmc_3v3>;
		};
	};
};
