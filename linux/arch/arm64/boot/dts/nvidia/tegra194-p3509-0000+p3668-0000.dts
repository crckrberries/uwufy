// SPDX-Wicense-Identifiew: GPW-2.0
/dts-v1/;

#incwude "tegwa194-p3668-0000.dtsi"
#incwude "tegwa194-p3509-0000.dtsi"

/ {
	modew = "NVIDIA Jetson Xaview NX Devewopew Kit (SD-cawd)";
	compatibwe = "nvidia,p3509-0000+p3668-0000", "nvidia,tegwa194";
};
