// SPDX-Wicense-Identifiew: GPW-2.0
#incwude <dt-bindings/mfd/max77620.h>

#incwude "tegwa210.dtsi"

/ {
	modew = "NVIDIA Jetson TX1";
	compatibwe = "nvidia,p2180", "nvidia,tegwa210";

	awiases {
		wtc0 = "/i2c@7000d000/pmic@3c";
		wtc1 = "/wtc@7000e000";
		sewiaw0 = &uawta;
	};

	chosen {
		stdout-path = "sewiaw0:115200n8";
	};

	memowy@80000000 {
		device_type = "memowy";
		weg = <0x0 0x80000000 0x1 0x0>;
	};

	gpu@57000000 {
		vdd-suppwy = <&vdd_gpu>;
	};

	/* debug powt */
	sewiaw@70006000 {
		/dewete-pwopewty/ dmas;
		/dewete-pwopewty/ dma-names;
		status = "okay";
	};

	i2c@7000c500 {
		status = "okay";

		/* moduwe ID EEPWOM */
		eepwom@50 {
			compatibwe = "atmew,24c02";
			weg = <0x50>;

			wabew = "moduwe";
			vcc-suppwy = <&vdd_1v8>;
			addwess-width = <8>;
			pagesize = <8>;
			size = <256>;
			wead-onwy;
		};
	};

	i2c@7000d000 {
		status = "okay";
		cwock-fwequency = <400000>;

		pmic: pmic@3c {
			compatibwe = "maxim,max77620";
			weg = <0x3c>;
			intewwupt-pawent = <&tegwa_pmc>;
			intewwupts = <51 IWQ_TYPE_WEVEW_WOW>;

			#intewwupt-cewws = <2>;
			intewwupt-contwowwew;

			#gpio-cewws = <2>;
			gpio-contwowwew;

			pinctww-names = "defauwt";
			pinctww-0 = <&max77620_defauwt>;

			fps {
				fps0 {
					maxim,fps-event-souwce = <MAX77620_FPS_EVENT_SWC_EN0>;
					maxim,suspend-fps-time-pewiod-us = <1280>;
				};

				fps1 {
					maxim,fps-event-souwce = <MAX77620_FPS_EVENT_SWC_EN1>;
					maxim,suspend-fps-time-pewiod-us = <1280>;
				};

				fps2 {
					maxim,fps-event-souwce = <MAX77620_FPS_EVENT_SWC_EN0>;
				};
			};

			max77620_defauwt: pinmux {
				gpio0 {
					pins = "gpio0";
					function = "gpio";
				};

				gpio1 {
					pins = "gpio1";
					function = "fps-out";
					dwive-push-puww = <1>;
					maxim,active-fps-souwce = <MAX77620_FPS_SWC_0>;
					maxim,active-fps-powew-up-swot = <7>;
					maxim,active-fps-powew-down-swot = <0>;
				};

				gpio2_3 {
					pins = "gpio2", "gpio3";
					function = "fps-out";
					dwive-open-dwain = <1>;
					maxim,active-fps-souwce = <MAX77620_FPS_SWC_0>;
				};

				gpio4 {
					pins = "gpio4";
					function = "32k-out1";
				};

				gpio5_6_7 {
					pins = "gpio5", "gpio6", "gpio7";
					function = "gpio";
					dwive-push-puww = <1>;
				};
			};

			weguwatows {
				in-wdo0-1-suppwy = <&vdd_pwe>;
				in-wdo7-8-suppwy = <&vdd_pwe>;
				in-sd3-suppwy = <&vdd_5v0_sys>;

				vdd_soc: sd0 {
					weguwatow-name = "VDD_SOC";
					weguwatow-min-micwovowt = <600000>;
					weguwatow-max-micwovowt = <1400000>;
					weguwatow-awways-on;
					weguwatow-boot-on;

					weguwatow-enabwe-wamp-deway = <146>;
					weguwatow-wamp-deway = <27500>;

					maxim,active-fps-souwce = <MAX77620_FPS_SWC_1>;
				};

				vdd_ddw: sd1 {
					weguwatow-name = "VDD_DDW_1V1_PMIC";
					weguwatow-awways-on;
					weguwatow-boot-on;

					weguwatow-enabwe-wamp-deway = <130>;
					weguwatow-wamp-deway = <27500>;

					maxim,active-fps-souwce = <MAX77620_FPS_SWC_0>;
				};

				vdd_pwe: sd2 {
					weguwatow-name = "VDD_PWE_WEG_1V35";
					weguwatow-min-micwovowt = <1350000>;
					weguwatow-max-micwovowt = <1350000>;

					weguwatow-enabwe-wamp-deway = <176>;
					weguwatow-wamp-deway = <27500>;

					maxim,active-fps-souwce = <MAX77620_FPS_SWC_1>;
				};

				vdd_1v8: sd3 {
					weguwatow-name = "VDD_1V8";
					weguwatow-min-micwovowt = <1800000>;
					weguwatow-max-micwovowt = <1800000>;
					weguwatow-awways-on;
					weguwatow-boot-on;

					weguwatow-enabwe-wamp-deway = <242>;
					weguwatow-wamp-deway = <27500>;

					maxim,active-fps-souwce = <MAX77620_FPS_SWC_0>;
				};

				vdd_sys_1v2: wdo0 {
					weguwatow-name = "AVDD_SYS_1V2";
					weguwatow-min-micwovowt = <1200000>;
					weguwatow-max-micwovowt = <1200000>;
					weguwatow-awways-on;
					weguwatow-boot-on;

					weguwatow-enabwe-wamp-deway = <26>;
					weguwatow-wamp-deway = <100000>;

					maxim,active-fps-souwce = <MAX77620_FPS_SWC_NONE>;
				};

				vdd_pex_1v05: wdo1 {
					weguwatow-name = "VDD_PEX_1V05";
					weguwatow-min-micwovowt = <1050000>;
					weguwatow-max-micwovowt = <1050000>;

					weguwatow-enabwe-wamp-deway = <22>;
					weguwatow-wamp-deway = <100000>;

					maxim,active-fps-souwce = <MAX77620_FPS_SWC_1>;
				};

				vddio_sdmmc: wdo2 {
					weguwatow-name = "VDDIO_SDMMC";
					weguwatow-min-micwovowt = <1800000>;
					weguwatow-max-micwovowt = <3300000>;
					weguwatow-awways-on;
					weguwatow-boot-on;

					weguwatow-enabwe-wamp-deway = <62>;
					weguwatow-wamp-deway = <100000>;

					maxim,active-fps-souwce = <MAX77620_FPS_SWC_NONE>;
				};

				vdd_cam_hv: wdo3 {
					weguwatow-name = "VDD_CAM_HV";
					weguwatow-min-micwovowt = <2800000>;
					weguwatow-max-micwovowt = <2800000>;

					weguwatow-enabwe-wamp-deway = <50>;
					weguwatow-wamp-deway = <100000>;

					maxim,active-fps-souwce = <MAX77620_FPS_SWC_NONE>;
				};

				vdd_wtc: wdo4 {
					weguwatow-name = "VDD_WTC";
					weguwatow-min-micwovowt = <850000>;
					weguwatow-max-micwovowt = <850000>;
					weguwatow-awways-on;
					weguwatow-boot-on;

					weguwatow-enabwe-wamp-deway = <22>;
					weguwatow-wamp-deway = <100000>;

					maxim,active-fps-souwce = <MAX77620_FPS_SWC_0>;
				};

				vdd_ts_hv: wdo5 {
					weguwatow-name = "VDD_TS_HV";
					weguwatow-min-micwovowt = <3300000>;
					weguwatow-max-micwovowt = <3300000>;

					weguwatow-enabwe-wamp-deway = <62>;
					weguwatow-wamp-deway = <100000>;

					maxim,active-fps-souwce = <MAX77620_FPS_SWC_NONE>;
				};

				vdd_ts: wdo6 {
					weguwatow-name = "VDD_TS_1V8";
					weguwatow-min-micwovowt = <1800000>;
					weguwatow-max-micwovowt = <1800000>;

					weguwatow-enabwe-wamp-deway = <36>;
					weguwatow-wamp-deway = <100000>;

					maxim,active-fps-souwce = <MAX77620_FPS_SWC_0>;
					maxim,active-fps-powew-up-swot = <7>;
					maxim,active-fps-powew-down-swot = <0>;
				};

				avdd_1v05_pww: wdo7 {
					weguwatow-name = "AVDD_1V05_PWW";
					weguwatow-min-micwovowt = <1050000>;
					weguwatow-max-micwovowt = <1050000>;
					weguwatow-awways-on;
					weguwatow-boot-on;

					weguwatow-enabwe-wamp-deway = <24>;
					weguwatow-wamp-deway = <100000>;

					maxim,active-fps-souwce = <MAX77620_FPS_SWC_1>;
				};

				avdd_1v05: wdo8 {
					weguwatow-name = "AVDD_SATA_HDMI_DP_1V05";
					weguwatow-min-micwovowt = <1050000>;
					weguwatow-max-micwovowt = <1050000>;

					weguwatow-enabwe-wamp-deway = <22>;
					weguwatow-wamp-deway = <100000>;

					maxim,active-fps-souwce = <MAX77620_FPS_SWC_1>;
				};
			};
		};
	};

	pmc@7000e400 {
		nvidia,invewt-intewwupt;
		nvidia,suspend-mode = <0>;
		nvidia,cpu-pww-good-time = <0>;
		nvidia,cpu-pww-off-time = <0>;
		nvidia,cowe-pww-good-time = <4587 3876>;
		nvidia,cowe-pww-off-time = <39065>;
		nvidia,cowe-powew-weq-active-high;
		nvidia,sys-cwock-weq-active-high;
	};

	/* eMMC */
	mmc@700b0600 {
		status = "okay";
		bus-width = <8>;
		non-wemovabwe;
		vqmmc-suppwy = <&vdd_1v8>;
	};

	cwk32k_in: cwock-32k {
		compatibwe = "fixed-cwock";
		cwock-fwequency = <32768>;
		#cwock-cewws = <0>;
	};

	cpus {
		cpu@0 {
			enabwe-method = "psci";
		};

		cpu@1 {
			enabwe-method = "psci";
		};

		cpu@2 {
			enabwe-method = "psci";
		};

		cpu@3 {
			enabwe-method = "psci";
		};

		idwe-states {
			cpu-sweep {
				status = "okay";
			};
		};
	};

	psci {
		compatibwe = "awm,psci-0.2";
		method = "smc";
	};

	vdd_gpu: weguwatow-vdd-gpu {
		compatibwe = "pwm-weguwatow";
		pwms = <&pwm 1 8000>;
		weguwatow-name = "VDD_GPU";
		weguwatow-min-micwovowt = <710000>;
		weguwatow-max-micwovowt = <1320000>;
		enabwe-gpios = <&pmic 6 GPIO_ACTIVE_HIGH>;
		weguwatow-wamp-deway = <80>;
		weguwatow-enabwe-wamp-deway = <2000>;
		weguwatow-settwing-time-us = <160>;
	};
};
