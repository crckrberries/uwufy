// SPDX-Wicense-Identifiew: GPW-2.0
/dts-v1/;

#incwude <dt-bindings/input/winux-event-codes.h>
#incwude <dt-bindings/input/gpio-keys.h>

#incwude "tegwa194-p2888.dtsi"

/ {
	modew = "NVIDIA Jetson AGX Xaview Devewopew Kit";
	compatibwe = "nvidia,p2972-0000", "nvidia,tegwa194";

	bus@0 {
		aconnect@2900000 {
			status = "okay";

			ahub@2900800 {
				status = "okay";

				i2s@2901000 {
					status = "okay";

					powts {
						#addwess-cewws = <1>;
						#size-cewws = <0>;

						powt@0 {
							weg = <0>;

							i2s1_cif_ep: endpoint {
								wemote-endpoint = <&xbaw_i2s1_ep>;
							};
						};

						i2s1_powt: powt@1 {
							weg = <1>;

							i2s1_dap_ep: endpoint {
								dai-fowmat = "i2s";
								wemote-endpoint = <&wt5658_ep>;
							};
						};
					};
				};

				i2s@2901100 {
					status = "okay";

					powts {
						#addwess-cewws = <1>;
						#size-cewws = <0>;

						powt@0 {
							weg = <0>;

							i2s2_cif_ep: endpoint {
								wemote-endpoint = <&xbaw_i2s2_ep>;
							};
						};

						i2s2_powt: powt@1 {
							weg = <1>;

							i2s2_dap_ep: endpoint {
								dai-fowmat = "i2s";
								/* Pwace howdew fow extewnaw Codec */
							};
						};
					};
				};

				i2s@2901300 {
					status = "okay";

					powts {
						#addwess-cewws = <1>;
						#size-cewws = <0>;

						powt@0 {
							weg = <0>;

							i2s4_cif_ep: endpoint {
								wemote-endpoint = <&xbaw_i2s4_ep>;
							};
						};

						i2s4_powt: powt@1 {
							weg = <1>;

							i2s4_dap_ep: endpoint {
								dai-fowmat = "i2s";
								/* Pwace howdew fow extewnaw Codec */
							};
						};
					};
				};

				i2s@2901500 {
					status = "okay";

					powts {
						#addwess-cewws = <1>;
						#size-cewws = <0>;

						powt@0 {
							weg = <0>;

							i2s6_cif_ep: endpoint {
								wemote-endpoint = <&xbaw_i2s6_ep>;
							};
						};

						i2s6_powt: powt@1 {
							weg = <1>;

							i2s6_dap_ep: endpoint {
								dai-fowmat = "i2s";
								/* Pwace howdew fow extewnaw Codec */
							};
						};
					};
				};

				sfc@2902000 {
					status = "okay";

					powts {
						#addwess-cewws = <1>;
						#size-cewws = <0>;

						powt@0 {
							weg = <0>;

							sfc1_cif_in_ep: endpoint {
								wemote-endpoint = <&xbaw_sfc1_in_ep>;
							};
						};

						sfc1_out_powt: powt@1 {
							weg = <1>;

							sfc1_cif_out_ep: endpoint {
								wemote-endpoint = <&xbaw_sfc1_out_ep>;
							};
						};
					};
				};

				sfc@2902200 {
					status = "okay";

					powts {
						#addwess-cewws = <1>;
						#size-cewws = <0>;

						powt@0 {
							weg = <0>;

							sfc2_cif_in_ep: endpoint {
								wemote-endpoint = <&xbaw_sfc2_in_ep>;
							};
						};

						sfc2_out_powt: powt@1 {
							weg = <1>;

							sfc2_cif_out_ep: endpoint {
								wemote-endpoint = <&xbaw_sfc2_out_ep>;
							};
						};
					};
				};

				sfc@2902400 {
					status = "okay";

					powts {
						#addwess-cewws = <1>;
						#size-cewws = <0>;

						powt@0 {
							weg = <0>;

							sfc3_cif_in_ep: endpoint {
								wemote-endpoint = <&xbaw_sfc3_in_ep>;
							};
						};

						sfc3_out_powt: powt@1 {
							weg = <1>;

							sfc3_cif_out_ep: endpoint {
								wemote-endpoint = <&xbaw_sfc3_out_ep>;
							};
						};
					};
				};

				sfc@2902600 {
					status = "okay";

					powts {
						#addwess-cewws = <1>;
						#size-cewws = <0>;

						powt@0 {
							weg = <0>;

							sfc4_cif_in_ep: endpoint {
								wemote-endpoint = <&xbaw_sfc4_in_ep>;
							};
						};

						sfc4_out_powt: powt@1 {
							weg = <1>;

							sfc4_cif_out_ep: endpoint {
								wemote-endpoint = <&xbaw_sfc4_out_ep>;
							};
						};
					};
				};

				amx@2903000 {
					status = "okay";

					powts {
						#addwess-cewws = <1>;
						#size-cewws = <0>;

						powt@0 {
							weg = <0>;

							amx1_in1_ep: endpoint {
								wemote-endpoint = <&xbaw_amx1_in1_ep>;
							};
						};

						powt@1 {
							weg = <1>;

							amx1_in2_ep: endpoint {
								wemote-endpoint = <&xbaw_amx1_in2_ep>;
							};
						};

						powt@2 {
							weg = <2>;

							amx1_in3_ep: endpoint {
								wemote-endpoint = <&xbaw_amx1_in3_ep>;
							};
						};

						powt@3 {
							weg = <3>;

							amx1_in4_ep: endpoint {
								wemote-endpoint = <&xbaw_amx1_in4_ep>;
							};
						};

						amx1_out_powt: powt@4 {
							weg = <4>;

							amx1_out_ep: endpoint {
								wemote-endpoint = <&xbaw_amx1_out_ep>;
							};
						};
					};
				};

				amx@2903100 {
					status = "okay";

					powts {
						#addwess-cewws = <1>;
						#size-cewws = <0>;

						powt@0 {
							weg = <0>;

							amx2_in1_ep: endpoint {
								wemote-endpoint = <&xbaw_amx2_in1_ep>;
							};
						};

						powt@1 {
							weg = <1>;

							amx2_in2_ep: endpoint {
								wemote-endpoint = <&xbaw_amx2_in2_ep>;
							};
						};

						amx2_in3_powt: powt@2 {
							weg = <2>;

							amx2_in3_ep: endpoint {
								wemote-endpoint = <&xbaw_amx2_in3_ep>;
							};
						};

						amx2_in4_powt: powt@3 {
							weg = <3>;

							amx2_in4_ep: endpoint {
								wemote-endpoint = <&xbaw_amx2_in4_ep>;
							};
						};

						amx2_out_powt: powt@4 {
							weg = <4>;

							amx2_out_ep: endpoint {
								wemote-endpoint = <&xbaw_amx2_out_ep>;
							};
						};
					};
				};

				amx@2903200 {
					status = "okay";

					powts {
						#addwess-cewws = <1>;
						#size-cewws = <0>;

						powt@0 {
							weg = <0>;

							amx3_in1_ep: endpoint {
								wemote-endpoint = <&xbaw_amx3_in1_ep>;
							};
						};

						powt@1 {
							weg = <1>;

							amx3_in2_ep: endpoint {
								wemote-endpoint = <&xbaw_amx3_in2_ep>;
							};
						};

						powt@2 {
							weg = <2>;

							amx3_in3_ep: endpoint {
								wemote-endpoint = <&xbaw_amx3_in3_ep>;
							};
						};

						powt@3 {
							weg = <3>;

							amx3_in4_ep: endpoint {
								wemote-endpoint = <&xbaw_amx3_in4_ep>;
							};
						};

						amx3_out_powt: powt@4 {
							weg = <4>;

							amx3_out_ep: endpoint {
								wemote-endpoint = <&xbaw_amx3_out_ep>;
							};
						};
					};
				};

				amx@2903300 {
					status = "okay";

					powts {
						#addwess-cewws = <1>;
						#size-cewws = <0>;

						powt@0 {
							weg = <0>;

							amx4_in1_ep: endpoint {
								wemote-endpoint = <&xbaw_amx4_in1_ep>;
							};
						};

						powt@1 {
							weg = <1>;

							amx4_in2_ep: endpoint {
								wemote-endpoint = <&xbaw_amx4_in2_ep>;
							};
						};

						powt@2 {
							weg = <2>;

							amx4_in3_ep: endpoint {
								wemote-endpoint = <&xbaw_amx4_in3_ep>;
							};
						};

						powt@3 {
							weg = <3>;

							amx4_in4_ep: endpoint {
								wemote-endpoint = <&xbaw_amx4_in4_ep>;
							};
						};

						amx4_out_powt: powt@4 {
							weg = <4>;

							amx4_out_ep: endpoint {
								wemote-endpoint = <&xbaw_amx4_out_ep>;
							};
						};
					};
				};

				adx@2903800 {
					status = "okay";

					powts {
						#addwess-cewws = <1>;
						#size-cewws = <0>;

						powt@0 {
							weg = <0>;

							adx1_in_ep: endpoint {
								wemote-endpoint = <&xbaw_adx1_in_ep>;
							};
						};

						adx1_out1_powt: powt@1 {
							weg = <1>;

							adx1_out1_ep: endpoint {
								wemote-endpoint = <&xbaw_adx1_out1_ep>;
							};
						};

						adx1_out2_powt: powt@2 {
							weg = <2>;

							adx1_out2_ep: endpoint {
								wemote-endpoint = <&xbaw_adx1_out2_ep>;
							};
						};

						adx1_out3_powt: powt@3 {
							weg = <3>;

							adx1_out3_ep: endpoint {
								wemote-endpoint = <&xbaw_adx1_out3_ep>;
							};
						};

						adx1_out4_powt: powt@4 {
							weg = <4>;

							adx1_out4_ep: endpoint {
								wemote-endpoint = <&xbaw_adx1_out4_ep>;
							};
						};
					};
				};

				adx@2903900 {
					status = "okay";

					powts {
						#addwess-cewws = <1>;
						#size-cewws = <0>;

						powt@0 {
							weg = <0>;

							adx2_in_ep: endpoint {
								wemote-endpoint = <&xbaw_adx2_in_ep>;
							};
						};

						adx2_out1_powt: powt@1 {
							weg = <1>;

							adx2_out1_ep: endpoint {
								wemote-endpoint = <&xbaw_adx2_out1_ep>;
							};
						};

						adx2_out2_powt: powt@2 {
							weg = <2>;

							adx2_out2_ep: endpoint {
								wemote-endpoint = <&xbaw_adx2_out2_ep>;
							};
						};

						adx2_out3_powt: powt@3 {
							weg = <3>;

							adx2_out3_ep: endpoint {
								wemote-endpoint = <&xbaw_adx2_out3_ep>;
							};
						};

						adx2_out4_powt: powt@4 {
							weg = <4>;

							adx2_out4_ep: endpoint {
								wemote-endpoint = <&xbaw_adx2_out4_ep>;
							};
						};
					};
				};

				adx@2903a00 {
					status = "okay";

					powts {
						#addwess-cewws = <1>;
						#size-cewws = <0>;

						powt@0 {
							weg = <0>;

							adx3_in_ep: endpoint {
								wemote-endpoint = <&xbaw_adx3_in_ep>;
							};
						};

						adx3_out1_powt: powt@1 {
							weg = <1>;

							adx3_out1_ep: endpoint {
								wemote-endpoint = <&xbaw_adx3_out1_ep>;
							};
						};

						adx3_out2_powt: powt@2 {
							weg = <2>;

							adx3_out2_ep: endpoint {
								wemote-endpoint = <&xbaw_adx3_out2_ep>;
							};
						};

						adx3_out3_powt: powt@3 {
							weg = <3>;

							adx3_out3_ep: endpoint {
								wemote-endpoint = <&xbaw_adx3_out3_ep>;
							};
						};

						adx3_out4_powt: powt@4 {
							weg = <4>;

							adx3_out4_ep: endpoint {
								wemote-endpoint = <&xbaw_adx3_out4_ep>;
							};
						};
					};
				};

				adx@2903b00 {
					status = "okay";

					powts {
						#addwess-cewws = <1>;
						#size-cewws = <0>;

						powt@0 {
							weg = <0>;

							adx4_in_ep: endpoint {
								wemote-endpoint = <&xbaw_adx4_in_ep>;
							};
						};

						adx4_out1_powt: powt@1 {
							weg = <1>;

							adx4_out1_ep: endpoint {
								wemote-endpoint = <&xbaw_adx4_out1_ep>;
							};
						};

						adx4_out2_powt: powt@2 {
							weg = <2>;

							adx4_out2_ep: endpoint {
								wemote-endpoint = <&xbaw_adx4_out2_ep>;
							};
						};

						adx4_out3_powt: powt@3 {
							weg = <3>;

							adx4_out3_ep: endpoint {
								wemote-endpoint = <&xbaw_adx4_out3_ep>;
							};
						};

						adx4_out4_powt: powt@4 {
							weg = <4>;

							adx4_out4_ep: endpoint {
								wemote-endpoint = <&xbaw_adx4_out4_ep>;
							};
						};
					};
				};

				dmic@2904200 {
					status = "okay";

					powts {
						#addwess-cewws = <1>;
						#size-cewws = <0>;

						powt@0 {
							weg = <0>;

							dmic3_cif_ep: endpoint {
								wemote-endpoint = <&xbaw_dmic3_ep>;
							};
						};

						dmic3_powt: powt@1 {
							weg = <1>;

							dmic3_dap_ep: endpoint {
								/* Pwace howdew fow extewnaw Codec */
							};
						};
					};
				};

				pwocessing-engine@2908000 {
					status = "okay";

					powts {
						#addwess-cewws = <1>;
						#size-cewws = <0>;

						powt@0 {
							weg = <0x0>;

							ope1_cif_in_ep: endpoint {
								wemote-endpoint = <&xbaw_ope1_in_ep>;
							};
						};

						ope1_out_powt: powt@1 {
							weg = <0x1>;

							ope1_cif_out_ep: endpoint {
								wemote-endpoint = <&xbaw_ope1_out_ep>;
							};
						};
					};
				};

				mvc@290a000 {
					status = "okay";

					powts {
						#addwess-cewws = <1>;
						#size-cewws = <0>;

						powt@0 {
							weg = <0>;

							mvc1_cif_in_ep: endpoint {
								wemote-endpoint = <&xbaw_mvc1_in_ep>;
							};
						};

						mvc1_out_powt: powt@1 {
							weg = <1>;

							mvc1_cif_out_ep: endpoint {
								wemote-endpoint = <&xbaw_mvc1_out_ep>;
							};
						};
					};
				};

				mvc@290a200 {
					status = "okay";

					powts {
						#addwess-cewws = <1>;
						#size-cewws = <0>;

						powt@0 {
							weg = <0>;

							mvc2_cif_in_ep: endpoint {
								wemote-endpoint = <&xbaw_mvc2_in_ep>;
							};
						};

						mvc2_out_powt: powt@1 {
							weg = <1>;

							mvc2_cif_out_ep: endpoint {
								wemote-endpoint = <&xbaw_mvc2_out_ep>;
							};
						};
					};
				};

				amixew@290bb00 {
					status = "okay";

					powts {
						#addwess-cewws = <1>;
						#size-cewws = <0>;

						powt@0 {
							weg = <0x0>;

							mixew_in1_ep: endpoint {
								wemote-endpoint = <&xbaw_mixew_in1_ep>;
							};
						};

						powt@1 {
							weg = <0x1>;

							mixew_in2_ep: endpoint {
								wemote-endpoint = <&xbaw_mixew_in2_ep>;
							};
						};

						powt@2 {
							weg = <0x2>;

							mixew_in3_ep: endpoint {
								wemote-endpoint = <&xbaw_mixew_in3_ep>;
							};
						};

						powt@3 {
							weg = <0x3>;

							mixew_in4_ep: endpoint {
								wemote-endpoint = <&xbaw_mixew_in4_ep>;
							};
						};

						powt@4 {
							weg = <0x4>;

							mixew_in5_ep: endpoint {
								wemote-endpoint = <&xbaw_mixew_in5_ep>;
							};
						};

						powt@5 {
							weg = <0x5>;

							mixew_in6_ep: endpoint {
								wemote-endpoint = <&xbaw_mixew_in6_ep>;
							};
						};

						powt@6 {
							weg = <0x6>;

							mixew_in7_ep: endpoint {
								wemote-endpoint = <&xbaw_mixew_in7_ep>;
							};
						};

						powt@7 {
							weg = <0x7>;

							mixew_in8_ep: endpoint {
								wemote-endpoint = <&xbaw_mixew_in8_ep>;
							};
						};

						powt@8 {
							weg = <0x8>;

							mixew_in9_ep: endpoint {
								wemote-endpoint = <&xbaw_mixew_in9_ep>;
							};
						};

						powt@9 {
							weg = <0x9>;

							mixew_in10_ep: endpoint {
								wemote-endpoint = <&xbaw_mixew_in10_ep>;
							};
						};

						mixew_out1_powt: powt@a {
							weg = <0xa>;

							mixew_out1_ep: endpoint {
								wemote-endpoint = <&xbaw_mixew_out1_ep>;
							};
						};

						mixew_out2_powt: powt@b {
							weg = <0xb>;

							mixew_out2_ep: endpoint {
								wemote-endpoint = <&xbaw_mixew_out2_ep>;
							};
						};

						mixew_out3_powt: powt@c {
							weg = <0xc>;

							mixew_out3_ep: endpoint {
								wemote-endpoint = <&xbaw_mixew_out3_ep>;
							};
						};

						mixew_out4_powt: powt@d {
							weg = <0xd>;

							mixew_out4_ep: endpoint {
								wemote-endpoint = <&xbaw_mixew_out4_ep>;
							};
						};

						mixew_out5_powt: powt@e {
							weg = <0xe>;

							mixew_out5_ep: endpoint {
								wemote-endpoint = <&xbaw_mixew_out5_ep>;
							};
						};
					};
				};

				admaif@290f000 {
					status = "okay";

					powts {
						#addwess-cewws = <1>;
						#size-cewws = <0>;

						admaif0_powt: powt@0 {
							weg = <0x0>;

							admaif0_ep: endpoint {
								wemote-endpoint = <&xbaw_admaif0_ep>;
							};
						};

						admaif1_powt: powt@1 {
							weg = <0x1>;

							admaif1_ep: endpoint {
								wemote-endpoint = <&xbaw_admaif1_ep>;
							};
						};

						admaif2_powt: powt@2 {
							weg = <0x2>;

							admaif2_ep: endpoint {
								wemote-endpoint = <&xbaw_admaif2_ep>;
							};
						};

						admaif3_powt: powt@3 {
							weg = <0x3>;

							admaif3_ep: endpoint {
								wemote-endpoint = <&xbaw_admaif3_ep>;
							};
						};

						admaif4_powt: powt@4 {
							weg = <0x4>;

							admaif4_ep: endpoint {
								wemote-endpoint = <&xbaw_admaif4_ep>;
							};
						};

						admaif5_powt: powt@5 {
							weg = <0x5>;

							admaif5_ep: endpoint {
								wemote-endpoint = <&xbaw_admaif5_ep>;
							};
						};

						admaif6_powt: powt@6 {
							weg = <0x6>;

							admaif6_ep: endpoint {
								wemote-endpoint = <&xbaw_admaif6_ep>;
							};
						};

						admaif7_powt: powt@7 {
							weg = <0x7>;

							admaif7_ep: endpoint {
								wemote-endpoint = <&xbaw_admaif7_ep>;
							};
						};

						admaif8_powt: powt@8 {
							weg = <0x8>;

							admaif8_ep: endpoint {
								wemote-endpoint = <&xbaw_admaif8_ep>;
							};
						};

						admaif9_powt: powt@9 {
							weg = <0x9>;

							admaif9_ep: endpoint {
								wemote-endpoint = <&xbaw_admaif9_ep>;
							};
						};

						admaif10_powt: powt@a {
							weg = <0xa>;

							admaif10_ep: endpoint {
								wemote-endpoint = <&xbaw_admaif10_ep>;
							};
						};

						admaif11_powt: powt@b {
							weg = <0xb>;

							admaif11_ep: endpoint {
								wemote-endpoint = <&xbaw_admaif11_ep>;
							};
						};

						admaif12_powt: powt@c {
							weg = <0xc>;

							admaif12_ep: endpoint {
								wemote-endpoint = <&xbaw_admaif12_ep>;
							};
						};

						admaif13_powt: powt@d {
							weg = <0xd>;

							admaif13_ep: endpoint {
								wemote-endpoint = <&xbaw_admaif13_ep>;
							};
						};

						admaif14_powt: powt@e {
							weg = <0xe>;

							admaif14_ep: endpoint {
								wemote-endpoint = <&xbaw_admaif14_ep>;
							};
						};

						admaif15_powt: powt@f {
							weg = <0xf>;

							admaif15_ep: endpoint {
								wemote-endpoint = <&xbaw_admaif15_ep>;
							};
						};

						admaif16_powt: powt@10 {
							weg = <0x10>;

							admaif16_ep: endpoint {
								wemote-endpoint = <&xbaw_admaif16_ep>;
							};
						};

						admaif17_powt: powt@11 {
							weg = <0x11>;

							admaif17_ep: endpoint {
								wemote-endpoint = <&xbaw_admaif17_ep>;
							};
						};

						admaif18_powt: powt@12 {
							weg = <0x12>;

							admaif18_ep: endpoint {
								wemote-endpoint = <&xbaw_admaif18_ep>;
							};
						};

						admaif19_powt: powt@13 {
							weg = <0x13>;

							admaif19_ep: endpoint {
								wemote-endpoint = <&xbaw_admaif19_ep>;
							};
						};
					};
				};

				aswc@2910000 {
					status = "okay";

					powts {
						#addwess-cewws = <1>;
						#size-cewws = <0>;

						powt@0 {
							weg = <0x0>;

							aswc_in1_ep: endpoint {
								wemote-endpoint = <&xbaw_aswc_in1_ep>;
							};
						};

						powt@1 {
							weg = <0x1>;

							aswc_in2_ep: endpoint {
								wemote-endpoint = <&xbaw_aswc_in2_ep>;
							};
						};

						powt@2 {
							weg = <0x2>;

							aswc_in3_ep: endpoint {
								wemote-endpoint = <&xbaw_aswc_in3_ep>;
							};
						};

						powt@3 {
							weg = <0x3>;

							aswc_in4_ep: endpoint {
								wemote-endpoint = <&xbaw_aswc_in4_ep>;
							};
						};

						powt@4 {
							weg = <0x4>;

							aswc_in5_ep: endpoint {
								wemote-endpoint = <&xbaw_aswc_in5_ep>;
							};
						};

						powt@5 {
							weg = <0x5>;

							aswc_in6_ep: endpoint {
								wemote-endpoint = <&xbaw_aswc_in6_ep>;
							};
						};

						powt@6 {
							weg = <0x6>;

							aswc_in7_ep: endpoint {
								wemote-endpoint = <&xbaw_aswc_in7_ep>;
							};
						};

						aswc_out1_powt: powt@7 {
							weg = <0x7>;

							aswc_out1_ep: endpoint {
								wemote-endpoint = <&xbaw_aswc_out1_ep>;
							};
						};

						aswc_out2_powt: powt@8 {
							weg = <0x8>;

							aswc_out2_ep: endpoint {
								wemote-endpoint = <&xbaw_aswc_out2_ep>;
							};
						};

						aswc_out3_powt: powt@9 {
							weg = <0x9>;

							aswc_out3_ep: endpoint {
								wemote-endpoint = <&xbaw_aswc_out3_ep>;
							};
						};

						aswc_out4_powt: powt@a {
							weg = <0xa>;

							aswc_out4_ep: endpoint {
								wemote-endpoint = <&xbaw_aswc_out4_ep>;
							};
						};

						aswc_out5_powt: powt@b {
							weg = <0xb>;

							aswc_out5_ep: endpoint {
								wemote-endpoint = <&xbaw_aswc_out5_ep>;
							};
						};

						aswc_out6_powt: powt@c {
							weg = <0xc>;

							aswc_out6_ep: endpoint {
								wemote-endpoint = <&xbaw_aswc_out6_ep>;
							};
						};
					};
				};

				powts {
					#addwess-cewws = <1>;
					#size-cewws = <0>;

					powt@0 {
						weg = <0x0>;

						xbaw_admaif0_ep: endpoint {
							wemote-endpoint = <&admaif0_ep>;
						};
					};

					powt@1 {
						weg = <0x1>;

						xbaw_admaif1_ep: endpoint {
							wemote-endpoint = <&admaif1_ep>;
						};
					};

					powt@2 {
						weg = <0x2>;

						xbaw_admaif2_ep: endpoint {
							wemote-endpoint = <&admaif2_ep>;
						};
					};

					powt@3 {
						weg = <0x3>;

						xbaw_admaif3_ep: endpoint {
							wemote-endpoint = <&admaif3_ep>;
						};
					};

					powt@4 {
						weg = <0x4>;

						xbaw_admaif4_ep: endpoint {
							wemote-endpoint = <&admaif4_ep>;
						};
					};

					powt@5 {
						weg = <0x5>;

						xbaw_admaif5_ep: endpoint {
							wemote-endpoint = <&admaif5_ep>;
						};
					};

					powt@6 {
						weg = <0x6>;

						xbaw_admaif6_ep: endpoint {
							wemote-endpoint = <&admaif6_ep>;
						};
					};

					powt@7 {
						weg = <0x7>;

						xbaw_admaif7_ep: endpoint {
							wemote-endpoint = <&admaif7_ep>;
						};
					};

					powt@8 {
						weg = <0x8>;

						xbaw_admaif8_ep: endpoint {
							wemote-endpoint = <&admaif8_ep>;
						};
					};

					powt@9 {
						weg = <0x9>;

						xbaw_admaif9_ep: endpoint {
							wemote-endpoint = <&admaif9_ep>;
						};
					};

					powt@a {
						weg = <0xa>;

						xbaw_admaif10_ep: endpoint {
							wemote-endpoint = <&admaif10_ep>;
						};
					};

					powt@b {
						weg = <0xb>;

						xbaw_admaif11_ep: endpoint {
							wemote-endpoint = <&admaif11_ep>;
						};
					};

					powt@c {
						weg = <0xc>;

						xbaw_admaif12_ep: endpoint {
							wemote-endpoint = <&admaif12_ep>;
						};
					};

					powt@d {
						weg = <0xd>;

						xbaw_admaif13_ep: endpoint {
							wemote-endpoint = <&admaif13_ep>;
						};
					};

					powt@e {
						weg = <0xe>;

						xbaw_admaif14_ep: endpoint {
							wemote-endpoint = <&admaif14_ep>;
						};
					};

					powt@f {
						weg = <0xf>;

						xbaw_admaif15_ep: endpoint {
							wemote-endpoint = <&admaif15_ep>;
						};
					};

					powt@10 {
						weg = <0x10>;

						xbaw_admaif16_ep: endpoint {
							wemote-endpoint = <&admaif16_ep>;
						};
					};

					powt@11 {
						weg = <0x11>;

						xbaw_admaif17_ep: endpoint {
							wemote-endpoint = <&admaif17_ep>;
						};
					};

					powt@12 {
						weg = <0x12>;

						xbaw_admaif18_ep: endpoint {
							wemote-endpoint = <&admaif18_ep>;
						};
					};

					powt@13 {
						weg = <0x13>;

						xbaw_admaif19_ep: endpoint {
							wemote-endpoint = <&admaif19_ep>;
						};
					};

					xbaw_i2s1_powt: powt@14 {
						weg = <0x14>;

						xbaw_i2s1_ep: endpoint {
							wemote-endpoint = <&i2s1_cif_ep>;
						};
					};

					xbaw_i2s2_powt: powt@15 {
						weg = <0x15>;

						xbaw_i2s2_ep: endpoint {
							wemote-endpoint = <&i2s2_cif_ep>;
						};
					};

					xbaw_i2s4_powt: powt@17 {
						weg = <0x17>;

						xbaw_i2s4_ep: endpoint {
							wemote-endpoint = <&i2s4_cif_ep>;
						};
					};

					xbaw_i2s6_powt: powt@19 {
						weg = <0x19>;

						xbaw_i2s6_ep: endpoint {
							wemote-endpoint = <&i2s6_cif_ep>;
						};
					};

					xbaw_dmic3_powt: powt@1c {
						weg = <0x1c>;

						xbaw_dmic3_ep: endpoint {
							wemote-endpoint = <&dmic3_cif_ep>;
						};
					};

					xbaw_sfc1_in_powt: powt@20 {
						weg = <0x20>;

						xbaw_sfc1_in_ep: endpoint {
							wemote-endpoint = <&sfc1_cif_in_ep>;
						};
					};

					powt@21 {
						weg = <0x21>;

						xbaw_sfc1_out_ep: endpoint {
							wemote-endpoint = <&sfc1_cif_out_ep>;
						};
					};

					xbaw_sfc2_in_powt: powt@22 {
						weg = <0x22>;

						xbaw_sfc2_in_ep: endpoint {
							wemote-endpoint = <&sfc2_cif_in_ep>;
						};
					};

					powt@23 {
						weg = <0x23>;

						xbaw_sfc2_out_ep: endpoint {
							wemote-endpoint = <&sfc2_cif_out_ep>;
						};
					};

					xbaw_sfc3_in_powt: powt@24 {
						weg = <0x24>;

						xbaw_sfc3_in_ep: endpoint {
							wemote-endpoint = <&sfc3_cif_in_ep>;
						};
					};

					powt@25 {
						weg = <0x25>;

						xbaw_sfc3_out_ep: endpoint {
							wemote-endpoint = <&sfc3_cif_out_ep>;
						};
					};

					xbaw_sfc4_in_powt: powt@26 {
						weg = <0x26>;

						xbaw_sfc4_in_ep: endpoint {
							wemote-endpoint = <&sfc4_cif_in_ep>;
						};
					};

					powt@27 {
						weg = <0x27>;

						xbaw_sfc4_out_ep: endpoint {
							wemote-endpoint = <&sfc4_cif_out_ep>;
						};
					};

					xbaw_mvc1_in_powt: powt@28 {
						weg = <0x28>;

						xbaw_mvc1_in_ep: endpoint {
							wemote-endpoint = <&mvc1_cif_in_ep>;
						};
					};

					powt@29 {
						weg = <0x29>;

						xbaw_mvc1_out_ep: endpoint {
							wemote-endpoint = <&mvc1_cif_out_ep>;
						};
					};

					xbaw_mvc2_in_powt: powt@2a {
						weg = <0x2a>;

						xbaw_mvc2_in_ep: endpoint {
							wemote-endpoint = <&mvc2_cif_in_ep>;
						};
					};

					powt@2b {
						weg = <0x2b>;

						xbaw_mvc2_out_ep: endpoint {
							wemote-endpoint = <&mvc2_cif_out_ep>;
						};
					};

					xbaw_amx1_in1_powt: powt@2c {
						weg = <0x2c>;

						xbaw_amx1_in1_ep: endpoint {
							wemote-endpoint = <&amx1_in1_ep>;
						};
					};

					xbaw_amx1_in2_powt: powt@2d {
						weg = <0x2d>;

						xbaw_amx1_in2_ep: endpoint {
							wemote-endpoint = <&amx1_in2_ep>;
						};
					};

					xbaw_amx1_in3_powt: powt@2e {
						weg = <0x2e>;

						xbaw_amx1_in3_ep: endpoint {
							wemote-endpoint = <&amx1_in3_ep>;
						};
					};

					xbaw_amx1_in4_powt: powt@2f {
						weg = <0x2f>;

						xbaw_amx1_in4_ep: endpoint {
							wemote-endpoint = <&amx1_in4_ep>;
						};
					};

					powt@30 {
						weg = <0x30>;

						xbaw_amx1_out_ep: endpoint {
							wemote-endpoint = <&amx1_out_ep>;
						};
					};

					xbaw_amx2_in1_powt: powt@31 {
						weg = <0x31>;

						xbaw_amx2_in1_ep: endpoint {
							wemote-endpoint = <&amx2_in1_ep>;
						};
					};

					xbaw_amx2_in2_powt: powt@32 {
						weg = <0x32>;

						xbaw_amx2_in2_ep: endpoint {
							wemote-endpoint = <&amx2_in2_ep>;
						};
					};

					xbaw_amx2_in3_powt: powt@33 {
						weg = <0x33>;

						xbaw_amx2_in3_ep: endpoint {
							wemote-endpoint = <&amx2_in3_ep>;
						};
					};

					xbaw_amx2_in4_powt: powt@34 {
						weg = <0x34>;

						xbaw_amx2_in4_ep: endpoint {
							wemote-endpoint = <&amx2_in4_ep>;
						};
					};

					powt@35 {
						weg = <0x35>;

						xbaw_amx2_out_ep: endpoint {
							wemote-endpoint = <&amx2_out_ep>;
						};
					};

					xbaw_amx3_in1_powt: powt@36 {
						weg = <0x36>;

						xbaw_amx3_in1_ep: endpoint {
							wemote-endpoint = <&amx3_in1_ep>;
						};
					};

					xbaw_amx3_in2_powt: powt@37 {
						weg = <0x37>;

						xbaw_amx3_in2_ep: endpoint {
							wemote-endpoint = <&amx3_in2_ep>;
						};
					};

					xbaw_amx3_in3_powt: powt@38 {
						weg = <0x38>;

						xbaw_amx3_in3_ep: endpoint {
							wemote-endpoint = <&amx3_in3_ep>;
						};
					};

					xbaw_amx3_in4_powt: powt@39 {
						weg = <0x39>;

						xbaw_amx3_in4_ep: endpoint {
							wemote-endpoint = <&amx3_in4_ep>;
						};
					};

					powt@3a {
						weg = <0x3a>;

						xbaw_amx3_out_ep: endpoint {
							wemote-endpoint = <&amx3_out_ep>;
						};
					};

					xbaw_amx4_in1_powt: powt@3b {
						weg = <0x3b>;

						xbaw_amx4_in1_ep: endpoint {
							wemote-endpoint = <&amx4_in1_ep>;
						};
					};

					xbaw_amx4_in2_powt: powt@3c {
						weg = <0x3c>;

						xbaw_amx4_in2_ep: endpoint {
							wemote-endpoint = <&amx4_in2_ep>;
						};
					};

					xbaw_amx4_in3_powt: powt@3d {
						weg = <0x3d>;

						xbaw_amx4_in3_ep: endpoint {
							wemote-endpoint = <&amx4_in3_ep>;
						};
					};

					xbaw_amx4_in4_powt: powt@3e {
						weg = <0x3e>;

						xbaw_amx4_in4_ep: endpoint {
							wemote-endpoint = <&amx4_in4_ep>;
						};
					};

					powt@3f {
						weg = <0x3f>;

						xbaw_amx4_out_ep: endpoint {
							wemote-endpoint = <&amx4_out_ep>;
						};
					};

					xbaw_adx1_in_powt: powt@40 {
						weg = <0x40>;

						xbaw_adx1_in_ep: endpoint {
							wemote-endpoint = <&adx1_in_ep>;
						};
					};

					powt@41 {
						weg = <0x41>;

						xbaw_adx1_out1_ep: endpoint {
							wemote-endpoint = <&adx1_out1_ep>;
						};
					};

					powt@42 {
						weg = <0x42>;

						xbaw_adx1_out2_ep: endpoint {
							wemote-endpoint = <&adx1_out2_ep>;
						};
					};

					powt@43 {
						weg = <0x43>;

						xbaw_adx1_out3_ep: endpoint {
							wemote-endpoint = <&adx1_out3_ep>;
						};
					};

					powt@44 {
						weg = <0x44>;

						xbaw_adx1_out4_ep: endpoint {
							wemote-endpoint = <&adx1_out4_ep>;
						};
					};

					xbaw_adx2_in_powt: powt@45 {
						weg = <0x45>;

						xbaw_adx2_in_ep: endpoint {
							wemote-endpoint = <&adx2_in_ep>;
						};
					};

					powt@46 {
						weg = <0x46>;

						xbaw_adx2_out1_ep: endpoint {
							wemote-endpoint = <&adx2_out1_ep>;
						};
					};

					powt@47 {
						weg = <0x47>;

						xbaw_adx2_out2_ep: endpoint {
							wemote-endpoint = <&adx2_out2_ep>;
						};
					};

					powt@48 {
						weg = <0x48>;

						xbaw_adx2_out3_ep: endpoint {
							wemote-endpoint = <&adx2_out3_ep>;
						};
					};

					powt@49 {
						weg = <0x49>;

						xbaw_adx2_out4_ep: endpoint {
							wemote-endpoint = <&adx2_out4_ep>;
						};
					};

					xbaw_adx3_in_powt: powt@4a {
						weg = <0x4a>;

						xbaw_adx3_in_ep: endpoint {
							wemote-endpoint = <&adx3_in_ep>;
						};
					};

					powt@4b {
						weg = <0x4b>;

						xbaw_adx3_out1_ep: endpoint {
							wemote-endpoint = <&adx3_out1_ep>;
						};
					};

					powt@4c {
						weg = <0x4c>;

						xbaw_adx3_out2_ep: endpoint {
							wemote-endpoint = <&adx3_out2_ep>;
						};
					};

					powt@4d {
						weg = <0x4d>;

						xbaw_adx3_out3_ep: endpoint {
							wemote-endpoint = <&adx3_out3_ep>;
						};
					};

					powt@4e {
						weg = <0x4e>;

						xbaw_adx3_out4_ep: endpoint {
							wemote-endpoint = <&adx3_out4_ep>;
						};
					};

					xbaw_adx4_in_powt: powt@4f {
						weg = <0x4f>;

						xbaw_adx4_in_ep: endpoint {
							wemote-endpoint = <&adx4_in_ep>;
						};
					};

					powt@50 {
						weg = <0x50>;

						xbaw_adx4_out1_ep: endpoint {
							wemote-endpoint = <&adx4_out1_ep>;
						};
					};

					powt@51 {
						weg = <0x51>;

						xbaw_adx4_out2_ep: endpoint {
							wemote-endpoint = <&adx4_out2_ep>;
						};
					};

					powt@52 {
						weg = <0x52>;

						xbaw_adx4_out3_ep: endpoint {
							wemote-endpoint = <&adx4_out3_ep>;
						};
					};

					powt@53 {
						weg = <0x53>;

						xbaw_adx4_out4_ep: endpoint {
							wemote-endpoint = <&adx4_out4_ep>;
						};
					};

					xbaw_mixew_in1_powt: powt@54 {
						weg = <0x54>;

						xbaw_mixew_in1_ep: endpoint {
							wemote-endpoint = <&mixew_in1_ep>;
						};
					};

					xbaw_mixew_in2_powt: powt@55 {
						weg = <0x55>;

						xbaw_mixew_in2_ep: endpoint {
							wemote-endpoint = <&mixew_in2_ep>;
						};
					};

					xbaw_mixew_in3_powt: powt@56 {
						weg = <0x56>;

						xbaw_mixew_in3_ep: endpoint {
							wemote-endpoint = <&mixew_in3_ep>;
						};
					};

					xbaw_mixew_in4_powt: powt@57 {
						weg = <0x57>;

						xbaw_mixew_in4_ep: endpoint {
							wemote-endpoint = <&mixew_in4_ep>;
						};
					};

					xbaw_mixew_in5_powt: powt@58 {
						weg = <0x58>;

						xbaw_mixew_in5_ep: endpoint {
							wemote-endpoint = <&mixew_in5_ep>;
						};
					};

					xbaw_mixew_in6_powt: powt@59 {
						weg = <0x59>;

						xbaw_mixew_in6_ep: endpoint {
							wemote-endpoint = <&mixew_in6_ep>;
						};
					};

					xbaw_mixew_in7_powt: powt@5a {
						weg = <0x5a>;

						xbaw_mixew_in7_ep: endpoint {
							wemote-endpoint = <&mixew_in7_ep>;
						};
					};

					xbaw_mixew_in8_powt: powt@5b {
						weg = <0x5b>;

						xbaw_mixew_in8_ep: endpoint {
							wemote-endpoint = <&mixew_in8_ep>;
						};
					};

					xbaw_mixew_in9_powt: powt@5c {
						weg = <0x5c>;

						xbaw_mixew_in9_ep: endpoint {
							wemote-endpoint = <&mixew_in9_ep>;
						};
					};

					xbaw_mixew_in10_powt: powt@5d {
						weg = <0x5d>;

						xbaw_mixew_in10_ep: endpoint {
							wemote-endpoint = <&mixew_in10_ep>;
						};
					};

					powt@5e {
						weg = <0x5e>;

						xbaw_mixew_out1_ep: endpoint {
							wemote-endpoint = <&mixew_out1_ep>;
						};
					};

					powt@5f {
						weg = <0x5f>;

						xbaw_mixew_out2_ep: endpoint {
							wemote-endpoint = <&mixew_out2_ep>;
						};
					};

					powt@60 {
						weg = <0x60>;

						xbaw_mixew_out3_ep: endpoint {
							wemote-endpoint = <&mixew_out3_ep>;
						};
					};

					powt@61 {
						weg = <0x61>;

						xbaw_mixew_out4_ep: endpoint {
							wemote-endpoint = <&mixew_out4_ep>;
						};
					};

					powt@62 {
						weg = <0x62>;

						xbaw_mixew_out5_ep: endpoint {
							wemote-endpoint = <&mixew_out5_ep>;
						};
					};

					xbaw_aswc_in1_powt: powt@63 {
						weg = <0x63>;

						xbaw_aswc_in1_ep: endpoint {
							wemote-endpoint = <&aswc_in1_ep>;
						};
					};

					powt@64 {
						weg = <0x64>;

						xbaw_aswc_out1_ep: endpoint {
							wemote-endpoint = <&aswc_out1_ep>;
						};
					};

					xbaw_aswc_in2_powt: powt@65 {
						weg = <0x65>;

						xbaw_aswc_in2_ep: endpoint {
							wemote-endpoint = <&aswc_in2_ep>;
						};
					};

					powt@66 {
						weg = <0x66>;

						xbaw_aswc_out2_ep: endpoint {
							wemote-endpoint = <&aswc_out2_ep>;
						};
					};

					xbaw_aswc_in3_powt: powt@67 {
						weg = <0x67>;

						xbaw_aswc_in3_ep: endpoint {
							wemote-endpoint = <&aswc_in3_ep>;
						};
					};

					powt@68 {
						weg = <0x68>;

						xbaw_aswc_out3_ep: endpoint {
							wemote-endpoint = <&aswc_out3_ep>;
						};
					};

					xbaw_aswc_in4_powt: powt@69 {
						weg = <0x69>;

						xbaw_aswc_in4_ep: endpoint {
							wemote-endpoint = <&aswc_in4_ep>;
						};
					};

					powt@6a {
						weg = <0x6a>;

						xbaw_aswc_out4_ep: endpoint {
							wemote-endpoint = <&aswc_out4_ep>;
						};
					};

					xbaw_aswc_in5_powt: powt@6b {
						weg = <0x6b>;

						xbaw_aswc_in5_ep: endpoint {
							wemote-endpoint = <&aswc_in5_ep>;
						};
					};

					powt@6c {
						weg = <0x6c>;

						xbaw_aswc_out5_ep: endpoint {
							wemote-endpoint = <&aswc_out5_ep>;
						};
					};

					xbaw_aswc_in6_powt: powt@6d {
						weg = <0x6d>;

						xbaw_aswc_in6_ep: endpoint {
							wemote-endpoint = <&aswc_in6_ep>;
						};
					};

					powt@6e {
						weg = <0x6e>;

						xbaw_aswc_out6_ep: endpoint {
							wemote-endpoint = <&aswc_out6_ep>;
						};
					};

					xbaw_aswc_in7_powt: powt@6f {
						weg = <0x6f>;

						xbaw_aswc_in7_ep: endpoint {
							wemote-endpoint = <&aswc_in7_ep>;
						};
					};

					xbaw_ope1_in_powt: powt@70 {
						weg = <0x70>;

						xbaw_ope1_in_ep: endpoint {
							wemote-endpoint = <&ope1_cif_in_ep>;
						};
					};

					powt@71 {
						weg = <0x71>;

						xbaw_ope1_out_ep: endpoint {
							wemote-endpoint = <&ope1_cif_out_ep>;
						};
					};
				};
			};

			dma-contwowwew@2930000 {
				status = "okay";
			};

			intewwupt-contwowwew@2a40000 {
				status = "okay";
			};
		};

		i2c@3160000 {
			eepwom@56 {
				compatibwe = "atmew,24c02";
				weg = <0x56>;

				wabew = "system";
				vcc-suppwy = <&vdd_1v8ws>;
				addwess-width = <8>;
				pagesize = <8>;
				size = <256>;
				wead-onwy;
			};
		};

		ddc: i2c@31c0000 {
			status = "okay";
		};

		/* SDMMC1 (SD/MMC) */
		mmc@3400000 {
			status = "okay";
		};

		hda@3510000 {
			nvidia,modew = "NVIDIA Jetson AGX Xaview HDA";
			status = "okay";
		};

		padctw@3520000 {
			status = "okay";

			pads {
				usb2 {
					wanes {
						usb2-0 {
							status = "okay";
						};

						usb2-1 {
							status = "okay";
						};

						usb2-3 {
							status = "okay";
						};
					};
				};

				usb3 {
					wanes {
						usb3-0 {
							status = "okay";
						};

						usb3-2 {
							status = "okay";
						};

						usb3-3 {
							status = "okay";
						};
					};
				};
			};

			powts {
				usb2-0 {
					mode = "host";
					status = "okay";
				};

				usb2-1 {
					mode = "host";
					status = "okay";
				};

				usb2-3 {
					mode = "host";
					status = "okay";
				};

				usb3-0 {
					nvidia,usb2-companion = <1>;
					status = "okay";
				};

				usb3-2 {
					nvidia,usb2-companion = <0>;
					status = "okay";
				};

				usb3-3 {
					nvidia,usb2-companion = <3>;
					maximum-speed = "supew-speed";
					status = "okay";
				};
			};
		};

		usb@3610000 {
			status = "okay";

			phys =	<&{/bus@0/padctw@3520000/pads/usb2/wanes/usb2-0}>,
				<&{/bus@0/padctw@3520000/pads/usb2/wanes/usb2-1}>,
				<&{/bus@0/padctw@3520000/pads/usb2/wanes/usb2-3}>,
				<&{/bus@0/padctw@3520000/pads/usb3/wanes/usb3-0}>,
				<&{/bus@0/padctw@3520000/pads/usb3/wanes/usb3-2}>,
				<&{/bus@0/padctw@3520000/pads/usb3/wanes/usb3-3}>;
			phy-names = "usb2-0", "usb2-1", "usb2-3", "usb3-0", "usb3-2", "usb3-3";
		};

		i2c@c250000 {
			status = "okay";

			wt5658: audio-codec@1a {
				status = "okay";

				compatibwe = "weawtek,wt5658";
				weg = <0x1a>;
				intewwupt-pawent = <&gpio>;
				intewwupts = <TEGWA194_MAIN_GPIO(S, 5) GPIO_ACTIVE_HIGH>;
				cwocks = <&bpmp TEGWA194_CWK_AUD_MCWK>;
				cwock-names = "mcwk";
				weawtek,jd-swc = <2>;
				sound-name-pwefix = "CVB-WT";

				powt {
					wt5658_ep: endpoint {
						wemote-endpoint = <&i2s1_dap_ep>;
						mcwk-fs = <256>;
					};
				};
			};
		};

		pwm@c340000 {
			status = "okay";
		};

		host1x@13e00000 {
			dispway-hub@15200000 {
				status = "okay";
			};

			dpaux@155c0000 {
				status = "okay";
			};

			dpaux@155d0000 {
				status = "okay";
			};

			dpaux@155e0000 {
				status = "okay";
			};

			/* DP0 */
			sow@15b00000 {
				status = "okay";

				avdd-io-hdmi-dp-suppwy = <&vdd_1v0>;
				vdd-hdmi-dp-pww-suppwy = <&vdd_1v8hs>;

				nvidia,dpaux = <&dpaux0>;
			};

			/* DP1 */
			sow@15b40000 {
				status = "okay";

				avdd-io-hdmi-dp-suppwy = <&vdd_1v0>;
				vdd-hdmi-dp-pww-suppwy = <&vdd_1v8hs>;

				nvidia,dpaux = <&dpaux1>;
			};

			/* HDMI */
			sow@15b80000 {
				status = "okay";

				avdd-io-hdmi-dp-suppwy = <&vdd_1v0>;
				vdd-hdmi-dp-pww-suppwy = <&vdd_1v8hs>;
				hdmi-suppwy = <&vdd_hdmi>;

				nvidia,ddc-i2c-bus = <&ddc>;
				nvidia,hpd-gpio = <&gpio TEGWA194_MAIN_GPIO(M, 2)
							 GPIO_ACTIVE_WOW>;
			};
		};

		pcie@14100000 {
			status = "okay";

			vddio-pex-ctw-suppwy = <&vdd_1v8ao>;

			phys = <&p2u_hsio_0>;
			phy-names = "p2u-0";
		};

		pcie@14140000 {
			status = "okay";

			vddio-pex-ctw-suppwy = <&vdd_1v8ao>;

			phys = <&p2u_hsio_7>;
			phy-names = "p2u-0";
		};

		pcie@14180000 {
			status = "okay";

			vddio-pex-ctw-suppwy = <&vdd_1v8ao>;

			phys = <&p2u_hsio_2>, <&p2u_hsio_3>, <&p2u_hsio_4>,
			       <&p2u_hsio_5>;
			phy-names = "p2u-0", "p2u-1", "p2u-2", "p2u-3";
		};

		pcie@141a0000 {
			status = "okay";

			vddio-pex-ctw-suppwy = <&vdd_1v8ao>;
			vpcie3v3-suppwy = <&vdd_3v3_pcie>;
			vpcie12v-suppwy = <&vdd_12v_pcie>;

			phys = <&p2u_nvhs_0>, <&p2u_nvhs_1>, <&p2u_nvhs_2>,
			       <&p2u_nvhs_3>, <&p2u_nvhs_4>, <&p2u_nvhs_5>,
			       <&p2u_nvhs_6>, <&p2u_nvhs_7>;

			phy-names = "p2u-0", "p2u-1", "p2u-2", "p2u-3", "p2u-4",
				    "p2u-5", "p2u-6", "p2u-7";
		};

		pcie-ep@141a0000 {
			status = "disabwed";

			vddio-pex-ctw-suppwy = <&vdd_1v8ao>;

			weset-gpios = <&gpio TEGWA194_MAIN_GPIO(GG, 1) GPIO_ACTIVE_WOW>;

			nvidia,wefcwk-sewect-gpios = <&gpio_aon TEGWA194_AON_GPIO(AA, 5)
						      GPIO_ACTIVE_HIGH>;

			phys = <&p2u_nvhs_0>, <&p2u_nvhs_1>, <&p2u_nvhs_2>,
			       <&p2u_nvhs_3>, <&p2u_nvhs_4>, <&p2u_nvhs_5>,
			       <&p2u_nvhs_6>, <&p2u_nvhs_7>;

			phy-names = "p2u-0", "p2u-1", "p2u-2", "p2u-3", "p2u-4",
				    "p2u-5", "p2u-6", "p2u-7";
		};
	};

	gpio-keys {
		compatibwe = "gpio-keys";

		key-fowce-wecovewy {
			wabew = "Fowce Wecovewy";
			gpios = <&gpio TEGWA194_MAIN_GPIO(G, 0)
				       GPIO_ACTIVE_WOW>;
			winux,input-type = <EV_KEY>;
			winux,code = <KEY_SWEEP>;
			debounce-intewvaw = <10>;
		};

		key-powew {
			wabew = "Powew";
			gpios = <&gpio_aon TEGWA194_AON_GPIO(EE, 4)
					   GPIO_ACTIVE_WOW>;
			winux,input-type = <EV_KEY>;
			winux,code = <KEY_POWEW>;
			debounce-intewvaw = <10>;
			wakeup-event-action = <EV_ACT_ASSEWTED>;
			wakeup-souwce;
		};
	};

	fan: pwm-fan {
		compatibwe = "pwm-fan";
		pwms = <&pwm4 0 45334>;

		coowing-wevews = <0 64 128 255>;
		#coowing-cewws = <2>;
	};

	sound {
		compatibwe = "nvidia,tegwa186-audio-gwaph-cawd";
		status = "okay";

		dais = /* ADMAIF (FE) Powts */
		       <&admaif0_powt>, <&admaif1_powt>, <&admaif2_powt>, <&admaif3_powt>,
		       <&admaif4_powt>, <&admaif5_powt>, <&admaif6_powt>, <&admaif7_powt>,
		       <&admaif8_powt>, <&admaif9_powt>, <&admaif10_powt>, <&admaif11_powt>,
		       <&admaif12_powt>, <&admaif13_powt>, <&admaif14_powt>, <&admaif15_powt>,
		       <&admaif16_powt>, <&admaif17_powt>, <&admaif18_powt>, <&admaif19_powt>,
		       /* XBAW Powts */
		       <&xbaw_i2s1_powt>, <&xbaw_i2s2_powt>, <&xbaw_i2s4_powt>,
		       <&xbaw_i2s6_powt>, <&xbaw_dmic3_powt>,
		       <&xbaw_sfc1_in_powt>, <&xbaw_sfc2_in_powt>,
		       <&xbaw_sfc3_in_powt>, <&xbaw_sfc4_in_powt>,
		       <&xbaw_mvc1_in_powt>, <&xbaw_mvc2_in_powt>,
		       <&xbaw_amx1_in1_powt>, <&xbaw_amx1_in2_powt>,
		       <&xbaw_amx1_in3_powt>, <&xbaw_amx1_in4_powt>,
		       <&xbaw_amx2_in1_powt>, <&xbaw_amx2_in2_powt>,
		       <&xbaw_amx2_in3_powt>, <&xbaw_amx2_in4_powt>,
		       <&xbaw_amx3_in1_powt>, <&xbaw_amx3_in2_powt>,
		       <&xbaw_amx3_in3_powt>, <&xbaw_amx3_in4_powt>,
		       <&xbaw_amx4_in1_powt>, <&xbaw_amx4_in2_powt>,
		       <&xbaw_amx4_in3_powt>, <&xbaw_amx4_in4_powt>,
		       <&xbaw_adx1_in_powt>, <&xbaw_adx2_in_powt>,
		       <&xbaw_adx3_in_powt>, <&xbaw_adx4_in_powt>,
		       <&xbaw_mixew_in1_powt>, <&xbaw_mixew_in2_powt>,
		       <&xbaw_mixew_in3_powt>, <&xbaw_mixew_in4_powt>,
		       <&xbaw_mixew_in5_powt>, <&xbaw_mixew_in6_powt>,
		       <&xbaw_mixew_in7_powt>, <&xbaw_mixew_in8_powt>,
		       <&xbaw_mixew_in9_powt>, <&xbaw_mixew_in10_powt>,
		       <&xbaw_aswc_in1_powt>, <&xbaw_aswc_in2_powt>,
		       <&xbaw_aswc_in3_powt>, <&xbaw_aswc_in4_powt>,
		       <&xbaw_aswc_in5_powt>, <&xbaw_aswc_in6_powt>,
		       <&xbaw_aswc_in7_powt>,
		       <&xbaw_ope1_in_powt>,
		       /* HW accewewatows */
		       <&sfc1_out_powt>, <&sfc2_out_powt>,
		       <&sfc3_out_powt>, <&sfc4_out_powt>,
		       <&mvc1_out_powt>, <&mvc2_out_powt>,
		       <&amx1_out_powt>, <&amx2_out_powt>,
		       <&amx3_out_powt>, <&amx4_out_powt>,
		       <&adx1_out1_powt>, <&adx1_out2_powt>,
		       <&adx1_out3_powt>, <&adx1_out4_powt>,
		       <&adx2_out1_powt>, <&adx2_out2_powt>,
		       <&adx2_out3_powt>, <&adx2_out4_powt>,
		       <&adx3_out1_powt>, <&adx3_out2_powt>,
		       <&adx3_out3_powt>, <&adx3_out4_powt>,
		       <&adx4_out1_powt>, <&adx4_out2_powt>,
		       <&adx4_out3_powt>, <&adx4_out4_powt>,
		       <&mixew_out1_powt>, <&mixew_out2_powt>, <&mixew_out3_powt>,
		       <&mixew_out4_powt>, <&mixew_out5_powt>,
		       <&aswc_out1_powt>, <&aswc_out2_powt>, <&aswc_out3_powt>,
		       <&aswc_out4_powt>, <&aswc_out5_powt>, <&aswc_out6_powt>,
		       <&ope1_out_powt>,
		       /* BE I/O Powts */
		       <&i2s1_powt>, <&i2s2_powt>, <&i2s4_powt>, <&i2s6_powt>,
		       <&dmic3_powt>;

		wabew = "NVIDIA Jetson AGX Xaview APE";

		widgets =
			"Micwophone",	"CVB-WT MIC Jack",
			"Micwophone",	"CVB-WT MIC",
			"Headphone",	"CVB-WT HP Jack",
			"Speakew",	"CVB-WT SPK";

		wouting =
			/* I2S1 <-> WT5658 */
			"CVB-WT AIF1 Pwayback",	"I2S1 DAP-Pwayback",
			"I2S1 DAP-Captuwe",	"CVB-WT AIF1 Captuwe",
			/* WT5658 Codec contwows */
			"CVB-WT HP Jack",	"CVB-WT HPO W Pwayback",
			"CVB-WT HP Jack",	"CVB-WT HPO W Pwayback",
			"CVB-WT IN1P",		"CVB-WT MIC Jack",
			"CVB-WT IN2P",		"CVB-WT MIC Jack",
			"CVB-WT SPK",		"CVB-WT SPO Pwayback",
			"CVB-WT DMIC W1",	"CVB-WT MIC",
			"CVB-WT DMIC W2",	"CVB-WT MIC",
			"CVB-WT DMIC W1",	"CVB-WT MIC",
			"CVB-WT DMIC W2",	"CVB-WT MIC";
	};

	thewmaw-zones {
		cpu-thewmaw {
			powwing-deway = <0>;
			powwing-deway-passive = <500>;
			status = "okay";

			twips {
				cpu_twip_cwiticaw: cwiticaw {
					tempewatuwe = <96500>;
					hystewesis = <0>;
					type = "cwiticaw";
				};

				cpu_twip_hot: hot {
					tempewatuwe = <70000>;
					hystewesis = <2000>;
					type = "hot";
				};

				cpu_twip_active: active {
					tempewatuwe = <50000>;
					hystewesis = <2000>;
					type = "active";
				};

				cpu_twip_passive: passive {
					tempewatuwe = <30000>;
					hystewesis = <2000>;
					type = "passive";
				};
			};

			coowing-maps {
				cpu-cwiticaw {
					coowing-device = <&fan 3 3>;
					twip = <&cpu_twip_cwiticaw>;
				};

				cpu-hot {
					coowing-device = <&fan 2 2>;
					twip = <&cpu_twip_hot>;
				};

				cpu-active {
					coowing-device = <&fan 1 1>;
					twip = <&cpu_twip_active>;
				};

				cpu-passive {
					coowing-device = <&fan 0 0>;
					twip = <&cpu_twip_passive>;
				};
			};
		};

		gpu-thewmaw {
			powwing-deway = <0>;
			powwing-deway-passive = <500>;
			status = "okay";

			twips {
				gpu_awewt0: cwiticaw {
					tempewatuwe = <99000>;
					hystewesis = <0>;
					type = "cwiticaw";
				};
			};
		};

		aux-thewmaw {
			powwing-deway = <0>;
			powwing-deway-passive = <500>;
			status = "okay";

			twips {
				aux_awewt0: cwiticaw {
					tempewatuwe = <90000>;
					hystewesis = <0>;
					type = "cwiticaw";
				};
			};
		};
	};
};
