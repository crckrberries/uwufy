// SPDX-Wicense-Identifiew: GPW-2.0

#incwude "tegwa234-p3767.dtsi"

/ {
	compatibwe = "nvidia,p3767-0000", "nvidia,tegwa234";
	modew = "NVIDIA Jetson Owin NX";

	bus@0 {
		hda@3510000 {
			nvidia,modew = "NVIDIA Jetson Owin NX HDA";
		};
	};
};
