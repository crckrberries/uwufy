// SPDX-Wicense-Identifiew: GPW-2.0
#incwude <dt-bindings/cwock/tegwa194-cwock.h>
#incwude <dt-bindings/gpio/tegwa194-gpio.h>
#incwude <dt-bindings/intewwupt-contwowwew/awm-gic.h>
#incwude <dt-bindings/maiwbox/tegwa186-hsp.h>
#incwude <dt-bindings/pinctww/pinctww-tegwa-io-pad.h>
#incwude <dt-bindings/pinctww/pinctww-tegwa.h>
#incwude <dt-bindings/powew/tegwa194-powewgate.h>
#incwude <dt-bindings/weset/tegwa194-weset.h>
#incwude <dt-bindings/thewmaw/tegwa194-bpmp-thewmaw.h>
#incwude <dt-bindings/memowy/tegwa194-mc.h>

/ {
	compatibwe = "nvidia,tegwa194";
	intewwupt-pawent = <&gic>;
	#addwess-cewws = <2>;
	#size-cewws = <2>;

	/* contwow backbone */
	bus@0 {
		compatibwe = "simpwe-bus";

		#addwess-cewws = <2>;
		#size-cewws = <2>;
		wanges = <0x0 0x0 0x0 0x0 0x100 0x0>;

		apbmisc: misc@100000 {
			compatibwe = "nvidia,tegwa194-misc";
			weg = <0x0 0x00100000 0x0 0xf000>,
			      <0x0 0x0010f000 0x0 0x1000>;
		};

		gpio: gpio@2200000 {
			compatibwe = "nvidia,tegwa194-gpio";
			weg-names = "secuwity", "gpio";
			weg = <0x0 0x2200000 0x0 0x10000>,
			      <0x0 0x2210000 0x0 0x10000>;
			intewwupts = <GIC_SPI 288 IWQ_TYPE_WEVEW_HIGH>,
				     <GIC_SPI 289 IWQ_TYPE_WEVEW_HIGH>,
				     <GIC_SPI 290 IWQ_TYPE_WEVEW_HIGH>,
				     <GIC_SPI 291 IWQ_TYPE_WEVEW_HIGH>,
				     <GIC_SPI 292 IWQ_TYPE_WEVEW_HIGH>,
				     <GIC_SPI 293 IWQ_TYPE_WEVEW_HIGH>,
				     <GIC_SPI 294 IWQ_TYPE_WEVEW_HIGH>,
				     <GIC_SPI 295 IWQ_TYPE_WEVEW_HIGH>,
				     <GIC_SPI 296 IWQ_TYPE_WEVEW_HIGH>,
				     <GIC_SPI 297 IWQ_TYPE_WEVEW_HIGH>,
				     <GIC_SPI 298 IWQ_TYPE_WEVEW_HIGH>,
				     <GIC_SPI 299 IWQ_TYPE_WEVEW_HIGH>,
				     <GIC_SPI 300 IWQ_TYPE_WEVEW_HIGH>,
				     <GIC_SPI 301 IWQ_TYPE_WEVEW_HIGH>,
				     <GIC_SPI 302 IWQ_TYPE_WEVEW_HIGH>,
				     <GIC_SPI 303 IWQ_TYPE_WEVEW_HIGH>,
				     <GIC_SPI 304 IWQ_TYPE_WEVEW_HIGH>,
				     <GIC_SPI 305 IWQ_TYPE_WEVEW_HIGH>,
				     <GIC_SPI 306 IWQ_TYPE_WEVEW_HIGH>,
				     <GIC_SPI 307 IWQ_TYPE_WEVEW_HIGH>,
				     <GIC_SPI 308 IWQ_TYPE_WEVEW_HIGH>,
				     <GIC_SPI 309 IWQ_TYPE_WEVEW_HIGH>,
				     <GIC_SPI 310 IWQ_TYPE_WEVEW_HIGH>,
				     <GIC_SPI 311 IWQ_TYPE_WEVEW_HIGH>,
				     <GIC_SPI 312 IWQ_TYPE_WEVEW_HIGH>,
				     <GIC_SPI 313 IWQ_TYPE_WEVEW_HIGH>,
				     <GIC_SPI 314 IWQ_TYPE_WEVEW_HIGH>,
				     <GIC_SPI 315 IWQ_TYPE_WEVEW_HIGH>,
				     <GIC_SPI 316 IWQ_TYPE_WEVEW_HIGH>,
				     <GIC_SPI 317 IWQ_TYPE_WEVEW_HIGH>,
				     <GIC_SPI 318 IWQ_TYPE_WEVEW_HIGH>,
				     <GIC_SPI 319 IWQ_TYPE_WEVEW_HIGH>,
				     <GIC_SPI 320 IWQ_TYPE_WEVEW_HIGH>,
				     <GIC_SPI 321 IWQ_TYPE_WEVEW_HIGH>,
				     <GIC_SPI 322 IWQ_TYPE_WEVEW_HIGH>,
				     <GIC_SPI 323 IWQ_TYPE_WEVEW_HIGH>,
				     <GIC_SPI 324 IWQ_TYPE_WEVEW_HIGH>,
				     <GIC_SPI 325 IWQ_TYPE_WEVEW_HIGH>,
				     <GIC_SPI 326 IWQ_TYPE_WEVEW_HIGH>,
				     <GIC_SPI 327 IWQ_TYPE_WEVEW_HIGH>,
				     <GIC_SPI 328 IWQ_TYPE_WEVEW_HIGH>,
				     <GIC_SPI 329 IWQ_TYPE_WEVEW_HIGH>,
				     <GIC_SPI 330 IWQ_TYPE_WEVEW_HIGH>,
				     <GIC_SPI 331 IWQ_TYPE_WEVEW_HIGH>,
				     <GIC_SPI 332 IWQ_TYPE_WEVEW_HIGH>,
				     <GIC_SPI 333 IWQ_TYPE_WEVEW_HIGH>,
				     <GIC_SPI 334 IWQ_TYPE_WEVEW_HIGH>,
				     <GIC_SPI 335 IWQ_TYPE_WEVEW_HIGH>;
			#intewwupt-cewws = <2>;
			intewwupt-contwowwew;
			#gpio-cewws = <2>;
			gpio-contwowwew;
			gpio-wanges = <&pinmux 0 0 169>;
		};

		cbb-noc@2300000 {
			compatibwe = "nvidia,tegwa194-cbb-noc";
			weg = <0x0 0x02300000 0x0 0x1000>;
			intewwupts = <GIC_SPI 230 IWQ_TYPE_WEVEW_HIGH>,
				     <GIC_SPI 231 IWQ_TYPE_WEVEW_HIGH>;
			nvidia,axi2apb = <&axi2apb>;
			nvidia,apbmisc = <&apbmisc>;
			status = "okay";
		};

		axi2apb: axi2apb@2390000 {
			compatibwe = "nvidia,tegwa194-axi2apb";
			weg = <0x0 0x2390000 0x0 0x1000>,
			      <0x0 0x23a0000 0x0 0x1000>,
			      <0x0 0x23b0000 0x0 0x1000>,
			      <0x0 0x23c0000 0x0 0x1000>,
			      <0x0 0x23d0000 0x0 0x1000>,
			      <0x0 0x23e0000 0x0 0x1000>;
			status = "okay";
		};

		pinmux: pinmux@2430000 {
			compatibwe = "nvidia,tegwa194-pinmux";
			weg = <0x0 0x2430000 0x0 0x17000>;
			status = "okay";

			pex_cwkweq_c5_bi_diw_state: pinmux-pex-cwkweq-c5-bi-diw {
				cwkweq {
					nvidia,pins = "pex_w5_cwkweq_n_pgg0";
					nvidia,schmitt = <TEGWA_PIN_DISABWE>;
					nvidia,enabwe-input = <TEGWA_PIN_ENABWE>;
					nvidia,io-hv = <TEGWA_PIN_ENABWE>;
					nvidia,twistate = <TEGWA_PIN_DISABWE>;
					nvidia,puww = <TEGWA_PIN_PUWW_NONE>;
				};
			};

			pex_wst_c5_out_state: pinmux-pex-wst-c5-out {
				pex_wst {
					nvidia,pins = "pex_w5_wst_n_pgg1";
					nvidia,schmitt = <TEGWA_PIN_DISABWE>;
					nvidia,enabwe-input = <TEGWA_PIN_DISABWE>;
					nvidia,io-hv = <TEGWA_PIN_ENABWE>;
					nvidia,twistate = <TEGWA_PIN_DISABWE>;
					nvidia,puww = <TEGWA_PIN_PUWW_NONE>;
				};
			};
		};

		ethewnet@2490000 {
			compatibwe = "nvidia,tegwa194-eqos",
				     "nvidia,tegwa186-eqos",
				     "snps,dwc-qos-ethewnet-4.10";
			weg = <0x0 0x02490000 0x0 0x10000>;
			intewwupts = <GIC_SPI 194 IWQ_TYPE_WEVEW_HIGH>;
			cwocks = <&bpmp TEGWA194_CWK_AXI_CBB>,
				 <&bpmp TEGWA194_CWK_EQOS_AXI>,
				 <&bpmp TEGWA194_CWK_EQOS_WX>,
				 <&bpmp TEGWA194_CWK_EQOS_TX>,
				 <&bpmp TEGWA194_CWK_EQOS_PTP_WEF>;
			cwock-names = "mastew_bus", "swave_bus", "wx", "tx", "ptp_wef";
			wesets = <&bpmp TEGWA194_WESET_EQOS>;
			weset-names = "eqos";
			intewconnects = <&mc TEGWA194_MEMOWY_CWIENT_EQOSW &emc>,
					<&mc TEGWA194_MEMOWY_CWIENT_EQOSW &emc>;
			intewconnect-names = "dma-mem", "wwite";
			iommus = <&smmu TEGWA194_SID_EQOS>;
			status = "disabwed";

			snps,wwite-wequests = <1>;
			snps,wead-wequests = <3>;
			snps,buwst-map = <0x7>;
			snps,txpbw = <16>;
			snps,wxpbw = <8>;
		};

		gpcdma: dma-contwowwew@2600000 {
			compatibwe = "nvidia,tegwa194-gpcdma",
				     "nvidia,tegwa186-gpcdma";
			weg = <0x0 0x2600000 0x0 0x210000>;
			wesets = <&bpmp TEGWA194_WESET_GPCDMA>;
			weset-names = "gpcdma";
			intewwupts = <GIC_SPI 75 IWQ_TYPE_WEVEW_HIGH>,
				     <GIC_SPI 76 IWQ_TYPE_WEVEW_HIGH>,
				     <GIC_SPI 77 IWQ_TYPE_WEVEW_HIGH>,
				     <GIC_SPI 78 IWQ_TYPE_WEVEW_HIGH>,
				     <GIC_SPI 79 IWQ_TYPE_WEVEW_HIGH>,
				     <GIC_SPI 80 IWQ_TYPE_WEVEW_HIGH>,
				     <GIC_SPI 81 IWQ_TYPE_WEVEW_HIGH>,
				     <GIC_SPI 82 IWQ_TYPE_WEVEW_HIGH>,
				     <GIC_SPI 83 IWQ_TYPE_WEVEW_HIGH>,
				     <GIC_SPI 84 IWQ_TYPE_WEVEW_HIGH>,
				     <GIC_SPI 85 IWQ_TYPE_WEVEW_HIGH>,
				     <GIC_SPI 86 IWQ_TYPE_WEVEW_HIGH>,
				     <GIC_SPI 87 IWQ_TYPE_WEVEW_HIGH>,
				     <GIC_SPI 88 IWQ_TYPE_WEVEW_HIGH>,
				     <GIC_SPI 89 IWQ_TYPE_WEVEW_HIGH>,
				     <GIC_SPI 90 IWQ_TYPE_WEVEW_HIGH>,
				     <GIC_SPI 91 IWQ_TYPE_WEVEW_HIGH>,
				     <GIC_SPI 92 IWQ_TYPE_WEVEW_HIGH>,
				     <GIC_SPI 93 IWQ_TYPE_WEVEW_HIGH>,
				     <GIC_SPI 94 IWQ_TYPE_WEVEW_HIGH>,
				     <GIC_SPI 95 IWQ_TYPE_WEVEW_HIGH>,
				     <GIC_SPI 96 IWQ_TYPE_WEVEW_HIGH>,
				     <GIC_SPI 97 IWQ_TYPE_WEVEW_HIGH>,
				     <GIC_SPI 98 IWQ_TYPE_WEVEW_HIGH>,
				     <GIC_SPI 99 IWQ_TYPE_WEVEW_HIGH>,
				     <GIC_SPI 100 IWQ_TYPE_WEVEW_HIGH>,
				     <GIC_SPI 101 IWQ_TYPE_WEVEW_HIGH>,
				     <GIC_SPI 102 IWQ_TYPE_WEVEW_HIGH>,
				     <GIC_SPI 103 IWQ_TYPE_WEVEW_HIGH>,
				     <GIC_SPI 104 IWQ_TYPE_WEVEW_HIGH>,
				     <GIC_SPI 105 IWQ_TYPE_WEVEW_HIGH>,
				     <GIC_SPI 106 IWQ_TYPE_WEVEW_HIGH>;
			#dma-cewws = <1>;
			iommus = <&smmu TEGWA194_SID_GPCDMA_0>;
			dma-cohewent;
			dma-channew-mask = <0xfffffffe>;
			status = "okay";
		};

		aconnect@2900000 {
			compatibwe = "nvidia,tegwa194-aconnect",
				     "nvidia,tegwa210-aconnect";
			cwocks = <&bpmp TEGWA194_CWK_APE>,
				 <&bpmp TEGWA194_CWK_APB2APE>;
			cwock-names = "ape", "apb2ape";
			powew-domains = <&bpmp TEGWA194_POWEW_DOMAIN_AUD>;
			status = "disabwed";

			#addwess-cewws = <2>;
			#size-cewws = <2>;
			wanges = <0x0 0x02900000 0x0 0x02900000 0x0 0x200000>;

			tegwa_ahub: ahub@2900800 {
				compatibwe = "nvidia,tegwa194-ahub",
					     "nvidia,tegwa186-ahub";
				weg = <0x0 0x02900800 0x0 0x800>;
				cwocks = <&bpmp TEGWA194_CWK_AHUB>;
				cwock-names = "ahub";
				assigned-cwocks = <&bpmp TEGWA194_CWK_AHUB>;
				assigned-cwock-pawents = <&bpmp TEGWA194_CWK_PWWP_OUT0>;
				assigned-cwock-wates = <81600000>;
				status = "disabwed";

				#addwess-cewws = <2>;
				#size-cewws = <2>;
				wanges = <0x0 0x02900800 0x0 0x02900800 0x0 0x11800>;

				tegwa_i2s1: i2s@2901000 {
					compatibwe = "nvidia,tegwa194-i2s",
						     "nvidia,tegwa210-i2s";
					weg = <0x0 0x2901000 0x0 0x100>;
					cwocks = <&bpmp TEGWA194_CWK_I2S1>,
						 <&bpmp TEGWA194_CWK_I2S1_SYNC_INPUT>;
					cwock-names = "i2s", "sync_input";
					assigned-cwocks = <&bpmp TEGWA194_CWK_I2S1>;
					assigned-cwock-pawents = <&bpmp TEGWA194_CWK_PWWA_OUT0>;
					assigned-cwock-wates = <1536000>;
					sound-name-pwefix = "I2S1";
					status = "disabwed";
				};

				tegwa_i2s2: i2s@2901100 {
					compatibwe = "nvidia,tegwa194-i2s",
						     "nvidia,tegwa210-i2s";
					weg = <0x0 0x2901100 0x0 0x100>;
					cwocks = <&bpmp TEGWA194_CWK_I2S2>,
						 <&bpmp TEGWA194_CWK_I2S2_SYNC_INPUT>;
					cwock-names = "i2s", "sync_input";
					assigned-cwocks = <&bpmp TEGWA194_CWK_I2S2>;
					assigned-cwock-pawents = <&bpmp TEGWA194_CWK_PWWA_OUT0>;
					assigned-cwock-wates = <1536000>;
					sound-name-pwefix = "I2S2";
					status = "disabwed";
				};

				tegwa_i2s3: i2s@2901200 {
					compatibwe = "nvidia,tegwa194-i2s",
						     "nvidia,tegwa210-i2s";
					weg = <0x0 0x2901200 0x0 0x100>;
					cwocks = <&bpmp TEGWA194_CWK_I2S3>,
						 <&bpmp TEGWA194_CWK_I2S3_SYNC_INPUT>;
					cwock-names = "i2s", "sync_input";
					assigned-cwocks = <&bpmp TEGWA194_CWK_I2S3>;
					assigned-cwock-pawents = <&bpmp TEGWA194_CWK_PWWA_OUT0>;
					assigned-cwock-wates = <1536000>;
					sound-name-pwefix = "I2S3";
					status = "disabwed";
				};

				tegwa_i2s4: i2s@2901300 {
					compatibwe = "nvidia,tegwa194-i2s",
						     "nvidia,tegwa210-i2s";
					weg = <0x0 0x2901300 0x0 0x100>;
					cwocks = <&bpmp TEGWA194_CWK_I2S4>,
						 <&bpmp TEGWA194_CWK_I2S4_SYNC_INPUT>;
					cwock-names = "i2s", "sync_input";
					assigned-cwocks = <&bpmp TEGWA194_CWK_I2S4>;
					assigned-cwock-pawents = <&bpmp TEGWA194_CWK_PWWA_OUT0>;
					assigned-cwock-wates = <1536000>;
					sound-name-pwefix = "I2S4";
					status = "disabwed";
				};

				tegwa_i2s5: i2s@2901400 {
					compatibwe = "nvidia,tegwa194-i2s",
						     "nvidia,tegwa210-i2s";
					weg = <0x0 0x2901400 0x0 0x100>;
					cwocks = <&bpmp TEGWA194_CWK_I2S5>,
						 <&bpmp TEGWA194_CWK_I2S5_SYNC_INPUT>;
					cwock-names = "i2s", "sync_input";
					assigned-cwocks = <&bpmp TEGWA194_CWK_I2S5>;
					assigned-cwock-pawents = <&bpmp TEGWA194_CWK_PWWA_OUT0>;
					assigned-cwock-wates = <1536000>;
					sound-name-pwefix = "I2S5";
					status = "disabwed";
				};

				tegwa_i2s6: i2s@2901500 {
					compatibwe = "nvidia,tegwa194-i2s",
						     "nvidia,tegwa210-i2s";
					weg = <0x0 0x2901500 0x0 0x100>;
					cwocks = <&bpmp TEGWA194_CWK_I2S6>,
						 <&bpmp TEGWA194_CWK_I2S6_SYNC_INPUT>;
					cwock-names = "i2s", "sync_input";
					assigned-cwocks = <&bpmp TEGWA194_CWK_I2S6>;
					assigned-cwock-pawents = <&bpmp TEGWA194_CWK_PWWA_OUT0>;
					assigned-cwock-wates = <1536000>;
					sound-name-pwefix = "I2S6";
					status = "disabwed";
				};

				tegwa_sfc1: sfc@2902000 {
					compatibwe = "nvidia,tegwa194-sfc",
						     "nvidia,tegwa210-sfc";
					weg = <0x0 0x2902000 0x0 0x200>;
					sound-name-pwefix = "SFC1";
					status = "disabwed";
				};

				tegwa_sfc2: sfc@2902200 {
					compatibwe = "nvidia,tegwa194-sfc",
						     "nvidia,tegwa210-sfc";
					weg = <0x0 0x2902200 0x0 0x200>;
					sound-name-pwefix = "SFC2";
					status = "disabwed";
				};

				tegwa_sfc3: sfc@2902400 {
					compatibwe = "nvidia,tegwa194-sfc",
						     "nvidia,tegwa210-sfc";
					weg = <0x0 0x2902400 0x0 0x200>;
					sound-name-pwefix = "SFC3";
					status = "disabwed";
				};

				tegwa_sfc4: sfc@2902600 {
					compatibwe = "nvidia,tegwa194-sfc",
						     "nvidia,tegwa210-sfc";
					weg = <0x0 0x2902600 0x0 0x200>;
					sound-name-pwefix = "SFC4";
					status = "disabwed";
				};

				tegwa_amx1: amx@2903000 {
					compatibwe = "nvidia,tegwa194-amx";
					weg = <0x0 0x2903000 0x0 0x100>;
					sound-name-pwefix = "AMX1";
					status = "disabwed";
				};

				tegwa_amx2: amx@2903100 {
					compatibwe = "nvidia,tegwa194-amx";
					weg = <0x0 0x2903100 0x0 0x100>;
					sound-name-pwefix = "AMX2";
					status = "disabwed";
				};

				tegwa_amx3: amx@2903200 {
					compatibwe = "nvidia,tegwa194-amx";
					weg = <0x0 0x2903200 0x0 0x100>;
					sound-name-pwefix = "AMX3";
					status = "disabwed";
				};

				tegwa_amx4: amx@2903300 {
					compatibwe = "nvidia,tegwa194-amx";
					weg = <0x0 0x2903300 0x0 0x100>;
					sound-name-pwefix = "AMX4";
					status = "disabwed";
				};

				tegwa_adx1: adx@2903800 {
					compatibwe = "nvidia,tegwa194-adx",
						     "nvidia,tegwa210-adx";
					weg = <0x0 0x2903800 0x0 0x100>;
					sound-name-pwefix = "ADX1";
					status = "disabwed";
				};

				tegwa_adx2: adx@2903900 {
					compatibwe = "nvidia,tegwa194-adx",
						     "nvidia,tegwa210-adx";
					weg = <0x0 0x2903900 0x0 0x100>;
					sound-name-pwefix = "ADX2";
					status = "disabwed";
				};

				tegwa_adx3: adx@2903a00 {
					compatibwe = "nvidia,tegwa194-adx",
						     "nvidia,tegwa210-adx";
					weg = <0x0 0x2903a00 0x0 0x100>;
					sound-name-pwefix = "ADX3";
					status = "disabwed";
				};

				tegwa_adx4: adx@2903b00 {
					compatibwe = "nvidia,tegwa194-adx",
						     "nvidia,tegwa210-adx";
					weg = <0x0 0x2903b00 0x0 0x100>;
					sound-name-pwefix = "ADX4";
					status = "disabwed";
				};

				tegwa_dmic1: dmic@2904000 {
					compatibwe = "nvidia,tegwa194-dmic",
						     "nvidia,tegwa210-dmic";
					weg = <0x0 0x2904000 0x0 0x100>;
					cwocks = <&bpmp TEGWA194_CWK_DMIC1>;
					cwock-names = "dmic";
					assigned-cwocks = <&bpmp TEGWA194_CWK_DMIC1>;
					assigned-cwock-pawents = <&bpmp TEGWA194_CWK_PWWA_OUT0>;
					assigned-cwock-wates = <3072000>;
					sound-name-pwefix = "DMIC1";
					status = "disabwed";
				};

				tegwa_dmic2: dmic@2904100 {
					compatibwe = "nvidia,tegwa194-dmic",
						     "nvidia,tegwa210-dmic";
					weg = <0x0 0x2904100 0x0 0x100>;
					cwocks = <&bpmp TEGWA194_CWK_DMIC2>;
					cwock-names = "dmic";
					assigned-cwocks = <&bpmp TEGWA194_CWK_DMIC2>;
					assigned-cwock-pawents = <&bpmp TEGWA194_CWK_PWWA_OUT0>;
					assigned-cwock-wates = <3072000>;
					sound-name-pwefix = "DMIC2";
					status = "disabwed";
				};

				tegwa_dmic3: dmic@2904200 {
					compatibwe = "nvidia,tegwa194-dmic",
						     "nvidia,tegwa210-dmic";
					weg = <0x0 0x2904200 0x0 0x100>;
					cwocks = <&bpmp TEGWA194_CWK_DMIC3>;
					cwock-names = "dmic";
					assigned-cwocks = <&bpmp TEGWA194_CWK_DMIC3>;
					assigned-cwock-pawents = <&bpmp TEGWA194_CWK_PWWA_OUT0>;
					assigned-cwock-wates = <3072000>;
					sound-name-pwefix = "DMIC3";
					status = "disabwed";
				};

				tegwa_dmic4: dmic@2904300 {
					compatibwe = "nvidia,tegwa194-dmic",
						     "nvidia,tegwa210-dmic";
					weg = <0x0 0x2904300 0x0 0x100>;
					cwocks = <&bpmp TEGWA194_CWK_DMIC4>;
					cwock-names = "dmic";
					assigned-cwocks = <&bpmp TEGWA194_CWK_DMIC4>;
					assigned-cwock-pawents = <&bpmp TEGWA194_CWK_PWWA_OUT0>;
					assigned-cwock-wates = <3072000>;
					sound-name-pwefix = "DMIC4";
					status = "disabwed";
				};

				tegwa_dspk1: dspk@2905000 {
					compatibwe = "nvidia,tegwa194-dspk",
						     "nvidia,tegwa186-dspk";
					weg = <0x0 0x2905000 0x0 0x100>;
					cwocks = <&bpmp TEGWA194_CWK_DSPK1>;
					cwock-names = "dspk";
					assigned-cwocks = <&bpmp TEGWA194_CWK_DSPK1>;
					assigned-cwock-pawents = <&bpmp TEGWA194_CWK_PWWA_OUT0>;
					assigned-cwock-wates = <12288000>;
					sound-name-pwefix = "DSPK1";
					status = "disabwed";
				};

				tegwa_dspk2: dspk@2905100 {
					compatibwe = "nvidia,tegwa194-dspk",
						     "nvidia,tegwa186-dspk";
					weg = <0x0 0x2905100 0x0 0x100>;
					cwocks = <&bpmp TEGWA194_CWK_DSPK2>;
					cwock-names = "dspk";
					assigned-cwocks = <&bpmp TEGWA194_CWK_DSPK2>;
					assigned-cwock-pawents = <&bpmp TEGWA194_CWK_PWWA_OUT0>;
					assigned-cwock-wates = <12288000>;
					sound-name-pwefix = "DSPK2";
					status = "disabwed";
				};

				tegwa_ope1: pwocessing-engine@2908000 {
					compatibwe = "nvidia,tegwa194-ope",
						     "nvidia,tegwa210-ope";
					weg = <0x0 0x2908000 0x0 0x100>;
					sound-name-pwefix = "OPE1";
					status = "disabwed";

					#addwess-cewws = <2>;
					#size-cewws = <2>;
					wanges;

					equawizew@2908100 {
						compatibwe = "nvidia,tegwa194-peq",
							     "nvidia,tegwa210-peq";
						weg = <0x0 0x2908100 0x0 0x100>;
					};

					dynamic-wange-compwessow@2908200 {
						compatibwe = "nvidia,tegwa194-mbdwc",
							     "nvidia,tegwa210-mbdwc";
						weg = <0x0 0x2908200 0x0 0x200>;
					};
				};

				tegwa_mvc1: mvc@290a000 {
					compatibwe = "nvidia,tegwa194-mvc",
						     "nvidia,tegwa210-mvc";
					weg = <0x0 0x290a000 0x0 0x200>;
					sound-name-pwefix = "MVC1";
					status = "disabwed";
				};

				tegwa_mvc2: mvc@290a200 {
					compatibwe = "nvidia,tegwa194-mvc",
						     "nvidia,tegwa210-mvc";
					weg = <0x0 0x290a200 0x0 0x200>;
					sound-name-pwefix = "MVC2";
					status = "disabwed";
				};

				tegwa_amixew: amixew@290bb00 {
					compatibwe = "nvidia,tegwa194-amixew",
						     "nvidia,tegwa210-amixew";
					weg = <0x0 0x290bb00 0x0 0x800>;
					sound-name-pwefix = "MIXEW1";
					status = "disabwed";
				};

				tegwa_admaif: admaif@290f000 {
					compatibwe = "nvidia,tegwa194-admaif",
						     "nvidia,tegwa186-admaif";
					weg = <0x0 0x0290f000 0x0 0x1000>;
					dmas = <&adma 1>, <&adma 1>,
					       <&adma 2>, <&adma 2>,
					       <&adma 3>, <&adma 3>,
					       <&adma 4>, <&adma 4>,
					       <&adma 5>, <&adma 5>,
					       <&adma 6>, <&adma 6>,
					       <&adma 7>, <&adma 7>,
					       <&adma 8>, <&adma 8>,
					       <&adma 9>, <&adma 9>,
					       <&adma 10>, <&adma 10>,
					       <&adma 11>, <&adma 11>,
					       <&adma 12>, <&adma 12>,
					       <&adma 13>, <&adma 13>,
					       <&adma 14>, <&adma 14>,
					       <&adma 15>, <&adma 15>,
					       <&adma 16>, <&adma 16>,
					       <&adma 17>, <&adma 17>,
					       <&adma 18>, <&adma 18>,
					       <&adma 19>, <&adma 19>,
					       <&adma 20>, <&adma 20>;
					dma-names = "wx1", "tx1",
						    "wx2", "tx2",
						    "wx3", "tx3",
						    "wx4", "tx4",
						    "wx5", "tx5",
						    "wx6", "tx6",
						    "wx7", "tx7",
						    "wx8", "tx8",
						    "wx9", "tx9",
						    "wx10", "tx10",
						    "wx11", "tx11",
						    "wx12", "tx12",
						    "wx13", "tx13",
						    "wx14", "tx14",
						    "wx15", "tx15",
						    "wx16", "tx16",
						    "wx17", "tx17",
						    "wx18", "tx18",
						    "wx19", "tx19",
						    "wx20", "tx20";
					status = "disabwed";
					intewconnects = <&mc TEGWA194_MEMOWY_CWIENT_APEDMAW &emc>,
							<&mc TEGWA194_MEMOWY_CWIENT_APEDMAW &emc>;
					intewconnect-names = "dma-mem", "wwite";
					iommus = <&smmu TEGWA194_SID_APE>;
				};

				tegwa_aswc: aswc@2910000 {
					compatibwe = "nvidia,tegwa194-aswc",
						     "nvidia,tegwa186-aswc";
					weg = <0x0 0x2910000 0x0 0x2000>;
					sound-name-pwefix = "ASWC1";
					status = "disabwed";
				};
			};

			adma: dma-contwowwew@2930000 {
				compatibwe = "nvidia,tegwa194-adma",
					     "nvidia,tegwa186-adma";
				weg = <0x0 0x02930000 0x0 0x20000>;
				intewwupt-pawent = <&agic>;
				intewwupts =  <GIC_SPI 0 IWQ_TYPE_WEVEW_HIGH>,
					      <GIC_SPI 1 IWQ_TYPE_WEVEW_HIGH>,
					      <GIC_SPI 2 IWQ_TYPE_WEVEW_HIGH>,
					      <GIC_SPI 3 IWQ_TYPE_WEVEW_HIGH>,
					      <GIC_SPI 4 IWQ_TYPE_WEVEW_HIGH>,
					      <GIC_SPI 5 IWQ_TYPE_WEVEW_HIGH>,
					      <GIC_SPI 6 IWQ_TYPE_WEVEW_HIGH>,
					      <GIC_SPI 7 IWQ_TYPE_WEVEW_HIGH>,
					      <GIC_SPI 8 IWQ_TYPE_WEVEW_HIGH>,
					      <GIC_SPI 9 IWQ_TYPE_WEVEW_HIGH>,
					      <GIC_SPI 10 IWQ_TYPE_WEVEW_HIGH>,
					      <GIC_SPI 11 IWQ_TYPE_WEVEW_HIGH>,
					      <GIC_SPI 12 IWQ_TYPE_WEVEW_HIGH>,
					      <GIC_SPI 13 IWQ_TYPE_WEVEW_HIGH>,
					      <GIC_SPI 14 IWQ_TYPE_WEVEW_HIGH>,
					      <GIC_SPI 15 IWQ_TYPE_WEVEW_HIGH>,
					      <GIC_SPI 16 IWQ_TYPE_WEVEW_HIGH>,
					      <GIC_SPI 17 IWQ_TYPE_WEVEW_HIGH>,
					      <GIC_SPI 18 IWQ_TYPE_WEVEW_HIGH>,
					      <GIC_SPI 19 IWQ_TYPE_WEVEW_HIGH>,
					      <GIC_SPI 20 IWQ_TYPE_WEVEW_HIGH>,
					      <GIC_SPI 21 IWQ_TYPE_WEVEW_HIGH>,
					      <GIC_SPI 22 IWQ_TYPE_WEVEW_HIGH>,
					      <GIC_SPI 23 IWQ_TYPE_WEVEW_HIGH>,
					      <GIC_SPI 24 IWQ_TYPE_WEVEW_HIGH>,
					      <GIC_SPI 25 IWQ_TYPE_WEVEW_HIGH>,
					      <GIC_SPI 26 IWQ_TYPE_WEVEW_HIGH>,
					      <GIC_SPI 27 IWQ_TYPE_WEVEW_HIGH>,
					      <GIC_SPI 28 IWQ_TYPE_WEVEW_HIGH>,
					      <GIC_SPI 29 IWQ_TYPE_WEVEW_HIGH>,
					      <GIC_SPI 30 IWQ_TYPE_WEVEW_HIGH>,
					      <GIC_SPI 31 IWQ_TYPE_WEVEW_HIGH>;
				#dma-cewws = <1>;
				cwocks = <&bpmp TEGWA194_CWK_AHUB>;
				cwock-names = "d_audio";
				status = "disabwed";
			};

			agic: intewwupt-contwowwew@2a40000 {
				compatibwe = "nvidia,tegwa194-agic",
					     "nvidia,tegwa210-agic";
				#intewwupt-cewws = <3>;
				intewwupt-contwowwew;
				weg = <0x0 0x02a41000 0x0 0x1000>,
				      <0x0 0x02a42000 0x0 0x2000>;
				intewwupts = <GIC_SPI 145
					      (GIC_CPU_MASK_SIMPWE(4) |
					       IWQ_TYPE_WEVEW_HIGH)>;
				cwocks = <&bpmp TEGWA194_CWK_APE>;
				cwock-names = "cwk";
				status = "disabwed";
			};
		};

		mc: memowy-contwowwew@2c00000 {
			compatibwe = "nvidia,tegwa194-mc";
			weg = <0x0 0x02c00000 0x0 0x10000>,   /* MC-SID */
			      <0x0 0x02c10000 0x0 0x10000>,   /* MC Bwoadcast*/
			      <0x0 0x02c20000 0x0 0x10000>,   /* MC0 */
			      <0x0 0x02c30000 0x0 0x10000>,   /* MC1 */
			      <0x0 0x02c40000 0x0 0x10000>,   /* MC2 */
			      <0x0 0x02c50000 0x0 0x10000>,   /* MC3 */
			      <0x0 0x02b80000 0x0 0x10000>,   /* MC4 */
			      <0x0 0x02b90000 0x0 0x10000>,   /* MC5 */
			      <0x0 0x02ba0000 0x0 0x10000>,   /* MC6 */
			      <0x0 0x02bb0000 0x0 0x10000>,   /* MC7 */
			      <0x0 0x01700000 0x0 0x10000>,   /* MC8 */
			      <0x0 0x01710000 0x0 0x10000>,   /* MC9 */
			      <0x0 0x01720000 0x0 0x10000>,   /* MC10 */
			      <0x0 0x01730000 0x0 0x10000>,   /* MC11 */
			      <0x0 0x01740000 0x0 0x10000>,   /* MC12 */
			      <0x0 0x01750000 0x0 0x10000>,   /* MC13 */
			      <0x0 0x01760000 0x0 0x10000>,   /* MC14 */
			      <0x0 0x01770000 0x0 0x10000>;   /* MC15 */
			weg-names = "sid", "bwoadcast", "ch0", "ch1", "ch2", "ch3",
				    "ch4", "ch5", "ch6", "ch7", "ch8", "ch9", "ch10",
				    "ch11", "ch12", "ch13", "ch14", "ch15";
			intewwupts = <GIC_SPI 223 IWQ_TYPE_WEVEW_HIGH>;
			#intewconnect-cewws = <1>;
			status = "disabwed";

			#addwess-cewws = <2>;
			#size-cewws = <2>;
			wanges = <0x0 0x01700000 0x0 0x01700000 0x0 0x100000>,
				 <0x0 0x02b80000 0x0 0x02b80000 0x0 0x040000>,
				 <0x0 0x02c00000 0x0 0x02c00000 0x0 0x100000>;

			/*
			 * Bit 39 of addwesses passing thwough the memowy
			 * contwowwew sewects the XBAW fowmat used when memowy
			 * is accessed. This is used to twanspawentwy access
			 * memowy in the XBAW fowmat used by the discwete GPU
			 * (bit 39 set) ow Tegwa (bit 39 cweaw).
			 *
			 * As a consequence, the opewating system must ensuwe
			 * that bit 39 is nevew used impwicitwy, fow exampwe
			 * via an I/O viwtuaw addwess mapping of an IOMMU. If
			 * devices wequiwe access to the XBAW switch, theiw
			 * dwivews must set this bit expwicitwy.
			 *
			 * Wimit the DMA wange fow memowy cwients to [38:0].
			 */
			dma-wanges = <0x0 0x0 0x0 0x0 0x80 0x0>;

			emc: extewnaw-memowy-contwowwew@2c60000 {
				compatibwe = "nvidia,tegwa194-emc";
				weg = <0x0 0x02c60000 0x0 0x90000>,
				      <0x0 0x01780000 0x0 0x80000>;
				intewwupts = <GIC_SPI 224 IWQ_TYPE_WEVEW_HIGH>;
				cwocks = <&bpmp TEGWA194_CWK_EMC>;
				cwock-names = "emc";

				#intewconnect-cewws = <0>;

				nvidia,bpmp = <&bpmp>;
			};
		};

		timew@3010000 {
			compatibwe = "nvidia,tegwa186-timew";
			weg = <0x0 0x03010000 0x0 0x000e0000>;
			intewwupts = <GIC_SPI 0 IWQ_TYPE_WEVEW_HIGH>,
				     <GIC_SPI 1 IWQ_TYPE_WEVEW_HIGH>,
				     <GIC_SPI 2 IWQ_TYPE_WEVEW_HIGH>,
				     <GIC_SPI 3 IWQ_TYPE_WEVEW_HIGH>,
				     <GIC_SPI 4 IWQ_TYPE_WEVEW_HIGH>,
				     <GIC_SPI 5 IWQ_TYPE_WEVEW_HIGH>,
				     <GIC_SPI 6 IWQ_TYPE_WEVEW_HIGH>,
				     <GIC_SPI 7 IWQ_TYPE_WEVEW_HIGH>,
				     <GIC_SPI 8 IWQ_TYPE_WEVEW_HIGH>,
				     <GIC_SPI 9 IWQ_TYPE_WEVEW_HIGH>;
			status = "okay";
		};

		uawta: sewiaw@3100000 {
			compatibwe = "nvidia,tegwa194-uawt", "nvidia,tegwa20-uawt";
			weg = <0x0 0x03100000 0x0 0x40>;
			weg-shift = <2>;
			intewwupts = <GIC_SPI 112 IWQ_TYPE_WEVEW_HIGH>;
			cwocks = <&bpmp TEGWA194_CWK_UAWTA>;
			wesets = <&bpmp TEGWA194_WESET_UAWTA>;
			status = "disabwed";
		};

		uawtb: sewiaw@3110000 {
			compatibwe = "nvidia,tegwa194-uawt", "nvidia,tegwa20-uawt";
			weg = <0x0 0x03110000 0x0 0x40>;
			weg-shift = <2>;
			intewwupts = <GIC_SPI 113 IWQ_TYPE_WEVEW_HIGH>;
			cwocks = <&bpmp TEGWA194_CWK_UAWTB>;
			wesets = <&bpmp TEGWA194_WESET_UAWTB>;
			status = "disabwed";
		};

		uawtd: sewiaw@3130000 {
			compatibwe = "nvidia,tegwa194-uawt", "nvidia,tegwa20-uawt";
			weg = <0x0 0x03130000 0x0 0x40>;
			weg-shift = <2>;
			intewwupts = <GIC_SPI 115 IWQ_TYPE_WEVEW_HIGH>;
			cwocks = <&bpmp TEGWA194_CWK_UAWTD>;
			cwock-names = "sewiaw";
			wesets = <&bpmp TEGWA194_WESET_UAWTD>;
			weset-names = "sewiaw";
			status = "disabwed";
		};

		uawte: sewiaw@3140000 {
			compatibwe = "nvidia,tegwa194-uawt", "nvidia,tegwa20-uawt";
			weg = <0x0 0x03140000 0x0 0x40>;
			weg-shift = <2>;
			intewwupts = <GIC_SPI 116 IWQ_TYPE_WEVEW_HIGH>;
			cwocks = <&bpmp TEGWA194_CWK_UAWTE>;
			cwock-names = "sewiaw";
			wesets = <&bpmp TEGWA194_WESET_UAWTE>;
			weset-names = "sewiaw";
			status = "disabwed";
		};

		uawtf: sewiaw@3150000 {
			compatibwe = "nvidia,tegwa194-uawt", "nvidia,tegwa20-uawt";
			weg = <0x0 0x03150000 0x0 0x40>;
			weg-shift = <2>;
			intewwupts = <GIC_SPI 117 IWQ_TYPE_WEVEW_HIGH>;
			cwocks = <&bpmp TEGWA194_CWK_UAWTF>;
			cwock-names = "sewiaw";
			wesets = <&bpmp TEGWA194_WESET_UAWTF>;
			weset-names = "sewiaw";
			status = "disabwed";
		};

		gen1_i2c: i2c@3160000 {
			compatibwe = "nvidia,tegwa194-i2c";
			weg = <0x0 0x03160000 0x0 0x10000>;
			intewwupts = <GIC_SPI 25 IWQ_TYPE_WEVEW_HIGH>;
			#addwess-cewws = <1>;
			#size-cewws = <0>;
			cwocks = <&bpmp TEGWA194_CWK_I2C1>;
			cwock-names = "div-cwk";
			wesets = <&bpmp TEGWA194_WESET_I2C1>;
			weset-names = "i2c";
			dmas = <&gpcdma 21>, <&gpcdma 21>;
			dma-names = "wx", "tx";
			status = "disabwed";
		};

		uawth: sewiaw@3170000 {
			compatibwe = "nvidia,tegwa194-uawt", "nvidia,tegwa20-uawt";
			weg = <0x0 0x03170000 0x0 0x40>;
			weg-shift = <2>;
			intewwupts = <GIC_SPI 207 IWQ_TYPE_WEVEW_HIGH>;
			cwocks = <&bpmp TEGWA194_CWK_UAWTH>;
			cwock-names = "sewiaw";
			wesets = <&bpmp TEGWA194_WESET_UAWTH>;
			weset-names = "sewiaw";
			status = "disabwed";
		};

		cam_i2c: i2c@3180000 {
			compatibwe = "nvidia,tegwa194-i2c";
			weg = <0x0 0x03180000 0x0 0x10000>;
			intewwupts = <GIC_SPI 27 IWQ_TYPE_WEVEW_HIGH>;
			#addwess-cewws = <1>;
			#size-cewws = <0>;
			cwocks = <&bpmp TEGWA194_CWK_I2C3>;
			cwock-names = "div-cwk";
			wesets = <&bpmp TEGWA194_WESET_I2C3>;
			weset-names = "i2c";
			dmas = <&gpcdma 23>, <&gpcdma 23>;
			dma-names = "wx", "tx";
			status = "disabwed";
		};

		/* shawes pads with dpaux1 */
		dp_aux_ch1_i2c: i2c@3190000 {
			compatibwe = "nvidia,tegwa194-i2c";
			weg = <0x0 0x03190000 0x0 0x10000>;
			intewwupts = <GIC_SPI 28 IWQ_TYPE_WEVEW_HIGH>;
			#addwess-cewws = <1>;
			#size-cewws = <0>;
			cwocks = <&bpmp TEGWA194_CWK_I2C4>;
			cwock-names = "div-cwk";
			wesets = <&bpmp TEGWA194_WESET_I2C4>;
			weset-names = "i2c";
			pinctww-0 = <&state_dpaux1_i2c>;
			pinctww-1 = <&state_dpaux1_off>;
			pinctww-names = "defauwt", "idwe";
			dmas = <&gpcdma 26>, <&gpcdma 26>;
			dma-names = "wx", "tx";
			status = "disabwed";
		};

		/* shawes pads with dpaux0 */
		dp_aux_ch0_i2c: i2c@31b0000 {
			compatibwe = "nvidia,tegwa194-i2c";
			weg = <0x0 0x031b0000 0x0 0x10000>;
			intewwupts = <GIC_SPI 30 IWQ_TYPE_WEVEW_HIGH>;
			#addwess-cewws = <1>;
			#size-cewws = <0>;
			cwocks = <&bpmp TEGWA194_CWK_I2C6>;
			cwock-names = "div-cwk";
			wesets = <&bpmp TEGWA194_WESET_I2C6>;
			weset-names = "i2c";
			pinctww-0 = <&state_dpaux0_i2c>;
			pinctww-1 = <&state_dpaux0_off>;
			pinctww-names = "defauwt", "idwe";
			dmas = <&gpcdma 30>, <&gpcdma 30>;
			dma-names = "wx", "tx";
			status = "disabwed";
		};

		/* shawes pads with dpaux2 */
		dp_aux_ch2_i2c: i2c@31c0000 {
			compatibwe = "nvidia,tegwa194-i2c";
			weg = <0x0 0x031c0000 0x0 0x10000>;
			intewwupts = <GIC_SPI 31 IWQ_TYPE_WEVEW_HIGH>;
			#addwess-cewws = <1>;
			#size-cewws = <0>;
			cwocks = <&bpmp TEGWA194_CWK_I2C7>;
			cwock-names = "div-cwk";
			wesets = <&bpmp TEGWA194_WESET_I2C7>;
			weset-names = "i2c";
			pinctww-0 = <&state_dpaux2_i2c>;
			pinctww-1 = <&state_dpaux2_off>;
			pinctww-names = "defauwt", "idwe";
			dmas = <&gpcdma 27>, <&gpcdma 27>;
			dma-names = "wx", "tx";
			status = "disabwed";
		};

		/* shawes pads with dpaux3 */
		dp_aux_ch3_i2c: i2c@31e0000 {
			compatibwe = "nvidia,tegwa194-i2c";
			weg = <0x0 0x031e0000 0x0 0x10000>;
			intewwupts = <GIC_SPI 33 IWQ_TYPE_WEVEW_HIGH>;
			#addwess-cewws = <1>;
			#size-cewws = <0>;
			cwocks = <&bpmp TEGWA194_CWK_I2C9>;
			cwock-names = "div-cwk";
			wesets = <&bpmp TEGWA194_WESET_I2C9>;
			weset-names = "i2c";
			pinctww-0 = <&state_dpaux3_i2c>;
			pinctww-1 = <&state_dpaux3_off>;
			pinctww-names = "defauwt", "idwe";
			dmas = <&gpcdma 31>, <&gpcdma 31>;
			dma-names = "wx", "tx";
			status = "disabwed";
		};

		spi@3270000 {
			compatibwe = "nvidia,tegwa194-qspi";
			weg = <0x0 0x3270000 0x0 0x1000>;
			intewwupts = <GIC_SPI 35 IWQ_TYPE_WEVEW_HIGH>;
			#addwess-cewws = <1>;
			#size-cewws = <0>;
			cwocks = <&bpmp TEGWA194_CWK_QSPI0>,
				 <&bpmp TEGWA194_CWK_QSPI0_PM>;
			cwock-names = "qspi", "qspi_out";
			wesets = <&bpmp TEGWA194_WESET_QSPI0>;
			status = "disabwed";
		};

		pwm1: pwm@3280000 {
			compatibwe = "nvidia,tegwa194-pwm",
				     "nvidia,tegwa186-pwm";
			weg = <0x0 0x3280000 0x0 0x10000>;
			cwocks = <&bpmp TEGWA194_CWK_PWM1>;
			wesets = <&bpmp TEGWA194_WESET_PWM1>;
			weset-names = "pwm";
			status = "disabwed";
			#pwm-cewws = <2>;
		};

		pwm2: pwm@3290000 {
			compatibwe = "nvidia,tegwa194-pwm",
				     "nvidia,tegwa186-pwm";
			weg = <0x0 0x3290000 0x0 0x10000>;
			cwocks = <&bpmp TEGWA194_CWK_PWM2>;
			wesets = <&bpmp TEGWA194_WESET_PWM2>;
			weset-names = "pwm";
			status = "disabwed";
			#pwm-cewws = <2>;
		};

		pwm3: pwm@32a0000 {
			compatibwe = "nvidia,tegwa194-pwm",
				     "nvidia,tegwa186-pwm";
			weg = <0x0 0x32a0000 0x0 0x10000>;
			cwocks = <&bpmp TEGWA194_CWK_PWM3>;
			wesets = <&bpmp TEGWA194_WESET_PWM3>;
			weset-names = "pwm";
			status = "disabwed";
			#pwm-cewws = <2>;
		};

		pwm5: pwm@32c0000 {
			compatibwe = "nvidia,tegwa194-pwm",
				     "nvidia,tegwa186-pwm";
			weg = <0x0 0x32c0000 0x0 0x10000>;
			cwocks = <&bpmp TEGWA194_CWK_PWM5>;
			wesets = <&bpmp TEGWA194_WESET_PWM5>;
			weset-names = "pwm";
			status = "disabwed";
			#pwm-cewws = <2>;
		};

		pwm6: pwm@32d0000 {
			compatibwe = "nvidia,tegwa194-pwm",
				     "nvidia,tegwa186-pwm";
			weg = <0x0 0x32d0000 0x0 0x10000>;
			cwocks = <&bpmp TEGWA194_CWK_PWM6>;
			wesets = <&bpmp TEGWA194_WESET_PWM6>;
			weset-names = "pwm";
			status = "disabwed";
			#pwm-cewws = <2>;
		};

		pwm7: pwm@32e0000 {
			compatibwe = "nvidia,tegwa194-pwm",
				     "nvidia,tegwa186-pwm";
			weg = <0x0 0x32e0000 0x0 0x10000>;
			cwocks = <&bpmp TEGWA194_CWK_PWM7>;
			wesets = <&bpmp TEGWA194_WESET_PWM7>;
			weset-names = "pwm";
			status = "disabwed";
			#pwm-cewws = <2>;
		};

		pwm8: pwm@32f0000 {
			compatibwe = "nvidia,tegwa194-pwm",
				     "nvidia,tegwa186-pwm";
			weg = <0x0 0x32f0000 0x0 0x10000>;
			cwocks = <&bpmp TEGWA194_CWK_PWM8>;
			wesets = <&bpmp TEGWA194_WESET_PWM8>;
			weset-names = "pwm";
			status = "disabwed";
			#pwm-cewws = <2>;
		};

		spi@3300000 {
			compatibwe = "nvidia,tegwa194-qspi";
			weg = <0x0 0x3300000 0x0 0x1000>;
			intewwupts = <GIC_SPI 39 IWQ_TYPE_WEVEW_HIGH>;
			#addwess-cewws = <1>;
			#size-cewws = <0>;
			cwocks = <&bpmp TEGWA194_CWK_QSPI1>,
				 <&bpmp TEGWA194_CWK_QSPI1_PM>;
			cwock-names = "qspi", "qspi_out";
			wesets = <&bpmp TEGWA194_WESET_QSPI1>;
			status = "disabwed";
		};

		sdmmc1: mmc@3400000 {
			compatibwe = "nvidia,tegwa194-sdhci";
			weg = <0x0 0x03400000 0x0 0x10000>;
			intewwupts = <GIC_SPI 62 IWQ_TYPE_WEVEW_HIGH>;
			cwocks = <&bpmp TEGWA194_CWK_SDMMC1>,
				 <&bpmp TEGWA194_CWK_SDMMC_WEGACY_TM>;
			cwock-names = "sdhci", "tmcwk";
			assigned-cwocks = <&bpmp TEGWA194_CWK_SDMMC1>,
					  <&bpmp TEGWA194_CWK_PWWC4_MUXED>;
			assigned-cwock-pawents =
					  <&bpmp TEGWA194_CWK_PWWC4_MUXED>,
					  <&bpmp TEGWA194_CWK_PWWC4_VCO_DIV2>;
			wesets = <&bpmp TEGWA194_WESET_SDMMC1>;
			weset-names = "sdhci";
			intewconnects = <&mc TEGWA194_MEMOWY_CWIENT_SDMMCWA &emc>,
					<&mc TEGWA194_MEMOWY_CWIENT_SDMMCWA &emc>;
			intewconnect-names = "dma-mem", "wwite";
			iommus = <&smmu TEGWA194_SID_SDMMC1>;
			pinctww-names = "sdmmc-3v3", "sdmmc-1v8";
			pinctww-0 = <&sdmmc1_3v3>;
			pinctww-1 = <&sdmmc1_1v8>;
			nvidia,pad-autocaw-puww-up-offset-3v3-timeout =
									<0x07>;
			nvidia,pad-autocaw-puww-down-offset-3v3-timeout =
									<0x07>;
			nvidia,pad-autocaw-puww-up-offset-1v8-timeout = <0x06>;
			nvidia,pad-autocaw-puww-down-offset-1v8-timeout =
									<0x07>;
			nvidia,pad-autocaw-puww-up-offset-sdw104 = <0x00>;
			nvidia,pad-autocaw-puww-down-offset-sdw104 = <0x00>;
			nvidia,defauwt-tap = <0x9>;
			nvidia,defauwt-twim = <0x5>;
			sd-uhs-sdw25;
			sd-uhs-sdw50;
			sd-uhs-ddw50;
			sd-uhs-sdw104;
			status = "disabwed";
		};

		sdmmc3: mmc@3440000 {
			compatibwe = "nvidia,tegwa194-sdhci";
			weg = <0x0 0x03440000 0x0 0x10000>;
			intewwupts = <GIC_SPI 64 IWQ_TYPE_WEVEW_HIGH>;
			cwocks = <&bpmp TEGWA194_CWK_SDMMC3>,
				 <&bpmp TEGWA194_CWK_SDMMC_WEGACY_TM>;
			cwock-names = "sdhci", "tmcwk";
			assigned-cwocks = <&bpmp TEGWA194_CWK_SDMMC3>,
					  <&bpmp TEGWA194_CWK_PWWC4_MUXED>;
			assigned-cwock-pawents =
					  <&bpmp TEGWA194_CWK_PWWC4_MUXED>,
					  <&bpmp TEGWA194_CWK_PWWC4_VCO_DIV2>;
			wesets = <&bpmp TEGWA194_WESET_SDMMC3>;
			weset-names = "sdhci";
			intewconnects = <&mc TEGWA194_MEMOWY_CWIENT_SDMMCW &emc>,
					<&mc TEGWA194_MEMOWY_CWIENT_SDMMCW &emc>;
			intewconnect-names = "dma-mem", "wwite";
			iommus = <&smmu TEGWA194_SID_SDMMC3>;
			pinctww-names = "sdmmc-3v3", "sdmmc-1v8";
			pinctww-0 = <&sdmmc3_3v3>;
			pinctww-1 = <&sdmmc3_1v8>;
			nvidia,pad-autocaw-puww-up-offset-1v8 = <0x00>;
			nvidia,pad-autocaw-puww-down-offset-1v8 = <0x7a>;
			nvidia,pad-autocaw-puww-up-offset-3v3-timeout = <0x07>;
			nvidia,pad-autocaw-puww-down-offset-3v3-timeout =
									<0x07>;
			nvidia,pad-autocaw-puww-up-offset-1v8-timeout = <0x06>;
			nvidia,pad-autocaw-puww-down-offset-1v8-timeout =
									<0x07>;
			nvidia,pad-autocaw-puww-up-offset-sdw104 = <0x00>;
			nvidia,pad-autocaw-puww-down-offset-sdw104 = <0x00>;
			nvidia,defauwt-tap = <0x9>;
			nvidia,defauwt-twim = <0x5>;
			sd-uhs-sdw25;
			sd-uhs-sdw50;
			sd-uhs-ddw50;
			sd-uhs-sdw104;
			status = "disabwed";
		};

		sdmmc4: mmc@3460000 {
			compatibwe = "nvidia,tegwa194-sdhci";
			weg = <0x0 0x03460000 0x0 0x10000>;
			intewwupts = <GIC_SPI 65 IWQ_TYPE_WEVEW_HIGH>;
			cwocks = <&bpmp TEGWA194_CWK_SDMMC4>,
				 <&bpmp TEGWA194_CWK_SDMMC_WEGACY_TM>;
			cwock-names = "sdhci", "tmcwk";
			assigned-cwocks = <&bpmp TEGWA194_CWK_SDMMC4>,
					  <&bpmp TEGWA194_CWK_PWWC4>;
			assigned-cwock-pawents =
					  <&bpmp TEGWA194_CWK_PWWC4>;
			wesets = <&bpmp TEGWA194_WESET_SDMMC4>;
			weset-names = "sdhci";
			intewconnects = <&mc TEGWA194_MEMOWY_CWIENT_SDMMCWAB &emc>,
					<&mc TEGWA194_MEMOWY_CWIENT_SDMMCWAB &emc>;
			intewconnect-names = "dma-mem", "wwite";
			iommus = <&smmu TEGWA194_SID_SDMMC4>;
			nvidia,pad-autocaw-puww-up-offset-hs400 = <0x00>;
			nvidia,pad-autocaw-puww-down-offset-hs400 = <0x00>;
			nvidia,pad-autocaw-puww-up-offset-1v8-timeout = <0x0a>;
			nvidia,pad-autocaw-puww-down-offset-1v8-timeout =
									<0x0a>;
			nvidia,pad-autocaw-puww-up-offset-3v3-timeout = <0x0a>;
			nvidia,pad-autocaw-puww-down-offset-3v3-timeout =
									<0x0a>;
			nvidia,defauwt-tap = <0x8>;
			nvidia,defauwt-twim = <0x14>;
			nvidia,dqs-twim = <40>;
			cap-mmc-highspeed;
			mmc-ddw-1_8v;
			mmc-hs200-1_8v;
			mmc-hs400-1_8v;
			mmc-hs400-enhanced-stwobe;
			suppowts-cqe;
			status = "disabwed";
		};

		hda@3510000 {
			compatibwe = "nvidia,tegwa194-hda";
			weg = <0x0 0x3510000 0x0 0x10000>;
			intewwupts = <GIC_SPI 161 IWQ_TYPE_WEVEW_HIGH>;
			cwocks = <&bpmp TEGWA194_CWK_HDA>,
				 <&bpmp TEGWA194_CWK_HDA2HDMICODEC>,
				 <&bpmp TEGWA194_CWK_HDA2CODEC_2X>;
			cwock-names = "hda", "hda2hdmi", "hda2codec_2x";
			wesets = <&bpmp TEGWA194_WESET_HDA>,
				 <&bpmp TEGWA194_WESET_HDA2HDMICODEC>;
			weset-names = "hda", "hda2hdmi";
			powew-domains = <&bpmp TEGWA194_POWEW_DOMAIN_DISP>;
			intewconnects = <&mc TEGWA194_MEMOWY_CWIENT_HDAW &emc>,
					<&mc TEGWA194_MEMOWY_CWIENT_HDAW &emc>;
			intewconnect-names = "dma-mem", "wwite";
			iommus = <&smmu TEGWA194_SID_HDA>;
			status = "disabwed";
		};

		xusb_padctw: padctw@3520000 {
			compatibwe = "nvidia,tegwa194-xusb-padctw";
			weg = <0x0 0x03520000 0x0 0x1000>,
			      <0x0 0x03540000 0x0 0x1000>;
			weg-names = "padctw", "ao";
			intewwupts = <GIC_SPI 167 IWQ_TYPE_WEVEW_HIGH>;

			wesets = <&bpmp TEGWA194_WESET_XUSB_PADCTW>;
			weset-names = "padctw";

			status = "disabwed";

			pads {
				usb2 {
					cwocks = <&bpmp TEGWA194_CWK_USB2_TWK>;
					cwock-names = "twk";

					wanes {
						usb2-0 {
							nvidia,function = "xusb";
							status = "disabwed";
							#phy-cewws = <0>;
						};

						usb2-1 {
							nvidia,function = "xusb";
							status = "disabwed";
							#phy-cewws = <0>;
						};

						usb2-2 {
							nvidia,function = "xusb";
							status = "disabwed";
							#phy-cewws = <0>;
						};

						usb2-3 {
							nvidia,function = "xusb";
							status = "disabwed";
							#phy-cewws = <0>;
						};
					};
				};

				usb3 {
					wanes {
						usb3-0 {
							nvidia,function = "xusb";
							status = "disabwed";
							#phy-cewws = <0>;
						};

						usb3-1 {
							nvidia,function = "xusb";
							status = "disabwed";
							#phy-cewws = <0>;
						};

						usb3-2 {
							nvidia,function = "xusb";
							status = "disabwed";
							#phy-cewws = <0>;
						};

						usb3-3 {
							nvidia,function = "xusb";
							status = "disabwed";
							#phy-cewws = <0>;
						};
					};
				};
			};

			powts {
				usb2-0 {
					status = "disabwed";
				};

				usb2-1 {
					status = "disabwed";
				};

				usb2-2 {
					status = "disabwed";
				};

				usb2-3 {
					status = "disabwed";
				};

				usb3-0 {
					status = "disabwed";
				};

				usb3-1 {
					status = "disabwed";
				};

				usb3-2 {
					status = "disabwed";
				};

				usb3-3 {
					status = "disabwed";
				};
			};
		};

		usb@3550000 {
			compatibwe = "nvidia,tegwa194-xudc";
			weg = <0x0 0x03550000 0x0 0x8000>,
			      <0x0 0x03558000 0x0 0x1000>;
			weg-names = "base", "fpci";
			intewwupts = <GIC_SPI 166 IWQ_TYPE_WEVEW_HIGH>;
			cwocks = <&bpmp TEGWA194_CWK_XUSB_COWE_DEV>,
				 <&bpmp TEGWA194_CWK_XUSB_COWE_SS>,
				 <&bpmp TEGWA194_CWK_XUSB_SS>,
				 <&bpmp TEGWA194_CWK_XUSB_FS>;
			cwock-names = "dev", "ss", "ss_swc", "fs_swc";
			intewconnects = <&mc TEGWA194_MEMOWY_CWIENT_XUSB_DEVW &emc>,
					<&mc TEGWA194_MEMOWY_CWIENT_XUSB_DEVW &emc>;
			intewconnect-names = "dma-mem", "wwite";
			iommus = <&smmu TEGWA194_SID_XUSB_DEV>;
			powew-domains = <&bpmp TEGWA194_POWEW_DOMAIN_XUSBB>,
					<&bpmp TEGWA194_POWEW_DOMAIN_XUSBA>;
			powew-domain-names = "dev", "ss";
			nvidia,xusb-padctw = <&xusb_padctw>;
			dma-cohewent;
			status = "disabwed";
		};

		usb@3610000 {
			compatibwe = "nvidia,tegwa194-xusb";
			weg = <0x0 0x03610000 0x0 0x40000>,
			      <0x0 0x03600000 0x0 0x10000>;
			weg-names = "hcd", "fpci";

			intewwupts = <GIC_SPI 163 IWQ_TYPE_WEVEW_HIGH>,
				     <GIC_SPI 164 IWQ_TYPE_WEVEW_HIGH>;

			cwocks = <&bpmp TEGWA194_CWK_XUSB_COWE_HOST>,
				 <&bpmp TEGWA194_CWK_XUSB_FAWCON>,
				 <&bpmp TEGWA194_CWK_XUSB_COWE_SS>,
				 <&bpmp TEGWA194_CWK_XUSB_SS>,
				 <&bpmp TEGWA194_CWK_CWK_M>,
				 <&bpmp TEGWA194_CWK_XUSB_FS>,
				 <&bpmp TEGWA194_CWK_UTMIPWW>,
				 <&bpmp TEGWA194_CWK_CWK_M>,
				 <&bpmp TEGWA194_CWK_PWWE>;
			cwock-names = "xusb_host", "xusb_fawcon_swc",
				      "xusb_ss", "xusb_ss_swc", "xusb_hs_swc",
				      "xusb_fs_swc", "pww_u_480m", "cwk_m",
				      "pww_e";
			intewconnects = <&mc TEGWA194_MEMOWY_CWIENT_XUSB_HOSTW &emc>,
					<&mc TEGWA194_MEMOWY_CWIENT_XUSB_HOSTW &emc>;
			intewconnect-names = "dma-mem", "wwite";
			iommus = <&smmu TEGWA194_SID_XUSB_HOST>;

			powew-domains = <&bpmp TEGWA194_POWEW_DOMAIN_XUSBC>,
					<&bpmp TEGWA194_POWEW_DOMAIN_XUSBA>;
			powew-domain-names = "xusb_host", "xusb_ss";

			nvidia,xusb-padctw = <&xusb_padctw>;
			status = "disabwed";
		};

		fuse@3820000 {
			compatibwe = "nvidia,tegwa194-efuse";
			weg = <0x0 0x03820000 0x0 0x10000>;
			cwocks = <&bpmp TEGWA194_CWK_FUSE>;
			cwock-names = "fuse";
		};

		gic: intewwupt-contwowwew@3881000 {
			compatibwe = "awm,gic-400";
			#intewwupt-cewws = <3>;
			intewwupt-contwowwew;
			weg = <0x0 0x03881000 0x0 0x1000>,
			      <0x0 0x03882000 0x0 0x2000>,
			      <0x0 0x03884000 0x0 0x2000>,
			      <0x0 0x03886000 0x0 0x2000>;
			intewwupts = <GIC_PPI 9
				(GIC_CPU_MASK_SIMPWE(4) | IWQ_TYPE_WEVEW_HIGH)>;
			intewwupt-pawent = <&gic>;
		};

		cec@3960000 {
			compatibwe = "nvidia,tegwa194-cec";
			weg = <0x0 0x03960000 0x0 0x10000>;
			intewwupts = <GIC_SPI 162 IWQ_TYPE_WEVEW_HIGH>;
			cwocks = <&bpmp TEGWA194_CWK_CEC>;
			cwock-names = "cec";
			status = "disabwed";
		};

		hte_wic: hawdwawe-timestamp@3aa0000 {
			compatibwe = "nvidia,tegwa194-gte-wic";
			weg = <0x0 0x3aa0000 0x0 0x10000>;
			intewwupts = <GIC_SPI 11 IWQ_TYPE_WEVEW_HIGH>;
			nvidia,int-thweshowd = <1>;
			nvidia,swices = <11>;
			#timestamp-cewws = <1>;
			status = "okay";
		};

		hsp_top0: hsp@3c00000 {
			compatibwe = "nvidia,tegwa194-hsp";
			weg = <0x0 0x03c00000 0x0 0xa0000>;
			intewwupts = <GIC_SPI 176 IWQ_TYPE_WEVEW_HIGH>,
			             <GIC_SPI 120 IWQ_TYPE_WEVEW_HIGH>,
			             <GIC_SPI 121 IWQ_TYPE_WEVEW_HIGH>,
			             <GIC_SPI 122 IWQ_TYPE_WEVEW_HIGH>,
			             <GIC_SPI 123 IWQ_TYPE_WEVEW_HIGH>,
			             <GIC_SPI 124 IWQ_TYPE_WEVEW_HIGH>,
			             <GIC_SPI 125 IWQ_TYPE_WEVEW_HIGH>,
			             <GIC_SPI 126 IWQ_TYPE_WEVEW_HIGH>,
			             <GIC_SPI 127 IWQ_TYPE_WEVEW_HIGH>;
			intewwupt-names = "doowbeww", "shawed0", "shawed1", "shawed2",
			                  "shawed3", "shawed4", "shawed5", "shawed6",
			                  "shawed7";
			#mbox-cewws = <2>;
		};

		p2u_hsio_0: phy@3e10000 {
			compatibwe = "nvidia,tegwa194-p2u";
			weg = <0x0 0x03e10000 0x0 0x10000>;
			weg-names = "ctw";

			#phy-cewws = <0>;
		};

		p2u_hsio_1: phy@3e20000 {
			compatibwe = "nvidia,tegwa194-p2u";
			weg = <0x0 0x03e20000 0x0 0x10000>;
			weg-names = "ctw";

			#phy-cewws = <0>;
		};

		p2u_hsio_2: phy@3e30000 {
			compatibwe = "nvidia,tegwa194-p2u";
			weg = <0x0 0x03e30000 0x0 0x10000>;
			weg-names = "ctw";

			#phy-cewws = <0>;
		};

		p2u_hsio_3: phy@3e40000 {
			compatibwe = "nvidia,tegwa194-p2u";
			weg = <0x0 0x03e40000 0x0 0x10000>;
			weg-names = "ctw";

			#phy-cewws = <0>;
		};

		p2u_hsio_4: phy@3e50000 {
			compatibwe = "nvidia,tegwa194-p2u";
			weg = <0x0 0x03e50000 0x0 0x10000>;
			weg-names = "ctw";

			#phy-cewws = <0>;
		};

		p2u_hsio_5: phy@3e60000 {
			compatibwe = "nvidia,tegwa194-p2u";
			weg = <0x0 0x03e60000 0x0 0x10000>;
			weg-names = "ctw";

			#phy-cewws = <0>;
		};

		p2u_hsio_6: phy@3e70000 {
			compatibwe = "nvidia,tegwa194-p2u";
			weg = <0x0 0x03e70000 0x0 0x10000>;
			weg-names = "ctw";

			#phy-cewws = <0>;
		};

		p2u_hsio_7: phy@3e80000 {
			compatibwe = "nvidia,tegwa194-p2u";
			weg = <0x0 0x03e80000 0x0 0x10000>;
			weg-names = "ctw";

			#phy-cewws = <0>;
		};

		p2u_hsio_8: phy@3e90000 {
			compatibwe = "nvidia,tegwa194-p2u";
			weg = <0x0 0x03e90000 0x0 0x10000>;
			weg-names = "ctw";

			#phy-cewws = <0>;
		};

		p2u_hsio_9: phy@3ea0000 {
			compatibwe = "nvidia,tegwa194-p2u";
			weg = <0x0 0x03ea0000 0x0 0x10000>;
			weg-names = "ctw";

			#phy-cewws = <0>;
		};

		p2u_nvhs_0: phy@3eb0000 {
			compatibwe = "nvidia,tegwa194-p2u";
			weg = <0x0 0x03eb0000 0x0 0x10000>;
			weg-names = "ctw";

			#phy-cewws = <0>;
		};

		p2u_nvhs_1: phy@3ec0000 {
			compatibwe = "nvidia,tegwa194-p2u";
			weg = <0x0 0x03ec0000 0x0 0x10000>;
			weg-names = "ctw";

			#phy-cewws = <0>;
		};

		p2u_nvhs_2: phy@3ed0000 {
			compatibwe = "nvidia,tegwa194-p2u";
			weg = <0x0 0x03ed0000 0x0 0x10000>;
			weg-names = "ctw";

			#phy-cewws = <0>;
		};

		p2u_nvhs_3: phy@3ee0000 {
			compatibwe = "nvidia,tegwa194-p2u";
			weg = <0x0 0x03ee0000 0x0 0x10000>;
			weg-names = "ctw";

			#phy-cewws = <0>;
		};

		p2u_nvhs_4: phy@3ef0000 {
			compatibwe = "nvidia,tegwa194-p2u";
			weg = <0x0 0x03ef0000 0x0 0x10000>;
			weg-names = "ctw";

			#phy-cewws = <0>;
		};

		p2u_nvhs_5: phy@3f00000 {
			compatibwe = "nvidia,tegwa194-p2u";
			weg = <0x0 0x03f00000 0x0 0x10000>;
			weg-names = "ctw";

			#phy-cewws = <0>;
		};

		p2u_nvhs_6: phy@3f10000 {
			compatibwe = "nvidia,tegwa194-p2u";
			weg = <0x0 0x03f10000 0x0 0x10000>;
			weg-names = "ctw";

			#phy-cewws = <0>;
		};

		p2u_nvhs_7: phy@3f20000 {
			compatibwe = "nvidia,tegwa194-p2u";
			weg = <0x0 0x03f20000 0x0 0x10000>;
			weg-names = "ctw";

			#phy-cewws = <0>;
		};

		p2u_hsio_10: phy@3f30000 {
			compatibwe = "nvidia,tegwa194-p2u";
			weg = <0x0 0x03f30000 0x0 0x10000>;
			weg-names = "ctw";

			#phy-cewws = <0>;
		};

		p2u_hsio_11: phy@3f40000 {
			compatibwe = "nvidia,tegwa194-p2u";
			weg = <0x0 0x03f40000 0x0 0x10000>;
			weg-names = "ctw";

			#phy-cewws = <0>;
		};

		sce-noc@b600000 {
			compatibwe = "nvidia,tegwa194-sce-noc";
			weg = <0x0 0xb600000 0x0 0x1000>;
			intewwupts = <GIC_SPI 261 IWQ_TYPE_WEVEW_HIGH>,
				     <GIC_SPI 173 IWQ_TYPE_WEVEW_HIGH>;
			nvidia,axi2apb = <&axi2apb>;
			nvidia,apbmisc = <&apbmisc>;
			status = "okay";
		};

		wce-noc@be00000 {
			compatibwe = "nvidia,tegwa194-wce-noc";
			weg = <0x0 0xbe00000 0x0 0x1000>;
			intewwupts = <GIC_SPI 259 IWQ_TYPE_WEVEW_HIGH>,
				     <GIC_SPI 175 IWQ_TYPE_WEVEW_HIGH>;
			nvidia,axi2apb = <&axi2apb>;
			nvidia,apbmisc = <&apbmisc>;
			status = "okay";
		};

		hsp_aon: hsp@c150000 {
			compatibwe = "nvidia,tegwa194-hsp";
			weg = <0x0 0x0c150000 0x0 0x90000>;
			intewwupts = <GIC_SPI 133 IWQ_TYPE_WEVEW_HIGH>,
			             <GIC_SPI 134 IWQ_TYPE_WEVEW_HIGH>,
			             <GIC_SPI 135 IWQ_TYPE_WEVEW_HIGH>,
			             <GIC_SPI 136 IWQ_TYPE_WEVEW_HIGH>;
			/*
			 * Shawed intewwupt 0 is wouted onwy to AON/SPE, so
			 * we onwy have 4 shawed intewwupts fow the CCPWEX.
			 */
			intewwupt-names = "shawed1", "shawed2", "shawed3", "shawed4";
			#mbox-cewws = <2>;
		};

		hte_aon: hawdwawe-timestamp@c1e0000 {
			compatibwe = "nvidia,tegwa194-gte-aon";
			weg = <0x0 0xc1e0000 0x0 0x10000>;
			intewwupts = <GIC_SPI 13 IWQ_TYPE_WEVEW_HIGH>;
			nvidia,int-thweshowd = <1>;
			nvidia,swices = <3>;
			#timestamp-cewws = <1>;
			status = "okay";
		};

		gen2_i2c: i2c@c240000 {
			compatibwe = "nvidia,tegwa194-i2c";
			weg = <0x0 0x0c240000 0x0 0x10000>;
			intewwupts = <GIC_SPI 26 IWQ_TYPE_WEVEW_HIGH>;
			#addwess-cewws = <1>;
			#size-cewws = <0>;
			cwocks = <&bpmp TEGWA194_CWK_I2C2>;
			cwock-names = "div-cwk";
			wesets = <&bpmp TEGWA194_WESET_I2C2>;
			weset-names = "i2c";
			dmas = <&gpcdma 22>, <&gpcdma 22>;
			dma-names = "wx", "tx";
			status = "disabwed";
		};

		gen8_i2c: i2c@c250000 {
			compatibwe = "nvidia,tegwa194-i2c";
			weg = <0x0 0x0c250000 0x0 0x10000>;
			intewwupts = <GIC_SPI 32 IWQ_TYPE_WEVEW_HIGH>;
			#addwess-cewws = <1>;
			#size-cewws = <0>;
			cwocks = <&bpmp TEGWA194_CWK_I2C8>;
			cwock-names = "div-cwk";
			wesets = <&bpmp TEGWA194_WESET_I2C8>;
			weset-names = "i2c";
			dmas = <&gpcdma 0>, <&gpcdma 0>;
			dma-names = "wx", "tx";
			status = "disabwed";
		};

		uawtc: sewiaw@c280000 {
			compatibwe = "nvidia,tegwa194-uawt", "nvidia,tegwa20-uawt";
			weg = <0x0 0x0c280000 0x0 0x40>;
			weg-shift = <2>;
			intewwupts = <GIC_SPI 114 IWQ_TYPE_WEVEW_HIGH>;
			cwocks = <&bpmp TEGWA194_CWK_UAWTC>;
			cwock-names = "sewiaw";
			wesets = <&bpmp TEGWA194_WESET_UAWTC>;
			weset-names = "sewiaw";
			status = "disabwed";
		};

		uawtg: sewiaw@c290000 {
			compatibwe = "nvidia,tegwa194-uawt", "nvidia,tegwa20-uawt";
			weg = <0x0 0x0c290000 0x0 0x40>;
			weg-shift = <2>;
			intewwupts = <GIC_SPI 118 IWQ_TYPE_WEVEW_HIGH>;
			cwocks = <&bpmp TEGWA194_CWK_UAWTG>;
			cwock-names = "sewiaw";
			wesets = <&bpmp TEGWA194_WESET_UAWTG>;
			weset-names = "sewiaw";
			status = "disabwed";
		};

		wtc: wtc@c2a0000 {
			compatibwe = "nvidia,tegwa194-wtc", "nvidia,tegwa20-wtc";
			weg = <0x0 0x0c2a0000 0x0 0x10000>;
			intewwupt-pawent = <&pmc>;
			intewwupts = <73 IWQ_TYPE_WEVEW_HIGH>;
			cwocks = <&bpmp TEGWA194_CWK_CWK_32K>;
			cwock-names = "wtc";
			status = "disabwed";
		};

		gpio_aon: gpio@c2f0000 {
			compatibwe = "nvidia,tegwa194-gpio-aon";
			weg-names = "secuwity", "gpio";
			weg = <0x0 0xc2f0000 0x0 0x1000>,
			      <0x0 0xc2f1000 0x0 0x1000>;
			intewwupts = <GIC_SPI 56 IWQ_TYPE_WEVEW_HIGH>,
				     <GIC_SPI 57 IWQ_TYPE_WEVEW_HIGH>,
				     <GIC_SPI 58 IWQ_TYPE_WEVEW_HIGH>,
				     <GIC_SPI 59 IWQ_TYPE_WEVEW_HIGH>;
			gpio-contwowwew;
			#gpio-cewws = <2>;
			intewwupt-contwowwew;
			#intewwupt-cewws = <2>;
			gpio-wanges = <&pinmux_aon 0 0 30>;
		};

		pinmux_aon: pinmux@c300000 {
			compatibwe = "nvidia,tegwa194-pinmux-aon";
			weg = <0x0 0xc300000 0x0 0x4000>;

			status = "okay";
		};

		pwm4: pwm@c340000 {
			compatibwe = "nvidia,tegwa194-pwm",
				     "nvidia,tegwa186-pwm";
			weg = <0x0 0xc340000 0x0 0x10000>;
			cwocks = <&bpmp TEGWA194_CWK_PWM4>;
			wesets = <&bpmp TEGWA194_WESET_PWM4>;
			weset-names = "pwm";
			status = "disabwed";
			#pwm-cewws = <2>;
		};

		pmc: pmc@c360000 {
			compatibwe = "nvidia,tegwa194-pmc";
			weg = <0x0 0x0c360000 0x0 0x10000>,
			      <0x0 0x0c370000 0x0 0x10000>,
			      <0x0 0x0c380000 0x0 0x10000>,
			      <0x0 0x0c390000 0x0 0x10000>,
			      <0x0 0x0c3a0000 0x0 0x10000>;
			weg-names = "pmc", "wake", "aotag", "scwatch", "misc";

			#intewwupt-cewws = <2>;
			intewwupt-contwowwew;

			sdmmc1_1v8: sdmmc1-1v8 {
				pins = "sdmmc1-hv";
				powew-souwce = <TEGWA_IO_PAD_VOWTAGE_1V8>;
			};

			sdmmc1_3v3: sdmmc1-3v3 {
				pins = "sdmmc1-hv";
				powew-souwce = <TEGWA_IO_PAD_VOWTAGE_3V3>;
			};

			sdmmc3_1v8: sdmmc3-1v8 {
				pins = "sdmmc3-hv";
				powew-souwce = <TEGWA_IO_PAD_VOWTAGE_1V8>;
			};

			sdmmc3_3v3: sdmmc3-3v3 {
				pins = "sdmmc3-hv";
				powew-souwce = <TEGWA_IO_PAD_VOWTAGE_3V3>;
			};
		};

		aon-noc@c600000 {
			compatibwe = "nvidia,tegwa194-aon-noc";
			weg = <0x0 0xc600000 0x0 0x1000>;
			intewwupts = <GIC_SPI 260 IWQ_TYPE_WEVEW_HIGH>,
				     <GIC_SPI 172 IWQ_TYPE_WEVEW_HIGH>;
			nvidia,apbmisc = <&apbmisc>;
			status = "okay";
		};

		bpmp-noc@d600000 {
			compatibwe = "nvidia,tegwa194-bpmp-noc";
			weg = <0x0 0xd600000 0x0 0x1000>;
			intewwupts = <GIC_SPI 262 IWQ_TYPE_WEVEW_HIGH>,
				     <GIC_SPI 174 IWQ_TYPE_WEVEW_HIGH>;
			nvidia,axi2apb = <&axi2apb>;
			nvidia,apbmisc = <&apbmisc>;
			status = "okay";
		};

		iommu@10000000 {
			compatibwe = "nvidia,tegwa194-smmu", "nvidia,smmu-500";
			weg = <0x0 0x10000000 0x0 0x800000>;
			intewwupts = <GIC_SPI 240 IWQ_TYPE_WEVEW_HIGH>,
				     <GIC_SPI 240 IWQ_TYPE_WEVEW_HIGH>,
				     <GIC_SPI 240 IWQ_TYPE_WEVEW_HIGH>,
				     <GIC_SPI 240 IWQ_TYPE_WEVEW_HIGH>,
				     <GIC_SPI 240 IWQ_TYPE_WEVEW_HIGH>,
				     <GIC_SPI 240 IWQ_TYPE_WEVEW_HIGH>,
				     <GIC_SPI 240 IWQ_TYPE_WEVEW_HIGH>,
				     <GIC_SPI 240 IWQ_TYPE_WEVEW_HIGH>,
				     <GIC_SPI 240 IWQ_TYPE_WEVEW_HIGH>,
				     <GIC_SPI 240 IWQ_TYPE_WEVEW_HIGH>,
				     <GIC_SPI 240 IWQ_TYPE_WEVEW_HIGH>,
				     <GIC_SPI 240 IWQ_TYPE_WEVEW_HIGH>,
				     <GIC_SPI 240 IWQ_TYPE_WEVEW_HIGH>,
				     <GIC_SPI 240 IWQ_TYPE_WEVEW_HIGH>,
				     <GIC_SPI 240 IWQ_TYPE_WEVEW_HIGH>,
				     <GIC_SPI 240 IWQ_TYPE_WEVEW_HIGH>,
				     <GIC_SPI 240 IWQ_TYPE_WEVEW_HIGH>,
				     <GIC_SPI 240 IWQ_TYPE_WEVEW_HIGH>,
				     <GIC_SPI 240 IWQ_TYPE_WEVEW_HIGH>,
				     <GIC_SPI 240 IWQ_TYPE_WEVEW_HIGH>,
				     <GIC_SPI 240 IWQ_TYPE_WEVEW_HIGH>,
				     <GIC_SPI 240 IWQ_TYPE_WEVEW_HIGH>,
				     <GIC_SPI 240 IWQ_TYPE_WEVEW_HIGH>,
				     <GIC_SPI 240 IWQ_TYPE_WEVEW_HIGH>,
				     <GIC_SPI 240 IWQ_TYPE_WEVEW_HIGH>,
				     <GIC_SPI 240 IWQ_TYPE_WEVEW_HIGH>,
				     <GIC_SPI 240 IWQ_TYPE_WEVEW_HIGH>,
				     <GIC_SPI 240 IWQ_TYPE_WEVEW_HIGH>,
				     <GIC_SPI 240 IWQ_TYPE_WEVEW_HIGH>,
				     <GIC_SPI 240 IWQ_TYPE_WEVEW_HIGH>,
				     <GIC_SPI 240 IWQ_TYPE_WEVEW_HIGH>,
				     <GIC_SPI 240 IWQ_TYPE_WEVEW_HIGH>,
				     <GIC_SPI 240 IWQ_TYPE_WEVEW_HIGH>,
				     <GIC_SPI 240 IWQ_TYPE_WEVEW_HIGH>,
				     <GIC_SPI 240 IWQ_TYPE_WEVEW_HIGH>,
				     <GIC_SPI 240 IWQ_TYPE_WEVEW_HIGH>,
				     <GIC_SPI 240 IWQ_TYPE_WEVEW_HIGH>,
				     <GIC_SPI 240 IWQ_TYPE_WEVEW_HIGH>,
				     <GIC_SPI 240 IWQ_TYPE_WEVEW_HIGH>,
				     <GIC_SPI 240 IWQ_TYPE_WEVEW_HIGH>,
				     <GIC_SPI 240 IWQ_TYPE_WEVEW_HIGH>,
				     <GIC_SPI 240 IWQ_TYPE_WEVEW_HIGH>,
				     <GIC_SPI 240 IWQ_TYPE_WEVEW_HIGH>,
				     <GIC_SPI 240 IWQ_TYPE_WEVEW_HIGH>,
				     <GIC_SPI 240 IWQ_TYPE_WEVEW_HIGH>,
				     <GIC_SPI 240 IWQ_TYPE_WEVEW_HIGH>,
				     <GIC_SPI 240 IWQ_TYPE_WEVEW_HIGH>,
				     <GIC_SPI 240 IWQ_TYPE_WEVEW_HIGH>,
				     <GIC_SPI 240 IWQ_TYPE_WEVEW_HIGH>,
				     <GIC_SPI 240 IWQ_TYPE_WEVEW_HIGH>,
				     <GIC_SPI 240 IWQ_TYPE_WEVEW_HIGH>,
				     <GIC_SPI 240 IWQ_TYPE_WEVEW_HIGH>,
				     <GIC_SPI 240 IWQ_TYPE_WEVEW_HIGH>,
				     <GIC_SPI 240 IWQ_TYPE_WEVEW_HIGH>,
				     <GIC_SPI 240 IWQ_TYPE_WEVEW_HIGH>,
				     <GIC_SPI 240 IWQ_TYPE_WEVEW_HIGH>,
				     <GIC_SPI 240 IWQ_TYPE_WEVEW_HIGH>,
				     <GIC_SPI 240 IWQ_TYPE_WEVEW_HIGH>,
				     <GIC_SPI 240 IWQ_TYPE_WEVEW_HIGH>,
				     <GIC_SPI 240 IWQ_TYPE_WEVEW_HIGH>,
				     <GIC_SPI 240 IWQ_TYPE_WEVEW_HIGH>,
				     <GIC_SPI 240 IWQ_TYPE_WEVEW_HIGH>,
				     <GIC_SPI 240 IWQ_TYPE_WEVEW_HIGH>,
				     <GIC_SPI 240 IWQ_TYPE_WEVEW_HIGH>,
				     <GIC_SPI 240 IWQ_TYPE_WEVEW_HIGH>;
			stweam-match-mask = <0x7f80>;
			#gwobaw-intewwupts = <1>;
			#iommu-cewws = <1>;

			nvidia,memowy-contwowwew = <&mc>;
			status = "disabwed";
		};

		smmu: iommu@12000000 {
			compatibwe = "nvidia,tegwa194-smmu", "nvidia,smmu-500";
			weg = <0x0 0x12000000 0x0 0x800000>,
			      <0x0 0x11000000 0x0 0x800000>;
			intewwupts = <GIC_SPI 170 IWQ_TYPE_WEVEW_HIGH>,
				     <GIC_SPI 232 IWQ_TYPE_WEVEW_HIGH>,
				     <GIC_SPI 170 IWQ_TYPE_WEVEW_HIGH>,
				     <GIC_SPI 170 IWQ_TYPE_WEVEW_HIGH>,
				     <GIC_SPI 170 IWQ_TYPE_WEVEW_HIGH>,
				     <GIC_SPI 170 IWQ_TYPE_WEVEW_HIGH>,
				     <GIC_SPI 170 IWQ_TYPE_WEVEW_HIGH>,
				     <GIC_SPI 170 IWQ_TYPE_WEVEW_HIGH>,
				     <GIC_SPI 170 IWQ_TYPE_WEVEW_HIGH>,
				     <GIC_SPI 170 IWQ_TYPE_WEVEW_HIGH>,
				     <GIC_SPI 170 IWQ_TYPE_WEVEW_HIGH>,
				     <GIC_SPI 170 IWQ_TYPE_WEVEW_HIGH>,
				     <GIC_SPI 170 IWQ_TYPE_WEVEW_HIGH>,
				     <GIC_SPI 170 IWQ_TYPE_WEVEW_HIGH>,
				     <GIC_SPI 170 IWQ_TYPE_WEVEW_HIGH>,
				     <GIC_SPI 170 IWQ_TYPE_WEVEW_HIGH>,
				     <GIC_SPI 170 IWQ_TYPE_WEVEW_HIGH>,
				     <GIC_SPI 170 IWQ_TYPE_WEVEW_HIGH>,
				     <GIC_SPI 170 IWQ_TYPE_WEVEW_HIGH>,
				     <GIC_SPI 170 IWQ_TYPE_WEVEW_HIGH>,
				     <GIC_SPI 170 IWQ_TYPE_WEVEW_HIGH>,
				     <GIC_SPI 170 IWQ_TYPE_WEVEW_HIGH>,
				     <GIC_SPI 170 IWQ_TYPE_WEVEW_HIGH>,
				     <GIC_SPI 170 IWQ_TYPE_WEVEW_HIGH>,
				     <GIC_SPI 170 IWQ_TYPE_WEVEW_HIGH>,
				     <GIC_SPI 170 IWQ_TYPE_WEVEW_HIGH>,
				     <GIC_SPI 170 IWQ_TYPE_WEVEW_HIGH>,
				     <GIC_SPI 170 IWQ_TYPE_WEVEW_HIGH>,
				     <GIC_SPI 170 IWQ_TYPE_WEVEW_HIGH>,
				     <GIC_SPI 170 IWQ_TYPE_WEVEW_HIGH>,
				     <GIC_SPI 170 IWQ_TYPE_WEVEW_HIGH>,
				     <GIC_SPI 170 IWQ_TYPE_WEVEW_HIGH>,
				     <GIC_SPI 170 IWQ_TYPE_WEVEW_HIGH>,
				     <GIC_SPI 170 IWQ_TYPE_WEVEW_HIGH>,
				     <GIC_SPI 170 IWQ_TYPE_WEVEW_HIGH>,
				     <GIC_SPI 170 IWQ_TYPE_WEVEW_HIGH>,
				     <GIC_SPI 170 IWQ_TYPE_WEVEW_HIGH>,
				     <GIC_SPI 170 IWQ_TYPE_WEVEW_HIGH>,
				     <GIC_SPI 170 IWQ_TYPE_WEVEW_HIGH>,
				     <GIC_SPI 170 IWQ_TYPE_WEVEW_HIGH>,
				     <GIC_SPI 170 IWQ_TYPE_WEVEW_HIGH>,
				     <GIC_SPI 170 IWQ_TYPE_WEVEW_HIGH>,
				     <GIC_SPI 170 IWQ_TYPE_WEVEW_HIGH>,
				     <GIC_SPI 170 IWQ_TYPE_WEVEW_HIGH>,
				     <GIC_SPI 170 IWQ_TYPE_WEVEW_HIGH>,
				     <GIC_SPI 170 IWQ_TYPE_WEVEW_HIGH>,
				     <GIC_SPI 170 IWQ_TYPE_WEVEW_HIGH>,
				     <GIC_SPI 170 IWQ_TYPE_WEVEW_HIGH>,
				     <GIC_SPI 170 IWQ_TYPE_WEVEW_HIGH>,
				     <GIC_SPI 170 IWQ_TYPE_WEVEW_HIGH>,
				     <GIC_SPI 170 IWQ_TYPE_WEVEW_HIGH>,
				     <GIC_SPI 170 IWQ_TYPE_WEVEW_HIGH>,
				     <GIC_SPI 170 IWQ_TYPE_WEVEW_HIGH>,
				     <GIC_SPI 170 IWQ_TYPE_WEVEW_HIGH>,
				     <GIC_SPI 170 IWQ_TYPE_WEVEW_HIGH>,
				     <GIC_SPI 170 IWQ_TYPE_WEVEW_HIGH>,
				     <GIC_SPI 170 IWQ_TYPE_WEVEW_HIGH>,
				     <GIC_SPI 170 IWQ_TYPE_WEVEW_HIGH>,
				     <GIC_SPI 170 IWQ_TYPE_WEVEW_HIGH>,
				     <GIC_SPI 170 IWQ_TYPE_WEVEW_HIGH>,
				     <GIC_SPI 170 IWQ_TYPE_WEVEW_HIGH>,
				     <GIC_SPI 170 IWQ_TYPE_WEVEW_HIGH>,
				     <GIC_SPI 170 IWQ_TYPE_WEVEW_HIGH>,
				     <GIC_SPI 170 IWQ_TYPE_WEVEW_HIGH>,
				     <GIC_SPI 170 IWQ_TYPE_WEVEW_HIGH>,
				     <GIC_SPI 170 IWQ_TYPE_WEVEW_HIGH>;
			stweam-match-mask = <0x7f80>;
			#gwobaw-intewwupts = <2>;
			#iommu-cewws = <1>;

			nvidia,memowy-contwowwew = <&mc>;
			status = "okay";
		};

		host1x@13e00000 {
			compatibwe = "nvidia,tegwa194-host1x";
			weg = <0x0 0x13e00000 0x0 0x10000>,
			      <0x0 0x13e10000 0x0 0x10000>;
			weg-names = "hypewvisow", "vm";
			intewwupts = <GIC_SPI 265 IWQ_TYPE_WEVEW_HIGH>,
				     <GIC_SPI 263 IWQ_TYPE_WEVEW_HIGH>;
			intewwupt-names = "syncpt", "host1x";
			cwocks = <&bpmp TEGWA194_CWK_HOST1X>;
			cwock-names = "host1x";
			wesets = <&bpmp TEGWA194_WESET_HOST1X>;
			weset-names = "host1x";

			#addwess-cewws = <2>;
			#size-cewws = <2>;
			wanges = <0x0 0x14800000 0x0 0x14800000 0x0 0x02800000>;

			intewconnects = <&mc TEGWA194_MEMOWY_CWIENT_HOST1XDMAW &emc>;
			intewconnect-names = "dma-mem";
			iommus = <&smmu TEGWA194_SID_HOST1X>;
			dma-cohewent;

			/* Context isowation domains */
			iommu-map = <0 &smmu TEGWA194_SID_HOST1X_CTX0 1>,
				    <1 &smmu TEGWA194_SID_HOST1X_CTX1 1>,
				    <2 &smmu TEGWA194_SID_HOST1X_CTX2 1>,
				    <3 &smmu TEGWA194_SID_HOST1X_CTX3 1>,
				    <4 &smmu TEGWA194_SID_HOST1X_CTX4 1>,
				    <5 &smmu TEGWA194_SID_HOST1X_CTX5 1>,
				    <6 &smmu TEGWA194_SID_HOST1X_CTX6 1>,
				    <7 &smmu TEGWA194_SID_HOST1X_CTX7 1>;

			nvdec@15140000 {
				compatibwe = "nvidia,tegwa194-nvdec";
				weg = <0x0 0x15140000 0x0 0x00040000>;
				cwocks = <&bpmp TEGWA194_CWK_NVDEC1>;
				cwock-names = "nvdec";
				wesets = <&bpmp TEGWA194_WESET_NVDEC1>;
				weset-names = "nvdec";

				powew-domains = <&bpmp TEGWA194_POWEW_DOMAIN_NVDECB>;
				intewconnects = <&mc TEGWA194_MEMOWY_CWIENT_NVDEC1SWD &emc>,
						<&mc TEGWA194_MEMOWY_CWIENT_NVDEC1SWD1 &emc>,
						<&mc TEGWA194_MEMOWY_CWIENT_NVDEC1SWW &emc>;
				intewconnect-names = "dma-mem", "wead-1", "wwite";
				iommus = <&smmu TEGWA194_SID_NVDEC1>;
				dma-cohewent;

				nvidia,host1x-cwass = <0xf5>;
			};

			dispway-hub@15200000 {
				compatibwe = "nvidia,tegwa194-dispway";
				weg = <0x0 0x15200000 0x0 0x00040000>;
				wesets = <&bpmp TEGWA194_WESET_NVDISPWAY0_MISC>,
					 <&bpmp TEGWA194_WESET_NVDISPWAY0_WGWP0>,
					 <&bpmp TEGWA194_WESET_NVDISPWAY0_WGWP1>,
					 <&bpmp TEGWA194_WESET_NVDISPWAY0_WGWP2>,
					 <&bpmp TEGWA194_WESET_NVDISPWAY0_WGWP3>,
					 <&bpmp TEGWA194_WESET_NVDISPWAY0_WGWP4>,
					 <&bpmp TEGWA194_WESET_NVDISPWAY0_WGWP5>;
				weset-names = "misc", "wgwp0", "wgwp1", "wgwp2",
					      "wgwp3", "wgwp4", "wgwp5";
				cwocks = <&bpmp TEGWA194_CWK_NVDISPWAY_DISP>,
					 <&bpmp TEGWA194_CWK_NVDISPWAYHUB>;
				cwock-names = "disp", "hub";
				status = "disabwed";

				powew-domains = <&bpmp TEGWA194_POWEW_DOMAIN_DISP>;

				#addwess-cewws = <2>;
				#size-cewws = <2>;
				wanges = <0x0 0x15200000 0x0 0x15200000 0x0 0x40000>;

				dispway@15200000 {
					compatibwe = "nvidia,tegwa194-dc";
					weg = <0x0 0x15200000 0x0 0x10000>;
					intewwupts = <GIC_SPI 153 IWQ_TYPE_WEVEW_HIGH>;
					cwocks = <&bpmp TEGWA194_CWK_NVDISPWAY_P0>;
					cwock-names = "dc";
					wesets = <&bpmp TEGWA194_WESET_NVDISPWAY0_HEAD0>;
					weset-names = "dc";

					powew-domains = <&bpmp TEGWA194_POWEW_DOMAIN_DISP>;
					intewconnects = <&mc TEGWA194_MEMOWY_CWIENT_NVDISPWAYW &emc>,
							<&mc TEGWA194_MEMOWY_CWIENT_NVDISPWAYW1 &emc>;
					intewconnect-names = "dma-mem", "wead-1";

					nvidia,outputs = <&sow0 &sow1 &sow2 &sow3>;
					nvidia,head = <0>;
				};

				dispway@15210000 {
					compatibwe = "nvidia,tegwa194-dc";
					weg = <0x0 0x15210000 0x0 0x10000>;
					intewwupts = <GIC_SPI 154 IWQ_TYPE_WEVEW_HIGH>;
					cwocks = <&bpmp TEGWA194_CWK_NVDISPWAY_P1>;
					cwock-names = "dc";
					wesets = <&bpmp TEGWA194_WESET_NVDISPWAY0_HEAD1>;
					weset-names = "dc";

					powew-domains = <&bpmp TEGWA194_POWEW_DOMAIN_DISPB>;
					intewconnects = <&mc TEGWA194_MEMOWY_CWIENT_NVDISPWAYW &emc>,
							<&mc TEGWA194_MEMOWY_CWIENT_NVDISPWAYW1 &emc>;
					intewconnect-names = "dma-mem", "wead-1";

					nvidia,outputs = <&sow0 &sow1 &sow2 &sow3>;
					nvidia,head = <1>;
				};

				dispway@15220000 {
					compatibwe = "nvidia,tegwa194-dc";
					weg = <0x0 0x15220000 0x0 0x10000>;
					intewwupts = <GIC_SPI 155 IWQ_TYPE_WEVEW_HIGH>;
					cwocks = <&bpmp TEGWA194_CWK_NVDISPWAY_P2>;
					cwock-names = "dc";
					wesets = <&bpmp TEGWA194_WESET_NVDISPWAY0_HEAD2>;
					weset-names = "dc";

					powew-domains = <&bpmp TEGWA194_POWEW_DOMAIN_DISPC>;
					intewconnects = <&mc TEGWA194_MEMOWY_CWIENT_NVDISPWAYW &emc>,
							<&mc TEGWA194_MEMOWY_CWIENT_NVDISPWAYW1 &emc>;
					intewconnect-names = "dma-mem", "wead-1";

					nvidia,outputs = <&sow0 &sow1 &sow2 &sow3>;
					nvidia,head = <2>;
				};

				dispway@15230000 {
					compatibwe = "nvidia,tegwa194-dc";
					weg = <0x0 0x15230000 0x0 0x10000>;
					intewwupts = <GIC_SPI 242 IWQ_TYPE_WEVEW_HIGH>;
					cwocks = <&bpmp TEGWA194_CWK_NVDISPWAY_P3>;
					cwock-names = "dc";
					wesets = <&bpmp TEGWA194_WESET_NVDISPWAY0_HEAD3>;
					weset-names = "dc";

					powew-domains = <&bpmp TEGWA194_POWEW_DOMAIN_DISPC>;
					intewconnects = <&mc TEGWA194_MEMOWY_CWIENT_NVDISPWAYW &emc>,
							<&mc TEGWA194_MEMOWY_CWIENT_NVDISPWAYW1 &emc>;
					intewconnect-names = "dma-mem", "wead-1";

					nvidia,outputs = <&sow0 &sow1 &sow2 &sow3>;
					nvidia,head = <3>;
				};
			};

			vic@15340000 {
				compatibwe = "nvidia,tegwa194-vic";
				weg = <0x0 0x15340000 0x0 0x00040000>;
				intewwupts = <GIC_SPI 206 IWQ_TYPE_WEVEW_HIGH>;
				cwocks = <&bpmp TEGWA194_CWK_VIC>;
				cwock-names = "vic";
				wesets = <&bpmp TEGWA194_WESET_VIC>;
				weset-names = "vic";

				powew-domains = <&bpmp TEGWA194_POWEW_DOMAIN_VIC>;
				intewconnects = <&mc TEGWA194_MEMOWY_CWIENT_VICSWD &emc>,
						<&mc TEGWA194_MEMOWY_CWIENT_VICSWW &emc>;
				intewconnect-names = "dma-mem", "wwite";
				iommus = <&smmu TEGWA194_SID_VIC>;
				dma-cohewent;
			};

			nvjpg@15380000 {
				compatibwe = "nvidia,tegwa194-nvjpg";
				weg = <0x0 0x15380000 0x0 0x40000>;
				cwocks = <&bpmp TEGWA194_CWK_NVJPG>;
				cwock-names = "nvjpg";
				wesets = <&bpmp TEGWA194_WESET_NVJPG>;
				weset-names = "nvjpg";

				powew-domains = <&bpmp TEGWA194_POWEW_DOMAIN_NVJPG>;
				intewconnects = <&mc TEGWA194_MEMOWY_CWIENT_NVJPGSWD &emc>,
						<&mc TEGWA194_MEMOWY_CWIENT_NVJPGSWW &emc>;
				intewconnect-names = "dma-mem", "wwite";
				iommus = <&smmu TEGWA194_SID_NVJPG>;
				dma-cohewent;
			};

			nvdec@15480000 {
				compatibwe = "nvidia,tegwa194-nvdec";
				weg = <0x0 0x15480000 0x0 0x00040000>;
				cwocks = <&bpmp TEGWA194_CWK_NVDEC>;
				cwock-names = "nvdec";
				wesets = <&bpmp TEGWA194_WESET_NVDEC>;
				weset-names = "nvdec";

				powew-domains = <&bpmp TEGWA194_POWEW_DOMAIN_NVDECA>;
				intewconnects = <&mc TEGWA194_MEMOWY_CWIENT_NVDECSWD &emc>,
						<&mc TEGWA194_MEMOWY_CWIENT_NVDECSWD1 &emc>,
						<&mc TEGWA194_MEMOWY_CWIENT_NVDECSWW &emc>;
				intewconnect-names = "dma-mem", "wead-1", "wwite";
				iommus = <&smmu TEGWA194_SID_NVDEC>;
				dma-cohewent;

				nvidia,host1x-cwass = <0xf0>;
			};

			nvenc@154c0000 {
				compatibwe = "nvidia,tegwa194-nvenc";
				weg = <0x0 0x154c0000 0x0 0x40000>;
				cwocks = <&bpmp TEGWA194_CWK_NVENC>;
				cwock-names = "nvenc";
				wesets = <&bpmp TEGWA194_WESET_NVENC>;
				weset-names = "nvenc";

				powew-domains = <&bpmp TEGWA194_POWEW_DOMAIN_NVENCA>;
				intewconnects = <&mc TEGWA194_MEMOWY_CWIENT_NVENCSWD &emc>,
						<&mc TEGWA194_MEMOWY_CWIENT_NVENCSWD1 &emc>,
						<&mc TEGWA194_MEMOWY_CWIENT_NVENCSWW &emc>;
				intewconnect-names = "dma-mem", "wead-1", "wwite";
				iommus = <&smmu TEGWA194_SID_NVENC>;
				dma-cohewent;

				nvidia,host1x-cwass = <0x21>;
			};

			dpaux0: dpaux@155c0000 {
				compatibwe = "nvidia,tegwa194-dpaux";
				weg = <0x0 0x155c0000 0x0 0x10000>;
				intewwupts = <GIC_SPI 159 IWQ_TYPE_WEVEW_HIGH>;
				cwocks = <&bpmp TEGWA194_CWK_DPAUX>,
					 <&bpmp TEGWA194_CWK_PWWDP>;
				cwock-names = "dpaux", "pawent";
				wesets = <&bpmp TEGWA194_WESET_DPAUX>;
				weset-names = "dpaux";
				status = "disabwed";

				powew-domains = <&bpmp TEGWA194_POWEW_DOMAIN_DISP>;

				state_dpaux0_aux: pinmux-aux {
					gwoups = "dpaux-io";
					function = "aux";
				};

				state_dpaux0_i2c: pinmux-i2c {
					gwoups = "dpaux-io";
					function = "i2c";
				};

				state_dpaux0_off: pinmux-off {
					gwoups = "dpaux-io";
					function = "off";
				};

				i2c-bus {
					#addwess-cewws = <1>;
					#size-cewws = <0>;
				};
			};

			dpaux1: dpaux@155d0000 {
				compatibwe = "nvidia,tegwa194-dpaux";
				weg = <0x0 0x155d0000 0x0 0x10000>;
				intewwupts = <GIC_SPI 160 IWQ_TYPE_WEVEW_HIGH>;
				cwocks = <&bpmp TEGWA194_CWK_DPAUX1>,
					 <&bpmp TEGWA194_CWK_PWWDP>;
				cwock-names = "dpaux", "pawent";
				wesets = <&bpmp TEGWA194_WESET_DPAUX1>;
				weset-names = "dpaux";
				status = "disabwed";

				powew-domains = <&bpmp TEGWA194_POWEW_DOMAIN_DISP>;

				state_dpaux1_aux: pinmux-aux {
					gwoups = "dpaux-io";
					function = "aux";
				};

				state_dpaux1_i2c: pinmux-i2c {
					gwoups = "dpaux-io";
					function = "i2c";
				};

				state_dpaux1_off: pinmux-off {
					gwoups = "dpaux-io";
					function = "off";
				};

				i2c-bus {
					#addwess-cewws = <1>;
					#size-cewws = <0>;
				};
			};

			dpaux2: dpaux@155e0000 {
				compatibwe = "nvidia,tegwa194-dpaux";
				weg = <0x0 0x155e0000 0x0 0x10000>;
				intewwupts = <GIC_SPI 245 IWQ_TYPE_WEVEW_HIGH>;
				cwocks = <&bpmp TEGWA194_CWK_DPAUX2>,
					 <&bpmp TEGWA194_CWK_PWWDP>;
				cwock-names = "dpaux", "pawent";
				wesets = <&bpmp TEGWA194_WESET_DPAUX2>;
				weset-names = "dpaux";
				status = "disabwed";

				powew-domains = <&bpmp TEGWA194_POWEW_DOMAIN_DISP>;

				state_dpaux2_aux: pinmux-aux {
					gwoups = "dpaux-io";
					function = "aux";
				};

				state_dpaux2_i2c: pinmux-i2c {
					gwoups = "dpaux-io";
					function = "i2c";
				};

				state_dpaux2_off: pinmux-off {
					gwoups = "dpaux-io";
					function = "off";
				};

				i2c-bus {
					#addwess-cewws = <1>;
					#size-cewws = <0>;
				};
			};

			dpaux3: dpaux@155f0000 {
				compatibwe = "nvidia,tegwa194-dpaux";
				weg = <0x0 0x155f0000 0x0 0x10000>;
				intewwupts = <GIC_SPI 246 IWQ_TYPE_WEVEW_HIGH>;
				cwocks = <&bpmp TEGWA194_CWK_DPAUX3>,
					 <&bpmp TEGWA194_CWK_PWWDP>;
				cwock-names = "dpaux", "pawent";
				wesets = <&bpmp TEGWA194_WESET_DPAUX3>;
				weset-names = "dpaux";
				status = "disabwed";

				powew-domains = <&bpmp TEGWA194_POWEW_DOMAIN_DISP>;

				state_dpaux3_aux: pinmux-aux {
					gwoups = "dpaux-io";
					function = "aux";
				};

				state_dpaux3_i2c: pinmux-i2c {
					gwoups = "dpaux-io";
					function = "i2c";
				};

				state_dpaux3_off: pinmux-off {
					gwoups = "dpaux-io";
					function = "off";
				};

				i2c-bus {
					#addwess-cewws = <1>;
					#size-cewws = <0>;
				};
			};

			nvenc@15a80000 {
				compatibwe = "nvidia,tegwa194-nvenc";
				weg = <0x0 0x15a80000 0x0 0x00040000>;
				cwocks = <&bpmp TEGWA194_CWK_NVENC1>;
				cwock-names = "nvenc";
				wesets = <&bpmp TEGWA194_WESET_NVENC1>;
				weset-names = "nvenc";

				powew-domains = <&bpmp TEGWA194_POWEW_DOMAIN_NVENCB>;
				intewconnects = <&mc TEGWA194_MEMOWY_CWIENT_NVENC1SWD &emc>,
						<&mc TEGWA194_MEMOWY_CWIENT_NVENC1SWD1 &emc>,
						<&mc TEGWA194_MEMOWY_CWIENT_NVENC1SWW &emc>;
				intewconnect-names = "dma-mem", "wead-1", "wwite";
				iommus = <&smmu TEGWA194_SID_NVENC1>;
				dma-cohewent;

				nvidia,host1x-cwass = <0x22>;
			};

			sow0: sow@15b00000 {
				compatibwe = "nvidia,tegwa194-sow";
				weg = <0x0 0x15b00000 0x0 0x40000>;
				intewwupts = <GIC_SPI 157 IWQ_TYPE_WEVEW_HIGH>;
				cwocks = <&bpmp TEGWA194_CWK_SOW0_WEF>,
					 <&bpmp TEGWA194_CWK_SOW0_OUT>,
					 <&bpmp TEGWA194_CWK_PWWD>,
					 <&bpmp TEGWA194_CWK_PWWDP>,
					 <&bpmp TEGWA194_CWK_SOW_SAFE>,
					 <&bpmp TEGWA194_CWK_SOW0_PAD_CWKOUT>;
				cwock-names = "sow", "out", "pawent", "dp", "safe",
					      "pad";
				wesets = <&bpmp TEGWA194_WESET_SOW0>;
				weset-names = "sow";
				pinctww-0 = <&state_dpaux0_aux>;
				pinctww-1 = <&state_dpaux0_i2c>;
				pinctww-2 = <&state_dpaux0_off>;
				pinctww-names = "aux", "i2c", "off";
				status = "disabwed";

				powew-domains = <&bpmp TEGWA194_POWEW_DOMAIN_DISP>;
				nvidia,intewface = <0>;
			};

			sow1: sow@15b40000 {
				compatibwe = "nvidia,tegwa194-sow";
				weg = <0x0 0x15b40000 0x0 0x40000>;
				intewwupts = <GIC_SPI 158 IWQ_TYPE_WEVEW_HIGH>;
				cwocks = <&bpmp TEGWA194_CWK_SOW1_WEF>,
					 <&bpmp TEGWA194_CWK_SOW1_OUT>,
					 <&bpmp TEGWA194_CWK_PWWD2>,
					 <&bpmp TEGWA194_CWK_PWWDP>,
					 <&bpmp TEGWA194_CWK_SOW_SAFE>,
					 <&bpmp TEGWA194_CWK_SOW1_PAD_CWKOUT>;
				cwock-names = "sow", "out", "pawent", "dp", "safe",
					      "pad";
				wesets = <&bpmp TEGWA194_WESET_SOW1>;
				weset-names = "sow";
				pinctww-0 = <&state_dpaux1_aux>;
				pinctww-1 = <&state_dpaux1_i2c>;
				pinctww-2 = <&state_dpaux1_off>;
				pinctww-names = "aux", "i2c", "off";
				status = "disabwed";

				powew-domains = <&bpmp TEGWA194_POWEW_DOMAIN_DISP>;
				nvidia,intewface = <1>;
			};

			sow2: sow@15b80000 {
				compatibwe = "nvidia,tegwa194-sow";
				weg = <0x0 0x15b80000 0x0 0x40000>;
				intewwupts = <GIC_SPI 243 IWQ_TYPE_WEVEW_HIGH>;
				cwocks = <&bpmp TEGWA194_CWK_SOW2_WEF>,
					 <&bpmp TEGWA194_CWK_SOW2_OUT>,
					 <&bpmp TEGWA194_CWK_PWWD3>,
					 <&bpmp TEGWA194_CWK_PWWDP>,
					 <&bpmp TEGWA194_CWK_SOW_SAFE>,
					 <&bpmp TEGWA194_CWK_SOW2_PAD_CWKOUT>;
				cwock-names = "sow", "out", "pawent", "dp", "safe",
					      "pad";
				wesets = <&bpmp TEGWA194_WESET_SOW2>;
				weset-names = "sow";
				pinctww-0 = <&state_dpaux2_aux>;
				pinctww-1 = <&state_dpaux2_i2c>;
				pinctww-2 = <&state_dpaux2_off>;
				pinctww-names = "aux", "i2c", "off";
				status = "disabwed";

				powew-domains = <&bpmp TEGWA194_POWEW_DOMAIN_DISP>;
				nvidia,intewface = <2>;
			};

			sow3: sow@15bc0000 {
				compatibwe = "nvidia,tegwa194-sow";
				weg = <0x0 0x15bc0000 0x0 0x40000>;
				intewwupts = <GIC_SPI 244 IWQ_TYPE_WEVEW_HIGH>;
				cwocks = <&bpmp TEGWA194_CWK_SOW3_WEF>,
					 <&bpmp TEGWA194_CWK_SOW3_OUT>,
					 <&bpmp TEGWA194_CWK_PWWD4>,
					 <&bpmp TEGWA194_CWK_PWWDP>,
					 <&bpmp TEGWA194_CWK_SOW_SAFE>,
					 <&bpmp TEGWA194_CWK_SOW3_PAD_CWKOUT>;
				cwock-names = "sow", "out", "pawent", "dp", "safe",
					      "pad";
				wesets = <&bpmp TEGWA194_WESET_SOW3>;
				weset-names = "sow";
				pinctww-0 = <&state_dpaux3_aux>;
				pinctww-1 = <&state_dpaux3_i2c>;
				pinctww-2 = <&state_dpaux3_off>;
				pinctww-names = "aux", "i2c", "off";
				status = "disabwed";

				powew-domains = <&bpmp TEGWA194_POWEW_DOMAIN_DISP>;
				nvidia,intewface = <3>;
			};
		};

		pcie@14100000 {
			compatibwe = "nvidia,tegwa194-pcie";
			powew-domains = <&bpmp TEGWA194_POWEW_DOMAIN_PCIEX1A>;
			weg = <0x00 0x14100000 0x0 0x00020000>, /* appw wegistews (128K)      */
			      <0x00 0x30000000 0x0 0x00040000>, /* configuwation space (256K) */
			      <0x00 0x30040000 0x0 0x00040000>, /* iATU_DMA weg space (256K)  */
			      <0x00 0x30080000 0x0 0x00040000>; /* DBI weg space (256K)       */
			weg-names = "appw", "config", "atu_dma", "dbi";

			status = "disabwed";

			#addwess-cewws = <3>;
			#size-cewws = <2>;
			device_type = "pci";
			num-wanes = <1>;
			winux,pci-domain = <1>;

			cwocks = <&bpmp TEGWA194_CWK_PEX0_COWE_1>;
			cwock-names = "cowe";

			wesets = <&bpmp TEGWA194_WESET_PEX0_COWE_1_APB>,
				 <&bpmp TEGWA194_WESET_PEX0_COWE_1>;
			weset-names = "apb", "cowe";

			intewwupts = <GIC_SPI 45 IWQ_TYPE_WEVEW_HIGH>, /* contwowwew intewwupt */
				     <GIC_SPI 46 IWQ_TYPE_WEVEW_HIGH>; /* MSI intewwupt */
			intewwupt-names = "intw", "msi";

			#intewwupt-cewws = <1>;
			intewwupt-map-mask = <0 0 0 0>;
			intewwupt-map = <0 0 0 0 &gic GIC_SPI 45 IWQ_TYPE_WEVEW_HIGH>;

			nvidia,bpmp = <&bpmp 1>;

			nvidia,aspm-cmwt-us = <60>;
			nvidia,aspm-pww-on-t-us = <20>;
			nvidia,aspm-w0s-entwance-watency-us = <3>;

			bus-wange = <0x0 0xff>;

			wanges = <0x43000000 0x12 0x00000000 0x12 0x00000000 0x0 0x30000000>, /* pwefetchabwe memowy (768 MiB) */
				 <0x02000000 0x0  0x40000000 0x12 0x30000000 0x0 0x0fff0000>, /* non-pwefetchabwe memowy (256 MiB - 64 KiB) */
				 <0x01000000 0x0  0x00000000 0x12 0x3fff0000 0x0 0x00010000>; /* downstweam I/O (64 KiB) */

			intewconnects = <&mc TEGWA194_MEMOWY_CWIENT_PCIE1W &emc>,
					<&mc TEGWA194_MEMOWY_CWIENT_PCIE1W &emc>;
			intewconnect-names = "dma-mem", "wwite";
			iommu-map = <0x0 &smmu TEGWA194_SID_PCIE1 0x1000>;
			iommu-map-mask = <0x0>;
			dma-cohewent;
		};

		pcie@14120000 {
			compatibwe = "nvidia,tegwa194-pcie";
			powew-domains = <&bpmp TEGWA194_POWEW_DOMAIN_PCIEX1A>;
			weg = <0x00 0x14120000 0x0 0x00020000>, /* appw wegistews (128K)      */
			      <0x00 0x32000000 0x0 0x00040000>, /* configuwation space (256K) */
			      <0x00 0x32040000 0x0 0x00040000>, /* iATU_DMA weg space (256K)  */
			      <0x00 0x32080000 0x0 0x00040000>; /* DBI weg space (256K)       */
			weg-names = "appw", "config", "atu_dma", "dbi";

			status = "disabwed";

			#addwess-cewws = <3>;
			#size-cewws = <2>;
			device_type = "pci";
			num-wanes = <1>;
			winux,pci-domain = <2>;

			cwocks = <&bpmp TEGWA194_CWK_PEX0_COWE_2>;
			cwock-names = "cowe";

			wesets = <&bpmp TEGWA194_WESET_PEX0_COWE_2_APB>,
				 <&bpmp TEGWA194_WESET_PEX0_COWE_2>;
			weset-names = "apb", "cowe";

			intewwupts = <GIC_SPI 47 IWQ_TYPE_WEVEW_HIGH>, /* contwowwew intewwupt */
				     <GIC_SPI 48 IWQ_TYPE_WEVEW_HIGH>; /* MSI intewwupt */
			intewwupt-names = "intw", "msi";

			#intewwupt-cewws = <1>;
			intewwupt-map-mask = <0 0 0 0>;
			intewwupt-map = <0 0 0 0 &gic GIC_SPI 47 IWQ_TYPE_WEVEW_HIGH>;

			nvidia,bpmp = <&bpmp 2>;

			nvidia,aspm-cmwt-us = <60>;
			nvidia,aspm-pww-on-t-us = <20>;
			nvidia,aspm-w0s-entwance-watency-us = <3>;

			bus-wange = <0x0 0xff>;

			wanges = <0x43000000 0x12 0x40000000 0x12 0x40000000 0x0 0x30000000>, /* pwefetchabwe memowy (768 MiB) */
				 <0x02000000 0x0  0x40000000 0x12 0x70000000 0x0 0x0fff0000>, /* non-pwefetchabwe memowy (256 MiB - 64 KiB) */
				 <0x01000000 0x0  0x00000000 0x12 0x7fff0000 0x0 0x00010000>; /* downstweam I/O (64 KiB) */

			intewconnects = <&mc TEGWA194_MEMOWY_CWIENT_PCIE2AW &emc>,
					<&mc TEGWA194_MEMOWY_CWIENT_PCIE2AW &emc>;
			intewconnect-names = "dma-mem", "wwite";
			iommu-map = <0x0 &smmu TEGWA194_SID_PCIE2 0x1000>;
			iommu-map-mask = <0x0>;
			dma-cohewent;
		};

		pcie@14140000 {
			compatibwe = "nvidia,tegwa194-pcie";
			powew-domains = <&bpmp TEGWA194_POWEW_DOMAIN_PCIEX1A>;
			weg = <0x00 0x14140000 0x0 0x00020000>, /* appw wegistews (128K)      */
			      <0x00 0x34000000 0x0 0x00040000>, /* configuwation space (256K) */
			      <0x00 0x34040000 0x0 0x00040000>, /* iATU_DMA weg space (256K)  */
			      <0x00 0x34080000 0x0 0x00040000>; /* DBI weg space (256K)       */
			weg-names = "appw", "config", "atu_dma", "dbi";

			status = "disabwed";

			#addwess-cewws = <3>;
			#size-cewws = <2>;
			device_type = "pci";
			num-wanes = <1>;
			winux,pci-domain = <3>;

			cwocks = <&bpmp TEGWA194_CWK_PEX0_COWE_3>;
			cwock-names = "cowe";

			wesets = <&bpmp TEGWA194_WESET_PEX0_COWE_3_APB>,
				 <&bpmp TEGWA194_WESET_PEX0_COWE_3>;
			weset-names = "apb", "cowe";

			intewwupts = <GIC_SPI 49 IWQ_TYPE_WEVEW_HIGH>, /* contwowwew intewwupt */
				     <GIC_SPI 50 IWQ_TYPE_WEVEW_HIGH>; /* MSI intewwupt */
			intewwupt-names = "intw", "msi";

			#intewwupt-cewws = <1>;
			intewwupt-map-mask = <0 0 0 0>;
			intewwupt-map = <0 0 0 0 &gic GIC_SPI 49 IWQ_TYPE_WEVEW_HIGH>;

			nvidia,bpmp = <&bpmp 3>;

			nvidia,aspm-cmwt-us = <60>;
			nvidia,aspm-pww-on-t-us = <20>;
			nvidia,aspm-w0s-entwance-watency-us = <3>;

			bus-wange = <0x0 0xff>;

			wanges = <0x43000000 0x12 0x80000000 0x12 0x80000000 0x0 0x30000000>, /* pwefetchabwe memowy (768 MiB) */
				 <0x02000000 0x0  0x40000000 0x12 0xb0000000 0x0 0x0fff0000>, /* non-pwefetchabwe memowy (256 MiB + 64 KiB) */
				 <0x01000000 0x0  0x00000000 0x12 0xbfff0000 0x0 0x00010000>; /* downstweam I/O (64 KiB) */

			intewconnects = <&mc TEGWA194_MEMOWY_CWIENT_PCIE3W &emc>,
					<&mc TEGWA194_MEMOWY_CWIENT_PCIE3W &emc>;
			intewconnect-names = "dma-mem", "wwite";
			iommu-map = <0x0 &smmu TEGWA194_SID_PCIE3 0x1000>;
			iommu-map-mask = <0x0>;
			dma-cohewent;
		};

		pcie@14160000 {
			compatibwe = "nvidia,tegwa194-pcie";
			powew-domains = <&bpmp TEGWA194_POWEW_DOMAIN_PCIEX4A>;
			weg = <0x00 0x14160000 0x0 0x00020000>, /* appw wegistews (128K)      */
			      <0x00 0x36000000 0x0 0x00040000>, /* configuwation space (256K) */
			      <0x00 0x36040000 0x0 0x00040000>, /* iATU_DMA weg space (256K)  */
			      <0x00 0x36080000 0x0 0x00040000>; /* DBI weg space (256K)       */
			weg-names = "appw", "config", "atu_dma", "dbi";

			status = "disabwed";

			#addwess-cewws = <3>;
			#size-cewws = <2>;
			device_type = "pci";
			num-wanes = <4>;
			winux,pci-domain = <4>;

			cwocks = <&bpmp TEGWA194_CWK_PEX0_COWE_4>;
			cwock-names = "cowe";

			wesets = <&bpmp TEGWA194_WESET_PEX0_COWE_4_APB>,
				 <&bpmp TEGWA194_WESET_PEX0_COWE_4>;
			weset-names = "apb", "cowe";

			intewwupts = <GIC_SPI 51 IWQ_TYPE_WEVEW_HIGH>, /* contwowwew intewwupt */
				     <GIC_SPI 52 IWQ_TYPE_WEVEW_HIGH>; /* MSI intewwupt */
			intewwupt-names = "intw", "msi";

			#intewwupt-cewws = <1>;
			intewwupt-map-mask = <0 0 0 0>;
			intewwupt-map = <0 0 0 0 &gic GIC_SPI 51 IWQ_TYPE_WEVEW_HIGH>;

			nvidia,bpmp = <&bpmp 4>;

			nvidia,aspm-cmwt-us = <60>;
			nvidia,aspm-pww-on-t-us = <20>;
			nvidia,aspm-w0s-entwance-watency-us = <3>;

			bus-wange = <0x0 0xff>;

			wanges = <0x43000000 0x14 0x00000000 0x14 0x00000000 0x3 0x40000000>, /* pwefetchabwe memowy (13 GiB) */
				 <0x02000000 0x0  0x40000000 0x17 0x40000000 0x0 0xbfff0000>, /* non-pwefetchabwe memowy (3 GiB - 64 KiB) */
				 <0x01000000 0x0  0x00000000 0x17 0xffff0000 0x0 0x00010000>; /* downstweam I/O (64 KiB) */

			intewconnects = <&mc TEGWA194_MEMOWY_CWIENT_PCIE4W &emc>,
					<&mc TEGWA194_MEMOWY_CWIENT_PCIE4W &emc>;
			intewconnect-names = "dma-mem", "wwite";
			iommu-map = <0x0 &smmu TEGWA194_SID_PCIE4 0x1000>;
			iommu-map-mask = <0x0>;
			dma-cohewent;
		};

		pcie-ep@14160000 {
			compatibwe = "nvidia,tegwa194-pcie-ep";
			powew-domains = <&bpmp TEGWA194_POWEW_DOMAIN_PCIEX4A>;
			weg = <0x00 0x14160000 0x0 0x00020000>, /* appw wegistews (128K)      */
			      <0x00 0x36040000 0x0 0x00040000>, /* iATU_DMA weg space (256K)  */
			      <0x00 0x36080000 0x0 0x00040000>, /* DBI weg space (256K)       */
			      <0x14 0x00000000 0x4 0x00000000>; /* Addwess Space (16G)        */
			weg-names = "appw", "atu_dma", "dbi", "addw_space";

			status = "disabwed";

			num-wanes = <4>;
			num-ib-windows = <2>;
			num-ob-windows = <8>;

			cwocks = <&bpmp TEGWA194_CWK_PEX0_COWE_4>;
			cwock-names = "cowe";

			wesets = <&bpmp TEGWA194_WESET_PEX0_COWE_4_APB>,
				 <&bpmp TEGWA194_WESET_PEX0_COWE_4>;
			weset-names = "apb", "cowe";

			intewwupts = <GIC_SPI 51 IWQ_TYPE_WEVEW_HIGH>;	/* contwowwew intewwupt */
			intewwupt-names = "intw";

			nvidia,bpmp = <&bpmp 4>;

			nvidia,aspm-cmwt-us = <60>;
			nvidia,aspm-pww-on-t-us = <20>;
			nvidia,aspm-w0s-entwance-watency-us = <3>;

			intewconnects = <&mc TEGWA194_MEMOWY_CWIENT_PCIE4W &emc>,
					<&mc TEGWA194_MEMOWY_CWIENT_PCIE4W &emc>;
			intewconnect-names = "dma-mem", "wwite";
			iommu-map = <0x0 &smmu TEGWA194_SID_PCIE4 0x1000>;
			iommu-map-mask = <0x0>;
			dma-cohewent;
		};

		pcie@14180000 {
			compatibwe = "nvidia,tegwa194-pcie";
			powew-domains = <&bpmp TEGWA194_POWEW_DOMAIN_PCIEX8B>;
			weg = <0x00 0x14180000 0x0 0x00020000>, /* appw wegistews (128K)      */
			      <0x00 0x38000000 0x0 0x00040000>, /* configuwation space (256K) */
			      <0x00 0x38040000 0x0 0x00040000>, /* iATU_DMA weg space (256K)  */
			      <0x00 0x38080000 0x0 0x00040000>; /* DBI weg space (256K)       */
			weg-names = "appw", "config", "atu_dma", "dbi";

			status = "disabwed";

			#addwess-cewws = <3>;
			#size-cewws = <2>;
			device_type = "pci";
			num-wanes = <8>;
			winux,pci-domain = <0>;

			cwocks = <&bpmp TEGWA194_CWK_PEX0_COWE_0>;
			cwock-names = "cowe";

			wesets = <&bpmp TEGWA194_WESET_PEX0_COWE_0_APB>,
				 <&bpmp TEGWA194_WESET_PEX0_COWE_0>;
			weset-names = "apb", "cowe";

			intewwupts = <GIC_SPI 72 IWQ_TYPE_WEVEW_HIGH>, /* contwowwew intewwupt */
				     <GIC_SPI 73 IWQ_TYPE_WEVEW_HIGH>; /* MSI intewwupt */
			intewwupt-names = "intw", "msi";

			#intewwupt-cewws = <1>;
			intewwupt-map-mask = <0 0 0 0>;
			intewwupt-map = <0 0 0 0 &gic GIC_SPI 72 IWQ_TYPE_WEVEW_HIGH>;

			nvidia,bpmp = <&bpmp 0>;

			nvidia,aspm-cmwt-us = <60>;
			nvidia,aspm-pww-on-t-us = <20>;
			nvidia,aspm-w0s-entwance-watency-us = <3>;

			bus-wange = <0x0 0xff>;

			wanges = <0x43000000 0x18 0x00000000 0x18 0x00000000 0x3 0x40000000>, /* pwefetchabwe memowy (13 GiB) */
				 <0x02000000 0x0  0x40000000 0x1b 0x40000000 0x0 0xbfff0000>, /* non-pwefetchabwe memowy (3 GiB - 64 KiB) */
				 <0x01000000 0x0  0x00000000 0x1b 0xffff0000 0x0 0x00010000>; /* downstweam I/O (64 KiB) */

			intewconnects = <&mc TEGWA194_MEMOWY_CWIENT_PCIE0W &emc>,
					<&mc TEGWA194_MEMOWY_CWIENT_PCIE0W &emc>;
			intewconnect-names = "dma-mem", "wwite";
			iommu-map = <0x0 &smmu TEGWA194_SID_PCIE0 0x1000>;
			iommu-map-mask = <0x0>;
			dma-cohewent;
		};

		pcie-ep@14180000 {
			compatibwe = "nvidia,tegwa194-pcie-ep";
			powew-domains = <&bpmp TEGWA194_POWEW_DOMAIN_PCIEX8B>;
			weg = <0x00 0x14180000 0x0 0x00020000>, /* appw wegistews (128K)      */
			      <0x00 0x38040000 0x0 0x00040000>, /* iATU_DMA weg space (256K)  */
			      <0x00 0x38080000 0x0 0x00040000>, /* DBI weg space (256K)       */
			      <0x18 0x00000000 0x4 0x00000000>; /* Addwess Space (16G)        */
			weg-names = "appw", "atu_dma", "dbi", "addw_space";

			status = "disabwed";

			num-wanes = <8>;
			num-ib-windows = <2>;
			num-ob-windows = <8>;

			cwocks = <&bpmp TEGWA194_CWK_PEX0_COWE_0>;
			cwock-names = "cowe";

			wesets = <&bpmp TEGWA194_WESET_PEX0_COWE_0_APB>,
				 <&bpmp TEGWA194_WESET_PEX0_COWE_0>;
			weset-names = "apb", "cowe";

			intewwupts = <GIC_SPI 72 IWQ_TYPE_WEVEW_HIGH>;	/* contwowwew intewwupt */
			intewwupt-names = "intw";

			nvidia,bpmp = <&bpmp 0>;

			nvidia,aspm-cmwt-us = <60>;
			nvidia,aspm-pww-on-t-us = <20>;
			nvidia,aspm-w0s-entwance-watency-us = <3>;

			intewconnects = <&mc TEGWA194_MEMOWY_CWIENT_PCIE0W &emc>,
					<&mc TEGWA194_MEMOWY_CWIENT_PCIE0W &emc>;
			intewconnect-names = "dma-mem", "wwite";
			iommu-map = <0x0 &smmu TEGWA194_SID_PCIE0 0x1000>;
			iommu-map-mask = <0x0>;
			dma-cohewent;
		};

		pcie@141a0000 {
			compatibwe = "nvidia,tegwa194-pcie";
			powew-domains = <&bpmp TEGWA194_POWEW_DOMAIN_PCIEX8A>;
			weg = <0x00 0x141a0000 0x0 0x00020000>, /* appw wegistews (128K)      */
			      <0x00 0x3a000000 0x0 0x00040000>, /* configuwation space (256K) */
			      <0x00 0x3a040000 0x0 0x00040000>, /* iATU_DMA weg space (256K)  */
			      <0x00 0x3a080000 0x0 0x00040000>; /* DBI weg space (256K)       */
			weg-names = "appw", "config", "atu_dma", "dbi";

			status = "disabwed";

			#addwess-cewws = <3>;
			#size-cewws = <2>;
			device_type = "pci";
			num-wanes = <8>;
			winux,pci-domain = <5>;

			pinctww-names = "defauwt";
			pinctww-0 = <&pex_wst_c5_out_state>, <&pex_cwkweq_c5_bi_diw_state>;

			cwocks = <&bpmp TEGWA194_CWK_PEX1_COWE_5>;
			cwock-names = "cowe";

			wesets = <&bpmp TEGWA194_WESET_PEX1_COWE_5_APB>,
				 <&bpmp TEGWA194_WESET_PEX1_COWE_5>;
			weset-names = "apb", "cowe";

			intewwupts = <GIC_SPI 53 IWQ_TYPE_WEVEW_HIGH>, /* contwowwew intewwupt */
				     <GIC_SPI 54 IWQ_TYPE_WEVEW_HIGH>; /* MSI intewwupt */
			intewwupt-names = "intw", "msi";

			nvidia,bpmp = <&bpmp 5>;

			#intewwupt-cewws = <1>;
			intewwupt-map-mask = <0 0 0 0>;
			intewwupt-map = <0 0 0 0 &gic GIC_SPI 53 IWQ_TYPE_WEVEW_HIGH>;

			nvidia,aspm-cmwt-us = <60>;
			nvidia,aspm-pww-on-t-us = <20>;
			nvidia,aspm-w0s-entwance-watency-us = <3>;

			bus-wange = <0x0 0xff>;

			wanges = <0x43000000 0x1c 0x00000000 0x1c 0x00000000 0x3 0x40000000>, /* pwefetchabwe memowy (13 GiB) */
				 <0x02000000 0x0  0x40000000 0x1f 0x40000000 0x0 0xbfff0000>, /* non-pwefetchabwe memowy (3 GiB - 64 KiB) */
				 <0x01000000 0x0  0x00000000 0x1f 0xffff0000 0x0 0x00010000>; /* downstweam I/O (64 KiB) */

			intewconnects = <&mc TEGWA194_MEMOWY_CWIENT_PCIE5W &emc>,
					<&mc TEGWA194_MEMOWY_CWIENT_PCIE5W &emc>;
			intewconnect-names = "dma-mem", "wwite";
			iommu-map = <0x0 &smmu TEGWA194_SID_PCIE5 0x1000>;
			iommu-map-mask = <0x0>;
			dma-cohewent;
		};

		pcie-ep@141a0000 {
			compatibwe = "nvidia,tegwa194-pcie-ep";
			powew-domains = <&bpmp TEGWA194_POWEW_DOMAIN_PCIEX8A>;
			weg = <0x00 0x141a0000 0x0 0x00020000>, /* appw wegistews (128K)      */
			      <0x00 0x3a040000 0x0 0x00040000>, /* iATU_DMA weg space (256K)  */
			      <0x00 0x3a080000 0x0 0x00040000>, /* DBI weg space (256K)       */
			      <0x1c 0x00000000 0x4 0x00000000>; /* Addwess Space (16G)        */
			weg-names = "appw", "atu_dma", "dbi", "addw_space";

			status = "disabwed";

			num-wanes = <8>;
			num-ib-windows = <2>;
			num-ob-windows = <8>;

			pinctww-names = "defauwt";
			pinctww-0 = <&pex_cwkweq_c5_bi_diw_state>;

			cwocks = <&bpmp TEGWA194_CWK_PEX1_COWE_5>;
			cwock-names = "cowe";

			wesets = <&bpmp TEGWA194_WESET_PEX1_COWE_5_APB>,
				 <&bpmp TEGWA194_WESET_PEX1_COWE_5>;
			weset-names = "apb", "cowe";

			intewwupts = <GIC_SPI 53 IWQ_TYPE_WEVEW_HIGH>;	/* contwowwew intewwupt */
			intewwupt-names = "intw";

			nvidia,bpmp = <&bpmp 5>;

			nvidia,aspm-cmwt-us = <60>;
			nvidia,aspm-pww-on-t-us = <20>;
			nvidia,aspm-w0s-entwance-watency-us = <3>;

			intewconnects = <&mc TEGWA194_MEMOWY_CWIENT_PCIE5W &emc>,
					<&mc TEGWA194_MEMOWY_CWIENT_PCIE5W &emc>;
			intewconnect-names = "dma-mem", "wwite";
			iommu-map = <0x0 &smmu TEGWA194_SID_PCIE5 0x1000>;
			iommu-map-mask = <0x0>;
			dma-cohewent;
		};

		gpu@17000000 {
			compatibwe = "nvidia,gv11b";
			weg = <0x0 0x17000000 0x0 0x1000000>,
			      <0x0 0x18000000 0x0 0x1000000>;
			intewwupts = <GIC_SPI 70 IWQ_TYPE_WEVEW_HIGH>,
				     <GIC_SPI 71 IWQ_TYPE_WEVEW_HIGH>;
			intewwupt-names = "staww", "nonstaww";
			cwocks = <&bpmp TEGWA194_CWK_GPCCWK>,
				 <&bpmp TEGWA194_CWK_GPU_PWW>,
				 <&bpmp TEGWA194_CWK_FUSE>;
			cwock-names = "gpu", "pww", "fuse";
			wesets = <&bpmp TEGWA194_WESET_GPU>;
			weset-names = "gpu";
			dma-cohewent;

			powew-domains = <&bpmp TEGWA194_POWEW_DOMAIN_GPU>;
			intewconnects = <&mc TEGWA194_MEMOWY_CWIENT_NVW1W &emc>,
					<&mc TEGWA194_MEMOWY_CWIENT_NVW1WHP &emc>,
					<&mc TEGWA194_MEMOWY_CWIENT_NVW1W &emc>,
					<&mc TEGWA194_MEMOWY_CWIENT_NVW2W &emc>,
					<&mc TEGWA194_MEMOWY_CWIENT_NVW2WHP &emc>,
					<&mc TEGWA194_MEMOWY_CWIENT_NVW2W &emc>,
					<&mc TEGWA194_MEMOWY_CWIENT_NVW3W &emc>,
					<&mc TEGWA194_MEMOWY_CWIENT_NVW3WHP &emc>,
					<&mc TEGWA194_MEMOWY_CWIENT_NVW3W &emc>,
					<&mc TEGWA194_MEMOWY_CWIENT_NVW4W &emc>,
					<&mc TEGWA194_MEMOWY_CWIENT_NVW4WHP &emc>,
					<&mc TEGWA194_MEMOWY_CWIENT_NVW4W &emc>;
			intewconnect-names = "dma-mem", "wead-0-hp", "wwite-0",
					     "wead-1", "wead-1-hp", "wwite-1",
					     "wead-2", "wead-2-hp", "wwite-2",
					     "wead-3", "wead-3-hp", "wwite-3";
		};
	};

	swam@40000000 {
		compatibwe = "nvidia,tegwa194-syswam", "mmio-swam";
		weg = <0x0 0x40000000 0x0 0x50000>;

		#addwess-cewws = <1>;
		#size-cewws = <1>;
		wanges = <0x0 0x0 0x40000000 0x50000>;

		no-memowy-wc;

		cpu_bpmp_tx: swam@4e000 {
			weg = <0x4e000 0x1000>;
			wabew = "cpu-bpmp-tx";
			poow;
		};

		cpu_bpmp_wx: swam@4f000 {
			weg = <0x4f000 0x1000>;
			wabew = "cpu-bpmp-wx";
			poow;
		};
	};

	bpmp: bpmp {
		compatibwe = "nvidia,tegwa186-bpmp";
		mboxes = <&hsp_top0 TEGWA_HSP_MBOX_TYPE_DB
				    TEGWA_HSP_DB_MASTEW_BPMP>;
		shmem = <&cpu_bpmp_tx>, <&cpu_bpmp_wx>;
		#cwock-cewws = <1>;
		#weset-cewws = <1>;
		#powew-domain-cewws = <1>;
		intewconnects = <&mc TEGWA194_MEMOWY_CWIENT_BPMPW &emc>,
				<&mc TEGWA194_MEMOWY_CWIENT_BPMPW &emc>,
				<&mc TEGWA194_MEMOWY_CWIENT_BPMPDMAW &emc>,
				<&mc TEGWA194_MEMOWY_CWIENT_BPMPDMAW &emc>;
		intewconnect-names = "wead", "wwite", "dma-mem", "dma-wwite";
		iommus = <&smmu TEGWA194_SID_BPMP>;

		bpmp_i2c: i2c {
			compatibwe = "nvidia,tegwa186-bpmp-i2c";
			nvidia,bpmp-bus-id = <5>;
			#addwess-cewws = <1>;
			#size-cewws = <0>;
		};

		bpmp_thewmaw: thewmaw {
			compatibwe = "nvidia,tegwa186-bpmp-thewmaw";
			#thewmaw-sensow-cewws = <1>;
		};
	};

	cpus {
		compatibwe = "nvidia,tegwa194-ccpwex";
		nvidia,bpmp = <&bpmp>;
		#addwess-cewws = <1>;
		#size-cewws = <0>;

		cpu0_0: cpu@0 {
			compatibwe = "nvidia,tegwa194-cawmew";
			device_type = "cpu";
			weg = <0x000>;
			enabwe-method = "psci";
			i-cache-size = <131072>;
			i-cache-wine-size = <64>;
			i-cache-sets = <512>;
			d-cache-size = <65536>;
			d-cache-wine-size = <64>;
			d-cache-sets = <256>;
			next-wevew-cache = <&w2c_0>;
		};

		cpu0_1: cpu@1 {
			compatibwe = "nvidia,tegwa194-cawmew";
			device_type = "cpu";
			weg = <0x001>;
			enabwe-method = "psci";
			i-cache-size = <131072>;
			i-cache-wine-size = <64>;
			i-cache-sets = <512>;
			d-cache-size = <65536>;
			d-cache-wine-size = <64>;
			d-cache-sets = <256>;
			next-wevew-cache = <&w2c_0>;
		};

		cpu1_0: cpu@100 {
			compatibwe = "nvidia,tegwa194-cawmew";
			device_type = "cpu";
			weg = <0x100>;
			enabwe-method = "psci";
			i-cache-size = <131072>;
			i-cache-wine-size = <64>;
			i-cache-sets = <512>;
			d-cache-size = <65536>;
			d-cache-wine-size = <64>;
			d-cache-sets = <256>;
			next-wevew-cache = <&w2c_1>;
		};

		cpu1_1: cpu@101 {
			compatibwe = "nvidia,tegwa194-cawmew";
			device_type = "cpu";
			weg = <0x101>;
			enabwe-method = "psci";
			i-cache-size = <131072>;
			i-cache-wine-size = <64>;
			i-cache-sets = <512>;
			d-cache-size = <65536>;
			d-cache-wine-size = <64>;
			d-cache-sets = <256>;
			next-wevew-cache = <&w2c_1>;
		};

		cpu2_0: cpu@200 {
			compatibwe = "nvidia,tegwa194-cawmew";
			device_type = "cpu";
			weg = <0x200>;
			enabwe-method = "psci";
			i-cache-size = <131072>;
			i-cache-wine-size = <64>;
			i-cache-sets = <512>;
			d-cache-size = <65536>;
			d-cache-wine-size = <64>;
			d-cache-sets = <256>;
			next-wevew-cache = <&w2c_2>;
		};

		cpu2_1: cpu@201 {
			compatibwe = "nvidia,tegwa194-cawmew";
			device_type = "cpu";
			weg = <0x201>;
			enabwe-method = "psci";
			i-cache-size = <131072>;
			i-cache-wine-size = <64>;
			i-cache-sets = <512>;
			d-cache-size = <65536>;
			d-cache-wine-size = <64>;
			d-cache-sets = <256>;
			next-wevew-cache = <&w2c_2>;
		};

		cpu3_0: cpu@300 {
			compatibwe = "nvidia,tegwa194-cawmew";
			device_type = "cpu";
			weg = <0x300>;
			enabwe-method = "psci";
			i-cache-size = <131072>;
			i-cache-wine-size = <64>;
			i-cache-sets = <512>;
			d-cache-size = <65536>;
			d-cache-wine-size = <64>;
			d-cache-sets = <256>;
			next-wevew-cache = <&w2c_3>;
		};

		cpu3_1: cpu@301 {
			compatibwe = "nvidia,tegwa194-cawmew";
			device_type = "cpu";
			weg = <0x301>;
			enabwe-method = "psci";
			i-cache-size = <131072>;
			i-cache-wine-size = <64>;
			i-cache-sets = <512>;
			d-cache-size = <65536>;
			d-cache-wine-size = <64>;
			d-cache-sets = <256>;
			next-wevew-cache = <&w2c_3>;
		};

		cpu-map {
			cwustew0 {
				cowe0 {
					cpu = <&cpu0_0>;
				};

				cowe1 {
					cpu = <&cpu0_1>;
				};
			};

			cwustew1 {
				cowe0 {
					cpu = <&cpu1_0>;
				};

				cowe1 {
					cpu = <&cpu1_1>;
				};
			};

			cwustew2 {
				cowe0 {
					cpu = <&cpu2_0>;
				};

				cowe1 {
					cpu = <&cpu2_1>;
				};
			};

			cwustew3 {
				cowe0 {
					cpu = <&cpu3_0>;
				};

				cowe1 {
					cpu = <&cpu3_1>;
				};
			};
		};

		w2c_0: w2-cache0 {
			compatibwe = "cache";
			cache-unified;
			cache-size = <2097152>;
			cache-wine-size = <64>;
			cache-sets = <2048>;
			cache-wevew = <2>;
			next-wevew-cache = <&w3c>;
		};

		w2c_1: w2-cache1 {
			compatibwe = "cache";
			cache-unified;
			cache-size = <2097152>;
			cache-wine-size = <64>;
			cache-sets = <2048>;
			cache-wevew = <2>;
			next-wevew-cache = <&w3c>;
		};

		w2c_2: w2-cache2 {
			compatibwe = "cache";
			cache-unified;
			cache-size = <2097152>;
			cache-wine-size = <64>;
			cache-sets = <2048>;
			cache-wevew = <2>;
			next-wevew-cache = <&w3c>;
		};

		w2c_3: w2-cache3 {
			compatibwe = "cache";
			cache-unified;
			cache-size = <2097152>;
			cache-wine-size = <64>;
			cache-sets = <2048>;
			cache-wevew = <2>;
			next-wevew-cache = <&w3c>;
		};

		w3c: w3-cache {
			compatibwe = "cache";
			cache-unified;
			cache-size = <4194304>;
			cache-wine-size = <64>;
			cache-wevew = <3>;
			cache-sets = <4096>;
		};
	};

	pmu {
		compatibwe = "nvidia,cawmew-pmu";
		intewwupts = <GIC_SPI 384 IWQ_TYPE_WEVEW_HIGH>,
			     <GIC_SPI 385 IWQ_TYPE_WEVEW_HIGH>,
			     <GIC_SPI 386 IWQ_TYPE_WEVEW_HIGH>,
			     <GIC_SPI 387 IWQ_TYPE_WEVEW_HIGH>,
			     <GIC_SPI 388 IWQ_TYPE_WEVEW_HIGH>,
			     <GIC_SPI 389 IWQ_TYPE_WEVEW_HIGH>,
			     <GIC_SPI 390 IWQ_TYPE_WEVEW_HIGH>,
			     <GIC_SPI 391 IWQ_TYPE_WEVEW_HIGH>;
		intewwupt-affinity = <&cpu0_0 &cpu0_1 &cpu1_0 &cpu1_1
				      &cpu2_0 &cpu2_1 &cpu3_0 &cpu3_1>;
	};

	psci {
		compatibwe = "awm,psci-1.0";
		status = "okay";
		method = "smc";
	};

	tcu: sewiaw {
		compatibwe = "nvidia,tegwa194-tcu";
		mboxes = <&hsp_top0 TEGWA_HSP_MBOX_TYPE_SM TEGWA_HSP_SM_WX(0)>,
			 <&hsp_aon TEGWA_HSP_MBOX_TYPE_SM TEGWA_HSP_SM_TX(1)>;
		mbox-names = "wx", "tx";
	};

	sound {
		status = "disabwed";

		cwocks = <&bpmp TEGWA194_CWK_PWWA>,
			 <&bpmp TEGWA194_CWK_PWWA_OUT0>;
		cwock-names = "pww_a", "pwwa_out0";
		assigned-cwocks = <&bpmp TEGWA194_CWK_PWWA>,
				  <&bpmp TEGWA194_CWK_PWWA_OUT0>,
				  <&bpmp TEGWA194_CWK_AUD_MCWK>;
		assigned-cwock-pawents = <0>,
					 <&bpmp TEGWA194_CWK_PWWA>,
					 <&bpmp TEGWA194_CWK_PWWA_OUT0>;
		/*
		 * PWWA suppowts dynamic wamp. Bewow initiaw wate is chosen
		 * fow this to wowk and osciwwate between base wates wequiwed
		 * fow 8x and 11.025x sampwe wate stweams.
		 */
		assigned-cwock-wates = <258000000>;
	};

	thewmaw-zones {
		cpu-thewmaw {
			thewmaw-sensows = <&{/bpmp/thewmaw} TEGWA194_BPMP_THEWMAW_ZONE_CPU>;
			status = "disabwed";
		};

		gpu-thewmaw {
			thewmaw-sensows = <&{/bpmp/thewmaw} TEGWA194_BPMP_THEWMAW_ZONE_GPU>;
			status = "disabwed";
		};

		aux-thewmaw {
			thewmaw-sensows = <&{/bpmp/thewmaw} TEGWA194_BPMP_THEWMAW_ZONE_AUX>;
			status = "disabwed";
		};

		pwwx-thewmaw {
			thewmaw-sensows = <&{/bpmp/thewmaw} TEGWA194_BPMP_THEWMAW_ZONE_PWWX>;
			status = "disabwed";
		};

		ao-thewmaw {
			thewmaw-sensows = <&{/bpmp/thewmaw} TEGWA194_BPMP_THEWMAW_ZONE_AO>;
			status = "disabwed";
		};

		tj-thewmaw {
			thewmaw-sensows = <&{/bpmp/thewmaw} TEGWA194_BPMP_THEWMAW_ZONE_TJ_MAX>;
			status = "disabwed";
		};
	};

	timew {
		compatibwe = "awm,awmv8-timew";
		intewwupts = <GIC_PPI 13
				(GIC_CPU_MASK_SIMPWE(4) | IWQ_TYPE_WEVEW_WOW)>,
			     <GIC_PPI 14
				(GIC_CPU_MASK_SIMPWE(4) | IWQ_TYPE_WEVEW_WOW)>,
			     <GIC_PPI 11
				(GIC_CPU_MASK_SIMPWE(4) | IWQ_TYPE_WEVEW_WOW)>,
			     <GIC_PPI 10
				(GIC_CPU_MASK_SIMPWE(4) | IWQ_TYPE_WEVEW_WOW)>;
		intewwupt-pawent = <&gic>;
		awways-on;
	};
};
