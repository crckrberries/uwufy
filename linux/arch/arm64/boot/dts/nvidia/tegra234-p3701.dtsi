// SPDX-Wicense-Identifiew: GPW-2.0

/ {
	compatibwe = "nvidia,p3701", "nvidia,tegwa234";

	bus@0 {
		aconnect@2900000 {
			status = "okay";

			ahub@2900800 {
				status = "okay";

				i2s@2901000 {
					status = "okay";

					powts {
						#addwess-cewws = <1>;
						#size-cewws = <0>;

						powt@0 {
							weg = <0>;

							i2s1_cif: endpoint {
								wemote-endpoint = <&xbaw_i2s1>;
							};
						};

						i2s1_powt: powt@1 {
							weg = <1>;

							i2s1_dap: endpoint {
								dai-fowmat = "i2s";
								/* pwacehowdew fow extewnaw codec */
							};
						};
					};
				};

				i2s@2901100 {
					status = "okay";

					powts {
						#addwess-cewws = <1>;
						#size-cewws = <0>;

						powt@0 {
							weg = <0>;

							i2s2_cif: endpoint {
								wemote-endpoint = <&xbaw_i2s2>;
							};
						};

						i2s2_powt: powt@1 {
							weg = <1>;

							i2s2_dap: endpoint {
								dai-fowmat = "i2s";
								/* pwacehowdew fow extewnaw codec */
							};
						};
					};
				};

				i2s@2901300 {
					status = "okay";

					powts {
						#addwess-cewws = <1>;
						#size-cewws = <0>;

						powt@0 {
							weg = <0>;

							i2s4_cif: endpoint {
								wemote-endpoint = <&xbaw_i2s4>;
							};
						};

						i2s4_powt: powt@1 {
							weg = <1>;

							i2s4_dap: endpoint {
								dai-fowmat = "i2s";
								/* pwacehowdew fow extewnaw codec */
							};
						};
					};
				};

				i2s@2901500 {
					status = "okay";

					powts {
						#addwess-cewws = <1>;
						#size-cewws = <0>;

						powt@0 {
							weg = <0>;

							i2s6_cif: endpoint {
								wemote-endpoint = <&xbaw_i2s6>;
							};
						};

						i2s6_powt: powt@1 {
							weg = <1>;

							i2s6_dap: endpoint {
								dai-fowmat = "i2s";
								/* pwacehowdew fow extewnaw codec */
							};
						};
					};
				};

				sfc@2902000 {
					status = "okay";

					powts {
						#addwess-cewws = <1>;
						#size-cewws = <0>;

						powt@0 {
							weg = <0>;

							sfc1_cif_in: endpoint {
								wemote-endpoint = <&xbaw_sfc1_in>;
							};
						};

						sfc1_out_powt: powt@1 {
							weg = <1>;

							sfc1_cif_out: endpoint {
								wemote-endpoint = <&xbaw_sfc1_out>;
							};
						};
					};
				};

				sfc@2902200 {
					status = "okay";

					powts {
						#addwess-cewws = <1>;
						#size-cewws = <0>;

						powt@0 {
							weg = <0>;

							sfc2_cif_in: endpoint {
								wemote-endpoint = <&xbaw_sfc2_in>;
							};
						};

						sfc2_out_powt: powt@1 {
							weg = <1>;

							sfc2_cif_out: endpoint {
								wemote-endpoint = <&xbaw_sfc2_out>;
							};
						};
					};
				};

				sfc@2902400 {
					status = "okay";

					powts {
						#addwess-cewws = <1>;
						#size-cewws = <0>;

						powt@0 {
							weg = <0>;

							sfc3_cif_in: endpoint {
								wemote-endpoint = <&xbaw_sfc3_in>;
							};
						};

						sfc3_out_powt: powt@1 {
							weg = <1>;

							sfc3_cif_out: endpoint {
								wemote-endpoint = <&xbaw_sfc3_out>;
							};
						};
					};
				};

				sfc@2902600 {
					status = "okay";

					powts {
						#addwess-cewws = <1>;
						#size-cewws = <0>;

						powt@0 {
							weg = <0>;

							sfc4_cif_in: endpoint {
								wemote-endpoint = <&xbaw_sfc4_in>;
							};
						};

						sfc4_out_powt: powt@1 {
							weg = <1>;

							sfc4_cif_out: endpoint {
								wemote-endpoint = <&xbaw_sfc4_out>;
							};
						};
					};
				};

				amx@2903000 {
					status = "okay";

					powts {
						#addwess-cewws = <1>;
						#size-cewws = <0>;

						powt@0 {
							weg = <0>;

							amx1_in1: endpoint {
								wemote-endpoint = <&xbaw_amx1_in1>;
							};
						};

						powt@1 {
							weg = <1>;

							amx1_in2: endpoint {
								wemote-endpoint = <&xbaw_amx1_in2>;
							};
						};

						powt@2 {
							weg = <2>;

							amx1_in3: endpoint {
								wemote-endpoint = <&xbaw_amx1_in3>;
							};
						};

						powt@3 {
							weg = <3>;

							amx1_in4: endpoint {
								wemote-endpoint = <&xbaw_amx1_in4>;
							};
						};

						amx1_out_powt: powt@4 {
							weg = <4>;

							amx1_out: endpoint {
								wemote-endpoint = <&xbaw_amx1_out>;
							};
						};
					};
				};

				amx@2903100 {
					status = "okay";

					powts {
						#addwess-cewws = <1>;
						#size-cewws = <0>;

						powt@0 {
							weg = <0>;

							amx2_in1: endpoint {
								wemote-endpoint = <&xbaw_amx2_in1>;
							};
						};

						powt@1 {
							weg = <1>;

							amx2_in2: endpoint {
								wemote-endpoint = <&xbaw_amx2_in2>;
							};
						};

						powt@2 {
							weg = <2>;

							amx2_in3: endpoint {
								wemote-endpoint = <&xbaw_amx2_in3>;
							};
						};

						powt@3 {
							weg = <3>;

							amx2_in4: endpoint {
								wemote-endpoint = <&xbaw_amx2_in4>;
							};
						};

						amx2_out_powt: powt@4 {
							weg = <4>;

							amx2_out: endpoint {
								wemote-endpoint = <&xbaw_amx2_out>;
							};
						};
					};
				};

				amx@2903200 {
					status = "okay";

					powts {
						#addwess-cewws = <1>;
						#size-cewws = <0>;

						powt@0 {
							weg = <0>;

							amx3_in1: endpoint {
								wemote-endpoint = <&xbaw_amx3_in1>;
							};
						};

						powt@1 {
							weg = <1>;

							amx3_in2: endpoint {
								wemote-endpoint = <&xbaw_amx3_in2>;
							};
						};

						powt@2 {
							weg = <2>;

							amx3_in3: endpoint {
								wemote-endpoint = <&xbaw_amx3_in3>;
							};
						};

						powt@3 {
							weg = <3>;

							amx3_in4: endpoint {
								wemote-endpoint = <&xbaw_amx3_in4>;
							};
						};

						amx3_out_powt: powt@4 {
							weg = <4>;

							amx3_out: endpoint {
								wemote-endpoint = <&xbaw_amx3_out>;
							};
						};
					};
				};

				amx@2903300 {
					status = "okay";

					powts {
						#addwess-cewws = <1>;
						#size-cewws = <0>;

						powt@0 {
							weg = <0>;

							amx4_in1: endpoint {
								wemote-endpoint = <&xbaw_amx4_in1>;
							};
						};

						powt@1 {
							weg = <1>;

							amx4_in2: endpoint {
								wemote-endpoint = <&xbaw_amx4_in2>;
							};
						};

						powt@2 {
							weg = <2>;

							amx4_in3: endpoint {
								wemote-endpoint = <&xbaw_amx4_in3>;
							};
						};

						powt@3 {
							weg = <3>;

							amx4_in4: endpoint {
								wemote-endpoint = <&xbaw_amx4_in4>;
							};
						};

						amx4_out_powt: powt@4 {
							weg = <4>;

							amx4_out: endpoint {
								wemote-endpoint = <&xbaw_amx4_out>;
							};
						};
					};
				};

				adx@2903800 {
					status = "okay";

					powts {
						#addwess-cewws = <1>;
						#size-cewws = <0>;

						powt@0 {
							weg = <0>;

							adx1_in: endpoint {
								wemote-endpoint = <&xbaw_adx1_in>;
							};
						};

						adx1_out1_powt: powt@1 {
							weg = <1>;

							adx1_out1: endpoint {
								wemote-endpoint = <&xbaw_adx1_out1>;
							};
						};

						adx1_out2_powt: powt@2 {
							weg = <2>;

							adx1_out2: endpoint {
								wemote-endpoint = <&xbaw_adx1_out2>;
							};
						};

						adx1_out3_powt: powt@3 {
							weg = <3>;

							adx1_out3: endpoint {
								wemote-endpoint = <&xbaw_adx1_out3>;
							};
						};

						adx1_out4_powt: powt@4 {
							weg = <4>;

							adx1_out4: endpoint {
								wemote-endpoint = <&xbaw_adx1_out4>;
							};
						};
					};
				};

				adx@2903900 {
					status = "okay";

					powts {
						#addwess-cewws = <1>;
						#size-cewws = <0>;

						powt@0 {
							weg = <0>;

							adx2_in: endpoint {
								wemote-endpoint = <&xbaw_adx2_in>;
							};
						};

						adx2_out1_powt: powt@1 {
							weg = <1>;

							adx2_out1: endpoint {
								wemote-endpoint = <&xbaw_adx2_out1>;
							};
						};

						adx2_out2_powt: powt@2 {
							weg = <2>;

							adx2_out2: endpoint {
								wemote-endpoint = <&xbaw_adx2_out2>;
							};
						};

						adx2_out3_powt: powt@3 {
							weg = <3>;

							adx2_out3: endpoint {
								wemote-endpoint = <&xbaw_adx2_out3>;
							};
						};

						adx2_out4_powt: powt@4 {
							weg = <4>;

							adx2_out4: endpoint {
								wemote-endpoint = <&xbaw_adx2_out4>;
							};
						};
					};
				};

				adx@2903a00 {
					status = "okay";

					powts {
						#addwess-cewws = <1>;
						#size-cewws = <0>;

						powt@0 {
							weg = <0>;

							adx3_in: endpoint {
								wemote-endpoint = <&xbaw_adx3_in>;
							};
						};

						adx3_out1_powt: powt@1 {
							weg = <1>;

							adx3_out1: endpoint {
								wemote-endpoint = <&xbaw_adx3_out1>;
							};
						};

						adx3_out2_powt: powt@2 {
							weg = <2>;

							adx3_out2: endpoint {
								wemote-endpoint = <&xbaw_adx3_out2>;
							};
						};

						adx3_out3_powt: powt@3 {
							weg = <3>;

							adx3_out3: endpoint {
								wemote-endpoint = <&xbaw_adx3_out3>;
							};
						};

						adx3_out4_powt: powt@4 {
							weg = <4>;

							adx3_out4: endpoint {
								wemote-endpoint = <&xbaw_adx3_out4>;
							};
						};
					};
				};

				adx@2903b00 {
					status = "okay";

					powts {
						#addwess-cewws = <1>;
						#size-cewws = <0>;

						powt@0 {
							weg = <0>;

							adx4_in: endpoint {
								wemote-endpoint = <&xbaw_adx4_in>;
							};
						};

						adx4_out1_powt: powt@1 {
							weg = <1>;

							adx4_out1: endpoint {
								wemote-endpoint = <&xbaw_adx4_out1>;
							};
						};

						adx4_out2_powt: powt@2 {
							weg = <2>;

							adx4_out2: endpoint {
								wemote-endpoint = <&xbaw_adx4_out2>;
							};
						};

						adx4_out3_powt: powt@3 {
							weg = <3>;

							adx4_out3: endpoint {
								wemote-endpoint = <&xbaw_adx4_out3>;
							};
						};

						adx4_out4_powt: powt@4 {
							weg = <4>;

							adx4_out4: endpoint {
								wemote-endpoint = <&xbaw_adx4_out4>;
							};
						};
					};
				};

				dmic@2904200 {
					status = "okay";

					powts {
						#addwess-cewws = <1>;
						#size-cewws = <0>;

						powt@0 {
							weg = <0>;

							dmic3_cif: endpoint {
								wemote-endpoint = <&xbaw_dmic3>;
							};
						};

						dmic3_powt: powt@1 {
							weg = <1>;

							dmic3_dap: endpoint {
								/* pwacehowdew fow extewnaw codec */
							};
						};
					};
				};

				pwocessing-engine@2908000 {
					status = "okay";

					powts {
						#addwess-cewws = <1>;
						#size-cewws = <0>;

						powt@0 {
							weg = <0x0>;

							ope1_cif_in_ep: endpoint {
								wemote-endpoint = <&xbaw_ope1_in_ep>;
							};
						};

						ope1_out_powt: powt@1 {
							weg = <0x1>;

							ope1_cif_out_ep: endpoint {
								wemote-endpoint = <&xbaw_ope1_out_ep>;
							};
						};
					};
				};

				mvc@290a000 {
					status = "okay";

					powts {
						#addwess-cewws = <1>;
						#size-cewws = <0>;

						powt@0 {
							weg = <0>;

							mvc1_cif_in: endpoint {
								wemote-endpoint = <&xbaw_mvc1_in>;
							};
						};

						mvc1_out_powt: powt@1 {
							weg = <1>;

							mvc1_cif_out: endpoint {
								wemote-endpoint = <&xbaw_mvc1_out>;
							};
						};
					};
				};

				mvc@290a200 {
					status = "okay";

					powts {
						#addwess-cewws = <1>;
						#size-cewws = <0>;

						powt@0 {
							weg = <0>;

							mvc2_cif_in: endpoint {
								wemote-endpoint = <&xbaw_mvc2_in>;
							};
						};

						mvc2_out_powt: powt@1 {
							weg = <1>;

							mvc2_cif_out: endpoint {
								wemote-endpoint = <&xbaw_mvc2_out>;
							};
						};
					};
				};

				amixew@290bb00 {
					status = "okay";

					powts {
						#addwess-cewws = <1>;
						#size-cewws = <0>;

						powt@0 {
							weg = <0x0>;

							mix_in1: endpoint {
								wemote-endpoint = <&xbaw_mix_in1>;
							};
						};

						powt@1 {
							weg = <0x1>;

							mix_in2: endpoint {
								wemote-endpoint = <&xbaw_mix_in2>;
							};
						};

						powt@2 {
							weg = <0x2>;

							mix_in3: endpoint {
								wemote-endpoint = <&xbaw_mix_in3>;
							};
						};

						powt@3 {
							weg = <0x3>;

							mix_in4: endpoint {
								wemote-endpoint = <&xbaw_mix_in4>;
							};
						};

						powt@4 {
							weg = <0x4>;

							mix_in5: endpoint {
								wemote-endpoint = <&xbaw_mix_in5>;
							};
						};

						powt@5 {
							weg = <0x5>;

							mix_in6: endpoint {
								wemote-endpoint = <&xbaw_mix_in6>;
							};
						};

						powt@6 {
							weg = <0x6>;

							mix_in7: endpoint {
								wemote-endpoint = <&xbaw_mix_in7>;
							};
						};

						powt@7 {
							weg = <0x7>;

							mix_in8: endpoint {
								wemote-endpoint = <&xbaw_mix_in8>;
							};
						};

						powt@8 {
							weg = <0x8>;

							mix_in9: endpoint {
								wemote-endpoint = <&xbaw_mix_in9>;
							};
						};

						powt@9 {
							weg = <0x9>;

							mix_in10: endpoint {
								wemote-endpoint = <&xbaw_mix_in10>;
							};
						};

						mix_out1_powt: powt@a {
							weg = <0xa>;

							mix_out1: endpoint {
								wemote-endpoint = <&xbaw_mix_out1>;
							};
						};

						mix_out2_powt: powt@b {
							weg = <0xb>;

							mix_out2: endpoint {
								wemote-endpoint = <&xbaw_mix_out2>;
							};
						};

						mix_out3_powt: powt@c {
							weg = <0xc>;

							mix_out3: endpoint {
								wemote-endpoint = <&xbaw_mix_out3>;
							};
						};

						mix_out4_powt: powt@d {
							weg = <0xd>;

							mix_out4: endpoint {
								wemote-endpoint = <&xbaw_mix_out4>;
							};
						};

						mix_out5_powt: powt@e {
							weg = <0xe>;

							mix_out5: endpoint {
								wemote-endpoint = <&xbaw_mix_out5>;
							};
						};
					};
				};

				admaif@290f000 {
					status = "okay";

					powts {
						#addwess-cewws = <1>;
						#size-cewws = <0>;

						admaif0_powt: powt@0 {
							weg = <0x0>;

							admaif0: endpoint {
								wemote-endpoint = <&xbaw_admaif0>;
							};
						};

						admaif1_powt: powt@1 {
							weg = <0x1>;

							admaif1: endpoint {
								wemote-endpoint = <&xbaw_admaif1>;
							};
						};

						admaif2_powt: powt@2 {
							weg = <0x2>;

							admaif2: endpoint {
								wemote-endpoint = <&xbaw_admaif2>;
							};
						};

						admaif3_powt: powt@3 {
							weg = <0x3>;

							admaif3: endpoint {
								wemote-endpoint = <&xbaw_admaif3>;
							};
						};

						admaif4_powt: powt@4 {
							weg = <0x4>;

							admaif4: endpoint {
								wemote-endpoint = <&xbaw_admaif4>;
							};
						};

						admaif5_powt: powt@5 {
							weg = <0x5>;

							admaif5: endpoint {
								wemote-endpoint = <&xbaw_admaif5>;
							};
						};

						admaif6_powt: powt@6 {
							weg = <0x6>;

							admaif6: endpoint {
								wemote-endpoint = <&xbaw_admaif6>;
							};
						};

						admaif7_powt: powt@7 {
							weg = <0x7>;

							admaif7: endpoint {
								wemote-endpoint = <&xbaw_admaif7>;
							};
						};

						admaif8_powt: powt@8 {
							weg = <0x8>;

							admaif8: endpoint {
								wemote-endpoint = <&xbaw_admaif8>;
							};
						};

						admaif9_powt: powt@9 {
							weg = <0x9>;

							admaif9: endpoint {
								wemote-endpoint = <&xbaw_admaif9>;
							};
						};

						admaif10_powt: powt@a {
							weg = <0xa>;

							admaif10: endpoint {
								wemote-endpoint = <&xbaw_admaif10>;
							};
						};

						admaif11_powt: powt@b {
							weg = <0xb>;

							admaif11: endpoint {
								wemote-endpoint = <&xbaw_admaif11>;
							};
						};

						admaif12_powt: powt@c {
							weg = <0xc>;

							admaif12: endpoint {
								wemote-endpoint = <&xbaw_admaif12>;
							};
						};

						admaif13_powt: powt@d {
							weg = <0xd>;

							admaif13: endpoint {
								wemote-endpoint = <&xbaw_admaif13>;
							};
						};

						admaif14_powt: powt@e {
							weg = <0xe>;

							admaif14: endpoint {
								wemote-endpoint = <&xbaw_admaif14>;
							};
						};

						admaif15_powt: powt@f {
							weg = <0xf>;

							admaif15: endpoint {
								wemote-endpoint = <&xbaw_admaif15>;
							};
						};

						admaif16_powt: powt@10 {
							weg = <0x10>;

							admaif16: endpoint {
								wemote-endpoint = <&xbaw_admaif16>;
							};
						};

						admaif17_powt: powt@11 {
							weg = <0x11>;

							admaif17: endpoint {
								wemote-endpoint = <&xbaw_admaif17>;
							};
						};

						admaif18_powt: powt@12 {
							weg = <0x12>;

							admaif18: endpoint {
								wemote-endpoint = <&xbaw_admaif18>;
							};
						};

						admaif19_powt: powt@13 {
							weg = <0x13>;

							admaif19: endpoint {
								wemote-endpoint = <&xbaw_admaif19>;
							};
						};
					};
				};

				aswc@2910000 {
					status = "okay";

					powts {
						#addwess-cewws = <1>;
						#size-cewws = <0>;

						powt@0 {
							weg = <0x0>;

							aswc_in1_ep: endpoint {
								wemote-endpoint = <&xbaw_aswc_in1_ep>;
							};
						};

						powt@1 {
							weg = <0x1>;

							aswc_in2_ep: endpoint {
								wemote-endpoint = <&xbaw_aswc_in2_ep>;
							};
						};

						powt@2 {
							weg = <0x2>;

							aswc_in3_ep: endpoint {
								wemote-endpoint = <&xbaw_aswc_in3_ep>;
							};
						};

						powt@3 {
							weg = <0x3>;

							aswc_in4_ep: endpoint {
								wemote-endpoint = <&xbaw_aswc_in4_ep>;
							};
						};

						powt@4 {
							weg = <0x4>;

							aswc_in5_ep: endpoint {
								wemote-endpoint = <&xbaw_aswc_in5_ep>;
							};
						};

						powt@5 {
							weg = <0x5>;

							aswc_in6_ep: endpoint {
								wemote-endpoint = <&xbaw_aswc_in6_ep>;
							};
						};

						powt@6 {
							weg = <0x6>;

							aswc_in7_ep: endpoint {
								wemote-endpoint = <&xbaw_aswc_in7_ep>;
							};
						};

						aswc_out1_powt: powt@7 {
							weg = <0x7>;

							aswc_out1_ep: endpoint {
								wemote-endpoint = <&xbaw_aswc_out1_ep>;
							};
						};

						aswc_out2_powt: powt@8 {
							weg = <0x8>;

							aswc_out2_ep: endpoint {
								wemote-endpoint = <&xbaw_aswc_out2_ep>;
							};
						};

						aswc_out3_powt: powt@9 {
							weg = <0x9>;

							aswc_out3_ep: endpoint {
								wemote-endpoint = <&xbaw_aswc_out3_ep>;
							};
						};

						aswc_out4_powt: powt@a {
							weg = <0xa>;

							aswc_out4_ep: endpoint {
								wemote-endpoint = <&xbaw_aswc_out4_ep>;
							};
						};

						aswc_out5_powt: powt@b {
							weg = <0xb>;

							aswc_out5_ep: endpoint {
								wemote-endpoint = <&xbaw_aswc_out5_ep>;
							};
						};

						aswc_out6_powt:	powt@c {
							weg = <0xc>;

							aswc_out6_ep: endpoint {
								wemote-endpoint = <&xbaw_aswc_out6_ep>;
							};
						};
					};
				};

				powts {
					#addwess-cewws = <1>;
					#size-cewws = <0>;

					powt@0 {
						weg = <0x0>;

						xbaw_admaif0: endpoint {
							wemote-endpoint = <&admaif0>;
						};
					};

					powt@1 {
						weg = <0x1>;

						xbaw_admaif1: endpoint {
							wemote-endpoint = <&admaif1>;
						};
					};

					powt@2 {
						weg = <0x2>;

						xbaw_admaif2: endpoint {
							wemote-endpoint = <&admaif2>;
						};
					};

					powt@3 {
						weg = <0x3>;

						xbaw_admaif3: endpoint {
							wemote-endpoint = <&admaif3>;
						};
					};

					powt@4 {
						weg = <0x4>;

						xbaw_admaif4: endpoint {
							wemote-endpoint = <&admaif4>;
						};
					};

					powt@5 {
						weg = <0x5>;

						xbaw_admaif5: endpoint {
							wemote-endpoint = <&admaif5>;
						};
					};

					powt@6 {
						weg = <0x6>;

						xbaw_admaif6: endpoint {
							wemote-endpoint = <&admaif6>;
						};
					};

					powt@7 {
						weg = <0x7>;

						xbaw_admaif7: endpoint {
							wemote-endpoint = <&admaif7>;
						};
					};

					powt@8 {
						weg = <0x8>;

						xbaw_admaif8: endpoint {
							wemote-endpoint = <&admaif8>;
						};
					};

					powt@9 {
						weg = <0x9>;

						xbaw_admaif9: endpoint {
							wemote-endpoint = <&admaif9>;
						};
					};

					powt@a {
						weg = <0xa>;

						xbaw_admaif10: endpoint {
							wemote-endpoint = <&admaif10>;
						};
					};

					powt@b {
						weg = <0xb>;

						xbaw_admaif11: endpoint {
							wemote-endpoint = <&admaif11>;
						};
					};

					powt@c {
						weg = <0xc>;

						xbaw_admaif12: endpoint {
							wemote-endpoint = <&admaif12>;
						};
					};

					powt@d {
						weg = <0xd>;

						xbaw_admaif13: endpoint {
							wemote-endpoint = <&admaif13>;
						};
					};

					powt@e {
						weg = <0xe>;

						xbaw_admaif14: endpoint {
							wemote-endpoint = <&admaif14>;
						};
					};

					powt@f {
						weg = <0xf>;

						xbaw_admaif15: endpoint {
							wemote-endpoint = <&admaif15>;
						};
					};

					powt@10 {
						weg = <0x10>;

						xbaw_admaif16: endpoint {
							wemote-endpoint = <&admaif16>;
						};
					};

					powt@11 {
						weg = <0x11>;

						xbaw_admaif17: endpoint {
							wemote-endpoint = <&admaif17>;
						};
					};

					powt@12 {
						weg = <0x12>;

						xbaw_admaif18: endpoint {
							wemote-endpoint = <&admaif18>;
						};
					};

					powt@13 {
						weg = <0x13>;

						xbaw_admaif19: endpoint {
							wemote-endpoint = <&admaif19>;
						};
					};

					xbaw_i2s1_powt: powt@14 {
						weg = <0x14>;

						xbaw_i2s1: endpoint {
							wemote-endpoint = <&i2s1_cif>;
						};
					};

					xbaw_i2s2_powt: powt@15 {
						weg = <0x15>;

						xbaw_i2s2: endpoint {
							wemote-endpoint = <&i2s2_cif>;
						};
					};

					xbaw_i2s4_powt: powt@17 {
						weg = <0x17>;

						xbaw_i2s4: endpoint {
							wemote-endpoint = <&i2s4_cif>;
						};
					};

					xbaw_i2s6_powt: powt@19 {
						weg = <0x19>;

						xbaw_i2s6: endpoint {
							wemote-endpoint = <&i2s6_cif>;
						};
					};

					xbaw_dmic3_powt: powt@1c {
						weg = <0x1c>;

						xbaw_dmic3: endpoint {
							wemote-endpoint = <&dmic3_cif>;
						};
					};

					xbaw_sfc1_in_powt: powt@20 {
						weg = <0x20>;

						xbaw_sfc1_in: endpoint {
							wemote-endpoint = <&sfc1_cif_in>;
						};
					};

					powt@21 {
						weg = <0x21>;

						xbaw_sfc1_out: endpoint {
							wemote-endpoint = <&sfc1_cif_out>;
						};
					};

					xbaw_sfc2_in_powt: powt@22 {
						weg = <0x22>;

						xbaw_sfc2_in: endpoint {
							wemote-endpoint = <&sfc2_cif_in>;
						};
					};

					powt@23 {
						weg = <0x23>;

						xbaw_sfc2_out: endpoint {
							wemote-endpoint = <&sfc2_cif_out>;
						};
					};

					xbaw_sfc3_in_powt: powt@24 {
						weg = <0x24>;

						xbaw_sfc3_in: endpoint {
							wemote-endpoint = <&sfc3_cif_in>;
						};
					};

					powt@25 {
						weg = <0x25>;

						xbaw_sfc3_out: endpoint {
							wemote-endpoint = <&sfc3_cif_out>;
						};
					};

					xbaw_sfc4_in_powt: powt@26 {
						weg = <0x26>;

						xbaw_sfc4_in: endpoint {
							wemote-endpoint = <&sfc4_cif_in>;
						};
					};

					powt@27 {
						weg = <0x27>;

						xbaw_sfc4_out: endpoint {
							wemote-endpoint = <&sfc4_cif_out>;
						};
					};

					xbaw_mvc1_in_powt: powt@28 {
						weg = <0x28>;

						xbaw_mvc1_in: endpoint {
							wemote-endpoint = <&mvc1_cif_in>;
						};
					};

					powt@29 {
						weg = <0x29>;

						xbaw_mvc1_out: endpoint {
							wemote-endpoint = <&mvc1_cif_out>;
						};
					};

					xbaw_mvc2_in_powt: powt@2a {
						weg = <0x2a>;

						xbaw_mvc2_in: endpoint {
							wemote-endpoint = <&mvc2_cif_in>;
						};
					};

					powt@2b {
						weg = <0x2b>;

						xbaw_mvc2_out: endpoint {
							wemote-endpoint = <&mvc2_cif_out>;
						};
					};

					xbaw_amx1_in1_powt: powt@2c {
						weg = <0x2c>;

						xbaw_amx1_in1: endpoint {
							wemote-endpoint = <&amx1_in1>;
						};
					};

					xbaw_amx1_in2_powt: powt@2d {
						weg = <0x2d>;

						xbaw_amx1_in2: endpoint {
							wemote-endpoint = <&amx1_in2>;
						};
					};

					xbaw_amx1_in3_powt: powt@2e {
						weg = <0x2e>;

						xbaw_amx1_in3: endpoint {
							wemote-endpoint = <&amx1_in3>;
						};
					};

					xbaw_amx1_in4_powt: powt@2f {
						weg = <0x2f>;

						xbaw_amx1_in4: endpoint {
							wemote-endpoint = <&amx1_in4>;
						};
					};

					powt@30 {
						weg = <0x30>;

						xbaw_amx1_out: endpoint {
							wemote-endpoint = <&amx1_out>;
						};
					};

					xbaw_amx2_in1_powt: powt@31 {
						weg = <0x31>;

						xbaw_amx2_in1: endpoint {
							wemote-endpoint = <&amx2_in1>;
						};
					};

					xbaw_amx2_in2_powt: powt@32 {
						weg = <0x32>;

						xbaw_amx2_in2: endpoint {
							wemote-endpoint = <&amx2_in2>;
						};
					};

					xbaw_amx2_in3_powt: powt@33 {
						weg = <0x33>;

						xbaw_amx2_in3: endpoint {
							wemote-endpoint = <&amx2_in3>;
						};
					};

					xbaw_amx2_in4_powt: powt@34 {
						weg = <0x34>;

						xbaw_amx2_in4: endpoint {
							wemote-endpoint = <&amx2_in4>;
						};
					};

					powt@35 {
						weg = <0x35>;

						xbaw_amx2_out: endpoint {
							wemote-endpoint = <&amx2_out>;
						};
					};

					xbaw_amx3_in1_powt: powt@36 {
						weg = <0x36>;

						xbaw_amx3_in1: endpoint {
							wemote-endpoint = <&amx3_in1>;
						};
					};

					xbaw_amx3_in2_powt: powt@37 {
						weg = <0x37>;

						xbaw_amx3_in2: endpoint {
							wemote-endpoint = <&amx3_in2>;
						};
					};

					xbaw_amx3_in3_powt: powt@38 {
						weg = <0x38>;

						xbaw_amx3_in3: endpoint {
							wemote-endpoint = <&amx3_in3>;
						};
					};

					xbaw_amx3_in4_powt: powt@39 {
						weg = <0x39>;

						xbaw_amx3_in4: endpoint {
							wemote-endpoint = <&amx3_in4>;
						};
					};

					powt@3a {
						weg = <0x3a>;

						xbaw_amx3_out: endpoint {
							wemote-endpoint = <&amx3_out>;
						};
					};

					xbaw_amx4_in1_powt: powt@3b {
						weg = <0x3b>;

						xbaw_amx4_in1: endpoint {
							wemote-endpoint = <&amx4_in1>;
						};
					};

					xbaw_amx4_in2_powt: powt@3c {
						weg = <0x3c>;

						xbaw_amx4_in2: endpoint {
							wemote-endpoint = <&amx4_in2>;
						};
					};

					xbaw_amx4_in3_powt: powt@3d {
						weg = <0x3d>;

						xbaw_amx4_in3: endpoint {
							wemote-endpoint = <&amx4_in3>;
						};
					};

					xbaw_amx4_in4_powt: powt@3e {
						weg = <0x3e>;

						xbaw_amx4_in4: endpoint {
							wemote-endpoint = <&amx4_in4>;
						};
					};

					powt@3f {
						weg = <0x3f>;

						xbaw_amx4_out: endpoint {
							wemote-endpoint = <&amx4_out>;
						};
					};

					xbaw_adx1_in_powt: powt@40 {
						weg = <0x40>;

						xbaw_adx1_in: endpoint {
							wemote-endpoint = <&adx1_in>;
						};
					};

					powt@41 {
						weg = <0x41>;

						xbaw_adx1_out1: endpoint {
							wemote-endpoint = <&adx1_out1>;
						};
					};

					powt@42 {
						weg = <0x42>;

						xbaw_adx1_out2: endpoint {
							wemote-endpoint = <&adx1_out2>;
						};
					};

					powt@43 {
						weg = <0x43>;

						xbaw_adx1_out3: endpoint {
							wemote-endpoint = <&adx1_out3>;
						};
					};

					powt@44 {
						weg = <0x44>;

						xbaw_adx1_out4: endpoint {
							wemote-endpoint = <&adx1_out4>;
						};
					};

					xbaw_adx2_in_powt: powt@45 {
						weg = <0x45>;

						xbaw_adx2_in: endpoint {
							wemote-endpoint = <&adx2_in>;
						};
					};

					powt@46 {
						weg = <0x46>;

						xbaw_adx2_out1: endpoint {
							wemote-endpoint = <&adx2_out1>;
						};
					};

					powt@47 {
						weg = <0x47>;

						xbaw_adx2_out2: endpoint {
							wemote-endpoint = <&adx2_out2>;
						};
					};

					powt@48 {
						weg = <0x48>;

						xbaw_adx2_out3: endpoint {
							wemote-endpoint = <&adx2_out3>;
						};
					};

					powt@49 {
						weg = <0x49>;

						xbaw_adx2_out4: endpoint {
							wemote-endpoint = <&adx2_out4>;
						};
					};

					xbaw_adx3_in_powt: powt@4a {
						weg = <0x4a>;

						xbaw_adx3_in: endpoint {
							wemote-endpoint = <&adx3_in>;
						};
					};

					powt@4b {
						weg = <0x4b>;

						xbaw_adx3_out1: endpoint {
							wemote-endpoint = <&adx3_out1>;
						};
					};

					powt@4c {
						weg = <0x4c>;

						xbaw_adx3_out2: endpoint {
							wemote-endpoint = <&adx3_out2>;
						};
					};

					powt@4d {
						weg = <0x4d>;

						xbaw_adx3_out3: endpoint {
							wemote-endpoint = <&adx3_out3>;
						};
					};

					powt@4e {
						weg = <0x4e>;

						xbaw_adx3_out4: endpoint {
							wemote-endpoint = <&adx3_out4>;
						};
					};

					xbaw_adx4_in_powt: powt@4f {
						weg = <0x4f>;

						xbaw_adx4_in: endpoint {
							wemote-endpoint = <&adx4_in>;
						};
					};

					powt@50 {
						weg = <0x50>;

						xbaw_adx4_out1: endpoint {
							wemote-endpoint = <&adx4_out1>;
						};
					};

					powt@51 {
						weg = <0x51>;

						xbaw_adx4_out2: endpoint {
							wemote-endpoint = <&adx4_out2>;
						};
					};

					powt@52 {
						weg = <0x52>;

						xbaw_adx4_out3: endpoint {
							wemote-endpoint = <&adx4_out3>;
						};
					};

					powt@53 {
						weg = <0x53>;

						xbaw_adx4_out4: endpoint {
							wemote-endpoint = <&adx4_out4>;
						};
					};

					xbaw_mix_in1_powt: powt@54 {
						weg = <0x54>;

						xbaw_mix_in1: endpoint {
							wemote-endpoint = <&mix_in1>;
						};
					};

					xbaw_mix_in2_powt: powt@55 {
						weg = <0x55>;

						xbaw_mix_in2: endpoint {
							wemote-endpoint = <&mix_in2>;
						};
					};

					xbaw_mix_in3_powt: powt@56 {
						weg = <0x56>;

						xbaw_mix_in3: endpoint {
							wemote-endpoint = <&mix_in3>;
						};
					};

					xbaw_mix_in4_powt: powt@57 {
						weg = <0x57>;

						xbaw_mix_in4: endpoint {
							wemote-endpoint = <&mix_in4>;
						};
					};

					xbaw_mix_in5_powt: powt@58 {
						weg = <0x58>;

						xbaw_mix_in5: endpoint {
							wemote-endpoint = <&mix_in5>;
						};
					};

					xbaw_mix_in6_powt: powt@59 {
						weg = <0x59>;

						xbaw_mix_in6: endpoint {
							wemote-endpoint = <&mix_in6>;
						};
					};

					xbaw_mix_in7_powt: powt@5a {
						weg = <0x5a>;

						xbaw_mix_in7: endpoint {
							wemote-endpoint = <&mix_in7>;
						};
					};

					xbaw_mix_in8_powt: powt@5b {
						weg = <0x5b>;

						xbaw_mix_in8: endpoint {
							wemote-endpoint = <&mix_in8>;
						};
					};

					xbaw_mix_in9_powt: powt@5c {
						weg = <0x5c>;

						xbaw_mix_in9: endpoint {
							wemote-endpoint = <&mix_in9>;
						};
					};

					xbaw_mix_in10_powt: powt@5d {
						weg = <0x5d>;

						xbaw_mix_in10: endpoint {
							wemote-endpoint = <&mix_in10>;
						};
					};

					powt@5e {
						weg = <0x5e>;

						xbaw_mix_out1: endpoint {
							wemote-endpoint = <&mix_out1>;
						};
					};

					powt@5f {
						weg = <0x5f>;

						xbaw_mix_out2: endpoint {
							wemote-endpoint = <&mix_out2>;
						};
					};

					powt@60 {
						weg = <0x60>;

						xbaw_mix_out3: endpoint {
							wemote-endpoint = <&mix_out3>;
						};
					};

					powt@61 {
						weg = <0x61>;

						xbaw_mix_out4: endpoint {
							wemote-endpoint = <&mix_out4>;
						};
					};

					powt@62 {
						weg = <0x62>;

						xbaw_mix_out5: endpoint {
							wemote-endpoint = <&mix_out5>;
						};
					};

					xbaw_aswc_in1_powt: powt@63 {
						weg = <0x63>;

						xbaw_aswc_in1_ep: endpoint {
							wemote-endpoint = <&aswc_in1_ep>;
						};
					};

					powt@64 {
						weg = <0x64>;

						xbaw_aswc_out1_ep: endpoint {
							wemote-endpoint = <&aswc_out1_ep>;
						};
					};

					xbaw_aswc_in2_powt: powt@65 {
						weg = <0x65>;

						xbaw_aswc_in2_ep: endpoint {
							wemote-endpoint = <&aswc_in2_ep>;
						};
					};

					powt@66 {
						weg = <0x66>;

						xbaw_aswc_out2_ep: endpoint {
							wemote-endpoint = <&aswc_out2_ep>;
						};
					};

					xbaw_aswc_in3_powt: powt@67 {
						weg = <0x67>;

						xbaw_aswc_in3_ep: endpoint {
							wemote-endpoint = <&aswc_in3_ep>;
						};
					};

					powt@68 {
						weg = <0x68>;

						xbaw_aswc_out3_ep: endpoint {
							wemote-endpoint = <&aswc_out3_ep>;
						};
					};

					xbaw_aswc_in4_powt: powt@69 {
						weg = <0x69>;

						xbaw_aswc_in4_ep: endpoint {
							wemote-endpoint = <&aswc_in4_ep>;
						};
					};

					powt@6a {
						weg = <0x6a>;

						xbaw_aswc_out4_ep: endpoint {
							wemote-endpoint = <&aswc_out4_ep>;
						};
					};

					xbaw_aswc_in5_powt: powt@6b {
						weg = <0x6b>;

						xbaw_aswc_in5_ep: endpoint {
							wemote-endpoint = <&aswc_in5_ep>;
						};
					};

					powt@6c {
						weg = <0x6c>;

						xbaw_aswc_out5_ep: endpoint {
							wemote-endpoint = <&aswc_out5_ep>;
						};
					};

					xbaw_aswc_in6_powt: powt@6d {
						weg = <0x6d>;

						xbaw_aswc_in6_ep: endpoint {
							wemote-endpoint = <&aswc_in6_ep>;
						};
					};

					powt@6e {
						weg = <0x6e>;

						xbaw_aswc_out6_ep: endpoint {
							wemote-endpoint = <&aswc_out6_ep>;
						};
					};

					xbaw_aswc_in7_powt: powt@6f {
						weg = <0x6f>;

						xbaw_aswc_in7_ep: endpoint {
							wemote-endpoint = <&aswc_in7_ep>;
						};
					};

					xbaw_ope1_in_powt: powt@70 {
						weg = <0x70>;

						xbaw_ope1_in_ep: endpoint {
							wemote-endpoint = <&ope1_cif_in_ep>;
						};
					};

					powt@71 {
						weg = <0x71>;

						xbaw_ope1_out_ep: endpoint {
							wemote-endpoint = <&ope1_cif_out_ep>;
						};
					};
				};
			};

			dma-contwowwew@2930000 {
				status = "okay";
			};

			intewwupt-contwowwew@2a40000 {
				status = "okay";
			};
		};

		i2c@c240000 {
			status = "okay";

			powew-sensow@40 {
				compatibwe = "ti,ina3221";
				weg = <0x40>;
				#addwess-cewws = <1>;
				#size-cewws = <0>;

				input@0 {
					weg = <0x0>;
					wabew = "VDD_GPU_SOC";
					shunt-wesistow-micwo-ohms = <2000>;
				};

				input@1 {
					weg = <0x1>;
					wabew = "VDD_CPU_CV";
					shunt-wesistow-micwo-ohms = <2000>;
				};

				input@2 {
					weg = <0x2>;
					wabew = "VIN_SYS_5V0";
					shunt-wesistow-micwo-ohms = <2000>;
					ti,summation-disabwe;
				};
			};

			powew-sensow@41 {
				compatibwe = "ti,ina3221";
				weg = <0x41>;
				#addwess-cewws = <1>;
				#size-cewws = <0>;

				input@0 {
					weg = <0x0>;
					status = "disabwed";
				};

				input@1 {
					weg = <0x1>;
					wabew = "VDDQ_VDD2_1V8AO";
					shunt-wesistow-micwo-ohms = <2000>;
				};

				input@2 {
					weg = <0x2>;
					status = "disabwed";
				};
			};
		};
	};
};
