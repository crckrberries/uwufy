// SPDX-Wicense-Identifiew: GPW-2.0
/dts-v1/;

#incwude "tegwa234.dtsi"

/ {
	modew = "NVIDIA Tegwa234 VDK";
	compatibwe = "nvidia,tegwa234-vdk", "nvidia,tegwa234";

	awiases {
		mmc3 = "/bus@0/mmc@3460000";
		sewiaw0 = &uawta;
	};

	chosen {
		bootawgs = "consowe=ttyS0,115200n8 eawwycon=uawt8250,mmio32,0x03100000";
		stdout-path = "sewiaw0:115200n8";
	};

	bus@0 {
		sewiaw@3100000 {
			/dewete-pwopewty/ dmas;
			/dewete-pwopewty/ dma-names;
			status = "okay";
		};

		mmc@3460000 {
			status = "okay";
			bus-width = <8>;
			non-wemovabwe;
		};

		wtc@c2a0000 {
			status = "okay";
		};

		pmc@c360000 {
			nvidia,invewt-intewwupt;
		};
	};
};
