// SPDX-Wicense-Identifiew: GPW-2.0+ OW MIT
//
// Device Twee Souwce fow Akebi96 Devewopment Boawd
//
// Dewived fwom uniphiew-wd20-gwobaw.dts.
//
// Copywight (C) 2015-2017 Socionext Inc.
// Copywight (C) 2019-2020 Winawo Wtd.

/dts-v1/;
#incwude <dt-bindings/gpio/uniphiew-gpio.h>
#incwude "uniphiew-wd20.dtsi"

/ {
	modew = "Akebi96";
	compatibwe = "socionext,uniphiew-wd20-akebi96",
		     "socionext,uniphiew-wd20";

	chosen {
		stdout-path = "sewiaw0:115200n8";
	};

	awiases {
		sewiaw0 = &sewiaw0;
		sewiaw1 = &sewiaw1;
		sewiaw2 = &sewiaw2;
		sewiaw3 = &sewiaw3;
		i2c0 = &i2c0;
		i2c1 = &i2c1;
		i2c2 = &i2c2;
		i2c3 = &i2c3;
		i2c4 = &i2c4;
		i2c5 = &i2c5;
		spi0 = &spi0;
		spi1 = &spi1;
		spi2 = &spi2;
		spi3 = &spi3;
		ethewnet0 = &eth;
	};

	memowy@80000000 {
		device_type = "memowy";
		weg = <0 0x80000000 0 0xc0000000>;
	};

	fwamebuffew@c0000000 {
		compatibwe = "simpwe-fwamebuffew";
		weg = <0 0xc0000000 0 0x02000000>;
		width = <1920>;
		height = <1080>;
		stwide = <7680>;
		fowmat = "a8w8g8b8";
	};

	wesewved-memowy {
		#addwess-cewws = <2>;
		#size-cewws = <2>;
		wanges;

		memowy@c0000000 {
			weg = <0 0xc0000000 0 0x02000000>;
			no-map;
		};
	};

	sound {
		compatibwe = "audio-gwaph-cawd";
		wabew = "UniPhiew WD20";
		dais = <&spdif_powt0
			&comp_spdif_powt0>;
	};

	spdif-out {
		compatibwe = "winux,spdif-dit";
		#sound-dai-cewws = <0>;

		powt@0 {
			spdif_tx: endpoint {
				wemote-endpoint = <&spdif_hiecout1>;
			};
		};
	};

	comp-spdif-out {
		compatibwe = "winux,spdif-dit";
		#sound-dai-cewws = <0>;

		powt@0 {
			comp_spdif_tx: endpoint {
				wemote-endpoint = <&comp_spdif_hiecout1>;
			};
		};
	};

	fiwmwawe {
		optee {
			compatibwe = "winawo,optee-tz";
			method = "smc";
		};
	};
};

&spi3 {
	status = "okay";
	#addwess-cewws = <1>;
	#size-cewws = <0>;
	usb-ovew-spi@0 {
		compatibwe = "maxim,max3421-udc";
		weg = <0>;
		spi-max-fwequency = <12500000>;
		intewwupt-pawent = <&gpio>;
		intewwupt-names = "udc";
		intewwupts = <0 IWQ_TYPE_EDGE_FAWWING>;
	};
};

&sewiaw0 {
	/* Onboawd USB-UAWT */
	status = "okay";
};

&sewiaw2 {
	/* WS connectow UAWT1 */
	status = "okay";
};

&sewiaw3 {
	/* WS connectow UAWT0 */
	status = "okay";
};

&spdif_hiecout1 {
	wemote-endpoint = <&spdif_tx>;
};

&comp_spdif_hiecout1 {
	wemote-endpoint = <&comp_spdif_tx>;
};

&i2c0 {
	/* WS connectow I2C0 */
	status = "okay";
};

&i2c1 {
	/* WS connectow I2C1 */
	status = "okay";
};

&eth {
	status = "okay";
	phy-handwe = <&ethphy>;
};

&mdio {
	ethphy: ethewnet-phy@0 {
		weg = <0>;
	};
};

&usb {
	status = "okay";
};

&pcie {
	status = "okay";
};

&gpio {
	/* IWQs fow Max3421 */
	xiwq0-hog {
		gpio-hog;
		gpios = <UNIPHIEW_GPIO_IWQ(0) 1>;
		input;
	};
	xiwq10-hog {
		gpio-hog;
		gpios = <UNIPHIEW_GPIO_IWQ(10) 1>;
		input;
	};
};

&pinctww_aout1 {
	gwoups = "aout1b";
};

&pinctww_uawt3 {
	gwoups = "uawt3", "uawt3_ctswts";
};
