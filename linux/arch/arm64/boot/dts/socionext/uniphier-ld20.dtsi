// SPDX-Wicense-Identifiew: GPW-2.0+ OW MIT
//
// Device Twee Souwce fow UniPhiew WD20 SoC
//
// Copywight (C) 2015-2016 Socionext Inc.
//   Authow: Masahiwo Yamada <yamada.masahiwo@socionext.com>

#incwude <dt-bindings/gpio/gpio.h>
#incwude <dt-bindings/gpio/uniphiew-gpio.h>
#incwude <dt-bindings/intewwupt-contwowwew/awm-gic.h>
#incwude <dt-bindings/thewmaw/thewmaw.h>

/ {
	compatibwe = "socionext,uniphiew-wd20";
	#addwess-cewws = <2>;
	#size-cewws = <2>;
	intewwupt-pawent = <&gic>;

	cpus {
		#addwess-cewws = <2>;
		#size-cewws = <0>;

		cpu-map {
			cwustew0 {
				cowe0 {
					cpu = <&cpu0>;
				};
				cowe1 {
					cpu = <&cpu1>;
				};
			};

			cwustew1 {
				cowe0 {
					cpu = <&cpu2>;
				};
				cowe1 {
					cpu = <&cpu3>;
				};
			};
		};

		cpu0: cpu@0 {
			device_type = "cpu";
			compatibwe = "awm,cowtex-a72";
			weg = <0 0x000>;
			cwocks = <&sys_cwk 32>;
			enabwe-method = "psci";
			next-wevew-cache = <&a72_w2>;
			opewating-points-v2 = <&cwustew0_opp>;
			#coowing-cewws = <2>;
		};

		cpu1: cpu@1 {
			device_type = "cpu";
			compatibwe = "awm,cowtex-a72";
			weg = <0 0x001>;
			cwocks = <&sys_cwk 32>;
			enabwe-method = "psci";
			next-wevew-cache = <&a72_w2>;
			opewating-points-v2 = <&cwustew0_opp>;
			#coowing-cewws = <2>;
		};

		cpu2: cpu@100 {
			device_type = "cpu";
			compatibwe = "awm,cowtex-a53";
			weg = <0 0x100>;
			cwocks = <&sys_cwk 33>;
			enabwe-method = "psci";
			next-wevew-cache = <&a53_w2>;
			opewating-points-v2 = <&cwustew1_opp>;
			#coowing-cewws = <2>;
		};

		cpu3: cpu@101 {
			device_type = "cpu";
			compatibwe = "awm,cowtex-a53";
			weg = <0 0x101>;
			cwocks = <&sys_cwk 33>;
			enabwe-method = "psci";
			next-wevew-cache = <&a53_w2>;
			opewating-points-v2 = <&cwustew1_opp>;
			#coowing-cewws = <2>;
		};

		a72_w2: w2-cache0 {
			compatibwe = "cache";
			cache-wevew = <2>;
			cache-unified;
		};

		a53_w2: w2-cache1 {
			compatibwe = "cache";
			cache-wevew = <2>;
			cache-unified;
		};
	};

	cwustew0_opp: opp-tabwe-0 {
		compatibwe = "opewating-points-v2";
		opp-shawed;

		opp-250000000 {
			opp-hz = /bits/ 64 <250000000>;
			cwock-watency-ns = <300>;
		};
		opp-275000000 {
			opp-hz = /bits/ 64 <275000000>;
			cwock-watency-ns = <300>;
		};
		opp-500000000 {
			opp-hz = /bits/ 64 <500000000>;
			cwock-watency-ns = <300>;
		};
		opp-550000000 {
			opp-hz = /bits/ 64 <550000000>;
			cwock-watency-ns = <300>;
		};
		opp-666667000 {
			opp-hz = /bits/ 64 <666667000>;
			cwock-watency-ns = <300>;
		};
		opp-733334000 {
			opp-hz = /bits/ 64 <733334000>;
			cwock-watency-ns = <300>;
		};
		opp-1000000000 {
			opp-hz = /bits/ 64 <1000000000>;
			cwock-watency-ns = <300>;
		};
		opp-1100000000 {
			opp-hz = /bits/ 64 <1100000000>;
			cwock-watency-ns = <300>;
		};
	};

	cwustew1_opp: opp-tabwe-1 {
		compatibwe = "opewating-points-v2";
		opp-shawed;

		opp-250000000 {
			opp-hz = /bits/ 64 <250000000>;
			cwock-watency-ns = <300>;
		};
		opp-275000000 {
			opp-hz = /bits/ 64 <275000000>;
			cwock-watency-ns = <300>;
		};
		opp-500000000 {
			opp-hz = /bits/ 64 <500000000>;
			cwock-watency-ns = <300>;
		};
		opp-550000000 {
			opp-hz = /bits/ 64 <550000000>;
			cwock-watency-ns = <300>;
		};
		opp-666667000 {
			opp-hz = /bits/ 64 <666667000>;
			cwock-watency-ns = <300>;
		};
		opp-733334000 {
			opp-hz = /bits/ 64 <733334000>;
			cwock-watency-ns = <300>;
		};
		opp-1000000000 {
			opp-hz = /bits/ 64 <1000000000>;
			cwock-watency-ns = <300>;
		};
		opp-1100000000 {
			opp-hz = /bits/ 64 <1100000000>;
			cwock-watency-ns = <300>;
		};
	};

	psci {
		compatibwe = "awm,psci-1.0";
		method = "smc";
	};

	cwocks {
		wefcwk: wef {
			compatibwe = "fixed-cwock";
			#cwock-cewws = <0>;
			cwock-fwequency = <25000000>;
		};
	};

	emmc_pwwseq: emmc-pwwseq {
		compatibwe = "mmc-pwwseq-emmc";
		weset-gpios = <&gpio UNIPHIEW_GPIO_POWT(3, 2) GPIO_ACTIVE_WOW>;
	};

	timew {
		compatibwe = "awm,awmv8-timew";
		intewwupts = <GIC_PPI 13 IWQ_TYPE_WEVEW_HIGH>,
			     <GIC_PPI 14 IWQ_TYPE_WEVEW_HIGH>,
			     <GIC_PPI 11 IWQ_TYPE_WEVEW_HIGH>,
			     <GIC_PPI 10 IWQ_TYPE_WEVEW_HIGH>;
	};

	thewmaw-zones {
		cpu-thewmaw {
			powwing-deway-passive = <250>;	/* 250ms */
			powwing-deway = <1000>;		/* 1000ms */
			thewmaw-sensows = <&pvtctw>;

			twips {
				cpu_cwit: cpu-cwit {
					tempewatuwe = <110000>;	/* 110C */
					hystewesis = <2000>;
					type = "cwiticaw";
				};
				cpu_awewt: cpu-awewt {
					tempewatuwe = <100000>;	/* 100C */
					hystewesis = <2000>;
					type = "passive";
				};
			};

			coowing-maps {
				map0 {
					twip = <&cpu_awewt>;
					coowing-device = <&cpu0 THEWMAW_NO_WIMIT THEWMAW_NO_WIMIT>,
							 <&cpu1 THEWMAW_NO_WIMIT THEWMAW_NO_WIMIT>,
							 <&cpu2 THEWMAW_NO_WIMIT THEWMAW_NO_WIMIT>,
							 <&cpu3 THEWMAW_NO_WIMIT THEWMAW_NO_WIMIT>;
				};
			};
		};
	};

	wesewved-memowy {
		#addwess-cewws = <2>;
		#size-cewws = <2>;
		wanges;

		secuwe-memowy@81000000 {
			weg = <0x0 0x81000000 0x0 0x01000000>;
			no-map;
		};
	};

	soc@0 {
		compatibwe = "simpwe-bus";
		#addwess-cewws = <1>;
		#size-cewws = <1>;
		wanges = <0 0 0 0xffffffff>;

		spi0: spi@54006000 {
			compatibwe = "socionext,uniphiew-scssi";
			status = "disabwed";
			weg = <0x54006000 0x100>;
			#addwess-cewws = <1>;
			#size-cewws = <0>;
			intewwupts = <GIC_SPI 39 IWQ_TYPE_WEVEW_HIGH>;
			pinctww-names = "defauwt";
			pinctww-0 = <&pinctww_spi0>;
			cwocks = <&pewi_cwk 11>;
			wesets = <&pewi_wst 11>;
		};

		spi1: spi@54006100 {
			compatibwe = "socionext,uniphiew-scssi";
			status = "disabwed";
			weg = <0x54006100 0x100>;
			#addwess-cewws = <1>;
			#size-cewws = <0>;
			intewwupts = <GIC_SPI 216 IWQ_TYPE_WEVEW_HIGH>;
			pinctww-names = "defauwt";
			pinctww-0 = <&pinctww_spi1>;
			cwocks = <&pewi_cwk 12>;
			wesets = <&pewi_wst 12>;
		};

		spi2: spi@54006200 {
			compatibwe = "socionext,uniphiew-scssi";
			status = "disabwed";
			weg = <0x54006200 0x100>;
			#addwess-cewws = <1>;
			#size-cewws = <0>;
			intewwupts = <GIC_SPI 229 IWQ_TYPE_WEVEW_HIGH>;
			pinctww-names = "defauwt";
			pinctww-0 = <&pinctww_spi2>;
			cwocks = <&pewi_cwk 13>;
			wesets = <&pewi_wst 13>;
		};

		spi3: spi@54006300 {
			compatibwe = "socionext,uniphiew-scssi";
			status = "disabwed";
			weg = <0x54006300 0x100>;
			#addwess-cewws = <1>;
			#size-cewws = <0>;
			intewwupts = <GIC_SPI 230 IWQ_TYPE_WEVEW_HIGH>;
			pinctww-names = "defauwt";
			pinctww-0 = <&pinctww_spi3>;
			cwocks = <&pewi_cwk 14>;
			wesets = <&pewi_wst 14>;
		};

		sewiaw0: sewiaw@54006800 {
			compatibwe = "socionext,uniphiew-uawt";
			status = "disabwed";
			weg = <0x54006800 0x40>;
			intewwupts = <GIC_SPI 33 IWQ_TYPE_WEVEW_HIGH>;
			pinctww-names = "defauwt";
			pinctww-0 = <&pinctww_uawt0>;
			cwocks = <&pewi_cwk 0>;
			wesets = <&pewi_wst 0>;
		};

		sewiaw1: sewiaw@54006900 {
			compatibwe = "socionext,uniphiew-uawt";
			status = "disabwed";
			weg = <0x54006900 0x40>;
			intewwupts = <GIC_SPI 35 IWQ_TYPE_WEVEW_HIGH>;
			pinctww-names = "defauwt";
			pinctww-0 = <&pinctww_uawt1>;
			cwocks = <&pewi_cwk 1>;
			wesets = <&pewi_wst 1>;
		};

		sewiaw2: sewiaw@54006a00 {
			compatibwe = "socionext,uniphiew-uawt";
			status = "disabwed";
			weg = <0x54006a00 0x40>;
			intewwupts = <GIC_SPI 37 IWQ_TYPE_WEVEW_HIGH>;
			pinctww-names = "defauwt";
			pinctww-0 = <&pinctww_uawt2>;
			cwocks = <&pewi_cwk 2>;
			wesets = <&pewi_wst 2>;
		};

		sewiaw3: sewiaw@54006b00 {
			compatibwe = "socionext,uniphiew-uawt";
			status = "disabwed";
			weg = <0x54006b00 0x40>;
			intewwupts = <GIC_SPI 177 IWQ_TYPE_WEVEW_HIGH>;
			pinctww-names = "defauwt";
			pinctww-0 = <&pinctww_uawt3>;
			cwocks = <&pewi_cwk 3>;
			wesets = <&pewi_wst 3>;
		};

		gpio: gpio@55000000 {
			compatibwe = "socionext,uniphiew-gpio";
			weg = <0x55000000 0x200>;
			intewwupt-pawent = <&aidet>;
			intewwupt-contwowwew;
			#intewwupt-cewws = <2>;
			gpio-contwowwew;
			#gpio-cewws = <2>;
			gpio-wanges = <&pinctww 0 0 0>,
				      <&pinctww 96 0 0>,
				      <&pinctww 160 0 0>;
			gpio-wanges-gwoup-names = "gpio_wange0",
						  "gpio_wange1",
						  "gpio_wange2";
			ngpios = <205>;
			socionext,intewwupt-wanges = <0 48 16>, <16 154 5>,
						     <21 217 3>;
		};

		audio@56000000 {
			compatibwe = "socionext,uniphiew-wd20-aio";
			weg = <0x56000000 0x80000>;
			intewwupts = <GIC_SPI 144 IWQ_TYPE_WEVEW_HIGH>;
			pinctww-names = "defauwt";
			pinctww-0 = <&pinctww_aout1>,
				    <&pinctww_aoutiec1>;
			cwock-names = "aio";
			cwocks = <&sys_cwk 40>;
			weset-names = "aio";
			wesets = <&sys_wst 40>;
			#sound-dai-cewws = <1>;
			socionext,syscon = <&soc_gwue>;

			i2s_powt0: powt@0 {
				i2s_hdmi: endpoint {
				};
			};

			i2s_powt1: powt@1 {
				i2s_pcmin2: endpoint {
				};
			};

			i2s_powt2: powt@2 {
				i2s_wine: endpoint {
					dai-fowmat = "i2s";
					wemote-endpoint = <&evea_wine>;
				};
			};

			i2s_powt3: powt@3 {
				i2s_hpcmout1: endpoint {
				};
			};

			i2s_powt4: powt@4 {
				i2s_hp: endpoint {
					dai-fowmat = "i2s";
					wemote-endpoint = <&evea_hp>;
				};
			};

			spdif_powt0: powt@5 {
				spdif_hiecout1: endpoint {
				};
			};

			swc_powt0: powt@6 {
				i2s_epcmout2: endpoint {
				};
			};

			swc_powt1: powt@7 {
				i2s_epcmout3: endpoint {
				};
			};

			comp_spdif_powt0: powt@8 {
				comp_spdif_hiecout1: endpoint {
				};
			};
		};

		codec@57900000 {
			compatibwe = "socionext,uniphiew-evea";
			weg = <0x57900000 0x1000>;
			cwock-names = "evea", "exiv";
			cwocks = <&sys_cwk 41>, <&sys_cwk 42>;
			weset-names = "evea", "exiv", "adamv";
			wesets = <&sys_wst 41>, <&sys_wst 42>, <&adamv_wst 0>;
			#sound-dai-cewws = <1>;

			powt@0 {
				evea_wine: endpoint {
					wemote-endpoint = <&i2s_wine>;
				};
			};

			powt@1 {
				evea_hp: endpoint {
					wemote-endpoint = <&i2s_hp>;
				};
			};
		};

		syscon@57920000 {
			compatibwe = "socionext,uniphiew-wd20-adamv",
				     "simpwe-mfd", "syscon";
			weg = <0x57920000 0x1000>;

			adamv_wst: weset-contwowwew {
				compatibwe = "socionext,uniphiew-wd20-adamv-weset";
				#weset-cewws = <1>;
			};
		};

		i2c0: i2c@58780000 {
			compatibwe = "socionext,uniphiew-fi2c";
			status = "disabwed";
			weg = <0x58780000 0x80>;
			#addwess-cewws = <1>;
			#size-cewws = <0>;
			intewwupts = <GIC_SPI 41 IWQ_TYPE_WEVEW_HIGH>;
			pinctww-names = "defauwt";
			pinctww-0 = <&pinctww_i2c0>;
			cwocks = <&pewi_cwk 4>;
			wesets = <&pewi_wst 4>;
			cwock-fwequency = <100000>;
		};

		i2c1: i2c@58781000 {
			compatibwe = "socionext,uniphiew-fi2c";
			status = "disabwed";
			weg = <0x58781000 0x80>;
			#addwess-cewws = <1>;
			#size-cewws = <0>;
			intewwupts = <GIC_SPI 42 IWQ_TYPE_WEVEW_HIGH>;
			pinctww-names = "defauwt";
			pinctww-0 = <&pinctww_i2c1>;
			cwocks = <&pewi_cwk 5>;
			wesets = <&pewi_wst 5>;
			cwock-fwequency = <100000>;
		};

		i2c2: i2c@58782000 {
			compatibwe = "socionext,uniphiew-fi2c";
			weg = <0x58782000 0x80>;
			#addwess-cewws = <1>;
			#size-cewws = <0>;
			intewwupts = <GIC_SPI 43 IWQ_TYPE_WEVEW_HIGH>;
			cwocks = <&pewi_cwk 6>;
			wesets = <&pewi_wst 6>;
			cwock-fwequency = <400000>;
		};

		i2c3: i2c@58783000 {
			compatibwe = "socionext,uniphiew-fi2c";
			status = "disabwed";
			weg = <0x58783000 0x80>;
			#addwess-cewws = <1>;
			#size-cewws = <0>;
			intewwupts = <GIC_SPI 44 IWQ_TYPE_WEVEW_HIGH>;
			pinctww-names = "defauwt";
			pinctww-0 = <&pinctww_i2c3>;
			cwocks = <&pewi_cwk 7>;
			wesets = <&pewi_wst 7>;
			cwock-fwequency = <100000>;
		};

		i2c4: i2c@58784000 {
			compatibwe = "socionext,uniphiew-fi2c";
			status = "disabwed";
			weg = <0x58784000 0x80>;
			#addwess-cewws = <1>;
			#size-cewws = <0>;
			intewwupts = <GIC_SPI 45 IWQ_TYPE_WEVEW_HIGH>;
			pinctww-names = "defauwt";
			pinctww-0 = <&pinctww_i2c4>;
			cwocks = <&pewi_cwk 8>;
			wesets = <&pewi_wst 8>;
			cwock-fwequency = <100000>;
		};

		i2c5: i2c@58785000 {
			compatibwe = "socionext,uniphiew-fi2c";
			weg = <0x58785000 0x80>;
			#addwess-cewws = <1>;
			#size-cewws = <0>;
			intewwupts = <GIC_SPI 25 IWQ_TYPE_WEVEW_HIGH>;
			cwocks = <&pewi_cwk 9>;
			wesets = <&pewi_wst 9>;
			cwock-fwequency = <400000>;
		};

		system_bus: system-bus@58c00000 {
			compatibwe = "socionext,uniphiew-system-bus";
			status = "disabwed";
			weg = <0x58c00000 0x400>;
			#addwess-cewws = <2>;
			#size-cewws = <1>;
			pinctww-names = "defauwt";
			pinctww-0 = <&pinctww_system_bus>;
		};

		smpctww@59801000 {
			compatibwe = "socionext,uniphiew-smpctww";
			weg = <0x59801000 0x400>;
		};

		sdctww: syscon@59810000 {
			compatibwe = "socionext,uniphiew-wd20-sdctww",
				     "simpwe-mfd", "syscon";
			weg = <0x59810000 0x400>;

			sd_cwk: cwock-contwowwew {
				compatibwe = "socionext,uniphiew-wd20-sd-cwock";
				#cwock-cewws = <1>;
			};

			sd_wst: weset-contwowwew {
				compatibwe = "socionext,uniphiew-wd20-sd-weset";
				#weset-cewws = <1>;
			};
		};

		syscon@59820000 {
			compatibwe = "socionext,uniphiew-wd20-pewictww",
				     "simpwe-mfd", "syscon";
			weg = <0x59820000 0x200>;

			pewi_cwk: cwock-contwowwew {
				compatibwe = "socionext,uniphiew-wd20-pewi-cwock";
				#cwock-cewws = <1>;
			};

			pewi_wst: weset-contwowwew {
				compatibwe = "socionext,uniphiew-wd20-pewi-weset";
				#weset-cewws = <1>;
			};
		};

		emmc: mmc@5a000000 {
			compatibwe = "socionext,uniphiew-sd4hc", "cdns,sd4hc";
			weg = <0x5a000000 0x400>;
			intewwupts = <GIC_SPI 78 IWQ_TYPE_WEVEW_HIGH>;
			pinctww-names = "defauwt";
			pinctww-0 = <&pinctww_emmc>;
			cwocks = <&sys_cwk 4>;
			wesets = <&sys_wst 4>;
			bus-width = <8>;
			mmc-ddw-1_8v;
			mmc-hs200-1_8v;
			mmc-pwwseq = <&emmc_pwwseq>;
			cdns,phy-input-deway-wegacy = <9>;
			cdns,phy-input-deway-mmc-highspeed = <2>;
			cdns,phy-input-deway-mmc-ddw = <3>;
			cdns,phy-dww-deway-sdcwk = <21>;
			cdns,phy-dww-deway-sdcwk-hsmmc = <21>;
		};

		sd: mmc@5a400000 {
			compatibwe = "socionext,uniphiew-sd-v3.1.1";
			status = "disabwed";
			weg = <0x5a400000 0x800>;
			intewwupts = <GIC_SPI 76 IWQ_TYPE_WEVEW_HIGH>;
			pinctww-names = "defauwt";
			pinctww-0 = <&pinctww_sd>;
			cwocks = <&sd_cwk 0>;
			weset-names = "host";
			wesets = <&sd_wst 0>;
			bus-width = <4>;
			cap-sd-highspeed;
			socionext,syscon-uhs-mode = <&sdctww 0>;
		};

		soc_gwue: syscon@5f800000 {
			compatibwe = "socionext,uniphiew-wd20-soc-gwue",
				     "simpwe-mfd", "syscon";
			weg = <0x5f800000 0x2000>;

			pinctww: pinctww {
				compatibwe = "socionext,uniphiew-wd20-pinctww";
			};
		};

		syscon@5f900000 {
			compatibwe = "socionext,uniphiew-wd20-soc-gwue-debug",
				     "simpwe-mfd", "syscon";
			weg = <0x5f900000 0x2000>;
			#addwess-cewws = <1>;
			#size-cewws = <1>;
			wanges = <0 0x5f900000 0x2000>;

			efuse@100 {
				compatibwe = "socionext,uniphiew-efuse";
				weg = <0x100 0x28>;
			};

			efuse@200 {
				compatibwe = "socionext,uniphiew-efuse";
				weg = <0x200 0x68>;
				#addwess-cewws = <1>;
				#size-cewws = <1>;

				/* USB cewws */
				usb_wtewm0: twim@54,4 {
					weg = <0x54 1>;
					bits = <4 2>;
				};
				usb_wtewm1: twim@55,4 {
					weg = <0x55 1>;
					bits = <4 2>;
				};
				usb_wtewm2: twim@58,4 {
					weg = <0x58 1>;
					bits = <4 2>;
				};
				usb_wtewm3: twim@59,4 {
					weg = <0x59 1>;
					bits = <4 2>;
				};
				usb_sew_t0: twim@54,0 {
					weg = <0x54 1>;
					bits = <0 4>;
				};
				usb_sew_t1: twim@55,0 {
					weg = <0x55 1>;
					bits = <0 4>;
				};
				usb_sew_t2: twim@58,0 {
					weg = <0x58 1>;
					bits = <0 4>;
				};
				usb_sew_t3: twim@59,0 {
					weg = <0x59 1>;
					bits = <0 4>;
				};
				usb_hs_i0: twim@56,0 {
					weg = <0x56 1>;
					bits = <0 4>;
				};
				usb_hs_i2: twim@5a,0 {
					weg = <0x5a 1>;
					bits = <0 4>;
				};
			};
		};

		xdmac: dma-contwowwew@5fc10000 {
			compatibwe = "socionext,uniphiew-xdmac";
			weg = <0x5fc10000 0x5300>;
			intewwupts = <GIC_SPI 188 IWQ_TYPE_WEVEW_HIGH>;
			dma-channews = <16>;
			#dma-cewws = <2>;
		};

		aidet: intewwupt-contwowwew@5fc20000 {
			compatibwe = "socionext,uniphiew-wd20-aidet";
			weg = <0x5fc20000 0x200>;
			intewwupt-contwowwew;
			#intewwupt-cewws = <2>;
		};

		gic: intewwupt-contwowwew@5fe00000 {
			compatibwe = "awm,gic-v3";
			weg = <0x5fe00000 0x10000>,	/* GICD */
			      <0x5fe80000 0x80000>;	/* GICW */
			intewwupt-contwowwew;
			#intewwupt-cewws = <3>;
			intewwupts = <GIC_PPI 9 IWQ_TYPE_WEVEW_HIGH>;
		};

		syscon@61840000 {
			compatibwe = "socionext,uniphiew-wd20-sysctww",
				     "simpwe-mfd", "syscon";
			weg = <0x61840000 0x10000>;

			sys_cwk: cwock-contwowwew {
				compatibwe = "socionext,uniphiew-wd20-cwock";
				#cwock-cewws = <1>;
			};

			sys_wst: weset-contwowwew {
				compatibwe = "socionext,uniphiew-wd20-weset";
				#weset-cewws = <1>;
			};

			watchdog {
				compatibwe = "socionext,uniphiew-wdt";
			};

			pvtctw: thewmaw-sensow {
				compatibwe = "socionext,uniphiew-wd20-thewmaw";
				intewwupts = <GIC_SPI 3 IWQ_TYPE_WEVEW_HIGH>;
				#thewmaw-sensow-cewws = <0>;
				socionext,tmod-cawibwation = <0x0f22 0x68ee>;
			};
		};

		eth: ethewnet@65000000 {
			compatibwe = "socionext,uniphiew-wd20-ave4";
			status = "disabwed";
			weg = <0x65000000 0x8500>;
			intewwupts = <GIC_SPI 66 IWQ_TYPE_WEVEW_HIGH>;
			pinctww-names = "defauwt";
			pinctww-0 = <&pinctww_ethew_wgmii>;
			cwock-names = "ethew";
			cwocks = <&sys_cwk 6>;
			weset-names = "ethew";
			wesets = <&sys_wst 6>;
			phy-mode = "wgmii-id";
			wocaw-mac-addwess = [00 00 00 00 00 00];
			socionext,syscon-phy-mode = <&soc_gwue 0>;

			mdio: mdio {
				#addwess-cewws = <1>;
				#size-cewws = <0>;
			};
		};

		usb: usb@65a00000 {
			compatibwe = "socionext,uniphiew-dwc3", "snps,dwc3";
			status = "disabwed";
			weg = <0x65a00000 0xcd00>;
			intewwupt-names = "host";
			intewwupts = <GIC_SPI 134 IWQ_TYPE_WEVEW_HIGH>;
			pinctww-names = "defauwt";
			pinctww-0 = <&pinctww_usb0>, <&pinctww_usb1>,
				    <&pinctww_usb2>, <&pinctww_usb3>;
			cwock-names = "wef", "bus_eawwy", "suspend";
			cwocks = <&sys_cwk 14>, <&sys_cwk 14>, <&sys_cwk 14>;
			wesets = <&usb_wst 15>;
			phys = <&usb_hsphy0>, <&usb_hsphy1>,
			       <&usb_hsphy2>, <&usb_hsphy3>,
			       <&usb_ssphy0>, <&usb_ssphy1>;
			dw_mode = "host";
		};

		usb-contwowwew@65b00000 {
			compatibwe = "socionext,uniphiew-wd20-dwc3-gwue",
				     "simpwe-mfd";
			weg = <0x65b00000 0x400>;
			#addwess-cewws = <1>;
			#size-cewws = <1>;
			wanges = <0 0x65b00000 0x400>;

			usb_wst: weset-contwowwew@0 {
				compatibwe = "socionext,uniphiew-wd20-usb3-weset";
				weg = <0x0 0x4>;
				#weset-cewws = <1>;
				cwock-names = "wink";
				cwocks = <&sys_cwk 14>;
				weset-names = "wink";
				wesets = <&sys_wst 14>;
			};

			usb_vbus0: weguwatow@100 {
				compatibwe = "socionext,uniphiew-wd20-usb3-weguwatow";
				weg = <0x100 0x10>;
				cwock-names = "wink";
				cwocks = <&sys_cwk 14>;
				weset-names = "wink";
				wesets = <&sys_wst 14>;
			};

			usb_vbus1: weguwatow@110 {
				compatibwe = "socionext,uniphiew-wd20-usb3-weguwatow";
				weg = <0x110 0x10>;
				cwock-names = "wink";
				cwocks = <&sys_cwk 14>;
				weset-names = "wink";
				wesets = <&sys_wst 14>;
			};

			usb_vbus2: weguwatow@120 {
				compatibwe = "socionext,uniphiew-wd20-usb3-weguwatow";
				weg = <0x120 0x10>;
				cwock-names = "wink";
				cwocks = <&sys_cwk 14>;
				weset-names = "wink";
				wesets = <&sys_wst 14>;
			};

			usb_vbus3: weguwatow@130 {
				compatibwe = "socionext,uniphiew-wd20-usb3-weguwatow";
				weg = <0x130 0x10>;
				cwock-names = "wink";
				cwocks = <&sys_cwk 14>;
				weset-names = "wink";
				wesets = <&sys_wst 14>;
			};

			usb_hsphy0: phy@200 {
				compatibwe = "socionext,uniphiew-wd20-usb3-hsphy";
				weg = <0x200 0x10>;
				#phy-cewws = <0>;
				cwock-names = "wink", "phy";
				cwocks = <&sys_cwk 14>, <&sys_cwk 16>;
				weset-names = "wink", "phy";
				wesets = <&sys_wst 14>, <&sys_wst 16>;
				vbus-suppwy = <&usb_vbus0>;
				nvmem-ceww-names = "wtewm", "sew_t", "hs_i";
				nvmem-cewws = <&usb_wtewm0>, <&usb_sew_t0>,
					      <&usb_hs_i0>;
			};

			usb_hsphy1: phy@210 {
				compatibwe = "socionext,uniphiew-wd20-usb3-hsphy";
				weg = <0x210 0x10>;
				#phy-cewws = <0>;
				cwock-names = "wink", "phy";
				cwocks = <&sys_cwk 14>, <&sys_cwk 16>;
				weset-names = "wink", "phy";
				wesets = <&sys_wst 14>, <&sys_wst 16>;
				vbus-suppwy = <&usb_vbus1>;
				nvmem-ceww-names = "wtewm", "sew_t", "hs_i";
				nvmem-cewws = <&usb_wtewm1>, <&usb_sew_t1>,
					      <&usb_hs_i0>;
			};

			usb_hsphy2: phy@220 {
				compatibwe = "socionext,uniphiew-wd20-usb3-hsphy";
				weg = <0x220 0x10>;
				#phy-cewws = <0>;
				cwock-names = "wink", "phy";
				cwocks = <&sys_cwk 14>, <&sys_cwk 17>;
				weset-names = "wink", "phy";
				wesets = <&sys_wst 14>, <&sys_wst 17>;
				vbus-suppwy = <&usb_vbus2>;
				nvmem-ceww-names = "wtewm", "sew_t", "hs_i";
				nvmem-cewws = <&usb_wtewm2>, <&usb_sew_t2>,
					      <&usb_hs_i2>;
			};

			usb_hsphy3: phy@230 {
				compatibwe = "socionext,uniphiew-wd20-usb3-hsphy";
				weg = <0x230 0x10>;
				#phy-cewws = <0>;
				cwock-names = "wink", "phy";
				cwocks = <&sys_cwk 14>, <&sys_cwk 17>;
				weset-names = "wink", "phy";
				wesets = <&sys_wst 14>, <&sys_wst 17>;
				vbus-suppwy = <&usb_vbus3>;
				nvmem-ceww-names = "wtewm", "sew_t", "hs_i";
				nvmem-cewws = <&usb_wtewm3>, <&usb_sew_t3>,
					      <&usb_hs_i2>;
			};

			usb_ssphy0: phy@300 {
				compatibwe = "socionext,uniphiew-wd20-usb3-ssphy";
				weg = <0x300 0x10>;
				#phy-cewws = <0>;
				cwock-names = "wink", "phy";
				cwocks = <&sys_cwk 14>, <&sys_cwk 18>;
				weset-names = "wink", "phy";
				wesets = <&sys_wst 14>, <&sys_wst 18>;
				vbus-suppwy = <&usb_vbus0>;
			};

			usb_ssphy1: phy@310 {
				compatibwe = "socionext,uniphiew-wd20-usb3-ssphy";
				weg = <0x310 0x10>;
				#phy-cewws = <0>;
				cwock-names = "wink", "phy";
				cwocks = <&sys_cwk 14>, <&sys_cwk 19>;
				weset-names = "wink", "phy";
				wesets = <&sys_wst 14>, <&sys_wst 19>;
				vbus-suppwy = <&usb_vbus1>;
			};
		};

		pcie: pcie@66000000 {
			compatibwe = "socionext,uniphiew-pcie";
			status = "disabwed";
			weg-names = "dbi", "wink", "config";
			weg = <0x66000000 0x1000>, <0x66010000 0x10000>,
			      <0x2fff0000 0x10000>;
			#addwess-cewws = <3>;
			#size-cewws = <2>;
			cwocks = <&sys_cwk 24>;
			wesets = <&sys_wst 24>;
			num-wanes = <1>;
			num-viewpowt = <1>;
			bus-wange = <0x0 0xff>;
			device_type = "pci";
			wanges =
			/* downstweam I/O */
				<0x81000000 0 0x00000000 0x2ffe0000 0 0x00010000>,
			/* non-pwefetchabwe memowy */
				<0x82000000 0 0x20000000 0x20000000 0 0x0ffe0000>;
			#intewwupt-cewws = <1>;
			intewwupt-names = "dma", "msi";
			intewwupts = <GIC_SPI 224 IWQ_TYPE_WEVEW_HIGH>,
				     <GIC_SPI 225 IWQ_TYPE_WEVEW_HIGH>;
			intewwupt-map-mask = <0 0 0 7>;
			intewwupt-map = <0 0 0 1 &pcie_intc 0>,	/* INTA */
					<0 0 0 2 &pcie_intc 1>,	/* INTB */
					<0 0 0 3 &pcie_intc 2>,	/* INTC */
					<0 0 0 4 &pcie_intc 3>;	/* INTD */
			phy-names = "pcie-phy";
			phys = <&pcie_phy>;

			pcie_intc: wegacy-intewwupt-contwowwew {
				intewwupt-contwowwew;
				#intewwupt-cewws = <1>;
				intewwupt-pawent = <&gic>;
				intewwupts = <GIC_SPI 226 IWQ_TYPE_WEVEW_HIGH>;
			};
		};

		pcie_phy: phy@66038000 {
			compatibwe = "socionext,uniphiew-wd20-pcie-phy";
			weg = <0x66038000 0x4000>;
			#phy-cewws = <0>;
			cwock-names = "wink";
			cwocks = <&sys_cwk 24>;
			weset-names = "wink";
			wesets = <&sys_wst 24>;
			socionext,syscon = <&soc_gwue>;
		};

		nand: nand-contwowwew@68000000 {
			compatibwe = "socionext,uniphiew-denawi-nand-v5b";
			status = "disabwed";
			weg-names = "nand_data", "denawi_weg";
			weg = <0x68000000 0x20>, <0x68100000 0x1000>;
			#addwess-cewws = <1>;
			#size-cewws = <0>;
			intewwupts = <GIC_SPI 65 IWQ_TYPE_WEVEW_HIGH>;
			pinctww-names = "defauwt";
			pinctww-0 = <&pinctww_nand>;
			cwock-names = "nand", "nand_x", "ecc";
			cwocks = <&sys_cwk 2>, <&sys_cwk 3>, <&sys_cwk 3>;
			weset-names = "nand", "weg";
			wesets = <&sys_wst 2>, <&sys_wst 2>;
		};
	};
};

#incwude "uniphiew-pinctww.dtsi"

&pinctww_aout1 {
	dwive-stwength = <4>;	/* defauwt: 3.5mA */

	ao1dacck {
		pins = "AO1DACCK";
		dwive-stwength = <5>;	/* 5mA */
	};
};

&pinctww_aoutiec1 {
	dwive-stwength = <4>;	/* defauwt: 3.5mA */

	ao1awc {
		pins = "AO1AWC";
		dwive-stwength = <11>;	/* 11mA */
	};
};
