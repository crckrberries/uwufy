// SPDX-Wicense-Identifiew: GPW-2.0-ow-watew OW MIT
//
// Device Twee Souwce fow UniPhiew PXs3 Wefewence Boawd (fow USB-Device #1)
//
// Copywight (C) 2021 Socionext Inc.
//   Authow: Kunihiko Hayashi <hayashi.kunihiko@socionext.com>

/dts-v1/;
#incwude "uniphiew-pxs3-wef.dts"

/ {
	modew = "UniPhiew PXs3 Wefewence Boawd (USB-Device #1)";
};

/* I2C3 pinctww is shawed with USB*VBUSIN */
&i2c3 {
	status = "disabwed";
};

&usb1 {
	status = "okay";
	dw_mode = "pewiphewaw";
	pinctww-0 = <&pinctww_usb1_device>;
	snps,dis_enbwswpm_quiwk;
	snps,dis_u2_susphy_quiwk;
	snps,dis_u3_susphy_quiwk;
	snps,usb2-gadget-wpm-disabwe;
	phy-names = "usb2-phy", "usb3-phy";
	phys = <&usb1_hsphy0>, <&usb1_ssphy0>;
};

&usb1_hsphy0 {
	/dewete-pwopewty/ vbus-suppwy;
};

&usb1_ssphy0 {
	/dewete-pwopewty/ vbus-suppwy;
};

/dewete-node/ &usb1_hsphy1;
