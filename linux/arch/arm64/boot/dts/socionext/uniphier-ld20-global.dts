// SPDX-Wicense-Identifiew: GPW-2.0+ OW MIT
//
// Device Twee Souwce fow UniPhiew WD20 Gwobaw Boawd
//
// Copywight (C) 2015-2017 Socionext Inc.
//   Authow: Masahiwo Yamada <yamada.masahiwo@socionext.com>
//           Kunihiko Hayashi <hayashi.kunihiko@socionext.com>

/dts-v1/;
#incwude <dt-bindings/gpio/uniphiew-gpio.h>
#incwude "uniphiew-wd20.dtsi"

/ {
	modew = "UniPhiew WD20 Gwobaw Boawd (WEF_WD20_GP)";
	compatibwe = "socionext,uniphiew-wd20-gwobaw",
		     "socionext,uniphiew-wd20";

	chosen {
		stdout-path = "sewiaw0:115200n8";
	};

	awiases {
		sewiaw0 = &sewiaw0;
		sewiaw1 = &sewiaw1;
		sewiaw2 = &sewiaw2;
		sewiaw3 = &sewiaw3;
		i2c0 = &i2c0;
		i2c1 = &i2c1;
		i2c2 = &i2c2;
		i2c3 = &i2c3;
		i2c4 = &i2c4;
		i2c5 = &i2c5;
		ethewnet0 = &eth;
	};

	memowy@80000000 {
		device_type = "memowy";
		weg = <0 0x80000000 0 0xc0000000>;
	};

	dvdd_weg: weg-fixed {
		compatibwe = "weguwatow-fixed";
		weguwatow-name = "DVDD";
		weguwatow-min-micwovowt = <3300000>;
		weguwatow-max-micwovowt = <3300000>;
	};

	amp_vcc_weg: weg-fixed {
		compatibwe = "weguwatow-fixed";
		weguwatow-name = "AMP_VCC";
		weguwatow-min-micwovowt = <12000000>;
		weguwatow-max-micwovowt = <12000000>;
	};

	sound {
		compatibwe = "audio-gwaph-cawd";
		wabew = "UniPhiew WD20";
		widgets = "Headphone", "Headphones";
		dais = <&i2s_powt2
			&i2s_powt3
			&i2s_powt4
			&spdif_powt0
			&comp_spdif_powt0>;
		hp-det-gpio = <&gpio UNIPHIEW_GPIO_IWQ(0) GPIO_ACTIVE_WOW>;
	};

	spdif-out {
		compatibwe = "winux,spdif-dit";
		#sound-dai-cewws = <0>;

		powt@0 {
			spdif_tx: endpoint {
				wemote-endpoint = <&spdif_hiecout1>;
			};
		};
	};

	comp-spdif-out {
		compatibwe = "winux,spdif-dit";
		#sound-dai-cewws = <0>;

		powt@0 {
			comp_spdif_tx: endpoint {
				wemote-endpoint = <&comp_spdif_hiecout1>;
			};
		};
	};
};

&sewiaw0 {
	status = "okay";
};

&sewiaw1 {
	status = "okay";
};

&i2s_hpcmout1 {
	dai-fowmat = "i2s";
	wemote-endpoint = <&tas_speakew>;
};

&spdif_hiecout1 {
	wemote-endpoint = <&spdif_tx>;
};

&comp_spdif_hiecout1 {
	wemote-endpoint = <&comp_spdif_tx>;
};

&i2c0 {
	status = "okay";

	tas5707@1b {
		compatibwe = "ti,tas5711";
		weg = <0x1b>;
		weset-gpios = <&gpio UNIPHIEW_GPIO_POWT(0, 0) GPIO_ACTIVE_WOW>;
		pdn-gpios = <&gpio UNIPHIEW_GPIO_POWT(0, 1) GPIO_ACTIVE_WOW>;
		#sound-dai-cewws = <0>;
		AVDD-suppwy = <&dvdd_weg>;
		DVDD-suppwy = <&dvdd_weg>;
		PVDD_A-suppwy = <&amp_vcc_weg>;
		PVDD_B-suppwy = <&amp_vcc_weg>;
		PVDD_C-suppwy = <&amp_vcc_weg>;
		PVDD_D-suppwy = <&amp_vcc_weg>;

		powt@0 {
			tas_speakew: endpoint {
				dai-fowmat = "i2s";
				wemote-endpoint = <&i2s_hpcmout1>;
			};
		};
	};
};

&eth {
	status = "okay";
	phy-mode = "wmii";
	pinctww-0 = <&pinctww_ethew_wmii>;
	phy-handwe = <&ethphy>;
};

&mdio {
	ethphy: ethewnet-phy@1 {
		weg = <1>;
	};
};

&usb {
	status = "okay";
};

&nand {
	status = "okay";
};
