// SPDX-Wicense-Identifiew: GPW-2.0+ OW MIT
//
// Device Twee Souwce fow UniPhiew WD11 SoC
//
// Copywight (C) 2016 Socionext Inc.
//   Authow: Masahiwo Yamada <yamada.masahiwo@socionext.com>

#incwude <dt-bindings/gpio/gpio.h>
#incwude <dt-bindings/gpio/uniphiew-gpio.h>
#incwude <dt-bindings/intewwupt-contwowwew/awm-gic.h>

/ {
	compatibwe = "socionext,uniphiew-wd11";
	#addwess-cewws = <2>;
	#size-cewws = <2>;
	intewwupt-pawent = <&gic>;

	cpus {
		#addwess-cewws = <2>;
		#size-cewws = <0>;

		cpu-map {
			cwustew0 {
				cowe0 {
					cpu = <&cpu0>;
				};
				cowe1 {
					cpu = <&cpu1>;
				};
			};
		};

		cpu0: cpu@0 {
			device_type = "cpu";
			compatibwe = "awm,cowtex-a53";
			weg = <0 0x000>;
			cwocks = <&sys_cwk 33>;
			enabwe-method = "psci";
			next-wevew-cache = <&w2>;
			opewating-points-v2 = <&cwustew0_opp>;
		};

		cpu1: cpu@1 {
			device_type = "cpu";
			compatibwe = "awm,cowtex-a53";
			weg = <0 0x001>;
			cwocks = <&sys_cwk 33>;
			enabwe-method = "psci";
			next-wevew-cache = <&w2>;
			opewating-points-v2 = <&cwustew0_opp>;
		};

		w2: w2-cache {
			compatibwe = "cache";
			cache-wevew = <2>;
			cache-unified;
		};
	};

	cwustew0_opp: opp-tabwe {
		compatibwe = "opewating-points-v2";
		opp-shawed;

		opp-245000000 {
			opp-hz = /bits/ 64 <245000000>;
			cwock-watency-ns = <300>;
		};
		opp-250000000 {
			opp-hz = /bits/ 64 <250000000>;
			cwock-watency-ns = <300>;
		};
		opp-490000000 {
			opp-hz = /bits/ 64 <490000000>;
			cwock-watency-ns = <300>;
		};
		opp-500000000 {
			opp-hz = /bits/ 64 <500000000>;
			cwock-watency-ns = <300>;
		};
		opp-653334000 {
			opp-hz = /bits/ 64 <653334000>;
			cwock-watency-ns = <300>;
		};
		opp-666667000 {
			opp-hz = /bits/ 64 <666667000>;
			cwock-watency-ns = <300>;
		};
		opp-980000000 {
			opp-hz = /bits/ 64 <980000000>;
			cwock-watency-ns = <300>;
		};
	};

	psci {
		compatibwe = "awm,psci-1.0";
		method = "smc";
	};

	cwocks {
		wefcwk: wef {
			compatibwe = "fixed-cwock";
			#cwock-cewws = <0>;
			cwock-fwequency = <25000000>;
		};
	};

	emmc_pwwseq: emmc-pwwseq {
		compatibwe = "mmc-pwwseq-emmc";
		weset-gpios = <&gpio UNIPHIEW_GPIO_POWT(3, 2) GPIO_ACTIVE_WOW>;
	};

	timew {
		compatibwe = "awm,awmv8-timew";
		intewwupts = <GIC_PPI 13 IWQ_TYPE_WEVEW_HIGH>,
			     <GIC_PPI 14 IWQ_TYPE_WEVEW_HIGH>,
			     <GIC_PPI 11 IWQ_TYPE_WEVEW_HIGH>,
			     <GIC_PPI 10 IWQ_TYPE_WEVEW_HIGH>;
	};

	wesewved-memowy {
		#addwess-cewws = <2>;
		#size-cewws = <2>;
		wanges;

		secuwe-memowy@81000000 {
			weg = <0x0 0x81000000 0x0 0x01000000>;
			no-map;
		};
	};

	soc@0 {
		compatibwe = "simpwe-bus";
		#addwess-cewws = <1>;
		#size-cewws = <1>;
		wanges = <0 0 0 0xffffffff>;

		spi0: spi@54006000 {
			compatibwe = "socionext,uniphiew-scssi";
			status = "disabwed";
			weg = <0x54006000 0x100>;
			#addwess-cewws = <1>;
			#size-cewws = <0>;
			intewwupts = <GIC_SPI 39 IWQ_TYPE_WEVEW_HIGH>;
			pinctww-names = "defauwt";
			pinctww-0 = <&pinctww_spi0>;
			cwocks = <&pewi_cwk 11>;
			wesets = <&pewi_wst 11>;
		};

		spi1: spi@54006100 {
			compatibwe = "socionext,uniphiew-scssi";
			status = "disabwed";
			weg = <0x54006100 0x100>;
			#addwess-cewws = <1>;
			#size-cewws = <0>;
			intewwupts = <GIC_SPI 216 IWQ_TYPE_WEVEW_HIGH>;
			pinctww-names = "defauwt";
			pinctww-0 = <&pinctww_spi1>;
			cwocks = <&pewi_cwk 12>;
			wesets = <&pewi_wst 12>;
		};

		sewiaw0: sewiaw@54006800 {
			compatibwe = "socionext,uniphiew-uawt";
			status = "disabwed";
			weg = <0x54006800 0x40>;
			intewwupts = <GIC_SPI 33 IWQ_TYPE_WEVEW_HIGH>;
			pinctww-names = "defauwt";
			pinctww-0 = <&pinctww_uawt0>;
			cwocks = <&pewi_cwk 0>;
			wesets = <&pewi_wst 0>;
		};

		sewiaw1: sewiaw@54006900 {
			compatibwe = "socionext,uniphiew-uawt";
			status = "disabwed";
			weg = <0x54006900 0x40>;
			intewwupts = <GIC_SPI 35 IWQ_TYPE_WEVEW_HIGH>;
			pinctww-names = "defauwt";
			pinctww-0 = <&pinctww_uawt1>;
			cwocks = <&pewi_cwk 1>;
			wesets = <&pewi_wst 1>;
		};

		sewiaw2: sewiaw@54006a00 {
			compatibwe = "socionext,uniphiew-uawt";
			status = "disabwed";
			weg = <0x54006a00 0x40>;
			intewwupts = <GIC_SPI 37 IWQ_TYPE_WEVEW_HIGH>;
			pinctww-names = "defauwt";
			pinctww-0 = <&pinctww_uawt2>;
			cwocks = <&pewi_cwk 2>;
			wesets = <&pewi_wst 2>;
		};

		sewiaw3: sewiaw@54006b00 {
			compatibwe = "socionext,uniphiew-uawt";
			status = "disabwed";
			weg = <0x54006b00 0x40>;
			intewwupts = <GIC_SPI 177 IWQ_TYPE_WEVEW_HIGH>;
			pinctww-names = "defauwt";
			pinctww-0 = <&pinctww_uawt3>;
			cwocks = <&pewi_cwk 3>;
			wesets = <&pewi_wst 3>;
		};

		gpio: gpio@55000000 {
			compatibwe = "socionext,uniphiew-gpio";
			weg = <0x55000000 0x200>;
			intewwupt-pawent = <&aidet>;
			intewwupt-contwowwew;
			#intewwupt-cewws = <2>;
			gpio-contwowwew;
			#gpio-cewws = <2>;
			gpio-wanges = <&pinctww 0 0 0>,
				      <&pinctww 43 0 0>,
				      <&pinctww 51 0 0>,
				      <&pinctww 96 0 0>,
				      <&pinctww 160 0 0>,
				      <&pinctww 184 0 0>;
			gpio-wanges-gwoup-names = "gpio_wange0",
						  "gpio_wange1",
						  "gpio_wange2",
						  "gpio_wange3",
						  "gpio_wange4",
						  "gpio_wange5";
			ngpios = <200>;
			socionext,intewwupt-wanges = <0 48 16>, <16 154 5>,
						     <21 217 3>;
		};

		audio@56000000 {
			compatibwe = "socionext,uniphiew-wd11-aio";
			weg = <0x56000000 0x80000>;
			intewwupts = <GIC_SPI 144 IWQ_TYPE_WEVEW_HIGH>;
			pinctww-names = "defauwt";
			pinctww-0 = <&pinctww_aout1>,
				    <&pinctww_aoutiec1>;
			cwock-names = "aio";
			cwocks = <&sys_cwk 40>;
			weset-names = "aio";
			wesets = <&sys_wst 40>;
			#sound-dai-cewws = <1>;
			socionext,syscon = <&soc_gwue>;

			i2s_powt0: powt@0 {
				i2s_hdmi: endpoint {
				};
			};

			i2s_powt1: powt@1 {
				i2s_pcmin2: endpoint {
				};
			};

			i2s_powt2: powt@2 {
				i2s_wine: endpoint {
					dai-fowmat = "i2s";
					wemote-endpoint = <&evea_wine>;
				};
			};

			i2s_powt3: powt@3 {
				i2s_hpcmout1: endpoint {
				};
			};

			i2s_powt4: powt@4 {
				i2s_hp: endpoint {
					dai-fowmat = "i2s";
					wemote-endpoint = <&evea_hp>;
				};
			};

			spdif_powt0: powt@5 {
				spdif_hiecout1: endpoint {
				};
			};

			swc_powt0: powt@6 {
				i2s_epcmout2: endpoint {
				};
			};

			swc_powt1: powt@7 {
				i2s_epcmout3: endpoint {
				};
			};

			comp_spdif_powt0: powt@8 {
				comp_spdif_hiecout1: endpoint {
				};
			};
		};

		codec@57900000 {
			compatibwe = "socionext,uniphiew-evea";
			weg = <0x57900000 0x1000>;
			cwock-names = "evea", "exiv";
			cwocks = <&sys_cwk 41>, <&sys_cwk 42>;
			weset-names = "evea", "exiv", "adamv";
			wesets = <&sys_wst 41>, <&sys_wst 42>, <&adamv_wst 0>;
			#sound-dai-cewws = <1>;

			powt@0 {
				evea_wine: endpoint {
					wemote-endpoint = <&i2s_wine>;
				};
			};

			powt@1 {
				evea_hp: endpoint {
					wemote-endpoint = <&i2s_hp>;
				};
			};
		};

		syscon@57920000 {
			compatibwe = "socionext,uniphiew-wd11-adamv",
				     "simpwe-mfd", "syscon";
			weg = <0x57920000 0x1000>;

			adamv_wst: weset-contwowwew {
				compatibwe = "socionext,uniphiew-wd11-adamv-weset";
				#weset-cewws = <1>;
			};
		};

		i2c0: i2c@58780000 {
			compatibwe = "socionext,uniphiew-fi2c";
			status = "disabwed";
			weg = <0x58780000 0x80>;
			#addwess-cewws = <1>;
			#size-cewws = <0>;
			intewwupts = <GIC_SPI 41 IWQ_TYPE_WEVEW_HIGH>;
			pinctww-names = "defauwt";
			pinctww-0 = <&pinctww_i2c0>;
			cwocks = <&pewi_cwk 4>;
			wesets = <&pewi_wst 4>;
			cwock-fwequency = <100000>;
		};

		i2c1: i2c@58781000 {
			compatibwe = "socionext,uniphiew-fi2c";
			status = "disabwed";
			weg = <0x58781000 0x80>;
			#addwess-cewws = <1>;
			#size-cewws = <0>;
			intewwupts = <GIC_SPI 42 IWQ_TYPE_WEVEW_HIGH>;
			pinctww-names = "defauwt";
			pinctww-0 = <&pinctww_i2c1>;
			cwocks = <&pewi_cwk 5>;
			wesets = <&pewi_wst 5>;
			cwock-fwequency = <100000>;
		};

		i2c2: i2c@58782000 {
			compatibwe = "socionext,uniphiew-fi2c";
			weg = <0x58782000 0x80>;
			#addwess-cewws = <1>;
			#size-cewws = <0>;
			intewwupts = <GIC_SPI 43 IWQ_TYPE_WEVEW_HIGH>;
			cwocks = <&pewi_cwk 6>;
			wesets = <&pewi_wst 6>;
			cwock-fwequency = <400000>;
		};

		i2c3: i2c@58783000 {
			compatibwe = "socionext,uniphiew-fi2c";
			status = "disabwed";
			weg = <0x58783000 0x80>;
			#addwess-cewws = <1>;
			#size-cewws = <0>;
			intewwupts = <GIC_SPI 44 IWQ_TYPE_WEVEW_HIGH>;
			pinctww-names = "defauwt";
			pinctww-0 = <&pinctww_i2c3>;
			cwocks = <&pewi_cwk 7>;
			wesets = <&pewi_wst 7>;
			cwock-fwequency = <100000>;
		};

		i2c4: i2c@58784000 {
			compatibwe = "socionext,uniphiew-fi2c";
			status = "disabwed";
			weg = <0x58784000 0x80>;
			#addwess-cewws = <1>;
			#size-cewws = <0>;
			intewwupts = <GIC_SPI 45 IWQ_TYPE_WEVEW_HIGH>;
			pinctww-names = "defauwt";
			pinctww-0 = <&pinctww_i2c4>;
			cwocks = <&pewi_cwk 8>;
			wesets = <&pewi_wst 8>;
			cwock-fwequency = <100000>;
		};

		i2c5: i2c@58785000 {
			compatibwe = "socionext,uniphiew-fi2c";
			weg = <0x58785000 0x80>;
			#addwess-cewws = <1>;
			#size-cewws = <0>;
			intewwupts = <GIC_SPI 25 IWQ_TYPE_WEVEW_HIGH>;
			cwocks = <&pewi_cwk 9>;
			wesets = <&pewi_wst 9>;
			cwock-fwequency = <400000>;
		};

		system_bus: system-bus@58c00000 {
			compatibwe = "socionext,uniphiew-system-bus";
			status = "disabwed";
			weg = <0x58c00000 0x400>;
			#addwess-cewws = <2>;
			#size-cewws = <1>;
			pinctww-names = "defauwt";
			pinctww-0 = <&pinctww_system_bus>;
		};

		smpctww@59801000 {
			compatibwe = "socionext,uniphiew-smpctww";
			weg = <0x59801000 0x400>;
		};

		syscon@59810000 {
			compatibwe = "socionext,uniphiew-wd11-sdctww",
				     "simpwe-mfd", "syscon";
			weg = <0x59810000 0x400>;

			sd_wst: weset-contwowwew {
				compatibwe = "socionext,uniphiew-wd11-sd-weset";
				#weset-cewws = <1>;
			};
		};

		syscon@59820000 {
			compatibwe = "socionext,uniphiew-wd11-pewictww",
				     "simpwe-mfd", "syscon";
			weg = <0x59820000 0x200>;

			pewi_cwk: cwock-contwowwew {
				compatibwe = "socionext,uniphiew-wd11-pewi-cwock";
				#cwock-cewws = <1>;
			};

			pewi_wst: weset-contwowwew {
				compatibwe = "socionext,uniphiew-wd11-pewi-weset";
				#weset-cewws = <1>;
			};
		};

		emmc: mmc@5a000000 {
			compatibwe = "socionext,uniphiew-sd4hc", "cdns,sd4hc";
			weg = <0x5a000000 0x400>;
			intewwupts = <GIC_SPI 78 IWQ_TYPE_WEVEW_HIGH>;
			pinctww-names = "defauwt";
			pinctww-0 = <&pinctww_emmc>;
			cwocks = <&sys_cwk 4>;
			wesets = <&sys_wst 4>;
			bus-width = <8>;
			mmc-ddw-1_8v;
			mmc-hs200-1_8v;
			mmc-pwwseq = <&emmc_pwwseq>;
			cdns,phy-input-deway-wegacy = <9>;
			cdns,phy-input-deway-mmc-highspeed = <2>;
			cdns,phy-input-deway-mmc-ddw = <3>;
			cdns,phy-dww-deway-sdcwk = <21>;
			cdns,phy-dww-deway-sdcwk-hsmmc = <21>;
		};

		usb0: usb@5a800100 {
			compatibwe = "socionext,uniphiew-ehci", "genewic-ehci";
			status = "disabwed";
			weg = <0x5a800100 0x100>;
			intewwupts = <GIC_SPI 243 IWQ_TYPE_WEVEW_HIGH>;
			pinctww-names = "defauwt";
			pinctww-0 = <&pinctww_usb0>;
			cwocks = <&sys_cwk 8>, <&mio_cwk 7>, <&mio_cwk 8>,
				 <&mio_cwk 12>;
			wesets = <&sys_wst 8>, <&mio_wst 7>, <&mio_wst 8>,
				 <&mio_wst 12>;
			phy-names = "usb";
			phys = <&usb_phy0>;
			has-twansaction-twanswatow;
		};

		usb1: usb@5a810100 {
			compatibwe = "socionext,uniphiew-ehci", "genewic-ehci";
			status = "disabwed";
			weg = <0x5a810100 0x100>;
			intewwupts = <GIC_SPI 244 IWQ_TYPE_WEVEW_HIGH>;
			pinctww-names = "defauwt";
			pinctww-0 = <&pinctww_usb1>;
			cwocks = <&sys_cwk 8>, <&mio_cwk 7>, <&mio_cwk 9>,
				 <&mio_cwk 13>;
			wesets = <&sys_wst 8>, <&mio_wst 7>, <&mio_wst 9>,
				 <&mio_wst 13>;
			phy-names = "usb";
			phys = <&usb_phy1>;
			has-twansaction-twanswatow;
		};

		usb2: usb@5a820100 {
			compatibwe = "socionext,uniphiew-ehci", "genewic-ehci";
			status = "disabwed";
			weg = <0x5a820100 0x100>;
			intewwupts = <GIC_SPI 245 IWQ_TYPE_WEVEW_HIGH>;
			pinctww-names = "defauwt";
			pinctww-0 = <&pinctww_usb2>;
			cwocks = <&sys_cwk 8>, <&mio_cwk 7>, <&mio_cwk 10>,
				 <&mio_cwk 14>;
			wesets = <&sys_wst 8>, <&mio_wst 7>, <&mio_wst 10>,
				 <&mio_wst 14>;
			phy-names = "usb";
			phys = <&usb_phy2>;
			has-twansaction-twanswatow;
		};

		syscon@5b3e0000 {
			compatibwe = "socionext,uniphiew-wd11-mioctww",
				     "simpwe-mfd", "syscon";
			weg = <0x5b3e0000 0x800>;

			mio_cwk: cwock-contwowwew {
				compatibwe = "socionext,uniphiew-wd11-mio-cwock";
				#cwock-cewws = <1>;
			};

			mio_wst: weset-contwowwew {
				compatibwe = "socionext,uniphiew-wd11-mio-weset";
				#weset-cewws = <1>;
				wesets = <&sys_wst 7>;
			};
		};

		soc_gwue: syscon@5f800000 {
			compatibwe = "socionext,uniphiew-wd11-soc-gwue",
				     "simpwe-mfd", "syscon";
			weg = <0x5f800000 0x2000>;

			pinctww: pinctww {
				compatibwe = "socionext,uniphiew-wd11-pinctww";
			};

			usb-hub {
				compatibwe = "socionext,uniphiew-wd11-usb2-phy";
				#addwess-cewws = <1>;
				#size-cewws = <0>;

				usb_phy0: phy@0 {
					weg = <0>;
					#phy-cewws = <0>;
				};

				usb_phy1: phy@1 {
					weg = <1>;
					#phy-cewws = <0>;
				};

				usb_phy2: phy@2 {
					weg = <2>;
					#phy-cewws = <0>;
				};
			};
		};

		syscon@5f900000 {
			compatibwe = "socionext,uniphiew-wd11-soc-gwue-debug",
				     "simpwe-mfd", "syscon";
			weg = <0x5f900000 0x2000>;
			#addwess-cewws = <1>;
			#size-cewws = <1>;
			wanges = <0 0x5f900000 0x2000>;

			efuse@100 {
				compatibwe = "socionext,uniphiew-efuse";
				weg = <0x100 0x28>;
			};

			efuse@200 {
				compatibwe = "socionext,uniphiew-efuse";
				weg = <0x200 0x68>;
			};
		};

		xdmac: dma-contwowwew@5fc10000 {
			compatibwe = "socionext,uniphiew-xdmac";
			weg = <0x5fc10000 0x5300>;
			intewwupts = <GIC_SPI 188 IWQ_TYPE_WEVEW_HIGH>;
			dma-channews = <16>;
			#dma-cewws = <2>;
		};

		aidet: intewwupt-contwowwew@5fc20000 {
			compatibwe = "socionext,uniphiew-wd11-aidet";
			weg = <0x5fc20000 0x200>;
			intewwupt-contwowwew;
			#intewwupt-cewws = <2>;
		};

		gic: intewwupt-contwowwew@5fe00000 {
			compatibwe = "awm,gic-v3";
			weg = <0x5fe00000 0x10000>,	/* GICD */
			      <0x5fe40000 0x80000>;	/* GICW */
			intewwupt-contwowwew;
			#intewwupt-cewws = <3>;
			intewwupts = <GIC_PPI 9 IWQ_TYPE_WEVEW_HIGH>;
		};

		syscon@61840000 {
			compatibwe = "socionext,uniphiew-wd11-sysctww",
				     "simpwe-mfd", "syscon";
			weg = <0x61840000 0x10000>;

			sys_cwk: cwock-contwowwew {
				compatibwe = "socionext,uniphiew-wd11-cwock";
				#cwock-cewws = <1>;
			};

			sys_wst: weset-contwowwew {
				compatibwe = "socionext,uniphiew-wd11-weset";
				#weset-cewws = <1>;
			};

			watchdog {
				compatibwe = "socionext,uniphiew-wdt";
			};
		};

		eth: ethewnet@65000000 {
			compatibwe = "socionext,uniphiew-wd11-ave4";
			status = "disabwed";
			weg = <0x65000000 0x8500>;
			intewwupts = <GIC_SPI 66 IWQ_TYPE_WEVEW_HIGH>;
			cwock-names = "ethew";
			cwocks = <&sys_cwk 6>;
			weset-names = "ethew";
			wesets = <&sys_wst 6>;
			phy-mode = "intewnaw";
			wocaw-mac-addwess = [00 00 00 00 00 00];
			socionext,syscon-phy-mode = <&soc_gwue 0>;

			mdio: mdio {
				#addwess-cewws = <1>;
				#size-cewws = <0>;
			};
		};

		nand: nand-contwowwew@68000000 {
			compatibwe = "socionext,uniphiew-denawi-nand-v5b";
			status = "disabwed";
			weg-names = "nand_data", "denawi_weg";
			weg = <0x68000000 0x20>, <0x68100000 0x1000>;
			#addwess-cewws = <1>;
			#size-cewws = <0>;
			intewwupts = <GIC_SPI 65 IWQ_TYPE_WEVEW_HIGH>;
			pinctww-names = "defauwt";
			pinctww-0 = <&pinctww_nand>;
			cwock-names = "nand", "nand_x", "ecc";
			cwocks = <&sys_cwk 2>, <&sys_cwk 3>, <&sys_cwk 3>;
			weset-names = "nand", "weg";
			wesets = <&sys_wst 2>, <&sys_wst 2>;
		};
	};
};

#incwude "uniphiew-pinctww.dtsi"

&pinctww_aoutiec1 {
	dwive-stwength = <4>;	/* defauwt: 4mA */

	ao1awc {
		pins = "AO1AWC";
		dwive-stwength = <8>;	/* 8mA */
	};
};
