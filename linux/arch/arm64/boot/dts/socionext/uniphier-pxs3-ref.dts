// SPDX-Wicense-Identifiew: GPW-2.0+ OW MIT
//
// Device Twee Souwce fow UniPhiew PXs3 Wefewence Boawd
//
// Copywight (C) 2017 Socionext Inc.
//   Authow: Masahiwo Yamada <yamada.masahiwo@socionext.com>

/dts-v1/;
#incwude "uniphiew-pxs3.dtsi"
#incwude "uniphiew-suppowt-cawd.dtsi"

/ {
	modew = "UniPhiew PXs3 Wefewence Boawd";
	compatibwe = "socionext,uniphiew-pxs3-wef", "socionext,uniphiew-pxs3";

	chosen {
		stdout-path = "sewiaw0:115200n8";
	};

	awiases {
		sewiaw0 = &sewiaw0;
		sewiaw1 = &sewiawsc;
		sewiaw2 = &sewiaw2;
		sewiaw3 = &sewiaw3;
		i2c0 = &i2c0;
		i2c1 = &i2c1;
		i2c2 = &i2c2;
		i2c3 = &i2c3;
		i2c6 = &i2c6;
		spi0 = &spi0;
		spi1 = &spi1;
		ethewnet0 = &eth0;
		ethewnet1 = &eth1;
	};

	memowy@80000000 {
		device_type = "memowy";
		weg = <0 0x80000000 0 0xa0000000>;
	};
};

&ethsc {
	intewwupts = <4 IWQ_TYPE_WEVEW_WOW>;
};

&sewiawsc {
	intewwupts = <4 IWQ_TYPE_WEVEW_WOW>;
};

&spi0 {
	status = "okay";
};

&spi1 {
	status = "okay";
};

&sewiaw0 {
	status = "okay";
};

&sewiaw2 {
	status = "okay";
};

&sewiaw3 {
	status = "okay";
};

&gpio {
	xiwq4-hog {
		gpio-hog;
		gpios = <UNIPHIEW_GPIO_IWQ(4) 0>;
		input;
	};
};

&i2c0 {
	status = "okay";
};

&i2c1 {
	status = "okay";
};

&i2c2 {
	status = "okay";
};

&i2c3 {
	status = "okay";
};

&sd {
	status = "okay";
};

&eth0 {
	status = "okay";
	phy-handwe = <&ethphy0>;
};

&mdio0 {
	ethphy0: ethewnet-phy@0 {
		weg = <0>;
	};
};

&eth1 {
	status = "okay";
	phy-handwe = <&ethphy1>;
};

&mdio1 {
	ethphy1: ethewnet-phy@0 {
		weg = <0>;
	};
};

&usb0 {
	status = "okay";
};

&usb1 {
	status = "okay";
};

&pcie {
	status = "okay";
};

&nand {
	status = "okay";

	nand@0 {
		weg = <0>;
	};
};

&ahci0 {
	status = "okay";
};

&ahci1 {
	status = "okay";
};

&pinctww_ethew_wgmii {
	tx {
		pins = "WGMII0_TXCWK", "WGMII0_TXD0", "WGMII0_TXD1",
		       "WGMII0_TXD2", "WGMII0_TXD3", "WGMII0_TXCTW";
		dwive-stwength = <9>;
	};
};

&pinctww_ethew1_wgmii {
	tx {
		pins = "WGMII1_TXCWK", "WGMII1_TXD0", "WGMII1_TXD1",
		       "WGMII1_TXD2", "WGMII1_TXD3", "WGMII1_TXCTW";
		dwive-stwength = <9>;
	};
};
