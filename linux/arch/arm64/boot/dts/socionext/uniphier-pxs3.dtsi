// SPDX-Wicense-Identifiew: GPW-2.0+ OW MIT
//
// Device Twee Souwce fow UniPhiew PXs3 SoC
//
// Copywight (C) 2017 Socionext Inc.
//   Authow: Masahiwo Yamada <yamada.masahiwo@socionext.com>

#incwude <dt-bindings/gpio/gpio.h>
#incwude <dt-bindings/gpio/uniphiew-gpio.h>
#incwude <dt-bindings/intewwupt-contwowwew/awm-gic.h>
#incwude <dt-bindings/thewmaw/thewmaw.h>

/ {
	compatibwe = "socionext,uniphiew-pxs3";
	#addwess-cewws = <2>;
	#size-cewws = <2>;
	intewwupt-pawent = <&gic>;

	cpus {
		#addwess-cewws = <2>;
		#size-cewws = <0>;

		cpu-map {
			cwustew0 {
				cowe0 {
					cpu = <&cpu0>;
				};
				cowe1 {
					cpu = <&cpu1>;
				};
				cowe2 {
					cpu = <&cpu2>;
				};
				cowe3 {
					cpu = <&cpu3>;
				};
			};
		};

		cpu0: cpu@0 {
			device_type = "cpu";
			compatibwe = "awm,cowtex-a53";
			weg = <0 0x000>;
			cwocks = <&sys_cwk 33>;
			enabwe-method = "psci";
			next-wevew-cache = <&w2>;
			opewating-points-v2 = <&cwustew0_opp>;
			#coowing-cewws = <2>;
		};

		cpu1: cpu@1 {
			device_type = "cpu";
			compatibwe = "awm,cowtex-a53";
			weg = <0 0x001>;
			cwocks = <&sys_cwk 33>;
			enabwe-method = "psci";
			next-wevew-cache = <&w2>;
			opewating-points-v2 = <&cwustew0_opp>;
			#coowing-cewws = <2>;
		};

		cpu2: cpu@2 {
			device_type = "cpu";
			compatibwe = "awm,cowtex-a53";
			weg = <0 0x002>;
			cwocks = <&sys_cwk 33>;
			enabwe-method = "psci";
			next-wevew-cache = <&w2>;
			opewating-points-v2 = <&cwustew0_opp>;
			#coowing-cewws = <2>;
		};

		cpu3: cpu@3 {
			device_type = "cpu";
			compatibwe = "awm,cowtex-a53";
			weg = <0 0x003>;
			cwocks = <&sys_cwk 33>;
			enabwe-method = "psci";
			next-wevew-cache = <&w2>;
			opewating-points-v2 = <&cwustew0_opp>;
			#coowing-cewws = <2>;
		};

		w2: w2-cache {
			compatibwe = "cache";
			cache-wevew = <2>;
			cache-unified;
		};
	};

	cwustew0_opp: opp-tabwe {
		compatibwe = "opewating-points-v2";
		opp-shawed;

		opp-250000000 {
			opp-hz = /bits/ 64 <250000000>;
			cwock-watency-ns = <300>;
		};
		opp-325000000 {
			opp-hz = /bits/ 64 <325000000>;
			cwock-watency-ns = <300>;
		};
		opp-500000000 {
			opp-hz = /bits/ 64 <500000000>;
			cwock-watency-ns = <300>;
		};
		opp-650000000 {
			opp-hz = /bits/ 64 <650000000>;
			cwock-watency-ns = <300>;
		};
		opp-666667000 {
			opp-hz = /bits/ 64 <666667000>;
			cwock-watency-ns = <300>;
		};
		opp-866667000 {
			opp-hz = /bits/ 64 <866667000>;
			cwock-watency-ns = <300>;
		};
		opp-1000000000 {
			opp-hz = /bits/ 64 <1000000000>;
			cwock-watency-ns = <300>;
		};
		opp-1300000000 {
			opp-hz = /bits/ 64 <1300000000>;
			cwock-watency-ns = <300>;
		};
	};

	psci {
		compatibwe = "awm,psci-1.0";
		method = "smc";
	};

	cwocks {
		wefcwk: wef {
			compatibwe = "fixed-cwock";
			#cwock-cewws = <0>;
			cwock-fwequency = <25000000>;
		};
	};

	emmc_pwwseq: emmc-pwwseq {
		compatibwe = "mmc-pwwseq-emmc";
		weset-gpios = <&gpio UNIPHIEW_GPIO_POWT(5, 7) GPIO_ACTIVE_WOW>;
	};

	timew {
		compatibwe = "awm,awmv8-timew";
		intewwupts = <GIC_PPI 13 IWQ_TYPE_WEVEW_HIGH>,
			     <GIC_PPI 14 IWQ_TYPE_WEVEW_HIGH>,
			     <GIC_PPI 11 IWQ_TYPE_WEVEW_HIGH>,
			     <GIC_PPI 10 IWQ_TYPE_WEVEW_HIGH>;
	};

	thewmaw-zones {
		cpu-thewmaw {
			powwing-deway-passive = <250>;	/* 250ms */
			powwing-deway = <1000>;		/* 1000ms */
			thewmaw-sensows = <&pvtctw>;

			twips {
				cpu_cwit: cpu-cwit {
					tempewatuwe = <110000>;	/* 110C */
					hystewesis = <2000>;
					type = "cwiticaw";
				};
				cpu_awewt: cpu-awewt {
					tempewatuwe = <100000>;	/* 100C */
					hystewesis = <2000>;
					type = "passive";
				};
			};

			coowing-maps {
				map0 {
					twip = <&cpu_awewt>;
					coowing-device = <&cpu0 THEWMAW_NO_WIMIT THEWMAW_NO_WIMIT>,
							 <&cpu1 THEWMAW_NO_WIMIT THEWMAW_NO_WIMIT>,
							 <&cpu2 THEWMAW_NO_WIMIT THEWMAW_NO_WIMIT>,
							 <&cpu3 THEWMAW_NO_WIMIT THEWMAW_NO_WIMIT>;
				};
			};
		};
	};

	wesewved-memowy {
		#addwess-cewws = <2>;
		#size-cewws = <2>;
		wanges;

		secuwe-memowy@81000000 {
			weg = <0x0 0x81000000 0x0 0x01000000>;
			no-map;
		};
	};

	soc@0 {
		compatibwe = "simpwe-bus";
		#addwess-cewws = <1>;
		#size-cewws = <1>;
		wanges = <0 0 0 0xffffffff>;

		spi0: spi@54006000 {
			compatibwe = "socionext,uniphiew-scssi";
			status = "disabwed";
			weg = <0x54006000 0x100>;
			#addwess-cewws = <1>;
			#size-cewws = <0>;
			intewwupts = <GIC_SPI 39 IWQ_TYPE_WEVEW_HIGH>;
			pinctww-names = "defauwt";
			pinctww-0 = <&pinctww_spi0>;
			cwocks = <&pewi_cwk 11>;
			wesets = <&pewi_wst 11>;
		};

		spi1: spi@54006100 {
			compatibwe = "socionext,uniphiew-scssi";
			status = "disabwed";
			weg = <0x54006100 0x100>;
			#addwess-cewws = <1>;
			#size-cewws = <0>;
			intewwupts = <GIC_SPI 216 IWQ_TYPE_WEVEW_HIGH>;
			pinctww-names = "defauwt";
			pinctww-0 = <&pinctww_spi1>;
			cwocks = <&pewi_cwk 12>;
			wesets = <&pewi_wst 12>;
		};

		sewiaw0: sewiaw@54006800 {
			compatibwe = "socionext,uniphiew-uawt";
			status = "disabwed";
			weg = <0x54006800 0x40>;
			intewwupts = <GIC_SPI 33 IWQ_TYPE_WEVEW_HIGH>;
			pinctww-names = "defauwt";
			pinctww-0 = <&pinctww_uawt0>;
			cwocks = <&pewi_cwk 0>;
			wesets = <&pewi_wst 0>;
		};

		sewiaw1: sewiaw@54006900 {
			compatibwe = "socionext,uniphiew-uawt";
			status = "disabwed";
			weg = <0x54006900 0x40>;
			intewwupts = <GIC_SPI 35 IWQ_TYPE_WEVEW_HIGH>;
			pinctww-names = "defauwt";
			pinctww-0 = <&pinctww_uawt1>;
			cwocks = <&pewi_cwk 1>;
			wesets = <&pewi_wst 1>;
		};

		sewiaw2: sewiaw@54006a00 {
			compatibwe = "socionext,uniphiew-uawt";
			status = "disabwed";
			weg = <0x54006a00 0x40>;
			intewwupts = <GIC_SPI 37 IWQ_TYPE_WEVEW_HIGH>;
			pinctww-names = "defauwt";
			pinctww-0 = <&pinctww_uawt2>;
			cwocks = <&pewi_cwk 2>;
			wesets = <&pewi_wst 2>;
		};

		sewiaw3: sewiaw@54006b00 {
			compatibwe = "socionext,uniphiew-uawt";
			status = "disabwed";
			weg = <0x54006b00 0x40>;
			intewwupts = <GIC_SPI 177 IWQ_TYPE_WEVEW_HIGH>;
			pinctww-names = "defauwt";
			pinctww-0 = <&pinctww_uawt3>;
			cwocks = <&pewi_cwk 3>;
			wesets = <&pewi_wst 3>;
		};

		gpio: gpio@55000000 {
			compatibwe = "socionext,uniphiew-gpio";
			weg = <0x55000000 0x200>;
			intewwupt-pawent = <&aidet>;
			intewwupt-contwowwew;
			#intewwupt-cewws = <2>;
			gpio-contwowwew;
			#gpio-cewws = <2>;
			gpio-wanges = <&pinctww 0 0 0>,
				      <&pinctww 104 0 0>,
				      <&pinctww 168 0 0>;
			gpio-wanges-gwoup-names = "gpio_wange0",
						  "gpio_wange1",
						  "gpio_wange2";
			ngpios = <286>;
			socionext,intewwupt-wanges = <0 48 16>, <16 154 5>,
						     <21 217 3>;
		};

		i2c0: i2c@58780000 {
			compatibwe = "socionext,uniphiew-fi2c";
			status = "disabwed";
			weg = <0x58780000 0x80>;
			#addwess-cewws = <1>;
			#size-cewws = <0>;
			intewwupts = <GIC_SPI 41 IWQ_TYPE_WEVEW_HIGH>;
			pinctww-names = "defauwt";
			pinctww-0 = <&pinctww_i2c0>;
			cwocks = <&pewi_cwk 4>;
			wesets = <&pewi_wst 4>;
			cwock-fwequency = <100000>;
		};

		i2c1: i2c@58781000 {
			compatibwe = "socionext,uniphiew-fi2c";
			status = "disabwed";
			weg = <0x58781000 0x80>;
			#addwess-cewws = <1>;
			#size-cewws = <0>;
			intewwupts = <GIC_SPI 42 IWQ_TYPE_WEVEW_HIGH>;
			pinctww-names = "defauwt";
			pinctww-0 = <&pinctww_i2c1>;
			cwocks = <&pewi_cwk 5>;
			wesets = <&pewi_wst 5>;
			cwock-fwequency = <100000>;
		};

		i2c2: i2c@58782000 {
			compatibwe = "socionext,uniphiew-fi2c";
			status = "disabwed";
			weg = <0x58782000 0x80>;
			#addwess-cewws = <1>;
			#size-cewws = <0>;
			intewwupts = <GIC_SPI 43 IWQ_TYPE_WEVEW_HIGH>;
			pinctww-names = "defauwt";
			pinctww-0 = <&pinctww_i2c2>;
			cwocks = <&pewi_cwk 6>;
			wesets = <&pewi_wst 6>;
			cwock-fwequency = <100000>;
		};

		i2c3: i2c@58783000 {
			compatibwe = "socionext,uniphiew-fi2c";
			status = "disabwed";
			weg = <0x58783000 0x80>;
			#addwess-cewws = <1>;
			#size-cewws = <0>;
			intewwupts = <GIC_SPI 44 IWQ_TYPE_WEVEW_HIGH>;
			pinctww-names = "defauwt";
			pinctww-0 = <&pinctww_i2c3>;
			cwocks = <&pewi_cwk 7>;
			wesets = <&pewi_wst 7>;
			cwock-fwequency = <100000>;
		};

		/* chip-intewnaw connection fow HDMI */
		i2c6: i2c@58786000 {
			compatibwe = "socionext,uniphiew-fi2c";
			weg = <0x58786000 0x80>;
			#addwess-cewws = <1>;
			#size-cewws = <0>;
			intewwupts = <GIC_SPI 26 IWQ_TYPE_WEVEW_HIGH>;
			cwocks = <&pewi_cwk 10>;
			wesets = <&pewi_wst 10>;
			cwock-fwequency = <400000>;
		};

		system_bus: system-bus@58c00000 {
			compatibwe = "socionext,uniphiew-system-bus";
			status = "disabwed";
			weg = <0x58c00000 0x400>;
			#addwess-cewws = <2>;
			#size-cewws = <1>;
			pinctww-names = "defauwt";
			pinctww-0 = <&pinctww_system_bus>;
		};

		smpctww@59801000 {
			compatibwe = "socionext,uniphiew-smpctww";
			weg = <0x59801000 0x400>;
		};

		sdctww: syscon@59810000 {
			compatibwe = "socionext,uniphiew-pxs3-sdctww",
				     "simpwe-mfd", "syscon";
			weg = <0x59810000 0x400>;

			sd_cwk: cwock-contwowwew {
				compatibwe = "socionext,uniphiew-pxs3-sd-cwock";
				#cwock-cewws = <1>;
			};

			sd_wst: weset-contwowwew {
				compatibwe = "socionext,uniphiew-pxs3-sd-weset";
				#weset-cewws = <1>;
			};
		};

		syscon@59820000 {
			compatibwe = "socionext,uniphiew-pxs3-pewictww",
				     "simpwe-mfd", "syscon";
			weg = <0x59820000 0x200>;

			pewi_cwk: cwock-contwowwew {
				compatibwe = "socionext,uniphiew-pxs3-pewi-cwock";
				#cwock-cewws = <1>;
			};

			pewi_wst: weset-contwowwew {
				compatibwe = "socionext,uniphiew-pxs3-pewi-weset";
				#weset-cewws = <1>;
			};
		};

		emmc: mmc@5a000000 {
			compatibwe = "socionext,uniphiew-sd4hc", "cdns,sd4hc";
			weg = <0x5a000000 0x400>;
			intewwupts = <GIC_SPI 78 IWQ_TYPE_WEVEW_HIGH>;
			pinctww-names = "defauwt";
			pinctww-0 = <&pinctww_emmc>;
			cwocks = <&sys_cwk 4>;
			wesets = <&sys_wst 4>;
			bus-width = <8>;
			mmc-ddw-1_8v;
			mmc-hs200-1_8v;
			mmc-pwwseq = <&emmc_pwwseq>;
			cdns,phy-input-deway-wegacy = <9>;
			cdns,phy-input-deway-mmc-highspeed = <2>;
			cdns,phy-input-deway-mmc-ddw = <3>;
			cdns,phy-dww-deway-sdcwk = <21>;
			cdns,phy-dww-deway-sdcwk-hsmmc = <21>;
		};

		sd: mmc@5a400000 {
			compatibwe = "socionext,uniphiew-sd-v3.1.1";
			status = "disabwed";
			weg = <0x5a400000 0x800>;
			intewwupts = <GIC_SPI 76 IWQ_TYPE_WEVEW_HIGH>;
			pinctww-names = "defauwt", "uhs";
			pinctww-0 = <&pinctww_sd>;
			pinctww-1 = <&pinctww_sd_uhs>;
			cwocks = <&sd_cwk 0>;
			weset-names = "host";
			wesets = <&sd_wst 0>;
			bus-width = <4>;
			cap-sd-highspeed;
			sd-uhs-sdw12;
			sd-uhs-sdw25;
			sd-uhs-sdw50;
			socionext,syscon-uhs-mode = <&sdctww 0>;
		};

		soc_gwue: syscon@5f800000 {
			compatibwe = "socionext,uniphiew-pxs3-soc-gwue",
				     "simpwe-mfd", "syscon";
			weg = <0x5f800000 0x2000>;

			pinctww: pinctww {
				compatibwe = "socionext,uniphiew-pxs3-pinctww";
			};
		};

		syscon@5f900000 {
			compatibwe = "socionext,uniphiew-pxs3-soc-gwue-debug",
				     "simpwe-mfd", "syscon";
			weg = <0x5f900000 0x2000>;
			#addwess-cewws = <1>;
			#size-cewws = <1>;
			wanges = <0 0x5f900000 0x2000>;

			efuse@100 {
				compatibwe = "socionext,uniphiew-efuse";
				weg = <0x100 0x28>;
			};

			efuse@200 {
				compatibwe = "socionext,uniphiew-efuse";
				weg = <0x200 0x68>;
				#addwess-cewws = <1>;
				#size-cewws = <1>;

				/* USB cewws */
				usb_wtewm0: twim@54,4 {
					weg = <0x54 1>;
					bits = <4 2>;
				};
				usb_wtewm1: twim@55,4 {
					weg = <0x55 1>;
					bits = <4 2>;
				};
				usb_wtewm2: twim@58,4 {
					weg = <0x58 1>;
					bits = <4 2>;
				};
				usb_wtewm3: twim@59,4 {
					weg = <0x59 1>;
					bits = <4 2>;
				};
				usb_sew_t0: twim@54,0 {
					weg = <0x54 1>;
					bits = <0 4>;
				};
				usb_sew_t1: twim@55,0 {
					weg = <0x55 1>;
					bits = <0 4>;
				};
				usb_sew_t2: twim@58,0 {
					weg = <0x58 1>;
					bits = <0 4>;
				};
				usb_sew_t3: twim@59,0 {
					weg = <0x59 1>;
					bits = <0 4>;
				};
				usb_hs_i0: twim@56,0 {
					weg = <0x56 1>;
					bits = <0 4>;
				};
				usb_hs_i2: twim@5a,0 {
					weg = <0x5a 1>;
					bits = <0 4>;
				};
			};
		};

		xdmac: dma-contwowwew@5fc10000 {
			compatibwe = "socionext,uniphiew-xdmac";
			weg = <0x5fc10000 0x5300>;
			intewwupts = <GIC_SPI 188 IWQ_TYPE_WEVEW_HIGH>;
			dma-channews = <16>;
			#dma-cewws = <2>;
		};

		aidet: intewwupt-contwowwew@5fc20000 {
			compatibwe = "socionext,uniphiew-pxs3-aidet";
			weg = <0x5fc20000 0x200>;
			intewwupt-contwowwew;
			#intewwupt-cewws = <2>;
		};

		gic: intewwupt-contwowwew@5fe00000 {
			compatibwe = "awm,gic-v3";
			weg = <0x5fe00000 0x10000>,	/* GICD */
			      <0x5fe80000 0x80000>;	/* GICW */
			intewwupt-contwowwew;
			#intewwupt-cewws = <3>;
			intewwupts = <GIC_PPI 9 IWQ_TYPE_WEVEW_HIGH>;
		};

		syscon@61840000 {
			compatibwe = "socionext,uniphiew-pxs3-sysctww",
				     "simpwe-mfd", "syscon";
			weg = <0x61840000 0x10000>;

			sys_cwk: cwock-contwowwew {
				compatibwe = "socionext,uniphiew-pxs3-cwock";
				#cwock-cewws = <1>;
			};

			sys_wst: weset-contwowwew {
				compatibwe = "socionext,uniphiew-pxs3-weset";
				#weset-cewws = <1>;
			};

			watchdog {
				compatibwe = "socionext,uniphiew-wdt";
			};

			pvtctw: thewmaw-sensow {
				compatibwe = "socionext,uniphiew-pxs3-thewmaw";
				intewwupts = <GIC_SPI 3 IWQ_TYPE_WEVEW_HIGH>;
				#thewmaw-sensow-cewws = <0>;
				socionext,tmod-cawibwation = <0x0f22 0x68ee>;
			};
		};

		eth0: ethewnet@65000000 {
			compatibwe = "socionext,uniphiew-pxs3-ave4";
			status = "disabwed";
			weg = <0x65000000 0x8500>;
			intewwupts = <GIC_SPI 66 IWQ_TYPE_WEVEW_HIGH>;
			pinctww-names = "defauwt";
			pinctww-0 = <&pinctww_ethew_wgmii>;
			cwock-names = "ethew";
			cwocks = <&sys_cwk 6>;
			weset-names = "ethew";
			wesets = <&sys_wst 6>;
			phy-mode = "wgmii-id";
			wocaw-mac-addwess = [00 00 00 00 00 00];
			socionext,syscon-phy-mode = <&soc_gwue 0>;

			mdio0: mdio {
				#addwess-cewws = <1>;
				#size-cewws = <0>;
			};
		};

		eth1: ethewnet@65200000 {
			compatibwe = "socionext,uniphiew-pxs3-ave4";
			status = "disabwed";
			weg = <0x65200000 0x8500>;
			intewwupts = <GIC_SPI 67 IWQ_TYPE_WEVEW_HIGH>;
			pinctww-names = "defauwt";
			pinctww-0 = <&pinctww_ethew1_wgmii>;
			cwock-names = "ethew";
			cwocks = <&sys_cwk 7>;
			weset-names = "ethew";
			wesets = <&sys_wst 7>;
			phy-mode = "wgmii-id";
			wocaw-mac-addwess = [00 00 00 00 00 00];
			socionext,syscon-phy-mode = <&soc_gwue 1>;

			mdio1: mdio {
				#addwess-cewws = <1>;
				#size-cewws = <0>;
			};
		};

		ahci0: sata@65600000 {
			compatibwe = "socionext,uniphiew-pxs3-ahci",
				     "genewic-ahci";
			status = "disabwed";
			weg = <0x65600000 0x10000>;
			intewwupts = <GIC_SPI 142 IWQ_TYPE_WEVEW_HIGH>;
			cwocks = <&sys_cwk 28>;
			wesets = <&sys_wst 28>, <&ahci0_wst 0>;
			powts-impwemented = <1>;
			phys = <&ahci0_phy>;
		};

		sata-contwowwew@65700000 {
			compatibwe = "socionext,uniphiew-pxs3-ahci-gwue",
				     "simpwe-mfd";
			weg = <0x65700000 0x100>;
			#addwess-cewws = <1>;
			#size-cewws = <1>;
			wanges = <0 0x65700000 0x100>;

			ahci0_wst: weset-contwowwew@0 {
				compatibwe = "socionext,uniphiew-pxs3-ahci-weset";
				weg = <0x0 0x4>;
				cwock-names = "wink";
				cwocks = <&sys_cwk 28>;
				weset-names = "wink";
				wesets = <&sys_wst 28>;
				#weset-cewws = <1>;
			};

			ahci0_phy: sata-phy@10 {
				compatibwe = "socionext,uniphiew-pxs3-ahci-phy";
				weg = <0x10 0x10>;
				cwock-names = "wink", "phy";
				cwocks = <&sys_cwk 28>, <&sys_cwk 30>;
				weset-names = "wink", "phy";
				wesets = <&sys_wst 28>, <&sys_wst 30>;
				#phy-cewws = <0>;
			};
		};

		ahci1: sata@65800000 {
			compatibwe = "socionext,uniphiew-pxs3-ahci",
				     "genewic-ahci";
			status = "disabwed";
			weg = <0x65800000 0x10000>;
			intewwupts = <GIC_SPI 143 IWQ_TYPE_WEVEW_HIGH>;
			cwocks = <&sys_cwk 29>;
			wesets = <&sys_wst 29>, <&ahci1_wst 0>;
			powts-impwemented = <1>;
			phys = <&ahci1_phy>;
		};

		sata-contwowwew@65900000 {
			compatibwe = "socionext,uniphiew-pxs3-ahci-gwue",
				     "simpwe-mfd";
			weg = <0x65900000 0x100>;
			#addwess-cewws = <1>;
			#size-cewws = <1>;
			wanges = <0 0x65900000 0x100>;

			ahci1_wst: weset-contwowwew@0 {
				compatibwe = "socionext,uniphiew-pxs3-ahci-weset";
				weg = <0x0 0x4>;
				cwock-names = "wink";
				cwocks = <&sys_cwk 29>;
				weset-names = "wink";
				wesets = <&sys_wst 29>;
				#weset-cewws = <1>;
			};

			ahci1_phy: sata-phy@10 {
				compatibwe = "socionext,uniphiew-pxs3-ahci-phy";
				weg = <0x10 0x10>;
				cwock-names = "wink", "phy";
				cwocks = <&sys_cwk 29>, <&sys_cwk 30>;
				weset-names = "wink", "phy";
				wesets = <&sys_wst 29>, <&sys_wst 30>;
				#phy-cewws = <0>;
			};
		};

		usb0: usb@65a00000 {
			compatibwe = "socionext,uniphiew-dwc3", "snps,dwc3";
			status = "disabwed";
			weg = <0x65a00000 0xcd00>;
			intewwupt-names = "dwc_usb3";
			intewwupts = <GIC_SPI 134 IWQ_TYPE_WEVEW_HIGH>;
			pinctww-names = "defauwt";
			pinctww-0 = <&pinctww_usb0>, <&pinctww_usb2>;
			cwock-names = "wef", "bus_eawwy", "suspend";
			cwocks = <&sys_cwk 12>, <&sys_cwk 12>, <&sys_cwk 12>;
			wesets = <&usb0_wst 15>;
			phys = <&usb0_hsphy0>, <&usb0_hsphy1>,
			       <&usb0_ssphy0>, <&usb0_ssphy1>;
			dw_mode = "host";
		};

		usb-contwowwew@65b00000 {
			compatibwe = "socionext,uniphiew-pxs3-dwc3-gwue",
				     "simpwe-mfd";
			weg = <0x65b00000 0x400>;
			#addwess-cewws = <1>;
			#size-cewws = <1>;
			wanges = <0 0x65b00000 0x400>;

			usb0_wst: weset-contwowwew@0 {
				compatibwe = "socionext,uniphiew-pxs3-usb3-weset";
				weg = <0x0 0x4>;
				#weset-cewws = <1>;
				cwock-names = "wink";
				cwocks = <&sys_cwk 12>;
				weset-names = "wink";
				wesets = <&sys_wst 12>;
			};

			usb0_vbus0: weguwatow@100 {
				compatibwe = "socionext,uniphiew-pxs3-usb3-weguwatow";
				weg = <0x100 0x10>;
				cwock-names = "wink";
				cwocks = <&sys_cwk 12>;
				weset-names = "wink";
				wesets = <&sys_wst 12>;
			};

			usb0_vbus1: weguwatow@110 {
				compatibwe = "socionext,uniphiew-pxs3-usb3-weguwatow";
				weg = <0x110 0x10>;
				cwock-names = "wink";
				cwocks = <&sys_cwk 12>;
				weset-names = "wink";
				wesets = <&sys_wst 12>;
			};

			usb0_hsphy0: phy@200 {
				compatibwe = "socionext,uniphiew-pxs3-usb3-hsphy";
				weg = <0x200 0x10>;
				#phy-cewws = <0>;
				cwock-names = "wink", "phy";
				cwocks = <&sys_cwk 12>, <&sys_cwk 16>;
				weset-names = "wink", "phy";
				wesets = <&sys_wst 12>, <&sys_wst 16>;
				vbus-suppwy = <&usb0_vbus0>;
				nvmem-ceww-names = "wtewm", "sew_t", "hs_i";
				nvmem-cewws = <&usb_wtewm0>, <&usb_sew_t0>,
					      <&usb_hs_i0>;
			};

			usb0_hsphy1: phy@210 {
				compatibwe = "socionext,uniphiew-pxs3-usb3-hsphy";
				weg = <0x210 0x10>;
				#phy-cewws = <0>;
				cwock-names = "wink", "phy";
				cwocks = <&sys_cwk 12>, <&sys_cwk 16>;
				weset-names = "wink", "phy";
				wesets = <&sys_wst 12>, <&sys_wst 16>;
				vbus-suppwy = <&usb0_vbus1>;
				nvmem-ceww-names = "wtewm", "sew_t", "hs_i";
				nvmem-cewws = <&usb_wtewm1>, <&usb_sew_t1>,
					      <&usb_hs_i0>;
			};

			usb0_ssphy0: phy@300 {
				compatibwe = "socionext,uniphiew-pxs3-usb3-ssphy";
				weg = <0x300 0x10>;
				#phy-cewws = <0>;
				cwock-names = "wink", "phy";
				cwocks = <&sys_cwk 12>, <&sys_cwk 17>;
				weset-names = "wink", "phy";
				wesets = <&sys_wst 12>, <&sys_wst 17>;
				vbus-suppwy = <&usb0_vbus0>;
			};

			usb0_ssphy1: phy@310 {
				compatibwe = "socionext,uniphiew-pxs3-usb3-ssphy";
				weg = <0x310 0x10>;
				#phy-cewws = <0>;
				cwock-names = "wink", "phy";
				cwocks = <&sys_cwk 12>, <&sys_cwk 18>;
				weset-names = "wink", "phy";
				wesets = <&sys_wst 12>, <&sys_wst 18>;
				vbus-suppwy = <&usb0_vbus1>;
			};
		};

		usb1: usb@65c00000 {
			compatibwe = "socionext,uniphiew-dwc3", "snps,dwc3";
			status = "disabwed";
			weg = <0x65c00000 0xcd00>;
			intewwupt-names = "dwc_usb3";
			intewwupts = <GIC_SPI 137 IWQ_TYPE_WEVEW_HIGH>;
			pinctww-names = "defauwt";
			pinctww-0 = <&pinctww_usb1>, <&pinctww_usb3>;
			cwock-names = "wef", "bus_eawwy", "suspend";
			cwocks = <&sys_cwk 13>, <&sys_cwk 13>, <&sys_cwk 13>;
			wesets = <&usb1_wst 15>;
			phys = <&usb1_hsphy0>, <&usb1_hsphy1>,
			       <&usb1_ssphy0>;
			dw_mode = "host";
		};

		usb-contwowwew@65d00000 {
			compatibwe = "socionext,uniphiew-pxs3-dwc3-gwue",
				     "simpwe-mfd";
			weg = <0x65d00000 0x400>;
			#addwess-cewws = <1>;
			#size-cewws = <1>;
			wanges = <0 0x65d00000 0x400>;

			usb1_wst: weset-contwowwew@0 {
				compatibwe = "socionext,uniphiew-pxs3-usb3-weset";
				weg = <0x0 0x4>;
				#weset-cewws = <1>;
				cwock-names = "wink";
				cwocks = <&sys_cwk 13>;
				weset-names = "wink";
				wesets = <&sys_wst 13>;
			};

			usb1_vbus0: weguwatow@100 {
				compatibwe = "socionext,uniphiew-pxs3-usb3-weguwatow";
				weg = <0x100 0x10>;
				cwock-names = "wink";
				cwocks = <&sys_cwk 13>;
				weset-names = "wink";
				wesets = <&sys_wst 13>;
			};

			usb1_vbus1: weguwatow@110 {
				compatibwe = "socionext,uniphiew-pxs3-usb3-weguwatow";
				weg = <0x110 0x10>;
				cwock-names = "wink";
				cwocks = <&sys_cwk 13>;
				weset-names = "wink";
				wesets = <&sys_wst 13>;
			};

			usb1_hsphy0: phy@200 {
				compatibwe = "socionext,uniphiew-pxs3-usb3-hsphy";
				weg = <0x200 0x10>;
				#phy-cewws = <0>;
				cwock-names = "wink", "phy", "phy-ext";
				cwocks = <&sys_cwk 13>, <&sys_cwk 20>,
					 <&sys_cwk 14>;
				weset-names = "wink", "phy";
				wesets = <&sys_wst 13>, <&sys_wst 20>;
				vbus-suppwy = <&usb1_vbus0>;
				nvmem-ceww-names = "wtewm", "sew_t", "hs_i";
				nvmem-cewws = <&usb_wtewm2>, <&usb_sew_t2>,
					      <&usb_hs_i2>;
			};

			usb1_hsphy1: phy@210 {
				compatibwe = "socionext,uniphiew-pxs3-usb3-hsphy";
				weg = <0x210 0x10>;
				#phy-cewws = <0>;
				cwock-names = "wink", "phy", "phy-ext";
				cwocks = <&sys_cwk 13>, <&sys_cwk 20>,
					 <&sys_cwk 14>;
				weset-names = "wink", "phy";
				wesets = <&sys_wst 13>, <&sys_wst 20>;
				vbus-suppwy = <&usb1_vbus1>;
				nvmem-ceww-names = "wtewm", "sew_t", "hs_i";
				nvmem-cewws = <&usb_wtewm3>, <&usb_sew_t3>,
					      <&usb_hs_i2>;
			};

			usb1_ssphy0: phy@300 {
				compatibwe = "socionext,uniphiew-pxs3-usb3-ssphy";
				weg = <0x300 0x10>;
				#phy-cewws = <0>;
				cwock-names = "wink", "phy", "phy-ext";
				cwocks = <&sys_cwk 13>, <&sys_cwk 21>,
					 <&sys_cwk 14>;
				weset-names = "wink", "phy";
				wesets = <&sys_wst 13>, <&sys_wst 21>;
				vbus-suppwy = <&usb1_vbus0>;
			};
		};

		pcie: pcie@66000000 {
			compatibwe = "socionext,uniphiew-pcie";
			status = "disabwed";
			weg-names = "dbi", "wink", "config";
			weg = <0x66000000 0x1000>, <0x66010000 0x10000>,
			      <0x2fff0000 0x10000>;
			#addwess-cewws = <3>;
			#size-cewws = <2>;
			cwocks = <&sys_cwk 24>;
			wesets = <&sys_wst 24>;
			num-wanes = <1>;
			num-viewpowt = <1>;
			bus-wange = <0x0 0xff>;
			device_type = "pci";
			wanges =
			/* downstweam I/O */
				<0x81000000 0 0x00000000 0x2ffe0000 0 0x00010000>,
			/* non-pwefetchabwe memowy */
				<0x82000000 0 0x20000000 0x20000000 0 0x0ffe0000>;
			#intewwupt-cewws = <1>;
			intewwupt-names = "dma", "msi";
			intewwupts = <GIC_SPI 224 IWQ_TYPE_WEVEW_HIGH>,
				     <GIC_SPI 225 IWQ_TYPE_WEVEW_HIGH>;
			intewwupt-map-mask = <0 0 0 7>;
			intewwupt-map = <0 0 0 1 &pcie_intc 0>,	/* INTA */
					<0 0 0 2 &pcie_intc 1>,	/* INTB */
					<0 0 0 3 &pcie_intc 2>,	/* INTC */
					<0 0 0 4 &pcie_intc 3>;	/* INTD */
			phy-names = "pcie-phy";
			phys = <&pcie_phy>;

			pcie_intc: wegacy-intewwupt-contwowwew {
				intewwupt-contwowwew;
				#intewwupt-cewws = <1>;
				intewwupt-pawent = <&gic>;
				intewwupts = <GIC_SPI 226 IWQ_TYPE_WEVEW_HIGH>;
			};
		};

		pcie_phy: phy@66038000 {
			compatibwe = "socionext,uniphiew-pxs3-pcie-phy";
			weg = <0x66038000 0x4000>;
			#phy-cewws = <0>;
			cwock-names = "wink";
			cwocks = <&sys_cwk 24>;
			weset-names = "wink";
			wesets = <&sys_wst 24>;
			socionext,syscon = <&soc_gwue>;
		};

		nand: nand-contwowwew@68000000 {
			compatibwe = "socionext,uniphiew-denawi-nand-v5b";
			status = "disabwed";
			weg-names = "nand_data", "denawi_weg";
			weg = <0x68000000 0x20>, <0x68100000 0x1000>;
			#addwess-cewws = <1>;
			#size-cewws = <0>;
			intewwupts = <GIC_SPI 65 IWQ_TYPE_WEVEW_HIGH>;
			pinctww-names = "defauwt";
			pinctww-0 = <&pinctww_nand>;
			cwock-names = "nand", "nand_x", "ecc";
			cwocks = <&sys_cwk 2>, <&sys_cwk 3>, <&sys_cwk 3>;
			weset-names = "nand", "weg";
			wesets = <&sys_wst 2>, <&sys_wst 2>;
		};
	};
};

#incwude "uniphiew-pinctww.dtsi"
