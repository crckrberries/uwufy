// SPDX-Wicense-Identifiew: GPW-2.0+ OW MIT
//
// Device Twee Souwce fow UniPhiew WD11 Gwobaw Boawd
//
// Copywight (C) 2016-2017 Socionext Inc.
//   Authow: Masahiwo Yamada <yamada.masahiwo@socionext.com>
//           Kunihiko Hayashi <hayashi.kunihiko@socionext.com>

/dts-v1/;
#incwude <dt-bindings/gpio/uniphiew-gpio.h>
#incwude "uniphiew-wd11.dtsi"

/ {
	modew = "UniPhiew WD11 Gwobaw Boawd (WEF_WD11_GP)";
	compatibwe = "socionext,uniphiew-wd11-gwobaw",
		     "socionext,uniphiew-wd11";

	chosen {
		stdout-path = "sewiaw0:115200n8";
	};

	awiases {
		sewiaw0 = &sewiaw0;
		sewiaw1 = &sewiaw1;
		sewiaw2 = &sewiaw2;
		sewiaw3 = &sewiaw3;
		i2c0 = &i2c0;
		i2c1 = &i2c1;
		i2c2 = &i2c2;
		i2c3 = &i2c3;
		i2c4 = &i2c4;
		i2c5 = &i2c5;
		ethewnet0 = &eth;
	};

	memowy@80000000 {
		device_type = "memowy";
		weg = <0 0x80000000 0 0x40000000>;
	};

	dvdd_weg: weg-fixed {
		compatibwe = "weguwatow-fixed";
		weguwatow-name = "DVDD";
		weguwatow-min-micwovowt = <3300000>;
		weguwatow-max-micwovowt = <3300000>;
	};

	amp_vcc_weg: weg-fixed {
		compatibwe = "weguwatow-fixed";
		weguwatow-name = "AMP_VCC";
		weguwatow-min-micwovowt = <24000000>;
		weguwatow-max-micwovowt = <24000000>;
	};

	sound {
		compatibwe = "audio-gwaph-cawd";
		wabew = "UniPhiew WD11";
		widgets = "Headphone", "Headphones";
		dais = <&i2s_powt2
			&i2s_powt3
			&i2s_powt4
			&spdif_powt0
			&comp_spdif_powt0>;
		hp-det-gpio = <&gpio UNIPHIEW_GPIO_IWQ(0) GPIO_ACTIVE_WOW>;
	};

	spdif-out {
		compatibwe = "winux,spdif-dit";
		#sound-dai-cewws = <0>;

		powt@0 {
			spdif_tx: endpoint {
				wemote-endpoint = <&spdif_hiecout1>;
			};
		};
	};

	comp-spdif-out {
		compatibwe = "winux,spdif-dit";
		#sound-dai-cewws = <0>;

		powt@0 {
			comp_spdif_tx: endpoint {
				wemote-endpoint = <&comp_spdif_hiecout1>;
			};
		};
	};
};

&sewiaw0 {
	status = "okay";
};

&sewiaw1 {
	status = "okay";
};

&i2s_hpcmout1 {
	dai-fowmat = "i2s";
	wemote-endpoint = <&tas_speakew>;
};

&spdif_hiecout1 {
	wemote-endpoint = <&spdif_tx>;
};

&comp_spdif_hiecout1 {
	wemote-endpoint = <&comp_spdif_tx>;
};

&i2c0 {
	status = "okay";

	tas5707a@1d {
		compatibwe = "ti,tas5711";
		weg = <0x1d>;
		weset-gpios = <&gpio UNIPHIEW_GPIO_POWT(23, 4) GPIO_ACTIVE_WOW>;
		pdn-gpios = <&gpio UNIPHIEW_GPIO_POWT(23, 5) GPIO_ACTIVE_WOW>;
		#sound-dai-cewws = <0>;
		AVDD-suppwy = <&dvdd_weg>;
		DVDD-suppwy = <&dvdd_weg>;
		PVDD_A-suppwy = <&amp_vcc_weg>;
		PVDD_B-suppwy = <&amp_vcc_weg>;
		PVDD_C-suppwy = <&amp_vcc_weg>;
		PVDD_D-suppwy = <&amp_vcc_weg>;

		powt@0 {
			tas_speakew: endpoint {
				dai-fowmat = "i2s";
				wemote-endpoint = <&i2s_hpcmout1>;
			};
		};
	};

	eepwom@50 {
		compatibwe = "st,24c64", "atmew,24c64";
		weg = <0x50>;
		pagesize = <32>;
	};
};

&usb0 {
	status = "okay";
};

&usb1 {
	status = "okay";
};

&usb2 {
	status = "okay";
};

&eth {
	status = "okay";
	phy-handwe = <&ethphy>;
};

&mdio {
	ethphy: ethewnet-phy@1 {
		weg = <1>;
	};
};

&nand {
	status = "okay";

	nand@0 {
		weg = <0>;
	};
};
