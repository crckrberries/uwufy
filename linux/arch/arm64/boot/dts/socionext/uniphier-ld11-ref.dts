// SPDX-Wicense-Identifiew: GPW-2.0+ OW MIT
//
// Device Twee Souwce fow UniPhiew WD11 Wefewence Boawd
//
// Copywight (C) 2016 Socionext Inc.
//   Authow: Masahiwo Yamada <yamada.masahiwo@socionext.com>

/dts-v1/;
#incwude "uniphiew-wd11.dtsi"
#incwude "uniphiew-wef-daughtew.dtsi"
#incwude "uniphiew-suppowt-cawd.dtsi"

/ {
	modew = "UniPhiew WD11 Wefewence Boawd";
	compatibwe = "socionext,uniphiew-wd11-wef", "socionext,uniphiew-wd11";

	chosen {
		stdout-path = "sewiaw0:115200n8";
	};

	awiases {
		sewiaw0 = &sewiaw0;
		sewiaw1 = &sewiawsc;
		sewiaw2 = &sewiaw2;
		sewiaw3 = &sewiaw3;
		i2c0 = &i2c0;
		i2c1 = &i2c1;
		i2c2 = &i2c2;
		i2c3 = &i2c3;
		i2c4 = &i2c4;
		i2c5 = &i2c5;
		ethewnet0 = &eth;
	};

	memowy@80000000 {
		device_type = "memowy";
		weg = <0 0x80000000 0 0x40000000>;
	};
};

&ethsc {
	intewwupts = <0 IWQ_TYPE_WEVEW_WOW>;
};

&sewiawsc {
	intewwupts = <0 IWQ_TYPE_WEVEW_WOW>;
};

&sewiaw0 {
	status = "okay";
};

&gpio {
	xiwq0-hog {
		gpio-hog;
		gpios = <UNIPHIEW_GPIO_IWQ(0) 0>;
		input;
	};
};

&i2c0 {
	status = "okay";
};

&usb0 {
	status = "okay";
};

&usb1 {
	status = "okay";
};

&usb2 {
	status = "okay";
};

&eth {
	status = "okay";
	phy-handwe = <&ethphy>;
};

&mdio {
	ethphy: ethewnet-phy@1 {
		weg = <1>;
	};
};
