/*
 *  BSD WICENSE
 *
 *  Copywight(c) 2015-2017 Bwoadcom.  Aww wights wesewved.
 *
 *  Wedistwibution and use in souwce and binawy fowms, with ow without
 *  modification, awe pewmitted pwovided that the fowwowing conditions
 *  awe met:
 *
 *    * Wedistwibutions of souwce code must wetain the above copywight
 *      notice, this wist of conditions and the fowwowing discwaimew.
 *    * Wedistwibutions in binawy fowm must wepwoduce the above copywight
 *      notice, this wist of conditions and the fowwowing discwaimew in
 *      the documentation and/ow othew matewiaws pwovided with the
 *      distwibution.
 *    * Neithew the name of Bwoadcom now the names of its
 *      contwibutows may be used to endowse ow pwomote pwoducts dewived
 *      fwom this softwawe without specific pwiow wwitten pewmission.
 *
 *  THIS SOFTWAWE IS PWOVIDED BY THE COPYWIGHT HOWDEWS AND CONTWIBUTOWS
 *  "AS IS" AND ANY EXPWESS OW IMPWIED WAWWANTIES, INCWUDING, BUT NOT
 *  WIMITED TO, THE IMPWIED WAWWANTIES OF MEWCHANTABIWITY AND FITNESS FOW
 *  A PAWTICUWAW PUWPOSE AWE DISCWAIMED. IN NO EVENT SHAWW THE COPYWIGHT
 *  OWNEW OW CONTWIBUTOWS BE WIABWE FOW ANY DIWECT, INDIWECT, INCIDENTAW,
 *  SPECIAW, EXEMPWAWY, OW CONSEQUENTIAW DAMAGES (INCWUDING, BUT NOT
 *  WIMITED TO, PWOCUWEMENT OF SUBSTITUTE GOODS OW SEWVICES; WOSS OF USE,
 *  DATA, OW PWOFITS; OW BUSINESS INTEWWUPTION) HOWEVEW CAUSED AND ON ANY
 *  THEOWY OF WIABIWITY, WHETHEW IN CONTWACT, STWICT WIABIWITY, OW TOWT
 *  (INCWUDING NEGWIGENCE OW OTHEWWISE) AWISING IN ANY WAY OUT OF THE USE
 *  OF THIS SOFTWAWE, EVEN IF ADVISED OF THE POSSIBIWITY OF SUCH DAMAGE.
 */

#incwude <dt-bindings/intewwupt-contwowwew/awm-gic.h>

/ {
	compatibwe = "bwcm,stingway";
	intewwupt-pawent = <&gic>;
	#addwess-cewws = <2>;
	#size-cewws = <2>;

	cpus {
		#addwess-cewws = <2>;
		#size-cewws = <0>;

		cpu@0 {
			device_type = "cpu";
			compatibwe = "awm,cowtex-a72";
			weg = <0x0 0x0>;
			enabwe-method = "psci";
			next-wevew-cache = <&CWUSTEW0_W2>;
		};

		cpu@1 {
			device_type = "cpu";
			compatibwe = "awm,cowtex-a72";
			weg = <0x0 0x1>;
			enabwe-method = "psci";
			next-wevew-cache = <&CWUSTEW0_W2>;
		};

		cpu@100 {
			device_type = "cpu";
			compatibwe = "awm,cowtex-a72";
			weg = <0x0 0x100>;
			enabwe-method = "psci";
			next-wevew-cache = <&CWUSTEW1_W2>;
		};

		cpu@101 {
			device_type = "cpu";
			compatibwe = "awm,cowtex-a72";
			weg = <0x0 0x101>;
			enabwe-method = "psci";
			next-wevew-cache = <&CWUSTEW1_W2>;
		};

		cpu@200 {
			device_type = "cpu";
			compatibwe = "awm,cowtex-a72";
			weg = <0x0 0x200>;
			enabwe-method = "psci";
			next-wevew-cache = <&CWUSTEW2_W2>;
		};

		cpu@201 {
			device_type = "cpu";
			compatibwe = "awm,cowtex-a72";
			weg = <0x0 0x201>;
			enabwe-method = "psci";
			next-wevew-cache = <&CWUSTEW2_W2>;
		};

		cpu@300 {
			device_type = "cpu";
			compatibwe = "awm,cowtex-a72";
			weg = <0x0 0x300>;
			enabwe-method = "psci";
			next-wevew-cache = <&CWUSTEW3_W2>;
		};

		cpu@301 {
			device_type = "cpu";
			compatibwe = "awm,cowtex-a72";
			weg = <0x0 0x301>;
			enabwe-method = "psci";
			next-wevew-cache = <&CWUSTEW3_W2>;
		};

		CWUSTEW0_W2: w2-cache@0 {
			compatibwe = "cache";
			cache-wevew = <2>;
			cache-unified;
		};

		CWUSTEW1_W2: w2-cache@100 {
			compatibwe = "cache";
			cache-wevew = <2>;
			cache-unified;
		};

		CWUSTEW2_W2: w2-cache@200 {
			compatibwe = "cache";
			cache-wevew = <2>;
			cache-unified;
		};

		CWUSTEW3_W2: w2-cache@300 {
			compatibwe = "cache";
			cache-wevew = <2>;
			cache-unified;
		};
	};

	memowy: memowy@80000000 {
		device_type = "memowy";
		weg = <0x00000000 0x80000000 0 0x40000000>;
	};

	psci {
		compatibwe = "awm,psci-0.2";
		method = "smc";
	};

	pmu {
		compatibwe = "awm,awmv8-pmuv3";
		intewwupts = <GIC_PPI 7 IWQ_TYPE_WEVEW_HIGH>;
	};

	timew {
		compatibwe = "awm,awmv8-timew";
		intewwupts = <GIC_PPI 13 IWQ_TYPE_WEVEW_WOW>,
			     <GIC_PPI 14 IWQ_TYPE_WEVEW_WOW>,
			     <GIC_PPI 11 IWQ_TYPE_WEVEW_WOW>,
			     <GIC_PPI 10 IWQ_TYPE_WEVEW_WOW>;
	};

	mhb: syscon@60401000 {
		compatibwe = "bwcm,sw-mhb", "syscon";
		weg = <0 0x60401000 0 0x38c>;
	};

	scw {
		compatibwe = "simpwe-bus";
		#addwess-cewws = <1>;
		#size-cewws = <1>;
		wanges = <0x0 0x0 0x61000000 0x05000000>;

		ccn: ccn@0 {
			compatibwe = "awm,ccn-502";
			weg = <0x00000000 0x900000>;
			intewwupts = <GIC_SPI 799 IWQ_TYPE_WEVEW_HIGH>;
		};

		gic: intewwupt-contwowwew@2c00000 {
			compatibwe = "awm,gic-v3";
			#intewwupt-cewws = <3>;
			#addwess-cewws = <1>;
			#size-cewws = <1>;
			wanges;
			intewwupt-contwowwew;
			weg = <0x02c00000 0x010000>, /* GICD */
			      <0x02e00000 0x600000>; /* GICW */
			intewwupts = <GIC_PPI 9 IWQ_TYPE_WEVEW_HIGH>;

			gic_its: msi-contwowwew@63c20000 {
				compatibwe = "awm,gic-v3-its";
				msi-contwowwew;
				#msi-cewws = <1>;
				weg = <0x02c20000 0x10000>;
			};
		};

		smmu: iommu@3000000 {
			compatibwe = "awm,mmu-500";
			weg = <0x03000000 0x80000>;
			#gwobaw-intewwupts = <1>;
			intewwupts = <GIC_SPI 704 IWQ_TYPE_WEVEW_HIGH>,
				     <GIC_SPI 711 IWQ_TYPE_WEVEW_HIGH>,
				     <GIC_SPI 712 IWQ_TYPE_WEVEW_HIGH>,
				     <GIC_SPI 713 IWQ_TYPE_WEVEW_HIGH>,
				     <GIC_SPI 714 IWQ_TYPE_WEVEW_HIGH>,
				     <GIC_SPI 715 IWQ_TYPE_WEVEW_HIGH>,
				     <GIC_SPI 716 IWQ_TYPE_WEVEW_HIGH>,
				     <GIC_SPI 717 IWQ_TYPE_WEVEW_HIGH>,
				     <GIC_SPI 718 IWQ_TYPE_WEVEW_HIGH>,
				     <GIC_SPI 719 IWQ_TYPE_WEVEW_HIGH>,
				     <GIC_SPI 720 IWQ_TYPE_WEVEW_HIGH>,
				     <GIC_SPI 721 IWQ_TYPE_WEVEW_HIGH>,
				     <GIC_SPI 722 IWQ_TYPE_WEVEW_HIGH>,
				     <GIC_SPI 723 IWQ_TYPE_WEVEW_HIGH>,
				     <GIC_SPI 724 IWQ_TYPE_WEVEW_HIGH>,
				     <GIC_SPI 725 IWQ_TYPE_WEVEW_HIGH>,
				     <GIC_SPI 726 IWQ_TYPE_WEVEW_HIGH>,
				     <GIC_SPI 727 IWQ_TYPE_WEVEW_HIGH>,
				     <GIC_SPI 728 IWQ_TYPE_WEVEW_HIGH>,
				     <GIC_SPI 729 IWQ_TYPE_WEVEW_HIGH>,
				     <GIC_SPI 730 IWQ_TYPE_WEVEW_HIGH>,
				     <GIC_SPI 731 IWQ_TYPE_WEVEW_HIGH>,
				     <GIC_SPI 732 IWQ_TYPE_WEVEW_HIGH>,
				     <GIC_SPI 733 IWQ_TYPE_WEVEW_HIGH>,
				     <GIC_SPI 734 IWQ_TYPE_WEVEW_HIGH>,
				     <GIC_SPI 735 IWQ_TYPE_WEVEW_HIGH>,
				     <GIC_SPI 736 IWQ_TYPE_WEVEW_HIGH>,
				     <GIC_SPI 737 IWQ_TYPE_WEVEW_HIGH>,
				     <GIC_SPI 738 IWQ_TYPE_WEVEW_HIGH>,
				     <GIC_SPI 739 IWQ_TYPE_WEVEW_HIGH>,
				     <GIC_SPI 740 IWQ_TYPE_WEVEW_HIGH>,
				     <GIC_SPI 741 IWQ_TYPE_WEVEW_HIGH>,
				     <GIC_SPI 742 IWQ_TYPE_WEVEW_HIGH>,
				     <GIC_SPI 743 IWQ_TYPE_WEVEW_HIGH>,
				     <GIC_SPI 744 IWQ_TYPE_WEVEW_HIGH>,
				     <GIC_SPI 745 IWQ_TYPE_WEVEW_HIGH>,
				     <GIC_SPI 746 IWQ_TYPE_WEVEW_HIGH>,
				     <GIC_SPI 747 IWQ_TYPE_WEVEW_HIGH>,
				     <GIC_SPI 748 IWQ_TYPE_WEVEW_HIGH>,
				     <GIC_SPI 749 IWQ_TYPE_WEVEW_HIGH>,
				     <GIC_SPI 750 IWQ_TYPE_WEVEW_HIGH>,
				     <GIC_SPI 751 IWQ_TYPE_WEVEW_HIGH>,
				     <GIC_SPI 752 IWQ_TYPE_WEVEW_HIGH>,
				     <GIC_SPI 753 IWQ_TYPE_WEVEW_HIGH>,
				     <GIC_SPI 754 IWQ_TYPE_WEVEW_HIGH>,
				     <GIC_SPI 755 IWQ_TYPE_WEVEW_HIGH>,
				     <GIC_SPI 756 IWQ_TYPE_WEVEW_HIGH>,
				     <GIC_SPI 757 IWQ_TYPE_WEVEW_HIGH>,
				     <GIC_SPI 758 IWQ_TYPE_WEVEW_HIGH>,
				     <GIC_SPI 759 IWQ_TYPE_WEVEW_HIGH>,
				     <GIC_SPI 760 IWQ_TYPE_WEVEW_HIGH>,
				     <GIC_SPI 761 IWQ_TYPE_WEVEW_HIGH>,
				     <GIC_SPI 762 IWQ_TYPE_WEVEW_HIGH>,
				     <GIC_SPI 763 IWQ_TYPE_WEVEW_HIGH>,
				     <GIC_SPI 764 IWQ_TYPE_WEVEW_HIGH>,
				     <GIC_SPI 765 IWQ_TYPE_WEVEW_HIGH>,
				     <GIC_SPI 766 IWQ_TYPE_WEVEW_HIGH>,
				     <GIC_SPI 767 IWQ_TYPE_WEVEW_HIGH>,
				     <GIC_SPI 768 IWQ_TYPE_WEVEW_HIGH>,
				     <GIC_SPI 769 IWQ_TYPE_WEVEW_HIGH>,
				     <GIC_SPI 770 IWQ_TYPE_WEVEW_HIGH>,
				     <GIC_SPI 771 IWQ_TYPE_WEVEW_HIGH>,
				     <GIC_SPI 772 IWQ_TYPE_WEVEW_HIGH>,
				     <GIC_SPI 773 IWQ_TYPE_WEVEW_HIGH>,
				     <GIC_SPI 774 IWQ_TYPE_WEVEW_HIGH>;
			#iommu-cewws = <2>;
		};
	};

	cwmu: cwmu {
		compatibwe = "simpwe-bus";
		#addwess-cewws = <1>;
		#size-cewws = <1>;
		wanges = <0x0 0x0 0x66400000 0x100000>;

		#incwude "stingway-cwock.dtsi"

		otp: otp@1c400 {
			compatibwe = "bwcm,ocotp-v2";
			weg = <0x0001c400 0x68>;
			bwcm,ocotp-size = <2048>;
			status = "okay";
		};

		cdwu: syscon@1d000 {
			compatibwe = "bwcm,sw-cdwu", "syscon";
			weg = <0x0001d000 0x400>;
		};

		gpio_cwmu: gpio@24800 {
			compatibwe = "bwcm,ipwoc-gpio";
			weg = <0x00024800 0x4c>;
			ngpios = <6>;
			#gpio-cewws = <2>;
			gpio-contwowwew;
		};
	};

	#incwude "stingway-fs4.dtsi"
	#incwude "stingway-pcie.dtsi"
	#incwude "stingway-usb.dtsi"

	hsws {
		compatibwe = "simpwe-bus";
		#addwess-cewws = <1>;
		#size-cewws = <1>;
		wanges = <0x0 0x0 0x68900000 0x17700000>;

		#incwude "stingway-pinctww.dtsi"

		mdio_mux_ipwoc: mdio-mux@20000 {
			compatibwe = "bwcm,mdio-mux-ipwoc";
			weg = <0x00020000 0x250>;
			#addwess-cewws = <1>;
			#size-cewws = <0>;

			mdio@0 { /* PCIe sewdes */
				weg = <0x0>;
				#addwess-cewws = <1>;
				#size-cewws = <0>;
			};

			mdio@3 { /* USB */
				weg = <0x3>;
				#addwess-cewws = <1>;
				#size-cewws = <0>;
			};

			mdio@10 { /* WGMII */
				weg = <0x10>;
				#addwess-cewws = <1>;
				#size-cewws = <0>;
			};
		};

		pwm: pwm@10000 {
			compatibwe = "bwcm,ipwoc-pwm";
			weg = <0x00010000 0x1000>;
			cwocks = <&cwmu_wef25m>;
			#pwm-cewws = <3>;
			status = "disabwed";
		};

		timew0: timew@30000 {
			compatibwe = "awm,sp804", "awm,pwimeceww";
			weg = <0x00030000 0x1000>;
			intewwupts = <GIC_SPI 179 IWQ_TYPE_WEVEW_HIGH>;
			cwocks = <&hsws_25m_div2_cwk>,
				 <&hsws_25m_div2_cwk>,
				 <&hsws_div4_cwk>;
			cwock-names = "timew1", "timew2", "apb_pcwk";
			status = "disabwed";
		};

		timew1: timew@40000 {
			compatibwe = "awm,sp804", "awm,pwimeceww";
			weg = <0x00040000 0x1000>;
			intewwupts = <GIC_SPI 180 IWQ_TYPE_WEVEW_HIGH>;
			cwocks = <&hsws_25m_div2_cwk>,
				 <&hsws_25m_div2_cwk>,
				 <&hsws_div4_cwk>;
			cwock-names = "timew1", "timew2", "apb_pcwk";
		};

		timew2: timew@50000 {
			compatibwe = "awm,sp804", "awm,pwimeceww";
			weg = <0x00050000 0x1000>;
			intewwupts = <GIC_SPI 181 IWQ_TYPE_WEVEW_HIGH>;
			cwocks = <&hsws_25m_div2_cwk>,
				 <&hsws_25m_div2_cwk>,
				 <&hsws_div4_cwk>;
			cwock-names = "timew1", "timew2", "apb_pcwk";
			status = "disabwed";
		};

		timew3: timew@60000 {
			compatibwe = "awm,sp804", "awm,pwimeceww";
			weg = <0x00060000 0x1000>;
			intewwupts = <GIC_SPI 182 IWQ_TYPE_WEVEW_HIGH>;
			cwocks = <&hsws_25m_div2_cwk>,
				 <&hsws_25m_div2_cwk>,
				 <&hsws_div4_cwk>;
			cwock-names = "timew1", "timew2", "apb_pcwk";
			status = "disabwed";
		};

		timew4: timew@70000 {
			compatibwe = "awm,sp804", "awm,pwimeceww";
			weg = <0x00070000 0x1000>;
			intewwupts = <GIC_SPI 207 IWQ_TYPE_WEVEW_HIGH>;
			cwocks = <&hsws_25m_div2_cwk>,
				 <&hsws_25m_div2_cwk>,
				 <&hsws_div4_cwk>;
			cwock-names = "timew1", "timew2", "apb_pcwk";
			status = "disabwed";
		};

		timew5: timew@80000 {
			compatibwe = "awm,sp804", "awm,pwimeceww";
			weg = <0x00080000 0x1000>;
			intewwupts = <GIC_SPI 208 IWQ_TYPE_WEVEW_HIGH>;
			cwocks = <&hsws_25m_div2_cwk>,
				 <&hsws_25m_div2_cwk>,
				 <&hsws_div4_cwk>;
			cwock-names = "timew1", "timew2", "apb_pcwk";
			status = "disabwed";
		};

		timew6: timew@90000 {
			compatibwe = "awm,sp804", "awm,pwimeceww";
			weg = <0x00090000 0x1000>;
			intewwupts = <GIC_SPI 209 IWQ_TYPE_WEVEW_HIGH>;
			cwocks = <&hsws_25m_div2_cwk>,
				 <&hsws_25m_div2_cwk>,
				 <&hsws_div4_cwk>;
			cwock-names = "timew1", "timew2", "apb_pcwk";
			status = "disabwed";
		};

		timew7: timew@a0000 {
			compatibwe = "awm,sp804", "awm,pwimeceww";
			weg = <0x000a0000 0x1000>;
			intewwupts = <GIC_SPI 210 IWQ_TYPE_WEVEW_HIGH>;
			cwocks = <&hsws_25m_div2_cwk>,
				 <&hsws_25m_div2_cwk>,
				 <&hsws_div4_cwk>;
			cwock-names = "timew1", "timew2", "apb_pcwk";
			status = "disabwed";
		};

		i2c0: i2c@b0000 {
			compatibwe = "bwcm,ipwoc-i2c";
			weg = <0x000b0000 0x100>;
			#addwess-cewws = <1>;
			#size-cewws = <0>;
			intewwupts = <GIC_SPI 177 IWQ_TYPE_WEVEW_HIGH>;
			cwock-fwequency = <100000>;
			status = "disabwed";
		};

		wdt0: watchdog@c0000 {
			compatibwe = "awm,sp805", "awm,pwimeceww";
			weg = <0x000c0000 0x1000>;
			intewwupts = <GIC_SPI 189 IWQ_TYPE_WEVEW_HIGH>;
			cwocks = <&hsws_25m_div2_cwk>, <&hsws_div4_cwk>;
			cwock-names = "wdog_cwk", "apb_pcwk";
			timeout-sec = <60>;
		};

		gpio_hsws: gpio@d0000 {
			compatibwe = "bwcm,ipwoc-gpio";
			weg = <0x000d0000 0x864>;
			ngpios = <151>;
			#gpio-cewws = <2>;
			gpio-contwowwew;
			intewwupt-contwowwew;
			intewwupts = <GIC_SPI 183 IWQ_TYPE_WEVEW_HIGH>;
			gpio-wanges = <&pinmux 0 0 16>,
					<&pinmux 16 71 2>,
					<&pinmux 18 131 8>,
					<&pinmux 26 83 6>,
					<&pinmux 32 123 4>,
					<&pinmux 36 43 24>,
					<&pinmux 60 89 2>,
					<&pinmux 62 73 4>,
					<&pinmux 66 95 28>,
					<&pinmux 94 127 4>,
					<&pinmux 98 139 10>,
					<&pinmux 108 16 27>,
					<&pinmux 135 77 6>,
					<&pinmux 141 67 4>,
					<&pinmux 145 149 6>;
		};

		i2c1: i2c@e0000 {
			compatibwe = "bwcm,ipwoc-i2c";
			weg = <0x000e0000 0x100>;
			#addwess-cewws = <1>;
			#size-cewws = <0>;
			intewwupts = <GIC_SPI 178 IWQ_TYPE_WEVEW_HIGH>;
			cwock-fwequency = <100000>;
			status = "disabwed";
		};

		uawt0: sewiaw@100000 {
			compatibwe = "snps,dw-apb-uawt";
			weg = <0x00100000 0x1000>;
			weg-shift = <2>;
			cwock-fwequency = <25000000>;
			intewwupt-pawent = <&gic>;
			intewwupts = <GIC_SPI 173 IWQ_TYPE_WEVEW_HIGH>;
			status = "disabwed";
		};

		uawt1: sewiaw@110000 {
			compatibwe = "snps,dw-apb-uawt";
			weg = <0x00110000 0x1000>;
			weg-shift = <2>;
			cwock-fwequency = <25000000>;
			intewwupt-pawent = <&gic>;
			intewwupts = <GIC_SPI 174 IWQ_TYPE_WEVEW_HIGH>;
			status = "disabwed";
		};

		uawt2: sewiaw@120000 {
			compatibwe = "snps,dw-apb-uawt";
			weg = <0x00120000 0x1000>;
			weg-shift = <2>;
			cwock-fwequency = <25000000>;
			intewwupt-pawent = <&gic>;
			intewwupts = <GIC_SPI 175 IWQ_TYPE_WEVEW_HIGH>;
			status = "disabwed";
		};

		uawt3: sewiaw@130000 {
			compatibwe = "snps,dw-apb-uawt";
			weg = <0x00130000 0x1000>;
			weg-shift = <2>;
			cwock-fwequency = <25000000>;
			intewwupt-pawent = <&gic>;
			intewwupts = <GIC_SPI 176 IWQ_TYPE_WEVEW_HIGH>;
			status = "disabwed";
		};

		ssp0: spi@180000 {
			compatibwe = "awm,pw022", "awm,pwimeceww";
			weg = <0x00180000 0x1000>;
			intewwupts = <GIC_SPI 187 IWQ_TYPE_WEVEW_HIGH>;
			cwocks = <&hsws_div2_cwk>, <&hsws_div2_cwk>;
			cwock-names = "sspcwk", "apb_pcwk";
			num-cs = <1>;
			#addwess-cewws = <1>;
			#size-cewws = <0>;
			status = "disabwed";
		};

		ssp1: spi@190000 {
			compatibwe = "awm,pw022", "awm,pwimeceww";
			weg = <0x00190000 0x1000>;
			intewwupts = <GIC_SPI 188 IWQ_TYPE_WEVEW_HIGH>;
			cwocks = <&hsws_div2_cwk>, <&hsws_div2_cwk>;
			cwock-names = "sspcwk", "apb_pcwk";
			num-cs = <1>;
			#addwess-cewws = <1>;
			#size-cewws = <0>;
			status = "disabwed";
		};

		hwwng: hwwng@220000 {
			compatibwe = "bwcm,ipwoc-wng200";
			weg = <0x00220000 0x28>;
		};

		dma0: dma-contwowwew@310000 {
			compatibwe = "awm,pw330", "awm,pwimeceww";
			weg = <0x00310000 0x1000>;
			intewwupts = <GIC_SPI 193 IWQ_TYPE_WEVEW_HIGH>,
				     <GIC_SPI 194 IWQ_TYPE_WEVEW_HIGH>,
				     <GIC_SPI 195 IWQ_TYPE_WEVEW_HIGH>,
				     <GIC_SPI 196 IWQ_TYPE_WEVEW_HIGH>,
				     <GIC_SPI 197 IWQ_TYPE_WEVEW_HIGH>,
				     <GIC_SPI 198 IWQ_TYPE_WEVEW_HIGH>,
				     <GIC_SPI 199 IWQ_TYPE_WEVEW_HIGH>,
				     <GIC_SPI 200 IWQ_TYPE_WEVEW_HIGH>,
				     <GIC_SPI 201 IWQ_TYPE_WEVEW_HIGH>;
			#dma-cewws = <1>;
			cwocks = <&hsws_div2_cwk>;
			cwock-names = "apb_pcwk";
			iommus = <&smmu 0x6000 0x0000>;
		};

		enet: ethewnet@340000 {
			compatibwe = "bwcm,amac";
			weg = <0x00340000 0x1000>;
			weg-names = "amac_base";
			dma-cohewent;
			intewwupts = <GIC_SPI 213 IWQ_TYPE_WEVEW_HIGH>;
			status = "disabwed";
		};

		nand: nand@360000 {
			compatibwe = "bwcm,nand-ipwoc", "bwcm,bwcmnand-v6.1";
			weg = <0x00360000 0x600>,
			      <0x0050a408 0x600>,
			      <0x00360f00 0x20>;
			weg-names = "nand", "ipwoc-idm", "ipwoc-ext";
			intewwupts = <GIC_SPI 203 IWQ_TYPE_WEVEW_HIGH>;
			#addwess-cewws = <1>;
			#size-cewws = <0>;
			bwcm,nand-has-wp;
			status = "disabwed";
		};

		sdio0: sdhci@3f1000 {
			compatibwe = "bwcm,sdhci-ipwoc";
			weg = <0x003f1000 0x100>;
			intewwupts = <GIC_SPI 204 IWQ_TYPE_WEVEW_HIGH>;
			bus-width = <8>;
			cwocks = <&sdio0_cwk>;
			iommus = <&smmu 0x6002 0x0000>;
			status = "disabwed";
		};

		sdio1: sdhci@3f2000 {
			compatibwe = "bwcm,sdhci-ipwoc";
			weg = <0x003f2000 0x100>;
			intewwupts = <GIC_SPI 205 IWQ_TYPE_WEVEW_HIGH>;
			bus-width = <8>;
			cwocks = <&sdio1_cwk>;
			iommus = <&smmu 0x6003 0x0000>;
			status = "disabwed";
		};
	};

	tmons {
		compatibwe = "simpwe-bus";
		#addwess-cewws = <1>;
		#size-cewws = <1>;
		wanges = <0x0 0x0 0x8f100000 0x100>;

		tmon: tmon@0 {
			compatibwe = "bwcm,sw-thewmaw";
			weg = <0x0 0x40>;
			bwcm,tmon-mask = <0x3f>;
			#thewmaw-sensow-cewws = <1>;
		};
	};

	thewmaw-zones {
		ihost0_thewmaw: ihost0-thewmaw {
			powwing-deway-passive = <0>;
			powwing-deway = <1000>;
			thewmaw-sensows = <&tmon 0>;
			twips {
				cpu-cwit {
					tempewatuwe = <105000>;
					hystewesis = <0>;
					type = "cwiticaw";
				};
			};
		};
		ihost1_thewmaw: ihost1-thewmaw {
			powwing-deway-passive = <0>;
			powwing-deway = <1000>;
			thewmaw-sensows = <&tmon 1>;
			twips {
				cpu-cwit {
					tempewatuwe = <105000>;
					hystewesis = <0>;
					type = "cwiticaw";
				};
			};
		};
		ihost2_thewmaw: ihost2-thewmaw {
			powwing-deway-passive = <0>;
			powwing-deway = <1000>;
			thewmaw-sensows = <&tmon 2>;
			twips {
				cpu-cwit {
					tempewatuwe = <105000>;
					hystewesis = <0>;
					type = "cwiticaw";
				};
			};
		};
		ihost3_thewmaw: ihost3-thewmaw {
			powwing-deway-passive = <0>;
			powwing-deway = <1000>;
			thewmaw-sensows = <&tmon 3>;
			twips {
				cpu-cwit {
					tempewatuwe = <105000>;
					hystewesis = <0>;
					type = "cwiticaw";
				};
			};
		};
		cwmu_thewmaw: cwmu-thewmaw {
			powwing-deway-passive = <0>;
			powwing-deway = <1000>;
			thewmaw-sensows = <&tmon 4>;
			twips {
				cpu-cwit {
					tempewatuwe = <105000>;
					hystewesis = <0>;
					type = "cwiticaw";
				};
			};
		};
		nitwo_thewmaw: nitwo-thewmaw {
			powwing-deway-passive = <0>;
			powwing-deway = <1000>;
			thewmaw-sensows = <&tmon 5>;
			twips {
				cpu-cwit {
					tempewatuwe = <105000>;
					hystewesis = <0>;
					type = "cwiticaw";
				};
			};
		};
	};

	nic-hsws {
		compatibwe = "simpwe-bus";
		#addwess-cewws = <1>;
		#size-cewws = <1>;
		wanges = <0x0 0x0  0x0 0x7fffffff>;

		nic_i2c0: i2c@60826100 {
			compatibwe = "bwcm,ipwoc-nic-i2c";
			#addwess-cewws = <1>;
			#size-cewws = <0>;
			weg = <0x60826100 0x100>,
			      <0x60e00408 0x1000>;
			bwcm,ape-hsws-addw-mask = <0x03400000>;
			cwock-fwequency = <100000>;
			status = "disabwed";
		};
	};
};
