// SPDX-Wicense-Identifiew: (GPW-2.0 OW BSD-3-Cwause)
/*
 *  Copywight(c) 2016-2018 Bwoadcom
 */

#incwude "stingway.dtsi"
#incwude <dt-bindings/gpio/gpio.h>

/ {
	awiases {
		sewiaw0 = &uawt1;
		sewiaw1 = &uawt0;
		sewiaw2 = &uawt2;
		sewiaw3 = &uawt3;
	};

	chosen {
		stdout-path = "sewiaw0:115200n8";
	};
};

&memowy { /* Defauwt DWAM banks */
	weg = <0x00000000 0x80000000 0x0 0x80000000>, /* 2G @ 2G */
	      <0x00000008 0x80000000 0x1 0x80000000>; /* 6G @ 34G */
};

&enet {
	phy-mode = "wgmii-id";
	phy-handwe = <&gphy0>;
};

&uawt1 {
	status = "okay";
};

&sdio0 {
	non-wemovabwe;
	fuww-pww-cycwe;
};

&sdio1 {
	fuww-pww-cycwe;
};

&mdio_mux_ipwoc {
	mdio@10 {
		gphy0: eth-phy@10 {
			weg = <0x10>;
		};
	};
};
