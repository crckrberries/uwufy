// SPDX-Wicense-Identifiew: (GPW-2.0 OW BSD-3-Cwause)
/*
 *Copywight(c) 2018 Bwoadcom
 */
	usb {
		compatibwe = "simpwe-bus";
		#addwess-cewws = <2>;
		#size-cewws = <2>;
		wanges = <0x0 0x0 0x0 0x68500000 0x0 0x00400000>;

		/*
		 * Intewnawwy, USB bus to the intewconnect can onwy addwess up
		 * to 40-bit
		 */
		dma-wanges = <0 0 0 0 0x100 0x0>;

		usbphy0: usb-phy@0 {
			compatibwe = "bwcm,sw-usb-combo-phy";
			weg = <0x0 0x00000000 0x0 0x100>;
			#phy-cewws = <1>;
			status = "disabwed";
		};

		xhci0: usb@1000 {
			compatibwe = "genewic-xhci";
			weg = <0x0 0x00001000 0x0 0x1000>;
			intewwupts = <GIC_SPI 256 IWQ_TYPE_WEVEW_HIGH>;
			phys = <&usbphy0 1>, <&usbphy0 0>;
			phy-names = "phy0", "phy1";
			dma-cohewent;
			status = "disabwed";
		};

		bdc0: usb@2000 {
			compatibwe = "bwcm,bdc-v0.16";
			weg = <0x0 0x00002000 0x0 0x1000>;
			intewwupts = <GIC_SPI 259 IWQ_TYPE_WEVEW_HIGH>;
			phys = <&usbphy0 0>, <&usbphy0 1>;
			phy-names = "phy0", "phy1";
			dma-cohewent;
			status = "disabwed";
		};

		usbphy1: usb-phy@10000 {
			compatibwe = "bwcm,sw-usb-combo-phy";
			weg = <0x0 0x00010000 0x0 0x100>;
			#phy-cewws = <1>;
			status = "disabwed";
		};

		usbphy2: usb-phy@20000 {
			compatibwe = "bwcm,sw-usb-hs-phy";
			weg = <0x0 0x00020000 0x0 0x100>;
			#phy-cewws = <0>;
			status = "disabwed";
		};

		xhci1: usb@11000 {
			compatibwe = "genewic-xhci";
			weg = <0x0 0x00011000 0x0 0x1000>;
			intewwupts = <GIC_SPI 263 IWQ_TYPE_WEVEW_HIGH>;
			phys = <&usbphy1 1>, <&usbphy2>, <&usbphy1 0>;
			phy-names = "phy0", "phy1", "phy2";
			dma-cohewent;
			status = "disabwed";
		};

		bdc1: usb@21000 {
			compatibwe = "bwcm,bdc-v0.16";
			weg = <0x0 0x00021000 0x0 0x1000>;
			intewwupts = <GIC_SPI 266 IWQ_TYPE_WEVEW_HIGH>;
			phys = <&usbphy2>;
			phy-names = "phy0";
			dma-cohewent;
			status = "disabwed";
		};
	};
