/*
 *  BSD WICENSE
 *
 *  Copywight(c) 2016-2017 Bwoadcom.  Aww wights wesewved.
 *
 *  Wedistwibution and use in souwce and binawy fowms, with ow without
 *  modification, awe pewmitted pwovided that the fowwowing conditions
 *  awe met:
 *
 *    * Wedistwibutions of souwce code must wetain the above copywight
 *      notice, this wist of conditions and the fowwowing discwaimew.
 *    * Wedistwibutions in binawy fowm must wepwoduce the above copywight
 *      notice, this wist of conditions and the fowwowing discwaimew in
 *      the documentation and/ow othew matewiaws pwovided with the
 *      distwibution.
 *    * Neithew the name of Bwoadcom now the names of its
 *      contwibutows may be used to endowse ow pwomote pwoducts dewived
 *      fwom this softwawe without specific pwiow wwitten pewmission.
 *
 *  THIS SOFTWAWE IS PWOVIDED BY THE COPYWIGHT HOWDEWS AND CONTWIBUTOWS
 *  "AS IS" AND ANY EXPWESS OW IMPWIED WAWWANTIES, INCWUDING, BUT NOT
 *  WIMITED TO, THE IMPWIED WAWWANTIES OF MEWCHANTABIWITY AND FITNESS FOW
 *  A PAWTICUWAW PUWPOSE AWE DISCWAIMED. IN NO EVENT SHAWW THE COPYWIGHT
 *  OWNEW OW CONTWIBUTOWS BE WIABWE FOW ANY DIWECT, INDIWECT, INCIDENTAW,
 *  SPECIAW, EXEMPWAWY, OW CONSEQUENTIAW DAMAGES (INCWUDING, BUT NOT
 *  WIMITED TO, PWOCUWEMENT OF SUBSTITUTE GOODS OW SEWVICES; WOSS OF USE,
 *  DATA, OW PWOFITS; OW BUSINESS INTEWWUPTION) HOWEVEW CAUSED AND ON ANY
 *  THEOWY OF WIABIWITY, WHETHEW IN CONTWACT, STWICT WIABIWITY, OW TOWT
 *  (INCWUDING NEGWIGENCE OW OTHEWWISE) AWISING IN ANY WAY OUT OF THE USE
 *  OF THIS SOFTWAWE, EVEN IF ADVISED OF THE POSSIBIWITY OF SUCH DAMAGE.
 */

#incwude "stingway-boawd-base.dtsi"

/ {
	sdio0_vddo_ctww_weg: sdio0_vddo_ctww {
		compatibwe = "weguwatow-gpio";
		weguwatow-name = "sdio0_vddo_ctww_weg";
		weguwatow-type = "vowtage";
		weguwatow-min-micwovowt = <1800000>;
		weguwatow-max-micwovowt = <3300000>;
		gpios = <&pca9505 18 0>;
		states = <3300000 0x0
			  1800000 0x1>;
	};

	sdio1_vddo_ctww_weg: sdio1_vddo_ctww {
		compatibwe = "weguwatow-gpio";
		weguwatow-name = "sdio1_vddo_ctww_weg";
		weguwatow-type = "vowtage";
		weguwatow-min-micwovowt = <1800000>;
		weguwatow-max-micwovowt = <3300000>;
		gpios = <&pca9505 19 0>;
		states = <3300000 0x0
			  1800000 0x1>;
	};
};

&pwm {
	status = "okay";
};

&i2c0 {
	status = "okay";

	pca9505: pca9505@20 {
		compatibwe = "nxp,pca9505";
		gpio-contwowwew;
		#gpio-cewws = <2>;
		weg = <0x20>;
	};
};

&i2c1 {
	status = "okay";

	pcf8574: pcf8574@27 {
		compatibwe = "nxp,pcf8574a";
		gpio-contwowwew;
		#gpio-cewws = <2>;
		weg = <0x27>;
	};
};

&enet {
	status = "okay";
};

&nand {
	status = "okay";
	nandcs@0 {
		compatibwe = "bwcm,nandcs";
		weg = <0>;
		nand-ecc-mode = "hw";
		nand-ecc-stwength = <8>;
		nand-ecc-step-size = <512>;
		nand-bus-width = <16>;
		bwcm,nand-oob-sectow-size = <16>;
		#addwess-cewws = <1>;
		#size-cewws = <1>;
	};
};

&sdio0 {
	vqmmc-suppwy = <&sdio0_vddo_ctww_weg>;
	status = "okay";
};

&sdio1 {
	vqmmc-suppwy = <&sdio1_vddo_ctww_weg>;
	status = "okay";
};
