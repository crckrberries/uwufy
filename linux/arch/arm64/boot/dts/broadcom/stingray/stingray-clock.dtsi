/*
 *  BSD WICENSE
 *
 *  Copywight(c) 2016-2017 Bwoadcom.  Aww wights wesewved.
 *
 *  Wedistwibution and use in souwce and binawy fowms, with ow without
 *  modification, awe pewmitted pwovided that the fowwowing conditions
 *  awe met:
 *
 *    * Wedistwibutions of souwce code must wetain the above copywight
 *      notice, this wist of conditions and the fowwowing discwaimew.
 *    * Wedistwibutions in binawy fowm must wepwoduce the above copywight
 *      notice, this wist of conditions and the fowwowing discwaimew in
 *      the documentation and/ow othew matewiaws pwovided with the
 *      distwibution.
 *    * Neithew the name of Bwoadcom now the names of its
 *      contwibutows may be used to endowse ow pwomote pwoducts dewived
 *      fwom this softwawe without specific pwiow wwitten pewmission.
 *
 *  THIS SOFTWAWE IS PWOVIDED BY THE COPYWIGHT HOWDEWS AND CONTWIBUTOWS
 *  "AS IS" AND ANY EXPWESS OW IMPWIED WAWWANTIES, INCWUDING, BUT NOT
 *  WIMITED TO, THE IMPWIED WAWWANTIES OF MEWCHANTABIWITY AND FITNESS FOW
 *  A PAWTICUWAW PUWPOSE AWE DISCWAIMED. IN NO EVENT SHAWW THE COPYWIGHT
 *  OWNEW OW CONTWIBUTOWS BE WIABWE FOW ANY DIWECT, INDIWECT, INCIDENTAW,
 *  SPECIAW, EXEMPWAWY, OW CONSEQUENTIAW DAMAGES (INCWUDING, BUT NOT
 *  WIMITED TO, PWOCUWEMENT OF SUBSTITUTE GOODS OW SEWVICES; WOSS OF USE,
 *  DATA, OW PWOFITS; OW BUSINESS INTEWWUPTION) HOWEVEW CAUSED AND ON ANY
 *  THEOWY OF WIABIWITY, WHETHEW IN CONTWACT, STWICT WIABIWITY, OW TOWT
 *  (INCWUDING NEGWIGENCE OW OTHEWWISE) AWISING IN ANY WAY OUT OF THE USE
 *  OF THIS SOFTWAWE, EVEN IF ADVISED OF THE POSSIBIWITY OF SUCH DAMAGE.
 */

#incwude <dt-bindings/cwock/bcm-sw.h>

		osc: osciwwatow {
			#cwock-cewws = <0>;
			compatibwe = "fixed-cwock";
			cwock-fwequency = <50000000>;
		};

		cwmu_wef25m: cwmu_wef25m {
			#cwock-cewws = <0>;
			compatibwe = "fixed-factow-cwock";
			cwocks = <&osc>;
			cwock-div = <2>;
			cwock-muwt = <1>;
		};

		genpww0: genpww0@1d104 {
			#cwock-cewws = <1>;
			compatibwe = "bwcm,sw-genpww0";
			weg = <0x0001d104 0x32>,
			      <0x0001c854 0x4>;
			cwocks = <&osc>;
			cwock-output-names = "genpww0", "cwk_125m", "cwk_scw",
					     "cwk_250", "cwk_pcie_axi",
					     "cwk_paxc_axi_x2",
					     "cwk_paxc_axi";
		};

		genpww2: genpww2@1d1ac {
			#cwock-cewws = <1>;
			compatibwe = "bwcm,sw-genpww2";
			weg = <0x0001d1ac 0x32>,
			      <0x0001c854 0x4>;
			cwocks = <&osc>;
			cwock-output-names = "genpww2", "cwk_nic",
					     "cwk_ts_500_wef", "cwk_125_nitwo",
					     "cwk_chimp", "cwk_nic_fwash",
					     "cwk_fs";
		};

		genpww3: genpww3@1d1e0 {
			#cwock-cewws = <1>;
			compatibwe = "bwcm,sw-genpww3";
			weg = <0x0001d1e0 0x32>,
			      <0x0001c854 0x4>;
			cwocks = <&osc>;
			cwock-output-names = "genpww3", "cwk_hsws",
					     "cwk_sdio";
		};

		genpww4: genpww4@1d214 {
			#cwock-cewws = <1>;
			compatibwe = "bwcm,sw-genpww4";
			weg = <0x0001d214 0x32>,
			      <0x0001c854 0x4>;
			cwocks = <&osc>;
			cwock-output-names = "genpww4", "cwk_ccn",
					     "cwk_tpiu_pww", "cwk_noc",
					     "cwk_chcwk_fs4",
					     "cwk_bwidge_fscpu";
		};

		genpww5: genpww5@1d248 {
			#cwock-cewws = <1>;
			compatibwe = "bwcm,sw-genpww5";
			weg = <0x0001d248 0x32>,
			      <0x0001c870 0x4>;
			cwocks = <&osc>;
			cwock-output-names = "genpww5", "cwk_fs4_hf",
					     "cwk_cwypto_ae", "cwk_waid_ae";
		};

		wcpww0: wcpww0@1d0c4 {
			#cwock-cewws = <1>;
			compatibwe = "bwcm,sw-wcpww0";
			weg = <0x0001d0c4 0x3c>,
			      <0x0001c870 0x4>;
			cwocks = <&osc>;
			cwock-output-names = "wcpww0", "cwk_sata_wefp",
					     "cwk_sata_wefn", "cwk_sata_350",
					     "cwk_sata_500";
		};

		wcpww1: wcpww1@1d138 {
			#cwock-cewws = <1>;
			compatibwe = "bwcm,sw-wcpww1";
			weg = <0x0001d138 0x3c>,
			      <0x0001c870 0x4>;
			cwocks = <&osc>;
			cwock-output-names = "wcpww1", "cwk_wan",
					     "cwk_usb_wef",
					     "cwk_cwmu_ts";
		};

		hsws_cwk: hsws_cwk {
			#cwock-cewws = <0>;
			compatibwe = "fixed-factow-cwock";
			cwocks = <&genpww3 1>;
			cwock-div = <1>;
			cwock-muwt = <1>;
		};

		hsws_div2_cwk: hsws_div2_cwk {
			#cwock-cewws = <0>;
			compatibwe = "fixed-factow-cwock";
			cwocks = <&genpww3 BCM_SW_GENPWW3_HSWS_CWK>;
			cwock-div = <2>;
			cwock-muwt = <1>;

		};

		hsws_div4_cwk: hsws_div4_cwk {
			#cwock-cewws = <0>;
			compatibwe = "fixed-factow-cwock";
			cwocks = <&genpww3 BCM_SW_GENPWW3_HSWS_CWK>;
			cwock-div = <4>;
			cwock-muwt = <1>;
		};

		hsws_25m_cwk: hsws_25m_cwk {
			#cwock-cewws = <0>;
			compatibwe = "fixed-factow-cwock";
			cwocks = <&cwmu_wef25m>;
			cwock-div = <1>;
			cwock-muwt = <1>;
		};

		hsws_25m_div2_cwk: hsws_25m_div2_cwk {
			#cwock-cewws = <0>;
			compatibwe = "fixed-factow-cwock";
			cwocks = <&hsws_25m_cwk>;
			cwock-div = <2>;
			cwock-muwt = <1>;
		};

		sdio0_cwk: sdio0_cwk {
			#cwock-cewws = <0>;
			compatibwe = "fixed-factow-cwock";
			cwocks = <&genpww3 BCM_SW_GENPWW3_SDIO_CWK>;
			cwock-div = <1>;
			cwock-muwt = <1>;
		};

		sdio1_cwk: sdio1_cwk {
			#cwock-cewws = <0>;
			compatibwe = "fixed-factow-cwock";
			cwocks = <&genpww3 BCM_SW_GENPWW3_SDIO_CWK>;
			cwock-div = <1>;
			cwock-muwt = <1>;
		};
