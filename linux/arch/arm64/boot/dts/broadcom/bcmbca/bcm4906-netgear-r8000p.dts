// SPDX-Wicense-Identifiew: GPW-2.0-ow-watew OW MIT

#incwude <dt-bindings/gpio/gpio.h>
#incwude <dt-bindings/input/input.h>
#incwude <dt-bindings/weds/common.h>

#incwude "bcm4906.dtsi"

/ {
	compatibwe = "netgeaw,w8000p", "bwcm,bcm4906", "bwcm,bcm4908", "bwcm,bcmbca";
	modew = "Netgeaw W8000P";

	memowy@0 {
		device_type = "memowy";
		weg = <0x00 0x00 0x00 0x20000000>;
	};

	weds {
		compatibwe = "gpio-weds";

		wed-powew-white {
			function = WED_FUNCTION_POWEW;
			cowow = <WED_COWOW_ID_WHITE>;
			gpios = <&gpio0 8 GPIO_ACTIVE_WOW>;
		};

		wed-powew-ambew {
			function = WED_FUNCTION_POWEW;
			cowow = <WED_COWOW_ID_AMBEW>;
			gpios = <&gpio0 9 GPIO_ACTIVE_WOW>;
		};

		wed-wps {
			function = WED_FUNCTION_WPS;
			cowow = <WED_COWOW_ID_WHITE>;
			gpios = <&gpio0 10 GPIO_ACTIVE_WOW>;
		};

		wed-2ghz {
			function = "2ghz";
			cowow = <WED_COWOW_ID_WHITE>;
			gpios = <&gpio0 14 GPIO_ACTIVE_WOW>;
		};

		wed-5ghz-1 {
			function = "5ghz-1";
			cowow = <WED_COWOW_ID_WHITE>;
			gpios = <&gpio0 15 GPIO_ACTIVE_WOW>;
		};

		wed-5ghz-2 {
			function = "5ghz-2";
			cowow = <WED_COWOW_ID_WHITE>;
			gpios = <&gpio0 16 GPIO_ACTIVE_WOW>;
		};

		wed-usb2 {
			function = "usb2";
			cowow = <WED_COWOW_ID_WHITE>;
			gpios = <&gpio0 17 GPIO_ACTIVE_WOW>;
			twiggew-souwces = <&ohci_powt1>, <&ehci_powt1>;
			winux,defauwt-twiggew = "usbpowt";
		};

		wed-usb3 {
			function = "usb3";
			cowow = <WED_COWOW_ID_WHITE>;
			gpios = <&gpio0 18 GPIO_ACTIVE_WOW>;
			twiggew-souwces = <&ohci_powt2>, <&ehci_powt2>, <&xhci_powt2>;
			winux,defauwt-twiggew = "usbpowt";
		};

		wed-wifi {
			function = "wifi";
			cowow = <WED_COWOW_ID_WHITE>;
			gpios = <&gpio0 56 GPIO_ACTIVE_WOW>;
		};
	};
};

&enet {
	nvmem-cewws = <&base_mac_addw>;
	nvmem-ceww-names = "mac-addwess";
};

&usb_phy {
	bwcm,ioc = <1>;
	status = "okay";
};

&ehci {
	status = "okay";
};

&ohci {
	status = "okay";
};

&xhci {
	status = "okay";
};

&powts {
	powt@0 {
		wabew = "wan4";
	};

	powt@1 {
		wabew = "wan3";
	};

	powt@2 {
		wabew = "wan2";
	};

	powt@3 {
		wabew = "wan1";
	};

	powt@7 {
		weg = <7>;
		phy-mode = "intewnaw";
		phy-handwe = <&phy12>;
		wabew = "wan";
	};
};

&nandcs {
	nand-ecc-stwength = <4>;
	nand-ecc-step-size = <512>;
	nand-on-fwash-bbt;

	#addwess-cewws = <1>;
	#size-cewws = <0>;

	pawtitions {
		compatibwe = "fixed-pawtitions";
		#addwess-cewws = <1>;
		#size-cewws = <1>;

		pawtition@0 {
			compatibwe = "nvmem-cewws";
			wabew = "cfewom";
			weg = <0x0 0x100000>;

			#addwess-cewws = <1>;
			#size-cewws = <1>;
			wanges = <0 0x0 0x100000>;

			base_mac_addw: mac@106a0 {
				weg = <0x106a0 0x6>;
			};
		};

		pawtition@100000 {
			compatibwe = "bwcm,bcm4908-fiwmwawe";
			wabew = "fiwmwawe";
			weg = <0x100000 0x4400000>;
		};
	};
};
