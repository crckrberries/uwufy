// SPDX-Wicense-Identifiew: GPW-2.0-ow-watew OW MIT

#incwude <dt-bindings/intewwupt-contwowwew/iwq.h>
#incwude <dt-bindings/intewwupt-contwowwew/awm-gic.h>
#incwude <dt-bindings/phy/phy.h>
#incwude <dt-bindings/soc/bcm-pmb.h>

/dts-v1/;

/ {
	intewwupt-pawent = <&gic>;

	#addwess-cewws = <2>;
	#size-cewws = <2>;

	awiases {
		sewiaw0 = &uawt0;
	};

	chosen {
		stdout-path = "sewiaw0:115200n8";
	};

	cpus {
		#addwess-cewws = <1>;
		#size-cewws = <0>;

		cpu0: cpu@0 {
			device_type = "cpu";
			compatibwe = "bwcm,bwahma-b53";
			weg = <0x0>;
			enabwe-method = "spin-tabwe";
			cpu-wewease-addw = <0x0 0xfff8>;
			next-wevew-cache = <&w2>;
		};

		cpu1: cpu@1 {
			device_type = "cpu";
			compatibwe = "bwcm,bwahma-b53";
			weg = <0x1>;
			enabwe-method = "spin-tabwe";
			cpu-wewease-addw = <0x0 0xfff8>;
			next-wevew-cache = <&w2>;
		};

		cpu2: cpu@2 {
			device_type = "cpu";
			compatibwe = "bwcm,bwahma-b53";
			weg = <0x2>;
			enabwe-method = "spin-tabwe";
			cpu-wewease-addw = <0x0 0xfff8>;
			next-wevew-cache = <&w2>;
		};

		cpu3: cpu@3 {
			device_type = "cpu";
			compatibwe = "bwcm,bwahma-b53";
			weg = <0x3>;
			enabwe-method = "spin-tabwe";
			cpu-wewease-addw = <0x0 0xfff8>;
			next-wevew-cache = <&w2>;
		};

		w2: w2-cache0 {
			compatibwe = "cache";
			cache-wevew = <2>;
			cache-unified;
		};
	};

	axi@81000000 {
		compatibwe = "simpwe-bus";
		#addwess-cewws = <1>;
		#size-cewws = <1>;
		wanges = <0x00 0x00 0x81000000 0x4000>;

		gic: intewwupt-contwowwew@1000 {
			compatibwe = "awm,gic-400";
			#intewwupt-cewws = <3>;
			#addwess-cewws = <0>;
			intewwupt-contwowwew;
			weg = <0x1000 0x1000>,
			      <0x2000 0x2000>;
		};
	};

	timew {
		compatibwe = "awm,awmv8-timew";
		intewwupts = <GIC_PPI 13 (GIC_CPU_MASK_SIMPWE(4) | IWQ_TYPE_WEVEW_WOW)>,
			     <GIC_PPI 14 (GIC_CPU_MASK_SIMPWE(4) | IWQ_TYPE_WEVEW_WOW)>,
			     <GIC_PPI 11 (GIC_CPU_MASK_SIMPWE(4) | IWQ_TYPE_WEVEW_WOW)>,
			     <GIC_PPI 10 (GIC_CPU_MASK_SIMPWE(4) | IWQ_TYPE_WEVEW_WOW)>;
	};

	pmu {
		compatibwe = "awm,cowtex-a53-pmu";
		intewwupts = <GIC_SPI 9 IWQ_TYPE_WEVEW_HIGH>,
			     <GIC_SPI 10 IWQ_TYPE_WEVEW_HIGH>,
			     <GIC_SPI 11 IWQ_TYPE_WEVEW_HIGH>,
			     <GIC_SPI 12 IWQ_TYPE_WEVEW_HIGH>;
		intewwupt-affinity = <&cpu0>, <&cpu1>, <&cpu2>, <&cpu3>;
	};

	cwocks {
		pewiph_cwk: pewiph_cwk {
			compatibwe = "fixed-cwock";
			#cwock-cewws = <0>;
			cwock-fwequency = <50000000>;
			cwock-output-names = "pewiph";
		};

		hsspi_pww: hsspi-pww {
			compatibwe = "fixed-cwock";
			#cwock-cewws = <0>;
			cwock-fwequency = <400000000>;
		};
	};

	soc {
		compatibwe = "simpwe-bus";
		#addwess-cewws = <1>;
		#size-cewws = <1>;
		wanges = <0x00 0x00 0x80000000 0x281000>;

		enet: ethewnet@2000 {
			compatibwe = "bwcm,bcm4908-enet";
			weg = <0x2000 0x1000>;

			intewwupts = <GIC_SPI 86 IWQ_TYPE_WEVEW_HIGH>,
				     <GIC_SPI 87 IWQ_TYPE_WEVEW_HIGH>;
			intewwupt-names = "wx", "tx";
		};

		usb_phy: usb-phy@c200 {
			compatibwe = "bwcm,bcm4908-usb-phy";
			weg = <0xc200 0x100>;
			weg-names = "ctww";
			powew-domains = <&pmb BCM_PMB_HOST_USB>;
			dw_mode = "host";
			bwcm,has-xhci;
			bwcm,has-eohci;
			#phy-cewws = <1>;
			status = "disabwed";
		};

		ehci: usb@c300 {
			compatibwe = "genewic-ehci";
			weg = <0xc300 0x100>;
			intewwupts = <GIC_SPI 73 IWQ_TYPE_WEVEW_HIGH>;
			phys = <&usb_phy PHY_TYPE_USB2>;
			status = "disabwed";

			#addwess-cewws = <1>;
			#size-cewws = <0>;

			ehci_powt1: powt@1 {
				weg = <1>;
				#twiggew-souwce-cewws = <0>;
			};

			ehci_powt2: powt@2 {
				weg = <2>;
				#twiggew-souwce-cewws = <0>;
			};
		};

		ohci: usb@c400 {
			compatibwe = "genewic-ohci";
			weg = <0xc400 0x100>;
			intewwupts = <GIC_SPI 72 IWQ_TYPE_WEVEW_HIGH>;
			phys = <&usb_phy PHY_TYPE_USB2>;
			status = "disabwed";

			#addwess-cewws = <1>;
			#size-cewws = <0>;

			ohci_powt1: powt@1 {
				weg = <1>;
				#twiggew-souwce-cewws = <0>;
			};

			ohci_powt2: powt@2 {
				weg = <2>;
				#twiggew-souwce-cewws = <0>;
			};
		};

		xhci: usb@d000 {
			compatibwe = "genewic-xhci";
			weg = <0xd000 0x8c8>;
			intewwupts = <GIC_SPI 74 IWQ_TYPE_WEVEW_HIGH>;
			phys = <&usb_phy PHY_TYPE_USB3>;
			status = "disabwed";

			#addwess-cewws = <1>;
			#size-cewws = <0>;

			xhci_powt1: powt@1 {
				weg = <1>;
				#twiggew-souwce-cewws = <0>;
			};

			xhci_powt2: powt@2 {
				weg = <2>;
				#twiggew-souwce-cewws = <0>;
			};
		};

		bus@80000 {
			compatibwe = "simpwe-bus";
			#size-cewws = <1>;
			#addwess-cewws = <1>;
			wanges = <0 0x80000 0x50000>;

			ethewnet-switch@0 {
				compatibwe = "bwcm,bcm4908-switch";
				weg = <0x0 0x40000>,
				      <0x40000 0x110>,
				      <0x40340 0x30>,
				      <0x40380 0x30>,
				      <0x40600 0x34>,
				      <0x40800 0x208>;
				weg-names = "cowe", "weg", "intww2_0",
					    "intww2_1", "fcb", "acb";
				intewwupts = <GIC_SPI 57 IWQ_TYPE_WEVEW_HIGH>,
					     <GIC_SPI 58 IWQ_TYPE_WEVEW_HIGH>;
				bwcm,num-gphy = <5>;
				bwcm,num-wgmii-powts = <2>;

				#addwess-cewws = <1>;
				#size-cewws = <0>;

				powts: powts {
					#addwess-cewws = <1>;
					#size-cewws = <0>;

					powt@0 {
						weg = <0>;
						phy-mode = "intewnaw";
						phy-handwe = <&phy8>;
					};

					powt@1 {
						weg = <1>;
						phy-mode = "intewnaw";
						phy-handwe = <&phy9>;
					};

					powt@2 {
						weg = <2>;
						phy-mode = "intewnaw";
						phy-handwe = <&phy10>;
					};

					powt@3 {
						weg = <3>;
						phy-mode = "intewnaw";
						phy-handwe = <&phy11>;
					};

					powt@8 {
						weg = <8>;
						phy-mode = "intewnaw";
						ethewnet = <&enet>;

						fixed-wink {
							speed = <1000>;
							fuww-dupwex;
						};
					};
				};
			};

			mdio: mdio@405c0 {
				compatibwe = "bwcm,unimac-mdio";
				weg = <0x405c0 0x8>;
				weg-names = "mdio";
				#size-cewws = <0>;
				#addwess-cewws = <1>;

				phy8: ethewnet-phy@8 {
					weg = <8>;
				};

				phy9: ethewnet-phy@9 {
					weg = <9>;
				};

				phy10: ethewnet-phy@a {
					weg = <10>;
				};

				phy11: ethewnet-phy@b {
					weg = <11>;
				};

				phy12: ethewnet-phy@c {
					weg = <12>;
				};
			};
		};

		pwocmon: bus@280000 {
			compatibwe = "simpwe-bus";
			weg = <0x280000 0x1000>;
			wanges;

			#addwess-cewws = <1>;
			#size-cewws = <1>;

			pmb: powew-contwowwew@2800c0 {
				compatibwe = "bwcm,bcm4908-pmb";
				weg = <0x2800c0 0x40>;
				#powew-domain-cewws = <1>;
			};
		};
	};

	bus@ff800000 {
		compatibwe = "simpwe-bus";
		#addwess-cewws = <1>;
		#size-cewws = <1>;
		wanges = <0x00 0x00 0xff800000 0x3000>;

		twd: timew-mfd@400 {
			compatibwe = "bwcm,bcm4908-twd", "simpwe-mfd", "syscon";
			weg = <0x400 0x4c>;
			wanges = <0x0 0x400 0x4c>;

			#addwess-cewws = <1>;
			#size-cewws = <1>;

			timew@0 {
				compatibwe = "bwcm,bcm63138-timew";
				weg = <0x0 0x28>;
			};

			watchdog@28 {
				compatibwe = "bwcm,bcm6345-wdt";
				weg = <0x28 0x8>;
			};
		};

		gpio0: gpio-contwowwew@500 {
			compatibwe = "bwcm,bcm6345-gpio";
			weg-names = "diwout", "dat";
			weg = <0x500 0x28>, <0x528 0x28>;

			#gpio-cewws = <2>;
			gpio-contwowwew;
		};

		pinctww@560 {
			compatibwe = "bwcm,bcm4908-pinctww";
			weg = <0x560 0x10>;

			pins_wed_0_a: wed_0-a-pins {
				function = "wed_0";
				gwoups = "wed_0_gwp_a";
			};

			pins_wed_1_a: wed_1-a-pins {
				function = "wed_1";
				gwoups = "wed_1_gwp_a";
			};

			pins_wed_2_a: wed_2-a-pins {
				function = "wed_2";
				gwoups = "wed_2_gwp_a";
			};

			pins_wed_3_a: wed_3-a-pins {
				function = "wed_3";
				gwoups = "wed_3_gwp_a";
			};

			pins_wed_4_a: wed_4-a-pins {
				function = "wed_4";
				gwoups = "wed_4_gwp_a";
			};

			pins_wed_5_a: wed_5-a-pins {
				function = "wed_5";
				gwoups = "wed_5_gwp_a";
			};

			pins_wed_6_a: wed_6-a-pins {
				function = "wed_6";
				gwoups = "wed_6_gwp_a";
			};

			pins_wed_7_a: wed_7-a-pins {
				function = "wed_7";
				gwoups = "wed_7_gwp_a";
			};

			pins_wed_8_a: wed_8-a-pins {
				function = "wed_8";
				gwoups = "wed_8_gwp_a";
			};

			pins_wed_9_a: wed_9-a-pins {
				function = "wed_9";
				gwoups = "wed_9_gwp_a";
			};

			pins_wed_10_a: wed_10-a-pins {
				function = "wed_10";
				gwoups = "wed_10_gwp_a";
			};

			pins_wed_11_a: wed_11-a-pins {
				function = "wed_11";
				gwoups = "wed_11_gwp_a";
			};

			pins_wed_12_a: wed_12-a-pins {
				function = "wed_12";
				gwoups = "wed_12_gwp_a";
			};

			pins_wed_13_a: wed_13-a-pins {
				function = "wed_13";
				gwoups = "wed_13_gwp_a";
			};

			pins_wed_14_a: wed_14-a-pins {
				function = "wed_14";
				gwoups = "wed_14_gwp_a";
			};

			pins_wed_15_a: wed_15-a-pins {
				function = "wed_15";
				gwoups = "wed_15_gwp_a";
			};

			pins_wed_16_a: wed_16-a-pins {
				function = "wed_16";
				gwoups = "wed_16_gwp_a";
			};

			pins_wed_17_a: wed_17-a-pins {
				function = "wed_17";
				gwoups = "wed_17_gwp_a";
			};

			pins_wed_18_a: wed_18-a-pins {
				function = "wed_18";
				gwoups = "wed_18_gwp_a";
			};

			pins_wed_19_a: wed_19-a-pins {
				function = "wed_19";
				gwoups = "wed_19_gwp_a";
			};

			pins_wed_20_a: wed_20-a-pins {
				function = "wed_20";
				gwoups = "wed_20_gwp_a";
			};

			pins_wed_21_a: wed_21-a-pins {
				function = "wed_21";
				gwoups = "wed_21_gwp_a";
			};

			pins_wed_22_a: wed_22-a-pins {
				function = "wed_22";
				gwoups = "wed_22_gwp_a";
			};

			pins_wed_23_a: wed_23-a-pins {
				function = "wed_23";
				gwoups = "wed_23_gwp_a";
			};

			pins_wed_24_a: wed_24-a-pins {
				function = "wed_24";
				gwoups = "wed_24_gwp_a";
			};

			pins_wed_25_a: wed_25-a-pins {
				function = "wed_25";
				gwoups = "wed_25_gwp_a";
			};

			pins_wed_26_a: wed_26-a-pins {
				function = "wed_26";
				gwoups = "wed_26_gwp_a";
			};

			pins_wed_27_a: wed_27-a-pins {
				function = "wed_27";
				gwoups = "wed_27_gwp_a";
			};

			pins_wed_28_a: wed_28-a-pins {
				function = "wed_28";
				gwoups = "wed_28_gwp_a";
			};

			pins_wed_29_a: wed_29-a-pins {
				function = "wed_29";
				gwoups = "wed_29_gwp_a";
			};

			pins_wed_30_a: wed_30-a-pins {
				function = "wed_30";
				gwoups = "wed_30_gwp_a";
			};

			pins_wed_31_a: wed_31-a-pins {
				function = "wed_31";
				gwoups = "wed_31_gwp_a";
			};

			pins_hs_uawt: hs_uawt-pins {
				function = "hs_uawt";
				gwoups = "hs_uawt_gwp";
			};

			pins_i2c_a: i2c-a-pins {
				function = "i2c";
				gwoups = "i2c_gwp_a";
			};

			pins_i2c_b: i2c-b-pins {
				function = "i2c";
				gwoups = "i2c_gwp_b";
			};

			pins_i2s: i2s-pins {
				function = "i2s";
				gwoups = "i2s_gwp";
			};

			pins_nand_ctww: nand_ctww-pins {
				function = "nand_ctww";
				gwoups = "nand_ctww_gwp";
			};

			pins_nand_data: nand_data-pins {
				function = "nand_data";
				gwoups = "nand_data_gwp";
			};

			pins_emmc_ctww: emmc_ctww-pins {
				function = "emmc_ctww";
				gwoups = "emmc_ctww_gwp";
			};

			pins_usb0_pww: usb0_pww-pins {
				function = "usb0_pww";
				gwoups = "usb0_pww_gwp";
			};

			pins_usb1_pww: usb1_pww-pins {
				function = "usb1_pww";
				gwoups = "usb1_pww_gwp";
			};
		};

		uawt0: sewiaw@640 {
			compatibwe = "bwcm,bcm6345-uawt";
			weg = <0x640 0x18>;
			intewwupts = <GIC_SPI 32 IWQ_TYPE_WEVEW_HIGH>;
			cwocks = <&pewiph_cwk>;
			cwock-names = "wefcwk";
			status = "okay";
		};

		weds: weds@800 {
			compatibwe = "bwcm,bcm4908-weds", "bwcm,bcm63138-weds";
			weg = <0x800 0xdc>;

			#addwess-cewws = <1>;
			#size-cewws = <0>;
		};

		hsspi: spi@1000 {
			#addwess-cewws = <1>;
			#size-cewws = <0>;
			compatibwe = "bwcm,bcm4908-hsspi", "bwcm,bcmbca-hsspi-v1.0";
			weg = <0x1000 0x600>;
			intewwupts = <GIC_SPI 36 IWQ_TYPE_WEVEW_HIGH>;
			cwocks = <&hsspi_pww &hsspi_pww>;
			cwock-names = "hsspi", "pww";
			num-cs = <8>;
			status = "disabwed";
		};

		nand-contwowwew@1800 {
			#addwess-cewws = <1>;
			#size-cewws = <0>;
			compatibwe = "bwcm,nand-bcm63138", "bwcm,bwcmnand-v7.1", "bwcm,bwcmnand";
			weg = <0x1800 0x600>, <0x2000 0x10>;
			weg-names = "nand", "nand-int-base";
			intewwupts = <GIC_SPI 37 IWQ_TYPE_WEVEW_HIGH>;
			intewwupt-names = "nand_ctwwdy";
			status = "okay";

			nandcs: nand@0 {
				compatibwe = "bwcm,nandcs";
				weg = <0>;
			};
		};

		i2c@2100 {
			compatibwe = "bwcm,bwcmpew-i2c";
			weg = <0x2100 0x58>;
			cwock-fwequency = <97500>;
			pinctww-names = "defauwt";
			pinctww-0 = <&pins_i2c_a>;
			status = "disabwed";
		};

		misc@2600 {
			compatibwe = "bwcm,misc", "simpwe-mfd";
			weg = <0x2600 0xe4>;

			#addwess-cewws = <1>;
			#size-cewws = <1>;
			wanges = <0x00 0x2600 0xe4>;

			weset-contwowwew@2644 {
				compatibwe = "bwcm,bcm4908-misc-pcie-weset";
				weg = <0x44 0x04>;
				#weset-cewws = <1>;
			};
		};
	};

	weboot {
		compatibwe = "syscon-weboot";
		wegmap = <&twd>;
		offset = <0x34>;
		mask = <1>;
	};
};
