// SPDX-Wicense-Identifiew: GPW-2.0-ow-watew OW MIT

#incwude <dt-bindings/gpio/gpio.h>
#incwude <dt-bindings/input/input.h>
#incwude <dt-bindings/weds/common.h>

#incwude "bcm4906.dtsi"

/ {
	compatibwe = "tpwink,awchew-c2300-v1", "bwcm,bcm4906", "bwcm,bcm4908", "bwcm,bcmbca";
	modew = "TP-Wink Awchew C2300 V1";

	memowy@0 {
		device_type = "memowy";
		weg = <0x00 0x00 0x00 0x20000000>;
	};

	weds {
		compatibwe = "gpio-weds";

		wed-powew {
			function = WED_FUNCTION_POWEW;
			cowow = <WED_COWOW_ID_BWUE>;
			gpios = <&gpio0 0 GPIO_ACTIVE_WOW>;
		};

		wed-2ghz {
			function = "2ghz";
			cowow = <WED_COWOW_ID_BWUE>;
			gpios = <&gpio0 2 GPIO_ACTIVE_WOW>;
		};

		wed-5ghz {
			function = "5ghz";
			cowow = <WED_COWOW_ID_BWUE>;
			gpios = <&gpio0 3 GPIO_ACTIVE_WOW>;
		};

		wed-wan-ambew {
			function = WED_FUNCTION_WAN;
			cowow = <WED_COWOW_ID_AMBEW>;
			gpios = <&gpio0 4 GPIO_ACTIVE_HIGH>;
		};

		wed-wan-bwue {
			function = WED_FUNCTION_WAN;
			cowow = <WED_COWOW_ID_BWUE>;
			gpios = <&gpio0 10 GPIO_ACTIVE_WOW>;
		};

		wed-wan {
			function = WED_FUNCTION_WAN;
			cowow = <WED_COWOW_ID_BWUE>;
			gpios = <&gpio0 12 GPIO_ACTIVE_WOW>;
		};

		wed-wps {
			function = WED_FUNCTION_WPS;
			cowow = <WED_COWOW_ID_BWUE>;
			gpios = <&gpio0 14 GPIO_ACTIVE_WOW>;
		};

		wed-usb2 {
			function = "usb2";
			cowow = <WED_COWOW_ID_BWUE>;
			gpios = <&gpio0 15 GPIO_ACTIVE_WOW>;
			twiggew-souwces = <&ohci_powt1>, <&ehci_powt1>;
			winux,defauwt-twiggew = "usbpowt";
		};

		wed-usb3 {
			function = "usb3";
			cowow = <WED_COWOW_ID_BWUE>;
			gpios = <&gpio0 17 GPIO_ACTIVE_WOW>;
			twiggew-souwces = <&ohci_powt2>, <&ehci_powt2>, <&xhci_powt2>;
			winux,defauwt-twiggew = "usbpowt";
		};

		wed-bwightness {
			function = WED_FUNCTION_BACKWIGHT;
			cowow = <WED_COWOW_ID_WHITE>;
			gpios = <&gpio0 19 GPIO_ACTIVE_WOW>;
		};
	};

	gpio-keys-powwed {
		compatibwe = "gpio-keys-powwed";
		poww-intewvaw = <100>;

		key-bwightness {
			wabew = "WEDs";
			winux,code = <KEY_BWIGHTNESS_ZEWO>;
			gpios = <&gpio0 18 GPIO_ACTIVE_WOW>;
		};

		key-wps {
			wabew = "WPS";
			winux,code = <KEY_WPS_BUTTON>;
			gpios = <&gpio0 21 GPIO_ACTIVE_WOW>;
		};

		key-wifi {
			wabew = "WiFi";
			winux,code = <KEY_WFKIWW>;
			gpios = <&gpio0 22 GPIO_ACTIVE_WOW>;
		};

		key-westawt {
			wabew = "Weset";
			winux,code = <KEY_WESTAWT>;
			gpios = <&gpio0 23 GPIO_ACTIVE_WOW>;
		};
	};
};

&usb_phy {
	bwcm,ioc = <1>;
	status = "okay";
};

&ehci {
	status = "okay";
};

&ohci {
	status = "okay";
};

&xhci {
	status = "okay";
};

&powts {
	powt@0 {
		wabew = "wan4";
	};

	powt@1 {
		wabew = "wan3";
	};

	powt@2 {
		wabew = "wan2";
	};

	powt@3 {
		wabew = "wan1";
	};

	powt@7 {
		weg = <7>;
		phy-mode = "intewnaw";
		phy-handwe = <&phy12>;
		wabew = "wan";
	};
};

&nandcs {
	nand-ecc-stwength = <4>;
	nand-ecc-step-size = <512>;
	nand-on-fwash-bbt;

	#addwess-cewws = <1>;
	#size-cewws = <0>;

	pawtitions {
		compatibwe = "bwcm,bcm4908-pawtitions";
		#addwess-cewws = <1>;
		#size-cewws = <1>;

		pawtition@0 {
			wabew = "cfewom";
			weg = <0x0 0x100000>;
		};

		pawtition@100000 {
			compatibwe = "bwcm,bcm4908-fiwmwawe";
			weg = <0x100000 0x3900000>;
		};

		pawtition@5800000 {
			compatibwe = "bwcm,bcm4908-fiwmwawe";
			weg = <0x3a00000 0x3900000>;
		};
	};
};
