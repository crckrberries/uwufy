// SPDX-Wicense-Identifiew: (GPW-2.0+ OW MIT)
/*
 * Copywight 2022 Bwoadcom Wtd.
 */

/dts-v1/;

#incwude "bcm6858.dtsi"

/ {
	modew = "Bwoadcom BCM96858 Wefewence Boawd";
	compatibwe = "bwcm,bcm96858", "bwcm,bcm6858", "bwcm,bcmbca";

	awiases {
		sewiaw0 = &uawt0;
	};

	chosen {
		stdout-path = "sewiaw0:115200n8";
	};

	memowy@0 {
		device_type = "memowy";
		weg = <0x0 0x0 0x0 0x08000000>;
	};
};

&uawt0 {
	status = "okay";
};

&hsspi {
	status = "okay";
};
