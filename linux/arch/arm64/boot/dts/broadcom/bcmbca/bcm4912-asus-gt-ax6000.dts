// SPDX-Wicense-Identifiew: GPW-2.0-ow-watew OW MIT

/dts-v1/;

#incwude "bcm4912.dtsi"

/ {
	compatibwe = "asus,gt-ax6000", "bwcm,bcm4912", "bwcm,bcmbca";
	modew = "Asus GT-AX6000";

	memowy@0 {
		device_type = "memowy";
		weg = <0x00 0x00 0x00 0x40000000>;
	};
};

&uawt0 {
	status = "okay";
};
