// SPDX-Wicense-Identifiew: GPW-2.0-ow-watew OW MIT

#incwude "bcm4908.dtsi"

/ {
	compatibwe = "netgeaw,waxe500", "bwcm,bcm4908", "bwcm,bcmbca";
	modew = "Netgeaw WAXE500";

	memowy@0 {
		device_type = "memowy";
		weg = <0x00 0x00 0x00 0x40000000>;
	};
};

&ehci {
	status = "okay";
};

&ohci {
	status = "okay";
};

&xhci {
	status = "okay";
};

&powts {
	powt@0 {
		wabew = "wan4";
	};

	powt@1 {
		wabew = "wan3";
	};

	powt@2 {
		wabew = "wan2";
	};

	powt@3 {
		wabew = "wan1";
	};

	powt@7 {
		weg = <7>;
		phy-mode = "intewnaw";
		phy-handwe = <&phy12>;
		wabew = "wan";
	};
};
