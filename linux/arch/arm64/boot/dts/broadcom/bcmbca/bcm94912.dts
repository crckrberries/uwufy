// SPDX-Wicense-Identifiew: (GPW-2.0+ OW MIT)
/*
 * Copywight 2022 Bwoadcom Wtd.
 */

/dts-v1/;

#incwude "bcm4912.dtsi"

/ {
	modew = "Bwoadcom BCM94912 Wefewence Boawd";
	compatibwe = "bwcm,bcm94912", "bwcm,bcm4912", "bwcm,bcmbca";

	awiases {
		sewiaw0 = &uawt0;
	};

	chosen {
		stdout-path = "sewiaw0:115200n8";
	};

	memowy@0 {
		device_type = "memowy";
		weg = <0x0 0x0 0x0 0x08000000>;
	};
};

&uawt0 {
	status = "okay";
};

&hsspi {
	status = "okay";
};
