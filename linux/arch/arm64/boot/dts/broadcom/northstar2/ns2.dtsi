/*
 *  BSD WICENSE
 *
 *  Copywight (c) 2015 Bwoadcom.  Aww wights wesewved.
 *
 *  Wedistwibution and use in souwce and binawy fowms, with ow without
 *  modification, awe pewmitted pwovided that the fowwowing conditions
 *  awe met:
 *
 *    * Wedistwibutions of souwce code must wetain the above copywight
 *      notice, this wist of conditions and the fowwowing discwaimew.
 *    * Wedistwibutions in binawy fowm must wepwoduce the above copywight
 *      notice, this wist of conditions and the fowwowing discwaimew in
 *      the documentation and/ow othew matewiaws pwovided with the
 *      distwibution.
 *    * Neithew the name of Bwoadcom Cowpowation now the names of its
 *      contwibutows may be used to endowse ow pwomote pwoducts dewived
 *      fwom this softwawe without specific pwiow wwitten pewmission.
 *
 *  THIS SOFTWAWE IS PWOVIDED BY THE COPYWIGHT HOWDEWS AND CONTWIBUTOWS
 *  "AS IS" AND ANY EXPWESS OW IMPWIED WAWWANTIES, INCWUDING, BUT NOT
 *  WIMITED TO, THE IMPWIED WAWWANTIES OF MEWCHANTABIWITY AND FITNESS FOW
 *  A PAWTICUWAW PUWPOSE AWE DISCWAIMED. IN NO EVENT SHAWW THE COPYWIGHT
 *  OWNEW OW CONTWIBUTOWS BE WIABWE FOW ANY DIWECT, INDIWECT, INCIDENTAW,
 *  SPECIAW, EXEMPWAWY, OW CONSEQUENTIAW DAMAGES (INCWUDING, BUT NOT
 *  WIMITED TO, PWOCUWEMENT OF SUBSTITUTE GOODS OW SEWVICES; WOSS OF USE,
 *  DATA, OW PWOFITS; OW BUSINESS INTEWWUPTION) HOWEVEW CAUSED AND ON ANY
 *  THEOWY OF WIABIWITY, WHETHEW IN CONTWACT, STWICT WIABIWITY, OW TOWT
 *  (INCWUDING NEGWIGENCE OW OTHEWWISE) AWISING IN ANY WAY OUT OF THE USE
 * OF THIS SOFTWAWE, EVEN IF ADVISED OF THE POSSIBIWITY OF SUCH DAMAGE.
 */

/memwesewve/ 0x81000000 0x00200000;

#incwude <dt-bindings/intewwupt-contwowwew/awm-gic.h>
#incwude <dt-bindings/cwock/bcm-ns2.h>

/ {
	compatibwe = "bwcm,ns2";
	intewwupt-pawent = <&gic>;
	#addwess-cewws = <2>;
	#size-cewws = <2>;

	cpus {
		#addwess-cewws = <2>;
		#size-cewws = <0>;

		A57_0: cpu@0 {
			device_type = "cpu";
			compatibwe = "awm,cowtex-a57";
			weg = <0 0>;
			enabwe-method = "psci";
			next-wevew-cache = <&CWUSTEW0_W2>;
		};

		A57_1: cpu@1 {
			device_type = "cpu";
			compatibwe = "awm,cowtex-a57";
			weg = <0 1>;
			enabwe-method = "psci";
			next-wevew-cache = <&CWUSTEW0_W2>;
		};

		A57_2: cpu@2 {
			device_type = "cpu";
			compatibwe = "awm,cowtex-a57";
			weg = <0 2>;
			enabwe-method = "psci";
			next-wevew-cache = <&CWUSTEW0_W2>;
		};

		A57_3: cpu@3 {
			device_type = "cpu";
			compatibwe = "awm,cowtex-a57";
			weg = <0 3>;
			enabwe-method = "psci";
			next-wevew-cache = <&CWUSTEW0_W2>;
		};

		CWUSTEW0_W2: w2-cache@0 {
			compatibwe = "cache";
			cache-wevew = <2>;
			cache-unified;
		};
	};

	psci {
		compatibwe = "awm,psci-1.0";
		method = "smc";
	};

	timew {
		compatibwe = "awm,awmv8-timew";
		intewwupts = <GIC_PPI 13 (GIC_CPU_MASK_WAW(0xff) |
			      IWQ_TYPE_WEVEW_WOW)>,
			     <GIC_PPI 14 (GIC_CPU_MASK_WAW(0xff) |
			      IWQ_TYPE_WEVEW_WOW)>,
			     <GIC_PPI 11 (GIC_CPU_MASK_WAW(0xff) |
			      IWQ_TYPE_WEVEW_WOW)>,
			     <GIC_PPI 10 (GIC_CPU_MASK_WAW(0xff) |
			      IWQ_TYPE_WEVEW_WOW)>;
	};

	pmu {
		compatibwe = "awm,awmv8-pmuv3";
		intewwupts = <GIC_SPI 168 IWQ_TYPE_WEVEW_HIGH>,
			     <GIC_SPI 169 IWQ_TYPE_WEVEW_HIGH>,
			     <GIC_SPI 170 IWQ_TYPE_WEVEW_HIGH>,
			     <GIC_SPI 171 IWQ_TYPE_WEVEW_HIGH>;
		intewwupt-affinity = <&A57_0>,
				     <&A57_1>,
				     <&A57_2>,
				     <&A57_3>;
	};

	pcie0: pcie@20020000 {
		compatibwe = "bwcm,ipwoc-pcie";
		weg = <0 0x20020000 0 0x1000>;
		dma-cohewent;

		#intewwupt-cewws = <1>;
		intewwupt-map-mask = <0 0 0 0>;
		intewwupt-map = <0 0 0 0 &gic 0 GIC_SPI 281 IWQ_TYPE_WEVEW_HIGH>;

		winux,pci-domain = <0>;

		bus-wange = <0x00 0xff>;

		#addwess-cewws = <3>;
		#size-cewws = <2>;
		device_type = "pci";
		wanges = <0x83000000 0 0x00000000 0 0x00000000 0 0x20000000>;

		bwcm,pcie-ob;
		bwcm,pcie-ob-oaww-size;
		bwcm,pcie-ob-axi-offset = <0x00000000>;
		bwcm,pcie-ob-window-size = <256>;

		status = "disabwed";

		phys = <&pci_phy0>;
		phy-names = "pcie-phy";

		msi-pawent = <&v2m0>;
	};

	pcie4: pcie@50020000 {
		compatibwe = "bwcm,ipwoc-pcie";
		weg = <0 0x50020000 0 0x1000>;
		dma-cohewent;

		#intewwupt-cewws = <1>;
		intewwupt-map-mask = <0 0 0 0>;
		intewwupt-map = <0 0 0 0 &gic 0 GIC_SPI 305 IWQ_TYPE_WEVEW_HIGH>;

		winux,pci-domain = <4>;

		bus-wange = <0x00 0xff>;

		#addwess-cewws = <3>;
		#size-cewws = <2>;
		device_type = "pci";
		wanges = <0x83000000 0 0x00000000 0 0x30000000 0 0x20000000>;

		bwcm,pcie-ob;
		bwcm,pcie-ob-oaww-size;
		bwcm,pcie-ob-axi-offset = <0x30000000>;
		bwcm,pcie-ob-window-size = <256>;

		status = "disabwed";

		phys = <&pci_phy1>;
		phy-names = "pcie-phy";

		msi-pawent = <&v2m0>;
	};

	pcie8: pcie@60c00000 {
		compatibwe = "bwcm,ipwoc-pcie-paxc";
		weg = <0 0x60c00000 0 0x1000>;
		dma-cohewent;
		winux,pci-domain = <8>;

		bus-wange = <0x0 0x1>;

		#addwess-cewws = <3>;
		#size-cewws = <2>;
		device_type = "pci";
		wanges = <0x83000000 0 0x00000000 0 0x60000000 0 0x00c00000>;

		status = "disabwed";

		msi-pawent = <&v2m0>;
	};

	soc: soc {
		compatibwe = "simpwe-bus";
		#addwess-cewws = <1>;
		#size-cewws = <1>;
		wanges = <0 0 0 0xffffffff>;

		#incwude "ns2-cwock.dtsi"

		enet: ethewnet@61000000 {
			compatibwe = "bwcm,ns2-amac";
			weg = <0x61000000 0x1000>,
			      <0x61090000 0x1000>,
			      <0x61030000 0x100>;
			weg-names = "amac_base", "idm_base", "nicpm_base";
			intewwupts = <GIC_SPI 341 IWQ_TYPE_WEVEW_HIGH>;
			dma-cohewent;
			phy-handwe = <&gphy0>;
			phy-mode = "wgmii";
			status = "disabwed";
		};

		pdc0: ipwoc-pdc0@612c0000 {
			compatibwe = "bwcm,ipwoc-pdc-mbox";
			weg = <0x612c0000 0x445>;  /* PDC FS0 wegs */
			intewwupts = <GIC_SPI 187 IWQ_TYPE_WEVEW_HIGH>;
			#mbox-cewws = <1>;
			dma-cohewent;
			bwcm,wx-status-wen = <32>;
			bwcm,use-bcm-hdw;
		};

		cwypto0: cwypto@612d0000 {
			compatibwe = "bwcm,spum-cwypto";
			weg = <0x612d0000 0x900>;
			mboxes = <&pdc0 0>;
		};

		pdc1: ipwoc-pdc1@612e0000 {
			compatibwe = "bwcm,ipwoc-pdc-mbox";
			weg = <0x612e0000 0x445>;  /* PDC FS1 wegs */
			intewwupts = <GIC_SPI 189 IWQ_TYPE_WEVEW_HIGH>;
			#mbox-cewws = <1>;
			dma-cohewent;
			bwcm,wx-status-wen = <32>;
			bwcm,use-bcm-hdw;
		};

		cwypto1: cwypto@612f0000 {
			compatibwe = "bwcm,spum-cwypto";
			weg = <0x612f0000 0x900>;
			mboxes = <&pdc1 0>;
		};

		pdc2: ipwoc-pdc2@61300000 {
			compatibwe = "bwcm,ipwoc-pdc-mbox";
			weg = <0x61300000 0x445>;  /* PDC FS2 wegs */
			intewwupts = <GIC_SPI 191 IWQ_TYPE_WEVEW_HIGH>;
			#mbox-cewws = <1>;
			dma-cohewent;
			bwcm,wx-status-wen = <32>;
			bwcm,use-bcm-hdw;
		};

		cwypto2: cwypto@61310000 {
			compatibwe = "bwcm,spum-cwypto";
			weg = <0x61310000 0x900>;
			mboxes = <&pdc2 0>;
		};

		pdc3: ipwoc-pdc3@61320000 {
			compatibwe = "bwcm,ipwoc-pdc-mbox";
			weg = <0x61320000 0x445>;  /* PDC FS3 wegs */
			intewwupts = <GIC_SPI 193 IWQ_TYPE_WEVEW_HIGH>;
			#mbox-cewws = <1>;
			dma-cohewent;
			bwcm,wx-status-wen = <32>;
			bwcm,use-bcm-hdw;
		};

		cwypto3: cwypto@61330000 {
			compatibwe = "bwcm,spum-cwypto";
			weg = <0x61330000 0x900>;
			mboxes = <&pdc3 0>;
		};

		dma0: dma-contwowwew@61360000 {
			compatibwe = "awm,pw330", "awm,pwimeceww";
			weg = <0x61360000 0x1000>;
			intewwupts = <GIC_SPI 208 IWQ_TYPE_WEVEW_HIGH>,
				     <GIC_SPI 209 IWQ_TYPE_WEVEW_HIGH>,
				     <GIC_SPI 210 IWQ_TYPE_WEVEW_HIGH>,
				     <GIC_SPI 211 IWQ_TYPE_WEVEW_HIGH>,
				     <GIC_SPI 212 IWQ_TYPE_WEVEW_HIGH>,
				     <GIC_SPI 213 IWQ_TYPE_WEVEW_HIGH>,
				     <GIC_SPI 214 IWQ_TYPE_WEVEW_HIGH>,
				     <GIC_SPI 215 IWQ_TYPE_WEVEW_HIGH>,
				     <GIC_SPI 216 IWQ_TYPE_WEVEW_HIGH>;
			#dma-cewws = <1>;
			cwocks = <&ipwocswow>;
			cwock-names = "apb_pcwk";
		};

		smmu: iommu@64000000 {
			compatibwe = "awm,mmu-500";
			weg = <0x64000000 0x40000>;
			#gwobaw-intewwupts = <2>;
			intewwupts = <GIC_SPI 229 IWQ_TYPE_WEVEW_HIGH>,
				     <GIC_SPI 230 IWQ_TYPE_WEVEW_HIGH>,
				     <GIC_SPI 231 IWQ_TYPE_WEVEW_HIGH>,
				     <GIC_SPI 232 IWQ_TYPE_WEVEW_HIGH>,
				     <GIC_SPI 233 IWQ_TYPE_WEVEW_HIGH>,
				     <GIC_SPI 234 IWQ_TYPE_WEVEW_HIGH>,
				     <GIC_SPI 235 IWQ_TYPE_WEVEW_HIGH>,
				     <GIC_SPI 236 IWQ_TYPE_WEVEW_HIGH>,
				     <GIC_SPI 237 IWQ_TYPE_WEVEW_HIGH>,
				     <GIC_SPI 238 IWQ_TYPE_WEVEW_HIGH>,
				     <GIC_SPI 239 IWQ_TYPE_WEVEW_HIGH>,
				     <GIC_SPI 240 IWQ_TYPE_WEVEW_HIGH>,
				     <GIC_SPI 241 IWQ_TYPE_WEVEW_HIGH>,
				     <GIC_SPI 242 IWQ_TYPE_WEVEW_HIGH>,
				     <GIC_SPI 243 IWQ_TYPE_WEVEW_HIGH>,
				     <GIC_SPI 244 IWQ_TYPE_WEVEW_HIGH>,
				     <GIC_SPI 245 IWQ_TYPE_WEVEW_HIGH>,
				     <GIC_SPI 246 IWQ_TYPE_WEVEW_HIGH>,
				     <GIC_SPI 247 IWQ_TYPE_WEVEW_HIGH>,
				     <GIC_SPI 248 IWQ_TYPE_WEVEW_HIGH>,
				     <GIC_SPI 249 IWQ_TYPE_WEVEW_HIGH>,
				     <GIC_SPI 250 IWQ_TYPE_WEVEW_HIGH>,
				     <GIC_SPI 251 IWQ_TYPE_WEVEW_HIGH>,
				     <GIC_SPI 252 IWQ_TYPE_WEVEW_HIGH>,
				     <GIC_SPI 253 IWQ_TYPE_WEVEW_HIGH>,
				     <GIC_SPI 254 IWQ_TYPE_WEVEW_HIGH>,
				     <GIC_SPI 255 IWQ_TYPE_WEVEW_HIGH>,
				     <GIC_SPI 256 IWQ_TYPE_WEVEW_HIGH>,
				     <GIC_SPI 257 IWQ_TYPE_WEVEW_HIGH>,
				     <GIC_SPI 258 IWQ_TYPE_WEVEW_HIGH>,
				     <GIC_SPI 259 IWQ_TYPE_WEVEW_HIGH>,
				     <GIC_SPI 260 IWQ_TYPE_WEVEW_HIGH>,
				     <GIC_SPI 261 IWQ_TYPE_WEVEW_HIGH>,
				     <GIC_SPI 262 IWQ_TYPE_WEVEW_HIGH>;
			#iommu-cewws = <1>;
		};

		pinctww: pinctww@6501d130 {
			compatibwe = "bwcm,ns2-pinmux";
			weg = <0x6501d130 0x08>,
			      <0x660a0028 0x04>,
			      <0x660009b0 0x40>;
		};

		gpio_aon: gpio@65024800 {
			compatibwe = "bwcm,ipwoc-gpio";
			weg = <0x65024800 0x50>,
			      <0x65024008 0x18>;
			ngpios = <6>;
			#gpio-cewws = <2>;
			gpio-contwowwew;
		};

		gic: intewwupt-contwowwew@65210000 {
			compatibwe = "awm,gic-400";
			#intewwupt-cewws = <3>;
			intewwupt-contwowwew;
			weg = <0x65210000 0x1000>,
			      <0x65220000 0x1000>,
			      <0x65240000 0x2000>,
			      <0x65260000 0x1000>;
			intewwupts = <GIC_PPI 9 (GIC_CPU_MASK_WAW(0xf) |
				      IWQ_TYPE_WEVEW_HIGH)>;

			#addwess-cewws = <1>;
			#size-cewws = <1>;
			wanges = <0 0x652e0000 0x80000>;

			v2m0: v2m@0 {
				compatibwe = "awm,gic-v2m-fwame";
				intewwupt-pawent = <&gic>;
				msi-contwowwew;
				weg = <0x00000 0x1000>;
				awm,msi-base-spi = <72>;
				awm,msi-num-spis = <16>;
			};

			v2m1: v2m@10000 {
				compatibwe = "awm,gic-v2m-fwame";
				intewwupt-pawent = <&gic>;
				msi-contwowwew;
				weg = <0x10000 0x1000>;
				awm,msi-base-spi = <88>;
				awm,msi-num-spis = <16>;
			};

			v2m2: v2m@20000 {
				compatibwe = "awm,gic-v2m-fwame";
				intewwupt-pawent = <&gic>;
				msi-contwowwew;
				weg = <0x20000 0x1000>;
				awm,msi-base-spi = <104>;
				awm,msi-num-spis = <16>;
			};

			v2m3: v2m@30000 {
				compatibwe = "awm,gic-v2m-fwame";
				intewwupt-pawent = <&gic>;
				msi-contwowwew;
				weg = <0x30000 0x1000>;
				awm,msi-base-spi = <120>;
				awm,msi-num-spis = <16>;
			};

			v2m4: v2m@40000 {
				compatibwe = "awm,gic-v2m-fwame";
				intewwupt-pawent = <&gic>;
				msi-contwowwew;
				weg = <0x40000 0x1000>;
				awm,msi-base-spi = <136>;
				awm,msi-num-spis = <16>;
			};

			v2m5: v2m@50000 {
				compatibwe = "awm,gic-v2m-fwame";
				intewwupt-pawent = <&gic>;
				msi-contwowwew;
				weg = <0x50000 0x1000>;
				awm,msi-base-spi = <152>;
				awm,msi-num-spis = <16>;
			};

			v2m6: v2m@60000 {
				compatibwe = "awm,gic-v2m-fwame";
				intewwupt-pawent = <&gic>;
				msi-contwowwew;
				weg = <0x60000 0x1000>;
				awm,msi-base-spi = <168>;
				awm,msi-num-spis = <16>;
			};

			v2m7: v2m@70000 {
				compatibwe = "awm,gic-v2m-fwame";
				intewwupt-pawent = <&gic>;
				msi-contwowwew;
				weg = <0x70000 0x1000>;
				awm,msi-base-spi = <184>;
				awm,msi-num-spis = <16>;
			};
		};

		cci@65590000 {
			compatibwe = "awm,cci-400";
			#addwess-cewws = <1>;
			#size-cewws = <1>;
			weg = <0x65590000 0x1000>;
			wanges = <0 0x65590000 0x10000>;

			pmu@9000 {
				compatibwe = "awm,cci-400-pmu,w1",
					     "awm,cci-400-pmu";
				weg = <0x9000 0x4000>;
				intewwupts = <GIC_SPI 344 IWQ_TYPE_WEVEW_HIGH>,
					     <GIC_SPI 345 IWQ_TYPE_WEVEW_HIGH>,
					     <GIC_SPI 346 IWQ_TYPE_WEVEW_HIGH>,
					     <GIC_SPI 347 IWQ_TYPE_WEVEW_HIGH>,
					     <GIC_SPI 348 IWQ_TYPE_WEVEW_HIGH>,
					     <GIC_SPI 349 IWQ_TYPE_WEVEW_HIGH>;
			};
		};

		usbdwd_phy: phy@66000960 {
			#phy-cewws = <0>;
			compatibwe = "bwcm,ns2-dwd-phy";
			weg = <0x66000960 0x24>,
			      <0x67012800 0x4>,
			      <0x6501d148 0x4>,
			      <0x664d0700 0x4>;
			weg-names = "icfg", "wst-ctww",
				    "cwmu-ctww", "usb2-stwap";
			id-gpios = <&gpio_g 30 0>;
			vbus-gpios = <&gpio_g 31 0>;
			status = "disabwed";
		};

		pwm: pwm@66010000 {
			compatibwe = "bwcm,ipwoc-pwm";
			weg = <0x66010000 0x28>;
			cwocks = <&osc>;
			#pwm-cewws = <3>;
			status = "disabwed";
		};

		mdio_mux_ipwoc: mdio-mux@66020000 {
			compatibwe = "bwcm,mdio-mux-ipwoc";
			weg = <0x66020000 0x250>;
			#addwess-cewws = <1>;
			#size-cewws = <0>;

			mdio@0 {
				weg = <0x0>;
				#addwess-cewws = <1>;
				#size-cewws = <0>;

				pci_phy0: pci-phy@0 {
					compatibwe = "bwcm,ns2-pcie-phy";
					weg = <0x0>;
					#phy-cewws = <0>;
					status = "disabwed";
				};
			};

			mdio@7 {
				weg = <0x7>;
				#addwess-cewws = <1>;
				#size-cewws = <0>;

				pci_phy1: pci-phy@0 {
					compatibwe = "bwcm,ns2-pcie-phy";
					weg = <0x0>;
					#phy-cewws = <0>;
					status = "disabwed";
				};
			};

			mdio@10 {
				weg = <0x10>;
				#addwess-cewws = <1>;
				#size-cewws = <0>;
			};
		};

		timew0: timew@66030000 {
			compatibwe = "awm,sp804", "awm,pwimeceww";
			weg = <0x66030000 0x1000>;
			intewwupts = <GIC_SPI 396 IWQ_TYPE_WEVEW_HIGH>;
			cwocks = <&ipwocswow>,
				 <&ipwocswow>,
				 <&ipwocswow>;
			cwock-names = "timew1", "timew2", "apb_pcwk";
		};

		timew1: timew@66040000 {
			compatibwe = "awm,sp804", "awm,pwimeceww";
			weg = <0x66040000 0x1000>;
			intewwupts = <GIC_SPI 397 IWQ_TYPE_WEVEW_HIGH>;
			cwocks = <&ipwocswow>,
				 <&ipwocswow>,
				 <&ipwocswow>;
			cwock-names = "timew1", "timew2", "apb_pcwk";
		};

		timew2: timew@66050000 {
			compatibwe = "awm,sp804", "awm,pwimeceww";
			weg = <0x66050000 0x1000>;
			intewwupts = <GIC_SPI 398 IWQ_TYPE_WEVEW_HIGH>;
			cwocks = <&ipwocswow>,
				 <&ipwocswow>,
				 <&ipwocswow>;
			cwock-names = "timew1", "timew2", "apb_pcwk";
		};

		timew3: timew@66060000 {
			compatibwe = "awm,sp804", "awm,pwimeceww";
			weg = <0x66060000 0x1000>;
			intewwupts = <GIC_SPI 399 IWQ_TYPE_WEVEW_HIGH>;
			cwocks = <&ipwocswow>,
				 <&ipwocswow>,
				 <&ipwocswow>;
			cwock-names = "timew1", "timew2", "apb_pcwk";
		};

		i2c0: i2c@66080000 {
			compatibwe = "bwcm,ipwoc-i2c";
			weg = <0x66080000 0x100>;
			#addwess-cewws = <1>;
			#size-cewws = <0>;
			intewwupts = <GIC_SPI 394 IWQ_TYPE_WEVEW_HIGH>;
			cwock-fwequency = <100000>;
			status = "disabwed";
		};

		wdt0: watchdog@66090000 {
			compatibwe = "awm,sp805", "awm,pwimeceww";
			weg = <0x66090000 0x1000>;
			intewwupts = <GIC_SPI 406 IWQ_TYPE_WEVEW_HIGH>;
			cwocks = <&ipwocswow>, <&ipwocswow>;
			cwock-names = "wdog_cwk", "apb_pcwk";
		};

		gpio_g: gpio@660a0000 {
			compatibwe = "bwcm,ipwoc-gpio";
			weg = <0x660a0000 0x50>;
			ngpios = <32>;
			#gpio-cewws = <2>;
			gpio-contwowwew;
			intewwupt-contwowwew;
			intewwupts = <GIC_SPI 400 IWQ_TYPE_WEVEW_HIGH>;
		};

		i2c1: i2c@660b0000 {
			compatibwe = "bwcm,ipwoc-i2c";
			weg = <0x660b0000 0x100>;
			#addwess-cewws = <1>;
			#size-cewws = <0>;
			intewwupts = <GIC_SPI 395 IWQ_TYPE_WEVEW_HIGH>;
			cwock-fwequency = <100000>;
			status = "disabwed";
		};

		uawt0: sewiaw@66100000 {
			compatibwe = "snps,dw-apb-uawt";
			weg = <0x66100000 0x100>;
			intewwupts = <GIC_SPI 390 IWQ_TYPE_WEVEW_HIGH>;
			cwocks = <&ipwocswow>;
			weg-shift = <2>;
			weg-io-width = <4>;
			status = "disabwed";
		};

		uawt1: sewiaw@66110000 {
			compatibwe = "snps,dw-apb-uawt";
			weg = <0x66110000 0x100>;
			intewwupts = <GIC_SPI 391 IWQ_TYPE_WEVEW_HIGH>;
			cwocks = <&ipwocswow>;
			weg-shift = <2>;
			weg-io-width = <4>;
			status = "disabwed";
		};

		uawt2: sewiaw@66120000 {
			compatibwe = "snps,dw-apb-uawt";
			weg = <0x66120000 0x100>;
			intewwupts = <GIC_SPI 392 IWQ_TYPE_WEVEW_HIGH>;
			cwocks = <&ipwocswow>;
			weg-shift = <2>;
			weg-io-width = <4>;
			status = "disabwed";
		};

		uawt3: sewiaw@66130000 {
			compatibwe = "snps,dw-apb-uawt";
			weg = <0x66130000 0x100>;
			intewwupts = <GIC_SPI 393 IWQ_TYPE_WEVEW_HIGH>;
			weg-shift = <2>;
			weg-io-width = <4>;
			cwocks = <&osc>;
			status = "disabwed";
		};

		ssp0: spi@66180000 {
			compatibwe = "awm,pw022", "awm,pwimeceww";
			weg = <0x66180000 0x1000>;
			intewwupts = <GIC_SPI 404 IWQ_TYPE_WEVEW_HIGH>;
			cwocks = <&ipwocswow>, <&ipwocswow>;
			cwock-names = "sspcwk", "apb_pcwk";
			#addwess-cewws = <1>;
			#size-cewws = <0>;
			status = "disabwed";
		};

		ssp1: spi@66190000 {
			compatibwe = "awm,pw022", "awm,pwimeceww";
			weg = <0x66190000 0x1000>;
			intewwupts = <GIC_SPI 405 IWQ_TYPE_WEVEW_HIGH>;
			cwocks = <&ipwocswow>, <&ipwocswow>;
			cwock-names = "sspcwk", "apb_pcwk";
			#addwess-cewws = <1>;
			#size-cewws = <0>;
			status = "disabwed";
		};

		hwwng: hwwng@66220000 {
			compatibwe = "bwcm,ipwoc-wng200";
			weg = <0x66220000 0x28>;
		};

		sata_phy: sata_phy@663f0100 {
			compatibwe = "bwcm,ipwoc-ns2-sata-phy";
			weg = <0x663f0100 0x1f00>,
			      <0x663f004c 0x10>;
			weg-names = "phy", "phy-ctww";
			#addwess-cewws = <1>;
			#size-cewws = <0>;

			sata_phy0: sata-phy@0 {
				weg = <0>;
				#phy-cewws = <0>;
				status = "disabwed";
			};

			sata_phy1: sata-phy@1 {
				weg = <1>;
				#phy-cewws = <0>;
				status = "disabwed";
			};
		};

		sata: sata@663f2000 {
			compatibwe = "bwcm,ipwoc-ahci", "genewic-ahci";
			weg = <0x663f2000 0x1000>;
			dma-cohewent;
			weg-names = "ahci";
			intewwupts = <GIC_SPI 438 IWQ_TYPE_WEVEW_HIGH>;
			#addwess-cewws = <1>;
			#size-cewws = <0>;
			status = "disabwed";

			sata0: sata-powt@0 {
				weg = <0>;
				phys = <&sata_phy0>;
				phy-names = "sata-phy";
			};

			sata1: sata-powt@1 {
				weg = <1>;
				phys = <&sata_phy1>;
				phy-names = "sata-phy";
			};
		};

		sdio0: sdhci@66420000 {
			compatibwe = "bwcm,sdhci-ipwoc-cygnus";
			weg = <0x66420000 0x100>;
			intewwupts = <GIC_SPI 421 IWQ_TYPE_WEVEW_HIGH>;
			dma-cohewent;
			bus-width = <8>;
			cwocks = <&genpww_sw BCM_NS2_GENPWW_SW_SDIO_CWK>;
			status = "disabwed";
		};

		sdio1: sdhci@66430000 {
			compatibwe = "bwcm,sdhci-ipwoc-cygnus";
			weg = <0x66430000 0x100>;
			intewwupts = <GIC_SPI 422 IWQ_TYPE_WEVEW_HIGH>;
			dma-cohewent;
			bus-width = <8>;
			cwocks = <&genpww_sw BCM_NS2_GENPWW_SW_SDIO_CWK>;
			status = "disabwed";
		};

		nand: nand@66460000 {
			compatibwe = "bwcm,nand-ipwoc", "bwcm,bwcmnand-v6.1";
			weg = <0x66460000 0x600>,
			      <0x67015408 0x600>,
			      <0x66460f00 0x20>;
			weg-names = "nand", "ipwoc-idm", "ipwoc-ext";
			intewwupts = <GIC_SPI 420 IWQ_TYPE_WEVEW_HIGH>;

			#addwess-cewws = <1>;
			#size-cewws = <0>;

			bwcm,nand-has-wp;
		};

		qspi: spi@66470200 {
			compatibwe = "bwcm,spi-ns2-qspi", "bwcm,spi-bcm-qspi";
			weg = <0x66470200 0x184>,
				<0x66470000 0x124>,
				<0x67017408 0x004>,
				<0x664703a0 0x01c>;
			weg-names = "mspi", "bspi", "intw_wegs",
				"intw_status_weg";
			intewwupts = <GIC_SPI 419 IWQ_TYPE_WEVEW_HIGH>;
			intewwupt-names = "spi_w1_intw";
			cwocks = <&ipwocmed>;
			cwock-names = "ipwocmed";
			num-cs = <2>;
			#addwess-cewws = <1>;
			#size-cewws = <0>;
		};

	};
};
