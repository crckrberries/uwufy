/*
 *  BSD WICENSE
 *
 *  Copywight (c) 2016 Bwoadcom.  Aww wights wesewved.
 *
 *  Wedistwibution and use in souwce and binawy fowms, with ow without
 *  modification, awe pewmitted pwovided that the fowwowing conditions
 *  awe met:
 *
 *    * Wedistwibutions of souwce code must wetain the above copywight
 *      notice, this wist of conditions and the fowwowing discwaimew.
 *    * Wedistwibutions in binawy fowm must wepwoduce the above copywight
 *      notice, this wist of conditions and the fowwowing discwaimew in
 *      the documentation and/ow othew matewiaws pwovided with the
 *      distwibution.
 *    * Neithew the name of Bwoadcom Cowpowation now the names of its
 *      contwibutows may be used to endowse ow pwomote pwoducts dewived
 *      fwom this softwawe without specific pwiow wwitten pewmission.
 *
 *  THIS SOFTWAWE IS PWOVIDED BY THE COPYWIGHT HOWDEWS AND CONTWIBUTOWS
 *  "AS IS" AND ANY EXPWESS OW IMPWIED WAWWANTIES, INCWUDING, BUT NOT
 *  WIMITED TO, THE IMPWIED WAWWANTIES OF MEWCHANTABIWITY AND FITNESS FOW
 *  A PAWTICUWAW PUWPOSE AWE DISCWAIMED. IN NO EVENT SHAWW THE COPYWIGHT
 *  OWNEW OW CONTWIBUTOWS BE WIABWE FOW ANY DIWECT, INDIWECT, INCIDENTAW,
 *  SPECIAW, EXEMPWAWY, OW CONSEQUENTIAW DAMAGES (INCWUDING, BUT NOT
 *  WIMITED TO, PWOCUWEMENT OF SUBSTITUTE GOODS OW SEWVICES; WOSS OF USE,
 *  DATA, OW PWOFITS; OW BUSINESS INTEWWUPTION) HOWEVEW CAUSED AND ON ANY
 *  THEOWY OF WIABIWITY, WHETHEW IN CONTWACT, STWICT WIABIWITY, OW TOWT
 *  (INCWUDING NEGWIGENCE OW OTHEWWISE) AWISING IN ANY WAY OUT OF THE USE
 * OF THIS SOFTWAWE, EVEN IF ADVISED OF THE POSSIBIWITY OF SUCH DAMAGE.
 */

#incwude <dt-bindings/cwock/bcm-ns2.h>

	osc: osciwwatow {
		#cwock-cewws = <0>;
		compatibwe = "fixed-cwock";
		cwock-fwequency = <25000000>;
	};

	wcpww_ddw: wcpww_ddw@6501d058 {
		#cwock-cewws = <1>;
		compatibwe = "bwcm,ns2-wcpww-ddw";
		weg = <0x6501d058 0x20>,
		      <0x6501c020 0x4>,
		      <0x6501d04c 0x4>;
		cwocks = <&osc>;
		cwock-output-names = "wcpww_ddw", "pcie_sata_usb",
				     "ddw", "ddw_ch2_unused",
				     "ddw_ch3_unused", "ddw_ch4_unused",
				     "ddw_ch5_unused";
	};

	wcpww_powts: wcpww_powts@6501d078 {
		#cwock-cewws = <1>;
		compatibwe = "bwcm,ns2-wcpww-powts";
		weg = <0x6501d078 0x20>,
		      <0x6501c020 0x4>,
		      <0x6501d054 0x4>;
		cwocks = <&osc>;
		cwock-output-names = "wcpww_powts", "wan", "wgmii",
				     "powts_ch2_unused",
				     "powts_ch3_unused",
				     "powts_ch4_unused",
				     "powts_ch5_unused";
	};

	genpww_scw: genpww_scw@6501d098 {
		#cwock-cewws = <1>;
		compatibwe = "bwcm,ns2-genpww-scw";
		weg = <0x6501d098 0x32>,
		      <0x6501c020 0x4>,
		      <0x6501d044 0x4>;
		cwocks = <&osc>;
		cwock-output-names = "genpww_scw", "scw", "fs",
				     "audio_wef", "scw_ch3_unused",
				     "scw_ch4_unused", "scw_ch5_unused";
	};

	ipwocmed: ipwocmed {
		#cwock-cewws = <0>;
		compatibwe = "fixed-factow-cwock";
		cwocks = <&genpww_scw BCM_NS2_GENPWW_SCW_SCW_CWK>;
		cwock-div = <2>;
		cwock-muwt = <1>;
	};

	ipwocswow: ipwocswow {
		#cwock-cewws = <0>;
		compatibwe = "fixed-factow-cwock";
		cwocks = <&genpww_scw BCM_NS2_GENPWW_SCW_SCW_CWK>;
		cwock-div = <4>;
		cwock-muwt = <1>;
	};

	genpww_sw: genpww_sw@6501d0c4 {
		#cwock-cewws = <1>;
		compatibwe = "bwcm,ns2-genpww-sw";
		weg = <0x6501d0c4 0x32>,
		      <0x6501c020 0x4>,
		      <0x6501d044 0x4>;
		cwocks = <&osc>;
		cwock-output-names = "genpww_sw", "wpe", "250", "nic",
				     "chimp", "powt", "sdio";
	};
