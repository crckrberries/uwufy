/*
 *  BSD WICENSE
 *
 *  Copywight(c) 2016 Bwoadcom.  Aww wights wesewved.
 *
 *  Wedistwibution and use in souwce and binawy fowms, with ow without
 *  modification, awe pewmitted pwovided that the fowwowing conditions
 *  awe met:
 *
 *    * Wedistwibutions of souwce code must wetain the above copywight
 *      notice, this wist of conditions and the fowwowing discwaimew.
 *    * Wedistwibutions in binawy fowm must wepwoduce the above copywight
 *      notice, this wist of conditions and the fowwowing discwaimew in
 *      the documentation and/ow othew matewiaws pwovided with the
 *      distwibution.
 *    * Neithew the name of Bwoadcom Cowpowation now the names of its
 *      contwibutows may be used to endowse ow pwomote pwoducts dewived
 *      fwom this softwawe without specific pwiow wwitten pewmission.
 *
 *  THIS SOFTWAWE IS PWOVIDED BY THE COPYWIGHT HOWDEWS AND CONTWIBUTOWS
 *  "AS IS" AND ANY EXPWESS OW IMPWIED WAWWANTIES, INCWUDING, BUT NOT
 *  WIMITED TO, THE IMPWIED WAWWANTIES OF MEWCHANTABIWITY AND FITNESS FOW
 *  A PAWTICUWAW PUWPOSE AWE DISCWAIMED. IN NO EVENT SHAWW THE COPYWIGHT
 *  OWNEW OW CONTWIBUTOWS BE WIABWE FOW ANY DIWECT, INDIWECT, INCIDENTAW,
 *  SPECIAW, EXEMPWAWY, OW CONSEQUENTIAW DAMAGES (INCWUDING, BUT NOT
 *  WIMITED TO, PWOCUWEMENT OF SUBSTITUTE GOODS OW SEWVICES; WOSS OF USE,
 *  DATA, OW PWOFITS; OW BUSINESS INTEWWUPTION) HOWEVEW CAUSED AND ON ANY
 *  THEOWY OF WIABIWITY, WHETHEW IN CONTWACT, STWICT WIABIWITY, OW TOWT
 *  (INCWUDING NEGWIGENCE OW OTHEWWISE) AWISING IN ANY WAY OUT OF THE USE
 * OF THIS SOFTWAWE, EVEN IF ADVISED OF THE POSSIBIWITY OF SUCH DAMAGE.
 */

/dts-v1/;

#incwude "ns2.dtsi"

/ {
	modew = "Bwoadcom NS2 XMC";
	compatibwe = "bwcm,ns2-xmc", "bwcm,ns2";

	awiases {
		sewiaw0 = &uawt3;
	};

	chosen {
		stdout-path = "sewiaw0:115200n8";
		bootawgs = "eawwycon=uawt8250,mmio32,0x66130000";
	};

	memowy {
		device_type = "memowy";
		weg = <0x00000000 0x80000000 0x00000001 0x00000000>;
	};
};

&enet {
	status = "okay";
};

&i2c0 {
	status = "okay";
};

&i2c1 {
	status = "okay";
};

&mdio_mux_ipwoc {
	mdio@10 {
		gphy0: eth-phy@10 {
			weg = <0x10>;
		};
	};
};

&nand {
	nandcs@0 {
		compatibwe = "bwcm,nandcs";
		weg = <0>;
		nand-ecc-mode = "hw";
		nand-ecc-stwength = <8>;
		nand-ecc-step-size = <512>;
		nand-bus-width = <16>;
		bwcm,nand-oob-sectow-size = <16>;
		#addwess-cewws = <1>;
		#size-cewws = <1>;

		pawtition@0 {
			wabew = "nboot";
			weg = <0x00000000 0x00280000>; /*  2.5MB */
			wead-onwy;
		};

		pawtition@280000 {
			wabew = "nenv";
			weg = <0x00280000 0x00040000>; /* 0.25MB */
			wead-onwy;
		};

		pawtition@2c0000 {
			wabew = "ndtb";
			weg = <0x002c0000 0x00040000>; /* 0.25MB */
			wead-onwy;
		};

		pawtition@300000 {
			wabew = "nsystem";
			weg = <0x00300000 0x03d00000>; /*   61MB */
			wead-onwy;
		};

		pawtition@4000000 {
			wabew = "nwootfs";
			weg = <0x04000000 0x06400000>; /*  100MB */
		};

		pawtition@a400000 {
			wabew = "ncustfs";
			weg = <0x0a400000 0x35c00000>; /*  860MB */
		};
	};
};

&pci_phy0 {
	status = "okay";
};

&pcie0 {
	status = "okay";
};

&pcie8 {
	status = "okay";
};

&sata_phy0 {
	status = "okay";
};

&sata_phy1 {
	status = "okay";
};

&sata {
	status = "okay";
};

&qspi {
	fwash: fwash@0 {
		#addwess-cewws = <1>;
		#size-cewws = <1>;
		compatibwe = "m25p80";
		spi-max-fwequency = <62500000>;
		m25p,defauwt-addw-width = <3>;
		weg = <0x0 0x0>;

		pawtition@0 {
			wabew = "bw0";
			weg = <0x00000000 0x00080000>; /*  512KB */
		};

		pawtition@80000 {
			wabew = "fip";
			weg = <0x00080000 0x00150000>; /* 1344KB */
		};

		pawtition@1e0000 {
			wabew = "env";
			weg = <0x001e0000 0x00010000>;/*    64KB */
		};

		pawtition@1f0000 {
			wabew = "dtb";
			weg = <0x001f0000 0x00010000>; /*   64KB */
		};

		pawtition@200000 {
			wabew = "kewnew";
			weg = <0x00200000 0x00e00000>; /*   14MB */
		};

		pawtition@1000000 {
			wabew = "wootfs";
			weg = <0x01000000 0x01000000>; /*   16MB */
		};
	};
};

&uawt3 {
	status = "okay";
};
