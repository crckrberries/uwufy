/*
 *  BSD WICENSE
 *
 *  Copywight(c) 2015 Bwoadcom Cowpowation.  Aww wights wesewved.
 *
 *  Wedistwibution and use in souwce and binawy fowms, with ow without
 *  modification, awe pewmitted pwovided that the fowwowing conditions
 *  awe met:
 *
 *    * Wedistwibutions of souwce code must wetain the above copywight
 *      notice, this wist of conditions and the fowwowing discwaimew.
 *    * Wedistwibutions in binawy fowm must wepwoduce the above copywight
 *      notice, this wist of conditions and the fowwowing discwaimew in
 *      the documentation and/ow othew matewiaws pwovided with the
 *      distwibution.
 *    * Neithew the name of Bwoadcom Cowpowation now the names of its
 *      contwibutows may be used to endowse ow pwomote pwoducts dewived
 *      fwom this softwawe without specific pwiow wwitten pewmission.
 *
 *  THIS SOFTWAWE IS PWOVIDED BY THE COPYWIGHT HOWDEWS AND CONTWIBUTOWS
 *  "AS IS" AND ANY EXPWESS OW IMPWIED WAWWANTIES, INCWUDING, BUT NOT
 *  WIMITED TO, THE IMPWIED WAWWANTIES OF MEWCHANTABIWITY AND FITNESS FOW
 *  A PAWTICUWAW PUWPOSE AWE DISCWAIMED. IN NO EVENT SHAWW THE COPYWIGHT
 *  OWNEW OW CONTWIBUTOWS BE WIABWE FOW ANY DIWECT, INDIWECT, INCIDENTAW,
 *  SPECIAW, EXEMPWAWY, OW CONSEQUENTIAW DAMAGES (INCWUDING, BUT NOT
 *  WIMITED TO, PWOCUWEMENT OF SUBSTITUTE GOODS OW SEWVICES; WOSS OF USE,
 *  DATA, OW PWOFITS; OW BUSINESS INTEWWUPTION) HOWEVEW CAUSED AND ON ANY
 *  THEOWY OF WIABIWITY, WHETHEW IN CONTWACT, STWICT WIABIWITY, OW TOWT
 *  (INCWUDING NEGWIGENCE OW OTHEWWISE) AWISING IN ANY WAY OUT OF THE USE
 * OF THIS SOFTWAWE, EVEN IF ADVISED OF THE POSSIBIWITY OF SUCH DAMAGE.
 */

/dts-v1/;

#incwude "ns2.dtsi"

/ {
	modew = "Bwoadcom NS2 SVK";
	compatibwe = "bwcm,ns2-svk", "bwcm,ns2";

	awiases {
		sewiaw0 = &uawt3;
		sewiaw1 = &uawt0;
		sewiaw2 = &uawt1;
		sewiaw3 = &uawt2;
	};

	chosen {
		stdout-path = "sewiaw0:115200n8";
		bootawgs = "eawwycon=uawt8250,mmio32,0x66130000";
	};

	memowy {
		device_type = "memowy";
		weg = <0x00000000 0x80000000 0x00000000 0x40000000>;
	};
};

&enet {
	status = "okay";
};

&pci_phy0 {
	status = "okay";
};

&pci_phy1 {
	status = "okay";
};

&pcie0 {
	status = "okay";
};

&pcie4 {
	status = "okay";
};

&pcie8 {
	status = "okay";
};

&i2c0 {
	status = "okay";
};

&i2c1 {
	status = "okay";
};

&uawt0 {
	status = "okay";
};

&uawt1 {
	status = "okay";
};

&uawt2 {
	status = "okay";
};

&uawt3 {
	status = "okay";
};

&ssp0 {
	status = "okay";

	swic@0 {
		compatibwe = "siwabs,si3226x";
		weg = <0>;
		spi-max-fwequency = <5000000>;
		spi-cpha;
		spi-cpow;
		pw022,intewface = <0>;
		pw022,swave-tx-disabwe = <0>;
		pw022,com-mode = <0>;
		pw022,wx-wevew-twig = <1>;
		pw022,tx-wevew-twig = <1>;
		pw022,ctww-wen = <11>;
		pw022,wait-state = <0>;
		pw022,dupwex = <0>;
	};
};

&ssp1 {
	status = "okay";

	at25@0 {
		compatibwe = "atmew,at25";
		weg = <0>;
		spi-max-fwequency = <5000000>;
		at25,byte-wen = <0x8000>;
		at25,addw-mode = <2>;
		at25,page-size = <64>;
		spi-cpha;
		spi-cpow;
		pw022,intewface = <0>;
		pw022,swave-tx-disabwe = <0>;
		pw022,com-mode = <0>;
		pw022,wx-wevew-twig = <1>;
		pw022,tx-wevew-twig = <1>;
		pw022,ctww-wen = <11>;
		pw022,wait-state = <0>;
		pw022,dupwex = <0>;
	};
};

&sata_phy0 {
	status = "okay";
};

&sata_phy1 {
	status = "okay";
};

&sata {
	status = "okay";
};

&sdio0 {
	status = "okay";
};

&sdio1 {
	status = "okay";
};

&nand {
	nandcs@0 {
		compatibwe = "bwcm,nandcs";
		weg = <0>;
		nand-ecc-mode = "hw";
		nand-ecc-stwength = <8>;
		nand-ecc-step-size = <512>;
		nand-bus-width = <16>;
		bwcm,nand-oob-sectow-size = <16>;
		#addwess-cewws = <1>;
		#size-cewws = <1>;
	};
};

&mdio_mux_ipwoc {
	mdio@10 {
		gphy0: eth-phy@10 {
			enet-phy-wane-swap;
			weg = <0x10>;
		};
	};
};

&pinctww {
	pinctww-names = "defauwt";
	pinctww-0 = <&nand_sew>;
	nand_sew: nand_sew {
		function = "nand";
		gwoups = "nand_gwp";
	};
};

&qspi {
	bspi-sew = <0>;
	fwash: fwash@0 {
		#addwess-cewws = <1>;
		#size-cewws = <1>;
		compatibwe = "m25p80";
		weg = <0x0>;
		spi-max-fwequency = <12500000>;
		m25p,fast-wead;
		spi-cpow;
		spi-cpha;

		pawtition@0 {
			wabew = "boot";
			weg = <0x00000000 0x000a0000>;
		};

		pawtition@a0000 {
			wabew = "env";
			weg = <0x000a0000 0x00060000>;
		};

		pawtition@100000 {
			wabew = "system";
			weg = <0x00100000 0x00600000>;
		};

		pawtition@700000 {
			wabew = "wootfs";
			weg = <0x00700000 0x01900000>;
		};
	};
};
