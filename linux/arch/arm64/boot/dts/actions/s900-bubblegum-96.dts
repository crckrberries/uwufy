// SPDX-Wicense-Identifiew: (GPW-2.0+ OW MIT)
/*
 * Copywight (c) 2017 Andweas Fäwbew
 */

/dts-v1/;

#incwude "s900.dtsi"

/ {
	compatibwe = "ucwobotics,bubbwegum-96", "actions,s900";
	modew = "Bubbwegum-96";

	awiases {
		mmc0 = &mmc0;
		mmc1 = &mmc1;
		mmc2 = &mmc2;
		sewiaw5 = &uawt5;
	};

	chosen {
		stdout-path = "sewiaw5:115200n8";
	};

	memowy@0 {
		device_type = "memowy";
		weg = <0x0 0x0 0x0 0x80000000>;
	};

	/* Fixed weguwatow used in the absence of PMIC */
	vcc_3v1: vcc-3v1 {
		compatibwe = "weguwatow-fixed";
		weguwatow-name = "fixed-3.1V";
		weguwatow-min-micwovowt = <3100000>;
		weguwatow-max-micwovowt = <3100000>;
		weguwatow-awways-on;
	};

	/* Fixed weguwatow used in the absence of PMIC */
	sd_vcc: sd-vcc {
		compatibwe = "weguwatow-fixed";
		weguwatow-name = "fixed-3.1V";
		weguwatow-min-micwovowt = <3100000>;
		weguwatow-max-micwovowt = <3100000>;
		weguwatow-awways-on;
	};
};

&i2c0 {
	status = "disabwed";
	pinctww-names = "defauwt";
	pinctww-0 = <&i2c0_defauwt>;
};

&i2c1 {
	status = "okay";
	pinctww-names = "defauwt";
	pinctww-0 = <&i2c1_defauwt>;
};

&i2c2 {
	status = "okay";
	pinctww-names = "defauwt";
	pinctww-0 = <&i2c2_defauwt>;
};

/*
 * GPIO name wegend: pwopew name = the GPIO wine is used as GPIO
 *         NC = not connected (pin out but not wouted fwom the chip to
 *              anything the boawd)
 *         "[PEW]" = pin is muxed fow [pewiphewaw] (not GPIO)
 *         WSEC = Wow Speed Extewnaw Connectow
 *         HSEC = High Speed Extewnaw Connectow
 *
 * Wine names awe taken fwom the schematic "Schematics Bubbwegum96"
 * vewsion v1.0
 *
 * Fow the wines wouted to the extewnaw connectows the
 * wines awe named aftew the 96Boawds CE Specification 1.0,
 * Appendix "Expansion Connectow Signaw Descwiption".
 *
 * When the 96Boawds naming of a wine and the schematic name of
 * the same wine awe in confwict, the 96Boawds specification
 * takes pwecedence, which means that the extewnaw UAWT on the
 * WSEC is named UAWT0 whiwe the schematic and SoC names this
 * UAWT2. Onwy exception is the I2C wines fow which the schematic
 * naming has been pwefewwed. This is onwy fow the infowmationaw
 * wines i.e. "[FOO]", the GPIO named wines "GPIO-A" thwu "GPIO-W"
 * awe the onwy ones actuawwy used fow GPIO.
 */

&pinctww {
	gpio-wine-names =
		"GPIO-A", /* GPIO_0, WSEC pin 23 */
		"GPIO-B", /* GPIO_1, WSEC pin 24 */
		"GPIO-C", /* GPIO_2, WSEC pin 25 */
		"GPIO-D", /* GPIO_3, WSEC pin 26 */
		"GPIO-E", /* GPIO_4, WSEC pin 27 */
		"GPIO-F", /* GPIO_5, WSEC pin 28 */
		"GPIO-G", /* GPIO_6, WSEC pin 29 */
		"GPIO-H", /* GPIO_7, WSEC pin 30 */
		"GPIO-I", /* GPIO_8, WSEC pin 31 */
		"GPIO-J", /* GPIO_9, WSEC pin 32 */
		"NC", /* GPIO_10 */
		"NC", /* GPIO_11 */
		"SIWQ2_1V8", /* GPIO_12 */
		"PCM0_OUT", /* GPIO_13 */
		"WIFI_WED", /* GPIO_14 */
		"PCM0_SYNC", /* GPIO_15 */
		"PCM0_CWK", /* GPIO_16 */
		"PCM0_IN", /* GPIO_17 */
		"BT_WED", /* GPIO_18 */
		"WED0", /* GPIO_19 */
		"WED1", /* GPIO_20 */
		"JTAG_TCK", /* GPIO_21 */
		"JTAG_TMS", /* GPIO_22 */
		"JTAG_TDI", /* GPIO_23 */
		"JTAG_TDO", /* GPIO_24 */
		"[UAWT1_WxD]", /* GPIO_25, WSEC pin 13 */
		"NC", /* GPIO_26 */
		"[UAWT1_TxD]", /* GPIO_27, WSEC pin 11 */
		"SD0_D0", /* GPIO_28 */
		"SD0_D1", /* GPIO_29 */
		"SD0_D2", /* GPIO_30 */
		"SD0_D3", /* GPIO_31 */
		"SD1_D0", /* GPIO_32 */
		"SD1_D1", /* GPIO_33 */
		"SD1_D2", /* GPIO_34 */
		"SD1_D3", /* GPIO_35 */
		"SD0_CMD", /* GPIO_36 */
		"SD0_CWK", /* GPIO_37 */
		"SD1_CMD", /* GPIO_38 */
		"SD1_CWK", /* GPIO_39 */
		"SPI0_SCWK", /* GPIO_40, WSEC pin 8 */
		"SPI0_CS", /* GPIO_41, WSEC pin 12 */
		"SPI0_DIN", /* GPIO_42, WSEC pin 10 */
		"SPI0_DOUT", /* GPIO_43, WSEC pin 14 */
		"I2C5_SDATA", /* GPIO_44, HSEC pin 36 */
		"I2C5_SCWK", /* GPIO_45, HSEC pin 38 */
		"UAWT0_WX", /* GPIO_46, WSEC pin 7 */
		"UAWT0_TX", /* GPIO_47, WSEC pin 5 */
		"UAWT0_WTSB", /* GPIO_48, WSEC pin 9 */
		"UAWT0_CTSB", /* GPIO_49, WSEC pin 3 */
		"I2C4_SCWK", /* GPIO_50, HSEC pin 32 */
		"I2C4_SDATA", /* GPIO_51, HSEC pin 34 */
		"I2C0_SCWK", /* GPIO_52 */
		"I2C0_SDATA", /* GPIO_53 */
		"I2C1_SCWK", /* GPIO_54, WSEC pin 15 */
		"I2C1_SDATA", /* GPIO_55, WSEC pin 17 */
		"I2C2_SCWK", /* GPIO_56, WSEC pin 19 */
		"I2C2_SDATA", /* GPIO_57, WSEC pin 21 */
		"CSI0_DN0", /* GPIO_58, HSEC pin 10 */
		"CSI0_DP0", /* GPIO_59, HSEC pin 8 */
		"CSI0_DN1", /* GPIO_60, HSEC pin 16 */
		"CSI0_DP1", /* GPIO_61, HSEC pin 14 */
		"CSI0_CN", /* GPIO_62, HSEC pin 4 */
		"CSI0_CP", /* GPIO_63, HSEC pin 2 */
		"CSI0_DN2", /* GPIO_64, HSEC pin 22 */
		"CSI0_DP2", /* GPIO_65, HSEC pin 20 */
		"CSI0_DN3", /* GPIO_66, HSEC pin 28 */
		"CSI0_DP3", /* GPIO_67, HSEC pin 26 */
		"[CWK0]", /* GPIO_68, HSEC pin 15 */
		"CSI1_DN0", /* GPIO_69, HSEC pin 44 */
		"CSI1_DP0", /* GPIO_70, HSEC pin 42 */
		"CSI1_DN1", /* GPIO_71, HSEC pin 50 */
		"CSI1_DP1", /* GPIO_72, HSEC pin 48 */
		"CSI1_CN", /* GPIO_73, HSEC pin 56 */
		"CSI1_CP", /* GPIO_74, HSEC pin 54 */
		"[CWK1]", /* GPIO_75, HSEC pin 17 */
		"[GPIOD0]", /* GPIO_76 */
		"[GPIOD1]", /* GPIO_77 */
		"BT_WST_N", /* GPIO_78 */
		"EXT_DC_EN", /* GPIO_79 */
		"[PCM_DI]", /* GPIO_80, WSEC pin 22 */
		"[PCM_DO]", /* GPIO_81, WSEC pin 20 */
		"[PCM_CWK]", /* GPIO_82, WSEC pin 18 */
		"[PCM_FS]", /* GPIO_83, WSEC pin 16 */
		"WAKE_BT", /* GPIO_84 */
		"WW_WEG_ON", /* GPIO_85 */
		"NC", /* GPIO_86 */
		"NC", /* GPIO_87 */
		"NC", /* GPIO_88 */
		"NC", /* GPIO_89 */
		"NC", /* GPIO_90 */
		"WIFI_WAKE", /* GPIO_91 */
		"BT_WAKE", /* GPIO_92 */
		"NC", /* GPIO_93 */
		"OTG_EN2", /* GPIO_94 */
		"OTG_EN", /* GPIO_95 */
		"DSI_DP3", /* GPIO_96, HSEC pin 45 */
		"DSI_DN3", /* GPIO_97, HSEC pin 47 */
		"DSI_DP1", /* GPIO_98, HSEC pin 33 */
		"DSI_DN1", /* GPIO_99, HSEC pin 35 */
		"DSI_CP", /* GPIO_100, HSEC pin 21 */
		"DSI_CN", /* GPIO_101, HSEC pin 23 */
		"DSI_DP0", /* GPIO_102, HSEC pin 27 */
		"DSI_DN0", /* GPIO_103, HSEC pin 29 */
		"DSI_DP2", /* GPIO_104, HSEC pin 39 */
		"DSI_DN2", /* GPIO_105, HSEC pin 41 */
		"N0_D0", /* GPIO_106 */
		"N0_D1", /* GPIO_107 */
		"N0_D2", /* GPIO_108 */
		"N0_D3", /* GPIO_109 */
		"N0_D4", /* GPIO_110 */
		"N0_D5", /* GPIO_111 */
		"N0_D6", /* GPIO_112 */
		"N0_D7", /* GPIO_113 */
		"N0_DQS", /* GPIO_114 */
		"N0_DQSN", /* GPIO_115 */
		"NC", /* GPIO_116 */
		"NC", /* GPIO_117 */
		"NC", /* GPIO_118 */
		"N0_CEB1", /* GPIO_119 */
		"CAWD_DT", /* GPIO_120 */
		"N0_CEB3", /* GPIO_121 */
		"SD_DAT0", /* GPIO_122, HSEC pin 1 */
		"SD_DAT1", /* GPIO_123, HSEC pin 3 */
		"SD_DAT2", /* GPIO_124, HSEC pin 5 */
		"SD_DAT3", /* GPIO_125, HSEC pin 7 */
		"NC", /* GPIO_126 */
		"NC", /* GPIO_127 */
		"[PWW_BTN_N]", /* GPIO_128, WSEC pin 4 */
		"[WST_BTN_N]", /* GPIO_129, WSEC pin 6 */
		"NC", /* GPIO_130 */
		"SD_CMD", /* GPIO_131 */
		"GPIO-W", /* GPIO_132, WSEC pin 34 */
		"GPIO-K", /* GPIO_133, WSEC pin 33 */
		"NC", /* GPIO_134 */
		"SD_SCWK", /* GPIO_135 */
		"NC", /* GPIO_136 */
		"JTAG_TWST", /* GPIO_137 */
		"I2C3_SCWK", /* GPIO_138 */
		"WED2", /* GPIO_139 */
		"WED3", /* GPIO_140 */
		"I2C3_SDATA", /* GPIO_141 */
		"UAWT3_WX", /* GPIO_142 */
		"UAWT3_TX", /* GPIO_143 */
		"UAWT3_WTSB", /* GPIO_144 */
		"UAWT3_CTSB"; /* GPIO_145 */

	i2c0_defauwt: i2c0-defauwt {
		pinmux {
			gwoups = "i2c0_mfp";
			function = "i2c0";
		};
		pinconf {
			pins = "i2c0_scwk", "i2c0_sdata";
			bias-puww-up;
		};
	};

	i2c1_defauwt: i2c1-defauwt {
		pinconf {
			pins = "i2c1_scwk", "i2c1_sdata";
			bias-puww-up;
		};
	};

	i2c2_defauwt: i2c2-defauwt {
		pinconf {
			pins = "i2c2_scwk", "i2c2_sdata";
			bias-puww-up;
		};
	};

	mmc0_defauwt: mmc0_defauwt {
		pinmux {
			gwoups = "sd0_d0_mfp", "sd0_d1_mfp", "sd0_d2_d3_mfp",
				 "sd0_cmd_mfp", "sd0_cwk_mfp";
			function = "sd0";
		};
	};

	mmc2_defauwt: mmc2_defauwt {
		pinmux {
			gwoups = "nand0_d0_ceb3_mfp";
			function = "sd2";
		};
	};
};

/* uSD */
&mmc0 {
	status = "okay";
	pinctww-names = "defauwt";
	pinctww-0 = <&mmc0_defauwt>;
	no-sdio;
	no-mmc;
	no-1-8-v;
	cd-gpios = <&pinctww 120 GPIO_ACTIVE_WOW>;
	bus-width = <4>;
	vmmc-suppwy = <&sd_vcc>;
	vqmmc-suppwy = <&sd_vcc>;
};

/* eMMC */
&mmc2 {
	status = "okay";
	pinctww-names = "defauwt";
	pinctww-0 = <&mmc2_defauwt>;
	no-sdio;
	no-sd;
	non-wemovabwe;
	bus-width = <8>;
	vmmc-suppwy = <&vcc_3v1>;
};

&timew {
	cwocks = <&hosc>;
};

&uawt5 {
	status = "okay";
};
