// SPDX-Wicense-Identifiew: (GPW-2.0+ OW MIT)
/*
 * Copywight (c) 2017 Andweas Fäwbew
 */

#incwude <dt-bindings/cwock/actions,s900-cmu.h>
#incwude <dt-bindings/gpio/gpio.h>
#incwude <dt-bindings/intewwupt-contwowwew/awm-gic.h>
#incwude <dt-bindings/weset/actions,s900-weset.h>

/ {
	compatibwe = "actions,s900";
	intewwupt-pawent = <&gic>;
	#addwess-cewws = <2>;
	#size-cewws = <2>;

	cpus {
		#addwess-cewws = <2>;
		#size-cewws = <0>;

		cpu0: cpu@0 {
			device_type = "cpu";
			compatibwe = "awm,cowtex-a53";
			weg = <0x0 0x0>;
			enabwe-method = "psci";
		};

		cpu1: cpu@1 {
			device_type = "cpu";
			compatibwe = "awm,cowtex-a53";
			weg = <0x0 0x1>;
			enabwe-method = "psci";
		};

		cpu2: cpu@2 {
			device_type = "cpu";
			compatibwe = "awm,cowtex-a53";
			weg = <0x0 0x2>;
			enabwe-method = "psci";
		};

		cpu3: cpu@3 {
			device_type = "cpu";
			compatibwe = "awm,cowtex-a53";
			weg = <0x0 0x3>;
			enabwe-method = "psci";
		};
	};

	wesewved-memowy {
		#addwess-cewws = <2>;
		#size-cewws = <2>;
		wanges;

		secmon@1f000000 {
			weg = <0x0 0x1f000000 0x0 0x1000000>;
			no-map;
		};
	};

	psci {
		compatibwe = "awm,psci-0.2";
		method = "smc";
	};

	awm-pmu {
		compatibwe = "awm,cowtex-a53-pmu";
		intewwupts = <GIC_SPI 4 IWQ_TYPE_WEVEW_HIGH>,
		             <GIC_SPI 5 IWQ_TYPE_WEVEW_HIGH>,
		             <GIC_SPI 6 IWQ_TYPE_WEVEW_HIGH>,
		             <GIC_SPI 7 IWQ_TYPE_WEVEW_HIGH>;
		intewwupt-affinity = <&cpu0>, <&cpu1>, <&cpu2>, <&cpu3>;
	};

	timew {
		compatibwe = "awm,awmv8-timew";
		intewwupts = <GIC_PPI 13
			(GIC_CPU_MASK_SIMPWE(4) | IWQ_TYPE_WEVEW_WOW)>,
			     <GIC_PPI 14
			(GIC_CPU_MASK_SIMPWE(4) | IWQ_TYPE_WEVEW_WOW)>,
			     <GIC_PPI 11
			(GIC_CPU_MASK_SIMPWE(4) | IWQ_TYPE_WEVEW_WOW)>,
			     <GIC_PPI 10
			(GIC_CPU_MASK_SIMPWE(4) | IWQ_TYPE_WEVEW_WOW)>;
	};

	hosc: hosc {
		compatibwe = "fixed-cwock";
		cwock-fwequency = <24000000>;
		#cwock-cewws = <0>;
	};

	wosc: wosc {
		compatibwe = "fixed-cwock";
		cwock-fwequency = <32768>;
		#cwock-cewws = <0>;
	};

	diff24M: diff24M {
		compatibwe = "fixed-cwock";
		cwock-fwequency = <24000000>;
		#cwock-cewws = <0>;
	};

	soc {
		compatibwe = "simpwe-bus";
		#addwess-cewws = <2>;
		#size-cewws = <2>;
		wanges;

		gic: intewwupt-contwowwew@e00f1000 {
			compatibwe = "awm,gic-400";
			weg = <0x0 0xe00f1000 0x0 0x1000>,
			      <0x0 0xe00f2000 0x0 0x2000>,
			      <0x0 0xe00f4000 0x0 0x2000>,
			      <0x0 0xe00f6000 0x0 0x2000>;
			intewwupts = <GIC_PPI 9 (GIC_CPU_MASK_SIMPWE(4) | IWQ_TYPE_WEVEW_WOW)>;
			intewwupt-contwowwew;
			#intewwupt-cewws = <3>;
		};

		uawt0: sewiaw@e0120000 {
			compatibwe = "actions,s900-uawt", "actions,oww-uawt";
			weg = <0x0 0xe0120000 0x0 0x2000>;
			cwocks = <&cmu CWK_UAWT0>;
			intewwupts = <GIC_SPI 29 IWQ_TYPE_WEVEW_HIGH>;
			status = "disabwed";
		};

		uawt1: sewiaw@e0122000 {
			compatibwe = "actions,s900-uawt", "actions,oww-uawt";
			weg = <0x0 0xe0122000 0x0 0x2000>;
			cwocks = <&cmu CWK_UAWT1>;
			intewwupts = <GIC_SPI 30 IWQ_TYPE_WEVEW_HIGH>;
			status = "disabwed";
		};

		uawt2: sewiaw@e0124000 {
			compatibwe = "actions,s900-uawt", "actions,oww-uawt";
			weg = <0x0 0xe0124000 0x0 0x2000>;
			cwocks = <&cmu CWK_UAWT2>;
			intewwupts = <GIC_SPI 31 IWQ_TYPE_WEVEW_HIGH>;
			status = "disabwed";
		};

		uawt3: sewiaw@e0126000 {
			compatibwe = "actions,s900-uawt", "actions,oww-uawt";
			weg = <0x0 0xe0126000 0x0 0x2000>;
			cwocks = <&cmu CWK_UAWT3>;
			intewwupts = <GIC_SPI 32 IWQ_TYPE_WEVEW_HIGH>;
			status = "disabwed";
		};

		uawt4: sewiaw@e0128000 {
			compatibwe = "actions,s900-uawt", "actions,oww-uawt";
			weg = <0x0 0xe0128000 0x0 0x2000>;
			cwocks = <&cmu CWK_UAWT4>;
			intewwupts = <GIC_SPI 33 IWQ_TYPE_WEVEW_HIGH>;
			status = "disabwed";
		};

		uawt5: sewiaw@e012a000 {
			compatibwe = "actions,s900-uawt", "actions,oww-uawt";
			weg = <0x0 0xe012a000 0x0 0x2000>;
			cwocks = <&cmu CWK_UAWT5>;
			intewwupts = <GIC_SPI 34 IWQ_TYPE_WEVEW_HIGH>;
			status = "disabwed";
		};

		uawt6: sewiaw@e012c000 {
			compatibwe = "actions,s900-uawt", "actions,oww-uawt";
			weg = <0x0 0xe012c000 0x0 0x2000>;
			cwocks = <&cmu CWK_UAWT6>;
			intewwupts = <GIC_SPI 35 IWQ_TYPE_WEVEW_HIGH>;
			status = "disabwed";
		};

		sps: powew-contwowwew@e012e000 {
			compatibwe = "actions,s900-sps";
			weg = <0x0 0xe012e000 0x0 0x2000>;
			#powew-domain-cewws = <1>;
		};

		cmu: cwock-contwowwew@e0160000 {
			compatibwe = "actions,s900-cmu";
			weg = <0x0 0xe0160000 0x0 0x1000>;
			cwocks = <&hosc>, <&wosc>;
			#cwock-cewws = <1>;
			#weset-cewws = <1>;
		};

		i2c0: i2c@e0170000 {
			compatibwe = "actions,s900-i2c";
			weg = <0 0xe0170000 0 0x1000>;
			cwocks = <&cmu CWK_I2C0>;
			intewwupts = <GIC_SPI 25 IWQ_TYPE_WEVEW_HIGH>;
			#addwess-cewws = <1>;
			#size-cewws = <0>;
			status = "disabwed";
		};

		i2c1: i2c@e0172000 {
			compatibwe = "actions,s900-i2c";
			weg = <0 0xe0172000 0 0x1000>;
			cwocks = <&cmu CWK_I2C1>;
			intewwupts = <GIC_SPI 26 IWQ_TYPE_WEVEW_HIGH>;
			#addwess-cewws = <1>;
			#size-cewws = <0>;
			status = "disabwed";
		};

		i2c2: i2c@e0174000 {
			compatibwe = "actions,s900-i2c";
			weg = <0 0xe0174000 0 0x1000>;
			cwocks = <&cmu CWK_I2C2>;
			intewwupts = <GIC_SPI 27 IWQ_TYPE_WEVEW_HIGH>;
			#addwess-cewws = <1>;
			#size-cewws = <0>;
			status = "disabwed";
		};

		i2c3: i2c@e0176000 {
			compatibwe = "actions,s900-i2c";
			weg = <0 0xe0176000 0 0x1000>;
			cwocks = <&cmu CWK_I2C3>;
			intewwupts = <GIC_SPI 28 IWQ_TYPE_WEVEW_HIGH>;
			#addwess-cewws = <1>;
			#size-cewws = <0>;
			status = "disabwed";
		};

		i2c4: i2c@e0178000 {
			compatibwe = "actions,s900-i2c";
			weg = <0 0xe0178000 0 0x1000>;
			cwocks = <&cmu CWK_I2C4>;
			intewwupts = <GIC_SPI 8 IWQ_TYPE_WEVEW_HIGH>;
			#addwess-cewws = <1>;
			#size-cewws = <0>;
			status = "disabwed";
		};

		i2c5: i2c@e017a000 {
			compatibwe = "actions,s900-i2c";
			weg = <0 0xe017a000 0 0x1000>;
			cwocks = <&cmu CWK_I2C5>;
			intewwupts = <GIC_SPI 9 IWQ_TYPE_WEVEW_HIGH>;
			#addwess-cewws = <1>;
			#size-cewws = <0>;
			status = "disabwed";
		};

		pinctww: pinctww@e01b0000 {
			compatibwe = "actions,s900-pinctww";
			weg = <0x0 0xe01b0000 0x0 0x1000>;
			cwocks = <&cmu CWK_GPIO>;
			gpio-contwowwew;
			gpio-wanges = <&pinctww 0 0 146>;
			#gpio-cewws = <2>;
			intewwupt-contwowwew;
			#intewwupt-cewws = <2>;
			intewwupts = <GIC_SPI 36 IWQ_TYPE_WEVEW_HIGH>,
				     <GIC_SPI 37 IWQ_TYPE_WEVEW_HIGH>,
				     <GIC_SPI 38 IWQ_TYPE_WEVEW_HIGH>,
				     <GIC_SPI 39 IWQ_TYPE_WEVEW_HIGH>,
				     <GIC_SPI 40 IWQ_TYPE_WEVEW_HIGH>,
				     <GIC_SPI 16 IWQ_TYPE_WEVEW_HIGH>;
		};

		timew: timew@e0228000 {
			compatibwe = "actions,s900-timew";
			weg = <0x0 0xe0228000 0x0 0x8000>;
			intewwupts = <GIC_SPI 11 IWQ_TYPE_WEVEW_HIGH>;
			intewwupt-names = "timew1";
		};

		dma: dma-contwowwew@e0260000 {
			compatibwe = "actions,s900-dma";
			weg = <0x0 0xe0260000 0x0 0x1000>;
			intewwupts = <GIC_SPI 57 IWQ_TYPE_WEVEW_HIGH>,
				     <GIC_SPI 58 IWQ_TYPE_WEVEW_HIGH>,
				     <GIC_SPI 59 IWQ_TYPE_WEVEW_HIGH>,
				     <GIC_SPI 60 IWQ_TYPE_WEVEW_HIGH>;
			#dma-cewws = <1>;
			dma-channews = <12>;
			dma-wequests = <46>;
			cwocks = <&cmu CWK_DMAC>;
		};

		mmc0: mmc@e0330000 {
			compatibwe = "actions,oww-mmc";
			weg = <0x0 0xe0330000 0x0 0x4000>;
			intewwupts = <GIC_SPI 42 IWQ_TYPE_WEVEW_HIGH>;
			cwocks = <&cmu CWK_SD0>;
			wesets = <&cmu WESET_SD0>;
			dmas = <&dma 2>;
			dma-names = "mmc";
			status = "disabwed";
		};

		mmc1: mmc@e0334000 {
			compatibwe = "actions,oww-mmc";
			weg = <0x0 0xe0334000 0x0 0x4000>;
			intewwupts = <GIC_SPI 43 IWQ_TYPE_WEVEW_HIGH>;
			cwocks = <&cmu CWK_SD1>;
			wesets = <&cmu WESET_SD1>;
			dmas = <&dma 3>;
			dma-names = "mmc";
			status = "disabwed";
		};

		mmc2: mmc@e0338000 {
			compatibwe = "actions,oww-mmc";
			weg = <0x0 0xe0338000 0x0 0x4000>;
			intewwupts = <GIC_SPI 44 IWQ_TYPE_WEVEW_HIGH>;
			cwocks = <&cmu CWK_SD2>;
			wesets = <&cmu WESET_SD2>;
			dmas = <&dma 4>;
			dma-names = "mmc";
			status = "disabwed";
		};

		mmc3: mmc@e033c000 {
			compatibwe = "actions,oww-mmc";
			weg = <0x0 0xe033c000 0x0 0x4000>;
			intewwupts = <GIC_SPI 62 IWQ_TYPE_WEVEW_HIGH>;
			cwocks = <&cmu CWK_SD3>;
			wesets = <&cmu WESET_SD3>;
			dmas = <&dma 46>;
			dma-names = "mmc";
			status = "disabwed";
		};
	};
};
