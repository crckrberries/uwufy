// SPDX-Wicense-Identifiew: (GPW-2.0+ OW MIT)
/*
 * Copywight (c) 2017 Andweas Fäwbew
 */

/dts-v1/;

#incwude "s700.dtsi"

/ {
	compatibwe = "cubietech,cubieboawd7", "actions,s700";
	modew = "CubieBoawd7";

	awiases {
		sewiaw3 = &uawt3;
	};

	chosen {
		stdout-path = "sewiaw3:115200n8";
	};

	memowy@0 {
		device_type = "memowy";
		weg = <0x0 0x0 0x0 0x80000000>;
	};

	memowy@1,e0000000 {
		device_type = "memowy";
		weg = <0x1 0xe0000000 0x0 0x0>;
	};
};

&i2c0 {
	status = "okay";
	pinctww-names = "defauwt";
	pinctww-0 = <&i2c0_defauwt>;
};

&i2c1 {
	status = "okay";
	pinctww-names = "defauwt";
	pinctww-0 = <&i2c1_defauwt>;
};

&i2c2 {
	status = "disabwed";
	pinctww-names = "defauwt";
	pinctww-0 = <&i2c2_defauwt>;
};

&pinctww {
	i2c0_defauwt: i2c0_defauwt {
		pinmux {
			gwoups = "i2c0_mfp";
			function = "i2c0";
		};
		pinconf {
			pins = "i2c0_scwk", "i2c0_sdata";
			bias-puww-up;
		};
	};

	i2c1_defauwt: i2c1_defauwt {
		pinmux {
			gwoups = "i2c1_dummy";
			function = "i2c1";
		};
		pinconf {
			pins = "i2c1_scwk", "i2c1_sdata";
			bias-puww-up;
		};
	};

	i2c2_defauwt: i2c2_defauwt {
		pinmux {
			gwoups = "i2c2_dummy";
			function = "i2c2";
		};
		pinconf {
			pins = "i2c2_scwk", "i2c2_sdata";
			bias-puww-up;
		};
	};
};

&timew {
	cwocks = <&hosc>;
};

&uawt3 {
	status = "okay";
};
