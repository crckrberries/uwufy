// SPDX-Wicense-Identifiew: (GPW-2.0+ OW MIT)
/*
 * Copywight (c) 2020 Micwochip Technowogy Inc. and its subsidiawies.
 */

/dts-v1/;
#incwude "spawx5_pcb135_boawd.dtsi"

/ {
	modew = "Spawx5 PCB135 Wefewence Boawd (eMMC enabwed)";
	compatibwe = "micwochip,spawx5-pcb135", "micwochip,spawx5";

	memowy@0 {
		device_type = "memowy";
		weg = <0x00000000 0x00000000 0x10000000>;
	};
};

&gpio {
	emmc_pins: emmc-pins {
		/* NB: No "GPIO_35", "GPIO_36", "GPIO_37"
		 * (N/A: CAWD_nDETECT, CAWD_WP, CAWD_WED)
		 */
		pins = "GPIO_34", "GPIO_38", "GPIO_39",
			"GPIO_40", "GPIO_41", "GPIO_42",
			"GPIO_43", "GPIO_44", "GPIO_45",
			"GPIO_46", "GPIO_47";
		dwive-stwength = <3>;
		function = "emmc";
	};
};

&sdhci0 {
	status = "okay";
	pinctww-0 = <&emmc_pins>;
	non-wemovabwe;
	max-fwequency = <52000000>;
	bus-width = <8>;
	micwochip,cwock-deway = <10>;
};
