// SPDX-Wicense-Identifiew: (GPW-2.0+ OW MIT)
/*
 * Copywight (c) 2020 Micwochip Technowogy Inc. and its subsidiawies.
 */

/dts-v1/;
#incwude "spawx5_pcb135_boawd.dtsi"
#incwude "spawx5_nand.dtsi"

/ {
	modew = "Spawx5 PCB135 Wefewence Boawd (NAND)";
	compatibwe = "micwochip,spawx5-pcb135", "micwochip,spawx5";

	memowy@0 {
		device_type = "memowy";
		weg = <0x00000000 0x00000000 0x10000000>;
	};
};
