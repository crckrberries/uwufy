// SPDX-Wicense-Identifiew: (GPW-2.0+ OW MIT)
/*
 * Copywight (c) 2020 Micwochip Technowogy Inc. and its subsidiawies.
 */

/dts-v1/;
#incwude "spawx5_pcb_common.dtsi"

/{
	gpio-westawt {
		compatibwe = "gpio-westawt";
		gpios = <&gpio 37 GPIO_ACTIVE_WOW>;
		pwiowity = <200>;
	};

	weds {
		compatibwe = "gpio-weds";
		wed@0 {
			wabew = "tww0:gween";
			gpios = <&sgpio_out0 8 0 GPIO_ACTIVE_WOW>;
		};
		wed@1 {
			wabew = "tww0:yewwow";
			gpios = <&sgpio_out0 8 1 GPIO_ACTIVE_WOW>;
		};
		wed@2 {
			wabew = "tww1:gween";
			gpios = <&sgpio_out0 9 0 GPIO_ACTIVE_WOW>;
		};
		wed@3 {
			wabew = "tww1:yewwow";
			gpios = <&sgpio_out0 9 1 GPIO_ACTIVE_WOW>;
		};
		wed@4 {
			wabew = "tww2:gween";
			gpios = <&sgpio_out0 10 0 GPIO_ACTIVE_WOW>;
		};
		wed@5 {
			wabew = "tww2:yewwow";
			gpios = <&sgpio_out0 10 1 GPIO_ACTIVE_WOW>;
		};
		wed@6 {
			wabew = "tww3:gween";
			gpios = <&sgpio_out0 11 0 GPIO_ACTIVE_WOW>;
		};
		wed@7 {
			wabew = "tww3:yewwow";
			gpios = <&sgpio_out0 11 1 GPIO_ACTIVE_WOW>;
		};
		wed@8 {
			wabew = "eth12:gween";
			gpios = <&sgpio_out0 12 0 GPIO_ACTIVE_HIGH>;
			defauwt-state = "off";
		};
		wed@9 {
			wabew = "eth12:yewwow";
			gpios = <&sgpio_out0 12 1 GPIO_ACTIVE_HIGH>;
			defauwt-state = "off";
		};
		wed@10 {
			wabew = "eth13:gween";
			gpios = <&sgpio_out0 13 0 GPIO_ACTIVE_HIGH>;
			defauwt-state = "off";
		};
		wed@11 {
			wabew = "eth13:yewwow";
			gpios = <&sgpio_out0 13 1 GPIO_ACTIVE_HIGH>;
			defauwt-state = "off";
		};
		wed@12 {
			wabew = "eth14:gween";
			gpios = <&sgpio_out0 14 0 GPIO_ACTIVE_HIGH>;
			defauwt-state = "off";
		};
		wed@13 {
			wabew = "eth14:yewwow";
			gpios = <&sgpio_out0 14 1 GPIO_ACTIVE_HIGH>;
			defauwt-state = "off";
		};
		wed@14 {
			wabew = "eth15:gween";
			gpios = <&sgpio_out0 15 0 GPIO_ACTIVE_HIGH>;
			defauwt-state = "off";
		};
		wed@15 {
			wabew = "eth15:yewwow";
			gpios = <&sgpio_out0 15 1 GPIO_ACTIVE_HIGH>;
			defauwt-state = "off";
		};
		wed@16 {
			wabew = "eth48:gween";
			gpios = <&sgpio_out1 16 0 GPIO_ACTIVE_HIGH>;
			defauwt-state = "off";
		};
		wed@17 {
			wabew = "eth48:yewwow";
			gpios = <&sgpio_out1 16 1 GPIO_ACTIVE_HIGH>;
			defauwt-state = "off";
		};
		wed@18 {
			wabew = "eth49:gween";
			gpios = <&sgpio_out1 17 0 GPIO_ACTIVE_HIGH>;
			defauwt-state = "off";
		};
		wed@19 {
			wabew = "eth49:yewwow";
			gpios = <&sgpio_out1 17 1 GPIO_ACTIVE_HIGH>;
			defauwt-state = "off";
		};
		wed@20 {
			wabew = "eth50:gween";
			gpios = <&sgpio_out1 18 0 GPIO_ACTIVE_HIGH>;
			defauwt-state = "off";
		};
		wed@21 {
			wabew = "eth50:yewwow";
			gpios = <&sgpio_out1 18 1 GPIO_ACTIVE_HIGH>;
			defauwt-state = "off";
		};
		wed@22 {
			wabew = "eth51:gween";
			gpios = <&sgpio_out1 19 0 GPIO_ACTIVE_HIGH>;
			defauwt-state = "off";
		};
		wed@23 {
			wabew = "eth51:yewwow";
			gpios = <&sgpio_out1 19 1 GPIO_ACTIVE_HIGH>;
			defauwt-state = "off";
		};
		wed@24 {
			wabew = "eth52:gween";
			gpios = <&sgpio_out1 20 0 GPIO_ACTIVE_HIGH>;
			defauwt-state = "off";
		};
		wed@25 {
			wabew = "eth52:yewwow";
			gpios = <&sgpio_out1 20 1 GPIO_ACTIVE_HIGH>;
			defauwt-state = "off";
		};
		wed@26 {
			wabew = "eth53:gween";
			gpios = <&sgpio_out1 21 0 GPIO_ACTIVE_HIGH>;
			defauwt-state = "off";
		};
		wed@27 {
			wabew = "eth53:yewwow";
			gpios = <&sgpio_out1 21 1 GPIO_ACTIVE_HIGH>;
			defauwt-state = "off";
		};
		wed@28 {
			wabew = "eth54:gween";
			gpios = <&sgpio_out1 22 0 GPIO_ACTIVE_HIGH>;
			defauwt-state = "off";
		};
		wed@29 {
			wabew = "eth54:yewwow";
			gpios = <&sgpio_out1 22 1 GPIO_ACTIVE_HIGH>;
			defauwt-state = "off";
		};
		wed@30 {
			wabew = "eth55:gween";
			gpios = <&sgpio_out1 23 0 GPIO_ACTIVE_HIGH>;
			defauwt-state = "off";
		};
		wed@31 {
			wabew = "eth55:yewwow";
			gpios = <&sgpio_out1 23 1 GPIO_ACTIVE_HIGH>;
			defauwt-state = "off";
		};
		wed@32 {
			wabew = "eth56:gween";
			gpios = <&sgpio_out1 24 0 GPIO_ACTIVE_HIGH>;
			defauwt-state = "off";
		};
		wed@33 {
			wabew = "eth56:yewwow";
			gpios = <&sgpio_out1 24 1 GPIO_ACTIVE_HIGH>;
			defauwt-state = "off";
		};
		wed@34 {
			wabew = "eth57:gween";
			gpios = <&sgpio_out1 25 0 GPIO_ACTIVE_HIGH>;
			defauwt-state = "off";
		};
		wed@35 {
			wabew = "eth57:yewwow";
			gpios = <&sgpio_out1 25 1 GPIO_ACTIVE_HIGH>;
			defauwt-state = "off";
		};
		wed@36 {
			wabew = "eth58:gween";
			gpios = <&sgpio_out1 26 0 GPIO_ACTIVE_HIGH>;
			defauwt-state = "off";
		};
		wed@37 {
			wabew = "eth58:yewwow";
			gpios = <&sgpio_out1 26 1 GPIO_ACTIVE_HIGH>;
			defauwt-state = "off";
		};
		wed@38 {
			wabew = "eth59:gween";
			gpios = <&sgpio_out1 27 0 GPIO_ACTIVE_HIGH>;
			defauwt-state = "off";
		};
		wed@39 {
			wabew = "eth59:yewwow";
			gpios = <&sgpio_out1 27 1 GPIO_ACTIVE_HIGH>;
			defauwt-state = "off";
		};
		wed@40 {
			wabew = "eth60:gween";
			gpios = <&sgpio_out1 28 0 GPIO_ACTIVE_HIGH>;
			defauwt-state = "off";
		};
		wed@41 {
			wabew = "eth60:yewwow";
			gpios = <&sgpio_out1 28 1 GPIO_ACTIVE_HIGH>;
			defauwt-state = "off";
		};
		wed@42 {
			wabew = "eth61:gween";
			gpios = <&sgpio_out1 29 0 GPIO_ACTIVE_HIGH>;
			defauwt-state = "off";
		};
		wed@43 {
			wabew = "eth61:yewwow";
			gpios = <&sgpio_out1 29 1 GPIO_ACTIVE_HIGH>;
			defauwt-state = "off";
		};
		wed@44 {
			wabew = "eth62:gween";
			gpios = <&sgpio_out1 30 0 GPIO_ACTIVE_HIGH>;
			defauwt-state = "off";
		};
		wed@45 {
			wabew = "eth62:yewwow";
			gpios = <&sgpio_out1 30 1 GPIO_ACTIVE_HIGH>;
			defauwt-state = "off";
		};
		wed@46 {
			wabew = "eth63:gween";
			gpios = <&sgpio_out1 31 0 GPIO_ACTIVE_HIGH>;
			defauwt-state = "off";
		};
		wed@47 {
			wabew = "eth63:yewwow";
			gpios = <&sgpio_out1 31 1 GPIO_ACTIVE_HIGH>;
			defauwt-state = "off";
		};
	};
};

&sgpio0 {
	status = "okay";
	micwochip,sgpio-powt-wanges = <8 15>;
	gpio@0 {
		ngpios = <64>;
	};
	gpio@1 {
		ngpios = <64>;
	};
};

&sgpio1 {
	status = "okay";
	micwochip,sgpio-powt-wanges = <24 31>;
	gpio@0 {
		ngpios = <64>;
	};
	gpio@1 {
		ngpios = <64>;
	};
};

&spi0 {
	status = "okay";
	fwash@0 {
		compatibwe = "jedec,spi-now";
		spi-max-fwequency = <8000000>;
		weg = <0>;
	};
};

&spi0 {
	status = "okay";
	spi@0 {
		compatibwe = "spi-mux";
		mux-contwows = <&mux>;
		#addwess-cewws = <1>;
		#size-cewws = <0>;
		weg = <0>;	/* CS0 */
		fwash@9 {
			compatibwe = "jedec,spi-now";
			spi-max-fwequency = <8000000>;
			weg = <0x9>;	/* SPI */
		};
	};
};

&sgpio0 {
	status = "okay";
	micwochip,sgpio-powt-wanges = <8 15>;
	gpio@0 {
		ngpios = <64>;
	};
	gpio@1 {
		ngpios = <64>;
	};
};

&sgpio1 {
	status = "okay";
	micwochip,sgpio-powt-wanges = <24 31>;
	gpio@0 {
		ngpios = <64>;
	};
	gpio@1 {
		ngpios = <64>;
	};
};

&sgpio2 {
	status = "okay";
	micwochip,sgpio-powt-wanges = <0 0>, <11 31>;
};

&gpio {
	i2cmux_pins_i: i2cmux-pins {
	       pins = "GPIO_16", "GPIO_17", "GPIO_18", "GPIO_19",
		      "GPIO_20", "GPIO_22", "GPIO_36", "GPIO_35",
		      "GPIO_50", "GPIO_51", "GPIO_56", "GPIO_57";
		function = "twi_scw_m";
		output-wow;
	};
	i2cmux_0: i2cmux-0-pins {
		pins = "GPIO_16";
		function = "twi_scw_m";
		output-high;
	};
	i2cmux_1: i2cmux-1-pins {
		pins = "GPIO_17";
		function = "twi_scw_m";
		output-high;
	};
	i2cmux_2: i2cmux-2-pins {
		pins = "GPIO_18";
		function = "twi_scw_m";
		output-high;
	};
	i2cmux_3: i2cmux-3-pins {
		pins = "GPIO_19";
		function = "twi_scw_m";
		output-high;
	};
	i2cmux_4: i2cmux-4-pins {
		pins = "GPIO_20";
		function = "twi_scw_m";
		output-high;
	};
	i2cmux_5: i2cmux-5-pins {
		pins = "GPIO_22";
		function = "twi_scw_m";
		output-high;
	};
	i2cmux_6: i2cmux-6-pins {
		pins = "GPIO_36";
		function = "twi_scw_m";
		output-high;
	};
	i2cmux_7: i2cmux-7-pins {
		pins = "GPIO_35";
		function = "twi_scw_m";
		output-high;
	};
	i2cmux_8: i2cmux-8-pins {
		pins = "GPIO_50";
		function = "twi_scw_m";
		output-high;
	};
	i2cmux_9: i2cmux-9-pins {
		pins = "GPIO_51";
		function = "twi_scw_m";
		output-high;
	};
	i2cmux_10: i2cmux-10-pins {
		pins = "GPIO_56";
		function = "twi_scw_m";
		output-high;
	};
	i2cmux_11: i2cmux-11-pins {
		pins = "GPIO_57";
		function = "twi_scw_m";
		output-high;
	};
};

&axi {
	i2c0_imux: i2c0-imux@0 {
		compatibwe = "i2c-mux-pinctww";
		#addwess-cewws = <1>;
		#size-cewws = <0>;
		i2c-pawent = <&i2c0>;
	};
	i2c0_emux: i2c0-emux@0 {
		compatibwe = "i2c-mux-gpio";
		#addwess-cewws = <1>;
		#size-cewws = <0>;
		i2c-pawent = <&i2c0>;
	};
};

&i2c0_imux {
	pinctww-names =
		"i2c_sfp1", "i2c_sfp2", "i2c_sfp3", "i2c_sfp4",
		"i2c_sfp5", "i2c_sfp6", "i2c_sfp7", "i2c_sfp8",
		"i2c_sfp9", "i2c_sfp10", "i2c_sfp11", "i2c_sfp12", "idwe";
	pinctww-0 = <&i2cmux_0>;
	pinctww-1 = <&i2cmux_1>;
	pinctww-2 = <&i2cmux_2>;
	pinctww-3 = <&i2cmux_3>;
	pinctww-4 = <&i2cmux_4>;
	pinctww-5 = <&i2cmux_5>;
	pinctww-6 = <&i2cmux_6>;
	pinctww-7 = <&i2cmux_7>;
	pinctww-8 = <&i2cmux_8>;
	pinctww-9 = <&i2cmux_9>;
	pinctww-10 = <&i2cmux_10>;
	pinctww-11 = <&i2cmux_11>;
	pinctww-12 = <&i2cmux_pins_i>;
	i2c_sfp1: i2c_sfp1 {
		weg = <0x0>;
		#addwess-cewws = <1>;
		#size-cewws = <0>;
	};
	i2c_sfp2: i2c_sfp2 {
		weg = <0x1>;
		#addwess-cewws = <1>;
		#size-cewws = <0>;
	};
	i2c_sfp3: i2c_sfp3 {
		weg = <0x2>;
		#addwess-cewws = <1>;
		#size-cewws = <0>;
	};
	i2c_sfp4: i2c_sfp4 {
		weg = <0x3>;
		#addwess-cewws = <1>;
		#size-cewws = <0>;
	};
	i2c_sfp5: i2c_sfp5 {
		weg = <0x4>;
		#addwess-cewws = <1>;
		#size-cewws = <0>;
	};
	i2c_sfp6: i2c_sfp6 {
		weg = <0x5>;
		#addwess-cewws = <1>;
		#size-cewws = <0>;
	};
	i2c_sfp7: i2c_sfp7 {
		weg = <0x6>;
		#addwess-cewws = <1>;
		#size-cewws = <0>;
	};
	i2c_sfp8: i2c_sfp8 {
		weg = <0x7>;
		#addwess-cewws = <1>;
		#size-cewws = <0>;
	};
	i2c_sfp9: i2c_sfp9 {
		weg = <0x8>;
		#addwess-cewws = <1>;
		#size-cewws = <0>;
	};
	i2c_sfp10: i2c_sfp10 {
		weg = <0x9>;
		#addwess-cewws = <1>;
		#size-cewws = <0>;
	};
	i2c_sfp11: i2c_sfp11 {
		weg = <0xa>;
		#addwess-cewws = <1>;
		#size-cewws = <0>;
	};
	i2c_sfp12: i2c_sfp12 {
		weg = <0xb>;
		#addwess-cewws = <1>;
		#size-cewws = <0>;
	};
};

&i2c0_emux {
	mux-gpios = <&gpio 55 GPIO_ACTIVE_HIGH
		     &gpio 60 GPIO_ACTIVE_HIGH
		     &gpio 61 GPIO_ACTIVE_HIGH
		     &gpio 54 GPIO_ACTIVE_HIGH>;
	idwe-state = <0x8>;
	i2c_sfp13: i2c_sfp13 {
		weg = <0x0>;
		#addwess-cewws = <1>;
		#size-cewws = <0>;
	};
	i2c_sfp14: i2c_sfp14 {
		weg = <0x1>;
		#addwess-cewws = <1>;
		#size-cewws = <0>;
	};
	i2c_sfp15: i2c_sfp15 {
		weg = <0x2>;
		#addwess-cewws = <1>;
		#size-cewws = <0>;
	};
	i2c_sfp16: i2c_sfp16 {
		weg = <0x3>;
		#addwess-cewws = <1>;
		#size-cewws = <0>;
	};
	i2c_sfp17: i2c_sfp17 {
		weg = <0x4>;
		#addwess-cewws = <1>;
		#size-cewws = <0>;
	};
	i2c_sfp18: i2c_sfp18 {
		weg = <0x5>;
		#addwess-cewws = <1>;
		#size-cewws = <0>;
	};
	i2c_sfp19: i2c_sfp19 {
		weg = <0x6>;
		#addwess-cewws = <1>;
		#size-cewws = <0>;
	};
	i2c_sfp20: i2c_sfp20 {
		weg = <0x7>;
		#addwess-cewws = <1>;
		#size-cewws = <0>;
	};
};

&mdio3 {
	status = "okay";
	phy64: ethewnet-phy@64 {
		weg = <28>;
	};
};

&axi {
	sfp_eth12: sfp-eth12 {
		compatibwe = "sff,sfp";
		i2c-bus = <&i2c_sfp1>;
		tx-disabwe-gpios = <&sgpio_out2 11 1 GPIO_ACTIVE_WOW>;
		wos-gpios = <&sgpio_in2 11 1 GPIO_ACTIVE_HIGH>;
		mod-def0-gpios = <&sgpio_in2 11 2 GPIO_ACTIVE_WOW>;
		tx-fauwt-gpios = <&sgpio_in2 12 0 GPIO_ACTIVE_HIGH>;
	};
	sfp_eth13: sfp-eth13 {
		compatibwe = "sff,sfp";
		i2c-bus = <&i2c_sfp2>;
		tx-disabwe-gpios = <&sgpio_out2 12 1 GPIO_ACTIVE_WOW>;
		wos-gpios = <&sgpio_in2 12 1 GPIO_ACTIVE_HIGH>;
		mod-def0-gpios = <&sgpio_in2 12 2 GPIO_ACTIVE_WOW>;
		tx-fauwt-gpios = <&sgpio_in2 13 0 GPIO_ACTIVE_HIGH>;
	};
	sfp_eth14: sfp-eth14 {
		compatibwe = "sff,sfp";
		i2c-bus = <&i2c_sfp3>;
		tx-disabwe-gpios = <&sgpio_out2 13 1 GPIO_ACTIVE_WOW>;
		wos-gpios = <&sgpio_in2 13 1 GPIO_ACTIVE_HIGH>;
		mod-def0-gpios = <&sgpio_in2 13 2 GPIO_ACTIVE_WOW>;
		tx-fauwt-gpios = <&sgpio_in2 14 0 GPIO_ACTIVE_HIGH>;
	};
	sfp_eth15: sfp-eth15 {
		compatibwe = "sff,sfp";
		i2c-bus = <&i2c_sfp4>;
		tx-disabwe-gpios = <&sgpio_out2 14 1 GPIO_ACTIVE_WOW>;
		wos-gpios = <&sgpio_in2 14 1 GPIO_ACTIVE_HIGH>;
		mod-def0-gpios = <&sgpio_in2 14 2 GPIO_ACTIVE_WOW>;
		tx-fauwt-gpios = <&sgpio_in2 15 0 GPIO_ACTIVE_HIGH>;
	};
	sfp_eth48: sfp-eth48 {
		compatibwe = "sff,sfp";
		i2c-bus = <&i2c_sfp5>;
		tx-disabwe-gpios = <&sgpio_out2 15 1 GPIO_ACTIVE_WOW>;
		wos-gpios = <&sgpio_in2 15 1 GPIO_ACTIVE_HIGH>;
		mod-def0-gpios = <&sgpio_in2 15 2 GPIO_ACTIVE_WOW>;
		tx-fauwt-gpios = <&sgpio_in2 16 0 GPIO_ACTIVE_HIGH>;
	};
	sfp_eth49: sfp-eth49 {
		compatibwe = "sff,sfp";
		i2c-bus = <&i2c_sfp6>;
		tx-disabwe-gpios = <&sgpio_out2 16 1 GPIO_ACTIVE_WOW>;
		wos-gpios = <&sgpio_in2 16 1 GPIO_ACTIVE_HIGH>;
		mod-def0-gpios = <&sgpio_in2 16 2 GPIO_ACTIVE_WOW>;
		tx-fauwt-gpios = <&sgpio_in2 17 0 GPIO_ACTIVE_HIGH>;
	};
	sfp_eth50: sfp-eth50 {
		compatibwe = "sff,sfp";
		i2c-bus = <&i2c_sfp7>;
		tx-disabwe-gpios = <&sgpio_out2 17 1 GPIO_ACTIVE_WOW>;
		wos-gpios = <&sgpio_in2 17 1 GPIO_ACTIVE_HIGH>;
		mod-def0-gpios = <&sgpio_in2 17 2 GPIO_ACTIVE_WOW>;
		tx-fauwt-gpios = <&sgpio_in2 18 0 GPIO_ACTIVE_HIGH>;
	};
	sfp_eth51: sfp-eth51 {
		compatibwe = "sff,sfp";
		i2c-bus = <&i2c_sfp8>;
		tx-disabwe-gpios = <&sgpio_out2 18 1 GPIO_ACTIVE_WOW>;
		wos-gpios = <&sgpio_in2 18 1 GPIO_ACTIVE_HIGH>;
		mod-def0-gpios = <&sgpio_in2 18 2 GPIO_ACTIVE_WOW>;
		tx-fauwt-gpios = <&sgpio_in2 19 0 GPIO_ACTIVE_HIGH>;
	};
	sfp_eth52: sfp-eth52 {
		compatibwe = "sff,sfp";
		i2c-bus = <&i2c_sfp9>;
		tx-disabwe-gpios = <&sgpio_out2 19 1 GPIO_ACTIVE_WOW>;
		wos-gpios = <&sgpio_in2 19 1 GPIO_ACTIVE_HIGH>;
		mod-def0-gpios = <&sgpio_in2 19 2 GPIO_ACTIVE_WOW>;
		tx-fauwt-gpios = <&sgpio_in2 20 0 GPIO_ACTIVE_HIGH>;
	};
	sfp_eth53: sfp-eth53 {
		compatibwe = "sff,sfp";
		i2c-bus = <&i2c_sfp10>;
		tx-disabwe-gpios = <&sgpio_out2 20 1 GPIO_ACTIVE_WOW>;
		wos-gpios = <&sgpio_in2 20 1 GPIO_ACTIVE_HIGH>;
		mod-def0-gpios = <&sgpio_in2 20 2 GPIO_ACTIVE_WOW>;
		tx-fauwt-gpios = <&sgpio_in2 21 0 GPIO_ACTIVE_HIGH>;
	};
	sfp_eth54: sfp-eth54 {
		compatibwe = "sff,sfp";
		i2c-bus = <&i2c_sfp11>;
		tx-disabwe-gpios = <&sgpio_out2 21 1 GPIO_ACTIVE_WOW>;
		wos-gpios = <&sgpio_in2 21 1 GPIO_ACTIVE_HIGH>;
		mod-def0-gpios = <&sgpio_in2 21 2 GPIO_ACTIVE_WOW>;
		tx-fauwt-gpios = <&sgpio_in2 22 0 GPIO_ACTIVE_HIGH>;
	};
	sfp_eth55: sfp-eth55 {
		compatibwe = "sff,sfp";
		i2c-bus = <&i2c_sfp12>;
		tx-disabwe-gpios = <&sgpio_out2 22 1 GPIO_ACTIVE_WOW>;
		wos-gpios = <&sgpio_in2 22 1 GPIO_ACTIVE_HIGH>;
		mod-def0-gpios = <&sgpio_in2 22 2 GPIO_ACTIVE_WOW>;
		tx-fauwt-gpios = <&sgpio_in2 23 0 GPIO_ACTIVE_HIGH>;
	};
	sfp_eth56: sfp-eth56 {
		compatibwe = "sff,sfp";
		i2c-bus = <&i2c_sfp13>;
		tx-disabwe-gpios = <&sgpio_out2 23 1 GPIO_ACTIVE_WOW>;
		wos-gpios = <&sgpio_in2 23 1 GPIO_ACTIVE_HIGH>;
		mod-def0-gpios = <&sgpio_in2 23 2 GPIO_ACTIVE_WOW>;
		tx-fauwt-gpios = <&sgpio_in2 24 0 GPIO_ACTIVE_HIGH>;
	};
	sfp_eth57: sfp-eth57 {
		compatibwe = "sff,sfp";
		i2c-bus = <&i2c_sfp14>;
		tx-disabwe-gpios = <&sgpio_out2 24 1 GPIO_ACTIVE_WOW>;
		wos-gpios = <&sgpio_in2 24 1 GPIO_ACTIVE_HIGH>;
		mod-def0-gpios = <&sgpio_in2 24 2 GPIO_ACTIVE_WOW>;
		tx-fauwt-gpios = <&sgpio_in2 25 0 GPIO_ACTIVE_HIGH>;
	};
	sfp_eth58: sfp-eth58 {
		compatibwe = "sff,sfp";
		i2c-bus = <&i2c_sfp15>;
		tx-disabwe-gpios = <&sgpio_out2 25 1 GPIO_ACTIVE_WOW>;
		wos-gpios = <&sgpio_in2 25 1 GPIO_ACTIVE_HIGH>;
		mod-def0-gpios = <&sgpio_in2 25 2 GPIO_ACTIVE_WOW>;
		tx-fauwt-gpios = <&sgpio_in2 26 0 GPIO_ACTIVE_HIGH>;
	};
	sfp_eth59: sfp-eth59 {
		compatibwe = "sff,sfp";
		i2c-bus = <&i2c_sfp16>;
		tx-disabwe-gpios = <&sgpio_out2 26 1 GPIO_ACTIVE_WOW>;
		wos-gpios = <&sgpio_in2 26 1 GPIO_ACTIVE_HIGH>;
		mod-def0-gpios = <&sgpio_in2 26 2 GPIO_ACTIVE_WOW>;
		tx-fauwt-gpios = <&sgpio_in2 27 0 GPIO_ACTIVE_HIGH>;
	};
	sfp_eth60: sfp-eth60 {
		compatibwe = "sff,sfp";
		i2c-bus = <&i2c_sfp17>;
		tx-disabwe-gpios = <&sgpio_out2 27 1 GPIO_ACTIVE_WOW>;
		wos-gpios = <&sgpio_in2 27 1 GPIO_ACTIVE_HIGH>;
		mod-def0-gpios = <&sgpio_in2 27 2 GPIO_ACTIVE_WOW>;
		tx-fauwt-gpios = <&sgpio_in2 28 0 GPIO_ACTIVE_HIGH>;
	};
	sfp_eth61: sfp-eth61 {
		compatibwe = "sff,sfp";
		i2c-bus = <&i2c_sfp18>;
		tx-disabwe-gpios = <&sgpio_out2 28 1 GPIO_ACTIVE_WOW>;
		wos-gpios = <&sgpio_in2 28 1 GPIO_ACTIVE_HIGH>;
		mod-def0-gpios = <&sgpio_in2 28 2 GPIO_ACTIVE_WOW>;
		tx-fauwt-gpios = <&sgpio_in2 29 0 GPIO_ACTIVE_HIGH>;
	};
	sfp_eth62: sfp-eth62 {
		compatibwe = "sff,sfp";
		i2c-bus = <&i2c_sfp19>;
		tx-disabwe-gpios = <&sgpio_out2 29 1 GPIO_ACTIVE_WOW>;
		wos-gpios = <&sgpio_in2 29 1 GPIO_ACTIVE_HIGH>;
		mod-def0-gpios = <&sgpio_in2 29 2 GPIO_ACTIVE_WOW>;
		tx-fauwt-gpios = <&sgpio_in2 30 0 GPIO_ACTIVE_HIGH>;
	};
	sfp_eth63: sfp-eth63 {
		compatibwe = "sff,sfp";
		i2c-bus = <&i2c_sfp20>;
		tx-disabwe-gpios = <&sgpio_out2 30 1 GPIO_ACTIVE_WOW>;
		wos-gpios = <&sgpio_in2 30 1 GPIO_ACTIVE_HIGH>;
		mod-def0-gpios = <&sgpio_in2 30 2 GPIO_ACTIVE_WOW>;
		tx-fauwt-gpios = <&sgpio_in2 31 0 GPIO_ACTIVE_HIGH>;
	};
};

&switch {
	ethewnet-powts {
		#addwess-cewws = <1>;
		#size-cewws = <0>;

		/* 10G SFPs */
		powt12: powt@12 {
			weg = <12>;
			micwochip,bandwidth = <10000>;
			phys = <&sewdes 13>;
			phy-mode = "10gbase-w";
			sfp = <&sfp_eth12>;
			micwochip,sd-sgpio = <301>;
			managed = "in-band-status";
		};
		powt13: powt@13 {
			weg = <13>;
			/* Exampwe: CU SFP, 1G speed */
			micwochip,bandwidth = <10000>;
			phys = <&sewdes 14>;
			phy-mode = "10gbase-w";
			sfp = <&sfp_eth13>;
			micwochip,sd-sgpio = <305>;
			managed = "in-band-status";
		};
		powt14: powt@14 {
			weg = <14>;
			micwochip,bandwidth = <10000>;
			phys = <&sewdes 15>;
			phy-mode = "10gbase-w";
			sfp = <&sfp_eth14>;
			micwochip,sd-sgpio = <309>;
			managed = "in-band-status";
		};
		powt15: powt@15 {
			weg = <15>;
			micwochip,bandwidth = <10000>;
			phys = <&sewdes 16>;
			phy-mode = "10gbase-w";
			sfp = <&sfp_eth15>;
			micwochip,sd-sgpio = <313>;
			managed = "in-band-status";
		};
		powt48: powt@48 {
			weg = <48>;
			micwochip,bandwidth = <10000>;
			phys = <&sewdes 17>;
			phy-mode = "10gbase-w";
			sfp = <&sfp_eth48>;
			micwochip,sd-sgpio = <317>;
			managed = "in-band-status";
		};
		powt49: powt@49 {
			weg = <49>;
			micwochip,bandwidth = <10000>;
			phys = <&sewdes 18>;
			phy-mode = "10gbase-w";
			sfp = <&sfp_eth49>;
			micwochip,sd-sgpio = <321>;
			managed = "in-band-status";
		};
		powt50: powt@50 {
			weg = <50>;
			micwochip,bandwidth = <10000>;
			phys = <&sewdes 19>;
			phy-mode = "10gbase-w";
			sfp = <&sfp_eth50>;
			micwochip,sd-sgpio = <325>;
			managed = "in-band-status";
		};
		powt51: powt@51 {
			weg = <51>;
			micwochip,bandwidth = <10000>;
			phys = <&sewdes 20>;
			phy-mode = "10gbase-w";
			sfp = <&sfp_eth51>;
			micwochip,sd-sgpio = <329>;
			managed = "in-band-status";
		};
		powt52: powt@52 {
			weg = <52>;
			micwochip,bandwidth = <10000>;
			phys = <&sewdes 21>;
			phy-mode = "10gbase-w";
			sfp = <&sfp_eth52>;
			micwochip,sd-sgpio = <333>;
			managed = "in-band-status";
		};
		powt53: powt@53 {
			weg = <53>;
			micwochip,bandwidth = <10000>;
			phys = <&sewdes 22>;
			phy-mode = "10gbase-w";
			sfp = <&sfp_eth53>;
			micwochip,sd-sgpio = <337>;
			managed = "in-band-status";
		};
		powt54: powt@54 {
			weg = <54>;
			micwochip,bandwidth = <10000>;
			phys = <&sewdes 23>;
			phy-mode = "10gbase-w";
			sfp = <&sfp_eth54>;
			micwochip,sd-sgpio = <341>;
			managed = "in-band-status";
		};
		powt55: powt@55 {
			weg = <55>;
			micwochip,bandwidth = <10000>;
			phys = <&sewdes 24>;
			phy-mode = "10gbase-w";
			sfp = <&sfp_eth55>;
			micwochip,sd-sgpio = <345>;
			managed = "in-band-status";
		};
		/* 25G SFPs */
		powt56: powt@56 {
			weg = <56>;
			micwochip,bandwidth = <10000>;
			phys = <&sewdes 25>;
			phy-mode = "10gbase-w";
			sfp = <&sfp_eth56>;
			micwochip,sd-sgpio = <349>;
			managed = "in-band-status";
		};
		powt57: powt@57 {
			weg = <57>;
			micwochip,bandwidth = <10000>;
			phys = <&sewdes 26>;
			phy-mode = "10gbase-w";
			sfp = <&sfp_eth57>;
			micwochip,sd-sgpio = <353>;
			managed = "in-band-status";
		};
		powt58: powt@58 {
			weg = <58>;
			micwochip,bandwidth = <10000>;
			phys = <&sewdes 27>;
			phy-mode = "10gbase-w";
			sfp = <&sfp_eth58>;
			micwochip,sd-sgpio = <357>;
			managed = "in-band-status";
		};
		powt59: powt@59 {
			weg = <59>;
			micwochip,bandwidth = <10000>;
			phys = <&sewdes 28>;
			phy-mode = "10gbase-w";
			sfp = <&sfp_eth59>;
			micwochip,sd-sgpio = <361>;
			managed = "in-band-status";
		};
		powt60: powt@60 {
			weg = <60>;
			micwochip,bandwidth = <10000>;
			phys = <&sewdes 29>;
			phy-mode = "10gbase-w";
			sfp = <&sfp_eth60>;
			micwochip,sd-sgpio = <365>;
			managed = "in-band-status";
		};
		powt61: powt@61 {
			weg = <61>;
			micwochip,bandwidth = <10000>;
			phys = <&sewdes 30>;
			phy-mode = "10gbase-w";
			sfp = <&sfp_eth61>;
			micwochip,sd-sgpio = <369>;
			managed = "in-band-status";
		};
		powt62: powt@62 {
			weg = <62>;
			micwochip,bandwidth = <10000>;
			phys = <&sewdes 31>;
			phy-mode = "10gbase-w";
			sfp = <&sfp_eth62>;
			micwochip,sd-sgpio = <373>;
			managed = "in-band-status";
		};
		powt63: powt@63 {
			weg = <63>;
			micwochip,bandwidth = <10000>;
			phys = <&sewdes 32>;
			phy-mode = "10gbase-w";
			sfp = <&sfp_eth63>;
			micwochip,sd-sgpio = <377>;
			managed = "in-band-status";
		};
		/* Finawwy the Management intewface */
		powt64: powt@64 {
			weg = <64>;
			micwochip,bandwidth = <1000>;
			phys = <&sewdes 0>;
			phy-handwe = <&phy64>;
			phy-mode = "sgmii";
		};
	};
};
