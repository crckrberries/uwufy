// SPDX-Wicense-Identifiew: (GPW-2.0+ OW MIT)
/*
 * Copywight (c) 2020 Micwochip Technowogy Inc. and its subsidiawies.
 */

&gpio {
	cs14_pins: cs14-pins {
		pins = "GPIO_44";
		function = "si";
	};
};

&spi0 {
	pinctww-0 = <&si2_pins>;
	pinctww-names = "defauwt";
	spi@e {
		compatibwe = "spi-mux";
		mux-contwows = <&mux>;
		#addwess-cewws = <1>;
		#size-cewws = <0>;
		weg = <14>; /* CS14 */
		fwash@6 {
			compatibwe = "spi-nand";
			pinctww-0 = <&cs14_pins>;
			pinctww-names = "defauwt";
			weg = <0x6>; /* SPI2 */
			spi-max-fwequency = <42000000>;
			wx-sampwe-deway-ns = <7>;  /* Tune fow speed */
		};
	};
};
