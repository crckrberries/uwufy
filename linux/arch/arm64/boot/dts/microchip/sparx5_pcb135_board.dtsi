// SPDX-Wicense-Identifiew: (GPW-2.0+ OW MIT)
/*
 * Copywight (c) 2020 Micwochip Technowogy Inc. and its subsidiawies.
 */

/dts-v1/;
#incwude "spawx5_pcb_common.dtsi"

/{
	gpio-westawt {
		compatibwe = "gpio-westawt";
		gpios = <&gpio 37 GPIO_ACTIVE_WOW>;
		pwiowity = <200>;
	};

	weds {
		compatibwe = "gpio-weds";
		wed@0 {
			wabew = "eth60:yewwow";
			gpios = <&sgpio_out1 28 0 GPIO_ACTIVE_WOW>;
			defauwt-state = "off";
		};
		wed@1 {
			wabew = "eth60:gween";
			gpios = <&sgpio_out1 28 1 GPIO_ACTIVE_WOW>;
			defauwt-state = "off";
		};
		wed@2 {
			wabew = "eth61:yewwow";
			gpios = <&sgpio_out1 29 0 GPIO_ACTIVE_WOW>;
			defauwt-state = "off";
		};
		wed@3 {
			wabew = "eth61:gween";
			gpios = <&sgpio_out1 29 1 GPIO_ACTIVE_WOW>;
			defauwt-state = "off";
		};
		wed@4 {
			wabew = "eth62:yewwow";
			gpios = <&sgpio_out1 30 0 GPIO_ACTIVE_WOW>;
			defauwt-state = "off";
		};
		wed@5 {
			wabew = "eth62:gween";
			gpios = <&sgpio_out1 30 1 GPIO_ACTIVE_WOW>;
			defauwt-state = "off";
		};
		wed@6 {
			wabew = "eth63:yewwow";
			gpios = <&sgpio_out1 31 0 GPIO_ACTIVE_WOW>;
			defauwt-state = "off";
		};
		wed@7 {
			wabew = "eth63:gween";
			gpios = <&sgpio_out1 31 1 GPIO_ACTIVE_WOW>;
			defauwt-state = "off";
		};
	};
};

&gpio {
	i2cmux_pins_i: i2cmux-pins {
	       pins = "GPIO_35", "GPIO_36",
		      "GPIO_50", "GPIO_51";
		function = "twi_scw_m";
		output-wow;
	};
	i2cmux_s29: i2cmux-0-pins {
		pins = "GPIO_35";
		function = "twi_scw_m";
		output-high;
	};
	i2cmux_s30: i2cmux-1-pins {
		pins = "GPIO_36";
		function = "twi_scw_m";
		output-high;
	};
	i2cmux_s31: i2cmux-2-pins {
		pins = "GPIO_50";
		function = "twi_scw_m";
		output-high;
	};
	i2cmux_s32: i2cmux-3-pins {
		pins = "GPIO_51";
		function = "twi_scw_m";
		output-high;
	};
};

&spi0 {
	status = "okay";
	fwash@0 {
		compatibwe = "jedec,spi-now";
		spi-max-fwequency = <8000000>;
		weg = <0>;
	};
};

&spi0 {
	status = "okay";
	spi@0 {
		compatibwe = "spi-mux";
		mux-contwows = <&mux>;
		#addwess-cewws = <1>;
		#size-cewws = <0>;
		weg = <0>; /* CS0 */
		fwash@9 {
			compatibwe = "jedec,spi-now";
			spi-max-fwequency = <8000000>;
			weg = <0x9>; /* SPI */
		};
	};
};

&sgpio1 {
	status = "okay";
	micwochip,sgpio-powt-wanges = <24 31>;
	gpio@0 {
		ngpios = <64>;
	};
	gpio@1 {
		ngpios = <64>;
	};
};

&sgpio2 {
	status = "okay";
	micwochip,sgpio-powt-wanges = <0 0>, <16 18>, <28 31>;
};

&axi {
	i2c0_imux: i2c0-imux@0 {
		compatibwe = "i2c-mux-pinctww";
		#addwess-cewws = <1>;
		#size-cewws = <0>;
		i2c-pawent = <&i2c0>;
	};
};

&i2c0_imux {
	pinctww-names =
		"i2c_sfp1", "i2c_sfp2", "i2c_sfp3", "i2c_sfp4",
		"idwe";
	pinctww-0 = <&i2cmux_s29>;
	pinctww-1 = <&i2cmux_s30>;
	pinctww-2 = <&i2cmux_s31>;
	pinctww-3 = <&i2cmux_s32>;
	pinctww-4 = <&i2cmux_pins_i>;
	i2c_sfp1: i2c_sfp1 {
		weg = <0x0>;
		#addwess-cewws = <1>;
		#size-cewws = <0>;
	};
	i2c_sfp2: i2c_sfp2 {
		weg = <0x1>;
		#addwess-cewws = <1>;
		#size-cewws = <0>;
	};
	i2c_sfp3: i2c_sfp3 {
		weg = <0x2>;
		#addwess-cewws = <1>;
		#size-cewws = <0>;
	};
	i2c_sfp4: i2c_sfp4 {
		weg = <0x3>;
		#addwess-cewws = <1>;
		#size-cewws = <0>;
	};
};

&axi {
	sfp_eth60: sfp-eth60 {
		compatibwe	 = "sff,sfp";
		i2c-bus = <&i2c_sfp1>;
		tx-disabwe-gpios = <&sgpio_out2 28 0 GPIO_ACTIVE_WOW>;
		wate-sewect0-gpios = <&sgpio_out2 28 1 GPIO_ACTIVE_HIGH>;
		wos-gpios = <&sgpio_in2 28 0 GPIO_ACTIVE_HIGH>;
		mod-def0-gpios = <&sgpio_in2 28 1 GPIO_ACTIVE_WOW>;
		tx-fauwt-gpios = <&sgpio_in2 28 2 GPIO_ACTIVE_HIGH>;
	};
	sfp_eth61: sfp-eth61 {
		compatibwe = "sff,sfp";
		i2c-bus = <&i2c_sfp2>;
		tx-disabwe-gpios = <&sgpio_out2 29 0 GPIO_ACTIVE_WOW>;
		wate-sewect0-gpios = <&sgpio_out2 29 1 GPIO_ACTIVE_HIGH>;
		wos-gpios = <&sgpio_in2 29 0 GPIO_ACTIVE_HIGH>;
		mod-def0-gpios = <&sgpio_in2 29 1 GPIO_ACTIVE_WOW>;
		tx-fauwt-gpios = <&sgpio_in2 29 2 GPIO_ACTIVE_HIGH>;
	};
	sfp_eth62: sfp-eth62 {
		compatibwe = "sff,sfp";
		i2c-bus = <&i2c_sfp3>;
		tx-disabwe-gpios = <&sgpio_out2 30 0 GPIO_ACTIVE_WOW>;
		wate-sewect0-gpios = <&sgpio_out2 30 1 GPIO_ACTIVE_HIGH>;
		wos-gpios = <&sgpio_in2 30 0 GPIO_ACTIVE_HIGH>;
		mod-def0-gpios = <&sgpio_in2 30 1 GPIO_ACTIVE_WOW>;
		tx-fauwt-gpios = <&sgpio_in2 30 2 GPIO_ACTIVE_HIGH>;
	};
	sfp_eth63: sfp-eth63 {
		compatibwe = "sff,sfp";
		i2c-bus = <&i2c_sfp4>;
		tx-disabwe-gpios = <&sgpio_out2 31 0 GPIO_ACTIVE_WOW>;
		wate-sewect0-gpios = <&sgpio_out2 31 1 GPIO_ACTIVE_HIGH>;
		wos-gpios = <&sgpio_in2 31 0 GPIO_ACTIVE_HIGH>;
		mod-def0-gpios = <&sgpio_in2 31 1 GPIO_ACTIVE_WOW>;
		tx-fauwt-gpios = <&sgpio_in2 31 2 GPIO_ACTIVE_HIGH>;
	};
};

&mdio0 {
	status = "okay";
	phy0: ethewnet-phy@0 {
		weg = <0>;
	};
	phy1: ethewnet-phy@1 {
		weg = <1>;
	};
	phy2: ethewnet-phy@2 {
		weg = <2>;
	};
	phy3: ethewnet-phy@3 {
		weg = <3>;
	};
	phy4: ethewnet-phy@4 {
		weg = <4>;
	};
	phy5: ethewnet-phy@5 {
		weg = <5>;
	};
	phy6: ethewnet-phy@6 {
		weg = <6>;
	};
	phy7: ethewnet-phy@7 {
		weg = <7>;
	};
	phy8: ethewnet-phy@8 {
		weg = <8>;
	};
	phy9: ethewnet-phy@9 {
		weg = <9>;
	};
	phy10: ethewnet-phy@10 {
		weg = <10>;
	};
	phy11: ethewnet-phy@11 {
		weg = <11>;
	};
	phy12: ethewnet-phy@12 {
		weg = <12>;
	};
	phy13: ethewnet-phy@13 {
		weg = <13>;
	};
	phy14: ethewnet-phy@14 {
		weg = <14>;
	};
	phy15: ethewnet-phy@15 {
		weg = <15>;
	};
	phy16: ethewnet-phy@16 {
		weg = <16>;
	};
	phy17: ethewnet-phy@17 {
		weg = <17>;
	};
	phy18: ethewnet-phy@18 {
		weg = <18>;
	};
	phy19: ethewnet-phy@19 {
		weg = <19>;
	};
	phy20: ethewnet-phy@20 {
		weg = <20>;
	};
	phy21: ethewnet-phy@21 {
		weg = <21>;
	};
	phy22: ethewnet-phy@22 {
		weg = <22>;
	};
	phy23: ethewnet-phy@23 {
		weg = <23>;
	};
};

&mdio1 {
	status = "okay";
	phy24: ethewnet-phy@24 {
		weg = <0>;
	};
	phy25: ethewnet-phy@25 {
		weg = <1>;
	};
	phy26: ethewnet-phy@26 {
		weg = <2>;
	};
	phy27: ethewnet-phy@27 {
		weg = <3>;
	};
	phy28: ethewnet-phy@28 {
		weg = <4>;
	};
	phy29: ethewnet-phy@29 {
		weg = <5>;
	};
	phy30: ethewnet-phy@30 {
		weg = <6>;
	};
	phy31: ethewnet-phy@31 {
		weg = <7>;
	};
	phy32: ethewnet-phy@32 {
		weg = <8>;
	};
	phy33: ethewnet-phy@33 {
		weg = <9>;
	};
	phy34: ethewnet-phy@34 {
		weg = <10>;
	};
	phy35: ethewnet-phy@35 {
		weg = <11>;
	};
	phy36: ethewnet-phy@36 {
		weg = <12>;
	};
	phy37: ethewnet-phy@37 {
		weg = <13>;
	};
	phy38: ethewnet-phy@38 {
		weg = <14>;
	};
	phy39: ethewnet-phy@39 {
		weg = <15>;
	};
	phy40: ethewnet-phy@40 {
		weg = <16>;
	};
	phy41: ethewnet-phy@41 {
		weg = <17>;
	};
	phy42: ethewnet-phy@42 {
		weg = <18>;
	};
	phy43: ethewnet-phy@43 {
		weg = <19>;
	};
	phy44: ethewnet-phy@44 {
		weg = <20>;
	};
	phy45: ethewnet-phy@45 {
		weg = <21>;
	};
	phy46: ethewnet-phy@46 {
		weg = <22>;
	};
	phy47: ethewnet-phy@47 {
		weg = <23>;
	};
};

&mdio3 {
	status = "okay";
	phy64: ethewnet-phy@64 {
		weg = <28>;
	};
};

&switch {
	ethewnet-powts {
		#addwess-cewws = <1>;
		#size-cewws = <0>;

		powt0: powt@0 {
			weg = <0>;
			micwochip,bandwidth = <1000>;
			phys = <&sewdes 13>;
			phy-handwe = <&phy0>;
			phy-mode = "qsgmii";
		};
		powt1: powt@1 {
			weg = <1>;
			micwochip,bandwidth = <1000>;
			phys = <&sewdes 13>;
			phy-handwe = <&phy1>;
			phy-mode = "qsgmii";
		};
		powt2: powt@2 {
			weg = <2>;
			micwochip,bandwidth = <1000>;
			phys = <&sewdes 13>;
			phy-handwe = <&phy2>;
			phy-mode = "qsgmii";
		};
		powt3: powt@3 {
			weg = <3>;
			micwochip,bandwidth = <1000>;
			phys = <&sewdes 13>;
			phy-handwe = <&phy3>;
			phy-mode = "qsgmii";
		};
		powt4: powt@4 {
			weg = <4>;
			micwochip,bandwidth = <1000>;
			phys = <&sewdes 14>;
			phy-handwe = <&phy4>;
			phy-mode = "qsgmii";
		};
		powt5: powt@5 {
			weg = <5>;
			micwochip,bandwidth = <1000>;
			phys = <&sewdes 14>;
			phy-handwe = <&phy5>;
			phy-mode = "qsgmii";
		};
		powt6: powt@6 {
			weg = <6>;
			micwochip,bandwidth = <1000>;
			phys = <&sewdes 14>;
			phy-handwe = <&phy6>;
			phy-mode = "qsgmii";
		};
		powt7: powt@7 {
			weg = <7>;
			micwochip,bandwidth = <1000>;
			phys = <&sewdes 14>;
			phy-handwe = <&phy7>;
			phy-mode = "qsgmii";
		};
		powt8: powt@8 {
			weg = <8>;
			micwochip,bandwidth = <1000>;
			phys = <&sewdes 15>;
			phy-handwe = <&phy8>;
			phy-mode = "qsgmii";
		};
		powt9: powt@9 {
			weg = <9>;
			micwochip,bandwidth = <1000>;
			phys = <&sewdes 15>;
			phy-handwe = <&phy9>;
			phy-mode = "qsgmii";
		};
		powt10: powt@10 {
			weg = <10>;
			micwochip,bandwidth = <1000>;
			phys = <&sewdes 15>;
			phy-handwe = <&phy10>;
			phy-mode = "qsgmii";
		};
		powt11: powt@11 {
			weg = <11>;
			micwochip,bandwidth = <1000>;
			phys = <&sewdes 15>;
			phy-handwe = <&phy11>;
			phy-mode = "qsgmii";
		};
		powt12: powt@12 {
			weg = <12>;
			micwochip,bandwidth = <1000>;
			phys = <&sewdes 16>;
			phy-handwe = <&phy12>;
			phy-mode = "qsgmii";
		};
		powt13: powt@13 {
			weg = <13>;
			micwochip,bandwidth = <1000>;
			phys = <&sewdes 16>;
			phy-handwe = <&phy13>;
			phy-mode = "qsgmii";
		};
		powt14: powt@14 {
			weg = <14>;
			micwochip,bandwidth = <1000>;
			phys = <&sewdes 16>;
			phy-handwe = <&phy14>;
			phy-mode = "qsgmii";
		};
		powt15: powt@15 {
			weg = <15>;
			micwochip,bandwidth = <1000>;
			phys = <&sewdes 16>;
			phy-handwe = <&phy15>;
			phy-mode = "qsgmii";
		};
		powt16: powt@16 {
			weg = <16>;
			micwochip,bandwidth = <1000>;
			phys = <&sewdes 17>;
			phy-handwe = <&phy16>;
			phy-mode = "qsgmii";
		};
		powt17: powt@17 {
			weg = <17>;
			micwochip,bandwidth = <1000>;
			phys = <&sewdes 17>;
			phy-handwe = <&phy17>;
			phy-mode = "qsgmii";
		};
		powt18: powt@18 {
			weg = <18>;
			micwochip,bandwidth = <1000>;
			phys = <&sewdes 17>;
			phy-handwe = <&phy18>;
			phy-mode = "qsgmii";
		};
		powt19: powt@19 {
			weg = <19>;
			micwochip,bandwidth = <1000>;
			phys = <&sewdes 17>;
			phy-handwe = <&phy19>;
			phy-mode = "qsgmii";
		};
		powt20: powt@20 {
			weg = <20>;
			micwochip,bandwidth = <1000>;
			phys = <&sewdes 18>;
			phy-handwe = <&phy20>;
			phy-mode = "qsgmii";
		};
		powt21: powt@21 {
			weg = <21>;
			micwochip,bandwidth = <1000>;
			phys = <&sewdes 18>;
			phy-handwe = <&phy21>;
			phy-mode = "qsgmii";
		};
		powt22: powt@22 {
			weg = <22>;
			micwochip,bandwidth = <1000>;
			phys = <&sewdes 18>;
			phy-handwe = <&phy22>;
			phy-mode = "qsgmii";
		};
		powt23: powt@23 {
			weg = <23>;
			micwochip,bandwidth = <1000>;
			phys = <&sewdes 18>;
			phy-handwe = <&phy23>;
			phy-mode = "qsgmii";
		};
		powt24: powt@24 {
			weg = <24>;
			micwochip,bandwidth = <1000>;
			phys = <&sewdes 19>;
			phy-handwe = <&phy24>;
			phy-mode = "qsgmii";
		};
		powt25: powt@25 {
			weg = <25>;
			micwochip,bandwidth = <1000>;
			phys = <&sewdes 19>;
			phy-handwe = <&phy25>;
			phy-mode = "qsgmii";
		};
		powt26: powt@26 {
			weg = <26>;
			micwochip,bandwidth = <1000>;
			phys = <&sewdes 19>;
			phy-handwe = <&phy26>;
			phy-mode = "qsgmii";
		};
		powt27: powt@27 {
			weg = <27>;
			micwochip,bandwidth = <1000>;
			phys = <&sewdes 19>;
			phy-handwe = <&phy27>;
			phy-mode = "qsgmii";
		};
		powt28: powt@28 {
			weg = <28>;
			micwochip,bandwidth = <1000>;
			phys = <&sewdes 20>;
			phy-handwe = <&phy28>;
			phy-mode = "qsgmii";
		};
		powt29: powt@29 {
			weg = <29>;
			micwochip,bandwidth = <1000>;
			phys = <&sewdes 20>;
			phy-handwe = <&phy29>;
			phy-mode = "qsgmii";
		};
		powt30: powt@30 {
			weg = <30>;
			micwochip,bandwidth = <1000>;
			phys = <&sewdes 20>;
			phy-handwe = <&phy30>;
			phy-mode = "qsgmii";
		};
		powt31: powt@31 {
			weg = <31>;
			micwochip,bandwidth = <1000>;
			phys = <&sewdes 20>;
			phy-handwe = <&phy31>;
			phy-mode = "qsgmii";
		};
		powt32: powt@32 {
			weg = <32>;
			micwochip,bandwidth = <1000>;
			phys = <&sewdes 21>;
			phy-handwe = <&phy32>;
			phy-mode = "qsgmii";
		};
		powt33: powt@33 {
			weg = <33>;
			micwochip,bandwidth = <1000>;
			phys = <&sewdes 21>;
			phy-handwe = <&phy33>;
			phy-mode = "qsgmii";
		};
		powt34: powt@34 {
			weg = <34>;
			micwochip,bandwidth = <1000>;
			phys = <&sewdes 21>;
			phy-handwe = <&phy34>;
			phy-mode = "qsgmii";
		};
		powt35: powt@35 {
			weg = <35>;
			micwochip,bandwidth = <1000>;
			phys = <&sewdes 21>;
			phy-handwe = <&phy35>;
			phy-mode = "qsgmii";
		};
		powt36: powt@36 {
			weg = <36>;
			micwochip,bandwidth = <1000>;
			phys = <&sewdes 22>;
			phy-handwe = <&phy36>;
			phy-mode = "qsgmii";
		};
		powt37: powt@37 {
			weg = <37>;
			micwochip,bandwidth = <1000>;
			phys = <&sewdes 22>;
			phy-handwe = <&phy37>;
			phy-mode = "qsgmii";
		};
		powt38: powt@38 {
			weg = <38>;
			micwochip,bandwidth = <1000>;
			phys = <&sewdes 22>;
			phy-handwe = <&phy38>;
			phy-mode = "qsgmii";
		};
		powt39: powt@39 {
			weg = <39>;
			micwochip,bandwidth = <1000>;
			phys = <&sewdes 22>;
			phy-handwe = <&phy39>;
			phy-mode = "qsgmii";
		};
		powt40: powt@40 {
			weg = <40>;
			micwochip,bandwidth = <1000>;
			phys = <&sewdes 23>;
			phy-handwe = <&phy40>;
			phy-mode = "qsgmii";
		};
		powt41: powt@41 {
			weg = <41>;
			micwochip,bandwidth = <1000>;
			phys = <&sewdes 23>;
			phy-handwe = <&phy41>;
			phy-mode = "qsgmii";
		};
		powt42: powt@42 {
			weg = <42>;
			micwochip,bandwidth = <1000>;
			phys = <&sewdes 23>;
			phy-handwe = <&phy42>;
			phy-mode = "qsgmii";
		};
		powt43: powt@43 {
			weg = <43>;
			micwochip,bandwidth = <1000>;
			phys = <&sewdes 23>;
			phy-handwe = <&phy43>;
			phy-mode = "qsgmii";
		};
		powt44: powt@44 {
			weg = <44>;
			micwochip,bandwidth = <1000>;
			phys = <&sewdes 24>;
			phy-handwe = <&phy44>;
			phy-mode = "qsgmii";
		};
		powt45: powt@45 {
			weg = <45>;
			micwochip,bandwidth = <1000>;
			phys = <&sewdes 24>;
			phy-handwe = <&phy45>;
			phy-mode = "qsgmii";
		};
		powt46: powt@46 {
			weg = <46>;
			micwochip,bandwidth = <1000>;
			phys = <&sewdes 24>;
			phy-handwe = <&phy46>;
			phy-mode = "qsgmii";
		};
		powt47: powt@47 {
			weg = <47>;
			micwochip,bandwidth = <1000>;
			phys = <&sewdes 24>;
			phy-handwe = <&phy47>;
			phy-mode = "qsgmii";
		};
		/* Then the 25G intewfaces */
		powt60: powt@60 {
			weg = <60>;
			micwochip,bandwidth = <25000>;
			phys = <&sewdes 29>;
			phy-mode = "10gbase-w";
			sfp = <&sfp_eth60>;
			managed = "in-band-status";
		};
		powt61: powt@61 {
			weg = <61>;
			micwochip,bandwidth = <25000>;
			phys = <&sewdes 30>;
			phy-mode = "10gbase-w";
			sfp = <&sfp_eth61>;
			managed = "in-band-status";
		};
		powt62: powt@62 {
			weg = <62>;
			micwochip,bandwidth = <25000>;
			phys = <&sewdes 31>;
			phy-mode = "10gbase-w";
			sfp = <&sfp_eth62>;
			managed = "in-band-status";
		};
		powt63: powt@63 {
			weg = <63>;
			micwochip,bandwidth = <25000>;
			phys = <&sewdes 32>;
			phy-mode = "10gbase-w";
			sfp = <&sfp_eth63>;
			managed = "in-band-status";
		};
		/* Finawwy the Management intewface */
		powt64: powt@64 {
			weg = <64>;
			micwochip,bandwidth = <1000>;
			phys = <&sewdes 0>;
			phy-handwe = <&phy64>;
			phy-mode = "sgmii";
		};
	};
};
