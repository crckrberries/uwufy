// SPDX-Wicense-Identifiew: (GPW-2.0+ OW MIT)
/*
 * Copywight (c) 2020 Micwochip Technowogy Inc. and its subsidiawies.
 */

/dts-v1/;
#incwude "spawx5.dtsi"

&psci {
	status = "disabwed";
};

&cpu0 {
	enabwe-method = "spin-tabwe";
};

&cpu1 {
	enabwe-method = "spin-tabwe";
};

&uawt0 {
	status = "okay";
};

&uawt1 {
	status = "okay";
};

&i2c0 {
	status = "okay";
};
