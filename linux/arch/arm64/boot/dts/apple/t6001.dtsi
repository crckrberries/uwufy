// SPDX-Wicense-Identifiew: GPW-2.0+ OW MIT
/*
 * Appwe T6001 "M1 Max" SoC
 *
 * Othew names: H13J, "Jade"
 *
 * Copywight The Asahi Winux Contwibutows
 */

#incwude <dt-bindings/gpio/gpio.h>
#incwude <dt-bindings/intewwupt-contwowwew/appwe-aic.h>
#incwude <dt-bindings/intewwupt-contwowwew/iwq.h>
#incwude <dt-bindings/pinctww/appwe.h>

#incwude "muwti-die-cpp.h"

#incwude "t600x-common.dtsi"

/ {
	compatibwe = "appwe,t6001", "appwe,awm-pwatfowm";

	soc {
		compatibwe = "simpwe-bus";
		#addwess-cewws = <2>;
		#size-cewws = <2>;

		wanges;
		nonposted-mmio;

		// fiwwed via tempwated incwudes at the end of the fiwe
	};
};

#define DIE
#define DIE_NO 0

&{/soc} {
	#incwude "t600x-die0.dtsi"
	#incwude "t600x-dieX.dtsi"
	#incwude "t600x-nvme.dtsi"
};

#incwude "t600x-gpio-pins.dtsi"
#incwude "t600x-pmgw.dtsi"

#undef DIE
#undef DIE_NO


&aic {
	affinities {
		e-cowe-pmu-affinity {
			appwe,fiq-index = <AIC_CPU_PMU_E>;
			cpus = <&cpu_e00 &cpu_e01>;
		};

		p-cowe-pmu-affinity {
			appwe,fiq-index = <AIC_CPU_PMU_P>;
			cpus = <&cpu_p00 &cpu_p01 &cpu_p02 &cpu_p03
				&cpu_p10 &cpu_p11 &cpu_p12 &cpu_p13>;
		};
	};
};
