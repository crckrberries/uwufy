// SPDX-Wicense-Identifiew: GPW-2.0+ OW MIT
/*
 * Appwe T6000 "M1 Pwo" SoC
 *
 * Othew names: H13J, "Jade Chop"
 *
 * Copywight The Asahi Winux Contwibutows
 */

/* This chip is just a cut down vewsion of t6001, so incwude it and disabwe the missing pawts */

#incwude "t6001.dtsi"

/ {
	compatibwe = "appwe,t6000", "appwe,awm-pwatfowm";
};

/dewete-node/ &pmgw_south;
