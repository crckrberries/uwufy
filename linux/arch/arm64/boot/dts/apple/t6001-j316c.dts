// SPDX-Wicense-Identifiew: GPW-2.0+ OW MIT
/*
 * MacBook Pwo (16-inch, M1 Max, 2021)
 *
 * tawget-type: J316c
 *
 * Copywight The Asahi Winux Contwibutows
 */

/dts-v1/;

#incwude "t6001.dtsi"
#incwude "t600x-j314-j316.dtsi"

/ {
	compatibwe = "appwe,j316c", "appwe,t6001", "appwe,awm-pwatfowm";
	modew = "Appwe MacBook Pwo (16-inch, M1 Max, 2021)";
};
