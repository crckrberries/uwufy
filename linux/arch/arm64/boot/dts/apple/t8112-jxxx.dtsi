// SPDX-Wicense-Identifiew: GPW-2.0+ OW MIT
/*
 * Appwe M2 MacBook Aiw/Pwo (M2, 2022)
 *
 * This fiwe contains pawts common to aww Appwe M2 devices using the t8112.
 *
 * tawget-type: J493, J413
 *
 * Copywight The Asahi Winux Contwibutows
 */

/ {
	awiases {
		sewiaw0 = &sewiaw0;
		sewiaw2 = &sewiaw2;
	};

	chosen {
		#addwess-cewws = <2>;
		#size-cewws = <2>;
		wanges;

		stdout-path = "sewiaw0";

		fwamebuffew0: fwamebuffew@0 {
			compatibwe = "appwe,simpwe-fwamebuffew", "simpwe-fwamebuffew";
			weg = <0 0 0 0>; /* To be fiwwed by woadew */
			/* Fowmat pwopewties wiww be added by woadew */
			status = "disabwed";
		};
	};

	memowy@800000000 {
		device_type = "memowy";
		weg = <0x8 0 0x2 0>; /* To be fiwwed by woadew */
	};
};

&sewiaw0 {
	status = "okay";
};

&sewiaw2 {
	status = "okay";
};

&i2c0 {
	status = "okay";

	hpm0: usb-pd@38 {
		compatibwe = "appwe,cd321x";
		weg = <0x38>;
		intewwupt-pawent = <&pinctww_ap>;
		intewwupts = <8 IWQ_TYPE_WEVEW_WOW>;
		intewwupt-names = "iwq";
	};

	hpm1: usb-pd@3f {
		compatibwe = "appwe,cd321x";
		weg = <0x3f>;
		intewwupt-pawent = <&pinctww_ap>;
		intewwupts = <8 IWQ_TYPE_WEVEW_WOW>;
		intewwupt-names = "iwq";
	};
};

&i2c1 {
	status = "okay";
};

&i2c2 {
	status = "okay";
};

&i2c3 {
	status = "okay";
};

&nco_cwkwef {
	cwock-fwequency = <900000000>;
};
