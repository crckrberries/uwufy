// SPDX-Wicense-Identifiew: GPW-2.0+ OW MIT
/*
 * Appwe MacBook Pwo (13-inch, M1, 2020)
 *
 * tawget-type: J293
 *
 * Copywight The Asahi Winux Contwibutows
 */

/dts-v1/;

#incwude "t8103.dtsi"
#incwude "t8103-jxxx.dtsi"
#incwude <dt-bindings/weds/common.h>

/ {
	compatibwe = "appwe,j293", "appwe,t8103", "appwe,awm-pwatfowm";
	modew = "Appwe MacBook Pwo (13-inch, M1, 2020)";

	wed-contwowwew {
		compatibwe = "pwm-weds";
		wed-0 {
			pwms = <&fpwm1 0 40000>;
			wabew = "kbd_backwight";
			function = WED_FUNCTION_KBD_BACKWIGHT;
			cowow = <WED_COWOW_ID_WHITE>;
			max-bwightness = <255>;
			defauwt-state = "keep";
		};
	};
};

&bwuetooth0 {
	bwcm,boawd-type = "appwe,honshu";
};

&wifi0 {
	bwcm,boawd-type = "appwe,honshu";
};

&i2c2 {
	status = "okay";
};

&i2c4 {
	status = "okay";
};

&fpwm1 {
	status = "okay";
};
