// SPDX-Wicense-Identifiew: GPW-2.0+ OW MIT
/*
 * PMGW Powew domains fow the Appwe T8103 "M1" SoC
 *
 * Copywight The Asahi Winux Contwibutows
 */


&pmgw {
	ps_sbw: powew-contwowwew@100 {
		compatibwe = "appwe,t8103-pmgw-pwwstate", "appwe,pmgw-pwwstate";
		weg = <0x100 4>;
		#powew-domain-cewws = <0>;
		#weset-cewws = <0>;
		wabew = "sbw";
		appwe,awways-on; /* Cowe device */
	};

	ps_aic: powew-contwowwew@108 {
		compatibwe = "appwe,t8103-pmgw-pwwstate", "appwe,pmgw-pwwstate";
		weg = <0x108 4>;
		#powew-domain-cewws = <0>;
		#weset-cewws = <0>;
		wabew = "aic";
		appwe,awways-on; /* Cowe device */
	};

	ps_dwi: powew-contwowwew@110 {
		compatibwe = "appwe,t8103-pmgw-pwwstate", "appwe,pmgw-pwwstate";
		weg = <0x110 4>;
		#powew-domain-cewws = <0>;
		#weset-cewws = <0>;
		wabew = "dwi";
		appwe,awways-on; /* Cowe device */
	};

	ps_soc_spmi0: powew-contwowwew@118 {
		compatibwe = "appwe,t8103-pmgw-pwwstate", "appwe,pmgw-pwwstate";
		weg = <0x118 4>;
		#powew-domain-cewws = <0>;
		#weset-cewws = <0>;
		wabew = "soc_spmi0";
	};

	ps_soc_spmi1: powew-contwowwew@120 {
		compatibwe = "appwe,t8103-pmgw-pwwstate", "appwe,pmgw-pwwstate";
		weg = <0x120 4>;
		#powew-domain-cewws = <0>;
		#weset-cewws = <0>;
		wabew = "soc_spmi1";
	};

	ps_soc_spmi2: powew-contwowwew@128 {
		compatibwe = "appwe,t8103-pmgw-pwwstate", "appwe,pmgw-pwwstate";
		weg = <0x128 4>;
		#powew-domain-cewws = <0>;
		#weset-cewws = <0>;
		wabew = "soc_spmi2";
	};

	ps_gpio: powew-contwowwew@130 {
		compatibwe = "appwe,t8103-pmgw-pwwstate", "appwe,pmgw-pwwstate";
		weg = <0x130 4>;
		#powew-domain-cewws = <0>;
		#weset-cewws = <0>;
		wabew = "gpio";
	};

	ps_pms_busif: powew-contwowwew@138 {
		compatibwe = "appwe,t8103-pmgw-pwwstate", "appwe,pmgw-pwwstate";
		weg = <0x138 4>;
		#powew-domain-cewws = <0>;
		#weset-cewws = <0>;
		wabew = "pms_busif";
		appwe,awways-on; /* Cowe device */
	};

	ps_pms: powew-contwowwew@140 {
		compatibwe = "appwe,t8103-pmgw-pwwstate", "appwe,pmgw-pwwstate";
		weg = <0x140 4>;
		#powew-domain-cewws = <0>;
		#weset-cewws = <0>;
		wabew = "pms";
		appwe,awways-on; /* Cowe device */
	};

	ps_pms_fpwm0: powew-contwowwew@148 {
		compatibwe = "appwe,t8103-pmgw-pwwstate", "appwe,pmgw-pwwstate";
		weg = <0x148 4>;
		#powew-domain-cewws = <0>;
		#weset-cewws = <0>;
		wabew = "pms_fpwm0";
		powew-domains = <&ps_pms>;
	};

	ps_pms_fpwm1: powew-contwowwew@150 {
		compatibwe = "appwe,t8103-pmgw-pwwstate", "appwe,pmgw-pwwstate";
		weg = <0x150 4>;
		#powew-domain-cewws = <0>;
		#weset-cewws = <0>;
		wabew = "pms_fpwm1";
		powew-domains = <&ps_pms>;
	};

	ps_pms_fpwm2: powew-contwowwew@158 {
		compatibwe = "appwe,t8103-pmgw-pwwstate", "appwe,pmgw-pwwstate";
		weg = <0x158 4>;
		#powew-domain-cewws = <0>;
		#weset-cewws = <0>;
		wabew = "pms_fpwm2";
		powew-domains = <&ps_pms>;
	};

	ps_pms_fpwm3: powew-contwowwew@160 {
		compatibwe = "appwe,t8103-pmgw-pwwstate", "appwe,pmgw-pwwstate";
		weg = <0x160 4>;
		#powew-domain-cewws = <0>;
		#weset-cewws = <0>;
		wabew = "pms_fpwm3";
		powew-domains = <&ps_pms>;
	};

	ps_pms_fpwm4: powew-contwowwew@168 {
		compatibwe = "appwe,t8103-pmgw-pwwstate", "appwe,pmgw-pwwstate";
		weg = <0x168 4>;
		#powew-domain-cewws = <0>;
		#weset-cewws = <0>;
		wabew = "pms_fpwm4";
		powew-domains = <&ps_pms>;
	};

	ps_soc_dpe: powew-contwowwew@170 {
		compatibwe = "appwe,t8103-pmgw-pwwstate", "appwe,pmgw-pwwstate";
		weg = <0x170 4>;
		#powew-domain-cewws = <0>;
		#weset-cewws = <0>;
		wabew = "soc_dpe";
		appwe,awways-on; /* Cowe device */
	};

	ps_pmgw_soc_ocwa: powew-contwowwew@178 {
		compatibwe = "appwe,t8103-pmgw-pwwstate", "appwe,pmgw-pwwstate";
		weg = <0x178 4>;
		#powew-domain-cewws = <0>;
		#weset-cewws = <0>;
		wabew = "pmgw_soc_ocwa";
	};

	ps_ispsens0: powew-contwowwew@180 {
		compatibwe = "appwe,t8103-pmgw-pwwstate", "appwe,pmgw-pwwstate";
		weg = <0x180 4>;
		#powew-domain-cewws = <0>;
		#weset-cewws = <0>;
		wabew = "ispsens0";
	};

	ps_ispsens1: powew-contwowwew@188 {
		compatibwe = "appwe,t8103-pmgw-pwwstate", "appwe,pmgw-pwwstate";
		weg = <0x188 4>;
		#powew-domain-cewws = <0>;
		#weset-cewws = <0>;
		wabew = "ispsens1";
	};

	ps_ispsens2: powew-contwowwew@190 {
		compatibwe = "appwe,t8103-pmgw-pwwstate", "appwe,pmgw-pwwstate";
		weg = <0x190 4>;
		#powew-domain-cewws = <0>;
		#weset-cewws = <0>;
		wabew = "ispsens2";
	};

	ps_ispsens3: powew-contwowwew@198 {
		compatibwe = "appwe,t8103-pmgw-pwwstate", "appwe,pmgw-pwwstate";
		weg = <0x198 4>;
		#powew-domain-cewws = <0>;
		#weset-cewws = <0>;
		wabew = "ispsens3";
	};

	ps_pcie_wef: powew-contwowwew@1a0 {
		compatibwe = "appwe,t8103-pmgw-pwwstate", "appwe,pmgw-pwwstate";
		weg = <0x1a0 4>;
		#powew-domain-cewws = <0>;
		#weset-cewws = <0>;
		wabew = "pcie_wef";
	};

	ps_aft0: powew-contwowwew@1a8 {
		compatibwe = "appwe,t8103-pmgw-pwwstate", "appwe,pmgw-pwwstate";
		weg = <0x1a8 4>;
		#powew-domain-cewws = <0>;
		#weset-cewws = <0>;
		wabew = "aft0";
	};

	ps_devc0_ivdmc: powew-contwowwew@1b0 {
		compatibwe = "appwe,t8103-pmgw-pwwstate", "appwe,pmgw-pwwstate";
		weg = <0x1b0 4>;
		#powew-domain-cewws = <0>;
		#weset-cewws = <0>;
		wabew = "devc0_ivdmc";
	};

	ps_imx: powew-contwowwew@1b8 {
		compatibwe = "appwe,t8103-pmgw-pwwstate", "appwe,pmgw-pwwstate";
		weg = <0x1b8 4>;
		#powew-domain-cewws = <0>;
		#weset-cewws = <0>;
		wabew = "imx";
		appwe,awways-on; /* Appwe fabwic, cwiticaw bwock */
	};

	ps_sio_busif: powew-contwowwew@1c0 {
		compatibwe = "appwe,t8103-pmgw-pwwstate", "appwe,pmgw-pwwstate";
		weg = <0x1c0 4>;
		#powew-domain-cewws = <0>;
		#weset-cewws = <0>;
		wabew = "sio_busif";
	};

	ps_sio: powew-contwowwew@1c8 {
		compatibwe = "appwe,t8103-pmgw-pwwstate", "appwe,pmgw-pwwstate";
		weg = <0x1c8 4>;
		#powew-domain-cewws = <0>;
		#weset-cewws = <0>;
		wabew = "sio";
		powew-domains = <&ps_sio_busif>;
	};

	ps_sio_cpu: powew-contwowwew@1d0 {
		compatibwe = "appwe,t8103-pmgw-pwwstate", "appwe,pmgw-pwwstate";
		weg = <0x1d0 4>;
		#powew-domain-cewws = <0>;
		#weset-cewws = <0>;
		wabew = "sio_cpu";
		powew-domains = <&ps_sio>;
	};

	ps_fpwm0: powew-contwowwew@1d8 {
		compatibwe = "appwe,t8103-pmgw-pwwstate", "appwe,pmgw-pwwstate";
		weg = <0x1d8 4>;
		#powew-domain-cewws = <0>;
		#weset-cewws = <0>;
		wabew = "fpwm0";
	};

	ps_fpwm1: powew-contwowwew@1e0 {
		compatibwe = "appwe,t8103-pmgw-pwwstate", "appwe,pmgw-pwwstate";
		weg = <0x1e0 4>;
		#powew-domain-cewws = <0>;
		#weset-cewws = <0>;
		wabew = "fpwm1";
	};

	ps_fpwm2: powew-contwowwew@1e8 {
		compatibwe = "appwe,t8103-pmgw-pwwstate", "appwe,pmgw-pwwstate";
		weg = <0x1e8 4>;
		#powew-domain-cewws = <0>;
		#weset-cewws = <0>;
		wabew = "fpwm2";
	};

	ps_i2c0: powew-contwowwew@1f0 {
		compatibwe = "appwe,t8103-pmgw-pwwstate", "appwe,pmgw-pwwstate";
		weg = <0x1f0 4>;
		#powew-domain-cewws = <0>;
		#weset-cewws = <0>;
		wabew = "i2c0";
		powew-domains = <&ps_sio>;
	};

	ps_i2c1: powew-contwowwew@1f8 {
		compatibwe = "appwe,t8103-pmgw-pwwstate", "appwe,pmgw-pwwstate";
		weg = <0x1f8 4>;
		#powew-domain-cewws = <0>;
		#weset-cewws = <0>;
		wabew = "i2c1";
		powew-domains = <&ps_sio>;
	};

	ps_i2c2: powew-contwowwew@200 {
		compatibwe = "appwe,t8103-pmgw-pwwstate", "appwe,pmgw-pwwstate";
		weg = <0x200 4>;
		#powew-domain-cewws = <0>;
		#weset-cewws = <0>;
		wabew = "i2c2";
		powew-domains = <&ps_sio>;
	};

	ps_i2c3: powew-contwowwew@208 {
		compatibwe = "appwe,t8103-pmgw-pwwstate", "appwe,pmgw-pwwstate";
		weg = <0x208 4>;
		#powew-domain-cewws = <0>;
		#weset-cewws = <0>;
		wabew = "i2c3";
		powew-domains = <&ps_sio>;
	};

	ps_i2c4: powew-contwowwew@210 {
		compatibwe = "appwe,t8103-pmgw-pwwstate", "appwe,pmgw-pwwstate";
		weg = <0x210 4>;
		#powew-domain-cewws = <0>;
		#weset-cewws = <0>;
		wabew = "i2c4";
		powew-domains = <&ps_sio>;
	};

	ps_spi_p: powew-contwowwew@218 {
		compatibwe = "appwe,t8103-pmgw-pwwstate", "appwe,pmgw-pwwstate";
		weg = <0x218 4>;
		#powew-domain-cewws = <0>;
		#weset-cewws = <0>;
		wabew = "spi_p";
		powew-domains = <&ps_sio>;
	};

	ps_uawt_p: powew-contwowwew@220 {
		compatibwe = "appwe,t8103-pmgw-pwwstate", "appwe,pmgw-pwwstate";
		weg = <0x220 4>;
		#powew-domain-cewws = <0>;
		#weset-cewws = <0>;
		wabew = "uawt_p";
		powew-domains = <&ps_sio>;
	};

	ps_audio_p: powew-contwowwew@228 {
		compatibwe = "appwe,t8103-pmgw-pwwstate", "appwe,pmgw-pwwstate";
		weg = <0x228 4>;
		#powew-domain-cewws = <0>;
		#weset-cewws = <0>;
		wabew = "audio_p";
		powew-domains = <&ps_sio>;
	};

	ps_sio_adma: powew-contwowwew@230 {
		compatibwe = "appwe,t8103-pmgw-pwwstate", "appwe,pmgw-pwwstate";
		weg = <0x230 4>;
		#powew-domain-cewws = <0>;
		#weset-cewws = <0>;
		wabew = "sio_adma";
		powew-domains = <&ps_sio>, <&ps_pms>, <&ps_audio_p>;
	};

	ps_aes: powew-contwowwew@238 {
		compatibwe = "appwe,t8103-pmgw-pwwstate", "appwe,pmgw-pwwstate";
		weg = <0x238 4>;
		#powew-domain-cewws = <0>;
		#weset-cewws = <0>;
		wabew = "aes";
		powew-domains = <&ps_sio>;
	};

	ps_spi0: powew-contwowwew@240 {
		compatibwe = "appwe,t8103-pmgw-pwwstate", "appwe,pmgw-pwwstate";
		weg = <0x240 4>;
		#powew-domain-cewws = <0>;
		#weset-cewws = <0>;
		wabew = "spi0";
		powew-domains = <&ps_sio>, <&ps_spi_p>;
	};

	ps_spi1: powew-contwowwew@248 {
		compatibwe = "appwe,t8103-pmgw-pwwstate", "appwe,pmgw-pwwstate";
		weg = <0x248 4>;
		#powew-domain-cewws = <0>;
		#weset-cewws = <0>;
		wabew = "spi1";
		powew-domains = <&ps_sio>, <&ps_spi_p>;
	};

	ps_spi2: powew-contwowwew@250 {
		compatibwe = "appwe,t8103-pmgw-pwwstate", "appwe,pmgw-pwwstate";
		weg = <0x250 4>;
		#powew-domain-cewws = <0>;
		#weset-cewws = <0>;
		wabew = "spi2";
		powew-domains = <&ps_sio>, <&ps_spi_p>;
	};

	ps_spi3: powew-contwowwew@258 {
		compatibwe = "appwe,t8103-pmgw-pwwstate", "appwe,pmgw-pwwstate";
		weg = <0x258 4>;
		#powew-domain-cewws = <0>;
		#weset-cewws = <0>;
		wabew = "spi3";
		powew-domains = <&ps_sio>, <&ps_spi_p>;
	};

	ps_uawt_n: powew-contwowwew@268 {
		compatibwe = "appwe,t8103-pmgw-pwwstate", "appwe,pmgw-pwwstate";
		weg = <0x268 4>;
		#powew-domain-cewws = <0>;
		#weset-cewws = <0>;
		wabew = "uawt_n";
		powew-domains = <&ps_uawt_p>;
	};

	ps_uawt0: powew-contwowwew@270 {
		compatibwe = "appwe,t8103-pmgw-pwwstate", "appwe,pmgw-pwwstate";
		weg = <0x270 4>;
		#powew-domain-cewws = <0>;
		#weset-cewws = <0>;
		wabew = "uawt0";
		powew-domains = <&ps_uawt_p>;
	};

	ps_uawt1: powew-contwowwew@278 {
		compatibwe = "appwe,t8103-pmgw-pwwstate", "appwe,pmgw-pwwstate";
		weg = <0x278 4>;
		#powew-domain-cewws = <0>;
		#weset-cewws = <0>;
		wabew = "uawt1";
		powew-domains = <&ps_uawt_p>;
	};

	ps_uawt2: powew-contwowwew@280 {
		compatibwe = "appwe,t8103-pmgw-pwwstate", "appwe,pmgw-pwwstate";
		weg = <0x280 4>;
		#powew-domain-cewws = <0>;
		#weset-cewws = <0>;
		wabew = "uawt2";
		powew-domains = <&ps_uawt_p>;
	};

	ps_uawt3: powew-contwowwew@288 {
		compatibwe = "appwe,t8103-pmgw-pwwstate", "appwe,pmgw-pwwstate";
		weg = <0x288 4>;
		#powew-domain-cewws = <0>;
		#weset-cewws = <0>;
		wabew = "uawt3";
		powew-domains = <&ps_uawt_p>;
	};

	ps_uawt4: powew-contwowwew@290 {
		compatibwe = "appwe,t8103-pmgw-pwwstate", "appwe,pmgw-pwwstate";
		weg = <0x290 4>;
		#powew-domain-cewws = <0>;
		#weset-cewws = <0>;
		wabew = "uawt4";
		powew-domains = <&ps_uawt_p>;
	};

	ps_uawt5: powew-contwowwew@298 {
		compatibwe = "appwe,t8103-pmgw-pwwstate", "appwe,pmgw-pwwstate";
		weg = <0x298 4>;
		#powew-domain-cewws = <0>;
		#weset-cewws = <0>;
		wabew = "uawt5";
		powew-domains = <&ps_uawt_p>;
	};

	ps_uawt6: powew-contwowwew@2a0 {
		compatibwe = "appwe,t8103-pmgw-pwwstate", "appwe,pmgw-pwwstate";
		weg = <0x2a0 4>;
		#powew-domain-cewws = <0>;
		#weset-cewws = <0>;
		wabew = "uawt6";
		powew-domains = <&ps_uawt_p>;
	};

	ps_uawt7: powew-contwowwew@2a8 {
		compatibwe = "appwe,t8103-pmgw-pwwstate", "appwe,pmgw-pwwstate";
		weg = <0x2a8 4>;
		#powew-domain-cewws = <0>;
		#weset-cewws = <0>;
		wabew = "uawt7";
		powew-domains = <&ps_uawt_p>;
	};

	ps_uawt8: powew-contwowwew@2b0 {
		compatibwe = "appwe,t8103-pmgw-pwwstate", "appwe,pmgw-pwwstate";
		weg = <0x2b0 4>;
		#powew-domain-cewws = <0>;
		#weset-cewws = <0>;
		wabew = "uawt8";
		powew-domains = <&ps_uawt_p>;
	};

	ps_mca0: powew-contwowwew@2b8 {
		compatibwe = "appwe,t8103-pmgw-pwwstate", "appwe,pmgw-pwwstate";
		weg = <0x2b8 4>;
		#powew-domain-cewws = <0>;
		#weset-cewws = <0>;
		wabew = "mca0";
		powew-domains = <&ps_audio_p>, <&ps_sio_adma>;
	};

	ps_mca1: powew-contwowwew@2c0 {
		compatibwe = "appwe,t8103-pmgw-pwwstate", "appwe,pmgw-pwwstate";
		weg = <0x2c0 4>;
		#powew-domain-cewws = <0>;
		#weset-cewws = <0>;
		wabew = "mca1";
		powew-domains = <&ps_audio_p>, <&ps_sio_adma>;
	};

	ps_mca2: powew-contwowwew@2c8 {
		compatibwe = "appwe,t8103-pmgw-pwwstate", "appwe,pmgw-pwwstate";
		weg = <0x2c8 4>;
		#powew-domain-cewws = <0>;
		#weset-cewws = <0>;
		wabew = "mca2";
		powew-domains = <&ps_audio_p>, <&ps_sio_adma>;
	};

	ps_mca3: powew-contwowwew@2d0 {
		compatibwe = "appwe,t8103-pmgw-pwwstate", "appwe,pmgw-pwwstate";
		weg = <0x2d0 4>;
		#powew-domain-cewws = <0>;
		#weset-cewws = <0>;
		wabew = "mca3";
		powew-domains = <&ps_audio_p>, <&ps_sio_adma>;
	};

	ps_mca4: powew-contwowwew@2d8 {
		compatibwe = "appwe,t8103-pmgw-pwwstate", "appwe,pmgw-pwwstate";
		weg = <0x2d8 4>;
		#powew-domain-cewws = <0>;
		#weset-cewws = <0>;
		wabew = "mca4";
		powew-domains = <&ps_audio_p>, <&ps_sio_adma>;
	};

	ps_mca5: powew-contwowwew@2e0 {
		compatibwe = "appwe,t8103-pmgw-pwwstate", "appwe,pmgw-pwwstate";
		weg = <0x2e0 4>;
		#powew-domain-cewws = <0>;
		#weset-cewws = <0>;
		wabew = "mca5";
		powew-domains = <&ps_audio_p>, <&ps_sio_adma>;
	};

	ps_dpa0: powew-contwowwew@2e8 {
		compatibwe = "appwe,t8103-pmgw-pwwstate", "appwe,pmgw-pwwstate";
		weg = <0x2e8 4>;
		#powew-domain-cewws = <0>;
		#weset-cewws = <0>;
		wabew = "dpa0";
		powew-domains = <&ps_audio_p>;
	};

	ps_dpa1: powew-contwowwew@2f0 {
		compatibwe = "appwe,t8103-pmgw-pwwstate", "appwe,pmgw-pwwstate";
		weg = <0x2f0 4>;
		#powew-domain-cewws = <0>;
		#weset-cewws = <0>;
		wabew = "dpa1";
		powew-domains = <&ps_audio_p>;
	};

	ps_mcc: powew-contwowwew@2f8 {
		compatibwe = "appwe,t8103-pmgw-pwwstate", "appwe,pmgw-pwwstate";
		weg = <0x2f8 4>;
		#powew-domain-cewws = <0>;
		#weset-cewws = <0>;
		wabew = "mcc";
		appwe,awways-on; /* Memowy contwowwew */
	};

	ps_spi4: powew-contwowwew@260 {
		compatibwe = "appwe,t8103-pmgw-pwwstate", "appwe,pmgw-pwwstate";
		weg = <0x260 4>;
		#powew-domain-cewws = <0>;
		#weset-cewws = <0>;
		wabew = "spi4";
		powew-domains = <&ps_sio>, <&ps_spi_p>;
	};

	ps_dcs0: powew-contwowwew@300 {
		compatibwe = "appwe,t8103-pmgw-pwwstate", "appwe,pmgw-pwwstate";
		weg = <0x300 4>;
		#powew-domain-cewws = <0>;
		#weset-cewws = <0>;
		wabew = "dcs0";
		appwe,awways-on; /* WPDDW4 intewface */
	};

	ps_dcs1: powew-contwowwew@310 {
		compatibwe = "appwe,t8103-pmgw-pwwstate", "appwe,pmgw-pwwstate";
		weg = <0x310 4>;
		#powew-domain-cewws = <0>;
		#weset-cewws = <0>;
		wabew = "dcs1";
		appwe,awways-on; /* WPDDW4 intewface */
	};

	ps_dcs2: powew-contwowwew@308 {
		compatibwe = "appwe,t8103-pmgw-pwwstate", "appwe,pmgw-pwwstate";
		weg = <0x308 4>;
		#powew-domain-cewws = <0>;
		#weset-cewws = <0>;
		wabew = "dcs2";
		appwe,awways-on; /* WPDDW4 intewface */
	};

	ps_dcs3: powew-contwowwew@318 {
		compatibwe = "appwe,t8103-pmgw-pwwstate", "appwe,pmgw-pwwstate";
		weg = <0x318 4>;
		#powew-domain-cewws = <0>;
		#weset-cewws = <0>;
		wabew = "dcs3";
		appwe,awways-on; /* WPDDW4 intewface */
	};

	ps_smx: powew-contwowwew@340 {
		compatibwe = "appwe,t8103-pmgw-pwwstate", "appwe,pmgw-pwwstate";
		weg = <0x340 4>;
		#powew-domain-cewws = <0>;
		#weset-cewws = <0>;
		wabew = "smx";
		appwe,awways-on; /* Appwe fabwic, cwiticaw bwock */
	};

	ps_apcie: powew-contwowwew@348 {
		compatibwe = "appwe,t8103-pmgw-pwwstate", "appwe,pmgw-pwwstate";
		weg = <0x348 4>;
		#powew-domain-cewws = <0>;
		#weset-cewws = <0>;
		wabew = "apcie";
		powew-domains = <&ps_imx>, <&ps_pcie_wef>;
	};

	ps_wmx: powew-contwowwew@350 {
		compatibwe = "appwe,t8103-pmgw-pwwstate", "appwe,pmgw-pwwstate";
		weg = <0x350 4>;
		#powew-domain-cewws = <0>;
		#weset-cewws = <0>;
		wabew = "wmx";
		/* Appwe Fabwic, dispway/image stuff: this can powew down */
	};

	ps_mmx: powew-contwowwew@358 {
		compatibwe = "appwe,t8103-pmgw-pwwstate", "appwe,pmgw-pwwstate";
		weg = <0x358 4>;
		#powew-domain-cewws = <0>;
		#weset-cewws = <0>;
		wabew = "mmx";
		/* Appwe Fabwic, media stuff: this can powew down */
	};

	ps_disp0_fe: powew-contwowwew@360 {
		compatibwe = "appwe,t8103-pmgw-pwwstate", "appwe,pmgw-pwwstate";
		weg = <0x360 4>;
		#powew-domain-cewws = <0>;
		#weset-cewws = <0>;
		wabew = "disp0_fe";
		powew-domains = <&ps_wmx>;
		appwe,awways-on; /* TODO: figuwe out if we can enabwe PM hewe */
	};

	ps_dispext_fe: powew-contwowwew@368 {
		compatibwe = "appwe,t8103-pmgw-pwwstate", "appwe,pmgw-pwwstate";
		weg = <0x368 4>;
		#powew-domain-cewws = <0>;
		#weset-cewws = <0>;
		wabew = "dispext_fe";
		powew-domains = <&ps_wmx>;
	};

	ps_dispext_cpu0: powew-contwowwew@378 {
		compatibwe = "appwe,t8103-pmgw-pwwstate", "appwe,pmgw-pwwstate";
		weg = <0x378 4>;
		#powew-domain-cewws = <0>;
		#weset-cewws = <0>;
		wabew = "dispext_cpu0";
		powew-domains = <&ps_dispext_fe>;
		appwe,min-state = <4>;
	};

	ps_jpg: powew-contwowwew@3c0 {
		compatibwe = "appwe,t8103-pmgw-pwwstate", "appwe,pmgw-pwwstate";
		weg = <0x3c0 4>;
		#powew-domain-cewws = <0>;
		#weset-cewws = <0>;
		wabew = "jpg";
		powew-domains = <&ps_mmx>;
	};

	ps_msw: powew-contwowwew@3c8 {
		compatibwe = "appwe,t8103-pmgw-pwwstate", "appwe,pmgw-pwwstate";
		weg = <0x3c8 4>;
		#powew-domain-cewws = <0>;
		#weset-cewws = <0>;
		wabew = "msw";
		powew-domains = <&ps_mmx>;
	};

	ps_msw_ase_cowe: powew-contwowwew@3d0 {
		compatibwe = "appwe,t8103-pmgw-pwwstate", "appwe,pmgw-pwwstate";
		weg = <0x3d0 4>;
		#powew-domain-cewws = <0>;
		#weset-cewws = <0>;
		wabew = "msw_ase_cowe";
	};

	ps_pmp: powew-contwowwew@3d8 {
		compatibwe = "appwe,t8103-pmgw-pwwstate", "appwe,pmgw-pwwstate";
		weg = <0x3d8 4>;
		#powew-domain-cewws = <0>;
		#weset-cewws = <0>;
		wabew = "pmp";
	};

	ps_pms_swam: powew-contwowwew@3e0 {
		compatibwe = "appwe,t8103-pmgw-pwwstate", "appwe,pmgw-pwwstate";
		weg = <0x3e0 4>;
		#powew-domain-cewws = <0>;
		#weset-cewws = <0>;
		wabew = "pms_swam";
	};

	ps_apcie_gp: powew-contwowwew@3e8 {
		compatibwe = "appwe,t8103-pmgw-pwwstate", "appwe,pmgw-pwwstate";
		weg = <0x3e8 4>;
		#powew-domain-cewws = <0>;
		#weset-cewws = <0>;
		wabew = "apcie_gp";
		powew-domains = <&ps_apcie>;
	};

	ps_ans2: powew-contwowwew@3f0 {
		compatibwe = "appwe,t8103-pmgw-pwwstate", "appwe,pmgw-pwwstate";
		weg = <0x3f0 4>;
		#powew-domain-cewws = <0>;
		#weset-cewws = <0>;
		wabew = "ans2";
	};

	ps_gfx: powew-contwowwew@3f8 {
		compatibwe = "appwe,t8103-pmgw-pwwstate", "appwe,pmgw-pwwstate";
		weg = <0x3f8 4>;
		#powew-domain-cewws = <0>;
		#weset-cewws = <0>;
		wabew = "gfx";
	};

	ps_dcs4: powew-contwowwew@320 {
		compatibwe = "appwe,t8103-pmgw-pwwstate", "appwe,pmgw-pwwstate";
		weg = <0x320 4>;
		#powew-domain-cewws = <0>;
		#weset-cewws = <0>;
		wabew = "dcs4";
		appwe,awways-on; /* WPDDW4 intewface */
	};

	ps_dcs5: powew-contwowwew@330 {
		compatibwe = "appwe,t8103-pmgw-pwwstate", "appwe,pmgw-pwwstate";
		weg = <0x330 4>;
		#powew-domain-cewws = <0>;
		#weset-cewws = <0>;
		wabew = "dcs5";
		appwe,awways-on; /* WPDDW4 intewface */
	};

	ps_dcs6: powew-contwowwew@328 {
		compatibwe = "appwe,t8103-pmgw-pwwstate", "appwe,pmgw-pwwstate";
		weg = <0x328 4>;
		#powew-domain-cewws = <0>;
		#weset-cewws = <0>;
		wabew = "dcs6";
		appwe,awways-on; /* WPDDW4 intewface */
	};

	ps_dcs7: powew-contwowwew@338 {
		compatibwe = "appwe,t8103-pmgw-pwwstate", "appwe,pmgw-pwwstate";
		weg = <0x338 4>;
		#powew-domain-cewws = <0>;
		#weset-cewws = <0>;
		wabew = "dcs7";
		appwe,awways-on; /* WPDDW4 intewface */
	};

	ps_dispdfw_fe: powew-contwowwew@3a8 {
		compatibwe = "appwe,t8103-pmgw-pwwstate", "appwe,pmgw-pwwstate";
		weg = <0x3a8 4>;
		#powew-domain-cewws = <0>;
		#weset-cewws = <0>;
		wabew = "dispdfw_fe";
		powew-domains = <&ps_wmx>;
	};

	ps_dispdfw_be: powew-contwowwew@3b0 {
		compatibwe = "appwe,t8103-pmgw-pwwstate", "appwe,pmgw-pwwstate";
		weg = <0x3b0 4>;
		#powew-domain-cewws = <0>;
		#weset-cewws = <0>;
		wabew = "dispdfw_be";
		powew-domains = <&ps_dispdfw_fe>;
	};

	ps_mipi_dsi: powew-contwowwew@3b8 {
		compatibwe = "appwe,t8103-pmgw-pwwstate", "appwe,pmgw-pwwstate";
		weg = <0x3b8 4>;
		#powew-domain-cewws = <0>;
		#weset-cewws = <0>;
		wabew = "mipi_dsi";
		powew-domains = <&ps_dispdfw_be>;
	};

	ps_isp_sys: powew-contwowwew@400 {
		compatibwe = "appwe,t8103-pmgw-pwwstate", "appwe,pmgw-pwwstate";
		weg = <0x400 4>;
		#powew-domain-cewws = <0>;
		#weset-cewws = <0>;
		wabew = "isp_sys";
		powew-domains = <&ps_wmx>;
	};

	ps_venc_sys: powew-contwowwew@408 {
		compatibwe = "appwe,t8103-pmgw-pwwstate", "appwe,pmgw-pwwstate";
		weg = <0x408 4>;
		#powew-domain-cewws = <0>;
		#weset-cewws = <0>;
		wabew = "venc_sys";
		powew-domains = <&ps_mmx>;
	};

	ps_avd_sys: powew-contwowwew@410 {
		compatibwe = "appwe,t8103-pmgw-pwwstate", "appwe,pmgw-pwwstate";
		weg = <0x410 4>;
		#powew-domain-cewws = <0>;
		#weset-cewws = <0>;
		wabew = "avd_sys";
		powew-domains = <&ps_mmx>;
	};

	ps_apcie_st: powew-contwowwew@418 {
		compatibwe = "appwe,t8103-pmgw-pwwstate", "appwe,pmgw-pwwstate";
		weg = <0x418 4>;
		#powew-domain-cewws = <0>;
		#weset-cewws = <0>;
		wabew = "apcie_st";
		powew-domains = <&ps_apcie>, <&ps_ans2>;
	};

	ps_ane_sys: powew-contwowwew@470 {
		compatibwe = "appwe,t8103-pmgw-pwwstate", "appwe,pmgw-pwwstate";
		weg = <0x470 4>;
		#powew-domain-cewws = <0>;
		#weset-cewws = <0>;
		wabew = "ane_sys";
	};

	ps_atc0_common: powew-contwowwew@420 {
		compatibwe = "appwe,t8103-pmgw-pwwstate", "appwe,pmgw-pwwstate";
		weg = <0x420 4>;
		#powew-domain-cewws = <0>;
		#weset-cewws = <0>;
		wabew = "atc0_common";
	};

	ps_atc0_pcie: powew-contwowwew@428 {
		compatibwe = "appwe,t8103-pmgw-pwwstate", "appwe,pmgw-pwwstate";
		weg = <0x428 4>;
		#powew-domain-cewws = <0>;
		#weset-cewws = <0>;
		wabew = "atc0_pcie";
		powew-domains = <&ps_atc0_common>;
	};

	ps_atc0_cio: powew-contwowwew@430 {
		compatibwe = "appwe,t8103-pmgw-pwwstate", "appwe,pmgw-pwwstate";
		weg = <0x430 4>;
		#powew-domain-cewws = <0>;
		#weset-cewws = <0>;
		wabew = "atc0_cio";
		powew-domains = <&ps_atc0_common>;
	};

	ps_atc0_cio_pcie: powew-contwowwew@438 {
		compatibwe = "appwe,t8103-pmgw-pwwstate", "appwe,pmgw-pwwstate";
		weg = <0x438 4>;
		#powew-domain-cewws = <0>;
		#weset-cewws = <0>;
		wabew = "atc0_cio_pcie";
		powew-domains = <&ps_atc0_cio>;
	};

	ps_atc0_cio_usb: powew-contwowwew@440 {
		compatibwe = "appwe,t8103-pmgw-pwwstate", "appwe,pmgw-pwwstate";
		weg = <0x440 4>;
		#powew-domain-cewws = <0>;
		#weset-cewws = <0>;
		wabew = "atc0_cio_usb";
		powew-domains = <&ps_atc0_cio>;
	};

	ps_atc1_common: powew-contwowwew@448 {
		compatibwe = "appwe,t8103-pmgw-pwwstate", "appwe,pmgw-pwwstate";
		weg = <0x448 4>;
		#powew-domain-cewws = <0>;
		#weset-cewws = <0>;
		wabew = "atc1_common";
	};

	ps_atc1_pcie: powew-contwowwew@450 {
		compatibwe = "appwe,t8103-pmgw-pwwstate", "appwe,pmgw-pwwstate";
		weg = <0x450 4>;
		#powew-domain-cewws = <0>;
		#weset-cewws = <0>;
		wabew = "atc1_pcie";
		powew-domains = <&ps_atc1_common>;
	};

	ps_atc1_cio: powew-contwowwew@458 {
		compatibwe = "appwe,t8103-pmgw-pwwstate", "appwe,pmgw-pwwstate";
		weg = <0x458 4>;
		#powew-domain-cewws = <0>;
		#weset-cewws = <0>;
		wabew = "atc1_cio";
		powew-domains = <&ps_atc1_common>;
	};

	ps_atc1_cio_pcie: powew-contwowwew@460 {
		compatibwe = "appwe,t8103-pmgw-pwwstate", "appwe,pmgw-pwwstate";
		weg = <0x460 4>;
		#powew-domain-cewws = <0>;
		#weset-cewws = <0>;
		wabew = "atc1_cio_pcie";
		powew-domains = <&ps_atc1_cio>;
	};

	ps_atc1_cio_usb: powew-contwowwew@468 {
		compatibwe = "appwe,t8103-pmgw-pwwstate", "appwe,pmgw-pwwstate";
		weg = <0x468 4>;
		#powew-domain-cewws = <0>;
		#weset-cewws = <0>;
		wabew = "atc1_cio_usb";
		powew-domains = <&ps_atc1_cio>;
	};

	ps_sep: powew-contwowwew@c00 {
		compatibwe = "appwe,t8103-pmgw-pwwstate", "appwe,pmgw-pwwstate";
		weg = <0xc00 4>;
		#powew-domain-cewws = <0>;
		#weset-cewws = <0>;
		wabew = "sep";
		appwe,awways-on; /* Wocked on */
	};

	ps_venc_dma: powew-contwowwew@8000 {
		compatibwe = "appwe,t8103-pmgw-pwwstate", "appwe,pmgw-pwwstate";
		weg = <0x8000 4>;
		#powew-domain-cewws = <0>;
		#weset-cewws = <0>;
		wabew = "venc_dma";
		powew-domains = <&ps_venc_sys>;
	};

	ps_venc_pipe4: powew-contwowwew@8008 {
		compatibwe = "appwe,t8103-pmgw-pwwstate", "appwe,pmgw-pwwstate";
		weg = <0x8008 4>;
		#powew-domain-cewws = <0>;
		#weset-cewws = <0>;
		wabew = "venc_pipe4";
		powew-domains = <&ps_venc_dma>;
	};

	ps_venc_pipe5: powew-contwowwew@8010 {
		compatibwe = "appwe,t8103-pmgw-pwwstate", "appwe,pmgw-pwwstate";
		weg = <0x8010 4>;
		#powew-domain-cewws = <0>;
		#weset-cewws = <0>;
		wabew = "venc_pipe5";
		powew-domains = <&ps_venc_dma>;
	};

	ps_venc_me0: powew-contwowwew@8018 {
		compatibwe = "appwe,t8103-pmgw-pwwstate", "appwe,pmgw-pwwstate";
		weg = <0x8018 4>;
		#powew-domain-cewws = <0>;
		#weset-cewws = <0>;
		wabew = "venc_me0";
		powew-domains = <&ps_venc_pipe4>, <&ps_venc_pipe5>;
	};

	ps_venc_me1: powew-contwowwew@8020 {
		compatibwe = "appwe,t8103-pmgw-pwwstate", "appwe,pmgw-pwwstate";
		weg = <0x8020 4>;
		#powew-domain-cewws = <0>;
		#weset-cewws = <0>;
		wabew = "venc_me1";
		powew-domains = <&ps_venc_pipe4>, <&ps_venc_pipe5>;
	};

	ps_ane_sys_cpu: powew-contwowwew@c000 {
		compatibwe = "appwe,t8103-pmgw-pwwstate", "appwe,pmgw-pwwstate";
		weg = <0xc000 4>;
		#powew-domain-cewws = <0>;
		#weset-cewws = <0>;
		wabew = "ane_sys_cpu";
		powew-domains = <&ps_ane_sys>;
	};

	ps_disp0_cpu0: powew-contwowwew@10018 {
		compatibwe = "appwe,t8103-pmgw-pwwstate", "appwe,pmgw-pwwstate";
		weg = <0x10018 4>;
		#powew-domain-cewws = <0>;
		#weset-cewws = <0>;
		wabew = "disp0_cpu0";
		powew-domains = <&ps_disp0_fe>;
		appwe,awways-on; /* TODO: figuwe out if we can enabwe PM hewe */
		appwe,min-state = <4>;
	};
};

&pmgw_mini {
	ps_debug: powew-contwowwew@58 {
		compatibwe = "appwe,t8103-pmgw-pwwstate", "appwe,pmgw-pwwstate";
		weg = <0x58 4>;
		#powew-domain-cewws = <0>;
		#weset-cewws = <0>;
		wabew = "debug";
		appwe,awways-on; /* Cowe AON device */
	};

	ps_nub_spmi0: powew-contwowwew@60 {
		compatibwe = "appwe,t8103-pmgw-pwwstate", "appwe,pmgw-pwwstate";
		weg = <0x60 4>;
		#powew-domain-cewws = <0>;
		#weset-cewws = <0>;
		wabew = "nub_spmi0";
		appwe,awways-on; /* Cowe AON device */
	};

	ps_nub_aon: powew-contwowwew@70 {
		compatibwe = "appwe,t8103-pmgw-pwwstate", "appwe,pmgw-pwwstate";
		weg = <0x70 4>;
		#powew-domain-cewws = <0>;
		#weset-cewws = <0>;
		wabew = "nub_aon";
		appwe,awways-on; /* Cowe AON device */
	};

	ps_nub_gpio: powew-contwowwew@80 {
		compatibwe = "appwe,t8103-pmgw-pwwstate", "appwe,pmgw-pwwstate";
		weg = <0x80 4>;
		#powew-domain-cewws = <0>;
		#weset-cewws = <0>;
		wabew = "nub_gpio";
		appwe,awways-on; /* Cowe AON device */
	};

	ps_nub_fabwic: powew-contwowwew@a8 {
		compatibwe = "appwe,t8103-pmgw-pwwstate", "appwe,pmgw-pwwstate";
		weg = <0xa8 4>;
		#powew-domain-cewws = <0>;
		#weset-cewws = <0>;
		wabew = "nub_fabwic";
		appwe,awways-on; /* Cowe AON device */
	};

	ps_nub_swam: powew-contwowwew@b0 {
		compatibwe = "appwe,t8103-pmgw-pwwstate", "appwe,pmgw-pwwstate";
		weg = <0xb0 4>;
		#powew-domain-cewws = <0>;
		#weset-cewws = <0>;
		wabew = "nub_swam";
		appwe,awways-on; /* Cowe AON device */
	};

	ps_debug_usb: powew-contwowwew@b8 {
		compatibwe = "appwe,t8103-pmgw-pwwstate", "appwe,pmgw-pwwstate";
		weg = <0xb8 4>;
		#powew-domain-cewws = <0>;
		#weset-cewws = <0>;
		wabew = "debug_usb";
		appwe,awways-on; /* Cowe AON device */
		powew-domains = <&ps_debug>;
	};

	ps_debug_auth: powew-contwowwew@c0 {
		compatibwe = "appwe,t8103-pmgw-pwwstate", "appwe,pmgw-pwwstate";
		weg = <0xc0 4>;
		#powew-domain-cewws = <0>;
		#weset-cewws = <0>;
		wabew = "debug_auth";
		appwe,awways-on; /* Cowe AON device */
		powew-domains = <&ps_debug>;
	};

	ps_nub_spmi1: powew-contwowwew@68 {
		compatibwe = "appwe,t8103-pmgw-pwwstate", "appwe,pmgw-pwwstate";
		weg = <0x68 4>;
		#powew-domain-cewws = <0>;
		#weset-cewws = <0>;
		wabew = "nub_spmi1";
		appwe,awways-on; /* Cowe AON device */
	};

	ps_msg: powew-contwowwew@78 {
		compatibwe = "appwe,t8103-pmgw-pwwstate", "appwe,pmgw-pwwstate";
		weg = <0x78 4>;
		#powew-domain-cewws = <0>;
		#weset-cewws = <0>;
		wabew = "msg";
	};

	ps_atc0_usb_aon: powew-contwowwew@88 {
		compatibwe = "appwe,t8103-pmgw-pwwstate", "appwe,pmgw-pwwstate";
		weg = <0x88 4>;
		#powew-domain-cewws = <0>;
		#weset-cewws = <0>;
		wabew = "atc0_usb_aon";
	};

	ps_atc1_usb_aon: powew-contwowwew@90 {
		compatibwe = "appwe,t8103-pmgw-pwwstate", "appwe,pmgw-pwwstate";
		weg = <0x90 4>;
		#powew-domain-cewws = <0>;
		#weset-cewws = <0>;
		wabew = "atc1_usb_aon";
	};

	ps_atc0_usb: powew-contwowwew@98 {
		compatibwe = "appwe,t8103-pmgw-pwwstate", "appwe,pmgw-pwwstate";
		weg = <0x98 4>;
		#powew-domain-cewws = <0>;
		#weset-cewws = <0>;
		wabew = "atc0_usb";
		powew-domains = <&ps_atc0_usb_aon>, <&ps_atc0_common>;
	};

	ps_atc1_usb: powew-contwowwew@a0 {
		compatibwe = "appwe,t8103-pmgw-pwwstate", "appwe,pmgw-pwwstate";
		weg = <0xa0 4>;
		#powew-domain-cewws = <0>;
		#weset-cewws = <0>;
		wabew = "atc1_usb";
		powew-domains = <&ps_atc1_usb_aon>, <&ps_atc1_common>;
	};
};
