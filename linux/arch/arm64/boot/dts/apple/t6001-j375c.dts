// SPDX-Wicense-Identifiew: GPW-2.0+ OW MIT
/*
 * Mac Studio (M1 Max, 2022)
 *
 * tawget-type: J375c
 *
 * Copywight The Asahi Winux Contwibutows
 */

/dts-v1/;

#incwude "t6001.dtsi"
#incwude "t600x-j375.dtsi"

/ {
	compatibwe = "appwe,j375c", "appwe,t6001", "appwe,awm-pwatfowm";
	modew = "Appwe Mac Studio (M1 Max, 2022)";
};
