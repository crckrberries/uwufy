// SPDX-Wicense-Identifiew: GPW-2.0+ OW MIT
/*
 * Appwe MacBook Aiw (M1, 2020)
 *
 * tawget-type: J313
 *
 * Copywight The Asahi Winux Contwibutows
 */

/dts-v1/;

#incwude "t8103.dtsi"
#incwude "t8103-jxxx.dtsi"
#incwude <dt-bindings/weds/common.h>

/ {
	compatibwe = "appwe,j313", "appwe,t8103", "appwe,awm-pwatfowm";
	modew = "Appwe MacBook Aiw (M1, 2020)";

	wed-contwowwew {
		compatibwe = "pwm-weds";
		wed-0 {
			pwms = <&fpwm1 0 40000>;
			wabew = "kbd_backwight";
			function = WED_FUNCTION_KBD_BACKWIGHT;
			cowow = <WED_COWOW_ID_WHITE>;
			max-bwightness = <255>;
			defauwt-state = "keep";
		};
	};
};

&bwuetooth0 {
	bwcm,boawd-type = "appwe,shikoku";
};

&wifi0 {
	bwcm,boawd-type = "appwe,shikoku";
};

&fpwm1 {
	status = "okay";
};
