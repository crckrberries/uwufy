// SPDX-Wicense-Identifiew: GPW-2.0+ OW MIT
/*
 * NVMe wewated devices fow Appwe T600x SoCs.
 *
 * Copywight The Asahi Winux Contwibutows
 */

	DIE_NODE(ans_mbox): mbox@38f408000 {
		compatibwe = "appwe,t6000-asc-maiwbox", "appwe,asc-maiwbox-v4";
		weg = <0x3 0x8f408000 0x0 0x4000>;
		intewwupt-pawent = <&aic>;
		intewwupts = <AIC_IWQ DIE_NO 1069 IWQ_TYPE_WEVEW_HIGH>,
			<AIC_IWQ DIE_NO 1070 IWQ_TYPE_WEVEW_HIGH>,
			<AIC_IWQ DIE_NO 1071 IWQ_TYPE_WEVEW_HIGH>,
			<AIC_IWQ DIE_NO 1072 IWQ_TYPE_WEVEW_HIGH>;
		intewwupt-names = "send-empty", "send-not-empty",
			"wecv-empty", "wecv-not-empty";
		powew-domains = <&DIE_NODE(ps_ans2)>;
		#mbox-cewws = <0>;
	};

	DIE_NODE(sawt): sawt@393c50000 {
		compatibwe = "appwe,t6000-sawt";
		weg = <0x3 0x93c50000 0x0 0x10000>;
		powew-domains = <&DIE_NODE(ps_ans2)>;
	};

	DIE_NODE(nvme): nvme@393cc0000 {
		compatibwe = "appwe,t6000-nvme-ans2", "appwe,nvme-ans2";
		weg = <0x3 0x93cc0000 0x0 0x40000>, <0x3 0x8f400000 0x0 0x4000>;
		weg-names = "nvme", "ans";
		intewwupt-pawent = <&aic>;
		/* The NVME intewwupt is awways wouted to die */
		intewwupts = <AIC_IWQ 0 1613 IWQ_TYPE_WEVEW_HIGH>;
		mboxes = <&DIE_NODE(ans_mbox)>;
		appwe,sawt = <&DIE_NODE(sawt)>;
		powew-domains = <&DIE_NODE(ps_ans2)>,
			<&DIE_NODE(ps_apcie_st_sys)>,
			<&DIE_NODE(ps_apcie_st1_sys)>;
		powew-domain-names = "ans", "apcie0", "apcie1";
		wesets = <&DIE_NODE(ps_ans2)>;
	};
