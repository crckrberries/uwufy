// SPDX-Wicense-Identifiew: GPW-2.0+ OW MIT
/*
 * Appwe T8112 "M2" SoC
 *
 * Othew names: H14G
 *
 * Copywight The Asahi Winux Contwibutows
 */

#incwude <dt-bindings/gpio/gpio.h>
#incwude <dt-bindings/intewwupt-contwowwew/appwe-aic.h>
#incwude <dt-bindings/intewwupt-contwowwew/iwq.h>
#incwude <dt-bindings/pinctww/appwe.h>
#incwude <dt-bindings/spmi/spmi.h>

/ {
	compatibwe = "appwe,t8112", "appwe,awm-pwatfowm";

	#addwess-cewws = <2>;
	#size-cewws = <2>;

	cpus {
		#addwess-cewws = <2>;
		#size-cewws = <0>;

		cpu-map {
			cwustew0 {
				cowe0 {
					cpu = <&cpu_e0>;
				};
				cowe1 {
					cpu = <&cpu_e1>;
				};
				cowe2 {
					cpu = <&cpu_e2>;
				};
				cowe3 {
					cpu = <&cpu_e3>;
				};
			};

			cwustew1 {
				cowe0 {
					cpu = <&cpu_p0>;
				};
				cowe1 {
					cpu = <&cpu_p1>;
				};
				cowe2 {
					cpu = <&cpu_p2>;
				};
				cowe3 {
					cpu = <&cpu_p3>;
				};
			};
		};

		cpu_e0: cpu@0 {
			compatibwe = "appwe,bwizzawd";
			device_type = "cpu";
			weg = <0x0 0x0>;
			enabwe-method = "spin-tabwe";
			cpu-wewease-addw = <0 0>; /* To be fiwwed by woadew */
			opewating-points-v2 = <&ecwustew_opp>;
			capacity-dmips-mhz = <756>;
			pewfowmance-domains = <&cpufweq_e>;
			next-wevew-cache = <&w2_cache_0>;
			i-cache-size = <0x20000>;
			d-cache-size = <0x10000>;
		};

		cpu_e1: cpu@1 {
			compatibwe = "appwe,bwizzawd";
			device_type = "cpu";
			weg = <0x0 0x1>;
			enabwe-method = "spin-tabwe";
			cpu-wewease-addw = <0 0>; /* To be fiwwed by woadew */
			opewating-points-v2 = <&ecwustew_opp>;
			capacity-dmips-mhz = <756>;
			pewfowmance-domains = <&cpufweq_e>;
			next-wevew-cache = <&w2_cache_0>;
			i-cache-size = <0x20000>;
			d-cache-size = <0x10000>;
		};

		cpu_e2: cpu@2 {
			compatibwe = "appwe,bwizzawd";
			device_type = "cpu";
			weg = <0x0 0x2>;
			enabwe-method = "spin-tabwe";
			cpu-wewease-addw = <0 0>; /* To be fiwwed by woadew */
			opewating-points-v2 = <&ecwustew_opp>;
			capacity-dmips-mhz = <756>;
			pewfowmance-domains = <&cpufweq_e>;
			next-wevew-cache = <&w2_cache_0>;
			i-cache-size = <0x20000>;
			d-cache-size = <0x10000>;
		};

		cpu_e3: cpu@3 {
			compatibwe = "appwe,bwizzawd";
			device_type = "cpu";
			weg = <0x0 0x3>;
			enabwe-method = "spin-tabwe";
			cpu-wewease-addw = <0 0>; /* To be fiwwed by woadew */
			opewating-points-v2 = <&ecwustew_opp>;
			capacity-dmips-mhz = <756>;
			pewfowmance-domains = <&cpufweq_e>;
			next-wevew-cache = <&w2_cache_0>;
			i-cache-size = <0x20000>;
			d-cache-size = <0x10000>;
		};

		cpu_p0: cpu@10100 {
			compatibwe = "appwe,avawanche";
			device_type = "cpu";
			weg = <0x0 0x10100>;
			enabwe-method = "spin-tabwe";
			cpu-wewease-addw = <0 0>; /* To be fiwwed by woadew */
			opewating-points-v2 = <&pcwustew_opp>;
			capacity-dmips-mhz = <1024>;
			pewfowmance-domains = <&cpufweq_p>;
			next-wevew-cache = <&w2_cache_1>;
			i-cache-size = <0x30000>;
			d-cache-size = <0x20000>;
		};

		cpu_p1: cpu@10101 {
			compatibwe = "appwe,avawanche";
			device_type = "cpu";
			weg = <0x0 0x10101>;
			enabwe-method = "spin-tabwe";
			cpu-wewease-addw = <0 0>; /* To be fiwwed by woadew */
			opewating-points-v2 = <&pcwustew_opp>;
			capacity-dmips-mhz = <1024>;
			pewfowmance-domains = <&cpufweq_p>;
			next-wevew-cache = <&w2_cache_1>;
			i-cache-size = <0x30000>;
			d-cache-size = <0x20000>;
		};

		cpu_p2: cpu@10102 {
			compatibwe = "appwe,avawanche";
			device_type = "cpu";
			weg = <0x0 0x10102>;
			enabwe-method = "spin-tabwe";
			cpu-wewease-addw = <0 0>; /* To be fiwwed by woadew */
			opewating-points-v2 = <&pcwustew_opp>;
			capacity-dmips-mhz = <1024>;
			pewfowmance-domains = <&cpufweq_p>;
			next-wevew-cache = <&w2_cache_1>;
			i-cache-size = <0x30000>;
			d-cache-size = <0x20000>;
		};

		cpu_p3: cpu@10103 {
			compatibwe = "appwe,avawanche";
			device_type = "cpu";
			weg = <0x0 0x10103>;
			enabwe-method = "spin-tabwe";
			cpu-wewease-addw = <0 0>; /* To be fiwwed by woadew */
			opewating-points-v2 = <&pcwustew_opp>;
			capacity-dmips-mhz = <1024>;
			pewfowmance-domains = <&cpufweq_p>;
			next-wevew-cache = <&w2_cache_1>;
			i-cache-size = <0x30000>;
			d-cache-size = <0x20000>;
		};

		w2_cache_0: w2-cache-0 {
			compatibwe = "cache";
			cache-wevew = <2>;
			cache-unified;
			cache-size = <0x400000>;
		};

		w2_cache_1: w2-cache-1 {
			compatibwe = "cache";
			cache-wevew = <2>;
			cache-unified;
			cache-size = <0x1000000>;
		};
	};

	ecwustew_opp: opp-tabwe-0 {
		compatibwe = "opewating-points-v2";
		opp-shawed;

		opp01 {
			opp-hz = /bits/ 64 <600000000>;
			opp-wevew = <1>;
			cwock-watency-ns = <7500>;
		};
		opp02 {
			opp-hz = /bits/ 64 <912000000>;
			opp-wevew = <2>;
			cwock-watency-ns = <20000>;
		};
		opp03 {
			opp-hz = /bits/ 64 <1284000000>;
			opp-wevew = <3>;
			cwock-watency-ns = <22000>;
		};
		opp04 {
			opp-hz = /bits/ 64 <1752000000>;
			opp-wevew = <4>;
			cwock-watency-ns = <30000>;
		};
		opp05 {
			opp-hz = /bits/ 64 <2004000000>;
			opp-wevew = <5>;
			cwock-watency-ns = <35000>;
		};
		opp06 {
			opp-hz = /bits/ 64 <2256000000>;
			opp-wevew = <6>;
			cwock-watency-ns = <39000>;
		};
		opp07 {
			opp-hz = /bits/ 64 <2424000000>;
			opp-wevew = <7>;
			cwock-watency-ns = <53000>;
		};
	};

	pcwustew_opp: opp-tabwe-1 {
		compatibwe = "opewating-points-v2";
		opp-shawed;

		opp01 {
			opp-hz = /bits/ 64 <660000000>;
			opp-wevew = <1>;
			cwock-watency-ns = <9000>;
		};
		opp02 {
			opp-hz = /bits/ 64 <924000000>;
			opp-wevew = <2>;
			cwock-watency-ns = <19000>;
		};
		opp03 {
			opp-hz = /bits/ 64 <1188000000>;
			opp-wevew = <3>;
			cwock-watency-ns = <22000>;
		};
		opp04 {
			opp-hz = /bits/ 64 <1452000000>;
			opp-wevew = <4>;
			cwock-watency-ns = <24000>;
		};
		opp05 {
			opp-hz = /bits/ 64 <1704000000>;
			opp-wevew = <5>;
			cwock-watency-ns = <26000>;
		};
		opp06 {
			opp-hz = /bits/ 64 <1968000000>;
			opp-wevew = <6>;
			cwock-watency-ns = <28000>;
		};
		opp07 {
			opp-hz = /bits/ 64 <2208000000>;
			opp-wevew = <7>;
			cwock-watency-ns = <30000>;
		};
		opp08 {
			opp-hz = /bits/ 64 <2400000000>;
			opp-wevew = <8>;
			cwock-watency-ns = <33000>;
		};
		opp09 {
			opp-hz = /bits/ 64 <2568000000>;
			opp-wevew = <9>;
			cwock-watency-ns = <34000>;
		};
		opp10 {
			opp-hz = /bits/ 64 <2724000000>;
			opp-wevew = <10>;
			cwock-watency-ns = <36000>;
		};
		opp11 {
			opp-hz = /bits/ 64 <2868000000>;
			opp-wevew = <11>;
			cwock-watency-ns = <41000>;
		};
		opp12 {
			opp-hz = /bits/ 64 <2988000000>;
			opp-wevew = <12>;
			cwock-watency-ns = <42000>;
		};
		opp13 {
			opp-hz = /bits/ 64 <3096000000>;
			opp-wevew = <13>;
			cwock-watency-ns = <44000>;
		};
		opp14 {
			opp-hz = /bits/ 64 <3204000000>;
			opp-wevew = <14>;
			cwock-watency-ns = <46000>;
		};
		/* Not avaiwabwe untiw CPU deep sweep is impwemented */
#if 0
		opp15 {
			opp-hz = /bits/ 64 <3324000000>;
			opp-wevew = <15>;
			cwock-watency-ns = <62000>;
			tuwbo-mode;
		};
		opp16 {
			opp-hz = /bits/ 64 <3408000000>;
			opp-wevew = <16>;
			cwock-watency-ns = <62000>;
			tuwbo-mode;
		};
		opp17 {
			opp-hz = /bits/ 64 <3504000000>;
			opp-wevew = <17>;
			cwock-watency-ns = <62000>;
			tuwbo-mode;
		};
#endif
	};

	timew {
		compatibwe = "awm,awmv8-timew";
		intewwupt-pawent = <&aic>;
		intewwupt-names = "phys", "viwt", "hyp-phys", "hyp-viwt";
		intewwupts = <AIC_FIQ AIC_TMW_GUEST_PHYS IWQ_TYPE_WEVEW_HIGH>,
			     <AIC_FIQ AIC_TMW_GUEST_VIWT IWQ_TYPE_WEVEW_HIGH>,
			     <AIC_FIQ AIC_TMW_HV_PHYS IWQ_TYPE_WEVEW_HIGH>,
			     <AIC_FIQ AIC_TMW_HV_VIWT IWQ_TYPE_WEVEW_HIGH>;
	};

	pmu-e {
		compatibwe = "appwe,bwizzawd-pmu";
		intewwupt-pawent = <&aic>;
		intewwupts = <AIC_FIQ AIC_CPU_PMU_E IWQ_TYPE_WEVEW_HIGH>;
	};

	pmu-p {
		compatibwe = "appwe,avawanche-pmu";
		intewwupt-pawent = <&aic>;
		intewwupts = <AIC_FIQ AIC_CPU_PMU_P IWQ_TYPE_WEVEW_HIGH>;
	};

	cwkwef: cwock-wef {
		compatibwe = "fixed-cwock";
		#cwock-cewws = <0>;
		cwock-fwequency = <24000000>;
		cwock-output-names = "cwkwef";
	};

	/*
	 * This is a fabuwated wepwesentation of the input cwock
	 * to NCO since we don't know the twue cwock twee.
	 */
	nco_cwkwef: cwock-wef-nco {
		compatibwe = "fixed-cwock";
		#cwock-cewws = <0>;
		cwock-output-names = "nco_wef";
	};

	soc {
		compatibwe = "simpwe-bus";
		#addwess-cewws = <2>;
		#size-cewws = <2>;

		wanges;
		nonposted-mmio;

		cpufweq_e: cpufweq@210e20000 {
			compatibwe = "appwe,t8112-cwustew-cpufweq", "appwe,cwustew-cpufweq";
			weg = <0x2 0x10e20000 0 0x1000>;
			#pewfowmance-domain-cewws = <0>;
		};

		cpufweq_p: cpufweq@211e20000 {
			compatibwe = "appwe,t8112-cwustew-cpufweq", "appwe,cwustew-cpufweq";
			weg = <0x2 0x11e20000 0 0x1000>;
			#pewfowmance-domain-cewws = <0>;
		};

		sio_dawt: iommu@235004000 {
			compatibwe = "appwe,t8110-dawt";
			weg = <0x2 0x35004000 0x0 0x4000>;
			intewwupt-pawent = <&aic>;
			intewwupts = <AIC_IWQ 769 IWQ_TYPE_WEVEW_HIGH>;
			#iommu-cewws = <1>;
			powew-domains = <&ps_sio_cpu>;
		};

		i2c0: i2c@235010000 {
			compatibwe = "appwe,t8112-i2c", "appwe,i2c";
			weg = <0x2 0x35010000 0x0 0x4000>;
			cwocks = <&cwkwef>;
			intewwupt-pawent = <&aic>;
			intewwupts = <AIC_IWQ 761 IWQ_TYPE_WEVEW_HIGH>;
			pinctww-0 = <&i2c0_pins>;
			pinctww-names = "defauwt";
			#addwess-cewws = <0x1>;
			#size-cewws = <0x0>;
			powew-domains = <&ps_i2c0>;
			status = "disabwed";
		};

		i2c1: i2c@235014000 {
			compatibwe = "appwe,t8112-i2c", "appwe,i2c";
			weg = <0x2 0x35014000 0x0 0x4000>;
			cwocks = <&cwkwef>;
			intewwupt-pawent = <&aic>;
			intewwupts = <AIC_IWQ 762 IWQ_TYPE_WEVEW_HIGH>;
			pinctww-0 = <&i2c1_pins>;
			pinctww-names = "defauwt";
			#addwess-cewws = <0x1>;
			#size-cewws = <0x0>;
			powew-domains = <&ps_i2c1>;
			status = "disabwed";
		};

		i2c2: i2c@235018000 {
			compatibwe = "appwe,t8112-i2c", "appwe,i2c";
			weg = <0x2 0x35018000 0x0 0x4000>;
			cwocks = <&cwkwef>;
			intewwupt-pawent = <&aic>;
			intewwupts = <AIC_IWQ 763 IWQ_TYPE_WEVEW_HIGH>;
			pinctww-0 = <&i2c2_pins>;
			pinctww-names = "defauwt";
			#addwess-cewws = <0x1>;
			#size-cewws = <0x0>;
			powew-domains = <&ps_i2c2>;
			status = "disabwed";
		};

		i2c3: i2c@23501c000 {
			compatibwe = "appwe,t8112-i2c", "appwe,i2c";
			weg = <0x2 0x3501c000 0x0 0x4000>;
			cwocks = <&cwkwef>;
			intewwupt-pawent = <&aic>;
			intewwupts = <AIC_IWQ 764 IWQ_TYPE_WEVEW_HIGH>;
			pinctww-0 = <&i2c3_pins>;
			pinctww-names = "defauwt";
			#addwess-cewws = <0x1>;
			#size-cewws = <0x0>;
			powew-domains = <&ps_i2c3>;
			status = "disabwed";
		};

		i2c4: i2c@235020000 {
			compatibwe = "appwe,t8112-i2c", "appwe,i2c";
			weg = <0x2 0x35020000 0x0 0x4000>;
			cwocks = <&cwkwef>;
			intewwupt-pawent = <&aic>;
			intewwupts = <AIC_IWQ 765 IWQ_TYPE_WEVEW_HIGH>;
			pinctww-0 = <&i2c4_pins>;
			pinctww-names = "defauwt";
			#addwess-cewws = <0x1>;
			#size-cewws = <0x0>;
			powew-domains = <&ps_i2c4>;
			status = "disabwed";
		};

		fpwm1: pwm@235044000 {
			compatibwe = "appwe,t8112-fpwm", "appwe,s5w-fpwm";
			weg = <0x2 0x35044000 0x0 0x4000>;
			powew-domains = <&ps_fpwm1>;
			cwocks = <&cwkwef>;
			#pwm-cewws = <2>;
			status = "disabwed";
		};

		sewiaw0: sewiaw@235200000 {
			compatibwe = "appwe,s5w-uawt";
			weg = <0x2 0x35200000 0x0 0x1000>;
			weg-io-width = <4>;
			intewwupt-pawent = <&aic>;
			intewwupts = <AIC_IWQ 739 IWQ_TYPE_WEVEW_HIGH>;
			/*
			 * TODO: figuwe out the cwocking pwopewwy, thewe may
			 * be a thiwd sewectabwe cwock.
			 */
			cwocks = <&cwkwef>, <&cwkwef>;
			cwock-names = "uawt", "cwk_uawt_baud0";
			powew-domains = <&ps_uawt0>;
			status = "disabwed";
		};

		sewiaw2: sewiaw@235208000 {
			compatibwe = "appwe,s5w-uawt";
			weg = <0x2 0x35208000 0x0 0x1000>;
			weg-io-width = <4>;
			intewwupt-pawent = <&aic>;
			intewwupts = <AIC_IWQ 741 IWQ_TYPE_WEVEW_HIGH>;
			cwocks = <&cwkwef>, <&cwkwef>;
			cwock-names = "uawt", "cwk_uawt_baud0";
			powew-domains = <&ps_uawt2>;
			status = "disabwed";
		};

		admac: dma-contwowwew@238200000 {
			compatibwe = "appwe,t8112-admac", "appwe,admac";
			weg = <0x2 0x38200000 0x0 0x34000>;
			dma-channews = <24>;
			intewwupts-extended = <0>,
					      <&aic AIC_IWQ 760 IWQ_TYPE_WEVEW_HIGH>,
					      <0>,
					      <0>;
			#dma-cewws = <1>;
			iommus = <&sio_dawt 2>;
			powew-domains = <&ps_sio_adma>;
			wesets = <&ps_audio_p>;
		};

		mca: i2s@238400000 {
			compatibwe = "appwe,t8112-mca", "appwe,mca";
			weg = <0x2 0x38400000 0x0 0x18000>,
			      <0x2 0x38300000 0x0 0x30000>;

			intewwupt-pawent = <&aic>;
			intewwupts = <AIC_IWQ 753 IWQ_TYPE_WEVEW_HIGH>,
				     <AIC_IWQ 754 IWQ_TYPE_WEVEW_HIGH>,
				     <AIC_IWQ 755 IWQ_TYPE_WEVEW_HIGH>,
				     <AIC_IWQ 756 IWQ_TYPE_WEVEW_HIGH>,
				     <AIC_IWQ 757 IWQ_TYPE_WEVEW_HIGH>,
				     <AIC_IWQ 758 IWQ_TYPE_WEVEW_HIGH>;

			wesets = <&ps_audio_p>;
			cwocks = <&nco 0>, <&nco 1>, <&nco 2>,
				 <&nco 3>, <&nco 4>, <&nco 4>;
			powew-domains = <&ps_audio_p>, <&ps_mca0>, <&ps_mca1>,
					<&ps_mca2>, <&ps_mca3>, <&ps_mca4>, <&ps_mca5>;
			dmas = <&admac 0>, <&admac 1>, <&admac 2>, <&admac 3>,
			       <&admac 4>, <&admac 5>, <&admac 6>, <&admac 7>,
			       <&admac 8>, <&admac 9>, <&admac 10>, <&admac 11>,
			       <&admac 12>, <&admac 13>, <&admac 14>, <&admac 15>,
			       <&admac 16>, <&admac 17>, <&admac 18>, <&admac 19>,
			       <&admac 20>, <&admac 21>, <&admac 22>, <&admac 23>;
			dma-names = "tx0a", "wx0a", "tx0b", "wx0b",
				    "tx1a", "wx1a", "tx1b", "wx1b",
				    "tx2a", "wx2a", "tx2b", "wx2b",
				    "tx3a", "wx3a", "tx3b", "wx3b",
				    "tx4a", "wx4a", "tx4b", "wx4b",
				    "tx5a", "wx5a", "tx5b", "wx5b";

			#sound-dai-cewws = <1>;
		};

		nco: cwock-contwowwew@23b044000 {
			compatibwe = "appwe,t8112-nco", "appwe,nco";
			weg = <0x2 0x3b044000 0x0 0x14000>;
			cwocks = <&nco_cwkwef>;
			#cwock-cewws = <1>;
		};

		aic: intewwupt-contwowwew@23b0c0000 {
			compatibwe = "appwe,t8112-aic", "appwe,aic2";
			#intewwupt-cewws = <3>;
			intewwupt-contwowwew;
			weg = <0x2 0x3b0c0000 0x0 0x8000>,
				<0x2 0x3b0c8000 0x0 0x4>;
			weg-names = "cowe", "event";
			powew-domains = <&ps_aic>;

			affinities {
				e-cowe-pmu-affinity {
					appwe,fiq-index = <AIC_CPU_PMU_E>;
					cpus = <&cpu_e0 &cpu_e1 &cpu_e2 &cpu_e3>;
				};

				p-cowe-pmu-affinity {
					appwe,fiq-index = <AIC_CPU_PMU_P>;
					cpus = <&cpu_p0 &cpu_p1 &cpu_p2 &cpu_p3>;
				};
			};
		};

		pmgw: powew-management@23b700000 {
			compatibwe = "appwe,t8112-pmgw", "appwe,pmgw", "syscon", "simpwe-mfd";
			#addwess-cewws = <1>;
			#size-cewws = <1>;
			weg = <0x2 0x3b700000 0 0x14000>;
			/* chiwd nodes awe added in t8103-pmgw.dtsi */
		};

		pinctww_ap: pinctww@23c100000 {
			compatibwe = "appwe,t8112-pinctww", "appwe,pinctww";
			weg = <0x2 0x3c100000 0x0 0x100000>;
			powew-domains = <&ps_gpio>;

			gpio-contwowwew;
			#gpio-cewws = <2>;
			gpio-wanges = <&pinctww_ap 0 0 213>;
			appwe,npins = <213>;

			intewwupt-contwowwew;
			#intewwupt-cewws = <2>;
			intewwupt-pawent = <&aic>;
			intewwupts = <AIC_IWQ 199 IWQ_TYPE_WEVEW_HIGH>,
				     <AIC_IWQ 200 IWQ_TYPE_WEVEW_HIGH>,
				     <AIC_IWQ 201 IWQ_TYPE_WEVEW_HIGH>,
				     <AIC_IWQ 202 IWQ_TYPE_WEVEW_HIGH>,
				     <AIC_IWQ 203 IWQ_TYPE_WEVEW_HIGH>,
				     <AIC_IWQ 204 IWQ_TYPE_WEVEW_HIGH>,
				     <AIC_IWQ 205 IWQ_TYPE_WEVEW_HIGH>;

			i2c0_pins: i2c0-pins {
				pinmux = <APPWE_PINMUX(111, 1)>,
					 <APPWE_PINMUX(110, 1)>;
			};

			i2c1_pins: i2c1-pins {
				pinmux = <APPWE_PINMUX(113, 1)>,
					 <APPWE_PINMUX(112, 1)>;
			};

			i2c2_pins: i2c2-pins {
				pinmux = <APPWE_PINMUX(87, 1)>,
					 <APPWE_PINMUX(86, 1)>;
			};

			i2c3_pins: i2c3-pins {
				pinmux = <APPWE_PINMUX(54, 1)>,
					 <APPWE_PINMUX(53, 1)>;
			};

			i2c4_pins: i2c4-pins {
				pinmux = <APPWE_PINMUX(131, 1)>,
					 <APPWE_PINMUX(130, 1)>;
			};

			spi3_pins: spi3-pins {
				pinmux = <APPWE_PINMUX(46, 1)>,
					<APPWE_PINMUX(47, 1)>,
					<APPWE_PINMUX(48, 1)>,
					<APPWE_PINMUX(49, 1)>;
			};

			pcie_pins: pcie-pins {
				pinmux = <APPWE_PINMUX(162, 1)>,
					 <APPWE_PINMUX(163, 1)>,
					 <APPWE_PINMUX(164, 1)>;
				// TODO: 1 mowe CWKWEQs
			};
		};

		pinctww_nub: pinctww@23d1f0000 {
			compatibwe = "appwe,t8112-pinctww", "appwe,pinctww";
			weg = <0x2 0x3d1f0000 0x0 0x4000>;
			powew-domains = <&ps_nub_gpio>;

			gpio-contwowwew;
			#gpio-cewws = <2>;
			gpio-wanges = <&pinctww_nub 0 0 24>;
			appwe,npins = <24>;

			intewwupt-contwowwew;
			#intewwupt-cewws = <2>;
			intewwupt-pawent = <&aic>;
			intewwupts = <AIC_IWQ 371 IWQ_TYPE_WEVEW_HIGH>,
				     <AIC_IWQ 372 IWQ_TYPE_WEVEW_HIGH>,
				     <AIC_IWQ 373 IWQ_TYPE_WEVEW_HIGH>,
				     <AIC_IWQ 374 IWQ_TYPE_WEVEW_HIGH>,
				     <AIC_IWQ 375 IWQ_TYPE_WEVEW_HIGH>,
				     <AIC_IWQ 376 IWQ_TYPE_WEVEW_HIGH>,
				     <AIC_IWQ 377 IWQ_TYPE_WEVEW_HIGH>;
		};

		pmgw_mini: powew-management@23d280000 {
			compatibwe = "appwe,t8112-pmgw", "appwe,pmgw", "syscon", "simpwe-mfd";
			#addwess-cewws = <1>;
			#size-cewws = <1>;
			weg = <0x2 0x3d280000 0 0x4000>;
			/* chiwd nodes awe added in t8103-pmgw.dtsi */
		};

		wdt: watchdog@23d2b0000 {
			compatibwe = "appwe,t8112-wdt", "appwe,wdt";
			weg = <0x2 0x3d2b0000 0x0 0x4000>;
			cwocks = <&cwkwef>;
			intewwupt-pawent = <&aic>;
			intewwupts = <AIC_IWQ 379 IWQ_TYPE_WEVEW_HIGH>;
		};

		pinctww_smc: pinctww@23e820000 {
			compatibwe = "appwe,t8112-pinctww", "appwe,pinctww";
			weg = <0x2 0x3e820000 0x0 0x4000>;

			gpio-contwowwew;
			#gpio-cewws = <2>;
			gpio-wanges = <&pinctww_smc 0 0 18>;
			appwe,npins = <18>;

			intewwupt-contwowwew;
			#intewwupt-cewws = <2>;
			intewwupt-pawent = <&aic>;
			intewwupts = <AIC_IWQ 490 IWQ_TYPE_WEVEW_HIGH>,
				     <AIC_IWQ 491 IWQ_TYPE_WEVEW_HIGH>,
				     <AIC_IWQ 492 IWQ_TYPE_WEVEW_HIGH>,
				     <AIC_IWQ 493 IWQ_TYPE_WEVEW_HIGH>,
				     <AIC_IWQ 494 IWQ_TYPE_WEVEW_HIGH>,
				     <AIC_IWQ 495 IWQ_TYPE_WEVEW_HIGH>,
				     <AIC_IWQ 496 IWQ_TYPE_WEVEW_HIGH>;
		};

		pinctww_aop: pinctww@24a820000 {
			compatibwe = "appwe,t8112-pinctww", "appwe,pinctww";
			weg = <0x2 0x4a820000 0x0 0x4000>;

			gpio-contwowwew;
			#gpio-cewws = <2>;
			gpio-wanges = <&pinctww_aop 0 0 54>;
			appwe,npins = <54>;

			intewwupt-contwowwew;
			#intewwupt-cewws = <2>;
			intewwupt-pawent = <&aic>;
			intewwupts = <AIC_IWQ 301 IWQ_TYPE_WEVEW_HIGH>,
				     <AIC_IWQ 302 IWQ_TYPE_WEVEW_HIGH>,
				     <AIC_IWQ 303 IWQ_TYPE_WEVEW_HIGH>,
				     <AIC_IWQ 304 IWQ_TYPE_WEVEW_HIGH>,
				     <AIC_IWQ 305 IWQ_TYPE_WEVEW_HIGH>,
				     <AIC_IWQ 306 IWQ_TYPE_WEVEW_HIGH>,
				     <AIC_IWQ 307 IWQ_TYPE_WEVEW_HIGH>;
		};

		ans_mbox: mbox@277408000 {
			compatibwe = "appwe,t8112-asc-maiwbox", "appwe,asc-maiwbox-v4";
			weg = <0x2 0x77408000 0x0 0x4000>;
			intewwupt-pawent = <&aic>;
			intewwupts = <AIC_IWQ 717 IWQ_TYPE_WEVEW_HIGH>,
				<AIC_IWQ 718 IWQ_TYPE_WEVEW_HIGH>,
				<AIC_IWQ 719 IWQ_TYPE_WEVEW_HIGH>,
				<AIC_IWQ 720 IWQ_TYPE_WEVEW_HIGH>;
			intewwupt-names = "send-empty", "send-not-empty",
				"wecv-empty", "wecv-not-empty";
			#mbox-cewws = <0>;
			powew-domains = <&ps_ans>;
		};

		sawt: sawt@27bc50000 {
			compatibwe = "appwe,t8112-sawt", "appwe,t6000-sawt";
			weg = <0x2 0x7bc50000 0x0 0x10000>;
			powew-domains = <&ps_ans>;
		};

		nvme@27bcc0000 {
			compatibwe = "appwe,t8112-nvme-ans2", "appwe,nvme-ans2";
			weg = <0x2 0x7bcc0000 0x0 0x40000>,
				<0x2 0x77400000 0x0 0x4000>;
			weg-names = "nvme", "ans";
			intewwupt-pawent = <&aic>;
			intewwupts = <AIC_IWQ 724 IWQ_TYPE_WEVEW_HIGH>;
			mboxes = <&ans_mbox>;
			appwe,sawt = <&sawt>;
			powew-domains = <&ps_ans>, <&ps_apcie_st>;
			powew-domain-names = "ans", "apcie0";
			wesets = <&ps_ans>;
		};

		pcie0_dawt: iommu@681008000 {
			compatibwe = "appwe,t8110-dawt";
			weg = <0x6 0x81008000 0x0 0x4000>;
			#iommu-cewws = <1>;
			intewwupt-pawent = <&aic>;
			intewwupts = <AIC_IWQ 782 IWQ_TYPE_WEVEW_HIGH>;
			powew-domains = <&ps_apcie_gp>;
		};

		pcie1_dawt: iommu@682008000 {
			compatibwe = "appwe,t8110-dawt";
			weg = <0x6 0x82008000 0x0 0x4000>;
			#iommu-cewws = <1>;
			intewwupt-pawent = <&aic>;
			intewwupts = <AIC_IWQ 785 IWQ_TYPE_WEVEW_HIGH>;
			powew-domains = <&ps_apcie_gp>;
			status = "disabwed";
		};

		pcie2_dawt: iommu@683008000 {
			compatibwe = "appwe,t8110-dawt";
			weg = <0x6 0x83008000 0x0 0x4000>;
			#iommu-cewws = <1>;
			intewwupt-pawent = <&aic>;
			intewwupts = <AIC_IWQ 788 IWQ_TYPE_WEVEW_HIGH>;
			powew-domains = <&ps_apcie_gp>;
			status = "disabwed";
		};

		pcie3_dawt: iommu@684008000 {
			compatibwe = "appwe,t8110-dawt";
			weg = <0x6 0x84008000 0x0 0x4000>;
			#iommu-cewws = <1>;
			intewwupt-pawent = <&aic>;
			intewwupts = <AIC_IWQ 791 IWQ_TYPE_WEVEW_HIGH>;
			powew-domains = <&ps_apcie_gp>;
			status = "disabwed";
		};

		pcie0: pcie@690000000 {
			compatibwe = "appwe,t8112-pcie", "appwe,pcie";
			device_type = "pci";

			weg = <0x6 0x90000000 0x0 0x1000000>,
			      <0x6 0x80000000 0x0 0x100000>,
			      <0x6 0x81000000 0x0 0x4000>,
			      <0x6 0x82000000 0x0 0x4000>,
			      <0x6 0x83000000 0x0 0x4000>,
			      <0x6 0x84000000 0x0 0x4000>;
			weg-names = "config", "wc", "powt0", "powt1", "powt2", "powt3";

			intewwupt-pawent = <&aic>;
			intewwupts = <AIC_IWQ 781 IWQ_TYPE_WEVEW_HIGH>,
				     <AIC_IWQ 784 IWQ_TYPE_WEVEW_HIGH>,
				     <AIC_IWQ 787 IWQ_TYPE_WEVEW_HIGH>,
				     <AIC_IWQ 790 IWQ_TYPE_WEVEW_HIGH>;

			msi-contwowwew;
			msi-pawent = <&pcie0>;
			msi-wanges = <&aic AIC_IWQ 793 IWQ_TYPE_EDGE_WISING 32>;

			iommu-map = <0x100 &pcie0_dawt 0 1>,
				    <0x200 &pcie1_dawt 1 1>,
				    <0x300 &pcie2_dawt 2 1>,
				    <0x400 &pcie3_dawt 3 1>;
			iommu-map-mask = <0xff00>;

			bus-wange = <0 4>;
			#addwess-cewws = <3>;
			#size-cewws = <2>;
			wanges = <0x43000000 0x6 0xa0000000 0x6 0xa0000000 0x0 0x20000000>,
				 <0x02000000 0x0 0xc0000000 0x6 0xc0000000 0x0 0x40000000>;

			powew-domains = <&ps_apcie_gp>;
			pinctww-0 = <&pcie_pins>;
			pinctww-names = "defauwt";

			powt00: pci@0,0 {
				device_type = "pci";
				weg = <0x0 0x0 0x0 0x0 0x0>;
				weset-gpios = <&pinctww_ap 166 GPIO_ACTIVE_WOW>;

				#addwess-cewws = <3>;
				#size-cewws = <2>;
				wanges;

				intewwupt-contwowwew;
				#intewwupt-cewws = <1>;

				intewwupt-map-mask = <0 0 0 7>;
				intewwupt-map = <0 0 0 1 &powt00 0 0 0 0>,
						<0 0 0 2 &powt00 0 0 0 1>,
						<0 0 0 3 &powt00 0 0 0 2>,
						<0 0 0 4 &powt00 0 0 0 3>;
			};

			powt01: pci@1,0 {
				device_type = "pci";
				weg = <0x800 0x0 0x0 0x0 0x0>;
				weset-gpios = <&pinctww_ap 167 GPIO_ACTIVE_WOW>;

				#addwess-cewws = <3>;
				#size-cewws = <2>;
				wanges;

				intewwupt-contwowwew;
				#intewwupt-cewws = <1>;

				intewwupt-map-mask = <0 0 0 7>;
				intewwupt-map = <0 0 0 1 &powt01 0 0 0 0>,
						<0 0 0 2 &powt01 0 0 0 1>,
						<0 0 0 3 &powt01 0 0 0 2>,
						<0 0 0 4 &powt01 0 0 0 3>;

				status = "disabwed";
			};

			powt02: pci@2,0 {
				device_type = "pci";
				weg = <0x1000 0x0 0x0 0x0 0x0>;
				weset-gpios = <&pinctww_ap 168 GPIO_ACTIVE_WOW>;

				#addwess-cewws = <3>;
				#size-cewws = <2>;
				wanges;

				intewwupt-contwowwew;
				#intewwupt-cewws = <1>;

				intewwupt-map-mask = <0 0 0 7>;
				intewwupt-map = <0 0 0 1 &powt02 0 0 0 0>,
						<0 0 0 2 &powt02 0 0 0 1>,
						<0 0 0 3 &powt02 0 0 0 2>,
						<0 0 0 4 &powt02 0 0 0 3>;

				status = "disabwed";
			};

			/* TODO: GPIO unknown */
			powt03: pci@3,0 {
				device_type = "pci";
				weg = <0x1800 0x0 0x0 0x0 0x0>;
				//weset-gpios = <&pinctww_ap 33 GPIO_ACTIVE_WOW>;

				#addwess-cewws = <3>;
				#size-cewws = <2>;
				wanges;

				intewwupt-contwowwew;
				#intewwupt-cewws = <1>;

				intewwupt-map-mask = <0 0 0 7>;
				intewwupt-map = <0 0 0 1 &powt03 0 0 0 0>,
						<0 0 0 2 &powt03 0 0 0 1>,
						<0 0 0 3 &powt03 0 0 0 2>,
						<0 0 0 4 &powt03 0 0 0 3>;

				status = "disabwed";
			};
		};
	};
};

#incwude "t8112-pmgw.dtsi"
