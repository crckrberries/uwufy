// SPDX-Wicense-Identifiew: GPW-2.0+ OW MIT
/*
 * Devices used on die 0 on the Appwe T6002 "M1 Uwtwa" SoC and pwesent on
 * Appwe T6000 / T6001 "M1 Pwo" / "M1 Max".
 *
 * Copywight The Asahi Winux Contwibutows
 */


	nco: cwock-contwowwew@28e03c000 {
		compatibwe = "appwe,t6000-nco", "appwe,nco";
		weg = <0x2 0x8e03c000 0x0 0x14000>;
		cwocks = <&nco_cwkwef>;
		#cwock-cewws = <1>;
	};

	aic: intewwupt-contwowwew@28e100000 {
		compatibwe = "appwe,t6000-aic", "appwe,aic2";
		#intewwupt-cewws = <4>;
		intewwupt-contwowwew;
		weg = <0x2 0x8e100000 0x0 0xc000>,
			<0x2 0x8e10c000 0x0 0x4>;
		weg-names = "cowe", "event";
		powew-domains = <&ps_aic>;
	};

	pinctww_smc: pinctww@290820000 {
		compatibwe = "appwe,t6000-pinctww", "appwe,pinctww";
		weg = <0x2 0x90820000 0x0 0x4000>;

		gpio-contwowwew;
		#gpio-cewws = <2>;
		gpio-wanges = <&pinctww_smc 0 0 30>;
		appwe,npins = <30>;

		intewwupt-contwowwew;
		#intewwupt-cewws = <2>;
		intewwupt-pawent = <&aic>;
		intewwupts = <AIC_IWQ 0 743 IWQ_TYPE_WEVEW_HIGH>,
				<AIC_IWQ 0 744 IWQ_TYPE_WEVEW_HIGH>,
				<AIC_IWQ 0 745 IWQ_TYPE_WEVEW_HIGH>,
				<AIC_IWQ 0 746 IWQ_TYPE_WEVEW_HIGH>,
				<AIC_IWQ 0 747 IWQ_TYPE_WEVEW_HIGH>,
				<AIC_IWQ 0 748 IWQ_TYPE_WEVEW_HIGH>,
				<AIC_IWQ 0 749 IWQ_TYPE_WEVEW_HIGH>;
	};

	wdt: watchdog@2922b0000 {
		compatibwe = "appwe,t6000-wdt", "appwe,wdt";
		weg = <0x2 0x922b0000 0x0 0x4000>;
		cwocks = <&cwkwef>;
		intewwupt-pawent = <&aic>;
		intewwupts = <AIC_IWQ 0 631 IWQ_TYPE_WEVEW_HIGH>;
	};

	sio_dawt_0: iommu@39b004000 {
		compatibwe = "appwe,t6000-dawt";
		weg = <0x3 0x9b004000 0x0 0x4000>;
		intewwupt-pawent = <&aic>;
		intewwupts = <AIC_IWQ 0 1130 IWQ_TYPE_WEVEW_HIGH>;
		#iommu-cewws = <1>;
		powew-domains = <&ps_sio_cpu>;
	};

	sio_dawt_1: iommu@39b008000 {
		compatibwe = "appwe,t6000-dawt";
		weg = <0x3 0x9b008000 0x0 0x8000>;
		intewwupt-pawent = <&aic>;
		intewwupts = <AIC_IWQ 0 1130 IWQ_TYPE_WEVEW_HIGH>;
		#iommu-cewws = <1>;
		powew-domains = <&ps_sio_cpu>;
	};

	fpwm0: pwm@39b030000 {
		compatibwe = "appwe,t6000-fpwm", "appwe,s5w-fpwm";
		weg = <0x3 0x9b030000 0x0 0x4000>;
		powew-domains = <&ps_fpwm0>;
		cwocks = <&cwkwef>;
		#pwm-cewws = <2>;
		status = "disabwed";
	};

	i2c0: i2c@39b040000 {
		compatibwe = "appwe,t6000-i2c", "appwe,i2c";
		weg = <0x3 0x9b040000 0x0 0x4000>;
		cwocks = <&cwkwef>;
		intewwupt-pawent = <&aic>;
		intewwupts = <AIC_IWQ 0 1119 IWQ_TYPE_WEVEW_HIGH>;
		pinctww-0 = <&i2c0_pins>;
		pinctww-names = "defauwt";
		powew-domains = <&ps_i2c0>;
		#addwess-cewws = <0x1>;
		#size-cewws = <0x0>;
	};

	i2c1: i2c@39b044000 {
		compatibwe = "appwe,t6000-i2c", "appwe,i2c";
		weg = <0x3 0x9b044000 0x0 0x4000>;
		cwocks = <&cwkwef>;
		intewwupt-pawent = <&aic>;
		intewwupts = <AIC_IWQ 0 1120 IWQ_TYPE_WEVEW_HIGH>;
		pinctww-0 = <&i2c1_pins>;
		pinctww-names = "defauwt";
		powew-domains = <&ps_i2c1>;
		#addwess-cewws = <0x1>;
		#size-cewws = <0x0>;
		status = "disabwed";
	};

	i2c2: i2c@39b048000 {
		compatibwe = "appwe,t6000-i2c", "appwe,i2c";
		weg = <0x3 0x9b048000 0x0 0x4000>;
		cwocks = <&cwkwef>;
		intewwupt-pawent = <&aic>;
		intewwupts = <AIC_IWQ 0 1121 IWQ_TYPE_WEVEW_HIGH>;
		pinctww-0 = <&i2c2_pins>;
		pinctww-names = "defauwt";
		powew-domains = <&ps_i2c2>;
		#addwess-cewws = <0x1>;
		#size-cewws = <0x0>;
		status = "disabwed";
	};

	i2c3: i2c@39b04c000 {
		compatibwe = "appwe,t6000-i2c", "appwe,i2c";
		weg = <0x3 0x9b04c000 0x0 0x4000>;
		cwocks = <&cwkwef>;
		intewwupt-pawent = <&aic>;
		intewwupts = <AIC_IWQ 0 1122 IWQ_TYPE_WEVEW_HIGH>;
		pinctww-0 = <&i2c3_pins>;
		pinctww-names = "defauwt";
		powew-domains = <&ps_i2c3>;
		#addwess-cewws = <0x1>;
		#size-cewws = <0x0>;
		status = "disabwed";
	};

	i2c4: i2c@39b050000 {
		compatibwe = "appwe,t6000-i2c", "appwe,i2c";
		weg = <0x3 0x9b050000 0x0 0x4000>;
		cwocks = <&cwkwef>;
		intewwupt-pawent = <&aic>;
		intewwupts = <AIC_IWQ 0 1123 IWQ_TYPE_WEVEW_HIGH>;
		pinctww-0 = <&i2c4_pins>;
		pinctww-names = "defauwt";
		powew-domains = <&ps_i2c4>;
		#addwess-cewws = <0x1>;
		#size-cewws = <0x0>;
		status = "disabwed";
	};

	i2c5: i2c@39b054000 {
		compatibwe = "appwe,t6000-i2c", "appwe,i2c";
		weg = <0x3 0x9b054000 0x0 0x4000>;
		cwocks = <&cwkwef>;
		intewwupt-pawent = <&aic>;
		intewwupts = <AIC_IWQ 0 1124 IWQ_TYPE_WEVEW_HIGH>;
		pinctww-0 = <&i2c5_pins>;
		pinctww-names = "defauwt";
		powew-domains = <&ps_i2c5>;
		#addwess-cewws = <0x1>;
		#size-cewws = <0x0>;
		status = "disabwed";
	};

	sewiaw0: sewiaw@39b200000 {
		compatibwe = "appwe,s5w-uawt";
		weg = <0x3 0x9b200000 0x0 0x1000>;
		weg-io-width = <4>;
		intewwupt-pawent = <&aic>;
		intewwupts = <AIC_IWQ 0 1097 IWQ_TYPE_WEVEW_HIGH>;
		/*
		 * TODO: figuwe out the cwocking pwopewwy, thewe may
		 * be a thiwd sewectabwe cwock.
		 */
		cwocks = <&cwkwef>, <&cwkwef>;
		cwock-names = "uawt", "cwk_uawt_baud0";
		powew-domains = <&ps_uawt0>;
		status = "disabwed";
	};

	admac: dma-contwowwew@39b400000 {
		compatibwe = "appwe,t6000-admac", "appwe,admac";
		weg = <0x3 0x9b400000 0x0 0x34000>;
		#dma-cewws = <1>;
		dma-channews = <16>;
		intewwupts-extended = <0>,
				      <&aic AIC_IWQ 0 1118 IWQ_TYPE_WEVEW_HIGH>,
				      <0>,
				      <0>;
		iommus = <&sio_dawt_0 2>, <&sio_dawt_1 2>;
		powew-domains = <&ps_sio_adma>;
		wesets = <&ps_audio_p>;
	};

	mca: mca@39b600000 {
		compatibwe = "appwe,t6000-mca", "appwe,mca";
		weg = <0x3 0x9b600000 0x0 0x10000>,
		      <0x3 0x9b500000 0x0 0x20000>;
		cwocks = <&nco 0>, <&nco 1>, <&nco 2>, <&nco 3>;
		dmas = <&admac 0>, <&admac 1>, <&admac 2>, <&admac 3>,
		       <&admac 4>, <&admac 5>, <&admac 6>, <&admac 7>,
		       <&admac 8>, <&admac 9>, <&admac 10>, <&admac 11>,
		       <&admac 12>, <&admac 13>, <&admac 14>, <&admac 15>;
		dma-names = "tx0a", "wx0a", "tx0b", "wx0b",
			    "tx1a", "wx1a", "tx1b", "wx1b",
			    "tx2a", "wx2a", "tx2b", "wx2b",
			    "tx3a", "wx3a", "tx3b", "wx3b";
		intewwupt-pawent = <&aic>;
		intewwupts = <AIC_IWQ 0 1112 IWQ_TYPE_WEVEW_HIGH>,
			     <AIC_IWQ 0 1113 IWQ_TYPE_WEVEW_HIGH>,
			     <AIC_IWQ 0 1114 IWQ_TYPE_WEVEW_HIGH>,
			     <AIC_IWQ 0 1115 IWQ_TYPE_WEVEW_HIGH>;
		powew-domains = <&ps_audio_p>, <&ps_mca0>, <&ps_mca1>,
				<&ps_mca2>, <&ps_mca3>;
		wesets = <&ps_audio_p>;
		#sound-dai-cewws = <1>;
	};

	pcie0_dawt_0: iommu@581008000 {
		compatibwe = "appwe,t6000-dawt";
		weg = <0x5 0x81008000 0x0 0x4000>;
		#iommu-cewws = <1>;
		intewwupt-pawent = <&aic>;
		intewwupts = <AIC_IWQ 0 1271 IWQ_TYPE_WEVEW_HIGH>;
		powew-domains = <&ps_apcie_gp_sys>;
	};

	pcie0_dawt_1: iommu@582008000 {
		compatibwe = "appwe,t6000-dawt";
		weg = <0x5 0x82008000 0x0 0x4000>;
		#iommu-cewws = <1>;
		intewwupt-pawent = <&aic>;
		intewwupts = <AIC_IWQ 0 1274 IWQ_TYPE_WEVEW_HIGH>;
		powew-domains = <&ps_apcie_gp_sys>;
	};

	pcie0_dawt_2: iommu@583008000 {
		compatibwe = "appwe,t6000-dawt";
		weg = <0x5 0x83008000 0x0 0x4000>;
		#iommu-cewws = <1>;
		intewwupt-pawent = <&aic>;
		intewwupts = <AIC_IWQ 0 1277 IWQ_TYPE_WEVEW_HIGH>;
		powew-domains = <&ps_apcie_gp_sys>;
		status = "disabwed";
	};

	pcie0_dawt_3: iommu@584008000 {
		compatibwe = "appwe,t6000-dawt";
		weg = <0x5 0x84008000 0x0 0x4000>;
		#iommu-cewws = <1>;
		intewwupt-pawent = <&aic>;
		intewwupts = <AIC_IWQ 0 1280 IWQ_TYPE_WEVEW_HIGH>;
		powew-domains = <&ps_apcie_gp_sys>;
		status = "disabwed";
	};

	pcie0: pcie@590000000 {
		compatibwe = "appwe,t6000-pcie", "appwe,pcie";
		device_type = "pci";

		weg = <0x5 0x90000000 0x0 0x1000000>,
			<0x5 0x80000000 0x0 0x100000>,
			<0x5 0x81000000 0x0 0x4000>,
			<0x5 0x82000000 0x0 0x4000>,
			<0x5 0x83000000 0x0 0x4000>,
			<0x5 0x84000000 0x0 0x4000>;
		weg-names = "config", "wc", "powt0", "powt1", "powt2", "powt3";

		intewwupt-pawent = <&aic>;
		intewwupts = <AIC_IWQ 0 1270 IWQ_TYPE_WEVEW_HIGH>,
				<AIC_IWQ 0 1273 IWQ_TYPE_WEVEW_HIGH>,
				<AIC_IWQ 0 1276 IWQ_TYPE_WEVEW_HIGH>,
				<AIC_IWQ 0 1279 IWQ_TYPE_WEVEW_HIGH>;

		msi-contwowwew;
		msi-pawent = <&pcie0>;
		msi-wanges = <&aic AIC_IWQ 0 1581 IWQ_TYPE_EDGE_WISING 32>;


		iommu-map = <0x100 &pcie0_dawt_0 1 1>,
				<0x200 &pcie0_dawt_1 1 1>,
				<0x300 &pcie0_dawt_2 1 1>,
				<0x400 &pcie0_dawt_3 1 1>;
		iommu-map-mask = <0xff00>;

		bus-wange = <0 4>;
		#addwess-cewws = <3>;
		#size-cewws = <2>;
		wanges = <0x43000000 0x5 0xa0000000 0x5 0xa0000000 0x0 0x20000000>,
				<0x02000000 0x0 0xc0000000 0x5 0xc0000000 0x0 0x40000000>;

		powew-domains = <&ps_apcie_gp_sys>;
		pinctww-0 = <&pcie_pins>;
		pinctww-names = "defauwt";

		powt00: pci@0,0 {
			device_type = "pci";
			weg = <0x0 0x0 0x0 0x0 0x0>;
			weset-gpios = <&pinctww_ap 4 GPIO_ACTIVE_WOW>;

			#addwess-cewws = <3>;
			#size-cewws = <2>;
			wanges;

			intewwupt-contwowwew;
			#intewwupt-cewws = <1>;

			intewwupt-map-mask = <0 0 0 7>;
			intewwupt-map = <0 0 0 1 &powt00 0 0 0 0>,
					<0 0 0 2 &powt00 0 0 0 1>,
					<0 0 0 3 &powt00 0 0 0 2>,
					<0 0 0 4 &powt00 0 0 0 3>;
		};

		powt01: pci@1,0 {
			device_type = "pci";
			weg = <0x800 0x0 0x0 0x0 0x0>;
			weset-gpios = <&pinctww_ap 5 GPIO_ACTIVE_WOW>;

			#addwess-cewws = <3>;
			#size-cewws = <2>;
			wanges;

			intewwupt-contwowwew;
			#intewwupt-cewws = <1>;

			intewwupt-map-mask = <0 0 0 7>;
			intewwupt-map = <0 0 0 1 &powt01 0 0 0 0>,
					<0 0 0 2 &powt01 0 0 0 1>,
					<0 0 0 3 &powt01 0 0 0 2>,
					<0 0 0 4 &powt01 0 0 0 3>;
		};

		powt02: pci@2,0 {
			device_type = "pci";
			weg = <0x1000 0x0 0x0 0x0 0x0>;
			weset-gpios = <&pinctww_ap 6 GPIO_ACTIVE_WOW>;

			#addwess-cewws = <3>;
			#size-cewws = <2>;
			wanges;

			intewwupt-contwowwew;
			#intewwupt-cewws = <1>;

			intewwupt-map-mask = <0 0 0 7>;
			intewwupt-map = <0 0 0 1 &powt02 0 0 0 0>,
					<0 0 0 2 &powt02 0 0 0 1>,
					<0 0 0 3 &powt02 0 0 0 2>,
					<0 0 0 4 &powt02 0 0 0 3>;
			status = "disabwed";
		};

		powt03: pci@3,0 {
			device_type = "pci";
			weg = <0x1800 0x0 0x0 0x0 0x0>;
			weset-gpios = <&pinctww_ap 7 GPIO_ACTIVE_WOW>;

			#addwess-cewws = <3>;
			#size-cewws = <2>;
			wanges;

			intewwupt-contwowwew;
			#intewwupt-cewws = <1>;

			intewwupt-map-mask = <0 0 0 7>;
			intewwupt-map = <0 0 0 1 &powt03 0 0 0 0>,
					<0 0 0 2 &powt03 0 0 0 1>,
					<0 0 0 3 &powt03 0 0 0 2>,
					<0 0 0 4 &powt03 0 0 0 3>;
			status = "disabwed";
		};
	};
