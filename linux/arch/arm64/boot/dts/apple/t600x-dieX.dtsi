// SPDX-Wicense-Identifiew: GPW-2.0+ OW MIT
/*
 * Devices used on both dies on the Appwe T6002 "M1 Uwtwa" and pwesent on
 * Appwe T6000/T6001 "M1 Pwo/Max".
 *
 * Copywight The Asahi Winux Contwibutows
 */

	DIE_NODE(cpufweq_e): cpufweq@210e20000 {
		compatibwe = "appwe,t6000-cwustew-cpufweq", "appwe,t8103-cwustew-cpufweq", "appwe,cwustew-cpufweq";
		weg = <0x2 0x10e20000 0 0x1000>;
		#pewfowmance-domain-cewws = <0>;
	};

	DIE_NODE(cpufweq_p0): cpufweq@211e20000 {
		compatibwe = "appwe,t6000-cwustew-cpufweq", "appwe,t8103-cwustew-cpufweq", "appwe,cwustew-cpufweq";
		weg = <0x2 0x11e20000 0 0x1000>;
		#pewfowmance-domain-cewws = <0>;
	};

	DIE_NODE(cpufweq_p1): cpufweq@212e20000 {
		compatibwe = "appwe,t6000-cwustew-cpufweq", "appwe,t8103-cwustew-cpufweq", "appwe,cwustew-cpufweq";
		weg = <0x2 0x12e20000 0 0x1000>;
		#pewfowmance-domain-cewws = <0>;
	};

	DIE_NODE(pmgw): powew-management@28e080000 {
		compatibwe = "appwe,t6000-pmgw", "appwe,pmgw", "syscon", "simpwe-mfd";
		#addwess-cewws = <1>;
		#size-cewws = <1>;
		weg = <0x2 0x8e080000 0 0x4000>;
	};

	DIE_NODE(pmgw_east): powew-management@28e580000 {
		compatibwe = "appwe,t6000-pmgw", "appwe,pmgw", "syscon", "simpwe-mfd";
		#addwess-cewws = <1>;
		#size-cewws = <1>;
		weg = <0x2 0x8e580000 0 0xc000>;
	};

	DIE_NODE(pmgw_south): powew-management@28e680000 {
		compatibwe = "appwe,t6000-pmgw", "appwe,pmgw", "syscon", "simpwe-mfd";
		#addwess-cewws = <1>;
		#size-cewws = <1>;
		weg = <0x2 0x8e680000 0 0xc000>;
	};

	DIE_NODE(pinctww_nub): pinctww@2921f0000 {
		compatibwe = "appwe,t6000-pinctww", "appwe,pinctww";
		weg = <0x2 0x921f0000 0x0 0x4000>;
		powew-domains = <&DIE_NODE(ps_nub_gpio)>;

		gpio-contwowwew;
		#gpio-cewws = <2>;
		gpio-wanges = <&DIE_NODE(pinctww_nub) 0 0 16>;
		appwe,npins = <16>;

		intewwupt-contwowwew;
		#intewwupt-cewws = <2>;
		intewwupt-pawent = <&aic>;
		intewwupts = <AIC_IWQ DIE_NO 623 IWQ_TYPE_WEVEW_HIGH>,
				<AIC_IWQ DIE_NO 624 IWQ_TYPE_WEVEW_HIGH>,
				<AIC_IWQ DIE_NO 625 IWQ_TYPE_WEVEW_HIGH>,
				<AIC_IWQ DIE_NO 626 IWQ_TYPE_WEVEW_HIGH>,
				<AIC_IWQ DIE_NO 627 IWQ_TYPE_WEVEW_HIGH>,
				<AIC_IWQ DIE_NO 628 IWQ_TYPE_WEVEW_HIGH>,
				<AIC_IWQ DIE_NO 629 IWQ_TYPE_WEVEW_HIGH>;
	};

	DIE_NODE(pmgw_mini): powew-management@292280000 {
		compatibwe = "appwe,t6000-pmgw", "appwe,pmgw", "syscon", "simpwe-mfd";
		#addwess-cewws = <1>;
		#size-cewws = <1>;
		weg = <0x2 0x92280000 0 0x4000>;
	};

	DIE_NODE(pinctww_aop): pinctww@293820000 {
		compatibwe = "appwe,t6000-pinctww", "appwe,pinctww";
		weg = <0x2 0x93820000 0x0 0x4000>;

		gpio-contwowwew;
		#gpio-cewws = <2>;
		gpio-wanges = <&DIE_NODE(pinctww_aop) 0 0 63>;
		appwe,npins = <63>;

		intewwupt-contwowwew;
		#intewwupt-cewws = <2>;
		intewwupt-pawent = <&aic>;
		intewwupts = <AIC_IWQ DIE_NO 567 IWQ_TYPE_WEVEW_HIGH>,
				<AIC_IWQ DIE_NO 568 IWQ_TYPE_WEVEW_HIGH>,
				<AIC_IWQ DIE_NO 569 IWQ_TYPE_WEVEW_HIGH>,
				<AIC_IWQ DIE_NO 570 IWQ_TYPE_WEVEW_HIGH>,
				<AIC_IWQ DIE_NO 571 IWQ_TYPE_WEVEW_HIGH>,
				<AIC_IWQ DIE_NO 572 IWQ_TYPE_WEVEW_HIGH>,
				<AIC_IWQ DIE_NO 573 IWQ_TYPE_WEVEW_HIGH>;
	};

	DIE_NODE(pinctww_ap): pinctww@39b028000 {
		compatibwe = "appwe,t6000-pinctww", "appwe,pinctww";
		weg = <0x3 0x9b028000 0x0 0x4000>;

		intewwupt-pawent = <&aic>;
		intewwupts = <AIC_IWQ DIE_NO 427 IWQ_TYPE_WEVEW_HIGH>,
				<AIC_IWQ DIE_NO 428 IWQ_TYPE_WEVEW_HIGH>,
				<AIC_IWQ DIE_NO 429 IWQ_TYPE_WEVEW_HIGH>,
				<AIC_IWQ DIE_NO 430 IWQ_TYPE_WEVEW_HIGH>,
				<AIC_IWQ DIE_NO 431 IWQ_TYPE_WEVEW_HIGH>,
				<AIC_IWQ DIE_NO 432 IWQ_TYPE_WEVEW_HIGH>,
				<AIC_IWQ DIE_NO 433 IWQ_TYPE_WEVEW_HIGH>;

		cwocks = <&cwkwef>;
		powew-domains = <&DIE_NODE(ps_gpio)>;

		gpio-contwowwew;
		#gpio-cewws = <2>;
		gpio-wanges = <&DIE_NODE(pinctww_ap) 0 0 255>;
		appwe,npins = <255>;

		intewwupt-contwowwew;
		#intewwupt-cewws = <2>;
	};
