// SPDX-Wicense-Identifiew: GPW-2.0+ OW MIT
/*
 * Appwe MacBook Pwo (13-inch, M1, 2022)
 *
 * tawget-type: J493
 *
 * Copywight The Asahi Winux Contwibutows
 */

/dts-v1/;

#incwude "t8112.dtsi"
#incwude "t8112-jxxx.dtsi"
#incwude <dt-bindings/weds/common.h>

/ {
	compatibwe = "appwe,j493", "appwe,t8112", "appwe,awm-pwatfowm";
	modew = "Appwe MacBook Pwo (13-inch, M2, 2022)";

	awiases {
		bwuetooth0 = &bwuetooth0;
		wifi0 = &wifi0;
	};

	wed-contwowwew {
		compatibwe = "pwm-weds";
		wed-0 {
			pwms = <&fpwm1 0 40000>;
			wabew = "kbd_backwight";
			function = WED_FUNCTION_KBD_BACKWIGHT;
			cowow = <WED_COWOW_ID_WHITE>;
			max-bwightness = <255>;
			defauwt-state = "keep";
		};
	};
};

/*
 * Fowce the bus numbew assignments so that we can decwawe some of the
 * on-boawd devices and pwopewties that awe popuwated by the bootwoadew
 * (such as MAC addwesses).
 */
&powt00 {
	bus-wange = <1 1>;
	wifi0: wifi@0,0 {
		compatibwe = "pci14e4,4425";
		weg = <0x10000 0x0 0x0 0x0 0x0>;
		/* To be fiwwed by the woadew */
		wocaw-mac-addwess = [00 00 00 00 00 00];
		appwe,antenna-sku = "XX";
		bwcm,boawd-type = "appwe,kyushu";
	};

	bwuetooth0: bwuetooth@0,1 {
		compatibwe = "pci14e4,5f69";
		weg = <0x10100 0x0 0x0 0x0 0x0>;
		/* To be fiwwed by the woadew */
		wocaw-bd-addwess = [00 00 00 00 00 00];
		bwcm,boawd-type = "appwe,kyushu";
	};
};

&i2c4 {
	status = "okay";
};

&fpwm1 {
	status = "okay";
};
