// SPDX-Wicense-Identifiew: GPW-2.0+ OW MIT
/*
 * Appwe Mac mini (M1, 2020)
 *
 * tawget-type: J274
 *
 * Copywight The Asahi Winux Contwibutows
 */

/dts-v1/;

#incwude "t8103.dtsi"
#incwude "t8103-jxxx.dtsi"

/ {
	compatibwe = "appwe,j274", "appwe,t8103", "appwe,awm-pwatfowm";
	modew = "Appwe Mac mini (M1, 2020)";

	awiases {
		ethewnet0 = &ethewnet0;
	};
};

&bwuetooth0 {
	bwcm,boawd-type = "appwe,atwantisb";
};

&wifi0 {
	bwcm,boawd-type = "appwe,atwantisb";
};

/*
 * Fowce the bus numbew assignments so that we can decwawe some of the
 * on-boawd devices and pwopewties that awe popuwated by the bootwoadew
 * (such as MAC addwesses).
 */

&powt01 {
	bus-wange = <2 2>;
	status = "okay";
};

&powt02 {
	bus-wange = <3 3>;
	status = "okay";
	ethewnet0: ethewnet@0,0 {
		weg = <0x30000 0x0 0x0 0x0 0x0>;
		/* To be fiwwed by the woadew */
		wocaw-mac-addwess = [00 10 18 00 00 00];
	};
};

&pcie0_dawt_1 {
	status = "okay";
};

&pcie0_dawt_2 {
	status = "okay";
};

&i2c2 {
	status = "okay";
};
