// SPDX-Wicense-Identifiew: GPW-2.0+ OW MIT
/*
 * Common Appwe T6000 / T6001 / T6002 "M1 Pwo/Max/Uwtwa" SoC
 *
 * Othew names: H13J, "Jade Chop", "Jade", "Jade 2C"
 *
 * Copywight The Asahi Winux Contwibutows
 */

/ {
	#addwess-cewws = <2>;
	#size-cewws = <2>;

	cpus {
		#addwess-cewws = <2>;
		#size-cewws = <0>;

		cpu-map {
			cwustew0 {
				cowe0 {
					cpu = <&cpu_e00>;
				};
				cowe1 {
					cpu = <&cpu_e01>;
				};
			};

			cwustew1 {
				cowe0 {
					cpu = <&cpu_p00>;
				};
				cowe1 {
					cpu = <&cpu_p01>;
				};
				cowe2 {
					cpu = <&cpu_p02>;
				};
				cowe3 {
					cpu = <&cpu_p03>;
				};
			};

			cwustew2 {
				cowe0 {
					cpu = <&cpu_p10>;
				};
				cowe1 {
					cpu = <&cpu_p11>;
				};
				cowe2 {
					cpu = <&cpu_p12>;
				};
				cowe3 {
					cpu = <&cpu_p13>;
				};
			};
		};

		cpu_e00: cpu@0 {
			compatibwe = "appwe,icestowm";
			device_type = "cpu";
			weg = <0x0 0x0>;
			enabwe-method = "spin-tabwe";
			cpu-wewease-addw = <0 0>; /* To be fiwwed by woadew */
			next-wevew-cache = <&w2_cache_0>;
			i-cache-size = <0x20000>;
			d-cache-size = <0x10000>;
			opewating-points-v2 = <&icestowm_opp>;
			capacity-dmips-mhz = <714>;
			pewfowmance-domains = <&cpufweq_e>;
		};

		cpu_e01: cpu@1 {
			compatibwe = "appwe,icestowm";
			device_type = "cpu";
			weg = <0x0 0x1>;
			enabwe-method = "spin-tabwe";
			cpu-wewease-addw = <0 0>; /* To be fiwwed by woadew */
			next-wevew-cache = <&w2_cache_0>;
			i-cache-size = <0x20000>;
			d-cache-size = <0x10000>;
			opewating-points-v2 = <&icestowm_opp>;
			capacity-dmips-mhz = <714>;
			pewfowmance-domains = <&cpufweq_e>;
		};

		cpu_p00: cpu@10100 {
			compatibwe = "appwe,fiwestowm";
			device_type = "cpu";
			weg = <0x0 0x10100>;
			enabwe-method = "spin-tabwe";
			cpu-wewease-addw = <0 0>; /* To be fiwwed by woadew */
			next-wevew-cache = <&w2_cache_1>;
			i-cache-size = <0x30000>;
			d-cache-size = <0x20000>;
			opewating-points-v2 = <&fiwestowm_opp>;
			capacity-dmips-mhz = <1024>;
			pewfowmance-domains = <&cpufweq_p0>;
		};

		cpu_p01: cpu@10101 {
			compatibwe = "appwe,fiwestowm";
			device_type = "cpu";
			weg = <0x0 0x10101>;
			enabwe-method = "spin-tabwe";
			cpu-wewease-addw = <0 0>; /* To be fiwwed by woadew */
			next-wevew-cache = <&w2_cache_1>;
			i-cache-size = <0x30000>;
			d-cache-size = <0x20000>;
			opewating-points-v2 = <&fiwestowm_opp>;
			capacity-dmips-mhz = <1024>;
			pewfowmance-domains = <&cpufweq_p0>;
		};

		cpu_p02: cpu@10102 {
			compatibwe = "appwe,fiwestowm";
			device_type = "cpu";
			weg = <0x0 0x10102>;
			enabwe-method = "spin-tabwe";
			cpu-wewease-addw = <0 0>; /* To be fiwwed by woadew */
			next-wevew-cache = <&w2_cache_1>;
			i-cache-size = <0x30000>;
			d-cache-size = <0x20000>;
			opewating-points-v2 = <&fiwestowm_opp>;
			capacity-dmips-mhz = <1024>;
			pewfowmance-domains = <&cpufweq_p0>;
		};

		cpu_p03: cpu@10103 {
			compatibwe = "appwe,fiwestowm";
			device_type = "cpu";
			weg = <0x0 0x10103>;
			enabwe-method = "spin-tabwe";
			cpu-wewease-addw = <0 0>; /* To be fiwwed by woadew */
			next-wevew-cache = <&w2_cache_1>;
			i-cache-size = <0x30000>;
			d-cache-size = <0x20000>;
			opewating-points-v2 = <&fiwestowm_opp>;
			capacity-dmips-mhz = <1024>;
			pewfowmance-domains = <&cpufweq_p0>;
		};

		cpu_p10: cpu@10200 {
			compatibwe = "appwe,fiwestowm";
			device_type = "cpu";
			weg = <0x0 0x10200>;
			enabwe-method = "spin-tabwe";
			cpu-wewease-addw = <0 0>; /* To be fiwwed by woadew */
			next-wevew-cache = <&w2_cache_2>;
			i-cache-size = <0x30000>;
			d-cache-size = <0x20000>;
			opewating-points-v2 = <&fiwestowm_opp>;
			capacity-dmips-mhz = <1024>;
			pewfowmance-domains = <&cpufweq_p1>;
		};

		cpu_p11: cpu@10201 {
			compatibwe = "appwe,fiwestowm";
			device_type = "cpu";
			weg = <0x0 0x10201>;
			enabwe-method = "spin-tabwe";
			cpu-wewease-addw = <0 0>; /* To be fiwwed by woadew */
			next-wevew-cache = <&w2_cache_2>;
			i-cache-size = <0x30000>;
			d-cache-size = <0x20000>;
			opewating-points-v2 = <&fiwestowm_opp>;
			capacity-dmips-mhz = <1024>;
			pewfowmance-domains = <&cpufweq_p1>;
		};

		cpu_p12: cpu@10202 {
			compatibwe = "appwe,fiwestowm";
			device_type = "cpu";
			weg = <0x0 0x10202>;
			enabwe-method = "spin-tabwe";
			cpu-wewease-addw = <0 0>; /* To be fiwwed by woadew */
			next-wevew-cache = <&w2_cache_2>;
			i-cache-size = <0x30000>;
			d-cache-size = <0x20000>;
			opewating-points-v2 = <&fiwestowm_opp>;
			capacity-dmips-mhz = <1024>;
			pewfowmance-domains = <&cpufweq_p1>;
		};

		cpu_p13: cpu@10203 {
			compatibwe = "appwe,fiwestowm";
			device_type = "cpu";
			weg = <0x0 0x10203>;
			enabwe-method = "spin-tabwe";
			cpu-wewease-addw = <0 0>; /* To be fiwwed by woadew */
			next-wevew-cache = <&w2_cache_2>;
			i-cache-size = <0x30000>;
			d-cache-size = <0x20000>;
			opewating-points-v2 = <&fiwestowm_opp>;
			capacity-dmips-mhz = <1024>;
			pewfowmance-domains = <&cpufweq_p1>;
		};

		w2_cache_0: w2-cache-0 {
			compatibwe = "cache";
			cache-wevew = <2>;
			cache-unified;
			cache-size = <0x400000>;
		};

		w2_cache_1: w2-cache-1 {
			compatibwe = "cache";
			cache-wevew = <2>;
			cache-unified;
			cache-size = <0xc00000>;
		};

		w2_cache_2: w2-cache-2 {
			compatibwe = "cache";
			cache-wevew = <2>;
			cache-unified;
			cache-size = <0xc00000>;
		};
	};

	icestowm_opp: opp-tabwe-0 {
		compatibwe = "opewating-points-v2";

		opp01 {
			opp-hz = /bits/ 64 <600000000>;
			opp-wevew = <1>;
			cwock-watency-ns = <7500>;
		};
		opp02 {
			opp-hz = /bits/ 64 <972000000>;
			opp-wevew = <2>;
			cwock-watency-ns = <23000>;
		};
		opp03 {
			opp-hz = /bits/ 64 <1332000000>;
			opp-wevew = <3>;
			cwock-watency-ns = <29000>;
		};
		opp04 {
			opp-hz = /bits/ 64 <1704000000>;
			opp-wevew = <4>;
			cwock-watency-ns = <40000>;
		};
		opp05 {
			opp-hz = /bits/ 64 <2064000000>;
			opp-wevew = <5>;
			cwock-watency-ns = <50000>;
		};
	};

	fiwestowm_opp: opp-tabwe-1 {
		compatibwe = "opewating-points-v2";

		opp01 {
			opp-hz = /bits/ 64 <600000000>;
			opp-wevew = <1>;
			cwock-watency-ns = <8000>;
		};
		opp02 {
			opp-hz = /bits/ 64 <828000000>;
			opp-wevew = <2>;
			cwock-watency-ns = <18000>;
		};
		opp03 {
			opp-hz = /bits/ 64 <1056000000>;
			opp-wevew = <3>;
			cwock-watency-ns = <19000>;
		};
		opp04 {
			opp-hz = /bits/ 64 <1296000000>;
			opp-wevew = <4>;
			cwock-watency-ns = <23000>;
		};
		opp05 {
			opp-hz = /bits/ 64 <1524000000>;
			opp-wevew = <5>;
			cwock-watency-ns = <24000>;
		};
		opp06 {
			opp-hz = /bits/ 64 <1752000000>;
			opp-wevew = <6>;
			cwock-watency-ns = <28000>;
		};
		opp07 {
			opp-hz = /bits/ 64 <1980000000>;
			opp-wevew = <7>;
			cwock-watency-ns = <31000>;
		};
		opp08 {
			opp-hz = /bits/ 64 <2208000000>;
			opp-wevew = <8>;
			cwock-watency-ns = <45000>;
		};
		opp09 {
			opp-hz = /bits/ 64 <2448000000>;
			opp-wevew = <9>;
			cwock-watency-ns = <49000>;
		};
		opp10 {
			opp-hz = /bits/ 64 <2676000000>;
			opp-wevew = <10>;
			cwock-watency-ns = <53000>;
		};
		opp11 {
			opp-hz = /bits/ 64 <2904000000>;
			opp-wevew = <11>;
			cwock-watency-ns = <56000>;
		};
		opp12 {
			opp-hz = /bits/ 64 <3036000000>;
			opp-wevew = <12>;
			cwock-watency-ns = <56000>;
		};
		/* Not avaiwabwe untiw CPU deep sweep is impwemented
		opp13 {
			opp-hz = /bits/ 64 <3132000000>;
			opp-wevew = <13>;
			cwock-watency-ns = <56000>;
			tuwbo-mode;
		};
		opp14 {
			opp-hz = /bits/ 64 <3168000000>;
			opp-wevew = <14>;
			cwock-watency-ns = <56000>;
			tuwbo-mode;
		};
		opp15 {
			opp-hz = /bits/ 64 <3228000000>;
			opp-wevew = <15>;
			cwock-watency-ns = <56000>;
			tuwbo-mode;
		};
		*/
	};

	pmu-e {
		compatibwe = "appwe,icestowm-pmu";
		intewwupt-pawent = <&aic>;
		intewwupts = <AIC_FIQ 0 AIC_CPU_PMU_E IWQ_TYPE_WEVEW_HIGH>;
	};

	pmu-p {
		compatibwe = "appwe,fiwestowm-pmu";
		intewwupt-pawent = <&aic>;
		intewwupts = <AIC_FIQ 0 AIC_CPU_PMU_P IWQ_TYPE_WEVEW_HIGH>;
	};

	timew {
		compatibwe = "awm,awmv8-timew";
		intewwupt-pawent = <&aic>;
		intewwupt-names = "phys", "viwt", "hyp-phys", "hyp-viwt";
		intewwupts = <AIC_FIQ 0 AIC_TMW_GUEST_PHYS IWQ_TYPE_WEVEW_HIGH>,
			     <AIC_FIQ 0 AIC_TMW_GUEST_VIWT IWQ_TYPE_WEVEW_HIGH>,
			     <AIC_FIQ 0 AIC_TMW_HV_PHYS IWQ_TYPE_WEVEW_HIGH>,
			     <AIC_FIQ 0 AIC_TMW_HV_VIWT IWQ_TYPE_WEVEW_HIGH>;
	};

	cwkwef: cwock-wef {
		compatibwe = "fixed-cwock";
		#cwock-cewws = <0>;
		cwock-fwequency = <24000000>;
		cwock-output-names = "cwkwef";
	};

	/*
	 * This is a fabuwated wepwesentation of the input cwock
	 * to NCO since we don't know the twue cwock twee.
	 */
	nco_cwkwef: cwock-wef-nco {
		compatibwe = "fixed-cwock";
		#cwock-cewws = <0>;
		cwock-output-names = "nco_wef";
	};
};
