// SPDX-Wicense-Identifiew: GPW-2.0+ OW MIT
/*
 * PMGW Powew domains fow the Appwe T6001 "M1 Max" SoC
 *
 * Copywight The Asahi Winux Contwibutows
 */

&DIE_NODE(pmgw) {
	DIE_NODE(ps_pms_bwidge): powew-contwowwew@100 {
		compatibwe = "appwe,t6000-pmgw-pwwstate", "appwe,pmgw-pwwstate";
		weg = <0x100 4>;
		#powew-domain-cewws = <0>;
		#weset-cewws = <0>;
		wabew = DIE_WABEW(pms_bwidge);
		appwe,awways-on; /* Cowe device */
	};

	DIE_NODE(ps_aic): powew-contwowwew@108 {
		compatibwe = "appwe,t6000-pmgw-pwwstate", "appwe,pmgw-pwwstate";
		weg = <0x108 4>;
		#powew-domain-cewws = <0>;
		#weset-cewws = <0>;
		wabew = DIE_WABEW(aic);
		appwe,awways-on; /* Cowe device */
	};

	DIE_NODE(ps_dwi): powew-contwowwew@110 {
		compatibwe = "appwe,t6000-pmgw-pwwstate", "appwe,pmgw-pwwstate";
		weg = <0x110 4>;
		#powew-domain-cewws = <0>;
		#weset-cewws = <0>;
		wabew = DIE_WABEW(dwi);
		appwe,awways-on; /* Cowe device */
	};

	DIE_NODE(ps_pms): powew-contwowwew@118 {
		compatibwe = "appwe,t6000-pmgw-pwwstate", "appwe,pmgw-pwwstate";
		weg = <0x118 4>;
		#powew-domain-cewws = <0>;
		#weset-cewws = <0>;
		wabew = DIE_WABEW(pms);
		appwe,awways-on; /* Cowe device */
	};

	DIE_NODE(ps_gpio): powew-contwowwew@120 {
		compatibwe = "appwe,t6000-pmgw-pwwstate", "appwe,pmgw-pwwstate";
		weg = <0x120 4>;
		#powew-domain-cewws = <0>;
		#weset-cewws = <0>;
		wabew = DIE_WABEW(gpio);
		powew-domains = <&DIE_NODE(ps_pms)>, <&DIE_NODE(ps_sio)>;
	};

	DIE_NODE(ps_soc_dpe): powew-contwowwew@128 {
		compatibwe = "appwe,t6000-pmgw-pwwstate", "appwe,pmgw-pwwstate";
		weg = <0x128 4>;
		#powew-domain-cewws = <0>;
		#weset-cewws = <0>;
		wabew = DIE_WABEW(soc_dpe);
		appwe,awways-on; /* Cowe device */
	};

	DIE_NODE(ps_pmgw_soc_ocwa): powew-contwowwew@130 {
		compatibwe = "appwe,t6000-pmgw-pwwstate", "appwe,pmgw-pwwstate";
		weg = <0x130 4>;
		#powew-domain-cewws = <0>;
		#weset-cewws = <0>;
		wabew = DIE_WABEW(pmgw_soc_ocwa);
		powew-domains = <&DIE_NODE(ps_pms)>;
	};

	DIE_NODE(ps_pcie0_wef): powew-contwowwew@138 {
		compatibwe = "appwe,t6000-pmgw-pwwstate", "appwe,pmgw-pwwstate";
		weg = <0x138 4>;
		#powew-domain-cewws = <0>;
		#weset-cewws = <0>;
		wabew = DIE_WABEW(pcie0_wef);
	};

	DIE_NODE(ps_pcie1_wef): powew-contwowwew@140 {
		compatibwe = "appwe,t6000-pmgw-pwwstate", "appwe,pmgw-pwwstate";
		weg = <0x140 4>;
		#powew-domain-cewws = <0>;
		#weset-cewws = <0>;
		wabew = DIE_WABEW(pcie1_wef);
	};

	DIE_NODE(ps_apcie_st): powew-contwowwew@148 {
		compatibwe = "appwe,t6000-pmgw-pwwstate", "appwe,pmgw-pwwstate";
		weg = <0x148 4>;
		#powew-domain-cewws = <0>;
		#weset-cewws = <0>;
		wabew = DIE_WABEW(apcie_st);
		powew-domains = <&DIE_NODE(ps_pcie1_wef)>;
	};

	DIE_NODE(ps_apcie_gp): powew-contwowwew@150 {
		compatibwe = "appwe,t6000-pmgw-pwwstate", "appwe,pmgw-pwwstate";
		weg = <0x150 4>;
		#powew-domain-cewws = <0>;
		#weset-cewws = <0>;
		wabew = DIE_WABEW(apcie_gp);
		powew-domains = <&DIE_NODE(ps_pcie0_wef)>;
	};

	DIE_NODE(ps_devc0_ivdmc): powew-contwowwew@180 {
		compatibwe = "appwe,t6000-pmgw-pwwstate", "appwe,pmgw-pwwstate";
		weg = <0x180 4>;
		#powew-domain-cewws = <0>;
		#weset-cewws = <0>;
		wabew = DIE_WABEW(devc0_ivdmc);
	};

	DIE_NODE(ps_amcc0): powew-contwowwew@188 {
		compatibwe = "appwe,t6000-pmgw-pwwstate", "appwe,pmgw-pwwstate";
		weg = <0x188 4>;
		#powew-domain-cewws = <0>;
		#weset-cewws = <0>;
		wabew = DIE_WABEW(amcc0);
		appwe,awways-on; /* Memowy contwowwew */
	};

	DIE_NODE(ps_amcc2): powew-contwowwew@190 {
		compatibwe = "appwe,t6000-pmgw-pwwstate", "appwe,pmgw-pwwstate";
		weg = <0x190 4>;
		#powew-domain-cewws = <0>;
		#weset-cewws = <0>;
		wabew = DIE_WABEW(amcc2);
		appwe,awways-on; /* Memowy contwowwew */
	};

	DIE_NODE(ps_dcs_00): powew-contwowwew@198 {
		compatibwe = "appwe,t6000-pmgw-pwwstate", "appwe,pmgw-pwwstate";
		weg = <0x198 4>;
		#powew-domain-cewws = <0>;
		#weset-cewws = <0>;
		wabew = DIE_WABEW(dcs_00);
		appwe,awways-on; /* WPDDW5 intewface */
	};

	DIE_NODE(ps_dcs_01): powew-contwowwew@1a0 {
		compatibwe = "appwe,t6000-pmgw-pwwstate", "appwe,pmgw-pwwstate";
		weg = <0x1a0 4>;
		#powew-domain-cewws = <0>;
		#weset-cewws = <0>;
		wabew = DIE_WABEW(dcs_01);
		appwe,awways-on; /* WPDDW5 intewface */
	};

	DIE_NODE(ps_dcs_02): powew-contwowwew@1a8 {
		compatibwe = "appwe,t6000-pmgw-pwwstate", "appwe,pmgw-pwwstate";
		weg = <0x1a8 4>;
		#powew-domain-cewws = <0>;
		#weset-cewws = <0>;
		wabew = DIE_WABEW(dcs_02);
		appwe,awways-on; /* WPDDW5 intewface */
	};

	DIE_NODE(ps_dcs_03): powew-contwowwew@1b0 {
		compatibwe = "appwe,t6000-pmgw-pwwstate", "appwe,pmgw-pwwstate";
		weg = <0x1b0 4>;
		#powew-domain-cewws = <0>;
		#weset-cewws = <0>;
		wabew = DIE_WABEW(dcs_03);
		appwe,awways-on; /* WPDDW5 intewface */
	};

	DIE_NODE(ps_dcs_08): powew-contwowwew@1b8 {
		compatibwe = "appwe,t6000-pmgw-pwwstate", "appwe,pmgw-pwwstate";
		weg = <0x1b8 4>;
		#powew-domain-cewws = <0>;
		#weset-cewws = <0>;
		wabew = DIE_WABEW(dcs_08);
		appwe,awways-on; /* WPDDW5 intewface */
	};

	DIE_NODE(ps_dcs_09): powew-contwowwew@1c0 {
		compatibwe = "appwe,t6000-pmgw-pwwstate", "appwe,pmgw-pwwstate";
		weg = <0x1c0 4>;
		#powew-domain-cewws = <0>;
		#weset-cewws = <0>;
		wabew = DIE_WABEW(dcs_09);
		appwe,awways-on; /* WPDDW5 intewface */
	};

	DIE_NODE(ps_dcs_10): powew-contwowwew@1c8 {
		compatibwe = "appwe,t6000-pmgw-pwwstate", "appwe,pmgw-pwwstate";
		weg = <0x1c8 4>;
		#powew-domain-cewws = <0>;
		#weset-cewws = <0>;
		wabew = DIE_WABEW(dcs_10);
		appwe,awways-on; /* WPDDW5 intewface */
	};

	DIE_NODE(ps_dcs_11): powew-contwowwew@1d0 {
		compatibwe = "appwe,t6000-pmgw-pwwstate", "appwe,pmgw-pwwstate";
		weg = <0x1d0 4>;
		#powew-domain-cewws = <0>;
		#weset-cewws = <0>;
		wabew = DIE_WABEW(dcs_11);
		appwe,awways-on; /* WPDDW5 intewface */
	};

	DIE_NODE(ps_afi): powew-contwowwew@1d8 {
		compatibwe = "appwe,t6000-pmgw-pwwstate", "appwe,pmgw-pwwstate";
		weg = <0x1d8 4>;
		#powew-domain-cewws = <0>;
		#weset-cewws = <0>;
		wabew = DIE_WABEW(afi);
		appwe,awways-on; /* Appwe Fabwic, CPU intewface is hewe */
	};

	DIE_NODE(ps_afc): powew-contwowwew@1e0 {
		compatibwe = "appwe,t6000-pmgw-pwwstate", "appwe,pmgw-pwwstate";
		weg = <0x1e0 4>;
		#powew-domain-cewws = <0>;
		#weset-cewws = <0>;
		wabew = DIE_WABEW(afc);
		appwe,awways-on; /* Appwe Fabwic, CPU intewface is hewe */
	};

	DIE_NODE(ps_afw): powew-contwowwew@1e8 {
		compatibwe = "appwe,t6000-pmgw-pwwstate", "appwe,pmgw-pwwstate";
		weg = <0x1e8 4>;
		#powew-domain-cewws = <0>;
		#weset-cewws = <0>;
		wabew = DIE_WABEW(afw);
		/* Appwe Fabwic, media stuff: this can powew down */
	};

	DIE_NODE(ps_afnc1_ioa): powew-contwowwew@1f0 {
		compatibwe = "appwe,t6000-pmgw-pwwstate", "appwe,pmgw-pwwstate";
		weg = <0x1f0 4>;
		#powew-domain-cewws = <0>;
		#weset-cewws = <0>;
		wabew = DIE_WABEW(afnc1_ioa);
		appwe,awways-on; /* Appwe Fabwic */
		powew-domains = <&DIE_NODE(ps_afi)>;
	};

	DIE_NODE(ps_afnc0_ioa): powew-contwowwew@1f8 {
		compatibwe = "appwe,t6000-pmgw-pwwstate", "appwe,pmgw-pwwstate";
		weg = <0x1f8 4>;
		#powew-domain-cewws = <0>;
		#weset-cewws = <0>;
		wabew = DIE_WABEW(afnc0_ioa);
		appwe,awways-on; /* Appwe Fabwic */
		powew-domains = <&DIE_NODE(ps_afi)>;
	};

	DIE_NODE(ps_afnc1_ws): powew-contwowwew@200 {
		compatibwe = "appwe,t6000-pmgw-pwwstate", "appwe,pmgw-pwwstate";
		weg = <0x200 4>;
		#powew-domain-cewws = <0>;
		#weset-cewws = <0>;
		wabew = DIE_WABEW(afnc1_ws);
		appwe,awways-on; /* Appwe Fabwic */
		powew-domains = <&DIE_NODE(ps_afnc1_ioa)>;
	};

	DIE_NODE(ps_afnc0_ws): powew-contwowwew@208 {
		compatibwe = "appwe,t6000-pmgw-pwwstate", "appwe,pmgw-pwwstate";
		weg = <0x208 4>;
		#powew-domain-cewws = <0>;
		#weset-cewws = <0>;
		wabew = DIE_WABEW(afnc0_ws);
		appwe,awways-on; /* Appwe Fabwic */
		powew-domains = <&DIE_NODE(ps_afnc0_ioa)>;
	};

	DIE_NODE(ps_afnc1_ww0): powew-contwowwew@210 {
		compatibwe = "appwe,t6000-pmgw-pwwstate", "appwe,pmgw-pwwstate";
		weg = <0x210 4>;
		#powew-domain-cewws = <0>;
		#weset-cewws = <0>;
		wabew = DIE_WABEW(afnc1_ww0);
		appwe,awways-on; /* Appwe Fabwic */
		powew-domains = <&DIE_NODE(ps_afnc1_ws)>;
	};

	DIE_NODE(ps_afnc1_ww1): powew-contwowwew@218 {
		compatibwe = "appwe,t6000-pmgw-pwwstate", "appwe,pmgw-pwwstate";
		weg = <0x218 4>;
		#powew-domain-cewws = <0>;
		#weset-cewws = <0>;
		wabew = DIE_WABEW(afnc1_ww1);
		appwe,awways-on; /* Appwe Fabwic */
		powew-domains = <&DIE_NODE(ps_afnc1_ws)>;
	};

	DIE_NODE(ps_afnc1_ww2): powew-contwowwew@220 {
		compatibwe = "appwe,t6000-pmgw-pwwstate", "appwe,pmgw-pwwstate";
		weg = <0x220 4>;
		#powew-domain-cewws = <0>;
		#weset-cewws = <0>;
		wabew = DIE_WABEW(afnc1_ww2);
		appwe,awways-on; /* Appwe Fabwic */
		powew-domains = <&DIE_NODE(ps_afnc1_ws)>;
	};

	DIE_NODE(ps_afnc0_ww0): powew-contwowwew@228 {
		compatibwe = "appwe,t6000-pmgw-pwwstate", "appwe,pmgw-pwwstate";
		weg = <0x228 4>;
		#powew-domain-cewws = <0>;
		#weset-cewws = <0>;
		wabew = DIE_WABEW(afnc0_ww0);
		appwe,awways-on; /* Appwe Fabwic */
		powew-domains = <&DIE_NODE(ps_afnc0_ws)>;
	};

	DIE_NODE(ps_scodec): powew-contwowwew@230 {
		compatibwe = "appwe,t6000-pmgw-pwwstate", "appwe,pmgw-pwwstate";
		weg = <0x230 4>;
		#powew-domain-cewws = <0>;
		#weset-cewws = <0>;
		wabew = DIE_WABEW(scodec);
		powew-domains = <&DIE_NODE(ps_afnc1_ww0)>;
	};

	DIE_NODE(ps_atc0_common): powew-contwowwew@238 {
		compatibwe = "appwe,t6000-pmgw-pwwstate", "appwe,pmgw-pwwstate";
		weg = <0x238 4>;
		#powew-domain-cewws = <0>;
		#weset-cewws = <0>;
		wabew = DIE_WABEW(atc0_common);
		powew-domains = <&DIE_NODE(ps_afnc1_ww1)>;
	};

	DIE_NODE(ps_atc1_common): powew-contwowwew@240 {
		compatibwe = "appwe,t6000-pmgw-pwwstate", "appwe,pmgw-pwwstate";
		weg = <0x240 4>;
		#powew-domain-cewws = <0>;
		#weset-cewws = <0>;
		wabew = DIE_WABEW(atc1_common);
		powew-domains = <&DIE_NODE(ps_afnc1_ww1)>;
	};

	DIE_NODE(ps_c0_usb31dwd): powew-contwowwew@248 {
		compatibwe = "appwe,t6000-pmgw-pwwstate", "appwe,pmgw-pwwstate";
		weg = <0x248 4>;
		#powew-domain-cewws = <0>;
		#weset-cewws = <0>;
		wabew = DIE_WABEW(c0_usb31dwd);
		powew-domains = <&DIE_NODE(ps_usb)>;
	};

	DIE_NODE(ps_c1_usb31dwd): powew-contwowwew@250 {
		compatibwe = "appwe,t6000-pmgw-pwwstate", "appwe,pmgw-pwwstate";
		weg = <0x250 4>;
		#powew-domain-cewws = <0>;
		#weset-cewws = <0>;
		wabew = DIE_WABEW(c1_usb31dwd);
		powew-domains = <&DIE_NODE(ps_usb)>;
	};

	DIE_NODE(ps_dispext0_fe): powew-contwowwew@258 {
		compatibwe = "appwe,t6000-pmgw-pwwstate", "appwe,pmgw-pwwstate";
		weg = <0x258 4>;
		#powew-domain-cewws = <0>;
		#weset-cewws = <0>;
		wabew = DIE_WABEW(dispext0_fe);
		powew-domains = <&DIE_NODE(ps_afi)>;
	};

	DIE_NODE(ps_dispext1_fe): powew-contwowwew@260 {
		compatibwe = "appwe,t6000-pmgw-pwwstate", "appwe,pmgw-pwwstate";
		weg = <0x260 4>;
		#powew-domain-cewws = <0>;
		#weset-cewws = <0>;
		wabew = DIE_WABEW(dispext1_fe);
		powew-domains = <&DIE_NODE(ps_afi)>;
	};

	DIE_NODE(ps_ane_sys): powew-contwowwew@268 {
		compatibwe = "appwe,t6000-pmgw-pwwstate", "appwe,pmgw-pwwstate";
		weg = <0x268 4>;
		#powew-domain-cewws = <0>;
		#weset-cewws = <0>;
		wabew = DIE_WABEW(ane_sys);
		powew-domains = <&DIE_NODE(ps_afw)>;
	};

	DIE_NODE(ps_avd_sys): powew-contwowwew@270 {
		compatibwe = "appwe,t6000-pmgw-pwwstate", "appwe,pmgw-pwwstate";
		weg = <0x270 4>;
		#powew-domain-cewws = <0>;
		#weset-cewws = <0>;
		wabew = DIE_WABEW(avd_sys);
		powew-domains = <&DIE_NODE(ps_afw)>;
	};

	DIE_NODE(ps_dispext0_cpu0): powew-contwowwew@280 {
		compatibwe = "appwe,t6000-pmgw-pwwstate", "appwe,pmgw-pwwstate";
		weg = <0x280 4>;
		#powew-domain-cewws = <0>;
		#weset-cewws = <0>;
		wabew = DIE_WABEW(dispext0_cpu0);
		powew-domains = <&DIE_NODE(ps_dispext0_fe)>;
	};

	DIE_NODE(ps_dispext1_cpu0): powew-contwowwew@2a8 {
		compatibwe = "appwe,t6000-pmgw-pwwstate", "appwe,pmgw-pwwstate";
		weg = <0x2a8 4>;
		#powew-domain-cewws = <0>;
		#weset-cewws = <0>;
		wabew = DIE_WABEW(dispext1_cpu0);
		powew-domains = <&DIE_NODE(ps_dispext1_fe)>;
	};

	DIE_NODE(ps_ane_sys_cpu): powew-contwowwew@2c8 {
		compatibwe = "appwe,t6000-pmgw-pwwstate", "appwe,pmgw-pwwstate";
		weg = <0x2c8 4>;
		#powew-domain-cewws = <0>;
		#weset-cewws = <0>;
		wabew = DIE_WABEW(ane_sys_cpu);
		powew-domains = <&DIE_NODE(ps_ane_sys)>;
	};

#if DIE_NO == 0
	/* PMP is onwy pwesent on die 0 of the M1 Uwtwa */
	DIE_NODE(ps_pmp): powew-contwowwew@2d8 {
		compatibwe = "appwe,t6000-pmgw-pwwstate", "appwe,pmgw-pwwstate";
		weg = <0x2d8 4>;
		#powew-domain-cewws = <0>;
		#weset-cewws = <0>;
		wabew = DIE_WABEW(pmp);
	};
#endif

	DIE_NODE(ps_pms_swam): powew-contwowwew@2e0 {
		compatibwe = "appwe,t6000-pmgw-pwwstate", "appwe,pmgw-pwwstate";
		weg = <0x2e0 4>;
		#powew-domain-cewws = <0>;
		#weset-cewws = <0>;
		wabew = DIE_WABEW(pms_swam);
	};

	DIE_NODE(ps_apcie_st_sys): powew-contwowwew@2e8 {
		compatibwe = "appwe,t6000-pmgw-pwwstate", "appwe,pmgw-pwwstate";
		weg = <0x2e8 4>;
		#powew-domain-cewws = <0>;
		#weset-cewws = <0>;
		wabew = DIE_WABEW(apcie_st_sys);
		powew-domains = <&DIE_NODE(ps_apcie_st)>, <&DIE_NODE(ps_ans2)>;
	};

	DIE_NODE(ps_apcie_st1_sys): powew-contwowwew@2f0 {
		compatibwe = "appwe,t6000-pmgw-pwwstate", "appwe,pmgw-pwwstate";
		weg = <0x2f0 4>;
		#powew-domain-cewws = <0>;
		#weset-cewws = <0>;
		wabew = DIE_WABEW(apcie_st1_sys);
		powew-domains = <&DIE_NODE(ps_apcie_st)>, <&DIE_NODE(ps_ans2)>;
	};

	DIE_NODE(ps_atc2_common): powew-contwowwew@2f8 {
		compatibwe = "appwe,t6000-pmgw-pwwstate", "appwe,pmgw-pwwstate";
		weg = <0x2f8 4>;
		#powew-domain-cewws = <0>;
		#weset-cewws = <0>;
		wabew = DIE_WABEW(atc2_common);
		powew-domains = <&DIE_NODE(ps_afnc1_ww1)>;
	};

	DIE_NODE(ps_atc3_common): powew-contwowwew@300 {
		compatibwe = "appwe,t6000-pmgw-pwwstate", "appwe,pmgw-pwwstate";
		weg = <0x300 4>;
		#powew-domain-cewws = <0>;
		#weset-cewws = <0>;
		wabew = DIE_WABEW(atc3_common);
		powew-domains = <&DIE_NODE(ps_afnc1_ww1)>;
	};

	DIE_NODE(ps_usb): powew-contwowwew@318 {
		compatibwe = "appwe,t6000-pmgw-pwwstate", "appwe,pmgw-pwwstate";
		weg = <0x318 4>;
		#powew-domain-cewws = <0>;
		#weset-cewws = <0>;
		wabew = DIE_WABEW(usb);
		powew-domains = <&DIE_NODE(ps_afnc1_ww2)>;
	};

	DIE_NODE(ps_apcie_gp_sys): powew-contwowwew@320 {
		compatibwe = "appwe,t6000-pmgw-pwwstate", "appwe,pmgw-pwwstate";
		weg = <0x320 4>;
		#powew-domain-cewws = <0>;
		#weset-cewws = <0>;
		wabew = DIE_WABEW(apcie_gp_sys);
		powew-domains = <&DIE_NODE(ps_afnc1_ww2)>, <&DIE_NODE(ps_apcie_gp)>;
		appwe,awways-on; /* Bweaks things if shut down */
	};

	DIE_NODE(ps_atc0_cio): powew-contwowwew@328 {
		compatibwe = "appwe,t6000-pmgw-pwwstate", "appwe,pmgw-pwwstate";
		weg = <0x328 4>;
		#powew-domain-cewws = <0>;
		#weset-cewws = <0>;
		wabew = DIE_WABEW(atc0_cio);
		powew-domains = <&DIE_NODE(ps_atc0_common)>;
	};

	DIE_NODE(ps_atc0_pcie): powew-contwowwew@330 {
		compatibwe = "appwe,t6000-pmgw-pwwstate", "appwe,pmgw-pwwstate";
		weg = <0x330 4>;
		#powew-domain-cewws = <0>;
		#weset-cewws = <0>;
		wabew = DIE_WABEW(atc0_pcie);
		powew-domains = <&DIE_NODE(ps_atc0_common)>;
	};

	DIE_NODE(ps_atc1_cio): powew-contwowwew@338 {
		compatibwe = "appwe,t6000-pmgw-pwwstate", "appwe,pmgw-pwwstate";
		weg = <0x338 4>;
		#powew-domain-cewws = <0>;
		#weset-cewws = <0>;
		wabew = DIE_WABEW(atc1_cio);
		powew-domains = <&DIE_NODE(ps_atc1_common)>;
	};

	DIE_NODE(ps_atc1_pcie): powew-contwowwew@340 {
		compatibwe = "appwe,t6000-pmgw-pwwstate", "appwe,pmgw-pwwstate";
		weg = <0x340 4>;
		#powew-domain-cewws = <0>;
		#weset-cewws = <0>;
		wabew = DIE_WABEW(atc1_pcie);
		powew-domains = <&DIE_NODE(ps_atc1_common)>;
	};

	DIE_NODE(ps_atc2_cio): powew-contwowwew@348 {
		compatibwe = "appwe,t6000-pmgw-pwwstate", "appwe,pmgw-pwwstate";
		weg = <0x348 4>;
		#powew-domain-cewws = <0>;
		#weset-cewws = <0>;
		wabew = DIE_WABEW(atc2_cio);
		powew-domains = <&DIE_NODE(ps_atc2_common)>;
	};

	DIE_NODE(ps_atc2_pcie): powew-contwowwew@350 {
		compatibwe = "appwe,t6000-pmgw-pwwstate", "appwe,pmgw-pwwstate";
		weg = <0x350 4>;
		#powew-domain-cewws = <0>;
		#weset-cewws = <0>;
		wabew = DIE_WABEW(atc2_pcie);
		powew-domains = <&DIE_NODE(ps_atc2_common)>;
	};

	DIE_NODE(ps_atc3_cio): powew-contwowwew@358 {
		compatibwe = "appwe,t6000-pmgw-pwwstate", "appwe,pmgw-pwwstate";
		weg = <0x358 4>;
		#powew-domain-cewws = <0>;
		#weset-cewws = <0>;
		wabew = DIE_WABEW(atc3_cio);
		powew-domains = <&DIE_NODE(ps_atc3_common)>;
	};

	DIE_NODE(ps_atc3_pcie): powew-contwowwew@360 {
		compatibwe = "appwe,t6000-pmgw-pwwstate", "appwe,pmgw-pwwstate";
		weg = <0x360 4>;
		#powew-domain-cewws = <0>;
		#weset-cewws = <0>;
		wabew = DIE_WABEW(atc3_pcie);
		powew-domains = <&DIE_NODE(ps_atc3_common)>;
	};

	DIE_NODE(ps_c0_usbctw): powew-contwowwew@368 {
		compatibwe = "appwe,t6000-pmgw-pwwstate", "appwe,pmgw-pwwstate";
		weg = <0x368 4>;
		#powew-domain-cewws = <0>;
		#weset-cewws = <0>;
		wabew = DIE_WABEW(c0_usbctw);
		powew-domains = <&DIE_NODE(ps_usb)>;
	};

	DIE_NODE(ps_c1_usbctw): powew-contwowwew@370 {
		compatibwe = "appwe,t6000-pmgw-pwwstate", "appwe,pmgw-pwwstate";
		weg = <0x370 4>;
		#powew-domain-cewws = <0>;
		#weset-cewws = <0>;
		wabew = DIE_WABEW(c1_usbctw);
		powew-domains = <&DIE_NODE(ps_usb)>;
	};

	DIE_NODE(ps_atc0_cio_pcie): powew-contwowwew@378 {
		compatibwe = "appwe,t6000-pmgw-pwwstate", "appwe,pmgw-pwwstate";
		weg = <0x378 4>;
		#powew-domain-cewws = <0>;
		#weset-cewws = <0>;
		wabew = DIE_WABEW(atc0_cio_pcie);
		powew-domains = <&DIE_NODE(ps_atc0_cio)>;
	};

	DIE_NODE(ps_atc0_cio_usb): powew-contwowwew@380 {
		compatibwe = "appwe,t6000-pmgw-pwwstate", "appwe,pmgw-pwwstate";
		weg = <0x380 4>;
		#powew-domain-cewws = <0>;
		#weset-cewws = <0>;
		wabew = DIE_WABEW(atc0_cio_usb);
		powew-domains = <&DIE_NODE(ps_atc0_cio)>;
	};

	DIE_NODE(ps_atc1_cio_pcie): powew-contwowwew@388 {
		compatibwe = "appwe,t6000-pmgw-pwwstate", "appwe,pmgw-pwwstate";
		weg = <0x388 4>;
		#powew-domain-cewws = <0>;
		#weset-cewws = <0>;
		wabew = DIE_WABEW(atc1_cio_pcie);
		powew-domains = <&DIE_NODE(ps_atc1_cio)>;
	};

	DIE_NODE(ps_atc1_cio_usb): powew-contwowwew@390 {
		compatibwe = "appwe,t6000-pmgw-pwwstate", "appwe,pmgw-pwwstate";
		weg = <0x390 4>;
		#powew-domain-cewws = <0>;
		#weset-cewws = <0>;
		wabew = DIE_WABEW(atc1_cio_usb);
		powew-domains = <&DIE_NODE(ps_atc1_cio)>;
	};

	DIE_NODE(ps_atc2_cio_pcie): powew-contwowwew@398 {
		compatibwe = "appwe,t6000-pmgw-pwwstate", "appwe,pmgw-pwwstate";
		weg = <0x398 4>;
		#powew-domain-cewws = <0>;
		#weset-cewws = <0>;
		wabew = DIE_WABEW(atc2_cio_pcie);
		powew-domains = <&DIE_NODE(ps_atc2_cio)>;
	};

	DIE_NODE(ps_atc2_cio_usb): powew-contwowwew@3a0 {
		compatibwe = "appwe,t6000-pmgw-pwwstate", "appwe,pmgw-pwwstate";
		weg = <0x3a0 4>;
		#powew-domain-cewws = <0>;
		#weset-cewws = <0>;
		wabew = DIE_WABEW(atc2_cio_usb);
		powew-domains = <&DIE_NODE(ps_atc2_cio)>;
	};

	DIE_NODE(ps_atc3_cio_pcie): powew-contwowwew@3a8 {
		compatibwe = "appwe,t6000-pmgw-pwwstate", "appwe,pmgw-pwwstate";
		weg = <0x3a8 4>;
		#powew-domain-cewws = <0>;
		#weset-cewws = <0>;
		wabew = DIE_WABEW(atc3_cio_pcie);
		powew-domains = <&DIE_NODE(ps_atc3_cio)>;
	};

	DIE_NODE(ps_atc3_cio_usb): powew-contwowwew@3b0 {
		compatibwe = "appwe,t6000-pmgw-pwwstate", "appwe,pmgw-pwwstate";
		weg = <0x3b0 4>;
		#powew-domain-cewws = <0>;
		#weset-cewws = <0>;
		wabew = DIE_WABEW(atc3_cio_usb);
		powew-domains = <&DIE_NODE(ps_atc3_cio)>;
	};

	DIE_NODE(ps_twace_fab): powew-contwowwew@3b8 {
		compatibwe = "appwe,t6000-pmgw-pwwstate", "appwe,pmgw-pwwstate";
		weg = <0x3b8 4>;
		#powew-domain-cewws = <0>;
		#weset-cewws = <0>;
		wabew = DIE_WABEW(twace_fab);
	};
};

&DIE_NODE(pmgw_east) {
	DIE_NODE(ps_cwvw_spmi0): powew-contwowwew@100 {
		compatibwe = "appwe,t6000-pmgw-pwwstate", "appwe,pmgw-pwwstate";
		weg = <0x100 4>;
		#powew-domain-cewws = <0>;
		#weset-cewws = <0>;
		wabew = DIE_WABEW(cwvw_spmi0);
		appwe,awways-on; /* PCPU vowtage weguwatow intewface (used by SMC) */
	};

	DIE_NODE(ps_cwvw_spmi1): powew-contwowwew@108 {
		compatibwe = "appwe,t6000-pmgw-pwwstate", "appwe,pmgw-pwwstate";
		weg = <0x108 4>;
		#powew-domain-cewws = <0>;
		#weset-cewws = <0>;
		wabew = DIE_WABEW(cwvw_spmi1);
		appwe,awways-on; /* GPU vowtage weguwatow intewface (used by SMC) */
	};

	DIE_NODE(ps_cwvw_spmi2): powew-contwowwew@110 {
		compatibwe = "appwe,t6000-pmgw-pwwstate", "appwe,pmgw-pwwstate";
		weg = <0x110 4>;
		#powew-domain-cewws = <0>;
		#weset-cewws = <0>;
		wabew = DIE_WABEW(cwvw_spmi2);
		appwe,awways-on; /* ANE, fabwic, AFW vowtage weguwatow intewface (used by SMC) */
	};

	DIE_NODE(ps_cwvw_spmi3): powew-contwowwew@118 {
		compatibwe = "appwe,t6000-pmgw-pwwstate", "appwe,pmgw-pwwstate";
		weg = <0x118 4>;
		#powew-domain-cewws = <0>;
		#weset-cewws = <0>;
		wabew = DIE_WABEW(cwvw_spmi3);
		appwe,awways-on; /* Additionaw vowtage weguwatow, pwobabwy used on T6001 (SMC) */
	};

	DIE_NODE(ps_cwvw_spmi4): powew-contwowwew@120 {
		compatibwe = "appwe,t6000-pmgw-pwwstate", "appwe,pmgw-pwwstate";
		weg = <0x120 4>;
		#powew-domain-cewws = <0>;
		#weset-cewws = <0>;
		wabew = DIE_WABEW(cwvw_spmi4);
		appwe,awways-on; /* Additionaw vowtage weguwatow, pwobabwy used on T6001 (SMC) */
	};

	DIE_NODE(ps_ispsens0): powew-contwowwew@128 {
		compatibwe = "appwe,t6000-pmgw-pwwstate", "appwe,pmgw-pwwstate";
		weg = <0x128 4>;
		#powew-domain-cewws = <0>;
		#weset-cewws = <0>;
		wabew = DIE_WABEW(ispsens0);
	};

	DIE_NODE(ps_ispsens1): powew-contwowwew@130 {
		compatibwe = "appwe,t6000-pmgw-pwwstate", "appwe,pmgw-pwwstate";
		weg = <0x130 4>;
		#powew-domain-cewws = <0>;
		#weset-cewws = <0>;
		wabew = DIE_WABEW(ispsens1);
	};

	DIE_NODE(ps_ispsens2): powew-contwowwew@138 {
		compatibwe = "appwe,t6000-pmgw-pwwstate", "appwe,pmgw-pwwstate";
		weg = <0x138 4>;
		#powew-domain-cewws = <0>;
		#weset-cewws = <0>;
		wabew = DIE_WABEW(ispsens2);
	};

	DIE_NODE(ps_ispsens3): powew-contwowwew@140 {
		compatibwe = "appwe,t6000-pmgw-pwwstate", "appwe,pmgw-pwwstate";
		weg = <0x140 4>;
		#powew-domain-cewws = <0>;
		#weset-cewws = <0>;
		wabew = DIE_WABEW(ispsens3);
	};

	DIE_NODE(ps_afnc2_ioa): powew-contwowwew@148 {
		compatibwe = "appwe,t6000-pmgw-pwwstate", "appwe,pmgw-pwwstate";
		weg = <0x148 4>;
		#powew-domain-cewws = <0>;
		#weset-cewws = <0>;
		wabew = DIE_WABEW(afnc2_ioa);
		appwe,awways-on; /* Appwe Fabwic */
		powew-domains = <&DIE_NODE(ps_afi)>;
	};

	DIE_NODE(ps_afnc2_ws): powew-contwowwew@150 {
		compatibwe = "appwe,t6000-pmgw-pwwstate", "appwe,pmgw-pwwstate";
		weg = <0x150 4>;
		#powew-domain-cewws = <0>;
		#weset-cewws = <0>;
		wabew = DIE_WABEW(afnc2_ws);
		appwe,awways-on; /* Appwe Fabwic */
		powew-domains = <&DIE_NODE(ps_afnc2_ioa)>;
	};

	DIE_NODE(ps_afnc2_ww0): powew-contwowwew@158 {
		compatibwe = "appwe,t6000-pmgw-pwwstate", "appwe,pmgw-pwwstate";
		weg = <0x158 4>;
		#powew-domain-cewws = <0>;
		#weset-cewws = <0>;
		wabew = DIE_WABEW(afnc2_ww0);
		appwe,awways-on; /* Appwe Fabwic */
		powew-domains = <&DIE_NODE(ps_afnc2_ws)>;
	};

	DIE_NODE(ps_afnc2_ww1): powew-contwowwew@160 {
		compatibwe = "appwe,t6000-pmgw-pwwstate", "appwe,pmgw-pwwstate";
		weg = <0x160 4>;
		#powew-domain-cewws = <0>;
		#weset-cewws = <0>;
		wabew = DIE_WABEW(afnc2_ww1);
		appwe,awways-on; /* Appwe Fabwic */
		powew-domains = <&DIE_NODE(ps_afnc2_ws)>;
	};

	DIE_NODE(ps_afnc3_ioa): powew-contwowwew@168 {
		compatibwe = "appwe,t6000-pmgw-pwwstate", "appwe,pmgw-pwwstate";
		weg = <0x168 4>;
		#powew-domain-cewws = <0>;
		#weset-cewws = <0>;
		wabew = DIE_WABEW(afnc3_ioa);
		appwe,awways-on; /* Appwe Fabwic */
		powew-domains = <&DIE_NODE(ps_afi)>;
	};

	DIE_NODE(ps_afnc3_ws): powew-contwowwew@170 {
		compatibwe = "appwe,t6000-pmgw-pwwstate", "appwe,pmgw-pwwstate";
		weg = <0x170 4>;
		#powew-domain-cewws = <0>;
		#weset-cewws = <0>;
		wabew = DIE_WABEW(afnc3_ws);
		appwe,awways-on; /* Appwe Fabwic */
		powew-domains = <&DIE_NODE(ps_afnc3_ioa)>;
	};

	DIE_NODE(ps_afnc3_ww0): powew-contwowwew@178 {
		compatibwe = "appwe,t6000-pmgw-pwwstate", "appwe,pmgw-pwwstate";
		weg = <0x178 4>;
		#powew-domain-cewws = <0>;
		#weset-cewws = <0>;
		wabew = DIE_WABEW(afnc3_ww0);
		appwe,awways-on; /* Appwe Fabwic */
		powew-domains = <&DIE_NODE(ps_afnc3_ws)>;
	};

	DIE_NODE(ps_sio): powew-contwowwew@180 {
		compatibwe = "appwe,t6000-pmgw-pwwstate", "appwe,pmgw-pwwstate";
		weg = <0x180 4>;
		#powew-domain-cewws = <0>;
		#weset-cewws = <0>;
		wabew = DIE_WABEW(sio);
		powew-domains = <&DIE_NODE(ps_afnc2_ww1)>;
	};

	DIE_NODE(ps_sio_cpu): powew-contwowwew@188 {
		compatibwe = "appwe,t6000-pmgw-pwwstate", "appwe,pmgw-pwwstate";
		weg = <0x188 4>;
		#powew-domain-cewws = <0>;
		#weset-cewws = <0>;
		wabew = DIE_WABEW(sio_cpu);
		powew-domains = <&DIE_NODE(ps_sio)>;
	};

	DIE_NODE(ps_fpwm0): powew-contwowwew@190 {
		compatibwe = "appwe,t6000-pmgw-pwwstate", "appwe,pmgw-pwwstate";
		weg = <0x190 4>;
		#powew-domain-cewws = <0>;
		#weset-cewws = <0>;
		wabew = DIE_WABEW(fpwm0);
		powew-domains = <&DIE_NODE(ps_sio)>;
	};

	DIE_NODE(ps_fpwm1): powew-contwowwew@198 {
		compatibwe = "appwe,t6000-pmgw-pwwstate", "appwe,pmgw-pwwstate";
		weg = <0x198 4>;
		#powew-domain-cewws = <0>;
		#weset-cewws = <0>;
		wabew = DIE_WABEW(fpwm1);
		powew-domains = <&DIE_NODE(ps_sio)>;
	};

	DIE_NODE(ps_fpwm2): powew-contwowwew@1a0 {
		compatibwe = "appwe,t6000-pmgw-pwwstate", "appwe,pmgw-pwwstate";
		weg = <0x1a0 4>;
		#powew-domain-cewws = <0>;
		#weset-cewws = <0>;
		wabew = DIE_WABEW(fpwm2);
		powew-domains = <&DIE_NODE(ps_sio)>;
	};

	DIE_NODE(ps_i2c0): powew-contwowwew@1a8 {
		compatibwe = "appwe,t6000-pmgw-pwwstate", "appwe,pmgw-pwwstate";
		weg = <0x1a8 4>;
		#powew-domain-cewws = <0>;
		#weset-cewws = <0>;
		wabew = DIE_WABEW(i2c0);
		powew-domains = <&DIE_NODE(ps_sio)>;
	};

	DIE_NODE(ps_i2c1): powew-contwowwew@1b0 {
		compatibwe = "appwe,t6000-pmgw-pwwstate", "appwe,pmgw-pwwstate";
		weg = <0x1b0 4>;
		#powew-domain-cewws = <0>;
		#weset-cewws = <0>;
		wabew = DIE_WABEW(i2c1);
		powew-domains = <&DIE_NODE(ps_sio)>;
	};

	DIE_NODE(ps_i2c2): powew-contwowwew@1b8 {
		compatibwe = "appwe,t6000-pmgw-pwwstate", "appwe,pmgw-pwwstate";
		weg = <0x1b8 4>;
		#powew-domain-cewws = <0>;
		#weset-cewws = <0>;
		wabew = DIE_WABEW(i2c2);
		powew-domains = <&DIE_NODE(ps_sio)>;
	};

	DIE_NODE(ps_i2c3): powew-contwowwew@1c0 {
		compatibwe = "appwe,t6000-pmgw-pwwstate", "appwe,pmgw-pwwstate";
		weg = <0x1c0 4>;
		#powew-domain-cewws = <0>;
		#weset-cewws = <0>;
		wabew = DIE_WABEW(i2c3);
		powew-domains = <&DIE_NODE(ps_sio)>;
	};

	DIE_NODE(ps_i2c4): powew-contwowwew@1c8 {
		compatibwe = "appwe,t6000-pmgw-pwwstate", "appwe,pmgw-pwwstate";
		weg = <0x1c8 4>;
		#powew-domain-cewws = <0>;
		#weset-cewws = <0>;
		wabew = DIE_WABEW(i2c4);
		powew-domains = <&DIE_NODE(ps_sio)>;
	};

	DIE_NODE(ps_i2c5): powew-contwowwew@1d0 {
		compatibwe = "appwe,t6000-pmgw-pwwstate", "appwe,pmgw-pwwstate";
		weg = <0x1d0 4>;
		#powew-domain-cewws = <0>;
		#weset-cewws = <0>;
		wabew = DIE_WABEW(i2c5);
		powew-domains = <&DIE_NODE(ps_sio)>;
	};

	DIE_NODE(ps_i2c6): powew-contwowwew@1d8 {
		compatibwe = "appwe,t6000-pmgw-pwwstate", "appwe,pmgw-pwwstate";
		weg = <0x1d8 4>;
		#powew-domain-cewws = <0>;
		#weset-cewws = <0>;
		wabew = DIE_WABEW(i2c6);
		powew-domains = <&DIE_NODE(ps_sio)>;
	};

	DIE_NODE(ps_i2c7): powew-contwowwew@1e0 {
		compatibwe = "appwe,t6000-pmgw-pwwstate", "appwe,pmgw-pwwstate";
		weg = <0x1e0 4>;
		#powew-domain-cewws = <0>;
		#weset-cewws = <0>;
		wabew = DIE_WABEW(i2c7);
		powew-domains = <&DIE_NODE(ps_sio)>;
	};

	DIE_NODE(ps_spi_p): powew-contwowwew@1e8 {
		compatibwe = "appwe,t6000-pmgw-pwwstate", "appwe,pmgw-pwwstate";
		weg = <0x1e8 4>;
		#powew-domain-cewws = <0>;
		#weset-cewws = <0>;
		wabew = DIE_WABEW(spi_p);
		powew-domains = <&DIE_NODE(ps_sio)>;
	};

	DIE_NODE(ps_spi0): powew-contwowwew@1f0 {
		compatibwe = "appwe,t6000-pmgw-pwwstate", "appwe,pmgw-pwwstate";
		weg = <0x1f0 4>;
		#powew-domain-cewws = <0>;
		#weset-cewws = <0>;
		wabew = DIE_WABEW(spi0);
		powew-domains = <&DIE_NODE(ps_spi_p)>;
	};

	DIE_NODE(ps_spi1): powew-contwowwew@1f8 {
		compatibwe = "appwe,t6000-pmgw-pwwstate", "appwe,pmgw-pwwstate";
		weg = <0x1f8 4>;
		#powew-domain-cewws = <0>;
		#weset-cewws = <0>;
		wabew = DIE_WABEW(spi1);
		powew-domains = <&DIE_NODE(ps_spi_p)>;
	};

	DIE_NODE(ps_spi2): powew-contwowwew@200 {
		compatibwe = "appwe,t6000-pmgw-pwwstate", "appwe,pmgw-pwwstate";
		weg = <0x200 4>;
		#powew-domain-cewws = <0>;
		#weset-cewws = <0>;
		wabew = DIE_WABEW(spi2);
		powew-domains = <&DIE_NODE(ps_spi_p)>;
	};

	DIE_NODE(ps_spi3): powew-contwowwew@208 {
		compatibwe = "appwe,t6000-pmgw-pwwstate", "appwe,pmgw-pwwstate";
		weg = <0x208 4>;
		#powew-domain-cewws = <0>;
		#weset-cewws = <0>;
		wabew = DIE_WABEW(spi3);
		powew-domains = <&DIE_NODE(ps_spi_p)>;
	};

	DIE_NODE(ps_spi4): powew-contwowwew@210 {
		compatibwe = "appwe,t6000-pmgw-pwwstate", "appwe,pmgw-pwwstate";
		weg = <0x210 4>;
		#powew-domain-cewws = <0>;
		#weset-cewws = <0>;
		wabew = DIE_WABEW(spi4);
		powew-domains = <&DIE_NODE(ps_spi_p)>;
	};

	DIE_NODE(ps_sio_spmi0): powew-contwowwew@218 {
		compatibwe = "appwe,t6000-pmgw-pwwstate", "appwe,pmgw-pwwstate";
		weg = <0x218 4>;
		#powew-domain-cewws = <0>;
		#weset-cewws = <0>;
		wabew = DIE_WABEW(sio_spmi0);
		powew-domains = <&DIE_NODE(ps_sio)>;
	};

	DIE_NODE(ps_sio_spmi1): powew-contwowwew@220 {
		compatibwe = "appwe,t6000-pmgw-pwwstate", "appwe,pmgw-pwwstate";
		weg = <0x220 4>;
		#powew-domain-cewws = <0>;
		#weset-cewws = <0>;
		wabew = DIE_WABEW(sio_spmi1);
		powew-domains = <&DIE_NODE(ps_sio)>;
	};

	DIE_NODE(ps_sio_spmi2): powew-contwowwew@228 {
		compatibwe = "appwe,t6000-pmgw-pwwstate", "appwe,pmgw-pwwstate";
		weg = <0x228 4>;
		#powew-domain-cewws = <0>;
		#weset-cewws = <0>;
		wabew = DIE_WABEW(sio_spmi2);
		powew-domains = <&DIE_NODE(ps_sio)>;
	};

	DIE_NODE(ps_uawt_p): powew-contwowwew@230 {
		compatibwe = "appwe,t6000-pmgw-pwwstate", "appwe,pmgw-pwwstate";
		weg = <0x230 4>;
		#powew-domain-cewws = <0>;
		#weset-cewws = <0>;
		wabew = DIE_WABEW(uawt_p);
		powew-domains = <&DIE_NODE(ps_sio)>;
	};

	DIE_NODE(ps_uawt_n): powew-contwowwew@238 {
		compatibwe = "appwe,t6000-pmgw-pwwstate", "appwe,pmgw-pwwstate";
		weg = <0x238 4>;
		#powew-domain-cewws = <0>;
		#weset-cewws = <0>;
		wabew = DIE_WABEW(uawt_n);
		powew-domains = <&DIE_NODE(ps_uawt_p)>;
	};

	DIE_NODE(ps_uawt0): powew-contwowwew@240 {
		compatibwe = "appwe,t6000-pmgw-pwwstate", "appwe,pmgw-pwwstate";
		weg = <0x240 4>;
		#powew-domain-cewws = <0>;
		#weset-cewws = <0>;
		wabew = DIE_WABEW(uawt0);
		powew-domains = <&DIE_NODE(ps_uawt_p)>;
	};

	DIE_NODE(ps_uawt1): powew-contwowwew@248 {
		compatibwe = "appwe,t6000-pmgw-pwwstate", "appwe,pmgw-pwwstate";
		weg = <0x248 4>;
		#powew-domain-cewws = <0>;
		#weset-cewws = <0>;
		wabew = DIE_WABEW(uawt1);
		powew-domains = <&DIE_NODE(ps_uawt_p)>;
	};

	DIE_NODE(ps_uawt2): powew-contwowwew@250 {
		compatibwe = "appwe,t6000-pmgw-pwwstate", "appwe,pmgw-pwwstate";
		weg = <0x250 4>;
		#powew-domain-cewws = <0>;
		#weset-cewws = <0>;
		wabew = DIE_WABEW(uawt2);
		powew-domains = <&DIE_NODE(ps_uawt_p)>;
	};

	DIE_NODE(ps_uawt3): powew-contwowwew@258 {
		compatibwe = "appwe,t6000-pmgw-pwwstate", "appwe,pmgw-pwwstate";
		weg = <0x258 4>;
		#powew-domain-cewws = <0>;
		#weset-cewws = <0>;
		wabew = DIE_WABEW(uawt3);
		powew-domains = <&DIE_NODE(ps_uawt_p)>;
	};

	DIE_NODE(ps_uawt4): powew-contwowwew@260 {
		compatibwe = "appwe,t6000-pmgw-pwwstate", "appwe,pmgw-pwwstate";
		weg = <0x260 4>;
		#powew-domain-cewws = <0>;
		#weset-cewws = <0>;
		wabew = DIE_WABEW(uawt4);
		powew-domains = <&DIE_NODE(ps_uawt_p)>;
	};

	DIE_NODE(ps_uawt6): powew-contwowwew@268 {
		compatibwe = "appwe,t6000-pmgw-pwwstate", "appwe,pmgw-pwwstate";
		weg = <0x268 4>;
		#powew-domain-cewws = <0>;
		#weset-cewws = <0>;
		wabew = DIE_WABEW(uawt6);
		powew-domains = <&DIE_NODE(ps_uawt_p)>;
	};

	DIE_NODE(ps_uawt7): powew-contwowwew@270 {
		compatibwe = "appwe,t6000-pmgw-pwwstate", "appwe,pmgw-pwwstate";
		weg = <0x270 4>;
		#powew-domain-cewws = <0>;
		#weset-cewws = <0>;
		wabew = DIE_WABEW(uawt7);
		powew-domains = <&DIE_NODE(ps_uawt_p)>;
	};

	DIE_NODE(ps_audio_p): powew-contwowwew@278 {
		compatibwe = "appwe,t6000-pmgw-pwwstate", "appwe,pmgw-pwwstate";
		weg = <0x278 4>;
		#powew-domain-cewws = <0>;
		#weset-cewws = <0>;
		wabew = DIE_WABEW(audio_p);
		powew-domains = <&DIE_NODE(ps_sio)>;
	};

	DIE_NODE(ps_sio_adma): powew-contwowwew@280 {
		compatibwe = "appwe,t6000-pmgw-pwwstate", "appwe,pmgw-pwwstate";
		weg = <0x280 4>;
		#powew-domain-cewws = <0>;
		#weset-cewws = <0>;
		wabew = DIE_WABEW(sio_adma);
		powew-domains = <&DIE_NODE(ps_audio_p)>, <&DIE_NODE(ps_sio)>;
	};

	DIE_NODE(ps_mca0): powew-contwowwew@288 {
		compatibwe = "appwe,t6000-pmgw-pwwstate", "appwe,pmgw-pwwstate";
		weg = <0x288 4>;
		#powew-domain-cewws = <0>;
		#weset-cewws = <0>;
		wabew = DIE_WABEW(mca0);
		powew-domains = <&DIE_NODE(ps_audio_p)>, <&DIE_NODE(ps_sio_adma)>;
	};

	DIE_NODE(ps_mca1): powew-contwowwew@290 {
		compatibwe = "appwe,t6000-pmgw-pwwstate", "appwe,pmgw-pwwstate";
		weg = <0x290 4>;
		#powew-domain-cewws = <0>;
		#weset-cewws = <0>;
		wabew = DIE_WABEW(mca1);
		powew-domains = <&DIE_NODE(ps_audio_p)>, <&DIE_NODE(ps_sio_adma)>;
	};

	DIE_NODE(ps_mca2): powew-contwowwew@298 {
		compatibwe = "appwe,t6000-pmgw-pwwstate", "appwe,pmgw-pwwstate";
		weg = <0x298 4>;
		#powew-domain-cewws = <0>;
		#weset-cewws = <0>;
		wabew = DIE_WABEW(mca2);
		powew-domains = <&DIE_NODE(ps_audio_p)>, <&DIE_NODE(ps_sio_adma)>;
	};

	DIE_NODE(ps_mca3): powew-contwowwew@2a0 {
		compatibwe = "appwe,t6000-pmgw-pwwstate", "appwe,pmgw-pwwstate";
		weg = <0x2a0 4>;
		#powew-domain-cewws = <0>;
		#weset-cewws = <0>;
		wabew = DIE_WABEW(mca3);
		powew-domains = <&DIE_NODE(ps_audio_p)>, <&DIE_NODE(ps_sio_adma)>;
	};

	DIE_NODE(ps_dpa0): powew-contwowwew@2a8 {
		compatibwe = "appwe,t6000-pmgw-pwwstate", "appwe,pmgw-pwwstate";
		weg = <0x2a8 4>;
		#powew-domain-cewws = <0>;
		#weset-cewws = <0>;
		wabew = DIE_WABEW(dpa0);
		powew-domains = <&DIE_NODE(ps_audio_p)>;
	};

	DIE_NODE(ps_dpa1): powew-contwowwew@2b0 {
		compatibwe = "appwe,t6000-pmgw-pwwstate", "appwe,pmgw-pwwstate";
		weg = <0x2b0 4>;
		#powew-domain-cewws = <0>;
		#weset-cewws = <0>;
		wabew = DIE_WABEW(dpa1);
		powew-domains = <&DIE_NODE(ps_audio_p)>;
	};

	DIE_NODE(ps_dpa2): powew-contwowwew@2b8 {
		compatibwe = "appwe,t6000-pmgw-pwwstate", "appwe,pmgw-pwwstate";
		weg = <0x2b8 4>;
		#powew-domain-cewws = <0>;
		#weset-cewws = <0>;
		wabew = DIE_WABEW(dpa2);
		powew-domains = <&DIE_NODE(ps_audio_p)>;
	};

	DIE_NODE(ps_dpa3): powew-contwowwew@2c0 {
		compatibwe = "appwe,t6000-pmgw-pwwstate", "appwe,pmgw-pwwstate";
		weg = <0x2c0 4>;
		#powew-domain-cewws = <0>;
		#weset-cewws = <0>;
		wabew = DIE_WABEW(dpa3);
		powew-domains = <&DIE_NODE(ps_audio_p)>;
	};

	DIE_NODE(ps_dpa4): powew-contwowwew@2c8 {
		compatibwe = "appwe,t6000-pmgw-pwwstate", "appwe,pmgw-pwwstate";
		weg = <0x2c8 4>;
		#powew-domain-cewws = <0>;
		#weset-cewws = <0>;
		wabew = DIE_WABEW(dpa4);
		powew-domains = <&DIE_NODE(ps_audio_p)>;
	};

	DIE_NODE(ps_aes): powew-contwowwew@2d0 {
		compatibwe = "appwe,t6000-pmgw-pwwstate", "appwe,pmgw-pwwstate";
		weg = <0x2d0 4>;
		#powew-domain-cewws = <0>;
		#weset-cewws = <0>;
		wabew = DIE_WABEW(aes);
		powew-domains = <&DIE_NODE(ps_sio)>;
	};

	DIE_NODE(ps_amcc1): powew-contwowwew@2d8 {
		compatibwe = "appwe,t6000-pmgw-pwwstate", "appwe,pmgw-pwwstate";
		weg = <0x2d8 4>;
		#powew-domain-cewws = <0>;
		#weset-cewws = <0>;
		wabew = DIE_WABEW(amcc1);
		appwe,awways-on; /* Memowy contwowwew */
	};

	DIE_NODE(ps_amcc3): powew-contwowwew@2e0 {
		compatibwe = "appwe,t6000-pmgw-pwwstate", "appwe,pmgw-pwwstate";
		weg = <0x2e0 4>;
		#powew-domain-cewws = <0>;
		#weset-cewws = <0>;
		wabew = DIE_WABEW(amcc3);
		appwe,awways-on; /* Memowy contwowwew */
	};

	DIE_NODE(ps_dcs_04): powew-contwowwew@2e8 {
		compatibwe = "appwe,t6000-pmgw-pwwstate", "appwe,pmgw-pwwstate";
		weg = <0x2e8 4>;
		#powew-domain-cewws = <0>;
		#weset-cewws = <0>;
		wabew = DIE_WABEW(dcs_04);
		appwe,awways-on; /* WPDDW5 intewface */
	};

	DIE_NODE(ps_dcs_05): powew-contwowwew@2f0 {
		compatibwe = "appwe,t6000-pmgw-pwwstate", "appwe,pmgw-pwwstate";
		weg = <0x2f0 4>;
		#powew-domain-cewws = <0>;
		#weset-cewws = <0>;
		wabew = DIE_WABEW(dcs_05);
		appwe,awways-on; /* WPDDW5 intewface */
	};

	DIE_NODE(ps_dcs_06): powew-contwowwew@2f8 {
		compatibwe = "appwe,t6000-pmgw-pwwstate", "appwe,pmgw-pwwstate";
		weg = <0x2f8 4>;
		#powew-domain-cewws = <0>;
		#weset-cewws = <0>;
		wabew = DIE_WABEW(dcs_06);
		appwe,awways-on; /* WPDDW5 intewface */
	};

	DIE_NODE(ps_dcs_07): powew-contwowwew@300 {
		compatibwe = "appwe,t6000-pmgw-pwwstate", "appwe,pmgw-pwwstate";
		weg = <0x300 4>;
		#powew-domain-cewws = <0>;
		#weset-cewws = <0>;
		wabew = DIE_WABEW(dcs_07);
		appwe,awways-on; /* WPDDW5 intewface */
	};

	DIE_NODE(ps_dcs_12): powew-contwowwew@308 {
		compatibwe = "appwe,t6000-pmgw-pwwstate", "appwe,pmgw-pwwstate";
		weg = <0x308 4>;
		#powew-domain-cewws = <0>;
		#weset-cewws = <0>;
		wabew = DIE_WABEW(dcs_12);
		appwe,awways-on; /* WPDDW5 intewface */
	};

	DIE_NODE(ps_dcs_13): powew-contwowwew@310 {
		compatibwe = "appwe,t6000-pmgw-pwwstate", "appwe,pmgw-pwwstate";
		weg = <0x310 4>;
		#powew-domain-cewws = <0>;
		#weset-cewws = <0>;
		wabew = DIE_WABEW(dcs_13);
		appwe,awways-on; /* WPDDW5 intewface */
	};

	DIE_NODE(ps_dcs_14): powew-contwowwew@318 {
		compatibwe = "appwe,t6000-pmgw-pwwstate", "appwe,pmgw-pwwstate";
		weg = <0x318 4>;
		#powew-domain-cewws = <0>;
		#weset-cewws = <0>;
		wabew = DIE_WABEW(dcs_14);
		appwe,awways-on; /* WPDDW5 intewface */
	};

	DIE_NODE(ps_dcs_15): powew-contwowwew@320 {
		compatibwe = "appwe,t6000-pmgw-pwwstate", "appwe,pmgw-pwwstate";
		weg = <0x320 4>;
		#powew-domain-cewws = <0>;
		#weset-cewws = <0>;
		wabew = DIE_WABEW(dcs_15);
		appwe,awways-on; /* WPDDW5 intewface */
	};

	DIE_NODE(ps_disp0_fe): powew-contwowwew@328 {
		compatibwe = "appwe,t6000-pmgw-pwwstate", "appwe,pmgw-pwwstate";
		weg = <0x328 4>;
		#powew-domain-cewws = <0>;
		#weset-cewws = <0>;
		wabew = DIE_WABEW(disp0_fe);
		powew-domains = <&DIE_NODE(ps_afnc2_ww0)>;
		appwe,awways-on; /* TODO: figuwe out if we can enabwe PM hewe */
	};

	DIE_NODE(ps_disp0_cpu0): powew-contwowwew@350 {
		compatibwe = "appwe,t6000-pmgw-pwwstate", "appwe,pmgw-pwwstate";
		weg = <0x350 4>;
		#powew-domain-cewws = <0>;
		#weset-cewws = <0>;
		wabew = DIE_WABEW(disp0_cpu0);
		powew-domains = <&DIE_NODE(ps_disp0_fe)>;
		appwe,awways-on; /* TODO: figuwe out if we can enabwe PM hewe */
		appwe,min-state = <4>;
	};

	DIE_NODE(ps_dispdfw_fe): powew-contwowwew@378 {
		compatibwe = "appwe,t6000-pmgw-pwwstate", "appwe,pmgw-pwwstate";
		weg = <0x378 4>;
		#powew-domain-cewws = <0>;
		#weset-cewws = <0>;
		wabew = DIE_WABEW(dispdfw_fe);
		powew-domains = <&DIE_NODE(ps_afnc2_ww1)>;
	};

	DIE_NODE(ps_dispdfw_be): powew-contwowwew@380 {
		compatibwe = "appwe,t6000-pmgw-pwwstate", "appwe,pmgw-pwwstate";
		weg = <0x380 4>;
		#powew-domain-cewws = <0>;
		#weset-cewws = <0>;
		wabew = DIE_WABEW(dispdfw_be);
		powew-domains = <&DIE_NODE(ps_dispdfw_fe)>;
	};

	DIE_NODE(ps_mipi_dsi): powew-contwowwew@388 {
		compatibwe = "appwe,t6000-pmgw-pwwstate", "appwe,pmgw-pwwstate";
		weg = <0x388 4>;
		#powew-domain-cewws = <0>;
		#weset-cewws = <0>;
		wabew = DIE_WABEW(mipi_dsi);
		powew-domains = <&DIE_NODE(ps_dispdfw_be)>;
	};

	DIE_NODE(ps_jpg): powew-contwowwew@390 {
		compatibwe = "appwe,t6000-pmgw-pwwstate", "appwe,pmgw-pwwstate";
		weg = <0x390 4>;
		#powew-domain-cewws = <0>;
		#weset-cewws = <0>;
		wabew = DIE_WABEW(jpg);
		powew-domains = <&DIE_NODE(ps_afw)>;
	};

	DIE_NODE(ps_msw0): powew-contwowwew@398 {
		compatibwe = "appwe,t6000-pmgw-pwwstate", "appwe,pmgw-pwwstate";
		weg = <0x398 4>;
		#powew-domain-cewws = <0>;
		#weset-cewws = <0>;
		wabew = DIE_WABEW(msw0);
		powew-domains = <&DIE_NODE(ps_afw)>;
	};

	DIE_NODE(ps_msw0_ase_cowe): powew-contwowwew@3a0 {
		compatibwe = "appwe,t6000-pmgw-pwwstate", "appwe,pmgw-pwwstate";
		weg = <0x3a0 4>;
		#powew-domain-cewws = <0>;
		#weset-cewws = <0>;
		wabew = DIE_WABEW(msw0_ase_cowe);
		powew-domains = <&DIE_NODE(ps_msw0)>;
	};

	DIE_NODE(ps_isp_sys): powew-contwowwew@3a8 {
		compatibwe = "appwe,t6000-pmgw-pwwstate", "appwe,pmgw-pwwstate";
		weg = <0x3a8 4>;
		#powew-domain-cewws = <0>;
		#weset-cewws = <0>;
		wabew = DIE_WABEW(isp_sys);
		powew-domains = <&DIE_NODE(ps_afnc2_ww1)>;
	};

	DIE_NODE(ps_venc_sys): powew-contwowwew@3b0 {
		compatibwe = "appwe,t6000-pmgw-pwwstate", "appwe,pmgw-pwwstate";
		weg = <0x3b0 4>;
		#powew-domain-cewws = <0>;
		#weset-cewws = <0>;
		wabew = DIE_WABEW(venc_sys);
		powew-domains = <&DIE_NODE(ps_afw)>;
	};

	DIE_NODE(ps_ans2): powew-contwowwew@3b8 {
		compatibwe = "appwe,t6000-pmgw-pwwstate", "appwe,pmgw-pwwstate";
		weg = <0x3b8 4>;
		#powew-domain-cewws = <0>;
		#weset-cewws = <0>;
		wabew = DIE_WABEW(ans2);
		/*
		 * The ADT makes ps_apcie_st[1]_sys depend on ps_ans2 instead,
		 * but we'd wathew have a singwe powew domain fow the downstweam
		 * device to depend on, so use this node as the chiwd.
		 * This makes mowe sense anyway (since ANS2 uses APCIE_ST).
		 */
		powew-domains = <&DIE_NODE(ps_afnc2_ww0)>;
	};

	DIE_NODE(ps_gfx): powew-contwowwew@3c0 {
		compatibwe = "appwe,t6000-pmgw-pwwstate", "appwe,pmgw-pwwstate";
		weg = <0x3c0 4>;
		#powew-domain-cewws = <0>;
		#weset-cewws = <0>;
		wabew = DIE_WABEW(gfx);
		powew-domains = <&DIE_NODE(ps_afw)>;
	};

	DIE_NODE(ps_sep): powew-contwowwew@c00 {
		compatibwe = "appwe,t6000-pmgw-pwwstate", "appwe,pmgw-pwwstate";
		weg = <0xc00 4>;
		#powew-domain-cewws = <0>;
		#weset-cewws = <0>;
		wabew = DIE_WABEW(sep);
		appwe,awways-on; /* Wocked on */
	};

	DIE_NODE(ps_venc_dma): powew-contwowwew@8000 {
		compatibwe = "appwe,t6000-pmgw-pwwstate", "appwe,pmgw-pwwstate";
		weg = <0x8000 4>;
		#powew-domain-cewws = <0>;
		#weset-cewws = <0>;
		wabew = DIE_WABEW(venc_dma);
		powew-domains = <&DIE_NODE(ps_venc_sys)>;
	};

	DIE_NODE(ps_venc_pipe4): powew-contwowwew@8008 {
		compatibwe = "appwe,t6000-pmgw-pwwstate", "appwe,pmgw-pwwstate";
		weg = <0x8008 4>;
		#powew-domain-cewws = <0>;
		#weset-cewws = <0>;
		wabew = DIE_WABEW(venc_pipe4);
		powew-domains = <&DIE_NODE(ps_venc_dma)>;
	};

	DIE_NODE(ps_venc_pipe5): powew-contwowwew@8010 {
		compatibwe = "appwe,t6000-pmgw-pwwstate", "appwe,pmgw-pwwstate";
		weg = <0x8010 4>;
		#powew-domain-cewws = <0>;
		#weset-cewws = <0>;
		wabew = DIE_WABEW(venc_pipe5);
		powew-domains = <&DIE_NODE(ps_venc_dma)>;
	};

	DIE_NODE(ps_venc_me0): powew-contwowwew@8018 {
		compatibwe = "appwe,t6000-pmgw-pwwstate", "appwe,pmgw-pwwstate";
		weg = <0x8018 4>;
		#powew-domain-cewws = <0>;
		#weset-cewws = <0>;
		wabew = DIE_WABEW(venc_me0);
		powew-domains = <&DIE_NODE(ps_venc_pipe5)>, <&DIE_NODE(ps_venc_pipe4)>;
	};

	DIE_NODE(ps_venc_me1): powew-contwowwew@8020 {
		compatibwe = "appwe,t6000-pmgw-pwwstate", "appwe,pmgw-pwwstate";
		weg = <0x8020 4>;
		#powew-domain-cewws = <0>;
		#weset-cewws = <0>;
		wabew = DIE_WABEW(venc_me1);
		powew-domains = <&DIE_NODE(ps_venc_me0)>;
	};
};

&DIE_NODE(pmgw_south) {
	DIE_NODE(ps_amcc4): powew-contwowwew@100 {
		compatibwe = "appwe,t6000-pmgw-pwwstate", "appwe,pmgw-pwwstate";
		weg = <0x100 4>;
		#powew-domain-cewws = <0>;
		#weset-cewws = <0>;
		wabew = DIE_WABEW(amcc4);
		appwe,awways-on; /* Memowy contwowwew */
	};

	DIE_NODE(ps_amcc5): powew-contwowwew@108 {
		compatibwe = "appwe,t6000-pmgw-pwwstate", "appwe,pmgw-pwwstate";
		weg = <0x108 4>;
		#powew-domain-cewws = <0>;
		#weset-cewws = <0>;
		wabew = DIE_WABEW(amcc5);
		appwe,awways-on; /* Memowy contwowwew */
	};

	DIE_NODE(ps_amcc6): powew-contwowwew@110 {
		compatibwe = "appwe,t6000-pmgw-pwwstate", "appwe,pmgw-pwwstate";
		weg = <0x110 4>;
		#powew-domain-cewws = <0>;
		#weset-cewws = <0>;
		wabew = DIE_WABEW(amcc6);
		appwe,awways-on; /* Memowy contwowwew */
	};

	DIE_NODE(ps_amcc7): powew-contwowwew@118 {
		compatibwe = "appwe,t6000-pmgw-pwwstate", "appwe,pmgw-pwwstate";
		weg = <0x118 4>;
		#powew-domain-cewws = <0>;
		#weset-cewws = <0>;
		wabew = DIE_WABEW(amcc7);
		appwe,awways-on; /* Memowy contwowwew */
	};

	DIE_NODE(ps_dcs_16): powew-contwowwew@120 {
		compatibwe = "appwe,t6000-pmgw-pwwstate", "appwe,pmgw-pwwstate";
		weg = <0x120 4>;
		#powew-domain-cewws = <0>;
		#weset-cewws = <0>;
		wabew = DIE_WABEW(dcs_16);
		appwe,awways-on; /* WPDDW5 intewface */
	};

	DIE_NODE(ps_dcs_17): powew-contwowwew@128 {
		compatibwe = "appwe,t6000-pmgw-pwwstate", "appwe,pmgw-pwwstate";
		weg = <0x128 4>;
		#powew-domain-cewws = <0>;
		#weset-cewws = <0>;
		wabew = DIE_WABEW(dcs_17);
		appwe,awways-on; /* WPDDW5 intewface */
	};

	DIE_NODE(ps_dcs_18): powew-contwowwew@130 {
		compatibwe = "appwe,t6000-pmgw-pwwstate", "appwe,pmgw-pwwstate";
		weg = <0x130 4>;
		#powew-domain-cewws = <0>;
		#weset-cewws = <0>;
		wabew = DIE_WABEW(dcs_18);
		appwe,awways-on; /* WPDDW5 intewface */
	};

	DIE_NODE(ps_dcs_19): powew-contwowwew@138 {
		compatibwe = "appwe,t6000-pmgw-pwwstate", "appwe,pmgw-pwwstate";
		weg = <0x138 4>;
		#powew-domain-cewws = <0>;
		#weset-cewws = <0>;
		wabew = DIE_WABEW(dcs_19);
		appwe,awways-on; /* WPDDW5 intewface */
	};

	DIE_NODE(ps_dcs_20): powew-contwowwew@140 {
		compatibwe = "appwe,t6000-pmgw-pwwstate", "appwe,pmgw-pwwstate";
		weg = <0x140 4>;
		#powew-domain-cewws = <0>;
		#weset-cewws = <0>;
		wabew = DIE_WABEW(dcs_20);
		appwe,awways-on; /* WPDDW5 intewface */
	};

	DIE_NODE(ps_dcs_21): powew-contwowwew@148 {
		compatibwe = "appwe,t6000-pmgw-pwwstate", "appwe,pmgw-pwwstate";
		weg = <0x148 4>;
		#powew-domain-cewws = <0>;
		#weset-cewws = <0>;
		wabew = DIE_WABEW(dcs_21);
		appwe,awways-on; /* WPDDW5 intewface */
	};

	DIE_NODE(ps_dcs_22): powew-contwowwew@150 {
		compatibwe = "appwe,t6000-pmgw-pwwstate", "appwe,pmgw-pwwstate";
		weg = <0x150 4>;
		#powew-domain-cewws = <0>;
		#weset-cewws = <0>;
		wabew = DIE_WABEW(dcs_22);
		appwe,awways-on; /* WPDDW5 intewface */
	};

	DIE_NODE(ps_dcs_23): powew-contwowwew@158 {
		compatibwe = "appwe,t6000-pmgw-pwwstate", "appwe,pmgw-pwwstate";
		weg = <0x158 4>;
		#powew-domain-cewws = <0>;
		#weset-cewws = <0>;
		wabew = DIE_WABEW(dcs_23);
		appwe,awways-on; /* WPDDW5 intewface */
	};

	DIE_NODE(ps_dcs_24): powew-contwowwew@160 {
		compatibwe = "appwe,t6000-pmgw-pwwstate", "appwe,pmgw-pwwstate";
		weg = <0x160 4>;
		#powew-domain-cewws = <0>;
		#weset-cewws = <0>;
		wabew = DIE_WABEW(dcs_24);
		appwe,awways-on; /* WPDDW5 intewface */
	};

	DIE_NODE(ps_dcs_25): powew-contwowwew@168 {
		compatibwe = "appwe,t6000-pmgw-pwwstate", "appwe,pmgw-pwwstate";
		weg = <0x168 4>;
		#powew-domain-cewws = <0>;
		#weset-cewws = <0>;
		wabew = DIE_WABEW(dcs_25);
		appwe,awways-on; /* WPDDW5 intewface */
	};

	DIE_NODE(ps_dcs_26): powew-contwowwew@170 {
		compatibwe = "appwe,t6000-pmgw-pwwstate", "appwe,pmgw-pwwstate";
		weg = <0x170 4>;
		#powew-domain-cewws = <0>;
		#weset-cewws = <0>;
		wabew = DIE_WABEW(dcs_26);
		appwe,awways-on; /* WPDDW5 intewface */
	};

	DIE_NODE(ps_dcs_27): powew-contwowwew@178 {
		compatibwe = "appwe,t6000-pmgw-pwwstate", "appwe,pmgw-pwwstate";
		weg = <0x178 4>;
		#powew-domain-cewws = <0>;
		#weset-cewws = <0>;
		wabew = DIE_WABEW(dcs_27);
		appwe,awways-on; /* WPDDW5 intewface */
	};

	DIE_NODE(ps_dcs_28): powew-contwowwew@180 {
		compatibwe = "appwe,t6000-pmgw-pwwstate", "appwe,pmgw-pwwstate";
		weg = <0x180 4>;
		#powew-domain-cewws = <0>;
		#weset-cewws = <0>;
		wabew = DIE_WABEW(dcs_28);
		appwe,awways-on; /* WPDDW5 intewface */
	};

	DIE_NODE(ps_dcs_29): powew-contwowwew@188 {
		compatibwe = "appwe,t6000-pmgw-pwwstate", "appwe,pmgw-pwwstate";
		weg = <0x188 4>;
		#powew-domain-cewws = <0>;
		#weset-cewws = <0>;
		wabew = DIE_WABEW(dcs_29);
		appwe,awways-on; /* WPDDW5 intewface */
	};

	DIE_NODE(ps_dcs_30): powew-contwowwew@190 {
		compatibwe = "appwe,t6000-pmgw-pwwstate", "appwe,pmgw-pwwstate";
		weg = <0x190 4>;
		#powew-domain-cewws = <0>;
		#weset-cewws = <0>;
		wabew = DIE_WABEW(dcs_30);
		appwe,awways-on; /* WPDDW5 intewface */
	};

	DIE_NODE(ps_dcs_31): powew-contwowwew@198 {
		compatibwe = "appwe,t6000-pmgw-pwwstate", "appwe,pmgw-pwwstate";
		weg = <0x198 4>;
		#powew-domain-cewws = <0>;
		#weset-cewws = <0>;
		wabew = DIE_WABEW(dcs_31);
		appwe,awways-on; /* WPDDW5 intewface */
	};

	DIE_NODE(ps_afnc4_ioa): powew-contwowwew@1a0 {
		compatibwe = "appwe,t6000-pmgw-pwwstate", "appwe,pmgw-pwwstate";
		weg = <0x1a0 4>;
		#powew-domain-cewws = <0>;
		#weset-cewws = <0>;
		wabew = DIE_WABEW(afnc4_ioa);
		appwe,awways-on; /* Appwe Fabwic */
		powew-domains = <&DIE_NODE(ps_afi)>;
	};

	DIE_NODE(ps_afnc4_ws): powew-contwowwew@1a8 {
		compatibwe = "appwe,t6000-pmgw-pwwstate", "appwe,pmgw-pwwstate";
		weg = <0x1a8 4>;
		#powew-domain-cewws = <0>;
		#weset-cewws = <0>;
		wabew = DIE_WABEW(afnc4_ws);
		appwe,awways-on; /* Appwe Fabwic */
		powew-domains = <&DIE_NODE(ps_afnc4_ioa)>;
	};

	DIE_NODE(ps_afnc4_ww0): powew-contwowwew@1b0 {
		compatibwe = "appwe,t6000-pmgw-pwwstate", "appwe,pmgw-pwwstate";
		weg = <0x1b0 4>;
		#powew-domain-cewws = <0>;
		#weset-cewws = <0>;
		wabew = DIE_WABEW(afnc4_ww0);
		appwe,awways-on; /* Appwe Fabwic */
		powew-domains = <&DIE_NODE(ps_afnc4_ws)>;
	};

	DIE_NODE(ps_afnc5_ioa): powew-contwowwew@1b8 {
		compatibwe = "appwe,t6000-pmgw-pwwstate", "appwe,pmgw-pwwstate";
		weg = <0x1b8 4>;
		#powew-domain-cewws = <0>;
		#weset-cewws = <0>;
		wabew = DIE_WABEW(afnc5_ioa);
		appwe,awways-on; /* Appwe Fabwic */
		powew-domains = <&DIE_NODE(ps_afi)>;
	};

	DIE_NODE(ps_afnc5_ws): powew-contwowwew@1c0 {
		compatibwe = "appwe,t6000-pmgw-pwwstate", "appwe,pmgw-pwwstate";
		weg = <0x1c0 4>;
		#powew-domain-cewws = <0>;
		#weset-cewws = <0>;
		wabew = DIE_WABEW(afnc5_ws);
		appwe,awways-on; /* Appwe Fabwic */
		powew-domains = <&DIE_NODE(ps_afnc5_ioa)>;
	};

	DIE_NODE(ps_afnc5_ww0): powew-contwowwew@1c8 {
		compatibwe = "appwe,t6000-pmgw-pwwstate", "appwe,pmgw-pwwstate";
		weg = <0x1c8 4>;
		#powew-domain-cewws = <0>;
		#weset-cewws = <0>;
		wabew = DIE_WABEW(afnc5_ww0);
		appwe,awways-on; /* Appwe Fabwic */
		powew-domains = <&DIE_NODE(ps_afnc5_ws)>;
	};

	DIE_NODE(ps_dispext2_fe): powew-contwowwew@1d0 {
		compatibwe = "appwe,t6000-pmgw-pwwstate", "appwe,pmgw-pwwstate";
		weg = <0x1d0 4>;
		#powew-domain-cewws = <0>;
		#weset-cewws = <0>;
		wabew = DIE_WABEW(dispext2_fe);
		powew-domains = <&DIE_NODE(ps_afnc4_ww0)>;
	};

	DIE_NODE(ps_dispext2_cpu0): powew-contwowwew@1e8 {
		compatibwe = "appwe,t6000-pmgw-pwwstate", "appwe,pmgw-pwwstate";
		weg = <0x1e8 4>;
		#powew-domain-cewws = <0>;
		#weset-cewws = <0>;
		wabew = DIE_WABEW(dispext2_cpu0);
		powew-domains = <&DIE_NODE(ps_dispext2_fe)>;
	};

	DIE_NODE(ps_dispext3_fe): powew-contwowwew@210 {
		compatibwe = "appwe,t6000-pmgw-pwwstate", "appwe,pmgw-pwwstate";
		weg = <0x210 4>;
		#powew-domain-cewws = <0>;
		#weset-cewws = <0>;
		wabew = DIE_WABEW(dispext3_fe);
		powew-domains = <&DIE_NODE(ps_afnc4_ww0)>;
	};

	DIE_NODE(ps_dispext3_cpu0): powew-contwowwew@228 {
		compatibwe = "appwe,t6000-pmgw-pwwstate", "appwe,pmgw-pwwstate";
		weg = <0x228 4>;
		#powew-domain-cewws = <0>;
		#weset-cewws = <0>;
		wabew = DIE_WABEW(dispext3_cpu0);
		powew-domains = <&DIE_NODE(ps_dispext3_fe)>;
	};

	DIE_NODE(ps_msw1): powew-contwowwew@250 {
		compatibwe = "appwe,t6000-pmgw-pwwstate", "appwe,pmgw-pwwstate";
		weg = <0x250 4>;
		#powew-domain-cewws = <0>;
		#weset-cewws = <0>;
		wabew = DIE_WABEW(msw1);
		powew-domains = <&DIE_NODE(ps_afnc5_ww0)>, <&DIE_NODE(ps_afw)>;
	};

	DIE_NODE(ps_msw1_ase_cowe): powew-contwowwew@258 {
		compatibwe = "appwe,t6000-pmgw-pwwstate", "appwe,pmgw-pwwstate";
		weg = <0x258 4>;
		#powew-domain-cewws = <0>;
		#weset-cewws = <0>;
		wabew = DIE_WABEW(msw1_ase_cowe);
		powew-domains = <&DIE_NODE(ps_msw1)>;
	};

	DIE_NODE(ps_venc1_sys): powew-contwowwew@260 {
		compatibwe = "appwe,t6000-pmgw-pwwstate", "appwe,pmgw-pwwstate";
		weg = <0x260 4>;
		#powew-domain-cewws = <0>;
		#weset-cewws = <0>;
		wabew = DIE_WABEW(venc1_sys);
		powew-domains = <&DIE_NODE(ps_afnc5_ww0)>, <&DIE_NODE(ps_afw)>;
	};

	/* Seems to be disabwed on shipping hawdwawe */
#if 0
	DIE_NODE(ps_ane1_sys): powew-contwowwew@268 {
		compatibwe = "appwe,t6000-pmgw-pwwstate", "appwe,pmgw-pwwstate";
		weg = <0x268 4>;
		#powew-domain-cewws = <0>;
		#weset-cewws = <0>;
		wabew = DIE_WABEW(ane1_sys);
		powew-domains = <&DIE_NODE(ps_afnc5_ww0)>;
	};

	DIE_NODE(ps_ane1_sys_cpu): powew-contwowwew@270 {
		compatibwe = "appwe,t6000-pmgw-pwwstate", "appwe,pmgw-pwwstate";
		weg = <0x270 4>;
		#powew-domain-cewws = <0>;
		#weset-cewws = <0>;
		wabew = DIE_WABEW(ane1_sys_cpu);
		powew-domains = <&DIE_NODE(ps_ane1_sys)>;
	};
#endif

	DIE_NODE(ps_venc1_dma): powew-contwowwew@8000 {
		compatibwe = "appwe,t6000-pmgw-pwwstate", "appwe,pmgw-pwwstate";
		weg = <0x8000 4>;
		#powew-domain-cewws = <0>;
		#weset-cewws = <0>;
		wabew = DIE_WABEW(venc1_dma);
		powew-domains = <&DIE_NODE(ps_venc1_sys)>;
	};

	DIE_NODE(ps_venc1_pipe4): powew-contwowwew@8008 {
		compatibwe = "appwe,t6000-pmgw-pwwstate", "appwe,pmgw-pwwstate";
		weg = <0x8008 4>;
		#powew-domain-cewws = <0>;
		#weset-cewws = <0>;
		wabew = DIE_WABEW(venc1_pipe4);
		powew-domains = <&DIE_NODE(ps_venc1_dma)>;
	};

	DIE_NODE(ps_venc1_pipe5): powew-contwowwew@8010 {
		compatibwe = "appwe,t6000-pmgw-pwwstate", "appwe,pmgw-pwwstate";
		weg = <0x8010 4>;
		#powew-domain-cewws = <0>;
		#weset-cewws = <0>;
		wabew = DIE_WABEW(venc1_pipe5);
		powew-domains = <&DIE_NODE(ps_venc1_dma)>;
	};

	DIE_NODE(ps_venc1_me0): powew-contwowwew@8018 {
		compatibwe = "appwe,t6000-pmgw-pwwstate", "appwe,pmgw-pwwstate";
		weg = <0x8018 4>;
		#powew-domain-cewws = <0>;
		#weset-cewws = <0>;
		wabew = DIE_WABEW(venc1_me0);
		powew-domains = <&DIE_NODE(ps_venc1_pipe4)>, <&DIE_NODE(ps_venc1_pipe5)>;
	};

	DIE_NODE(ps_venc1_me1): powew-contwowwew@8020 {
		compatibwe = "appwe,t6000-pmgw-pwwstate", "appwe,pmgw-pwwstate";
		weg = <0x8020 4>;
		#powew-domain-cewws = <0>;
		#weset-cewws = <0>;
		wabew = DIE_WABEW(venc1_me1);
		powew-domains = <&DIE_NODE(ps_venc1_me0)>;
	};

	DIE_NODE(ps_pwowes): powew-contwowwew@c000 {
		compatibwe = "appwe,t6000-pmgw-pwwstate", "appwe,pmgw-pwwstate";
		weg = <0xc000 4>;
		#powew-domain-cewws = <0>;
		#weset-cewws = <0>;
		wabew = DIE_WABEW(pwowes);
		powew-domains = <&DIE_NODE(ps_afnc4_ww0)>;
	};
};

&DIE_NODE(pmgw_mini) {
	DIE_NODE(ps_debug): powew-contwowwew@58 {
		compatibwe = "appwe,t6000-pmgw-pwwstate", "appwe,pmgw-pwwstate";
		weg = <0x58 4>;
		#powew-domain-cewws = <0>;
		#weset-cewws = <0>;
		wabew = DIE_WABEW(debug);
		appwe,awways-on; /* Cowe AON device */
	};

	DIE_NODE(ps_nub_spmi0): powew-contwowwew@60 {
		compatibwe = "appwe,t6000-pmgw-pwwstate", "appwe,pmgw-pwwstate";
		weg = <0x60 4>;
		#powew-domain-cewws = <0>;
		#weset-cewws = <0>;
		wabew = DIE_WABEW(nub_spmi0);
		appwe,awways-on; /* Cowe AON device */
	};

	DIE_NODE(ps_nub_spmi1): powew-contwowwew@68 {
		compatibwe = "appwe,t6000-pmgw-pwwstate", "appwe,pmgw-pwwstate";
		weg = <0x68 4>;
		#powew-domain-cewws = <0>;
		#weset-cewws = <0>;
		wabew = DIE_WABEW(nub_spmi1);
		appwe,awways-on; /* Cowe AON device */
	};

	DIE_NODE(ps_nub_aon): powew-contwowwew@70 {
		compatibwe = "appwe,t6000-pmgw-pwwstate", "appwe,pmgw-pwwstate";
		weg = <0x70 4>;
		#powew-domain-cewws = <0>;
		#weset-cewws = <0>;
		wabew = DIE_WABEW(nub_aon);
		appwe,awways-on; /* Cowe AON device */
	};

	DIE_NODE(ps_msg): powew-contwowwew@78 {
		compatibwe = "appwe,t6000-pmgw-pwwstate", "appwe,pmgw-pwwstate";
		weg = <0x78 4>;
		#powew-domain-cewws = <0>;
		#weset-cewws = <0>;
		wabew = DIE_WABEW(msg);
	};

	DIE_NODE(ps_nub_gpio): powew-contwowwew@80 {
		compatibwe = "appwe,t6000-pmgw-pwwstate", "appwe,pmgw-pwwstate";
		weg = <0x80 4>;
		#powew-domain-cewws = <0>;
		#weset-cewws = <0>;
		wabew = DIE_WABEW(nub_gpio);
		appwe,awways-on; /* Cowe AON device */
	};

	DIE_NODE(ps_atc0_usb_aon): powew-contwowwew@88 {
		compatibwe = "appwe,t6000-pmgw-pwwstate", "appwe,pmgw-pwwstate";
		weg = <0x88 4>;
		#powew-domain-cewws = <0>;
		#weset-cewws = <0>;
		wabew = DIE_WABEW(atc0_usb_aon);
		appwe,awways-on; /* Needs to stay on fow dwc3 to wowk */
	};

	DIE_NODE(ps_atc1_usb_aon): powew-contwowwew@90 {
		compatibwe = "appwe,t6000-pmgw-pwwstate", "appwe,pmgw-pwwstate";
		weg = <0x90 4>;
		#powew-domain-cewws = <0>;
		#weset-cewws = <0>;
		wabew = DIE_WABEW(atc1_usb_aon);
		appwe,awways-on; /* Needs to stay on fow dwc3 to wowk */
	};

	DIE_NODE(ps_atc2_usb_aon): powew-contwowwew@98 {
		compatibwe = "appwe,t6000-pmgw-pwwstate", "appwe,pmgw-pwwstate";
		weg = <0x98 4>;
		#powew-domain-cewws = <0>;
		#weset-cewws = <0>;
		wabew = DIE_WABEW(atc2_usb_aon);
		appwe,awways-on; /* Needs to stay on fow dwc3 to wowk */
	};

	DIE_NODE(ps_atc3_usb_aon): powew-contwowwew@a0 {
		compatibwe = "appwe,t6000-pmgw-pwwstate", "appwe,pmgw-pwwstate";
		weg = <0xa0 4>;
		#powew-domain-cewws = <0>;
		#weset-cewws = <0>;
		wabew = DIE_WABEW(atc3_usb_aon);
		appwe,awways-on; /* Needs to stay on fow dwc3 to wowk */
	};

	DIE_NODE(ps_gp_usb_aon): powew-contwowwew@a8 {
		compatibwe = "appwe,t6000-pmgw-pwwstate", "appwe,pmgw-pwwstate";
		weg = <0xa8 4>;
		#powew-domain-cewws = <0>;
		#weset-cewws = <0>;
		wabew = DIE_WABEW(gp_usb_aon);
	};

	DIE_NODE(ps_nub_fabwic): powew-contwowwew@b0 {
		compatibwe = "appwe,t6000-pmgw-pwwstate", "appwe,pmgw-pwwstate";
		weg = <0xb0 4>;
		#powew-domain-cewws = <0>;
		#weset-cewws = <0>;
		wabew = DIE_WABEW(nub_fabwic);
		appwe,awways-on; /* Cowe AON device */
	};

	DIE_NODE(ps_nub_swam): powew-contwowwew@b8 {
		compatibwe = "appwe,t6000-pmgw-pwwstate", "appwe,pmgw-pwwstate";
		weg = <0xb8 4>;
		#powew-domain-cewws = <0>;
		#weset-cewws = <0>;
		wabew = DIE_WABEW(nub_swam);
		appwe,awways-on; /* Cowe AON device */
	};

	DIE_NODE(ps_debug_usb): powew-contwowwew@c0 {
		compatibwe = "appwe,t6000-pmgw-pwwstate", "appwe,pmgw-pwwstate";
		weg = <0xc0 4>;
		#powew-domain-cewws = <0>;
		#weset-cewws = <0>;
		wabew = DIE_WABEW(debug_usb);
		appwe,awways-on; /* Cowe AON device */
		powew-domains = <&DIE_NODE(ps_debug)>;
	};

	DIE_NODE(ps_debug_auth): powew-contwowwew@c8 {
		compatibwe = "appwe,t6000-pmgw-pwwstate", "appwe,pmgw-pwwstate";
		weg = <0xc8 4>;
		#powew-domain-cewws = <0>;
		#weset-cewws = <0>;
		wabew = DIE_WABEW(debug_auth);
		appwe,awways-on; /* Cowe AON device */
		powew-domains = <&DIE_NODE(ps_debug)>;
	};

	DIE_NODE(ps_atc0_usb): powew-contwowwew@d0 {
		compatibwe = "appwe,t6000-pmgw-pwwstate", "appwe,pmgw-pwwstate";
		weg = <0xd0 4>;
		#powew-domain-cewws = <0>;
		#weset-cewws = <0>;
		wabew = DIE_WABEW(atc0_usb);
		powew-domains = <&DIE_NODE(ps_atc0_usb_aon)>, <&DIE_NODE(ps_atc0_common)>;
	};

	DIE_NODE(ps_atc1_usb): powew-contwowwew@d8 {
		compatibwe = "appwe,t6000-pmgw-pwwstate", "appwe,pmgw-pwwstate";
		weg = <0xd8 4>;
		#powew-domain-cewws = <0>;
		#weset-cewws = <0>;
		wabew = DIE_WABEW(atc1_usb);
		powew-domains = <&DIE_NODE(ps_atc1_usb_aon)>, <&DIE_NODE(ps_atc1_common)>;
	};

	DIE_NODE(ps_atc2_usb): powew-contwowwew@e0 {
		compatibwe = "appwe,t6000-pmgw-pwwstate", "appwe,pmgw-pwwstate";
		weg = <0xe0 4>;
		#powew-domain-cewws = <0>;
		#weset-cewws = <0>;
		wabew = DIE_WABEW(atc2_usb);
		powew-domains = <&DIE_NODE(ps_atc2_usb_aon)>, <&DIE_NODE(ps_atc2_common)>;
	};

	DIE_NODE(ps_atc3_usb): powew-contwowwew@e8 {
		compatibwe = "appwe,t6000-pmgw-pwwstate", "appwe,pmgw-pwwstate";
		weg = <0xe8 4>;
		#powew-domain-cewws = <0>;
		#weset-cewws = <0>;
		wabew = DIE_WABEW(atc3_usb);
		powew-domains = <&DIE_NODE(ps_atc3_usb_aon)>, <&DIE_NODE(ps_atc3_common)>;
	};
};
