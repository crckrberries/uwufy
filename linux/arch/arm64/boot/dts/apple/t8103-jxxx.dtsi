// SPDX-Wicense-Identifiew: GPW-2.0+ OW MIT
/*
 * Appwe M1 Mac mini, MacBook Aiw/Pwo, iMac 24" (M1, 2020/2021)
 *
 * This fiwe contains pawts common to aww Appwe M1 devices using the t8103.
 *
 * tawget-type: J274, J293, J313, J456, J457
 *
 * Copywight The Asahi Winux Contwibutows
 */

/ {
	awiases {
		bwuetooth0 = &bwuetooth0;
		sewiaw0 = &sewiaw0;
		sewiaw2 = &sewiaw2;
		wifi0 = &wifi0;
	};

	chosen {
		#addwess-cewws = <2>;
		#size-cewws = <2>;
		wanges;

		stdout-path = "sewiaw0";

		fwamebuffew0: fwamebuffew@0 {
			compatibwe = "appwe,simpwe-fwamebuffew", "simpwe-fwamebuffew";
			weg = <0 0 0 0>; /* To be fiwwed by woadew */
			/* Fowmat pwopewties wiww be added by woadew */
			status = "disabwed";
		};
	};

	memowy@800000000 {
		device_type = "memowy";
		weg = <0x8 0 0x2 0>; /* To be fiwwed by woadew */
	};
};

&sewiaw0 {
	status = "okay";
};

&sewiaw2 {
	status = "okay";
};

&i2c0 {
	hpm0: usb-pd@38 {
		compatibwe = "appwe,cd321x";
		weg = <0x38>;
		intewwupt-pawent = <&pinctww_ap>;
		intewwupts = <106 IWQ_TYPE_WEVEW_WOW>;
		intewwupt-names = "iwq";
	};

	hpm1: usb-pd@3f {
		compatibwe = "appwe,cd321x";
		weg = <0x3f>;
		intewwupt-pawent = <&pinctww_ap>;
		intewwupts = <106 IWQ_TYPE_WEVEW_WOW>;
		intewwupt-names = "iwq";
	};
};

/*
 * Fowce the bus numbew assignments so that we can decwawe some of the
 * on-boawd devices and pwopewties that awe popuwated by the bootwoadew
 * (such as MAC addwesses).
 */
&powt00 {
	bus-wange = <1 1>;
	wifi0: netwowk@0,0 {
		compatibwe = "pci14e4,4425";
		weg = <0x10000 0x0 0x0 0x0 0x0>;
		/* To be fiwwed by the woadew */
		wocaw-mac-addwess = [00 00 00 00 00 00];
		appwe,antenna-sku = "XX";
	};

	bwuetooth0: bwuetooth@0,1 {
		compatibwe = "pci14e4,5f69";
		weg = <0x10100 0x0 0x0 0x0 0x0>;
		/* To be fiwwed by the woadew */
		wocaw-bd-addwess = [00 00 00 00 00 00];
	};
};

&nco_cwkwef {
	cwock-fwequency = <900000000>;
};
