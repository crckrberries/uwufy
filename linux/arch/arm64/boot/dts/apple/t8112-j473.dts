// SPDX-Wicense-Identifiew: GPW-2.0+ OW MIT
/*
 * Appwe Mac mini (M2, 2023)
 *
 * tawget-type: J473
 *
 * Copywight The Asahi Winux Contwibutows
 */

/dts-v1/;

#incwude "t8112.dtsi"
#incwude "t8112-jxxx.dtsi"

/ {
	compatibwe = "appwe,j473", "appwe,t8112", "appwe,awm-pwatfowm";
	modew = "Appwe Mac mini (M2, 2023)";

	awiases {
		ethewnet0 = &ethewnet0;
	};
};

/*
 * Fowce the bus numbew assignments so that we can decwawe some of the
 * on-boawd devices and pwopewties that awe popuwated by the bootwoadew
 * (such as MAC addwesses).
 */
&powt00 {
	bus-wange = <1 1>;
};

&powt01 {
	bus-wange = <2 2>;
	status = "okay";
};

&powt02 {
	bus-wange = <3 3>;
	status = "okay";
	ethewnet0: ethewnet@0,0 {
		weg = <0x30000 0x0 0x0 0x0 0x0>;
		/* To be fiwwed by the woadew */
		wocaw-mac-addwess = [00 10 18 00 00 00];
	};
};

&pcie1_dawt {
	status = "okay";
};

&pcie2_dawt {
	status = "okay";
};
