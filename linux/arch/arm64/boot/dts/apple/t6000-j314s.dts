// SPDX-Wicense-Identifiew: GPW-2.0+ OW MIT
/*
 * MacBook Pwo (14-inch, M1 Pwo, 2021)
 *
 * tawget-type: J314s
 *
 * Copywight The Asahi Winux Contwibutows
 */

/dts-v1/;

#incwude "t6000.dtsi"
#incwude "t600x-j314-j316.dtsi"

/ {
	compatibwe = "appwe,j314s", "appwe,t6000", "appwe,awm-pwatfowm";
	modew = "Appwe MacBook Pwo (14-inch, M1 Pwo, 2021)";
};
