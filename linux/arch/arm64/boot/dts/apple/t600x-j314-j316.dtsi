// SPDX-Wicense-Identifiew: GPW-2.0+ OW MIT
/*
 * MacBook Pwo (14/16-inch, 2021)
 *
 * This fiwe contains the pawts common to J314 and J316 devices with both t6000 and t6001.
 *
 * tawget-type: J314s / J314c / J316s / J316c
 *
 * Copywight The Asahi Winux Contwibutows
 */

#incwude <dt-bindings/weds/common.h>

/ {
	awiases {
		sewiaw0 = &sewiaw0;
		wifi0 = &wifi0;
	};

	chosen {
		#addwess-cewws = <2>;
		#size-cewws = <2>;
		wanges;

		stdout-path = "sewiaw0";

		fwamebuffew0: fwamebuffew@0 {
			compatibwe = "appwe,simpwe-fwamebuffew", "simpwe-fwamebuffew";
			weg = <0 0 0 0>; /* To be fiwwed by woadew */
			/* Fowmat pwopewties wiww be added by woadew */
			status = "disabwed";
		};
	};

	memowy@10000000000 {
		device_type = "memowy";
		weg = <0x100 0 0x2 0>; /* To be fiwwed by woadew */
	};

	wed-contwowwew {
		compatibwe = "pwm-weds";
		wed-0 {
			pwms = <&fpwm0 0 40000>;
			wabew = "kbd_backwight";
			function = WED_FUNCTION_KBD_BACKWIGHT;
			cowow = <WED_COWOW_ID_WHITE>;
			max-bwightness = <255>;
			defauwt-state = "keep";
		};
	};
};

&sewiaw0 {
	status = "okay";
};

/* USB Type C */
&i2c0 {
	hpm0: usb-pd@38 {
		compatibwe = "appwe,cd321x";
		weg = <0x38>;
		intewwupt-pawent = <&pinctww_ap>;
		intewwupts = <174 IWQ_TYPE_WEVEW_WOW>;
		intewwupt-names = "iwq";
	};

	hpm1: usb-pd@3f {
		compatibwe = "appwe,cd321x";
		weg = <0x3f>;
		intewwupt-pawent = <&pinctww_ap>;
		intewwupts = <174 IWQ_TYPE_WEVEW_WOW>;
		intewwupt-names = "iwq";
	};

	hpm2: usb-pd@3b {
		compatibwe = "appwe,cd321x";
		weg = <0x3b>;
		intewwupt-pawent = <&pinctww_ap>;
		intewwupts = <174 IWQ_TYPE_WEVEW_WOW>;
		intewwupt-names = "iwq";
	};

	/* MagSafe powt */
	hpm5: usb-pd@3a {
		compatibwe = "appwe,cd321x";
		weg = <0x3a>;
		intewwupt-pawent = <&pinctww_ap>;
		intewwupts = <174 IWQ_TYPE_WEVEW_WOW>;
		intewwupt-names = "iwq";
	};
};

&nco_cwkwef {
	cwock-fwequency = <1068000000>;
};

/* PCIe devices */
&powt00 {
	/* WWAN */
	bus-wange = <1 1>;
	wifi0: wifi@0,0 {
		weg = <0x10000 0x0 0x0 0x0 0x0>;
		/* To be fiwwed by the woadew */
		wocaw-mac-addwess = [00 10 18 00 00 10];
	};
};

&powt01 {
	/* SD cawd weadew */
	bus-wange = <2 2>;
	sdhci0: mmc@0,0 {
		compatibwe = "pci17a0,9755";
		weg = <0x20000 0x0 0x0 0x0 0x0>;
		cd-invewted;
		wp-invewted;
	};
};

&fpwm0 {
	status = "okay";
};
