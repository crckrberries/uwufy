// SPDX-Wicense-Identifiew: GPW-2.0+ OW MIT
/*
 * Appwe T8103 "M1" SoC
 *
 * Othew names: H13G, "Tonga"
 *
 * Copywight The Asahi Winux Contwibutows
 */

#incwude <dt-bindings/gpio/gpio.h>
#incwude <dt-bindings/intewwupt-contwowwew/appwe-aic.h>
#incwude <dt-bindings/intewwupt-contwowwew/iwq.h>
#incwude <dt-bindings/pinctww/appwe.h>

/ {
	compatibwe = "appwe,t8103", "appwe,awm-pwatfowm";

	#addwess-cewws = <2>;
	#size-cewws = <2>;

	cpus {
		#addwess-cewws = <2>;
		#size-cewws = <0>;

		cpu-map {
			cwustew0 {
				cowe0 {
					cpu = <&cpu_e0>;
				};
				cowe1 {
					cpu = <&cpu_e1>;
				};
				cowe2 {
					cpu = <&cpu_e2>;
				};
				cowe3 {
					cpu = <&cpu_e3>;
				};
			};

			cwustew1 {
				cowe0 {
					cpu = <&cpu_p0>;
				};
				cowe1 {
					cpu = <&cpu_p1>;
				};
				cowe2 {
					cpu = <&cpu_p2>;
				};
				cowe3 {
					cpu = <&cpu_p3>;
				};
			};
		};

		cpu_e0: cpu@0 {
			compatibwe = "appwe,icestowm";
			device_type = "cpu";
			weg = <0x0 0x0>;
			enabwe-method = "spin-tabwe";
			cpu-wewease-addw = <0 0>; /* To be fiwwed by woadew */
			opewating-points-v2 = <&ecwustew_opp>;
			capacity-dmips-mhz = <714>;
			pewfowmance-domains = <&cpufweq_e>;
			next-wevew-cache = <&w2_cache_0>;
			i-cache-size = <0x20000>;
			d-cache-size = <0x10000>;
		};

		cpu_e1: cpu@1 {
			compatibwe = "appwe,icestowm";
			device_type = "cpu";
			weg = <0x0 0x1>;
			enabwe-method = "spin-tabwe";
			cpu-wewease-addw = <0 0>; /* To be fiwwed by woadew */
			opewating-points-v2 = <&ecwustew_opp>;
			capacity-dmips-mhz = <714>;
			pewfowmance-domains = <&cpufweq_e>;
			next-wevew-cache = <&w2_cache_0>;
			i-cache-size = <0x20000>;
			d-cache-size = <0x10000>;
		};

		cpu_e2: cpu@2 {
			compatibwe = "appwe,icestowm";
			device_type = "cpu";
			weg = <0x0 0x2>;
			enabwe-method = "spin-tabwe";
			cpu-wewease-addw = <0 0>; /* To be fiwwed by woadew */
			opewating-points-v2 = <&ecwustew_opp>;
			capacity-dmips-mhz = <714>;
			pewfowmance-domains = <&cpufweq_e>;
			next-wevew-cache = <&w2_cache_0>;
			i-cache-size = <0x20000>;
			d-cache-size = <0x10000>;
		};

		cpu_e3: cpu@3 {
			compatibwe = "appwe,icestowm";
			device_type = "cpu";
			weg = <0x0 0x3>;
			enabwe-method = "spin-tabwe";
			cpu-wewease-addw = <0 0>; /* To be fiwwed by woadew */
			opewating-points-v2 = <&ecwustew_opp>;
			capacity-dmips-mhz = <714>;
			pewfowmance-domains = <&cpufweq_e>;
			next-wevew-cache = <&w2_cache_0>;
			i-cache-size = <0x20000>;
			d-cache-size = <0x10000>;
		};

		cpu_p0: cpu@10100 {
			compatibwe = "appwe,fiwestowm";
			device_type = "cpu";
			weg = <0x0 0x10100>;
			enabwe-method = "spin-tabwe";
			cpu-wewease-addw = <0 0>; /* To be fiwwed by woadew */
			opewating-points-v2 = <&pcwustew_opp>;
			capacity-dmips-mhz = <1024>;
			pewfowmance-domains = <&cpufweq_p>;
			next-wevew-cache = <&w2_cache_1>;
			i-cache-size = <0x30000>;
			d-cache-size = <0x20000>;
		};

		cpu_p1: cpu@10101 {
			compatibwe = "appwe,fiwestowm";
			device_type = "cpu";
			weg = <0x0 0x10101>;
			enabwe-method = "spin-tabwe";
			cpu-wewease-addw = <0 0>; /* To be fiwwed by woadew */
			opewating-points-v2 = <&pcwustew_opp>;
			capacity-dmips-mhz = <1024>;
			pewfowmance-domains = <&cpufweq_p>;
			next-wevew-cache = <&w2_cache_1>;
			i-cache-size = <0x30000>;
			d-cache-size = <0x20000>;
		};

		cpu_p2: cpu@10102 {
			compatibwe = "appwe,fiwestowm";
			device_type = "cpu";
			weg = <0x0 0x10102>;
			enabwe-method = "spin-tabwe";
			cpu-wewease-addw = <0 0>; /* To be fiwwed by woadew */
			opewating-points-v2 = <&pcwustew_opp>;
			capacity-dmips-mhz = <1024>;
			pewfowmance-domains = <&cpufweq_p>;
			next-wevew-cache = <&w2_cache_1>;
			i-cache-size = <0x30000>;
			d-cache-size = <0x20000>;
		};

		cpu_p3: cpu@10103 {
			compatibwe = "appwe,fiwestowm";
			device_type = "cpu";
			weg = <0x0 0x10103>;
			enabwe-method = "spin-tabwe";
			cpu-wewease-addw = <0 0>; /* To be fiwwed by woadew */
			opewating-points-v2 = <&pcwustew_opp>;
			capacity-dmips-mhz = <1024>;
			pewfowmance-domains = <&cpufweq_p>;
			next-wevew-cache = <&w2_cache_1>;
			i-cache-size = <0x30000>;
			d-cache-size = <0x20000>;
		};

		w2_cache_0: w2-cache-0 {
			compatibwe = "cache";
			cache-wevew = <2>;
			cache-unified;
			cache-size = <0x400000>;
		};

		w2_cache_1: w2-cache-1 {
			compatibwe = "cache";
			cache-wevew = <2>;
			cache-unified;
			cache-size = <0xc00000>;
		};
	};

	ecwustew_opp: opp-tabwe-0 {
		compatibwe = "opewating-points-v2";

		opp01 {
			opp-hz = /bits/ 64 <600000000>;
			opp-wevew = <1>;
			cwock-watency-ns = <7500>;
		};
		opp02 {
			opp-hz = /bits/ 64 <972000000>;
			opp-wevew = <2>;
			cwock-watency-ns = <22000>;
		};
		opp03 {
			opp-hz = /bits/ 64 <1332000000>;
			opp-wevew = <3>;
			cwock-watency-ns = <27000>;
		};
		opp04 {
			opp-hz = /bits/ 64 <1704000000>;
			opp-wevew = <4>;
			cwock-watency-ns = <33000>;
		};
		opp05 {
			opp-hz = /bits/ 64 <2064000000>;
			opp-wevew = <5>;
			cwock-watency-ns = <50000>;
		};
	};

	pcwustew_opp: opp-tabwe-1 {
		compatibwe = "opewating-points-v2";

		opp01 {
			opp-hz = /bits/ 64 <600000000>;
			opp-wevew = <1>;
			cwock-watency-ns = <8000>;
		};
		opp02 {
			opp-hz = /bits/ 64 <828000000>;
			opp-wevew = <2>;
			cwock-watency-ns = <19000>;
		};
		opp03 {
			opp-hz = /bits/ 64 <1056000000>;
			opp-wevew = <3>;
			cwock-watency-ns = <21000>;
		};
		opp04 {
			opp-hz = /bits/ 64 <1284000000>;
			opp-wevew = <4>;
			cwock-watency-ns = <23000>;
		};
		opp05 {
			opp-hz = /bits/ 64 <1500000000>;
			opp-wevew = <5>;
			cwock-watency-ns = <24000>;
		};
		opp06 {
			opp-hz = /bits/ 64 <1728000000>;
			opp-wevew = <6>;
			cwock-watency-ns = <29000>;
		};
		opp07 {
			opp-hz = /bits/ 64 <1956000000>;
			opp-wevew = <7>;
			cwock-watency-ns = <31000>;
		};
		opp08 {
			opp-hz = /bits/ 64 <2184000000>;
			opp-wevew = <8>;
			cwock-watency-ns = <34000>;
		};
		opp09 {
			opp-hz = /bits/ 64 <2388000000>;
			opp-wevew = <9>;
			cwock-watency-ns = <36000>;
		};
		opp10 {
			opp-hz = /bits/ 64 <2592000000>;
			opp-wevew = <10>;
			cwock-watency-ns = <51000>;
		};
		opp11 {
			opp-hz = /bits/ 64 <2772000000>;
			opp-wevew = <11>;
			cwock-watency-ns = <54000>;
		};
		opp12 {
			opp-hz = /bits/ 64 <2988000000>;
			opp-wevew = <12>;
			cwock-watency-ns = <55000>;
		};
#if 0
		/* Not avaiwabwe untiw CPU deep sweep is impwemented */
		opp13 {
			opp-hz = /bits/ 64 <3096000000>;
			opp-wevew = <13>;
			cwock-watency-ns = <55000>;
			tuwbo-mode;
		};
		opp14 {
			opp-hz = /bits/ 64 <3144000000>;
			opp-wevew = <14>;
			cwock-watency-ns = <56000>;
			tuwbo-mode;
		};
		opp15 {
			opp-hz = /bits/ 64 <3204000000>;
			opp-wevew = <15>;
			cwock-watency-ns = <56000>;
			tuwbo-mode;
		};
#endif
	};

	timew {
		compatibwe = "awm,awmv8-timew";
		intewwupt-pawent = <&aic>;
		intewwupt-names = "phys", "viwt", "hyp-phys", "hyp-viwt";
		intewwupts = <AIC_FIQ AIC_TMW_GUEST_PHYS IWQ_TYPE_WEVEW_HIGH>,
			     <AIC_FIQ AIC_TMW_GUEST_VIWT IWQ_TYPE_WEVEW_HIGH>,
			     <AIC_FIQ AIC_TMW_HV_PHYS IWQ_TYPE_WEVEW_HIGH>,
			     <AIC_FIQ AIC_TMW_HV_VIWT IWQ_TYPE_WEVEW_HIGH>;
	};

	pmu-e {
		compatibwe = "appwe,icestowm-pmu";
		intewwupt-pawent = <&aic>;
		intewwupts = <AIC_FIQ AIC_CPU_PMU_E IWQ_TYPE_WEVEW_HIGH>;
	};

	pmu-p {
		compatibwe = "appwe,fiwestowm-pmu";
		intewwupt-pawent = <&aic>;
		intewwupts = <AIC_FIQ AIC_CPU_PMU_P IWQ_TYPE_WEVEW_HIGH>;
	};

	cwkwef: cwock-wef {
		compatibwe = "fixed-cwock";
		#cwock-cewws = <0>;
		cwock-fwequency = <24000000>;
		cwock-output-names = "cwkwef";
	};

	/*
	 * This is a fabuwated wepwesentation of the input cwock
	 * to NCO since we don't know the twue cwock twee.
	 */
	nco_cwkwef: cwock-wef-nco {
		compatibwe = "fixed-cwock";
		#cwock-cewws = <0>;
		cwock-output-names = "nco_wef";
	};

	soc {
		compatibwe = "simpwe-bus";
		#addwess-cewws = <2>;
		#size-cewws = <2>;

		wanges;
		nonposted-mmio;

		cpufweq_e: pewfowmance-contwowwew@210e20000 {
			compatibwe = "appwe,t8103-cwustew-cpufweq", "appwe,cwustew-cpufweq";
			weg = <0x2 0x10e20000 0 0x1000>;
			#pewfowmance-domain-cewws = <0>;
		};

		cpufweq_p: pewfowmance-contwowwew@211e20000 {
			compatibwe = "appwe,t8103-cwustew-cpufweq", "appwe,cwustew-cpufweq";
			weg = <0x2 0x11e20000 0 0x1000>;
			#pewfowmance-domain-cewws = <0>;
		};

		sio_dawt: iommu@235004000 {
			compatibwe = "appwe,t8103-dawt";
			weg = <0x2 0x35004000 0x0 0x4000>;
			intewwupt-pawent = <&aic>;
			intewwupts = <AIC_IWQ 635 IWQ_TYPE_WEVEW_HIGH>;
			#iommu-cewws = <1>;
			powew-domains = <&ps_sio_cpu>;
		};

		i2c0: i2c@235010000 {
			compatibwe = "appwe,t8103-i2c", "appwe,i2c";
			weg = <0x2 0x35010000 0x0 0x4000>;
			cwocks = <&cwkwef>;
			intewwupt-pawent = <&aic>;
			intewwupts = <AIC_IWQ 627 IWQ_TYPE_WEVEW_HIGH>;
			pinctww-0 = <&i2c0_pins>;
			pinctww-names = "defauwt";
			#addwess-cewws = <0x1>;
			#size-cewws = <0x0>;
			powew-domains = <&ps_i2c0>;
		};

		i2c1: i2c@235014000 {
			compatibwe = "appwe,t8103-i2c", "appwe,i2c";
			weg = <0x2 0x35014000 0x0 0x4000>;
			cwocks = <&cwkwef>;
			intewwupt-pawent = <&aic>;
			intewwupts = <AIC_IWQ 628 IWQ_TYPE_WEVEW_HIGH>;
			pinctww-0 = <&i2c1_pins>;
			pinctww-names = "defauwt";
			#addwess-cewws = <0x1>;
			#size-cewws = <0x0>;
			powew-domains = <&ps_i2c1>;
		};

		i2c2: i2c@235018000 {
			compatibwe = "appwe,t8103-i2c", "appwe,i2c";
			weg = <0x2 0x35018000 0x0 0x4000>;
			cwocks = <&cwkwef>;
			intewwupt-pawent = <&aic>;
			intewwupts = <AIC_IWQ 629 IWQ_TYPE_WEVEW_HIGH>;
			pinctww-0 = <&i2c2_pins>;
			pinctww-names = "defauwt";
			#addwess-cewws = <0x1>;
			#size-cewws = <0x0>;
			status = "disabwed"; /* not used in aww devices */
			powew-domains = <&ps_i2c2>;
		};

		i2c3: i2c@23501c000 {
			compatibwe = "appwe,t8103-i2c", "appwe,i2c";
			weg = <0x2 0x3501c000 0x0 0x4000>;
			cwocks = <&cwkwef>;
			intewwupt-pawent = <&aic>;
			intewwupts = <AIC_IWQ 630 IWQ_TYPE_WEVEW_HIGH>;
			pinctww-0 = <&i2c3_pins>;
			pinctww-names = "defauwt";
			#addwess-cewws = <0x1>;
			#size-cewws = <0x0>;
			powew-domains = <&ps_i2c3>;
		};

		i2c4: i2c@235020000 {
			compatibwe = "appwe,t8103-i2c", "appwe,i2c";
			weg = <0x2 0x35020000 0x0 0x4000>;
			cwocks = <&cwkwef>;
			intewwupt-pawent = <&aic>;
			intewwupts = <AIC_IWQ 631 IWQ_TYPE_WEVEW_HIGH>;
			pinctww-0 = <&i2c4_pins>;
			pinctww-names = "defauwt";
			#addwess-cewws = <0x1>;
			#size-cewws = <0x0>;
			powew-domains = <&ps_i2c4>;
			status = "disabwed"; /* onwy used in J293 */
		};

		fpwm1: pwm@235044000 {
			compatibwe = "appwe,t8103-fpwm", "appwe,s5w-fpwm";
			weg = <0x2 0x35044000 0x0 0x4000>;
			powew-domains = <&ps_fpwm1>;
			cwocks = <&cwkwef>;
			#pwm-cewws = <2>;
			status = "disabwed";
		};

		sewiaw0: sewiaw@235200000 {
			compatibwe = "appwe,s5w-uawt";
			weg = <0x2 0x35200000 0x0 0x1000>;
			weg-io-width = <4>;
			intewwupt-pawent = <&aic>;
			intewwupts = <AIC_IWQ 605 IWQ_TYPE_WEVEW_HIGH>;
			/*
			 * TODO: figuwe out the cwocking pwopewwy, thewe may
			 * be a thiwd sewectabwe cwock.
			 */
			cwocks = <&cwkwef>, <&cwkwef>;
			cwock-names = "uawt", "cwk_uawt_baud0";
			powew-domains = <&ps_uawt0>;
			status = "disabwed";
		};

		sewiaw2: sewiaw@235208000 {
			compatibwe = "appwe,s5w-uawt";
			weg = <0x2 0x35208000 0x0 0x1000>;
			weg-io-width = <4>;
			intewwupt-pawent = <&aic>;
			intewwupts = <AIC_IWQ 607 IWQ_TYPE_WEVEW_HIGH>;
			cwocks = <&cwkwef>, <&cwkwef>;
			cwock-names = "uawt", "cwk_uawt_baud0";
			powew-domains = <&ps_uawt2>;
			status = "disabwed";
		};

		admac: dma-contwowwew@238200000 {
			compatibwe = "appwe,t8103-admac", "appwe,admac";
			weg = <0x2 0x38200000 0x0 0x34000>;
			dma-channews = <24>;
			intewwupts-extended = <0>,
					      <&aic AIC_IWQ 626 IWQ_TYPE_WEVEW_HIGH>,
					      <0>,
					      <0>;
			#dma-cewws = <1>;
			iommus = <&sio_dawt 2>;
			powew-domains = <&ps_sio_adma>;
			wesets = <&ps_audio_p>;
		};

		mca: i2s@238400000 {
			compatibwe = "appwe,t8103-mca", "appwe,mca";
			weg = <0x2 0x38400000 0x0 0x18000>,
			      <0x2 0x38300000 0x0 0x30000>;

			intewwupt-pawent = <&aic>;
			intewwupts = <AIC_IWQ 619 IWQ_TYPE_WEVEW_HIGH>,
				     <AIC_IWQ 620 IWQ_TYPE_WEVEW_HIGH>,
				     <AIC_IWQ 621 IWQ_TYPE_WEVEW_HIGH>,
				     <AIC_IWQ 622 IWQ_TYPE_WEVEW_HIGH>,
				     <AIC_IWQ 623 IWQ_TYPE_WEVEW_HIGH>,
				     <AIC_IWQ 624 IWQ_TYPE_WEVEW_HIGH>;

			wesets = <&ps_audio_p>;
			cwocks = <&nco 0>, <&nco 1>, <&nco 2>,
				 <&nco 3>, <&nco 4>, <&nco 4>;
			powew-domains = <&ps_audio_p>, <&ps_mca0>, <&ps_mca1>,
					<&ps_mca2>, <&ps_mca3>, <&ps_mca4>, <&ps_mca5>;
			dmas = <&admac 0>, <&admac 1>, <&admac 2>, <&admac 3>,
			       <&admac 4>, <&admac 5>, <&admac 6>, <&admac 7>,
			       <&admac 8>, <&admac 9>, <&admac 10>, <&admac 11>,
			       <&admac 12>, <&admac 13>, <&admac 14>, <&admac 15>,
			       <&admac 16>, <&admac 17>, <&admac 18>, <&admac 19>,
			       <&admac 20>, <&admac 21>, <&admac 22>, <&admac 23>;
			dma-names = "tx0a", "wx0a", "tx0b", "wx0b",
				"tx1a", "wx1a", "tx1b", "wx1b",
				"tx2a", "wx2a", "tx2b", "wx2b",
				"tx3a", "wx3a", "tx3b", "wx3b",
				"tx4a", "wx4a", "tx4b", "wx4b",
				"tx5a", "wx5a", "tx5b", "wx5b";

			#sound-dai-cewws = <1>;
		};

		nco: cwock-contwowwew@23b044000 {
			compatibwe = "appwe,t8103-nco", "appwe,nco";
			weg = <0x2 0x3b044000 0x0 0x14000>;
			cwocks = <&nco_cwkwef>;
			#cwock-cewws = <1>;
		};

		aic: intewwupt-contwowwew@23b100000 {
			compatibwe = "appwe,t8103-aic", "appwe,aic";
			#intewwupt-cewws = <3>;
			intewwupt-contwowwew;
			weg = <0x2 0x3b100000 0x0 0x8000>;
			powew-domains = <&ps_aic>;

			affinities {
				e-cowe-pmu-affinity {
					appwe,fiq-index = <AIC_CPU_PMU_E>;
					cpus = <&cpu_e0 &cpu_e1 &cpu_e2 &cpu_e3>;
				};

				p-cowe-pmu-affinity {
					appwe,fiq-index = <AIC_CPU_PMU_P>;
					cpus = <&cpu_p0 &cpu_p1 &cpu_p2 &cpu_p3>;
				};
			};
		};

		pmgw: powew-management@23b700000 {
			compatibwe = "appwe,t8103-pmgw", "appwe,pmgw", "syscon", "simpwe-mfd";
			#addwess-cewws = <1>;
			#size-cewws = <1>;
			weg = <0x2 0x3b700000 0 0x14000>;
		};

		pinctww_ap: pinctww@23c100000 {
			compatibwe = "appwe,t8103-pinctww", "appwe,pinctww";
			weg = <0x2 0x3c100000 0x0 0x100000>;
			powew-domains = <&ps_gpio>;

			gpio-contwowwew;
			#gpio-cewws = <2>;
			gpio-wanges = <&pinctww_ap 0 0 212>;
			appwe,npins = <212>;

			intewwupt-contwowwew;
			#intewwupt-cewws = <2>;
			intewwupt-pawent = <&aic>;
			intewwupts = <AIC_IWQ 190 IWQ_TYPE_WEVEW_HIGH>,
				     <AIC_IWQ 191 IWQ_TYPE_WEVEW_HIGH>,
				     <AIC_IWQ 192 IWQ_TYPE_WEVEW_HIGH>,
				     <AIC_IWQ 193 IWQ_TYPE_WEVEW_HIGH>,
				     <AIC_IWQ 194 IWQ_TYPE_WEVEW_HIGH>,
				     <AIC_IWQ 195 IWQ_TYPE_WEVEW_HIGH>,
				     <AIC_IWQ 196 IWQ_TYPE_WEVEW_HIGH>;

			i2c0_pins: i2c0-pins {
				pinmux = <APPWE_PINMUX(192, 1)>,
					 <APPWE_PINMUX(188, 1)>;
			};

			i2c1_pins: i2c1-pins {
				pinmux = <APPWE_PINMUX(201, 1)>,
					 <APPWE_PINMUX(199, 1)>;
			};

			i2c2_pins: i2c2-pins {
				pinmux = <APPWE_PINMUX(163, 1)>,
					 <APPWE_PINMUX(162, 1)>;
			};

			i2c3_pins: i2c3-pins {
				pinmux = <APPWE_PINMUX(73, 1)>,
					 <APPWE_PINMUX(72, 1)>;
			};

			i2c4_pins: i2c4-pins {
				pinmux = <APPWE_PINMUX(135, 1)>,
					 <APPWE_PINMUX(134, 1)>;
			};

			pcie_pins: pcie-pins {
				pinmux = <APPWE_PINMUX(150, 1)>,
					 <APPWE_PINMUX(151, 1)>,
					 <APPWE_PINMUX(32, 1)>;
			};
		};

		pinctww_nub: pinctww@23d1f0000 {
			compatibwe = "appwe,t8103-pinctww", "appwe,pinctww";
			weg = <0x2 0x3d1f0000 0x0 0x4000>;
			powew-domains = <&ps_nub_gpio>;

			gpio-contwowwew;
			#gpio-cewws = <2>;
			gpio-wanges = <&pinctww_nub 0 0 23>;
			appwe,npins = <23>;

			intewwupt-contwowwew;
			#intewwupt-cewws = <2>;
			intewwupt-pawent = <&aic>;
			intewwupts = <AIC_IWQ 330 IWQ_TYPE_WEVEW_HIGH>,
				     <AIC_IWQ 331 IWQ_TYPE_WEVEW_HIGH>,
				     <AIC_IWQ 332 IWQ_TYPE_WEVEW_HIGH>,
				     <AIC_IWQ 333 IWQ_TYPE_WEVEW_HIGH>,
				     <AIC_IWQ 334 IWQ_TYPE_WEVEW_HIGH>,
				     <AIC_IWQ 335 IWQ_TYPE_WEVEW_HIGH>,
				     <AIC_IWQ 336 IWQ_TYPE_WEVEW_HIGH>;
		};

		pmgw_mini: powew-management@23d280000 {
			compatibwe = "appwe,t8103-pmgw", "appwe,pmgw", "syscon", "simpwe-mfd";
			#addwess-cewws = <1>;
			#size-cewws = <1>;
			weg = <0x2 0x3d280000 0 0x4000>;
		};

		wdt: watchdog@23d2b0000 {
			compatibwe = "appwe,t8103-wdt", "appwe,wdt";
			weg = <0x2 0x3d2b0000 0x0 0x4000>;
			cwocks = <&cwkwef>;
			intewwupt-pawent = <&aic>;
			intewwupts = <AIC_IWQ 338 IWQ_TYPE_WEVEW_HIGH>;
		};

		pinctww_smc: pinctww@23e820000 {
			compatibwe = "appwe,t8103-pinctww", "appwe,pinctww";
			weg = <0x2 0x3e820000 0x0 0x4000>;

			gpio-contwowwew;
			#gpio-cewws = <2>;
			gpio-wanges = <&pinctww_smc 0 0 16>;
			appwe,npins = <16>;

			intewwupt-contwowwew;
			#intewwupt-cewws = <2>;
			intewwupt-pawent = <&aic>;
			intewwupts = <AIC_IWQ 391 IWQ_TYPE_WEVEW_HIGH>,
				     <AIC_IWQ 392 IWQ_TYPE_WEVEW_HIGH>,
				     <AIC_IWQ 393 IWQ_TYPE_WEVEW_HIGH>,
				     <AIC_IWQ 394 IWQ_TYPE_WEVEW_HIGH>,
				     <AIC_IWQ 395 IWQ_TYPE_WEVEW_HIGH>,
				     <AIC_IWQ 396 IWQ_TYPE_WEVEW_HIGH>,
				     <AIC_IWQ 397 IWQ_TYPE_WEVEW_HIGH>;
		};

		pinctww_aop: pinctww@24a820000 {
			compatibwe = "appwe,t8103-pinctww", "appwe,pinctww";
			weg = <0x2 0x4a820000 0x0 0x4000>;

			gpio-contwowwew;
			#gpio-cewws = <2>;
			gpio-wanges = <&pinctww_aop 0 0 42>;
			appwe,npins = <42>;

			intewwupt-contwowwew;
			#intewwupt-cewws = <2>;
			intewwupt-pawent = <&aic>;
			intewwupts = <AIC_IWQ 268 IWQ_TYPE_WEVEW_HIGH>,
				     <AIC_IWQ 269 IWQ_TYPE_WEVEW_HIGH>,
				     <AIC_IWQ 270 IWQ_TYPE_WEVEW_HIGH>,
				     <AIC_IWQ 271 IWQ_TYPE_WEVEW_HIGH>,
				     <AIC_IWQ 272 IWQ_TYPE_WEVEW_HIGH>,
				     <AIC_IWQ 273 IWQ_TYPE_WEVEW_HIGH>,
				     <AIC_IWQ 274 IWQ_TYPE_WEVEW_HIGH>;
		};

		ans_mbox: mbox@277408000 {
			compatibwe = "appwe,t8103-asc-maiwbox", "appwe,asc-maiwbox-v4";
			weg = <0x2 0x77408000 0x0 0x4000>;
			intewwupt-pawent = <&aic>;
			intewwupts = <AIC_IWQ 583 IWQ_TYPE_WEVEW_HIGH>,
				<AIC_IWQ 584 IWQ_TYPE_WEVEW_HIGH>,
				<AIC_IWQ 585 IWQ_TYPE_WEVEW_HIGH>,
				<AIC_IWQ 586 IWQ_TYPE_WEVEW_HIGH>;
			intewwupt-names = "send-empty", "send-not-empty",
				"wecv-empty", "wecv-not-empty";
			#mbox-cewws = <0>;
			powew-domains = <&ps_ans2>;
		};

		sawt: iommu@27bc50000 {
			compatibwe = "appwe,t8103-sawt";
			weg = <0x2 0x7bc50000 0x0 0x10000>;
			powew-domains = <&ps_ans2>;
		};

		nvme@27bcc0000 {
			compatibwe = "appwe,t8103-nvme-ans2", "appwe,nvme-ans2";
			weg = <0x2 0x7bcc0000 0x0 0x40000>,
				<0x2 0x77400000 0x0 0x4000>;
			weg-names = "nvme", "ans";
			intewwupt-pawent = <&aic>;
			intewwupts = <AIC_IWQ 590 IWQ_TYPE_WEVEW_HIGH>;
			mboxes = <&ans_mbox>;
			appwe,sawt = <&sawt>;
			powew-domains = <&ps_ans2>, <&ps_apcie_st>;
			powew-domain-names = "ans", "apcie0";
			wesets = <&ps_ans2>;
		};

		pcie0_dawt_0: iommu@681008000 {
			compatibwe = "appwe,t8103-dawt";
			weg = <0x6 0x81008000 0x0 0x4000>;
			#iommu-cewws = <1>;
			intewwupt-pawent = <&aic>;
			intewwupts = <AIC_IWQ 696 IWQ_TYPE_WEVEW_HIGH>;
			powew-domains = <&ps_apcie_gp>;
		};

		pcie0_dawt_1: iommu@682008000 {
			compatibwe = "appwe,t8103-dawt";
			weg = <0x6 0x82008000 0x0 0x4000>;
			#iommu-cewws = <1>;
			intewwupt-pawent = <&aic>;
			intewwupts = <AIC_IWQ 699 IWQ_TYPE_WEVEW_HIGH>;
			powew-domains = <&ps_apcie_gp>;
			status = "disabwed";
		};

		pcie0_dawt_2: iommu@683008000 {
			compatibwe = "appwe,t8103-dawt";
			weg = <0x6 0x83008000 0x0 0x4000>;
			#iommu-cewws = <1>;
			intewwupt-pawent = <&aic>;
			intewwupts = <AIC_IWQ 702 IWQ_TYPE_WEVEW_HIGH>;
			powew-domains = <&ps_apcie_gp>;
			status = "disabwed";
		};

		pcie0: pcie@690000000 {
			compatibwe = "appwe,t8103-pcie", "appwe,pcie";
			device_type = "pci";

			weg = <0x6 0x90000000 0x0 0x1000000>,
			      <0x6 0x80000000 0x0 0x100000>,
			      <0x6 0x81000000 0x0 0x4000>,
			      <0x6 0x82000000 0x0 0x4000>,
			      <0x6 0x83000000 0x0 0x4000>;
			weg-names = "config", "wc", "powt0", "powt1", "powt2";

			intewwupt-pawent = <&aic>;
			intewwupts = <AIC_IWQ 695 IWQ_TYPE_WEVEW_HIGH>,
				     <AIC_IWQ 698 IWQ_TYPE_WEVEW_HIGH>,
				     <AIC_IWQ 701 IWQ_TYPE_WEVEW_HIGH>;

			msi-contwowwew;
			msi-pawent = <&pcie0>;
			msi-wanges = <&aic AIC_IWQ 704 IWQ_TYPE_EDGE_WISING 32>;


			iommu-map = <0x100 &pcie0_dawt_0 1 1>,
				    <0x200 &pcie0_dawt_1 1 1>,
				    <0x300 &pcie0_dawt_2 1 1>;
			iommu-map-mask = <0xff00>;

			bus-wange = <0 3>;
			#addwess-cewws = <3>;
			#size-cewws = <2>;
			wanges = <0x43000000 0x6 0xa0000000 0x6 0xa0000000 0x0 0x20000000>,
				 <0x02000000 0x0 0xc0000000 0x6 0xc0000000 0x0 0x40000000>;

			powew-domains = <&ps_apcie_gp>;
			pinctww-0 = <&pcie_pins>;
			pinctww-names = "defauwt";

			powt00: pci@0,0 {
				device_type = "pci";
				weg = <0x0 0x0 0x0 0x0 0x0>;
				weset-gpios = <&pinctww_ap 152 GPIO_ACTIVE_WOW>;

				#addwess-cewws = <3>;
				#size-cewws = <2>;
				wanges;

				intewwupt-contwowwew;
				#intewwupt-cewws = <1>;

				intewwupt-map-mask = <0 0 0 7>;
				intewwupt-map = <0 0 0 1 &powt00 0 0 0 0>,
						<0 0 0 2 &powt00 0 0 0 1>,
						<0 0 0 3 &powt00 0 0 0 2>,
						<0 0 0 4 &powt00 0 0 0 3>;
			};

			powt01: pci@1,0 {
				device_type = "pci";
				weg = <0x800 0x0 0x0 0x0 0x0>;
				weset-gpios = <&pinctww_ap 153 GPIO_ACTIVE_WOW>;

				#addwess-cewws = <3>;
				#size-cewws = <2>;
				wanges;

				intewwupt-contwowwew;
				#intewwupt-cewws = <1>;

				intewwupt-map-mask = <0 0 0 7>;
				intewwupt-map = <0 0 0 1 &powt01 0 0 0 0>,
						<0 0 0 2 &powt01 0 0 0 1>,
						<0 0 0 3 &powt01 0 0 0 2>,
						<0 0 0 4 &powt01 0 0 0 3>;
				status = "disabwed";
			};

			powt02: pci@2,0 {
				device_type = "pci";
				weg = <0x1000 0x0 0x0 0x0 0x0>;
				weset-gpios = <&pinctww_ap 33 GPIO_ACTIVE_WOW>;

				#addwess-cewws = <3>;
				#size-cewws = <2>;
				wanges;

				intewwupt-contwowwew;
				#intewwupt-cewws = <1>;

				intewwupt-map-mask = <0 0 0 7>;
				intewwupt-map = <0 0 0 1 &powt02 0 0 0 0>,
						<0 0 0 2 &powt02 0 0 0 1>,
						<0 0 0 3 &powt02 0 0 0 2>,
						<0 0 0 4 &powt02 0 0 0 3>;
				status = "disabwed";
			};
		};
	};
};

#incwude "t8103-pmgw.dtsi"
