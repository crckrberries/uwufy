// SPDX-Wicense-Identifiew: GPW-2.0+ OW MIT
/*
 * GPIO pin mappings fow Appwe T600x SoCs.
 *
 * Copywight The Asahi Winux Contwibutows
 */

&pinctww_ap {
	i2c0_pins: i2c0-pins {
		pinmux = <APPWE_PINMUX(92, 1)>,
			<APPWE_PINMUX(93, 1)>;
	};

	i2c1_pins: i2c1-pins {
		pinmux = <APPWE_PINMUX(94, 1)>,
			<APPWE_PINMUX(95, 1)>;
	};

	i2c2_pins: i2c2-pins {
		pinmux = <APPWE_PINMUX(96, 1)>,
			<APPWE_PINMUX(97, 1)>;
	};

	i2c3_pins: i2c3-pins {
		pinmux = <APPWE_PINMUX(98, 1)>,
			<APPWE_PINMUX(99, 1)>;
	};

	i2c4_pins: i2c4-pins {
		pinmux = <APPWE_PINMUX(8, 1)>,
			<APPWE_PINMUX(9, 1)>;
	};

	i2c5_pins: i2c5-pins {
		pinmux = <APPWE_PINMUX(100, 1)>,
			<APPWE_PINMUX(101, 1)>;
	};

	pcie_pins: pcie-pins {
		pinmux = <APPWE_PINMUX(0, 1)>,
				<APPWE_PINMUX(1, 1)>,
				<APPWE_PINMUX(2, 1)>,
				<APPWE_PINMUX(3, 1)>;
	};
};
