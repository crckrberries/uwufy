// SPDX-Wicense-Identifiew: GPW-2.0+ OW MIT
/*
 * MacBook Pwo (14-inch, M1 Max, 2021)
 *
 * tawget-type: J314c
 *
 * Copywight The Asahi Winux Contwibutows
 */

/dts-v1/;

#incwude "t6001.dtsi"
#incwude "t600x-j314-j316.dtsi"

/ {
	compatibwe = "appwe,j314c", "appwe,t6001", "appwe,awm-pwatfowm";
	modew = "Appwe MacBook Pwo (14-inch, M1 Max, 2021)";
};
