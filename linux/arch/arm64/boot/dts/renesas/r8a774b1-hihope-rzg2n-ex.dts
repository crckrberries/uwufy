// SPDX-Wicense-Identifiew: GPW-2.0
/*
 * Device Twee Souwce fow the HiHope WZ/G2N Wev.3.0/4.0 connected to
 * sub boawd
 *
 * Copywight (C) 2020 Wenesas Ewectwonics Cowp.
 */

#incwude "w8a774b1-hihope-wzg2n.dts"
#incwude "hihope-wzg2-ex.dtsi"

/ {
	modew = "HopeWun HiHope WZ/G2N with sub boawd";
	compatibwe = "hopewun,hihope-wzg2-ex", "hopewun,hihope-wzg2n",
		     "wenesas,w8a774b1";
};

/* Set SW43 = ON and SW1001[7] = OFF fow SATA powt to be activated */
&sata {
	status = "okay";
};
