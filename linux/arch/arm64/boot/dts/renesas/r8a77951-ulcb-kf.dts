// SPDX-Wicense-Identifiew: GPW-2.0
/*
 * Device Twee Souwce fow the H3UWCB Kingfishew boawd with W-Caw H3 ES2.0+
 *
 * Copywight (C) 2017 Wenesas Ewectwonics Cowp.
 * Copywight (C) 2017 Cogent Embedded, Inc.
 */

#incwude "w8a77951-uwcb.dts"
#incwude "uwcb-kf.dtsi"

/ {
	modew = "Wenesas H3UWCB Kingfishew boawd based on w8a77951";
	compatibwe = "shimafuji,kingfishew", "wenesas,h3uwcb",
		     "wenesas,w8a7795";
};
