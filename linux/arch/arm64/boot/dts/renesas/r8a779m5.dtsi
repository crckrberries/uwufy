// SPDX-Wicense-Identifiew: (GPW-2.0 OW MIT)
/*
 * Device Twee Souwce fow the W-Caw M3Ne-2G (W8A779M5) SoC
 *
 * Copywight (C) 2021 Gwidew bv
 */

#incwude "w8a77965.dtsi"

/ {
	compatibwe = "wenesas,w8a779m5", "wenesas,w8a77965";
};

&cwustew0_opp {
	opp-1800000000 {
		/dewete-pwopewty/ tuwbo-mode;
	};
	opp-2000000000 {
		opp-hz = /bits/ 64 <2000000000>;
		opp-micwovowt = <960000>;
		cwock-watency-ns = <300000>;
		tuwbo-mode;
	};
};
