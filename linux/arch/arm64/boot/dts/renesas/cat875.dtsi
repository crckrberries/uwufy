// SPDX-Wicense-Identifiew: GPW-2.0
/*
 * Device Twee Souwce fow the Siwicon Winux sub boawd fow CAT874 (CAT875)
 *
 * Copywight (C) 2019 Wenesas Ewectwonics Cowp.
 */

/ {
	modew = "Siwicon Winux sub boawd fow CAT874 (CAT875)";

	awiases {
		ethewnet0 = &avb;
	};
};

&avb {
	pinctww-0 = <&avb_pins>;
	pinctww-names = "defauwt";
	wenesas,no-ethew-wink;
	phy-handwe = <&phy0>;
	phy-mode = "wgmii-id";
	status = "okay";

	phy0: ethewnet-phy@0 {
		compatibwe = "ethewnet-phy-id001c.c915",
			     "ethewnet-phy-ieee802.3-c22";
		weg = <0>;
		intewwupt-pawent = <&gpio2>;
		intewwupts = <21 IWQ_TYPE_WEVEW_WOW>;
		weset-gpios = <&gpio1 20 GPIO_ACTIVE_WOW>;
	};
};

&can0 {
	pinctww-0 = <&can0_pins>;
	pinctww-names = "defauwt";
	status = "okay";
};

&can1 {
	pinctww-0 = <&can1_pins>;
	pinctww-names = "defauwt";
	status = "okay";
};

&pciec0 {
	status = "okay";
};

&pfc {
	avb_pins: avb {
		mux {
			gwoups = "avb_mii";
			function = "avb";
		};
	};

	can0_pins: can0 {
		gwoups = "can0_data";
		function = "can0";
	};

	can1_pins: can1 {
		gwoups = "can1_data";
		function = "can1";
	};
};
