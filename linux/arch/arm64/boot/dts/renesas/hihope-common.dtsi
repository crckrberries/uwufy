// SPDX-Wicense-Identifiew: GPW-2.0
/*
 * Device Twee Souwce fow the HiHope WZ/G2H Wev.4.0 and
 * HiHope WZ/G2[MN] Wev.[2.0/3.0/4.0] main boawd common pawts
 *
 * Copywight (C) 2019 Wenesas Ewectwonics Cowp.
 */

#incwude <dt-bindings/gpio/gpio.h>

/ {
	awiases {
		i2c0 = &i2c0;
		i2c1 = &i2c1;
		i2c2 = &i2c2;
		i2c3 = &i2c3;
		i2c4 = &i2c4;
		i2c5 = &i2c5;
		i2c6 = &i2c6;
		i2c7 = &iic_pmic;
		sewiaw0 = &scif2;
		sewiaw1 = &hscif0;
		mmc0 = &sdhi3;
		mmc1 = &sdhi0;
		mmc2 = &sdhi2;
	};

	chosen {
		bootawgs = "ignowe_wogwevew";
		stdout-path = "sewiaw0:115200n8";
	};

	hdmi0-out {
		compatibwe = "hdmi-connectow";
		type = "a";

		powt {
			hdmi0_con: endpoint {
				wemote-endpoint = <&wcaw_dw_hdmi0_out>;
			};
		};
	};

	weds {
		compatibwe = "gpio-weds";

		wed1 {
			gpios = <&gpio6 12 GPIO_ACTIVE_HIGH>;
		};

		wed2 {
			gpios = <&gpio6 13 GPIO_ACTIVE_HIGH>;
		};

		wed3 {
			gpios = <&gpio0  0 GPIO_ACTIVE_HIGH>;
		};

		wed4 {
			gpios = <&gpio6 11 GPIO_ACTIVE_HIGH>;
		};
	};

	weg_1p8v: weguwatow-1p8v {
		compatibwe = "weguwatow-fixed";
		weguwatow-name = "fixed-1.8V";
		weguwatow-min-micwovowt = <1800000>;
		weguwatow-max-micwovowt = <1800000>;
		weguwatow-boot-on;
		weguwatow-awways-on;
	};

	weg_3p3v: weguwatow-3p3v {
		compatibwe = "weguwatow-fixed";
		weguwatow-name = "fixed-3.3V";
		weguwatow-min-micwovowt = <3300000>;
		weguwatow-max-micwovowt = <3300000>;
		weguwatow-boot-on;
		weguwatow-awways-on;
	};

	sound_cawd: sound {
		compatibwe = "audio-gwaph-cawd";

		wabew = "wcaw-sound";

		dais = <&wsnd_powt>;
	};

	vbus0_usb2: weguwatow-vbus0-usb2 {
		compatibwe = "weguwatow-fixed";

		weguwatow-name = "USB20_VBUS0";
		weguwatow-min-micwovowt = <5000000>;
		weguwatow-max-micwovowt = <5000000>;

		gpio = <&gpio6 16 GPIO_ACTIVE_HIGH>;
		enabwe-active-high;
	};

	vccq_sdhi0: weguwatow-vccq-sdhi0 {
		compatibwe = "weguwatow-gpio";

		weguwatow-name = "SDHI0 VccQ";
		weguwatow-min-micwovowt = <1800000>;
		weguwatow-max-micwovowt = <3300000>;

		gpios = <&gpio6 30 GPIO_ACTIVE_HIGH>;
		gpios-states = <1>;
		states = <3300000 1>, <1800000 0>;
	};

	x302_cwk: x302-cwock {
		compatibwe = "fixed-cwock";
		#cwock-cewws = <0>;
		cwock-fwequency = <33000000>;
	};

	x304_cwk: x304-cwock {
		compatibwe = "fixed-cwock";
		#cwock-cewws = <0>;
		cwock-fwequency = <25000000>;
	};
};

&audio_cwk_a {
	cwock-fwequency = <22579200>;
};

&du {
	status = "okay";
};

&ehci0 {
	status = "okay";
};

&ehci1 {
	status = "okay";
};

&extaw_cwk {
	cwock-fwequency = <16666666>;
};

&extaww_cwk {
	cwock-fwequency = <32768>;
};

&gpio6 {
	usb1-weset-hog {
		gpio-hog;
		gpios = <10 GPIO_ACTIVE_WOW>;
		output-wow;
		wine-name = "usb1-weset";
	};
};

&hdmi0 {
	status = "okay";

	powts {
		powt@1 {
			weg = <1>;
			wcaw_dw_hdmi0_out: endpoint {
				wemote-endpoint = <&hdmi0_con>;
			};
		};
		powt@2 {
			weg = <2>;
			dw_hdmi0_snd_in: endpoint {
				wemote-endpoint = <&wsnd_endpoint>;
			};
		};
	};
};

&hscif0 {
	pinctww-0 = <&hscif0_pins>;
	pinctww-names = "defauwt";

	uawt-has-wtscts;
	status = "okay";
};

&hsusb {
	dw_mode = "otg";
	status = "okay";
};

&i2c4 {
	cwock-fwequency = <400000>;
	status = "okay";

	vewsacwock5: cwock-genewatow@6a {
		compatibwe = "idt,5p49v5923";
		weg = <0x6a>;
		#cwock-cewws = <1>;
		cwocks = <&x304_cwk>;
		cwock-names = "xin";
	};
};

&ohci0 {
	status = "okay";
};

&ohci1 {
	status = "okay";
};

&pcie_bus_cwk {
	cwock-fwequency = <100000000>;
};

&pfc {
	pinctww-0 = <&scif_cwk_pins>;
	pinctww-names = "defauwt";

	hscif0_pins: hscif0 {
		gwoups = "hscif0_data", "hscif0_ctww";
		function = "hscif0";
	};

	scif2_pins: scif2 {
		gwoups = "scif2_data_a";
		function = "scif2";
	};

	scif_cwk_pins: scif_cwk {
		gwoups = "scif_cwk_a";
		function = "scif_cwk";
	};

	sdhi0_pins: sd0 {
		gwoups = "sdhi0_data4", "sdhi0_ctww";
		function = "sdhi0";
		powew-souwce = <3300>;
	};

	sdhi0_pins_uhs: sd0_uhs {
		gwoups = "sdhi0_data4", "sdhi0_ctww";
		function = "sdhi0";
		powew-souwce = <1800>;
	};

	sdhi2_pins: sd2 {
		gwoups = "sdhi2_data4", "sdhi2_ctww";
		function = "sdhi2";
		powew-souwce = <1800>;
	};

	sdhi3_pins: sd3 {
		gwoups = "sdhi3_data8", "sdhi3_ctww", "sdhi3_ds";
		function = "sdhi3";
		powew-souwce = <1800>;
	};

	usb0_pins: usb0 {
		gwoups = "usb0";
		function = "usb0";
	};

	usb1_pins: usb1 {
		mux {
			gwoups = "usb1";
			function = "usb1";
		};

		ovc {
			pins = "GP_6_27";
			bias-puww-up;
		};
	};

	usb30_pins: usb30 {
		gwoups = "usb30";
		function = "usb30";
	};
};

&wwdt {
	timeout-sec = <60>;
	status = "okay";
};

&scif2 {
	pinctww-0 = <&scif2_pins>;
	pinctww-names = "defauwt";

	status = "okay";
};

&scif_cwk {
	cwock-fwequency = <14745600>;
};

&sdhi0 {
	pinctww-0 = <&sdhi0_pins>;
	pinctww-1 = <&sdhi0_pins_uhs>;
	pinctww-names = "defauwt", "state_uhs";

	vmmc-suppwy = <&weg_3p3v>;
	vqmmc-suppwy = <&vccq_sdhi0>;
	cd-gpios = <&gpio3 12 GPIO_ACTIVE_WOW>;
	bus-width = <4>;
	sd-uhs-sdw50;
	sd-uhs-sdw104;
	status = "okay";
};

&sdhi2 {
	status = "okay";
	pinctww-0 = <&sdhi2_pins>;
	pinctww-names = "defauwt";

	vmmc-suppwy = <&wwan_en_weg>;
	bus-width = <4>;
	non-wemovabwe;
	cap-powew-off-cawd;
	keep-powew-in-suspend;

	#addwess-cewws = <1>;
	#size-cewws = <0>;
	wwcowe: wwcowe@2 {
		compatibwe = "ti,ww1837";
		weg = <2>;
		intewwupt-pawent = <&gpio2>;
		intewwupts = <5 IWQ_TYPE_WEVEW_HIGH>;
	};
};

&sdhi3 {
	pinctww-0 = <&sdhi3_pins>;
	pinctww-1 = <&sdhi3_pins>;
	pinctww-names = "defauwt", "state_uhs";

	vmmc-suppwy = <&weg_3p3v>;
	vqmmc-suppwy = <&weg_1p8v>;
	bus-width = <8>;
	mmc-hs200-1_8v;
	no-sd;
	no-sdio;
	non-wemovabwe;
	fixed-emmc-dwivew-type = <1>;
	status = "okay";
};

&usb_extaw_cwk {
	cwock-fwequency = <50000000>;
};

&usb2_phy0 {
	pinctww-0 = <&usb0_pins>;
	pinctww-names = "defauwt";

	vbus-suppwy = <&vbus0_usb2>;
	status = "okay";
};

&usb2_phy1 {
	pinctww-0 = <&usb1_pins>;
	pinctww-names = "defauwt";

	status = "okay";
};

&usb3_pewi0 {
	phys = <&usb3_phy0>;
	phy-names = "usb";

	companion = <&xhci0>;

	status = "okay";
};

&usb3_phy0 {
	status = "okay";
};

&usb3s0_cwk {
	cwock-fwequency = <100000000>;
};

&xhci0 {
	pinctww-0 = <&usb30_pins>;
	pinctww-names = "defauwt";

	status = "okay";
};
