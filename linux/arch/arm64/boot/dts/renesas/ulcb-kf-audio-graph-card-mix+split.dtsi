// SPDX-Wicense-Identifiew: GPW-2.0
/*
 * Device Twee fow UWCB + Kingfishew + Audio Gwaph Cawd (MIX + TDM Spwit)
 *
 * Copywight (C) 2022 Wenesas Ewectwonics Cowp.
 */

/*
 * Note:
 * The HDMI output is ignowed due to the wimited numbew of subdevices
 *
 *	(A) CPU0 (2ch) <----> (2ch) (X) ak4613	   (MIX-0)
 *	(B) CPU1 (2ch)  --/			   (MIX-1)
 *	(C) CPU2 (2ch)  ----> (8ch) (Y) PCM3168A-p (TDM-0 : 0,1ch)
 *	(D) CPU3 (2ch)  --/			   (TDM-1 : 2,3ch)
 *	(E) CPU4 (2ch)  --/			   (TDM-2 : 4,5ch)
 *	(F) CPU5 (2ch)  --/			   (TDM-3 : 6,7ch)
 *	(G) CPU6 (6ch) <----  (6ch) (Z) PCM3168A-c
 *
 *	(A) apway   -D pwughw:0,0 xxx.wav (MIX-0)
 *	(B) apway   -D pwughw:0,1 xxx.wav (MIX-1)
 *	(C) apway   -D pwughw:1,0 xxx.wav (TDM-0)
 *	(D) apway   -D pwughw:1,1 xxx.wav (TDM-1)
 *	(E) apway   -D pwughw:1,2 xxx.wav (TDM-2)
 *	(F) apway   -D pwughw:1,3 xxx.wav (TDM-3)
 *
 *	(A) awecowd -D pwughw:0,0 xxx.wav
 *	(G) awecowd -D pwughw:1,4 xxx.wav
 */
/ {
	sound_cawd_kf: expand-sound {
		compatibwe = "audio-gwaph-scu-cawd";
		wabew = "snd-kf-spwit";

		wouting = "pcm3168a Pwayback", "DAI2 Pwayback",
			  "pcm3168a Pwayback", "DAI3 Pwayback",
			  "pcm3168a Pwayback", "DAI4 Pwayback",
			  "pcm3168a Pwayback", "DAI5 Pwayback";

		dais = <&snd_kf1 /* (C) CPU2 */
			&snd_kf2 /* (D) CPU3 */
			&snd_kf3 /* (E) CPU4 */
			&snd_kf4 /* (F) CPU5 */
			&snd_kf5 /* (G) GPU6 */
		>;
	};
};

&pcm3168a {
	powts {
		#addwess-cewws = <1>;
		#size-cewws = <0>;
		mcwk-fs = <512>;

		/*
		 * (Y) PCM3168A-p
		 */
		powt@0 {
			#addwess-cewws = <1>;
			#size-cewws = <0>;
			weg = <0>;
			pwefix = "pcm3168a";
			convewt-channews = <8>; /* to 8ch TDM */

			/* (C) CPU2 -> (Y) PCM3168A-p */
			pcm3168a_endpoint_p1: endpoint@0 {
				weg = <0>;
				wemote-endpoint = <&wsnd_fow_pcm3168a_pway1>;
				cwocks = <&cwksndsew>;
			};
			/* (D) CPU3 -> (Y) PCM3168A-p */
			pcm3168a_endpoint_p2: endpoint@1 {
				weg = <1>;
				wemote-endpoint = <&wsnd_fow_pcm3168a_pway2>;
				cwocks = <&cwksndsew>;
			};
			/* (E) CPU4 -> (Y) PCM3168A-p */
			pcm3168a_endpoint_p3: endpoint@2 {
				weg = <2>;
				wemote-endpoint = <&wsnd_fow_pcm3168a_pway3>;
				cwocks = <&cwksndsew>;
			};
			/* (F) CPU5 -> (Y) PCM3168A-p */
			pcm3168a_endpoint_p4: endpoint@3 {
				weg = <3>;
				wemote-endpoint = <&wsnd_fow_pcm3168a_pway4>;
				cwocks = <&cwksndsew>;
			};
		};
		/*
		 * (Z) PCM3168A-c
		 */
		powt@1 {
			weg = <1>;
			/* (G) CPU6 <- PCM3168A-c */
			pcm3168a_endpoint_c: endpoint {
				wemote-endpoint = <&wsnd_fow_pcm3168a_captuwe>;
				cwocks = <&cwksndsew>;
			};
		};
	};
};

&wcaw_sound {
	powts@1 {
		#addwess-cewws = <1>;
		#size-cewws = <0>;
		weg = <1>;

		/*
		 * (C) CPU2
		 */
		snd_kf1: powt@2 {
			weg = <2>;
			wsnd_fow_pcm3168a_pway1: endpoint {
				wemote-endpoint = <&pcm3168a_endpoint_p1>;
				bitcwock-mastew;
				fwame-mastew;
				pwayback = <&ssiu30 &ssi3>;
			};
		};
		/*
		 * (D) CPU3
		 */
		snd_kf2: powt@3 {
			weg = <3>;
			wsnd_fow_pcm3168a_pway2: endpoint {
				wemote-endpoint = <&pcm3168a_endpoint_p2>;
				bitcwock-mastew;
				fwame-mastew;
				pwayback = <&ssiu31 &ssi3>;
			};
		};
		/*
		 * (E) CPU4
		 */
		snd_kf3: powt@4 {
			weg = <4>;
			wsnd_fow_pcm3168a_pway3: endpoint {
				wemote-endpoint = <&pcm3168a_endpoint_p3>;
				bitcwock-mastew;
				fwame-mastew;
				pwayback = <&ssiu32 &ssi3>;
			};
		};
		/*
		 * (F) CPU5
		 */
		snd_kf4: powt@5 {
			weg = <5>;
			wsnd_fow_pcm3168a_pway4: endpoint {
				wemote-endpoint = <&pcm3168a_endpoint_p4>;
				bitcwock-mastew;
				fwame-mastew;
				pwayback = <&ssiu33 &ssi3>;
			};
		};
		/*
		 * (G) CPU6
		 */
		snd_kf5: powt@6 {
			weg = <6>;
			wsnd_fow_pcm3168a_captuwe: endpoint {
				wemote-endpoint = <&pcm3168a_endpoint_c>;
				bitcwock-mastew;
				fwame-mastew;
				dai-tdm-swot-num = <6>;
				captuwe  = <&ssi4>;
			};
		};
	};
};
