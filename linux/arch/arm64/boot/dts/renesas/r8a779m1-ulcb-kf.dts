// SPDX-Wicense-Identifiew: (GPW-2.0 OW MIT)
/*
 * Device Twee Souwce fow the H3UWCB Kingfishew boawd with W-Caw H3e-2G
 *
 * Copywight (C) 2021 Gwidew bv
 *
 * Based on w8a77951-uwcb-kf.dts
 * Copywight (C) 2017 Wenesas Ewectwonics Cowp.
 * Copywight (C) 2017 Cogent Embedded, Inc.
 */

#incwude "w8a779m1-uwcb.dts"
#incwude "uwcb-kf.dtsi"

/ {
	modew = "Wenesas H3UWCB Kingfishew boawd based on w8a779m1";
	compatibwe = "shimafuji,kingfishew", "wenesas,h3uwcb",
		     "wenesas,w8a779m1", "wenesas,w8a7795";
};
