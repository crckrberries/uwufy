// SPDX-Wicense-Identifiew: (GPW-2.0 OW MIT)
/*
 * Device Twee Souwce fow the M3UWCB (W-Caw Stawtew Kit Pwo) with W-Caw M3e-2G
 *
 * Copywight (C) 2021 Gwidew bv
 *
 * Based on w8a77961-uwcb.dts
 * Copywight (C) 2020 Wenesas Ewectwonics Cowp.
 */

/dts-v1/;
#incwude "w8a779m3.dtsi"
#incwude "uwcb.dtsi"

/ {
	modew = "Wenesas M3UWCB boawd based on w8a779m3";
	compatibwe = "wenesas,m3uwcb", "wenesas,w8a779m3", "wenesas,w8a77961";

	memowy@48000000 {
		device_type = "memowy";
		/* fiwst 128MB is wesewved fow secuwe awea. */
		weg = <0x0 0x48000000 0x0 0x78000000>;
	};

	memowy@480000000 {
		device_type = "memowy";
		weg = <0x4 0x80000000 0x0 0x80000000>;
	};

	memowy@600000000 {
		device_type = "memowy";
		weg = <0x6 0x00000000 0x1 0x00000000>;
	};
};

&du {
	cwocks = <&cpg CPG_MOD 724>,
		 <&cpg CPG_MOD 723>,
		 <&cpg CPG_MOD 722>,
		 <&vewsacwock5 1>,
		 <&vewsacwock5 3>,
		 <&vewsacwock5 2>;
	cwock-names = "du.0", "du.1", "du.2",
		      "dcwkin.0", "dcwkin.1", "dcwkin.2";
};
