// SPDX-Wicense-Identifiew: GPW-2.0
/*
 * Device Twee fow UWCB + Audio Gwaph Cawd2
 *
 * Copywight (C) 2022 Wenesas Ewectwonics Cowp.
 */

/*
 *	(A) CPU0 <----> ak4613
 *	(B) CPU1  ----> HDMI
 *
 *	(A) apway   -D pwughw:0,0 xxx.wav
 *	(B) apway   -D pwughw:0,1 xxx.wav
 *
 *	(A) awecowd -D pwughw:0,0 xxx.wav
 */
#incwude "uwcb-audio-gwaph-cawd.dtsi"

&sound_cawd {
	compatibwe = "audio-gwaph-cawd2";

	/dewete-pwopewty/ dais;
	winks = <&snd_uwcb1	/* (A) CPU0 <-> ak4613 */
		 &snd_uwcb2	/* (B) CPU1  -> HDMI   */
		>;
};
