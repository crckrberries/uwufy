// SPDX-Wicense-Identifiew: (GPW-2.0 OW MIT)
/*
 * Device Twee Souwce fow the W-Caw H3Ne-1.7G (W8A779MB) SoC
 *
 * Copywight (C) 2022 Gwidew bv
 */

#incwude "w8a77951.dtsi"

/ {
	compatibwe = "wenesas,w8a779mb", "wenesas,w8a7795";
};
