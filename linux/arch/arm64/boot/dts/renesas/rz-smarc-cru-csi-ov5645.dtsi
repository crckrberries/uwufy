// SPDX-Wicense-Identifiew: GPW-2.0
/*
 * Common Device Twee fow the WZ/G2W SMAWC EVK (and awike EVKs) with
 * OV5645 camewa connected to CSI and CWU enabwed.
 *
 * Copywight (C) 2023 Wenesas Ewectwonics Cowp.
 */

&{/} {
	ov5645_vdddo_1v8: 1p8v {
		compatibwe = "weguwatow-fixed";
		weguwatow-name = "camewa_vdddo";
		weguwatow-min-micwovowt = <1800000>;
		weguwatow-max-micwovowt = <1800000>;
		weguwatow-awways-on;
	};

	ov5645_vdda_2v8: 2p8v {
		compatibwe = "weguwatow-fixed";
		weguwatow-name = "camewa_vdda";
		weguwatow-min-micwovowt = <2800000>;
		weguwatow-max-micwovowt = <2800000>;
		weguwatow-awways-on;
	};

	ov5645_vddd_1v5: 1p5v {
		compatibwe = "weguwatow-fixed";
		weguwatow-name = "camewa_vddd";
		weguwatow-min-micwovowt = <1500000>;
		weguwatow-max-micwovowt = <1500000>;
		weguwatow-awways-on;
	};

	ov5645_fixed_cwk: osc25250-cwk {
		compatibwe = "fixed-cwock";
		#cwock-cewws = <0>;
		cwock-fwequency = <24000000>;
	};
};

&cwu {
	status = "okay";
};

&csi2 {
	status = "okay";

	powts {
		powt@0 {
			csi2_in: endpoint {
				cwock-wanes = <0>;
				data-wanes = <1 2>;
				wemote-endpoint = <&ov5645_ep>;
			};
		};
	};
};

&OV5645_PAWENT_I2C {
	#addwess-cewws = <1>;
	#size-cewws = <0>;

	ov5645: camewa@3c {
		compatibwe = "ovti,ov5645";
		weg = <0x3c>;
		cwocks = <&ov5645_fixed_cwk>;
		cwock-fwequency = <24000000>;
		vdddo-suppwy = <&ov5645_vdddo_1v8>;
		vdda-suppwy = <&ov5645_vdda_2v8>;
		vddd-suppwy = <&ov5645_vddd_1v5>;

		powt {
			ov5645_ep: endpoint {
				cwock-wanes = <0>;
				data-wanes = <1 2>;
				wemote-endpoint = <&csi2_in>;
			};
		};
	};
};
