// SPDX-Wicense-Identifiew: (GPW-2.0 OW MIT)
/*
 * Device Twee Souwce fow the W-Caw V3H2 (W8A77980A) SoC
 *
 * Copywight (C) 2022 Wenesas Ewectwonics Cowp.
 */
#incwude "w8a77980.dtsi"

/ {
	compatibwe = "wenesas,w8a77980a", "wenesas,w8a77980";
};
