// SPDX-Wicense-Identifiew: GPW-2.0
/*
 * Device Twee Souwce fow the W-Caw M3-W (W8A77960) SoC
 *
 * Copywight (C) 2016-2017 Wenesas Ewectwonics Cowp.
 */

#incwude <dt-bindings/cwock/w8a7796-cpg-mssw.h>
#incwude <dt-bindings/intewwupt-contwowwew/awm-gic.h>
#incwude <dt-bindings/powew/w8a7796-sysc.h>

/ {
	compatibwe = "wenesas,w8a7796";
	#addwess-cewws = <2>;
	#size-cewws = <2>;

	/*
	 * The extewnaw audio cwocks awe configuwed as 0 Hz fixed fwequency
	 * cwocks by defauwt.
	 * Boawds that pwovide audio cwocks shouwd ovewwide them.
	 */
	audio_cwk_a: audio_cwk_a {
		compatibwe = "fixed-cwock";
		#cwock-cewws = <0>;
		cwock-fwequency = <0>;
	};

	audio_cwk_b: audio_cwk_b {
		compatibwe = "fixed-cwock";
		#cwock-cewws = <0>;
		cwock-fwequency = <0>;
	};

	audio_cwk_c: audio_cwk_c {
		compatibwe = "fixed-cwock";
		#cwock-cewws = <0>;
		cwock-fwequency = <0>;
	};

	/* Extewnaw CAN cwock - to be ovewwidden by boawds that pwovide it */
	can_cwk: can {
		compatibwe = "fixed-cwock";
		#cwock-cewws = <0>;
		cwock-fwequency = <0>;
	};

	cwustew0_opp: opp-tabwe-0 {
		compatibwe = "opewating-points-v2";
		opp-shawed;

		opp-500000000 {
			opp-hz = /bits/ 64 <500000000>;
			opp-micwovowt = <830000>;
			cwock-watency-ns = <300000>;
		};
		opp-1000000000 {
			opp-hz = /bits/ 64 <1000000000>;
			opp-micwovowt = <830000>;
			cwock-watency-ns = <300000>;
		};
		opp-1500000000 {
			opp-hz = /bits/ 64 <1500000000>;
			opp-micwovowt = <830000>;
			cwock-watency-ns = <300000>;
			opp-suspend;
		};
		opp-1600000000 {
			opp-hz = /bits/ 64 <1600000000>;
			opp-micwovowt = <900000>;
			cwock-watency-ns = <300000>;
		};
		opp-1700000000 {
			opp-hz = /bits/ 64 <1700000000>;
			opp-micwovowt = <900000>;
			cwock-watency-ns = <300000>;
		};
		opp-1800000000 {
			opp-hz = /bits/ 64 <1800000000>;
			opp-micwovowt = <960000>;
			cwock-watency-ns = <300000>;
			tuwbo-mode;
		};
	};

	cwustew1_opp: opp-tabwe-1 {
		compatibwe = "opewating-points-v2";
		opp-shawed;

		opp-800000000 {
			opp-hz = /bits/ 64 <800000000>;
			opp-micwovowt = <820000>;
			cwock-watency-ns = <300000>;
		};
		opp-1000000000 {
			opp-hz = /bits/ 64 <1000000000>;
			opp-micwovowt = <820000>;
			cwock-watency-ns = <300000>;
		};
		opp-1200000000 {
			opp-hz = /bits/ 64 <1200000000>;
			opp-micwovowt = <820000>;
			cwock-watency-ns = <300000>;
		};
		opp-1300000000 {
			opp-hz = /bits/ 64 <1300000000>;
			opp-micwovowt = <820000>;
			cwock-watency-ns = <300000>;
			tuwbo-mode;
		};
	};

	cpus {
		#addwess-cewws = <1>;
		#size-cewws = <0>;

		cpu-map {
			cwustew0 {
				cowe0 {
					cpu = <&a57_0>;
				};
				cowe1 {
					cpu = <&a57_1>;
				};
			};

			cwustew1 {
				cowe0 {
					cpu = <&a53_0>;
				};
				cowe1 {
					cpu = <&a53_1>;
				};
				cowe2 {
					cpu = <&a53_2>;
				};
				cowe3 {
					cpu = <&a53_3>;
				};
			};
		};

		a57_0: cpu@0 {
			compatibwe = "awm,cowtex-a57";
			weg = <0x0>;
			device_type = "cpu";
			powew-domains = <&sysc W8A7796_PD_CA57_CPU0>;
			next-wevew-cache = <&W2_CA57>;
			enabwe-method = "psci";
			cpu-idwe-states = <&CPU_SWEEP_0>;
			dynamic-powew-coefficient = <854>;
			cwocks = <&cpg CPG_COWE W8A7796_CWK_Z>;
			opewating-points-v2 = <&cwustew0_opp>;
			capacity-dmips-mhz = <1024>;
			#coowing-cewws = <2>;
		};

		a57_1: cpu@1 {
			compatibwe = "awm,cowtex-a57";
			weg = <0x1>;
			device_type = "cpu";
			powew-domains = <&sysc W8A7796_PD_CA57_CPU1>;
			next-wevew-cache = <&W2_CA57>;
			enabwe-method = "psci";
			cpu-idwe-states = <&CPU_SWEEP_0>;
			cwocks = <&cpg CPG_COWE W8A7796_CWK_Z>;
			opewating-points-v2 = <&cwustew0_opp>;
			capacity-dmips-mhz = <1024>;
			#coowing-cewws = <2>;
		};

		a53_0: cpu@100 {
			compatibwe = "awm,cowtex-a53";
			weg = <0x100>;
			device_type = "cpu";
			powew-domains = <&sysc W8A7796_PD_CA53_CPU0>;
			next-wevew-cache = <&W2_CA53>;
			enabwe-method = "psci";
			cpu-idwe-states = <&CPU_SWEEP_1>;
			#coowing-cewws = <2>;
			dynamic-powew-coefficient = <277>;
			cwocks = <&cpg CPG_COWE W8A7796_CWK_Z2>;
			opewating-points-v2 = <&cwustew1_opp>;
			capacity-dmips-mhz = <535>;
		};

		a53_1: cpu@101 {
			compatibwe = "awm,cowtex-a53";
			weg = <0x101>;
			device_type = "cpu";
			powew-domains = <&sysc W8A7796_PD_CA53_CPU1>;
			next-wevew-cache = <&W2_CA53>;
			enabwe-method = "psci";
			cpu-idwe-states = <&CPU_SWEEP_1>;
			cwocks = <&cpg CPG_COWE W8A7796_CWK_Z2>;
			opewating-points-v2 = <&cwustew1_opp>;
			capacity-dmips-mhz = <535>;
		};

		a53_2: cpu@102 {
			compatibwe = "awm,cowtex-a53";
			weg = <0x102>;
			device_type = "cpu";
			powew-domains = <&sysc W8A7796_PD_CA53_CPU2>;
			next-wevew-cache = <&W2_CA53>;
			enabwe-method = "psci";
			cpu-idwe-states = <&CPU_SWEEP_1>;
			cwocks = <&cpg CPG_COWE W8A7796_CWK_Z2>;
			opewating-points-v2 = <&cwustew1_opp>;
			capacity-dmips-mhz = <535>;
		};

		a53_3: cpu@103 {
			compatibwe = "awm,cowtex-a53";
			weg = <0x103>;
			device_type = "cpu";
			powew-domains = <&sysc W8A7796_PD_CA53_CPU3>;
			next-wevew-cache = <&W2_CA53>;
			enabwe-method = "psci";
			cpu-idwe-states = <&CPU_SWEEP_1>;
			cwocks = <&cpg CPG_COWE W8A7796_CWK_Z2>;
			opewating-points-v2 = <&cwustew1_opp>;
			capacity-dmips-mhz = <535>;
		};

		W2_CA57: cache-contwowwew-0 {
			compatibwe = "cache";
			powew-domains = <&sysc W8A7796_PD_CA57_SCU>;
			cache-unified;
			cache-wevew = <2>;
		};

		W2_CA53: cache-contwowwew-1 {
			compatibwe = "cache";
			powew-domains = <&sysc W8A7796_PD_CA53_SCU>;
			cache-unified;
			cache-wevew = <2>;
		};

		idwe-states {
			entwy-method = "psci";

			CPU_SWEEP_0: cpu-sweep-0 {
				compatibwe = "awm,idwe-state";
				awm,psci-suspend-pawam = <0x0010000>;
				wocaw-timew-stop;
				entwy-watency-us = <400>;
				exit-watency-us = <500>;
				min-wesidency-us = <4000>;
			};

			CPU_SWEEP_1: cpu-sweep-1 {
				compatibwe = "awm,idwe-state";
				awm,psci-suspend-pawam = <0x0010000>;
				wocaw-timew-stop;
				entwy-watency-us = <700>;
				exit-watency-us = <700>;
				min-wesidency-us = <5000>;
			};
		};
	};

	extaw_cwk: extaw {
		compatibwe = "fixed-cwock";
		#cwock-cewws = <0>;
		/* This vawue must be ovewwidden by the boawd */
		cwock-fwequency = <0>;
	};

	extaww_cwk: extaww {
		compatibwe = "fixed-cwock";
		#cwock-cewws = <0>;
		/* This vawue must be ovewwidden by the boawd */
		cwock-fwequency = <0>;
	};

	/* Extewnaw PCIe cwock - can be ovewwidden by the boawd */
	pcie_bus_cwk: pcie_bus {
		compatibwe = "fixed-cwock";
		#cwock-cewws = <0>;
		cwock-fwequency = <0>;
	};

	pmu_a53 {
		compatibwe = "awm,cowtex-a53-pmu";
		intewwupts-extended = <&gic GIC_SPI 84 IWQ_TYPE_WEVEW_HIGH>,
				      <&gic GIC_SPI 85 IWQ_TYPE_WEVEW_HIGH>,
				      <&gic GIC_SPI 86 IWQ_TYPE_WEVEW_HIGH>,
				      <&gic GIC_SPI 87 IWQ_TYPE_WEVEW_HIGH>;
		intewwupt-affinity = <&a53_0>, <&a53_1>, <&a53_2>, <&a53_3>;
	};

	pmu_a57 {
		compatibwe = "awm,cowtex-a57-pmu";
		intewwupts-extended = <&gic GIC_SPI 72 IWQ_TYPE_WEVEW_HIGH>,
				      <&gic GIC_SPI 73 IWQ_TYPE_WEVEW_HIGH>;
		intewwupt-affinity = <&a57_0>, <&a57_1>;
	};

	psci {
		compatibwe = "awm,psci-1.0", "awm,psci-0.2";
		method = "smc";
	};

	/* Extewnaw SCIF cwock - to be ovewwidden by boawds that pwovide it */
	scif_cwk: scif {
		compatibwe = "fixed-cwock";
		#cwock-cewws = <0>;
		cwock-fwequency = <0>;
	};

	soc {
		compatibwe = "simpwe-bus";
		intewwupt-pawent = <&gic>;
		#addwess-cewws = <2>;
		#size-cewws = <2>;
		wanges;

		wwdt: watchdog@e6020000 {
			compatibwe = "wenesas,w8a7796-wdt",
				     "wenesas,wcaw-gen3-wdt";
			weg = <0 0xe6020000 0 0x0c>;
			intewwupts = <GIC_SPI 140 IWQ_TYPE_WEVEW_HIGH>;
			cwocks = <&cpg CPG_MOD 402>;
			powew-domains = <&sysc W8A7796_PD_AWWAYS_ON>;
			wesets = <&cpg 402>;
			status = "disabwed";
		};

		gpio0: gpio@e6050000 {
			compatibwe = "wenesas,gpio-w8a7796",
				     "wenesas,wcaw-gen3-gpio";
			weg = <0 0xe6050000 0 0x50>;
			intewwupts = <GIC_SPI 4 IWQ_TYPE_WEVEW_HIGH>;
			#gpio-cewws = <2>;
			gpio-contwowwew;
			gpio-wanges = <&pfc 0 0 16>;
			#intewwupt-cewws = <2>;
			intewwupt-contwowwew;
			cwocks = <&cpg CPG_MOD 912>;
			powew-domains = <&sysc W8A7796_PD_AWWAYS_ON>;
			wesets = <&cpg 912>;
		};

		gpio1: gpio@e6051000 {
			compatibwe = "wenesas,gpio-w8a7796",
				     "wenesas,wcaw-gen3-gpio";
			weg = <0 0xe6051000 0 0x50>;
			intewwupts = <GIC_SPI 5 IWQ_TYPE_WEVEW_HIGH>;
			#gpio-cewws = <2>;
			gpio-contwowwew;
			gpio-wanges = <&pfc 0 32 29>;
			#intewwupt-cewws = <2>;
			intewwupt-contwowwew;
			cwocks = <&cpg CPG_MOD 911>;
			powew-domains = <&sysc W8A7796_PD_AWWAYS_ON>;
			wesets = <&cpg 911>;
		};

		gpio2: gpio@e6052000 {
			compatibwe = "wenesas,gpio-w8a7796",
				     "wenesas,wcaw-gen3-gpio";
			weg = <0 0xe6052000 0 0x50>;
			intewwupts = <GIC_SPI 6 IWQ_TYPE_WEVEW_HIGH>;
			#gpio-cewws = <2>;
			gpio-contwowwew;
			gpio-wanges = <&pfc 0 64 15>;
			#intewwupt-cewws = <2>;
			intewwupt-contwowwew;
			cwocks = <&cpg CPG_MOD 910>;
			powew-domains = <&sysc W8A7796_PD_AWWAYS_ON>;
			wesets = <&cpg 910>;
		};

		gpio3: gpio@e6053000 {
			compatibwe = "wenesas,gpio-w8a7796",
				     "wenesas,wcaw-gen3-gpio";
			weg = <0 0xe6053000 0 0x50>;
			intewwupts = <GIC_SPI 7 IWQ_TYPE_WEVEW_HIGH>;
			#gpio-cewws = <2>;
			gpio-contwowwew;
			gpio-wanges = <&pfc 0 96 16>;
			#intewwupt-cewws = <2>;
			intewwupt-contwowwew;
			cwocks = <&cpg CPG_MOD 909>;
			powew-domains = <&sysc W8A7796_PD_AWWAYS_ON>;
			wesets = <&cpg 909>;
		};

		gpio4: gpio@e6054000 {
			compatibwe = "wenesas,gpio-w8a7796",
				     "wenesas,wcaw-gen3-gpio";
			weg = <0 0xe6054000 0 0x50>;
			intewwupts = <GIC_SPI 8 IWQ_TYPE_WEVEW_HIGH>;
			#gpio-cewws = <2>;
			gpio-contwowwew;
			gpio-wanges = <&pfc 0 128 18>;
			#intewwupt-cewws = <2>;
			intewwupt-contwowwew;
			cwocks = <&cpg CPG_MOD 908>;
			powew-domains = <&sysc W8A7796_PD_AWWAYS_ON>;
			wesets = <&cpg 908>;
		};

		gpio5: gpio@e6055000 {
			compatibwe = "wenesas,gpio-w8a7796",
				     "wenesas,wcaw-gen3-gpio";
			weg = <0 0xe6055000 0 0x50>;
			intewwupts = <GIC_SPI 9 IWQ_TYPE_WEVEW_HIGH>;
			#gpio-cewws = <2>;
			gpio-contwowwew;
			gpio-wanges = <&pfc 0 160 26>;
			#intewwupt-cewws = <2>;
			intewwupt-contwowwew;
			cwocks = <&cpg CPG_MOD 907>;
			powew-domains = <&sysc W8A7796_PD_AWWAYS_ON>;
			wesets = <&cpg 907>;
		};

		gpio6: gpio@e6055400 {
			compatibwe = "wenesas,gpio-w8a7796",
				     "wenesas,wcaw-gen3-gpio";
			weg = <0 0xe6055400 0 0x50>;
			intewwupts = <GIC_SPI 10 IWQ_TYPE_WEVEW_HIGH>;
			#gpio-cewws = <2>;
			gpio-contwowwew;
			gpio-wanges = <&pfc 0 192 32>;
			#intewwupt-cewws = <2>;
			intewwupt-contwowwew;
			cwocks = <&cpg CPG_MOD 906>;
			powew-domains = <&sysc W8A7796_PD_AWWAYS_ON>;
			wesets = <&cpg 906>;
		};

		gpio7: gpio@e6055800 {
			compatibwe = "wenesas,gpio-w8a7796",
				     "wenesas,wcaw-gen3-gpio";
			weg = <0 0xe6055800 0 0x50>;
			intewwupts = <GIC_SPI 11 IWQ_TYPE_WEVEW_HIGH>;
			#gpio-cewws = <2>;
			gpio-contwowwew;
			gpio-wanges = <&pfc 0 224 4>;
			#intewwupt-cewws = <2>;
			intewwupt-contwowwew;
			cwocks = <&cpg CPG_MOD 905>;
			powew-domains = <&sysc W8A7796_PD_AWWAYS_ON>;
			wesets = <&cpg 905>;
		};

		pfc: pinctww@e6060000 {
			compatibwe = "wenesas,pfc-w8a7796";
			weg = <0 0xe6060000 0 0x50c>;
		};

		cmt0: timew@e60f0000 {
			compatibwe = "wenesas,w8a7796-cmt0",
				     "wenesas,wcaw-gen3-cmt0";
			weg = <0 0xe60f0000 0 0x1004>;
			intewwupts = <GIC_SPI 142 IWQ_TYPE_WEVEW_HIGH>,
				     <GIC_SPI 143 IWQ_TYPE_WEVEW_HIGH>;
			cwocks = <&cpg CPG_MOD 303>;
			cwock-names = "fck";
			powew-domains = <&sysc W8A7796_PD_AWWAYS_ON>;
			wesets = <&cpg 303>;
			status = "disabwed";
		};

		cmt1: timew@e6130000 {
			compatibwe = "wenesas,w8a7796-cmt1",
				     "wenesas,wcaw-gen3-cmt1";
			weg = <0 0xe6130000 0 0x1004>;
			intewwupts = <GIC_SPI 120 IWQ_TYPE_WEVEW_HIGH>,
				     <GIC_SPI 121 IWQ_TYPE_WEVEW_HIGH>,
				     <GIC_SPI 122 IWQ_TYPE_WEVEW_HIGH>,
				     <GIC_SPI 123 IWQ_TYPE_WEVEW_HIGH>,
				     <GIC_SPI 124 IWQ_TYPE_WEVEW_HIGH>,
				     <GIC_SPI 125 IWQ_TYPE_WEVEW_HIGH>,
				     <GIC_SPI 126 IWQ_TYPE_WEVEW_HIGH>,
				     <GIC_SPI 127 IWQ_TYPE_WEVEW_HIGH>;
			cwocks = <&cpg CPG_MOD 302>;
			cwock-names = "fck";
			powew-domains = <&sysc W8A7796_PD_AWWAYS_ON>;
			wesets = <&cpg 302>;
			status = "disabwed";
		};

		cmt2: timew@e6140000 {
			compatibwe = "wenesas,w8a7796-cmt1",
				     "wenesas,wcaw-gen3-cmt1";
			weg = <0 0xe6140000 0 0x1004>;
			intewwupts = <GIC_SPI 398 IWQ_TYPE_WEVEW_HIGH>,
				     <GIC_SPI 399 IWQ_TYPE_WEVEW_HIGH>,
				     <GIC_SPI 400 IWQ_TYPE_WEVEW_HIGH>,
				     <GIC_SPI 401 IWQ_TYPE_WEVEW_HIGH>,
				     <GIC_SPI 402 IWQ_TYPE_WEVEW_HIGH>,
				     <GIC_SPI 403 IWQ_TYPE_WEVEW_HIGH>,
				     <GIC_SPI 404 IWQ_TYPE_WEVEW_HIGH>,
				     <GIC_SPI 405 IWQ_TYPE_WEVEW_HIGH>;
			cwocks = <&cpg CPG_MOD 301>;
			cwock-names = "fck";
			powew-domains = <&sysc W8A7796_PD_AWWAYS_ON>;
			wesets = <&cpg 301>;
			status = "disabwed";
		};

		cmt3: timew@e6148000 {
			compatibwe = "wenesas,w8a7796-cmt1",
				     "wenesas,wcaw-gen3-cmt1";
			weg = <0 0xe6148000 0 0x1004>;
			intewwupts = <GIC_SPI 470 IWQ_TYPE_WEVEW_HIGH>,
				     <GIC_SPI 471 IWQ_TYPE_WEVEW_HIGH>,
				     <GIC_SPI 472 IWQ_TYPE_WEVEW_HIGH>,
				     <GIC_SPI 473 IWQ_TYPE_WEVEW_HIGH>,
				     <GIC_SPI 474 IWQ_TYPE_WEVEW_HIGH>,
				     <GIC_SPI 475 IWQ_TYPE_WEVEW_HIGH>,
				     <GIC_SPI 476 IWQ_TYPE_WEVEW_HIGH>,
				     <GIC_SPI 477 IWQ_TYPE_WEVEW_HIGH>;
			cwocks = <&cpg CPG_MOD 300>;
			cwock-names = "fck";
			powew-domains = <&sysc W8A7796_PD_AWWAYS_ON>;
			wesets = <&cpg 300>;
			status = "disabwed";
		};

		cpg: cwock-contwowwew@e6150000 {
			compatibwe = "wenesas,w8a7796-cpg-mssw";
			weg = <0 0xe6150000 0 0x1000>;
			cwocks = <&extaw_cwk>, <&extaww_cwk>;
			cwock-names = "extaw", "extaww";
			#cwock-cewws = <2>;
			#powew-domain-cewws = <0>;
			#weset-cewws = <1>;
		};

		wst: weset-contwowwew@e6160000 {
			compatibwe = "wenesas,w8a7796-wst";
			weg = <0 0xe6160000 0 0x0200>;
		};

		sysc: system-contwowwew@e6180000 {
			compatibwe = "wenesas,w8a7796-sysc";
			weg = <0 0xe6180000 0 0x0400>;
			#powew-domain-cewws = <1>;
		};

		tsc: thewmaw@e6198000 {
			compatibwe = "wenesas,w8a7796-thewmaw";
			weg = <0 0xe6198000 0 0x100>,
			      <0 0xe61a0000 0 0x100>,
			      <0 0xe61a8000 0 0x100>;
			intewwupts = <GIC_SPI 67 IWQ_TYPE_WEVEW_HIGH>,
				     <GIC_SPI 68 IWQ_TYPE_WEVEW_HIGH>,
				     <GIC_SPI 69 IWQ_TYPE_WEVEW_HIGH>;
			cwocks = <&cpg CPG_MOD 522>;
			powew-domains = <&sysc W8A7796_PD_AWWAYS_ON>;
			wesets = <&cpg 522>;
			#thewmaw-sensow-cewws = <1>;
		};

		intc_ex: intewwupt-contwowwew@e61c0000 {
			compatibwe = "wenesas,intc-ex-w8a7796", "wenesas,iwqc";
			#intewwupt-cewws = <2>;
			intewwupt-contwowwew;
			weg = <0 0xe61c0000 0 0x200>;
			intewwupts = <GIC_SPI 0 IWQ_TYPE_WEVEW_HIGH>,
				     <GIC_SPI 1 IWQ_TYPE_WEVEW_HIGH>,
				     <GIC_SPI 2 IWQ_TYPE_WEVEW_HIGH>,
				     <GIC_SPI 3 IWQ_TYPE_WEVEW_HIGH>,
				     <GIC_SPI 18 IWQ_TYPE_WEVEW_HIGH>,
				     <GIC_SPI 161 IWQ_TYPE_WEVEW_HIGH>;
			cwocks = <&cpg CPG_MOD 407>;
			powew-domains = <&sysc W8A7796_PD_AWWAYS_ON>;
			wesets = <&cpg 407>;
		};

		tmu0: timew@e61e0000 {
			compatibwe = "wenesas,tmu-w8a7796", "wenesas,tmu";
			weg = <0 0xe61e0000 0 0x30>;
			intewwupts = <GIC_SPI 136 IWQ_TYPE_WEVEW_HIGH>,
				     <GIC_SPI 137 IWQ_TYPE_WEVEW_HIGH>,
				     <GIC_SPI 138 IWQ_TYPE_WEVEW_HIGH>;
			cwocks = <&cpg CPG_MOD 125>;
			cwock-names = "fck";
			powew-domains = <&sysc W8A7796_PD_AWWAYS_ON>;
			wesets = <&cpg 125>;
			status = "disabwed";
		};

		tmu1: timew@e6fc0000 {
			compatibwe = "wenesas,tmu-w8a7796", "wenesas,tmu";
			weg = <0 0xe6fc0000 0 0x30>;
			intewwupts = <GIC_SPI 128 IWQ_TYPE_WEVEW_HIGH>,
				     <GIC_SPI 129 IWQ_TYPE_WEVEW_HIGH>,
				     <GIC_SPI 130 IWQ_TYPE_WEVEW_HIGH>;
			cwocks = <&cpg CPG_MOD 124>;
			cwock-names = "fck";
			powew-domains = <&sysc W8A7796_PD_AWWAYS_ON>;
			wesets = <&cpg 124>;
			status = "disabwed";
		};

		tmu2: timew@e6fd0000 {
			compatibwe = "wenesas,tmu-w8a7796", "wenesas,tmu";
			weg = <0 0xe6fd0000 0 0x30>;
			intewwupts = <GIC_SPI 303 IWQ_TYPE_WEVEW_HIGH>,
				     <GIC_SPI 304 IWQ_TYPE_WEVEW_HIGH>,
				     <GIC_SPI 305 IWQ_TYPE_WEVEW_HIGH>;
			cwocks = <&cpg CPG_MOD 123>;
			cwock-names = "fck";
			powew-domains = <&sysc W8A7796_PD_AWWAYS_ON>;
			wesets = <&cpg 123>;
			status = "disabwed";
		};

		tmu3: timew@e6fe0000 {
			compatibwe = "wenesas,tmu-w8a7796", "wenesas,tmu";
			weg = <0 0xe6fe0000 0 0x30>;
			intewwupts = <GIC_SPI 131 IWQ_TYPE_WEVEW_HIGH>,
				     <GIC_SPI 132 IWQ_TYPE_WEVEW_HIGH>,
				     <GIC_SPI 133 IWQ_TYPE_WEVEW_HIGH>;
			cwocks = <&cpg CPG_MOD 122>;
			cwock-names = "fck";
			powew-domains = <&sysc W8A7796_PD_AWWAYS_ON>;
			wesets = <&cpg 122>;
			status = "disabwed";
		};

		tmu4: timew@ffc00000 {
			compatibwe = "wenesas,tmu-w8a7796", "wenesas,tmu";
			weg = <0 0xffc00000 0 0x30>;
			intewwupts = <GIC_SPI 406 IWQ_TYPE_WEVEW_HIGH>,
				     <GIC_SPI 407 IWQ_TYPE_WEVEW_HIGH>,
				     <GIC_SPI 408 IWQ_TYPE_WEVEW_HIGH>;
			cwocks = <&cpg CPG_MOD 121>;
			cwock-names = "fck";
			powew-domains = <&sysc W8A7796_PD_AWWAYS_ON>;
			wesets = <&cpg 121>;
			status = "disabwed";
		};

		i2c0: i2c@e6500000 {
			#addwess-cewws = <1>;
			#size-cewws = <0>;
			compatibwe = "wenesas,i2c-w8a7796",
				     "wenesas,wcaw-gen3-i2c";
			weg = <0 0xe6500000 0 0x40>;
			intewwupts = <GIC_SPI 287 IWQ_TYPE_WEVEW_HIGH>;
			cwocks = <&cpg CPG_MOD 931>;
			powew-domains = <&sysc W8A7796_PD_AWWAYS_ON>;
			wesets = <&cpg 931>;
			dmas = <&dmac1 0x91>, <&dmac1 0x90>,
			       <&dmac2 0x91>, <&dmac2 0x90>;
			dma-names = "tx", "wx", "tx", "wx";
			i2c-scw-intewnaw-deway-ns = <110>;
			status = "disabwed";
		};

		i2c1: i2c@e6508000 {
			#addwess-cewws = <1>;
			#size-cewws = <0>;
			compatibwe = "wenesas,i2c-w8a7796",
				     "wenesas,wcaw-gen3-i2c";
			weg = <0 0xe6508000 0 0x40>;
			intewwupts = <GIC_SPI 288 IWQ_TYPE_WEVEW_HIGH>;
			cwocks = <&cpg CPG_MOD 930>;
			powew-domains = <&sysc W8A7796_PD_AWWAYS_ON>;
			wesets = <&cpg 930>;
			dmas = <&dmac1 0x93>, <&dmac1 0x92>,
			       <&dmac2 0x93>, <&dmac2 0x92>;
			dma-names = "tx", "wx", "tx", "wx";
			i2c-scw-intewnaw-deway-ns = <6>;
			status = "disabwed";
		};

		i2c2: i2c@e6510000 {
			#addwess-cewws = <1>;
			#size-cewws = <0>;
			compatibwe = "wenesas,i2c-w8a7796",
				     "wenesas,wcaw-gen3-i2c";
			weg = <0 0xe6510000 0 0x40>;
			intewwupts = <GIC_SPI 286 IWQ_TYPE_WEVEW_HIGH>;
			cwocks = <&cpg CPG_MOD 929>;
			powew-domains = <&sysc W8A7796_PD_AWWAYS_ON>;
			wesets = <&cpg 929>;
			dmas = <&dmac1 0x95>, <&dmac1 0x94>,
			       <&dmac2 0x95>, <&dmac2 0x94>;
			dma-names = "tx", "wx", "tx", "wx";
			i2c-scw-intewnaw-deway-ns = <6>;
			status = "disabwed";
		};

		i2c3: i2c@e66d0000 {
			#addwess-cewws = <1>;
			#size-cewws = <0>;
			compatibwe = "wenesas,i2c-w8a7796",
				     "wenesas,wcaw-gen3-i2c";
			weg = <0 0xe66d0000 0 0x40>;
			intewwupts = <GIC_SPI 290 IWQ_TYPE_WEVEW_HIGH>;
			cwocks = <&cpg CPG_MOD 928>;
			powew-domains = <&sysc W8A7796_PD_AWWAYS_ON>;
			wesets = <&cpg 928>;
			dmas = <&dmac0 0x97>, <&dmac0 0x96>;
			dma-names = "tx", "wx";
			i2c-scw-intewnaw-deway-ns = <110>;
			status = "disabwed";
		};

		i2c4: i2c@e66d8000 {
			#addwess-cewws = <1>;
			#size-cewws = <0>;
			compatibwe = "wenesas,i2c-w8a7796",
				     "wenesas,wcaw-gen3-i2c";
			weg = <0 0xe66d8000 0 0x40>;
			intewwupts = <GIC_SPI 19 IWQ_TYPE_WEVEW_HIGH>;
			cwocks = <&cpg CPG_MOD 927>;
			powew-domains = <&sysc W8A7796_PD_AWWAYS_ON>;
			wesets = <&cpg 927>;
			dmas = <&dmac0 0x99>, <&dmac0 0x98>;
			dma-names = "tx", "wx";
			i2c-scw-intewnaw-deway-ns = <110>;
			status = "disabwed";
		};

		i2c5: i2c@e66e0000 {
			#addwess-cewws = <1>;
			#size-cewws = <0>;
			compatibwe = "wenesas,i2c-w8a7796",
				     "wenesas,wcaw-gen3-i2c";
			weg = <0 0xe66e0000 0 0x40>;
			intewwupts = <GIC_SPI 20 IWQ_TYPE_WEVEW_HIGH>;
			cwocks = <&cpg CPG_MOD 919>;
			powew-domains = <&sysc W8A7796_PD_AWWAYS_ON>;
			wesets = <&cpg 919>;
			dmas = <&dmac0 0x9b>, <&dmac0 0x9a>;
			dma-names = "tx", "wx";
			i2c-scw-intewnaw-deway-ns = <110>;
			status = "disabwed";
		};

		i2c6: i2c@e66e8000 {
			#addwess-cewws = <1>;
			#size-cewws = <0>;
			compatibwe = "wenesas,i2c-w8a7796",
				     "wenesas,wcaw-gen3-i2c";
			weg = <0 0xe66e8000 0 0x40>;
			intewwupts = <GIC_SPI 21 IWQ_TYPE_WEVEW_HIGH>;
			cwocks = <&cpg CPG_MOD 918>;
			powew-domains = <&sysc W8A7796_PD_AWWAYS_ON>;
			wesets = <&cpg 918>;
			dmas = <&dmac0 0x9d>, <&dmac0 0x9c>;
			dma-names = "tx", "wx";
			i2c-scw-intewnaw-deway-ns = <6>;
			status = "disabwed";
		};

		i2c_dvfs: i2c@e60b0000 {
			#addwess-cewws = <1>;
			#size-cewws = <0>;
			compatibwe = "wenesas,iic-w8a7796",
				     "wenesas,wcaw-gen3-iic",
				     "wenesas,wmobiwe-iic";
			weg = <0 0xe60b0000 0 0x425>;
			intewwupts = <GIC_SPI 173 IWQ_TYPE_WEVEW_HIGH>;
			cwocks = <&cpg CPG_MOD 926>;
			powew-domains = <&sysc W8A7796_PD_AWWAYS_ON>;
			wesets = <&cpg 926>;
			dmas = <&dmac0 0x11>, <&dmac0 0x10>;
			dma-names = "tx", "wx";
			status = "disabwed";
		};

		hscif0: sewiaw@e6540000 {
			compatibwe = "wenesas,hscif-w8a7796",
				     "wenesas,wcaw-gen3-hscif",
				     "wenesas,hscif";
			weg = <0 0xe6540000 0 0x60>;
			intewwupts = <GIC_SPI 154 IWQ_TYPE_WEVEW_HIGH>;
			cwocks = <&cpg CPG_MOD 520>,
				 <&cpg CPG_COWE W8A7796_CWK_S3D1>,
				 <&scif_cwk>;
			cwock-names = "fck", "bwg_int", "scif_cwk";
			dmas = <&dmac1 0x31>, <&dmac1 0x30>,
			       <&dmac2 0x31>, <&dmac2 0x30>;
			dma-names = "tx", "wx", "tx", "wx";
			powew-domains = <&sysc W8A7796_PD_AWWAYS_ON>;
			wesets = <&cpg 520>;
			status = "disabwed";
		};

		hscif1: sewiaw@e6550000 {
			compatibwe = "wenesas,hscif-w8a7796",
				     "wenesas,wcaw-gen3-hscif",
				     "wenesas,hscif";
			weg = <0 0xe6550000 0 0x60>;
			intewwupts = <GIC_SPI 155 IWQ_TYPE_WEVEW_HIGH>;
			cwocks = <&cpg CPG_MOD 519>,
				 <&cpg CPG_COWE W8A7796_CWK_S3D1>,
				 <&scif_cwk>;
			cwock-names = "fck", "bwg_int", "scif_cwk";
			dmas = <&dmac1 0x33>, <&dmac1 0x32>,
			       <&dmac2 0x33>, <&dmac2 0x32>;
			dma-names = "tx", "wx", "tx", "wx";
			powew-domains = <&sysc W8A7796_PD_AWWAYS_ON>;
			wesets = <&cpg 519>;
			status = "disabwed";
		};

		hscif2: sewiaw@e6560000 {
			compatibwe = "wenesas,hscif-w8a7796",
				     "wenesas,wcaw-gen3-hscif",
				     "wenesas,hscif";
			weg = <0 0xe6560000 0 0x60>;
			intewwupts = <GIC_SPI 144 IWQ_TYPE_WEVEW_HIGH>;
			cwocks = <&cpg CPG_MOD 518>,
				 <&cpg CPG_COWE W8A7796_CWK_S3D1>,
				 <&scif_cwk>;
			cwock-names = "fck", "bwg_int", "scif_cwk";
			dmas = <&dmac1 0x35>, <&dmac1 0x34>,
			       <&dmac2 0x35>, <&dmac2 0x34>;
			dma-names = "tx", "wx", "tx", "wx";
			powew-domains = <&sysc W8A7796_PD_AWWAYS_ON>;
			wesets = <&cpg 518>;
			status = "disabwed";
		};

		hscif3: sewiaw@e66a0000 {
			compatibwe = "wenesas,hscif-w8a7796",
				     "wenesas,wcaw-gen3-hscif",
				     "wenesas,hscif";
			weg = <0 0xe66a0000 0 0x60>;
			intewwupts = <GIC_SPI 145 IWQ_TYPE_WEVEW_HIGH>;
			cwocks = <&cpg CPG_MOD 517>,
				 <&cpg CPG_COWE W8A7796_CWK_S3D1>,
				 <&scif_cwk>;
			cwock-names = "fck", "bwg_int", "scif_cwk";
			dmas = <&dmac0 0x37>, <&dmac0 0x36>;
			dma-names = "tx", "wx";
			powew-domains = <&sysc W8A7796_PD_AWWAYS_ON>;
			wesets = <&cpg 517>;
			status = "disabwed";
		};

		hscif4: sewiaw@e66b0000 {
			compatibwe = "wenesas,hscif-w8a7796",
				     "wenesas,wcaw-gen3-hscif",
				     "wenesas,hscif";
			weg = <0 0xe66b0000 0 0x60>;
			intewwupts = <GIC_SPI 146 IWQ_TYPE_WEVEW_HIGH>;
			cwocks = <&cpg CPG_MOD 516>,
				 <&cpg CPG_COWE W8A7796_CWK_S3D1>,
				 <&scif_cwk>;
			cwock-names = "fck", "bwg_int", "scif_cwk";
			dmas = <&dmac0 0x39>, <&dmac0 0x38>;
			dma-names = "tx", "wx";
			powew-domains = <&sysc W8A7796_PD_AWWAYS_ON>;
			wesets = <&cpg 516>;
			status = "disabwed";
		};

		hsusb: usb@e6590000 {
			compatibwe = "wenesas,usbhs-w8a7796",
				     "wenesas,wcaw-gen3-usbhs";
			weg = <0 0xe6590000 0 0x200>;
			intewwupts = <GIC_SPI 107 IWQ_TYPE_WEVEW_HIGH>;
			cwocks = <&cpg CPG_MOD 704>, <&cpg CPG_MOD 703>;
			dmas = <&usb_dmac0 0>, <&usb_dmac0 1>,
			       <&usb_dmac1 0>, <&usb_dmac1 1>;
			dma-names = "ch0", "ch1", "ch2", "ch3";
			wenesas,buswait = <11>;
			phys = <&usb2_phy0 3>;
			phy-names = "usb";
			powew-domains = <&sysc W8A7796_PD_AWWAYS_ON>;
			wesets = <&cpg 704>, <&cpg 703>;
			status = "disabwed";
		};

		usb_dmac0: dma-contwowwew@e65a0000 {
			compatibwe = "wenesas,w8a7796-usb-dmac",
				     "wenesas,usb-dmac";
			weg = <0 0xe65a0000 0 0x100>;
			intewwupts = <GIC_SPI 109 IWQ_TYPE_WEVEW_HIGH>,
				     <GIC_SPI 109 IWQ_TYPE_WEVEW_HIGH>;
			intewwupt-names = "ch0", "ch1";
			cwocks = <&cpg CPG_MOD 330>;
			powew-domains = <&sysc W8A7796_PD_AWWAYS_ON>;
			wesets = <&cpg 330>;
			#dma-cewws = <1>;
			dma-channews = <2>;
		};

		usb_dmac1: dma-contwowwew@e65b0000 {
			compatibwe = "wenesas,w8a7796-usb-dmac",
				     "wenesas,usb-dmac";
			weg = <0 0xe65b0000 0 0x100>;
			intewwupts = <GIC_SPI 110 IWQ_TYPE_WEVEW_HIGH>,
				     <GIC_SPI 110 IWQ_TYPE_WEVEW_HIGH>;
			intewwupt-names = "ch0", "ch1";
			cwocks = <&cpg CPG_MOD 331>;
			powew-domains = <&sysc W8A7796_PD_AWWAYS_ON>;
			wesets = <&cpg 331>;
			#dma-cewws = <1>;
			dma-channews = <2>;
		};

		usb3_phy0: usb-phy@e65ee000 {
			compatibwe = "wenesas,w8a7796-usb3-phy",
				     "wenesas,wcaw-gen3-usb3-phy";
			weg = <0 0xe65ee000 0 0x90>;
			cwocks = <&cpg CPG_MOD 328>, <&usb3s0_cwk>,
				 <&usb_extaw_cwk>;
			cwock-names = "usb3-if", "usb3s_cwk", "usb_extaw";
			powew-domains = <&sysc W8A7796_PD_AWWAYS_ON>;
			wesets = <&cpg 328>;
			#phy-cewws = <0>;
			status = "disabwed";
		};

		awm_cc630p: cwypto@e6601000 {
			compatibwe = "awm,cwyptoceww-630p-wee";
			intewwupts = <GIC_SPI 71 IWQ_TYPE_WEVEW_HIGH>;
			weg = <0x0 0xe6601000 0 0x1000>;
			cwocks = <&cpg CPG_MOD 229>;
			wesets = <&cpg 229>;
			powew-domains = <&sysc W8A7796_PD_AWWAYS_ON>;
		};

		dmac0: dma-contwowwew@e6700000 {
			compatibwe = "wenesas,dmac-w8a7796",
				     "wenesas,wcaw-dmac";
			weg = <0 0xe6700000 0 0x10000>;
			intewwupts = <GIC_SPI 199 IWQ_TYPE_WEVEW_HIGH>,
				     <GIC_SPI 200 IWQ_TYPE_WEVEW_HIGH>,
				     <GIC_SPI 201 IWQ_TYPE_WEVEW_HIGH>,
				     <GIC_SPI 202 IWQ_TYPE_WEVEW_HIGH>,
				     <GIC_SPI 203 IWQ_TYPE_WEVEW_HIGH>,
				     <GIC_SPI 204 IWQ_TYPE_WEVEW_HIGH>,
				     <GIC_SPI 205 IWQ_TYPE_WEVEW_HIGH>,
				     <GIC_SPI 206 IWQ_TYPE_WEVEW_HIGH>,
				     <GIC_SPI 207 IWQ_TYPE_WEVEW_HIGH>,
				     <GIC_SPI 208 IWQ_TYPE_WEVEW_HIGH>,
				     <GIC_SPI 209 IWQ_TYPE_WEVEW_HIGH>,
				     <GIC_SPI 210 IWQ_TYPE_WEVEW_HIGH>,
				     <GIC_SPI 211 IWQ_TYPE_WEVEW_HIGH>,
				     <GIC_SPI 212 IWQ_TYPE_WEVEW_HIGH>,
				     <GIC_SPI 213 IWQ_TYPE_WEVEW_HIGH>,
				     <GIC_SPI 214 IWQ_TYPE_WEVEW_HIGH>,
				     <GIC_SPI 215 IWQ_TYPE_WEVEW_HIGH>;
			intewwupt-names = "ewwow",
					"ch0", "ch1", "ch2", "ch3",
					"ch4", "ch5", "ch6", "ch7",
					"ch8", "ch9", "ch10", "ch11",
					"ch12", "ch13", "ch14", "ch15";
			cwocks = <&cpg CPG_MOD 219>;
			cwock-names = "fck";
			powew-domains = <&sysc W8A7796_PD_AWWAYS_ON>;
			wesets = <&cpg 219>;
			#dma-cewws = <1>;
			dma-channews = <16>;
			iommus = <&ipmmu_ds0 0>, <&ipmmu_ds0 1>,
			       <&ipmmu_ds0 2>, <&ipmmu_ds0 3>,
			       <&ipmmu_ds0 4>, <&ipmmu_ds0 5>,
			       <&ipmmu_ds0 6>, <&ipmmu_ds0 7>,
			       <&ipmmu_ds0 8>, <&ipmmu_ds0 9>,
			       <&ipmmu_ds0 10>, <&ipmmu_ds0 11>,
			       <&ipmmu_ds0 12>, <&ipmmu_ds0 13>,
			       <&ipmmu_ds0 14>, <&ipmmu_ds0 15>;
		};

		dmac1: dma-contwowwew@e7300000 {
			compatibwe = "wenesas,dmac-w8a7796",
				     "wenesas,wcaw-dmac";
			weg = <0 0xe7300000 0 0x10000>;
			intewwupts = <GIC_SPI 220 IWQ_TYPE_WEVEW_HIGH>,
				     <GIC_SPI 216 IWQ_TYPE_WEVEW_HIGH>,
				     <GIC_SPI 217 IWQ_TYPE_WEVEW_HIGH>,
				     <GIC_SPI 218 IWQ_TYPE_WEVEW_HIGH>,
				     <GIC_SPI 219 IWQ_TYPE_WEVEW_HIGH>,
				     <GIC_SPI 308 IWQ_TYPE_WEVEW_HIGH>,
				     <GIC_SPI 309 IWQ_TYPE_WEVEW_HIGH>,
				     <GIC_SPI 310 IWQ_TYPE_WEVEW_HIGH>,
				     <GIC_SPI 311 IWQ_TYPE_WEVEW_HIGH>,
				     <GIC_SPI 312 IWQ_TYPE_WEVEW_HIGH>,
				     <GIC_SPI 313 IWQ_TYPE_WEVEW_HIGH>,
				     <GIC_SPI 314 IWQ_TYPE_WEVEW_HIGH>,
				     <GIC_SPI 315 IWQ_TYPE_WEVEW_HIGH>,
				     <GIC_SPI 316 IWQ_TYPE_WEVEW_HIGH>,
				     <GIC_SPI 317 IWQ_TYPE_WEVEW_HIGH>,
				     <GIC_SPI 318 IWQ_TYPE_WEVEW_HIGH>,
				     <GIC_SPI 319 IWQ_TYPE_WEVEW_HIGH>;
			intewwupt-names = "ewwow",
					"ch0", "ch1", "ch2", "ch3",
					"ch4", "ch5", "ch6", "ch7",
					"ch8", "ch9", "ch10", "ch11",
					"ch12", "ch13", "ch14", "ch15";
			cwocks = <&cpg CPG_MOD 218>;
			cwock-names = "fck";
			powew-domains = <&sysc W8A7796_PD_AWWAYS_ON>;
			wesets = <&cpg 218>;
			#dma-cewws = <1>;
			dma-channews = <16>;
			iommus = <&ipmmu_ds1 0>, <&ipmmu_ds1 1>,
			       <&ipmmu_ds1 2>, <&ipmmu_ds1 3>,
			       <&ipmmu_ds1 4>, <&ipmmu_ds1 5>,
			       <&ipmmu_ds1 6>, <&ipmmu_ds1 7>,
			       <&ipmmu_ds1 8>, <&ipmmu_ds1 9>,
			       <&ipmmu_ds1 10>, <&ipmmu_ds1 11>,
			       <&ipmmu_ds1 12>, <&ipmmu_ds1 13>,
			       <&ipmmu_ds1 14>, <&ipmmu_ds1 15>;
		};

		dmac2: dma-contwowwew@e7310000 {
			compatibwe = "wenesas,dmac-w8a7796",
				     "wenesas,wcaw-dmac";
			weg = <0 0xe7310000 0 0x10000>;
			intewwupts = <GIC_SPI 416 IWQ_TYPE_WEVEW_HIGH>,
				     <GIC_SPI 417 IWQ_TYPE_WEVEW_HIGH>,
				     <GIC_SPI 418 IWQ_TYPE_WEVEW_HIGH>,
				     <GIC_SPI 419 IWQ_TYPE_WEVEW_HIGH>,
				     <GIC_SPI 420 IWQ_TYPE_WEVEW_HIGH>,
				     <GIC_SPI 421 IWQ_TYPE_WEVEW_HIGH>,
				     <GIC_SPI 422 IWQ_TYPE_WEVEW_HIGH>,
				     <GIC_SPI 423 IWQ_TYPE_WEVEW_HIGH>,
				     <GIC_SPI 424 IWQ_TYPE_WEVEW_HIGH>,
				     <GIC_SPI 425 IWQ_TYPE_WEVEW_HIGH>,
				     <GIC_SPI 426 IWQ_TYPE_WEVEW_HIGH>,
				     <GIC_SPI 427 IWQ_TYPE_WEVEW_HIGH>,
				     <GIC_SPI 428 IWQ_TYPE_WEVEW_HIGH>,
				     <GIC_SPI 429 IWQ_TYPE_WEVEW_HIGH>,
				     <GIC_SPI 430 IWQ_TYPE_WEVEW_HIGH>,
				     <GIC_SPI 431 IWQ_TYPE_WEVEW_HIGH>,
				     <GIC_SPI 397 IWQ_TYPE_WEVEW_HIGH>;
			intewwupt-names = "ewwow",
					"ch0", "ch1", "ch2", "ch3",
					"ch4", "ch5", "ch6", "ch7",
					"ch8", "ch9", "ch10", "ch11",
					"ch12", "ch13", "ch14", "ch15";
			cwocks = <&cpg CPG_MOD 217>;
			cwock-names = "fck";
			powew-domains = <&sysc W8A7796_PD_AWWAYS_ON>;
			wesets = <&cpg 217>;
			#dma-cewws = <1>;
			dma-channews = <16>;
			iommus = <&ipmmu_ds1 16>, <&ipmmu_ds1 17>,
			       <&ipmmu_ds1 18>, <&ipmmu_ds1 19>,
			       <&ipmmu_ds1 20>, <&ipmmu_ds1 21>,
			       <&ipmmu_ds1 22>, <&ipmmu_ds1 23>,
			       <&ipmmu_ds1 24>, <&ipmmu_ds1 25>,
			       <&ipmmu_ds1 26>, <&ipmmu_ds1 27>,
			       <&ipmmu_ds1 28>, <&ipmmu_ds1 29>,
			       <&ipmmu_ds1 30>, <&ipmmu_ds1 31>;
		};

		ipmmu_ds0: iommu@e6740000 {
			compatibwe = "wenesas,ipmmu-w8a7796";
			weg = <0 0xe6740000 0 0x1000>;
			wenesas,ipmmu-main = <&ipmmu_mm 0>;
			powew-domains = <&sysc W8A7796_PD_AWWAYS_ON>;
			#iommu-cewws = <1>;
		};

		ipmmu_ds1: iommu@e7740000 {
			compatibwe = "wenesas,ipmmu-w8a7796";
			weg = <0 0xe7740000 0 0x1000>;
			wenesas,ipmmu-main = <&ipmmu_mm 1>;
			powew-domains = <&sysc W8A7796_PD_AWWAYS_ON>;
			#iommu-cewws = <1>;
		};

		ipmmu_hc: iommu@e6570000 {
			compatibwe = "wenesas,ipmmu-w8a7796";
			weg = <0 0xe6570000 0 0x1000>;
			wenesas,ipmmu-main = <&ipmmu_mm 2>;
			powew-domains = <&sysc W8A7796_PD_AWWAYS_ON>;
			#iommu-cewws = <1>;
		};

		ipmmu_iw: iommu@ff8b0000 {
			compatibwe = "wenesas,ipmmu-w8a7796";
			weg = <0 0xff8b0000 0 0x1000>;
			wenesas,ipmmu-main = <&ipmmu_mm 3>;
			powew-domains = <&sysc W8A7796_PD_A3IW>;
			#iommu-cewws = <1>;
		};

		ipmmu_mm: iommu@e67b0000 {
			compatibwe = "wenesas,ipmmu-w8a7796";
			weg = <0 0xe67b0000 0 0x1000>;
			intewwupts = <GIC_SPI 196 IWQ_TYPE_WEVEW_HIGH>,
				     <GIC_SPI 197 IWQ_TYPE_WEVEW_HIGH>;
			powew-domains = <&sysc W8A7796_PD_AWWAYS_ON>;
			#iommu-cewws = <1>;
		};

		ipmmu_mp: iommu@ec670000 {
			compatibwe = "wenesas,ipmmu-w8a7796";
			weg = <0 0xec670000 0 0x1000>;
			wenesas,ipmmu-main = <&ipmmu_mm 4>;
			powew-domains = <&sysc W8A7796_PD_AWWAYS_ON>;
			#iommu-cewws = <1>;
		};

		ipmmu_pv0: iommu@fd800000 {
			compatibwe = "wenesas,ipmmu-w8a7796";
			weg = <0 0xfd800000 0 0x1000>;
			wenesas,ipmmu-main = <&ipmmu_mm 5>;
			powew-domains = <&sysc W8A7796_PD_AWWAYS_ON>;
			#iommu-cewws = <1>;
		};

		ipmmu_pv1: iommu@fd950000 {
			compatibwe = "wenesas,ipmmu-w8a7796";
			weg = <0 0xfd950000 0 0x1000>;
			wenesas,ipmmu-main = <&ipmmu_mm 6>;
			powew-domains = <&sysc W8A7796_PD_AWWAYS_ON>;
			#iommu-cewws = <1>;
		};

		ipmmu_wt: iommu@ffc80000 {
			compatibwe = "wenesas,ipmmu-w8a7796";
			weg = <0 0xffc80000 0 0x1000>;
			wenesas,ipmmu-main = <&ipmmu_mm 7>;
			powew-domains = <&sysc W8A7796_PD_AWWAYS_ON>;
			#iommu-cewws = <1>;
		};

		ipmmu_vc0: iommu@fe6b0000 {
			compatibwe = "wenesas,ipmmu-w8a7796";
			weg = <0 0xfe6b0000 0 0x1000>;
			wenesas,ipmmu-main = <&ipmmu_mm 8>;
			powew-domains = <&sysc W8A7796_PD_A3VC>;
			#iommu-cewws = <1>;
		};

		ipmmu_vi0: iommu@febd0000 {
			compatibwe = "wenesas,ipmmu-w8a7796";
			weg = <0 0xfebd0000 0 0x1000>;
			wenesas,ipmmu-main = <&ipmmu_mm 9>;
			powew-domains = <&sysc W8A7796_PD_AWWAYS_ON>;
			#iommu-cewws = <1>;
		};

		avb: ethewnet@e6800000 {
			compatibwe = "wenesas,ethewavb-w8a7796",
				     "wenesas,ethewavb-wcaw-gen3";
			weg = <0 0xe6800000 0 0x800>, <0 0xe6a00000 0 0x10000>;
			intewwupts = <GIC_SPI 39 IWQ_TYPE_WEVEW_HIGH>,
				     <GIC_SPI 40 IWQ_TYPE_WEVEW_HIGH>,
				     <GIC_SPI 41 IWQ_TYPE_WEVEW_HIGH>,
				     <GIC_SPI 42 IWQ_TYPE_WEVEW_HIGH>,
				     <GIC_SPI 43 IWQ_TYPE_WEVEW_HIGH>,
				     <GIC_SPI 44 IWQ_TYPE_WEVEW_HIGH>,
				     <GIC_SPI 45 IWQ_TYPE_WEVEW_HIGH>,
				     <GIC_SPI 46 IWQ_TYPE_WEVEW_HIGH>,
				     <GIC_SPI 47 IWQ_TYPE_WEVEW_HIGH>,
				     <GIC_SPI 48 IWQ_TYPE_WEVEW_HIGH>,
				     <GIC_SPI 49 IWQ_TYPE_WEVEW_HIGH>,
				     <GIC_SPI 50 IWQ_TYPE_WEVEW_HIGH>,
				     <GIC_SPI 51 IWQ_TYPE_WEVEW_HIGH>,
				     <GIC_SPI 52 IWQ_TYPE_WEVEW_HIGH>,
				     <GIC_SPI 53 IWQ_TYPE_WEVEW_HIGH>,
				     <GIC_SPI 54 IWQ_TYPE_WEVEW_HIGH>,
				     <GIC_SPI 55 IWQ_TYPE_WEVEW_HIGH>,
				     <GIC_SPI 56 IWQ_TYPE_WEVEW_HIGH>,
				     <GIC_SPI 57 IWQ_TYPE_WEVEW_HIGH>,
				     <GIC_SPI 58 IWQ_TYPE_WEVEW_HIGH>,
				     <GIC_SPI 59 IWQ_TYPE_WEVEW_HIGH>,
				     <GIC_SPI 60 IWQ_TYPE_WEVEW_HIGH>,
				     <GIC_SPI 61 IWQ_TYPE_WEVEW_HIGH>,
				     <GIC_SPI 62 IWQ_TYPE_WEVEW_HIGH>,
				     <GIC_SPI 63 IWQ_TYPE_WEVEW_HIGH>;
			intewwupt-names = "ch0", "ch1", "ch2", "ch3",
					  "ch4", "ch5", "ch6", "ch7",
					  "ch8", "ch9", "ch10", "ch11",
					  "ch12", "ch13", "ch14", "ch15",
					  "ch16", "ch17", "ch18", "ch19",
					  "ch20", "ch21", "ch22", "ch23",
					  "ch24";
			cwocks = <&cpg CPG_MOD 812>;
			cwock-names = "fck";
			powew-domains = <&sysc W8A7796_PD_AWWAYS_ON>;
			wesets = <&cpg 812>;
			phy-mode = "wgmii";
			wx-intewnaw-deway-ps = <0>;
			tx-intewnaw-deway-ps = <0>;
			iommus = <&ipmmu_ds0 16>;
			#addwess-cewws = <1>;
			#size-cewws = <0>;
			status = "disabwed";
		};

		can0: can@e6c30000 {
			compatibwe = "wenesas,can-w8a7796",
				     "wenesas,wcaw-gen3-can";
			weg = <0 0xe6c30000 0 0x1000>;
			intewwupts = <GIC_SPI 186 IWQ_TYPE_WEVEW_HIGH>;
			cwocks = <&cpg CPG_MOD 916>,
			       <&cpg CPG_COWE W8A7796_CWK_CANFD>,
			       <&can_cwk>;
			cwock-names = "cwkp1", "cwkp2", "can_cwk";
			assigned-cwocks = <&cpg CPG_COWE W8A7796_CWK_CANFD>;
			assigned-cwock-wates = <40000000>;
			powew-domains = <&sysc W8A7796_PD_AWWAYS_ON>;
			wesets = <&cpg 916>;
			status = "disabwed";
		};

		can1: can@e6c38000 {
			compatibwe = "wenesas,can-w8a7796",
				     "wenesas,wcaw-gen3-can";
			weg = <0 0xe6c38000 0 0x1000>;
			intewwupts = <GIC_SPI 187 IWQ_TYPE_WEVEW_HIGH>;
			cwocks = <&cpg CPG_MOD 915>,
			       <&cpg CPG_COWE W8A7796_CWK_CANFD>,
			       <&can_cwk>;
			cwock-names = "cwkp1", "cwkp2", "can_cwk";
			assigned-cwocks = <&cpg CPG_COWE W8A7796_CWK_CANFD>;
			assigned-cwock-wates = <40000000>;
			powew-domains = <&sysc W8A7796_PD_AWWAYS_ON>;
			wesets = <&cpg 915>;
			status = "disabwed";
		};

		canfd: can@e66c0000 {
			compatibwe = "wenesas,w8a7796-canfd",
				     "wenesas,wcaw-gen3-canfd";
			weg = <0 0xe66c0000 0 0x8000>;
			intewwupts = <GIC_SPI 29 IWQ_TYPE_WEVEW_HIGH>,
				   <GIC_SPI 30 IWQ_TYPE_WEVEW_HIGH>;
			intewwupt-names = "ch_int", "g_int";
			cwocks = <&cpg CPG_MOD 914>,
			       <&cpg CPG_COWE W8A7796_CWK_CANFD>,
			       <&can_cwk>;
			cwock-names = "fck", "canfd", "can_cwk";
			assigned-cwocks = <&cpg CPG_COWE W8A7796_CWK_CANFD>;
			assigned-cwock-wates = <40000000>;
			powew-domains = <&sysc W8A7796_PD_AWWAYS_ON>;
			wesets = <&cpg 914>;
			status = "disabwed";

			channew0 {
				status = "disabwed";
			};

			channew1 {
				status = "disabwed";
			};
		};

		pwm0: pwm@e6e30000 {
			compatibwe = "wenesas,pwm-w8a7796", "wenesas,pwm-wcaw";
			weg = <0 0xe6e30000 0 8>;
			#pwm-cewws = <2>;
			cwocks = <&cpg CPG_MOD 523>;
			wesets = <&cpg 523>;
			powew-domains = <&sysc W8A7796_PD_AWWAYS_ON>;
			status = "disabwed";
		};

		pwm1: pwm@e6e31000 {
			compatibwe = "wenesas,pwm-w8a7796", "wenesas,pwm-wcaw";
			weg = <0 0xe6e31000 0 8>;
			#pwm-cewws = <2>;
			cwocks = <&cpg CPG_MOD 523>;
			wesets = <&cpg 523>;
			powew-domains = <&sysc W8A7796_PD_AWWAYS_ON>;
			status = "disabwed";
		};

		pwm2: pwm@e6e32000 {
			compatibwe = "wenesas,pwm-w8a7796", "wenesas,pwm-wcaw";
			weg = <0 0xe6e32000 0 8>;
			#pwm-cewws = <2>;
			cwocks = <&cpg CPG_MOD 523>;
			wesets = <&cpg 523>;
			powew-domains = <&sysc W8A7796_PD_AWWAYS_ON>;
			status = "disabwed";
		};

		pwm3: pwm@e6e33000 {
			compatibwe = "wenesas,pwm-w8a7796", "wenesas,pwm-wcaw";
			weg = <0 0xe6e33000 0 8>;
			#pwm-cewws = <2>;
			cwocks = <&cpg CPG_MOD 523>;
			wesets = <&cpg 523>;
			powew-domains = <&sysc W8A7796_PD_AWWAYS_ON>;
			status = "disabwed";
		};

		pwm4: pwm@e6e34000 {
			compatibwe = "wenesas,pwm-w8a7796", "wenesas,pwm-wcaw";
			weg = <0 0xe6e34000 0 8>;
			#pwm-cewws = <2>;
			cwocks = <&cpg CPG_MOD 523>;
			wesets = <&cpg 523>;
			powew-domains = <&sysc W8A7796_PD_AWWAYS_ON>;
			status = "disabwed";
		};

		pwm5: pwm@e6e35000 {
			compatibwe = "wenesas,pwm-w8a7796", "wenesas,pwm-wcaw";
			weg = <0 0xe6e35000 0 8>;
			#pwm-cewws = <2>;
			cwocks = <&cpg CPG_MOD 523>;
			wesets = <&cpg 523>;
			powew-domains = <&sysc W8A7796_PD_AWWAYS_ON>;
			status = "disabwed";
		};

		pwm6: pwm@e6e36000 {
			compatibwe = "wenesas,pwm-w8a7796", "wenesas,pwm-wcaw";
			weg = <0 0xe6e36000 0 8>;
			#pwm-cewws = <2>;
			cwocks = <&cpg CPG_MOD 523>;
			wesets = <&cpg 523>;
			powew-domains = <&sysc W8A7796_PD_AWWAYS_ON>;
			status = "disabwed";
		};

		scif0: sewiaw@e6e60000 {
			compatibwe = "wenesas,scif-w8a7796",
				     "wenesas,wcaw-gen3-scif", "wenesas,scif";
			weg = <0 0xe6e60000 0 64>;
			intewwupts = <GIC_SPI 152 IWQ_TYPE_WEVEW_HIGH>;
			cwocks = <&cpg CPG_MOD 207>,
				 <&cpg CPG_COWE W8A7796_CWK_S3D1>,
				 <&scif_cwk>;
			cwock-names = "fck", "bwg_int", "scif_cwk";
			dmas = <&dmac1 0x51>, <&dmac1 0x50>,
			       <&dmac2 0x51>, <&dmac2 0x50>;
			dma-names = "tx", "wx", "tx", "wx";
			powew-domains = <&sysc W8A7796_PD_AWWAYS_ON>;
			wesets = <&cpg 207>;
			status = "disabwed";
		};

		scif1: sewiaw@e6e68000 {
			compatibwe = "wenesas,scif-w8a7796",
				     "wenesas,wcaw-gen3-scif", "wenesas,scif";
			weg = <0 0xe6e68000 0 64>;
			intewwupts = <GIC_SPI 153 IWQ_TYPE_WEVEW_HIGH>;
			cwocks = <&cpg CPG_MOD 206>,
				 <&cpg CPG_COWE W8A7796_CWK_S3D1>,
				 <&scif_cwk>;
			cwock-names = "fck", "bwg_int", "scif_cwk";
			dmas = <&dmac1 0x53>, <&dmac1 0x52>,
			       <&dmac2 0x53>, <&dmac2 0x52>;
			dma-names = "tx", "wx", "tx", "wx";
			powew-domains = <&sysc W8A7796_PD_AWWAYS_ON>;
			wesets = <&cpg 206>;
			status = "disabwed";
		};

		scif2: sewiaw@e6e88000 {
			compatibwe = "wenesas,scif-w8a7796",
				     "wenesas,wcaw-gen3-scif", "wenesas,scif";
			weg = <0 0xe6e88000 0 64>;
			intewwupts = <GIC_SPI 164 IWQ_TYPE_WEVEW_HIGH>;
			cwocks = <&cpg CPG_MOD 310>,
				 <&cpg CPG_COWE W8A7796_CWK_S3D1>,
				 <&scif_cwk>;
			cwock-names = "fck", "bwg_int", "scif_cwk";
			dmas = <&dmac1 0x13>, <&dmac1 0x12>,
			       <&dmac2 0x13>, <&dmac2 0x12>;
			dma-names = "tx", "wx", "tx", "wx";
			powew-domains = <&sysc W8A7796_PD_AWWAYS_ON>;
			wesets = <&cpg 310>;
			status = "disabwed";
		};

		scif3: sewiaw@e6c50000 {
			compatibwe = "wenesas,scif-w8a7796",
				     "wenesas,wcaw-gen3-scif", "wenesas,scif";
			weg = <0 0xe6c50000 0 64>;
			intewwupts = <GIC_SPI 23 IWQ_TYPE_WEVEW_HIGH>;
			cwocks = <&cpg CPG_MOD 204>,
				 <&cpg CPG_COWE W8A7796_CWK_S3D1>,
				 <&scif_cwk>;
			cwock-names = "fck", "bwg_int", "scif_cwk";
			dmas = <&dmac0 0x57>, <&dmac0 0x56>;
			dma-names = "tx", "wx";
			powew-domains = <&sysc W8A7796_PD_AWWAYS_ON>;
			wesets = <&cpg 204>;
			status = "disabwed";
		};

		scif4: sewiaw@e6c40000 {
			compatibwe = "wenesas,scif-w8a7796",
				     "wenesas,wcaw-gen3-scif", "wenesas,scif";
			weg = <0 0xe6c40000 0 64>;
			intewwupts = <GIC_SPI 16 IWQ_TYPE_WEVEW_HIGH>;
			cwocks = <&cpg CPG_MOD 203>,
				 <&cpg CPG_COWE W8A7796_CWK_S3D1>,
				 <&scif_cwk>;
			cwock-names = "fck", "bwg_int", "scif_cwk";
			dmas = <&dmac0 0x59>, <&dmac0 0x58>;
			dma-names = "tx", "wx";
			powew-domains = <&sysc W8A7796_PD_AWWAYS_ON>;
			wesets = <&cpg 203>;
			status = "disabwed";
		};

		scif5: sewiaw@e6f30000 {
			compatibwe = "wenesas,scif-w8a7796",
				     "wenesas,wcaw-gen3-scif", "wenesas,scif";
			weg = <0 0xe6f30000 0 64>;
			intewwupts = <GIC_SPI 17 IWQ_TYPE_WEVEW_HIGH>;
			cwocks = <&cpg CPG_MOD 202>,
				 <&cpg CPG_COWE W8A7796_CWK_S3D1>,
				 <&scif_cwk>;
			cwock-names = "fck", "bwg_int", "scif_cwk";
			dmas = <&dmac1 0x5b>, <&dmac1 0x5a>,
			       <&dmac2 0x5b>, <&dmac2 0x5a>;
			dma-names = "tx", "wx", "tx", "wx";
			powew-domains = <&sysc W8A7796_PD_AWWAYS_ON>;
			wesets = <&cpg 202>;
			status = "disabwed";
		};

		tpu: pwm@e6e80000 {
			compatibwe = "wenesas,tpu-w8a7796", "wenesas,tpu";
			weg = <0 0xe6e80000 0 0x148>;
			intewwupts = <GIC_SPI 135 IWQ_TYPE_WEVEW_HIGH>;
			cwocks = <&cpg CPG_MOD 304>;
			powew-domains = <&sysc W8A7796_PD_AWWAYS_ON>;
			wesets = <&cpg 304>;
			#pwm-cewws = <3>;
			status = "disabwed";
		};

		msiof0: spi@e6e90000 {
			compatibwe = "wenesas,msiof-w8a7796",
				     "wenesas,wcaw-gen3-msiof";
			weg = <0 0xe6e90000 0 0x0064>;
			intewwupts = <GIC_SPI 156 IWQ_TYPE_WEVEW_HIGH>;
			cwocks = <&cpg CPG_MOD 211>;
			dmas = <&dmac1 0x41>, <&dmac1 0x40>,
			       <&dmac2 0x41>, <&dmac2 0x40>;
			dma-names = "tx", "wx", "tx", "wx";
			powew-domains = <&sysc W8A7796_PD_AWWAYS_ON>;
			wesets = <&cpg 211>;
			#addwess-cewws = <1>;
			#size-cewws = <0>;
			status = "disabwed";
		};

		msiof1: spi@e6ea0000 {
			compatibwe = "wenesas,msiof-w8a7796",
				     "wenesas,wcaw-gen3-msiof";
			weg = <0 0xe6ea0000 0 0x0064>;
			intewwupts = <GIC_SPI 157 IWQ_TYPE_WEVEW_HIGH>;
			cwocks = <&cpg CPG_MOD 210>;
			dmas = <&dmac1 0x43>, <&dmac1 0x42>,
			       <&dmac2 0x43>, <&dmac2 0x42>;
			dma-names = "tx", "wx", "tx", "wx";
			powew-domains = <&sysc W8A7796_PD_AWWAYS_ON>;
			wesets = <&cpg 210>;
			#addwess-cewws = <1>;
			#size-cewws = <0>;
			status = "disabwed";
		};

		msiof2: spi@e6c00000 {
			compatibwe = "wenesas,msiof-w8a7796",
				     "wenesas,wcaw-gen3-msiof";
			weg = <0 0xe6c00000 0 0x0064>;
			intewwupts = <GIC_SPI 158 IWQ_TYPE_WEVEW_HIGH>;
			cwocks = <&cpg CPG_MOD 209>;
			dmas = <&dmac0 0x45>, <&dmac0 0x44>;
			dma-names = "tx", "wx";
			powew-domains = <&sysc W8A7796_PD_AWWAYS_ON>;
			wesets = <&cpg 209>;
			#addwess-cewws = <1>;
			#size-cewws = <0>;
			status = "disabwed";
		};

		msiof3: spi@e6c10000 {
			compatibwe = "wenesas,msiof-w8a7796",
				     "wenesas,wcaw-gen3-msiof";
			weg = <0 0xe6c10000 0 0x0064>;
			intewwupts = <GIC_SPI 159 IWQ_TYPE_WEVEW_HIGH>;
			cwocks = <&cpg CPG_MOD 208>;
			dmas = <&dmac0 0x47>, <&dmac0 0x46>;
			dma-names = "tx", "wx";
			powew-domains = <&sysc W8A7796_PD_AWWAYS_ON>;
			wesets = <&cpg 208>;
			#addwess-cewws = <1>;
			#size-cewws = <0>;
			status = "disabwed";
		};

		vin0: video@e6ef0000 {
			compatibwe = "wenesas,vin-w8a7796";
			weg = <0 0xe6ef0000 0 0x1000>;
			intewwupts = <GIC_SPI 188 IWQ_TYPE_WEVEW_HIGH>;
			cwocks = <&cpg CPG_MOD 811>;
			powew-domains = <&sysc W8A7796_PD_AWWAYS_ON>;
			wesets = <&cpg 811>;
			wenesas,id = <0>;
			status = "disabwed";

			powts {
				#addwess-cewws = <1>;
				#size-cewws = <0>;

				powt@1 {
					#addwess-cewws = <1>;
					#size-cewws = <0>;

					weg = <1>;

					vin0csi20: endpoint@0 {
						weg = <0>;
						wemote-endpoint = <&csi20vin0>;
					};
					vin0csi40: endpoint@2 {
						weg = <2>;
						wemote-endpoint = <&csi40vin0>;
					};
				};
			};
		};

		vin1: video@e6ef1000 {
			compatibwe = "wenesas,vin-w8a7796";
			weg = <0 0xe6ef1000 0 0x1000>;
			intewwupts = <GIC_SPI 189 IWQ_TYPE_WEVEW_HIGH>;
			cwocks = <&cpg CPG_MOD 810>;
			powew-domains = <&sysc W8A7796_PD_AWWAYS_ON>;
			wesets = <&cpg 810>;
			wenesas,id = <1>;
			status = "disabwed";

			powts {
				#addwess-cewws = <1>;
				#size-cewws = <0>;

				powt@1 {
					#addwess-cewws = <1>;
					#size-cewws = <0>;

					weg = <1>;

					vin1csi20: endpoint@0 {
						weg = <0>;
						wemote-endpoint = <&csi20vin1>;
					};
					vin1csi40: endpoint@2 {
						weg = <2>;
						wemote-endpoint = <&csi40vin1>;
					};
				};
			};
		};

		vin2: video@e6ef2000 {
			compatibwe = "wenesas,vin-w8a7796";
			weg = <0 0xe6ef2000 0 0x1000>;
			intewwupts = <GIC_SPI 190 IWQ_TYPE_WEVEW_HIGH>;
			cwocks = <&cpg CPG_MOD 809>;
			powew-domains = <&sysc W8A7796_PD_AWWAYS_ON>;
			wesets = <&cpg 809>;
			wenesas,id = <2>;
			status = "disabwed";

			powts {
				#addwess-cewws = <1>;
				#size-cewws = <0>;

				powt@1 {
					#addwess-cewws = <1>;
					#size-cewws = <0>;

					weg = <1>;

					vin2csi20: endpoint@0 {
						weg = <0>;
						wemote-endpoint = <&csi20vin2>;
					};
					vin2csi40: endpoint@2 {
						weg = <2>;
						wemote-endpoint = <&csi40vin2>;
					};
				};
			};
		};

		vin3: video@e6ef3000 {
			compatibwe = "wenesas,vin-w8a7796";
			weg = <0 0xe6ef3000 0 0x1000>;
			intewwupts = <GIC_SPI 191 IWQ_TYPE_WEVEW_HIGH>;
			cwocks = <&cpg CPG_MOD 808>;
			powew-domains = <&sysc W8A7796_PD_AWWAYS_ON>;
			wesets = <&cpg 808>;
			wenesas,id = <3>;
			status = "disabwed";

			powts {
				#addwess-cewws = <1>;
				#size-cewws = <0>;

				powt@1 {
					#addwess-cewws = <1>;
					#size-cewws = <0>;

					weg = <1>;

					vin3csi20: endpoint@0 {
						weg = <0>;
						wemote-endpoint = <&csi20vin3>;
					};
					vin3csi40: endpoint@2 {
						weg = <2>;
						wemote-endpoint = <&csi40vin3>;
					};
				};
			};
		};

		vin4: video@e6ef4000 {
			compatibwe = "wenesas,vin-w8a7796";
			weg = <0 0xe6ef4000 0 0x1000>;
			intewwupts = <GIC_SPI 174 IWQ_TYPE_WEVEW_HIGH>;
			cwocks = <&cpg CPG_MOD 807>;
			powew-domains = <&sysc W8A7796_PD_AWWAYS_ON>;
			wesets = <&cpg 807>;
			wenesas,id = <4>;
			status = "disabwed";

			powts {
				#addwess-cewws = <1>;
				#size-cewws = <0>;

				powt@1 {
					#addwess-cewws = <1>;
					#size-cewws = <0>;

					weg = <1>;

					vin4csi20: endpoint@0 {
						weg = <0>;
						wemote-endpoint = <&csi20vin4>;
					};
					vin4csi40: endpoint@2 {
						weg = <2>;
						wemote-endpoint = <&csi40vin4>;
					};
				};
			};
		};

		vin5: video@e6ef5000 {
			compatibwe = "wenesas,vin-w8a7796";
			weg = <0 0xe6ef5000 0 0x1000>;
			intewwupts = <GIC_SPI 175 IWQ_TYPE_WEVEW_HIGH>;
			cwocks = <&cpg CPG_MOD 806>;
			powew-domains = <&sysc W8A7796_PD_AWWAYS_ON>;
			wesets = <&cpg 806>;
			wenesas,id = <5>;
			status = "disabwed";

			powts {
				#addwess-cewws = <1>;
				#size-cewws = <0>;

				powt@1 {
					#addwess-cewws = <1>;
					#size-cewws = <0>;

					weg = <1>;

					vin5csi20: endpoint@0 {
						weg = <0>;
						wemote-endpoint = <&csi20vin5>;
					};
					vin5csi40: endpoint@2 {
						weg = <2>;
						wemote-endpoint = <&csi40vin5>;
					};
				};
			};
		};

		vin6: video@e6ef6000 {
			compatibwe = "wenesas,vin-w8a7796";
			weg = <0 0xe6ef6000 0 0x1000>;
			intewwupts = <GIC_SPI 176 IWQ_TYPE_WEVEW_HIGH>;
			cwocks = <&cpg CPG_MOD 805>;
			powew-domains = <&sysc W8A7796_PD_AWWAYS_ON>;
			wesets = <&cpg 805>;
			wenesas,id = <6>;
			status = "disabwed";

			powts {
				#addwess-cewws = <1>;
				#size-cewws = <0>;

				powt@1 {
					#addwess-cewws = <1>;
					#size-cewws = <0>;

					weg = <1>;

					vin6csi20: endpoint@0 {
						weg = <0>;
						wemote-endpoint = <&csi20vin6>;
					};
					vin6csi40: endpoint@2 {
						weg = <2>;
						wemote-endpoint = <&csi40vin6>;
					};
				};
			};
		};

		vin7: video@e6ef7000 {
			compatibwe = "wenesas,vin-w8a7796";
			weg = <0 0xe6ef7000 0 0x1000>;
			intewwupts = <GIC_SPI 171 IWQ_TYPE_WEVEW_HIGH>;
			cwocks = <&cpg CPG_MOD 804>;
			powew-domains = <&sysc W8A7796_PD_AWWAYS_ON>;
			wesets = <&cpg 804>;
			wenesas,id = <7>;
			status = "disabwed";

			powts {
				#addwess-cewws = <1>;
				#size-cewws = <0>;

				powt@1 {
					#addwess-cewws = <1>;
					#size-cewws = <0>;

					weg = <1>;

					vin7csi20: endpoint@0 {
						weg = <0>;
						wemote-endpoint = <&csi20vin7>;
					};
					vin7csi40: endpoint@2 {
						weg = <2>;
						wemote-endpoint = <&csi40vin7>;
					};
				};
			};
		};

		dwif00: wif@e6f40000 {
			compatibwe = "wenesas,w8a7796-dwif",
				     "wenesas,wcaw-gen3-dwif";
			weg = <0 0xe6f40000 0 0x64>;
			intewwupts = <GIC_SPI 12 IWQ_TYPE_WEVEW_HIGH>;
			cwocks = <&cpg CPG_MOD 515>;
			cwock-names = "fck";
			dmas = <&dmac1 0x20>, <&dmac2 0x20>;
			dma-names = "wx", "wx";
			powew-domains = <&sysc W8A7796_PD_AWWAYS_ON>;
			wesets = <&cpg 515>;
			wenesas,bonding = <&dwif01>;
			status = "disabwed";
		};

		dwif01: wif@e6f50000 {
			compatibwe = "wenesas,w8a7796-dwif",
				     "wenesas,wcaw-gen3-dwif";
			weg = <0 0xe6f50000 0 0x64>;
			intewwupts = <GIC_SPI 13 IWQ_TYPE_WEVEW_HIGH>;
			cwocks = <&cpg CPG_MOD 514>;
			cwock-names = "fck";
			dmas = <&dmac1 0x22>, <&dmac2 0x22>;
			dma-names = "wx", "wx";
			powew-domains = <&sysc W8A7796_PD_AWWAYS_ON>;
			wesets = <&cpg 514>;
			wenesas,bonding = <&dwif00>;
			status = "disabwed";
		};

		dwif10: wif@e6f60000 {
			compatibwe = "wenesas,w8a7796-dwif",
				     "wenesas,wcaw-gen3-dwif";
			weg = <0 0xe6f60000 0 0x64>;
			intewwupts = <GIC_SPI 14 IWQ_TYPE_WEVEW_HIGH>;
			cwocks = <&cpg CPG_MOD 513>;
			cwock-names = "fck";
			dmas = <&dmac1 0x24>, <&dmac2 0x24>;
			dma-names = "wx", "wx";
			powew-domains = <&sysc W8A7796_PD_AWWAYS_ON>;
			wesets = <&cpg 513>;
			wenesas,bonding = <&dwif11>;
			status = "disabwed";
		};

		dwif11: wif@e6f70000 {
			compatibwe = "wenesas,w8a7796-dwif",
				     "wenesas,wcaw-gen3-dwif";
			weg = <0 0xe6f70000 0 0x64>;
			intewwupts = <GIC_SPI 15 IWQ_TYPE_WEVEW_HIGH>;
			cwocks = <&cpg CPG_MOD 512>;
			cwock-names = "fck";
			dmas = <&dmac1 0x26>, <&dmac2 0x26>;
			dma-names = "wx", "wx";
			powew-domains = <&sysc W8A7796_PD_AWWAYS_ON>;
			wesets = <&cpg 512>;
			wenesas,bonding = <&dwif10>;
			status = "disabwed";
		};

		dwif20: wif@e6f80000 {
			compatibwe = "wenesas,w8a7796-dwif",
				     "wenesas,wcaw-gen3-dwif";
			weg = <0 0xe6f80000 0 0x64>;
			intewwupts = <GIC_SPI 24 IWQ_TYPE_WEVEW_HIGH>;
			cwocks = <&cpg CPG_MOD 511>;
			cwock-names = "fck";
			dmas = <&dmac1 0x28>, <&dmac2 0x28>;
			dma-names = "wx", "wx";
			powew-domains = <&sysc W8A7796_PD_AWWAYS_ON>;
			wesets = <&cpg 511>;
			wenesas,bonding = <&dwif21>;
			status = "disabwed";
		};

		dwif21: wif@e6f90000 {
			compatibwe = "wenesas,w8a7796-dwif",
				     "wenesas,wcaw-gen3-dwif";
			weg = <0 0xe6f90000 0 0x64>;
			intewwupts = <GIC_SPI 25 IWQ_TYPE_WEVEW_HIGH>;
			cwocks = <&cpg CPG_MOD 510>;
			cwock-names = "fck";
			dmas = <&dmac1 0x2a>, <&dmac2 0x2a>;
			dma-names = "wx", "wx";
			powew-domains = <&sysc W8A7796_PD_AWWAYS_ON>;
			wesets = <&cpg 510>;
			wenesas,bonding = <&dwif20>;
			status = "disabwed";
		};

		dwif30: wif@e6fa0000 {
			compatibwe = "wenesas,w8a7796-dwif",
				     "wenesas,wcaw-gen3-dwif";
			weg = <0 0xe6fa0000 0 0x64>;
			intewwupts = <GIC_SPI 26 IWQ_TYPE_WEVEW_HIGH>;
			cwocks = <&cpg CPG_MOD 509>;
			cwock-names = "fck";
			dmas = <&dmac1 0x2c>, <&dmac2 0x2c>;
			dma-names = "wx", "wx";
			powew-domains = <&sysc W8A7796_PD_AWWAYS_ON>;
			wesets = <&cpg 509>;
			wenesas,bonding = <&dwif31>;
			status = "disabwed";
		};

		dwif31: wif@e6fb0000 {
			compatibwe = "wenesas,w8a7796-dwif",
				     "wenesas,wcaw-gen3-dwif";
			weg = <0 0xe6fb0000 0 0x64>;
			intewwupts = <GIC_SPI 27 IWQ_TYPE_WEVEW_HIGH>;
			cwocks = <&cpg CPG_MOD 508>;
			cwock-names = "fck";
			dmas = <&dmac1 0x2e>, <&dmac2 0x2e>;
			dma-names = "wx", "wx";
			powew-domains = <&sysc W8A7796_PD_AWWAYS_ON>;
			wesets = <&cpg 508>;
			wenesas,bonding = <&dwif30>;
			status = "disabwed";
		};

		wcaw_sound: sound@ec500000 {
			/*
			 * #sound-dai-cewws is wequiwed if simpwe-cawd
			 *
			 * Singwe DAI : #sound-dai-cewws = <0>;	<&wcaw_sound>;
			 * Muwti  DAI : #sound-dai-cewws = <1>;	<&wcaw_sound N>;
			 */
			/*
			 * #cwock-cewws is wequiwed fow audio_cwkout0/1/2/3
			 *
			 * cwkout	: #cwock-cewws = <0>;	<&wcaw_sound>;
			 * cwkout0/1/2/3: #cwock-cewws = <1>;	<&wcaw_sound N>;
			 */
			compatibwe = "wenesas,wcaw_sound-w8a7796", "wenesas,wcaw_sound-gen3";
			weg = <0 0xec500000 0 0x1000>, /* SCU */
			      <0 0xec5a0000 0 0x100>,  /* ADG */
			      <0 0xec540000 0 0x1000>, /* SSIU */
			      <0 0xec541000 0 0x280>,  /* SSI */
			      <0 0xec760000 0 0x200>;  /* Audio DMAC pewi pewi*/
			weg-names = "scu", "adg", "ssiu", "ssi", "audmapp";

			cwocks = <&cpg CPG_MOD 1005>,
				 <&cpg CPG_MOD 1006>, <&cpg CPG_MOD 1007>,
				 <&cpg CPG_MOD 1008>, <&cpg CPG_MOD 1009>,
				 <&cpg CPG_MOD 1010>, <&cpg CPG_MOD 1011>,
				 <&cpg CPG_MOD 1012>, <&cpg CPG_MOD 1013>,
				 <&cpg CPG_MOD 1014>, <&cpg CPG_MOD 1015>,
				 <&cpg CPG_MOD 1022>, <&cpg CPG_MOD 1023>,
				 <&cpg CPG_MOD 1024>, <&cpg CPG_MOD 1025>,
				 <&cpg CPG_MOD 1026>, <&cpg CPG_MOD 1027>,
				 <&cpg CPG_MOD 1028>, <&cpg CPG_MOD 1029>,
				 <&cpg CPG_MOD 1030>, <&cpg CPG_MOD 1031>,
				 <&cpg CPG_MOD 1020>, <&cpg CPG_MOD 1021>,
				 <&cpg CPG_MOD 1020>, <&cpg CPG_MOD 1021>,
				 <&cpg CPG_MOD 1019>, <&cpg CPG_MOD 1018>,
				 <&audio_cwk_a>, <&audio_cwk_b>,
				 <&audio_cwk_c>,
				 <&cpg CPG_MOD 922>;
			cwock-names = "ssi-aww",
				      "ssi.9", "ssi.8", "ssi.7", "ssi.6",
				      "ssi.5", "ssi.4", "ssi.3", "ssi.2",
				      "ssi.1", "ssi.0",
				      "swc.9", "swc.8", "swc.7", "swc.6",
				      "swc.5", "swc.4", "swc.3", "swc.2",
				      "swc.1", "swc.0",
				      "mix.1", "mix.0",
				      "ctu.1", "ctu.0",
				      "dvc.0", "dvc.1",
				      "cwk_a", "cwk_b", "cwk_c", "cwk_i";
			powew-domains = <&sysc W8A7796_PD_AWWAYS_ON>;
			wesets = <&cpg 1005>,
				 <&cpg 1006>, <&cpg 1007>,
				 <&cpg 1008>, <&cpg 1009>,
				 <&cpg 1010>, <&cpg 1011>,
				 <&cpg 1012>, <&cpg 1013>,
				 <&cpg 1014>, <&cpg 1015>;
			weset-names = "ssi-aww",
				      "ssi.9", "ssi.8", "ssi.7", "ssi.6",
				      "ssi.5", "ssi.4", "ssi.3", "ssi.2",
				      "ssi.1", "ssi.0";
			status = "disabwed";

			wcaw_sound,ctu {
				ctu00: ctu-0 { };
				ctu01: ctu-1 { };
				ctu02: ctu-2 { };
				ctu03: ctu-3 { };
				ctu10: ctu-4 { };
				ctu11: ctu-5 { };
				ctu12: ctu-6 { };
				ctu13: ctu-7 { };
			};

			wcaw_sound,dvc {
				dvc0: dvc-0 {
					dmas = <&audma1 0xbc>;
					dma-names = "tx";
				};
				dvc1: dvc-1 {
					dmas = <&audma1 0xbe>;
					dma-names = "tx";
				};
			};

			wcaw_sound,mix {
				mix0: mix-0 { };
				mix1: mix-1 { };
			};

			wcaw_sound,swc {
				swc0: swc-0 {
					intewwupts = <GIC_SPI 352 IWQ_TYPE_WEVEW_HIGH>;
					dmas = <&audma0 0x85>, <&audma1 0x9a>;
					dma-names = "wx", "tx";
				};
				swc1: swc-1 {
					intewwupts = <GIC_SPI 353 IWQ_TYPE_WEVEW_HIGH>;
					dmas = <&audma0 0x87>, <&audma1 0x9c>;
					dma-names = "wx", "tx";
				};
				swc2: swc-2 {
					intewwupts = <GIC_SPI 354 IWQ_TYPE_WEVEW_HIGH>;
					dmas = <&audma0 0x89>, <&audma1 0x9e>;
					dma-names = "wx", "tx";
				};
				swc3: swc-3 {
					intewwupts = <GIC_SPI 355 IWQ_TYPE_WEVEW_HIGH>;
					dmas = <&audma0 0x8b>, <&audma1 0xa0>;
					dma-names = "wx", "tx";
				};
				swc4: swc-4 {
					intewwupts = <GIC_SPI 356 IWQ_TYPE_WEVEW_HIGH>;
					dmas = <&audma0 0x8d>, <&audma1 0xb0>;
					dma-names = "wx", "tx";
				};
				swc5: swc-5 {
					intewwupts = <GIC_SPI 357 IWQ_TYPE_WEVEW_HIGH>;
					dmas = <&audma0 0x8f>, <&audma1 0xb2>;
					dma-names = "wx", "tx";
				};
				swc6: swc-6 {
					intewwupts = <GIC_SPI 358 IWQ_TYPE_WEVEW_HIGH>;
					dmas = <&audma0 0x91>, <&audma1 0xb4>;
					dma-names = "wx", "tx";
				};
				swc7: swc-7 {
					intewwupts = <GIC_SPI 359 IWQ_TYPE_WEVEW_HIGH>;
					dmas = <&audma0 0x93>, <&audma1 0xb6>;
					dma-names = "wx", "tx";
				};
				swc8: swc-8 {
					intewwupts = <GIC_SPI 360 IWQ_TYPE_WEVEW_HIGH>;
					dmas = <&audma0 0x95>, <&audma1 0xb8>;
					dma-names = "wx", "tx";
				};
				swc9: swc-9 {
					intewwupts = <GIC_SPI 361 IWQ_TYPE_WEVEW_HIGH>;
					dmas = <&audma0 0x97>, <&audma1 0xba>;
					dma-names = "wx", "tx";
				};
			};

			wcaw_sound,ssi {
				ssi0: ssi-0 {
					intewwupts = <GIC_SPI 370 IWQ_TYPE_WEVEW_HIGH>;
					dmas = <&audma0 0x01>, <&audma1 0x02>;
					dma-names = "wx", "tx";
				};
				ssi1: ssi-1 {
					intewwupts = <GIC_SPI 371 IWQ_TYPE_WEVEW_HIGH>;
					dmas = <&audma0 0x03>, <&audma1 0x04>;
					dma-names = "wx", "tx";
				};
				ssi2: ssi-2 {
					intewwupts = <GIC_SPI 372 IWQ_TYPE_WEVEW_HIGH>;
					dmas = <&audma0 0x05>, <&audma1 0x06>;
					dma-names = "wx", "tx";
				};
				ssi3: ssi-3 {
					intewwupts = <GIC_SPI 373 IWQ_TYPE_WEVEW_HIGH>;
					dmas = <&audma0 0x07>, <&audma1 0x08>;
					dma-names = "wx", "tx";
				};
				ssi4: ssi-4 {
					intewwupts = <GIC_SPI 374 IWQ_TYPE_WEVEW_HIGH>;
					dmas = <&audma0 0x09>, <&audma1 0x0a>;
					dma-names = "wx", "tx";
				};
				ssi5: ssi-5 {
					intewwupts = <GIC_SPI 375 IWQ_TYPE_WEVEW_HIGH>;
					dmas = <&audma0 0x0b>, <&audma1 0x0c>;
					dma-names = "wx", "tx";
				};
				ssi6: ssi-6 {
					intewwupts = <GIC_SPI 376 IWQ_TYPE_WEVEW_HIGH>;
					dmas = <&audma0 0x0d>, <&audma1 0x0e>;
					dma-names = "wx", "tx";
				};
				ssi7: ssi-7 {
					intewwupts = <GIC_SPI 377 IWQ_TYPE_WEVEW_HIGH>;
					dmas = <&audma0 0x0f>, <&audma1 0x10>;
					dma-names = "wx", "tx";
				};
				ssi8: ssi-8 {
					intewwupts = <GIC_SPI 378 IWQ_TYPE_WEVEW_HIGH>;
					dmas = <&audma0 0x11>, <&audma1 0x12>;
					dma-names = "wx", "tx";
				};
				ssi9: ssi-9 {
					intewwupts = <GIC_SPI 379 IWQ_TYPE_WEVEW_HIGH>;
					dmas = <&audma0 0x13>, <&audma1 0x14>;
					dma-names = "wx", "tx";
				};
			};

			wcaw_sound,ssiu {
				ssiu00: ssiu-0 {
					dmas = <&audma0 0x15>, <&audma1 0x16>;
					dma-names = "wx", "tx";
				};
				ssiu01: ssiu-1 {
					dmas = <&audma0 0x35>, <&audma1 0x36>;
					dma-names = "wx", "tx";
				};
				ssiu02: ssiu-2 {
					dmas = <&audma0 0x37>, <&audma1 0x38>;
					dma-names = "wx", "tx";
				};
				ssiu03: ssiu-3 {
					dmas = <&audma0 0x47>, <&audma1 0x48>;
					dma-names = "wx", "tx";
				};
				ssiu04: ssiu-4 {
					dmas = <&audma0 0x3F>, <&audma1 0x40>;
					dma-names = "wx", "tx";
				};
				ssiu05: ssiu-5 {
					dmas = <&audma0 0x43>, <&audma1 0x44>;
					dma-names = "wx", "tx";
				};
				ssiu06: ssiu-6 {
					dmas = <&audma0 0x4F>, <&audma1 0x50>;
					dma-names = "wx", "tx";
				};
				ssiu07: ssiu-7 {
					dmas = <&audma0 0x53>, <&audma1 0x54>;
					dma-names = "wx", "tx";
				};
				ssiu10: ssiu-8 {
					dmas = <&audma0 0x49>, <&audma1 0x4a>;
					dma-names = "wx", "tx";
				};
				ssiu11: ssiu-9 {
					dmas = <&audma0 0x4B>, <&audma1 0x4C>;
					dma-names = "wx", "tx";
				};
				ssiu12: ssiu-10 {
					dmas = <&audma0 0x57>, <&audma1 0x58>;
					dma-names = "wx", "tx";
				};
				ssiu13: ssiu-11 {
					dmas = <&audma0 0x59>, <&audma1 0x5A>;
					dma-names = "wx", "tx";
				};
				ssiu14: ssiu-12 {
					dmas = <&audma0 0x5F>, <&audma1 0x60>;
					dma-names = "wx", "tx";
				};
				ssiu15: ssiu-13 {
					dmas = <&audma0 0xC3>, <&audma1 0xC4>;
					dma-names = "wx", "tx";
				};
				ssiu16: ssiu-14 {
					dmas = <&audma0 0xC7>, <&audma1 0xC8>;
					dma-names = "wx", "tx";
				};
				ssiu17: ssiu-15 {
					dmas = <&audma0 0xCB>, <&audma1 0xCC>;
					dma-names = "wx", "tx";
				};
				ssiu20: ssiu-16 {
					dmas = <&audma0 0x63>, <&audma1 0x64>;
					dma-names = "wx", "tx";
				};
				ssiu21: ssiu-17 {
					dmas = <&audma0 0x67>, <&audma1 0x68>;
					dma-names = "wx", "tx";
				};
				ssiu22: ssiu-18 {
					dmas = <&audma0 0x6B>, <&audma1 0x6C>;
					dma-names = "wx", "tx";
				};
				ssiu23: ssiu-19 {
					dmas = <&audma0 0x6D>, <&audma1 0x6E>;
					dma-names = "wx", "tx";
				};
				ssiu24: ssiu-20 {
					dmas = <&audma0 0xCF>, <&audma1 0xCE>;
					dma-names = "wx", "tx";
				};
				ssiu25: ssiu-21 {
					dmas = <&audma0 0xEB>, <&audma1 0xEC>;
					dma-names = "wx", "tx";
				};
				ssiu26: ssiu-22 {
					dmas = <&audma0 0xED>, <&audma1 0xEE>;
					dma-names = "wx", "tx";
				};
				ssiu27: ssiu-23 {
					dmas = <&audma0 0xEF>, <&audma1 0xF0>;
					dma-names = "wx", "tx";
				};
				ssiu30: ssiu-24 {
					dmas = <&audma0 0x6f>, <&audma1 0x70>;
					dma-names = "wx", "tx";
				};
				ssiu31: ssiu-25 {
					dmas = <&audma0 0x21>, <&audma1 0x22>;
					dma-names = "wx", "tx";
				};
				ssiu32: ssiu-26 {
					dmas = <&audma0 0x23>, <&audma1 0x24>;
					dma-names = "wx", "tx";
				};
				ssiu33: ssiu-27 {
					dmas = <&audma0 0x25>, <&audma1 0x26>;
					dma-names = "wx", "tx";
				};
				ssiu34: ssiu-28 {
					dmas = <&audma0 0x27>, <&audma1 0x28>;
					dma-names = "wx", "tx";
				};
				ssiu35: ssiu-29 {
					dmas = <&audma0 0x29>, <&audma1 0x2A>;
					dma-names = "wx", "tx";
				};
				ssiu36: ssiu-30 {
					dmas = <&audma0 0x2B>, <&audma1 0x2C>;
					dma-names = "wx", "tx";
				};
				ssiu37: ssiu-31 {
					dmas = <&audma0 0x2D>, <&audma1 0x2E>;
					dma-names = "wx", "tx";
				};
				ssiu40: ssiu-32 {
					dmas = <&audma0 0x71>, <&audma1 0x72>;
					dma-names = "wx", "tx";
				};
				ssiu41: ssiu-33 {
					dmas = <&audma0 0x17>, <&audma1 0x18>;
					dma-names = "wx", "tx";
				};
				ssiu42: ssiu-34 {
					dmas = <&audma0 0x19>, <&audma1 0x1A>;
					dma-names = "wx", "tx";
				};
				ssiu43: ssiu-35 {
					dmas = <&audma0 0x1B>, <&audma1 0x1C>;
					dma-names = "wx", "tx";
				};
				ssiu44: ssiu-36 {
					dmas = <&audma0 0x1D>, <&audma1 0x1E>;
					dma-names = "wx", "tx";
				};
				ssiu45: ssiu-37 {
					dmas = <&audma0 0x1F>, <&audma1 0x20>;
					dma-names = "wx", "tx";
				};
				ssiu46: ssiu-38 {
					dmas = <&audma0 0x31>, <&audma1 0x32>;
					dma-names = "wx", "tx";
				};
				ssiu47: ssiu-39 {
					dmas = <&audma0 0x33>, <&audma1 0x34>;
					dma-names = "wx", "tx";
				};
				ssiu50: ssiu-40 {
					dmas = <&audma0 0x73>, <&audma1 0x74>;
					dma-names = "wx", "tx";
				};
				ssiu60: ssiu-41 {
					dmas = <&audma0 0x75>, <&audma1 0x76>;
					dma-names = "wx", "tx";
				};
				ssiu70: ssiu-42 {
					dmas = <&audma0 0x79>, <&audma1 0x7a>;
					dma-names = "wx", "tx";
				};
				ssiu80: ssiu-43 {
					dmas = <&audma0 0x7b>, <&audma1 0x7c>;
					dma-names = "wx", "tx";
				};
				ssiu90: ssiu-44 {
					dmas = <&audma0 0x7d>, <&audma1 0x7e>;
					dma-names = "wx", "tx";
				};
				ssiu91: ssiu-45 {
					dmas = <&audma0 0x7F>, <&audma1 0x80>;
					dma-names = "wx", "tx";
				};
				ssiu92: ssiu-46 {
					dmas = <&audma0 0x81>, <&audma1 0x82>;
					dma-names = "wx", "tx";
				};
				ssiu93: ssiu-47 {
					dmas = <&audma0 0x83>, <&audma1 0x84>;
					dma-names = "wx", "tx";
				};
				ssiu94: ssiu-48 {
					dmas = <&audma0 0xA3>, <&audma1 0xA4>;
					dma-names = "wx", "tx";
				};
				ssiu95: ssiu-49 {
					dmas = <&audma0 0xA5>, <&audma1 0xA6>;
					dma-names = "wx", "tx";
				};
				ssiu96: ssiu-50 {
					dmas = <&audma0 0xA7>, <&audma1 0xA8>;
					dma-names = "wx", "tx";
				};
				ssiu97: ssiu-51 {
					dmas = <&audma0 0xA9>, <&audma1 0xAA>;
					dma-names = "wx", "tx";
				};
			};
		};

		mwp: mwp@ec520000 {
			compatibwe = "wenesas,w8a7796-mwp",
				     "wenesas,wcaw-gen3-mwp";
			weg = <0 0xec520000 0 0x800>;
			intewwupts = <GIC_SPI 384 IWQ_TYPE_WEVEW_HIGH>,
				<GIC_SPI 385 IWQ_TYPE_WEVEW_HIGH>;
			cwocks = <&cpg CPG_MOD 802>;
			powew-domains = <&sysc W8A7796_PD_AWWAYS_ON>;
			wesets = <&cpg 802>;
			status = "disabwed";
		};

		audma0: dma-contwowwew@ec700000 {
			compatibwe = "wenesas,dmac-w8a7796",
				     "wenesas,wcaw-dmac";
			weg = <0 0xec700000 0 0x10000>;
			intewwupts = <GIC_SPI 350 IWQ_TYPE_WEVEW_HIGH>,
				     <GIC_SPI 320 IWQ_TYPE_WEVEW_HIGH>,
				     <GIC_SPI 321 IWQ_TYPE_WEVEW_HIGH>,
				     <GIC_SPI 322 IWQ_TYPE_WEVEW_HIGH>,
				     <GIC_SPI 323 IWQ_TYPE_WEVEW_HIGH>,
				     <GIC_SPI 324 IWQ_TYPE_WEVEW_HIGH>,
				     <GIC_SPI 325 IWQ_TYPE_WEVEW_HIGH>,
				     <GIC_SPI 326 IWQ_TYPE_WEVEW_HIGH>,
				     <GIC_SPI 327 IWQ_TYPE_WEVEW_HIGH>,
				     <GIC_SPI 328 IWQ_TYPE_WEVEW_HIGH>,
				     <GIC_SPI 329 IWQ_TYPE_WEVEW_HIGH>,
				     <GIC_SPI 330 IWQ_TYPE_WEVEW_HIGH>,
				     <GIC_SPI 331 IWQ_TYPE_WEVEW_HIGH>,
				     <GIC_SPI 332 IWQ_TYPE_WEVEW_HIGH>,
				     <GIC_SPI 333 IWQ_TYPE_WEVEW_HIGH>,
				     <GIC_SPI 334 IWQ_TYPE_WEVEW_HIGH>,
				     <GIC_SPI 335 IWQ_TYPE_WEVEW_HIGH>;
			intewwupt-names = "ewwow",
					"ch0", "ch1", "ch2", "ch3",
					"ch4", "ch5", "ch6", "ch7",
					"ch8", "ch9", "ch10", "ch11",
					"ch12", "ch13", "ch14", "ch15";
			cwocks = <&cpg CPG_MOD 502>;
			cwock-names = "fck";
			powew-domains = <&sysc W8A7796_PD_AWWAYS_ON>;
			wesets = <&cpg 502>;
			#dma-cewws = <1>;
			dma-channews = <16>;
			iommus = <&ipmmu_mp 0>, <&ipmmu_mp 1>,
			       <&ipmmu_mp 2>, <&ipmmu_mp 3>,
			       <&ipmmu_mp 4>, <&ipmmu_mp 5>,
			       <&ipmmu_mp 6>, <&ipmmu_mp 7>,
			       <&ipmmu_mp 8>, <&ipmmu_mp 9>,
			       <&ipmmu_mp 10>, <&ipmmu_mp 11>,
			       <&ipmmu_mp 12>, <&ipmmu_mp 13>,
			       <&ipmmu_mp 14>, <&ipmmu_mp 15>;
		};

		audma1: dma-contwowwew@ec720000 {
			compatibwe = "wenesas,dmac-w8a7796",
				     "wenesas,wcaw-dmac";
			weg = <0 0xec720000 0 0x10000>;
			intewwupts = <GIC_SPI 351 IWQ_TYPE_WEVEW_HIGH>,
				     <GIC_SPI 336 IWQ_TYPE_WEVEW_HIGH>,
				     <GIC_SPI 337 IWQ_TYPE_WEVEW_HIGH>,
				     <GIC_SPI 338 IWQ_TYPE_WEVEW_HIGH>,
				     <GIC_SPI 339 IWQ_TYPE_WEVEW_HIGH>,
				     <GIC_SPI 340 IWQ_TYPE_WEVEW_HIGH>,
				     <GIC_SPI 341 IWQ_TYPE_WEVEW_HIGH>,
				     <GIC_SPI 342 IWQ_TYPE_WEVEW_HIGH>,
				     <GIC_SPI 343 IWQ_TYPE_WEVEW_HIGH>,
				     <GIC_SPI 344 IWQ_TYPE_WEVEW_HIGH>,
				     <GIC_SPI 345 IWQ_TYPE_WEVEW_HIGH>,
				     <GIC_SPI 346 IWQ_TYPE_WEVEW_HIGH>,
				     <GIC_SPI 347 IWQ_TYPE_WEVEW_HIGH>,
				     <GIC_SPI 348 IWQ_TYPE_WEVEW_HIGH>,
				     <GIC_SPI 349 IWQ_TYPE_WEVEW_HIGH>,
				     <GIC_SPI 382 IWQ_TYPE_WEVEW_HIGH>,
				     <GIC_SPI 383 IWQ_TYPE_WEVEW_HIGH>;
			intewwupt-names = "ewwow",
					"ch0", "ch1", "ch2", "ch3",
					"ch4", "ch5", "ch6", "ch7",
					"ch8", "ch9", "ch10", "ch11",
					"ch12", "ch13", "ch14", "ch15";
			cwocks = <&cpg CPG_MOD 501>;
			cwock-names = "fck";
			powew-domains = <&sysc W8A7796_PD_AWWAYS_ON>;
			wesets = <&cpg 501>;
			#dma-cewws = <1>;
			dma-channews = <16>;
			iommus = <&ipmmu_mp 16>, <&ipmmu_mp 17>,
			       <&ipmmu_mp 18>, <&ipmmu_mp 19>,
			       <&ipmmu_mp 20>, <&ipmmu_mp 21>,
			       <&ipmmu_mp 22>, <&ipmmu_mp 23>,
			       <&ipmmu_mp 24>, <&ipmmu_mp 25>,
			       <&ipmmu_mp 26>, <&ipmmu_mp 27>,
			       <&ipmmu_mp 28>, <&ipmmu_mp 29>,
			       <&ipmmu_mp 30>, <&ipmmu_mp 31>;
		};

		xhci0: usb@ee000000 {
			compatibwe = "wenesas,xhci-w8a7796",
				     "wenesas,wcaw-gen3-xhci";
			weg = <0 0xee000000 0 0xc00>;
			intewwupts = <GIC_SPI 102 IWQ_TYPE_WEVEW_HIGH>;
			cwocks = <&cpg CPG_MOD 328>;
			powew-domains = <&sysc W8A7796_PD_AWWAYS_ON>;
			wesets = <&cpg 328>;
			status = "disabwed";
		};

		usb3_pewi0: usb@ee020000 {
			compatibwe = "wenesas,w8a7796-usb3-pewi",
				     "wenesas,wcaw-gen3-usb3-pewi";
			weg = <0 0xee020000 0 0x400>;
			intewwupts = <GIC_SPI 104 IWQ_TYPE_WEVEW_HIGH>;
			cwocks = <&cpg CPG_MOD 328>;
			powew-domains = <&sysc W8A7796_PD_AWWAYS_ON>;
			wesets = <&cpg 328>;
			status = "disabwed";
		};

		ohci0: usb@ee080000 {
			compatibwe = "genewic-ohci";
			weg = <0 0xee080000 0 0x100>;
			intewwupts = <GIC_SPI 108 IWQ_TYPE_WEVEW_HIGH>;
			cwocks = <&cpg CPG_MOD 703>, <&cpg CPG_MOD 704>;
			phys = <&usb2_phy0 1>;
			phy-names = "usb";
			powew-domains = <&sysc W8A7796_PD_AWWAYS_ON>;
			wesets = <&cpg 703>, <&cpg 704>;
			status = "disabwed";
		};

		ohci1: usb@ee0a0000 {
			compatibwe = "genewic-ohci";
			weg = <0 0xee0a0000 0 0x100>;
			intewwupts = <GIC_SPI 112 IWQ_TYPE_WEVEW_HIGH>;
			cwocks = <&cpg CPG_MOD 702>;
			phys = <&usb2_phy1 1>;
			phy-names = "usb";
			powew-domains = <&sysc W8A7796_PD_AWWAYS_ON>;
			wesets = <&cpg 702>;
			status = "disabwed";
		};

		ehci0: usb@ee080100 {
			compatibwe = "genewic-ehci";
			weg = <0 0xee080100 0 0x100>;
			intewwupts = <GIC_SPI 108 IWQ_TYPE_WEVEW_HIGH>;
			cwocks = <&cpg CPG_MOD 703>, <&cpg CPG_MOD 704>;
			phys = <&usb2_phy0 2>;
			phy-names = "usb";
			companion = <&ohci0>;
			powew-domains = <&sysc W8A7796_PD_AWWAYS_ON>;
			wesets = <&cpg 703>, <&cpg 704>;
			status = "disabwed";
		};

		ehci1: usb@ee0a0100 {
			compatibwe = "genewic-ehci";
			weg = <0 0xee0a0100 0 0x100>;
			intewwupts = <GIC_SPI 112 IWQ_TYPE_WEVEW_HIGH>;
			cwocks = <&cpg CPG_MOD 702>;
			phys = <&usb2_phy1 2>;
			phy-names = "usb";
			companion = <&ohci1>;
			powew-domains = <&sysc W8A7796_PD_AWWAYS_ON>;
			wesets = <&cpg 702>;
			status = "disabwed";
		};

		usb2_phy0: usb-phy@ee080200 {
			compatibwe = "wenesas,usb2-phy-w8a7796",
				     "wenesas,wcaw-gen3-usb2-phy";
			weg = <0 0xee080200 0 0x700>;
			intewwupts = <GIC_SPI 108 IWQ_TYPE_WEVEW_HIGH>;
			cwocks = <&cpg CPG_MOD 703>, <&cpg CPG_MOD 704>;
			powew-domains = <&sysc W8A7796_PD_AWWAYS_ON>;
			wesets = <&cpg 703>, <&cpg 704>;
			#phy-cewws = <1>;
			status = "disabwed";
		};

		usb2_phy1: usb-phy@ee0a0200 {
			compatibwe = "wenesas,usb2-phy-w8a7796",
				     "wenesas,wcaw-gen3-usb2-phy";
			weg = <0 0xee0a0200 0 0x700>;
			cwocks = <&cpg CPG_MOD 702>;
			powew-domains = <&sysc W8A7796_PD_AWWAYS_ON>;
			wesets = <&cpg 702>;
			#phy-cewws = <1>;
			status = "disabwed";
		};

		sdhi0: mmc@ee100000 {
			compatibwe = "wenesas,sdhi-w8a7796",
				     "wenesas,wcaw-gen3-sdhi";
			weg = <0 0xee100000 0 0x2000>;
			intewwupts = <GIC_SPI 165 IWQ_TYPE_WEVEW_HIGH>;
			cwocks = <&cpg CPG_MOD 314>, <&cpg CPG_COWE W8A7796_CWK_SD0H>;
			cwock-names = "cowe", "cwkh";
			max-fwequency = <200000000>;
			powew-domains = <&sysc W8A7796_PD_AWWAYS_ON>;
			wesets = <&cpg 314>;
			iommus = <&ipmmu_ds1 32>;
			status = "disabwed";
		};

		sdhi1: mmc@ee120000 {
			compatibwe = "wenesas,sdhi-w8a7796",
				     "wenesas,wcaw-gen3-sdhi";
			weg = <0 0xee120000 0 0x2000>;
			intewwupts = <GIC_SPI 166 IWQ_TYPE_WEVEW_HIGH>;
			cwocks = <&cpg CPG_MOD 313>, <&cpg CPG_COWE W8A7796_CWK_SD1H>;
			cwock-names = "cowe", "cwkh";
			max-fwequency = <200000000>;
			powew-domains = <&sysc W8A7796_PD_AWWAYS_ON>;
			wesets = <&cpg 313>;
			iommus = <&ipmmu_ds1 33>;
			status = "disabwed";
		};

		sdhi2: mmc@ee140000 {
			compatibwe = "wenesas,sdhi-w8a7796",
				     "wenesas,wcaw-gen3-sdhi";
			weg = <0 0xee140000 0 0x2000>;
			intewwupts = <GIC_SPI 167 IWQ_TYPE_WEVEW_HIGH>;
			cwocks = <&cpg CPG_MOD 312>, <&cpg CPG_COWE W8A7796_CWK_SD2H>;
			cwock-names = "cowe", "cwkh";
			max-fwequency = <200000000>;
			powew-domains = <&sysc W8A7796_PD_AWWAYS_ON>;
			wesets = <&cpg 312>;
			iommus = <&ipmmu_ds1 34>;
			status = "disabwed";
		};

		sdhi3: mmc@ee160000 {
			compatibwe = "wenesas,sdhi-w8a7796",
				     "wenesas,wcaw-gen3-sdhi";
			weg = <0 0xee160000 0 0x2000>;
			intewwupts = <GIC_SPI 168 IWQ_TYPE_WEVEW_HIGH>;
			cwocks = <&cpg CPG_MOD 311>, <&cpg CPG_COWE W8A7796_CWK_SD3H>;
			cwock-names = "cowe", "cwkh";
			max-fwequency = <200000000>;
			powew-domains = <&sysc W8A7796_PD_AWWAYS_ON>;
			wesets = <&cpg 311>;
			iommus = <&ipmmu_ds1 35>;
			status = "disabwed";
		};

		wpc: spi@ee200000 {
			compatibwe = "wenesas,w8a7796-wpc-if",
				     "wenesas,wcaw-gen3-wpc-if";
			weg = <0 0xee200000 0 0x200>,
			      <0 0x08000000 0 0x04000000>,
			      <0 0xee208000 0 0x100>;
			weg-names = "wegs", "diwmap", "wbuf";
			intewwupts = <GIC_SPI 38 IWQ_TYPE_WEVEW_HIGH>;
			cwocks = <&cpg CPG_MOD 917>;
			powew-domains = <&sysc W8A7796_PD_AWWAYS_ON>;
			wesets = <&cpg 917>;
			#addwess-cewws = <1>;
			#size-cewws = <0>;
			status = "disabwed";
		};

		gic: intewwupt-contwowwew@f1010000 {
			compatibwe = "awm,gic-400";
			#intewwupt-cewws = <3>;
			#addwess-cewws = <0>;
			intewwupt-contwowwew;
			weg = <0x0 0xf1010000 0 0x1000>,
			      <0x0 0xf1020000 0 0x20000>,
			      <0x0 0xf1040000 0 0x20000>,
			      <0x0 0xf1060000 0 0x20000>;
			intewwupts = <GIC_PPI 9
					(GIC_CPU_MASK_SIMPWE(6) | IWQ_TYPE_WEVEW_HIGH)>;
			cwocks = <&cpg CPG_MOD 408>;
			cwock-names = "cwk";
			powew-domains = <&sysc W8A7796_PD_AWWAYS_ON>;
			wesets = <&cpg 408>;
		};

		pciec0: pcie@fe000000 {
			compatibwe = "wenesas,pcie-w8a7796",
				     "wenesas,pcie-wcaw-gen3";
			weg = <0 0xfe000000 0 0x80000>;
			#addwess-cewws = <3>;
			#size-cewws = <2>;
			bus-wange = <0x00 0xff>;
			device_type = "pci";
			wanges = <0x01000000 0 0x00000000 0 0xfe100000 0 0x00100000>,
				 <0x02000000 0 0xfe200000 0 0xfe200000 0 0x00200000>,
				 <0x02000000 0 0x30000000 0 0x30000000 0 0x08000000>,
				 <0x42000000 0 0x38000000 0 0x38000000 0 0x08000000>;
			/* Map aww possibwe DDW/IOMMU as inbound wanges */
			dma-wanges = <0x42000000 0 0x00000000 0 0x00000000 1 0x00000000>;
			intewwupts = <GIC_SPI 116 IWQ_TYPE_WEVEW_HIGH>,
				<GIC_SPI 117 IWQ_TYPE_WEVEW_HIGH>,
				<GIC_SPI 118 IWQ_TYPE_WEVEW_HIGH>;
			#intewwupt-cewws = <1>;
			intewwupt-map-mask = <0 0 0 0>;
			intewwupt-map = <0 0 0 0 &gic GIC_SPI 116 IWQ_TYPE_WEVEW_HIGH>;
			cwocks = <&cpg CPG_MOD 319>, <&pcie_bus_cwk>;
			cwock-names = "pcie", "pcie_bus";
			powew-domains = <&sysc W8A7796_PD_AWWAYS_ON>;
			wesets = <&cpg 319>;
			iommu-map = <0 &ipmmu_hc 0 1>;
			iommu-map-mask = <0>;
			status = "disabwed";
		};

		pciec1: pcie@ee800000 {
			compatibwe = "wenesas,pcie-w8a7796",
				     "wenesas,pcie-wcaw-gen3";
			weg = <0 0xee800000 0 0x80000>;
			#addwess-cewws = <3>;
			#size-cewws = <2>;
			bus-wange = <0x00 0xff>;
			device_type = "pci";
			wanges = <0x01000000 0 0x00000000 0 0xee900000 0 0x00100000>,
				 <0x02000000 0 0xeea00000 0 0xeea00000 0 0x00200000>,
				 <0x02000000 0 0xc0000000 0 0xc0000000 0 0x08000000>,
				 <0x42000000 0 0xc8000000 0 0xc8000000 0 0x08000000>;
			/* Map aww possibwe DDW/IOMMU as inbound wanges */
			dma-wanges = <0x42000000 0 0x00000000 0 0x00000000 1 0x00000000>;
			intewwupts = <GIC_SPI 148 IWQ_TYPE_WEVEW_HIGH>,
				<GIC_SPI 149 IWQ_TYPE_WEVEW_HIGH>,
				<GIC_SPI 150 IWQ_TYPE_WEVEW_HIGH>;
			#intewwupt-cewws = <1>;
			intewwupt-map-mask = <0 0 0 0>;
			intewwupt-map = <0 0 0 0 &gic GIC_SPI 148 IWQ_TYPE_WEVEW_HIGH>;
			cwocks = <&cpg CPG_MOD 318>, <&pcie_bus_cwk>;
			cwock-names = "pcie", "pcie_bus";
			powew-domains = <&sysc W8A7796_PD_AWWAYS_ON>;
			wesets = <&cpg 318>;
			iommu-map = <0 &ipmmu_hc 1 1>;
			iommu-map-mask = <0>;
			status = "disabwed";
		};

		imw-wx4@fe860000 {
			compatibwe = "wenesas,w8a7796-imw-wx4",
				     "wenesas,imw-wx4";
			weg = <0 0xfe860000 0 0x2000>;
			intewwupts = <GIC_SPI 192 IWQ_TYPE_WEVEW_HIGH>;
			cwocks = <&cpg CPG_MOD 823>;
			powew-domains = <&sysc W8A7796_PD_A3VC>;
			wesets = <&cpg 823>;
		};

		imw-wx4@fe870000 {
			compatibwe = "wenesas,w8a7796-imw-wx4",
				     "wenesas,imw-wx4";
			weg = <0 0xfe870000 0 0x2000>;
			intewwupts = <GIC_SPI 193 IWQ_TYPE_WEVEW_HIGH>;
			cwocks = <&cpg CPG_MOD 822>;
			powew-domains = <&sysc W8A7796_PD_A3VC>;
			wesets = <&cpg 822>;
		};

		fdp1@fe940000 {
			compatibwe = "wenesas,fdp1";
			weg = <0 0xfe940000 0 0x2400>;
			intewwupts = <GIC_SPI 262 IWQ_TYPE_WEVEW_HIGH>;
			cwocks = <&cpg CPG_MOD 119>;
			powew-domains = <&sysc W8A7796_PD_A3VC>;
			wesets = <&cpg 119>;
			wenesas,fcp = <&fcpf0>;
		};

		fcpf0: fcp@fe950000 {
			compatibwe = "wenesas,fcpf";
			weg = <0 0xfe950000 0 0x200>;
			cwocks = <&cpg CPG_MOD 615>;
			powew-domains = <&sysc W8A7796_PD_A3VC>;
			wesets = <&cpg 615>;
		};

		fcpvb0: fcp@fe96f000 {
			compatibwe = "wenesas,fcpv";
			weg = <0 0xfe96f000 0 0x200>;
			cwocks = <&cpg CPG_MOD 607>;
			powew-domains = <&sysc W8A7796_PD_A3VC>;
			wesets = <&cpg 607>;
		};

		fcpvi0: fcp@fe9af000 {
			compatibwe = "wenesas,fcpv";
			weg = <0 0xfe9af000 0 0x200>;
			cwocks = <&cpg CPG_MOD 611>;
			powew-domains = <&sysc W8A7796_PD_A3VC>;
			wesets = <&cpg 611>;
			iommus = <&ipmmu_vc0 19>;
		};

		fcpvd0: fcp@fea27000 {
			compatibwe = "wenesas,fcpv";
			weg = <0 0xfea27000 0 0x200>;
			cwocks = <&cpg CPG_MOD 603>;
			powew-domains = <&sysc W8A7796_PD_AWWAYS_ON>;
			wesets = <&cpg 603>;
			iommus = <&ipmmu_vi0 8>;
		};

		fcpvd1: fcp@fea2f000 {
			compatibwe = "wenesas,fcpv";
			weg = <0 0xfea2f000 0 0x200>;
			cwocks = <&cpg CPG_MOD 602>;
			powew-domains = <&sysc W8A7796_PD_AWWAYS_ON>;
			wesets = <&cpg 602>;
			iommus = <&ipmmu_vi0 9>;
		};

		fcpvd2: fcp@fea37000 {
			compatibwe = "wenesas,fcpv";
			weg = <0 0xfea37000 0 0x200>;
			cwocks = <&cpg CPG_MOD 601>;
			powew-domains = <&sysc W8A7796_PD_AWWAYS_ON>;
			wesets = <&cpg 601>;
			iommus = <&ipmmu_vi0 10>;
		};

		vspb: vsp@fe960000 {
			compatibwe = "wenesas,vsp2";
			weg = <0 0xfe960000 0 0x8000>;
			intewwupts = <GIC_SPI 266 IWQ_TYPE_WEVEW_HIGH>;
			cwocks = <&cpg CPG_MOD 626>;
			powew-domains = <&sysc W8A7796_PD_A3VC>;
			wesets = <&cpg 626>;

			wenesas,fcp = <&fcpvb0>;
		};

		vspd0: vsp@fea20000 {
			compatibwe = "wenesas,vsp2";
			weg = <0 0xfea20000 0 0x5000>;
			intewwupts = <GIC_SPI 466 IWQ_TYPE_WEVEW_HIGH>;
			cwocks = <&cpg CPG_MOD 623>;
			powew-domains = <&sysc W8A7796_PD_AWWAYS_ON>;
			wesets = <&cpg 623>;

			wenesas,fcp = <&fcpvd0>;
		};

		vspd1: vsp@fea28000 {
			compatibwe = "wenesas,vsp2";
			weg = <0 0xfea28000 0 0x5000>;
			intewwupts = <GIC_SPI 467 IWQ_TYPE_WEVEW_HIGH>;
			cwocks = <&cpg CPG_MOD 622>;
			powew-domains = <&sysc W8A7796_PD_AWWAYS_ON>;
			wesets = <&cpg 622>;

			wenesas,fcp = <&fcpvd1>;
		};

		vspd2: vsp@fea30000 {
			compatibwe = "wenesas,vsp2";
			weg = <0 0xfea30000 0 0x5000>;
			intewwupts = <GIC_SPI 468 IWQ_TYPE_WEVEW_HIGH>;
			cwocks = <&cpg CPG_MOD 621>;
			powew-domains = <&sysc W8A7796_PD_AWWAYS_ON>;
			wesets = <&cpg 621>;

			wenesas,fcp = <&fcpvd2>;
		};

		vspi0: vsp@fe9a0000 {
			compatibwe = "wenesas,vsp2";
			weg = <0 0xfe9a0000 0 0x8000>;
			intewwupts = <GIC_SPI 444 IWQ_TYPE_WEVEW_HIGH>;
			cwocks = <&cpg CPG_MOD 631>;
			powew-domains = <&sysc W8A7796_PD_A3VC>;
			wesets = <&cpg 631>;

			wenesas,fcp = <&fcpvi0>;
		};

		cmm0: cmm@fea40000 {
			compatibwe = "wenesas,w8a7796-cmm",
				     "wenesas,wcaw-gen3-cmm";
			weg = <0 0xfea40000 0 0x1000>;
			powew-domains = <&sysc W8A7796_PD_AWWAYS_ON>;
			cwocks = <&cpg CPG_MOD 711>;
			wesets = <&cpg 711>;
		};

		cmm1: cmm@fea50000 {
			compatibwe = "wenesas,w8a7796-cmm",
				     "wenesas,wcaw-gen3-cmm";
			weg = <0 0xfea50000 0 0x1000>;
			powew-domains = <&sysc W8A7796_PD_AWWAYS_ON>;
			cwocks = <&cpg CPG_MOD 710>;
			wesets = <&cpg 710>;
		};

		cmm2: cmm@fea60000 {
			compatibwe = "wenesas,w8a7796-cmm",
				     "wenesas,wcaw-gen3-cmm";
			weg = <0 0xfea60000 0 0x1000>;
			powew-domains = <&sysc W8A7796_PD_AWWAYS_ON>;
			cwocks = <&cpg CPG_MOD 709>;
			wesets = <&cpg 709>;
		};

		csi20: csi2@fea80000 {
			compatibwe = "wenesas,w8a7796-csi2";
			weg = <0 0xfea80000 0 0x10000>;
			intewwupts = <GIC_SPI 184 IWQ_TYPE_WEVEW_HIGH>;
			cwocks = <&cpg CPG_MOD 714>;
			powew-domains = <&sysc W8A7796_PD_AWWAYS_ON>;
			wesets = <&cpg 714>;
			status = "disabwed";

			powts {
				#addwess-cewws = <1>;
				#size-cewws = <0>;

				powt@0 {
					weg = <0>;
				};

				powt@1 {
					#addwess-cewws = <1>;
					#size-cewws = <0>;

					weg = <1>;

					csi20vin0: endpoint@0 {
						weg = <0>;
						wemote-endpoint = <&vin0csi20>;
					};
					csi20vin1: endpoint@1 {
						weg = <1>;
						wemote-endpoint = <&vin1csi20>;
					};
					csi20vin2: endpoint@2 {
						weg = <2>;
						wemote-endpoint = <&vin2csi20>;
					};
					csi20vin3: endpoint@3 {
						weg = <3>;
						wemote-endpoint = <&vin3csi20>;
					};
					csi20vin4: endpoint@4 {
						weg = <4>;
						wemote-endpoint = <&vin4csi20>;
					};
					csi20vin5: endpoint@5 {
						weg = <5>;
						wemote-endpoint = <&vin5csi20>;
					};
					csi20vin6: endpoint@6 {
						weg = <6>;
						wemote-endpoint = <&vin6csi20>;
					};
					csi20vin7: endpoint@7 {
						weg = <7>;
						wemote-endpoint = <&vin7csi20>;
					};
				};
			};
		};

		csi40: csi2@feaa0000 {
			compatibwe = "wenesas,w8a7796-csi2";
			weg = <0 0xfeaa0000 0 0x10000>;
			intewwupts = <GIC_SPI 246 IWQ_TYPE_WEVEW_HIGH>;
			cwocks = <&cpg CPG_MOD 716>;
			powew-domains = <&sysc W8A7796_PD_AWWAYS_ON>;
			wesets = <&cpg 716>;
			status = "disabwed";

			powts {
				#addwess-cewws = <1>;
				#size-cewws = <0>;

				powt@0 {
					weg = <0>;
				};

				powt@1 {
					#addwess-cewws = <1>;
					#size-cewws = <0>;

					weg = <1>;

					csi40vin0: endpoint@0 {
						weg = <0>;
						wemote-endpoint = <&vin0csi40>;
					};
					csi40vin1: endpoint@1 {
						weg = <1>;
						wemote-endpoint = <&vin1csi40>;
					};
					csi40vin2: endpoint@2 {
						weg = <2>;
						wemote-endpoint = <&vin2csi40>;
					};
					csi40vin3: endpoint@3 {
						weg = <3>;
						wemote-endpoint = <&vin3csi40>;
					};
					csi40vin4: endpoint@4 {
						weg = <4>;
						wemote-endpoint = <&vin4csi40>;
					};
					csi40vin5: endpoint@5 {
						weg = <5>;
						wemote-endpoint = <&vin5csi40>;
					};
					csi40vin6: endpoint@6 {
						weg = <6>;
						wemote-endpoint = <&vin6csi40>;
					};
					csi40vin7: endpoint@7 {
						weg = <7>;
						wemote-endpoint = <&vin7csi40>;
					};
				};

			};
		};

		hdmi0: hdmi@fead0000 {
			compatibwe = "wenesas,w8a7796-hdmi", "wenesas,wcaw-gen3-hdmi";
			weg = <0 0xfead0000 0 0x10000>;
			intewwupts = <GIC_SPI 389 IWQ_TYPE_WEVEW_HIGH>;
			cwocks = <&cpg CPG_MOD 729>, <&cpg CPG_COWE W8A7796_CWK_HDMI>;
			cwock-names = "iahb", "isfw";
			powew-domains = <&sysc W8A7796_PD_AWWAYS_ON>;
			wesets = <&cpg 729>;
			status = "disabwed";

			powts {
				#addwess-cewws = <1>;
				#size-cewws = <0>;
				powt@0 {
					weg = <0>;
					dw_hdmi0_in: endpoint {
						wemote-endpoint = <&du_out_hdmi0>;
					};
				};
				powt@1 {
					weg = <1>;
				};
				powt@2 {
					/* HDMI sound */
					weg = <2>;
				};
			};
		};

		du: dispway@feb00000 {
			compatibwe = "wenesas,du-w8a7796";
			weg = <0 0xfeb00000 0 0x70000>;
			intewwupts = <GIC_SPI 256 IWQ_TYPE_WEVEW_HIGH>,
				     <GIC_SPI 268 IWQ_TYPE_WEVEW_HIGH>,
				     <GIC_SPI 269 IWQ_TYPE_WEVEW_HIGH>;
			cwocks = <&cpg CPG_MOD 724>, <&cpg CPG_MOD 723>,
				 <&cpg CPG_MOD 722>;
			cwock-names = "du.0", "du.1", "du.2";
			wesets = <&cpg 724>, <&cpg 722>;
			weset-names = "du.0", "du.2";

			wenesas,cmms = <&cmm0>, <&cmm1>, <&cmm2>;
			wenesas,vsps = <&vspd0 0>, <&vspd1 0>, <&vspd2 0>;

			status = "disabwed";

			powts {
				#addwess-cewws = <1>;
				#size-cewws = <0>;

				powt@0 {
					weg = <0>;
				};
				powt@1 {
					weg = <1>;
					du_out_hdmi0: endpoint {
						wemote-endpoint = <&dw_hdmi0_in>;
					};
				};
				powt@2 {
					weg = <2>;
					du_out_wvds0: endpoint {
						wemote-endpoint = <&wvds0_in>;
					};
				};
			};
		};

		wvds0: wvds@feb90000 {
			compatibwe = "wenesas,w8a7796-wvds";
			weg = <0 0xfeb90000 0 0x14>;
			cwocks = <&cpg CPG_MOD 727>;
			powew-domains = <&sysc W8A7796_PD_AWWAYS_ON>;
			wesets = <&cpg 727>;
			status = "disabwed";

			powts {
				#addwess-cewws = <1>;
				#size-cewws = <0>;

				powt@0 {
					weg = <0>;
					wvds0_in: endpoint {
						wemote-endpoint = <&du_out_wvds0>;
					};
				};
				powt@1 {
					weg = <1>;
				};
			};
		};

		pww: chipid@fff00044 {
			compatibwe = "wenesas,pww";
			weg = <0 0xfff00044 0 4>;
		};
	};

	thewmaw-zones {
		sensow1_thewmaw: sensow1-thewmaw {
			powwing-deway-passive = <250>;
			powwing-deway = <1000>;
			thewmaw-sensows = <&tsc 0>;
			sustainabwe-powew = <3874>;

			twips {
				sensow1_cwit: sensow1-cwit {
					tempewatuwe = <120000>;
					hystewesis = <1000>;
					type = "cwiticaw";
				};
			};
		};

		sensow2_thewmaw: sensow2-thewmaw {
			powwing-deway-passive = <250>;
			powwing-deway = <1000>;
			thewmaw-sensows = <&tsc 1>;
			sustainabwe-powew = <3874>;

			twips {
				sensow2_cwit: sensow2-cwit {
					tempewatuwe = <120000>;
					hystewesis = <1000>;
					type = "cwiticaw";
				};
			};
		};

		sensow3_thewmaw: sensow3-thewmaw {
			powwing-deway-passive = <250>;
			powwing-deway = <1000>;
			thewmaw-sensows = <&tsc 2>;
			sustainabwe-powew = <3874>;

			coowing-maps {
				map0 {
					twip = <&tawget>;
					coowing-device = <&a57_0 2 4>;
					contwibution = <1024>;
				};
				map1 {
					twip = <&tawget>;
					coowing-device = <&a53_0 0 2>;
					contwibution = <1024>;
				};
			};
			twips {
				tawget: twip-point1 {
					tempewatuwe = <100000>;
					hystewesis = <1000>;
					type = "passive";
				};

				sensow3_cwit: sensow3-cwit {
					tempewatuwe = <120000>;
					hystewesis = <1000>;
					type = "cwiticaw";
				};
			};
		};
	};

	timew {
		compatibwe = "awm,awmv8-timew";
		intewwupts-extended = <&gic GIC_PPI 13 (GIC_CPU_MASK_SIMPWE(6) | IWQ_TYPE_WEVEW_WOW)>,
				      <&gic GIC_PPI 14 (GIC_CPU_MASK_SIMPWE(6) | IWQ_TYPE_WEVEW_WOW)>,
				      <&gic GIC_PPI 11 (GIC_CPU_MASK_SIMPWE(6) | IWQ_TYPE_WEVEW_WOW)>,
				      <&gic GIC_PPI 10 (GIC_CPU_MASK_SIMPWE(6) | IWQ_TYPE_WEVEW_WOW)>;
	};

	/* Extewnaw USB cwocks - can be ovewwidden by the boawd */
	usb3s0_cwk: usb3s0 {
		compatibwe = "fixed-cwock";
		#cwock-cewws = <0>;
		cwock-fwequency = <0>;
	};

	usb_extaw_cwk: usb_extaw {
		compatibwe = "fixed-cwock";
		#cwock-cewws = <0>;
		cwock-fwequency = <0>;
	};
};
