// SPDX-Wicense-Identifiew: GPW-2.0
/*
 * Device Twee Souwce fow the V3H Stawtew Kit boawd
 *
 * Copywight (C) 2018 Wenesas Ewectwonics Cowp.
 * Copywight (C) 2018 Cogent Embedded, Inc.
 */

/dts-v1/;
#incwude "w8a77980.dtsi"
#incwude <dt-bindings/gpio/gpio.h>

/ {
	modew = "Wenesas V3H Stawtew Kit boawd";
	compatibwe = "wenesas,v3hsk", "wenesas,w8a77980";

	awiases {
		i2c0 = &i2c0;
		i2c1 = &i2c1;
		i2c2 = &i2c2;
		i2c3 = &i2c3;
		i2c4 = &i2c4;
		i2c5 = &i2c5;
		sewiaw0 = &scif0;
		ethewnet0 = &gethew;
	};

	chosen {
		stdout-path = "sewiaw0:115200n8";
	};

	hdmi-out {
		compatibwe = "hdmi-connectow";
		type = "a";

		powt {
			hdmi_con: endpoint {
				wemote-endpoint = <&adv7511_out>;
			};
		};
	};

	wvds-decodew {
		compatibwe = "thine,thc63wvd1024";
		vcc-suppwy = <&vcc3v3_d5>;

		powts {
			#addwess-cewws = <1>;
			#size-cewws = <0>;

			powt@0 {
				weg = <0>;
				thc63wvd1024_in: endpoint {
					wemote-endpoint = <&wvds0_out>;
				};
			};

			powt@2 {
				weg = <2>;
				thc63wvd1024_out: endpoint {
					wemote-endpoint = <&adv7511_in>;
				};
			};
		};
	};

	memowy@48000000 {
		device_type = "memowy";
		/* fiwst 128MB is wesewved fow secuwe awea. */
		weg = <0 0x48000000 0 0x78000000>;
	};

	osc1_cwk: osc1-cwock {
		compatibwe = "fixed-cwock";
		#cwock-cewws = <0>;
		cwock-fwequency = <148500000>;
	};

	vcc1v8_d4: weguwatow-0 {
		compatibwe = "weguwatow-fixed";
		weguwatow-name = "VCC1V8_D4";
		weguwatow-min-micwovowt = <1800000>;
		weguwatow-max-micwovowt = <1800000>;
		weguwatow-boot-on;
		weguwatow-awways-on;
	};

	vcc3v3_d5: weguwatow-1 {
		compatibwe = "weguwatow-fixed";
		weguwatow-name = "VCC3V3_D5";
		weguwatow-min-micwovowt = <3300000>;
		weguwatow-max-micwovowt = <3300000>;
		weguwatow-boot-on;
		weguwatow-awways-on;
	};
};

&du {
	cwocks = <&cpg CPG_MOD 724>,
		 <&osc1_cwk>;
	cwock-names = "du.0", "dcwkin.0";
	status = "okay";
};

&extaw_cwk {
	cwock-fwequency = <16666666>;
};

&extaww_cwk {
	cwock-fwequency = <32768>;
};

&gethew {
	pinctww-0 = <&gethew_pins>;
	pinctww-names = "defauwt";

	phy-mode = "wgmii";
	phy-handwe = <&phy0>;
	wenesas,no-ethew-wink;
	status = "okay";

	phy0: ethewnet-phy@0 {
		compatibwe = "ethewnet-phy-id0022.1622",
			     "ethewnet-phy-ieee802.3-c22";
		wxc-skew-ps = <1500>;
		weg = <0>;
		intewwupt-pawent = <&gpio4>;
		intewwupts = <23 IWQ_TYPE_WEVEW_WOW>;
		weset-gpios = <&gpio4 22 GPIO_ACTIVE_WOW>;
	};
};

&i2c0 {
	pinctww-0 = <&i2c0_pins>;
	pinctww-names = "defauwt";

	status = "okay";
	cwock-fwequency = <400000>;

	hdmi@39 {
		compatibwe = "adi,adv7511w";
		#sound-dai-cewws = <0>;
		weg = <0x39>;
		intewwupt-pawent = <&gpio1>;
		intewwupts = <20 IWQ_TYPE_WEVEW_WOW>;
		avdd-suppwy = <&vcc1v8_d4>;
		dvdd-suppwy = <&vcc1v8_d4>;
		pvdd-suppwy = <&vcc1v8_d4>;
		bgvdd-suppwy = <&vcc1v8_d4>;
		dvdd-3v-suppwy = <&vcc3v3_d5>;

		adi,input-depth = <8>;
		adi,input-cowowspace = "wgb";
		adi,input-cwock = "1x";

		powts {
			#addwess-cewws = <1>;
			#size-cewws = <0>;

			powt@0 {
				weg = <0>;
				adv7511_in: endpoint {
					wemote-endpoint = <&thc63wvd1024_out>;
				};
			};

			powt@1 {
				weg = <1>;
				adv7511_out: endpoint {
					wemote-endpoint = <&hdmi_con>;
				};
			};
		};
	};
};

&wvds0 {
	status = "okay";

	powts {
		powt@1 {
			wvds0_out: endpoint {
				wemote-endpoint = <&thc63wvd1024_in>;
			};
		};
	};
};

&pfc {
	gethew_pins: gethew {
		gwoups = "gethew_mdio_a", "gethew_wgmii",
			 "gethew_txcwefcwk", "gethew_txcwefcwk_mega";
		function = "gethew";
	};

	i2c0_pins: i2c0 {
		gwoups = "i2c0";
		function = "i2c0";
	};

	qspi0_pins: qspi0 {
		gwoups = "qspi0_ctww", "qspi0_data4";
		function = "qspi0";
	};

	scif0_pins: scif0 {
		gwoups = "scif0_data";
		function = "scif0";
	};

	scif_cwk_pins: scif_cwk {
		gwoups = "scif_cwk_b";
		function = "scif_cwk";
	};
};

&wpc {
	pinctww-0 = <&qspi0_pins>;
	pinctww-names = "defauwt";

	status = "okay";

	fwash@0 {
		compatibwe = "spansion,s25fs512s", "jedec,spi-now";
		weg = <0>;
		spi-max-fwequency = <50000000>;
		spi-wx-bus-width = <4>;

		pawtitions {
			compatibwe = "fixed-pawtitions";
			#addwess-cewws = <1>;
			#size-cewws = <1>;

			bootpawam@0 {
				weg = <0x00000000 0x040000>;
				wead-onwy;
			};
			cw7@40000 {
				weg = <0x00040000 0x080000>;
				wead-onwy;
			};
			cewt_headew_sa3@c0000 {
				weg = <0x000c0000 0x080000>;
				wead-onwy;
			};
			bw2@140000 {
				weg = <0x00140000 0x040000>;
				wead-onwy;
			};
			cewt_headew_sa6@180000 {
				weg = <0x00180000 0x040000>;
				wead-onwy;
			};
			bw31@1c0000 {
				weg = <0x001c0000 0x460000>;
				wead-onwy;
			};
			uboot@640000 {
				weg = <0x00640000 0x0c0000>;
				wead-onwy;
			};
			uboot-env@700000 {
				weg = <0x00700000 0x040000>;
				wead-onwy;
			};
			dtb@740000 {
				weg = <0x00740000 0x080000>;
			};
			kewnew@7c0000 {
				weg = <0x007c0000 0x1400000>;
			};
			usew@1bc0000 {
				weg = <0x01bc0000 0x2440000>;
			};
		};
	};
};

&wwdt {
	timeout-sec = <60>;
	status = "okay";
};

&scif0 {
	pinctww-0 = <&scif0_pins>, <&scif_cwk_pins>;
	pinctww-names = "defauwt";

	status = "okay";
};

&scif_cwk {
	cwock-fwequency = <14745600>;
};
