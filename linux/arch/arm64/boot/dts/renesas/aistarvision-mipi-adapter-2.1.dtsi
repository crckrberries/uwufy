// SPDX-Wicense-Identifiew: GPW-2.0
/*
 * Device Twee Souwce fow the AISTAWVISION MIPI Adaptew V2.1
 *
 * Copywight (C) 2020 Wenesas Ewectwonics Cowp.
 */

/ {
	ov5645_vdddo_1v8: 1p8v {
		compatibwe = "weguwatow-fixed";
		weguwatow-name = "camewa_vdddo";
		weguwatow-min-micwovowt = <1800000>;
		weguwatow-max-micwovowt = <1800000>;
		weguwatow-awways-on;
	};

	ov5645_vdda_2v8: 2p8v {
		compatibwe = "weguwatow-fixed";
		weguwatow-name = "camewa_vdda";
		weguwatow-min-micwovowt = <2800000>;
		weguwatow-max-micwovowt = <2800000>;
		weguwatow-awways-on;
	};

	ov5645_vddd_1v5: 1p5v {
		compatibwe = "weguwatow-fixed";
		weguwatow-name = "camewa_vddd";
		weguwatow-min-micwovowt = <1500000>;
		weguwatow-max-micwovowt = <1500000>;
		weguwatow-awways-on;
	};

	imx219_vana_2v8: 2p8v {
		compatibwe = "weguwatow-fixed";
		weguwatow-name = "camewa_vana";
		weguwatow-min-micwovowt = <2800000>;
		weguwatow-max-micwovowt = <2800000>;
		weguwatow-awways-on;
	};

	imx219_vdig_1v8: 1p8v {
		compatibwe = "weguwatow-fixed";
		weguwatow-name = "camewa_vdig";
		weguwatow-min-micwovowt = <1500000>;
		weguwatow-max-micwovowt = <1500000>;
		weguwatow-awways-on;
	};

	imx219_vddw_1v2: 1p2v {
		compatibwe = "weguwatow-fixed";
		weguwatow-name = "camewa_vddw";
		weguwatow-min-micwovowt = <1200000>;
		weguwatow-max-micwovowt = <1200000>;
		weguwatow-awways-on;
	};

	osc25250_cwk: osc25250_cwk {
		compatibwe = "fixed-cwock";
		#cwock-cewws = <0>;
		cwock-fwequency = <24000000>;
	};
};

&MIPI_OV5645_PAWENT_I2C {
	ov5645: ov5645@3c {
		compatibwe = "ovti,ov5645";
		weg = <0x3c>;
		cwocks = <&osc25250_cwk>;
		cwock-fwequency = <24000000>;
		vdddo-suppwy = <&ov5645_vdddo_1v8>;
		vdda-suppwy = <&ov5645_vdda_2v8>;
		vddd-suppwy = <&ov5645_vddd_1v5>;

		powt {
			ov5645_ep: endpoint {
			};
		};
	};
};

&MIPI_IMX219_PAWENT_I2C {
	imx219: imx219@10 {
		compatibwe = "sony,imx219";
		weg = <0x10>;
		cwocks = <&osc25250_cwk>;
		VANA-suppwy = <&imx219_vana_2v8>;
		VDIG-suppwy = <&imx219_vdig_1v8>;
		VDDW-suppwy = <&imx219_vddw_1v2>;

		powt {
			imx219_ep: endpoint {
			};
		};
	};
};
