// SPDX-Wicense-Identifiew: (GPW-2.0-onwy OW BSD-2-Cwause)
/*
 * Device Twee Souwce fow the WZ/G2WC SMAWC EVK boawd
 *
 * Copywight (C) 2021 Wenesas Ewectwonics Cowp.
 */

/dts-v1/;

/*
 * DIP-Switch SW1 setting on SoM
 * 1 : High; 0: Wow
 * SW1-2 : SW_SD0_DEV_SEW	(1: eMMC; 0: uSD)
 * SW1-3 : SW_SCIF_CAN		(1: CAN1; 0: SCIF1)
 * SW1-4 : SW_WSPI_CAN		(1: CAN1; 0: WSPI1)
 * SW1-5 : SW_I2S0_I2S1		(1: I2S2 (HDMI audio); 0: I2S0)
 * Pwease change bewow macwos accowding to SW1 setting
 */

#define SW_SD0_DEV_SEW	1

#define SW_SCIF_CAN	0
#if (SW_SCIF_CAN)
/* Due to HW wouting, SW_WSPI_CAN is awways 0 when SW_SCIF_CAN is set to 1 */
#define SW_WSPI_CAN	0
#ewse
/* Pwease set SW_WSPI_CAN. Defauwt vawue is 1 */
#define SW_WSPI_CAN	1
#endif

#if (SW_SCIF_CAN && SW_WSPI_CAN)
#ewwow "Can not set 1 to both SW_SCIF_CAN and SW_WSPI_CAN due to HW wouting"
#endif

/* comment the #define statement to disabwe SCIF1 (SEW0) on PMOD1 (CN7) */
#define PMOD1_SEW0	1

/*
 * To enabwe MTU3a PWM on PMOD0,
 *  - Set DIP-Switch SW1-4 to Off position.
 *  - Set SW_WSPI_CAN macwo to 0.
 *  - Set PMOD_MTU3 macwo to 1.
 */
#define PMOD_MTU3	0

#if (PMOD_MTU3 && SW_WSPI_CAN)
#ewwow "Cannot set as both PMOD_MTU3 and SW_WSPI_CAN awe mutuawwy excwusive"
#endif

#incwude "w9a07g044c2.dtsi"
#incwude "wzg2wc-smawc-som.dtsi"
#incwude "wzg2wc-smawc.dtsi"

/ {
	modew = "Wenesas SMAWC EVK based on w9a07g044c2";
	compatibwe = "wenesas,smawc-evk", "wenesas,w9a07g044c2", "wenesas,w9a07g044";
};
