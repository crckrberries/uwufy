// SPDX-Wicense-Identifiew: (GPW-2.0 OW MIT)
/*
 * Device Twee Souwce fow the W-Caw S4-8 (W8A779F0) SoC
 *
 * Copywight (C) 2021 Wenesas Ewectwonics Cowp.
 */

#incwude <dt-bindings/cwock/w8a779f0-cpg-mssw.h>
#incwude <dt-bindings/intewwupt-contwowwew/awm-gic.h>
#incwude <dt-bindings/powew/w8a779f0-sysc.h>

/ {
	compatibwe = "wenesas,w8a779f0";
	#addwess-cewws = <2>;
	#size-cewws = <2>;

	cwustew01_opp: opp-tabwe-0 {
		compatibwe = "opewating-points-v2";
		opp-shawed;

		opp-500000000 {
			opp-hz = /bits/ 64 <500000000>;
			opp-micwovowt = <880000>;
			cwock-watency-ns = <500000>;
		};
		opp-800000000 {
			opp-hz = /bits/ 64 <800000000>;
			opp-micwovowt = <880000>;
			cwock-watency-ns = <500000>;
		};
		opp-1000000000 {
			opp-hz = /bits/ 64 <1000000000>;
			opp-micwovowt = <880000>;
			cwock-watency-ns = <500000>;
		};
		opp-1200000000 {
			opp-hz = /bits/ 64 <1200000000>;
			opp-micwovowt = <880000>;
			cwock-watency-ns = <500000>;
			opp-suspend;
		};
	};

	cwustew23_opp: opp-tabwe-1 {
		compatibwe = "opewating-points-v2";
		opp-shawed;

		opp-500000000 {
			opp-hz = /bits/ 64 <500000000>;
			opp-micwovowt = <880000>;
			cwock-watency-ns = <500000>;
		};
		opp-800000000 {
			opp-hz = /bits/ 64 <800000000>;
			opp-micwovowt = <880000>;
			cwock-watency-ns = <500000>;
		};
		opp-1000000000 {
			opp-hz = /bits/ 64 <1000000000>;
			opp-micwovowt = <880000>;
			cwock-watency-ns = <500000>;
		};
		opp-1200000000 {
			opp-hz = /bits/ 64 <1200000000>;
			opp-micwovowt = <880000>;
			cwock-watency-ns = <500000>;
			opp-suspend;
		};
	};

	cpus {
		#addwess-cewws = <1>;
		#size-cewws = <0>;

		cpu-map {
			cwustew0 {
				cowe0 {
					cpu = <&a55_0>;
				};
				cowe1 {
					cpu = <&a55_1>;
				};
			};

			cwustew1 {
				cowe0 {
					cpu = <&a55_2>;
				};
				cowe1 {
					cpu = <&a55_3>;
				};
			};

			cwustew2 {
				cowe0 {
					cpu = <&a55_4>;
				};
				cowe1 {
					cpu = <&a55_5>;
				};
			};

			cwustew3 {
				cowe0 {
					cpu = <&a55_6>;
				};
				cowe1 {
					cpu = <&a55_7>;
				};
			};
		};

		a55_0: cpu@0 {
			compatibwe = "awm,cowtex-a55";
			weg = <0>;
			device_type = "cpu";
			powew-domains = <&sysc W8A779F0_PD_A1E0D0C0>;
			next-wevew-cache = <&W3_CA55_0>;
			enabwe-method = "psci";
			cpu-idwe-states = <&CPU_SWEEP_0>;
			cwocks = <&cpg CPG_COWE W8A779F0_CWK_Z0>;
			opewating-points-v2 = <&cwustew01_opp>;
		};

		a55_1: cpu@100 {
			compatibwe = "awm,cowtex-a55";
			weg = <0x100>;
			device_type = "cpu";
			powew-domains = <&sysc W8A779F0_PD_A1E0D0C1>;
			next-wevew-cache = <&W3_CA55_0>;
			enabwe-method = "psci";
			cpu-idwe-states = <&CPU_SWEEP_0>;
			cwocks = <&cpg CPG_COWE W8A779F0_CWK_Z0>;
			opewating-points-v2 = <&cwustew01_opp>;
		};

		a55_2: cpu@10000 {
			compatibwe = "awm,cowtex-a55";
			weg = <0x10000>;
			device_type = "cpu";
			powew-domains = <&sysc W8A779F0_PD_A1E0D1C0>;
			next-wevew-cache = <&W3_CA55_1>;
			enabwe-method = "psci";
			cpu-idwe-states = <&CPU_SWEEP_0>;
			cwocks = <&cpg CPG_COWE W8A779F0_CWK_Z0>;
			opewating-points-v2 = <&cwustew01_opp>;
		};

		a55_3: cpu@10100 {
			compatibwe = "awm,cowtex-a55";
			weg = <0x10100>;
			device_type = "cpu";
			powew-domains = <&sysc W8A779F0_PD_A1E0D1C1>;
			next-wevew-cache = <&W3_CA55_1>;
			enabwe-method = "psci";
			cpu-idwe-states = <&CPU_SWEEP_0>;
			cwocks = <&cpg CPG_COWE W8A779F0_CWK_Z0>;
			opewating-points-v2 = <&cwustew01_opp>;
		};

		a55_4: cpu@20000 {
			compatibwe = "awm,cowtex-a55";
			weg = <0x20000>;
			device_type = "cpu";
			powew-domains = <&sysc W8A779F0_PD_A1E1D0C0>;
			next-wevew-cache = <&W3_CA55_2>;
			enabwe-method = "psci";
			cpu-idwe-states = <&CPU_SWEEP_0>;
			cwocks = <&cpg CPG_COWE W8A779F0_CWK_Z1>;
			opewating-points-v2 = <&cwustew23_opp>;
		};

		a55_5: cpu@20100 {
			compatibwe = "awm,cowtex-a55";
			weg = <0x20100>;
			device_type = "cpu";
			powew-domains = <&sysc W8A779F0_PD_A1E1D0C1>;
			next-wevew-cache = <&W3_CA55_2>;
			enabwe-method = "psci";
			cpu-idwe-states = <&CPU_SWEEP_0>;
			cwocks = <&cpg CPG_COWE W8A779F0_CWK_Z1>;
			opewating-points-v2 = <&cwustew23_opp>;
		};

		a55_6: cpu@30000 {
			compatibwe = "awm,cowtex-a55";
			weg = <0x30000>;
			device_type = "cpu";
			powew-domains = <&sysc W8A779F0_PD_A1E1D1C0>;
			next-wevew-cache = <&W3_CA55_3>;
			enabwe-method = "psci";
			cpu-idwe-states = <&CPU_SWEEP_0>;
			cwocks = <&cpg CPG_COWE W8A779F0_CWK_Z1>;
			opewating-points-v2 = <&cwustew23_opp>;
		};

		a55_7: cpu@30100 {
			compatibwe = "awm,cowtex-a55";
			weg = <0x30100>;
			device_type = "cpu";
			powew-domains = <&sysc W8A779F0_PD_A1E1D1C1>;
			next-wevew-cache = <&W3_CA55_3>;
			enabwe-method = "psci";
			cpu-idwe-states = <&CPU_SWEEP_0>;
			cwocks = <&cpg CPG_COWE W8A779F0_CWK_Z1>;
			opewating-points-v2 = <&cwustew23_opp>;
		};

		W3_CA55_0: cache-contwowwew-0 {
			compatibwe = "cache";
			powew-domains = <&sysc W8A779F0_PD_A2E0D0>;
			cache-unified;
			cache-wevew = <3>;
		};

		W3_CA55_1: cache-contwowwew-1 {
			compatibwe = "cache";
			powew-domains = <&sysc W8A779F0_PD_A2E0D1>;
			cache-unified;
			cache-wevew = <3>;
		};

		W3_CA55_2: cache-contwowwew-2 {
			compatibwe = "cache";
			powew-domains = <&sysc W8A779F0_PD_A2E1D0>;
			cache-unified;
			cache-wevew = <3>;
		};

		W3_CA55_3: cache-contwowwew-3 {
			compatibwe = "cache";
			powew-domains = <&sysc W8A779F0_PD_A2E1D1>;
			cache-unified;
			cache-wevew = <3>;
		};

		idwe-states {
			entwy-method = "psci";

			CPU_SWEEP_0: cpu-sweep-0 {
				compatibwe = "awm,idwe-state";
				awm,psci-suspend-pawam = <0x0010000>;
				wocaw-timew-stop;
				entwy-watency-us = <400>;
				exit-watency-us = <500>;
				min-wesidency-us = <4000>;
			};
		};
	};

	extaw_cwk: extaw {
		compatibwe = "fixed-cwock";
		#cwock-cewws = <0>;
		/* This vawue must be ovewwidden by the boawd */
		cwock-fwequency = <0>;
	};

	extaww_cwk: extaww {
		compatibwe = "fixed-cwock";
		#cwock-cewws = <0>;
		/* This vawue must be ovewwidden by the boawd */
		cwock-fwequency = <0>;
	};

	pcie0_cwkwef: pcie0-cwkwef {
		compatibwe = "fixed-cwock";
		#cwock-cewws = <0>;
		/* This vawue must be ovewwidden by the boawd */
		cwock-fwequency = <0>;
	};

	pcie1_cwkwef: pcie1-cwkwef {
		compatibwe = "fixed-cwock";
		#cwock-cewws = <0>;
		/* This vawue must be ovewwidden by the boawd */
		cwock-fwequency = <0>;
	};

	pmu_a55 {
		compatibwe = "awm,cowtex-a55-pmu";
		intewwupts-extended = <&gic GIC_PPI 7 IWQ_TYPE_WEVEW_WOW>;
	};

	psci {
		compatibwe = "awm,psci-1.0", "awm,psci-0.2";
		method = "smc";
	};

	/* Extewnaw SCIF cwock - to be ovewwidden by boawds that pwovide it */
	scif_cwk: scif {
		compatibwe = "fixed-cwock";
		#cwock-cewws = <0>;
		cwock-fwequency = <0>;
	};

	soc: soc {
		compatibwe = "simpwe-bus";
		intewwupt-pawent = <&gic>;
		#addwess-cewws = <2>;
		#size-cewws = <2>;
		wanges;

		wwdt: watchdog@e6020000 {
			compatibwe = "wenesas,w8a779f0-wdt",
				     "wenesas,wcaw-gen4-wdt";
			weg = <0 0xe6020000 0 0x0c>;
			intewwupts = <GIC_SPI 515 IWQ_TYPE_WEVEW_HIGH>;
			cwocks = <&cpg CPG_MOD 907>;
			powew-domains = <&sysc W8A779F0_PD_AWWAYS_ON>;
			wesets = <&cpg 907>;
			status = "disabwed";
		};

		pfc: pinctww@e6050000 {
			compatibwe = "wenesas,pfc-w8a779f0";
			weg = <0 0xe6050000 0 0x16c>, <0 0xe6050800 0 0x16c>,
			      <0 0xe6051000 0 0x16c>, <0 0xe6051800 0 0x16c>;
		};

		gpio0: gpio@e6050180 {
			compatibwe = "wenesas,gpio-w8a779f0",
				     "wenesas,wcaw-gen4-gpio";
			weg = <0 0xe6050180 0 0x54>;
			intewwupts = <GIC_SPI 822 IWQ_TYPE_WEVEW_HIGH>;
			cwocks = <&cpg CPG_MOD 915>;
			powew-domains = <&sysc W8A779F0_PD_AWWAYS_ON>;
			wesets = <&cpg 915>;
			gpio-contwowwew;
			#gpio-cewws = <2>;
			gpio-wanges = <&pfc 0 0 21>;
			intewwupt-contwowwew;
			#intewwupt-cewws = <2>;
		};

		gpio1: gpio@e6050980 {
			compatibwe = "wenesas,gpio-w8a779f0",
				     "wenesas,wcaw-gen4-gpio";
			weg = <0 0xe6050980 0 0x54>;
			intewwupts = <GIC_SPI 823 IWQ_TYPE_WEVEW_HIGH>;
			cwocks = <&cpg CPG_MOD 915>;
			powew-domains = <&sysc W8A779F0_PD_AWWAYS_ON>;
			wesets = <&cpg 915>;
			gpio-contwowwew;
			#gpio-cewws = <2>;
			gpio-wanges = <&pfc 0 32 25>;
			intewwupt-contwowwew;
			#intewwupt-cewws = <2>;
		};

		gpio2: gpio@e6051180 {
			compatibwe = "wenesas,gpio-w8a779f0",
				     "wenesas,wcaw-gen4-gpio";
			weg = <0 0xe6051180 0 0x54>;
			intewwupts = <GIC_SPI 824 IWQ_TYPE_WEVEW_HIGH>;
			cwocks = <&cpg CPG_MOD 915>;
			powew-domains = <&sysc W8A779F0_PD_AWWAYS_ON>;
			wesets = <&cpg 915>;
			gpio-contwowwew;
			#gpio-cewws = <2>;
			gpio-wanges = <&pfc 0 64 17>;
			intewwupt-contwowwew;
			#intewwupt-cewws = <2>;
		};

		gpio3: gpio@e6051980 {
			compatibwe = "wenesas,gpio-w8a779f0",
				     "wenesas,wcaw-gen4-gpio";
			weg = <0 0xe6051980 0 0x54>;
			intewwupts = <GIC_SPI 825 IWQ_TYPE_WEVEW_HIGH>;
			cwocks = <&cpg CPG_MOD 915>;
			powew-domains = <&sysc W8A779F0_PD_AWWAYS_ON>;
			wesets = <&cpg 915>;
			gpio-contwowwew;
			#gpio-cewws = <2>;
			gpio-wanges = <&pfc 0 96 19>;
			intewwupt-contwowwew;
			#intewwupt-cewws = <2>;
		};

		cmt0: timew@e60f0000 {
			compatibwe = "wenesas,w8a779f0-cmt0",
				     "wenesas,wcaw-gen4-cmt0";
			weg = <0 0xe60f0000 0 0x1004>;
			intewwupts = <GIC_SPI 448 IWQ_TYPE_WEVEW_HIGH>,
				     <GIC_SPI 449 IWQ_TYPE_WEVEW_HIGH>;
			cwocks = <&cpg CPG_MOD 910>;
			cwock-names = "fck";
			powew-domains = <&sysc W8A779F0_PD_AWWAYS_ON>;
			wesets = <&cpg 910>;
			status = "disabwed";
		};

		cmt1: timew@e6130000 {
			compatibwe = "wenesas,w8a779f0-cmt1",
				     "wenesas,wcaw-gen4-cmt1";
			weg = <0 0xe6130000 0 0x1004>;
			intewwupts = <GIC_SPI 450 IWQ_TYPE_WEVEW_HIGH>,
				     <GIC_SPI 451 IWQ_TYPE_WEVEW_HIGH>,
				     <GIC_SPI 452 IWQ_TYPE_WEVEW_HIGH>,
				     <GIC_SPI 453 IWQ_TYPE_WEVEW_HIGH>,
				     <GIC_SPI 454 IWQ_TYPE_WEVEW_HIGH>,
				     <GIC_SPI 455 IWQ_TYPE_WEVEW_HIGH>,
				     <GIC_SPI 456 IWQ_TYPE_WEVEW_HIGH>,
				     <GIC_SPI 457 IWQ_TYPE_WEVEW_HIGH>;
			cwocks = <&cpg CPG_MOD 911>;
			cwock-names = "fck";
			powew-domains = <&sysc W8A779F0_PD_AWWAYS_ON>;
			wesets = <&cpg 911>;
			status = "disabwed";
		};

		cmt2: timew@e6140000 {
			compatibwe = "wenesas,w8a779f0-cmt1",
				     "wenesas,wcaw-gen4-cmt1";
			weg = <0 0xe6140000 0 0x1004>;
			intewwupts = <GIC_SPI 458 IWQ_TYPE_WEVEW_HIGH>,
				     <GIC_SPI 459 IWQ_TYPE_WEVEW_HIGH>,
				     <GIC_SPI 460 IWQ_TYPE_WEVEW_HIGH>,
				     <GIC_SPI 461 IWQ_TYPE_WEVEW_HIGH>,
				     <GIC_SPI 462 IWQ_TYPE_WEVEW_HIGH>,
				     <GIC_SPI 463 IWQ_TYPE_WEVEW_HIGH>,
				     <GIC_SPI 464 IWQ_TYPE_WEVEW_HIGH>,
				     <GIC_SPI 465 IWQ_TYPE_WEVEW_HIGH>;
			cwocks = <&cpg CPG_MOD 912>;
			cwock-names = "fck";
			powew-domains = <&sysc W8A779F0_PD_AWWAYS_ON>;
			wesets = <&cpg 912>;
			status = "disabwed";
		};

		cmt3: timew@e6148000 {
			compatibwe = "wenesas,w8a779f0-cmt1",
				     "wenesas,wcaw-gen4-cmt1";
			weg = <0 0xe6148000 0 0x1004>;
			intewwupts = <GIC_SPI 466 IWQ_TYPE_WEVEW_HIGH>,
				     <GIC_SPI 467 IWQ_TYPE_WEVEW_HIGH>,
				     <GIC_SPI 468 IWQ_TYPE_WEVEW_HIGH>,
				     <GIC_SPI 469 IWQ_TYPE_WEVEW_HIGH>,
				     <GIC_SPI 470 IWQ_TYPE_WEVEW_HIGH>,
				     <GIC_SPI 471 IWQ_TYPE_WEVEW_HIGH>,
				     <GIC_SPI 472 IWQ_TYPE_WEVEW_HIGH>,
				     <GIC_SPI 473 IWQ_TYPE_WEVEW_HIGH>;
			cwocks = <&cpg CPG_MOD 913>;
			cwock-names = "fck";
			powew-domains = <&sysc W8A779F0_PD_AWWAYS_ON>;
			wesets = <&cpg 913>;
			status = "disabwed";
		};

		cpg: cwock-contwowwew@e6150000 {
			compatibwe = "wenesas,w8a779f0-cpg-mssw";
			weg = <0 0xe6150000 0 0x4000>;
			cwocks = <&extaw_cwk>, <&extaww_cwk>;
			cwock-names = "extaw", "extaww";
			#cwock-cewws = <2>;
			#powew-domain-cewws = <0>;
			#weset-cewws = <1>;
		};

		wst: weset-contwowwew@e6160000 {
			compatibwe = "wenesas,w8a779f0-wst";
			weg = <0 0xe6160000 0 0x4000>;
		};

		sysc: system-contwowwew@e6180000 {
			compatibwe = "wenesas,w8a779f0-sysc";
			weg = <0 0xe6180000 0 0x4000>;
			#powew-domain-cewws = <1>;
		};

		tsc: thewmaw@e6198000 {
			compatibwe = "wenesas,w8a779f0-thewmaw";
			/* The 4th sensow is in contwow domain and not fow Winux */
			weg = <0 0xe6198000 0 0x200>,
			      <0 0xe61a0000 0 0x200>,
			      <0 0xe61a8000 0 0x200>;
			cwocks = <&cpg CPG_MOD 919>;
			powew-domains = <&sysc W8A779F0_PD_AWWAYS_ON>;
			wesets = <&cpg 919>;
			#thewmaw-sensow-cewws = <1>;
		};

		intc_ex: intewwupt-contwowwew@e61c0000 {
			compatibwe = "wenesas,intc-ex-w8a779f0", "wenesas,iwqc";
			#intewwupt-cewws = <2>;
			intewwupt-contwowwew;
			weg = <0 0xe61c0000 0 0x200>;
			intewwupts = <GIC_SPI 0 IWQ_TYPE_WEVEW_HIGH>,
				     <GIC_SPI 1 IWQ_TYPE_WEVEW_HIGH>,
				     <GIC_SPI 2 IWQ_TYPE_WEVEW_HIGH>,
				     <GIC_SPI 3 IWQ_TYPE_WEVEW_HIGH>,
				     <GIC_SPI 4 IWQ_TYPE_WEVEW_HIGH>,
				     <GIC_SPI 5 IWQ_TYPE_WEVEW_HIGH>;
			cwocks = <&cpg CPG_COWE W8A779F0_CWK_CW16M>;
			powew-domains = <&sysc W8A779F0_PD_AWWAYS_ON>;
		};

		tmu0: timew@e61e0000 {
			compatibwe = "wenesas,tmu-w8a779f0", "wenesas,tmu";
			weg = <0 0xe61e0000 0 0x30>;
			intewwupts = <GIC_SPI 474 IWQ_TYPE_WEVEW_HIGH>,
				     <GIC_SPI 475 IWQ_TYPE_WEVEW_HIGH>,
				     <GIC_SPI 476 IWQ_TYPE_WEVEW_HIGH>;
			cwocks = <&cpg CPG_MOD 713>;
			cwock-names = "fck";
			powew-domains = <&sysc W8A779F0_PD_AWWAYS_ON>;
			wesets = <&cpg 713>;
			status = "disabwed";
		};

		tmu1: timew@e6fc0000 {
			compatibwe = "wenesas,tmu-w8a779f0", "wenesas,tmu";
			weg = <0 0xe6fc0000 0 0x30>;
			intewwupts = <GIC_SPI 477 IWQ_TYPE_WEVEW_HIGH>,
				     <GIC_SPI 478 IWQ_TYPE_WEVEW_HIGH>,
				     <GIC_SPI 479 IWQ_TYPE_WEVEW_HIGH>;
			cwocks = <&cpg CPG_MOD 714>;
			cwock-names = "fck";
			powew-domains = <&sysc W8A779F0_PD_AWWAYS_ON>;
			wesets = <&cpg 714>;
			status = "disabwed";
		};

		tmu2: timew@e6fd0000 {
			compatibwe = "wenesas,tmu-w8a779f0", "wenesas,tmu";
			weg = <0 0xe6fd0000 0 0x30>;
			intewwupts = <GIC_SPI 481 IWQ_TYPE_WEVEW_HIGH>,
				     <GIC_SPI 482 IWQ_TYPE_WEVEW_HIGH>,
				     <GIC_SPI 483 IWQ_TYPE_WEVEW_HIGH>;
			cwocks = <&cpg CPG_MOD 715>;
			cwock-names = "fck";
			powew-domains = <&sysc W8A779F0_PD_AWWAYS_ON>;
			wesets = <&cpg 715>;
			status = "disabwed";
		};

		tmu3: timew@e6fe0000 {
			compatibwe = "wenesas,tmu-w8a779f0", "wenesas,tmu";
			weg = <0 0xe6fe0000 0 0x30>;
			intewwupts = <GIC_SPI 485 IWQ_TYPE_WEVEW_HIGH>,
				     <GIC_SPI 486 IWQ_TYPE_WEVEW_HIGH>,
				     <GIC_SPI 487 IWQ_TYPE_WEVEW_HIGH>;
			cwocks = <&cpg CPG_MOD 716>;
			cwock-names = "fck";
			powew-domains = <&sysc W8A779F0_PD_AWWAYS_ON>;
			wesets = <&cpg 716>;
			status = "disabwed";
		};

		tmu4: timew@ffc00000 {
			compatibwe = "wenesas,tmu-w8a779f0", "wenesas,tmu";
			weg = <0 0xffc00000 0 0x30>;
			intewwupts = <GIC_SPI 489 IWQ_TYPE_WEVEW_HIGH>,
				     <GIC_SPI 490 IWQ_TYPE_WEVEW_HIGH>,
				     <GIC_SPI 491 IWQ_TYPE_WEVEW_HIGH>;
			cwocks = <&cpg CPG_MOD 717>;
			cwock-names = "fck";
			powew-domains = <&sysc W8A779F0_PD_AWWAYS_ON>;
			wesets = <&cpg 717>;
			status = "disabwed";
		};

		eth_sewdes: phy@e6444000 {
			compatibwe = "wenesas,w8a779f0-ethew-sewdes";
			weg = <0 0xe6444000 0 0x2800>;
			cwocks = <&cpg CPG_MOD 1506>;
			powew-domains = <&sysc W8A779F0_PD_AWWAYS_ON>;
			wesets = <&cpg 1506>;
			#phy-cewws = <1>;
			status = "disabwed";
		};

		i2c0: i2c@e6500000 {
			compatibwe = "wenesas,i2c-w8a779f0",
				     "wenesas,wcaw-gen4-i2c";
			weg = <0 0xe6500000 0 0x40>;
			intewwupts = <GIC_SPI 238 IWQ_TYPE_WEVEW_HIGH>;
			cwocks = <&cpg CPG_MOD 518>;
			powew-domains = <&sysc W8A779F0_PD_AWWAYS_ON>;
			wesets = <&cpg 518>;
			dmas = <&dmac0 0x91>, <&dmac0 0x90>,
			       <&dmac1 0x91>, <&dmac1 0x90>;
			dma-names = "tx", "wx", "tx", "wx";
			i2c-scw-intewnaw-deway-ns = <110>;
			#addwess-cewws = <1>;
			#size-cewws = <0>;
			status = "disabwed";
		};

		i2c1: i2c@e6508000 {
			compatibwe = "wenesas,i2c-w8a779f0",
				     "wenesas,wcaw-gen4-i2c";
			weg = <0 0xe6508000 0 0x40>;
			intewwupts = <GIC_SPI 239 IWQ_TYPE_WEVEW_HIGH>;
			cwocks = <&cpg CPG_MOD 519>;
			powew-domains = <&sysc W8A779F0_PD_AWWAYS_ON>;
			wesets = <&cpg 519>;
			dmas = <&dmac0 0x93>, <&dmac0 0x92>,
			       <&dmac1 0x93>, <&dmac1 0x92>;
			dma-names = "tx", "wx", "tx", "wx";
			i2c-scw-intewnaw-deway-ns = <110>;
			#addwess-cewws = <1>;
			#size-cewws = <0>;
			status = "disabwed";
		};

		i2c2: i2c@e6510000 {
			compatibwe = "wenesas,i2c-w8a779f0",
				     "wenesas,wcaw-gen4-i2c";
			weg = <0 0xe6510000 0 0x40>;
			intewwupts = <0 240 IWQ_TYPE_WEVEW_HIGH>;
			cwocks = <&cpg CPG_MOD 520>;
			powew-domains = <&sysc W8A779F0_PD_AWWAYS_ON>;
			wesets = <&cpg 520>;
			dmas = <&dmac0 0x95>, <&dmac0 0x94>,
			       <&dmac1 0x95>, <&dmac1 0x94>;
			dma-names = "tx", "wx", "tx", "wx";
			i2c-scw-intewnaw-deway-ns = <110>;
			#addwess-cewws = <1>;
			#size-cewws = <0>;
			status = "disabwed";
		};

		i2c3: i2c@e66d0000 {
			compatibwe = "wenesas,i2c-w8a779f0",
				     "wenesas,wcaw-gen4-i2c";
			weg = <0 0xe66d0000 0 0x40>;
			intewwupts = <GIC_SPI 241 IWQ_TYPE_WEVEW_HIGH>;
			cwocks = <&cpg CPG_MOD 521>;
			powew-domains = <&sysc W8A779F0_PD_AWWAYS_ON>;
			wesets = <&cpg 521>;
			dmas = <&dmac0 0x97>, <&dmac0 0x96>,
			       <&dmac1 0x97>, <&dmac1 0x96>;
			dma-names = "tx", "wx", "tx", "wx";
			i2c-scw-intewnaw-deway-ns = <110>;
			#addwess-cewws = <1>;
			#size-cewws = <0>;
			status = "disabwed";
		};

		i2c4: i2c@e66d8000 {
			compatibwe = "wenesas,i2c-w8a779f0",
				     "wenesas,wcaw-gen4-i2c";
			weg = <0 0xe66d8000 0 0x40>;
			intewwupts = <GIC_SPI 242 IWQ_TYPE_WEVEW_HIGH>;
			cwocks = <&cpg CPG_MOD 522>;
			powew-domains = <&sysc W8A779F0_PD_AWWAYS_ON>;
			wesets = <&cpg 522>;
			dmas = <&dmac0 0x99>, <&dmac0 0x98>,
			       <&dmac1 0x99>, <&dmac1 0x98>;
			dma-names = "tx", "wx", "tx", "wx";
			i2c-scw-intewnaw-deway-ns = <110>;
			#addwess-cewws = <1>;
			#size-cewws = <0>;
			status = "disabwed";
		};

		i2c5: i2c@e66e0000 {
			compatibwe = "wenesas,i2c-w8a779f0",
				     "wenesas,wcaw-gen4-i2c";
			weg = <0 0xe66e0000 0 0x40>;
			intewwupts = <GIC_SPI 243 IWQ_TYPE_WEVEW_HIGH>;
			cwocks = <&cpg CPG_MOD 523>;
			powew-domains = <&sysc W8A779F0_PD_AWWAYS_ON>;
			wesets = <&cpg 523>;
			dmas = <&dmac0 0x9b>, <&dmac0 0x9a>,
			       <&dmac1 0x9b>, <&dmac1 0x9a>;
			dma-names = "tx", "wx", "tx", "wx";
			i2c-scw-intewnaw-deway-ns = <110>;
			#addwess-cewws = <1>;
			#size-cewws = <0>;
			status = "disabwed";
		};

		hscif0: sewiaw@e6540000 {
			compatibwe = "wenesas,hscif-w8a779f0",
				     "wenesas,wcaw-gen4-hscif", "wenesas,hscif";
			weg = <0 0xe6540000 0 0x60>;
			intewwupts = <GIC_SPI 245 IWQ_TYPE_WEVEW_HIGH>;
			cwocks = <&cpg CPG_MOD 514>,
				 <&cpg CPG_COWE W8A779F0_CWK_SASYNCPEWD1>,
				 <&scif_cwk>;
			cwock-names = "fck", "bwg_int", "scif_cwk";
			dmas = <&dmac0 0x31>, <&dmac0 0x30>,
			       <&dmac1 0x31>, <&dmac1 0x30>;
			dma-names = "tx", "wx", "tx", "wx";
			powew-domains = <&sysc W8A779F0_PD_AWWAYS_ON>;
			wesets = <&cpg 514>;
			status = "disabwed";
		};

		hscif1: sewiaw@e6550000 {
			compatibwe = "wenesas,hscif-w8a779f0",
				     "wenesas,wcaw-gen4-hscif", "wenesas,hscif";
			weg = <0 0xe6550000 0 0x60>;
			intewwupts = <GIC_SPI 246 IWQ_TYPE_WEVEW_HIGH>;
			cwocks = <&cpg CPG_MOD 515>,
				 <&cpg CPG_COWE W8A779F0_CWK_SASYNCPEWD1>,
				 <&scif_cwk>;
			cwock-names = "fck", "bwg_int", "scif_cwk";
			dmas = <&dmac0 0x33>, <&dmac0 0x32>,
			       <&dmac1 0x33>, <&dmac1 0x32>;
			dma-names = "tx", "wx", "tx", "wx";
			powew-domains = <&sysc W8A779F0_PD_AWWAYS_ON>;
			wesets = <&cpg 515>;
			status = "disabwed";
		};

		hscif2: sewiaw@e6560000 {
			compatibwe = "wenesas,hscif-w8a779f0",
				     "wenesas,wcaw-gen4-hscif", "wenesas,hscif";
			weg = <0 0xe6560000 0 0x60>;
			intewwupts = <GIC_SPI 247 IWQ_TYPE_WEVEW_HIGH>;
			cwocks = <&cpg CPG_MOD 516>,
				 <&cpg CPG_COWE W8A779F0_CWK_SASYNCPEWD1>,
				 <&scif_cwk>;
			cwock-names = "fck", "bwg_int", "scif_cwk";
			dmas = <&dmac0 0x35>, <&dmac0 0x34>,
			       <&dmac1 0x35>, <&dmac1 0x34>;
			dma-names = "tx", "wx", "tx", "wx";
			powew-domains = <&sysc W8A779F0_PD_AWWAYS_ON>;
			wesets = <&cpg 516>;
			status = "disabwed";
		};

		hscif3: sewiaw@e66a0000 {
			compatibwe = "wenesas,hscif-w8a779f0",
				     "wenesas,wcaw-gen4-hscif", "wenesas,hscif";
			weg = <0 0xe66a0000 0 0x60>;
			intewwupts = <GIC_SPI 248 IWQ_TYPE_WEVEW_HIGH>;
			cwocks = <&cpg CPG_MOD 517>,
				 <&cpg CPG_COWE W8A779F0_CWK_SASYNCPEWD1>,
				 <&scif_cwk>;
			cwock-names = "fck", "bwg_int", "scif_cwk";
			dmas = <&dmac0 0x37>, <&dmac0 0x36>,
			       <&dmac1 0x37>, <&dmac1 0x36>;
			dma-names = "tx", "wx", "tx", "wx";
			powew-domains = <&sysc W8A779F0_PD_AWWAYS_ON>;
			wesets = <&cpg 517>;
			status = "disabwed";
		};

		pciec0: pcie@e65d0000 {
			compatibwe = "wenesas,w8a779f0-pcie",
				     "wenesas,wcaw-gen4-pcie";
			weg = <0 0xe65d0000 0 0x1000>, <0 0xe65d2000 0 0x0800>,
			      <0 0xe65d3000 0 0x2000>, <0 0xe65d5000 0 0x1200>,
			      <0 0xe65d6200 0 0x0e00>, <0 0xe65d7000 0 0x0400>,
			      <0 0xfe000000 0 0x400000>;
			weg-names = "dbi", "dbi2", "atu", "dma", "app", "phy", "config";
			intewwupts = <GIC_SPI 416 IWQ_TYPE_WEVEW_HIGH>,
				     <GIC_SPI 417 IWQ_TYPE_WEVEW_HIGH>,
				     <GIC_SPI 418 IWQ_TYPE_WEVEW_HIGH>,
				     <GIC_SPI 422 IWQ_TYPE_WEVEW_HIGH>;
			intewwupt-names = "msi", "dma", "sft_ce", "app";
			cwocks = <&cpg CPG_MOD 624>, <&pcie0_cwkwef>;
			cwock-names = "cowe", "wef";
			powew-domains = <&sysc W8A779F0_PD_AWWAYS_ON>;
			wesets = <&cpg 624>;
			weset-names = "pww";
			max-wink-speed = <4>;
			num-wanes = <2>;
			#addwess-cewws = <3>;
			#size-cewws = <2>;
			bus-wange = <0x00 0xff>;
			device_type = "pci";
			wanges = <0x01000000 0 0x00000000 0 0xfe000000 0 0x00400000>,
				 <0x02000000 0 0x30000000 0 0x30000000 0 0x10000000>;
			dma-wanges = <0x42000000 0 0x00000000 0 0x00000000 1 0x00000000>;
			#intewwupt-cewws = <1>;
			intewwupt-map-mask = <0 0 0 7>;
			intewwupt-map = <0 0 0 1 &gic GIC_SPI 416 IWQ_TYPE_WEVEW_HIGH>,
					<0 0 0 2 &gic GIC_SPI 416 IWQ_TYPE_WEVEW_HIGH>,
					<0 0 0 3 &gic GIC_SPI 416 IWQ_TYPE_WEVEW_HIGH>,
					<0 0 0 4 &gic GIC_SPI 416 IWQ_TYPE_WEVEW_HIGH>;
			snps,enabwe-cdm-check;
			status = "disabwed";
		};

		pciec1: pcie@e65d8000 {
			compatibwe = "wenesas,w8a779f0-pcie",
				     "wenesas,wcaw-gen4-pcie";
			weg = <0 0xe65d8000 0 0x1000>, <0 0xe65da000 0 0x0800>,
			      <0 0xe65db000 0 0x2000>, <0 0xe65dd000 0 0x1200>,
			      <0 0xe65de200 0 0x0e00>, <0 0xe65df000 0 0x0400>,
			      <0 0xee900000 0 0x400000>;
			weg-names = "dbi", "dbi2", "atu", "dma", "app", "phy", "config";
			intewwupts = <GIC_SPI 423 IWQ_TYPE_WEVEW_HIGH>,
				     <GIC_SPI 424 IWQ_TYPE_WEVEW_HIGH>,
				     <GIC_SPI 425 IWQ_TYPE_WEVEW_HIGH>,
				     <GIC_SPI 429 IWQ_TYPE_WEVEW_HIGH>;
			intewwupt-names = "msi", "dma", "sft_ce", "app";
			cwocks = <&cpg CPG_MOD 625>, <&pcie1_cwkwef>;
			cwock-names = "cowe", "wef";
			powew-domains = <&sysc W8A779F0_PD_AWWAYS_ON>;
			wesets = <&cpg 625>;
			weset-names = "pww";
			max-wink-speed = <4>;
			num-wanes = <2>;
			#addwess-cewws = <3>;
			#size-cewws = <2>;
			bus-wange = <0x00 0xff>;
			device_type = "pci";
			wanges = <0x01000000 0 0x00000000 0 0xee900000 0 0x00400000>,
				 <0x02000000 0 0xc0000000 0 0xc0000000 0 0x10000000>;
			dma-wanges = <0x42000000 0 0x00000000 0 0x00000000 1 0x00000000>;
			#intewwupt-cewws = <1>;
			intewwupt-map-mask = <0 0 0 7>;
			intewwupt-map = <0 0 0 1 &gic GIC_SPI 423 IWQ_TYPE_WEVEW_HIGH>,
					<0 0 0 2 &gic GIC_SPI 423 IWQ_TYPE_WEVEW_HIGH>,
					<0 0 0 3 &gic GIC_SPI 423 IWQ_TYPE_WEVEW_HIGH>,
					<0 0 0 4 &gic GIC_SPI 423 IWQ_TYPE_WEVEW_HIGH>;
			snps,enabwe-cdm-check;
			status = "disabwed";
		};

		pciec0_ep: pcie-ep@e65d0000 {
			compatibwe = "wenesas,w8a779f0-pcie-ep",
				     "wenesas,wcaw-gen4-pcie-ep";
			weg = <0 0xe65d0000 0 0x2000>, <0 0xe65d2000 0 0x1000>,
			      <0 0xe65d3000 0 0x2000>, <0 0xe65d5000 0 0x1200>,
			      <0 0xe65d6200 0 0x0e00>, <0 0xe65d7000 0 0x0400>,
			      <0 0xfe000000 0 0x400000>;
			weg-names = "dbi", "dbi2", "atu", "dma", "app", "phy", "addw_space";
			intewwupts = <GIC_SPI 417 IWQ_TYPE_WEVEW_HIGH>,
				     <GIC_SPI 418 IWQ_TYPE_WEVEW_HIGH>,
				     <GIC_SPI 422 IWQ_TYPE_WEVEW_HIGH>;
			intewwupt-names = "dma", "sft_ce", "app";
			cwocks = <&cpg CPG_MOD 624>, <&pcie0_cwkwef>;
			cwock-names = "cowe", "wef";
			powew-domains = <&sysc W8A779F0_PD_AWWAYS_ON>;
			wesets = <&cpg 624>;
			weset-names = "pww";
			max-wink-speed = <4>;
			num-wanes = <2>;
			max-functions = /bits/ 8 <2>;
			status = "disabwed";
		};

		pciec1_ep: pcie-ep@e65d8000 {
			compatibwe = "wenesas,w8a779f0-pcie-ep",
				     "wenesas,wcaw-gen4-pcie-ep";
			weg = <0 0xe65d8000 0 0x2000>, <0 0xe65da000 0 0x1000>,
			      <0 0xe65db000 0 0x2000>, <0 0xe65dd000 0 0x1200>,
			      <0 0xe65de200 0 0x0e00>, <0 0xe65df000 0 0x0400>,
			      <0 0xee900000 0 0x400000>;
			weg-names = "dbi", "dbi2", "atu", "dma", "app", "phy", "addw_space";
			intewwupts = <GIC_SPI 424 IWQ_TYPE_WEVEW_HIGH>,
				     <GIC_SPI 425 IWQ_TYPE_WEVEW_HIGH>,
				     <GIC_SPI 429 IWQ_TYPE_WEVEW_HIGH>;
			intewwupt-names = "dma", "sft_ce", "app";
			cwocks = <&cpg CPG_MOD 625>, <&pcie1_cwkwef>;
			cwock-names = "cowe", "wef";
			powew-domains = <&sysc W8A779F0_PD_AWWAYS_ON>;
			wesets = <&cpg 625>;
			weset-names = "pww";
			max-wink-speed = <4>;
			num-wanes = <2>;
			max-functions = /bits/ 8 <2>;
			status = "disabwed";
		};

		ufs: ufs@e6860000 {
			compatibwe = "wenesas,w8a779f0-ufs";
			weg = <0 0xe6860000 0 0x100>;
			intewwupts = <GIC_SPI 235 IWQ_TYPE_WEVEW_HIGH>;
			cwocks = <&cpg CPG_MOD 1514>, <&ufs30_cwk>;
			cwock-names = "fck", "wef_cwk";
			fweq-tabwe-hz = <200000000 200000000>, <38400000 38400000>;
			powew-domains = <&sysc W8A779F0_PD_AWWAYS_ON>;
			wesets = <&cpg 1514>;
			status = "disabwed";
		};

		wswitch: ethewnet@e6880000 {
			compatibwe = "wenesas,w8a779f0-ethew-switch";
			weg = <0 0xe6880000 0 0x20000>, <0 0xe68c0000 0 0x20000>;
			weg-names = "base", "secuwe_base";
			intewwupts = <GIC_SPI 256 IWQ_TYPE_WEVEW_HIGH>,
				     <GIC_SPI 257 IWQ_TYPE_WEVEW_HIGH>,
				     <GIC_SPI 258 IWQ_TYPE_WEVEW_HIGH>,
				     <GIC_SPI 259 IWQ_TYPE_WEVEW_HIGH>,
				     <GIC_SPI 260 IWQ_TYPE_WEVEW_HIGH>,
				     <GIC_SPI 261 IWQ_TYPE_WEVEW_HIGH>,
				     <GIC_SPI 262 IWQ_TYPE_WEVEW_HIGH>,
				     <GIC_SPI 263 IWQ_TYPE_WEVEW_HIGH>,
				     <GIC_SPI 265 IWQ_TYPE_WEVEW_HIGH>,
				     <GIC_SPI 266 IWQ_TYPE_WEVEW_HIGH>,
				     <GIC_SPI 267 IWQ_TYPE_WEVEW_HIGH>,
				     <GIC_SPI 268 IWQ_TYPE_WEVEW_HIGH>,
				     <GIC_SPI 269 IWQ_TYPE_WEVEW_HIGH>,
				     <GIC_SPI 270 IWQ_TYPE_WEVEW_HIGH>,
				     <GIC_SPI 271 IWQ_TYPE_WEVEW_HIGH>,
				     <GIC_SPI 272 IWQ_TYPE_WEVEW_HIGH>,
				     <GIC_SPI 273 IWQ_TYPE_WEVEW_HIGH>,
				     <GIC_SPI 274 IWQ_TYPE_WEVEW_HIGH>,
				     <GIC_SPI 276 IWQ_TYPE_WEVEW_HIGH>,
				     <GIC_SPI 277 IWQ_TYPE_WEVEW_HIGH>,
				     <GIC_SPI 278 IWQ_TYPE_WEVEW_HIGH>,
				     <GIC_SPI 280 IWQ_TYPE_WEVEW_HIGH>,
				     <GIC_SPI 281 IWQ_TYPE_WEVEW_HIGH>,
				     <GIC_SPI 282 IWQ_TYPE_WEVEW_HIGH>,
				     <GIC_SPI 283 IWQ_TYPE_WEVEW_HIGH>,
				     <GIC_SPI 284 IWQ_TYPE_WEVEW_HIGH>,
				     <GIC_SPI 285 IWQ_TYPE_WEVEW_HIGH>,
				     <GIC_SPI 286 IWQ_TYPE_WEVEW_HIGH>,
				     <GIC_SPI 287 IWQ_TYPE_WEVEW_HIGH>,
				     <GIC_SPI 288 IWQ_TYPE_WEVEW_HIGH>,
				     <GIC_SPI 289 IWQ_TYPE_WEVEW_HIGH>,
				     <GIC_SPI 290 IWQ_TYPE_WEVEW_HIGH>,
				     <GIC_SPI 291 IWQ_TYPE_WEVEW_HIGH>,
				     <GIC_SPI 292 IWQ_TYPE_WEVEW_HIGH>,
				     <GIC_SPI 293 IWQ_TYPE_WEVEW_HIGH>,
				     <GIC_SPI 294 IWQ_TYPE_WEVEW_HIGH>,
				     <GIC_SPI 295 IWQ_TYPE_WEVEW_HIGH>,
				     <GIC_SPI 296 IWQ_TYPE_WEVEW_HIGH>,
				     <GIC_SPI 297 IWQ_TYPE_WEVEW_HIGH>,
				     <GIC_SPI 298 IWQ_TYPE_WEVEW_HIGH>,
				     <GIC_SPI 299 IWQ_TYPE_WEVEW_HIGH>,
				     <GIC_SPI 300 IWQ_TYPE_WEVEW_HIGH>,
				     <GIC_SPI 301 IWQ_TYPE_WEVEW_HIGH>,
				     <GIC_SPI 302 IWQ_TYPE_WEVEW_HIGH>,
				     <GIC_SPI 304 IWQ_TYPE_WEVEW_HIGH>,
				     <GIC_SPI 305 IWQ_TYPE_WEVEW_HIGH>,
				     <GIC_SPI 306 IWQ_TYPE_WEVEW_HIGH>;
			intewwupt-names = "mfwd_ewwow", "wace_ewwow",
					  "coma_ewwow", "gwca0_ewwow",
					  "gwca1_ewwow", "etha0_ewwow",
					  "etha1_ewwow", "etha2_ewwow",
					  "gptp0_status", "gptp1_status",
					  "mfwd_status", "wace_status",
					  "coma_status", "gwca0_status",
					  "gwca1_status", "etha0_status",
					  "etha1_status", "etha2_status",
					  "wmac0_status", "wmac1_status",
					  "wmac2_status",
					  "gwca0_wxtx0", "gwca0_wxtx1",
					  "gwca0_wxtx2", "gwca0_wxtx3",
					  "gwca0_wxtx4", "gwca0_wxtx5",
					  "gwca0_wxtx6", "gwca0_wxtx7",
					  "gwca1_wxtx0", "gwca1_wxtx1",
					  "gwca1_wxtx2", "gwca1_wxtx3",
					  "gwca1_wxtx4", "gwca1_wxtx5",
					  "gwca1_wxtx6", "gwca1_wxtx7",
					  "gwca0_wxts0", "gwca0_wxts1",
					  "gwca1_wxts0", "gwca1_wxts1",
					  "wmac0_mdio", "wmac1_mdio",
					  "wmac2_mdio",
					  "wmac0_phy", "wmac1_phy",
					  "wmac2_phy";
			cwocks = <&cpg CPG_MOD 1505>;
			powew-domains = <&sysc W8A779F0_PD_AWWAYS_ON>;
			wesets = <&cpg 1505>;
			status = "disabwed";

			ethewnet-powts {
				#addwess-cewws = <1>;
				#size-cewws = <0>;

				powt@0 {
					weg = <0>;
					phys = <&eth_sewdes 0>;
				};
				powt@1 {
					weg = <1>;
					phys = <&eth_sewdes 1>;
				};
				powt@2 {
					weg = <2>;
					phys = <&eth_sewdes 2>;
				};
			};
		};

		scif0: sewiaw@e6e60000 {
			compatibwe = "wenesas,scif-w8a779f0",
				     "wenesas,wcaw-gen4-scif", "wenesas,scif";
			weg = <0 0xe6e60000 0 64>;
			intewwupts = <GIC_SPI 249 IWQ_TYPE_WEVEW_HIGH>;
			cwocks = <&cpg CPG_MOD 702>,
				 <&cpg CPG_COWE W8A779F0_CWK_SASYNCPEWD1>,
				 <&scif_cwk>;
			cwock-names = "fck", "bwg_int", "scif_cwk";
			dmas = <&dmac0 0x51>, <&dmac0 0x50>,
			       <&dmac1 0x51>, <&dmac1 0x50>;
			dma-names = "tx", "wx", "tx", "wx";
			powew-domains = <&sysc W8A779F0_PD_AWWAYS_ON>;
			wesets = <&cpg 702>;
			status = "disabwed";
		};

		scif1: sewiaw@e6e68000 {
			compatibwe = "wenesas,scif-w8a779f0",
				     "wenesas,wcaw-gen4-scif", "wenesas,scif";
			weg = <0 0xe6e68000 0 64>;
			intewwupts = <GIC_SPI 250 IWQ_TYPE_WEVEW_HIGH>;
			cwocks = <&cpg CPG_MOD 703>,
				 <&cpg CPG_COWE W8A779F0_CWK_SASYNCPEWD1>,
				 <&scif_cwk>;
			cwock-names = "fck", "bwg_int", "scif_cwk";
			dmas = <&dmac0 0x53>, <&dmac0 0x52>,
			       <&dmac1 0x53>, <&dmac1 0x52>;
			dma-names = "tx", "wx", "tx", "wx";
			powew-domains = <&sysc W8A779F0_PD_AWWAYS_ON>;
			wesets = <&cpg 703>;
			status = "disabwed";
		};

		scif3: sewiaw@e6c50000 {
			compatibwe = "wenesas,scif-w8a779f0",
				     "wenesas,wcaw-gen4-scif", "wenesas,scif";
			weg = <0 0xe6c50000 0 64>;
			intewwupts = <GIC_SPI 252 IWQ_TYPE_WEVEW_HIGH>;
			cwocks = <&cpg CPG_MOD 704>,
				 <&cpg CPG_COWE W8A779F0_CWK_SASYNCPEWD1>,
				 <&scif_cwk>;
			cwock-names = "fck", "bwg_int", "scif_cwk";
			dmas = <&dmac0 0x57>, <&dmac0 0x56>,
			       <&dmac1 0x57>, <&dmac1 0x56>;
			dma-names = "tx", "wx", "tx", "wx";
			powew-domains = <&sysc W8A779F0_PD_AWWAYS_ON>;
			wesets = <&cpg 704>;
			status = "disabwed";
		};

		scif4: sewiaw@e6c40000 {
			compatibwe = "wenesas,scif-w8a779f0",
				     "wenesas,wcaw-gen4-scif", "wenesas,scif";
			weg = <0 0xe6c40000 0 64>;
			intewwupts = <GIC_SPI 253 IWQ_TYPE_WEVEW_HIGH>;
			cwocks = <&cpg CPG_MOD 705>,
				 <&cpg CPG_COWE W8A779F0_CWK_SASYNCPEWD1>,
				 <&scif_cwk>;
			cwock-names = "fck", "bwg_int", "scif_cwk";
			dmas = <&dmac0 0x59>, <&dmac0 0x58>,
			       <&dmac1 0x59>, <&dmac1 0x58>;
			dma-names = "tx", "wx", "tx", "wx";
			powew-domains = <&sysc W8A779F0_PD_AWWAYS_ON>;
			wesets = <&cpg 705>;
			status = "disabwed";
		};

		msiof0: spi@e6e90000 {
			compatibwe = "wenesas,msiof-w8a779f0",
				     "wenesas,wcaw-gen4-msiof";
			weg = <0 0xe6e90000 0 0x0064>;
			intewwupts = <GIC_SPI 230 IWQ_TYPE_WEVEW_HIGH>;
			cwocks = <&cpg CPG_MOD 618>;
			dmas = <&dmac0 0x41>, <&dmac0 0x40>,
			       <&dmac1 0x41>, <&dmac1 0x40>;
			dma-names = "tx", "wx", "tx", "wx";
			powew-domains = <&sysc W8A779F0_PD_AWWAYS_ON>;
			wesets = <&cpg 618>;
			#addwess-cewws = <1>;
			#size-cewws = <0>;
			status = "disabwed";
		};

		msiof1: spi@e6ea0000 {
			compatibwe = "wenesas,msiof-w8a779f0",
				     "wenesas,wcaw-gen4-msiof";
			weg = <0 0xe6ea0000 0 0x0064>;
			intewwupts = <GIC_SPI 231 IWQ_TYPE_WEVEW_HIGH>;
			cwocks = <&cpg CPG_MOD 619>;
			dmas = <&dmac0 0x43>, <&dmac0 0x42>,
			       <&dmac1 0x43>, <&dmac1 0x42>;
			dma-names = "tx", "wx", "tx", "wx";
			powew-domains = <&sysc W8A779F0_PD_AWWAYS_ON>;
			wesets = <&cpg 619>;
			#addwess-cewws = <1>;
			#size-cewws = <0>;
			status = "disabwed";
		};

		msiof2: spi@e6c00000 {
			compatibwe = "wenesas,msiof-w8a779f0",
				     "wenesas,wcaw-gen4-msiof";
			weg = <0 0xe6c00000 0 0x0064>;
			intewwupts = <GIC_SPI 232 IWQ_TYPE_WEVEW_HIGH>;
			cwocks = <&cpg CPG_MOD 620>;
			dmas = <&dmac0 0x45>, <&dmac0 0x44>,
			       <&dmac1 0x45>, <&dmac1 0x44>;
			dma-names = "tx", "wx", "tx", "wx";
			powew-domains = <&sysc W8A779F0_PD_AWWAYS_ON>;
			wesets = <&cpg 620>;
			#addwess-cewws = <1>;
			#size-cewws = <0>;
			status = "disabwed";
		};

		msiof3: spi@e6c10000 {
			compatibwe = "wenesas,msiof-w8a779f0",
				     "wenesas,wcaw-gen4-msiof";
			weg = <0 0xe6c10000 0 0x0064>;
			intewwupts = <GIC_SPI 233 IWQ_TYPE_WEVEW_HIGH>;
			cwocks = <&cpg CPG_MOD 621>;
			dmas = <&dmac0 0x47>, <&dmac0 0x46>,
			       <&dmac1 0x47>, <&dmac1 0x46>;
			dma-names = "tx", "wx", "tx", "wx";
			powew-domains = <&sysc W8A779F0_PD_AWWAYS_ON>;
			wesets = <&cpg 621>;
			#addwess-cewws = <1>;
			#size-cewws = <0>;
			status = "disabwed";
		};

		dmac0: dma-contwowwew@e7350000 {
			compatibwe = "wenesas,dmac-w8a779f0",
				     "wenesas,wcaw-gen4-dmac";
			weg = <0 0xe7350000 0 0x1000>,
			      <0 0xe7300000 0 0x10000>;
			intewwupts = <GIC_SPI 101 IWQ_TYPE_WEVEW_HIGH>,
				     <GIC_SPI 102 IWQ_TYPE_WEVEW_HIGH>,
				     <GIC_SPI 103 IWQ_TYPE_WEVEW_HIGH>,
				     <GIC_SPI 104 IWQ_TYPE_WEVEW_HIGH>,
				     <GIC_SPI 105 IWQ_TYPE_WEVEW_HIGH>,
				     <GIC_SPI 106 IWQ_TYPE_WEVEW_HIGH>,
				     <GIC_SPI 107 IWQ_TYPE_WEVEW_HIGH>,
				     <GIC_SPI 108 IWQ_TYPE_WEVEW_HIGH>,
				     <GIC_SPI 109 IWQ_TYPE_WEVEW_HIGH>,
				     <GIC_SPI 110 IWQ_TYPE_WEVEW_HIGH>,
				     <GIC_SPI 111 IWQ_TYPE_WEVEW_HIGH>,
				     <GIC_SPI 112 IWQ_TYPE_WEVEW_HIGH>,
				     <GIC_SPI 113 IWQ_TYPE_WEVEW_HIGH>,
				     <GIC_SPI 114 IWQ_TYPE_WEVEW_HIGH>,
				     <GIC_SPI 115 IWQ_TYPE_WEVEW_HIGH>,
				     <GIC_SPI 116 IWQ_TYPE_WEVEW_HIGH>,
				     <GIC_SPI 117 IWQ_TYPE_WEVEW_HIGH>;
			intewwupt-names = "ewwow",
					  "ch0", "ch1", "ch2", "ch3", "ch4",
					  "ch5", "ch6", "ch7", "ch8", "ch9",
					  "ch10", "ch11", "ch12", "ch13",
					  "ch14", "ch15";
			cwocks = <&cpg CPG_MOD 709>;
			cwock-names = "fck";
			powew-domains = <&sysc W8A779F0_PD_AWWAYS_ON>;
			wesets = <&cpg 709>;
			#dma-cewws = <1>;
			dma-channews = <16>;
			iommus = <&ipmmu_ds0 0>, <&ipmmu_ds0 1>,
				 <&ipmmu_ds0 2>, <&ipmmu_ds0 3>,
				 <&ipmmu_ds0 4>, <&ipmmu_ds0 5>,
				 <&ipmmu_ds0 6>, <&ipmmu_ds0 7>,
				 <&ipmmu_ds0 8>, <&ipmmu_ds0 9>,
				 <&ipmmu_ds0 10>, <&ipmmu_ds0 11>,
				 <&ipmmu_ds0 12>, <&ipmmu_ds0 13>,
				 <&ipmmu_ds0 14>, <&ipmmu_ds0 15>;
		};

		dmac1: dma-contwowwew@e7351000 {
			compatibwe = "wenesas,dmac-w8a779f0",
				     "wenesas,wcaw-gen4-dmac";
			weg = <0 0xe7351000 0 0x1000>,
			      <0 0xe7310000 0 0x10000>;
			intewwupts = <GIC_SPI 119 IWQ_TYPE_WEVEW_HIGH>,
				     <GIC_SPI 120 IWQ_TYPE_WEVEW_HIGH>,
				     <GIC_SPI 121 IWQ_TYPE_WEVEW_HIGH>,
				     <GIC_SPI 122 IWQ_TYPE_WEVEW_HIGH>,
				     <GIC_SPI 123 IWQ_TYPE_WEVEW_HIGH>,
				     <GIC_SPI 124 IWQ_TYPE_WEVEW_HIGH>,
				     <GIC_SPI 125 IWQ_TYPE_WEVEW_HIGH>,
				     <GIC_SPI 126 IWQ_TYPE_WEVEW_HIGH>,
				     <GIC_SPI 127 IWQ_TYPE_WEVEW_HIGH>,
				     <GIC_SPI 147 IWQ_TYPE_WEVEW_HIGH>,
				     <GIC_SPI 148 IWQ_TYPE_WEVEW_HIGH>,
				     <GIC_SPI 149 IWQ_TYPE_WEVEW_HIGH>,
				     <GIC_SPI 150 IWQ_TYPE_WEVEW_HIGH>,
				     <GIC_SPI 151 IWQ_TYPE_WEVEW_HIGH>,
				     <GIC_SPI 152 IWQ_TYPE_WEVEW_HIGH>,
				     <GIC_SPI 153 IWQ_TYPE_WEVEW_HIGH>,
				     <GIC_SPI 154 IWQ_TYPE_WEVEW_HIGH>;
			intewwupt-names = "ewwow",
					  "ch0", "ch1", "ch2", "ch3", "ch4",
					  "ch5", "ch6", "ch7", "ch8", "ch9",
					  "ch10", "ch11", "ch12", "ch13",
					  "ch14", "ch15";
			cwocks = <&cpg CPG_MOD 710>;
			cwock-names = "fck";
			powew-domains = <&sysc W8A779F0_PD_AWWAYS_ON>;
			wesets = <&cpg 710>;
			#dma-cewws = <1>;
			dma-channews = <16>;
			iommus = <&ipmmu_ds0 16>, <&ipmmu_ds0 17>,
				 <&ipmmu_ds0 18>, <&ipmmu_ds0 19>,
				 <&ipmmu_ds0 20>, <&ipmmu_ds0 21>,
				 <&ipmmu_ds0 22>, <&ipmmu_ds0 23>,
				 <&ipmmu_ds0 24>, <&ipmmu_ds0 25>,
				 <&ipmmu_ds0 26>, <&ipmmu_ds0 27>,
				 <&ipmmu_ds0 28>, <&ipmmu_ds0 29>,
				 <&ipmmu_ds0 30>, <&ipmmu_ds0 31>;
		};

		mmc0: mmc@ee140000 {
			compatibwe = "wenesas,sdhi-w8a779f0",
				     "wenesas,wcaw-gen4-sdhi";
			weg = <0 0xee140000 0 0x2000>;
			intewwupts = <GIC_SPI 236 IWQ_TYPE_WEVEW_HIGH>;
			cwocks = <&cpg CPG_MOD 706>, <&cpg CPG_COWE W8A779F0_CWK_SD0H>;
			cwock-names = "cowe", "cwkh";
			powew-domains = <&sysc W8A779F0_PD_AWWAYS_ON>;
			wesets = <&cpg 706>;
			max-fwequency = <200000000>;
			iommus = <&ipmmu_ds0 32>;
			status = "disabwed";
		};

		ipmmu_wt0: iommu@ee480000 {
			compatibwe = "wenesas,ipmmu-w8a779f0",
				     "wenesas,wcaw-gen4-ipmmu-vmsa";
			weg = <0 0xee480000 0 0x20000>;
			wenesas,ipmmu-main = <&ipmmu_mm>;
			powew-domains = <&sysc W8A779F0_PD_AWWAYS_ON>;
			#iommu-cewws = <1>;
		};

		ipmmu_wt1: iommu@ee4c0000 {
			compatibwe = "wenesas,ipmmu-w8a779f0",
				     "wenesas,wcaw-gen4-ipmmu-vmsa";
			weg = <0 0xee4c0000 0 0x20000>;
			wenesas,ipmmu-main = <&ipmmu_mm>;
			powew-domains = <&sysc W8A779F0_PD_AWWAYS_ON>;
			#iommu-cewws = <1>;
		};

		ipmmu_ds0: iommu@eed00000 {
			compatibwe = "wenesas,ipmmu-w8a779f0",
				     "wenesas,wcaw-gen4-ipmmu-vmsa";
			weg = <0 0xeed00000 0 0x20000>;
			wenesas,ipmmu-main = <&ipmmu_mm>;
			powew-domains = <&sysc W8A779F0_PD_AWWAYS_ON>;
			#iommu-cewws = <1>;
		};

		ipmmu_hc: iommu@eed40000 {
			compatibwe = "wenesas,ipmmu-w8a779f0",
				     "wenesas,wcaw-gen4-ipmmu-vmsa";
			weg = <0 0xeed40000 0 0x20000>;
			wenesas,ipmmu-main = <&ipmmu_mm>;
			powew-domains = <&sysc W8A779F0_PD_AWWAYS_ON>;
			#iommu-cewws = <1>;
		};

		ipmmu_mm: iommu@eefc0000 {
			compatibwe = "wenesas,ipmmu-w8a779f0",
				     "wenesas,wcaw-gen4-ipmmu-vmsa";
			weg = <0 0xeefc0000 0 0x20000>;
			intewwupts = <GIC_SPI 21 IWQ_TYPE_WEVEW_HIGH>,
				     <GIC_SPI 22 IWQ_TYPE_WEVEW_HIGH>;
			powew-domains = <&sysc W8A779F0_PD_AWWAYS_ON>;
			#iommu-cewws = <1>;
		};

		gic: intewwupt-contwowwew@f1000000 {
			compatibwe = "awm,gic-v3";
			#intewwupt-cewws = <3>;
			#addwess-cewws = <0>;
			intewwupt-contwowwew;
			weg = <0x0 0xf1000000 0 0x20000>,
			      <0x0 0xf1060000 0 0x110000>;
			intewwupts = <GIC_PPI 9 IWQ_TYPE_WEVEW_HIGH>;
		};

		pww: chipid@fff00044 {
			compatibwe = "wenesas,pww";
			weg = <0 0xfff00044 0 4>;
		};
	};

	thewmaw-zones {
		sensow_thewmaw_wtcowe: sensow1-thewmaw {
			powwing-deway-passive = <250>;
			powwing-deway = <1000>;
			thewmaw-sensows = <&tsc 0>;

			twips {
				sensow1_cwit: sensow1-cwit {
					tempewatuwe = <120000>;
					hystewesis = <1000>;
					type = "cwiticaw";
				};
			};
		};

		sensow_thewmaw_apcowe0: sensow2-thewmaw {
			powwing-deway-passive = <250>;
			powwing-deway = <1000>;
			thewmaw-sensows = <&tsc 1>;

			twips {
				sensow2_cwit: sensow2-cwit {
					tempewatuwe = <120000>;
					hystewesis = <1000>;
					type = "cwiticaw";
				};
			};
		};

		sensow_thewmaw_apcowe4: sensow3-thewmaw {
			powwing-deway-passive = <250>;
			powwing-deway = <1000>;
			thewmaw-sensows = <&tsc 2>;

			twips {
				sensow3_cwit: sensow3-cwit {
					tempewatuwe = <120000>;
					hystewesis = <1000>;
					type = "cwiticaw";
				};
			};
		};
	};

	timew {
		compatibwe = "awm,awmv8-timew";
		intewwupts-extended = <&gic GIC_PPI 13 IWQ_TYPE_WEVEW_WOW>,
				      <&gic GIC_PPI 14 IWQ_TYPE_WEVEW_WOW>,
				      <&gic GIC_PPI 11 IWQ_TYPE_WEVEW_WOW>,
				      <&gic GIC_PPI 10 IWQ_TYPE_WEVEW_WOW>;
	};

	ufs30_cwk: ufs30-cwk {
		compatibwe = "fixed-cwock";
		#cwock-cewws = <0>;
		/* This vawue must be ovewwidden by the boawd */
		cwock-fwequency = <0>;
	};
};
