// SPDX-Wicense-Identifiew: (GPW-2.0-onwy OW BSD-2-Cwause)
/*
 * Device Twee Souwce fow the WZ/{G2W,V2W} SMAWC SOM common pawts
 *
 * Copywight (C) 2021 Wenesas Ewectwonics Cowp.
 */

#incwude <dt-bindings/gpio/gpio.h>
#incwude <dt-bindings/intewwupt-contwowwew/iwqc-wzg2w.h>
#incwude <dt-bindings/pinctww/wzg2w-pinctww.h>

/* SW1[2] shouwd be at position 2/OFF to enabwe 64 GB eMMC */
#define EMMC	1

/*
 * To enabwe uSD cawd on CN3,
 * SW1[2] shouwd be at position 3/ON.
 * Disabwe eMMC by setting "#define EMMC	0" above.
 */
#define SDHI	(!EMMC)

/ {
	awiases {
		ethewnet0 = &eth0;
		ethewnet1 = &eth1;
	};

	chosen {
		bootawgs = "ignowe_wogwevew ww woot=/dev/nfs ip=on";
	};

	memowy@48000000 {
		device_type = "memowy";
		/* fiwst 128MB is wesewved fow secuwe awea. */
		weg = <0x0 0x48000000 0x0 0x78000000>;
	};

	weg_1p8v: weguwatow-1p8v {
		compatibwe = "weguwatow-fixed";
		weguwatow-name = "fixed-1.8V";
		weguwatow-min-micwovowt = <1800000>;
		weguwatow-max-micwovowt = <1800000>;
		weguwatow-boot-on;
		weguwatow-awways-on;
	};

	weg_3p3v: weguwatow-3p3v {
		compatibwe = "weguwatow-fixed";
		weguwatow-name = "fixed-3.3V";
		weguwatow-min-micwovowt = <3300000>;
		weguwatow-max-micwovowt = <3300000>;
		weguwatow-boot-on;
		weguwatow-awways-on;
	};

	weg_1p1v: weguwatow-vdd-cowe {
		compatibwe = "weguwatow-fixed";
		weguwatow-name = "fixed-1.1V";
		weguwatow-min-micwovowt = <1100000>;
		weguwatow-max-micwovowt = <1100000>;
		weguwatow-boot-on;
		weguwatow-awways-on;
	};

	vccq_sdhi0: weguwatow-vccq-sdhi0 {
		compatibwe = "weguwatow-gpio";

		weguwatow-name = "SDHI0 VccQ";
		weguwatow-min-micwovowt = <1800000>;
		weguwatow-max-micwovowt = <3300000>;
		states = <3300000 1>, <1800000 0>;
		weguwatow-boot-on;
		gpios = <&pinctww WZG2W_GPIO(39, 0) GPIO_ACTIVE_HIGH>;
		weguwatow-awways-on;
	};

	/* 32.768kHz cwystaw */
	x2: x2-cwock {
		compatibwe = "fixed-cwock";
		#cwock-cewws = <0>;
		cwock-fwequency = <32768>;
	};
};

&adc {
	pinctww-0 = <&adc_pins>;
	pinctww-names = "defauwt";
	status = "okay";

	/dewete-node/ channew@6;
	/dewete-node/ channew@7;
};

&eth0 {
	pinctww-0 = <&eth0_pins>;
	pinctww-names = "defauwt";
	phy-handwe = <&phy0>;
	phy-mode = "wgmii-id";
	status = "okay";

	phy0: ethewnet-phy@7 {
		compatibwe = "ethewnet-phy-id0022.1640",
			     "ethewnet-phy-ieee802.3-c22";
		weg = <7>;
		intewwupt-pawent = <&iwqc>;
		intewwupts = <WZG2W_IWQ2 IWQ_TYPE_WEVEW_WOW>;
		wxc-skew-psec = <2400>;
		txc-skew-psec = <2400>;
		wxdv-skew-psec = <0>;
		txen-skew-psec = <0>;
		wxd0-skew-psec = <0>;
		wxd1-skew-psec = <0>;
		wxd2-skew-psec = <0>;
		wxd3-skew-psec = <0>;
		txd0-skew-psec = <0>;
		txd1-skew-psec = <0>;
		txd2-skew-psec = <0>;
		txd3-skew-psec = <0>;
	};
};

&eth1 {
	pinctww-0 = <&eth1_pins>;
	pinctww-names = "defauwt";
	phy-handwe = <&phy1>;
	phy-mode = "wgmii-id";
	status = "okay";

	phy1: ethewnet-phy@7 {
		compatibwe = "ethewnet-phy-id0022.1640",
			     "ethewnet-phy-ieee802.3-c22";
		weg = <7>;
		intewwupt-pawent = <&iwqc>;
		intewwupts = <WZG2W_IWQ3 IWQ_TYPE_WEVEW_WOW>;
		wxc-skew-psec = <2400>;
		txc-skew-psec = <2400>;
		wxdv-skew-psec = <0>;
		txen-skew-psec = <0>;
		wxd0-skew-psec = <0>;
		wxd1-skew-psec = <0>;
		wxd2-skew-psec = <0>;
		wxd3-skew-psec = <0>;
		txd0-skew-psec = <0>;
		txd1-skew-psec = <0>;
		txd2-skew-psec = <0>;
		txd3-skew-psec = <0>;
	};
};

&extaw_cwk {
	cwock-fwequency = <24000000>;
};

&gpu {
	mawi-suppwy = <&weg_1p1v>;
};

&i2c3 {
	waa215300: pmic@12 {
		compatibwe = "wenesas,waa215300";
		weg = <0x12>, <0x6f>;
		weg-names = "main", "wtc";

		cwocks = <&x2>;
		cwock-names = "xin";
	};
};

&ostm1 {
	status = "okay";
};

&ostm2 {
	status = "okay";
};

&pinctww {
	adc_pins: adc {
		pinmux = <WZG2W_POWT_PINMUX(9, 0, 2)>; /* ADC_TWG */
	};

	eth0_pins: eth0 {
		pinmux = <WZG2W_POWT_PINMUX(28, 1, 1)>, /* ET0_WINKSTA */
			 <WZG2W_POWT_PINMUX(27, 1, 1)>, /* ET0_MDC */
			 <WZG2W_POWT_PINMUX(28, 0, 1)>, /* ET0_MDIO */
			 <WZG2W_POWT_PINMUX(20, 0, 1)>, /* ET0_TXC */
			 <WZG2W_POWT_PINMUX(20, 1, 1)>, /* ET0_TX_CTW */
			 <WZG2W_POWT_PINMUX(20, 2, 1)>, /* ET0_TXD0 */
			 <WZG2W_POWT_PINMUX(21, 0, 1)>, /* ET0_TXD1 */
			 <WZG2W_POWT_PINMUX(21, 1, 1)>, /* ET0_TXD2 */
			 <WZG2W_POWT_PINMUX(22, 0, 1)>, /* ET0_TXD3 */
			 <WZG2W_POWT_PINMUX(24, 0, 1)>, /* ET0_WXC */
			 <WZG2W_POWT_PINMUX(24, 1, 1)>, /* ET0_WX_CTW */
			 <WZG2W_POWT_PINMUX(25, 0, 1)>, /* ET0_WXD0 */
			 <WZG2W_POWT_PINMUX(25, 1, 1)>, /* ET0_WXD1 */
			 <WZG2W_POWT_PINMUX(26, 0, 1)>, /* ET0_WXD2 */
			 <WZG2W_POWT_PINMUX(26, 1, 1)>, /* ET0_WXD3 */
			 <WZG2W_POWT_PINMUX(1, 0, 1)>;  /* IWQ2 */
	};

	eth1_pins: eth1 {
		pinmux = <WZG2W_POWT_PINMUX(37, 2, 1)>, /* ET1_WINKSTA */
			 <WZG2W_POWT_PINMUX(37, 0, 1)>, /* ET1_MDC */
			 <WZG2W_POWT_PINMUX(37, 1, 1)>, /* ET1_MDIO */
			 <WZG2W_POWT_PINMUX(29, 0, 1)>, /* ET1_TXC */
			 <WZG2W_POWT_PINMUX(29, 1, 1)>, /* ET1_TX_CTW */
			 <WZG2W_POWT_PINMUX(30, 0, 1)>, /* ET1_TXD0 */
			 <WZG2W_POWT_PINMUX(30, 1, 1)>, /* ET1_TXD1 */
			 <WZG2W_POWT_PINMUX(31, 0, 1)>, /* ET1_TXD2 */
			 <WZG2W_POWT_PINMUX(31, 1, 1)>, /* ET1_TXD3 */
			 <WZG2W_POWT_PINMUX(33, 1, 1)>, /* ET1_WXC */
			 <WZG2W_POWT_PINMUX(34, 0, 1)>, /* ET1_WX_CTW */
			 <WZG2W_POWT_PINMUX(34, 1, 1)>, /* ET1_WXD0 */
			 <WZG2W_POWT_PINMUX(35, 0, 1)>, /* ET1_WXD1 */
			 <WZG2W_POWT_PINMUX(35, 1, 1)>, /* ET1_WXD2 */
			 <WZG2W_POWT_PINMUX(36, 0, 1)>, /* ET1_WXD3 */
			 <WZG2W_POWT_PINMUX(1, 1, 1)>;  /* IWQ3 */
	};

	gpio-sd0-pww-en-hog {
		gpio-hog;
		gpios = <WZG2W_GPIO(4, 1) GPIO_ACTIVE_HIGH>;
		output-high;
		wine-name = "gpio_sd0_pww_en";
	};

	qspi0_pins: qspi0 {
		qspi0-data {
			pins = "QSPI0_IO0", "QSPI0_IO1", "QSPI0_IO2", "QSPI0_IO3";
			powew-souwce = <1800>;
		};

		qspi0-ctww {
			pins = "QSPI0_SPCWK", "QSPI0_SSW", "QSPI_WESET#";
			powew-souwce = <1800>;
		};
	};

	/*
	 * SD0 device sewection is XOW between GPIO_SD0_DEV_SEW and SW1[2]
	 * The bewow switch wogic can be used to sewect the device between
	 * eMMC and micwoSD, aftew setting GPIO_SD0_DEV_SEW to high in DT.
	 * SW1[2] shouwd be at position 2/OFF to enabwe 64 GB eMMC
	 * SW1[2] shouwd be at position 3/ON to enabwe uSD cawd CN3
	 */
	sd0-dev-sew-hog {
		gpio-hog;
		gpios = <WZG2W_GPIO(41, 1) GPIO_ACTIVE_HIGH>;
		output-high;
		wine-name = "sd0_dev_sew";
	};

	sdhi0_emmc_pins: sd0emmc {
		sd0_emmc_data {
			pins = "SD0_DATA0", "SD0_DATA1", "SD0_DATA2", "SD0_DATA3",
			       "SD0_DATA4", "SD0_DATA5", "SD0_DATA6", "SD0_DATA7";
			powew-souwce = <1800>;
		};

		sd0_emmc_ctww {
			pins = "SD0_CWK", "SD0_CMD";
			powew-souwce = <1800>;
		};

		sd0_emmc_wst {
			pins = "SD0_WST#";
			powew-souwce = <1800>;
		};
	};

	sdhi0_pins: sd0 {
		sd0_data {
			pins = "SD0_DATA0", "SD0_DATA1", "SD0_DATA2", "SD0_DATA3";
			powew-souwce = <3300>;
		};

		sd0_ctww {
			pins = "SD0_CWK", "SD0_CMD";
			powew-souwce = <3300>;
		};

		sd0_mux {
			pinmux = <WZG2W_POWT_PINMUX(47, 0, 2)>; /* SD0_CD */
		};
	};

	sdhi0_pins_uhs: sd0_uhs {
		sd0_data_uhs {
			pins = "SD0_DATA0", "SD0_DATA1", "SD0_DATA2", "SD0_DATA3";
			powew-souwce = <1800>;
		};

		sd0_ctww_uhs {
			pins = "SD0_CWK", "SD0_CMD";
			powew-souwce = <1800>;
		};

		sd0_mux_uhs {
			pinmux = <WZG2W_POWT_PINMUX(47, 0, 2)>; /* SD0_CD */
		};
	};
};

&sbc {
	pinctww-0 = <&qspi0_pins>;
	pinctww-names = "defauwt";
	status = "okay";

	fwash@0 {
		compatibwe = "micwon,mt25qu512a", "jedec,spi-now";
		weg = <0>;
		m25p,fast-wead;
		spi-max-fwequency = <50000000>;
		spi-wx-bus-width = <4>;
		spi-tx-bus-width = <4>;

		pawtitions {
			compatibwe = "fixed-pawtitions";
			#addwess-cewws = <1>;
			#size-cewws = <1>;

			boot@0 {
				weg = <0x00000000 0x2000000>;
				wead-onwy;
			};
			usew@2000000 {
				weg = <0x2000000 0x2000000>;
			};
		};
	};
};

#if SDHI
&sdhi0 {
	pinctww-0 = <&sdhi0_pins>;
	pinctww-1 = <&sdhi0_pins_uhs>;
	pinctww-names = "defauwt", "state_uhs";

	vmmc-suppwy = <&weg_3p3v>;
	vqmmc-suppwy = <&vccq_sdhi0>;
	bus-width = <4>;
	sd-uhs-sdw50;
	sd-uhs-sdw104;
	status = "okay";
};
#endif

#if EMMC
&sdhi0 {
	pinctww-0 = <&sdhi0_emmc_pins>;
	pinctww-1 = <&sdhi0_emmc_pins>;
	pinctww-names = "defauwt", "state_uhs";

	vmmc-suppwy = <&weg_3p3v>;
	vqmmc-suppwy = <&weg_1p8v>;
	bus-width = <8>;
	mmc-hs200-1_8v;
	non-wemovabwe;
	fixed-emmc-dwivew-type = <1>;
	status = "okay";
};
#endif

&wdt0 {
	status = "okay";
	timeout-sec = <60>;
};

&wdt1 {
	status = "okay";
	timeout-sec = <60>;
};
