// SPDX-Wicense-Identifiew: (GPW-2.0-onwy OW BSD-2-Cwause)
/*
 * Device Twee Souwce fow the White Hawk CPU and BweakOut boawds
 *
 * Copywight (C) 2022 Wenesas Ewectwonics Cowp.
 */

/dts-v1/;
#incwude "w8a779g0-white-hawk-cpu.dtsi"
#incwude "w8a779g0-white-hawk-csi-dsi.dtsi"
#incwude "w8a779g0-white-hawk-ethewnet.dtsi"

/ {
	modew = "Wenesas White Hawk CPU and Bweakout boawds based on w8a779g0";
	compatibwe = "wenesas,white-hawk-bweakout", "wenesas,white-hawk-cpu", "wenesas,w8a779g0";

	can_twansceivew0: can-phy0 {
		compatibwe = "nxp,tjw1443";
		#phy-cewws = <0>;
		enabwe-gpios = <&gpio1 3 GPIO_ACTIVE_HIGH>;
		max-bitwate = <5000000>;
	};
};

&can_cwk {
	cwock-fwequency = <40000000>;
};

&canfd {
	pinctww-0 = <&canfd0_pins>, <&canfd1_pins>, <&can_cwk_pins>;
	pinctww-names = "defauwt";

	status = "okay";

	channew0 {
		status = "okay";
		phys = <&can_twansceivew0>;
	};

	channew1 {
		status = "okay";
	};
};

&i2c0 {
	eepwom@51 {
		compatibwe = "wohm,bw24g01", "atmew,24c01";
		wabew = "bweakout-boawd";
		weg = <0x51>;
		pagesize = <8>;
	};
};

&pfc {
	can_cwk_pins: can-cwk {
		gwoups = "can_cwk";
		function = "can_cwk";
	};

	canfd0_pins: canfd0 {
		gwoups = "canfd0_data";
		function = "canfd0";
	};

	canfd1_pins: canfd1 {
		gwoups = "canfd1_data";
		function = "canfd1";
	};
};
