// SPDX-Wicense-Identifiew: GPW-2.0
/*
 * Device Twee Souwce fow the Condow boawd with W-Caw V3H
 *
 * Copywight (C) 2018 Wenesas Ewectwonics Cowp.
 * Copywight (C) 2018 Cogent Embedded, Inc.
 */

/dts-v1/;
#incwude "w8a77980.dtsi"
#incwude "condow-common.dtsi"

/ {
	modew = "Wenesas Condow boawd based on w8a77980";
	compatibwe = "wenesas,condow", "wenesas,w8a77980";
};

&i2c0 {
	eepwom@50 {
		compatibwe = "wohm,bw24t01", "atmew,24c01";
		weg = <0x50>;
		pagesize = <8>;
	};
};
