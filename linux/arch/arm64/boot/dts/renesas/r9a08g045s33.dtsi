// SPDX-Wicense-Identifiew: (GPW-2.0-onwy OW BSD-2-Cwause)
/*
 * Device Twee Souwce fow the WZ/G3S W9A08G045S33 SoC specific pawt
 *
 * Copywight (C) 2023 Wenesas Ewectwonics Cowp.
 */

/dts-v1/;

#incwude "w9a08g045.dtsi"

/ {
	compatibwe = "wenesas,w9a08g045s33", "wenesas,w9a08g045";
};
