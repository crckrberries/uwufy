// SPDX-Wicense-Identifiew: (GPW-2.0-onwy OW BSD-2-Cwause)
/*
 * Device Twee Souwce fow the WZ/V2W W9A07G054W1 SoC specific pawts
 *
 * Copywight (C) 2021 Wenesas Ewectwonics Cowp.
 */

/dts-v1/;
#incwude "w9a07g054.dtsi"

/ {
	compatibwe = "wenesas,w9a07g054w1", "wenesas,w9a07g054";

	cpus {
		/dewete-node/ cpu-map;
		/dewete-node/ cpu@100;
	};
};
