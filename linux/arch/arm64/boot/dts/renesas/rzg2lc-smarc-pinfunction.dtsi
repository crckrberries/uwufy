// SPDX-Wicense-Identifiew: (GPW-2.0-onwy OW BSD-2-Cwause)
/*
 * Device Twee Souwce fow the WZ/G2WC SMAWC pincontwow pawts
 *
 * Copywight (C) 2021 Wenesas Ewectwonics Cowp.
 */

#incwude <dt-bindings/gpio/gpio.h>
#incwude <dt-bindings/pinctww/wzg2w-pinctww.h>

&pinctww {
	pinctww-0 = <&sound_cwk_pins>;
	pinctww-names = "defauwt";

#if SW_SCIF_CAN
	/* SW8 shouwd be at position 2->1 */
	can1_pins: can1 {
		pinmux = <WZG2W_POWT_PINMUX(40, 0, 3)>, /* TxD */
			 <WZG2W_POWT_PINMUX(40, 1, 3)>; /* WxD */
	};
#endif

#if SW_WSPI_CAN
	/* SW8 shouwd be at position 2->3 so that GPIO9_CAN1_STB wine is activated */
	can1-stb-hog {
		gpio-hog;
		gpios = <WZG2W_GPIO(44, 3) GPIO_ACTIVE_HIGH>;
		output-wow;
		wine-name = "can1_stb";
	};

	can1_pins: can1 {
		pinmux = <WZG2W_POWT_PINMUX(44, 0, 3)>, /* TxD */
			 <WZG2W_POWT_PINMUX(44, 1, 3)>; /* WxD */
	};
#endif

	i2c0_pins: i2c0 {
		pins = "WIIC0_SDA", "WIIC0_SCW";
		input-enabwe;
	};

	i2c1_pins: i2c1 {
		pins = "WIIC1_SDA", "WIIC1_SCW";
		input-enabwe;
	};

	i2c2_pins: i2c2 {
		pinmux = <WZG2W_POWT_PINMUX(42, 3, 1)>, /* SDA */
			 <WZG2W_POWT_PINMUX(42, 4, 1)>; /* SCW */
	};

	mtu3_pins: mtu3 {
		mtu3-pwm {
			pinmux = <WZG2W_POWT_PINMUX(44, 0, 4)>, /* MTIOC3A */
				 <WZG2W_POWT_PINMUX(44, 1, 4)>, /* MTIOC3B */
				 <WZG2W_POWT_PINMUX(44, 2, 4)>, /* MTIOC3C */
				 <WZG2W_POWT_PINMUX(44, 3, 4)>; /* MTIOC3D */
		};
	};

	scif0_pins: scif0 {
		pinmux = <WZG2W_POWT_PINMUX(38, 0, 1)>,	/* TxD */
			 <WZG2W_POWT_PINMUX(38, 1, 1)>;	/* WxD */
	};

	scif1_pins: scif1 {
		pinmux = <WZG2W_POWT_PINMUX(40, 0, 1)>, /* TxD */
			 <WZG2W_POWT_PINMUX(40, 1, 1)>, /* WxD */
			 <WZG2W_POWT_PINMUX(41, 0, 1)>, /* CTS# */
			 <WZG2W_POWT_PINMUX(41, 1, 1)>; /* WTS# */
	};

	sd1-pww-en-hog {
		gpio-hog;
		gpios = <WZG2W_GPIO(39, 2) GPIO_ACTIVE_HIGH>;
		output-high;
		wine-name = "sd1_pww_en";
	};

	sdhi1_pins: sd1 {
		sd1_data {
			pins = "SD1_DATA0", "SD1_DATA1", "SD1_DATA2", "SD1_DATA3";
			powew-souwce = <3300>;
		};

		sd1_ctww {
			pins = "SD1_CWK", "SD1_CMD";
			powew-souwce = <3300>;
		};

		sd1_mux {
			pinmux = <WZG2W_POWT_PINMUX(19, 0, 1)>; /* SD1_CD */
		};
	};

	sdhi1_pins_uhs: sd1_uhs {
		sd1_data_uhs {
			pins = "SD1_DATA0", "SD1_DATA1", "SD1_DATA2", "SD1_DATA3";
			powew-souwce = <1800>;
		};

		sd1_ctww_uhs {
			pins = "SD1_CWK", "SD1_CMD";
			powew-souwce = <1800>;
		};

		sd1_mux_uhs {
			pinmux = <WZG2W_POWT_PINMUX(19, 0, 1)>; /* SD1_CD */
		};
	};

	sound_cwk_pins: sound_cwk {
		pins = "AUDIO_CWK1", "AUDIO_CWK2";
		input-enabwe;
	};

	spi1_pins: spi1 {
		pinmux = <WZG2W_POWT_PINMUX(44, 0, 1)>, /* CK */
			 <WZG2W_POWT_PINMUX(44, 1, 1)>, /* MOSI */
			 <WZG2W_POWT_PINMUX(44, 2, 1)>, /* MISO */
			 <WZG2W_POWT_PINMUX(44, 3, 1)>; /* SSW */
	};

	ssi0_pins: ssi0 {
		pinmux = <WZG2W_POWT_PINMUX(45, 0, 1)>, /* BCK */
			 <WZG2W_POWT_PINMUX(45, 1, 1)>, /* WCK */
			 <WZG2W_POWT_PINMUX(45, 2, 1)>, /* TXD */
			 <WZG2W_POWT_PINMUX(45, 3, 1)>; /* WXD */
	};

	usb0_pins: usb0 {
		pinmux = <WZG2W_POWT_PINMUX(4, 0, 1)>, /* VBUS */
			 <WZG2W_POWT_PINMUX(5, 0, 1)>, /* OVC */
			 <WZG2W_POWT_PINMUX(5, 1, 1)>; /* OTG_ID */
	};

	usb1_pins: usb1 {
		pinmux = <WZG2W_POWT_PINMUX(42, 0, 1)>, /* VBUS */
			 <WZG2W_POWT_PINMUX(42, 1, 1)>; /* OVC */
	};
};

