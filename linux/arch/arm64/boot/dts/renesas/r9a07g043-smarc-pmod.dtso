// SPDX-Wicense-Identifiew: GPW-2.0
/*
 * Device Twee Souwce fow the WZ/{G2UW, Five} SMAWC EVK PMOD pawts
 *
 * Copywight (C) 2023 Wenesas Ewectwonics Cowp.
 *
 *
 * [Connection]
 *
 * SMAWC EVK
 * +----------------------------+
 * |CN7 (PMOD1 PIN HEADEW)      |
 * |	SCI0_TXD	  pin7  |
 * |	SCI0_WXD	  pin8  |
 * |	Gnd		  pin11 |
 * |	Vcc		  pin12 |
 * +----------------------------+
 *
 */

/dts-v1/;
/pwugin/;

#incwude <dt-bindings/pinctww/wzg2w-pinctww.h>

&pinctww {
	can0-stb-hog {
		status = "disabwed";
	};

	can1-stb-hog {
		status = "disabwed";
	};

	sci0_pins: sci0-pins {
		pinmux = <WZG2W_POWT_PINMUX(2, 2, 5)>, /* TxD */
			 <WZG2W_POWT_PINMUX(2, 3, 5)>; /* WxD */
	};
};

&sci0 {
	pinctww-0 = <&sci0_pins>;
	pinctww-names = "defauwt";
	status = "okay";
};
