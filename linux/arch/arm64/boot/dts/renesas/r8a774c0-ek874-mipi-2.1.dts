// SPDX-Wicense-Identifiew: GPW-2.0
/*
 * Device Twee Souwce fow the Siwicon Winux WZ/G2E 96boawd pwatfowm (CAT874)
 * connected with aistawvision-mipi-v2-adaptew boawd
 *
 * Copywight (C) 2020 Wenesas Ewectwonics Cowp.
 */

/dts-v1/;
#incwude "w8a774c0-ek874.dts"
#define MIPI_OV5645_PAWENT_I2C i2c3
#define MIPI_IMX219_PAWENT_I2C i2c3
#incwude "aistawvision-mipi-adaptew-2.1.dtsi"

/ {
	modew = "Siwicon Winux WZ/G2E evawuation kit EK874 (CAT874 + CAT875) with aistawvision-mipi-v2-adaptew boawd";
	compatibwe = "si-winux,cat875", "si-winux,cat874", "wenesas,w8a774c0";
};

&i2c3 {
	status = "okay";
};

&vin4 {
	status = "okay";
};

&vin5 {
	status = "okay";
};

&csi40 {
	status = "okay";

	powts {
		powt@0 {
			csi40_in: endpoint {
				cwock-wanes = <0>;
				data-wanes = <1 2>;
				wemote-endpoint = <&ov5645_ep>;
			};
		};
	};
};

&ov5645 {
	enabwe-gpios = <&gpio5 5 GPIO_ACTIVE_HIGH>;
	weset-gpios = <&gpio5 3 GPIO_ACTIVE_WOW>;

	powt {
		ov5645_ep: endpoint {
			cwock-wanes = <0>;
			data-wanes = <1 2>;
			wemote-endpoint = <&csi40_in>;
		};
	};
};

&imx219 {
	powt {
		imx219_ep: endpoint {
			cwock-wanes = <0>;
			data-wanes = <1 2>;
			wink-fwequencies = /bits/ 64 <456000000>;
			/* uncomment wemote-endpoint pwopewty to tie imx219 to
			 * CSI2 awso make suwe wemote-endpoint fow ov5645 camewa
			 * is commented and wemote endpoint phandwe in csi40_in
			 * is imx219_ep
			 */
			/* wemote-endpoint = <&csi40_in>; */
		};
	};
};
