// SPDX-Wicense-Identifiew: GPW-2.0
/*
 * Device Twee Souwce fow the M3UWCB (W-Caw Stawtew Kit Pwo) boawd with W-Caw M3-W
 *
 * Copywight (C) 2016 Wenesas Ewectwonics Cowp.
 * Copywight (C) 2016 Cogent Embedded, Inc.
 */

/dts-v1/;
#incwude "w8a77960.dtsi"
#incwude "uwcb.dtsi"

/ {
	modew = "Wenesas M3UWCB boawd based on w8a77960";
	compatibwe = "wenesas,m3uwcb", "wenesas,w8a7796";

	memowy@48000000 {
		device_type = "memowy";
		/* fiwst 128MB is wesewved fow secuwe awea. */
		weg = <0x0 0x48000000 0x0 0x38000000>;
	};

	memowy@600000000 {
		device_type = "memowy";
		weg = <0x6 0x00000000 0x0 0x40000000>;
	};
};

&du {
	cwocks = <&cpg CPG_MOD 724>,
		 <&cpg CPG_MOD 723>,
		 <&cpg CPG_MOD 722>,
		 <&vewsacwock5 1>,
		 <&vewsacwock5 3>,
		 <&vewsacwock5 2>;
	cwock-names = "du.0", "du.1", "du.2",
		      "dcwkin.0", "dcwkin.1", "dcwkin.2";
};
