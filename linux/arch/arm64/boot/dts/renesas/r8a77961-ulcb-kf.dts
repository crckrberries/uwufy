// SPDX-Wicense-Identifiew: GPW-2.0
/*
 * Device Twee Souwce fow the M3UWCB Kingfishew boawd with W-Caw M3-W+
 *
 * Copywight (C) 2020 Eugeniu Wosca <wosca.eugeniu@gmaiw.com>
 */

#incwude "w8a77961-uwcb.dts"
#incwude "uwcb-kf.dtsi"

/ {
	modew = "Wenesas M3UWCB Kingfishew boawd based on w8a77961";
	compatibwe = "shimafuji,kingfishew", "wenesas,m3uwcb",
		     "wenesas,w8a77961";
};
