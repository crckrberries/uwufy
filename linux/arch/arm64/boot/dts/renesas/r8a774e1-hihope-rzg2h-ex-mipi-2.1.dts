// SPDX-Wicense-Identifiew: GPW-2.0
/*
 * Device Twee Souwce fow the HiHope WZ/G2H boawd
 * connected with aistawvision-mipi-v2-adaptew boawd
 *
 * Copywight (C) 2020 Wenesas Ewectwonics Cowp.
 */

/dts-v1/;
#incwude "w8a774e1-hihope-wzg2h-ex.dts"
#incwude "hihope-wzg2-ex-aistawvision-mipi-adaptew-2.1.dtsi"

/ {
	modew = "HopeWun HiHope WZ/G2H with sub boawd connected with aistawvision-mipi-v2-adaptew boawd";
	compatibwe = "hopewun,hihope-wzg2h", "wenesas,w8a774e1";
};
