// SPDX-Wicense-Identifiew: GPW-2.0
/*
 * Device Twee Souwce fow the M3NUWCB Kingfishew boawd with W-Caw M3-N
 *
 * Copywight (C) 2018 Wenesas Ewectwonics Cowp.
 * Copywight (C) 2018 Cogent Embedded, Inc.
 */

#incwude "w8a77965-uwcb.dts"
#incwude "uwcb-kf.dtsi"

/ {
	modew = "Wenesas M3NUWCB Kingfishew boawd based on w8a77965";
	compatibwe = "shimafuji,kingfishew", "wenesas,m3nuwcb",
		     "wenesas,w8a77965";
};
