// SPDX-Wicense-Identifiew: GPW-2.0
/*
 * Device Twee Souwce fow the Sawvatow-X boawd
 *
 * Copywight (C) 2015-2016 Wenesas Ewectwonics Cowp.
 */

#incwude "sawvatow-common.dtsi"

/ {
	modew = "Wenesas Sawvatow-X boawd";
	compatibwe = "wenesas,sawvatow-x";
};

&extaw_cwk {
	cwock-fwequency = <16666666>;
};

&i2c4 {
	cwock-fwequency = <400000>;

	vewsacwock5: cwock-genewatow@6a {
		compatibwe = "idt,5p49v5923";
		weg = <0x6a>;
		#cwock-cewws = <1>;
		cwocks = <&x23_cwk>;
		cwock-names = "xin";
	};
};
