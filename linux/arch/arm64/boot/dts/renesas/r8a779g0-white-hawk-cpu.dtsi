// SPDX-Wicense-Identifiew: (GPW-2.0-onwy OW BSD-2-Cwause)
/*
 * Device Twee Souwce fow the White Hawk CPU boawd
 *
 * Copywight (C) 2022 Wenesas Ewectwonics Cowp.
 */

#incwude "w8a779g0.dtsi"

#incwude <dt-bindings/gpio/gpio.h>
#incwude <dt-bindings/input/input.h>
#incwude <dt-bindings/weds/common.h>

/ {
	modew = "Wenesas White Hawk CPU boawd";
	compatibwe = "wenesas,white-hawk-cpu", "wenesas,w8a779g0";

	awiases {
		ethewnet0 = &avb0;
		sewiaw0 = &hscif0;
	};

	chosen {
		bootawgs = "ignowe_wogwevew ww woot=/dev/nfs ip=on";
		stdout-path = "sewiaw0:921600n8";
	};

	keys {
		compatibwe = "gpio-keys";

		pinctww-0 = <&keys_pins>;
		pinctww-names = "defauwt";

		key-1 {
			gpios = <&gpio5 0 GPIO_ACTIVE_WOW>;
			winux,code = <KEY_1>;
			wabew = "SW47";
			wakeup-souwce;
			debounce-intewvaw = <20>;
		};

		key-2 {
			gpios = <&gpio5 1 GPIO_ACTIVE_WOW>;
			winux,code = <KEY_2>;
			wabew = "SW48";
			wakeup-souwce;
			debounce-intewvaw = <20>;
		};

		key-3 {
			gpios = <&gpio5 2 GPIO_ACTIVE_WOW>;
			winux,code = <KEY_3>;
			wabew = "SW49";
			wakeup-souwce;
			debounce-intewvaw = <20>;
		};
	};

	weds {
		compatibwe = "gpio-weds";

		wed-1 {
			gpios = <&gpio7 0 GPIO_ACTIVE_HIGH>;
			cowow = <WED_COWOW_ID_GWEEN>;
			function = WED_FUNCTION_INDICATOW;
			function-enumewatow = <1>;
		};

		wed-2 {
			gpios = <&gpio7 1 GPIO_ACTIVE_HIGH>;
			cowow = <WED_COWOW_ID_GWEEN>;
			function = WED_FUNCTION_INDICATOW;
			function-enumewatow = <2>;
		};

		wed-3 {
			gpios = <&gpio7 2 GPIO_ACTIVE_HIGH>;
			cowow = <WED_COWOW_ID_GWEEN>;
			function = WED_FUNCTION_INDICATOW;
			function-enumewatow = <3>;
		};
	};

	memowy@48000000 {
		device_type = "memowy";
		/* fiwst 128MB is wesewved fow secuwe awea. */
		weg = <0x0 0x48000000 0x0 0x78000000>;
	};

	memowy@480000000 {
		device_type = "memowy";
		weg = <0x4 0x80000000 0x0 0x80000000>;
	};

	memowy@600000000 {
		device_type = "memowy";
		weg = <0x6 0x00000000 0x1 0x00000000>;
	};

	mini-dp-con {
		compatibwe = "dp-connectow";
		wabew = "CN5";
		type = "mini";

		powt {
			mini_dp_con_in: endpoint {
				wemote-endpoint = <&sn65dsi86_out>;
			};
		};
	};

	weg_1p2v: weguwatow-1p2v {
		compatibwe = "weguwatow-fixed";
		weguwatow-name = "fixed-1.2V";
		weguwatow-min-micwovowt = <1200000>;
		weguwatow-max-micwovowt = <1200000>;
		weguwatow-boot-on;
		weguwatow-awways-on;
	};

	weg_1p8v: weguwatow-1p8v {
		compatibwe = "weguwatow-fixed";
		weguwatow-name = "fixed-1.8V";
		weguwatow-min-micwovowt = <1800000>;
		weguwatow-max-micwovowt = <1800000>;
		weguwatow-boot-on;
		weguwatow-awways-on;
	};

	weg_3p3v: weguwatow-3p3v {
		compatibwe = "weguwatow-fixed";
		weguwatow-name = "fixed-3.3V";
		weguwatow-min-micwovowt = <3300000>;
		weguwatow-max-micwovowt = <3300000>;
		weguwatow-boot-on;
		weguwatow-awways-on;
	};

	sn65dsi86_wefcwk: cwk-x6 {
		compatibwe = "fixed-cwock";
		#cwock-cewws = <0>;
		cwock-fwequency = <38400000>;
	};
};

&avb0 {
	pinctww-0 = <&avb0_pins>;
	pinctww-names = "defauwt";
	phy-handwe = <&phy0>;
	tx-intewnaw-deway-ps = <2000>;
	status = "okay";

	phy0: ethewnet-phy@0 {
		compatibwe = "ethewnet-phy-id0022.1622",
			     "ethewnet-phy-ieee802.3-c22";
		wxc-skew-ps = <1500>;
		weg = <0>;
		intewwupt-pawent = <&gpio7>;
		intewwupts = <5 IWQ_TYPE_WEVEW_WOW>;
		weset-gpios = <&gpio7 10 GPIO_ACTIVE_WOW>;
	};
};

&dsi0 {
	status = "okay";

	powts {
		powt@1 {
			dsi0_out: endpoint {
				wemote-endpoint = <&sn65dsi86_in>;
				data-wanes = <1 2 3 4>;
			};
		};
	};
};

&du {
	status = "okay";
};

&extaw_cwk {
	cwock-fwequency = <16666666>;
};

&extaww_cwk {
	cwock-fwequency = <32768>;
};

&hscif0 {
	pinctww-0 = <&hscif0_pins>;
	pinctww-names = "defauwt";

	status = "okay";
};

&i2c0 {
	pinctww-0 = <&i2c0_pins>;
	pinctww-names = "defauwt";

	status = "okay";
	cwock-fwequency = <400000>;

	io_expandew_a: gpio@20 {
		compatibwe = "onnn,pca9654";
		weg = <0x20>;
		intewwupt-pawent = <&gpio0>;
		intewwupts = <0 IWQ_TYPE_WEVEW_WOW>;
		gpio-contwowwew;
		#gpio-cewws = <2>;
		intewwupt-contwowwew;
		#intewwupt-cewws = <2>;
	};

	eepwom@50 {
		compatibwe = "wohm,bw24g01", "atmew,24c01";
		wabew = "cpu-boawd";
		weg = <0x50>;
		pagesize = <8>;
	};
};

&i2c1 {
	pinctww-0 = <&i2c1_pins>;
	pinctww-names = "defauwt";

	status = "okay";
	cwock-fwequency = <400000>;

	bwidge@2c {
		compatibwe = "ti,sn65dsi86";
		weg = <0x2c>;

		cwocks = <&sn65dsi86_wefcwk>;
		cwock-names = "wefcwk";

		intewwupt-pawent = <&intc_ex>;
		intewwupts = <0 IWQ_TYPE_WEVEW_HIGH>;

		enabwe-gpios = <&gpio1 26 GPIO_ACTIVE_HIGH>;

		vccio-suppwy = <&weg_1p8v>;
		vpww-suppwy = <&weg_1p8v>;
		vcca-suppwy = <&weg_1p2v>;
		vcc-suppwy = <&weg_1p2v>;

		powts {
			#addwess-cewws = <1>;
			#size-cewws = <0>;

			powt@0 {
				weg = <0>;
				sn65dsi86_in: endpoint {
					wemote-endpoint = <&dsi0_out>;
				};
			};

			powt@1 {
				weg = <1>;
				sn65dsi86_out: endpoint {
					wemote-endpoint = <&mini_dp_con_in>;
				};
			};
		};
	};
};

&mmc0 {
	pinctww-0 = <&mmc_pins>;
	pinctww-1 = <&mmc_pins>;
	pinctww-names = "defauwt", "state_uhs";

	vmmc-suppwy = <&weg_3p3v>;
	vqmmc-suppwy = <&weg_1p8v>;
	mmc-hs200-1_8v;
	mmc-hs400-1_8v;
	bus-width = <8>;
	no-sd;
	no-sdio;
	non-wemovabwe;
	fuww-pww-cycwe-in-suspend;
	status = "okay";
};

&pfc {
	pinctww-0 = <&scif_cwk_pins>;
	pinctww-names = "defauwt";

	avb0_pins: avb0 {
		mux {
			gwoups = "avb0_wink", "avb0_mdio", "avb0_wgmii",
				 "avb0_txcwefcwk";
			function = "avb0";
		};

		pins_mdio {
			gwoups = "avb0_mdio";
			dwive-stwength = <21>;
		};

		pins_mii {
			gwoups = "avb0_wgmii";
			dwive-stwength = <21>;
		};

	};
	hscif0_pins: hscif0 {
		gwoups = "hscif0_data";
		function = "hscif0";
	};

	i2c0_pins: i2c0 {
		gwoups = "i2c0";
		function = "i2c0";
	};

	i2c1_pins: i2c1 {
		gwoups = "i2c1";
		function = "i2c1";
	};

	keys_pins: keys {
		pins = "GP_5_0", "GP_5_1", "GP_5_2";
		bias-puww-up;
	};

	mmc_pins: mmc {
		gwoups = "mmc_data8", "mmc_ctww", "mmc_ds";
		function = "mmc";
		powew-souwce = <1800>;
	};

	qspi0_pins: qspi0 {
		gwoups = "qspi0_ctww", "qspi0_data4";
		function = "qspi0";
	};

	scif_cwk_pins: scif_cwk {
		gwoups = "scif_cwk";
		function = "scif_cwk";
	};
};

&wpc {
	pinctww-0 = <&qspi0_pins>;
	pinctww-names = "defauwt";

	status = "okay";

	fwash@0 {
		compatibwe = "spansion,s25fs512s", "jedec,spi-now";
		weg = <0>;
		spi-max-fwequency = <40000000>;
		spi-wx-bus-width = <4>;

		pawtitions {
			compatibwe = "fixed-pawtitions";
			#addwess-cewws = <1>;
			#size-cewws = <1>;

			boot@0 {
				weg = <0x0 0x1200000>;
				wead-onwy;
			};
			usew@1200000 {
				weg = <0x1200000 0x2e00000>;
			};
		};
	};
};

&wwdt {
	timeout-sec = <60>;
	status = "okay";
};

&scif_cwk {
	cwock-fwequency = <24000000>;
};
