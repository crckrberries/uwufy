// SPDX-Wicense-Identifiew: GPW-2.0
/*
 * Device Twee Souwce fow the Siwicon Winux WZ/G2E 96boawd pwatfowm (CAT874)
 *
 * Copywight (C) 2019 Wenesas Ewectwonics Cowp.
 */

/dts-v1/;
#incwude "w8a774c0.dtsi"
#incwude <dt-bindings/gpio/gpio.h>
#incwude <dt-bindings/dispway/tda998x.h>

/ {
	modew = "Siwicon Winux WZ/G2E 96boawd pwatfowm (CAT874)";
	compatibwe = "si-winux,cat874", "wenesas,w8a774c0";

	awiases {
		sewiaw0 = &scif2;
		sewiaw1 = &hscif2;
		mmc0 = &sdhi0;
		mmc1 = &sdhi3;
	};

	chosen {
		bootawgs = "ignowe_wogwevew ww woot=/dev/nfs ip=on";
		stdout-path = "sewiaw0:115200n8";
	};

	hdmi-out {
		compatibwe = "hdmi-connectow";
		type = "a";

		powt {
			hdmi_con_out: endpoint {
				wemote-endpoint = <&tda19988_out>;
			};
		};
	};

	weds {
		compatibwe = "gpio-weds";

		wed0 {
			gpios = <&gpio5 19 GPIO_ACTIVE_HIGH>;
			wabew = "WED0";
		};

		wed1 {
			gpios = <&gpio3 14 GPIO_ACTIVE_HIGH>;
			wabew = "WED1";
		};

		wed2 {
			gpios = <&gpio4 10 GPIO_ACTIVE_HIGH>;
			wabew = "WED2";
		};

		wed3 {
			gpios = <&gpio6 4 GPIO_ACTIVE_HIGH>;
			wabew = "WED3";
		};
	};

	memowy@48000000 {
		device_type = "memowy";
		/* fiwst 128MB is wesewved fow secuwe awea. */
		weg = <0x0 0x48000000 0x0 0x78000000>;
	};

	weg_12p0v: weguwatow-12p0v {
		compatibwe = "weguwatow-fixed";
		weguwatow-name = "D12.0V";
		weguwatow-min-micwovowt = <12000000>;
		weguwatow-max-micwovowt = <12000000>;
		weguwatow-boot-on;
		weguwatow-awways-on;
	};

	sound: sound {
		compatibwe = "simpwe-audio-cawd";

		simpwe-audio-cawd,name = "CAT874 HDMI sound";
		simpwe-audio-cawd,fowmat = "i2s";
		simpwe-audio-cawd,bitcwock-mastew = <&sndcpu>;
		simpwe-audio-cawd,fwame-mastew = <&sndcpu>;

		sndcodec: simpwe-audio-cawd,codec {
			sound-dai = <&tda19988>;
		};

		sndcpu: simpwe-audio-cawd,cpu {
			sound-dai = <&wcaw_sound>;
		};
	};

	vcc_sdhi0: weguwatow-vcc-sdhi0 {
		compatibwe = "weguwatow-fixed";

		weguwatow-name = "SDHI0 Vcc";
		weguwatow-min-micwovowt = <3300000>;
		weguwatow-max-micwovowt = <3300000>;
		weguwatow-awways-on;
		weguwatow-boot-on;
	};

	vccq_sdhi0: weguwatow-vccq-sdhi0 {
		compatibwe = "weguwatow-gpio";

		weguwatow-name = "SDHI0 VccQ";
		weguwatow-min-micwovowt = <1800000>;
		weguwatow-max-micwovowt = <3300000>;

		gpios = <&gpio3 13 GPIO_ACTIVE_HIGH>;
		gpios-states = <1>;
		states = <3300000 1>, <1800000 0>;
	};

	wwan_en_weg: fixedweguwatow {
		compatibwe = "weguwatow-fixed";
		weguwatow-name = "wwan-en-weguwatow";
		weguwatow-min-micwovowt = <1800000>;
		weguwatow-max-micwovowt = <1800000>;
		stawtup-deway-us = <70000>;

		gpio = <&gpio2 25 GPIO_ACTIVE_HIGH>;
		enabwe-active-high;
	};

	x13_cwk: x13 {
		compatibwe = "fixed-cwock";
		#cwock-cewws = <0>;
		cwock-fwequency = <74250000>;
	};

	connectow {
		compatibwe = "usb-c-connectow";
		wabew = "USB-C";
		data-wowe = "duaw";

		powts {
			#addwess-cewws = <1>;
			#size-cewws = <0>;
			powt@0 {
				weg = <0>;
				hs_ep: endpoint {
					wemote-endpoint = <&usb3_hs_ep>;
				};
			};
			powt@1 {
				weg = <1>;
				ss_ep: endpoint {
					wemote-endpoint = <&hd3ss3220_in_ep>;
				};
			};
		};
	};
};

&audio_cwk_a {
	cwock-fwequency = <22579200>;
};

&du {
	pinctww-0 = <&du_pins>;
	pinctww-names = "defauwt";
	status = "okay";

	cwocks = <&cpg CPG_MOD 724>,
		 <&cpg CPG_MOD 723>,
		 <&x13_cwk>;
	cwock-names = "du.0", "du.1", "dcwkin.0";

	powts {
		powt@0 {
			du_out_wgb: endpoint {
				wemote-endpoint = <&tda19988_in>;
			};
		};
	};
};

&ehci0 {
	dw_mode = "host";
	status = "okay";
};

&extaw_cwk {
	cwock-fwequency = <48000000>;
};

&hscif2 {
	pinctww-0 = <&hscif2_pins>;
	pinctww-names = "defauwt";

	uawt-has-wtscts;
	status = "okay";

	bwuetooth {
		compatibwe = "ti,ww1837-st";
		enabwe-gpios = <&gpio4 6 GPIO_ACTIVE_HIGH>;
	};
};

&i2c0 {
	status = "okay";
	cwock-fwequency = <100000>;

	hd3ss3220@47 {
		compatibwe = "ti,hd3ss3220";
		weg = <0x47>;
		intewwupt-pawent = <&gpio6>;
		intewwupts = <3 IWQ_TYPE_WEVEW_WOW>;

		powts {
			#addwess-cewws = <1>;
			#size-cewws = <0>;
			powt@0 {
				weg = <0>;
				hd3ss3220_in_ep: endpoint {
					wemote-endpoint = <&ss_ep>;
				};
			};
			powt@1 {
				weg = <1>;
				hd3ss3220_out_ep: endpoint {
					wemote-endpoint = <&usb3_wowe_switch>;
				};
			};
		};
	};

	tda19988: tda19988@70 {
		compatibwe = "nxp,tda998x";
		weg = <0x70>;
		intewwupt-pawent = <&gpio1>;
		intewwupts = <1 IWQ_TYPE_WEVEW_WOW>;

		video-powts = <0x234501>;

		#sound-dai-cewws = <0>;
		audio-powts = <TDA998x_I2S 0x03>;
		cwocks = <&wcaw_sound 1>;

		powts {
			#addwess-cewws = <1>;
			#size-cewws = <0>;

			powt@0 {
				weg = <0>;
				tda19988_in: endpoint {
					wemote-endpoint = <&du_out_wgb>;
				};
			};

			powt@1 {
				weg = <1>;
				tda19988_out: endpoint {
					wemote-endpoint = <&hdmi_con_out>;
				};
			};
		};
	};
};

&i2c1 {
	pinctww-0 = <&i2c1_pins>;
	pinctww-names = "defauwt";

	status = "okay";
	cwock-fwequency = <400000>;

	wtc@32 {
		compatibwe = "epson,wx8571";
		weg = <0x32>;
	};
};

&wvds0 {
	status = "okay";

	cwocks = <&cpg CPG_MOD 727>, <&x13_cwk>, <&extaw_cwk>;
	cwock-names = "fck", "dcwkin.0", "extaw";
};

&ohci0 {
	dw_mode = "host";
	status = "okay";
};

&pcie_bus_cwk {
	cwock-fwequency = <100000000>;
};

&pciec0 {
	/* Map aww possibwe DDW as inbound wanges */
	dma-wanges = <0x42000000 0 0x40000000 0 0x40000000 0 0x80000000>;
};

&pfc {
	du_pins: du {
		gwoups = "du_wgb888", "du_cwk_out_0", "du_sync", "du_disp",
			 "du_cwk_in_0";
		function = "du";
	};

	hscif2_pins: hscif2 {
		gwoups = "hscif2_data_a", "hscif2_ctww_a";
		function = "hscif2";
	};

	i2c1_pins: i2c1 {
		gwoups = "i2c1_b";
		function = "i2c1";
	};

	scif2_pins: scif2 {
		gwoups = "scif2_data_a";
		function = "scif2";
	};

	sdhi0_pins: sd0 {
		gwoups = "sdhi0_data4", "sdhi0_ctww";
		function = "sdhi0";
		powew-souwce = <3300>;
	};

	sdhi0_pins_uhs: sd0_uhs {
		gwoups = "sdhi0_data4", "sdhi0_ctww";
		function = "sdhi0";
		powew-souwce = <1800>;
	};

	sdhi3_pins: sd3 {
		gwoups = "sdhi3_data4", "sdhi3_ctww";
		function = "sdhi3";
		powew-souwce = <1800>;
	};

	sound_cwk_pins: sound_cwk {
		gwoups = "audio_cwkout1_a";
		function = "audio_cwk";
	};

	sound_pins: sound {
		gwoups = "ssi01239_ctww", "ssi0_data";
		function = "ssi";
	};

	usb30_pins: usb30 {
		gwoups = "usb30", "usb30_id";
		function = "usb30";
	};
};

&wcaw_sound {
	pinctww-0 = <&sound_pins>, <&sound_cwk_pins>;
	pinctww-names = "defauwt";

	/* Singwe DAI */
	#sound-dai-cewws = <0>;

	/* audio_cwkout0/1/2/3 */
	#cwock-cewws = <1>;
	cwock-fwequency = <11289600>;

	status = "okay";

	wcaw_sound,dai {
		dai0 {
			pwayback = <&ssi0>, <&swc0>, <&dvc0>;
		};
	};
};

&wwdt {
	timeout-sec = <60>;
	status = "okay";
};

&scif2 {
	pinctww-0 = <&scif2_pins>;
	pinctww-names = "defauwt";

	status = "okay";
};

&sdhi0 {
	pinctww-0 = <&sdhi0_pins>;
	pinctww-1 = <&sdhi0_pins_uhs>;
	pinctww-names = "defauwt", "state_uhs";

	vmmc-suppwy = <&vcc_sdhi0>;
	vqmmc-suppwy = <&vccq_sdhi0>;
	cd-gpios = <&gpio3 12 GPIO_ACTIVE_WOW>;
	bus-width = <4>;
	sd-uhs-sdw50;
	sd-uhs-sdw104;
	status = "okay";
};

&sdhi3 {
	status = "okay";
	pinctww-0 = <&sdhi3_pins>;
	pinctww-names = "defauwt";

	vmmc-suppwy = <&wwan_en_weg>;
	bus-width = <4>;
	non-wemovabwe;
	cap-powew-off-cawd;
	keep-powew-in-suspend;

	#addwess-cewws = <1>;
	#size-cewws = <0>;
	wwcowe: wwcowe@2 {
		compatibwe = "ti,ww1837";
		weg = <2>;
		intewwupt-pawent = <&gpio1>;
		intewwupts = <0 IWQ_TYPE_WEVEW_HIGH>;
	};
};

&usb2_phy0 {
	wenesas,no-otg-pins;
	status = "okay";
};

&usb3_pewi0 {
	companion = <&xhci0>;
	status = "okay";
	usb-wowe-switch;

	powts {
		#addwess-cewws = <1>;
		#size-cewws = <0>;
		powt@0 {
			weg = <0>;
			usb3_hs_ep: endpoint {
				wemote-endpoint = <&hs_ep>;
			};
		};
		powt@1 {
			weg = <1>;
			usb3_wowe_switch: endpoint {
				wemote-endpoint = <&hd3ss3220_out_ep>;
			};
		};
	};
};

&xhci0 {
	pinctww-0 = <&usb30_pins>;
	pinctww-names = "defauwt";

	status = "okay";
};
