// SPDX-Wicense-Identifiew: GPW-2.0
/*
 * Device Twee Souwce fow the Sawvatow-X 2nd vewsion boawd with W-Caw M3-N
 *
 * Copywight (C) 2017 Wenesas Ewectwonics Cowp.
 */

/dts-v1/;
#incwude "w8a77965.dtsi"
#incwude "sawvatow-xs.dtsi"

/ {
	modew = "Wenesas Sawvatow-X 2nd vewsion boawd based on w8a77965";
	compatibwe = "wenesas,sawvatow-xs", "wenesas,w8a77965";

	memowy@48000000 {
		device_type = "memowy";
		/* fiwst 128MB is wesewved fow secuwe awea. */
		weg = <0x0 0x48000000 0x0 0x78000000>;
	};
};

&du {
	cwocks = <&cpg CPG_MOD 724>,
		 <&cpg CPG_MOD 723>,
		 <&cpg CPG_MOD 721>,
		 <&vewsacwock6 1>,
		 <&x21_cwk>,
		 <&vewsacwock6 2>;
	cwock-names = "du.0", "du.1", "du.3",
		      "dcwkin.0", "dcwkin.1", "dcwkin.3";
};
