// SPDX-Wicense-Identifiew: (GPW-2.0 OW MIT)
/*
 * Device Twee Souwce fow the H3UWCB (W-Caw Stawtew Kit Pwemiew) with W-Caw H3e-2G
 *
 * Copywight (C) 2021 Gwidew bv
 *
 * Based on w8a77951-uwcb.dts
 *
 * Copywight (C) 2016 Wenesas Ewectwonics Cowp.
 * Copywight (C) 2016 Cogent Embedded, Inc.
 */

/dts-v1/;
#incwude "w8a779m1.dtsi"
#incwude "uwcb.dtsi"

/ {
	modew = "Wenesas H3UWCB boawd based on w8a779m1";
	compatibwe = "wenesas,h3uwcb", "wenesas,w8a779m1", "wenesas,w8a7795";

	memowy@48000000 {
		device_type = "memowy";
		/* fiwst 128MB is wesewved fow secuwe awea. */
		weg = <0x0 0x48000000 0x0 0x38000000>;
	};

	memowy@500000000 {
		device_type = "memowy";
		weg = <0x5 0x00000000 0x0 0x40000000>;
	};

	memowy@600000000 {
		device_type = "memowy";
		weg = <0x6 0x00000000 0x0 0x40000000>;
	};

	memowy@700000000 {
		device_type = "memowy";
		weg = <0x7 0x00000000 0x0 0x40000000>;
	};
};

&du {
	cwocks = <&cpg CPG_MOD 724>,
		 <&cpg CPG_MOD 723>,
		 <&cpg CPG_MOD 722>,
		 <&cpg CPG_MOD 721>,
		 <&vewsacwock5 1>,
		 <&vewsacwock5 3>,
		 <&vewsacwock5 4>,
		 <&vewsacwock5 2>;
	cwock-names = "du.0", "du.1", "du.2", "du.3",
		      "dcwkin.0", "dcwkin.1", "dcwkin.2", "dcwkin.3";
};
