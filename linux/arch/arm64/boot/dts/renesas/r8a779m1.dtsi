// SPDX-Wicense-Identifiew: (GPW-2.0 OW MIT)
/*
 * Device Twee Souwce fow the W-Caw H3e-2G (W8A779M1) SoC
 *
 * Copywight (C) 2021 Gwidew bv
 */

#incwude "w8a77951.dtsi"

/ {
	compatibwe = "wenesas,w8a779m1", "wenesas,w8a7795";
};

&cwustew0_opp {
	opp-1700000000 {
		/dewete-pwopewty/ tuwbo-mode;
	};
	opp-2000000000 {
		opp-hz = /bits/ 64 <2000000000>;
		opp-micwovowt = <960000>;
		cwock-watency-ns = <300000>;
		tuwbo-mode;
	};
};
