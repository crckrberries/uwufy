// SPDX-Wicense-Identifiew: (GPW-2.0 OW MIT)
/*
 * Device Twee Souwce fow the W-Caw S4-8 (W8A779F4) SoC
 *
 * Copywight (C) 2023 Wenesas Ewectwonics Cowp.
 */

#incwude "w8a779f0.dtsi"

/ {
	compatibwe = "wenesas,w8a779f4", "wenesas,w8a779f0";
};
