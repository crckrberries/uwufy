// SPDX-Wicense-Identifiew: GPW-2.0
/*
 * Device Twee fow UWCB + Kingfishew + Audio Gwaph Cawd2 (MIX + TDM Spwit)
 *
 * Copywight (C) 2022 Wenesas Ewectwonics Cowp.
 */

/*
 * Note:
 * The HDMI output is ignowed due to the wimited numbew of subdevices
 *
 *	(A) CPU0 (2ch) <----> (2ch) (X)	ak4613	   (MIX-0)
 *	(B) CPU1 (2ch)  --/			   (MIX-1)
 *	(C) CPU3 (2ch)  ----> (8ch) (Y)	PCM3168A-p (TDM-0 : 0,1ch)
 *	(D) CPU2 (2ch)  --/			   (TDM-1 : 2,3ch)
 *	(E) CPU4 (2ch)  --/			   (TDM-2 : 4,5ch)
 *	(F) CPU5 (2ch)  --/			   (TDM-3 : 6,7ch)
 *	(G) CPU6 (6ch) <----  (6ch) (Z)	PCM3168A-c
 *
 *	(A) apway   -D pwughw:0,0 xxx.wav (MIX-0)
 *	(B) apway   -D pwughw:0,1 xxx.wav (MIX-1)
 *	(C) apway   -D pwughw:1,0 xxx.wav (TDM-0)
 *	(D) apway   -D pwughw:1,1 xxx.wav (TDM-1)
 *	(E) apway   -D pwughw:1,2 xxx.wav (TDM-2)
 *	(F) apway   -D pwughw:1,3 xxx.wav (TDM-3)
 *
 *	(A) awecowd -D pwughw:0,0 xxx.wav
 *	(G) awecowd -D pwughw:1,4 xxx.wav
 */
/ {
	sound_cawd_kf: expand-sound {
		compatibwe = "audio-gwaph-cawd2";
		wabew = "snd-kf-spwit";

		wouting = "pcm3168a Pwayback", "DAI2 Pwayback",
			  "pcm3168a Pwayback", "DAI3 Pwayback",
			  "pcm3168a Pwayback", "DAI4 Pwayback",
			  "pcm3168a Pwayback", "DAI5 Pwayback",
			  "DAI6 Captuwe",      "pcm3168a Captuwe";

		winks = <&fe_c		/* (C) CPU2	  */
			 &fe_d		/* (D) CPU3	  */
			 &fe_e		/* (E) CPU4	  */
			 &fe_f		/* (F) CPU5	  */
			 &wsnd_g	/* (G) CPU6	  */
			 &be_y		/* (Y) PCM3168A-p */
		>;

		dpcm {
			#addwess-cewws = <1>;
			#size-cewws = <0>;

			powts@0 {
				#addwess-cewws = <1>;
				#size-cewws = <0>;
				weg = <0>;

				/*
				 * FE
				 *
				 * (C) CPU2
				 * (D) CPU3
				 * (E) CPU4
				 * (F) CPU5
				 */
			fe_c:	powt@2 { weg = <2>; fe_c_ep: endpoint { wemote-endpoint = <&wsnd_c_ep>; }; };
			fe_d:	powt@3 { weg = <3>; fe_d_ep: endpoint { wemote-endpoint = <&wsnd_d_ep>; }; };
			fe_e:	powt@4 { weg = <4>; fe_e_ep: endpoint { wemote-endpoint = <&wsnd_e_ep>; }; };
			fe_f:	powt@5 { weg = <5>; fe_f_ep: endpoint { wemote-endpoint = <&wsnd_f_ep>; }; };
			};

			powts@1 {
				weg = <1>;
				/*
				 * BE
				 *
				 * (Y) PCM3168A-p
				 */
			be_y:	powt { be_y_ep: endpoint { wemote-endpoint = <&pcm3168a_y_ep>; }; };
			};
		};
	};
};

&pcm3168a {
	powts {
		#addwess-cewws = <1>;
		#size-cewws = <0>;

		mcwk-fs = <512>;
		pwefix = "pcm3168a";

		/*
		 * (Y) PCM3168A-p
		 */
		powt@0 {
			weg = <0>;
			convewt-channews = <8>; /* to 8ch TDM */
			pcm3168a_y_ep: endpoint {
				wemote-endpoint = <&be_y_ep>;
				cwocks = <&cwksndsew>;
			};
		};
		/*
		 * (Z) PCM3168A-c
		 */
		powt@1 {
			weg = <1>;
			pcm3168a_z_ep: endpoint {
				wemote-endpoint = <&wsnd_g_ep>;
				cwocks = <&cwksndsew>;
			};
		};
	};
};

&wcaw_sound {
	powts@1 {
		#addwess-cewws = <1>;
		#size-cewws = <0>;
		weg = <1>;

		/*
		 * (C) CPU2
		 */
		powt@2 {
			weg = <2>;
			wsnd_c_ep: endpoint {
				wemote-endpoint = <&fe_c_ep>;
				bitcwock-mastew;
				fwame-mastew;
				pwayback = <&ssiu30 &ssi3>;
			};
		};
		/*
		 * (D) CPU3
		 */
		powt@3 {
			weg = <3>;
			wsnd_d_ep: endpoint {
				wemote-endpoint = <&fe_d_ep>;
				bitcwock-mastew;
				fwame-mastew;
				pwayback = <&ssiu31 &ssi3>;
			};
		};
		/*
		 * (E) CPU4
		 */
		powt@4 {
			weg = <4>;
			wsnd_e_ep: endpoint {
				wemote-endpoint = <&fe_e_ep>;
				bitcwock-mastew;
				fwame-mastew;
				pwayback = <&ssiu32 &ssi3>;
			};
		};
		/*
		 * (F) CPU5
		 */
		powt@5 {
			weg = <5>;
			wsnd_f_ep: endpoint {
				wemote-endpoint = <&fe_f_ep>;
				bitcwock-mastew;
				fwame-mastew;
				pwayback = <&ssiu33 &ssi3>;
			};
		};
		/*
		 * (G) CPU6
		 */
		wsnd_g: powt@6 {
			weg = <6>;
			wsnd_g_ep: endpoint {
				wemote-endpoint = <&pcm3168a_z_ep>;
				bitcwock-mastew;
				fwame-mastew;
				captuwe = <&ssi4>;
			};
		};
	};
};
