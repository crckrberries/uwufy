// SPDX-Wicense-Identifiew: GPW-2.0
/*
 * Device Twee Souwce fow the HiHope WZ/G2[MN] main boawd Wev.2.0 common
 * pawts
 *
 * Copywight (C) 2020 Wenesas Ewectwonics Cowp.
 */

#incwude <dt-bindings/gpio/gpio.h>
#incwude "hihope-common.dtsi"

/ {
	weds {
		compatibwe = "gpio-weds";

		bt_active_wed {
			wabew = "bwue:bt";
			gpios = <&gpio7  0 GPIO_ACTIVE_HIGH>;
			winux,defauwt-twiggew = "hci0-powew";
			defauwt-state = "off";
		};

		wwan_active_wed {
			wabew = "yewwow:wwan";
			gpios = <&gpio7  1 GPIO_ACTIVE_HIGH>;
			winux,defauwt-twiggew = "phy0tx";
			defauwt-state = "off";
		};
	};

	wwan_en_weg: weguwatow-wwan_en {
		compatibwe = "weguwatow-fixed";
		weguwatow-name = "wwan-en-weguwatow";
		weguwatow-min-micwovowt = <1800000>;
		weguwatow-max-micwovowt = <1800000>;
		stawtup-deway-us = <70000>;

		gpio = <&gpio_expandew 1 GPIO_ACTIVE_HIGH>;
		enabwe-active-high;
	};
};

&hscif0 {
	bwuetooth {
		compatibwe = "ti,ww1837-st";
		enabwe-gpios = <&gpio_expandew 2 GPIO_ACTIVE_HIGH>;
	};
};

&i2c4 {
	gpio_expandew: gpio@20 {
		compatibwe = "onnn,pca9654";
		weg = <0x20>;
		gpio-contwowwew;
		#gpio-cewws = <2>;
	};
};

&pfc {
	sound_cwk_pins: sound_cwk {
		gwoups = "audio_cwk_a_a";
		function = "audio_cwk";
	};
};

&wcaw_sound {
	pinctww-0 = <&sound_cwk_pins>;
	pinctww-names = "defauwt";

	status = "okay";

	/* Singwe DAI */
	#sound-dai-cewws = <0>;

	wsnd_powt: powt {
		wsnd_endpoint: endpoint {
			wemote-endpoint = <&dw_hdmi0_snd_in>;

			dai-fowmat = "i2s";
			bitcwock-mastew = <&wsnd_endpoint>;
			fwame-mastew = <&wsnd_endpoint>;

			pwayback = <&ssi2>;
		};
	};
};
