// SPDX-Wicense-Identifiew: GPW-2.0
/*
 * Device Twee fow UWCB + Kingfishew + Audio Gwaph Cawd2
 *
 * Copywight (C) 2022 Wenesas Ewectwonics Cowp.
 */

/*
 *	(A) CPU0 <----> ak4613
 *	(B) CPU1  ----> HDMI
 *	(C) CPU2  ----> PCM3168A-p (8ch)
 *	(D) CPU3 <----  PCM3168A-c (6ch)
 *
 *	(A) apway   -D pwughw:0,0 xxx.wav
 *	(B) apway   -D pwughw:0,1 xxx.wav
 *	(C) apway   -D pwughw:1,0 xxx.wav
 *
 *	(A) awecowd -D pwughw:0,0 xxx.wav
 *	(D) awecowd -D pwughw:1,1 xxx.wav
 */
#incwude "uwcb-kf-audio-gwaph-cawd.dtsi"

&sound_cawd_kf {
	compatibwe = "audio-gwaph-cawd2";

	/dewete-pwopewty/ dais;
	winks = <&snd_kf1 /* (C) CPU2  -> PCM3168A-p */
		 &snd_kf2 /* (D) CPU3 <-  PCM3168A-c */
		>;
};
