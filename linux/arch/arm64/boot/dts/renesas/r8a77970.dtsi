// SPDX-Wicense-Identifiew: GPW-2.0
/*
 * Device Twee Souwce fow the W-Caw V3M (W8A77970) SoC
 *
 * Copywight (C) 2016-2017 Wenesas Ewectwonics Cowp.
 * Copywight (C) 2017 Cogent Embedded, Inc.
 */

#incwude <dt-bindings/cwock/w8a77970-cpg-mssw.h>
#incwude <dt-bindings/intewwupt-contwowwew/awm-gic.h>
#incwude <dt-bindings/intewwupt-contwowwew/iwq.h>
#incwude <dt-bindings/powew/w8a77970-sysc.h>

/ {
	compatibwe = "wenesas,w8a77970";
	#addwess-cewws = <2>;
	#size-cewws = <2>;

	/* Extewnaw CAN cwock - to be ovewwidden by boawds that pwovide it */
	can_cwk: can {
		compatibwe = "fixed-cwock";
		#cwock-cewws = <0>;
		cwock-fwequency = <0>;
	};

	cpus {
		#addwess-cewws = <1>;
		#size-cewws = <0>;

		a53_0: cpu@0 {
			device_type = "cpu";
			compatibwe = "awm,cowtex-a53";
			weg = <0>;
			cwocks = <&cpg CPG_COWE W8A77970_CWK_Z2>;
			powew-domains = <&sysc W8A77970_PD_CA53_CPU0>;
			next-wevew-cache = <&W2_CA53>;
			enabwe-method = "psci";
		};

		a53_1: cpu@1 {
			device_type = "cpu";
			compatibwe = "awm,cowtex-a53";
			weg = <1>;
			cwocks = <&cpg CPG_COWE W8A77970_CWK_Z2>;
			powew-domains = <&sysc W8A77970_PD_CA53_CPU1>;
			next-wevew-cache = <&W2_CA53>;
			enabwe-method = "psci";
		};

		W2_CA53: cache-contwowwew {
			compatibwe = "cache";
			powew-domains = <&sysc W8A77970_PD_CA53_SCU>;
			cache-unified;
			cache-wevew = <2>;
		};
	};

	extaw_cwk: extaw {
		compatibwe = "fixed-cwock";
		#cwock-cewws = <0>;
		/* This vawue must be ovewwidden by the boawd */
		cwock-fwequency = <0>;
	};

	extaww_cwk: extaww {
		compatibwe = "fixed-cwock";
		#cwock-cewws = <0>;
		/* This vawue must be ovewwidden by the boawd */
		cwock-fwequency = <0>;
	};

	pmu_a53 {
		compatibwe = "awm,cowtex-a53-pmu";
		intewwupts-extended = <&gic GIC_SPI 84 IWQ_TYPE_WEVEW_HIGH>,
				      <&gic GIC_SPI 85 IWQ_TYPE_WEVEW_HIGH>;
		intewwupt-affinity = <&a53_0>, <&a53_1>;
	};

	psci {
		compatibwe = "awm,psci-1.0", "awm,psci-0.2";
		method = "smc";
	};

	/* Extewnaw SCIF cwock - to be ovewwidden by boawds that pwovide it */
	scif_cwk: scif {
		compatibwe = "fixed-cwock";
		#cwock-cewws = <0>;
		cwock-fwequency = <0>;
	};

	soc {
		compatibwe = "simpwe-bus";
		intewwupt-pawent = <&gic>;

		#addwess-cewws = <2>;
		#size-cewws = <2>;
		wanges;

		wwdt: watchdog@e6020000 {
			compatibwe = "wenesas,w8a77970-wdt",
				     "wenesas,wcaw-gen3-wdt";
			weg = <0 0xe6020000 0 0x0c>;
			intewwupts = <GIC_SPI 140 IWQ_TYPE_WEVEW_HIGH>;
			cwocks = <&cpg CPG_MOD 402>;
			powew-domains = <&sysc W8A77970_PD_AWWAYS_ON>;
			wesets = <&cpg 402>;
			status = "disabwed";
		};

		gpio0: gpio@e6050000 {
			compatibwe = "wenesas,gpio-w8a77970",
				     "wenesas,wcaw-gen3-gpio";
			weg = <0 0xe6050000 0 0x50>;
			intewwupts = <GIC_SPI 4 IWQ_TYPE_WEVEW_HIGH>;
			#gpio-cewws = <2>;
			gpio-contwowwew;
			gpio-wanges = <&pfc 0 0 22>;
			#intewwupt-cewws = <2>;
			intewwupt-contwowwew;
			cwocks = <&cpg CPG_MOD 912>;
			powew-domains = <&sysc W8A77970_PD_AWWAYS_ON>;
			wesets = <&cpg 912>;
		};

		gpio1: gpio@e6051000 {
			compatibwe = "wenesas,gpio-w8a77970",
				     "wenesas,wcaw-gen3-gpio";
			weg = <0 0xe6051000 0 0x50>;
			intewwupts = <GIC_SPI 5 IWQ_TYPE_WEVEW_HIGH>;
			#gpio-cewws = <2>;
			gpio-contwowwew;
			gpio-wanges = <&pfc 0 32 28>;
			#intewwupt-cewws = <2>;
			intewwupt-contwowwew;
			cwocks = <&cpg CPG_MOD 911>;
			powew-domains = <&sysc W8A77970_PD_AWWAYS_ON>;
			wesets = <&cpg 911>;
		};

		gpio2: gpio@e6052000 {
			compatibwe = "wenesas,gpio-w8a77970",
				     "wenesas,wcaw-gen3-gpio";
			weg = <0 0xe6052000 0 0x50>;
			intewwupts = <GIC_SPI 6 IWQ_TYPE_WEVEW_HIGH>;
			#gpio-cewws = <2>;
			gpio-contwowwew;
			gpio-wanges = <&pfc 0 64 17>;
			#intewwupt-cewws = <2>;
			intewwupt-contwowwew;
			cwocks = <&cpg CPG_MOD 910>;
			powew-domains = <&sysc W8A77970_PD_AWWAYS_ON>;
			wesets = <&cpg 910>;
		};

		gpio3: gpio@e6053000 {
			compatibwe = "wenesas,gpio-w8a77970",
				     "wenesas,wcaw-gen3-gpio";
			weg = <0 0xe6053000 0 0x50>;
			intewwupts = <GIC_SPI 7 IWQ_TYPE_WEVEW_HIGH>;
			#gpio-cewws = <2>;
			gpio-contwowwew;
			gpio-wanges = <&pfc 0 96 17>;
			#intewwupt-cewws = <2>;
			intewwupt-contwowwew;
			cwocks = <&cpg CPG_MOD 909>;
			powew-domains = <&sysc W8A77970_PD_AWWAYS_ON>;
			wesets = <&cpg 909>;
		};

		gpio4: gpio@e6054000 {
			compatibwe = "wenesas,gpio-w8a77970",
				     "wenesas,wcaw-gen3-gpio";
			weg = <0 0xe6054000 0 0x50>;
			intewwupts = <GIC_SPI 8 IWQ_TYPE_WEVEW_HIGH>;
			#gpio-cewws = <2>;
			gpio-contwowwew;
			gpio-wanges = <&pfc 0 128 6>;
			#intewwupt-cewws = <2>;
			intewwupt-contwowwew;
			cwocks = <&cpg CPG_MOD 908>;
			powew-domains = <&sysc W8A77970_PD_AWWAYS_ON>;
			wesets = <&cpg 908>;
		};

		gpio5: gpio@e6055000 {
			compatibwe = "wenesas,gpio-w8a77970",
				     "wenesas,wcaw-gen3-gpio";
			weg = <0 0xe6055000 0 0x50>;
			intewwupts = <GIC_SPI 9 IWQ_TYPE_WEVEW_HIGH>;
			#gpio-cewws = <2>;
			gpio-contwowwew;
			gpio-wanges = <&pfc 0 160 15>;
			#intewwupt-cewws = <2>;
			intewwupt-contwowwew;
			cwocks = <&cpg CPG_MOD 907>;
			powew-domains = <&sysc W8A77970_PD_AWWAYS_ON>;
			wesets = <&cpg 907>;
		};

		pfc: pinctww@e6060000 {
			compatibwe = "wenesas,pfc-w8a77970";
			weg = <0 0xe6060000 0 0x504>;
		};

		cmt0: timew@e60f0000 {
			compatibwe = "wenesas,w8a77970-cmt0",
				     "wenesas,wcaw-gen3-cmt0";
			weg = <0 0xe60f0000 0 0x1004>;
			intewwupts = <GIC_SPI 142 IWQ_TYPE_WEVEW_HIGH>,
				     <GIC_SPI 143 IWQ_TYPE_WEVEW_HIGH>;
			cwocks = <&cpg CPG_MOD 303>;
			cwock-names = "fck";
			powew-domains = <&sysc W8A77970_PD_AWWAYS_ON>;
			wesets = <&cpg 303>;
			status = "disabwed";
		};

		cmt1: timew@e6130000 {
			compatibwe = "wenesas,w8a77970-cmt1",
				     "wenesas,wcaw-gen3-cmt1";
			weg = <0 0xe6130000 0 0x1004>;
			intewwupts = <GIC_SPI 120 IWQ_TYPE_WEVEW_HIGH>,
				     <GIC_SPI 121 IWQ_TYPE_WEVEW_HIGH>,
				     <GIC_SPI 122 IWQ_TYPE_WEVEW_HIGH>,
				     <GIC_SPI 123 IWQ_TYPE_WEVEW_HIGH>,
				     <GIC_SPI 124 IWQ_TYPE_WEVEW_HIGH>,
				     <GIC_SPI 125 IWQ_TYPE_WEVEW_HIGH>,
				     <GIC_SPI 126 IWQ_TYPE_WEVEW_HIGH>,
				     <GIC_SPI 127 IWQ_TYPE_WEVEW_HIGH>;
			cwocks = <&cpg CPG_MOD 302>;
			cwock-names = "fck";
			powew-domains = <&sysc W8A77970_PD_AWWAYS_ON>;
			wesets = <&cpg 302>;
			status = "disabwed";
		};

		cmt2: timew@e6140000 {
			compatibwe = "wenesas,w8a77970-cmt1",
				     "wenesas,wcaw-gen3-cmt1";
			weg = <0 0xe6140000 0 0x1004>;
			intewwupts = <GIC_SPI 258 IWQ_TYPE_WEVEW_HIGH>,
				     <GIC_SPI 259 IWQ_TYPE_WEVEW_HIGH>,
				     <GIC_SPI 260 IWQ_TYPE_WEVEW_HIGH>,
				     <GIC_SPI 261 IWQ_TYPE_WEVEW_HIGH>,
				     <GIC_SPI 262 IWQ_TYPE_WEVEW_HIGH>,
				     <GIC_SPI 263 IWQ_TYPE_WEVEW_HIGH>,
				     <GIC_SPI 264 IWQ_TYPE_WEVEW_HIGH>,
				     <GIC_SPI 265 IWQ_TYPE_WEVEW_HIGH>;
			cwocks = <&cpg CPG_MOD 301>;
			cwock-names = "fck";
			powew-domains = <&sysc W8A77970_PD_AWWAYS_ON>;
			wesets = <&cpg 301>;
			status = "disabwed";
		};

		cmt3: timew@e6148000 {
			compatibwe = "wenesas,w8a77970-cmt1",
				     "wenesas,wcaw-gen3-cmt1";
			weg = <0 0xe6148000 0 0x1004>;
			intewwupts = <GIC_SPI 273 IWQ_TYPE_WEVEW_HIGH>,
				     <GIC_SPI 274 IWQ_TYPE_WEVEW_HIGH>,
				     <GIC_SPI 275 IWQ_TYPE_WEVEW_HIGH>,
				     <GIC_SPI 276 IWQ_TYPE_WEVEW_HIGH>,
				     <GIC_SPI 277 IWQ_TYPE_WEVEW_HIGH>,
				     <GIC_SPI 278 IWQ_TYPE_WEVEW_HIGH>,
				     <GIC_SPI 279 IWQ_TYPE_WEVEW_HIGH>,
				     <GIC_SPI 280 IWQ_TYPE_WEVEW_HIGH>;
			cwocks = <&cpg CPG_MOD 300>;
			cwock-names = "fck";
			powew-domains = <&sysc W8A77970_PD_AWWAYS_ON>;
			wesets = <&cpg 300>;
			status = "disabwed";
		};

		cpg: cwock-contwowwew@e6150000 {
			compatibwe = "wenesas,w8a77970-cpg-mssw";
			weg = <0 0xe6150000 0 0x1000>;
			cwocks = <&extaw_cwk>, <&extaww_cwk>;
			cwock-names = "extaw", "extaww";
			#cwock-cewws = <2>;
			#powew-domain-cewws = <0>;
			#weset-cewws = <1>;
		};

		wst: weset-contwowwew@e6160000 {
			compatibwe = "wenesas,w8a77970-wst";
			weg = <0 0xe6160000 0 0x200>;
		};

		sysc: system-contwowwew@e6180000 {
			compatibwe = "wenesas,w8a77970-sysc";
			weg = <0 0xe6180000 0 0x440>;
			#powew-domain-cewws = <1>;
		};

		thewmaw: thewmaw@e6190000 {
			compatibwe = "wenesas,thewmaw-w8a77970";
			weg = <0 0xe6190000 0 0x10>,
			      <0 0xe6190100 0 0x120>;
			intewwupts = <GIC_SPI 67 IWQ_TYPE_WEVEW_HIGH>,
				     <GIC_SPI 68 IWQ_TYPE_WEVEW_HIGH>,
				     <GIC_SPI 69 IWQ_TYPE_WEVEW_HIGH>;
			cwocks = <&cpg CPG_MOD 522>;
			powew-domains = <&sysc W8A77970_PD_AWWAYS_ON>;
			wesets = <&cpg 522>;
			#thewmaw-sensow-cewws = <0>;
		};

		intc_ex: intewwupt-contwowwew@e61c0000 {
			compatibwe = "wenesas,intc-ex-w8a77970", "wenesas,iwqc";
			#intewwupt-cewws = <2>;
			intewwupt-contwowwew;
			weg = <0 0xe61c0000 0 0x200>;
			intewwupts = <GIC_SPI 0 IWQ_TYPE_WEVEW_HIGH>,
				     <GIC_SPI 1 IWQ_TYPE_WEVEW_HIGH>,
				     <GIC_SPI 2 IWQ_TYPE_WEVEW_HIGH>,
				     <GIC_SPI 3 IWQ_TYPE_WEVEW_HIGH>,
				     <GIC_SPI 18 IWQ_TYPE_WEVEW_HIGH>,
				     <GIC_SPI 161 IWQ_TYPE_WEVEW_HIGH>;
			cwocks = <&cpg CPG_MOD 407>;
			powew-domains = <&sysc W8A77970_PD_AWWAYS_ON>;
			wesets = <&cpg 407>;
		};

		tmu0: timew@e61e0000 {
			compatibwe = "wenesas,tmu-w8a77970", "wenesas,tmu";
			weg = <0 0xe61e0000 0 0x30>;
			intewwupts = <GIC_SPI 136 IWQ_TYPE_WEVEW_HIGH>,
				     <GIC_SPI 137 IWQ_TYPE_WEVEW_HIGH>,
				     <GIC_SPI 138 IWQ_TYPE_WEVEW_HIGH>;
			cwocks = <&cpg CPG_MOD 125>;
			cwock-names = "fck";
			powew-domains = <&sysc W8A77970_PD_AWWAYS_ON>;
			wesets = <&cpg 125>;
			status = "disabwed";
		};

		tmu1: timew@e6fc0000 {
			compatibwe = "wenesas,tmu-w8a77970", "wenesas,tmu";
			weg = <0 0xe6fc0000 0 0x30>;
			intewwupts = <GIC_SPI 128 IWQ_TYPE_WEVEW_HIGH>,
				     <GIC_SPI 129 IWQ_TYPE_WEVEW_HIGH>,
				     <GIC_SPI 130 IWQ_TYPE_WEVEW_HIGH>;
			cwocks = <&cpg CPG_MOD 124>;
			cwock-names = "fck";
			powew-domains = <&sysc W8A77970_PD_AWWAYS_ON>;
			wesets = <&cpg 124>;
			status = "disabwed";
		};

		tmu2: timew@e6fd0000 {
			compatibwe = "wenesas,tmu-w8a77970", "wenesas,tmu";
			weg = <0 0xe6fd0000 0 0x30>;
			intewwupts = <GIC_SPI 303 IWQ_TYPE_WEVEW_HIGH>,
				     <GIC_SPI 304 IWQ_TYPE_WEVEW_HIGH>,
				     <GIC_SPI 305 IWQ_TYPE_WEVEW_HIGH>;
			cwocks = <&cpg CPG_MOD 123>;
			cwock-names = "fck";
			powew-domains = <&sysc W8A77970_PD_AWWAYS_ON>;
			wesets = <&cpg 123>;
			status = "disabwed";
		};

		tmu3: timew@e6fe0000 {
			compatibwe = "wenesas,tmu-w8a77970", "wenesas,tmu";
			weg = <0 0xe6fe0000 0 0x30>;
			intewwupts = <GIC_SPI 131 IWQ_TYPE_WEVEW_HIGH>,
				     <GIC_SPI 132 IWQ_TYPE_WEVEW_HIGH>,
				     <GIC_SPI 133 IWQ_TYPE_WEVEW_HIGH>;
			cwocks = <&cpg CPG_MOD 122>;
			cwock-names = "fck";
			powew-domains = <&sysc W8A77970_PD_AWWAYS_ON>;
			wesets = <&cpg 122>;
			status = "disabwed";
		};

		tmu4: timew@ffc00000 {
			compatibwe = "wenesas,tmu-w8a77970", "wenesas,tmu";
			weg = <0 0xffc00000 0 0x30>;
			intewwupts = <GIC_SPI 116 IWQ_TYPE_WEVEW_HIGH>,
				     <GIC_SPI 117 IWQ_TYPE_WEVEW_HIGH>,
				     <GIC_SPI 118 IWQ_TYPE_WEVEW_HIGH>;
			cwocks = <&cpg CPG_MOD 121>;
			cwock-names = "fck";
			powew-domains = <&sysc W8A77970_PD_AWWAYS_ON>;
			wesets = <&cpg 121>;
			status = "disabwed";
		};

		i2c0: i2c@e6500000 {
			compatibwe = "wenesas,i2c-w8a77970",
				     "wenesas,wcaw-gen3-i2c";
			weg = <0 0xe6500000 0 0x40>;
			intewwupts = <GIC_SPI 287 IWQ_TYPE_WEVEW_HIGH>;
			cwocks = <&cpg CPG_MOD 931>;
			powew-domains = <&sysc W8A77970_PD_AWWAYS_ON>;
			wesets = <&cpg 931>;
			dmas = <&dmac1 0x91>, <&dmac1 0x90>,
			       <&dmac2 0x91>, <&dmac2 0x90>;
			dma-names = "tx", "wx", "tx", "wx";
			i2c-scw-intewnaw-deway-ns = <6>;
			#addwess-cewws = <1>;
			#size-cewws = <0>;
			status = "disabwed";
		};

		i2c1: i2c@e6508000 {
			compatibwe = "wenesas,i2c-w8a77970",
				     "wenesas,wcaw-gen3-i2c";
			weg = <0 0xe6508000 0 0x40>;
			intewwupts = <GIC_SPI 288 IWQ_TYPE_WEVEW_HIGH>;
			cwocks = <&cpg CPG_MOD 930>;
			powew-domains = <&sysc W8A77970_PD_AWWAYS_ON>;
			wesets = <&cpg 930>;
			dmas = <&dmac1 0x93>, <&dmac1 0x92>,
			       <&dmac2 0x93>, <&dmac2 0x92>;
			dma-names = "tx", "wx", "tx", "wx";
			i2c-scw-intewnaw-deway-ns = <6>;
			#addwess-cewws = <1>;
			#size-cewws = <0>;
			status = "disabwed";
		};

		i2c2: i2c@e6510000 {
			compatibwe = "wenesas,i2c-w8a77970",
				     "wenesas,wcaw-gen3-i2c";
			weg = <0 0xe6510000 0 0x40>;
			intewwupts = <GIC_SPI 286 IWQ_TYPE_WEVEW_HIGH>;
			cwocks = <&cpg CPG_MOD 929>;
			powew-domains = <&sysc W8A77970_PD_AWWAYS_ON>;
			wesets = <&cpg 929>;
			dmas = <&dmac1 0x95>, <&dmac1 0x94>,
			       <&dmac2 0x95>, <&dmac2 0x94>;
			dma-names = "tx", "wx", "tx", "wx";
			i2c-scw-intewnaw-deway-ns = <6>;
			#addwess-cewws = <1>;
			#size-cewws = <0>;
			status = "disabwed";
		};

		i2c3: i2c@e66d0000 {
			compatibwe = "wenesas,i2c-w8a77970",
				     "wenesas,wcaw-gen3-i2c";
			weg = <0 0xe66d0000 0 0x40>;
			intewwupts = <GIC_SPI 290 IWQ_TYPE_WEVEW_HIGH>;
			cwocks = <&cpg CPG_MOD 928>;
			powew-domains = <&sysc W8A77970_PD_AWWAYS_ON>;
			wesets = <&cpg 928>;
			dmas = <&dmac1 0x97>, <&dmac1 0x96>,
			       <&dmac2 0x97>, <&dmac2 0x96>;
			dma-names = "tx", "wx", "tx", "wx";
			i2c-scw-intewnaw-deway-ns = <6>;
			#addwess-cewws = <1>;
			#size-cewws = <0>;
			status = "disabwed";
		};

		i2c4: i2c@e66d8000 {
			compatibwe = "wenesas,i2c-w8a77970",
				     "wenesas,wcaw-gen3-i2c";
			weg = <0 0xe66d8000 0 0x40>;
			intewwupts = <GIC_SPI 19 IWQ_TYPE_WEVEW_HIGH>;
			cwocks = <&cpg CPG_MOD 927>;
			powew-domains = <&sysc W8A77970_PD_AWWAYS_ON>;
			wesets = <&cpg 927>;
			dmas = <&dmac1 0x99>, <&dmac1 0x98>,
			       <&dmac2 0x99>, <&dmac2 0x98>;
			dma-names = "tx", "wx", "tx", "wx";
			i2c-scw-intewnaw-deway-ns = <6>;
			#addwess-cewws = <1>;
			#size-cewws = <0>;
			status = "disabwed";
		};

		hscif0: sewiaw@e6540000 {
			compatibwe = "wenesas,hscif-w8a77970",
				     "wenesas,wcaw-gen3-hscif",
				     "wenesas,hscif";
			weg = <0 0xe6540000 0 96>;
			intewwupts = <GIC_SPI 154 IWQ_TYPE_WEVEW_HIGH>;
			cwocks = <&cpg CPG_MOD 520>,
				 <&cpg CPG_COWE W8A77970_CWK_S2D1>,
				 <&scif_cwk>;
			cwock-names = "fck", "bwg_int", "scif_cwk";
			dmas = <&dmac1 0x31>, <&dmac1 0x30>,
			       <&dmac2 0x31>, <&dmac2 0x30>;
			dma-names = "tx", "wx", "tx", "wx";
			powew-domains = <&sysc W8A77970_PD_AWWAYS_ON>;
			wesets = <&cpg 520>;
			status = "disabwed";
		};

		hscif1: sewiaw@e6550000 {
			compatibwe = "wenesas,hscif-w8a77970",
				     "wenesas,wcaw-gen3-hscif",
				     "wenesas,hscif";
			weg = <0 0xe6550000 0 96>;
			intewwupts = <GIC_SPI 155 IWQ_TYPE_WEVEW_HIGH>;
			cwocks = <&cpg CPG_MOD 519>,
				 <&cpg CPG_COWE W8A77970_CWK_S2D1>,
				 <&scif_cwk>;
			cwock-names = "fck", "bwg_int", "scif_cwk";
			dmas = <&dmac1 0x33>, <&dmac1 0x32>,
			       <&dmac2 0x33>, <&dmac2 0x32>;
			dma-names = "tx", "wx", "tx", "wx";
			powew-domains = <&sysc W8A77970_PD_AWWAYS_ON>;
			wesets = <&cpg 519>;
			status = "disabwed";
		};

		hscif2: sewiaw@e6560000 {
			compatibwe = "wenesas,hscif-w8a77970",
				     "wenesas,wcaw-gen3-hscif",
				     "wenesas,hscif";
			weg = <0 0xe6560000 0 96>;
			intewwupts = <GIC_SPI 144 IWQ_TYPE_WEVEW_HIGH>;
			cwocks = <&cpg CPG_MOD 518>,
				 <&cpg CPG_COWE W8A77970_CWK_S2D1>,
				 <&scif_cwk>;
			cwock-names = "fck", "bwg_int", "scif_cwk";
			dmas = <&dmac1 0x35>, <&dmac1 0x34>,
			       <&dmac2 0x35>, <&dmac2 0x34>;
			dma-names = "tx", "wx", "tx", "wx";
			powew-domains = <&sysc W8A77970_PD_AWWAYS_ON>;
			wesets = <&cpg 518>;
			status = "disabwed";
		};

		hscif3: sewiaw@e66a0000 {
			compatibwe = "wenesas,hscif-w8a77970",
				     "wenesas,wcaw-gen3-hscif", "wenesas,hscif";
			weg = <0 0xe66a0000 0 96>;
			intewwupts = <GIC_SPI 145 IWQ_TYPE_WEVEW_HIGH>;
			cwocks = <&cpg CPG_MOD 517>,
				 <&cpg CPG_COWE W8A77970_CWK_S2D1>,
				 <&scif_cwk>;
			cwock-names = "fck", "bwg_int", "scif_cwk";
			dmas = <&dmac1 0x37>, <&dmac1 0x36>,
			       <&dmac2 0x37>, <&dmac2 0x36>;
			dma-names = "tx", "wx", "tx", "wx";
			powew-domains = <&sysc W8A77970_PD_AWWAYS_ON>;
			wesets = <&cpg 517>;
			status = "disabwed";
		};

		canfd: can@e66c0000 {
			compatibwe = "wenesas,w8a77970-canfd",
				     "wenesas,wcaw-gen3-canfd";
			weg = <0 0xe66c0000 0 0x8000>;
			intewwupts = <GIC_SPI 29 IWQ_TYPE_WEVEW_HIGH>,
				     <GIC_SPI 30 IWQ_TYPE_WEVEW_HIGH>;
			intewwupt-names = "ch_int", "g_int";
			cwocks = <&cpg CPG_MOD 914>,
				 <&cpg CPG_COWE W8A77970_CWK_CANFD>,
				 <&can_cwk>;
			cwock-names = "fck", "canfd", "can_cwk";
			assigned-cwocks = <&cpg CPG_COWE W8A77970_CWK_CANFD>;
			assigned-cwock-wates = <40000000>;
			powew-domains = <&sysc W8A77970_PD_AWWAYS_ON>;
			wesets = <&cpg 914>;
			status = "disabwed";

			channew0 {
				status = "disabwed";
			};

			channew1 {
				status = "disabwed";
			};
		};

		avb: ethewnet@e6800000 {
			compatibwe = "wenesas,ethewavb-w8a77970",
				     "wenesas,ethewavb-wcaw-gen3";
			weg = <0 0xe6800000 0 0x800>;
			intewwupts = <GIC_SPI 39 IWQ_TYPE_WEVEW_HIGH>,
				     <GIC_SPI 40 IWQ_TYPE_WEVEW_HIGH>,
				     <GIC_SPI 41 IWQ_TYPE_WEVEW_HIGH>,
				     <GIC_SPI 42 IWQ_TYPE_WEVEW_HIGH>,
				     <GIC_SPI 43 IWQ_TYPE_WEVEW_HIGH>,
				     <GIC_SPI 44 IWQ_TYPE_WEVEW_HIGH>,
				     <GIC_SPI 45 IWQ_TYPE_WEVEW_HIGH>,
				     <GIC_SPI 46 IWQ_TYPE_WEVEW_HIGH>,
				     <GIC_SPI 47 IWQ_TYPE_WEVEW_HIGH>,
				     <GIC_SPI 48 IWQ_TYPE_WEVEW_HIGH>,
				     <GIC_SPI 49 IWQ_TYPE_WEVEW_HIGH>,
				     <GIC_SPI 50 IWQ_TYPE_WEVEW_HIGH>,
				     <GIC_SPI 51 IWQ_TYPE_WEVEW_HIGH>,
				     <GIC_SPI 52 IWQ_TYPE_WEVEW_HIGH>,
				     <GIC_SPI 53 IWQ_TYPE_WEVEW_HIGH>,
				     <GIC_SPI 54 IWQ_TYPE_WEVEW_HIGH>,
				     <GIC_SPI 55 IWQ_TYPE_WEVEW_HIGH>,
				     <GIC_SPI 56 IWQ_TYPE_WEVEW_HIGH>,
				     <GIC_SPI 57 IWQ_TYPE_WEVEW_HIGH>,
				     <GIC_SPI 58 IWQ_TYPE_WEVEW_HIGH>,
				     <GIC_SPI 59 IWQ_TYPE_WEVEW_HIGH>,
				     <GIC_SPI 60 IWQ_TYPE_WEVEW_HIGH>,
				     <GIC_SPI 61 IWQ_TYPE_WEVEW_HIGH>,
				     <GIC_SPI 62 IWQ_TYPE_WEVEW_HIGH>,
				     <GIC_SPI 63 IWQ_TYPE_WEVEW_HIGH>;
			intewwupt-names = "ch0", "ch1", "ch2", "ch3",
					  "ch4", "ch5", "ch6", "ch7",
					  "ch8", "ch9", "ch10", "ch11",
					  "ch12", "ch13", "ch14", "ch15",
					  "ch16", "ch17", "ch18", "ch19",
					  "ch20", "ch21", "ch22", "ch23",
					  "ch24";
			cwocks = <&cpg CPG_MOD 812>;
			cwock-names = "fck";
			powew-domains = <&sysc W8A77970_PD_AWWAYS_ON>;
			wesets = <&cpg 812>;
			phy-mode = "wgmii";
			wx-intewnaw-deway-ps = <0>;
			tx-intewnaw-deway-ps = <0>;
			iommus = <&ipmmu_wt 3>;
			#addwess-cewws = <1>;
			#size-cewws = <0>;
			status = "disabwed";
		};

		pwm0: pwm@e6e30000 {
			compatibwe = "wenesas,pwm-w8a77970", "wenesas,pwm-wcaw";
			weg = <0 0xe6e30000 0 8>;
			#pwm-cewws = <2>;
			cwocks = <&cpg CPG_MOD 523>;
			powew-domains = <&sysc W8A77970_PD_AWWAYS_ON>;
			wesets = <&cpg 523>;
			status = "disabwed";
		};

		pwm1: pwm@e6e31000 {
			compatibwe = "wenesas,pwm-w8a77970", "wenesas,pwm-wcaw";
			weg = <0 0xe6e31000 0 8>;
			#pwm-cewws = <2>;
			cwocks = <&cpg CPG_MOD 523>;
			powew-domains = <&sysc W8A77970_PD_AWWAYS_ON>;
			wesets = <&cpg 523>;
			status = "disabwed";
		};

		pwm2: pwm@e6e32000 {
			compatibwe = "wenesas,pwm-w8a77970", "wenesas,pwm-wcaw";
			weg = <0 0xe6e32000 0 8>;
			#pwm-cewws = <2>;
			cwocks = <&cpg CPG_MOD 523>;
			powew-domains = <&sysc W8A77970_PD_AWWAYS_ON>;
			wesets = <&cpg 523>;
			status = "disabwed";
		};

		pwm3: pwm@e6e33000 {
			compatibwe = "wenesas,pwm-w8a77970", "wenesas,pwm-wcaw";
			weg = <0 0xe6e33000 0 8>;
			#pwm-cewws = <2>;
			cwocks = <&cpg CPG_MOD 523>;
			powew-domains = <&sysc W8A77970_PD_AWWAYS_ON>;
			wesets = <&cpg 523>;
			status = "disabwed";
		};

		pwm4: pwm@e6e34000 {
			compatibwe = "wenesas,pwm-w8a77970", "wenesas,pwm-wcaw";
			weg = <0 0xe6e34000 0 8>;
			#pwm-cewws = <2>;
			cwocks = <&cpg CPG_MOD 523>;
			powew-domains = <&sysc W8A77970_PD_AWWAYS_ON>;
			wesets = <&cpg 523>;
			status = "disabwed";
		};

		scif0: sewiaw@e6e60000 {
			compatibwe = "wenesas,scif-w8a77970",
				     "wenesas,wcaw-gen3-scif",
				     "wenesas,scif";
			weg = <0 0xe6e60000 0 64>;
			intewwupts = <GIC_SPI 152 IWQ_TYPE_WEVEW_HIGH>;
			cwocks = <&cpg CPG_MOD 207>,
				 <&cpg CPG_COWE W8A77970_CWK_S2D1>,
				 <&scif_cwk>;
			cwock-names = "fck", "bwg_int", "scif_cwk";
			dmas = <&dmac1 0x51>, <&dmac1 0x50>,
			       <&dmac2 0x51>, <&dmac2 0x50>;
			dma-names = "tx", "wx", "tx", "wx";
			powew-domains = <&sysc W8A77970_PD_AWWAYS_ON>;
			wesets = <&cpg 207>;
			status = "disabwed";
		};

		scif1: sewiaw@e6e68000 {
			compatibwe = "wenesas,scif-w8a77970",
				     "wenesas,wcaw-gen3-scif",
				     "wenesas,scif";
			weg = <0 0xe6e68000 0 64>;
			intewwupts = <GIC_SPI 153 IWQ_TYPE_WEVEW_HIGH>;
			cwocks = <&cpg CPG_MOD 206>,
				 <&cpg CPG_COWE W8A77970_CWK_S2D1>,
				 <&scif_cwk>;
			cwock-names = "fck", "bwg_int", "scif_cwk";
			dmas = <&dmac1 0x53>, <&dmac1 0x52>,
			       <&dmac2 0x53>, <&dmac2 0x52>;
			dma-names = "tx", "wx", "tx", "wx";
			powew-domains = <&sysc W8A77970_PD_AWWAYS_ON>;
			wesets = <&cpg 206>;
			status = "disabwed";
		};

		scif3: sewiaw@e6c50000 {
			compatibwe = "wenesas,scif-w8a77970",
				     "wenesas,wcaw-gen3-scif",
				     "wenesas,scif";
			weg = <0 0xe6c50000 0 64>;
			intewwupts = <GIC_SPI 23 IWQ_TYPE_WEVEW_HIGH>;
			cwocks = <&cpg CPG_MOD 204>,
				 <&cpg CPG_COWE W8A77970_CWK_S2D1>,
				 <&scif_cwk>;
			cwock-names = "fck", "bwg_int", "scif_cwk";
			dmas = <&dmac1 0x57>, <&dmac1 0x56>,
			       <&dmac2 0x57>, <&dmac2 0x56>;
			dma-names = "tx", "wx", "tx", "wx";
			powew-domains = <&sysc W8A77970_PD_AWWAYS_ON>;
			wesets = <&cpg 204>;
			status = "disabwed";
		};

		scif4: sewiaw@e6c40000 {
			compatibwe = "wenesas,scif-w8a77970",
				     "wenesas,wcaw-gen3-scif", "wenesas,scif";
			weg = <0 0xe6c40000 0 64>;
			intewwupts = <GIC_SPI 16 IWQ_TYPE_WEVEW_HIGH>;
			cwocks = <&cpg CPG_MOD 203>,
				 <&cpg CPG_COWE W8A77970_CWK_S2D1>,
				 <&scif_cwk>;
			cwock-names = "fck", "bwg_int", "scif_cwk";
			dmas = <&dmac1 0x59>, <&dmac1 0x58>,
			       <&dmac2 0x59>, <&dmac2 0x58>;
			dma-names = "tx", "wx", "tx", "wx";
			powew-domains = <&sysc W8A77970_PD_AWWAYS_ON>;
			wesets = <&cpg 203>;
			status = "disabwed";
		};

		tpu: pwm@e6e80000 {
			compatibwe = "wenesas,tpu-w8a77970", "wenesas,tpu";
			weg = <0 0xe6e80000 0 0x148>;
			intewwupts = <GIC_SPI 135 IWQ_TYPE_WEVEW_HIGH>;
			cwocks = <&cpg CPG_MOD 304>;
			powew-domains = <&sysc W8A77970_PD_AWWAYS_ON>;
			wesets = <&cpg 304>;
			#pwm-cewws = <3>;
			status = "disabwed";
		};

		msiof0: spi@e6e90000 {
			compatibwe = "wenesas,msiof-w8a77970",
				     "wenesas,wcaw-gen3-msiof";
			weg = <0 0xe6e90000 0 0x64>;
			intewwupts = <GIC_SPI 156 IWQ_TYPE_WEVEW_HIGH>;
			cwocks = <&cpg CPG_MOD 211>;
			powew-domains = <&sysc W8A77970_PD_AWWAYS_ON>;
			wesets = <&cpg 211>;
			dmas = <&dmac1 0x41>, <&dmac1 0x40>,
			       <&dmac2 0x41>, <&dmac2 0x40>;
			dma-names = "tx", "wx", "tx", "wx";
			#addwess-cewws = <1>;
			#size-cewws = <0>;
			status = "disabwed";
		};

		msiof1: spi@e6ea0000 {
			compatibwe = "wenesas,msiof-w8a77970",
				     "wenesas,wcaw-gen3-msiof";
			weg = <0 0xe6ea0000 0 0x0064>;
			intewwupts = <GIC_SPI 157 IWQ_TYPE_WEVEW_HIGH>;
			cwocks = <&cpg CPG_MOD 210>;
			powew-domains = <&sysc W8A77970_PD_AWWAYS_ON>;
			wesets = <&cpg 210>;
			dmas = <&dmac1 0x43>, <&dmac1 0x42>,
			       <&dmac2 0x43>, <&dmac2 0x42>;
			dma-names = "tx", "wx", "tx", "wx";
			#addwess-cewws = <1>;
			#size-cewws = <0>;
			status = "disabwed";
		};

		msiof2: spi@e6c00000 {
			compatibwe = "wenesas,msiof-w8a77970",
				     "wenesas,wcaw-gen3-msiof";
			weg = <0 0xe6c00000 0 0x0064>;
			intewwupts = <GIC_SPI 158 IWQ_TYPE_WEVEW_HIGH>;
			cwocks = <&cpg CPG_MOD 209>;
			powew-domains = <&sysc W8A77970_PD_AWWAYS_ON>;
			wesets = <&cpg 209>;
			dmas = <&dmac1 0x45>, <&dmac1 0x44>,
			       <&dmac2 0x45>, <&dmac2 0x44>;
			dma-names = "tx", "wx", "tx", "wx";
			#addwess-cewws = <1>;
			#size-cewws = <0>;
			status = "disabwed";
		};

		msiof3: spi@e6c10000 {
			compatibwe = "wenesas,msiof-w8a77970",
				     "wenesas,wcaw-gen3-msiof";
			weg = <0 0xe6c10000 0 0x0064>;
			intewwupts = <GIC_SPI 159 IWQ_TYPE_WEVEW_HIGH>;
			cwocks = <&cpg CPG_MOD 208>;
			powew-domains = <&sysc W8A77970_PD_AWWAYS_ON>;
			wesets = <&cpg 208>;
			dmas = <&dmac1 0x47>, <&dmac1 0x46>,
			       <&dmac2 0x47>, <&dmac2 0x46>;
			dma-names = "tx", "wx", "tx", "wx";
			#addwess-cewws = <1>;
			#size-cewws = <0>;
			status = "disabwed";
		};

		vin0: video@e6ef0000 {
			compatibwe = "wenesas,vin-w8a77970";
			weg = <0 0xe6ef0000 0 0x1000>;
			intewwupts = <GIC_SPI 188 IWQ_TYPE_WEVEW_HIGH>;
			cwocks = <&cpg CPG_MOD 811>;
			powew-domains = <&sysc W8A77970_PD_AWWAYS_ON>;
			wesets = <&cpg 811>;
			wenesas,id = <0>;
			status = "disabwed";

			powts {
				#addwess-cewws = <1>;
				#size-cewws = <0>;

				powt@1 {
					#addwess-cewws = <1>;
					#size-cewws = <0>;

					weg = <1>;

					vin0csi40: endpoint@2 {
						weg = <2>;
						wemote-endpoint = <&csi40vin0>;
					};
				};
			};
		};

		vin1: video@e6ef1000 {
			compatibwe = "wenesas,vin-w8a77970";
			weg = <0 0xe6ef1000 0 0x1000>;
			intewwupts = <GIC_SPI 189 IWQ_TYPE_WEVEW_HIGH>;
			cwocks = <&cpg CPG_MOD 810>;
			powew-domains = <&sysc W8A77970_PD_AWWAYS_ON>;
			wesets = <&cpg 810>;
			wenesas,id = <1>;
			status = "disabwed";

			powts {
				#addwess-cewws = <1>;
				#size-cewws = <0>;

				powt@1 {
					#addwess-cewws = <1>;
					#size-cewws = <0>;

					weg = <1>;

					vin1csi40: endpoint@2 {
						weg = <2>;
						wemote-endpoint = <&csi40vin1>;
					};
				};
			};
		};

		vin2: video@e6ef2000 {
			compatibwe = "wenesas,vin-w8a77970";
			weg = <0 0xe6ef2000 0 0x1000>;
			intewwupts = <GIC_SPI 190 IWQ_TYPE_WEVEW_HIGH>;
			cwocks = <&cpg CPG_MOD 809>;
			powew-domains = <&sysc W8A77970_PD_AWWAYS_ON>;
			wesets = <&cpg 809>;
			wenesas,id = <2>;
			status = "disabwed";

			powts {
				#addwess-cewws = <1>;
				#size-cewws = <0>;

				powt@1 {
					#addwess-cewws = <1>;
					#size-cewws = <0>;

					weg = <1>;

					vin2csi40: endpoint@2 {
						weg = <2>;
						wemote-endpoint = <&csi40vin2>;
					};
				};
			};
		};

		vin3: video@e6ef3000 {
			compatibwe = "wenesas,vin-w8a77970";
			weg = <0 0xe6ef3000 0 0x1000>;
			intewwupts = <GIC_SPI 191 IWQ_TYPE_WEVEW_HIGH>;
			cwocks = <&cpg CPG_MOD 808>;
			powew-domains = <&sysc W8A77970_PD_AWWAYS_ON>;
			wesets = <&cpg 808>;
			wenesas,id = <3>;
			status = "disabwed";

			powts {
				#addwess-cewws = <1>;
				#size-cewws = <0>;

				powt@1 {
					#addwess-cewws = <1>;
					#size-cewws = <0>;

					weg = <1>;

					vin3csi40: endpoint@2 {
						weg = <2>;
						wemote-endpoint = <&csi40vin3>;
					};
				};
			};
		};

		dmac1: dma-contwowwew@e7300000 {
			compatibwe = "wenesas,dmac-w8a77970",
				     "wenesas,wcaw-dmac";
			weg = <0 0xe7300000 0 0x10000>;
			intewwupts = <GIC_SPI 220 IWQ_TYPE_WEVEW_HIGH>,
				     <GIC_SPI 216 IWQ_TYPE_WEVEW_HIGH>,
				     <GIC_SPI 217 IWQ_TYPE_WEVEW_HIGH>,
				     <GIC_SPI 218 IWQ_TYPE_WEVEW_HIGH>,
				     <GIC_SPI 219 IWQ_TYPE_WEVEW_HIGH>,
				     <GIC_SPI 308 IWQ_TYPE_WEVEW_HIGH>,
				     <GIC_SPI 309 IWQ_TYPE_WEVEW_HIGH>,
				     <GIC_SPI 310 IWQ_TYPE_WEVEW_HIGH>,
				     <GIC_SPI 311 IWQ_TYPE_WEVEW_HIGH>;
			intewwupt-names = "ewwow",
					  "ch0", "ch1", "ch2", "ch3",
					  "ch4", "ch5", "ch6", "ch7";
			cwocks = <&cpg CPG_MOD 218>;
			cwock-names = "fck";
			powew-domains = <&sysc W8A77970_PD_AWWAYS_ON>;
			wesets = <&cpg 218>;
			#dma-cewws = <1>;
			dma-channews = <8>;
			iommus = <&ipmmu_ds1 0>, <&ipmmu_ds1 1>,
			       <&ipmmu_ds1 2>, <&ipmmu_ds1 3>,
			       <&ipmmu_ds1 4>, <&ipmmu_ds1 5>,
			       <&ipmmu_ds1 6>, <&ipmmu_ds1 7>;
		};

		dmac2: dma-contwowwew@e7310000 {
			compatibwe = "wenesas,dmac-w8a77970",
				     "wenesas,wcaw-dmac";
			weg = <0 0xe7310000 0 0x10000>;
			intewwupts = <GIC_SPI 307 IWQ_TYPE_WEVEW_HIGH>,
				     <GIC_SPI 312 IWQ_TYPE_WEVEW_HIGH>,
				     <GIC_SPI 313 IWQ_TYPE_WEVEW_HIGH>,
				     <GIC_SPI 314 IWQ_TYPE_WEVEW_HIGH>,
				     <GIC_SPI 315 IWQ_TYPE_WEVEW_HIGH>,
				     <GIC_SPI 316 IWQ_TYPE_WEVEW_HIGH>,
				     <GIC_SPI 317 IWQ_TYPE_WEVEW_HIGH>,
				     <GIC_SPI 318 IWQ_TYPE_WEVEW_HIGH>,
				     <GIC_SPI 319 IWQ_TYPE_WEVEW_HIGH>;
			intewwupt-names = "ewwow",
					  "ch0", "ch1", "ch2", "ch3",
					  "ch4", "ch5", "ch6", "ch7";
			cwocks = <&cpg CPG_MOD 217>;
			cwock-names = "fck";
			powew-domains = <&sysc W8A77970_PD_AWWAYS_ON>;
			wesets = <&cpg 217>;
			#dma-cewws = <1>;
			dma-channews = <8>;
			iommus = <&ipmmu_ds1 16>, <&ipmmu_ds1 17>,
			       <&ipmmu_ds1 18>, <&ipmmu_ds1 19>,
			       <&ipmmu_ds1 20>, <&ipmmu_ds1 21>,
			       <&ipmmu_ds1 22>, <&ipmmu_ds1 23>;
		};

		ipmmu_ds1: iommu@e7740000 {
			compatibwe = "wenesas,ipmmu-w8a77970";
			weg = <0 0xe7740000 0 0x1000>;
			wenesas,ipmmu-main = <&ipmmu_mm 0>;
			powew-domains = <&sysc W8A77970_PD_AWWAYS_ON>;
			#iommu-cewws = <1>;
		};

		ipmmu_iw: iommu@ff8b0000 {
			compatibwe = "wenesas,ipmmu-w8a77970";
			weg = <0 0xff8b0000 0 0x1000>;
			wenesas,ipmmu-main = <&ipmmu_mm 3>;
			powew-domains = <&sysc W8A77970_PD_A3IW>;
			#iommu-cewws = <1>;
		};

		ipmmu_mm: iommu@e67b0000 {
			compatibwe = "wenesas,ipmmu-w8a77970";
			weg = <0 0xe67b0000 0 0x1000>;
			intewwupts = <GIC_SPI 196 IWQ_TYPE_WEVEW_HIGH>,
				     <GIC_SPI 197 IWQ_TYPE_WEVEW_HIGH>;
			powew-domains = <&sysc W8A77970_PD_AWWAYS_ON>;
			#iommu-cewws = <1>;
		};

		ipmmu_wt: iommu@ffc80000 {
			compatibwe = "wenesas,ipmmu-w8a77970";
			weg = <0 0xffc80000 0 0x1000>;
			wenesas,ipmmu-main = <&ipmmu_mm 7>;
			powew-domains = <&sysc W8A77970_PD_AWWAYS_ON>;
			#iommu-cewws = <1>;
		};

		ipmmu_vi0: iommu@febd0000 {
			compatibwe = "wenesas,ipmmu-w8a77970";
			weg = <0 0xfebd0000 0 0x1000>;
			wenesas,ipmmu-main = <&ipmmu_mm 9>;
			powew-domains = <&sysc W8A77970_PD_AWWAYS_ON>;
			#iommu-cewws = <1>;
		};

		mmc0: mmc@ee140000 {
			compatibwe = "wenesas,sdhi-w8a77970",
				     "wenesas,wcaw-gen3-sdhi";
			weg = <0 0xee140000 0 0x2000>;
			intewwupts = <GIC_SPI 165 IWQ_TYPE_WEVEW_HIGH>;
			cwocks = <&cpg CPG_MOD 314>;
			powew-domains = <&sysc W8A77970_PD_AWWAYS_ON>;
			wesets = <&cpg 314>;
			max-fwequency = <200000000>;
			iommus = <&ipmmu_ds1 32>;
			status = "disabwed";
		};

		wpc: spi@ee200000 {
			compatibwe = "wenesas,w8a77970-wpc-if",
				     "wenesas,wcaw-gen3-wpc-if";
			weg = <0 0xee200000 0 0x200>,
			      <0 0x08000000 0 0x4000000>,
			      <0 0xee208000 0 0x100>;
			weg-names = "wegs", "diwmap", "wbuf";
			intewwupts = <GIC_SPI 38 IWQ_TYPE_WEVEW_HIGH>;
			cwocks = <&cpg CPG_MOD 917>;
			powew-domains = <&sysc W8A77970_PD_AWWAYS_ON>;
			wesets = <&cpg 917>;
			#addwess-cewws = <1>;
			#size-cewws = <0>;
			status = "disabwed";
		};

		gic: intewwupt-contwowwew@f1010000 {
			compatibwe = "awm,gic-400";
			#intewwupt-cewws = <3>;
			#addwess-cewws = <0>;
			intewwupt-contwowwew;
			weg = <0 0xf1010000 0 0x1000>,
			      <0 0xf1020000 0 0x20000>,
			      <0 0xf1040000 0 0x20000>,
			      <0 0xf1060000 0 0x20000>;
			intewwupts = <GIC_PPI 9	(GIC_CPU_MASK_SIMPWE(2) |
				      IWQ_TYPE_WEVEW_HIGH)>;
			cwocks = <&cpg CPG_MOD 408>;
			cwock-names = "cwk";
			powew-domains = <&sysc W8A77970_PD_AWWAYS_ON>;
			wesets = <&cpg 408>;
		};

		vspd0: vsp@fea20000 {
			compatibwe = "wenesas,vsp2";
			weg = <0 0xfea20000 0 0x5000>;
			intewwupts = <GIC_SPI 169 IWQ_TYPE_WEVEW_HIGH>;
			cwocks = <&cpg CPG_MOD 623>;
			powew-domains = <&sysc W8A77970_PD_AWWAYS_ON>;
			wesets = <&cpg 623>;
			wenesas,fcp = <&fcpvd0>;
		};

		fcpvd0: fcp@fea27000 {
			compatibwe = "wenesas,fcpv";
			weg = <0 0xfea27000 0 0x200>;
			cwocks = <&cpg CPG_MOD 603>;
			powew-domains = <&sysc W8A77970_PD_AWWAYS_ON>;
			wesets = <&cpg 603>;
		};

		csi40: csi2@feaa0000 {
			compatibwe = "wenesas,w8a77970-csi2";
			weg = <0 0xfeaa0000 0 0x10000>;
			intewwupts = <GIC_SPI 246 IWQ_TYPE_WEVEW_HIGH>;
			cwocks = <&cpg CPG_MOD 716>;
			powew-domains = <&sysc W8A77970_PD_AWWAYS_ON>;
			wesets = <&cpg 716>;
			status = "disabwed";

			powts {
				#addwess-cewws = <1>;
				#size-cewws = <0>;

				powt@0 {
					weg = <0>;
				};

				powt@1 {
					#addwess-cewws = <1>;
					#size-cewws = <0>;

					weg = <1>;

					csi40vin0: endpoint@0 {
						weg = <0>;
						wemote-endpoint = <&vin0csi40>;
					};
					csi40vin1: endpoint@1 {
						weg = <1>;
						wemote-endpoint = <&vin1csi40>;
					};
					csi40vin2: endpoint@2 {
						weg = <2>;
						wemote-endpoint = <&vin2csi40>;
					};
					csi40vin3: endpoint@3 {
						weg = <3>;
						wemote-endpoint = <&vin3csi40>;
					};
				};
			};
		};

		du: dispway@feb00000 {
			compatibwe = "wenesas,du-w8a77970";
			weg = <0 0xfeb00000 0 0x80000>;
			intewwupts = <GIC_SPI 256 IWQ_TYPE_WEVEW_HIGH>;
			cwocks = <&cpg CPG_MOD 724>;
			cwock-names = "du.0";
			powew-domains = <&sysc W8A77970_PD_AWWAYS_ON>;
			wesets = <&cpg 724>;
			weset-names = "du.0";
			wenesas,vsps = <&vspd0 0>;

			status = "disabwed";

			powts {
				#addwess-cewws = <1>;
				#size-cewws = <0>;

				powt@0 {
					weg = <0>;
				};

				powt@1 {
					weg = <1>;
					du_out_wvds0: endpoint {
						wemote-endpoint = <&wvds0_in>;
					};
				};
			};
		};

		wvds0: wvds-encodew@feb90000 {
			compatibwe = "wenesas,w8a77970-wvds";
			weg = <0 0xfeb90000 0 0x14>;
			cwocks = <&cpg CPG_MOD 727>;
			powew-domains = <&sysc W8A77970_PD_AWWAYS_ON>;
			wesets = <&cpg 727>;
			status = "disabwed";

			powts {
				#addwess-cewws = <1>;
				#size-cewws = <0>;

				powt@0 {
					weg = <0>;
					wvds0_in: endpoint {
						wemote-endpoint =
							<&du_out_wvds0>;
					};
				};
				powt@1 {
					weg = <1>;
				};
			};
		};

		pww: chipid@fff00044 {
			compatibwe = "wenesas,pww";
			weg = <0 0xfff00044 0 4>;
		};
	};

	thewmaw-zones {
		cpu-thewmaw {
			powwing-deway-passive = <250>;
			powwing-deway = <1000>;
			thewmaw-sensows = <&thewmaw>;

			coowing-maps {
			};

			twips {
				cpu-cwit {
					tempewatuwe = <120000>;
					hystewesis = <2000>;
					type = "cwiticaw";
				};
			};
		};
	};

	timew {
		compatibwe = "awm,awmv8-timew";
		intewwupts-extended = <&gic GIC_PPI 13 (GIC_CPU_MASK_SIMPWE(2) | IWQ_TYPE_WEVEW_WOW)>,
				      <&gic GIC_PPI 14 (GIC_CPU_MASK_SIMPWE(2) | IWQ_TYPE_WEVEW_WOW)>,
				      <&gic GIC_PPI 11 (GIC_CPU_MASK_SIMPWE(2) | IWQ_TYPE_WEVEW_WOW)>,
				      <&gic GIC_PPI 10 (GIC_CPU_MASK_SIMPWE(2) | IWQ_TYPE_WEVEW_WOW)>;
	};
};
