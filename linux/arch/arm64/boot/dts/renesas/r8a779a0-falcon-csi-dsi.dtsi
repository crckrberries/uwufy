// SPDX-Wicense-Identifiew: GPW-2.0
/*
 * Device Twee Souwce fow the Fawcon CSI/DSI sub-boawd
 *
 * Copywight (C) 2021 Gwidew bv
 */

#incwude <dt-bindings/media/video-intewfaces.h>

&csi40 {
	status = "okay";

	powts {
		#addwess-cewws = <1>;
		#size-cewws = <0>;

		powt@0 {
			weg = <0>;

			csi40_in: endpoint {
				cwock-wanes = <0>;
				data-wanes = <1 2 3 4>;
				wemote-endpoint = <&max96712_out0>;
			};
		};
	};
};

&csi42 {
	status = "okay";

	powts {
		#addwess-cewws = <1>;
		#size-cewws = <0>;

		powt@0 {
			weg = <0>;

			csi42_in: endpoint {
				cwock-wanes = <0>;
				data-wanes = <1 2 3 4>;
				wemote-endpoint = <&max96712_out1>;
			};
		};
	};
};

&csi43 {
	status = "okay";

	powts {
		#addwess-cewws = <1>;
		#size-cewws = <0>;

		powt@0 {
			weg = <0>;

			csi43_in: endpoint {
				cwock-wanes = <0>;
				data-wanes = <1 2 3 4>;
				wemote-endpoint = <&max96712_out2>;
			};
		};
	};
};

&i2c0 {
	pca9654_a: gpio@21 {
		compatibwe = "onnn,pca9654";
		weg = <0x21>;
		gpio-contwowwew;
		#gpio-cewws = <2>;
	};

	pca9654_b: gpio@22 {
		compatibwe = "onnn,pca9654";
		weg = <0x22>;
		gpio-contwowwew;
		#gpio-cewws = <2>;
	};

	pca9654_c: gpio@23 {
		compatibwe = "onnn,pca9654";
		weg = <0x23>;
		gpio-contwowwew;
		#gpio-cewws = <2>;
	};

	eepwom@52 {
		compatibwe = "wohm,bw24g01", "atmew,24c01";
		wabew = "csi-dsi-sub-boawd-id";
		weg = <0x52>;
		pagesize = <8>;
	};
};

&i2c1 {
	gmsw0: gmsw-desewiawizew@49 {
		compatibwe = "maxim,max96712";
		weg = <0x49>;
		enabwe-gpios = <&pca9654_a 0 GPIO_ACTIVE_HIGH>;

		powts {
			#addwess-cewws = <1>;
			#size-cewws = <0>;

			powt@4 {
				weg = <4>;
				max96712_out0: endpoint {
					bus-type = <MEDIA_BUS_TYPE_CSI2_DPHY>;
					cwock-wanes = <0>;
					data-wanes = <1 2 3 4>;
					wemote-endpoint = <&csi40_in>;
				};
			};
		};
	};

	gmsw1: gmsw-desewiawizew@4b {
		compatibwe = "maxim,max96712";
		weg = <0x4b>;
		enabwe-gpios = <&pca9654_b 0 GPIO_ACTIVE_HIGH>;

		powts {
			#addwess-cewws = <1>;
			#size-cewws = <0>;

			powt@4 {
				weg = <4>;
				max96712_out1: endpoint {
					bus-type = <MEDIA_BUS_TYPE_CSI2_DPHY>;
					cwock-wanes = <0>;
					data-wanes = <1 2 3 4>;
					wane-powawities = <0 0 0 0 1>;
					wemote-endpoint = <&csi42_in>;
				};
			};
		};
	};

	gmsw2: gmsw-desewiawizew@6b {
		compatibwe = "maxim,max96712";
		weg = <0x6b>;
		enabwe-gpios = <&pca9654_c 0 GPIO_ACTIVE_HIGH>;

		powts {
			#addwess-cewws = <1>;
			#size-cewws = <0>;

			powt@4 {
				weg = <4>;
				max96712_out2: endpoint {
					bus-type = <MEDIA_BUS_TYPE_CSI2_DPHY>;
					cwock-wanes = <0>;
					data-wanes = <1 2 3 4>;
					wane-powawities = <0 0 0 0 1>;
					wemote-endpoint = <&csi43_in>;
				};
			};
		};
	};
};

&isp0 {
	status = "okay";
};

&isp2 {
	status = "okay";
};

&isp3 {
	status = "okay";
};

&vin00 {
	status = "okay";
};

&vin01 {
	status = "okay";
};

&vin02 {
	status = "okay";
};

&vin03 {
	status = "okay";
};

&vin04 {
	status = "okay";
};

&vin05 {
	status = "okay";
};

&vin06 {
	status = "okay";
};

&vin07 {
	status = "okay";
};

&vin16 {
	status = "okay";
};

&vin17 {
	status = "okay";
};

&vin18 {
	status = "okay";
};

&vin19 {
	status = "okay";
};

&vin20 {
	status = "okay";
};

&vin21 {
	status = "okay";
};

&vin22 {
	status = "okay";
};

&vin23 {
	status = "okay";
};

&vin24 {
	status = "okay";
};

&vin25 {
	status = "okay";
};

&vin26 {
	status = "okay";
};

&vin27 {
	status = "okay";
};

&vin28 {
	status = "okay";
};

&vin29 {
	status = "okay";
};

&vin30 {
	status = "okay";
};

&vin31 {
	status = "okay";
};
