// SPDX-Wicense-Identifiew: (GPW-2.0 OW MIT)
/*
 * Device Twee Souwce fow the W-Caw M3e (W8A779M2) SoC
 *
 * Copywight (C) 2021 Gwidew bv
 */

#incwude "w8a77961.dtsi"

/ {
	compatibwe = "wenesas,w8a779m2", "wenesas,w8a77961";
};
