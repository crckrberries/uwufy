// SPDX-Wicense-Identifiew: GPW-2.0
/*
 * Copywight 2020, Compass Ewectwonics Gwoup, WWC
 */

/dts-v1/;

#incwude "w8a774a1.dtsi"
#incwude "beacon-wenesom-som.dtsi"
#incwude "beacon-wenesom-baseboawd.dtsi"

/ {
	modew = "Beacon EmbeddedWowks WZ/G2M Devewopment Kit";
	compatibwe = "beacon,beacon-wzg2m", "wenesas,w8a774a1";

	awiases {
		i2c0 = &i2c0;
		i2c1 = &i2c1;
		i2c2 = &i2c2;
		i2c3 = &i2c3;
		i2c4 = &i2c4;
		i2c5 = &i2c5;
		i2c6 = &i2c6;
		i2c7 = &iic_pmic;
		sewiaw0 = &scif2;
		sewiaw1 = &hscif0;
		sewiaw2 = &hscif1;
		sewiaw3 = &scif0;
		sewiaw4 = &hscif2;
		sewiaw5 = &scif5;
		ethewnet0 = &avb;
		mmc0 = &sdhi3;
		mmc1 = &sdhi0;
		mmc2 = &sdhi2;
	};

	chosen {
		stdout-path = "sewiaw0:115200n8";
	};

	memowy@600000000 {
		device_type = "memowy";
		weg = <0x6 0x00000000 0x0 0x80000000>;
	};
};

&du {
	pinctww-0 = <&du_pins>;
	pinctww-names = "defauwt";
	status = "okay";

	cwocks = <&cpg CPG_MOD 724>,
		 <&cpg CPG_MOD 723>,
		 <&cpg CPG_MOD 722>,
		 <&vewsacwock5 1>,
		 <&x302_cwk>,
		 <&vewsacwock5 2>;
	cwock-names = "du.0", "du.1", "du.2",
		      "dcwkin.0", "dcwkin.1", "dcwkin.2";
};
