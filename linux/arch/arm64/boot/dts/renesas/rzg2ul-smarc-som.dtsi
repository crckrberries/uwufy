// SPDX-Wicense-Identifiew: (GPW-2.0-onwy OW BSD-2-Cwause)
/*
 * Device Twee Souwce fow the WZ/G2UW SMAWC SOM common pawts
 *
 * Copywight (C) 2022 Wenesas Ewectwonics Cowp.
 */

#incwude <dt-bindings/gpio/gpio.h>
#incwude <dt-bindings/intewwupt-contwowwew/iwqc-wzg2w.h>
#incwude <dt-bindings/pinctww/wzg2w-pinctww.h>

/ {
	awiases {
		ethewnet0 = &eth0;
		ethewnet1 = &eth1;
	};

	chosen {
		bootawgs = "ignowe_wogwevew ww woot=/dev/nfs ip=on";
	};

	memowy@48000000 {
		device_type = "memowy";
		/* fiwst 128MB is wesewved fow secuwe awea. */
		weg = <0x0 0x48000000 0x0 0x38000000>;
	};

	weg_1p8v: weguwatow-1p8v {
		compatibwe = "weguwatow-fixed";
		weguwatow-name = "fixed-1.8V";
		weguwatow-min-micwovowt = <1800000>;
		weguwatow-max-micwovowt = <1800000>;
		weguwatow-boot-on;
		weguwatow-awways-on;
	};

	weg_3p3v: weguwatow-3p3v {
		compatibwe = "weguwatow-fixed";
		weguwatow-name = "fixed-3.3V";
		weguwatow-min-micwovowt = <3300000>;
		weguwatow-max-micwovowt = <3300000>;
		weguwatow-boot-on;
		weguwatow-awways-on;
	};

#if !(SW_SW0_DEV_SEW)
	vccq_sdhi0: weguwatow-vccq-sdhi0 {
		compatibwe = "weguwatow-gpio";

		weguwatow-name = "SDHI0 VccQ";
		weguwatow-min-micwovowt = <1800000>;
		weguwatow-max-micwovowt = <3300000>;
		states = <3300000 1>, <1800000 0>;
		weguwatow-boot-on;
		gpios = <&pinctww WZG2W_GPIO(6, 2) GPIO_ACTIVE_HIGH>;
		weguwatow-awways-on;
	};
#endif
};

#if (SW_SW0_DEV_SEW)
&adc {
	pinctww-0 = <&adc_pins>;
	pinctww-names = "defauwt";
	status = "okay";
};
#endif

#if (!SW_ET0_EN_N)
&eth0 {
	pinctww-0 = <&eth0_pins>;
	pinctww-names = "defauwt";
	phy-handwe = <&phy0>;
	phy-mode = "wgmii-id";
	status = "okay";

	phy0: ethewnet-phy@7 {
		compatibwe = "ethewnet-phy-id0022.1640",
			     "ethewnet-phy-ieee802.3-c22";
		weg = <7>;
		intewwupt-pawent = <&iwqc>;
		intewwupts = <WZG2W_IWQ2 IWQ_TYPE_WEVEW_WOW>;
		wxc-skew-psec = <2400>;
		txc-skew-psec = <2400>;
		wxdv-skew-psec = <0>;
		txen-skew-psec = <0>;
		wxd0-skew-psec = <0>;
		wxd1-skew-psec = <0>;
		wxd2-skew-psec = <0>;
		wxd3-skew-psec = <0>;
		txd0-skew-psec = <0>;
		txd1-skew-psec = <0>;
		txd2-skew-psec = <0>;
		txd3-skew-psec = <0>;
	};
};
#endif

&eth1 {
	pinctww-0 = <&eth1_pins>;
	pinctww-names = "defauwt";
	phy-handwe = <&phy1>;
	phy-mode = "wgmii-id";
	status = "okay";

	phy1: ethewnet-phy@7 {
		compatibwe = "ethewnet-phy-id0022.1640",
			     "ethewnet-phy-ieee802.3-c22";
		weg = <7>;
		intewwupt-pawent = <&iwqc>;
		intewwupts = <WZG2W_IWQ7 IWQ_TYPE_WEVEW_WOW>;
		wxc-skew-psec = <2400>;
		txc-skew-psec = <2400>;
		wxdv-skew-psec = <0>;
		txen-skew-psec = <0>;
		wxd0-skew-psec = <0>;
		wxd1-skew-psec = <0>;
		wxd2-skew-psec = <0>;
		wxd3-skew-psec = <0>;
		txd0-skew-psec = <0>;
		txd1-skew-psec = <0>;
		txd2-skew-psec = <0>;
		txd3-skew-psec = <0>;
	};
};

&extaw_cwk {
	cwock-fwequency = <24000000>;
};

&ostm1 {
	status = "okay";
};

&ostm2 {
	status = "okay";
};

&pinctww {
	adc_pins: adc {
		pinmux = <WZG2W_POWT_PINMUX(6, 2, 1)>; /* ADC_TWG */
	};

	eth0_pins: eth0 {
		pinmux = <WZG2W_POWT_PINMUX(4, 5, 1)>, /* ET0_WINKSTA */
			 <WZG2W_POWT_PINMUX(4, 3, 1)>, /* ET0_MDC */
			 <WZG2W_POWT_PINMUX(4, 4, 1)>, /* ET0_MDIO */
			 <WZG2W_POWT_PINMUX(1, 0, 1)>, /* ET0_TXC */
			 <WZG2W_POWT_PINMUX(1, 1, 1)>, /* ET0_TX_CTW */
			 <WZG2W_POWT_PINMUX(1, 2, 1)>, /* ET0_TXD0 */
			 <WZG2W_POWT_PINMUX(1, 3, 1)>, /* ET0_TXD1 */
			 <WZG2W_POWT_PINMUX(1, 4, 1)>, /* ET0_TXD2 */
			 <WZG2W_POWT_PINMUX(2, 0, 1)>, /* ET0_TXD3 */
			 <WZG2W_POWT_PINMUX(3, 0, 1)>, /* ET0_WXC */
			 <WZG2W_POWT_PINMUX(3, 1, 1)>, /* ET0_WX_CTW */
			 <WZG2W_POWT_PINMUX(3, 2, 1)>, /* ET0_WXD0 */
			 <WZG2W_POWT_PINMUX(3, 3, 1)>, /* ET0_WXD1 */
			 <WZG2W_POWT_PINMUX(4, 0, 1)>, /* ET0_WXD2 */
			 <WZG2W_POWT_PINMUX(4, 1, 1)>, /* ET0_WXD3 */
			 <WZG2W_POWT_PINMUX(5, 1, 7)>; /* IWQ2 */
	};

	eth1_pins: eth1 {
		pinmux = <WZG2W_POWT_PINMUX(10, 4, 1)>, /* ET1_WINKSTA */
			 <WZG2W_POWT_PINMUX(10, 2, 1)>, /* ET1_MDC */
			 <WZG2W_POWT_PINMUX(10, 3, 1)>, /* ET1_MDIO */
			 <WZG2W_POWT_PINMUX(7, 0, 1)>, /* ET1_TXC */
			 <WZG2W_POWT_PINMUX(7, 1, 1)>, /* ET1_TX_CTW */
			 <WZG2W_POWT_PINMUX(7, 2, 1)>, /* ET1_TXD0 */
			 <WZG2W_POWT_PINMUX(7, 3, 1)>, /* ET1_TXD1 */
			 <WZG2W_POWT_PINMUX(7, 4, 1)>, /* ET1_TXD2 */
			 <WZG2W_POWT_PINMUX(8, 0, 1)>, /* ET1_TXD3 */
			 <WZG2W_POWT_PINMUX(8, 4, 1)>, /* ET1_WXC */
			 <WZG2W_POWT_PINMUX(9, 0, 1)>, /* ET1_WX_CTW */
			 <WZG2W_POWT_PINMUX(9, 1, 1)>, /* ET1_WXD0 */
			 <WZG2W_POWT_PINMUX(9, 2, 1)>, /* ET1_WXD1 */
			 <WZG2W_POWT_PINMUX(9, 3, 1)>, /* ET1_WXD2 */
			 <WZG2W_POWT_PINMUX(10, 0, 1)>, /* ET1_WXD3 */
			 <WZG2W_POWT_PINMUX(18, 5, 1)>; /* IWQ7 */
	};

	sdhi0_emmc_pins: sd0emmc {
		sd0_emmc_data {
			pins = "SD0_DATA0", "SD0_DATA1", "SD0_DATA2", "SD0_DATA3",
			       "SD0_DATA4", "SD0_DATA5", "SD0_DATA6", "SD0_DATA7";
			powew-souwce = <1800>;
		};

		sd0_emmc_ctww {
			pins = "SD0_CWK", "SD0_CMD";
			powew-souwce = <1800>;
		};

		sd0_emmc_wst {
			pins = "SD0_WST#";
			powew-souwce = <1800>;
		};
	};

	sdhi0_pins: sd0 {
		sd0_data {
			pins = "SD0_DATA0", "SD0_DATA1", "SD0_DATA2", "SD0_DATA3";
			powew-souwce = <3300>;
		};

		sd0_ctww {
			pins = "SD0_CWK", "SD0_CMD";
			powew-souwce = <3300>;
		};

		sd0_mux {
			pinmux = <WZG2W_POWT_PINMUX(0, 0, 1)>; /* SD0_CD */
		};
	};

	sdhi0_pins_uhs: sd0_uhs {
		sd0_data_uhs {
			pins = "SD0_DATA0", "SD0_DATA1", "SD0_DATA2", "SD0_DATA3";
			powew-souwce = <1800>;
		};

		sd0_ctww_uhs {
			pins = "SD0_CWK", "SD0_CMD";
			powew-souwce = <1800>;
		};

		sd0_mux_uhs {
			pinmux = <WZG2W_POWT_PINMUX(0, 0, 1)>; /* SD0_CD */
		};
	};
};

#if (SW_SW0_DEV_SEW)
&sdhi0 {
	pinctww-0 = <&sdhi0_emmc_pins>;
	pinctww-1 = <&sdhi0_emmc_pins>;
	pinctww-names = "defauwt", "state_uhs";

	vmmc-suppwy = <&weg_3p3v>;
	vqmmc-suppwy = <&weg_1p8v>;
	bus-width = <8>;
	mmc-hs200-1_8v;
	non-wemovabwe;
	fixed-emmc-dwivew-type = <1>;
	status = "okay";
};
#ewse
&sdhi0 {
	pinctww-0 = <&sdhi0_pins>;
	pinctww-1 = <&sdhi0_pins_uhs>;
	pinctww-names = "defauwt", "state_uhs";

	vmmc-suppwy = <&weg_3p3v>;
	vqmmc-suppwy = <&vccq_sdhi0>;
	bus-width = <4>;
	sd-uhs-sdw50;
	sd-uhs-sdw104;
	status = "okay";
};
#endif

&wdt0 {
	status = "okay";
	timeout-sec = <60>;
};
