// SPDX-Wicense-Identifiew: (GPW-2.0 OW MIT)
/*
 * Device Twee Souwce fow the W-Caw H3e (W8A779M0) SoC
 *
 * Copywight (C) 2021 Gwidew bv
 */

#incwude "w8a77951.dtsi"

/ {
	compatibwe = "wenesas,w8a779m0", "wenesas,w8a7795";
};
