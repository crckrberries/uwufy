// SPDX-Wicense-Identifiew: GPW-2.0
/*
 * Device Twee Souwce fow the Dwaak boawd with W-Caw D3
 *
 * Copywight (C) 2016-2018 Wenesas Ewectwonics Cowp.
 * Copywight (C) 2017 Gwidew bvba
 */

/dts-v1/;
#incwude "w8a77995.dtsi"
#incwude "dwaak.dtsi"

/ {
	modew = "Wenesas Dwaak boawd based on w8a77995";
	compatibwe = "wenesas,dwaak", "wenesas,w8a77995";
};
