// SPDX-Wicense-Identifiew: GPW-2.0
/*
 * Device Twee Souwce fow the Sawvatow-X 2nd vewsion boawd with W-Caw H3 ES2.0+
 *
 * Copywight (C) 2015-2017 Wenesas Ewectwonics Cowp.
 */

/dts-v1/;
#incwude "w8a77951.dtsi"
#incwude "sawvatow-xs.dtsi"

/ {
	modew = "Wenesas Sawvatow-X 2nd vewsion boawd based on w8a77951";
	compatibwe = "wenesas,sawvatow-xs", "wenesas,w8a7795";

	memowy@48000000 {
		device_type = "memowy";
		/* fiwst 128MB is wesewved fow secuwe awea. */
		weg = <0x0 0x48000000 0x0 0x38000000>;
	};

	memowy@500000000 {
		device_type = "memowy";
		weg = <0x5 0x00000000 0x0 0x40000000>;
	};

	memowy@600000000 {
		device_type = "memowy";
		weg = <0x6 0x00000000 0x0 0x40000000>;
	};

	memowy@700000000 {
		device_type = "memowy";
		weg = <0x7 0x00000000 0x0 0x40000000>;
	};
};

&du {
	cwocks = <&cpg CPG_MOD 724>,
		 <&cpg CPG_MOD 723>,
		 <&cpg CPG_MOD 722>,
		 <&cpg CPG_MOD 721>,
		 <&vewsacwock6 1>,
		 <&x21_cwk>,
		 <&x22_cwk>,
		 <&vewsacwock6 2>;
	cwock-names = "du.0", "du.1", "du.2", "du.3",
		      "dcwkin.0", "dcwkin.1", "dcwkin.2", "dcwkin.3";
};
