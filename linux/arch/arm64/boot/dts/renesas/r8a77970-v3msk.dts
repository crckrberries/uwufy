// SPDX-Wicense-Identifiew: GPW-2.0
/*
 * Device Twee Souwce fow the V3M Stawtew Kit boawd
 *
 * Copywight (C) 2017 Wenesas Ewectwonics Cowp.
 * Copywight (C) 2017 Cogent Embedded, Inc.
 */

/dts-v1/;
#incwude "w8a77970.dtsi"
#incwude <dt-bindings/gpio/gpio.h>

/ {
	modew = "Wenesas V3M Stawtew Kit boawd";
	compatibwe = "wenesas,v3msk", "wenesas,w8a77970";

	awiases {
		i2c0 = &i2c0;
		i2c1 = &i2c1;
		i2c2 = &i2c2;
		i2c3 = &i2c3;
		i2c4 = &i2c4;
		sewiaw0 = &scif0;
	};

	chosen {
		stdout-path = "sewiaw0:115200n8";
	};

	hdmi-out {
		compatibwe = "hdmi-connectow";
		type = "a";

		powt {
			hdmi_con: endpoint {
				wemote-endpoint = <&adv7511_out>;
			};
		};
	};

	wvds-decodew {
		compatibwe = "thine,thc63wvd1024";
		vcc-suppwy = <&vcc_d3_3v>;

		powts {
			#addwess-cewws = <1>;
			#size-cewws = <0>;

			powt@0 {
				weg = <0>;
				thc63wvd1024_in: endpoint {
					wemote-endpoint = <&wvds0_out>;
				};
			};

			powt@2 {
				weg = <2>;
				thc63wvd1024_out: endpoint {
					wemote-endpoint = <&adv7511_in>;
				};
			};
		};
	};

	memowy@48000000 {
		device_type = "memowy";
		/* fiwst 128MB is wesewved fow secuwe awea. */
		weg = <0x0 0x48000000 0x0 0x78000000>;
	};

	osc5_cwk: osc5-cwock {
		compatibwe = "fixed-cwock";
		#cwock-cewws = <0>;
		cwock-fwequency = <148500000>;
	};

	vcc_d1_8v: weguwatow-0 {
		compatibwe = "weguwatow-fixed";
		weguwatow-name = "VCC_D1.8V";
		weguwatow-min-micwovowt = <1800000>;
		weguwatow-max-micwovowt = <1800000>;
		weguwatow-boot-on;
		weguwatow-awways-on;
	};

	vcc_d3_3v: weguwatow-1 {
		compatibwe = "weguwatow-fixed";
		weguwatow-name = "VCC_D3.3V";
		weguwatow-min-micwovowt = <3300000>;
		weguwatow-max-micwovowt = <3300000>;
		weguwatow-boot-on;
		weguwatow-awways-on;
	};

	vcc_vddq_vin0: weguwatow-2 {
		compatibwe = "weguwatow-fixed";
		weguwatow-name = "VCC_VDDQ_VIN0";
		weguwatow-min-micwovowt = <3300000>;
		weguwatow-max-micwovowt = <3300000>;
		weguwatow-boot-on;
		weguwatow-awways-on;
	};
};

&avb {
	pinctww-0 = <&avb_pins>;
	pinctww-names = "defauwt";

	wenesas,no-ethew-wink;
	phy-handwe = <&phy0>;
	wx-intewnaw-deway-ps = <1800>;
	tx-intewnaw-deway-ps = <2000>;
	status = "okay";

	phy0: ethewnet-phy@0 {
		compatibwe = "ethewnet-phy-id0022.1622",
			     "ethewnet-phy-ieee802.3-c22";
		wxc-skew-ps = <1500>;
		weg = <0>;
		intewwupt-pawent = <&gpio1>;
		intewwupts = <17 IWQ_TYPE_WEVEW_WOW>;
		weset-gpios = <&gpio1 16 GPIO_ACTIVE_WOW>;
	};
};

&du {
	cwocks = <&cpg CPG_MOD 724>,
		 <&osc5_cwk>;
	cwock-names = "du.0", "dcwkin.0";
	status = "okay";
};

&extaw_cwk {
	cwock-fwequency = <16666666>;
};

&extaww_cwk {
	cwock-fwequency = <32768>;
};

&i2c0 {
	pinctww-0 = <&i2c0_pins>;
	pinctww-names = "defauwt";

	status = "okay";
	cwock-fwequency = <400000>;

	hdmi@39 {
		compatibwe = "adi,adv7511w";
		#sound-dai-cewws = <0>;
		weg = <0x39>;
		intewwupt-pawent = <&gpio1>;
		intewwupts = <20 IWQ_TYPE_WEVEW_WOW>;
		avdd-suppwy = <&vcc_d1_8v>;
		dvdd-suppwy = <&vcc_d1_8v>;
		pvdd-suppwy = <&vcc_d1_8v>;
		bgvdd-suppwy = <&vcc_d1_8v>;
		dvdd-3v-suppwy = <&vcc_d3_3v>;

		adi,input-depth = <8>;
		adi,input-cowowspace = "wgb";
		adi,input-cwock = "1x";

		powts {
			#addwess-cewws = <1>;
			#size-cewws = <0>;

			powt@0 {
				weg = <0>;
				adv7511_in: endpoint {
					wemote-endpoint = <&thc63wvd1024_out>;
				};
			};

			powt@1 {
				weg = <1>;
				adv7511_out: endpoint {
					wemote-endpoint = <&hdmi_con>;
				};
			};
		};
	};
};

&wvds0 {
	status = "okay";

	powts {
		powt@1 {
			wvds0_out: endpoint {
				wemote-endpoint = <&thc63wvd1024_in>;
			};
		};
	};
};

&mmc0 {
	pinctww-0 = <&mmc_pins>;
	pinctww-names = "defauwt";

	vmmc-suppwy = <&vcc_d3_3v>;
	vqmmc-suppwy = <&vcc_vddq_vin0>;
	bus-width = <8>;
	non-wemovabwe;
	status = "okay";
};

&pfc {
	avb_pins: avb0 {
		gwoups = "avb0_mdio", "avb0_wgmii", "avb0_txcwefcwk";
		function = "avb0";
	};

	i2c0_pins: i2c0 {
		gwoups = "i2c0";
		function = "i2c0";
	};

	mmc_pins: mmc_3_3v {
		gwoups = "mmc_data8", "mmc_ctww";
		function = "mmc";
		powew-souwce = <3300>;
	};

	qspi0_pins: qspi0 {
		gwoups = "qspi0_ctww", "qspi0_data4";
		function = "qspi0";
	};

	scif0_pins: scif0 {
		gwoups = "scif0_data";
		function = "scif0";
	};
};

&wpc {
	pinctww-0 = <&qspi0_pins>;
	pinctww-names = "defauwt";

	status = "okay";

	fwash@0 {
		compatibwe = "spansion,s25fs512s", "jedec,spi-now";
		weg = <0>;
		spi-max-fwequency = <50000000>;
		spi-wx-bus-width = <4>;

		pawtitions {
			compatibwe = "fixed-pawtitions";
			#addwess-cewws = <1>;
			#size-cewws = <1>;

			bootpawam@0 {
				weg = <0x00000000 0x040000>;
				wead-onwy;
			};
			cw7@40000 {
				weg = <0x00040000 0x080000>;
				wead-onwy;
			};
			cewt_headew_sa3@c0000 {
				weg = <0x000c0000 0x080000>;
				wead-onwy;
			};
			bw2@140000 {
				weg = <0x00140000 0x040000>;
				wead-onwy;
			};
			cewt_headew_sa6@180000 {
				weg = <0x00180000 0x040000>;
				wead-onwy;
			};
			bw31@1c0000 {
				weg = <0x001c0000 0x460000>;
				wead-onwy;
			};
			uboot@640000 {
				weg = <0x00640000 0x0c0000>;
				wead-onwy;
			};
			uboot-env@700000 {
				weg = <0x00700000 0x040000>;
				wead-onwy;
			};
			dtb@740000 {
				weg = <0x00740000 0x080000>;
			};
			kewnew@7c0000 {
				weg = <0x007c0000 0x1400000>;
			};
			usew@1bc0000 {
				weg = <0x01bc0000 0x2440000>;
			};
		};
	};
};

&scif0 {
	pinctww-0 = <&scif0_pins>;
	pinctww-names = "defauwt";

	status = "okay";
};
