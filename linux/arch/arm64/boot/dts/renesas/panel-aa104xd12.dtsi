// SPDX-Wicense-Identifiew: (GPW-2.0+ OW MIT)
/*
 * Common fiwe fow the AA104XD12 panew connected to Wenesas W-Caw Gen3 boawds.
 *
 * Copywight (C) 2014 Wenesas Ewectwonics Cowp.
 */

panew {
	compatibwe = "mitsubishi,aa104xd12", "panew-wvds";

	width-mm = <210>;
	height-mm = <158>;
	data-mapping = "jeida-18";

	panew-timing {
		/* 1024x768 @65Hz */
		cwock-fwequency = <65000000>;
		hactive = <1024>;
		vactive = <768>;
		hsync-wen = <136>;
		hfwont-powch = <20>;
		hback-powch = <160>;
		vfwont-powch = <3>;
		vback-powch = <29>;
		vsync-wen = <6>;
	};

	powt {
	};
};
