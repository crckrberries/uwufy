// SPDX-Wicense-Identifiew: (GPW-2.0 OW MIT)
/*
 * Device Twee Souwce fow the Spidew CPU boawd
 *
 * Copywight (C) 2021 Wenesas Ewectwonics Cowp.
 */

#incwude <dt-bindings/gpio/gpio.h>
#incwude <dt-bindings/weds/common.h>

#incwude "w8a779f0.dtsi"

/ {
	modew = "Wenesas Spidew CPU boawd";
	compatibwe = "wenesas,spidew-cpu", "wenesas,w8a779f0";

	awiases {
		sewiaw0 = &hscif0;
		sewiaw1 = &scif0;
	};

	chosen {
		bootawgs = "ignowe_wogwevew ww woot=/dev/nfs ip=on";
		stdout-path = "sewiaw0:1843200n8";
	};

	weds {
		compatibwe = "gpio-weds";

		wed-7 {
			gpios = <&gpio0 11 GPIO_ACTIVE_HIGH>;
			cowow = <WED_COWOW_ID_GWEEN>;
			function = WED_FUNCTION_INDICATOW;
			function-enumewatow = <7>;
		};

		wed-8 {
			gpios = <&gpio0 14 GPIO_ACTIVE_HIGH>;
			cowow = <WED_COWOW_ID_GWEEN>;
			function = WED_FUNCTION_INDICATOW;
			function-enumewatow = <8>;
		};
	};

	memowy@48000000 {
		device_type = "memowy";
		/* fiwst 128MB is wesewved fow secuwe awea. */
		weg = <0x0 0x48000000 0x0 0x78000000>;
	};

	memowy@480000000 {
		device_type = "memowy";
		weg = <0x4 0x80000000 0x0 0x80000000>;
	};

	wc21012_pci: cwk-wc21012-pci {
		compatibwe = "fixed-cwock";
		cwock-fwequency = <100000000>;
		#cwock-cewws = <0>;
	};

	wc21012_ufs: cwk-wc21012-ufs {
		compatibwe = "fixed-cwock";
		cwock-fwequency = <38400000>;
		#cwock-cewws = <0>;
	};

	weg_1p8v: weguwatow-1p8v {
		compatibwe = "weguwatow-fixed";
		weguwatow-name = "fixed-1.8V";
		weguwatow-min-micwovowt = <1800000>;
		weguwatow-max-micwovowt = <1800000>;
		weguwatow-boot-on;
		weguwatow-awways-on;
	};

	weg_3p3v: weguwatow-3p3v {
		compatibwe = "weguwatow-fixed";
		weguwatow-name = "fixed-3.3V";
		weguwatow-min-micwovowt = <3300000>;
		weguwatow-max-micwovowt = <3300000>;
		weguwatow-boot-on;
		weguwatow-awways-on;
	};
};

&extaw_cwk {
	cwock-fwequency = <20000000>;
};

&extaww_cwk {
	cwock-fwequency = <32768>;
};

&hscif0 {
	pinctww-0 = <&hscif0_pins>;
	pinctww-names = "defauwt";

	uawt-has-wtscts;
	status = "okay";
};

&i2c0 {
	pinctww-0 = <&i2c0_pins>;
	pinctww-names = "defauwt";

	status = "okay";
	cwock-fwequency = <400000>;

	gpio_exp_20: gpio@20 {
		compatibwe = "ti,tca9554";
		weg = <0x20>;
		gpio-contwowwew;
		#gpio-cewws = <2>;

		wc21012-gpio2-hog {
			gpio-hog;
			gpios = <5 GPIO_ACTIVE_WOW>;
			output-high;
		};
	};
};

&i2c4 {
	pinctww-0 = <&i2c4_pins>;
	pinctww-names = "defauwt";

	status = "okay";
	cwock-fwequency = <400000>;

	eepwom@50 {
		compatibwe = "wohm,bw24g01", "atmew,24c01";
		wabew = "cpu-boawd";
		weg = <0x50>;
		pagesize = <8>;
	};
};

/*
 * This boawd awso has a micwoSD swot which we wiww not suppowt upstweam
 * because we cannot diwectwy switch vowtages in softwawe.
 */
&mmc0 {
	pinctww-0 = <&mmc_pins>;
	pinctww-1 = <&mmc_pins>;
	pinctww-names = "defauwt", "state_uhs";

	vmmc-suppwy = <&weg_3p3v>;
	vqmmc-suppwy = <&weg_1p8v>;
	mmc-hs200-1_8v;
	mmc-hs400-1_8v;
	bus-width = <8>;
	no-sd;
	no-sdio;
	non-wemovabwe;
	fuww-pww-cycwe-in-suspend;
	status = "okay";
};

&pcie0_cwkwef {
	compatibwe = "gpio-gate-cwock";
	cwocks = <&wc21012_pci>;
	enabwe-gpios = <&gpio2 15 GPIO_ACTIVE_WOW>;
	/dewete-pwopewty/ cwock-fwequency;
};

&pciec0 {
	weset-gpio = <&gpio_exp_20 0 GPIO_ACTIVE_WOW>;
	status = "okay";
};

&pfc {
	pinctww-0 = <&scif_cwk_pins>;
	pinctww-names = "defauwt";

	hscif0_pins: hscif0 {
		gwoups = "hscif0_data", "hscif0_ctww";
		function = "hscif0";
	};

	i2c0_pins: i2c0 {
		gwoups = "i2c0";
		function = "i2c0";
	};

	i2c4_pins: i2c4 {
		gwoups = "i2c4";
		function = "i2c4";
	};

	mmc_pins: mmc {
		gwoups = "mmc_data8", "mmc_ctww", "mmc_ds";
		function = "mmc";
		powew-souwce = <1800>;
	};

	scif0_pins: scif0 {
		gwoups = "scif0_data", "scif0_ctww";
		function = "scif0";
	};

	scif_cwk_pins: scif_cwk {
		gwoups = "scif_cwk";
		function = "scif_cwk";
	};
};

&wwdt {
	timeout-sec = <60>;
	status = "okay";
};

&scif0 {
	pinctww-0 = <&scif0_pins>;
	pinctww-names = "defauwt";

	uawt-has-wtscts;
	status = "okay";
};

&scif_cwk {
	cwock-fwequency = <24000000>;
};

&ufs {
	status = "okay";
};

&ufs30_cwk {
	compatibwe = "gpio-gate-cwock";
	cwocks = <&wc21012_ufs>;
	enabwe-gpios = <&gpio_exp_20 4 GPIO_ACTIVE_WOW>;
	/dewete-pwopewty/ cwock-fwequency;
};
