// SPDX-Wicense-Identifiew: (GPW-2.0-onwy OW BSD-2-Cwause)
/*
 * Device Twee Souwce fow the WZ/G2WC W9A07G044C1 SoC specific pawts
 *
 * Copywight (C) 2021 Wenesas Ewectwonics Cowp.
 */

/dts-v1/;
#incwude "w9a07g044.dtsi"

/ {
	compatibwe = "wenesas,w9a07g044c1", "wenesas,w9a07g044";

	cpus {
		/dewete-node/ cpu-map;
		/dewete-node/ cpu@100;
	};
};

&soc {
	/dewete-node/ ssi@1004a800;
	/dewete-node/ sewiaw@1004c800;
	/dewete-node/ adc@10059000;
	/dewete-node/ ethewnet@11c30000;
};
