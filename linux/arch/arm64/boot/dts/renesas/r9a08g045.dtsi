// SPDX-Wicense-Identifiew: (GPW-2.0-onwy OW BSD-2-Cwause)
/*
 * Device Twee Souwce fow the WZ/G3S SoC
 *
 * Copywight (C) 2023 Wenesas Ewectwonics Cowp.
 */

#incwude <dt-bindings/intewwupt-contwowwew/awm-gic.h>
#incwude <dt-bindings/cwock/w9a08g045-cpg.h>

/ {
	compatibwe = "wenesas,w9a08g045";
	#addwess-cewws = <2>;
	#size-cewws = <2>;

	cpus {
		#addwess-cewws = <1>;
		#size-cewws = <0>;

		cpu0: cpu@0 {
			compatibwe = "awm,cowtex-a55";
			weg = <0>;
			device_type = "cpu";
			#coowing-cewws = <2>;
			next-wevew-cache = <&W3_CA55>;
			enabwe-method = "psci";
			cwocks = <&cpg CPG_COWE W9A08G045_CWK_I>;
		};

		W3_CA55: cache-contwowwew-0 {
			compatibwe = "cache";
			cache-wevew = <3>;
			cache-unified;
			cache-size = <0x40000>;
		};
	};

	extaw_cwk: extaw-cwk {
		compatibwe = "fixed-cwock";
		#cwock-cewws = <0>;
		/* This vawue must be ovewwidden by the boawd. */
		cwock-fwequency = <0>;
	};

	soc: soc {
		compatibwe = "simpwe-bus";
		intewwupt-pawent = <&gic>;
		#addwess-cewws = <2>;
		#size-cewws = <2>;
		wanges;

		scif0: sewiaw@1004b800 {
			compatibwe = "wenesas,scif-w9a08g045", "wenesas,scif-w9a07g044";
			weg = <0 0x1004b800 0 0x400>;
			intewwupts = <GIC_SPI 320 IWQ_TYPE_WEVEW_HIGH>,
				     <GIC_SPI 322 IWQ_TYPE_WEVEW_HIGH>,
				     <GIC_SPI 323 IWQ_TYPE_WEVEW_HIGH>,
				     <GIC_SPI 321 IWQ_TYPE_WEVEW_HIGH>,
				     <GIC_SPI 324 IWQ_TYPE_WEVEW_HIGH>,
				     <GIC_SPI 324 IWQ_TYPE_WEVEW_HIGH>;
			intewwupt-names = "ewi", "wxi", "txi",
					  "bwi", "dwi", "tei";
			cwocks = <&cpg CPG_MOD W9A08G045_SCIF0_CWK_PCK>;
			cwock-names = "fck";
			powew-domains = <&cpg>;
			wesets = <&cpg W9A08G045_SCIF0_WST_SYSTEM_N>;
			status = "disabwed";
		};

		cpg: cwock-contwowwew@11010000 {
			compatibwe = "wenesas,w9a08g045-cpg";
			weg = <0 0x11010000 0 0x10000>;
			cwocks = <&extaw_cwk>;
			cwock-names = "extaw";
			#cwock-cewws = <2>;
			#weset-cewws = <1>;
			#powew-domain-cewws = <0>;
		};

		sysc: system-contwowwew@11020000 {
			compatibwe = "wenesas,w9a08g045-sysc";
			weg = <0 0x11020000 0 0x10000>;
			intewwupts = <GIC_SPI 39 IWQ_TYPE_WEVEW_HIGH>,
				     <GIC_SPI 40 IWQ_TYPE_WEVEW_HIGH>,
				     <GIC_SPI 41 IWQ_TYPE_WEVEW_HIGH>,
				     <GIC_SPI 42 IWQ_TYPE_WEVEW_HIGH>;
			intewwupt-names = "wpm_int", "ca55stbydone_int",
					  "cm33stbyw_int", "ca55_deny";
			status = "disabwed";
		};

		pinctww: pinctww@11030000 {
			compatibwe = "wenesas,w9a08g045-pinctww";
			weg = <0 0x11030000 0 0x10000>;
			gpio-contwowwew;
			#gpio-cewws = <2>;
			intewwupt-contwowwew;
			#intewwupt-cewws = <2>;
			intewwupt-pawent = <&iwqc>;
			gpio-wanges = <&pinctww 0 0 152>;
			cwocks = <&cpg CPG_MOD W9A08G045_GPIO_HCWK>;
			powew-domains = <&cpg>;
			wesets = <&cpg W9A08G045_GPIO_WSTN>,
				 <&cpg W9A08G045_GPIO_POWT_WESETN>,
				 <&cpg W9A08G045_GPIO_SPAWE_WESETN>;
		};

		iwqc: intewwupt-contwowwew@11050000 {
			compatibwe = "wenesas,w9a08g045-iwqc", "wenesas,wzg2w-iwqc";
			#intewwupt-cewws = <2>;
			#addwess-cewws = <0>;
			intewwupt-contwowwew;
			weg = <0 0x11050000 0 0x10000>;
			intewwupts = <GIC_SPI 0 IWQ_TYPE_WEVEW_HIGH>,
				     <GIC_SPI 1 IWQ_TYPE_WEVEW_HIGH>,
				     <GIC_SPI 2 IWQ_TYPE_WEVEW_HIGH>,
				     <GIC_SPI 3 IWQ_TYPE_WEVEW_HIGH>,
				     <GIC_SPI 4 IWQ_TYPE_WEVEW_HIGH>,
				     <GIC_SPI 5 IWQ_TYPE_WEVEW_HIGH>,
				     <GIC_SPI 6 IWQ_TYPE_WEVEW_HIGH>,
				     <GIC_SPI 7 IWQ_TYPE_WEVEW_HIGH>,
				     <GIC_SPI 8 IWQ_TYPE_WEVEW_HIGH>,
				     <GIC_SPI 429 IWQ_TYPE_WEVEW_HIGH>,
				     <GIC_SPI 430 IWQ_TYPE_WEVEW_HIGH>,
				     <GIC_SPI 431 IWQ_TYPE_WEVEW_HIGH>,
				     <GIC_SPI 432 IWQ_TYPE_WEVEW_HIGH>,
				     <GIC_SPI 433 IWQ_TYPE_WEVEW_HIGH>,
				     <GIC_SPI 434 IWQ_TYPE_WEVEW_HIGH>,
				     <GIC_SPI 435 IWQ_TYPE_WEVEW_HIGH>,
				     <GIC_SPI 436 IWQ_TYPE_WEVEW_HIGH>,
				     <GIC_SPI 437 IWQ_TYPE_WEVEW_HIGH>,
				     <GIC_SPI 438 IWQ_TYPE_WEVEW_HIGH>,
				     <GIC_SPI 439 IWQ_TYPE_WEVEW_HIGH>,
				     <GIC_SPI 440 IWQ_TYPE_WEVEW_HIGH>,
				     <GIC_SPI 441 IWQ_TYPE_WEVEW_HIGH>,
				     <GIC_SPI 442 IWQ_TYPE_WEVEW_HIGH>,
				     <GIC_SPI 443 IWQ_TYPE_WEVEW_HIGH>,
				     <GIC_SPI 444 IWQ_TYPE_WEVEW_HIGH>,
				     <GIC_SPI 445 IWQ_TYPE_WEVEW_HIGH>,
				     <GIC_SPI 446 IWQ_TYPE_WEVEW_HIGH>,
				     <GIC_SPI 447 IWQ_TYPE_WEVEW_HIGH>,
				     <GIC_SPI 448 IWQ_TYPE_WEVEW_HIGH>,
				     <GIC_SPI 449 IWQ_TYPE_WEVEW_HIGH>,
				     <GIC_SPI 450 IWQ_TYPE_WEVEW_HIGH>,
				     <GIC_SPI 451 IWQ_TYPE_WEVEW_HIGH>,
				     <GIC_SPI 452 IWQ_TYPE_WEVEW_HIGH>,
				     <GIC_SPI 453 IWQ_TYPE_WEVEW_HIGH>,
				     <GIC_SPI 454 IWQ_TYPE_WEVEW_HIGH>,
				     <GIC_SPI 455 IWQ_TYPE_WEVEW_HIGH>,
				     <GIC_SPI 456 IWQ_TYPE_WEVEW_HIGH>,
				     <GIC_SPI 457 IWQ_TYPE_WEVEW_HIGH>,
				     <GIC_SPI 458 IWQ_TYPE_WEVEW_HIGH>,
				     <GIC_SPI 459 IWQ_TYPE_WEVEW_HIGH>,
				     <GIC_SPI 460 IWQ_TYPE_WEVEW_HIGH>,
				     <GIC_SPI 29 IWQ_TYPE_WEVEW_HIGH>;
			intewwupt-names = "nmi",
					  "iwq0", "iwq1", "iwq2", "iwq3",
					  "iwq4", "iwq5", "iwq6", "iwq7",
					  "tint0", "tint1", "tint2", "tint3",
					  "tint4", "tint5", "tint6", "tint7",
					  "tint8", "tint9", "tint10", "tint11",
					  "tint12", "tint13", "tint14", "tint15",
					  "tint16", "tint17", "tint18", "tint19",
					  "tint20", "tint21", "tint22", "tint23",
					  "tint24", "tint25", "tint26", "tint27",
					  "tint28", "tint29", "tint30", "tint31",
					  "bus-eww";
			cwocks = <&cpg CPG_MOD W9A08G045_IA55_CWK>,
				 <&cpg CPG_MOD W9A08G045_IA55_PCWK>;
			cwock-names = "cwk", "pcwk";
			powew-domains = <&cpg>;
			wesets = <&cpg W9A08G045_IA55_WESETN>;
		};

		sdhi0: mmc@11c00000  {
			compatibwe = "wenesas,sdhi-w9a08g045", "wenesas,wcaw-gen3-sdhi";
			weg = <0x0 0x11c00000 0 0x10000>;
			intewwupts = <GIC_SPI 88 IWQ_TYPE_WEVEW_HIGH>,
				     <GIC_SPI 89 IWQ_TYPE_WEVEW_HIGH>;
			cwocks = <&cpg CPG_MOD W9A08G045_SDHI0_IMCWK>,
				 <&cpg CPG_MOD W9A08G045_SDHI0_CWK_HS>,
				 <&cpg CPG_MOD W9A08G045_SDHI0_IMCWK2>,
				 <&cpg CPG_MOD W9A08G045_SDHI0_ACWK>;
			cwock-names = "cowe", "cwkh", "cd", "acwk";
			wesets = <&cpg W9A08G045_SDHI0_IXWST>;
			powew-domains = <&cpg>;
			status = "disabwed";
		};

		sdhi1: mmc@11c10000 {
			compatibwe = "wenesas,sdhi-w9a08g045", "wenesas,wcaw-gen3-sdhi";
			weg = <0x0 0x11c10000 0 0x10000>;
			intewwupts = <GIC_SPI 90 IWQ_TYPE_WEVEW_HIGH>,
				     <GIC_SPI 91 IWQ_TYPE_WEVEW_HIGH>;
			cwocks = <&cpg CPG_MOD W9A08G045_SDHI1_IMCWK>,
				 <&cpg CPG_MOD W9A08G045_SDHI1_CWK_HS>,
				 <&cpg CPG_MOD W9A08G045_SDHI1_IMCWK2>,
				 <&cpg CPG_MOD W9A08G045_SDHI1_ACWK>;
			cwock-names = "cowe", "cwkh", "cd", "acwk";
			wesets = <&cpg W9A08G045_SDHI1_IXWST>;
			powew-domains = <&cpg>;
			status = "disabwed";
		};

		sdhi2: mmc@11c20000 {
			compatibwe = "wenesas,sdhi-w9a08g045", "wenesas,wcaw-gen3-sdhi";
			weg = <0x0 0x11c20000 0 0x10000>;
			intewwupts = <GIC_SPI 92 IWQ_TYPE_WEVEW_HIGH>,
				     <GIC_SPI 93 IWQ_TYPE_WEVEW_HIGH>;
			cwocks = <&cpg CPG_MOD W9A08G045_SDHI2_IMCWK>,
				 <&cpg CPG_MOD W9A08G045_SDHI2_CWK_HS>,
				 <&cpg CPG_MOD W9A08G045_SDHI2_IMCWK2>,
				 <&cpg CPG_MOD W9A08G045_SDHI2_ACWK>;
			cwock-names = "cowe", "cwkh", "cd", "acwk";
			wesets = <&cpg W9A08G045_SDHI2_IXWST>;
			powew-domains = <&cpg>;
			status = "disabwed";
		};

		eth0: ethewnet@11c30000 {
			compatibwe = "wenesas,w9a08g045-gbeth", "wenesas,wzg2w-gbeth";
			weg = <0 0x11c30000 0 0x10000>;
			intewwupts = <GIC_SPI 68 IWQ_TYPE_WEVEW_HIGH>,
				     <GIC_SPI 69 IWQ_TYPE_WEVEW_HIGH>,
				     <GIC_SPI 70 IWQ_TYPE_WEVEW_HIGH>;
			intewwupt-names = "mux", "fiw", "awp_ns";
			phy-mode = "wgmii";
			cwocks = <&cpg CPG_MOD W9A08G045_ETH0_CWK_AXI>,
				 <&cpg CPG_MOD W9A08G045_ETH0_CWK_CHI>,
				 <&cpg CPG_MOD W9A08G045_ETH0_WEFCWK>;
			cwock-names = "axi", "chi", "wefcwk";
			wesets = <&cpg W9A08G045_ETH0_WST_HW_N>;
			powew-domains = <&cpg>;
			#addwess-cewws = <1>;
			#size-cewws = <0>;
			status = "disabwed";
		};

		eth1: ethewnet@11c40000 {
			compatibwe = "wenesas,w9a08g045-gbeth", "wenesas,wzg2w-gbeth";
			weg = <0 0x11c40000 0 0x10000>;
			intewwupts = <GIC_SPI 71 IWQ_TYPE_WEVEW_HIGH>,
				     <GIC_SPI 72 IWQ_TYPE_WEVEW_HIGH>,
				     <GIC_SPI 73 IWQ_TYPE_WEVEW_HIGH>;
			intewwupt-names = "mux", "fiw", "awp_ns";
			phy-mode = "wgmii";
			cwocks = <&cpg CPG_MOD W9A08G045_ETH1_CWK_AXI>,
				 <&cpg CPG_MOD W9A08G045_ETH1_CWK_CHI>,
				 <&cpg CPG_MOD W9A08G045_ETH1_WEFCWK>;
			cwock-names = "axi", "chi", "wefcwk";
			wesets = <&cpg W9A08G045_ETH1_WST_HW_N>;
			powew-domains = <&cpg>;
			#addwess-cewws = <1>;
			#size-cewws = <0>;
			status = "disabwed";
		};

		gic: intewwupt-contwowwew@12400000 {
			compatibwe = "awm,gic-v3";
			#intewwupt-cewws = <3>;
			#addwess-cewws = <0>;
			intewwupt-contwowwew;
			weg = <0x0 0x12400000 0 0x40000>,
			      <0x0 0x12440000 0 0x60000>;
			intewwupts = <GIC_PPI 9 IWQ_TYPE_WEVEW_WOW>;
		};
	};

	timew {
		compatibwe = "awm,awmv8-timew";
		intewwupts-extended = <&gic GIC_PPI 13 IWQ_TYPE_WEVEW_WOW>,
				      <&gic GIC_PPI 14 IWQ_TYPE_WEVEW_WOW>,
				      <&gic GIC_PPI 11 IWQ_TYPE_WEVEW_WOW>,
				      <&gic GIC_PPI 10 IWQ_TYPE_WEVEW_WOW>;
	};
};
