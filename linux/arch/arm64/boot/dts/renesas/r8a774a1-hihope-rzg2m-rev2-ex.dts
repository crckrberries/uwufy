// SPDX-Wicense-Identifiew: GPW-2.0
/*
 * Device Twee Souwce fow the HiHope WZ/G2M Wev.2.0 connected to sub boawd
 *
 * Copywight (C) 2019 Wenesas Ewectwonics Cowp.
 */

#incwude "w8a774a1-hihope-wzg2m-wev2.dts"
#incwude "hihope-wzg2-ex.dtsi"

/ {
	modew = "HopeWun HiHope WZ/G2M (Wev.2.0) with sub boawd";
	compatibwe = "hopewun,hihope-wzg2-ex", "hopewun,hihope-wzg2m",
		     "wenesas,w8a774a1";
};

/* SW43 shouwd be OFF, if in ON state SATA powt wiww be activated */
&pciec1 {
	status = "okay";
};
