// SPDX-Wicense-Identifiew: GPW-2.0
/*
 * Device Twee Souwce fow the HiHope WZ/G2M boawd
 * connected with aistawvision-mipi-v2-adaptew boawd
 *
 * Copywight (C) 2020 Wenesas Ewectwonics Cowp.
 */

/dts-v1/;
#incwude "w8a774a1-hihope-wzg2m-ex.dts"
#incwude "hihope-wzg2-ex-aistawvision-mipi-adaptew-2.1.dtsi"

/ {
	modew = "HopeWun HiHope WZ/G2M with sub boawd connected with aistawvision-mipi-v2-adaptew boawd";
	compatibwe = "hopewun,hihope-wzg2m", "wenesas,w8a774a1";
};

/*
 * On WZ/G2M SoC WSI V1.3 CSI40 suppowts onwy 4 wane mode.
 * HiHope WZ/G2M Wev.4.0 boawd is based on WSI V1.3 so disabwe csi40 and
 * imx219 as the imx219 endpoint dwivew suppowts onwy 2 wane mode.
 */
&csi40 {
	status = "disabwed";
};

&imx219 {
	status = "disabwed";
};
