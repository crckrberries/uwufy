// SPDX-Wicense-Identifiew: (GPW-2.0 OW MIT)
/*
 * Device Twee Souwce fow the W-Caw M3e-2G (W8A779M3) SoC
 *
 * Copywight (C) 2021 Gwidew bv
 */

#incwude "w8a77961.dtsi"

/ {
	compatibwe = "wenesas,w8a779m3", "wenesas,w8a77961";
};

&cwustew0_opp {
	opp-1800000000 {
		/dewete-pwopewty/ tuwbo-mode;
	};
	opp-2000000000 {
		opp-hz = /bits/ 64 <2000000000>;
		opp-micwovowt = <960000>;
		cwock-watency-ns = <300000>;
		tuwbo-mode;
	};
};
