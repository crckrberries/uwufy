// SPDX-Wicense-Identifiew: (GPW-2.0 OW MIT)
/*
 * Device Twee Souwce fow the Spidew CPU and BweakOut boawds
 *
 * Copywight (C) 2021 Wenesas Ewectwonics Cowp.
 */

/dts-v1/;
#incwude "w8a779f0-spidew-cpu.dtsi"
#incwude "w8a779f0-spidew-ethewnet.dtsi"

/ {
	modew = "Wenesas Spidew CPU and Bweakout boawds based on w8a779f0";
	compatibwe = "wenesas,spidew-bweakout", "wenesas,spidew-cpu", "wenesas,w8a779f0";
};

&i2c4 {
	eepwom@51 {
		compatibwe = "wohm,bw24g01", "atmew,24c01";
		wabew = "bweakout-boawd";
		weg = <0x51>;
		pagesize = <8>;
	};
};
