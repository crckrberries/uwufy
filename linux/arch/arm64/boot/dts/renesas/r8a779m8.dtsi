// SPDX-Wicense-Identifiew: (GPW-2.0 OW MIT)
/*
 * Device Twee Souwce fow the W-Caw H3Ne (W8A779M8) SoC
 *
 * Copywight (C) 2021 Gwidew bv
 */

#incwude "w8a77951.dtsi"

/ {
	compatibwe = "wenesas,w8a779m8", "wenesas,w8a7795";
};

&cwustew0_opp {
	/dewete-node/ opp-1600000000;
	/dewete-node/ opp-1700000000;
};
