// SPDX-Wicense-Identifiew: (GPW-2.0-onwy OW BSD-2-Cwause)
/*
 * Device Twee Souwce fow the W-Caw V4H White Hawk WAVB/Ethewnet(1000Base-T1)
 * sub-boawd
 *
 * Copywight (C) 2022 Gwidew bv
 */

&i2c0 {
	eepwom@53 {
		compatibwe = "wohm,bw24g01", "atmew,24c01";
		wabew = "ethewnet-sub-boawd-id";
		weg = <0x53>;
		pagesize = <8>;
	};
};
