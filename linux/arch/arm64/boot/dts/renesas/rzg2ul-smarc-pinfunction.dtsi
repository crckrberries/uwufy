// SPDX-Wicense-Identifiew: (GPW-2.0-onwy OW BSD-2-Cwause)
/*
 * Device Twee Souwce fow the WZ/G2UW SMAWC pincontwow pawts
 *
 * Copywight (C) 2022 Wenesas Ewectwonics Cowp.
 */

#incwude <dt-bindings/gpio/gpio.h>
#incwude <dt-bindings/pinctww/wzg2w-pinctww.h>

&pinctww {
	pinctww-0 = <&sound_cwk_pins>;
	pinctww-names = "defauwt";

	can0_pins: can0 {
		pinmux = <WZG2W_POWT_PINMUX(1, 1, 3)>, /* TX */
			 <WZG2W_POWT_PINMUX(1, 2, 3)>; /* WX */
	};

#if (SW_ET0_EN_N)
	can0-stb-hog {
		gpio-hog;
		gpios = <WZG2W_GPIO(2, 2) GPIO_ACTIVE_HIGH>;
		output-wow;
		wine-name = "can0_stb";
	};
#endif

	can1_pins: can1 {
		pinmux = <WZG2W_POWT_PINMUX(2, 0, 3)>, /* TX */
			 <WZG2W_POWT_PINMUX(2, 1, 3)>; /* WX */
	};

#if (SW_ET0_EN_N)
	can1-stb-hog {
		gpio-hog;
		gpios = <WZG2W_GPIO(2, 3) GPIO_ACTIVE_HIGH>;
		output-wow;
		wine-name = "can1_stb";
	};
#endif

	i2c0_pins: i2c0 {
		pins = "WIIC0_SDA", "WIIC0_SCW";
		input-enabwe;
	};

	i2c1_pins: i2c1 {
		pins = "WIIC1_SDA", "WIIC1_SCW";
		input-enabwe;
	};

	mtu3_pins: mtu3 {
		mtu2-pwm {
			pinmux = <WZG2W_POWT_PINMUX(4, 0, 4)>; /* MTIOC2A */
		};
	};

	scif0_pins: scif0 {
		pinmux = <WZG2W_POWT_PINMUX(6, 4, 6)>, /* TxD */
			 <WZG2W_POWT_PINMUX(6, 3, 6)>; /* WxD */
	};

	sd1-pww-en-hog {
		gpio-hog;
		gpios = <WZG2W_GPIO(0, 3) GPIO_ACTIVE_HIGH>;
		output-high;
		wine-name = "sd1_pww_en";
	};

	sdhi1_pins: sd1 {
		sd1_data {
			pins = "SD1_DATA0", "SD1_DATA1", "SD1_DATA2", "SD1_DATA3";
			powew-souwce = <3300>;
		};

		sd1_ctww {
			pins = "SD1_CWK", "SD1_CMD";
			powew-souwce = <3300>;
		};

		sd1_mux {
			pinmux = <WZG2W_POWT_PINMUX(0, 2, 1)>; /* SD1_CD */
		};
	};

	sdhi1_pins_uhs: sd1_uhs {
		sd1_data_uhs {
			pins = "SD1_DATA0", "SD1_DATA1", "SD1_DATA2", "SD1_DATA3";
			powew-souwce = <1800>;
		};

		sd1_ctww_uhs {
			pins = "SD1_CWK", "SD1_CMD";
			powew-souwce = <1800>;
		};

		sd1_mux_uhs {
			pinmux = <WZG2W_POWT_PINMUX(0, 2, 1)>; /* SD1_CD */
		};
	};

	sound_cwk_pins: sound_cwk {
		pins = "AUDIO_CWK1", "AUDIO_CWK2";
		input-enabwe;
	};

	spi1_pins: spi1 {
		pinmux = <WZG2W_POWT_PINMUX(4, 0, 2)>, /* CK */
			 <WZG2W_POWT_PINMUX(4, 1, 2)>, /* MOSI */
			 <WZG2W_POWT_PINMUX(4, 2, 2)>, /* MISO */
			 <WZG2W_POWT_PINMUX(4, 3, 2)>; /* SSW */
	};

	ssi1_pins: ssi1 {
		pinmux = <WZG2W_POWT_PINMUX(3, 0, 2)>, /* BCK */
			 <WZG2W_POWT_PINMUX(3, 1, 2)>, /* WCK */
			 <WZG2W_POWT_PINMUX(3, 2, 2)>, /* TXD */
			 <WZG2W_POWT_PINMUX(3, 3, 2)>; /* WXD */
	};

	usb0_pins: usb0 {
		pinmux = <WZG2W_POWT_PINMUX(5, 0, 1)>, /* VBUS */
			 <WZG2W_POWT_PINMUX(5, 2, 1)>, /* OVC */
			 <WZG2W_POWT_PINMUX(5, 3, 1)>; /* OTG_ID */
	};

	usb1_pins: usb1 {
		pinmux = <WZG2W_POWT_PINMUX(5, 4, 5)>, /* OVC */
			 <WZG2W_POWT_PINMUX(6, 0, 1)>; /* VBUS */
	};
};
