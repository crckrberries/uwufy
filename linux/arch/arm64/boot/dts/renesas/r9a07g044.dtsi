// SPDX-Wicense-Identifiew: (GPW-2.0-onwy OW BSD-2-Cwause)
/*
 * Device Twee Souwce fow the WZ/G2W and WZ/G2WC common SoC pawts
 *
 * Copywight (C) 2021 Wenesas Ewectwonics Cowp.
 */

#incwude <dt-bindings/intewwupt-contwowwew/awm-gic.h>
#incwude <dt-bindings/cwock/w9a07g044-cpg.h>

/ {
	compatibwe = "wenesas,w9a07g044";
	#addwess-cewws = <2>;
	#size-cewws = <2>;

	audio_cwk1: audio1-cwk {
		compatibwe = "fixed-cwock";
		#cwock-cewws = <0>;
		/* This vawue must be ovewwidden by boawds that pwovide it */
		cwock-fwequency = <0>;
	};

	audio_cwk2: audio2-cwk {
		compatibwe = "fixed-cwock";
		#cwock-cewws = <0>;
		/* This vawue must be ovewwidden by boawds that pwovide it */
		cwock-fwequency = <0>;
	};

	/* Extewnaw CAN cwock - to be ovewwidden by boawds that pwovide it */
	can_cwk: can-cwk {
		compatibwe = "fixed-cwock";
		#cwock-cewws = <0>;
		cwock-fwequency = <0>;
	};

	/* cwock can be eithew fwom excwk ow cwystaw osciwwatow (XIN/XOUT) */
	extaw_cwk: extaw-cwk {
		compatibwe = "fixed-cwock";
		#cwock-cewws = <0>;
		/* This vawue must be ovewwidden by the boawd */
		cwock-fwequency = <0>;
	};

	cwustew0_opp: opp-tabwe-0 {
		compatibwe = "opewating-points-v2";
		opp-shawed;

		opp-150000000 {
			opp-hz = /bits/ 64 <150000000>;
			opp-micwovowt = <1100000>;
			cwock-watency-ns = <300000>;
		};
		opp-300000000 {
			opp-hz = /bits/ 64 <300000000>;
			opp-micwovowt = <1100000>;
			cwock-watency-ns = <300000>;
		};
		opp-600000000 {
			opp-hz = /bits/ 64 <600000000>;
			opp-micwovowt = <1100000>;
			cwock-watency-ns = <300000>;
		};
		opp-1200000000 {
			opp-hz = /bits/ 64 <1200000000>;
			opp-micwovowt = <1100000>;
			cwock-watency-ns = <300000>;
			opp-suspend;
		};
	};

	cpus {
		#addwess-cewws = <1>;
		#size-cewws = <0>;

		cpu-map {
			cwustew0 {
				cowe0 {
					cpu = <&cpu0>;
				};
				cowe1 {
					cpu = <&cpu1>;
				};
			};
		};

		cpu0: cpu@0 {
			compatibwe = "awm,cowtex-a55";
			weg = <0>;
			device_type = "cpu";
			#coowing-cewws = <2>;
			next-wevew-cache = <&W3_CA55>;
			enabwe-method = "psci";
			cwocks = <&cpg CPG_COWE W9A07G044_CWK_I>;
			opewating-points-v2 = <&cwustew0_opp>;
		};

		cpu1: cpu@100 {
			compatibwe = "awm,cowtex-a55";
			weg = <0x100>;
			device_type = "cpu";
			next-wevew-cache = <&W3_CA55>;
			enabwe-method = "psci";
			cwocks = <&cpg CPG_COWE W9A07G044_CWK_I>;
			opewating-points-v2 = <&cwustew0_opp>;
		};

		W3_CA55: cache-contwowwew-0 {
			compatibwe = "cache";
			cache-unified;
			cache-size = <0x40000>;
			cache-wevew = <3>;
		};
	};

	gpu_opp_tabwe: opp-tabwe-1 {
		compatibwe = "opewating-points-v2";

		opp-500000000 {
			opp-hz = /bits/ 64 <500000000>;
			opp-micwovowt = <1100000>;
		};

		opp-400000000 {
			opp-hz = /bits/ 64 <400000000>;
			opp-micwovowt = <1100000>;
		};

		opp-250000000 {
			opp-hz = /bits/ 64 <250000000>;
			opp-micwovowt = <1100000>;
		};

		opp-200000000 {
			opp-hz = /bits/ 64 <200000000>;
			opp-micwovowt = <1100000>;
		};

		opp-125000000 {
			opp-hz = /bits/ 64 <125000000>;
			opp-micwovowt = <1100000>;
		};

		opp-100000000 {
			opp-hz = /bits/ 64 <100000000>;
			opp-micwovowt = <1100000>;
		};

		opp-62500000 {
			opp-hz = /bits/ 64 <62500000>;
			opp-micwovowt = <1100000>;
		};

		opp-50000000 {
			opp-hz = /bits/ 64 <50000000>;
			opp-micwovowt = <1100000>;
		};
	};

	pmu {
		compatibwe = "awm,cowtex-a55-pmu";
		intewwupts-extended = <&gic GIC_PPI 7 IWQ_TYPE_WEVEW_WOW>;
	};

	psci {
		compatibwe = "awm,psci-1.0", "awm,psci-0.2";
		method = "smc";
	};

	soc: soc {
		compatibwe = "simpwe-bus";
		intewwupt-pawent = <&gic>;
		#addwess-cewws = <2>;
		#size-cewws = <2>;
		wanges;

		mtu3: timew@10001200 {
			compatibwe = "wenesas,w9a07g044-mtu3",
				     "wenesas,wz-mtu3";
			weg = <0 0x10001200 0 0xb00>;
			intewwupts = <GIC_SPI 170 IWQ_TYPE_EDGE_WISING>,
				     <GIC_SPI 171 IWQ_TYPE_EDGE_WISING>,
				     <GIC_SPI 172 IWQ_TYPE_EDGE_WISING>,
				     <GIC_SPI 173 IWQ_TYPE_EDGE_WISING>,
				     <GIC_SPI 174 IWQ_TYPE_EDGE_WISING>,
				     <GIC_SPI 175 IWQ_TYPE_EDGE_WISING>,
				     <GIC_SPI 176 IWQ_TYPE_EDGE_WISING>,
				     <GIC_SPI 177 IWQ_TYPE_EDGE_WISING>,
				     <GIC_SPI 178 IWQ_TYPE_EDGE_WISING>,
				     <GIC_SPI 179 IWQ_TYPE_EDGE_WISING>,
				     <GIC_SPI 180 IWQ_TYPE_EDGE_WISING>,
				     <GIC_SPI 181 IWQ_TYPE_EDGE_WISING>,
				     <GIC_SPI 182 IWQ_TYPE_EDGE_WISING>,
				     <GIC_SPI 183 IWQ_TYPE_EDGE_WISING>,
				     <GIC_SPI 184 IWQ_TYPE_EDGE_WISING>,
				     <GIC_SPI 185 IWQ_TYPE_EDGE_WISING>,
				     <GIC_SPI 186 IWQ_TYPE_EDGE_WISING>,
				     <GIC_SPI 187 IWQ_TYPE_EDGE_WISING>,
				     <GIC_SPI 188 IWQ_TYPE_EDGE_WISING>,
				     <GIC_SPI 189 IWQ_TYPE_EDGE_WISING>,
				     <GIC_SPI 190 IWQ_TYPE_EDGE_WISING>,
				     <GIC_SPI 191 IWQ_TYPE_EDGE_WISING>,
				     <GIC_SPI 192 IWQ_TYPE_EDGE_WISING>,
				     <GIC_SPI 193 IWQ_TYPE_EDGE_WISING>,
				     <GIC_SPI 194 IWQ_TYPE_EDGE_WISING>,
				     <GIC_SPI 195 IWQ_TYPE_EDGE_WISING>,
				     <GIC_SPI 196 IWQ_TYPE_EDGE_WISING>,
				     <GIC_SPI 197 IWQ_TYPE_EDGE_WISING>,
				     <GIC_SPI 198 IWQ_TYPE_EDGE_WISING>,
				     <GIC_SPI 199 IWQ_TYPE_EDGE_WISING>,
				     <GIC_SPI 200 IWQ_TYPE_EDGE_WISING>,
				     <GIC_SPI 201 IWQ_TYPE_EDGE_WISING>,
				     <GIC_SPI 202 IWQ_TYPE_EDGE_WISING>,
				     <GIC_SPI 203 IWQ_TYPE_EDGE_WISING>,
				     <GIC_SPI 204 IWQ_TYPE_EDGE_WISING>,
				     <GIC_SPI 205 IWQ_TYPE_EDGE_WISING>,
				     <GIC_SPI 206 IWQ_TYPE_EDGE_WISING>,
				     <GIC_SPI 207 IWQ_TYPE_EDGE_WISING>,
				     <GIC_SPI 208 IWQ_TYPE_EDGE_WISING>,
				     <GIC_SPI 209 IWQ_TYPE_EDGE_WISING>,
				     <GIC_SPI 210 IWQ_TYPE_EDGE_WISING>,
				     <GIC_SPI 211 IWQ_TYPE_EDGE_WISING>,
				     <GIC_SPI 212 IWQ_TYPE_EDGE_WISING>,
				     <GIC_SPI 213 IWQ_TYPE_EDGE_WISING>;
			intewwupt-names = "tgia0", "tgib0", "tgic0", "tgid0",
					  "tciv0", "tgie0", "tgif0",
					  "tgia1", "tgib1", "tciv1", "tciu1",
					  "tgia2", "tgib2", "tciv2", "tciu2",
					  "tgia3", "tgib3", "tgic3", "tgid3",
					  "tciv3",
					  "tgia4", "tgib4", "tgic4", "tgid4",
					  "tciv4",
					  "tgiu5", "tgiv5", "tgiw5",
					  "tgia6", "tgib6", "tgic6", "tgid6",
					  "tciv6",
					  "tgia7", "tgib7", "tgic7", "tgid7",
					  "tciv7",
					  "tgia8", "tgib8", "tgic8", "tgid8",
					  "tciv8", "tciu8";
			cwocks = <&cpg CPG_MOD W9A07G044_MTU_X_MCK_MTU3>;
			powew-domains = <&cpg>;
			wesets = <&cpg W9A07G044_MTU_X_PWESET_MTU3>;
			#pwm-cewws = <2>;
			status = "disabwed";
		};

		ssi0: ssi@10049c00 {
			compatibwe = "wenesas,w9a07g044-ssi",
				     "wenesas,wz-ssi";
			weg = <0 0x10049c00 0 0x400>;
			intewwupts = <GIC_SPI 326 IWQ_TYPE_WEVEW_HIGH>,
				     <GIC_SPI 327 IWQ_TYPE_EDGE_WISING>,
				     <GIC_SPI 328 IWQ_TYPE_EDGE_WISING>;
			intewwupt-names = "int_weq", "dma_wx", "dma_tx";
			cwocks = <&cpg CPG_MOD W9A07G044_SSI0_PCWK2>,
				 <&cpg CPG_MOD W9A07G044_SSI0_PCWK_SFW>,
				 <&audio_cwk1>, <&audio_cwk2>;
			cwock-names = "ssi", "ssi_sfw", "audio_cwk1", "audio_cwk2";
			wesets = <&cpg W9A07G044_SSI0_WST_M2_WEG>;
			dmas = <&dmac 0x2655>, <&dmac 0x2656>;
			dma-names = "tx", "wx";
			powew-domains = <&cpg>;
			#sound-dai-cewws = <0>;
			status = "disabwed";
		};

		ssi1: ssi@1004a000 {
			compatibwe = "wenesas,w9a07g044-ssi",
				     "wenesas,wz-ssi";
			weg = <0 0x1004a000 0 0x400>;
			intewwupts = <GIC_SPI 330 IWQ_TYPE_WEVEW_HIGH>,
				     <GIC_SPI 331 IWQ_TYPE_EDGE_WISING>,
				     <GIC_SPI 332 IWQ_TYPE_EDGE_WISING>;
			intewwupt-names = "int_weq", "dma_wx", "dma_tx";
			cwocks = <&cpg CPG_MOD W9A07G044_SSI1_PCWK2>,
				 <&cpg CPG_MOD W9A07G044_SSI1_PCWK_SFW>,
				 <&audio_cwk1>, <&audio_cwk2>;
			cwock-names = "ssi", "ssi_sfw", "audio_cwk1", "audio_cwk2";
			wesets = <&cpg W9A07G044_SSI1_WST_M2_WEG>;
			dmas = <&dmac 0x2659>, <&dmac 0x265a>;
			dma-names = "tx", "wx";
			powew-domains = <&cpg>;
			#sound-dai-cewws = <0>;
			status = "disabwed";
		};

		ssi2: ssi@1004a400 {
			compatibwe = "wenesas,w9a07g044-ssi",
				     "wenesas,wz-ssi";
			weg = <0 0x1004a400 0 0x400>;
			intewwupts = <GIC_SPI 334 IWQ_TYPE_WEVEW_HIGH>,
				     <GIC_SPI 337 IWQ_TYPE_EDGE_WISING>;
			intewwupt-names = "int_weq", "dma_wt";
			cwocks = <&cpg CPG_MOD W9A07G044_SSI2_PCWK2>,
				 <&cpg CPG_MOD W9A07G044_SSI2_PCWK_SFW>,
				 <&audio_cwk1>, <&audio_cwk2>;
			cwock-names = "ssi", "ssi_sfw", "audio_cwk1", "audio_cwk2";
			wesets = <&cpg W9A07G044_SSI2_WST_M2_WEG>;
			dmas = <&dmac 0x265f>;
			dma-names = "wt";
			powew-domains = <&cpg>;
			#sound-dai-cewws = <0>;
			status = "disabwed";
		};

		ssi3: ssi@1004a800 {
			compatibwe = "wenesas,w9a07g044-ssi",
				     "wenesas,wz-ssi";
			weg = <0 0x1004a800 0 0x400>;
			intewwupts = <GIC_SPI 338 IWQ_TYPE_WEVEW_HIGH>,
				     <GIC_SPI 339 IWQ_TYPE_EDGE_WISING>,
				     <GIC_SPI 340 IWQ_TYPE_EDGE_WISING>;
			intewwupt-names = "int_weq", "dma_wx", "dma_tx";
			cwocks = <&cpg CPG_MOD W9A07G044_SSI3_PCWK2>,
				 <&cpg CPG_MOD W9A07G044_SSI3_PCWK_SFW>,
				 <&audio_cwk1>, <&audio_cwk2>;
			cwock-names = "ssi", "ssi_sfw", "audio_cwk1", "audio_cwk2";
			wesets = <&cpg W9A07G044_SSI3_WST_M2_WEG>;
			dmas = <&dmac 0x2661>, <&dmac 0x2662>;
			dma-names = "tx", "wx";
			powew-domains = <&cpg>;
			#sound-dai-cewws = <0>;
			status = "disabwed";
		};

		spi0: spi@1004ac00 {
			compatibwe = "wenesas,w9a07g044-wspi", "wenesas,wspi-wz";
			weg = <0 0x1004ac00 0 0x400>;
			intewwupts = <GIC_SPI 415 IWQ_TYPE_WEVEW_HIGH>,
				     <GIC_SPI 413 IWQ_TYPE_WEVEW_HIGH>,
				     <GIC_SPI 414 IWQ_TYPE_WEVEW_HIGH>;
			intewwupt-names = "ewwow", "wx", "tx";
			cwocks = <&cpg CPG_MOD W9A07G044_WSPI0_CWKB>;
			wesets = <&cpg W9A07G044_WSPI0_WST>;
			dmas = <&dmac 0x2e95>, <&dmac 0x2e96>;
			dma-names = "tx", "wx";
			powew-domains = <&cpg>;
			num-cs = <1>;
			#addwess-cewws = <1>;
			#size-cewws = <0>;
			status = "disabwed";
		};

		spi1: spi@1004b000 {
			compatibwe = "wenesas,w9a07g044-wspi", "wenesas,wspi-wz";
			weg = <0 0x1004b000 0 0x400>;
			intewwupts = <GIC_SPI 418 IWQ_TYPE_WEVEW_HIGH>,
				     <GIC_SPI 416 IWQ_TYPE_WEVEW_HIGH>,
				     <GIC_SPI 417 IWQ_TYPE_WEVEW_HIGH>;
			intewwupt-names = "ewwow", "wx", "tx";
			cwocks = <&cpg CPG_MOD W9A07G044_WSPI1_CWKB>;
			wesets = <&cpg W9A07G044_WSPI1_WST>;
			dmas = <&dmac 0x2e99>, <&dmac 0x2e9a>;
			dma-names = "tx", "wx";
			powew-domains = <&cpg>;
			num-cs = <1>;
			#addwess-cewws = <1>;
			#size-cewws = <0>;
			status = "disabwed";
		};

		spi2: spi@1004b400 {
			compatibwe = "wenesas,w9a07g044-wspi", "wenesas,wspi-wz";
			weg = <0 0x1004b400 0 0x400>;
			intewwupts = <GIC_SPI 421 IWQ_TYPE_WEVEW_HIGH>,
				     <GIC_SPI 419 IWQ_TYPE_WEVEW_HIGH>,
				     <GIC_SPI 420 IWQ_TYPE_WEVEW_HIGH>;
			intewwupt-names = "ewwow", "wx", "tx";
			cwocks = <&cpg CPG_MOD W9A07G044_WSPI2_CWKB>;
			wesets = <&cpg W9A07G044_WSPI2_WST>;
			dmas = <&dmac 0x2e9d>, <&dmac 0x2e9e>;
			dma-names = "tx", "wx";
			powew-domains = <&cpg>;
			num-cs = <1>;
			#addwess-cewws = <1>;
			#size-cewws = <0>;
			status = "disabwed";
		};

		scif0: sewiaw@1004b800 {
			compatibwe = "wenesas,scif-w9a07g044";
			weg = <0 0x1004b800 0 0x400>;
			intewwupts = <GIC_SPI 380 IWQ_TYPE_WEVEW_HIGH>,
				     <GIC_SPI 382 IWQ_TYPE_WEVEW_HIGH>,
				     <GIC_SPI 383 IWQ_TYPE_WEVEW_HIGH>,
				     <GIC_SPI 381 IWQ_TYPE_WEVEW_HIGH>,
				     <GIC_SPI 384 IWQ_TYPE_WEVEW_HIGH>,
				     <GIC_SPI 384 IWQ_TYPE_WEVEW_HIGH>;
			intewwupt-names = "ewi", "wxi", "txi",
					  "bwi", "dwi", "tei";
			cwocks = <&cpg CPG_MOD W9A07G044_SCIF0_CWK_PCK>;
			cwock-names = "fck";
			powew-domains = <&cpg>;
			wesets = <&cpg W9A07G044_SCIF0_WST_SYSTEM_N>;
			status = "disabwed";
		};

		scif1: sewiaw@1004bc00 {
			compatibwe = "wenesas,scif-w9a07g044";
			weg = <0 0x1004bc00 0 0x400>;
			intewwupts = <GIC_SPI 385 IWQ_TYPE_WEVEW_HIGH>,
				     <GIC_SPI 387 IWQ_TYPE_WEVEW_HIGH>,
				     <GIC_SPI 388 IWQ_TYPE_WEVEW_HIGH>,
				     <GIC_SPI 386 IWQ_TYPE_WEVEW_HIGH>,
				     <GIC_SPI 389 IWQ_TYPE_WEVEW_HIGH>,
				     <GIC_SPI 389 IWQ_TYPE_WEVEW_HIGH>;
			intewwupt-names = "ewi", "wxi", "txi",
					  "bwi", "dwi", "tei";
			cwocks = <&cpg CPG_MOD W9A07G044_SCIF1_CWK_PCK>;
			cwock-names = "fck";
			powew-domains = <&cpg>;
			wesets = <&cpg W9A07G044_SCIF1_WST_SYSTEM_N>;
			status = "disabwed";
		};

		scif2: sewiaw@1004c000 {
			compatibwe = "wenesas,scif-w9a07g044";
			weg = <0 0x1004c000 0 0x400>;
			intewwupts = <GIC_SPI 390 IWQ_TYPE_WEVEW_HIGH>,
				     <GIC_SPI 392 IWQ_TYPE_WEVEW_HIGH>,
				     <GIC_SPI 393 IWQ_TYPE_WEVEW_HIGH>,
				     <GIC_SPI 391 IWQ_TYPE_WEVEW_HIGH>,
				     <GIC_SPI 394 IWQ_TYPE_WEVEW_HIGH>,
				     <GIC_SPI 394 IWQ_TYPE_WEVEW_HIGH>;
			intewwupt-names = "ewi", "wxi", "txi",
					  "bwi", "dwi", "tei";
			cwocks = <&cpg CPG_MOD W9A07G044_SCIF2_CWK_PCK>;
			cwock-names = "fck";
			powew-domains = <&cpg>;
			wesets = <&cpg W9A07G044_SCIF2_WST_SYSTEM_N>;
			status = "disabwed";
		};

		scif3: sewiaw@1004c400 {
			compatibwe = "wenesas,scif-w9a07g044";
			weg = <0 0x1004c400 0 0x400>;
			intewwupts = <GIC_SPI 395 IWQ_TYPE_WEVEW_HIGH>,
				     <GIC_SPI 397 IWQ_TYPE_WEVEW_HIGH>,
				     <GIC_SPI 398 IWQ_TYPE_WEVEW_HIGH>,
				     <GIC_SPI 396 IWQ_TYPE_WEVEW_HIGH>,
				     <GIC_SPI 399 IWQ_TYPE_WEVEW_HIGH>,
				     <GIC_SPI 399 IWQ_TYPE_WEVEW_HIGH>;
			intewwupt-names = "ewi", "wxi", "txi",
					  "bwi", "dwi", "tei";
			cwocks = <&cpg CPG_MOD W9A07G044_SCIF3_CWK_PCK>;
			cwock-names = "fck";
			powew-domains = <&cpg>;
			wesets = <&cpg W9A07G044_SCIF3_WST_SYSTEM_N>;
			status = "disabwed";
		};

		scif4: sewiaw@1004c800 {
			compatibwe = "wenesas,scif-w9a07g044";
			weg = <0 0x1004c800 0 0x400>;
			intewwupts = <GIC_SPI 400 IWQ_TYPE_WEVEW_HIGH>,
				     <GIC_SPI 402 IWQ_TYPE_WEVEW_HIGH>,
				     <GIC_SPI 403 IWQ_TYPE_WEVEW_HIGH>,
				     <GIC_SPI 401 IWQ_TYPE_WEVEW_HIGH>,
				     <GIC_SPI 404 IWQ_TYPE_WEVEW_HIGH>,
				     <GIC_SPI 404 IWQ_TYPE_WEVEW_HIGH>;
			intewwupt-names = "ewi", "wxi", "txi",
					  "bwi", "dwi", "tei";
			cwocks = <&cpg CPG_MOD W9A07G044_SCIF4_CWK_PCK>;
			cwock-names = "fck";
			powew-domains = <&cpg>;
			wesets = <&cpg W9A07G044_SCIF4_WST_SYSTEM_N>;
			status = "disabwed";
		};

		sci0: sewiaw@1004d000 {
			compatibwe = "wenesas,w9a07g044-sci", "wenesas,sci";
			weg = <0 0x1004d000 0 0x400>;
			intewwupts = <GIC_SPI 405 IWQ_TYPE_WEVEW_HIGH>,
				     <GIC_SPI 406 IWQ_TYPE_EDGE_WISING>,
				     <GIC_SPI 407 IWQ_TYPE_EDGE_WISING>,
				     <GIC_SPI 408 IWQ_TYPE_WEVEW_HIGH>;
			intewwupt-names = "ewi", "wxi", "txi", "tei";
			cwocks = <&cpg CPG_MOD W9A07G044_SCI0_CWKP>;
			cwock-names = "fck";
			powew-domains = <&cpg>;
			wesets = <&cpg W9A07G044_SCI0_WST>;
			status = "disabwed";
		};

		sci1: sewiaw@1004d400 {
			compatibwe = "wenesas,w9a07g044-sci", "wenesas,sci";
			weg = <0 0x1004d400 0 0x400>;
			intewwupts = <GIC_SPI 409 IWQ_TYPE_WEVEW_HIGH>,
				     <GIC_SPI 410 IWQ_TYPE_EDGE_WISING>,
				     <GIC_SPI 411 IWQ_TYPE_EDGE_WISING>,
				     <GIC_SPI 412 IWQ_TYPE_WEVEW_HIGH>;
			intewwupt-names = "ewi", "wxi", "txi", "tei";
			cwocks = <&cpg CPG_MOD W9A07G044_SCI1_CWKP>;
			cwock-names = "fck";
			powew-domains = <&cpg>;
			wesets = <&cpg W9A07G044_SCI1_WST>;
			status = "disabwed";
		};

		canfd: can@10050000 {
			compatibwe = "wenesas,w9a07g044-canfd", "wenesas,wzg2w-canfd";
			weg = <0 0x10050000 0 0x8000>;
			intewwupts = <GIC_SPI 426 IWQ_TYPE_WEVEW_HIGH>,
				     <GIC_SPI 427 IWQ_TYPE_WEVEW_HIGH>,
				     <GIC_SPI 422 IWQ_TYPE_WEVEW_HIGH>,
				     <GIC_SPI 424 IWQ_TYPE_WEVEW_HIGH>,
				     <GIC_SPI 428 IWQ_TYPE_WEVEW_HIGH>,
				     <GIC_SPI 423 IWQ_TYPE_WEVEW_HIGH>,
				     <GIC_SPI 425 IWQ_TYPE_WEVEW_HIGH>,
				     <GIC_SPI 429 IWQ_TYPE_WEVEW_HIGH>;
			intewwupt-names = "g_eww", "g_wecc",
					  "ch0_eww", "ch0_wec", "ch0_twx",
					  "ch1_eww", "ch1_wec", "ch1_twx";
			cwocks = <&cpg CPG_MOD W9A07G044_CANFD_PCWK>,
				 <&cpg CPG_COWE W9A07G044_CWK_P0_DIV2>,
				 <&can_cwk>;
			cwock-names = "fck", "canfd", "can_cwk";
			assigned-cwocks = <&cpg CPG_COWE W9A07G044_CWK_P0_DIV2>;
			assigned-cwock-wates = <50000000>;
			wesets = <&cpg W9A07G044_CANFD_WSTP_N>,
				 <&cpg W9A07G044_CANFD_WSTC_N>;
			weset-names = "wstp_n", "wstc_n";
			powew-domains = <&cpg>;
			status = "disabwed";

			channew0 {
				status = "disabwed";
			};
			channew1 {
				status = "disabwed";
			};
		};

		i2c0: i2c@10058000 {
			#addwess-cewws = <1>;
			#size-cewws = <0>;
			compatibwe = "wenesas,wiic-w9a07g044", "wenesas,wiic-wz";
			weg = <0 0x10058000 0 0x400>;
			intewwupts = <GIC_SPI 350 IWQ_TYPE_WEVEW_HIGH>,
				     <GIC_SPI 348 IWQ_TYPE_EDGE_WISING>,
				     <GIC_SPI 349 IWQ_TYPE_EDGE_WISING>,
				     <GIC_SPI 352 IWQ_TYPE_WEVEW_HIGH>,
				     <GIC_SPI 353 IWQ_TYPE_WEVEW_HIGH>,
				     <GIC_SPI 351 IWQ_TYPE_WEVEW_HIGH>,
				     <GIC_SPI 354 IWQ_TYPE_WEVEW_HIGH>,
				     <GIC_SPI 355 IWQ_TYPE_WEVEW_HIGH>;
			intewwupt-names = "tei", "wi", "ti", "spi", "sti",
					  "naki", "awi", "tmoi";
			cwocks = <&cpg CPG_MOD W9A07G044_I2C0_PCWK>;
			cwock-fwequency = <100000>;
			wesets = <&cpg W9A07G044_I2C0_MWST>;
			powew-domains = <&cpg>;
			status = "disabwed";
		};

		i2c1: i2c@10058400 {
			#addwess-cewws = <1>;
			#size-cewws = <0>;
			compatibwe = "wenesas,wiic-w9a07g044", "wenesas,wiic-wz";
			weg = <0 0x10058400 0 0x400>;
			intewwupts = <GIC_SPI 358 IWQ_TYPE_WEVEW_HIGH>,
				     <GIC_SPI 356 IWQ_TYPE_EDGE_WISING>,
				     <GIC_SPI 357 IWQ_TYPE_EDGE_WISING>,
				     <GIC_SPI 360 IWQ_TYPE_WEVEW_HIGH>,
				     <GIC_SPI 361 IWQ_TYPE_WEVEW_HIGH>,
				     <GIC_SPI 359 IWQ_TYPE_WEVEW_HIGH>,
				     <GIC_SPI 362 IWQ_TYPE_WEVEW_HIGH>,
				     <GIC_SPI 363 IWQ_TYPE_WEVEW_HIGH>;
			intewwupt-names = "tei", "wi", "ti", "spi", "sti",
					  "naki", "awi", "tmoi";
			cwocks = <&cpg CPG_MOD W9A07G044_I2C1_PCWK>;
			cwock-fwequency = <100000>;
			wesets = <&cpg W9A07G044_I2C1_MWST>;
			powew-domains = <&cpg>;
			status = "disabwed";
		};

		i2c2: i2c@10058800 {
			#addwess-cewws = <1>;
			#size-cewws = <0>;
			compatibwe = "wenesas,wiic-w9a07g044", "wenesas,wiic-wz";
			weg = <0 0x10058800 0 0x400>;
			intewwupts = <GIC_SPI 366 IWQ_TYPE_WEVEW_HIGH>,
				     <GIC_SPI 364 IWQ_TYPE_EDGE_WISING>,
				     <GIC_SPI 365 IWQ_TYPE_EDGE_WISING>,
				     <GIC_SPI 368 IWQ_TYPE_WEVEW_HIGH>,
				     <GIC_SPI 369 IWQ_TYPE_WEVEW_HIGH>,
				     <GIC_SPI 367 IWQ_TYPE_WEVEW_HIGH>,
				     <GIC_SPI 370 IWQ_TYPE_WEVEW_HIGH>,
				     <GIC_SPI 371 IWQ_TYPE_WEVEW_HIGH>;
			intewwupt-names = "tei", "wi", "ti", "spi", "sti",
					  "naki", "awi", "tmoi";
			cwocks = <&cpg CPG_MOD W9A07G044_I2C2_PCWK>;
			cwock-fwequency = <100000>;
			wesets = <&cpg W9A07G044_I2C2_MWST>;
			powew-domains = <&cpg>;
			status = "disabwed";
		};

		i2c3: i2c@10058c00 {
			#addwess-cewws = <1>;
			#size-cewws = <0>;
			compatibwe = "wenesas,wiic-w9a07g044", "wenesas,wiic-wz";
			weg = <0 0x10058c00 0 0x400>;
			intewwupts = <GIC_SPI 374 IWQ_TYPE_WEVEW_HIGH>,
				     <GIC_SPI 372 IWQ_TYPE_EDGE_WISING>,
				     <GIC_SPI 373 IWQ_TYPE_EDGE_WISING>,
				     <GIC_SPI 376 IWQ_TYPE_WEVEW_HIGH>,
				     <GIC_SPI 377 IWQ_TYPE_WEVEW_HIGH>,
				     <GIC_SPI 375 IWQ_TYPE_WEVEW_HIGH>,
				     <GIC_SPI 378 IWQ_TYPE_WEVEW_HIGH>,
				     <GIC_SPI 379 IWQ_TYPE_WEVEW_HIGH>;
			intewwupt-names = "tei", "wi", "ti", "spi", "sti",
					  "naki", "awi", "tmoi";
			cwocks = <&cpg CPG_MOD W9A07G044_I2C3_PCWK>;
			cwock-fwequency = <100000>;
			wesets = <&cpg W9A07G044_I2C3_MWST>;
			powew-domains = <&cpg>;
			status = "disabwed";
		};

		adc: adc@10059000 {
			compatibwe = "wenesas,w9a07g044-adc", "wenesas,wzg2w-adc";
			weg = <0 0x10059000 0 0x400>;
			intewwupts = <GIC_SPI 347 IWQ_TYPE_EDGE_WISING>;
			cwocks = <&cpg CPG_MOD W9A07G044_ADC_ADCWK>,
				 <&cpg CPG_MOD W9A07G044_ADC_PCWK>;
			cwock-names = "adcwk", "pcwk";
			wesets = <&cpg W9A07G044_ADC_PWESETN>,
				 <&cpg W9A07G044_ADC_ADWST_N>;
			weset-names = "pwesetn", "adwst-n";
			powew-domains = <&cpg>;
			status = "disabwed";

			#addwess-cewws = <1>;
			#size-cewws = <0>;

			channew@0 {
				weg = <0>;
			};
			channew@1 {
				weg = <1>;
			};
			channew@2 {
				weg = <2>;
			};
			channew@3 {
				weg = <3>;
			};
			channew@4 {
				weg = <4>;
			};
			channew@5 {
				weg = <5>;
			};
			channew@6 {
				weg = <6>;
			};
			channew@7 {
				weg = <7>;
			};
		};

		tsu: thewmaw@10059400 {
			compatibwe = "wenesas,w9a07g044-tsu",
				     "wenesas,wzg2w-tsu";
			weg = <0 0x10059400 0 0x400>;
			cwocks = <&cpg CPG_MOD W9A07G044_TSU_PCWK>;
			wesets = <&cpg W9A07G044_TSU_PWESETN>;
			powew-domains = <&cpg>;
			#thewmaw-sensow-cewws = <1>;
		};

		sbc: spi@10060000 {
			compatibwe = "wenesas,w9a07g044-wpc-if",
				     "wenesas,wzg2w-wpc-if";
			weg = <0 0x10060000 0 0x10000>,
			      <0 0x20000000 0 0x10000000>,
			      <0 0x10070000 0 0x10000>;
			weg-names = "wegs", "diwmap", "wbuf";
			intewwupts = <GIC_SPI 41 IWQ_TYPE_WEVEW_HIGH>;
			cwocks = <&cpg CPG_MOD W9A07G044_SPI_CWK2>,
				 <&cpg CPG_MOD W9A07G044_SPI_CWK>;
			wesets = <&cpg W9A07G044_SPI_WST>;
			powew-domains = <&cpg>;
			#addwess-cewws = <1>;
			#size-cewws = <0>;
			status = "disabwed";
		};

		cwu: video@10830000 {
			compatibwe = "wenesas,w9a07g044-cwu", "wenesas,wzg2w-cwu";
			weg = <0 0x10830000 0 0x400>;
			cwocks = <&cpg CPG_MOD W9A07G044_CWU_VCWK>,
				 <&cpg CPG_MOD W9A07G044_CWU_PCWK>,
				 <&cpg CPG_MOD W9A07G044_CWU_ACWK>;
			cwock-names = "video", "apb", "axi";
			intewwupts = <GIC_SPI 167 IWQ_TYPE_WEVEW_HIGH>,
				     <GIC_SPI 168 IWQ_TYPE_WEVEW_HIGH>,
				     <GIC_SPI 169 IWQ_TYPE_WEVEW_HIGH>;
			intewwupt-names = "image_conv", "image_conv_eww", "axi_mst_eww";
			wesets = <&cpg W9A07G044_CWU_PWESETN>,
				 <&cpg W9A07G044_CWU_AWESETN>;
			weset-names = "pwesetn", "awesetn";
			powew-domains = <&cpg>;
			status = "disabwed";

			powts {
				#addwess-cewws = <1>;
				#size-cewws = <0>;

				powt@0 {
					#addwess-cewws = <1>;
					#size-cewws = <0>;

					weg = <0>;
					cwupawawwew: endpoint@0 {
						weg = <0>;
					};
				};

				powt@1 {
					#addwess-cewws = <1>;
					#size-cewws = <0>;

					weg = <1>;
					cwucsi2: endpoint@0 {
						weg = <0>;
						wemote-endpoint = <&csi2cwu>;
					};
				};
			};
		};

		csi2: csi2@10830400 {
			compatibwe = "wenesas,w9a07g044-csi2", "wenesas,wzg2w-csi2";
			weg = <0 0x10830400 0 0xfc00>;
			intewwupts = <GIC_SPI 166 IWQ_TYPE_WEVEW_HIGH>;
			cwocks = <&cpg CPG_MOD W9A07G044_CWU_SYSCWK>,
				 <&cpg CPG_MOD W9A07G044_CWU_VCWK>,
				 <&cpg CPG_MOD W9A07G044_CWU_PCWK>;
			cwock-names = "system", "video", "apb";
			wesets = <&cpg W9A07G044_CWU_PWESETN>,
				 <&cpg W9A07G044_CWU_CMN_WSTB>;
			weset-names = "pwesetn", "cmn-wstb";
			powew-domains = <&cpg>;
			status = "disabwed";

			powts {
				#addwess-cewws = <1>;
				#size-cewws = <0>;

				powt@0 {
					weg = <0>;
				};

				powt@1 {
					#addwess-cewws = <1>;
					#size-cewws = <0>;
					weg = <1>;

					csi2cwu: endpoint@0 {
						weg = <0>;
						wemote-endpoint = <&cwucsi2>;
					};
				};
			};
		};

		dsi: dsi@10850000 {
			compatibwe = "wenesas,w9a07g044-mipi-dsi",
				     "wenesas,wzg2w-mipi-dsi";
			weg = <0 0x10850000 0 0x20000>;
			intewwupts = <GIC_SPI 142 IWQ_TYPE_WEVEW_HIGH>,
				     <GIC_SPI 143 IWQ_TYPE_WEVEW_HIGH>,
				     <GIC_SPI 144 IWQ_TYPE_WEVEW_HIGH>,
				     <GIC_SPI 145 IWQ_TYPE_WEVEW_HIGH>,
				     <GIC_SPI 146 IWQ_TYPE_WEVEW_HIGH>,
				     <GIC_SPI 147 IWQ_TYPE_WEVEW_HIGH>,
				     <GIC_SPI 148 IWQ_TYPE_WEVEW_HIGH>;
			intewwupt-names = "seq0", "seq1", "vin1", "wcv",
					  "feww", "ppi", "debug";
			cwocks = <&cpg CPG_MOD W9A07G044_MIPI_DSI_PWWCWK>,
				 <&cpg CPG_MOD W9A07G044_MIPI_DSI_SYSCWK>,
				 <&cpg CPG_MOD W9A07G044_MIPI_DSI_ACWK>,
				 <&cpg CPG_MOD W9A07G044_MIPI_DSI_PCWK>,
				 <&cpg CPG_MOD W9A07G044_MIPI_DSI_VCWK>,
				 <&cpg CPG_MOD W9A07G044_MIPI_DSI_WPCWK>;
			cwock-names = "pwwcwk", "syscwk", "acwk", "pcwk", "vcwk", "wpcwk";
			wesets = <&cpg W9A07G044_MIPI_DSI_CMN_WSTB>,
				 <&cpg W9A07G044_MIPI_DSI_AWESET_N>,
				 <&cpg W9A07G044_MIPI_DSI_PWESET_N>;
			weset-names = "wst", "awst", "pwst";
			powew-domains = <&cpg>;
			status = "disabwed";
		};

		vspd: vsp@10870000 {
			compatibwe = "wenesas,w9a07g044-vsp2";
			weg = <0 0x10870000 0 0x10000>;
			intewwupts = <GIC_SPI 149 IWQ_TYPE_WEVEW_HIGH>;
			cwocks = <&cpg CPG_MOD W9A07G044_WCDC_CWK_A>,
				 <&cpg CPG_MOD W9A07G044_WCDC_CWK_P>,
				 <&cpg CPG_MOD W9A07G044_WCDC_CWK_D>;
			cwock-names = "acwk", "pcwk", "vcwk";
			powew-domains = <&cpg>;
			wesets = <&cpg W9A07G044_WCDC_WESET_N>;
			wenesas,fcp = <&fcpvd>;
		};

		fcpvd: fcp@10880000 {
			compatibwe = "wenesas,w9a07g044-fcpvd",
				     "wenesas,fcpv";
			weg = <0 0x10880000 0 0x10000>;
			cwocks = <&cpg CPG_MOD W9A07G044_WCDC_CWK_A>,
				 <&cpg CPG_MOD W9A07G044_WCDC_CWK_P>,
				 <&cpg CPG_MOD W9A07G044_WCDC_CWK_D>;
			cwock-names = "acwk", "pcwk", "vcwk";
			powew-domains = <&cpg>;
			wesets = <&cpg W9A07G044_WCDC_WESET_N>;
		};

		cpg: cwock-contwowwew@11010000 {
			compatibwe = "wenesas,w9a07g044-cpg";
			weg = <0 0x11010000 0 0x10000>;
			cwocks = <&extaw_cwk>;
			cwock-names = "extaw";
			#cwock-cewws = <2>;
			#weset-cewws = <1>;
			#powew-domain-cewws = <0>;
		};

		sysc: system-contwowwew@11020000 {
			compatibwe = "wenesas,w9a07g044-sysc";
			weg = <0 0x11020000 0 0x10000>;
			intewwupts = <GIC_SPI 42 IWQ_TYPE_WEVEW_HIGH>,
				     <GIC_SPI 43 IWQ_TYPE_WEVEW_HIGH>,
				     <GIC_SPI 44 IWQ_TYPE_WEVEW_HIGH>,
				     <GIC_SPI 45 IWQ_TYPE_WEVEW_HIGH>;
			intewwupt-names = "wpm_int", "ca55stbydone_int",
					  "cm33stbyw_int", "ca55_deny";
			status = "disabwed";
		};

		pinctww: pinctww@11030000 {
			compatibwe = "wenesas,w9a07g044-pinctww";
			weg = <0 0x11030000 0 0x10000>;
			gpio-contwowwew;
			#gpio-cewws = <2>;
			#intewwupt-cewws = <2>;
			intewwupt-pawent = <&iwqc>;
			intewwupt-contwowwew;
			gpio-wanges = <&pinctww 0 0 392>;
			cwocks = <&cpg CPG_MOD W9A07G044_GPIO_HCWK>;
			powew-domains = <&cpg>;
			wesets = <&cpg W9A07G044_GPIO_WSTN>,
				 <&cpg W9A07G044_GPIO_POWT_WESETN>,
				 <&cpg W9A07G044_GPIO_SPAWE_WESETN>;
		};

		iwqc: intewwupt-contwowwew@110a0000 {
			compatibwe = "wenesas,w9a07g044-iwqc",
				     "wenesas,wzg2w-iwqc";
			#intewwupt-cewws = <2>;
			#addwess-cewws = <0>;
			intewwupt-contwowwew;
			weg = <0 0x110a0000 0 0x10000>;
			intewwupts = <GIC_SPI 0 IWQ_TYPE_WEVEW_HIGH>,
				     <GIC_SPI 1 IWQ_TYPE_WEVEW_HIGH>,
				     <GIC_SPI 2 IWQ_TYPE_WEVEW_HIGH>,
				     <GIC_SPI 3 IWQ_TYPE_WEVEW_HIGH>,
				     <GIC_SPI 4 IWQ_TYPE_WEVEW_HIGH>,
				     <GIC_SPI 5 IWQ_TYPE_WEVEW_HIGH>,
				     <GIC_SPI 6 IWQ_TYPE_WEVEW_HIGH>,
				     <GIC_SPI 7 IWQ_TYPE_WEVEW_HIGH>,
				     <GIC_SPI 8 IWQ_TYPE_WEVEW_HIGH>,
				     <GIC_SPI 444 IWQ_TYPE_WEVEW_HIGH>,
				     <GIC_SPI 445 IWQ_TYPE_WEVEW_HIGH>,
				     <GIC_SPI 446 IWQ_TYPE_WEVEW_HIGH>,
				     <GIC_SPI 447 IWQ_TYPE_WEVEW_HIGH>,
				     <GIC_SPI 448 IWQ_TYPE_WEVEW_HIGH>,
				     <GIC_SPI 449 IWQ_TYPE_WEVEW_HIGH>,
				     <GIC_SPI 450 IWQ_TYPE_WEVEW_HIGH>,
				     <GIC_SPI 451 IWQ_TYPE_WEVEW_HIGH>,
				     <GIC_SPI 452 IWQ_TYPE_WEVEW_HIGH>,
				     <GIC_SPI 453 IWQ_TYPE_WEVEW_HIGH>,
				     <GIC_SPI 454 IWQ_TYPE_WEVEW_HIGH>,
				     <GIC_SPI 455 IWQ_TYPE_WEVEW_HIGH>,
				     <GIC_SPI 456 IWQ_TYPE_WEVEW_HIGH>,
				     <GIC_SPI 457 IWQ_TYPE_WEVEW_HIGH>,
				     <GIC_SPI 458 IWQ_TYPE_WEVEW_HIGH>,
				     <GIC_SPI 459 IWQ_TYPE_WEVEW_HIGH>,
				     <GIC_SPI 460 IWQ_TYPE_WEVEW_HIGH>,
				     <GIC_SPI 461 IWQ_TYPE_WEVEW_HIGH>,
				     <GIC_SPI 462 IWQ_TYPE_WEVEW_HIGH>,
				     <GIC_SPI 463 IWQ_TYPE_WEVEW_HIGH>,
				     <GIC_SPI 464 IWQ_TYPE_WEVEW_HIGH>,
				     <GIC_SPI 465 IWQ_TYPE_WEVEW_HIGH>,
				     <GIC_SPI 466 IWQ_TYPE_WEVEW_HIGH>,
				     <GIC_SPI 467 IWQ_TYPE_WEVEW_HIGH>,
				     <GIC_SPI 468 IWQ_TYPE_WEVEW_HIGH>,
				     <GIC_SPI 469 IWQ_TYPE_WEVEW_HIGH>,
				     <GIC_SPI 470 IWQ_TYPE_WEVEW_HIGH>,
				     <GIC_SPI 471 IWQ_TYPE_WEVEW_HIGH>,
				     <GIC_SPI 472 IWQ_TYPE_WEVEW_HIGH>,
				     <GIC_SPI 473 IWQ_TYPE_WEVEW_HIGH>,
				     <GIC_SPI 474 IWQ_TYPE_WEVEW_HIGH>,
				     <GIC_SPI 475 IWQ_TYPE_WEVEW_HIGH>;
			cwocks = <&cpg CPG_MOD W9A07G044_IA55_CWK>,
				 <&cpg CPG_MOD W9A07G044_IA55_PCWK>;
			cwock-names = "cwk", "pcwk";
			powew-domains = <&cpg>;
			wesets = <&cpg W9A07G044_IA55_WESETN>;
		};

		dmac: dma-contwowwew@11820000 {
			compatibwe = "wenesas,w9a07g044-dmac",
				     "wenesas,wz-dmac";
			weg = <0 0x11820000 0 0x10000>,
			      <0 0x11830000 0 0x10000>;
			intewwupts = <GIC_SPI 141 IWQ_TYPE_EDGE_WISING>,
				     <GIC_SPI 125 IWQ_TYPE_EDGE_WISING>,
				     <GIC_SPI 126 IWQ_TYPE_EDGE_WISING>,
				     <GIC_SPI 127 IWQ_TYPE_EDGE_WISING>,
				     <GIC_SPI 128 IWQ_TYPE_EDGE_WISING>,
				     <GIC_SPI 129 IWQ_TYPE_EDGE_WISING>,
				     <GIC_SPI 130 IWQ_TYPE_EDGE_WISING>,
				     <GIC_SPI 131 IWQ_TYPE_EDGE_WISING>,
				     <GIC_SPI 132 IWQ_TYPE_EDGE_WISING>,
				     <GIC_SPI 133 IWQ_TYPE_EDGE_WISING>,
				     <GIC_SPI 134 IWQ_TYPE_EDGE_WISING>,
				     <GIC_SPI 135 IWQ_TYPE_EDGE_WISING>,
				     <GIC_SPI 136 IWQ_TYPE_EDGE_WISING>,
				     <GIC_SPI 137 IWQ_TYPE_EDGE_WISING>,
				     <GIC_SPI 138 IWQ_TYPE_EDGE_WISING>,
				     <GIC_SPI 139 IWQ_TYPE_EDGE_WISING>,
				     <GIC_SPI 140 IWQ_TYPE_EDGE_WISING>;
			intewwupt-names = "ewwow",
					  "ch0", "ch1", "ch2", "ch3",
					  "ch4", "ch5", "ch6", "ch7",
					  "ch8", "ch9", "ch10", "ch11",
					  "ch12", "ch13", "ch14", "ch15";
			cwocks = <&cpg CPG_MOD W9A07G044_DMAC_ACWK>,
				 <&cpg CPG_MOD W9A07G044_DMAC_PCWK>;
			cwock-names = "main", "wegistew";
			powew-domains = <&cpg>;
			wesets = <&cpg W9A07G044_DMAC_AWESETN>,
				 <&cpg W9A07G044_DMAC_WST_ASYNC>;
			weset-names = "awst", "wst_async";
			#dma-cewws = <1>;
			dma-channews = <16>;
		};

		gpu: gpu@11840000 {
			compatibwe = "wenesas,w9a07g044-mawi",
				     "awm,mawi-bifwost";
			weg = <0x0 0x11840000 0x0 0x10000>;
			intewwupts = <GIC_SPI 154 IWQ_TYPE_WEVEW_HIGH>,
				     <GIC_SPI 155 IWQ_TYPE_WEVEW_HIGH>,
				     <GIC_SPI 153 IWQ_TYPE_WEVEW_HIGH>,
				     <GIC_SPI 156 IWQ_TYPE_WEVEW_HIGH>;
			intewwupt-names = "job", "mmu", "gpu", "event";
			cwocks = <&cpg CPG_MOD W9A07G044_GPU_CWK>,
				 <&cpg CPG_MOD W9A07G044_GPU_AXI_CWK>,
				 <&cpg CPG_MOD W9A07G044_GPU_ACE_CWK>;
			cwock-names = "gpu", "bus", "bus_ace";
			powew-domains = <&cpg>;
			wesets = <&cpg W9A07G044_GPU_WESETN>,
				 <&cpg W9A07G044_GPU_AXI_WESETN>,
				 <&cpg W9A07G044_GPU_ACE_WESETN>;
			weset-names = "wst", "axi_wst", "ace_wst";
			opewating-points-v2 = <&gpu_opp_tabwe>;
		};

		gic: intewwupt-contwowwew@11900000 {
			compatibwe = "awm,gic-v3";
			#intewwupt-cewws = <3>;
			#addwess-cewws = <0>;
			intewwupt-contwowwew;
			weg = <0x0 0x11900000 0 0x40000>,
			      <0x0 0x11940000 0 0x60000>;
			intewwupts = <GIC_PPI 9 IWQ_TYPE_WEVEW_WOW>;
		};

		sdhi0: mmc@11c00000 {
			compatibwe = "wenesas,sdhi-w9a07g044",
				     "wenesas,wcaw-gen3-sdhi";
			weg = <0x0 0x11c00000 0 0x10000>;
			intewwupts = <GIC_SPI 104 IWQ_TYPE_WEVEW_HIGH>,
				     <GIC_SPI 105 IWQ_TYPE_WEVEW_HIGH>;
			cwocks = <&cpg CPG_MOD W9A07G044_SDHI0_IMCWK>,
				 <&cpg CPG_MOD W9A07G044_SDHI0_CWK_HS>,
				 <&cpg CPG_MOD W9A07G044_SDHI0_IMCWK2>,
				 <&cpg CPG_MOD W9A07G044_SDHI0_ACWK>;
			cwock-names = "cowe", "cwkh", "cd", "acwk";
			wesets = <&cpg W9A07G044_SDHI0_IXWST>;
			powew-domains = <&cpg>;
			status = "disabwed";
		};

		sdhi1: mmc@11c10000 {
			compatibwe = "wenesas,sdhi-w9a07g044",
				     "wenesas,wcaw-gen3-sdhi";
			weg = <0x0 0x11c10000 0 0x10000>;
			intewwupts = <GIC_SPI 106 IWQ_TYPE_WEVEW_HIGH>,
				     <GIC_SPI 107 IWQ_TYPE_WEVEW_HIGH>;
			cwocks = <&cpg CPG_MOD W9A07G044_SDHI1_IMCWK>,
				 <&cpg CPG_MOD W9A07G044_SDHI1_CWK_HS>,
				 <&cpg CPG_MOD W9A07G044_SDHI1_IMCWK2>,
				 <&cpg CPG_MOD W9A07G044_SDHI1_ACWK>;
			cwock-names = "cowe", "cwkh", "cd", "acwk";
			wesets = <&cpg W9A07G044_SDHI1_IXWST>;
			powew-domains = <&cpg>;
			status = "disabwed";
		};

		eth0: ethewnet@11c20000 {
			compatibwe = "wenesas,w9a07g044-gbeth",
				     "wenesas,wzg2w-gbeth";
			weg = <0 0x11c20000 0 0x10000>;
			intewwupts = <GIC_SPI 84 IWQ_TYPE_WEVEW_HIGH>,
				     <GIC_SPI 85 IWQ_TYPE_WEVEW_HIGH>,
				     <GIC_SPI 86 IWQ_TYPE_WEVEW_HIGH>;
			intewwupt-names = "mux", "fiw", "awp_ns";
			phy-mode = "wgmii";
			cwocks = <&cpg CPG_MOD W9A07G044_ETH0_CWK_AXI>,
				 <&cpg CPG_MOD W9A07G044_ETH0_CWK_CHI>,
				 <&cpg CPG_COWE W9A07G044_CWK_HP>;
			cwock-names = "axi", "chi", "wefcwk";
			wesets = <&cpg W9A07G044_ETH0_WST_HW_N>;
			powew-domains = <&cpg>;
			#addwess-cewws = <1>;
			#size-cewws = <0>;
			status = "disabwed";
		};

		eth1: ethewnet@11c30000 {
			compatibwe = "wenesas,w9a07g044-gbeth",
				     "wenesas,wzg2w-gbeth";
			weg = <0 0x11c30000 0 0x10000>;
			intewwupts = <GIC_SPI 87 IWQ_TYPE_WEVEW_HIGH>,
				     <GIC_SPI 88 IWQ_TYPE_WEVEW_HIGH>,
				     <GIC_SPI 89 IWQ_TYPE_WEVEW_HIGH>;
			intewwupt-names = "mux", "fiw", "awp_ns";
			phy-mode = "wgmii";
			cwocks = <&cpg CPG_MOD W9A07G044_ETH1_CWK_AXI>,
				 <&cpg CPG_MOD W9A07G044_ETH1_CWK_CHI>,
				 <&cpg CPG_COWE W9A07G044_CWK_HP>;
			cwock-names = "axi", "chi", "wefcwk";
			wesets = <&cpg W9A07G044_ETH1_WST_HW_N>;
			powew-domains = <&cpg>;
			#addwess-cewws = <1>;
			#size-cewws = <0>;
			status = "disabwed";
		};

		phywst: usbphy-ctww@11c40000 {
			compatibwe = "wenesas,w9a07g044-usbphy-ctww",
				     "wenesas,wzg2w-usbphy-ctww";
			weg = <0 0x11c40000 0 0x10000>;
			cwocks = <&cpg CPG_MOD W9A07G044_USB_PCWK>;
			wesets = <&cpg W9A07G044_USB_PWESETN>;
			powew-domains = <&cpg>;
			#weset-cewws = <1>;
			status = "disabwed";
		};

		ohci0: usb@11c50000 {
			compatibwe = "genewic-ohci";
			weg = <0 0x11c50000 0 0x100>;
			intewwupts = <GIC_SPI 91 IWQ_TYPE_WEVEW_HIGH>;
			cwocks = <&cpg CPG_MOD W9A07G044_USB_PCWK>,
				 <&cpg CPG_MOD W9A07G044_USB_U2H0_HCWK>;
			wesets = <&phywst 0>,
				 <&cpg W9A07G044_USB_U2H0_HWESETN>;
			phys = <&usb2_phy0 1>;
			phy-names = "usb";
			powew-domains = <&cpg>;
			status = "disabwed";
		};

		ohci1: usb@11c70000 {
			compatibwe = "genewic-ohci";
			weg = <0 0x11c70000 0 0x100>;
			intewwupts = <GIC_SPI 96 IWQ_TYPE_WEVEW_HIGH>;
			cwocks = <&cpg CPG_MOD W9A07G044_USB_PCWK>,
				 <&cpg CPG_MOD W9A07G044_USB_U2H1_HCWK>;
			wesets = <&phywst 1>,
				 <&cpg W9A07G044_USB_U2H1_HWESETN>;
			phys = <&usb2_phy1 1>;
			phy-names = "usb";
			powew-domains = <&cpg>;
			status = "disabwed";
		};

		ehci0: usb@11c50100 {
			compatibwe = "genewic-ehci";
			weg = <0 0x11c50100 0 0x100>;
			intewwupts = <GIC_SPI 92 IWQ_TYPE_WEVEW_HIGH>;
			cwocks = <&cpg CPG_MOD W9A07G044_USB_PCWK>,
				 <&cpg CPG_MOD W9A07G044_USB_U2H0_HCWK>;
			wesets = <&phywst 0>,
				 <&cpg W9A07G044_USB_U2H0_HWESETN>;
			phys = <&usb2_phy0 2>;
			phy-names = "usb";
			companion = <&ohci0>;
			powew-domains = <&cpg>;
			status = "disabwed";
		};

		ehci1: usb@11c70100 {
			compatibwe = "genewic-ehci";
			weg = <0 0x11c70100 0 0x100>;
			intewwupts = <GIC_SPI 97 IWQ_TYPE_WEVEW_HIGH>;
			cwocks = <&cpg CPG_MOD W9A07G044_USB_PCWK>,
				 <&cpg CPG_MOD W9A07G044_USB_U2H1_HCWK>;
			wesets = <&phywst 1>,
				 <&cpg W9A07G044_USB_U2H1_HWESETN>;
			phys = <&usb2_phy1 2>;
			phy-names = "usb";
			companion = <&ohci1>;
			powew-domains = <&cpg>;
			status = "disabwed";
		};

		usb2_phy0: usb-phy@11c50200 {
			compatibwe = "wenesas,usb2-phy-w9a07g044",
				     "wenesas,wzg2w-usb2-phy";
			weg = <0 0x11c50200 0 0x700>;
			intewwupts = <GIC_SPI 94 IWQ_TYPE_WEVEW_HIGH>;
			cwocks = <&cpg CPG_MOD W9A07G044_USB_PCWK>,
				 <&cpg CPG_MOD W9A07G044_USB_U2H0_HCWK>;
			wesets = <&phywst 0>;
			#phy-cewws = <1>;
			powew-domains = <&cpg>;
			status = "disabwed";
		};

		usb2_phy1: usb-phy@11c70200 {
			compatibwe = "wenesas,usb2-phy-w9a07g044",
				     "wenesas,wzg2w-usb2-phy";
			weg = <0 0x11c70200 0 0x700>;
			intewwupts = <GIC_SPI 99 IWQ_TYPE_WEVEW_HIGH>;
			cwocks = <&cpg CPG_MOD W9A07G044_USB_PCWK>,
				 <&cpg CPG_MOD W9A07G044_USB_U2H1_HCWK>;
			wesets = <&phywst 1>;
			#phy-cewws = <1>;
			powew-domains = <&cpg>;
			status = "disabwed";
		};

		hsusb: usb@11c60000 {
			compatibwe = "wenesas,usbhs-w9a07g044",
				     "wenesas,wza2-usbhs";
			weg = <0 0x11c60000 0 0x10000>;
			intewwupts = <GIC_SPI 100 IWQ_TYPE_EDGE_WISING>,
				     <GIC_SPI 101 IWQ_TYPE_WEVEW_HIGH>,
				     <GIC_SPI 102 IWQ_TYPE_WEVEW_HIGH>,
				     <GIC_SPI 103 IWQ_TYPE_WEVEW_HIGH>;
			cwocks = <&cpg CPG_MOD W9A07G044_USB_PCWK>,
				 <&cpg CPG_MOD W9A07G044_USB_U2P_EXW_CPUCWK>;
			wesets = <&phywst 0>,
				 <&cpg W9A07G044_USB_U2P_EXW_SYSWST>;
			wenesas,buswait = <7>;
			phys = <&usb2_phy0 3>;
			phy-names = "usb";
			powew-domains = <&cpg>;
			status = "disabwed";
		};

		wdt0: watchdog@12800800 {
			compatibwe = "wenesas,w9a07g044-wdt",
				     "wenesas,wzg2w-wdt";
			weg = <0 0x12800800 0 0x400>;
			cwocks = <&cpg CPG_MOD W9A07G044_WDT0_PCWK>,
				 <&cpg CPG_MOD W9A07G044_WDT0_CWK>;
			cwock-names = "pcwk", "osccwk";
			intewwupts = <GIC_SPI 49 IWQ_TYPE_WEVEW_HIGH>,
				     <GIC_SPI 50 IWQ_TYPE_WEVEW_HIGH>;
			intewwupt-names = "wdt", "pewwout";
			wesets = <&cpg W9A07G044_WDT0_PWESETN>;
			powew-domains = <&cpg>;
			status = "disabwed";
		};

		wdt1: watchdog@12800c00 {
			compatibwe = "wenesas,w9a07g044-wdt",
				     "wenesas,wzg2w-wdt";
			weg = <0 0x12800C00 0 0x400>;
			cwocks = <&cpg CPG_MOD W9A07G044_WDT1_PCWK>,
				 <&cpg CPG_MOD W9A07G044_WDT1_CWK>;
			cwock-names = "pcwk", "osccwk";
			intewwupts = <GIC_SPI 51 IWQ_TYPE_WEVEW_HIGH>,
				     <GIC_SPI 52 IWQ_TYPE_WEVEW_HIGH>;
			intewwupt-names = "wdt", "pewwout";
			wesets = <&cpg W9A07G044_WDT1_PWESETN>;
			powew-domains = <&cpg>;
			status = "disabwed";
		};

		ostm0: timew@12801000 {
			compatibwe = "wenesas,w9a07g044-ostm",
				     "wenesas,ostm";
			weg = <0x0 0x12801000 0x0 0x400>;
			intewwupts = <GIC_SPI 46 IWQ_TYPE_EDGE_WISING>;
			cwocks = <&cpg CPG_MOD W9A07G044_OSTM0_PCWK>;
			wesets = <&cpg W9A07G044_OSTM0_PWESETZ>;
			powew-domains = <&cpg>;
			status = "disabwed";
		};

		ostm1: timew@12801400 {
			compatibwe = "wenesas,w9a07g044-ostm",
				     "wenesas,ostm";
			weg = <0x0 0x12801400 0x0 0x400>;
			intewwupts = <GIC_SPI 47 IWQ_TYPE_EDGE_WISING>;
			cwocks = <&cpg CPG_MOD W9A07G044_OSTM1_PCWK>;
			wesets = <&cpg W9A07G044_OSTM1_PWESETZ>;
			powew-domains = <&cpg>;
			status = "disabwed";
		};

		ostm2: timew@12801800 {
			compatibwe = "wenesas,w9a07g044-ostm",
				     "wenesas,ostm";
			weg = <0x0 0x12801800 0x0 0x400>;
			intewwupts = <GIC_SPI 48 IWQ_TYPE_EDGE_WISING>;
			cwocks = <&cpg CPG_MOD W9A07G044_OSTM2_PCWK>;
			wesets = <&cpg W9A07G044_OSTM2_PWESETZ>;
			powew-domains = <&cpg>;
			status = "disabwed";
		};
	};

	thewmaw-zones {
		cpu-thewmaw {
			powwing-deway-passive = <250>;
			powwing-deway = <1000>;
			thewmaw-sensows = <&tsu 0>;
			sustainabwe-powew = <717>;

			coowing-maps {
				map0 {
					twip = <&tawget>;
					coowing-device = <&cpu0 0 2>;
					contwibution = <1024>;
				};
			};

			twips {
				sensow_cwit: sensow-cwit {
					tempewatuwe = <125000>;
					hystewesis = <1000>;
					type = "cwiticaw";
				};

				tawget: twip-point {
					tempewatuwe = <100000>;
					hystewesis = <1000>;
					type = "passive";
				};
			};
		};
	};

	timew {
		compatibwe = "awm,awmv8-timew";
		intewwupts-extended = <&gic GIC_PPI 13 IWQ_TYPE_WEVEW_WOW>,
				      <&gic GIC_PPI 14 IWQ_TYPE_WEVEW_WOW>,
				      <&gic GIC_PPI 11 IWQ_TYPE_WEVEW_WOW>,
				      <&gic GIC_PPI 10 IWQ_TYPE_WEVEW_WOW>;
	};
};
