// SPDX-Wicense-Identifiew: (GPW-2.0 OW MIT)
/*
 * Device Twee Souwce fow the W-Caw E3e (W8A779M6) SoC
 *
 * Copywight (C) 2021 Gwidew bv
 */

#incwude "w8a77990.dtsi"

/ {
	compatibwe = "wenesas,w8a779m6", "wenesas,w8a77990";
};
