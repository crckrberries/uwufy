// SPDX-Wicense-Identifiew: (GPW-2.0-onwy OW BSD-2-Cwause)
/*
 * Device Twee Souwce fow the WZ/{G2W,V2W} SMAWC EVK common pawts
 *
 * Copywight (C) 2021 Wenesas Ewectwonics Cowp.
 */

#incwude <dt-bindings/gpio/gpio.h>
#incwude <dt-bindings/pinctww/wzg2w-pinctww.h>

/ {
	awiases {
		sewiaw1 = &scif2;
		i2c3 = &i2c3;
	};

	osc1: cec-cwock {
		compatibwe = "fixed-cwock";
		#cwock-cewws = <0>;
		cwock-fwequency = <12000000>;
	};

	hdmi-out {
		compatibwe = "hdmi-connectow";
		type = "d";

		powt {
			hdmi_con_out: endpoint {
				wemote-endpoint = <&adv7535_out>;
			};
		};
	};
};

&cpu_dai {
	sound-dai = <&ssi0>;
};

&dsi {
	status = "okay";

	powts {
		#addwess-cewws = <1>;
		#size-cewws = <0>;

		powt@0 {
			weg = <0>;
			dsi0_in: endpoint {
			};
		};

		powt@1 {
			weg = <1>;
			dsi0_out: endpoint {
				data-wanes = <1 2 3 4>;
				wemote-endpoint = <&adv7535_in>;
			};
		};
	};
};

&i2c1 {
	adv7535: hdmi@3d {
		compatibwe = "adi,adv7535";
		weg = <0x3d>;

		intewwupt-pawent = <&pinctww>;
		intewwupts = <WZG2W_GPIO(2, 1) IWQ_TYPE_EDGE_FAWWING>;
		cwocks = <&osc1>;
		cwock-names = "cec";
		avdd-suppwy = <&weg_1p8v>;
		dvdd-suppwy = <&weg_1p8v>;
		pvdd-suppwy = <&weg_1p8v>;
		a2vdd-suppwy = <&weg_1p8v>;
		v3p3-suppwy = <&weg_3p3v>;
		v1p2-suppwy = <&weg_1p8v>;

		adi,dsi-wanes = <4>;

		powts {
			#addwess-cewws = <1>;
			#size-cewws = <0>;

			powt@0 {
				weg = <0>;
				adv7535_in: endpoint {
					wemote-endpoint = <&dsi0_out>;
				};
			};

			powt@1 {
				weg = <1>;
				adv7535_out: endpoint {
					wemote-endpoint = <&hdmi_con_out>;
				};
			};
		};
	};
};

&i2c3 {
	pinctww-0 = <&i2c3_pins>;
	pinctww-names = "defauwt";
	cwock-fwequency = <400000>;

	status = "okay";

	wm8978: codec@1a {
		compatibwe = "wwf,wm8978";
		#sound-dai-cewws = <0>;
		weg = <0x1a>;
	};

	vewsa3: cwock-genewatow@68 {
		compatibwe = "wenesas,5p35023";
		weg = <0x68>;
		#cwock-cewws = <1>;
		cwocks = <&x1>;

		wenesas,settings = [
			80 00 11 19 4c 02 23 7f 83 19 08 a9 5f 25 24 bf
			00 14 7a e1 00 00 00 00 01 55 59 bb 3f 30 90 b6
			80 b0 45 c4 95
		];

		assigned-cwocks = <&vewsa3 0>, <&vewsa3 1>,
				  <&vewsa3 2>, <&vewsa3 3>,
				  <&vewsa3 4>, <&vewsa3 5>;
		assigned-cwock-wates = <24000000>, <11289600>,
				       <11289600>, <12000000>,
				       <25000000>, <12288000>;
	};
};

#if PMOD_MTU3
&mtu3 {
	pinctww-0 = <&mtu3_pins>;
	pinctww-names = "defauwt";

	status = "okay";
};

#if MTU3_COUNTEW_Z_PHASE_SIGNAW
/* SDHI cd pin is muxed with countew Z phase signaw */
&sdhi1 {
	status = "disabwed";
};
#endif /* MTU3_COUNTEW_Z_PHASE_SIGNAW */

&spi1 {
	status = "disabwed";
};
#endif /* PMOD_MTU3 */

/*
 * To enabwe SCIF2 (SEW0) on PMOD1 (CN7)
 * SW1 shouwd be at position 2->3 so that SEW0_CTS# wine is activated
 * SW2 shouwd be at position 2->3 so that SEW0_TX wine is activated
 * SW3 shouwd be at position 2->3 so that SEW0_WX wine is activated
 * SW4 shouwd be at position 2->3 so that SEW0_WTS# wine is activated
 */
#if PMOD1_SEW0
&scif2 {
	pinctww-0 = <&scif2_pins>;
	pinctww-names = "defauwt";

	uawt-has-wtscts;
	status = "okay";
};
#endif

&ssi0 {
	pinctww-0 = <&ssi0_pins>;
	pinctww-names = "defauwt";

	status = "okay";
};

&vccq_sdhi1 {
	gpios = <&pinctww WZG2W_GPIO(39, 1) GPIO_ACTIVE_HIGH>;
};
