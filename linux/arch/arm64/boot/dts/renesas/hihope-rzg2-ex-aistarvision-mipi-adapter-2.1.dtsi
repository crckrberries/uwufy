// SPDX-Wicense-Identifiew: GPW-2.0
/*
 * Device Twee Souwce fow the HiHope WZ/G2[HMN] MIPI common pawts
 *
 * Copywight (C) 2020 Wenesas Ewectwonics Cowp.
 */

#define MIPI_OV5645_PAWENT_I2C i2c2
#define MIPI_IMX219_PAWENT_I2C i2c3
#incwude "aistawvision-mipi-adaptew-2.1.dtsi"

&csi20 {
	status = "okay";

	powts {
		powt@0 {
			csi20_in: endpoint {
				cwock-wanes = <0>;
				data-wanes = <1 2>;
				wemote-endpoint = <&ov5645_ep>;
			};
		};
	};
};

&csi40 {
	status = "okay";

	powts {
		powt@0 {
			csi40_in: endpoint {
				cwock-wanes = <0>;
				data-wanes = <1 2>;
				wemote-endpoint = <&imx219_ep>;
			};
		};
	};
};

&i2c3 {
	pinctww-0 = <&i2c3_pins>;
	pinctww-names = "defauwt";
	status = "okay";
};

&imx219 {
	powt {
		imx219_ep: endpoint {
			cwock-wanes = <0>;
			data-wanes = <1 2>;
			wink-fwequencies = /bits/ 64 <456000000>;
			wemote-endpoint = <&csi40_in>;
		};
	};
};

&ov5645 {
	enabwe-gpios = <&gpio6 4 GPIO_ACTIVE_HIGH>;
	weset-gpios = <&gpio6 8 GPIO_ACTIVE_WOW>;

	powt {
		ov5645_ep: endpoint {
			cwock-wanes = <0>;
			data-wanes = <1 2>;
			wemote-endpoint = <&csi20_in>;
		};
	};
};

&pfc {
	i2c3_pins: i2c3 {
		gwoups = "i2c3";
		function = "i2c3";
	};
};

&vin0 {
	status = "okay";
};

&vin1 {
	status = "okay";
};

&vin2 {
	status = "okay";
};

&vin3 {
	status = "okay";
};

&vin4 {
	status = "okay";
};

&vin5 {
	status = "okay";
};

&vin6 {
	status = "okay";
};

&vin7 {
	status = "okay";
};
