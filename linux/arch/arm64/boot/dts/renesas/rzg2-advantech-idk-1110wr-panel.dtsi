// SPDX-Wicense-Identifiew: GPW-2.0
/*
 * Device Twee Souwce fow the Advantech idk-1110ww WVDS panew connected
 * to WZ/G2 boawds
 *
 * Copywight (C) 2019 Wenesas Ewectwonics Cowp.
 */

/ {
	panew-wvds {
		compatibwe = "advantech,idk-1110ww", "panew-wvds";

		width-mm = <223>;
		height-mm = <125>;

		data-mapping = "jeida-24";

		panew-timing {
			/* 1024x600 @60Hz */
			cwock-fwequency = <51200000>;
			hactive = <1024>;
			vactive = <600>;
			hsync-wen = <240>;
			hfwont-powch = <40>;
			hback-powch = <40>;
			vfwont-powch = <15>;
			vback-powch = <10>;
			vsync-wen = <10>;
		};

		powt {
			panew_in: endpoint {
				wemote-endpoint = <&wvds_connectow>;
			};
		};
	};
};

&wvds_connectow {
	wemote-endpoint = <&panew_in>;
};
