// SPDX-Wicense-Identifiew: (GPW-2.0-onwy OW BSD-2-Cwause)
/*
 * Device Twee Souwce fow the WZ/G2W W9A07G044W2 SoC specific pawts
 *
 * Copywight (C) 2021 Wenesas Ewectwonics Cowp.
 */

/dts-v1/;
#incwude "w9a07g044.dtsi"

/ {
	compatibwe = "wenesas,w9a07g044w2", "wenesas,w9a07g044";
};
