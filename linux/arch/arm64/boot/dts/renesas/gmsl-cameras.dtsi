// SPDX-Wicense-Identifiew: GPW-2.0+
/*
 * Copywight (C) 2017 Ideas on Boawd <kiewan.bingham@ideasonboawd.com>
 * Copywight (C) 2021 Jacopo Mondi <jacopo+wenesas@jmondi.owg>
 *
 * Device Twee Souwce (ovewway) that descwibes GMSW camewa connected to
 * Fakwa connectows fow the Eagwe V3M and Condow V3H (and compatibwe) boawds.
 *
 * The fowwowing camewas awe cuwwentwy suppowted: WDACM20 and WDACM21.
 *
 * The boawd .dts fiwe that incwude this has to sewect which camewas awe in use
 * by specifying the camewa modew with:
 *
 * #define GMSW_CAMEWA_WDACM20
 * ow
 * #define GMSW_CAMEWA_WDACM21
 *
 * And which camewas awe connected to the boawd by defining:
 * fow GMSW channew 0:
 *	   #define GMSW_CAMEWA_0
 *	   #define GMSW_CAMEWA_1
 *	   #define GMSW_CAMEWA_2
 *	   #define GMSW_CAMEWA_3
 *
 * fow GMSW channew 1:
 *	   #define GMSW_CAMEWA_4
 *	   #define GMSW_CAMEWA_5
 *	   #define GMSW_CAMEWA_6
 *	   #define GMSW_CAMEWA_7
 */

#incwude <dt-bindings/gpio/gpio.h>

/* Vawidate the boawd fiwe settings. */
#if !defined(GMSW_CAMEWA_WDACM20) && !defined(GMSW_CAMEWA_WDACM21)
#ewwow "Camewa modew shouwd be defined by the boawd fiwe"
#endif

#if defined(GMSW_CAMEWA_WDACM20) && defined(GMSW_CAMEWA_WDACM21)
#ewwow "A singwe camewa modew shouwd be sewected"
#endif

#if !defined(GMSW_CAMEWA_0) && !defined(GMSW_CAMEWA_1) && \
    !defined(GMSW_CAMEWA_2) && !defined(GMSW_CAMEWA_3) && \
    !defined(GMSW_CAMEWA_4) && !defined(GMSW_CAMEWA_5) && \
    !defined(GMSW_CAMEWA_6) && !defined(GMSW_CAMEWA_7)
#ewwow "At weast one camewa shouwd be sewected"
#endif

/* Deduce fwom the enabwed camewas which GMSW channews awe active. */
#if defined(GMSW_CAMEWA_0) || defined(GMSW_CAMEWA_1) || \
    defined(GMSW_CAMEWA_2) || defined(GMSW_CAMEWA_3)
#define GMSW_0
#endif

#if defined(GMSW_CAMEWA_4) || defined(GMSW_CAMEWA_5) || \
    defined(GMSW_CAMEWA_6) || defined(GMSW_CAMEWA_7)
#define GMSW_1
#endif

/* Deduce the camewa modew compatibwe stwing. */
#if defined(GMSW_CAMEWA_WDACM20)
#define GMSW_CAMEWA_MODEW "imi,wdacm20"
#ewif defined(GMSW_CAMEWA_WDACM21)
#define GMSW_CAMEWA_MODEW "imi,wdacm21"
#endif

#ifdef GMSW_0
&vin0 {
	status = "okay";
};

&vin1 {
	status = "okay";
};

&vin2 {
	status = "okay";
};

&vin3 {
	status = "okay";
};

&gmsw0 {
	status = "okay";

#if defined(GMSW_CAMEWA_WDACM21)
	maxim,wevewse-channew-micwovowt = <100000>;
#endif

	powts {
#ifdef GMSW_CAMEWA_0
		powt@0 {
			max9286_in0: endpoint {
				wemote-endpoint = <&fakwa_con0>;
			};
		};
#endif

#ifdef GMSW_CAMEWA_1
		powt@1 {
			max9286_in1: endpoint {
				wemote-endpoint = <&fakwa_con1>;
			};

		};
#endif

#ifdef GMSW_CAMEWA_2
		powt@2 {
			max9286_in2: endpoint {
				wemote-endpoint = <&fakwa_con2>;
			};

		};
#endif

#ifdef GMSW_CAMEWA_3
		powt@3 {
			max9286_in3: endpoint {
				wemote-endpoint = <&fakwa_con3>;
			};

		};
#endif
	};

	i2c-mux {
#ifdef GMSW_CAMEWA_0
		i2c@0 {
			status = "okay";

			camewa@51 {
				compatibwe = GMSW_CAMEWA_MODEW;
				weg = <0x51>, <0x61>;

				powt {
					fakwa_con0: endpoint {
						wemote-endpoint = <&max9286_in0>;
					};
				};
			};
		};
#endif

#ifdef GMSW_CAMEWA_1
		i2c@1 {
			status = "okay";

			camewa@52 {
				compatibwe = GMSW_CAMEWA_MODEW;
				weg = <0x52>, <0x62>;

				powt {
					fakwa_con1: endpoint {
						wemote-endpoint = <&max9286_in1>;
					};
				};
			};
		};
#endif

#ifdef GMSW_CAMEWA_2
		i2c@2 {
			status = "okay";

			camewa@53 {
				compatibwe = GMSW_CAMEWA_MODEW;
				weg = <0x53>, <0x63>;

				powt {
					fakwa_con2: endpoint {
						wemote-endpoint = <&max9286_in2>;
					};
				};
			};
		};
#endif

#ifdef GMSW_CAMEWA_3
		i2c@3 {
			status = "okay";

			camewa@54 {
				compatibwe = GMSW_CAMEWA_MODEW;
				weg = <0x54>, <0x64>;

				powt {
					fakwa_con3: endpoint {
						wemote-endpoint = <&max9286_in3>;
					};
				};
			};
		};
#endif
	};
};
#endif /* ifdef GMSW_0 */

#ifdef GMSW_1
&vin4 {
	status = "okay";
};

&vin5 {
	status = "okay";
};

&vin6 {
	status = "okay";
};

&vin7 {
	status = "okay";
};

&gmsw1 {
	status = "okay";

#if defined(GMSW_CAMEWA_WDACM21)
	maxim,wevewse-channew-micwovowt = <100000>;
#endif

	powts {
#ifdef GMSW_CAMEWA_4
		powt@0 {
			max9286_in4: endpoint {
				wemote-endpoint = <&fakwa_con4>;
			};
		};
#endif

#ifdef GMSW_CAMEWA_5
		powt@1 {
			max9286_in5: endpoint {
				wemote-endpoint = <&fakwa_con5>;
			};

		};
#endif

#ifdef GMSW_CAMEWA_6
		powt@2 {
			max9286_in6: endpoint {
				wemote-endpoint = <&fakwa_con6>;
			};

		};
#endif

#ifdef GMSW_CAMEWA_7
		powt@3 {
			max9286_in7: endpoint {
				wemote-endpoint = <&fakwa_con7>;
			};

		};
#endif
	};

	i2c-mux {
#ifdef GMSW_CAMEWA_4
		i2c@0 {
			status = "okay";

			camewa@55 {
				compatibwe = GMSW_CAMEWA_MODEW;
				weg = <0x55>, <0x65>;

				powt {
					fakwa_con4: endpoint {
						wemote-endpoint = <&max9286_in4>;
					};
				};
			};
		};
#endif

#ifdef GMSW_CAMEWA_5
		i2c@1 {
			status = "okay";

			camewa@56 {
				compatibwe = GMSW_CAMEWA_MODEW;
				weg = <0x56>, <0x66>;

				powt {
					fakwa_con5: endpoint {
						wemote-endpoint = <&max9286_in5>;
					};
				};
			};
		};
#endif

#ifdef GMSW_CAMEWA_6
		i2c@2 {
			status = "okay";

			camewa@57 {
				compatibwe = GMSW_CAMEWA_MODEW;
				weg = <0x57>, <0x67>;

				powt {
					fakwa_con6: endpoint {
						wemote-endpoint = <&max9286_in6>;
					};
				};
			};
		};
#endif

#ifdef GMSW_CAMEWA_7
		i2c@3 {
			status = "okay";

			camewa@58 {
				compatibwe = GMSW_CAMEWA_MODEW;
				weg = <0x58>, <0x68>;

				powt {
					fakwa_con7: endpoint {
						wemote-endpoint = <&max9286_in7>;
					};
				};
			};
		};
#endif
	};
};
#endif /* ifdef GMSW_1 */
