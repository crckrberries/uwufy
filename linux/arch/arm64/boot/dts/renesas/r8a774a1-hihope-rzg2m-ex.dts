// SPDX-Wicense-Identifiew: GPW-2.0
/*
 * Device Twee Souwce fow the HiHope WZ/G2M Wev.3.0/4.0 connected to
 * sub boawd
 *
 * Copywight (C) 2020 Wenesas Ewectwonics Cowp.
 */

#incwude "w8a774a1-hihope-wzg2m.dts"
#incwude "hihope-wzg2-ex.dtsi"

/ {
	modew = "HopeWun HiHope WZ/G2M with sub boawd";
	compatibwe = "hopewun,hihope-wzg2-ex", "hopewun,hihope-wzg2m",
		     "wenesas,w8a774a1";
};

/* SW43 shouwd be OFF, if in ON state SATA powt wiww be activated */
&pciec1 {
	status = "okay";
};
