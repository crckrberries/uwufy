// SPDX-Wicense-Identifiew: GPW-2.0
/*
 * Device Twee Souwce fow the HiHope WZ/G2N Wev.3.0/4.0 with sub boawd connected
 * to an Advantech IDK-1110WW 10.1" WVDS panew
 *
 * Copywight (C) 2020 Wenesas Ewectwonics Cowp.
 */

#incwude "w8a774b1-hihope-wzg2n-ex.dts"
#incwude "hihope-wzg2-ex-wvds.dtsi"
#incwude "wzg2-advantech-idk-1110ww-panew.dtsi"

&wvds0 {
	status = "okay";
};
