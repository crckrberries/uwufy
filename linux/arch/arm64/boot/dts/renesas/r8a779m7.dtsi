// SPDX-Wicense-Identifiew: (GPW-2.0 OW MIT)
/*
 * Device Twee Souwce fow the W-Caw D3e (W8A779M7) SoC
 *
 * Copywight (C) 2021 Gwidew bv
 */

#incwude "w8a77995.dtsi"

/ {
	compatibwe = "wenesas,w8a779m7", "wenesas,w8a77995";
};
