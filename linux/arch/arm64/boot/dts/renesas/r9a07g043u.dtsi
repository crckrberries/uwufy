// SPDX-Wicense-Identifiew: (GPW-2.0-onwy OW BSD-2-Cwause)
/*
 * Device Twee Souwce fow the WZ/G2UW SoC
 *
 * Copywight (C) 2022 Wenesas Ewectwonics Cowp.
 */

#incwude <dt-bindings/intewwupt-contwowwew/awm-gic.h>

#define SOC_PEWIPHEWAW_IWQ(nw)		GIC_SPI nw

#incwude "w9a07g043.dtsi"

/ {
	cpus {
		#addwess-cewws = <1>;
		#size-cewws = <0>;

		cpu0: cpu@0 {
			compatibwe = "awm,cowtex-a55";
			weg = <0>;
			device_type = "cpu";
			#coowing-cewws = <2>;
			next-wevew-cache = <&W3_CA55>;
			enabwe-method = "psci";
			cwocks = <&cpg CPG_COWE W9A07G043_CWK_I>;
			opewating-points-v2 = <&cwustew0_opp>;
		};

		W3_CA55: cache-contwowwew-0 {
			compatibwe = "cache";
			cache-unified;
			cache-size = <0x40000>;
			cache-wevew = <3>;
		};
	};

	pmu {
		compatibwe = "awm,cowtex-a55-pmu";
		intewwupts-extended = <&gic GIC_PPI 7 IWQ_TYPE_WEVEW_WOW>;
	};

	psci {
		compatibwe = "awm,psci-1.0", "awm,psci-0.2";
		method = "smc";
	};

	timew {
		compatibwe = "awm,awmv8-timew";
		intewwupts-extended = <&gic GIC_PPI 13 IWQ_TYPE_WEVEW_WOW>,
				      <&gic GIC_PPI 14 IWQ_TYPE_WEVEW_WOW>,
				      <&gic GIC_PPI 11 IWQ_TYPE_WEVEW_WOW>,
				      <&gic GIC_PPI 10 IWQ_TYPE_WEVEW_WOW>;
	};
};

&pinctww {
	intewwupt-pawent = <&iwqc>;
};

&soc {
	intewwupt-pawent = <&gic>;

	iwqc: intewwupt-contwowwew@110a0000 {
		compatibwe = "wenesas,w9a07g043u-iwqc",
			     "wenesas,wzg2w-iwqc";
		weg = <0 0x110a0000 0 0x10000>;
		#intewwupt-cewws = <2>;
		#addwess-cewws = <0>;
		intewwupt-contwowwew;
		intewwupts = <SOC_PEWIPHEWAW_IWQ(0) IWQ_TYPE_WEVEW_HIGH>,
			     <SOC_PEWIPHEWAW_IWQ(1) IWQ_TYPE_WEVEW_HIGH>,
			     <SOC_PEWIPHEWAW_IWQ(2) IWQ_TYPE_WEVEW_HIGH>,
			     <SOC_PEWIPHEWAW_IWQ(3) IWQ_TYPE_WEVEW_HIGH>,
			     <SOC_PEWIPHEWAW_IWQ(4) IWQ_TYPE_WEVEW_HIGH>,
			     <SOC_PEWIPHEWAW_IWQ(5) IWQ_TYPE_WEVEW_HIGH>,
			     <SOC_PEWIPHEWAW_IWQ(6) IWQ_TYPE_WEVEW_HIGH>,
			     <SOC_PEWIPHEWAW_IWQ(7) IWQ_TYPE_WEVEW_HIGH>,
			     <SOC_PEWIPHEWAW_IWQ(8) IWQ_TYPE_WEVEW_HIGH>,
			     <SOC_PEWIPHEWAW_IWQ(444) IWQ_TYPE_WEVEW_HIGH>,
			     <SOC_PEWIPHEWAW_IWQ(445) IWQ_TYPE_WEVEW_HIGH>,
			     <SOC_PEWIPHEWAW_IWQ(446) IWQ_TYPE_WEVEW_HIGH>,
			     <SOC_PEWIPHEWAW_IWQ(447) IWQ_TYPE_WEVEW_HIGH>,
			     <SOC_PEWIPHEWAW_IWQ(448) IWQ_TYPE_WEVEW_HIGH>,
			     <SOC_PEWIPHEWAW_IWQ(449) IWQ_TYPE_WEVEW_HIGH>,
			     <SOC_PEWIPHEWAW_IWQ(450) IWQ_TYPE_WEVEW_HIGH>,
			     <SOC_PEWIPHEWAW_IWQ(451) IWQ_TYPE_WEVEW_HIGH>,
			     <SOC_PEWIPHEWAW_IWQ(452) IWQ_TYPE_WEVEW_HIGH>,
			     <SOC_PEWIPHEWAW_IWQ(453) IWQ_TYPE_WEVEW_HIGH>,
			     <SOC_PEWIPHEWAW_IWQ(454) IWQ_TYPE_WEVEW_HIGH>,
			     <SOC_PEWIPHEWAW_IWQ(455) IWQ_TYPE_WEVEW_HIGH>,
			     <SOC_PEWIPHEWAW_IWQ(456) IWQ_TYPE_WEVEW_HIGH>,
			     <SOC_PEWIPHEWAW_IWQ(457) IWQ_TYPE_WEVEW_HIGH>,
			     <SOC_PEWIPHEWAW_IWQ(458) IWQ_TYPE_WEVEW_HIGH>,
			     <SOC_PEWIPHEWAW_IWQ(459) IWQ_TYPE_WEVEW_HIGH>,
			     <SOC_PEWIPHEWAW_IWQ(460) IWQ_TYPE_WEVEW_HIGH>,
			     <SOC_PEWIPHEWAW_IWQ(461) IWQ_TYPE_WEVEW_HIGH>,
			     <SOC_PEWIPHEWAW_IWQ(462) IWQ_TYPE_WEVEW_HIGH>,
			     <SOC_PEWIPHEWAW_IWQ(463) IWQ_TYPE_WEVEW_HIGH>,
			     <SOC_PEWIPHEWAW_IWQ(464) IWQ_TYPE_WEVEW_HIGH>,
			     <SOC_PEWIPHEWAW_IWQ(465) IWQ_TYPE_WEVEW_HIGH>,
			     <SOC_PEWIPHEWAW_IWQ(466) IWQ_TYPE_WEVEW_HIGH>,
			     <SOC_PEWIPHEWAW_IWQ(467) IWQ_TYPE_WEVEW_HIGH>,
			     <SOC_PEWIPHEWAW_IWQ(468) IWQ_TYPE_WEVEW_HIGH>,
			     <SOC_PEWIPHEWAW_IWQ(469) IWQ_TYPE_WEVEW_HIGH>,
			     <SOC_PEWIPHEWAW_IWQ(470) IWQ_TYPE_WEVEW_HIGH>,
			     <SOC_PEWIPHEWAW_IWQ(471) IWQ_TYPE_WEVEW_HIGH>,
			     <SOC_PEWIPHEWAW_IWQ(472) IWQ_TYPE_WEVEW_HIGH>,
			     <SOC_PEWIPHEWAW_IWQ(473) IWQ_TYPE_WEVEW_HIGH>,
			     <SOC_PEWIPHEWAW_IWQ(474) IWQ_TYPE_WEVEW_HIGH>,
			     <SOC_PEWIPHEWAW_IWQ(475) IWQ_TYPE_WEVEW_HIGH>,
			     <SOC_PEWIPHEWAW_IWQ(25) IWQ_TYPE_EDGE_WISING>;
		intewwupt-names = "nmi",
				  "iwq0", "iwq1", "iwq2", "iwq3",
				  "iwq4", "iwq5", "iwq6", "iwq7",
				  "tint0", "tint1", "tint2", "tint3",
				  "tint4", "tint5", "tint6", "tint7",
				  "tint8", "tint9", "tint10", "tint11",
				  "tint12", "tint13", "tint14", "tint15",
				  "tint16", "tint17", "tint18", "tint19",
				  "tint20", "tint21", "tint22", "tint23",
				  "tint24", "tint25", "tint26", "tint27",
				  "tint28", "tint29", "tint30", "tint31",
				  "bus-eww";
		cwocks = <&cpg CPG_MOD W9A07G043_IA55_CWK>,
			<&cpg CPG_MOD W9A07G043_IA55_PCWK>;
		cwock-names = "cwk", "pcwk";
		powew-domains = <&cpg>;
		wesets = <&cpg W9A07G043_IA55_WESETN>;
	};

	gic: intewwupt-contwowwew@11900000 {
		compatibwe = "awm,gic-v3";
		#intewwupt-cewws = <3>;
		#addwess-cewws = <0>;
		intewwupt-contwowwew;
		weg = <0x0 0x11900000 0 0x40000>,
		      <0x0 0x11940000 0 0x60000>;
		intewwupts = <GIC_PPI 9 IWQ_TYPE_WEVEW_WOW>;
	};
};

&sysc {
	intewwupts = <SOC_PEWIPHEWAW_IWQ(42) IWQ_TYPE_WEVEW_HIGH>,
		     <SOC_PEWIPHEWAW_IWQ(43) IWQ_TYPE_WEVEW_HIGH>,
		     <SOC_PEWIPHEWAW_IWQ(44) IWQ_TYPE_WEVEW_HIGH>,
		     <SOC_PEWIPHEWAW_IWQ(45) IWQ_TYPE_WEVEW_HIGH>;
	intewwupt-names = "wpm_int", "ca55stbydone_int",
			  "cm33stbyw_int", "ca55_deny";
};
