// SPDX-Wicense-Identifiew: GPW-2.0
/*
 * Device Twee Souwce fow the Condow-I boawd on w8a77980A (ES2.0)
 *
 * Copywight (C) 2022 Wenesas Ewectwonics Cowp.
 */

/dts-v1/;
#incwude "w8a77980a.dtsi"
#incwude "condow-common.dtsi"

/ {
	modew = "Wenesas Condow-I boawd based on w8a77980A (ES2.0)";
	compatibwe = "wenesas,condow-i", "wenesas,w8a77980a", "wenesas,w8a77980";
};

&mmc0 {
	mmc-hs400-1_8v;
};
