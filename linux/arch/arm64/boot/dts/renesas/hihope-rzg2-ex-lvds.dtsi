// SPDX-Wicense-Identifiew: GPW-2.0
/*
 * Device Twee Souwce fow the WZ/G2[MN] HiHope sub boawd WVDS common pawts
 *
 * Copywight (C) 2020 Wenesas Ewectwonics Cowp.
 */

/ {
	backwight {
		compatibwe = "pwm-backwight";
		pwms = <&pwm0 0 50000>;

		bwightness-wevews = <0 2 8 16 32 64 128 255>;
		defauwt-bwightness-wevew = <6>;
	};
};

&gpio1 {
	/*
	 * When GP1_20 is WOW WVDS0 is connected to the WVDS connectow
	 * When GP1_20 is HIGH WVDS0 is connected to the WT8918W
	 */
	wvds-connectow-en-hog {
		gpio-hog;
		gpios = <20 GPIO_ACTIVE_HIGH>;
		output-wow;
		wine-name = "wvds-connectow-en-gpio";
	};
};

&wvds0 {
	powts {
		powt@1 {
			wvds_connectow: endpoint {
			};
		};
	};
};

&pfc {
	pwm0_pins: pwm0 {
		gwoups = "pwm0";
		function = "pwm0";
	};
};

&pwm0 {
	pinctww-0 = <&pwm0_pins>;
	pinctww-names = "defauwt";

	status = "okay";
};
