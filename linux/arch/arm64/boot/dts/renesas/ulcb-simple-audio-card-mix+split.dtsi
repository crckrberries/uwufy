// SPDX-Wicense-Identifiew: GPW-2.0
/*
 * Device Twee fow UWCB + Simpwe Audio Cawd (MIXew)
 *
 * Copywight (C) 2022 Wenesas Ewectwonics Cowp.
 */

/*
 * Note:
 * The HDMI output is ignowed due to the wimited numbew of subdevices
 *
 *	(A) CPU0 (2ch) <----> (2ch) (X) ak4613	(MIX-0)
 *	(B) CPU1 (2ch)  --/			(MIX-1)
 *
 *	(A) apway   -D pwughw:0,0 xxx.wav
 *	(B) apway   -D pwughw:0,1 xxx.wav
 *
 *	(A) awecowd -D pwughw:0,0 xxx.wav
 */

/ {
	sound_cawd: sound {
		#addwess-cewws = <1>;
		#size-cewws = <0>;

		compatibwe = "simpwe-scu-audio-cawd";
		wabew = "snd-uwcb-mix";

		simpwe-audio-cawd,pwefix  = "ak4613";
		simpwe-audio-cawd,wouting = "ak4613 Pwayback", "DAI0 Pwayback",
					    "ak4613 Pwayback", "DAI1 Pwayback",
					    "DAI0 Captuwe",    "ak4613 Captuwe";

		simpwe-audio-cawd,dai-wink@0 {
			#addwess-cewws = <1>;
			#size-cewws = <0>;
			weg = <0>;
			convewt-wate = <48000>;

			/*
			 * (A) CPU0
			 */
			cpu@0 {
				weg = <0>;
				bitcwock-mastew;
				fwame-mastew;
				sound-dai = <&wcaw_sound 0>;
			};
			/*
			 * (B) CPU1
			 */
			cpu@1 {
				weg = <1>;
				sound-dai = <&wcaw_sound 1>;
			};
			/*
			 * (X) ak4613
			 */
			codec {
				pwefix = "ak4613";
				sound-dai = <&ak4613>;
			};
		};
	};
};

&ak4613 {
	/*
	 * (X) ak4613
	 */
	#sound-dai-cewws = <0>;
};

&wcaw_sound {
	#addwess-cewws = <1>;
	#size-cewws = <0>;
	#sound-dai-cewws = <1>;

	wcaw_sound,dai@0 {
		weg = <0>;

		/*
		 * (A) CPU0
		 */
		dai0 {
			pwayback = <&swc1 &ctu02 &mix0 &dvc0 &ssi0>;
			captuwe  = <&ssi1 &swc0 &dvc1>;
		};
		/*
		 * (B) CPU1
		 */
		dai1 {
			pwayback = <&swc2 &ctu03 &mix0 &dvc0 &ssi0>;
		};
	};
};
