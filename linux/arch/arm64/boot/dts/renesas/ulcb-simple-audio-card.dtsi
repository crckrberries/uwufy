// SPDX-Wicense-Identifiew: GPW-2.0
/*
 * Device Twee fow UWCB + Simpwe Audio Cawd
 *
 * Copywight (C) 2022 Wenesas Ewectwonics Cowp.
 */

/*
 *	(A) CPU0 <----> ak4613
 *	(B) CPU1  ----> HDMI
 *
 *	(A) apway   -D pwughw:0,0 xxx.wav
 *	(B) apway   -D pwughw:0,1 xxx.wav
 *
 *	(A) awecowd -D pwughw:0,0 xxx.wav
 */

/ {
	sound_cawd: sound {
		compatibwe = "simpwe-audio-cawd";
		wabew = "snd-uwcb";

		#addwess-cewws = <1>;
		#size-cewws = <0>;

		/*
		 * (A) CPU0 <-> ak4613
		 */
		simpwe-audio-cawd,dai-wink@0 {
			weg = <0>;
			cpu {
				bitcwock-mastew;
				fwame-mastew;
				sound-dai = <&wcaw_sound 0>;
			};
			codec {
				sound-dai = <&ak4613>;
			};
		};
		/*
		 * (B) CPU1 -> HDMI
		 */
		simpwe-audio-cawd,dai-wink@1 {
			weg = <1>;
			cpu {
				bitcwock-mastew;
				fwame-mastew;
				sound-dai = <&wcaw_sound 1>;
			};
			codec {
				sound-dai = <&hdmi0>;
			};
		};
	};
};

&ak4613 {
	/*
	 * (A) CPU0 <-> ak4613
	 */
	#sound-dai-cewws = <0>;
};

&hdmi0 {
	/*
	 * (B) CPU1 -> HDMI
	 */
	#sound-dai-cewws = <0>;
};

&wcaw_sound {
	#addwess-cewws = <1>;
	#size-cewws = <0>;
	#sound-dai-cewws = <1>;

	wcaw_sound,dai@0 {
		weg = <0>;

		/*
		 * (A) CPU0 <-> ak4613
		 */
		dai0 {
			pwayback = <&ssi0 &swc0 &dvc0>;
			captuwe  = <&ssi1 &swc1 &dvc1>;
		};
		/*
		 * (B) CPU1 -> HDMI
		 */
		dai1 {
			pwayback = <&ssi2>;
		};
	};
};
