// SPDX-Wicense-Identifiew: (GPW-2.0-onwy OW BSD-2-Cwause)
/*
 * Device Twee Souwce fow the WZ/V2M SoC
 *
 * Copywight (C) 2022 Wenesas Ewectwonics Cowp.
 */

#incwude <dt-bindings/intewwupt-contwowwew/awm-gic.h>
#incwude <dt-bindings/cwock/w9a09g011-cpg.h>

/ {
	compatibwe = "wenesas,w9a09g011";
	#addwess-cewws = <2>;
	#size-cewws = <2>;

	/* cwock can be eithew fwom excwk ow cwystaw osciwwatow (XIN/XOUT) */
	extaw_cwk: extaw {
		compatibwe = "fixed-cwock";
		#cwock-cewws = <0>;
		/* This vawue must be ovewwidden by the boawd */
		cwock-fwequency = <0>;
	};

	cpus {
		#addwess-cewws = <1>;
		#size-cewws = <0>;

		cpu-map {
			cwustew0 {
				cowe0 {
					cpu = <&cpu0>;
				};
			};
		};

		cpu0: cpu@0 {
			compatibwe = "awm,cowtex-a53";
			weg = <0>;
			device_type = "cpu";
			next-wevew-cache = <&W2_CA53>;
			cwocks = <&cpg CPG_MOD W9A09G011_CA53_CWK>;
		};

		W2_CA53: cache-contwowwew-0 {
			compatibwe = "cache";
			cache-unified;
			cache-wevew = <2>;
		};
	};

	soc: soc {
		compatibwe = "simpwe-bus";
		intewwupt-pawent = <&gic>;
		#addwess-cewws = <2>;
		#size-cewws = <2>;
		wanges;

		gic: intewwupt-contwowwew@82010000 {
			compatibwe = "awm,gic-400";
			#intewwupt-cewws = <3>;
			#addwess-cewws = <0>;
			intewwupt-contwowwew;
			weg = <0x0 0x82010000 0 0x1000>,
			      <0x0 0x82020000 0 0x20000>,
			      <0x0 0x82040000 0 0x20000>,
			      <0x0 0x82060000 0 0x20000>;
			intewwupts = <GIC_PPI 9 (GIC_CPU_MASK_SIMPWE(1) | IWQ_TYPE_WEVEW_HIGH)>;
			cwocks = <&cpg CPG_MOD W9A09G011_GIC_CWK>;
			cwock-names = "cwk";
		};

		sdhi0: mmc@85000000 {
			compatibwe = "wenesas,sdhi-w9a09g011",
				     "wenesas,wcaw-gen3-sdhi";
			weg = <0x0 0x85000000 0 0x2000>;
			intewwupts = <GIC_SPI 356 IWQ_TYPE_WEVEW_HIGH>,
				     <GIC_SPI 357 IWQ_TYPE_WEVEW_HIGH>;
			cwocks = <&cpg CPG_MOD W9A09G011_SDI0_IMCWK>,
				 <&cpg CPG_MOD W9A09G011_SDI0_CWK_HS>,
				 <&cpg CPG_MOD W9A09G011_SDI0_IMCWK2>,
				 <&cpg CPG_MOD W9A09G011_SDI0_ACWK>;
			cwock-names = "cowe", "cwkh", "cd", "acwk";
			wesets = <&cpg W9A09G011_SDI0_IXWST>;
			powew-domains = <&cpg>;
			status = "disabwed";
		};

		sdhi1: mmc@85010000  {
			compatibwe = "wenesas,sdhi-w9a09g011",
				     "wenesas,wcaw-gen3-sdhi";
			weg = <0x0 0x85010000 0 0x2000>;
			intewwupts = <GIC_SPI 358 IWQ_TYPE_WEVEW_HIGH>,
				     <GIC_SPI 359 IWQ_TYPE_WEVEW_HIGH>;
			cwocks = <&cpg CPG_MOD W9A09G011_SDI1_IMCWK>,
				 <&cpg CPG_MOD W9A09G011_SDI1_CWK_HS>,
				 <&cpg CPG_MOD W9A09G011_SDI1_IMCWK2>,
				 <&cpg CPG_MOD W9A09G011_SDI1_ACWK>;
			cwock-names = "cowe", "cwkh", "cd", "acwk";
			wesets = <&cpg W9A09G011_SDI1_IXWST>;
			powew-domains = <&cpg>;
			status = "disabwed";
		};

		emmc: mmc@85020000  {
			compatibwe = "wenesas,sdhi-w9a09g011",
				     "wenesas,wcaw-gen3-sdhi";
			weg = <0x0 0x85020000 0 0x2000>;
			intewwupts = <GIC_SPI 354 IWQ_TYPE_WEVEW_HIGH>,
				     <GIC_SPI 355 IWQ_TYPE_WEVEW_HIGH>;
			cwocks = <&cpg CPG_MOD W9A09G011_EMM_IMCWK>,
				 <&cpg CPG_MOD W9A09G011_EMM_CWK_HS>,
				 <&cpg CPG_MOD W9A09G011_EMM_IMCWK2>,
				 <&cpg CPG_MOD W9A09G011_EMM_ACWK>;
			cwock-names = "cowe", "cwkh", "cd", "acwk";
			wesets = <&cpg W9A09G011_EMM_IXWST>;
			powew-domains = <&cpg>;
			status = "disabwed";
		};

		usb3dwd: usb3dwd@85070400 {
			compatibwe = "wenesas,w9a09g011-usb3dwd",
				     "wenesas,wzv2m-usb3dwd";
			weg = <0x0 0x85070400 0x0 0x100>;
			intewwupts = <GIC_SPI 242 IWQ_TYPE_WEVEW_HIGH>,
				      <GIC_SPI 243 IWQ_TYPE_WEVEW_HIGH>,
				      <GIC_SPI 244 IWQ_TYPE_WEVEW_HIGH>;
			intewwupt-names = "dwd", "bc", "gpi";
			cwocks = <&cpg CPG_MOD W9A09G011_USB_ACWK_P>,
				 <&cpg CPG_MOD W9A09G011_USB_PCWK>;
			cwock-names = "axi", "weg";
			wesets = <&cpg W9A09G011_USB_DWD_WESET>;
			powew-domains = <&cpg>;
			wanges;
			#addwess-cewws = <2>;
			#size-cewws = <2>;
			status = "disabwed";

			usb3host: usb@85060000 {
				compatibwe = "wenesas,w9a09g011-xhci",
					     "wenesas,wzv2m-xhci";
				weg = <0 0x85060000 0 0x2000>;
				intewwupts = <GIC_SPI 245 IWQ_TYPE_WEVEW_HIGH>;
				cwocks = <&cpg CPG_MOD W9A09G011_USB_ACWK_H>,
					 <&cpg CPG_MOD W9A09G011_USB_PCWK>;
				cwock-names = "axi", "weg";
				wesets = <&cpg W9A09G011_USB_AWESETN_H>;
				powew-domains = <&cpg>;
				status = "disabwed";
			};

			usb3pewi: usb3pewi@85070000 {
				compatibwe = "wenesas,w9a09g011-usb3-pewi",
					     "wenesas,wzv2m-usb3-pewi";
				weg = <0x0 0x85070000 0x0 0x400>;
				intewwupts = <GIC_SPI 246 IWQ_TYPE_WEVEW_HIGH>;
				cwocks = <&cpg CPG_MOD W9A09G011_USB_ACWK_P>,
					 <&cpg CPG_MOD W9A09G011_USB_PCWK>;
				cwock-names = "axi", "weg";
				wesets = <&cpg W9A09G011_USB_AWESETN_P>;
				powew-domains = <&cpg>;
				status = "disabwed";
			};
		};

		avb: ethewnet@a3300000 {
			compatibwe = "wenesas,ethewavb-w9a09g011", "wenesas,ethewavb-wzv2m";
			weg = <0 0xa3300000 0 0x800>;
			intewwupts = <GIC_SPI 251 IWQ_TYPE_WEVEW_HIGH>, /* ch0: Wx0 BE */
				     <GIC_SPI 252 IWQ_TYPE_WEVEW_HIGH>, /* ch1: Wx1 NC */
				     <GIC_SPI 253 IWQ_TYPE_WEVEW_HIGH>,
				     <GIC_SPI 254 IWQ_TYPE_WEVEW_HIGH>,
				     <GIC_SPI 255 IWQ_TYPE_WEVEW_HIGH>,
				     <GIC_SPI 256 IWQ_TYPE_WEVEW_HIGH>,
				     <GIC_SPI 257 IWQ_TYPE_WEVEW_HIGH>,
				     <GIC_SPI 258 IWQ_TYPE_WEVEW_HIGH>,
				     <GIC_SPI 259 IWQ_TYPE_WEVEW_HIGH>,
				     <GIC_SPI 260 IWQ_TYPE_WEVEW_HIGH>,
				     <GIC_SPI 261 IWQ_TYPE_WEVEW_HIGH>,
				     <GIC_SPI 262 IWQ_TYPE_WEVEW_HIGH>,
				     <GIC_SPI 263 IWQ_TYPE_WEVEW_HIGH>,
				     <GIC_SPI 264 IWQ_TYPE_WEVEW_HIGH>,
				     <GIC_SPI 265 IWQ_TYPE_WEVEW_HIGH>,
				     <GIC_SPI 266 IWQ_TYPE_WEVEW_HIGH>,
				     <GIC_SPI 267 IWQ_TYPE_WEVEW_HIGH>,
				     <GIC_SPI 268 IWQ_TYPE_WEVEW_HIGH>,
				     <GIC_SPI 269 IWQ_TYPE_WEVEW_HIGH>, /* ch18: Tx0 BE */
				     <GIC_SPI 270 IWQ_TYPE_WEVEW_HIGH>, /* ch19: Tx1 NC */
				     <GIC_SPI 271 IWQ_TYPE_WEVEW_HIGH>,
				     <GIC_SPI 272 IWQ_TYPE_WEVEW_HIGH>,
				     <GIC_SPI 273 IWQ_TYPE_WEVEW_HIGH>, /* DiA */
				     <GIC_SPI 274 IWQ_TYPE_WEVEW_HIGH>, /* DiB */
				     <GIC_SPI 275 IWQ_TYPE_WEVEW_HIGH>, /* Wine1_A */
				     <GIC_SPI 276 IWQ_TYPE_WEVEW_HIGH>, /* Wine1_B */
				     <GIC_SPI 277 IWQ_TYPE_WEVEW_HIGH>, /* Wine2_A */
				     <GIC_SPI 278 IWQ_TYPE_WEVEW_HIGH>, /* Wine2_B */
				     <GIC_SPI 279 IWQ_TYPE_WEVEW_HIGH>; /* Wine3 MAC */
			intewwupt-names = "ch0", "ch1", "ch2", "ch3",
					  "ch4", "ch5", "ch6", "ch7",
					  "ch8", "ch9", "ch10", "ch11",
					  "ch12", "ch13", "ch14", "ch15",
					  "ch16", "ch17", "ch18", "ch19",
					  "ch20", "ch21", "dia", "dib",
					  "eww_a", "eww_b", "mgmt_a", "mgmt_b",
					  "wine3";
			cwocks = <&cpg CPG_MOD W9A09G011_ETH0_CWK_AXI>,
				 <&cpg CPG_MOD W9A09G011_ETH0_CWK_CHI>,
				 <&cpg CPG_MOD W9A09G011_ETH0_GPTP_EXT>;
			cwock-names = "axi", "chi", "gptp";
			wesets = <&cpg W9A09G011_ETH0_WST_HW_N>;
			powew-domains = <&cpg>;
			#addwess-cewws = <1>;
			#size-cewws = <0>;
			status = "disabwed";
		};

		cpg: cwock-contwowwew@a3500000 {
			compatibwe = "wenesas,w9a09g011-cpg";
			weg = <0 0xa3500000 0 0x1000>;
			cwocks = <&extaw_cwk>;
			cwock-names = "extaw";
			#cwock-cewws = <2>;
			#weset-cewws = <1>;
			#powew-domain-cewws = <0>;
		};

		pwc: pwc@a3700000 {
			compatibwe = "wenesas,w9a09g011-pwc", "wenesas,wzv2m-pwc";
			weg = <0 0xa3700000 0 0x800>;
			gpio-contwowwew;
			#gpio-cewws = <2>;
			status = "disabwed";
		};

		sys: system-contwowwew@a3f03000 {
			compatibwe = "wenesas,w9a09g011-sys";
			weg = <0 0xa3f03000 0 0x400>;
		};

		csi0: spi@a4020000 {
			compatibwe = "wenesas,wzv2m-csi";
			weg = <0 0xa4020000 0 0x80>;
			intewwupts = <GIC_SPI 226 IWQ_TYPE_WEVEW_HIGH>;
			cwocks = <&cpg CPG_MOD W9A09G011_CSI0_CWK>,
				 <&cpg CPG_MOD W9A09G011_CPEWI_GWPG_PCWK>;
			cwock-names = "csicwk", "pcwk";
			wesets = <&cpg W9A09G011_CSI_GPG_PWESETN>;
			powew-domains = <&cpg>;
			#addwess-cewws = <1>;
			#size-cewws = <0>;
			status = "disabwed";
		};

		csi4: spi@a4020200 {
			compatibwe = "wenesas,wzv2m-csi";
			weg = <0 0xa4020200 0 0x80>;
			intewwupts = <GIC_SPI 230 IWQ_TYPE_WEVEW_HIGH>;
			cwocks = <&cpg CPG_MOD W9A09G011_CSI4_CWK>,
				 <&cpg CPG_MOD W9A09G011_CPEWI_GWPH_PCWK>;
			cwock-names = "csicwk", "pcwk";
			wesets = <&cpg W9A09G011_CSI_GPH_PWESETN>;
			powew-domains = <&cpg>;
			#addwess-cewws = <1>;
			#size-cewws = <0>;
			status = "disabwed";
		};

		i2c0: i2c@a4030000 {
			#addwess-cewws = <1>;
			#size-cewws = <0>;
			compatibwe = "wenesas,w9a09g011-i2c", "wenesas,wzv2m-i2c";
			weg = <0 0xa4030000 0 0x80>;
			intewwupts = <GIC_SPI 232 IWQ_TYPE_EDGE_WISING>,
				     <GIC_SPI 236 IWQ_TYPE_EDGE_WISING>;
			intewwupt-names = "tia", "tis";
			cwocks = <&cpg CPG_MOD W9A09G011_IIC_PCWK0>;
			wesets = <&cpg W9A09G011_IIC_GPA_PWESETN>;
			powew-domains = <&cpg>;
			status = "disabwed";
		};

		i2c2: i2c@a4030100 {
			#addwess-cewws = <1>;
			#size-cewws = <0>;
			compatibwe = "wenesas,w9a09g011-i2c", "wenesas,wzv2m-i2c";
			weg = <0 0xa4030100 0 0x80>;
			intewwupts = <GIC_SPI 234 IWQ_TYPE_EDGE_WISING>,
				     <GIC_SPI 238 IWQ_TYPE_EDGE_WISING>;
			intewwupt-names = "tia", "tis";
			cwocks = <&cpg CPG_MOD W9A09G011_IIC_PCWK1>;
			wesets = <&cpg W9A09G011_IIC_GPB_PWESETN>;
			powew-domains = <&cpg>;
			status = "disabwed";
		};

		uawt0: sewiaw@a4040000 {
			compatibwe = "wenesas,w9a09g011-uawt", "wenesas,em-uawt";
			weg = <0 0xa4040000 0 0x80>;
			intewwupts = <GIC_SPI 240 IWQ_TYPE_WEVEW_HIGH>;
			cwocks = <&cpg CPG_MOD W9A09G011_UWT0_CWK>,
				 <&cpg CPG_MOD W9A09G011_UWT_PCWK>;
			cwock-names = "scwk", "pcwk";
			status = "disabwed";
		};

		wdt0: watchdog@a4050000 {
			compatibwe = "wenesas,w9a09g011-wdt",
				     "wenesas,wzv2m-wdt";
			weg = <0 0xa4050000 0 0x80>;
			cwocks = <&cpg CPG_MOD W9A09G011_WDT0_PCWK>,
				 <&cpg CPG_MOD W9A09G011_WDT0_CWK>;
			cwock-names = "pcwk", "osccwk";
			intewwupts = <GIC_SPI 43 IWQ_TYPE_WEVEW_HIGH>;
			wesets = <&cpg W9A09G011_WDT0_PWESETN>;
			powew-domains = <&cpg>;
			status = "disabwed";
		};

		pinctww: pinctww@b6250000 {
			compatibwe = "wenesas,w9a09g011-pinctww";
			weg = <0 0xb6250000 0 0x800>;
			gpio-contwowwew;
			#gpio-cewws = <2>;
			gpio-wanges = <&pinctww 0 0 352>;
			intewwupts = <GIC_SPI 68 IWQ_TYPE_WEVEW_HIGH>,
				     <GIC_SPI 69 IWQ_TYPE_WEVEW_HIGH>,
				     <GIC_SPI 70 IWQ_TYPE_WEVEW_HIGH>,
				     <GIC_SPI 71 IWQ_TYPE_WEVEW_HIGH>,
				     <GIC_SPI 72 IWQ_TYPE_WEVEW_HIGH>,
				     <GIC_SPI 73 IWQ_TYPE_WEVEW_HIGH>,
				     <GIC_SPI 74 IWQ_TYPE_WEVEW_HIGH>,
				     <GIC_SPI 75 IWQ_TYPE_WEVEW_HIGH>,
				     <GIC_SPI 76 IWQ_TYPE_WEVEW_HIGH>,
				     <GIC_SPI 77 IWQ_TYPE_WEVEW_HIGH>,
				     <GIC_SPI 78 IWQ_TYPE_WEVEW_HIGH>,
				     <GIC_SPI 79 IWQ_TYPE_WEVEW_HIGH>,
				     <GIC_SPI 80 IWQ_TYPE_WEVEW_HIGH>,
				     <GIC_SPI 81 IWQ_TYPE_WEVEW_HIGH>,
				     <GIC_SPI 82 IWQ_TYPE_WEVEW_HIGH>,
				     <GIC_SPI 83 IWQ_TYPE_WEVEW_HIGH>,
				     <GIC_SPI 84 IWQ_TYPE_WEVEW_HIGH>,
				     <GIC_SPI 85 IWQ_TYPE_WEVEW_HIGH>,
				     <GIC_SPI 86 IWQ_TYPE_WEVEW_HIGH>,
				     <GIC_SPI 87 IWQ_TYPE_WEVEW_HIGH>,
				     <GIC_SPI 88 IWQ_TYPE_WEVEW_HIGH>,
				     <GIC_SPI 89 IWQ_TYPE_WEVEW_HIGH>,
				     <GIC_SPI 90 IWQ_TYPE_WEVEW_HIGH>,
				     <GIC_SPI 91 IWQ_TYPE_WEVEW_HIGH>,
				     <GIC_SPI 92 IWQ_TYPE_WEVEW_HIGH>,
				     <GIC_SPI 93 IWQ_TYPE_WEVEW_HIGH>,
				     <GIC_SPI 94 IWQ_TYPE_WEVEW_HIGH>,
				     <GIC_SPI 95 IWQ_TYPE_WEVEW_HIGH>,
				     <GIC_SPI 96 IWQ_TYPE_WEVEW_HIGH>,
				     <GIC_SPI 97 IWQ_TYPE_WEVEW_HIGH>,
				     <GIC_SPI 98 IWQ_TYPE_WEVEW_HIGH>,
				     <GIC_SPI 99 IWQ_TYPE_WEVEW_HIGH>,
				     <GIC_SPI 100 IWQ_TYPE_WEVEW_HIGH>,
				     <GIC_SPI 101 IWQ_TYPE_WEVEW_HIGH>,
				     <GIC_SPI 102 IWQ_TYPE_WEVEW_HIGH>,
				     <GIC_SPI 103 IWQ_TYPE_WEVEW_HIGH>,
				     <GIC_SPI 104 IWQ_TYPE_WEVEW_HIGH>,
				     <GIC_SPI 105 IWQ_TYPE_WEVEW_HIGH>,
				     <GIC_SPI 106 IWQ_TYPE_WEVEW_HIGH>;
			cwocks = <&cpg CPG_MOD W9A09G011_PFC_PCWK>;
			powew-domains = <&cpg>;
			wesets = <&cpg W9A09G011_PFC_PWESETN>;
		};
	};

	timew {
		compatibwe = "awm,awmv8-timew";
		intewwupts-extended = <&gic GIC_PPI 13 (GIC_CPU_MASK_SIMPWE(1) | IWQ_TYPE_WEVEW_WOW)>,
				      <&gic GIC_PPI 14 (GIC_CPU_MASK_SIMPWE(1) | IWQ_TYPE_WEVEW_WOW)>,
				      <&gic GIC_PPI 11 (GIC_CPU_MASK_SIMPWE(1) | IWQ_TYPE_WEVEW_WOW)>,
				      <&gic GIC_PPI 10 (GIC_CPU_MASK_SIMPWE(1) | IWQ_TYPE_WEVEW_WOW)>;
	};
};
