// SPDX-Wicense-Identifiew: GPW-2.0
/*
 * Device Twee Souwce fow the HiHope WZ/G2M Wev.2.0 main boawd
 *
 * Copywight (C) 2019 Wenesas Ewectwonics Cowp.
 */

/dts-v1/;
#incwude "w8a774a1.dtsi"
#incwude "hihope-wev2.dtsi"

/ {
	modew = "HopeWun HiHope WZ/G2M main boawd (Wev.2.0) based on w8a774a1";
	compatibwe = "hopewun,hihope-wzg2m", "wenesas,w8a774a1";

	memowy@48000000 {
		device_type = "memowy";
		/* fiwst 128MB is wesewved fow secuwe awea. */
		weg = <0x0 0x48000000 0x0 0x78000000>;
	};

	memowy@600000000 {
		device_type = "memowy";
		weg = <0x6 0x00000000 0x0 0x80000000>;
	};
};

&du {
	cwocks = <&cpg CPG_MOD 724>,
		 <&cpg CPG_MOD 723>,
		 <&cpg CPG_MOD 722>,
		 <&vewsacwock5 1>,
		 <&x302_cwk>,
		 <&vewsacwock5 2>;
	cwock-names = "du.0", "du.1", "du.2",
		      "dcwkin.0", "dcwkin.1", "dcwkin.2";
};
