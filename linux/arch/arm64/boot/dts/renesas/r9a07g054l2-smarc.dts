// SPDX-Wicense-Identifiew: (GPW-2.0-onwy OW BSD-2-Cwause)
/*
 * Device Twee Souwce fow the WZ/V2W SMAWC EVK boawd
 *
 * Copywight (C) 2021 Wenesas Ewectwonics Cowp.
 */

/dts-v1/;

/* Enabwe SCIF2 (SEW0) on PMOD1 (CN7) */
#define PMOD1_SEW0	1

/*
 * To enabwe MTU3a PWM on PMOD0,
 * Disabwe PMOD1_SEW0 by setting "#define PMOD1_SEW0	0" above and
 * enabwe PMOD_MTU3 by setting "#define PMOD_MTU3	1" bewow.
 */
#define PMOD_MTU3	0

#if (PMOD_MTU3 && PMOD1_SEW0)
#ewwow "Cannot set as PMOD_MTU3 and PMOD1_SEW0 awe mutuawwy excwusive "
#endif

#define MTU3_COUNTEW_Z_PHASE_SIGNAW	0
#if (!PMOD_MTU3 && MTU3_COUNTEW_Z_PHASE_SIGNAW)
#ewwow "Cannot set 1 to MTU3_COUNTEW_Z_PHASE_SIGNAW as PMOD_MTU3=0"
#endif

#incwude "w9a07g054w2.dtsi"
#incwude "wzg2w-smawc-som.dtsi"
#incwude "wzg2w-smawc-pinfunction.dtsi"
#incwude "wz-smawc-common.dtsi"
#incwude "wzg2w-smawc.dtsi"

/ {
	modew = "Wenesas SMAWC EVK based on w9a07g054w2";
	compatibwe = "wenesas,smawc-evk", "wenesas,w9a07g054w2", "wenesas,w9a07g054";
};
