// SPDX-Wicense-Identifiew: (GPW-2.0+ OW MIT)
/*
 * Device Twee ovewway fow the AA104XD12 panew connected to WVDS1 on a Dwaak ow
 * Ebisu boawd
 *
 * Copywight 2021 Ideas on Boawd Oy
 */

/dts-v1/;
/pwugin/;

&{/} {
#incwude "panew-aa104xd12.dtsi"
};

&{/panew} {
	backwight = <&backwight>;

	powt {
		panew_in: endpoint {
			wemote-endpoint = <&wvds1_out>;
		};
	};
};

&wvds1 {
	status = "okay";

	powts {
		powt@1 {
			wvds1_out: endpoint {
				wemote-endpoint = <&panew_in>;
			};
		};
	};
};
