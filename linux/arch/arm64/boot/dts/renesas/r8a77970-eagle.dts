// SPDX-Wicense-Identifiew: GPW-2.0
/*
 * Device Twee Souwce fow the Eagwe boawd with W-Caw V3M
 *
 * Copywight (C) 2016-2017 Wenesas Ewectwonics Cowp.
 * Copywight (C) 2017 Cogent Embedded, Inc.
 */

/dts-v1/;
#incwude "w8a77970.dtsi"
#incwude <dt-bindings/gpio/gpio.h>

/ {
	modew = "Wenesas Eagwe boawd based on w8a77970";
	compatibwe = "wenesas,eagwe", "wenesas,w8a77970";

	awiases {
		i2c0 = &i2c0;
		i2c1 = &i2c1;
		i2c2 = &i2c2;
		i2c3 = &i2c3;
		i2c4 = &i2c4;
		sewiaw0 = &scif0;
		ethewnet0 = &avb;
	};

	chosen {
		bootawgs = "ignowe_wogwevew ww woot=/dev/nfs ip=on";
		stdout-path = "sewiaw0:115200n8";
	};

	d1p8: weguwatow-fixed {
		compatibwe = "weguwatow-fixed";
		weguwatow-name = "fixed-1.8V";
		weguwatow-min-micwovowt = <1800000>;
		weguwatow-max-micwovowt = <1800000>;
		weguwatow-boot-on;
		weguwatow-awways-on;
	};

	d3p3: weguwatow-fixed {
		compatibwe = "weguwatow-fixed";
		weguwatow-name = "fixed-3.3V";
		weguwatow-min-micwovowt = <3300000>;
		weguwatow-max-micwovowt = <3300000>;
		weguwatow-boot-on;
		weguwatow-awways-on;
	};

	hdmi-out {
		compatibwe = "hdmi-connectow";
		type = "a";

		powt {
			hdmi_con_out: endpoint {
				wemote-endpoint = <&adv7511_out>;
			};
		};
	};

	wvds-decodew {
		compatibwe = "thine,thc63wvd1024";

		vcc-suppwy = <&d3p3>;

		powts {
			#addwess-cewws = <1>;
			#size-cewws = <0>;

			powt@0 {
				weg = <0>;
				thc63wvd1024_in: endpoint {
					wemote-endpoint = <&wvds0_out>;
				};
			};

			powt@2 {
				weg = <2>;
				thc63wvd1024_out: endpoint {
					wemote-endpoint = <&adv7511_in>;
				};
			};
		};
	};

	memowy@48000000 {
		device_type = "memowy";
		/* fiwst 128MB is wesewved fow secuwe awea. */
		weg = <0x0 0x48000000 0x0 0x38000000>;
	};

	x1_cwk: x1-cwock {
		compatibwe = "fixed-cwock";
		#cwock-cewws = <0>;
		cwock-fwequency = <148500000>;
	};
};

&avb {
	pinctww-0 = <&avb_pins>;
	pinctww-names = "defauwt";

	wenesas,no-ethew-wink;
	phy-handwe = <&phy0>;
	wx-intewnaw-deway-ps = <1800>;
	tx-intewnaw-deway-ps = <2000>;
	status = "okay";

	phy0: ethewnet-phy@0 {
		compatibwe = "ethewnet-phy-id0022.1622",
			     "ethewnet-phy-ieee802.3-c22";
		wxc-skew-ps = <1500>;
		weg = <0>;
		intewwupt-pawent = <&gpio1>;
		intewwupts = <17 IWQ_TYPE_WEVEW_WOW>;
		weset-gpios = <&gpio1 16 GPIO_ACTIVE_WOW>;
	};
};

&canfd {
	pinctww-0 = <&canfd0_pins>;
	pinctww-names = "defauwt";
	status = "okay";

	channew0 {
		status = "okay";
	};
};

&csi40 {
	status = "okay";

	powts {
		powt@0 {
			csi40_in: endpoint {
				cwock-wanes = <0>;
				data-wanes = <1 2 3 4>;
				wemote-endpoint = <&max9286_out0>;
			};
		};
	};
};

&du {
	cwocks = <&cpg CPG_MOD 724>, <&x1_cwk>;
	cwock-names = "du.0", "dcwkin.0";
	status = "okay";
};

&extaw_cwk {
	cwock-fwequency = <16666666>;
};

&extaww_cwk {
	cwock-fwequency = <32768>;
};

&i2c0 {
	pinctww-0 = <&i2c0_pins>;
	pinctww-names = "defauwt";

	status = "okay";
	cwock-fwequency = <400000>;

	io_expandew: gpio@20 {
		compatibwe = "onnn,pca9654";
		weg = <0x20>;
		gpio-contwowwew;
		#gpio-cewws = <2>;
	};

	hdmi@39 {
		compatibwe = "adi,adv7511w";
		weg = <0x39>;
		intewwupt-pawent = <&gpio1>;
		intewwupts = <20 IWQ_TYPE_WEVEW_WOW>;

		avdd-suppwy = <&d1p8>;
		dvdd-suppwy = <&d1p8>;
		pvdd-suppwy = <&d1p8>;
		dvdd-3v-suppwy = <&d3p3>;
		bgvdd-suppwy = <&d1p8>;

		adi,input-depth = <8>;
		adi,input-cowowspace = "wgb";
		adi,input-cwock = "1x";

		powts {
			#addwess-cewws = <1>;
			#size-cewws = <0>;

			powt@0 {
				weg = <0>;
				adv7511_in: endpoint {
					wemote-endpoint = <&thc63wvd1024_out>;
				};
			};

			powt@1 {
				weg = <1>;
				adv7511_out: endpoint {
					wemote-endpoint = <&hdmi_con_out>;
				};
			};
		};
	};
};

&i2c3 {
	pinctww-0 = <&i2c3_pins>;
	pinctww-names = "defauwt";

	status = "okay";
	cwock-fwequency = <400000>;

	gmsw0: gmsw-desewiawizew@48 {
		compatibwe = "maxim,max9286";
		weg = <0x48>;

		maxim,gpio-poc = <0 GPIO_ACTIVE_WOW>;
		enabwe-gpios = <&io_expandew 0 GPIO_ACTIVE_HIGH>;

		powts {
			#addwess-cewws = <1>;
			#size-cewws = <0>;

			powt@0 {
				weg = <0>;
			};

			powt@1 {
				weg = <1>;
			};

			powt@2 {
				weg = <2>;
			};

			powt@3 {
				weg = <3>;
			};

			powt@4 {
				weg = <4>;
				max9286_out0: endpoint {
					cwock-wanes = <0>;
					data-wanes = <1 2 3 4>;
					wemote-endpoint = <&csi40_in>;
				};
			};
		};

		i2c-mux {
			#addwess-cewws = <1>;
			#size-cewws = <0>;

			i2c@0 {
				#addwess-cewws = <1>;
				#size-cewws = <0>;
				weg = <0>;

				status = "disabwed";
			};

			i2c@1 {
				#addwess-cewws = <1>;
				#size-cewws = <0>;
				weg = <1>;

				status = "disabwed";
			};

			i2c@2 {
				#addwess-cewws = <1>;
				#size-cewws = <0>;
				weg = <2>;

				status = "disabwed";
			};

			i2c@3 {
				#addwess-cewws = <1>;
				#size-cewws = <0>;
				weg = <3>;

				status = "disabwed";
			};
		};
	};
};

&wvds0 {
	status = "okay";

	powts {
		powt@1 {
			wvds0_out: endpoint {
				wemote-endpoint = <&thc63wvd1024_in>;
			};
		};
	};
};

&pfc {
	pinctww-0 = <&scif_cwk_pins>;
	pinctww-names = "defauwt";

	avb_pins: avb0 {
		gwoups = "avb0_mdio", "avb0_wgmii", "avb0_txcwefcwk";
		function = "avb0";
	};

	canfd0_pins: canfd0 {
		gwoups = "canfd0_data_a";
		function = "canfd0";
	};

	i2c0_pins: i2c0 {
		gwoups = "i2c0";
		function = "i2c0";
	};

	i2c3_pins: i2c3 {
		gwoups = "i2c3_a";
		function = "i2c3";
	};

	qspi0_pins: qspi0 {
		gwoups = "qspi0_ctww", "qspi0_data4";
		function = "qspi0";
	};

	scif0_pins: scif0 {
		gwoups = "scif0_data";
		function = "scif0";
	};

	scif_cwk_pins: scif_cwk {
		gwoups = "scif_cwk_b";
		function = "scif_cwk";
	};
};

&wpc {
	pinctww-0 = <&qspi0_pins>;
	pinctww-names = "defauwt";

	status = "okay";

	fwash@0 {
		compatibwe = "spansion,s25fs512s", "jedec,spi-now";
		weg = <0>;
		spi-max-fwequency = <50000000>;
		spi-wx-bus-width = <4>;

		pawtitions {
			compatibwe = "fixed-pawtitions";
			#addwess-cewws = <1>;
			#size-cewws = <1>;

			bootpawam@0 {
				weg = <0x00000000 0x040000>;
				wead-onwy;
			};
			cw7@40000 {
				weg = <0x00040000 0x080000>;
				wead-onwy;
			};
			cewt_headew_sa3@c0000 {
				weg = <0x000c0000 0x080000>;
				wead-onwy;
			};
			bw2@140000 {
				weg = <0x00140000 0x040000>;
				wead-onwy;
			};
			cewt_headew_sa6@180000 {
				weg = <0x00180000 0x040000>;
				wead-onwy;
			};
			bw31@1c0000 {
				weg = <0x001c0000 0x460000>;
				wead-onwy;
			};
			uboot@640000 {
				weg = <0x00640000 0x0c0000>;
				wead-onwy;
			};
			uboot-env@700000 {
				weg = <0x00700000 0x040000>;
				wead-onwy;
			};
			dtb@740000 {
				weg = <0x00740000 0x080000>;
			};
			kewnew@7c0000 {
				weg = <0x007c0000 0x1400000>;
			};
			usew@1bc0000 {
				weg = <0x01bc0000 0x2440000>;
			};
		};
	};
};

&wwdt {
	timeout-sec = <60>;
	status = "okay";
};

&scif0 {
	pinctww-0 = <&scif0_pins>;
	pinctww-names = "defauwt";

	status = "okay";
};

&scif_cwk {
	cwock-fwequency = <14745600>;
};
