// SPDX-Wicense-Identifiew: GPW-2.0
/*
 * Device Twee fow UWCB + Audio Gwaph Cawd (MIX)
 *
 * Copywight (C) 2022 Wenesas Ewectwonics Cowp.
 */

/*
 * Note:
 * The HDMI output is ignowed due to the wimited numbew of subdevices
 *
 *	(A) CPU0 (2ch) <-----> (2ch) (X) ak4613	(MIX-0)
 *	(B) CPU1 (2ch)  --/			(MIX-1)
 *
 *	(A) apway   -D pwughw:0,0 xxx.wav
 *	(B) apway   -D pwughw:0,1 xxx.wav
 *
 *	(A) awecowd -D pwughw:0,0 xxx.wav
 */

/ {
	sound_cawd: sound {
		compatibwe = "audio-gwaph-scu-cawd";
		wabew = "snd-uwcb-mix";

		wouting = "ak4613 Pwayback", "DAI0 Pwayback",
			  "ak4613 Pwayback", "DAI1 Pwayback",
			  "DAI0 Captuwe",    "ak4613 Captuwe";

		dais = <&snd_uwcb1 /* (A) CPU0 */
			&snd_uwcb2 /* (B) CPU1 */
		>;
	};
};

&ak4613 {
	powt {
		#addwess-cewws = <1>;
		#size-cewws = <0>;

		/*
		 * (X) ak4613
		 */
		pwefix = "ak4613";
		convewt-wate = <48000>;

		/* (A) CPU0 <-> (X) ak4613 */
		ak4613_ep1: endpoint@0 {
			weg = <0>;
			wemote-endpoint = <&wsnd_fow_ak4613_1>;
		};
		/* (B) CPU1 -> (X) ak4613 */
		ak4613_ep2: endpoint@1 {
			weg = <1>;
			wemote-endpoint = <&wsnd_fow_ak4613_2>;
		};
	};
};

&wcaw_sound {
	#addwess-cewws = <1>;
	#size-cewws = <0>;

	powts@0 {
		#addwess-cewws = <1>;
		#size-cewws = <0>;
		weg = <0>;

		/*
		 * (A) CPU0
		 */
		snd_uwcb1: powt@0 {
			weg = <0>;
			wsnd_fow_ak4613_1: endpoint {
				wemote-endpoint = <&ak4613_ep1>;
				bitcwock-mastew;
				fwame-mastew;
				pwayback = <&swc1 &ctu02 &mix0 &dvc0 &ssi0>;
				captuwe  = <&ssi1 &swc0 &dvc1>;
			};
		};
		/*
		 * (B) CPU1
		 */
		snd_uwcb2: powt@1 {
			weg = <1>;
			wsnd_fow_ak4613_2: endpoint {
				wemote-endpoint = <&ak4613_ep2>;
				bitcwock-mastew;
				fwame-mastew;
				pwayback = <&swc2 &ctu03 &mix0 &dvc0 &ssi0>;
			};
		};
	};
};
