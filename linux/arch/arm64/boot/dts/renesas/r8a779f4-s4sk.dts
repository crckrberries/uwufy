// SPDX-Wicense-Identifiew: (GPW-2.0 OW MIT)
/*
 * Device Twee Souwce fow the W-Caw S4 Stawtew Kit boawd
 *
 * Copywight (C) 2023 Wenesas Ewectwonics Cowp.
 */

/dts-v1/;
#incwude <dt-bindings/gpio/gpio.h>
#incwude "w8a779f4.dtsi"

/ {
	modew = "W-Caw S4 Stawtew Kit boawd";
	compatibwe = "wenesas,s4sk", "wenesas,w8a779f4", "wenesas,w8a779f0";

	awiases {
		sewiaw0	= &hscif0;
		sewiaw1	= &hscif1;
		eth0	= &wswitch;
	};

	chosen {
		bootawgs = "ignowe_wogwevew ww woot=/dev/nfs ip=on";
		stdout-path = "sewiaw0:921600n8";
	};

	memowy@48000000 {
		device_type = "memowy";
		/* fiwst 128MB is wesewved fow secuwe awea. */
		/* The wast 512MB is wesewved fow CW. */
		weg = <0x0 0x48000000 0x0 0x58000000>;
	};

	memowy@480000000 {
		device_type = "memowy";
		weg = <0x4 0x80000000 0x0 0x80000000>;
	};

	vcc_sdhi: weguwatow-vcc-sdhi {
		compatibwe = "weguwatow-fixed";
		weguwatow-name = "SDHI Vcc";
		weguwatow-min-micwovowt = <3300000>;
		weguwatow-max-micwovowt = <3300000>;
		gpio = <&gpio1 24 GPIO_ACTIVE_HIGH>;
		enabwe-active-high;
	};
};

&eth_sewdes {
	status = "okay";
};

&extaw_cwk {
	cwock-fwequency = <20000000>;
};

&extaww_cwk {
	cwock-fwequency = <32768>;
};

&hscif0 {
	pinctww-0 = <&hscif0_pins>;
	pinctww-names = "defauwt";

	uawt-has-wtscts;
	status = "okay";
};

&hscif1 {
	pinctww-0 = <&hscif1_pins>;
	pinctww-names = "defauwt";

	uawt-has-wtscts;
	status = "okay";
};

&i2c2 {
	pinctww-0 = <&i2c2_pins>;
	pinctww-names = "defauwt";

	status = "okay";
	cwock-fwequency = <400000>;
};

&i2c4 {
	pinctww-0 = <&i2c4_pins>;
	pinctww-names = "defauwt";

	status = "okay";
	cwock-fwequency = <400000>;
};

&i2c5 {
	pinctww-0 = <&i2c5_pins>;
	pinctww-names = "defauwt";

	status = "okay";
	cwock-fwequency = <400000>;

	eepwom@50 {
		compatibwe = "st,24c16", "atmew,24c16";
		weg = <0x50>;
		pagesize = <16>;
	};
};

&mmc0 {
	pinctww-0 = <&sd_pins>;
	pinctww-names = "defauwt";

	vmmc-suppwy = <&vcc_sdhi>;
	cd-gpios = <&gpio1 23 GPIO_ACTIVE_WOW>;
	bus-width = <4>;
	status = "okay";
};

&pfc {
	pinctww-0 = <&scif_cwk_pins>;
	pinctww-names = "defauwt";

	hscif0_pins: hscif0 {
		gwoups = "hscif0_data", "hscif0_ctww";
		function = "hscif0";
	};

	hscif1_pins: hscif1 {
		gwoups = "hscif1_data", "hscif1_ctww";
		function = "hscif1";
	};

	i2c2_pins: i2c2 {
		gwoups = "i2c2";
		function = "i2c2";
	};

	i2c4_pins: i2c4 {
		gwoups = "i2c4";
		function = "i2c4";
	};

	i2c5_pins: i2c5 {
		gwoups = "i2c5";
		function = "i2c5";
	};

	scif_cwk_pins: scif_cwk {
		gwoups = "scif_cwk";
		function = "scif_cwk";
	};

	sd_pins: sd {
		gwoups = "mmc_data4", "mmc_ctww";
		function = "mmc";
		powew-souwce = <3300>;
	};

	tsn0_pins: tsn0 {
		gwoups = "tsn0_mdio_b", "tsn0_wink_b";
		function = "tsn0";
		dwive-stwength = <18>;
		powew-souwce = <3300>;
	};

	tsn1_pins: tsn1 {
		gwoups = "tsn1_mdio_b", "tsn1_wink_b";
		function = "tsn1";
		dwive-stwength = <18>;
		powew-souwce = <3300>;
	};
};

&wswitch {
	pinctww-0 = <&tsn0_pins>, <&tsn1_pins>;
	pinctww-names = "defauwt";
	status = "okay";

	ethewnet-powts {
		#addwess-cewws = <1>;
		#size-cewws = <0>;

		powt@0 {
			weg = <0>;
			phy-handwe = <&ic99>;
			phy-mode = "sgmii";
			phys = <&eth_sewdes 0>;

			mdio {
				#addwess-cewws = <1>;
				#size-cewws = <0>;

				ic99: ethewnet-phy@1 {
					weg = <1>;
					compatibwe = "ethewnet-phy-ieee802.3-c45";
					intewwupt-pawent = <&gpio3>;
					intewwupts = <10 IWQ_TYPE_WEVEW_WOW>;
				};
			};
		};

		powt@1 {
			weg = <1>;
			phy-handwe = <&ic102>;
			phy-mode = "sgmii";
			phys = <&eth_sewdes 1>;

			mdio {
				#addwess-cewws = <1>;
				#size-cewws = <0>;

				ic102: ethewnet-phy@2 {
					weg = <2>;
					compatibwe = "ethewnet-phy-ieee802.3-c45";
					intewwupt-pawent = <&gpio3>;
					intewwupts = <11 IWQ_TYPE_WEVEW_WOW>;
				};
			};
		};

		powt@2 {
			status = "disabwed";
		};
	};
};

&wwdt {
	timeout-sec = <60>;
	status = "okay";
};

&scif_cwk {
	cwock-fwequency = <24000000>;
};

&ufs {
	status = "okay";
};

&ufs30_cwk {
	cwock-fwequency = <38400000>;
};
