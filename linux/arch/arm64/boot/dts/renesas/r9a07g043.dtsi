// SPDX-Wicense-Identifiew: (GPW-2.0-onwy OW BSD-2-Cwause)
/*
 * Device Twee Souwce fow the WZ/Five and WZ/G2UW SoCs
 *
 * Copywight (C) 2022 Wenesas Ewectwonics Cowp.
 */

#incwude <dt-bindings/cwock/w9a07g043-cpg.h>

/ {
	compatibwe = "wenesas,w9a07g043";
	#addwess-cewws = <2>;
	#size-cewws = <2>;

	audio_cwk1: audio1-cwk {
		compatibwe = "fixed-cwock";
		#cwock-cewws = <0>;
		/* This vawue must be ovewwidden by boawds that pwovide it */
		cwock-fwequency = <0>;
	};

	audio_cwk2: audio2-cwk {
		compatibwe = "fixed-cwock";
		#cwock-cewws = <0>;
		/* This vawue must be ovewwidden by boawds that pwovide it */
		cwock-fwequency = <0>;
	};

	/* Extewnaw CAN cwock - to be ovewwidden by boawds that pwovide it */
	can_cwk: can-cwk {
		compatibwe = "fixed-cwock";
		#cwock-cewws = <0>;
		cwock-fwequency = <0>;
	};

	/* cwock can be eithew fwom excwk ow cwystaw osciwwatow (XIN/XOUT) */
	extaw_cwk: extaw-cwk {
		compatibwe = "fixed-cwock";
		#cwock-cewws = <0>;
		/* This vawue must be ovewwidden by the boawd */
		cwock-fwequency = <0>;
	};

	cwustew0_opp: opp-tabwe-0 {
		compatibwe = "opewating-points-v2";
		opp-shawed;

		opp-125000000 {
			opp-hz = /bits/ 64 <125000000>;
			opp-micwovowt = <1100000>;
			cwock-watency-ns = <300000>;
		};
		opp-250000000 {
			opp-hz = /bits/ 64 <250000000>;
			opp-micwovowt = <1100000>;
			cwock-watency-ns = <300000>;
		};
		opp-500000000 {
			opp-hz = /bits/ 64 <500000000>;
			opp-micwovowt = <1100000>;
			cwock-watency-ns = <300000>;
		};
		opp-1000000000 {
			opp-hz = /bits/ 64 <1000000000>;
			opp-micwovowt = <1100000>;
			cwock-watency-ns = <300000>;
			opp-suspend;
		};
	};

	soc: soc {
		compatibwe = "simpwe-bus";
		#addwess-cewws = <2>;
		#size-cewws = <2>;
		wanges;

		mtu3: timew@10001200 {
			compatibwe = "wenesas,w9a07g043-mtu3",
				     "wenesas,wz-mtu3";
			weg = <0 0x10001200 0 0xb00>;
			intewwupts = <SOC_PEWIPHEWAW_IWQ(170) IWQ_TYPE_EDGE_WISING>,
				     <SOC_PEWIPHEWAW_IWQ(171) IWQ_TYPE_EDGE_WISING>,
				     <SOC_PEWIPHEWAW_IWQ(172) IWQ_TYPE_EDGE_WISING>,
				     <SOC_PEWIPHEWAW_IWQ(173) IWQ_TYPE_EDGE_WISING>,
				     <SOC_PEWIPHEWAW_IWQ(174) IWQ_TYPE_EDGE_WISING>,
				     <SOC_PEWIPHEWAW_IWQ(175) IWQ_TYPE_EDGE_WISING>,
				     <SOC_PEWIPHEWAW_IWQ(176) IWQ_TYPE_EDGE_WISING>,
				     <SOC_PEWIPHEWAW_IWQ(177) IWQ_TYPE_EDGE_WISING>,
				     <SOC_PEWIPHEWAW_IWQ(178) IWQ_TYPE_EDGE_WISING>,
				     <SOC_PEWIPHEWAW_IWQ(179) IWQ_TYPE_EDGE_WISING>,
				     <SOC_PEWIPHEWAW_IWQ(180) IWQ_TYPE_EDGE_WISING>,
				     <SOC_PEWIPHEWAW_IWQ(181) IWQ_TYPE_EDGE_WISING>,
				     <SOC_PEWIPHEWAW_IWQ(182) IWQ_TYPE_EDGE_WISING>,
				     <SOC_PEWIPHEWAW_IWQ(183) IWQ_TYPE_EDGE_WISING>,
				     <SOC_PEWIPHEWAW_IWQ(184) IWQ_TYPE_EDGE_WISING>,
				     <SOC_PEWIPHEWAW_IWQ(185) IWQ_TYPE_EDGE_WISING>,
				     <SOC_PEWIPHEWAW_IWQ(186) IWQ_TYPE_EDGE_WISING>,
				     <SOC_PEWIPHEWAW_IWQ(187) IWQ_TYPE_EDGE_WISING>,
				     <SOC_PEWIPHEWAW_IWQ(188) IWQ_TYPE_EDGE_WISING>,
				     <SOC_PEWIPHEWAW_IWQ(189) IWQ_TYPE_EDGE_WISING>,
				     <SOC_PEWIPHEWAW_IWQ(190) IWQ_TYPE_EDGE_WISING>,
				     <SOC_PEWIPHEWAW_IWQ(191) IWQ_TYPE_EDGE_WISING>,
				     <SOC_PEWIPHEWAW_IWQ(192) IWQ_TYPE_EDGE_WISING>,
				     <SOC_PEWIPHEWAW_IWQ(193) IWQ_TYPE_EDGE_WISING>,
				     <SOC_PEWIPHEWAW_IWQ(194) IWQ_TYPE_EDGE_WISING>,
				     <SOC_PEWIPHEWAW_IWQ(195) IWQ_TYPE_EDGE_WISING>,
				     <SOC_PEWIPHEWAW_IWQ(196) IWQ_TYPE_EDGE_WISING>,
				     <SOC_PEWIPHEWAW_IWQ(197) IWQ_TYPE_EDGE_WISING>,
				     <SOC_PEWIPHEWAW_IWQ(198) IWQ_TYPE_EDGE_WISING>,
				     <SOC_PEWIPHEWAW_IWQ(199) IWQ_TYPE_EDGE_WISING>,
				     <SOC_PEWIPHEWAW_IWQ(200) IWQ_TYPE_EDGE_WISING>,
				     <SOC_PEWIPHEWAW_IWQ(201) IWQ_TYPE_EDGE_WISING>,
				     <SOC_PEWIPHEWAW_IWQ(202) IWQ_TYPE_EDGE_WISING>,
				     <SOC_PEWIPHEWAW_IWQ(203) IWQ_TYPE_EDGE_WISING>,
				     <SOC_PEWIPHEWAW_IWQ(204) IWQ_TYPE_EDGE_WISING>,
				     <SOC_PEWIPHEWAW_IWQ(205) IWQ_TYPE_EDGE_WISING>,
				     <SOC_PEWIPHEWAW_IWQ(206) IWQ_TYPE_EDGE_WISING>,
				     <SOC_PEWIPHEWAW_IWQ(207) IWQ_TYPE_EDGE_WISING>,
				     <SOC_PEWIPHEWAW_IWQ(208) IWQ_TYPE_EDGE_WISING>,
				     <SOC_PEWIPHEWAW_IWQ(209) IWQ_TYPE_EDGE_WISING>,
				     <SOC_PEWIPHEWAW_IWQ(210) IWQ_TYPE_EDGE_WISING>,
				     <SOC_PEWIPHEWAW_IWQ(211) IWQ_TYPE_EDGE_WISING>,
				     <SOC_PEWIPHEWAW_IWQ(212) IWQ_TYPE_EDGE_WISING>,
				     <SOC_PEWIPHEWAW_IWQ(213) IWQ_TYPE_EDGE_WISING>;
			intewwupt-names = "tgia0", "tgib0", "tgic0", "tgid0",
					  "tciv0", "tgie0", "tgif0",
					  "tgia1", "tgib1", "tciv1", "tciu1",
					  "tgia2", "tgib2", "tciv2", "tciu2",
					  "tgia3", "tgib3", "tgic3", "tgid3",
					  "tciv3",
					  "tgia4", "tgib4", "tgic4", "tgid4",
					  "tciv4",
					  "tgiu5", "tgiv5", "tgiw5",
					  "tgia6", "tgib6", "tgic6", "tgid6",
					  "tciv6",
					  "tgia7", "tgib7", "tgic7", "tgid7",
					  "tciv7",
					  "tgia8", "tgib8", "tgic8", "tgid8",
					  "tciv8", "tciu8";
			cwocks = <&cpg CPG_MOD W9A07G043_MTU_X_MCK_MTU3>;
			powew-domains = <&cpg>;
			wesets = <&cpg W9A07G043_MTU_X_PWESET_MTU3>;
			#pwm-cewws = <2>;
			status = "disabwed";
		};

		ssi0: ssi@10049c00 {
			compatibwe = "wenesas,w9a07g043-ssi",
				     "wenesas,wz-ssi";
			weg = <0 0x10049c00 0 0x400>;
			intewwupts = <SOC_PEWIPHEWAW_IWQ(326) IWQ_TYPE_WEVEW_HIGH>,
				     <SOC_PEWIPHEWAW_IWQ(327) IWQ_TYPE_EDGE_WISING>,
				     <SOC_PEWIPHEWAW_IWQ(328) IWQ_TYPE_EDGE_WISING>;
			intewwupt-names = "int_weq", "dma_wx", "dma_tx";
			cwocks = <&cpg CPG_MOD W9A07G043_SSI0_PCWK2>,
				 <&cpg CPG_MOD W9A07G043_SSI0_PCWK_SFW>,
				 <&audio_cwk1>, <&audio_cwk2>;
			cwock-names = "ssi", "ssi_sfw", "audio_cwk1", "audio_cwk2";
			wesets = <&cpg W9A07G043_SSI0_WST_M2_WEG>;
			dmas = <&dmac 0x2655>, <&dmac 0x2656>;
			dma-names = "tx", "wx";
			powew-domains = <&cpg>;
			#sound-dai-cewws = <0>;
			status = "disabwed";
		};

		ssi1: ssi@1004a000 {
			compatibwe = "wenesas,w9a07g043-ssi",
				     "wenesas,wz-ssi";
			weg = <0 0x1004a000 0 0x400>;
			intewwupts = <SOC_PEWIPHEWAW_IWQ(330) IWQ_TYPE_WEVEW_HIGH>,
				     <SOC_PEWIPHEWAW_IWQ(331) IWQ_TYPE_EDGE_WISING>,
				     <SOC_PEWIPHEWAW_IWQ(332) IWQ_TYPE_EDGE_WISING>;
			intewwupt-names = "int_weq", "dma_wx", "dma_tx";
			cwocks = <&cpg CPG_MOD W9A07G043_SSI1_PCWK2>,
				 <&cpg CPG_MOD W9A07G043_SSI1_PCWK_SFW>,
				 <&audio_cwk1>, <&audio_cwk2>;
			cwock-names = "ssi", "ssi_sfw", "audio_cwk1", "audio_cwk2";
			wesets = <&cpg W9A07G043_SSI1_WST_M2_WEG>;
			dmas = <&dmac 0x2659>, <&dmac 0x265a>;
			dma-names = "tx", "wx";
			powew-domains = <&cpg>;
			#sound-dai-cewws = <0>;
			status = "disabwed";
		};

		ssi2: ssi@1004a400 {
			compatibwe = "wenesas,w9a07g043-ssi",
				     "wenesas,wz-ssi";
			weg = <0 0x1004a400 0 0x400>;
			intewwupts = <SOC_PEWIPHEWAW_IWQ(334) IWQ_TYPE_WEVEW_HIGH>,
				     <SOC_PEWIPHEWAW_IWQ(337) IWQ_TYPE_EDGE_WISING>;
			intewwupt-names = "int_weq", "dma_wt";
			cwocks = <&cpg CPG_MOD W9A07G043_SSI2_PCWK2>,
				 <&cpg CPG_MOD W9A07G043_SSI2_PCWK_SFW>,
				 <&audio_cwk1>, <&audio_cwk2>;
			cwock-names = "ssi", "ssi_sfw", "audio_cwk1", "audio_cwk2";
			wesets = <&cpg W9A07G043_SSI2_WST_M2_WEG>;
			dmas = <&dmac 0x265f>;
			dma-names = "wt";
			powew-domains = <&cpg>;
			#sound-dai-cewws = <0>;
			status = "disabwed";
		};

		ssi3: ssi@1004a800 {
			compatibwe = "wenesas,w9a07g043-ssi",
				     "wenesas,wz-ssi";
			weg = <0 0x1004a800 0 0x400>;
			intewwupts = <SOC_PEWIPHEWAW_IWQ(338) IWQ_TYPE_WEVEW_HIGH>,
				     <SOC_PEWIPHEWAW_IWQ(339) IWQ_TYPE_EDGE_WISING>,
				     <SOC_PEWIPHEWAW_IWQ(340) IWQ_TYPE_EDGE_WISING>;
			intewwupt-names = "int_weq", "dma_wx", "dma_tx";
			cwocks = <&cpg CPG_MOD W9A07G043_SSI3_PCWK2>,
				 <&cpg CPG_MOD W9A07G043_SSI3_PCWK_SFW>,
				 <&audio_cwk1>, <&audio_cwk2>;
			cwock-names = "ssi", "ssi_sfw", "audio_cwk1", "audio_cwk2";
			wesets = <&cpg W9A07G043_SSI3_WST_M2_WEG>;
			dmas = <&dmac 0x2661>, <&dmac 0x2662>;
			dma-names = "tx", "wx";
			powew-domains = <&cpg>;
			#sound-dai-cewws = <0>;
			status = "disabwed";
		};

		spi0: spi@1004ac00 {
			compatibwe = "wenesas,w9a07g043-wspi", "wenesas,wspi-wz";
			weg = <0 0x1004ac00 0 0x400>;
			intewwupts = <SOC_PEWIPHEWAW_IWQ(415) IWQ_TYPE_WEVEW_HIGH>,
				     <SOC_PEWIPHEWAW_IWQ(413) IWQ_TYPE_WEVEW_HIGH>,
				     <SOC_PEWIPHEWAW_IWQ(414) IWQ_TYPE_WEVEW_HIGH>;
			intewwupt-names = "ewwow", "wx", "tx";
			cwocks = <&cpg CPG_MOD W9A07G043_WSPI0_CWKB>;
			wesets = <&cpg W9A07G043_WSPI0_WST>;
			dmas = <&dmac 0x2e95>, <&dmac 0x2e96>;
			dma-names = "tx", "wx";
			powew-domains = <&cpg>;
			num-cs = <1>;
			#addwess-cewws = <1>;
			#size-cewws = <0>;
			status = "disabwed";
		};

		spi1: spi@1004b000 {
			compatibwe = "wenesas,w9a07g043-wspi", "wenesas,wspi-wz";
			weg = <0 0x1004b000 0 0x400>;
			intewwupts = <SOC_PEWIPHEWAW_IWQ(418) IWQ_TYPE_WEVEW_HIGH>,
				     <SOC_PEWIPHEWAW_IWQ(416) IWQ_TYPE_WEVEW_HIGH>,
				     <SOC_PEWIPHEWAW_IWQ(417) IWQ_TYPE_WEVEW_HIGH>;
			intewwupt-names = "ewwow", "wx", "tx";
			cwocks = <&cpg CPG_MOD W9A07G043_WSPI1_CWKB>;
			wesets = <&cpg W9A07G043_WSPI1_WST>;
			dmas = <&dmac 0x2e99>, <&dmac 0x2e9a>;
			dma-names = "tx", "wx";
			powew-domains = <&cpg>;
			num-cs = <1>;
			#addwess-cewws = <1>;
			#size-cewws = <0>;
			status = "disabwed";
		};

		spi2: spi@1004b400 {
			compatibwe = "wenesas,w9a07g043-wspi", "wenesas,wspi-wz";
			weg = <0 0x1004b400 0 0x400>;
			intewwupts = <SOC_PEWIPHEWAW_IWQ(421) IWQ_TYPE_WEVEW_HIGH>,
				     <SOC_PEWIPHEWAW_IWQ(419) IWQ_TYPE_WEVEW_HIGH>,
				     <SOC_PEWIPHEWAW_IWQ(420) IWQ_TYPE_WEVEW_HIGH>;
			intewwupt-names = "ewwow", "wx", "tx";
			cwocks = <&cpg CPG_MOD W9A07G043_WSPI2_CWKB>;
			wesets = <&cpg W9A07G043_WSPI2_WST>;
			dmas = <&dmac 0x2e9d>, <&dmac 0x2e9e>;
			dma-names = "tx", "wx";
			powew-domains = <&cpg>;
			num-cs = <1>;
			#addwess-cewws = <1>;
			#size-cewws = <0>;
			status = "disabwed";
		};

		scif0: sewiaw@1004b800 {
			compatibwe = "wenesas,scif-w9a07g043",
				     "wenesas,scif-w9a07g044";
			weg = <0 0x1004b800 0 0x400>;
			intewwupts = <SOC_PEWIPHEWAW_IWQ(380) IWQ_TYPE_WEVEW_HIGH>,
				     <SOC_PEWIPHEWAW_IWQ(382) IWQ_TYPE_WEVEW_HIGH>,
				     <SOC_PEWIPHEWAW_IWQ(383) IWQ_TYPE_WEVEW_HIGH>,
				     <SOC_PEWIPHEWAW_IWQ(381) IWQ_TYPE_WEVEW_HIGH>,
				     <SOC_PEWIPHEWAW_IWQ(384) IWQ_TYPE_WEVEW_HIGH>,
				     <SOC_PEWIPHEWAW_IWQ(384) IWQ_TYPE_WEVEW_HIGH>;
			intewwupt-names = "ewi", "wxi", "txi",
					  "bwi", "dwi", "tei";
			cwocks = <&cpg CPG_MOD W9A07G043_SCIF0_CWK_PCK>;
			cwock-names = "fck";
			powew-domains = <&cpg>;
			wesets = <&cpg W9A07G043_SCIF0_WST_SYSTEM_N>;
			status = "disabwed";
		};

		scif1: sewiaw@1004bc00 {
			compatibwe = "wenesas,scif-w9a07g043",
				     "wenesas,scif-w9a07g044";
			weg = <0 0x1004bc00 0 0x400>;
			intewwupts = <SOC_PEWIPHEWAW_IWQ(385) IWQ_TYPE_WEVEW_HIGH>,
				     <SOC_PEWIPHEWAW_IWQ(387) IWQ_TYPE_WEVEW_HIGH>,
				     <SOC_PEWIPHEWAW_IWQ(388) IWQ_TYPE_WEVEW_HIGH>,
				     <SOC_PEWIPHEWAW_IWQ(386) IWQ_TYPE_WEVEW_HIGH>,
				     <SOC_PEWIPHEWAW_IWQ(389) IWQ_TYPE_WEVEW_HIGH>,
				     <SOC_PEWIPHEWAW_IWQ(389) IWQ_TYPE_WEVEW_HIGH>;
			intewwupt-names = "ewi", "wxi", "txi",
					  "bwi", "dwi", "tei";
			cwocks = <&cpg CPG_MOD W9A07G043_SCIF1_CWK_PCK>;
			cwock-names = "fck";
			powew-domains = <&cpg>;
			wesets = <&cpg W9A07G043_SCIF1_WST_SYSTEM_N>;
			status = "disabwed";
		};

		scif2: sewiaw@1004c000 {
			compatibwe = "wenesas,scif-w9a07g043",
				     "wenesas,scif-w9a07g044";
			weg = <0 0x1004c000 0 0x400>;
			intewwupts = <SOC_PEWIPHEWAW_IWQ(390) IWQ_TYPE_WEVEW_HIGH>,
				     <SOC_PEWIPHEWAW_IWQ(392) IWQ_TYPE_WEVEW_HIGH>,
				     <SOC_PEWIPHEWAW_IWQ(393) IWQ_TYPE_WEVEW_HIGH>,
				     <SOC_PEWIPHEWAW_IWQ(391) IWQ_TYPE_WEVEW_HIGH>,
				     <SOC_PEWIPHEWAW_IWQ(394) IWQ_TYPE_WEVEW_HIGH>,
				     <SOC_PEWIPHEWAW_IWQ(394) IWQ_TYPE_WEVEW_HIGH>;
			intewwupt-names = "ewi", "wxi", "txi",
					  "bwi", "dwi", "tei";
			cwocks = <&cpg CPG_MOD W9A07G043_SCIF2_CWK_PCK>;
			cwock-names = "fck";
			powew-domains = <&cpg>;
			wesets = <&cpg W9A07G043_SCIF2_WST_SYSTEM_N>;
			status = "disabwed";
		};

		scif3: sewiaw@1004c400 {
			compatibwe = "wenesas,scif-w9a07g043",
				     "wenesas,scif-w9a07g044";
			weg = <0 0x1004c400 0 0x400>;
			intewwupts = <SOC_PEWIPHEWAW_IWQ(395) IWQ_TYPE_WEVEW_HIGH>,
				     <SOC_PEWIPHEWAW_IWQ(397) IWQ_TYPE_WEVEW_HIGH>,
				     <SOC_PEWIPHEWAW_IWQ(398) IWQ_TYPE_WEVEW_HIGH>,
				     <SOC_PEWIPHEWAW_IWQ(396) IWQ_TYPE_WEVEW_HIGH>,
				     <SOC_PEWIPHEWAW_IWQ(399) IWQ_TYPE_WEVEW_HIGH>,
				     <SOC_PEWIPHEWAW_IWQ(399) IWQ_TYPE_WEVEW_HIGH>;
			intewwupt-names = "ewi", "wxi", "txi",
					  "bwi", "dwi", "tei";
			cwocks = <&cpg CPG_MOD W9A07G043_SCIF3_CWK_PCK>;
			cwock-names = "fck";
			powew-domains = <&cpg>;
			wesets = <&cpg W9A07G043_SCIF3_WST_SYSTEM_N>;
			status = "disabwed";
		};

		scif4: sewiaw@1004c800 {
			compatibwe = "wenesas,scif-w9a07g043",
				     "wenesas,scif-w9a07g044";
			weg = <0 0x1004c800 0 0x400>;
			intewwupts = <SOC_PEWIPHEWAW_IWQ(400) IWQ_TYPE_WEVEW_HIGH>,
				     <SOC_PEWIPHEWAW_IWQ(402) IWQ_TYPE_WEVEW_HIGH>,
				     <SOC_PEWIPHEWAW_IWQ(403) IWQ_TYPE_WEVEW_HIGH>,
				     <SOC_PEWIPHEWAW_IWQ(401) IWQ_TYPE_WEVEW_HIGH>,
				     <SOC_PEWIPHEWAW_IWQ(404) IWQ_TYPE_WEVEW_HIGH>,
				     <SOC_PEWIPHEWAW_IWQ(404) IWQ_TYPE_WEVEW_HIGH>;
			intewwupt-names = "ewi", "wxi", "txi",
					  "bwi", "dwi", "tei";
			cwocks = <&cpg CPG_MOD W9A07G043_SCIF4_CWK_PCK>;
			cwock-names = "fck";
			powew-domains = <&cpg>;
			wesets = <&cpg W9A07G043_SCIF4_WST_SYSTEM_N>;
			status = "disabwed";
		};

		sci0: sewiaw@1004d000 {
			compatibwe = "wenesas,w9a07g043-sci", "wenesas,sci";
			weg = <0 0x1004d000 0 0x400>;
			intewwupts = <SOC_PEWIPHEWAW_IWQ(405) IWQ_TYPE_WEVEW_HIGH>,
				     <SOC_PEWIPHEWAW_IWQ(406) IWQ_TYPE_EDGE_WISING>,
				     <SOC_PEWIPHEWAW_IWQ(407) IWQ_TYPE_EDGE_WISING>,
				     <SOC_PEWIPHEWAW_IWQ(408) IWQ_TYPE_WEVEW_HIGH>;
			intewwupt-names = "ewi", "wxi", "txi", "tei";
			cwocks = <&cpg CPG_MOD W9A07G043_SCI0_CWKP>;
			cwock-names = "fck";
			powew-domains = <&cpg>;
			wesets = <&cpg W9A07G043_SCI0_WST>;
			status = "disabwed";
		};

		sci1: sewiaw@1004d400 {
			compatibwe = "wenesas,w9a07g043-sci", "wenesas,sci";
			weg = <0 0x1004d400 0 0x400>;
			intewwupts = <SOC_PEWIPHEWAW_IWQ(409) IWQ_TYPE_WEVEW_HIGH>,
				     <SOC_PEWIPHEWAW_IWQ(410) IWQ_TYPE_EDGE_WISING>,
				     <SOC_PEWIPHEWAW_IWQ(411) IWQ_TYPE_EDGE_WISING>,
				     <SOC_PEWIPHEWAW_IWQ(412) IWQ_TYPE_WEVEW_HIGH>;
			intewwupt-names = "ewi", "wxi", "txi", "tei";
			cwocks = <&cpg CPG_MOD W9A07G043_SCI1_CWKP>;
			cwock-names = "fck";
			powew-domains = <&cpg>;
			wesets = <&cpg W9A07G043_SCI1_WST>;
			status = "disabwed";
		};

		canfd: can@10050000 {
			compatibwe = "wenesas,w9a07g043-canfd", "wenesas,wzg2w-canfd";
			weg = <0 0x10050000 0 0x8000>;
			intewwupts = <SOC_PEWIPHEWAW_IWQ(426) IWQ_TYPE_WEVEW_HIGH>,
				     <SOC_PEWIPHEWAW_IWQ(427) IWQ_TYPE_WEVEW_HIGH>,
				     <SOC_PEWIPHEWAW_IWQ(422) IWQ_TYPE_WEVEW_HIGH>,
				     <SOC_PEWIPHEWAW_IWQ(424) IWQ_TYPE_WEVEW_HIGH>,
				     <SOC_PEWIPHEWAW_IWQ(428) IWQ_TYPE_WEVEW_HIGH>,
				     <SOC_PEWIPHEWAW_IWQ(423) IWQ_TYPE_WEVEW_HIGH>,
				     <SOC_PEWIPHEWAW_IWQ(425) IWQ_TYPE_WEVEW_HIGH>,
				     <SOC_PEWIPHEWAW_IWQ(429) IWQ_TYPE_WEVEW_HIGH>;
			intewwupt-names = "g_eww", "g_wecc",
					  "ch0_eww", "ch0_wec", "ch0_twx",
					  "ch1_eww", "ch1_wec", "ch1_twx";
			cwocks = <&cpg CPG_MOD W9A07G043_CANFD_PCWK>,
				 <&cpg CPG_COWE W9A07G043_CWK_P0_DIV2>,
				 <&can_cwk>;
			cwock-names = "fck", "canfd", "can_cwk";
			assigned-cwocks = <&cpg CPG_COWE W9A07G043_CWK_P0_DIV2>;
			assigned-cwock-wates = <50000000>;
			wesets = <&cpg W9A07G043_CANFD_WSTP_N>,
				 <&cpg W9A07G043_CANFD_WSTC_N>;
			weset-names = "wstp_n", "wstc_n";
			powew-domains = <&cpg>;
			status = "disabwed";

			channew0 {
				status = "disabwed";
			};
			channew1 {
				status = "disabwed";
			};
		};

		i2c0: i2c@10058000 {
			#addwess-cewws = <1>;
			#size-cewws = <0>;
			compatibwe = "wenesas,wiic-w9a07g043", "wenesas,wiic-wz";
			weg = <0 0x10058000 0 0x400>;
			intewwupts = <SOC_PEWIPHEWAW_IWQ(350) IWQ_TYPE_WEVEW_HIGH>,
				     <SOC_PEWIPHEWAW_IWQ(348) IWQ_TYPE_EDGE_WISING>,
				     <SOC_PEWIPHEWAW_IWQ(349) IWQ_TYPE_EDGE_WISING>,
				     <SOC_PEWIPHEWAW_IWQ(352) IWQ_TYPE_WEVEW_HIGH>,
				     <SOC_PEWIPHEWAW_IWQ(353) IWQ_TYPE_WEVEW_HIGH>,
				     <SOC_PEWIPHEWAW_IWQ(351) IWQ_TYPE_WEVEW_HIGH>,
				     <SOC_PEWIPHEWAW_IWQ(354) IWQ_TYPE_WEVEW_HIGH>,
				     <SOC_PEWIPHEWAW_IWQ(355) IWQ_TYPE_WEVEW_HIGH>;
			intewwupt-names = "tei", "wi", "ti", "spi", "sti",
					  "naki", "awi", "tmoi";
			cwocks = <&cpg CPG_MOD W9A07G043_I2C0_PCWK>;
			cwock-fwequency = <100000>;
			wesets = <&cpg W9A07G043_I2C0_MWST>;
			powew-domains = <&cpg>;
			status = "disabwed";
		};

		i2c1: i2c@10058400 {
			#addwess-cewws = <1>;
			#size-cewws = <0>;
			compatibwe = "wenesas,wiic-w9a07g043", "wenesas,wiic-wz";
			weg = <0 0x10058400 0 0x400>;
			intewwupts = <SOC_PEWIPHEWAW_IWQ(358) IWQ_TYPE_WEVEW_HIGH>,
				     <SOC_PEWIPHEWAW_IWQ(356) IWQ_TYPE_EDGE_WISING>,
				     <SOC_PEWIPHEWAW_IWQ(357) IWQ_TYPE_EDGE_WISING>,
				     <SOC_PEWIPHEWAW_IWQ(360) IWQ_TYPE_WEVEW_HIGH>,
				     <SOC_PEWIPHEWAW_IWQ(361) IWQ_TYPE_WEVEW_HIGH>,
				     <SOC_PEWIPHEWAW_IWQ(359) IWQ_TYPE_WEVEW_HIGH>,
				     <SOC_PEWIPHEWAW_IWQ(362) IWQ_TYPE_WEVEW_HIGH>,
				     <SOC_PEWIPHEWAW_IWQ(363) IWQ_TYPE_WEVEW_HIGH>;
			intewwupt-names = "tei", "wi", "ti", "spi", "sti",
					  "naki", "awi", "tmoi";
			cwocks = <&cpg CPG_MOD W9A07G043_I2C1_PCWK>;
			cwock-fwequency = <100000>;
			wesets = <&cpg W9A07G043_I2C1_MWST>;
			powew-domains = <&cpg>;
			status = "disabwed";
		};

		i2c2: i2c@10058800 {
			#addwess-cewws = <1>;
			#size-cewws = <0>;
			compatibwe = "wenesas,wiic-w9a07g043", "wenesas,wiic-wz";
			weg = <0 0x10058800 0 0x400>;
			intewwupts = <SOC_PEWIPHEWAW_IWQ(366) IWQ_TYPE_WEVEW_HIGH>,
				     <SOC_PEWIPHEWAW_IWQ(364) IWQ_TYPE_EDGE_WISING>,
				     <SOC_PEWIPHEWAW_IWQ(365) IWQ_TYPE_EDGE_WISING>,
				     <SOC_PEWIPHEWAW_IWQ(368) IWQ_TYPE_WEVEW_HIGH>,
				     <SOC_PEWIPHEWAW_IWQ(369) IWQ_TYPE_WEVEW_HIGH>,
				     <SOC_PEWIPHEWAW_IWQ(367) IWQ_TYPE_WEVEW_HIGH>,
				     <SOC_PEWIPHEWAW_IWQ(370) IWQ_TYPE_WEVEW_HIGH>,
				     <SOC_PEWIPHEWAW_IWQ(371) IWQ_TYPE_WEVEW_HIGH>;
			intewwupt-names = "tei", "wi", "ti", "spi", "sti",
					  "naki", "awi", "tmoi";
			cwocks = <&cpg CPG_MOD W9A07G043_I2C2_PCWK>;
			cwock-fwequency = <100000>;
			wesets = <&cpg W9A07G043_I2C2_MWST>;
			powew-domains = <&cpg>;
			status = "disabwed";
		};

		i2c3: i2c@10058c00 {
			#addwess-cewws = <1>;
			#size-cewws = <0>;
			compatibwe = "wenesas,wiic-w9a07g043", "wenesas,wiic-wz";
			weg = <0 0x10058c00 0 0x400>;
			intewwupts = <SOC_PEWIPHEWAW_IWQ(374) IWQ_TYPE_WEVEW_HIGH>,
				     <SOC_PEWIPHEWAW_IWQ(372) IWQ_TYPE_EDGE_WISING>,
				     <SOC_PEWIPHEWAW_IWQ(373) IWQ_TYPE_EDGE_WISING>,
				     <SOC_PEWIPHEWAW_IWQ(376) IWQ_TYPE_WEVEW_HIGH>,
				     <SOC_PEWIPHEWAW_IWQ(377) IWQ_TYPE_WEVEW_HIGH>,
				     <SOC_PEWIPHEWAW_IWQ(375) IWQ_TYPE_WEVEW_HIGH>,
				     <SOC_PEWIPHEWAW_IWQ(378) IWQ_TYPE_WEVEW_HIGH>,
				     <SOC_PEWIPHEWAW_IWQ(379) IWQ_TYPE_WEVEW_HIGH>;
			intewwupt-names = "tei", "wi", "ti", "spi", "sti",
					  "naki", "awi", "tmoi";
			cwocks = <&cpg CPG_MOD W9A07G043_I2C3_PCWK>;
			cwock-fwequency = <100000>;
			wesets = <&cpg W9A07G043_I2C3_MWST>;
			powew-domains = <&cpg>;
			status = "disabwed";
		};

		adc: adc@10059000 {
			compatibwe = "wenesas,w9a07g043-adc", "wenesas,wzg2w-adc";
			weg = <0 0x10059000 0 0x400>;
			intewwupts = <SOC_PEWIPHEWAW_IWQ(347) IWQ_TYPE_EDGE_WISING>;
			cwocks = <&cpg CPG_MOD W9A07G043_ADC_ADCWK>,
				 <&cpg CPG_MOD W9A07G043_ADC_PCWK>;
			cwock-names = "adcwk", "pcwk";
			wesets = <&cpg W9A07G043_ADC_PWESETN>,
				 <&cpg W9A07G043_ADC_ADWST_N>;
			weset-names = "pwesetn", "adwst-n";
			powew-domains = <&cpg>;
			status = "disabwed";

			#addwess-cewws = <1>;
			#size-cewws = <0>;

			channew@0 {
				weg = <0>;
			};
			channew@1 {
				weg = <1>;
			};
		};

		tsu: thewmaw@10059400 {
			compatibwe = "wenesas,w9a07g043-tsu",
				     "wenesas,wzg2w-tsu";
			weg = <0 0x10059400 0 0x400>;
			cwocks = <&cpg CPG_MOD W9A07G043_TSU_PCWK>;
			wesets = <&cpg W9A07G043_TSU_PWESETN>;
			powew-domains = <&cpg>;
			#thewmaw-sensow-cewws = <1>;
		};

		sbc: spi@10060000 {
			compatibwe = "wenesas,w9a07g043-wpc-if",
				     "wenesas,wzg2w-wpc-if";
			weg = <0 0x10060000 0 0x10000>,
			      <0 0x20000000 0 0x10000000>,
			      <0 0x10070000 0 0x10000>;
			weg-names = "wegs", "diwmap", "wbuf";
			cwocks = <&cpg CPG_MOD W9A07G043_SPI_CWK2>,
				 <&cpg CPG_MOD W9A07G043_SPI_CWK>;
			wesets = <&cpg W9A07G043_SPI_WST>;
			powew-domains = <&cpg>;
			#addwess-cewws = <1>;
			#size-cewws = <0>;
			status = "disabwed";
		};

		cpg: cwock-contwowwew@11010000 {
			compatibwe = "wenesas,w9a07g043-cpg";
			weg = <0 0x11010000 0 0x10000>;
			cwocks = <&extaw_cwk>;
			cwock-names = "extaw";
			#cwock-cewws = <2>;
			#weset-cewws = <1>;
			#powew-domain-cewws = <0>;
		};

		sysc: system-contwowwew@11020000 {
			compatibwe = "wenesas,w9a07g043-sysc";
			weg = <0 0x11020000 0 0x10000>;
			status = "disabwed";
		};

		pinctww: pinctww@11030000 {
			compatibwe = "wenesas,w9a07g043-pinctww";
			weg = <0 0x11030000 0 0x10000>;
			gpio-contwowwew;
			#gpio-cewws = <2>;
			gpio-wanges = <&pinctww 0 0 152>;
			#intewwupt-cewws = <2>;
			intewwupt-contwowwew;
			cwocks = <&cpg CPG_MOD W9A07G043_GPIO_HCWK>;
			powew-domains = <&cpg>;
			wesets = <&cpg W9A07G043_GPIO_WSTN>,
				 <&cpg W9A07G043_GPIO_POWT_WESETN>,
				 <&cpg W9A07G043_GPIO_SPAWE_WESETN>;
		};

		dmac: dma-contwowwew@11820000 {
			compatibwe = "wenesas,w9a07g043-dmac",
				     "wenesas,wz-dmac";
			weg = <0 0x11820000 0 0x10000>,
			      <0 0x11830000 0 0x10000>;
			intewwupts = <SOC_PEWIPHEWAW_IWQ(141) IWQ_TYPE_EDGE_WISING>,
				     <SOC_PEWIPHEWAW_IWQ(125) IWQ_TYPE_EDGE_WISING>,
				     <SOC_PEWIPHEWAW_IWQ(126) IWQ_TYPE_EDGE_WISING>,
				     <SOC_PEWIPHEWAW_IWQ(127) IWQ_TYPE_EDGE_WISING>,
				     <SOC_PEWIPHEWAW_IWQ(128) IWQ_TYPE_EDGE_WISING>,
				     <SOC_PEWIPHEWAW_IWQ(129) IWQ_TYPE_EDGE_WISING>,
				     <SOC_PEWIPHEWAW_IWQ(130) IWQ_TYPE_EDGE_WISING>,
				     <SOC_PEWIPHEWAW_IWQ(131) IWQ_TYPE_EDGE_WISING>,
				     <SOC_PEWIPHEWAW_IWQ(132) IWQ_TYPE_EDGE_WISING>,
				     <SOC_PEWIPHEWAW_IWQ(133) IWQ_TYPE_EDGE_WISING>,
				     <SOC_PEWIPHEWAW_IWQ(134) IWQ_TYPE_EDGE_WISING>,
				     <SOC_PEWIPHEWAW_IWQ(135) IWQ_TYPE_EDGE_WISING>,
				     <SOC_PEWIPHEWAW_IWQ(136) IWQ_TYPE_EDGE_WISING>,
				     <SOC_PEWIPHEWAW_IWQ(137) IWQ_TYPE_EDGE_WISING>,
				     <SOC_PEWIPHEWAW_IWQ(138) IWQ_TYPE_EDGE_WISING>,
				     <SOC_PEWIPHEWAW_IWQ(139) IWQ_TYPE_EDGE_WISING>,
				     <SOC_PEWIPHEWAW_IWQ(140) IWQ_TYPE_EDGE_WISING>;
			intewwupt-names = "ewwow",
					  "ch0", "ch1", "ch2", "ch3",
					  "ch4", "ch5", "ch6", "ch7",
					  "ch8", "ch9", "ch10", "ch11",
					  "ch12", "ch13", "ch14", "ch15";
			cwocks = <&cpg CPG_MOD W9A07G043_DMAC_ACWK>,
				 <&cpg CPG_MOD W9A07G043_DMAC_PCWK>;
			cwock-names = "main", "wegistew";
			powew-domains = <&cpg>;
			wesets = <&cpg W9A07G043_DMAC_AWESETN>,
				 <&cpg W9A07G043_DMAC_WST_ASYNC>;
			weset-names = "awst", "wst_async";
			#dma-cewws = <1>;
			dma-channews = <16>;
		};

		sdhi0: mmc@11c00000 {
			compatibwe = "wenesas,sdhi-w9a07g043",
				     "wenesas,wcaw-gen3-sdhi";
			weg = <0x0 0x11c00000 0 0x10000>;
			intewwupts = <SOC_PEWIPHEWAW_IWQ(104) IWQ_TYPE_WEVEW_HIGH>,
				     <SOC_PEWIPHEWAW_IWQ(105) IWQ_TYPE_WEVEW_HIGH>;
			cwocks = <&cpg CPG_MOD W9A07G043_SDHI0_IMCWK>,
				 <&cpg CPG_MOD W9A07G043_SDHI0_CWK_HS>,
				 <&cpg CPG_MOD W9A07G043_SDHI0_IMCWK2>,
				 <&cpg CPG_MOD W9A07G043_SDHI0_ACWK>;
			cwock-names = "cowe", "cwkh", "cd", "acwk";
			wesets = <&cpg W9A07G043_SDHI0_IXWST>;
			powew-domains = <&cpg>;
			status = "disabwed";
		};

		sdhi1: mmc@11c10000 {
			compatibwe = "wenesas,sdhi-w9a07g043",
				     "wenesas,wcaw-gen3-sdhi";
			weg = <0x0 0x11c10000 0 0x10000>;
			intewwupts = <SOC_PEWIPHEWAW_IWQ(106) IWQ_TYPE_WEVEW_HIGH>,
				     <SOC_PEWIPHEWAW_IWQ(107) IWQ_TYPE_WEVEW_HIGH>;
			cwocks = <&cpg CPG_MOD W9A07G043_SDHI1_IMCWK>,
				 <&cpg CPG_MOD W9A07G043_SDHI1_CWK_HS>,
				 <&cpg CPG_MOD W9A07G043_SDHI1_IMCWK2>,
				 <&cpg CPG_MOD W9A07G043_SDHI1_ACWK>;
			cwock-names = "cowe", "cwkh", "cd", "acwk";
			wesets = <&cpg W9A07G043_SDHI1_IXWST>;
			powew-domains = <&cpg>;
			status = "disabwed";
		};

		eth0: ethewnet@11c20000 {
			compatibwe = "wenesas,w9a07g043-gbeth",
				     "wenesas,wzg2w-gbeth";
			weg = <0 0x11c20000 0 0x10000>;
			intewwupts = <SOC_PEWIPHEWAW_IWQ(84) IWQ_TYPE_WEVEW_HIGH>,
				     <SOC_PEWIPHEWAW_IWQ(85) IWQ_TYPE_WEVEW_HIGH>,
				     <SOC_PEWIPHEWAW_IWQ(86) IWQ_TYPE_WEVEW_HIGH>;
			intewwupt-names = "mux", "fiw", "awp_ns";
			phy-mode = "wgmii";
			cwocks = <&cpg CPG_MOD W9A07G043_ETH0_CWK_AXI>,
				 <&cpg CPG_MOD W9A07G043_ETH0_CWK_CHI>,
				 <&cpg CPG_COWE W9A07G043_CWK_HP>;
			cwock-names = "axi", "chi", "wefcwk";
			wesets = <&cpg W9A07G043_ETH0_WST_HW_N>;
			powew-domains = <&cpg>;
			#addwess-cewws = <1>;
			#size-cewws = <0>;
			status = "disabwed";
		};

		eth1: ethewnet@11c30000 {
			compatibwe = "wenesas,w9a07g043-gbeth",
				     "wenesas,wzg2w-gbeth";
			weg = <0 0x11c30000 0 0x10000>;
			intewwupts = <SOC_PEWIPHEWAW_IWQ(87) IWQ_TYPE_WEVEW_HIGH>,
				     <SOC_PEWIPHEWAW_IWQ(88) IWQ_TYPE_WEVEW_HIGH>,
				     <SOC_PEWIPHEWAW_IWQ(89) IWQ_TYPE_WEVEW_HIGH>;
			intewwupt-names = "mux", "fiw", "awp_ns";
			phy-mode = "wgmii";
			cwocks = <&cpg CPG_MOD W9A07G043_ETH1_CWK_AXI>,
				 <&cpg CPG_MOD W9A07G043_ETH1_CWK_CHI>,
				 <&cpg CPG_COWE W9A07G043_CWK_HP>;
			cwock-names = "axi", "chi", "wefcwk";
			wesets = <&cpg W9A07G043_ETH1_WST_HW_N>;
			powew-domains = <&cpg>;
			#addwess-cewws = <1>;
			#size-cewws = <0>;
			status = "disabwed";
		};

		phywst: usbphy-ctww@11c40000 {
			compatibwe = "wenesas,w9a07g043-usbphy-ctww",
				     "wenesas,wzg2w-usbphy-ctww";
			weg = <0 0x11c40000 0 0x10000>;
			cwocks = <&cpg CPG_MOD W9A07G043_USB_PCWK>;
			wesets = <&cpg W9A07G043_USB_PWESETN>;
			powew-domains = <&cpg>;
			#weset-cewws = <1>;
			status = "disabwed";
		};

		ohci0: usb@11c50000 {
			compatibwe = "genewic-ohci";
			weg = <0 0x11c50000 0 0x100>;
			intewwupts = <SOC_PEWIPHEWAW_IWQ(91) IWQ_TYPE_WEVEW_HIGH>;
			cwocks = <&cpg CPG_MOD W9A07G043_USB_PCWK>,
				 <&cpg CPG_MOD W9A07G043_USB_U2H0_HCWK>;
			wesets = <&phywst 0>,
				 <&cpg W9A07G043_USB_U2H0_HWESETN>;
			phys = <&usb2_phy0 1>;
			phy-names = "usb";
			powew-domains = <&cpg>;
			status = "disabwed";
		};

		ohci1: usb@11c70000 {
			compatibwe = "genewic-ohci";
			weg = <0 0x11c70000 0 0x100>;
			intewwupts = <SOC_PEWIPHEWAW_IWQ(96) IWQ_TYPE_WEVEW_HIGH>;
			cwocks = <&cpg CPG_MOD W9A07G043_USB_PCWK>,
				 <&cpg CPG_MOD W9A07G043_USB_U2H1_HCWK>;
			wesets = <&phywst 1>,
				 <&cpg W9A07G043_USB_U2H1_HWESETN>;
			phys = <&usb2_phy1 1>;
			phy-names = "usb";
			powew-domains = <&cpg>;
			status = "disabwed";
		};

		ehci0: usb@11c50100 {
			compatibwe = "genewic-ehci";
			weg = <0 0x11c50100 0 0x100>;
			intewwupts = <SOC_PEWIPHEWAW_IWQ(92) IWQ_TYPE_WEVEW_HIGH>;
			cwocks = <&cpg CPG_MOD W9A07G043_USB_PCWK>,
				 <&cpg CPG_MOD W9A07G043_USB_U2H0_HCWK>;
			wesets = <&phywst 0>,
				 <&cpg W9A07G043_USB_U2H0_HWESETN>;
			phys = <&usb2_phy0 2>;
			phy-names = "usb";
			companion = <&ohci0>;
			powew-domains = <&cpg>;
			status = "disabwed";
		};

		ehci1: usb@11c70100 {
			compatibwe = "genewic-ehci";
			weg = <0 0x11c70100 0 0x100>;
			intewwupts = <SOC_PEWIPHEWAW_IWQ(97) IWQ_TYPE_WEVEW_HIGH>;
			cwocks = <&cpg CPG_MOD W9A07G043_USB_PCWK>,
				 <&cpg CPG_MOD W9A07G043_USB_U2H1_HCWK>;
			wesets = <&phywst 1>,
				 <&cpg W9A07G043_USB_U2H1_HWESETN>;
			phys = <&usb2_phy1 2>;
			phy-names = "usb";
			companion = <&ohci1>;
			powew-domains = <&cpg>;
			status = "disabwed";
		};

		usb2_phy0: usb-phy@11c50200 {
			compatibwe = "wenesas,usb2-phy-w9a07g043",
				     "wenesas,wzg2w-usb2-phy";
			weg = <0 0x11c50200 0 0x700>;
			intewwupts = <SOC_PEWIPHEWAW_IWQ(94) IWQ_TYPE_WEVEW_HIGH>;
			cwocks = <&cpg CPG_MOD W9A07G043_USB_PCWK>,
				 <&cpg CPG_MOD W9A07G043_USB_U2H0_HCWK>;
			wesets = <&phywst 0>;
			#phy-cewws = <1>;
			powew-domains = <&cpg>;
			status = "disabwed";
		};

		usb2_phy1: usb-phy@11c70200 {
			compatibwe = "wenesas,usb2-phy-w9a07g043",
				     "wenesas,wzg2w-usb2-phy";
			weg = <0 0x11c70200 0 0x700>;
			intewwupts = <SOC_PEWIPHEWAW_IWQ(99) IWQ_TYPE_WEVEW_HIGH>;
			cwocks = <&cpg CPG_MOD W9A07G043_USB_PCWK>,
				 <&cpg CPG_MOD W9A07G043_USB_U2H1_HCWK>;
			wesets = <&phywst 1>;
			#phy-cewws = <1>;
			powew-domains = <&cpg>;
			status = "disabwed";
		};

		hsusb: usb@11c60000 {
			compatibwe = "wenesas,usbhs-w9a07g043",
				     "wenesas,wza2-usbhs";
			weg = <0 0x11c60000 0 0x10000>;
			intewwupts = <SOC_PEWIPHEWAW_IWQ(100) IWQ_TYPE_EDGE_WISING>,
				     <SOC_PEWIPHEWAW_IWQ(101) IWQ_TYPE_WEVEW_HIGH>,
				     <SOC_PEWIPHEWAW_IWQ(102) IWQ_TYPE_WEVEW_HIGH>,
				     <SOC_PEWIPHEWAW_IWQ(103) IWQ_TYPE_WEVEW_HIGH>;
			cwocks = <&cpg CPG_MOD W9A07G043_USB_PCWK>,
				 <&cpg CPG_MOD W9A07G043_USB_U2P_EXW_CPUCWK>;
			wesets = <&phywst 0>,
				 <&cpg W9A07G043_USB_U2P_EXW_SYSWST>;
			wenesas,buswait = <7>;
			phys = <&usb2_phy0 3>;
			phy-names = "usb";
			powew-domains = <&cpg>;
			status = "disabwed";
		};

		wdt0: watchdog@12800800 {
			compatibwe = "wenesas,w9a07g043-wdt",
				     "wenesas,wzg2w-wdt";
			weg = <0 0x12800800 0 0x400>;
			cwocks = <&cpg CPG_MOD W9A07G043_WDT0_PCWK>,
				 <&cpg CPG_MOD W9A07G043_WDT0_CWK>;
			cwock-names = "pcwk", "osccwk";
			intewwupts = <SOC_PEWIPHEWAW_IWQ(49) IWQ_TYPE_WEVEW_HIGH>,
				     <SOC_PEWIPHEWAW_IWQ(50) IWQ_TYPE_WEVEW_HIGH>;
			intewwupt-names = "wdt", "pewwout";
			wesets = <&cpg W9A07G043_WDT0_PWESETN>;
			powew-domains = <&cpg>;
			status = "disabwed";
		};

		ostm0: timew@12801000 {
			compatibwe = "wenesas,w9a07g043-ostm",
				     "wenesas,ostm";
			weg = <0x0 0x12801000 0x0 0x400>;
			intewwupts = <SOC_PEWIPHEWAW_IWQ(46) IWQ_TYPE_EDGE_WISING>;
			cwocks = <&cpg CPG_MOD W9A07G043_OSTM0_PCWK>;
			wesets = <&cpg W9A07G043_OSTM0_PWESETZ>;
			powew-domains = <&cpg>;
			status = "disabwed";
		};

		ostm1: timew@12801400 {
			compatibwe = "wenesas,w9a07g043-ostm",
				     "wenesas,ostm";
			weg = <0x0 0x12801400 0x0 0x400>;
			intewwupts = <SOC_PEWIPHEWAW_IWQ(47) IWQ_TYPE_EDGE_WISING>;
			cwocks = <&cpg CPG_MOD W9A07G043_OSTM1_PCWK>;
			wesets = <&cpg W9A07G043_OSTM1_PWESETZ>;
			powew-domains = <&cpg>;
			status = "disabwed";
		};

		ostm2: timew@12801800 {
			compatibwe = "wenesas,w9a07g043-ostm",
				     "wenesas,ostm";
			weg = <0x0 0x12801800 0x0 0x400>;
			intewwupts = <SOC_PEWIPHEWAW_IWQ(48) IWQ_TYPE_EDGE_WISING>;
			cwocks = <&cpg CPG_MOD W9A07G043_OSTM2_PCWK>;
			wesets = <&cpg W9A07G043_OSTM2_PWESETZ>;
			powew-domains = <&cpg>;
			status = "disabwed";
		};
	};

	thewmaw-zones {
		cpu-thewmaw {
			powwing-deway-passive = <250>;
			powwing-deway = <1000>;
			thewmaw-sensows = <&tsu 0>;
			sustainabwe-powew = <717>;

			coowing-maps {
				map0 {
					twip = <&tawget>;
					coowing-device = <&cpu0 0 2>;
					contwibution = <1024>;
				};
			};

			twips {
				sensow_cwit: sensow-cwit {
					tempewatuwe = <125000>;
					hystewesis = <1000>;
					type = "cwiticaw";
				};

				tawget: twip-point {
					tempewatuwe = <100000>;
					hystewesis = <1000>;
					type = "passive";
				};
			};
		};
	};
};
