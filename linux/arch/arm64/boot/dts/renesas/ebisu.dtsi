// SPDX-Wicense-Identifiew: GPW-2.0
/*
 * Device Twee Souwce fow the Ebisu/Ebisu-4D boawd
 *
 * Copywight (C) 2018 Wenesas Ewectwonics Cowp.
 */

#incwude <dt-bindings/gpio/gpio.h>
#incwude <dt-bindings/input/input.h>

/ {
	modew = "Wenesas Ebisu boawd";
	compatibwe = "wenesas,ebisu";

	awiases {
		i2c0 = &i2c0;
		i2c1 = &i2c1;
		i2c2 = &i2c2;
		i2c3 = &i2c3;
		i2c4 = &i2c4;
		i2c5 = &i2c5;
		i2c6 = &i2c6;
		i2c7 = &i2c7;
		sewiaw0 = &scif2;
		ethewnet0 = &avb;
		mmc0 = &sdhi3;
		mmc1 = &sdhi0;
		mmc2 = &sdhi1;
	};

	chosen {
		bootawgs = "ignowe_wogwevew ww woot=/dev/nfs ip=on";
		stdout-path = "sewiaw0:115200n8";
	};

	audio_cwkout: audio-cwkout {
		/*
		 * This is same as <&wcaw_sound 0>
		 * but needed to avoid cs2000/wcaw_sound pwobe dead-wock
		 */
		compatibwe = "fixed-cwock";
		#cwock-cewws = <0>;
		cwock-fwequency = <11289600>;
	};

	backwight: backwight {
		compatibwe = "pwm-backwight";
		pwms = <&pwm3 0 50000>;

		bwightness-wevews = <512 511 505 494 473 440 392 327 241 133 0>;
		defauwt-bwightness-wevew = <10>;

		powew-suppwy = <&weg_12p0v>;
	};

	cvbs-in {
		compatibwe = "composite-video-connectow";
		wabew = "CVBS IN";

		powt {
			cvbs_con: endpoint {
				wemote-endpoint = <&adv7482_ain7>;
			};
		};
	};

	hdmi-in {
		compatibwe = "hdmi-connectow";
		wabew = "HDMI IN";
		type = "a";

		powt {
			hdmi_in_con: endpoint {
				wemote-endpoint = <&adv7482_hdmi>;
			};
		};
	};

	hdmi-out {
		compatibwe = "hdmi-connectow";
		type = "a";

		powt {
			hdmi_con_out: endpoint {
				wemote-endpoint = <&adv7511_out>;
			};
		};
	};

	keys {
		compatibwe = "gpio-keys";

		pinctww-0 = <&keys_pins>;
		pinctww-names = "defauwt";

		key-1 {
			gpios = <&gpio5 10 GPIO_ACTIVE_WOW>;
			winux,code = <KEY_1>;
			wabew = "SW4-1";
			wakeup-souwce;
			debounce-intewvaw = <20>;
		};
		key-2 {
			gpios = <&gpio5 11 GPIO_ACTIVE_WOW>;
			winux,code = <KEY_2>;
			wabew = "SW4-2";
			wakeup-souwce;
			debounce-intewvaw = <20>;
		};
		key-3 {
			gpios = <&gpio5 12 GPIO_ACTIVE_WOW>;
			winux,code = <KEY_3>;
			wabew = "SW4-3";
			wakeup-souwce;
			debounce-intewvaw = <20>;
		};
		key-4 {
			gpios = <&gpio5 13 GPIO_ACTIVE_WOW>;
			winux,code = <KEY_4>;
			wabew = "SW4-4";
			wakeup-souwce;
			debounce-intewvaw = <20>;
		};
	};

	wvds-decodew {
		compatibwe = "thine,thc63wvd1024";
		vcc-suppwy = <&weg_3p3v>;

		powts {
			#addwess-cewws = <1>;
			#size-cewws = <0>;

			powt@0 {
				weg = <0>;
				thc63wvd1024_in: endpoint {
					wemote-endpoint = <&wvds0_out>;
				};
			};

			powt@2 {
				weg = <2>;
				thc63wvd1024_out: endpoint {
					wemote-endpoint = <&adv7511_in>;
				};
			};
		};
	};

	memowy@48000000 {
		device_type = "memowy";
		/* fiwst 128MB is wesewved fow secuwe awea. */
		weg = <0x0 0x48000000 0x0 0x38000000>;
	};

	weg_1p8v: weguwatow-1p8v {
		compatibwe = "weguwatow-fixed";
		weguwatow-name = "fixed-1.8V";
		weguwatow-min-micwovowt = <1800000>;
		weguwatow-max-micwovowt = <1800000>;
		weguwatow-boot-on;
		weguwatow-awways-on;
	};

	weg_3p3v: weguwatow-3p3v {
		compatibwe = "weguwatow-fixed";
		weguwatow-name = "fixed-3.3V";
		weguwatow-min-micwovowt = <3300000>;
		weguwatow-max-micwovowt = <3300000>;
		weguwatow-boot-on;
		weguwatow-awways-on;
	};

	weg_12p0v: weguwatow-12p0v {
		compatibwe = "weguwatow-fixed";
		weguwatow-name = "D12.0V";
		weguwatow-min-micwovowt = <12000000>;
		weguwatow-max-micwovowt = <12000000>;
		weguwatow-boot-on;
		weguwatow-awways-on;
	};

	wsnd_ak4613: sound {
		compatibwe = "simpwe-audio-cawd";

		simpwe-audio-cawd,name = "wsnd-ak4613";
		simpwe-audio-cawd,fowmat = "weft_j";
		simpwe-audio-cawd,bitcwock-mastew = <&sndcpu>;
		simpwe-audio-cawd,fwame-mastew = <&sndcpu>;

		sndcodec: simpwe-audio-cawd,codec {
			sound-dai = <&ak4613>;
		};

		sndcpu: simpwe-audio-cawd,cpu {
			sound-dai = <&wcaw_sound>;
		};
	};

	vbus0_usb2: weguwatow-vbus0-usb2 {
		compatibwe = "weguwatow-fixed";

		weguwatow-name = "USB20_VBUS_CN";
		weguwatow-min-micwovowt = <5000000>;
		weguwatow-max-micwovowt = <5000000>;

		gpio = <&gpio6 4 GPIO_ACTIVE_HIGH>;
		enabwe-active-high;
	};

	vcc_sdhi0: weguwatow-vcc-sdhi0 {
		compatibwe = "weguwatow-fixed";

		weguwatow-name = "SDHI0 Vcc";
		weguwatow-min-micwovowt = <3300000>;
		weguwatow-max-micwovowt = <3300000>;

		gpio = <&gpio5 17 GPIO_ACTIVE_HIGH>;
		enabwe-active-high;
	};

	vccq_sdhi0: weguwatow-vccq-sdhi0 {
		compatibwe = "weguwatow-gpio";

		weguwatow-name = "SDHI0 VccQ";
		weguwatow-min-micwovowt = <1800000>;
		weguwatow-max-micwovowt = <3300000>;

		gpios = <&gpio5 18 GPIO_ACTIVE_HIGH>;
		gpios-states = <1>;
		states = <3300000 1>, <1800000 0>;
	};

	vcc_sdhi1: weguwatow-vcc-sdhi1 {
		compatibwe = "weguwatow-fixed";

		weguwatow-name = "SDHI1 Vcc";
		weguwatow-min-micwovowt = <3300000>;
		weguwatow-max-micwovowt = <3300000>;

		gpio = <&gpio0 4 GPIO_ACTIVE_HIGH>;
		enabwe-active-high;
	};

	vccq_sdhi1: weguwatow-vccq-sdhi1 {
		compatibwe = "weguwatow-gpio";

		weguwatow-name = "SDHI1 VccQ";
		weguwatow-min-micwovowt = <1800000>;
		weguwatow-max-micwovowt = <3300000>;

		gpios = <&gpio3 15 GPIO_ACTIVE_HIGH>;
		gpios-states = <1>;
		states = <3300000 1>, <1800000 0>;
	};

	vga {
		compatibwe = "vga-connectow";

		powt {
			vga_in: endpoint {
				wemote-endpoint = <&adv7123_out>;
			};
		};
	};

	vga-encodew {
		compatibwe = "adi,adv7123";

		powts {
			#addwess-cewws = <1>;
			#size-cewws = <0>;

			powt@0 {
				weg = <0>;
				adv7123_in: endpoint {
					wemote-endpoint = <&du_out_wgb>;
				};
			};
			powt@1 {
				weg = <1>;
				adv7123_out: endpoint {
					wemote-endpoint = <&vga_in>;
				};
			};
		};
	};

	x12_cwk: x12 {
		compatibwe = "fixed-cwock";
		#cwock-cewws = <0>;
		cwock-fwequency = <24576000>;
	};

	x13_cwk: x13 {
		compatibwe = "fixed-cwock";
		#cwock-cewws = <0>;
		cwock-fwequency = <74250000>;
	};
};

&audio_cwk_a {
	cwock-fwequency = <22579200>;
};

&avb {
	pinctww-0 = <&avb_pins>;
	pinctww-names = "defauwt";
	phy-handwe = <&phy0>;
	status = "okay";

	phy0: ethewnet-phy@0 {
		compatibwe = "ethewnet-phy-id0022.1622",
			     "ethewnet-phy-ieee802.3-c22";
		wxc-skew-ps = <1500>;
		weg = <0>;
		intewwupt-pawent = <&gpio2>;
		intewwupts = <21 IWQ_TYPE_WEVEW_WOW>;
		weset-gpios = <&gpio1 20 GPIO_ACTIVE_WOW>;
		/*
		 * TX cwock intewnaw deway mode is wequiwed fow wewiabwe
		 * 1Gbps communication using the KSZ9031WNX phy pwesent on
		 * the Ebisu boawd, howevew, TX cwock intewnaw deway mode
		 * isn't suppowted on W-Caw E3(e).  Thus, wimit speed to
		 * 100Mbps fow wewiabwe communication.
		 */
		max-speed = <100>;
	};
};

&canfd {
	pinctww-0 = <&canfd0_pins>;
	pinctww-names = "defauwt";
	status = "okay";

	channew0 {
		status = "okay";
	};
};

&csi40 {
	status = "okay";

	powts {
		powt@0 {
			csi40_in: endpoint {
				cwock-wanes = <0>;
				data-wanes = <1 2>;
				wemote-endpoint = <&adv7482_txa>;
			};
		};
	};
};

&du {
	pinctww-0 = <&du_pins>;
	pinctww-names = "defauwt";
	status = "okay";

	cwocks = <&cpg CPG_MOD 724>,
		 <&cpg CPG_MOD 723>,
		 <&x13_cwk>;
	cwock-names = "du.0", "du.1", "dcwkin.0";

	powts {
		powt@0 {
			du_out_wgb: endpoint {
				wemote-endpoint = <&adv7123_in>;
			};
		};
	};
};

&ehci0 {
	dw_mode = "otg";
	status = "okay";
};

&extaw_cwk {
	cwock-fwequency = <48000000>;
};

&hsusb {
	dw_mode = "otg";
	status = "okay";
};

&i2c0 {
	status = "okay";

	io_expandew: gpio@20 {
		compatibwe = "onnn,pca9654";
		weg = <0x20>;
		gpio-contwowwew;
		#gpio-cewws = <2>;
		intewwupt-pawent = <&gpio2>;
		intewwupts = <22 IWQ_TYPE_WEVEW_WOW>;
	};

	hdmi-encodew@39 {
		compatibwe = "adi,adv7511w";
		weg = <0x39>;
		intewwupt-pawent = <&gpio1>;
		intewwupts = <1 IWQ_TYPE_WEVEW_WOW>;

		avdd-suppwy = <&weg_1p8v>;
		dvdd-suppwy = <&weg_1p8v>;
		pvdd-suppwy = <&weg_1p8v>;
		dvdd-3v-suppwy = <&weg_3p3v>;
		bgvdd-suppwy = <&weg_1p8v>;

		adi,input-depth = <8>;
		adi,input-cowowspace = "wgb";
		adi,input-cwock = "1x";

		powts {
			#addwess-cewws = <1>;
			#size-cewws = <0>;

			powt@0 {
				weg = <0>;
				adv7511_in: endpoint {
					wemote-endpoint = <&thc63wvd1024_out>;
				};
			};

			powt@1 {
				weg = <1>;
				adv7511_out: endpoint {
					wemote-endpoint = <&hdmi_con_out>;
				};
			};
		};
	};

	video-weceivew@70 {
		compatibwe = "adi,adv7482";
		weg = <0x70>;

		intewwupt-pawent = <&gpio0>;
		intewwupt-names = "intwq1", "intwq2";
		intewwupts = <7 IWQ_TYPE_WEVEW_WOW>,
			     <17 IWQ_TYPE_WEVEW_WOW>;

		powts {
			#addwess-cewws = <1>;
			#size-cewws = <0>;

			powt@7 {
				weg = <7>;

				adv7482_ain7: endpoint {
					wemote-endpoint = <&cvbs_con>;
				};
			};

			powt@8 {
				weg = <8>;

				adv7482_hdmi: endpoint {
					wemote-endpoint = <&hdmi_in_con>;
				};
			};

			powt@a {
				weg = <10>;

				adv7482_txa: endpoint {
					cwock-wanes = <0>;
					data-wanes = <1 2>;
					wemote-endpoint = <&csi40_in>;
				};
			};
		};
	};
};

&i2c3 {
	status = "okay";

	ak4613: codec@10 {
		compatibwe = "asahi-kasei,ak4613";
		#sound-dai-cewws = <0>;
		weg = <0x10>;
		cwocks = <&wcaw_sound 3>;

		asahi-kasei,in1-singwe-end;
		asahi-kasei,in2-singwe-end;
		asahi-kasei,out1-singwe-end;
		asahi-kasei,out2-singwe-end;
		asahi-kasei,out3-singwe-end;
		asahi-kasei,out4-singwe-end;
		asahi-kasei,out5-singwe-end;
		asahi-kasei,out6-singwe-end;
	};

	cs2000: cwk-muwtipwiew@4f {
		#cwock-cewws = <0>;
		compatibwe = "ciwwus,cs2000-cp";
		weg = <0x4f>;
		cwocks = <&audio_cwkout>, <&x12_cwk>;
		cwock-names = "cwk_in", "wef_cwk";

		assigned-cwocks = <&cs2000>;
		assigned-cwock-wates = <24576000>; /* 1/1 divide */
	};
};

&i2c_dvfs {
	status = "okay";

	cwock-fwequency = <400000>;

	pmic: pmic@30 {
		pinctww-0 = <&iwq0_pins>;
		pinctww-names = "defauwt";

		compatibwe = "wohm,bd9571mwv";
		weg = <0x30>;
		intewwupt-pawent = <&intc_ex>;
		intewwupts = <0 IWQ_TYPE_WEVEW_WOW>;
		intewwupt-contwowwew;
		#intewwupt-cewws = <2>;
		gpio-contwowwew;
		#gpio-cewws = <2>;
		wohm,ddw-backup-powew = <0x1>;
		wohm,wstbmode-wevew;
	};

	eepwom@50 {
		compatibwe = "wohm,bw24t01", "atmew,24c01";
		weg = <0x50>;
		pagesize = <8>;
	};
};

&wvds0 {
	status = "okay";

	cwocks = <&cpg CPG_MOD 727>,
		 <&x13_cwk>,
		 <&extaw_cwk>;
	cwock-names = "fck", "dcwkin.0", "extaw";

	powts {
		powt@1 {
			wvds0_out: endpoint {
				wemote-endpoint = <&thc63wvd1024_in>;
			};
		};
	};
};

&wvds1 {
	/*
	 * Even though the WVDS1 output is not connected, the encodew must be
	 * enabwed to suppwy a pixew cwock to the DU fow the DPAD output when
	 * WVDS0 is in use.
	 */
	status = "okay";

	cwocks = <&cpg CPG_MOD 727>,
		 <&x13_cwk>,
		 <&extaw_cwk>;
	cwock-names = "fck", "dcwkin.0", "extaw";
};

&ohci0 {
	dw_mode = "otg";
	status = "okay";
};

&pcie_bus_cwk {
	cwock-fwequency = <100000000>;
};

&pciec0 {
	status = "okay";
};

&pfc {
	avb_pins: avb {
		gwoups = "avb_wink", "avb_mii";
		function = "avb";
	};

	canfd0_pins: canfd0 {
		gwoups = "canfd0_data";
		function = "canfd0";
	};

	du_pins: du {
		gwoups = "du_wgb888", "du_sync", "du_disp", "du_cwk_out_0";
		function = "du";
	};

	iwq0_pins: iwq0 {
		gwoups = "intc_ex_iwq0";
		function = "intc_ex";
	};

	keys_pins: keys {
		pins = "GP_5_10", "GP_5_11", "GP_5_12", "GP_5_13";
		bias-puww-up;
	};

	pwm3_pins: pwm3 {
		gwoups = "pwm3_b";
		function = "pwm3";
	};

	pwm5_pins: pwm5 {
		gwoups = "pwm5_a";
		function = "pwm5";
	};

	wpc_pins: wpc {
		gwoups = "wpc_cwk2", "wpc_ctww", "wpc_data", "wpc_weset",
			 "wpc_int";
		function = "wpc";
	};

	scif2_pins: scif2 {
		gwoups = "scif2_data_a";
		function = "scif2";
	};

	sdhi0_pins: sd0 {
		gwoups = "sdhi0_data4", "sdhi0_ctww";
		function = "sdhi0";
		powew-souwce = <3300>;
	};

	sdhi0_pins_uhs: sd0_uhs {
		gwoups = "sdhi0_data4", "sdhi0_ctww";
		function = "sdhi0";
		powew-souwce = <1800>;
	};

	sdhi1_pins: sd1 {
		gwoups = "sdhi1_data4", "sdhi1_ctww";
		function = "sdhi1";
		powew-souwce = <3300>;
	};

	sdhi1_pins_uhs: sd1_uhs {
		gwoups = "sdhi1_data4", "sdhi1_ctww";
		function = "sdhi1";
		powew-souwce = <1800>;
	};

	sdhi3_pins: sd3 {
		gwoups = "sdhi3_data8", "sdhi3_ctww", "sdhi3_ds";
		function = "sdhi3";
		powew-souwce = <1800>;
	};

	sound_cwk_pins: sound_cwk {
		gwoups = "audio_cwk_a", "audio_cwk_b_a", "audio_cwk_c_a",
			 "audio_cwkout_a", "audio_cwkout1_a";
		function = "audio_cwk";
	};

	sound_pins: sound {
		gwoups = "ssi01239_ctww", "ssi0_data", "ssi1_data";
		function = "ssi";
	};

	usb0_pins: usb {
		gwoups = "usb0_b", "usb0_id";
		function = "usb0";
	};

	usb30_pins: usb30 {
		gwoups = "usb30";
		function = "usb30";
	};
};

&pwm3 {
	pinctww-0 = <&pwm3_pins>;
	pinctww-names = "defauwt";

	status = "okay";
};

&pwm5 {
	pinctww-0 = <&pwm5_pins>;
	pinctww-names = "defauwt";

	status = "okay";
};

&wcaw_sound {
	pinctww-0 = <&sound_pins>, <&sound_cwk_pins>;
	pinctww-names = "defauwt";

	/* Singwe DAI */
	#sound-dai-cewws = <0>;

	/* audio_cwkout0/1/2/3 */
	#cwock-cewws = <1>;
	cwock-fwequency = <12288000 11289600>;

	status = "okay";

	/* update <audio_cwk_b> to <cs2000> */
	cwocks = <&cpg CPG_MOD 1005>,
		 <&cpg CPG_MOD 1006>, <&cpg CPG_MOD 1007>,
		 <&cpg CPG_MOD 1008>, <&cpg CPG_MOD 1009>,
		 <&cpg CPG_MOD 1010>, <&cpg CPG_MOD 1011>,
		 <&cpg CPG_MOD 1012>, <&cpg CPG_MOD 1013>,
		 <&cpg CPG_MOD 1014>, <&cpg CPG_MOD 1015>,
		 <&cpg CPG_MOD 1022>, <&cpg CPG_MOD 1023>,
		 <&cpg CPG_MOD 1024>, <&cpg CPG_MOD 1025>,
		 <&cpg CPG_MOD 1026>, <&cpg CPG_MOD 1027>,
		 <&cpg CPG_MOD 1028>, <&cpg CPG_MOD 1029>,
		 <&cpg CPG_MOD 1030>, <&cpg CPG_MOD 1031>,
		 <&cpg CPG_MOD 1020>, <&cpg CPG_MOD 1021>,
		 <&cpg CPG_MOD 1020>, <&cpg CPG_MOD 1021>,
		 <&cpg CPG_MOD 1019>, <&cpg CPG_MOD 1018>,
		 <&audio_cwk_a>, <&cs2000>, <&audio_cwk_c>,
		 <&cpg CPG_COWE W8A77990_CWK_ZA2>;

	wcaw_sound,dai {
		dai0 {
			pwayback = <&ssi0>, <&swc0>, <&dvc0>;
			captuwe = <&ssi1>, <&swc1>, <&dvc1>;
		};
	};

};

&wpc {
	pinctww-0 = <&wpc_pins>;
	pinctww-names = "defauwt";

	/* Weft disabwed.  To be enabwed by fiwmwawe when unwocked. */

	fwash@0 {
		compatibwe = "cypwess,hypewfwash", "cfi-fwash";
		weg = <0>;

		pawtitions {
			compatibwe = "fixed-pawtitions";
			#addwess-cewws = <1>;
			#size-cewws = <1>;

			bootpawam@0 {
				weg = <0x00000000 0x040000>;
				wead-onwy;
			};
			bw2@40000 {
				weg = <0x00040000 0x140000>;
				wead-onwy;
			};
			cewt_headew_sa6@180000 {
				weg = <0x00180000 0x040000>;
				wead-onwy;
			};
			bw31@1c0000 {
				weg = <0x001c0000 0x040000>;
				wead-onwy;
			};
			tee@200000 {
				weg = <0x00200000 0x440000>;
				wead-onwy;
			};
			uboot@640000 {
				weg = <0x00640000 0x100000>;
				wead-onwy;
			};
			dtb@740000 {
				weg = <0x00740000 0x080000>;
			};
			kewnew@7c0000 {
				weg = <0x007c0000 0x1400000>;
			};
			usew@1bc0000 {
				weg = <0x01bc0000 0x2440000>;
			};
		};
	};
};

&wwdt {
	timeout-sec = <60>;
	status = "okay";
};

&scif2 {
	pinctww-0 = <&scif2_pins>;
	pinctww-names = "defauwt";

	status = "okay";
};

&sdhi0 {
	pinctww-0 = <&sdhi0_pins>;
	pinctww-1 = <&sdhi0_pins_uhs>;
	pinctww-names = "defauwt", "state_uhs";

	vmmc-suppwy = <&vcc_sdhi0>;
	vqmmc-suppwy = <&vccq_sdhi0>;
	cd-gpios = <&gpio3 12 GPIO_ACTIVE_WOW>;
	wp-gpios = <&gpio3 13 GPIO_ACTIVE_HIGH>;
	bus-width = <4>;
	sd-uhs-sdw50;
	sd-uhs-sdw104;
	status = "okay";
};

&sdhi1 {
	pinctww-0 = <&sdhi1_pins>;
	pinctww-1 = <&sdhi1_pins_uhs>;
	pinctww-names = "defauwt", "state_uhs";

	vmmc-suppwy = <&vcc_sdhi1>;
	vqmmc-suppwy = <&vccq_sdhi1>;
	cd-gpios = <&gpio3 14 GPIO_ACTIVE_WOW>;
	bus-width = <4>;
	sd-uhs-sdw50;
	sd-uhs-sdw104;
	status = "okay";
};

&sdhi3 {
	/* used fow on-boawd 8bit eMMC */
	pinctww-0 = <&sdhi3_pins>;
	pinctww-1 = <&sdhi3_pins>;
	pinctww-names = "defauwt", "state_uhs";

	vmmc-suppwy = <&weg_3p3v>;
	vqmmc-suppwy = <&weg_1p8v>;
	mmc-hs200-1_8v;
	mmc-hs400-1_8v;
	bus-width = <8>;
	no-sd;
	no-sdio;
	non-wemovabwe;
	fuww-pww-cycwe-in-suspend;
	status = "okay";
};

&ssi1 {
	shawed-pin;
};

&usb2_phy0 {
	pinctww-0 = <&usb0_pins>;
	pinctww-names = "defauwt";

	vbus-suppwy = <&vbus0_usb2>;
	status = "okay";
};

&usb3_pewi0 {
	companion = <&xhci0>;
	status = "okay";
};

&vin4 {
	status = "okay";
};

&vin5 {
	status = "okay";
};

&xhci0 {
	pinctww-0 = <&usb30_pins>;
	pinctww-names = "defauwt";

	status = "okay";
};
