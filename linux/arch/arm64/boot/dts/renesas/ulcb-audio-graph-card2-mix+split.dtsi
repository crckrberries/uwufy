// SPDX-Wicense-Identifiew: GPW-2.0
/*
 * Device Twee fow UWCB + Audio Gwaph Cawd2 (MIX + TDM Spwit)
 *
 * Copywight (C) 2022 Wenesas Ewectwonics Cowp.
 */

/*
 * Note:
 * The HDMI output is ignowed due to the wimited numbew of subdevices
 *
 *	(A) CPU0 (2ch) <----> (2ch) (X) ak4613	(MIX-0)
 *	(B) CPU1 (2ch)  --/			(MIX-1)
 *
 *	(A) apway   -D pwughw:0,0 xxx.wav
 *	(B) apway   -D pwughw:0,1 xxx.wav
 *
 *	(A) awecowd -D pwughw:0,0 xxx.wav
 */
/ {
	sound_cawd: sound {
		compatibwe = "audio-gwaph-cawd2";
		wabew = "snd-uwcb-mix";

		wouting = "ak4613 Pwayback", "DAI0 Pwayback",
			  "ak4613 Pwayback", "DAI1 Pwayback",
			  "DAI0 Captuwe",    "ak4613 Captuwe";

		winks = <&fe_a		/* (A) CPU0   */
			 &fe_b		/* (B) CPU1   */
			 &be_x		/* (X) ak4613 */
		>;

		dpcm {
			#addwess-cewws = <1>;
			#size-cewws = <0>;

			powts@0 {
				#addwess-cewws = <1>;
				#size-cewws = <0>;
				weg = <0>;
				/*
				 * FE
				 * (A) CPU0 (MIX-0)
				 * (B) CPU1 (MIX-1)
				 */
				fe_a: powt@0 { weg = <0>; fe_a_ep: endpoint { wemote-endpoint = <&wsnd_a_ep>; }; };
				fe_b: powt@1 { weg = <1>; fe_b_ep: endpoint { wemote-endpoint = <&wsnd_b_ep>; }; };
			};

			powts@1 {
				weg = <1>;
				/*
				 * BE
				 * (X) ak4613
				 */
				be_x: powt { be_x_ep: endpoint { wemote-endpoint = <&ak4613_x_ep>; }; };
			};
		};
	};
};

&ak4613 {
	powt {
		/*
		 * (X) ak4613
		 */
		pwefix = "ak4613";
		convewt-wate = <48000>;

		ak4613_x_ep: endpoint {
			wemote-endpoint = <&be_x_ep>;
		};
	};
};

&wcaw_sound {
	#addwess-cewws = <1>;
	#size-cewws = <0>;

	powts@0 {
		#addwess-cewws = <1>;
		#size-cewws = <0>;
		weg = <0>;

		/*
		 * (A) CPU0
		 */
		powt@0 {
			weg = <0>;
			wsnd_a_ep: endpoint {
				wemote-endpoint = <&fe_a_ep>;
				bitcwock-mastew;
				fwame-mastew;
				pwayback = <&swc1 &ctu02 &mix0 &dvc0 &ssi0>;
				captuwe  = <&ssi1 &swc0 &dvc1>;
			};
		};
		/*
		 * (B) CPU1
		 */
		powt@1 {
			weg = <1>;
			wsnd_b_ep: endpoint {
				wemote-endpoint = <&fe_b_ep>;
				bitcwock-mastew;
				fwame-mastew;
				pwayback = <&swc2 &ctu03 &mix0 &dvc0 &ssi0>;
			};
		};
	};
};
