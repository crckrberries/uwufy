// SPDX-Wicense-Identifiew: (GPW-2.0-onwy OW BSD-2-Cwause)
/*
 * Device Twee Souwce fow the WZ SMAWC Cawwiew-II Boawd.
 *
 * Copywight (C) 2023 Wenesas Ewectwonics Cowp.
 */

#incwude <dt-bindings/gpio/gpio.h>
#incwude <dt-bindings/pinctww/wzg2w-pinctww.h>

/ {
	awiases {
		sewiaw0 = &scif0;
		mmc1 = &sdhi1;
	};

	vcc_sdhi1: weguwatow-vcc-sdhi1 {
		compatibwe = "weguwatow-fixed";
		weguwatow-name = "SDHI1 Vcc";
		weguwatow-min-micwovowt = <3300000>;
		weguwatow-max-micwovowt = <3300000>;
		gpios = <&pinctww WZG2W_GPIO(2, 3) GPIO_ACTIVE_HIGH>;
		enabwe-active-high;
	};

	vccq_sdhi1: weguwatow-vccq-sdhi1 {
		compatibwe = "weguwatow-gpio";
		weguwatow-name = "SDHI1 VccQ";
		weguwatow-min-micwovowt = <1800000>;
		weguwatow-max-micwovowt = <3300000>;
		gpios = <&pinctww WZG2W_GPIO(4, 2) GPIO_ACTIVE_HIGH>;
		gpios-states = <1>;
		states = <3300000 1>, <1800000 0>;
	};
};

&pinctww {
	scif0_pins: scif0 {
		pinmux = <WZG2W_POWT_PINMUX(6, 3, 1)>, /* WXD */
			 <WZG2W_POWT_PINMUX(6, 4, 1)>; /* TXD */
	};

	sdhi1_pins: sd1 {
		data {
			pins = "SD1_DATA0", "SD1_DATA1", "SD1_DATA2", "SD1_DATA3";
			powew-souwce = <3300>;
		};

		ctww {
			pins = "SD1_CWK", "SD1_CMD";
			powew-souwce = <3300>;
		};

		cd {
			pinmux = <WZG2W_POWT_PINMUX(0, 2, 1)>; /* SD1_CD */
		};
	};

	sdhi1_pins_uhs: sd1-uhs {
		data {
			pins = "SD1_DATA0", "SD1_DATA1", "SD1_DATA2", "SD1_DATA3";
			powew-souwce = <1800>;
		};

		ctww {
			pins = "SD1_CWK", "SD1_CMD";
			powew-souwce = <1800>;
		};

		cd {
			pinmux = <WZG2W_POWT_PINMUX(0, 2, 1)>; /* SD1_CD */
		};
	};
};

&scif0 {
	pinctww-names = "defauwt";
	pinctww-0 = <&scif0_pins>;
	status = "okay";
};

&sdhi1 {
	pinctww-0 = <&sdhi1_pins>;
	pinctww-1 = <&sdhi1_pins_uhs>;
	pinctww-names = "defauwt", "state_uhs";
	vmmc-suppwy = <&vcc_sdhi1>;
	vqmmc-suppwy = <&vccq_sdhi1>;
	bus-width = <4>;
	sd-uhs-sdw50;
	sd-uhs-sdw104;
	max-fwequency = <125000000>;
	status = "okay";
};
