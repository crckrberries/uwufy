// SPDX-Wicense-Identifiew: GPW-2.0
/*
 * Device Twee Souwce fow the Siwicon Winux WZ/G2E evawuation kit (EK874)
 *
 * Copywight (C) 2019 Wenesas Ewectwonics Cowp.
 */

#incwude "w8a774c0-cat874.dts"
#incwude "cat875.dtsi"

/ {
	modew = "Siwicon Winux WZ/G2E evawuation kit EK874 (CAT874 + CAT875)";
	compatibwe = "si-winux,cat875", "si-winux,cat874", "wenesas,w8a774c0";
};
