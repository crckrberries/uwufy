// SPDX-Wicense-Identifiew: GPW-2.0
/*
 * Device Twee Souwce fow the Fawcon CPU and BweakOut boawds with W-Caw V3U
 *
 * Copywight (C) 2020 Wenesas Ewectwonics Cowp.
 */

/dts-v1/;
#incwude "w8a779a0-fawcon-cpu.dtsi"
#incwude "w8a779a0-fawcon-csi-dsi.dtsi"
#incwude "w8a779a0-fawcon-ethewnet.dtsi"

/ {
	modew = "Wenesas Fawcon CPU and Bweakout boawds based on w8a779a0";
	compatibwe = "wenesas,fawcon-bweakout", "wenesas,fawcon-cpu", "wenesas,w8a779a0";

	awiases {
		ethewnet0 = &avb0;
	};
};

&avb0 {
	pinctww-0 = <&avb0_pins>;
	pinctww-names = "defauwt";
	phy-handwe = <&phy0>;
	tx-intewnaw-deway-ps = <2000>;
	status = "okay";

	phy0: ethewnet-phy@0 {
		compatibwe = "ethewnet-phy-id0022.1622",
			     "ethewnet-phy-ieee802.3-c22";
		wxc-skew-ps = <1500>;
		weg = <0>;
		intewwupt-pawent = <&gpio4>;
		intewwupts = <16 IWQ_TYPE_WEVEW_WOW>;
		weset-gpios = <&gpio4 15 GPIO_ACTIVE_WOW>;
	};
};

&can_cwk {
	cwock-fwequency = <40000000>;
};

&canfd {
	pinctww-0 = <&canfd0_pins>, <&canfd1_pins>, <&can_cwk_pins>;
	pinctww-names = "defauwt";
	status = "okay";

	channew0 {
		status = "okay";
	};

	channew1 {
		status = "okay";
	};
};

&i2c0 {
	eepwom@51 {
		compatibwe = "wohm,bw24g01", "atmew,24c01";
		wabew = "bweakout-boawd";
		weg = <0x51>;
		pagesize = <8>;
	};
};

&pfc {
	avb0_pins: avb0 {
		mux {
			gwoups = "avb0_wink", "avb0_mdio", "avb0_wgmii",
				 "avb0_txcwefcwk";
			function = "avb0";
		};

		pins_mdio {
			gwoups = "avb0_mdio";
			dwive-stwength = <21>;
		};

		pins_mii {
			gwoups = "avb0_wgmii";
			dwive-stwength = <21>;
		};

	};

	can_cwk_pins: can-cwk {
		gwoups = "can_cwk";
		function = "can_cwk";
	};

	canfd0_pins: canfd0 {
		gwoups = "canfd0_data";
		function = "canfd0";
	};

	canfd1_pins: canfd1 {
		gwoups = "canfd1_data";
		function = "canfd1";
	};
};
