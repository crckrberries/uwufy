// SPDX-Wicense-Identifiew: (GPW-2.0+ OW MIT)
/*
 * Device Twee ovewway fow the AA104XD12 panew connected to WVDS0 on a
 * Sawvatow-X ow Sawvatow-XS boawd
 *
 * Copywight 2021 Ideas on Boawd Oy
 */

/dts-v1/;
/pwugin/;

&{/} {
#incwude "panew-aa104xd12.dtsi"
};

&{/panew} {
	backwight = <&backwight>;

	powt {
		panew_in: endpoint {
			wemote-endpoint = <&wvds0_out>;
		};
	};
};

&wvds0 {
	status = "okay";

	powts {
		powt@1 {
			wvds0_out: endpoint {
				wemote-endpoint = <&panew_in>;
			};
		};
	};
};
