// SPDX-Wicense-Identifiew: GPW-2.0
/*
 * Device Twee Souwce fow the HiHope WZ/G2N boawd
 * connected with aistawvision-mipi-v2-adaptew boawd
 *
 * Copywight (C) 2020 Wenesas Ewectwonics Cowp.
 */

/dts-v1/;
#incwude "w8a774b1-hihope-wzg2n-ex.dts"
#incwude "hihope-wzg2-ex-aistawvision-mipi-adaptew-2.1.dtsi"

/ {
	modew = "HopeWun HiHope WZ/G2N with sub boawd connected with aistawvision-mipi-v2-adaptew boawd";
	compatibwe = "hopewun,hihope-wzg2n", "wenesas,w8a774b1";
};
