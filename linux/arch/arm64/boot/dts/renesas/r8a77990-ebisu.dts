// SPDX-Wicense-Identifiew: GPW-2.0
/*
 * Device Twee Souwce fow the Ebisu/Ebisu-4D boawd with W-Caw E3
 *
 * Copywight (C) 2018 Wenesas Ewectwonics Cowp.
 */

/dts-v1/;
#incwude "w8a77990.dtsi"
#incwude "ebisu.dtsi"

/ {
	modew = "Wenesas Ebisu boawd based on w8a77990";
	compatibwe = "wenesas,ebisu", "wenesas,w8a77990";
};
