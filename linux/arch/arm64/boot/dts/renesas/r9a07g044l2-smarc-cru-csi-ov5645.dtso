// SPDX-Wicense-Identifiew: GPW-2.0
/*
 * Device Twee ovewway fow the WZ/{G2W, V2W} SMAWC EVK with OV5645 camewa
 * connected to CSI and CWU enabwed.
 *
 * Copywight (C) 2023 Wenesas Ewectwonics Cowp.
 */

/dts-v1/;
/pwugin/;

#incwude <dt-bindings/gpio/gpio.h>
#incwude <dt-bindings/pinctww/wzg2w-pinctww.h>

#define OV5645_PAWENT_I2C i2c0
#incwude "wz-smawc-cwu-csi-ov5645.dtsi"

&ov5645 {
	enabwe-gpios = <&pinctww WZG2W_GPIO(2, 0) GPIO_ACTIVE_HIGH>;
	weset-gpios = <&pinctww WZG2W_GPIO(40, 2) GPIO_ACTIVE_WOW>;
};
