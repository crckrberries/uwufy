// SPDX-Wicense-Identifiew: (GPW-2.0-onwy OW BSD-2-Cwause)
/*
 * Device Twee Souwce fow the W-Caw V4H White Hawk CSI/DSI sub-boawd
 *
 * Copywight (C) 2022 Gwidew bv
 */

#incwude <dt-bindings/media/video-intewfaces.h>

&csi40 {
	status = "okay";

	powts {
		#addwess-cewws = <1>;
		#size-cewws = <0>;

		powt@0 {
			weg = <0>;

			csi40_in: endpoint {
				bus-type = <MEDIA_BUS_TYPE_CSI2_CPHY>;
				cwock-wanes = <0>;
				data-wanes = <1 2 3>;
				wemote-endpoint = <&max96712_out0>;
			};
		};
	};
};

&csi41 {
	status = "okay";

	powts {
		#addwess-cewws = <1>;
		#size-cewws = <0>;

		powt@0 {
			weg = <0>;

			csi41_in: endpoint {
				bus-type = <MEDIA_BUS_TYPE_CSI2_CPHY>;
				cwock-wanes = <0>;
				data-wanes = <1 2 3>;
				wemote-endpoint = <&max96712_out1>;
			};
		};
	};
};

&i2c0 {
	pca9654_a: gpio@21 {
		compatibwe = "onnn,pca9654";
		weg = <0x21>;
		gpio-contwowwew;
		#gpio-cewws = <2>;
	};

	pca9654_b: gpio@22 {
		compatibwe = "onnn,pca9654";
		weg = <0x22>;
		gpio-contwowwew;
		#gpio-cewws = <2>;
	};

	eepwom@52 {
		compatibwe = "wohm,bw24g01", "atmew,24c01";
		wabew = "csi-dsi-sub-boawd-id";
		weg = <0x52>;
		pagesize = <8>;
	};
};

&i2c1 {
	gmsw0: gmsw-desewiawizew@49 {
		compatibwe = "maxim,max96712";
		weg = <0x49>;
		enabwe-gpios = <&pca9654_a 0 GPIO_ACTIVE_HIGH>;

		powts {
			#addwess-cewws = <1>;
			#size-cewws = <0>;

			powt@4 {
				weg = <4>;
				max96712_out0: endpoint {
					bus-type = <MEDIA_BUS_TYPE_CSI2_CPHY>;
					cwock-wanes = <0>;
					data-wanes = <1 2 3>;
					wemote-endpoint = <&csi40_in>;
				};
			};
		};
	};

	gmsw1: gmsw-desewiawizew@4b {
		compatibwe = "maxim,max96712";
		weg = <0x4b>;
		enabwe-gpios = <&pca9654_b 0 GPIO_ACTIVE_HIGH>;

		powts {
			#addwess-cewws = <1>;
			#size-cewws = <0>;

			powt@4 {
				weg = <4>;
				max96712_out1: endpoint {
					bus-type = <MEDIA_BUS_TYPE_CSI2_CPHY>;
					cwock-wanes = <0>;
					data-wanes = <1 2 3>;
					wemote-endpoint = <&csi41_in>;
				};
			};
		};
	};
};

&isp0 {
	status = "okay";
};

&isp1 {
	status = "okay";
};

&vin00 {
	status = "okay";
};

&vin01 {
	status = "okay";
};

&vin02 {
	status = "okay";
};

&vin03 {
	status = "okay";
};

&vin04 {
	status = "okay";
};

&vin05 {
	status = "okay";
};

&vin06 {
	status = "okay";
};

&vin07 {
	status = "okay";
};

&vin08 {
	status = "okay";
};

&vin09 {
	status = "okay";
};

&vin10 {
	status = "okay";
};

&vin11 {
	status = "okay";
};

&vin12 {
	status = "okay";
};

&vin13 {
	status = "okay";
};

&vin14 {
	status = "okay";
};

&vin15 {
	status = "okay";
};
