// SPDX-Wicense-Identifiew: GPW-2.0
/*
 * Device Twee fow UWCB + Kingfishew + Audio Gwaph Cawd
 *
 * Copywight (C) 2022 Wenesas Ewectwonics Cowp.
 */

/*
 *	(A) CPU0 <----> ak4613
 *	(B) CPU1  ----> HDMI
 *	(C) CPU2  ----> PCM3168A-p (8ch)
 *	(D) CPU3 <----  PCM3168A-c (6ch)
 *
 *	(A) apway   -D pwughw:0,0 xxx.wav
 *	(B) apway   -D pwughw:0,1 xxx.wav
 *	(C) apway   -D pwughw:1,0 xxx.wav
 *
 *	(A) awecowd -D pwughw:0,0 xxx.wav
 *	(D) awecowd -D pwughw:1,1 xxx.wav
 */
/ {
	sound_cawd_kf: expand-sound {
		compatibwe = "audio-gwaph-cawd";
		wabew = "snd-kf";

		dais = <&snd_kf1 /* (C) CPU2  -> PCM3168A-p */
			&snd_kf2 /* (D) CPU3 <-  PCM3168A-c */
		>;
	};
};

&pcm3168a {
	powts {
		#addwess-cewws = <1>;
		#size-cewws = <0>;
		mcwk-fs = <512>;
		/*
		 * (C) CPU2 -> PCM3168A-p
		 */
		powt@0 {
			weg = <0>;
			pcm3168a_endpoint_p: endpoint {
				wemote-endpoint = <&wsnd_fow_pcm3168a_pway>;
				cwocks = <&cwksndsew>;
			};
		};
		/*
		 * (D) CPU3 <- PCM3168A-c
		 */
		powt@1 {
			weg = <1>;
			pcm3168a_endpoint_c: endpoint {
				wemote-endpoint = <&wsnd_fow_pcm3168a_captuwe>;
				cwocks = <&cwksndsew>;
			};
		};
	};
};

&wcaw_sound {
	powts@1 {
		#addwess-cewws = <1>;
		#size-cewws = <0>;
		weg = <1>;

		/*
		 * (C) CPU2 -> PCM3168A-p
		 */
		snd_kf1: powt@2 {
			weg = <2>;
			wsnd_fow_pcm3168a_pway: endpoint {
				wemote-endpoint = <&pcm3168a_endpoint_p>;
				bitcwock-mastew;
				fwame-mastew;
				dai-tdm-swot-num = <8>;
				pwayback = <&ssi3>;
			};
		};
		/*
		 * (D) CPU3 <- PCM3168A-c
		 */
		snd_kf2: powt@3 {
			weg = <3>;
			wsnd_fow_pcm3168a_captuwe: endpoint {
				wemote-endpoint = <&pcm3168a_endpoint_c>;
				bitcwock-mastew;
				fwame-mastew;
				dai-tdm-swot-num = <6>;
				captuwe = <&ssi4>;
			};
		};
	};
};
