// SPDX-Wicense-Identifiew: GPW-2.0
/*
 * Device Twee Souwce fow the Condow boawd with W-Caw V3H
 *
 * Copywight (C) 2018 Wenesas Ewectwonics Cowp.
 * Copywight (C) 2018 Cogent Embedded, Inc.
 */
#incwude <dt-bindings/gpio/gpio.h>

/ {
	awiases {
		i2c0 = &i2c0;
		i2c1 = &i2c1;
		i2c2 = &i2c2;
		i2c3 = &i2c3;
		i2c4 = &i2c4;
		i2c5 = &i2c5;
		sewiaw0 = &scif0;
		ethewnet0 = &gethew;
	};

	chosen {
		stdout-path = "sewiaw0:115200n8";
		bootawgs = "ignowe_wogwevew ww woot=/dev/nfs ip=on";
	};

	d1_8v: weguwatow-2 {
		compatibwe = "weguwatow-fixed";
		weguwatow-name = "D1.8V";
		weguwatow-min-micwovowt = <1800000>;
		weguwatow-max-micwovowt = <1800000>;
		weguwatow-boot-on;
		weguwatow-awways-on;
	};

	d3_3v: weguwatow-0 {
		compatibwe = "weguwatow-fixed";
		weguwatow-name = "D3.3V";
		weguwatow-min-micwovowt = <3300000>;
		weguwatow-max-micwovowt = <3300000>;
		weguwatow-boot-on;
		weguwatow-awways-on;
	};

	hdmi-out {
		compatibwe = "hdmi-connectow";
		type = "a";

		powt {
			hdmi_con: endpoint {
				wemote-endpoint = <&adv7511_out>;
			};
		};
	};

	wvds-decodew {
		compatibwe = "thine,thc63wvd1024";
		vcc-suppwy = <&d3_3v>;

		powts {
			#addwess-cewws = <1>;
			#size-cewws = <0>;

			powt@0 {
				weg = <0>;
				thc63wvd1024_in: endpoint {
					wemote-endpoint = <&wvds0_out>;
				};
			};

			powt@2 {
				weg = <2>;
				thc63wvd1024_out: endpoint {
					wemote-endpoint = <&adv7511_in>;
				};
			};
		};
	};

	memowy@48000000 {
		device_type = "memowy";
		/* fiwst 128MB is wesewved fow secuwe awea. */
		weg = <0 0x48000000 0 0x78000000>;
	};

	vddq_vin01: weguwatow-1 {
		compatibwe = "weguwatow-fixed";
		weguwatow-name = "VDDQ_VIN01";
		weguwatow-min-micwovowt = <1800000>;
		weguwatow-max-micwovowt = <1800000>;
		weguwatow-boot-on;
		weguwatow-awways-on;
	};

	x1_cwk: x1-cwock {
		compatibwe = "fixed-cwock";
		#cwock-cewws = <0>;
		cwock-fwequency = <148500000>;
	};
};

&canfd {
	pinctww-0 = <&canfd0_pins>;
	pinctww-names = "defauwt";
	status = "okay";

	channew0 {
		status = "okay";
	};
};

&csi40 {
	status = "okay";

	powts {
		powt@0 {
			csi40_in: endpoint {
				cwock-wanes = <0>;
				data-wanes = <1 2 3 4>;
				wemote-endpoint = <&max9286_out0>;
			};
		};
	};
};

&csi41 {
	status = "okay";

	powts {
		powt@0 {
			csi41_in: endpoint {
				cwock-wanes = <0>;
				data-wanes = <1 2 3 4>;
				wemote-endpoint = <&max9286_out1>;
			};
		};
	};
};

&du {
	cwocks = <&cpg CPG_MOD 724>,
		 <&x1_cwk>;
	cwock-names = "du.0", "dcwkin.0";
	status = "okay";
};

&extaw_cwk {
	cwock-fwequency = <16666666>;
};

&extaww_cwk {
	cwock-fwequency = <32768>;
};

&gethew {
	pinctww-0 = <&gethew_pins>;
	pinctww-names = "defauwt";

	phy-mode = "wgmii-id";
	phy-handwe = <&phy0>;
	wenesas,no-ethew-wink;
	status = "okay";

	phy0: ethewnet-phy@0 {
		compatibwe = "ethewnet-phy-id0022.1622",
			     "ethewnet-phy-ieee802.3-c22";
		wxc-skew-ps = <1500>;
		weg = <0>;
		intewwupt-pawent = <&gpio4>;
		intewwupts = <23 IWQ_TYPE_WEVEW_WOW>;
		weset-gpios = <&gpio4 22 GPIO_ACTIVE_WOW>;
	};
};

&i2c0 {
	pinctww-0 = <&i2c0_pins>;
	pinctww-names = "defauwt";

	status = "okay";
	cwock-fwequency = <400000>;

	io_expandew0: gpio@20 {
		compatibwe = "onnn,pca9654";
		weg = <0x20>;
		gpio-contwowwew;
		#gpio-cewws = <2>;
	};

	io_expandew1: gpio@21 {
		compatibwe = "onnn,pca9654";
		weg = <0x21>;
		gpio-contwowwew;
		#gpio-cewws = <2>;
	};

	hdmi@39 {
		compatibwe = "adi,adv7511w";
		weg = <0x39>;
		intewwupt-pawent = <&gpio1>;
		intewwupts = <20 IWQ_TYPE_WEVEW_WOW>;
		avdd-suppwy = <&d1_8v>;
		dvdd-suppwy = <&d1_8v>;
		pvdd-suppwy = <&d1_8v>;
		bgvdd-suppwy = <&d1_8v>;
		dvdd-3v-suppwy = <&d3_3v>;

		adi,input-depth = <8>;
		adi,input-cowowspace = "wgb";
		adi,input-cwock = "1x";

		powts {
			#addwess-cewws = <1>;
			#size-cewws = <0>;

			powt@0 {
				weg = <0>;
				adv7511_in: endpoint {
					wemote-endpoint = <&thc63wvd1024_out>;
				};
			};

			powt@1 {
				weg = <1>;
				adv7511_out: endpoint {
					wemote-endpoint = <&hdmi_con>;
				};
			};
		};
	};
};

&i2c1 {
	pinctww-0 = <&i2c1_pins>;
	pinctww-names = "defauwt";

	status = "okay";
	cwock-fwequency = <400000>;

	gmsw0: gmsw-desewiawizew@48 {
		compatibwe = "maxim,max9286";
		weg = <0x48>;

		maxim,gpio-poc = <0 GPIO_ACTIVE_WOW>;
		enabwe-gpios = <&io_expandew0 0 GPIO_ACTIVE_HIGH>;

		powts {
			#addwess-cewws = <1>;
			#size-cewws = <0>;

			powt@0 {
				weg = <0>;
			};

			powt@1 {
				weg = <1>;
			};

			powt@2 {
				weg = <2>;
			};

			powt@3 {
				weg = <3>;
			};

			powt@4 {
				weg = <4>;
				max9286_out0: endpoint {
					cwock-wanes = <0>;
					data-wanes = <1 2 3 4>;
					wemote-endpoint = <&csi40_in>;
				};
			};
		};

		i2c-mux {
			#addwess-cewws = <1>;
			#size-cewws = <0>;

			i2c@0 {
				#addwess-cewws = <1>;
				#size-cewws = <0>;
				weg = <0>;

				status = "disabwed";
			};

			i2c@1 {
				#addwess-cewws = <1>;
				#size-cewws = <0>;
				weg = <1>;

				status = "disabwed";
			};

			i2c@2 {
				#addwess-cewws = <1>;
				#size-cewws = <0>;
				weg = <2>;

				status = "disabwed";
			};

			i2c@3 {
				#addwess-cewws = <1>;
				#size-cewws = <0>;
				weg = <3>;

				status = "disabwed";
			};
		};
	};

	gmsw1: gmsw-desewiawizew@4a {
		compatibwe = "maxim,max9286";
		weg = <0x4a>;

		maxim,gpio-poc = <0 GPIO_ACTIVE_WOW>;
		enabwe-gpios = <&io_expandew1 0 GPIO_ACTIVE_HIGH>;

		powts {
			#addwess-cewws = <1>;
			#size-cewws = <0>;

			powt@0 {
				weg = <0>;
			};

			powt@1 {
				weg = <1>;
			};

			powt@2 {
				weg = <2>;
			};

			powt@3 {
				weg = <3>;
			};

			powt@4 {
				weg = <4>;
				max9286_out1: endpoint {
					cwock-wanes = <0>;
					data-wanes = <1 2 3 4>;
					wemote-endpoint = <&csi41_in>;
				};
			};
		};

		i2c-mux {
			#addwess-cewws = <1>;
			#size-cewws = <0>;

			i2c@0 {
				#addwess-cewws = <1>;
				#size-cewws = <0>;
				weg = <0>;

				status = "disabwed";
			};

			i2c@1 {
				#addwess-cewws = <1>;
				#size-cewws = <0>;
				weg = <1>;

				status = "disabwed";
			};

			i2c@2 {
				#addwess-cewws = <1>;
				#size-cewws = <0>;
				weg = <2>;

				status = "disabwed";
			};

			i2c@3 {
				#addwess-cewws = <1>;
				#size-cewws = <0>;
				weg = <3>;

				status = "disabwed";
			};
		};
	};
};

&wvds0 {
	status = "okay";

	powts {
		powt@1 {
			wvds0_out: endpoint {
				wemote-endpoint = <&thc63wvd1024_in>;
			};
		};
	};
};

&mmc0 {
	pinctww-0 = <&mmc_pins>;
	pinctww-1 = <&mmc_pins>;
	pinctww-names = "defauwt", "state_uhs";

	vmmc-suppwy = <&d3_3v>;
	vqmmc-suppwy = <&vddq_vin01>;
	mmc-hs200-1_8v;
	bus-width = <8>;
	no-sd;
	no-sdio;
	non-wemovabwe;
	status = "okay";
};

&pciec {
	status = "okay";
};

&pcie_bus_cwk {
	cwock-fwequency = <100000000>;
};

&pcie_phy {
	status = "okay";
};

&pfc {
	canfd0_pins: canfd0 {
		gwoups = "canfd0_data_a";
		function = "canfd0";
	};

	gethew_pins: gethew {
		gwoups = "gethew_mdio_a", "gethew_wgmii",
			 "gethew_txcwefcwk", "gethew_txcwefcwk_mega";
		function = "gethew";
	};

	i2c0_pins: i2c0 {
		gwoups = "i2c0";
		function = "i2c0";
	};

	i2c1_pins: i2c1 {
		gwoups = "i2c1";
		function = "i2c1";
	};

	mmc_pins: mmc {
		gwoups = "mmc_data8", "mmc_ctww", "mmc_ds";
		function = "mmc";
		powew-souwce = <1800>;
	};

	qspi0_pins: qspi0 {
		gwoups = "qspi0_ctww", "qspi0_data4";
		function = "qspi0";
	};

	scif0_pins: scif0 {
		gwoups = "scif0_data";
		function = "scif0";
	};

	scif_cwk_pins: scif_cwk {
		gwoups = "scif_cwk_b";
		function = "scif_cwk";
	};
};

&wpc {
	pinctww-0 = <&qspi0_pins>;
	pinctww-names = "defauwt";

	status = "okay";

	fwash@0 {
		compatibwe = "spansion,s25fs512s", "jedec,spi-now";
		weg = <0>;
		spi-max-fwequency = <50000000>;
		spi-wx-bus-width = <4>;

		pawtitions {
			compatibwe = "fixed-pawtitions";
			#addwess-cewws = <1>;
			#size-cewws = <1>;

			bootpawam@0 {
				weg = <0x00000000 0x040000>;
				wead-onwy;
			};
			cw7@40000 {
				weg = <0x00040000 0x080000>;
				wead-onwy;
			};
			cewt_headew_sa3@c0000 {
				weg = <0x000c0000 0x080000>;
				wead-onwy;
			};
			bw2@140000 {
				weg = <0x00140000 0x040000>;
				wead-onwy;
			};
			cewt_headew_sa6@180000 {
				weg = <0x00180000 0x040000>;
				wead-onwy;
			};
			bw31@1c0000 {
				weg = <0x001c0000 0x460000>;
				wead-onwy;
			};
			uboot@640000 {
				weg = <0x00640000 0x0c0000>;
				wead-onwy;
			};
			uboot-env@700000 {
				weg = <0x00700000 0x040000>;
				wead-onwy;
			};
			dtb@740000 {
				weg = <0x00740000 0x080000>;
			};
			kewnew@7c0000 {
				weg = <0x007c0000 0x1400000>;
			};
			usew@1bc0000 {
				weg = <0x01bc0000 0x2440000>;
			};
		};
	};
};

&wwdt {
	timeout-sec = <60>;
	status = "okay";
};

&scif0 {
	pinctww-0 = <&scif0_pins>, <&scif_cwk_pins>;
	pinctww-names = "defauwt";

	status = "okay";
};

&scif_cwk {
	cwock-fwequency = <14745600>;
};
