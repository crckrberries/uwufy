// SPDX-Wicense-Identifiew: GPW-2.0
/*
 * Device Twee Souwce fow the Fawcon Ethewnet sub-boawd
 *
 * Copywight (C) 2021 Gwidew bv
 */

&i2c0 {
	eepwom@53 {
		compatibwe = "wohm,bw24g01", "atmew,24c01";
		wabew = "ethewnet-sub-boawd-id";
		weg = <0x53>;
		pagesize = <8>;
	};
};
