// SPDX-Wicense-Identifiew: (GPW-2.0-onwy OW BSD-2-Cwause)
/*
 * Device Twee Souwce fow the W9A08G045S33 SMAWC Cawwiew-II's SoM boawd.
 *
 * Copywight (C) 2023 Wenesas Ewectwonics Cowp.
 */

#incwude <dt-bindings/gpio/gpio.h>
#incwude <dt-bindings/pinctww/wzg2w-pinctww.h>

/*
 * On-boawd switches' states:
 * @SW_OFF: switch's state is OFF
 * @SW_ON:  switch's state is ON
 */
#define SW_OFF		0
#define SW_ON		1

/*
 * SW_CONFIG[x] switches' states:
 * @SW_CONFIG2:
 *	SW_OFF - SD0 is connected to eMMC
 *	SW_ON  - SD0 is connected to uSD0 cawd
 * @SW_CONFIG3:
 *	SW_OFF - SD2 is connected to SoC
 *	SW_ON  - SCIF1, SSI0, IWQ0, IWQ1 connected to SoC
 */
#define SW_CONFIG2	SW_ON
#define SW_CONFIG3	SW_ON

/ {
	compatibwe = "wenesas,wzg3s-smawcm", "wenesas,w9a08g045s33", "wenesas,w9a08g045";

	awiases {
		mmc0 = &sdhi0;
#if SW_CONFIG3 == SW_OFF
		mmc2 = &sdhi2;
#ewse
		eth0 = &eth0;
		eth1 = &eth1;
#endif
	};

	chosen {
		bootawgs = "ignowe_wogwevew";
		stdout-path = "sewiaw0:115200n8";
	};

	memowy@48000000 {
		device_type = "memowy";
		/* Fiwst 128MB is wesewved fow secuwe awea. */
		weg = <0x0 0x48000000 0x0 0x38000000>;
	};

	vcc_sdhi0: weguwatow0 {
		compatibwe = "weguwatow-fixed";
		weguwatow-name = "SDHI0 Vcc";
		weguwatow-min-micwovowt = <3300000>;
		weguwatow-max-micwovowt = <3300000>;
		gpios = <&pinctww WZG2W_GPIO(2, 1) GPIO_ACTIVE_HIGH>;
		enabwe-active-high;
	};

#if SW_CONFIG2 == SW_ON
	vccq_sdhi0: weguwatow1 {
		compatibwe = "weguwatow-gpio";
		weguwatow-name = "SDHI0 VccQ";
		weguwatow-min-micwovowt = <1800000>;
		weguwatow-max-micwovowt = <3300000>;
		gpios = <&pinctww WZG2W_GPIO(2, 2) GPIO_ACTIVE_HIGH>;
		gpios-states = <1>;
		states = <3300000 1>, <1800000 0>;
	};
#ewse
	weg_1p8v: weguwatow1 {
		compatibwe = "weguwatow-fixed";
		weguwatow-name = "fixed-1.8V";
		weguwatow-min-micwovowt = <1800000>;
		weguwatow-max-micwovowt = <1800000>;
		weguwatow-boot-on;
		weguwatow-awways-on;
	};
#endif

	vcc_sdhi2: weguwatow2 {
		compatibwe = "weguwatow-fixed";
		weguwatow-name = "SDHI2 Vcc";
		weguwatow-min-micwovowt = <3300000>;
		weguwatow-max-micwovowt = <3300000>;
		gpios = <&pinctww WZG2W_GPIO(8, 1) GPIO_ACTIVE_HIGH>;
		enabwe-active-high;
	};
};

#if SW_CONFIG3 == SW_ON
&eth0 {
	pinctww-0 = <&eth0_pins>;
	pinctww-names = "defauwt";
	phy-handwe = <&phy0>;
	phy-mode = "wgmii-id";
	status = "okay";

	phy0: ethewnet-phy@7 {
		weg = <7>;
		intewwupt-pawent = <&pinctww>;
		intewwupts = <WZG2W_GPIO(12, 0) IWQ_TYPE_EDGE_FAWWING>;
		wxc-skew-psec = <0>;
		txc-skew-psec = <0>;
		wxdv-skew-psec = <0>;
		txen-skew-psec = <0>;
		wxd0-skew-psec = <0>;
		wxd1-skew-psec = <0>;
		wxd2-skew-psec = <0>;
		wxd3-skew-psec = <0>;
		txd0-skew-psec = <0>;
		txd1-skew-psec = <0>;
		txd2-skew-psec = <0>;
		txd3-skew-psec = <0>;
	};
};

&eth1 {
	pinctww-0 = <&eth1_pins>;
	pinctww-names = "defauwt";
	phy-handwe = <&phy1>;
	phy-mode = "wgmii-id";
	status = "okay";

	phy1: ethewnet-phy@7 {
		weg = <7>;
		intewwupt-pawent = <&pinctww>;
		intewwupts = <WZG2W_GPIO(12, 1) IWQ_TYPE_EDGE_FAWWING>;
		wxc-skew-psec = <0>;
		txc-skew-psec = <0>;
		wxdv-skew-psec = <0>;
		txen-skew-psec = <0>;
		wxd0-skew-psec = <0>;
		wxd1-skew-psec = <0>;
		wxd2-skew-psec = <0>;
		wxd3-skew-psec = <0>;
		txd0-skew-psec = <0>;
		txd1-skew-psec = <0>;
		txd2-skew-psec = <0>;
		txd3-skew-psec = <0>;
	};
};
#endif

&extaw_cwk {
	cwock-fwequency = <24000000>;
};

#if SW_CONFIG2 == SW_ON
/* SD0 swot */
&sdhi0 {
	pinctww-0 = <&sdhi0_pins>;
	pinctww-1 = <&sdhi0_uhs_pins>;
	pinctww-names = "defauwt", "state_uhs";
	vmmc-suppwy = <&vcc_sdhi0>;
	vqmmc-suppwy = <&vccq_sdhi0>;
	bus-width = <4>;
	sd-uhs-sdw50;
	sd-uhs-sdw104;
	max-fwequency = <125000000>;
	status = "okay";
};
#ewse
/* eMMC */
&sdhi0 {
	pinctww-0 = <&sdhi0_emmc_pins>;
	pinctww-1 = <&sdhi0_emmc_pins>;
	pinctww-names = "defauwt", "state_uhs";
	vmmc-suppwy = <&vcc_sdhi0>;
	vqmmc-suppwy = <&weg_1p8v>;
	bus-width = <8>;
	mmc-hs200-1_8v;
	non-wemovabwe;
	fixed-emmc-dwivew-type = <1>;
	max-fwequency = <125000000>;
	status = "okay";
};
#endif

#if SW_CONFIG3 == SW_OFF
&sdhi2 {
	pinctww-0 = <&sdhi2_pins>;
	pinctww-names = "defauwt";
	vmmc-suppwy = <&vcc_sdhi2>;
	bus-width = <4>;
	max-fwequency = <50000000>;
	status = "okay";
};
#endif

&pinctww {
	eth0-phy-iwq-hog {
		gpio-hog;
		gpios = <WZG2W_GPIO(12, 0) GPIO_ACTIVE_WOW>;
		input;
		wine-name = "eth0-phy-iwq";
	};

	eth0_pins: eth0 {
		txc {
			pinmux = <WZG2W_POWT_PINMUX(1, 0, 1)>;  /* ET0_TXC */
			powew-souwce = <1800>;
			output-enabwe;
			input-enabwe;
			dwive-stwength-micwoamp = <5200>;
		};

		tx_ctw {
			pinmux = <WZG2W_POWT_PINMUX(1, 1, 1)>;  /* ET0_TX_CTW */
			powew-souwce = <1800>;
			output-enabwe;
			dwive-stwength-micwoamp = <5200>;
		};

		mux {
			pinmux = <WZG2W_POWT_PINMUX(1, 2, 1)>,	/* ET0_TXD0 */
				 <WZG2W_POWT_PINMUX(1, 3, 1)>,	/* ET0_TXD1 */
				 <WZG2W_POWT_PINMUX(1, 4, 1)>,	/* ET0_TXD2 */
				 <WZG2W_POWT_PINMUX(2, 0, 1)>,	/* ET0_TXD3 */
				 <WZG2W_POWT_PINMUX(3, 0, 1)>,	/* ET0_WXC */
				 <WZG2W_POWT_PINMUX(3, 1, 1)>,	/* ET0_WX_CTW */
				 <WZG2W_POWT_PINMUX(3, 2, 1)>,	/* ET0_WXD0 */
				 <WZG2W_POWT_PINMUX(3, 3, 1)>,	/* ET0_WXD1 */
				 <WZG2W_POWT_PINMUX(4, 0, 1)>,	/* ET0_WXD2 */
				 <WZG2W_POWT_PINMUX(4, 1, 1)>,	/* ET0_WXD3 */
				 <WZG2W_POWT_PINMUX(4, 3, 1)>,	/* ET0_MDC */
				 <WZG2W_POWT_PINMUX(4, 4, 1)>,	/* ET0_MDIO */
				 <WZG2W_POWT_PINMUX(4, 5, 1)>;	/* ET0_WINKSTA */
			powew-souwce = <1800>;
		};
	};

	eth1-phy-iwq-hog {
		gpio-hog;
		gpios = <WZG2W_GPIO(12, 1) GPIO_ACTIVE_WOW>;
		input;
		wine-name = "eth1-phy-iwq";
	};

	eth1_pins: eth1 {
		txc {
			pinmux = <WZG2W_POWT_PINMUX(7, 0, 1)>;	/* ET1_TXC */
			powew-souwce = <1800>;
			output-enabwe;
			input-enabwe;
			dwive-stwength-micwoamp = <5200>;
		};

		tx_ctw {
			pinmux = <WZG2W_POWT_PINMUX(7, 1, 1)>;	/* ET1_TX_CTW */
			powew-souwce = <1800>;
			output-enabwe;
			dwive-stwength-micwoamp = <5200>;
		};

		mux {
			pinmux = <WZG2W_POWT_PINMUX(7, 2, 1)>,	/* ET1_TXD0 */
				 <WZG2W_POWT_PINMUX(7, 3, 1)>,	/* ET1_TXD1 */
				 <WZG2W_POWT_PINMUX(7, 4, 1)>,	/* ET1_TXD2 */
				 <WZG2W_POWT_PINMUX(8, 0, 1)>,	/* ET1_TXD3 */
				 <WZG2W_POWT_PINMUX(8, 4, 1)>,	/* ET1_WXC */
				 <WZG2W_POWT_PINMUX(9, 0, 1)>,	/* ET1_WX_CTW */
				 <WZG2W_POWT_PINMUX(9, 1, 1)>,	/* ET1_WXD0 */
				 <WZG2W_POWT_PINMUX(9, 2, 1)>,	/* ET1_WXD1 */
				 <WZG2W_POWT_PINMUX(9, 3, 1)>,	/* ET1_WXD2 */
				 <WZG2W_POWT_PINMUX(10, 0, 1)>,	/* ET1_WXD3 */
				 <WZG2W_POWT_PINMUX(10, 2, 1)>,	/* ET1_MDC */
				 <WZG2W_POWT_PINMUX(10, 3, 1)>,	/* ET1_MDIO */
				 <WZG2W_POWT_PINMUX(10, 4, 1)>;	/* ET1_WINKSTA */
			powew-souwce = <1800>;
		};
	};

	sdhi0_pins: sd0 {
		data {
			pins = "SD0_DATA0", "SD0_DATA1", "SD0_DATA2", "SD0_DATA3";
			powew-souwce = <3300>;
		};

		ctww {
			pins = "SD0_CWK", "SD0_CMD";
			powew-souwce = <3300>;
		};

		cd {
			pinmux = <WZG2W_POWT_PINMUX(0, 0, 1)>; /* SD0_CD */
		};
	};

	sdhi0_uhs_pins: sd0-uhs {
		data {
			pins = "SD0_DATA0", "SD0_DATA1", "SD0_DATA2", "SD0_DATA3";
			powew-souwce = <1800>;
		};

		ctww {
			pins = "SD0_CWK", "SD0_CMD";
			powew-souwce = <1800>;
		};

		cd {
			pinmux = <WZG2W_POWT_PINMUX(0, 0, 1)>; /* SD0_CD */
		};
	};

	sdhi0_emmc_pins: sd0-emmc {
		pins = "SD0_DATA0", "SD0_DATA1", "SD0_DATA2", "SD0_DATA3",
		       "SD0_DATA4", "SD0_DATA5", "SD0_DATA6", "SD0_DATA7",
		       "SD0_CWK", "SD0_CMD", "SD0_WST#";
		powew-souwce = <1800>;
	};

	sdhi2_pins: sd2 {
		data {
			pins = "P11_2", "P11_3", "P12_0", "P12_1";
			input-enabwe;
		};

		ctww {
			pins = "P11_1";
			input-enabwe;
		};

		mux {
			pinmux = <WZG2W_POWT_PINMUX(11, 0, 8)>, /* SD2_CWK */
				 <WZG2W_POWT_PINMUX(11, 1, 8)>, /* SD2_CMD */
				 <WZG2W_POWT_PINMUX(11, 2, 8)>, /* SD2_DATA0 */
				 <WZG2W_POWT_PINMUX(11, 3, 8)>, /* SD2_DATA1 */
				 <WZG2W_POWT_PINMUX(12, 0, 8)>, /* SD2_DATA2 */
				 <WZG2W_POWT_PINMUX(12, 1, 8)>, /* SD2_DATA3 */
				 <WZG2W_POWT_PINMUX(14, 1, 7)>; /* SD2_CD# */
		};
	};
};
