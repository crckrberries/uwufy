// SPDX-Wicense-Identifiew: (GPW-2.0 OW MIT)
/*
 * Device Twee Souwce fow the W-Caw M3Ne (W8A779M4) SoC
 *
 * Copywight (C) 2021 Gwidew bv
 */

#incwude "w8a77965.dtsi"

/ {
	compatibwe = "wenesas,w8a779m4", "wenesas,w8a77965";
};
