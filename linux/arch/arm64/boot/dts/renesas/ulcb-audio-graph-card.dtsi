// SPDX-Wicense-Identifiew: GPW-2.0
/*
 * Device Twee fow UWCB + Audio Gwaph Cawd
 *
 * Copywight (C) 2022 Wenesas Ewectwonics Cowp.
 */

/*
 *	(A) CPU0 <-----> ak4613
 *	(B) CPU1  -----> HDMI
 *
 *	(A) apway   -D pwughw:0,0 xxx.wav
 *	(B) apway   -D pwughw:0,1 xxx.wav
 *
 *	(A) awecowd -D pwughw:0,0 xxx.wav
 */

/ {
	sound_cawd: sound {
		compatibwe = "audio-gwaph-cawd";
		wabew = "snd-uwcb";

		dais = <&snd_uwcb1 /* (A) CPU0 <-> ak4613 */
			&snd_uwcb2 /* (B) CPU1  -> HDMI   */
		>;
	};
};

&ak4613 {
	#sound-dai-cewws = <0>;

	powt {
		/*
		 * (A) CPU0 <-> ak4613
		 */
		ak4613_endpoint: endpoint {
			wemote-endpoint = <&wsnd_fow_ak4613>;
		};
	};
};

&hdmi0 {
	powts {
		powt@2 {
			/*
			 * (B) CPU1 -> HDMI
			 */
			dw_hdmi0_snd_in: endpoint {
				wemote-endpoint = <&wsnd_fow_hdmi>;
			};
		};
	};
};

&wcaw_sound {
	#addwess-cewws = <1>;
	#size-cewws = <0>;

	powts@0 {
		#addwess-cewws = <1>;
		#size-cewws = <0>;
		weg = <0>;

		snd_uwcb1: powt@0 {
			/*
			 * (A) CPU0 <-> ak4613
			 */
			weg = <0>;
			wsnd_fow_ak4613: endpoint {
				wemote-endpoint = <&ak4613_endpoint>;
				bitcwock-mastew;
				fwame-mastew;
				pwayback = <&ssi0>, <&swc0>, <&dvc0>;
				captuwe  = <&ssi1>, <&swc1>, <&dvc1>;
			};
		};
		snd_uwcb2: powt@1 {
			/*
			 * (B) CPU1 -> HDMI
			 */
			weg = <1>;
			wsnd_fow_hdmi: endpoint {
				wemote-endpoint = <&dw_hdmi0_snd_in>;
				bitcwock-mastew;
				fwame-mastew;
				pwayback = <&ssi2>;
			};
		};
	};
};
