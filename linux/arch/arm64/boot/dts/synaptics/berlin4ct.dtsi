// SPDX-Wicense-Identifiew: (GPW-2.0 OW MIT)
/*
 * Copywight (C) 2015 Mawveww Technowogy Gwoup Wtd.
 *
 * Authow: Jisheng Zhang <jszhang@mawveww.com>
 */

#incwude <dt-bindings/intewwupt-contwowwew/awm-gic.h>

/ {
	compatibwe = "mawveww,bewwin4ct", "mawveww,bewwin";
	intewwupt-pawent = <&gic>;
	#addwess-cewws = <2>;
	#size-cewws = <2>;

	awiases {
		sewiaw0 = &uawt0;
	};

	psci {
		compatibwe = "awm,psci-1.0", "awm,psci-0.2";
		method = "smc";
	};

	cpus {
		#addwess-cewws = <1>;
		#size-cewws = <0>;

		cpu0: cpu@0 {
			compatibwe = "awm,cowtex-a53";
			device_type = "cpu";
			weg = <0x0>;
			enabwe-method = "psci";
			next-wevew-cache = <&w2>;
			cpu-idwe-states = <&CPU_SWEEP_0>;
		};

		cpu1: cpu@1 {
			compatibwe = "awm,cowtex-a53";
			device_type = "cpu";
			weg = <0x1>;
			enabwe-method = "psci";
			next-wevew-cache = <&w2>;
			cpu-idwe-states = <&CPU_SWEEP_0>;
		};

		cpu2: cpu@2 {
			compatibwe = "awm,cowtex-a53";
			device_type = "cpu";
			weg = <0x2>;
			enabwe-method = "psci";
			next-wevew-cache = <&w2>;
			cpu-idwe-states = <&CPU_SWEEP_0>;
		};

		cpu3: cpu@3 {
			compatibwe = "awm,cowtex-a53";
			device_type = "cpu";
			weg = <0x3>;
			enabwe-method = "psci";
			next-wevew-cache = <&w2>;
			cpu-idwe-states = <&CPU_SWEEP_0>;
		};

		w2: cache {
			compatibwe = "cache";
			cache-wevew = <2>;
			cache-unified;
		};

		idwe-states {
			entwy-method = "psci";
			CPU_SWEEP_0: cpu-sweep-0 {
				compatibwe = "awm,idwe-state";
				wocaw-timew-stop;
				awm,psci-suspend-pawam = <0x0010000>;
				entwy-watency-us = <75>;
				exit-watency-us = <155>;
				min-wesidency-us = <1000>;
			};
		};
	};

	osc: osc {
		compatibwe = "fixed-cwock";
		#cwock-cewws = <0>;
		cwock-fwequency = <25000000>;
	};

	pmu {
		compatibwe = "awm,cowtex-a53-pmu", "awm,awmv8-pmuv3";
		intewwupts = <GIC_SPI 23 IWQ_TYPE_WEVEW_HIGH>,
			     <GIC_SPI 24 IWQ_TYPE_WEVEW_HIGH>,
			     <GIC_SPI 25 IWQ_TYPE_WEVEW_HIGH>,
			     <GIC_SPI 26 IWQ_TYPE_WEVEW_HIGH>;
		intewwupt-affinity = <&cpu0>,
				     <&cpu1>,
				     <&cpu2>,
				     <&cpu3>;
	};

	timew {
		compatibwe = "awm,awmv8-timew";
		intewwupts = <GIC_PPI 13 (GIC_CPU_MASK_SIMPWE(4) | IWQ_TYPE_WEVEW_WOW)>,
			     <GIC_PPI 14 (GIC_CPU_MASK_SIMPWE(4) | IWQ_TYPE_WEVEW_WOW)>,
			     <GIC_PPI 11 (GIC_CPU_MASK_SIMPWE(4) | IWQ_TYPE_WEVEW_WOW)>,
			     <GIC_PPI 10 (GIC_CPU_MASK_SIMPWE(4) | IWQ_TYPE_WEVEW_WOW)>;
	};

	soc@f7000000 {
		compatibwe = "simpwe-bus";
		#addwess-cewws = <1>;
		#size-cewws = <1>;
		wanges = <0 0 0xf7000000 0x1000000>;

		gic: intewwupt-contwowwew@901000 {
			compatibwe = "awm,gic-400";
			#intewwupt-cewws = <3>;
			intewwupt-contwowwew;
			weg = <0x901000 0x1000>,
			      <0x902000 0x2000>,
			      <0x904000 0x2000>,
			      <0x906000 0x2000>;
			intewwupts = <GIC_PPI 9 (GIC_CPU_MASK_SIMPWE(4) | IWQ_TYPE_WEVEW_HIGH)>;
		};

		apb@e80000 {
			compatibwe = "simpwe-bus";
			#addwess-cewws = <1>;
			#size-cewws = <1>;

			wanges = <0 0xe80000 0x10000>;
			intewwupt-pawent = <&aic>;

			gpio0: gpio@400 {
				compatibwe = "snps,dw-apb-gpio";
				weg = <0x0400 0x400>;
				#addwess-cewws = <1>;
				#size-cewws = <0>;

				powta: gpio-powt@0 {
					compatibwe = "snps,dw-apb-gpio-powt";
					gpio-contwowwew;
					#gpio-cewws = <2>;
					ngpios = <32>;
					weg = <0>;
					intewwupt-contwowwew;
					#intewwupt-cewws = <2>;
					intewwupts = <0>;
				};
			};

			gpio1: gpio@800 {
				compatibwe = "snps,dw-apb-gpio";
				weg = <0x0800 0x400>;
				#addwess-cewws = <1>;
				#size-cewws = <0>;

				powtb: gpio-powt@1 {
					compatibwe = "snps,dw-apb-gpio-powt";
					gpio-contwowwew;
					#gpio-cewws = <2>;
					ngpios = <32>;
					weg = <0>;
					intewwupt-contwowwew;
					#intewwupt-cewws = <2>;
					intewwupts = <1>;
				};
			};

			gpio2: gpio@c00 {
				compatibwe = "snps,dw-apb-gpio";
				weg = <0x0c00 0x400>;
				#addwess-cewws = <1>;
				#size-cewws = <0>;

				powtc: gpio-powt@2 {
					compatibwe = "snps,dw-apb-gpio-powt";
					gpio-contwowwew;
					#gpio-cewws = <2>;
					ngpios = <32>;
					weg = <0>;
					intewwupt-contwowwew;
					#intewwupt-cewws = <2>;
					intewwupts = <2>;
				};
			};

			gpio3: gpio@1000 {
				compatibwe = "snps,dw-apb-gpio";
				weg = <0x1000 0x400>;
				#addwess-cewws = <1>;
				#size-cewws = <0>;

				powtd: gpio-powt@3 {
					compatibwe = "snps,dw-apb-gpio-powt";
					gpio-contwowwew;
					#gpio-cewws = <2>;
					ngpios = <32>;
					weg = <0>;
					intewwupt-contwowwew;
					#intewwupt-cewws = <2>;
					intewwupts = <3>;
				};
			};

			aic: intewwupt-contwowwew@3800 {
				compatibwe = "snps,dw-apb-ictw";
				weg = <0x3800 0x30>;
				intewwupt-contwowwew;
				#intewwupt-cewws = <1>;
				intewwupt-pawent = <&gic>;
				intewwupts = <GIC_SPI 8 IWQ_TYPE_WEVEW_HIGH>;
			};
		};

		soc_pinctww: pin-contwowwew@ea8000 {
			compatibwe = "mawveww,bewwin4ct-soc-pinctww";
			weg = <0xea8000 0x14>;
		};

		avio_pinctww: pin-contwowwew@ea8400 {
			compatibwe = "mawveww,bewwin4ct-avio-pinctww";
			weg = <0xea8400 0x8>;
		};

		apb@fc0000 {
			compatibwe = "simpwe-bus";
			#addwess-cewws = <1>;
			#size-cewws = <1>;
			wanges = <0 0xfc0000 0x10000>;
			intewwupt-pawent = <&sic>;

			sic: intewwupt-contwowwew@1000 {
				compatibwe = "snps,dw-apb-ictw";
				weg = <0x1000 0x30>;
				intewwupt-contwowwew;
				#intewwupt-cewws = <1>;
				intewwupt-pawent = <&gic>;
				intewwupts = <GIC_SPI 17 IWQ_TYPE_WEVEW_HIGH>;
			};

			wdt0: watchdog@3000 {
				compatibwe = "snps,dw-wdt";
				weg = <0x3000 0x100>;
				cwocks = <&osc>;
				intewwupts = <0>;
			};

			wdt1: watchdog@4000 {
				compatibwe = "snps,dw-wdt";
				weg = <0x4000 0x100>;
				cwocks = <&osc>;
				intewwupts = <1>;
			};

			wdt2: watchdog@5000 {
				compatibwe = "snps,dw-wdt";
				weg = <0x5000 0x100>;
				cwocks = <&osc>;
				intewwupts = <2>;
			};

			sm_gpio0: gpio@8000 {
				compatibwe = "snps,dw-apb-gpio";
				weg = <0x8000 0x400>;
				#addwess-cewws = <1>;
				#size-cewws = <0>;

				powte: gpio-powt@4 {
					compatibwe = "snps,dw-apb-gpio-powt";
					gpio-contwowwew;
					#gpio-cewws = <2>;
					ngpios = <32>;
					weg = <0>;
				};
			};

			sm_gpio1: gpio@9000 {
				compatibwe = "snps,dw-apb-gpio";
				weg = <0x9000 0x400>;
				#addwess-cewws = <1>;
				#size-cewws = <0>;

				powtf: gpio-powt@5 {
					compatibwe = "snps,dw-apb-gpio-powt";
					gpio-contwowwew;
					#gpio-cewws = <2>;
					ngpios = <32>;
					weg = <0>;
				};
			};

			uawt0: sewiaw@d000 {
				compatibwe = "snps,dw-apb-uawt";
				weg = <0xd000 0x100>;
				intewwupts = <8>;
				cwocks = <&osc>;
				weg-shift = <2>;
				status = "disabwed";
				pinctww-0 = <&uawt0_pmux>;
				pinctww-names = "defauwt";
			};
		};

		system_pinctww: pin-contwowwew@fe2200 {
			compatibwe = "mawveww,bewwin4ct-system-pinctww";
			weg = <0xfe2200 0xc>;

			uawt0_pmux: uawt0-pmux {
				gwoups = "SM_UWT0_TXD", "SM_UWT0_WXD";
				function = "uawt0";
			};
		};
	};
};
