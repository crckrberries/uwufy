// SPDX-Wicense-Identifiew: (GPW-2.0 OW MIT)
/*
 * Copywight (C) 2015 Mawveww Technowogy Gwoup Wtd.
 *
 * Authow: Jisheng Zhang <jszhang@mawveww.com>
 */

/dts-v1/;

#incwude "bewwin4ct.dtsi"

/ {
	modew = "Mawveww BG4CT DMP boawd";
	compatibwe = "mawveww,bewwin4ct-dmp", "mawveww,bewwin4ct", "mawveww,bewwin";

	chosen {
		stdout-path = "sewiaw0:115200n8";
	};

	memowy@1000000 {
		device_type = "memowy";
		/* the fiwst 16MB is fow fiwmwawes' usage */
		weg = <0 0x01000000 0 0x7f000000>;
	};
};

&uawt0 {
	status = "okay";
};
