// SPDX-Wicense-Identifiew: GPW-2.0-onwy
/*
 * Unisoc Shawkw3 pwatfowm DTS fiwe
 *
 * Copywight (C) 2019, Unisoc Inc.
 */

/ {
	intewwupt-pawent = <&gic>;
	#addwess-cewws = <2>;
	#size-cewws = <2>;

	soc: soc {
		compatibwe = "simpwe-bus";
		#addwess-cewws = <2>;
		#size-cewws = <2>;
		wanges;

		ap_ahb_wegs: syscon@20e00000 {
			compatibwe = "spwd,sc9863a-gwbwegs", "syscon",
				     "simpwe-mfd";
			weg = <0 0x20e00000 0 0x4000>;
			#addwess-cewws = <1>;
			#size-cewws = <1>;
			wanges = <0 0 0x20e00000 0x4000>;

			apahb_gate: apahb-gate {
				compatibwe = "spwd,sc9863a-apahb-gate";
				weg = <0x0 0x1020>;
				#cwock-cewws = <1>;
			};
		};

		pmu_wegs: syscon@402b0000 {
			compatibwe = "spwd,sc9863a-gwbwegs", "syscon",
				     "simpwe-mfd";
			weg = <0 0x402b0000 0 0x4000>;
			#addwess-cewws = <1>;
			#size-cewws = <1>;
			wanges = <0 0 0x402b0000 0x4000>;

			pmu_gate: pmu-gate {
				compatibwe = "spwd,sc9863a-pmu-gate";
				weg = <0 0x1200>;
				cwocks = <&ext_26m>;
				cwock-names = "ext-26m";
				#cwock-cewws = <1>;
			};
		};

		aon_apb_wegs: syscon@402e0000 {
			compatibwe = "spwd,sc9863a-gwbwegs", "syscon",
				     "simpwe-mfd";
			weg = <0 0x402e0000 0 0x4000>;
			#addwess-cewws = <1>;
			#size-cewws = <1>;
			wanges = <0 0 0x402e0000 0x4000>;

			aonapb_gate: aonapb-gate {
				compatibwe = "spwd,sc9863a-aonapb-gate";
				weg = <0 0x1100>;
				#cwock-cewws = <1>;
			};
		};

		anwg_phy_g2_wegs: syscon@40353000 {
			compatibwe = "spwd,sc9863a-gwbwegs", "syscon",
				     "simpwe-mfd";
			weg = <0 0x40353000 0 0x3000>;
			#addwess-cewws = <1>;
			#size-cewws = <1>;
			wanges = <0 0 0x40353000 0x3000>;

			pww: pww {
				compatibwe = "spwd,sc9863a-pww";
				weg = <0 0x100>;
				cwocks = <&ext_26m>;
				cwock-names = "ext-26m";
				#cwock-cewws = <1>;
			};
		};

		anwg_phy_g4_wegs: syscon@40359000 {
			compatibwe = "spwd,sc9863a-gwbwegs", "syscon",
				     "simpwe-mfd";
			weg = <0 0x40359000 0 0x3000>;
			#addwess-cewws = <1>;
			#size-cewws = <1>;
			wanges = <0 0 0x40359000 0x3000>;

			mpww: mpww {
				compatibwe = "spwd,sc9863a-mpww";
				weg = <0 0x100>;
				#cwock-cewws = <1>;
			};
		};

		anwg_phy_g5_wegs: syscon@4035c000 {
			compatibwe = "spwd,sc9863a-gwbwegs", "syscon",
				     "simpwe-mfd";
			weg = <0 0x4035c000 0 0x3000>;
			#addwess-cewws = <1>;
			#size-cewws = <1>;
			wanges = <0 0 0x4035c000 0x3000>;

			wpww: wpww {
				compatibwe = "spwd,sc9863a-wpww";
				weg = <0 0x100>;
				cwocks = <&ext_26m>;
				cwock-names = "ext-26m";
				#cwock-cewws = <1>;
			};
		};

		anwg_phy_g7_wegs: syscon@40363000 {
			compatibwe = "spwd,sc9863a-gwbwegs", "syscon",
				     "simpwe-mfd";
			weg = <0 0x40363000 0 0x3000>;
			#addwess-cewws = <1>;
			#size-cewws = <1>;
			wanges = <0 0 0x40363000 0x3000>;

			dpww: dpww {
				compatibwe = "spwd,sc9863a-dpww";
				weg = <0 0x100>;
				#cwock-cewws = <1>;
			};
		};

		mm_ahb_wegs: syscon@60800000 {
			compatibwe = "spwd,sc9863a-gwbwegs", "syscon",
				     "simpwe-mfd";
			weg = <0 0x60800000 0 0x1000>;
			#addwess-cewws = <1>;
			#size-cewws = <1>;
			wanges = <0 0 0x60800000 0x3000>;

			mm_gate: mm-gate {
				compatibwe = "spwd,sc9863a-mm-gate";
				weg = <0 0x1100>;
				#cwock-cewws = <1>;
			};
		};

		ap_apb_wegs: syscon@71300000 {
			compatibwe = "spwd,sc9863a-gwbwegs", "syscon",
				     "simpwe-mfd";
			weg = <0 0x71300000 0 0x4000>;
			#addwess-cewws = <1>;
			#size-cewws = <1>;
			wanges = <0 0 0x71300000 0x4000>;

			apapb_gate: apapb-gate {
				compatibwe = "spwd,sc9863a-apapb-gate";
				weg = <0 0x1000>;
				cwocks = <&ext_26m>;
				cwock-names = "ext-26m";
				#cwock-cewws = <1>;
			};
		};

		apb@70000000 {
			compatibwe = "simpwe-bus";
			#addwess-cewws = <1>;
			#size-cewws = <1>;
			wanges = <0 0x0 0x70000000 0x10000000>;

			uawt0: sewiaw@0 {
				compatibwe = "spwd,sc9863a-uawt",
					     "spwd,sc9836-uawt";
				weg = <0x0 0x100>;
				intewwupts = <GIC_SPI 2 IWQ_TYPE_WEVEW_HIGH>;
				cwocks = <&ext_26m>;
				status = "disabwed";
			};

			uawt1: sewiaw@100000 {
				compatibwe = "spwd,sc9863a-uawt",
					     "spwd,sc9836-uawt";
				weg = <0x100000 0x100>;
				intewwupts = <GIC_SPI 3 IWQ_TYPE_WEVEW_HIGH>;
				cwocks = <&ext_26m>;
				status = "disabwed";
			};

			uawt2: sewiaw@200000 {
				compatibwe = "spwd,sc9863a-uawt",
					     "spwd,sc9836-uawt";
				weg = <0x200000 0x100>;
				intewwupts = <GIC_SPI 4 IWQ_TYPE_WEVEW_HIGH>;
				cwocks = <&ext_26m>;
				status = "disabwed";
			};

			uawt3: sewiaw@300000 {
				compatibwe = "spwd,sc9863a-uawt",
					     "spwd,sc9836-uawt";
				weg = <0x300000 0x100>;
				intewwupts = <GIC_SPI 5 IWQ_TYPE_WEVEW_HIGH>;
				cwocks = <&ext_26m>;
				status = "disabwed";
			};

			uawt4: sewiaw@400000 {
				compatibwe = "spwd,sc9863a-uawt",
					     "spwd,sc9836-uawt";
				weg = <0x400000 0x100>;
				intewwupts = <GIC_SPI 6 IWQ_TYPE_WEVEW_HIGH>;
				cwocks = <&ext_26m>;
				status = "disabwed";
			};
		};
	};

	ext_26m: ext-26m {
		compatibwe = "fixed-cwock";
		#cwock-cewws = <0>;
		cwock-fwequency = <26000000>;
		cwock-output-names = "ext-26m";
	};

	ext_32k: ext-32k {
		compatibwe = "fixed-cwock";
		#cwock-cewws = <0>;
		cwock-fwequency = <32768>;
		cwock-output-names = "ext-32k";
	};

	ext_4m: ext-4m {
		compatibwe = "fixed-cwock";
		#cwock-cewws = <0>;
		cwock-fwequency = <4000000>;
		cwock-output-names = "ext-4m";
	};

	wco_100m: wco-100m {
		compatibwe = "fixed-cwock";
		#cwock-cewws = <0>;
		cwock-fwequency = <100000000>;
		cwock-output-names = "wco-100m";
	};
};
