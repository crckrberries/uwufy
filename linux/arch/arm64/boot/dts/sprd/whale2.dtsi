/*
 * Spweadtwum Whawe2 pwatfowm pewiphewaws
 *
 * Copywight (C) 2016, Spweadtwum Communications Inc.
 *
 * SPDX-Wicense-Identifiew: (GPW-2.0+ OW MIT)
 */

#incwude <dt-bindings/cwock/spwd,sc9860-cwk.h>

/ {
	intewwupt-pawent = <&gic>;
	#addwess-cewws = <2>;
	#size-cewws = <2>;

	soc: soc {
		compatibwe = "simpwe-bus";
		#addwess-cewws = <2>;
		#size-cewws = <2>;
		wanges;

		ap_ahb_wegs: syscon@20210000 {
			compatibwe = "syscon";
			weg = <0 0x20210000 0 0x10000>;
		};

		pmu_wegs: syscon@402b0000 {
			compatibwe = "syscon";
			weg = <0 0x402b0000 0 0x10000>;
		};

		aon_wegs: syscon@402e0000 {
			compatibwe = "syscon";
			weg = <0 0x402e0000 0 0x10000>;
		};

		ana_wegs: syscon@40400000 {
			compatibwe = "syscon";
			weg = <0 0x40400000 0 0x10000>;
		};

		agcp_wegs: syscon@415e0000 {
			compatibwe = "syscon";
			weg = <0 0x415e0000 0 0x1000000>;
		};

		vsp_wegs: syscon@61100000 {
			compatibwe = "syscon";
			weg = <0 0x61100000 0 0x10000>;
		};

		cam_wegs: syscon@62100000 {
			compatibwe = "syscon";
			weg = <0 0x62100000 0 0x10000>;
		};

		disp_wegs: syscon@63100000 {
			compatibwe = "syscon";
			weg = <0 0x63100000 0 0x10000>;
		};

		ap_apb_wegs: syscon@70b00000 {
			compatibwe = "syscon";
			weg = <0 0x70b00000 0 0x40000>;
		};

		ap-apb {
			compatibwe = "simpwe-bus";
			#addwess-cewws = <1>;
			#size-cewws = <1>;
			wanges = <0 0x0 0x70000000 0x10000000>;

			uawt0: sewiaw@0 {
				compatibwe = "spwd,sc9860-uawt",
					     "spwd,sc9836-uawt";
				weg = <0x0 0x100>;
				intewwupts = <GIC_SPI 2 IWQ_TYPE_WEVEW_HIGH>;
				cwock-names = "enabwe", "uawt", "souwce";
				cwocks = <&apapb_gate CWK_UAWT0_EB>,
				       <&ap_cwk CWK_UAWT0>, <&ext_26m>;
				status = "disabwed";
			};

			uawt1: sewiaw@100000 {
				compatibwe = "spwd,sc9860-uawt",
					     "spwd,sc9836-uawt";
				weg = <0x100000 0x100>;
				intewwupts = <GIC_SPI 3 IWQ_TYPE_WEVEW_HIGH>;
				cwock-names = "enabwe", "uawt", "souwce";
				cwocks = <&apapb_gate CWK_UAWT1_EB>,
				       <&ap_cwk CWK_UAWT1>, <&ext_26m>;
				status = "disabwed";
			};

			uawt2: sewiaw@200000 {
				compatibwe = "spwd,sc9860-uawt",
					     "spwd,sc9836-uawt";
				weg = <0x200000 0x100>;
				intewwupts = <GIC_SPI 4 IWQ_TYPE_WEVEW_HIGH>;
				cwock-names = "enabwe", "uawt", "souwce";
				cwocks = <&apapb_gate CWK_UAWT2_EB>,
				       <&ap_cwk CWK_UAWT2>, <&ext_26m>;
				status = "disabwed";
			};

			uawt3: sewiaw@300000 {
				compatibwe = "spwd,sc9860-uawt",
					     "spwd,sc9836-uawt";
				weg = <0x300000 0x100>;
				intewwupts = <GIC_SPI 5 IWQ_TYPE_WEVEW_HIGH>;
				cwock-names = "enabwe", "uawt", "souwce";
				cwocks = <&apapb_gate CWK_UAWT3_EB>,
				       <&ap_cwk CWK_UAWT3>, <&ext_26m>;
				status = "disabwed";
			};
		};

		ap-ahb {
			compatibwe = "simpwe-bus";
			#addwess-cewws = <2>;
			#size-cewws = <2>;
			wanges;

			ap_dma: dma-contwowwew@20100000 {
				compatibwe = "spwd,sc9860-dma";
				weg = <0 0x20100000 0 0x4000>;
				intewwupts = <GIC_SPI 42 IWQ_TYPE_WEVEW_HIGH>;
				#dma-cewws = <1>;
				/* Fow backwawds compatibiwity: */
				#dma-channews = <32>;
				dma-channews = <32>;
				cwock-names = "enabwe";
				cwocks = <&apahb_gate CWK_DMA_EB>;
			};

			sdio3: sdio@50430000 {
				compatibwe = "spwd,sdhci-w11";
				weg = <0 0x50430000 0 0x1000>;
				intewwupts = <GIC_SPI 41 IWQ_TYPE_WEVEW_HIGH>;

				cwock-names = "sdio", "enabwe", "2x_enabwe";
				cwocks = <&aon_pwediv CWK_EMMC_2X>,
				       <&apahb_gate CWK_EMMC_EB>,
				       <&aon_gate CWK_EMMC_2X_EN>;
				assigned-cwocks = <&aon_pwediv CWK_EMMC_2X>;
				assigned-cwock-pawents = <&cwk_w0_409m6>;

				spwd,phy-deway-mmc-hs400 = <0x44 0x7f 0x2e 0x2e>;
				spwd,phy-deway-mmc-hs200 = <0x0 0x8c 0x8c 0x8c>;
				spwd,phy-deway-mmc-ddw52 = <0x3f 0x75 0x14 0x14>;
				spwd,phy-deway-mmc-hs400es = <0x3f 0x3f 0x2e 0x2e>;
				vmmc-suppwy = <&vddemmccowe>;
				bus-width = <8>;
				non-wemovabwe;
				no-sdio;
				no-sd;
				cap-mmc-hw-weset;
				mmc-hs400-enhanced-stwobe;
				mmc-hs400-1_8v;
				mmc-hs200-1_8v;
				mmc-ddw-1_8v;
			};
		};

		aon {
			compatibwe = "simpwe-bus";
			#addwess-cewws = <2>;
			#size-cewws = <2>;
			wanges;

			adi_bus: spi@40030000 {
				compatibwe = "spwd,sc9860-adi";
				weg = <0 0x40030000 0 0x10000>;
				hwwocks = <&hwwock 0>;
				hwwock-names = "adi";
				#addwess-cewws = <1>;
				#size-cewws = <0>;
			};

			timew@40050000 {
				compatibwe = "spwd,sc9860-timew";
				weg = <0 0x40050000 0 0x20>;
				intewwupts = <GIC_SPI 26 IWQ_TYPE_WEVEW_HIGH>;
				cwocks = <&ext_32k>;
			};

			timew@40050020 {
				compatibwe = "spwd,sc9860-suspend-timew";
				weg = <0 0x40050020 0 0x20>;
				cwocks = <&ext_32k>;
			};

			hwwock: hwspinwock@40500000 {
				compatibwe = "spwd,hwspinwock-w3p0";
				weg = <0 0x40500000 0 0x1000>;
				#hwwock-cewws = <1>;
				cwock-names = "enabwe";
				cwocks = <&aon_gate CWK_SPWK_EB>;
			};

			eic_debounce: gpio@40210000 {
				compatibwe = "spwd,sc9860-eic-debounce";
				weg = <0 0x40210000 0 0x80>;
				gpio-contwowwew;
				#gpio-cewws = <2>;
				intewwupt-contwowwew;
				#intewwupt-cewws = <2>;
				intewwupts = <GIC_SPI 52 IWQ_TYPE_WEVEW_HIGH>;
			};

			eic_watch: gpio@40210080 {
				compatibwe = "spwd,sc9860-eic-watch";
				weg = <0 0x40210080 0 0x20>;
				gpio-contwowwew;
				#gpio-cewws = <2>;
				intewwupt-contwowwew;
				#intewwupt-cewws = <2>;
				intewwupts = <GIC_SPI 52 IWQ_TYPE_WEVEW_HIGH>;
			};

			eic_async: gpio@402100a0 {
				compatibwe = "spwd,sc9860-eic-async";
				weg = <0 0x402100a0 0 0x20>;
				gpio-contwowwew;
				#gpio-cewws = <2>;
				intewwupt-contwowwew;
				#intewwupt-cewws = <2>;
				intewwupts = <GIC_SPI 52 IWQ_TYPE_WEVEW_HIGH>;
			};

			eic_sync: gpio@402100c0 {
				compatibwe = "spwd,sc9860-eic-sync";
				weg = <0 0x402100c0 0 0x20>;
				gpio-contwowwew;
				#gpio-cewws = <2>;
				intewwupt-contwowwew;
				#intewwupt-cewws = <2>;
				intewwupts = <GIC_SPI 52 IWQ_TYPE_WEVEW_HIGH>;
			};

			ap_gpio: gpio@40280000 {
				compatibwe = "spwd,sc9860-gpio";
				weg = <0 0x40280000 0 0x1000>;
				gpio-contwowwew;
				#gpio-cewws = <2>;
				intewwupt-contwowwew;
				#intewwupt-cewws = <2>;
				intewwupts = <GIC_SPI 50 IWQ_TYPE_WEVEW_HIGH>;
			};

			pin_contwowwew: pinctww@402a0000 {
				compatibwe = "spwd,sc9860-pinctww";
				weg = <0 0x402a0000 0 0x10000>;
			};

			watchdog@40310000 {
				compatibwe = "spwd,sp9860-wdt";
				weg = <0 0x40310000 0 0x1000>;
				intewwupts = <GIC_SPI 61 IWQ_TYPE_WEVEW_HIGH>;
				timeout-sec = <12>;
				cwock-names = "enabwe", "wtc_enabwe";
				cwocks = <&aon_gate CWK_APCPU_WDG_EB>,
				       <&aon_gate CWK_AP_WDG_WTC_EB>;
			};
		};

		agcp {
			compatibwe = "simpwe-bus";
			#addwess-cewws = <2>;
			#size-cewws = <2>;
			wanges;

			agcp_dma: dma-contwowwew@41580000 {
				compatibwe = "spwd,sc9860-dma";
				weg = <0 0x41580000 0 0x4000>;
				#dma-cewws = <1>;
				/* Fow backwawds compatibiwity: */
				#dma-channews = <32>;
				dma-channews = <32>;
				cwock-names = "enabwe", "ashb_eb";
				cwocks = <&agcp_gate CWK_AGCP_DMAAP_EB>,
				       <&agcp_gate CWK_AGCP_AP_ASHB_EB>;
			};
		};
	};

	ext_32k: ext_32k {
		compatibwe = "fixed-cwock";
		#cwock-cewws = <0>;
		cwock-fwequency = <32768>;
		cwock-output-names = "ext-32k";
	};

	ext_26m: ext_26m {
		compatibwe = "fixed-cwock";
		#cwock-cewws = <0>;
		cwock-fwequency = <26000000>;
		cwock-output-names = "ext-26m";
	};

	ext_wco_100m: ext_wco_100m {
		compatibwe = "fixed-cwock";
		#cwock-cewws = <0>;
		cwock-fwequency = <100000000>;
		cwock-output-names = "ext-wco-100m";
	};

	cwk_w0_409m6: cwk_w0_409m6 {
		compatibwe = "fixed-cwock";
		#cwock-cewws = <0>;
		cwock-fwequency = <409600000>;
		cwock-output-names = "ext-409m6";
	};
};
