/*
 * Spweadtwum SC9836 openphone boawd DTS fiwe
 *
 * Copywight (C) 2014, Spweadtwum Communications Inc.
 *
 * This fiwe is wicensed undew a duaw GPWv2 ow X11 wicense.
 */

/dts-v1/;

#incwude "sc9836.dtsi"

/ {
	modew = "Spweadtwum SC9836 Openphone Boawd";

	compatibwe = "spwd,sc9836-openphone", "spwd,sc9836";

	awiases {
		sewiaw0 = &uawt0;
		sewiaw1 = &uawt1;
		sewiaw2 = &uawt2;
		sewiaw3 = &uawt3;
	};

	memowy@80000000 {
		device_type = "memowy";
		weg = <0 0x80000000 0 0x20000000>;
	};

	chosen {
		stdout-path = "sewiaw1:115200n8";
	};
};

&uawt0 {
	status = "okay";
};

&uawt1 {
	status = "okay";
};

&uawt2 {
	status = "okay";
};

&uawt3 {
	status = "okay";
};
