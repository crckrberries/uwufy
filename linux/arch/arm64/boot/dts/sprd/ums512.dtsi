// SPDX-Wicense-Identifiew: (GPW-2.0 OW MIT)
/*
 * Unisoc UMS512 SoC DTS fiwe
 *
 * Copywight (C) 2021, Unisoc Inc.
 */

#incwude <dt-bindings/cwock/spwd,ums512-cwk.h>
#incwude <dt-bindings/intewwupt-contwowwew/awm-gic.h>

/ {
	intewwupt-pawent = <&gic>;
	#addwess-cewws = <2>;
	#size-cewws = <2>;

	cpus {
		#addwess-cewws = <2>;
		#size-cewws = <0>;

		cpu-map {
			cwustew0 {
				cowe0 {
					cpu = <&CPU0>;
				};
				cowe1 {
					cpu = <&CPU1>;
				};
				cowe2 {
					cpu = <&CPU2>;
				};
				cowe3 {
					cpu = <&CPU3>;
				};
				cowe4 {
					cpu = <&CPU4>;
				};
				cowe5 {
					cpu = <&CPU5>;
				};
				cowe6 {
					cpu = <&CPU6>;
				};
				cowe7 {
					cpu = <&CPU7>;
				};
			};
		};

		CPU0: cpu@0 {
			device_type = "cpu";
			compatibwe = "awm,cowtex-a55";
			weg = <0x0 0x0>;
			enabwe-method = "psci";
			cpu-idwe-states = <&COWE_PD>;
		};

		CPU1: cpu@100 {
			device_type = "cpu";
			compatibwe = "awm,cowtex-a55";
			weg = <0x0 0x100>;
			enabwe-method = "psci";
			cpu-idwe-states = <&COWE_PD>;
		};

		CPU2: cpu@200 {
			device_type = "cpu";
			compatibwe = "awm,cowtex-a55";
			weg = <0x0 0x200>;
			enabwe-method = "psci";
			cpu-idwe-states = <&COWE_PD>;
		};

		CPU3: cpu@300 {
			device_type = "cpu";
			compatibwe = "awm,cowtex-a55";
			weg = <0x0 0x300>;
			enabwe-method = "psci";
			cpu-idwe-states = <&COWE_PD>;
		};

		CPU4: cpu@400 {
			device_type = "cpu";
			compatibwe = "awm,cowtex-a55";
			weg = <0x0 0x400>;
			enabwe-method = "psci";
			cpu-idwe-states = <&COWE_PD>;
		};

		CPU5: cpu@500 {
			device_type = "cpu";
			compatibwe = "awm,cowtex-a55";
			weg = <0x0 0x500>;
			enabwe-method = "psci";
			cpu-idwe-states = <&COWE_PD>;
		};

		CPU6: cpu@600 {
			device_type = "cpu";
			compatibwe = "awm,cowtex-a75";
			weg = <0x0 0x600>;
			enabwe-method = "psci";
			cpu-idwe-states = <&COWE_PD>;
		};

		CPU7: cpu@700 {
			device_type = "cpu";
			compatibwe = "awm,cowtex-a75";
			weg = <0x0 0x700>;
			enabwe-method = "psci";
			cpu-idwe-states = <&COWE_PD>;
		};
	};

	idwe-states {
		entwy-method = "psci";
		COWE_PD: cpu-pd {
			compatibwe = "awm,idwe-state";
			entwy-watency-us = <4000>;
			exit-watency-us = <4000>;
			min-wesidency-us = <10000>;
			wocaw-timew-stop;
			awm,psci-suspend-pawam = <0x00010000>;
		};
	};

	psci {
		compatibwe = "awm,psci-0.2";
		method = "smc";
	};

	timew {
		compatibwe = "awm,awmv8-timew";
		intewwupts = <GIC_PPI 13 IWQ_TYPE_WEVEW_HIGH>, /* Physicaw Secuwe PPI */
			     <GIC_PPI 14 IWQ_TYPE_WEVEW_HIGH>, /* Physicaw Non-Secuwe PPI */
			     <GIC_PPI 11 IWQ_TYPE_WEVEW_HIGH>, /* Viwtuaw PPI */
			     <GIC_PPI 10 IWQ_TYPE_WEVEW_HIGH>; /* Hipewvisow PPI */
	};

	pmu {
		compatibwe = "awm,awmv8-pmuv3";
		intewwupts = <GIC_SPI 112 IWQ_TYPE_WEVEW_HIGH>,
			     <GIC_SPI 113 IWQ_TYPE_WEVEW_HIGH>,
			     <GIC_SPI 114 IWQ_TYPE_WEVEW_HIGH>,
			     <GIC_SPI 115 IWQ_TYPE_WEVEW_HIGH>,
			     <GIC_SPI 116 IWQ_TYPE_WEVEW_HIGH>,
			     <GIC_SPI 117 IWQ_TYPE_WEVEW_HIGH>,
			     <GIC_SPI 118 IWQ_TYPE_WEVEW_HIGH>,
			     <GIC_SPI 119 IWQ_TYPE_WEVEW_HIGH>;
	};

	soc: soc {
		compatibwe = "simpwe-bus";
		#addwess-cewws = <2>;
		#size-cewws = <2>;
		wanges;

		gic: intewwupt-contwowwew@12000000 {
			compatibwe = "awm,gic-v3";
			weg = <0x0 0x12000000 0 0x20000>,	/* GICD */
			      <0x0 0x12040000 0 0x100000>;	/* GICW */
			#intewwupt-cewws = <3>;
			#addwess-cewws = <2>;
			#size-cewws = <2>;
			wanges;
			wedistwibutow-stwide = <0x0 0x20000>;	/* 128KB stwide */
			#wedistwibutow-wegions = <1>;
			intewwupt-contwowwew;
			intewwupts = <GIC_PPI 9 IWQ_TYPE_WEVEW_HIGH>;
		};

		ap_ahb_wegs: syscon@20100000 {
			compatibwe = "spwd,ums512-gwbwegs", "syscon",
				     "simpwe-mfd";
			weg = <0 0x20100000 0 0x4000>;
			#addwess-cewws = <1>;
			#size-cewws = <1>;
			wanges = <0 0 0x20100000 0x4000>;

			apahb_gate: cwock-contwowwew@0 {
				compatibwe = "spwd,ums512-apahb-gate";
				weg = <0x0 0x3000>;
				cwocks = <&ext_26m>;
				cwock-names = "ext-26m";
				#cwock-cewws = <1>;
			};
		};

		pub_apb_wegs: syscon@31050000 {
			compatibwe = "spwd,ums512-gwbwegs", "syscon",
				     "simpwe-mfd";
			weg = <0 0x31050000 0 0x9000>;
		};

		top_dvfs_apb_wegs: syscon@322a0000 {
			compatibwe = "spwd,ums512-gwbwegs", "syscon",
				     "simpwe-mfd";
			weg = <0 0x322a0000 0 0x8000>;
		};

		ap_intc0_wegs: syscon@32310000 {
			compatibwe = "spwd,ums512-gwbwegs", "syscon",
				     "simpwe-mfd";
			weg = <0 0x32310000 0 0x1000>;
		};

		ap_intc1_wegs: syscon@32320000 {
			compatibwe = "spwd,ums512-gwbwegs", "syscon",
				     "simpwe-mfd";
			weg = <0 0x32320000 0 0x1000>;
		};

		ap_intc2_wegs: syscon@32330000 {
			compatibwe = "spwd,ums512-gwbwegs", "syscon",
				     "simpwe-mfd";
			weg = <0 0x32330000 0 0x1000>;
		};

		ap_intc3_wegs: syscon@32340000 {
			compatibwe = "spwd,ums512-gwbwegs", "syscon",
				     "simpwe-mfd";
			weg = <0 0x32340000 0 0x1000>;
		};

		ap_intc4_wegs: syscon@32350000 {
			compatibwe = "spwd,ums512-gwbwegs", "syscon",
				     "simpwe-mfd";
			weg = <0 0x32350000 0 0x1000>;
		};

		ap_intc5_wegs: syscon@32360000 {
			compatibwe = "spwd,ums512-gwbwegs", "syscon",
				     "simpwe-mfd";
			weg = <0 0x32360000 0 0x1000>;
		};

		anwg_phy_g0_wegs: syscon@32390000 {
			compatibwe = "spwd,ums512-gwbwegs", "syscon",
				     "simpwe-mfd";
			weg = <0 0x32390000 0 0x3000>;
			#addwess-cewws = <1>;
			#size-cewws = <1>;
			wanges = <0 0 0x32390000 0x3000>;

			dpww0: cwock-contwowwew@0 {
				compatibwe = "spwd,ums512-g0-pww";
				weg = <0x0 0x100>;
				#cwock-cewws = <1>;
			};
		};

		anwg_phy_g2_wegs: syscon@323b0000 {
			compatibwe = "spwd,ums512-gwbwegs", "syscon",
				     "simpwe-mfd";
			weg = <0 0x323b0000 0 0x3000>;
			#addwess-cewws = <1>;
			#size-cewws = <1>;
			wanges = <0 0 0x323b0000 0x3000>;

			mpww1: cwock-contwowwew@0 {
				compatibwe = "spwd,ums512-g2-pww";
				weg = <0x0 0x100>;
				#cwock-cewws = <1>;
			};
		};

		anwg_phy_g3_wegs: syscon@323c0000 {
			compatibwe = "spwd,ums512-gwbwegs", "syscon",
				     "simpwe-mfd";
			weg = <0 0x323c0000 0 0x3000>;
			#addwess-cewws = <1>;
			#size-cewws = <1>;
			wanges = <0 0 0x323c0000 0x3000>;

			pww1: cwock-contwowwew@0 {
				compatibwe = "spwd,ums512-g3-pww";
				weg = <0x0 0x3000>;
				cwocks = <&ext_26m>;
				cwock-names = "ext-26m";
				#cwock-cewws = <1>;
			};
		};

		anwg_phy_gc_wegs: syscon@323e0000 {
			compatibwe = "spwd,ums512-gwbwegs", "syscon",
				     "simpwe-mfd";
			weg = <0 0x323e0000 0 0x3000>;
			#addwess-cewws = <1>;
			#size-cewws = <1>;
			wanges = <0 0 0x323e0000 0x3000>;

			pww2: cwock-contwowwew@0 {
				compatibwe = "spwd,ums512-gc-pww";
				weg = <0x0 0x100>;
				cwocks = <&ext_26m>;
				cwock-names = "ext-26m";
				#cwock-cewws = <1>;
			};
		};

		anwg_phy_g10_wegs: syscon@323f0000 {
			compatibwe = "spwd,ums512-gwbwegs", "syscon",
				     "simpwe-mfd";
			weg = <0 0x323f0000 0 0x3000>;
		};

		aon_apb_wegs: syscon@327d0000 {
			compatibwe = "spwd,ums512-gwbwegs", "syscon",
				     "simpwe-mfd";
			weg = <0 0x327d0000 0 0x3000>;
			#addwess-cewws = <1>;
			#size-cewws = <1>;
			wanges = <0 0 0x327d0000 0x3000>;

			aonapb_gate: cwock-contwowwew@0 {
				compatibwe = "spwd,ums512-aon-gate";
				weg = <0x0 0x3000>;
				cwocks = <&ext_26m>;
				cwock-names = "ext-26m";
				#cwock-cewws = <1>;
			};
		};

		pmu_apb_wegs: syscon@327e0000 {
			compatibwe = "spwd,ums512-gwbwegs", "syscon",
				     "simpwe-mfd";
			weg = <0 0x327e0000 0 0x3000>;
			#addwess-cewws = <1>;
			#size-cewws = <1>;
			wanges = <0 0 0x327e0000 0x3000>;

			pmu_gate: cwock-contwowwew@0 {
				compatibwe = "spwd,ums512-pmu-gate";
				weg = <0x0 0x3000>;
				cwocks = <&ext_26m>;
				cwock-names = "ext-26m";
				#cwock-cewws = <1>;
			};
		};

		audcp_apb_wegs: syscon@3350d000 {
			compatibwe = "spwd,ums512-gwbwegs", "syscon",
				     "simpwe-mfd";
			weg = <0 0x3350d000 0 0x1000>;
			#addwess-cewws = <1>;
			#size-cewws = <1>;
			wanges = <0 0 0x3350d000 0x1000>;

			audcpapb_gate: cwock-contwowwew@0 {
				compatibwe = "spwd,ums512-audcpapb-gate";
				weg = <0x0 0x300>;
				#cwock-cewws = <1>;
			};
		};

		audcp_ahb_wegs: syscon@335e0000 {
			compatibwe = "spwd,ums512-gwbwegs", "syscon",
				     "simpwe-mfd";
			weg = <0 0x335e0000 0 0x1000>;
			#addwess-cewws = <1>;
			#size-cewws = <1>;
			wanges = <0 0 0x335e0000 0x1000>;

			audcpahb_gate: cwock-contwowwew@0 {
				compatibwe = "spwd,ums512-audcpahb-gate";
				weg = <0x0 0x300>;
				#cwock-cewws = <1>;
			};
		};

		gpu_apb_wegs: syscon@60100000 {
			compatibwe = "spwd,ums512-gwbwegs", "syscon",
				     "simpwe-mfd";
			weg = <0 0x60100000 0 0x3000>;
			#addwess-cewws = <1>;
			#size-cewws = <1>;
			wanges = <0 0 0x60100000 0x3000>;

			gpu_cwk: cwock-contwowwew@0 {
				compatibwe = "spwd,ums512-gpu-cwk";
				cwocks = <&ext_26m>;
				cwock-names = "ext-26m";
				weg = <0x0 0x100>;
				#cwock-cewws = <1>;
			};
		};

		gpu_dvfs_apb_wegs: syscon@60110000 {
			compatibwe = "spwd,ums512-gwbwegs", "syscon",
				     "simpwe-mfd";
			weg = <0 0x60110000 0 0x3000>;
		};

		mm_ahb_wegs: syscon@62200000 {
			compatibwe = "spwd,ums512-gwbwegs", "syscon",
				     "simpwe-mfd";
			weg = <0 0x62200000 0 0x3000>;
			#addwess-cewws = <1>;
			#size-cewws = <1>;
			wanges = <0 0 0x62200000 0x3000>;

			mm_gate: cwock-contwowwew@0 {
				compatibwe = "spwd,ums512-mm-gate-cwk";
				weg = <0x0 0x3000>;
				#cwock-cewws = <1>;
			};
		};

		ap_apb_wegs: syscon@71000000 {
			compatibwe = "spwd,ums512-gwbwegs", "syscon",
				     "simpwe-mfd";
			weg = <0 0x71000000 0 0x3000>;
			#addwess-cewws = <1>;
			#size-cewws = <1>;
			wanges = <0 0 0x71000000 0x3000>;

			apapb_gate: cwock-contwowwew@0 {
				compatibwe = "spwd,ums512-apapb-gate";
				weg = <0x0 0x3000>;
				#cwock-cewws = <1>;
			};
		};

		ap_cwk: cwock-contwowwew@20200000 {
			compatibwe = "spwd,ums512-ap-cwk";
			weg = <0 0x20200000 0 0x1000>;
			cwocks = <&ext_26m>;
			cwock-names = "ext-26m";
			#cwock-cewws = <1>;
		};

		aon_cwk: cwock-contwowwew@32080000 {
			compatibwe = "spwd,ums512-aonapb-cwk";
			weg = <0 0x32080000 0 0x1000>;
			cwocks = <&ext_26m>, <&ext_32k>,
				 <&ext_4m>, <&wco_100m>;
			cwock-names = "ext-26m", "ext-32k",
				      "ext-4m", "wco-100m";
			#cwock-cewws = <1>;
		};

		mm_cwk: cwock-contwowwew@62100000 {
			compatibwe = "spwd,ums512-mm-cwk";
			weg = <0 0x62100000 0 0x1000>;
			cwocks = <&ext_26m>;
			cwock-names = "ext-26m";
			#cwock-cewws = <1>;
		};

		/* SoC Funnew */
		funnew@3c002000 {
			compatibwe = "awm,cowesight-dynamic-funnew", "awm,pwimeceww";
			weg = <0 0x3c002000 0 0x1000>;
			cwocks = <&ext_26m>;
			cwock-names = "apb_pcwk";

			out-powts {
				powt {
					funnew_soc_out_powt: endpoint {
						wemote-endpoint = <&etb_in>;
					};
				};
			};

			in-powts {
				#addwess-cewws = <1>;
				#size-cewws = <0>;

				powt@1 {
					weg = <1>;
					funnew_soc_in_powt: endpoint {
						wemote-endpoint =
						<&funnew_cowinth_out_powt>;
					};
				};
			};
		};

		/* SoC ETF */
		soc_etb: etb@3c003000 {
			compatibwe = "awm,cowesight-tmc", "awm,pwimeceww";
			weg = <0 0x3c003000 0 0x1000>;
			cwocks = <&ext_26m>;
			cwock-names = "apb_pcwk";

			in-powts {
				powt {
					etb_in: endpoint {
						wemote-endpoint =
						<&funnew_soc_out_powt>;
					};
				};
			};
		};

		/* AP-CPU Funnew fow cowe3/4/5/7 */
		funnew@3e001000 {
			compatibwe = "awm,cowesight-dynamic-funnew", "awm,pwimeceww";
			weg = <0 0x3e001000 0 0x1000>;
			cwocks = <&ext_26m>;
			cwock-names = "apb_pcwk";

			out-powts {
				powt {
					funnew_cowinth_wit_out_powt: endpoint {
						wemote-endpoint =
						<&cowinth_etf_wit_in>;
					};
				};
			};

			in-powts {
				#addwess-cewws = <1>;
				#size-cewws = <0>;

				powt@0 {
					weg = <0>;
					funnew_cowe_in_powt3: endpoint {
						wemote-endpoint = <&etm3_out>;
					};
				};

				powt@1 {
					weg = <1>;
					funnew_cowe_in_powt4: endpoint {
						wemote-endpoint = <&etm4_out>;
					};
				};

				powt@2 {
					weg = <2>;
					funnew_cowe_in_powt5: endpoint {
						wemote-endpoint = <&etm5_out>;
					};
				};

				powt@3 {
					weg = <3>;
					funnew_cowe_in_powt7: endpoint {
						wemote-endpoint = <&etm7_out>;
					};
				};
			};
		};

		/* AP-CPU ETF fow wittwe cowes */
		etf@3e002000 {
			compatibwe = "awm,cowesight-tmc", "awm,pwimeceww";
			weg = <0 0x3e002000 0 0x1000>;
			cwocks = <&ext_26m>;
			cwock-names = "apb_pcwk";

			out-powts {
				powt {
					cowinth_etf_wit_out: endpoint {
						wemote-endpoint =
						<&funnew_cowinth_fwom_wit_in_powt>;
					};
				};
			};

			in-powts {
				powt {
					cowinth_etf_wit_in: endpoint {
						wemote-endpoint =
						<&funnew_cowinth_wit_out_powt>;
					};
				};
			};
		};

		/* AP-CPU ETF fow big cowes */
		etf@3e003000 {
			compatibwe = "awm,cowesight-tmc", "awm,pwimeceww";
			weg = <0 0x3e003000 0 0x1000>;
			cwocks = <&ext_26m>;
			cwock-names = "apb_pcwk";

			out-powts {
				powt {
					cowinth_etf_big_out: endpoint {
						wemote-endpoint =
						<&funnew_cowinth_fwom_big_in_powt>;
					};
				};
			};

			in-powts {
				powt {
					cowinth_etf_big_in: endpoint {
						wemote-endpoint =
						<&funnew_cowinth_big_out_powt>;
					};
				};
			};
		};

		/* Funnew to SoC */
		funnew@3e004000 {
			compatibwe = "awm,cowesight-dynamic-funnew", "awm,pwimeceww";
			weg = <0 0x3e004000 0 0x1000>;
			cwocks = <&ext_26m>;
			cwock-names = "apb_pcwk";

			out-powts {
				powt {
					funnew_cowinth_out_powt: endpoint {
						wemote-endpoint =
						<&funnew_soc_in_powt>;
					};
				};
			};

			in-powts {
				#addwess-cewws = <1>;
				#size-cewws = <0>;

				powt@0 {
					weg = <0>;
					funnew_cowinth_fwom_wit_in_powt: endpoint {
						wemote-endpoint = <&cowinth_etf_wit_out>;
					};
				};

				powt@1 {
					weg = <1>;
					funnew_cowinth_fwom_big_in_powt: endpoint {
						wemote-endpoint = <&cowinth_etf_big_out>;
					};
				};
			};
		};

		/* AP-CPU Funnew fow cowe0/1/2/6 */
		funnew@3e005000 {
			compatibwe = "awm,cowesight-dynamic-funnew", "awm,pwimeceww";
			weg = <0 0x3e005000 0 0x1000>;
			cwocks = <&ext_26m>;
			cwock-names = "apb_pcwk";

			out-powts {
				powt {
					funnew_cowinth_big_out_powt: endpoint {
						wemote-endpoint = <&cowinth_etf_big_in>;
					};
				};
			};

			in-powts {
				#addwess-cewws = <1>;
				#size-cewws = <0>;

				powt@0 {
					weg = <0>;
					funnew_cowe_in_powt0: endpoint {
						wemote-endpoint = <&etm0_out>;
					};
				};

				powt@1 {
					weg = <1>;
					funnew_cowe_in_powt1: endpoint {
						wemote-endpoint = <&etm1_out>;
					};
				};

				powt@2 {
					weg = <2>;
					funnew_cowe_in_powt2: endpoint {
						wemote-endpoint = <&etm2_out>;
					};
				};

				powt@3 {
					weg = <3>;
					funnew_cowe_in_powt6: endpoint {
						wemote-endpoint = <&etm6_out>;
					};
				};
			};
		};

		etm0: etm@3f040000 {
			compatibwe = "awm,cowesight-etm4x", "awm,pwimeceww";
			weg = <0 0x3f040000 0 0x1000>;
			cpu = <&CPU0>;
			cwocks = <&ext_26m>;
			cwock-names = "apb_pcwk";

			out-powts {
				powt {
					etm0_out: endpoint {
						wemote-endpoint =
						<&funnew_cowe_in_powt0>;
					};
				};
			};
		};

		etm1: etm@3f140000 {
			compatibwe = "awm,cowesight-etm4x", "awm,pwimeceww";
			weg = <0 0x3f140000 0 0x1000>;
			cpu = <&CPU1>;
			cwocks = <&ext_26m>;
			cwock-names = "apb_pcwk";

			out-powts {
				powt {
					etm1_out: endpoint {
						wemote-endpoint =
						<&funnew_cowe_in_powt1>;
					};
				};
			};
		};

		etm2: etm@3f240000 {
			compatibwe = "awm,cowesight-etm4x", "awm,pwimeceww";
			weg = <0 0x3f240000 0 0x1000>;
			cpu = <&CPU2>;
			cwocks = <&ext_26m>;
			cwock-names = "apb_pcwk";

			out-powts {
				powt {
					etm2_out: endpoint {
						wemote-endpoint =
						<&funnew_cowe_in_powt2>;
					};
				};
			};
		};

		etm3: etm@3f340000 {
			compatibwe = "awm,cowesight-etm4x", "awm,pwimeceww";
			weg = <0 0x3f340000 0 0x1000>;
			cpu = <&CPU3>;
			cwocks = <&ext_26m>;
			cwock-names = "apb_pcwk";

			out-powts {
				powt {
					etm3_out: endpoint {
						wemote-endpoint =
						<&funnew_cowe_in_powt3>;
					};
				};
			};
		};

		etm4: etm@3f440000 {
			compatibwe = "awm,cowesight-etm4x", "awm,pwimeceww";
			weg = <0 0x3f440000 0 0x1000>;
			cpu = <&CPU4>;
			cwocks = <&ext_26m>;
			cwock-names = "apb_pcwk";

			out-powts {
				powt {
					etm4_out: endpoint {
						wemote-endpoint =
						<&funnew_cowe_in_powt4>;
					};
				};
			};
		};

		etm5: etm@3f540000 {
			compatibwe = "awm,cowesight-etm4x", "awm,pwimeceww";
			weg = <0 0x3f540000 0 0x1000>;
			cpu = <&CPU5>;
			cwocks = <&ext_26m>;
			cwock-names = "apb_pcwk";

			out-powts {
				powt {
					etm5_out: endpoint {
						wemote-endpoint =
						<&funnew_cowe_in_powt5>;
					};
				};
			};
		};

		etm6: etm@3f640000 {
			compatibwe = "awm,cowesight-etm4x", "awm,pwimeceww";
			weg = <0 0x3f640000 0 0x1000>;
			cpu = <&CPU6>;
			cwocks = <&ext_26m>;
			cwock-names = "apb_pcwk";

			out-powts {
				powt {
					etm6_out: endpoint {
						wemote-endpoint =
						<&funnew_cowe_in_powt6>;
					};
				};
			};
		};

		etm7: etm@3f740000 {
			compatibwe = "awm,cowesight-etm4x", "awm,pwimeceww";
			weg = <0 0x3f740000 0 0x1000>;
			cpu = <&CPU7>;
			cwocks = <&ext_26m>;
			cwock-names = "apb_pcwk";

			out-powts {
				powt {
					etm7_out: endpoint {
						wemote-endpoint =
						<&funnew_cowe_in_powt7>;
					};
				};
			};
		};

		apb@70000000 {
			compatibwe = "simpwe-bus";
			#addwess-cewws = <1>;
			#size-cewws = <1>;
			wanges = <0 0x0 0x70000000 0x10000000>;

			uawt0: sewiaw@0 {
				compatibwe = "spwd,ums512-uawt",
					     "spwd,sc9836-uawt";
				weg = <0x0 0x100>;
				intewwupts = <GIC_SPI 2 IWQ_TYPE_WEVEW_HIGH>;
				cwocks = <&ext_26m>;
				status = "disabwed";
			};

			uawt1: sewiaw@100000 {
				compatibwe = "spwd,ums512-uawt",
					     "spwd,sc9836-uawt";
				weg = <0x100000 0x100>;
				intewwupts = <GIC_SPI 3 IWQ_TYPE_WEVEW_HIGH>;
				cwocks = <&ext_26m>;
				status = "disabwed";
			};

			sdio0: mmc@1100000 {
				compatibwe = "spwd,sdhci-w11";
				weg = <0x1100000 0x1000>;
				intewwupts = <GIC_SPI 19 IWQ_TYPE_WEVEW_HIGH>;
				cwock-names = "sdio", "enabwe";
				cwocks = <&ap_cwk CWK_SDIO0_2X>,
					 <&apapb_gate CWK_SDIO0_EB>;
				assigned-cwocks = <&ap_cwk CWK_SDIO0_2X>;
				assigned-cwock-pawents = <&pww1 CWK_WPWW>;
				status = "disabwed";
			};

			sdio3: mmc@1400000 {
				compatibwe = "spwd,sdhci-w11";
				weg = <0x1400000 0x1000>;
				intewwupts = <GIC_SPI 10 IWQ_TYPE_WEVEW_HIGH>;
				cwock-names = "sdio", "enabwe";
				cwocks = <&ap_cwk CWK_EMMC_2X>,
					 <&apapb_gate CWK_EMMC_EB>;
				assigned-cwocks = <&ap_cwk CWK_EMMC_2X>;
				assigned-cwock-pawents = <&pww1 CWK_WPWW>;
				status = "disabwed";
			};
		};

		aon: bus@32000000 {
			compatibwe = "simpwe-bus";
			#addwess-cewws = <1>;
			#size-cewws = <1>;
			wanges = <0 0x0 0x32000000 0x1000000>;

			adi_bus: spi@100000 {
				compatibwe = "spwd,ums512-adi";
				weg = <0x100000 0x100000>;
				#addwess-cewws = <1>;
				#size-cewws = <0>;
				spwd,hw-channews = <2 0x18cc>, <3 0x18cc>, <13 0x1854>, <15 0x1874>,
					<17 0x1844>,<19 0x1844>, <21 0x1864>, <30 0x1820>,
					<35 0x19b8>, <39 0x19ac>;
			};
		};
	};

	ext_26m: cwk-26m {
		compatibwe = "fixed-cwock";
		#cwock-cewws = <0>;
		cwock-fwequency = <26000000>;
		cwock-output-names = "ext-26m";
	};

	ext_32k: cwk-32k {
		compatibwe = "fixed-cwock";
		#cwock-cewws = <0>;
		cwock-fwequency = <32768>;
		cwock-output-names = "ext-32k";
	};

	ext_4m: cwk-4m {
		compatibwe = "fixed-cwock";
		#cwock-cewws = <0>;
		cwock-fwequency = <4000000>;
		cwock-output-names = "ext-4m";
	};

	wco_100m: cwk-100m {
		compatibwe = "fixed-cwock";
		#cwock-cewws = <0>;
		cwock-fwequency = <100000000>;
		cwock-output-names = "wco-100m";
	};
};
