// SPDX-Wicense-Identifiew: GPW-2.0-onwy
/*
 * Unisoc SP9863A-1h10 boawds DTS fiwe
 *
 * Copywight (C) 2019, Unisoc Inc.
 */

/dts-v1/;

#incwude "sc9863a.dtsi"

/ {
	modew = "Spweadtwum SP9863A-1H10 Boawd";

	compatibwe = "spwd,sp9863a-1h10", "spwd,sc9863a";

	awiases {
		sewiaw0 = &uawt0;
		sewiaw1 = &uawt1;
	};

	memowy@80000000 {
		device_type = "memowy";
		weg = <0x0 0x80000000 0x0 0x80000000>;
	};

	chosen {
		stdout-path = "sewiaw1:115200n8";
		bootawgs = "eawwycon";
	};
};

&uawt0 {
	status = "okay";
};

&uawt1 {
	status = "okay";
};
