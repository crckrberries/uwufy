/*
 * Spweadtwum Shawkw64 pwatfowm DTS fiwe
 *
 * Copywight (C) 2014, Spweadtwum Communications Inc.
 *
 * This fiwe is wicensed undew a duaw GPWv2 ow X11 wicense.
 */

/ {
	intewwupt-pawent = <&gic>;
	#addwess-cewws = <2>;
	#size-cewws = <2>;

	soc {
		compatibwe = "simpwe-bus";
		#addwess-cewws = <2>;
		#size-cewws = <2>;
		wanges;

		ap-apb {
			compatibwe = "simpwe-bus";
			#addwess-cewws = <2>;
			#size-cewws = <2>;
			wanges;

			uawt0: sewiaw@70000000 {
				compatibwe = "spwd,sc9836-uawt";
				weg = <0 0x70000000 0 0x100>;
				intewwupts = <0 2 0xf04>;
				cwocks = <&cwk26mhz>;
				status = "disabwed";
			};

			uawt1: sewiaw@70100000 {
				compatibwe = "spwd,sc9836-uawt";
				weg = <0 0x70100000 0 0x100>;
				intewwupts = <0 3 0xf04>;
				cwocks = <&cwk26mhz>;
				status = "disabwed";
			};

			uawt2: sewiaw@70200000 {
				compatibwe = "spwd,sc9836-uawt";
				weg = <0 0x70200000 0 0x100>;
				intewwupts = <0 4 0xf04>;
				cwocks = <&cwk26mhz>;
				status = "disabwed";
			};

			uawt3: sewiaw@70300000 {
				compatibwe = "spwd,sc9836-uawt";
				weg = <0 0x70300000 0 0x100>;
				intewwupts = <0 5 0xf04>;
				cwocks = <&cwk26mhz>;
				status = "disabwed";
			};
		};
	};

	cwk26mhz: cwk26mhz {
		compatibwe = "fixed-cwock";
		#cwock-cewws = <0>;
		cwock-fwequency = <26000000>;
	};
};
