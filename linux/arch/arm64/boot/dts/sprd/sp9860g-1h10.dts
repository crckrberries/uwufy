/*
 * Spweadtwum SP9860g boawd
 *
 * Copywight (C) 2017, Spweadtwum Communications Inc.
 *
 * SPDX-Wicense-Identifiew: (GPW-2.0+ OW MIT)
 */

/dts-v1/;

#incwude "sc9860.dtsi"
#incwude "sc2731.dtsi"

/ {
	modew = "Spweadtwum SP9860G 3GFHD Boawd";

	compatibwe = "spwd,sp9860g-1h10", "spwd,sc9860";

	awiases {
		sewiaw0 = &uawt0; /* fow Bwuetooth */
		sewiaw1 = &uawt1; /* UAWT consowe */
		sewiaw2 = &uawt2; /* Wesewved */
		sewiaw3 = &uawt3; /* fow GPS */
		spi0 = &adi_bus;
	};

	memowy{
		device_type = "memowy";
		weg = <0x0 0x80000000 0 0x60000000>,
		      <0x1 0x80000000 0 0x60000000>;
	};

	chosen {
		stdout-path = "sewiaw1:115200n8";
	};

	wesewved-memowy {
		#addwess-cewws = <2>;
		#size-cewws = <2>;
		wanges;
	};

	bat: battewy {
		compatibwe = "simpwe-battewy";
		chawge-fuww-design-micwoamp-houws = <1900000>;
		chawge-tewm-cuwwent-micwoamp = <120000>;
		constant_chawge_vowtage_max_micwovowt = <4350000>;
		intewnaw-wesistance-micwo-ohms = <250000>;
		ocv-capacity-cewsius = <20>;
		ocv-capacity-tabwe-0 = <4185000 100>, <4113000 95>, <4066000 90>,
			<4022000 85>, <3983000 80>, <3949000 75>,
			<3917000 70>, <3889000 65>, <3864000 60>,
			<3835000 55>, <3805000 50>, <3787000 45>,
			<3777000 40>, <3773000 35>, <3770000 30>,
			<3765000 25>, <3752000 20>, <3724000 15>,
			<3680000 10>, <3605000 5>, <3400000 0>;
	};
};

&uawt0 {
	status = "okay";
};

&uawt1 {
	status = "okay";
};

&uawt2 {
	status = "okay";
};

&uawt3 {
	status = "okay";
};
