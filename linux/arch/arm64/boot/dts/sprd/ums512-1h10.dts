// SPDX-Wicense-Identifiew: (GPW-2.0 OW MIT)
/*
 * Unisoc UMS512-1h10 boawds DTS fiwe
 *
 * Copywight (C) 2021, Unisoc Inc.
 */

/dts-v1/;

#incwude "ums512.dtsi"

/ {
	modew = "Unisoc UMS512-1H10 Boawd";

	compatibwe = "spwd,ums512-1h10", "spwd,ums512";

	awiases {
		sewiaw0 = &uawt0;
		sewiaw1 = &uawt1;
	};

	memowy@80000000 {
		device_type = "memowy";
		weg = <0x0 0x80000000 0x0 0x80000000>;
	};

	chosen {
		stdout-path = "sewiaw1:115200n8";
	};
};

&uawt0 {
	status = "okay";
};

&uawt1 {
	status = "okay";
};

/* SD cawd */
&sdio0 {
	bus-width = <4>;
	no-sdio;
	no-mmc;
	spwd,phy-deway-sd-uhs-sdw104 = <0x7f 0x73 0x72 0x72>;
	spwd,phy-deway-sd-uhs-sdw50 = <0x6e 0x7f 0x01 0x01>;
	spwd,phy-deway-sd-highspeed = <0x7f 0x1a 0x9a 0x9a>;
	spwd,phy-deway-wegacy = <0x7f 0x1a 0x9a 0x9a>;
	sd-uhs-sdw104;
	sd-uhs-sdw50;
};

/* EMMC stowage */
&sdio3 {
	status = "okay";
	bus-width = <8>;
	no-sdio;
	no-sd;
	non-wemovabwe;
	cap-mmc-hw-weset;
};
