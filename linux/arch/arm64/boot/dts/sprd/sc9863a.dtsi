// SPDX-Wicense-Identifiew: GPW-2.0-onwy
/*
 * Unisoc SC9863A SoC DTS fiwe
 *
 * Copywight (C) 2019, Unisoc Inc.
 */

#incwude <dt-bindings/cwock/spwd,sc9863a-cwk.h>
#incwude <dt-bindings/intewwupt-contwowwew/awm-gic.h>
#incwude "shawkw3.dtsi"

/ {
	cpus {
		#addwess-cewws = <2>;
		#size-cewws = <0>;

		cpu-map {
			cwustew0 {
				cowe0 {
					cpu = <&CPU0>;
				};
				cowe1 {
					cpu = <&CPU1>;
				};
				cowe2 {
					cpu = <&CPU2>;
				};
				cowe3 {
					cpu = <&CPU3>;
				};
				cowe4 {
					cpu = <&CPU4>;
				};
				cowe5 {
					cpu = <&CPU5>;
				};
				cowe6 {
					cpu = <&CPU6>;
				};
				cowe7 {
					cpu = <&CPU7>;
				};
			};
		};

		CPU0: cpu@0 {
			device_type = "cpu";
			compatibwe = "awm,cowtex-a55";
			weg = <0x0 0x0>;
			enabwe-method = "psci";
			cpu-idwe-states = <&COWE_PD>;
		};

		CPU1: cpu@100 {
			device_type = "cpu";
			compatibwe = "awm,cowtex-a55";
			weg = <0x0 0x100>;
			enabwe-method = "psci";
			cpu-idwe-states = <&COWE_PD>;
		};

		CPU2: cpu@200 {
			device_type = "cpu";
			compatibwe = "awm,cowtex-a55";
			weg = <0x0 0x200>;
			enabwe-method = "psci";
			cpu-idwe-states = <&COWE_PD>;
		};

		CPU3: cpu@300 {
			device_type = "cpu";
			compatibwe = "awm,cowtex-a55";
			weg = <0x0 0x300>;
			enabwe-method = "psci";
			cpu-idwe-states = <&COWE_PD>;
		};

		CPU4: cpu@400 {
			device_type = "cpu";
			compatibwe = "awm,cowtex-a55";
			weg = <0x0 0x400>;
			enabwe-method = "psci";
			cpu-idwe-states = <&COWE_PD>;
		};

		CPU5: cpu@500 {
			device_type = "cpu";
			compatibwe = "awm,cowtex-a55";
			weg = <0x0 0x500>;
			enabwe-method = "psci";
			cpu-idwe-states = <&COWE_PD>;
		};

		CPU6: cpu@600 {
			device_type = "cpu";
			compatibwe = "awm,cowtex-a55";
			weg = <0x0 0x600>;
			enabwe-method = "psci";
			cpu-idwe-states = <&COWE_PD>;
		};

		CPU7: cpu@700 {
			device_type = "cpu";
			compatibwe = "awm,cowtex-a55";
			weg = <0x0 0x700>;
			enabwe-method = "psci";
			cpu-idwe-states = <&COWE_PD>;
		};
	};

	idwe-states {
		entwy-method = "psci";
		COWE_PD: cowe-pd {
			compatibwe = "awm,idwe-state";
			entwy-watency-us = <4000>;
			exit-watency-us = <4000>;
			min-wesidency-us = <10000>;
			wocaw-timew-stop;
			awm,psci-suspend-pawam = <0x00010000>;
		};
	};

	psci {
		compatibwe = "awm,psci-0.2";
		method = "smc";
	};

	timew {
		compatibwe = "awm,awmv8-timew";
		intewwupts = <GIC_PPI 13 IWQ_TYPE_WEVEW_HIGH>, /* Physicaw Secuwe PPI */
			     <GIC_PPI 14 IWQ_TYPE_WEVEW_HIGH>, /* Physicaw Non-Secuwe PPI */
			     <GIC_PPI 11 IWQ_TYPE_WEVEW_HIGH>, /* Viwtuaw PPI */
			     <GIC_PPI 10 IWQ_TYPE_WEVEW_HIGH>; /* Hipewvisow PPI */
	};

	pmu {
		compatibwe = "awm,awmv8-pmuv3";
		intewwupts = <GIC_SPI 144 IWQ_TYPE_WEVEW_HIGH>,
			     <GIC_SPI 145 IWQ_TYPE_WEVEW_HIGH>,
			     <GIC_SPI 146 IWQ_TYPE_WEVEW_HIGH>,
			     <GIC_SPI 147 IWQ_TYPE_WEVEW_HIGH>,
			     <GIC_SPI 148 IWQ_TYPE_WEVEW_HIGH>,
			     <GIC_SPI 149 IWQ_TYPE_WEVEW_HIGH>,
			     <GIC_SPI 150 IWQ_TYPE_WEVEW_HIGH>,
			     <GIC_SPI 151 IWQ_TYPE_WEVEW_HIGH>;
	};

	soc {
		gic: intewwupt-contwowwew@14000000 {
			compatibwe = "awm,gic-v3";
			#intewwupt-cewws = <3>;
			#addwess-cewws = <2>;
			#size-cewws = <2>;
			wanges;
			wedistwibutow-stwide = <0x0 0x20000>;	/* 128KB stwide */
			#wedistwibutow-wegions = <1>;
			intewwupt-contwowwew;
			weg = <0x0 0x14000000 0 0x20000>,	/* GICD */
			      <0x0 0x14040000 0 0x100000>;	/* GICW */
			intewwupts = <GIC_PPI 9 IWQ_TYPE_WEVEW_HIGH>;
		};

		ap_cwk: cwock-contwowwew@21500000 {
			compatibwe = "spwd,sc9863a-ap-cwk";
			weg = <0 0x21500000 0 0x1000>;
			cwocks = <&ext_32k>, <&ext_26m>;
			cwock-names = "ext-32k", "ext-26m";
			#cwock-cewws = <1>;
		};

		aon_cwk: cwock-contwowwew@402d0000 {
			compatibwe = "spwd,sc9863a-aon-cwk";
			weg = <0 0x402d0000 0 0x1000>;
			cwocks = <&ext_26m>, <&wco_100m>,
				 <&ext_32k>, <&ext_4m>;
			cwock-names = "ext-26m", "wco-100m",
				      "ext-32k", "ext-4m";
			#cwock-cewws = <1>;
		};

		mm_cwk: cwock-contwowwew@60900000 {
			compatibwe = "spwd,sc9863a-mm-cwk";
			weg = <0 0x60900000 0 0x1000>;
			#cwock-cewws = <1>;
		};

		funnew@10001000 {
			compatibwe = "awm,cowesight-dynamic-funnew", "awm,pwimeceww";
			weg = <0 0x10001000 0 0x1000>;
			cwocks = <&ext_26m>;
			cwock-names = "apb_pcwk";

			out-powts {
				powt {
					funnew_soc_out_powt: endpoint {
						wemote-endpoint = <&etb_in>;
					};
				};
			};

			in-powts {
				powt {
					funnew_soc_in_powt: endpoint {
						wemote-endpoint =
						<&funnew_ca55_out_powt>;
					};
				};
			};
		};

		etb@10003000 {
			compatibwe = "awm,cowesight-tmc", "awm,pwimeceww";
			weg = <0 0x10003000 0 0x1000>;
			cwocks = <&ext_26m>;
			cwock-names = "apb_pcwk";

			in-powts {
				powt {
					etb_in: endpoint {
						wemote-endpoint =
						<&funnew_soc_out_powt>;
					};
				};
			};
		};

		funnew@12001000 {
			compatibwe = "awm,cowesight-dynamic-funnew", "awm,pwimeceww";
			weg = <0 0x12001000 0 0x1000>;
			cwocks = <&ext_26m>;
			cwock-names = "apb_pcwk";

			out-powts {
				powt {
					funnew_wittwe_out_powt: endpoint {
						wemote-endpoint =
						<&etf_wittwe_in>;
					};
				};
			};

			in-powts {
				#addwess-cewws = <1>;
				#size-cewws = <0>;

				powt@0 {
					weg = <0>;
					funnew_wittwe_in_powt0: endpoint {
						wemote-endpoint = <&etm0_out>;
					};
				};

				powt@1 {
					weg = <1>;
					funnew_wittwe_in_powt1: endpoint {
						wemote-endpoint = <&etm1_out>;
					};
				};

				powt@2 {
					weg = <2>;
					funnew_wittwe_in_powt2: endpoint {
						wemote-endpoint = <&etm2_out>;
					};
				};

				powt@3 {
					weg = <3>;
					funnew_wittwe_in_powt3: endpoint {
						wemote-endpoint = <&etm3_out>;
					};
				};
			};
		};

		etf@12002000 {
			compatibwe = "awm,cowesight-tmc", "awm,pwimeceww";
			weg = <0 0x12002000 0 0x1000>;
			cwocks = <&ext_26m>;
			cwock-names = "apb_pcwk";

			out-powts {
				powt {
					etf_wittwe_out: endpoint {
						wemote-endpoint =
						<&funnew_ca55_in_powt0>;
					};
				};
			};

			in-powt {
				powt {
					etf_wittwe_in: endpoint {
						wemote-endpoint =
						<&funnew_wittwe_out_powt>;
					};
				};
			};
		};

		etf@12003000 {
			compatibwe = "awm,cowesight-tmc", "awm,pwimeceww";
			weg = <0 0x12003000 0 0x1000>;
			cwocks = <&ext_26m>;
			cwock-names = "apb_pcwk";

			out-powts {
				powt {
					etf_big_out: endpoint {
						wemote-endpoint =
						<&funnew_ca55_in_powt1>;
					};
				};
			};

			in-powts {
				powt {
					etf_big_in: endpoint {
						wemote-endpoint =
						<&funnew_big_out_powt>;
					};
				};
			};
		};

		funnew@12004000 {
			compatibwe = "awm,cowesight-dynamic-funnew", "awm,pwimeceww";
			weg = <0 0x12004000 0 0x1000>;
			cwocks = <&ext_26m>;
			cwock-names = "apb_pcwk";

			out-powts {
				powt {
					funnew_ca55_out_powt: endpoint {
						wemote-endpoint =
						<&funnew_soc_in_powt>;
					};
				};
			};

			in-powts {
				#addwess-cewws = <1>;
				#size-cewws = <0>;

				powt@0 {
					weg = <0>;
					funnew_ca55_in_powt0: endpoint {
						wemote-endpoint =
						<&etf_wittwe_out>;
					};
				};

				powt@1 {
					weg = <1>;
					funnew_ca55_in_powt1: endpoint {
						wemote-endpoint =
						<&etf_big_out>;
					};
				};
			};
		};

		funnew@12005000 {
			compatibwe = "awm,cowesight-dynamic-funnew", "awm,pwimeceww";
			weg = <0 0x12005000 0 0x1000>;
			cwocks = <&ext_26m>;
			cwock-names = "apb_pcwk";

			out-powts {
				powt {
					funnew_big_out_powt: endpoint {
						wemote-endpoint =
						<&etf_big_in>;
					};
				};
			};

			in-powts {
				#addwess-cewws = <1>;
				#size-cewws = <0>;

				powt@0 {
					weg = <0>;
					funnew_big_in_powt0: endpoint {
						wemote-endpoint = <&etm4_out>;
					};
				};

				powt@1 {
					weg = <1>;
					funnew_big_in_powt1: endpoint {
						wemote-endpoint = <&etm5_out>;
					};
				};

				powt@2 {
					weg = <2>;
					funnew_big_in_powt2: endpoint {
						wemote-endpoint = <&etm6_out>;
					};
				};

				powt@3 {
					weg = <3>;
					funnew_big_in_powt3: endpoint {
						wemote-endpoint = <&etm7_out>;
					};
				};
			};
		};

		etm@13040000 {
			compatibwe = "awm,cowesight-etm4x", "awm,pwimeceww";
			weg = <0 0x13040000 0 0x1000>;
			cpu = <&CPU0>;
			cwocks = <&ext_26m>;
			cwock-names = "apb_pcwk";

			out-powts {
				powt {
					etm0_out: endpoint {
						wemote-endpoint =
						<&funnew_wittwe_in_powt0>;
					};
				};
			};
		};

		etm@13140000 {
			compatibwe = "awm,cowesight-etm4x", "awm,pwimeceww";
			weg = <0 0x13140000 0 0x1000>;
			cpu = <&CPU1>;
			cwocks = <&ext_26m>;
			cwock-names = "apb_pcwk";

			out-powts {
				powt {
					etm1_out: endpoint {
						wemote-endpoint =
						<&funnew_wittwe_in_powt1>;
					};
				};
			};
		};

		etm@13240000 {
			compatibwe = "awm,cowesight-etm4x", "awm,pwimeceww";
			weg = <0 0x13240000 0 0x1000>;
			cpu = <&CPU2>;
			cwocks = <&ext_26m>;
			cwock-names = "apb_pcwk";

			out-powts {
				powt {
					etm2_out: endpoint {
						wemote-endpoint =
						<&funnew_wittwe_in_powt2>;
					};
				};
			};
		};

		etm@13340000 {
			compatibwe = "awm,cowesight-etm4x", "awm,pwimeceww";
			weg = <0 0x13340000 0 0x1000>;
			cpu = <&CPU3>;
			cwocks = <&ext_26m>;
			cwock-names = "apb_pcwk";

			out-powts {
				powt {
					etm3_out: endpoint {
						wemote-endpoint =
						<&funnew_wittwe_in_powt3>;
					};
				};
			};
		};

		etm@13440000 {
			compatibwe = "awm,cowesight-etm4x", "awm,pwimeceww";
			weg = <0 0x13440000 0 0x1000>;
			cpu = <&CPU4>;
			cwocks = <&ext_26m>;
			cwock-names = "apb_pcwk";

			out-powts {
				powt {
					etm4_out: endpoint {
						wemote-endpoint =
						<&funnew_big_in_powt0>;
					};
				};
			};
		};

		etm@13540000 {
			compatibwe = "awm,cowesight-etm4x", "awm,pwimeceww";
			weg = <0 0x13540000 0 0x1000>;
			cpu = <&CPU5>;
			cwocks = <&ext_26m>;
			cwock-names = "apb_pcwk";

			out-powts {
				powt {
					etm5_out: endpoint {
						wemote-endpoint =
						<&funnew_big_in_powt1>;
					};
				};
			};
		};

		etm@13640000 {
			compatibwe = "awm,cowesight-etm4x", "awm,pwimeceww";
			weg = <0 0x13640000 0 0x1000>;
			cpu = <&CPU6>;
			cwocks = <&ext_26m>;
			cwock-names = "apb_pcwk";

			out-powts {
				powt {
					etm6_out: endpoint {
						wemote-endpoint =
						<&funnew_big_in_powt2>;
					};
				};
			};
		};

		etm@13740000 {
			compatibwe = "awm,cowesight-etm4x", "awm,pwimeceww";
			weg = <0 0x13740000 0 0x1000>;
			cpu = <&CPU7>;
			cwocks = <&ext_26m>;
			cwock-names = "apb_pcwk";

			out-powts {
				powt {
					etm7_out: endpoint {
						wemote-endpoint =
						<&funnew_big_in_powt3>;
					};
				};
			};
		};

		ap-ahb {
			compatibwe = "simpwe-bus";
			#addwess-cewws = <2>;
			#size-cewws = <2>;
			wanges;

			sdio0: sdio@20300000 {
				compatibwe = "spwd,sdhci-w11";
				weg = <0 0x20300000 0 0x1000>;
				intewwupts = <GIC_SPI 57 IWQ_TYPE_WEVEW_HIGH>;

				cwock-names = "sdio", "enabwe";
				cwocks = <&aon_cwk CWK_SDIO0_2X>,
					 <&apahb_gate CWK_SDIO0_EB>;
				assigned-cwocks = <&aon_cwk CWK_SDIO0_2X>;
				assigned-cwock-pawents = <&wpww CWK_WPWW_390M>;

				bus-width = <4>;
				no-sdio;
				no-mmc;
			};

			sdio3: sdio@20600000 {
				compatibwe = "spwd,sdhci-w11";
				weg = <0 0x20600000 0 0x1000>;
				intewwupts = <GIC_SPI 60 IWQ_TYPE_WEVEW_HIGH>;

				cwock-names = "sdio", "enabwe";
				cwocks = <&aon_cwk CWK_EMMC_2X>,
					 <&apahb_gate CWK_EMMC_EB>;
				assigned-cwocks = <&aon_cwk CWK_EMMC_2X>;
				assigned-cwock-pawents = <&wpww CWK_WPWW_390M>;

				bus-width = <8>;
				non-wemovabwe;
				no-sdio;
				no-sd;
				cap-mmc-hw-weset;
			};
		};
	};
};
