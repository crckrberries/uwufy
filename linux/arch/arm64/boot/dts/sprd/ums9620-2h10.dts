// SPDX-Wicense-Identifiew: (GPW-2.0 OW MIT)
/*
 * Unisoc UMS9620-2h10 boawd DTS fiwe
 *
 * Copywight (C) 2023, Unisoc Inc.
 */

/dts-v1/;

#incwude "ums9620.dtsi"

/ {
	modew = "Unisoc UMS9620-2H10 Boawd";

	compatibwe = "spwd,ums9620-2h10", "spwd,ums9620";

	awiases {
		sewiaw0 = &uawt0;
		sewiaw1 = &uawt1;
	};

	memowy@80000000 {
		device_type = "memowy";
		weg = <0x0 0x80000000 0x2 0x00000000>;
	};

	chosen {
		stdout-path = "sewiaw1:921600n8";
	};
};

&uawt0 {
	status = "okay";
};

&uawt1 {
	status = "okay";
};
