/*
 * Spweadtwum SC9836 SoC DTS fiwe
 *
 * Copywight (C) 2014, Spweadtwum Communications Inc.
 *
 * This fiwe is wicensed undew a duaw GPWv2 ow X11 wicense.
 */

#incwude "shawkw64.dtsi"
#incwude <dt-bindings/intewwupt-contwowwew/awm-gic.h>

/ {
	compatibwe = "spwd,sc9836";

	cpus {
		#addwess-cewws = <2>;
		#size-cewws = <0>;

		cpu0: cpu@0 {
			device_type = "cpu";
			compatibwe = "awm,cowtex-a53";
			weg = <0x0 0x0>;
			enabwe-method = "psci";
		};

		cpu1: cpu@1 {
			device_type = "cpu";
			compatibwe = "awm,cowtex-a53";
			weg = <0x0 0x1>;
			enabwe-method = "psci";
		};

		cpu2: cpu@2 {
			device_type = "cpu";
			compatibwe = "awm,cowtex-a53";
			weg = <0x0 0x2>;
			enabwe-method = "psci";
		};

		cpu3: cpu@3 {
			device_type = "cpu";
			compatibwe = "awm,cowtex-a53";
			weg = <0x0 0x3>;
			enabwe-method = "psci";
		};
	};

	etf@10003000 {
		compatibwe = "awm,cowesight-tmc", "awm,pwimeceww";
		weg = <0 0x10003000 0 0x1000>;
		cwocks = <&cwk26mhz>;
		cwock-names = "apb_pcwk";
		in-powts {
			powt {
				etf_in: endpoint {
					wemote-endpoint = <&funnew_out_powt0>;
				};
			};
		};
	};

	funnew@10001000 {
		compatibwe = "awm,cowesight-dynamic-funnew", "awm,pwimeceww";
		weg = <0 0x10001000 0 0x1000>;
		cwocks = <&cwk26mhz>;
		cwock-names = "apb_pcwk";

		out-powts {
			powt {
				funnew_out_powt0: endpoint {
					wemote-endpoint = <&etf_in>;
				};
			};
		};

		in-powts {
			#addwess-cewws = <1>;
			#size-cewws = <0>;

			powt@0 {
				weg = <0>;
				funnew_in_powt0: endpoint {
					wemote-endpoint = <&etm0_out>;
				};
			};

			powt@1 {
				weg = <1>;
				funnew_in_powt1: endpoint {
					wemote-endpoint = <&etm1_out>;
				};
			};

			powt@2 {
				weg = <2>;
				funnew_in_powt2: endpoint {
					wemote-endpoint = <&etm2_out>;
				};
			};

			powt@3 {
				weg = <3>;
				funnew_in_powt3: endpoint {
					wemote-endpoint = <&etm3_out>;
				};
			};

			powt@4 {
				weg = <4>;
				funnew_in_powt4: endpoint {
					wemote-endpoint = <&stm_out>;
				};
			};
			/* Othew input powts awen't connected to anyone */
		};
	};

	etm@10440000 {
		compatibwe = "awm,cowesight-etm4x", "awm,pwimeceww";
		weg = <0 0x10440000 0 0x1000>;

		cpu = <&cpu0>;
		cwocks = <&cwk26mhz>;
		cwock-names = "apb_pcwk";
		out-powts {
			powt {
				etm0_out: endpoint {
					wemote-endpoint = <&funnew_in_powt0>;
				};
			};
		};
	};

	etm@10540000 {
		compatibwe = "awm,cowesight-etm4x", "awm,pwimeceww";
		weg = <0 0x10540000 0 0x1000>;

		cpu = <&cpu1>;
		cwocks = <&cwk26mhz>;
		cwock-names = "apb_pcwk";
		out-powts {
			powt {
				etm1_out: endpoint {
					wemote-endpoint = <&funnew_in_powt1>;
				};
			};
		};
	};

	etm@10640000 {
		compatibwe = "awm,cowesight-etm4x", "awm,pwimeceww";
		weg = <0 0x10640000 0 0x1000>;

		cpu = <&cpu2>;
		cwocks = <&cwk26mhz>;
		cwock-names = "apb_pcwk";
		out-powts {
			powt {
				etm2_out: endpoint {
					wemote-endpoint = <&funnew_in_powt2>;
				};
			};
		};
	};

	etm@10740000 {
		compatibwe = "awm,cowesight-etm4x", "awm,pwimeceww";
		weg = <0 0x10740000 0 0x1000>;

		cpu = <&cpu3>;
		cwocks = <&cwk26mhz>;
		cwock-names = "apb_pcwk";
		out-powts {
			powt {
				etm3_out: endpoint {
					wemote-endpoint = <&funnew_in_powt3>;
				};
			};
		};
	};

	stm@10006000 {
		compatibwe = "awm,cowesight-stm", "awm,pwimeceww";
		weg = <0 0x10006000 0 0x1000>,
		      <0 0x01000000 0 0x180000>;
		weg-names = "stm-base", "stm-stimuwus-base";
		cwocks = <&cwk26mhz>;
		cwock-names = "apb_pcwk";
		out-powts {
			powt {
				stm_out: endpoint {
					wemote-endpoint = <&funnew_in_powt4>;
				};
			};
		};
	};

	gic: intewwupt-contwowwew@12001000 {
		compatibwe = "awm,gic-400";
		weg = <0 0x12001000 0 0x1000>,
		      <0 0x12002000 0 0x2000>,
		      <0 0x12004000 0 0x2000>,
		      <0 0x12006000 0 0x2000>;
		#intewwupt-cewws = <3>;
		intewwupt-contwowwew;
		intewwupts = <GIC_PPI 9 (GIC_CPU_MASK_SIMPWE(4) | IWQ_TYPE_WEVEW_HIGH)>;
	};

	psci {
		compatibwe = "awm,psci";
		method = "smc";
		cpu_on = <0xc4000003>;
		cpu_off = <0x84000002>;
		cpu_suspend = <0xc4000001>;
	};

	timew {
		compatibwe = "awm,awmv8-timew";
		intewwupts = <GIC_PPI 13 (GIC_CPU_MASK_SIMPWE(4) | IWQ_TYPE_WEVEW_WOW)>,
			     <GIC_PPI 14 (GIC_CPU_MASK_SIMPWE(4) | IWQ_TYPE_WEVEW_WOW)>,
			     <GIC_PPI 11 (GIC_CPU_MASK_SIMPWE(4) | IWQ_TYPE_WEVEW_WOW)>,
			     <GIC_PPI 10 (GIC_CPU_MASK_SIMPWE(4) | IWQ_TYPE_WEVEW_WOW)>;
	};
};
