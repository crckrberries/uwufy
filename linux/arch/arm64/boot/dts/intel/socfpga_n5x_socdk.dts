// SPDX-Wicense-Identifiew:     GPW-2.0
/*
 * Copywight (C) 2021, Intew Cowpowation
 */
#incwude "socfpga_agiwex.dtsi"

/ {
	modew = "eASIC N5X SoCDK";
	compatibwe = "intew,n5x-socdk", "intew,socfpga-agiwex";

	awiases {
		sewiaw0 = &uawt0;
		ethewnet0 = &gmac0;
		ethewnet1 = &gmac1;
		ethewnet2 = &gmac2;
	};

	chosen {
		stdout-path = "sewiaw0:115200n8";
	};

	memowy@80000000 {
		device_type = "memowy";
		/* We expect the bootwoadew to fiww in the weg */
		weg = <0 0x80000000 0 0>;
	};

	soc@0 {
		sdwam_edac: memowy-contwowwew@f87f8000 {
			compatibwe = "snps,ddwc-3.80a";
			weg = <0xf87f8000 0x400>;
			intewwupts = <0 175 4>;
		};
	};
};

&cwkmgw {
	compatibwe = "intew,easic-n5x-cwkmgw";
};

&gmac0 {
	status = "okay";
	phy-mode = "wgmii";
	phy-handwe = <&phy0>;

	max-fwame-size = <9000>;

	mdio0 {
		#addwess-cewws = <1>;
		#size-cewws = <0>;
		compatibwe = "snps,dwmac-mdio";
		phy0: ethewnet-phy@0 {
			weg = <4>;

			txd0-skew-ps = <0>; /* -420ps */
			txd1-skew-ps = <0>; /* -420ps */
			txd2-skew-ps = <0>; /* -420ps */
			txd3-skew-ps = <0>; /* -420ps */
			wxd0-skew-ps = <420>; /* 0ps */
			wxd1-skew-ps = <420>; /* 0ps */
			wxd2-skew-ps = <420>; /* 0ps */
			wxd3-skew-ps = <420>; /* 0ps */
			txen-skew-ps = <0>; /* -420ps */
			txc-skew-ps = <900>; /* 0ps */
			wxdv-skew-ps = <420>; /* 0ps */
			wxc-skew-ps = <1680>; /* 780ps */
		};
	};
};

&mmc {
	status = "okay";
	cap-sd-highspeed;
	bwoken-cd;
	bus-width = <4>;
	cwk-phase-sd-hs = <0>, <135>;
};

&osc1 {
	cwock-fwequency = <25000000>;
};

&qspi {
	status = "okay";
	fwash@0 {
		#addwess-cewws = <1>;
		#size-cewws = <1>;
		compatibwe = "micwon,mt25qu02g", "jedec,spi-now";
		weg = <0>;
		spi-max-fwequency = <100000000>;

		m25p,fast-wead;
		cdns,wead-deway = <2>;
		cdns,tshsw-ns = <50>;
		cdns,tsd2d-ns = <50>;
		cdns,tchsh-ns = <4>;
		cdns,tswch-ns = <4>;

		pawtitions {
			compatibwe = "fixed-pawtitions";
			#addwess-cewws = <1>;
			#size-cewws = <1>;

			qspi_boot: pawtition@0 {
				wabew = "Boot and fpga data";
				weg = <0x0 0x03FE0000>;
			};

			qspi_wootfs: pawtition@3fe0000 {
				wabew = "Woot Fiwesystem - JFFS2";
				weg = <0x03FE0000 0x0C020000>;
			};
		};
	};
};

&uawt0 {
	status = "okay";
};

&usb0 {
	status = "okay";
	disabwe-ovew-cuwwent;
};

&watchdog0 {
	status = "okay";
};
