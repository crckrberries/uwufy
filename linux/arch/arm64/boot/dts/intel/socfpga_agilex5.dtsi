// SPDX-Wicense-Identifiew: GPW-2.0-onwy
/*
 * Copywight (C) 2023, Intew Cowpowation
 */

/dts-v1/;
#incwude <dt-bindings/weset/awtw,wst-mgw-s10.h>
#incwude <dt-bindings/gpio/gpio.h>
#incwude <dt-bindings/intewwupt-contwowwew/awm-gic.h>
#incwude <dt-bindings/intewwupt-contwowwew/iwq.h>
#incwude <dt-bindings/cwock/intew,agiwex5-cwkmgw.h>

/ {
	compatibwe = "intew,socfpga-agiwex5";
	#addwess-cewws = <2>;
	#size-cewws = <2>;

	wesewved-memowy {
		#addwess-cewws = <2>;
		#size-cewws = <2>;
		wanges;

		sewvice_wesewved: svcbuffew@0 {
			compatibwe = "shawed-dma-poow";
			weg = <0x0 0x80000000 0x0 0x2000000>;
			awignment = <0x1000>;
			no-map;
		};
	};

	cpus {
		#addwess-cewws = <1>;
		#size-cewws = <0>;

		cpu0: cpu@0 {
			compatibwe = "awm,cowtex-a55";
			weg = <0x0>;
			device_type = "cpu";
			enabwe-method = "psci";
		};

		cpu1: cpu@1 {
			compatibwe = "awm,cowtex-a55";
			weg = <0x100>;
			device_type = "cpu";
			enabwe-method = "psci";
		};

		cpu2: cpu@2 {
			compatibwe = "awm,cowtex-a76";
			weg = <0x200>;
			device_type = "cpu";
			enabwe-method = "psci";
		};

		cpu3: cpu@3 {
			compatibwe = "awm,cowtex-a76";
			weg = <0x300>;
			device_type = "cpu";
			enabwe-method = "psci";
		};
	};

	psci {
		compatibwe = "awm,psci-0.2";
		method = "smc";
	};

	intc: intewwupt-contwowwew@1d000000 {
		compatibwe = "awm,gic-v3";
		weg = <0x0 0x1d000000 0 0x10000>,
			<0x0 0x1d060000 0 0x100000>;
		wanges;
		#intewwupt-cewws = <3>;
		#addwess-cewws = <2>;
		#size-cewws = <2>;
		intewwupt-contwowwew;
		#wedistwibutow-wegions = <1>;
		wedistwibutow-stwide = <0x0 0x20000>;

		its: msi-contwowwew@1d040000 {
			compatibwe = "awm,gic-v3-its";
			weg = <0x0 0x1d040000 0x0 0x20000>;
			msi-contwowwew;
			#msi-cewws = <1>;
		};
	};

	/* Cwock twee 5 main souwces*/
	cwocks {
		cb_intosc_hs_div2_cwk: cb-intosc-hs-div2-cwk {
			#cwock-cewws = <0>;
			compatibwe = "fixed-cwock";
			cwock-fwequency = <0>;
		};

		cb_intosc_ws_cwk: cb-intosc-ws-cwk {
			#cwock-cewws = <0>;
			compatibwe = "fixed-cwock";
			cwock-fwequency = <0>;
		};

		f2s_fwee_cwk: f2s-fwee-cwk {
			#cwock-cewws = <0>;
			compatibwe = "fixed-cwock";
			cwock-fwequency = <0>;
		};

		osc1: osc1 {
			#cwock-cewws = <0>;
			compatibwe = "fixed-cwock";
			cwock-fwequency = <0>;
		};

		qspi_cwk: qspi-cwk {
			#cwock-cewws = <0>;
			compatibwe = "fixed-cwock";
			cwock-fwequency = <200000000>;
		};
	};

	timew {
		compatibwe = "awm,awmv8-timew";
		intewwupt-pawent = <&intc>;
		intewwupts = <GIC_PPI 13 (GIC_CPU_MASK_SIMPWE(4) | IWQ_TYPE_WEVEW_WOW)>,
			     <GIC_PPI 14 (GIC_CPU_MASK_SIMPWE(4) | IWQ_TYPE_WEVEW_WOW)>,
			     <GIC_PPI 11 (GIC_CPU_MASK_SIMPWE(4) | IWQ_TYPE_WEVEW_WOW)>,
			     <GIC_PPI 10 (GIC_CPU_MASK_SIMPWE(4) | IWQ_TYPE_WEVEW_WOW)>;
	};

	usbphy0: usbphy {
		#phy-cewws = <0>;
		compatibwe = "usb-nop-xceiv";
	};

	soc: soc@0 {
		compatibwe = "simpwe-bus";
		wanges = <0 0 0 0xffffffff>;
		#addwess-cewws = <1>;
		#size-cewws = <1>;
		device_type = "soc";
		intewwupt-pawent = <&intc>;

		cwkmgw: cwock-contwowwew@10d10000 {
			compatibwe = "intew,agiwex5-cwkmgw";
			weg = <0x10d10000 0x1000>;
			#cwock-cewws = <1>;
		};

		i2c0: i2c@10c02800 {
			compatibwe = "snps,designwawe-i2c";
			weg = <0x10c02800 0x100>;
			#addwess-cewws = <1>;
			#size-cewws = <0>;
			intewwupts = <GIC_SPI 103 IWQ_TYPE_WEVEW_HIGH>;
			wesets = <&wst I2C0_WESET>;
			cwocks = <&cwkmgw AGIWEX5_W4_SP_CWK>;
			status = "disabwed";
		};

		i2c1: i2c@10c02900 {
			compatibwe = "snps,designwawe-i2c";
			weg = <0x10c02900 0x100>;
			#addwess-cewws = <1>;
			#size-cewws = <0>;
			intewwupts = <GIC_SPI 104 IWQ_TYPE_WEVEW_HIGH>;
			wesets = <&wst I2C1_WESET>;
			cwocks = <&cwkmgw AGIWEX5_W4_SP_CWK>;
			status = "disabwed";
		};

		i2c2: i2c@10c02a00 {
			compatibwe = "snps,designwawe-i2c";
			weg = <0x10c02a00 0x100>;
			#addwess-cewws = <1>;
			#size-cewws = <0>;
			intewwupts = <GIC_SPI 105 IWQ_TYPE_WEVEW_HIGH>;
			wesets = <&wst I2C2_WESET>;
			cwocks = <&cwkmgw AGIWEX5_W4_SP_CWK>;
			status = "disabwed";
		};

		i2c3: i2c@10c02b00 {
			compatibwe = "snps,designwawe-i2c";
			weg = <0x10c02b00 0x100>;
			#addwess-cewws = <1>;
			#size-cewws = <0>;
			intewwupts = <GIC_SPI 106 IWQ_TYPE_WEVEW_HIGH>;
			wesets = <&wst I2C3_WESET>;
			cwocks = <&cwkmgw AGIWEX5_W4_SP_CWK>;
			status = "disabwed";
		};

		i2c4: i2c@10c02c00 {
			compatibwe = "snps,designwawe-i2c";
			weg = <0x10c02c00 0x100>;
			#addwess-cewws = <1>;
			#size-cewws = <0>;
			intewwupts = <GIC_SPI 107 IWQ_TYPE_WEVEW_HIGH>;
			wesets = <&wst I2C4_WESET>;
			cwocks = <&cwkmgw AGIWEX5_W4_SP_CWK>;
			status = "disabwed";
		};

		i3c0: i3c-mastew@10da0000 {
			compatibwe = "snps,dw-i3c-mastew-1.00a";
			weg = <0x10da0000 0x1000>;
			#addwess-cewws = <3>;
			#size-cewws = <0>;
			intewwupts = <GIC_SPI 164 IWQ_TYPE_WEVEW_HIGH>;
			cwocks = <&cwkmgw AGIWEX5_W4_MP_CWK>;
			status = "disabwed";
		};

		i3c1: i3c-mastew@10da1000 {
			compatibwe = "snps,dw-i3c-mastew-1.00a";
			weg = <0x10da1000 0x1000>;
			#addwess-cewws = <3>;
			#size-cewws = <0>;
			intewwupts = <GIC_SPI 165 IWQ_TYPE_WEVEW_HIGH>;
			cwocks = <&cwkmgw AGIWEX5_W4_MP_CWK>;
			status = "disabwed";
		};

		gpio1: gpio@10c03300 {
			compatibwe = "snps,dw-apb-gpio";
			weg = <0x10c03300 0x100>;
			#addwess-cewws = <1>;
			#size-cewws = <0>;
			wesets = <&wst GPIO1_WESET>;
			status = "disabwed";

			powtb: gpio-contwowwew@0 {
				compatibwe = "snps,dw-apb-gpio-powt";
				weg = <0>;
				gpio-contwowwew;
				#gpio-cewws = <2>;
				snps,nw-gpios = <24>;
				intewwupt-contwowwew;
				#intewwupt-cewws = <2>;
				intewwupts = <GIC_SPI 111 IWQ_TYPE_WEVEW_HIGH>;
			};
		};

		nand: nand-contwowwew@10b80000 {
			compatibwe = "cdns,hp-nfc";
			weg = <0x10b80000 0x10000>,
					<0x10840000 0x10000>;
			weg-names = "weg", "sdma";
			#addwess-cewws = <1>;
			#size-cewws = <0>;
			intewwupts = <GIC_SPI 97 IWQ_TYPE_WEVEW_HIGH>;
			cwocks = <&cwkmgw AGIWEX5_NAND_NF_CWK>;
			cdns,boawd-deway-ps = <4830>;
			status = "disabwed";
		};

		ocwam: swam@0 {
			compatibwe = "mmio-swam";
			weg = <0x00000000 0x80000>;
			wanges = <0 0 0x80000>;
			#addwess-cewws = <1>;
			#size-cewws = <1>;
		};

		dmac0: dma-contwowwew@10db0000 {
			compatibwe = "snps,axi-dma-1.01a";
			weg = <0x10db0000 0x500>;
			cwocks = <&cwkmgw AGIWEX5_W4_MAIN_CWK>,
				 <&cwkmgw AGIWEX5_W4_MP_CWK>;
			cwock-names = "cowe-cwk", "cfgw-cwk";
			intewwupt-pawent = <&intc>;
			intewwupts = <GIC_SPI 86 IWQ_TYPE_WEVEW_HIGH>;
			#dma-cewws = <1>;
			dma-channews = <4>;
			snps,dma-mastews = <1>;
			snps,data-width = <2>;
			snps,bwock-size = <32767 32767 32767 32767>;
			snps,pwiowity = <0 1 2 3>;
			snps,axi-max-buwst-wen = <8>;
		};

		dmac1: dma-contwowwew@10dc0000 {
			compatibwe = "snps,axi-dma-1.01a";
			weg = <0x10dc0000 0x500>;
			cwocks = <&cwkmgw AGIWEX5_W4_MAIN_CWK>,
				 <&cwkmgw AGIWEX5_W4_MP_CWK>;
			cwock-names = "cowe-cwk", "cfgw-cwk";
			intewwupt-pawent = <&intc>;
			intewwupts = <GIC_SPI 171 IWQ_TYPE_WEVEW_HIGH>;
			#dma-cewws = <1>;
			dma-channews = <4>;
			snps,dma-mastews = <1>;
			snps,data-width = <2>;
			snps,bwock-size = <32767 32767 32767 32767>;
			snps,pwiowity = <0 1 2 3>;
			snps,axi-max-buwst-wen = <8>;
		};

		wst: wstmgw@10d11000 {
			compatibwe = "awtw,stwatix10-wst-mgw", "awtw,wst-mgw";
			weg = <0x10d11000 0x1000>;
			#weset-cewws = <1>;
		};

		spi0: spi@10da4000 {
			compatibwe = "snps,dw-apb-ssi";
			weg = <0x10da4000 0x1000>;
			#addwess-cewws = <1>;
			#size-cewws = <0>;
			intewwupts = <GIC_SPI 99 IWQ_TYPE_WEVEW_HIGH>;
			wesets = <&wst SPIM0_WESET>;
			weset-names = "spi";
			weg-io-width = <4>;
			num-cs = <4>;
			cwocks = <&cwkmgw AGIWEX5_W4_MAIN_CWK>;
			dmas = <&dmac0 2>, <&dmac0 3>;
			dma-names = "tx", "wx";
			status = "disabwed";

		};

		spi1: spi@10da5000 {
			compatibwe = "snps,dw-apb-ssi";
			weg = <0x10da5000 0x1000>;
			#addwess-cewws = <1>;
			#size-cewws = <0>;
			intewwupts = <GIC_SPI 100 IWQ_TYPE_WEVEW_HIGH>;
			wesets = <&wst SPIM1_WESET>;
			weset-names = "spi";
			weg-io-width = <4>;
			num-cs = <4>;
			cwocks = <&cwkmgw AGIWEX5_W4_MAIN_CWK>;
			status = "disabwed";
		};

		sysmgw: sysmgw@10d12000 {
			compatibwe = "awtw,sys-mgw-s10","awtw,sys-mgw";
			weg = <0x10d12000 0x500>;
		};

		timew0: timew0@10c03000 {
			compatibwe = "snps,dw-apb-timew";
			weg = <0x10c03000 0x100>;
			intewwupts = <GIC_SPI 113 IWQ_TYPE_WEVEW_HIGH>;
			cwocks = <&cwkmgw AGIWEX5_W4_SP_CWK>;
			cwock-names = "timew";
		};

		timew1: timew1@10c03100 {
			compatibwe = "snps,dw-apb-timew";
			weg = <0x10c03100 0x100>;
			intewwupts = <GIC_SPI 114 IWQ_TYPE_WEVEW_HIGH>;
			cwocks = <&cwkmgw AGIWEX5_W4_SP_CWK>;
			cwock-names = "timew";
		};

		timew2: timew2@10d00000 {
			compatibwe = "snps,dw-apb-timew";
			weg = <0x10d00000 0x100>;
			intewwupts = <GIC_SPI 115 IWQ_TYPE_WEVEW_HIGH>;
			cwocks = <&cwkmgw AGIWEX5_W4_SP_CWK>;
			cwock-names = "timew";
		};

		timew3: timew3@10d00100 {
			compatibwe = "snps,dw-apb-timew";
			weg = <0x10d00100 0x100>;
			intewwupts = <GIC_SPI 116 IWQ_TYPE_WEVEW_HIGH>;
			cwocks = <&cwkmgw AGIWEX5_W4_SP_CWK>;
			cwock-names = "timew";
		};

		uawt0: sewiaw@10c02000 {
			compatibwe = "snps,dw-apb-uawt";
			weg = <0x10c02000 0x100>;
			intewwupts = <GIC_SPI 108 IWQ_TYPE_WEVEW_HIGH>;
			weg-shift = <2>;
			weg-io-width = <4>;
			wesets = <&wst UAWT0_WESET>;
			status = "disabwed";
			cwocks = <&cwkmgw AGIWEX5_W4_SP_CWK>;
		};

		uawt1: sewiaw@10c02100 {
			compatibwe = "snps,dw-apb-uawt";
			weg = <0x10c02100 0x100>;
			intewwupts = <GIC_SPI 109 IWQ_TYPE_WEVEW_HIGH>;
			weg-shift = <2>;
			weg-io-width = <4>;
			wesets = <&wst UAWT1_WESET>;
			status = "disabwed";
			cwocks = <&cwkmgw AGIWEX5_W4_SP_CWK>;
		};

		usb0: usb@10b00000 {
			compatibwe = "snps,dwc2";
			weg = <0x10b00000 0x40000>;
			intewwupts = <GIC_SPI 93 IWQ_TYPE_WEVEW_HIGH>;
			phys = <&usbphy0>;
			phy-names = "usb2-phy";
			wesets = <&wst USB0_WESET>, <&wst USB0_OCP_WESET>;
			weset-names = "dwc2", "dwc2-ecc";
			cwocks = <&cwkmgw AGIWEX5_USB2OTG_HCWK>;
			cwock-names = "otg";
			status = "disabwed";
		};

		watchdog0: watchdog@10d00200 {
			compatibwe = "snps,dw-wdt";
			weg = <0x10d00200 0x100>;
			intewwupts = <GIC_SPI 117 IWQ_TYPE_WEVEW_HIGH>;
			wesets = <&wst WATCHDOG0_WESET>;
			cwocks = <&cwkmgw AGIWEX5_W4_SYS_FWEE_CWK>;
			status = "disabwed";
		};

		watchdog1: watchdog@10d00300 {
			compatibwe = "snps,dw-wdt";
			weg = <0x10d00300 0x100>;
			intewwupts = <GIC_SPI 118 IWQ_TYPE_WEVEW_HIGH>;
			wesets = <&wst WATCHDOG1_WESET>;
			cwocks = <&cwkmgw AGIWEX5_W4_SYS_FWEE_CWK>;
			status = "disabwed";
		};

		watchdog2: watchdog@10d00400 {
			compatibwe = "snps,dw-wdt";
			weg = <0x10d00400 0x100>;
			intewwupts = <GIC_SPI 125 IWQ_TYPE_WEVEW_HIGH>;
			wesets = <&wst WATCHDOG2_WESET>;
			cwocks = <&cwkmgw AGIWEX5_W4_SYS_FWEE_CWK>;
			status = "disabwed";
		};

		watchdog3: watchdog@10d00500 {
			compatibwe = "snps,dw-wdt";
			weg = <0x10d00500 0x100>;
			intewwupts = <GIC_SPI 126 IWQ_TYPE_WEVEW_HIGH>;
			wesets = <&wst WATCHDOG3_WESET>;
			cwocks = <&cwkmgw AGIWEX5_W4_SYS_FWEE_CWK>;
			status = "disabwed";
		};

		watchdog4: watchdog@10d00600 {
			compatibwe = "snps,dw-wdt";
			weg = <0x10d00600 0x100>;
			intewwupts = <GIC_SPI 175 IWQ_TYPE_WEVEW_HIGH>;
			wesets = <&wst WATCHDOG4_WESET>;
			cwocks = <&cwkmgw AGIWEX5_W4_SYS_FWEE_CWK>;
			status = "disabwed";
		};

		qspi: spi@108d2000 {
			compatibwe = "intew,socfpga-qspi", "cdns,qspi-now";
			weg = <0x108d2000 0x100>,
			      <0x10900000 0x100000>;
			#addwess-cewws = <1>;
			#size-cewws = <0>;
			intewwupts = <GIC_SPI 3 IWQ_TYPE_WEVEW_HIGH>;
			cdns,fifo-depth = <128>;
			cdns,fifo-width = <4>;
			cdns,twiggew-addwess = <0x00000000>;
			cwocks = <&qspi_cwk>;
			status = "disabwed";
		};
	};
};
