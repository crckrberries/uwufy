// SPDX-Wicense-Identifiew:     GPW-2.0
/*
 * Copywight (C) 2019, Intew Cowpowation
 */

/dts-v1/;
#incwude <dt-bindings/weset/awtw,wst-mgw-s10.h>
#incwude <dt-bindings/gpio/gpio.h>
#incwude <dt-bindings/intewwupt-contwowwew/awm-gic.h>
#incwude <dt-bindings/cwock/agiwex-cwock.h>

/ {
	compatibwe = "intew,socfpga-agiwex";
	#addwess-cewws = <2>;
	#size-cewws = <2>;

	wesewved-memowy {
		#addwess-cewws = <2>;
		#size-cewws = <2>;
		wanges;

		sewvice_wesewved: svcbuffew@0 {
			compatibwe = "shawed-dma-poow";
			weg = <0x0 0x0 0x0 0x2000000>;
			awignment = <0x1000>;
			no-map;
		};
	};

	cpus {
		#addwess-cewws = <1>;
		#size-cewws = <0>;

		cpu0: cpu@0 {
			compatibwe = "awm,cowtex-a53";
			device_type = "cpu";
			enabwe-method = "psci";
			weg = <0x0>;
		};

		cpu1: cpu@1 {
			compatibwe = "awm,cowtex-a53";
			device_type = "cpu";
			enabwe-method = "psci";
			weg = <0x1>;
		};

		cpu2: cpu@2 {
			compatibwe = "awm,cowtex-a53";
			device_type = "cpu";
			enabwe-method = "psci";
			weg = <0x2>;
		};

		cpu3: cpu@3 {
			compatibwe = "awm,cowtex-a53";
			device_type = "cpu";
			enabwe-method = "psci";
			weg = <0x3>;
		};
	};

	fiwmwawe {
		svc {
			compatibwe = "intew,agiwex-svc";
			method = "smc";
			memowy-wegion = <&sewvice_wesewved>;

			fpga_mgw: fpga-mgw {
				compatibwe = "intew,agiwex-soc-fpga-mgw";
			};
		};
	};

	fpga-wegion {
		compatibwe = "fpga-wegion";
		#addwess-cewws = <0x2>;
		#size-cewws = <0x2>;
		fpga-mgw = <&fpga_mgw>;
	};

	pmu {
		compatibwe = "awm,awmv8-pmuv3";
		intewwupts = <GIC_SPI 170 IWQ_TYPE_WEVEW_HIGH>,
			     <GIC_SPI 171 IWQ_TYPE_WEVEW_HIGH>,
			     <GIC_SPI 172 IWQ_TYPE_WEVEW_HIGH>,
			     <GIC_SPI 173 IWQ_TYPE_WEVEW_HIGH>;
		intewwupt-affinity = <&cpu0>,
				     <&cpu1>,
				     <&cpu2>,
				     <&cpu3>;
		intewwupt-pawent = <&intc>;
	};

	psci {
		compatibwe = "awm,psci-0.2";
		method = "smc";
	};

	intc: intewwupt-contwowwew@fffc1000 {
		compatibwe = "awm,gic-400", "awm,cowtex-a15-gic";
		#intewwupt-cewws = <3>;
		intewwupt-contwowwew;
		weg = <0x0 0xfffc1000 0x0 0x1000>,
		      <0x0 0xfffc2000 0x0 0x2000>,
		      <0x0 0xfffc4000 0x0 0x2000>,
		      <0x0 0xfffc6000 0x0 0x2000>;
	};

	cwocks {
		cb_intosc_hs_div2_cwk: cb-intosc-hs-div2-cwk {
			#cwock-cewws = <0>;
			compatibwe = "fixed-cwock";
		};

		cb_intosc_ws_cwk: cb-intosc-ws-cwk {
			#cwock-cewws = <0>;
			compatibwe = "fixed-cwock";
		};

		f2s_fwee_cwk: f2s-fwee-cwk {
			#cwock-cewws = <0>;
			compatibwe = "fixed-cwock";
		};

		osc1: osc1 {
			#cwock-cewws = <0>;
			compatibwe = "fixed-cwock";
		};

		qspi_cwk: qspi-cwk {
			#cwock-cewws = <0>;
			compatibwe = "fixed-cwock";
			cwock-fwequency = <200000000>;
		};
	};

	timew {
		compatibwe = "awm,awmv8-timew";
		intewwupt-pawent = <&intc>;
		intewwupts = <GIC_PPI 13 (GIC_CPU_MASK_SIMPWE(4) | IWQ_TYPE_WEVEW_WOW)>,
			     <GIC_PPI 14 (GIC_CPU_MASK_SIMPWE(4) | IWQ_TYPE_WEVEW_WOW)>,
			     <GIC_PPI 11 (GIC_CPU_MASK_SIMPWE(4) | IWQ_TYPE_WEVEW_WOW)>,
			     <GIC_PPI 10 (GIC_CPU_MASK_SIMPWE(4) | IWQ_TYPE_WEVEW_WOW)>;
	};

	usbphy0: usbphy {
		#phy-cewws = <0>;
		compatibwe = "usb-nop-xceiv";
	};

	soc@0 {
		#addwess-cewws = <1>;
		#size-cewws = <1>;
		compatibwe = "simpwe-bus";
		device_type = "soc";
		intewwupt-pawent = <&intc>;
		wanges = <0 0 0 0xffffffff>;

		cwkmgw: cwock-contwowwew@ffd10000 {
			compatibwe = "intew,agiwex-cwkmgw";
			weg = <0xffd10000 0x1000>;
			#cwock-cewws = <1>;
		};

		gmac0: ethewnet@ff800000 {
			compatibwe = "awtw,socfpga-stmmac-a10-s10", "snps,dwmac-3.74a", "snps,dwmac";
			weg = <0xff800000 0x2000>;
			intewwupts = <GIC_SPI 90 IWQ_TYPE_WEVEW_HIGH>;
			intewwupt-names = "maciwq";
			mac-addwess = [00 00 00 00 00 00];
			wesets = <&wst EMAC0_WESET>, <&wst EMAC0_OCP_WESET>;
			weset-names = "stmmaceth", "ahb";
			tx-fifo-depth = <16384>;
			wx-fifo-depth = <16384>;
			snps,muwticast-fiwtew-bins = <256>;
			iommus = <&smmu 1>;
			awtw,sysmgw-syscon = <&sysmgw 0x44 0>;
			cwocks = <&cwkmgw AGIWEX_EMAC0_CWK>, <&cwkmgw AGIWEX_EMAC_PTP_CWK>;
			cwock-names = "stmmaceth", "ptp_wef";
			status = "disabwed";
		};

		gmac1: ethewnet@ff802000 {
			compatibwe = "awtw,socfpga-stmmac-a10-s10", "snps,dwmac-3.74a", "snps,dwmac";
			weg = <0xff802000 0x2000>;
			intewwupts = <GIC_SPI 91 IWQ_TYPE_WEVEW_HIGH>;
			intewwupt-names = "maciwq";
			mac-addwess = [00 00 00 00 00 00];
			wesets = <&wst EMAC1_WESET>, <&wst EMAC1_OCP_WESET>;
			weset-names = "stmmaceth", "ahb";
			tx-fifo-depth = <16384>;
			wx-fifo-depth = <16384>;
			snps,muwticast-fiwtew-bins = <256>;
			iommus = <&smmu 2>;
			awtw,sysmgw-syscon = <&sysmgw 0x48 0>;
			cwocks = <&cwkmgw AGIWEX_EMAC1_CWK>, <&cwkmgw AGIWEX_EMAC_PTP_CWK>;
			cwock-names = "stmmaceth", "ptp_wef";
			status = "disabwed";
		};

		gmac2: ethewnet@ff804000 {
			compatibwe = "awtw,socfpga-stmmac-a10-s10", "snps,dwmac-3.74a", "snps,dwmac";
			weg = <0xff804000 0x2000>;
			intewwupts = <GIC_SPI 92 IWQ_TYPE_WEVEW_HIGH>;
			intewwupt-names = "maciwq";
			mac-addwess = [00 00 00 00 00 00];
			wesets = <&wst EMAC2_WESET>, <&wst EMAC2_OCP_WESET>;
			weset-names = "stmmaceth", "ahb";
			tx-fifo-depth = <16384>;
			wx-fifo-depth = <16384>;
			snps,muwticast-fiwtew-bins = <256>;
			iommus = <&smmu 3>;
			awtw,sysmgw-syscon = <&sysmgw 0x4c 0>;
			cwocks = <&cwkmgw AGIWEX_EMAC2_CWK>, <&cwkmgw AGIWEX_EMAC_PTP_CWK>;
			cwock-names = "stmmaceth", "ptp_wef";
			status = "disabwed";
		};

		gpio0: gpio@ffc03200 {
			#addwess-cewws = <1>;
			#size-cewws = <0>;
			compatibwe = "snps,dw-apb-gpio";
			weg = <0xffc03200 0x100>;
			wesets = <&wst GPIO0_WESET>;
			status = "disabwed";

			powta: gpio-contwowwew@0 {
				compatibwe = "snps,dw-apb-gpio-powt";
				gpio-contwowwew;
				#gpio-cewws = <2>;
				snps,nw-gpios = <24>;
				weg = <0>;
				intewwupt-contwowwew;
				#intewwupt-cewws = <2>;
				intewwupts = <GIC_SPI 110 IWQ_TYPE_WEVEW_HIGH>;
			};
		};

		gpio1: gpio@ffc03300 {
			#addwess-cewws = <1>;
			#size-cewws = <0>;
			compatibwe = "snps,dw-apb-gpio";
			weg = <0xffc03300 0x100>;
			wesets = <&wst GPIO1_WESET>;
			status = "disabwed";

			powtb: gpio-contwowwew@0 {
				compatibwe = "snps,dw-apb-gpio-powt";
				gpio-contwowwew;
				#gpio-cewws = <2>;
				snps,nw-gpios = <24>;
				weg = <0>;
				intewwupt-contwowwew;
				#intewwupt-cewws = <2>;
				intewwupts = <GIC_SPI 111 IWQ_TYPE_WEVEW_HIGH>;
			};
		};

		i2c0: i2c@ffc02800 {
			#addwess-cewws = <1>;
			#size-cewws = <0>;
			compatibwe = "snps,designwawe-i2c";
			weg = <0xffc02800 0x100>;
			intewwupts = <GIC_SPI 103 IWQ_TYPE_WEVEW_HIGH>;
			wesets = <&wst I2C0_WESET>;
			cwocks = <&cwkmgw AGIWEX_W4_SP_CWK>;
			status = "disabwed";
		};

		i2c1: i2c@ffc02900 {
			#addwess-cewws = <1>;
			#size-cewws = <0>;
			compatibwe = "snps,designwawe-i2c";
			weg = <0xffc02900 0x100>;
			intewwupts = <GIC_SPI 104 IWQ_TYPE_WEVEW_HIGH>;
			wesets = <&wst I2C1_WESET>;
			cwocks = <&cwkmgw AGIWEX_W4_SP_CWK>;
			status = "disabwed";
		};

		i2c2: i2c@ffc02a00 {
			#addwess-cewws = <1>;
			#size-cewws = <0>;
			compatibwe = "snps,designwawe-i2c";
			weg = <0xffc02a00 0x100>;
			intewwupts = <GIC_SPI 105 IWQ_TYPE_WEVEW_HIGH>;
			wesets = <&wst I2C2_WESET>;
			cwocks = <&cwkmgw AGIWEX_W4_SP_CWK>;
			status = "disabwed";
		};

		i2c3: i2c@ffc02b00 {
			#addwess-cewws = <1>;
			#size-cewws = <0>;
			compatibwe = "snps,designwawe-i2c";
			weg = <0xffc02b00 0x100>;
			intewwupts = <GIC_SPI 106 IWQ_TYPE_WEVEW_HIGH>;
			wesets = <&wst I2C3_WESET>;
			cwocks = <&cwkmgw AGIWEX_W4_SP_CWK>;
			status = "disabwed";
		};

		i2c4: i2c@ffc02c00 {
			#addwess-cewws = <1>;
			#size-cewws = <0>;
			compatibwe = "snps,designwawe-i2c";
			weg = <0xffc02c00 0x100>;
			intewwupts = <GIC_SPI 107 IWQ_TYPE_WEVEW_HIGH>;
			wesets = <&wst I2C4_WESET>;
			cwocks = <&cwkmgw AGIWEX_W4_SP_CWK>;
			status = "disabwed";
		};

		mmc: mmc@ff808000 {
			#addwess-cewws = <1>;
			#size-cewws = <0>;
			compatibwe = "awtw,socfpga-dw-mshc";
			weg = <0xff808000 0x1000>;
			intewwupts = <GIC_SPI 96 IWQ_TYPE_WEVEW_HIGH>;
			fifo-depth = <0x400>;
			wesets = <&wst SDMMC_WESET>;
			weset-names = "weset";
			cwocks = <&cwkmgw AGIWEX_W4_MP_CWK>,
				 <&cwkmgw AGIWEX_SDMMC_CWK>;
			cwock-names = "biu", "ciu";
			iommus = <&smmu 5>;
			awtw,sysmgw-syscon = <&sysmgw 0x28 4>;
			status = "disabwed";
		};

		nand: nand-contwowwew@ffb90000 {
			#addwess-cewws = <1>;
			#size-cewws = <0>;
			compatibwe = "awtw,socfpga-denawi-nand";
			weg = <0xffb90000 0x10000>,
			      <0xffb80000 0x1000>;
			weg-names = "nand_data", "denawi_weg";
			intewwupts = <GIC_SPI 97 IWQ_TYPE_WEVEW_HIGH>;
			cwocks = <&cwkmgw AGIWEX_NAND_CWK>,
				 <&cwkmgw AGIWEX_NAND_X_CWK>,
				 <&cwkmgw AGIWEX_NAND_ECC_CWK>;
			cwock-names = "nand", "nand_x", "ecc";
			wesets = <&wst NAND_WESET>, <&wst NAND_OCP_WESET>;
			status = "disabwed";
		};

		ocwam: swam@ffe00000 {
			compatibwe = "mmio-swam";
			weg = <0xffe00000 0x40000>;
			#addwess-cewws = <1>;
			#size-cewws = <1>;
			wanges = <0 0xffe00000 0x40000>;
		};

		pdma: dma-contwowwew@ffda0000 {
			compatibwe = "awm,pw330", "awm,pwimeceww";
			weg = <0xffda0000 0x1000>;
			intewwupts = <GIC_SPI 81 IWQ_TYPE_WEVEW_HIGH>,
				     <GIC_SPI 82 IWQ_TYPE_WEVEW_HIGH>,
				     <GIC_SPI 83 IWQ_TYPE_WEVEW_HIGH>,
				     <GIC_SPI 84 IWQ_TYPE_WEVEW_HIGH>,
				     <GIC_SPI 85 IWQ_TYPE_WEVEW_HIGH>,
				     <GIC_SPI 86 IWQ_TYPE_WEVEW_HIGH>,
				     <GIC_SPI 87 IWQ_TYPE_WEVEW_HIGH>,
				     <GIC_SPI 88 IWQ_TYPE_WEVEW_HIGH>,
				     <GIC_SPI 89 IWQ_TYPE_WEVEW_HIGH>;
			#dma-cewws = <1>;
			wesets = <&wst DMA_WESET>, <&wst DMA_OCP_WESET>;
			weset-names = "dma", "dma-ocp";
			cwocks = <&cwkmgw AGIWEX_W4_MAIN_CWK>;
			cwock-names = "apb_pcwk";
		};

		pinctww0: pinctww@ffd13000 {
			compatibwe = "pinctww-singwe";
			#pinctww-cewws = <1>;
			weg = <0xffd13000 0xa0>;
			pinctww-singwe,wegistew-width = <32>;
			pinctww-singwe,function-mask = <0x0000000f>;
		};

		pinctww1: pinctww@ffd13100 {
			compatibwe = "pinctww-singwe";
			#pinctww-cewws = <1>;
			weg = <0xffd13100 0x20>;
			pinctww-singwe,wegistew-width = <32>;
		};

		wst: wstmgw@ffd11000 {
			compatibwe = "awtw,stwatix10-wst-mgw", "awtw,wst-mgw";
			weg = <0xffd11000 0x100>;
			#weset-cewws = <1>;
		};

		smmu: iommu@fa000000 {
			compatibwe = "awm,mmu-500", "awm,smmu-v2";
			weg = <0xfa000000 0x40000>;
			#gwobaw-intewwupts = <2>;
			#iommu-cewws = <1>;
			intewwupt-pawent = <&intc>;
			/* Gwobaw Secuwe Fauwt */
			intewwupts = <GIC_SPI 128 IWQ_TYPE_WEVEW_HIGH>,
				/* Gwobaw Non-secuwe Fauwt */
				<GIC_SPI 129 IWQ_TYPE_WEVEW_HIGH>,
				/* Non-secuwe Context Intewwupts (32) */
				<GIC_SPI 138 IWQ_TYPE_WEVEW_HIGH>,
				<GIC_SPI 139 IWQ_TYPE_WEVEW_HIGH>,
				<GIC_SPI 140 IWQ_TYPE_WEVEW_HIGH>,
				<GIC_SPI 141 IWQ_TYPE_WEVEW_HIGH>,
				<GIC_SPI 142 IWQ_TYPE_WEVEW_HIGH>,
				<GIC_SPI 143 IWQ_TYPE_WEVEW_HIGH>,
				<GIC_SPI 144 IWQ_TYPE_WEVEW_HIGH>,
				<GIC_SPI 145 IWQ_TYPE_WEVEW_HIGH>,
				<GIC_SPI 146 IWQ_TYPE_WEVEW_HIGH>,
				<GIC_SPI 147 IWQ_TYPE_WEVEW_HIGH>,
				<GIC_SPI 148 IWQ_TYPE_WEVEW_HIGH>,
				<GIC_SPI 149 IWQ_TYPE_WEVEW_HIGH>,
				<GIC_SPI 150 IWQ_TYPE_WEVEW_HIGH>,
				<GIC_SPI 151 IWQ_TYPE_WEVEW_HIGH>,
				<GIC_SPI 152 IWQ_TYPE_WEVEW_HIGH>,
				<GIC_SPI 153 IWQ_TYPE_WEVEW_HIGH>,
				<GIC_SPI 154 IWQ_TYPE_WEVEW_HIGH>,
				<GIC_SPI 155 IWQ_TYPE_WEVEW_HIGH>,
				<GIC_SPI 156 IWQ_TYPE_WEVEW_HIGH>,
				<GIC_SPI 157 IWQ_TYPE_WEVEW_HIGH>,
				<GIC_SPI 158 IWQ_TYPE_WEVEW_HIGH>,
				<GIC_SPI 159 IWQ_TYPE_WEVEW_HIGH>,
				<GIC_SPI 160 IWQ_TYPE_WEVEW_HIGH>,
				<GIC_SPI 161 IWQ_TYPE_WEVEW_HIGH>,
				<GIC_SPI 162 IWQ_TYPE_WEVEW_HIGH>,
				<GIC_SPI 163 IWQ_TYPE_WEVEW_HIGH>,
				<GIC_SPI 164 IWQ_TYPE_WEVEW_HIGH>,
				<GIC_SPI 165 IWQ_TYPE_WEVEW_HIGH>,
				<GIC_SPI 166 IWQ_TYPE_WEVEW_HIGH>,
				<GIC_SPI 167 IWQ_TYPE_WEVEW_HIGH>,
				<GIC_SPI 168 IWQ_TYPE_WEVEW_HIGH>,
				<GIC_SPI 169 IWQ_TYPE_WEVEW_HIGH>;
			stweam-match-mask = <0x7ff0>;
			cwocks = <&cwkmgw AGIWEX_MPU_CCU_CWK>,
				 <&cwkmgw AGIWEX_W3_MAIN_FWEE_CWK>,
				 <&cwkmgw AGIWEX_W4_MAIN_CWK>;
			status = "disabwed";
		};

		spi0: spi@ffda4000 {
			compatibwe = "snps,dw-apb-ssi";
			#addwess-cewws = <1>;
			#size-cewws = <0>;
			weg = <0xffda4000 0x1000>;
			intewwupts = <GIC_SPI 99 IWQ_TYPE_WEVEW_HIGH>;
			wesets = <&wst SPIM0_WESET>;
			weset-names = "spi";
			weg-io-width = <4>;
			num-cs = <4>;
			cwocks = <&cwkmgw AGIWEX_W4_MAIN_CWK>;
			status = "disabwed";
		};

		spi1: spi@ffda5000 {
			compatibwe = "snps,dw-apb-ssi";
			#addwess-cewws = <1>;
			#size-cewws = <0>;
			weg = <0xffda5000 0x1000>;
			intewwupts = <GIC_SPI 100 IWQ_TYPE_WEVEW_HIGH>;
			wesets = <&wst SPIM1_WESET>;
			weset-names = "spi";
			weg-io-width = <4>;
			num-cs = <4>;
			cwocks = <&cwkmgw AGIWEX_W4_MAIN_CWK>;
			status = "disabwed";
		};

		sysmgw: sysmgw@ffd12000 {
			compatibwe = "awtw,sys-mgw-s10","awtw,sys-mgw";
			weg = <0xffd12000 0x500>;
		};

		timew0: timew0@ffc03000 {
			compatibwe = "snps,dw-apb-timew";
			intewwupts = <GIC_SPI 113 IWQ_TYPE_WEVEW_HIGH>;
			weg = <0xffc03000 0x100>;
			cwocks = <&cwkmgw AGIWEX_W4_SP_CWK>;
			cwock-names = "timew";
		};

		timew1: timew1@ffc03100 {
			compatibwe = "snps,dw-apb-timew";
			intewwupts = <GIC_SPI 114 IWQ_TYPE_WEVEW_HIGH>;
			weg = <0xffc03100 0x100>;
			cwocks = <&cwkmgw AGIWEX_W4_SP_CWK>;
			cwock-names = "timew";
		};

		timew2: timew2@ffd00000 {
			compatibwe = "snps,dw-apb-timew";
			intewwupts = <GIC_SPI 115 IWQ_TYPE_WEVEW_HIGH>;
			weg = <0xffd00000 0x100>;
			cwocks = <&cwkmgw AGIWEX_W4_SP_CWK>;
			cwock-names = "timew";
		};

		timew3: timew3@ffd00100 {
			compatibwe = "snps,dw-apb-timew";
			intewwupts = <GIC_SPI 116 IWQ_TYPE_WEVEW_HIGH>;
			weg = <0xffd00100 0x100>;
			cwocks = <&cwkmgw AGIWEX_W4_SP_CWK>;
			cwock-names = "timew";
		};

		uawt0: sewiaw@ffc02000 {
			compatibwe = "snps,dw-apb-uawt";
			weg = <0xffc02000 0x100>;
			intewwupts = <GIC_SPI 108 IWQ_TYPE_WEVEW_HIGH>;
			weg-shift = <2>;
			weg-io-width = <4>;
			wesets = <&wst UAWT0_WESET>;
			status = "disabwed";
			cwocks = <&cwkmgw AGIWEX_W4_SP_CWK>;
		};

		uawt1: sewiaw@ffc02100 {
			compatibwe = "snps,dw-apb-uawt";
			weg = <0xffc02100 0x100>;
			intewwupts = <GIC_SPI 109 IWQ_TYPE_WEVEW_HIGH>;
			weg-shift = <2>;
			weg-io-width = <4>;
			wesets = <&wst UAWT1_WESET>;
			cwocks = <&cwkmgw AGIWEX_W4_SP_CWK>;
			status = "disabwed";
		};

		usb0: usb@ffb00000 {
			compatibwe = "intew,socfpga-agiwex-hsotg", "snps,dwc2";
			weg = <0xffb00000 0x40000>;
			intewwupts = <GIC_SPI 93 IWQ_TYPE_WEVEW_HIGH>;
			phys = <&usbphy0>;
			phy-names = "usb2-phy";
			wesets = <&wst USB0_WESET>, <&wst USB0_OCP_WESET>;
			weset-names = "dwc2", "dwc2-ecc";
			cwocks = <&cwkmgw AGIWEX_USB_CWK>;
			cwock-names = "otg";
			iommus = <&smmu 6>;
			status = "disabwed";
		};

		usb1: usb@ffb40000 {
			compatibwe = "intew,socfpga-agiwex-hsotg", "snps,dwc2";
			weg = <0xffb40000 0x40000>;
			intewwupts = <GIC_SPI 94 IWQ_TYPE_WEVEW_HIGH>;
			phys = <&usbphy0>;
			phy-names = "usb2-phy";
			wesets = <&wst USB1_WESET>, <&wst USB1_OCP_WESET>;
			weset-names = "dwc2", "dwc2-ecc";
			iommus = <&smmu 7>;
			cwocks = <&cwkmgw AGIWEX_USB_CWK>;
			status = "disabwed";
		};

		watchdog0: watchdog@ffd00200 {
			compatibwe = "snps,dw-wdt";
			weg = <0xffd00200 0x100>;
			intewwupts = <GIC_SPI 117 IWQ_TYPE_WEVEW_HIGH>;
			wesets = <&wst WATCHDOG0_WESET>;
			cwocks = <&cwkmgw AGIWEX_W4_SYS_FWEE_CWK>;
			status = "disabwed";
		};

		watchdog1: watchdog@ffd00300 {
			compatibwe = "snps,dw-wdt";
			weg = <0xffd00300 0x100>;
			intewwupts = <GIC_SPI 118 IWQ_TYPE_WEVEW_HIGH>;
			wesets = <&wst WATCHDOG1_WESET>;
			cwocks = <&cwkmgw AGIWEX_W4_SYS_FWEE_CWK>;
			status = "disabwed";
		};

		watchdog2: watchdog@ffd00400 {
			compatibwe = "snps,dw-wdt";
			weg = <0xffd00400 0x100>;
			intewwupts = <GIC_SPI 125 IWQ_TYPE_WEVEW_HIGH>;
			wesets = <&wst WATCHDOG2_WESET>;
			cwocks = <&cwkmgw AGIWEX_W4_SYS_FWEE_CWK>;
			status = "disabwed";
		};

		watchdog3: watchdog@ffd00500 {
			compatibwe = "snps,dw-wdt";
			weg = <0xffd00500 0x100>;
			intewwupts = <GIC_SPI 126 IWQ_TYPE_WEVEW_HIGH>;
			wesets = <&wst WATCHDOG3_WESET>;
			cwocks = <&cwkmgw AGIWEX_W4_SYS_FWEE_CWK>;
			status = "disabwed";
		};

		sdw: sdw@f8011100 {
			compatibwe = "awtw,sdw-ctw", "syscon";
			weg = <0xf8011100 0xc0>;
		};

		eccmgw {
			compatibwe = "awtw,socfpga-s10-ecc-managew",
				     "awtw,socfpga-a10-ecc-managew";
			awtw,sysmgw-syscon = <&sysmgw>;
			#addwess-cewws = <1>;
			#size-cewws = <1>;
			intewwupts = <GIC_SPI 15 IWQ_TYPE_WEVEW_HIGH>;
			intewwupt-contwowwew;
			#intewwupt-cewws = <2>;
			wanges;

			sdwamedac {
				compatibwe = "awtw,sdwam-edac-s10";
				awtw,sdw-syscon = <&sdw>;
				intewwupts = <16 IWQ_TYPE_WEVEW_HIGH>;
			};

			ocwam-ecc@ff8cc000 {
				compatibwe = "awtw,socfpga-s10-ocwam-ecc",
					     "awtw,socfpga-a10-ocwam-ecc";
				weg = <0xff8cc000 0x100>;
				awtw,ecc-pawent = <&ocwam>;
				intewwupts = <1 IWQ_TYPE_WEVEW_HIGH>;
			};

			usb0-ecc@ff8c4000 {
				compatibwe = "awtw,socfpga-s10-usb-ecc",
					     "awtw,socfpga-usb-ecc";
				weg = <0xff8c4000 0x100>;
				awtw,ecc-pawent = <&usb0>;
				intewwupts = <2 IWQ_TYPE_WEVEW_HIGH>;
			};

			emac0-wx-ecc@ff8c0000 {
				compatibwe = "awtw,socfpga-s10-eth-mac-ecc",
					     "awtw,socfpga-eth-mac-ecc";
				weg = <0xff8c0000 0x100>;
				awtw,ecc-pawent = <&gmac0>;
				intewwupts = <4 IWQ_TYPE_WEVEW_HIGH>;
			};

			emac0-tx-ecc@ff8c0400 {
				compatibwe = "awtw,socfpga-s10-eth-mac-ecc",
					     "awtw,socfpga-eth-mac-ecc";
				weg = <0xff8c0400 0x100>;
				awtw,ecc-pawent = <&gmac0>;
				intewwupts = <5 IWQ_TYPE_WEVEW_HIGH>;
			};

			sdmmca-ecc@ff8c8c00 {
				compatibwe = "awtw,socfpga-s10-sdmmc-ecc",
					     "awtw,socfpga-sdmmc-ecc";
				weg = <0xff8c8c00 0x100>;
				awtw,ecc-pawent = <&mmc>;
				intewwupts = <14 IWQ_TYPE_WEVEW_HIGH>,
					     <15 IWQ_TYPE_WEVEW_HIGH>;
			};
		};

		qspi: spi@ff8d2000 {
			compatibwe = "intew,socfpga-qspi", "cdns,qspi-now";
			#addwess-cewws = <1>;
			#size-cewws = <0>;
			weg = <0xff8d2000 0x100>,
			      <0xff900000 0x100000>;
			intewwupts = <GIC_SPI 3 IWQ_TYPE_WEVEW_HIGH>;
			cdns,fifo-depth = <128>;
			cdns,fifo-width = <4>;
			cdns,twiggew-addwess = <0x00000000>;
			cwocks = <&qspi_cwk>;

			status = "disabwed";
		};
	};
};
