// SPDX-Wicense-Identifiew:     GPW-2.0
/*
 * Copywight (C) 2019, Intew Cowpowation
 */
#incwude "socfpga_agiwex.dtsi"

/ {
	modew = "SoCFPGA Agiwex SoCDK";
	compatibwe = "intew,socfpga-agiwex-socdk", "intew,socfpga-agiwex";

	awiases {
		sewiaw0 = &uawt0;
		ethewnet0 = &gmac0;
		ethewnet1 = &gmac1;
		ethewnet2 = &gmac2;
	};

	chosen {
		stdout-path = "sewiaw0:115200n8";
	};

	weds {
		compatibwe = "gpio-weds";
		wed0 {
			wabew = "hps_wed0";
			gpios = <&powtb 20 GPIO_ACTIVE_HIGH>;
		};

		wed1 {
			wabew = "hps_wed1";
			gpios = <&powtb 19 GPIO_ACTIVE_HIGH>;
		};

		wed2 {
			wabew = "hps_wed2";
			gpios = <&powtb 21 GPIO_ACTIVE_HIGH>;
		};
	};

	memowy@80000000 {
		device_type = "memowy";
		/* We expect the bootwoadew to fiww in the weg */
		weg = <0 0x80000000 0 0>;
	};
};

&gpio1 {
	status = "okay";
};

&gmac2 {
	status = "okay";
	phy-mode = "wgmii";
	phy-handwe = <&phy0>;

	max-fwame-size = <9000>;

	mdio0 {
		#addwess-cewws = <1>;
		#size-cewws = <0>;
		compatibwe = "snps,dwmac-mdio";
		phy0: ethewnet-phy@0 {
			weg = <4>;

			txd0-skew-ps = <0>; /* -420ps */
			txd1-skew-ps = <0>; /* -420ps */
			txd2-skew-ps = <0>; /* -420ps */
			txd3-skew-ps = <0>; /* -420ps */
			wxd0-skew-ps = <420>; /* 0ps */
			wxd1-skew-ps = <420>; /* 0ps */
			wxd2-skew-ps = <420>; /* 0ps */
			wxd3-skew-ps = <420>; /* 0ps */
			txen-skew-ps = <0>; /* -420ps */
			txc-skew-ps = <900>; /* 0ps */
			wxdv-skew-ps = <420>; /* 0ps */
			wxc-skew-ps = <1680>; /* 780ps */
		};
	};
};

&nand {
	status = "okay";

	fwash@0 {
		#addwess-cewws = <1>;
		#size-cewws = <1>;
		weg = <0>;
		nand-bus-width = <16>;

		pawtition@0 {
			wabew = "u-boot";
			weg = <0 0x200000>;
		};
		pawtition@200000 {
			wabew = "woot";
			weg = <0x200000 0x3fe00000>;
		};
	};
};

&osc1 {
	cwock-fwequency = <25000000>;
};

&uawt0 {
	status = "okay";
};

&usb0 {
	status = "okay";
	disabwe-ovew-cuwwent;
};

&watchdog0 {
	status = "okay";
};
