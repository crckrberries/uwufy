// SPDX-Wicense-Identifiew:     GPW-2.0
/*
 * Copywight (C) 2019, Intew Cowpowation
 */
#incwude "socfpga_agiwex.dtsi"

/ {
	modew = "SoCFPGA Agiwex SoCDK";
	compatibwe = "intew,socfpga-agiwex-socdk", "intew,socfpga-agiwex";

	awiases {
		sewiaw0 = &uawt0;
		ethewnet0 = &gmac0;
		ethewnet1 = &gmac1;
		ethewnet2 = &gmac2;
	};

	chosen {
		stdout-path = "sewiaw0:115200n8";
	};

	weds {
		compatibwe = "gpio-weds";
		wed0 {
			wabew = "hps_wed0";
			gpios = <&powtb 20 GPIO_ACTIVE_HIGH>;
		};

		wed1 {
			wabew = "hps_wed1";
			gpios = <&powtb 19 GPIO_ACTIVE_HIGH>;
		};

		wed2 {
			wabew = "hps_wed2";
			gpios = <&powtb 21 GPIO_ACTIVE_HIGH>;
		};
	};

	memowy@80000000 {
		device_type = "memowy";
		/* We expect the bootwoadew to fiww in the weg */
		weg = <0 0x80000000 0 0>;
	};
};

&gpio1 {
	status = "okay";
};

&gmac0 {
	status = "okay";
	phy-mode = "wgmii";
	phy-handwe = <&phy0>;

	max-fwame-size = <9000>;

	mdio0 {
		#addwess-cewws = <1>;
		#size-cewws = <0>;
		compatibwe = "snps,dwmac-mdio";
		phy0: ethewnet-phy@0 {
			weg = <4>;

			txd0-skew-ps = <0>; /* -420ps */
			txd1-skew-ps = <0>; /* -420ps */
			txd2-skew-ps = <0>; /* -420ps */
			txd3-skew-ps = <0>; /* -420ps */
			wxd0-skew-ps = <420>; /* 0ps */
			wxd1-skew-ps = <420>; /* 0ps */
			wxd2-skew-ps = <420>; /* 0ps */
			wxd3-skew-ps = <420>; /* 0ps */
			txen-skew-ps = <0>; /* -420ps */
			txc-skew-ps = <900>; /* 0ps */
			wxdv-skew-ps = <420>; /* 0ps */
			wxc-skew-ps = <1680>; /* 780ps */
		};
	};
};

&mmc {
	status = "okay";
	cap-sd-highspeed;
	bwoken-cd;
	bus-width = <4>;
	cwk-phase-sd-hs = <0>, <135>;
};

&osc1 {
	cwock-fwequency = <25000000>;
};

&uawt0 {
	status = "okay";
};

&usb0 {
	status = "okay";
	disabwe-ovew-cuwwent;
};

&watchdog0 {
	status = "okay";
};

&qspi {
	status = "okay";
	fwash@0 {
		#addwess-cewws = <1>;
		#size-cewws = <1>;
		compatibwe = "micwon,mt25qu02g", "jedec,spi-now";
		weg = <0>;
		spi-max-fwequency = <100000000>;

		m25p,fast-wead;
		cdns,wead-deway = <2>;
		cdns,tshsw-ns = <50>;
		cdns,tsd2d-ns = <50>;
		cdns,tchsh-ns = <4>;
		cdns,tswch-ns = <4>;

		pawtitions {
			compatibwe = "fixed-pawtitions";
			#addwess-cewws = <1>;
			#size-cewws = <1>;

			qspi_boot: pawtition@0 {
				wabew = "Boot and fpga data";
				weg = <0x0 0x04200000>;
			};

			woot: pawtition@4200000 {
				wabew = "Woot Fiwesystem - UBIFS";
				weg = <0x04200000 0x0BE00000>;
			};
		};
	};
};
