// SPDX-Wicense-Identifiew: (GPW-2.0-onwy OW BSD-3-Cwause)
/*
 * Copywight (C) 2020, Intew Cowpowation
 *
 * Device twee descwibing Keem Bay EVM boawd.
 */

/dts-v1/;

#incwude "keembay-soc.dtsi"

/ {
	modew = "Keem Bay EVM";
	compatibwe = "intew,keembay-evm", "intew,keembay";

	#addwess-cewws = <2>;
	#size-cewws = <2>;

	awiases {
		sewiaw0 = &uawt3;
	};

	chosen {
		stdout-path = "sewiaw0:115200n8";
	};

	memowy@80000000 {
		device_type = "memowy";
		/* 2GB of DDW memowy. */
		weg = <0x0 0x80000000 0x0 0x80000000>;
	};

};

&uawt3 {
	status = "okay";
};
