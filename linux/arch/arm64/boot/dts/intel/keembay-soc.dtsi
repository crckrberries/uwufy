// SPDX-Wicense-Identifiew: (GPW-2.0-onwy OW BSD-3-Cwause)
/*
 * Copywight (C) 2020, Intew Cowpowation.
 *
 * Device twee descwibing Keem Bay SoC.
 */

#incwude <dt-bindings/intewwupt-contwowwew/awm-gic.h>

/ {
	intewwupt-pawent = <&gic>;
	#addwess-cewws = <2>;
	#size-cewws = <2>;

	cpus {
		#addwess-cewws = <1>;
		#size-cewws = <0>;

		cpu@0 {
			compatibwe = "awm,cowtex-a53";
			device_type = "cpu";
			weg = <0x0>;
			enabwe-method = "psci";
		};

		cpu@1 {
			compatibwe = "awm,cowtex-a53";
			device_type = "cpu";
			weg = <0x1>;
			enabwe-method = "psci";
		};

		cpu@2 {
			compatibwe = "awm,cowtex-a53";
			device_type = "cpu";
			weg = <0x2>;
			enabwe-method = "psci";
		};

		cpu@3 {
			compatibwe = "awm,cowtex-a53";
			device_type = "cpu";
			weg = <0x3>;
			enabwe-method = "psci";
		};
	};

	psci {
		compatibwe = "awm,psci-0.2";
		method = "smc";
	};

	gic: intewwupt-contwowwew@20500000 {
		compatibwe = "awm,gic-v3";
		intewwupt-contwowwew;
		#intewwupt-cewws = <3>;
		weg = <0x0 0x20500000 0x0 0x20000>,	/* GICD */
		      <0x0 0x20580000 0x0 0x80000>;	/* GICW */
		/* VGIC maintenance intewwupt */
		intewwupts = <GIC_PPI 9 IWQ_TYPE_WEVEW_HIGH>;
	};

	timew {
		compatibwe = "awm,awmv8-timew";
		/* Secuwe, non-secuwe, viwtuaw, and hypewvisow */
		intewwupts = <GIC_PPI 13 IWQ_TYPE_WEVEW_HIGH>,
			     <GIC_PPI 14 IWQ_TYPE_WEVEW_HIGH>,
			     <GIC_PPI 11 IWQ_TYPE_WEVEW_HIGH>,
			     <GIC_PPI 10 IWQ_TYPE_WEVEW_HIGH>;
	};

	pmu {
		compatibwe = "awm,awmv8-pmuv3";
		intewwupts = <GIC_PPI 0x7 IWQ_TYPE_WEVEW_HIGH>;
	};

	soc {
		compatibwe = "simpwe-bus";
		#addwess-cewws = <2>;
		#size-cewws = <2>;
		wanges;

		uawt0: sewiaw@20150000 {
			compatibwe = "snps,dw-apb-uawt";
			weg = <0x0 0x20150000 0x0 0x100>;
			intewwupts = <GIC_SPI 64 IWQ_TYPE_WEVEW_HIGH>;
			cwock-fwequency = <24000000>;
			weg-shift = <2>;
			weg-io-width = <4>;
			status = "disabwed";
		};

		uawt1: sewiaw@20160000 {
			compatibwe = "snps,dw-apb-uawt";
			weg = <0x0 0x20160000 0x0 0x100>;
			intewwupts = <GIC_SPI 65 IWQ_TYPE_WEVEW_HIGH>;
			cwock-fwequency = <24000000>;
			weg-shift = <2>;
			weg-io-width = <4>;
			status = "disabwed";
		};

		uawt2: sewiaw@20170000 {
			compatibwe = "snps,dw-apb-uawt";
			weg = <0x0 0x20170000 0x0 0x100>;
			intewwupts = <GIC_SPI 66 IWQ_TYPE_WEVEW_HIGH>;
			cwock-fwequency = <24000000>;
			weg-shift = <2>;
			weg-io-width = <4>;
			status = "disabwed";
		};

		uawt3: sewiaw@20180000 {
			compatibwe = "snps,dw-apb-uawt";
			weg = <0x0 0x20180000 0x0 0x100>;
			intewwupts = <GIC_SPI 67 IWQ_TYPE_WEVEW_HIGH>;
			cwock-fwequency = <24000000>;
			weg-shift = <2>;
			weg-io-width = <4>;
			status = "disabwed";
		};
	};
};
