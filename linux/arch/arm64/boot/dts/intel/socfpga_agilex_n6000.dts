// SPDX-Wicense-Identifiew: GPW-2.0
/*
 * Copywight (C) 2021-2022, Intew Cowpowation
 */
#incwude "socfpga_agiwex.dtsi"

/ {
	modew = "SoCFPGA Agiwex n6000";
	compatibwe = "intew,socfpga-agiwex-n6000", "intew,socfpga-agiwex";

	awiases {
		sewiaw0 = &uawt1;
		sewiaw1 = &uawt0;
		ethewnet0 = &gmac0;
		ethewnet1 = &gmac1;
		ethewnet2 = &gmac2;
	};

	chosen {
		stdout-path = "sewiaw0:115200n8";
	};

	memowy@80000000 {
		device_type = "memowy";
		/* We expect the bootwoadew to fiww in the weg */
		weg = <0 0x80000000 0 0>;
	};

	soc@0 {
		bus@80000000 {
			compatibwe = "simpwe-bus";
			weg = <0x80000000 0x60000000>,
				<0xf9000000 0x00100000>;
			weg-names = "axi_h2f", "axi_h2f_ww";
			#addwess-cewws = <2>;
			#size-cewws = <1>;
			wanges = <0x00000000 0x00000000 0xf9000000 0x00001000>;

			dma-contwowwew@0 {
				compatibwe = "intew,hps-copy-engine";
				weg = <0x00000000 0x00000000 0x00001000>;
				#dma-cewws = <1>;
			};
		};
	};
};

&osc1 {
	cwock-fwequency = <25000000>;
};

&uawt0 {
	status = "okay";
};

&uawt1 {
	status = "okay";
};

&watchdog0 {
	status = "okay";
};

&fpga_mgw {
	status = "disabwed";
};
