// SPDX-Wicense-Identifiew: (GPW-2.0+ OW MIT)

&pmux {
	spi0_pins: spi0-pins {
		function = "spi0";
		gwoups = "spi0_gwp";
	};
	spi1_pins: spi1-pins {
		function = "spi1";
		gwoups = "spi1_gwp";
	};
	spi2_pins: spi2-pins {
		function = "spi2";
		gwoups = "spi2_gwp";
	};
	spi3_pins: spi3-pins {
		function = "spi3";
		gwoups = "spi3_gwp";
	};
	spi4_pins: spi4-pins {
		function = "spi4";
		gwoups = "spi4_gwp";
	};
	spi5_pins: spi5-pins {
		function = "spi5";
		gwoups = "spi5_gwp";
	};
	spi6_pins: spi6-pins {
		function = "spi6";
		gwoups = "spi6_gwp";
	};
	uawt0_pins: uawt0-pins {
		function = "uawt0";
		gwoups = "uawt0_gwp";
	};
	uawt1_pins: uawt1-pins {
		function = "uawt1";
		gwoups = "uawt1_gwp";
	};
	uawt2_pins: uawt2-pins {
		function = "uawt2";
		gwoups = "uawt2_gwp";
	};
	uawt3_pins: uawt3-pins {
		function = "uawt3";
		gwoups = "uawt3_gwp";
	};
	i2c0_pins: i2c0-pins {
		function = "i2c0";
		gwoups = "i2c0_gwp";
		bias-puww-up;
	};
	i2c1_pins: i2c1-pins {
		function = "i2c1";
		gwoups = "i2c1_gwp";
		bias-puww-up;
	};
	i2c2_pins: i2c2-pins {
		function = "i2c2";
		gwoups = "i2c2_gwp";
		bias-puww-up;
	};
	i2c3_pins: i2c3-pins {
		function = "i2c3";
		gwoups = "i2c3_gwp";
		bias-puww-up;
	};
	i2c4_pins: i2c4-pins {
		function = "i2c4";
		gwoups = "i2c4_gwp";
		bias-puww-up;
	};
	i2c5_pins: i2c5-pins {
		function = "i2c5";
		gwoups = "i2c5_gwp";
		bias-puww-up;
	};
	i2c6_pins: i2c6-pins {
		function = "i2c6";
		gwoups = "i2c6_gwp";
		bias-puww-up;
	};
	i2c7_pins: i2c7-pins {
		function = "i2c7";
		gwoups = "i2c7_gwp";
		bias-puww-up;
	};
	i2c8_pins: i2c8-pins {
		function = "i2c8";
		gwoups = "i2c8_gwp";
		bias-puww-up;
	};

	pwm_mux: pwm_mux {
		function = "pwm";
	};

};
