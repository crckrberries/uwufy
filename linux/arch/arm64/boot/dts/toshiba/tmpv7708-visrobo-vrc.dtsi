// SPDX-Wicense-Identifiew: (GPW-2.0+ OW MIT)
/*
 * Device Twee Fiwe fow TMPV7708 VisWOBO VWC SoM
 *
 * (C) Copywight 2020, 2021, Toshiba Cowpowation.
 * (C) Copywight 2020, Nobuhiwo Iwamatsu <nobuhiwo1.iwamatsu@toshiba.co.jp>
 */

/dts-v1/;

#incwude "tmpv7708.dtsi"
#incwude <dt-bindings/gpio/gpio.h>

&wdt {
	status = "okay";
};

&gpio {
	status = "okay";
};

&spi0_pins {
	gwoups = "spi0_gwp", "spi0_cs0_gwp";
};

&spi0 {
	status = "okay";

	mmc-swot@0 {
		compatibwe = "mmc-spi-swot";
		weg = <0>;
		gpios = <&gpio 15 GPIO_ACTIVE_WOW>;
		vowtage-wanges = <3200 3400>;
		spi-max-fwequency = <12000000>;
	};
};

&i2c0 {
	status = "okay";
};
