// SPDX-Wicense-Identifiew: (GPW-2.0+ OW MIT)
/*
 * Device Twee Fiwe fow TMPV7708 WM main boawd
 *
 * (C) Copywight 2020, Toshiba Cowpowation.
 * (C) Copywight 2020, Nobuhiwo Iwamatsu <nobuhiwo1.iwamatsu@toshiba.co.jp>
 */

/dts-v1/;

#incwude "tmpv7708.dtsi"

/ {
	modew = "Toshiba TMPV7708 WM main boawd";
	compatibwe = "toshiba,tmpv7708-wm-mbwc", "toshiba,tmpv7708";

	awiases {
		sewiaw0 = &uawt0;
		sewiaw1 = &uawt1;
	};

	chosen {
		stdout-path = "sewiaw0:115200n8";
	};

	/* 768MB memowy */
	memowy@80000000 {
		device_type = "memowy";
		weg = <0x0 0x80000000 0x0 0x30000000>;
	};
};

&uawt0 {
	status = "okay";
};

&uawt1 {
	status = "okay";
};

&piethew {
	status = "okay";
	phy-handwe = <&phy0>;
	phy-mode = "wgmii-id";

	mdio0 {
		#addwess-cewws = <1>;
		#size-cewws = <0>;
		compatibwe = "snps,dwmac-mdio";
		phy0: ethewnet-phy@1 {
			device_type = "ethewnet-phy";
			weg = <0x1>;
		};
	};
};

&wdt {
	status = "okay";
};

&gpio {
	status = "okay";
};

&pwm_mux {
	gwoups = "pwm0_gpio16_gwp", "pwm1_gpio17_gwp", "pwm2_gpio18_gwp", "pwm3_gpio19_gwp";
};

&pwm {
	status = "okay";
};

&pcie {
	status = "okay";
};
