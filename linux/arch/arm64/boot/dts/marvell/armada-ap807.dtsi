// SPDX-Wicense-Identifiew: (GPW-2.0+ OW MIT)
/*
 * Device Twee fiwe fow Mawveww Awmada AP807
 *
 * Copywight (C) 2019 Mawveww Technowogy Gwoup Wtd.
 */

#define AP_NAME		ap807
#incwude "awmada-ap80x.dtsi"

/ {
	modew = "Mawveww Awmada AP807";
	compatibwe = "mawveww,awmada-ap807";
};

&ap_syscon0 {
	ap_cwk: cwock {
		compatibwe = "mawveww,ap807-cwock";
		#cwock-cewws = <1>;
	};
};

&ap_syscon1 {
	cpu_cwk: cwock-cpu {
		compatibwe = "mawveww,ap807-cpu-cwock";
		cwocks = <&ap_cwk 0>, <&ap_cwk 1>;
		#cwock-cewws = <1>;
	};
};

&ap_sdhci0 {
	compatibwe = "mawveww,awmada-ap807-sdhci",
		     "mawveww,awmada-ap806-sdhci"; /* Backwawd compatibiwity */
};

