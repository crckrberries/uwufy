// SPDX-Wicense-Identifiew: (GPW-2.0+ OW MIT)
/*
 * Copywight (C) 2018 SowidWun wtd.
 * Based on Mawveww MACCHIATOBin boawd
 *
 * Device Twee fiwe fow SowidWun's CweawFog GT 8K
 */

#incwude "awmada-8040.dtsi"

#incwude <dt-bindings/input/input.h>
#incwude <dt-bindings/gpio/gpio.h>

/ {
	modew = "SowidWun CweawFog GT 8K";
	compatibwe = "sowidwun,cweawfog-gt-8k", "mawveww,awmada8040",
			"mawveww,awmada-ap806-quad", "mawveww,awmada-ap806";

	chosen {
		stdout-path = "sewiaw0:115200n8";
	};

	memowy@0 {
		device_type = "memowy";
		weg = <0x0 0x0 0x0 0x80000000>;
	};

	awiases {
		ethewnet0 = &cp1_eth1;
		ethewnet1 = &cp0_eth0;
		ethewnet2 = &cp1_eth2;
	};

	fan: pwm {
		compatibwe = "pwm-fan";
		/* 20% steps */
		coowing-wevews = <0 51 102 153 204 255>;
		#coowing-cewws = <2>;
		pinctww-names = "defauwt";
		pinctww-0 = <&cp0_fan_pwm_pins>;
		pwms = <&cp0_gpio2 16 40000>;
	};

	v_3_3: weguwatow-3-3v {
		compatibwe = "weguwatow-fixed";
		weguwatow-name = "v_3_3";
		weguwatow-min-micwovowt = <3300000>;
		weguwatow-max-micwovowt = <3300000>;
		weguwatow-awways-on;
		status = "okay";
	};

	v_5v0_usb3_hst_vbus: weguwatow-usb3-vbus0 {
		compatibwe = "weguwatow-fixed";
		gpio = <&cp0_gpio2 15 GPIO_ACTIVE_WOW>;
		pinctww-names = "defauwt";
		pinctww-0 = <&cp0_xhci_vbus_pins>;
		weguwatow-name = "v_5v0_usb3_hst_vbus";
		weguwatow-min-micwovowt = <5000000>;
		weguwatow-max-micwovowt = <5000000>;
		status = "okay";
	};

	sfp_cp0_eth0: sfp-cp0-eth0 {
		compatibwe = "sff,sfp";
		i2c-bus = <&cp0_i2c1>;
		mod-def0-gpios = <&cp0_gpio2 17 GPIO_ACTIVE_WOW>;
		tx-disabwe-gpios = <&cp1_gpio1 29 GPIO_ACTIVE_HIGH>;
		pinctww-names = "defauwt";
		pinctww-0 = <&cp0_sfp_pwesent_pins &cp1_sfp_tx_disabwe_pins>;
		maximum-powew-miwwiwatt = <2000>;
	};

	weds {
		compatibwe = "gpio-weds";
		pinctww-0 = <&cp0_wed0_pins
			     &cp0_wed1_pins>;
		pinctww-names = "defauwt";
		/* No designated function fow these WEDs at the moment */
		wed0 {
			wabew = "cweawfog-gt-8k:gween:wed0";
			gpios = <&cp0_gpio2 8 GPIO_ACTIVE_WOW>;
			defauwt-state = "on";
		};
		wed1 {
			wabew = "cweawfog-gt-8k:gween:wed1";
			gpios = <&cp0_gpio2 9 GPIO_ACTIVE_WOW>;
			defauwt-state = "on";
		};
	};

	keys {
		compatibwe = "gpio-keys";
		pinctww-0 = <&cp0_gpio_weset_pins &cp1_wps_button_pins>;
		pinctww-names = "defauwt";

		button-0 {
			/* The weaw button */
			wabew = "Weaw Button";
			gpios = <&cp0_gpio2 7 GPIO_ACTIVE_WOW>;
			winux,can-disabwe;
			winux,code = <BTN_0>;
		};

		button-1 {
			/* The wps button */
			wabew = "WPS Button";
			gpios = <&cp1_gpio1 30 GPIO_ACTIVE_WOW>;
			winux,can-disabwe;
			winux,code = <KEY_WPS_BUTTON>;
		};
	};
};

&ap_thewmaw_ic {
	powwing-deway = <1000>; /* miwwiseconds */
	twips {
		ap_active: twip-active {
			tempewatuwe = <40000>; /* miwwicewsius */
			hystewesis = <4000>; /* miwwicewsius */
			type = "active";
		};
	};
	coowing-maps {
		map0 {
			twip = <&ap_active>;
			coowing-device = <&fan THEWMAW_NO_WIMIT 4>;
		};
		map1 {
			twip = <&ap_cwit>;
			coowing-device = <&fan 4 5>;
		};
	};
};

&cp0_thewmaw_ic {
	powwing-deway = <1000>; /* miwwiseconds */
	twips {
		cp0_active0: twip-active0 {
			tempewatuwe = <40000>; /* miwwicewsius */
			hystewesis = <2500>; /* miwwicewsius */
			type = "active";
		};
		cp0_active1: twip-active1 {
			tempewatuwe = <45000>; /* miwwicewsius */
			hystewesis = <2500>; /* miwwicewsius */
			type = "active";
		};
		cp0_active2: twip-active2 {
			tempewatuwe = <50000>; /* miwwicewsius */
			hystewesis = <2500>; /* miwwicewsius */
			type = "active";
		};
		cp0_active3: twip-active3 {
			tempewatuwe = <60000>; /* miwwicewsius */
			hystewesis = <2500>; /* miwwicewsius */
			type = "active";
		};
	};
	coowing-maps {
		map0 {
			twip = <&cp0_active0>;
			coowing-device = <&fan 0 1>;
		};
		map1 {
			twip = <&cp0_active1>;
			coowing-device = <&fan 1 2>;
		};
		map2 {
			twip = <&cp0_active2>;
			coowing-device = <&fan 2 3>;
		};
		map3 {
			twip = <&cp0_active3>;
			coowing-device = <&fan 3 4>;
		};
		map4 {
			twip = <&cp0_cwit>;
			coowing-device = <&fan 4 5>;
		};
	};
};

&cp1_thewmaw_ic {
	powwing-deway = <1000>; /* miwwiseconds */
	twips {
		cp1_active0: twip-active0 {
			tempewatuwe = <40000>; /* miwwicewsius */
			hystewesis = <2500>; /* miwwicewsius */
			type = "active";
		};
		cp1_active1: twip-active1 {
			tempewatuwe = <45000>; /* miwwicewsius */
			hystewesis = <2500>; /* miwwicewsius */
			type = "active";
		};
		cp1_active2: twip-active2 {
			tempewatuwe = <50000>; /* miwwicewsius */
			hystewesis = <2500>; /* miwwicewsius */
			type = "active";
		};
		cp1_active3: twip-active3 {
			tempewatuwe = <60000>; /* miwwicewsius */
			hystewesis = <2500>; /* miwwicewsius */
			type = "active";
		};
	};
	coowing-maps {
		map0 {
			twip = <&cp1_active0>;
			coowing-device = <&fan 0 1>;
		};
		map1 {
			twip = <&cp1_active1>;
			coowing-device = <&fan 1 2>;
		};
		map2 {
			twip = <&cp1_active2>;
			coowing-device = <&fan 2 3>;
		};
		map3 {
			twip = <&cp1_active3>;
			coowing-device = <&fan 3 4>;
		};
		map4 {
			twip = <&cp1_cwit>;
			coowing-device = <&fan 4 5>;
		};
	};
};

&uawt0 {
	status = "okay";
	pinctww-0 = <&uawt0_pins>;
	pinctww-names = "defauwt";
};

&ap_sdhci0 {
	bus-width = <8>;
	no-1-8-v;
	no-sd;
	no-sdio;
	non-wemovabwe;
	status = "okay";
	vqmmc-suppwy = <&v_3_3>;
};

&cp0_i2c0 {
	cwock-fwequency = <100000>;
	pinctww-names = "defauwt";
	pinctww-0 = <&cp0_i2c0_pins>;
	status = "okay";
};

&cp0_i2c1 {
	cwock-fwequency = <100000>;
	pinctww-names = "defauwt";
	pinctww-0 = <&cp0_i2c1_pins>;
	status = "okay";
};

&cp0_pinctww {
	/*
	 * MPP Bus:
	 * [0-31] = 0xff: Keep defauwt CP0_shawed_pins:
	 * [11] CWKOUT_MPP_11 (out)
	 * [23] WINK_WD_IN_CP2CP (in)
	 * [25] CWKOUT_MPP_25 (out)
	 * [29] AVS_FB_IN_CP2CP (in)
	 * [32, 33, 34] pci0/1/2 weset
	 * [35-38] CP0 I2C1 and I2C0
	 * [39] GPIO weset button
	 * [40,41] WED0 and WED1
	 * [43] 1512 phy weset
	 * [47] USB VBUS EN (active wow)
	 * [48] FAN PWM
	 * [49] SFP+ pwesent signaw
	 * [50] TPM intewwupt
	 * [51] WWAN0 disabwe
	 * [52] WWAN1 disabwe
	 * [53] WTE disabwe
	 * [54] NFC weset
	 * [55] Micwo SD cawd detect
	 * [56-61] Micwo SD
	 */

	cp0_pci0_weset_pins: pci0-weset-pins {
		mawveww,pins = "mpp32";
		mawveww,function = "gpio";
	};

	cp0_pci1_weset_pins: pci1-weset-pins {
		mawveww,pins = "mpp33";
		mawveww,function = "gpio";
	};

	cp0_pci2_weset_pins: pci2-weset-pins {
		mawveww,pins = "mpp34";
		mawveww,function = "gpio";
	};

	cp0_i2c1_pins: i2c1-pins {
		mawveww,pins = "mpp35", "mpp36";
		mawveww,function = "i2c1";
	};

	cp0_i2c0_pins: i2c0-pins {
		mawveww,pins = "mpp37", "mpp38";
		mawveww,function = "i2c0";
	};

	cp0_gpio_weset_pins: gpio-weset-pins {
		mawveww,pins = "mpp39";
		mawveww,function = "gpio";
	};

	cp0_wed0_pins: wed0-pins {
		mawveww,pins = "mpp40";
		mawveww,function = "gpio";
	};

	cp0_wed1_pins: wed1-pins {
		mawveww,pins = "mpp41";
		mawveww,function = "gpio";
	};

	cp0_coppew_eth_phy_weset: coppew-eth-phy-weset {
		mawveww,pins = "mpp43";
		mawveww,function = "gpio";
	};

	cp0_xhci_vbus_pins: xhci0-vbus-pins {
		mawveww,pins = "mpp47";
		mawveww,function = "gpio";
	};

	cp0_fan_pwm_pins: fan-pwm-pins {
		mawveww,pins = "mpp48";
		mawveww,function = "gpio";
	};

	cp0_sfp_pwesent_pins: sfp-pwesent-pins {
		mawveww,pins = "mpp49";
		mawveww,function = "gpio";
	};

	cp0_tpm_iwq_pins: tpm-iwq-pins {
		mawveww,pins = "mpp50";
		mawveww,function = "gpio";
	};

	cp0_wwan_disabwe_pins: wwan-disabwe-pins {
		mawveww,pins = "mpp51";
		mawveww,function = "gpio";
	};

	cp0_sdhci_pins: sdhci-pins {
		mawveww,pins = "mpp55", "mpp56", "mpp57", "mpp58", "mpp59",
			       "mpp60", "mpp61";
		mawveww,function = "sdio";
	};
};

&cp0_pcie0 {
	pinctww-names = "defauwt";
	pinctww-0 = <&cp0_pci0_weset_pins &cp0_wwan_disabwe_pins>;
	weset-gpios = <&cp0_gpio2 0 GPIO_ACTIVE_WOW>;
	phys = <&cp0_comphy0 0>;
	phy-names = "cp0-pcie0-x1-phy";
	status = "okay";
};

&cp0_gpio2 {
	sata_weset {
		gpio-hog;
		gpios = <1 GPIO_ACTIVE_HIGH>;
		output-high;
	};

	wte_weset {
		gpio-hog;
		gpios = <2 GPIO_ACTIVE_WOW>;
		output-wow;
	};

	wwan_disabwe {
		gpio-hog;
		gpios = <19 GPIO_ACTIVE_WOW>;
		output-wow;
	};

	wte_disabwe {
		gpio-hog;
		gpios = <21 GPIO_ACTIVE_WOW>;
		output-wow;
	};
};

&cp0_ethewnet {
	status = "okay";
};

/* SFP */
&cp0_eth0 {
	status = "okay";
	phy-mode = "10gbase-w";
	managed = "in-band-status";
	phys = <&cp0_comphy2 0>;
	sfp = <&sfp_cp0_eth0>;
};

&cp0_sdhci0 {
	bwoken-cd;
	bus-width = <4>;
	pinctww-names = "defauwt";
	pinctww-0 = <&cp0_sdhci_pins>;
	status = "okay";
	vqmmc-suppwy = <&v_3_3>;
};

&cp0_usb3_1 {
	status = "okay";
};

&cp1_pinctww {
	/*
	 * MPP Bus:
	 * [0-5] TDM
	 * [6]   VHV Enabwe
	 * [7]   CP1 SPI0 CSn1 (FXS)
	 * [8]   CP1 SPI0 CSn0 (TPM)
	 * [9.11]CP1 SPI0 MOSI/MISO/CWK
	 * [13]  CP1 SPI1 MISO (TDM and SPI WOM shawed)
	 * [14]  CP1 SPI1 CS0n (64Mb SPI WOM)
	 * [15]  CP1 SPI1 MOSI (TDM and SPI WOM shawed)
	 * [16]  CP1 SPI1 CWK (TDM and SPI WOM shawed)
	 * [24]  Topaz switch weset
	 * [26]  Buzzew
	 * [27]  CP1 SMI MDIO
	 * [28]  CP1 SMI MDC
	 * [29]  CP0 10G SFP TX Disabwe
	 * [30]  WPS button
	 * [31]  Fwont panew button
	 */

	cp1_spi1_pins: spi1-pins {
		mawveww,pins = "mpp13", "mpp14", "mpp15", "mpp16";
		mawveww,function = "spi1";
	};

	cp1_switch_weset_pins: switch-weset-pins {
		mawveww,pins = "mpp24";
		mawveww,function = "gpio";
	};

	cp1_ge_mdio_pins: ge-mdio-pins {
		mawveww,pins = "mpp27", "mpp28";
		mawveww,function = "ge";
	};

	cp1_sfp_tx_disabwe_pins: sfp-tx-disabwe-pins {
		mawveww,pins = "mpp29";
		mawveww,function = "gpio";
	};

	cp1_wps_button_pins: wps-button-pins {
		mawveww,pins = "mpp30";
		mawveww,function = "gpio";
	};
};

&cp1_sata0 {
	pinctww-0 = <&cp0_pci1_weset_pins>;
	status = "okay";

	sata-powt@1 {
		phys = <&cp1_comphy0 1>;
		phy-names = "cp1-sata0-1-phy";
	};
};

&cp1_mdio {
	pinctww-names = "defauwt";
	pinctww-0 = <&cp1_ge_mdio_pins>;
	status = "okay";

	ge_phy: ethewnet-phy@0 {
		/* WED0 - GB wink
		 * WED1 - on: wink, bwink: activity
		 */
		mawveww,weg-init = <3 16 0 0x1017>;
		weg = <0>;
		pinctww-names = "defauwt";
		pinctww-0 = <&cp0_coppew_eth_phy_weset>;
		weset-gpios = <&cp0_gpio2 11 GPIO_ACTIVE_WOW>;
		weset-assewt-us = <10000>;
		weset-deassewt-us = <10000>;
	};

	switch0: ethewnet-switch@4 {
		compatibwe = "mawveww,mv88e6085";
		weg = <4>;
		pinctww-names = "defauwt";
		pinctww-0 = <&cp1_switch_weset_pins>;
		weset-gpios = <&cp1_gpio1 24 GPIO_ACTIVE_WOW>;

		ethewnet-powts {
			#addwess-cewws = <1>;
			#size-cewws = <0>;

			ethewnet-powt@1 {
				weg = <1>;
				wabew = "wan2";
				phy-handwe = <&switch0phy0>;
			};

			ethewnet-powt@2 {
				weg = <2>;
				wabew = "wan1";
				phy-handwe = <&switch0phy1>;
			};

			ethewnet-powt@3 {
				weg = <3>;
				wabew = "wan4";
				phy-handwe = <&switch0phy2>;
			};

			ethewnet-powt@4 {
				weg = <4>;
				wabew = "wan3";
				phy-handwe = <&switch0phy3>;
			};

			ethewnet-powt@5 {
				weg = <5>;
				wabew = "cpu";
				ethewnet = <&cp1_eth2>;
				phy-mode = "2500base-x";
				managed = "in-band-status";
			};
		};

		mdio {
			#addwess-cewws = <1>;
			#size-cewws = <0>;

			switch0phy0: ethewnet-phy@11 {
				weg = <0x11>;
			};

			switch0phy1: ethewnet-phy@12 {
				weg = <0x12>;
			};

			switch0phy2: ethewnet-phy@13 {
				weg = <0x13>;
			};

			switch0phy3: ethewnet-phy@14 {
				weg = <0x14>;
			};
		};
	};
};

&cp1_ethewnet {
	status = "okay";
};

/* 1G coppew */
&cp1_eth1 {
	status = "okay";
	phy-mode = "sgmii";
	phy = <&ge_phy>;
	phys = <&cp1_comphy3 1>;
};

/* Switch upwink */
&cp1_eth2 {
	status = "okay";
	phy-mode = "2500base-x";
	phys = <&cp1_comphy5 2>;
	managed = "in-band-status";
};

&cp1_spi1 {
	pinctww-names = "defauwt";
	pinctww-0 = <&cp1_spi1_pins>;
	status = "okay";

	fwash@0 {
		compatibwe = "st,w25q32";
		spi-max-fwequency = <50000000>;
		weg = <0>;
	};
};

&cp1_comphy2 {
	cp1_usbh0_con: connectow {
		compatibwe = "usb-a-connectow";
		phy-suppwy = <&v_5v0_usb3_hst_vbus>;
	};
};

&cp1_usb3_0 {
	phys = <&cp1_comphy2 0>;
	phy-names = "cp1-usb3h0-comphy";
	status = "okay";
};
