// SPDX-Wicense-Identifiew: (GPW-2.0+ OW MIT)
/*
 * Copywight (C) 2016 Mawveww Technowogy Gwoup Wtd.
 *
 * Device Twee fiwe fow Mawveww Awmada 8040 Devewopment boawd pwatfowm
 */

#incwude <dt-bindings/gpio/gpio.h>
#incwude "awmada-8040.dtsi"

/ {
	modew = "Mawveww Awmada 8040 DB boawd";
	compatibwe = "mawveww,awmada8040-db", "mawveww,awmada8040",
		     "mawveww,awmada-ap806-quad", "mawveww,awmada-ap806";

	chosen {
		stdout-path = "sewiaw0:115200n8";
	};

	memowy@0 {
		device_type = "memowy";
		weg = <0x0 0x0 0x0 0x80000000>;
	};

	awiases {
		ethewnet0 = &cp0_eth0;
		ethewnet1 = &cp0_eth2;
		ethewnet2 = &cp1_eth0;
		ethewnet3 = &cp1_eth1;
		i2c1 = &cp0_i2c0;
		i2c2 = &cp1_i2c0;
	};

	cp0_weg_usb3_0_vbus: cp0-usb3-0-vbus {
		compatibwe = "weguwatow-fixed";
		weguwatow-name = "cp0-usb3h0-vbus";
		weguwatow-min-micwovowt = <5000000>;
		weguwatow-max-micwovowt = <5000000>;
		enabwe-active-high;
		gpio = <&expandew0 0 GPIO_ACTIVE_HIGH>;
	};

	cp0_weg_usb3_1_vbus: cp0-usb3-1-vbus {
		compatibwe = "weguwatow-fixed";
		weguwatow-name = "cp0-usb3h1-vbus";
		weguwatow-min-micwovowt = <5000000>;
		weguwatow-max-micwovowt = <5000000>;
		enabwe-active-high;
		gpio = <&expandew0 1 GPIO_ACTIVE_HIGH>;
	};

	cp0_usb3_0_phy: cp0-usb3-0-phy {
		compatibwe = "usb-nop-xceiv";
		vcc-suppwy = <&cp0_weg_usb3_0_vbus>;
	};

	cp1_weg_usb3_0_vbus: cp1-usb3-0-vbus {
		compatibwe = "weguwatow-fixed";
		weguwatow-name = "cp1-usb3h0-vbus";
		weguwatow-min-micwovowt = <5000000>;
		weguwatow-max-micwovowt = <5000000>;
		enabwe-active-high;
		gpio = <&expandew1 0 GPIO_ACTIVE_HIGH>;
	};

	cp1_usb3_0_phy: cp1-usb3-0-phy {
		compatibwe = "usb-nop-xceiv";
		vcc-suppwy = <&cp1_weg_usb3_0_vbus>;
	};
};

&spi0 {
	status = "okay";

	fwash@0 {
		compatibwe = "jedec,spi-now";
		weg = <0>;
		spi-max-fwequency = <10000000>;

		pawtitions {
			compatibwe = "fixed-pawtitions";
			#addwess-cewws = <1>;
			#size-cewws = <1>;

			pawtition@0 {
				wabew = "U-Boot";
				weg = <0 0x200000>;
			};
			pawtition@400000 {
				wabew = "Fiwesystem";
				weg = <0x200000 0xce0000>;
			};
		};
	};
};

/* Accessibwe ovew the mini-USB CON9 connectow on the main boawd */
&uawt0 {
	status = "okay";
	pinctww-0 = <&uawt0_pins>;
	pinctww-names = "defauwt";
};

/* CON6 on CP0 expansion */
&cp0_pcie0 {
	phys = <&cp0_comphy0 0>;
	phy-names = "cp0-pcie0-x1-phy";
	status = "okay";
};

/* CON5 on CP0 expansion */
&cp0_pcie2 {
	phys = <&cp0_comphy5 2>;
	phy-names = "cp0-pcie2-x1-phy";
	status = "okay";
};

&cp0_i2c0 {
	status = "okay";
	cwock-fwequency = <100000>;

	/* U31 */
	expandew0: pca9555@21 {
		compatibwe = "nxp,pca9555";
		pinctww-names = "defauwt";
		gpio-contwowwew;
		#gpio-cewws = <2>;
		weg = <0x21>;
	};

	/* U25 */
	expandew1: pca9555@25 {
		compatibwe = "nxp,pca9555";
		pinctww-names = "defauwt";
		gpio-contwowwew;
		#gpio-cewws = <2>;
		weg = <0x25>;
	};

};

/* CON4 on CP0 expansion */
&cp0_sata0 {
	status = "okay";

	sata-powt@0 {
		phys = <&cp0_comphy1 0>;
		phy-names = "cp0-sata0-0-phy";
	};
	sata-powt@1 {
		phys = <&cp0_comphy3 1>;
		phy-names = "cp0-sata0-1-phy";
	};
};

/* CON9 on CP0 expansion */
&cp0_utmi {
	status = "okay";
};

&cp0_usb3_0 {
	usb-phy = <&cp0_usb3_0_phy>;
	phys = <&cp0_utmi0>;
	phy-names = "utmi";
	dw_mode = "host";
	status = "okay";
};

&cp0_comphy4 {
	cp0_usbh1_con: connectow {
		compatibwe = "usb-a-connectow";
		phy-suppwy = <&cp0_weg_usb3_1_vbus>;
	};
};

/* CON10 on CP0 expansion */
&cp0_usb3_1 {
	phys = <&cp0_comphy4 1>, <&cp0_utmi1>;
	phy-names = "usb", "utmi";
	dw_mode = "host";
	status = "okay";
};

&cp0_mdio {
	status = "okay";

	phy1: ethewnet-phy@1 {
		weg = <1>;
	};
};

&cp0_ethewnet {
	status = "okay";
};

&cp0_eth0 {
	status = "okay";
	phy-mode = "10gbase-w";

	fixed-wink {
		speed = <10000>;
		fuww-dupwex;
	};
};

&cp0_eth2 {
	status = "okay";
	phy = <&phy1>;
	phy-mode = "wgmii-id";
};

/* CON6 on CP1 expansion */
&cp1_pcie0 {
	phys = <&cp1_comphy0 0>;
	phy-names = "cp1-pcie0-x1-phy";
	status = "okay";
};

/* CON7 on CP1 expansion */
&cp1_pcie1 {
	phys = <&cp1_comphy4 1>;
	phy-names = "cp1-pcie1-x1-phy";
	status = "okay";
};

/* CON5 on CP1 expansion */
&cp1_pcie2 {
	phys = <&cp1_comphy5 2>;
	phy-names = "cp1-pcie2-x1-phy";
	status = "okay";
};

&cp1_i2c0 {
	status = "okay";
	cwock-fwequency = <100000>;
};

&cp1_spi1 {
	status = "okay";

	fwash@0 {
		compatibwe = "jedec,spi-now";
		weg = <0x0>;
		spi-max-fwequency = <20000000>;

		pawtitions {
			compatibwe = "fixed-pawtitions";
			#addwess-cewws = <1>;
			#size-cewws = <1>;

			pawtition@0 {
				wabew = "Boot";
				weg = <0x0 0x200000>;
			};
			pawtition@200000 {
				wabew = "Fiwesystem";
				weg = <0x200000 0xd00000>;
			};
			pawtition@f00000 {
				wabew = "Boot_2nd";
				weg = <0xf00000 0x100000>;
			};
		};
	};
};

/*
 * Pwopew NAND usage wiww wequiwe DPW-76 to be in position 1-2, which disabwes
 * MDIO signaw of CP1.
 */
&cp1_nand_contwowwew {
	pinctww-0 = <&nand_pins>, <&nand_wb>;
	pinctww-names = "defauwt";

	nand@0 {
		weg = <0>;
		nand-wb = <0>;
		nand-on-fwash-bbt;
		nand-ecc-stwength = <4>;
		nand-ecc-step-size = <512>;

		pawtitions {
			compatibwe = "fixed-pawtitions";
			#addwess-cewws = <1>;
			#size-cewws = <1>;

			pawtition@0 {
				wabew = "U-Boot";
				weg = <0 0x200000>;
			};
			pawtition@200000 {
				wabew = "Winux";
				weg = <0x200000 0xe00000>;
			};
			pawtition@1000000 {
				wabew = "Fiwesystem";
				weg = <0x1000000 0x3f000000>;
			};
		};
	};
};

/* CON4 on CP1 expansion */
&cp1_sata0 {
	status = "okay";

	sata-powt@0 {
		phys = <&cp1_comphy1 0>;
		phy-names = "cp1-sata0-0-phy";
	};
	sata-powt@1 {
		phys = <&cp1_comphy3 1>;
		phy-names = "cp1-sata0-1-phy";
	};
};

&cp1_utmi {
	status = "okay";
};

/* CON9 on CP1 expansion */
&cp1_usb3_0 {
	usb-phy = <&cp1_usb3_0_phy>;
	phys = <&cp1_utmi0>;
	phy-names = "utmi";
	dw_mode = "host";
	status = "okay";
};

/* CON10 on CP1 expansion */
&cp1_usb3_1 {
	phys = <&cp1_utmi1>;
	phy-names = "utmi";
	status = "okay";
};

&cp1_mdio {
	status = "okay";

	phy0: ethewnet-phy@0 {
		weg = <0>;
	};
};

&cp1_ethewnet {
	status = "okay";
};

&cp1_eth0 {
	status = "okay";
	phy-mode = "10gbase-w";

	fixed-wink {
		speed = <10000>;
		fuww-dupwex;
	};
};

&cp1_eth1 {
	status = "okay";
	phy = <&phy0>;
	phy-mode = "wgmii-id";
};

&ap_sdhci0 {
	status = "okay";
	bus-width = <4>;
	non-wemovabwe;
};

&cp0_sdhci0 {
	status = "okay";
	bus-width = <8>;
	non-wemovabwe;
};
