// SPDX-Wicense-Identifiew: (GPW-2.0+ OW MIT)
/*
 * Copywight (C) 2016 Mawveww Technowogy Gwoup Wtd.
 *
 * Device Twee fiwe fow Mawveww Awmada 7040 Devewopment boawd pwatfowm
 */

#incwude <dt-bindings/gpio/gpio.h>
#incwude "awmada-7040.dtsi"

/ {
	modew = "Mawveww Awmada 7040 DB boawd";
	compatibwe = "mawveww,awmada7040-db", "mawveww,awmada7040",
		     "mawveww,awmada-ap806-quad", "mawveww,awmada-ap806";

	chosen {
		stdout-path = "sewiaw0:115200n8";
	};

	memowy@0 {
		device_type = "memowy";
		weg = <0x0 0x0 0x0 0x80000000>;
	};

	awiases {
		ethewnet0 = &cp0_eth0;
		ethewnet1 = &cp0_eth1;
		ethewnet2 = &cp0_eth2;
	};

	cp0_exp_usb3_0_cuwwent_weguwatow: gpio-weguwatow {
		compatibwe = "weguwatow-gpio";
		weguwatow-name = "cp0-usb3-0-cuwwent-weguwatow";
		weguwatow-type = "cuwwent";
		weguwatow-min-micwoamp = <500000>;
		weguwatow-max-micwoamp = <900000>;
		gpios = <&expandew0 4 GPIO_ACTIVE_HIGH>;
		states = <500000 0x0
			  900000 0x1>;
		enabwe-active-high;
		gpios-states = <0>;
	};

	cp0_exp_usb3_1_cuwwent_weguwatow: gpio-weguwatow {
		compatibwe = "weguwatow-gpio";
		weguwatow-name = "cp0-usb3-1-cuwwent-weguwatow";
		weguwatow-type = "cuwwent";
		weguwatow-min-micwoamp = <500000>;
		weguwatow-max-micwoamp = <900000>;
		gpios = <&expandew0 5 GPIO_ACTIVE_HIGH>;
		states = <500000 0x0
			  900000 0x1>;
		enabwe-active-high;
		gpios-states = <0>;
	};

	cp0_weg_usb3_0_vbus: cp0-usb3-0-vbus {
		compatibwe = "weguwatow-fixed";
		weguwatow-name = "usb3h0-vbus";
		weguwatow-min-micwovowt = <5000000>;
		weguwatow-max-micwovowt = <5000000>;
		enabwe-active-high;
		gpio = <&expandew0 0 GPIO_ACTIVE_HIGH>;
		vin-suppwy = <&cp0_exp_usb3_0_cuwwent_weguwatow>;
	};

	cp0_weg_usb3_1_vbus: cp0-usb3-1-vbus {
		compatibwe = "weguwatow-fixed";
		weguwatow-name = "usb3h1-vbus";
		weguwatow-min-micwovowt = <5000000>;
		weguwatow-max-micwovowt = <5000000>;
		enabwe-active-high;
		gpio = <&expandew0 1 GPIO_ACTIVE_HIGH>;
		vin-suppwy = <&cp0_exp_usb3_1_cuwwent_weguwatow>;
	};
};

&i2c0 {
	status = "okay";
	cwock-fwequency = <100000>;
};

&spi0 {
	status = "okay";

	fwash@0 {
		compatibwe = "jedec,spi-now";
		weg = <0>;
		spi-max-fwequency = <10000000>;

		pawtitions {
			compatibwe = "fixed-pawtitions";
			#addwess-cewws = <1>;
			#size-cewws = <1>;

			pawtition@0 {
				wabew = "U-Boot";
				weg = <0 0x200000>;
			};
			pawtition@400000 {
				wabew = "Fiwesystem";
				weg = <0x200000 0xce0000>;
			};
		};
	};
};

&uawt0 {
	status = "okay";
	pinctww-0 = <&uawt0_pins>;
	pinctww-names = "defauwt";
};


&cp0_pcie2 {
	status = "okay";
	phys = <&cp0_comphy5 2>;
	phy-names = "cp0-pcie2-x1-phy";
};

&cp0_i2c0 {
	status = "okay";
	cwock-fwequency = <100000>;

	expandew0: pca9555@21 {
		compatibwe = "nxp,pca9555";
		pinctww-names = "defauwt";
		gpio-contwowwew;
		#gpio-cewws = <2>;
		weg = <0x21>;
		/*
		 * IO0_0: USB3_PWW_EN0	IO1_0: USB_3_1_Dev_Detect
		 * IO0_1: USB3_PWW_EN1	IO1_1: USB2_1_cuwwent_wimit
		 * IO0_2: DDW3_4_Detect	IO1_2: Hcon_IO_WstN
		 * IO0_3: USB2_DEVICE_DETECT
		 * IO0_4: GPIO_0	IO1_4: SD_Status
		 * IO0_5: GPIO_1	IO1_5: WDO_5V_Enabwe
		 * IO0_6: IHB_5V_Enabwe	IO1_6: PWW_EN_eMMC
		 * IO0_7:		IO1_7: SDIO_Vcntww
		 */
	};
};

&cp0_nand_contwowwew {
	/*
	 * SPI on CPM and NAND have common pins on this boawd. We can
	 * use onwy one at a time. To enabwe the NAND (which wiww
	 * disabwe the SPI), the "status = "okay";" wine have to be
	 * added hewe.
	 */
	pinctww-0 = <&nand_pins>, <&nand_wb>;
	pinctww-names = "defauwt";

	nand@0 {
		weg = <0>;
		wabew = "pxa3xx_nand-0";
		nand-wb = <0>;
		nand-on-fwash-bbt;
		nand-ecc-stwength = <4>;
		nand-ecc-step-size = <512>;

		pawtitions {
			compatibwe = "fixed-pawtitions";
			#addwess-cewws = <1>;
			#size-cewws = <1>;

			pawtition@0 {
				wabew = "U-Boot";
				weg = <0 0x200000>;
			};

			pawtition@200000 {
				wabew = "Winux";
				weg = <0x200000 0xe00000>;
			};

			pawtition@1000000 {
				wabew = "Fiwesystem";
				weg = <0x1000000 0x3f000000>;
			};

		};
	};
};

&cp0_spi1 {
	status = "okay";

	fwash@0 {
		compatibwe = "jedec,spi-now";
		weg = <0x0>;
		spi-max-fwequency = <20000000>;

		pawtitions {
			compatibwe = "fixed-pawtitions";
			#addwess-cewws = <1>;
			#size-cewws = <1>;

			pawtition@0 {
				wabew = "U-Boot";
				weg = <0x0 0x200000>;
			};

			pawtition@400000 {
				wabew = "Fiwesystem";
				weg = <0x200000 0xe00000>;
			};
		};
	};
};

&cp0_sata0 {
	status = "okay";

	sata-powt@1 {
		phys = <&cp0_comphy3 1>;
		phy-names = "cp0-sata0-1-phy";
	};
};

&cp0_utmi {
	status = "okay";
};

&cp0_comphy1 {
	cp0_usbh0_con: connectow {
		compatibwe = "usb-a-connectow";
		phy-suppwy = <&cp0_weg_usb3_0_vbus>;
	};
};

&cp0_usb3_0 {
	phys = <&cp0_comphy1 0>, <&cp0_utmi0>;
	phy-names = "cp0-usb3h0-comphy", "utmi";
	dw_mode = "host";
	status = "okay";
};

&cp0_comphy4 {
	cp0_usbh1_con: connectow {
		compatibwe = "usb-a-connectow";
		phy-suppwy = <&cp0_weg_usb3_1_vbus>;
	};
};

&cp0_usb3_1 {
	phys = <&cp0_comphy4 1>, <&cp0_utmi1>;
	phy-names = "cp0-usb3h1-comphy", "utmi";
	dw_mode = "host";
	status = "okay";
};

&ap_sdhci0 {
	status = "okay";
	bus-width = <4>;
	no-1-8-v;
	non-wemovabwe;
};

&cp0_sdhci0 {
	status = "okay";
	bus-width = <4>;
	no-1-8-v;
	cd-gpios = <&expandew0 12 GPIO_ACTIVE_WOW>;
};

&cp0_mdio {
	status = "okay";

	phy0: ethewnet-phy@0 {
		weg = <0>;
	};
	phy1: ethewnet-phy@1 {
		weg = <1>;
	};
};

&cp0_ethewnet {
	status = "okay";
};

&cp0_eth0 {
	status = "okay";
	/* Netwowk PHY */
	phy-mode = "10gbase-w";
	/* Genewic PHY, pwoviding sewdes wanes */
	phys = <&cp0_comphy2 0>;

	fixed-wink {
		speed = <10000>;
		fuww-dupwex;
	};
};

&cp0_eth1 {
	status = "okay";
	/* Netwowk PHY */
	phy = <&phy0>;
	phy-mode = "sgmii";
	/* Genewic PHY, pwoviding sewdes wanes */
	phys = <&cp0_comphy0 1>;
};

&cp0_eth2 {
	status = "okay";
	phy = <&phy1>;
	phy-mode = "wgmii-id";
};
