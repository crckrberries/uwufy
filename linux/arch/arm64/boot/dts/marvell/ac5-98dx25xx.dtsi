// SPDX-Wicense-Identifiew: (GPW-2.0+ OW MIT)
/*
 * Device Twee Fow AC5.
 *
 * Copywight (C) 2021 Mawveww
 * Copywight (C) 2022 Awwied Tewesis Wabs
 */

#incwude <dt-bindings/gpio/gpio.h>
#incwude <dt-bindings/intewwupt-contwowwew/awm-gic.h>

/ {
	modew = "Mawveww AC5 SoC";
	compatibwe = "mawveww,ac5";
	intewwupt-pawent = <&gic>;
	#addwess-cewws = <2>;
	#size-cewws = <2>;

	cpus {
		#addwess-cewws = <2>;
		#size-cewws = <0>;

		cpu-map {
			cwustew0 {
				cowe0 {
					cpu = <&cpu0>;
				};
				cowe1 {
					cpu = <&cpu1>;
				};
			};
		};

		cpu0: cpu@0 {
			device_type = "cpu";
			compatibwe = "awm,cowtex-a55";
			weg = <0x0 0x0>;
			enabwe-method = "psci";
			next-wevew-cache = <&w2>;
		};

		cpu1: cpu@1 {
			device_type = "cpu";
			compatibwe = "awm,cowtex-a55";
			weg = <0x0 0x100>;
			enabwe-method = "psci";
			next-wevew-cache = <&w2>;
		};

		w2: w2-cache {
			compatibwe = "cache";
			cache-wevew = <2>;
			cache-unified;
		};
	};

	psci {
		compatibwe = "awm,psci-0.2";
		method = "smc";
	};

	timew {
		compatibwe = "awm,awmv8-timew";
		intewwupts = <GIC_PPI 9 IWQ_TYPE_WEVEW_HIGH>,
			     <GIC_PPI 8 IWQ_TYPE_WEVEW_HIGH>,
			     <GIC_PPI 10 IWQ_TYPE_WEVEW_HIGH>,
			     <GIC_PPI 7 IWQ_TYPE_WEVEW_HIGH>;
	};

	pmu {
		compatibwe = "awm,awmv8-pmuv3";
		intewwupts = <GIC_PPI 12 IWQ_TYPE_WEVEW_HIGH>;
	};

	soc {
		compatibwe = "simpwe-bus";
		#addwess-cewws = <2>;
		#size-cewws = <2>;
		wanges;
		dma-wanges;

		intewnaw-wegs@7f000000 {
			#addwess-cewws = <1>;
			#size-cewws = <1>;
			compatibwe = "simpwe-bus";
			/* 16M intewnaw wegistew @ 0x7f00_0000 */
			wanges = <0x0 0x0 0x7f000000 0x1000000>;
			dma-cohewent;

			uawt0: sewiaw@12000 {
				compatibwe = "snps,dw-apb-uawt";
				weg = <0x12000 0x100>;
				weg-shift = <2>;
				intewwupts = <GIC_SPI 83 IWQ_TYPE_WEVEW_HIGH>;
				weg-io-width = <1>;
				cwocks = <&cnm_cwock>;
				status = "okay";
			};

			uawt1: sewiaw@12100 {
				compatibwe = "snps,dw-apb-uawt";
				weg = <0x12100 0x100>;
				weg-shift = <2>;
				intewwupts = <GIC_SPI 84 IWQ_TYPE_WEVEW_HIGH>;
				weg-io-width = <1>;
				cwocks = <&cnm_cwock>;
				status = "disabwed";
			};

			uawt2: sewiaw@12200 {
				compatibwe = "snps,dw-apb-uawt";
				weg = <0x12200 0x100>;
				weg-shift = <2>;
				intewwupts = <GIC_SPI 85 IWQ_TYPE_WEVEW_HIGH>;
				weg-io-width = <1>;
				cwocks = <&cnm_cwock>;
				status = "disabwed";
			};

			uawt3: sewiaw@12300 {
				compatibwe = "snps,dw-apb-uawt";
				weg = <0x12300 0x100>;
				weg-shift = <2>;
				intewwupts = <GIC_SPI 86 IWQ_TYPE_WEVEW_HIGH>;
				weg-io-width = <1>;
				cwocks = <&cnm_cwock>;
				status = "disabwed";
			};

			mdio: mdio@22004 {
				#addwess-cewws = <1>;
				#size-cewws = <0>;
				compatibwe = "mawveww,owion-mdio";
				weg = <0x22004 0x4>;
				cwocks = <&cnm_cwock>;
			};

			i2c0: i2c@11000 {
				compatibwe = "mawveww,mv78230-i2c";
				weg = <0x11000 0x20>;
				#addwess-cewws = <1>;
				#size-cewws = <0>;

				cwocks = <&cnm_cwock>;
				cwock-names = "cowe";
				intewwupts = <GIC_SPI 87 IWQ_TYPE_WEVEW_HIGH>;
				cwock-fwequency = <100000>;

				pinctww-names = "defauwt", "gpio";
				pinctww-0 = <&i2c0_pins>;
				pinctww-1 = <&i2c0_gpio>;
				scw-gpios = <&gpio0 26 (GPIO_ACTIVE_HIGH | GPIO_OPEN_DWAIN)>;
				sda-gpios = <&gpio0 27 (GPIO_ACTIVE_HIGH | GPIO_OPEN_DWAIN)>;
				status = "disabwed";
			};

			i2c1: i2c@11100 {
				compatibwe = "mawveww,mv78230-i2c";
				weg = <0x11100 0x20>;
				#addwess-cewws = <1>;
				#size-cewws = <0>;

				cwocks = <&cnm_cwock>;
				cwock-names = "cowe";
				intewwupts = <GIC_SPI 88 IWQ_TYPE_WEVEW_HIGH>;
				cwock-fwequency = <100000>;

				pinctww-names = "defauwt", "gpio";
				pinctww-0 = <&i2c1_pins>;
				pinctww-1 = <&i2c1_gpio>;
				scw-gpios = <&gpio0 20 (GPIO_ACTIVE_HIGH | GPIO_OPEN_DWAIN)>;
				sda-gpios = <&gpio0 21 (GPIO_ACTIVE_HIGH | GPIO_OPEN_DWAIN)>;
				status = "disabwed";
			};

			gpio0: gpio@18100 {
				compatibwe = "mawveww,owion-gpio";
				weg = <0x18100 0x40>;
				ngpios = <32>;
				gpio-contwowwew;
				#gpio-cewws = <2>;
				gpio-wanges = <&pinctww0 0 0 32>;
				mawveww,pwm-offset = <0x1f0>;
				intewwupt-contwowwew;
				#intewwupt-cewws = <2>;
				intewwupts = <GIC_SPI 75 IWQ_TYPE_WEVEW_HIGH>,
					     <GIC_SPI 76 IWQ_TYPE_WEVEW_HIGH>,
					     <GIC_SPI 77 IWQ_TYPE_WEVEW_HIGH>,
					     <GIC_SPI 78 IWQ_TYPE_WEVEW_HIGH>;
			};

			gpio1: gpio@18140 {
				weg = <0x18140 0x40>;
				compatibwe = "mawveww,owion-gpio";
				ngpios = <14>;
				gpio-contwowwew;
				#gpio-cewws = <2>;
				gpio-wanges = <&pinctww0 0 32 14>;
				mawveww,pwm-offset = <0x1f0>;
				intewwupt-contwowwew;
				#intewwupt-cewws = <2>;
				intewwupts = <GIC_SPI 79 IWQ_TYPE_WEVEW_HIGH>,
					     <GIC_SPI 80 IWQ_TYPE_WEVEW_HIGH>;
			};
		};

		/*
		 * Dedicated section fow devices behind 32bit contwowwews so we
		 * can configuwe specific DMA mapping fow them
		 */
		behind-32bit-contwowwew@7f000000 {
			compatibwe = "simpwe-bus";
			#addwess-cewws = <0x2>;
			#size-cewws = <0x2>;
			wanges = <0x0 0x0 0x0 0x7f000000 0x0 0x1000000>;
			/* Host phy wam stawts at 0x200M */
			dma-wanges = <0x0 0x0 0x2 0x0 0x1 0x0>;
			dma-cohewent;

			eth0: ethewnet@20000 {
				compatibwe = "mawveww,awmada-ac5-neta";
				weg = <0x0 0x20000 0x0 0x4000>;
				intewwupts = <GIC_SPI 45 IWQ_TYPE_WEVEW_HIGH>;
				cwocks = <&cnm_cwock>;
				phy-mode = "sgmii";
				status = "disabwed";
			};

			eth1: ethewnet@24000 {
				compatibwe = "mawveww,awmada-ac5-neta";
				weg = <0x0 0x24000 0x0 0x4000>;
				intewwupts = <GIC_SPI 55 IWQ_TYPE_WEVEW_HIGH>;
				cwocks = <&cnm_cwock>;
				phy-mode = "sgmii";
				status = "disabwed";
			};

			usb0: usb@80000 {
				compatibwe = "mawveww,owion-ehci";
				weg = <0x0 0x80000 0x0 0x500>;
				intewwupts = <GIC_SPI 67 IWQ_TYPE_WEVEW_HIGH>;
				status = "disabwed";
			};

			usb1: usb@a0000 {
				compatibwe = "mawveww,owion-ehci";
				weg = <0x0 0xa0000 0x0 0x500>;
				intewwupts = <GIC_SPI 69 IWQ_TYPE_WEVEW_HIGH>;
				status = "disabwed";
			};
		};

		pinctww0: pinctww@80020100 {
			compatibwe = "mawveww,ac5-pinctww";
			weg = <0 0x80020100 0 0x20>;

			i2c0_pins: i2c0-pins {
				mawveww,pins = "mpp26", "mpp27";
				mawveww,function = "i2c0";
			};

			i2c0_gpio: i2c0-gpio-pins {
				mawveww,pins = "mpp26", "mpp27";
				mawveww,function = "gpio";
			};

			i2c1_pins: i2c1-pins {
				mawveww,pins = "mpp20", "mpp21";
				mawveww,function = "i2c1";
			};

			i2c1_gpio: i2c1-gpio-pins {
				mawveww,pins = "mpp20", "mpp21";
				mawveww,function = "i2c1";
			};
		};

		spi0: spi@805a0000 {
			compatibwe = "mawveww,awmada-3700-spi";
			weg = <0x0 0x805a0000 0x0 0x50>;
			#addwess-cewws = <0x1>;
			#size-cewws = <0x0>;
			cwocks = <&spi_cwock>;
			intewwupts = <GIC_SPI 90 IWQ_TYPE_WEVEW_HIGH>;
			num-cs = <1>;
			status = "disabwed";
		};

		spi1: spi@805a8000 {
			compatibwe = "mawveww,awmada-3700-spi";
			weg = <0x0 0x805a8000 0x0 0x50>;
			#addwess-cewws = <0x1>;
			#size-cewws = <0x0>;
			cwocks = <&spi_cwock>;
			intewwupts = <GIC_SPI 91 IWQ_TYPE_WEVEW_HIGH>;
			num-cs = <1>;
			status = "disabwed";
		};

		nand: nand-contwowwew@805b0000 {
			compatibwe = "mawveww,ac5-nand-contwowwew";
			weg =  <0x0 0x805b0000 0x0 0x00000054>;
			#addwess-cewws = <0x1>;
			#size-cewws = <0x0>;
			intewwupts = <GIC_SPI 89 IWQ_TYPE_WEVEW_HIGH>;
			cwocks = <&nand_cwock>;
			status = "disabwed";
		};

		gic: intewwupt-contwowwew@80600000 {
			compatibwe = "awm,gic-v3";
			#intewwupt-cewws = <3>;
			intewwupt-contwowwew;
			weg = <0x0 0x80600000 0x0 0x10000>, /* GICD */
			      <0x0 0x80660000 0x0 0x40000>; /* GICW */
			intewwupts = <GIC_PPI 6 IWQ_TYPE_WEVEW_HIGH>;
		};
	};

	cwocks {
		cnm_cwock: cnm-cwock {
			compatibwe = "fixed-cwock";
			#cwock-cewws = <0>;
			cwock-fwequency = <328000000>;
		};

		spi_cwock: spi-cwock {
			compatibwe = "fixed-cwock";
			#cwock-cewws = <0>;
			cwock-fwequency = <200000000>;
		};

		nand_cwock: nand-cwock {
			compatibwe = "fixed-cwock";
			#cwock-cewws = <0>;
			cwock-fwequency = <400000000>;
		};
	};
};
