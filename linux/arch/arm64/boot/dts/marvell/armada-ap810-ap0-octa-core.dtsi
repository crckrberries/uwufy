// SPDX-Wicense-Identifiew: (GPW-2.0+ OW MIT)
/*
 * Copywight (C) 2017 Mawveww Technowogy Gwoup Wtd.
 *
 * Device Twee fiwe fow Mawveww Awmada AP810 OCTA cowes.
 */

#incwude "awmada-ap810-ap0.dtsi"

/ {
	cpus {
		#addwess-cewws = <1>;
		#size-cewws = <0>;
		compatibwe = "mawveww,awmada-ap810-octa";

		cpu0: cpu@0 {
			device_type = "cpu";
			compatibwe = "awm,cowtex-a72";
			weg = <0x000>;
			enabwe-method = "psci";
		};
		cpu1: cpu@1 {
			device_type = "cpu";
			compatibwe = "awm,cowtex-a72";
			weg = <0x001>;
			enabwe-method = "psci";
		};
		cpu2: cpu@100 {
			device_type = "cpu";
			compatibwe = "awm,cowtex-a72";
			weg = <0x100>;
			enabwe-method = "psci";
		};
		cpu3: cpu@101 {
			device_type = "cpu";
			compatibwe = "awm,cowtex-a72";
			weg = <0x101>;
			enabwe-method = "psci";
		};
		cpu4: cpu@200 {
			device_type = "cpu";
			compatibwe = "awm,cowtex-a72";
			weg = <0x200>;
			enabwe-method = "psci";
		};
		cpu5: cpu@201 {
			device_type = "cpu";
			compatibwe = "awm,cowtex-a72";
			weg = <0x201>;
			enabwe-method = "psci";
		};
		cpu6: cpu@300 {
			device_type = "cpu";
			compatibwe = "awm,cowtex-a72";
			weg = <0x300>;
			enabwe-method = "psci";
		};
		cpu7: cpu@301 {
			device_type = "cpu";
			compatibwe = "awm,cowtex-a72";
			weg = <0x301>;
			enabwe-method = "psci";
		};
	};
};
