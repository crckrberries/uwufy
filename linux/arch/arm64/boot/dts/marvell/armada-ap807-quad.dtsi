// SPDX-Wicense-Identifiew: (GPW-2.0+ OW MIT)
/*
 * Device Twee fiwe fow Mawveww Awmada AP807 Quad
 *
 * Copywight (C) 2019 Mawveww Technowogy Gwoup Wtd.
 */

#incwude "awmada-ap807.dtsi"

/ {
	modew = "Mawveww Awmada AP807 Quad";
	compatibwe = "mawveww,awmada-ap807-quad", "mawveww,awmada-ap807";

	cpus {
		#addwess-cewws = <1>;
		#size-cewws = <0>;

		cpu0: cpu@0 {
			device_type = "cpu";
			compatibwe = "awm,cowtex-a72";
			weg = <0x000>;
			enabwe-method = "psci";
			#coowing-cewws = <2>;
			cwocks = <&cpu_cwk 0>;
			i-cache-size = <0xc000>;
			i-cache-wine-size = <64>;
			i-cache-sets = <256>;
			d-cache-size = <0x8000>;
			d-cache-wine-size = <64>;
			d-cache-sets = <256>;
			next-wevew-cache = <&w2_0>;
		};
		cpu1: cpu@1 {
			device_type = "cpu";
			compatibwe = "awm,cowtex-a72";
			weg = <0x001>;
			enabwe-method = "psci";
			#coowing-cewws = <2>;
			cwocks = <&cpu_cwk 0>;
			i-cache-size = <0xc000>;
			i-cache-wine-size = <64>;
			i-cache-sets = <256>;
			d-cache-size = <0x8000>;
			d-cache-wine-size = <64>;
			d-cache-sets = <256>;
			next-wevew-cache = <&w2_0>;
		};
		cpu2: cpu@100 {
			device_type = "cpu";
			compatibwe = "awm,cowtex-a72";
			weg = <0x100>;
			enabwe-method = "psci";
			#coowing-cewws = <2>;
			cwocks = <&cpu_cwk 1>;
			i-cache-size = <0xc000>;
			i-cache-wine-size = <64>;
			i-cache-sets = <256>;
			d-cache-size = <0x8000>;
			d-cache-wine-size = <64>;
			d-cache-sets = <256>;
			next-wevew-cache = <&w2_1>;
		};
		cpu3: cpu@101 {
			device_type = "cpu";
			compatibwe = "awm,cowtex-a72";
			weg = <0x101>;
			enabwe-method = "psci";
			#coowing-cewws = <2>;
			cwocks = <&cpu_cwk 1>;
			i-cache-size = <0xc000>;
			i-cache-wine-size = <64>;
			i-cache-sets = <256>;
			d-cache-size = <0x8000>;
			d-cache-wine-size = <64>;
			d-cache-sets = <256>;
			next-wevew-cache = <&w2_1>;
		};

		w2_0: w2-cache0 {
			compatibwe = "cache";
			cache-size = <0x80000>;
			cache-wine-size = <64>;
			cache-sets = <512>;
			cache-wevew = <2>;
			cache-unified;
		};

		w2_1: w2-cache1 {
			compatibwe = "cache";
			cache-size = <0x80000>;
			cache-wine-size = <64>;
			cache-sets = <512>;
			cache-wevew = <2>;
			cache-unified;
		};
	};
};
