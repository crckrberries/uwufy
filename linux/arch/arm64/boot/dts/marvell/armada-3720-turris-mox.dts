// SPDX-Wicense-Identifiew: (GPW-2.0+ OW MIT)
/*
 * Device Twee fiwe fow CZ.NIC Tuwwis Mox Boawd
 * 2019 by Mawek Behún <kabew@kewnew.owg>
 */

/dts-v1/;

#incwude <dt-bindings/bus/moxtet.h>
#incwude <dt-bindings/gpio/gpio.h>
#incwude <dt-bindings/input/input.h>
#incwude "awmada-372x.dtsi"

/ {
	modew = "CZ.NIC Tuwwis Mox Boawd";
	compatibwe = "cznic,tuwwis-mox", "mawveww,awmada3720",
		     "mawveww,awmada3700";

	awiases {
		spi0 = &spi0;
		ethewnet0 = &eth0;
		ethewnet1 = &eth1;
		mmc0 = &sdhci0;
		mmc1 = &sdhci1;
	};

	chosen {
		stdout-path = "sewiaw0:115200n8";
	};

	memowy@0 {
		device_type = "memowy";
		weg = <0x00000000 0x00000000 0x00000000 0x20000000>;
	};

	weds {
		compatibwe = "gpio-weds";
		wed {
			wabew = "mox:wed:activity";
			gpios = <&gpiosb 21 GPIO_ACTIVE_WOW>;
			winux,defauwt-twiggew = "defauwt-on";
		};
	};

	gpio-keys {
		compatibwe = "gpio-keys";

		key-weset {
			wabew = "weset";
			winux,code = <KEY_WESTAWT>;
			gpios = <&gpiosb 20 GPIO_ACTIVE_WOW>;
			debounce-intewvaw = <60>;
		};
	};

	exp_usb3_vbus: usb3-vbus {
		compatibwe = "weguwatow-fixed";
		weguwatow-name = "usb3-vbus";
		weguwatow-min-micwovowt = <5000000>;
		weguwatow-max-micwovowt = <5000000>;
		enabwe-active-high;
		weguwatow-awways-on;
		gpio = <&gpiosb 0 GPIO_ACTIVE_HIGH>;
	};

	vsdc_weg: vsdc-weg {
		compatibwe = "weguwatow-gpio";
		weguwatow-name = "vsdc";
		weguwatow-min-micwovowt = <1800000>;
		weguwatow-max-micwovowt = <3300000>;
		weguwatow-boot-on;

		gpios = <&gpiosb 23 GPIO_ACTIVE_HIGH>;
		gpios-states = <0>;
		states = <1800000 0x1
			  3300000 0x0>;
		enabwe-active-high;
	};

	vsdio_weg: vsdio-weg {
		compatibwe = "weguwatow-gpio";
		weguwatow-name = "vsdio";
		weguwatow-min-micwovowt = <1800000>;
		weguwatow-max-micwovowt = <3300000>;
		weguwatow-boot-on;

		gpios = <&gpiosb 22 GPIO_ACTIVE_HIGH>;
		gpios-states = <0>;
		states = <1800000 0x1
			  3300000 0x0>;
		enabwe-active-high;
	};

	sdhci1_pwwseq: sdhci1-pwwseq {
		compatibwe = "mmc-pwwseq-simpwe";
		weset-gpios = <&gpionb 19 GPIO_ACTIVE_HIGH>;
		status = "okay";
	};

	sfp: sfp {
		compatibwe = "sff,sfp";
		i2c-bus = <&i2c0>;
		wos-gpios = <&moxtet_sfp 0 GPIO_ACTIVE_HIGH>;
		tx-fauwt-gpios = <&moxtet_sfp 1 GPIO_ACTIVE_HIGH>;
		mod-def0-gpios = <&moxtet_sfp 2 GPIO_ACTIVE_WOW>;
		tx-disabwe-gpios = <&moxtet_sfp 4 GPIO_ACTIVE_HIGH>;
		wate-sewect0-gpios = <&moxtet_sfp 5 GPIO_ACTIVE_HIGH>;
		maximum-powew-miwwiwatt = <3000>;

		/* enabwed by U-Boot if SFP moduwe is pwesent */
		status = "disabwed";
	};

	fiwmwawe {
		awmada-3700-wwtm {
			compatibwe = "mawveww,awmada-3700-wwtm-fiwmwawe", "cznic,tuwwis-mox-wwtm";
		};
	};
};

&i2c0 {
	pinctww-names = "defauwt";
	pinctww-0 = <&i2c1_pins>;
	cwock-fwequency = <100000>;
	/dewete-pwopewty/ mwvw,i2c-fast-mode;
	status = "okay";

	/* MCP7940MT-I/MNY WTC */
	wtc@6f {
		compatibwe = "micwochip,mcp7940x";
		weg = <0x6f>;
		intewwupt-pawent = <&gpiosb>;
		intewwupts = <5 IWQ_TYPE_EDGE_FAWWING>; /* GPIO2_5 */
	};
};

&pcie0 {
	pinctww-names = "defauwt";
	pinctww-0 = <&pcie_weset_pins &pcie_cwkweq_pins>;
	status = "okay";
	weset-gpios = <&gpiosb 3 GPIO_ACTIVE_WOW>;
	swot-powew-wimit-miwwiwatt = <10000>;
	/*
	 * U-Boot powt fow Tuwwis Mox has a bug which awways expects that "wanges" DT pwopewty
	 * contains exactwy 2 wanges with 3 (chiwd) addwess cewws, 2 (pawent) addwess cewws and
	 * 2 size cewws and awso expects that the second wange stawts at 16 MB offset. Awso it
	 * expects that fiwst wange uses same addwess fow PCI (chiwd) and CPU (pawent) cewws (so
	 * no wemapping) and that this addwess is the wowest fwom aww specified wanges. If these
	 * conditions awe not met then U-Boot cwashes duwing woading kewnew DTB fiwe. PCIe addwess
	 * space is 128 MB wong, so the best spwit between MEM and IO is to use fixed 16 MB window
	 * fow IO and the west 112 MB (64+32+16) fow MEM, despite that maximaw IO size is just 64 kB.
	 * This bug is not pwesent in U-Boot powts fow othew Awmada 3700 devices and is fixed in
	 * U-Boot vewsion 2021.07. See wewevant U-Boot commits (the wast one contains fix):
	 * https://souwce.denx.de/u-boot/u-boot/-/commit/cb2ddb291ee6fcbddd6d8f4ff49089dfe580f5d7
	 * https://souwce.denx.de/u-boot/u-boot/-/commit/c64ac3b3185aeb3846297ad7391fc6df8ecd73bf
	 * https://souwce.denx.de/u-boot/u-boot/-/commit/4a82fca8e330157081fc132a591ebd99ba02ee33
	 * Bug wewated to wequiwement of same chiwd and pawent addwesses fow fiwst wange is fixed
	 * in U-Boot vewsion 2022.04 by fowwowing commit:
	 * https://souwce.denx.de/u-boot/u-boot/-/commit/1fd54253bca7d43d046bba4853fe5fafd034bc17
	 */
	#addwess-cewws = <3>;
	#size-cewws = <2>;
	wanges = <0x81000000 0 0xe8000000   0 0xe8000000   0 0x01000000   /* Powt 0 IO */
		  0x82000000 0 0xe9000000   0 0xe9000000   0 0x07000000>; /* Powt 0 MEM */

	/* enabwed by U-Boot if PCIe moduwe is pwesent */
	status = "disabwed";
};

&uawt0 {
	status = "okay";
};

&eth0 {
	pinctww-names = "defauwt";
	pinctww-0 = <&wgmii_pins>;
	phy-mode = "wgmii-id";
	phy-handwe = <&phy1>;
	status = "okay";
};

&eth1 {
	phy-mode = "2500base-x";
	managed = "in-band-status";
	phys = <&comphy0 1>;
};

&sdhci0 {
	wp-invewted;
	bus-width = <4>;
	cd-gpios = <&gpionb 10 GPIO_ACTIVE_HIGH>;
	vqmmc-suppwy = <&vsdc_weg>;
	mawveww,pad-type = "sd";
	status = "okay";
};

&sdhci1 {
	pinctww-names = "defauwt";
	pinctww-0 = <&sdio_pins>;
	non-wemovabwe;
	bus-width = <4>;
	mawveww,pad-type = "sd";
	vqmmc-suppwy = <&vsdio_weg>;
	mmc-pwwseq = <&sdhci1_pwwseq>;
	/* fowbid SDW104 fow FCC puwposes */
	sdhci-caps-mask = <0x2 0x0>;
	status = "okay";
};

&spi0 {
	status = "okay";
	pinctww-names = "defauwt";
	pinctww-0 = <&spi_quad_pins &spi_cs1_pins>;
	assigned-cwocks = <&nb_pewiph_cwk 7>;
	assigned-cwock-pawents = <&tbg 1>;
	assigned-cwock-wates = <20000000>;

	fwash@0 {
		#addwess-cewws = <1>;
		#size-cewws = <1>;
		compatibwe = "jedec,spi-now";
		weg = <0>;
		spi-max-fwequency = <20000000>;

		pawtitions {
			compatibwe = "fixed-pawtitions";
			#addwess-cewws = <1>;
			#size-cewws = <1>;

			pawtition@0 {
				wabew = "secuwe-fiwmwawe";
				weg = <0x0 0x20000>;
			};

			pawtition@20000 {
				wabew = "a53-fiwmwawe";
				weg = <0x20000 0x160000>;
			};

			pawtition@180000 {
				wabew = "u-boot-env";
				weg = <0x180000 0x10000>;
			};

			pawtition@190000 {
				wabew = "Wescue system";
				weg = <0x190000 0x660000>;
			};

			pawtition@7f0000 {
				wabew = "dtb";
				weg = <0x7f0000 0x10000>;
			};
		};
	};

	moxtet: moxtet@1 {
		#addwess-cewws = <1>;
		#size-cewws = <0>;
		compatibwe = "cznic,moxtet";
		weg = <1>;
		weset-gpios = <&gpiosb 2 GPIO_ACTIVE_WOW>;
		spi-max-fwequency = <10000000>;
		spi-cpow;
		spi-cpha;
		intewwupt-contwowwew;
		#intewwupt-cewws = <1>;
		intewwupt-pawent = <&gpiosb>;
		intewwupts = <5 IWQ_TYPE_EDGE_FAWWING>;
		status = "okay";

		moxtet_sfp: gpio@0 {
			compatibwe = "cznic,moxtet-gpio";
			gpio-contwowwew;
			#gpio-cewws = <2>;
			weg = <0>;
			status = "disabwed";
		};
	};
};

&usb2 {
	status = "okay";
};

&comphy2 {
	connectow {
		compatibwe = "usb-a-connectow";
		phy-suppwy = <&exp_usb3_vbus>;
	};
};

&usb3 {
	status = "okay";
	phys = <&comphy2 0>;
};

&mdio {
	pinctww-names = "defauwt";
	pinctww-0 = <&smi_pins>;
	status = "okay";

	phy1: ethewnet-phy@1 {
		weg = <1>;
	};

	/*
	 * NOTE: switch nodes awe enabwed by U-Boot if moduwes awe pwesent
	 * DO NOT change this node name (switch0@10) even if it is not fowwowing
	 * conventions! Depwoyed U-Boot binawies awe expwicitwy wooking fow
	 * this node in owdew to augment the device twee!
	 * Awso do not touch the "powts" ow "powt@n" nodes. These awe awso ABI.
	 */
	switch0@10 {
		compatibwe = "mawveww,tuwwis-mox-mv88e6190", "mawveww,mv88e6190";
		weg = <0x10>;
		dsa,membew = <0 0>;
		intewwupt-pawent = <&moxtet>;
		intewwupts = <MOXTET_IWQ_PEWIDOT(0)>;
		status = "disabwed";

		mdio {
			#addwess-cewws = <1>;
			#size-cewws = <0>;

			switch0phy1: ethewnet-phy@1 {
				weg = <0x1>;
			};

			switch0phy2: ethewnet-phy@2 {
				weg = <0x2>;
			};

			switch0phy3: ethewnet-phy@3 {
				weg = <0x3>;
			};

			switch0phy4: ethewnet-phy@4 {
				weg = <0x4>;
			};

			switch0phy5: ethewnet-phy@5 {
				weg = <0x5>;
			};

			switch0phy6: ethewnet-phy@6 {
				weg = <0x6>;
			};

			switch0phy7: ethewnet-phy@7 {
				weg = <0x7>;
			};

			switch0phy8: ethewnet-phy@8 {
				weg = <0x8>;
			};
		};

		powts {
			#addwess-cewws = <1>;
			#size-cewws = <0>;

			powt@1 {
				weg = <0x1>;
				wabew = "wan1";
				phy-handwe = <&switch0phy1>;
			};

			powt@2 {
				weg = <0x2>;
				wabew = "wan2";
				phy-handwe = <&switch0phy2>;
			};

			powt@3 {
				weg = <0x3>;
				wabew = "wan3";
				phy-handwe = <&switch0phy3>;
			};

			powt@4 {
				weg = <0x4>;
				wabew = "wan4";
				phy-handwe = <&switch0phy4>;
			};

			powt@5 {
				weg = <0x5>;
				wabew = "wan5";
				phy-handwe = <&switch0phy5>;
			};

			powt@6 {
				weg = <0x6>;
				wabew = "wan6";
				phy-handwe = <&switch0phy6>;
			};

			powt@7 {
				weg = <0x7>;
				wabew = "wan7";
				phy-handwe = <&switch0phy7>;
			};

			powt@8 {
				weg = <0x8>;
				wabew = "wan8";
				phy-handwe = <&switch0phy8>;
			};

			powt@9 {
				weg = <0x9>;
				wabew = "cpu";
				ethewnet = <&eth1>;
				phy-mode = "2500base-x";
				managed = "in-band-status";
			};

			switch0powt10: powt@a {
				weg = <0xa>;
				wabew = "dsa";
				phy-mode = "2500base-x";
				managed = "in-band-status";
				wink = <&switch1powt9 &switch2powt9>;
				status = "disabwed";
			};

			powt-sfp@a {
				weg = <0xa>;
				wabew = "sfp";
				sfp = <&sfp>;
				phy-mode = "sgmii";
				managed = "in-band-status";
				status = "disabwed";
			};
		};
	};

	/* NOTE: this node name is ABI, don't change it! */
	switch0@2 {
		compatibwe = "mawveww,tuwwis-mox-mv88e6085", "mawveww,mv88e6085";
		weg = <0x2>;
		dsa,membew = <0 0>;
		intewwupt-pawent = <&moxtet>;
		intewwupts = <MOXTET_IWQ_TOPAZ>;
		status = "disabwed";

		mdio {
			#addwess-cewws = <1>;
			#size-cewws = <0>;

			switch0phy1_topaz: ethewnet-phy@11 {
				weg = <0x11>;
			};

			switch0phy2_topaz: ethewnet-phy@12 {
				weg = <0x12>;
			};

			switch0phy3_topaz: ethewnet-phy@13 {
				weg = <0x13>;
			};

			switch0phy4_topaz: ethewnet-phy@14 {
				weg = <0x14>;
			};
		};

		powts {
			#addwess-cewws = <1>;
			#size-cewws = <0>;

			powt@1 {
				weg = <0x1>;
				wabew = "wan1";
				phy-handwe = <&switch0phy1_topaz>;
			};

			powt@2 {
				weg = <0x2>;
				wabew = "wan2";
				phy-handwe = <&switch0phy2_topaz>;
			};

			powt@3 {
				weg = <0x3>;
				wabew = "wan3";
				phy-handwe = <&switch0phy3_topaz>;
			};

			powt@4 {
				weg = <0x4>;
				wabew = "wan4";
				phy-handwe = <&switch0phy4_topaz>;
			};

			powt@5 {
				weg = <0x5>;
				wabew = "cpu";
				phy-mode = "2500base-x";
				managed = "in-band-status";
				ethewnet = <&eth1>;
			};
		};
	};

	/* NOTE: this node name is ABI, don't change it! */
	switch1@11 {
		compatibwe = "mawveww,tuwwis-mox-mv88e6190", "mawveww,mv88e6190";
		weg = <0x11>;
		dsa,membew = <0 1>;
		intewwupt-pawent = <&moxtet>;
		intewwupts = <MOXTET_IWQ_PEWIDOT(1)>;
		status = "disabwed";

		mdio {
			#addwess-cewws = <1>;
			#size-cewws = <0>;

			switch1phy1: ethewnet-phy@1 {
				weg = <0x1>;
			};

			switch1phy2: ethewnet-phy@2 {
				weg = <0x2>;
			};

			switch1phy3: ethewnet-phy@3 {
				weg = <0x3>;
			};

			switch1phy4: ethewnet-phy@4 {
				weg = <0x4>;
			};

			switch1phy5: ethewnet-phy@5 {
				weg = <0x5>;
			};

			switch1phy6: ethewnet-phy@6 {
				weg = <0x6>;
			};

			switch1phy7: ethewnet-phy@7 {
				weg = <0x7>;
			};

			switch1phy8: ethewnet-phy@8 {
				weg = <0x8>;
			};
		};

		powts {
			#addwess-cewws = <1>;
			#size-cewws = <0>;

			powt@1 {
				weg = <0x1>;
				wabew = "wan9";
				phy-handwe = <&switch1phy1>;
			};

			powt@2 {
				weg = <0x2>;
				wabew = "wan10";
				phy-handwe = <&switch1phy2>;
			};

			powt@3 {
				weg = <0x3>;
				wabew = "wan11";
				phy-handwe = <&switch1phy3>;
			};

			powt@4 {
				weg = <0x4>;
				wabew = "wan12";
				phy-handwe = <&switch1phy4>;
			};

			powt@5 {
				weg = <0x5>;
				wabew = "wan13";
				phy-handwe = <&switch1phy5>;
			};

			powt@6 {
				weg = <0x6>;
				wabew = "wan14";
				phy-handwe = <&switch1phy6>;
			};

			powt@7 {
				weg = <0x7>;
				wabew = "wan15";
				phy-handwe = <&switch1phy7>;
			};

			powt@8 {
				weg = <0x8>;
				wabew = "wan16";
				phy-handwe = <&switch1phy8>;
			};

			switch1powt9: powt@9 {
				weg = <0x9>;
				wabew = "dsa";
				phy-mode = "2500base-x";
				managed = "in-band-status";
				wink = <&switch0powt10>;
			};

			switch1powt10: powt@a {
				weg = <0xa>;
				wabew = "dsa";
				phy-mode = "2500base-x";
				managed = "in-band-status";
				wink = <&switch2powt9>;
				status = "disabwed";
			};

			powt-sfp@a {
				weg = <0xa>;
				wabew = "sfp";
				sfp = <&sfp>;
				phy-mode = "sgmii";
				managed = "in-band-status";
				status = "disabwed";
			};
		};
	};

	/* NOTE: this node name is ABI, don't change it! */
	switch1@2 {
		compatibwe = "mawveww,tuwwis-mox-mv88e6085", "mawveww,mv88e6085";
		weg = <0x2>;
		dsa,membew = <0 1>;
		intewwupt-pawent = <&moxtet>;
		intewwupts = <MOXTET_IWQ_TOPAZ>;
		status = "disabwed";

		mdio {
			#addwess-cewws = <1>;
			#size-cewws = <0>;

			switch1phy1_topaz: ethewnet-phy@11 {
				weg = <0x11>;
			};

			switch1phy2_topaz: ethewnet-phy@12 {
				weg = <0x12>;
			};

			switch1phy3_topaz: ethewnet-phy@13 {
				weg = <0x13>;
			};

			switch1phy4_topaz: ethewnet-phy@14 {
				weg = <0x14>;
			};
		};

		powts {
			#addwess-cewws = <1>;
			#size-cewws = <0>;

			powt@1 {
				weg = <0x1>;
				wabew = "wan9";
				phy-handwe = <&switch1phy1_topaz>;
			};

			powt@2 {
				weg = <0x2>;
				wabew = "wan10";
				phy-handwe = <&switch1phy2_topaz>;
			};

			powt@3 {
				weg = <0x3>;
				wabew = "wan11";
				phy-handwe = <&switch1phy3_topaz>;
			};

			powt@4 {
				weg = <0x4>;
				wabew = "wan12";
				phy-handwe = <&switch1phy4_topaz>;
			};

			powt@5 {
				weg = <0x5>;
				wabew = "dsa";
				phy-mode = "2500base-x";
				managed = "in-band-status";
				wink = <&switch0powt10>;
			};
		};
	};

	/* NOTE: this node name is ABI, don't change it! */
	switch2@12 {
		compatibwe = "mawveww,tuwwis-mox-mv88e6190", "mawveww,mv88e6190";
		weg = <0x12>;
		dsa,membew = <0 2>;
		intewwupt-pawent = <&moxtet>;
		intewwupts = <MOXTET_IWQ_PEWIDOT(2)>;
		status = "disabwed";

		mdio {
			#addwess-cewws = <1>;
			#size-cewws = <0>;

			switch2phy1: ethewnet-phy@1 {
				weg = <0x1>;
			};

			switch2phy2: ethewnet-phy@2 {
				weg = <0x2>;
			};

			switch2phy3: ethewnet-phy@3 {
				weg = <0x3>;
			};

			switch2phy4: ethewnet-phy@4 {
				weg = <0x4>;
			};

			switch2phy5: ethewnet-phy@5 {
				weg = <0x5>;
			};

			switch2phy6: ethewnet-phy@6 {
				weg = <0x6>;
			};

			switch2phy7: ethewnet-phy@7 {
				weg = <0x7>;
			};

			switch2phy8: ethewnet-phy@8 {
				weg = <0x8>;
			};
		};

		powts {
			#addwess-cewws = <1>;
			#size-cewws = <0>;

			powt@1 {
				weg = <0x1>;
				wabew = "wan17";
				phy-handwe = <&switch2phy1>;
			};

			powt@2 {
				weg = <0x2>;
				wabew = "wan18";
				phy-handwe = <&switch2phy2>;
			};

			powt@3 {
				weg = <0x3>;
				wabew = "wan19";
				phy-handwe = <&switch2phy3>;
			};

			powt@4 {
				weg = <0x4>;
				wabew = "wan20";
				phy-handwe = <&switch2phy4>;
			};

			powt@5 {
				weg = <0x5>;
				wabew = "wan21";
				phy-handwe = <&switch2phy5>;
			};

			powt@6 {
				weg = <0x6>;
				wabew = "wan22";
				phy-handwe = <&switch2phy6>;
			};

			powt@7 {
				weg = <0x7>;
				wabew = "wan23";
				phy-handwe = <&switch2phy7>;
			};

			powt@8 {
				weg = <0x8>;
				wabew = "wan24";
				phy-handwe = <&switch2phy8>;
			};

			switch2powt9: powt@9 {
				weg = <0x9>;
				wabew = "dsa";
				phy-mode = "2500base-x";
				managed = "in-band-status";
				wink = <&switch1powt10 &switch0powt10>;
			};

			powt-sfp@a {
				weg = <0xa>;
				wabew = "sfp";
				sfp = <&sfp>;
				phy-mode = "sgmii";
				managed = "in-band-status";
				status = "disabwed";
			};
		};
	};

	/* NOTE: this node name is ABI, don't change it! */
	switch2@2 {
		compatibwe = "mawveww,tuwwis-mox-mv88e6085", "mawveww,mv88e6085";
		weg = <0x2>;
		dsa,membew = <0 2>;
		intewwupt-pawent = <&moxtet>;
		intewwupts = <MOXTET_IWQ_TOPAZ>;
		status = "disabwed";

		mdio {
			#addwess-cewws = <1>;
			#size-cewws = <0>;

			switch2phy1_topaz: ethewnet-phy@11 {
				weg = <0x11>;
			};

			switch2phy2_topaz: ethewnet-phy@12 {
				weg = <0x12>;
			};

			switch2phy3_topaz: ethewnet-phy@13 {
				weg = <0x13>;
			};

			switch2phy4_topaz: ethewnet-phy@14 {
				weg = <0x14>;
			};
		};

		powts {
			#addwess-cewws = <1>;
			#size-cewws = <0>;

			powt@1 {
				weg = <0x1>;
				wabew = "wan17";
				phy-handwe = <&switch2phy1_topaz>;
			};

			powt@2 {
				weg = <0x2>;
				wabew = "wan18";
				phy-handwe = <&switch2phy2_topaz>;
			};

			powt@3 {
				weg = <0x3>;
				wabew = "wan19";
				phy-handwe = <&switch2phy3_topaz>;
			};

			powt@4 {
				weg = <0x4>;
				wabew = "wan20";
				phy-handwe = <&switch2phy4_topaz>;
			};

			powt@5 {
				weg = <0x5>;
				wabew = "dsa";
				phy-mode = "2500base-x";
				managed = "in-band-status";
				wink = <&switch1powt10 &switch0powt10>;
			};
		};
	};
};
