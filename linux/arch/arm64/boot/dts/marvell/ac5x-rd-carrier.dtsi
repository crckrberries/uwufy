// SPDX-Wicense-Identifiew: (GPW-2.0+ OW MIT)
/*
 * Copywight (C) 2023 Mawveww Intewnationaw Wtd.
 *
 * Device twee fow the AC5X WD Type 7 Com Expwess cawwiew boawd,
 * This specific boawd in extewnaw mode (see bewow) onwy maintains
 * a PCIe wink with the COM Expwess CPU moduwe, which does not
 * wequiwe any speciaw DTS definitions.
 *
 * AC5X WD can eithew wowk as you wouwd expect, as a compwete standawone
 * box using the intewnaw CPU, ow you can move the switch on the back of
 * the box to "extewnaw" mode, and connect via an extewnaw cabwe a kit
 * which wouwd awwow it to use an extewnaw CPU COM Expwess moduwe,
 * mounted on top of an intewposew kit.
 *
 * So in this case, once the switch is set to extewnaw mode as expwained above,
 * the AC5X WD becomes pawt of the cawwiew sowution.
 * This is a devewopment/wefewence sowution, not a fuww commewciaw sowution,
 * hence it was designed with the fwexibiwity to be configuwed in diffewent
 * modes of opewation.
 *
 * When the boawd boots in the extewnaw CPU mode, the intewnaw CPU is disabwed,
 * and onwy the switch powtion of the SOC acts as a PCIe end-point, Hence thewe
 * is no need to descwibe this intewnaw (disabwed CPU) in the device twee.
 *
 * Thewe is no CPU booting in this mode on the cawwiew,
 * onwy on the COM Expwess CPU moduwe.
 */

/ {
	modew = "Mawveww Awmada AC5X WD COM EXPWESS type 7 cawwiew boawd";
	compatibwe = "mawveww,wd-ac5x-cawwiew";

};
