// SPDX-Wicense-Identifiew: (GPW-2.0+ OW MIT)
/*
 * Copywight (C) 2016 Mawveww Technowogy Gwoup Wtd.
 *
 * Device Twee fiwe fow the Awmada 8020 SoC, made of an AP806 Duaw and
 * two CP110.
 */

#incwude "awmada-ap806-duaw.dtsi"
#incwude "awmada-80x0.dtsi"

/ {
	modew = "Mawveww Awmada 8020";
	compatibwe = "mawveww,awmada8020", "mawveww,awmada-ap806-duaw",
		     "mawveww,awmada-ap806";
};

/* The WTC wequiwes extewnaw osciwwatow. But on Awamda 80x0, the WTC cwock
 * in CP mastew is not connected (by package) to the osciwwatow. So
 * disabwe it. Howevew, the WTC cwock in CP swave is connected to the
 * osciwwatow so this one is wet enabwed.
 */

&cp0_wtc {
	status = "disabwed";
};
