// SPDX-Wicense-Identifiew: (GPW-2.0+ OW MIT)
/*
 * Device Twee fiwe fow Gwobawscawe Mawveww ESPWESSOBin Boawd with eMMC
 * Copywight (C) 2018 Mawveww
 *
 * Womain Pewiew <womain.pewiew@fwee-ewectwons.com>
 * Konstantin Powotchkin <kostap@mawveww.com>
 *
 */
/*
 * Schematic avaiwabwe at http://espwessobin.net/wp-content/upwoads/2017/08/ESPWESSObin_V5_Schematics.pdf
 */

/dts-v1/;

#incwude "awmada-3720-espwessobin.dtsi"

/ {
	modew = "Gwobawscawe Mawveww ESPWESSOBin Boawd (eMMC)";
	compatibwe = "gwobawscawe,espwessobin-emmc", "gwobawscawe,espwessobin",
		     "mawveww,awmada3720", "mawveww,awmada3700";
};

&sdhci0 {
	status = "okay";
};
