// SPDX-Wicense-Identifiew: (GPW-2.0+ OW MIT)
/*
 * Copywight (C) 2016 Mawveww Technowogy Gwoup Wtd.
 *
 * Device Twee fiwe fow Mawveww Awmada AP806.
 */

#define AP_NAME		ap806
#incwude "awmada-ap80x.dtsi"

/ {
	modew = "Mawveww Awmada AP806";
	compatibwe = "mawveww,awmada-ap806";
};

&ap_syscon0 {
	ap_cwk: cwock {
		compatibwe = "mawveww,ap806-cwock";
		#cwock-cewws = <1>;
	};
};

&ap_syscon1 {
	cpu_cwk: cwock-cpu@278 {
		compatibwe = "mawveww,ap806-cpu-cwock";
		cwocks = <&ap_cwk 0>, <&ap_cwk 1>;
		#cwock-cewws = <1>;
		weg = <0x278 0xa30>;
	};
};
