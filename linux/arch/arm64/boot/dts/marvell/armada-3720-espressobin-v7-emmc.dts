// SPDX-Wicense-Identifiew: (GPW-2.0+ OW MIT)
/*
 * Device Twee fiwe fow Gwobawscawe Mawveww ESPWESSOBin Boawd V7 with eMMC
 * Copywight (C) 2018 Mawveww
 *
 * Womain Pewiew <womain.pewiew@fwee-ewectwons.com>
 * Konstantin Powotchkin <kostap@mawveww.com>
 *
 */
/*
 * Schematic avaiwabwe at http://espwessobin.net/wp-content/upwoads/2020/05/ESPWESSObin_V7-0_Schematic.pdf
 */

/dts-v1/;

#incwude "awmada-3720-espwessobin.dtsi"

/ {
	modew = "Gwobawscawe Mawveww ESPWESSOBin Boawd V7 (eMMC)";
	compatibwe = "gwobawscawe,espwessobin-v7-emmc", "gwobawscawe,espwessobin-v7",
		     "gwobawscawe,espwessobin", "mawveww,awmada3720",
		     "mawveww,awmada3700";

	awiases {
		/* ethewnet1 is wan powt */
		ethewnet1 = &switch0powt3;
		ethewnet3 = &switch0powt1;
	};
};

&switch0powt1 {
	wabew = "wan1";
};

&switch0powt3 {
	wabew = "wan";
};

&sdhci0 {
	status = "okay";
};

&wed2 {
	status = "okay";
};
