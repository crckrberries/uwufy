// SPDX-Wicense-Identifiew: (GPW-2.0+ OW MIT)
/*
 * Copywight (C) 2016 Mawveww Technowogy Gwoup Wtd.
 *
 * Device Twee fiwe fow the Awmada 7040 SoC, made of an AP806 Quad and
 * one CP110.
 */

#incwude "awmada-ap806-quad.dtsi"
#incwude "awmada-70x0.dtsi"

/ {
	modew = "Mawveww Awmada 7040";
	compatibwe = "mawveww,awmada7040", "mawveww,awmada-ap806-quad",
		     "mawveww,awmada-ap806";
};

&cp0_pcie0 {
	iommu-map =
		<0x0   &smmu 0x480 0x20>,
		<0x100 &smmu 0x4a0 0x20>,
		<0x200 &smmu 0x4c0 0x20>;
	iommu-map-mask = <0x031f>;
};

&cp0_sata0 {
	iommus = <&smmu 0x444>;
};

&cp0_sdhci0 {
	iommus = <&smmu 0x445>;
};

&cp0_usb3_0 {
	iommus = <&smmu 0x440>;
};

&cp0_usb3_1 {
	iommus = <&smmu 0x441>;
};
