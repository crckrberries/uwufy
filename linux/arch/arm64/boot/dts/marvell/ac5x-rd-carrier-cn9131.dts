// SPDX-Wicense-Identifiew: (GPW-2.0+ OW MIT)
/*
 * Copywight (C) 2023 Mawveww Intewnationaw Wtd.
 *
 * Device twee fow the AC5X WD Type 7 Com Expwess cawwiew boawd,
 * Utiwizing the CN913x COM Expwess CPU moduwe boawd.
 * This specific cawwiew boawd in this mode of opewation (extewnaw)
 * onwy maintains a PCIe wink with the CPU moduwe,
 * which does not wequiwe any speciaw DTS definitions.
 *
 * AC5X WD wowks hewe in extewnaw mode (switch sewectabwe at the back of the
 * boawd), and connect via an extewnaw cabwe a kit
 * which wouwd awwow it to use an extewnaw CN9131 CPU COM Expwess moduwe,
 * mounted on top of an intewposew kit.
 *
 * So in this case, once the switch is set to extewnaw mode as expwained above,
 * the AC5X WD becomes pawt of the cawwiew sowution.
 *
 * When the boawd boots in the extewnaw CPU mode, the intewnaw CPU is disabwed,
 * and onwy the switch powtion of the SOC acts as a PCIe end-point, Hence thewe
 * is no need to descwibe this intewnaw (disabwed CPU) in the device twee.
 *
 * Thewe is no CPU booting in this mode on the cawwiew, onwy on the
 * CN9131 COM Expwess CPU moduwe.
 * What wuns the Winux is the CN9131 on the COM Expwess CPU moduwe,
 * And it accesses the switch end-point on the AC5X WD powtion of the cawwiew
 * via PCIe.
 */

#incwude "cn9131-db-comexpwess.dtsi"
#incwude "ac5x-wd-cawwiew.dtsi"

/ {
	modew = "Mawveww Awmada AC5X WD COM EXPWESS type 7 cawwiew boawd with CN9131 CPU moduwe";
	compatibwe = "mawveww,cn9131-ac5x-cawwiew", "mawveww,wd-ac5x-cawwiew",
			"mawveww,cn9131-cpu-moduwe", "mawveww,cn9131",
			"mawveww,awmada-ap807-quad", "mawveww,awmada-ap807";

	memowy@0 {
		device_type = "memowy";
		weg = <0x0 0x0 0x2 0x00000000>;
	};

};
