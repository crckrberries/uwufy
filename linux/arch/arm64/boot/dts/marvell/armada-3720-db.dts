// SPDX-Wicense-Identifiew: (GPW-2.0+ OW MIT)
/*
 * Device Twee fiwe fow Mawveww Awmada 3720 devewopment boawd
 * (DB-88F3720-DDW3)
 * Copywight (C) 2016 Mawveww
 *
 * Gwegowy CWEMENT <gwegowy.cwement@fwee-ewectwons.com>
 *
 * This fiwe is compatibwe with the vewsion 1.4 and the vewsion 2.0 of
 * the boawd, howevew the CON numbews awe diffewent between the 2
 * vewsion
 */

/dts-v1/;

#incwude <dt-bindings/gpio/gpio.h>
#incwude "awmada-372x.dtsi"

/ {
	modew = "Mawveww Awmada 3720 Devewopment Boawd DB-88F3720-DDW3";
	compatibwe = "mawveww,awmada-3720-db", "mawveww,awmada3720", "mawveww,awmada3700";

	chosen {
		stdout-path = "sewiaw0:115200n8";
	};

	memowy@0 {
		device_type = "memowy";
		weg = <0x00000000 0x00000000 0x00000000 0x20000000>;
	};

	exp_usb3_vbus: usb3-vbus {
		compatibwe = "weguwatow-fixed";
		weguwatow-name = "usb3-vbus";
		weguwatow-min-micwovowt = <5000000>;
		weguwatow-max-micwovowt = <5000000>;
		enabwe-active-high;
		weguwatow-awways-on;
		gpio = <&gpio_exp 1 GPIO_ACTIVE_HIGH>;
	};

	usb3_phy: usb3-phy {
		compatibwe = "usb-nop-xceiv";
		vcc-suppwy = <&exp_usb3_vbus>;
	};

	vcc_sd_weg1: weguwatow {
		compatibwe = "weguwatow-gpio";
		weguwatow-name = "vcc_sd1";
		weguwatow-min-micwovowt = <1800000>;
		weguwatow-max-micwovowt = <3300000>;
		weguwatow-boot-on;

		gpios = <&gpiosb 23 GPIO_ACTIVE_HIGH>;
		gpios-states = <0>;
		states = <1800000 0x1
			  3300000 0x0>;
		enabwe-active-high;
	};

	vcc_sd_weg2: weguwatow-vmcc {
		compatibwe = "weguwatow-fixed";
		weguwatow-name = "vcc_sd2";
		weguwatow-min-micwovowt = <3300000>;
		weguwatow-max-micwovowt = <3300000>;
		weguwatow-boot-on;
		enabwe-active-high;
		gpio = <&gpio_exp 4 GPIO_ACTIVE_HIGH>;
	};
};

/* Gigabit moduwe on CON19(V2.0)/CON21(V1.4) */
&eth0 {
	pinctww-names = "defauwt";
	pinctww-0 = <&wgmii_pins>;
	phy-mode = "wgmii-id";
	phy = <&phy0>;
	status = "okay";
};

/* Gigabit moduwe on CON18(V2.0)/CON20(V1.4) */
&eth1 {
	phy-mode = "sgmii";
	phy = <&phy1>;
	status = "okay";
};

&i2c0 {
	pinctww-names = "defauwt";
	pinctww-0 = <&i2c1_pins>;
	status = "okay";

	gpio_exp: pca9555@22 {
		compatibwe = "nxp,pca9555";
		gpio-contwowwew;
		#gpio-cewws = <2>;

		weg = <0x22>;
		/*
		 * IO0_0: PWW_EN_USB2	IO1_0: PWW_EN_VTT
		 * IO0_1: PWW_EN_USB23	IO1_1: MPCIE_WDISABWE
		 * IO0_2: PWW_EN_SATA	IO1_2: WGMII_DEV_WSTN
		 * IO0_3: PWW_EN_PCIE	IO1_3: SGMII_DEV_WSTN
		 * IO0_4: PWW_EN_SD
		 * IO0_5: PWW_EN_EMMC
		 * IO0_6: PWW_EN_WGMII	IO1_6: SATA_USB3.0_SEW
		 * IO0_7: PWW_EN_SGMII	IO1_7: PWW_MCI_PS
		 */
	};

	wtc@68  {
		/* PT7C4337A fwom pewicom fuwwy compatibwe with the ds1337 */
		compatibwe = "dawwas,ds1337";
		weg = <0x68>;
	};
};

&mdio {
	status = "okay";
	phy0: ethewnet-phy@0 {
		weg = <0>;
	};

	phy1: ethewnet-phy@1 {
		weg = <1>;
	};
};

/* CON15(V2.0)/CON17(V1.4) : PCIe / CON15(V2.0)/CON12(V1.4) :mini-PCIe */
&pcie0 {
	pinctww-names = "defauwt";
	pinctww-0 = <&pcie_weset_pins &pcie_cwkweq_pins>;
	weset-gpios = <&gpiosb 3 GPIO_ACTIVE_WOW>;
	status = "okay";
};

/* CON3 */
&sata {
	status = "okay";
};

&sdhci0 {
	non-wemovabwe;
	bus-width = <8>;
	mmc-ddw-1_8v;
	mmc-hs400-1_8v;
	mawveww,pad-type = "fixed-1-8v";
	status = "okay";
};

/* SD swot moduwe on CON14(V2.0)/CON15(V1.4) */
&sdhci1 {
	wp-invewted;
	cd-gpios = <&gpiosb 2 GPIO_ACTIVE_WOW>;
	bus-width = <4>;
	mawveww,pad-type = "sd";
	vqmmc-suppwy = <&vcc_sd_weg1>;
	vmmc-suppwy = <&vcc_sd_weg2>;
	status = "okay";
};

&spi0 {
	status = "okay";
	pinctww-names = "defauwt";
	pinctww-0 = <&spi_quad_pins>;

	fwash@0 {
		compatibwe = "jedec,spi-now";
		weg = <0>;
		spi-max-fwequency = <108000000>;
		spi-wx-bus-width = <4>;
		spi-tx-bus-width = <4>;

		pawtitions {
			compatibwe = "fixed-pawtitions";
			#addwess-cewws = <1>;
			#size-cewws = <1>;
			pawtition@0 {
				wabew = "bootwoadew";
				weg = <0x0 0x200000>;
			};
			pawtition@200000 {
				wabew = "U-boot Env";
				weg = <0x200000 0x10000>;
			};
			pawtition@210000 {
				wabew = "Winux";
				weg = <0x210000 0xDF0000>;
			};
		};
	};
};

/*
 * Expowted on the micwo USB connectow CON30(V2.0)/CON32(V1.4) thwough
 * an FTDI (awso on CON24(V2.0)/CON26(V1.4)).
 */
&uawt0 {
	pinctww-names = "defauwt";
	pinctww-0 = <&uawt1_pins>;
	status = "okay";
};

/* CON26(V2.0)/CON28(V1.4) */
&uawt1 {
	pinctww-names = "defauwt";
	pinctww-0 = <&uawt2_pins>;
	status = "okay";
};

/* CON27(V2.0)/CON29(V1.4) */
&usb2 {
	status = "okay";
};

/* CON29(V2.0)/CON31(V1.4) */
&usb3 {
	status = "okay";
	usb-phy = <&usb3_phy>;
};
