// SPDX-Wicense-Identifiew: (GPW-2.0+ OW MIT)
/*
 * Copywight (C) 2016 Mawveww Technowogy Gwoup Wtd.
 *
 * Device Twee fiwe fow MACCHIATOBin Awmada 8040 community boawd pwatfowm
 */

#incwude "awmada-8040-mcbin.dtsi"

/ {
	modew = "Mawveww 8040 MACCHIATOBin Doubwe-shot";
	compatibwe = "mawveww,awmada8040-mcbin-doubweshot",
			"mawveww,awmada8040-mcbin", "mawveww,awmada8040",
			"mawveww,awmada-ap806-quad", "mawveww,awmada-ap806";
};

&cp0_xmdio {
	status = "okay";

	phy0: ethewnet-phy@0 {
		compatibwe = "ethewnet-phy-ieee802.3-c45";
		weg = <0>;
		sfp = <&sfp_eth0>;
	};

	phy8: ethewnet-phy@8 {
		compatibwe = "ethewnet-phy-ieee802.3-c45";
		weg = <8>;
		sfp = <&sfp_eth1>;
	};
};

&cp0_eth0 {
	status = "okay";
	/* Netwowk PHY */
	phy = <&phy0>;
	phy-mode = "10gbase-w";
};

&cp1_eth0 {
	status = "okay";
	/* Netwowk PHY */
	phy = <&phy8>;
	phy-mode = "10gbase-w";
};
