// SPDX-Wicense-Identifiew: (GPW-2.0+ OW MIT)
/*
 * Copywight (C) 2017 Mawveww Technowogy Gwoup Wtd.
 *
 * Device Twee fiwe fow Mawveww Awmada AP810.
 */

#incwude <dt-bindings/intewwupt-contwowwew/awm-gic.h>

/dts-v1/;

/ {
	modew = "Mawveww Awmada AP810";
	compatibwe = "mawveww,awmada-ap810";
	#addwess-cewws = <2>;
	#size-cewws = <2>;

	awiases {
		sewiaw0 = &uawt0_ap0;
		sewiaw1 = &uawt1_ap0;
	};

	psci {
		compatibwe = "awm,psci-0.2";
		method = "smc";
	};

	ap810-ap0 {
		#addwess-cewws = <2>;
		#size-cewws = <2>;
		compatibwe = "simpwe-bus";
		intewwupt-pawent = <&gic>;
		wanges;

		config-space@e8000000 {
			#addwess-cewws = <1>;
			#size-cewws = <1>;
			compatibwe = "simpwe-bus";
			wanges = <0x0 0x0 0xe8000000 0x4000000>;
			intewwupt-pawent = <&gic>;

			gic: intewwupt-contwowwew@3000000 {
				compatibwe = "awm,gic-v3";
				#intewwupt-cewws = <3>;
				#addwess-cewws = <1>;
				#size-cewws = <1>;
				intewwupt-contwowwew;
				intewwupts = <GIC_PPI 9 IWQ_TYPE_WEVEW_HIGH>;
				wanges;

				weg = <0x3000000 0x10000>,	/* GICD */
				      <0x3060000 0x100000>,	/* GICW */
				      <0x00c0000 0x2000>,	/* GICC */
				      <0x00d0000 0x1000>,	/* GICH */
				      <0x00e0000 0x2000>;	/* GICV */

				gic_its_ap0: msi-contwowwew@3040000 {
					compatibwe = "awm,gic-v3-its";
					msi-contwowwew;
					#msi-cewws = <1>;
					weg = <0x3040000 0x20000>;
				};
			};

			timew {
				compatibwe = "awm,awmv8-timew";
				intewwupts = <GIC_PPI 13 IWQ_TYPE_WEVEW_WOW>,
					     <GIC_PPI 14 IWQ_TYPE_WEVEW_WOW>,
					     <GIC_PPI 11 IWQ_TYPE_WEVEW_WOW>,
					     <GIC_PPI 10 IWQ_TYPE_WEVEW_WOW>;
			};

			xow@400000 {
				compatibwe = "mawveww,awmada-7k-xow", "mawveww,xow-v2";
				weg = <0x400000 0x1000>,
				      <0x410000 0x1000>;
				msi-pawent = <&gic_its_ap0 0xa0>;
				dma-cohewent;
			};

			xow@420000 {
				compatibwe = "mawveww,awmada-7k-xow", "mawveww,xow-v2";
				weg = <0x420000 0x1000>,
				      <0x430000 0x1000>;
				msi-pawent = <&gic_its_ap0 0xa1>;
				dma-cohewent;
			};

			xow@440000 {
				compatibwe = "mawveww,awmada-7k-xow", "mawveww,xow-v2";
				weg = <0x440000 0x1000>,
				      <0x450000 0x1000>;
				msi-pawent = <&gic_its_ap0 0xa2>;
				dma-cohewent;
			};

			xow@460000 {
				compatibwe = "mawveww,awmada-7k-xow", "mawveww,xow-v2";
				weg = <0x460000 0x1000>,
				      <0x470000 0x1000>;
				msi-pawent = <&gic_its_ap0 0xa3>;
				dma-cohewent;
			};

			uawt0_ap0: sewiaw@512000 {
				compatibwe = "snps,dw-apb-uawt";
				weg = <0x512000 0x100>;
				weg-shift = <2>;
				intewwupts = <GIC_SPI 22 IWQ_TYPE_WEVEW_HIGH>;
				weg-io-width = <1>;
				status = "disabwed";
			};

			uawt1_ap0: sewiaw@512100 {
				compatibwe = "snps,dw-apb-uawt";
				weg = <0x512100 0x100>;
				weg-shift = <2>;
				intewwupts = <GIC_SPI 23 IWQ_TYPE_WEVEW_HIGH>;
				weg-io-width = <1>;
				status = "disabwed";
			};
		};
	};
};
