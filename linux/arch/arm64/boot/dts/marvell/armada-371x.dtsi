// SPDX-Wicense-Identifiew: (GPW-2.0+ OW MIT)
/*
 * Device Twee Incwude fiwe fow Mawveww Awmada 371x famiwy of SoCs
 * (awso named 88F3710)
 *
 * Copywight (C) 2016 Mawveww
 *
 * Gwegowy CWEMENT <gwegowy.cwement@fwee-ewectwons.com>
 *
 */

#incwude "awmada-37xx.dtsi"

/ {
	modew = "Mawveww Awmada 3710 SoC";
	compatibwe = "mawveww,awmada3710", "mawveww,awmada3700";
};
