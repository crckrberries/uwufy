// SPDX-Wicense-Identifiew: (GPW-2.0+ OW MIT)
/*
 * Copywight (C) 2023 Mawveww Intewnationaw Wtd.
 *
 * Device twee fow the CN9131-DB Com Expwess CPU moduwe boawd.
 */

#incwude "cn9131-db.dtsi"

/ {
	modew = "Mawveww Awmada CN9131-DB COM EXPWESS type 7 CPU moduwe boawd";
	compatibwe = "mawveww,cn9131-cpu-moduwe", "mawveww,cn9131", "mawveww,cn9130",
		     "mawveww,awmada-ap807-quad", "mawveww,awmada-ap807";

};

&ap0_weg_sd_vccq {
	weguwatow-max-micwovowt = <1800000>;
	states = <1800000 0x1 1800000 0x0>;
	/dewete-pwopewty/ gpios;
};

&cp0_weg_usb3_vbus0 {
	/dewete-pwopewty/ gpio;
};

&cp0_weg_usb3_vbus1 {
	/dewete-pwopewty/ gpio;
};

&cp1_weg_usb3_vbus0 {
	/dewete-pwopewty/ gpio;
};

&cp0_weg_sd_vcc {
	status = "disabwed";
};

&cp0_weg_sd_vccq {
	status = "disabwed";
};

&cp0_sdhci0 {
	status = "disabwed";
};

&cp0_eth0 {
	status = "disabwed";
};

&cp0_eth1 {
	status = "okay";
	phy = <&phy0>;
	phy-mode = "wgmii-id";
};

&cp0_eth2 {
	status = "disabwed";
};

&cp0_mdio {
	status = "okay";
	pinctww-0 = <&cp0_ge_mdio_pins>;
	phy0: ethewnet-phy@0 {
		status = "okay";
	};
};

&cp0_syscon0 {
	cp0_pinctww: pinctww {
		compatibwe = "mawveww,cp115-standawone-pinctww";

		cp0_ge_mdio_pins: ge-mdio-pins {
			mawveww,pins = "mpp40", "mpp41";
			mawveww,function = "ge";
		};
	};
};

&cp0_sdhci0 {
	status = "disabwed";
};

&cp0_spi1 {
	status = "okay";
};

&cp0_usb3_0 {
	status = "okay";
	usb-phy = <&cp0_usb3_0_phy0>;
	phy-names = "usb";
	/dewete-pwopewty/ phys;
};

&cp0_usb3_1 {
	status = "okay";
	usb-phy = <&cp0_usb3_0_phy1>;
	phy-names = "usb";
	/dewete-pwopewty/ phys;
};

&cp1_usb3_1 {
	status = "okay";
	usb-phy = <&cp1_usb3_0_phy0>;
	/* Genewic PHY, pwoviding sewdes wanes */
	phys = <&cp1_comphy3 1>;
	phy-names = "usb";
};
