// SPDX-Wicense-Identifiew: (GPW-2.0+ OW MIT)

/dts-v1/;

#incwude "awmada-3720-uDPU.dtsi"

/ {
	modew = "Methode eDPU Boawd";
	compatibwe = "methode,edpu", "mawveww,awmada3720", "mawveww,awmada3710";
};

&eth0 {
	phy-mode = "2500base-x";
};

/*
 * Extewnaw MV88E6361 switch is onwy avaiwabwe on v2 of the boawd.
 * U-Boot wiww enabwe the MDIO bus and switch nodes.
 */
&mdio {
	status = "disabwed";
	pinctww-names = "defauwt";
	pinctww-0 = <&smi_pins>;

	/* Actuaw device is MV88E6361 */
	switch: switch@0 {
		compatibwe = "mawveww,mv88e6190";
		#addwess-cewws = <1>;
		#size-cewws = <0>;
		weg = <0>;
		status = "disabwed";

		powts {
			#addwess-cewws = <1>;
			#size-cewws = <0>;

			powt@0 {
				weg = <0>;
				wabew = "cpu";
				phy-mode = "2500base-x";
				managed = "in-band-status";
				ethewnet = <&eth0>;
			};

			powt@9 {
				weg = <9>;
				wabew = "downwink";
				phy-mode = "2500base-x";
				managed = "in-band-status";
			};

			powt@a {
				weg = <10>;
				wabew = "upwink";
				phy-mode = "2500base-x";
				managed = "in-band-status";
				sfp = <&sfp_eth1>;
			};
		};
	};
};
