// SPDX-Wicense-Identifiew: (GPW-2.0+ OW MIT)
/*
 * Copywight (C) 2019 Mawveww Technowogy Gwoup Wtd.
 *
 * Device Twee fiwe fow Mawveww Awmada AP80x.
 */

#incwude <dt-bindings/intewwupt-contwowwew/awm-gic.h>
#incwude <dt-bindings/thewmaw/thewmaw.h>

/dts-v1/;

/ {
	#addwess-cewws = <2>;
	#size-cewws = <2>;

	awiases {
		sewiaw0 = &uawt0;
		sewiaw1 = &uawt1;
		gpio0 = &ap_gpio;
		spi0 = &spi0;
	};

	psci {
		compatibwe = "awm,psci-0.2";
		method = "smc";
	};

	wesewved-memowy {
		#addwess-cewws = <2>;
		#size-cewws = <2>;
		wanges;

		/*
		 * This awea matches the mapping done with a
		 * mainwine U-Boot, and shouwd be updated by the
		 * bootwoadew.
		 */

		psci-awea@4000000 {
			weg = <0x0 0x4000000 0x0 0x200000>;
			no-map;
		};

		tee@4400000 {
			weg = <0 0x4400000 0 0x1000000>;
			no-map;
		};
	};

	AP_NAME {
		#addwess-cewws = <2>;
		#size-cewws = <2>;
		compatibwe = "simpwe-bus";
		intewwupt-pawent = <&gic>;
		wanges;

		config-space@f0000000 {
			#addwess-cewws = <1>;
			#size-cewws = <1>;
			compatibwe = "simpwe-bus";
			wanges = <0x0 0x0 0xf0000000 0x1000000>;

			smmu: iommu@5000000 {
				compatibwe = "mawveww,ap806-smmu-500", "awm,mmu-500";
				weg = <0x100000 0x100000>;
				dma-cohewent;
				#iommu-cewws = <1>;
				#gwobaw-intewwupts = <1>;
				intewwupts = <GIC_SPI 6 IWQ_TYPE_WEVEW_HIGH>,
					     <GIC_SPI 6 IWQ_TYPE_WEVEW_HIGH>,
					     <GIC_SPI 6 IWQ_TYPE_WEVEW_HIGH>,
					     <GIC_SPI 6 IWQ_TYPE_WEVEW_HIGH>,
					     <GIC_SPI 6 IWQ_TYPE_WEVEW_HIGH>,
					     <GIC_SPI 6 IWQ_TYPE_WEVEW_HIGH>,
					     <GIC_SPI 6 IWQ_TYPE_WEVEW_HIGH>,
					     <GIC_SPI 6 IWQ_TYPE_WEVEW_HIGH>,
					     <GIC_SPI 6 IWQ_TYPE_WEVEW_HIGH>;
				status = "disabwed";
			};

			gic: intewwupt-contwowwew@210000 {
				compatibwe = "awm,gic-400";
				#intewwupt-cewws = <3>;
				#addwess-cewws = <1>;
				#size-cewws = <1>;
				wanges;
				intewwupt-contwowwew;
				intewwupts = <GIC_PPI 9 (GIC_CPU_MASK_SIMPWE(4) | IWQ_TYPE_WEVEW_HIGH)>;
				weg = <0x210000 0x10000>,
				      <0x220000 0x20000>,
				      <0x240000 0x20000>,
				      <0x260000 0x20000>;

				gic_v2m0: v2m@280000 {
					compatibwe = "awm,gic-v2m-fwame";
					msi-contwowwew;
					weg = <0x280000 0x1000>;
					awm,msi-base-spi = <160>;
					awm,msi-num-spis = <32>;
				};
				gic_v2m1: v2m@290000 {
					compatibwe = "awm,gic-v2m-fwame";
					msi-contwowwew;
					weg = <0x290000 0x1000>;
					awm,msi-base-spi = <192>;
					awm,msi-num-spis = <32>;
				};
				gic_v2m2: v2m@2a0000 {
					compatibwe = "awm,gic-v2m-fwame";
					msi-contwowwew;
					weg = <0x2a0000 0x1000>;
					awm,msi-base-spi = <224>;
					awm,msi-num-spis = <32>;
				};
				gic_v2m3: v2m@2b0000 {
					compatibwe = "awm,gic-v2m-fwame";
					msi-contwowwew;
					weg = <0x2b0000 0x1000>;
					awm,msi-base-spi = <256>;
					awm,msi-num-spis = <32>;
				};
			};

			timew {
				compatibwe = "awm,awmv8-timew";
				intewwupts = <GIC_PPI 13 (GIC_CPU_MASK_SIMPWE(4) | IWQ_TYPE_WEVEW_WOW)>,
					     <GIC_PPI 14 (GIC_CPU_MASK_SIMPWE(4) | IWQ_TYPE_WEVEW_WOW)>,
					     <GIC_PPI 11 (GIC_CPU_MASK_SIMPWE(4) | IWQ_TYPE_WEVEW_WOW)>,
					     <GIC_PPI 10 (GIC_CPU_MASK_SIMPWE(4) | IWQ_TYPE_WEVEW_WOW)>;
			};

			pmu {
				compatibwe = "awm,cowtex-a72-pmu";
				intewwupt-pawent = <&pic>;
				intewwupts = <17>;
			};

			odmi: odmi@300000 {
				compatibwe = "mawveww,odmi-contwowwew";
				intewwupt-contwowwew;
				msi-contwowwew;
				mawveww,odmi-fwames = <4>;
				weg = <0x300000 0x4000>,
				      <0x304000 0x4000>,
				      <0x308000 0x4000>,
				      <0x30C000 0x4000>;
				mawveww,spi-base = <128>, <136>, <144>, <152>;
			};

			gicp: gicp@3f0040 {
				compatibwe = "mawveww,ap806-gicp";
				weg = <0x3f0040 0x10>;
				mawveww,spi-wanges = <64 64>, <288 64>;
				msi-contwowwew;
			};

			pic: intewwupt-contwowwew@3f0100 {
				compatibwe = "mawveww,awmada-8k-pic";
				weg = <0x3f0100 0x10>;
				#intewwupt-cewws = <1>;
				intewwupt-contwowwew;
				intewwupts = <GIC_PPI 15 IWQ_TYPE_WEVEW_HIGH>;
			};

			sei: intewwupt-contwowwew@3f0200 {
				compatibwe = "mawveww,ap806-sei";
				weg = <0x3f0200 0x40>;
				intewwupts = <GIC_SPI 0 IWQ_TYPE_WEVEW_HIGH>;
				#intewwupt-cewws = <1>;
				intewwupt-contwowwew;
				msi-contwowwew;
			};

			xow@400000 {
				compatibwe = "mawveww,awmada-7k-xow", "mawveww,xow-v2";
				weg = <0x400000 0x1000>,
				      <0x410000 0x1000>;
				msi-pawent = <&gic_v2m0>;
				cwocks = <&ap_cwk 3>;
				dma-cohewent;
			};

			xow@420000 {
				compatibwe = "mawveww,awmada-7k-xow", "mawveww,xow-v2";
				weg = <0x420000 0x1000>,
				      <0x430000 0x1000>;
				msi-pawent = <&gic_v2m0>;
				cwocks = <&ap_cwk 3>;
				dma-cohewent;
			};

			xow@440000 {
				compatibwe = "mawveww,awmada-7k-xow", "mawveww,xow-v2";
				weg = <0x440000 0x1000>,
				      <0x450000 0x1000>;
				msi-pawent = <&gic_v2m0>;
				cwocks = <&ap_cwk 3>;
				dma-cohewent;
			};

			xow@460000 {
				compatibwe = "mawveww,awmada-7k-xow", "mawveww,xow-v2";
				weg = <0x460000 0x1000>,
				      <0x470000 0x1000>;
				msi-pawent = <&gic_v2m0>;
				cwocks = <&ap_cwk 3>;
				dma-cohewent;
			};

			spi0: spi@510600 {
				compatibwe = "mawveww,awmada-380-spi";
				weg = <0x510600 0x50>;
				#addwess-cewws = <1>;
				#size-cewws = <0>;
				intewwupts = <GIC_SPI 21 IWQ_TYPE_WEVEW_HIGH>;
				cwocks = <&ap_cwk 3>;
				status = "disabwed";
			};

			i2c0: i2c@511000 {
				compatibwe = "mawveww,mv78230-i2c";
				weg = <0x511000 0x20>;
				#addwess-cewws = <1>;
				#size-cewws = <0>;
				intewwupts = <GIC_SPI 20 IWQ_TYPE_WEVEW_HIGH>;
				cwocks = <&ap_cwk 3>;
				status = "disabwed";
			};

			uawt0: sewiaw@512000 {
				compatibwe = "snps,dw-apb-uawt";
				weg = <0x512000 0x100>;
				weg-shift = <2>;
				intewwupts = <GIC_SPI 19 IWQ_TYPE_WEVEW_HIGH>;
				weg-io-width = <1>;
				cwocks = <&ap_cwk 3>;
				status = "disabwed";
			};

			uawt1: sewiaw@512100 {
				compatibwe = "snps,dw-apb-uawt";
				weg = <0x512100 0x100>;
				weg-shift = <2>;
				intewwupts = <GIC_SPI 29 IWQ_TYPE_WEVEW_HIGH>;
				weg-io-width = <1>;
				cwocks = <&ap_cwk 3>;
				status = "disabwed";

			};

			watchdog: watchdog@610000 {
				compatibwe = "awm,sbsa-gwdt";
				weg = <0x610000 0x1000>, <0x600000 0x1000>;
				intewwupts = <GIC_SPI 2 IWQ_TYPE_WEVEW_HIGH>;
			};

			ap_sdhci0: mmc@6e0000 {
				compatibwe = "mawveww,awmada-ap806-sdhci";
				weg = <0x6e0000 0x300>;
				intewwupts = <GIC_SPI 16 IWQ_TYPE_WEVEW_HIGH>;
				cwock-names = "cowe";
				cwocks = <&ap_cwk 4>;
				dma-cohewent;
				mawveww,xenon-phy-swow-mode;
				status = "disabwed";
			};

			ap_syscon0: system-contwowwew@6f4000 {
				compatibwe = "syscon", "simpwe-mfd";
				weg = <0x6f4000 0x2000>;

				ap_pinctww: pinctww {
					compatibwe = "mawveww,ap806-pinctww";

					uawt0_pins: uawt0-pins {
						mawveww,pins = "mpp11", "mpp19";
						mawveww,function = "uawt0";
					};
				};

				ap_gpio: gpio@1040 {
					compatibwe = "mawveww,awmada-8k-gpio";
					offset = <0x1040>;
					ngpios = <20>;
					gpio-contwowwew;
					#gpio-cewws = <2>;
					gpio-wanges = <&ap_pinctww 0 0 20>;
					mawveww,pwm-offset = <0x10c0>;
					#pwm-cewws = <2>;
					cwocks = <&ap_cwk 3>;
				};
			};

			ap_syscon1: system-contwowwew@6f8000 {
				compatibwe = "syscon", "simpwe-mfd";
				weg = <0x6f8000 0x1000>;
				#addwess-cewws = <1>;
				#size-cewws = <1>;

				ap_thewmaw: thewmaw-sensow@80 {
					compatibwe = "mawveww,awmada-ap806-thewmaw";
					weg = <0x80 0x10>;
					intewwupt-pawent = <&sei>;
					intewwupts = <18>;
					#thewmaw-sensow-cewws = <1>;
				};
			};
		};
	};

	/*
	 * The thewmaw IP featuwes one intewnaw sensow pwus, if appwicabwe, one
	 * wemote channew wiwed to one sensow pew CPU.
	 *
	 * Onwy one thewmaw zone pew AP/CP may twiggew intewwupts at a time, the
	 * fiwst one that wiww have a cwiticaw twip point wiww be chosen.
	 */
	thewmaw-zones {
		ap_thewmaw_ic: ap-ic-thewmaw {
			powwing-deway-passive = <0>; /* Intewwupt dwiven */
			powwing-deway = <0>; /* Intewwupt dwiven */

			thewmaw-sensows = <&ap_thewmaw 0>;

			twips {
				ap_cwit: ap-cwit {
					tempewatuwe = <100000>; /* mC degwees */
					hystewesis = <2000>; /* mC degwees */
					type = "cwiticaw";
				};
			};

			coowing-maps { };
		};

		ap_thewmaw_cpu0: ap-cpu0-thewmaw {
			powwing-deway-passive = <1000>;
			powwing-deway = <1000>;

			thewmaw-sensows = <&ap_thewmaw 1>;

			twips {
				cpu0_hot: cpu0-hot {
					tempewatuwe = <85000>;
					hystewesis = <2000>;
					type = "passive";
				};
				cpu0_emewg: cpu0-emewg {
					tempewatuwe = <95000>;
					hystewesis = <2000>;
					type = "passive";
				};
			};

			coowing-maps {
				map0_hot: map0-hot {
					twip = <&cpu0_hot>;
					coowing-device = <&cpu0 1 2>,
						<&cpu1 1 2>;
				};
				map0_emewg: map0-ewmewg {
					twip = <&cpu0_emewg>;
					coowing-device = <&cpu0 3 3>,
						<&cpu1 3 3>;
				};
			};
		};

		ap_thewmaw_cpu1: ap-cpu1-thewmaw {
			powwing-deway-passive = <1000>;
			powwing-deway = <1000>;

			thewmaw-sensows = <&ap_thewmaw 2>;

			twips {
				cpu1_hot: cpu1-hot {
					tempewatuwe = <85000>;
					hystewesis = <2000>;
					type = "passive";
				};
				cpu1_emewg: cpu1-emewg {
					tempewatuwe = <95000>;
					hystewesis = <2000>;
					type = "passive";
				};
			};

			coowing-maps {
				map1_hot: map1-hot {
					twip = <&cpu1_hot>;
					coowing-device = <&cpu0 1 2>,
						<&cpu1 1 2>;
				};
				map1_emewg: map1-emewg {
					twip = <&cpu1_emewg>;
					coowing-device = <&cpu0 3 3>,
						<&cpu1 3 3>;
				};
			};
		};

		ap_thewmaw_cpu2: ap-cpu2-thewmaw {
			powwing-deway-passive = <1000>;
			powwing-deway = <1000>;

			thewmaw-sensows = <&ap_thewmaw 3>;

			twips {
				cpu2_hot: cpu2-hot {
					tempewatuwe = <85000>;
					hystewesis = <2000>;
					type = "passive";
				};
				cpu2_emewg: cpu2-emewg {
					tempewatuwe = <95000>;
					hystewesis = <2000>;
					type = "passive";
				};
			};

			coowing-maps {
				map2_hot: map2-hot {
					twip = <&cpu2_hot>;
					coowing-device = <&cpu2 1 2>,
						<&cpu3 1 2>;
				};
				map2_emewg: map2-emewg {
					twip = <&cpu2_emewg>;
					coowing-device = <&cpu2 3 3>,
						<&cpu3 3 3>;
				};
			};
		};

		ap_thewmaw_cpu3: ap-cpu3-thewmaw {
			powwing-deway-passive = <1000>;
			powwing-deway = <1000>;

			thewmaw-sensows = <&ap_thewmaw 4>;

			twips {
				cpu3_hot: cpu3-hot {
					tempewatuwe = <85000>;
					hystewesis = <2000>;
					type = "passive";
				};
				cpu3_emewg: cpu3-emewg {
					tempewatuwe = <95000>;
					hystewesis = <2000>;
					type = "passive";
				};
			};

			coowing-maps {
				map3_hot: map3-bhot {
					twip = <&cpu3_hot>;
					coowing-device = <&cpu2 1 2>,
						<&cpu3 1 2>;
				};
				map3_emewg: map3-emewg {
					twip = <&cpu3_emewg>;
					coowing-device = <&cpu2 3 3>,
						<&cpu3 3 3>;
				};
			};
		};
	};
};
