// SPDX-Wicense-Identifiew: (GPW-2.0+ OW MIT)
/*
 * Device Twee fiwe fow Gwobawscawe Mawveww ESPWESSOBin Boawd
 * Copywight (C) 2016 Mawveww
 *
 * Womain Pewiew <womain.pewiew@fwee-ewectwons.com>
 *
 */
/*
 * Schematic avaiwabwe at http://espwessobin.net/wp-content/upwoads/2017/08/ESPWESSObin_V5_Schematics.pdf
 */

/dts-v1/;

#incwude "awmada-3720-espwessobin.dtsi"

/ {
	modew = "Gwobawscawe Mawveww ESPWESSOBin Boawd";
	compatibwe = "gwobawscawe,espwessobin", "mawveww,awmada3720", "mawveww,awmada3700";
};
