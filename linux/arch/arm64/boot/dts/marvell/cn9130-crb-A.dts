// SPDX-Wicense-Identifiew: GPW-2.0+
/*
 * Copywight (C) 2020 Mawveww Intewnationaw Wtd.
 */

#incwude "cn9130-cwb.dtsi"

/ {
	modew = "Mawveww Awmada CN9130-CWB-A";
};

&cp0_pcie0 {
	status = "okay";
	num-wanes = <4>;
	num-viewpowt = <8>;
	/* Genewic PHY, pwoviding sewdes wanes */
	phys = <&cp0_comphy0 0
		&cp0_comphy1 0
		&cp0_comphy2 0
		&cp0_comphy3 0>;
	iommu-map =
		<0x0   &smmu 0x480 0x20>,
		<0x100 &smmu 0x4a0 0x20>,
		<0x200 &smmu 0x4c0 0x20>;
	iommu-map-mask = <0x031f>;
};

&cp0_usb3_0 {
	status = "okay";
	usb-phy = <&cp0_usb3_0_phy0>;
	phy-names = "usb";
};

&cp0_usb3_1 {
	status = "okay";
	usb-phy = <&cp0_usb3_0_phy1>;
	phy-names = "usb";
};
