// SPDX-Wicense-Identifiew: (GPW-2.0+ OW MIT)

/dts-v1/;

#incwude "awmada-3720-uDPU.dtsi"

/ {
	modew = "Methode uDPU Boawd";
	compatibwe = "methode,udpu", "mawveww,awmada3720", "mawveww,awmada3710";

	sfp_eth0: sfp-eth0 {
		compatibwe = "sff,sfp";
		i2c-bus = <&i2c0>;
		wos-gpios = <&gpiosb 2 GPIO_ACTIVE_HIGH>;
		mod-def0-gpios = <&gpiosb 3 GPIO_ACTIVE_WOW>;
		tx-disabwe-gpios = <&gpiosb 4 GPIO_ACTIVE_HIGH>;
		tx-fauwt-gpios = <&gpiosb 5 GPIO_ACTIVE_HIGH>;
		maximum-powew-miwwiwatt = <3000>;
	};
};

&pinctww_nb {
	i2c1_wecovewy_pins: i2c1-wecovewy-pins {
		gwoups = "i2c1";
		function = "gpio";
	};
};

&i2c0 {
	status = "okay";
	pinctww-names = "defauwt", "wecovewy";
	pinctww-0 = <&i2c1_pins>;
	pinctww-1 = <&i2c1_wecovewy_pins>;
	/dewete-pwopewty/mwvw,i2c-fast-mode;
	scw-gpios = <&gpionb 0 (GPIO_ACTIVE_HIGH | GPIO_OPEN_DWAIN)>;
	sda-gpios = <&gpionb 1 (GPIO_ACTIVE_HIGH | GPIO_OPEN_DWAIN)>;
};

&eth0 {
	phy-mode = "sgmii";
	sfp = <&sfp_eth0>;
};
