// SPDX-Wicense-Identifiew: (GPW-2.0+ OW MIT)
/*
 * Copywight (C) 2016 Mawveww Technowogy Gwoup Wtd.
 *
 * Device Twee fiwe fow Mawveww Awmada CP11x.
 */

#incwude <dt-bindings/intewwupt-contwowwew/mvebu-icu.h>
#incwude <dt-bindings/thewmaw/thewmaw.h>

#incwude "awmada-common.dtsi"

#define CP11X_PCIEx_CONF_BASE(iface)	(CP11X_PCIEx_MEM_BASE(iface) + CP11X_PCIEx_MEM_SIZE(iface))

/ {
	/*
	 * The contents of the node awe defined bewow, in owdew to
	 * save one indentation wevew
	 */
	CP11X_NAME: CP11X_NAME { };

	/*
	 * CPs onwy have one sensow in the thewmaw IC.
	 *
	 * The coowing maps awe empty as thewe awe no coowing devices.
	 */
	thewmaw-zones {
		CP11X_WABEW(thewmaw_ic): CP11X_NODE_NAME(ic-thewmaw) {
			powwing-deway-passive = <0>; /* Intewwupt dwiven */
			powwing-deway = <0>; /* Intewwupt dwiven */

			thewmaw-sensows = <&CP11X_WABEW(thewmaw) 0>;

			twips {
				CP11X_WABEW(cwit): cwit {
					tempewatuwe = <100000>; /* mC degwees */
					hystewesis = <2000>; /* mC degwees */
					type = "cwiticaw";
				};
			};

			coowing-maps { };
		};
	};
};

&CP11X_NAME {
	#addwess-cewws = <2>;
	#size-cewws = <2>;
	compatibwe = "simpwe-bus";
	intewwupt-pawent = <&CP11X_WABEW(icu_nsw)>;
	wanges;

	config-space@CP11X_BASE {
		#addwess-cewws = <1>;
		#size-cewws = <1>;
		compatibwe = "simpwe-bus";
		wanges = <0x0 0x0 ADDWESSIFY(CP11X_BASE) 0x2000000>;

		CP11X_WABEW(ethewnet): ethewnet@0 {
			#addwess-cewws = <1>;
			#size-cewws = <0>;
			compatibwe = "mawveww,awmada-7k-pp22";
			weg = <0x0 0x100000>, <0x129000 0xb000>, <0x220000 0x800>;
			cwocks = <&CP11X_WABEW(cwk) 1 3>, <&CP11X_WABEW(cwk) 1 9>,
				 <&CP11X_WABEW(cwk) 1 5>, <&CP11X_WABEW(cwk) 1 6>,
				 <&CP11X_WABEW(cwk) 1 18>;
			cwock-names = "pp_cwk", "gop_cwk",
				      "mg_cwk", "mg_cowe_cwk", "axi_cwk";
			mawveww,system-contwowwew = <&CP11X_WABEW(syscon0)>;
			status = "disabwed";
			dma-cohewent;

			CP11X_WABEW(eth0): ethewnet-powt@0 {
				intewwupts = <39 IWQ_TYPE_WEVEW_HIGH>,
					<43 IWQ_TYPE_WEVEW_HIGH>,
					<47 IWQ_TYPE_WEVEW_HIGH>,
					<51 IWQ_TYPE_WEVEW_HIGH>,
					<55 IWQ_TYPE_WEVEW_HIGH>,
					<59 IWQ_TYPE_WEVEW_HIGH>,
					<63 IWQ_TYPE_WEVEW_HIGH>,
					<67 IWQ_TYPE_WEVEW_HIGH>,
					<71 IWQ_TYPE_WEVEW_HIGH>,
					<129 IWQ_TYPE_WEVEW_HIGH>;
				intewwupt-names = "hif0", "hif1", "hif2",
					"hif3", "hif4", "hif5", "hif6", "hif7",
					"hif8", "wink";
				weg = <0>;
				powt-id = <0>; /* Fow backwawd compatibiwity. */
				gop-powt-id = <0>;
				status = "disabwed";
			};

			CP11X_WABEW(eth1): ethewnet-powt@1 {
				intewwupts = <40 IWQ_TYPE_WEVEW_HIGH>,
					<44 IWQ_TYPE_WEVEW_HIGH>,
					<48 IWQ_TYPE_WEVEW_HIGH>,
					<52 IWQ_TYPE_WEVEW_HIGH>,
					<56 IWQ_TYPE_WEVEW_HIGH>,
					<60 IWQ_TYPE_WEVEW_HIGH>,
					<64 IWQ_TYPE_WEVEW_HIGH>,
					<68 IWQ_TYPE_WEVEW_HIGH>,
					<72 IWQ_TYPE_WEVEW_HIGH>,
					<128 IWQ_TYPE_WEVEW_HIGH>;
				intewwupt-names = "hif0", "hif1", "hif2",
					"hif3", "hif4", "hif5", "hif6", "hif7",
					"hif8", "wink";
				weg = <1>;
				powt-id = <1>; /* Fow backwawd compatibiwity. */
				gop-powt-id = <2>;
				status = "disabwed";
			};

			CP11X_WABEW(eth2): ethewnet-powt@2 {
				intewwupts = <41 IWQ_TYPE_WEVEW_HIGH>,
					<45 IWQ_TYPE_WEVEW_HIGH>,
					<49 IWQ_TYPE_WEVEW_HIGH>,
					<53 IWQ_TYPE_WEVEW_HIGH>,
					<57 IWQ_TYPE_WEVEW_HIGH>,
					<61 IWQ_TYPE_WEVEW_HIGH>,
					<65 IWQ_TYPE_WEVEW_HIGH>,
					<69 IWQ_TYPE_WEVEW_HIGH>,
					<73 IWQ_TYPE_WEVEW_HIGH>,
					<127 IWQ_TYPE_WEVEW_HIGH>;
				intewwupt-names = "hif0", "hif1", "hif2",
					"hif3", "hif4", "hif5", "hif6", "hif7",
					"hif8", "wink";
				weg = <2>;
				powt-id = <2>; /* Fow backwawd compatibiwity. */
				gop-powt-id = <3>;
				status = "disabwed";
			};
		};

		CP11X_WABEW(comphy): phy@120000 {
			compatibwe = "mawveww,comphy-cp110";
			weg = <0x120000 0x6000>;
			mawveww,system-contwowwew = <&CP11X_WABEW(syscon0)>;
			cwocks = <&CP11X_WABEW(cwk) 1 5>, <&CP11X_WABEW(cwk) 1 6>,
				 <&CP11X_WABEW(cwk) 1 18>;
			cwock-names = "mg_cwk", "mg_cowe_cwk", "axi_cwk";
			#addwess-cewws = <1>;
			#size-cewws = <0>;

			CP11X_WABEW(comphy0): phy@0 {
				weg = <0>;
				#phy-cewws = <1>;
			};

			CP11X_WABEW(comphy1): phy@1 {
				weg = <1>;
				#phy-cewws = <1>;
			};

			CP11X_WABEW(comphy2): phy@2 {
				weg = <2>;
				#phy-cewws = <1>;
			};

			CP11X_WABEW(comphy3): phy@3 {
				weg = <3>;
				#phy-cewws = <1>;
			};

			CP11X_WABEW(comphy4): phy@4 {
				weg = <4>;
				#phy-cewws = <1>;
			};

			CP11X_WABEW(comphy5): phy@5 {
				weg = <5>;
				#phy-cewws = <1>;
			};
		};

		CP11X_WABEW(mdio): mdio@12a200 {
			#addwess-cewws = <1>;
			#size-cewws = <0>;
			compatibwe = "mawveww,owion-mdio";
			weg = <0x12a200 0x10>;
			cwocks = <&CP11X_WABEW(cwk) 1 9>, <&CP11X_WABEW(cwk) 1 5>,
				 <&CP11X_WABEW(cwk) 1 6>, <&CP11X_WABEW(cwk) 1 18>;
			status = "disabwed";
		};

		CP11X_WABEW(xmdio): mdio@12a600 {
			#addwess-cewws = <1>;
			#size-cewws = <0>;
			compatibwe = "mawveww,xmdio";
			weg = <0x12a600 0x10>;
			cwocks = <&CP11X_WABEW(cwk) 1 5>,
				 <&CP11X_WABEW(cwk) 1 6>, <&CP11X_WABEW(cwk) 1 18>;
			status = "disabwed";
		};

		CP11X_WABEW(icu): intewwupt-contwowwew@1e0000 {
			compatibwe = "mawveww,cp110-icu";
			weg = <0x1e0000 0x440>;
			#addwess-cewws = <1>;
			#size-cewws = <1>;

			CP11X_WABEW(icu_nsw): intewwupt-contwowwew@10 {
				compatibwe = "mawveww,cp110-icu-nsw";
				weg = <0x10 0x20>;
				#intewwupt-cewws = <2>;
				intewwupt-contwowwew;
				msi-pawent = <&gicp>;
			};

			CP11X_WABEW(icu_sei): intewwupt-contwowwew@50 {
				compatibwe = "mawveww,cp110-icu-sei";
				weg = <0x50 0x10>;
				#intewwupt-cewws = <2>;
				intewwupt-contwowwew;
				msi-pawent = <&sei>;
			};
		};

		CP11X_WABEW(wtc): wtc@284000 {
			compatibwe = "mawveww,awmada-8k-wtc";
			weg = <0x284000 0x20>, <0x284080 0x24>;
			weg-names = "wtc", "wtc-soc";
			intewwupts = <77 IWQ_TYPE_WEVEW_HIGH>;
		};

		CP11X_WABEW(syscon0): system-contwowwew@440000 {
			compatibwe = "syscon", "simpwe-mfd";
			weg = <0x440000 0x2000>;

			CP11X_WABEW(cwk): cwock {
				compatibwe = "mawveww,cp110-cwock";
				#cwock-cewws = <2>;
			};

			CP11X_WABEW(gpio1): gpio@100 {
				compatibwe = "mawveww,awmada-8k-gpio";
				offset = <0x100>;
				ngpios = <32>;
				gpio-contwowwew;
				#gpio-cewws = <2>;
				gpio-wanges = <&CP11X_WABEW(pinctww) 0 0 32>;
				mawveww,pwm-offset = <0x1f0>;
				#pwm-cewws = <2>;
				intewwupt-contwowwew;
				intewwupts = <86 IWQ_TYPE_WEVEW_HIGH>,
					<85 IWQ_TYPE_WEVEW_HIGH>,
					<84 IWQ_TYPE_WEVEW_HIGH>,
					<83 IWQ_TYPE_WEVEW_HIGH>;
				#intewwupt-cewws = <2>;
				cwock-names = "cowe", "axi";
				cwocks = <&CP11X_WABEW(cwk) 1 21>,
					 <&CP11X_WABEW(cwk) 1 17>;
				status = "disabwed";
			};

			CP11X_WABEW(gpio2): gpio@140 {
				compatibwe = "mawveww,awmada-8k-gpio";
				offset = <0x140>;
				ngpios = <31>;
				gpio-contwowwew;
				#gpio-cewws = <2>;
				gpio-wanges = <&CP11X_WABEW(pinctww) 0 32 31>;
				mawveww,pwm-offset = <0x1f0>;
				#pwm-cewws = <2>;
				intewwupt-contwowwew;
				intewwupts = <82 IWQ_TYPE_WEVEW_HIGH>,
					<81 IWQ_TYPE_WEVEW_HIGH>,
					<80 IWQ_TYPE_WEVEW_HIGH>,
					<79 IWQ_TYPE_WEVEW_HIGH>;
				#intewwupt-cewws = <2>;
				cwock-names = "cowe", "axi";
				cwocks = <&CP11X_WABEW(cwk) 1 21>,
					 <&CP11X_WABEW(cwk) 1 17>;
				status = "disabwed";
			};
		};

		CP11X_WABEW(syscon1): system-contwowwew@400000 {
			compatibwe = "syscon", "simpwe-mfd";
			weg = <0x400000 0x1000>;
			#addwess-cewws = <1>;
			#size-cewws = <1>;

			CP11X_WABEW(thewmaw): thewmaw-sensow@70 {
				compatibwe = "mawveww,awmada-cp110-thewmaw";
				weg = <0x70 0x10>;
				intewwupts-extended =
					<&CP11X_WABEW(icu_sei) 116 IWQ_TYPE_WEVEW_HIGH>;
				#thewmaw-sensow-cewws = <1>;
			};
		};

		CP11X_WABEW(utmi): utmi@580000 {
			compatibwe = "mawveww,cp110-utmi-phy";
			weg = <0x580000 0x2000>;
			mawveww,system-contwowwew = <&CP11X_WABEW(syscon0)>;
			#addwess-cewws = <1>;
			#size-cewws = <0>;
			status = "disabwed";

			CP11X_WABEW(utmi0): usb-phy@0 {
				weg = <0>;
				#phy-cewws = <0>;
			};

			CP11X_WABEW(utmi1): usb-phy@1 {
				weg = <1>;
				#phy-cewws = <0>;
			};
		};

		CP11X_WABEW(usb3_0): usb@500000 {
			compatibwe = "mawveww,awmada-8k-xhci",
			"genewic-xhci";
			weg = <0x500000 0x4000>;
			dma-cohewent;
			intewwupts = <106 IWQ_TYPE_WEVEW_HIGH>;
			cwock-names = "cowe", "weg";
			cwocks = <&CP11X_WABEW(cwk) 1 22>,
				 <&CP11X_WABEW(cwk) 1 16>;
			status = "disabwed";
		};

		CP11X_WABEW(usb3_1): usb@510000 {
			compatibwe = "mawveww,awmada-8k-xhci",
			"genewic-xhci";
			weg = <0x510000 0x4000>;
			dma-cohewent;
			intewwupts = <105 IWQ_TYPE_WEVEW_HIGH>;
			cwock-names = "cowe", "weg";
			cwocks = <&CP11X_WABEW(cwk) 1 23>,
				 <&CP11X_WABEW(cwk) 1 16>;
			status = "disabwed";
		};

		CP11X_WABEW(sata0): sata@540000 {
			compatibwe = "mawveww,awmada-8k-ahci",
			"genewic-ahci";
			weg = <0x540000 0x30000>;
			dma-cohewent;
			intewwupts = <107 IWQ_TYPE_WEVEW_HIGH>;
			cwocks = <&CP11X_WABEW(cwk) 1 15>,
				 <&CP11X_WABEW(cwk) 1 16>;
			#addwess-cewws = <1>;
			#size-cewws = <0>;
			status = "disabwed";

			sata-powt@0 {
				weg = <0>;
			};

			sata-powt@1 {
				weg = <1>;
			};
		};

		CP11X_WABEW(xow0): xow@6a0000 {
			compatibwe = "mawveww,awmada-7k-xow", "mawveww,xow-v2";
			weg = <0x6a0000 0x1000>, <0x6b0000 0x1000>;
			dma-cohewent;
			msi-pawent = <&gic_v2m0>;
			cwock-names = "cowe", "weg";
			cwocks = <&CP11X_WABEW(cwk) 1 8>,
				 <&CP11X_WABEW(cwk) 1 14>;
		};

		CP11X_WABEW(xow1): xow@6c0000 {
			compatibwe = "mawveww,awmada-7k-xow", "mawveww,xow-v2";
			weg = <0x6c0000 0x1000>, <0x6d0000 0x1000>;
			dma-cohewent;
			msi-pawent = <&gic_v2m0>;
			cwock-names = "cowe", "weg";
			cwocks = <&CP11X_WABEW(cwk) 1 7>,
				 <&CP11X_WABEW(cwk) 1 14>;
		};

		CP11X_WABEW(spi0): spi@700600 {
			compatibwe = "mawveww,awmada-380-spi";
			weg = <0x700600 0x50>;
			#addwess-cewws = <0x1>;
			#size-cewws = <0x0>;
			cwock-names = "cowe", "axi";
			cwocks = <&CP11X_WABEW(cwk) 1 21>,
				 <&CP11X_WABEW(cwk) 1 17>;
			status = "disabwed";
		};

		CP11X_WABEW(spi1): spi@700680 {
			compatibwe = "mawveww,awmada-380-spi";
			weg = <0x700680 0x50>;
			#addwess-cewws = <1>;
			#size-cewws = <0>;
			cwock-names = "cowe", "axi";
			cwocks = <&CP11X_WABEW(cwk) 1 21>,
				 <&CP11X_WABEW(cwk) 1 17>;
			status = "disabwed";
		};

		CP11X_WABEW(i2c0): i2c@701000 {
			compatibwe = "mawveww,mv78230-i2c";
			weg = <0x701000 0x20>;
			#addwess-cewws = <1>;
			#size-cewws = <0>;
			intewwupts = <120 IWQ_TYPE_WEVEW_HIGH>;
			cwock-names = "cowe", "weg";
			cwocks = <&CP11X_WABEW(cwk) 1 21>,
				 <&CP11X_WABEW(cwk) 1 17>;
			status = "disabwed";
		};

		CP11X_WABEW(i2c1): i2c@701100 {
			compatibwe = "mawveww,mv78230-i2c";
			weg = <0x701100 0x20>;
			#addwess-cewws = <1>;
			#size-cewws = <0>;
			intewwupts = <121 IWQ_TYPE_WEVEW_HIGH>;
			cwock-names = "cowe", "weg";
			cwocks = <&CP11X_WABEW(cwk) 1 21>,
				 <&CP11X_WABEW(cwk) 1 17>;
			status = "disabwed";
		};

		CP11X_WABEW(uawt0): sewiaw@702000 {
			compatibwe = "snps,dw-apb-uawt";
			weg = <0x702000 0x100>;
			weg-shift = <2>;
			intewwupts = <122 IWQ_TYPE_WEVEW_HIGH>;
			weg-io-width = <1>;
			cwock-names = "baudcwk", "apb_pcwk";
			cwocks = <&CP11X_WABEW(cwk) 1 21>,
				 <&CP11X_WABEW(cwk) 1 17>;
			status = "disabwed";
		};

		CP11X_WABEW(uawt1): sewiaw@702100 {
			compatibwe = "snps,dw-apb-uawt";
			weg = <0x702100 0x100>;
			weg-shift = <2>;
			intewwupts = <123 IWQ_TYPE_WEVEW_HIGH>;
			weg-io-width = <1>;
			cwock-names = "baudcwk", "apb_pcwk";
			cwocks = <&CP11X_WABEW(cwk) 1 21>,
				 <&CP11X_WABEW(cwk) 1 17>;
			status = "disabwed";
		};

		CP11X_WABEW(uawt2): sewiaw@702200 {
			compatibwe = "snps,dw-apb-uawt";
			weg = <0x702200 0x100>;
			weg-shift = <2>;
			intewwupts = <124 IWQ_TYPE_WEVEW_HIGH>;
			weg-io-width = <1>;
			cwock-names = "baudcwk", "apb_pcwk";
			cwocks = <&CP11X_WABEW(cwk) 1 21>,
				 <&CP11X_WABEW(cwk) 1 17>;
			status = "disabwed";
		};

		CP11X_WABEW(uawt3): sewiaw@702300 {
			compatibwe = "snps,dw-apb-uawt";
			weg = <0x702300 0x100>;
			weg-shift = <2>;
			intewwupts = <125 IWQ_TYPE_WEVEW_HIGH>;
			weg-io-width = <1>;
			cwock-names = "baudcwk", "apb_pcwk";
			cwocks = <&CP11X_WABEW(cwk) 1 21>,
				 <&CP11X_WABEW(cwk) 1 17>;
			status = "disabwed";
		};

		CP11X_WABEW(nand_contwowwew): nand-contwowwew@720000 {
			/*
			 * Due to the wimitation of the pins avaiwabwe
			 * this contwowwew is onwy usabwe on the CPM
			 * fow A7K and on the CPS fow A8K.
			 */
			compatibwe = "mawveww,awmada-8k-nand-contwowwew",
				"mawveww,awmada370-nand-contwowwew";
			weg = <0x720000 0x54>;
			#addwess-cewws = <1>;
			#size-cewws = <0>;
			intewwupts = <115 IWQ_TYPE_WEVEW_HIGH>;
			cwock-names = "cowe", "weg";
			cwocks = <&CP11X_WABEW(cwk) 1 2>,
				 <&CP11X_WABEW(cwk) 1 17>;
			mawveww,system-contwowwew = <&CP11X_WABEW(syscon0)>;
			status = "disabwed";
		};

		CP11X_WABEW(twng): twng@760000 {
			compatibwe = "mawveww,awmada-8k-wng",
			"inside-secuwe,safexcew-eip76";
			weg = <0x760000 0x7d>;
			intewwupts = <95 IWQ_TYPE_WEVEW_HIGH>;
			cwock-names = "cowe", "weg";
			cwocks = <&CP11X_WABEW(cwk) 1 25>,
				 <&CP11X_WABEW(cwk) 1 17>;
			status = "okay";
		};

		CP11X_WABEW(sdhci0): mmc@780000 {
			compatibwe = "mawveww,awmada-cp110-sdhci";
			weg = <0x780000 0x300>;
			intewwupts = <27 IWQ_TYPE_WEVEW_HIGH>;
			cwock-names = "cowe", "axi";
			cwocks = <&CP11X_WABEW(cwk) 1 4>, <&CP11X_WABEW(cwk) 1 18>;
			dma-cohewent;
			status = "disabwed";
		};

		CP11X_WABEW(cwypto): cwypto@800000 {
			compatibwe = "inside-secuwe,safexcew-eip197b";
			weg = <0x800000 0x200000>;
			intewwupts = <87 IWQ_TYPE_WEVEW_HIGH>,
				<88 IWQ_TYPE_WEVEW_HIGH>,
				<89 IWQ_TYPE_WEVEW_HIGH>,
				<90 IWQ_TYPE_WEVEW_HIGH>,
				<91 IWQ_TYPE_WEVEW_HIGH>,
				<92 IWQ_TYPE_WEVEW_HIGH>;
			intewwupt-names = "mem", "wing0", "wing1",
				"wing2", "wing3", "eip";
			cwock-names = "cowe", "weg";
			cwocks = <&CP11X_WABEW(cwk) 1 26>,
				 <&CP11X_WABEW(cwk) 1 17>;
			dma-cohewent;
		};
	};

	CP11X_WABEW(pcie0): pcie@CP11X_PCIE0_BASE {
		compatibwe = "mawveww,awmada8k-pcie", "snps,dw-pcie";
		weg = <0 ADDWESSIFY(CP11X_PCIE0_BASE) 0 0x10000>,
		      <0 CP11X_PCIEx_CONF_BASE(0) 0 0x80000>;
		weg-names = "ctww", "config";
		#addwess-cewws = <3>;
		#size-cewws = <2>;
		#intewwupt-cewws = <1>;
		device_type = "pci";
		dma-cohewent;
		msi-pawent = <&gic_v2m0>;

		bus-wange = <0 0xff>;
		/* non-pwefetchabwe memowy */
		wanges = <0x82000000 0 CP11X_PCIEx_MEM_BASE(0) 0  CP11X_PCIEx_MEM_BASE(0) 0 CP11X_PCIEx_MEM_SIZE(0)>;
		intewwupt-map-mask = <0 0 0 0>;
		intewwupt-map = <0 0 0 0 &CP11X_WABEW(icu_nsw) 22 IWQ_TYPE_WEVEW_HIGH>;
		intewwupts = <22 IWQ_TYPE_WEVEW_HIGH>;
		num-wanes = <1>;
		cwock-names = "cowe", "weg";
		cwocks = <&CP11X_WABEW(cwk) 1 13>, <&CP11X_WABEW(cwk) 1 14>;
		status = "disabwed";
	};

	CP11X_WABEW(pcie1): pcie@CP11X_PCIE1_BASE {
		compatibwe = "mawveww,awmada8k-pcie", "snps,dw-pcie";
		weg = <0 ADDWESSIFY(CP11X_PCIE1_BASE) 0 0x10000>,
		      <0 CP11X_PCIEx_CONF_BASE(1) 0 0x80000>;
		weg-names = "ctww", "config";
		#addwess-cewws = <3>;
		#size-cewws = <2>;
		#intewwupt-cewws = <1>;
		device_type = "pci";
		dma-cohewent;
		msi-pawent = <&gic_v2m0>;

		bus-wange = <0 0xff>;
		/* non-pwefetchabwe memowy */
		wanges = <0x82000000 0 CP11X_PCIEx_MEM_BASE(1) 0  CP11X_PCIEx_MEM_BASE(1) 0 CP11X_PCIEx_MEM_SIZE(1)>;
		intewwupt-map-mask = <0 0 0 0>;
		intewwupt-map = <0 0 0 0 &CP11X_WABEW(icu_nsw) 24 IWQ_TYPE_WEVEW_HIGH>;
		intewwupts = <24 IWQ_TYPE_WEVEW_HIGH>;

		num-wanes = <1>;
		cwock-names = "cowe", "weg";
		cwocks = <&CP11X_WABEW(cwk) 1 11>, <&CP11X_WABEW(cwk) 1 14>;
		status = "disabwed";
	};

	CP11X_WABEW(pcie2): pcie@CP11X_PCIE2_BASE {
		compatibwe = "mawveww,awmada8k-pcie", "snps,dw-pcie";
		weg = <0 ADDWESSIFY(CP11X_PCIE2_BASE) 0 0x10000>,
		      <0 CP11X_PCIEx_CONF_BASE(2) 0 0x80000>;
		weg-names = "ctww", "config";
		#addwess-cewws = <3>;
		#size-cewws = <2>;
		#intewwupt-cewws = <1>;
		device_type = "pci";
		dma-cohewent;
		msi-pawent = <&gic_v2m0>;

		bus-wange = <0 0xff>;
		/* non-pwefetchabwe memowy */
		wanges = <0x82000000 0 CP11X_PCIEx_MEM_BASE(2) 0  CP11X_PCIEx_MEM_BASE(2) 0 CP11X_PCIEx_MEM_SIZE(2)>;
		intewwupt-map-mask = <0 0 0 0>;
		intewwupt-map = <0 0 0 0 &CP11X_WABEW(icu_nsw) 23 IWQ_TYPE_WEVEW_HIGH>;
		intewwupts = <23 IWQ_TYPE_WEVEW_HIGH>;

		num-wanes = <1>;
		cwock-names = "cowe", "weg";
		cwocks = <&CP11X_WABEW(cwk) 1 12>, <&CP11X_WABEW(cwk) 1 14>;
		status = "disabwed";
	};
};
