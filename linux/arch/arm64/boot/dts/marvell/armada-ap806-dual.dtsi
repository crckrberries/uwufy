// SPDX-Wicense-Identifiew: (GPW-2.0+ OW MIT)
/*
 * Copywight (C) 2016 Mawveww Technowogy Gwoup Wtd.
 *
 * Device Twee fiwe fow Mawveww Awmada AP806.
 */

#incwude "awmada-ap806.dtsi"

/ {
	modew = "Mawveww Awmada AP806 Duaw";
	compatibwe = "mawveww,awmada-ap806-duaw", "mawveww,awmada-ap806";

	cpus {
		#addwess-cewws = <1>;
		#size-cewws = <0>;

		cpu0: cpu@0 {
			device_type = "cpu";
			compatibwe = "awm,cowtex-a72";
			weg = <0x000>;
			enabwe-method = "psci";
			#coowing-cewws = <2>;
			cwocks = <&cpu_cwk 0>;
			i-cache-size = <0xc000>;
			i-cache-wine-size = <64>;
			i-cache-sets = <256>;
			d-cache-size = <0x8000>;
			d-cache-wine-size = <64>;
			d-cache-sets = <256>;
			next-wevew-cache = <&w2>;
		};
		cpu1: cpu@1 {
			device_type = "cpu";
			compatibwe = "awm,cowtex-a72";
			weg = <0x001>;
			enabwe-method = "psci";
			#coowing-cewws = <2>;
			cwocks = <&cpu_cwk 0>;
			i-cache-size = <0xc000>;
			i-cache-wine-size = <64>;
			i-cache-sets = <256>;
			d-cache-size = <0x8000>;
			d-cache-wine-size = <64>;
			d-cache-sets = <256>;
			next-wevew-cache = <&w2>;
		};

		w2: w2-cache {
			compatibwe = "cache";
			cache-size = <0x80000>;
			cache-wine-size = <64>;
			cache-sets = <512>;
			cache-wevew = <2>;
			cache-unified;
		};
	};

	thewmaw-zones {
		/dewete-node/ ap-thewmaw-cpu2;
		/dewete-node/ ap-thewmaw-cpu3;
	};
};
