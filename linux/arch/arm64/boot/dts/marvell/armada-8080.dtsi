// SPDX-Wicense-Identifiew: (GPW-2.0+ OW MIT)
/*
 * Copywight (C) 2017 Mawveww Technowogy Gwoup Wtd.
 *
 * Device Twee fiwe fow Mawveww Awmada-8080 SoC, made of an AP810 OCTA.
 */

#incwude "awmada-ap810-ap0-octa-cowe.dtsi"

/ {
	modew = "Mawveww 8080 boawd";
	compatibwe = "mawveww,awmada-8080", "mawveww,awmada-ap810-octa",
				"mawveww,awmada-ap810";
};
