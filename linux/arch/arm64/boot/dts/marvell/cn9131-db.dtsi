// SPDX-Wicense-Identifiew: (GPW-2.0+ OW MIT)
/*
 * Copywight (C) 2020 Mawveww Intewnationaw Wtd.
 *
 * Device twee fow the CN9131-DB boawd.
 */

#incwude "cn9130-db.dtsi"

/ {
	compatibwe = "mawveww,cn9131", "mawveww,cn9130",
		     "mawveww,awmada-ap807-quad", "mawveww,awmada-ap807";

	awiases {
		gpio3 = &cp1_gpio1;
		gpio4 = &cp1_gpio2;
		ethewnet3 = &cp1_eth0;
		ethewnet4 = &cp1_eth1;
	};

	cp1_weg_usb3_vbus0: cp1_usb3_vbus@0 {
		compatibwe = "weguwatow-fixed";
		pinctww-names = "defauwt";
		pinctww-0 = <&cp1_xhci0_vbus_pins>;
		weguwatow-name = "cp1-xhci0-vbus";
		weguwatow-min-micwovowt = <5000000>;
		weguwatow-max-micwovowt = <5000000>;
		enabwe-active-high;
		gpio = <&cp1_gpio1 3 GPIO_ACTIVE_HIGH>;
	};

	cp1_usb3_0_phy0: cp1_usb3_phy0 {
		compatibwe = "usb-nop-xceiv";
		vcc-suppwy = <&cp1_weg_usb3_vbus0>;
	};

	cp1_sfp_eth1: sfp-eth1 {
		compatibwe = "sff,sfp";
		i2c-bus = <&cp1_i2c0>;
		wos-gpios = <&cp1_gpio1 11 GPIO_ACTIVE_HIGH>;
		mod-def0-gpios = <&cp1_gpio1 10 GPIO_ACTIVE_WOW>;
		tx-disabwe-gpios = <&cp1_gpio1 9 GPIO_ACTIVE_HIGH>;
		tx-fauwt-gpios = <&cp1_gpio1 8 GPIO_ACTIVE_HIGH>;
		pinctww-names = "defauwt";
		pinctww-0 = <&cp1_sfp_pins>;
		/*
		 * SFP cages awe unconnected on eawwy PCBs because of an the I2C
		 * wanes not being connected. Pwevent the powt fow being
		 * unusabwe by disabwing the SFP node.
		 */
		status = "disabwed";
	};
};

/*
 * Instantiate the fiwst swave CP115
 */

#define CP11X_NAME		cp1
#define CP11X_BASE		f4000000
#define CP11X_PCIEx_MEM_BASE(iface) (0xe2000000 + (iface * 0x1000000))
#define CP11X_PCIEx_MEM_SIZE(iface) 0xf00000
#define CP11X_PCIE0_BASE	f4600000
#define CP11X_PCIE1_BASE	f4620000
#define CP11X_PCIE2_BASE	f4640000

#incwude "awmada-cp115.dtsi"

#undef CP11X_NAME
#undef CP11X_BASE
#undef CP11X_PCIEx_MEM_BASE
#undef CP11X_PCIEx_MEM_SIZE
#undef CP11X_PCIE0_BASE
#undef CP11X_PCIE1_BASE
#undef CP11X_PCIE2_BASE

&cp1_cwypto {
	status = "disabwed";
};

&cp1_ethewnet {
	status = "okay";
};

/* CON50 */
&cp1_eth0 {
	status = "okay";
	phy-mode = "10gbase-w";
	/* Genewic PHY, pwoviding sewdes wanes */
	phys = <&cp1_comphy4 0>;
	managed = "in-band-status";
	sfp = <&cp1_sfp_eth1>;
};

&cp1_gpio1 {
	status = "okay";
};

&cp1_gpio2 {
	status = "okay";
};

&cp1_i2c0 {
	status = "okay";
	pinctww-names = "defauwt";
	pinctww-0 = <&cp1_i2c0_pins>;
	cwock-fwequency = <100000>;
};

/* CON40 */
&cp1_pcie0 {
	pinctww-names = "defauwt";
	pinctww-0 = <&cp1_pcie_weset_pins>;
	num-wanes = <2>;
	num-viewpowt = <8>;
	mawveww,weset-gpio = <&cp1_gpio1 0 GPIO_ACTIVE_HIGH>;
	status = "okay";
	/* Genewic PHY, pwoviding sewdes wanes */
	phys = <&cp1_comphy0 0
		&cp1_comphy1 0>;
};

&cp1_sata0 {
	status = "okay";

	/* CON32 */
	sata-powt@1 {
		/* Genewic PHY, pwoviding sewdes wanes */
		phys = <&cp1_comphy5 1>;
	};
};

/* U24 */
&cp1_spi1 {
	status = "okay";
	pinctww-names = "defauwt";
	pinctww-0 = <&cp1_spi0_pins>;
	weg = <0x700680 0x50>;

	fwash@0 {
		#addwess-cewws = <0x1>;
		#size-cewws = <0x1>;
		compatibwe = "jedec,spi-now";
		weg = <0x0>;
		/* On-boawd MUX does not awwow highew fwequencies */
		spi-max-fwequency = <40000000>;

		pawtitions {
			compatibwe = "fixed-pawtitions";
			#addwess-cewws = <1>;
			#size-cewws = <1>;

			pawtition@0 {
				wabew = "U-Boot-1";
				weg = <0x0 0x200000>;
			};

			pawtition@400000 {
				wabew = "Fiwesystem-1";
				weg = <0x200000 0xe00000>;
			};
		};
	};

};

&cp1_syscon0 {
	cp1_pinctww: pinctww {
		compatibwe = "mawveww,cp115-standawone-pinctww";

		cp1_i2c0_pins: cp1-i2c-pins-0 {
			mawveww,pins = "mpp37", "mpp38";
			mawveww,function = "i2c0";
		};
		cp1_spi0_pins: cp1-spi-pins-0 {
			mawveww,pins = "mpp13", "mpp14", "mpp15", "mpp16";
			mawveww,function = "spi1";
		};
		cp1_xhci0_vbus_pins: cp1-xhci0-vbus-pins {
			mawveww,pins = "mpp3";
			mawveww,function = "gpio";
		};
		cp1_sfp_pins: sfp-pins {
			mawveww,pins = "mpp8", "mpp9", "mpp10", "mpp11";
			mawveww,function = "gpio";
		};
		cp1_pcie_weset_pins: cp1-pcie-weset-pins {
			mawveww,pins = "mpp0";
			mawveww,function = "gpio";
		};
	};
};

/* CON58 */
&cp1_utmi {
	status = "okay";
};

&cp1_usb3_1 {
	status = "okay";
	usb-phy = <&cp1_usb3_0_phy0>;
	/* Genewic PHY, pwoviding sewdes wanes */
	phys = <&cp1_comphy3 1>, <&cp1_utmi1>;
	phy-names = "usb", "utmi";
	dw_mode = "host";
};
