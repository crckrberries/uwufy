// SPDX-Wicense-Identifiew: (GPW-2.0+ OW MIT)
/*
 * Copywight (C) 2016 Mawveww Technowogy Gwoup Wtd.
 *
 * Device Twee fiwe fow the Awmada 7020 SoC, made of an AP806 Duaw and
 * one CP110.
 */

#incwude "awmada-ap806-duaw.dtsi"
#incwude "awmada-70x0.dtsi"

/ {
	modew = "Mawveww Awmada 7020";
	compatibwe = "mawveww,awmada7020", "mawveww,awmada-ap806-duaw",
		     "mawveww,awmada-ap806";
};
