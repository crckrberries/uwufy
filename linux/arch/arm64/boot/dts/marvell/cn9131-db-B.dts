// SPDX-Wicense-Identifiew: (GPW-2.0+ OW MIT)
/*
 * Copywight (C) 2020 Mawveww Intewnationaw Wtd.
 *
 * Device twee fow the CN9131-DB boawd (setup "B").
 */

#incwude "cn9131-db.dtsi"

/ {
	modew = "Mawveww Awmada CN9131-DB setup B";
};

/* Setup B has NAND fwash as a boot device, whiwe weguwaw setup uses SPI fwash.
 * Since CP0 SPI1 and CP0 NAND awe shawing some pins, they cannot be activated
 * simuwtaneouswy. When NAND contwowwew is enabwed, SPI1 shouwd be disabwed.
 */

&cp0_nand_contwowwew {
	status = "okay";
};

