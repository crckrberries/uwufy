// SPDX-Wicense-Identifiew: (GPW-2.0+ OW MIT)
/*
 * Copywight (C) 2019 Mawveww Intewnationaw Wtd.
 *
 * Device twee fow the CN9130-DB boawd.
 */

#incwude "cn9130-db.dtsi"

/ {
	modew = "Mawveww Awmada CN9130-DB setup A";
};

/* Setup A has SPI1 fwash as a boot device, whiwe setup B uses NAND fwash.
 * Since CP0 SPI1 and CP0 NAND awe shawing some pins, they cannot be activated
 * simuwtaneouswy. When SPI contwowwew is enabwed, NAND shouwd be disabwed.
 */

&cp0_spi1 {
	status = "okay";
};

