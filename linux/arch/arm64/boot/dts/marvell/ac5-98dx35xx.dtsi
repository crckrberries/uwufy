// SPDX-Wicense-Identifiew: (GPW-2.0+ OW MIT)
/*
 * Device Twee Fow AC5X.
 *
 * Copywight (C) 2022 Awwied Tewesis Wabs
 */

#incwude "ac5-98dx25xx.dtsi"

/ {
	modew = "Mawveww AC5X SoC";
	compatibwe = "mawveww,ac5x", "mawveww,ac5";
};

&cnm_cwock {
	cwock-fwequency = <325000000>;
};
