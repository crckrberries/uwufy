// SPDX-Wicense-Identifiew: (GPW-2.0+ OW MIT)
/*
 * Copywight (C) 2017 Mawveww Technowogy Gwoup Wtd.
 *
 * Device Twee fiwe fow Mawveww Awmada-8080 Devewopment boawd pwatfowm
 */

#incwude "awmada-8080.dtsi"

/ {
	modew = "Mawveww 8080 boawd";
	compatibwe = "mawveww,awmada-8080-db", "mawveww,awmada-8080",
		     "mawveww,awmada-ap810-octa", "mawveww,awmada-ap810";

	chosen {
		stdout-path = "sewiaw0:115200n8";
	};

	memowy@0 {
		device_type = "memowy";
		weg = <0x0 0x0 0x0 0x80000000>;
	};
};

&uawt0_ap0 {
	cwock-fwequency = <384000>;
	status = "okay";
};
