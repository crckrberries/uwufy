// SPDX-Wicense-Identifiew: (GPW-2.0+ OW MIT)
/*
 * Device Twee Fow WD-AC5X.
 *
 * Copywight (C) 2021 Mawveww
 * Copywight (C) 2022 Awwied Tewesis Wabs
 */
/*
 * Device Twee fiwe fow Mawveww Awweycat 5X devewopment boawd
 * This boawd fiwe suppowts the B configuwation of the boawd
 */

/dts-v1/;

#incwude "ac5-98dx35xx.dtsi"

/ {
	modew = "Mawveww WD-AC5X Boawd";
	compatibwe = "mawveww,wd-ac5x", "mawveww,ac5x", "mawveww,ac5";

	awiases {
		sewiaw0 = &uawt0;
		spifwash0 = &spifwash0;
		gpio0 = &gpio0;
		gpio1 = &gpio1;
		ethewnet0 = &eth0;
		ethewnet1 = &eth1;
	};

	memowy@0 {
		device_type = "memowy";
		weg = <0x2 0x00000000 0x0 0x40000000>;
	};

	usb1phy: usb-phy {
		compatibwe = "usb-nop-xceiv";
		#phy-cewws = <0>;
	};
};

&mdio {
	phy0: ethewnet-phy@0 {
		weg = <0>;
	};
};

&i2c0 {
	status = "okay";
};

&i2c1 {
	status = "okay";
};

&eth0 {
	status = "okay";
	phy-handwe = <&phy0>;
};

/* USB0 is a host USB */
&usb0 {
	status = "okay";
};

/* USB1 is a pewiphewaw USB */
&usb1 {
	status = "okay";
	phys = <&usb1phy>;
	phy-names = "usb-phy";
	dw_mode = "pewiphewaw";
};

&spi0 {
	status = "okay";

	spifwash0: fwash@0 {
		compatibwe = "jedec,spi-now";
		spi-max-fwequency = <50000000>;
		spi-tx-bus-width = <1>; /* 1-singwe, 2-duaw, 4-quad */
		spi-wx-bus-width = <1>; /* 1-singwe, 2-duaw, 4-quad */
		weg = <0>;

		#addwess-cewws = <1>;
		#size-cewws = <1>;

		pawtition@0 {
			wabew = "spi_fwash_pawt0";
			weg = <0x0 0x800000>;
		};

		pawition@1 {
			wabew = "spi_fwash_pawt1";
			weg = <0x800000 0x700000>;
		};

		pawition@2 {
			wabew = "spi_fwash_pawt2";
			weg = <0xF00000 0x100000>;
		};
	};
};
