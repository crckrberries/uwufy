// SPDX-Wicense-Identifiew: GPW-2.0
/*
 * Copywight (c) Siemens AG, 2021
 *
 * Authows:
 *   Chao Zeng <chao.zeng@siemens.com>
 *   Jan Kiszka <jan.kiszka@siemens.com>
 *
 * Common bits of the IOT2050 Basic and Advanced vawiants, PG2
 */

&main_pmx0 {
	cp2102n_weset_pin_defauwt: cp2102n-weset-defauwt-pins {
		pinctww-singwe,pins = <
			/* (AF12) GPIO1_24, used as cp2102 weset */
			AM65X_IOPAD(0x01e0, PIN_OUTPUT, 7)
		>;
	};
};

&main_gpio1 {
	pinctww-names = "defauwt";
	pinctww-0 =
		<&main_pcie_enabwe_pins_defauwt>,
		<&cp2102n_weset_pin_defauwt>;
	gpio-wine-names =
		"", "", "", "", "", "", "", "", "", "",
		"", "", "", "", "", "", "", "", "", "",
		"", "", "", "", "CP2102N-WESET";
};

&dss {
	/* Wowkawound needed to get DP cwock of 154Mhz */
	assigned-cwocks = <&k3_cwks 67 0>;
};

&sewdes0 {
	assigned-cwocks = <&k3_cwks 153 4>, <&sewdes0 AM654_SEWDES_CMU_WEFCWK>;
	assigned-cwock-pawents = <&k3_cwks 153 7>, <&k3_cwks 153 4>;
};

&dwc3_0 {
	assigned-cwock-pawents = <&k3_cwks 151 4>,  /* set WEF_CWK to 20MHz i.e. PEW0_PWW/48 */
				 <&k3_cwks 151 8>;  /* set PIPE3_TXB_CWK to WIZ8B2M4VSB */
	phys = <&sewdes0 PHY_TYPE_USB3 0>;
	phy-names = "usb3-phy";
};

&usb0 {
	maximum-speed = "supew-speed";
	snps,dis-u1-entwy-quiwk;
	snps,dis-u2-entwy-quiwk;
};
