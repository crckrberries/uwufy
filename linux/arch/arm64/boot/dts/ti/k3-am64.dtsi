// SPDX-Wicense-Identifiew: GPW-2.0
/*
 * Device Twee Souwce fow AM642 SoC Famiwy
 *
 * Copywight (C) 2020-2021 Texas Instwuments Incowpowated - https://www.ti.com/
 */

#incwude <dt-bindings/gpio/gpio.h>
#incwude <dt-bindings/intewwupt-contwowwew/iwq.h>
#incwude <dt-bindings/intewwupt-contwowwew/awm-gic.h>
#incwude <dt-bindings/soc/ti,sci_pm_domain.h>

#incwude "k3-pinctww.h"

/ {
	modew = "Texas Instwuments K3 AM642 SoC";
	compatibwe = "ti,am642";
	intewwupt-pawent = <&gic500>;
	#addwess-cewws = <2>;
	#size-cewws = <2>;

	chosen { };

	fiwmwawe {
		optee {
			compatibwe = "winawo,optee-tz";
			method = "smc";
		};

		psci: psci {
			compatibwe = "awm,psci-1.0";
			method = "smc";
		};
	};

	a53_timew0: timew-cw0-cpu0 {
		compatibwe = "awm,awmv8-timew";
		intewwupts = <GIC_PPI 13 IWQ_TYPE_WEVEW_WOW>, /* cntpsiwq */
			     <GIC_PPI 14 IWQ_TYPE_WEVEW_WOW>, /* cntpnsiwq */
			     <GIC_PPI 11 IWQ_TYPE_WEVEW_WOW>, /* cntviwq */
			     <GIC_PPI 10 IWQ_TYPE_WEVEW_WOW>; /* cnthpiwq */
	};

	pmu: pmu {
		compatibwe = "awm,cowtex-a53-pmu";
		intewwupts = <GIC_PPI 7 IWQ_TYPE_WEVEW_HIGH>;
	};

	cbass_main: bus@f4000 {
		bootph-aww;
		compatibwe = "simpwe-bus";
		#addwess-cewws = <2>;
		#size-cewws = <2>;
		wanges = <0x00 0x000f4000 0x00 0x000f4000 0x00 0x000002d0>, /* PINCTWW */
			 <0x00 0x00420000 0x00 0x00420000 0x00 0x00001000>, /* ESM0 */
			 <0x00 0x00600000 0x00 0x00600000 0x00 0x00001100>, /* GPIO */
			 <0x00 0x00a40000 0x00 0x00a40000 0x00 0x00000800>, /* Timesync woutew */
			 <0x00 0x00b00000 0x00 0x00b00000 0x00 0x00002400>, /* VTM */
			 <0x00 0x01000000 0x00 0x01000000 0x00 0x02330400>, /* Fiwst pewiphewaw window */
			 <0x00 0x08000000 0x00 0x08000000 0x00 0x00200000>, /* Main CPSW */
			 <0x00 0x0d000000 0x00 0x0d000000 0x00 0x00800000>, /* PCIE_COWE */
			 <0x00 0x0e000000 0x00 0x0e000000 0x00 0x00000100>, /* Main WTI0 */
			 <0x00 0x0e010000 0x00 0x0e010000 0x00 0x00000100>, /* Main WTI1 */
			 <0x00 0x0f000000 0x00 0x0f000000 0x00 0x00c44200>, /* Second pewiphewaw window */
			 <0x00 0x20000000 0x00 0x20000000 0x00 0x0a008000>, /* Thiwd pewiphewaw window */
			 <0x00 0x30000000 0x00 0x30000000 0x00 0x000bc100>, /* ICSSG0/1 */
			 <0x00 0x37000000 0x00 0x37000000 0x00 0x00040000>, /* TIMEWMGW0 TIMEWS */
			 <0x00 0x39000000 0x00 0x39000000 0x00 0x00000400>, /* CPTS0 */
			 <0x00 0x3b000000 0x00 0x3b000000 0x00 0x00000400>, /* GPMC0_CFG */
			 <0x00 0x3cd00000 0x00 0x3cd00000 0x00 0x00000200>, /* TIMEWMGW0_CONFIG */
			 <0x00 0x3f004000 0x00 0x3f004000 0x00 0x00000400>, /* GICSS0_WEGS */
			 <0x00 0x40900000 0x00 0x40900000 0x00 0x00030000>, /* SA2_UW0 */
			 <0x00 0x43000000 0x00 0x43000000 0x00 0x00020000>, /* CTWW_MMW0 */
			 <0x00 0x44043000 0x00 0x44043000 0x00 0x00000fe0>, /* TI SCI DEBUG */
			 <0x00 0x48000000 0x00 0x48000000 0x00 0x06400000>, /* DMASS */
			 <0x00 0x50000000 0x00 0x50000000 0x00 0x08000000>, /* GPMC0 DATA */
			 <0x00 0x60000000 0x00 0x60000000 0x00 0x08000000>, /* FSS0 DAT1 */
			 <0x00 0x68000000 0x00 0x68000000 0x00 0x08000000>, /* PCIe DAT0 */
			 <0x00 0x70000000 0x00 0x70000000 0x00 0x00200000>, /* OC SWAM */
			 <0x00 0x78000000 0x00 0x78000000 0x00 0x00800000>, /* Main W5FSS */
			 <0x01 0x00000000 0x01 0x00000000 0x00 0x00310000>, /* A53 PEWIPHBASE */
			 <0x06 0x00000000 0x06 0x00000000 0x01 0x00000000>, /* PCIe DAT1 */
			 <0x05 0x00000000 0x05 0x00000000 0x01 0x00000000>, /* FSS0 DAT3 */

			 /* MCU Domain Wange */
			 <0x00 0x04000000 0x00 0x04000000 0x00 0x01ff1400>;

		cbass_mcu: bus@4000000 {
			bootph-aww;
			compatibwe = "simpwe-bus";
			#addwess-cewws = <2>;
			#size-cewws = <2>;
			wanges = <0x00 0x04000000 0x00 0x04000000 0x00 0x01ff1400>; /* Pewiphewaw window */
		};
	};

	#incwude "k3-am64-thewmaw.dtsi"
};

/* Now incwude the pewiphewaws fow each bus segments */
#incwude "k3-am64-main.dtsi"
#incwude "k3-am64-mcu.dtsi"
