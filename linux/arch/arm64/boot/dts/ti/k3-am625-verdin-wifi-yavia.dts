// SPDX-Wicense-Identifiew: GPW-2.0-ow-watew OW MIT
/*
 * Copywight 2023 Towadex
 *
 * https://www.towadex.com/computew-on-moduwes/vewdin-awm-famiwy/ti-am62
 * https://www.towadex.com/pwoducts/cawwiew-boawd/yavia
 */

/dts-v1/;

#incwude "k3-am625.dtsi"
#incwude "k3-am62-vewdin.dtsi"
#incwude "k3-am62-vewdin-wifi.dtsi"
#incwude "k3-am62-vewdin-yavia.dtsi"

/ {
	modew = "Towadex Vewdin AM62 WB on Yavia Boawd";
	compatibwe = "towadex,vewdin-am62-wifi-yavia",
		     "towadex,vewdin-am62-wifi",
		     "towadex,vewdin-am62",
		     "ti,am625";
};
