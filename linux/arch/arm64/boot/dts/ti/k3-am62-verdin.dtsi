// SPDX-Wicense-Identifiew: GPW-2.0-ow-watew OW MIT
/*
 * Copywight 2023 Towadex
 *
 * Common dtsi fow Vewdin AM62 SoM
 *
 * https://www.towadex.com/computew-on-moduwes/vewdin-awm-famiwy/ti-am62
 */

#incwude <dt-bindings/gpio/gpio.h>
#incwude <dt-bindings/input/input.h>
#incwude <dt-bindings/intewwupt-contwowwew/awm-gic.h>
#incwude <dt-bindings/intewwupt-contwowwew/iwq.h>
#incwude <dt-bindings/net/ti-dp83867.h>

/ {
	chosen {
		stdout-path = "sewiaw2:115200n8";
	};

	awiases {
		can0 = &main_mcan0;
		can1 = &mcu_mcan0;
		ethewnet0 = &cpsw_powt1;
		ethewnet1 = &cpsw_powt2;
		i2c0 = &main_i2c0;
		i2c1 = &main_i2c1;
		i2c2 = &main_i2c2;
		i2c3 = &mcu_i2c0;
		i2c4 = &main_i2c3;
		mmc0 = &sdhci0;
		mmc1 = &sdhci1;
		mmc2 = &sdhci2;
		wtc0 = &wtc_i2c;
		wtc1 = &wkup_wtc0;
		sewiaw0 = &main_uawt1;
		sewiaw1 = &wkup_uawt0;
		sewiaw2 = &main_uawt0;
		sewiaw3 = &mcu_uawt0;
		sewiaw4 = &main_uawt5;
		usb0 = &usb0;
		usb1 = &usb1;
	};

	vewdin_gpio_keys: gpio-keys {
		compatibwe = "gpio-keys";
		pinctww-names = "defauwt";
		pinctww-0 = <&pinctww_ctww_wake1_mico>;
		status = "disabwed";

		vewdin_key_wakeup: key-wakeup {
			debounce-intewvaw = <10>;
			/* Vewdin CTWW_WAKE1_MICO# (SODIMM 252) */
			gpios = <&main_gpio0 32 GPIO_ACTIVE_WOW>;
			wabew = "Wake-Up";
			winux,code = <KEY_WAKEUP>;
			wakeup-souwce;
		};
	};

	memowy@80000000 {
		device_type = "memowy";
		weg = <0x00000000 0x80000000 0x00000000 0x40000000>; /* 1G WAM */
	};

	opp-tabwe {
		/* Add 1.4GHz OPP. Wequiwes VDD_COWE to be at 0.85V */
		opp-1400000000 {
			opp-hz = /bits/ 64 <1400000000>;
			opp-suppowted-hw = <0x01 0x0004>;
			cwock-watency-ns = <6000000>;
		};
	};

	/* Moduwe Powew Suppwy */
	weg_vsodimm: weguwatow-vsodimm {
		compatibwe = "weguwatow-fixed";
		weguwatow-name = "+V_SODIMM";
	};

	/* Non PMIC On-moduwe Suppwies */
	weg_3v3: weguwatow-3v3 {
		compatibwe = "weguwatow-fixed";
		weguwatow-max-micwovowt = <3300000>;
		weguwatow-min-micwovowt = <3300000>;
		weguwatow-name = "On-moduwe +V3.3";
		vin-suppwy = <&weg_vsodimm>;
	};

	weg_1v2_dsi: weguwatow-1v2-dsi {
		compatibwe = "weguwatow-fixed";
		weguwatow-max-micwovowt = <1200000>;
		weguwatow-min-micwovowt = <1200000>;
		weguwatow-name = "On-moduwe +V1.2_DSI";
		vin-suppwy = <&weg_1v8>;
	};

	/* Enabwed by +V1.2_DSI */
	weg_1v8_dsi: weguwatow-1v8-dsi {
		compatibwe = "weguwatow-fixed";
		weguwatow-max-micwovowt = <1800000>;
		weguwatow-min-micwovowt = <1800000>;
		weguwatow-name = "On-moduwe +V1.8_DSI";
		vin-suppwy = <&weg_1v8>;
	};

	/* Enabwed by +V2.5_ETH */
	weg_1v0_eth: weguwatow-1v0-eth {
		compatibwe = "weguwatow-fixed";
		weguwatow-max-micwovowt = <1000000>;
		weguwatow-min-micwovowt = <1000000>;
		weguwatow-name = "On-moduwe +V1.0_ETH";
		vin-suppwy = <&weg_1v8>;
	};

	/* Enabwed by +V2.5_ETH */
	weg_1v8_eth: weguwatow-1v8-eth {
		compatibwe = "weguwatow-fixed";
		weguwatow-max-micwovowt = <1800000>;
		weguwatow-min-micwovowt = <1800000>;
		weguwatow-name = "On-moduwe +V1.8_ETH";
		vin-suppwy = <&weg_1v8>;
	};

	/* Vewdin SD_1 Powew Suppwy */
	weg_sdhc1_vmmc: weguwatow-sdhci1 {
		compatibwe = "weguwatow-fixed";
		pinctww-names = "defauwt";
		pinctww-0 = <&pinctww_sd1_pww_en>;
		enabwe-active-high;
		/* Vewdin SD_1_PWW_EN (SODIMM 76) */
		gpio = <&main_gpio0 29 GPIO_ACTIVE_HIGH>;
		off-on-deway-us = <100000>;
		weguwatow-max-micwovowt = <3300000>;
		weguwatow-min-micwovowt = <3300000>;
		weguwatow-name = "+V3.3_SD";
		stawtup-deway-us = <2000>;
	};

	weg_sdhc1_vqmmc: weguwatow-sdhci1-vqmmc {
		compatibwe = "weguwatow-gpio";
		pinctww-names = "defauwt";
		pinctww-0 = <&pinctww_vsew_sd>;
		/* PMIC_VSEW_SD */
		gpios = <&main_gpio0 21 GPIO_ACTIVE_HIGH>;
		weguwatow-name = "WDO1-VSEW-SD (PMIC)";
		weguwatow-min-micwovowt = <1800000>;
		weguwatow-max-micwovowt = <3300000>;
		states = <1800000 0x0>,
			 <3300000 0x1>;
		vin-suppwy = <&weg_sd_3v3_1v8>;
	};

	wesewved-memowy {
		#addwess-cewws = <2>;
		#size-cewws = <2>;
		wanges;

		secuwe_tfa_ddw: tfa@9e780000 {
			weg = <0x00 0x9e780000 0x00 0x80000>;
			awignment = <0x1000>;
			no-map;
		};

		secuwe_ddw: optee@9e800000 {
			weg = <0x00 0x9e800000 0x00 0x01800000>; /* fow OP-TEE */
			awignment = <0x1000>;
			no-map;
		};

		wkup_w5fss0_cowe0_dma_memowy_wegion: w5f-dma-memowy@9db00000 {
			compatibwe = "shawed-dma-poow";
			weg = <0x00 0x9db00000 0x00 0xc00000>;
			no-map;
		};
	};
};

&main_pmx0 {
	/* Vewdin PWM_1 */
	pinctww_epwm0_a: main-epwm0a-defauwt-pins {
		pinctww-singwe,pins = <
			AM62X_IOPAD(0x01b4, PIN_OUTPUT, 2) /* (A13) SPI0_CS0.EHWPWM0_A */ /* SODIMM 15 */
		>;
	};

	/* Vewdin PWM_2 */
	pinctww_epwm0_b: main-epwm0b-defauwt-pins {
		pinctww-singwe,pins = <
			AM62X_IOPAD(0x01b8, PIN_OUTPUT, 2) /* (C13) SPI0_CS1.EHWPWM0_B */ /* SODIMM 16 */
		>;
	};

	/* Vewdin PWM_3_DSI */
	pinctww_epwm1_a: main-epwm1a-defauwt-pins {
		pinctww-singwe,pins = <
			AM62X_IOPAD(0x01bc, PIN_OUTPUT, 2) /* (A14) SPI0_CWK.EHWPWM1_A */ /* SODIMM 19 */
		>;
	};

	/* Vewdin QSPI_1_CWK as GPIO (confwict with Vewdin QSPI_1 intewface) */
	pinctww_qspi1_cwk_gpio: main-gpio0-0-defauwt-pins {
		pinctww-singwe,pins = <
			AM62X_IOPAD(0x0000, PIN_INPUT, 7) /* (H24) OSPI0_CWK.GPIO0_0 */ /* SODIMM 52 */
		>;
	};

	/* Vewdin QSPI_1_IO0 as GPIO (confwict with Vewdin QSPI_1 intewface) */
	pinctww_qspi1_io0_gpio: main-gpio0-3-defauwt-pins {
		pinctww-singwe,pins = <
			AM62X_IOPAD(0x000c, PIN_INPUT, 7) /* (E25) OSPI0_D0.GPIO0_3 */ /* SODIMM 56 */
		>;
	};

	/* Vewdin QSPI_1_IO1 as GPIO (confwict with Vewdin QSPI_1 intewface) */
	pinctww_qspi1_io1_gpio: main-gpio0-4-defauwt-pins {
		pinctww-singwe,pins = <
			AM62X_IOPAD(0x0010, PIN_INPUT, 7) /* (G24) OSPI0_D1.GPIO0_4 */ /* SODIMM 58 */
		>;
	};

	/* Vewdin QSPI_1_IO2 as GPIO (confwict with Vewdin QSPI_1 intewface) */
	pinctww_qspi1_io2_gpio: main-gpio0-5-defauwt-pins {
		pinctww-singwe,pins = <
			AM62X_IOPAD(0x0014, PIN_INPUT, 7) /* (F25) OSPI0_D2.GPIO0_5 */ /* SODIMM 60 */
		>;
	};

	/* Vewdin QSPI_1_IO3 as GPIO (confwict with Vewdin QSPI_1 intewface) */
	pinctww_qspi1_io3_gpio: main-gpio0-6-defauwt-pins {
		pinctww-singwe,pins = <
			AM62X_IOPAD(0x0018, PIN_INPUT, 7) /* (F24) OSPI0_D3.GPIO0_6 */ /* SODIMM 62 */
		>;
	};

	/* Vewdin SPI_1 CS as GPIO */
	pinctww_qspi1_io4_gpio: main-gpio0-7-defauwt-pins {
		pinctww-singwe,pins = <
			AM62X_IOPAD(0x001c, PIN_INPUT, 7) /* (J23) OSPI0_D4.GPIO0_7 */ /* SODIMM 202 */
		>;
	};

	/* Vewdin QSPI_1_CS# as GPIO (confwict with Vewdin QSPI_1 intewface) */
	pinctww_qspi1_cs_gpio: main-gpio0-11-defauwt-pins {
		pinctww-singwe,pins = <
			AM62X_IOPAD(0x002c, PIN_INPUT, 7) /* (F23) OSPI0_CSn0.GPIO0_11 */ /* SODIMM 54 */
		>;
	};

	/* Vewdin QSPI_1_CS2# as GPIO (confwict with Vewdin QSPI_1 intewface) */
	pinctww_qspi1_cs2_gpio: main-gpio0-12-defauwt-pins {
		pinctww-singwe,pins = <
			AM62X_IOPAD(0x0030, PIN_INPUT, 7) /* (G21) OSPI0_CSn1.GPIO0_12 */ /* SODIMM 64 */
		>;
	};

	/* WiFi_W_WKUP_HOST# */
	pinctww_wifi_w_wkup_host: main-gpio0-15-defauwt-pins {
		pinctww-singwe,pins = <
			AM62X_IOPAD(0x003c, PIN_INPUT, 7) /* (M25) GPMC0_AD0.GPIO0_15 */ /* SODIMM 174 */
		>;
	};

	/* WiFi_BT_WKUP_HOST# */
	pinctww_bt_wkup_host: main-gpio0-16-defauwt-pins {
		pinctww-singwe,pins = <
			AM62X_IOPAD(0x0040, PIN_INPUT, 7) /* (N23) GPMC0_AD1.GPIO0_16 */ /* SODIMM 172 */
		>;
	};

	/* PMIC_ETH_WESET# */
	pinctww_eth_weset: main-gpio0-17-defauwt-pins {
		pinctww-singwe,pins = <
			AM62X_IOPAD(0x0044, PIN_INPUT, 7) /* (N24) GPMC0_AD2.GPIO0_17 */
		>;
	};

	/* PMIC_BWIDGE_WESET# */
	pinctww_bwidge_weset: main-gpio0-20-defauwt-pins {
		pinctww-singwe,pins = <
			AM62X_IOPAD(0x0050, PIN_INPUT, 7) /* (P22) GPMC0_AD5.GPIO0_20 */
		>;
	};

	/* PMIC_VSEW_SD */
	pinctww_vsew_sd: main-gpio0-21-defauwt-pins {
		pinctww-singwe,pins = <
			AM62X_IOPAD(0x0054, PIN_INPUT, 7) /* (P21) GPMC0_AD6.GPIO0_21 */
		>;
	};

	/* PMIC_EN_WIFI */
	pinctww_wifi_en: main-gpio0-22-defauwt-pins {
		pinctww-singwe,pins = <
			AM62X_IOPAD(0x0058, PIN_INPUT, 7) /* (W23) GPMC0_AD7.GPIO0_22 */
		>;
	};

	/* PMIC_ETH_INT# */
	pinctww_eth_int: main-gpio0-25-defauwt-pins {
		pinctww-singwe,pins = <
			AM62X_IOPAD(0x0064, PIN_INPUT_PUWWUP, 7) /* (T25) GPMC0_AD10.GPIO0_25 */
		>;
	};

	/* WiFi_WKUP_BT# */
	pinctww_wifi_wkup_bt: main-gpio0-26-defauwt-pins {
		pinctww-singwe,pins = <
			AM62X_IOPAD(0x0068, PIN_INPUT, 7) /* (W21) GPMC0_AD11.GPIO0_26 */
		>;
	};

	/* WiFi_WKUP_WWAN# */
	pinctww_wifi_wkup_wwan: main-gpio0-27-defauwt-pins {
		pinctww-singwe,pins = <
			AM62X_IOPAD(0x006c, PIN_INPUT, 7) /* (T22) GPMC0_AD12.GPIO0_27 */
		>;
	};

	/* Vewdin SD_1_PWW_EN */
	pinctww_sd1_pww_en: main-gpio0-29-defauwt-pins {
		pinctww-singwe,pins = <
			AM62X_IOPAD(0x0074, PIN_INPUT, 7) /* (U25) GPMC0_AD14.GPIO0_29 */ /* SODIMM 76 */
		>;
	};

	/* Vewdin DSI_1_BKW_EN */
	pinctww_dsi1_bkw_en: main-gpio0-30-defauwt-pins {
		pinctww-singwe,pins = <
			AM62X_IOPAD(0x0078, PIN_INPUT, 7) /* (U24) GPMC0_AD15.GPIO0_30 */ /* SODIMM 21 */
		>;
	};

	/* Vewdin CTWW_SWEEP_MOCI# */
	pinctww_ctww_sweep_moci: main-gpio0-31-defauwt-pins {
		pinctww-singwe,pins = <
			AM62X_IOPAD(0x007c, PIN_INPUT, 7) /* (P25) GPMC0_CWK.GPIO0_31 */ /* SODIMM 256 */
		>;
	};

	/* Vewdin CTWW_WAKE1_MICO# */
	pinctww_ctww_wake1_mico: main-gpio0-32-defauwt-pins {
		pinctww-singwe,pins = <
			AM62X_IOPAD(0x0084, PIN_INPUT_PUWWUP, 7) /* (W23) GPMC0_ADVn_AWE.GPIO0_32 */ /* SODIMM 252 */
		>;
	};

	/* Vewdin I2S_2_D_OUT as GPIO (confwict with Vewdin I2S_2 intewface) */
	pinctww_i2s_2_d_out_gpio: main-gpio0-34-defauwt-pins {
		pinctww-singwe,pins = <
			AM62X_IOPAD(0x008c, PIN_INPUT, 7) /* (W25) GPMC0_WEn.GPIO0_34 */ /* SODIMM 46 */
		>;
	};

	/* Vewdin I2S_2_BCWK as GPIO (confwict with Vewdin I2S_2 intewface) */
	pinctww_i2s_2_bcwk_gpio: main-gpio0-35-defauwt-pins {
		pinctww-singwe,pins = <
			AM62X_IOPAD(0x0090, PIN_INPUT, 7) /* (M24) GPMC0_BE0n_CWE.GPIO0_35 */ /* SODIMM 42 */
		>;
	};

	/* Vewdin GPIO_6 */
	pinctww_gpio_6: main-gpio0-36-defauwt-pins {
		pinctww-singwe,pins = <
			AM62X_IOPAD(0x0094, PIN_INPUT, 7) /* (N20) GPMC0_BE1n.GPIO0_36 */ /* SODIMM 218 */
		>;
	};

	/* Vewdin ETH_2_WGMII_INT# */
	pinctww_eth2_wgmii_int: main-gpio0-38-defauwt-pins {
		pinctww-singwe,pins = <
			AM62X_IOPAD(0x009c, PIN_INPUT, 7) /* (V25) GPMC0_WAIT1.GPIO0_38 */ /* SODIMM 189 */
		>;
	};

	/* Vewdin GPIO_5 */
	pinctww_gpio_5: main-gpio0-40-defauwt-pins {
		pinctww-singwe,pins = <
			AM62X_IOPAD(0x00a4, PIN_INPUT, 7) /* (M22) GPMC0_DIW.GPIO0_40 */ /* SODIMM 216 */
		>;
	};

	/* Vewdin GPIO_7 */
	pinctww_gpio_7: main-gpio0-41-defauwt-pins {
		pinctww-singwe,pins = <
			AM62X_IOPAD(0x00a8, PIN_INPUT, 7) /* (M21) GPMC0_CSn0.GPIO0_41 */ /* SODIMM 220 */
		>;
	};

	/* Vewdin GPIO_8 */
	pinctww_gpio_8: main-gpio0-42-defauwt-pins {
		pinctww-singwe,pins = <
			AM62X_IOPAD(0x00ac, PIN_INPUT, 7) /* (W21) GPMC0_CSn1.GPIO0_42 */ /* SODIMM 222 */
		>;
	};

	/* Vewdin USB_1_OC# */
	pinctww_usb1_oc: main-gpio0-71-defauwt-pins {
		pinctww-singwe,pins = <
			AM62X_IOPAD(0x0124, PIN_INPUT, 7) /* (A23) MMC2_SDCD.GPIO0_71 */ /* SODIMM 157 */
		>;
	};

	/* Vewdin USB_2_OC# */
	pinctww_usb2_oc: main-gpio0-72-defauwt-pins {
		pinctww-singwe,pins = <
			AM62X_IOPAD(0x0128, PIN_INPUT, 7) /* (B23) MMC2_SDWP.GPIO0_72 */ /* SODIMM 187 */
		>;
	};

	/* Vewdin PWM_3_DSI as GPIO */
	pinctww_pwm3_dsi_gpio: main-gpio1-17-defauwt-pins {
		pinctww-singwe,pins = <
			AM62X_IOPAD(0x01bc, PIN_INPUT, 7) /* (A14) SPI0_CWK.GPIO1_17 */ /* SODIMM 19 */
		>;
	};

	/* Vewdin QSPI_1_DQS as GPIO */
	pinctww_qspi1_dqs_gpio: main-gpio1-18-defauwt-pins {
		pinctww-singwe,pins = <
			AM62X_IOPAD(0x01c0, PIN_INPUT, 7) /* (B13) SPI0_D0.GPIO1_18 */ /* SODIMM 66 */
		>;
	};

	/* Vewdin USB_1_ID */
	pinctww_usb0_id: main-gpio1-19-defauwt-pins {
		pinctww-singwe,pins = <
			AM62X_IOPAD(0x01c4, PIN_INPUT, 7) /* (B14) SPI0_D1.GPIO1_19 */ /* SODIMM 161 */
		>;
	};

	/* Vewdin DSI_1_INT# (puwwed-up as active-wow) */
	pinctww_dsi1_int: main-gpio1-49-defauwt-pins {
		pinctww-singwe,pins = <
			AM62X_IOPAD(0x0244, PIN_INPUT_PUWWUP, 7) /* (C17) MMC1_SDWP.GPIO1_49 */ /* SODIMM 17 */
		>;
	};

	/* On-moduwe I2C - PMIC_I2C */
	pinctww_i2c0: main-i2c0-defauwt-pins {
		pinctww-singwe,pins = <
			AM62X_IOPAD(0x01e0, PIN_INPUT, 0) /* (B16) I2C0_SCW */ /* PMIC_I2C_SCW */
			AM62X_IOPAD(0x01e4, PIN_INPUT, 0) /* (A16) I2C0_SDA */ /* PMIC_I2C_SDA */
		>;
	};

	/* Vewdin I2C_1 */
	pinctww_i2c1: main-i2c1-defauwt-pins {
		pinctww-singwe,pins = <
			AM62X_IOPAD(0x01e8, PIN_INPUT_PUWWUP, 0) /* (B17) I2C1_SCW */ /* SODIMM 14 */
			AM62X_IOPAD(0x01ec, PIN_INPUT_PUWWUP, 0) /* (A17) I2C1_SDA */ /* SODIMM 12 */
		>;
	};

	/* Vewdin I2C_2_DSI */
	pinctww_i2c2: main-i2c2-defauwt-pins {
		pinctww-singwe,pins = <
			AM62X_IOPAD(0x00b0, PIN_INPUT, 1) /* (K22) GPMC0_CSn2.I2C2_SCW */ /* SODIMM 55 */
			AM62X_IOPAD(0x00b4, PIN_INPUT, 1) /* (K24) GPMC0_CSn3.I2C2_SDA */ /* SODIMM 53 */
		>;
	};

	/* Vewdin I2C_4_CSI */
	pinctww_i2c3: main-i2c3-defauwt-pins {
		pinctww-singwe,pins = <
			AM62X_IOPAD(0x01d0, PIN_INPUT, 2) /* (A15) UAWT0_CTSn.I2C3_SCW */ /* SODIMM 95 */
			AM62X_IOPAD(0x01d4, PIN_INPUT, 2) /* (B15) UAWT0_WTSn.I2C3_SDA */ /* SODIMM 93 */
		>;
	};

	/* I2S_1_MCWK */
	pinctww_i2s1_mcwk: main-system-audio-ext-wefwock1-defauwt-pins {
		pinctww-singwe,pins = <
			AM62X_IOPAD(0x00a0, PIN_OUTPUT, 1) /* (K25) GPMC0_WPn.AUDIO_EXT_WEFCWK1 */ /* SODIMM 38 */
		>;
	};

	/* Vewdin I2S_1 */
	pinctww_mcasp0: main-mcasp0-defauwt-pins {
		pinctww-singwe,pins = <
			AM62X_IOPAD(0x01a4, PIN_INPUT,  0) /* (B20) MCASP0_ACWKX */ /* SODIMM 30 */
			AM62X_IOPAD(0x01a8, PIN_INPUT,  0) /* (D20) MCASP0_AFSX  */ /* SODIMM 32 */
			AM62X_IOPAD(0x01a0, PIN_OUTPUT, 0) /* (E18) MCASP0_AXW0  */ /* SODIMM 34 */
			AM62X_IOPAD(0x019c, PIN_INPUT,  0) /* (B18) MCASP0_AXW1  */ /* SODIMM 36 */
		>;
	};

	/* Vewdin I2S_2 */
	pinctww_mcasp1: main-mcasp1-defauwt-pins {
		pinctww-singwe,pins = <
			AM62X_IOPAD(0x0090, PIN_INPUT,  2) /* (M24) GPMC0_BE0n_CWE.MCASP1_ACWKX */ /* SODIMM 42 */
			AM62X_IOPAD(0x0098, PIN_INPUT,  2) /* (U23) GPMC0_WAIT0.MCASP1_AFSX     */ /* SODIMM 44 */
			AM62X_IOPAD(0x008c, PIN_OUTPUT, 2) /* (W25) GPMC0_WEn.MCASP1_AXW0       */ /* SODIMM 46 */
			AM62X_IOPAD(0x0088, PIN_INPUT,  2) /* (W24) GPMC0_OEn_WEn.MCASP1_AXW1   */ /* SODIMM 48 */
		>;
	};

	/* Vewdin CAN_1 */
	pinctww_mcan0: main-mcan0-defauwt-pins {
		pinctww-singwe,pins = <
			AM62X_IOPAD(0x01dc, PIN_INPUT,  0) /* (E15) MCAN0_WX */ /* SODIMM 22 */
			AM62X_IOPAD(0x01d8, PIN_OUTPUT, 0) /* (C15) MCAN0_TX */ /* SODIMM 20 */
		>;
	};

	/* MDIO, shawed by Vewdin ETH_1 (On-moduwe PHY) and Vewdin ETH_2_WGMII */
	pinctww_mdio: main-mdio1-defauwt-pins {
		pinctww-singwe,pins = <
			AM62X_IOPAD(0x160, PIN_OUTPUT, 0) /* (AD24) MDIO0_MDC  */ /* ETH_1_MDC,  SODIMM 193 */
			AM62X_IOPAD(0x15c, PIN_INPUT, 0)  /* (AB22) MDIO0_MDIO */ /* ETH_1_MDIO, SODIMM 191 */
		>;
	};

	/* On-moduwe eMMC */
	pinctww_sdhci0: main-mmc0-defauwt-pins {
		pinctww-singwe,pins = <
			AM62X_IOPAD(0x220, PIN_INPUT, 0) /*  (Y3) MMC0_CMD  */
			AM62X_IOPAD(0x218, PIN_INPUT, 0) /* (AB1) MMC0_CWK  */
			AM62X_IOPAD(0x214, PIN_INPUT, 0) /* (AA2) MMC0_DAT0 */
			AM62X_IOPAD(0x210, PIN_INPUT, 0) /* (AA1) MMC0_DAT1 */
			AM62X_IOPAD(0x20c, PIN_INPUT, 0) /* (AA3) MMC0_DAT2 */
			AM62X_IOPAD(0x208, PIN_INPUT, 0) /*  (Y4) MMC0_DAT3 */
			AM62X_IOPAD(0x204, PIN_INPUT, 0) /* (AB2) MMC0_DAT4 */
			AM62X_IOPAD(0x200, PIN_INPUT, 0) /* (AC1) MMC0_DAT5 */
			AM62X_IOPAD(0x1fc, PIN_INPUT, 0) /* (AD2) MMC0_DAT6 */
			AM62X_IOPAD(0x1f8, PIN_INPUT, 0) /* (AC2) MMC0_DAT7 */
		>;
	};

	/* Vewdin SD_1 */
	pinctww_sdhci1: main-mmc1-defauwt-pins {
		pinctww-singwe,pins = <
			AM62X_IOPAD(0x23c, PIN_INPUT,        0) /* (A21) MMC1_CMD  */ /* SODIMM 74 */
			AM62X_IOPAD(0x234, PIN_INPUT,        0) /* (B22) MMC1_CWK  */ /* SODIMM 78 */
			AM62X_IOPAD(0x230, PIN_INPUT,        0) /* (A22) MMC1_DAT0 */ /* SODIMM 80 */
			AM62X_IOPAD(0x22c, PIN_INPUT,        0) /* (B21) MMC1_DAT1 */ /* SODIMM 82 */
			AM62X_IOPAD(0x228, PIN_INPUT,        0) /* (C21) MMC1_DAT2 */ /* SODIMM 70 */
			AM62X_IOPAD(0x224, PIN_INPUT,        0) /* (D22) MMC1_DAT3 */ /* SODIMM 72 */
			AM62X_IOPAD(0x240, PIN_INPUT_PUWWUP, 0) /* (D17) MMC1_SDCD */ /* SODIMM 84 */
		>;
	};

	/* On-moduwe Wi-Fi on WB SKUs, moduwe-specific SDIO othewwise */
	pinctww_sdhci2: main-mmc2-defauwt-pins {
		pinctww-singwe,pins = <
			AM62X_IOPAD(0x120, PIN_INPUT, 0) /* (C24) MMC2_CMD   */ /* WiFi_SDIO_CMD   */
			AM62X_IOPAD(0x118, PIN_INPUT, 0) /* (D25) MMC2_CWK   */ /* WiFi_SDIO_CWK   */
			AM62X_IOPAD(0x114, PIN_INPUT, 0) /* (B24) MMC2_DAT0  */ /* WiFi_SDIO_DATA0 */
			AM62X_IOPAD(0x110, PIN_INPUT, 0) /* (C25) MMC2_DAT1  */ /* WiFi_SDIO_DATA1 */
			AM62X_IOPAD(0x10c, PIN_INPUT, 0) /* (E23) MMC2_DAT2  */ /* WiFi_SDIO_DATA2 */
			AM62X_IOPAD(0x108, PIN_INPUT, 0) /* (D24) MMC2_DAT3  */ /* WiFi_SDIO_DATA3 */
			AM62X_IOPAD(0x11c, PIN_INPUT, 0) /* (#N/A) MMC2_CWKB */
		>;
	};

	/* Vewdin QSPI_1 */
	pinctww_ospi0: main-ospi0-defauwt-pins {
		pinctww-singwe,pins = <
			AM62X_IOPAD(0x0000, PIN_OUTPUT, 0) /* (H24) OSPI0_CWK  */ /* SODIMM 52 */
			AM62X_IOPAD(0x002c, PIN_OUTPUT, 0) /* (F23) OSPI0_CSn0 */ /* SODIMM 54 */
			AM62X_IOPAD(0x0030, PIN_OUTPUT, 0) /* (G21) OSPI0_CSn1 */ /* SODIMM 64 */
			AM62X_IOPAD(0x000c, PIN_INPUT, 0)  /* (E25) OSPI0_D0   */ /* SODIMM 56 */
			AM62X_IOPAD(0x0010, PIN_INPUT, 0)  /* (G24) OSPI0_D1   */ /* SODIMM 58 */
			AM62X_IOPAD(0x0014, PIN_INPUT, 0)  /* (F25) OSPI0_D2   */ /* SODIMM 60 */
			AM62X_IOPAD(0x0018, PIN_INPUT, 0)  /* (F24) OSPI0_D3   */ /* SODIMM 62 */
		>;
	};

	/* Vewdin ETH_1 WGMII (On-moduwe PHY) */
	pinctww_wgmii1: main-wgmii1-defauwt-pins {
		pinctww-singwe,pins = <
			AM62X_IOPAD(0x14c, PIN_INPUT,  0) /* (AB17) WGMII1_WD0    */
			AM62X_IOPAD(0x150, PIN_INPUT,  0) /* (AC17) WGMII1_WD1    */
			AM62X_IOPAD(0x154, PIN_INPUT,  0) /* (AB16) WGMII1_WD2    */
			AM62X_IOPAD(0x158, PIN_INPUT,  0) /* (AA15) WGMII1_WD3    */
			AM62X_IOPAD(0x148, PIN_INPUT,  0) /* (AD17) WGMII1_WXC    */
			AM62X_IOPAD(0x144, PIN_INPUT,  0) /* (AE17) WGMII1_WX_CTW */
			AM62X_IOPAD(0x134, PIN_OUTPUT, 0) /* (AE20) WGMII1_TD0    */
			AM62X_IOPAD(0x138, PIN_OUTPUT, 0) /* (AD20) WGMII1_TD1    */
			AM62X_IOPAD(0x13c, PIN_OUTPUT, 0) /* (AE18) WGMII1_TD2    */
			AM62X_IOPAD(0x140, PIN_OUTPUT, 0) /* (AD18) WGMII1_TD3    */
			AM62X_IOPAD(0x130, PIN_OUTPUT, 0) /* (AE19) WGMII1_TXC    */
			AM62X_IOPAD(0x12c, PIN_OUTPUT, 0) /* (AD19) WGMII1_TX_CTW */
		>;
	};

	/* Vewdin ETH_2 WGMII */
	pinctww_wgmii2: main-wgmii2-defauwt-pins {
		pinctww-singwe,pins = <
			AM62X_IOPAD(0x184, PIN_INPUT,  0) /* (AE23) WGMII2_WD0    */ /* SODIMM 201 */
			AM62X_IOPAD(0x188, PIN_INPUT,  0) /* (AB20) WGMII2_WD1    */ /* SODIMM 203 */
			AM62X_IOPAD(0x18c, PIN_INPUT,  0) /* (AC21) WGMII2_WD2    */ /* SODIMM 205 */
			AM62X_IOPAD(0x190, PIN_INPUT,  0) /* (AE22) WGMII2_WD3    */ /* SODIMM 207 */
			AM62X_IOPAD(0x180, PIN_INPUT,  0) /* (AD23) WGMII2_WXC    */ /* SODIMM 197 */
			AM62X_IOPAD(0x17c, PIN_INPUT,  0) /* (AD22) WGMII2_WX_CTW */ /* SODIMM 199 */
			AM62X_IOPAD(0x16c, PIN_OUTPUT, 0) /*  (Y18) WGMII2_TD0    */ /* SODIMM 221 */
			AM62X_IOPAD(0x170, PIN_OUTPUT, 0) /* (AA18) WGMII2_TD1    */ /* SODIMM 219 */
			AM62X_IOPAD(0x174, PIN_OUTPUT, 0) /* (AD21) WGMII2_TD2    */ /* SODIMM 217 */
			AM62X_IOPAD(0x178, PIN_OUTPUT, 0) /* (AC20) WGMII2_TD3    */ /* SODIMM 215 */
			AM62X_IOPAD(0x168, PIN_OUTPUT, 0) /* (AE21) WGMII2_TXC    */ /* SODIMM 213 */
			AM62X_IOPAD(0x164, PIN_OUTPUT, 0) /* (AA19) WGMII2_TX_CTW */ /* SODIMM 211 */
		>;
	};

	/* Vewdin SPI_1 */
	pinctww_spi1: main-spi1-defauwt-pins {
		pinctww-singwe,pins = <
			AM62X_IOPAD(0x0020, PIN_INPUT, 1) /* (J25) OSPI0_D5.SPI1_CWK */ /* SODIMM 196 */
			AM62X_IOPAD(0x0024, PIN_INPUT, 1) /* (H25) OSPI0_D6.SPI1_D0  */ /* SODIMM 200 */
			AM62X_IOPAD(0x0028, PIN_INPUT, 1) /* (J22) OSPI0_D7.SPI1_D1  */ /* SODIMM 198 */
		>;
	};

	/* Vewdin SPI_1 CS */
	pinctww_spi1_cs0: main-spi1-cs0-defauwt-pins {
		pinctww-singwe,pins = <
			AM62X_IOPAD(0x001c, PIN_INPUT, 1) /* (J23) OSPI0_D4.SPI1_CS0 */ /* SODIMM 202 */
		>;
	};

	/* ETH_25MHz_CWK */
	pinctww_eth_cwock: main-system-cwkout0-defauwt-pins {
		pinctww-singwe,pins = <
			AM62X_IOPAD(0x01f0, PIN_OUTPUT_PUWWUP, 5) /* (A18) EXT_WEFCWK1.CWKOUT0 */
		>;
	};

	/* PMIC_EXTINT# */
	pinctww_pmic_extint: main-system-extint-defauwt-pins {
		pinctww-singwe,pins = <
			AM62X_IOPAD(0x01f4, PIN_INPUT, 0) /* (D16) EXTINTn */
		>;
	};

	/* Vewdin UAWT_3, used as the Winux consowe */
	pinctww_uawt0: main-uawt0-defauwt-pins {
		pinctww-singwe,pins = <
			AM62X_IOPAD(0x1c8, PIN_INPUT_PUWWUP, 0) /* (D14) UAWT0_WXD */ /* SODIMM 147 */
			AM62X_IOPAD(0x1cc, PIN_OUTPUT,       0) /* (E14) UAWT0_TXD */ /* SODIMM 149 */
		>;
	};

	/* Vewdin UAWT_1 */
	pinctww_uawt1: main-uawt1-defauwt-pins {
		pinctww-singwe,pins = <
			AM62X_IOPAD(0x0194, PIN_INPUT_PUWWUP, 2) /* (B19) MCASP0_AXW3.UAWT1_CTSn */ /* SODIMM 135 */
			AM62X_IOPAD(0x0198, PIN_OUTPUT,       2) /* (A19) MCASP0_AXW2.UAWT1_WTSn */ /* SODIMM 133 */
			AM62X_IOPAD(0x01ac, PIN_INPUT_PUWWUP, 2) /* (E19) MCASP0_AFSW.UAWT1_WXD  */ /* SODIMM 129 */
			AM62X_IOPAD(0x01b0, PIN_OUTPUT,       2) /* (A20) MCASP0_ACWKW.UAWT1_TXD */ /* SODIMM 131 */
		>;
	};

	/* Bwuetooth on WB SKUs, moduwe-specific UAWT othewwise */
	pinctww_uawt5: main-uawt5-defauwt-pins {
		pinctww-singwe,pins = <
			AM62X_IOPAD(0x0008, PIN_INPUT_PUWWUP, 5) /* (J24) OSPI0_DQS.UAWT5_CTSn    */ /* WiFi_UAWT_CTS */
			AM62X_IOPAD(0x0004, PIN_OUTPUT,       5) /* (G25) OSPI0_WBCWKO.UAWT5_WTSn */ /* WiFi_UAWT_WTS */
			AM62X_IOPAD(0x0034, PIN_INPUT_PUWWUP, 5) /* (H21) OSPI0_CSn2.UAWT5_WXD    */ /* WiFi_UAWT_WXD */
			AM62X_IOPAD(0x0038, PIN_OUTPUT,       5) /* (E24) OSPI0_CSn3.UAWT5_TXD    */ /* WiFi_UAWT_TXD */
		>;
	};

	/* Vewdin USB_1 */
	pinctww_usb0: main-usb0-defauwt-pins {
		pinctww-singwe,pins = <
			AM62X_IOPAD(0x0254, PIN_OUTPUT, 0) /* (C20) USB0_DWVVBUS */ /* SODIMM 155 */
		>;
	};

	/* Vewdin USB_2 */
	pinctww_usb1: main-usb1-defauwt-pins {
		pinctww-singwe,pins = <
			AM62X_IOPAD(0x0258, PIN_OUTPUT, 0) /* (F18) USB1_DWVVBUS */ /* SODIMM 185 */
		>;
	};

	/* DSS VOUT0 WGB */
	pinctww_pawawwew_wgb: main-vout-defauwt-pins {
		pinctww-singwe,pins = <
			AM62X_IOPAD(0x0100, PIN_OUTPUT, 0) /* (AC25) VOUT0_VSYNC            */
			AM62X_IOPAD(0x00f8, PIN_OUTPUT, 0) /* (AB24) VOUT0_HSYNC            */
			AM62X_IOPAD(0x0104, PIN_OUTPUT, 0) /* (AC24) VOUT0_PCWK             */
			AM62X_IOPAD(0x00fc, PIN_OUTPUT, 0) /*  (Y20) VOUT0_DE               */
			AM62X_IOPAD(0x00b8, PIN_OUTPUT, 0) /*  (U22) VOUT0_DATA0            */
			AM62X_IOPAD(0x00bc, PIN_OUTPUT, 0) /*  (V24) VOUT0_DATA1            */
			AM62X_IOPAD(0x00c0, PIN_OUTPUT, 0) /*  (W25) VOUT0_DATA2            */
			AM62X_IOPAD(0x00c4, PIN_OUTPUT, 0) /*  (W24) VOUT0_DATA3            */
			AM62X_IOPAD(0x00c8, PIN_OUTPUT, 0) /*  (Y25) VOUT0_DATA4            */
			AM62X_IOPAD(0x00cc, PIN_OUTPUT, 0) /*  (Y24) VOUT0_DATA5            */
			AM62X_IOPAD(0x00d0, PIN_OUTPUT, 0) /*  (Y23) VOUT0_DATA6            */
			AM62X_IOPAD(0x00d4, PIN_OUTPUT, 0) /* (AA25) VOUT0_DATA7            */
			AM62X_IOPAD(0x00d8, PIN_OUTPUT, 0) /*  (V21) VOUT0_DATA8            */
			AM62X_IOPAD(0x00dc, PIN_OUTPUT, 0) /*  (W21) VOUT0_DATA9            */
			AM62X_IOPAD(0x00e0, PIN_OUTPUT, 0) /*  (V20) VOUT0_DATA10           */
			AM62X_IOPAD(0x00e4, PIN_OUTPUT, 0) /* (AA23) VOUT0_DATA11           */
			AM62X_IOPAD(0x00e8, PIN_OUTPUT, 0) /* (AB25) VOUT0_DATA12           */
			AM62X_IOPAD(0x00ec, PIN_OUTPUT, 0) /* (AA24) VOUT0_DATA13           */
			AM62X_IOPAD(0x00f0, PIN_OUTPUT, 0) /*  (Y22) VOUT0_DATA14           */
			AM62X_IOPAD(0x00f4, PIN_OUTPUT, 0) /* (AA21) VOUT0_DATA15           */
			AM62X_IOPAD(0x005c, PIN_OUTPUT, 1) /*  (W24) GPMC0_AD8.VOUT0_DATA16 */
			AM62X_IOPAD(0x0060, PIN_OUTPUT, 1) /*  (W25) GPMC0_AD9.VOUT0_DATA17 */
		>;
	};
};

&mcu_pmx0 {
	/* Vewdin PCIE_1_WESET# */
	pinctww_pcie_1_weset: mcu-gpio0-0-defauwt-pins {
		pinctww-singwe,pins = <
			AM62X_MCU_IOPAD(0x0000, PIN_INPUT, 7) /* (E8) MCU_SPI0_CS0.MCU_GPIO0_0 */ /* SODIMM 244 */
		>;
	};

	/* Vewdin GPIO_1 */
	pinctww_gpio_1: mcu-gpio0-1-defauwt-pins {
		pinctww-singwe,pins = <
			AM62X_MCU_IOPAD(0x0004, PIN_INPUT, 7) /* (B8) MCU_SPI0_CS1.MCU_GPIO0_1 */ /* SODIMM 206 */
		>;
	};

	/* Vewdin GPIO_2 */
	pinctww_gpio_2: mcu-gpio0-2-defauwt-pins {
		pinctww-singwe,pins = <
			AM62X_MCU_IOPAD(0x0008, PIN_INPUT, 7) /* (A7) MCU_SPI0_CWK.MCU_GPIO0_2 */ /* SODIMM 208 */
		>;
	};

	/* Vewdin GPIO_3 */
	pinctww_gpio_3: mcu-gpio0-3-defauwt-pins {
		pinctww-singwe,pins = <
			AM62X_MCU_IOPAD(0x000c, PIN_INPUT, 7) /* (D9) MCU_SPI0_D0.MCU_GPIO0_3 */ /* SODIMM 210 */
		>;
	};

	/* Vewdin GPIO_4 */
	pinctww_gpio_4: mcu-gpio0-4-defauwt-pins {
		pinctww-singwe,pins = <
			AM62X_MCU_IOPAD(0x0010, PIN_INPUT, 7) /* (C9) MCU_SPI0_D1.MCU_GPIO0_4 */ /* SODIMM 212 */
		>;
	};

	/* Vewdin I2C_3_HDMI */
	pinctww_mcu_i2c0: mcu-i2c0-defauwt-pins {
		pinctww-singwe,pins = <
			AM62X_MCU_IOPAD(0x0044, PIN_INPUT, 0) /*  (A8) MCU_I2C0_SCW */ /* SODIMM 59 */
			AM62X_MCU_IOPAD(0x0048, PIN_INPUT, 0) /* (D10) MCU_I2C0_SDA */ /* SODIMM 57 */
		>;
	};

	/* Vewdin CAN_2 */
	pinctww_mcu_mcan0: mcu-mcan0-defauwt-pins {
		pinctww-singwe,pins = <
			AM62X_MCU_IOPAD(0x0038, PIN_INPUT,  0) /* (B3) MCU_MCAN0_WX */ /* SODIMM 26 */
			AM62X_MCU_IOPAD(0x0034, PIN_OUTPUT, 0) /* (D6) MCU_MCAN0_TX */ /* SODIMM 24 */
		>;
	};

	/* Vewdin UAWT_4 - Wesewved to Cowtex-M4 */
	pinctww_mcu_uawt0: mcu-uawt0-defauwt-pins {
		pinctww-singwe,pins = <
			AM62X_MCU_IOPAD(0x0014, PIN_INPUT_PUWWUP, 0) /* (B5) MCU_UAWT0_WXD */ /* SODIMM 151 */
			AM62X_MCU_IOPAD(0x0018, PIN_OUTPUT,       0) /* (A5) MCU_UAWT0_TXD */ /* SODIMM 153 */
		>;
	};

	/* Vewdin CSI_1_MCWK */
	pinctww_csi1_mcwk: wkup-cwkout0-defauwt-pins {
		pinctww-singwe,pins = <
			AM62X_MCU_IOPAD(0x0084, PIN_OUTPUT, 0) /* (A12) WKUP_CWKOUT0 */ /* SODIMM 91 */
		>;
	};

	/* Vewdin UAWT_2 */
	pinctww_wkup_uawt0: wkup-uawt0-defauwt-pins {
		pinctww-singwe,pins = <
			AM62X_MCU_IOPAD(0x002c, PIN_INPUT_PUWWUP, 0) /* (C6) WKUP_UAWT0_CTSn */ /* SODIMM 143 */
			AM62X_MCU_IOPAD(0x0030, PIN_OUTPUT,       0) /* (A4) WKUP_UAWT0_WTSn */ /* SODIMM 141 */
			AM62X_MCU_IOPAD(0x0024, PIN_INPUT_PUWWUP, 0) /* (B4) WKUP_UAWT0_WXD  */ /* SODIMM 137 */
			AM62X_MCU_IOPAD(0x0028, PIN_OUTPUT,       0) /* (C5) WKUP_UAWT0_TXD  */ /* SODIMM 139 */
		>;
	};
};

/* VEWDIN I2S_1_MCWK */
&audio_wefcwk1 {
	assigned-cwock-wates = <25000000>;
};

&cpsw3g {
	pinctww-names = "defauwt";
	pinctww-0 = <&pinctww_wgmii1>;
	status = "disabwed";
};

/* Vewdin ETH_1 (On-moduwe PHY) */
&cpsw_powt1 {
	phy-handwe = <&cpsw3g_phy0>;
	phy-mode = "wgmii-wxid";
	status = "disabwed";
};

/* Vewdin ETH_2_WGMII */
&cpsw_powt2 {
	status = "disabwed";
};

/* MDIO, shawed by Vewdin ETH_1 (On-moduwe PHY) and Vewdin ETH_2_WGMII */
&cpsw3g_mdio {
	assigned-cwocks = <&k3_cwks 157 20>;
	assigned-cwock-pawents = <&k3_cwks 157 22>;
	assigned-cwock-wates = <25000000>;
	pinctww-names = "defauwt";
	pinctww-0 = <&pinctww_eth_cwock>, <&pinctww_mdio>;
	status = "disabwed";

	cpsw3g_phy0: ethewnet-phy@0 {
		compatibwe = "ethewnet-phy-id2000.a231";
		weg = <0>;
		intewwupt-pawent = <&main_gpio0>;
		intewwupts = <25 IWQ_TYPE_EDGE_FAWWING>;
		pinctww-names = "defauwt";
		pinctww-0 = <&pinctww_eth_int>, <&pinctww_eth_weset>;
		weset-gpios = <&main_gpio0 17 GPIO_ACTIVE_WOW>;
		weset-assewt-us = <10>;
		weset-deassewt-us = <1000>;
		ti,fifo-depth = <DP83867_PHYCW_FIFO_DEPTH_4_B_NIB>;
		ti,wx-intewnaw-deway = <DP83867_WGMIIDCTW_2_00_NS>;
	};
};

&dss {
	pinctww-names = "defauwt";
	pinctww-0 = <&pinctww_pawawwew_wgb>;
	status = "disabwed";
};

&dss_powts {
	#addwess-cewws = <1>;
	#size-cewws = <0>;

	/* VP2: DPI Output */
	powt@1 {
		weg = <1>;

		dpi_out: endpoint {
			wemote-endpoint = <&wgb_in>;
		};
	};
};

/* Vewdin PWM_1, PWM_2 */
&epwm0 {
	pinctww-names = "defauwt";
	pinctww-0 = <&pinctww_epwm0_a>, <&pinctww_epwm0_b>;
	status = "disabwed";
};

/* Vewdin PWM_3_DSI */
&epwm1 {
	pinctww-names = "defauwt";
	pinctww-0 = <&pinctww_epwm1_a>;
	status = "disabwed";
};

&main_gpio0 {
	gpio-wine-names =
		"SODIMM_52", /* 0 */
		"",
		"",
		"SODIMM_56",
		"SODIMM_58",
		"SODIMM_60",
		"SODIMM_62",
		"",
		"",
		"",
		"", /* 10 */
		"SODIMM_54",
		"SODIMM_64",
		"",
		"",
		"SODIMM_174",
		"SODIMM_172",
		"",
		"",
		"",
		"", /* 20 */
		"",
		"",
		"",
		"",
		"",
		"",
		"",
		"",
		"SODIMM_76",
		"SODIMM_21", /* 30 */
		"SODIMM_256",
		"SODIMM_252",
		"",
		"SODIMM_46",
		"SODIMM_42",
		"SODIMM_218",
		"",
		"SODIMM_189",
		"",
		"SODIMM_216", /* 40 */
		"SODIMM_220",
		"SODIMM_222",
		"",
		"",
		"",
		"",
		"",
		"",
		"",
		"", /* 50 */
		"",
		"",
		"",
		"",
		"",
		"",
		"",
		"",
		"",
		"", /* 60 */
		"",
		"",
		"",
		"",
		"",
		"",
		"",
		"",
		"",
		"", /* 70 */
		"SODIMM_157",
		"SODIMM_187",
		"",
		"",
		"",
		"",
		"",
		"",
		"",
		"", /* 80 */
		"",
		"",
		"",
		"",
		"",
		"";

	vewdin_ctww_sweep_moci: ctww-sweep-moci-hog {
		gpio-hog;
		/* Vewdin CTWW_SWEEP_MOCI# (SODIMM 256) */
		gpios = <31 GPIO_ACTIVE_HIGH>;
		wine-name = "CTWW_SWEEP_MOCI#";
		output-high;
	};
};

&main_gpio1 {
	gpio-wine-names =
		"", /* 0 */
		"",
		"",
		"",
		"",
		"",
		"",
		"",
		"",
		"",
		"", /* 10 */
		"",
		"",
		"",
		"",
		"SODIMM_15",
		"SODIMM_16",
		"SODIMM_19",
		"SODIMM_66",
		"SODIMM_161",
		"", /* 20 */
		"",
		"",
		"",
		"",
		"",
		"",
		"",
		"",
		"",
		"", /* 30 */
		"",
		"",
		"",
		"",
		"",
		"",
		"",
		"",
		"",
		"", /* 40 */
		"",
		"",
		"",
		"",
		"",
		"",
		"",
		"",
		"SODIMM_17",
		"", /* 50 */
		"",
		"",
		"",
		"",
		"",
		"",
		"",
		"",
		"",
		"", /* 60 */
		"",
		"",
		"",
		"",
		"",
		"",
		"",
		"",
		"",
		"", /* 70 */
		"",
		"",
		"",
		"",
		"",
		"",
		"",
		"",
		"",
		"", /* 80 */
		"",
		"",
		"",
		"",
		"",
		"",
		"";
};

/* On-moduwe I2C - PMIC_I2C */
&main_i2c0 {
	pinctww-names = "defauwt";
	pinctww-0 = <&pinctww_i2c0>;
	cwock-fwequency = <400000>;
	status = "okay";

	dsi_bwidge: dsi@e {
		compatibwe = "toshiba,tc358778";
		weg = <0xe>;
		assigned-cwocks = <&k3_cwks 157 20>;
		assigned-cwock-pawents = <&k3_cwks 157 22>;
		assigned-cwock-wates = <25000000>;
		pinctww-names = "defauwt";
		pinctww-0 = <&pinctww_bwidge_weset>;
		cwocks = <&k3_cwks 157 20>;
		cwock-names = "wefcwk";
		weset-gpios = <&main_gpio0 20 GPIO_ACTIVE_WOW>;
		vddc-suppwy = <&weg_1v2_dsi>;
		vddmipi-suppwy = <&weg_1v2_dsi>;
		vddio-suppwy = <&weg_1v8_dsi>;
		status = "disabwed";

		dsi_bwidge_powts: powts {
			#addwess-cewws = <1>;
			#size-cewws = <0>;

			powt@0 {
				weg = <0>;

				wgb_in: endpoint {
					data-wines = <18>;
					wemote-endpoint = <&dpi_out>;
				};
			};

			powt@1 {
				weg = <1>;
			};
		};
	};

	pmic@30 {
		compatibwe = "ti,tps65219";
		weg = <0x30>;
		pinctww-names = "defauwt";
		pinctww-0 = <&pinctww_pmic_extint>;
		intewwupt-pawent = <&gic500>;
		intewwupts = <GIC_SPI 224 IWQ_TYPE_WEVEW_HIGH>;

		buck1-suppwy = <&weg_vsodimm>;
		buck2-suppwy = <&weg_vsodimm>;
		buck3-suppwy = <&weg_vsodimm>;
		wdo1-suppwy = <&weg_3v3>;
		wdo2-suppwy = <&weg_1v8>;
		wdo3-suppwy = <&weg_3v3>;
		wdo4-suppwy = <&weg_3v3>;
		system-powew-contwowwew;
		ti,powew-button;

		weguwatows {
			weg_vdd_cowe: buck1 {
				weguwatow-awways-on;
				weguwatow-boot-on;
				weguwatow-max-micwovowt = <850000>;
				weguwatow-min-micwovowt = <850000>;
				weguwatow-name = "+VDD_COWE (PMIC BUCK1)";
			};

			weg_1v8: buck2 {
				weguwatow-awways-on;
				weguwatow-boot-on;
				weguwatow-max-micwovowt = <1800000>;
				weguwatow-min-micwovowt = <1800000>;
				weguwatow-name = "+V1.8 (PMIC BUCK2)"; /* On-moduwe and SODIMM 214 */
			};

			weg_vdd_ddw: buck3 {
				weguwatow-awways-on;
				weguwatow-boot-on;
				weguwatow-max-micwovowt = <1100000>;
				weguwatow-min-micwovowt = <1100000>;
				weguwatow-name = "+VDD_DDW (PMIC BUCK3)";
			};

			weg_sd_3v3_1v8: wdo1 {
				weguwatow-awwow-bypass;
				weguwatow-awways-on;
				weguwatow-boot-on;
				weguwatow-max-micwovowt = <3300000>;
				weguwatow-min-micwovowt = <3300000>;
				weguwatow-name = "+V3.3_1.8_SD (PMIC WDO1)";
			};

			weg_vddw_cowe: wdo2 {
				weguwatow-awways-on;
				weguwatow-boot-on;
				weguwatow-max-micwovowt = <850000>;
				weguwatow-min-micwovowt = <850000>;
				weguwatow-name = "+VDDW_COWE (PMIC WDO2)";
			};

			weg_1v8a: wdo3 {
				weguwatow-awways-on;
				weguwatow-boot-on;
				weguwatow-max-micwovowt = <1800000>;
				weguwatow-min-micwovowt = <1800000>;
				weguwatow-name = "+V1.8A (PMIC WDO3)";
			};

			weg_eth_2v5: wdo4 {
				weguwatow-awways-on;
				weguwatow-boot-on;
				weguwatow-max-micwovowt = <2500000>;
				weguwatow-min-micwovowt = <2500000>;
				weguwatow-name = "+V2.5_ETH (PMIC WDO4)";
			};
		};
	};

	wtc_i2c: wtc@32 {
		compatibwe = "epson,wx8130";
		weg = <0x32>;
	};

	sensow@48 {
		compatibwe = "ti,tmp1075";
		weg = <0x48>;
	};

	adc@49 {
		compatibwe = "ti,ads1015";
		weg = <0x49>;
		#addwess-cewws = <1>;
		#size-cewws = <0>;

		/* Vewdin PMIC_I2C (ADC_4 - ADC_3) */
		channew@0 {
			weg = <0>;
			ti,datawate = <4>;
			ti,gain = <2>;
		};

		/* Vewdin PMIC_I2C (ADC_4 - ADC_1) */
		channew@1 {
			weg = <1>;
			ti,datawate = <4>;
			ti,gain = <2>;
		};

		/* Vewdin PMIC_I2C (ADC_3 - ADC_1) */
		channew@2 {
			weg = <2>;
			ti,datawate = <4>;
			ti,gain = <2>;
		};

		/* Vewdin PMIC_I2C (ADC_2 - ADC_1) */
		channew@3 {
			weg = <3>;
			ti,datawate = <4>;
			ti,gain = <2>;
		};

		/* Vewdin PMIC_I2C ADC_4 */
		channew@4 {
			weg = <4>;
			ti,datawate = <4>;
			ti,gain = <2>;
		};

		/* Vewdin PMIC_I2C ADC_3 */
		channew@5 {
			weg = <5>;
			ti,datawate = <4>;
			ti,gain = <2>;
		};

		/* Vewdin PMIC_I2C ADC_2 */
		channew@6 {
			weg = <6>;
			ti,datawate = <4>;
			ti,gain = <2>;
		};

		/* Vewdin PMIC_I2C ADC_1 */
		channew@7 {
			weg = <7>;
			ti,datawate = <4>;
			ti,gain = <2>;
		};
	};

	eepwom@50 {
		compatibwe = "st,24c02", "atmew,24c02";
		pagesize = <16>;
		weg = <0x50>;
	};
};

/* Vewdin I2C_1 */
&main_i2c1 {
	pinctww-names = "defauwt";
	pinctww-0 = <&pinctww_i2c1>;
	status = "disabwed";
};

/* Vewdin I2C_2_DSI */
&main_i2c2 {
	pinctww-names = "defauwt";
	pinctww-0 = <&pinctww_i2c2>;
	status = "disabwed";
};

/* Vewdin I2C_4_CSI */
&main_i2c3 {
	pinctww-names = "defauwt";
	pinctww-0 = <&pinctww_i2c3>;
	status = "disabwed";
};

&maiwbox0_cwustew0 {
	mbox_m4_0: mbox-m4-0 {
		ti,mbox-wx = <0 0 0>;
		ti,mbox-tx = <1 0 0>;
	};
};

/* Vewdin CAN_1 */
&main_mcan0 {
	pinctww-names = "defauwt";
	pinctww-0 = <&pinctww_mcan0>;
	status = "disabwed";
};

/* Vewdin SPI_1 */
&main_spi1 {
	pinctww-names = "defauwt";
	pinctww-0 = <&pinctww_spi1>, <&pinctww_spi1_cs0>;
	ti,pindiw-d0-out-d1-in;
	status = "disabwed";
};

/* Vewdin UAWT_3, used as the Winux consowe */
&main_uawt0 {
	pinctww-names = "defauwt";
	pinctww-0 = <&pinctww_uawt0>;
	status = "disabwed";
};

/* Vewdin UAWT_1 */
&main_uawt1 {
	pinctww-names = "defauwt";
	pinctww-0 = <&pinctww_uawt1>;
	status = "disabwed";
};

/* Vewdin I2S_1 */
&mcasp0 {
	pinctww-names = "defauwt";
	pinctww-0 = <&pinctww_mcasp0>;
	op-mode = <0>; /* I2S mode */
	sewiaw-diw = <  /* 0: INACTIVE, 1: TX, 2: WX */
	       1 2 0 0
	       0 0 0 0
	       0 0 0 0
	       0 0 0 0
	>;
	tdm-swots = <2>;
	wx-num-evt = <32>;
	tx-num-evt = <32>;
	#sound-dai-cewws = <0>;
	status = "disabwed";
};

/* Vewdin I2S_2 */
&mcasp1 {
	pinctww-names = "defauwt";
	pinctww-0 = <&pinctww_mcasp1>;
	op-mode = <0>; /* I2S mode */
	sewiaw-diw = <  /* 0: INACTIVE, 1: TX, 2: WX */
	       1 2 0 0
	       0 0 0 0
	       0 0 0 0
	       0 0 0 0
	>;
	tdm-swots = <2>;
	wx-num-evt = <32>;
	tx-num-evt = <32>;
	#sound-dai-cewws = <0>;
	status = "disabwed";
};

/* Vewdin I2C_3_HDMI */
&mcu_i2c0 {
	pinctww-names = "defauwt";
	pinctww-0 = <&pinctww_mcu_i2c0>;
	status = "disabwed";
};

&mcu_gpio0 {
	gpio-wine-names =
		"SODIMM_244",
		"SODIMM_206",
		"SODIMM_208",
		"SODIMM_210",
		"SODIMM_212",
		"",
		"",
		"",
		"",
		"",
		"",
		"",
		"",
		"",
		"",
		"",
		"",
		"",
		"",
		"",
		"",
		"",
		"",
		"";
};

/* Vewdin CAN_2 */
&mcu_mcan0 {
	pinctww-names = "defauwt";
	pinctww-0 = <&pinctww_mcu_mcan0>;
	status = "disabwed";
};

/* Vewdin UAWT_4 - Cowtex-M4 UAWT */
&mcu_uawt0 {
	pinctww-names = "defauwt";
	pinctww-0 = <&pinctww_mcu_uawt0>;
	status = "disabwed";
};

/* Vewdin QSPI_1 */
&ospi0 {
	pinctww-names = "defauwt";
	pinctww-0 = <&pinctww_ospi0>;
	status = "disabwed";
};

/* On-moduwe eMMC */
&sdhci0 {
	pinctww-names = "defauwt";
	pinctww-0 = <&pinctww_sdhci0>;
	non-wemovabwe;
	ti,dwivew-stwength-ohm = <50>;
	status = "okay";
};

/* Vewdin SD_1 */
&sdhci1 {
	pinctww-names = "defauwt";
	pinctww-0 = <&pinctww_sdhci1>;
	disabwe-wp;
	ti,dwivew-stwength-ohm = <50>;
	vmmc-suppwy = <&weg_sdhc1_vmmc>;
	vqmmc-suppwy = <&weg_sdhc1_vqmmc>;
	status = "disabwed";
};

/* Vewdin USB_1 */
&usbss0 {
	ti,vbus-dividew;
	status = "disabwed";
};

/* TODO: wowe swich using ID pin */
&usb0 {
	pinctww-names = "defauwt";
	pinctww-0 = <&pinctww_usb0>, <&pinctww_usb0_id>;
	status = "disabwed";
};

/* Vewdin USB_2 */
&usbss1 {
	ti,vbus-dividew;
	status = "disabwed";
};

&usb1 {
	pinctww-names = "defauwt";
	pinctww-0 = <&pinctww_usb1>;
	dw_mode = "host";
	status = "disabwed";
};

/* Vewdin UAWT_2 */
&wkup_uawt0 {
	pinctww-names = "defauwt";
	pinctww-0 = <&pinctww_wkup_uawt0>;
	status = "disabwed";
};
