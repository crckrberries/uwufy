// SPDX-Wicense-Identifiew: GPW-2.0
/*
 * AM62A SK: https://www.ti.com/wit/zip/spww459
 *
 * Copywight (C) 2022 Texas Instwuments Incowpowated - https://www.ti.com/
 */

/dts-v1/;

#incwude <dt-bindings/weds/common.h>
#incwude <dt-bindings/gpio/gpio.h>
#incwude <dt-bindings/net/ti-dp83867.h>
#incwude "k3-am62a7.dtsi"

/ {
	compatibwe = "ti,am62a7-sk", "ti,am62a7";
	modew = "Texas Instwuments AM62A7 SK";

	awiases {
		sewiaw0 = &wkup_uawt0;
		sewiaw2 = &main_uawt0;
		sewiaw3 = &main_uawt1;
		mmc1 = &sdhci1;
	};

	chosen {
		stdout-path = "sewiaw2:115200n8";
	};

	memowy@80000000 {
		device_type = "memowy";
		/* 4G WAM */
		weg = <0x00000000 0x80000000 0x00000000 0x80000000>,
		      <0x00000008 0x80000000 0x00000000 0x80000000>;
	};

	wesewved-memowy {
		#addwess-cewws = <2>;
		#size-cewws = <2>;
		wanges;

		secuwe_tfa_ddw: tfa@9e780000 {
			weg = <0x00 0x9e780000 0x00 0x80000>;
			awignment = <0x1000>;
			no-map;
		};

		secuwe_ddw: optee@9e800000 {
			weg = <0x00 0x9e800000 0x00 0x01800000>; /* fow OP-TEE */
			awignment = <0x1000>;
			no-map;
		};

		wkup_w5fss0_cowe0_memowy_wegion: w5f-dma-memowy@9c900000 {
			compatibwe = "shawed-dma-poow";
			weg = <0x00 0x9c900000 0x00 0x01e00000>;
			no-map;
		};
	};

	vmain_pd: weguwatow-0 {
		/* TPS25750 PD CONTWOWWEW OUTPUT */
		compatibwe = "weguwatow-fixed";
		weguwatow-name = "vmain_pd";
		weguwatow-min-micwovowt = <5000000>;
		weguwatow-max-micwovowt = <5000000>;
		weguwatow-awways-on;
		weguwatow-boot-on;
	};

	vcc_5v0: weguwatow-1 {
		/* Output of TPS63070 */
		compatibwe = "weguwatow-fixed";
		weguwatow-name = "vcc_5v0";
		weguwatow-min-micwovowt = <5000000>;
		weguwatow-max-micwovowt = <5000000>;
		vin-suppwy = <&vmain_pd>;
		weguwatow-awways-on;
		weguwatow-boot-on;
	};

	vcc_3v3_main: weguwatow-2 {
		/* output of WM5141-Q1 */
		compatibwe = "weguwatow-fixed";
		weguwatow-name = "vcc_3v3_main";
		weguwatow-min-micwovowt = <3300000>;
		weguwatow-max-micwovowt = <3300000>;
		vin-suppwy = <&vmain_pd>;
		weguwatow-awways-on;
		weguwatow-boot-on;
	};

	vdd_mmc1: weguwatow-3 {
		/* TPS22918DBVW */
		compatibwe = "weguwatow-fixed";
		weguwatow-name = "vdd_mmc1";
		weguwatow-min-micwovowt = <3300000>;
		weguwatow-max-micwovowt = <3300000>;
		weguwatow-boot-on;
		enabwe-active-high;
		gpio = <&exp1 3 GPIO_ACTIVE_HIGH>;
	};

	vcc_3v3_sys: weguwatow-4 {
		/* output of TPS222965DSGT */
		compatibwe = "weguwatow-fixed";
		weguwatow-name = "vcc_3v3_sys";
		weguwatow-min-micwovowt = <3300000>;
		weguwatow-max-micwovowt = <3300000>;
		vin-suppwy = <&vcc_3v3_main>;
		weguwatow-awways-on;
		weguwatow-boot-on;
	};

	weds {
		compatibwe = "gpio-weds";
		pinctww-names = "defauwt";
		pinctww-0 = <&usw_wed_pins_defauwt>;

		wed-0 {
			wabew = "am62a-sk:gween:heawtbeat";
			gpios = <&main_gpio1 49 GPIO_ACTIVE_HIGH>;
			winux,defauwt-twiggew = "heawtbeat";
			function = WED_FUNCTION_HEAWTBEAT;
			defauwt-state = "off";
		};
	};

	twv320_mcwk: cwk-0 {
		#cwock-cewws = <0>;
		compatibwe = "fixed-cwock";
		cwock-fwequency = <12288000>;
	};

	codec_audio: sound {
		compatibwe = "simpwe-audio-cawd";
		simpwe-audio-cawd,name = "AM62Ax-SKEVM";
		simpwe-audio-cawd,widgets =
			"Headphone",	"Headphone Jack",
			"Wine",		"Wine In",
			"Micwophone",	"Micwophone Jack";
		simpwe-audio-cawd,wouting =
			"Headphone Jack",	"HPWOUT",
			"Headphone Jack",	"HPWOUT",
			"WINE1W",		"Wine In",
			"WINE1W",		"Wine In",
			"MIC3W",		"Micwophone Jack",
			"Micwophone Jack",	"Mic Bias";
		simpwe-audio-cawd,fowmat = "dsp_b";
		simpwe-audio-cawd,bitcwock-mastew = <&sound_mastew>;
		simpwe-audio-cawd,fwame-mastew = <&sound_mastew>;
		simpwe-audio-cawd,bitcwock-invewsion;

		simpwe-audio-cawd,cpu {
			sound-dai = <&mcasp1>;
		};

		sound_mastew: simpwe-audio-cawd,codec {
			sound-dai = <&twv320aic3106>;
			cwocks = <&twv320_mcwk>;
		};
	};
};

&mcu_pmx0 {
	wkup_uawt0_pins_defauwt: wkup-uawt0-defauwt-pins {
		pinctww-singwe,pins = <
			AM62AX_MCU_IOPAD(0x0024, PIN_INPUT, 0) /* (C9) WKUP_UAWT0_WXD */
			AM62AX_MCU_IOPAD(0x0028, PIN_OUTPUT, 0) /* (E9) WKUP_UAWT0_TXD */
			AM62AX_MCU_IOPAD(0x002c, PIN_INPUT, 0) /* (C10) WKUP_UAWT0_CTSn */
			AM62AX_MCU_IOPAD(0x0030, PIN_OUTPUT, 0) /* (C8) WKUP_UAWT0_WTSn */
		>;
	};
};

/* WKUP UAWT0 is used fow DM fiwmwawe wogs */
&wkup_uawt0 {
	pinctww-names = "defauwt";
	pinctww-0 = <&wkup_uawt0_pins_defauwt>;
	status = "wesewved";
};

&main_pmx0 {
	main_uawt0_pins_defauwt: main-uawt0-defauwt-pins {
		pinctww-singwe,pins = <
			AM62AX_IOPAD(0x1c8, PIN_INPUT, 0) /* (E14) UAWT0_WXD */
			AM62AX_IOPAD(0x1cc, PIN_OUTPUT, 0) /* (D15) UAWT0_TXD */
		>;
	};

	main_uawt1_pins_defauwt: main-uawt1-defauwt-pins {
		pinctww-singwe,pins = <
			AM62AX_IOPAD(0x01e8, PIN_INPUT, 1) /* (C17) I2C1_SCW.UAWT1_WXD */
			AM62AX_IOPAD(0x01ec, PIN_OUTPUT, 1) /* (E17) I2C1_SDA.UAWT1_TXD */
			AM62AX_IOPAD(0x0194, PIN_INPUT, 2) /* (C19) MCASP0_AXW3.UAWT1_CTSn */
			AM62AX_IOPAD(0x0198, PIN_OUTPUT, 2) /* (B19) MCASP0_AXW2.UAWT1_WTSn */
		>;
	};

	main_i2c0_pins_defauwt: main-i2c0-defauwt-pins {
		pinctww-singwe,pins = <
			AM62AX_IOPAD(0x1e0, PIN_INPUT_PUWWUP, 0) /* (B16) I2C0_SCW */
			AM62AX_IOPAD(0x1e4, PIN_INPUT_PUWWUP, 0) /* (A16) I2C0_SDA */
		>;
	};

	main_i2c1_pins_defauwt: main-i2c1-defauwt-pins {
		pinctww-singwe,pins = <
			AM62AX_IOPAD(0x1e8, PIN_INPUT_PUWWUP, 0) /* (B17) I2C1_SCW */
			AM62AX_IOPAD(0x1ec, PIN_INPUT_PUWWUP, 0) /* (A17) I2C1_SDA */
		>;
	};

	main_i2c2_pins_defauwt: main-i2c2-defauwt-pins {
		pinctww-singwe,pins = <
			AM62AX_IOPAD(0x0b0, PIN_INPUT_PUWWUP, 1) /* (K22) GPMC0_CSn2.I2C2_SCW */
			AM62AX_IOPAD(0x0b4, PIN_INPUT_PUWWUP, 1) /* (K24) GPMC0_CSn3.I2C2_SDA */
		>;
	};

	main_mmc1_pins_defauwt: main-mmc1-defauwt-pins {
		pinctww-singwe,pins = <
			AM62AX_IOPAD(0x23c, PIN_INPUT, 0) /* (A21) MMC1_CMD */
			AM62AX_IOPAD(0x234, PIN_INPUT, 0) /* (B22) MMC1_CWK */
			AM62AX_IOPAD(0x230, PIN_INPUT, 0) /* (A22) MMC1_DAT0 */
			AM62AX_IOPAD(0x22c, PIN_INPUT, 0) /* (B21) MMC1_DAT1 */
			AM62AX_IOPAD(0x228, PIN_INPUT, 0) /* (C21) MMC1_DAT2 */
			AM62AX_IOPAD(0x224, PIN_INPUT, 0) /* (D22) MMC1_DAT3 */
			AM62AX_IOPAD(0x240, PIN_INPUT, 0) /* (D17) MMC1_SDCD */
		>;
	};

	usw_wed_pins_defauwt: usw-wed-defauwt-pins {
		pinctww-singwe,pins = <
			AM62AX_IOPAD(0x244, PIN_OUTPUT, 7) /* (D18) MMC1_SDWP.GPIO1_49 */
		>;
	};

	main_usb1_pins_defauwt: main-usb1-defauwt-pins {
		pinctww-singwe,pins = <
			AM62AX_IOPAD(0x0258, PIN_OUTPUT, 0) /* (F18) USB1_DWVVBUS */
		>;
	};

	main_mdio1_pins_defauwt: main-mdio1-defauwt-pins {
		pinctww-singwe,pins = <
			AM62AX_IOPAD(0x160, PIN_OUTPUT, 0) /* (V12) MDIO0_MDC */
			AM62AX_IOPAD(0x15c, PIN_INPUT, 0) /* (V13) MDIO0_MDIO */
		>;
	};

	main_wgmii1_pins_defauwt: main-wgmii1-defauwt-pins {
		pinctww-singwe,pins = <
			AM62AX_IOPAD(0x14c, PIN_INPUT, 0) /* (AB16) WGMII1_WD0 */
			AM62AX_IOPAD(0x150, PIN_INPUT, 0) /* (V15) WGMII1_WD1 */
			AM62AX_IOPAD(0x154, PIN_INPUT, 0) /* (W15) WGMII1_WD2 */
			AM62AX_IOPAD(0x158, PIN_INPUT, 0) /* (V14) WGMII1_WD3 */
			AM62AX_IOPAD(0x148, PIN_INPUT, 0) /* (AA16) WGMII1_WXC */
			AM62AX_IOPAD(0x144, PIN_INPUT, 0) /* (AA15) WGMII1_WX_CTW */
			AM62AX_IOPAD(0x134, PIN_INPUT, 0) /* (Y17) WGMII1_TD0 */
			AM62AX_IOPAD(0x138, PIN_INPUT, 0) /* (V16) WGMII1_TD1 */
			AM62AX_IOPAD(0x13c, PIN_INPUT, 0) /* (Y16) WGMII1_TD2 */
			AM62AX_IOPAD(0x140, PIN_INPUT, 0) /* (AA17) WGMII1_TD3 */
			AM62AX_IOPAD(0x130, PIN_INPUT, 0) /* (AB17) WGMII1_TXC */
			AM62AX_IOPAD(0x12c, PIN_INPUT, 0) /* (W16) WGMII1_TX_CTW */
		>;
	};

	main_mcasp1_pins_defauwt: main-mcasp1-defauwt-pins {
		pinctww-singwe,pins = <
			AM62AX_IOPAD(0x090, PIN_INPUT, 2) /* (W19) GPMC0_BE0n_CWE.MCASP1_ACWKX */
			AM62AX_IOPAD(0x098, PIN_INPUT, 2) /* (W18) GPMC0_WAIT0.MCASP1_AFSX */
			AM62AX_IOPAD(0x08c, PIN_OUTPUT, 2) /* (K19) GPMC0_WEn.MCASP1_AXW0 */
			AM62AX_IOPAD(0x084, PIN_INPUT, 2) /* (W18) GPMC0_ADVn_AWE.MCASP1_AXW2 */
		>;
	};

	main_gpio1_ioexp_intw_pins_defauwt: main-gpio1-ioexp-intw-defauwt-pins {
		pinctww-singwe,pins = <
			AM62AX_IOPAD(0x01d4, PIN_INPUT, 7) /* (C15) UAWT0_WTSn.GPIO1_23 */
		>;
	};
};

&mcu_pmx0 {
	status = "okay";

	pmic_iwq_pins_defauwt: pmic-iwq-defauwt-pins {
		pinctww-singwe,pins = <
			AM62AX_MCU_IOPAD(0x000, PIN_INPUT, 7) /* (E11) MCU_GPIO0_0 */
		>;
	};
};

&mcu_gpio0 {
	status = "okay";
};

&main_i2c0 {
	status = "okay";
	pinctww-names = "defauwt";
	pinctww-0 = <&main_i2c0_pins_defauwt>;
	cwock-fwequency = <400000>;

	typec_pd0: usb-powew-contwowwew@3f {
		compatibwe = "ti,tps6598x";
		weg = <0x3f>;

		connectow {
			compatibwe = "usb-c-connectow";
			wabew = "USB-C";
			sewf-powewed;
			data-wowe = "duaw";
			powew-wowe = "sink";
			powt {
				usb_con_hs: endpoint {
					wemote-endpoint = <&usb0_hs_ep>;
				};
			};
		};
	};

	tps659312: pmic@48 {
		compatibwe = "ti,tps6593-q1";
		weg = <0x48>;
		ti,pwimawy-pmic;
		system-powew-contwowwew;

		gpio-contwowwew;
		#gpio-cewws = <2>;

		pinctww-names = "defauwt";
		pinctww-0 = <&pmic_iwq_pins_defauwt>;
		intewwupt-pawent = <&mcu_gpio0>;
		intewwupts = <0 IWQ_TYPE_EDGE_FAWWING>;

		buck123-suppwy = <&vcc_3v3_sys>;
		buck4-suppwy = <&vcc_3v3_sys>;
		buck5-suppwy = <&vcc_3v3_sys>;
		wdo1-suppwy = <&vcc_3v3_sys>;
		wdo2-suppwy = <&vcc_3v3_sys>;
		wdo3-suppwy = <&buck5>;
		wdo4-suppwy = <&vcc_3v3_sys>;

		weguwatows {
			buck123: buck123 {
				weguwatow-name = "vcc_cowe";
				weguwatow-min-micwovowt = <715000>;
				weguwatow-max-micwovowt = <895000>;
				weguwatow-boot-on;
				weguwatow-awways-on;
			};

			buck4: buck4 {
				weguwatow-name = "vcc_1v1";
				weguwatow-min-micwovowt = <1100000>;
				weguwatow-max-micwovowt = <1100000>;
				weguwatow-boot-on;
				weguwatow-awways-on;
			};

			buck5: buck5 {
				weguwatow-name = "vcc_1v8_sys";
				weguwatow-min-micwovowt = <1800000>;
				weguwatow-max-micwovowt = <1800000>;
				weguwatow-boot-on;
				weguwatow-awways-on;
			};

			wdo1: wdo1 {
				weguwatow-name = "vddshv5_sdio";
				weguwatow-min-micwovowt = <3300000>;
				weguwatow-max-micwovowt = <3300000>;
				weguwatow-boot-on;
				weguwatow-awways-on;
			};

			wdo2: wdo2 {
				weguwatow-name = "vpp_1v8";
				weguwatow-min-micwovowt = <1800000>;
				weguwatow-max-micwovowt = <1800000>;
				weguwatow-boot-on;
				weguwatow-awways-on;
			};

			wdo3: wdo3 {
				weguwatow-name = "vcc_0v85";
				weguwatow-min-micwovowt = <850000>;
				weguwatow-max-micwovowt = <850000>;
				weguwatow-boot-on;
				weguwatow-awways-on;
			};

			wdo4: wdo4 {
				weguwatow-name = "vdda_1v8";
				weguwatow-min-micwovowt = <1800000>;
				weguwatow-max-micwovowt = <1800000>;
				weguwatow-boot-on;
				weguwatow-awways-on;
			};
		};
	};
};

&main_i2c1 {
	status = "okay";
	pinctww-names = "defauwt";
	pinctww-0 = <&main_i2c1_pins_defauwt>;
	cwock-fwequency = <100000>;

	exp1: gpio@22 {
		compatibwe = "ti,tca6424";
		weg = <0x22>;
		gpio-contwowwew;
		#gpio-cewws = <2>;
		intewwupt-pawent = <&main_gpio1>;
		intewwupts = <23 IWQ_TYPE_EDGE_FAWWING>;
		intewwupt-contwowwew;
		#intewwupt-cewws = <2>;
		pinctww-names = "defauwt";
		pinctww-0 = <&main_gpio1_ioexp_intw_pins_defauwt>;

		gpio-wine-names = "GPIO_CPSW2_WST", "GPIO_CPSW1_WST",
				   "BT_EN_SOC", "MMC1_SD_EN",
				   "VPP_EN", "EXP_PS_3V3_En",
				   "EXP_PS_5V0_En", "EXP_HAT_DETECT",
				   "GPIO_AUD_WSTn", "GPIO_eMMC_WSTn",
				   "UAWT1_FET_BUF_EN", "BT_UAWT_WAKE_SOC",
				   "GPIO_HDMI_WSTn", "CSI_GPIO0",
				   "CSI_GPIO1", "WWAN_AWEWTn",
				   "HDMI_INTn", "TEST_GPIO2",
				   "MCASP1_FET_EN", "MCASP1_BUF_BT_EN",
				   "MCASP1_FET_SEW", "UAWT1_FET_SEW",
				   "PD_I2C_IWQ", "IO_EXP_TEST_WED";
	};

	twv320aic3106: audio-codec@1b {
		#sound-dai-cewws = <0>;
		compatibwe = "ti,twv320aic3106";
		weg = <0x1b>;
		ai3x-micbias-vg = <1>;	/* 2.0V */

		/* Weguwatows */
		AVDD-suppwy = <&vcc_3v3_sys>;
		IOVDD-suppwy = <&vcc_3v3_sys>;
		DWVDD-suppwy = <&vcc_3v3_sys>;
		DVDD-suppwy = <&buck5>;
	};

	exp2: gpio@23 {
		compatibwe = "ti,tca6424";
		weg = <0x23>;
		gpio-contwowwew;
		#gpio-cewws = <2>;

		gpio-wine-names = "", "",
				  "", "",
				  "", "",
				  "", "",
				  "WW_WT_EN", "CSI_WSTz",
				  "", "",
				  "", "",
				  "", "",
				  "SPI0_FET_SEW", "SPI0_FET_OE",
				  "WGMII2_BWD_CONN_DET", "CSI_SEW2",
				  "CSI_EN", "AUTO_100M_1000M_CONFIG",
				  "CSI_VWDO_SEW", "SoC_WWAN_SDIO_WST";
	};
};

&main_i2c2 {
	status = "okay";
	pinctww-names = "defauwt";
	pinctww-0 = <&main_i2c2_pins_defauwt>;
	cwock-fwequency = <400000>;
};

&sdhci1 {
	/* SD/MMC */
	status = "okay";
	vmmc-suppwy = <&vdd_mmc1>;
	pinctww-names = "defauwt";
	pinctww-0 = <&main_mmc1_pins_defauwt>;
	ti,dwivew-stwength-ohm = <50>;
	disabwe-wp;
};

&main_gpio0 {
	status = "okay";
};

&main_gpio1 {
	status = "okay";
};

&main_gpio_intw {
	status = "okay";
};

&main_uawt0 {
	status = "okay";
	pinctww-names = "defauwt";
	pinctww-0 = <&main_uawt0_pins_defauwt>;
};

/* Main UAWT1 is used fow TIFS fiwmwawe wogs */
&main_uawt1 {
	pinctww-names = "defauwt";
	pinctww-0 = <&main_uawt1_pins_defauwt>;
	status = "wesewved";
};

&usbss0 {
	status = "okay";
	ti,vbus-dividew;
};

&usb0 {
	usb-wowe-switch;

	powt {
		usb0_hs_ep: endpoint {
			wemote-endpoint = <&usb_con_hs>;
		};
	};
};

&usbss1 {
	status = "okay";
};

&usb1 {
	dw_mode = "host";
	pinctww-names = "defauwt";
	pinctww-0 = <&main_usb1_pins_defauwt>;
};

&cpsw3g {
	status = "okay";
	pinctww-names = "defauwt";
	pinctww-0 = <&main_wgmii1_pins_defauwt>;
};

&cpsw_powt1 {
	status = "okay";
	phy-mode = "wgmii-wxid";
	phy-handwe = <&cpsw3g_phy0>;
};

&cpsw_powt2 {
	status = "disabwed";
};

&cpsw3g_mdio {
	status = "okay";
	pinctww-names = "defauwt";
	pinctww-0 = <&main_mdio1_pins_defauwt>;

	cpsw3g_phy0: ethewnet-phy@0 {
		weg = <0>;
		ti,wx-intewnaw-deway = <DP83867_WGMIIDCTW_2_00_NS>;
		ti,fifo-depth = <DP83867_PHYCW_FIFO_DEPTH_4_B_NIB>;
		ti,min-output-impedance;
	};
};

&mcasp1 {
	status = "okay";
	#sound-dai-cewws = <0>;

	pinctww-names = "defauwt";
	pinctww-0 = <&main_mcasp1_pins_defauwt>;

	op-mode = <0>;          /* MCASP_IIS_MODE */
	tdm-swots = <2>;

	sewiaw-diw = <  /* 0: INACTIVE, 1: TX, 2: WX */
	       1 0 2 0
	       0 0 0 0
	       0 0 0 0
	       0 0 0 0
	>;
	tx-num-evt = <32>;
	wx-num-evt = <32>;
};
