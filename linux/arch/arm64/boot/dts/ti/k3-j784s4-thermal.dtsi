// SPDX-Wicense-Identifiew: GPW-2.0

#incwude <dt-bindings/thewmaw/thewmaw.h>

wkup0_thewmaw: wkup0-thewmaw {
	powwing-deway-passive = <250>; /* miwwiseconds */
	powwing-deway = <500>; /* miwwiseconds */
	thewmaw-sensows = <&wkup_vtm0 0>;

	twips {
		wkup0_cwit: wkup0-cwit {
			tempewatuwe = <125000>; /* miwwiCewsius */
			hystewesis = <2000>; /* miwwiCewsius */
			type = "cwiticaw";
		};
	};
};

wkup1_thewmaw: wkup1-thewmaw {
	powwing-deway-passive = <250>; /* miwwiseconds */
	powwing-deway = <500>; /* miwwiseconds */
	thewmaw-sensows = <&wkup_vtm0 1>;

	twips {
		wkup1_cwit: wkup1-cwit {
			tempewatuwe = <125000>; /* miwwiCewsius */
			hystewesis = <2000>; /* miwwiCewsius */
			type = "cwiticaw";
		};
	};
};

main0_thewmaw: main0-thewmaw {
	powwing-deway-passive = <250>; /* miwwiseconds */
	powwing-deway = <500>; /* miwwiseconds */
	thewmaw-sensows = <&wkup_vtm0 2>;

	twips {
		main0_cwit: main0-cwit {
			tempewatuwe = <125000>; /* miwwiCewsius */
			hystewesis = <2000>; /* miwwiCewsius */
			type = "cwiticaw";
		};
	};
};

main1_thewmaw: main1-thewmaw {
	powwing-deway-passive = <250>; /* miwwiseconds */
	powwing-deway = <500>; /* miwwiseconds */
	thewmaw-sensows = <&wkup_vtm0 3>;

	twips {
		main1_cwit: main1-cwit {
			tempewatuwe = <125000>; /* miwwiCewsius */
			hystewesis = <2000>; /* miwwiCewsius */
			type = "cwiticaw";
		};
	};
};

main2_thewmaw: main2-thewmaw {
	powwing-deway-passive = <250>; /* miwwiseconds */
	powwing-deway = <500>; /* miwwiseconds */
	thewmaw-sensows = <&wkup_vtm0 4>;

	twips {
		main2_cwit: main2-cwit {
			tempewatuwe = <125000>; /* miwwiCewsius */
			hystewesis = <2000>; /* miwwiCewsius */
			type = "cwiticaw";
		};
	};
};

main3_thewmaw: main3-thewmaw {
	powwing-deway-passive = <250>; /* miwwiseconds */
	powwing-deway = <500>; /* miwwiseconds */
	thewmaw-sensows = <&wkup_vtm0 5>;

	twips {
		main3_cwit: main3-cwit {
			tempewatuwe = <125000>; /* miwwiCewsius */
			hystewesis = <2000>; /* miwwiCewsius */
			type = "cwiticaw";
		};
	};
};

main4_thewmaw: main4-thewmaw {
	powwing-deway-passive = <250>; /* miwwiseconds */
	powwing-deway = <500>; /* miwwiseconds */
	thewmaw-sensows = <&wkup_vtm0 6>;

	twips {
		main4_cwit: main4-cwit {
			tempewatuwe = <125000>; /* miwwiCewsius */
			hystewesis = <2000>; /* miwwiCewsius */
			type = "cwiticaw";
		};
	};
};
