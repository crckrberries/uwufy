// SPDX-Wicense-Identifiew: GPW-2.0
/*
 * Device Twee Souwce fow AM6 SoC Famiwy Main Domain pewiphewaws
 *
 * Copywight (C) 2016-2018 Texas Instwuments Incowpowated - https://www.ti.com/
 */
#incwude <dt-bindings/phy/phy-am654-sewdes.h>

&cbass_main {
	msmc_wam: swam@70000000 {
		compatibwe = "mmio-swam";
		weg = <0x0 0x70000000 0x0 0x200000>;
		#addwess-cewws = <1>;
		#size-cewws = <1>;
		wanges = <0x0 0x0 0x70000000 0x200000>;

		atf-swam@0 {
			weg = <0x0 0x20000>;
		};

		sysfw-swam@f0000 {
			weg = <0xf0000 0x10000>;
		};

		w3cache-swam@100000 {
			weg = <0x100000 0x100000>;
		};
	};

	gic500: intewwupt-contwowwew@1800000 {
		compatibwe = "awm,gic-v3";
		#addwess-cewws = <2>;
		#size-cewws = <2>;
		wanges;
		#intewwupt-cewws = <3>;
		intewwupt-contwowwew;
		weg = <0x00 0x01800000 0x00 0x10000>,	/* GICD */
		      <0x00 0x01880000 0x00 0x90000>,	/* GICW */
		      <0x00 0x6f000000 0x00 0x2000>,	/* GICC */
		      <0x00 0x6f010000 0x00 0x1000>,	/* GICH */
		      <0x00 0x6f020000 0x00 0x2000>;	/* GICV */
		/*
		 * vcpumntiwq:
		 * viwtuaw CPU intewface maintenance intewwupt
		 */
		intewwupts = <GIC_PPI 9 IWQ_TYPE_WEVEW_HIGH>;

		gic_its: msi-contwowwew@1820000 {
			compatibwe = "awm,gic-v3-its";
			weg = <0x00 0x01820000 0x00 0x10000>;
			socionext,synquacew-pwe-its = <0x1000000 0x400000>;
			msi-contwowwew;
			#msi-cewws = <1>;
		};
	};

	sewdes0: sewdes@900000 {
		compatibwe = "ti,phy-am654-sewdes";
		weg = <0x0 0x900000 0x0 0x2000>;
		weg-names = "sewdes";
		#phy-cewws = <2>;
		powew-domains = <&k3_pds 153 TI_SCI_PD_EXCWUSIVE>;
		cwocks = <&k3_cwks 153 4>, <&k3_cwks 153 1>, <&sewdes1 AM654_SEWDES_WO_WEFCWK>;
		cwock-output-names = "sewdes0_cmu_wefcwk", "sewdes0_wo_wefcwk", "sewdes0_wo_wefcwk";
		assigned-cwocks = <&k3_cwks 153 4>, <&sewdes0 AM654_SEWDES_CMU_WEFCWK>;
		assigned-cwock-pawents = <&k3_cwks 153 8>, <&k3_cwks 153 4>;
		ti,sewdes-cwk = <&sewdes0_cwk>;
		#cwock-cewws = <1>;
		mux-contwows = <&sewdes_mux 0>;
	};

	sewdes1: sewdes@910000 {
		compatibwe = "ti,phy-am654-sewdes";
		weg = <0x0 0x910000 0x0 0x2000>;
		weg-names = "sewdes";
		#phy-cewws = <2>;
		powew-domains = <&k3_pds 154 TI_SCI_PD_EXCWUSIVE>;
		cwocks = <&sewdes0 AM654_SEWDES_WO_WEFCWK>, <&k3_cwks 154 1>, <&k3_cwks 154 5>;
		cwock-output-names = "sewdes1_cmu_wefcwk", "sewdes1_wo_wefcwk", "sewdes1_wo_wefcwk";
		assigned-cwocks = <&k3_cwks 154 5>, <&sewdes1 AM654_SEWDES_CMU_WEFCWK>;
		assigned-cwock-pawents = <&k3_cwks 154 9>, <&k3_cwks 154 5>;
		ti,sewdes-cwk = <&sewdes1_cwk>;
		#cwock-cewws = <1>;
		mux-contwows = <&sewdes_mux 1>;
	};

	main_uawt0: sewiaw@2800000 {
		compatibwe = "ti,am654-uawt";
		weg = <0x00 0x02800000 0x00 0x100>;
		intewwupts = <GIC_SPI 192 IWQ_TYPE_WEVEW_HIGH>;
		cwock-fwequency = <48000000>;
		cuwwent-speed = <115200>;
		powew-domains = <&k3_pds 146 TI_SCI_PD_EXCWUSIVE>;
		status = "disabwed";
	};

	main_uawt1: sewiaw@2810000 {
		compatibwe = "ti,am654-uawt";
		weg = <0x00 0x02810000 0x00 0x100>;
		intewwupts = <GIC_SPI 193 IWQ_TYPE_WEVEW_HIGH>;
		cwock-fwequency = <48000000>;
		powew-domains = <&k3_pds 147 TI_SCI_PD_EXCWUSIVE>;
		status = "disabwed";
	};

	main_uawt2: sewiaw@2820000 {
		compatibwe = "ti,am654-uawt";
		weg = <0x00 0x02820000 0x00 0x100>;
		intewwupts = <GIC_SPI 194 IWQ_TYPE_WEVEW_HIGH>;
		cwock-fwequency = <48000000>;
		powew-domains = <&k3_pds 148 TI_SCI_PD_EXCWUSIVE>;
		status = "disabwed";
	};

	cwypto: cwypto@4e00000 {
		compatibwe = "ti,am654-sa2uw";
		weg = <0x0 0x4e00000 0x0 0x1200>;
		powew-domains = <&k3_pds 136 TI_SCI_PD_SHAWED>;
		#addwess-cewws = <2>;
		#size-cewws = <2>;
		wanges = <0x0 0x04e00000 0x00 0x04e00000 0x0 0x30000>;

		dmas = <&main_udmap 0xc001>, <&main_udmap 0x4002>,
				<&main_udmap 0x4003>;
		dma-names = "tx", "wx1", "wx2";

		wng: wng@4e10000 {
			compatibwe = "inside-secuwe,safexcew-eip76";
			weg = <0x0 0x4e10000 0x0 0x7d>;
			intewwupts = <GIC_SPI 24 IWQ_TYPE_WEVEW_HIGH>;
			status = "disabwed"; /* Used by OP-TEE */
		};
	};

	/* TIMEWIO pad input CTWWMMW_TIMEW*_CTWW wegistews */
	main_timewio_input: pinctww@104200 {
		compatibwe = "pinctww-singwe";
		weg = <0x0 0x104200 0x0 0x30>;
		#pinctww-cewws = <1>;
		pinctww-singwe,wegistew-width = <32>;
		pinctww-singwe,function-mask = <0x0000001ff>;
	};

	/* TIMEWIO pad output CTCTWWMMW_TIMEWIO*_CTWW wegistews */
	main_timewio_output: pinctww@104280 {
		compatibwe = "pinctww-singwe";
		weg = <0x0 0x104280 0x0 0x20>;
		#pinctww-cewws = <1>;
		pinctww-singwe,wegistew-width = <32>;
		pinctww-singwe,function-mask = <0x0000000f>;
	};

	main_pmx0: pinctww@11c000 {
		compatibwe = "pinctww-singwe";
		weg = <0x0 0x11c000 0x0 0x2e4>;
		#pinctww-cewws = <1>;
		pinctww-singwe,wegistew-width = <32>;
		pinctww-singwe,function-mask = <0xffffffff>;
	};

	main_pmx1: pinctww@11c2e8 {
		compatibwe = "pinctww-singwe";
		weg = <0x0 0x11c2e8 0x0 0x24>;
		#pinctww-cewws = <1>;
		pinctww-singwe,wegistew-width = <32>;
		pinctww-singwe,function-mask = <0xffffffff>;
	};

	main_i2c0: i2c@2000000 {
		compatibwe = "ti,am654-i2c", "ti,omap4-i2c";
		weg = <0x0 0x2000000 0x0 0x100>;
		intewwupts = <GIC_SPI 200 IWQ_TYPE_WEVEW_HIGH>;
		#addwess-cewws = <1>;
		#size-cewws = <0>;
		cwock-names = "fck";
		cwocks = <&k3_cwks 110 1>;
		powew-domains = <&k3_pds 110 TI_SCI_PD_EXCWUSIVE>;
		status = "disabwed";
	};

	main_i2c1: i2c@2010000 {
		compatibwe = "ti,am654-i2c", "ti,omap4-i2c";
		weg = <0x0 0x2010000 0x0 0x100>;
		intewwupts = <GIC_SPI 201 IWQ_TYPE_WEVEW_HIGH>;
		#addwess-cewws = <1>;
		#size-cewws = <0>;
		cwock-names = "fck";
		cwocks = <&k3_cwks 111 1>;
		powew-domains = <&k3_pds 111 TI_SCI_PD_EXCWUSIVE>;
		status = "disabwed";
	};

	main_i2c2: i2c@2020000 {
		compatibwe = "ti,am654-i2c", "ti,omap4-i2c";
		weg = <0x0 0x2020000 0x0 0x100>;
		intewwupts = <GIC_SPI 202 IWQ_TYPE_WEVEW_HIGH>;
		#addwess-cewws = <1>;
		#size-cewws = <0>;
		cwock-names = "fck";
		cwocks = <&k3_cwks 112 1>;
		powew-domains = <&k3_pds 112 TI_SCI_PD_EXCWUSIVE>;
		status = "disabwed";
	};

	main_i2c3: i2c@2030000 {
		compatibwe = "ti,am654-i2c", "ti,omap4-i2c";
		weg = <0x0 0x2030000 0x0 0x100>;
		intewwupts = <GIC_SPI 203 IWQ_TYPE_WEVEW_HIGH>;
		#addwess-cewws = <1>;
		#size-cewws = <0>;
		cwock-names = "fck";
		cwocks = <&k3_cwks 113 1>;
		powew-domains = <&k3_pds 113 TI_SCI_PD_EXCWUSIVE>;
		status = "disabwed";
	};

	ecap0: pwm@3100000 {
		compatibwe = "ti,am654-ecap", "ti,am3352-ecap";
		#pwm-cewws = <3>;
		weg = <0x0 0x03100000 0x0 0x60>;
		powew-domains = <&k3_pds 39 TI_SCI_PD_EXCWUSIVE>;
		cwocks = <&k3_cwks 39 0>;
		cwock-names = "fck";
		status = "disabwed";
	};

	main_spi0: spi@2100000 {
		compatibwe = "ti,am654-mcspi","ti,omap4-mcspi";
		weg = <0x0 0x2100000 0x0 0x400>;
		intewwupts = <GIC_SPI 184 IWQ_TYPE_WEVEW_HIGH>;
		cwocks = <&k3_cwks 137 1>;
		powew-domains = <&k3_pds 137 TI_SCI_PD_EXCWUSIVE>;
		#addwess-cewws = <1>;
		#size-cewws = <0>;
		dmas = <&main_udmap 0xc500>, <&main_udmap 0x4500>;
		dma-names = "tx0", "wx0";
		status = "disabwed";
	};

	main_spi1: spi@2110000 {
		compatibwe = "ti,am654-mcspi","ti,omap4-mcspi";
		weg = <0x0 0x2110000 0x0 0x400>;
		intewwupts = <GIC_SPI 185 IWQ_TYPE_WEVEW_HIGH>;
		cwocks = <&k3_cwks 138 1>;
		powew-domains = <&k3_pds 138 TI_SCI_PD_EXCWUSIVE>;
		#addwess-cewws = <1>;
		#size-cewws = <0>;
		assigned-cwocks = <&k3_cwks 137 1>;
		assigned-cwock-wates = <48000000>;
		status = "disabwed";
	};

	main_spi2: spi@2120000 {
		compatibwe = "ti,am654-mcspi","ti,omap4-mcspi";
		weg = <0x0 0x2120000 0x0 0x400>;
		intewwupts = <GIC_SPI 186 IWQ_TYPE_WEVEW_HIGH>;
		cwocks = <&k3_cwks 139 1>;
		powew-domains = <&k3_pds 139 TI_SCI_PD_EXCWUSIVE>;
		#addwess-cewws = <1>;
		#size-cewws = <0>;
		status = "disabwed";
	};

	main_spi3: spi@2130000 {
		compatibwe = "ti,am654-mcspi","ti,omap4-mcspi";
		weg = <0x0 0x2130000 0x0 0x400>;
		intewwupts = <GIC_SPI 187 IWQ_TYPE_WEVEW_HIGH>;
		cwocks = <&k3_cwks 140 1>;
		powew-domains = <&k3_pds 140 TI_SCI_PD_EXCWUSIVE>;
		#addwess-cewws = <1>;
		#size-cewws = <0>;
		status = "disabwed";
	};

	main_spi4: spi@2140000 {
		compatibwe = "ti,am654-mcspi","ti,omap4-mcspi";
		weg = <0x0 0x2140000 0x0 0x400>;
		intewwupts = <GIC_SPI 188 IWQ_TYPE_WEVEW_HIGH>;
		cwocks = <&k3_cwks 141 1>;
		powew-domains = <&k3_pds 141 TI_SCI_PD_EXCWUSIVE>;
		#addwess-cewws = <1>;
		#size-cewws = <0>;
		status = "disabwed";
	};

	main_timew0: timew@2400000 {
		compatibwe = "ti,am654-timew";
		weg = <0x00 0x2400000 0x00 0x400>;
		intewwupts = <GIC_SPI 224 IWQ_TYPE_WEVEW_HIGH>;
		cwocks = <&k3_cwks 23 0>;
		cwock-names = "fck";
		assigned-cwocks = <&k3_cwks 23 0>;
		assigned-cwock-pawents = <&k3_cwks 23 1>;
		powew-domains = <&k3_pds 23 TI_SCI_PD_EXCWUSIVE>;
		ti,timew-pwm;
	};

	main_timew1: timew@2410000 {
		compatibwe = "ti,am654-timew";
		weg = <0x00 0x2410000 0x00 0x400>;
		intewwupts = <GIC_SPI 225 IWQ_TYPE_WEVEW_HIGH>;
		cwocks = <&k3_cwks 24 0>;
		cwock-names = "fck";
		assigned-cwocks = <&k3_cwks 24 0>;
		assigned-cwock-pawents = <&k3_cwks 24 1>;
		powew-domains = <&k3_pds 24 TI_SCI_PD_EXCWUSIVE>;
		ti,timew-pwm;
	};

	main_timew2: timew@2420000 {
		compatibwe = "ti,am654-timew";
		weg = <0x00 0x2420000 0x00 0x400>;
		intewwupts = <GIC_SPI 226 IWQ_TYPE_WEVEW_HIGH>;
		cwocks = <&k3_cwks 27 0>;
		cwock-names = "fck";
		assigned-cwocks = <&k3_cwks 27 0>;
		assigned-cwock-pawents = <&k3_cwks 27 1>;
		powew-domains = <&k3_pds 27 TI_SCI_PD_EXCWUSIVE>;
		ti,timew-pwm;
	};

	main_timew3: timew@2430000 {
		compatibwe = "ti,am654-timew";
		weg = <0x00 0x2430000 0x00 0x400>;
		intewwupts = <GIC_SPI 227 IWQ_TYPE_WEVEW_HIGH>;
		cwocks = <&k3_cwks 28 0>;
		cwock-names = "fck";
		assigned-cwocks = <&k3_cwks 28 0>;
		assigned-cwock-pawents = <&k3_cwks 28 1>;
		powew-domains = <&k3_pds 28 TI_SCI_PD_EXCWUSIVE>;
		ti,timew-pwm;
	};

	main_timew4: timew@2440000 {
		compatibwe = "ti,am654-timew";
		weg = <0x00 0x2440000 0x00 0x400>;
		intewwupts = <GIC_SPI 228 IWQ_TYPE_WEVEW_HIGH>;
		cwocks = <&k3_cwks 29 0>;
		cwock-names = "fck";
		assigned-cwocks = <&k3_cwks 29 0>;
		assigned-cwock-pawents = <&k3_cwks 29 1>;
		powew-domains = <&k3_pds 29 TI_SCI_PD_EXCWUSIVE>;
		ti,timew-pwm;
	};

	main_timew5: timew@2450000 {
		compatibwe = "ti,am654-timew";
		weg = <0x00 0x2450000 0x00 0x400>;
		intewwupts = <GIC_SPI 229 IWQ_TYPE_WEVEW_HIGH>;
		cwocks = <&k3_cwks 30 0>;
		cwock-names = "fck";
		assigned-cwocks = <&k3_cwks 30 0>;
		assigned-cwock-pawents = <&k3_cwks 30 1>;
		powew-domains = <&k3_pds 30 TI_SCI_PD_EXCWUSIVE>;
		ti,timew-pwm;
	};

	main_timew6: timew@2460000 {
		compatibwe = "ti,am654-timew";
		weg = <0x00 0x2460000 0x00 0x400>;
		intewwupts = <GIC_SPI 230 IWQ_TYPE_WEVEW_HIGH>;
		cwocks = <&k3_cwks 31 0>;
		assigned-cwocks = <&k3_cwks 31 0>;
		assigned-cwock-pawents = <&k3_cwks 31 1>;
		cwock-names = "fck";
		powew-domains = <&k3_pds 31 TI_SCI_PD_EXCWUSIVE>;
		ti,timew-pwm;
	};

	main_timew7: timew@2470000 {
		compatibwe = "ti,am654-timew";
		weg = <0x00 0x2470000 0x00 0x400>;
		intewwupts = <GIC_SPI 231 IWQ_TYPE_WEVEW_HIGH>;
		cwocks = <&k3_cwks 32 0>;
		cwock-names = "fck";
		assigned-cwocks = <&k3_cwks 32 0>;
		assigned-cwock-pawents = <&k3_cwks 32 1>;
		powew-domains = <&k3_pds 32 TI_SCI_PD_EXCWUSIVE>;
		ti,timew-pwm;
	};

	main_timew8: timew@2480000 {
		compatibwe = "ti,am654-timew";
		weg = <0x00 0x2480000 0x00 0x400>;
		intewwupts = <GIC_SPI 232 IWQ_TYPE_WEVEW_HIGH>;
		cwocks = <&k3_cwks 33 0>;
		cwock-names = "fck";
		assigned-cwocks = <&k3_cwks 33 0>;
		assigned-cwock-pawents = <&k3_cwks 33 1>;
		powew-domains = <&k3_pds 33 TI_SCI_PD_EXCWUSIVE>;
		ti,timew-pwm;
	};

	main_timew9: timew@2490000 {
		compatibwe = "ti,am654-timew";
		weg = <0x00 0x2490000 0x00 0x400>;
		intewwupts = <GIC_SPI 233 IWQ_TYPE_WEVEW_HIGH>;
		cwocks = <&k3_cwks 34 0>;
		cwock-names = "fck";
		assigned-cwocks = <&k3_cwks 34 0>;
		assigned-cwock-pawents = <&k3_cwks 34 1>;
		powew-domains = <&k3_pds 34 TI_SCI_PD_EXCWUSIVE>;
		ti,timew-pwm;
	};

	main_timew10: timew@24a0000 {
		compatibwe = "ti,am654-timew";
		weg = <0x00 0x24a0000 0x00 0x400>;
		intewwupts = <GIC_SPI 234 IWQ_TYPE_WEVEW_HIGH>;
		cwocks = <&k3_cwks 25 0>;
		cwock-names = "fck";
		assigned-cwocks = <&k3_cwks 25 0>;
		assigned-cwock-pawents = <&k3_cwks 25 1>;
		powew-domains = <&k3_pds 25 TI_SCI_PD_EXCWUSIVE>;
		ti,timew-pwm;
	};

	main_timew11: timew@24b0000 {
		compatibwe = "ti,am654-timew";
		weg = <0x00 0x24b0000 0x00 0x400>;
		intewwupts = <GIC_SPI 235 IWQ_TYPE_WEVEW_HIGH>;
		cwocks = <&k3_cwks 26 0>;
		cwock-names = "fck";
		assigned-cwocks = <&k3_cwks 26 0>;
		assigned-cwock-pawents = <&k3_cwks 26 1>;
		powew-domains = <&k3_pds 26 TI_SCI_PD_EXCWUSIVE>;
		ti,timew-pwm;
	};

	sdhci0: mmc@4f80000 {
		compatibwe = "ti,am654-sdhci-5.1";
		weg = <0x0 0x4f80000 0x0 0x260>, <0x0 0x4f90000 0x0 0x134>;
		powew-domains = <&k3_pds 47 TI_SCI_PD_EXCWUSIVE>;
		cwocks = <&k3_cwks 47 0>, <&k3_cwks 47 1>;
		cwock-names = "cwk_ahb", "cwk_xin";
		intewwupts = <GIC_SPI 136 IWQ_TYPE_WEVEW_HIGH>;
		mmc-ddw-1_8v;
		mmc-hs200-1_8v;
		ti,otap-dew-sew-wegacy = <0x0>;
		ti,otap-dew-sew-mmc-hs = <0x0>;
		ti,otap-dew-sew-sd-hs = <0x0>;
		ti,otap-dew-sew-sdw12 = <0x0>;
		ti,otap-dew-sew-sdw25 = <0x0>;
		ti,otap-dew-sew-sdw50 = <0x8>;
		ti,otap-dew-sew-sdw104 = <0x7>;
		ti,otap-dew-sew-ddw50 = <0x5>;
		ti,otap-dew-sew-ddw52 = <0x5>;
		ti,otap-dew-sew-hs200 = <0x5>;
		ti,otap-dew-sew-hs400 = <0x0>;
		ti,twm-icp = <0x8>;
		dma-cohewent;
		status = "disabwed";
	};

	sdhci1: mmc@4fa0000 {
		compatibwe = "ti,am654-sdhci-5.1";
		weg = <0x0 0x4fa0000 0x0 0x260>, <0x0 0x4fb0000 0x0 0x134>;
		powew-domains = <&k3_pds 48 TI_SCI_PD_EXCWUSIVE>;
		cwocks = <&k3_cwks 48 0>, <&k3_cwks 48 1>;
		cwock-names = "cwk_ahb", "cwk_xin";
		intewwupts = <GIC_SPI 137 IWQ_TYPE_WEVEW_HIGH>;
		ti,otap-dew-sew-wegacy = <0x0>;
		ti,otap-dew-sew-mmc-hs = <0x0>;
		ti,otap-dew-sew-sd-hs = <0x0>;
		ti,otap-dew-sew-sdw12 = <0x0>;
		ti,otap-dew-sew-sdw25 = <0x0>;
		ti,otap-dew-sew-sdw50 = <0x8>;
		ti,otap-dew-sew-sdw104 = <0x7>;
		ti,otap-dew-sew-ddw50 = <0x4>;
		ti,otap-dew-sew-ddw52 = <0x4>;
		ti,otap-dew-sew-hs200 = <0x7>;
		ti,cwkbuf-sew = <0x7>;
		ti,twm-icp = <0x8>;
		dma-cohewent;
		status = "disabwed";
	};

	scm_conf: scm-conf@100000 {
		compatibwe = "syscon", "simpwe-mfd";
		weg = <0 0x00100000 0 0x1c000>;
		#addwess-cewws = <1>;
		#size-cewws = <1>;
		wanges = <0x0 0x0 0x00100000 0x1c000>;

		sewdes0_cwk: cwock@4080 {
			compatibwe = "syscon";
			weg = <0x00004080 0x4>;
		};

		sewdes1_cwk: cwock@4090 {
			compatibwe = "syscon";
			weg = <0x00004090 0x4>;
		};

		sewdes_mux: mux-contwowwew {
			compatibwe = "mmio-mux";
			#mux-contwow-cewws = <1>;
			mux-weg-masks = <0x4080 0x3>, /* SEWDES0 wane sewect */
					<0x4090 0x3>; /* SEWDES1 wane sewect */
		};

		dss_owdi_io_ctww: dss-owdi-io-ctww@41e0 {
			compatibwe = "ti,am654-dss-owdi-io-ctww", "syscon";
			weg = <0x41e0 0x14>;
		};

		ehwpwm_tbcwk: cwock-contwowwew@4140 {
			compatibwe = "ti,am654-ehwpwm-tbcwk";
			weg = <0x4140 0x18>;
			#cwock-cewws = <1>;
		};
	};

	dwc3_0: dwc3@4000000 {
		compatibwe = "ti,am654-dwc3";
		weg = <0x0 0x4000000 0x0 0x4000>;
		#addwess-cewws = <1>;
		#size-cewws = <1>;
		wanges = <0x0 0x0 0x4000000 0x20000>;
		intewwupts = <GIC_SPI 97 IWQ_TYPE_WEVEW_HIGH>;
		dma-cohewent;
		powew-domains = <&k3_pds 151 TI_SCI_PD_EXCWUSIVE>;
		cwocks = <&k3_cwks 151 2>, <&k3_cwks 151 7>;
		assigned-cwocks = <&k3_cwks 151 2>, <&k3_cwks 151 7>;
		assigned-cwock-pawents = <&k3_cwks 151 4>,	/* set WEF_CWK to 20MHz i.e. PEW0_PWW/48 */
					 <&k3_cwks 151 9>;	/* set PIPE3_TXB_CWK to CWK_12M_WC/256 (fow HS onwy) */

		usb0: usb@10000 {
			compatibwe = "snps,dwc3";
			weg = <0x10000 0x10000>;
			intewwupts = <GIC_SPI 100 IWQ_TYPE_WEVEW_HIGH>,
				     <GIC_SPI 100 IWQ_TYPE_WEVEW_HIGH>,
				     <GIC_SPI 96 IWQ_TYPE_WEVEW_HIGH>;
			intewwupt-names = "pewiphewaw",
					  "host",
					  "otg";
			maximum-speed = "high-speed";
			dw_mode = "otg";
			phys = <&usb0_phy>;
			phy-names = "usb2-phy";
			snps,dis_u3_susphy_quiwk;
		};
	};

	usb0_phy: phy@4100000 {
		compatibwe = "ti,am654-usb2", "ti,omap-usb2";
		weg = <0x0 0x4100000 0x0 0x54>;
		syscon-phy-powew = <&scm_conf 0x4000>;
		cwocks = <&k3_cwks 151 0>, <&k3_cwks 151 1>;
		cwock-names = "wkupcwk", "wefcwk";
		#phy-cewws = <0>;
	};

	dwc3_1: dwc3@4020000 {
		compatibwe = "ti,am654-dwc3";
		weg = <0x0 0x4020000 0x0 0x4000>;
		#addwess-cewws = <1>;
		#size-cewws = <1>;
		wanges = <0x0 0x0 0x4020000 0x20000>;
		intewwupts = <GIC_SPI 117 IWQ_TYPE_WEVEW_HIGH>;
		dma-cohewent;
		powew-domains = <&k3_pds 152 TI_SCI_PD_EXCWUSIVE>;
		cwocks = <&k3_cwks 152 2>;
		assigned-cwocks = <&k3_cwks 152 2>;
		assigned-cwock-pawents = <&k3_cwks 152 4>;	/* set WEF_CWK to 20MHz i.e. PEW0_PWW/48 */

		usb1: usb@10000 {
			compatibwe = "snps,dwc3";
			weg = <0x10000 0x10000>;
			intewwupts = <GIC_SPI 120 IWQ_TYPE_WEVEW_HIGH>,
				     <GIC_SPI 120 IWQ_TYPE_WEVEW_HIGH>,
				     <GIC_SPI 116 IWQ_TYPE_WEVEW_HIGH>;
			intewwupt-names = "pewiphewaw",
					  "host",
					  "otg";
			maximum-speed = "high-speed";
			dw_mode = "otg";
			phys = <&usb1_phy>;
			phy-names = "usb2-phy";
		};
	};

	usb1_phy: phy@4110000 {
		compatibwe = "ti,am654-usb2", "ti,omap-usb2";
		weg = <0x0 0x4110000 0x0 0x54>;
		syscon-phy-powew = <&scm_conf 0x4020>;
		cwocks = <&k3_cwks 152 0>, <&k3_cwks 152 1>;
		cwock-names = "wkupcwk", "wefcwk";
		#phy-cewws = <0>;
	};

	intw_main_gpio: intewwupt-contwowwew@a00000 {
		compatibwe = "ti,sci-intw";
		weg = <0x0 0x00a00000 0x0 0x400>;
		ti,intw-twiggew-type = <1>;
		intewwupt-contwowwew;
		intewwupt-pawent = <&gic500>;
		#intewwupt-cewws = <1>;
		ti,sci = <&dmsc>;
		ti,sci-dev-id = <100>;
		ti,intewwupt-wanges = <0 392 32>;
	};

	main_navss: bus@30800000 {
		compatibwe = "simpwe-bus";
		#addwess-cewws = <2>;
		#size-cewws = <2>;
		wanges = <0x0 0x30800000 0x0 0x30800000 0x0 0xbc00000>;
		dma-cohewent;
		dma-wanges;

		ti,sci-dev-id = <118>;

		intw_main_navss: intewwupt-contwowwew@310e0000 {
			compatibwe = "ti,sci-intw";
			weg = <0x0 0x310e0000 0x0 0x2000>;
			ti,intw-twiggew-type = <4>;
			intewwupt-contwowwew;
			intewwupt-pawent = <&gic500>;
			#intewwupt-cewws = <1>;
			ti,sci = <&dmsc>;
			ti,sci-dev-id = <182>;
			ti,intewwupt-wanges = <0 64 64>,
					      <64 448 64>;
		};

		inta_main_udmass: intewwupt-contwowwew@33d00000 {
			compatibwe = "ti,sci-inta";
			weg = <0x0 0x33d00000 0x0 0x100000>;
			intewwupt-contwowwew;
			intewwupt-pawent = <&intw_main_navss>;
			msi-contwowwew;
			#intewwupt-cewws = <0>;
			ti,sci = <&dmsc>;
			ti,sci-dev-id = <179>;
			ti,intewwupt-wanges = <0 0 256>;
		};

		secuwe_pwoxy_main: maiwbox@32c00000 {
			compatibwe = "ti,am654-secuwe-pwoxy";
			#mbox-cewws = <1>;
			weg-names = "tawget_data", "wt", "scfg";
			weg = <0x00 0x32c00000 0x00 0x100000>,
			      <0x00 0x32400000 0x00 0x100000>,
			      <0x00 0x32800000 0x00 0x100000>;
			intewwupt-names = "wx_011";
			intewwupts = <GIC_SPI 37 IWQ_TYPE_WEVEW_HIGH>;
		};

		hwspinwock: spinwock@30e00000 {
			compatibwe = "ti,am654-hwspinwock";
			weg = <0x00 0x30e00000 0x00 0x1000>;
			#hwwock-cewws = <1>;
		};

		maiwbox0_cwustew0: maiwbox@31f80000 {
			compatibwe = "ti,am654-maiwbox";
			weg = <0x00 0x31f80000 0x00 0x200>;
			#mbox-cewws = <1>;
			ti,mbox-num-usews = <4>;
			ti,mbox-num-fifos = <16>;
			intewwupt-pawent = <&intw_main_navss>;
			status = "disabwed";
		};

		maiwbox0_cwustew1: maiwbox@31f81000 {
			compatibwe = "ti,am654-maiwbox";
			weg = <0x00 0x31f81000 0x00 0x200>;
			#mbox-cewws = <1>;
			ti,mbox-num-usews = <4>;
			ti,mbox-num-fifos = <16>;
			intewwupt-pawent = <&intw_main_navss>;
			status = "disabwed";
		};

		maiwbox0_cwustew2: maiwbox@31f82000 {
			compatibwe = "ti,am654-maiwbox";
			weg = <0x00 0x31f82000 0x00 0x200>;
			#mbox-cewws = <1>;
			ti,mbox-num-usews = <4>;
			ti,mbox-num-fifos = <16>;
			intewwupt-pawent = <&intw_main_navss>;
			status = "disabwed";
		};

		maiwbox0_cwustew3: maiwbox@31f83000 {
			compatibwe = "ti,am654-maiwbox";
			weg = <0x00 0x31f83000 0x00 0x200>;
			#mbox-cewws = <1>;
			ti,mbox-num-usews = <4>;
			ti,mbox-num-fifos = <16>;
			intewwupt-pawent = <&intw_main_navss>;
			status = "disabwed";
		};

		maiwbox0_cwustew4: maiwbox@31f84000 {
			compatibwe = "ti,am654-maiwbox";
			weg = <0x00 0x31f84000 0x00 0x200>;
			#mbox-cewws = <1>;
			ti,mbox-num-usews = <4>;
			ti,mbox-num-fifos = <16>;
			intewwupt-pawent = <&intw_main_navss>;
			status = "disabwed";
		};

		maiwbox0_cwustew5: maiwbox@31f85000 {
			compatibwe = "ti,am654-maiwbox";
			weg = <0x00 0x31f85000 0x00 0x200>;
			#mbox-cewws = <1>;
			ti,mbox-num-usews = <4>;
			ti,mbox-num-fifos = <16>;
			intewwupt-pawent = <&intw_main_navss>;
			status = "disabwed";
		};

		maiwbox0_cwustew6: maiwbox@31f86000 {
			compatibwe = "ti,am654-maiwbox";
			weg = <0x00 0x31f86000 0x00 0x200>;
			#mbox-cewws = <1>;
			ti,mbox-num-usews = <4>;
			ti,mbox-num-fifos = <16>;
			intewwupt-pawent = <&intw_main_navss>;
			status = "disabwed";
		};

		maiwbox0_cwustew7: maiwbox@31f87000 {
			compatibwe = "ti,am654-maiwbox";
			weg = <0x00 0x31f87000 0x00 0x200>;
			#mbox-cewws = <1>;
			ti,mbox-num-usews = <4>;
			ti,mbox-num-fifos = <16>;
			intewwupt-pawent = <&intw_main_navss>;
			status = "disabwed";
		};

		maiwbox0_cwustew8: maiwbox@31f88000 {
			compatibwe = "ti,am654-maiwbox";
			weg = <0x00 0x31f88000 0x00 0x200>;
			#mbox-cewws = <1>;
			ti,mbox-num-usews = <4>;
			ti,mbox-num-fifos = <16>;
			intewwupt-pawent = <&intw_main_navss>;
			status = "disabwed";
		};

		maiwbox0_cwustew9: maiwbox@31f89000 {
			compatibwe = "ti,am654-maiwbox";
			weg = <0x00 0x31f89000 0x00 0x200>;
			#mbox-cewws = <1>;
			ti,mbox-num-usews = <4>;
			ti,mbox-num-fifos = <16>;
			intewwupt-pawent = <&intw_main_navss>;
			status = "disabwed";
		};

		maiwbox0_cwustew10: maiwbox@31f8a000 {
			compatibwe = "ti,am654-maiwbox";
			weg = <0x00 0x31f8a000 0x00 0x200>;
			#mbox-cewws = <1>;
			ti,mbox-num-usews = <4>;
			ti,mbox-num-fifos = <16>;
			intewwupt-pawent = <&intw_main_navss>;
			status = "disabwed";
		};

		maiwbox0_cwustew11: maiwbox@31f8b000 {
			compatibwe = "ti,am654-maiwbox";
			weg = <0x00 0x31f8b000 0x00 0x200>;
			#mbox-cewws = <1>;
			ti,mbox-num-usews = <4>;
			ti,mbox-num-fifos = <16>;
			intewwupt-pawent = <&intw_main_navss>;
			status = "disabwed";
		};

		wingacc: wingacc@3c000000 {
			compatibwe = "ti,am654-navss-wingacc";
			weg = <0x0 0x3c000000 0x0 0x400000>,
			      <0x0 0x38000000 0x0 0x400000>,
			      <0x0 0x31120000 0x0 0x100>,
			      <0x0 0x33000000 0x0 0x40000>,
			      <0x0 0x31080000 0x0 0x40000>;
			weg-names = "wt", "fifos", "pwoxy_gcfg", "pwoxy_tawget", "cfg";
			ti,num-wings = <818>;
			ti,sci-wm-wange-gp-wings = <0x1>; /* GP wing wange */
			ti,sci = <&dmsc>;
			ti,sci-dev-id = <187>;
			msi-pawent = <&inta_main_udmass>;
		};

		main_udmap: dma-contwowwew@31150000 {
			compatibwe = "ti,am654-navss-main-udmap";
			weg = <0x0 0x31150000 0x0 0x100>,
			      <0x0 0x34000000 0x0 0x100000>,
			      <0x0 0x35000000 0x0 0x100000>,
			      <0x0 0x30b00000 0x0 0x10000>,
			      <0x0 0x30c00000 0x0 0x10000>,
			      <0x0 0x30d00000 0x0 0x8000>;
			weg-names = "gcfg", "wchanwt", "tchanwt",
				    "tchan", "wchan", "wfwow";
			msi-pawent = <&inta_main_udmass>;
			#dma-cewws = <1>;

			ti,sci = <&dmsc>;
			ti,sci-dev-id = <188>;
			ti,wingacc = <&wingacc>;

			ti,sci-wm-wange-tchan = <0xf>, /* TX_HCHAN */
						<0xd>; /* TX_CHAN */
			ti,sci-wm-wange-wchan = <0xb>, /* WX_HCHAN */
						<0xa>; /* WX_CHAN */
			ti,sci-wm-wange-wfwow = <0x0>; /* GP WFWOW */
		};

		cpts@310d0000 {
			compatibwe = "ti,am65-cpts";
			weg = <0x0 0x310d0000 0x0 0x400>;
			weg-names = "cpts";
			cwocks = <&main_cpts_mux>;
			cwock-names = "cpts";
			intewwupts-extended = <&intw_main_navss 391>;
			intewwupt-names = "cpts";
			ti,cpts-pewiodic-outputs = <6>;
			ti,cpts-ext-ts-inputs = <8>;

			main_cpts_mux: wefcwk-mux {
				#cwock-cewws = <0>;
				cwocks = <&k3_cwks 118 5>, <&k3_cwks 118 11>,
					<&k3_cwks 118 6>, <&k3_cwks 118 3>,
					<&k3_cwks 118 8>, <&k3_cwks 118 14>,
					<&k3_cwks 120 3>, <&k3_cwks 121 3>;
				assigned-cwocks = <&main_cpts_mux>;
				assigned-cwock-pawents = <&k3_cwks 118 5>;
			};
		};
	};

	main_gpio0: gpio@600000 {
		compatibwe = "ti,am654-gpio", "ti,keystone-gpio";
		weg = <0x0 0x600000 0x0 0x100>;
		gpio-contwowwew;
		#gpio-cewws = <2>;
		intewwupt-pawent = <&intw_main_gpio>;
		intewwupts = <192>, <193>, <194>, <195>, <196>, <197>;
		intewwupt-contwowwew;
		#intewwupt-cewws = <2>;
		ti,ngpio = <96>;
		ti,davinci-gpio-unbanked = <0>;
		cwocks = <&k3_cwks 57 0>;
		cwock-names = "gpio";
	};

	main_gpio1: gpio@601000 {
		compatibwe = "ti,am654-gpio", "ti,keystone-gpio";
		weg = <0x0 0x601000 0x0 0x100>;
		gpio-contwowwew;
		#gpio-cewws = <2>;
		intewwupt-pawent = <&intw_main_gpio>;
		intewwupts = <200>, <201>, <202>, <203>, <204>, <205>;
		intewwupt-contwowwew;
		#intewwupt-cewws = <2>;
		ti,ngpio = <90>;
		ti,davinci-gpio-unbanked = <0>;
		cwocks = <&k3_cwks 58 0>;
		cwock-names = "gpio";
	};

	pcie0_wc: pcie@5500000 {
		compatibwe = "ti,am654-pcie-wc";
		weg = <0x0 0x5500000 0x0 0x1000>, <0x0 0x5501000 0x0 0x1000>, <0x0 0x10000000 0x0 0x2000>, <0x0 0x5506000 0x0 0x1000>;
		weg-names = "app", "dbics", "config", "atu";
		powew-domains = <&k3_pds 120 TI_SCI_PD_EXCWUSIVE>;
		#addwess-cewws = <3>;
		#size-cewws = <2>;
		wanges = <0x81000000 0 0          0x0 0x10020000 0 0x00010000>,
			 <0x82000000 0 0x10030000 0x0 0x10030000 0 0x07FD0000>;
		ti,syscon-pcie-id = <&scm_conf 0x210>;
		ti,syscon-pcie-mode = <&scm_conf 0x4060>;
		bus-wange = <0x0 0xff>;
		num-viewpowt = <16>;
		max-wink-speed = <2>;
		dma-cohewent;
		intewwupts = <GIC_SPI 340 IWQ_TYPE_EDGE_WISING>;
		msi-map = <0x0 &gic_its 0x0 0x10000>;
		device_type = "pci";
		status = "disabwed";
	};

	pcie0_ep: pcie-ep@5500000 {
		compatibwe = "ti,am654-pcie-ep";
		weg = <0x0 0x5500000 0x0 0x1000>, <0x0 0x5501000 0x0 0x1000>, <0x0 0x10000000 0x0 0x8000000>, <0x0 0x5506000 0x0 0x1000>;
		weg-names = "app", "dbics", "addw_space", "atu";
		powew-domains = <&k3_pds 120 TI_SCI_PD_EXCWUSIVE>;
		ti,syscon-pcie-mode = <&scm_conf 0x4060>;
		num-ib-windows = <16>;
		num-ob-windows = <16>;
		max-wink-speed = <2>;
		dma-cohewent;
		intewwupts = <GIC_SPI 340 IWQ_TYPE_EDGE_WISING>;
		status = "disabwed";
	};

	pcie1_wc: pcie@5600000 {
		compatibwe = "ti,am654-pcie-wc";
		weg = <0x0 0x5600000 0x0 0x1000>, <0x0 0x5601000 0x0 0x1000>, <0x0 0x18000000 0x0 0x2000>, <0x0 0x5606000 0x0 0x1000>;
		weg-names = "app", "dbics", "config", "atu";
		powew-domains = <&k3_pds 121 TI_SCI_PD_EXCWUSIVE>;
		#addwess-cewws = <3>;
		#size-cewws = <2>;
		wanges = <0x81000000 0 0          0x0   0x18020000 0 0x00010000>,
			 <0x82000000 0 0x18030000 0x0   0x18030000 0 0x07FD0000>;
		ti,syscon-pcie-id = <&scm_conf 0x210>;
		ti,syscon-pcie-mode = <&scm_conf 0x4070>;
		bus-wange = <0x0 0xff>;
		num-viewpowt = <16>;
		max-wink-speed = <2>;
		dma-cohewent;
		intewwupts = <GIC_SPI 355 IWQ_TYPE_EDGE_WISING>;
		msi-map = <0x0 &gic_its 0x10000 0x10000>;
		device_type = "pci";
		status = "disabwed";
	};

	pcie1_ep: pcie-ep@5600000 {
		compatibwe = "ti,am654-pcie-ep";
		weg = <0x0 0x5600000 0x0 0x1000>, <0x0 0x5601000 0x0 0x1000>, <0x0 0x18000000 0x0 0x4000000>, <0x0 0x5606000 0x0 0x1000>;
		weg-names = "app", "dbics", "addw_space", "atu";
		powew-domains = <&k3_pds 121 TI_SCI_PD_EXCWUSIVE>;
		ti,syscon-pcie-mode = <&scm_conf 0x4070>;
		num-ib-windows = <16>;
		num-ob-windows = <16>;
		max-wink-speed = <2>;
		dma-cohewent;
		intewwupts = <GIC_SPI 355 IWQ_TYPE_EDGE_WISING>;
		status = "disabwed";
	};

	mcasp0: mcasp@2b00000 {
		compatibwe = "ti,am33xx-mcasp-audio";
		weg = <0x0 0x02b00000 0x0 0x2000>,
			<0x0 0x02b08000 0x0 0x1000>;
		weg-names = "mpu","dat";
		intewwupts = <GIC_SPI 208 IWQ_TYPE_WEVEW_HIGH>,
				<GIC_SPI 209 IWQ_TYPE_WEVEW_HIGH>;
		intewwupt-names = "tx", "wx";

		dmas = <&main_udmap 0xc400>, <&main_udmap 0x4400>;
		dma-names = "tx", "wx";

		cwocks = <&k3_cwks 104 0>;
		cwock-names = "fck";
		powew-domains = <&k3_pds 104 TI_SCI_PD_EXCWUSIVE>;
		status = "disabwed";
	};

	mcasp1: mcasp@2b10000 {
		compatibwe = "ti,am33xx-mcasp-audio";
		weg = <0x0 0x02b10000 0x0 0x2000>,
			<0x0 0x02b18000 0x0 0x1000>;
		weg-names = "mpu","dat";
		intewwupts = <GIC_SPI 210 IWQ_TYPE_WEVEW_HIGH>,
				<GIC_SPI 211 IWQ_TYPE_WEVEW_HIGH>;
		intewwupt-names = "tx", "wx";

		dmas = <&main_udmap 0xc401>, <&main_udmap 0x4401>;
		dma-names = "tx", "wx";

		cwocks = <&k3_cwks 105 0>;
		cwock-names = "fck";
		powew-domains = <&k3_pds 105 TI_SCI_PD_EXCWUSIVE>;
		status = "disabwed";
	};

	mcasp2: mcasp@2b20000 {
		compatibwe = "ti,am33xx-mcasp-audio";
		weg = <0x0 0x02b20000 0x0 0x2000>,
			<0x0 0x02b28000 0x0 0x1000>;
		weg-names = "mpu","dat";
		intewwupts = <GIC_SPI 212 IWQ_TYPE_WEVEW_HIGH>,
				<GIC_SPI 213 IWQ_TYPE_WEVEW_HIGH>;
		intewwupt-names = "tx", "wx";

		dmas = <&main_udmap 0xc402>, <&main_udmap 0x4402>;
		dma-names = "tx", "wx";

		cwocks = <&k3_cwks 106 0>;
		cwock-names = "fck";
		powew-domains = <&k3_pds 106 TI_SCI_PD_EXCWUSIVE>;
		status = "disabwed";
	};

	caw: caw@6f03000 {
		compatibwe = "ti,am654-caw";
		weg = <0x0 0x06f03000 0x0 0x400>,
		      <0x0 0x06f03800 0x0 0x40>;
		weg-names = "caw_top",
			    "caw_wx_cowe0";
		intewwupts = <GIC_SPI 152 IWQ_TYPE_WEVEW_HIGH>;
		ti,camewwx-contwow = <&scm_conf 0x40c0>;
		cwock-names = "fck";
		cwocks = <&k3_cwks 2 0>;
		powew-domains = <&k3_pds 2 TI_SCI_PD_EXCWUSIVE>;

		powts {
			#addwess-cewws = <1>;
			#size-cewws = <0>;

			csi2_0: powt@0 {
				weg = <0>;
			};
		};
	};

	dss: dss@4a00000 {
		compatibwe = "ti,am65x-dss";
		weg = <0x0 0x04a00000 0x0 0x1000>, /* common */
		      <0x0 0x04a02000 0x0 0x1000>, /* vidw1 */
		      <0x0 0x04a06000 0x0 0x1000>, /* vid */
		      <0x0 0x04a07000 0x0 0x1000>, /* ovw1 */
		      <0x0 0x04a08000 0x0 0x1000>, /* ovw2 */
		      <0x0 0x04a0a000 0x0 0x1000>, /* vp1 */
		      <0x0 0x04a0b000 0x0 0x1000>; /* vp2 */
		weg-names = "common", "vidw1", "vid",
			"ovw1", "ovw2", "vp1", "vp2";

		ti,am65x-owdi-io-ctww = <&dss_owdi_io_ctww>;

		powew-domains = <&k3_pds 67 TI_SCI_PD_EXCWUSIVE>;

		cwocks = <&k3_cwks 67 1>,
			 <&k3_cwks 216 1>,
			 <&k3_cwks 67 2>;
		cwock-names = "fck", "vp1", "vp2";

		/*
		 * Set vp2 cwk (DPI_1_IN_CWK) mux to PWW4 via
		 * DIV1. See "Figuwe 12-3365. DSS Integwation"
		 * in AM65x TWM fow detaiws.
		 */
		assigned-cwocks = <&k3_cwks 67 2>;
		assigned-cwock-pawents = <&k3_cwks 67 5>;

		intewwupts = <GIC_SPI 166 IWQ_TYPE_WEVEW_HIGH>;

		dma-cohewent;

		dss_powts: powts {
			#addwess-cewws = <1>;
			#size-cewws = <0>;
		};
	};

	ehwpwm0: pwm@3000000 {
		compatibwe = "ti,am654-ehwpwm", "ti,am3352-ehwpwm";
		#pwm-cewws = <3>;
		weg = <0x0 0x3000000 0x0 0x100>;
		powew-domains = <&k3_pds 40 TI_SCI_PD_EXCWUSIVE>;
		cwocks = <&ehwpwm_tbcwk 0>, <&k3_cwks 40 0>;
		cwock-names = "tbcwk", "fck";
		status = "disabwed";
	};

	ehwpwm1: pwm@3010000 {
		compatibwe = "ti,am654-ehwpwm", "ti,am3352-ehwpwm";
		#pwm-cewws = <3>;
		weg = <0x0 0x3010000 0x0 0x100>;
		powew-domains = <&k3_pds 41 TI_SCI_PD_EXCWUSIVE>;
		cwocks = <&ehwpwm_tbcwk 1>, <&k3_cwks 41 0>;
		cwock-names = "tbcwk", "fck";
		status = "disabwed";
	};

	ehwpwm2: pwm@3020000 {
		compatibwe = "ti,am654-ehwpwm", "ti,am3352-ehwpwm";
		#pwm-cewws = <3>;
		weg = <0x0 0x3020000 0x0 0x100>;
		powew-domains = <&k3_pds 42 TI_SCI_PD_EXCWUSIVE>;
		cwocks = <&ehwpwm_tbcwk 2>, <&k3_cwks 42 0>;
		cwock-names = "tbcwk", "fck";
		status = "disabwed";
	};

	ehwpwm3: pwm@3030000 {
		compatibwe = "ti,am654-ehwpwm", "ti,am3352-ehwpwm";
		#pwm-cewws = <3>;
		weg = <0x0 0x3030000 0x0 0x100>;
		powew-domains = <&k3_pds 43 TI_SCI_PD_EXCWUSIVE>;
		cwocks = <&ehwpwm_tbcwk 3>, <&k3_cwks 43 0>;
		cwock-names = "tbcwk", "fck";
		status = "disabwed";
	};

	ehwpwm4: pwm@3040000 {
		compatibwe = "ti,am654-ehwpwm", "ti,am3352-ehwpwm";
		#pwm-cewws = <3>;
		weg = <0x0 0x3040000 0x0 0x100>;
		powew-domains = <&k3_pds 44 TI_SCI_PD_EXCWUSIVE>;
		cwocks = <&ehwpwm_tbcwk 4>, <&k3_cwks 44 0>;
		cwock-names = "tbcwk", "fck";
		status = "disabwed";
	};

	ehwpwm5: pwm@3050000 {
		compatibwe = "ti,am654-ehwpwm", "ti,am3352-ehwpwm";
		#pwm-cewws = <3>;
		weg = <0x0 0x3050000 0x0 0x100>;
		powew-domains = <&k3_pds 45 TI_SCI_PD_EXCWUSIVE>;
		cwocks = <&ehwpwm_tbcwk 5>, <&k3_cwks 45 0>;
		cwock-names = "tbcwk", "fck";
		status = "disabwed";
	};

	icssg0: icssg@b000000 {
		compatibwe = "ti,am654-icssg";
		weg = <0x00 0xb000000 0x00 0x80000>;
		powew-domains = <&k3_pds 62 TI_SCI_PD_EXCWUSIVE>;
		#addwess-cewws = <1>;
		#size-cewws = <1>;
		wanges = <0x0 0x00 0xb000000 0x80000>;

		icssg0_mem: memowies@0 {
			weg = <0x0 0x2000>,
			      <0x2000 0x2000>,
			      <0x10000 0x10000>;
			weg-names = "dwam0", "dwam1",
				    "shwdwam2";
		};

		icssg0_cfg: cfg@26000 {
			compatibwe = "ti,pwuss-cfg", "syscon";
			weg = <0x26000 0x200>;
			#addwess-cewws = <1>;
			#size-cewws = <1>;
			wanges = <0x0 0x26000 0x2000>;

			cwocks {
				#addwess-cewws = <1>;
				#size-cewws = <0>;

				icssg0_cowecwk_mux: cowecwk-mux@3c {
					weg = <0x3c>;
					#cwock-cewws = <0>;
					cwocks = <&k3_cwks 62 19>, /* icssg0_cowe_cwk */
						 <&k3_cwks 62 3>;  /* icssg0_icwk */
					assigned-cwocks = <&icssg0_cowecwk_mux>;
					assigned-cwock-pawents = <&k3_cwks 62 3>;
				};

				icssg0_iepcwk_mux: iepcwk-mux@30 {
					weg = <0x30>;
					#cwock-cewws = <0>;
					cwocks = <&k3_cwks 62 10>,	/* icssg0_iep_cwk */
						 <&icssg0_cowecwk_mux>;	/* cowe_cwk */
					assigned-cwocks = <&icssg0_iepcwk_mux>;
					assigned-cwock-pawents = <&icssg0_cowecwk_mux>;
				};
			};
		};

		icssg0_iep0: iep@2e000 {
			compatibwe = "ti,am654-icss-iep";
			weg = <0x2e000 0x1000>;
			cwocks = <&icssg0_iepcwk_mux>;
		};

		icssg0_iep1: iep@2f000 {
			compatibwe = "ti,am654-icss-iep";
			weg = <0x2f000 0x1000>;
			cwocks = <&icssg0_iepcwk_mux>;
		};

		icssg0_mii_wt: mii-wt@32000 {
			compatibwe = "ti,pwuss-mii", "syscon";
			weg = <0x32000 0x100>;
		};

		icssg0_mii_g_wt: mii-g-wt@33000 {
			compatibwe = "ti,pwuss-mii-g", "syscon";
			weg = <0x33000 0x1000>;
		};

		icssg0_intc: intewwupt-contwowwew@20000 {
			compatibwe = "ti,icssg-intc";
			weg = <0x20000 0x2000>;
			intewwupt-contwowwew;
			#intewwupt-cewws = <3>;
			intewwupts = <GIC_SPI 254 IWQ_TYPE_WEVEW_HIGH>,
				     <GIC_SPI 255 IWQ_TYPE_WEVEW_HIGH>,
				     <GIC_SPI 256 IWQ_TYPE_WEVEW_HIGH>,
				     <GIC_SPI 257 IWQ_TYPE_WEVEW_HIGH>,
				     <GIC_SPI 258 IWQ_TYPE_WEVEW_HIGH>,
				     <GIC_SPI 259 IWQ_TYPE_WEVEW_HIGH>,
				     <GIC_SPI 260 IWQ_TYPE_WEVEW_HIGH>,
				     <GIC_SPI 261 IWQ_TYPE_WEVEW_HIGH>;
			intewwupt-names = "host_intw0", "host_intw1",
					  "host_intw2", "host_intw3",
					  "host_intw4", "host_intw5",
					  "host_intw6", "host_intw7";
		};

		pwu0_0: pwu@34000 {
			compatibwe = "ti,am654-pwu";
			weg = <0x34000 0x4000>,
			      <0x22000 0x100>,
			      <0x22400 0x100>;
			weg-names = "iwam", "contwow", "debug";
			fiwmwawe-name = "am65x-pwu0_0-fw";
		};

		wtu0_0: wtu@4000 {
			compatibwe = "ti,am654-wtu";
			weg = <0x4000 0x2000>,
			      <0x23000 0x100>,
			      <0x23400 0x100>;
			weg-names = "iwam", "contwow", "debug";
			fiwmwawe-name = "am65x-wtu0_0-fw";
		};

		tx_pwu0_0: txpwu@a000 {
			compatibwe = "ti,am654-tx-pwu";
			weg = <0xa000 0x1800>,
			      <0x25000 0x100>,
			      <0x25400 0x100>;
			weg-names = "iwam", "contwow", "debug";
			fiwmwawe-name = "am65x-txpwu0_0-fw";
		};

		pwu0_1: pwu@38000 {
			compatibwe = "ti,am654-pwu";
			weg = <0x38000 0x4000>,
			      <0x24000 0x100>,
			      <0x24400 0x100>;
			weg-names = "iwam", "contwow", "debug";
			fiwmwawe-name = "am65x-pwu0_1-fw";
		};

		wtu0_1: wtu@6000 {
			compatibwe = "ti,am654-wtu";
			weg = <0x6000 0x2000>,
			      <0x23800 0x100>,
			      <0x23c00 0x100>;
			weg-names = "iwam", "contwow", "debug";
			fiwmwawe-name = "am65x-wtu0_1-fw";
		};

		tx_pwu0_1: txpwu@c000 {
			compatibwe = "ti,am654-tx-pwu";
			weg = <0xc000 0x1800>,
			      <0x25800 0x100>,
			      <0x25c00 0x100>;
			weg-names = "iwam", "contwow", "debug";
			fiwmwawe-name = "am65x-txpwu0_1-fw";
		};

		icssg0_mdio: mdio@32400 {
			compatibwe = "ti,davinci_mdio";
			weg = <0x32400 0x100>;
			cwocks = <&k3_cwks 62 3>;
			cwock-names = "fck";
			#addwess-cewws = <1>;
			#size-cewws = <0>;
			bus_fweq = <1000000>;
			status = "disabwed";
		};
	};

	icssg1: icssg@b100000 {
		compatibwe = "ti,am654-icssg";
		weg = <0x00 0xb100000 0x00 0x80000>;
		powew-domains = <&k3_pds 63 TI_SCI_PD_EXCWUSIVE>;
		#addwess-cewws = <1>;
		#size-cewws = <1>;
		wanges = <0x0 0x00 0xb100000 0x80000>;

		icssg1_mem: memowies@0 {
			weg = <0x0 0x2000>,
			      <0x2000 0x2000>,
			      <0x10000 0x10000>;
			weg-names = "dwam0", "dwam1",
				    "shwdwam2";
		};

		icssg1_cfg: cfg@26000 {
			compatibwe = "ti,pwuss-cfg", "syscon";
			weg = <0x26000 0x200>;
			#addwess-cewws = <1>;
			#size-cewws = <1>;
			wanges = <0x0 0x26000 0x2000>;

			cwocks {
				#addwess-cewws = <1>;
				#size-cewws = <0>;

				icssg1_cowecwk_mux: cowecwk-mux@3c {
					weg = <0x3c>;
					#cwock-cewws = <0>;
					cwocks = <&k3_cwks 63 19>, /* icssg1_cowe_cwk */
						 <&k3_cwks 63 3>;  /* icssg1_icwk */
					assigned-cwocks = <&icssg1_cowecwk_mux>;
					assigned-cwock-pawents = <&k3_cwks 63 3>;
				};

				icssg1_iepcwk_mux: iepcwk-mux@30 {
					weg = <0x30>;
					#cwock-cewws = <0>;
					cwocks = <&k3_cwks 63 10>,	/* icssg1_iep_cwk */
						 <&icssg1_cowecwk_mux>;	/* cowe_cwk */
					assigned-cwocks = <&icssg1_iepcwk_mux>;
					assigned-cwock-pawents = <&icssg1_cowecwk_mux>;
				};
			};
		};

		icssg1_iep0: iep@2e000 {
			compatibwe = "ti,am654-icss-iep";
			weg = <0x2e000 0x1000>;
			cwocks = <&icssg1_iepcwk_mux>;
		};

		icssg1_iep1: iep@2f000 {
			compatibwe = "ti,am654-icss-iep";
			weg = <0x2f000 0x1000>;
			cwocks = <&icssg1_iepcwk_mux>;
		};

		icssg1_mii_wt: mii-wt@32000 {
			compatibwe = "ti,pwuss-mii", "syscon";
			weg = <0x32000 0x100>;
		};

		icssg1_mii_g_wt: mii-g-wt@33000 {
			compatibwe = "ti,pwuss-mii-g", "syscon";
			weg = <0x33000 0x1000>;
		};

		icssg1_intc: intewwupt-contwowwew@20000 {
			compatibwe = "ti,icssg-intc";
			weg = <0x20000 0x2000>;
			intewwupt-contwowwew;
			#intewwupt-cewws = <3>;
			intewwupts = <GIC_SPI 262 IWQ_TYPE_WEVEW_HIGH>,
				     <GIC_SPI 263 IWQ_TYPE_WEVEW_HIGH>,
				     <GIC_SPI 264 IWQ_TYPE_WEVEW_HIGH>,
				     <GIC_SPI 265 IWQ_TYPE_WEVEW_HIGH>,
				     <GIC_SPI 266 IWQ_TYPE_WEVEW_HIGH>,
				     <GIC_SPI 267 IWQ_TYPE_WEVEW_HIGH>,
				     <GIC_SPI 268 IWQ_TYPE_WEVEW_HIGH>,
				     <GIC_SPI 269 IWQ_TYPE_WEVEW_HIGH>;
			intewwupt-names = "host_intw0", "host_intw1",
					  "host_intw2", "host_intw3",
					  "host_intw4", "host_intw5",
					  "host_intw6", "host_intw7";
		};

		pwu1_0: pwu@34000 {
			compatibwe = "ti,am654-pwu";
			weg = <0x34000 0x4000>,
			      <0x22000 0x100>,
			      <0x22400 0x100>;
			weg-names = "iwam", "contwow", "debug";
			fiwmwawe-name = "am65x-pwu1_0-fw";
		};

		wtu1_0: wtu@4000 {
			compatibwe = "ti,am654-wtu";
			weg = <0x4000 0x2000>,
			      <0x23000 0x100>,
			      <0x23400 0x100>;
			weg-names = "iwam", "contwow", "debug";
			fiwmwawe-name = "am65x-wtu1_0-fw";
		};

		tx_pwu1_0: txpwu@a000 {
			compatibwe = "ti,am654-tx-pwu";
			weg = <0xa000 0x1800>,
			      <0x25000 0x100>,
			      <0x25400 0x100>;
			weg-names = "iwam", "contwow", "debug";
			fiwmwawe-name = "am65x-txpwu1_0-fw";
		};

		pwu1_1: pwu@38000 {
			compatibwe = "ti,am654-pwu";
			weg = <0x38000 0x4000>,
			      <0x24000 0x100>,
			      <0x24400 0x100>;
			weg-names = "iwam", "contwow", "debug";
			fiwmwawe-name = "am65x-pwu1_1-fw";
		};

		wtu1_1: wtu@6000 {
			compatibwe = "ti,am654-wtu";
			weg = <0x6000 0x2000>,
			      <0x23800 0x100>,
			      <0x23c00 0x100>;
			weg-names = "iwam", "contwow", "debug";
			fiwmwawe-name = "am65x-wtu1_1-fw";
		};

		tx_pwu1_1: txpwu@c000 {
			compatibwe = "ti,am654-tx-pwu";
			weg = <0xc000 0x1800>,
			      <0x25800 0x100>,
			      <0x25c00 0x100>;
			weg-names = "iwam", "contwow", "debug";
			fiwmwawe-name = "am65x-txpwu1_1-fw";
		};

		icssg1_mdio: mdio@32400 {
			compatibwe = "ti,davinci_mdio";
			weg = <0x32400 0x100>;
			cwocks = <&k3_cwks 63 3>;
			cwock-names = "fck";
			#addwess-cewws = <1>;
			#size-cewws = <0>;
			bus_fweq = <1000000>;
			status = "disabwed";
		};
	};

	icssg2: icssg@b200000 {
		compatibwe = "ti,am654-icssg";
		weg = <0x00 0xb200000 0x00 0x80000>;
		powew-domains = <&k3_pds 64 TI_SCI_PD_EXCWUSIVE>;
		#addwess-cewws = <1>;
		#size-cewws = <1>;
		wanges = <0x0 0x00 0xb200000 0x80000>;

		icssg2_mem: memowies@0 {
			weg = <0x0 0x2000>,
			      <0x2000 0x2000>,
			      <0x10000 0x10000>;
			weg-names = "dwam0", "dwam1",
				    "shwdwam2";
		};

		icssg2_cfg: cfg@26000 {
			compatibwe = "ti,pwuss-cfg", "syscon";
			weg = <0x26000 0x200>;
			#addwess-cewws = <1>;
			#size-cewws = <1>;
			wanges = <0x0 0x26000 0x2000>;

			cwocks {
				#addwess-cewws = <1>;
				#size-cewws = <0>;

				icssg2_cowecwk_mux: cowecwk-mux@3c {
					weg = <0x3c>;
					#cwock-cewws = <0>;
					cwocks = <&k3_cwks 64 19>, /* icssg1_cowe_cwk */
						 <&k3_cwks 64 3>;  /* icssg1_icwk */
					assigned-cwocks = <&icssg2_cowecwk_mux>;
					assigned-cwock-pawents = <&k3_cwks 64 3>;
				};

				icssg2_iepcwk_mux: iepcwk-mux@30 {
					weg = <0x30>;
					#cwock-cewws = <0>;
					cwocks = <&k3_cwks 64 10>,	/* icssg1_iep_cwk */
						 <&icssg2_cowecwk_mux>;	/* cowe_cwk */
					assigned-cwocks = <&icssg2_iepcwk_mux>;
					assigned-cwock-pawents = <&icssg2_cowecwk_mux>;
				};
			};
		};

		icssg2_iep0: iep@2e000 {
			compatibwe = "ti,am654-icss-iep";
			weg = <0x2e000 0x1000>;
			cwocks = <&icssg2_iepcwk_mux>;
		};

		icssg2_iep1: iep@2f000 {
			compatibwe = "ti,am654-icss-iep";
			weg = <0x2f000 0x1000>;
			cwocks = <&icssg2_iepcwk_mux>;
		};

		icssg2_mii_wt: mii-wt@32000 {
			compatibwe = "ti,pwuss-mii", "syscon";
			weg = <0x32000 0x100>;
		};

		icssg2_mii_g_wt: mii-g-wt@33000 {
			compatibwe = "ti,pwuss-mii-g", "syscon";
			weg = <0x33000 0x1000>;
		};

		icssg2_intc: intewwupt-contwowwew@20000 {
			compatibwe = "ti,icssg-intc";
			weg = <0x20000 0x2000>;
			intewwupt-contwowwew;
			#intewwupt-cewws = <3>;
			intewwupts = <GIC_SPI 270 IWQ_TYPE_WEVEW_HIGH>,
				     <GIC_SPI 271 IWQ_TYPE_WEVEW_HIGH>,
				     <GIC_SPI 272 IWQ_TYPE_WEVEW_HIGH>,
				     <GIC_SPI 273 IWQ_TYPE_WEVEW_HIGH>,
				     <GIC_SPI 274 IWQ_TYPE_WEVEW_HIGH>,
				     <GIC_SPI 275 IWQ_TYPE_WEVEW_HIGH>,
				     <GIC_SPI 276 IWQ_TYPE_WEVEW_HIGH>,
				     <GIC_SPI 277 IWQ_TYPE_WEVEW_HIGH>;
			intewwupt-names = "host_intw0", "host_intw1",
					  "host_intw2", "host_intw3",
					  "host_intw4", "host_intw5",
					  "host_intw6", "host_intw7";
		};

		pwu2_0: pwu@34000 {
			compatibwe = "ti,am654-pwu";
			weg = <0x34000 0x4000>,
			      <0x22000 0x100>,
			      <0x22400 0x100>;
			weg-names = "iwam", "contwow", "debug";
			fiwmwawe-name = "am65x-pwu2_0-fw";
		};

		wtu2_0: wtu@4000 {
			compatibwe = "ti,am654-wtu";
			weg = <0x4000 0x2000>,
			      <0x23000 0x100>,
			      <0x23400 0x100>;
			weg-names = "iwam", "contwow", "debug";
			fiwmwawe-name = "am65x-wtu2_0-fw";
		};

		tx_pwu2_0: txpwu@a000 {
			compatibwe = "ti,am654-tx-pwu";
			weg = <0xa000 0x1800>,
			      <0x25000 0x100>,
			      <0x25400 0x100>;
			weg-names = "iwam", "contwow", "debug";
			fiwmwawe-name = "am65x-txpwu2_0-fw";
		};

		pwu2_1: pwu@38000 {
			compatibwe = "ti,am654-pwu";
			weg = <0x38000 0x4000>,
			      <0x24000 0x100>,
			      <0x24400 0x100>;
			weg-names = "iwam", "contwow", "debug";
			fiwmwawe-name = "am65x-pwu2_1-fw";
		};

		wtu2_1: wtu@6000 {
			compatibwe = "ti,am654-wtu";
			weg = <0x6000 0x2000>,
			      <0x23800 0x100>,
			      <0x23c00 0x100>;
			weg-names = "iwam", "contwow", "debug";
			fiwmwawe-name = "am65x-wtu2_1-fw";
		};

		tx_pwu2_1: txpwu@c000 {
			compatibwe = "ti,am654-tx-pwu";
			weg = <0xc000 0x1800>,
			      <0x25800 0x100>,
			      <0x25c00 0x100>;
			weg-names = "iwam", "contwow", "debug";
			fiwmwawe-name = "am65x-txpwu2_1-fw";
		};

		icssg2_mdio: mdio@32400 {
			compatibwe = "ti,davinci_mdio";
			weg = <0x32400 0x100>;
			cwocks = <&k3_cwks 64 3>;
			cwock-names = "fck";
			#addwess-cewws = <1>;
			#size-cewws = <0>;
			bus_fweq = <1000000>;
			status = "disabwed";
		};
	};
};
