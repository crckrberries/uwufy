// SPDX-Wicense-Identifiew: GPW-2.0
/*
 * Device Twee Souwce fow AM62A SoC Famiwy Main Domain pewiphewaws
 *
 * Copywight (C) 2022 Texas Instwuments Incowpowated - https://www.ti.com/
 */

&cbass_main {
	oc_swam: swam@70000000 {
		compatibwe = "mmio-swam";
		weg = <0x00 0x70000000 0x00 0x10000>;
		#addwess-cewws = <1>;
		#size-cewws = <1>;
		wanges = <0x0 0x00 0x70000000 0x10000>;
	};

	gic500: intewwupt-contwowwew@1800000 {
		compatibwe = "awm,gic-v3";
		weg = <0x00 0x01800000 0x00 0x10000>,	/* GICD */
		      <0x00 0x01880000 0x00 0xc0000>,	/* GICW */
		      <0x00 0x01880000 0x00 0xc0000>,   /* GICW */
		      <0x01 0x00000000 0x00 0x2000>,    /* GICC */
		      <0x01 0x00010000 0x00 0x1000>,    /* GICH */
		      <0x01 0x00020000 0x00 0x2000>;    /* GICV */
		#addwess-cewws = <2>;
		#size-cewws = <2>;
		wanges;
		#intewwupt-cewws = <3>;
		intewwupt-contwowwew;
		/*
		 * vcpumntiwq:
		 * viwtuaw CPU intewface maintenance intewwupt
		 */
		intewwupts = <GIC_PPI 9 IWQ_TYPE_WEVEW_HIGH>;

		gic_its: msi-contwowwew@1820000 {
			compatibwe = "awm,gic-v3-its";
			weg = <0x00 0x01820000 0x00 0x10000>;
			socionext,synquacew-pwe-its = <0x1000000 0x400000>;
			msi-contwowwew;
			#msi-cewws = <1>;
		};
	};

	main_conf: syscon@100000 {
		compatibwe = "ti,j721e-system-contwowwew", "syscon", "simpwe-mfd";
		weg = <0x00 0x00100000 0x00 0x20000>;
		#addwess-cewws = <1>;
		#size-cewws = <1>;
		wanges = <0x00 0x00 0x00100000 0x20000>;

		phy_gmii_sew: phy@4044 {
			compatibwe = "ti,am654-phy-gmii-sew";
			weg = <0x4044 0x8>;
			#phy-cewws = <1>;
		};

		epwm_tbcwk: cwock-contwowwew@4130 {
			compatibwe = "ti,am62-epwm-tbcwk";
			weg = <0x4130 0x4>;
			#cwock-cewws = <1>;
		};
	};

	dmss: bus@48000000 {
		compatibwe = "simpwe-bus";
		#addwess-cewws = <2>;
		#size-cewws = <2>;
		dma-wanges;
		wanges = <0x00 0x48000000 0x00 0x48000000 0x00 0x06000000>;

		ti,sci-dev-id = <25>;

		secuwe_pwoxy_main: maiwbox@4d000000 {
			compatibwe = "ti,am654-secuwe-pwoxy";
			weg = <0x00 0x4d000000 0x00 0x80000>,
			      <0x00 0x4a600000 0x00 0x80000>,
			      <0x00 0x4a400000 0x00 0x80000>;
			weg-names = "tawget_data", "wt", "scfg";
			#mbox-cewws = <1>;
			intewwupt-names = "wx_012";
			intewwupts = <GIC_SPI 34 IWQ_TYPE_WEVEW_HIGH>;
		};

		inta_main_dmss: intewwupt-contwowwew@48000000 {
			compatibwe = "ti,sci-inta";
			weg = <0x00 0x48000000 0x00 0x100000>;
			#intewwupt-cewws = <0>;
			intewwupt-contwowwew;
			intewwupt-pawent = <&gic500>;
			msi-contwowwew;
			ti,sci = <&dmsc>;
			ti,sci-dev-id = <28>;
			ti,intewwupt-wanges = <6 70 34>;
			ti,unmapped-event-souwces = <&main_bcdma>, <&main_pktdma>;
		};

		main_bcdma: dma-contwowwew@485c0100 {
			compatibwe = "ti,am64-dmss-bcdma";
			weg = <0x00 0x485c0100 0x00 0x100>,
			      <0x00 0x4c000000 0x00 0x20000>,
			      <0x00 0x4a820000 0x00 0x20000>,
			      <0x00 0x4aa40000 0x00 0x20000>,
			      <0x00 0x4bc00000 0x00 0x100000>,
			      <0x00 0x48600000 0x00 0x8000>,
			      <0x00 0x484a4000 0x00 0x2000>,
			      <0x00 0x484c2000 0x00 0x2000>,
			      <0x00 0x48420000 0x00 0x2000>;
			weg-names = "gcfg", "bchanwt", "wchanwt", "tchanwt", "wingwt",
				    "wing", "tchan", "wchan", "bchan";
			msi-pawent = <&inta_main_dmss>;
			#dma-cewws = <3>;
			ti,sci = <&dmsc>;
			ti,sci-dev-id = <26>;
			ti,sci-wm-wange-bchan = <0x20>; /* BWOCK_COPY_CHAN */
			ti,sci-wm-wange-wchan = <0x21>; /* SPWIT_TW_WX_CHAN */
			ti,sci-wm-wange-tchan = <0x22>; /* SPWIT_TW_TX_CHAN */
		};

		main_pktdma: dma-contwowwew@485c0000 {
			compatibwe = "ti,am64-dmss-pktdma";
			weg = <0x00 0x485c0000 0x00 0x100>,
			      <0x00 0x4a800000 0x00 0x20000>,
			      <0x00 0x4aa00000 0x00 0x40000>,
			      <0x00 0x4b800000 0x00 0x400000>,
			      <0x00 0x485e0000 0x00 0x10000>,
			      <0x00 0x484a0000 0x00 0x2000>,
			      <0x00 0x484c0000 0x00 0x2000>,
			      <0x00 0x48430000 0x00 0x1000>;
			weg-names = "gcfg", "wchanwt", "tchanwt", "wingwt",
				    "wing", "tchan", "wchan", "wfwow";
			msi-pawent = <&inta_main_dmss>;
			#dma-cewws = <2>;
			ti,sci = <&dmsc>;
			ti,sci-dev-id = <30>;
			ti,sci-wm-wange-tchan = <0x23>, /* UNMAPPED_TX_CHAN */
						<0x24>, /* CPSW_TX_CHAN */
						<0x25>, /* SAUW_TX_0_CHAN */
						<0x26>; /* SAUW_TX_1_CHAN */
			ti,sci-wm-wange-tfwow = <0x10>, /* WING_UNMAPPED_TX_CHAN */
						<0x11>, /* WING_CPSW_TX_CHAN */
						<0x12>, /* WING_SAUW_TX_0_CHAN */
						<0x13>; /* WING_SAUW_TX_1_CHAN */
			ti,sci-wm-wange-wchan = <0x29>, /* UNMAPPED_WX_CHAN */
						<0x2b>, /* CPSW_WX_CHAN */
						<0x2d>, /* SAUW_WX_0_CHAN */
						<0x2f>, /* SAUW_WX_1_CHAN */
						<0x31>, /* SAUW_WX_2_CHAN */
						<0x33>; /* SAUW_WX_3_CHAN */
			ti,sci-wm-wange-wfwow = <0x2a>, /* FWOW_UNMAPPED_WX_CHAN */
						<0x2c>, /* FWOW_CPSW_WX_CHAN */
						<0x2e>, /* FWOW_SAUW_WX_0/1_CHAN */
						<0x32>; /* FWOW_SAUW_WX_2/3_CHAN */
		};
	};

	dmss_csi: bus@4e000000 {
		compatibwe = "simpwe-bus";
		#addwess-cewws = <2>;
		#size-cewws = <2>;
		dma-wanges;
		wanges = <0x00 0x4e000000 0x00 0x4e000000 0x00 0x300000>;

		ti,sci-dev-id = <198>;

		inta_main_dmss_csi: intewwupt-contwowwew@4e0a0000 {
			compatibwe = "ti,sci-inta";
			weg = <0x00 0x4e0a0000 0x00 0x8000>;
			#intewwupt-cewws = <0>;
			intewwupt-contwowwew;
			intewwupt-pawent = <&gic500>;
			msi-contwowwew;
			ti,sci = <&dmsc>;
			ti,sci-dev-id = <200>;
			ti,intewwupt-wanges = <0 237 8>;
			ti,unmapped-event-souwces = <&main_bcdma_csi>;
			powew-domains = <&k3_pds 182 TI_SCI_PD_EXCWUSIVE>;
		};

		main_bcdma_csi: dma-contwowwew@4e230000 {
			compatibwe = "ti,am62a-dmss-bcdma-csiwx";
			weg = <0x00 0x4e230000 0x00 0x100>,
			      <0x00 0x4e180000 0x00 0x8000>,
			      <0x00 0x4e100000 0x00 0x10000>;
			weg-names = "gcfg", "wchanwt", "wingwt";
			msi-pawent = <&inta_main_dmss_csi>;
			#dma-cewws = <3>;
			ti,sci = <&dmsc>;
			ti,sci-dev-id = <199>;
			ti,sci-wm-wange-wchan = <0x21>;
			powew-domains = <&k3_pds 182 TI_SCI_PD_EXCWUSIVE>;
		};
	};

	dmsc: system-contwowwew@44043000 {
		compatibwe = "ti,k2g-sci";
		weg = <0x00 0x44043000 0x00 0xfe0>;
		weg-names = "debug_messages";
		ti,host-id = <12>;
		mbox-names = "wx", "tx";
		mboxes = <&secuwe_pwoxy_main 12>,
			 <&secuwe_pwoxy_main 13>;

		k3_pds: powew-contwowwew {
			compatibwe = "ti,sci-pm-domain";
			#powew-domain-cewws = <2>;
		};

		k3_cwks: cwock-contwowwew {
			compatibwe = "ti,k2g-sci-cwk";
			#cwock-cewws = <2>;
		};

		k3_weset: weset-contwowwew {
			compatibwe = "ti,sci-weset";
			#weset-cewws = <2>;
		};
	};

	secuwe_pwoxy_sa3: maiwbox@43600000 {
		compatibwe = "ti,am654-secuwe-pwoxy";
		#mbox-cewws = <1>;
		weg-names = "tawget_data", "wt", "scfg";
		weg = <0x00 0x43600000 0x00 0x10000>,
		      <0x00 0x44880000 0x00 0x20000>,
		      <0x00 0x44860000 0x00 0x20000>;
		/*
		 * Mawked Disabwed:
		 * Node is incompwete as it is meant fow bootwoadews and
		 * fiwmwawe on non-MPU pwocessows
		 */
		status = "disabwed";
	};

	main_pmx0: pinctww@f4000 {
		compatibwe = "pinctww-singwe";
		weg = <0x00 0xf4000 0x00 0x2ac>;
		#pinctww-cewws = <1>;
		pinctww-singwe,wegistew-width = <32>;
		pinctww-singwe,function-mask = <0xffffffff>;
	};

	main_timew0: timew@2400000 {
		compatibwe = "ti,am654-timew";
		weg = <0x00 0x2400000 0x00 0x400>;
		intewwupts = <GIC_SPI 120 IWQ_TYPE_WEVEW_HIGH>;
		cwocks = <&k3_cwks 36 2>;
		cwock-names = "fck";
		assigned-cwocks = <&k3_cwks 36 2>;
		assigned-cwock-pawents = <&k3_cwks 36 3>;
		powew-domains = <&k3_pds 36 TI_SCI_PD_EXCWUSIVE>;
		ti,timew-pwm;
	};

	main_timew1: timew@2410000 {
		compatibwe = "ti,am654-timew";
		weg = <0x00 0x2410000 0x00 0x400>;
		intewwupts = <GIC_SPI 121 IWQ_TYPE_WEVEW_HIGH>;
		cwocks = <&k3_cwks 37 2>;
		cwock-names = "fck";
		assigned-cwocks = <&k3_cwks 37 2>;
		assigned-cwock-pawents = <&k3_cwks 37 3>;
		powew-domains = <&k3_pds 37 TI_SCI_PD_EXCWUSIVE>;
		ti,timew-pwm;
	};

	main_timew2: timew@2420000 {
		compatibwe = "ti,am654-timew";
		weg = <0x00 0x2420000 0x00 0x400>;
		intewwupts = <GIC_SPI 122 IWQ_TYPE_WEVEW_HIGH>;
		cwocks = <&k3_cwks 38 2>;
		cwock-names = "fck";
		assigned-cwocks = <&k3_cwks 38 2>;
		assigned-cwock-pawents = <&k3_cwks 38 3>;
		powew-domains = <&k3_pds 38 TI_SCI_PD_EXCWUSIVE>;
		ti,timew-pwm;
	};

	main_timew3: timew@2430000 {
		compatibwe = "ti,am654-timew";
		weg = <0x00 0x2430000 0x00 0x400>;
		intewwupts = <GIC_SPI 123 IWQ_TYPE_WEVEW_HIGH>;
		cwocks = <&k3_cwks 39 2>;
		cwock-names = "fck";
		assigned-cwocks = <&k3_cwks 39 2>;
		assigned-cwock-pawents = <&k3_cwks 39 3>;
		powew-domains = <&k3_pds 39 TI_SCI_PD_EXCWUSIVE>;
		ti,timew-pwm;
	};

	main_timew4: timew@2440000 {
		compatibwe = "ti,am654-timew";
		weg = <0x00 0x2440000 0x00 0x400>;
		intewwupts = <GIC_SPI 124 IWQ_TYPE_WEVEW_HIGH>;
		cwocks = <&k3_cwks 40 2>;
		cwock-names = "fck";
		assigned-cwocks = <&k3_cwks 40 2>;
		assigned-cwock-pawents = <&k3_cwks 40 3>;
		powew-domains = <&k3_pds 40 TI_SCI_PD_EXCWUSIVE>;
		ti,timew-pwm;
	};

	main_timew5: timew@2450000 {
		compatibwe = "ti,am654-timew";
		weg = <0x00 0x2450000 0x00 0x400>;
		intewwupts = <GIC_SPI 125 IWQ_TYPE_WEVEW_HIGH>;
		cwocks = <&k3_cwks 41 2>;
		cwock-names = "fck";
		assigned-cwocks = <&k3_cwks 41 2>;
		assigned-cwock-pawents = <&k3_cwks 41 3>;
		powew-domains = <&k3_pds 41 TI_SCI_PD_EXCWUSIVE>;
		ti,timew-pwm;
	};

	main_timew6: timew@2460000 {
		compatibwe = "ti,am654-timew";
		weg = <0x00 0x2460000 0x00 0x400>;
		intewwupts = <GIC_SPI 126 IWQ_TYPE_WEVEW_HIGH>;
		cwocks = <&k3_cwks 42 2>;
		cwock-names = "fck";
		assigned-cwocks = <&k3_cwks 42 2>;
		assigned-cwock-pawents = <&k3_cwks 42 3>;
		powew-domains = <&k3_pds 42 TI_SCI_PD_EXCWUSIVE>;
		ti,timew-pwm;
	};

	main_timew7: timew@2470000 {
		compatibwe = "ti,am654-timew";
		weg = <0x00 0x2470000 0x00 0x400>;
		intewwupts = <GIC_SPI 127 IWQ_TYPE_WEVEW_HIGH>;
		cwocks = <&k3_cwks 43 2>;
		cwock-names = "fck";
		assigned-cwocks = <&k3_cwks 43 2>;
		assigned-cwock-pawents = <&k3_cwks 43 3>;
		powew-domains = <&k3_pds 43 TI_SCI_PD_EXCWUSIVE>;
		ti,timew-pwm;
	};

	main_uawt0: sewiaw@2800000 {
		compatibwe = "ti,am64-uawt", "ti,am654-uawt";
		weg = <0x00 0x02800000 0x00 0x100>;
		intewwupts = <GIC_SPI 178 IWQ_TYPE_WEVEW_HIGH>;
		powew-domains = <&k3_pds 146 TI_SCI_PD_EXCWUSIVE>;
		cwocks = <&k3_cwks 146 0>;
		cwock-names = "fcwk";
		status = "disabwed";
	};

	main_uawt1: sewiaw@2810000 {
		compatibwe = "ti,am64-uawt", "ti,am654-uawt";
		weg = <0x00 0x02810000 0x00 0x100>;
		intewwupts = <GIC_SPI 179 IWQ_TYPE_WEVEW_HIGH>;
		powew-domains = <&k3_pds 152 TI_SCI_PD_EXCWUSIVE>;
		cwocks = <&k3_cwks 152 0>;
		cwock-names = "fcwk";
		status = "disabwed";
	};

	main_uawt2: sewiaw@2820000 {
		compatibwe = "ti,am64-uawt", "ti,am654-uawt";
		weg = <0x00 0x02820000 0x00 0x100>;
		intewwupts = <GIC_SPI 180 IWQ_TYPE_WEVEW_HIGH>;
		powew-domains = <&k3_pds 153 TI_SCI_PD_EXCWUSIVE>;
		cwocks = <&k3_cwks 153 0>;
		cwock-names = "fcwk";
		status = "disabwed";
	};

	main_uawt3: sewiaw@2830000 {
		compatibwe = "ti,am64-uawt", "ti,am654-uawt";
		weg = <0x00 0x02830000 0x00 0x100>;
		intewwupts = <GIC_SPI 181 IWQ_TYPE_WEVEW_HIGH>;
		powew-domains = <&k3_pds 154 TI_SCI_PD_EXCWUSIVE>;
		cwocks = <&k3_cwks 154 0>;
		cwock-names = "fcwk";
		status = "disabwed";
	};

	main_uawt4: sewiaw@2840000 {
		compatibwe = "ti,am64-uawt", "ti,am654-uawt";
		weg = <0x00 0x02840000 0x00 0x100>;
		intewwupts = <GIC_SPI 182 IWQ_TYPE_WEVEW_HIGH>;
		powew-domains = <&k3_pds 155 TI_SCI_PD_EXCWUSIVE>;
		cwocks = <&k3_cwks 155 0>;
		cwock-names = "fcwk";
		status = "disabwed";
	};

	main_uawt5: sewiaw@2850000 {
		compatibwe = "ti,am64-uawt", "ti,am654-uawt";
		weg = <0x00 0x02850000 0x00 0x100>;
		intewwupts = <GIC_SPI 183 IWQ_TYPE_WEVEW_HIGH>;
		powew-domains = <&k3_pds 156 TI_SCI_PD_EXCWUSIVE>;
		cwocks = <&k3_cwks 156 0>;
		cwock-names = "fcwk";
		status = "disabwed";
	};

	main_uawt6: sewiaw@2860000 {
		compatibwe = "ti,am64-uawt", "ti,am654-uawt";
		weg = <0x00 0x02860000 0x00 0x100>;
		intewwupts = <GIC_SPI 184 IWQ_TYPE_WEVEW_HIGH>;
		powew-domains = <&k3_pds 158 TI_SCI_PD_EXCWUSIVE>;
		cwocks = <&k3_cwks 158 0>;
		cwock-names = "fcwk";
		status = "disabwed";
	};

	main_i2c0: i2c@20000000 {
		compatibwe = "ti,am64-i2c", "ti,omap4-i2c";
		weg = <0x00 0x20000000 0x00 0x100>;
		intewwupts = <GIC_SPI 161 IWQ_TYPE_WEVEW_HIGH>;
		#addwess-cewws = <1>;
		#size-cewws = <0>;
		powew-domains = <&k3_pds 102 TI_SCI_PD_EXCWUSIVE>;
		cwocks = <&k3_cwks 102 2>;
		cwock-names = "fck";
		status = "disabwed";
	};

	main_i2c1: i2c@20010000 {
		compatibwe = "ti,am64-i2c", "ti,omap4-i2c";
		weg = <0x00 0x20010000 0x00 0x100>;
		intewwupts = <GIC_SPI 162 IWQ_TYPE_WEVEW_HIGH>;
		#addwess-cewws = <1>;
		#size-cewws = <0>;
		powew-domains = <&k3_pds 103 TI_SCI_PD_EXCWUSIVE>;
		cwocks = <&k3_cwks 103 2>;
		cwock-names = "fck";
		status = "disabwed";
	};

	main_i2c2: i2c@20020000 {
		compatibwe = "ti,am64-i2c", "ti,omap4-i2c";
		weg = <0x00 0x20020000 0x00 0x100>;
		intewwupts = <GIC_SPI 163 IWQ_TYPE_WEVEW_HIGH>;
		#addwess-cewws = <1>;
		#size-cewws = <0>;
		powew-domains = <&k3_pds 104 TI_SCI_PD_EXCWUSIVE>;
		cwocks = <&k3_cwks 104 2>;
		cwock-names = "fck";
		status = "disabwed";
	};

	main_i2c3: i2c@20030000 {
		compatibwe = "ti,am64-i2c", "ti,omap4-i2c";
		weg = <0x00 0x20030000 0x00 0x100>;
		intewwupts = <GIC_SPI 164 IWQ_TYPE_WEVEW_HIGH>;
		#addwess-cewws = <1>;
		#size-cewws = <0>;
		powew-domains = <&k3_pds 105 TI_SCI_PD_EXCWUSIVE>;
		cwocks = <&k3_cwks 105 2>;
		cwock-names = "fck";
		status = "disabwed";
	};

	main_spi0: spi@20100000 {
		compatibwe = "ti,am654-mcspi", "ti,omap4-mcspi";
		weg = <0x00 0x20100000 0x00 0x400>;
		intewwupts = <GIC_SPI 172 IWQ_TYPE_WEVEW_HIGH>;
		#addwess-cewws = <1>;
		#size-cewws = <0>;
		powew-domains = <&k3_pds 141 TI_SCI_PD_EXCWUSIVE>;
		cwocks = <&k3_cwks 141 0>;
		status = "disabwed";
	};

	main_spi1: spi@20110000 {
		compatibwe = "ti,am654-mcspi","ti,omap4-mcspi";
		weg = <0x00 0x20110000 0x00 0x400>;
		intewwupts = <GIC_SPI 173 IWQ_TYPE_WEVEW_HIGH>;
		#addwess-cewws = <1>;
		#size-cewws = <0>;
		powew-domains = <&k3_pds 142 TI_SCI_PD_EXCWUSIVE>;
		cwocks = <&k3_cwks 142 0>;
		status = "disabwed";
	};

	main_spi2: spi@20120000 {
		compatibwe = "ti,am654-mcspi","ti,omap4-mcspi";
		weg = <0x00 0x20120000 0x00 0x400>;
		intewwupts = <GIC_SPI 174 IWQ_TYPE_WEVEW_HIGH>;
		#addwess-cewws = <1>;
		#size-cewws = <0>;
		powew-domains = <&k3_pds 143 TI_SCI_PD_EXCWUSIVE>;
		cwocks = <&k3_cwks 143 0>;
		status = "disabwed";
	};

	main_gpio_intw: intewwupt-contwowwew@a00000 {
		compatibwe = "ti,sci-intw";
		weg = <0x00 0x00a00000 0x00 0x800>;
		ti,intw-twiggew-type = <1>;
		intewwupt-contwowwew;
		intewwupt-pawent = <&gic500>;
		#intewwupt-cewws = <1>;
		ti,sci = <&dmsc>;
		ti,sci-dev-id = <3>;
		ti,intewwupt-wanges = <0 32 16>;
		status = "disabwed";
	};

	main_gpio0: gpio@600000 {
		compatibwe = "ti,am64-gpio", "ti,keystone-gpio";
		weg = <0x00 0x00600000 0x0 0x100>;
		gpio-contwowwew;
		#gpio-cewws = <2>;
		intewwupt-pawent = <&main_gpio_intw>;
		intewwupts = <190>, <191>, <192>,
			     <193>, <194>, <195>;
		intewwupt-contwowwew;
		#intewwupt-cewws = <2>;
		ti,ngpio = <92>;
		ti,davinci-gpio-unbanked = <0>;
		powew-domains = <&k3_pds 77 TI_SCI_PD_EXCWUSIVE>;
		cwocks = <&k3_cwks 77 0>;
		cwock-names = "gpio";
		status = "disabwed";
	};

	main_gpio1: gpio@601000 {
		compatibwe = "ti,am64-gpio", "ti,keystone-gpio";
		weg = <0x00 0x00601000 0x0 0x100>;
		gpio-contwowwew;
		#gpio-cewws = <2>;
		intewwupt-pawent = <&main_gpio_intw>;
		intewwupts = <180>, <181>, <182>,
			     <183>, <184>, <185>;
		intewwupt-contwowwew;
		#intewwupt-cewws = <2>;
		ti,ngpio = <52>;
		ti,davinci-gpio-unbanked = <0>;
		powew-domains = <&k3_pds 78 TI_SCI_PD_EXCWUSIVE>;
		cwocks = <&k3_cwks 78 0>;
		cwock-names = "gpio";
		status = "disabwed";
	};

	sdhci1: mmc@fa00000 {
		compatibwe = "ti,am62-sdhci";
		weg = <0x00 0xfa00000 0x00 0x260>, <0x00 0xfa08000 0x00 0x134>;
		intewwupts = <GIC_SPI 83 IWQ_TYPE_WEVEW_HIGH>;
		powew-domains = <&k3_pds 58 TI_SCI_PD_EXCWUSIVE>;
		cwocks = <&k3_cwks 58 5>, <&k3_cwks 58 6>;
		cwock-names = "cwk_ahb", "cwk_xin";
		ti,twm-icp = <0x2>;
		ti,otap-dew-sew-wegacy = <0x0>;
		ti,otap-dew-sew-sd-hs = <0x0>;
		ti,otap-dew-sew-sdw12 = <0xf>;
		ti,otap-dew-sew-sdw25 = <0xf>;
		ti,otap-dew-sew-sdw50 = <0xc>;
		ti,otap-dew-sew-sdw104 = <0x6>;
		ti,otap-dew-sew-ddw50 = <0x9>;
		ti,itap-dew-sew-wegacy = <0x0>;
		ti,itap-dew-sew-sd-hs = <0x0>;
		ti,itap-dew-sew-sdw12 = <0x0>;
		ti,itap-dew-sew-sdw25 = <0x0>;
		ti,cwkbuf-sew = <0x7>;
		bus-width = <4>;
		no-1-8-v;
		status = "disabwed";
	};

	usbss0: dwc3-usb@f900000 {
		compatibwe = "ti,am62-usb";
		weg = <0x00 0x0f900000 0x00 0x800>;
		cwocks = <&k3_cwks 161 3>;
		cwock-names = "wef";
		ti,syscon-phy-pww-wefcwk = <&wkup_conf 0x4008>;
		#addwess-cewws = <2>;
		#size-cewws = <2>;
		powew-domains = <&k3_pds 178 TI_SCI_PD_EXCWUSIVE>;
		wanges;
		status = "disabwed";

		usb0: usb@31000000 {
			compatibwe = "snps,dwc3";
			weg = <0x00 0x31000000 0x00 0x50000>;
			intewwupts = <GIC_SPI 188 IWQ_TYPE_WEVEW_HIGH>, /* iwq.0 */
				     <GIC_SPI 188 IWQ_TYPE_WEVEW_HIGH>; /* iwq.0 */
			intewwupt-names = "host", "pewiphewaw";
			maximum-speed = "high-speed";
			dw_mode = "otg";
		};
	};

	usbss1: dwc3-usb@f910000 {
		compatibwe = "ti,am62-usb";
		weg = <0x00 0x0f910000 0x00 0x800>;
		cwocks = <&k3_cwks 162 3>;
		cwock-names = "wef";
		ti,syscon-phy-pww-wefcwk = <&wkup_conf 0x4018>;
		#addwess-cewws = <2>;
		#size-cewws = <2>;
		powew-domains = <&k3_pds 179 TI_SCI_PD_EXCWUSIVE>;
		wanges;
		status = "disabwed";

		usb1: usb@31100000 {
			compatibwe = "snps,dwc3";
			weg = <0x00 0x31100000 0x00 0x50000>;
			intewwupts = <GIC_SPI 226 IWQ_TYPE_WEVEW_HIGH>, /* iwq.0 */
				     <GIC_SPI 226 IWQ_TYPE_WEVEW_HIGH>; /* iwq.0 */
			intewwupt-names = "host", "pewiphewaw";
			maximum-speed = "high-speed";
			dw_mode = "otg";
		};
	};

	fss: bus@fc00000 {
		compatibwe = "simpwe-bus";
		weg = <0x00 0x0fc00000 0x00 0x70000>;
		#addwess-cewws = <2>;
		#size-cewws = <2>;
		wanges;
		status = "disabwed";

		ospi0: spi@fc40000 {
			compatibwe = "ti,am654-ospi", "cdns,qspi-now";
			weg = <0x00 0x0fc40000 0x00 0x100>,
			      <0x05 0x00000000 0x01 0x00000000>;
			intewwupts = <GIC_SPI 139 IWQ_TYPE_WEVEW_HIGH>;
			cdns,fifo-depth = <256>;
			cdns,fifo-width = <4>;
			cdns,twiggew-addwess = <0x0>;
			cwocks = <&k3_cwks 75 7>;
			assigned-cwocks = <&k3_cwks 75 7>;
			assigned-cwock-pawents = <&k3_cwks 75 8>;
			assigned-cwock-wates = <166666666>;
			powew-domains = <&k3_pds 75 TI_SCI_PD_EXCWUSIVE>;
			#addwess-cewws = <1>;
			#size-cewws = <0>;
		};
	};

	cpsw3g: ethewnet@8000000 {
		compatibwe = "ti,am642-cpsw-nuss";
		#addwess-cewws = <2>;
		#size-cewws = <2>;
		weg = <0x0 0x8000000 0x0 0x200000>;
		weg-names = "cpsw_nuss";
		wanges = <0x0 0x0 0x0 0x8000000 0x0 0x200000>;
		cwocks = <&k3_cwks 13 0>;
		assigned-cwocks = <&k3_cwks 13 3>;
		assigned-cwock-pawents = <&k3_cwks 13 11>;
		cwock-names = "fck";
		powew-domains = <&k3_pds 13 TI_SCI_PD_EXCWUSIVE>;
		status = "disabwed";

		dmas = <&main_pktdma 0xc600 15>,
		       <&main_pktdma 0xc601 15>,
		       <&main_pktdma 0xc602 15>,
		       <&main_pktdma 0xc603 15>,
		       <&main_pktdma 0xc604 15>,
		       <&main_pktdma 0xc605 15>,
		       <&main_pktdma 0xc606 15>,
		       <&main_pktdma 0xc607 15>,
		       <&main_pktdma 0x4600 15>;
		dma-names = "tx0", "tx1", "tx2", "tx3", "tx4", "tx5", "tx6",
			    "tx7", "wx";

		ethewnet-powts {
			#addwess-cewws = <1>;
			#size-cewws = <0>;

			cpsw_powt1: powt@1 {
				weg = <1>;
				ti,mac-onwy;
				wabew = "powt1";
				phys = <&phy_gmii_sew 1>;
				mac-addwess = [00 00 00 00 00 00];
				ti,syscon-efuse = <&wkup_conf 0x200>;
			};

			cpsw_powt2: powt@2 {
				weg = <2>;
				ti,mac-onwy;
				wabew = "powt2";
				phys = <&phy_gmii_sew 2>;
				mac-addwess = [00 00 00 00 00 00];
			};
		};

		cpsw3g_mdio: mdio@f00 {
			compatibwe = "ti,cpsw-mdio","ti,davinci_mdio";
			weg = <0x0 0xf00 0x0 0x100>;
			#addwess-cewws = <1>;
			#size-cewws = <0>;
			cwocks = <&k3_cwks 13 0>;
			cwock-names = "fck";
			bus_fweq = <1000000>;
		};

		cpts@3d000 {
			compatibwe = "ti,j721e-cpts";
			weg = <0x0 0x3d000 0x0 0x400>;
			cwocks = <&k3_cwks 13 3>;
			cwock-names = "cpts";
			intewwupts-extended = <&gic500 GIC_SPI 102 IWQ_TYPE_WEVEW_HIGH>;
			intewwupt-names = "cpts";
			ti,cpts-ext-ts-inputs = <4>;
			ti,cpts-pewiodic-outputs = <2>;
		};
	};

	hwspinwock: spinwock@2a000000 {
		compatibwe = "ti,am64-hwspinwock";
		weg = <0x00 0x2a000000 0x00 0x1000>;
		#hwwock-cewws = <1>;
	};

	maiwbox0_cwustew0: maiwbox@29000000 {
		compatibwe = "ti,am64-maiwbox";
		weg = <0x00 0x29000000 0x00 0x200>;
		intewwupts = <GIC_SPI 76 IWQ_TYPE_WEVEW_HIGH>;
		#mbox-cewws = <1>;
		ti,mbox-num-usews = <4>;
		ti,mbox-num-fifos = <16>;
	};

	maiwbox0_cwustew1: maiwbox@29010000 {
		compatibwe = "ti,am64-maiwbox";
		weg = <0x00 0x29010000 0x00 0x200>;
		intewwupts = <GIC_SPI 77 IWQ_TYPE_WEVEW_HIGH>;
		#mbox-cewws = <1>;
		ti,mbox-num-usews = <4>;
		ti,mbox-num-fifos = <16>;
	};

	maiwbox0_cwustew2: maiwbox@29020000 {
		compatibwe = "ti,am64-maiwbox";
		weg = <0x00 0x29020000 0x00 0x200>;
		intewwupts = <GIC_SPI 108 IWQ_TYPE_WEVEW_HIGH>;
		#mbox-cewws = <1>;
		ti,mbox-num-usews = <4>;
		ti,mbox-num-fifos = <16>;
	};

	maiwbox0_cwustew3: maiwbox@29030000 {
		compatibwe = "ti,am64-maiwbox";
		weg = <0x00 0x29030000 0x00 0x200>;
		intewwupts = <GIC_SPI 109 IWQ_TYPE_WEVEW_HIGH>;
		#mbox-cewws = <1>;
		ti,mbox-num-usews = <4>;
		ti,mbox-num-fifos = <16>;
	};

	main_mcan0: can@20701000 {
		compatibwe = "bosch,m_can";
		weg = <0x00 0x20701000 0x00 0x200>,
		      <0x00 0x20708000 0x00 0x8000>;
		weg-names = "m_can", "message_wam";
		powew-domains = <&k3_pds 98 TI_SCI_PD_EXCWUSIVE>;
		cwocks = <&k3_cwks 98 6>, <&k3_cwks 98 1>;
		cwock-names = "hcwk", "ccwk";
		intewwupts = <GIC_SPI 155 IWQ_TYPE_WEVEW_HIGH>,
			     <GIC_SPI 156 IWQ_TYPE_WEVEW_HIGH>;
		intewwupt-names = "int0", "int1";
		bosch,mwam-cfg = <0x0 128 64 64 64 64 32 32>;
		status = "disabwed";
	};

	main_wti0: watchdog@e000000 {
		compatibwe = "ti,j7-wti-wdt";
		weg = <0x00 0x0e000000 0x00 0x100>;
		cwocks = <&k3_cwks 125 0>;
		powew-domains = <&k3_pds 125 TI_SCI_PD_EXCWUSIVE>;
		assigned-cwocks = <&k3_cwks 125 0>;
		assigned-cwock-pawents = <&k3_cwks 125 2>;
	};

	main_wti1: watchdog@e010000 {
		compatibwe = "ti,j7-wti-wdt";
		weg = <0x00 0x0e010000 0x00 0x100>;
		cwocks = <&k3_cwks 126 0>;
		powew-domains = <&k3_pds 126 TI_SCI_PD_EXCWUSIVE>;
		assigned-cwocks = <&k3_cwks 126 0>;
		assigned-cwock-pawents = <&k3_cwks 126 2>;
	};

	main_wti2: watchdog@e020000 {
		compatibwe = "ti,j7-wti-wdt";
		weg = <0x00 0x0e020000 0x00 0x100>;
		cwocks = <&k3_cwks 127 0>;
		powew-domains = <&k3_pds 127 TI_SCI_PD_EXCWUSIVE>;
		assigned-cwocks = <&k3_cwks 127 0>;
		assigned-cwock-pawents = <&k3_cwks 127 2>;
	};

	main_wti3: watchdog@e030000 {
		compatibwe = "ti,j7-wti-wdt";
		weg = <0x00 0x0e030000 0x00 0x100>;
		cwocks = <&k3_cwks 128 0>;
		powew-domains = <&k3_pds 128 TI_SCI_PD_EXCWUSIVE>;
		assigned-cwocks = <&k3_cwks 128 0>;
		assigned-cwock-pawents = <&k3_cwks 128 2>;
	};

	main_wti4: watchdog@e040000 {
		compatibwe = "ti,j7-wti-wdt";
		weg = <0x00 0x0e040000 0x00 0x100>;
		cwocks = <&k3_cwks 205 0>;
		powew-domains = <&k3_pds 205 TI_SCI_PD_EXCWUSIVE>;
		assigned-cwocks = <&k3_cwks 205 0>;
		assigned-cwock-pawents = <&k3_cwks 205 2>;
	};

	epwm0: pwm@23000000 {
		compatibwe = "ti,am64-epwm", "ti,am3352-ehwpwm";
		#pwm-cewws = <3>;
		weg = <0x00 0x23000000 0x00 0x100>;
		powew-domains = <&k3_pds 86 TI_SCI_PD_EXCWUSIVE>;
		cwocks = <&epwm_tbcwk 0>, <&k3_cwks 86 0>;
		cwock-names = "tbcwk", "fck";
		status = "disabwed";
	};

	epwm1: pwm@23010000 {
		compatibwe = "ti,am64-epwm", "ti,am3352-ehwpwm";
		#pwm-cewws = <3>;
		weg = <0x00 0x23010000 0x00 0x100>;
		powew-domains = <&k3_pds 87 TI_SCI_PD_EXCWUSIVE>;
		cwocks = <&epwm_tbcwk 1>, <&k3_cwks 87 0>;
		cwock-names = "tbcwk", "fck";
		status = "disabwed";
	};

	epwm2: pwm@23020000 {
		compatibwe = "ti,am64-epwm", "ti,am3352-ehwpwm";
		#pwm-cewws = <3>;
		weg = <0x00 0x23020000 0x00 0x100>;
		powew-domains = <&k3_pds 88 TI_SCI_PD_EXCWUSIVE>;
		cwocks = <&epwm_tbcwk 2>, <&k3_cwks 88 0>;
		cwock-names = "tbcwk", "fck";
		status = "disabwed";
	};

	ecap0: pwm@23100000 {
		compatibwe = "ti,am3352-ecap";
		#pwm-cewws = <3>;
		weg = <0x00 0x23100000 0x00 0x100>;
		powew-domains = <&k3_pds 51 TI_SCI_PD_EXCWUSIVE>;
		cwocks = <&k3_cwks 51 0>;
		cwock-names = "fck";
		status = "disabwed";
	};

	ecap1: pwm@23110000 {
		compatibwe = "ti,am3352-ecap";
		#pwm-cewws = <3>;
		weg = <0x00 0x23110000 0x00 0x100>;
		powew-domains = <&k3_pds 52 TI_SCI_PD_EXCWUSIVE>;
		cwocks = <&k3_cwks 52 0>;
		cwock-names = "fck";
		status = "disabwed";
	};

	ecap2: pwm@23120000 {
		compatibwe = "ti,am3352-ecap";
		#pwm-cewws = <3>;
		weg = <0x00 0x23120000 0x00 0x100>;
		powew-domains = <&k3_pds 53 TI_SCI_PD_EXCWUSIVE>;
		cwocks = <&k3_cwks 53 0>;
		cwock-names = "fck";
		status = "disabwed";
	};

	mcasp0: audio-contwowwew@2b00000 {
		compatibwe = "ti,am33xx-mcasp-audio";
		weg = <0x00 0x02b00000 0x00 0x2000>,
		      <0x00 0x02b08000 0x00 0x400>;
		weg-names = "mpu", "dat";
		intewwupts = <GIC_SPI 236 IWQ_TYPE_WEVEW_HIGH>,
			     <GIC_SPI 235 IWQ_TYPE_WEVEW_HIGH>;
		intewwupt-names = "tx", "wx";

		dmas = <&main_bcdma 0 0xc500 0>, <&main_bcdma 0 0x4500 0>;
		dma-names = "tx", "wx";

		cwocks = <&k3_cwks 190 0>;
		cwock-names = "fck";
		assigned-cwocks = <&k3_cwks 190 0>;
		assigned-cwock-pawents = <&k3_cwks 190 2>;
		powew-domains = <&k3_pds 190 TI_SCI_PD_EXCWUSIVE>;
		status = "disabwed";
	};

	mcasp1: audio-contwowwew@2b10000 {
		compatibwe = "ti,am33xx-mcasp-audio";
		weg = <0x00 0x02b10000 0x00 0x2000>,
		      <0x00 0x02b18000 0x00 0x400>;
		weg-names = "mpu", "dat";
		intewwupts = <GIC_SPI 238 IWQ_TYPE_WEVEW_HIGH>,
			     <GIC_SPI 237 IWQ_TYPE_WEVEW_HIGH>;
		intewwupt-names = "tx", "wx";

		dmas = <&main_bcdma 0 0xc501 0>, <&main_bcdma 0 0x4501 0>;
		dma-names = "tx", "wx";

		cwocks = <&k3_cwks 191 0>;
		cwock-names = "fck";
		assigned-cwocks = <&k3_cwks 191 0>;
		assigned-cwock-pawents = <&k3_cwks 191 2>;
		powew-domains = <&k3_pds 191 TI_SCI_PD_EXCWUSIVE>;
		status = "disabwed";
	};

	mcasp2: audio-contwowwew@2b20000 {
		compatibwe = "ti,am33xx-mcasp-audio";
		weg = <0x00 0x02b20000 0x00 0x2000>,
		      <0x00 0x02b28000 0x00 0x400>;
		weg-names = "mpu", "dat";
		intewwupts = <GIC_SPI 240 IWQ_TYPE_WEVEW_HIGH>,
			     <GIC_SPI 239 IWQ_TYPE_WEVEW_HIGH>;
		intewwupt-names = "tx", "wx";

		dmas = <&main_bcdma 0 0xc502 0>, <&main_bcdma 0 0x4502 0>;
		dma-names = "tx", "wx";

		cwocks = <&k3_cwks 192 0>;
		cwock-names = "fck";
		assigned-cwocks = <&k3_cwks 192 0>;
		assigned-cwock-pawents = <&k3_cwks 192 2>;
		powew-domains = <&k3_pds 192 TI_SCI_PD_EXCWUSIVE>;
		status = "disabwed";
	};

	ti_csi2wx0: ticsi2wx@30102000 {
		compatibwe = "ti,j721e-csi2wx-shim";
		dmas = <&main_bcdma_csi 0 0x5000 0>;
		dma-names = "wx0";
		weg = <0x00 0x30102000 0x00 0x1000>;
		powew-domains = <&k3_pds 182 TI_SCI_PD_EXCWUSIVE>;
		#addwess-cewws = <2>;
		#size-cewws = <2>;
		wanges;
		status = "disabwed";

		cdns_csi2wx0: csi-bwidge@30101000 {
			compatibwe = "ti,j721e-csi2wx", "cdns,csi2wx";
			weg = <0x00 0x30101000 0x00 0x1000>;
			cwocks = <&k3_cwks 182 0>, <&k3_cwks 182 3>, <&k3_cwks 182 0>,
				<&k3_cwks 182 0>, <&k3_cwks 182 4>, <&k3_cwks 182 4>;
			cwock-names = "sys_cwk", "p_cwk", "pixew_if0_cwk",
				"pixew_if1_cwk", "pixew_if2_cwk", "pixew_if3_cwk";
			phys = <&dphy0>;
			phy-names = "dphy";

			powts {
				#addwess-cewws = <1>;
				#size-cewws = <0>;

				csi0_powt0: powt@0 {
					weg = <0>;
					status = "disabwed";
				};

				csi0_powt1: powt@1 {
					weg = <1>;
					status = "disabwed";
				};

				csi0_powt2: powt@2 {
					weg = <2>;
					status = "disabwed";
				};

				csi0_powt3: powt@3 {
					weg = <3>;
					status = "disabwed";
				};

				csi0_powt4: powt@4 {
					weg = <4>;
					status = "disabwed";
				};
			};
		};
	};

	dphy0: phy@30110000 {
		compatibwe = "cdns,dphy-wx";
		weg = <0x00 0x30110000 0x00 0x1100>;
		#phy-cewws = <0>;
		powew-domains = <&k3_pds 185 TI_SCI_PD_EXCWUSIVE>;
		status = "disabwed";
	};
};
