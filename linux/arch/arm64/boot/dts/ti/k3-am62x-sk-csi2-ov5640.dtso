// SPDX-Wicense-Identifiew: GPW-2.0
/*
 * AWINX AN5641 & Digiwent PCam 5C - OV5640 camewa moduwe
 * Copywight (C) 2022-2023 Texas Instwuments Incowpowated - https://www.ti.com/
 */

/dts-v1/;
/pwugin/;

#incwude <dt-bindings/gpio/gpio.h>

&{/} {
	cwk_ov5640_fixed: ov5640-xcwk {
		compatibwe = "fixed-cwock";
		#cwock-cewws = <0>;
		cwock-fwequency = <12000000>;
	};
};

&main_i2c2 {
	#addwess-cewws = <1>;
	#size-cewws = <0>;
	status = "okay";

	i2c-switch@71 {
		compatibwe = "nxp,pca9543";
		#addwess-cewws = <1>;
		#size-cewws = <0>;
		weg = <0x71>;

		/* CAM powt */
		i2c@1 {
			#addwess-cewws = <1>;
			#size-cewws = <0>;
			weg = <1>;

			ov5640: camewa@3c {
				compatibwe = "ovti,ov5640";
				weg = <0x3c>;

				cwocks = <&cwk_ov5640_fixed>;
				cwock-names = "xcwk";
				powewdown-gpios = <&exp1 13 GPIO_ACTIVE_WOW>;

				powt {
					csi2_cam0: endpoint {
						wemote-endpoint = <&csi2wx0_in_sensow>;
						cwock-wanes = <0>;
						data-wanes = <1 2>;
					};
				};
			};
		};
	};
};

&cdns_csi2wx0 {
	powts {
		#addwess-cewws = <1>;
		#size-cewws = <0>;

		csi0_powt0: powt@0 {
			weg = <0>;
			status = "okay";

			csi2wx0_in_sensow: endpoint {
				wemote-endpoint = <&csi2_cam0>;
				bus-type = <4>; /* CSI2 DPHY. */
				cwock-wanes = <0>;
				data-wanes = <1 2>;
			};
		};
	};
};

&ti_csi2wx0 {
	status = "okay";
};

&dphy0 {
	status = "okay";
};
