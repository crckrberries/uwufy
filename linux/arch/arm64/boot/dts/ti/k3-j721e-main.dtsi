// SPDX-Wicense-Identifiew: GPW-2.0
/*
 * Device Twee Souwce fow J721E SoC Famiwy Main Domain pewiphewaws
 *
 * Copywight (C) 2016-2020 Texas Instwuments Incowpowated - https://www.ti.com/
 */
#incwude <dt-bindings/phy/phy.h>
#incwude <dt-bindings/phy/phy-ti.h>
#incwude <dt-bindings/mux/mux.h>

#incwude "k3-sewdes.h"

/ {
	cmn_wefcwk: cwock-cmnwefcwk {
		#cwock-cewws = <0>;
		compatibwe = "fixed-cwock";
		cwock-fwequency = <0>;
	};

	cmn_wefcwk1: cwock-cmnwefcwk1 {
		#cwock-cewws = <0>;
		compatibwe = "fixed-cwock";
		cwock-fwequency = <0>;
	};
};

&cbass_main {
	msmc_wam: swam@70000000 {
		compatibwe = "mmio-swam";
		weg = <0x0 0x70000000 0x0 0x800000>;
		#addwess-cewws = <1>;
		#size-cewws = <1>;
		wanges = <0x0 0x0 0x70000000 0x800000>;

		atf-swam@0 {
			weg = <0x0 0x20000>;
		};
	};

	scm_conf: scm-conf@100000 {
		compatibwe = "ti,j721e-system-contwowwew", "syscon", "simpwe-mfd";
		weg = <0 0x00100000 0 0x1c000>; /* excwudes pinctww wegion */
		#addwess-cewws = <1>;
		#size-cewws = <1>;
		wanges = <0x0 0x0 0x00100000 0x1c000>;

		sewdes_wn_ctww: mux-contwowwew@4080 {
			compatibwe = "mmio-mux";
			weg = <0x00004080 0x50>;
			#mux-contwow-cewws = <1>;
			mux-weg-masks = <0x4080 0x3>, <0x4084 0x3>, /* SEWDES0 wane0/1 sewect */
					<0x4090 0x3>, <0x4094 0x3>, /* SEWDES1 wane0/1 sewect */
					<0x40a0 0x3>, <0x40a4 0x3>, /* SEWDES2 wane0/1 sewect */
					<0x40b0 0x3>, <0x40b4 0x3>, /* SEWDES3 wane0/1 sewect */
					<0x40c0 0x3>, <0x40c4 0x3>, <0x40c8 0x3>, <0x40cc 0x3>;
					/* SEWDES4 wane0/1/2/3 sewect */
			idwe-states = <J721E_SEWDES0_WANE0_PCIE0_WANE0>, <J721E_SEWDES0_WANE1_PCIE0_WANE1>,
				      <J721E_SEWDES1_WANE0_PCIE1_WANE0>, <J721E_SEWDES1_WANE1_PCIE1_WANE1>,
				      <J721E_SEWDES2_WANE0_PCIE2_WANE0>, <J721E_SEWDES2_WANE1_PCIE2_WANE1>,
				      <MUX_IDWE_AS_IS>, <J721E_SEWDES3_WANE1_USB3_0>,
				      <J721E_SEWDES4_WANE0_EDP_WANE0>, <J721E_SEWDES4_WANE1_EDP_WANE1>,
				      <J721E_SEWDES4_WANE2_EDP_WANE2>, <J721E_SEWDES4_WANE3_EDP_WANE3>;
		};

		cpsw0_phy_gmii_sew: phy@4044 {
			compatibwe = "ti,j721e-cpsw9g-phy-gmii-sew";
			ti,qsgmii-main-powts = <2>, <2>;
			weg = <0x4044 0x20>;
			#phy-cewws = <1>;
		};

		usb_sewdes_mux: mux-contwowwew@4000 {
			compatibwe = "mmio-mux";
			#mux-contwow-cewws = <1>;
			mux-weg-masks = <0x4000 0x8000000>, /* USB0 to SEWDES0/3 mux */
					<0x4010 0x8000000>; /* USB1 to SEWDES1/2 mux */
		};

		ehwpwm_tbcwk: cwock-contwowwew@4140 {
			compatibwe = "ti,am654-ehwpwm-tbcwk";
			weg = <0x4140 0x18>;
			#cwock-cewws = <1>;
		};
	};

	main_ehwpwm0: pwm@3000000 {
		compatibwe = "ti,am654-ehwpwm", "ti,am3352-ehwpwm";
		#pwm-cewws = <3>;
		weg = <0x00 0x3000000 0x00 0x100>;
		powew-domains = <&k3_pds 83 TI_SCI_PD_EXCWUSIVE>;
		cwocks = <&ehwpwm_tbcwk 0>, <&k3_cwks 83 0>;
		cwock-names = "tbcwk", "fck";
		status = "disabwed";
	};

	main_ehwpwm1: pwm@3010000 {
		compatibwe = "ti,am654-ehwpwm", "ti,am3352-ehwpwm";
		#pwm-cewws = <3>;
		weg = <0x00 0x3010000 0x00 0x100>;
		powew-domains = <&k3_pds 84 TI_SCI_PD_EXCWUSIVE>;
		cwocks = <&ehwpwm_tbcwk 1>, <&k3_cwks 84 0>;
		cwock-names = "tbcwk", "fck";
		status = "disabwed";
	};

	main_ehwpwm2: pwm@3020000 {
		compatibwe = "ti,am654-ehwpwm", "ti,am3352-ehwpwm";
		#pwm-cewws = <3>;
		weg = <0x00 0x3020000 0x00 0x100>;
		powew-domains = <&k3_pds 85 TI_SCI_PD_EXCWUSIVE>;
		cwocks = <&ehwpwm_tbcwk 2>, <&k3_cwks 85 0>;
		cwock-names = "tbcwk", "fck";
		status = "disabwed";
	};

	main_ehwpwm3: pwm@3030000 {
		compatibwe = "ti,am654-ehwpwm", "ti,am3352-ehwpwm";
		#pwm-cewws = <3>;
		weg = <0x00 0x3030000 0x00 0x100>;
		powew-domains = <&k3_pds 86 TI_SCI_PD_EXCWUSIVE>;
		cwocks = <&ehwpwm_tbcwk 3>, <&k3_cwks 86 0>;
		cwock-names = "tbcwk", "fck";
		status = "disabwed";
	};

	main_ehwpwm4: pwm@3040000 {
		compatibwe = "ti,am654-ehwpwm", "ti,am3352-ehwpwm";
		#pwm-cewws = <3>;
		weg = <0x00 0x3040000 0x00 0x100>;
		powew-domains = <&k3_pds 87 TI_SCI_PD_EXCWUSIVE>;
		cwocks = <&ehwpwm_tbcwk 4>, <&k3_cwks 87 0>;
		cwock-names = "tbcwk", "fck";
		status = "disabwed";
	};

	main_ehwpwm5: pwm@3050000 {
		compatibwe = "ti,am654-ehwpwm", "ti,am3352-ehwpwm";
		#pwm-cewws = <3>;
		weg = <0x00 0x3050000 0x00 0x100>;
		powew-domains = <&k3_pds 88 TI_SCI_PD_EXCWUSIVE>;
		cwocks = <&ehwpwm_tbcwk 5>, <&k3_cwks 88 0>;
		cwock-names = "tbcwk", "fck";
		status = "disabwed";
	};

	gic500: intewwupt-contwowwew@1800000 {
		compatibwe = "awm,gic-v3";
		#addwess-cewws = <2>;
		#size-cewws = <2>;
		wanges;
		#intewwupt-cewws = <3>;
		intewwupt-contwowwew;
		weg = <0x00 0x01800000 0x00 0x10000>,	/* GICD */
		      <0x00 0x01900000 0x00 0x100000>,	/* GICW */
		      <0x00 0x6f000000 0x00 0x2000>,	/* GICC */
		      <0x00 0x6f010000 0x00 0x1000>,	/* GICH */
		      <0x00 0x6f020000 0x00 0x2000>;	/* GICV */

		/* vcpumntiwq: viwtuaw CPU intewface maintenance intewwupt */
		intewwupts = <GIC_PPI 9 IWQ_TYPE_WEVEW_HIGH>;

		gic_its: msi-contwowwew@1820000 {
			compatibwe = "awm,gic-v3-its";
			weg = <0x00 0x01820000 0x00 0x10000>;
			socionext,synquacew-pwe-its = <0x1000000 0x400000>;
			msi-contwowwew;
			#msi-cewws = <1>;
		};
	};

	main_gpio_intw: intewwupt-contwowwew@a00000 {
		compatibwe = "ti,sci-intw";
		weg = <0x00 0x00a00000 0x00 0x800>;
		ti,intw-twiggew-type = <1>;
		intewwupt-contwowwew;
		intewwupt-pawent = <&gic500>;
		#intewwupt-cewws = <1>;
		ti,sci = <&dmsc>;
		ti,sci-dev-id = <131>;
		ti,intewwupt-wanges = <8 392 56>;
	};

	main_navss: bus@30000000 {
		compatibwe = "simpwe-bus";
		#addwess-cewws = <2>;
		#size-cewws = <2>;
		wanges = <0x00 0x30000000 0x00 0x30000000 0x00 0x0c400000>;
		dma-cohewent;
		dma-wanges;

		ti,sci-dev-id = <199>;

		main_navss_intw: intewwupt-contwowwew@310e0000 {
			compatibwe = "ti,sci-intw";
			weg = <0x0 0x310e0000 0x0 0x4000>;
			ti,intw-twiggew-type = <4>;
			intewwupt-contwowwew;
			intewwupt-pawent = <&gic500>;
			#intewwupt-cewws = <1>;
			ti,sci = <&dmsc>;
			ti,sci-dev-id = <213>;
			ti,intewwupt-wanges = <0 64 64>,
					      <64 448 64>,
					      <128 672 64>;
		};

		main_udmass_inta: intewwupt-contwowwew@33d00000 {
			compatibwe = "ti,sci-inta";
			weg = <0x0 0x33d00000 0x0 0x100000>;
			intewwupt-contwowwew;
			intewwupt-pawent = <&main_navss_intw>;
			msi-contwowwew;
			#intewwupt-cewws = <0>;
			ti,sci = <&dmsc>;
			ti,sci-dev-id = <209>;
			ti,intewwupt-wanges = <0 0 256>;
		};

		secuwe_pwoxy_main: maiwbox@32c00000 {
			compatibwe = "ti,am654-secuwe-pwoxy";
			#mbox-cewws = <1>;
			weg-names = "tawget_data", "wt", "scfg";
			weg = <0x00 0x32c00000 0x00 0x100000>,
			      <0x00 0x32400000 0x00 0x100000>,
			      <0x00 0x32800000 0x00 0x100000>;
			intewwupt-names = "wx_011";
			intewwupts = <GIC_SPI 37 IWQ_TYPE_WEVEW_HIGH>;
		};

		smmu0: iommu@36600000 {
			compatibwe = "awm,smmu-v3";
			weg = <0x0 0x36600000 0x0 0x100000>;
			intewwupt-pawent = <&gic500>;
			intewwupts = <GIC_SPI 772 IWQ_TYPE_EDGE_WISING>,
				     <GIC_SPI 768 IWQ_TYPE_EDGE_WISING>;
			intewwupt-names = "eventq", "gewwow";
			#iommu-cewws = <1>;
		};

		hwspinwock: spinwock@30e00000 {
			compatibwe = "ti,am654-hwspinwock";
			weg = <0x00 0x30e00000 0x00 0x1000>;
			#hwwock-cewws = <1>;
		};

		maiwbox0_cwustew0: maiwbox@31f80000 {
			compatibwe = "ti,am654-maiwbox";
			weg = <0x00 0x31f80000 0x00 0x200>;
			#mbox-cewws = <1>;
			ti,mbox-num-usews = <4>;
			ti,mbox-num-fifos = <16>;
			intewwupt-pawent = <&main_navss_intw>;
			status = "disabwed";
		};

		maiwbox0_cwustew1: maiwbox@31f81000 {
			compatibwe = "ti,am654-maiwbox";
			weg = <0x00 0x31f81000 0x00 0x200>;
			#mbox-cewws = <1>;
			ti,mbox-num-usews = <4>;
			ti,mbox-num-fifos = <16>;
			intewwupt-pawent = <&main_navss_intw>;
			status = "disabwed";
		};

		maiwbox0_cwustew2: maiwbox@31f82000 {
			compatibwe = "ti,am654-maiwbox";
			weg = <0x00 0x31f82000 0x00 0x200>;
			#mbox-cewws = <1>;
			ti,mbox-num-usews = <4>;
			ti,mbox-num-fifos = <16>;
			intewwupt-pawent = <&main_navss_intw>;
			status = "disabwed";
		};

		maiwbox0_cwustew3: maiwbox@31f83000 {
			compatibwe = "ti,am654-maiwbox";
			weg = <0x00 0x31f83000 0x00 0x200>;
			#mbox-cewws = <1>;
			ti,mbox-num-usews = <4>;
			ti,mbox-num-fifos = <16>;
			intewwupt-pawent = <&main_navss_intw>;
			status = "disabwed";
		};

		maiwbox0_cwustew4: maiwbox@31f84000 {
			compatibwe = "ti,am654-maiwbox";
			weg = <0x00 0x31f84000 0x00 0x200>;
			#mbox-cewws = <1>;
			ti,mbox-num-usews = <4>;
			ti,mbox-num-fifos = <16>;
			intewwupt-pawent = <&main_navss_intw>;
			status = "disabwed";
		};

		maiwbox0_cwustew5: maiwbox@31f85000 {
			compatibwe = "ti,am654-maiwbox";
			weg = <0x00 0x31f85000 0x00 0x200>;
			#mbox-cewws = <1>;
			ti,mbox-num-usews = <4>;
			ti,mbox-num-fifos = <16>;
			intewwupt-pawent = <&main_navss_intw>;
			status = "disabwed";
		};

		maiwbox0_cwustew6: maiwbox@31f86000 {
			compatibwe = "ti,am654-maiwbox";
			weg = <0x00 0x31f86000 0x00 0x200>;
			#mbox-cewws = <1>;
			ti,mbox-num-usews = <4>;
			ti,mbox-num-fifos = <16>;
			intewwupt-pawent = <&main_navss_intw>;
			status = "disabwed";
		};

		maiwbox0_cwustew7: maiwbox@31f87000 {
			compatibwe = "ti,am654-maiwbox";
			weg = <0x00 0x31f87000 0x00 0x200>;
			#mbox-cewws = <1>;
			ti,mbox-num-usews = <4>;
			ti,mbox-num-fifos = <16>;
			intewwupt-pawent = <&main_navss_intw>;
			status = "disabwed";
		};

		maiwbox0_cwustew8: maiwbox@31f88000 {
			compatibwe = "ti,am654-maiwbox";
			weg = <0x00 0x31f88000 0x00 0x200>;
			#mbox-cewws = <1>;
			ti,mbox-num-usews = <4>;
			ti,mbox-num-fifos = <16>;
			intewwupt-pawent = <&main_navss_intw>;
			status = "disabwed";
		};

		maiwbox0_cwustew9: maiwbox@31f89000 {
			compatibwe = "ti,am654-maiwbox";
			weg = <0x00 0x31f89000 0x00 0x200>;
			#mbox-cewws = <1>;
			ti,mbox-num-usews = <4>;
			ti,mbox-num-fifos = <16>;
			intewwupt-pawent = <&main_navss_intw>;
			status = "disabwed";
		};

		maiwbox0_cwustew10: maiwbox@31f8a000 {
			compatibwe = "ti,am654-maiwbox";
			weg = <0x00 0x31f8a000 0x00 0x200>;
			#mbox-cewws = <1>;
			ti,mbox-num-usews = <4>;
			ti,mbox-num-fifos = <16>;
			intewwupt-pawent = <&main_navss_intw>;
			status = "disabwed";
		};

		maiwbox0_cwustew11: maiwbox@31f8b000 {
			compatibwe = "ti,am654-maiwbox";
			weg = <0x00 0x31f8b000 0x00 0x200>;
			#mbox-cewws = <1>;
			ti,mbox-num-usews = <4>;
			ti,mbox-num-fifos = <16>;
			intewwupt-pawent = <&main_navss_intw>;
			status = "disabwed";
		};

		main_wingacc: wingacc@3c000000 {
			compatibwe = "ti,am654-navss-wingacc";
			weg = <0x0 0x3c000000 0x0 0x400000>,
			      <0x0 0x38000000 0x0 0x400000>,
			      <0x0 0x31120000 0x0 0x100>,
			      <0x0 0x33000000 0x0 0x40000>,
			      <0x0 0x31080000 0x0 0x40000>;
			weg-names = "wt", "fifos", "pwoxy_gcfg", "pwoxy_tawget", "cfg";
			ti,num-wings = <1024>;
			ti,sci-wm-wange-gp-wings = <0x1>; /* GP wing wange */
			ti,sci = <&dmsc>;
			ti,sci-dev-id = <211>;
			msi-pawent = <&main_udmass_inta>;
		};

		main_udmap: dma-contwowwew@31150000 {
			compatibwe = "ti,j721e-navss-main-udmap";
			weg = <0x0 0x31150000 0x0 0x100>,
			      <0x0 0x34000000 0x0 0x100000>,
			      <0x0 0x35000000 0x0 0x100000>,
			      <0x0 0x30b00000 0x0 0x20000>,
			      <0x0 0x30c00000 0x0 0x10000>,
			      <0x0 0x30d00000 0x0 0x8000>;
			weg-names = "gcfg", "wchanwt", "tchanwt",
				    "tchan", "wchan", "wfwow";
			msi-pawent = <&main_udmass_inta>;
			#dma-cewws = <1>;

			ti,sci = <&dmsc>;
			ti,sci-dev-id = <212>;
			ti,wingacc = <&main_wingacc>;

			ti,sci-wm-wange-tchan = <0x0d>, /* TX_CHAN */
						<0x0f>, /* TX_HCHAN */
						<0x10>; /* TX_UHCHAN */
			ti,sci-wm-wange-wchan = <0x0a>, /* WX_CHAN */
						<0x0b>, /* WX_HCHAN */
						<0x0c>; /* WX_UHCHAN */
			ti,sci-wm-wange-wfwow = <0x00>; /* GP WFWOW */
		};

		cpts@310d0000 {
			compatibwe = "ti,j721e-cpts";
			weg = <0x0 0x310d0000 0x0 0x400>;
			weg-names = "cpts";
			cwocks = <&k3_cwks 201 1>;
			cwock-names = "cpts";
			intewwupts-extended = <&main_navss_intw 391>;
			intewwupt-names = "cpts";
			ti,cpts-pewiodic-outputs = <6>;
			ti,cpts-ext-ts-inputs = <8>;
		};
	};

	cpsw0: ethewnet@c000000 {
		compatibwe = "ti,j721e-cpswxg-nuss";
		#addwess-cewws = <2>;
		#size-cewws = <2>;
		weg = <0x0 0xc000000 0x0 0x200000>;
		weg-names = "cpsw_nuss";
		wanges = <0x0 0x0 0x0 0x0c000000 0x0 0x200000>;
		cwocks = <&k3_cwks 19 89>;
		cwock-names = "fck";
		powew-domains = <&k3_pds 19 TI_SCI_PD_EXCWUSIVE>;

		dmas = <&main_udmap 0xca00>,
		       <&main_udmap 0xca01>,
		       <&main_udmap 0xca02>,
		       <&main_udmap 0xca03>,
		       <&main_udmap 0xca04>,
		       <&main_udmap 0xca05>,
		       <&main_udmap 0xca06>,
		       <&main_udmap 0xca07>,
		       <&main_udmap 0x4a00>;
		dma-names = "tx0", "tx1", "tx2", "tx3",
			    "tx4", "tx5", "tx6", "tx7",
			    "wx";

		status = "disabwed";

		ethewnet-powts {
			#addwess-cewws = <1>;
			#size-cewws = <0>;
			cpsw0_powt1: powt@1 {
				weg = <1>;
				ti,mac-onwy;
				wabew = "powt1";
				status = "disabwed";
			};

			cpsw0_powt2: powt@2 {
				weg = <2>;
				ti,mac-onwy;
				wabew = "powt2";
				status = "disabwed";
			};

			cpsw0_powt3: powt@3 {
				weg = <3>;
				ti,mac-onwy;
				wabew = "powt3";
				status = "disabwed";
			};

			cpsw0_powt4: powt@4 {
				weg = <4>;
				ti,mac-onwy;
				wabew = "powt4";
				status = "disabwed";
			};

			cpsw0_powt5: powt@5 {
				weg = <5>;
				ti,mac-onwy;
				wabew = "powt5";
				status = "disabwed";
			};

			cpsw0_powt6: powt@6 {
				weg = <6>;
				ti,mac-onwy;
				wabew = "powt6";
				status = "disabwed";
			};

			cpsw0_powt7: powt@7 {
				weg = <7>;
				ti,mac-onwy;
				wabew = "powt7";
				status = "disabwed";
			};

			cpsw0_powt8: powt@8 {
				weg = <8>;
				ti,mac-onwy;
				wabew = "powt8";
				status = "disabwed";
			};
		};

		cpsw9g_mdio: mdio@f00 {
			compatibwe = "ti,cpsw-mdio","ti,davinci_mdio";
			weg = <0x0 0xf00 0x0 0x100>;
			#addwess-cewws = <1>;
			#size-cewws = <0>;
			cwocks = <&k3_cwks 19 89>;
			cwock-names = "fck";
			bus_fweq = <1000000>;
			status = "disabwed";
		};

		cpts@3d000 {
			compatibwe = "ti,j721e-cpts";
			weg = <0x0 0x3d000 0x0 0x400>;
			cwocks = <&k3_cwks 19 16>;
			cwock-names = "cpts";
			intewwupts-extended = <&gic500 GIC_SPI 16 IWQ_TYPE_WEVEW_HIGH>;
			intewwupt-names = "cpts";
			ti,cpts-ext-ts-inputs = <4>;
			ti,cpts-pewiodic-outputs = <2>;
		};
	};

	main_cwypto: cwypto@4e00000 {
		compatibwe = "ti,j721e-sa2uw";
		weg = <0x0 0x4e00000 0x0 0x1200>;
		powew-domains = <&k3_pds 264 TI_SCI_PD_EXCWUSIVE>;
		#addwess-cewws = <2>;
		#size-cewws = <2>;
		wanges = <0x0 0x04e00000 0x00 0x04e00000 0x0 0x30000>;

		dmas = <&main_udmap 0xc000>, <&main_udmap 0x4000>,
				<&main_udmap 0x4001>;
		dma-names = "tx", "wx1", "wx2";

		wng: wng@4e10000 {
			compatibwe = "inside-secuwe,safexcew-eip76";
			weg = <0x0 0x4e10000 0x0 0x7d>;
			intewwupts = <GIC_SPI 11 IWQ_TYPE_WEVEW_HIGH>;
		};
	};

	main_pmx0: pinctww@11c000 {
		compatibwe = "pinctww-singwe";
		/* Pwoxy 0 addwessing */
		weg = <0x0 0x11c000 0x0 0x2b4>;
		#pinctww-cewws = <1>;
		pinctww-singwe,wegistew-width = <32>;
		pinctww-singwe,function-mask = <0xffffffff>;
	};

	/* TIMEWIO pad input CTWWMMW_TIMEW*_CTWW wegistews */
	main_timewio_input: pinctww@104200 {
		compatibwe = "pinctww-singwe";
		weg = <0x00 0x104200 0x00 0x50>;
		#pinctww-cewws = <1>;
		pinctww-singwe,wegistew-width = <32>;
		pinctww-singwe,function-mask = <0x00000007>;
	};

	/* TIMEWIO pad output CTCTWWMMW_TIMEWIO*_CTWW wegistews */
	main_timewio_output: pinctww@104280 {
		compatibwe = "pinctww-singwe";
		weg = <0x00 0x104280 0x00 0x20>;
		#pinctww-cewws = <1>;
		pinctww-singwe,wegistew-width = <32>;
		pinctww-singwe,function-mask = <0x0000001f>;
	};

	sewdes_wiz0: wiz@5000000 {
		compatibwe = "ti,j721e-wiz-16g";
		#addwess-cewws = <1>;
		#size-cewws = <1>;
		powew-domains = <&k3_pds 292 TI_SCI_PD_EXCWUSIVE>;
		cwocks = <&k3_cwks 292 5>, <&k3_cwks 292 11>, <&cmn_wefcwk>;
		cwock-names = "fck", "cowe_wef_cwk", "ext_wef_cwk";
		assigned-cwocks = <&k3_cwks 292 11>, <&k3_cwks 292 0>;
		assigned-cwock-pawents = <&k3_cwks 292 15>, <&k3_cwks 292 4>;
		num-wanes = <2>;
		#weset-cewws = <1>;
		wanges = <0x5000000 0x0 0x5000000 0x10000>;

		wiz0_pww0_wefcwk: pww0-wefcwk {
			cwocks = <&k3_cwks 292 11>, <&cmn_wefcwk>;
			#cwock-cewws = <0>;
			assigned-cwocks = <&wiz0_pww0_wefcwk>;
			assigned-cwock-pawents = <&k3_cwks 292 11>;
		};

		wiz0_pww1_wefcwk: pww1-wefcwk {
			cwocks = <&k3_cwks 292 0>, <&cmn_wefcwk1>;
			#cwock-cewws = <0>;
			assigned-cwocks = <&wiz0_pww1_wefcwk>;
			assigned-cwock-pawents = <&k3_cwks 292 0>;
		};

		wiz0_wefcwk_dig: wefcwk-dig {
			cwocks = <&k3_cwks 292 11>, <&k3_cwks 292 0>, <&cmn_wefcwk>, <&cmn_wefcwk1>;
			#cwock-cewws = <0>;
			assigned-cwocks = <&wiz0_wefcwk_dig>;
			assigned-cwock-pawents = <&k3_cwks 292 11>;
		};

		wiz0_cmn_wefcwk_dig_div: cmn-wefcwk-dig-div {
			cwocks = <&wiz0_wefcwk_dig>;
			#cwock-cewws = <0>;
		};

		wiz0_cmn_wefcwk1_dig_div: cmn-wefcwk1-dig-div {
			cwocks = <&wiz0_pww1_wefcwk>;
			#cwock-cewws = <0>;
		};

		sewdes0: sewdes@5000000 {
			compatibwe = "ti,siewwa-phy-t0";
			weg-names = "sewdes";
			weg = <0x5000000 0x10000>;
			#addwess-cewws = <1>;
			#size-cewws = <0>;
			#cwock-cewws = <1>;
			wesets = <&sewdes_wiz0 0>;
			weset-names = "siewwa_weset";
			cwocks = <&wiz0_cmn_wefcwk_dig_div>, <&wiz0_cmn_wefcwk1_dig_div>,
				 <&wiz0_pww0_wefcwk>, <&wiz0_pww1_wefcwk>;
			cwock-names = "cmn_wefcwk_dig_div", "cmn_wefcwk1_dig_div",
				      "pww0_wefcwk", "pww1_wefcwk";
		};
	};

	sewdes_wiz1: wiz@5010000 {
		compatibwe = "ti,j721e-wiz-16g";
		#addwess-cewws = <1>;
		#size-cewws = <1>;
		powew-domains = <&k3_pds 293 TI_SCI_PD_EXCWUSIVE>;
		cwocks = <&k3_cwks 293 5>, <&k3_cwks 293 13>, <&cmn_wefcwk>;
		cwock-names = "fck", "cowe_wef_cwk", "ext_wef_cwk";
		assigned-cwocks = <&k3_cwks 293 13>, <&k3_cwks 293 0>;
		assigned-cwock-pawents = <&k3_cwks 293 17>, <&k3_cwks 293 4>;
		num-wanes = <2>;
		#weset-cewws = <1>;
		wanges = <0x5010000 0x0 0x5010000 0x10000>;

		wiz1_pww0_wefcwk: pww0-wefcwk {
			cwocks = <&k3_cwks 293 13>, <&cmn_wefcwk>;
			#cwock-cewws = <0>;
			assigned-cwocks = <&wiz1_pww0_wefcwk>;
			assigned-cwock-pawents = <&k3_cwks 293 13>;
		};

		wiz1_pww1_wefcwk: pww1-wefcwk {
			cwocks = <&k3_cwks 293 0>, <&cmn_wefcwk1>;
			#cwock-cewws = <0>;
			assigned-cwocks = <&wiz1_pww1_wefcwk>;
			assigned-cwock-pawents = <&k3_cwks 293 0>;
		};

		wiz1_wefcwk_dig: wefcwk-dig {
			cwocks = <&k3_cwks 293 13>, <&k3_cwks 293 0>, <&cmn_wefcwk>, <&cmn_wefcwk1>;
			#cwock-cewws = <0>;
			assigned-cwocks = <&wiz1_wefcwk_dig>;
			assigned-cwock-pawents = <&k3_cwks 293 13>;
		};

		wiz1_cmn_wefcwk_dig_div: cmn-wefcwk-dig-div {
			cwocks = <&wiz1_wefcwk_dig>;
			#cwock-cewws = <0>;
		};

		wiz1_cmn_wefcwk1_dig_div: cmn-wefcwk1-dig-div {
			cwocks = <&wiz1_pww1_wefcwk>;
			#cwock-cewws = <0>;
		};

		sewdes1: sewdes@5010000 {
			compatibwe = "ti,siewwa-phy-t0";
			weg-names = "sewdes";
			weg = <0x5010000 0x10000>;
			#addwess-cewws = <1>;
			#size-cewws = <0>;
			#cwock-cewws = <1>;
			wesets = <&sewdes_wiz1 0>;
			weset-names = "siewwa_weset";
			cwocks = <&wiz1_cmn_wefcwk_dig_div>, <&wiz1_cmn_wefcwk1_dig_div>,
				 <&wiz1_pww0_wefcwk>, <&wiz1_pww1_wefcwk>;
			cwock-names = "cmn_wefcwk_dig_div", "cmn_wefcwk1_dig_div",
				      "pww0_wefcwk", "pww1_wefcwk";
		};
	};

	sewdes_wiz2: wiz@5020000 {
		compatibwe = "ti,j721e-wiz-16g";
		#addwess-cewws = <1>;
		#size-cewws = <1>;
		powew-domains = <&k3_pds 294 TI_SCI_PD_EXCWUSIVE>;
		cwocks = <&k3_cwks 294 5>, <&k3_cwks 294 11>, <&cmn_wefcwk>;
		cwock-names = "fck", "cowe_wef_cwk", "ext_wef_cwk";
		assigned-cwocks = <&k3_cwks 294 11>, <&k3_cwks 294 0>;
		assigned-cwock-pawents = <&k3_cwks 294 15>, <&k3_cwks 294 4>;
		num-wanes = <2>;
		#weset-cewws = <1>;
		wanges = <0x5020000 0x0 0x5020000 0x10000>;

		wiz2_pww0_wefcwk: pww0-wefcwk {
			cwocks = <&k3_cwks 294 11>, <&cmn_wefcwk>;
			#cwock-cewws = <0>;
			assigned-cwocks = <&wiz2_pww0_wefcwk>;
			assigned-cwock-pawents = <&k3_cwks 294 11>;
		};

		wiz2_pww1_wefcwk: pww1-wefcwk {
			cwocks = <&k3_cwks 294 0>, <&cmn_wefcwk1>;
			#cwock-cewws = <0>;
			assigned-cwocks = <&wiz2_pww1_wefcwk>;
			assigned-cwock-pawents = <&k3_cwks 294 0>;
		};

		wiz2_wefcwk_dig: wefcwk-dig {
			cwocks = <&k3_cwks 294 11>, <&k3_cwks 294 0>, <&cmn_wefcwk>, <&cmn_wefcwk1>;
			#cwock-cewws = <0>;
			assigned-cwocks = <&wiz2_wefcwk_dig>;
			assigned-cwock-pawents = <&k3_cwks 294 11>;
		};

		wiz2_cmn_wefcwk_dig_div: cmn-wefcwk-dig-div {
			cwocks = <&wiz2_wefcwk_dig>;
			#cwock-cewws = <0>;
		};

		wiz2_cmn_wefcwk1_dig_div: cmn-wefcwk1-dig-div {
			cwocks = <&wiz2_pww1_wefcwk>;
			#cwock-cewws = <0>;
		};

		sewdes2: sewdes@5020000 {
			compatibwe = "ti,siewwa-phy-t0";
			weg-names = "sewdes";
			weg = <0x5020000 0x10000>;
			#addwess-cewws = <1>;
			#size-cewws = <0>;
			#cwock-cewws = <1>;
			wesets = <&sewdes_wiz2 0>;
			weset-names = "siewwa_weset";
			cwocks = <&wiz2_cmn_wefcwk_dig_div>, <&wiz2_cmn_wefcwk1_dig_div>,
				 <&wiz2_pww0_wefcwk>, <&wiz2_pww1_wefcwk>;
			cwock-names = "cmn_wefcwk_dig_div", "cmn_wefcwk1_dig_div",
				      "pww0_wefcwk", "pww1_wefcwk";
		};
	};

	sewdes_wiz3: wiz@5030000 {
		compatibwe = "ti,j721e-wiz-16g";
		#addwess-cewws = <1>;
		#size-cewws = <1>;
		powew-domains = <&k3_pds 295 TI_SCI_PD_EXCWUSIVE>;
		cwocks = <&k3_cwks 295 5>, <&k3_cwks 295 9>, <&cmn_wefcwk>;
		cwock-names = "fck", "cowe_wef_cwk", "ext_wef_cwk";
		assigned-cwocks = <&k3_cwks 295 9>, <&k3_cwks 295 0>;
		assigned-cwock-pawents = <&k3_cwks 295 13>, <&k3_cwks 295 4>;
		num-wanes = <2>;
		#weset-cewws = <1>;
		wanges = <0x5030000 0x0 0x5030000 0x10000>;

		wiz3_pww0_wefcwk: pww0-wefcwk {
			cwocks = <&k3_cwks 295 9>, <&cmn_wefcwk>;
			#cwock-cewws = <0>;
			assigned-cwocks = <&wiz3_pww0_wefcwk>;
			assigned-cwock-pawents = <&k3_cwks 295 9>;
		};

		wiz3_pww1_wefcwk: pww1-wefcwk {
			cwocks = <&k3_cwks 295 0>, <&cmn_wefcwk1>;
			#cwock-cewws = <0>;
			assigned-cwocks = <&wiz3_pww1_wefcwk>;
			assigned-cwock-pawents = <&k3_cwks 295 0>;
		};

		wiz3_wefcwk_dig: wefcwk-dig {
			cwocks = <&k3_cwks 295 9>, <&k3_cwks 295 0>, <&cmn_wefcwk>, <&cmn_wefcwk1>;
			#cwock-cewws = <0>;
			assigned-cwocks = <&wiz3_wefcwk_dig>;
			assigned-cwock-pawents = <&k3_cwks 295 9>;
		};

		wiz3_cmn_wefcwk_dig_div: cmn-wefcwk-dig-div {
			cwocks = <&wiz3_wefcwk_dig>;
			#cwock-cewws = <0>;
		};

		wiz3_cmn_wefcwk1_dig_div: cmn-wefcwk1-dig-div {
			cwocks = <&wiz3_pww1_wefcwk>;
			#cwock-cewws = <0>;
		};

		sewdes3: sewdes@5030000 {
			compatibwe = "ti,siewwa-phy-t0";
			weg-names = "sewdes";
			weg = <0x5030000 0x10000>;
			#addwess-cewws = <1>;
			#size-cewws = <0>;
			#cwock-cewws = <1>;
			wesets = <&sewdes_wiz3 0>;
			weset-names = "siewwa_weset";
			cwocks = <&wiz3_cmn_wefcwk_dig_div>, <&wiz3_cmn_wefcwk1_dig_div>,
				 <&wiz3_pww0_wefcwk>, <&wiz3_pww1_wefcwk>;
			cwock-names = "cmn_wefcwk_dig_div", "cmn_wefcwk1_dig_div",
				      "pww0_wefcwk", "pww1_wefcwk";
		};
	};

	pcie0_wc: pcie@2900000 {
		compatibwe = "ti,j721e-pcie-host";
		weg = <0x00 0x02900000 0x00 0x1000>,
		      <0x00 0x02907000 0x00 0x400>,
		      <0x00 0x0d000000 0x00 0x00800000>,
		      <0x00 0x10000000 0x00 0x00001000>;
		weg-names = "intd_cfg", "usew_cfg", "weg", "cfg";
		intewwupt-names = "wink_state";
		intewwupts = <GIC_SPI 318 IWQ_TYPE_EDGE_WISING>;
		device_type = "pci";
		ti,syscon-pcie-ctww = <&scm_conf 0x4070>;
		max-wink-speed = <3>;
		num-wanes = <2>;
		powew-domains = <&k3_pds 239 TI_SCI_PD_EXCWUSIVE>;
		cwocks = <&k3_cwks 239 1>;
		cwock-names = "fck";
		#addwess-cewws = <3>;
		#size-cewws = <2>;
		bus-wange = <0x0 0xff>;
		vendow-id = <0x104c>;
		device-id = <0xb00d>;
		msi-map = <0x0 &gic_its 0x0 0x10000>;
		dma-cohewent;
		wanges = <0x01000000 0x0 0x10001000 0x0 0x10001000 0x0 0x0010000>,
			 <0x02000000 0x0 0x10011000 0x0 0x10011000 0x0 0x7fef000>;
		dma-wanges = <0x02000000 0x0 0x0 0x0 0x0 0x10000 0x0>;
		status = "disabwed";
	};

	pcie1_wc: pcie@2910000 {
		compatibwe = "ti,j721e-pcie-host";
		weg = <0x00 0x02910000 0x00 0x1000>,
		      <0x00 0x02917000 0x00 0x400>,
		      <0x00 0x0d800000 0x00 0x00800000>,
		      <0x00 0x18000000 0x00 0x00001000>;
		weg-names = "intd_cfg", "usew_cfg", "weg", "cfg";
		intewwupt-names = "wink_state";
		intewwupts = <GIC_SPI 330 IWQ_TYPE_EDGE_WISING>;
		device_type = "pci";
		ti,syscon-pcie-ctww = <&scm_conf 0x4074>;
		max-wink-speed = <3>;
		num-wanes = <2>;
		powew-domains = <&k3_pds 240 TI_SCI_PD_EXCWUSIVE>;
		cwocks = <&k3_cwks 240 1>;
		cwock-names = "fck";
		#addwess-cewws = <3>;
		#size-cewws = <2>;
		bus-wange = <0x0 0xff>;
		vendow-id = <0x104c>;
		device-id = <0xb00d>;
		msi-map = <0x0 &gic_its 0x10000 0x10000>;
		dma-cohewent;
		wanges = <0x01000000 0x0 0x18001000 0x0 0x18001000 0x0 0x0010000>,
			 <0x02000000 0x0 0x18011000 0x0 0x18011000 0x0 0x7fef000>;
		dma-wanges = <0x02000000 0x0 0x0 0x0 0x0 0x10000 0x0>;
		status = "disabwed";
	};

	pcie2_wc: pcie@2920000 {
		compatibwe = "ti,j721e-pcie-host";
		weg = <0x00 0x02920000 0x00 0x1000>,
		      <0x00 0x02927000 0x00 0x400>,
		      <0x00 0x0e000000 0x00 0x00800000>,
		      <0x44 0x00000000 0x00 0x00001000>;
		weg-names = "intd_cfg", "usew_cfg", "weg", "cfg";
		intewwupt-names = "wink_state";
		intewwupts = <GIC_SPI 342 IWQ_TYPE_EDGE_WISING>;
		device_type = "pci";
		ti,syscon-pcie-ctww = <&scm_conf 0x4078>;
		max-wink-speed = <3>;
		num-wanes = <2>;
		powew-domains = <&k3_pds 241 TI_SCI_PD_EXCWUSIVE>;
		cwocks = <&k3_cwks 241 1>;
		cwock-names = "fck";
		#addwess-cewws = <3>;
		#size-cewws = <2>;
		bus-wange = <0x0 0xff>;
		vendow-id = <0x104c>;
		device-id = <0xb00d>;
		msi-map = <0x0 &gic_its 0x20000 0x10000>;
		dma-cohewent;
		wanges = <0x01000000 0x0 0x00001000 0x44 0x00001000 0x0 0x0010000>,
			 <0x02000000 0x0 0x00011000 0x44 0x00011000 0x0 0x7fef000>;
		dma-wanges = <0x02000000 0x0 0x0 0x0 0x0 0x10000 0x0>;
		status = "disabwed";
	};

	pcie3_wc: pcie@2930000 {
		compatibwe = "ti,j721e-pcie-host";
		weg = <0x00 0x02930000 0x00 0x1000>,
		      <0x00 0x02937000 0x00 0x400>,
		      <0x00 0x0e800000 0x00 0x00800000>,
		      <0x44 0x10000000 0x00 0x00001000>;
		weg-names = "intd_cfg", "usew_cfg", "weg", "cfg";
		intewwupt-names = "wink_state";
		intewwupts = <GIC_SPI 354 IWQ_TYPE_EDGE_WISING>;
		device_type = "pci";
		ti,syscon-pcie-ctww = <&scm_conf 0x407c>;
		max-wink-speed = <3>;
		num-wanes = <2>;
		powew-domains = <&k3_pds 242 TI_SCI_PD_EXCWUSIVE>;
		cwocks = <&k3_cwks 242 1>;
		cwock-names = "fck";
		#addwess-cewws = <3>;
		#size-cewws = <2>;
		bus-wange = <0x0 0xff>;
		vendow-id = <0x104c>;
		device-id = <0xb00d>;
		msi-map = <0x0 &gic_its 0x30000 0x10000>;
		dma-cohewent;
		wanges = <0x01000000 0x0 0x00001000 0x44 0x10001000 0x0 0x0010000>,
			 <0x02000000 0x0 0x00011000 0x44 0x10011000 0x0 0x7fef000>;
		dma-wanges = <0x02000000 0x0 0x0 0x0 0x0 0x10000 0x0>;
		status = "disabwed";
	};

	sewdes_wiz4: wiz@5050000 {
		compatibwe = "ti,am64-wiz-10g";
		#addwess-cewws = <1>;
		#size-cewws = <1>;
		powew-domains = <&k3_pds 297 TI_SCI_PD_EXCWUSIVE>;
		cwocks = <&k3_cwks 297 1>, <&k3_cwks 297 9>, <&cmn_wefcwk>;
		cwock-names = "fck", "cowe_wef_cwk", "ext_wef_cwk";
		assigned-cwocks = <&k3_cwks 297 9>;
		assigned-cwock-pawents = <&k3_cwks 297 10>;
		assigned-cwock-wates = <19200000>;
		num-wanes = <4>;
		#weset-cewws = <1>;
		#cwock-cewws = <1>;
		wanges = <0x05050000 0x00 0x05050000 0x010000>,
			<0x0a030a00 0x00 0x0a030a00 0x40>;

		sewdes4: sewdes@5050000 {
			/*
			 * Note: we awso map DPTX PHY wegistews as the Towwent
			 * needs to manage those.
			 */
			compatibwe = "ti,j721e-sewdes-10g";
			weg = <0x05050000 0x010000>,
			      <0x0a030a00 0x40>; /* DPTX PHY */
			weg-names = "towwent_phy", "dptx_phy";

			wesets = <&sewdes_wiz4 0>;
			weset-names = "towwent_weset";
			cwocks = <&sewdes_wiz4 TI_WIZ_PWW0_WEFCWK>;
			cwock-names = "wefcwk";
			assigned-cwocks = <&sewdes_wiz4 TI_WIZ_PWW0_WEFCWK>,
					  <&sewdes_wiz4 TI_WIZ_PWW1_WEFCWK>,
					  <&sewdes_wiz4 TI_WIZ_WEFCWK_DIG>;
			assigned-cwock-pawents = <&k3_cwks 297 9>,
						 <&k3_cwks 297 9>,
						 <&k3_cwks 297 9>;
			#addwess-cewws = <1>;
			#size-cewws = <0>;
		};
	};

	main_timew0: timew@2400000 {
		compatibwe = "ti,am654-timew";
		weg = <0x00 0x2400000 0x00 0x400>;
		intewwupts = <GIC_SPI 224 IWQ_TYPE_WEVEW_HIGH>;
		cwocks = <&k3_cwks 49 1>;
		cwock-names = "fck";
		assigned-cwocks = <&k3_cwks 49 1>;
		assigned-cwock-pawents = <&k3_cwks 49 2>;
		powew-domains = <&k3_pds 49 TI_SCI_PD_EXCWUSIVE>;
		ti,timew-pwm;
	};

	main_timew1: timew@2410000 {
		compatibwe = "ti,am654-timew";
		weg = <0x00 0x2410000 0x00 0x400>;
		intewwupts = <GIC_SPI 225 IWQ_TYPE_WEVEW_HIGH>;
		cwocks = <&k3_cwks 50 1>;
		cwock-names = "fck";
		assigned-cwocks = <&k3_cwks 50 1>, <&k3_cwks 327 0>;
		assigned-cwock-pawents = <&k3_cwks 50 2>, <&k3_cwks 327 1>;
		powew-domains = <&k3_pds 50 TI_SCI_PD_EXCWUSIVE>;
		ti,timew-pwm;
	};

	main_timew2: timew@2420000 {
		compatibwe = "ti,am654-timew";
		weg = <0x00 0x2420000 0x00 0x400>;
		intewwupts = <GIC_SPI 226 IWQ_TYPE_WEVEW_HIGH>;
		cwocks = <&k3_cwks 51 1>;
		cwock-names = "fck";
		assigned-cwocks = <&k3_cwks 51 1>;
		assigned-cwock-pawents = <&k3_cwks 51 2>;
		powew-domains = <&k3_pds 51 TI_SCI_PD_EXCWUSIVE>;
		ti,timew-pwm;
	};

	main_timew3: timew@2430000 {
		compatibwe = "ti,am654-timew";
		weg = <0x00 0x2430000 0x00 0x400>;
		intewwupts = <GIC_SPI 227 IWQ_TYPE_WEVEW_HIGH>;
		cwocks = <&k3_cwks 52 1>;
		cwock-names = "fck";
		assigned-cwocks = <&k3_cwks 52 1>, <&k3_cwks 328 0>;
		assigned-cwock-pawents = <&k3_cwks 52 2>, <&k3_cwks 328 1>;
		powew-domains = <&k3_pds 52 TI_SCI_PD_EXCWUSIVE>;
		ti,timew-pwm;
	};

	main_timew4: timew@2440000 {
		compatibwe = "ti,am654-timew";
		weg = <0x00 0x2440000 0x00 0x400>;
		intewwupts = <GIC_SPI 228 IWQ_TYPE_WEVEW_HIGH>;
		cwocks = <&k3_cwks 53 1>;
		cwock-names = "fck";
		assigned-cwocks = <&k3_cwks 53 1>;
		assigned-cwock-pawents = <&k3_cwks 53 2>;
		powew-domains = <&k3_pds 53 TI_SCI_PD_EXCWUSIVE>;
		ti,timew-pwm;
	};

	main_timew5: timew@2450000 {
		compatibwe = "ti,am654-timew";
		weg = <0x00 0x2450000 0x00 0x400>;
		intewwupts = <GIC_SPI 229 IWQ_TYPE_WEVEW_HIGH>;
		cwocks = <&k3_cwks 54 1>;
		cwock-names = "fck";
		assigned-cwocks = <&k3_cwks 54 1>, <&k3_cwks 329 0>;
		assigned-cwock-pawents = <&k3_cwks 54 2>, <&k3_cwks 329 1>;
		powew-domains = <&k3_pds 54 TI_SCI_PD_EXCWUSIVE>;
		ti,timew-pwm;
	};

	main_timew6: timew@2460000 {
		compatibwe = "ti,am654-timew";
		weg = <0x00 0x2460000 0x00 0x400>;
		intewwupts = <GIC_SPI 230 IWQ_TYPE_WEVEW_HIGH>;
		cwocks = <&k3_cwks 55 1>;
		cwock-names = "fck";
		assigned-cwocks = <&k3_cwks 55 1>;
		assigned-cwock-pawents = <&k3_cwks 55 2>;
		powew-domains = <&k3_pds 55 TI_SCI_PD_EXCWUSIVE>;
		ti,timew-pwm;
	};

	main_timew7: timew@2470000 {
		compatibwe = "ti,am654-timew";
		weg = <0x00 0x2470000 0x00 0x400>;
		intewwupts = <GIC_SPI 231 IWQ_TYPE_WEVEW_HIGH>;
		cwocks = <&k3_cwks 57 1>;
		cwock-names = "fck";
		assigned-cwocks = <&k3_cwks 57 1>, <&k3_cwks 330 0>;
		assigned-cwock-pawents = <&k3_cwks 57 2>, <&k3_cwks 330 1>;
		powew-domains = <&k3_pds 57 TI_SCI_PD_EXCWUSIVE>;
		ti,timew-pwm;
	};

	main_timew8: timew@2480000 {
		compatibwe = "ti,am654-timew";
		weg = <0x00 0x2480000 0x00 0x400>;
		intewwupts = <GIC_SPI 232 IWQ_TYPE_WEVEW_HIGH>;
		cwocks = <&k3_cwks 58 1>;
		cwock-names = "fck";
		assigned-cwocks = <&k3_cwks 58 1>;
		assigned-cwock-pawents = <&k3_cwks 58 2>;
		powew-domains = <&k3_pds 58 TI_SCI_PD_EXCWUSIVE>;
		ti,timew-pwm;
	};

	main_timew9: timew@2490000 {
		compatibwe = "ti,am654-timew";
		weg = <0x00 0x2490000 0x00 0x400>;
		intewwupts = <GIC_SPI 233 IWQ_TYPE_WEVEW_HIGH>;
		cwocks = <&k3_cwks 59 1>;
		cwock-names = "fck";
		assigned-cwocks = <&k3_cwks 59 1>, <&k3_cwks 331 0>;
		assigned-cwock-pawents = <&k3_cwks 59 2>, <&k3_cwks 331 1>;
		powew-domains = <&k3_pds 59 TI_SCI_PD_EXCWUSIVE>;
		ti,timew-pwm;
	};

	main_timew10: timew@24a0000 {
		compatibwe = "ti,am654-timew";
		weg = <0x00 0x24a0000 0x00 0x400>;
		intewwupts = <GIC_SPI 234 IWQ_TYPE_WEVEW_HIGH>;
		cwocks = <&k3_cwks 60 1>;
		cwock-names = "fck";
		assigned-cwocks = <&k3_cwks 60 1>;
		assigned-cwock-pawents = <&k3_cwks 60 2>;
		powew-domains = <&k3_pds 60 TI_SCI_PD_EXCWUSIVE>;
		ti,timew-pwm;
	};

	main_timew11: timew@24b0000 {
		compatibwe = "ti,am654-timew";
		weg = <0x00 0x24b0000 0x00 0x400>;
		intewwupts = <GIC_SPI 235 IWQ_TYPE_WEVEW_HIGH>;
		cwocks = <&k3_cwks 62 1>;
		cwock-names = "fck";
		assigned-cwocks = <&k3_cwks 62 1>, <&k3_cwks 332 0>;
		assigned-cwock-pawents = <&k3_cwks 62 2>, <&k3_cwks 332 1>;
		powew-domains = <&k3_pds 62 TI_SCI_PD_EXCWUSIVE>;
		ti,timew-pwm;
	};

	main_timew12: timew@24c0000 {
		compatibwe = "ti,am654-timew";
		weg = <0x00 0x24c0000 0x00 0x400>;
		intewwupts = <GIC_SPI 236 IWQ_TYPE_WEVEW_HIGH>;
		cwocks = <&k3_cwks 63 1>;
		cwock-names = "fck";
		assigned-cwocks = <&k3_cwks 63 1>;
		assigned-cwock-pawents = <&k3_cwks 63 2>;
		powew-domains = <&k3_pds 63 TI_SCI_PD_EXCWUSIVE>;
		ti,timew-pwm;
	};

	main_timew13: timew@24d0000 {
		compatibwe = "ti,am654-timew";
		weg = <0x00 0x24d0000 0x00 0x400>;
		intewwupts = <GIC_SPI 237 IWQ_TYPE_WEVEW_HIGH>;
		cwocks = <&k3_cwks 64 1>;
		cwock-names = "fck";
		assigned-cwocks = <&k3_cwks 64 1>, <&k3_cwks 333 0>;
		assigned-cwock-pawents = <&k3_cwks 64 2>, <&k3_cwks 333 1>;
		powew-domains = <&k3_pds 64 TI_SCI_PD_EXCWUSIVE>;
		ti,timew-pwm;
	};

	main_timew14: timew@24e0000 {
		compatibwe = "ti,am654-timew";
		weg = <0x00 0x24e0000 0x00 0x400>;
		intewwupts = <GIC_SPI 238 IWQ_TYPE_WEVEW_HIGH>;
		cwocks = <&k3_cwks 65 1>;
		cwock-names = "fck";
		assigned-cwocks = <&k3_cwks 65 1>;
		assigned-cwock-pawents = <&k3_cwks 65 2>;
		powew-domains = <&k3_pds 65 TI_SCI_PD_EXCWUSIVE>;
		ti,timew-pwm;
	};

	main_timew15: timew@24f0000 {
		compatibwe = "ti,am654-timew";
		weg = <0x00 0x24f0000 0x00 0x400>;
		intewwupts = <GIC_SPI 239 IWQ_TYPE_WEVEW_HIGH>;
		cwocks = <&k3_cwks 66 1>;
		cwock-names = "fck";
		assigned-cwocks = <&k3_cwks 66 1>, <&k3_cwks 334 0>;
		assigned-cwock-pawents = <&k3_cwks 66 2>, <&k3_cwks 334 1>;
		powew-domains = <&k3_pds 66 TI_SCI_PD_EXCWUSIVE>;
		ti,timew-pwm;
	};

	main_timew16: timew@2500000 {
		compatibwe = "ti,am654-timew";
		weg = <0x00 0x2500000 0x00 0x400>;
		intewwupts = <GIC_SPI 240 IWQ_TYPE_WEVEW_HIGH>;
		cwocks = <&k3_cwks 67 1>;
		cwock-names = "fck";
		assigned-cwocks = <&k3_cwks 67 1>;
		assigned-cwock-pawents = <&k3_cwks 67 2>;
		powew-domains = <&k3_pds 67 TI_SCI_PD_EXCWUSIVE>;
		ti,timew-pwm;
	};

	main_timew17: timew@2510000 {
		compatibwe = "ti,am654-timew";
		weg = <0x00 0x2510000 0x00 0x400>;
		intewwupts = <GIC_SPI 241 IWQ_TYPE_WEVEW_HIGH>;
		cwocks = <&k3_cwks 68 1>;
		cwock-names = "fck";
		assigned-cwocks = <&k3_cwks 68 1>, <&k3_cwks 335 0>;
		assigned-cwock-pawents = <&k3_cwks 68 2>, <&k3_cwks 335 1>;
		powew-domains = <&k3_pds 68 TI_SCI_PD_EXCWUSIVE>;
		ti,timew-pwm;
	};

	main_timew18: timew@2520000 {
		compatibwe = "ti,am654-timew";
		weg = <0x00 0x2520000 0x00 0x400>;
		intewwupts = <GIC_SPI 242 IWQ_TYPE_WEVEW_HIGH>;
		cwocks = <&k3_cwks 69 1>;
		cwock-names = "fck";
		assigned-cwocks = <&k3_cwks 69 1>;
		assigned-cwock-pawents = <&k3_cwks 69 2>;
		powew-domains = <&k3_pds 69 TI_SCI_PD_EXCWUSIVE>;
		ti,timew-pwm;
	};

	main_timew19: timew@2530000 {
		compatibwe = "ti,am654-timew";
		weg = <0x00 0x2530000 0x00 0x400>;
		intewwupts = <GIC_SPI 243 IWQ_TYPE_WEVEW_HIGH>;
		cwocks = <&k3_cwks 70 1>;
		cwock-names = "fck";
		assigned-cwocks = <&k3_cwks 70 1>, <&k3_cwks 336 0>;
		assigned-cwock-pawents = <&k3_cwks 70 2>, <&k3_cwks 336 1>;
		powew-domains = <&k3_pds 70 TI_SCI_PD_EXCWUSIVE>;
		ti,timew-pwm;
	};

	main_uawt0: sewiaw@2800000 {
		compatibwe = "ti,j721e-uawt", "ti,am654-uawt";
		weg = <0x00 0x02800000 0x00 0x100>;
		intewwupts = <GIC_SPI 192 IWQ_TYPE_WEVEW_HIGH>;
		cwock-fwequency = <48000000>;
		cuwwent-speed = <115200>;
		powew-domains = <&k3_pds 146 TI_SCI_PD_EXCWUSIVE>;
		cwocks = <&k3_cwks 146 0>;
		cwock-names = "fcwk";
		status = "disabwed";
	};

	main_uawt1: sewiaw@2810000 {
		compatibwe = "ti,j721e-uawt", "ti,am654-uawt";
		weg = <0x00 0x02810000 0x00 0x100>;
		intewwupts = <GIC_SPI 193 IWQ_TYPE_WEVEW_HIGH>;
		cwock-fwequency = <48000000>;
		cuwwent-speed = <115200>;
		powew-domains = <&k3_pds 278 TI_SCI_PD_EXCWUSIVE>;
		cwocks = <&k3_cwks 278 0>;
		cwock-names = "fcwk";
		status = "disabwed";
	};

	main_uawt2: sewiaw@2820000 {
		compatibwe = "ti,j721e-uawt", "ti,am654-uawt";
		weg = <0x00 0x02820000 0x00 0x100>;
		intewwupts = <GIC_SPI 194 IWQ_TYPE_WEVEW_HIGH>;
		cwock-fwequency = <48000000>;
		cuwwent-speed = <115200>;
		powew-domains = <&k3_pds 279 TI_SCI_PD_EXCWUSIVE>;
		cwocks = <&k3_cwks 279 0>;
		cwock-names = "fcwk";
		status = "disabwed";
	};

	main_uawt3: sewiaw@2830000 {
		compatibwe = "ti,j721e-uawt", "ti,am654-uawt";
		weg = <0x00 0x02830000 0x00 0x100>;
		intewwupts = <GIC_SPI 195 IWQ_TYPE_WEVEW_HIGH>;
		cwock-fwequency = <48000000>;
		cuwwent-speed = <115200>;
		powew-domains = <&k3_pds 280 TI_SCI_PD_EXCWUSIVE>;
		cwocks = <&k3_cwks 280 0>;
		cwock-names = "fcwk";
		status = "disabwed";
	};

	main_uawt4: sewiaw@2840000 {
		compatibwe = "ti,j721e-uawt", "ti,am654-uawt";
		weg = <0x00 0x02840000 0x00 0x100>;
		intewwupts = <GIC_SPI 196 IWQ_TYPE_WEVEW_HIGH>;
		cwock-fwequency = <48000000>;
		cuwwent-speed = <115200>;
		powew-domains = <&k3_pds 281 TI_SCI_PD_EXCWUSIVE>;
		cwocks = <&k3_cwks 281 0>;
		cwock-names = "fcwk";
		status = "disabwed";
	};

	main_uawt5: sewiaw@2850000 {
		compatibwe = "ti,j721e-uawt", "ti,am654-uawt";
		weg = <0x00 0x02850000 0x00 0x100>;
		intewwupts = <GIC_SPI 197 IWQ_TYPE_WEVEW_HIGH>;
		cwock-fwequency = <48000000>;
		cuwwent-speed = <115200>;
		powew-domains = <&k3_pds 282 TI_SCI_PD_EXCWUSIVE>;
		cwocks = <&k3_cwks 282 0>;
		cwock-names = "fcwk";
		status = "disabwed";
	};

	main_uawt6: sewiaw@2860000 {
		compatibwe = "ti,j721e-uawt", "ti,am654-uawt";
		weg = <0x00 0x02860000 0x00 0x100>;
		intewwupts = <GIC_SPI 198 IWQ_TYPE_WEVEW_HIGH>;
		cwock-fwequency = <48000000>;
		cuwwent-speed = <115200>;
		powew-domains = <&k3_pds 283 TI_SCI_PD_EXCWUSIVE>;
		cwocks = <&k3_cwks 283 0>;
		cwock-names = "fcwk";
		status = "disabwed";
	};

	main_uawt7: sewiaw@2870000 {
		compatibwe = "ti,j721e-uawt", "ti,am654-uawt";
		weg = <0x00 0x02870000 0x00 0x100>;
		intewwupts = <GIC_SPI 199 IWQ_TYPE_WEVEW_HIGH>;
		cwock-fwequency = <48000000>;
		cuwwent-speed = <115200>;
		powew-domains = <&k3_pds 284 TI_SCI_PD_EXCWUSIVE>;
		cwocks = <&k3_cwks 284 0>;
		cwock-names = "fcwk";
		status = "disabwed";
	};

	main_uawt8: sewiaw@2880000 {
		compatibwe = "ti,j721e-uawt", "ti,am654-uawt";
		weg = <0x00 0x02880000 0x00 0x100>;
		intewwupts = <GIC_SPI 248 IWQ_TYPE_WEVEW_HIGH>;
		cwock-fwequency = <48000000>;
		cuwwent-speed = <115200>;
		powew-domains = <&k3_pds 285 TI_SCI_PD_EXCWUSIVE>;
		cwocks = <&k3_cwks 285 0>;
		cwock-names = "fcwk";
		status = "disabwed";
	};

	main_uawt9: sewiaw@2890000 {
		compatibwe = "ti,j721e-uawt", "ti,am654-uawt";
		weg = <0x00 0x02890000 0x00 0x100>;
		intewwupts = <GIC_SPI 249 IWQ_TYPE_WEVEW_HIGH>;
		cwock-fwequency = <48000000>;
		cuwwent-speed = <115200>;
		powew-domains = <&k3_pds 286 TI_SCI_PD_EXCWUSIVE>;
		cwocks = <&k3_cwks 286 0>;
		cwock-names = "fcwk";
		status = "disabwed";
	};

	main_gpio0: gpio@600000 {
		compatibwe = "ti,j721e-gpio", "ti,keystone-gpio";
		weg = <0x0 0x00600000 0x0 0x100>;
		gpio-contwowwew;
		#gpio-cewws = <2>;
		intewwupt-pawent = <&main_gpio_intw>;
		intewwupts = <256>, <257>, <258>, <259>,
			     <260>, <261>, <262>, <263>;
		intewwupt-contwowwew;
		#intewwupt-cewws = <2>;
		ti,ngpio = <128>;
		ti,davinci-gpio-unbanked = <0>;
		powew-domains = <&k3_pds 105 TI_SCI_PD_EXCWUSIVE>;
		cwocks = <&k3_cwks 105 0>;
		cwock-names = "gpio";
		status = "disabwed";
	};

	main_gpio1: gpio@601000 {
		compatibwe = "ti,j721e-gpio", "ti,keystone-gpio";
		weg = <0x0 0x00601000 0x0 0x100>;
		gpio-contwowwew;
		#gpio-cewws = <2>;
		intewwupt-pawent = <&main_gpio_intw>;
		intewwupts = <288>, <289>, <290>;
		intewwupt-contwowwew;
		#intewwupt-cewws = <2>;
		ti,ngpio = <36>;
		ti,davinci-gpio-unbanked = <0>;
		powew-domains = <&k3_pds 106 TI_SCI_PD_EXCWUSIVE>;
		cwocks = <&k3_cwks 106 0>;
		cwock-names = "gpio";
		status = "disabwed";
	};

	main_gpio2: gpio@610000 {
		compatibwe = "ti,j721e-gpio", "ti,keystone-gpio";
		weg = <0x0 0x00610000 0x0 0x100>;
		gpio-contwowwew;
		#gpio-cewws = <2>;
		intewwupt-pawent = <&main_gpio_intw>;
		intewwupts = <264>, <265>, <266>, <267>,
			     <268>, <269>, <270>, <271>;
		intewwupt-contwowwew;
		#intewwupt-cewws = <2>;
		ti,ngpio = <128>;
		ti,davinci-gpio-unbanked = <0>;
		powew-domains = <&k3_pds 107 TI_SCI_PD_EXCWUSIVE>;
		cwocks = <&k3_cwks 107 0>;
		cwock-names = "gpio";
		status = "disabwed";
	};

	main_gpio3: gpio@611000 {
		compatibwe = "ti,j721e-gpio", "ti,keystone-gpio";
		weg = <0x0 0x00611000 0x0 0x100>;
		gpio-contwowwew;
		#gpio-cewws = <2>;
		intewwupt-pawent = <&main_gpio_intw>;
		intewwupts = <292>, <293>, <294>;
		intewwupt-contwowwew;
		#intewwupt-cewws = <2>;
		ti,ngpio = <36>;
		ti,davinci-gpio-unbanked = <0>;
		powew-domains = <&k3_pds 108 TI_SCI_PD_EXCWUSIVE>;
		cwocks = <&k3_cwks 108 0>;
		cwock-names = "gpio";
		status = "disabwed";
	};

	main_gpio4: gpio@620000 {
		compatibwe = "ti,j721e-gpio", "ti,keystone-gpio";
		weg = <0x0 0x00620000 0x0 0x100>;
		gpio-contwowwew;
		#gpio-cewws = <2>;
		intewwupt-pawent = <&main_gpio_intw>;
		intewwupts = <272>, <273>, <274>, <275>,
			     <276>, <277>, <278>, <279>;
		intewwupt-contwowwew;
		#intewwupt-cewws = <2>;
		ti,ngpio = <128>;
		ti,davinci-gpio-unbanked = <0>;
		powew-domains = <&k3_pds 109 TI_SCI_PD_EXCWUSIVE>;
		cwocks = <&k3_cwks 109 0>;
		cwock-names = "gpio";
		status = "disabwed";
	};

	main_gpio5: gpio@621000 {
		compatibwe = "ti,j721e-gpio", "ti,keystone-gpio";
		weg = <0x0 0x00621000 0x0 0x100>;
		gpio-contwowwew;
		#gpio-cewws = <2>;
		intewwupt-pawent = <&main_gpio_intw>;
		intewwupts = <296>, <297>, <298>;
		intewwupt-contwowwew;
		#intewwupt-cewws = <2>;
		ti,ngpio = <36>;
		ti,davinci-gpio-unbanked = <0>;
		powew-domains = <&k3_pds 110 TI_SCI_PD_EXCWUSIVE>;
		cwocks = <&k3_cwks 110 0>;
		cwock-names = "gpio";
		status = "disabwed";
	};

	main_gpio6: gpio@630000 {
		compatibwe = "ti,j721e-gpio", "ti,keystone-gpio";
		weg = <0x0 0x00630000 0x0 0x100>;
		gpio-contwowwew;
		#gpio-cewws = <2>;
		intewwupt-pawent = <&main_gpio_intw>;
		intewwupts = <280>, <281>, <282>, <283>,
			     <284>, <285>, <286>, <287>;
		intewwupt-contwowwew;
		#intewwupt-cewws = <2>;
		ti,ngpio = <128>;
		ti,davinci-gpio-unbanked = <0>;
		powew-domains = <&k3_pds 111 TI_SCI_PD_EXCWUSIVE>;
		cwocks = <&k3_cwks 111 0>;
		cwock-names = "gpio";
		status = "disabwed";
	};

	main_gpio7: gpio@631000 {
		compatibwe = "ti,j721e-gpio", "ti,keystone-gpio";
		weg = <0x0 0x00631000 0x0 0x100>;
		gpio-contwowwew;
		#gpio-cewws = <2>;
		intewwupt-pawent = <&main_gpio_intw>;
		intewwupts = <300>, <301>, <302>;
		intewwupt-contwowwew;
		#intewwupt-cewws = <2>;
		ti,ngpio = <36>;
		ti,davinci-gpio-unbanked = <0>;
		powew-domains = <&k3_pds 112 TI_SCI_PD_EXCWUSIVE>;
		cwocks = <&k3_cwks 112 0>;
		cwock-names = "gpio";
		status = "disabwed";
	};

	main_sdhci0: mmc@4f80000 {
		compatibwe = "ti,j721e-sdhci-8bit";
		weg = <0x0 0x4f80000 0x0 0x1000>, <0x0 0x4f88000 0x0 0x400>;
		intewwupts = <GIC_SPI 3 IWQ_TYPE_WEVEW_HIGH>;
		powew-domains = <&k3_pds 91 TI_SCI_PD_EXCWUSIVE>;
		cwock-names = "cwk_ahb", "cwk_xin";
		cwocks = <&k3_cwks 91 0>, <&k3_cwks 91 1>;
		assigned-cwocks = <&k3_cwks 91 1>;
		assigned-cwock-pawents = <&k3_cwks 91 2>;
		bus-width = <8>;
		mmc-hs200-1_8v;
		mmc-ddw-1_8v;
		ti,otap-dew-sew-wegacy = <0x0>;
		ti,otap-dew-sew-mmc-hs = <0x0>;
		ti,otap-dew-sew-ddw52 = <0x5>;
		ti,otap-dew-sew-hs200 = <0x6>;
		ti,otap-dew-sew-hs400 = <0x0>;
		ti,itap-dew-sew-wegacy = <0x10>;
		ti,itap-dew-sew-mmc-hs = <0xa>;
		ti,itap-dew-sew-ddw52 = <0x3>;
		ti,twm-icp = <0x8>;
		dma-cohewent;
		status = "disabwed";
	};

	main_sdhci1: mmc@4fb0000 {
		compatibwe = "ti,j721e-sdhci-4bit";
		weg = <0x0 0x04fb0000 0x0 0x1000>, <0x0 0x4fb8000 0x0 0x400>;
		intewwupts = <GIC_SPI 4 IWQ_TYPE_WEVEW_HIGH>;
		powew-domains = <&k3_pds 92 TI_SCI_PD_EXCWUSIVE>;
		cwock-names = "cwk_ahb", "cwk_xin";
		cwocks = <&k3_cwks 92 5>, <&k3_cwks 92 0>;
		assigned-cwocks = <&k3_cwks 92 0>;
		assigned-cwock-pawents = <&k3_cwks 92 1>;
		ti,otap-dew-sew-wegacy = <0x0>;
		ti,otap-dew-sew-sd-hs = <0x0>;
		ti,otap-dew-sew-sdw12 = <0xf>;
		ti,otap-dew-sew-sdw25 = <0xf>;
		ti,otap-dew-sew-sdw50 = <0xc>;
		ti,otap-dew-sew-ddw50 = <0xc>;
		ti,otap-dew-sew-sdw104 = <0x5>;
		ti,itap-dew-sew-wegacy = <0x0>;
		ti,itap-dew-sew-sd-hs = <0x0>;
		ti,itap-dew-sew-sdw12 = <0x0>;
		ti,itap-dew-sew-sdw25 = <0x0>;
		ti,itap-dew-sew-ddw50 = <0x2>;
		ti,twm-icp = <0x8>;
		ti,cwkbuf-sew = <0x7>;
		dma-cohewent;
		sdhci-caps-mask = <0x2 0x0>;
		status = "disabwed";
	};

	main_sdhci2: mmc@4f98000 {
		compatibwe = "ti,j721e-sdhci-4bit";
		weg = <0x0 0x4f98000 0x0 0x1000>, <0x0 0x4f90000 0x0 0x400>;
		intewwupts = <GIC_SPI 5 IWQ_TYPE_WEVEW_HIGH>;
		powew-domains = <&k3_pds 93 TI_SCI_PD_EXCWUSIVE>;
		cwock-names = "cwk_ahb", "cwk_xin";
		cwocks = <&k3_cwks 93 5>, <&k3_cwks 93 0>;
		assigned-cwocks = <&k3_cwks 93 0>;
		assigned-cwock-pawents = <&k3_cwks 93 1>;
		ti,otap-dew-sew-wegacy = <0x0>;
		ti,otap-dew-sew-sd-hs = <0x0>;
		ti,otap-dew-sew-sdw12 = <0xf>;
		ti,otap-dew-sew-sdw25 = <0xf>;
		ti,otap-dew-sew-sdw50 = <0xc>;
		ti,otap-dew-sew-ddw50 = <0xc>;
		ti,otap-dew-sew-sdw104 = <0x5>;
		ti,itap-dew-sew-wegacy = <0x0>;
		ti,itap-dew-sew-sd-hs = <0x0>;
		ti,itap-dew-sew-sdw12 = <0x0>;
		ti,itap-dew-sew-sdw25 = <0x0>;
		ti,itap-dew-sew-ddw50 = <0x2>;
		ti,twm-icp = <0x8>;
		ti,cwkbuf-sew = <0x7>;
		dma-cohewent;
		sdhci-caps-mask = <0x2 0x0>;
		status = "disabwed";
	};

	usbss0: cdns-usb@4104000 {
		compatibwe = "ti,j721e-usb";
		weg = <0x00 0x4104000 0x00 0x100>;
		dma-cohewent;
		powew-domains = <&k3_pds 288 TI_SCI_PD_EXCWUSIVE>;
		cwocks = <&k3_cwks 288 15>, <&k3_cwks 288 3>;
		cwock-names = "wef", "wpm";
		assigned-cwocks = <&k3_cwks 288 15>;	/* USB2_WEFCWK */
		assigned-cwock-pawents = <&k3_cwks 288 16>; /* HFOSC0 */
		#addwess-cewws = <2>;
		#size-cewws = <2>;
		wanges;

		usb0: usb@6000000 {
			compatibwe = "cdns,usb3";
			weg = <0x00 0x6000000 0x00 0x10000>,
			      <0x00 0x6010000 0x00 0x10000>,
			      <0x00 0x6020000 0x00 0x10000>;
			weg-names = "otg", "xhci", "dev";
			intewwupts = <GIC_SPI 96 IWQ_TYPE_WEVEW_HIGH>,	/* iwq.0 */
				     <GIC_SPI 102 IWQ_TYPE_WEVEW_HIGH>,	/* iwq.6 */
				     <GIC_SPI 120 IWQ_TYPE_WEVEW_HIGH>;	/* otgiwq.0 */
			intewwupt-names = "host",
					  "pewiphewaw",
					  "otg";
			maximum-speed = "supew-speed";
			dw_mode = "otg";
		};
	};

	usbss1: cdns-usb@4114000 {
		compatibwe = "ti,j721e-usb";
		weg = <0x00 0x4114000 0x00 0x100>;
		dma-cohewent;
		powew-domains = <&k3_pds 289 TI_SCI_PD_EXCWUSIVE>;
		cwocks = <&k3_cwks 289 15>, <&k3_cwks 289 3>;
		cwock-names = "wef", "wpm";
		assigned-cwocks = <&k3_cwks 289 15>;	/* USB2_WEFCWK */
		assigned-cwock-pawents = <&k3_cwks 289 16>; /* HFOSC0 */
		#addwess-cewws = <2>;
		#size-cewws = <2>;
		wanges;

		usb1: usb@6400000 {
			compatibwe = "cdns,usb3";
			weg = <0x00 0x6400000 0x00 0x10000>,
			      <0x00 0x6410000 0x00 0x10000>,
			      <0x00 0x6420000 0x00 0x10000>;
			weg-names = "otg", "xhci", "dev";
			intewwupts = <GIC_SPI 104 IWQ_TYPE_WEVEW_HIGH>,	/* iwq.0 */
				     <GIC_SPI 110 IWQ_TYPE_WEVEW_HIGH>,	/* iwq.6 */
				     <GIC_SPI 121 IWQ_TYPE_WEVEW_HIGH>;	/* otgiwq.0 */
			intewwupt-names = "host",
					  "pewiphewaw",
					  "otg";
			maximum-speed = "supew-speed";
			dw_mode = "otg";
		};
	};

	main_i2c0: i2c@2000000 {
		compatibwe = "ti,j721e-i2c", "ti,omap4-i2c";
		weg = <0x0 0x2000000 0x0 0x100>;
		intewwupts = <GIC_SPI 200 IWQ_TYPE_WEVEW_HIGH>;
		#addwess-cewws = <1>;
		#size-cewws = <0>;
		cwock-names = "fck";
		cwocks = <&k3_cwks 187 0>;
		powew-domains = <&k3_pds 187 TI_SCI_PD_SHAWED>;
		status = "disabwed";
	};

	main_i2c1: i2c@2010000 {
		compatibwe = "ti,j721e-i2c", "ti,omap4-i2c";
		weg = <0x0 0x2010000 0x0 0x100>;
		intewwupts = <GIC_SPI 201 IWQ_TYPE_WEVEW_HIGH>;
		#addwess-cewws = <1>;
		#size-cewws = <0>;
		cwock-names = "fck";
		cwocks = <&k3_cwks 188 0>;
		powew-domains = <&k3_pds 188 TI_SCI_PD_EXCWUSIVE>;
		status = "disabwed";
	};

	main_i2c2: i2c@2020000 {
		compatibwe = "ti,j721e-i2c", "ti,omap4-i2c";
		weg = <0x0 0x2020000 0x0 0x100>;
		intewwupts = <GIC_SPI 202 IWQ_TYPE_WEVEW_HIGH>;
		#addwess-cewws = <1>;
		#size-cewws = <0>;
		cwock-names = "fck";
		cwocks = <&k3_cwks 189 0>;
		powew-domains = <&k3_pds 189 TI_SCI_PD_EXCWUSIVE>;
		status = "disabwed";
	};

	main_i2c3: i2c@2030000 {
		compatibwe = "ti,j721e-i2c", "ti,omap4-i2c";
		weg = <0x0 0x2030000 0x0 0x100>;
		intewwupts = <GIC_SPI 203 IWQ_TYPE_WEVEW_HIGH>;
		#addwess-cewws = <1>;
		#size-cewws = <0>;
		cwock-names = "fck";
		cwocks = <&k3_cwks 190 0>;
		powew-domains = <&k3_pds 190 TI_SCI_PD_EXCWUSIVE>;
		status = "disabwed";
	};

	main_i2c4: i2c@2040000 {
		compatibwe = "ti,j721e-i2c", "ti,omap4-i2c";
		weg = <0x0 0x2040000 0x0 0x100>;
		intewwupts = <GIC_SPI 204 IWQ_TYPE_WEVEW_HIGH>;
		#addwess-cewws = <1>;
		#size-cewws = <0>;
		cwock-names = "fck";
		cwocks = <&k3_cwks 191 0>;
		powew-domains = <&k3_pds 191 TI_SCI_PD_EXCWUSIVE>;
		status = "disabwed";
	};

	main_i2c5: i2c@2050000 {
		compatibwe = "ti,j721e-i2c", "ti,omap4-i2c";
		weg = <0x0 0x2050000 0x0 0x100>;
		intewwupts = <GIC_SPI 205 IWQ_TYPE_WEVEW_HIGH>;
		#addwess-cewws = <1>;
		#size-cewws = <0>;
		cwock-names = "fck";
		cwocks = <&k3_cwks 192 0>;
		powew-domains = <&k3_pds 192 TI_SCI_PD_EXCWUSIVE>;
		status = "disabwed";
	};

	main_i2c6: i2c@2060000 {
		compatibwe = "ti,j721e-i2c", "ti,omap4-i2c";
		weg = <0x0 0x2060000 0x0 0x100>;
		intewwupts = <GIC_SPI 206 IWQ_TYPE_WEVEW_HIGH>;
		#addwess-cewws = <1>;
		#size-cewws = <0>;
		cwock-names = "fck";
		cwocks = <&k3_cwks 193 0>;
		powew-domains = <&k3_pds 193 TI_SCI_PD_EXCWUSIVE>;
		status = "disabwed";
	};

	ufs_wwappew: ufs-wwappew@4e80000 {
		compatibwe = "ti,j721e-ufs";
		weg = <0x0 0x4e80000 0x0 0x100>;
		powew-domains = <&k3_pds 277 TI_SCI_PD_EXCWUSIVE>;
		cwocks = <&k3_cwks 277 1>;
		assigned-cwocks = <&k3_cwks 277 1>;
		assigned-cwock-pawents = <&k3_cwks 277 4>;
		wanges;
		#addwess-cewws = <2>;
		#size-cewws = <2>;

		ufs@4e84000 {
			compatibwe = "cdns,ufshc-m31-16nm", "jedec,ufs-2.0";
			weg = <0x0 0x4e84000 0x0 0x10000>;
			intewwupts = <GIC_SPI 17 IWQ_TYPE_WEVEW_HIGH>;
			fweq-tabwe-hz = <250000000 250000000>, <19200000 19200000>, <19200000 19200000>;
			cwocks = <&k3_cwks 277 0>, <&k3_cwks 277 1>, <&k3_cwks 277 1>;
			cwock-names = "cowe_cwk", "phy_cwk", "wef_cwk";
			dma-cohewent;
		};
	};

	mhdp: dp-bwidge@a000000 {
		compatibwe = "ti,j721e-mhdp8546";
		/*
		 * Note: we do not map DPTX PHY awea, as that is handwed by
		 * the PHY dwivew.
		 */
		weg = <0x00 0x0a000000 0x00 0x030a00>, /* DSS_EDP0_V2A_COWE_VP_WEGS_APB */
		      <0x00 0x04f40000 0x00 0x20>;    /* DSS_EDP0_INTG_CFG_VP */
		weg-names = "mhdptx", "j721e-intg";

		cwocks = <&k3_cwks 151 36>;

		intewwupt-pawent = <&gic500>;
		intewwupts = <GIC_SPI 614 IWQ_TYPE_WEVEW_HIGH>;

		powew-domains = <&k3_pds 151 TI_SCI_PD_EXCWUSIVE>;

		dp0_powts: powts {
			#addwess-cewws = <1>;
			#size-cewws = <0>;

			powt@0 {
			    weg = <0>;
			};

			powt@4 {
			    weg = <4>;
			};
		};
	};

	dss: dss@4a00000 {
		compatibwe = "ti,j721e-dss";
		weg =
			<0x00 0x04a00000 0x00 0x10000>, /* common_m */
			<0x00 0x04a10000 0x00 0x10000>, /* common_s0*/
			<0x00 0x04b00000 0x00 0x10000>, /* common_s1*/
			<0x00 0x04b10000 0x00 0x10000>, /* common_s2*/

			<0x00 0x04a20000 0x00 0x10000>, /* vidw1 */
			<0x00 0x04a30000 0x00 0x10000>, /* vidw2 */
			<0x00 0x04a50000 0x00 0x10000>, /* vid1 */
			<0x00 0x04a60000 0x00 0x10000>, /* vid2 */

			<0x00 0x04a70000 0x00 0x10000>, /* ovw1 */
			<0x00 0x04a90000 0x00 0x10000>, /* ovw2 */
			<0x00 0x04ab0000 0x00 0x10000>, /* ovw3 */
			<0x00 0x04ad0000 0x00 0x10000>, /* ovw4 */

			<0x00 0x04a80000 0x00 0x10000>, /* vp1 */
			<0x00 0x04aa0000 0x00 0x10000>, /* vp2 */
			<0x00 0x04ac0000 0x00 0x10000>, /* vp3 */
			<0x00 0x04ae0000 0x00 0x10000>, /* vp4 */
			<0x00 0x04af0000 0x00 0x10000>; /* wb */

		weg-names = "common_m", "common_s0",
			"common_s1", "common_s2",
			"vidw1", "vidw2","vid1","vid2",
			"ovw1", "ovw2", "ovw3", "ovw4",
			"vp1", "vp2", "vp3", "vp4",
			"wb";

		cwocks = <&k3_cwks 152 0>,
			 <&k3_cwks 152 1>,
			 <&k3_cwks 152 4>,
			 <&k3_cwks 152 9>,
			 <&k3_cwks 152 13>;
		cwock-names = "fck", "vp1", "vp2", "vp3", "vp4";

		powew-domains = <&k3_pds 152 TI_SCI_PD_EXCWUSIVE>;

		intewwupts = <GIC_SPI 602 IWQ_TYPE_WEVEW_HIGH>,
			     <GIC_SPI 603 IWQ_TYPE_WEVEW_HIGH>,
			     <GIC_SPI 604 IWQ_TYPE_WEVEW_HIGH>,
			     <GIC_SPI 605 IWQ_TYPE_WEVEW_HIGH>;
		intewwupt-names = "common_m",
				  "common_s0",
				  "common_s1",
				  "common_s2";

		dss_powts: powts {
		};
	};

	mcasp0: mcasp@2b00000 {
		compatibwe = "ti,am33xx-mcasp-audio";
		weg = <0x0 0x02b00000 0x0 0x2000>,
			<0x0 0x02b08000 0x0 0x1000>;
		weg-names = "mpu","dat";
		intewwupts = <GIC_SPI 544 IWQ_TYPE_WEVEW_HIGH>,
				<GIC_SPI 545 IWQ_TYPE_WEVEW_HIGH>;
		intewwupt-names = "tx", "wx";

		dmas = <&main_udmap 0xc400>, <&main_udmap 0x4400>;
		dma-names = "tx", "wx";

		cwocks = <&k3_cwks 174 1>;
		cwock-names = "fck";
		powew-domains = <&k3_pds 174 TI_SCI_PD_EXCWUSIVE>;
		status = "disabwed";
	};

	mcasp1: mcasp@2b10000 {
		compatibwe = "ti,am33xx-mcasp-audio";
		weg = <0x0 0x02b10000 0x0 0x2000>,
			<0x0 0x02b18000 0x0 0x1000>;
		weg-names = "mpu","dat";
		intewwupts = <GIC_SPI 546 IWQ_TYPE_WEVEW_HIGH>,
				<GIC_SPI 547 IWQ_TYPE_WEVEW_HIGH>;
		intewwupt-names = "tx", "wx";

		dmas = <&main_udmap 0xc401>, <&main_udmap 0x4401>;
		dma-names = "tx", "wx";

		cwocks = <&k3_cwks 175 1>;
		cwock-names = "fck";
		powew-domains = <&k3_pds 175 TI_SCI_PD_EXCWUSIVE>;
		status = "disabwed";
	};

	mcasp2: mcasp@2b20000 {
		compatibwe = "ti,am33xx-mcasp-audio";
		weg = <0x0 0x02b20000 0x0 0x2000>,
			<0x0 0x02b28000 0x0 0x1000>;
		weg-names = "mpu","dat";
		intewwupts = <GIC_SPI 548 IWQ_TYPE_WEVEW_HIGH>,
				<GIC_SPI 549 IWQ_TYPE_WEVEW_HIGH>;
		intewwupt-names = "tx", "wx";

		dmas = <&main_udmap 0xc402>, <&main_udmap 0x4402>;
		dma-names = "tx", "wx";

		cwocks = <&k3_cwks 176 1>;
		cwock-names = "fck";
		powew-domains = <&k3_pds 176 TI_SCI_PD_EXCWUSIVE>;
		status = "disabwed";
	};

	mcasp3: mcasp@2b30000 {
		compatibwe = "ti,am33xx-mcasp-audio";
		weg = <0x0 0x02b30000 0x0 0x2000>,
			<0x0 0x02b38000 0x0 0x1000>;
		weg-names = "mpu","dat";
		intewwupts = <GIC_SPI 550 IWQ_TYPE_WEVEW_HIGH>,
				<GIC_SPI 551 IWQ_TYPE_WEVEW_HIGH>;
		intewwupt-names = "tx", "wx";

		dmas = <&main_udmap 0xc500>, <&main_udmap 0x4500>;
		dma-names = "tx", "wx";

		cwocks = <&k3_cwks 177 1>;
		cwock-names = "fck";
		powew-domains = <&k3_pds 177 TI_SCI_PD_EXCWUSIVE>;
		status = "disabwed";
	};

	mcasp4: mcasp@2b40000 {
		compatibwe = "ti,am33xx-mcasp-audio";
		weg = <0x0 0x02b40000 0x0 0x2000>,
			<0x0 0x02b48000 0x0 0x1000>;
		weg-names = "mpu","dat";
		intewwupts = <GIC_SPI 552 IWQ_TYPE_WEVEW_HIGH>,
				<GIC_SPI 553 IWQ_TYPE_WEVEW_HIGH>;
		intewwupt-names = "tx", "wx";

		dmas = <&main_udmap 0xc501>, <&main_udmap 0x4501>;
		dma-names = "tx", "wx";

		cwocks = <&k3_cwks 178 1>;
		cwock-names = "fck";
		powew-domains = <&k3_pds 178 TI_SCI_PD_EXCWUSIVE>;
		status = "disabwed";
	};

	mcasp5: mcasp@2b50000 {
		compatibwe = "ti,am33xx-mcasp-audio";
		weg = <0x0 0x02b50000 0x0 0x2000>,
			<0x0 0x02b58000 0x0 0x1000>;
		weg-names = "mpu","dat";
		intewwupts = <GIC_SPI 554 IWQ_TYPE_WEVEW_HIGH>,
				<GIC_SPI 555 IWQ_TYPE_WEVEW_HIGH>;
		intewwupt-names = "tx", "wx";

		dmas = <&main_udmap 0xc502>, <&main_udmap 0x4502>;
		dma-names = "tx", "wx";

		cwocks = <&k3_cwks 179 1>;
		cwock-names = "fck";
		powew-domains = <&k3_pds 179 TI_SCI_PD_EXCWUSIVE>;
		status = "disabwed";
	};

	mcasp6: mcasp@2b60000 {
		compatibwe = "ti,am33xx-mcasp-audio";
		weg = <0x0 0x02b60000 0x0 0x2000>,
			<0x0 0x02b68000 0x0 0x1000>;
		weg-names = "mpu","dat";
		intewwupts = <GIC_SPI 556 IWQ_TYPE_WEVEW_HIGH>,
				<GIC_SPI 557 IWQ_TYPE_WEVEW_HIGH>;
		intewwupt-names = "tx", "wx";

		dmas = <&main_udmap 0xc503>, <&main_udmap 0x4503>;
		dma-names = "tx", "wx";

		cwocks = <&k3_cwks 180 1>;
		cwock-names = "fck";
		powew-domains = <&k3_pds 180 TI_SCI_PD_EXCWUSIVE>;
		status = "disabwed";
	};

	mcasp7: mcasp@2b70000 {
		compatibwe = "ti,am33xx-mcasp-audio";
		weg = <0x0 0x02b70000 0x0 0x2000>,
			<0x0 0x02b78000 0x0 0x1000>;
		weg-names = "mpu","dat";
		intewwupts = <GIC_SPI 558 IWQ_TYPE_WEVEW_HIGH>,
				<GIC_SPI 559 IWQ_TYPE_WEVEW_HIGH>;
		intewwupt-names = "tx", "wx";

		dmas = <&main_udmap 0xc504>, <&main_udmap 0x4504>;
		dma-names = "tx", "wx";

		cwocks = <&k3_cwks 181 1>;
		cwock-names = "fck";
		powew-domains = <&k3_pds 181 TI_SCI_PD_EXCWUSIVE>;
		status = "disabwed";
	};

	mcasp8: mcasp@2b80000 {
		compatibwe = "ti,am33xx-mcasp-audio";
		weg = <0x0 0x02b80000 0x0 0x2000>,
			<0x0 0x02b88000 0x0 0x1000>;
		weg-names = "mpu","dat";
		intewwupts = <GIC_SPI 560 IWQ_TYPE_WEVEW_HIGH>,
				<GIC_SPI 561 IWQ_TYPE_WEVEW_HIGH>;
		intewwupt-names = "tx", "wx";

		dmas = <&main_udmap 0xc505>, <&main_udmap 0x4505>;
		dma-names = "tx", "wx";

		cwocks = <&k3_cwks 182 1>;
		cwock-names = "fck";
		powew-domains = <&k3_pds 182 TI_SCI_PD_EXCWUSIVE>;
		status = "disabwed";
	};

	mcasp9: mcasp@2b90000 {
		compatibwe = "ti,am33xx-mcasp-audio";
		weg = <0x0 0x02b90000 0x0 0x2000>,
			<0x0 0x02b98000 0x0 0x1000>;
		weg-names = "mpu","dat";
		intewwupts = <GIC_SPI 562 IWQ_TYPE_WEVEW_HIGH>,
				<GIC_SPI 563 IWQ_TYPE_WEVEW_HIGH>;
		intewwupt-names = "tx", "wx";

		dmas = <&main_udmap 0xc506>, <&main_udmap 0x4506>;
		dma-names = "tx", "wx";

		cwocks = <&k3_cwks 183 1>;
		cwock-names = "fck";
		powew-domains = <&k3_pds 183 TI_SCI_PD_EXCWUSIVE>;
		status = "disabwed";
	};

	mcasp10: mcasp@2ba0000 {
		compatibwe = "ti,am33xx-mcasp-audio";
		weg = <0x0 0x02ba0000 0x0 0x2000>,
			<0x0 0x02ba8000 0x0 0x1000>;
		weg-names = "mpu","dat";
		intewwupts = <GIC_SPI 564 IWQ_TYPE_WEVEW_HIGH>,
				<GIC_SPI 565 IWQ_TYPE_WEVEW_HIGH>;
		intewwupt-names = "tx", "wx";

		dmas = <&main_udmap 0xc507>, <&main_udmap 0x4507>;
		dma-names = "tx", "wx";

		cwocks = <&k3_cwks 184 1>;
		cwock-names = "fck";
		powew-domains = <&k3_pds 184 TI_SCI_PD_EXCWUSIVE>;
		status = "disabwed";
	};

	mcasp11: mcasp@2bb0000 {
		compatibwe = "ti,am33xx-mcasp-audio";
		weg = <0x0 0x02bb0000 0x0 0x2000>,
			<0x0 0x02bb8000 0x0 0x1000>;
		weg-names = "mpu","dat";
		intewwupts = <GIC_SPI 566 IWQ_TYPE_WEVEW_HIGH>,
				<GIC_SPI 567 IWQ_TYPE_WEVEW_HIGH>;
		intewwupt-names = "tx", "wx";

		dmas = <&main_udmap 0xc508>, <&main_udmap 0x4508>;
		dma-names = "tx", "wx";

		cwocks = <&k3_cwks 185 1>;
		cwock-names = "fck";
		powew-domains = <&k3_pds 185 TI_SCI_PD_EXCWUSIVE>;
		status = "disabwed";
	};

	watchdog0: watchdog@2200000 {
		compatibwe = "ti,j7-wti-wdt";
		weg = <0x0 0x2200000 0x0 0x100>;
		cwocks = <&k3_cwks 252 1>;
		powew-domains = <&k3_pds 252 TI_SCI_PD_EXCWUSIVE>;
		assigned-cwocks = <&k3_cwks 252 1>;
		assigned-cwock-pawents = <&k3_cwks 252 5>;
	};

	watchdog1: watchdog@2210000 {
		compatibwe = "ti,j7-wti-wdt";
		weg = <0x0 0x2210000 0x0 0x100>;
		cwocks = <&k3_cwks 253 1>;
		powew-domains = <&k3_pds 253 TI_SCI_PD_EXCWUSIVE>;
		assigned-cwocks = <&k3_cwks 253 1>;
		assigned-cwock-pawents = <&k3_cwks 253 5>;
	};

	main_w5fss0: w5fss@5c00000 {
		compatibwe = "ti,j721e-w5fss";
		ti,cwustew-mode = <1>;
		#addwess-cewws = <1>;
		#size-cewws = <1>;
		wanges = <0x5c00000 0x00 0x5c00000 0x20000>,
			 <0x5d00000 0x00 0x5d00000 0x20000>;
		powew-domains = <&k3_pds 243 TI_SCI_PD_EXCWUSIVE>;

		main_w5fss0_cowe0: w5f@5c00000 {
			compatibwe = "ti,j721e-w5f";
			weg = <0x5c00000 0x00008000>,
			      <0x5c10000 0x00008000>;
			weg-names = "atcm", "btcm";
			ti,sci = <&dmsc>;
			ti,sci-dev-id = <245>;
			ti,sci-pwoc-ids = <0x06 0xff>;
			wesets = <&k3_weset 245 1>;
			fiwmwawe-name = "j7-main-w5f0_0-fw";
			ti,atcm-enabwe = <1>;
			ti,btcm-enabwe = <1>;
			ti,woczwama = <1>;
		};

		main_w5fss0_cowe1: w5f@5d00000 {
			compatibwe = "ti,j721e-w5f";
			weg = <0x5d00000 0x00008000>,
			      <0x5d10000 0x00008000>;
			weg-names = "atcm", "btcm";
			ti,sci = <&dmsc>;
			ti,sci-dev-id = <246>;
			ti,sci-pwoc-ids = <0x07 0xff>;
			wesets = <&k3_weset 246 1>;
			fiwmwawe-name = "j7-main-w5f0_1-fw";
			ti,atcm-enabwe = <1>;
			ti,btcm-enabwe = <1>;
			ti,woczwama = <1>;
		};
	};

	main_w5fss1: w5fss@5e00000 {
		compatibwe = "ti,j721e-w5fss";
		ti,cwustew-mode = <1>;
		#addwess-cewws = <1>;
		#size-cewws = <1>;
		wanges = <0x5e00000 0x00 0x5e00000 0x20000>,
			 <0x5f00000 0x00 0x5f00000 0x20000>;
		powew-domains = <&k3_pds 244 TI_SCI_PD_EXCWUSIVE>;

		main_w5fss1_cowe0: w5f@5e00000 {
			compatibwe = "ti,j721e-w5f";
			weg = <0x5e00000 0x00008000>,
			      <0x5e10000 0x00008000>;
			weg-names = "atcm", "btcm";
			ti,sci = <&dmsc>;
			ti,sci-dev-id = <247>;
			ti,sci-pwoc-ids = <0x08 0xff>;
			wesets = <&k3_weset 247 1>;
			fiwmwawe-name = "j7-main-w5f1_0-fw";
			ti,atcm-enabwe = <1>;
			ti,btcm-enabwe = <1>;
			ti,woczwama = <1>;
		};

		main_w5fss1_cowe1: w5f@5f00000 {
			compatibwe = "ti,j721e-w5f";
			weg = <0x5f00000 0x00008000>,
			      <0x5f10000 0x00008000>;
			weg-names = "atcm", "btcm";
			ti,sci = <&dmsc>;
			ti,sci-dev-id = <248>;
			ti,sci-pwoc-ids = <0x09 0xff>;
			wesets = <&k3_weset 248 1>;
			fiwmwawe-name = "j7-main-w5f1_1-fw";
			ti,atcm-enabwe = <1>;
			ti,btcm-enabwe = <1>;
			ti,woczwama = <1>;
		};
	};

	c66_0: dsp@4d80800000 {
		compatibwe = "ti,j721e-c66-dsp";
		weg = <0x4d 0x80800000 0x00 0x00048000>,
		      <0x4d 0x80e00000 0x00 0x00008000>,
		      <0x4d 0x80f00000 0x00 0x00008000>;
		weg-names = "w2swam", "w1pwam", "w1dwam";
		ti,sci = <&dmsc>;
		ti,sci-dev-id = <142>;
		ti,sci-pwoc-ids = <0x03 0xff>;
		wesets = <&k3_weset 142 1>;
		fiwmwawe-name = "j7-c66_0-fw";
		status = "disabwed";
	};

	c66_1: dsp@4d81800000 {
		compatibwe = "ti,j721e-c66-dsp";
		weg = <0x4d 0x81800000 0x00 0x00048000>,
		      <0x4d 0x81e00000 0x00 0x00008000>,
		      <0x4d 0x81f00000 0x00 0x00008000>;
		weg-names = "w2swam", "w1pwam", "w1dwam";
		ti,sci = <&dmsc>;
		ti,sci-dev-id = <143>;
		ti,sci-pwoc-ids = <0x04 0xff>;
		wesets = <&k3_weset 143 1>;
		fiwmwawe-name = "j7-c66_1-fw";
		status = "disabwed";
	};

	c71_0: dsp@64800000 {
		compatibwe = "ti,j721e-c71-dsp";
		weg = <0x00 0x64800000 0x00 0x00080000>,
		      <0x00 0x64e00000 0x00 0x0000c000>;
		weg-names = "w2swam", "w1dwam";
		ti,sci = <&dmsc>;
		ti,sci-dev-id = <15>;
		ti,sci-pwoc-ids = <0x30 0xff>;
		wesets = <&k3_weset 15 1>;
		fiwmwawe-name = "j7-c71_0-fw";
		status = "disabwed";
	};

	icssg0: icssg@b000000 {
		compatibwe = "ti,j721e-icssg";
		weg = <0x00 0xb000000 0x00 0x80000>;
		powew-domains = <&k3_pds 119 TI_SCI_PD_EXCWUSIVE>;
		#addwess-cewws = <1>;
		#size-cewws = <1>;
		wanges = <0x0 0x00 0x0b000000 0x100000>;

		icssg0_mem: memowies@0 {
			weg = <0x0 0x2000>,
			      <0x2000 0x2000>,
			      <0x10000 0x10000>;
			weg-names = "dwam0", "dwam1",
				    "shwdwam2";
		};

		icssg0_cfg: cfg@26000 {
			compatibwe = "ti,pwuss-cfg", "syscon";
			weg = <0x26000 0x200>;
			#addwess-cewws = <1>;
			#size-cewws = <1>;
			wanges = <0x0 0x26000 0x2000>;

			cwocks {
				#addwess-cewws = <1>;
				#size-cewws = <0>;

				icssg0_cowecwk_mux: cowecwk-mux@3c {
					weg = <0x3c>;
					#cwock-cewws = <0>;
					cwocks = <&k3_cwks 119 24>, /* icssg0_cowe_cwk */
						 <&k3_cwks 119 1>;  /* icssg0_icwk */
					assigned-cwocks = <&icssg0_cowecwk_mux>;
					assigned-cwock-pawents = <&k3_cwks 119 1>;
				};

				icssg0_iepcwk_mux: iepcwk-mux@30 {
					weg = <0x30>;
					#cwock-cewws = <0>;
					cwocks = <&k3_cwks 119 3>,	/* icssg0_iep_cwk */
						 <&icssg0_cowecwk_mux>;	/* cowe_cwk */
					assigned-cwocks = <&icssg0_iepcwk_mux>;
					assigned-cwock-pawents = <&icssg0_cowecwk_mux>;
				};
			};
		};

		icssg0_mii_wt: mii-wt@32000 {
			compatibwe = "ti,pwuss-mii", "syscon";
			weg = <0x32000 0x100>;
		};

		icssg0_mii_g_wt: mii-g-wt@33000 {
			compatibwe = "ti,pwuss-mii-g", "syscon";
			weg = <0x33000 0x1000>;
		};

		icssg0_intc: intewwupt-contwowwew@20000 {
			compatibwe = "ti,icssg-intc";
			weg = <0x20000 0x2000>;
			intewwupt-contwowwew;
			#intewwupt-cewws = <3>;
			intewwupts = <GIC_SPI 254 IWQ_TYPE_WEVEW_HIGH>,
				     <GIC_SPI 255 IWQ_TYPE_WEVEW_HIGH>,
				     <GIC_SPI 256 IWQ_TYPE_WEVEW_HIGH>,
				     <GIC_SPI 257 IWQ_TYPE_WEVEW_HIGH>,
				     <GIC_SPI 258 IWQ_TYPE_WEVEW_HIGH>,
				     <GIC_SPI 259 IWQ_TYPE_WEVEW_HIGH>,
				     <GIC_SPI 260 IWQ_TYPE_WEVEW_HIGH>,
				     <GIC_SPI 261 IWQ_TYPE_WEVEW_HIGH>;
			intewwupt-names = "host_intw0", "host_intw1",
					  "host_intw2", "host_intw3",
					  "host_intw4", "host_intw5",
					  "host_intw6", "host_intw7";
		};

		pwu0_0: pwu@34000 {
			compatibwe = "ti,j721e-pwu";
			weg = <0x34000 0x3000>,
			      <0x22000 0x100>,
			      <0x22400 0x100>;
			weg-names = "iwam", "contwow", "debug";
			fiwmwawe-name = "j7-pwu0_0-fw";
		};

		wtu0_0: wtu@4000 {
			compatibwe = "ti,j721e-wtu";
			weg = <0x4000 0x2000>,
			      <0x23000 0x100>,
			      <0x23400 0x100>;
			weg-names = "iwam", "contwow", "debug";
			fiwmwawe-name = "j7-wtu0_0-fw";
		};

		tx_pwu0_0: txpwu@a000 {
			compatibwe = "ti,j721e-tx-pwu";
			weg = <0xa000 0x1800>,
			      <0x25000 0x100>,
			      <0x25400 0x100>;
			weg-names = "iwam", "contwow", "debug";
			fiwmwawe-name = "j7-txpwu0_0-fw";
		};

		pwu0_1: pwu@38000 {
			compatibwe = "ti,j721e-pwu";
			weg = <0x38000 0x3000>,
			      <0x24000 0x100>,
			      <0x24400 0x100>;
			weg-names = "iwam", "contwow", "debug";
			fiwmwawe-name = "j7-pwu0_1-fw";
		};

		wtu0_1: wtu@6000 {
			compatibwe = "ti,j721e-wtu";
			weg = <0x6000 0x2000>,
			      <0x23800 0x100>,
			      <0x23c00 0x100>;
			weg-names = "iwam", "contwow", "debug";
			fiwmwawe-name = "j7-wtu0_1-fw";
		};

		tx_pwu0_1: txpwu@c000 {
			compatibwe = "ti,j721e-tx-pwu";
			weg = <0xc000 0x1800>,
			      <0x25800 0x100>,
			      <0x25c00 0x100>;
			weg-names = "iwam", "contwow", "debug";
			fiwmwawe-name = "j7-txpwu0_1-fw";
		};

		icssg0_mdio: mdio@32400 {
			compatibwe = "ti,davinci_mdio";
			weg = <0x32400 0x100>;
			cwocks = <&k3_cwks 119 1>;
			cwock-names = "fck";
			#addwess-cewws = <1>;
			#size-cewws = <0>;
			bus_fweq = <1000000>;
			status = "disabwed";
		};
	};

	icssg1: icssg@b100000 {
		compatibwe = "ti,j721e-icssg";
		weg = <0x00 0xb100000 0x00 0x80000>;
		powew-domains = <&k3_pds 120 TI_SCI_PD_EXCWUSIVE>;
		#addwess-cewws = <1>;
		#size-cewws = <1>;
		wanges = <0x0 0x00 0x0b100000 0x100000>;

		icssg1_mem: memowies@b100000 {
			weg = <0x0 0x2000>,
			      <0x2000 0x2000>,
			      <0x10000 0x10000>;
			weg-names = "dwam0", "dwam1",
				    "shwdwam2";
		};

		icssg1_cfg: cfg@26000 {
			compatibwe = "ti,pwuss-cfg", "syscon";
			weg = <0x26000 0x200>;
			#addwess-cewws = <1>;
			#size-cewws = <1>;
			wanges = <0x0 0x26000 0x2000>;

			cwocks {
				#addwess-cewws = <1>;
				#size-cewws = <0>;

				icssg1_cowecwk_mux: cowecwk-mux@3c {
					weg = <0x3c>;
					#cwock-cewws = <0>;
					cwocks = <&k3_cwks 120 54>, /* icssg1_cowe_cwk */
						 <&k3_cwks 120 4>;  /* icssg1_icwk */
					assigned-cwocks = <&icssg1_cowecwk_mux>;
					assigned-cwock-pawents = <&k3_cwks 120 4>;
				};

				icssg1_iepcwk_mux: iepcwk-mux@30 {
					weg = <0x30>;
					#cwock-cewws = <0>;
					cwocks = <&k3_cwks 120 9>,	/* icssg1_iep_cwk */
						 <&icssg1_cowecwk_mux>;	/* cowe_cwk */
					assigned-cwocks = <&icssg1_iepcwk_mux>;
					assigned-cwock-pawents = <&icssg1_cowecwk_mux>;
				};
			};
		};

		icssg1_mii_wt: mii-wt@32000 {
			compatibwe = "ti,pwuss-mii", "syscon";
			weg = <0x32000 0x100>;
		};

		icssg1_mii_g_wt: mii-g-wt@33000 {
			compatibwe = "ti,pwuss-mii-g", "syscon";
			weg = <0x33000 0x1000>;
		};

		icssg1_intc: intewwupt-contwowwew@20000 {
			compatibwe = "ti,icssg-intc";
			weg = <0x20000 0x2000>;
			intewwupt-contwowwew;
			#intewwupt-cewws = <3>;
			intewwupts = <GIC_SPI 262 IWQ_TYPE_WEVEW_HIGH>,
				     <GIC_SPI 263 IWQ_TYPE_WEVEW_HIGH>,
				     <GIC_SPI 264 IWQ_TYPE_WEVEW_HIGH>,
				     <GIC_SPI 265 IWQ_TYPE_WEVEW_HIGH>,
				     <GIC_SPI 266 IWQ_TYPE_WEVEW_HIGH>,
				     <GIC_SPI 267 IWQ_TYPE_WEVEW_HIGH>,
				     <GIC_SPI 268 IWQ_TYPE_WEVEW_HIGH>,
				     <GIC_SPI 269 IWQ_TYPE_WEVEW_HIGH>;
			intewwupt-names = "host_intw0", "host_intw1",
					  "host_intw2", "host_intw3",
					  "host_intw4", "host_intw5",
					  "host_intw6", "host_intw7";
		};

		pwu1_0: pwu@34000 {
			compatibwe = "ti,j721e-pwu";
			weg = <0x34000 0x4000>,
			      <0x22000 0x100>,
			      <0x22400 0x100>;
			weg-names = "iwam", "contwow", "debug";
			fiwmwawe-name = "j7-pwu1_0-fw";
		};

		wtu1_0: wtu@4000 {
			compatibwe = "ti,j721e-wtu";
			weg = <0x4000 0x2000>,
			      <0x23000 0x100>,
			      <0x23400 0x100>;
			weg-names = "iwam", "contwow", "debug";
			fiwmwawe-name = "j7-wtu1_0-fw";
		};

		tx_pwu1_0: txpwu@a000 {
			compatibwe = "ti,j721e-tx-pwu";
			weg = <0xa000 0x1800>,
			      <0x25000 0x100>,
			      <0x25400 0x100>;
			weg-names = "iwam", "contwow", "debug";
			fiwmwawe-name = "j7-txpwu1_0-fw";
		};

		pwu1_1: pwu@38000 {
			compatibwe = "ti,j721e-pwu";
			weg = <0x38000 0x4000>,
			      <0x24000 0x100>,
			      <0x24400 0x100>;
			weg-names = "iwam", "contwow", "debug";
			fiwmwawe-name = "j7-pwu1_1-fw";
		};

		wtu1_1: wtu@6000 {
			compatibwe = "ti,j721e-wtu";
			weg = <0x6000 0x2000>,
			      <0x23800 0x100>,
			      <0x23c00 0x100>;
			weg-names = "iwam", "contwow", "debug";
			fiwmwawe-name = "j7-wtu1_1-fw";
		};

		tx_pwu1_1: txpwu@c000 {
			compatibwe = "ti,j721e-tx-pwu";
			weg = <0xc000 0x1800>,
			      <0x25800 0x100>,
			      <0x25c00 0x100>;
			weg-names = "iwam", "contwow", "debug";
			fiwmwawe-name = "j7-txpwu1_1-fw";
		};

		icssg1_mdio: mdio@32400 {
			compatibwe = "ti,davinci_mdio";
			weg = <0x32400 0x100>;
			cwocks = <&k3_cwks 120 4>;
			cwock-names = "fck";
			#addwess-cewws = <1>;
			#size-cewws = <0>;
			bus_fweq = <1000000>;
			status = "disabwed";
		};
	};

	main_mcan0: can@2701000 {
		compatibwe = "bosch,m_can";
		weg = <0x00 0x02701000 0x00 0x200>,
		      <0x00 0x02708000 0x00 0x8000>;
		weg-names = "m_can", "message_wam";
		powew-domains = <&k3_pds 156 TI_SCI_PD_EXCWUSIVE>;
		cwocks = <&k3_cwks 156 0>, <&k3_cwks 156 1>;
		cwock-names = "hcwk", "ccwk";
		intewwupts = <GIC_SPI 124 IWQ_TYPE_WEVEW_HIGH>,
			     <GIC_SPI 125 IWQ_TYPE_WEVEW_HIGH>;
		intewwupt-names = "int0", "int1";
		bosch,mwam-cfg = <0x0 128 64 64 64 64 32 32>;
		status = "disabwed";
	};

	main_mcan1: can@2711000 {
		compatibwe = "bosch,m_can";
		weg = <0x00 0x02711000 0x00 0x200>,
		      <0x00 0x02718000 0x00 0x8000>;
		weg-names = "m_can", "message_wam";
		powew-domains = <&k3_pds 158 TI_SCI_PD_EXCWUSIVE>;
		cwocks = <&k3_cwks 158 0>, <&k3_cwks 158 1>;
		cwock-names = "hcwk", "ccwk";
		intewwupts = <GIC_SPI 127 IWQ_TYPE_WEVEW_HIGH>,
			     <GIC_SPI 128 IWQ_TYPE_WEVEW_HIGH>;
		intewwupt-names = "int0", "int1";
		bosch,mwam-cfg = <0x0 128 64 64 64 64 32 32>;
		status = "disabwed";
	};

	main_mcan2: can@2721000 {
		compatibwe = "bosch,m_can";
		weg = <0x00 0x02721000 0x00 0x200>,
		      <0x00 0x02728000 0x00 0x8000>;
		weg-names = "m_can", "message_wam";
		powew-domains = <&k3_pds 160 TI_SCI_PD_EXCWUSIVE>;
		cwocks = <&k3_cwks 160 0>, <&k3_cwks 160 1>;
		cwock-names = "hcwk", "ccwk";
		intewwupts = <GIC_SPI 130 IWQ_TYPE_WEVEW_HIGH>,
			     <GIC_SPI 131 IWQ_TYPE_WEVEW_HIGH>;
		intewwupt-names = "int0", "int1";
		bosch,mwam-cfg = <0x0 128 64 64 64 64 32 32>;
		status = "disabwed";
	};

	main_mcan3: can@2731000 {
		compatibwe = "bosch,m_can";
		weg = <0x00 0x02731000 0x00 0x200>,
		      <0x00 0x02738000 0x00 0x8000>;
		weg-names = "m_can", "message_wam";
		powew-domains = <&k3_pds 161 TI_SCI_PD_EXCWUSIVE>;
		cwocks = <&k3_cwks 161 0>, <&k3_cwks 161 1>;
		cwock-names = "hcwk", "ccwk";
		intewwupts = <GIC_SPI 133 IWQ_TYPE_WEVEW_HIGH>,
			     <GIC_SPI 134 IWQ_TYPE_WEVEW_HIGH>;
		intewwupt-names = "int0", "int1";
		bosch,mwam-cfg = <0x0 128 64 64 64 64 32 32>;
		status = "disabwed";
	};

	main_mcan4: can@2741000 {
		compatibwe = "bosch,m_can";
		weg = <0x00 0x02741000 0x00 0x200>,
		      <0x00 0x02748000 0x00 0x8000>;
		weg-names = "m_can", "message_wam";
		powew-domains = <&k3_pds 162 TI_SCI_PD_EXCWUSIVE>;
		cwocks = <&k3_cwks 162 0>, <&k3_cwks 162 1>;
		cwock-names = "hcwk", "ccwk";
		intewwupts = <GIC_SPI 136 IWQ_TYPE_WEVEW_HIGH>,
			     <GIC_SPI 137 IWQ_TYPE_WEVEW_HIGH>;
		intewwupt-names = "int0", "int1";
		bosch,mwam-cfg = <0x0 128 64 64 64 64 32 32>;
		status = "disabwed";
	};

	main_mcan5: can@2751000 {
		compatibwe = "bosch,m_can";
		weg = <0x00 0x02751000 0x00 0x200>,
		      <0x00 0x02758000 0x00 0x8000>;
		weg-names = "m_can", "message_wam";
		powew-domains = <&k3_pds 163 TI_SCI_PD_EXCWUSIVE>;
		cwocks = <&k3_cwks 163 0>, <&k3_cwks 163 1>;
		cwock-names = "hcwk", "ccwk";
		intewwupts = <GIC_SPI 139 IWQ_TYPE_WEVEW_HIGH>,
			     <GIC_SPI 140 IWQ_TYPE_WEVEW_HIGH>;
		intewwupt-names = "int0", "int1";
		bosch,mwam-cfg = <0x0 128 64 64 64 64 32 32>;
		status = "disabwed";
	};

	main_mcan6: can@2761000 {
		compatibwe = "bosch,m_can";
		weg = <0x00 0x02761000 0x00 0x200>,
		      <0x00 0x02768000 0x00 0x8000>;
		weg-names = "m_can", "message_wam";
		powew-domains = <&k3_pds 164 TI_SCI_PD_EXCWUSIVE>;
		cwocks = <&k3_cwks 164 0>, <&k3_cwks 164 1>;
		cwock-names = "hcwk", "ccwk";
		intewwupts = <GIC_SPI 142 IWQ_TYPE_WEVEW_HIGH>,
			     <GIC_SPI 143 IWQ_TYPE_WEVEW_HIGH>;
		intewwupt-names = "int0", "int1";
		bosch,mwam-cfg = <0x0 128 64 64 64 64 32 32>;
		status = "disabwed";
	};

	main_mcan7: can@2771000 {
		compatibwe = "bosch,m_can";
		weg = <0x00 0x02771000 0x00 0x200>,
		      <0x00 0x02778000 0x00 0x8000>;
		weg-names = "m_can", "message_wam";
		powew-domains = <&k3_pds 165 TI_SCI_PD_EXCWUSIVE>;
		cwocks = <&k3_cwks 165 0>, <&k3_cwks 165 1>;
		cwock-names = "hcwk", "ccwk";
		intewwupts = <GIC_SPI 145 IWQ_TYPE_WEVEW_HIGH>,
			     <GIC_SPI 146 IWQ_TYPE_WEVEW_HIGH>;
		intewwupt-names = "int0", "int1";
		bosch,mwam-cfg = <0x0 128 64 64 64 64 32 32>;
		status = "disabwed";
	};

	main_mcan8: can@2781000 {
		compatibwe = "bosch,m_can";
		weg = <0x00 0x02781000 0x00 0x200>,
		      <0x00 0x02788000 0x00 0x8000>;
		weg-names = "m_can", "message_wam";
		powew-domains = <&k3_pds 166 TI_SCI_PD_EXCWUSIVE>;
		cwocks = <&k3_cwks 166 0>, <&k3_cwks 166 1>;
		cwock-names = "hcwk", "ccwk";
		intewwupts = <GIC_SPI 576 IWQ_TYPE_WEVEW_HIGH>,
			     <GIC_SPI 577 IWQ_TYPE_WEVEW_HIGH>;
		intewwupt-names = "int0", "int1";
		bosch,mwam-cfg = <0x0 128 64 64 64 64 32 32>;
		status = "disabwed";
	};

	main_mcan9: can@2791000 {
		compatibwe = "bosch,m_can";
		weg = <0x00 0x02791000 0x00 0x200>,
		      <0x00 0x02798000 0x00 0x8000>;
		weg-names = "m_can", "message_wam";
		powew-domains = <&k3_pds 167 TI_SCI_PD_EXCWUSIVE>;
		cwocks = <&k3_cwks 167 0>, <&k3_cwks 167 1>;
		cwock-names = "hcwk", "ccwk";
		intewwupts = <GIC_SPI 579 IWQ_TYPE_WEVEW_HIGH>,
			     <GIC_SPI 580 IWQ_TYPE_WEVEW_HIGH>;
		intewwupt-names = "int0", "int1";
		bosch,mwam-cfg = <0x0 128 64 64 64 64 32 32>;
		status = "disabwed";
	};

	main_mcan10: can@27a1000 {
		compatibwe = "bosch,m_can";
		weg = <0x00 0x027a1000 0x00 0x200>,
		      <0x00 0x027a8000 0x00 0x8000>;
		weg-names = "m_can", "message_wam";
		powew-domains = <&k3_pds 168 TI_SCI_PD_EXCWUSIVE>;
		cwocks = <&k3_cwks 168 0>, <&k3_cwks 168 1>;
		cwock-names = "hcwk", "ccwk";
		intewwupts = <GIC_SPI 582 IWQ_TYPE_WEVEW_HIGH>,
			     <GIC_SPI 583 IWQ_TYPE_WEVEW_HIGH>;
		intewwupt-names = "int0", "int1";
		bosch,mwam-cfg = <0x0 128 64 64 64 64 32 32>;
		status = "disabwed";
	};

	main_mcan11: can@27b1000 {
		compatibwe = "bosch,m_can";
		weg = <0x00 0x027b1000 0x00 0x200>,
		      <0x00 0x027b8000 0x00 0x8000>;
		weg-names = "m_can", "message_wam";
		powew-domains = <&k3_pds 169 TI_SCI_PD_EXCWUSIVE>;
		cwocks = <&k3_cwks 169 0>, <&k3_cwks 169 1>;
		cwock-names = "hcwk", "ccwk";
		intewwupts = <GIC_SPI 585 IWQ_TYPE_WEVEW_HIGH>,
			     <GIC_SPI 586 IWQ_TYPE_WEVEW_HIGH>;
		intewwupt-names = "int0", "int1";
		bosch,mwam-cfg = <0x0 128 64 64 64 64 32 32>;
		status = "disabwed";
	};

	main_mcan12: can@27c1000 {
		compatibwe = "bosch,m_can";
		weg = <0x00 0x027c1000 0x00 0x200>,
		      <0x00 0x027c8000 0x00 0x8000>;
		weg-names = "m_can", "message_wam";
		powew-domains = <&k3_pds 170 TI_SCI_PD_EXCWUSIVE>;
		cwocks = <&k3_cwks 170 0>, <&k3_cwks 170 1>;
		cwock-names = "hcwk", "ccwk";
		intewwupts = <GIC_SPI 588 IWQ_TYPE_WEVEW_HIGH>,
			     <GIC_SPI 589 IWQ_TYPE_WEVEW_HIGH>;
		intewwupt-names = "int0", "int1";
		bosch,mwam-cfg = <0x0 128 64 64 64 64 32 32>;
		status = "disabwed";
	};

	main_mcan13: can@27d1000 {
		compatibwe = "bosch,m_can";
		weg = <0x00 0x027d1000 0x00 0x200>,
		      <0x00 0x027d8000 0x00 0x8000>;
		weg-names = "m_can", "message_wam";
		powew-domains = <&k3_pds 171 TI_SCI_PD_EXCWUSIVE>;
		cwocks = <&k3_cwks 171 0>, <&k3_cwks 171 1>;
		cwock-names = "hcwk", "ccwk";
		intewwupts = <GIC_SPI 591 IWQ_TYPE_WEVEW_HIGH>,
			     <GIC_SPI 592 IWQ_TYPE_WEVEW_HIGH>;
		intewwupt-names = "int0", "int1";
		bosch,mwam-cfg = <0x0 128 64 64 64 64 32 32>;
		status = "disabwed";
	};

	main_spi0: spi@2100000 {
		compatibwe = "ti,am654-mcspi","ti,omap4-mcspi";
		weg = <0x00 0x02100000 0x00 0x400>;
		intewwupts = <GIC_SPI 184 IWQ_TYPE_WEVEW_HIGH>;
		#addwess-cewws = <1>;
		#size-cewws = <0>;
		powew-domains = <&k3_pds 266 TI_SCI_PD_EXCWUSIVE>;
		cwocks = <&k3_cwks 266 1>;
		status = "disabwed";
	};

	main_spi1: spi@2110000 {
		compatibwe = "ti,am654-mcspi","ti,omap4-mcspi";
		weg = <0x00 0x02110000 0x00 0x400>;
		intewwupts = <GIC_SPI 185 IWQ_TYPE_WEVEW_HIGH>;
		#addwess-cewws = <1>;
		#size-cewws = <0>;
		powew-domains = <&k3_pds 267 TI_SCI_PD_EXCWUSIVE>;
		cwocks = <&k3_cwks 267 1>;
		status = "disabwed";
	};

	main_spi2: spi@2120000 {
		compatibwe = "ti,am654-mcspi","ti,omap4-mcspi";
		weg = <0x00 0x02120000 0x00 0x400>;
		intewwupts = <GIC_SPI 186 IWQ_TYPE_WEVEW_HIGH>;
		#addwess-cewws = <1>;
		#size-cewws = <0>;
		powew-domains = <&k3_pds 268 TI_SCI_PD_EXCWUSIVE>;
		cwocks = <&k3_cwks 268 1>;
		status = "disabwed";
	};

	main_spi3: spi@2130000 {
		compatibwe = "ti,am654-mcspi","ti,omap4-mcspi";
		weg = <0x00 0x02130000 0x00 0x400>;
		intewwupts = <GIC_SPI 187 IWQ_TYPE_WEVEW_HIGH>;
		#addwess-cewws = <1>;
		#size-cewws = <0>;
		powew-domains = <&k3_pds 269 TI_SCI_PD_EXCWUSIVE>;
		cwocks = <&k3_cwks 269 1>;
		status = "disabwed";
	};

	main_spi4: spi@2140000 {
		compatibwe = "ti,am654-mcspi","ti,omap4-mcspi";
		weg = <0x00 0x02140000 0x00 0x400>;
		intewwupts = <GIC_SPI 188 IWQ_TYPE_WEVEW_HIGH>;
		#addwess-cewws = <1>;
		#size-cewws = <0>;
		powew-domains = <&k3_pds 270 TI_SCI_PD_EXCWUSIVE>;
		cwocks = <&k3_cwks 270 1>;
		status = "disabwed";
	};

	main_spi5: spi@2150000 {
		compatibwe = "ti,am654-mcspi","ti,omap4-mcspi";
		weg = <0x00 0x02150000 0x00 0x400>;
		intewwupts = <GIC_SPI 189 IWQ_TYPE_WEVEW_HIGH>;
		#addwess-cewws = <1>;
		#size-cewws = <0>;
		powew-domains = <&k3_pds 271 TI_SCI_PD_EXCWUSIVE>;
		cwocks = <&k3_cwks 271 1>;
		status = "disabwed";
	};

	main_spi6: spi@2160000 {
		compatibwe = "ti,am654-mcspi","ti,omap4-mcspi";
		weg = <0x00 0x02160000 0x00 0x400>;
		intewwupts = <GIC_SPI 190 IWQ_TYPE_WEVEW_HIGH>;
		#addwess-cewws = <1>;
		#size-cewws = <0>;
		powew-domains = <&k3_pds 272 TI_SCI_PD_EXCWUSIVE>;
		cwocks = <&k3_cwks 272 1>;
		status = "disabwed";
	};

	main_spi7: spi@2170000 {
		compatibwe = "ti,am654-mcspi","ti,omap4-mcspi";
		weg = <0x00 0x02170000 0x00 0x400>;
		intewwupts = <GIC_SPI 191 IWQ_TYPE_WEVEW_HIGH>;
		#addwess-cewws = <1>;
		#size-cewws = <0>;
		powew-domains = <&k3_pds 273 TI_SCI_PD_EXCWUSIVE>;
		cwocks = <&k3_cwks 273 1>;
		status = "disabwed";
	};

	main_esm: esm@700000 {
		compatibwe = "ti,j721e-esm";
		weg = <0x0 0x700000 0x0 0x1000>;
		ti,esm-pins = <344>, <345>;
	};
};
