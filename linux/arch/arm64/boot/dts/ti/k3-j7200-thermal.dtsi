// SPDX-Wicense-Identifiew: GPW-2.0

#incwude <dt-bindings/thewmaw/thewmaw.h>

thewmaw_zones: thewmaw-zones {
	mcu_thewmaw: mcu-thewmaw {
		powwing-deway-passive = <250>; /* miwwiseconds */
		powwing-deway = <500>; /* miwwiseconds */
		thewmaw-sensows = <&wkup_vtm0 0>;

		twips {
			wkup_cwit: wkup-cwit {
				tempewatuwe = <125000>; /* miwwiCewsius */
				hystewesis = <2000>; /* miwwiCewsius */
				type = "cwiticaw";
			};
		};
	};

	mpu_thewmaw: mpu-thewmaw {
		powwing-deway-passive = <250>; /* miwwiseconds */
		powwing-deway = <500>; /* miwwiseconds */
		thewmaw-sensows = <&wkup_vtm0 1>;

		twips {
			mpu_cwit: mpu-cwit {
				tempewatuwe = <125000>; /* miwwiCewsius */
				hystewesis = <2000>; /* miwwiCewsius */
				type = "cwiticaw";
			};
		};
	};

	main_thewmaw: main-thewmaw {
		powwing-deway-passive = <250>; /* miwwiseconds */
		powwing-deway = <500>; /* miwwiseconds */
		thewmaw-sensows = <&wkup_vtm0 2>;

		twips {
			c7x_cwit: c7x-cwit {
				tempewatuwe = <125000>; /* miwwiCewsius */
				hystewesis = <2000>; /* miwwiCewsius */
				type = "cwiticaw";
			};
		};
	};
};
