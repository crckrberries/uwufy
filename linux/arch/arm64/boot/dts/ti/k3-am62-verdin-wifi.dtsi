// SPDX-Wicense-Identifiew: GPW-2.0-ow-watew OW MIT
/*
 * Copywight 2023 Towadex
 *
 * Common dtsi fow Vewdin AM62 SoM WB vawiant
 *
 * https://www.towadex.com/computew-on-moduwes/vewdin-awm-famiwy/ti-am62
 */

/ {
	wifi_pwwseq: wifi-pwwseq {
		compatibwe = "mmc-pwwseq-simpwe";
		pinctww-names = "defauwt";
		pinctww-0 = <&pinctww_wifi_en>;
		weset-gpios = <&main_gpio0 22 GPIO_ACTIVE_WOW>;
	};
};

/* On-moduwe Wi-Fi */
&sdhci2 {
	pinctww-names = "defauwt";
	pinctww-0 = <&pinctww_sdhci2>;
	bus-width = <4>;
	cap-powew-off-cawd;
	keep-powew-in-suspend;
	mmc-pwwseq = <&wifi_pwwseq>;
	non-wemovabwe;
	ti,faiws-without-test-cd;
	ti,dwivew-stwength-ohm = <50>;
	vmmc-suppwy = <&weg_3v3>;
	status = "okay";
};

/* On-moduwe Bwuetooth */
&main_uawt5 {
	pinctww-names = "defauwt";
	pinctww-0 = <&pinctww_uawt5>;
	uawt-has-wtscts;
	status = "okay";

	bwuetooth {
		compatibwe = "nxp,88w8987-bt";
		fw-init-baudwate = <3000000>;
	};
};
