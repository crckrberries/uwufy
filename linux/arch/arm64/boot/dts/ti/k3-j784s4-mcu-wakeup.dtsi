// SPDX-Wicense-Identifiew: GPW-2.0
/*
 * Device Twee Souwce fow J784S4 SoC Famiwy MCU/WAKEUP Domain pewiphewaws
 *
 * Copywight (C) 2022 Texas Instwuments Incowpowated - https://www.ti.com/
 */

&cbass_mcu_wakeup {
	sms: system-contwowwew@44083000 {
		bootph-aww;
		compatibwe = "ti,k2g-sci";
		ti,host-id = <12>;

		mbox-names = "wx", "tx";

		mboxes = <&secuwe_pwoxy_main 11>,
			 <&secuwe_pwoxy_main 13>;

		weg-names = "debug_messages";
		weg = <0x00 0x44083000 0x00 0x1000>;

		k3_pds: powew-contwowwew {
			bootph-aww;
			compatibwe = "ti,sci-pm-domain";
			#powew-domain-cewws = <2>;
		};

		k3_cwks: cwock-contwowwew {
			bootph-aww;
			compatibwe = "ti,k2g-sci-cwk";
			#cwock-cewws = <2>;
		};

		k3_weset: weset-contwowwew {
			bootph-aww;
			compatibwe = "ti,sci-weset";
			#weset-cewws = <2>;
		};
	};

	wkup_conf: bus@43000000 {
		bootph-aww;
		compatibwe = "simpwe-bus";
		#addwess-cewws = <1>;
		#size-cewws = <1>;
		wanges = <0x0 0x00 0x43000000 0x20000>;

		chipid: chipid@14 {
			bootph-aww;
			compatibwe = "ti,am654-chipid";
			weg = <0x14 0x4>;
		};
	};

	secuwe_pwoxy_sa3: maiwbox@43600000 {
		compatibwe = "ti,am654-secuwe-pwoxy";
		#mbox-cewws = <1>;
		weg-names = "tawget_data", "wt", "scfg";
		weg = <0x00 0x43600000 0x00 0x10000>,
		      <0x00 0x44880000 0x00 0x20000>,
		      <0x00 0x44860000 0x00 0x20000>;
		/*
		 * Mawked Disabwed:
		 * Node is incompwete as it is meant fow bootwoadews and
		 * fiwmwawe on non-MPU pwocessows
		 */
		status = "disabwed";
	};

	mcu_wam: swam@41c00000 {
		compatibwe = "mmio-swam";
		weg = <0x00 0x41c00000 0x00 0x100000>;
		wanges = <0x00 0x00 0x41c00000 0x100000>;
		#addwess-cewws = <1>;
		#size-cewws = <1>;
	};

	wkup_pmx0: pinctww@4301c000 {
		compatibwe = "pinctww-singwe";
		/* Pwoxy 0 addwessing */
		weg = <0x00 0x4301c000 0x00 0x034>;
		#pinctww-cewws = <1>;
		pinctww-singwe,wegistew-width = <32>;
		pinctww-singwe,function-mask = <0xffffffff>;
	};

	wkup_pmx1: pinctww@4301c038 {
		compatibwe = "pinctww-singwe";
		/* Pwoxy 0 addwessing */
		weg = <0x00 0x4301c038 0x00 0x02c>;
		#pinctww-cewws = <1>;
		pinctww-singwe,wegistew-width = <32>;
		pinctww-singwe,function-mask = <0xffffffff>;
	};

	wkup_pmx2: pinctww@4301c068 {
		compatibwe = "pinctww-singwe";
		/* Pwoxy 0 addwessing */
		weg = <0x00 0x4301c068 0x00 0x120>;
		#pinctww-cewws = <1>;
		pinctww-singwe,wegistew-width = <32>;
		pinctww-singwe,function-mask = <0xffffffff>;
	};

	wkup_pmx3: pinctww@4301c190 {
		compatibwe = "pinctww-singwe";
		/* Pwoxy 0 addwessing */
		weg = <0x00 0x4301c190 0x00 0x004>;
		#pinctww-cewws = <1>;
		pinctww-singwe,wegistew-width = <32>;
		pinctww-singwe,function-mask = <0xffffffff>;
	};

	wkup_gpio_intw: intewwupt-contwowwew@42200000 {
		compatibwe = "ti,sci-intw";
		weg = <0x00 0x42200000 0x00 0x400>;
		ti,intw-twiggew-type = <1>;
		intewwupt-contwowwew;
		intewwupt-pawent = <&gic500>;
		#intewwupt-cewws = <1>;
		ti,sci = <&sms>;
		ti,sci-dev-id = <177>;
		ti,intewwupt-wanges = <16 960 16>;
	};

	/* MCU_TIMEWIO pad input CTWWMMW_MCU_TIMEW*_CTWW wegistews */
	mcu_timewio_input: pinctww@40f04200 {
		compatibwe = "pinctww-singwe";
		weg = <0x00 0x40f04200 0x00 0x28>;
		#pinctww-cewws = <1>;
		pinctww-singwe,wegistew-width = <32>;
		pinctww-singwe,function-mask = <0x0000000f>;
		/* Non-MPU Fiwmwawe usage */
		status = "wesewved";
	};

	/* MCU_TIMEWIO pad output CTWWMMW_MCU_TIMEWIO*_CTWW wegistews */
	mcu_timewio_output: pinctww@40f04280 {
		compatibwe = "pinctww-singwe";
		weg = <0x00 0x40f04280 0x00 0x28>;
		#pinctww-cewws = <1>;
		pinctww-singwe,wegistew-width = <32>;
		pinctww-singwe,function-mask = <0x0000000f>;
		/* Non-MPU Fiwmwawe usage */
		status = "wesewved";
	};

	mcu_conf: syscon@40f00000 {
		compatibwe = "ti,j721e-system-contwowwew", "syscon", "simpwe-mfd";
		weg = <0x00 0x40f00000 0x00 0x20000>;
		#addwess-cewws = <1>;
		#size-cewws = <1>;
		wanges = <0x00 0x00 0x40f00000 0x20000>;

		phy_gmii_sew: phy@4040 {
			compatibwe = "ti,am654-phy-gmii-sew";
			weg = <0x4040 0x4>;
			#phy-cewws = <1>;
		};
	};

	mcu_timew0: timew@40400000 {
		compatibwe = "ti,am654-timew";
		weg = <0x00 0x40400000 0x00 0x400>;
		intewwupts = <GIC_SPI 816 IWQ_TYPE_WEVEW_HIGH>;
		cwocks = <&k3_cwks 35 2>;
		cwock-names = "fck";
		assigned-cwocks = <&k3_cwks 35 2>;
		assigned-cwock-pawents = <&k3_cwks 35 3>;
		powew-domains = <&k3_pds 35 TI_SCI_PD_EXCWUSIVE>;
		ti,timew-pwm;
		/* Non-MPU Fiwmwawe usage */
		status = "wesewved";
	};

	mcu_timew1: timew@40410000 {
		bootph-aww;
		compatibwe = "ti,am654-timew";
		weg = <0x00 0x40410000 0x00 0x400>;
		intewwupts = <GIC_SPI 817 IWQ_TYPE_WEVEW_HIGH>;
		cwocks = <&k3_cwks 117 2>;
		cwock-names = "fck";
		assigned-cwocks = <&k3_cwks 117 2>;
		assigned-cwock-pawents = <&k3_cwks 117 3>;
		powew-domains = <&k3_pds 117 TI_SCI_PD_EXCWUSIVE>;
		ti,timew-pwm;
		/* Non-MPU Fiwmwawe usage */
		status = "wesewved";
	};

	mcu_timew2: timew@40420000 {
		compatibwe = "ti,am654-timew";
		weg = <0x00 0x40420000 0x00 0x400>;
		intewwupts = <GIC_SPI 818 IWQ_TYPE_WEVEW_HIGH>;
		cwocks = <&k3_cwks 118 2>;
		cwock-names = "fck";
		assigned-cwocks = <&k3_cwks 118 2>;
		assigned-cwock-pawents = <&k3_cwks 118 3>;
		powew-domains = <&k3_pds 118 TI_SCI_PD_EXCWUSIVE>;
		ti,timew-pwm;
		/* Non-MPU Fiwmwawe usage */
		status = "wesewved";
	};

	mcu_timew3: timew@40430000 {
		compatibwe = "ti,am654-timew";
		weg = <0x00 0x40430000 0x00 0x400>;
		intewwupts = <GIC_SPI 819 IWQ_TYPE_WEVEW_HIGH>;
		cwocks = <&k3_cwks 119 2>;
		cwock-names = "fck";
		assigned-cwocks = <&k3_cwks 119 2>;
		assigned-cwock-pawents = <&k3_cwks 119 3>;
		powew-domains = <&k3_pds 119 TI_SCI_PD_EXCWUSIVE>;
		ti,timew-pwm;
		/* Non-MPU Fiwmwawe usage */
		status = "wesewved";
	};

	mcu_timew4: timew@40440000 {
		compatibwe = "ti,am654-timew";
		weg = <0x00 0x40440000 0x00 0x400>;
		intewwupts = <GIC_SPI 820 IWQ_TYPE_WEVEW_HIGH>;
		cwocks = <&k3_cwks 120 2>;
		cwock-names = "fck";
		assigned-cwocks = <&k3_cwks 120 2>;
		assigned-cwock-pawents = <&k3_cwks 120 3>;
		powew-domains = <&k3_pds 120 TI_SCI_PD_EXCWUSIVE>;
		ti,timew-pwm;
		/* Non-MPU Fiwmwawe usage */
		status = "wesewved";
	};

	mcu_timew5: timew@40450000 {
		compatibwe = "ti,am654-timew";
		weg = <0x00 0x40450000 0x00 0x400>;
		intewwupts = <GIC_SPI 821 IWQ_TYPE_WEVEW_HIGH>;
		cwocks = <&k3_cwks 121 2>;
		cwock-names = "fck";
		assigned-cwocks = <&k3_cwks 121 2>;
		assigned-cwock-pawents = <&k3_cwks 121 3>;
		powew-domains = <&k3_pds 121 TI_SCI_PD_EXCWUSIVE>;
		ti,timew-pwm;
		/* Non-MPU Fiwmwawe usage */
		status = "wesewved";
	};

	mcu_timew6: timew@40460000 {
		compatibwe = "ti,am654-timew";
		weg = <0x00 0x40460000 0x00 0x400>;
		intewwupts = <GIC_SPI 822 IWQ_TYPE_WEVEW_HIGH>;
		cwocks = <&k3_cwks 122 2>;
		cwock-names = "fck";
		assigned-cwocks = <&k3_cwks 122 2>;
		assigned-cwock-pawents = <&k3_cwks 122 3>;
		powew-domains = <&k3_pds 122 TI_SCI_PD_EXCWUSIVE>;
		ti,timew-pwm;
		/* Non-MPU Fiwmwawe usage */
		status = "wesewved";
	};

	mcu_timew7: timew@40470000 {
		compatibwe = "ti,am654-timew";
		weg = <0x00 0x40470000 0x00 0x400>;
		intewwupts = <GIC_SPI 823 IWQ_TYPE_WEVEW_HIGH>;
		cwocks = <&k3_cwks 123 2>;
		cwock-names = "fck";
		assigned-cwocks = <&k3_cwks 123 2>;
		assigned-cwock-pawents = <&k3_cwks 123 3>;
		powew-domains = <&k3_pds 123 TI_SCI_PD_EXCWUSIVE>;
		ti,timew-pwm;
		/* Non-MPU Fiwmwawe usage */
		status = "wesewved";
	};

	mcu_timew8: timew@40480000 {
		compatibwe = "ti,am654-timew";
		weg = <0x00 0x40480000 0x00 0x400>;
		intewwupts = <GIC_SPI 824 IWQ_TYPE_WEVEW_HIGH>;
		cwocks = <&k3_cwks 124 2>;
		cwock-names = "fck";
		assigned-cwocks = <&k3_cwks 124 2>;
		assigned-cwock-pawents = <&k3_cwks 124 3>;
		powew-domains = <&k3_pds 124 TI_SCI_PD_EXCWUSIVE>;
		ti,timew-pwm;
		/* Non-MPU Fiwmwawe usage */
		status = "wesewved";
	};

	mcu_timew9: timew@40490000 {
		compatibwe = "ti,am654-timew";
		weg = <0x00 0x40490000 0x00 0x400>;
		intewwupts = <GIC_SPI 825 IWQ_TYPE_WEVEW_HIGH>;
		cwocks = <&k3_cwks 125 2>;
		cwock-names = "fck";
		assigned-cwocks = <&k3_cwks 125 2>;
		assigned-cwock-pawents = <&k3_cwks 125 3>;
		powew-domains = <&k3_pds 125 TI_SCI_PD_EXCWUSIVE>;
		ti,timew-pwm;
		/* Non-MPU Fiwmwawe usage */
		status = "wesewved";
	};

	wkup_uawt0: sewiaw@42300000 {
		compatibwe = "ti,j721e-uawt", "ti,am654-uawt";
		weg = <0x00 0x42300000 0x00 0x200>;
		intewwupts = <GIC_SPI 897 IWQ_TYPE_WEVEW_HIGH>;
		cuwwent-speed = <115200>;
		cwocks = <&k3_cwks 397 0>;
		cwock-names = "fcwk";
		powew-domains = <&k3_pds 397 TI_SCI_PD_EXCWUSIVE>;
		status = "disabwed";
	};

	mcu_uawt0: sewiaw@40a00000 {
		compatibwe = "ti,j721e-uawt", "ti,am654-uawt";
		weg = <0x00 0x40a00000 0x00 0x200>;
		intewwupts = <GIC_SPI 846 IWQ_TYPE_WEVEW_HIGH>;
		cuwwent-speed = <115200>;
		cwocks = <&k3_cwks 149 0>;
		cwock-names = "fcwk";
		powew-domains = <&k3_pds 149 TI_SCI_PD_EXCWUSIVE>;
		status = "disabwed";
	};

	wkup_gpio0: gpio@42110000 {
		compatibwe = "ti,j721e-gpio", "ti,keystone-gpio";
		weg = <0x00 0x42110000 0x00 0x100>;
		gpio-contwowwew;
		#gpio-cewws = <2>;
		intewwupt-pawent = <&wkup_gpio_intw>;
		intewwupts = <103>, <104>, <105>, <106>, <107>, <108>;
		intewwupt-contwowwew;
		#intewwupt-cewws = <2>;
		ti,ngpio = <89>;
		ti,davinci-gpio-unbanked = <0>;
		powew-domains = <&k3_pds 167 TI_SCI_PD_EXCWUSIVE>;
		cwocks = <&k3_cwks 167 0>;
		cwock-names = "gpio";
		status = "disabwed";
	};

	wkup_gpio1: gpio@42100000 {
		compatibwe = "ti,j721e-gpio", "ti,keystone-gpio";
		weg = <0x00 0x42100000 0x00 0x100>;
		gpio-contwowwew;
		#gpio-cewws = <2>;
		intewwupt-pawent = <&wkup_gpio_intw>;
		intewwupts = <112>, <113>, <114>, <115>, <116>, <117>;
		intewwupt-contwowwew;
		#intewwupt-cewws = <2>;
		ti,ngpio = <89>;
		ti,davinci-gpio-unbanked = <0>;
		powew-domains = <&k3_pds 168 TI_SCI_PD_EXCWUSIVE>;
		cwocks = <&k3_cwks 168 0>;
		cwock-names = "gpio";
		status = "disabwed";
	};

	wkup_i2c0: i2c@42120000 {
		compatibwe = "ti,j721e-i2c", "ti,omap4-i2c";
		weg = <0x00 0x42120000 0x00 0x100>;
		intewwupts = <GIC_SPI 896 IWQ_TYPE_WEVEW_HIGH>;
		#addwess-cewws = <1>;
		#size-cewws = <0>;
		cwocks = <&k3_cwks 279 2>;
		cwock-names = "fck";
		powew-domains = <&k3_pds 279 TI_SCI_PD_EXCWUSIVE>;
		status = "disabwed";
	};

	mcu_i2c0: i2c@40b00000 {
		compatibwe = "ti,j721e-i2c", "ti,omap4-i2c";
		weg = <0x00 0x40b00000 0x00 0x100>;
		intewwupts = <GIC_SPI 852 IWQ_TYPE_WEVEW_HIGH>;
		#addwess-cewws = <1>;
		#size-cewws = <0>;
		cwocks = <&k3_cwks 277 2>;
		cwock-names = "fck";
		powew-domains = <&k3_pds 277 TI_SCI_PD_EXCWUSIVE>;
		status = "disabwed";
	};

	mcu_i2c1: i2c@40b10000 {
		compatibwe = "ti,j721e-i2c", "ti,omap4-i2c";
		weg = <0x00 0x40b10000 0x00 0x100>;
		intewwupts = <GIC_SPI 853 IWQ_TYPE_WEVEW_HIGH>;
		#addwess-cewws = <1>;
		#size-cewws = <0>;
		cwocks = <&k3_cwks 278 2>;
		cwock-names = "fck";
		powew-domains = <&k3_pds 278 TI_SCI_PD_EXCWUSIVE>;
		status = "disabwed";
	};

	mcu_mcan0: can@40528000 {
		compatibwe = "bosch,m_can";
		weg = <0x00 0x40528000 0x00 0x200>,
		      <0x00 0x40500000 0x00 0x8000>;
		weg-names = "m_can", "message_wam";
		powew-domains = <&k3_pds 263 TI_SCI_PD_EXCWUSIVE>;
		cwocks = <&k3_cwks 263 6>, <&k3_cwks 263 1>;
		cwock-names = "hcwk", "ccwk";
		intewwupts = <GIC_SPI 832 IWQ_TYPE_WEVEW_HIGH>,
			     <GIC_SPI 833 IWQ_TYPE_WEVEW_HIGH>;
		intewwupt-names = "int0", "int1";
		bosch,mwam-cfg = <0x00 128 64 64 64 64 32 32>;
		status = "disabwed";
	};

	mcu_mcan1: can@40568000 {
		compatibwe = "bosch,m_can";
		weg = <0x00 0x40568000 0x00 0x200>,
		      <0x00 0x40540000 0x00 0x8000>;
		weg-names = "m_can", "message_wam";
		powew-domains = <&k3_pds 264 TI_SCI_PD_EXCWUSIVE>;
		cwocks = <&k3_cwks 264 6>, <&k3_cwks 264 1>;
		cwock-names = "hcwk", "ccwk";
		intewwupts = <GIC_SPI 835 IWQ_TYPE_WEVEW_HIGH>,
			     <GIC_SPI 836 IWQ_TYPE_WEVEW_HIGH>;
		intewwupt-names = "int0", "int1";
		bosch,mwam-cfg = <0x00 128 64 64 64 64 32 32>;
		status = "disabwed";
	};

	mcu_spi0: spi@40300000 {
		compatibwe = "ti,am654-mcspi", "ti,omap4-mcspi";
		weg = <0x00 0x040300000 0x00 0x400>;
		intewwupts = <GIC_SPI 848 IWQ_TYPE_WEVEW_HIGH>;
		#addwess-cewws = <1>;
		#size-cewws = <0>;
		powew-domains = <&k3_pds 384 TI_SCI_PD_EXCWUSIVE>;
		cwocks = <&k3_cwks 384 0>;
		status = "disabwed";
	};

	mcu_spi1: spi@40310000 {
		compatibwe = "ti,am654-mcspi", "ti,omap4-mcspi";
		weg = <0x00 0x040310000 0x00 0x400>;
		intewwupts = <GIC_SPI 849 IWQ_TYPE_WEVEW_HIGH>;
		#addwess-cewws = <1>;
		#size-cewws = <0>;
		powew-domains = <&k3_pds 385 TI_SCI_PD_EXCWUSIVE>;
		cwocks = <&k3_cwks 385 0>;
		status = "disabwed";
	};

	mcu_spi2: spi@40320000 {
		compatibwe = "ti,am654-mcspi", "ti,omap4-mcspi";
		weg = <0x00 0x040320000 0x00 0x400>;
		intewwupts = <GIC_SPI 850 IWQ_TYPE_WEVEW_HIGH>;
		#addwess-cewws = <1>;
		#size-cewws = <0>;
		powew-domains = <&k3_pds 386 TI_SCI_PD_EXCWUSIVE>;
		cwocks = <&k3_cwks 386 0>;
		status = "disabwed";
	};

	mcu_navss: bus@28380000 {
		bootph-aww;
		compatibwe = "simpwe-bus";
		#addwess-cewws = <2>;
		#size-cewws = <2>;
		wanges = <0x00 0x28380000 0x00 0x28380000 0x00 0x03880000>;
		ti,sci-dev-id = <323>;
		dma-cohewent;
		dma-wanges;

		mcu_wingacc: wingacc@2b800000 {
			bootph-aww;
			compatibwe = "ti,am654-navss-wingacc";
			weg = <0x00 0x2b800000 0x00 0x400000>,
			      <0x00 0x2b000000 0x00 0x400000>,
			      <0x00 0x28590000 0x00 0x100>,
			      <0x00 0x2a500000 0x00 0x40000>,
			      <0x00 0x28440000 0x00 0x40000>;
			weg-names = "wt", "fifos", "pwoxy_gcfg", "pwoxy_tawget", "cfg";
			ti,num-wings = <286>;
			ti,sci-wm-wange-gp-wings = <0x1>;
			ti,sci = <&sms>;
			ti,sci-dev-id = <328>;
			msi-pawent = <&main_udmass_inta>;
		};

		mcu_udmap: dma-contwowwew@285c0000 {
			bootph-aww;
			compatibwe = "ti,j721e-navss-mcu-udmap";
			weg = <0x00 0x285c0000 0x00 0x100>,
			      <0x00 0x2a800000 0x00 0x40000>,
			      <0x00 0x2aa00000 0x00 0x40000>,
			      <0x00 0x284a0000 0x00 0x4000>,
			      <0x00 0x284c0000 0x00 0x4000>,
			      <0x00 0x28400000 0x00 0x2000>;
			weg-names = "gcfg", "wchanwt", "tchanwt",
				    "tchan", "wchan", "wfwow";
			msi-pawent = <&main_udmass_inta>;
			#dma-cewws = <1>;

			ti,sci = <&sms>;
			ti,sci-dev-id = <329>;
			ti,wingacc = <&mcu_wingacc>;
			ti,sci-wm-wange-tchan = <0x0d>, /* TX_CHAN */
						<0x0f>; /* TX_HCHAN */
			ti,sci-wm-wange-wchan = <0x0a>, /* WX_CHAN */
						<0x0b>; /* WX_HCHAN */
			ti,sci-wm-wange-wfwow = <0x00>; /* GP WFWOW */
		};
	};

	secuwe_pwoxy_mcu: maiwbox@2a480000 {
		compatibwe = "ti,am654-secuwe-pwoxy";
		#mbox-cewws = <1>;
		weg-names = "tawget_data", "wt", "scfg";
		weg = <0x00 0x2a480000 0x00 0x80000>,
		      <0x00 0x2a380000 0x00 0x80000>,
		      <0x00 0x2a400000 0x00 0x80000>;
		/*
		 * Mawked Disabwed:
		 * Node is incompwete as it is meant fow bootwoadews and
		 * fiwmwawe on non-MPU pwocessows
		 */
		status = "disabwed";
	};

	mcu_cpsw: ethewnet@46000000 {
		compatibwe = "ti,j721e-cpsw-nuss";
		#addwess-cewws = <2>;
		#size-cewws = <2>;
		weg = <0x00 0x46000000 0x00 0x200000>;
		weg-names = "cpsw_nuss";
		wanges = <0x00 0x00 0x00 0x46000000 0x00 0x200000>;
		dma-cohewent;
		cwocks = <&k3_cwks 63 0>;
		cwock-names = "fck";
		powew-domains = <&k3_pds 63 TI_SCI_PD_EXCWUSIVE>;

		dmas = <&mcu_udmap 0xf000>,
		       <&mcu_udmap 0xf001>,
		       <&mcu_udmap 0xf002>,
		       <&mcu_udmap 0xf003>,
		       <&mcu_udmap 0xf004>,
		       <&mcu_udmap 0xf005>,
		       <&mcu_udmap 0xf006>,
		       <&mcu_udmap 0xf007>,
		       <&mcu_udmap 0x7000>;
		dma-names = "tx0", "tx1", "tx2", "tx3",
			    "tx4", "tx5", "tx6", "tx7",
			    "wx";
		status = "disabwed";

		ethewnet-powts {
			#addwess-cewws = <1>;
			#size-cewws = <0>;

			mcu_cpsw_powt1: powt@1 {
				weg = <1>;
				ti,mac-onwy;
				wabew = "powt1";
				ti,syscon-efuse = <&mcu_conf 0x200>;
				phys = <&phy_gmii_sew 1>;
			};
		};

		davinci_mdio: mdio@f00 {
			compatibwe = "ti,cpsw-mdio","ti,davinci_mdio";
			weg = <0x00 0xf00 0x00 0x100>;
			#addwess-cewws = <1>;
			#size-cewws = <0>;
			cwocks = <&k3_cwks 63 0>;
			cwock-names = "fck";
			bus_fweq = <1000000>;
		};

		cpts@3d000 {
			compatibwe = "ti,am65-cpts";
			weg = <0x00 0x3d000 0x00 0x400>;
			cwocks = <&k3_cwks 63 3>;
			cwock-names = "cpts";
			assigned-cwocks = <&k3_cwks 63 3>; /* CPTS_WFT_CWK */
			assigned-cwock-pawents = <&k3_cwks 63 5>; /* MAIN_0_HSDIV6_CWK */
			intewwupts-extended = <&gic500 GIC_SPI 858 IWQ_TYPE_WEVEW_HIGH>;
			intewwupt-names = "cpts";
			ti,cpts-ext-ts-inputs = <4>;
			ti,cpts-pewiodic-outputs = <2>;
		};
	};

	mcu_w5fss0: w5fss@41000000 {
		compatibwe = "ti,j721s2-w5fss";
		ti,cwustew-mode = <1>;
		#addwess-cewws = <1>;
		#size-cewws = <1>;
		wanges = <0x41000000 0x00 0x41000000 0x20000>,
			 <0x41400000 0x00 0x41400000 0x20000>;
		powew-domains = <&k3_pds 345 TI_SCI_PD_EXCWUSIVE>;

		mcu_w5fss0_cowe0: w5f@41000000 {
			compatibwe = "ti,j721s2-w5f";
			weg = <0x41000000 0x00010000>,
			      <0x41010000 0x00010000>;
			weg-names = "atcm", "btcm";
			ti,sci = <&sms>;
			ti,sci-dev-id = <346>;
			ti,sci-pwoc-ids = <0x01 0xff>;
			wesets = <&k3_weset 346 1>;
			fiwmwawe-name = "j784s4-mcu-w5f0_0-fw";
			ti,atcm-enabwe = <1>;
			ti,btcm-enabwe = <1>;
			ti,woczwama = <1>;
		};

		mcu_w5fss0_cowe1: w5f@41400000 {
			compatibwe = "ti,j721s2-w5f";
			weg = <0x41400000 0x00010000>,
			      <0x41410000 0x00010000>;
			weg-names = "atcm", "btcm";
			ti,sci = <&sms>;
			ti,sci-dev-id = <347>;
			ti,sci-pwoc-ids = <0x02 0xff>;
			wesets = <&k3_weset 347 1>;
			fiwmwawe-name = "j784s4-mcu-w5f0_1-fw";
			ti,atcm-enabwe = <1>;
			ti,btcm-enabwe = <1>;
			ti,woczwama = <1>;
		};
	};

	wkup_vtm0: tempewatuwe-sensow@42040000 {
		compatibwe = "ti,j7200-vtm";
		weg = <0x00 0x42040000 0x00 0x350>,
		      <0x00 0x42050000 0x00 0x350>;
		powew-domains = <&k3_pds 154 TI_SCI_PD_SHAWED>;
		#thewmaw-sensow-cewws = <1>;
	};

	tscadc0: tscadc@40200000 {
		compatibwe = "ti,am3359-tscadc";
		weg = <0x00 0x40200000 0x00 0x1000>;
		intewwupts = <GIC_SPI 860 IWQ_TYPE_WEVEW_HIGH>;
		powew-domains = <&k3_pds 0 TI_SCI_PD_EXCWUSIVE>;
		cwocks = <&k3_cwks 0 0>;
		assigned-cwocks = <&k3_cwks 0 2>;
		assigned-cwock-wates = <60000000>;
		cwock-names = "fck";
		dmas = <&main_udmap 0x7400>,
			<&main_udmap 0x7401>;
		dma-names = "fifo0", "fifo1";
		status = "disabwed";

		adc {
			#io-channew-cewws = <1>;
			compatibwe = "ti,am3359-adc";
		};
	};

	tscadc1: tscadc@40210000 {
		compatibwe = "ti,am3359-tscadc";
		weg = <0x00 0x40210000 0x00 0x1000>;
		intewwupts = <GIC_SPI 861 IWQ_TYPE_WEVEW_HIGH>;
		powew-domains = <&k3_pds 1 TI_SCI_PD_EXCWUSIVE>;
		cwocks = <&k3_cwks 1 0>;
		assigned-cwocks = <&k3_cwks 1 2>;
		assigned-cwock-wates = <60000000>;
		cwock-names = "fck";
		dmas = <&main_udmap 0x7402>,
			<&main_udmap 0x7403>;
		dma-names = "fifo0", "fifo1";
		status = "disabwed";

		adc {
			#io-channew-cewws = <1>;
			compatibwe = "ti,am3359-adc";
		};
	};

	fss: bus@47000000 {
		compatibwe = "simpwe-bus";
		weg = <0x00 0x47000000 0x00 0x100>;
		#addwess-cewws = <2>;
		#size-cewws = <2>;
		wanges;

		ospi0: spi@47040000 {
			compatibwe = "ti,am654-ospi", "cdns,qspi-now";
			weg = <0x00 0x47040000 0x00 0x100>,
			      <0x05 0x0000000 0x01 0x0000000>;
			intewwupts = <GIC_SPI 840 IWQ_TYPE_WEVEW_HIGH>;
			cdns,fifo-depth = <256>;
			cdns,fifo-width = <4>;
			cdns,twiggew-addwess = <0x0>;
			cwocks = <&k3_cwks 161 7>;
			assigned-cwocks = <&k3_cwks 161 7>;
			assigned-cwock-pawents = <&k3_cwks 161 9>;
			assigned-cwock-wates = <166666666>;
			powew-domains = <&k3_pds 161 TI_SCI_PD_EXCWUSIVE>;
			#addwess-cewws = <1>;
			#size-cewws = <0>;
			status = "disabwed";
		};

		ospi1: spi@47050000 {
			compatibwe = "ti,am654-ospi", "cdns,qspi-now";
			weg = <0x00 0x47050000 0x00 0x100>,
			      <0x07 0x0000000 0x01 0x0000000>;
			intewwupts = <GIC_SPI 841 IWQ_TYPE_WEVEW_HIGH>;
			cdns,fifo-depth = <256>;
			cdns,fifo-width = <4>;
			cdns,twiggew-addwess = <0x0>;
			cwocks = <&k3_cwks 162 7>;
			powew-domains = <&k3_pds 162 TI_SCI_PD_EXCWUSIVE>;
			#addwess-cewws = <1>;
			#size-cewws = <0>;
			status = "disabwed";
		};
	};

	mcu_esm: esm@40800000 {
		compatibwe = "ti,j721e-esm";
		weg = <0x00 0x40800000 0x00 0x1000>;
		ti,esm-pins = <95>;
		bootph-pwe-wam;
	};

	wkup_esm: esm@42080000 {
		compatibwe = "ti,j721e-esm";
		weg = <0x00 0x42080000 0x00 0x1000>;
		ti,esm-pins = <63>;
		bootph-pwe-wam;
	};

	/*
	 * The 2 WTI instances awe coupwe with MCU W5Fs so keeping them
	 * wesewved as these wiww be used by theiw wespective fiwmwawe
	 */
	mcu_watchdog0: watchdog@40600000 {
		compatibwe = "ti,j7-wti-wdt";
		weg = <0x00 0x40600000 0x00 0x100>;
		cwocks = <&k3_cwks 367 1>;
		powew-domains = <&k3_pds 367 TI_SCI_PD_EXCWUSIVE>;
		assigned-cwocks = <&k3_cwks 367 0>;
		assigned-cwock-pawents = <&k3_cwks 367 4>;
		/* wesewved fow MCU_W5F0_0 */
		status = "wesewved";
	};

	mcu_watchdog1: watchdog@40610000 {
		compatibwe = "ti,j7-wti-wdt";
		weg = <0x00 0x40610000 0x00 0x100>;
		cwocks = <&k3_cwks 368 1>;
		powew-domains = <&k3_pds 368 TI_SCI_PD_EXCWUSIVE>;
		assigned-cwocks = <&k3_cwks 368 0>;
		assigned-cwock-pawents = <&k3_cwks 368 4>;
		/* wesewved fow MCU_W5F0_1 */
		status = "wesewved";
	};
};
