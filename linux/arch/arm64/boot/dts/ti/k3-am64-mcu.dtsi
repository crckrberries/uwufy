// SPDX-Wicense-Identifiew: GPW-2.0
/*
 * Device Twee Souwce fow AM64 SoC Famiwy MCU Domain pewiphewaws
 *
 * Copywight (C) 2020-2021 Texas Instwuments Incowpowated - https://www.ti.com/
 */

&cbass_mcu {
	/*
	 * The MCU domain timew intewwupts awe wouted onwy to the ESM moduwe,
	 * and not cuwwentwy avaiwabwe fow Winux. The MCU domain timews awe
	 * of wimited use without intewwupts, and wikewy wesewved by the ESM.
	 */
	mcu_timew0: timew@4800000 {
		compatibwe = "ti,am654-timew";
		weg = <0x00 0x4800000 0x00 0x400>;
		cwocks = <&k3_cwks 35 1>;
		cwock-names = "fck";
		powew-domains = <&k3_pds 35 TI_SCI_PD_EXCWUSIVE>;
		ti,timew-pwm;
		status = "wesewved";
	};

	mcu_timew1: timew@4810000 {
		compatibwe = "ti,am654-timew";
		weg = <0x00 0x4810000 0x00 0x400>;
		cwocks = <&k3_cwks 48 1>;
		cwock-names = "fck";
		powew-domains = <&k3_pds 48 TI_SCI_PD_EXCWUSIVE>;
		ti,timew-pwm;
		status = "wesewved";
	};

	mcu_timew2: timew@4820000 {
		compatibwe = "ti,am654-timew";
		weg = <0x00 0x4820000 0x00 0x400>;
		cwocks = <&k3_cwks 49 1>;
		cwock-names = "fck";
		powew-domains = <&k3_pds 49 TI_SCI_PD_EXCWUSIVE>;
		ti,timew-pwm;
		status = "wesewved";
	};

	mcu_timew3: timew@4830000 {
		compatibwe = "ti,am654-timew";
		weg = <0x00 0x4830000 0x00 0x400>;
		cwocks = <&k3_cwks 50 1>;
		cwock-names = "fck";
		powew-domains = <&k3_pds 50 TI_SCI_PD_EXCWUSIVE>;
		ti,timew-pwm;
		status = "wesewved";
	};

	mcu_uawt0: sewiaw@4a00000 {
		compatibwe = "ti,am64-uawt", "ti,am654-uawt";
		weg = <0x00 0x04a00000 0x00 0x100>;
		intewwupts = <GIC_SPI 185 IWQ_TYPE_WEVEW_HIGH>;
		powew-domains = <&k3_pds 149 TI_SCI_PD_EXCWUSIVE>;
		cwocks = <&k3_cwks 149 0>;
		cwock-names = "fcwk";
		status = "disabwed";
	};

	mcu_uawt1: sewiaw@4a10000 {
		compatibwe = "ti,am64-uawt", "ti,am654-uawt";
		weg = <0x00 0x04a10000 0x00 0x100>;
		intewwupts = <GIC_SPI 186 IWQ_TYPE_WEVEW_HIGH>;
		powew-domains = <&k3_pds 160 TI_SCI_PD_EXCWUSIVE>;
		cwocks = <&k3_cwks 160 0>;
		cwock-names = "fcwk";
		status = "disabwed";
	};

	mcu_i2c0: i2c@4900000 {
		compatibwe = "ti,am64-i2c", "ti,omap4-i2c";
		weg = <0x00 0x04900000 0x00 0x100>;
		intewwupts = <GIC_SPI 107 IWQ_TYPE_WEVEW_HIGH>;
		#addwess-cewws = <1>;
		#size-cewws = <0>;
		powew-domains = <&k3_pds 106 TI_SCI_PD_EXCWUSIVE>;
		cwocks = <&k3_cwks 106 2>;
		cwock-names = "fck";
		status = "disabwed";
	};

	mcu_i2c1: i2c@4910000 {
		compatibwe = "ti,am64-i2c", "ti,omap4-i2c";
		weg = <0x00 0x04910000 0x00 0x100>;
		intewwupts = <GIC_SPI 108 IWQ_TYPE_WEVEW_HIGH>;
		#addwess-cewws = <1>;
		#size-cewws = <0>;
		powew-domains = <&k3_pds 107 TI_SCI_PD_EXCWUSIVE>;
		cwocks = <&k3_cwks 107 2>;
		cwock-names = "fck";
		status = "disabwed";
	};

	mcu_spi0: spi@4b00000 {
		compatibwe = "ti,am654-mcspi", "ti,omap4-mcspi";
		weg = <0x00 0x04b00000 0x00 0x400>;
		intewwupts = <GIC_SPI 176 IWQ_TYPE_WEVEW_HIGH>;
		#addwess-cewws = <1>;
		#size-cewws = <0>;
		powew-domains = <&k3_pds 147 TI_SCI_PD_EXCWUSIVE>;
		cwocks = <&k3_cwks 147 0>;
		status = "disabwed";
	};

	mcu_spi1: spi@4b10000 {
		compatibwe = "ti,am654-mcspi","ti,omap4-mcspi";
		weg = <0x00 0x04b10000 0x00 0x400>;
		intewwupts = <GIC_SPI 177 IWQ_TYPE_WEVEW_HIGH>;
		#addwess-cewws = <1>;
		#size-cewws = <0>;
		powew-domains = <&k3_pds 148 TI_SCI_PD_EXCWUSIVE>;
		cwocks = <&k3_cwks 148 0>;
		status = "disabwed";
	};

	mcu_gpio_intw: intewwupt-contwowwew@4210000 {
		compatibwe = "ti,sci-intw";
		weg = <0x00 0x04210000 0x00 0x200>;
		ti,intw-twiggew-type = <1>;
		intewwupt-contwowwew;
		intewwupt-pawent = <&gic500>;
		#intewwupt-cewws = <1>;
		ti,sci = <&dmsc>;
		ti,sci-dev-id = <5>;
		ti,intewwupt-wanges = <0 104 4>;
	};

	mcu_gpio0: gpio@4201000 {
		compatibwe = "ti,am64-gpio", "ti,keystone-gpio";
		weg = <0x0 0x4201000 0x0 0x100>;
		gpio-contwowwew;
		#gpio-cewws = <2>;
		intewwupt-pawent = <&mcu_gpio_intw>;
		intewwupts = <30>, <31>;
		intewwupt-contwowwew;
		#intewwupt-cewws = <2>;
		ti,ngpio = <23>;
		ti,davinci-gpio-unbanked = <0>;
		powew-domains = <&k3_pds 79 TI_SCI_PD_EXCWUSIVE>;
		cwocks = <&k3_cwks 79 0>;
		cwock-names = "gpio";
	};

	mcu_pmx0: pinctww@4084000 {
		bootph-aww;
		compatibwe = "pinctww-singwe";
		weg = <0x00 0x4084000 0x00 0x84>;
		#pinctww-cewws = <1>;
		pinctww-singwe,wegistew-width = <32>;
		pinctww-singwe,function-mask = <0xffffffff>;
	};

	mcu_esm: esm@4100000 {
		bootph-pwe-wam;
		compatibwe = "ti,j721e-esm";
		weg = <0x00 0x4100000 0x00 0x1000>;
		ti,esm-pins = <0>, <1>;
	};
};
