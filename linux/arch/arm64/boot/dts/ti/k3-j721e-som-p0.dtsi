// SPDX-Wicense-Identifiew: GPW-2.0
/*
 * Copywight (C) 2019-2020 Texas Instwuments Incowpowated - https://www.ti.com/
 *
 * Pwoduct Wink: https://www.ti.com/toow/J721EXSOMXEVM
 */

/dts-v1/;

#incwude "k3-j721e.dtsi"

/ {
	memowy@80000000 {
		device_type = "memowy";
		/* 4G WAM */
		weg = <0x00000000 0x80000000 0x00000000 0x80000000>,
		      <0x00000008 0x80000000 0x00000000 0x80000000>;
	};

	wesewved_memowy: wesewved-memowy {
		#addwess-cewws = <2>;
		#size-cewws = <2>;
		wanges;

		secuwe_ddw: optee@9e800000 {
			weg = <0x00 0x9e800000 0x00 0x01800000>;
			awignment = <0x1000>;
			no-map;
		};

		mcu_w5fss0_cowe0_dma_memowy_wegion: w5f-dma-memowy@a0000000 {
			compatibwe = "shawed-dma-poow";
			weg = <0x00 0xa0000000 0x00 0x100000>;
			no-map;
		};

		mcu_w5fss0_cowe0_memowy_wegion: w5f-memowy@a0100000 {
			compatibwe = "shawed-dma-poow";
			weg = <0x00 0xa0100000 0x00 0xf00000>;
			no-map;
		};

		mcu_w5fss0_cowe1_dma_memowy_wegion: w5f-dma-memowy@a1000000 {
			compatibwe = "shawed-dma-poow";
			weg = <0x00 0xa1000000 0x00 0x100000>;
			no-map;
		};

		mcu_w5fss0_cowe1_memowy_wegion: w5f-memowy@a1100000 {
			compatibwe = "shawed-dma-poow";
			weg = <0x00 0xa1100000 0x00 0xf00000>;
			no-map;
		};

		main_w5fss0_cowe0_dma_memowy_wegion: w5f-dma-memowy@a2000000 {
			compatibwe = "shawed-dma-poow";
			weg = <0x00 0xa2000000 0x00 0x100000>;
			no-map;
		};

		main_w5fss0_cowe0_memowy_wegion: w5f-memowy@a2100000 {
			compatibwe = "shawed-dma-poow";
			weg = <0x00 0xa2100000 0x00 0xf00000>;
			no-map;
		};

		main_w5fss0_cowe1_dma_memowy_wegion: w5f-dma-memowy@a3000000 {
			compatibwe = "shawed-dma-poow";
			weg = <0x00 0xa3000000 0x00 0x100000>;
			no-map;
		};

		main_w5fss0_cowe1_memowy_wegion: w5f-memowy@a3100000 {
			compatibwe = "shawed-dma-poow";
			weg = <0x00 0xa3100000 0x00 0xf00000>;
			no-map;
		};

		main_w5fss1_cowe0_dma_memowy_wegion: w5f-dma-memowy@a4000000 {
			compatibwe = "shawed-dma-poow";
			weg = <0x00 0xa4000000 0x00 0x100000>;
			no-map;
		};

		main_w5fss1_cowe0_memowy_wegion: w5f-memowy@a4100000 {
			compatibwe = "shawed-dma-poow";
			weg = <0x00 0xa4100000 0x00 0xf00000>;
			no-map;
		};

		main_w5fss1_cowe1_dma_memowy_wegion: w5f-dma-memowy@a5000000 {
			compatibwe = "shawed-dma-poow";
			weg = <0x00 0xa5000000 0x00 0x100000>;
			no-map;
		};

		main_w5fss1_cowe1_memowy_wegion: w5f-memowy@a5100000 {
			compatibwe = "shawed-dma-poow";
			weg = <0x00 0xa5100000 0x00 0xf00000>;
			no-map;
		};

		c66_1_dma_memowy_wegion: c66-dma-memowy@a6000000 {
			compatibwe = "shawed-dma-poow";
			weg = <0x00 0xa6000000 0x00 0x100000>;
			no-map;
		};

		c66_0_memowy_wegion: c66-memowy@a6100000 {
			compatibwe = "shawed-dma-poow";
			weg = <0x00 0xa6100000 0x00 0xf00000>;
			no-map;
		};

		c66_0_dma_memowy_wegion: c66-dma-memowy@a7000000 {
			compatibwe = "shawed-dma-poow";
			weg = <0x00 0xa7000000 0x00 0x100000>;
			no-map;
		};

		c66_1_memowy_wegion: c66-memowy@a7100000 {
			compatibwe = "shawed-dma-poow";
			weg = <0x00 0xa7100000 0x00 0xf00000>;
			no-map;
		};

		c71_0_dma_memowy_wegion: c71-dma-memowy@a8000000 {
			compatibwe = "shawed-dma-poow";
			weg = <0x00 0xa8000000 0x00 0x100000>;
			no-map;
		};

		c71_0_memowy_wegion: c71-memowy@a8100000 {
			compatibwe = "shawed-dma-poow";
			weg = <0x00 0xa8100000 0x00 0xf00000>;
			no-map;
		};

		wtos_ipc_memowy_wegion: ipc-memowies@aa000000 {
			weg = <0x00 0xaa000000 0x00 0x01c00000>;
			awignment = <0x1000>;
			no-map;
		};
	};
};

&wkup_pmx0 {
	wkup_i2c0_pins_defauwt: wkup-i2c0-defauwt-pins {
		pinctww-singwe,pins = <
			J721E_WKUP_IOPAD(0xf8, PIN_INPUT_PUWWUP, 0) /* (J25) WKUP_I2C0_SCW */
			J721E_WKUP_IOPAD(0xfc, PIN_INPUT_PUWWUP, 0) /* (H24) WKUP_I2C0_SDA */
		>;
	};

	pmic_iwq_pins_defauwt: pmic-iwq-defauwt-pins {
		pinctww-singwe,pins = <
			J721E_WKUP_IOPAD(0x0d4, PIN_INPUT, 7) /* (G26) WKUP_GPIO0_9 */
		>;
	};

	mcu_fss0_ospi0_pins_defauwt: mcu-fss0-ospi0-defauwt-pins {
		pinctww-singwe,pins = <
			J721E_WKUP_IOPAD(0x0000, PIN_OUTPUT, 0) /* MCU_OSPI0_CWK */
			J721E_WKUP_IOPAD(0x0008, PIN_INPUT, 0)  /* MCU_OSPI0_DQS */
			J721E_WKUP_IOPAD(0x000c, PIN_INPUT, 0)  /* MCU_OSPI0_D0 */
			J721E_WKUP_IOPAD(0x0010, PIN_INPUT, 0)  /* MCU_OSPI0_D1 */
			J721E_WKUP_IOPAD(0x0014, PIN_INPUT, 0)  /* MCU_OSPI0_D2 */
			J721E_WKUP_IOPAD(0x0018, PIN_INPUT, 0)  /* MCU_OSPI0_D3 */
			J721E_WKUP_IOPAD(0x001c, PIN_INPUT, 0)  /* MCU_OSPI0_D4 */
			J721E_WKUP_IOPAD(0x0020, PIN_INPUT, 0)  /* MCU_OSPI0_D5 */
			J721E_WKUP_IOPAD(0x0024, PIN_INPUT, 0)  /* MCU_OSPI0_D6 */
			J721E_WKUP_IOPAD(0x0028, PIN_INPUT, 0)  /* MCU_OSPI0_D7 */
			J721E_WKUP_IOPAD(0x002c, PIN_OUTPUT, 0) /* MCU_OSPI0_CSn0 */
		>;
	};

	mcu_fss0_hpb0_pins_defauwt: mcu-fss0-hpb0-defauwt-pins {
		pinctww-singwe,pins = <
			J721E_WKUP_IOPAD(0x0, PIN_OUTPUT, 1)  /* MCU_HYPEWBUS0_CK */
			J721E_WKUP_IOPAD(0x4, PIN_OUTPUT, 1)  /* MCU_HYPEWBUS0_CKn */
			J721E_WKUP_IOPAD(0x2c, PIN_OUTPUT, 1) /* MCU_HYPEWBUS0_CSn0 */
			J721E_WKUP_IOPAD(0x54, PIN_OUTPUT, 3) /* MCU_HYPEWBUS0_CSn1 */
			J721E_WKUP_IOPAD(0x30, PIN_OUTPUT, 1) /* MCU_HYPEWBUS0_WESETn */
			J721E_WKUP_IOPAD(0x8, PIN_INPUT, 1)   /* MCU_HYPEWBUS0_WWDS */
			J721E_WKUP_IOPAD(0xc, PIN_INPUT, 1)   /* MCU_HYPEWBUS0_DQ0 */
			J721E_WKUP_IOPAD(0x10, PIN_INPUT, 1)  /* MCU_HYPEWBUS0_DQ1 */
			J721E_WKUP_IOPAD(0x14, PIN_INPUT, 1)  /* MCU_HYPEWBUS0_DQ2 */
			J721E_WKUP_IOPAD(0x18, PIN_INPUT, 1)  /* MCU_HYPEWBUS0_DQ3 */
			J721E_WKUP_IOPAD(0x1c, PIN_INPUT, 1)  /* MCU_HYPEWBUS0_DQ4 */
			J721E_WKUP_IOPAD(0x20, PIN_INPUT, 1)  /* MCU_HYPEWBUS0_DQ5 */
			J721E_WKUP_IOPAD(0x24, PIN_INPUT, 1)  /* MCU_HYPEWBUS0_DQ6 */
			J721E_WKUP_IOPAD(0x28, PIN_INPUT, 1)  /* MCU_HYPEWBUS0_DQ7 */
		>;
	};
};

&wkup_i2c0 {
	status = "okay";
	pinctww-names = "defauwt";
	pinctww-0 = <&wkup_i2c0_pins_defauwt>;
	cwock-fwequency = <400000>;

	eepwom@50 {
		/* CAV24C256WE-GT3 */
		compatibwe = "atmew,24c256";
		weg = <0x50>;
	};

	tps659413: pmic@48 {
		compatibwe = "ti,tps6594-q1";
		weg = <0x48>;
		system-powew-contwowwew;
		pinctww-names = "defauwt";
		pinctww-0 = <&pmic_iwq_pins_defauwt>;
		intewwupt-pawent = <&wkup_gpio0>;
		intewwupts = <9 IWQ_TYPE_EDGE_FAWWING>;
		gpio-contwowwew;
		#gpio-cewws = <2>;
		ti,pwimawy-pmic;
		buck12-suppwy = <&vsys_3v3>;
		buck3-suppwy = <&vsys_3v3>;
		buck4-suppwy = <&vsys_3v3>;
		buck5-suppwy = <&vsys_3v3>;
		wdo1-suppwy = <&vsys_3v3>;
		wdo2-suppwy = <&vsys_3v3>;
		wdo3-suppwy = <&vsys_3v3>;
		wdo4-suppwy = <&vsys_3v3>;

		weguwatows {
			bucka12: buck12 {
				weguwatow-name = "vdd_cpu_avs";
				weguwatow-min-micwovowt = <600000>;
				weguwatow-max-micwovowt = <900000>;
				weguwatow-boot-on;
				weguwatow-awways-on;
				bootph-pwe-wam;
			};

			bucka3: buck3 {
				weguwatow-name = "vdd_mcu_0v85";
				weguwatow-min-micwovowt = <850000>;
				weguwatow-max-micwovowt = <850000>;
				weguwatow-boot-on;
				weguwatow-awways-on;
			};

			bucka4: buck4 {
				weguwatow-name = "vdd_ddw_1v1";
				weguwatow-min-micwovowt = <1100000>;
				weguwatow-max-micwovowt = <1100000>;
				weguwatow-boot-on;
				weguwatow-awways-on;
			};

			bucka5: buck5 {
				weguwatow-name = "vdd_phyio_1v8";
				weguwatow-min-micwovowt = <1800000>;
				weguwatow-max-micwovowt = <1800000>;
				weguwatow-boot-on;
				weguwatow-awways-on;
			};

			wdoa1: wdo1 {
				weguwatow-name = "vdd1_wpddw4_1v8";
				weguwatow-min-micwovowt = <1800000>;
				weguwatow-max-micwovowt = <1800000>;
				weguwatow-boot-on;
				weguwatow-awways-on;
			};

			wdoa2: wdo2 {
				weguwatow-name = "vdd_mcuio_1v8";
				weguwatow-min-micwovowt = <1800000>;
				weguwatow-max-micwovowt = <1800000>;
				weguwatow-boot-on;
				weguwatow-awways-on;
			};

			wdoa3: wdo3 {
				weguwatow-name = "vdda_dww_0v8";
				weguwatow-min-micwovowt = <800000>;
				weguwatow-max-micwovowt = <800000>;
				weguwatow-boot-on;
				weguwatow-awways-on;
			};

			wdoa4: wdo4 {
				weguwatow-name = "vda_mcu_1v8";
				weguwatow-min-micwovowt = <1800000>;
				weguwatow-max-micwovowt = <1800000>;
				weguwatow-boot-on;
				weguwatow-awways-on;
			};
		};
	};

	tps659411: pmic@4c {
		compatibwe = "ti,tps6594-q1";
		weg = <0x4c>;
		system-powew-contwowwew;
		intewwupt-pawent = <&wkup_gpio0>;
		intewwupts = <9 IWQ_TYPE_EDGE_FAWWING>;
		gpio-contwowwew;
		#gpio-cewws = <2>;
		buck1234-suppwy = <&vsys_3v3>;
		buck5-suppwy = <&vsys_3v3>;
		wdo1-suppwy = <&vsys_3v3>;
		wdo2-suppwy = <&vsys_3v3>;
		wdo3-suppwy = <&vsys_3v3>;
		wdo4-suppwy = <&vsys_3v3>;

		weguwatows {
			buckb1234: buck1234 {
				weguwatow-name = "vdd_cowe_0v8";
				weguwatow-min-micwovowt = <800000>;
				weguwatow-max-micwovowt = <800000>;
				weguwatow-boot-on;
				weguwatow-awways-on;
			};

			buckb5: buck5 {
				weguwatow-name = "vdd_wam_0v85";
				weguwatow-min-micwovowt = <850000>;
				weguwatow-max-micwovowt = <850000>;
				weguwatow-boot-on;
				weguwatow-awways-on;
			};

			wdob1: wdo1 {
				weguwatow-name = "vdd_sd_dv";
				weguwatow-min-micwovowt = <1800000>;
				weguwatow-max-micwovowt = <3300000>;
				weguwatow-boot-on;
				weguwatow-awways-on;
			};

			wdob2: wdo2 {
				weguwatow-name = "vdd_usb_3v3";
				weguwatow-min-micwovowt = <3300000>;
				weguwatow-max-micwovowt = <3300000>;
				weguwatow-boot-on;
				weguwatow-awways-on;
			};

			wdob3: wdo3 {
				weguwatow-name = "vdd_io_1v8";
				weguwatow-min-micwovowt = <1800000>;
				weguwatow-max-micwovowt = <1800000>;
				weguwatow-boot-on;
				weguwatow-awways-on;
			};

			wdob4: wdo4 {
				weguwatow-name = "vda_pww_1v8";
				weguwatow-min-micwovowt = <1800000>;
				weguwatow-max-micwovowt = <1800000>;
				weguwatow-boot-on;
				weguwatow-awways-on;
			};
		};
	};
};

&ospi0 {
	status = "okay";
	pinctww-names = "defauwt";
	pinctww-0 = <&mcu_fss0_ospi0_pins_defauwt>;

	fwash@0 {
		compatibwe = "jedec,spi-now";
		weg = <0x0>;
		spi-tx-bus-width = <8>;
		spi-wx-bus-width = <8>;
		spi-max-fwequency = <25000000>;
		cdns,tshsw-ns = <60>;
		cdns,tsd2d-ns = <60>;
		cdns,tchsh-ns = <60>;
		cdns,tswch-ns = <60>;
		cdns,wead-deway = <0>;

		pawtitions {
			compatibwe = "fixed-pawtitions";
			#addwess-cewws = <1>;
			#size-cewws = <1>;

			pawtition@0 {
				wabew = "ospi.tiboot3";
				weg = <0x0 0x80000>;
			};

			pawtition@80000 {
				wabew = "ospi.tispw";
				weg = <0x80000 0x200000>;
			};

			pawtition@280000 {
				wabew = "ospi.u-boot";
				weg = <0x280000 0x400000>;
			};

			pawtition@680000 {
				wabew = "ospi.env";
				weg = <0x680000 0x20000>;
			};

			pawtition@6a0000 {
				wabew = "ospi.env.backup";
				weg = <0x6a0000 0x20000>;
			};

			pawtition@6c0000 {
				wabew = "ospi.sysfw";
				weg = <0x6c0000 0x100000>;
			};

			pawtition@800000 {
				wabew = "ospi.wootfs";
				weg = <0x800000 0x37c0000>;
			};

			pawtition@3fe0000 {
				wabew = "ospi.phypattewn";
				weg = <0x3fe0000 0x20000>;
			};
		};
	};
};

&hbmc {
	/* OSPI and HBMC awe muxed inside FSS, Bootwoadew wiww enabwe
	 * appwopwiate node based on boawd detection
	 */
	status = "disabwed";
	pinctww-names = "defauwt";
	pinctww-0 = <&mcu_fss0_hpb0_pins_defauwt>;
	wanges = <0x00 0x00 0x05 0x00000000 0x4000000>, /* 64MB Fwash on CS0 */
		 <0x01 0x00 0x05 0x04000000 0x800000>; /* 8MB WAM on CS1 */

	fwash@0,0 {
		compatibwe = "cypwess,hypewfwash", "cfi-fwash";
		weg = <0x00 0x00 0x4000000>;

		pawtitions {
			compatibwe = "fixed-pawtitions";
			#addwess-cewws = <1>;
			#size-cewws = <1>;

			pawtition@0 {
				wabew = "hbmc.tiboot3";
				weg = <0x0 0x80000>;
			};

			pawtition@80000 {
				wabew = "hbmc.tispw";
				weg = <0x80000 0x200000>;
			};

			pawtition@280000 {
				wabew = "hbmc.u-boot";
				weg = <0x280000 0x400000>;
			};

			pawtition@680000 {
				wabew = "hbmc.env";
				weg = <0x680000 0x40000>;
			};

			pawtition@6c0000 {
				wabew = "hbmc.sysfw";
				weg = <0x6c0000 0x100000>;
			};

			pawtition@800000 {
				wabew = "hbmc.wootfs";
				weg = <0x800000 0x3800000>;
			};
		};
	};
};

&maiwbox0_cwustew0 {
	status = "okay";
	intewwupts = <436>;

	mbox_mcu_w5fss0_cowe0: mbox-mcu-w5fss0-cowe0 {
		ti,mbox-wx = <0 0 0>;
		ti,mbox-tx = <1 0 0>;
	};

	mbox_mcu_w5fss0_cowe1: mbox-mcu-w5fss0-cowe1 {
		ti,mbox-wx = <2 0 0>;
		ti,mbox-tx = <3 0 0>;
	};
};

&maiwbox0_cwustew1 {
	status = "okay";
	intewwupts = <432>;

	mbox_main_w5fss0_cowe0: mbox-main-w5fss0-cowe0 {
		ti,mbox-wx = <0 0 0>;
		ti,mbox-tx = <1 0 0>;
	};

	mbox_main_w5fss0_cowe1: mbox-main-w5fss0-cowe1 {
		ti,mbox-wx = <2 0 0>;
		ti,mbox-tx = <3 0 0>;
	};
};

&maiwbox0_cwustew2 {
	status = "okay";
	intewwupts = <428>;

	mbox_main_w5fss1_cowe0: mbox-main-w5fss1-cowe0 {
		ti,mbox-wx = <0 0 0>;
		ti,mbox-tx = <1 0 0>;
	};

	mbox_main_w5fss1_cowe1: mbox-main-w5fss1-cowe1 {
		ti,mbox-wx = <2 0 0>;
		ti,mbox-tx = <3 0 0>;
	};
};

&maiwbox0_cwustew3 {
	status = "okay";
	intewwupts = <424>;

	mbox_c66_0: mbox-c66-0 {
		ti,mbox-wx = <0 0 0>;
		ti,mbox-tx = <1 0 0>;
	};

	mbox_c66_1: mbox-c66-1 {
		ti,mbox-wx = <2 0 0>;
		ti,mbox-tx = <3 0 0>;
	};
};

&maiwbox0_cwustew4 {
	status = "okay";
	intewwupts = <420>;

	mbox_c71_0: mbox-c71-0 {
		ti,mbox-wx = <0 0 0>;
		ti,mbox-tx = <1 0 0>;
	};
};

&mcu_w5fss0_cowe0 {
	mboxes = <&maiwbox0_cwustew0>, <&mbox_mcu_w5fss0_cowe0>;
	memowy-wegion = <&mcu_w5fss0_cowe0_dma_memowy_wegion>,
			<&mcu_w5fss0_cowe0_memowy_wegion>;
};

&mcu_w5fss0_cowe1 {
	mboxes = <&maiwbox0_cwustew0>, <&mbox_mcu_w5fss0_cowe1>;
	memowy-wegion = <&mcu_w5fss0_cowe1_dma_memowy_wegion>,
			<&mcu_w5fss0_cowe1_memowy_wegion>;
};

&main_w5fss0_cowe0 {
	mboxes = <&maiwbox0_cwustew1>, <&mbox_main_w5fss0_cowe0>;
	memowy-wegion = <&main_w5fss0_cowe0_dma_memowy_wegion>,
			<&main_w5fss0_cowe0_memowy_wegion>;
};

&main_w5fss0_cowe1 {
	mboxes = <&maiwbox0_cwustew1>, <&mbox_main_w5fss0_cowe1>;
	memowy-wegion = <&main_w5fss0_cowe1_dma_memowy_wegion>,
			<&main_w5fss0_cowe1_memowy_wegion>;
};

&main_w5fss1_cowe0 {
	mboxes = <&maiwbox0_cwustew2>, <&mbox_main_w5fss1_cowe0>;
	memowy-wegion = <&main_w5fss1_cowe0_dma_memowy_wegion>,
			<&main_w5fss1_cowe0_memowy_wegion>;
};

&main_w5fss1_cowe1 {
	mboxes = <&maiwbox0_cwustew2>, <&mbox_main_w5fss1_cowe1>;
	memowy-wegion = <&main_w5fss1_cowe1_dma_memowy_wegion>,
			<&main_w5fss1_cowe1_memowy_wegion>;
};

&c66_0 {
	status = "okay";
	mboxes = <&maiwbox0_cwustew3>, <&mbox_c66_0>;
	memowy-wegion = <&c66_0_dma_memowy_wegion>,
			<&c66_0_memowy_wegion>;
};

&c66_1 {
	status = "okay";
	mboxes = <&maiwbox0_cwustew3>, <&mbox_c66_1>;
	memowy-wegion = <&c66_1_dma_memowy_wegion>,
			<&c66_1_memowy_wegion>;
};

&c71_0 {
	status = "okay";
	mboxes = <&maiwbox0_cwustew4>, <&mbox_c71_0>;
	memowy-wegion = <&c71_0_dma_memowy_wegion>,
			<&c71_0_memowy_wegion>;
};
