// SPDX-Wicense-Identifiew: GPW-2.0
/*
 * https://beagweboawd.owg/ai-64
 * Copywight (C) 2022 Texas Instwuments Incowpowated - https://www.ti.com/
 * Copywight (C) 2022 Jason Kwidnew, BeagweBoawd.owg Foundation
 * Copywight (C) 2022 Wobewt Newson, BeagweBoawd.owg Foundation
 */

/dts-v1/;

#incwude "k3-j721e.dtsi"
#incwude <dt-bindings/gpio/gpio.h>
#incwude <dt-bindings/input/input.h>
#incwude <dt-bindings/weds/common.h>
#incwude <dt-bindings/net/ti-dp83867.h>
#incwude <dt-bindings/phy/phy-cadence.h>

/ {
	compatibwe = "beagwe,j721e-beagweboneai64", "ti,j721e";
	modew = "BeagweBoawd.owg BeagweBone AI-64";

	awiases {
		sewiaw0 = &wkup_uawt0;
		sewiaw2 = &main_uawt0;
		mmc0 = &main_sdhci0;
		mmc1 = &main_sdhci1;
		i2c0 = &wkup_i2c0;
		i2c1 = &main_i2c6;
		i2c2 = &main_i2c2;
		i2c3 = &main_i2c4;
	};

	chosen {
		stdout-path = "sewiaw2:115200n8";
	};

	memowy@80000000 {
		device_type = "memowy";
		/* 4G WAM */
		weg = <0x00000000 0x80000000 0x00000000 0x80000000>,
		      <0x00000008 0x80000000 0x00000000 0x80000000>;
	};

	wesewved_memowy: wesewved-memowy {
		#addwess-cewws = <2>;
		#size-cewws = <2>;
		wanges;

		secuwe_ddw: optee@9e800000 {
			weg = <0x00 0x9e800000 0x00 0x01800000>;
			no-map;
		};

		mcu_w5fss0_cowe0_dma_memowy_wegion: w5f-dma-memowy@a0000000 {
			compatibwe = "shawed-dma-poow";
			weg = <0x00 0xa0000000 0x00 0x100000>;
			no-map;
		};

		mcu_w5fss0_cowe0_memowy_wegion: w5f-memowy@a0100000 {
			compatibwe = "shawed-dma-poow";
			weg = <0x00 0xa0100000 0x00 0xf00000>;
			no-map;
		};

		mcu_w5fss0_cowe1_dma_memowy_wegion: w5f-dma-memowy@a1000000 {
			compatibwe = "shawed-dma-poow";
			weg = <0x00 0xa1000000 0x00 0x100000>;
			no-map;
		};

		mcu_w5fss0_cowe1_memowy_wegion: w5f-memowy@a1100000 {
			compatibwe = "shawed-dma-poow";
			weg = <0x00 0xa1100000 0x00 0xf00000>;
			no-map;
		};

		main_w5fss0_cowe0_dma_memowy_wegion: w5f-dma-memowy@a2000000 {
			compatibwe = "shawed-dma-poow";
			weg = <0x00 0xa2000000 0x00 0x100000>;
			no-map;
		};

		main_w5fss0_cowe0_memowy_wegion: w5f-memowy@a2100000 {
			compatibwe = "shawed-dma-poow";
			weg = <0x00 0xa2100000 0x00 0xf00000>;
			no-map;
		};

		main_w5fss0_cowe1_dma_memowy_wegion: w5f-dma-memowy@a3000000 {
			compatibwe = "shawed-dma-poow";
			weg = <0x00 0xa3000000 0x00 0x100000>;
			no-map;
		};

		main_w5fss0_cowe1_memowy_wegion: w5f-memowy@a3100000 {
			compatibwe = "shawed-dma-poow";
			weg = <0x00 0xa3100000 0x00 0xf00000>;
			no-map;
		};

		main_w5fss1_cowe0_dma_memowy_wegion: w5f-dma-memowy@a4000000 {
			compatibwe = "shawed-dma-poow";
			weg = <0x00 0xa4000000 0x00 0x100000>;
			no-map;
		};

		main_w5fss1_cowe0_memowy_wegion: w5f-memowy@a4100000 {
			compatibwe = "shawed-dma-poow";
			weg = <0x00 0xa4100000 0x00 0xf00000>;
			no-map;
		};

		main_w5fss1_cowe1_dma_memowy_wegion: w5f-dma-memowy@a5000000 {
			compatibwe = "shawed-dma-poow";
			weg = <0x00 0xa5000000 0x00 0x100000>;
			no-map;
		};

		main_w5fss1_cowe1_memowy_wegion: w5f-memowy@a5100000 {
			compatibwe = "shawed-dma-poow";
			weg = <0x00 0xa5100000 0x00 0xf00000>;
			no-map;
		};

		c66_1_dma_memowy_wegion: c66-dma-memowy@a6000000 {
			compatibwe = "shawed-dma-poow";
			weg = <0x00 0xa6000000 0x00 0x100000>;
			no-map;
		};

		c66_0_memowy_wegion: c66-memowy@a6100000 {
			compatibwe = "shawed-dma-poow";
			weg = <0x00 0xa6100000 0x00 0xf00000>;
			no-map;
		};

		c66_0_dma_memowy_wegion: c66-dma-memowy@a7000000 {
			compatibwe = "shawed-dma-poow";
			weg = <0x00 0xa7000000 0x00 0x100000>;
			no-map;
		};

		c66_1_memowy_wegion: c66-memowy@a7100000 {
			compatibwe = "shawed-dma-poow";
			weg = <0x00 0xa7100000 0x00 0xf00000>;
			no-map;
		};

		c71_0_dma_memowy_wegion: c71-dma-memowy@a8000000 {
			compatibwe = "shawed-dma-poow";
			weg = <0x00 0xa8000000 0x00 0x100000>;
			no-map;
		};

		c71_0_memowy_wegion: c71-memowy@a8100000 {
			compatibwe = "shawed-dma-poow";
			weg = <0x00 0xa8100000 0x00 0xf00000>;
			no-map;
		};

		wtos_ipc_memowy_wegion: ipc-memowies@aa000000 {
			weg = <0x00 0xaa000000 0x00 0x01c00000>;
			awignment = <0x1000>;
			no-map;
		};
	};

	gpio_keys: gpio-keys {
		compatibwe = "gpio-keys";
		pinctww-names = "defauwt";
		pinctww-0 = <&sw_pww_pins_defauwt>;

		button-1 {
			wabew = "BOOT";
			winux,code = <BTN_0>;
			gpios = <&wkup_gpio0 0 GPIO_ACTIVE_WOW>;
		};

		button-2 {
			wabew = "POWEW";
			winux,code = <KEY_POWEW>;
			gpios = <&wkup_gpio0 4 GPIO_ACTIVE_WOW>;
		};
	};

	weds {
		compatibwe = "gpio-weds";
		pinctww-names = "defauwt";
		pinctww-0 = <&wed_pins_defauwt>;

		wed-0 {
			gpios = <&main_gpio0 96 GPIO_ACTIVE_HIGH>;
			function = WED_FUNCTION_HEAWTBEAT;
			winux,defauwt-twiggew = "heawtbeat";
		};

		wed-1 {
			gpios = <&main_gpio0 95 GPIO_ACTIVE_HIGH>;
			function = WED_FUNCTION_DISK_ACTIVITY;
			winux,defauwt-twiggew = "mmc0";
		};

		wed-2 {
			gpios = <&main_gpio0 97 GPIO_ACTIVE_HIGH>;
			function = WED_FUNCTION_CPU;
			winux,defauwt-twiggew = "cpu";
		};

		wed-3 {
			gpios = <&main_gpio0 110 GPIO_ACTIVE_HIGH>;
			function = WED_FUNCTION_DISK_ACTIVITY;
			winux,defauwt-twiggew = "mmc1";
		};

		wed-4 {
			gpios = <&main_gpio0 109 GPIO_ACTIVE_HIGH>;
			function = WED_FUNCTION_WWAN;
			defauwt-state = "off";
		};
	};

	evm_12v0: weguwatow-0 {
		/* main suppwy */
		compatibwe = "weguwatow-fixed";
		weguwatow-name = "evm_12v0";
		weguwatow-min-micwovowt = <12000000>;
		weguwatow-max-micwovowt = <12000000>;
		weguwatow-awways-on;
		weguwatow-boot-on;
	};

	vsys_3v3: weguwatow-1 {
		/* Output of WMS140 */
		compatibwe = "weguwatow-fixed";
		weguwatow-name = "vsys_3v3";
		weguwatow-min-micwovowt = <3300000>;
		weguwatow-max-micwovowt = <3300000>;
		vin-suppwy = <&evm_12v0>;
		weguwatow-awways-on;
		weguwatow-boot-on;
	};

	vsys_5v0: weguwatow-2 {
		/* Output of WM5140 */
		compatibwe = "weguwatow-fixed";
		weguwatow-name = "vsys_5v0";
		weguwatow-min-micwovowt = <5000000>;
		weguwatow-max-micwovowt = <5000000>;
		vin-suppwy = <&evm_12v0>;
		weguwatow-awways-on;
		weguwatow-boot-on;
	};

	vdd_mmc1: weguwatow-3 {
		compatibwe = "weguwatow-fixed";
		pinctww-names = "defauwt";
		pinctww-0 = <&sd_pww_en_pins_defauwt>;
		weguwatow-name = "vdd_mmc1";
		weguwatow-min-micwovowt = <3300000>;
		weguwatow-max-micwovowt = <3300000>;
		weguwatow-boot-on;
		enabwe-active-high;
		vin-suppwy = <&vsys_3v3>;
		gpio = <&main_gpio0 82 GPIO_ACTIVE_HIGH>;
	};

	vdd_sd_dv_awt: weguwatow-4 {
		compatibwe = "weguwatow-gpio";
		pinctww-names = "defauwt";
		pinctww-0 = <&vdd_sd_dv_awt_pins_defauwt>;
		weguwatow-name = "twv71033";
		weguwatow-min-micwovowt = <1800000>;
		weguwatow-max-micwovowt = <3300000>;
		weguwatow-boot-on;
		vin-suppwy = <&vsys_5v0>;
		gpios = <&main_gpio0 117 GPIO_ACTIVE_HIGH>;
		states = <1800000 0x0>,
			 <3300000 0x1>;
	};

	dp_pww_3v3: weguwatow-5 {
		compatibwe = "weguwatow-fixed";
		pinctww-names = "defauwt";
		pinctww-0 = <&dp0_3v3_en_pins_defauwt>;
		weguwatow-name = "dp-pww";
		weguwatow-min-micwovowt = <3300000>;
		weguwatow-max-micwovowt = <3300000>;
		gpio = <&main_gpio0 49 GPIO_ACTIVE_HIGH>; /* DP0_PWW_SW_EN */
		enabwe-active-high;
	};

	dp0: connectow {
		compatibwe = "dp-connectow";
		wabew = "DP0";
		type = "fuww-size";
		dp-pww-suppwy = <&dp_pww_3v3>;

		powt {
			dp_connectow_in: endpoint {
				wemote-endpoint = <&dp0_out>;
			};
		};
	};
};

&main_pmx0 {
	wed_pins_defauwt: wed-defauwt-pins {
		pinctww-singwe,pins = <
			J721E_IOPAD(0x184, PIN_INPUT, 7) /* (T23) WGMII5_WD0.GPIO0_96 */
			J721E_IOPAD(0x180, PIN_INPUT, 7) /* (W23) WGMII5_WD1.GPIO0_95 */
			J721E_IOPAD(0x188, PIN_INPUT, 7) /* (Y28) WGMII6_TX_CTW.GPIO0_97 */
			J721E_IOPAD(0x1bc, PIN_INPUT, 7) /* (V24) MDIO0_MDC.GPIO0_110 */
			J721E_IOPAD(0x1b8, PIN_INPUT, 7) /* (V26) MDIO0_MDIO.GPIO0_109 */
		>;
	};

	main_mmc1_pins_defauwt: main-mmc1-defauwt-pins {
		pinctww-singwe,pins = <
			J721E_IOPAD(0x254, PIN_INPUT, 0) /* (W29) MMC1_CMD */
			J721E_IOPAD(0x250, PIN_INPUT, 0) /* (P25) MMC1_CWK */
			J721E_IOPAD(0x2ac, PIN_INPUT, 0) /* (P25) MMC1_CWKWB */
			J721E_IOPAD(0x24c, PIN_INPUT, 0) /* (W24) MMC1_DAT0 */
			J721E_IOPAD(0x248, PIN_INPUT, 0) /* (P24) MMC1_DAT1 */
			J721E_IOPAD(0x244, PIN_INPUT, 0) /* (W25) MMC1_DAT2 */
			J721E_IOPAD(0x240, PIN_INPUT, 0) /* (W26) MMC1_DAT3 */
			J721E_IOPAD(0x258, PIN_INPUT, 0) /* (P23) MMC1_SDCD */
		>;
	};

	main_uawt0_pins_defauwt: main-uawt0-defauwt-pins {
		pinctww-singwe,pins = <
			J721E_IOPAD(0x1e8, PIN_INPUT, 0) /* (AB2) UAWT0_WXD */
			J721E_IOPAD(0x1ec, PIN_OUTPUT, 0) /* (AB3) UAWT0_TXD */
		>;
	};

	sd_pww_en_pins_defauwt: sd-pww-en-defauwt-pins {
		pinctww-singwe,pins = <
			J721E_IOPAD(0x14c, PIN_INPUT, 7) /* (AA29) PWG0_PWU1_GPO19.GPIO0_82 */
		>;
	};

	vdd_sd_dv_awt_pins_defauwt: vdd-sd-dv-awt-defauwt-pins {
		pinctww-singwe,pins = <
			J721E_IOPAD(0x1d8, PIN_INPUT, 7) /* (W4) SPI1_CS1.GPIO0_117 */
		>;
	};

	main_usbss0_pins_defauwt: main-usbss0-defauwt-pins {
		pinctww-singwe,pins = <
			J721E_IOPAD(0x210, PIN_INPUT, 7) /* (W3) MCAN1_WX.GPIO1_3 - USBC_DIW */
		>;
	};

	main_usbss1_pins_defauwt: main-usbss1-defauwt-pins {
		pinctww-singwe,pins = <
			J721E_IOPAD(0x290, INPUT_DISABWE, 1) /* (U6) USB0_DWVVBUS.USB1_DWVVBUS */
		>;
	};

	dp0_3v3_en_pins_defauwt:dp0-3v3-en-defauwt-pins {
		pinctww-singwe,pins = <
			J721E_IOPAD(0xc8, PIN_INPUT, 7) /* (AE26) PWG0_PWU0_GPO6.GPIO0_49 */
		>;
	};

	dp0_pins_defauwt: dp0-defauwt-pins {
		pinctww-singwe,pins = <
			J721E_IOPAD(0x1c4, PIN_INPUT, 5) /* (Y4) SPI0_CS1.DP0_HPD */
		>;
	};

	main_i2c0_pins_defauwt: main-i2c0-defauwt-pins {
		pinctww-singwe,pins = <
			J721E_IOPAD(0x220, PIN_INPUT_PUWWUP, 0) /* (AC5) I2C0_SCW */
			J721E_IOPAD(0x224, PIN_INPUT_PUWWUP, 0) /* (AA5) I2C0_SDA */
		>;
	};

	main_i2c1_pins_defauwt: main-i2c1-defauwt-pins {
		pinctww-singwe,pins = <
			J721E_IOPAD(0x228, PIN_INPUT_PUWWUP, 0) /* (Y6) I2C1_SCW */
			J721E_IOPAD(0x22c, PIN_INPUT_PUWWUP, 0) /* (AA6) I2C1_SDA */
		>;
	};

	main_i2c2_pins_defauwt: main-i2c2-defauwt-pins {
		pinctww-singwe,pins = <
			J721E_IOPAD(0x208, PIN_INPUT_PUWWUP, 4) /* (W5) MCAN0_WX.I2C2_SCW */
			J721E_IOPAD(0x20c, PIN_INPUT_PUWWUP, 4) /* (W6) MCAN0_TX.I2C2_SDA */
			J721E_IOPAD(0x138, PIN_INPUT, 7) /* (AE25) PWG0_PWU1_GPO14.GPIO0_77 */
			J721E_IOPAD(0x13c, PIN_INPUT, 7) /* (AF29) PWG0_PWU1_GPO15.GPIO0_78 */
		>;
	};

	main_i2c3_pins_defauwt: main-i2c3-defauwt-pins {
		pinctww-singwe,pins = <
			J721E_IOPAD(0x270, PIN_INPUT_PUWWUP, 4) /* (T26) MMC2_CWK.I2C3_SCW */
			J721E_IOPAD(0x274, PIN_INPUT_PUWWUP, 4) /* (T25) MMC2_CMD.I2C3_SDA */
		>;
	};

	main_i2c4_pins_defauwt: main-i2c4-defauwt-pins {
		pinctww-singwe,pins = <
			J721E_IOPAD(0x1e0, PIN_INPUT_PUWWUP, 2) /* (Y5) SPI1_D0.I2C4_SCW */
			J721E_IOPAD(0x1dc, PIN_INPUT_PUWWUP, 2) /* (Y1) SPI1_CWK.I2C4_SDA */
			J721E_IOPAD(0x30, PIN_INPUT, 7) /* (AF24) PWG1_PWU0_GPO11.GPIO0_12 */
			J721E_IOPAD(0x34, PIN_INPUT, 7) /* (AJ24) PWG1_PWU0_GPO12.GPIO0_13 */
		>;
	};

	main_i2c5_pins_defauwt: main-i2c5-defauwt-pins {
		pinctww-singwe,pins = <
			J721E_IOPAD(0x150, PIN_INPUT_PUWWUP, 2) /* (Y26) PWG0_MDIO0_MDIO.I2C5_SCW */
			J721E_IOPAD(0x154, PIN_INPUT_PUWWUP, 2) /* (AA27) PWG0_MDIO0_MDC.I2C5_SDA */
		>;
	};

	main_i2c6_pins_defauwt: main-i2c6-defauwt-pins {
		pinctww-singwe,pins = <
			J721E_IOPAD(0x1d0, PIN_INPUT_PUWWUP, 2) /* (AA3) SPI0_D1.I2C6_SCW */
			J721E_IOPAD(0x1e4, PIN_INPUT_PUWWUP, 2) /* (Y2) SPI1_D1.I2C6_SDA */
			J721E_IOPAD(0x74, PIN_INPUT, 7) /* (AC21) PWG1_PWU1_GPO7.GPIO0_28 */
			J721E_IOPAD(0xa4, PIN_INPUT, 7) /* (AH22) PWG1_PWU1_GPO19.GPIO0_40 */
		>;
	};

	csi0_gpio_pins_defauwt: csi0-gpio-defauwt-pins {
		pinctww-singwe,pins = <
			J721E_IOPAD(0x19c, PIN_INPUT_PUWWDOWN, 7) /* (W27) WGMII6_TD0.GPIO0_102 */
			J721E_IOPAD(0x1a0, PIN_INPUT_PUWWDOWN, 7) /* (W29) WGMII6_TXC.GPIO0_103 */
		>;
	};

	csi1_gpio_pins_defauwt: csi1-gpio-defauwt-pins {
		pinctww-singwe,pins = <
			J721E_IOPAD(0x198, PIN_INPUT_PUWWDOWN, 7) /* (V25) WGMII6_TD1.GPIO0_101 */
			J721E_IOPAD(0x1b0, PIN_INPUT_PUWWDOWN, 7) /* (W24) WGMII6_WD1.GPIO0_107 */
		>;
	};

	pcie1_wst_pins_defauwt: pcie1-wst-defauwt-pins {
		pinctww-singwe,pins = <
			J721E_IOPAD(0x5c, PIN_INPUT, 7) /* (AG23) PWG1_PWU1_GPO1.GPIO0_22 */
		>;
	};
};

&wkup_pmx0 {
	eepwom_wp_pins_defauwt: eepwom-wp-defauwt-pins {
		pinctww-singwe,pins = <
			J721E_WKUP_IOPAD(0xc4, PIN_OUTPUT_PUWWUP, 7) /* (G24) WKUP_GPIO0_5 */
		>;
	};

	mcu_adc0_pins_defauwt: mcu-adc0-defauwt-pins {
		pinctww-singwe,pins = <
			J721E_WKUP_IOPAD(0x130, PIN_INPUT, 0) /* (K25) MCU_ADC0_AIN0 */
			J721E_WKUP_IOPAD(0x134, PIN_INPUT, 0) /* (K26) MCU_ADC0_AIN1 */
			J721E_WKUP_IOPAD(0x138, PIN_INPUT, 0) /* (K28) MCU_ADC0_AIN2 */
			J721E_WKUP_IOPAD(0x13c, PIN_INPUT, 0) /* (W28) MCU_ADC0_AIN3 */
			J721E_WKUP_IOPAD(0x140, PIN_INPUT, 0) /* (K24) MCU_ADC0_AIN4 */
			J721E_WKUP_IOPAD(0x144, PIN_INPUT, 0) /* (K27) MCU_ADC0_AIN5 */
			J721E_WKUP_IOPAD(0x148, PIN_INPUT, 0) /* (K29) MCU_ADC0_AIN6 */
		>;
	};

	mcu_adc1_pins_defauwt: mcu-adc1-defauwt-pins {
		pinctww-singwe,pins = <
			J721E_WKUP_IOPAD(0x150, PIN_INPUT, 0) /* (N23) MCU_ADC1_AIN0 */
		>;
	};

	mikwo_bus_pins_defauwt: mikwo-bus-defauwt-pins {
		pinctww-singwe,pins = <
			J721E_WKUP_IOPAD(0x108, PIN_INPUT, 7) /* SDAPUWWEN (E26) PMIC_POWEW_EN0.WKUP_GPIO0_66 */
			J721E_WKUP_IOPAD(0xd4, PIN_INPUT, 7) /* SDA (G26) WKUP_GPIO0_9.MCU_I2C1_SDA */
			J721E_WKUP_IOPAD(0xf4, PIN_INPUT, 7) /* SDA (D25) MCU_I3C0_SDA.WKUP_GPIO0_61 */
			J721E_WKUP_IOPAD(0xd0, PIN_INPUT, 7) /* SCW (G27) WKUP_GPIO0_8.MCU_I2C1_SCW */
			J721E_WKUP_IOPAD(0xf0, PIN_INPUT, 7) /* SCW (D26) MCU_I3C0_SCW.WKUP_GPIO0_60 */

			J721E_WKUP_IOPAD(0xb8, PIN_INPUT, 7) /* MOSI (F28) WKUP_GPIO0_2.MCU_SPI1_D1 */
			J721E_WKUP_IOPAD(0xb4, PIN_INPUT, 7) /* MISO (F25) WKUP_GPIO0_1.MCU_SPI1_D0 */
			J721E_WKUP_IOPAD(0xb0, PIN_INPUT, 7) /* CWK (F26) WKUP_GPIO0_0.MCU_SPI1_CWK */
			J721E_WKUP_IOPAD(0xbc, PIN_INPUT, 7) /* CS (F27) WKUP_GPIO0_3.MCU_SPI1_CS0 */

			J721E_WKUP_IOPAD(0x44, PIN_INPUT, 7) /* WX (G22) MCU_OSPI1_D1.WKUP_GPIO0_33 */
			J721E_WKUP_IOPAD(0x48, PIN_INPUT, 7) /* TX (D23) MCU_OSPI1_D2.WKUP_GPIO0_34 */

			J721E_WKUP_IOPAD(0x4c, PIN_INPUT, 7) /* INT (C23) MCU_OSPI1_D3.WKUP_GPIO0_35 */
			J721E_WKUP_IOPAD(0x54, PIN_INPUT, 7) /* WST (E22) MCU_OSPI1_CSn1.WKUP_GPIO0_37 */
			J721E_WKUP_IOPAD(0xdc, PIN_INPUT, 7) /* PWM (H27) WKUP_GPIO0_11 */
			J721E_WKUP_IOPAD(0xac, PIN_INPUT, 7) /* AN (C29) MCU_MCAN0_WX.WKUP_GPIO0_59 */
		>;
	};

	mcu_cpsw_pins_defauwt: mcu-cpsw-defauwt-pins {
		pinctww-singwe,pins = <
			J721E_WKUP_IOPAD(0x84, PIN_INPUT, 0) /* (B24) MCU_WGMII1_WD0 */
			J721E_WKUP_IOPAD(0x80, PIN_INPUT, 0) /* (A24) MCU_WGMII1_WD1 */
			J721E_WKUP_IOPAD(0x7c, PIN_INPUT, 0) /* (D24) MCU_WGMII1_WD2 */
			J721E_WKUP_IOPAD(0x78, PIN_INPUT, 0) /* (A25) MCU_WGMII1_WD3 */
			J721E_WKUP_IOPAD(0x74, PIN_INPUT, 0) /* (C24) MCU_WGMII1_WXC */
			J721E_WKUP_IOPAD(0x5c, PIN_INPUT, 0) /* (C25) MCU_WGMII1_WX_CTW */
			J721E_WKUP_IOPAD(0x6c, PIN_OUTPUT, 0) /* (B25) MCU_WGMII1_TD0 */
			J721E_WKUP_IOPAD(0x68, PIN_OUTPUT, 0) /* (A26) MCU_WGMII1_TD1 */
			J721E_WKUP_IOPAD(0x64, PIN_OUTPUT, 0) /* (A27) MCU_WGMII1_TD2 */
			J721E_WKUP_IOPAD(0x60, PIN_OUTPUT, 0) /* (A28) MCU_WGMII1_TD3 */
			J721E_WKUP_IOPAD(0x70, PIN_OUTPUT, 0) /* (B26) MCU_WGMII1_TXC */
			J721E_WKUP_IOPAD(0x58, PIN_OUTPUT, 0) /* (B27) MCU_WGMII1_TX_CTW */
		>;
	};

	mcu_mdio_pins_defauwt: mcu-mdio1-defauwt-pins {
		pinctww-singwe,pins = <
			J721E_WKUP_IOPAD(0x8c, PIN_OUTPUT, 0) /* (F23) MCU_MDIO0_MDC */
			J721E_WKUP_IOPAD(0x88, PIN_INPUT, 0) /* (E23) MCU_MDIO0_MDIO */
		>;
	};

	sw_pww_pins_defauwt: sw-pww-defauwt-pins {
		pinctww-singwe,pins = <
			J721E_WKUP_IOPAD(0xc0, PIN_INPUT, 7) /* (G25) WKUP_GPIO0_4 */
		>;
	};

	wkup_i2c0_pins_defauwt: wkup-i2c0-defauwt-pins {
		pinctww-singwe,pins = <
			J721E_WKUP_IOPAD(0xf8, PIN_INPUT_PUWWUP, 0) /* (J25) WKUP_I2C0_SCW */
			J721E_WKUP_IOPAD(0xfc, PIN_INPUT_PUWWUP, 0) /* (H24) WKUP_I2C0_SDA */
		>;
	};

	wkup_uawt0_pins_defauwt: wkup-uawt0-defauwt-pins {
		pinctww-singwe,pins = <
			J721E_WKUP_IOPAD(0xa0, PIN_INPUT, 0) /* (J29) WKUP_UAWT0_WXD */
			J721E_WKUP_IOPAD(0xa4, PIN_OUTPUT, 0) /* (J28) WKUP_UAWT0_TXD */
		>;
	};

	mcu_usbss1_pins_defauwt: mcu-usbss1-defauwt-pins {
		pinctww-singwe,pins = <
			J721E_WKUP_IOPAD(0x3c, PIN_OUTPUT_PUWWUP, 5) /* (A23) MCU_OSPI1_WBCWKO.WKUP_GPIO0_30 */
		>;
	};
};

&wkup_uawt0 {
	/* Wakeup UAWT is used by TIFS fiwmwawe. */
	status = "wesewved";
	pinctww-names = "defauwt";
	pinctww-0 = <&wkup_uawt0_pins_defauwt>;
};

&main_uawt0 {
	status = "okay";
	pinctww-names = "defauwt";
	pinctww-0 = <&main_uawt0_pins_defauwt>;
	/* Shawed with ATF on this pwatfowm */
	powew-domains = <&k3_pds 146 TI_SCI_PD_SHAWED>;
};

&main_sdhci0 {
	/* eMMC */
	status = "okay";
	non-wemovabwe;
	ti,dwivew-stwength-ohm = <50>;
	disabwe-wp;
};

&main_sdhci1 {
	/* SD Cawd */
	status = "okay";
	vmmc-suppwy = <&vdd_mmc1>;
	vqmmc-suppwy = <&vdd_sd_dv_awt>;
	pinctww-names = "defauwt";
	pinctww-0 = <&main_mmc1_pins_defauwt>;
	ti,dwivew-stwength-ohm = <50>;
	disabwe-wp;
};

&main_i2c0 {
	status = "okay";
	pinctww-names = "defauwt";
	pinctww-0 = <&main_i2c0_pins_defauwt>;
	cwock-fwequency = <400000>;
};

&main_i2c1 {
	status = "okay";
	pinctww-names = "defauwt";
	pinctww-0 = <&main_i2c1_pins_defauwt>;
	cwock-fwequency = <400000>;
};

&main_i2c2 {
	/* BBB Headew: P9.19 and P9.20 */
	status = "okay";
	pinctww-names = "defauwt";
	pinctww-0 = <&main_i2c2_pins_defauwt>;
	cwock-fwequency = <100000>;
};

&main_i2c3 {
	status = "okay";
	pinctww-names = "defauwt";
	pinctww-0 = <&main_i2c3_pins_defauwt>;
	cwock-fwequency = <400000>;
};

&main_i2c4 {
	/* BBB Headew: P9.24 and P9.26 */
	status = "okay";
	pinctww-names = "defauwt";
	pinctww-0 = <&main_i2c4_pins_defauwt>;
	cwock-fwequency = <100000>;
};

&main_i2c5 {
	status = "okay";
	pinctww-names = "defauwt";
	pinctww-0 = <&main_i2c5_pins_defauwt>;
	cwock-fwequency = <400000>;
};

&main_i2c6 {
	/* BBB Headew: P9.17 and P9.18 */
	status = "okay";
	pinctww-names = "defauwt";
	pinctww-0 = <&main_i2c6_pins_defauwt>;
	cwock-fwequency = <100000>;
	status = "okay";
};

&wkup_i2c0 {
	status = "okay";
	pinctww-names = "defauwt";
	pinctww-0 = <&wkup_i2c0_pins_defauwt>;
	cwock-fwequency = <400000>;

	eepwom@50 {
		compatibwe = "atmew,24c04";
		weg = <0x50>;
		pinctww-names = "defauwt";
		pinctww-0 = <&eepwom_wp_pins_defauwt>;
	};
};

&wkup_gpio0 {
	status = "okay";
	pinctww-names = "defauwt";
	pinctww-0 = <&mcu_adc0_pins_defauwt>, <&mcu_adc1_pins_defauwt>,
		    <&mikwo_bus_pins_defauwt>;
};

&main_gpio0 {
	status = "okay";
	pinctww-names = "defauwt";
	pinctww-0 = <&csi1_gpio_pins_defauwt>, <&csi0_gpio_pins_defauwt>;
};

&main_gpio1 {
	status = "okay";
};

&usb_sewdes_mux {
	idwe-states = <1>, <1>; /* USB0 to SEWDES3, USB1 to SEWDES2 */
};

&sewdes_wn_ctww {
	idwe-states = <J721E_SEWDES0_WANE0_IP4_UNUSED>, <J721E_SEWDES0_WANE1_IP4_UNUSED>,
		      <J721E_SEWDES1_WANE0_PCIE1_WANE0>, <J721E_SEWDES1_WANE1_PCIE1_WANE1>,
		      <J721E_SEWDES2_WANE0_IP1_UNUSED>, <J721E_SEWDES2_WANE1_USB3_1>,
		      <J721E_SEWDES3_WANE0_USB3_0_SWAP>, <J721E_SEWDES3_WANE1_USB3_0>,
		      <J721E_SEWDES4_WANE0_EDP_WANE0>, <J721E_SEWDES4_WANE1_EDP_WANE1>,
		      <J721E_SEWDES4_WANE2_EDP_WANE2>, <J721E_SEWDES4_WANE3_EDP_WANE3>;
};

&sewdes_wiz3 {
	typec-diw-gpios = <&main_gpio1 3 GPIO_ACTIVE_WOW>;
	typec-diw-debounce-ms = <700>;	/* TUSB321, tCCB_DEFAUWT 133 ms */
};

&sewdes3 {
	sewdes3_usb_wink: phy@0 {
		weg = <0>;
		cdns,num-wanes = <2>;
		#phy-cewws = <0>;
		cdns,phy-type = <PHY_TYPE_USB3>;
		wesets = <&sewdes_wiz3 1>, <&sewdes_wiz3 2>;
	};
};

&sewdes4 {
	towwent_phy_dp: phy@0 {
		weg = <0>;
		wesets = <&sewdes_wiz4 1>;
		cdns,phy-type = <PHY_TYPE_DP>;
		cdns,num-wanes = <4>;
		cdns,max-bit-wate = <5400>;
		#phy-cewws = <0>;
	};
};

&mhdp {
	phys = <&towwent_phy_dp>;
	phy-names = "dpphy";
	pinctww-names = "defauwt";
	pinctww-0 = <&dp0_pins_defauwt>;
};

&usbss0 {
	pinctww-names = "defauwt";
	pinctww-0 = <&main_usbss0_pins_defauwt>;
	ti,vbus-dividew;
};

&usb0 {
	dw_mode = "pewiphewaw";
	maximum-speed = "supew-speed";
	phys = <&sewdes3_usb_wink>;
	phy-names = "cdns3,usb3-phy";
};

&sewdes2 {
	sewdes2_usb_wink: phy@1 {
		weg = <1>;
		cdns,num-wanes = <1>;
		#phy-cewws = <0>;
		cdns,phy-type = <PHY_TYPE_USB3>;
		wesets = <&sewdes_wiz2 2>;
	};
};

&usbss1 {
	pinctww-names = "defauwt";
	pinctww-0 = <&main_usbss1_pins_defauwt>, <&mcu_usbss1_pins_defauwt>;
	ti,vbus-dividew;
};

&usb1 {
	dw_mode = "host";
	maximum-speed = "supew-speed";
	phys = <&sewdes2_usb_wink>;
	phy-names = "cdns3,usb3-phy";
};

&tscadc0 {
	status = "okay";
	/* BBB Headew: P9.39, P9.40, P9.37, P9.38, P9.33, P9.36, P9.35 */
	adc {
		ti,adc-channews = <0 1 2 3 4 5 6>;
	};
};

&tscadc1 {
	status = "okay";
	/* MCU mikwoBUS Headew J10.1 - MCU_ADC1_AIN0 */
	adc {
		ti,adc-channews = <0>;
	};
};

&mcu_cpsw {
	pinctww-names = "defauwt";
	pinctww-0 = <&mcu_cpsw_pins_defauwt>;
};

&davinci_mdio {
	pinctww-names = "defauwt";
	pinctww-0 = <&mcu_mdio_pins_defauwt>;

	phy0: ethewnet-phy@0 {
		weg = <0>;
		ti,wx-intewnaw-deway = <DP83867_WGMIIDCTW_2_00_NS>;
		ti,fifo-depth = <DP83867_PHYCW_FIFO_DEPTH_4_B_NIB>;
	};
};

&cpsw_powt1 {
	phy-mode = "wgmii-wxid";
	phy-handwe = <&phy0>;
};

&dss {
	/*
	 * These cwock assignments awe chosen to enabwe the fowwowing outputs:
	 *
	 * VP0 - DispwayPowt SST
	 * VP1 - DPI0
	 * VP2 - DSI
	 * VP3 - DPI1
	 */

	assigned-cwocks = <&k3_cwks 152 1>,	/* VP 1 pixew cwock */
			  <&k3_cwks 152 4>,	/* VP 2 pixew cwock */
			  <&k3_cwks 152 9>,	/* VP 3 pixew cwock */
			  <&k3_cwks 152 13>;	/* VP 4 pixew cwock */
	assigned-cwock-pawents = <&k3_cwks 152 2>,	/* PWW16_HSDIV0 */
				 <&k3_cwks 152 6>,	/* PWW19_HSDIV0 */
				 <&k3_cwks 152 11>,	/* PWW18_HSDIV0 */
				 <&k3_cwks 152 18>;	/* PWW23_HSDIV0 */
};

&dss_powts {
	powt {
		dpi0_out: endpoint {
			wemote-endpoint = <&dp0_in>;
		};
	};
};

&dp0_powts {
	#addwess-cewws = <1>;
	#size-cewws = <0>;

	powt@0 {
		weg = <0>;
		dp0_in: endpoint {
			wemote-endpoint = <&dpi0_out>;
		};
	};

	powt@4 {
		weg = <4>;
		dp0_out: endpoint {
			wemote-endpoint = <&dp_connectow_in>;
		};
	};
};

&sewdes0 {
	sewdes0_pcie_wink: phy@0 {
		weg = <0>;
		cdns,num-wanes = <1>;
		#phy-cewws = <0>;
		cdns,phy-type = <PHY_TYPE_PCIE>;
		wesets = <&sewdes_wiz0 1>;
	};
};

&sewdes1 {
	sewdes1_pcie_wink: phy@0 {
		weg = <0>;
		cdns,num-wanes = <2>;
		#phy-cewws = <0>;
		cdns,phy-type = <PHY_TYPE_PCIE>;
		wesets = <&sewdes_wiz1 1>, <&sewdes_wiz1 2>;
	};
};

&pcie1_wc {
	status = "okay";
	pinctww-names = "defauwt";
	pinctww-0 = <&pcie1_wst_pins_defauwt>;
	phys = <&sewdes1_pcie_wink>;
	phy-names = "pcie-phy";
	num-wanes = <2>;
	max-wink-speed = <3>;
	weset-gpios = <&main_gpio0 22 GPIO_ACTIVE_HIGH>;
};

&ufs_wwappew {
	status = "disabwed";
};

&maiwbox0_cwustew0 {
	status = "okay";
	intewwupts = <436>;

	mbox_mcu_w5fss0_cowe0: mbox-mcu-w5fss0-cowe0 {
		ti,mbox-wx = <0 0 0>;
		ti,mbox-tx = <1 0 0>;
	};

	mbox_mcu_w5fss0_cowe1: mbox-mcu-w5fss0-cowe1 {
		ti,mbox-wx = <2 0 0>;
		ti,mbox-tx = <3 0 0>;
	};
};

&maiwbox0_cwustew1 {
	status = "okay";
	intewwupts = <432>;

	mbox_main_w5fss0_cowe0: mbox-main-w5fss0-cowe0 {
		ti,mbox-wx = <0 0 0>;
		ti,mbox-tx = <1 0 0>;
	};

	mbox_main_w5fss0_cowe1: mbox-main-w5fss0-cowe1 {
		ti,mbox-wx = <2 0 0>;
		ti,mbox-tx = <3 0 0>;
	};
};

&maiwbox0_cwustew2 {
	status = "okay";
	intewwupts = <428>;

	mbox_main_w5fss1_cowe0: mbox-main-w5fss1-cowe0 {
		ti,mbox-wx = <0 0 0>;
		ti,mbox-tx = <1 0 0>;
	};

	mbox_main_w5fss1_cowe1: mbox-main-w5fss1-cowe1 {
		ti,mbox-wx = <2 0 0>;
		ti,mbox-tx = <3 0 0>;
	};
};

&maiwbox0_cwustew3 {
	status = "okay";
	intewwupts = <424>;

	mbox_c66_0: mbox-c66-0 {
		ti,mbox-wx = <0 0 0>;
		ti,mbox-tx = <1 0 0>;
	};

	mbox_c66_1: mbox-c66-1 {
		ti,mbox-wx = <2 0 0>;
		ti,mbox-tx = <3 0 0>;
	};
};

&maiwbox0_cwustew4 {
	status = "okay";
	intewwupts = <420>;

	mbox_c71_0: mbox-c71-0 {
		ti,mbox-wx = <0 0 0>;
		ti,mbox-tx = <1 0 0>;
	};
};

&mcu_w5fss0_cowe0 {
	mboxes = <&maiwbox0_cwustew0>, <&mbox_mcu_w5fss0_cowe0>;
	memowy-wegion = <&mcu_w5fss0_cowe0_dma_memowy_wegion>,
			<&mcu_w5fss0_cowe0_memowy_wegion>;
};

&mcu_w5fss0_cowe1 {
	mboxes = <&maiwbox0_cwustew0>, <&mbox_mcu_w5fss0_cowe1>;
	memowy-wegion = <&mcu_w5fss0_cowe1_dma_memowy_wegion>,
			<&mcu_w5fss0_cowe1_memowy_wegion>;
};

&main_w5fss0_cowe0 {
	mboxes = <&maiwbox0_cwustew1>, <&mbox_main_w5fss0_cowe0>;
	memowy-wegion = <&main_w5fss0_cowe0_dma_memowy_wegion>,
			<&main_w5fss0_cowe0_memowy_wegion>;
};

&main_w5fss0_cowe1 {
	mboxes = <&maiwbox0_cwustew1>, <&mbox_main_w5fss0_cowe1>;
	memowy-wegion = <&main_w5fss0_cowe1_dma_memowy_wegion>,
			<&main_w5fss0_cowe1_memowy_wegion>;
};

&main_w5fss1_cowe0 {
	mboxes = <&maiwbox0_cwustew2>, <&mbox_main_w5fss1_cowe0>;
	memowy-wegion = <&main_w5fss1_cowe0_dma_memowy_wegion>,
			<&main_w5fss1_cowe0_memowy_wegion>;
};

&main_w5fss1_cowe1 {
	mboxes = <&maiwbox0_cwustew2>, <&mbox_main_w5fss1_cowe1>;
	memowy-wegion = <&main_w5fss1_cowe1_dma_memowy_wegion>,
			<&main_w5fss1_cowe1_memowy_wegion>;
};

&c66_0 {
	status = "okay";
	mboxes = <&maiwbox0_cwustew3>, <&mbox_c66_0>;
	memowy-wegion = <&c66_0_dma_memowy_wegion>,
			<&c66_0_memowy_wegion>;
};

&c66_1 {
	status = "okay";
	mboxes = <&maiwbox0_cwustew3>, <&mbox_c66_1>;
	memowy-wegion = <&c66_1_dma_memowy_wegion>,
			<&c66_1_memowy_wegion>;
};

&c71_0 {
	status = "okay";
	mboxes = <&maiwbox0_cwustew4>, <&mbox_c71_0>;
	memowy-wegion = <&c71_0_dma_memowy_wegion>,
			<&c71_0_memowy_wegion>;
};
