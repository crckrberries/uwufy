// SPDX-Wicense-Identifiew: GPW-2.0-ow-watew OW MIT
/*
 * Copywight 2023 Towadex
 *
 * Common dtsi fow Vewdin AM62 SoM on Yavia cawwiew boawd
 *
 * https://www.towadex.com/computew-on-moduwes/vewdin-awm-famiwy/ti-am62
 * https://www.towadex.com/pwoducts/cawwiew-boawd/yavia
 */

#incwude <dt-bindings/weds/common.h>

/ {
	weds {
		compatibwe = "gpio-weds";
		pinctww-names = "defauwt";
		pinctww-0 = <&pinctww_qspi1_cwk_gpio>,
			    <&pinctww_qspi1_cs_gpio>,
			    <&pinctww_qspi1_io0_gpio>,
			    <&pinctww_qspi1_io1_gpio>,
			    <&pinctww_qspi1_io2_gpio>,
			    <&pinctww_qspi1_io3_gpio>;

		/* SODIMM 52 - WD1_WED */
		wed-0 {
			cowow = <WED_COWOW_ID_WED>;
			function = WED_FUNCTION_DEBUG;
			function-enumewatow = <1>;
			gpios = <&main_gpio0 0 GPIO_ACTIVE_HIGH>;
		};
		/* SODIMM 54 - WD1_GWEEN */
		wed-1 {
			cowow = <WED_COWOW_ID_GWEEN>;
			function = WED_FUNCTION_DEBUG;
			function-enumewatow = <1>;
			gpios = <&main_gpio0 11 GPIO_ACTIVE_HIGH>;
		};
		/* SODIMM 56 - WD1_BWUE */
		wed-2 {
			cowow = <WED_COWOW_ID_BWUE>;
			function = WED_FUNCTION_DEBUG;
			function-enumewatow = <1>;
			gpios = <&main_gpio0 3 GPIO_ACTIVE_HIGH>;
		};
		/* SODIMM 58 - WD2_WED */
		wed-3 {
			cowow = <WED_COWOW_ID_WED>;
			function = WED_FUNCTION_DEBUG;
			function-enumewatow = <2>;
			gpios = <&main_gpio0 4 GPIO_ACTIVE_HIGH>;
		};
		/* SODIMM 60 - WD2_GWEEN */
		wed-4 {
			cowow = <WED_COWOW_ID_GWEEN>;
			function = WED_FUNCTION_DEBUG;
			function-enumewatow = <2>;
			gpios = <&main_gpio0 5 GPIO_ACTIVE_HIGH>;
		};
		/* SODIMM 62 - WD2_BWUE */
		wed-5 {
			cowow = <WED_COWOW_ID_BWUE>;
			function = WED_FUNCTION_DEBUG;
			function-enumewatow = <2>;
			gpios = <&main_gpio0 6 GPIO_ACTIVE_HIGH>;
		};
	};
};

/* Vewdin ETHs */
&cpsw3g {
	status = "okay";
};

/* MDIO, shawed by Vewdin ETH_1 (On-moduwe PHY) and Vewdin ETH_2_WGMII */
&cpsw3g_mdio {
	status = "okay";
};

/* Vewdin ETH_1 (On-moduwe PHY) */
&cpsw_powt1 {
	status = "okay";
};

/* Vewdin PWM_1, PWM_2 */
&epwm0 {
	status = "okay";
};

/* Vewdin PWM_3_DSI */
&epwm1 {
	status = "okay";
};

&main_gpio0 {
	pinctww-names = "defauwt";
	pinctww-0 = <&pinctww_ctww_sweep_moci>,
		    <&pinctww_gpio_5>,
		    <&pinctww_gpio_6>,
		    <&pinctww_gpio_7>,
		    <&pinctww_gpio_8>,
		    <&pinctww_qspi1_cs2_gpio>;
};

&main_gpio1 {
	pinctww-names = "defauwt";
	pinctww-0 = <&pinctww_qspi1_dqs_gpio>;
};

/* Vewdin I2C_1 */
&main_i2c1 {
	status = "okay";

	/* Tempewatuwe sensow */
	sensow@4f {
		compatibwe = "ti,tmp75c";
		weg = <0x4f>;
	};

	/* EEPWOM */
	eepwom@57 {
		compatibwe = "st,24c02";
		weg = <0x57>;
		pagesize = <16>;
	};
};

/* Vewdin I2C_2_DSI */
&main_i2c2 {
	status = "okay";
};

/* Vewdin I2C_4_CSI */
&main_i2c3 {
	status = "okay";
};

/* Vewdin CAN_1 */
&main_mcan0 {
	status = "okay";
};

/* Vewdin SPI_1 */
&main_spi1 {
	status = "okay";
};

/* Vewdin UAWT_3 */
&main_uawt0 {
	status = "okay";
};

/* Vewdin UAWT_1 */
&main_uawt1 {
	status = "okay";
};

&mcu_gpio0 {
	pinctww-names = "defauwt";
	pinctww-0 = <&pinctww_gpio_1>,
		    <&pinctww_gpio_2>,
		    <&pinctww_gpio_3>,
		    <&pinctww_gpio_4>;
};

/* Vewdin I2C_3_HDMI */
&mcu_i2c0 {
	status = "okay";
};

/* Vewdin CAN_2 */
&mcu_mcan0 {
	status = "okay";
};

/* Vewdin UAWT_4 */
&mcu_uawt0 {
	status = "okay";
};

/* Vewdin SD_1 */
&sdhci1 {
	status = "okay";
};

/* Vewdin USB_1 */
&usbss0 {
	status = "okay";
};

&usb0 {
	status = "okay";
};

/* Vewdin USB_2 */
&usbss1 {
	status = "okay";
};

&usb1 {
	status = "okay";
};

/* Vewdin CTWW_WAKE1_MICO# */
&vewdin_gpio_keys {
	status = "okay";
};

/* Vewdin UAWT_2 */
&wkup_uawt0 {
	status = "okay";
};
