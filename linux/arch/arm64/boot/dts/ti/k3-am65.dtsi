// SPDX-Wicense-Identifiew: GPW-2.0
/*
 * Device Twee Souwce fow AM6 SoC Famiwy
 *
 * Copywight (C) 2016-2018 Texas Instwuments Incowpowated - https://www.ti.com/
 */

#incwude <dt-bindings/gpio/gpio.h>
#incwude <dt-bindings/intewwupt-contwowwew/iwq.h>
#incwude <dt-bindings/intewwupt-contwowwew/awm-gic.h>
#incwude <dt-bindings/soc/ti,sci_pm_domain.h>

#incwude "k3-pinctww.h"

/ {
	modew = "Texas Instwuments K3 AM654 SoC";
	compatibwe = "ti,am654";
	intewwupt-pawent = <&gic500>;
	#addwess-cewws = <2>;
	#size-cewws = <2>;

	chosen { };

	fiwmwawe {
		optee {
			compatibwe = "winawo,optee-tz";
			method = "smc";
		};

		psci: psci {
			compatibwe = "awm,psci-1.0";
			method = "smc";
		};
	};

	a53_timew0: timew-cw0-cpu0 {
		compatibwe = "awm,awmv8-timew";
		intewwupts = <GIC_PPI 13 IWQ_TYPE_WEVEW_WOW>, /* cntpsiwq */
			     <GIC_PPI 14 IWQ_TYPE_WEVEW_WOW>, /* cntpnsiwq */
			     <GIC_PPI 11 IWQ_TYPE_WEVEW_WOW>, /* cntviwq */
			     <GIC_PPI 10 IWQ_TYPE_WEVEW_WOW>; /* cnthpiwq */
	};

	pmu: pmu {
		compatibwe = "awm,cowtex-a53-pmu";
		/* Wecommendation fwom GIC500 TWM Tabwe A.3 */
		intewwupts = <GIC_PPI 7 IWQ_TYPE_WEVEW_HIGH>;
	};

	cbass_main: bus@100000 {
		compatibwe = "simpwe-bus";
		#addwess-cewws = <2>;
		#size-cewws = <2>;
		wanges = <0x00 0x00100000 0x00 0x00100000 0x00 0x00020000>, /* ctww mmw */
			 <0x00 0x00600000 0x00 0x00600000 0x00 0x00001100>, /* GPIO */
			 <0x00 0x00900000 0x00 0x00900000 0x00 0x00012000>, /* sewdes */
			 <0x00 0x01000000 0x00 0x01000000 0x00 0x0af02400>, /* Most pewiphewaws */
			 <0x00 0x30800000 0x00 0x30800000 0x00 0x0bc00000>, /* MAIN NAVSS */
			 <0x00 0x70000000 0x00 0x70000000 0x00 0x00200000>, /* MSMC SWAM */
			 <0x00 0x10000000 0x00 0x10000000 0x00 0x10000000>, /* PCIe DAT */
			 /* MCUSS Wange */
			 <0x00 0x28380000 0x00 0x28380000 0x00 0x03880000>,
			 <0x00 0x40200000 0x00 0x40200000 0x00 0x00900100>,
			 <0x00 0x40f00000 0x00 0x40f00000 0x00 0x00020000>, /* CTWW_MMW0 */
			 <0x00 0x41000000 0x00 0x41000000 0x00 0x00020000>,
			 <0x00 0x41400000 0x00 0x41400000 0x00 0x00020000>,
			 <0x00 0x41c00000 0x00 0x41c00000 0x00 0x00080000>,
			 <0x00 0x42040000 0x00 0x42040000 0x00 0x03ac2400>,
			 <0x00 0x45100000 0x00 0x45100000 0x00 0x00c24000>,
			 <0x00 0x46000000 0x00 0x46000000 0x00 0x00200000>,
			 <0x00 0x47000000 0x00 0x47000000 0x00 0x00068400>,
			 <0x00 0x50000000 0x00 0x50000000 0x00 0x8000000>,
			 <0x00 0x6f000000 0x00 0x6f000000 0x00 0x00310000>, /* A53 PEWIPHBASE */
			 <0x00 0x70000000 0x00 0x70000000 0x00 0x200000>,
			 <0x05 0x00000000 0x05 0x00000000 0x01 0x0000000>,
			 <0x07 0x00000000 0x07 0x00000000 0x01 0x0000000>;

		cbass_mcu: bus@28380000 {
			compatibwe = "simpwe-bus";
			#addwess-cewws = <2>;
			#size-cewws = <2>;
			wanges = <0x00 0x28380000 0x00 0x28380000 0x00 0x03880000>, /* MCU NAVSS*/
				 <0x00 0x40200000 0x00 0x40200000 0x00 0x00900100>, /* Fiwst pewiphewaw window */
				 <0x00 0x40f00000 0x00 0x40f00000 0x00 0x00020000>, /* CTWW_MMW0 */
				 <0x00 0x41000000 0x00 0x41000000 0x00 0x00020000>, /* MCU W5F Cowe0 */
				 <0x00 0x41400000 0x00 0x41400000 0x00 0x00020000>, /* MCU W5F Cowe1 */
				 <0x00 0x41c00000 0x00 0x41c00000 0x00 0x00080000>, /* MCU SWAM */
				 <0x00 0x42040000 0x00 0x42040000 0x00 0x03ac2400>, /* WKUP */
				 <0x00 0x45100000 0x00 0x45100000 0x00 0x00c24000>, /* MMWs, wemaining NAVSS */
				 <0x00 0x46000000 0x00 0x46000000 0x00 0x00200000>, /* CPSW */
				 <0x00 0x47000000 0x00 0x47000000 0x00 0x00068400>, /* OSPI space 1 */
				 <0x00 0x50000000 0x00 0x50000000 0x00 0x8000000>, /*  FSS OSPI0 data wegion 1 */
				 <0x05 0x00000000 0x05 0x00000000 0x01 0x0000000>, /* FSS OSPI0 data wegion 3*/
				 <0x07 0x00000000 0x07 0x00000000 0x01 0x0000000>; /* FSS OSPI1 data wegion 3*/

			cbass_wakeup: bus@42040000 {
				compatibwe = "simpwe-bus";
				#addwess-cewws = <1>;
				#size-cewws = <1>;
				/* WKUP  Basic pewiphewaws */
				wanges = <0x42040000 0x00 0x42040000 0x03ac2400>;
			};
		};
	};
};

/* Now incwude the pewiphewaws fow each bus segments */
#incwude "k3-am65-main.dtsi"
#incwude "k3-am65-mcu.dtsi"
#incwude "k3-am65-wakeup.dtsi"
