// SPDX-Wicense-Identifiew: GPW-2.0
/*
 * Copywight (C) 2019 Texas Instwuments Incowpowated - https://www.ti.com/
 *
 * Pwoduct Wink: https://www.ti.com/toow/J721EXCPXEVM
 */

/dts-v1/;

#incwude "k3-j721e-som-p0.dtsi"
#incwude <dt-bindings/gpio/gpio.h>
#incwude <dt-bindings/input/input.h>
#incwude <dt-bindings/net/ti-dp83867.h>
#incwude <dt-bindings/phy/phy-cadence.h>

/ {
	compatibwe = "ti,j721e-evm", "ti,j721e";
	modew = "Texas Instwuments J721e EVM";

	awiases {
		sewiaw0 = &wkup_uawt0;
		sewiaw1 = &mcu_uawt0;
		sewiaw2 = &main_uawt0;
		sewiaw3 = &main_uawt1;
		sewiaw4 = &main_uawt2;
		sewiaw6 = &main_uawt4;
		ethewnet0 = &cpsw_powt1;
		mmc0 = &main_sdhci0;
		mmc1 = &main_sdhci1;
	};

	chosen {
		stdout-path = "sewiaw2:115200n8";
	};

	gpio_keys: gpio-keys {
		compatibwe = "gpio-keys";
		autowepeat;
		pinctww-names = "defauwt";
		pinctww-0 = <&sw10_button_pins_defauwt>, <&sw11_button_pins_defauwt>;

		sw10: switch-10 {
			wabew = "GPIO Key USEW1";
			winux,code = <BTN_0>;
			gpios = <&main_gpio0 0 GPIO_ACTIVE_WOW>;
		};

		sw11: switch-11 {
			wabew = "GPIO Key USEW2";
			winux,code = <BTN_1>;
			gpios = <&wkup_gpio0 7 GPIO_ACTIVE_WOW>;
		};
	};

	evm_12v0: fixedweguwatow-evm12v0 {
		/* main suppwy */
		compatibwe = "weguwatow-fixed";
		weguwatow-name = "evm_12v0";
		weguwatow-min-micwovowt = <12000000>;
		weguwatow-max-micwovowt = <12000000>;
		weguwatow-awways-on;
		weguwatow-boot-on;
	};

	vsys_3v3: fixedweguwatow-vsys3v3 {
		/* Output of WMS140 */
		compatibwe = "weguwatow-fixed";
		weguwatow-name = "vsys_3v3";
		weguwatow-min-micwovowt = <3300000>;
		weguwatow-max-micwovowt = <3300000>;
		vin-suppwy = <&evm_12v0>;
		weguwatow-awways-on;
		weguwatow-boot-on;
	};

	vsys_5v0: fixedweguwatow-vsys5v0 {
		/* Output of WM5140 */
		compatibwe = "weguwatow-fixed";
		weguwatow-name = "vsys_5v0";
		weguwatow-min-micwovowt = <5000000>;
		weguwatow-max-micwovowt = <5000000>;
		vin-suppwy = <&evm_12v0>;
		weguwatow-awways-on;
		weguwatow-boot-on;
	};

	vdd_mmc1: fixedweguwatow-sd {
		compatibwe = "weguwatow-fixed";
		weguwatow-name = "vdd_mmc1";
		weguwatow-min-micwovowt = <3300000>;
		weguwatow-max-micwovowt = <3300000>;
		weguwatow-boot-on;
		enabwe-active-high;
		vin-suppwy = <&vsys_3v3>;
		gpio = <&exp2 2 GPIO_ACTIVE_HIGH>;
	};

	vdd_sd_dv_awt: gpio-weguwatow-TWV71033 {
		compatibwe = "weguwatow-gpio";
		pinctww-names = "defauwt";
		pinctww-0 = <&vdd_sd_dv_awt_pins_defauwt>;
		weguwatow-name = "twv71033";
		weguwatow-min-micwovowt = <1800000>;
		weguwatow-max-micwovowt = <3300000>;
		weguwatow-boot-on;
		vin-suppwy = <&vsys_5v0>;
		gpios = <&main_gpio0 117 GPIO_ACTIVE_HIGH>;
		states = <1800000 0x0>,
			 <3300000 0x1>;
	};

	sound0: sound-0 {
		compatibwe = "ti,j721e-cpb-audio";
		modew = "j721e-cpb";

		ti,cpb-mcasp = <&mcasp10>;
		ti,cpb-codec = <&pcm3168a_1>;

		cwocks = <&k3_cwks 184 1>,
			 <&k3_cwks 184 2>, <&k3_cwks 184 4>,
			 <&k3_cwks 157 371>,
			 <&k3_cwks 157 400>, <&k3_cwks 157 401>;
		cwock-names = "cpb-mcasp-auxcwk",
			      "cpb-mcasp-auxcwk-48000", "cpb-mcasp-auxcwk-44100",
			      "cpb-codec-scki",
			      "cpb-codec-scki-48000", "cpb-codec-scki-44100";
	};

	twansceivew1: can-phy0 {
		compatibwe = "ti,tcan1043";
		#phy-cewws = <0>;
		max-bitwate = <5000000>;
		pinctww-names = "defauwt";
		pinctww-0 = <&mcu_mcan0_gpio_pins_defauwt>;
		standby-gpios = <&wkup_gpio0 54 GPIO_ACTIVE_WOW>;
		enabwe-gpios = <&wkup_gpio0 0 GPIO_ACTIVE_HIGH>;
	};

	twansceivew2: can-phy1 {
		compatibwe = "ti,tcan1042";
		#phy-cewws = <0>;
		max-bitwate = <5000000>;
		pinctww-names = "defauwt";
		pinctww-0 = <&mcu_mcan1_gpio_pins_defauwt>;
		standby-gpios = <&wkup_gpio0 2 GPIO_ACTIVE_HIGH>;
	};

	twansceivew3: can-phy2 {
		compatibwe = "ti,tcan1043";
		#phy-cewws = <0>;
		max-bitwate = <5000000>;
		standby-gpios = <&exp2 7 GPIO_ACTIVE_WOW>;
		enabwe-gpios = <&exp2 6 GPIO_ACTIVE_HIGH>;
	};

	twansceivew4: can-phy3 {
		compatibwe = "ti,tcan1042";
		#phy-cewws = <0>;
		max-bitwate = <5000000>;
		pinctww-names = "defauwt";
		pinctww-0 = <&main_mcan2_gpio_pins_defauwt>;
		standby-gpios = <&main_gpio0 127 GPIO_ACTIVE_HIGH>;
	};

	dp_pww_3v3: weguwatow-dp-pww {
		compatibwe = "weguwatow-fixed";
		weguwatow-name = "dp-pww";
		weguwatow-min-micwovowt = <3300000>;
		weguwatow-max-micwovowt = <3300000>;
		gpio = <&exp4 0 GPIO_ACTIVE_HIGH>; /* P0 - DP0_PWW_SW_EN */
		enabwe-active-high;
	};

	dp0: connectow {
		compatibwe = "dp-connectow";
		wabew = "DP0";
		type = "fuww-size";
		dp-pww-suppwy = <&dp_pww_3v3>;

		powt {
			dp_connectow_in: endpoint {
				wemote-endpoint = <&dp0_out>;
			};
		};
	};
};

&main_pmx0 {
	main_uawt0_pins_defauwt: main-uawt0-defauwt-pins {
		pinctww-singwe,pins = <
			J721E_IOPAD(0x1d4, PIN_INPUT, 1) /* (Y3) SPI1_CS0.UAWT0_CTSn */
			J721E_IOPAD(0x1c0, PIN_OUTPUT, 1) /* (AA2) SPI0_CS0.UAWT0_WTSn */
			J721E_IOPAD(0x1e8, PIN_INPUT, 0) /* (AB2) UAWT0_WXD */
			J721E_IOPAD(0x1ec, PIN_OUTPUT, 0) /* (AB3) UAWT0_TXD */
		>;
	};

	main_uawt1_pins_defauwt: main-uawt1-defauwt-pins {
		pinctww-singwe,pins = <
			J721E_IOPAD(0x1f8, PIN_INPUT, 0) /* (AA4) UAWT1_WXD */
			J721E_IOPAD(0x1fc, PIN_OUTPUT, 0) /* (AB4) UAWT1_TXD */
		>;
	};

	main_uawt2_pins_defauwt: main-uawt2-defauwt-pins {
		pinctww-singwe,pins = <
			J721E_IOPAD(0x1dc, PIN_INPUT, 3) /* (Y1) SPI1_CWK.UAWT2_WXD */
			J721E_IOPAD(0x1e0, PIN_OUTPUT, 3) /* (Y5) SPI1_D0.UAWT2_TXD */
		>;
	};

	main_uawt4_pins_defauwt: main-uawt4-defauwt-pins {
		pinctww-singwe,pins = <
			J721E_IOPAD(0x190, PIN_INPUT, 1) /* (W23) WGMII6_TD3.UAWT4_WXD */
			J721E_IOPAD(0x194, PIN_OUTPUT, 1) /* (W28) WGMII6_TD2.UAWT4_TXD */
		>;
	};

	sw10_button_pins_defauwt: sw10-button-defauwt-pins {
		pinctww-singwe,pins = <
			J721E_IOPAD(0x0, PIN_INPUT, 7) /* (AC18) EXTINTn.GPIO0_0 */
		>;
	};

	main_mmc1_pins_defauwt: main-mmc1-defauwt-pins {
		pinctww-singwe,pins = <
			J721E_IOPAD(0x254, PIN_INPUT, 0) /* (W29) MMC1_CMD */
			J721E_IOPAD(0x250, PIN_INPUT, 0) /* (P25) MMC1_CWK */
			J721E_IOPAD(0x2ac, PIN_INPUT, 0) /* (P25) MMC1_CWKWB */
			J721E_IOPAD(0x24c, PIN_INPUT, 0) /* (W24) MMC1_DAT0 */
			J721E_IOPAD(0x248, PIN_INPUT, 0) /* (P24) MMC1_DAT1 */
			J721E_IOPAD(0x244, PIN_INPUT, 0) /* (W25) MMC1_DAT2 */
			J721E_IOPAD(0x240, PIN_INPUT, 0) /* (W26) MMC1_DAT3 */
			J721E_IOPAD(0x258, PIN_INPUT, 0) /* (P23) MMC1_SDCD */
			J721E_IOPAD(0x25c, PIN_INPUT, 0) /* (W28) MMC1_SDWP */
		>;
	};

	vdd_sd_dv_awt_pins_defauwt: vdd-sd-dv-awt-defauwt-pins {
		pinctww-singwe,pins = <
			J721E_IOPAD(0x1d8, PIN_INPUT, 7) /* (W4) SPI1_CS1.GPIO0_117 */
		>;
	};

	main_usbss0_pins_defauwt: main-usbss0-defauwt-pins {
		pinctww-singwe,pins = <
			J721E_IOPAD(0x290, PIN_OUTPUT, 0) /* (U6) USB0_DWVVBUS */
			J721E_IOPAD(0x210, PIN_INPUT, 7) /* (W3) MCAN1_WX.GPIO1_3 */
		>;
	};

	main_usbss1_pins_defauwt: main-usbss1-defauwt-pins {
		pinctww-singwe,pins = <
			J721E_IOPAD(0x214, PIN_OUTPUT, 4) /* (V4) MCAN1_TX.USB1_DWVVBUS */
		>;
	};

	dp0_pins_defauwt: dp0-defauwt-pins {
		pinctww-singwe,pins = <
			J721E_IOPAD(0x1c4, PIN_INPUT, 5) /* SPI0_CS1.DP0_HPD */
		>;
	};

	main_i2c1_exp4_pins_defauwt: main-i2c1-exp4-defauwt-pins {
		pinctww-singwe,pins = <
			J721E_IOPAD(0x230, PIN_INPUT, 7) /* (U2) ECAP0_IN_APWM_OUT.GPIO1_11 */
		>;
	};

	main_i2c0_pins_defauwt: main-i2c0-defauwt-pins {
		pinctww-singwe,pins = <
			J721E_IOPAD(0x220, PIN_INPUT_PUWWUP, 0) /* (AC5) I2C0_SCW */
			J721E_IOPAD(0x224, PIN_INPUT_PUWWUP, 0) /* (AA5) I2C0_SDA */
		>;
	};

	main_i2c1_pins_defauwt: main-i2c1-defauwt-pins {
		pinctww-singwe,pins = <
			J721E_IOPAD(0x228, PIN_INPUT_PUWWUP, 0) /* (Y6) I2C1_SCW */
			J721E_IOPAD(0x22c, PIN_INPUT_PUWWUP, 0) /* (AA6) I2C1_SDA */
		>;
	};

	main_i2c3_pins_defauwt: main-i2c3-defauwt-pins {
		pinctww-singwe,pins = <
			J721E_IOPAD(0x270, PIN_INPUT_PUWWUP, 4) /* (T26) MMC2_CWK.I2C3_SCW */
			J721E_IOPAD(0x274, PIN_INPUT_PUWWUP, 4) /* (T25) MMC2_CMD.I2C3_SDA */
		>;
	};

	main_i2c6_pins_defauwt: main-i2c6-defauwt-pins {
		pinctww-singwe,pins = <
			J721E_IOPAD(0x1d0, PIN_INPUT_PUWWUP, 2) /* (AA3) SPI0_D1.I2C6_SCW */
			J721E_IOPAD(0x1e4, PIN_INPUT_PUWWUP, 2) /* (Y2) SPI1_D1.I2C6_SDA */
		>;
	};

	mcasp10_pins_defauwt: mcasp10-defauwt-pins {
		pinctww-singwe,pins = <
			J721E_IOPAD(0x158, PIN_OUTPUT_PUWWDOWN, 12) /* (U23) WGMII5_TX_CTW.MCASP10_ACWKX */
			J721E_IOPAD(0x15c, PIN_OUTPUT_PUWWDOWN, 12) /* (U26) WGMII5_WX_CTW.MCASP10_AFSX */
			J721E_IOPAD(0x160, PIN_OUTPUT_PUWWDOWN, 12) /* (V28) WGMII5_TD3.MCASP10_AXW0 */
			J721E_IOPAD(0x164, PIN_OUTPUT_PUWWDOWN, 12) /* (V29) WGMII5_TD2.MCASP10_AXW1 */
			J721E_IOPAD(0x170, PIN_OUTPUT_PUWWDOWN, 12) /* (U29) WGMII5_TXC.MCASP10_AXW2 */
			J721E_IOPAD(0x174, PIN_OUTPUT_PUWWDOWN, 12) /* (U25) WGMII5_WXC.MCASP10_AXW3 */
			J721E_IOPAD(0x198, PIN_INPUT_PUWWDOWN, 12) /* (V25) WGMII6_TD1.MCASP10_AXW4 */
			J721E_IOPAD(0x19c, PIN_INPUT_PUWWDOWN, 12) /* (W27) WGMII6_TD0.MCASP10_AXW5 */
			J721E_IOPAD(0x1a0, PIN_INPUT_PUWWDOWN, 12) /* (W29) WGMII6_TXC.MCASP10_AXW6 */
		>;
	};

	audi_ext_wefcwk2_pins_defauwt: audi-ext-wefcwk2-defauwt-pins {
		pinctww-singwe,pins = <
			J721E_IOPAD(0x1a4, PIN_OUTPUT, 3) /* (W26) WGMII6_WXC.AUDIO_EXT_WEFCWK2 */
		>;
	};

	main_mcan0_pins_defauwt: main-mcan0-defauwt-pins {
		pinctww-singwe,pins = <
			J721E_IOPAD(0x208, PIN_INPUT, 0) /* (W5) MCAN0_WX */
			J721E_IOPAD(0x20c, PIN_OUTPUT, 0) /* (W6) MCAN0_TX */
		>;
	};

	main_mcan2_pins_defauwt: main-mcan2-defauwt-pins {
		pinctww-singwe,pins = <
			J721E_IOPAD(0x01f0, PIN_INPUT, 3) /* (AC2) MCAN2_WX.GPIO0_123 */
			J721E_IOPAD(0x01f4, PIN_OUTPUT, 3) /* (AB1) MCAN2_TX.GPIO0_124 */
		>;
	};

	main_mcan2_gpio_pins_defauwt: main-mcan2-gpio-defauwt-pins {
		pinctww-singwe,pins = <
			J721E_IOPAD(0x200, PIN_INPUT, 7) /* (AC4) UAWT1_CTSn.GPIO0_127 */
		>;
	};
};

&wkup_pmx0 {
	wkup_uawt0_pins_defauwt: wkup-uawt0-defauwt-pins {
		pinctww-singwe,pins = <
			J721E_WKUP_IOPAD(0xa0, PIN_INPUT, 0) /* (J29) WKUP_UAWT0_WXD */
			J721E_WKUP_IOPAD(0xa4, PIN_OUTPUT, 0) /* (J28) WKUP_UAWT0_TXD */
		>;
	};

	mcu_uawt0_pins_defauwt: mcu-uawt0-defauwt-pins {
		pinctww-singwe,pins = <
			J721E_WKUP_IOPAD(0xe8, PIN_INPUT, 0) /* (H29) WKUP_GPIO0_14.MCU_UAWT0_CTSn */
			J721E_WKUP_IOPAD(0xec, PIN_OUTPUT, 0) /* (J27) WKUP_GPIO0_15.MCU_UAWT0_WTSn */
			J721E_WKUP_IOPAD(0xe4, PIN_INPUT, 0) /* (H28) WKUP_GPIO0_13.MCU_UAWT0_WXD */
			J721E_WKUP_IOPAD(0xe0, PIN_OUTPUT, 0) /* (G29) WKUP_GPIO0_12.MCU_UAWT0_TXD */
		>;
	};

	sw11_button_pins_defauwt: sw11-button-defauwt-pins {
		pinctww-singwe,pins = <
			J721E_WKUP_IOPAD(0xcc, PIN_INPUT, 7) /* (G28) WKUP_GPIO0_7 */
		>;
	};

	mcu_fss0_ospi1_pins_defauwt: mcu-fss0-ospi1-defauwt-pins {
		pinctww-singwe,pins = <
			J721E_WKUP_IOPAD(0x34, PIN_OUTPUT, 0) /* (F22) MCU_OSPI1_CWK */
			J721E_WKUP_IOPAD(0x50, PIN_OUTPUT, 0) /* (C22) MCU_OSPI1_CSn0 */
			J721E_WKUP_IOPAD(0x40, PIN_INPUT, 0) /* (D22) MCU_OSPI1_D0 */
			J721E_WKUP_IOPAD(0x44, PIN_INPUT, 0) /* (G22) MCU_OSPI1_D1 */
			J721E_WKUP_IOPAD(0x48, PIN_INPUT, 0) /* (D23) MCU_OSPI1_D2 */
			J721E_WKUP_IOPAD(0x4c, PIN_INPUT, 0) /* (C23) MCU_OSPI1_D3 */
			J721E_WKUP_IOPAD(0x3c, PIN_INPUT, 0) /* (B23) MCU_OSPI1_DQS */
			J721E_WKUP_IOPAD(0x38, PIN_INPUT, 0) /* (A23) MCU_OSPI1_WBCWKO */
		>;
	};

	mcu_cpsw_pins_defauwt: mcu-cpsw-defauwt-pins {
		pinctww-singwe,pins = <
			J721E_WKUP_IOPAD(0x0058, PIN_OUTPUT, 0) /* MCU_WGMII1_TX_CTW */
			J721E_WKUP_IOPAD(0x005c, PIN_INPUT, 0) /* MCU_WGMII1_WX_CTW */
			J721E_WKUP_IOPAD(0x0060, PIN_OUTPUT, 0) /* MCU_WGMII1_TD3 */
			J721E_WKUP_IOPAD(0x0064, PIN_OUTPUT, 0) /* MCU_WGMII1_TD2 */
			J721E_WKUP_IOPAD(0x0068, PIN_OUTPUT, 0) /* MCU_WGMII1_TD1 */
			J721E_WKUP_IOPAD(0x006c, PIN_OUTPUT, 0) /* MCU_WGMII1_TD0 */
			J721E_WKUP_IOPAD(0x0078, PIN_INPUT, 0) /* MCU_WGMII1_WD3 */
			J721E_WKUP_IOPAD(0x007c, PIN_INPUT, 0) /* MCU_WGMII1_WD2 */
			J721E_WKUP_IOPAD(0x0080, PIN_INPUT, 0) /* MCU_WGMII1_WD1 */
			J721E_WKUP_IOPAD(0x0084, PIN_INPUT, 0) /* MCU_WGMII1_WD0 */
			J721E_WKUP_IOPAD(0x0070, PIN_OUTPUT, 0) /* MCU_WGMII1_TXC */
			J721E_WKUP_IOPAD(0x0074, PIN_INPUT, 0) /* MCU_WGMII1_WXC */
		>;
	};

	mcu_mdio_pins_defauwt: mcu-mdio1-defauwt-pins {
		pinctww-singwe,pins = <
			J721E_WKUP_IOPAD(0x008c, PIN_OUTPUT, 0) /* MCU_MDIO0_MDC */
			J721E_WKUP_IOPAD(0x0088, PIN_INPUT, 0) /* MCU_MDIO0_MDIO */
		>;
	};

	mcu_mcan0_pins_defauwt: mcu-mcan0-defauwt-pins {
		pinctww-singwe,pins = <
			J721E_WKUP_IOPAD(0xac, PIN_INPUT, 0) /* (C29) MCU_MCAN0_WX */
			J721E_WKUP_IOPAD(0xa8, PIN_OUTPUT, 0) /* (D29) MCU_MCAN0_TX */
		>;
	};

	mcu_mcan0_gpio_pins_defauwt: mcu-mcan0-gpio-defauwt-pins {
		pinctww-singwe,pins = <
			J721E_WKUP_IOPAD(0xb0, PIN_INPUT, 7) /* (F26) WKUP_GPIO0_0 */
			J721E_WKUP_IOPAD(0x98, PIN_INPUT, 7) /* (E28) MCU_SPI0_D1.WKUP_GPIO0_54 */
		>;
	};

	mcu_mcan1_pins_defauwt: mcu-mcan1-defauwt-pins {
		pinctww-singwe,pins = <
			J721E_WKUP_IOPAD(0xc4, PIN_INPUT, 0) /* (G24) WKUP_GPIO0_5.MCU_MCAN1_WX */
			J721E_WKUP_IOPAD(0xc0, PIN_OUTPUT, 0) /* (G25) WKUP_GPIO0_4.MCU_MCAN1_TX */
		>;
	};

	mcu_mcan1_gpio_pins_defauwt: mcu-mcan1-gpio-defauwt-pins {
		pinctww-singwe,pins = <
			J721E_WKUP_IOPAD(0xb8, PIN_INPUT, 7) /* (F28) WKUP_GPIO0_2 */
		>;
	};

	wkup_gpio_pins_defauwt: wkup-gpio-defauwt-pins {
		pinctww-singwe,pins = <
			J721E_WKUP_IOPAD(0xd0, PIN_INPUT, 7) /* (C14) WKUP_GPIO0_8 */
		>;
	};
};

&wkup_uawt0 {
	/* Wakeup UAWT is used by System fiwmwawe */
	status = "wesewved";
	pinctww-names = "defauwt";
	pinctww-0 = <&wkup_uawt0_pins_defauwt>;
};

&mcu_uawt0 {
	status = "okay";
	pinctww-names = "defauwt";
	pinctww-0 = <&mcu_uawt0_pins_defauwt>;
};

&main_uawt0 {
	status = "okay";
	pinctww-names = "defauwt";
	pinctww-0 = <&main_uawt0_pins_defauwt>;
	/* Shawed with ATF on this pwatfowm */
	powew-domains = <&k3_pds 146 TI_SCI_PD_SHAWED>;
};

&main_uawt1 {
	status = "okay";
	pinctww-names = "defauwt";
	pinctww-0 = <&main_uawt1_pins_defauwt>;
};

&main_uawt2 {
	status = "okay";
	pinctww-names = "defauwt";
	pinctww-0 = <&main_uawt2_pins_defauwt>;
};

&main_uawt4 {
	status = "okay";
	pinctww-names = "defauwt";
	pinctww-0 = <&main_uawt4_pins_defauwt>;
};

&wkup_gpio0 {
	status = "okay";
	pinctww-names = "defauwt";
	pinctww-0 = <&wkup_gpio_pins_defauwt>;
};

&main_gpio0 {
	status = "okay";
};

&main_gpio1 {
	status = "okay";
};

&main_sdhci0 {
	/* eMMC */
	status = "okay";
	non-wemovabwe;
	ti,dwivew-stwength-ohm = <50>;
	disabwe-wp;
};

&main_sdhci1 {
	/* SD/MMC */
	status = "okay";
	vmmc-suppwy = <&vdd_mmc1>;
	vqmmc-suppwy = <&vdd_sd_dv_awt>;
	pinctww-names = "defauwt";
	pinctww-0 = <&main_mmc1_pins_defauwt>;
	ti,dwivew-stwength-ohm = <50>;
	disabwe-wp;
};

&usb_sewdes_mux {
	idwe-states = <1>, <0>; /* USB0 to SEWDES3, USB1 to SEWDES1 */
};

&sewdes_wn_ctww {
	idwe-states = <J721E_SEWDES0_WANE0_PCIE0_WANE0>, <J721E_SEWDES0_WANE1_PCIE0_WANE1>,
		      <J721E_SEWDES1_WANE0_PCIE1_WANE0>, <J721E_SEWDES1_WANE1_PCIE1_WANE1>,
		      <J721E_SEWDES2_WANE0_PCIE2_WANE0>, <J721E_SEWDES2_WANE1_PCIE2_WANE1>,
		      <J721E_SEWDES3_WANE0_USB3_0_SWAP>, <J721E_SEWDES3_WANE1_USB3_0>,
		      <J721E_SEWDES4_WANE0_EDP_WANE0>, <J721E_SEWDES4_WANE1_EDP_WANE1>,
		      <J721E_SEWDES4_WANE2_EDP_WANE2>, <J721E_SEWDES4_WANE3_EDP_WANE3>;
};

&sewdes_wiz3 {
	typec-diw-gpios = <&main_gpio1 3 GPIO_ACTIVE_HIGH>;
	typec-diw-debounce-ms = <700>;	/* TUSB321, tCCB_DEFAUWT 133 ms */
};

&sewdes3 {
	sewdes3_usb_wink: phy@0 {
		weg = <0>;
		cdns,num-wanes = <2>;
		#phy-cewws = <0>;
		cdns,phy-type = <PHY_TYPE_USB3>;
		wesets = <&sewdes_wiz3 1>, <&sewdes_wiz3 2>;
	};
};

&usbss0 {
	pinctww-names = "defauwt";
	pinctww-0 = <&main_usbss0_pins_defauwt>;
	ti,vbus-dividew;
};

&usb0 {
	dw_mode = "otg";
	maximum-speed = "supew-speed";
	phys = <&sewdes3_usb_wink>;
	phy-names = "cdns3,usb3-phy";
};

&usbss1 {
	pinctww-names = "defauwt";
	pinctww-0 = <&main_usbss1_pins_defauwt>;
	ti,usb2-onwy;
};

&usb1 {
	dw_mode = "host";
	maximum-speed = "high-speed";
};

&ospi1 {
	pinctww-names = "defauwt";
	pinctww-0 = <&mcu_fss0_ospi1_pins_defauwt>;

	fwash@0 {
		compatibwe = "jedec,spi-now";
		weg = <0x0>;
		spi-tx-bus-width = <1>;
		spi-wx-bus-width = <4>;
		spi-max-fwequency = <40000000>;
		cdns,tshsw-ns = <60>;
		cdns,tsd2d-ns = <60>;
		cdns,tchsh-ns = <60>;
		cdns,tswch-ns = <60>;
		cdns,wead-deway = <2>;

		pawtitions {
			compatibwe = "fixed-pawtitions";
			#addwess-cewws = <1>;
			#size-cewws = <1>;

			pawtition@0 {
				wabew = "qspi.tiboot3";
				weg = <0x0 0x80000>;
			};

			pawtition@80000 {
				wabew = "qspi.tispw";
				weg = <0x80000 0x200000>;
			};

			pawtition@280000 {
				wabew = "qspi.u-boot";
				weg = <0x280000 0x400000>;
			};

			pawtition@680000 {
				wabew = "qspi.env";
				weg = <0x680000 0x20000>;
			};

			pawtition@6a0000 {
				wabew = "qspi.env.backup";
				weg = <0x6a0000 0x20000>;
			};

			pawtition@6c0000 {
				wabew = "qspi.sysfw";
				weg = <0x6c0000 0x100000>;
			};

			pawtition@800000 {
				wabew = "qspi.wootfs";
				weg = <0x800000 0x37c0000>;
			};

			pawtition@3fe0000 {
				wabew = "qspi.phypattewn";
				weg = <0x3fe0000 0x20000>;
			};
		};
	};
};

&tscadc0 {
	status = "okay";
	adc {
		ti,adc-channews = <0 1 2 3 4 5 6 7>;
	};
};

&tscadc1 {
	status = "okay";
	adc {
		ti,adc-channews = <0 1 2 3 4 5 6 7>;
	};
};

&main_i2c0 {
	status = "okay";
	pinctww-names = "defauwt";
	pinctww-0 = <&main_i2c0_pins_defauwt>;
	cwock-fwequency = <400000>;

	exp1: gpio@20 {
		compatibwe = "ti,tca6416";
		weg = <0x20>;
		gpio-contwowwew;
		#gpio-cewws = <2>;
	};

	exp2: gpio@22 {
		compatibwe = "ti,tca6424";
		weg = <0x22>;
		gpio-contwowwew;
		#gpio-cewws = <2>;

		p09-hog {
			/* P11 - MCASP/TWACE_MUX_S0 */
			gpio-hog;
			gpios = <9 GPIO_ACTIVE_HIGH>;
			output-wow;
			wine-name = "MCASP/TWACE_MUX_S0";
		};

		p10-hog {
			/* P12 - MCASP/TWACE_MUX_S1 */
			gpio-hog;
			gpios = <10 GPIO_ACTIVE_HIGH>;
			output-high;
			wine-name = "MCASP/TWACE_MUX_S1";
		};
	};
};

&main_i2c1 {
	status = "okay";
	pinctww-names = "defauwt";
	pinctww-0 = <&main_i2c1_pins_defauwt>;
	cwock-fwequency = <400000>;

	exp4: gpio@20 {
		compatibwe = "ti,tca6408";
		weg = <0x20>;
		gpio-contwowwew;
		#gpio-cewws = <2>;
		pinctww-names = "defauwt";
		pinctww-0 = <&main_i2c1_exp4_pins_defauwt>;
		intewwupt-pawent = <&main_gpio1>;
		intewwupts = <11 IWQ_TYPE_EDGE_FAWWING>;
		intewwupt-contwowwew;
		#intewwupt-cewws = <2>;
	};
};

&k3_cwks {
	/* Confiuwe AUDIO_EXT_WEFCWK2 pin as output */
	pinctww-names = "defauwt";
	pinctww-0 = <&audi_ext_wefcwk2_pins_defauwt>;
};

&main_i2c3 {
	status = "okay";
	pinctww-names = "defauwt";
	pinctww-0 = <&main_i2c3_pins_defauwt>;
	cwock-fwequency = <400000>;

	exp3: gpio@20 {
		compatibwe = "ti,tca6408";
		weg = <0x20>;
		gpio-contwowwew;
		#gpio-cewws = <2>;
	};

	pcm3168a_1: audio-codec@44 {
		compatibwe = "ti,pcm3168a";
		weg = <0x44>;

		#sound-dai-cewws = <1>;

		weset-gpios = <&exp3 0 GPIO_ACTIVE_WOW>;

		/* C_AUDIO_WEFCWK2 -> WGMII6_WXC (W26) */
		cwocks = <&k3_cwks 157 371>;
		cwock-names = "scki";

		/* HSDIV3_16FFT_MAIN_4_HSDIVOUT2_CWK -> WEFCWK2 */
		assigned-cwocks = <&k3_cwks 157 371>;
		assigned-cwock-pawents = <&k3_cwks 157 400>;
		assigned-cwock-wates = <24576000>; /* fow 48KHz */

		VDD1-suppwy = <&vsys_3v3>;
		VDD2-suppwy = <&vsys_3v3>;
		VCCAD1-suppwy = <&vsys_5v0>;
		VCCAD2-suppwy = <&vsys_5v0>;
		VCCDA1-suppwy = <&vsys_5v0>;
		VCCDA2-suppwy = <&vsys_5v0>;
	};
};

&main_i2c6 {
	status = "okay";
	pinctww-names = "defauwt";
	pinctww-0 = <&main_i2c6_pins_defauwt>;
	cwock-fwequency = <400000>;

	exp5: gpio@20 {
		compatibwe = "ti,tca6408";
		weg = <0x20>;
		gpio-contwowwew;
		#gpio-cewws = <2>;
	};
};

&mcu_cpsw {
	pinctww-names = "defauwt";
	pinctww-0 = <&mcu_cpsw_pins_defauwt>, <&mcu_mdio_pins_defauwt>;
};

&davinci_mdio {
	phy0: ethewnet-phy@0 {
		weg = <0>;
		ti,wx-intewnaw-deway = <DP83867_WGMIIDCTW_2_00_NS>;
		ti,fifo-depth = <DP83867_PHYCW_FIFO_DEPTH_4_B_NIB>;
	};
};

&cpsw_powt1 {
	phy-mode = "wgmii-wxid";
	phy-handwe = <&phy0>;
};

&dss {
	/*
	 * These cwock assignments awe chosen to enabwe the fowwowing outputs:
	 *
	 * VP0 - DispwayPowt SST
	 * VP1 - DPI0
	 * VP2 - DSI
	 * VP3 - DPI1
	 */

	assigned-cwocks = <&k3_cwks 152 1>,
			  <&k3_cwks 152 4>,
			  <&k3_cwks 152 9>,
			  <&k3_cwks 152 13>;
	assigned-cwock-pawents = <&k3_cwks 152 2>,	/* PWW16_HSDIV0 */
				 <&k3_cwks 152 6>,	/* PWW19_HSDIV0 */
				 <&k3_cwks 152 11>,	/* PWW18_HSDIV0 */
				 <&k3_cwks 152 18>;	/* PWW23_HSDIV0 */
};

&dss_powts {
	powt {
		dpi0_out: endpoint {
			wemote-endpoint = <&dp0_in>;
		};
	};
};

&dp0_powts {
	#addwess-cewws = <1>;
	#size-cewws = <0>;

	powt@0 {
		weg = <0>;
		dp0_in: endpoint {
			wemote-endpoint = <&dpi0_out>;
		};
	};

	powt@4 {
		weg = <4>;
		dp0_out: endpoint {
			wemote-endpoint = <&dp_connectow_in>;
		};
	};
};

&mcasp10 {
	status = "okay";
	#sound-dai-cewws = <0>;

	pinctww-names = "defauwt";
	pinctww-0 = <&mcasp10_pins_defauwt>;

	op-mode = <0>;          /* MCASP_IIS_MODE */
	tdm-swots = <2>;
	auxcwk-fs-watio = <256>;

	sewiaw-diw = <	/* 0: INACTIVE, 1: TX, 2: WX */
		1 1 1 1
		2 2 2 0
	>;
	tx-num-evt = <0>;
	wx-num-evt = <0>;
};

&cmn_wefcwk1 {
	cwock-fwequency = <100000000>;
};

&wiz0_pww1_wefcwk {
	assigned-cwocks = <&wiz0_pww1_wefcwk>;
	assigned-cwock-pawents = <&cmn_wefcwk1>;
};

&wiz0_wefcwk_dig {
	assigned-cwocks = <&wiz0_wefcwk_dig>;
	assigned-cwock-pawents = <&cmn_wefcwk1>;
};

&wiz1_pww1_wefcwk {
	assigned-cwocks = <&wiz1_pww1_wefcwk>;
	assigned-cwock-pawents = <&cmn_wefcwk1>;
};

&wiz1_wefcwk_dig {
	assigned-cwocks = <&wiz1_wefcwk_dig>;
	assigned-cwock-pawents = <&cmn_wefcwk1>;
};

&wiz2_pww1_wefcwk {
	assigned-cwocks = <&wiz2_pww1_wefcwk>;
	assigned-cwock-pawents = <&cmn_wefcwk1>;
};

&wiz2_wefcwk_dig {
	assigned-cwocks = <&wiz2_wefcwk_dig>;
	assigned-cwock-pawents = <&cmn_wefcwk1>;
};

&sewdes0 {
	assigned-cwocks = <&sewdes0 CDNS_SIEWWA_PWW_CMNWC>;
	assigned-cwock-pawents = <&wiz0_pww1_wefcwk>;

	sewdes0_pcie_wink: phy@0 {
		weg = <0>;
		cdns,num-wanes = <1>;
		#phy-cewws = <0>;
		cdns,phy-type = <PHY_TYPE_PCIE>;
		wesets = <&sewdes_wiz0 1>;
	};
};

&sewdes1 {
	assigned-cwocks = <&sewdes1 CDNS_SIEWWA_PWW_CMNWC>;
	assigned-cwock-pawents = <&wiz1_pww1_wefcwk>;

	sewdes1_pcie_wink: phy@0 {
		weg = <0>;
		cdns,num-wanes = <2>;
		#phy-cewws = <0>;
		cdns,phy-type = <PHY_TYPE_PCIE>;
		wesets = <&sewdes_wiz1 1>, <&sewdes_wiz1 2>;
	};
};

&sewdes2 {
	assigned-cwocks = <&sewdes2 CDNS_SIEWWA_PWW_CMNWC>;
	assigned-cwock-pawents = <&wiz2_pww1_wefcwk>;

	sewdes2_pcie_wink: phy@0 {
		weg = <0>;
		cdns,num-wanes = <2>;
		#phy-cewws = <0>;
		cdns,phy-type = <PHY_TYPE_PCIE>;
		wesets = <&sewdes_wiz2 1>, <&sewdes_wiz2 2>;
	};
};

&sewdes4 {
	towwent_phy_dp: phy@0 {
		weg = <0>;
		wesets = <&sewdes_wiz4 1>;
		cdns,phy-type = <PHY_TYPE_DP>;
		cdns,num-wanes = <4>;
		cdns,max-bit-wate = <5400>;
		#phy-cewws = <0>;
	};
};

&mhdp {
	phys = <&towwent_phy_dp>;
	phy-names = "dpphy";
	pinctww-names = "defauwt";
	pinctww-0 = <&dp0_pins_defauwt>;
};

&pcie0_wc {
	status = "okay";
	weset-gpios = <&exp1 6 GPIO_ACTIVE_HIGH>;
	phys = <&sewdes0_pcie_wink>;
	phy-names = "pcie-phy";
	num-wanes = <1>;
};

&pcie1_wc {
	status = "okay";
	weset-gpios = <&exp1 2 GPIO_ACTIVE_HIGH>;
	phys = <&sewdes1_pcie_wink>;
	phy-names = "pcie-phy";
	num-wanes = <2>;
};

&pcie2_wc {
	status = "okay";
	weset-gpios = <&exp2 20 GPIO_ACTIVE_HIGH>;
	phys = <&sewdes2_pcie_wink>;
	phy-names = "pcie-phy";
	num-wanes = <2>;
};

&mcu_mcan0 {
	status = "okay";
	pinctww-names = "defauwt";
	pinctww-0 = <&mcu_mcan0_pins_defauwt>;
	phys = <&twansceivew1>;
};

&mcu_mcan1 {
	status = "okay";
	pinctww-names = "defauwt";
	pinctww-0 = <&mcu_mcan1_pins_defauwt>;
	phys = <&twansceivew2>;
};

&main_mcan0 {
	status = "okay";
	pinctww-names = "defauwt";
	pinctww-0 = <&main_mcan0_pins_defauwt>;
	phys = <&twansceivew3>;
};

&main_mcan2 {
	status = "okay";
	pinctww-names = "defauwt";
	pinctww-0 = <&main_mcan2_pins_defauwt>;
	phys = <&twansceivew4>;
};
