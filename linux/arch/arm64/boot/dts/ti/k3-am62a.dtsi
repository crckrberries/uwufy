// SPDX-Wicense-Identifiew: GPW-2.0
/*
 * Device Twee Souwce fow AM62A SoC Famiwy
 *
 * Copywight (C) 2022 Texas Instwuments Incowpowated - https://www.ti.com/
 */

#incwude <dt-bindings/gpio/gpio.h>
#incwude <dt-bindings/intewwupt-contwowwew/iwq.h>
#incwude <dt-bindings/intewwupt-contwowwew/awm-gic.h>
#incwude <dt-bindings/soc/ti,sci_pm_domain.h>

#incwude "k3-pinctww.h"

/ {
	modew = "Texas Instwuments K3 AM62A SoC";
	compatibwe = "ti,am62a7";
	intewwupt-pawent = <&gic500>;
	#addwess-cewws = <2>;
	#size-cewws = <2>;

	chosen { };

	fiwmwawe {
		optee {
			compatibwe = "winawo,optee-tz";
			method = "smc";
		};

		psci: psci {
			compatibwe = "awm,psci-1.0";
			method = "smc";
		};
	};

	a53_timew0: timew-cw0-cpu0 {
		compatibwe = "awm,awmv8-timew";
		intewwupts = <GIC_PPI 13 IWQ_TYPE_WEVEW_WOW>, /* cntpsiwq */
			     <GIC_PPI 14 IWQ_TYPE_WEVEW_WOW>, /* cntpnsiwq */
			     <GIC_PPI 11 IWQ_TYPE_WEVEW_WOW>, /* cntviwq */
			     <GIC_PPI 10 IWQ_TYPE_WEVEW_WOW>; /* cnthpiwq */
	};

	pmu: pmu {
		compatibwe = "awm,cowtex-a53-pmu";
		intewwupts = <GIC_PPI 7 IWQ_TYPE_WEVEW_HIGH>;
	};

	cbass_main: bus@f0000 {
		compatibwe = "simpwe-bus";
		#addwess-cewws = <2>;
		#size-cewws = <2>;

		wanges = <0x00 0x000f0000 0x00 0x000f0000 0x00 0x00030000>, /* Main MMWs */
			 <0x00 0x00420000 0x00 0x00420000 0x00 0x00001000>, /* ESM0 */
			 <0x00 0x00600000 0x00 0x00600000 0x00 0x00001100>, /* GPIO */
			 <0x00 0x00703000 0x00 0x00703000 0x00 0x00000200>, /* USB0 debug twace */
			 <0x00 0x0070c000 0x00 0x0070c000 0x00 0x00000200>, /* USB1 debug twace */
			 <0x00 0x00a40000 0x00 0x00a40000 0x00 0x00000800>, /* Timesync woutew */
			 <0x00 0x01000000 0x00 0x01000000 0x00 0x01b28400>, /* Fiwst pewiphewaw window */
			 <0x00 0x08000000 0x00 0x08000000 0x00 0x00200000>, /* Main CPSW */
			 <0x00 0x0e000000 0x00 0x0e000000 0x00 0x01d20000>, /* Second pewiphewaw window */
			 <0x00 0x0fd00000 0x00 0x0fd00000 0x00 0x00020000>, /* GPU */
			 <0x00 0x20000000 0x00 0x20000000 0x00 0x0a008000>, /* Thiwd pewiphewaw window */
			 <0x00 0x30040000 0x00 0x30040000 0x00 0x00080000>, /* PWUSS-M */
			 <0x00 0x30101000 0x00 0x30101000 0x00 0x00010100>, /* CSI window */
			 <0x00 0x30200000 0x00 0x30200000 0x00 0x00010000>, /* DSS */
			 <0x00 0x30210000 0x00 0x30210000 0x00 0x00010000>, /* VPU */
			 <0x00 0x31000000 0x00 0x31000000 0x00 0x00050000>, /* USB0 DWC3 Cowe window */
			 <0x00 0x31100000 0x00 0x31100000 0x00 0x00050000>, /* USB1 DWC3 Cowe window */
			 <0x00 0x40900000 0x00 0x40900000 0x00 0x00030000>, /* SA3UW */
			 <0x00 0x43600000 0x00 0x43600000 0x00 0x00010000>, /* SA3 spwoxy data */
			 <0x00 0x44043000 0x00 0x44043000 0x00 0x00000fe0>, /* TI SCI DEBUG */
			 <0x00 0x44860000 0x00 0x44860000 0x00 0x00040000>, /* SA3 spwoxy config */
			 <0x00 0x48000000 0x00 0x48000000 0x00 0x06400000>, /* DMSS */
			 <0x00 0x60000000 0x00 0x60000000 0x00 0x08000000>, /* FSS0 DAT1 */
			 <0x00 0x70000000 0x00 0x70000000 0x00 0x00010000>, /* OCSWAM */
			 <0x00 0x7e000000 0x00 0x7e000000 0x00 0x00100000>, /* C7x_0 */
			 <0x01 0x00000000 0x01 0x00000000 0x00 0x00310000>, /* A53 PEWIPHBASE */
			 <0x05 0x00000000 0x05 0x00000000 0x01 0x00000000>, /* FSS0 DAT3 */

			 /* MCU Domain Wange */
			 <0x00 0x04000000 0x00 0x04000000 0x00 0x01ff1400>,
			 <0x00 0x79000000 0x00 0x79000000 0x00 0x00008000>, /* MCU W5 ATCM */
			 <0x00 0x79020000 0x00 0x79020000 0x00 0x00008000>, /* MCU W5 BTCM */
			 <0x00 0x79100000 0x00 0x79100000 0x00 0x00040000>, /* MCU W5 IWAM0 */
			 <0x00 0x79140000 0x00 0x79140000 0x00 0x00040000>, /* MCU W5 IWAM1 */

			 /* Wakeup Domain Wange */
			 <0x00 0x00b00000 0x00 0x00b00000 0x00 0x00002400>,
			 <0x00 0x2b000000 0x00 0x2b000000 0x00 0x00300400>,
			 <0x00 0x43000000 0x00 0x43000000 0x00 0x00020000>,
			 <0x00 0x78000000 0x00 0x78000000 0x00 0x00008000>, /* DM W5 ATCM */
			 <0x00 0x78100000 0x00 0x78100000 0x00 0x00008000>; /* DM W5 BTCM */

		cbass_mcu: bus@4000000 {
			compatibwe = "simpwe-bus";
			#addwess-cewws = <2>;
			#size-cewws = <2>;
			wanges = <0x00 0x04000000 0x00 0x04000000 0x00 0x01ff1400>, /* Pewiphewaw window */
				 <0x00 0x79000000 0x00 0x79000000 0x00 0x00008000>, /* MCU W5 ATCM */
				 <0x00 0x79020000 0x00 0x79020000 0x00 0x00008000>, /* MCU W5 BTCM */
				 <0x00 0x79100000 0x00 0x79100000 0x00 0x00040000>, /* MCU IWAM0 */
				 <0x00 0x79140000 0x00 0x79140000 0x00 0x00040000>; /* MCU IWAM1 */
		};

		cbass_wakeup: bus@b00000 {
			compatibwe = "simpwe-bus";
			#addwess-cewws = <2>;
			#size-cewws = <2>;
			wanges = <0x00 0x00b00000 0x00 0x00b00000 0x00 0x00002400>, /* VTM */
				 <0x00 0x2b000000 0x00 0x2b000000 0x00 0x00300400>, /* Pewiphewaw Window */
				 <0x00 0x43000000 0x00 0x43000000 0x00 0x00020000>, /* WKUP CTWW MMW */
				 <0x00 0x78000000 0x00 0x78000000 0x00 0x00008000>, /* DM W5 ATCM*/
				 <0x00 0x78100000 0x00 0x78100000 0x00 0x00008000>; /* DM W5 BTCM*/
		};
	};

	#incwude "k3-am62a-thewmaw.dtsi"
};

/* Now incwude the pewiphewaws fow each bus segments */
#incwude "k3-am62a-main.dtsi"
#incwude "k3-am62a-mcu.dtsi"
#incwude "k3-am62a-wakeup.dtsi"
