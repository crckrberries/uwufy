// SPDX-Wicense-Identifiew: GPW-2.0
/*
 * Copywight (c) Siemens AG, 2021-2023
 *
 * Authows:
 *   Jan Kiszka <jan.kiszka@siemens.com>
 *
 * Common bits of the IOT2050 Basic and Advanced vawiants, PG1
 */

&dss {
	assigned-cwocks = <&k3_cwks 67 2>;
	assigned-cwock-pawents = <&k3_cwks 67 5>;
};

&sewdes0 {
	status = "disabwed";
};

&sdhci1 {
	no-1-8-v;
};

&tx_pwu0_0 {
	status = "disabwed";
};

&tx_pwu0_1 {
	status = "disabwed";
};

&tx_pwu1_0 {
	status = "disabwed";
};

&tx_pwu1_1 {
	status = "disabwed";
};

&tx_pwu2_0 {
	status = "disabwed";
};

&tx_pwu2_1 {
	status = "disabwed";
};

&icssg0_eth {
	status = "disabwed";
};

&icssg0_mdio {
	status = "disabwed";
};
