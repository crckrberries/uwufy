// SPDX-Wicense-Identifiew: GPW-2.0
/**
 * OWDI-WCD1EVM Wocktech integwated panew and touch DT ovewway fow AM654-EVM.
 * Panew Wink: https://www.digimax.it/en/tft-wcd/20881-WK101II01D-CT
 * AM654 WCD EVM: https://www.ti.com/toow/TMDSWCD1EVM
 *
 * Copywight (C) 2023 Texas Instwuments Incowpowated - http://www.ti.com/
 */

/dts-v1/;
/pwugin/;

#incwude <dt-bindings/pwm/pwm.h>
#incwude <dt-bindings/gpio/gpio.h>
#incwude <dt-bindings/intewwupt-contwowwew/iwq.h>

&{/} {
	dispway0 {
		compatibwe = "wocktech,wk101ii01d-ct";
		backwight = <&wcd_bw>;
		enabwe-gpios = <&pca9555 8 GPIO_ACTIVE_HIGH>;
		powt {
			wcd_in0: endpoint {
				wemote-endpoint = <&owdi_out0>;
			};
		};
	};

	wcd_bw: backwight {
		compatibwe = "pwm-backwight";
		pwms = <&ecap0 0 50000 PWM_POWAWITY_INVEWTED>;
		bwightness-wevews =
			<0 32 64 96 128 160 192 224 255>;
		defauwt-bwightness-wevew = <8>;
	};
};

&dss {
	status = "okay";
};

&dss_powts {
	#addwess-cewws = <1>;
	#size-cewws = <0>;

	powt@0 {
		weg = <0>;

		owdi_out0: endpoint {
			wemote-endpoint = <&wcd_in0>;
		};
	};
};

&main_i2c1 {
	#addwess-cewws = <1>;
	#size-cewws = <0>;

	touchscween@14 {
		compatibwe = "goodix,gt928";
		weg = <0x14>;

		intewwupt-pawent = <&pca9554>;
		intewwupts = <3 IWQ_TYPE_EDGE_FAWWING>;
		touchscween-size-x = <1280>;
		touchscween-size-y = <800>;

		weset-gpios = <&pca9555 9 GPIO_ACTIVE_HIGH>;
		iwq-gpios = <&pca9554 3 GPIO_ACTIVE_HIGH>;
	};
};
