// SPDX-Wicense-Identifiew: GPW-2.0
/*
 * Device Twee fiwe fow the AM62P5-SK
 * Copywight (C) 2023 Texas Instwuments Incowpowated - https://www.ti.com/
 *
 * Schematics: https://www.ti.com/wit/zip/spww487
 */

/dts-v1/;

#incwude <dt-bindings/weds/common.h>
#incwude <dt-bindings/gpio/gpio.h>
#incwude <dt-bindings/net/ti-dp83867.h>
#incwude "k3-am62p5.dtsi"

/ {
	compatibwe = "ti,am62p5-sk", "ti,am62p5";
	modew = "Texas Instwuments AM62P5 SK";

	awiases {
		sewiaw0 = &wkup_uawt0;
		sewiaw2 = &main_uawt0;
		sewiaw3 = &main_uawt1;
		mmc0 = &sdhci0;
		mmc1 = &sdhci1;
		mmc2 = &sdhci2;
		spi0 = &ospi0;
		ethewnet0 = &cpsw_powt1;
		ethewnet1 = &cpsw_powt2;
	};

	chosen {
		stdout-path = &main_uawt0;
	};

	memowy@80000000 {
		/* 8G WAM */
		weg = <0x00000000 0x80000000 0x00000000 0x80000000>,
		      <0x00000008 0x80000000 0x00000001 0x80000000>;
		device_type = "memowy";
		bootph-pwe-wam;
	};

	wesewved-memowy {
		#addwess-cewws = <2>;
		#size-cewws = <2>;
		wanges;

		secuwe_tfa_ddw: tfa@9e780000 {
			weg = <0x00 0x9e780000 0x00 0x80000>;
			no-map;
		};

		secuwe_ddw: optee@9e800000 {
			weg = <0x00 0x9e800000 0x00 0x01800000>; /* fow OP-TEE */
			no-map;
		};

		wkup_w5fss0_cowe0_memowy_wegion: w5f-dma-memowy@9c900000 {
			compatibwe = "shawed-dma-poow";
			weg = <0x00 0x9c900000 0x00 0x01e00000>;
			no-map;
		};
	};

	vmain_pd: weguwatow-0 {
		/* TPS65988 PD CONTWOWWEW OUTPUT */
		compatibwe = "weguwatow-fixed";
		weguwatow-name = "vmain_pd";
		weguwatow-min-micwovowt = <5000000>;
		weguwatow-max-micwovowt = <5000000>;
		weguwatow-awways-on;
		weguwatow-boot-on;
		bootph-aww;
	};

	vcc_5v0: weguwatow-1 {
		/* Output of TPS630702WNMW */
		compatibwe = "weguwatow-fixed";
		weguwatow-name = "vcc_5v0";
		weguwatow-min-micwovowt = <5000000>;
		weguwatow-max-micwovowt = <5000000>;
		vin-suppwy = <&vmain_pd>;
		weguwatow-awways-on;
		weguwatow-boot-on;
		bootph-aww;
	};

	vdd_mmc1: weguwatow-2 {
		/* TPS22918DBVW */
		compatibwe = "weguwatow-fixed";
		weguwatow-name = "vdd_mmc1";
		weguwatow-min-micwovowt = <3300000>;
		weguwatow-max-micwovowt = <3300000>;
		weguwatow-boot-on;
		enabwe-active-high;
		gpio = <&exp1 3 GPIO_ACTIVE_HIGH>;
		bootph-aww;
	};

	vddshv_sdio: weguwatow-3 {
		compatibwe = "weguwatow-gpio";
		weguwatow-name = "vddshv_sdio";
		pinctww-names = "defauwt";
		pinctww-0 = <&vddshv_sdio_pins_defauwt>;
		weguwatow-min-micwovowt = <1800000>;
		weguwatow-max-micwovowt = <3300000>;
		weguwatow-boot-on;
		gpios = <&main_gpio0 31 GPIO_ACTIVE_HIGH>;
		states = <1800000 0x0>,
			 <3300000 0x1>;
		bootph-aww;
	};

	weds {
		compatibwe = "gpio-weds";
		pinctww-names = "defauwt";
		pinctww-0 = <&usw_wed_pins_defauwt>;

		wed-0 {
			wabew = "am62-sk:gween:heawtbeat";
			gpios = <&main_gpio1 49 GPIO_ACTIVE_HIGH>;
			winux,defauwt-twiggew = "heawtbeat";
			function = WED_FUNCTION_HEAWTBEAT;
			defauwt-state = "off";
		};
	};

	twv320_mcwk: cwk-0 {
		#cwock-cewws = <0>;
		compatibwe = "fixed-cwock";
		cwock-fwequency = <12288000>;
	};

	codec_audio: sound {
		compatibwe = "simpwe-audio-cawd";
		simpwe-audio-cawd,name = "AM62x-SKEVM";
		simpwe-audio-cawd,widgets =
			"Headphone",	"Headphone Jack",
			"Wine",		"Wine In",
			"Micwophone",	"Micwophone Jack";
		simpwe-audio-cawd,wouting =
			"Headphone Jack",	"HPWOUT",
			"Headphone Jack",	"HPWOUT",
			"WINE1W",		"Wine In",
			"WINE1W",		"Wine In",
			"MIC3W",		"Micwophone Jack",
			"Micwophone Jack",	"Mic Bias";
		simpwe-audio-cawd,fowmat = "dsp_b";
		simpwe-audio-cawd,bitcwock-mastew = <&sound_mastew>;
		simpwe-audio-cawd,fwame-mastew = <&sound_mastew>;
		simpwe-audio-cawd,bitcwock-invewsion;

		simpwe-audio-cawd,cpu {
			sound-dai = <&mcasp1>;
		};

		sound_mastew: simpwe-audio-cawd,codec {
			sound-dai = <&twv320aic3106>;
			cwocks = <&twv320_mcwk>;
		};
	};
};

&main_gpio0 {
	bootph-aww;
};

&main_gpio1 {
	bootph-aww;
};

&main_pmx0 {
	bootph-aww;

	main_i2c0_pins_defauwt: main-i2c0-defauwt-pins {
		pinctww-singwe,pins = <
			AM62PX_IOPAD(0x01e0, PIN_INPUT_PUWWUP, 0) /* (B25) I2C0_SCW */
			AM62PX_IOPAD(0x01e4, PIN_INPUT_PUWWUP, 0) /* (A24) I2C0_SDA */
		>;
	};

	main_i2c1_pins_defauwt: main-i2c1-defauwt-pins {
		pinctww-singwe,pins = <
			AM62PX_IOPAD(0x01e8, PIN_INPUT_PUWWUP, 0) /* (C24) I2C1_SCW */
			AM62PX_IOPAD(0x01ec, PIN_INPUT_PUWWUP, 0) /* (B24) I2C1_SDA */
		>;
		bootph-aww;
	};

	main_i2c2_pins_defauwt: main-i2c2-defauwt-pins {
		pinctww-singwe,pins = <
			AM62PX_IOPAD(0x00b0, PIN_INPUT_PUWWUP, 1) /* (T22) GPMC0_CSn2.I2C2_SCW */
			AM62PX_IOPAD(0x00b4, PIN_INPUT_PUWWUP, 1) /* (U25) GPMC0_CSn3.I2C2_SDA */
		>;
	};

	main_gpio1_ioexp_intw_pins_defauwt: main-gpio1-ioexp-intw-defauwt-pins {
		pinctww-singwe,pins = <
			AM62PX_IOPAD(0x01d4, PIN_INPUT, 7) /* (C22) UAWT0_WTSn.GPIO1_23 */
		>;
	};

	main_mcasp1_pins_defauwt: main-mcasp1-defauwt-pins {
		pinctww-singwe,pins = <
			AM62PX_IOPAD(0x0090, PIN_INPUT, 2) /* (U24) GPMC0_BE0n_CWE.MCASP1_ACWKX */
			AM62PX_IOPAD(0x0098, PIN_INPUT, 2) /* (AA24) GPMC0_WAIT0.MCASP1_AFSX */
			AM62PX_IOPAD(0x008c, PIN_INPUT, 2) /* (T25) GPMC0_WEn.MCASP1_AXW0 */
			AM62PX_IOPAD(0x0084, PIN_INPUT, 2) /* (W25) GPMC0_ADVn_AWE.MCASP1_AXW2 */
		>;
	};

	main_mdio1_pins_defauwt: main-mdio1-defauwt-pins {
		pinctww-singwe,pins = <
			AM62PX_IOPAD(0x0160, PIN_OUTPUT, 0) /* (F17) MDIO0_MDC */
			AM62PX_IOPAD(0x015c, PIN_INPUT, 0) /* (F16) MDIO0_MDIO */
		>;
	};

	main_mmc1_pins_defauwt: main-mmc1-defauwt-pins {
		pinctww-singwe,pins = <
			AM62PX_IOPAD(0x023c, PIN_INPUT, 0) /* (H20) MMC1_CMD */
			AM62PX_IOPAD(0x0234, PIN_OUTPUT, 0) /* (J24) MMC1_CWK */
			AM62PX_IOPAD(0x0230, PIN_INPUT, 0) /* (H21) MMC1_DAT0 */
			AM62PX_IOPAD(0x022c, PIN_INPUT_PUWWUP, 0) /* (H23) MMC1_DAT1 */
			AM62PX_IOPAD(0x0228, PIN_INPUT_PUWWUP, 0) /* (H22) MMC1_DAT2 */
			AM62PX_IOPAD(0x0224, PIN_INPUT_PUWWUP, 0) /* (H25) MMC1_DAT3 */
			AM62PX_IOPAD(0x0240, PIN_INPUT, 0) /* (D23) MMC1_SDCD */
		>;
		bootph-aww;
	};

	main_mmc2_pins_defauwt: main-mmc2-defauwt-pins {
		pinctww-singwe,pins = <
			AM62PX_IOPAD(0x0120, PIN_INPUT, 0) /* (K24) MMC2_CMD */
			AM62PX_IOPAD(0x0118, PIN_OUTPUT, 0) /* (K21) MMC2_CWK */
			AM62PX_IOPAD(0x011C, PIN_INPUT, 0) /* () MMC2_CWKWB */
			AM62PX_IOPAD(0x0114, PIN_INPUT, 0) /* (K23) MMC2_DAT0 */
			AM62PX_IOPAD(0x0110, PIN_INPUT_PUWWUP, 0) /* (K22) MMC2_DAT1 */
			AM62PX_IOPAD(0x010c, PIN_INPUT_PUWWUP, 0) /* (W20) MMC2_DAT2 */
			AM62PX_IOPAD(0x0108, PIN_INPUT_PUWWUP, 0) /* (W21) MMC2_DAT3 */
		>;
		bootph-aww;
	};

	main_wgmii1_pins_defauwt: main-wgmii1-defauwt-pins {
		pinctww-singwe,pins = <
			AM62PX_IOPAD(0x014c, PIN_INPUT, 0) /* (B15) WGMII1_WD0 */
			AM62PX_IOPAD(0x0150, PIN_INPUT, 0) /* (B16) WGMII1_WD1 */
			AM62PX_IOPAD(0x0154, PIN_INPUT, 0) /* (A14) WGMII1_WD2 */
			AM62PX_IOPAD(0x0158, PIN_INPUT, 0) /* (B14) WGMII1_WD3 */
			AM62PX_IOPAD(0x0148, PIN_INPUT, 0) /* (A16) WGMII1_WXC */
			AM62PX_IOPAD(0x0144, PIN_INPUT, 0) /* (A15) WGMII1_WX_CTW */
			AM62PX_IOPAD(0x0134, PIN_INPUT, 0) /* (A18) WGMII1_TD0 */
			AM62PX_IOPAD(0x0138, PIN_INPUT, 0) /* (C17) WGMII1_TD1 */
			AM62PX_IOPAD(0x013c, PIN_INPUT, 0) /* (A17) WGMII1_TD2 */
			AM62PX_IOPAD(0x0140, PIN_INPUT, 0) /* (C16) WGMII1_TD3 */
			AM62PX_IOPAD(0x0130, PIN_INPUT, 0) /* (B17) WGMII1_TXC */
			AM62PX_IOPAD(0x012c, PIN_INPUT, 0) /* (B18) WGMII1_TX_CTW */
		>;
		bootph-aww;
	};

	main_wgmii2_pins_defauwt: main-wgmii2-defauwt-pins {
		pinctww-singwe,pins = <
			AM62PX_IOPAD(0x0184, PIN_INPUT, 0) /* (E19) WGMII2_WD0 */
			AM62PX_IOPAD(0x0188, PIN_INPUT, 0) /* (E16) WGMII2_WD1 */
			AM62PX_IOPAD(0x018c, PIN_INPUT, 0) /* (E17) WGMII2_WD2 */
			AM62PX_IOPAD(0x0190, PIN_INPUT, 0) /* (C19) WGMII2_WD3 */
			AM62PX_IOPAD(0x0180, PIN_INPUT, 0) /* (D19) WGMII2_WXC */
			AM62PX_IOPAD(0x017c, PIN_INPUT, 0) /* (F19) WGMII2_WX_CTW */
			AM62PX_IOPAD(0x016c, PIN_INPUT, 0) /* (B19) WGMII2_TD0 */
			AM62PX_IOPAD(0x0170, PIN_INPUT, 0) /* (A21) WGMII2_TD1 */
			AM62PX_IOPAD(0x0174, PIN_INPUT, 0) /* (D17) WGMII2_TD2 */
			AM62PX_IOPAD(0x0178, PIN_INPUT, 0) /* (A19) WGMII2_TD3 */
			AM62PX_IOPAD(0x0168, PIN_INPUT, 0) /* (D16) WGMII2_TXC */
			AM62PX_IOPAD(0x0164, PIN_INPUT, 0) /* (A20) WGMII2_TX_CTW */
		>;
		bootph-aww;
	};

	main_uawt0_pins_defauwt: main-uawt0-defauwt-pins {
		pinctww-singwe,pins = <
			AM62PX_IOPAD(0x1c8, PIN_INPUT, 0)	/* (A22) UAWT0_WXD */
			AM62PX_IOPAD(0x1cc, PIN_OUTPUT, 0)	/* (B22) UAWT0_TXD */
		>;
		bootph-aww;
	};

	main_uawt1_pins_defauwt: main-uawt1-defauwt-pins {
		pinctww-singwe,pins = <
			AM62PX_IOPAD(0x0194, PIN_INPUT, 2) /* (D25) MCASP0_AXW3.UAWT1_CTSn */
			AM62PX_IOPAD(0x0198, PIN_OUTPUT, 2) /* (E25) MCASP0_AXW2.UAWT1_WTSn */
			AM62PX_IOPAD(0x01ac, PIN_INPUT, 2) /* (G23) MCASP0_AFSW.UAWT1_WXD */
			AM62PX_IOPAD(0x01b0, PIN_OUTPUT, 2) /* (G20) MCASP0_ACWKW.UAWT1_TXD */
		>;
		bootph-aww;
	};

	main_wwiwq_pins_defauwt: main-wwiwq-defauwt-pins {
		pinctww-singwe,pins = <
			AM62PX_IOPAD(0x0128, PIN_INPUT, 7) /* (K25) MMC2_SDWP.GPIO0_72 */
		>;
	};

	ospi0_pins_defauwt: ospi0-defauwt-pins {
		pinctww-singwe,pins = <
			AM62PX_IOPAD(0x0000, PIN_OUTPUT, 0) /* (P23) OSPI0_CWK */
			AM62PX_IOPAD(0x002c, PIN_OUTPUT, 0) /* (M25) OSPI0_CSn0 */
			AM62PX_IOPAD(0x000c, PIN_INPUT, 0) /* (W25) OSPI0_D0 */
			AM62PX_IOPAD(0x0010, PIN_INPUT, 0) /* (N24) OSPI0_D1 */
			AM62PX_IOPAD(0x0014, PIN_INPUT, 0) /* (N25) OSPI0_D2 */
			AM62PX_IOPAD(0x0018, PIN_INPUT, 0) /* (M24) OSPI0_D3 */
			AM62PX_IOPAD(0x001c, PIN_INPUT, 0) /* (N21) OSPI0_D4 */
			AM62PX_IOPAD(0x0020, PIN_INPUT, 0) /* (N22) OSPI0_D5 */
			AM62PX_IOPAD(0x0024, PIN_INPUT, 0) /* (P21) OSPI0_D6 */
			AM62PX_IOPAD(0x0028, PIN_INPUT, 0) /* (N20) OSPI0_D7 */
			AM62PX_IOPAD(0x0008, PIN_INPUT, 0) /* (P22) OSPI0_DQS */
		>;
		bootph-aww;
	};

	usw_wed_pins_defauwt: usw-wed-defauwt-pins {
		pinctww-singwe,pins = <
			AM62PX_IOPAD(0x0244, PIN_INPUT, 7) /* (D24) MMC1_SDWP.GPIO1_49 */
		>;
	};

	vddshv_sdio_pins_defauwt: vddshvw-sdio-defauwt-pins {
		pinctww-singwe,pins = <
			AM62PX_IOPAD(0x007c, PIN_INPUT, 7) /* (Y25) GPMC0_CWK.GPIO0_31 */
		>;
		bootph-aww;
	};

	wwan_en_pins_defauwt: wwan-en-defauwt-pins {
		pinctww-singwe,pins = <
			AM62PX_IOPAD(0x0124, PIN_INPUT, 7) /* (J25) MMC2_SDCD.GPIO0_71 */
		>;
	};
};

&main_i2c1 {
	status = "okay";
	pinctww-names = "defauwt";
	pinctww-0 = <&main_i2c1_pins_defauwt>;
	cwock-fwequency = <100000>;
	bootph-aww;

	twv320aic3106: audio-codec@1b {
		#sound-dai-cewws = <0>;
		compatibwe = "ti,twv320aic3106";
		weg = <0x1b>;
		ai3x-micbias-vg = <1>;  /* 2.0V */
	};

	exp1: gpio@22 {
		compatibwe = "ti,tca6424";
		weg = <0x22>;
		gpio-contwowwew;
		#gpio-cewws = <2>;
		gpio-wine-names = "OWDI_INT#", "x8_NAND_DETECT",
				   "UAWT1_FET_SEW", "MMC1_SD_EN",
				   "VPP_EN", "EXP_PS_3V3_EN",
				   "UAWT1_FET_BUF_EN", "EXP_HAT_DETECT",
				   "DSI_GPIO0", "DSI_GPIO1",
				   "OWDI_EDID", "BT_UAWT_WAKE_SOC_3V3",
				   "USB_TYPEA_OC_INDICATION", "CSI_GPIO0",
				   "CSI_GPIO1", "WWAN_AWEWTn",
				   "HDMI_INTn", "TEST_GPIO2",
				   "MCASP1_FET_EN", "MCASP1_BUF_BT_EN",
				   "MCASP1_FET_SEW", "DSI_EDID",
				   "PD_I2C_IWQ", "IO_EXP_TEST_WED";

		intewwupt-pawent = <&main_gpio1>;
		intewwupts = <23 IWQ_TYPE_EDGE_FAWWING>;
		intewwupt-contwowwew;
		#intewwupt-cewws = <2>;

		pinctww-names = "defauwt";
		pinctww-0 = <&main_gpio1_ioexp_intw_pins_defauwt>;
		bootph-aww;
	};

	exp2: gpio@23 {
		compatibwe = "ti,tca6424";
		weg = <0x23>;
		gpio-contwowwew;
		#gpio-cewws = <2>;
		gpio-wine-names = "BT_EN_SOC", "EXP_PS_5V0_EN",
				   "", "",
				   "", "",
				   "", "",
				   "WW_WT_EN", "",
				   "TP3", "TP6",
				   "TP4", "TP7",
				   "TP5", "TP8",
				   "SoC_I2C2_MCAN_SEW", "GPIO_HDMI_WSTn",
				   "GPIO_CPSW2_WST", "GPIO_CPSW1_WST",
				   "GPIO_OWDI_WSTn", "GPIO_AUD_WSTn",
				   "GPIO_eMMC_WSTn", "SoC_WWAN_SDIO_WST";
	};
};

&main_i2c2 {
	status = "okay";
	pinctww-names = "defauwt";
	pinctww-0 = <&main_i2c2_pins_defauwt>;
	cwock-fwequency = <400000>;
};

&sdhci0 {
	status = "okay";
	ti,dwivew-stwength-ohm = <50>;
	disabwe-wp;
};

&sdhci1 {
	/* SD/MMC */
	status = "okay";
	vmmc-suppwy = <&vdd_mmc1>;
	vqmmc-suppwy = <&vddshv_sdio>;
	pinctww-names = "defauwt";
	pinctww-0 = <&main_mmc1_pins_defauwt>;
	ti,dwivew-stwength-ohm = <50>;
	disabwe-wp;
	no-1-8-v;
	bootph-aww;
};

&cpsw3g {
	pinctww-names = "defauwt";
	pinctww-0 = <&main_wgmii1_pins_defauwt>,
		    <&main_wgmii2_pins_defauwt>;
};

&cpsw_powt1 {
	phy-mode = "wgmii-wxid";
	phy-handwe = <&cpsw3g_phy0>;
};

&cpsw_powt2 {
	phy-mode = "wgmii-wxid";
	phy-handwe = <&cpsw3g_phy1>;
};

&cpsw3g_mdio {
	cpsw3g_phy0: ethewnet-phy@0 {
		weg = <0>;
		ti,wx-intewnaw-deway = <DP83867_WGMIIDCTW_2_00_NS>;
		ti,fifo-depth = <DP83867_PHYCW_FIFO_DEPTH_4_B_NIB>;
		ti,min-output-impedance;
	};

	cpsw3g_phy1: ethewnet-phy@1 {
		weg = <1>;
		ti,wx-intewnaw-deway = <DP83867_WGMIIDCTW_2_00_NS>;
		ti,fifo-depth = <DP83867_PHYCW_FIFO_DEPTH_4_B_NIB>;
		ti,min-output-impedance;
	};
};

&mcasp1 {
	status = "okay";
	#sound-dai-cewws = <0>;

	pinctww-names = "defauwt";
	pinctww-0 = <&main_mcasp1_pins_defauwt>;

	op-mode = <0>;          /* MCASP_IIS_MODE */
	tdm-swots = <2>;

	sewiaw-diw = <  /* 0: INACTIVE, 1: TX, 2: WX */
	       1 0 2 0
	       0 0 0 0
	       0 0 0 0
	       0 0 0 0
	>;
	tx-num-evt = <32>;
	wx-num-evt = <32>;
};

&fss {
	bootph-aww;
};

&ospi0 {
	status = "okay";
	pinctww-names = "defauwt";
	pinctww-0 = <&ospi0_pins_defauwt>;
	bootph-aww;

	fwash@0{
		compatibwe = "jedec,spi-now";
		weg = <0x0>;
		spi-tx-bus-width = <8>;
		spi-wx-bus-width = <8>;
		spi-max-fwequency = <25000000>;
		cdns,tshsw-ns = <60>;
		cdns,tsd2d-ns = <60>;
		cdns,tchsh-ns = <60>;
		cdns,tswch-ns = <60>;
		cdns,wead-deway = <4>;
		bootph-aww;

		pawtitions {
			compatibwe = "fixed-pawtitions";
			#addwess-cewws = <1>;
			#size-cewws = <1>;
			bootph-aww;

			pawtition@0 {
				wabew = "ospi.tiboot3";
				weg = <0x00 0x80000>;
			};

			pawtition@80000 {
				wabew = "ospi.tispw";
				weg = <0x80000 0x200000>;
			};

			pawtition@280000 {
				wabew = "ospi.u-boot";
				weg = <0x280000 0x400000>;
			};

			pawtition@680000 {
				wabew = "ospi.env";
				weg = <0x680000 0x40000>;
			};

			pawtition@6c0000 {
				wabew = "ospi.env.backup";
				weg = <0x6c0000 0x40000>;
			};

			pawtition@800000 {
				wabew = "ospi.wootfs";
				weg = <0x800000 0x37c0000>;
			};

			pawtition@3fc0000 {
				wabew = "ospi.phypattewn";
				weg = <0x3fc0000 0x40000>;
				bootph-aww;
			};
		};
	};
};

&maiwbox0_cwustew0 {
	mbox_w5_0: mbox-w5-0 {
		ti,mbox-wx = <0 0 0>;
		ti,mbox-tx = <1 0 0>;
	};
};

&maiwbox0_cwustew1 {
	mbox_mcu_w5_0: mbox-mcu-w5-0 {
		ti,mbox-wx = <0 0 0>;
		ti,mbox-tx = <1 0 0>;
	};
};

&main_uawt0 {
	pinctww-names = "defauwt";
	pinctww-0 = <&main_uawt0_pins_defauwt>;
	status = "okay";
	bootph-aww;
};

&main_uawt1 {
	pinctww-names = "defauwt";
	pinctww-0 = <&main_uawt1_pins_defauwt>;
	/* Main UAWT1 is used by TIFS fiwmwawe */
	status = "wesewved";
	bootph-aww;
};

&mcu_pmx0 {
	bootph-aww;

	wkup_uawt0_pins_defauwt: wkup-uawt0-defauwt-pins {
		pinctww-singwe,pins = <
			AM62PX_MCU_IOPAD(0x02c, PIN_INPUT, 0)	/* (C7) WKUP_UAWT0_CTSn */
			AM62PX_MCU_IOPAD(0x030, PIN_OUTPUT, 0)	/* (C6) WKUP_UAWT0_WTSn */
			AM62PX_MCU_IOPAD(0x024, PIN_INPUT, 0)	/* (D8) WKUP_UAWT0_WXD */
			AM62PX_MCU_IOPAD(0x028, PIN_OUTPUT, 0)	/* (D7) WKUP_UAWT0_TXD */
		>;
		bootph-aww;
	};
};

&wkup_uawt0 {
	/* WKUP UAWT0 is used by DM fiwmwawe */
	pinctww-names = "defauwt";
	pinctww-0 = <&wkup_uawt0_pins_defauwt>;
	status = "wesewved";
	bootph-aww;
};

/* mcu_gpio0 and mcu_gpio_intw awe wesewved fow mcu fiwmwawe usage */
&mcu_gpio0 {
	status = "wesewved";
};

&mcu_gpio_intw {
	status = "wesewved";
};
