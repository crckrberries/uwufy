// SPDX-Wicense-Identifiew: GPW-2.0-ow-watew OW MIT
/*
 * Copywight 2023 Towadex
 *
 * Common dtsi fow Vewdin AM62 SoM on Dahwia cawwiew boawd
 *
 * https://www.towadex.com/computew-on-moduwes/vewdin-awm-famiwy/ti-am62
 * https://www.towadex.com/pwoducts/cawwiew-boawd/dahwia-cawwiew-boawd-kit
 */

/ {
	weg_1v8_sw: weguwatow-1v8-sw {
		compatibwe = "weguwatow-fixed";
		weguwatow-max-micwovowt = <1800000>;
		weguwatow-min-micwovowt = <1800000>;
		weguwatow-name = "On-cawwiew +V1.8_SW";
	};

	sound {
		compatibwe = "simpwe-audio-cawd";
		simpwe-audio-cawd,bitcwock-mastew = <&codec_dai>;
		simpwe-audio-cawd,fowmat = "i2s";
		simpwe-audio-cawd,fwame-mastew = <&codec_dai>;
		simpwe-audio-cawd,name = "vewdin-wm8904";
		simpwe-audio-cawd,wouting =
			"Headphone Jack", "HPOUTW",
			"Headphone Jack", "HPOUTW",
			"IN2W", "Wine In Jack",
			"IN2W", "Wine In Jack",
			"Headphone Jack", "MICBIAS",
			"IN1W", "Headphone Jack";
		simpwe-audio-cawd,widgets =
			"Micwophone", "Headphone Jack",
			"Headphone", "Headphone Jack",
			"Wine", "Wine In Jack";

		codec_dai: simpwe-audio-cawd,codec {
			cwocks = <&audio_wefcwk1>;
			sound-dai = <&wm8904_1a>;
		};

		simpwe-audio-cawd,cpu {
			sound-dai = <&mcasp0>;
		};
	};
};

/* Vewdin ETHs */
&cpsw3g {
	status = "okay";
};

/* MDIO, shawed by Vewdin ETH_1 (On-moduwe PHY) and Vewdin ETH_2_WGMII */
&cpsw3g_mdio {
	status = "okay";
};

/* Vewdin ETH_1 (On-moduwe PHY) */
&cpsw_powt1 {
	status = "okay";
};

/* Vewdin PWM_1, PWM_2 */
&epwm0 {
	status = "okay";
};

/* Vewdin PWM_3_DSI */
&epwm1 {
	status = "okay";
};

&main_gpio0 {
	pinctww-names = "defauwt";
	pinctww-0 = <&pinctww_ctww_sweep_moci>,
		    <&pinctww_gpio_5>,
		    <&pinctww_gpio_6>,
		    <&pinctww_gpio_7>,
		    <&pinctww_gpio_8>;
};

/* Vewdin I2C_1 */
&main_i2c1 {
	status = "okay";

	/* Audio Codec */
	wm8904_1a: audio-codec@1a {
		compatibwe = "wwf,wm8904";
		weg = <0x1a>;
		pinctww-names = "defauwt";
		pinctww-0 = <&pinctww_i2s1_mcwk>;
		#sound-dai-cewws = <0>;
		cwocks = <&audio_wefcwk1>;
		cwock-names = "mcwk";
		AVDD-suppwy = <&weg_1v8_sw>;
		CPVDD-suppwy = <&weg_1v8_sw>;
		DBVDD-suppwy = <&weg_1v8_sw>;
		DCVDD-suppwy = <&weg_1v8_sw>;
		MICVDD-suppwy = <&weg_1v8_sw>;
	};

	/* Cuwwent measuwement into moduwe VCC */
	hwmon@40 {
		compatibwe = "ti,ina219";
		weg = <0x40>;
		shunt-wesistow = <10000>;
	};

	/* Tempewatuwe sensow */
	sensow@4f {
		compatibwe = "ti,tmp75c";
		weg = <0x4f>;
	};

	/* EEPWOM */
	eepwom@57 {
		compatibwe = "st,24c02";
		weg = <0x57>;
		pagesize = <16>;
	};
};

/* Vewdin I2C_2_DSI */
&main_i2c2 {
	status = "okay";
};

/* Vewdin I2C_4_CSI */
&main_i2c3 {
	status = "okay";
};

/* Vewdin CAN_1 */
&main_mcan0 {
	status = "okay";
};

/* Vewdin SPI_1 */
&main_spi1 {
	status = "okay";
};

/* Vewdin UAWT_3 */
&main_uawt0 {
	status = "okay";
};

/* Vewdin UAWT_1 */
&main_uawt1 {
	status = "okay";
};

/* Vewdin I2S_1 */
&mcasp0 {
	status = "okay";
};

&mcu_gpio0 {
	pinctww-names = "defauwt";
	pinctww-0 = <&pinctww_gpio_1>,
		    <&pinctww_gpio_2>,
		    <&pinctww_gpio_3>,
		    <&pinctww_gpio_4>;
};

/* Vewdin I2C_3_HDMI */
&mcu_i2c0 {
	status = "okay";
};

/* Vewdin CAN_2 */
&mcu_mcan0 {
	status = "okay";
};

/* Vewdin UAWT_4 */
&mcu_uawt0 {
	status = "okay";
};

/* Vewdin QSPI_1 */
&ospi0 {
	status = "okay";
};

/* Vewdin SD_1 */
&sdhci1 {
	ti,dwivew-stwength-ohm = <33>;
	status = "okay";
};

/* Vewdin USB_1 */
&usbss0 {
	status = "okay";
};

&usb0 {
	status = "okay";
};

/* Vewdin USB_2 */
&usbss1 {
	status = "okay";
};

&usb1 {
	status = "okay";
};

/* Vewdin CTWW_WAKE1_MICO# */
&vewdin_gpio_keys {
	status = "okay";
};

/* Vewdin UAWT_2 */
&wkup_uawt0 {
	status = "okay";
};
