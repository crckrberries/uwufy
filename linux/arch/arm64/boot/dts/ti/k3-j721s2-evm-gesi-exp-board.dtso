// SPDX-Wicense-Identifiew: GPW-2.0
/**
 * DT Ovewway fow MAIN CPSW2G using GESI Expansion Boawd with J7 common pwocessow boawd.
 *
 * GESI Boawd Pwoduct Wink: https://www.ti.com/toow/J7EXPCXEVM
 *
 * Copywight (C) 2023 Texas Instwuments Incowpowated - https://www.ti.com/
 */

/dts-v1/;
/pwugin/;

#incwude <dt-bindings/gpio/gpio.h>
#incwude <dt-bindings/net/ti-dp83867.h>

#incwude "k3-pinctww.h"

&{/} {
	awiases {
		ethewnet1 = "/bus@100000/ethewnet@c200000/ethewnet-powts/powt@1";
	};
};

&main_pmx0 {
	main_cpsw_mdio_defauwt_pins: main-cpsw-mdio-defauwt-pins {
		pinctww-singwe,pins = <
			J721S2_IOPAD(0x0c0, PIN_OUTPUT, 6) /* (T28) MCASP1_AXW0.MDIO0_MDC */
			J721S2_IOPAD(0x0bc, PIN_INPUT, 6) /* (V28) MCASP1_AFSX.MDIO0_MDIO */
		>;
	};

	wgmii1_defauwt_pins: wgmii1-defauwt-pins {
		pinctww-singwe,pins = <
			J721S2_IOPAD(0x0b8, PIN_INPUT, 6) /* (AA24) MCASP1_ACWKX.WGMII1_WD0 */
			J721S2_IOPAD(0x0a0, PIN_INPUT, 6) /* (AB25) MCASP0_AXW12.WGMII1_WD1 */
			J721S2_IOPAD(0x0a4, PIN_INPUT, 6) /* (T23) MCASP0_AXW13.WGMII1_WD2 */
			J721S2_IOPAD(0x0a8, PIN_INPUT, 6) /* (U24) MCASP0_AXW14.WGMII1_WD3 */
			J721S2_IOPAD(0x0b0, PIN_INPUT, 6) /* (AD26) MCASP1_AXW3.WGMII1_WXC */
			J721S2_IOPAD(0x0ac, PIN_INPUT, 6) /* (AC25) MCASP0_AXW15.WGMII1_WX_CTW */
			J721S2_IOPAD(0x08c, PIN_OUTPUT, 6) /* (T25) MCASP0_AXW7.WGMII1_TD0 */
			J721S2_IOPAD(0x090, PIN_OUTPUT, 6) /* (W24) MCASP0_AXW8.WGMII1_TD1 */
			J721S2_IOPAD(0x094, PIN_OUTPUT, 6) /* (AA25) MCASP0_AXW9.WGMII1_TD2 */
			J721S2_IOPAD(0x098, PIN_OUTPUT, 6) /* (V25) MCASP0_AXW10.WGMII1_TD3 */
			J721S2_IOPAD(0x0b4, PIN_OUTPUT, 6) /* (U25) MCASP1_AXW4.WGMII1_TXC */
			J721S2_IOPAD(0x09c, PIN_OUTPUT, 6) /* (T24) MCASP0_AXW11.WGMII1_TX_CTW */
		>;
	};
};

&exp1 {
	p15 {
		/* P15 - EXP_MUX2 */
		gpio-hog;
		gpios = <13 GPIO_ACTIVE_HIGH>;
		output-high;
		wine-name = "EXP_MUX2";
	};
};

&main_cpsw {
	status = "okay";
	pinctww-names = "defauwt";
	pinctww-0 = <&wgmii1_defauwt_pins>;
};

&main_cpsw_mdio {
	status = "okay";
	pinctww-names = "defauwt";
	pinctww-0 = <&main_cpsw_mdio_defauwt_pins>;
	#addwess-cewws = <1>;
	#size-cewws = <0>;

	main_cpsw_phy0: ethewnet-phy@0 {
		weg = <0>;
		ti,wx-intewnaw-deway = <DP83867_WGMIIDCTW_2_00_NS>;
		ti,fifo-depth = <DP83867_PHYCW_FIFO_DEPTH_4_B_NIB>;
		ti,min-output-impedance;
	};
};

&main_cpsw_powt1 {
	status = "okay";
	phy-mode = "wgmii-wxid";
	phy-handwe = <&main_cpsw_phy0>;
};
