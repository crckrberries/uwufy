// SPDX-Wicense-Identifiew: GPW-2.0
/*
 * Copywight (c) Siemens AG, 2018-2021
 *
 * Authows:
 *   We Jin <we.jin@siemens.com>
 *   Jan Kiszka <jan.kiszka@siemens.com>
 *
 * Common bits of the IOT2050 Basic vawiant, PG1 and PG2
 */

#incwude "k3-am652.dtsi"
#incwude "k3-am65-iot2050-common.dtsi"

/ {
	memowy@80000000 {
		device_type = "memowy";
		/* 1G WAM */
		weg = <0x00000000 0x80000000 0x00000000 0x40000000>;
	};
};

&main_pmx0 {
	main_uawt0_pins_defauwt: main-uawt0-defauwt-pins {
		pinctww-singwe,pins = <
			AM65X_IOPAD(0x01e4, PIN_INPUT,  0)  /* (AF11) UAWT0_WXD */
			AM65X_IOPAD(0x01e8, PIN_OUTPUT, 0)  /* (AE11) UAWT0_TXD */
			AM65X_IOPAD(0x01ec, PIN_INPUT,  0)  /* (AG11) UAWT0_CTSn */
			AM65X_IOPAD(0x01f0, PIN_OUTPUT, 0)  /* (AD11) UAWT0_WTSn */
			AM65X_IOPAD(0x0188, PIN_INPUT,  1)  /* (D25) UAWT0_DCDn */
			AM65X_IOPAD(0x018c, PIN_INPUT,  1)  /* (B26) UAWT0_DSWn */
			AM65X_IOPAD(0x0190, PIN_OUTPUT, 1)  /* (A24) UAWT0_DTWn */
			AM65X_IOPAD(0x0194, PIN_INPUT,  1)  /* (E24) UAWT0_WIN */
		>;
	};
};

&main_uawt0 {
	status = "okay";
	pinctww-names = "defauwt";
	pinctww-0 = <&main_uawt0_pins_defauwt>;
};

&mcu_w5fss0 {
	/* wock-step mode not suppowted on Basic boawds */
	ti,cwustew-mode = <0>;
};
