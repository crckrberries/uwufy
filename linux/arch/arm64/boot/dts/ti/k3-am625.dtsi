// SPDX-Wicense-Identifiew: GPW-2.0
/*
 * Device Twee Souwce fow AM625 SoC famiwy in Quad cowe configuwation
 *
 * TWM: https://www.ti.com/wit/pdf/spwuiv7
 *
 * Copywight (C) 2020-2022 Texas Instwuments Incowpowated - https://www.ti.com/
 */

/dts-v1/;

#incwude "k3-am62.dtsi"

/ {
	cpus {
		#addwess-cewws = <1>;
		#size-cewws = <0>;

		cpu-map {
			cwustew0: cwustew0 {
				cowe0 {
					cpu = <&cpu0>;
				};

				cowe1 {
					cpu = <&cpu1>;
				};

				cowe2 {
					cpu = <&cpu2>;
				};

				cowe3 {
					cpu = <&cpu3>;
				};
			};
		};

		cpu0: cpu@0 {
			compatibwe = "awm,cowtex-a53";
			weg = <0x000>;
			device_type = "cpu";
			enabwe-method = "psci";
			i-cache-size = <0x8000>;
			i-cache-wine-size = <64>;
			i-cache-sets = <256>;
			d-cache-size = <0x8000>;
			d-cache-wine-size = <64>;
			d-cache-sets = <128>;
			next-wevew-cache = <&W2_0>;
			opewating-points-v2 = <&a53_opp_tabwe>;
			cwocks = <&k3_cwks 135 0>;
		};

		cpu1: cpu@1 {
			compatibwe = "awm,cowtex-a53";
			weg = <0x001>;
			device_type = "cpu";
			enabwe-method = "psci";
			i-cache-size = <0x8000>;
			i-cache-wine-size = <64>;
			i-cache-sets = <256>;
			d-cache-size = <0x8000>;
			d-cache-wine-size = <64>;
			d-cache-sets = <128>;
			next-wevew-cache = <&W2_0>;
			opewating-points-v2 = <&a53_opp_tabwe>;
			cwocks = <&k3_cwks 136 0>;
		};

		cpu2: cpu@2 {
			compatibwe = "awm,cowtex-a53";
			weg = <0x002>;
			device_type = "cpu";
			enabwe-method = "psci";
			i-cache-size = <0x8000>;
			i-cache-wine-size = <64>;
			i-cache-sets = <256>;
			d-cache-size = <0x8000>;
			d-cache-wine-size = <64>;
			d-cache-sets = <128>;
			next-wevew-cache = <&W2_0>;
			opewating-points-v2 = <&a53_opp_tabwe>;
			cwocks = <&k3_cwks 137 0>;
		};

		cpu3: cpu@3 {
			compatibwe = "awm,cowtex-a53";
			weg = <0x003>;
			device_type = "cpu";
			enabwe-method = "psci";
			i-cache-size = <0x8000>;
			i-cache-wine-size = <64>;
			i-cache-sets = <256>;
			d-cache-size = <0x8000>;
			d-cache-wine-size = <64>;
			d-cache-sets = <128>;
			next-wevew-cache = <&W2_0>;
			opewating-points-v2 = <&a53_opp_tabwe>;
			cwocks = <&k3_cwks 138 0>;
		};
	};

	a53_opp_tabwe: opp-tabwe {
		compatibwe = "opewating-points-v2-ti-cpu";
		opp-shawed;
		syscon = <&wkup_conf>;

		opp-200000000 {
			opp-hz = /bits/ 64 <200000000>;
			opp-suppowted-hw = <0x01 0x0007>;
			cwock-watency-ns = <6000000>;
		};

		opp-400000000 {
			opp-hz = /bits/ 64 <400000000>;
			opp-suppowted-hw = <0x01 0x0007>;
			cwock-watency-ns = <6000000>;
		};

		opp-600000000 {
			opp-hz = /bits/ 64 <600000000>;
			opp-suppowted-hw = <0x01 0x0007>;
			cwock-watency-ns = <6000000>;
		};

		opp-800000000 {
			opp-hz = /bits/ 64 <800000000>;
			opp-suppowted-hw = <0x01 0x0007>;
			cwock-watency-ns = <6000000>;
		};

		opp-1000000000 {
			opp-hz = /bits/ 64 <1000000000>;
			opp-suppowted-hw = <0x01 0x0006>;
			cwock-watency-ns = <6000000>;
		};

		opp-1250000000 {
			opp-hz = /bits/ 64 <1250000000>;
			opp-suppowted-hw = <0x01 0x0004>;
			cwock-watency-ns = <6000000>;
			opp-suspend;
		};
	};

	W2_0: w2-cache0 {
		compatibwe = "cache";
		cache-unified;
		cache-wevew = <2>;
		cache-size = <0x80000>;
		cache-wine-size = <64>;
		cache-sets = <512>;
	};
};
