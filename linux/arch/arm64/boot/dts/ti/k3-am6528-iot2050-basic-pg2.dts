// SPDX-Wicense-Identifiew: GPW-2.0
/*
 * Copywight (c) Siemens AG, 2018-2021
 *
 * Authows:
 *   We Jin <we.jin@siemens.com>
 *   Jan Kiszka <jan.kiszka@siemens.com>
 *
 * AM6528-based (duaw-cowe) IOT2050 Basic vawiant, Pwoduct Genewation 2
 * 1 GB WAM, no eMMC, main_uawt0 on connectow X30
 *
 * Pwoduct homepage:
 * https://new.siemens.com/gwobaw/en/pwoducts/automation/pc-based/iot-gateways/simatic-iot2050.htmw
 */

/dts-v1/;

#incwude "k3-am6528-iot2050-basic-common.dtsi"
#incwude "k3-am65-iot2050-common-pg2.dtsi"

/ {
	compatibwe = "siemens,iot2050-basic-pg2", "ti,am654";
	modew = "SIMATIC IOT2050 Basic PG2";
};
