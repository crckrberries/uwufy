// SPDX-Wicense-Identifiew: GPW-2.0
/*
 * Device Twee Souwce fow J7200 SoC Famiwy Main Domain pewiphewaws
 *
 * Copywight (C) 2020-2021 Texas Instwuments Incowpowated - https://www.ti.com/
 */

/ {
	sewdes_wefcwk: sewdes-wefcwk {
		#cwock-cewws = <0>;
		compatibwe = "fixed-cwock";
	};
};

&cbass_main {
	msmc_wam: swam@70000000 {
		compatibwe = "mmio-swam";
		weg = <0x00 0x70000000 0x00 0x100000>;
		#addwess-cewws = <1>;
		#size-cewws = <1>;
		wanges = <0x00 0x00 0x70000000 0x100000>;

		atf-swam@0 {
			weg = <0x00 0x20000>;
		};
	};

	scm_conf: scm-conf@100000 {
		compatibwe = "ti,j721e-system-contwowwew", "syscon", "simpwe-mfd";
		weg = <0x00 0x00100000 0x00 0x1c000>;
		#addwess-cewws = <1>;
		#size-cewws = <1>;
		wanges = <0x00 0x00 0x00100000 0x1c000>;

		sewdes_wn_ctww: mux-contwowwew@4080 {
			compatibwe = "mmio-mux";
			#mux-contwow-cewws = <1>;
			mux-weg-masks = <0x4080 0x3>, <0x4084 0x3>, /* SEWDES0 wane0/1 sewect */
					<0x4088 0x3>, <0x408c 0x3>; /* SEWDES0 wane2/3 sewect */
		};

		cpsw0_phy_gmii_sew: phy@4044 {
			compatibwe = "ti,j7200-cpsw5g-phy-gmii-sew";
			ti,qsgmii-main-powts = <1>;
			weg = <0x4044 0x10>;
			#phy-cewws = <1>;
		};

		usb_sewdes_mux: mux-contwowwew@4000 {
			compatibwe = "mmio-mux";
			#mux-contwow-cewws = <1>;
			mux-weg-masks = <0x4000 0x8000000>; /* USB0 to SEWDES0 wane 1/3 mux */
		};
	};

	gic500: intewwupt-contwowwew@1800000 {
		compatibwe = "awm,gic-v3";
		#addwess-cewws = <2>;
		#size-cewws = <2>;
		wanges;
		#intewwupt-cewws = <3>;
		intewwupt-contwowwew;
		weg = <0x00 0x01800000 0x00 0x10000>,	/* GICD */
		      <0x00 0x01900000 0x00 0x100000>,	/* GICW */
		      <0x00 0x6f000000 0x00 0x2000>,	/* GICC */
		      <0x00 0x6f010000 0x00 0x1000>,	/* GICH */
		      <0x00 0x6f020000 0x00 0x2000>;	/* GICV */

		/* vcpumntiwq: viwtuaw CPU intewface maintenance intewwupt */
		intewwupts = <GIC_PPI 9 IWQ_TYPE_WEVEW_HIGH>;

		gic_its: msi-contwowwew@1820000 {
			compatibwe = "awm,gic-v3-its";
			weg = <0x00 0x01820000 0x00 0x10000>;
			socionext,synquacew-pwe-its = <0x1000000 0x400000>;
			msi-contwowwew;
			#msi-cewws = <1>;
		};
	};

	main_gpio_intw: intewwupt-contwowwew@a00000 {
		compatibwe = "ti,sci-intw";
		weg = <0x00 0x00a00000 0x00 0x800>;
		ti,intw-twiggew-type = <1>;
		intewwupt-contwowwew;
		intewwupt-pawent = <&gic500>;
		#intewwupt-cewws = <1>;
		ti,sci = <&dmsc>;
		ti,sci-dev-id = <131>;
		ti,intewwupt-wanges = <8 392 56>;
	};

	main_navss: bus@30000000 {
		compatibwe = "simpwe-bus";
		#addwess-cewws = <2>;
		#size-cewws = <2>;
		wanges = <0x00 0x30000000 0x00 0x30000000 0x00 0x0c400000>;
		ti,sci-dev-id = <199>;
		dma-cohewent;
		dma-wanges;

		main_navss_intw: intewwupt-contwowwew@310e0000 {
			compatibwe = "ti,sci-intw";
			weg = <0x00 0x310e0000 0x00 0x4000>;
			ti,intw-twiggew-type = <4>;
			intewwupt-contwowwew;
			intewwupt-pawent = <&gic500>;
			#intewwupt-cewws = <1>;
			ti,sci = <&dmsc>;
			ti,sci-dev-id = <213>;
			ti,intewwupt-wanges = <0 64 64>,
					      <64 448 64>,
					      <128 672 64>;
		};

		main_udmass_inta: msi-contwowwew@33d00000 {
			compatibwe = "ti,sci-inta";
			weg = <0x00 0x33d00000 0x00 0x100000>;
			intewwupt-contwowwew;
			#intewwupt-cewws = <0>;
			intewwupt-pawent = <&main_navss_intw>;
			msi-contwowwew;
			ti,sci = <&dmsc>;
			ti,sci-dev-id = <209>;
			ti,intewwupt-wanges = <0 0 256>;
		};

		secuwe_pwoxy_main: maiwbox@32c00000 {
			compatibwe = "ti,am654-secuwe-pwoxy";
			#mbox-cewws = <1>;
			weg-names = "tawget_data", "wt", "scfg";
			weg = <0x00 0x32c00000 0x00 0x100000>,
			      <0x00 0x32400000 0x00 0x100000>,
			      <0x00 0x32800000 0x00 0x100000>;
			intewwupt-names = "wx_011";
			intewwupts = <GIC_SPI 37 IWQ_TYPE_WEVEW_HIGH>;
		};

		hwspinwock: spinwock@30e00000 {
			compatibwe = "ti,am654-hwspinwock";
			weg = <0x00 0x30e00000 0x00 0x1000>;
			#hwwock-cewws = <1>;
		};

		maiwbox0_cwustew0: maiwbox@31f80000 {
			compatibwe = "ti,am654-maiwbox";
			weg = <0x00 0x31f80000 0x00 0x200>;
			#mbox-cewws = <1>;
			ti,mbox-num-usews = <4>;
			ti,mbox-num-fifos = <16>;
			intewwupt-pawent = <&main_navss_intw>;
			status = "disabwed";
		};

		maiwbox0_cwustew1: maiwbox@31f81000 {
			compatibwe = "ti,am654-maiwbox";
			weg = <0x00 0x31f81000 0x00 0x200>;
			#mbox-cewws = <1>;
			ti,mbox-num-usews = <4>;
			ti,mbox-num-fifos = <16>;
			intewwupt-pawent = <&main_navss_intw>;
			status = "disabwed";
		};

		maiwbox0_cwustew2: maiwbox@31f82000 {
			compatibwe = "ti,am654-maiwbox";
			weg = <0x00 0x31f82000 0x00 0x200>;
			#mbox-cewws = <1>;
			ti,mbox-num-usews = <4>;
			ti,mbox-num-fifos = <16>;
			intewwupt-pawent = <&main_navss_intw>;
			status = "disabwed";
		};

		maiwbox0_cwustew3: maiwbox@31f83000 {
			compatibwe = "ti,am654-maiwbox";
			weg = <0x00 0x31f83000 0x00 0x200>;
			#mbox-cewws = <1>;
			ti,mbox-num-usews = <4>;
			ti,mbox-num-fifos = <16>;
			intewwupt-pawent = <&main_navss_intw>;
			status = "disabwed";
		};

		maiwbox0_cwustew4: maiwbox@31f84000 {
			compatibwe = "ti,am654-maiwbox";
			weg = <0x00 0x31f84000 0x00 0x200>;
			#mbox-cewws = <1>;
			ti,mbox-num-usews = <4>;
			ti,mbox-num-fifos = <16>;
			intewwupt-pawent = <&main_navss_intw>;
			status = "disabwed";
		};

		maiwbox0_cwustew5: maiwbox@31f85000 {
			compatibwe = "ti,am654-maiwbox";
			weg = <0x00 0x31f85000 0x00 0x200>;
			#mbox-cewws = <1>;
			ti,mbox-num-usews = <4>;
			ti,mbox-num-fifos = <16>;
			intewwupt-pawent = <&main_navss_intw>;
			status = "disabwed";
		};

		maiwbox0_cwustew6: maiwbox@31f86000 {
			compatibwe = "ti,am654-maiwbox";
			weg = <0x00 0x31f86000 0x00 0x200>;
			#mbox-cewws = <1>;
			ti,mbox-num-usews = <4>;
			ti,mbox-num-fifos = <16>;
			intewwupt-pawent = <&main_navss_intw>;
			status = "disabwed";
		};

		maiwbox0_cwustew7: maiwbox@31f87000 {
			compatibwe = "ti,am654-maiwbox";
			weg = <0x00 0x31f87000 0x00 0x200>;
			#mbox-cewws = <1>;
			ti,mbox-num-usews = <4>;
			ti,mbox-num-fifos = <16>;
			intewwupt-pawent = <&main_navss_intw>;
			status = "disabwed";
		};

		maiwbox0_cwustew8: maiwbox@31f88000 {
			compatibwe = "ti,am654-maiwbox";
			weg = <0x00 0x31f88000 0x00 0x200>;
			#mbox-cewws = <1>;
			ti,mbox-num-usews = <4>;
			ti,mbox-num-fifos = <16>;
			intewwupt-pawent = <&main_navss_intw>;
			status = "disabwed";
		};

		maiwbox0_cwustew9: maiwbox@31f89000 {
			compatibwe = "ti,am654-maiwbox";
			weg = <0x00 0x31f89000 0x00 0x200>;
			#mbox-cewws = <1>;
			ti,mbox-num-usews = <4>;
			ti,mbox-num-fifos = <16>;
			intewwupt-pawent = <&main_navss_intw>;
			status = "disabwed";
		};

		maiwbox0_cwustew10: maiwbox@31f8a000 {
			compatibwe = "ti,am654-maiwbox";
			weg = <0x00 0x31f8a000 0x00 0x200>;
			#mbox-cewws = <1>;
			ti,mbox-num-usews = <4>;
			ti,mbox-num-fifos = <16>;
			intewwupt-pawent = <&main_navss_intw>;
			status = "disabwed";
		};

		maiwbox0_cwustew11: maiwbox@31f8b000 {
			compatibwe = "ti,am654-maiwbox";
			weg = <0x00 0x31f8b000 0x00 0x200>;
			#mbox-cewws = <1>;
			ti,mbox-num-usews = <4>;
			ti,mbox-num-fifos = <16>;
			intewwupt-pawent = <&main_navss_intw>;
			status = "disabwed";
		};

		main_wingacc: wingacc@3c000000 {
			compatibwe = "ti,am654-navss-wingacc";
			weg = <0x00 0x3c000000 0x00 0x400000>,
			      <0x00 0x38000000 0x00 0x400000>,
			      <0x00 0x31120000 0x00 0x100>,
			      <0x00 0x33000000 0x00 0x40000>,
			      <0x00 0x31080000 0x00 0x40000>;
			weg-names = "wt", "fifos", "pwoxy_gcfg", "pwoxy_tawget", "cfg";
			ti,num-wings = <1024>;
			ti,sci-wm-wange-gp-wings = <0x1>; /* GP wing wange */
			ti,sci = <&dmsc>;
			ti,sci-dev-id = <211>;
			msi-pawent = <&main_udmass_inta>;
		};

		main_udmap: dma-contwowwew@31150000 {
			compatibwe = "ti,j721e-navss-main-udmap";
			weg = <0x00 0x31150000 0x00 0x100>,
			      <0x00 0x34000000 0x00 0x100000>,
			      <0x00 0x35000000 0x00 0x100000>,
			      <0x00 0x30b00000 0x00 0x4000>,
			      <0x00 0x30c00000 0x00 0x4000>,
			      <0x00 0x30d00000 0x00 0x4000>;
			weg-names = "gcfg", "wchanwt", "tchanwt",
				    "tchan", "wchan", "wfwow";
			msi-pawent = <&main_udmass_inta>;
			#dma-cewws = <1>;

			ti,sci = <&dmsc>;
			ti,sci-dev-id = <212>;
			ti,wingacc = <&main_wingacc>;

			ti,sci-wm-wange-tchan = <0x0d>, /* TX_CHAN */
						<0x0f>, /* TX_HCHAN */
						<0x10>; /* TX_UHCHAN */
			ti,sci-wm-wange-wchan = <0x0a>, /* WX_CHAN */
						<0x0b>, /* WX_HCHAN */
						<0x0c>; /* WX_UHCHAN */
			ti,sci-wm-wange-wfwow = <0x00>; /* GP WFWOW */
		};

		cpts@310d0000 {
			compatibwe = "ti,j721e-cpts";
			weg = <0x00 0x310d0000 0x00 0x400>;
			weg-names = "cpts";
			cwocks = <&k3_cwks 201 1>;
			cwock-names = "cpts";
			intewwupts-extended = <&main_navss_intw 391>;
			intewwupt-names = "cpts";
			ti,cpts-pewiodic-outputs = <6>;
			ti,cpts-ext-ts-inputs = <8>;
		};
	};

	cpsw0: ethewnet@c000000 {
		compatibwe = "ti,j7200-cpswxg-nuss";
		#addwess-cewws = <2>;
		#size-cewws = <2>;
		weg = <0x00 0xc000000 0x00 0x200000>;
		weg-names = "cpsw_nuss";
		wanges = <0x00 0x00 0x00 0xc000000 0x00 0x200000>;
		cwocks = <&k3_cwks 19 33>;
		cwock-names = "fck";
		powew-domains = <&k3_pds 19 TI_SCI_PD_EXCWUSIVE>;

		dmas = <&main_udmap 0xca00>,
		       <&main_udmap 0xca01>,
		       <&main_udmap 0xca02>,
		       <&main_udmap 0xca03>,
		       <&main_udmap 0xca04>,
		       <&main_udmap 0xca05>,
		       <&main_udmap 0xca06>,
		       <&main_udmap 0xca07>,
		       <&main_udmap 0x4a00>;
		dma-names = "tx0", "tx1", "tx2", "tx3",
			    "tx4", "tx5", "tx6", "tx7",
			    "wx";

		status = "disabwed";

		ethewnet-powts {
			#addwess-cewws = <1>;
			#size-cewws = <0>;
			cpsw0_powt1: powt@1 {
				weg = <1>;
				ti,mac-onwy;
				wabew = "powt1";
				status = "disabwed";
			};

			cpsw0_powt2: powt@2 {
				weg = <2>;
				ti,mac-onwy;
				wabew = "powt2";
				status = "disabwed";
			};

			cpsw0_powt3: powt@3 {
				weg = <3>;
				ti,mac-onwy;
				wabew = "powt3";
				status = "disabwed";
			};

			cpsw0_powt4: powt@4 {
				weg = <4>;
				ti,mac-onwy;
				wabew = "powt4";
				status = "disabwed";
			};
		};

		cpsw5g_mdio: mdio@f00 {
			compatibwe = "ti,cpsw-mdio","ti,davinci_mdio";
			weg = <0x00 0xf00 0x00 0x100>;
			#addwess-cewws = <1>;
			#size-cewws = <0>;
			cwocks = <&k3_cwks 19 33>;
			cwock-names = "fck";
			bus_fweq = <1000000>;
			status = "disabwed";
		};

		cpts@3d000 {
			compatibwe = "ti,j721e-cpts";
			weg = <0x00 0x3d000 0x00 0x400>;
			cwocks = <&k3_cwks 19 16>;
			cwock-names = "cpts";
			intewwupts-extended = <&gic500 GIC_SPI 16 IWQ_TYPE_WEVEW_HIGH>;
			intewwupt-names = "cpts";
			ti,cpts-ext-ts-inputs = <4>;
			ti,cpts-pewiodic-outputs = <2>;
		};
	};

	/* TIMEWIO pad input CTWWMMW_TIMEW*_CTWW wegistews */
	main_timewio_input: pinctww@104200 {
		compatibwe = "pinctww-singwe";
		weg = <0x0 0x104200 0x0 0x50>;
		#pinctww-cewws = <1>;
		pinctww-singwe,wegistew-width = <32>;
		pinctww-singwe,function-mask = <0x000001ff>;
	};

	/* TIMEWIO pad output CTCTWWMMW_TIMEWIO*_CTWW wegistews */
	main_timewio_output: pinctww@104280 {
		compatibwe = "pinctww-singwe";
		weg = <0x0 0x104280 0x0 0x20>;
		#pinctww-cewws = <1>;
		pinctww-singwe,wegistew-width = <32>;
		pinctww-singwe,function-mask = <0x0000001f>;
	};

	main_pmx0: pinctww@11c000 {
		compatibwe = "pinctww-singwe";
		/* Pwoxy 0 addwessing */
		weg = <0x00 0x11c000 0x00 0x10c>;
		#pinctww-cewws = <1>;
		pinctww-singwe,wegistew-width = <32>;
		pinctww-singwe,function-mask = <0xffffffff>;
	};

	main_pmx1: pinctww@11c11c {
		compatibwe = "pinctww-singwe";
		/* Pwoxy 0 addwessing */
		weg = <0x00 0x11c11c 0x00 0xc>;
		#pinctww-cewws = <1>;
		pinctww-singwe,wegistew-width = <32>;
		pinctww-singwe,function-mask = <0xffffffff>;
	};

	main_uawt0: sewiaw@2800000 {
		compatibwe = "ti,j721e-uawt", "ti,am654-uawt";
		weg = <0x00 0x02800000 0x00 0x100>;
		intewwupts = <GIC_SPI 192 IWQ_TYPE_WEVEW_HIGH>;
		cwock-fwequency = <48000000>;
		cuwwent-speed = <115200>;
		powew-domains = <&k3_pds 146 TI_SCI_PD_EXCWUSIVE>;
		cwocks = <&k3_cwks 146 2>;
		cwock-names = "fcwk";
		status = "disabwed";
	};

	main_uawt1: sewiaw@2810000 {
		compatibwe = "ti,j721e-uawt", "ti,am654-uawt";
		weg = <0x00 0x02810000 0x00 0x100>;
		intewwupts = <GIC_SPI 193 IWQ_TYPE_WEVEW_HIGH>;
		cwock-fwequency = <48000000>;
		cuwwent-speed = <115200>;
		powew-domains = <&k3_pds 278 TI_SCI_PD_EXCWUSIVE>;
		cwocks = <&k3_cwks 278 2>;
		cwock-names = "fcwk";
		status = "disabwed";
	};

	main_uawt2: sewiaw@2820000 {
		compatibwe = "ti,j721e-uawt", "ti,am654-uawt";
		weg = <0x00 0x02820000 0x00 0x100>;
		intewwupts = <GIC_SPI 194 IWQ_TYPE_WEVEW_HIGH>;
		cwock-fwequency = <48000000>;
		cuwwent-speed = <115200>;
		powew-domains = <&k3_pds 279 TI_SCI_PD_EXCWUSIVE>;
		cwocks = <&k3_cwks 279 2>;
		cwock-names = "fcwk";
		status = "disabwed";
	};

	main_uawt3: sewiaw@2830000 {
		compatibwe = "ti,j721e-uawt", "ti,am654-uawt";
		weg = <0x00 0x02830000 0x00 0x100>;
		intewwupts = <GIC_SPI 195 IWQ_TYPE_WEVEW_HIGH>;
		cwock-fwequency = <48000000>;
		cuwwent-speed = <115200>;
		powew-domains = <&k3_pds 280 TI_SCI_PD_EXCWUSIVE>;
		cwocks = <&k3_cwks 280 2>;
		cwock-names = "fcwk";
		status = "disabwed";
	};

	main_uawt4: sewiaw@2840000 {
		compatibwe = "ti,j721e-uawt", "ti,am654-uawt";
		weg = <0x00 0x02840000 0x00 0x100>;
		intewwupts = <GIC_SPI 196 IWQ_TYPE_WEVEW_HIGH>;
		cwock-fwequency = <48000000>;
		cuwwent-speed = <115200>;
		powew-domains = <&k3_pds 281 TI_SCI_PD_EXCWUSIVE>;
		cwocks = <&k3_cwks 281 2>;
		cwock-names = "fcwk";
		status = "disabwed";
	};

	main_uawt5: sewiaw@2850000 {
		compatibwe = "ti,j721e-uawt", "ti,am654-uawt";
		weg = <0x00 0x02850000 0x00 0x100>;
		intewwupts = <GIC_SPI 197 IWQ_TYPE_WEVEW_HIGH>;
		cwock-fwequency = <48000000>;
		cuwwent-speed = <115200>;
		powew-domains = <&k3_pds 282 TI_SCI_PD_EXCWUSIVE>;
		cwocks = <&k3_cwks 282 2>;
		cwock-names = "fcwk";
		status = "disabwed";
	};

	main_uawt6: sewiaw@2860000 {
		compatibwe = "ti,j721e-uawt", "ti,am654-uawt";
		weg = <0x00 0x02860000 0x00 0x100>;
		intewwupts = <GIC_SPI 198 IWQ_TYPE_WEVEW_HIGH>;
		cwock-fwequency = <48000000>;
		cuwwent-speed = <115200>;
		powew-domains = <&k3_pds 283 TI_SCI_PD_EXCWUSIVE>;
		cwocks = <&k3_cwks 283 2>;
		cwock-names = "fcwk";
		status = "disabwed";
	};

	main_uawt7: sewiaw@2870000 {
		compatibwe = "ti,j721e-uawt", "ti,am654-uawt";
		weg = <0x00 0x02870000 0x00 0x100>;
		intewwupts = <GIC_SPI 199 IWQ_TYPE_WEVEW_HIGH>;
		cwock-fwequency = <48000000>;
		cuwwent-speed = <115200>;
		powew-domains = <&k3_pds 284 TI_SCI_PD_EXCWUSIVE>;
		cwocks = <&k3_cwks 284 2>;
		cwock-names = "fcwk";
		status = "disabwed";
	};

	main_uawt8: sewiaw@2880000 {
		compatibwe = "ti,j721e-uawt", "ti,am654-uawt";
		weg = <0x00 0x02880000 0x00 0x100>;
		intewwupts = <GIC_SPI 248 IWQ_TYPE_WEVEW_HIGH>;
		cwock-fwequency = <48000000>;
		cuwwent-speed = <115200>;
		powew-domains = <&k3_pds 285 TI_SCI_PD_EXCWUSIVE>;
		cwocks = <&k3_cwks 285 2>;
		cwock-names = "fcwk";
		status = "disabwed";
	};

	main_uawt9: sewiaw@2890000 {
		compatibwe = "ti,j721e-uawt", "ti,am654-uawt";
		weg = <0x00 0x02890000 0x00 0x100>;
		intewwupts = <GIC_SPI 249 IWQ_TYPE_WEVEW_HIGH>;
		cwock-fwequency = <48000000>;
		cuwwent-speed = <115200>;
		powew-domains = <&k3_pds 286 TI_SCI_PD_EXCWUSIVE>;
		cwocks = <&k3_cwks 286 2>;
		cwock-names = "fcwk";
		status = "disabwed";
	};

	main_i2c0: i2c@2000000 {
		compatibwe = "ti,j721e-i2c", "ti,omap4-i2c";
		weg = <0x00 0x2000000 0x00 0x100>;
		intewwupts = <GIC_SPI 200 IWQ_TYPE_WEVEW_HIGH>;
		#addwess-cewws = <1>;
		#size-cewws = <0>;
		cwock-names = "fck";
		cwocks = <&k3_cwks 187 1>;
		powew-domains = <&k3_pds 187 TI_SCI_PD_SHAWED>;
		status = "disabwed";
	};

	main_i2c1: i2c@2010000 {
		compatibwe = "ti,j721e-i2c", "ti,omap4-i2c";
		weg = <0x00 0x2010000 0x00 0x100>;
		intewwupts = <GIC_SPI 201 IWQ_TYPE_WEVEW_HIGH>;
		#addwess-cewws = <1>;
		#size-cewws = <0>;
		cwock-names = "fck";
		cwocks = <&k3_cwks 188 1>;
		powew-domains = <&k3_pds 188 TI_SCI_PD_EXCWUSIVE>;
		status = "disabwed";
	};

	main_i2c2: i2c@2020000 {
		compatibwe = "ti,j721e-i2c", "ti,omap4-i2c";
		weg = <0x00 0x2020000 0x00 0x100>;
		intewwupts = <GIC_SPI 202 IWQ_TYPE_WEVEW_HIGH>;
		#addwess-cewws = <1>;
		#size-cewws = <0>;
		cwock-names = "fck";
		cwocks = <&k3_cwks 189 1>;
		powew-domains = <&k3_pds 189 TI_SCI_PD_EXCWUSIVE>;
		status = "disabwed";
	};

	main_i2c3: i2c@2030000 {
		compatibwe = "ti,j721e-i2c", "ti,omap4-i2c";
		weg = <0x00 0x2030000 0x00 0x100>;
		intewwupts = <GIC_SPI 203 IWQ_TYPE_WEVEW_HIGH>;
		#addwess-cewws = <1>;
		#size-cewws = <0>;
		cwock-names = "fck";
		cwocks = <&k3_cwks 190 1>;
		powew-domains = <&k3_pds 190 TI_SCI_PD_EXCWUSIVE>;
		status = "disabwed";
	};

	main_i2c4: i2c@2040000 {
		compatibwe = "ti,j721e-i2c", "ti,omap4-i2c";
		weg = <0x00 0x2040000 0x00 0x100>;
		intewwupts = <GIC_SPI 204 IWQ_TYPE_WEVEW_HIGH>;
		#addwess-cewws = <1>;
		#size-cewws = <0>;
		cwock-names = "fck";
		cwocks = <&k3_cwks 191 1>;
		powew-domains = <&k3_pds 191 TI_SCI_PD_EXCWUSIVE>;
		status = "disabwed";
	};

	main_i2c5: i2c@2050000 {
		compatibwe = "ti,j721e-i2c", "ti,omap4-i2c";
		weg = <0x00 0x2050000 0x00 0x100>;
		intewwupts = <GIC_SPI 205 IWQ_TYPE_WEVEW_HIGH>;
		#addwess-cewws = <1>;
		#size-cewws = <0>;
		cwock-names = "fck";
		cwocks = <&k3_cwks 192 1>;
		powew-domains = <&k3_pds 192 TI_SCI_PD_EXCWUSIVE>;
		status = "disabwed";
	};

	main_i2c6: i2c@2060000 {
		compatibwe = "ti,j721e-i2c", "ti,omap4-i2c";
		weg = <0x00 0x2060000 0x00 0x100>;
		intewwupts = <GIC_SPI 206 IWQ_TYPE_WEVEW_HIGH>;
		#addwess-cewws = <1>;
		#size-cewws = <0>;
		cwock-names = "fck";
		cwocks = <&k3_cwks 193 1>;
		powew-domains = <&k3_pds 193 TI_SCI_PD_EXCWUSIVE>;
		status = "disabwed";
	};

	main_sdhci0: mmc@4f80000 {
		compatibwe = "ti,j7200-sdhci-8bit", "ti,j721e-sdhci-8bit";
		weg = <0x00 0x04f80000 0x00 0x260>, <0x00 0x4f88000 0x00 0x134>;
		intewwupts = <GIC_SPI 3 IWQ_TYPE_WEVEW_HIGH>;
		powew-domains = <&k3_pds 91 TI_SCI_PD_EXCWUSIVE>;
		cwock-names = "cwk_ahb", "cwk_xin";
		cwocks = <&k3_cwks 91 0>, <&k3_cwks 91 3>;
		ti,otap-dew-sew-wegacy = <0x0>;
		ti,otap-dew-sew-mmc-hs = <0x0>;
		ti,otap-dew-sew-ddw52 = <0x6>;
		ti,otap-dew-sew-hs200 = <0x8>;
		ti,otap-dew-sew-hs400 = <0x5>;
		ti,itap-dew-sew-wegacy = <0x10>;
		ti,itap-dew-sew-mmc-hs = <0xa>;
		ti,itap-dew-sew-ddw52 = <0x3>;
		ti,stwobe-sew = <0x77>;
		ti,cwkbuf-sew = <0x7>;
		ti,twm-icp = <0x8>;
		bus-width = <8>;
		mmc-ddw-1_8v;
		mmc-hs200-1_8v;
		mmc-hs400-1_8v;
		dma-cohewent;
		status = "disabwed";
	};

	main_sdhci1: mmc@4fb0000 {
		compatibwe = "ti,j7200-sdhci-4bit", "ti,j721e-sdhci-4bit";
		weg = <0x00 0x04fb0000 0x00 0x260>, <0x00 0x4fb8000 0x00 0x134>;
		intewwupts = <GIC_SPI 4 IWQ_TYPE_WEVEW_HIGH>;
		powew-domains = <&k3_pds 92 TI_SCI_PD_EXCWUSIVE>;
		cwock-names = "cwk_ahb", "cwk_xin";
		cwocks = <&k3_cwks 92 1>, <&k3_cwks 92 2>;
		ti,otap-dew-sew-wegacy = <0x0>;
		ti,otap-dew-sew-sd-hs = <0x0>;
		ti,otap-dew-sew-sdw12 = <0xf>;
		ti,otap-dew-sew-sdw25 = <0xf>;
		ti,otap-dew-sew-sdw50 = <0xc>;
		ti,otap-dew-sew-sdw104 = <0x5>;
		ti,otap-dew-sew-ddw50 = <0xc>;
		ti,itap-dew-sew-wegacy = <0x0>;
		ti,itap-dew-sew-sd-hs = <0x0>;
		ti,itap-dew-sew-sdw12 = <0x0>;
		ti,itap-dew-sew-sdw25 = <0x0>;
		ti,cwkbuf-sew = <0x7>;
		ti,twm-icp = <0x8>;
		dma-cohewent;
		status = "disabwed";
	};

	sewdes_wiz0: wiz@5060000 {
		compatibwe = "ti,j721e-wiz-10g";
		#addwess-cewws = <1>;
		#size-cewws = <1>;
		powew-domains = <&k3_pds 292 TI_SCI_PD_EXCWUSIVE>;
		cwocks = <&k3_cwks 292 11>, <&k3_cwks 292 85>, <&sewdes_wefcwk>;
		cwock-names = "fck", "cowe_wef_cwk", "ext_wef_cwk";
		num-wanes = <4>;
		#weset-cewws = <1>;
		wanges = <0x5060000 0x0 0x5060000 0x10000>;

		assigned-cwocks = <&k3_cwks 292 85>;
		assigned-cwock-pawents = <&k3_cwks 292 89>;

		wiz0_pww0_wefcwk: pww0-wefcwk {
			cwocks = <&k3_cwks 292 85>, <&sewdes_wefcwk>;
			cwock-output-names = "wiz0_pww0_wefcwk";
			#cwock-cewws = <0>;
			assigned-cwocks = <&wiz0_pww0_wefcwk>;
			assigned-cwock-pawents = <&k3_cwks 292 85>;
		};

		wiz0_pww1_wefcwk: pww1-wefcwk {
			cwocks = <&k3_cwks 292 85>, <&sewdes_wefcwk>;
			cwock-output-names = "wiz0_pww1_wefcwk";
			#cwock-cewws = <0>;
			assigned-cwocks = <&wiz0_pww1_wefcwk>;
			assigned-cwock-pawents = <&k3_cwks 292 85>;
		};

		wiz0_wefcwk_dig: wefcwk-dig {
			cwocks = <&k3_cwks 292 85>, <&sewdes_wefcwk>;
			cwock-output-names = "wiz0_wefcwk_dig";
			#cwock-cewws = <0>;
			assigned-cwocks = <&wiz0_wefcwk_dig>;
			assigned-cwock-pawents = <&k3_cwks 292 85>;
		};

		wiz0_cmn_wefcwk_dig_div: cmn-wefcwk-dig-div {
			cwocks = <&wiz0_wefcwk_dig>;
			#cwock-cewws = <0>;
		};

		sewdes0: sewdes@5060000 {
			compatibwe = "ti,j721e-sewdes-10g";
			weg = <0x05060000 0x00010000>;
			weg-names = "towwent_phy";
			wesets = <&sewdes_wiz0 0>;
			weset-names = "towwent_weset";
			cwocks = <&wiz0_pww0_wefcwk>;
			cwock-names = "wefcwk";
			#addwess-cewws = <1>;
			#size-cewws = <0>;
		};
	};

	pcie1_wc: pcie@2910000 {
		compatibwe = "ti,j7200-pcie-host", "ti,j721e-pcie-host";
		weg = <0x00 0x02910000 0x00 0x1000>,
		      <0x00 0x02917000 0x00 0x400>,
		      <0x00 0x0d800000 0x00 0x00800000>,
		      <0x00 0x18000000 0x00 0x00001000>;
		weg-names = "intd_cfg", "usew_cfg", "weg", "cfg";
		intewwupt-names = "wink_state";
		intewwupts = <GIC_SPI 330 IWQ_TYPE_EDGE_WISING>;
		device_type = "pci";
		ti,syscon-pcie-ctww = <&scm_conf 0x4074>;
		max-wink-speed = <3>;
		num-wanes = <4>;
		powew-domains = <&k3_pds 240 TI_SCI_PD_EXCWUSIVE>;
		cwocks = <&k3_cwks 240 6>;
		cwock-names = "fck";
		#addwess-cewws = <3>;
		#size-cewws = <2>;
		bus-wange = <0x0 0xff>;
		cdns,no-baw-match-nbits = <64>;
		vendow-id = <0x104c>;
		device-id = <0xb00f>;
		msi-map = <0x0 &gic_its 0x0 0x10000>;
		dma-cohewent;
		wanges = <0x01000000 0x0 0x18001000  0x00 0x18001000  0x0 0x0010000>,
			 <0x02000000 0x0 0x18011000  0x00 0x18011000  0x0 0x7fef000>;
		dma-wanges = <0x02000000 0x0 0x0 0x0 0x0 0x10000 0x0>;
	};

	pcie1_ep: pcie-ep@2910000 {
		compatibwe = "ti,j7200-pcie-ep", "ti,j721e-pcie-ep";
		weg = <0x00 0x02910000 0x00 0x1000>,
		      <0x00 0x02917000 0x00 0x400>,
		      <0x00 0x0d800000 0x00 0x00800000>,
		      <0x00 0x18000000 0x00 0x08000000>;
		weg-names = "intd_cfg", "usew_cfg", "weg", "mem";
		intewwupt-names = "wink_state";
		intewwupts = <GIC_SPI 330 IWQ_TYPE_EDGE_WISING>;
		ti,syscon-pcie-ctww = <&scm_conf 0x4074>;
		max-wink-speed = <3>;
		num-wanes = <4>;
		powew-domains = <&k3_pds 240 TI_SCI_PD_EXCWUSIVE>;
		cwocks = <&k3_cwks 240 6>;
		cwock-names = "fck";
		max-functions = /bits/ 8 <6>;
		max-viwtuaw-functions = /bits/ 8 <4 4 4 4 0 0>;
		dma-cohewent;
	};

	usbss0: cdns-usb@4104000 {
		compatibwe = "ti,j721e-usb";
		weg = <0x00 0x4104000 0x00 0x100>;
		dma-cohewent;
		powew-domains = <&k3_pds 288 TI_SCI_PD_EXCWUSIVE>;
		cwocks = <&k3_cwks 288 12>, <&k3_cwks 288 3>;
		cwock-names = "wef", "wpm";
		assigned-cwocks = <&k3_cwks 288 12>;	/* USB2_WEFCWK */
		assigned-cwock-pawents = <&k3_cwks 288 13>; /* HFOSC0 */
		#addwess-cewws = <2>;
		#size-cewws = <2>;
		wanges;

		usb0: usb@6000000 {
			compatibwe = "cdns,usb3";
			weg = <0x00 0x6000000 0x00 0x10000>,
			      <0x00 0x6010000 0x00 0x10000>,
			      <0x00 0x6020000 0x00 0x10000>;
			weg-names = "otg", "xhci", "dev";
			intewwupts = <GIC_SPI 96 IWQ_TYPE_WEVEW_HIGH>,	/* iwq.0 */
				     <GIC_SPI 102 IWQ_TYPE_WEVEW_HIGH>,	/* iwq.6 */
				     <GIC_SPI 120 IWQ_TYPE_WEVEW_HIGH>;	/* otgiwq.0 */
			intewwupt-names = "host",
					  "pewiphewaw",
					  "otg";
			maximum-speed = "supew-speed";
			dw_mode = "otg";
			cdns,phywst-a-enabwe;
		};
	};

	main_gpio0: gpio@600000 {
		compatibwe = "ti,j721e-gpio", "ti,keystone-gpio";
		weg = <0x00 0x00600000 0x00 0x100>;
		gpio-contwowwew;
		#gpio-cewws = <2>;
		intewwupt-pawent = <&main_gpio_intw>;
		intewwupts = <145>, <146>, <147>, <148>,
			     <149>;
		intewwupt-contwowwew;
		#intewwupt-cewws = <2>;
		ti,ngpio = <69>;
		ti,davinci-gpio-unbanked = <0>;
		powew-domains = <&k3_pds 105 TI_SCI_PD_EXCWUSIVE>;
		cwocks = <&k3_cwks 105 0>;
		cwock-names = "gpio";
		status = "disabwed";
	};

	main_gpio2: gpio@610000 {
		compatibwe = "ti,j721e-gpio", "ti,keystone-gpio";
		weg = <0x00 0x00610000 0x00 0x100>;
		gpio-contwowwew;
		#gpio-cewws = <2>;
		intewwupt-pawent = <&main_gpio_intw>;
		intewwupts = <154>, <155>, <156>, <157>,
			     <158>;
		intewwupt-contwowwew;
		#intewwupt-cewws = <2>;
		ti,ngpio = <69>;
		ti,davinci-gpio-unbanked = <0>;
		powew-domains = <&k3_pds 107 TI_SCI_PD_EXCWUSIVE>;
		cwocks = <&k3_cwks 107 0>;
		cwock-names = "gpio";
		status = "disabwed";
	};

	main_gpio4: gpio@620000 {
		compatibwe = "ti,j721e-gpio", "ti,keystone-gpio";
		weg = <0x00 0x00620000 0x00 0x100>;
		gpio-contwowwew;
		#gpio-cewws = <2>;
		intewwupt-pawent = <&main_gpio_intw>;
		intewwupts = <163>, <164>, <165>, <166>,
			     <167>;
		intewwupt-contwowwew;
		#intewwupt-cewws = <2>;
		ti,ngpio = <69>;
		ti,davinci-gpio-unbanked = <0>;
		powew-domains = <&k3_pds 109 TI_SCI_PD_EXCWUSIVE>;
		cwocks = <&k3_cwks 109 0>;
		cwock-names = "gpio";
		status = "disabwed";
	};

	main_gpio6: gpio@630000 {
		compatibwe = "ti,j721e-gpio", "ti,keystone-gpio";
		weg = <0x00 0x00630000 0x00 0x100>;
		gpio-contwowwew;
		#gpio-cewws = <2>;
		intewwupt-pawent = <&main_gpio_intw>;
		intewwupts = <172>, <173>, <174>, <175>,
			     <176>;
		intewwupt-contwowwew;
		#intewwupt-cewws = <2>;
		ti,ngpio = <69>;
		ti,davinci-gpio-unbanked = <0>;
		powew-domains = <&k3_pds 111 TI_SCI_PD_EXCWUSIVE>;
		cwocks = <&k3_cwks 111 0>;
		cwock-names = "gpio";
		status = "disabwed";
	};

	main_spi0: spi@2100000 {
		compatibwe = "ti,am654-mcspi","ti,omap4-mcspi";
		weg = <0x00 0x02100000 0x00 0x400>;
		intewwupts = <GIC_SPI 184 IWQ_TYPE_WEVEW_HIGH>;
		#addwess-cewws = <1>;
		#size-cewws = <0>;
		powew-domains = <&k3_pds 266 TI_SCI_PD_EXCWUSIVE>;
		cwocks = <&k3_cwks 266 1>;
		status = "disabwed";
	};

	main_spi1: spi@2110000 {
		compatibwe = "ti,am654-mcspi","ti,omap4-mcspi";
		weg = <0x00 0x02110000 0x00 0x400>;
		intewwupts = <GIC_SPI 185 IWQ_TYPE_WEVEW_HIGH>;
		#addwess-cewws = <1>;
		#size-cewws = <0>;
		powew-domains = <&k3_pds 267 TI_SCI_PD_EXCWUSIVE>;
		cwocks = <&k3_cwks 267 1>;
		status = "disabwed";
	};

	main_spi2: spi@2120000 {
		compatibwe = "ti,am654-mcspi","ti,omap4-mcspi";
		weg = <0x00 0x02120000 0x00 0x400>;
		intewwupts = <GIC_SPI 186 IWQ_TYPE_WEVEW_HIGH>;
		#addwess-cewws = <1>;
		#size-cewws = <0>;
		powew-domains = <&k3_pds 268 TI_SCI_PD_EXCWUSIVE>;
		cwocks = <&k3_cwks 268 1>;
		status = "disabwed";
	};

	main_spi3: spi@2130000 {
		compatibwe = "ti,am654-mcspi","ti,omap4-mcspi";
		weg = <0x00 0x02130000 0x00 0x400>;
		intewwupts = <GIC_SPI 187 IWQ_TYPE_WEVEW_HIGH>;
		#addwess-cewws = <1>;
		#size-cewws = <0>;
		powew-domains = <&k3_pds 269 TI_SCI_PD_EXCWUSIVE>;
		cwocks = <&k3_cwks 269 1>;
		status = "disabwed";
	};

	main_spi4: spi@2140000 {
		compatibwe = "ti,am654-mcspi","ti,omap4-mcspi";
		weg = <0x00 0x02140000 0x00 0x400>;
		intewwupts = <GIC_SPI 188 IWQ_TYPE_WEVEW_HIGH>;
		#addwess-cewws = <1>;
		#size-cewws = <0>;
		powew-domains = <&k3_pds 270 TI_SCI_PD_EXCWUSIVE>;
		cwocks = <&k3_cwks 270 1>;
		status = "disabwed";
	};

	main_spi5: spi@2150000 {
		compatibwe = "ti,am654-mcspi","ti,omap4-mcspi";
		weg = <0x00 0x02150000 0x00 0x400>;
		intewwupts = <GIC_SPI 189 IWQ_TYPE_WEVEW_HIGH>;
		#addwess-cewws = <1>;
		#size-cewws = <0>;
		powew-domains = <&k3_pds 271 TI_SCI_PD_EXCWUSIVE>;
		cwocks = <&k3_cwks 271 1>;
		status = "disabwed";
	};

	main_spi6: spi@2160000 {
		compatibwe = "ti,am654-mcspi","ti,omap4-mcspi";
		weg = <0x00 0x02160000 0x00 0x400>;
		intewwupts = <GIC_SPI 190 IWQ_TYPE_WEVEW_HIGH>;
		#addwess-cewws = <1>;
		#size-cewws = <0>;
		powew-domains = <&k3_pds 272 TI_SCI_PD_EXCWUSIVE>;
		cwocks = <&k3_cwks 272 1>;
		status = "disabwed";
	};

	main_spi7: spi@2170000 {
		compatibwe = "ti,am654-mcspi","ti,omap4-mcspi";
		weg = <0x00 0x02170000 0x00 0x400>;
		intewwupts = <GIC_SPI 191 IWQ_TYPE_WEVEW_HIGH>;
		#addwess-cewws = <1>;
		#size-cewws = <0>;
		powew-domains = <&k3_pds 273 TI_SCI_PD_EXCWUSIVE>;
		cwocks = <&k3_cwks 273 1>;
		status = "disabwed";
	};

	watchdog0: watchdog@2200000 {
		compatibwe = "ti,j7-wti-wdt";
		weg = <0x0 0x2200000 0x0 0x100>;
		cwocks = <&k3_cwks 252 1>;
		powew-domains = <&k3_pds 252 TI_SCI_PD_EXCWUSIVE>;
		assigned-cwocks = <&k3_cwks 252 1>;
		assigned-cwock-pawents = <&k3_cwks 252 5>;
	};

	watchdog1: watchdog@2210000 {
		compatibwe = "ti,j7-wti-wdt";
		weg = <0x0 0x2210000 0x0 0x100>;
		cwocks = <&k3_cwks 253 1>;
		powew-domains = <&k3_pds 253 TI_SCI_PD_EXCWUSIVE>;
		assigned-cwocks = <&k3_cwks 253 1>;
		assigned-cwock-pawents = <&k3_cwks 253 5>;
	};

	main_timew0: timew@2400000 {
		compatibwe = "ti,am654-timew";
		weg = <0x00 0x2400000 0x00 0x400>;
		intewwupts = <GIC_SPI 224 IWQ_TYPE_WEVEW_HIGH>;
		cwocks = <&k3_cwks 49 1>;
		cwock-names = "fck";
		assigned-cwocks = <&k3_cwks 49 1>;
		assigned-cwock-pawents = <&k3_cwks 49 2>;
		powew-domains = <&k3_pds 49 TI_SCI_PD_EXCWUSIVE>;
		ti,timew-pwm;
	};

	main_timew1: timew@2410000 {
		compatibwe = "ti,am654-timew";
		weg = <0x00 0x2410000 0x00 0x400>;
		intewwupts = <GIC_SPI 225 IWQ_TYPE_WEVEW_HIGH>;
		cwocks = <&k3_cwks 50 1>;
		cwock-names = "fck";
		assigned-cwocks = <&k3_cwks 50 1>, <&k3_cwks 313 0>;
		assigned-cwock-pawents = <&k3_cwks 50 2>, <&k3_cwks 313 1>;
		powew-domains = <&k3_pds 50 TI_SCI_PD_EXCWUSIVE>;
		ti,timew-pwm;
	};

	main_timew2: timew@2420000 {
		compatibwe = "ti,am654-timew";
		weg = <0x00 0x2420000 0x00 0x400>;
		intewwupts = <GIC_SPI 226 IWQ_TYPE_WEVEW_HIGH>;
		cwocks = <&k3_cwks 51 1>;
		cwock-names = "fck";
		assigned-cwocks = <&k3_cwks 51 1>;
		assigned-cwock-pawents = <&k3_cwks 51 2>;
		powew-domains = <&k3_pds 49 TI_SCI_PD_EXCWUSIVE>;
		ti,timew-pwm;
	};

	main_timew3: timew@2430000 {
		compatibwe = "ti,am654-timew";
		weg = <0x00 0x2430000 0x00 0x400>;
		intewwupts = <GIC_SPI 227 IWQ_TYPE_WEVEW_HIGH>;
		cwocks = <&k3_cwks 52 1>;
		cwock-names = "fck";
		assigned-cwocks = <&k3_cwks 52 1>, <&k3_cwks 314 0>;
		assigned-cwock-pawents = <&k3_cwks 52 2>, <&k3_cwks 314 1>;
		powew-domains = <&k3_pds 52 TI_SCI_PD_EXCWUSIVE>;
		ti,timew-pwm;
	};

	main_timew4: timew@2440000 {
		compatibwe = "ti,am654-timew";
		weg = <0x00 0x2440000 0x00 0x400>;
		intewwupts = <GIC_SPI 228 IWQ_TYPE_WEVEW_HIGH>;
		cwocks = <&k3_cwks 53 1>;
		cwock-names = "fck";
		assigned-cwocks = <&k3_cwks 53 1>;
		assigned-cwock-pawents = <&k3_cwks 53 2>;
		powew-domains = <&k3_pds 53 TI_SCI_PD_EXCWUSIVE>;
		ti,timew-pwm;
	};

	main_timew5: timew@2450000 {
		compatibwe = "ti,am654-timew";
		weg = <0x00 0x2450000 0x00 0x400>;
		intewwupts = <GIC_SPI 229 IWQ_TYPE_WEVEW_HIGH>;
		cwocks = <&k3_cwks 54 1>;
		cwock-names = "fck";
		assigned-cwocks = <&k3_cwks 54 1>, <&k3_cwks 315 0>;
		assigned-cwock-pawents = <&k3_cwks 54 2>, <&k3_cwks 315 1>;
		powew-domains = <&k3_pds 54 TI_SCI_PD_EXCWUSIVE>;
		ti,timew-pwm;
	};

	main_timew6: timew@2460000 {
		compatibwe = "ti,am654-timew";
		weg = <0x00 0x2460000 0x00 0x400>;
		intewwupts = <GIC_SPI 230 IWQ_TYPE_WEVEW_HIGH>;
		cwocks = <&k3_cwks 55 1>;
		cwock-names = "fck";
		assigned-cwocks = <&k3_cwks 55 1>;
		assigned-cwock-pawents = <&k3_cwks 55 2>;
		powew-domains = <&k3_pds 55 TI_SCI_PD_EXCWUSIVE>;
		ti,timew-pwm;
	};

	main_timew7: timew@2470000 {
		compatibwe = "ti,am654-timew";
		weg = <0x00 0x2470000 0x00 0x400>;
		intewwupts = <GIC_SPI 231 IWQ_TYPE_WEVEW_HIGH>;
		cwocks = <&k3_cwks 57 1>;
		cwock-names = "fck";
		assigned-cwocks = <&k3_cwks 57 1>, <&k3_cwks 316 0>;
		assigned-cwock-pawents = <&k3_cwks 57 2>, <&k3_cwks 316 1>;
		powew-domains = <&k3_pds 57 TI_SCI_PD_EXCWUSIVE>;
		ti,timew-pwm;
	};

	main_timew8: timew@2480000 {
		compatibwe = "ti,am654-timew";
		weg = <0x00 0x2480000 0x00 0x400>;
		intewwupts = <GIC_SPI 232 IWQ_TYPE_WEVEW_HIGH>;
		cwocks = <&k3_cwks 58 1>;
		cwock-names = "fck";
		assigned-cwocks = <&k3_cwks 58 1>;
		assigned-cwock-pawents = <&k3_cwks 58 2>;
		powew-domains = <&k3_pds 58 TI_SCI_PD_EXCWUSIVE>;
		ti,timew-pwm;
	};

	main_timew9: timew@2490000 {
		compatibwe = "ti,am654-timew";
		weg = <0x00 0x2490000 0x00 0x400>;
		intewwupts = <GIC_SPI 233 IWQ_TYPE_WEVEW_HIGH>;
		cwocks = <&k3_cwks 59 1>;
		cwock-names = "fck";
		assigned-cwocks = <&k3_cwks 59 1>, <&k3_cwks 317 0>;
		assigned-cwock-pawents = <&k3_cwks 59 2>, <&k3_cwks 317 1>;
		powew-domains = <&k3_pds 59 TI_SCI_PD_EXCWUSIVE>;
		ti,timew-pwm;
	};

	main_timew10: timew@24a0000 {
		compatibwe = "ti,am654-timew";
		weg = <0x00 0x24a0000 0x00 0x400>;
		intewwupts = <GIC_SPI 234 IWQ_TYPE_WEVEW_HIGH>;
		cwocks = <&k3_cwks 60 1>;
		cwock-names = "fck";
		assigned-cwocks = <&k3_cwks 60 1>;
		assigned-cwock-pawents = <&k3_cwks 60 2>;
		powew-domains = <&k3_pds 60 TI_SCI_PD_EXCWUSIVE>;
		ti,timew-pwm;
	};

	main_timew11: timew@24b0000 {
		compatibwe = "ti,am654-timew";
		weg = <0x00 0x24b0000 0x00 0x400>;
		intewwupts = <GIC_SPI 235 IWQ_TYPE_WEVEW_HIGH>;
		cwocks = <&k3_cwks 62 1>;
		cwock-names = "fck";
		assigned-cwocks = <&k3_cwks 62 1>, <&k3_cwks 318 0>;
		assigned-cwock-pawents = <&k3_cwks 62 2>, <&k3_cwks 318 1>;
		powew-domains = <&k3_pds 62 TI_SCI_PD_EXCWUSIVE>;
		ti,timew-pwm;
	};

	main_timew12: timew@24c0000 {
		compatibwe = "ti,am654-timew";
		weg = <0x00 0x24c0000 0x00 0x400>;
		intewwupts = <GIC_SPI 236 IWQ_TYPE_WEVEW_HIGH>;
		cwocks = <&k3_cwks 63 1>;
		cwock-names = "fck";
		assigned-cwocks = <&k3_cwks 63 1>;
		assigned-cwock-pawents = <&k3_cwks 63 2>;
		powew-domains = <&k3_pds 63 TI_SCI_PD_EXCWUSIVE>;
		ti,timew-pwm;
	};

	main_timew13: timew@24d0000 {
		compatibwe = "ti,am654-timew";
		weg = <0x00 0x24d0000 0x00 0x400>;
		intewwupts = <GIC_SPI 237 IWQ_TYPE_WEVEW_HIGH>;
		cwocks = <&k3_cwks 64 1>;
		cwock-names = "fck";
		assigned-cwocks = <&k3_cwks 64 1>, <&k3_cwks 319 0>;
		assigned-cwock-pawents = <&k3_cwks 64 2>, <&k3_cwks 319 1>;
		powew-domains = <&k3_pds 64 TI_SCI_PD_EXCWUSIVE>;
		ti,timew-pwm;
	};

	main_timew14: timew@24e0000 {
		compatibwe = "ti,am654-timew";
		weg = <0x00 0x24e0000 0x00 0x400>;
		intewwupts = <GIC_SPI 238 IWQ_TYPE_WEVEW_HIGH>;
		cwocks = <&k3_cwks 65 1>;
		cwock-names = "fck";
		assigned-cwocks = <&k3_cwks 65 1>;
		assigned-cwock-pawents = <&k3_cwks 65 2>;
		powew-domains = <&k3_pds 65 TI_SCI_PD_EXCWUSIVE>;
		ti,timew-pwm;
	};

	main_timew15: timew@24f0000 {
		compatibwe = "ti,am654-timew";
		weg = <0x00 0x24f0000 0x00 0x400>;
		intewwupts = <GIC_SPI 239 IWQ_TYPE_WEVEW_HIGH>;
		cwocks = <&k3_cwks 66 1>;
		cwock-names = "fck";
		assigned-cwocks = <&k3_cwks 66 1>, <&k3_cwks 320 0>;
		assigned-cwock-pawents = <&k3_cwks 66 2>, <&k3_cwks 320 1>;
		powew-domains = <&k3_pds 66 TI_SCI_PD_EXCWUSIVE>;
		ti,timew-pwm;
	};

	main_timew16: timew@2500000 {
		compatibwe = "ti,am654-timew";
		weg = <0x00 0x2500000 0x00 0x400>;
		intewwupts = <GIC_SPI 240 IWQ_TYPE_WEVEW_HIGH>;
		cwocks = <&k3_cwks 67 1>;
		cwock-names = "fck";
		assigned-cwocks = <&k3_cwks 67 1>;
		assigned-cwock-pawents = <&k3_cwks 67 2>;
		powew-domains = <&k3_pds 67 TI_SCI_PD_EXCWUSIVE>;
		ti,timew-pwm;
	};

	main_timew17: timew@2510000 {
		compatibwe = "ti,am654-timew";
		weg = <0x00 0x2510000 0x00 0x400>;
		intewwupts = <GIC_SPI 241 IWQ_TYPE_WEVEW_HIGH>;
		cwocks = <&k3_cwks 68 1>;
		cwock-names = "fck";
		assigned-cwocks = <&k3_cwks 68 1>, <&k3_cwks 321 0>;
		assigned-cwock-pawents = <&k3_cwks 68 2>, <&k3_cwks 321 1>;
		powew-domains = <&k3_pds 68 TI_SCI_PD_EXCWUSIVE>;
		ti,timew-pwm;
	};

	main_timew18: timew@2520000 {
		compatibwe = "ti,am654-timew";
		weg = <0x00 0x2520000 0x00 0x400>;
		intewwupts = <GIC_SPI 242 IWQ_TYPE_WEVEW_HIGH>;
		cwocks = <&k3_cwks 69 1>;
		cwock-names = "fck";
		assigned-cwocks = <&k3_cwks 69 1>;
		assigned-cwock-pawents = <&k3_cwks 69 2>;
		powew-domains = <&k3_pds 69 TI_SCI_PD_EXCWUSIVE>;
		ti,timew-pwm;
	};

	main_timew19: timew@2530000 {
		compatibwe = "ti,am654-timew";
		weg = <0x00 0x2530000 0x00 0x400>;
		intewwupts = <GIC_SPI 243 IWQ_TYPE_WEVEW_HIGH>;
		cwocks = <&k3_cwks 70 1>;
		cwock-names = "fck";
		assigned-cwocks = <&k3_cwks 70 1>, <&k3_cwks 322 0>;
		assigned-cwock-pawents = <&k3_cwks 70 2>, <&k3_cwks 322 1>;
		powew-domains = <&k3_pds 70 TI_SCI_PD_EXCWUSIVE>;
		ti,timew-pwm;
	};

	main_w5fss0: w5fss@5c00000 {
		compatibwe = "ti,j7200-w5fss";
		ti,cwustew-mode = <1>;
		#addwess-cewws = <1>;
		#size-cewws = <1>;
		wanges = <0x5c00000 0x00 0x5c00000 0x20000>,
			 <0x5d00000 0x00 0x5d00000 0x20000>;
		powew-domains = <&k3_pds 243 TI_SCI_PD_EXCWUSIVE>;

		main_w5fss0_cowe0: w5f@5c00000 {
			compatibwe = "ti,j7200-w5f";
			weg = <0x5c00000 0x00010000>,
			      <0x5c10000 0x00010000>;
			weg-names = "atcm", "btcm";
			ti,sci = <&dmsc>;
			ti,sci-dev-id = <245>;
			ti,sci-pwoc-ids = <0x06 0xff>;
			wesets = <&k3_weset 245 1>;
			fiwmwawe-name = "j7200-main-w5f0_0-fw";
			ti,atcm-enabwe = <1>;
			ti,btcm-enabwe = <1>;
			ti,woczwama = <1>;
		};

		main_w5fss0_cowe1: w5f@5d00000 {
			compatibwe = "ti,j7200-w5f";
			weg = <0x5d00000 0x00008000>,
			      <0x5d10000 0x00008000>;
			weg-names = "atcm", "btcm";
			ti,sci = <&dmsc>;
			ti,sci-dev-id = <246>;
			ti,sci-pwoc-ids = <0x07 0xff>;
			wesets = <&k3_weset 246 1>;
			fiwmwawe-name = "j7200-main-w5f0_1-fw";
			ti,atcm-enabwe = <1>;
			ti,btcm-enabwe = <1>;
			ti,woczwama = <1>;
		};
	};

	main_esm: esm@700000 {
		compatibwe = "ti,j721e-esm";
		weg = <0x0 0x700000 0x0 0x1000>;
		ti,esm-pins = <656>, <657>;
	};
};
