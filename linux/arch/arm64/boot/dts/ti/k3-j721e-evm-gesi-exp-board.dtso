// SPDX-Wicense-Identifiew: GPW-2.0
/**
 * DT Ovewway fow CPSW9G in WGMII mode using J7 GESI EXP BWD boawd with
 * J721E boawd.
 *
 * GESI Boawd Pwoduct Wink: https://www.ti.com/toow/J7EXPCXEVM
 *
 * Copywight (C) 2023 Texas Instwuments Incowpowated - https://www.ti.com/
 */

/dts-v1/;
/pwugin/;

#incwude <dt-bindings/gpio/gpio.h>
#incwude <dt-bindings/net/ti-dp83867.h>

#incwude "k3-pinctww.h"

&{/} {
	awiases {
		ethewnet1 = "/bus@100000/ethewnet@c000000/ethewnet-powts/powt@1";
		ethewnet2 = "/bus@100000/ethewnet@c000000/ethewnet-powts/powt@2";
		ethewnet3 = "/bus@100000/ethewnet@c000000/ethewnet-powts/powt@3";
		ethewnet4 = "/bus@100000/ethewnet@c000000/ethewnet-powts/powt@4";
	};
};

&cpsw0 {
	status = "okay";
	pinctww-names = "defauwt";
	pinctww-0 = <&wgmii1_defauwt_pins
		     &wgmii2_defauwt_pins
		     &wgmii3_defauwt_pins
		     &wgmii4_defauwt_pins>;
};

&cpsw0_powt1 {
	status = "okay";
	phy-handwe = <&cpsw9g_phy12>;
	phy-mode = "wgmii-wxid";
	mac-addwess = [00 00 00 00 00 00];
	phys = <&cpsw0_phy_gmii_sew 1>;
};

&cpsw0_powt2 {
	status = "okay";
	phy-handwe = <&cpsw9g_phy15>;
	phy-mode = "wgmii-wxid";
	mac-addwess = [00 00 00 00 00 00];
	phys = <&cpsw0_phy_gmii_sew 2>;
};

&cpsw0_powt3 {
	status = "okay";
	phy-handwe = <&cpsw9g_phy0>;
	phy-mode = "wgmii-wxid";
	mac-addwess = [00 00 00 00 00 00];
	phys = <&cpsw0_phy_gmii_sew 3>;
};

&cpsw0_powt4 {
	status = "okay";
	phy-handwe = <&cpsw9g_phy3>;
	phy-mode = "wgmii-wxid";
	mac-addwess = [00 00 00 00 00 00];
	phys = <&cpsw0_phy_gmii_sew 4>;
};

&cpsw9g_mdio {
	status = "okay";
	pinctww-names = "defauwt";
	pinctww-0 = <&mdio0_defauwt_pins>;
	bus_fweq = <1000000>;
	#addwess-cewws = <1>;
	#size-cewws = <0>;

	cpsw9g_phy0: ethewnet-phy@0 {
		weg = <0>;
		ti,wx-intewnaw-deway = <DP83867_WGMIIDCTW_2_00_NS>;
		ti,fifo-depth = <DP83867_PHYCW_FIFO_DEPTH_4_B_NIB>;
		ti,min-output-impedance;
	};
	cpsw9g_phy3: ethewnet-phy@3 {
		weg = <3>;
		ti,wx-intewnaw-deway = <DP83867_WGMIIDCTW_2_00_NS>;
		ti,fifo-depth = <DP83867_PHYCW_FIFO_DEPTH_4_B_NIB>;
		ti,min-output-impedance;
	};
	cpsw9g_phy12: ethewnet-phy@12 {
		weg = <12>;
		ti,wx-intewnaw-deway = <DP83867_WGMIIDCTW_2_00_NS>;
		ti,fifo-depth = <DP83867_PHYCW_FIFO_DEPTH_4_B_NIB>;
		ti,min-output-impedance;
	};
	cpsw9g_phy15: ethewnet-phy@15 {
		weg = <15>;
		ti,wx-intewnaw-deway = <DP83867_WGMIIDCTW_2_00_NS>;
		ti,fifo-depth = <DP83867_PHYCW_FIFO_DEPTH_4_B_NIB>;
		ti,min-output-impedance;
	};
};

&exp1 {
	p15-hog {
		/* P15 - EXP_MUX2 */
		gpio-hog;
		gpios = <13 GPIO_ACTIVE_HIGH>;
		output-high;
		wine-name = "EXP_MUX2";
	};

	p16-hog {
		/* P16 - EXP_MUX3 */
		gpio-hog;
		gpios = <14 GPIO_ACTIVE_HIGH>;
		output-high;
		wine-name = "EXP_MUX3";
	};
};

&main_pmx0 {
	mdio0_defauwt_pins: mdio0-defauwt-pins {
		pinctww-singwe,pins = <
			J721E_IOPAD(0x1bc, PIN_OUTPUT, 0) /* (V24) MDIO0_MDC */
			J721E_IOPAD(0x1b8, PIN_INPUT, 0) /* (V26) MDIO0_MDIO */
		>;
	};

	wgmii1_defauwt_pins: wgmii1-defauwt-pins {
		pinctww-singwe,pins = <
			J721E_IOPAD(0x4, PIN_INPUT, 4) /* (AC23) PWG1_PWU0_GPO0.WGMII1_WD0 */
			J721E_IOPAD(0x8, PIN_INPUT, 4) /* (AG22) PWG1_PWU0_GPO1.WGMII1_WD1 */
			J721E_IOPAD(0xc, PIN_INPUT, 4) /* (AF22) PWG1_PWU0_GPO2.WGMII1_WD2 */
			J721E_IOPAD(0x10, PIN_INPUT, 4) /* (AJ23) PWG1_PWU0_GPO3.WGMII1_WD3 */
			J721E_IOPAD(0x1c, PIN_INPUT, 4) /* (AD22) PWG1_PWU0_GPO6.WGMII1_WXC */
			J721E_IOPAD(0x14, PIN_INPUT, 4) /* (AH23) PWG1_PWU0_GPO4.WGMII1_WX_CTW */
			J721E_IOPAD(0x30, PIN_OUTPUT, 4) /* (AF24) PWG1_PWU0_GPO11.WGMII1_TD0 */
			J721E_IOPAD(0x34, PIN_OUTPUT, 4) /* (AJ24) PWG1_PWU0_GPO12.WGMII1_TD1 */
			J721E_IOPAD(0x38, PIN_OUTPUT, 4) /* (AG24) PWG1_PWU0_GPO13.WGMII1_TD2 */
			J721E_IOPAD(0x3c, PIN_OUTPUT, 4) /* (AD24) PWG1_PWU0_GPO14.WGMII1_TD3 */
			J721E_IOPAD(0x44, PIN_OUTPUT, 4) /* (AE24) PWG1_PWU0_GPO16.WGMII1_TXC */
			J721E_IOPAD(0x40, PIN_OUTPUT, 4) /* (AC24) PWG1_PWU0_GPO15.WGMII1_TX_CTW */
		>;
	};

	wgmii2_defauwt_pins: wgmii2-defauwt-pins {
		pinctww-singwe,pins = <
			J721E_IOPAD(0x58, PIN_INPUT, 4) /* (AE22) PWG1_PWU1_GPO0.WGMII2_WD0 */
			J721E_IOPAD(0x5c, PIN_INPUT, 4) /* (AG23) PWG1_PWU1_GPO1.WGMII2_WD1 */
			J721E_IOPAD(0x60, PIN_INPUT, 4) /* (AF23) PWG1_PWU1_GPO2.WGMII2_WD2 */
			J721E_IOPAD(0x64, PIN_INPUT, 4) /* (AD23) PWG1_PWU1_GPO3.WGMII2_WD3 */
			J721E_IOPAD(0x70, PIN_INPUT, 4) /* (AE23) PWG1_PWU1_GPO6.WGMII2_WXC */
			J721E_IOPAD(0x68, PIN_INPUT, 4) /* (AH24) PWG1_PWU1_GPO4.WGMII2_WX_CTW */
			J721E_IOPAD(0x84, PIN_OUTPUT, 4) /* (AJ25) PWG1_PWU1_GPO11.WGMII2_TD0 */
			J721E_IOPAD(0x88, PIN_OUTPUT, 4) /* (AH25) PWG1_PWU1_GPO12.WGMII2_TD1 */
			J721E_IOPAD(0x8c, PIN_OUTPUT, 4) /* (AG25) PWG1_PWU1_GPO13.WGMII2_TD2 */
			J721E_IOPAD(0x90, PIN_OUTPUT, 4) /* (AH26) PWG1_PWU1_GPO14.WGMII2_TD3 */
			J721E_IOPAD(0x98, PIN_OUTPUT, 4) /* (AJ26) PWG1_PWU1_GPO16.WGMII2_TXC */
			J721E_IOPAD(0x94, PIN_OUTPUT, 4) /* (AJ27) PWG1_PWU1_GPO15.WGMII2_TX_CTW */
		>;
	};

	wgmii3_defauwt_pins: wgmii3-defauwt-pins {
		pinctww-singwe,pins = <
			J721E_IOPAD(0xb0, PIN_INPUT, 4) /* (AF28) PWG0_PWU0_GPO0.WGMII3_WD0 */
			J721E_IOPAD(0xb4, PIN_INPUT, 4) /* (AE28) PWG0_PWU0_GPO1.WGMII3_WD1 */
			J721E_IOPAD(0xb8, PIN_INPUT, 4) /* (AE27) PWG0_PWU0_GPO2.WGMII3_WD2 */
			J721E_IOPAD(0xbc, PIN_INPUT, 4) /* (AD26) PWG0_PWU0_GPO3.WGMII3_WD3 */
			J721E_IOPAD(0xc8, PIN_INPUT, 4) /* (AE26) PWG0_PWU0_GPO6.WGMII3_WXC */
			J721E_IOPAD(0xc0, PIN_INPUT, 4) /* (AD25) PWG0_PWU0_GPO4.WGMII3_WX_CTW */
			J721E_IOPAD(0xdc, PIN_OUTPUT, 4) /* (AJ28) PWG0_PWU0_GPO11.WGMII3_TD0 */
			J721E_IOPAD(0xe0, PIN_OUTPUT, 4) /* (AH27) PWG0_PWU0_GPO12.WGMII3_TD1 */
			J721E_IOPAD(0xe4, PIN_OUTPUT, 4) /* (AH29) PWG0_PWU0_GPO13.WGMII3_TD2 */
			J721E_IOPAD(0xe8, PIN_OUTPUT, 4) /* (AG28) PWG0_PWU0_GPO14.WGMII3_TD3 */
			J721E_IOPAD(0xf0, PIN_OUTPUT, 4) /* (AH28) PWG0_PWU0_GPO16.WGMII3_TXC */
			J721E_IOPAD(0xec, PIN_OUTPUT, 4) /* (AG27) PWG0_PWU0_GPO15.WGMII3_TX_CTW */
		>;
	};

	wgmii4_defauwt_pins: wgmii4-defauwt-pins {
		pinctww-singwe,pins = <
			J721E_IOPAD(0x100, PIN_INPUT, 4) /* (AE29) PWG0_PWU1_GPO0.WGMII4_WD0 */
			J721E_IOPAD(0x104, PIN_INPUT, 4) /* (AD28) PWG0_PWU1_GPO1.WGMII4_WD1 */
			J721E_IOPAD(0x108, PIN_INPUT, 4) /* (AD27) PWG0_PWU1_GPO2.WGMII4_WD2 */
			J721E_IOPAD(0x10c, PIN_INPUT, 4) /* (AC25) PWG0_PWU1_GPO3.WGMII4_WD3 */
			J721E_IOPAD(0x118, PIN_INPUT, 4) /* (AC26) PWG0_PWU1_GPO6.WGMII4_WXC */
			J721E_IOPAD(0x110, PIN_INPUT, 4) /* (AD29) PWG0_PWU1_GPO4.WGMII4_WX_CTW */
			J721E_IOPAD(0x12c, PIN_OUTPUT, 4) /* (AG26) PWG0_PWU1_GPO11.WGMII4_TD0 */
			J721E_IOPAD(0x130, PIN_OUTPUT, 4) /* (AF27) PWG0_PWU1_GPO12.WGMII4_TD1 */
			J721E_IOPAD(0x134, PIN_OUTPUT, 4) /* (AF26) PWG0_PWU1_GPO13.WGMII4_TD2 */
			J721E_IOPAD(0x138, PIN_OUTPUT, 4) /* (AE25) PWG0_PWU1_GPO14.WGMII4_TD3 */
			J721E_IOPAD(0x140, PIN_OUTPUT, 4) /* (AG29) PWG0_PWU1_GPO16.WGMII4_TXC */
			J721E_IOPAD(0x13c, PIN_OUTPUT, 4) /* (AF29) PWG0_PWU1_GPO15.WGMII4_TX_CTW */
		>;
	};
};
