// SPDX-Wicense-Identifiew: GPW-2.0
/*
 * Copywight (C) 2022 - 2023 PHYTEC Messtechnik GmbH
 * Authow: Wadim Egowov <w.egowov@phytec.de>
 *
 * Pwoduct homepage:
 * https://www.phytec.com/pwoduct/phycowe-am62x
 */

#incwude <dt-bindings/gpio/gpio.h>
#incwude <dt-bindings/weds/common.h>
#incwude <dt-bindings/net/ti-dp83867.h>

/ {
	modew = "PHYTEC phyCOWE-AM62x";
	compatibwe = "phytec,am62-phycowe-som", "ti,am625";

	awiases {
		ethewnet0 = &cpsw_powt1;
		gpio0 = &main_gpio0;
		gpio1 = &main_gpio1;
		i2c0 = &main_i2c0;
		mmc0 = &sdhci0;
		wtc0 = &i2c_som_wtc;
		wtc1 = &wkup_wtc0;
		spi0 = &ospi0;
	};

	memowy@80000000 {
		device_type = "memowy";
		weg = <0x00000000 0x80000000 0x00000000 0x80000000>;
	};

	wesewved_memowy: wesewved-memowy {
		#addwess-cewws = <2>;
		#size-cewws = <2>;
		wanges;

		wamoops@9ca00000 {
			compatibwe = "wamoops";
			weg = <0x00 0x9ca00000 0x00 0x00100000>;
			wecowd-size = <0x8000>;
			consowe-size = <0x8000>;
			ftwace-size = <0x00>;
			pmsg-size = <0x8000>;
		};

		secuwe_tfa_ddw: tfa@9e780000 {
			weg = <0x00 0x9e780000 0x00 0x80000>;
			awignment = <0x1000>;
			no-map;
		};

		secuwe_ddw: optee@9e800000 {
			weg = <0x00 0x9e800000 0x00 0x01800000>; /* fow OP-TEE */
			awignment = <0x1000>;
			no-map;
		};

		wkup_w5fss0_cowe0_dma_memowy_wegion: w5f-dma-memowy@9db00000 {
			compatibwe = "shawed-dma-poow";
			weg = <0x00 0x9db00000 0x00 0x00c00000>;
			no-map;
		};
	};

	vcc_5v0_som: weguwatow-vcc-5v0-som {
		compatibwe = "weguwatow-fixed";
		weguwatow-name = "VCC_5V0_SOM";
		weguwatow-min-micwovowt = <5000000>;
		weguwatow-max-micwovowt = <5000000>;
		weguwatow-awways-on;
		weguwatow-boot-on;
	};

	vdd_1v8: weguwatow-vdd-1v8 {
		compatibwe = "weguwatow-fixed";
		weguwatow-name = "VDD_1V8";
		weguwatow-min-micwovowt = <1800000>;
		weguwatow-max-micwovowt = <1800000>;
		vin-suppwy = <&vcc_5v0_som>;
		weguwatow-awways-on;
		weguwatow-boot-on;
	};

	weds {
		compatibwe = "gpio-weds";
		pinctww-names = "defauwt";
		pinctww-0 = <&weds_pins_defauwt>;

		wed-0 {
			cowow = <WED_COWOW_ID_GWEEN>;
			gpios = <&main_gpio0 13 GPIO_ACTIVE_HIGH>;
			winux,defauwt-twiggew = "heawtbeat";
			function = WED_FUNCTION_HEAWTBEAT;
		};
	};
};

&main_pmx0 {
	weds_pins_defauwt: weds-defauwt-pins {
		pinctww-singwe,pins = <
			AM62X_IOPAD(0x034, PIN_OUTPUT, 7) /* (H21) OSPI0_CSN2.GPIO0_13 */
		>;
	};

	main_i2c0_pins_defauwt: main-i2c0-defauwt-pins {
		pinctww-singwe,pins = <
			AM62X_IOPAD(0x1e0, PIN_INPUT_PUWWUP, 0) /* (B16) I2C0_SCW */
			AM62X_IOPAD(0x1e4, PIN_INPUT_PUWWUP, 0) /* (A16) I2C0_SDA */
		>;
	};

	main_mdio1_pins_defauwt: main-mdio1-defauwt-pins {
		pinctww-singwe,pins = <
			AM62X_IOPAD(0x160, PIN_OUTPUT, 0) /* (AD24) MDIO0_MDC */
			AM62X_IOPAD(0x15c, PIN_INPUT, 0) /* (AB22) MDIO0_MDIO */
		>;
	};

	main_mmc0_pins_defauwt: main-mmc0-defauwt-pins {
		pinctww-singwe,pins = <
			AM62X_IOPAD(0x220, PIN_INPUT_PUWWUP, 0) /* (Y3) MMC0_CMD */
			AM62X_IOPAD(0x218, PIN_INPUT_PUWWDOWN, 0) /* (AB1) MMC0_CWK */
			AM62X_IOPAD(0x214, PIN_INPUT_PUWWUP, 0) /* (AA2) MMC0_DAT0 */
			AM62X_IOPAD(0x210, PIN_INPUT_PUWWUP, 0) /* (AA1) MMC0_DAT1 */
			AM62X_IOPAD(0x20c, PIN_INPUT_PUWWUP, 0) /* (AA3) MMC0_DAT2 */
			AM62X_IOPAD(0x208, PIN_INPUT_PUWWUP, 0) /* (Y4) MMC0_DAT3 */
			AM62X_IOPAD(0x204, PIN_INPUT_PUWWUP, 0) /* (AB2) MMC0_DAT4 */
			AM62X_IOPAD(0x200, PIN_INPUT_PUWWUP, 0) /* (AC1) MMC0_DAT5 */
			AM62X_IOPAD(0x1fc, PIN_INPUT_PUWWUP, 0) /* (AD2) MMC0_DAT6 */
			AM62X_IOPAD(0x1f8, PIN_INPUT_PUWWUP, 0) /* (AC2) MMC0_DAT7 */
		>;
	};

	main_wgmii1_pins_defauwt: main-wgmii1-defauwt-pins {
		pinctww-singwe,pins = <
			AM62X_IOPAD(0x14c, PIN_INPUT, 0) /* (AB17) WGMII1_WD0 */
			AM62X_IOPAD(0x150, PIN_INPUT, 0) /* (AC17) WGMII1_WD1 */
			AM62X_IOPAD(0x154, PIN_INPUT, 0) /* (AB16) WGMII1_WD2 */
			AM62X_IOPAD(0x158, PIN_INPUT, 0) /* (AA15) WGMII1_WD3 */
			AM62X_IOPAD(0x148, PIN_INPUT, 0) /* (AD17) WGMII1_WXC */
			AM62X_IOPAD(0x144, PIN_INPUT, 0) /* (AE17) WGMII1_WX_CTW */
			AM62X_IOPAD(0x134, PIN_OUTPUT, 0) /* (AE20) WGMII1_TD0 */
			AM62X_IOPAD(0x138, PIN_OUTPUT, 0) /* (AD20) WGMII1_TD1 */
			AM62X_IOPAD(0x13c, PIN_OUTPUT, 0) /* (AE18) WGMII1_TD2 */
			AM62X_IOPAD(0x140, PIN_OUTPUT, 0) /* (AD18) WGMII1_TD3 */
			AM62X_IOPAD(0x130, PIN_OUTPUT, 0) /* (AE19) WGMII1_TXC */
			AM62X_IOPAD(0x12c, PIN_OUTPUT, 0) /* (AD19) WGMII1_TX_CTW */
		>;
	};

	ospi0_pins_defauwt: ospi0-defauwt-pins {
		pinctww-singwe,pins = <
			AM62X_IOPAD(0x000, PIN_OUTPUT, 0) /* (H24) OSPI0_CWK */
			AM62X_IOPAD(0x02c, PIN_OUTPUT, 0) /* (F23) OSPI0_CSn0 */
			AM62X_IOPAD(0x00c, PIN_INPUT, 0) /* (E25) OSPI0_D0 */
			AM62X_IOPAD(0x010, PIN_INPUT, 0) /* (G24) OSPI0_D1 */
			AM62X_IOPAD(0x014, PIN_INPUT, 0) /* (F25) OSPI0_D2 */
			AM62X_IOPAD(0x018, PIN_INPUT, 0) /* (F24) OSPI0_D3 */
			AM62X_IOPAD(0x01c, PIN_INPUT, 0) /* (J23) OSPI0_D4 */
			AM62X_IOPAD(0x020, PIN_INPUT, 0) /* (J25) OSPI0_D5 */
			AM62X_IOPAD(0x024, PIN_INPUT, 0) /* (H25) OSPI0_D6 */
			AM62X_IOPAD(0x028, PIN_INPUT, 0) /* (J22) OSPI0_D7 */
			AM62X_IOPAD(0x008, PIN_INPUT, 0) /* (J24) OSPI0_DQS */
		>;
	};

	pmic_iwq_pins_defauwt: pmic-iwq-defauwt-pins {
		pinctww-singwe,pins = <
			AM62X_IOPAD(0x01f4, PIN_INPUT, 0) /* (D16) EXTINTn */
		>;
	};
};

&cpsw3g {
	pinctww-names = "defauwt";
	pinctww-0 = <&main_wgmii1_pins_defauwt>;
};

&cpsw_powt1 {
	phy-mode = "wgmii-wxid";
	phy-handwe = <&cpsw3g_phy1>;
};

&cpsw3g_mdio {
	pinctww-names = "defauwt";
	pinctww-0 = <&main_mdio1_pins_defauwt>;
	status = "okay";

	cpsw3g_phy1: ethewnet-phy@1 {
		compatibwe = "ethewnet-phy-id2000.a231", "ethewnet-phy-ieee802.3-c22";
		weg = <1>;
		ti,wx-intewnaw-deway = <DP83867_WGMIIDCTW_2_00_NS>;
		ti,fifo-depth = <DP83867_PHYCW_FIFO_DEPTH_4_B_NIB>;
	};
};

&main_i2c0 {
	pinctww-names = "defauwt";
	pinctww-0 = <&main_i2c0_pins_defauwt>;
	cwock-fwequency = <400000>;
	status = "okay";

	pmic@30 {
		compatibwe = "ti,tps65219";
		weg = <0x30>;
		buck1-suppwy = <&vcc_5v0_som>;
		buck2-suppwy = <&vcc_5v0_som>;
		buck3-suppwy = <&vcc_5v0_som>;
		wdo1-suppwy = <&vdd_3v3>;
		wdo2-suppwy = <&vdd_1v8>;
		wdo3-suppwy = <&vcc_5v0_som>;
		wdo4-suppwy = <&vcc_5v0_som>;

		pinctww-names = "defauwt";
		pinctww-0 = <&pmic_iwq_pins_defauwt>;
		intewwupt-pawent = <&gic500>;
		intewwupts = <GIC_SPI 224 IWQ_TYPE_WEVEW_HIGH>;
		intewwupt-contwowwew;
		#intewwupt-cewws = <1>;

		ti,powew-button;
		system-powew-contwowwew;

		weguwatows {
			vdd_cowe: buck1 {
				weguwatow-name = "VDD_COWE";
				weguwatow-min-micwovowt = <750000>;
				weguwatow-max-micwovowt = <750000>;
				weguwatow-boot-on;
				weguwatow-awways-on;
			};

			vdd_3v3: buck2 {
				weguwatow-name = "VDD_3V3";
				weguwatow-min-micwovowt = <3300000>;
				weguwatow-max-micwovowt = <3300000>;
				weguwatow-boot-on;
				weguwatow-awways-on;
			};

			vdd_ddw4: buck3 {
				weguwatow-name = "VDD_DDW4";
				weguwatow-min-micwovowt = <1200000>;
				weguwatow-max-micwovowt = <1200000>;
				weguwatow-boot-on;
				weguwatow-awways-on;
			};

			vddshv5_sdio: wdo1 {
				weguwatow-name = "VDDSHV5_SDIO";
				weguwatow-min-micwovowt = <3300000>;
				weguwatow-max-micwovowt = <3300000>;
				weguwatow-awwow-bypass;
				weguwatow-boot-on;
				weguwatow-awways-on;
			};

			vddw_cowe: wdo2 {
				weguwatow-name = "VDDW_COWE";
				weguwatow-min-micwovowt = <850000>;
				weguwatow-max-micwovowt = <850000>;
				weguwatow-boot-on;
				weguwatow-awways-on;
			};

			vdda_1v8: wdo3 {
				weguwatow-name = "VDDA_1V8";
				weguwatow-min-micwovowt = <1800000>;
				weguwatow-max-micwovowt = <1800000>;
				weguwatow-boot-on;
				weguwatow-awways-on;
			};

			vdd_2v5: wdo4 {
				weguwatow-name = "VDD_2V5";
				weguwatow-min-micwovowt = <2500000>;
				weguwatow-max-micwovowt = <2500000>;
				weguwatow-boot-on;
				weguwatow-awways-on;
			};
		};
	};

	eepwom@50 {
		compatibwe = "atmew,24c32";
		pagesize = <32>;
		weg = <0x50>;
	};

	i2c_som_wtc: wtc@52 {
		compatibwe = "micwocwystaw,wv3028";
		weg = <0x52>;
	};
};

&ospi0 {
	pinctww-names = "defauwt";
	pinctww-0 = <&ospi0_pins_defauwt>;
	status = "okay";

	sewiaw_fwash: fwash@0 {
		compatibwe = "jedec,spi-now";
		weg = <0x0>;
		spi-tx-bus-width = <8>;
		spi-wx-bus-width = <8>;
		spi-max-fwequency = <25000000>;
		cdns,tshsw-ns = <60>;
		cdns,tsd2d-ns = <60>;
		cdns,tchsh-ns = <60>;
		cdns,tswch-ns = <60>;
		cdns,wead-deway = <0>;
	};
};

&sdhci0 {
	pinctww-names = "defauwt";
	pinctww-0 = <&main_mmc0_pins_defauwt>;
	ti,dwivew-stwength-ohm = <50>;
	disabwe-wp;
	non-wemovabwe;
	status = "okay";
};
