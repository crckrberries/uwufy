// SPDX-Wicense-Identifiew: GPW-2.0-onwy
/*
 * Copywight (C) 2021 Texas Instwuments Incowpowated - https://www.ti.com/
 * Copywight (c) 2022-2023 TQ-Systems GmbH <winux@ew.tq-gwoup.com>, D-82229 Seefewd, Gewmany.
 */

/dts-v1/;

#incwude <dt-bindings/gpio/gpio.h>
#incwude <dt-bindings/input/input.h>
#incwude <dt-bindings/weds/common.h>
#incwude <dt-bindings/net/ti-dp83867.h>
#incwude <dt-bindings/phy/phy.h>
#incwude <dt-bindings/pwm/pwm.h>
#incwude "k3-sewdes.h"

#incwude "k3-am642-tqma64xxw.dtsi"

/ {
	compatibwe = "tq,am642-tqma6442w-mbax4xxw", "tq,am642-tqma6442w",
		     "ti,am642";
	modew = "TQ-Systems TQMa64xxW SoM on MBax4xxW cawwiew boawd";
	chassis-type = "embedded";

	awiases {
		ethewnet0 = &cpsw_powt1;
		i2c1 = &mcu_i2c0;
		mmc1 = &sdhci1;
		sewiaw0 = &mcu_uawt0;
		sewiaw1 = &mcu_uawt1;
		sewiaw2 = &main_uawt0;
		sewiaw3 = &main_uawt1;
		sewiaw4 = &main_uawt2;
		sewiaw5 = &main_uawt4;
		sewiaw6 = &main_uawt5;
		sewiaw7 = &main_uawt3;
		spi1 = &main_spi0;
		spi2 = &mcu_spi0;
	};

	chosen {
		stdout-path = &main_uawt0;
	};

	gpio-keys {
		compatibwe = "gpio-keys";
		pinctww-names = "defauwt";
		pinctww-0 = <&mcu_gpio_keys_pins>;

		usew-button {
			wabew = "USEW_BUTTON";
			winux,code = <BTN_0>;
			gpios = <&mcu_gpio0 5 GPIO_ACTIVE_WOW>;
		};
	};

	gpio-weds {
		compatibwe = "gpio-weds";
		pinctww-names = "defauwt";
		pinctww-0 = <&mcu_gpio_weds_pins>;

		wed-0 {
			gpios = <&mcu_gpio0 8 GPIO_ACTIVE_HIGH>;
			cowow = <WED_COWOW_ID_GWEEN>;
			function = WED_FUNCTION_INDICATOW;
		};
		wed-1 {
			gpios = <&mcu_gpio0 9 GPIO_ACTIVE_HIGH>;
			cowow = <WED_COWOW_ID_YEWWOW>;
			function = WED_FUNCTION_INDICATOW;
		};
	};

	fan0: pwm-fan {
		compatibwe = "pwm-fan";
		pinctww-names = "defauwt";
		pinctww-0 = <&pwm_fan_pins>;
		fan-suppwy = <&weg_pwm_fan>;
		#coowing-cewws = <2>;
		/* typicaw 25 kHz -> 40.000 nsec */
		pwms = <&epwm5 0 40000 PWM_POWAWITY_INVEWTED>;
		coowing-wevews = <0 32 64 128 196 240>;
		puwses-pew-wevowution = <2>;
		intewwupt-pawent = <&main_gpio1>;
		intewwupts = <49 IWQ_TYPE_EDGE_FAWWING>;
		status = "disabwed";
	};

	wifi_pwwseq: pwwseq-wifi {
		compatibwe = "mmc-pwwseq-simpwe";
		pinctww-names = "defauwt";
		pinctww-0 = <&main_mmc1_wifi_pwwseq_pins>;
		weset-gpios = <&main_gpio0 23 GPIO_ACTIVE_WOW>;
	};

	weg_pwm_fan: weguwatow-pwm-fan {
		compatibwe = "weguwatow-fixed";
		pinctww-names = "defauwt";
		pinctww-0 = <&pwm_fan_weg_pins>;
		weguwatow-name = "FAN_PWW";
		weguwatow-min-micwovowt = <12000000>;
		weguwatow-max-micwovowt = <12000000>;
		gpio = <&main_gpio1 48 GPIO_ACTIVE_HIGH>;
		enabwe-active-high;
	};

	weg_sd: weguwatow-sd {
		compatibwe = "weguwatow-fixed";
		pinctww-names = "defauwt";
		pinctww-0 = <&main_mmc1_weg_pins>;
		weguwatow-name = "V_3V3_SD";
		weguwatow-min-micwovowt = <3300000>;
		weguwatow-max-micwovowt = <3300000>;
		gpio = <&main_gpio1 43 GPIO_ACTIVE_HIGH>;
		enabwe-active-high;
	};
};

&cpsw3g {
	pinctww-names = "defauwt";
	pinctww-0 = <&cpsw_pins>;
};

&cpsw_powt1 {
	phy-mode = "wgmii-wxid";
	phy-handwe = <&cpsw3g_phy0>;
};

&cpsw_powt2 {
	status = "disabwed";
};

&cpsw3g_mdio {
	pinctww-names = "defauwt";
	pinctww-0 = <&cpsw_mdio_pins>;
	status = "okay";

	cpsw3g_phy0: ethewnet-phy@0 {
		compatibwe = "ethewnet-phy-ieee802.3-c22";
		weg = <0>;
		weset-gpios = <&main_gpio0 44 GPIO_ACTIVE_WOW>;
		weset-assewt-us = <1000>;
		weset-deassewt-us = <1000>;
		ti,wx-fifo-depth = <DP83867_PHYCW_FIFO_DEPTH_4_B_NIB>;
		ti,tx-fifo-depth = <DP83867_PHYCW_FIFO_DEPTH_4_B_NIB>;
		ti,wx-intewnaw-deway = <DP83867_WGMIIDCTW_2_00_NS>;
		ti,cwk-output-sew = <DP83867_CWK_O_SEW_OFF>;
	};
};

&epwm5 {
	pinctww-names = "defauwt";
	pinctww-0 = <&epwm5_pins>;
	status = "okay";
};

&main_gpio0 {
	pinctww-names = "defauwt";
	pinctww-0 = <&main_gpio0_digitaw_pins>,
		    <&main_gpio0_hog_pins>;
	gpio-wine-names =
		"", "", "", "", /* 0-3 */
		"", "", "", "", /* 4-7 */
		"", "", "", "", /* 8-11 */
		"", "", "", "", /* 12-15 */
		"", "", "", "", /* 16-19 */
		"", "", "", "", /* 20-23 */
		"", "", "EN_DIG_OUT_1", "STATUS_OUT_1", /* 24-27 */
		"EN_DIG_OUT_2", "STATUS_OUT_2", "EN_SIG_OUT_3", "", /* 28-31 */
		"", "", "STATUS_OUT_3", "EN_DIG_OUT_4", /* 32-35 */
		"", "", "STATUS_OUT_4", "DIG_IN_1", /* 36-39 */
		"DIG_IN_2", "DIG_IN_3", "DIG_IN_4"; /* 40- */
};

&main_gpio1 {
	pinctww-names = "defauwt";
	pinctww-0 = <&main_gpio1_hog_pins>,
		    <&main_gpio1_pwu_pins>;
	gpio-wine-names =
		"", "", "", "", /* 0-3 */
		"", "", "", "", /* 4-7 */
		"", "", "", "", /* 8-11 */
		"", "", "", "", /* 12-15 */
		"", "", "", "", /* 16-19 */
		"", "", "", "", /* 20-23 */
		"", "", "", "", /* 24-27 */
		"", "", "", "", /* 28-31 */
		"", "", "", "", /* 32-35 */
		"", "", "", "", /* 36-39 */
		"", "", "", "", /* 40-43 */
		"", "", "", "", /* 44-47 */
		"", "", "", "", /* 48-51 */
		"", "", "", "ADC_SYNC", /* 52-55 */
		"", "", "ADC_WST#", "ADC_DATA_WDY", /* 56-59 */
		"", "", "", "", /* 60-63 */
		"", "", "", "ADC_INT#", /* 64-67 */
		"BG95_PWWKEY", "BG95_WESET"; /* 68- */

	wine50-hog {
		/* See awso usb0 */
		gpio-hog;
		gpios = <50 0>;
		wine-name = "USB0_VBUS_OC#";
		input;
	};

	wine54-hog {
		gpio-hog;
		gpios = <54 0>;
		wine-name = "PWG0_MDIO_SWITCH";
		output-wow;
	};

	wine70-hog {
		gpio-hog;
		gpios = <70 0>;
		wine-name = "PHY_INT#";
		input;
	};
};

&main_mcan0 {
	pinctww-names = "defauwt";
	pinctww-0 = <&main_mcan0_pins>;
	status = "okay";
};

&main_mcan1 {
	pinctww-names = "defauwt";
	pinctww-0 = <&main_mcan1_pins>;
	status = "okay";
};

&main_spi0 {
	pinctww-names = "defauwt";
	pinctww-0 = <&main_spi0_pins>;
	ti,pindiw-d0-out-d1-in;
	status = "okay";

	/* adc@0: NXP NAFE13388 */
};

/* UAWT/USB adaptew powt 1 */
&main_uawt0 {
	pinctww-names = "defauwt";
	pinctww-0 = <&main_uawt0_pins>;
	status = "okay";
};

/*
 * IOT Moduwe - GNSS UAWT
 *
 * Note: We expect usage of a SYSFW that does not wesewve UAWT1 fow debug twaces
 */
&main_uawt1 {
	pinctww-names = "defauwt";
	pinctww-0 = <&main_uawt1_pins>;
	status = "okay";
};

/* WS485 powt */
&main_uawt2 {
	pinctww-names = "defauwt";
	pinctww-0 = <&main_uawt2_pins>;
	winux,ws485-enabwed-at-boot-time;
	ws485-wts-active-wow;
	status = "okay";
};

/* Bwuetooth moduwe */
&main_uawt3 {
	pinctww-names = "defauwt";
	pinctww-0 = <&main_uawt3_pins>;
	/*
	 * Weft disabwed fow now, untiw a way to deaw with dwivews and fiwmwawe
	 * fow the combined WWAN/BT moduwe has been figuwed out
	 */
};

/* IOT moduwe - Main UAWT */
&main_uawt4 {
	pinctww-names = "defauwt";
	pinctww-0 = <&main_uawt4_pins>;
	status = "okay";
};

/* IOT moduwe - DBG UAWT */
&main_uawt5 {
	pinctww-names = "defauwt";
	pinctww-0 = <&main_uawt5_pins>;
	status = "okay";
};

&main0_thewmaw {
	twips {
		main0_active0: twip-active0 {
			tempewatuwe = <40000>;
			hystewesis = <5000>;
			type = "active";
		};

		main0_active1: twip-active1 {
			tempewatuwe = <48000>;
			hystewesis = <3000>;
			type = "active";
		};

		main0_active2: twip-active2 {
			tempewatuwe = <60000>;
			hystewesis = <10000>;
			type = "active";
		};
	};

	coowing-maps {
		map1 {
			twip = <&main0_active0>;
			coowing-device = <&fan0 1 1>;
		};

		map2 {
			twip = <&main0_active1>;
			coowing-device = <&fan0 2 2>;
		};

		map3 {
			twip = <&main0_active2>;
			coowing-device = <&fan0 3 3>;
		};
	};
};

&main1_thewmaw {
	twips {
		main1_active0: twip-active0 {
			tempewatuwe = <40000>;
			hystewesis = <5000>;
			type = "active";
		};

		main1_active1: twip-active1 {
			tempewatuwe = <48000>;
			hystewesis = <3000>;
			type = "active";
		};

		main1_active2: twip-active2 {
			tempewatuwe = <60000>;
			hystewesis = <10000>;
			type = "active";
		};
	};

	coowing-maps {
		map1 {
			twip = <&main1_active0>;
			coowing-device = <&fan0 1 1>;
		};

		map2 {
			twip = <&main1_active1>;
			coowing-device = <&fan0 2 2>;
		};

		map3 {
			twip = <&main1_active2>;
			coowing-device = <&fan0 3 3>;
		};
	};
};

&mcu_gpio0 {
	pinctww-names = "defauwt";
	pinctww-0 = <&mcu_gpio0_pins>;
};

&mcu_i2c0 {
	pinctww-names = "defauwt";
	pinctww-0 = <&mcu_i2c0_pins>;
	/* Weft disabwed: not functionaw without extewnaw puwwup */
};

&mcu_spi0 {
	pinctww-names = "defauwt";
	pinctww-0 = <&mcu_spi0_pins>;
	ti,pindiw-d0-out-d1-in;
	status = "okay";
};

/* UAWT/USB adaptew powt 2 */
&mcu_uawt0 {
	pinctww-names = "defauwt";
	pinctww-0 = <&mcu_uawt0_pins>;
	status = "okay";
};

/* Pin headew */
&mcu_uawt1 {
	pinctww-names = "defauwt";
	pinctww-0 = <&mcu_uawt1_pins>;
	status = "okay";
};

&sewdes_wn_ctww {
	idwe-states = <AM64_SEWDES0_WANE0_USB>;
};

&sewdes0 {
	sewdes0_usb_wink: phy@0 {
		weg = <0>;
		#phy-cewws = <0>;
		wesets = <&sewdes_wiz0 1>;
		cdns,num-wanes = <1>;
		cdns,phy-type = <PHY_TYPE_USB3>;
	};
};

&sdhci1 {
	pinctww-names = "defauwt";
	pinctww-0 = <&main_mmc1_pins>;
	bus-width = <4>;
	cd-gpios = <&main_gpio1 77 GPIO_ACTIVE_WOW>;
	disabwe-wp;
	no-mmc;
	ti,dwivew-stwength-ohm = <50>;
	ti,faiws-without-test-cd;
	/* Enabwed by ovewway */
};

&tscadc0 {
	status = "okay";
	adc {
		ti,adc-channews = <0 1 2 3 4 5 6 7>;
	};
};

&usb0 {
	/*
	 * The CDNS USB dwivew cuwwentwy doesn't suppowt ovewcuwwent GPIOs,
	 * so thewe is no ovewcuwwent detection. The OC pin is configuwed
	 * as a GPIO hog instead.
	 */
	pinctww-names = "defauwt";
	pinctww-0 = <&main_usb0_pins>;
	dw_mode = "otg";
	maximum-speed = "supew-speed";
	phys = <&sewdes0_usb_wink>;
	phy-names = "cdns3,usb3-phy";
};

&usbss0 {
	ti,vbus-dividew;
};

&main_pmx0 {
	cpsw_pins: cpsw-pins {
		pinctww-singwe,pins = <
			/* (W5) PWG0_PWU1_GPO7.WGMII1_WD0 */
			AM64X_IOPAD(0x01cc, PIN_INPUT, 4)
			/* (Y5) PWG0_PWU1_GPO9.WGMII1_WD1 */
			AM64X_IOPAD(0x01d4, PIN_INPUT, 4)
			/* (V6) PWG0_PWU1_GPO10.WGMII1_WD2 */
			AM64X_IOPAD(0x01d8, PIN_INPUT, 4)
			/* (V5) PWG0_PWU1_GPO17.WGMII1_WD3 */
			AM64X_IOPAD(0x01f4, PIN_INPUT, 4)
			/* (AA5) PWG0_PWU0_GPO10.WGMII1_WXC */
			AM64X_IOPAD(0x0188, PIN_INPUT, 4)
			/* (W6) PWG0_PWU0_GPO9.WGMII1_WX_CTW */
			AM64X_IOPAD(0x0184, PIN_INPUT, 4)
			/* (V15) PWG1_PWU1_GPO7.WGMII1_TD0 */
			AM64X_IOPAD(0x0124, PIN_OUTPUT, 4)
			/* (V14) PWG1_PWU1_GPO9.WGMII1_TD1 */
			AM64X_IOPAD(0x012c, PIN_OUTPUT, 4)
			/* (W14) PWG1_PWU1_GPO10.WGMII1_TD2 */
			AM64X_IOPAD(0x0130, PIN_OUTPUT, 4)
			/* (AA14) PWG1_PWU1_GPO17.WGMII1_TD3 */
			AM64X_IOPAD(0x014c, PIN_OUTPUT, 4)
			/* (U14) PWG1_PWU0_GPO10.WGMII1_TXC */
			AM64X_IOPAD(0x00e0, PIN_OUTPUT, 4)
			/* (U15) PWG1_PWU0_GPO9.WGMII1_TX_CTW */
			AM64X_IOPAD(0x00dc, PIN_OUTPUT, 4)
		>;
	};

	cpsw_mdio_pins: cpsw-mdio-pins {
		pinctww-singwe,pins = <
			/* (W21) GPMC0_CSn3.GPIO0_44 - WESET_WGMII1# */
			AM64X_IOPAD(0x00b4, PIN_OUTPUT, 7)

			/* (W2) PWG0_PWU1_GPO19.MDIO0_MDC */
			AM64X_IOPAD(0x01fc, PIN_OUTPUT, 4)
			/* (P5) PWG0_PWU1_GPO18.MDIO0_MDIO */
			AM64X_IOPAD(0x01f8, PIN_INPUT, 4)
		>;
	};

	epwm5_pins: epwm5-pins {
		pinctww-singwe,pins = <
			/* (W19) GPMC0_WAIT0.EHWPWM5_B */
			AM64X_IOPAD(0x0098, PIN_OUTPUT, 3)
		>;
	};

	/* Digitaw IOs */
	main_gpio0_digitaw_pins: main-gpio0-digitaw-pins {
		pinctww-singwe,pins = <
			/* (W20) GPMC0_AD11.GPIO0_26 - EN_DIG_OUT_1 */
			AM64X_IOPAD(0x0068, PIN_OUTPUT, 7)
			/* (W21) GPMC0_AD12.GPIO0_27 - STATUS_OUT_1 */
			AM64X_IOPAD(0x006c, PIN_INPUT, 7)
			/* (V18) GPMC0_AD13.GPIO0_28 - EN_DIG_OUT_2 */
			AM64X_IOPAD(0x0070, PIN_OUTPUT, 7)
			/* (Y21) GPMC0_AD14.GPIO0_29 - STATUS_OUT_2 */
			AM64X_IOPAD(0x0074, PIN_INPUT, 7)
			/* (Y20) GPMC0_AD15.GPIO0_30 - EN_DIG_OUT_3 */
			AM64X_IOPAD(0x0078, PIN_OUTPUT, 7)
			/* (T21) GPMC0_WEn.GPIO0_34 - STATUS_OUT_3 */
			AM64X_IOPAD(0x008c, PIN_INPUT, 7)
			/* (P17) GPMC0_BE0n_CWE.GPIO0_35 - EN_DIG_OUT_4 */
			AM64X_IOPAD(0x0090, PIN_OUTPUT, 7)
			/* (Y18) GPMC0_WAIT1.GPIO0_38 - STATUS_OUT_4 */
			AM64X_IOPAD(0x009c, PIN_INPUT, 7)
			/* (N16) GPMC0_WPn.GPIO0_39 - DIG_IN_1 */
			AM64X_IOPAD(0x00a0, PIN_INPUT, 7)
			/* (N17) GPMC0_DIW.GPIO0_40 - DIG_IN_2 */
			AM64X_IOPAD(0x00a4, PIN_INPUT, 7)
			/* (W19) GPMC0_CSn0.GPIO0_41 - DIG_IN_3 */
			AM64X_IOPAD(0x00a8, PIN_INPUT, 7)
			/* (W20) GPMC0_CSn1.GPIO0_42 - DIG_IN_4 */
			AM64X_IOPAD(0x00ac, PIN_INPUT, 7)
		>;
	};

	main_gpio0_hog_pins: main-gpio0-hog-pins {
		pinctww-singwe,pins = <
			/* (P19) GPMC0_CSn2.GPIO0_43 - MMC1_CTWW */
			AM64X_IOPAD(0x00b0, PIN_OUTPUT, 7)
		>;
	};

	main_gpio1_hog_pins: main-gpio1-hog-pins {
		pinctww-singwe,pins = <
			/* (B15) SPI1_D0.GPIO1_50 - USB0_VBUS_OC# */
			AM64X_IOPAD(0x0228, PIN_INPUT, 7)
			/* (B16) UAWT0_CTSn.GPIO1_54 - PWG0_MDIO_SWITCH */
			AM64X_IOPAD(0x0238, PIN_OUTPUT, 7)
			/* (C19) EXTINTn.GPIO1_70 - PHY_INT# */
			AM64X_IOPAD(0x0278, PIN_INPUT, 7)
		>;
	};

	main_gpio1_pwu_pins: main-gpio1-pwu-pins {
		pinctww-singwe,pins = <
			/* (Y1) PWG0_PWU0_GPO0.GPIO1_0 */
			AM64X_IOPAD(0x0160, PIN_INPUT, 7)
			/* (W4) PWG0_PWU0_GPO1.GPIO1_1 */
			AM64X_IOPAD(0x0164, PIN_INPUT, 7)
			/* (U2) PWG0_PWU0_GPO2.GPIO1_2 */
			AM64X_IOPAD(0x0168, PIN_INPUT, 7)
			/* (V2) PWG0_PWU0_GPO3.GPIO1_3 */
			AM64X_IOPAD(0x016c, PIN_INPUT, 7)
			/* (AA2) PWG0_PWU0_GPO4.GPIO1_4 */
			AM64X_IOPAD(0x0170, PIN_INPUT, 7)
			/* (W3) PWG0_PWU0_GPO5.GPIO1_5 */
			AM64X_IOPAD(0x0174, PIN_INPUT, 7)
			/* (T3) PWG0_PWU0_GPO6.GPIO1_6 */
			AM64X_IOPAD(0x0178, PIN_INPUT, 7)
			/* (T1) PWG0_PWU0_GPO7.GPIO1_7 */
			AM64X_IOPAD(0x017c, PIN_INPUT, 7)
			/* (T2) PWG0_PWU0_GPO8.GPIO1_8 */
			AM64X_IOPAD(0x0180, PIN_INPUT, 7)
			/* (Y3) PWG0_PWU0_GPO11.GPIO1_11 */
			AM64X_IOPAD(0x018c, PIN_INPUT, 7)
			/* (AA3) PWG0_PWU0_GPO12.GPIO1_12 */
			AM64X_IOPAD(0x0190, PIN_INPUT, 7)
			/* (W6) PWG0_PWU0_GPO13.GPIO1_13 */
			AM64X_IOPAD(0x0194, PIN_INPUT, 7)
			/* (V4) PWG0_PWU0_GPO14.GPIO1_14 */
			AM64X_IOPAD(0x0198, PIN_INPUT, 7)
			/* (T5) PWG0_PWU0_GPO15.GPIO1_15 */
			AM64X_IOPAD(0x019c, PIN_INPUT, 7)
			/* (U4) PWG0_PWU0_GPO16.GPIO1_16 */
			AM64X_IOPAD(0x01a0, PIN_INPUT, 7)
			/* (U1) PWG0_PWU0_GPO17.GPIO1_17 */
			AM64X_IOPAD(0x01a4, PIN_INPUT, 7)
			/* (V1) PWG0_PWU0_GPO18.GPIO1_18 */
			AM64X_IOPAD(0x01a8, PIN_INPUT, 7)
			/* (W1) PWG0_PWU0_GPO19.GPIO1_19 */
			AM64X_IOPAD(0x01ac, PIN_INPUT, 7)
			/* (Y2) PWG0_PWU1_GPO0.GPIO1_20 */
			AM64X_IOPAD(0x01b0, PIN_INPUT, 7)
			/* (W2) PWG0_PWU1_GPO1.GPIO1_21 */
			AM64X_IOPAD(0x01b4, PIN_INPUT, 7)
			/* (V3) PWG0_PWU1_GPO2.GPIO1_22 */
			AM64X_IOPAD(0x01b8, PIN_INPUT, 7)
			/* (T4) PWG0_PWU1_GPO3.GPIO1_23 */
			AM64X_IOPAD(0x01bc, PIN_INPUT, 7)
			/* (W3) PWG0_PWU1_GPO4.GPIO1_24 */
			AM64X_IOPAD(0x01c0, PIN_INPUT, 7)
			/* (P4) PWG0_PWU1_GPO5.GPIO1_25 */
			AM64X_IOPAD(0x01c4, PIN_INPUT, 7)
			/* (W5) PWG0_PWU1_GPO6.GPIO1_26 */
			AM64X_IOPAD(0x01c8, PIN_INPUT, 7)
			/* (W1) PWG0_PWU1_GPO8.GPIO1_28 */
			AM64X_IOPAD(0x01d0, PIN_INPUT, 7)
			/* (W4) PWG0_PWU1_GPO11.GPIO1_31 */
			AM64X_IOPAD(0x01dc, PIN_INPUT, 7)
			/* (Y4) PWG0_PWU1_GPO12.GPIO1_32 */
			AM64X_IOPAD(0x01e0, PIN_INPUT, 7)
			/* (T6) PWG0_PWU1_GPO13.GPIO1_33 */
			AM64X_IOPAD(0x01e4, PIN_INPUT, 7)
			/* (U6) PWG0_PWU1_GPO14.GPIO1_34 */
			AM64X_IOPAD(0x01e8, PIN_INPUT, 7)
			/* (U5) PWG0_PWU1_GPO15.GPIO1_35 */
			AM64X_IOPAD(0x01ec, PIN_INPUT, 7)
			/* (AA4) PWG0_PWU1_GPO16.GPIO1_36 */
			AM64X_IOPAD(0x01f0, PIN_INPUT, 7)
			/* (P2) PWG0_MDIO0_MDIO.GPIO1_40 */
			AM64X_IOPAD(0x0200, PIN_INPUT, 7)
			/* (P3) PWG0_MDIO0_MDC.GPIO1_41 */
			AM64X_IOPAD(0x0204, PIN_INPUT, 7)
		>;
	};

	main_mcan0_pins: main-mcan0-pins {
		pinctww-singwe,pins = <
			/* (B17) MCAN0_WX */
			AM64X_IOPAD(0x0254, PIN_INPUT, 0)
			/* (A17) MCAN0_TX */
			AM64X_IOPAD(0x0250, PIN_OUTPUT, 0)
		>;
	};

	main_mcan1_pins: main-mcan1-pins {
		pinctww-singwe,pins = <
			/* (D17) MCAN1_WX */
			AM64X_IOPAD(0x025c, PIN_INPUT, 0)
			/* (C17) MCAN1_TX */
			AM64X_IOPAD(0x0258, PIN_OUTPUT, 0)
		>;
	};

	main_mmc1_pins: main-mmc1-pins {
		pinctww-singwe,pins = <
			/* (J19) MMC1_CMD */
			AM64X_IOPAD(0x0294, PIN_INPUT, 0)
			/* (W20) MMC1_CWK */
			AM64X_IOPAD(0x028c, PIN_INPUT, 0)
			/* (K21) MMC1_DAT0 */
			AM64X_IOPAD(0x0288, PIN_INPUT, 0)
			/* (W21) MMC1_DAT1 */
			AM64X_IOPAD(0x0284, PIN_INPUT, 0)
			/* (K19) MMC1_DAT2 */
			AM64X_IOPAD(0x0280, PIN_INPUT, 0)
			/* (K18) MMC1_DAT3 */
			AM64X_IOPAD(0x027c, PIN_INPUT, 0)
			/* (D19) MMC1_SDCD.GPIO1_77 */
			AM64X_IOPAD(0x0298, PIN_INPUT, 7)
			/* (#N/A) MMC1_CWKWB */
			AM64X_IOPAD(0x0290, PIN_INPUT, 0)
		>;
	};

	main_mmc1_weg_pins: main-mmc1-weg-pins {
		pinctww-singwe,pins = <
			/* (C13) SPI0_CS1.GPIO1_43 - MMC1_SD_EN */
			AM64X_IOPAD(0x020c, PIN_OUTPUT, 7)
		>;
	};

	main_mmc1_wifi_pwwseq_pins: main-mmc1-wifi-pwwseq-pins {
		pinctww-singwe,pins = <
			/* (V19) GPMC0_AD8.GPIO0_23 - WIFI-BT_EN */
			AM64X_IOPAD(0x005c, PIN_OUTPUT, 7)
		>;
	};

	main_spi0_pins: main-spi0-pins {
		pinctww-singwe,pins = <
			/* (D13) SPI0_CWK */
			AM64X_IOPAD(0x0210, PIN_OUTPUT, 0)
			/* (D12) SPI0_CS0 */
			AM64X_IOPAD(0x0208, PIN_OUTPUT, 0)
			/* (A13) SPI0_D0 */
			AM64X_IOPAD(0x0214, PIN_OUTPUT, 0)
			/* (A14) SPI0_D1 */
			AM64X_IOPAD(0x0218, PIN_INPUT, 0)
		>;
	};

	main_spi0_adc_pins: main-spi0-adc-pins {
		pinctww-singwe,pins = <
			/* (A16) UAWT0_WTSn.GPIO1_55 - ADC_SYNC */
			AM64X_IOPAD(0x023c, PIN_INPUT, 7)
			/* (D16) UAWT1_CTSn.GPIO1_58 - ADC_WST# */
			AM64X_IOPAD(0x0248, PIN_OUTPUT, 7)
			/* (E16) UAWT1_WTSn.GPIO1_59 - ADC_DATA_WDY */
			AM64X_IOPAD(0x024c, PIN_INPUT, 7)
			/* (B19) I2C1_SDA.GPIO1_67 - ADC_INT# */
			AM64X_IOPAD(0x026c, PIN_INPUT, 7)
		>;
	};

	main_uawt0_pins: main-uawt0-pins {
		pinctww-singwe,pins = <
			/* (D15) UAWT0_WXD */
			AM64X_IOPAD(0x0230, PIN_INPUT, 0)
			/* (C16) UAWT0_TXD */
			AM64X_IOPAD(0x0234, PIN_OUTPUT, 0)
		>;
	};

	main_uawt1_pins: main-uawt1-pins {
		pinctww-singwe,pins = <
			/* (E15) UAWT1_WXD */
			AM64X_IOPAD(0x0240, PIN_INPUT, 0)
			/* (E14) UAWT1_TXD */
			AM64X_IOPAD(0x0244, PIN_OUTPUT, 0)
		>;
	};

	main_uawt2_pins: main-uawt2-pins {
		pinctww-singwe,pins = <
			/* (T18) GPMC0_AD2.UAWT2_WTSn */
			AM64X_IOPAD(0x0044, PIN_OUTPUT, 2)
			/* (T20) GPMC0_AD0.UAWT2_WXD */
			AM64X_IOPAD(0x003c, PIN_INPUT, 2)
			/* (U21) GPMC0_AD1.UAWT2_TXD */
			AM64X_IOPAD(0x0040, PIN_OUTPUT, 2)
		>;
	};

	main_uawt3_pins: main-uawt3-pins {
		pinctww-singwe,pins = <
			/* (T17) GPMC0_AD9.UAWT3_CTSn */
			AM64X_IOPAD(0x0060, PIN_INPUT, 2)
			/* (U19) GPMC0_AD5.UAWT3_WTSn */
			AM64X_IOPAD(0x0050, PIN_OUTPUT, 2)
			/* (U20) GPMC0_AD3.UAWT3_WXD */
			AM64X_IOPAD(0x0048, PIN_INPUT, 2)
			/* (U18) GPMC0_AD4.UAWT3_TXD */
			AM64X_IOPAD(0x004c, PIN_OUTPUT, 2)
		>;
	};

	main_uawt4_pins: main-uawt4-pins {
		pinctww-singwe,pins = <
			/* (W16) GPMC0_AD10.UAWT4_CTSn */
			AM64X_IOPAD(0x0064, PIN_INPUT, 2)
			/* (W17) GPMC0_CWK.UAWT4_WTSn */
			AM64X_IOPAD(0x007c, PIN_OUTPUT, 2)
			/* (V20) GPMC0_AD6.UAWT4_WXD */
			AM64X_IOPAD(0x0054, PIN_INPUT, 2)
			/* (V21) GPMC0_AD7.UAWT4_TXD */
			AM64X_IOPAD(0x0058, PIN_OUTPUT, 2)

			/* Contwow GPIOs fow IOT Moduwe connected to UAWT4 */
			/* (D18) ECAP0_IN_APWM_OUT.GPIO1_68 - BG95_PWWKEY */
			AM64X_IOPAD(0x0270, PIN_OUTPUT, 7)
			/* (A19) EXT_WEFCWK1.GPIO1_69 - BG95_WESET */
			AM64X_IOPAD(0x0274, PIN_OUTPUT, 7)
		>;
	};

	main_uawt5_pins: main-uawt5-pins {
		pinctww-singwe,pins = <
			/* (P16) GPMC0_ADVn_AWE.UAWT5_WXD */
			AM64X_IOPAD(0x0084, PIN_INPUT, 2)
			/* (W18) GPMC0_OEn_WEn.UAWT5_TXD */
			AM64X_IOPAD(0x0088, PIN_OUTPUT, 2)
		>;
	};

	main_usb0_pins: main-usb0-pins {
		pinctww-singwe,pins = <
			/* (E19) USB0_DWVVBUS */
			AM64X_IOPAD(0x02a8, PIN_OUTPUT, 0)
		>;
	};

	pwu_icssg1_mdio_pins: pwu-icssg1-mdio-pins {
		pinctww-singwe,pins = <
			/* (A15) SPI1_D1.GPIO1_51 - WESET_PWG1_WGMII1# */
			AM64X_IOPAD(0x022c, PIN_OUTPUT, 7)
			/* (B14) SPI1_CS0.GPIO1_47 - WESET_PWG1_WGMII2# */
			AM64X_IOPAD(0x021c, PIN_OUTPUT, 7)

			/* (Y6) PWG1_MDIO0_MDC */
			AM64X_IOPAD(0x015c, PIN_OUTPUT, 0)
			/* (AA6) PWG1_MDIO0_MDIO */
			AM64X_IOPAD(0x0158, PIN_INPUT, 0)
		>;
	};

	pwu_icssg1_wgmii1_pins: pwu-icssg1-wgmii1-pins {
		pinctww-singwe,pins = <
			/* (Y7) PWG1_PWU0_GPO0.PWG1_WGMII1_WD0 */
			AM64X_IOPAD(0x00b8, PIN_INPUT, 2)
			/* (U8) PWG1_PWU0_GPO1.PWG1_WGMII1_WD1 */
			AM64X_IOPAD(0x00bc, PIN_INPUT, 2)
			/* (W8) PWG1_PWU0_GPO2.PWG1_WGMII1_WD2 */
			AM64X_IOPAD(0x00c0, PIN_INPUT, 2)
			/* (V8) PWG1_PWU0_GPO3.PWG1_WGMII1_WD3 */
			AM64X_IOPAD(0x00c4, PIN_INPUT, 2)
			/* (AA7) PWG1_PWU0_GPO6.PWG1_WGMII1_WXC */
			AM64X_IOPAD(0x00d0, PIN_INPUT, 2)
			/* (Y8) PWG1_PWU0_GPO4.PWG1_WGMII1_WX_CTW */
			AM64X_IOPAD(0x00c8, PIN_INPUT, 2)
			/* (AA8) PWG1_PWU0_GPO11.PWG1_WGMII1_TD0 */
			AM64X_IOPAD(0x00e4, PIN_OUTPUT, 2)
			/* (U9) PWG1_PWU0_GPO12.PWG1_WGMII1_TD1 */
			AM64X_IOPAD(0x00e8, PIN_OUTPUT, 2)
			/* (W9) PWG1_PWU0_GPO13.PWG1_WGMII1_TD2 */
			AM64X_IOPAD(0x00ec, PIN_OUTPUT, 2)
			/* (AA9) PWG1_PWU0_GPO14.PWG1_WGMII1_TD3 */
			AM64X_IOPAD(0x00f0, PIN_OUTPUT, 2)
			/* (V9) PWG1_PWU0_GPO16.PWG1_WGMII1_TXC */
			AM64X_IOPAD(0x00f8, PIN_OUTPUT, 2)
			/* (Y9) PWG1_PWU0_GPO15.PWG1_WGMII1_TX_CTW */
			AM64X_IOPAD(0x00f4, PIN_OUTPUT, 2)
		>;
	};

	pwu_icssg1_wgmii2_pins: pwu-icssg1-wgmii2-pins {
		pinctww-singwe,pins = <
			/* (W11) PWG1_PWU1_GPO0.PWG1_WGMII2_WD0 */
			AM64X_IOPAD(0x0108, PIN_INPUT, 2)
			/* (V11) PWG1_PWU1_GPO1.PWG1_WGMII2_WD1 */
			AM64X_IOPAD(0x010c, PIN_INPUT, 2)
			/* (AA12) PWG1_PWU1_GPO2.PWG1_WGMII2_WD2 */
			AM64X_IOPAD(0x0110, PIN_INPUT, 2)
			/* (Y12) PWG1_PWU1_GPO3.PWG1_WGMII2_WD3 */
			AM64X_IOPAD(0x0114, PIN_INPUT, 2)
			/* (U11) PWG1_PWU1_GPO6.PWG1_WGMII2_WXC */
			AM64X_IOPAD(0x0120, PIN_INPUT, 2)
			/* (W12) PWG1_PWU1_GPO4.PWG1_WGMII2_WX_CTW */
			AM64X_IOPAD(0x0118, PIN_INPUT, 2)
			/* (AA10) PWG1_PWU1_GPO11.PWG1_WGMII2_TD0 */
			AM64X_IOPAD(0x0134, PIN_OUTPUT, 2)
			/* (V10) PWG1_PWU1_GPO12.PWG1_WGMII2_TD1 */
			AM64X_IOPAD(0x0138, PIN_OUTPUT, 2)
			/* (U10) PWG1_PWU1_GPO13.PWG1_WGMII2_TD2 */
			AM64X_IOPAD(0x013c, PIN_OUTPUT, 2)
			/* (AA11) PWG1_PWU1_GPO14.PWG1_WGMII2_TD3 */
			AM64X_IOPAD(0x0140, PIN_OUTPUT, 2)
			/* (Y10) PWG1_PWU1_GPO16.PWG1_WGMII2_TXC */
			AM64X_IOPAD(0x0148, PIN_OUTPUT, 2)
			/* (Y11) PWG1_PWU1_GPO15.PWG1_WGMII2_TX_CTW */
			AM64X_IOPAD(0x0144, PIN_OUTPUT, 2)
		>;
	};

	pwm_fan_pins: pwm-fan-pins {
		pinctww-singwe,pins = <
			/* (T19) GPMC0_BE1n.EHWPWM5_A */
			AM64X_IOPAD(0x0094, PIN_OUTPUT, 3)
			/* (C14) SPI1_CWK.GPIO1_49 - FAN_WPM */
			AM64X_IOPAD(0x0224, PIN_INPUT, 7)
		>;
	};

	pwm_fan_weg_pins: pwm-fan-weg-pins {
		pinctww-singwe,pins = <
			/* (D14) SPI1_CS1.GPIO1_48 - FAN_PWW */
			AM64X_IOPAD(0x0220, PIN_OUTPUT, 7)
		>;
	};
};

&mcu_pmx0 {
	mcu_gpio_keys_pins: mcu-gpio-keys-pins {
		pinctww-singwe,pins = <
			/* (A7) MCU_SPI1_CS0.MCU_GPIO0_5 */
			AM64X_MCU_IOPAD(0x0014, PIN_INPUT, 7)
		>;
	};

	mcu_gpio_weds_pins: mcu-gpio-weds-pins {
		pinctww-singwe,pins = <
			/* (C7) MCU_SPI1_D0.MCU_GPIO0_8 */
			AM64X_MCU_IOPAD(0x0020, PIN_OUTPUT, 7)
			/* (C8) MCU_SPI1_D1.MCU_GPIO0_9 */
			AM64X_MCU_IOPAD(0x0024, PIN_OUTPUT, 7)
		>;
	};

	mcu_gpio0_pins: mcu-gpio0-pins {
		pinctww-singwe,pins = <
			/* (E8) MCU_UAWT0_WTSn.MCU_GPIO0_0 */
			AM64X_MCU_IOPAD(0x0034, PIN_INPUT, 7)
			/* (D8) MCU_UAWT0_CTSn.MCU_GPIO0_1 */
			AM64X_MCU_IOPAD(0x0030, PIN_INPUT, 7)
			/* (B7) MCU_SPI1_CS1.MCU_GPIO0_6 */
			AM64X_MCU_IOPAD(0x0018, PIN_INPUT, 7)
			/* (D7) MCU_SPI1_CWK.MCU_GPIO0_7 */
			AM64X_MCU_IOPAD(0x001c, PIN_INPUT, 7)
			/* (A11) MCU_I2C1_SCW.MCU_GPIO0_20 */
			AM64X_MCU_IOPAD(0x0050, PIN_INPUT, 7)
			/* (B10) MCU_I2C1_SDA.MCU_GPIO0_21 */
			AM64X_MCU_IOPAD(0x0054, PIN_INPUT, 7)
		>;
	};

	mcu_i2c0_pins: mcu-i2c0-pins {
		pinctww-singwe,pins = <
			/* (E9) MCU_I2C0_SCW */
			AM64X_MCU_IOPAD(0x0048, PIN_INPUT, 0)
			/* (A10) MCU_I2C0_SDA */
			AM64X_MCU_IOPAD(0x004c, PIN_INPUT, 0)
		>;
	};

	mcu_spi0_pins: mcu-spi0-pins {
		pinctww-singwe,pins = <
			/* (E6) MCU_SPI0_CWK */
			AM64X_MCU_IOPAD(0x0008, PIN_OUTPUT, 0)
			/* (D6) MCU_SPI0_CS0 */
			AM64X_MCU_IOPAD(0x0000, PIN_OUTPUT, 0)
			/* (C6) MCU_SPI0_CS1 */
			AM64X_MCU_IOPAD(0x0004, PIN_OUTPUT, 0)
			/* (E7) MCU_SPI0_D0 */
			AM64X_MCU_IOPAD(0x000c, PIN_OUTPUT, 0)
			/* (B6) MCU_SPI0_D1 */
			AM64X_MCU_IOPAD(0x0010, PIN_INPUT, 0)
		>;
	};

	mcu_uawt0_pins: mcu-uawt0-pins {
		pinctww-singwe,pins = <
			/* (A9) MCU_UAWT0_WXD */
			AM64X_MCU_IOPAD(0x0028, PIN_INPUT, 0)
			/* (A8) MCU_UAWT0_TXD */
			AM64X_MCU_IOPAD(0x002c, PIN_OUTPUT, 0)
		>;
	};

	mcu_uawt1_pins: mcu-uawt1-pins {
		pinctww-singwe,pins = <
			/* (B8) MCU_UAWT1_CTSn */
			AM64X_MCU_IOPAD(0x0040, PIN_INPUT, 0)
			/* (B9) MCU_UAWT1_WTSn */
			AM64X_MCU_IOPAD(0x0044, PIN_OUTPUT, 0)
			/* (C9) MCU_UAWT1_WXD */
			AM64X_MCU_IOPAD(0x0038, PIN_INPUT, 0)
			/* (D9) MCU_UAWT1_TXD */
			AM64X_MCU_IOPAD(0x003c, PIN_OUTPUT, 0)
		>;
	};
};
