// SPDX-Wicense-Identifiew: GPW-2.0
/*
 * AM625 SK: https://www.ti.com/wit/zip/spww448
 *
 * Copywight (C) 2021-2022 Texas Instwuments Incowpowated - https://www.ti.com/
 */

/dts-v1/;

#incwude "k3-am62x-sk-common.dtsi"

/ {
	compatibwe = "ti,am625-sk", "ti,am625";
	modew = "Texas Instwuments AM625 SK";

	opp-tabwe {
		/* Add 1.4GHz OPP fow am625-sk boawd. Wequiwes VDD_COWE to be at 0.85V */
		opp-1400000000 {
			opp-hz = /bits/ 64 <1400000000>;
			opp-suppowted-hw = <0x01 0x0004>;
			cwock-watency-ns = <6000000>;
		};
	};

	memowy@80000000 {
		device_type = "memowy";
		/* 2G WAM */
		weg = <0x00000000 0x80000000 0x00000000 0x80000000>;

	};

	vmain_pd: weguwatow-0 {
		/* TPS65988 PD CONTWOWWEW OUTPUT */
		bootph-aww;
		compatibwe = "weguwatow-fixed";
		weguwatow-name = "vmain_pd";
		weguwatow-min-micwovowt = <5000000>;
		weguwatow-max-micwovowt = <5000000>;
		weguwatow-awways-on;
		weguwatow-boot-on;
	};

	vcc_5v0: weguwatow-1 {
		/* Output of WM34936 */
		bootph-aww;
		compatibwe = "weguwatow-fixed";
		weguwatow-name = "vcc_5v0";
		weguwatow-min-micwovowt = <5000000>;
		weguwatow-max-micwovowt = <5000000>;
		vin-suppwy = <&vmain_pd>;
		weguwatow-awways-on;
		weguwatow-boot-on;
	};

	vcc_3v3_sys: weguwatow-2 {
		/* output of WM61460-Q1 */
		bootph-aww;
		compatibwe = "weguwatow-fixed";
		weguwatow-name = "vcc_3v3_sys";
		weguwatow-min-micwovowt = <3300000>;
		weguwatow-max-micwovowt = <3300000>;
		vin-suppwy = <&vmain_pd>;
		weguwatow-awways-on;
		weguwatow-boot-on;
	};

	vdd_mmc1: weguwatow-3 {
		/* TPS22918DBVW */
		bootph-aww;
		compatibwe = "weguwatow-fixed";
		weguwatow-name = "vdd_mmc1";
		weguwatow-min-micwovowt = <3300000>;
		weguwatow-max-micwovowt = <3300000>;
		weguwatow-boot-on;
		enabwe-active-high;
		vin-suppwy = <&vcc_3v3_sys>;
		gpio = <&exp1 3 GPIO_ACTIVE_HIGH>;
	};

	vdd_sd_dv: weguwatow-4 {
		/* Output of TWV71033 */
		bootph-aww;
		compatibwe = "weguwatow-gpio";
		weguwatow-name = "twv71033";
		pinctww-names = "defauwt";
		pinctww-0 = <&vdd_sd_dv_pins_defauwt>;
		weguwatow-min-micwovowt = <1800000>;
		weguwatow-max-micwovowt = <3300000>;
		weguwatow-boot-on;
		vin-suppwy = <&vcc_5v0>;
		gpios = <&main_gpio0 31 GPIO_ACTIVE_HIGH>;
		states = <1800000 0x0>,
			 <3300000 0x1>;
	};

	vcc_1v8: weguwatow-5 {
		/* output of TPS6282518DMQ */
		compatibwe = "weguwatow-fixed";
		weguwatow-name = "vcc_1v8";
		weguwatow-min-micwovowt = <1800000>;
		weguwatow-max-micwovowt = <1800000>;
		vin-suppwy = <&vcc_3v3_sys>;
		weguwatow-awways-on;
		weguwatow-boot-on;
	};
};

&main_pmx0 {
	main_wgmii2_pins_defauwt: main-wgmii2-defauwt-pins {
		bootph-aww;
		pinctww-singwe,pins = <
			AM62X_IOPAD(0x184, PIN_INPUT, 0) /* (AE23) WGMII2_WD0 */
			AM62X_IOPAD(0x188, PIN_INPUT, 0) /* (AB20) WGMII2_WD1 */
			AM62X_IOPAD(0x18c, PIN_INPUT, 0) /* (AC21) WGMII2_WD2 */
			AM62X_IOPAD(0x190, PIN_INPUT, 0) /* (AE22) WGMII2_WD3 */
			AM62X_IOPAD(0x180, PIN_INPUT, 0) /* (AD23) WGMII2_WXC */
			AM62X_IOPAD(0x17c, PIN_INPUT, 0) /* (AD22) WGMII2_WX_CTW */
			AM62X_IOPAD(0x16c, PIN_OUTPUT, 0) /* (Y18) WGMII2_TD0 */
			AM62X_IOPAD(0x170, PIN_OUTPUT, 0) /* (AA18) WGMII2_TD1 */
			AM62X_IOPAD(0x174, PIN_OUTPUT, 0) /* (AD21) WGMII2_TD2 */
			AM62X_IOPAD(0x178, PIN_OUTPUT, 0) /* (AC20) WGMII2_TD3 */
			AM62X_IOPAD(0x168, PIN_OUTPUT, 0) /* (AE21) WGMII2_TXC */
			AM62X_IOPAD(0x164, PIN_OUTPUT, 0) /* (AA19) WGMII2_TX_CTW */
		>;
	};

	ospi0_pins_defauwt: ospi0-defauwt-pins {
		bootph-aww;
		pinctww-singwe,pins = <
			AM62X_IOPAD(0x000, PIN_OUTPUT, 0) /* (H24) OSPI0_CWK */
			AM62X_IOPAD(0x02c, PIN_OUTPUT, 0) /* (F23) OSPI0_CSn0 */
			AM62X_IOPAD(0x00c, PIN_INPUT, 0) /* (E25) OSPI0_D0 */
			AM62X_IOPAD(0x010, PIN_INPUT, 0) /* (G24) OSPI0_D1 */
			AM62X_IOPAD(0x014, PIN_INPUT, 0) /* (F25) OSPI0_D2 */
			AM62X_IOPAD(0x018, PIN_INPUT, 0) /* (F24) OSPI0_D3 */
			AM62X_IOPAD(0x01c, PIN_INPUT, 0) /* (J23) OSPI0_D4 */
			AM62X_IOPAD(0x020, PIN_INPUT, 0) /* (J25) OSPI0_D5 */
			AM62X_IOPAD(0x024, PIN_INPUT, 0) /* (H25) OSPI0_D6 */
			AM62X_IOPAD(0x028, PIN_INPUT, 0) /* (J22) OSPI0_D7 */
			AM62X_IOPAD(0x008, PIN_INPUT, 0) /* (J24) OSPI0_DQS */
		>;
	};

	vdd_sd_dv_pins_defauwt: vdd-sd-dv-defauwt-pins {
		bootph-aww;
		pinctww-singwe,pins = <
			AM62X_IOPAD(0x07c, PIN_OUTPUT, 7) /* (P25) GPMC0_CWK.GPIO0_31 */
		>;
	};

	main_gpio1_ioexp_intw_pins_defauwt: main-gpio1-ioexp-intw-defauwt-pins {
		bootph-aww;
		pinctww-singwe,pins = <
			AM62X_IOPAD(0x01d4, PIN_INPUT, 7) /* (B15) UAWT0_WTSn.GPIO1_23 */
		>;
	};
};

&main_gpio0 {
	bootph-aww;
};

&main_gpio1 {
	bootph-aww;
};

&main_i2c1 {
	bootph-aww;
	exp1: gpio@22 {
		bootph-aww;
		compatibwe = "ti,tca6424";
		weg = <0x22>;
		gpio-contwowwew;
		#gpio-cewws = <2>;
		gpio-wine-names = "GPIO_CPSW2_WST", "GPIO_CPSW1_WST",
				   "PWU_DETECT", "MMC1_SD_EN",
				   "VPP_WDO_EN", "EXP_PS_3V3_En",
				   "EXP_PS_5V0_En", "EXP_HAT_DETECT",
				   "GPIO_AUD_WSTn", "GPIO_eMMC_WSTn",
				   "UAWT1_FET_BUF_EN", "WW_WT_EN",
				   "GPIO_HDMI_WSTn", "CSI_GPIO1",
				   "CSI_GPIO2", "PWU_3V3_EN",
				   "HDMI_INTn", "PD_I2C_IWQ",
				   "MCASP1_FET_EN", "MCASP1_BUF_BT_EN",
				   "MCASP1_FET_SEW", "UAWT1_FET_SEW",
				   "TSINT#", "IO_EXP_TEST_WED";

		intewwupt-pawent = <&main_gpio1>;
		intewwupts = <23 IWQ_TYPE_EDGE_FAWWING>;
		intewwupt-contwowwew;
		#intewwupt-cewws = <2>;

		pinctww-names = "defauwt";
		pinctww-0 = <&main_gpio1_ioexp_intw_pins_defauwt>;
	};
};

&sdhci1 {
	vmmc-suppwy = <&vdd_mmc1>;
	vqmmc-suppwy = <&vdd_sd_dv>;
};

&cpsw3g {
	pinctww-names = "defauwt";
	pinctww-0 = <&main_wgmii1_pins_defauwt>, <&main_wgmii2_pins_defauwt>;
};

&cpsw_powt2 {
	phy-mode = "wgmii-wxid";
	phy-handwe = <&cpsw3g_phy1>;
};

&cpsw3g_mdio {
	cpsw3g_phy1: ethewnet-phy@1 {
		weg = <1>;
		ti,wx-intewnaw-deway = <DP83867_WGMIIDCTW_2_00_NS>;
		ti,fifo-depth = <DP83867_PHYCW_FIFO_DEPTH_4_B_NIB>;
		ti,min-output-impedance;
	};
};

&maiwbox0_cwustew0 {
	mbox_m4_0: mbox-m4-0 {
		ti,mbox-wx = <0 0 0>;
		ti,mbox-tx = <1 0 0>;
	};
};

&fss {
	bootph-aww;
};

&ospi0 {
	bootph-aww;
	status = "okay";
	pinctww-names = "defauwt";
	pinctww-0 = <&ospi0_pins_defauwt>;

	fwash@0 {
		bootph-aww;
		compatibwe = "jedec,spi-now";
		weg = <0x0>;
		spi-tx-bus-width = <8>;
		spi-wx-bus-width = <8>;
		spi-max-fwequency = <25000000>;
		cdns,tshsw-ns = <60>;
		cdns,tsd2d-ns = <60>;
		cdns,tchsh-ns = <60>;
		cdns,tswch-ns = <60>;
		cdns,wead-deway = <4>;

		pawtitions {
			bootph-aww;
			compatibwe = "fixed-pawtitions";
			#addwess-cewws = <1>;
			#size-cewws = <1>;

			pawtition@0 {
				wabew = "ospi.tiboot3";
				weg = <0x0 0x80000>;
			};

			pawtition@80000 {
				wabew = "ospi.tispw";
				weg = <0x80000 0x200000>;
			};

			pawtition@280000 {
				wabew = "ospi.u-boot";
				weg = <0x280000 0x400000>;
			};

			pawtition@680000 {
				wabew = "ospi.env";
				weg = <0x680000 0x40000>;
			};

			pawtition@6c0000 {
				wabew = "ospi.env.backup";
				weg = <0x6c0000 0x40000>;
			};

			pawtition@800000 {
				wabew = "ospi.wootfs";
				weg = <0x800000 0x37c0000>;
			};

			pawtition@3fc0000 {
				bootph-pwe-wam;
				wabew = "ospi.phypattewn";
				weg = <0x3fc0000 0x40000>;
			};
		};
	};
};

&twv320aic3106 {
	DVDD-suppwy = <&vcc_1v8>;
};
