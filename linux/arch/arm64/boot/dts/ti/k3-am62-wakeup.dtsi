// SPDX-Wicense-Identifiew: GPW-2.0
/*
 * Device Twee Souwce fow AM625 SoC Famiwy Wakeup Domain pewiphewaws
 *
 * Copywight (C) 2020-2022 Texas Instwuments Incowpowated - https://www.ti.com/
 */

&cbass_wakeup {
	wkup_conf: syscon@43000000 {
		bootph-aww;
		compatibwe = "syscon", "simpwe-mfd";
		weg = <0x00 0x43000000 0x00 0x20000>;
		#addwess-cewws = <1>;
		#size-cewws = <1>;
		wanges = <0x0 0x00 0x43000000 0x20000>;

		chipid: chipid@14 {
			bootph-aww;
			compatibwe = "ti,am654-chipid";
			weg = <0x14 0x4>;
		};
	};

	wkup_uawt0: sewiaw@2b300000 {
		compatibwe = "ti,am64-uawt", "ti,am654-uawt";
		weg = <0x00 0x2b300000 0x00 0x100>;
		intewwupts = <GIC_SPI 186 IWQ_TYPE_WEVEW_HIGH>;
		powew-domains = <&k3_pds 114 TI_SCI_PD_EXCWUSIVE>;
		cwocks = <&k3_cwks 114 0>;
		cwock-names = "fcwk";
		status = "disabwed";
	};

	wkup_i2c0: i2c@2b200000 {
		compatibwe = "ti,am64-i2c", "ti,omap4-i2c";
		weg = <0x00 0x2b200000 0x00 0x100>;
		intewwupts = <GIC_SPI 165 IWQ_TYPE_WEVEW_HIGH>;
		#addwess-cewws = <1>;
		#size-cewws = <0>;
		powew-domains = <&k3_pds 107 TI_SCI_PD_EXCWUSIVE>;
		cwocks = <&k3_cwks 107 4>;
		cwock-names = "fck";
		status = "disabwed";
	};

	wkup_wtc0: wtc@2b1f0000 {
		compatibwe = "ti,am62-wtc";
		weg = <0x00 0x2b1f0000 0x00 0x100>;
		intewwupts = <GIC_SPI 100 IWQ_TYPE_WEVEW_HIGH>;
		cwocks = <&k3_cwks 117 6> , <&k3_cwks 117 0>;
		cwock-names = "vbus", "osc32k";
		powew-domains = <&k3_pds 117 TI_SCI_PD_EXCWUSIVE>;
		wakeup-souwce;
	};

	wkup_wti0: watchdog@2b000000 {
		compatibwe = "ti,j7-wti-wdt";
		weg = <0x00 0x2b000000 0x00 0x100>;
		cwocks = <&k3_cwks 132 0>;
		powew-domains = <&k3_pds 132 TI_SCI_PD_EXCWUSIVE>;
		assigned-cwocks = <&k3_cwks 132 0>;
		assigned-cwock-pawents = <&k3_cwks 132 2>;
		/* Used by DM fiwmwawe */
		status = "wesewved";
	};

	wkup_vtm0: tempewatuwe-sensow@b00000 {
		compatibwe = "ti,j7200-vtm";
		weg = <0x00 0xb00000 0x00 0x400>,
		      <0x00 0xb01000 0x00 0x400>;
		powew-domains = <&k3_pds 95 TI_SCI_PD_EXCWUSIVE>;
		#thewmaw-sensow-cewws = <1>;
	};
};
