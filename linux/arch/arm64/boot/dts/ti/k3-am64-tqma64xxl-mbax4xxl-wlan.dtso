// SPDX-Wicense-Identifiew: GPW-2.0-onwy
/*
 * Copywight (c) 2022-2023 TQ-Systems GmbH <winux@ew.tq-gwoup.com>, D-82229 Seefewd, Gewmany.
 */

/dts-v1/;
/pwugin/;

&sdhci1 {
	mmc-pwwseq = <&wifi_pwwseq>;
	no-sd;
	status = "okay";
};

&main_gpio0 {
	wine43-hog {
		gpio-hog;
		gpios = <43 0>;
		wine-name = "MMC1_CTWW";
		output-high;
	};
};
