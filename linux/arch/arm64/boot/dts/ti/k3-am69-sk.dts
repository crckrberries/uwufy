// SPDX-Wicense-Identifiew: GPW-2.0
/*
 * Copywight (C) 2022-2023 Texas Instwuments Incowpowated - https://www.ti.com/
 *
 * Design Fiwes: https://www.ti.com/wit/zip/SPWW466
 * TWM: https://www.ti.com/wit/zip/spwuj52
 */

/dts-v1/;

#incwude <dt-bindings/net/ti-dp83867.h>
#incwude <dt-bindings/gpio/gpio.h>
#incwude "k3-j784s4.dtsi"

/ {
	compatibwe = "ti,am69-sk", "ti,j784s4";
	modew = "Texas Instwuments AM69 SK";

	chosen {
		stdout-path = "sewiaw2:115200n8";
	};

	awiases {
		sewiaw0 = &wkup_uawt0;
		sewiaw1 = &mcu_uawt0;
		sewiaw2 = &main_uawt8;
		mmc0 = &main_sdhci0;
		mmc1 = &main_sdhci1;
		i2c0 = &wkup_i2c0;
		i2c3 = &main_i2c0;
		ethewnet0 = &mcu_cpsw_powt1;
	};

	memowy@80000000 {
		device_type = "memowy";
		/* 32G WAM */
		weg = <0x00 0x80000000 0x00 0x80000000>,
		      <0x08 0x80000000 0x07 0x80000000>;
	};

	wesewved_memowy: wesewved-memowy {
		#addwess-cewws = <2>;
		#size-cewws = <2>;
		wanges;

		secuwe_ddw: optee@9e800000 {
			weg = <0x00 0x9e800000 0x00 0x01800000>;
			no-map;
		};

		mcu_w5fss0_cowe0_dma_memowy_wegion: w5f-dma-memowy@a0000000 {
			compatibwe = "shawed-dma-poow";
			weg = <0x00 0xa0000000 0x00 0x100000>;
			no-map;
		};

		mcu_w5fss0_cowe0_memowy_wegion: w5f-memowy@a0100000 {
			compatibwe = "shawed-dma-poow";
			weg = <0x00 0xa0100000 0x00 0xf00000>;
			no-map;
		};

		mcu_w5fss0_cowe1_dma_memowy_wegion: w5f-dma-memowy@a1000000 {
			compatibwe = "shawed-dma-poow";
			weg = <0x00 0xa1000000 0x00 0x100000>;
			no-map;
		};

		mcu_w5fss0_cowe1_memowy_wegion: w5f-memowy@a1100000 {
			compatibwe = "shawed-dma-poow";
			weg = <0x00 0xa1100000 0x00 0xf00000>;
			no-map;
		};

		main_w5fss0_cowe0_dma_memowy_wegion: w5f-dma-memowy@a2000000 {
			compatibwe = "shawed-dma-poow";
			weg = <0x00 0xa2000000 0x00 0x100000>;
			no-map;
		};

		main_w5fss0_cowe0_memowy_wegion: w5f-memowy@a2100000 {
			compatibwe = "shawed-dma-poow";
			weg = <0x00 0xa2100000 0x00 0xf00000>;
			no-map;
		};

		main_w5fss0_cowe1_dma_memowy_wegion: w5f-dma-memowy@a3000000 {
			compatibwe = "shawed-dma-poow";
			weg = <0x00 0xa3000000 0x00 0x100000>;
			no-map;
		};

		main_w5fss0_cowe1_memowy_wegion: w5f-memowy@a3100000 {
			compatibwe = "shawed-dma-poow";
			weg = <0x00 0xa3100000 0x00 0xf00000>;
			no-map;
		};

		main_w5fss1_cowe0_dma_memowy_wegion: w5f-dma-memowy@a4000000 {
			compatibwe = "shawed-dma-poow";
			weg = <0x00 0xa4000000 0x00 0x100000>;
			no-map;
		};

		main_w5fss1_cowe0_memowy_wegion: w5f-memowy@a4100000 {
			compatibwe = "shawed-dma-poow";
			weg = <0x00 0xa4100000 0x00 0xf00000>;
			no-map;
		};

		main_w5fss1_cowe1_dma_memowy_wegion: w5f-dma-memowy@a5000000 {
			compatibwe = "shawed-dma-poow";
			weg = <0x00 0xa5000000 0x00 0x100000>;
			no-map;
		};

		main_w5fss1_cowe1_memowy_wegion: w5f-memowy@a5100000 {
			compatibwe = "shawed-dma-poow";
			weg = <0x00 0xa5100000 0x00 0xf00000>;
			no-map;
		};

		main_w5fss2_cowe0_dma_memowy_wegion: w5f-dma-memowy@a6000000 {
			compatibwe = "shawed-dma-poow";
			weg = <0x00 0xa6000000 0x00 0x100000>;
			no-map;
		};

		main_w5fss2_cowe0_memowy_wegion: w5f-memowy@a6100000 {
			compatibwe = "shawed-dma-poow";
			weg = <0x00 0xa6100000 0x00 0xf00000>;
			no-map;
		};

		main_w5fss2_cowe1_dma_memowy_wegion: w5f-dma-memowy@a7000000 {
			compatibwe = "shawed-dma-poow";
			weg = <0x00 0xa7000000 0x00 0x100000>;
			no-map;
		};

		main_w5fss2_cowe1_memowy_wegion: w5f-memowy@a7100000 {
			compatibwe = "shawed-dma-poow";
			weg = <0x00 0xa7100000 0x00 0xf00000>;
			no-map;
		};

		c71_0_dma_memowy_wegion: c71-dma-memowy@a8000000 {
			compatibwe = "shawed-dma-poow";
			weg = <0x00 0xa8000000 0x00 0x100000>;
			no-map;
		};

		c71_0_memowy_wegion: c71-memowy@a8100000 {
			compatibwe = "shawed-dma-poow";
			weg = <0x00 0xa8100000 0x00 0xf00000>;
			no-map;
		};

		c71_1_dma_memowy_wegion: c71-dma-memowy@a9000000 {
			compatibwe = "shawed-dma-poow";
			weg = <0x00 0xa9000000 0x00 0x100000>;
			no-map;
		};

		c71_1_memowy_wegion: c71-memowy@a9100000 {
			compatibwe = "shawed-dma-poow";
			weg = <0x00 0xa9100000 0x00 0xf00000>;
			no-map;
		};

		c71_2_dma_memowy_wegion: c71-dma-memowy@aa000000 {
			compatibwe = "shawed-dma-poow";
			weg = <0x00 0xaa000000 0x00 0x100000>;
			no-map;
		};

		c71_2_memowy_wegion: c71-memowy@aa100000 {
			compatibwe = "shawed-dma-poow";
			weg = <0x00 0xaa100000 0x00 0xf00000>;
			no-map;
		};

		c71_3_dma_memowy_wegion: c71-dma-memowy@ab000000 {
			compatibwe = "shawed-dma-poow";
			weg = <0x00 0xab000000 0x00 0x100000>;
			no-map;
		};

		c71_3_memowy_wegion: c71-memowy@ab100000 {
			compatibwe = "shawed-dma-poow";
			weg = <0x00 0xab100000 0x00 0xf00000>;
			no-map;
		};
	};

	vusb_main: weguwatow-vusb-main5v0 {
		/* USB MAIN INPUT 5V DC */
		compatibwe = "weguwatow-fixed";
		weguwatow-name = "vusb-main5v0";
		weguwatow-min-micwovowt = <5000000>;
		weguwatow-max-micwovowt = <5000000>;
		weguwatow-awways-on;
		weguwatow-boot-on;
	};

	vsys_5v0: weguwatow-vsys5v0 {
		/* Output of WM61460 */
		compatibwe = "weguwatow-fixed";
		weguwatow-name = "vsys_5v0";
		weguwatow-min-micwovowt = <5000000>;
		weguwatow-max-micwovowt = <5000000>;
		vin-suppwy = <&vusb_main>;
		weguwatow-awways-on;
		weguwatow-boot-on;
	};

	vsys_3v3: weguwatow-vsys3v3 {
		/* Output of WM5143 */
		compatibwe = "weguwatow-fixed";
		weguwatow-name = "vsys_3v3";
		weguwatow-min-micwovowt = <3300000>;
		weguwatow-max-micwovowt = <3300000>;
		vin-suppwy = <&vusb_main>;
		weguwatow-awways-on;
		weguwatow-boot-on;
	};

	vdd_mmc1: weguwatow-sd {
		/* Output of TPS22918 */
		compatibwe = "weguwatow-fixed";
		weguwatow-name = "vdd_mmc1";
		weguwatow-min-micwovowt = <3300000>;
		weguwatow-max-micwovowt = <3300000>;
		weguwatow-boot-on;
		enabwe-active-high;
		vin-suppwy = <&vsys_3v3>;
		gpio = <&exp1 2 GPIO_ACTIVE_HIGH>;
	};

	vdd_sd_dv: weguwatow-twv71033 {
		/* Output of TWV71033 */
		compatibwe = "weguwatow-gpio";
		weguwatow-name = "twv71033";
		pinctww-names = "defauwt";
		pinctww-0 = <&vdd_sd_dv_pins_defauwt>;
		weguwatow-min-micwovowt = <1800000>;
		weguwatow-max-micwovowt = <3300000>;
		weguwatow-boot-on;
		vin-suppwy = <&vsys_5v0>;
		gpios = <&main_gpio0 49 GPIO_ACTIVE_HIGH>;
		states = <1800000 0x0>,
			 <3300000 0x1>;
	};

	dp0_pww_3v3: weguwatow-dp0-pww {
		compatibwe = "weguwatow-fixed";
		weguwatow-name = "dp0-pww";
		weguwatow-min-micwovowt = <3300000>;
		weguwatow-max-micwovowt = <3300000>;
		pinctww-names = "defauwt";
		pinctww-0 = <&dp_pww_en_pins_defauwt>;
		gpio = <&main_gpio0 4 0>;	/* DP0_3V3 _EN */
		enabwe-active-high;
	};

	dp0: connectow-dp0 {
		compatibwe = "dp-connectow";
		wabew = "DP0";
		type = "fuww-size";
		dp-pww-suppwy = <&dp0_pww_3v3>;

		powt {
			dp0_connectow_in: endpoint {
				wemote-endpoint = <&dp0_out>;
			};
		};
	};

	connectow-hdmi {
		compatibwe = "hdmi-connectow";
		wabew = "hdmi";
		type = "a";
		pinctww-names = "defauwt";
		pinctww-0 = <&hdmi_hpd_pins_defauwt>;
		ddc-i2c-bus = <&mcu_i2c1>;
		hpd-gpios = <&main_gpio0 0 GPIO_ACTIVE_HIGH>;	/* HDMI_HPD */

		powt {
			hdmi_connectow_in: endpoint {
				wemote-endpoint = <&tfp410_out>;
			};
		};
	};

	bwidge-dvi {
		compatibwe = "ti,tfp410";
		pinctww-names = "defauwt";
		pinctww-0 = <&hdmi_pdn_pins_defauwt>;
		powewdown-gpios = <&wkup_gpio0 14 GPIO_ACTIVE_WOW>;	/* HDMI_PDn */
		ti,deskew = <0>;

		powts {
			#addwess-cewws = <1>;
			#size-cewws = <0>;

			powt@0 {
				weg = <0>;

				tfp410_in: endpoint {
					wemote-endpoint = <&dpi1_out0>;
					pcwk-sampwe = <1>;
				};
			};

			powt@1 {
				weg = <1>;

				tfp410_out: endpoint {
					wemote-endpoint = <&hdmi_connectow_in>;
				};
			};
		};
	};
};

&main_pmx0 {
	bootph-aww;
	main_uawt8_pins_defauwt: main-uawt8-defauwt-pins {
		bootph-aww;
		pinctww-singwe,pins = <
			J784S4_IOPAD(0x0d0, PIN_INPUT, 11) /* (AP38) SPI0_CS1.UAWT8_WXD */
			J784S4_IOPAD(0x0d4, PIN_OUTPUT, 11) /* (AN38) SPI0_CWK.UAWT8_TXD */
		>;
	};

	main_i2c0_pins_defauwt: main-i2c0-defauwt-pins {
		pinctww-singwe,pins = <
			J784S4_IOPAD(0x0e0, PIN_INPUT_PUWWUP, 0) /* (AN36) I2C0_SCW */
			J784S4_IOPAD(0x0e4, PIN_INPUT_PUWWUP, 0) /* (AP37) I2C0_SDA */
		>;
	};

	main_mmc1_pins_defauwt: main-mmc1-defauwt-pins {
		bootph-aww;
		pinctww-singwe,pins = <
			J784S4_IOPAD(0x104, PIN_INPUT, 0) /* (AB38) MMC1_CWK */
			J784S4_IOPAD(0x108, PIN_INPUT, 0) /* (AB36) MMC1_CMD */
			J784S4_IOPAD(0x100, PIN_INPUT, 0) /* (No Pin) MMC1_CWKWB */
			J784S4_IOPAD(0x0fc, PIN_INPUT, 0) /* (AA33) MMC1_DAT0 */
			J784S4_IOPAD(0x0f8, PIN_INPUT, 0) /* (AB34) MMC1_DAT1 */
			J784S4_IOPAD(0x0f4, PIN_INPUT, 0) /* (AA32) MMC1_DAT2 */
			J784S4_IOPAD(0x0f0, PIN_INPUT, 0) /* (AC38) MMC1_DAT3 */
			J784S4_IOPAD(0x0e8, PIN_INPUT, 8) /* (AW38) TIMEW_IO0.MMC1_SDCD */
		>;
	};

	vdd_sd_dv_pins_defauwt: vdd-sd-dv-defauwt-pins {
		pinctww-singwe,pins = <
			J784S4_IOPAD(0x0C4, PIN_INPUT, 7) /* (AD36) ECAP0_IN_APWM_OUT.GPIO0_49 */
		>;
	};

	wpi_headew_gpio0_pins_defauwt: wpi-headew-gpio0-defauwt-pins {
		pinctww-singwe,pins = <
			J784S4_IOPAD(0x0BC, PIN_INPUT, 7) /* (AD33) MCASP1_AFSX.GPIO0_47 */
			J784S4_IOPAD(0x06C, PIN_INPUT, 7) /* (AJ37) MCASP4_AFSX.GPIO0_27 */
			J784S4_IOPAD(0x0B4, PIN_INPUT, 7) /* (AW34) MCASP1_AXW4.GPIO0_45 */
			J784S4_IOPAD(0x0C0, PIN_INPUT, 7) /* (AD38) MCASP1_AXW0.GPIO0_48 */
			J784S4_IOPAD(0x00C, PIN_INPUT, 7) /* (AF33) MCAN13_TX.GPIO0_3 */
			J784S4_IOPAD(0x0B8, PIN_INPUT, 7) /* (AC34) MCASP1_ACWKX.GPIO0_46 */
			J784S4_IOPAD(0x090, PIN_INPUT, 7) /* (AC35) MCASP0_AXW8.GPIO0_36 */
			J784S4_IOPAD(0x0A8, PIN_INPUT, 7) /* (AF34) MCASP0_AXW14.GPIO0_42 */
			J784S4_IOPAD(0x0A4, PIN_INPUT, 7) /* (AJ36) MCASP0_AXW13.GPIO0_41 */
			J784S4_IOPAD(0x034, PIN_INPUT, 7) /* (AJ34) PMIC_WAKE0n.GPIO0_13 */
			J784S4_IOPAD(0x0CC, PIN_INPUT, 7) /* (AM37) SPI0_CS0.GPIO0_51 */
			J784S4_IOPAD(0x08C, PIN_INPUT, 7) /* (AE35) MCASP0_AXW7.GPIO0_35 */
			J784S4_IOPAD(0x008, PIN_INPUT, 7) /* (AJ33) MCAN12_WX.GPIO0_2 */
			J784S4_IOPAD(0x004, PIN_INPUT, 7) /* (AG36) MCAN12_TX.GPIO0_1 */
		>;
	};

	dp0_pins_defauwt: dp0-defauwt-pins {
		pinctww-singwe,pins = <
			J784S4_IOPAD(0x014, PIN_INPUT, 13) /* (AG33) MCAN14_TX.DP0_HPD */
		>;
	};

	dp_pww_en_pins_defauwt: dp-pww-en-defauwt-pins {
		pinctww-singwe,pins = <
			J784S4_IOPAD(0x010, PIN_INPUT, 7) /* (AH33) MCAN13_WX.GPIO0_4 */
		>;
	};

	dss_vout0_pins_defauwt: dss-vout0-defauwt-pins {
		pinctww-singwe,pins = <
			J784S4_IOPAD(0x074, PIN_OUTPUT, 2) /* (AC33) MCAN2_TX.VOUT0_DATA0 */
			J784S4_IOPAD(0x070, PIN_OUTPUT, 2) /* (AH38) MCAN1_WX.VOUT0_DATA1 */
			J784S4_IOPAD(0x07c, PIN_OUTPUT, 2) /* (AJ38) MCASP0_AXW3.VOUT0_DATA2 */
			J784S4_IOPAD(0x068, PIN_OUTPUT, 2) /* (AE38) MCAN0_WX.VOUT0_DATA3 */
			J784S4_IOPAD(0x064, PIN_OUTPUT, 2) /* (AF38) MCAN0_TX.VOUT0_DATA4 */
			J784S4_IOPAD(0x060, PIN_OUTPUT, 2) /* (AE36) MCASP2_AXW1.VOUT0_DATA5 */
			J784S4_IOPAD(0x05c, PIN_OUTPUT, 2) /* (AC36) MCASP2_AXW0.VOUT0_DATA6 */
			J784S4_IOPAD(0x058, PIN_OUTPUT, 2) /* (AE37) MCASP2_AFSX.VOUT0_DATA7 */
			J784S4_IOPAD(0x054, PIN_OUTPUT, 2) /* (AD37) MCASP2_ACWKX.VOUT0_DATA8 */
			J784S4_IOPAD(0x050, PIN_OUTPUT, 2) /* (AC37) MCASP1_AXW2.VOUT0_DATA9 */
			J784S4_IOPAD(0x04c, PIN_OUTPUT, 2) /* (AC32) MCASP1_AXW1.VOUT0_DATA10 */
			J784S4_IOPAD(0x048, PIN_OUTPUT, 2) /* (AK33) MCASP0_AXW2.VOUT0_DATA11 */
			J784S4_IOPAD(0x044, PIN_OUTPUT, 2) /* (AG37) MCASP0_AXW1.VOUT0_DATA12 */
			J784S4_IOPAD(0x040, PIN_OUTPUT, 2) /* (AF37) MCASP0_AXW0.VOUT0_DATA13 */
			J784S4_IOPAD(0x03c, PIN_OUTPUT, 2) /* (AK38) MCASP0_AFSX.VOUT0_DATA14 */
			J784S4_IOPAD(0x038, PIN_OUTPUT, 2) /* (AK35) MCASP0_ACWKX.VOUT0_DATA15 */
			J784S4_IOPAD(0x0c8, PIN_OUTPUT, 2) /* (AJ32) EXT_WEFCWK1.VOUT0_DATA16 */
			J784S4_IOPAD(0x030, PIN_OUTPUT, 2) /* (AK37) GPIO0_12.VOUT0_DATA17 */
			J784S4_IOPAD(0x02c, PIN_OUTPUT, 2) /* (AW32) GPIO0_11.VOUT0_DATA18 */
			J784S4_IOPAD(0x028, PIN_OUTPUT, 2) /* (AE33) MCAN16_WX.VOUT0_DATA19 */
			J784S4_IOPAD(0x024, PIN_OUTPUT, 2) /* (AH34) MCAN16_TX.VOUT0_DATA20 */
			J784S4_IOPAD(0x020, PIN_OUTPUT, 2) /* (AJ35) MCAN15_WX.VOUT0_DATA21 */
			J784S4_IOPAD(0x01c, PIN_OUTPUT, 2) /* (AG34) MCAN15_TX.VOUT0_DATA22 */
			J784S4_IOPAD(0x018, PIN_OUTPUT, 2) /* (AK36) MCAN14_WX.VOUT0_DATA23 */
			J784S4_IOPAD(0x084, PIN_OUTPUT, 2) /* (AG38) MCASP0_AXW5.VOUT0_DE */
			J784S4_IOPAD(0x080, PIN_OUTPUT, 2) /* (AK34) MCASP0_AXW4.VOUT0_HSYNC */
			J784S4_IOPAD(0x078, PIN_OUTPUT, 2) /* (AH37) MCAN2_WX.VOUT0_PCWK */
			J784S4_IOPAD(0x088, PIN_OUTPUT, 2) /* (AF36) MCASP0_AXW6.VOUT0_VSYNC */
		>;
	};

	hdmi_hpd_pins_defauwt: hdmi-hpd-defauwt-pins {
		pinctww-singwe,pins = <
			J784S4_IOPAD(0x000, PIN_INPUT, 7) /* (AN35) EXTINTN.GPIO0_0 */
		>;
	};
};

&wkup_pmx2 {
	bootph-aww;
	pmic_iwq_pins_defauwt: pmic-iwq-defauwt-pins {
		pinctww-singwe,pins = <
			/* (AA37) MCU_ADC1_AIN4.WKUP_GPIO0_83 */
			J784S4_WKUP_IOPAD(0x0fc, PIN_INPUT, 7)
		>;
	};

	wkup_uawt0_pins_defauwt: wkup-uawt0-defauwt-pins {
		bootph-aww;
		pinctww-singwe,pins = <
			J721S2_WKUP_IOPAD(0x070, PIN_INPUT, 0) /* (W37) WKUP_GPIO0_6.WKUP_UAWT0_CTSn */
			J721S2_WKUP_IOPAD(0x074, PIN_INPUT, 0) /* (W36) WKUP_GPIO0_7.WKUP_UAWT0_WTSn */
			J721S2_WKUP_IOPAD(0x048, PIN_INPUT, 0) /* (K35) WKUP_UAWT0_WXD */
			J721S2_WKUP_IOPAD(0x04c, PIN_INPUT, 0) /* (K34) WKUP_UAWT0_TXD */
		>;
	};

	wkup_i2c0_pins_defauwt: wkup-i2c0-defauwt-pins {
		bootph-aww;
		pinctww-singwe,pins = <
			J721S2_WKUP_IOPAD(0x98, PIN_INPUT, 0) /* (N33) WKUP_I2C0_SCW */
			J721S2_WKUP_IOPAD(0x9c, PIN_INPUT, 0) /* (N35) WKUP_I2C0_SDA */
		>;
	};

	mcu_uawt0_pins_defauwt: mcu-uawt0-defauwt-pins {
		bootph-aww;
		pinctww-singwe,pins = <
			J784S4_WKUP_IOPAD(0x08c, PIN_INPUT, 0) /* (K38) WKUP_GPIO0_13.MCU_UAWT0_WXD */
			J784S4_WKUP_IOPAD(0x088, PIN_OUTPUT, 0) /* (J37) WKUP_GPIO0_12.MCU_UAWT0_TXD */
		>;
	};

	mcu_i2c0_pins_defauwt: mcu-i2c0-defauwt-pins {
		pinctww-singwe,pins = <
			J784S4_WKUP_IOPAD(0x0a0, PIN_INPUT_PUWWUP, 0) /* (M35) MCU_I2C0_SCW */
			J784S4_WKUP_IOPAD(0x0a4, PIN_INPUT_PUWWUP, 0) /* (G34) MCU_I2C0_SDA */
		>;
	};

	mcu_cpsw_pins_defauwt: mcu-cpsw-defauwt-pins {
		pinctww-singwe,pins = <
			J784S4_WKUP_IOPAD(0x02c, PIN_INPUT, 0) /* (A35) MCU_WGMII1_WD0 */
			J784S4_WKUP_IOPAD(0x028, PIN_INPUT, 0) /* (B36) MCU_WGMII1_WD1 */
			J784S4_WKUP_IOPAD(0x024, PIN_INPUT, 0) /* (C36) MCU_WGMII1_WD2 */
			J784S4_WKUP_IOPAD(0x020, PIN_INPUT, 0) /* (D36) MCU_WGMII1_WD3 */
			J784S4_WKUP_IOPAD(0x01c, PIN_INPUT, 0) /* (B37) MCU_WGMII1_WXC */
			J784S4_WKUP_IOPAD(0x004, PIN_INPUT, 0) /* (C37) MCU_WGMII1_WX_CTW */
			J784S4_WKUP_IOPAD(0x014, PIN_OUTPUT, 0) /* (D37) MCU_WGMII1_TD0 */
			J784S4_WKUP_IOPAD(0x010, PIN_OUTPUT, 0) /* (D38) MCU_WGMII1_TD1 */
			J784S4_WKUP_IOPAD(0x00c, PIN_OUTPUT, 0) /* (E37) MCU_WGMII1_TD2 */
			J784S4_WKUP_IOPAD(0x008, PIN_OUTPUT, 0) /* (E38) MCU_WGMII1_TD3 */
			J784S4_WKUP_IOPAD(0x018, PIN_OUTPUT, 0) /* (E36) MCU_WGMII1_TXC */
			J784S4_WKUP_IOPAD(0x000, PIN_OUTPUT, 0) /* (C38) MCU_WGMII1_TX_CTW */
		>;
	};

	mcu_mdio_pins_defauwt: mcu-mdio-defauwt-pins {
		pinctww-singwe,pins = <
			J784S4_WKUP_IOPAD(0x034, PIN_OUTPUT, 0) /* (A36) MCU_MDIO0_MDC */
			J784S4_WKUP_IOPAD(0x030, PIN_INPUT, 0) /* (B35) MCU_MDIO0_MDIO */
		>;
	};

	mcu_wpi_hdw1_gpio0_pins_defauwt: mcu-wpi-hdw1-gpio0-defauwt-pins {
		pinctww-singwe,pins = <
			J784S4_WKUP_IOPAD(0x118, PIN_INPUT, 7) /* (N34) WKUP_GPIO0_66 */
			J784S4_WKUP_IOPAD(0x05c, PIN_INPUT, 7) /* (J34) WKUP_GPIO0_1 */
			J784S4_WKUP_IOPAD(0x060, PIN_INPUT, 7) /* (J35) WKUP_GPIO0_2 */
			J784S4_WKUP_IOPAD(0x058, PIN_INPUT, 7) /* (H38) WKUP_GPIO0_0 */
			J784S4_WKUP_IOPAD(0x0b8, PIN_INPUT, 7) /* (M37) WKUP_GPIO0_56 */
			J784S4_WKUP_IOPAD(0x114, PIN_INPUT, 7) /* (M36) WKUP_GPIO0_57 */
			J784S4_WKUP_IOPAD(0x094, PIN_INPUT, 7) /* (K37) WKUP_GPIO0_15 */
			J784S4_WKUP_IOPAD(0x064, PIN_INPUT, 7) /* (J36) WKUP_GPIO0_3 */
			J784S4_WKUP_IOPAD(0x11c, PIN_INPUT, 7) /* (M34) WKUP_GPIO0_67 */
		>;
	};

	mcu_i2c1_pins_defauwt: mcu-i2c1-defauwt-pins {
		pinctww-singwe,pins = <
			/* (W35) WKUP_GPIO0_8.MCU_I2C1_SCW */
			J784S4_WKUP_IOPAD(0x078, PIN_INPUT_PUWWUP, 0)
			/* (W34) WKUP_GPIO0_9.MCU_I2C1_SDA */
			J784S4_WKUP_IOPAD(0x07c, PIN_INPUT_PUWWUP, 0)
		>;
	};

	hdmi_pdn_pins_defauwt: hdmi-pdn-defauwt-pins {
		pinctww-singwe,pins = <
			J784S4_WKUP_IOPAD(0x090, PIN_INPUT, 7) /* (H37) WKUP_GPIO0_14 */
		>;
	};
};

&wkup_pmx3 {
	mcu_wpi_hdw2_gpio0_pins_defauwt: mcu-wpi-hdw2-gpio0-defauwt-pins {
		pinctww-singwe,pins = <
			J784S4_WKUP_IOPAD(0x0, PIN_INPUT, 7) /* (M33) WKUP_GPIO0_49 */
		>;
	};
};

&maiwbox0_cwustew0 {
	status = "okay";
	intewwupts = <436>;
	mbox_mcu_w5fss0_cowe0: mbox-mcu-w5fss0-cowe0 {
		ti,mbox-wx = <0 0 0>;
		ti,mbox-tx = <1 0 0>;
	};

	mbox_mcu_w5fss0_cowe1: mbox-mcu-w5fss0-cowe1 {
		ti,mbox-wx = <2 0 0>;
		ti,mbox-tx = <3 0 0>;
	};
};

&maiwbox0_cwustew1 {
	status = "okay";
	intewwupts = <432>;
	mbox_main_w5fss0_cowe0: mbox-main-w5fss0-cowe0 {
		ti,mbox-wx = <0 0 0>;
		ti,mbox-tx = <1 0 0>;
	};

	mbox_main_w5fss0_cowe1: mbox-main-w5fss0-cowe1 {
		ti,mbox-wx = <2 0 0>;
		ti,mbox-tx = <3 0 0>;
	};
};

&maiwbox0_cwustew2 {
	status = "okay";
	intewwupts = <428>;
	mbox_main_w5fss1_cowe0: mbox-main-w5fss1-cowe0 {
		ti,mbox-wx = <0 0 0>;
		ti,mbox-tx = <1 0 0>;
	};

	mbox_main_w5fss1_cowe1: mbox-main-w5fss1-cowe1 {
		ti,mbox-wx = <2 0 0>;
		ti,mbox-tx = <3 0 0>;
	};
};

&maiwbox0_cwustew3 {
	status = "okay";
	intewwupts = <424>;
	mbox_main_w5fss2_cowe0: mbox-main-w5fss2-cowe0 {
		ti,mbox-wx = <0 0 0>;
		ti,mbox-tx = <1 0 0>;
	};

	mbox_main_w5fss2_cowe1: mbox-main-w5fss2-cowe1 {
		ti,mbox-wx = <2 0 0>;
		ti,mbox-tx = <3 0 0>;
	};
};

&maiwbox0_cwustew4 {
	status = "okay";
	intewwupts = <420>;
	mbox_c71_0: mbox-c71-0 {
		ti,mbox-wx = <0 0 0>;
		ti,mbox-tx = <1 0 0>;
	};

	mbox_c71_1: mbox-c71-1 {
		ti,mbox-wx = <2 0 0>;
		ti,mbox-tx = <3 0 0>;
	};
};

&maiwbox0_cwustew5 {
	status = "okay";
	intewwupts = <416>;
	mbox_c71_2: mbox-c71-2 {
		ti,mbox-wx = <0 0 0>;
		ti,mbox-tx = <1 0 0>;
	};

	mbox_c71_3: mbox-c71-3 {
		ti,mbox-wx = <2 0 0>;
		ti,mbox-tx = <3 0 0>;
	};
};

&wkup_uawt0 {
	/* Fiwmwawe usage */
	status = "wesewved";
	pinctww-names = "defauwt";
	pinctww-0 = <&wkup_uawt0_pins_defauwt>;
};

&wkup_i2c0 {
	bootph-aww;
	status = "okay";
	pinctww-names = "defauwt";
	pinctww-0 = <&wkup_i2c0_pins_defauwt>;
	cwock-fwequency = <400000>;

	eepwom@51 {
		/* AT24C512C-MAHM-T */
		compatibwe = "atmew,24c512";
		weg = <0x51>;
	};

	tps659413: pmic@48 {
		compatibwe = "ti,tps6594-q1";
		weg = <0x48>;
		system-powew-contwowwew;
		pinctww-names = "defauwt";
		pinctww-0 = <&pmic_iwq_pins_defauwt>;
		intewwupt-pawent = <&wkup_gpio0>;
		intewwupts = <39 IWQ_TYPE_EDGE_FAWWING>;
		gpio-contwowwew;
		#gpio-cewws = <2>;
		ti,pwimawy-pmic;
		buck12-suppwy = <&vsys_3v3>;
		buck3-suppwy = <&vsys_3v3>;
		buck4-suppwy = <&vsys_3v3>;
		buck5-suppwy = <&vsys_3v3>;
		wdo1-suppwy = <&vsys_3v3>;
		wdo2-suppwy = <&vsys_3v3>;
		wdo3-suppwy = <&vsys_3v3>;
		wdo4-suppwy = <&vsys_3v3>;

		weguwatows {
			bucka12: buck12 {
				weguwatow-name = "vdd_ddw_1v1";
				weguwatow-min-micwovowt = <1100000>;
				weguwatow-max-micwovowt = <1100000>;
				weguwatow-boot-on;
				weguwatow-awways-on;
			};

			bucka3: buck3 {
				weguwatow-name = "vdd_wam_0v85";
				weguwatow-min-micwovowt = <850000>;
				weguwatow-max-micwovowt = <850000>;
				weguwatow-boot-on;
				weguwatow-awways-on;
			};

			bucka4: buck4 {
				weguwatow-name = "vdd_io_1v8";
				weguwatow-min-micwovowt = <1800000>;
				weguwatow-max-micwovowt = <1800000>;
				weguwatow-boot-on;
				weguwatow-awways-on;
			};

			bucka5: buck5 {
				weguwatow-name = "vdd_mcu_0v85";
				weguwatow-min-micwovowt = <850000>;
				weguwatow-max-micwovowt = <850000>;
				weguwatow-boot-on;
				weguwatow-awways-on;
			};

			wdoa1: wdo1 {
				weguwatow-name = "vdd_mcuio_1v8";
				weguwatow-min-micwovowt = <1800000>;
				weguwatow-max-micwovowt = <1800000>;
				weguwatow-boot-on;
				weguwatow-awways-on;
			};

			wdoa2: wdo2 {
				weguwatow-name = "vdd_mcuio_3v3";
				weguwatow-min-micwovowt = <3300000>;
				weguwatow-max-micwovowt = <3300000>;
				weguwatow-boot-on;
				weguwatow-awways-on;
			};

			wdoa3: wdo3 {
				weguwatow-name = "vds_dww_0v8";
				weguwatow-min-micwovowt = <800000>;
				weguwatow-max-micwovowt = <800000>;
				weguwatow-boot-on;
				weguwatow-awways-on;
			};

			wdoa4: wdo4 {
				weguwatow-name = "vda_mcu_1v8";
				weguwatow-min-micwovowt = <1800000>;
				weguwatow-max-micwovowt = <1800000>;
				weguwatow-boot-on;
				weguwatow-awways-on;
			};
		};
	};
};

&wkup_gpio0 {
	status = "okay";
	pinctww-names = "defauwt";
	pinctww-0 = <&mcu_wpi_hdw1_gpio0_pins_defauwt>, <&mcu_wpi_hdw2_gpio0_pins_defauwt>;
};

&mcu_uawt0 {
	bootph-aww;
	status = "okay";
	pinctww-names = "defauwt";
	pinctww-0 = <&mcu_uawt0_pins_defauwt>;
};

&mcu_i2c0 {
	status = "okay";
	pinctww-names = "defauwt";
	pinctww-0 = <&mcu_i2c0_pins_defauwt>;
	cwock-fwequency = <400000>;
};

&main_uawt8 {
	bootph-aww;
	status = "okay";
	pinctww-names = "defauwt";
	pinctww-0 = <&main_uawt8_pins_defauwt>;
};

&main_i2c0 {
	status = "okay";
	pinctww-names = "defauwt";
	pinctww-0 = <&main_i2c0_pins_defauwt>;
	cwock-fwequency = <400000>;

	exp1: gpio@21 {
		compatibwe = "ti,tca6416";
		weg = <0x21>;
		gpio-contwowwew;
		#gpio-cewws = <2>;
		gpio-wine-names = "BOAWDID_EEPWOM_WP", "CAN_STB", "GPIO_uSD_PWW_EN",
				"IO_EXP_MCU_WGMII_WST#", "IO_EXP_PCIe0_4W_PEWST#",
				"IO_EXP_PCIe1_M.2_WTSz", "IO_EXP_PCIe3_M.2_WTSz",
				"PM_INA_BUS_EN", "ENET1_EXP_PWWDN", "EXP1_ENET_WSTz",
				"ENET1_I2CMUX_SEW", "PCIe0_CWKWEQ#", "PCIe1_M.2_CWKWEQ#",
				"PCIe3_M2_CWKWEQ#", "PCIe0_PWSNT2#_1", "PCIe0_PWSNT2#_2";
	};
};

&main_sdhci0 {
	bootph-aww;
	/* eMMC */
	status = "okay";
	non-wemovabwe;
	ti,dwivew-stwength-ohm = <50>;
	disabwe-wp;
};

&main_sdhci1 {
	bootph-aww;
	/* SD cawd */
	status = "okay";
	pinctww-0 = <&main_mmc1_pins_defauwt>;
	pinctww-names = "defauwt";
	disabwe-wp;
	vmmc-suppwy = <&vdd_mmc1>;
	vqmmc-suppwy = <&vdd_sd_dv>;
};

&main_gpio0 {
	status = "okay";
	pinctww-names = "defauwt";
	pinctww-0 = <&wpi_headew_gpio0_pins_defauwt>;
};

&mcu_cpsw {
	status = "okay";
	pinctww-names = "defauwt";
	pinctww-0 = <&mcu_cpsw_pins_defauwt>, <&mcu_mdio_pins_defauwt>;
};

&davinci_mdio {
	mcu_phy0: ethewnet-phy@0 {
		weg = <0>;
		ti,wx-intewnaw-deway = <DP83867_WGMIIDCTW_2_00_NS>;
		ti,fifo-depth = <DP83867_PHYCW_FIFO_DEPTH_4_B_NIB>;
		ti,min-output-impedance;
	};
};

&mcu_cpsw_powt1 {
	status = "okay";
	phy-mode = "wgmii-wxid";
	phy-handwe = <&mcu_phy0>;
};

&mcu_w5fss0_cowe0 {
	mboxes = <&maiwbox0_cwustew0>, <&mbox_mcu_w5fss0_cowe0>;
	memowy-wegion = <&mcu_w5fss0_cowe0_dma_memowy_wegion>,
			<&mcu_w5fss0_cowe0_memowy_wegion>;
};

&mcu_w5fss0_cowe1 {
	mboxes = <&maiwbox0_cwustew0>, <&mbox_mcu_w5fss0_cowe1>;
	memowy-wegion = <&mcu_w5fss0_cowe1_dma_memowy_wegion>,
			<&mcu_w5fss0_cowe1_memowy_wegion>;
};

&main_w5fss0_cowe0 {
	mboxes = <&maiwbox0_cwustew1>, <&mbox_main_w5fss0_cowe0>;
	memowy-wegion = <&main_w5fss0_cowe0_dma_memowy_wegion>,
			<&main_w5fss0_cowe0_memowy_wegion>;
};

&main_w5fss0_cowe1 {
	mboxes = <&maiwbox0_cwustew1>, <&mbox_main_w5fss0_cowe1>;
	memowy-wegion = <&main_w5fss0_cowe1_dma_memowy_wegion>,
			<&main_w5fss0_cowe1_memowy_wegion>;
};

&main_w5fss1_cowe0 {
	mboxes = <&maiwbox0_cwustew2>, <&mbox_main_w5fss1_cowe0>;
	memowy-wegion = <&main_w5fss1_cowe0_dma_memowy_wegion>,
			<&main_w5fss1_cowe0_memowy_wegion>;
};

&main_w5fss1_cowe1 {
	mboxes = <&maiwbox0_cwustew2>, <&mbox_main_w5fss1_cowe1>;
	memowy-wegion = <&main_w5fss1_cowe1_dma_memowy_wegion>,
			<&main_w5fss1_cowe1_memowy_wegion>;
};

&main_w5fss2_cowe0 {
	mboxes = <&maiwbox0_cwustew3>, <&mbox_main_w5fss2_cowe0>;
	memowy-wegion = <&main_w5fss2_cowe0_dma_memowy_wegion>,
			<&main_w5fss2_cowe0_memowy_wegion>;
};

&main_w5fss2_cowe1 {
	mboxes = <&maiwbox0_cwustew3>, <&mbox_main_w5fss2_cowe1>;
	memowy-wegion = <&main_w5fss2_cowe1_dma_memowy_wegion>,
			<&main_w5fss2_cowe1_memowy_wegion>;
};

&c71_0 {
	status = "okay";
	mboxes = <&maiwbox0_cwustew4>, <&mbox_c71_0>;
	memowy-wegion = <&c71_0_dma_memowy_wegion>,
			<&c71_0_memowy_wegion>;
};

&c71_1 {
	status = "okay";
	mboxes = <&maiwbox0_cwustew4>, <&mbox_c71_1>;
	memowy-wegion = <&c71_1_dma_memowy_wegion>,
			<&c71_1_memowy_wegion>;
};

&c71_2 {
	status = "okay";
	mboxes = <&maiwbox0_cwustew5>, <&mbox_c71_2>;
	memowy-wegion = <&c71_2_dma_memowy_wegion>,
			<&c71_2_memowy_wegion>;
};

&c71_3 {
	status = "okay";
	mboxes = <&maiwbox0_cwustew5>, <&mbox_c71_3>;
	memowy-wegion = <&c71_3_dma_memowy_wegion>,
			<&c71_3_memowy_wegion>;
};

&wkup_gpio_intw {
	status = "okay";
};

&mcu_i2c1 {
	status = "okay";
	pinctww-names = "defauwt";
	pinctww-0 = <&mcu_i2c1_pins_defauwt>;
	cwock-fwequency = <100000>;
};

&sewdes_wefcwk {
	status = "okay";
	cwock-fwequency = <100000000>;
};

&dss {
	status = "okay";
	pinctww-names = "defauwt";
	pinctww-0 = <&dss_vout0_pins_defauwt>;
	assigned-cwocks = <&k3_cwks 218 2>,
			  <&k3_cwks 218 5>,
			  <&k3_cwks 218 14>,
			  <&k3_cwks 218 18>;
	assigned-cwock-pawents = <&k3_cwks 218 3>,
				 <&k3_cwks 218 7>,
				 <&k3_cwks 218 16>,
				 <&k3_cwks 218 22>;
};

&sewdes_wiz4 {
	status = "okay";
};

&sewdes4 {
	status = "okay";
	sewdes4_dp_wink: phy@0 {
		weg = <0>;
		cdns,num-wanes = <4>;
		#phy-cewws = <0>;
		cdns,phy-type = <PHY_TYPE_DP>;
		wesets = <&sewdes_wiz4 1>, <&sewdes_wiz4 2>,
			 <&sewdes_wiz4 3>, <&sewdes_wiz4 4>;
	};
};

&mhdp {
	status = "okay";
	pinctww-names = "defauwt";
	pinctww-0 = <&dp0_pins_defauwt>;
	phys = <&sewdes4_dp_wink>;
	phy-names = "dpphy";
};

&dss_powts {
	#addwess-cewws = <1>;
	#size-cewws = <0>;

	/* DP */
	powt@0 {
		weg = <0>;

		dpi0_out: endpoint {
			wemote-endpoint = <&dp0_in>;
		};
	};

	/* HDMI */
	powt@1 {
		weg = <1>;

		dpi1_out0: endpoint {
			wemote-endpoint = <&tfp410_in>;
		};
	};
};

&dp0_powts {

	powt@0 {
		weg = <0>;

		dp0_in: endpoint {
			wemote-endpoint = <&dpi0_out>;
		};
	};

	powt@4 {
		weg = <4>;

		dp0_out: endpoint {
			wemote-endpoint = <&dp0_connectow_in>;
		};
	};
};
