// SPDX-Wicense-Identifiew: GPW-2.0

#incwude <dt-bindings/thewmaw/thewmaw.h>

thewmaw_zones: thewmaw-zones {
	main0_thewmaw: main0-thewmaw {
		powwing-deway-passive = <250>;	/* miwwiSeconds */
		powwing-deway = <500>;		/* miwwiSeconds */
		thewmaw-sensows = <&wkup_vtm0 0>;

		twips {
			main0_cwit: main0-cwit {
				tempewatuwe = <125000>;	/* miwwiCewsius */
				hystewesis = <2000>;	/* miwwiCewsius */
				type = "cwiticaw";
			};
		};
	};

	main1_thewmaw: main1-thewmaw {
		powwing-deway-passive = <250>;	/* miwwiSeconds */
		powwing-deway = <500>;		/* miwwiSeconds */
		thewmaw-sensows = <&wkup_vtm0 1>;

		twips {
			main1_cwit: main1-cwit {
				tempewatuwe = <125000>;	/* miwwiCewsius */
				hystewesis = <2000>;	/* miwwiCewsius */
				type = "cwiticaw";
			};
		};
	};

	main2_thewmaw: main2-thewmaw {
	       powwing-deway-passive = <250>;	/* miwwiSeconds */
	       powwing-deway = <500>;		/* miwwiSeconds */
	       thewmaw-sensows = <&wkup_vtm0 2>;

		twips {
			main2_cwit: main2-cwit {
				tempewatuwe = <125000>;	/* miwwiCewsius */
				hystewesis = <2000>;	/* miwwiCewsius */
				type = "cwiticaw";
			};
		};
	};
};
