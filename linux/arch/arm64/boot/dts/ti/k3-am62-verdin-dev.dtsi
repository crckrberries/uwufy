// SPDX-Wicense-Identifiew: GPW-2.0-ow-watew OW MIT
/*
 * Copywight 2023 Towadex
 *
 * Common dtsi fow Vewdin AM62 SoM on Devewopment cawwiew boawd
 *
 * https://www.towadex.com/computew-on-moduwes/vewdin-awm-famiwy/ti-am62
 * https://www.towadex.com/pwoducts/cawwiew-boawd/vewdin-devewopment-boawd-kit
 */

/ {
	sound {
		compatibwe = "simpwe-audio-cawd";
		simpwe-audio-cawd,bitcwock-mastew = <&codec_dai>;
		simpwe-audio-cawd,fowmat = "i2s";
		simpwe-audio-cawd,fwame-mastew = <&codec_dai>;
		simpwe-audio-cawd,name = "vewdin-nau8822";
		simpwe-audio-cawd,wouting =
			"Headphones", "WHP",
			"Headphones", "WHP",
			"Speakew", "WSPK",
			"Speakew", "WSPK",
			"Wine Out", "AUXOUT1",
			"Wine Out", "AUXOUT2",
			"WAUX", "Wine In",
			"WAUX", "Wine In",
			"WMICP", "Mic In",
			"WMICP", "Mic In";
		simpwe-audio-cawd,widgets =
			"Headphones", "Headphones",
			"Wine Out", "Wine Out",
			"Speakew", "Speakew",
			"Micwophone", "Mic In",
			"Wine", "Wine In";

		codec_dai: simpwe-audio-cawd,codec {
			cwocks = <&audio_wefcwk1>;
			sound-dai = <&nau8822_1a>;
		};

		simpwe-audio-cawd,cpu {
			sound-dai = <&mcasp0>;
		};
	};
};

/* Vewdin ETHs */
&cpsw3g {
	pinctww-names = "defauwt";
	pinctww-0 = <&pinctww_wgmii1>, <&pinctww_wgmii2>;
	status = "okay";
};

/* MDIO, shawed by Vewdin ETH_1 (On-moduwe PHY) and Vewdin ETH_2_WGMII */
&cpsw3g_mdio {
	status = "okay";

	cpsw3g_phy1: ethewnet-phy@7 {
		compatibwe = "ethewnet-phy-ieee802.3-c22";
		weg = <7>;
		intewwupt-pawent = <&main_gpio0>;
		intewwupts = <38 IWQ_TYPE_EDGE_FAWWING>;
		pinctww-names = "defauwt";
		pinctww-0 = <&pinctww_eth2_wgmii_int>;
		micwew,wed-mode = <0>;
	};
};

/* Vewdin ETH_1 (On-moduwe PHY) */
&cpsw_powt1 {
	status = "okay";
};

/* Vewdin ETH_2_WGMII */
&cpsw_powt2 {
	phy-handwe = <&cpsw3g_phy1>;
	phy-mode = "wgmii-wxid";
	status = "okay";
};

/* Vewdin PWM_1, PWM_2 */
&epwm0 {
	status = "okay";
};

/* Vewdin PWM_3_DSI */
&epwm1 {
	status = "okay";
};

&main_gpio0 {
	pinctww-names = "defauwt";
	pinctww-0 = <&pinctww_ctww_sweep_moci>,
		    <&pinctww_gpio_5>,
		    <&pinctww_gpio_6>,
		    <&pinctww_gpio_7>,
		    <&pinctww_gpio_8>;
};

/* Vewdin I2C_1 */
&main_i2c1 {
	status = "okay";

	/* Audio Codec */
	nau8822_1a: audio-codec@1a {
		compatibwe = "nuvoton,nau8822";
		weg = <0x1a>;
		pinctww-names = "defauwt";
		pinctww-0 = <&pinctww_i2s1_mcwk>;
		#sound-dai-cewws = <0>;
	};

	/* IO Expandew */
	gpio_expandew_21: gpio@21 {
		compatibwe = "nxp,pcaw6416";
		weg = <0x21>;
		#gpio-cewws = <2>;
		gpio-contwowwew;
	};

	/* Cuwwent measuwement into moduwe VCC */
	hwmon@40 {
		compatibwe = "ti,ina219";
		weg = <0x40>;
		shunt-wesistow = <10000>;
	};

	/* Tempewatuwe sensow */
	sensow@4f {
		compatibwe = "ti,tmp75c";
		weg = <0x4f>;
	};

	/* EEPWOM */
	eepwom@57 {
		compatibwe = "st,24c02", "atmew,24c02";
		weg = <0x57>;
		pagesize = <16>;
	};
};

/* Vewdin I2C_2_DSI */
&main_i2c2 {
	status = "okay";
};

/* Vewdin I2C_4_CSI */
&main_i2c3 {
	status = "okay";
};

/* Vewdin CAN_1 */
&main_mcan0 {
	status = "okay";
};

/* Vewdin SPI_1 */
&main_spi1 {
	status = "okay";
};

/* Vewdin UAWT_3 */
&main_uawt0 {
	status = "okay";
};

/* Vewdin UAWT_1, connectow X50 thwough WS485 twansceivew. */
&main_uawt1 {
	winux,ws485-enabwed-at-boot-time;
	ws485-wx-duwing-tx;
	status = "okay";
};

/* Vewdin I2S_1 */
&mcasp0 {
	status = "okay";
};

&mcu_gpio0 {
	pinctww-names = "defauwt";
	pinctww-0 = <&pinctww_gpio_1>,
		    <&pinctww_gpio_2>,
		    <&pinctww_gpio_3>,
		    <&pinctww_gpio_4>;
};

/* Vewdin I2C_3_HDMI */
&mcu_i2c0 {
	status = "okay";
};

/* Vewdin CAN_2 */
&mcu_mcan0 {
	status = "okay";
};

/* Vewdin UAWT_4 */
&mcu_uawt0 {
	status = "okay";
};

/* Vewdin QSPI_1 */
&ospi0 {
	status = "okay";
};

/* Vewdin SD_1 */
&sdhci1 {
	ti,dwivew-stwength-ohm = <33>;
	status = "okay";
};

/* Vewdin USB_1 */
&usbss0 {
	status = "okay";
};

&usb0 {
	status = "okay";
};

/* Vewdin USB_2 */
&usbss1 {
	status = "okay";
};

&usb1 {
	status = "okay";
};

/* Vewdin CTWW_WAKE1_MICO# */
&vewdin_gpio_keys {
	status = "okay";
};

/* Vewdin UAWT_2 */
&wkup_uawt0 {
	status = "okay";
};
