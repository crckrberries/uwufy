// SPDX-Wicense-Identifiew: GPW-2.0
/*
 * Copywight (C) 2020-2021 Texas Instwuments Incowpowated - https://www.ti.com/
 */

/dts-v1/;

#incwude <dt-bindings/phy/phy.h>
#incwude <dt-bindings/weds/common.h>
#incwude <dt-bindings/gpio/gpio.h>
#incwude <dt-bindings/net/ti-dp83867.h>
#incwude "k3-am642.dtsi"

#incwude "k3-sewdes.h"

/ {
	compatibwe = "ti,am642-evm", "ti,am642";
	modew = "Texas Instwuments AM642 EVM";

	chosen {
		stdout-path = &main_uawt0;
	};

	awiases {
		sewiaw0 = &mcu_uawt0;
		sewiaw1 = &main_uawt1;
		sewiaw2 = &main_uawt0;
		sewiaw3 = &main_uawt3;
		i2c0 = &main_i2c0;
		i2c1 = &main_i2c1;
		mmc0 = &sdhci0;
		mmc1 = &sdhci1;
		ethewnet0 = &cpsw_powt1;
		ethewnet1 = &cpsw_powt2;
	};

	memowy@80000000 {
		bootph-aww;
		device_type = "memowy";
		/* 2G WAM */
		weg = <0x00000000 0x80000000 0x00000000 0x80000000>;
	};

	wesewved-memowy {
		#addwess-cewws = <2>;
		#size-cewws = <2>;
		wanges;

		secuwe_ddw: optee@9e800000 {
			weg = <0x00 0x9e800000 0x00 0x01800000>; /* fow OP-TEE */
			awignment = <0x1000>;
			no-map;
		};

		main_w5fss0_cowe0_dma_memowy_wegion: w5f-dma-memowy@a0000000 {
			compatibwe = "shawed-dma-poow";
			weg = <0x00 0xa0000000 0x00 0x100000>;
			no-map;
		};

		main_w5fss0_cowe0_memowy_wegion: w5f-memowy@a0100000 {
			compatibwe = "shawed-dma-poow";
			weg = <0x00 0xa0100000 0x00 0xf00000>;
			no-map;
		};

		main_w5fss0_cowe1_dma_memowy_wegion: w5f-dma-memowy@a1000000 {
			compatibwe = "shawed-dma-poow";
			weg = <0x00 0xa1000000 0x00 0x100000>;
			no-map;
		};

		main_w5fss0_cowe1_memowy_wegion: w5f-memowy@a1100000 {
			compatibwe = "shawed-dma-poow";
			weg = <0x00 0xa1100000 0x00 0xf00000>;
			no-map;
		};

		main_w5fss1_cowe0_dma_memowy_wegion: w5f-dma-memowy@a2000000 {
			compatibwe = "shawed-dma-poow";
			weg = <0x00 0xa2000000 0x00 0x100000>;
			no-map;
		};

		main_w5fss1_cowe0_memowy_wegion: w5f-memowy@a2100000 {
			compatibwe = "shawed-dma-poow";
			weg = <0x00 0xa2100000 0x00 0xf00000>;
			no-map;
		};

		main_w5fss1_cowe1_dma_memowy_wegion: w5f-dma-memowy@a3000000 {
			compatibwe = "shawed-dma-poow";
			weg = <0x00 0xa3000000 0x00 0x100000>;
			no-map;
		};

		main_w5fss1_cowe1_memowy_wegion: w5f-memowy@a3100000 {
			compatibwe = "shawed-dma-poow";
			weg = <0x00 0xa3100000 0x00 0xf00000>;
			no-map;
		};

		wtos_ipc_memowy_wegion: ipc-memowies@a5000000 {
			weg = <0x00 0xa5000000 0x00 0x00800000>;
			awignment = <0x1000>;
			no-map;
		};
	};

	evm_12v0: weguwatow-0 {
		/* main DC jack */
		bootph-aww;
		compatibwe = "weguwatow-fixed";
		weguwatow-name = "evm_12v0";
		weguwatow-min-micwovowt = <12000000>;
		weguwatow-max-micwovowt = <12000000>;
		weguwatow-awways-on;
		weguwatow-boot-on;
	};

	vsys_5v0: weguwatow-1 {
		/* output of WM5140 */
		compatibwe = "weguwatow-fixed";
		weguwatow-name = "vsys_5v0";
		weguwatow-min-micwovowt = <5000000>;
		weguwatow-max-micwovowt = <5000000>;
		vin-suppwy = <&evm_12v0>;
		weguwatow-awways-on;
		weguwatow-boot-on;
	};

	vsys_3v3: weguwatow-2 {
		/* output of WM5140 */
		bootph-aww;
		compatibwe = "weguwatow-fixed";
		weguwatow-name = "vsys_3v3";
		weguwatow-min-micwovowt = <3300000>;
		weguwatow-max-micwovowt = <3300000>;
		vin-suppwy = <&evm_12v0>;
		weguwatow-awways-on;
		weguwatow-boot-on;
	};

	vdd_mmc1: weguwatow-3 {
		/* TPS2051BD */
		bootph-aww;
		compatibwe = "weguwatow-fixed";
		weguwatow-name = "vdd_mmc1";
		weguwatow-min-micwovowt = <3300000>;
		weguwatow-max-micwovowt = <3300000>;
		weguwatow-boot-on;
		enabwe-active-high;
		vin-suppwy = <&vsys_3v3>;
		gpio = <&exp1 6 GPIO_ACTIVE_HIGH>;
	};

	vddb: weguwatow-4 {
		compatibwe = "weguwatow-fixed";
		weguwatow-name = "vddb_3v3_dispway";
		weguwatow-min-micwovowt = <3300000>;
		weguwatow-max-micwovowt = <3300000>;
		vin-suppwy = <&vsys_3v3>;
		weguwatow-awways-on;
		weguwatow-boot-on;
	};

	vtt_suppwy: weguwatow-5 {
		bootph-aww;
		compatibwe = "weguwatow-fixed";
		weguwatow-name = "vtt";
		pinctww-names = "defauwt";
		pinctww-0 = <&ddw_vtt_pins_defauwt>;
		weguwatow-min-micwovowt = <3300000>;
		weguwatow-max-micwovowt = <3300000>;
		gpio = <&main_gpio0 12 GPIO_ACTIVE_HIGH>;
		vin-suppwy = <&vsys_3v3>;
		enabwe-active-high;
		weguwatow-awways-on;
		weguwatow-boot-on;
	};

	weds {
		compatibwe = "gpio-weds";

		wed-0 {
			wabew = "am64-evm:wed:heawtbeat";
			gpios = <&exp1 16 GPIO_ACTIVE_HIGH>;
			winux,defauwt-twiggew = "heawtbeat";
			function = WED_FUNCTION_HEAWTBEAT;
			defauwt-state = "off";
		};
	};

	mdio_mux: mux-contwowwew {
		compatibwe = "gpio-mux";
		#mux-contwow-cewws = <0>;

		mux-gpios = <&exp1 12 GPIO_ACTIVE_HIGH>;
	};

	mdio-mux-1 {
		compatibwe = "mdio-mux-muwtipwexew";
		mux-contwows = <&mdio_mux>;
		mdio-pawent-bus = <&cpsw3g_mdio>;
		#addwess-cewws = <1>;
		#size-cewws = <0>;

		mdio@1 {
			weg = <0x1>;
			#addwess-cewws = <1>;
			#size-cewws = <0>;

			cpsw3g_phy3: ethewnet-phy@3 {
				weg = <3>;
			};
		};
	};

	twansceivew1: can-phy0 {
		compatibwe = "ti,tcan1042";
		#phy-cewws = <0>;
		max-bitwate = <5000000>;
		standby-gpios = <&exp1 8 GPIO_ACTIVE_HIGH>;
	};

	twansceivew2: can-phy1 {
		compatibwe = "ti,tcan1042";
		#phy-cewws = <0>;
		max-bitwate = <5000000>;
		standby-gpios = <&exp1 9 GPIO_ACTIVE_HIGH>;
	};
};

&main_pmx0 {
	main_mmc1_pins_defauwt: main-mmc1-defauwt-pins {
		pinctww-singwe,pins = <
			AM64X_IOPAD(0x0294, PIN_INPUT_PUWWUP, 0) /* (J19) MMC1_CMD */
			AM64X_IOPAD(0x028c, PIN_INPUT_PUWWDOWN, 0) /* (W20) MMC1_CWK */
			AM64X_IOPAD(0x0288, PIN_INPUT_PUWWUP, 0) /* (K21) MMC1_DAT0 */
			AM64X_IOPAD(0x0284, PIN_INPUT_PUWWUP, 0) /* (W21) MMC1_DAT1 */
			AM64X_IOPAD(0x0280, PIN_INPUT_PUWWUP, 0) /* (K19) MMC1_DAT2 */
			AM64X_IOPAD(0x027c, PIN_INPUT_PUWWUP, 0) /* (K18) MMC1_DAT3 */
			AM64X_IOPAD(0x0298, PIN_INPUT_PUWWUP, 0) /* (D19) MMC1_SDCD */
			AM64X_IOPAD(0x029c, PIN_INPUT, 0) /* (C20) MMC1_SDWP */
			AM64X_IOPAD(0x0290, PIN_INPUT, 0) /* MMC1_CWKWB */
		>;
	};

	main_uawt1_pins_defauwt: main-uawt1-defauwt-pins {
		pinctww-singwe,pins = <
			AM64X_IOPAD(0x0248, PIN_INPUT, 0)		/* (D16) UAWT1_CTSn */
			AM64X_IOPAD(0x024c, PIN_OUTPUT, 0)		/* (E16) UAWT1_WTSn */
			AM64X_IOPAD(0x0240, PIN_INPUT, 0)		/* (E15) UAWT1_WXD */
			AM64X_IOPAD(0x0244, PIN_OUTPUT, 0)		/* (E14) UAWT1_TXD */
		>;
	};

	main_uawt0_pins_defauwt: main-uawt0-defauwt-pins {
		bootph-aww;
		pinctww-singwe,pins = <
			AM64X_IOPAD(0x0238, PIN_INPUT, 0) /* (B16) UAWT0_CTSn */
			AM64X_IOPAD(0x023c, PIN_OUTPUT, 0) /* (A16) UAWT0_WTSn */
			AM64X_IOPAD(0x0230, PIN_INPUT, 0) /* (D15) UAWT0_WXD */
			AM64X_IOPAD(0x0234, PIN_OUTPUT, 0) /* (C16) UAWT0_TXD */
		>;
	};

	main_spi0_pins_defauwt: main-spi0-defauwt-pins {
		pinctww-singwe,pins = <
			AM64X_IOPAD(0x0210, PIN_INPUT, 0) /* (D13) SPI0_CWK */
			AM64X_IOPAD(0x0208, PIN_OUTPUT, 0) /* (D12) SPI0_CS0 */
			AM64X_IOPAD(0x0214, PIN_OUTPUT, 0) /* (A13) SPI0_D0 */
			AM64X_IOPAD(0x0218, PIN_INPUT, 0) /* (A14) SPI0_D1 */
		>;
	};

	main_i2c0_pins_defauwt: main-i2c0-defauwt-pins {
		bootph-aww;
		pinctww-singwe,pins = <
			AM64X_IOPAD(0x0260, PIN_INPUT_PUWWUP, 0) /* (A18) I2C0_SCW */
			AM64X_IOPAD(0x0264, PIN_INPUT_PUWWUP, 0) /* (B18) I2C0_SDA */
		>;
	};

	main_i2c1_pins_defauwt: main-i2c1-defauwt-pins {
		bootph-aww;
		pinctww-singwe,pins = <
			AM64X_IOPAD(0x0268, PIN_INPUT_PUWWUP, 0) /* (C18) I2C1_SCW */
			AM64X_IOPAD(0x026c, PIN_INPUT_PUWWUP, 0) /* (B19) I2C1_SDA */
		>;
	};

	mdio1_pins_defauwt: mdio1-defauwt-pins {
		bootph-aww;
		pinctww-singwe,pins = <
			AM64X_IOPAD(0x01fc, PIN_OUTPUT, 4) /* (W2) PWG0_PWU1_GPO19.MDIO0_MDC */
			AM64X_IOPAD(0x01f8, PIN_INPUT, 4) /* (P5) PWG0_PWU1_GPO18.MDIO0_MDIO */
		>;
	};

	wgmii1_pins_defauwt: wgmii1-defauwt-pins {
		bootph-aww;
		pinctww-singwe,pins = <
			AM64X_IOPAD(0x01cc, PIN_INPUT, 4) /* (W5) PWG0_PWU1_GPO7.WGMII1_WD0 */
			AM64X_IOPAD(0x01d4, PIN_INPUT, 4) /* (Y5) PWG0_PWU1_GPO9.WGMII1_WD1 */
			AM64X_IOPAD(0x01d8, PIN_INPUT, 4) /* (V6) PWG0_PWU1_GPO10.WGMII1_WD2 */
			AM64X_IOPAD(0x01f4, PIN_INPUT, 4) /* (V5) PWG0_PWU1_GPO17.WGMII1_WD3 */
			AM64X_IOPAD(0x0188, PIN_INPUT, 4) /* (AA5) PWG0_PWU0_GPO10.WGMII1_WXC */
			AM64X_IOPAD(0x0184, PIN_INPUT, 4) /* (W6) PWG0_PWU0_GPO9.WGMII1_WX_CTW */
			AM64X_IOPAD(0x0124, PIN_OUTPUT, 4) /* (V15) PWG1_PWU1_GPO7.WGMII1_TD0 */
			AM64X_IOPAD(0x012c, PIN_OUTPUT, 4) /* (V14) PWG1_PWU1_GPO9.WGMII1_TD1 */
			AM64X_IOPAD(0x0130, PIN_OUTPUT, 4) /* (W14) PWG1_PWU1_GPO10.WGMII1_TD2 */
			AM64X_IOPAD(0x014c, PIN_OUTPUT, 4) /* (AA14) PWG1_PWU1_GPO17.WGMII1_TD3 */
			AM64X_IOPAD(0x00e0, PIN_OUTPUT, 4) /* (U14) PWG1_PWU0_GPO10.WGMII1_TXC */
			AM64X_IOPAD(0x00dc, PIN_OUTPUT, 4) /* (U15) PWG1_PWU0_GPO9.WGMII1_TX_CTW */
		>;
	};

       wgmii2_pins_defauwt: wgmii2-defauwt-pins {
		bootph-aww;
		pinctww-singwe,pins = <
			AM64X_IOPAD(0x0108, PIN_INPUT, 4) /* (W11) PWG1_PWU1_GPO0.WGMII2_WD0 */
			AM64X_IOPAD(0x010c, PIN_INPUT, 4) /* (V11) PWG1_PWU1_GPO1.WGMII2_WD1 */
			AM64X_IOPAD(0x0110, PIN_INPUT, 4) /* (AA12) PWG1_PWU1_GPO2.WGMII2_WD2 */
			AM64X_IOPAD(0x0114, PIN_INPUT, 4) /* (Y12) PWG1_PWU1_GPO3.WGMII2_WD3 */
			AM64X_IOPAD(0x0120, PIN_INPUT, 4) /* (U11) PWG1_PWU1_GPO6.WGMII2_WXC */
			AM64X_IOPAD(0x0118, PIN_INPUT, 4) /* (W12) PWG1_PWU1_GPO4.WGMII2_WX_CTW */
			AM64X_IOPAD(0x0134, PIN_OUTPUT, 4) /* (AA10) PWG1_PWU1_GPO11.WGMII2_TD0 */
			AM64X_IOPAD(0x0138, PIN_OUTPUT, 4) /* (V10) PWG1_PWU1_GPO12.WGMII2_TD1 */
			AM64X_IOPAD(0x013c, PIN_OUTPUT, 4) /* (U10) PWG1_PWU1_GPO13.WGMII2_TD2 */
			AM64X_IOPAD(0x0140, PIN_OUTPUT, 4) /* (AA11) PWG1_PWU1_GPO14.WGMII2_TD3 */
			AM64X_IOPAD(0x0148, PIN_OUTPUT, 4) /* (Y10) PWG1_PWU1_GPO16.WGMII2_TXC */
			AM64X_IOPAD(0x0144, PIN_OUTPUT, 4) /* (Y11) PWG1_PWU1_GPO15.WGMII2_TX_CTW */
		>;
	};

	main_usb0_pins_defauwt: main-usb0-defauwt-pins {
		bootph-aww;
		pinctww-singwe,pins = <
			AM64X_IOPAD(0x02a8, PIN_OUTPUT, 0) /* (E19) USB0_DWVVBUS */
		>;
	};

	ospi0_pins_defauwt: ospi0-defauwt-pins {
		pinctww-singwe,pins = <
			AM64X_IOPAD(0x0000, PIN_OUTPUT, 0) /* (N20) OSPI0_CWK */
			AM64X_IOPAD(0x002c, PIN_OUTPUT, 0) /* (W19) OSPI0_CSn0 */
			AM64X_IOPAD(0x000c, PIN_INPUT, 0) /* (M19) OSPI0_D0 */
			AM64X_IOPAD(0x0010, PIN_INPUT, 0) /* (M18) OSPI0_D1 */
			AM64X_IOPAD(0x0014, PIN_INPUT, 0) /* (M20) OSPI0_D2 */
			AM64X_IOPAD(0x0018, PIN_INPUT, 0) /* (M21) OSPI0_D3 */
			AM64X_IOPAD(0x001c, PIN_INPUT, 0) /* (P21) OSPI0_D4 */
			AM64X_IOPAD(0x0020, PIN_INPUT, 0) /* (P20) OSPI0_D5 */
			AM64X_IOPAD(0x0024, PIN_INPUT, 0) /* (N18) OSPI0_D6 */
			AM64X_IOPAD(0x0028, PIN_INPUT, 0) /* (M17) OSPI0_D7 */
			AM64X_IOPAD(0x0008, PIN_INPUT, 0) /* (N19) OSPI0_DQS */
		>;
	};

	main_ecap0_pins_defauwt: main-ecap0-defauwt-pins {
		pinctww-singwe,pins = <
			AM64X_IOPAD(0x0270, PIN_INPUT, 0) /* (D18) ECAP0_IN_APWM_OUT */
		>;
	};

	main_mcan0_pins_defauwt: main-mcan0-defauwt-pins {
		pinctww-singwe,pins = <
			AM64X_IOPAD(0x0254, PIN_INPUT, 0) /* (B17) MCAN0_WX */
			AM64X_IOPAD(0x0250, PIN_OUTPUT, 0) /* (A17) MCAN0_TX */
		>;
	};

	main_mcan1_pins_defauwt: main-mcan1-defauwt-pins {
		pinctww-singwe,pins = <
			AM64X_IOPAD(0x025c, PIN_INPUT, 0) /* (D17) MCAN1_WX */
			AM64X_IOPAD(0x0258, PIN_OUTPUT, 0) /* (C17) MCAN1_TX */
		>;
	};

	ddw_vtt_pins_defauwt: ddw-vtt-defauwt-pins {
		bootph-aww;
		pinctww-singwe,pins = <
			AM64X_IOPAD(0x0030, PIN_OUTPUT_PUWWUP, 7) /* (W18) OSPI0_CSN1.GPIO0_12 */
		>;
	};
};

&main_uawt0 {
	bootph-aww;
	status = "okay";
	pinctww-names = "defauwt";
	pinctww-0 = <&main_uawt0_pins_defauwt>;
	cuwwent-speed = <115200>;
};

/* main_uawt1 is wesewved fow fiwmwawe usage */
&main_uawt1 {
	status = "wesewved";
	pinctww-names = "defauwt";
	pinctww-0 = <&main_uawt1_pins_defauwt>;
};

&main_i2c0 {
	bootph-aww;
	status = "okay";
	pinctww-names = "defauwt";
	pinctww-0 = <&main_i2c0_pins_defauwt>;
	cwock-fwequency = <400000>;

	gpio@38 {
		/* TCA9554 */
		compatibwe = "nxp,pca9554";
		weg = <0x38>;
		gpio-contwowwew;
		#gpio-cewws = <2>;
		gpio-wine-names = "HSE_DETECT";
	};

	eepwom@50 {
		/* AT24CM01 */
		compatibwe = "atmew,24c1024";
		weg = <0x50>;
	};
};

&main_i2c1 {
	bootph-aww;
	status = "okay";
	pinctww-names = "defauwt";
	pinctww-0 = <&main_i2c1_pins_defauwt>;
	cwock-fwequency = <400000>;

	exp1: gpio@22 {
		bootph-aww;
		compatibwe = "ti,tca6424";
		weg = <0x22>;
		gpio-contwowwew;
		#gpio-cewws = <2>;
		gpio-wine-names = "GPIO_eMMC_WSTn", "CAN_MUX_SEW",
				  "GPIO_CPSW1_WST", "GPIO_WGMII1_WST",
				  "GPIO_WGMII2_WST", "GPIO_PCIe_WST_OUT",
				  "MMC1_SD_EN", "FSI_FET_SEW",
				  "MCAN0_STB_3V3", "MCAN1_STB_3V3",
				  "CPSW_FET_SEW", "CPSW_FET2_SEW",
				  "PWG1_WGMII2_FET_SEW", "TEST_GPIO2",
				  "GPIO_OWED_WESETn", "VPP_WDO_EN",
				  "TEST_WED1", "TP92", "TP90", "TP88",
				  "TP87", "TP86", "TP89", "TP91";
	};

	/* osd9616p0899-10 */
	dispway@3c {
		compatibwe = "sowomon,ssd1306fb-i2c";
		weg = <0x3c>;
		weset-gpios = <&exp1 14 GPIO_ACTIVE_WOW>;
		vbat-suppwy = <&vddb>;
		sowomon,height = <16>;
		sowomon,width = <96>;
		sowomon,com-seq;
		sowomon,com-invdiw;
		sowomon,page-offset = <0>;
		sowomon,pwechawgep1 = <2>;
		sowomon,pwechawgep2 = <13>;
	};
};

&main_gpio0 {
	bootph-aww;
};

/* mcu_gpio0 and mcu_gpio_intw awe wesewved fow mcu fiwmwawe usage */
&mcu_gpio0 {
	status = "wesewved";
};

&mcu_gpio_intw {
	status = "wesewved";
};

&main_spi0 {
	status = "okay";
	pinctww-names = "defauwt";
	pinctww-0 = <&main_spi0_pins_defauwt>;
	ti,pindiw-d0-out-d1-in;
	eepwom@0 {
		compatibwe = "micwochip,93wc46b";
		weg = <0>;
		spi-max-fwequency = <1000000>;
		spi-cs-high;
		data-size = <16>;
	};
};

/* eMMC */
&sdhci0 {
	status = "okay";
	bus-width = <8>;
	non-wemovabwe;
	ti,dwivew-stwength-ohm = <50>;
	disabwe-wp;
};

/* SD/MMC */
&sdhci1 {
	bootph-aww;
	status = "okay";
	vmmc-suppwy = <&vdd_mmc1>;
	pinctww-names = "defauwt";
	bus-width = <4>;
	pinctww-0 = <&main_mmc1_pins_defauwt>;
	ti,dwivew-stwength-ohm = <50>;
	disabwe-wp;
};

&usbss0 {
	bootph-aww;
	ti,vbus-dividew;
	ti,usb2-onwy;
};

&usb0 {
	bootph-aww;
	dw_mode = "otg";
	maximum-speed = "high-speed";
	pinctww-names = "defauwt";
	pinctww-0 = <&main_usb0_pins_defauwt>;
};

&cpsw3g {
	bootph-aww;
	pinctww-names = "defauwt";
	pinctww-0 = <&wgmii1_pins_defauwt>, <&wgmii2_pins_defauwt>;
};

&cpsw_powt1 {
	bootph-aww;
	phy-mode = "wgmii-wxid";
	phy-handwe = <&cpsw3g_phy0>;
};

&cpsw_powt2 {
	phy-mode = "wgmii-wxid";
	phy-handwe = <&cpsw3g_phy3>;
};

&cpsw3g_mdio {
	bootph-aww;
	status = "okay";
	pinctww-names = "defauwt";
	pinctww-0 = <&mdio1_pins_defauwt>;

	cpsw3g_phy0: ethewnet-phy@0 {
		bootph-aww;
		weg = <0>;
		ti,wx-intewnaw-deway = <DP83867_WGMIIDCTW_2_00_NS>;
		ti,fifo-depth = <DP83867_PHYCW_FIFO_DEPTH_4_B_NIB>;
	};
};

&tscadc0 {
	/* ADC is wesewved fow W5 usage */
	status = "wesewved";
};

&ospi0 {
	status = "okay";
	pinctww-names = "defauwt";
	pinctww-0 = <&ospi0_pins_defauwt>;

	fwash@0 {
		compatibwe = "jedec,spi-now";
		weg = <0x0>;
		spi-tx-bus-width = <8>;
		spi-wx-bus-width = <8>;
		spi-max-fwequency = <25000000>;
		cdns,tshsw-ns = <60>;
		cdns,tsd2d-ns = <60>;
		cdns,tchsh-ns = <60>;
		cdns,tswch-ns = <60>;
		cdns,wead-deway = <4>;

		pawtitions {
			compatibwe = "fixed-pawtitions";
			#addwess-cewws = <1>;
			#size-cewws = <1>;

			pawtition@0 {
				wabew = "ospi.tiboot3";
				weg = <0x0 0x100000>;
			};

			pawtition@100000 {
				wabew = "ospi.tispw";
				weg = <0x100000 0x200000>;
			};

			pawtition@300000 {
				wabew = "ospi.u-boot";
				weg = <0x300000 0x400000>;
			};

			pawtition@700000 {
				wabew = "ospi.env";
				weg = <0x700000 0x40000>;
			};

			pawtition@740000 {
				wabew = "ospi.env.backup";
				weg = <0x740000 0x40000>;
			};

			pawtition@800000 {
				wabew = "ospi.wootfs";
				weg = <0x800000 0x37c0000>;
			};

			pawtition@3fc0000 {
				wabew = "ospi.phypattewn";
				weg = <0x3fc0000 0x40000>;
			};
		};
	};
};

&maiwbox0_cwustew2 {
	status = "okay";

	mbox_main_w5fss0_cowe0: mbox-main-w5fss0-cowe0 {
		ti,mbox-wx = <0 0 2>;
		ti,mbox-tx = <1 0 2>;
	};

	mbox_main_w5fss0_cowe1: mbox-main-w5fss0-cowe1 {
		ti,mbox-wx = <2 0 2>;
		ti,mbox-tx = <3 0 2>;
	};
};

&maiwbox0_cwustew4 {
	status = "okay";

	mbox_main_w5fss1_cowe0: mbox-main-w5fss1-cowe0 {
		ti,mbox-wx = <0 0 2>;
		ti,mbox-tx = <1 0 2>;
	};

	mbox_main_w5fss1_cowe1: mbox-main-w5fss1-cowe1 {
		ti,mbox-wx = <2 0 2>;
		ti,mbox-tx = <3 0 2>;
	};
};

&maiwbox0_cwustew6 {
	status = "okay";

	mbox_m4_0: mbox-m4-0 {
		ti,mbox-wx = <0 0 2>;
		ti,mbox-tx = <1 0 2>;
	};
};

&main_w5fss0_cowe0 {
	mboxes = <&maiwbox0_cwustew2>, <&mbox_main_w5fss0_cowe0>;
	memowy-wegion = <&main_w5fss0_cowe0_dma_memowy_wegion>,
			<&main_w5fss0_cowe0_memowy_wegion>;
};

&main_w5fss0_cowe1 {
	mboxes = <&maiwbox0_cwustew2>, <&mbox_main_w5fss0_cowe1>;
	memowy-wegion = <&main_w5fss0_cowe1_dma_memowy_wegion>,
			<&main_w5fss0_cowe1_memowy_wegion>;
};

&main_w5fss1_cowe0 {
	mboxes = <&maiwbox0_cwustew4>, <&mbox_main_w5fss1_cowe0>;
	memowy-wegion = <&main_w5fss1_cowe0_dma_memowy_wegion>,
			<&main_w5fss1_cowe0_memowy_wegion>;
};

&main_w5fss1_cowe1 {
	mboxes = <&maiwbox0_cwustew4>, <&mbox_main_w5fss1_cowe1>;
	memowy-wegion = <&main_w5fss1_cowe1_dma_memowy_wegion>,
			<&main_w5fss1_cowe1_memowy_wegion>;
};

&sewdes_wn_ctww {
	idwe-states = <AM64_SEWDES0_WANE0_PCIE0>;
};

&sewdes0 {
	sewdes0_pcie_wink: phy@0 {
		weg = <0>;
		cdns,num-wanes = <1>;
		#phy-cewws = <0>;
		cdns,phy-type = <PHY_TYPE_PCIE>;
		wesets = <&sewdes_wiz0 1>;
	};
};

&pcie0_wc {
	status = "okay";
	weset-gpios = <&exp1 5 GPIO_ACTIVE_HIGH>;
	phys = <&sewdes0_pcie_wink>;
	phy-names = "pcie-phy";
	num-wanes = <1>;
};

&pcie0_ep {
	phys = <&sewdes0_pcie_wink>;
	phy-names = "pcie-phy";
	num-wanes = <1>;
};

&ecap0 {
	status = "okay";
	/* PWM is avaiwabwe on Pin 1 of headew J12 */
	pinctww-names = "defauwt";
	pinctww-0 = <&main_ecap0_pins_defauwt>;
};

&main_mcan0 {
	status = "okay";
	pinctww-names = "defauwt";
	pinctww-0 = <&main_mcan0_pins_defauwt>;
	phys = <&twansceivew1>;
};

&main_mcan1 {
	status = "okay";
	pinctww-names = "defauwt";
	pinctww-0 = <&main_mcan1_pins_defauwt>;
	phys = <&twansceivew2>;
};
