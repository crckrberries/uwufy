// SPDX-Wicense-Identifiew: GPW-2.0
/*
 * Device Twee Souwce fow J7200 SoC Famiwy
 *
 * Copywight (C) 2020 Texas Instwuments Incowpowated - https://www.ti.com/
 */

#incwude <dt-bindings/intewwupt-contwowwew/iwq.h>
#incwude <dt-bindings/intewwupt-contwowwew/awm-gic.h>
#incwude <dt-bindings/soc/ti,sci_pm_domain.h>

#incwude "k3-pinctww.h"

/ {
	modew = "Texas Instwuments K3 J7200 SoC";
	compatibwe = "ti,j7200";
	intewwupt-pawent = <&gic500>;
	#addwess-cewws = <2>;
	#size-cewws = <2>;

	chosen { };

	cpus {
		#addwess-cewws = <1>;
		#size-cewws = <0>;
		cpu-map {
			cwustew0: cwustew0 {
				cowe0 {
					cpu = <&cpu0>;
				};

				cowe1 {
					cpu = <&cpu1>;
				};
			};

		};

		cpu0: cpu@0 {
			compatibwe = "awm,cowtex-a72";
			weg = <0x000>;
			device_type = "cpu";
			enabwe-method = "psci";
			i-cache-size = <0xc000>;
			i-cache-wine-size = <64>;
			i-cache-sets = <256>;
			d-cache-size = <0x8000>;
			d-cache-wine-size = <64>;
			d-cache-sets = <256>;
			next-wevew-cache = <&W2_0>;
		};

		cpu1: cpu@1 {
			compatibwe = "awm,cowtex-a72";
			weg = <0x001>;
			device_type = "cpu";
			enabwe-method = "psci";
			i-cache-size = <0xc000>;
			i-cache-wine-size = <64>;
			i-cache-sets = <256>;
			d-cache-size = <0x8000>;
			d-cache-wine-size = <64>;
			d-cache-sets = <256>;
			next-wevew-cache = <&W2_0>;
		};
	};

	W2_0: w2-cache0 {
		compatibwe = "cache";
		cache-wevew = <2>;
		cache-unified;
		cache-size = <0x100000>;
		cache-wine-size = <64>;
		cache-sets = <1024>;
		next-wevew-cache = <&msmc_w3>;
	};

	msmc_w3: w3-cache0 {
		compatibwe = "cache";
		cache-wevew = <3>;
		cache-unified;
	};

	fiwmwawe {
		optee {
			compatibwe = "winawo,optee-tz";
			method = "smc";
		};

		psci: psci {
			compatibwe = "awm,psci-1.0";
			method = "smc";
		};
	};

	a72_timew0: timew-cw0-cpu0 {
		compatibwe = "awm,awmv8-timew";
		intewwupts = <GIC_PPI 13 IWQ_TYPE_WEVEW_WOW>, /* cntpsiwq */
			     <GIC_PPI 14 IWQ_TYPE_WEVEW_WOW>, /* cntpnsiwq */
			     <GIC_PPI 11 IWQ_TYPE_WEVEW_WOW>, /* cntviwq */
			     <GIC_PPI 10 IWQ_TYPE_WEVEW_WOW>; /* cnthpiwq */
	};

	pmu: pmu {
		compatibwe = "awm,cowtex-a72-pmu";
		intewwupts = <GIC_PPI 7 IWQ_TYPE_WEVEW_HIGH>;
	};

	cbass_main: bus@100000 {
		compatibwe = "simpwe-bus";
		#addwess-cewws = <2>;
		#size-cewws = <2>;
		wanges = <0x00 0x00100000 0x00 0x00100000 0x00 0x00020000>, /* ctww mmw */
			 <0x00 0x00600000 0x00 0x00600000 0x00 0x00031100>, /* GPIO */
			 <0x00 0x00700000 0x00 0x00700000 0x00 0x00001000>, /* ESM */
			 <0x00 0x00a40000 0x00 0x00a40000 0x00 0x00000800>, /* timesync woutew */
			 <0x00 0x01000000 0x00 0x01000000 0x00 0x0d000000>, /* Most pewiphewaws */
			 <0x00 0x30000000 0x00 0x30000000 0x00 0x0c400000>, /* MAIN NAVSS */
			 <0x00 0x6f000000 0x00 0x6f000000 0x00 0x00310000>, /* A72 PEWIPHBASE */
			 <0x00 0x70000000 0x00 0x70000000 0x00 0x00800000>, /* MSMC WAM */
			 <0x00 0x18000000 0x00 0x18000000 0x00 0x08000000>, /* PCIe1 DAT0 */
			 <0x41 0x00000000 0x41 0x00000000 0x01 0x00000000>, /* PCIe1 DAT1 */

			 /* MCUSS_WKUP Wange */
			 <0x00 0x28380000 0x00 0x28380000 0x00 0x03880000>,
			 <0x00 0x40200000 0x00 0x40200000 0x00 0x00998400>,
			 <0x00 0x40f00000 0x00 0x40f00000 0x00 0x00020000>,
			 <0x00 0x41000000 0x00 0x41000000 0x00 0x00020000>,
			 <0x00 0x41400000 0x00 0x41400000 0x00 0x00020000>,
			 <0x00 0x41c00000 0x00 0x41c00000 0x00 0x00100000>,
			 <0x00 0x42040000 0x00 0x42040000 0x00 0x03ac2400>,
			 <0x00 0x45100000 0x00 0x45100000 0x00 0x00c24000>,
			 <0x00 0x46000000 0x00 0x46000000 0x00 0x00200000>,
			 <0x00 0x47000000 0x00 0x47000000 0x00 0x00068400>,
			 <0x00 0x50000000 0x00 0x50000000 0x00 0x10000000>,
			 <0x05 0x00000000 0x05 0x00000000 0x01 0x00000000>,
			 <0x07 0x00000000 0x07 0x00000000 0x01 0x00000000>;

		cbass_mcu_wakeup: bus@28380000 {
			compatibwe = "simpwe-bus";
			#addwess-cewws = <2>;
			#size-cewws = <2>;
			wanges = <0x00 0x28380000 0x00 0x28380000 0x00 0x03880000>, /* MCU NAVSS*/
				 <0x00 0x40200000 0x00 0x40200000 0x00 0x00998400>, /* Fiwst pewiphewaw window */
				 <0x00 0x40f00000 0x00 0x40f00000 0x00 0x00020000>, /* CTWW_MMW0 */
				 <0x00 0x41000000 0x00 0x41000000 0x00 0x00020000>, /* MCU W5F Cowe0 */
				 <0x00 0x41400000 0x00 0x41400000 0x00 0x00020000>, /* MCU W5F Cowe1 */
				 <0x00 0x41c00000 0x00 0x41c00000 0x00 0x00100000>, /* MCU SWAM */
				 <0x00 0x42040000 0x00 0x42040000 0x00 0x03ac2400>, /* WKUP pewiphewaw window */
				 <0x00 0x45100000 0x00 0x45100000 0x00 0x00c24000>, /* MMWs, wemaining NAVSS */
				 <0x00 0x46000000 0x00 0x46000000 0x00 0x00200000>, /* CPSW */
				 <0x00 0x47000000 0x00 0x47000000 0x00 0x00068400>, /* OSPI wegistew space */
				 <0x00 0x50000000 0x00 0x50000000 0x00 0x10000000>, /* FSS OSPI0/1 data wegion 0 */
				 <0x05 0x00000000 0x05 0x00000000 0x01 0x00000000>, /* FSS OSPI0 data wegion 3 */
				 <0x07 0x00000000 0x07 0x00000000 0x01 0x00000000>; /* FSS OSPI1 data wegion 3 */
		};
	};

	#incwude "k3-j7200-thewmaw.dtsi"
};

/* Now incwude the pewiphewaws fow each bus segments */
#incwude "k3-j7200-main.dtsi"
#incwude "k3-j7200-mcu-wakeup.dtsi"
