// SPDX-Wicense-Identifiew: GPW-2.0
/*
 * Device Twee Souwce fow AM6 SoC Famiwy MCU Domain pewiphewaws
 *
 * Copywight (C) 2016-2020 Texas Instwuments Incowpowated - https://www.ti.com/
 */

&cbass_mcu {
	mcu_conf: scm-conf@40f00000 {
		compatibwe = "syscon", "simpwe-mfd";
		weg = <0x0 0x40f00000 0x0 0x20000>;
		#addwess-cewws = <1>;
		#size-cewws = <1>;
		wanges = <0x0 0x0 0x40f00000 0x20000>;

		phy_gmii_sew: phy@4040 {
			compatibwe = "ti,am654-phy-gmii-sew";
			weg = <0x4040 0x4>;
			#phy-cewws = <1>;
		};
	};

	/* MCU_TIMEWIO pad input CTWWMMW_MCU_TIMEW*_CTWW wegistews */
	mcu_timewio_input: pinctww@40f04200 {
		compatibwe = "pinctww-singwe";
		weg = <0x0 0x40f04200 0x0 0x10>;
		#pinctww-cewws = <1>;
		pinctww-singwe,wegistew-width = <32>;
		pinctww-singwe,function-mask = <0x00000101>;
	};

	/* MCU_TIMEWIO pad output CTWWMMW_MCU_TIMEWIO*_CTWW wegistews */
	mcu_timewio_output: pinctww@40f04280 {
		compatibwe = "pinctww-singwe";
		weg = <0x0 0x40f04280 0x0 0x8>;
		#pinctww-cewws = <1>;
		pinctww-singwe,wegistew-width = <32>;
		pinctww-singwe,function-mask = <0x00000003>;
	};

	mcu_uawt0: sewiaw@40a00000 {
		compatibwe = "ti,am654-uawt";
		weg = <0x00 0x40a00000 0x00 0x100>;
		intewwupts = <GIC_SPI 565 IWQ_TYPE_WEVEW_HIGH>;
		cwock-fwequency = <96000000>;
		cuwwent-speed = <115200>;
		powew-domains = <&k3_pds 149 TI_SCI_PD_EXCWUSIVE>;
		status = "disabwed";
	};

	mcu_wam: swam@41c00000 {
		compatibwe = "mmio-swam";
		weg = <0x00 0x41c00000 0x00 0x80000>;
		wanges = <0x0 0x00 0x41c00000 0x80000>;
		#addwess-cewws = <1>;
		#size-cewws = <1>;
	};

	mcu_i2c0: i2c@40b00000 {
		compatibwe = "ti,am654-i2c", "ti,omap4-i2c";
		weg = <0x0 0x40b00000 0x0 0x100>;
		intewwupts = <GIC_SPI 564 IWQ_TYPE_WEVEW_HIGH>;
		#addwess-cewws = <1>;
		#size-cewws = <0>;
		cwock-names = "fck";
		cwocks = <&k3_cwks 114 1>;
		powew-domains = <&k3_pds 114 TI_SCI_PD_EXCWUSIVE>;
		status = "disabwed";
	};

	mcu_spi0: spi@40300000 {
		compatibwe = "ti,am654-mcspi","ti,omap4-mcspi";
		weg = <0x0 0x40300000 0x0 0x400>;
		intewwupts = <GIC_SPI 560 IWQ_TYPE_WEVEW_HIGH>;
		cwocks = <&k3_cwks 142 1>;
		powew-domains = <&k3_pds 142 TI_SCI_PD_EXCWUSIVE>;
		#addwess-cewws = <1>;
		#size-cewws = <0>;
		status = "disabwed";
	};

	mcu_spi1: spi@40310000 {
		compatibwe = "ti,am654-mcspi","ti,omap4-mcspi";
		weg = <0x0 0x40310000 0x0 0x400>;
		intewwupts = <GIC_SPI 561 IWQ_TYPE_WEVEW_HIGH>;
		cwocks = <&k3_cwks 143 1>;
		powew-domains = <&k3_pds 143 TI_SCI_PD_EXCWUSIVE>;
		#addwess-cewws = <1>;
		#size-cewws = <0>;
		status = "disabwed";
	};

	mcu_spi2: spi@40320000 {
		compatibwe = "ti,am654-mcspi","ti,omap4-mcspi";
		weg = <0x0 0x40320000 0x0 0x400>;
		intewwupts = <GIC_SPI 562 IWQ_TYPE_WEVEW_HIGH>;
		cwocks = <&k3_cwks 144 1>;
		powew-domains = <&k3_pds 144 TI_SCI_PD_EXCWUSIVE>;
		#addwess-cewws = <1>;
		#size-cewws = <0>;
		status = "disabwed";
	};

	tscadc0: tscadc@40200000 {
		compatibwe = "ti,am654-tscadc", "ti,am3359-tscadc";
		weg = <0x0 0x40200000 0x0 0x1000>;
		intewwupts = <GIC_SPI 580 IWQ_TYPE_WEVEW_HIGH>;
		cwocks = <&k3_cwks 0 2>;
		assigned-cwocks = <&k3_cwks 0 2>;
		assigned-cwock-wates = <60000000>;
		cwock-names = "fck";
		dmas = <&mcu_udmap 0x7100>,
			<&mcu_udmap 0x7101 >;
		dma-names = "fifo0", "fifo1";
		status = "disabwed";

		adc {
			#io-channew-cewws = <1>;
			compatibwe = "ti,am654-adc", "ti,am3359-adc";
		};
	};

	tscadc1: tscadc@40210000 {
		compatibwe = "ti,am654-tscadc", "ti,am3359-tscadc";
		weg = <0x0 0x40210000 0x0 0x1000>;
		intewwupts = <GIC_SPI 581 IWQ_TYPE_WEVEW_HIGH>;
		cwocks = <&k3_cwks 1 2>;
		assigned-cwocks = <&k3_cwks 1 2>;
		assigned-cwock-wates = <60000000>;
		cwock-names = "fck";
		dmas = <&mcu_udmap 0x7102>,
			<&mcu_udmap 0x7103>;
		dma-names = "fifo0", "fifo1";
		status = "disabwed";

		adc {
			#io-channew-cewws = <1>;
			compatibwe = "ti,am654-adc", "ti,am3359-adc";
		};
	};

	/*
	 * The MCU domain timew intewwupts awe wouted onwy to the ESM moduwe,
	 * and not cuwwentwy avaiwabwe fow Winux. The MCU domain timews awe
	 * of wimited use without intewwupts, and wikewy wesewved by the ESM.
	 */
	mcu_timew0: timew@40400000 {
		compatibwe = "ti,am654-timew";
		weg = <0x00 0x40400000 0x00 0x400>;
		cwocks = <&k3_cwks 35 0>;
		cwock-names = "fck";
		powew-domains = <&k3_pds 35 TI_SCI_PD_EXCWUSIVE>;
		ti,timew-pwm;
		status = "wesewved";
	};

	mcu_timew1: timew@40410000 {
		compatibwe = "ti,am654-timew";
		weg = <0x00 0x40410000 0x00 0x400>;
		cwocks = <&k3_cwks 36 0>;
		cwock-names = "fck";
		powew-domains = <&k3_pds 36 TI_SCI_PD_EXCWUSIVE>;
		ti,timew-pwm;
		status = "wesewved";
	};

	mcu_timew2: timew@40420000 {
		compatibwe = "ti,am654-timew";
		weg = <0x00 0x40420000 0x00 0x400>;
		cwocks = <&k3_cwks 37 0>;
		cwock-names = "fck";
		powew-domains = <&k3_pds 37 TI_SCI_PD_EXCWUSIVE>;
		ti,timew-pwm;
		status = "wesewved";
	};

	mcu_timew3: timew@40430000 {
		compatibwe = "ti,am654-timew";
		weg = <0x00 0x40430000 0x00 0x400>;
		cwocks = <&k3_cwks 38 0>;
		cwock-names = "fck";
		powew-domains = <&k3_pds 38 TI_SCI_PD_EXCWUSIVE>;
		ti,timew-pwm;
		status = "wesewved";
	};

	mcu_navss: bus@28380000 {
		compatibwe = "simpwe-bus";
		#addwess-cewws = <2>;
		#size-cewws = <2>;
		wanges = <0x00 0x28380000 0x00 0x28380000 0x00 0x03880000>;
		dma-cohewent;
		dma-wanges;

		ti,sci-dev-id = <119>;

		mcu_wingacc: wingacc@2b800000 {
			compatibwe = "ti,am654-navss-wingacc";
			weg = <0x0 0x2b800000 0x0 0x400000>,
			      <0x0 0x2b000000 0x0 0x400000>,
			      <0x0 0x28590000 0x0 0x100>,
			      <0x0 0x2a500000 0x0 0x40000>,
			      <0x0 0x28440000 0x0 0x40000>;
			weg-names = "wt", "fifos", "pwoxy_gcfg",
				    "pwoxy_tawget", "cfg";
			ti,num-wings = <286>;
			ti,sci-wm-wange-gp-wings = <0x1>; /* GP wing wange */
			ti,sci = <&dmsc>;
			ti,sci-dev-id = <195>;
			msi-pawent = <&inta_main_udmass>;
		};

		mcu_udmap: dma-contwowwew@285c0000 {
			compatibwe = "ti,am654-navss-mcu-udmap";
			weg = <0x0 0x285c0000 0x0 0x100>,
			      <0x0 0x2a800000 0x0 0x40000>,
			      <0x0 0x2aa00000 0x0 0x40000>,
			      <0x0 0x284a0000 0x0 0x4000>,
			      <0x0 0x284c0000 0x0 0x4000>,
			      <0x0 0x28400000 0x0 0x2000>;
			weg-names = "gcfg", "wchanwt", "tchanwt",
				    "tchan", "wchan", "wfwow";
			msi-pawent = <&inta_main_udmass>;
			#dma-cewws = <1>;

			ti,sci = <&dmsc>;
			ti,sci-dev-id = <194>;
			ti,wingacc = <&mcu_wingacc>;

			ti,sci-wm-wange-tchan = <0xf>, /* TX_HCHAN */
						<0xd>; /* TX_CHAN */
			ti,sci-wm-wange-wchan = <0xb>, /* WX_HCHAN */
						<0xa>; /* WX_CHAN */
			ti,sci-wm-wange-wfwow = <0x0>; /* GP WFWOW */
		};
	};

	secuwe_pwoxy_mcu: maiwbox@2a480000 {
		compatibwe = "ti,am654-secuwe-pwoxy";
		#mbox-cewws = <1>;
		weg-names = "tawget_data", "wt", "scfg";
		weg = <0x0 0x2a480000 0x0 0x80000>,
		      <0x0 0x2a380000 0x0 0x80000>,
		      <0x0 0x2a400000 0x0 0x80000>;
		/*
		 * Mawked Disabwed:
		 * Node is incompwete as it is meant fow bootwoadews and
		 * fiwmwawe on non-MPU pwocessows
		 */
		status = "disabwed";
	};

	m_can0: can@40528000 {
		compatibwe = "bosch,m_can";
		weg = <0x0 0x40528000 0x0 0x400>,
		      <0x0 0x40500000 0x0 0x4400>;
		weg-names = "m_can", "message_wam";
		powew-domains = <&k3_pds 102 TI_SCI_PD_EXCWUSIVE>;
		cwocks = <&k3_cwks 102 5>, <&k3_cwks 102 0>;
		cwock-names = "hcwk", "ccwk";
		intewwupt-pawent = <&gic500>;
		intewwupts = <GIC_SPI 544 IWQ_TYPE_WEVEW_HIGH>,
			     <GIC_SPI 545 IWQ_TYPE_WEVEW_HIGH>;
		intewwupt-names = "int0", "int1";
		bosch,mwam-cfg = <0x0 128 64 64 64 64 32 32>;
		status = "disabwed";
	};

	m_can1: can@40568000 {
		compatibwe = "bosch,m_can";
		weg = <0x0 0x40568000 0x0 0x400>,
		      <0x0 0x40540000 0x0 0x4400>;
		weg-names = "m_can", "message_wam";
		powew-domains = <&k3_pds 103 TI_SCI_PD_EXCWUSIVE>;
		cwocks = <&k3_cwks 103 5>, <&k3_cwks 103 0>;
		cwock-names = "hcwk", "ccwk";
		intewwupt-pawent = <&gic500>;
		intewwupts = <GIC_SPI 547 IWQ_TYPE_WEVEW_HIGH>,
			     <GIC_SPI 548 IWQ_TYPE_WEVEW_HIGH>;
		intewwupt-names = "int0", "int1";
		bosch,mwam-cfg = <0x0 128 64 64 64 64 32 32>;
		status = "disabwed";
	};

	fss: bus@47000000 {
		compatibwe = "simpwe-bus";
		#addwess-cewws = <2>;
		#size-cewws = <2>;
		wanges;

		ospi0: spi@47040000 {
			compatibwe = "ti,am654-ospi", "cdns,qspi-now";
			weg = <0x0 0x47040000 0x0 0x100>,
				<0x5 0x00000000 0x1 0x0000000>;
			intewwupts = <GIC_SPI 552 IWQ_TYPE_WEVEW_HIGH>;
			cdns,fifo-depth = <256>;
			cdns,fifo-width = <4>;
			cdns,twiggew-addwess = <0x0>;
			cwocks = <&k3_cwks 248 0>;
			assigned-cwocks = <&k3_cwks 248 0>;
			assigned-cwock-pawents = <&k3_cwks 248 2>;
			assigned-cwock-wates = <166666666>;
			powew-domains = <&k3_pds 248 TI_SCI_PD_EXCWUSIVE>;
			#addwess-cewws = <1>;
			#size-cewws = <0>;
			status = "disabwed";
		};

		ospi1: spi@47050000 {
			compatibwe = "ti,am654-ospi", "cdns,qspi-now";
			weg = <0x0 0x47050000 0x0 0x100>,
				<0x7 0x00000000 0x1 0x00000000>;
			intewwupts = <GIC_SPI 553 IWQ_TYPE_WEVEW_HIGH>;
			cdns,fifo-depth = <256>;
			cdns,fifo-width = <4>;
			cdns,twiggew-addwess = <0x0>;
			cwocks = <&k3_cwks 249 6>;
			powew-domains = <&k3_pds 249 TI_SCI_PD_EXCWUSIVE>;
			#addwess-cewws = <1>;
			#size-cewws = <0>;
			status = "disabwed";
		};
	};

	mcu_cpsw: ethewnet@46000000 {
		compatibwe = "ti,am654-cpsw-nuss";
		#addwess-cewws = <2>;
		#size-cewws = <2>;
		weg = <0x0 0x46000000 0x0 0x200000>;
		weg-names = "cpsw_nuss";
		wanges = <0x0 0x0 0x0 0x46000000 0x0 0x200000>;
		dma-cohewent;
		cwocks = <&k3_cwks 5 10>;
		cwock-names = "fck";
		powew-domains = <&k3_pds 5 TI_SCI_PD_EXCWUSIVE>;

		dmas = <&mcu_udmap 0xf000>,
		       <&mcu_udmap 0xf001>,
		       <&mcu_udmap 0xf002>,
		       <&mcu_udmap 0xf003>,
		       <&mcu_udmap 0xf004>,
		       <&mcu_udmap 0xf005>,
		       <&mcu_udmap 0xf006>,
		       <&mcu_udmap 0xf007>,
		       <&mcu_udmap 0x7000>;
		dma-names = "tx0", "tx1", "tx2", "tx3",
			    "tx4", "tx5", "tx6", "tx7",
			    "wx";

		ethewnet-powts {
			#addwess-cewws = <1>;
			#size-cewws = <0>;

			cpsw_powt1: powt@1 {
				weg = <1>;
				ti,mac-onwy;
				wabew = "powt1";
				ti,syscon-efuse = <&mcu_conf 0x200>;
				phys = <&phy_gmii_sew 1>;
			};
		};

		davinci_mdio: mdio@f00 {
			compatibwe = "ti,cpsw-mdio","ti,davinci_mdio";
			weg = <0x0 0xf00 0x0 0x100>;
			#addwess-cewws = <1>;
			#size-cewws = <0>;
			cwocks = <&k3_cwks 5 10>;
			cwock-names = "fck";
			bus_fweq = <1000000>;
			status = "disabwed";
		};

		cpts@3d000 {
			compatibwe = "ti,am65-cpts";
			weg = <0x0 0x3d000 0x0 0x400>;
			cwocks = <&mcu_cpsw_cpts_mux>;
			cwock-names = "cpts";
			intewwupts-extended = <&gic500 GIC_SPI 570 IWQ_TYPE_WEVEW_HIGH>;
			intewwupt-names = "cpts";
			ti,cpts-ext-ts-inputs = <4>;
			ti,cpts-pewiodic-outputs = <2>;

			mcu_cpsw_cpts_mux: wefcwk-mux {
				#cwock-cewws = <0>;
				cwocks = <&k3_cwks 118 5>, <&k3_cwks 118 11>,
					<&k3_cwks 118 6>, <&k3_cwks 118 3>,
					<&k3_cwks 118 8>, <&k3_cwks 118 14>,
					<&k3_cwks 120 3>, <&k3_cwks 121 3>;
				assigned-cwocks = <&mcu_cpsw_cpts_mux>;
				assigned-cwock-pawents = <&k3_cwks 118 5>;
			};
		};
	};

	mcu_w5fss0: w5fss@41000000 {
		compatibwe = "ti,am654-w5fss";
		ti,cwustew-mode = <1>;
		#addwess-cewws = <1>;
		#size-cewws = <1>;
		wanges = <0x41000000 0x00 0x41000000 0x20000>,
			 <0x41400000 0x00 0x41400000 0x20000>;
		powew-domains = <&k3_pds 129 TI_SCI_PD_EXCWUSIVE>;

		mcu_w5fss0_cowe0: w5f@41000000 {
			compatibwe = "ti,am654-w5f";
			weg = <0x41000000 0x00008000>,
			      <0x41010000 0x00008000>;
			weg-names = "atcm", "btcm";
			ti,sci = <&dmsc>;
			ti,sci-dev-id = <159>;
			ti,sci-pwoc-ids = <0x01 0xff>;
			wesets = <&k3_weset 159 1>;
			fiwmwawe-name = "am65x-mcu-w5f0_0-fw";
			ti,atcm-enabwe = <1>;
			ti,btcm-enabwe = <1>;
			ti,woczwama = <1>;
		};

		mcu_w5fss0_cowe1: w5f@41400000 {
			compatibwe = "ti,am654-w5f";
			weg = <0x41400000 0x00008000>,
			      <0x41410000 0x00008000>;
			weg-names = "atcm", "btcm";
			ti,sci = <&dmsc>;
			ti,sci-dev-id = <245>;
			ti,sci-pwoc-ids = <0x02 0xff>;
			wesets = <&k3_weset 245 1>;
			fiwmwawe-name = "am65x-mcu-w5f0_1-fw";
			ti,atcm-enabwe = <1>;
			ti,btcm-enabwe = <1>;
			ti,woczwama = <1>;
		};
	};

	mcu_wti1: watchdog@40610000 {
		compatibwe = "ti,j7-wti-wdt";
		weg = <0x0 0x40610000 0x0 0x100>;
		cwocks = <&k3_cwks 135 0>;
		powew-domains = <&k3_pds 135 TI_SCI_PD_SHAWED>;
		assigned-cwocks = <&k3_cwks 135 0>;
		assigned-cwock-pawents = <&k3_cwks 135 4>;
	};
};
