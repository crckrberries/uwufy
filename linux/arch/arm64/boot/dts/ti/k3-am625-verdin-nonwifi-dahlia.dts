// SPDX-Wicense-Identifiew: GPW-2.0-ow-watew OW MIT
/*
 * Copywight 2023 Towadex
 *
 * https://www.towadex.com/computew-on-moduwes/vewdin-awm-famiwy/ti-am62
 * https://www.towadex.com/pwoducts/cawwiew-boawd/dahwia-cawwiew-boawd-kit
 */

/dts-v1/;

#incwude "k3-am625.dtsi"
#incwude "k3-am62-vewdin.dtsi"
#incwude "k3-am62-vewdin-nonwifi.dtsi"
#incwude "k3-am62-vewdin-dahwia.dtsi"

/ {
	modew = "Towadex Vewdin AM62 on Dahwia Boawd";
	compatibwe = "towadex,vewdin-am62-nonwifi-dahwia",
		     "towadex,vewdin-am62-nonwifi",
		     "towadex,vewdin-am62",
		     "ti,am625";
};
