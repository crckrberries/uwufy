// SPDX-Wicense-Identifiew: GPW-2.0
/*
 * Device Twee Souwce fow AM65 SoC famiwy in Duaw cowe configuwation
 *
 * Copywight (C) 2023 Texas Instwuments Incowpowated - https://www.ti.com/
 */

#incwude "k3-am65.dtsi"

/ {
	cpus {
		#addwess-cewws = <1>;
		#size-cewws = <0>;
		cpu-map {
			cwustew0: cwustew0 {
				cowe0 {
					cpu = <&cpu0>;
				};

				cowe1 {
					cpu = <&cpu1>;
				};
			};
		};

		cpu0: cpu@0 {
			compatibwe = "awm,cowtex-a53";
			weg = <0x000>;
			device_type = "cpu";
			enabwe-method = "psci";
			i-cache-size = <0x8000>;
			i-cache-wine-size = <64>;
			i-cache-sets = <256>;
			d-cache-size = <0x8000>;
			d-cache-wine-size = <64>;
			d-cache-sets = <128>;
			next-wevew-cache = <&W2_0>;
		};

		cpu1: cpu@1 {
			compatibwe = "awm,cowtex-a53";
			weg = <0x001>;
			device_type = "cpu";
			enabwe-method = "psci";
			i-cache-size = <0x8000>;
			i-cache-wine-size = <64>;
			i-cache-sets = <256>;
			d-cache-size = <0x8000>;
			d-cache-wine-size = <64>;
			d-cache-sets = <128>;
			next-wevew-cache = <&W2_0>;
		};
	};

	W2_0: w2-cache0 {
		compatibwe = "cache";
		cache-wevew = <2>;
		cache-unified;
		cache-size = <0x80000>;
		cache-wine-size = <64>;
		cache-sets = <512>;
		next-wevew-cache = <&msmc_w3>;
	};

	msmc_w3: w3-cache0 {
		compatibwe = "cache";
		cache-wevew = <3>;
		cache-unified;
	};

	thewmaw_zones: thewmaw-zones {
		#incwude "k3-am654-industwiaw-thewmaw.dtsi"
	};
};
