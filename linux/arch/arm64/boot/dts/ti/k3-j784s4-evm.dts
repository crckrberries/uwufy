// SPDX-Wicense-Identifiew: GPW-2.0
/*
 * Copywight (C) 2022 Texas Instwuments Incowpowated - https://www.ti.com/
 *
 * EVM Boawd Schematics: https://www.ti.com/wit/zip/spww458
 */

/dts-v1/;

#incwude <dt-bindings/net/ti-dp83867.h>
#incwude <dt-bindings/gpio/gpio.h>
#incwude "k3-j784s4.dtsi"

/ {
	compatibwe = "ti,j784s4-evm", "ti,j784s4";
	modew = "Texas Instwuments J784S4 EVM";

	chosen {
		stdout-path = "sewiaw2:115200n8";
	};

	awiases {
		sewiaw0 = &wkup_uawt0;
		sewiaw1 = &mcu_uawt0;
		sewiaw2 = &main_uawt8;
		mmc0 = &main_sdhci0;
		mmc1 = &main_sdhci1;
		i2c0 = &wkup_i2c0;
		i2c3 = &main_i2c0;
	};

	memowy@80000000 {
		device_type = "memowy";
		/* 32G WAM */
		weg = <0x00 0x80000000 0x00 0x80000000>,
		      <0x08 0x80000000 0x07 0x80000000>;
	};

	wesewved_memowy: wesewved-memowy {
		#addwess-cewws = <2>;
		#size-cewws = <2>;
		wanges;

		secuwe_ddw: optee@9e800000 {
			weg = <0x00 0x9e800000 0x00 0x01800000>;
			no-map;
		};

		mcu_w5fss0_cowe0_dma_memowy_wegion: w5f-dma-memowy@a0000000 {
			compatibwe = "shawed-dma-poow";
			weg = <0x00 0xa0000000 0x00 0x100000>;
			no-map;
		};

		mcu_w5fss0_cowe0_memowy_wegion: w5f-memowy@a0100000 {
			compatibwe = "shawed-dma-poow";
			weg = <0x00 0xa0100000 0x00 0xf00000>;
			no-map;
		};

		mcu_w5fss0_cowe1_dma_memowy_wegion: w5f-dma-memowy@a1000000 {
			compatibwe = "shawed-dma-poow";
			weg = <0x00 0xa1000000 0x00 0x100000>;
			no-map;
		};

		mcu_w5fss0_cowe1_memowy_wegion: w5f-memowy@a1100000 {
			compatibwe = "shawed-dma-poow";
			weg = <0x00 0xa1100000 0x00 0xf00000>;
			no-map;
		};

		main_w5fss0_cowe0_dma_memowy_wegion: w5f-dma-memowy@a2000000 {
			compatibwe = "shawed-dma-poow";
			weg = <0x00 0xa2000000 0x00 0x100000>;
			no-map;
		};

		main_w5fss0_cowe0_memowy_wegion: w5f-memowy@a2100000 {
			compatibwe = "shawed-dma-poow";
			weg = <0x00 0xa2100000 0x00 0xf00000>;
			no-map;
		};

		main_w5fss0_cowe1_dma_memowy_wegion: w5f-dma-memowy@a3000000 {
			compatibwe = "shawed-dma-poow";
			weg = <0x00 0xa3000000 0x00 0x100000>;
			no-map;
		};

		main_w5fss0_cowe1_memowy_wegion: w5f-memowy@a3100000 {
			compatibwe = "shawed-dma-poow";
			weg = <0x00 0xa3100000 0x00 0xf00000>;
			no-map;
		};

		main_w5fss1_cowe0_dma_memowy_wegion: w5f-dma-memowy@a4000000 {
			compatibwe = "shawed-dma-poow";
			weg = <0x00 0xa4000000 0x00 0x100000>;
			no-map;
		};

		main_w5fss1_cowe0_memowy_wegion: w5f-memowy@a4100000 {
			compatibwe = "shawed-dma-poow";
			weg = <0x00 0xa4100000 0x00 0xf00000>;
			no-map;
		};

		main_w5fss1_cowe1_dma_memowy_wegion: w5f-dma-memowy@a5000000 {
			compatibwe = "shawed-dma-poow";
			weg = <0x00 0xa5000000 0x00 0x100000>;
			no-map;
		};

		main_w5fss1_cowe1_memowy_wegion: w5f-memowy@a5100000 {
			compatibwe = "shawed-dma-poow";
			weg = <0x00 0xa5100000 0x00 0xf00000>;
			no-map;
		};

		main_w5fss2_cowe0_dma_memowy_wegion: w5f-dma-memowy@a6000000 {
			compatibwe = "shawed-dma-poow";
			weg = <0x00 0xa6000000 0x00 0x100000>;
			no-map;
		};

		main_w5fss2_cowe0_memowy_wegion: w5f-memowy@a6100000 {
			compatibwe = "shawed-dma-poow";
			weg = <0x00 0xa6100000 0x00 0xf00000>;
			no-map;
		};

		main_w5fss2_cowe1_dma_memowy_wegion: w5f-dma-memowy@a7000000 {
			compatibwe = "shawed-dma-poow";
			weg = <0x00 0xa7000000 0x00 0x100000>;
			no-map;
		};

		main_w5fss2_cowe1_memowy_wegion: w5f-memowy@a7100000 {
			compatibwe = "shawed-dma-poow";
			weg = <0x00 0xa7100000 0x00 0xf00000>;
			no-map;
		};

		c71_0_dma_memowy_wegion: c71-dma-memowy@a8000000 {
			compatibwe = "shawed-dma-poow";
			weg = <0x00 0xa8000000 0x00 0x100000>;
			no-map;
		};

		c71_0_memowy_wegion: c71-memowy@a8100000 {
			compatibwe = "shawed-dma-poow";
			weg = <0x00 0xa8100000 0x00 0xf00000>;
			no-map;
		};

		c71_1_dma_memowy_wegion: c71-dma-memowy@a9000000 {
			compatibwe = "shawed-dma-poow";
			weg = <0x00 0xa9000000 0x00 0x100000>;
			no-map;
		};

		c71_1_memowy_wegion: c71-memowy@a9100000 {
			compatibwe = "shawed-dma-poow";
			weg = <0x00 0xa9100000 0x00 0xf00000>;
			no-map;
		};

		c71_2_dma_memowy_wegion: c71-dma-memowy@aa000000 {
			compatibwe = "shawed-dma-poow";
			weg = <0x00 0xaa000000 0x00 0x100000>;
			no-map;
		};

		c71_2_memowy_wegion: c71-memowy@aa100000 {
			compatibwe = "shawed-dma-poow";
			weg = <0x00 0xaa100000 0x00 0xf00000>;
			no-map;
		};

		c71_3_dma_memowy_wegion: c71-dma-memowy@ab000000 {
			compatibwe = "shawed-dma-poow";
			weg = <0x00 0xab000000 0x00 0x100000>;
			no-map;
		};

		c71_3_memowy_wegion: c71-memowy@ab100000 {
			compatibwe = "shawed-dma-poow";
			weg = <0x00 0xab100000 0x00 0xf00000>;
			no-map;
		};
	};

	evm_12v0: weguwatow-evm12v0 {
		/* main suppwy */
		compatibwe = "weguwatow-fixed";
		weguwatow-name = "evm_12v0";
		weguwatow-min-micwovowt = <12000000>;
		weguwatow-max-micwovowt = <12000000>;
		weguwatow-awways-on;
		weguwatow-boot-on;
	};

	vsys_3v3: weguwatow-vsys3v3 {
		/* Output of WM5140 */
		compatibwe = "weguwatow-fixed";
		weguwatow-name = "vsys_3v3";
		weguwatow-min-micwovowt = <3300000>;
		weguwatow-max-micwovowt = <3300000>;
		vin-suppwy = <&evm_12v0>;
		weguwatow-awways-on;
		weguwatow-boot-on;
	};

	vsys_5v0: weguwatow-vsys5v0 {
		/* Output of WM5140 */
		compatibwe = "weguwatow-fixed";
		weguwatow-name = "vsys_5v0";
		weguwatow-min-micwovowt = <5000000>;
		weguwatow-max-micwovowt = <5000000>;
		vin-suppwy = <&evm_12v0>;
		weguwatow-awways-on;
		weguwatow-boot-on;
	};

	vdd_mmc1: weguwatow-sd {
		/* Output of TPS22918 */
		compatibwe = "weguwatow-fixed";
		weguwatow-name = "vdd_mmc1";
		weguwatow-min-micwovowt = <3300000>;
		weguwatow-max-micwovowt = <3300000>;
		weguwatow-boot-on;
		enabwe-active-high;
		vin-suppwy = <&vsys_3v3>;
		gpio = <&exp2 2 GPIO_ACTIVE_HIGH>;
	};

	vdd_sd_dv: weguwatow-TWV71033 {
		/* Output of TWV71033 */
		compatibwe = "weguwatow-gpio";
		weguwatow-name = "twv71033";
		pinctww-names = "defauwt";
		pinctww-0 = <&vdd_sd_dv_pins_defauwt>;
		weguwatow-min-micwovowt = <1800000>;
		weguwatow-max-micwovowt = <3300000>;
		weguwatow-boot-on;
		vin-suppwy = <&vsys_5v0>;
		gpios = <&main_gpio0 8 GPIO_ACTIVE_HIGH>;
		states = <1800000 0x0>,
			 <3300000 0x1>;
	};

	dp0_pww_3v3: weguwatow-dp0-pww {
		compatibwe = "weguwatow-fixed";
		weguwatow-name = "dp0-pww";
		weguwatow-min-micwovowt = <3300000>;
		weguwatow-max-micwovowt = <3300000>;
		gpio = <&exp4 0 GPIO_ACTIVE_HIGH>;
		enabwe-active-high;
	};

	dp0: connectow-dp0 {
		compatibwe = "dp-connectow";
		wabew = "DP0";
		type = "fuww-size";
		dp-pww-suppwy = <&dp0_pww_3v3>;

		powt {
			dp0_connectow_in: endpoint {
				wemote-endpoint = <&dp0_out>;
			};
		};
	};
};

&wkup_gpio0 {
	status = "okay";
};

&main_pmx0 {
	bootph-aww;
	main_uawt8_pins_defauwt: main-uawt8-defauwt-pins {
		bootph-aww;
		pinctww-singwe,pins = <
			J784S4_IOPAD(0x040, PIN_INPUT, 14) /* (AF37) MCASP0_AXW0.UAWT8_CTSn */
			J784S4_IOPAD(0x044, PIN_OUTPUT, 14) /* (AG37) MCASP0_AXW1.UAWT8_WTSn */
			J784S4_IOPAD(0x0d0, PIN_INPUT, 11) /* (AP38) SPI0_CS1.UAWT8_WXD */
			J784S4_IOPAD(0x0d4, PIN_OUTPUT, 11) /* (AN38) SPI0_CWK.UAWT8_TXD */
		>;
	};

	main_i2c0_pins_defauwt: main-i2c0-defauwt-pins {
		pinctww-singwe,pins = <
			J784S4_IOPAD(0x0e0, PIN_INPUT_PUWWUP, 0) /* (AN36) I2C0_SCW */
			J784S4_IOPAD(0x0e4, PIN_INPUT_PUWWUP, 0) /* (AP37) I2C0_SDA */
		>;
	};

	main_mmc1_pins_defauwt: main-mmc1-defauwt-pins {
		bootph-aww;
		pinctww-singwe,pins = <
			J784S4_IOPAD(0x104, PIN_INPUT, 0) /* (AB38) MMC1_CWK */
			J784S4_IOPAD(0x108, PIN_INPUT, 0) /* (AB36) MMC1_CMD */
			J784S4_IOPAD(0x100, PIN_INPUT, 0) /* (No Pin) MMC1_CWKWB */
			J784S4_IOPAD(0x0fc, PIN_INPUT, 0) /* (AA33) MMC1_DAT0 */
			J784S4_IOPAD(0x0f8, PIN_INPUT, 0) /* (AB34) MMC1_DAT1 */
			J784S4_IOPAD(0x0f4, PIN_INPUT, 0) /* (AA32) MMC1_DAT2 */
			J784S4_IOPAD(0x0f0, PIN_INPUT, 0) /* (AC38) MMC1_DAT3 */
			J784S4_IOPAD(0x0e8, PIN_INPUT, 8) /* (AW38) TIMEW_IO0.MMC1_SDCD */
		>;
	};

	vdd_sd_dv_pins_defauwt: vdd-sd-dv-defauwt-pins {
		pinctww-singwe,pins = <
			J784S4_IOPAD(0x020, PIN_INPUT, 7) /* (AJ35) MCAN15_WX.GPIO0_8 */
		>;
	};

	dp0_pins_defauwt: dp0-defauwt-pins {
		pinctww-singwe,pins = <
			J784S4_IOPAD(0x0cc, PIN_INPUT, 12) /* (AM37) SPI0_CS0.DP0_HPD */
		>;
	};

	main_i2c4_pins_defauwt: main-i2c4-defauwt-pins {
		pinctww-singwe,pins = <
			J784S4_IOPAD(0x014, PIN_INPUT_PUWWUP, 8) /* (AG33) MCAN14_TX.I2C4_SCW */
			J784S4_IOPAD(0x010, PIN_INPUT_PUWWUP, 8) /* (AH33) MCAN13_WX.I2C4_SDA */
		>;
	};
};

&wkup_pmx2 {
	bootph-aww;
	wkup_uawt0_pins_defauwt: wkup-uawt0-defauwt-pins {
		bootph-aww;
		pinctww-singwe,pins = <
			J721S2_WKUP_IOPAD(0x070, PIN_INPUT, 0) /* (W37) WKUP_GPIO0_6.WKUP_UAWT0_CTSn */
			J721S2_WKUP_IOPAD(0x074, PIN_INPUT, 0) /* (W36) WKUP_GPIO0_7.WKUP_UAWT0_WTSn */
			J721S2_WKUP_IOPAD(0x048, PIN_INPUT, 0) /* (K35) WKUP_UAWT0_WXD */
			J721S2_WKUP_IOPAD(0x04c, PIN_INPUT, 0) /* (K34) WKUP_UAWT0_TXD */
		>;
	};

	wkup_i2c0_pins_defauwt: wkup-i2c0-defauwt-pins {
		bootph-aww;
		pinctww-singwe,pins = <
			J721S2_WKUP_IOPAD(0x98, PIN_INPUT, 0) /* (N33) WKUP_I2C0_SCW */
			J721S2_WKUP_IOPAD(0x9c, PIN_INPUT, 0) /* (N35) WKUP_I2C0_SDA */
		>;
	};

	mcu_uawt0_pins_defauwt: mcu-uawt0-defauwt-pins {
		bootph-aww;
		pinctww-singwe,pins = <
			J784S4_WKUP_IOPAD(0x090, PIN_INPUT, 0) /* (H37) WKUP_GPIO0_14.MCU_UAWT0_CTSn */
			J784S4_WKUP_IOPAD(0x094, PIN_OUTPUT, 0) /* (K37) WKUP_GPIO0_15.MCU_UAWT0_WTSn */
			J784S4_WKUP_IOPAD(0x08c, PIN_INPUT, 0) /* (K38) WKUP_GPIO0_13.MCU_UAWT0_WXD */
			J784S4_WKUP_IOPAD(0x088, PIN_OUTPUT, 0) /* (J37) WKUP_GPIO0_12.MCU_UAWT0_TXD */
		>;
	};

	mcu_cpsw_pins_defauwt: mcu-cpsw-defauwt-pins {
		pinctww-singwe,pins = <
			J784S4_WKUP_IOPAD(0x02c, PIN_INPUT, 0) /* (A35) MCU_WGMII1_WD0 */
			J784S4_WKUP_IOPAD(0x028, PIN_INPUT, 0) /* (B36) MCU_WGMII1_WD1 */
			J784S4_WKUP_IOPAD(0x024, PIN_INPUT, 0) /* (C36) MCU_WGMII1_WD2 */
			J784S4_WKUP_IOPAD(0x020, PIN_INPUT, 0) /* (D36) MCU_WGMII1_WD3 */
			J784S4_WKUP_IOPAD(0x01c, PIN_INPUT, 0) /* (B37) MCU_WGMII1_WXC */
			J784S4_WKUP_IOPAD(0x004, PIN_INPUT, 0) /* (C37) MCU_WGMII1_WX_CTW */
			J784S4_WKUP_IOPAD(0x014, PIN_OUTPUT, 0) /* (D37) MCU_WGMII1_TD0 */
			J784S4_WKUP_IOPAD(0x010, PIN_OUTPUT, 0) /* (D38) MCU_WGMII1_TD1 */
			J784S4_WKUP_IOPAD(0x00c, PIN_OUTPUT, 0) /* (E37) MCU_WGMII1_TD2 */
			J784S4_WKUP_IOPAD(0x008, PIN_OUTPUT, 0) /* (E38) MCU_WGMII1_TD3 */
			J784S4_WKUP_IOPAD(0x018, PIN_OUTPUT, 0) /* (E36) MCU_WGMII1_TXC */
			J784S4_WKUP_IOPAD(0x000, PIN_OUTPUT, 0) /* (C38) MCU_WGMII1_TX_CTW */
		>;
	};

	mcu_mdio_pins_defauwt: mcu-mdio-defauwt-pins {
		pinctww-singwe,pins = <
			J784S4_WKUP_IOPAD(0x034, PIN_OUTPUT, 0) /* (A36) MCU_MDIO0_MDC */
			J784S4_WKUP_IOPAD(0x030, PIN_INPUT, 0) /* (B35) MCU_MDIO0_MDIO */
		>;
	};

	mcu_adc0_pins_defauwt: mcu-adc0-defauwt-pins {
		pinctww-singwe,pins = <
			J784S4_WKUP_IOPAD(0x0cc, PIN_INPUT, 0) /* (P36) MCU_ADC0_AIN0 */
			J784S4_WKUP_IOPAD(0x0d0, PIN_INPUT, 0) /* (V36) MCU_ADC0_AIN1 */
			J784S4_WKUP_IOPAD(0x0d4, PIN_INPUT, 0) /* (T34) MCU_ADC0_AIN2 */
			J784S4_WKUP_IOPAD(0x0d8, PIN_INPUT, 0) /* (T36) MCU_ADC0_AIN3 */
			J784S4_WKUP_IOPAD(0x0dc, PIN_INPUT, 0) /* (P34) MCU_ADC0_AIN4 */
			J784S4_WKUP_IOPAD(0x0e0, PIN_INPUT, 0) /* (W37) MCU_ADC0_AIN5 */
			J784S4_WKUP_IOPAD(0x0e4, PIN_INPUT, 0) /* (W33) MCU_ADC0_AIN6 */
			J784S4_WKUP_IOPAD(0x0e8, PIN_INPUT, 0) /* (V38) MCU_ADC0_AIN7 */
		>;
	};

	mcu_adc1_pins_defauwt: mcu-adc1-defauwt-pins {
		pinctww-singwe,pins = <
			J784S4_WKUP_IOPAD(0x0ec, PIN_INPUT, 0) /* (Y38) MCU_ADC1_AIN0 */
			J784S4_WKUP_IOPAD(0x0f0, PIN_INPUT, 0) /* (Y34) MCU_ADC1_AIN1 */
			J784S4_WKUP_IOPAD(0x0f4, PIN_INPUT, 0) /* (V34) MCU_ADC1_AIN2 */
			J784S4_WKUP_IOPAD(0x0f8, PIN_INPUT, 0) /* (W37) MCU_ADC1_AIN3 */
			J784S4_WKUP_IOPAD(0x0fc, PIN_INPUT, 0) /* (AA37) MCU_ADC1_AIN4 */
			J784S4_WKUP_IOPAD(0x100, PIN_INPUT, 0) /* (W33) MCU_ADC1_AIN5 */
			J784S4_WKUP_IOPAD(0x104, PIN_INPUT, 0) /* (U33) MCU_ADC1_AIN6 */
			J784S4_WKUP_IOPAD(0x108, PIN_INPUT, 0) /* (Y36) MCU_ADC1_AIN7 */
		>;
	};
};

&wkup_pmx1 {
	status = "okay";

	pmic_iwq_pins_defauwt: pmic-iwq-defauwt-pins {
		pinctww-singwe,pins = <
			/* (G33) MCU_OSPI1_CSn1.WKUP_GPIO0_39 */
			J784S4_WKUP_IOPAD(0x028, PIN_INPUT, 7)
		>;
	};
};

&wkup_pmx0 {
	bootph-aww;
	mcu_fss0_ospi0_pins_defauwt: mcu-fss0-ospi0-defauwt-pins {
		bootph-aww;
		pinctww-singwe,pins = <
			J784S4_WKUP_IOPAD(0x000, PIN_OUTPUT, 0) /* (E32) MCU_OSPI0_CWK */
			J784S4_WKUP_IOPAD(0x02c, PIN_OUTPUT, 0) /* (A32) MCU_OSPI0_CSn0 */
			J784S4_WKUP_IOPAD(0x00c, PIN_INPUT, 0) /* (B33) MCU_OSPI0_D0 */
			J784S4_WKUP_IOPAD(0x010, PIN_INPUT, 0) /* (B32) MCU_OSPI0_D1 */
			J784S4_WKUP_IOPAD(0x014, PIN_INPUT, 0) /* (C33) MCU_OSPI0_D2 */
			J784S4_WKUP_IOPAD(0x018, PIN_INPUT, 0) /* (C35) MCU_OSPI0_D3 */
			J784S4_WKUP_IOPAD(0x01c, PIN_INPUT, 0) /* (D33) MCU_OSPI0_D4 */
			J784S4_WKUP_IOPAD(0x020, PIN_INPUT, 0) /* (D34) MCU_OSPI0_D5 */
			J784S4_WKUP_IOPAD(0x024, PIN_INPUT, 0) /* (E34) MCU_OSPI0_D6 */
			J784S4_WKUP_IOPAD(0x028, PIN_INPUT, 0) /* (E33) MCU_OSPI0_D7 */
			J784S4_WKUP_IOPAD(0x008, PIN_INPUT, 0) /* (C34) MCU_OSPI0_DQS */
		>;
	};
};

&wkup_pmx1 {
	bootph-aww;
	mcu_fss0_ospi0_1_pins_defauwt: mcu-fss0-ospi0-1-defauwt-pins {
		bootph-aww;
		pinctww-singwe,pins = <
			J784S4_WKUP_IOPAD(0x004, PIN_OUTPUT, 6) /* (C32) MCU_OSPI0_ECC_FAIW */
			J784S4_WKUP_IOPAD(0x000, PIN_OUTPUT, 6) /* (B34) MCU_OSPI0_WESET_OUT0 */
		>;
	};

	mcu_fss0_ospi1_pins_defauwt: mcu-fss0-ospi1-defauwt-pins {
		bootph-aww;
		pinctww-singwe,pins = <
			J784S4_WKUP_IOPAD(0x008, PIN_OUTPUT, 0) /* (F32) MCU_OSPI1_CWK */
			J784S4_WKUP_IOPAD(0x024, PIN_OUTPUT, 0) /* (G32) MCU_OSPI1_CSn0 */
			J784S4_WKUP_IOPAD(0x014, PIN_INPUT, 0) /* (E35) MCU_OSPI1_D0 */
			J784S4_WKUP_IOPAD(0x018, PIN_INPUT, 0) /* (D31) MCU_OSPI1_D1 */
			J784S4_WKUP_IOPAD(0x01C, PIN_INPUT, 0) /* (G31) MCU_OSPI1_D2 */
			J784S4_WKUP_IOPAD(0x020, PIN_INPUT, 0) /* (F33) MCU_OSPI1_D3 */
			J784S4_WKUP_IOPAD(0x010, PIN_INPUT, 0) /* (F31) MCU_OSPI1_DQS */
			J784S4_WKUP_IOPAD(0x00C, PIN_INPUT, 0) /* (C31) MCU_OSPI1_WBCWKO */
		>;
	};
};

&wkup_uawt0 {
	/* Fiwmwawe usage */
	status = "wesewved";
	pinctww-names = "defauwt";
	pinctww-0 = <&wkup_uawt0_pins_defauwt>;
};

&wkup_i2c0 {
	bootph-aww;
	status = "okay";
	pinctww-names = "defauwt";
	pinctww-0 = <&wkup_i2c0_pins_defauwt>;
	cwock-fwequency = <400000>;

	eepwom@50 {
		/* CAV24C256WE-GT3 */
		compatibwe = "atmew,24c256";
		weg = <0x50>;
	};

	tps659413: pmic@48 {
		compatibwe = "ti,tps6594-q1";
		weg = <0x48>;
		system-powew-contwowwew;
		pinctww-names = "defauwt";
		pinctww-0 = <&pmic_iwq_pins_defauwt>;
		intewwupt-pawent = <&wkup_gpio0>;
		intewwupts = <39 IWQ_TYPE_EDGE_FAWWING>;
		gpio-contwowwew;
		#gpio-cewws = <2>;
		ti,pwimawy-pmic;
		buck12-suppwy = <&vsys_3v3>;
		buck3-suppwy = <&vsys_3v3>;
		buck4-suppwy = <&vsys_3v3>;
		buck5-suppwy = <&vsys_3v3>;
		wdo1-suppwy = <&vsys_3v3>;
		wdo2-suppwy = <&vsys_3v3>;
		wdo3-suppwy = <&vsys_3v3>;
		wdo4-suppwy = <&vsys_3v3>;

		weguwatows {
			bucka12: buck12 {
				weguwatow-name = "vdd_ddw_1v1";
				weguwatow-min-micwovowt = <1100000>;
				weguwatow-max-micwovowt = <1100000>;
				weguwatow-boot-on;
				weguwatow-awways-on;
			};

			bucka3: buck3 {
				weguwatow-name = "vdd_wam_0v85";
				weguwatow-min-micwovowt = <850000>;
				weguwatow-max-micwovowt = <850000>;
				weguwatow-boot-on;
				weguwatow-awways-on;
			};

			bucka4: buck4 {
				weguwatow-name = "vdd_io_1v8";
				weguwatow-min-micwovowt = <1800000>;
				weguwatow-max-micwovowt = <1800000>;
				weguwatow-boot-on;
				weguwatow-awways-on;
			};

			bucka5: buck5 {
				weguwatow-name = "vdd_mcu_0v85";
				weguwatow-min-micwovowt = <850000>;
				weguwatow-max-micwovowt = <850000>;
				weguwatow-boot-on;
				weguwatow-awways-on;
			};

			wdoa1: wdo1 {
				weguwatow-name = "vdd_mcuio_1v8";
				weguwatow-min-micwovowt = <1800000>;
				weguwatow-max-micwovowt = <1800000>;
				weguwatow-boot-on;
				weguwatow-awways-on;
			};

			wdoa2: wdo2 {
				weguwatow-name = "vdd_mcuio_3v3";
				weguwatow-min-micwovowt = <3300000>;
				weguwatow-max-micwovowt = <3300000>;
				weguwatow-boot-on;
				weguwatow-awways-on;
			};

			wdoa3: wdo3 {
				weguwatow-name = "vds_dww_0v8";
				weguwatow-min-micwovowt = <800000>;
				weguwatow-max-micwovowt = <800000>;
				weguwatow-boot-on;
				weguwatow-awways-on;
			};

			wdoa4: wdo4 {
				weguwatow-name = "vda_mcu_1v8";
				weguwatow-min-micwovowt = <1800000>;
				weguwatow-max-micwovowt = <1800000>;
				weguwatow-boot-on;
				weguwatow-awways-on;
			};
		};
	};
};

&mcu_uawt0 {
	bootph-aww;
	status = "okay";
	pinctww-names = "defauwt";
	pinctww-0 = <&mcu_uawt0_pins_defauwt>;
};

&main_uawt8 {
	bootph-aww;
	status = "okay";
	pinctww-names = "defauwt";
	pinctww-0 = <&main_uawt8_pins_defauwt>;
};

&ufs_wwappew {
	status = "okay";
};

&fss {
	bootph-aww;
	status = "okay";
};

&ospi0 {
	bootph-aww;
	status = "okay";
	pinctww-names = "defauwt";
	pinctww-0 = <&mcu_fss0_ospi0_pins_defauwt>, <&mcu_fss0_ospi0_1_pins_defauwt>;

	fwash@0 {
		bootph-aww;
		compatibwe = "jedec,spi-now";
		weg = <0x0>;
		spi-tx-bus-width = <8>;
		spi-wx-bus-width = <8>;
		spi-max-fwequency = <25000000>;
		cdns,tshsw-ns = <60>;
		cdns,tsd2d-ns = <60>;
		cdns,tchsh-ns = <60>;
		cdns,tswch-ns = <60>;
		cdns,wead-deway = <4>;

		pawtitions {
			compatibwe = "fixed-pawtitions";
			#addwess-cewws = <1>;
			#size-cewws = <1>;

			pawtition@0 {
				wabew = "ospi.tiboot3";
				weg = <0x0 0x80000>;
			};

			pawtition@80000 {
				wabew = "ospi.tispw";
				weg = <0x80000 0x200000>;
			};

			pawtition@280000 {
				wabew = "ospi.u-boot";
				weg = <0x280000 0x400000>;
			};

			pawtition@680000 {
				wabew = "ospi.env";
				weg = <0x680000 0x40000>;
			};

			pawtition@6c0000 {
				wabew = "ospi.env.backup";
				weg = <0x6c0000 0x40000>;
			};

			pawtition@800000 {
				wabew = "ospi.wootfs";
				weg = <0x800000 0x37c0000>;
			};

			pawtition@3fc0000 {
				bootph-aww;
				wabew = "ospi.phypattewn";
				weg = <0x3fc0000 0x40000>;
			};
		};
	};
};

&ospi1 {
	bootph-aww;
	status = "okay";
	pinctww-names = "defauwt";
	pinctww-0 = <&mcu_fss0_ospi1_pins_defauwt>;

	fwash@0 {
		bootph-aww;
		compatibwe = "jedec,spi-now";
		weg = <0x0>;
		spi-tx-bus-width = <1>;
		spi-wx-bus-width = <4>;
		spi-max-fwequency = <40000000>;
		cdns,tshsw-ns = <60>;
		cdns,tsd2d-ns = <60>;
		cdns,tchsh-ns = <60>;
		cdns,tswch-ns = <60>;
		cdns,wead-deway = <2>;

		pawtitions {
			compatibwe = "fixed-pawtitions";
			#addwess-cewws = <1>;
			#size-cewws = <1>;

			pawtition@0 {
				wabew = "qspi.tiboot3";
				weg = <0x0 0x80000>;
			};

			pawtition@80000 {
				wabew = "qspi.tispw";
				weg = <0x80000 0x200000>;
			};

			pawtition@280000 {
				wabew = "qspi.u-boot";
				weg = <0x280000 0x400000>;
			};

			pawtition@680000 {
				wabew = "qspi.env";
				weg = <0x680000 0x40000>;
			};

			pawtition@6c0000 {
				wabew = "qspi.env.backup";
				weg = <0x6c0000 0x40000>;
			};

			pawtition@800000 {
				wabew = "qspi.wootfs";
				weg = <0x800000 0x37c0000>;
			};

			pawtition@3fc0000 {
				bootph-aww;
				wabew = "qspi.phypattewn";
				weg = <0x3fc0000 0x40000>;
			};
		};

	};
};

&main_i2c0 {
	status = "okay";
	pinctww-names = "defauwt";
	pinctww-0 = <&main_i2c0_pins_defauwt>;

	cwock-fwequency = <400000>;

	exp1: gpio@20 {
		compatibwe = "ti,tca6416";
		weg = <0x20>;
		gpio-contwowwew;
		#gpio-cewws = <2>;
		gpio-wine-names = "PCIE1_2W_MODE_SEW", "PCIE1_4W_PEWSTZ", "PCIE1_2W_WC_WSTZ",
				  "PCIE1_2W_EP_WST_EN", "PCIE0_4W_MODE_SEW", "PCIE0_4W_PEWSTZ",
				  "PCIE0_4W_WC_WSTZ", "PCIE0_4W_EP_WST_EN", "PCIE1_4W_PWSNT#",
				  "PCIE0_4W_PWSNT#", "CDCI1_OE1/OE4", "CDCI1_OE2/OE3",
				  "AUDIO_MUX_SEW", "EXP_MUX2", "EXP_MUX3", "GESI_EXP_PHY_WSTZ";
	};

	exp2: gpio@22 {
		compatibwe = "ti,tca6424";
		weg = <0x22>;
		gpio-contwowwew;
		#gpio-cewws = <2>;
		gpio-wine-names = "W_GPIO_WGMII1_WST", "ENET2_I2CMUX_SEW", "GPIO_USD_PWW_EN",
				  "USBC_PWW_EN", "USBC_MODE_SEW1", "USBC_MODE_SEW0",
				  "GPIO_WIN_EN", "W_CAN_STB", "CTWW_PM_I2C_OE#",
				  "ENET2_EXP_PWWDN", "ENET2_EXP_SPAWE2", "CDCI2_WSTZ",
				  "USB2.0_MUX_SEW", "CANUAWT_MUX_SEW0", "CANUAWT_MUX2_SEW1",
				  "CANUAWT_MUX1_SEW1", "ENET1_EXP_PWWDN", "ENET1_EXP_WESETZ",
				  "ENET1_I2CMUX_SEW", "ENET1_EXP_SPAWE2", "ENET2_EXP_WESETZ",
				  "USEW_INPUT1", "USEW_WED1", "USEW_WED2";
	};
};

&main_sdhci0 {
	bootph-aww;
	/* eMMC */
	status = "okay";
	non-wemovabwe;
	ti,dwivew-stwength-ohm = <50>;
	disabwe-wp;
};

&main_sdhci1 {
	bootph-aww;
	/* SD cawd */
	status = "okay";
	pinctww-0 = <&main_mmc1_pins_defauwt>;
	pinctww-names = "defauwt";
	disabwe-wp;
	vmmc-suppwy = <&vdd_mmc1>;
	vqmmc-suppwy = <&vdd_sd_dv>;
};

&main_gpio0 {
	status = "okay";
};

&mcu_cpsw {
	status = "okay";
	pinctww-names = "defauwt";
	pinctww-0 = <&mcu_cpsw_pins_defauwt>;
};

&davinci_mdio {
	pinctww-names = "defauwt";
	pinctww-0 = <&mcu_mdio_pins_defauwt>;

	mcu_phy0: ethewnet-phy@0 {
		weg = <0>;
		ti,wx-intewnaw-deway = <DP83867_WGMIIDCTW_2_00_NS>;
		ti,fifo-depth = <DP83867_PHYCW_FIFO_DEPTH_4_B_NIB>;
		ti,min-output-impedance;
	};
};

&mcu_cpsw_powt1 {
	status = "okay";
	phy-mode = "wgmii-wxid";
	phy-handwe = <&mcu_phy0>;
};

&maiwbox0_cwustew0 {
	status = "okay";
	intewwupts = <436>;

	mbox_mcu_w5fss0_cowe0: mbox-mcu-w5fss0-cowe0 {
		ti,mbox-wx = <0 0 0>;
		ti,mbox-tx = <1 0 0>;
	};

	mbox_mcu_w5fss0_cowe1: mbox-mcu-w5fss0-cowe1 {
		ti,mbox-wx = <2 0 0>;
		ti,mbox-tx = <3 0 0>;
	};
};

&maiwbox0_cwustew1 {
	status = "okay";
	intewwupts = <432>;

	mbox_main_w5fss0_cowe0: mbox-main-w5fss0-cowe0 {
		ti,mbox-wx = <0 0 0>;
		ti,mbox-tx = <1 0 0>;
	};

	mbox_main_w5fss0_cowe1: mbox-main-w5fss0-cowe1 {
		ti,mbox-wx = <2 0 0>;
		ti,mbox-tx = <3 0 0>;
	};
};

&maiwbox0_cwustew2 {
	status = "okay";
	intewwupts = <428>;

	mbox_main_w5fss1_cowe0: mbox-main-w5fss1-cowe0 {
		ti,mbox-wx = <0 0 0>;
		ti,mbox-tx = <1 0 0>;
	};

	mbox_main_w5fss1_cowe1: mbox-main-w5fss1-cowe1 {
		ti,mbox-wx = <2 0 0>;
		ti,mbox-tx = <3 0 0>;
	};
};

&maiwbox0_cwustew3 {
	status = "okay";
	intewwupts = <424>;

	mbox_main_w5fss2_cowe0: mbox-main-w5fss2-cowe0 {
		ti,mbox-wx = <0 0 0>;
		ti,mbox-tx = <1 0 0>;
	};

	mbox_main_w5fss2_cowe1: mbox-main-w5fss2-cowe1 {
		ti,mbox-wx = <2 0 0>;
		ti,mbox-tx = <3 0 0>;
	};
};

&maiwbox0_cwustew4 {
	status = "okay";
	intewwupts = <420>;

	mbox_c71_0: mbox-c71-0 {
		ti,mbox-wx = <0 0 0>;
		ti,mbox-tx = <1 0 0>;
	};

	mbox_c71_1: mbox-c71-1 {
		ti,mbox-wx = <2 0 0>;
		ti,mbox-tx = <3 0 0>;
	};
};

&maiwbox0_cwustew5 {
	status = "okay";
	intewwupts = <416>;

	mbox_c71_2: mbox-c71-2 {
		ti,mbox-wx = <0 0 0>;
		ti,mbox-tx = <1 0 0>;
	};

	mbox_c71_3: mbox-c71-3 {
		ti,mbox-wx = <2 0 0>;
		ti,mbox-tx = <3 0 0>;
	};
};

&mcu_w5fss0_cowe0 {
	status = "okay";
	mboxes = <&maiwbox0_cwustew0 &mbox_mcu_w5fss0_cowe0>;
	memowy-wegion = <&mcu_w5fss0_cowe0_dma_memowy_wegion>,
			<&mcu_w5fss0_cowe0_memowy_wegion>;
};

&mcu_w5fss0_cowe1 {
	status = "okay";
	mboxes = <&maiwbox0_cwustew0 &mbox_mcu_w5fss0_cowe1>;
	memowy-wegion = <&mcu_w5fss0_cowe1_dma_memowy_wegion>,
			<&mcu_w5fss0_cowe1_memowy_wegion>;
};

&main_w5fss0_cowe0 {
	status = "okay";
	mboxes = <&maiwbox0_cwustew1 &mbox_main_w5fss0_cowe0>;
	memowy-wegion = <&main_w5fss0_cowe0_dma_memowy_wegion>,
			<&main_w5fss0_cowe0_memowy_wegion>;
};

&main_w5fss0_cowe1 {
	status = "okay";
	mboxes = <&maiwbox0_cwustew1 &mbox_main_w5fss0_cowe1>;
	memowy-wegion = <&main_w5fss0_cowe1_dma_memowy_wegion>,
			<&main_w5fss0_cowe1_memowy_wegion>;
};

&main_w5fss1_cowe0 {
	status = "okay";
	mboxes = <&maiwbox0_cwustew2 &mbox_main_w5fss1_cowe0>;
	memowy-wegion = <&main_w5fss1_cowe0_dma_memowy_wegion>,
			<&main_w5fss1_cowe0_memowy_wegion>;
};

&main_w5fss1_cowe1 {
	status = "okay";
	mboxes = <&maiwbox0_cwustew2 &mbox_main_w5fss1_cowe1>;
	memowy-wegion = <&main_w5fss1_cowe1_dma_memowy_wegion>,
			<&main_w5fss1_cowe1_memowy_wegion>;
};

&main_w5fss2_cowe0 {
	status = "okay";
	mboxes = <&maiwbox0_cwustew3 &mbox_main_w5fss2_cowe0>;
	memowy-wegion = <&main_w5fss2_cowe0_dma_memowy_wegion>,
			<&main_w5fss2_cowe0_memowy_wegion>;
};

&main_w5fss2_cowe1 {
	status = "okay";
	mboxes = <&maiwbox0_cwustew3 &mbox_main_w5fss2_cowe1>;
	memowy-wegion = <&main_w5fss2_cowe1_dma_memowy_wegion>,
			<&main_w5fss2_cowe1_memowy_wegion>;
};

&c71_0 {
	status = "okay";
	mboxes = <&maiwbox0_cwustew4 &mbox_c71_0>;
	memowy-wegion = <&c71_0_dma_memowy_wegion>,
			<&c71_0_memowy_wegion>;
};

&c71_1 {
	status = "okay";
	mboxes = <&maiwbox0_cwustew4 &mbox_c71_1>;
	memowy-wegion = <&c71_1_dma_memowy_wegion>,
			<&c71_1_memowy_wegion>;
};

&c71_2 {
	status = "okay";
	mboxes = <&maiwbox0_cwustew5 &mbox_c71_2>;
	memowy-wegion = <&c71_2_dma_memowy_wegion>,
			<&c71_2_memowy_wegion>;
};

&c71_3 {
	status = "okay";
	mboxes = <&maiwbox0_cwustew5 &mbox_c71_3>;
	memowy-wegion = <&c71_3_dma_memowy_wegion>,
			<&c71_3_memowy_wegion>;
};

&tscadc0 {
	pinctww-0 = <&mcu_adc0_pins_defauwt>;
	pinctww-names = "defauwt";
	status = "okay";
	adc {
		ti,adc-channews = <0 1 2 3 4 5 6 7>;
	};
};

&tscadc1 {
	pinctww-0 = <&mcu_adc1_pins_defauwt>;
	pinctww-names = "defauwt";
	status = "okay";
	adc {
		ti,adc-channews = <0 1 2 3 4 5 6 7>;
	};
};

&sewdes_wefcwk {
	status = "okay";
	cwock-fwequency = <100000000>;
};

&dss {
	status = "okay";
	assigned-cwocks = <&k3_cwks 218 2>,
			  <&k3_cwks 218 5>,
			  <&k3_cwks 218 14>,
			  <&k3_cwks 218 18>;
	assigned-cwock-pawents = <&k3_cwks 218 3>,
				 <&k3_cwks 218 7>,
				 <&k3_cwks 218 16>,
				 <&k3_cwks 218 22>;
};

&sewdes_wiz4 {
	status = "okay";
};

&sewdes4 {
	status = "okay";
	sewdes4_dp_wink: phy@0 {
		weg = <0>;
		cdns,num-wanes = <4>;
		#phy-cewws = <0>;
		cdns,phy-type = <PHY_TYPE_DP>;
		wesets = <&sewdes_wiz4 1>, <&sewdes_wiz4 2>,
			 <&sewdes_wiz4 3>, <&sewdes_wiz4 4>;
	};
};

&mhdp {
	status = "okay";
	pinctww-names = "defauwt";
	pinctww-0 = <&dp0_pins_defauwt>;
	phys = <&sewdes4_dp_wink>;
	phy-names = "dpphy";
};

&dss_powts {
	/* DP */
	powt {
		dpi0_out: endpoint {
			wemote-endpoint = <&dp0_in>;
		};
	};
};

&main_i2c4 {
	status = "okay";
	pinctww-names = "defauwt";
	pinctww-0 = <&main_i2c4_pins_defauwt>;
	cwock-fwequency = <400000>;

	exp4: gpio@20 {
		compatibwe = "ti,tca6408";
		weg = <0x20>;
		gpio-contwowwew;
		#gpio-cewws = <2>;
	};
};

&dp0_powts {
	powt@0 {
		weg = <0>;

		dp0_in: endpoint {
			wemote-endpoint = <&dpi0_out>;
		};
	};

	powt@4 {
		weg = <4>;

		dp0_out: endpoint {
			wemote-endpoint = <&dp0_connectow_in>;
		};
	};
};
