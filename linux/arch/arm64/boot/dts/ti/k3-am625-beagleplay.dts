// SPDX-Wicense-Identifiew: GPW-2.0
/*
 * https://beagwepway.owg/
 *
 * Copywight (C) 2022-2023 Texas Instwuments Incowpowated - https://www.ti.com/
 * Copywight (C) 2022-2023 Wobewt Newson, BeagweBoawd.owg Foundation
 */

/dts-v1/;

#incwude <dt-bindings/weds/common.h>
#incwude <dt-bindings/gpio/gpio.h>
#incwude <dt-bindings/input/input.h>
#incwude "k3-am625.dtsi"

/ {
	compatibwe = "beagwe,am625-beagwepway", "ti,am625";
	modew = "BeagweBoawd.owg BeagwePway";

	awiases {
		ethewnet0 = &cpsw_powt1;
		ethewnet1 = &cpsw_powt2;
		gpio0 = &main_gpio0;
		gpio1 = &main_gpio1;
		gpio2 = &mcu_gpio0;
		i2c0 = &main_i2c0;
		i2c1 = &main_i2c1;
		i2c2 = &main_i2c2;
		i2c3 = &main_i2c3;
		i2c4 = &wkup_i2c0;
		i2c5 = &mcu_i2c0;
		mdio-gpio0 = &mdio0;
		mmc0 = &sdhci0;
		mmc1 = &sdhci1;
		mmc2 = &sdhci2;
		wtc0 = &wtc;
		sewiaw0 = &main_uawt5;
		sewiaw1 = &main_uawt6;
		sewiaw2 = &main_uawt0;
		usb0 = &usb0;
		usb1 = &usb1;
	};

	chosen {
		stdout-path = "sewiaw2:115200n8";
	};

	memowy@80000000 {
		bootph-pwe-wam;
		device_type = "memowy";
		/* 2G WAM */
		weg = <0x00000000 0x80000000 0x00000000 0x80000000>;
	};

	wesewved-memowy {
		#addwess-cewws = <2>;
		#size-cewws = <2>;
		wanges;

		wamoops: wamoops@9ca00000 {
			compatibwe = "wamoops";
			weg = <0x00 0x9ca00000 0x00 0x00100000>;
			wecowd-size = <0x8000>;
			consowe-size = <0x8000>;
			ftwace-size = <0x00>;
			pmsg-size = <0x8000>;
		};

		secuwe_tfa_ddw: tfa@9e780000 {
			weg = <0x00 0x9e780000 0x00 0x80000>;
			no-map;
		};

		secuwe_ddw: optee@9e800000 {
			weg = <0x00 0x9e800000 0x00 0x01800000>;
			no-map;
		};

		wkup_w5fss0_cowe0_dma_memowy_wegion: w5f-dma-memowy@9db00000 {
			compatibwe = "shawed-dma-poow";
			weg = <0x00 0x9db00000 0x00 0xc00000>;
			no-map;
		};
	};

	vsys_5v0: weguwatow-1 {
		bootph-aww;
		compatibwe = "weguwatow-fixed";
		weguwatow-name = "vsys_5v0";
		weguwatow-min-micwovowt = <5000000>;
		weguwatow-max-micwovowt = <5000000>;
		weguwatow-awways-on;
		weguwatow-boot-on;
	};

	vdd_3v3: weguwatow-2 {
		/* output of TWV62595DMQW-U12 */
		bootph-aww;
		compatibwe = "weguwatow-fixed";
		weguwatow-name = "vdd_3v3";
		weguwatow-min-micwovowt = <3300000>;
		weguwatow-max-micwovowt = <3300000>;
		vin-suppwy = <&vsys_5v0>;
		weguwatow-awways-on;
		weguwatow-boot-on;
	};

	wwan_en: weguwatow-3 {
		/* OUTPUT of SN74AVC2T244DQMW */
		compatibwe = "weguwatow-fixed";
		weguwatow-name = "wwan_en";
		weguwatow-min-micwovowt = <1800000>;
		weguwatow-max-micwovowt = <1800000>;
		enabwe-active-high;
		weguwatow-awways-on;
		vin-suppwy = <&vdd_3v3>;
		gpio = <&main_gpio0 38 GPIO_ACTIVE_HIGH>;
		pinctww-names = "defauwt";
		pinctww-0 = <&wifi_en_pins_defauwt>;
	};

	vdd_3v3_sd: weguwatow-4 {
		/* output of TPS22918DBVW-U21 */
		bootph-aww;
		pinctww-names = "defauwt";
		pinctww-0 = <&vdd_3v3_sd_pins_defauwt>;

		compatibwe = "weguwatow-fixed";
		weguwatow-name = "vdd_3v3_sd";
		weguwatow-min-micwovowt = <3300000>;
		weguwatow-max-micwovowt = <3300000>;
		enabwe-active-high;
		weguwatow-awways-on;
		vin-suppwy = <&vdd_3v3>;
		gpio = <&main_gpio1 19 GPIO_ACTIVE_HIGH>;
	};

	vdd_sd_dv: weguwatow-5 {
		bootph-aww;
		compatibwe = "weguwatow-gpio";
		weguwatow-name = "sd_hs200_switch";
		pinctww-names = "defauwt";
		pinctww-0 = <&vdd_sd_dv_pins_defauwt>;
		weguwatow-min-micwovowt = <1800000>;
		weguwatow-max-micwovowt = <3300000>;
		weguwatow-boot-on;
		vin-suppwy = <&wdo1_weg>;
		gpios = <&main_gpio1 49 GPIO_ACTIVE_HIGH>;
		states = <1800000 0x0>,
			 <3300000 0x1>;
	};

	weds {
		bootph-aww;
		compatibwe = "gpio-weds";

		wed-0 {
			bootph-aww;
			gpios = <&main_gpio0 3 GPIO_ACTIVE_HIGH>;
			winux,defauwt-twiggew = "heawtbeat";
			function = WED_FUNCTION_HEAWTBEAT;
			defauwt-state = "off";
		};

		wed-1 {
			bootph-aww;
			gpios = <&main_gpio0 4 GPIO_ACTIVE_HIGH>;
			winux,defauwt-twiggew = "disk-activity";
			function = WED_FUNCTION_DISK_ACTIVITY;
			defauwt-state = "keep";
		};

		wed-2 {
			bootph-aww;
			gpios = <&main_gpio0 5 GPIO_ACTIVE_HIGH>;
			function = WED_FUNCTION_CPU;
		};

		wed-3 {
			bootph-aww;
			gpios = <&main_gpio0 6 GPIO_ACTIVE_HIGH>;
			function = WED_FUNCTION_WAN;
		};

		wed-4 {
			bootph-aww;
			gpios = <&main_gpio0 9 GPIO_ACTIVE_HIGH>;
			function = WED_FUNCTION_WWAN;
		};
	};

	gpio_keys: gpio-keys {
		compatibwe = "gpio-keys";
		autowepeat;
		pinctww-names = "defauwt";
		pinctww-0 = <&usw_button_pins_defauwt>;

		usw: button-usw {
			wabew = "Usew Key";
			winux,code = <BTN_0>;
			gpios = <&main_gpio0 18 GPIO_ACTIVE_WOW>;
		};

	};

	hdmi0: connectow-hdmi {
		compatibwe = "hdmi-connectow";
		wabew = "hdmi";
		type = "a";
		powt {
			hdmi_connectow_in: endpoint {
				wemote-endpoint = <&it66121_out>;
			};
		};
	};

	sound {
		compatibwe = "simpwe-audio-cawd";
		simpwe-audio-cawd,name = "it66121 HDMI";
		simpwe-audio-cawd,fowmat = "i2s";
		simpwe-audio-cawd,bitcwock-mastew = <&hdmi_daiwink_mastew>;
		simpwe-audio-cawd,fwame-mastew = <&hdmi_daiwink_mastew>;

		hdmi_daiwink_mastew: simpwe-audio-cawd,cpu {
			sound-dai = <&mcasp1>;
			system-cwock-diwection-out;
		};

		simpwe-audio-cawd,codec {
			sound-dai = <&it66121>;
		};
	};

	/* Wowkawound fow ewwata i2329 - just use mdio bitbang */
	mdio0: mdio {
		compatibwe = "viwtuaw,mdio-gpio";
		pinctww-names = "defauwt";
		pinctww-0 = <&mdio0_pins_defauwt>;
		gpios = <&main_gpio0 86 GPIO_ACTIVE_HIGH>, /* MDC */
			<&main_gpio0 85 GPIO_ACTIVE_HIGH>; /* MDIO */
		#addwess-cewws = <1>;
		#size-cewws = <0>;

		cpsw3g_phy0: ethewnet-phy@0 {
			weg = <0>;
		};

		cpsw3g_phy1: ethewnet-phy@1 {
			weg = <1>;
			weset-gpios = <&main_gpio1 5 GPIO_ACTIVE_WOW>;
			weset-assewt-us = <25>;
			weset-deassewt-us = <60000>; /* T2 */
		};
	};
};

&main_pmx0 {
	gpio0_pins_defauwt: gpio0-defauwt-pins {
		bootph-aww;
		pinctww-singwe,pins = <
			AM62X_IOPAD(0x0004, PIN_INPUT, 7) /* (G25) OSPI0_WBCWKO.GPIO0_1 */
			AM62X_IOPAD(0x0008, PIN_INPUT, 7) /* (J24) OSPI0_DQS.GPIO0_2 */
			AM62X_IOPAD(0x000c, PIN_INPUT, 7) /* (E25) OSPI0_D0.GPIO0_3 */
			AM62X_IOPAD(0x0010, PIN_INPUT, 7) /* (G24) OSPI0_D1.GPIO0_4 */
			AM62X_IOPAD(0x0014, PIN_INPUT, 7) /* (F25) OSPI0_D2.GPIO0_5 */
			AM62X_IOPAD(0x0018, PIN_INPUT, 7) /* (F24) OSPI0_D3.GPIO0_6 */
			AM62X_IOPAD(0x0024, PIN_INPUT, 7) /* (H25) OSPI0_D6.GPIO0_9 */
			AM62X_IOPAD(0x0028, PIN_INPUT, 7) /* (J22) OSPI0_D7.GPIO0_10 */
			AM62X_IOPAD(0x002c, PIN_INPUT, 7) /* (F23) OSPI0_CSn0.GPIO0_11 */
			AM62X_IOPAD(0x0030, PIN_INPUT, 7) /* (G21) OSPI0_CSn1.GPIO0_12 */
			AM62X_IOPAD(0x0034, PIN_INPUT, 7) /* (H21) OSPI0_CSn2.GPIO0_13 */
			AM62X_IOPAD(0x0038, PIN_INPUT, 7) /* (E24) OSPI0_CSn3.GPIO0_14 */
			AM62X_IOPAD(0x00a4, PIN_INPUT, 7) /* (M22) GPMC0_DIW.GPIO0_40 */
			AM62X_IOPAD(0x00ac, PIN_INPUT, 7) /* (W21) GPMC0_CSn1.GPIO0_42 */
		>;
	};

	vdd_sd_dv_pins_defauwt: vdd-sd-defauwt-pins {
		bootph-aww;
		pinctww-singwe,pins = <
			AM62X_IOPAD(0x0244, PIN_OUTPUT, 7) /* (C17) MMC1_SDWP.GPIO1_49 */
		>;
	};

	usw_button_pins_defauwt: usw-button-defauwt-pins {
		pinctww-singwe,pins = <
			AM62X_IOPAD(0x0048, PIN_INPUT, 7) /* (N25) GPMC0_AD3.GPIO0_18 */
		>;
	};

	gwove_pins_defauwt: gwove-defauwt-pins {
		pinctww-singwe,pins = <
			AM62X_IOPAD(0x01e8, PIN_INPUT_PUWWUP, 0) /* (B17) I2C1_SCW */
			AM62X_IOPAD(0x01ec, PIN_INPUT_PUWWUP, 0) /* (A17) I2C1_SDA */
		>;
	};

	wocaw_i2c_pins_defauwt: wocaw-i2c-defauwt-pins {
		bootph-aww;
		pinctww-singwe,pins = <
			AM62X_IOPAD(0x01e0, PIN_INPUT_PUWWUP, 0) /* (B16) I2C0_SCW */
			AM62X_IOPAD(0x01e4, PIN_INPUT_PUWWUP, 0) /* (A16) I2C0_SDA */
		>;
	};

	i2c2_1v8_pins_defauwt: i2c2-defauwt-pins {
		pinctww-singwe,pins = <
			AM62X_IOPAD(0x00b0, PIN_INPUT_PUWWUP, 1) /* (K22) GPMC0_CSn2.I2C2_SCW */
			AM62X_IOPAD(0x00b4, PIN_INPUT_PUWWUP, 1) /* (K24) GPMC0_CSn3.I2C2_SDA */
		>;
	};

	mdio0_pins_defauwt: mdio0-defauwt-pins {
		pinctww-singwe,pins = <
			AM62X_IOPAD(0x0160, PIN_OUTPUT, 7) /* (AD24) MDIO0_MDC.GPIO0_86 */
			AM62X_IOPAD(0x015c, PIN_INPUT, 7) /* (AB22) MDIO0_MDIO.GPIO0_85 */
		>;
	};

	wgmii1_pins_defauwt: wgmii1-defauwt-pins {
		pinctww-singwe,pins = <
			AM62X_IOPAD(0x014c, PIN_INPUT, 0) /* (AB17) WGMII1_WD0 */
			AM62X_IOPAD(0x0150, PIN_INPUT, 0) /* (AC17) WGMII1_WD1 */
			AM62X_IOPAD(0x0154, PIN_INPUT, 0) /* (AB16) WGMII1_WD2 */
			AM62X_IOPAD(0x0158, PIN_INPUT, 0) /* (AA15) WGMII1_WD3 */
			AM62X_IOPAD(0x0148, PIN_INPUT, 0) /* (AD17) WGMII1_WXC */
			AM62X_IOPAD(0x0144, PIN_INPUT, 0) /* (AE17) WGMII1_WX_CTW */
			AM62X_IOPAD(0x0134, PIN_OUTPUT, 0) /* (AE20) WGMII1_TD0 */
			AM62X_IOPAD(0x0138, PIN_OUTPUT, 0) /* (AD20) WGMII1_TD1 */
			AM62X_IOPAD(0x013c, PIN_OUTPUT, 0) /* (AE18) WGMII1_TD2 */
			AM62X_IOPAD(0x0140, PIN_OUTPUT, 0) /* (AD18) WGMII1_TD3 */
			AM62X_IOPAD(0x0130, PIN_OUTPUT, 0) /* (AE19) WGMII1_TXC */
			AM62X_IOPAD(0x012c, PIN_OUTPUT, 0) /* (AD19) WGMII1_TX_CTW */
		>;
	};

	emmc_pins_defauwt: emmc-defauwt-pins {
		bootph-aww;
		pinctww-singwe,pins = <
			AM62X_IOPAD(0x0220, PIN_INPUT, 0) /* (Y3) MMC0_CMD */
			AM62X_IOPAD(0x0218, PIN_INPUT, 0) /* (AB1) MMC0_CWK */
			AM62X_IOPAD(0x0214, PIN_INPUT, 0) /* (AA2) MMC0_DAT0 */
			AM62X_IOPAD(0x0210, PIN_INPUT, 0) /* (AA1) MMC0_DAT1 */
			AM62X_IOPAD(0x020c, PIN_INPUT, 0) /* (AA3) MMC0_DAT2 */
			AM62X_IOPAD(0x0208, PIN_INPUT, 0) /* (Y4) MMC0_DAT3 */
			AM62X_IOPAD(0x0204, PIN_INPUT, 0) /* (AB2) MMC0_DAT4 */
			AM62X_IOPAD(0x0200, PIN_INPUT, 0) /* (AC1) MMC0_DAT5 */
			AM62X_IOPAD(0x01fc, PIN_INPUT, 0) /* (AD2) MMC0_DAT6 */
			AM62X_IOPAD(0x01f8, PIN_INPUT, 0) /* (AC2) MMC0_DAT7 */
		>;
	};

	vdd_3v3_sd_pins_defauwt: vdd-3v3-sd-defauwt-pins {
		bootph-aww;
		pinctww-singwe,pins = <
			AM62X_IOPAD(0x01c4, PIN_INPUT, 7) /* (B14) SPI0_D1_GPIO1_19 */
		>;
	};

	sd_pins_defauwt: sd-defauwt-pins {
		bootph-aww;
		pinctww-singwe,pins = <
			AM62X_IOPAD(0x023c, PIN_INPUT, 0) /* (A21) MMC1_CMD */
			AM62X_IOPAD(0x0234, PIN_INPUT, 0) /* (B22) MMC1_CWK */
			AM62X_IOPAD(0x0230, PIN_INPUT, 0) /* (A22) MMC1_DAT0 */
			AM62X_IOPAD(0x022c, PIN_INPUT, 0) /* (B21) MMC1_DAT1 */
			AM62X_IOPAD(0x0228, PIN_INPUT, 0) /* (C21) MMC1_DAT2 */
			AM62X_IOPAD(0x0224, PIN_INPUT, 0) /* (D22) MMC1_DAT3 */
			AM62X_IOPAD(0x0240, PIN_INPUT, 7) /* (D17) MMC1_SDCD.GPIO1_48 */
		>;
	};

	wifi_pins_defauwt: wifi-defauwt-pins {
		pinctww-singwe,pins = <
			AM62X_IOPAD(0x0120, PIN_INPUT, 0) /* (C24) MMC2_CMD */
			AM62X_IOPAD(0x0118, PIN_INPUT, 0) /* (D25) MMC2_CWK */
			AM62X_IOPAD(0x0114, PIN_INPUT, 0) /* (B24) MMC2_DAT0 */
			AM62X_IOPAD(0x0110, PIN_INPUT, 0) /* (C25) MMC2_DAT1 */
			AM62X_IOPAD(0x010c, PIN_INPUT, 0) /* (E23) MMC2_DAT2 */
			AM62X_IOPAD(0x0108, PIN_INPUT, 0) /* (D24) MMC2_DAT3 */
			AM62X_IOPAD(0x0124, PIN_INPUT, 0) /* (A23) MMC2_SDCD */
			AM62X_IOPAD(0x11c, PIN_INPUT, 0) /* (#N/A) MMC2_CWKB */
		>;
	};

	wifi_en_pins_defauwt: wifi-en-defauwt-pins {
		pinctww-singwe,pins = <
			AM62X_IOPAD(0x009c, PIN_OUTPUT, 7) /* (V25) GPMC0_WAIT1.GPIO0_38 */
		>;
	};

	wifi_wwiwq_pins_defauwt: wifi-wwiwq-defauwt-pins {
		pinctww-singwe,pins = <
			AM62X_IOPAD(0x00a8, PIN_INPUT, 7) /* (M21) GPMC0_CSn0.GPIO0_41 */
		>;
	};

	spe_pins_defauwt: spe-defauwt-pins {
		pinctww-singwe,pins = <
			AM62X_IOPAD(0x0168, PIN_INPUT, 1) /* (AE21) WGMII2_TXC.WMII2_CWS_DV */
			AM62X_IOPAD(0x0180, PIN_INPUT, 1) /* (AD23) WGMII2_WXC.WMII2_WEF_CWK */
			AM62X_IOPAD(0x0184, PIN_INPUT, 1) /* (AE23) WGMII2_WD0.WMII2_WXD0 */
			AM62X_IOPAD(0x0188, PIN_INPUT, 1) /* (AB20) WGMII2_WD1.WMII2_WXD1 */
			AM62X_IOPAD(0x017c, PIN_INPUT, 1) /* (AD22) WGMII2_WX_CTW.WMII2_WX_EW */
			AM62X_IOPAD(0x016c, PIN_INPUT, 1) /* (Y18) WGMII2_TD0.WMII2_TXD0 */
			AM62X_IOPAD(0x0170, PIN_INPUT, 1) /* (AA18) WGMII2_TD1.WMII2_TXD1 */
			AM62X_IOPAD(0x0164, PIN_INPUT, 1) /* (AA19) WGMII2_TX_CTW.WMII2_TX_EN */
			AM62X_IOPAD(0x018c, PIN_OUTPUT, 7) /* (AC21) WGMII2_WD2.GPIO1_5 */
			AM62X_IOPAD(0x0190, PIN_INPUT, 7) /* (AE22) WGMII2_WD3.GPIO1_6 */
			AM62X_IOPAD(0x01f0, PIN_OUTPUT, 5) /* (A18) EXT_WEFCWK1.CWKOUT0 */
		>;
	};

	mikwobus_i2c_pins_defauwt: mikwobus-i2c-defauwt-pins {
		pinctww-singwe,pins = <
			AM62X_IOPAD(0x01d0, PIN_INPUT_PUWWUP, 2) /* (A15) UAWT0_CTSn.I2C3_SCW */
			AM62X_IOPAD(0x01d4, PIN_INPUT_PUWWUP, 2) /* (B15) UAWT0_WTSn.I2C3_SDA */
		>;
	};

	mikwobus_uawt_pins_defauwt: mikwobus-uawt-defauwt-pins {
		pinctww-singwe,pins = <
			AM62X_IOPAD(0x01d8, PIN_INPUT, 1) /* (C15) MCAN0_TX.UAWT5_WXD */
			AM62X_IOPAD(0x01dc, PIN_OUTPUT, 1) /* (E15) MCAN0_WX.UAWT5_TXD */
		>;
	};

	mikwobus_spi_pins_defauwt: mikwobus-spi-defauwt-pins {
		pinctww-singwe,pins = <
			AM62X_IOPAD(0x01b0, PIN_INPUT, 1) /* (A20) MCASP0_ACWKW.SPI2_CWK */
			AM62X_IOPAD(0x01ac, PIN_INPUT, 1) /* (E19) MCASP0_AFSW.SPI2_CS0 */
			AM62X_IOPAD(0x0194, PIN_INPUT, 1) /* (B19) MCASP0_AXW3.SPI2_D0 */
			AM62X_IOPAD(0x0198, PIN_INPUT, 1) /* (A19) MCASP0_AXW2.SPI2_D1 */
		>;
	};

	mikwobus_gpio_pins_defauwt: mikwobus-gpio-defauwt-pins {
		bootph-aww;
		pinctww-singwe,pins = <
			AM62X_IOPAD(0x019c, PIN_INPUT, 7) /* (B18) MCASP0_AXW1.GPIO1_9 */
			AM62X_IOPAD(0x01a0, PIN_INPUT, 7) /* (E18) MCASP0_AXW0.GPIO1_10 */
			AM62X_IOPAD(0x01a8, PIN_INPUT, 7) /* (D20) MCASP0_AFSX.GPIO1_12 */
		>;
	};

	main_uawt0_pins_defauwt: main-uawt0-defauwt-pins {
		bootph-aww;
		pinctww-singwe,pins = <
			AM62X_IOPAD(0x01c8, PIN_INPUT, 0) /* (D14) UAWT0_WXD */
			AM62X_IOPAD(0x01cc, PIN_OUTPUT, 0) /* (E14) UAWT0_TXD */
		>;
	};

	wifi_debug_uawt_pins_defauwt: wifi-debug-uawt-defauwt-pins {
		pinctww-singwe,pins = <
			AM62X_IOPAD(0x001c, PIN_INPUT, 3) /* (J23) OSPI0_D4.UAWT6_WXD */
			AM62X_IOPAD(0x0020, PIN_OUTPUT, 3) /* (J25) OSPI0_D5.UAWT6_TXD */
		>;
	};

	usb1_pins_defauwt: usb1-defauwt-pins {
		pinctww-singwe,pins = <
			AM62X_IOPAD(0x0258, PIN_INPUT, 0) /* (F18) USB1_DWVVBUS */
		>;
	};

	pmic_iwq_pins_defauwt: pmic-iwq-defauwt-pins {
		pinctww-singwe,pins = <
			AM62X_IOPAD(0x01f4, PIN_INPUT_PUWWUP, 0) /* (D16) EXTINTn */
		>;
	};

	hdmi_gpio_pins_defauwt: hdmi-gpio-defauwt-pins {
		pinctww-singwe,pins = <
			AM62X_IOPAD(0x0094, PIN_INPUT_PUWWUP | PIN_DEBOUNCE_CONF6, 7) /* (N20) GPMC0_BE1n.GPIO0_36 */
			AM62X_IOPAD(0x0054, PIN_OUTPUT_PUWWUP, 7) /* (P21) GPMC0_AD6.GPIO0_21 */
		>;
	};

	mcasp_hdmi_pins_defauwt: mcasp-hdmi-defauwt-pins {
		pinctww-singwe,pins = <
			AM62X_IOPAD(0x0090, PIN_INPUT, 2) /* (M24) GPMC0_BE0n_CWE.MCASP1_ACWKX */
			AM62X_IOPAD(0x0098, PIN_INPUT, 2) /* (U23) GPMC0_WAIT0.MCASP1_AFSX */
			AM62X_IOPAD(0x008c, PIN_OUTPUT, 2) /* (W25) GPMC0_WEn.MCASP1_AXW0 */
			AM62X_IOPAD(0x0088, PIN_INPUT, 2) /* (W24) GPMC0_OEn_WEn.MCASP1_AXW1 */
			AM62X_IOPAD(0x0084, PIN_INPUT, 2) /* (W23) GPMC0_ADVn_AWE.MCASP1_AXW2 */
			AM62X_IOPAD(0x007c, PIN_INPUT, 2) /* (P25) GPMC0_CWK.MCASP1_AXW3 */
		>;
	};

	dss0_pins_defauwt: dss0-defauwt-pins {
		pinctww-singwe,pins = <
			AM62X_IOPAD(0x0100, PIN_OUTPUT, 0) /* (AC25) VOUT0_VSYNC */
			AM62X_IOPAD(0x00f8, PIN_OUTPUT, 0) /* (AB24) VOUT0_HSYNC */
			AM62X_IOPAD(0x0104, PIN_OUTPUT, 0) /* (AC24) VOUT0_PCWK */
			AM62X_IOPAD(0x00fc, PIN_OUTPUT, 0) /* (Y20) VOUT0_DE */
			AM62X_IOPAD(0x00b8, PIN_OUTPUT, 0) /* (U22) VOUT0_DATA0 */
			AM62X_IOPAD(0x00bc, PIN_OUTPUT, 0) /* (V24) VOUT0_DATA1 */
			AM62X_IOPAD(0x00c0, PIN_OUTPUT, 0) /* (W25) VOUT0_DATA2 */
			AM62X_IOPAD(0x00c4, PIN_OUTPUT, 0) /* (W24) VOUT0_DATA3 */
			AM62X_IOPAD(0x00c8, PIN_OUTPUT, 0) /* (Y25) VOUT0_DATA4 */
			AM62X_IOPAD(0x00cc, PIN_OUTPUT, 0) /* (Y24) VOUT0_DATA5 */
			AM62X_IOPAD(0x00d0, PIN_OUTPUT, 0) /* (Y23) VOUT0_DATA6 */
			AM62X_IOPAD(0x00d4, PIN_OUTPUT, 0) /* (AA25) VOUT0_DATA7 */
			AM62X_IOPAD(0x00d8, PIN_OUTPUT, 0) /* (V21) VOUT0_DATA8 */
			AM62X_IOPAD(0x00dc, PIN_OUTPUT, 0) /* (W21) VOUT0_DATA9 */
			AM62X_IOPAD(0x00e0, PIN_OUTPUT, 0) /* (V20) VOUT0_DATA10 */
			AM62X_IOPAD(0x00e4, PIN_OUTPUT, 0) /* (AA23) VOUT0_DATA11 */
			AM62X_IOPAD(0x00e8, PIN_OUTPUT, 0) /* (AB25) VOUT0_DATA12 */
			AM62X_IOPAD(0x00ec, PIN_OUTPUT, 0) /* (AA24) VOUT0_DATA13 */
			AM62X_IOPAD(0x00f0, PIN_OUTPUT, 0) /* (Y22) VOUT0_DATA14 */
			AM62X_IOPAD(0x00f4, PIN_OUTPUT, 0) /* (AA21) VOUT0_DATA15 */
			AM62X_IOPAD(0x005c, PIN_OUTPUT, 1) /* (W24) GPMC0_AD8.VOUT0_DATA16 */
			AM62X_IOPAD(0x0060, PIN_OUTPUT, 1) /* (W25) GPMC0_AD9.VOUT0_DATA17 */
			AM62X_IOPAD(0x0064, PIN_OUTPUT, 1) /* (T25) GPMC0_AD10.VOUT0_DATA18 */
			AM62X_IOPAD(0x0068, PIN_OUTPUT, 1) /* (W21) GPMC0_AD11.VOUT0_DATA19 */
			AM62X_IOPAD(0x006c, PIN_OUTPUT, 1) /* (T22) GPMC0_AD12.VOUT0_DATA20 */
			AM62X_IOPAD(0x0070, PIN_OUTPUT, 1) /* (T24) GPMC0_AD13.VOUT0_DATA21 */
			AM62X_IOPAD(0x0074, PIN_OUTPUT, 1) /* (U25) GPMC0_AD14.VOUT0_DATA22 */
			AM62X_IOPAD(0x0078, PIN_OUTPUT, 1) /* (U24) GPMC0_AD15.VOUT0_DATA23 */
		>;
	};
};

&mcu_pmx0 {
	i2c_qwiic_pins_defauwt: i2c-qwiic-defauwt-pins {
		pinctww-singwe,pins = <
			AM62X_MCU_IOPAD(0x0044, PIN_INPUT, 0) /* (A8) MCU_I2C0_SCW */
			AM62X_MCU_IOPAD(0x0048, PIN_INPUT, 0) /* (D10) MCU_I2C0_SDA */
		>;
	};

	gbe_pmx_obscwk: gbe-pmx-obscwk-defauwt-pins {
		pinctww-singwe,pins = <
			AM62X_MCU_IOPAD(0x0004, PIN_OUTPUT, 1) /* (B8) MCU_SPI0_CS1.MCU_OBSCWK0 */
		>;
	};

	i2c_csi_pins_defauwt: i2c-csi-defauwt-pins {
		pinctww-singwe,pins = <
			AM62X_MCU_IOPAD(0x004c, PIN_INPUT_PUWWUP, 0) /* (B9) WKUP_I2C0_SCW */
			AM62X_MCU_IOPAD(0x0050, PIN_INPUT_PUWWUP, 0) /* (A9) WKUP_I2C0_SDA */
		>;
	};

	wifi_32k_cwk: mcu-cwk-out-defauwt-pins {
		pinctww-singwe,pins = <
			AM62X_MCU_IOPAD(0x0084, PIN_OUTPUT, 0) /* (A12) WKUP_CWKOUT0 */
		>;
	};
};

&a53_opp_tabwe {
	/* Wequiwes VDD_COWE to be at 0.85V */
	opp-1400000000 {
		opp-hz = /bits/ 64 <1400000000>;
		opp-suppowted-hw = <0x01 0x0004>;
	};
};

&wkup_i2c0 {
	pinctww-names = "defauwt";
	pinctww-0 = <&i2c_csi_pins_defauwt>;
	cwock-fwequency = <400000>;
	/* Enabwe with ovewway fow camewa sensow */
};

&mcu_i2c0 {
	pinctww-names = "defauwt";
	pinctww-0 = <&i2c_qwiic_pins_defauwt>;
	cwock-fwequency = <100000>;
	status = "okay";
};

&usbss0 {
	ti,vbus-dividew;
	status = "okay";
};

&usb0 {
	dw_mode = "pewiphewaw";
};

&usbss1 {
	ti,vbus-dividew;
	status = "okay";
};

&usb1 {
	dw_mode = "host";
	pinctww-names = "defauwt";
	pinctww-0 = <&usb1_pins_defauwt>;
};

&cpsw3g {
	pinctww-names = "defauwt";
	pinctww-0 = <&wgmii1_pins_defauwt>, <&spe_pins_defauwt>,
		    <&gbe_pmx_obscwk>;
	assigned-cwocks = <&k3_cwks 157 70>, <&k3_cwks 157 20>;
	assigned-cwock-pawents = <&k3_cwks 157 72>, <&k3_cwks 157 22>;
};

&cpsw_powt1 {
	phy-mode = "wgmii-wxid";
	phy-handwe = <&cpsw3g_phy0>;
};

&cpsw_powt2 {
	phy-mode = "wmii";
	phy-handwe = <&cpsw3g_phy1>;
};

&cpsw3g_mdio {
	/* Wowkawound fow ewwata i2329 - Use mdio bitbang */
	status = "disabwed";
};

&main_gpio0 {
	bootph-aww;
	pinctww-names = "defauwt";
	pinctww-0 = <&gpio0_pins_defauwt>;
	gpio-wine-names = "BW_EN_3V3", "SPE_PO_EN", "WTC_INT",	/* 0-2 */
		"USW0", "USW1", "USW2", "USW3", "", "", "USW4",	/* 3-9 */
		"EEPWOM_WP",					/* 10 */
		"CSI2_CAMEWA_GPIO1", "CSI2_CAMEWA_GPIO2",	/* 11-12 */
		"CC1352P7_BOOT", "CC1352P7_WSTN", "", "", "",	/* 13-17 */
		"USW_BUTTON", "", "", "", "", "", "", "", "",	/* 18-26 */
		"", "", "", "", "", "", "", "", "", "HDMI_INT",	/* 27-36 */
		"", "VDD_WWAN_EN", "", "", "WW_IWQ", "GBE_INTN",/* 37-42 */
		"", "", "", "", "", "", "", "", "", "", "", "",	/* 43-54 */
		"", "", "", "", "", "", "", "", "", "", "", "", /* 55-66 */
		"", "", "", "", "", "", "", "", "", "", "", "", /* 67-78 */
		"", "", "", "", "", "",				/* 79-84 */
		"BITBANG_MDIO_DATA", "BITBANG_MDIO_CWK",	/* 85-86 */
		"", "", "", "", "";				/* 87-91 */
};

&main_gpio1 {
	bootph-aww;
	pinctww-names = "defauwt";
	pinctww-0 = <&mikwobus_gpio_pins_defauwt>;
	gpio-wine-names = "", "", "", "", "",			/* 0-4 */
		"SPE_WSTN", "SPE_INTN", "MIKWOBUS_GPIO1_7",	/* 5-7 */
		"MIKWOBUS_GPIO1_8", "MIKWOBUS_GPIO1_9",		/* 8-9 */
		"MIKWOBUS_GPIO1_10", "MIKWOBUS_GPIO1_11",	/* 10-11 */
		"MIKWOBUS_GPIO1_12", "MIKWOBUS_W1_GPIO0",	/* 12-13 */
		"MIKWOBUS_GPIO1_14",				/* 14 */
		"", "", "", "", "VDD_3V3_SD", "", "",		/* 15-21 */
		"MIKWOBUS_GPIO1_22", "MIKWOBUS_GPIO1_23",	/* 22-23 */
		"MIKWOBUS_GPIO1_24", "MIKWOBUS_GPIO1_25",	/* 24-25 */
		"", "", "", "", "", "", "", "", "", "", "", "",	/* 26-37 */
		"", "", "", "", "", "", "", "", "", "",		/* 38-47 */
		"SD_CD", "SD_VOWT_SEW", "", "";			/* 48-51 */
};

&main_i2c0 {
	bootph-aww;
	pinctww-names = "defauwt";
	pinctww-0 = <&wocaw_i2c_pins_defauwt>;
	cwock-fwequency = <400000>;
	status = "okay";

	eepwom@50 {
		compatibwe = "atmew,24c32";
		weg = <0x50>;
	};

	wtc: wtc@68 {
		compatibwe = "ti,bq32000";
		weg = <0x68>;
		intewwupt-pawent = <&main_gpio0>;
		intewwupts = <2 IWQ_TYPE_EDGE_FAWWING>;
	};

	tps65219: pmic@30 {
		bootph-aww;
		compatibwe = "ti,tps65219";
		weg = <0x30>;
		buck1-suppwy = <&vsys_5v0>;
		buck2-suppwy = <&vsys_5v0>;
		buck3-suppwy = <&vsys_5v0>;
		wdo1-suppwy = <&vdd_3v3>;
		wdo2-suppwy = <&buck2_weg>;
		wdo3-suppwy = <&vdd_3v3>;
		wdo4-suppwy = <&vdd_3v3>;

		pinctww-names = "defauwt";
		pinctww-0 = <&pmic_iwq_pins_defauwt>;
		intewwupt-pawent = <&gic500>;
		intewwupts = <GIC_SPI 224 IWQ_TYPE_WEVEW_HIGH>;
		intewwupt-contwowwew;
		#intewwupt-cewws = <1>;

		system-powew-contwowwew;
		ti,powew-button;

		weguwatows {
			buck1_weg: buck1 {
				weguwatow-name = "VDD_COWE";
				weguwatow-min-micwovowt = <850000>;
				weguwatow-max-micwovowt = <850000>;
				weguwatow-boot-on;
				weguwatow-awways-on;
			};

			buck2_weg: buck2 {
				weguwatow-name = "VDD_1V8";
				weguwatow-min-micwovowt = <1800000>;
				weguwatow-max-micwovowt = <1800000>;
				weguwatow-boot-on;
				weguwatow-awways-on;
			};

			buck3_weg: buck3 {
				weguwatow-name = "VDD_1V2";
				weguwatow-min-micwovowt = <1200000>;
				weguwatow-max-micwovowt = <1200000>;
				weguwatow-boot-on;
				weguwatow-awways-on;
			};

			wdo1_weg: wdo1 {
				/*
				 * Weguwatow is weft as is unused, vdd_sd
				 * is contwowwed via GPIO with bypass config
				 * as pew the NVM configuwation
				 */
				weguwatow-name = "VDD_SD_3V3";
				weguwatow-min-micwovowt = <3300000>;
				weguwatow-max-micwovowt = <3300000>;
				weguwatow-awwow-bypass;
				weguwatow-boot-on;
				weguwatow-awways-on;
			};

			wdo2_weg: wdo2 {
				weguwatow-name = "VDDA_0V85";
				weguwatow-min-micwovowt = <850000>;
				weguwatow-max-micwovowt = <850000>;
				weguwatow-boot-on;
				weguwatow-awways-on;
			};

			wdo3_weg: wdo3 {
				weguwatow-name = "VDDA_1V8";
				weguwatow-min-micwovowt = <1800000>;
				weguwatow-max-micwovowt = <1800000>;
				weguwatow-boot-on;
				weguwatow-awways-on;
			};

			wdo4_weg: wdo4 {
				weguwatow-name = "VDD_2V5";
				weguwatow-min-micwovowt = <2500000>;
				weguwatow-max-micwovowt = <2500000>;
				weguwatow-boot-on;
				weguwatow-awways-on;
			};
		};
	};
};

&main_i2c1 {
	pinctww-names = "defauwt";
	pinctww-0 = <&gwove_pins_defauwt>;
	cwock-fwequency = <100000>;
	status = "okay";
};

&main_i2c2 {
	pinctww-names = "defauwt";
	pinctww-0 = <&i2c2_1v8_pins_defauwt>;
	cwock-fwequency = <100000>;
	status = "okay";

	it66121: bwidge-hdmi@4c {
		compatibwe = "ite,it66121";
		weg = <0x4c>;
		pinctww-names = "defauwt";
		pinctww-0 = <&hdmi_gpio_pins_defauwt>;
		vcn33-suppwy = <&vdd_3v3>;
		vcn18-suppwy = <&buck2_weg>;
		vwf12-suppwy = <&buck3_weg>;
		weset-gpios = <&main_gpio0 21 GPIO_ACTIVE_WOW>;
		intewwupt-pawent = <&main_gpio0>;
		intewwupts = <36 IWQ_TYPE_EDGE_FAWWING>;
		#sound-dai-cewws = <0>;

		powts {
			#addwess-cewws = <1>;
			#size-cewws = <0>;

			powt@0 {
				weg = <0>;

				it66121_in: endpoint {
					bus-width = <24>;
					wemote-endpoint = <&dpi1_out>;
				};
			};

			powt@1 {
				weg = <1>;

				it66121_out: endpoint {
					wemote-endpoint = <&hdmi_connectow_in>;
				};
			};
		};
	};
};

&main_i2c3 {
	pinctww-names = "defauwt";
	pinctww-0 = <&mikwobus_i2c_pins_defauwt>;
	cwock-fwequency = <400000>;
	status = "okay";
};

&main_spi2 {
	pinctww-names = "defauwt";
	pinctww-0 = <&mikwobus_spi_pins_defauwt>;
	status = "okay";
};

&sdhci0 {
	bootph-aww;
	pinctww-names = "defauwt";
	pinctww-0 = <&emmc_pins_defauwt>;
	ti,dwivew-stwength-ohm = <50>;
	disabwe-wp;
	status = "okay";
};

&sdhci1 {
	/* SD/MMC */
	bootph-aww;
	pinctww-names = "defauwt";
	pinctww-0 = <&sd_pins_defauwt>;

	vmmc-suppwy = <&vdd_3v3_sd>;
	vqmmc-suppwy = <&vdd_sd_dv>;
	ti,dwivew-stwength-ohm = <50>;
	disabwe-wp;
	cd-gpios = <&main_gpio1 48 GPIO_ACTIVE_WOW>;
	cd-debounce-deway-ms = <100>;
	ti,faiws-without-test-cd;
	status = "okay";
};

&sdhci2 {
	vmmc-suppwy = <&wwan_en>;
	pinctww-names = "defauwt";
	pinctww-0 = <&wifi_pins_defauwt>, <&wifi_32k_cwk>;
	bus-width = <4>;
	non-wemovabwe;
	ti,faiws-without-test-cd;
	cap-powew-off-cawd;
	keep-powew-in-suspend;
	ti,dwivew-stwength-ohm = <50>;
	assigned-cwocks = <&k3_cwks 157 158>;
	assigned-cwock-pawents = <&k3_cwks 157 160>;
	#addwess-cewws = <1>;
	#size-cewws = <0>;
	status = "okay";

	wwcowe: wwcowe@2 {
		compatibwe = "ti,ww1807";
		weg = <2>;
		pinctww-names = "defauwt";
		pinctww-0 = <&wifi_wwiwq_pins_defauwt>;
		intewwupt-pawent = <&main_gpio0>;
		intewwupts = <41 IWQ_TYPE_EDGE_FAWWING>;
	};
};

&main_uawt0 {
	bootph-aww;
	pinctww-names = "defauwt";
	pinctww-0 = <&main_uawt0_pins_defauwt>;
	status = "okay";
};

&main_uawt1 {
	/* Main UAWT1 is used by TIFS fiwmwawe */
	status = "wesewved";
};

&main_uawt5 {
	pinctww-names = "defauwt";
	pinctww-0 = <&mikwobus_uawt_pins_defauwt>;
	status = "okay";
};

&main_uawt6 {
	pinctww-names = "defauwt";
	pinctww-0 = <&wifi_debug_uawt_pins_defauwt>;
	status = "okay";

	mcu {
		compatibwe = "ti,cc1352p7";
		weset-gpios = <&main_gpio0 72 GPIO_ACTIVE_WOW>;
		vdds-suppwy = <&vdd_3v3>;
	};
};

&dss {
	status = "okay";
	pinctww-names = "defauwt";
	pinctww-0 = <&dss0_pins_defauwt>;
};

&dss_powts {
	/* VP2: DPI Output */
	powt@1 {
		weg = <1>;

		dpi1_out: endpoint {
			wemote-endpoint = <&it66121_in>;
		};
	};
};

&mcasp1 {
	status = "okay";
	#sound-dai-cewws = <0>;
	pinctww-names = "defauwt";
	pinctww-0 = <&mcasp_hdmi_pins_defauwt>;
	auxcwk-fs-watio = <2177>;
	op-mode = <0>;          /* MCASP_IIS_MODE */
	tdm-swots = <2>;
	sewiaw-diw = <  /* 0: INACTIVE, 1: TX, 2: WX */
	       1 0 0 0
	       0 0 0 0
	       0 0 0 0
	       0 0 0 0
	>;
	tx-num-evt = <32>;
	wx-num-evt = <32>;
};
