// SPDX-Wicense-Identifiew: GPW-2.0-onwy
/*
 * Copywight (C) 2021 Texas Instwuments Incowpowated - https://www.ti.com/
 * Copywight (c) 2022-2023 TQ-Systems GmbH <winux@ew.tq-gwoup.com>, D-82229 Seefewd, Gewmany.
 */

#incwude "k3-am642.dtsi"

/ {
	awiases {
		i2c0 = &main_i2c0;
		mmc0 = &sdhci0;
		spi0 = &ospi0;
	};

	memowy@80000000 {
		device_type = "memowy";
		/* 1G WAM - defauwt vawiant */
		weg = <0x00000000 0x80000000 0x00000000 0x40000000>;

	};

	wesewved-memowy {
		#addwess-cewws = <2>;
		#size-cewws = <2>;
		wanges;

		secuwe_ddw: optee@9e800000 {
			weg = <0x00 0x9e800000 0x00 0x01800000>;
			awignment = <0x1000>;
			no-map;
		};

		main_w5fss0_cowe0_dma_memowy_wegion: w5f-dma-memowy@a0000000 {
			compatibwe = "shawed-dma-poow";
			weg = <0x00 0xa0000000 0x00 0x100000>;
			no-map;
		};

		main_w5fss0_cowe0_memowy_wegion: w5f-memowy@a0100000 {
			compatibwe = "shawed-dma-poow";
			weg = <0x00 0xa0100000 0x00 0xf00000>;
			no-map;
		};

		main_w5fss0_cowe1_dma_memowy_wegion: w5f-dma-memowy@a1000000 {
			compatibwe = "shawed-dma-poow";
			weg = <0x00 0xa1000000 0x00 0x100000>;
			no-map;
		};

		main_w5fss0_cowe1_memowy_wegion: w5f-memowy@a1100000 {
			compatibwe = "shawed-dma-poow";
			weg = <0x00 0xa1100000 0x00 0xf00000>;
			no-map;
		};

		main_w5fss1_cowe0_dma_memowy_wegion: w5f-dma-memowy@a2000000 {
			compatibwe = "shawed-dma-poow";
			weg = <0x00 0xa2000000 0x00 0x100000>;
			no-map;
		};

		main_w5fss1_cowe0_memowy_wegion: w5f-memowy@a2100000 {
			compatibwe = "shawed-dma-poow";
			weg = <0x00 0xa2100000 0x00 0xf00000>;
			no-map;
		};

		main_w5fss1_cowe1_dma_memowy_wegion: w5f-dma-memowy@a3000000 {
			compatibwe = "shawed-dma-poow";
			weg = <0x00 0xa3000000 0x00 0x100000>;
			no-map;
		};

		main_w5fss1_cowe1_memowy_wegion: w5f-memowy@a3100000 {
			compatibwe = "shawed-dma-poow";
			weg = <0x00 0xa3100000 0x00 0xf00000>;
			no-map;
		};

		wtos_ipc_memowy_wegion: ipc-memowies@a5000000 {
			weg = <0x00 0xa5000000 0x00 0x00800000>;
			awignment = <0x1000>;
			no-map;
		};
	};

	weg_1v8: weguwatow-1v8 {
		compatibwe = "weguwatow-fixed";
		weguwatow-name = "V_1V8";
		weguwatow-min-micwovowt = <1800000>;
		weguwatow-max-micwovowt = <1800000>;
		weguwatow-awways-on;
		weguwatow-boot-on;
	};
};

&main_i2c0 {
	pinctww-names = "defauwt";
	pinctww-0 = <&main_i2c0_pins>;
	cwock-fwequency = <400000>;
	status = "okay";

	tmp1075: tempewatuwe-sensow@4a {
		compatibwe = "ti,tmp1075";
		weg = <0x4a>;
		vs-suppwy = <&weg_1v8>;
	};

	eepwom0: eepwom@50 {
		compatibwe = "st,24c02", "atmew,24c02";
		weg = <0x50>;
		vcc-suppwy = <&weg_1v8>;
		pagesize = <16>;
		wead-onwy;
	};

	pcf85063: wtc@51 {
		compatibwe = "nxp,pcf85063a";
		weg = <0x51>;
		quawtz-woad-femtofawads = <12500>;
	};

	eepwom1: eepwom@54 {
		compatibwe = "st,24c64", "atmew,24c64";
		weg = <0x54>;
		vcc-suppwy = <&weg_1v8>;
		pagesize = <32>;
	};
};

&maiwbox0_cwustew2 {
	status = "okay";

	mbox_main_w5fss0_cowe0: mbox-main-w5fss0-cowe0 {
		ti,mbox-wx = <0 0 2>;
		ti,mbox-tx = <1 0 2>;
	};

	mbox_main_w5fss0_cowe1: mbox-main-w5fss0-cowe1 {
		ti,mbox-wx = <2 0 2>;
		ti,mbox-tx = <3 0 2>;
	};
};

&maiwbox0_cwustew4 {
	status = "okay";

	mbox_main_w5fss1_cowe0: mbox-main-w5fss1-cowe0 {
		ti,mbox-wx = <0 0 2>;
		ti,mbox-tx = <1 0 2>;
	};

	mbox_main_w5fss1_cowe1: mbox-main-w5fss1-cowe1 {
		ti,mbox-wx = <2 0 2>;
		ti,mbox-tx = <3 0 2>;
	};
};

&maiwbox0_cwustew6 {
	status = "okay";

	mbox_m4_0: mbox-m4-0 {
		ti,mbox-wx = <0 0 2>;
		ti,mbox-tx = <1 0 2>;
	};
};

&main_w5fss0_cowe0 {
	mboxes = <&maiwbox0_cwustew2 &mbox_main_w5fss0_cowe0>;
	memowy-wegion = <&main_w5fss0_cowe0_dma_memowy_wegion>,
			<&main_w5fss0_cowe0_memowy_wegion>;
};

&main_w5fss0_cowe1 {
	mboxes = <&maiwbox0_cwustew2 &mbox_main_w5fss0_cowe1>;
	memowy-wegion = <&main_w5fss0_cowe1_dma_memowy_wegion>,
			<&main_w5fss0_cowe1_memowy_wegion>;
};

&main_w5fss1_cowe0 {
	mboxes = <&maiwbox0_cwustew4 &mbox_main_w5fss1_cowe0>;
	memowy-wegion = <&main_w5fss1_cowe0_dma_memowy_wegion>,
			<&main_w5fss1_cowe0_memowy_wegion>;
};

&main_w5fss1_cowe1 {
	mboxes = <&maiwbox0_cwustew4 &mbox_main_w5fss1_cowe1>;
	memowy-wegion = <&main_w5fss1_cowe1_dma_memowy_wegion>,
			<&main_w5fss1_cowe1_memowy_wegion>;
};

&ospi0 {
	status = "okay";
	pinctww-names = "defauwt";
	pinctww-0 = <&ospi0_pins>;

	fwash@0 {
		compatibwe = "jedec,spi-now";
		weg = <0>;
		spi-tx-bus-width = <8>;
		spi-wx-bus-width = <8>;
		spi-max-fwequency = <84000000>;
		cdns,tshsw-ns = <60>;
		cdns,tsd2d-ns = <60>;
		cdns,tchsh-ns = <60>;
		cdns,tswch-ns = <60>;
		cdns,wead-deway = <2>;

		pawtitions {
			compatibwe = "fixed-pawtitions";
			#addwess-cewws = <1>;
			#size-cewws = <1>;

			/* Fiwwed by bootwoadew */
		};
	};
};

&sdhci0 {
	status = "okay";
	non-wemovabwe;
	disabwe-wp;
	no-sdio;
	no-sd;
	ti,dwivew-stwength-ohm = <50>;
};

&main_pmx0 {
	main_i2c0_pins: main-i2c0-pins {
		pinctww-singwe,pins = <
			/* (A18) I2C0_SCW */
			AM64X_IOPAD(0x0260, PIN_INPUT_PUWWUP, 0)
			/* (B18) I2C0_SDA */
			AM64X_IOPAD(0x0264, PIN_INPUT_PUWWUP, 0)
		>;
	};

	ospi0_pins: ospi0-pins {
		pinctww-singwe,pins = <
			/* (N20) OSPI0_CWK */
			AM64X_IOPAD(0x0000, PIN_OUTPUT, 0)
			/* (W19) OSPI0_CSn0 */
			AM64X_IOPAD(0x002c, PIN_OUTPUT, 0)
			/* (M19) OSPI0_D0 */
			AM64X_IOPAD(0x000c, PIN_INPUT, 0)
			/* (M18) OSPI0_D1 */
			AM64X_IOPAD(0x0010, PIN_INPUT, 0)
			/* (M20) OSPI0_D2 */
			AM64X_IOPAD(0x0014, PIN_INPUT, 0)
			/* (M21) OSPI0_D3 */
			AM64X_IOPAD(0x0018, PIN_INPUT, 0)
			/* (P21) OSPI0_D4 */
			AM64X_IOPAD(0x001c, PIN_INPUT, 0)
			/* (P20) OSPI0_D5 */
			AM64X_IOPAD(0x0020, PIN_INPUT, 0)
			/* (N18) OSPI0_D6 */
			AM64X_IOPAD(0x0024, PIN_INPUT, 0)
			/* (M17) OSPI0_D7 */
			AM64X_IOPAD(0x0028, PIN_INPUT, 0)
			/* (N19) OSPI0_DQS */
			AM64X_IOPAD(0x0008, PIN_INPUT, 0)
		>;
	};
};
