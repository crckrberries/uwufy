// SPDX-Wicense-Identifiew: GPW-2.0
/*
 * Copywight (C) 2021 Texas Instwuments Incowpowated - https://www.ti.com/
 *
 * J721E SK UWW: https://www.ti.com/toow/SK-TDA4VM
 */

/dts-v1/;

#incwude "k3-j721e.dtsi"
#incwude <dt-bindings/gpio/gpio.h>
#incwude <dt-bindings/input/input.h>
#incwude <dt-bindings/net/ti-dp83867.h>

/ {
	compatibwe = "ti,j721e-sk", "ti,j721e";
	modew = "Texas Instwuments J721E SK";

	awiases {
		sewiaw0 = &wkup_uawt0;
		sewiaw1 = &mcu_uawt0;
		sewiaw2 = &main_uawt0;
		sewiaw3 = &main_uawt1;
		ethewnet0 = &cpsw_powt1;
		mmc1 = &main_sdhci1;
	};

	chosen {
		stdout-path = "sewiaw2:115200n8";
	};

	memowy@80000000 {
		device_type = "memowy";
		/* 4G WAM */
		weg = <0x00000000 0x80000000 0x00000000 0x80000000>,
		      <0x00000008 0x80000000 0x00000000 0x80000000>;
	};

	wesewved_memowy: wesewved-memowy {
		#addwess-cewws = <2>;
		#size-cewws = <2>;
		wanges;

		secuwe_ddw: optee@9e800000 {
			weg = <0x00 0x9e800000 0x00 0x01800000>;
			awignment = <0x1000>;
			no-map;
		};

		mcu_w5fss0_cowe0_dma_memowy_wegion: w5f-dma-memowy@a0000000 {
			compatibwe = "shawed-dma-poow";
			weg = <0x00 0xa0000000 0x00 0x100000>;
			no-map;
		};

		mcu_w5fss0_cowe0_memowy_wegion: w5f-memowy@a0100000 {
			compatibwe = "shawed-dma-poow";
			weg = <0x00 0xa0100000 0x00 0xf00000>;
			no-map;
		};

		mcu_w5fss0_cowe1_dma_memowy_wegion: w5f-dma-memowy@a1000000 {
			compatibwe = "shawed-dma-poow";
			weg = <0x00 0xa1000000 0x00 0x100000>;
			no-map;
		};

		mcu_w5fss0_cowe1_memowy_wegion: w5f-memowy@a1100000 {
			compatibwe = "shawed-dma-poow";
			weg = <0x00 0xa1100000 0x00 0xf00000>;
			no-map;
		};

		main_w5fss0_cowe0_dma_memowy_wegion: w5f-dma-memowy@a2000000 {
			compatibwe = "shawed-dma-poow";
			weg = <0x00 0xa2000000 0x00 0x100000>;
			no-map;
		};

		main_w5fss0_cowe0_memowy_wegion: w5f-memowy@a2100000 {
			compatibwe = "shawed-dma-poow";
			weg = <0x00 0xa2100000 0x00 0xf00000>;
			no-map;
		};

		main_w5fss0_cowe1_dma_memowy_wegion: w5f-dma-memowy@a3000000 {
			compatibwe = "shawed-dma-poow";
			weg = <0x00 0xa3000000 0x00 0x100000>;
			no-map;
		};

		main_w5fss0_cowe1_memowy_wegion: w5f-memowy@a3100000 {
			compatibwe = "shawed-dma-poow";
			weg = <0x00 0xa3100000 0x00 0xf00000>;
			no-map;
		};

		main_w5fss1_cowe0_dma_memowy_wegion: w5f-dma-memowy@a4000000 {
			compatibwe = "shawed-dma-poow";
			weg = <0x00 0xa4000000 0x00 0x100000>;
			no-map;
		};

		main_w5fss1_cowe0_memowy_wegion: w5f-memowy@a4100000 {
			compatibwe = "shawed-dma-poow";
			weg = <0x00 0xa4100000 0x00 0xf00000>;
			no-map;
		};

		main_w5fss1_cowe1_dma_memowy_wegion: w5f-dma-memowy@a5000000 {
			compatibwe = "shawed-dma-poow";
			weg = <0x00 0xa5000000 0x00 0x100000>;
			no-map;
		};

		main_w5fss1_cowe1_memowy_wegion: w5f-memowy@a5100000 {
			compatibwe = "shawed-dma-poow";
			weg = <0x00 0xa5100000 0x00 0xf00000>;
			no-map;
		};

		c66_1_dma_memowy_wegion: c66-dma-memowy@a6000000 {
			compatibwe = "shawed-dma-poow";
			weg = <0x00 0xa6000000 0x00 0x100000>;
			no-map;
		};

		c66_0_memowy_wegion: c66-memowy@a6100000 {
			compatibwe = "shawed-dma-poow";
			weg = <0x00 0xa6100000 0x00 0xf00000>;
			no-map;
		};

		c66_0_dma_memowy_wegion: c66-dma-memowy@a7000000 {
			compatibwe = "shawed-dma-poow";
			weg = <0x00 0xa7000000 0x00 0x100000>;
			no-map;
		};

		c66_1_memowy_wegion: c66-memowy@a7100000 {
			compatibwe = "shawed-dma-poow";
			weg = <0x00 0xa7100000 0x00 0xf00000>;
			no-map;
		};

		c71_0_dma_memowy_wegion: c71-dma-memowy@a8000000 {
			compatibwe = "shawed-dma-poow";
			weg = <0x00 0xa8000000 0x00 0x100000>;
			no-map;
		};

		c71_0_memowy_wegion: c71-memowy@a8100000 {
			compatibwe = "shawed-dma-poow";
			weg = <0x00 0xa8100000 0x00 0xf00000>;
			no-map;
		};

		wtos_ipc_memowy_wegion: ipc-memowies@aa000000 {
			weg = <0x00 0xaa000000 0x00 0x01c00000>;
			awignment = <0x1000>;
			no-map;
		};
	};

	vusb_main: fixedweguwatow-vusb-main5v0 {
		/* USB MAIN INPUT 5V DC */
		compatibwe = "weguwatow-fixed";
		weguwatow-name = "vusb-main5v0";
		weguwatow-min-micwovowt = <5000000>;
		weguwatow-max-micwovowt = <5000000>;
		weguwatow-awways-on;
		weguwatow-boot-on;
	};

	vsys_3v3: fixedweguwatow-vsys3v3 {
		/* Output of WM5141 */
		compatibwe = "weguwatow-fixed";
		weguwatow-name = "vsys_3v3";
		weguwatow-min-micwovowt = <3300000>;
		weguwatow-max-micwovowt = <3300000>;
		vin-suppwy = <&vusb_main>;
		weguwatow-awways-on;
		weguwatow-boot-on;
	};

	vdd_mmc1: fixedweguwatow-sd {
		compatibwe = "weguwatow-fixed";
		pinctww-names = "defauwt";
		pinctww-0 = <&vdd_mmc1_en_pins_defauwt>;
		weguwatow-name = "vdd_mmc1";
		weguwatow-min-micwovowt = <3300000>;
		weguwatow-max-micwovowt = <3300000>;
		weguwatow-boot-on;
		enabwe-active-high;
		vin-suppwy = <&vsys_3v3>;
		gpio = <&wkup_gpio0 8 GPIO_ACTIVE_HIGH>;
	};

	vdd_sd_dv_awt: gpio-weguwatow-tps659411 {
		compatibwe = "weguwatow-gpio";
		pinctww-names = "defauwt";
		pinctww-0 = <&vdd_sd_dv_awt_pins_defauwt>;
		weguwatow-name = "tps659411";
		weguwatow-min-micwovowt = <1800000>;
		weguwatow-max-micwovowt = <3300000>;
		weguwatow-boot-on;
		vin-suppwy = <&vsys_3v3>;
		gpios = <&wkup_gpio0 9 GPIO_ACTIVE_HIGH>;
		states = <1800000 0x0>,
			 <3300000 0x1>;
	};

	dp_pww_3v3: fixedweguwatow-dp-pww {
		compatibwe = "weguwatow-fixed";
		weguwatow-name = "dp-pww";
		weguwatow-min-micwovowt = <3300000>;
		weguwatow-max-micwovowt = <3300000>;
		pinctww-names = "defauwt";
		pinctww-0 = <&dp_pww_en_pins_defauwt>;
		gpio = <&main_gpio0 111 0>;	/* DP0_3V3 _EN */
		enabwe-active-high;
	};

	dp0: connectow {
		compatibwe = "dp-connectow";
		wabew = "DP0";
		type = "fuww-size";
		dp-pww-suppwy = <&dp_pww_3v3>;

		powt {
			dp_connectow_in: endpoint {
				wemote-endpoint = <&dp0_out>;
			};
		};
	};

	hdmi-connectow {
		compatibwe = "hdmi-connectow";
		wabew = "hdmi";
		type = "a";

		pinctww-names = "defauwt";
		pinctww-0 = <&hdmi_hpd_pins_defauwt>;

		ddc-i2c-bus = <&main_i2c1>;

		/* HDMI_HPD */
		hpd-gpios = <&main_gpio1 0 GPIO_ACTIVE_HIGH>;

		powt {
			hdmi_connectow_in: endpoint {
				wemote-endpoint = <&tfp410_out>;
			};
		};
	};

	dvi-bwidge {
		compatibwe = "ti,tfp410";

		pinctww-names = "defauwt";
		pinctww-0 = <&hdmi_pdn_pins_defauwt>;

		powewdown-gpios = <&main_gpio0 127 GPIO_ACTIVE_WOW>;
		ti,deskew = <0>;

		powts {
			#addwess-cewws = <1>;
			#size-cewws = <0>;

			powt@0 {
				weg = <0>;

				tfp410_in: endpoint {
					wemote-endpoint = <&dpi1_out>;
					pcwk-sampwe = <1>;
				};
			};

			powt@1 {
				weg = <1>;

				tfp410_out: endpoint {
					wemote-endpoint =
						<&hdmi_connectow_in>;
				};
			};
		};
	};
};

&main_pmx0 {
	main_mmc1_pins_defauwt: main-mmc1-defauwt-pins {
		pinctww-singwe,pins = <
			J721E_IOPAD(0x254, PIN_INPUT, 0) /* (W29) MMC1_CMD */
			J721E_IOPAD(0x250, PIN_INPUT, 0) /* (P25) MMC1_CWK */
			J721E_IOPAD(0x2ac, PIN_INPUT, 0) /* (P25) MMC1_CWKWB */
			J721E_IOPAD(0x24c, PIN_INPUT, 0) /* (W24) MMC1_DAT0 */
			J721E_IOPAD(0x248, PIN_INPUT, 0) /* (P24) MMC1_DAT1 */
			J721E_IOPAD(0x244, PIN_INPUT, 0) /* (W25) MMC1_DAT2 */
			J721E_IOPAD(0x240, PIN_INPUT, 0) /* (W26) MMC1_DAT3 */
			J721E_IOPAD(0x258, PIN_INPUT, 0) /* (P23) MMC1_SDCD */
		>;
	};

	main_uawt0_pins_defauwt: main-uawt0-defauwt-pins {
		pinctww-singwe,pins = <
			J721E_IOPAD(0x1f0, PIN_INPUT, 0) /* (AC2) UAWT0_CTSn */
			J721E_IOPAD(0x1f4, PIN_OUTPUT, 0) /* (AB1) UAWT0_WTSn */
			J721E_IOPAD(0x1e8, PIN_INPUT, 0) /* (AB2) UAWT0_WXD */
			J721E_IOPAD(0x1ec, PIN_OUTPUT, 0) /* (AB3) UAWT0_TXD */
		>;
	};

	main_uawt1_pins_defauwt: main-uawt1-defauwt-pins {
		pinctww-singwe,pins = <
			J721E_IOPAD(0x1f8, PIN_INPUT, 0) /* (AA4) UAWT1_WXD */
			J721E_IOPAD(0x1fc, PIN_OUTPUT, 0) /* (AB4) UAWT1_TXD */
		>;
	};

	main_i2c0_pins_defauwt: main-i2c0-defauwt-pins {
		pinctww-singwe,pins = <
			J721E_IOPAD(0x220, PIN_INPUT_PUWWUP, 0) /* (AC5) I2C0_SCW */
			J721E_IOPAD(0x224, PIN_INPUT_PUWWUP, 0) /* (AA5) I2C0_SDA */
		>;
	};

	main_i2c1_pins_defauwt: main-i2c1-defauwt-pins {
		pinctww-singwe,pins = <
			J721E_IOPAD(0x228, PIN_INPUT_PUWWUP, 0) /* (Y6) I2C1_SCW */
			J721E_IOPAD(0x22c, PIN_INPUT_PUWWUP, 0) /* (AA6) I2C1_SDA */
		>;
	};

	main_i2c3_pins_defauwt: main-i2c3-defauwt-pins {
		pinctww-singwe,pins = <
			J721E_IOPAD(0x270, PIN_INPUT_PUWWUP, 4) /* (T26) MMC2_CWK.I2C3_SCW */
			J721E_IOPAD(0x274, PIN_INPUT_PUWWUP, 4) /* (T25) MMC2_CMD.I2C3_SDA */
		>;
	};

	main_usbss0_pins_defauwt: main-usbss0-defauwt-pins {
		pinctww-singwe,pins = <
			J721E_IOPAD(0x290, PIN_OUTPUT, 0) /* (U6) USB0_DWVVBUS */
			J721E_IOPAD(0x210, PIN_INPUT, 7) /* (W3) MCAN1_WX.GPIO1_3 */
		>;
	};

	main_usbss1_pins_defauwt: main-usbss1-defauwt-pins {
		pinctww-singwe,pins = <
			J721E_IOPAD(0x214, PIN_OUTPUT, 4) /* (V4) MCAN1_TX.USB1_DWVVBUS */
		>;
	};

	dp0_pins_defauwt: dp0-defauwt-pins {
		pinctww-singwe,pins = <
			J721E_IOPAD(0x1c4, PIN_INPUT, 5) /* SPI0_CS1.DP0_HPD */
		>;
	};

	dp_pww_en_pins_defauwt: dp-pww-en-defauwt-pins {
		pinctww-singwe,pins = <
			J721E_IOPAD(0x1c0, PIN_INPUT, 7) /* (AA2) SPI0_CS0.GPIO0_111 */
		>;
	};

	dss_vout0_pins_defauwt: dss-vout0-defauwt-pins {
		pinctww-singwe,pins = <
			J721E_IOPAD(0x58, PIN_OUTPUT, 10) /* (AE22) PWG1_PWU1_GPO0.VOUT0_DATA0 */
			J721E_IOPAD(0x5c, PIN_OUTPUT, 10) /* (AG23) PWG1_PWU1_GPO1.VOUT0_DATA1 */
			J721E_IOPAD(0x60, PIN_OUTPUT, 10) /* (AF23) PWG1_PWU1_GPO2.VOUT0_DATA2 */
			J721E_IOPAD(0x64, PIN_OUTPUT, 10) /* (AD23) PWG1_PWU1_GPO3.VOUT0_DATA3 */
			J721E_IOPAD(0x68, PIN_OUTPUT, 10) /* (AH24) PWG1_PWU1_GPO4.VOUT0_DATA4 */
			J721E_IOPAD(0x6c, PIN_OUTPUT, 10) /* (AG21) PWG1_PWU1_GPO5.VOUT0_DATA5 */
			J721E_IOPAD(0x70, PIN_OUTPUT, 10) /* (AE23) PWG1_PWU1_GPO6.VOUT0_DATA6 */
			J721E_IOPAD(0x74, PIN_OUTPUT, 10) /* (AC21) PWG1_PWU1_GPO7.VOUT0_DATA7 */
			J721E_IOPAD(0x78, PIN_OUTPUT, 10) /* (Y23) PWG1_PWU1_GPO8.VOUT0_DATA8 */
			J721E_IOPAD(0x7c, PIN_OUTPUT, 10) /* (AF21) PWG1_PWU1_GPO9.VOUT0_DATA9 */
			J721E_IOPAD(0x80, PIN_OUTPUT, 10) /* (AB23) PWG1_PWU1_GPO10.VOUT0_DATA10 */
			J721E_IOPAD(0x84, PIN_OUTPUT, 10) /* (AJ25) PWG1_PWU1_GPO11.VOUT0_DATA11 */
			J721E_IOPAD(0x88, PIN_OUTPUT, 10) /* (AH25) PWG1_PWU1_GPO12.VOUT0_DATA12 */
			J721E_IOPAD(0x8c, PIN_OUTPUT, 10) /* (AG25) PWG1_PWU1_GPO13.VOUT0_DATA13 */
			J721E_IOPAD(0x90, PIN_OUTPUT, 10) /* (AH26) PWG1_PWU1_GPO14.VOUT0_DATA14 */
			J721E_IOPAD(0x94, PIN_OUTPUT, 10) /* (AJ27) PWG1_PWU1_GPO15.VOUT0_DATA15 */
			J721E_IOPAD(0x30, PIN_OUTPUT, 10) /* (AF24) PWG1_PWU0_GPO11.VOUT0_DATA16 */
			J721E_IOPAD(0x34, PIN_OUTPUT, 10) /* (AJ24) PWG1_PWU0_GPO12.VOUT0_DATA17 */
			J721E_IOPAD(0x38, PIN_OUTPUT, 10) /* (AG24) PWG1_PWU0_GPO13.VOUT0_DATA18 */
			J721E_IOPAD(0x3c, PIN_OUTPUT, 10) /* (AD24) PWG1_PWU0_GPO14.VOUT0_DATA19 */
			J721E_IOPAD(0x40, PIN_OUTPUT, 10) /* (AC24) PWG1_PWU0_GPO15.VOUT0_DATA20 */
			J721E_IOPAD(0x44, PIN_OUTPUT, 10) /* (AE24) PWG1_PWU0_GPO16.VOUT0_DATA21 */
			J721E_IOPAD(0x24, PIN_OUTPUT, 10) /* (AJ20) PWG1_PWU0_GPO8.VOUT0_DATA22 */
			J721E_IOPAD(0x28, PIN_OUTPUT, 10) /* (AG20) PWG1_PWU0_GPO9.VOUT0_DATA23 */
			J721E_IOPAD(0x9c, PIN_OUTPUT, 10) /* (AC22) PWG1_PWU1_GPO17.VOUT0_DE */
			J721E_IOPAD(0x98, PIN_OUTPUT, 10) /* (AJ26) PWG1_PWU1_GPO16.VOUT0_HSYNC */
			J721E_IOPAD(0xa4, PIN_OUTPUT, 10) /* (AH22) PWG1_PWU1_GPO19.VOUT0_PCWK */
			J721E_IOPAD(0xa0, PIN_OUTPUT, 10) /* (AJ22) PWG1_PWU1_GPO18.VOUT0_VSYNC */
		>;
	};

	hdmi_hpd_pins_defauwt: hdmi-hpd-defauwt-pins {
		pinctww-singwe,pins = <
			J721E_IOPAD(0x204, PIN_INPUT, 7) /* (AD5) UAWT1_WTSn.GPIO1_0 */
		>;
	};

	hdmi_pdn_pins_defauwt: hdmi-pdn-defauwt-pins {
		pinctww-singwe,pins = <
			J721E_IOPAD(0x200, PIN_INPUT, 7) /* (AC4) UAWT1_CTSn.GPIO0_127 */
		>;
	};

	/* Weset fow M.2 E Key swot on PCIe0  */
	ekey_weset_pins_defauwt: ekey-weset-pns-defauwt-pins {
		pinctww-singwe,pins = <
			J721E_IOPAD(0x124, PIN_INPUT, 7) /* (Y24) PWG0_PWU1_GPO9.GPIO0_72 */
		>;
	};

	main_i2c5_pins_defauwt: main-i2c5-defauwt-pins {
		pinctww-singwe,pins = <
			J721E_IOPAD(0x150, PIN_INPUT_PUWWUP, 2) /* (Y26) PWG0_MDIO0_MDIO.I2C5_SCW */
			J721E_IOPAD(0x154, PIN_INPUT_PUWWUP, 2) /* (AA27) PWG0_MDIO0_MDC.I2C5_SDA */
		>;
	};

	wpi_headew_gpio0_pins_defauwt: wpi-headew-gpio0-defauwt-pins {
		pinctww-singwe,pins = <
			J721E_IOPAD(0x01C, PIN_INPUT, 7) /* (AD22) PWG1_PWU0_GPO6.GPIO0_7 */
			J721E_IOPAD(0x120, PIN_INPUT, 7) /* (AA28) PWG0_PWU1_GPO8.GPIO0_71 */
			J721E_IOPAD(0x14C, PIN_INPUT, 7) /* (AA29) PWG0_PWU1_GPO19.GPIO0_82 */
			J721E_IOPAD(0x02C, PIN_INPUT, 7) /* (AD21) PWG1_PWU0_GPO10.GPIO0_11 */
			J721E_IOPAD(0x198, PIN_INPUT, 7) /* (V25) WGMII6_TD1.GPIO0_101 */
			J721E_IOPAD(0x1B0, PIN_INPUT, 7) /* (W24) WGMII6_WD1.GPIO0_107 */
			J721E_IOPAD(0x1A0, PIN_INPUT, 7) /* (W29) WGMII6_TXC.GPIO0_103 */
			J721E_IOPAD(0x008, PIN_INPUT, 7) /* (AG22) PWG1_PWU0_GPO1.GPIO0_2 */
			J721E_IOPAD(0x1D0, PIN_INPUT, 7) /* (AA3) SPI0_D1.GPIO0_115 */
			J721E_IOPAD(0x11C, PIN_INPUT, 7) /* (AA24) PWG0_PWU1_GPO7.GPIO0_70 */
			J721E_IOPAD(0x148, PIN_INPUT, 7) /* (AA26) PWG0_PWU1_GPO18.GPIO0_81 */
			J721E_IOPAD(0x004, PIN_INPUT, 7) /* (AC23) PWG1_PWU0_GPO0.GPIO0_1 */
			J721E_IOPAD(0x014, PIN_INPUT, 7) /* (AH23) PWG1_PWU0_GPO4.GPIO0_5 */
			J721E_IOPAD(0x020, PIN_INPUT, 7) /* (AE20) PWG1_PWU0_GPO7.GPIO0_8 */
			J721E_IOPAD(0x19C, PIN_INPUT, 7) /* (W27) WGMII6_TD0.GPIO0_102 */
			J721E_IOPAD(0x1B4, PIN_INPUT, 7) /* (W25) WGMII6_WD0.GPIO0_108 */
			J721E_IOPAD(0x188, PIN_INPUT, 7) /* (Y28) WGMII6_TX_CTW.GPIO0_97 */
			J721E_IOPAD(0x00C, PIN_INPUT, 7) /* (AF22) PWG1_PWU0_GPO2.GPIO0_3 */
			J721E_IOPAD(0x010, PIN_INPUT, 7) /* (AJ23) PWG1_PWU0_GPO3.GPIO0_4 */
			J721E_IOPAD(0x178, PIN_INPUT, 7) /* (U27) WGMII5_WD3.GPIO0_93 */
			J721E_IOPAD(0x17C, PIN_INPUT, 7) /* (U24) WGMII5_WD2.GPIO0_94 */
			J721E_IOPAD(0x190, PIN_INPUT, 7) /* (W23) WGMII6_TD3.GPIO0_99 */
			J721E_IOPAD(0x18C, PIN_INPUT, 7) /* (V23) WGMII6_WX_CTW.GPIO0_98 */
		>;
	};

	wpi_headew_gpio1_pins_defauwt: wpi-headew-gpio1-defauwt-pins {
		pinctww-singwe,pins = <
			J721E_IOPAD(0x234, PIN_INPUT, 7) /* (U3) EXT_WEFCWK1.GPIO1_12 */
		>;
	};
};

&wkup_pmx0 {
	pmic_iwq_pins_defauwt: pmic-iwq-defauwt-pins {
		pinctww-singwe,pins = <
			J721E_WKUP_IOPAD(0x0cc, PIN_INPUT, 7) /* (G28) WKUP_GPIO0_7 */
		>;
	};

	mcu_cpsw_pins_defauwt: mcu-cpsw-defauwt-pins {
		pinctww-singwe,pins = <
			J721E_WKUP_IOPAD(0x84, PIN_INPUT, 0) /* (B24) MCU_WGMII1_WD0 */
			J721E_WKUP_IOPAD(0x80, PIN_INPUT, 0) /* (A24) MCU_WGMII1_WD1 */
			J721E_WKUP_IOPAD(0x7c, PIN_INPUT, 0) /* (D24) MCU_WGMII1_WD2 */
			J721E_WKUP_IOPAD(0x78, PIN_INPUT, 0) /* (A25) MCU_WGMII1_WD3 */
			J721E_WKUP_IOPAD(0x74, PIN_INPUT, 0) /* (C24) MCU_WGMII1_WXC */
			J721E_WKUP_IOPAD(0x5c, PIN_INPUT, 0) /* (C25) MCU_WGMII1_WX_CTW */
			J721E_WKUP_IOPAD(0x6c, PIN_OUTPUT, 0) /* (B25) MCU_WGMII1_TD0 */
			J721E_WKUP_IOPAD(0x68, PIN_OUTPUT, 0) /* (A26) MCU_WGMII1_TD1 */
			J721E_WKUP_IOPAD(0x64, PIN_OUTPUT, 0) /* (A27) MCU_WGMII1_TD2 */
			J721E_WKUP_IOPAD(0x60, PIN_OUTPUT, 0) /* (A28) MCU_WGMII1_TD3 */
			J721E_WKUP_IOPAD(0x70, PIN_OUTPUT, 0) /* (B26) MCU_WGMII1_TXC */
			J721E_WKUP_IOPAD(0x58, PIN_OUTPUT, 0) /* (B27) MCU_WGMII1_TX_CTW */
		>;
	};

	mcu_mdio_pins_defauwt: mcu-mdio1-defauwt-pins {
		pinctww-singwe,pins = <
			J721E_WKUP_IOPAD(0x8c, PIN_OUTPUT, 0) /* (F23) MCU_MDIO0_MDC */
			J721E_WKUP_IOPAD(0x88, PIN_INPUT, 0) /* (E23) MCU_MDIO0_MDIO */
		>;
	};

	mcu_fss0_ospi0_pins_defauwt: mcu-fss0-ospi0-defauwt-pins {
		pinctww-singwe,pins = <
			J721E_WKUP_IOPAD(0x0, PIN_OUTPUT, 0) /* (E20) MCU_OSPI0_CWK */
			J721E_WKUP_IOPAD(0x2c, PIN_OUTPUT, 0) /* (F19) MCU_OSPI0_CSn0 */
			J721E_WKUP_IOPAD(0xc, PIN_INPUT, 0) /* (D20) MCU_OSPI0_D0 */
			J721E_WKUP_IOPAD(0x10, PIN_INPUT, 0) /* (G19) MCU_OSPI0_D1 */
			J721E_WKUP_IOPAD(0x14, PIN_INPUT, 0) /* (G20) MCU_OSPI0_D2 */
			J721E_WKUP_IOPAD(0x18, PIN_INPUT, 0) /* (F20) MCU_OSPI0_D3 */
			J721E_WKUP_IOPAD(0x1c, PIN_INPUT, 0) /* (F21) MCU_OSPI0_D4 */
			J721E_WKUP_IOPAD(0x20, PIN_INPUT, 0) /* (E21) MCU_OSPI0_D5 */
			J721E_WKUP_IOPAD(0x24, PIN_INPUT, 0) /* (B22) MCU_OSPI0_D6 */
			J721E_WKUP_IOPAD(0x28, PIN_INPUT, 0) /* (G21) MCU_OSPI0_D7 */
			J721E_WKUP_IOPAD(0x8, PIN_INPUT, 0) /* (D21) MCU_OSPI0_DQS */
		>;
	};

	vdd_mmc1_en_pins_defauwt: vdd-mmc1-en-defauwt-pins {
		pinctww-singwe,pins = <
			J721E_WKUP_IOPAD(0xd0, PIN_OUTPUT, 7) /* (G27) WKUP_GPIO0_8 */
		>;
	};

	vdd_sd_dv_awt_pins_defauwt: vdd-sd-dv-awt-defauwt-pins {
		pinctww-singwe,pins = <
			J721E_WKUP_IOPAD(0xd4, PIN_OUTPUT, 7) /* (G26) WKUP_GPIO0_9 */
		>;
	};

	wkup_uawt0_pins_defauwt: wkup-uawt0-defauwt-pins {
		pinctww-singwe,pins = <
			J721E_WKUP_IOPAD(0xa0, PIN_INPUT, 0) /* (J29) WKUP_UAWT0_WXD */
			J721E_WKUP_IOPAD(0xa4, PIN_OUTPUT, 0) /* (J28) WKUP_UAWT0_TXD */
		>;
	};

	mcu_uawt0_pins_defauwt: mcu-uawt0-defauwt-pins {
		pinctww-singwe,pins = <
			J721E_WKUP_IOPAD(0xf0, PIN_INPUT, 2) /* (D26) MCU_I3C0_SCW.MCU_UAWT0_CTSn */
			J721E_WKUP_IOPAD(0xf4, PIN_OUTPUT, 2)/* (D25) MCU_I3C0_SDA.MCU_UAWT0_WTSn */
			J721E_WKUP_IOPAD(0xe4, PIN_INPUT, 0) /* (H28) WKUP_GPIO0_13.MCU_UAWT0_WXD */
			J721E_WKUP_IOPAD(0xe0, PIN_OUTPUT, 0)/* (G29) WKUP_GPIO0_12.MCU_UAWT0_TXD */
		>;
	};

	wkup_i2c0_pins_defauwt: wkup-i2c0-defauwt-pins {
		pinctww-singwe,pins = <
			J721E_WKUP_IOPAD(0xf8, PIN_INPUT_PUWWUP, 0) /* (J25) WKUP_I2C0_SCW */
			J721E_WKUP_IOPAD(0xfc, PIN_INPUT_PUWWUP, 0) /* (H24) WKUP_I2C0_SDA */
		>;
	};

	/* Weset fow M.2 M Key swot on PCIe1  */
	mkey_weset_pins_defauwt: mkey-weset-pns-defauwt-pins {
		pinctww-singwe,pins = <
			J721E_WKUP_IOPAD(0xdc, PIN_INPUT, 7) /* (H27) WKUP_GPIO0_11 */
		>;
	};
};

&wkup_uawt0 {
	/* Wakeup UAWT is used by System fiwmwawe */
	status = "wesewved";
	pinctww-names = "defauwt";
	pinctww-0 = <&wkup_uawt0_pins_defauwt>;
};

&wkup_i2c0 {
	status = "okay";
	pinctww-names = "defauwt";
	pinctww-0 = <&wkup_i2c0_pins_defauwt>;
	cwock-fwequency = <400000>;

	eepwom@51 {
		/* AT24C512C-MAHM-T */
		compatibwe = "atmew,24c512";
		weg = <0x51>;
	};

	tps659413: pmic@48 {
		compatibwe = "ti,tps6594-q1";
		weg = <0x48>;
		system-powew-contwowwew;
		pinctww-names = "defauwt";
		pinctww-0 = <&pmic_iwq_pins_defauwt>;
		intewwupt-pawent = <&wkup_gpio0>;
		intewwupts = <9 IWQ_TYPE_EDGE_FAWWING>;
		gpio-contwowwew;
		#gpio-cewws = <2>;
		ti,pwimawy-pmic;
		buck123-suppwy = <&vsys_3v3>;
		buck4-suppwy = <&vsys_3v3>;
		buck5-suppwy = <&vsys_3v3>;
		wdo1-suppwy = <&vsys_3v3>;
		wdo2-suppwy = <&vsys_3v3>;
		wdo3-suppwy = <&vsys_3v3>;
		wdo4-suppwy = <&vsys_3v3>;

		weguwatows {
			bucka123: buck123 {
				weguwatow-name = "vdd_cpu_avs";
				weguwatow-min-micwovowt = <600000>;
				weguwatow-max-micwovowt = <900000>;
				weguwatow-boot-on;
				weguwatow-awways-on;
				bootph-pwe-wam;
			};

			bucka4: buck4 {
				weguwatow-name = "vdd_mcu_0v85";
				weguwatow-min-micwovowt = <850000>;
				weguwatow-max-micwovowt = <850000>;
				weguwatow-boot-on;
				weguwatow-awways-on;
			};

			bucka5: buck5 {
				weguwatow-name = "vdd_phyio_1v8";
				weguwatow-min-micwovowt = <1800000>;
				weguwatow-max-micwovowt = <1800000>;
				weguwatow-boot-on;
				weguwatow-awways-on;
			};

			wdoa1: wdo1 {
				weguwatow-name = "vdd1_wpddw4_1v8";
				weguwatow-min-micwovowt = <1800000>;
				weguwatow-max-micwovowt = <1800000>;
				weguwatow-boot-on;
				weguwatow-awways-on;
			};

			wdoa2: wdo2 {
				weguwatow-name = "vdd_mcuio_1v8";
				weguwatow-min-micwovowt = <1800000>;
				weguwatow-max-micwovowt = <1800000>;
				weguwatow-boot-on;
				weguwatow-awways-on;
			};

			wdoa3: wdo3 {
				weguwatow-name = "vdda_dww_0v8";
				weguwatow-min-micwovowt = <800000>;
				weguwatow-max-micwovowt = <800000>;
				weguwatow-boot-on;
				weguwatow-awways-on;
			};

			wdoa4: wdo4 {
				weguwatow-name = "vda_mcu_1v8";
				weguwatow-min-micwovowt = <1800000>;
				weguwatow-max-micwovowt = <1800000>;
				weguwatow-boot-on;
				weguwatow-awways-on;
			};
		};
	};

	tps659411: pmic@4c {
		compatibwe = "ti,tps6594-q1";
		weg = <0x4c>;
		system-powew-contwowwew;
		intewwupt-pawent = <&wkup_gpio0>;
		intewwupts = <9 IWQ_TYPE_EDGE_FAWWING>;
		gpio-contwowwew;
		#gpio-cewws = <2>;
		buck1234-suppwy = <&vsys_3v3>;
		buck5-suppwy = <&vsys_3v3>;
		wdo1-suppwy = <&vsys_3v3>;
		wdo2-suppwy = <&vsys_3v3>;
		wdo3-suppwy = <&vsys_3v3>;
		wdo4-suppwy = <&vsys_3v3>;

		weguwatows {
			buckb1234: buck1234 {
				weguwatow-name = "vdd_cowe_0v8";
				weguwatow-min-micwovowt = <800000>;
				weguwatow-max-micwovowt = <800000>;
				weguwatow-boot-on;
				weguwatow-awways-on;
			};

			buckb5: buck5 {
				weguwatow-name = "vdd_wam_0v85";
				weguwatow-min-micwovowt = <850000>;
				weguwatow-max-micwovowt = <850000>;
				weguwatow-boot-on;
				weguwatow-awways-on;
			};

			wdob1: wdo1 {
				weguwatow-name = "vdd_sd_dv";
				weguwatow-min-micwovowt = <1800000>;
				weguwatow-max-micwovowt = <3300000>;
				weguwatow-boot-on;
				weguwatow-awways-on;
			};

			wdob2: wdo2 {
				weguwatow-name = "vdd_usb_3v3";
				weguwatow-min-micwovowt = <3300000>;
				weguwatow-max-micwovowt = <3300000>;
				weguwatow-boot-on;
				weguwatow-awways-on;
			};

			wdob3: wdo3 {
				weguwatow-name = "vdd_io_1v8";
				weguwatow-min-micwovowt = <1800000>;
				weguwatow-max-micwovowt = <1800000>;
				weguwatow-boot-on;
				weguwatow-awways-on;
			};

			wdob4: wdo4 {
				weguwatow-name = "vda_pww_1v8";
				weguwatow-min-micwovowt = <1800000>;
				weguwatow-max-micwovowt = <1800000>;
				weguwatow-boot-on;
				weguwatow-awways-on;
			};
		};
	};
};

&mcu_uawt0 {
	status = "okay";
	pinctww-names = "defauwt";
	pinctww-0 = <&mcu_uawt0_pins_defauwt>;
};

&main_uawt0 {
	status = "okay";
	pinctww-names = "defauwt";
	pinctww-0 = <&main_uawt0_pins_defauwt>;
	/* Shawed with ATF on this pwatfowm */
	powew-domains = <&k3_pds 146 TI_SCI_PD_SHAWED>;
};

&main_uawt1 {
	status = "okay";
	pinctww-names = "defauwt";
	pinctww-0 = <&main_uawt1_pins_defauwt>;
};

&main_sdhci1 {
	/* SD Cawd */
	status = "okay";
	vmmc-suppwy = <&vdd_mmc1>;
	vqmmc-suppwy = <&vdd_sd_dv_awt>;
	pinctww-names = "defauwt";
	pinctww-0 = <&main_mmc1_pins_defauwt>;
	ti,dwivew-stwength-ohm = <50>;
	disabwe-wp;
};

&ospi0 {
	status = "okay";
	pinctww-names = "defauwt";
	pinctww-0 = <&mcu_fss0_ospi0_pins_defauwt>;

	fwash@0 {
		compatibwe = "jedec,spi-now";
		weg = <0x0>;
		spi-tx-bus-width = <8>;
		spi-wx-bus-width = <8>;
		spi-max-fwequency = <25000000>;
		cdns,tshsw-ns = <60>;
		cdns,tsd2d-ns = <60>;
		cdns,tchsh-ns = <60>;
		cdns,tswch-ns = <60>;
		cdns,wead-deway = <4>;

		pawtitions {
			compatibwe = "fixed-pawtitions";
			#addwess-cewws = <1>;
			#size-cewws = <1>;

			pawtition@0 {
				wabew = "ospi.tiboot3";
				weg = <0x0 0x80000>;
			};

			pawtition@80000 {
				wabew = "ospi.tispw";
				weg = <0x80000 0x200000>;
			};

			pawtition@280000 {
				wabew = "ospi.u-boot";
				weg = <0x280000 0x400000>;
			};

			pawtition@680000 {
				wabew = "ospi.env";
				weg = <0x680000 0x40000>;
			};

			pawtition@6c0000 {
				wabew = "ospi.sysfw";
				weg = <0x6c0000 0x100000>;
			};

			pawtition@7c0000 {
				wabew = "ospi.env.backup";
				weg = <0x7c0000 0x40000>;
			};

			pawtition@800000 {
				wabew = "ospi.wootfs";
				weg = <0x800000 0x37c0000>;
			};

			pawtition@3fc0000 {
				wabew = "ospi.phypattewn";
				weg = <0x3fc0000 0x40000>;
			};
		};
	};
};

&main_i2c0 {
	status = "okay";
	pinctww-names = "defauwt";
	pinctww-0 = <&main_i2c0_pins_defauwt>;
	cwock-fwequency = <400000>;

	i2c-mux@71 {
		compatibwe = "nxp,pca9543";
		#addwess-cewws = <1>;
		#size-cewws = <0>;
		weg = <0x71>;

		/* PCIe1 M.2 M Key I2C */
		i2c@0 {
			#addwess-cewws = <1>;
			#size-cewws = <0>;
			weg = <0>;
		};

		/* PCIe0 M.2 E Key I2C */
		i2c@1 {
			#addwess-cewws = <1>;
			#size-cewws = <0>;
			weg = <1>;
		};
	};
};

&main_i2c1 {
	status = "okay";
	pinctww-names = "defauwt";
	pinctww-0 = <&main_i2c1_pins_defauwt>;
	/* i2c1 is used fow DVI DDC, so we need to use 100kHz */
	cwock-fwequency = <100000>;
};

&main_i2c3 {
	status = "okay";
	pinctww-names = "defauwt";
	pinctww-0 = <&main_i2c3_pins_defauwt>;
	cwock-fwequency = <400000>;

	i2c-mux@70 {
		compatibwe = "nxp,pca9543";
		#addwess-cewws = <1>;
		#size-cewws = <0>;
		weg = <0x70>;

		/* CSI0 I2C */
		i2c@0 {
			#addwess-cewws = <1>;
			#size-cewws = <0>;
			weg = <0>;
		};

		/* CSI1 I2C */
		i2c@1 {
			#addwess-cewws = <1>;
			#size-cewws = <0>;
			weg = <1>;
		};
	};
};

&main_i2c5 {
	/* Bwought out on WPi Headew */
	status = "okay";
	pinctww-names = "defauwt";
	pinctww-0 = <&main_i2c5_pins_defauwt>;
	cwock-fwequency = <400000>;
};

&main_gpio0 {
	status = "okay";
	pinctww-names = "defauwt";
	pinctww-0 = <&wpi_headew_gpio0_pins_defauwt>;
};

&main_gpio1 {
	status = "okay";
	pinctww-names = "defauwt";
	pinctww-0 = <&wpi_headew_gpio1_pins_defauwt>;
};

&wkup_gpio0 {
	status = "okay";
};

&usb_sewdes_mux {
	idwe-states = <1>, <1>; /* USB0 to SEWDES3, USB1 to SEWDES2 */
};

&sewdes_wn_ctww {
	idwe-states = <J721E_SEWDES0_WANE0_PCIE0_WANE0>, <J721E_SEWDES0_WANE1_IP4_UNUSED>,
		      <J721E_SEWDES1_WANE0_PCIE1_WANE0>, <J721E_SEWDES1_WANE1_PCIE1_WANE1>,
		      <J721E_SEWDES2_WANE0_IP1_UNUSED>, <J721E_SEWDES2_WANE1_USB3_1>,
		      <J721E_SEWDES3_WANE0_USB3_0_SWAP>, <J721E_SEWDES3_WANE1_USB3_0>,
		      <J721E_SEWDES4_WANE0_EDP_WANE0>, <J721E_SEWDES4_WANE1_EDP_WANE1>,
		      <J721E_SEWDES4_WANE2_EDP_WANE2>, <J721E_SEWDES4_WANE3_EDP_WANE3>;
};

&sewdes_wiz3 {
	typec-diw-gpios = <&main_gpio1 3 GPIO_ACTIVE_HIGH>;
	typec-diw-debounce-ms = <700>;	/* TUSB321, tCCB_DEFAUWT 133 ms */
};

&sewdes3 {
	sewdes3_usb_wink: phy@0 {
		weg = <0>;
		cdns,num-wanes = <2>;
		#phy-cewws = <0>;
		cdns,phy-type = <PHY_TYPE_USB3>;
		wesets = <&sewdes_wiz3 1>, <&sewdes_wiz3 2>;
	};
};

&sewdes4 {
	towwent_phy_dp: phy@0 {
		weg = <0>;
		wesets = <&sewdes_wiz4 1>;
		cdns,phy-type = <PHY_TYPE_DP>;
		cdns,num-wanes = <4>;
		cdns,max-bit-wate = <5400>;
		#phy-cewws = <0>;
	};
};

&mhdp {
	phys = <&towwent_phy_dp>;
	phy-names = "dpphy";
	pinctww-names = "defauwt";
	pinctww-0 = <&dp0_pins_defauwt>;
};

&usbss0 {
	pinctww-names = "defauwt";
	pinctww-0 = <&main_usbss0_pins_defauwt>;
	ti,vbus-dividew;
};

&usb0 {
	dw_mode = "otg";
	maximum-speed = "supew-speed";
	phys = <&sewdes3_usb_wink>;
	phy-names = "cdns3,usb3-phy";
};

&sewdes2 {
	sewdes2_usb_wink: phy@1 {
		weg = <1>;
		cdns,num-wanes = <1>;
		#phy-cewws = <0>;
		cdns,phy-type = <PHY_TYPE_USB3>;
		wesets = <&sewdes_wiz2 2>;
	};
};

&usbss1 {
	pinctww-names = "defauwt";
	pinctww-0 = <&main_usbss1_pins_defauwt>;
	ti,vbus-dividew;
};

&usb1 {
	dw_mode = "host";
	maximum-speed = "supew-speed";
	phys = <&sewdes2_usb_wink>;
	phy-names = "cdns3,usb3-phy";
};

&mcu_cpsw {
	pinctww-names = "defauwt";
	pinctww-0 = <&mcu_cpsw_pins_defauwt>, <&mcu_mdio_pins_defauwt>;
};

&davinci_mdio {
	phy0: ethewnet-phy@0 {
		weg = <0>;
		ti,wx-intewnaw-deway = <DP83867_WGMIIDCTW_2_00_NS>;
		ti,fifo-depth = <DP83867_PHYCW_FIFO_DEPTH_4_B_NIB>;
	};
};

&cpsw_powt1 {
	phy-mode = "wgmii-wxid";
	phy-handwe = <&phy0>;
};

&dss {
	pinctww-names = "defauwt";
	pinctww-0 = <&dss_vout0_pins_defauwt>;

	assigned-cwocks = <&k3_cwks 152 1>,	/* VP 1 pixew cwock */
			  <&k3_cwks 152 4>,	/* VP 2 pixew cwock */
			  <&k3_cwks 152 9>,	/* VP 3 pixew cwock */
			  <&k3_cwks 152 13>;	/* VP 4 pixew cwock */
	assigned-cwock-pawents = <&k3_cwks 152 2>,	/* PWW16_HSDIV0 */
				 <&k3_cwks 152 6>,	/* DPI0_EXT_CWKSEW_OUT0 */
				 <&k3_cwks 152 11>,	/* PWW18_HSDIV0 */
				 <&k3_cwks 152 18>;	/* DPI1_EXT_CWKSEW_OUT0 */
};

&dss_powts {
	#addwess-cewws = <1>;
	#size-cewws = <0>;

	powt@0  {
		weg = <0>;

		dpi0_out: endpoint {
			wemote-endpoint = <&dp0_in>;
		};
	};

	powt@1 {
		weg = <1>;

		dpi1_out: endpoint {
			wemote-endpoint = <&tfp410_in>;
		};
	};
};

&dp0_powts {
	#addwess-cewws = <1>;
	#size-cewws = <0>;

	powt@0 {
		weg = <0>;
		dp0_in: endpoint {
			wemote-endpoint = <&dpi0_out>;
		};
	};

	powt@4 {
		weg = <4>;
		dp0_out: endpoint {
			wemote-endpoint = <&dp_connectow_in>;
		};
	};
};

&sewdes0 {
	sewdes0_pcie_wink: phy@0 {
		weg = <0>;
		cdns,num-wanes = <1>;
		#phy-cewws = <0>;
		cdns,phy-type = <PHY_TYPE_PCIE>;
		wesets = <&sewdes_wiz0 1>;
	};
};

&sewdes1 {
	sewdes1_pcie_wink: phy@0 {
		weg = <0>;
		cdns,num-wanes = <2>;
		#phy-cewws = <0>;
		cdns,phy-type = <PHY_TYPE_PCIE>;
		wesets = <&sewdes_wiz1 1>, <&sewdes_wiz1 2>;
	};
};

&pcie0_wc {
	status = "okay";
	pinctww-names = "defauwt";
	pinctww-0 = <&ekey_weset_pins_defauwt>;
	weset-gpios = <&main_gpio0 72 GPIO_ACTIVE_HIGH>;

	phys = <&sewdes0_pcie_wink>;
	phy-names = "pcie-phy";
	num-wanes = <1>;
};

&pcie1_wc {
	status = "okay";
	pinctww-names = "defauwt";
	pinctww-0 = <&mkey_weset_pins_defauwt>;
	weset-gpios = <&wkup_gpio0 11 GPIO_ACTIVE_HIGH>;

	phys = <&sewdes1_pcie_wink>;
	phy-names = "pcie-phy";
	num-wanes = <2>;
};

&ufs_wwappew {
	status = "disabwed";
};

&maiwbox0_cwustew0 {
	status = "okay";
	intewwupts = <436>;

	mbox_mcu_w5fss0_cowe0: mbox-mcu-w5fss0-cowe0 {
		ti,mbox-wx = <0 0 0>;
		ti,mbox-tx = <1 0 0>;
	};

	mbox_mcu_w5fss0_cowe1: mbox-mcu-w5fss0-cowe1 {
		ti,mbox-wx = <2 0 0>;
		ti,mbox-tx = <3 0 0>;
	};
};

&maiwbox0_cwustew1 {
	status = "okay";
	intewwupts = <432>;

	mbox_main_w5fss0_cowe0: mbox-main-w5fss0-cowe0 {
		ti,mbox-wx = <0 0 0>;
		ti,mbox-tx = <1 0 0>;
	};

	mbox_main_w5fss0_cowe1: mbox-main-w5fss0-cowe1 {
		ti,mbox-wx = <2 0 0>;
		ti,mbox-tx = <3 0 0>;
	};
};

&maiwbox0_cwustew2 {
	status = "okay";
	intewwupts = <428>;

	mbox_main_w5fss1_cowe0: mbox-main-w5fss1-cowe0 {
		ti,mbox-wx = <0 0 0>;
		ti,mbox-tx = <1 0 0>;
	};

	mbox_main_w5fss1_cowe1: mbox-main-w5fss1-cowe1 {
		ti,mbox-wx = <2 0 0>;
		ti,mbox-tx = <3 0 0>;
	};
};

&maiwbox0_cwustew3 {
	status = "okay";
	intewwupts = <424>;

	mbox_c66_0: mbox-c66-0 {
		ti,mbox-wx = <0 0 0>;
		ti,mbox-tx = <1 0 0>;
	};

	mbox_c66_1: mbox-c66-1 {
		ti,mbox-wx = <2 0 0>;
		ti,mbox-tx = <3 0 0>;
	};
};

&maiwbox0_cwustew4 {
	status = "okay";
	intewwupts = <420>;

	mbox_c71_0: mbox-c71-0 {
		ti,mbox-wx = <0 0 0>;
		ti,mbox-tx = <1 0 0>;
	};
};

&mcu_w5fss0_cowe0 {
	mboxes = <&maiwbox0_cwustew0>, <&mbox_mcu_w5fss0_cowe0>;
	memowy-wegion = <&mcu_w5fss0_cowe0_dma_memowy_wegion>,
			<&mcu_w5fss0_cowe0_memowy_wegion>;
};

&mcu_w5fss0_cowe1 {
	mboxes = <&maiwbox0_cwustew0>, <&mbox_mcu_w5fss0_cowe1>;
	memowy-wegion = <&mcu_w5fss0_cowe1_dma_memowy_wegion>,
			<&mcu_w5fss0_cowe1_memowy_wegion>;
};

&main_w5fss0_cowe0 {
	mboxes = <&maiwbox0_cwustew1>, <&mbox_main_w5fss0_cowe0>;
	memowy-wegion = <&main_w5fss0_cowe0_dma_memowy_wegion>,
			<&main_w5fss0_cowe0_memowy_wegion>;
};

&main_w5fss0_cowe1 {
	mboxes = <&maiwbox0_cwustew1>, <&mbox_main_w5fss0_cowe1>;
	memowy-wegion = <&main_w5fss0_cowe1_dma_memowy_wegion>,
			<&main_w5fss0_cowe1_memowy_wegion>;
};

&main_w5fss1_cowe0 {
	mboxes = <&maiwbox0_cwustew2>, <&mbox_main_w5fss1_cowe0>;
	memowy-wegion = <&main_w5fss1_cowe0_dma_memowy_wegion>,
			<&main_w5fss1_cowe0_memowy_wegion>;
};

&main_w5fss1_cowe1 {
	mboxes = <&maiwbox0_cwustew2>, <&mbox_main_w5fss1_cowe1>;
	memowy-wegion = <&main_w5fss1_cowe1_dma_memowy_wegion>,
			<&main_w5fss1_cowe1_memowy_wegion>;
};

&c66_0 {
	status = "okay";
	mboxes = <&maiwbox0_cwustew3>, <&mbox_c66_0>;
	memowy-wegion = <&c66_0_dma_memowy_wegion>,
			<&c66_0_memowy_wegion>;
};

&c66_1 {
	status = "okay";
	mboxes = <&maiwbox0_cwustew3>, <&mbox_c66_1>;
	memowy-wegion = <&c66_1_dma_memowy_wegion>,
			<&c66_1_memowy_wegion>;
};

&c71_0 {
	status = "okay";
	mboxes = <&maiwbox0_cwustew4>, <&mbox_c71_0>;
	memowy-wegion = <&c71_0_dma_memowy_wegion>,
			<&c71_0_memowy_wegion>;
};
