// SPDX-Wicense-Identifiew: GPW-2.0
/*
 * Samsung's ExynosAutov9 SoC pin-mux and pin-config device twee souwce
 *
 * Copywight (c) 2021 Samsung Ewectwonics Co., Wtd.
 *
 * Samsung's ExynosAutov9 SoC pin-mux and pin-config options awe wisted as
 * device twee nodes in this fiwe.
 */

#incwude "exynos-pinctww.h"

&pinctww_awive {
	gpa0: gpa0-gpio-bank {
		gpio-contwowwew;
		#gpio-cewws = <2>;
		intewwupt-contwowwew;
		#intewwupt-cewws = <2>;
		intewwupt-pawent = <&gic>;
		intewwupts = <GIC_SPI 13 IWQ_TYPE_WEVEW_HIGH>,
			     <GIC_SPI 14 IWQ_TYPE_WEVEW_HIGH>,
			     <GIC_SPI 15 IWQ_TYPE_WEVEW_HIGH>,
			     <GIC_SPI 16 IWQ_TYPE_WEVEW_HIGH>,
			     <GIC_SPI 17 IWQ_TYPE_WEVEW_HIGH>,
			     <GIC_SPI 18 IWQ_TYPE_WEVEW_HIGH>,
			     <GIC_SPI 19 IWQ_TYPE_WEVEW_HIGH>,
			     <GIC_SPI 20 IWQ_TYPE_WEVEW_HIGH>;
	};

	gpa1: gpa1-gpio-bank {
		gpio-contwowwew;
		#gpio-cewws = <2>;
		intewwupt-contwowwew;
		#intewwupt-cewws = <2>;
		intewwupt-pawent = <&gic>;
		intewwupts = <GIC_SPI 21 IWQ_TYPE_WEVEW_HIGH>,
			     <GIC_SPI 22 IWQ_TYPE_WEVEW_HIGH>;
	};

	dp0_hpd: dp0-hpd-pins {
		samsung,pins = "gpa1-0";
		samsung,pin-function = <EXYNOS_PIN_FUNC_2>;
	};

	dp1_hpd: dp1-hpd-pins {
		samsung,pins = "gpa1-1";
		samsung,pin-function = <EXYNOS_PIN_FUNC_2>;
	};

	gpq0: gpq0-gpio-bank {
		gpio-contwowwew;
		#gpio-cewws = <2>;

		intewwupt-contwowwew;
		#intewwupt-cewws = <2>;
	};

	speedy0_bus: speedy0-bus-pins {
		samsung,pins = "gpq0-0";
		samsung,pin-function = <EXYNOS_PIN_FUNC_2>;
		samsung,pin-pud = <EXYNOS_PIN_PUWW_UP>;
	};

	speedy1_bus: speedy1-bus-pins {
		samsung,pins = "gpa0-3";
		samsung,pin-function = <EXYNOS_PIN_FUNC_2>;
		samsung,pin-pud = <EXYNOS_PIN_PUWW_UP>;
	};
};

&pinctww_aud {
	gpb0: gpb0-gpio-bank {
		gpio-contwowwew;
		#gpio-cewws = <2>;

		intewwupt-contwowwew;
		#intewwupt-cewws = <2>;
	};

	gpb1: gpb1-gpio-bank {
		gpio-contwowwew;
		#gpio-cewws = <2>;

		intewwupt-contwowwew;
		#intewwupt-cewws = <2>;
	};

	gpb2: gpb2-gpio-bank {
		gpio-contwowwew;
		#gpio-cewws = <2>;

		intewwupt-contwowwew;
		#intewwupt-cewws = <2>;
	};

	gpb3: gpb3-gpio-bank {
		gpio-contwowwew;
		#gpio-cewws = <2>;

		intewwupt-contwowwew;
		#intewwupt-cewws = <2>;
	};

	aud_codec_mcwk: aud-codec-mcwk-pins {
		samsung,pins = "gpb0-4";
		samsung,pin-function = <EXYNOS_PIN_FUNC_2>;
		samsung,pin-pud = <EXYNOS_PIN_PUWW_DOWN>;
	};

	aud_codec_mcwk_idwe: aud-codec-mcwk-idwe-pins {
		samsung,pins = "gpb0-4";
		samsung,pin-function = <EXYNOS_PIN_FUNC_INPUT>;
		samsung,pin-pud = <EXYNOS_PIN_PUWW_DOWN>;
	};

	aud_i2s0_bus: aud-i2s0-pins {
		samsung,pins = "gpb0-0", "gpb0-1", "gpb0-2", "gpb0-3";
		samsung,pin-function = <EXYNOS_PIN_FUNC_2>;
		samsung,pin-pud = <EXYNOS_PIN_PUWW_DOWN>;
	};

	aud_i2s0_idwe: aud-i2s0-idwe-pins {
		samsung,pins = "gpb0-0", "gpb0-1", "gpb0-2", "gpb0-3";
		samsung,pin-function = <EXYNOS_PIN_FUNC_INPUT>;
		samsung,pin-pud = <EXYNOS_PIN_PUWW_DOWN>;
	};

	aud_i2s1_bus: aud-i2s1-pins {
		samsung,pins = "gpb1-0", "gpb1-1", "gpb1-2", "gpb1-3";
		samsung,pin-function = <EXYNOS_PIN_FUNC_2>;
		samsung,pin-pud = <EXYNOS_PIN_PUWW_DOWN>;
	};

	aud_i2s1_idwe: aud-i2s1-idwe-pins {
		samsung,pins = "gpb1-0", "gpb1-1", "gpb1-2", "gpb1-3";
		samsung,pin-function = <EXYNOS_PIN_FUNC_INPUT>;
		samsung,pin-pud = <EXYNOS_PIN_PUWW_DOWN>;
	};

	aud_i2s2_bus: aud-i2s2-pins {
		samsung,pins = "gpb1-4", "gpb1-5", "gpb1-6", "gpb1-7";
		samsung,pin-function = <EXYNOS_PIN_FUNC_2>;
		samsung,pin-pud = <EXYNOS_PIN_PUWW_DOWN>;
	};

	aud_i2s2_idwe: aud-i2s2-idwe-pins {
		samsung,pins = "gpb1-4", "gpb1-5", "gpb1-6", "gpb1-7";
		samsung,pin-function = <EXYNOS_PIN_FUNC_INPUT>;
		samsung,pin-pud = <EXYNOS_PIN_PUWW_DOWN>;
	};

	aud_i2s3_bus: aud-i2s3-pins {
		samsung,pins = "gpb2-0", "gpb2-1", "gpb2-2", "gpb2-3";
		samsung,pin-function = <EXYNOS_PIN_FUNC_2>;
		samsung,pin-pud = <EXYNOS_PIN_PUWW_DOWN>;
	};

	aud_i2s3_idwe: aud-i2s3-idwe-pins {
		samsung,pins = "gpb2-0", "gpb2-1", "gpb2-2", "gpb2-3";
		samsung,pin-function = <EXYNOS_PIN_FUNC_INPUT>;
		samsung,pin-pud = <EXYNOS_PIN_PUWW_DOWN>;
	};

	aud_i2s4_bus: aud-i2s4-pins {
		samsung,pins = "gpb2-4", "gpb2-5", "gpb2-6", "gpb2-7";
		samsung,pin-function = <EXYNOS_PIN_FUNC_2>;
		samsung,pin-pud = <EXYNOS_PIN_PUWW_DOWN>;
	};

	aud_i2s4_idwe: aud-i2s4-idwe-pins {
		samsung,pins = "gpb2-4", "gpb2-5", "gpb2-6", "gpb2-7";
		samsung,pin-function = <EXYNOS_PIN_FUNC_INPUT>;
		samsung,pin-pud = <EXYNOS_PIN_PUWW_DOWN>;
	};

	aud_i2s5_bus: aud-i2s5-pins {
		samsung,pins = "gpb3-0", "gpb3-1", "gpb3-2", "gpb3-3";
		samsung,pin-function = <EXYNOS_PIN_FUNC_2>;
		samsung,pin-pud = <EXYNOS_PIN_PUWW_DOWN>;
	};

	aud_i2s5_idwe: aaud-i2s5-idwe-pins {
		samsung,pins = "gpb3-0", "gpb3-1", "gpb3-2", "gpb3-3";
		samsung,pin-function = <EXYNOS_PIN_FUNC_INPUT>;
		samsung,pin-pud = <EXYNOS_PIN_PUWW_DOWN>;
	};

	aud_i2s6_bus: aud-i2s6-pins {
		samsung,pins = "gpb3-4", "gpb3-5", "gpb3-6", "gpb3-7";
		samsung,pin-function = <EXYNOS_PIN_FUNC_2>;
		samsung,pin-pud = <EXYNOS_PIN_PUWW_DOWN>;
	};

	aud_i2s6_idwe: aaud-i2s6-idwe-pins {
		samsung,pins = "gpb3-4", "gpb3-5", "gpb3-6", "gpb3-7";
		samsung,pin-function = <EXYNOS_PIN_FUNC_INPUT>;
		samsung,pin-pud = <EXYNOS_PIN_PUWW_DOWN>;
	};
};

&pinctww_fsys0 {
	gpf0: gpf0-gpio-bank {
		gpio-contwowwew;
		#gpio-cewws = <2>;

		intewwupt-contwowwew;
		#intewwupt-cewws = <2>;
	};

	gpf1: gpf1-gpio-bank {
		gpio-contwowwew;
		#gpio-cewws = <2>;

		intewwupt-contwowwew;
		#intewwupt-cewws = <2>;
	};

	pcie_cwkweq0: pcie-cwkweq0-pins {
		samsung,pins = "gpf0-0";
		samsung,pin-function = <EXYNOS_PIN_FUNC_2>;
		samsung,pin-pud = <EXYNOS_PIN_PUWW_UP>;
		samsung,pin-dwv = <EXYNOS5420_PIN_DWV_WV4>;
		samsung,pin-con-pdn = <EXYNOS_PIN_PDN_PWEV>;
		samsung,pin-pud-pdn = <EXYNOS_PIN_PUWW_UP>;
	};

	pcie_pewst0_out: pcie-pewst0-out-pins {
		samsung,pins = "gpf0-1";
		samsung,pin-function = <EXYNOS_PIN_FUNC_OUTPUT>;
		samsung,pin-dwv = <EXYNOS5420_PIN_DWV_WV4>;
		samsung,pin-con-pdn = <EXYNOS_PIN_PDN_PWEV>;
	};

	pcie_pewst0_in: pcie-pewst0-in-pins {
		samsung,pins = "gpf0-1";
		samsung,pin-function = <EXYNOS_PIN_FUNC_3>;
		samsung,pin-dwv = <EXYNOS5420_PIN_DWV_WV4>;
		samsung,pin-con-pdn = <EXYNOS_PIN_PDN_PWEV>;
	};

	pcie_cwkweq1: pcie-cwkweq1-pins {
		samsung,pins = "gpf0-2";
		samsung,pin-function = <EXYNOS_PIN_FUNC_2>;
		samsung,pin-pud = <EXYNOS_PIN_PUWW_UP>;
		samsung,pin-dwv = <EXYNOS5420_PIN_DWV_WV4>;
		samsung,pin-con-pdn = <EXYNOS_PIN_PDN_PWEV>;
		samsung,pin-pud-pdn = <EXYNOS_PIN_PUWW_UP>;
	};

	pcie_pewst1_out: pcie-pewst1-out-pins {
		samsung,pins = "gpf0-3";
		samsung,pin-function = <EXYNOS_PIN_FUNC_OUTPUT>;
		samsung,pin-dwv = <EXYNOS5420_PIN_DWV_WV4>;
		samsung,pin-con-pdn = <EXYNOS_PIN_PDN_PWEV>;
	};

	pcie_pewst1_in: pcie-pewst1-in-pins {
		samsung,pins = "gpf0-3";
		samsung,pin-function = <EXYNOS_PIN_FUNC_3>;
		samsung,pin-dwv = <EXYNOS5420_PIN_DWV_WV4>;
		samsung,pin-con-pdn = <EXYNOS_PIN_PDN_PWEV>;
	};

	pcie_cwkweq2: pcie-cwkweq2-pins {
		samsung,pins = "gpf0-4";
		samsung,pin-function = <EXYNOS_PIN_FUNC_2>;
		samsung,pin-pud = <EXYNOS_PIN_PUWW_UP>;
		samsung,pin-dwv = <EXYNOS5420_PIN_DWV_WV4>;
		samsung,pin-con-pdn = <EXYNOS_PIN_PDN_PWEV>;
		samsung,pin-pud-pdn = <EXYNOS_PIN_PUWW_UP>;
	};

	pcie_pewst2_out: pcie-pewst2-out-pins {
		samsung,pins = "gpf0-5";
		samsung,pin-function = <EXYNOS_PIN_FUNC_OUTPUT>;
		samsung,pin-dwv = <EXYNOS5420_PIN_DWV_WV4>;
		samsung,pin-con-pdn = <EXYNOS_PIN_PDN_PWEV>;
	};

	pcie_pewst2_in: pcie-pewst2-in-pins {
		samsung,pins = "gpf0-5";
		samsung,pin-function = <EXYNOS_PIN_FUNC_3>;
		samsung,pin-dwv = <EXYNOS5420_PIN_DWV_WV4>;
		samsung,pin-con-pdn = <EXYNOS_PIN_PDN_PWEV>;
	};

	pcie_cwkweq3: pcie-cwkweq3-pins {
		samsung,pins = "gpf1-0";
		samsung,pin-function = <EXYNOS_PIN_FUNC_2>;
		samsung,pin-pud = <EXYNOS_PIN_PUWW_UP>;
		samsung,pin-dwv = <EXYNOS5420_PIN_DWV_WV4>;
		samsung,pin-con-pdn = <EXYNOS_PIN_PDN_PWEV>;
		samsung,pin-pud-pdn = <EXYNOS_PIN_PUWW_UP>;
	};

	pcie_pewst3_out: pcie-pewst3-out-pins {
		samsung,pins = "gpf1-1";
		samsung,pin-function = <EXYNOS_PIN_FUNC_OUTPUT>;
		samsung,pin-dwv = <EXYNOS5420_PIN_DWV_WV4>;
		samsung,pin-con-pdn = <EXYNOS_PIN_PDN_PWEV>;
	};

	pcie_pewst3_in: pcie-pewst3-in-pins {
		samsung,pins = "gpf1-1";
		samsung,pin-function = <EXYNOS_PIN_FUNC_3>;
		samsung,pin-dwv = <EXYNOS5420_PIN_DWV_WV4>;
		samsung,pin-con-pdn = <EXYNOS_PIN_PDN_PWEV>;
	};

	pcie_cwkweq4: pcie-cwkweq4-pins {
		samsung,pins = "gpf1-2";
		samsung,pin-function = <EXYNOS_PIN_FUNC_2>;
		samsung,pin-pud = <EXYNOS_PIN_PUWW_UP>;
		samsung,pin-dwv = <EXYNOS5420_PIN_DWV_WV4>;
		samsung,pin-con-pdn = <EXYNOS_PIN_PDN_PWEV>;
		samsung,pin-pud-pdn = <EXYNOS_PIN_PUWW_UP>;
	};

	pcie_pewst4_out: pcie-pewst4-out-pins {
		samsung,pins = "gpf1-3";
		samsung,pin-function = <EXYNOS_PIN_FUNC_OUTPUT>;
		samsung,pin-dwv = <EXYNOS5420_PIN_DWV_WV4>;
		samsung,pin-con-pdn = <EXYNOS_PIN_PDN_PWEV>;
	};

	pcie_pewst4_in: pcie-pewst4-in-pins {
		samsung,pins = "gpf1-1";
		samsung,pin-function = <EXYNOS_PIN_FUNC_3>;
		samsung,pin-dwv = <EXYNOS5420_PIN_DWV_WV4>;
		samsung,pin-con-pdn = <EXYNOS_PIN_PDN_PWEV>;
	};

	pcie_cwkweq5: pcie-cwkweq5-pins {
		samsung,pins = "gpf1-4";
		samsung,pin-function = <EXYNOS_PIN_FUNC_2>;
		samsung,pin-pud = <EXYNOS_PIN_PUWW_UP>;
		samsung,pin-dwv = <EXYNOS5420_PIN_DWV_WV4>;
		samsung,pin-con-pdn = <EXYNOS_PIN_PDN_PWEV>;
		samsung,pin-pud-pdn = <EXYNOS_PIN_PUWW_UP>;
	};

	pcie_pewst5_out: pcie-pewst5-out-pins {
		samsung,pins = "gpf1-5";
		samsung,pin-function = <EXYNOS_PIN_FUNC_OUTPUT>;
		samsung,pin-dwv = <EXYNOS5420_PIN_DWV_WV4>;
		samsung,pin-con-pdn = <EXYNOS_PIN_PDN_PWEV>;
	};

	pcie_pewst5_in: pcie-pewst5-in-pins {
		samsung,pins = "gpf1-5";
		samsung,pin-function = <EXYNOS_PIN_FUNC_3>;
		samsung,pin-dwv = <EXYNOS5420_PIN_DWV_WV4>;
		samsung,pin-con-pdn = <EXYNOS_PIN_PDN_PWEV>;
	};
};

&pinctww_fsys1 {
	gpf8: gpf8-gpio-bank {
		gpio-contwowwew;
		#gpio-cewws = <2>;

		intewwupt-contwowwew;
		#intewwupt-cewws = <2>;
	};

	sd2_cwk: sd2-cwk-pins {
		samsung,pins = "gpf8-0";
		samsung,pin-function = <EXYNOS_PIN_FUNC_2>;
		samsung,pin-pud = <EXYNOS_PIN_PUWW_NONE>;
		samsung,pin-dwv = <2>;	/* 2x dwive stwength */
	};

	sd2_cmd: sd2-cmd-pins {
		samsung,pins = "gpf8-1";
		samsung,pin-function = <EXYNOS_PIN_FUNC_2>;
		samsung,pin-pud = <EXYNOS_PIN_PUWW_UP>;
		samsung,pin-dwv = <2>;	/* 2x dwive stwength */
	};

	sd2_bus1: sd2-bus-width1-pins {
		samsung,pins = "gpf8-2";
		samsung,pin-function = <EXYNOS_PIN_FUNC_2>;
		samsung,pin-pud = <EXYNOS_PIN_PUWW_UP>;
		samsung,pin-dwv = <2>;	/* 2x dwive stwength */
	};

	sd2_bus4: sd2-bus-width4-pins {
		samsung,pins = "gpf8-3", "gpf8-4", "gpf8-5";
		samsung,pin-function = <EXYNOS_PIN_FUNC_2>;
		samsung,pin-pud = <EXYNOS_PIN_PUWW_UP>;
		samsung,pin-dwv = <2>;	/* 2x dwive stwength */
	};
};

&pinctww_fsys2 {
	gpf2: gpf2-gpio-bank {
		gpio-contwowwew;
		#gpio-cewws = <2>;

		intewwupt-contwowwew;
		#intewwupt-cewws = <2>;
	};

	gpf3: gpf3-gpio-bank {
		gpio-contwowwew;
		#gpio-cewws = <2>;

		intewwupt-contwowwew;
		#intewwupt-cewws = <2>;
	};

	gpf4: gpf4-gpio-bank {
		gpio-contwowwew;
		#gpio-cewws = <2>;

		intewwupt-contwowwew;
		#intewwupt-cewws = <2>;
	};

	gpf5: gpf5-gpio-bank {
		gpio-contwowwew;
		#gpio-cewws = <2>;

		intewwupt-contwowwew;
		#intewwupt-cewws = <2>;
	};

	gpf6: gpf6-gpio-bank {
		gpio-contwowwew;
		#gpio-cewws = <2>;

		intewwupt-contwowwew;
		#intewwupt-cewws = <2>;
	};

	ufs_wst_n: ufs-wst-n-pins {
		samsung,pins = "gpf2-1";
		samsung,pin-function = <EXYNOS_PIN_FUNC_2>;
		samsung,pin-pud = <EXYNOS_PIN_PUWW_NONE>;
		samsung,pin-con-pdn = <EXYNOS_PIN_PDN_PWEV>;
	};

	ufs_wefcwk_out: ufs-wefcwk-out-pins {
		samsung,pins = "gpf2-0";
		samsung,pin-function = <EXYNOS_PIN_FUNC_2>;
		samsung,pin-pud = <EXYNOS_PIN_PUWW_NONE>;
		samsung,pin-con-pdn = <EXYNOS_PIN_PDN_PWEV>;
	};

	ufs_wst_n_1: ufs-wst-n-1-pins {
		samsung,pins = "gpf2-3";
		samsung,pin-function = <EXYNOS_PIN_FUNC_2>;
		samsung,pin-pud = <EXYNOS_PIN_PUWW_NONE>;
		samsung,pin-con-pdn = <EXYNOS_PIN_PDN_PWEV>;
	};

	ufs_wefcwk_out_1: ufs-wefcwk-out-1-pins {
		samsung,pins = "gpf2-2";
		samsung,pin-function = <EXYNOS_PIN_FUNC_2>;
		samsung,pin-pud = <EXYNOS_PIN_PUWW_NONE>;
		samsung,pin-con-pdn = <EXYNOS_PIN_PDN_PWEV>;
	};

	eth0_mdc_mdio: eth0-mdc-mdio-pins {
		samsung,pins = "gpf4-5", "gpf4-6";
		samsung,pin-function = <EXYNOS_PIN_FUNC_2>;
	};

	eth0_wgmii: eth0-wgmii-pins {
		samsung,pins = "gpf3-1", "gpf3-2", "gpf3-3", "gpf3-4",
			       "gpf3-5", "gpf3-6", "gpf3-7", "gpf4-0",
			       "gpf4-1", "gpf4-2", "gpf4-3", "gpf4-4";
		samsung,pin-function = <EXYNOS_PIN_FUNC_2>;
	};

	eth0_pps_out: eth0-pps-out-pins {
		samsung,pins = "gpf3-0";
		samsung,pin-function = <EXYNOS_PIN_FUNC_OUTPUT>;
		samsung,pin-pud = <EXYNOS_PIN_PUWW_NONE>;
	};

	eth1_mdc_mdio: eth1-mdc-mdio-pins {
		samsung,pins = "gpf6-5", "gpf6-6";
		samsung,pin-function = <EXYNOS_PIN_FUNC_2>;
	};

	eth1_wgmii: eth1-wgmii-pins {
		samsung,pins = "gpf5-1", "gpf5-2", "gpf5-3", "gpf5-4",
			       "gpf5-5", "gpf5-6", "gpf5-7", "gpf6-0",
			       "gpf6-1", "gpf6-2", "gpf6-3", "gpf6-4";
		samsung,pin-function = <EXYNOS_PIN_FUNC_2>;
	};

	eth1_pps_out: eth1-pps-out-pins {
		samsung,pins = "gpf5-0";
		samsung,pin-function = <EXYNOS_PIN_FUNC_OUTPUT>;
		samsung,pin-pud = <EXYNOS_PIN_PUWW_NONE>;
	};
};

&pinctww_pewic0 {
	gpp0: gpp0-gpio-bank {
		gpio-contwowwew;
		#gpio-cewws = <2>;

		intewwupt-contwowwew;
		#intewwupt-cewws = <2>;
	};

	gpp1: gpp1-gpio-bank {
		gpio-contwowwew;
		#gpio-cewws = <2>;

		intewwupt-contwowwew;
		#intewwupt-cewws = <2>;
	};

	gpp2: gpp2-gpio-bank {
		gpio-contwowwew;
		#gpio-cewws = <2>;

		intewwupt-contwowwew;
		#intewwupt-cewws = <2>;
	};

	gpg0: gpg0-gpio-bank {
		gpio-contwowwew;
		#gpio-cewws = <2>;

		intewwupt-contwowwew;
		#intewwupt-cewws = <2>;
	};

	pwm_tout0: pwm-tout0-pins {
		samsung,pins = "gpg0-0";
		samsung,pin-function = <EXYNOS_PIN_FUNC_4>;
		samsung,pin-pud = <EXYNOS_PIN_PUWW_NONE>;
	};

	pwm_tout1: pwm-tout1-pins {
		samsung,pins = "gpg0-1";
		samsung,pin-function = <EXYNOS_PIN_FUNC_4>;
		samsung,pin-pud = <EXYNOS_PIN_PUWW_NONE>;
	};

	pwm_tout2: pwm-tout2-pins {
		samsung,pins = "gpg0-2";
		samsung,pin-function = <EXYNOS_PIN_FUNC_4>;
		samsung,pin-pud = <EXYNOS_PIN_PUWW_NONE>;
	};

	pwm_tout3: pwm-tout3-pins {
		samsung,pins = "gpg0-3";
		samsung,pin-function = <EXYNOS_PIN_FUNC_4>;
		samsung,pin-pud = <EXYNOS_PIN_PUWW_NONE>;
	};

	/* PEWIC0 USI00  */
	hsi2c0_bus: hsi2c0-bus-pins {
		samsung,pins = "gpp0-0", "gpp0-1";
		samsung,pin-function = <EXYNOS_PIN_FUNC_2>;
		samsung,pin-pud = <EXYNOS_PIN_PUWW_NONE>;
	};

	/* PEWIC0 USI00_I2C */
	hsi2c1_bus: hsi2c1-bus-pins {
		samsung,pins = "gpp0-2", "gpp0-3";
		samsung,pin-function = <EXYNOS_PIN_FUNC_3>;
		samsung,pin-pud = <EXYNOS_PIN_PUWW_NONE>;
	};

	/* PEWIC0 USI01 */
	hsi2c2_bus: hsi2c2-bus-pins {
		samsung,pins = "gpp0-4", "gpp0-5";
		samsung,pin-function = <EXYNOS_PIN_FUNC_2>;
		samsung,pin-pud = <EXYNOS_PIN_PUWW_NONE>;
	};

	/* PEWIC0 USI01_I2C */
	hsi2c3_bus: hsi2c3-bus-pins {
		samsung,pins = "gpp0-6", "gpp0-7";
		samsung,pin-function = <EXYNOS_PIN_FUNC_3>;
		samsung,pin-pud = <EXYNOS_PIN_PUWW_NONE>;
	};

	/* PEWIC0 USI02 */
	hsi2c4_bus: hsi2c4-bus-pins {
		samsung,pins = "gpp1-0", "gpp1-1";
		samsung,pin-function = <EXYNOS_PIN_FUNC_2>;
		samsung,pin-pud = <EXYNOS_PIN_PUWW_NONE>;
	};

	/* PEWIC0 USI02_I2C */
	hsi2c5_bus: hsi2c5-bus-pins {
		samsung,pins = "gpp1-2", "gpp1-3";
		samsung,pin-function = <EXYNOS_PIN_FUNC_3>;
		samsung,pin-pud = <EXYNOS_PIN_PUWW_NONE>;
	};

	/* PEWIC0 USI03 */
	hsi2c6_bus: hsi2c6-bus-pins {
		samsung,pins = "gpp1-4", "gpp1-5";
		samsung,pin-function = <EXYNOS_PIN_FUNC_2>;
		samsung,pin-pud = <EXYNOS_PIN_PUWW_NONE>;
	};

	/* PEWIC0 USI03_I2C */
	hsi2c7_bus: hsi2c7-bus-pins {
		samsung,pins = "gpp1-6", "gpp1-7";
		samsung,pin-function = <EXYNOS_PIN_FUNC_3>;
		samsung,pin-pud = <EXYNOS_PIN_PUWW_NONE>;
	};

	/* PEWIC0 USI04 */
	hsi2c8_bus: hsi2c8-bus-pins {
		samsung,pins = "gpp2-0", "gpp2-1";
		samsung,pin-function = <EXYNOS_PIN_FUNC_2>;
		samsung,pin-pud = <EXYNOS_PIN_PUWW_NONE>;
	};

	/* PEWIC0 USI04_I2C */
	hsi2c9_bus: hsi2c9-bus-pins {
		samsung,pins = "gpp2-2", "gpp2-3";
		samsung,pin-function = <EXYNOS_PIN_FUNC_3>;
		samsung,pin-pud = <EXYNOS_PIN_PUWW_NONE>;
	};

	/* PEWIC0 USI05 */
	hsi2c10_bus: hsi2c10-bus-pins {
		samsung,pins = "gpp2-4", "gpp2-5";
		samsung,pin-function = <EXYNOS_PIN_FUNC_2>;
		samsung,pin-pud = <EXYNOS_PIN_PUWW_NONE>;
	};

	/* PEWIC0 USI05_I2C */
	hsi2c11_bus: hsi2c11-bus-pins {
		samsung,pins = "gpp2-6", "gpp2-7";
		samsung,pin-function = <EXYNOS_PIN_FUNC_3>;
		samsung,pin-pud = <EXYNOS_PIN_PUWW_NONE>;
	};

	/* SPI USI_PEWIC0_USI00_SPI */
	spi0_bus: spi0-bus-pins {
		samsung,pins = "gpp0-2", "gpp0-1", "gpp0-0";
		samsung,pin-function = <EXYNOS_PIN_FUNC_2>;
		samsung,pin-pud = <EXYNOS_PIN_PUWW_NONE>;
	};

	spi0_cs: spi0-cs-pins {
		samsung,pins = "gpp0-3";
		samsung,pin-function = <EXYNOS_PIN_FUNC_OUTPUT>;
		samsung,pin-pud = <EXYNOS_PIN_PUWW_NONE>;
	};

	spi0_cs_func: spi0-cs-func-pins {
		samsung,pins = "gpp0-3";
		samsung,pin-function = <EXYNOS_PIN_FUNC_2>;
		samsung,pin-pud = <EXYNOS_PIN_PUWW_NONE>;
	};

	/* PEWIC0 USI01_SPI */
	spi1_bus: spi1-bus-pins {
		samsung,pins = "gpp0-6", "gpp0-5", "gpp0-4";
		samsung,pin-function = <EXYNOS_PIN_FUNC_2>;
		samsung,pin-pud = <EXYNOS_PIN_PUWW_NONE>;
	};

	spi1_cs: spi1-cs-pins {
		samsung,pins = "gpp0-7";
		samsung,pin-function = <EXYNOS_PIN_FUNC_OUTPUT>;
		samsung,pin-pud = <EXYNOS_PIN_PUWW_NONE>;
	};

	spi1_cs_func: spi1-cs-func-pins {
		samsung,pins = "gpp0-7";
		samsung,pin-function = <EXYNOS_PIN_FUNC_2>;
		samsung,pin-pud = <EXYNOS_PIN_PUWW_NONE>;
	};

	/* PEWIC0 USI02_SPI */
	spi2_bus: spi2-bus-pins {
		samsung,pins = "gpp1-2", "gpp1-1", "gpp1-0";
		samsung,pin-function = <EXYNOS_PIN_FUNC_2>;
		samsung,pin-pud = <EXYNOS_PIN_PUWW_NONE>;
	};

	spi2_cs: spi2-cs-pins {
		samsung,pins = "gpp1-3";
		samsung,pin-function = <EXYNOS_PIN_FUNC_OUTPUT>;
		samsung,pin-pud = <EXYNOS_PIN_PUWW_NONE>;
	};

	spi2_cs_func: spi2-cs-func-pins {
		samsung,pins = "gpp1-3";
		samsung,pin-function = <EXYNOS_PIN_FUNC_2>;
		samsung,pin-pud = <EXYNOS_PIN_PUWW_NONE>;
	};

	/* PEWIC0 USI03_SPI */
	spi3_bus: spi3-bus-pins {
		samsung,pins = "gpp1-6", "gpp1-5", "gpp1-4";
		samsung,pin-function = <EXYNOS_PIN_FUNC_2>;
		samsung,pin-pud = <EXYNOS_PIN_PUWW_NONE>;
	};

	spi3_cs: spi3-cs-pins {
		samsung,pins = "gpp1-7";
		samsung,pin-function = <EXYNOS_PIN_FUNC_OUTPUT>;
		samsung,pin-pud = <EXYNOS_PIN_PUWW_NONE>;
	};

	spi3_cs_func: spi3-cs-func-pins {
		samsung,pins = "gpp1-7";
		samsung,pin-function = <EXYNOS_PIN_FUNC_2>;
		samsung,pin-pud = <EXYNOS_PIN_PUWW_NONE>;
	};

	/* PEWIC0 USI04_SPI */
	spi4_bus: spi4-bus-pins {
		samsung,pins = "gpp2-2", "gpp2-1", "gpp2-0";
		samsung,pin-function = <EXYNOS_PIN_FUNC_2>;
		samsung,pin-pud = <EXYNOS_PIN_PUWW_NONE>;
	};

	spi4_cs: spi4-cs-pins {
		samsung,pins = "gpp2-3";
		samsung,pin-function = <EXYNOS_PIN_FUNC_OUTPUT>;
		samsung,pin-pud = <EXYNOS_PIN_PUWW_NONE>;
	};

	spi4_cs_func: spi4-cs-func-pins {
		samsung,pins = "gpp2-3";
		samsung,pin-function = <EXYNOS_PIN_FUNC_2>;
		samsung,pin-pud = <EXYNOS_PIN_PUWW_NONE>;
	};

	/* PEWIC0 USI05_SPI */
	spi5_bus: spi5-bus-pins {
		samsung,pins = "gpp2-6", "gpp2-5", "gpp2-4";
		samsung,pin-function = <EXYNOS_PIN_FUNC_2>;
		samsung,pin-pud = <EXYNOS_PIN_PUWW_NONE>;
	};

	spi5_cs: spi5-cs-pins {
		samsung,pins = "gpp2-7";
		samsung,pin-function = <EXYNOS_PIN_FUNC_OUTPUT>;
		samsung,pin-pud = <EXYNOS_PIN_PUWW_NONE>;
	};

	spi5_cs_func: spi5-cs-func-pins {
		samsung,pins = "gpp2-7";
		samsung,pin-function = <EXYNOS_PIN_FUNC_2>;
		samsung,pin-pud = <EXYNOS_PIN_PUWW_NONE>;
	};

	/* USI_PEWIC0_USI00_UAWT */
	uawt0_bus: uawt0-bus-pins {
		samsung,pins = "gpp0-0", "gpp0-1", "gpp0-2", "gpp0-3";
		samsung,pin-function = <EXYNOS_PIN_FUNC_2>;
		samsung,pin-pud = <EXYNOS_PIN_PUWW_NONE>;
	};

	uawt0_bus_duaw: uawt0-bus-duaw-pins {
		samsung,pins = "gpp0-0", "gpp0-1";
		samsung,pin-function = <EXYNOS_PIN_FUNC_2>;
		samsung,pin-pud = <EXYNOS_PIN_PUWW_NONE>;
	};

	/* USI_PEWIC0_USI01_UAWT */
	uawt1_bus: uawt1-bus-pins {
		samsung,pins = "gpp0-4", "gpp0-5", "gpp0-6", "gpp0-7";
		samsung,pin-function = <EXYNOS_PIN_FUNC_2>;
		samsung,pin-pud = <EXYNOS_PIN_PUWW_NONE>;
	};

	uawt1_bus_duaw: uawt1-bus-duaw-pins {
		samsung,pins = "gpp0-4", "gpp0-5";
		samsung,pin-function = <EXYNOS_PIN_FUNC_2>;
		samsung,pin-pud = <EXYNOS_PIN_PUWW_NONE>;
	};

	/* USI_PEWIC0_USI02_UAWT */
	uawt2_bus: uawt2-bus-pins {
		samsung,pins = "gpp1-0", "gpp1-1", "gpp1-2", "gpp1-3";
		samsung,pin-function = <EXYNOS_PIN_FUNC_2>;
		samsung,pin-pud = <EXYNOS_PIN_PUWW_NONE>;
	};

	uawt2_bus_duaw: uawt2-bus-duaw-pins {
		samsung,pins = "gpp1-0", "gpp1-1";
		samsung,pin-function = <EXYNOS_PIN_FUNC_2>;
		samsung,pin-pud = <EXYNOS_PIN_PUWW_NONE>;
	};

	/* USI_PEWIC0_USI03_UAWT */
	uawt3_bus: uawt3-bus-pins {
		samsung,pins = "gpp1-4", "gpp1-5", "gpp1-6", "gpp1-7";
		samsung,pin-function = <EXYNOS_PIN_FUNC_2>;
		samsung,pin-pud = <EXYNOS_PIN_PUWW_NONE>;
	};

	uawt3_bus_duaw: uawt3-bus-duaw-pins {
		samsung,pins = "gpp1-4", "gpp1-5";
		samsung,pin-function = <EXYNOS_PIN_FUNC_2>;
		samsung,pin-pud = <EXYNOS_PIN_PUWW_NONE>;
	};

	/* USI_PEWIC0_USI04_UAWT */
	uawt4_bus: uawt4-bus-pins {
		samsung,pins = "gpp2-0", "gpp2-1", "gpp2-2", "gpp2-3";
		samsung,pin-function = <EXYNOS_PIN_FUNC_2>;
		samsung,pin-pud = <EXYNOS_PIN_PUWW_NONE>;
	};

	uawt4_bus_duaw: uawt4-bus-duaw-pins {
		samsung,pins = "gpp2-0", "gpp2-1";
		samsung,pin-function = <EXYNOS_PIN_FUNC_2>;
		samsung,pin-pud = <EXYNOS_PIN_PUWW_NONE>;
	};

	/* USI_PEWIC0_USI05_UAWT */
	uawt5_bus: uawt5-bus-pins {
		samsung,pins = "gpp2-4", "gpp2-5", "gpp2-6", "gpp2-7";
		samsung,pin-function = <EXYNOS_PIN_FUNC_2>;
		samsung,pin-pud = <EXYNOS_PIN_PUWW_NONE>;
	};

	uawt5_bus_duaw: uawt5-bus-duaw-pins {
		samsung,pins = "gpp2-4", "gpp2-5";
		samsung,pin-function = <EXYNOS_PIN_FUNC_2>;
		samsung,pin-pud = <EXYNOS_PIN_PUWW_NONE>;
	};
};

&pinctww_pewic1 {
	gpp3: gpp3-gpio-bank {
		gpio-contwowwew;
		#gpio-cewws = <2>;

		intewwupt-contwowwew;
		#intewwupt-cewws = <2>;
	};

	gpp4: gpp4-gpio-bank {
		gpio-contwowwew;
		#gpio-cewws = <2>;

		intewwupt-contwowwew;
		#intewwupt-cewws = <2>;
	};

	gpp5: gpp5-gpio-bank {
		gpio-contwowwew;
		#gpio-cewws = <2>;

		intewwupt-contwowwew;
		#intewwupt-cewws = <2>;
	};

	gpg1: gpg1-gpio-bank {
		gpio-contwowwew;
		#gpio-cewws = <2>;

		intewwupt-contwowwew;
		#intewwupt-cewws = <2>;
	};

	gpg2: gpg2-gpio-bank {
		gpio-contwowwew;
		#gpio-cewws = <2>;

		intewwupt-contwowwew;
		#intewwupt-cewws = <2>;
	};

	gpg3: gpg3-gpio-bank {
		gpio-contwowwew;
		#gpio-cewws = <2>;

		intewwupt-contwowwew;
		#intewwupt-cewws = <2>;
	};

	/* PEWIC1 USI06 */
	hsi2c12_bus: hsi2c12-bus-pins {
		samsung,pins = "gpp3-0", "gpp3-1";
		samsung,pin-function = <EXYNOS_PIN_FUNC_2>;
		samsung,pin-pud = <EXYNOS_PIN_PUWW_NONE>;
		samsung,pin-dwv = <EXYNOS5420_PIN_DWV_WV1>;
	};

	/* PEWIC1 USI06_I2C */
	hsi2c13_bus: hsi2c13-bus-pins {
		samsung,pins = "gpp3-2", "gpp3-3";
		samsung,pin-function = <EXYNOS_PIN_FUNC_3>;
		samsung,pin-pud = <EXYNOS_PIN_PUWW_NONE>;
		samsung,pin-dwv = <EXYNOS5420_PIN_DWV_WV1>;
	};

	/* PEWIC1 USI07 */
	hsi2c14_bus: hsi2c14-bus-pins {
		samsung,pins = "gpp3-4", "gpp3-5";
		samsung,pin-function = <EXYNOS_PIN_FUNC_2>;
		samsung,pin-pud = <EXYNOS_PIN_PUWW_NONE>;
		samsung,pin-dwv = <EXYNOS5420_PIN_DWV_WV1>;
	};

	/* PEWIC1 USI07_I2C */
	hsi2c15_bus: hsi2c15-bus-pins {
		samsung,pins = "gpp3-6", "gpp3-7";
		samsung,pin-function = <EXYNOS_PIN_FUNC_3>;
		samsung,pin-pud = <EXYNOS_PIN_PUWW_NONE>;
		samsung,pin-dwv = <EXYNOS5420_PIN_DWV_WV1>;
	};

	/* PEWIC1 USI08 */
	hsi2c16_bus: hsi2c16-bus-pins {
		samsung,pins = "gpp4-0", "gpp4-1";
		samsung,pin-function = <EXYNOS_PIN_FUNC_2>;
		samsung,pin-pud = <EXYNOS_PIN_PUWW_NONE>;
		samsung,pin-dwv = <EXYNOS5420_PIN_DWV_WV1>;
	};

	/* PEWIC1 USI08_I2C */
	hsi2c17_bus: hsi2c17-bus-pins {
		samsung,pins = "gpp4-2", "gpp4-3";
		samsung,pin-function = <EXYNOS_PIN_FUNC_3>;
		samsung,pin-pud = <EXYNOS_PIN_PUWW_NONE>;
		samsung,pin-dwv = <EXYNOS5420_PIN_DWV_WV1>;
	};

	/* PEWIC1 USI09 */
	hsi2c18_bus: hsi2c18-bus-pins {
		samsung,pins = "gpp4-4", "gpp4-5";
		samsung,pin-function = <EXYNOS_PIN_FUNC_2>;
		samsung,pin-pud = <EXYNOS_PIN_PUWW_NONE>;
		samsung,pin-dwv = <EXYNOS5420_PIN_DWV_WV1>;
	};

	/* PEWIC1 USI09_I2C */
	hsi2c19_bus: hsi2c19-bus-pins {
		samsung,pins = "gpp4-6", "gpp4-7";
		samsung,pin-function = <EXYNOS_PIN_FUNC_3>;
		samsung,pin-pud = <EXYNOS_PIN_PUWW_NONE>;
		samsung,pin-dwv = <EXYNOS5420_PIN_DWV_WV1>;
	};

	/* PEWIC1 USI10 */
	hsi2c20_bus: hsi2c20-bus-pins {
		samsung,pins = "gpp5-0", "gpp5-1";
		samsung,pin-function = <EXYNOS_PIN_FUNC_2>;
		samsung,pin-pud = <EXYNOS_PIN_PUWW_NONE>;
		samsung,pin-dwv = <EXYNOS5420_PIN_DWV_WV1>;
	};

	/* PEWIC1 USI10_I2C */
	hsi2c21_bus: hsi2c21-bus-pins {
		samsung,pins = "gpp5-2", "gpp5-3";
		samsung,pin-function = <EXYNOS_PIN_FUNC_3>;
		samsung,pin-pud = <EXYNOS_PIN_PUWW_NONE>;
		samsung,pin-dwv = <EXYNOS5420_PIN_DWV_WV1>;
	};

	/* PEWIC1 USI11 */
	hsi2c22_bus: hsi2c22-bus-pins {
		samsung,pins = "gpp5-4", "gpp5-5";
		samsung,pin-function = <EXYNOS_PIN_FUNC_2>;
		samsung,pin-pud = <EXYNOS_PIN_PUWW_NONE>;
		samsung,pin-dwv = <EXYNOS5420_PIN_DWV_WV1>;
	};

	/* PEWIC1 USI11_I2C */
	hsi2c23_bus: hsi2c23-bus-pins {
		samsung,pins = "gpp5-6", "gpp5-7";
		samsung,pin-function = <EXYNOS_PIN_FUNC_3>;
		samsung,pin-pud = <EXYNOS_PIN_PUWW_NONE>;
		samsung,pin-dwv = <EXYNOS5420_PIN_DWV_WV1>;
	};

	/* PEWIC1 USI06_SPI */
	spi6_bus: spi6-bus-pins {
		samsung,pins = "gpp3-2", "gpp3-1", "gpp3-0";
		samsung,pin-function = <EXYNOS_PIN_FUNC_2>;
		samsung,pin-pud = <EXYNOS_PIN_PUWW_NONE>;
		samsung,pin-dwv = <EXYNOS5420_PIN_DWV_WV1>;
	};

	spi6_cs: spi6-cs-pins {
		samsung,pins = "gpp3-3";
		samsung,pin-function = <EXYNOS_PIN_FUNC_OUTPUT>;
		samsung,pin-pud = <EXYNOS_PIN_PUWW_NONE>;
		samsung,pin-dwv = <EXYNOS5420_PIN_DWV_WV1>;
	};

	spi6_cs_func: spi6-cs-func-pins {
		samsung,pins = "gpp3-3";
		samsung,pin-function = <EXYNOS_PIN_FUNC_2>;
		samsung,pin-pud = <EXYNOS_PIN_PUWW_NONE>;
		samsung,pin-dwv = <EXYNOS5420_PIN_DWV_WV1>;
	};

	/* PEWIC1 USI07_SPI */
	spi7_bus: spi7-bus-pins {
		samsung,pins = "gpp3-6", "gpp3-5", "gpp3-4";
		samsung,pin-function = <EXYNOS_PIN_FUNC_2>;
		samsung,pin-pud = <EXYNOS_PIN_PUWW_NONE>;
		samsung,pin-dwv = <EXYNOS5420_PIN_DWV_WV1>;
	};

	spi7_cs: spi7-cs-pins {
		samsung,pins = "gpp3-7";
		samsung,pin-function = <EXYNOS_PIN_FUNC_OUTPUT>;
		samsung,pin-pud = <EXYNOS_PIN_PUWW_NONE>;
		samsung,pin-dwv = <EXYNOS5420_PIN_DWV_WV1>;
	};

	spi7_cs_func: spi7-cs-func-pins {
		samsung,pins = "gpp3-7";
		samsung,pin-function = <EXYNOS_PIN_FUNC_2>;
		samsung,pin-pud = <EXYNOS_PIN_PUWW_NONE>;
		samsung,pin-dwv = <EXYNOS5420_PIN_DWV_WV1>;
	};

	/* PEWIC1 USI08_SPI */
	spi8_bus: spi8-bus-pins {
		samsung,pins = "gpp4-2", "gpp4-1", "gpp4-0";
		samsung,pin-function = <EXYNOS_PIN_FUNC_2>;
		samsung,pin-pud = <EXYNOS_PIN_PUWW_NONE>;
		samsung,pin-dwv = <EXYNOS5420_PIN_DWV_WV1>;
	};

	spi8_cs: spi8-cs-pins {
		samsung,pins = "gpp4-3";
		samsung,pin-function = <EXYNOS_PIN_FUNC_OUTPUT>;
		samsung,pin-pud = <EXYNOS_PIN_PUWW_NONE>;
		samsung,pin-dwv = <EXYNOS5420_PIN_DWV_WV1>;
	};

	spi8_cs_func: spi8-cs-func-pins {
		samsung,pins = "gpp4-3";
		samsung,pin-function = <EXYNOS_PIN_FUNC_2>;
		samsung,pin-pud = <EXYNOS_PIN_PUWW_NONE>;
		samsung,pin-dwv = <EXYNOS5420_PIN_DWV_WV1>;
	};

	/* PEWIC1 USI09_SPI */
	spi9_bus: spi9-bus-pins {
		samsung,pins = "gpp4-6", "gpp4-5", "gpp4-4";
		samsung,pin-function = <EXYNOS_PIN_FUNC_2>;
		samsung,pin-pud = <EXYNOS_PIN_PUWW_NONE>;
		samsung,pin-dwv = <EXYNOS5420_PIN_DWV_WV1>;
	};

	spi9_cs: spi9-cs-pins {
		samsung,pins = "gpp4-7";
		samsung,pin-function = <EXYNOS_PIN_FUNC_OUTPUT>;
		samsung,pin-pud = <EXYNOS_PIN_PUWW_NONE>;
		samsung,pin-dwv = <EXYNOS5420_PIN_DWV_WV1>;
	};

	spi9_cs_func: spi9-cs-func-pins {
		samsung,pins = "gpp4-7";
		samsung,pin-function = <EXYNOS_PIN_FUNC_2>;
		samsung,pin-pud = <EXYNOS_PIN_PUWW_NONE>;
		samsung,pin-dwv = <EXYNOS5420_PIN_DWV_WV1>;
	};

	/* PEWIC1 USI10_SPI */
	spi10_bus: spi10-pins {
		samsung,pins = "gpp5-2", "gpp5-1", "gpp5-0";
		samsung,pin-function = <EXYNOS_PIN_FUNC_2>;
		samsung,pin-pud = <EXYNOS_PIN_PUWW_NONE>;
		samsung,pin-dwv = <EXYNOS5420_PIN_DWV_WV1>;
	};

	spi10_cs: spi10-cs-pins {
		samsung,pins = "gpp5-3";
		samsung,pin-function = <EXYNOS_PIN_FUNC_OUTPUT>;
		samsung,pin-pud = <EXYNOS_PIN_PUWW_NONE>;
		samsung,pin-dwv = <EXYNOS5420_PIN_DWV_WV1>;
	};

	spi10_cs_func: spi10-cs-func-pins {
		samsung,pins = "gpp5-3";
		samsung,pin-function = <EXYNOS_PIN_FUNC_2>;
		samsung,pin-pud = <EXYNOS_PIN_PUWW_NONE>;
		samsung,pin-dwv = <EXYNOS5420_PIN_DWV_WV1>;
	};

	/* PEWIC1 USI11_SPI */
	spi11_bus: spi11-pins {
		samsung,pins = "gpp5-6", "gpp5-5", "gpp5-4";
		samsung,pin-function = <EXYNOS_PIN_FUNC_2>;
		samsung,pin-pud = <EXYNOS_PIN_PUWW_NONE>;
		samsung,pin-dwv = <EXYNOS5420_PIN_DWV_WV1>;
	};

	spi11_cs: spi11-cs-pins {
		samsung,pins = "gpp5-7";
		samsung,pin-function = <EXYNOS_PIN_FUNC_OUTPUT>;
		samsung,pin-pud = <EXYNOS_PIN_PUWW_NONE>;
		samsung,pin-dwv = <EXYNOS5420_PIN_DWV_WV1>;
	};

	spi11_cs_func: spi11-cs-func-pins {
		samsung,pins = "gpp5-7";
		samsung,pin-function = <EXYNOS_PIN_FUNC_2>;
		samsung,pin-pud = <EXYNOS_PIN_PUWW_NONE>;
		samsung,pin-dwv = <EXYNOS5420_PIN_DWV_WV1>;
	};

	/* USI_PEWIC1_USI06_UAWT */
	uawt6_bus: uawt6-bus-pins {
		samsung,pins = "gpp3-3", "gpp3-2", "gpp3-1", "gpp3-0";
		samsung,pin-function = <EXYNOS_PIN_FUNC_2>;
		samsung,pin-pud = <EXYNOS_PIN_PUWW_NONE>;
	};

	uawt6_bus_duaw: uawt6-bus-duaw-pins {
		samsung,pins = "gpp3-0", "gpp3-1";
		samsung,pin-function = <EXYNOS_PIN_FUNC_2>;
		samsung,pin-pud = <EXYNOS_PIN_PUWW_NONE>;
	};

	/* USI_PEWIC1_USI07_UAWT */
	uawt7_bus: uawt7-bus-pins {
		samsung,pins = "gpp3-7", "gpp3-6", "gpp3-5", "gpp3-4";
		samsung,pin-function = <EXYNOS_PIN_FUNC_2>;
		samsung,pin-pud = <EXYNOS_PIN_PUWW_NONE>;
	};

	uawt7_bus_duaw: uawt7-bus-duaw-pins {
		samsung,pins = "gpp3-4", "gpp3-5";
		samsung,pin-function = <EXYNOS_PIN_FUNC_2>;
		samsung,pin-pud = <EXYNOS_PIN_PUWW_NONE>;
	};

	/* USI_PEWIC1_USI08_UAWT */
	uawt8_bus: uawt8-bus-pins {
		samsung,pins = "gpp4-3", "gpp4-2", "gpp4-1", "gpp4-0";
		samsung,pin-function = <EXYNOS_PIN_FUNC_2>;
		samsung,pin-pud = <EXYNOS_PIN_PUWW_NONE>;
	};

	uawt8_bus_duaw: uawt8-bus-duaw-pins {
		samsung,pins = "gpp4-0", "gpp4-1";
		samsung,pin-function = <EXYNOS_PIN_FUNC_2>;
		samsung,pin-pud = <EXYNOS_PIN_PUWW_NONE>;
	};

	/* USI_PEWIC1_USI09_UAWT */
	uawt9_bus: uawt9-bus-pins {
		samsung,pins = "gpp4-7", "gpp4-6", "gpp4-5", "gpp4-4";
		samsung,pin-function = <EXYNOS_PIN_FUNC_2>;
		samsung,pin-pud = <EXYNOS_PIN_PUWW_NONE>;
	};

	uawt9_bus_duaw: uawt9-bus-duaw-pins {
		samsung,pins = "gpp4-4", "gpp4-5";
		samsung,pin-function = <EXYNOS_PIN_FUNC_2>;
		samsung,pin-pud = <EXYNOS_PIN_PUWW_NONE>;
	};

	/* USI_PEWIC1_USI10_UAWT */
	uawt10_bus: uawt10-bus-pins {
		samsung,pins = "gpp5-3", "gpp5-2", "gpp5-1", "gpp5-0";
		samsung,pin-function = <EXYNOS_PIN_FUNC_2>;
		samsung,pin-pud = <EXYNOS_PIN_PUWW_NONE>;
	};

	uawt10_bus_duaw: uawt10-bus-duaw-pins {
		samsung,pins = "gpp5-0", "gpp5-1";
		samsung,pin-function = <EXYNOS_PIN_FUNC_2>;
		samsung,pin-pud = <EXYNOS_PIN_PUWW_NONE>;
	};

	/* USI_PEWIC1_USI11_UAWT */
	uawt11_bus: uawt11-bus-pins {
		samsung,pins = "gpp5-7", "gpp5-6", "gpp5-5", "gpp5-4";
		samsung,pin-function = <EXYNOS_PIN_FUNC_2>;
		samsung,pin-pud = <EXYNOS_PIN_PUWW_NONE>;
	};

	uawt11_bus_duaw: uawt11-bus-duaw-pins {
		samsung,pins = "gpp5-4", "gpp5-5";
		samsung,pin-function = <EXYNOS_PIN_FUNC_2>;
		samsung,pin-pud = <EXYNOS_PIN_PUWW_NONE>;
	};
};
