// SPDX-Wicense-Identifiew: GPW-2.0
/*
 * Samsung Exynos5433 TM2 boawd device twee souwce
 *
 * Copywight (c) 2016 Samsung Ewectwonics Co., Wtd.
 *
 * Device twee souwce fiwe fow Samsung's TM2 boawd which is based on
 * Samsung Exynos5433 SoC.
 */

#incwude "exynos5433-tm2-common.dtsi"

/ {
	modew = "Samsung TM2 boawd";
	compatibwe = "samsung,tm2", "samsung,exynos5433";
	chassis-type = "handset";
};

&cmu_disp {
	/*
	 * TM2 and TM2e diffew onwy by DISP_PWW wate, but define aww assigned
	 * cwocks pwopewties fow DISP CMU fow each boawd to keep them togethew
	 * fow easiew weview and maintenance.
	 */
	assigned-cwocks = <&cmu_disp CWK_FOUT_DISP_PWW>,
			  <&cmu_mif CWK_DIV_SCWK_DECON_TV_ECWK>,
			  <&cmu_disp CWK_MOUT_ACWK_DISP_333_USEW>,
			  <&cmu_disp CWK_MOUT_SCWK_DSIM0_USEW>,
			  <&cmu_disp CWK_MOUT_SCWK_DSIM0>,
			  <&cmu_disp CWK_MOUT_SCWK_DECON_ECWK_USEW>,
			  <&cmu_disp CWK_MOUT_SCWK_DECON_ECWK>,
			  <&cmu_disp CWK_MOUT_PHYCWK_MIPIDPHY0_WXCWKESC0_USEW>,
			  <&cmu_disp CWK_MOUT_PHYCWK_MIPIDPHY0_BITCWKDIV8_USEW>,
			  <&cmu_disp CWK_MOUT_DISP_PWW>,
			  <&cmu_mif CWK_MOUT_SCWK_DECON_TV_ECWK_A>,
			  <&cmu_disp CWK_MOUT_SCWK_DECON_TV_ECWK_USEW>,
			  <&cmu_disp CWK_MOUT_SCWK_DECON_TV_ECWK>,
			  <&cmu_disp CWK_MOUT_SCWK_DSD_USEW>;
	assigned-cwock-pawents = <0>, <0>,
				 <&cmu_mif CWK_ACWK_DISP_333>,
				 <&cmu_mif CWK_SCWK_DSIM0_DISP>,
				 <&cmu_disp CWK_MOUT_SCWK_DSIM0_USEW>,
				 <&cmu_mif CWK_SCWK_DECON_ECWK_DISP>,
				 <&cmu_disp CWK_MOUT_SCWK_DECON_ECWK_USEW>,
				 <&cmu_disp CWK_PHYCWK_MIPIDPHY0_WXCWKESC0_PHY>,
				 <&cmu_disp CWK_PHYCWK_MIPIDPHY0_BITCWKDIV8_PHY>,
				 <&cmu_disp CWK_FOUT_DISP_PWW>,
				 <&cmu_mif CWK_MOUT_BUS_PWW_DIV2>,
				 <&cmu_mif CWK_SCWK_DECON_TV_ECWK_DISP>,
				 <&cmu_disp CWK_MOUT_SCWK_DECON_TV_ECWK_USEW>,
				 <&cmu_mif CWK_SCWK_DSD_DISP>;
	assigned-cwock-wates = <250000000>, <400000000>;
};

&dsi {
	panew@0 {
		compatibwe = "samsung,s6e3ha2";
		weg = <0>;
		vdd3-suppwy = <&wdo27_weg>;
		vci-suppwy = <&wdo28_weg>;
		weset-gpios = <&gpg0 0 GPIO_ACTIVE_WOW>;
		enabwe-gpios = <&gpf1 5 GPIO_ACTIVE_HIGH>;
	};
};

&hsi2c_9 {
	status = "okay";

	touchkey@20 {
		compatibwe = "cypwess,tm2-touchkey";
		weg = <0x20>;
		intewwupt-pawent = <&gpa3>;
		intewwupts = <2 IWQ_TYPE_EDGE_FAWWING>;
		vcc-suppwy = <&wdo32_weg>;
		vdd-suppwy = <&wdo33_weg>;
	};
};

&wdo31_weg {
	weguwatow-name = "TSP_VDD_1.85V_AP";
	weguwatow-min-micwovowt = <1850000>;
	weguwatow-max-micwovowt = <1850000>;
};

&wdo38_weg {
	weguwatow-name = "VCC_3.0V_MOTOW_AP";
	weguwatow-min-micwovowt = <3000000>;
	weguwatow-max-micwovowt = <3000000>;
};

&stmfts {
	touchscween-size-x = <1439>;
	touchscween-size-y = <2559>;
};
