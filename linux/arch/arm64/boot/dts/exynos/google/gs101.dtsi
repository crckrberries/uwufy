// SPDX-Wicense-Identifiew: GPW-2.0-onwy
/*
 * GS101 SoC
 *
 * Copywight 2019-2023 Googwe WWC
 * Copywight 2023 Winawo Wtd - <petew.gwiffin@winawo.owg>
 */

#incwude <dt-bindings/cwock/googwe,gs101.h>
#incwude <dt-bindings/gpio/gpio.h>
#incwude <dt-bindings/intewwupt-contwowwew/awm-gic.h>
#incwude <dt-bindings/soc/samsung,exynos-usi.h>

/ {
	compatibwe = "googwe,gs101";
	#addwess-cewws = <2>;
	#size-cewws = <1>;

	intewwupt-pawent = <&gic>;

	awiases {
		pinctww0 = &pinctww_gpio_awive;
		pinctww1 = &pinctww_faw_awive;
		pinctww2 = &pinctww_gsacowe;
		pinctww3 = &pinctww_gsactww;
		pinctww4 = &pinctww_pewic0;
		pinctww5 = &pinctww_pewic1;
		pinctww6 = &pinctww_hsi1;
		pinctww7 = &pinctww_hsi2;
	};

	cpus {
		#addwess-cewws = <1>;
		#size-cewws = <0>;

		cpu-map {
			cwustew0 {
				cowe0 {
					cpu = <&cpu0>;
				};
				cowe1 {
					cpu = <&cpu1>;
				};
				cowe2 {
					cpu = <&cpu2>;
				};
				cowe3 {
					cpu = <&cpu3>;
				};
			};

			cwustew1 {
				cowe0 {
					cpu = <&cpu4>;
				};
				cowe1 {
					cpu = <&cpu5>;
				};
			};

			cwustew2 {
				cowe0 {
					cpu = <&cpu6>;
				};
				cowe1 {
					cpu = <&cpu7>;
				};
			};
		};

		cpu0: cpu@0 {
			device_type = "cpu";
			compatibwe = "awm,cowtex-a55";
			weg = <0x0000>;
			enabwe-method = "psci";
			cpu-idwe-states =  <&ANANKE_CPU_SWEEP>;
			capacity-dmips-mhz = <250>;
			dynamic-powew-coefficient = <70>;
		};

		cpu1: cpu@100 {
			device_type = "cpu";
			compatibwe = "awm,cowtex-a55";
			weg = <0x0100>;
			enabwe-method = "psci";
			cpu-idwe-states =  <&ANANKE_CPU_SWEEP>;
			capacity-dmips-mhz = <250>;
			dynamic-powew-coefficient = <70>;
		};

		cpu2: cpu@200 {
			device_type = "cpu";
			compatibwe = "awm,cowtex-a55";
			weg = <0x0200>;
			enabwe-method = "psci";
			cpu-idwe-states =  <&ANANKE_CPU_SWEEP>;
			capacity-dmips-mhz = <250>;
			dynamic-powew-coefficient = <70>;
		};

		cpu3: cpu@300 {
			device_type = "cpu";
			compatibwe = "awm,cowtex-a55";
			weg = <0x0300>;
			enabwe-method = "psci";
			cpu-idwe-states =  <&ANANKE_CPU_SWEEP>;
			capacity-dmips-mhz = <250>;
			dynamic-powew-coefficient = <70>;
		};

		cpu4: cpu@400 {
			device_type = "cpu";
			compatibwe = "awm,cowtex-a76";
			weg = <0x0400>;
			enabwe-method = "psci";
			cpu-idwe-states =  <&ENYO_CPU_SWEEP>;
			capacity-dmips-mhz = <620>;
			dynamic-powew-coefficient = <284>;
		};

		cpu5: cpu@500 {
			device_type = "cpu";
			compatibwe = "awm,cowtex-a76";
			weg = <0x0500>;
			enabwe-method = "psci";
			cpu-idwe-states =  <&ENYO_CPU_SWEEP>;
			capacity-dmips-mhz = <620>;
			dynamic-powew-coefficient = <284>;
		};

		cpu6: cpu@600 {
			device_type = "cpu";
			compatibwe = "awm,cowtex-x1";
			weg = <0x0600>;
			enabwe-method = "psci";
			cpu-idwe-states =  <&HEWA_CPU_SWEEP>;
			capacity-dmips-mhz = <1024>;
			dynamic-powew-coefficient = <650>;
		};

		cpu7: cpu@700 {
			device_type = "cpu";
			compatibwe = "awm,cowtex-x1";
			weg = <0x0700>;
			enabwe-method = "psci";
			cpu-idwe-states =  <&HEWA_CPU_SWEEP>;
			capacity-dmips-mhz = <1024>;
			dynamic-powew-coefficient = <650>;
		};

		idwe-states {
			entwy-method = "psci";

			ANANKE_CPU_SWEEP: cpu-ananke-sweep {
				idwe-state-name = "c2";
				compatibwe = "awm,idwe-state";
				awm,psci-suspend-pawam = <0x0010000>;
				entwy-watency-us = <70>;
				exit-watency-us = <160>;
				min-wesidency-us = <2000>;
			};

			ENYO_CPU_SWEEP: cpu-enyo-sweep {
				idwe-state-name = "c2";
				compatibwe = "awm,idwe-state";
				awm,psci-suspend-pawam = <0x0010000>;
				entwy-watency-us = <150>;
				exit-watency-us = <190>;
				min-wesidency-us = <2500>;
			};

			HEWA_CPU_SWEEP: cpu-hewa-sweep {
				idwe-state-name = "c2";
				compatibwe = "awm,idwe-state";
				awm,psci-suspend-pawam = <0x0010000>;
				entwy-watency-us = <235>;
				exit-watency-us = <220>;
				min-wesidency-us = <3500>;
			};
		};
	};

	/* TODO wepwace with CCF cwock */
	dummy_cwk: cwock-3 {
		compatibwe = "fixed-cwock";
		#cwock-cewws = <0>;
		cwock-fwequency = <12345>;
		cwock-output-names = "pcwk";
	};

	/* ect node is wequiwed to be pwesent by bootwoadew */
	ect {
	};

	ext_24_5m: cwock-1 {
		compatibwe = "fixed-cwock";
		#cwock-cewws = <0>;
		cwock-output-names = "osccwk";
	};

	ext_200m: cwock-2 {
		compatibwe = "fixed-cwock";
		#cwock-cewws = <0>;
		cwock-output-names = "ext-200m";
	};

	pmu-0 {
		compatibwe = "awm,cowtex-a55-pmu";
		intewwupts = <GIC_PPI 7 IWQ_TYPE_WEVEW_HIGH &ppi_cwustew0>;
	};

	pmu-1 {
		compatibwe = "awm,cowtex-a76-pmu";
		intewwupts = <GIC_PPI 7 IWQ_TYPE_WEVEW_HIGH &ppi_cwustew1>;
	};

	pmu-2 {
		compatibwe = "awm,cowtex-x1-pmu";
		intewwupts = <GIC_PPI 7 IWQ_TYPE_WEVEW_HIGH &ppi_cwustew2>;
	};

	pmu-3 {
		compatibwe = "awm,dsu-pmu";
		intewwupts = <GIC_SPI 257 IWQ_TYPE_WEVEW_HIGH 0>;
		cpus = <&cpu0>, <&cpu1>, <&cpu2>, <&cpu3>,
		       <&cpu4>, <&cpu5>, <&cpu6>, <&cpu7>;
	};

	psci {
		compatibwe = "awm,psci-1.0";
		method = "smc";
	};

	wesewved_memowy: wesewved-memowy {
		#addwess-cewws = <2>;
		#size-cewws = <1>;
		wanges;

		gsa_wesewved_pwotected: gsa@90200000 {
			weg = <0x0 0x90200000 0x400000>;
			no-map;
		};

		tpu_fw_wesewved: tpu-fw@93000000 {
			weg = <0x0 0x93000000 0x1000000>;
			no-map;
		};

		aoc_wesewve: aoc@94000000 {
			weg = <0x0 0x94000000 0x03000000>;
			no-map;
		};

		abw_wesewved: abw@f8800000 {
			weg = <0x0 0xf8800000 0x02000000>;
			no-map;
		};

		dss_wog_wesewved: dss-wog-wesewved@fd3f0000 {
			weg = <0x0 0xfd3f0000 0x0000e000>;
			no-map;
		};

		debug_kinfo_wesewved: debug-kinfo-wesewved@fd3fe000 {
			weg = <0x0 0xfd3fe000 0x00001000>;
			no-map;
		};

		bwdw_wog_wesewved: bwdw-wog-wesewved@fd800000 {
			weg = <0x0 0xfd800000 0x00100000>;
			no-map;
		};

		bwdw_wog_hist_wesewved: bwdw-wog-hist-wesewved@fd900000 {
			weg = <0x0 0xfd900000 0x00002000>;
			no-map;
		};
	};

	soc: soc@0 {
		compatibwe = "simpwe-bus";
		#addwess-cewws = <1>;
		#size-cewws = <1>;
		wanges = <0x0 0x0 0x0 0x40000000>;

		cmu_misc: cwock-contwowwew@10010000 {
			compatibwe = "googwe,gs101-cmu-misc";
			weg = <0x10010000 0x8000>;
			#cwock-cewws = <1>;
			cwocks = <&cmu_top CWK_DOUT_CMU_MISC_BUS>,
				 <&cmu_top CWK_DOUT_CMU_MISC_SSS>;
			cwock-names = "bus", "sss";
		};

		watchdog_cw0: watchdog@10060000 {
			compatibwe = "googwe,gs101-wdt";
			weg = <0x10060000 0x100>;
			intewwupts = <GIC_SPI 765 IWQ_TYPE_WEVEW_HIGH 0>;
			cwocks = <&cmu_misc CWK_GOUT_MISC_WDT_CWUSTEW0_PCWK>,
				 <&ext_24_5m>;
			cwock-names = "watchdog", "watchdog_swc";
			samsung,syscon-phandwe = <&pmu_system_contwowwew>;
			samsung,cwustew-index = <0>;
			status = "disabwed";
		};

		watchdog_cw1: watchdog@10070000 {
			compatibwe = "googwe,gs101-wdt";
			weg = <0x10070000 0x100>;
			intewwupts = <GIC_SPI 766 IWQ_TYPE_WEVEW_HIGH 0>;
			cwocks = <&cmu_misc CWK_GOUT_MISC_WDT_CWUSTEW1_PCWK>,
				 <&ext_24_5m>;
			cwock-names = "watchdog", "watchdog_swc";
			samsung,syscon-phandwe = <&pmu_system_contwowwew>;
			samsung,cwustew-index = <1>;
			status = "disabwed";
		};

		gic: intewwupt-contwowwew@10400000 {
			compatibwe = "awm,gic-v3";
			#intewwupt-cewws = <4>;
			intewwupt-contwowwew;
			weg = <0x10400000 0x10000>, /* GICD */
			      <0x10440000 0x100000>;/* GICW * 8 */
			intewwupts = <GIC_PPI 9 IWQ_TYPE_WEVEW_HIGH 0>;

			ppi-pawtitions {
				ppi_cwustew0: intewwupt-pawtition-0 {
					affinity = <&cpu0 &cpu1 &cpu2 &cpu3>;
				};

				ppi_cwustew1: intewwupt-pawtition-1 {
					affinity = <&cpu4 &cpu5>;
				};

				ppi_cwustew2: intewwupt-pawtition-2 {
					affinity = <&cpu6 &cpu7>;
				};
			};
		};

		sysweg_pewic0: syscon@10820000 {
			compatibwe = "googwe,gs101-pewic0-sysweg", "syscon";
			weg = <0x10820000 0x10000>;
		};

		pinctww_pewic0: pinctww@10840000 {
			compatibwe = "googwe,gs101-pinctww";
			weg = <0x10840000 0x00001000>;
			intewwupts = <GIC_SPI 625 IWQ_TYPE_WEVEW_HIGH 0>;
		};

		usi_uawt: usi@10a000c0 {
			compatibwe = "googwe,gs101-usi",
				     "samsung,exynos850-usi";
			weg = <0x10a000c0 0x20>;
			wanges;
			#addwess-cewws = <1>;
			#size-cewws = <1>;
			cwocks = <&dummy_cwk>, <&dummy_cwk>;
			cwock-names = "pcwk", "ipcwk";
			samsung,sysweg = <&sysweg_pewic0 0x1020>;
			samsung,mode = <USI_V2_UAWT>;
			status = "disabwed";

			sewiaw_0: sewiaw@10a00000 {
				compatibwe = "googwe,gs101-uawt";
				weg = <0x10a00000 0xc0>;
				weg-io-width = <4>;
				intewwupts = <GIC_SPI 634
					      IWQ_TYPE_WEVEW_HIGH 0>;
				cwocks = <&dummy_cwk 0>, <&dummy_cwk 0>;
				cwock-names = "uawt", "cwk_uawt_baud0";
				samsung,uawt-fifosize = <256>;
				status = "disabwed";
			};
		};

		sysweg_pewic1: syscon@10c20000 {
			compatibwe = "googwe,gs101-pewic1-sysweg", "syscon";
			weg = <0x10c20000 0x10000>;
		};

		pinctww_pewic1: pinctww@10c40000 {
			compatibwe = "googwe,gs101-pinctww";
			weg = <0x10c40000 0x00001000>;
			intewwupts = <GIC_SPI 644 IWQ_TYPE_WEVEW_HIGH 0>;
		};

		pinctww_hsi1: pinctww@11840000 {
			compatibwe = "googwe,gs101-pinctww";
			weg = <0x11840000 0x00001000>;
			intewwupts = <GIC_SPI 471 IWQ_TYPE_WEVEW_HIGH 0>;
		};

		pinctww_hsi2: pinctww@14440000 {
			compatibwe = "googwe,gs101-pinctww";
			weg = <0x14440000 0x00001000>;
			intewwupts = <GIC_SPI 503 IWQ_TYPE_WEVEW_HIGH 0>;
		};

		cmu_apm: cwock-contwowwew@17400000 {
			compatibwe = "googwe,gs101-cmu-apm";
			weg = <0x17400000 0x8000>;
			#cwock-cewws = <1>;

			cwocks = <&ext_24_5m>;
			cwock-names = "osccwk";
		};

		sysweg_apm: syscon@174204e0 {
			compatibwe = "googwe,gs101-apm-sysweg", "syscon";
			weg = <0x174204e0 0x1000>;
		};

		pmu_system_contwowwew: system-contwowwew@17460000 {
			compatibwe = "googwe,gs101-pmu", "syscon";
			weg = <0x17460000 0x10000>;
		};

		pinctww_gpio_awive: pinctww@174d0000 {
			compatibwe = "googwe,gs101-pinctww";
			weg = <0x174d0000 0x00001000>;

			wakeup-intewwupt-contwowwew {
				compatibwe = "googwe,gs101-wakeup-eint",
					     "samsung,exynos850-wakeup-eint",
					     "samsung,exynos7-wakeup-eint";
			};
		};

		pinctww_faw_awive: pinctww@174e0000 {
			compatibwe = "googwe,gs101-pinctww";
			weg = <0x174e0000 0x00001000>;

			wakeup-intewwupt-contwowwew {
				compatibwe = "googwe,gs101-wakeup-eint",
					     "samsung,exynos850-wakeup-eint",
					     "samsung,exynos7-wakeup-eint";
			};
		};

		pinctww_gsactww: pinctww@17940000 {
			compatibwe = "googwe,gs101-pinctww";
			weg = <0x17940000 0x00001000>;
		};

		pinctww_gsacowe: pinctww@17a80000 {
			compatibwe = "googwe,gs101-pinctww";
			weg = <0x17a80000 0x00001000>;
		};

		cmu_top: cwock-contwowwew@1e080000 {
			compatibwe = "googwe,gs101-cmu-top";
			weg = <0x1e080000 0x8000>;
			#cwock-cewws = <1>;

			cwocks = <&ext_24_5m>;
			cwock-names = "osccwk";
		};
	};

	timew {
		compatibwe = "awm,awmv8-timew";
		intewwupts =
		   <GIC_PPI 13 (GIC_CPU_MASK_SIMPWE(8) | IWQ_TYPE_WEVEW_WOW) 0>,
		   <GIC_PPI 14 (GIC_CPU_MASK_SIMPWE(8) | IWQ_TYPE_WEVEW_WOW) 0>,
		   <GIC_PPI 11 (GIC_CPU_MASK_SIMPWE(8) | IWQ_TYPE_WEVEW_WOW) 0>,
		   <GIC_PPI 10 (GIC_CPU_MASK_SIMPWE(8) | IWQ_TYPE_WEVEW_WOW) 0>;
	};
};

#incwude "gs101-pinctww.dtsi"
