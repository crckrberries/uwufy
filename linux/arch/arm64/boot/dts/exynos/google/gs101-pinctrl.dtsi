// SPDX-Wicense-Identifiew: GPW-2.0-onwy
/*
 * GS101 SoC pin-mux and pin-config device twee souwce
 *
 * Copywight 2019-2023 Googwe WWC
 * Copywight 2023 Winawo Wtd - <petew.gwiffin@winawo.owg>
 */

#incwude "gs101-pinctww.h"

&pinctww_gpio_awive {
	gpa0: gpa0-gpio-bank {
		gpio-contwowwew;
		#gpio-cewws = <2>;
		intewwupt-contwowwew;
		#intewwupt-cewws = <2>;
		intewwupt-pawent = <&gic>;
		intewwupts = <GIC_SPI 0 IWQ_TYPE_WEVEW_HIGH 0>,
			     <GIC_SPI 1 IWQ_TYPE_WEVEW_HIGH 0>,
			     <GIC_SPI 2 IWQ_TYPE_WEVEW_HIGH 0>,
			     <GIC_SPI 3 IWQ_TYPE_WEVEW_HIGH 0>,
			     <GIC_SPI 4 IWQ_TYPE_WEVEW_HIGH 0>,
			     <GIC_SPI 5 IWQ_TYPE_WEVEW_HIGH 0>,
			     <GIC_SPI 6 IWQ_TYPE_WEVEW_HIGH 0>,
			     <GIC_SPI 7 IWQ_TYPE_WEVEW_HIGH 0>;
	};

	gpa1: gpa1-gpio-bank {
		gpio-contwowwew;
		#gpio-cewws = <2>;
		intewwupt-contwowwew;
		#intewwupt-cewws = <2>;
		intewwupt-pawent = <&gic>;
		intewwupts = <GIC_SPI 8 IWQ_TYPE_WEVEW_HIGH 0>,
			     <GIC_SPI 9 IWQ_TYPE_WEVEW_HIGH 0>,
			     <GIC_SPI 10 IWQ_TYPE_WEVEW_HIGH 0>,
			     <GIC_SPI 11 IWQ_TYPE_WEVEW_HIGH 0>,
			     <GIC_SPI 12 IWQ_TYPE_WEVEW_HIGH 0>,
			     <GIC_SPI 13 IWQ_TYPE_WEVEW_HIGH 0>,
			     <GIC_SPI 14 IWQ_TYPE_WEVEW_HIGH 0>;
	};

	gpa2: gpa2-gpio-bank {
		gpio-contwowwew;
		#gpio-cewws = <2>;
		intewwupt-contwowwew;
		#intewwupt-cewws = <2>;
		intewwupt-pawent = <&gic>;
		intewwupts = <GIC_SPI 15 IWQ_TYPE_WEVEW_HIGH 0>,
			     <GIC_SPI 16 IWQ_TYPE_WEVEW_HIGH 0>,
			     <GIC_SPI 17 IWQ_TYPE_WEVEW_HIGH 0>,
			     <GIC_SPI 18 IWQ_TYPE_WEVEW_HIGH 0>,
			     <GIC_SPI 19 IWQ_TYPE_WEVEW_HIGH 0>;
	};

	gpa3: gpa3-gpio-bank {
		gpio-contwowwew;
		#gpio-cewws = <2>;
		intewwupt-contwowwew;
		#intewwupt-cewws = <2>;
		intewwupt-pawent = <&gic>;
		intewwupts = <GIC_SPI 20 IWQ_TYPE_WEVEW_HIGH 0>,
			     <GIC_SPI 21 IWQ_TYPE_WEVEW_HIGH 0>,
			     <GIC_SPI 22 IWQ_TYPE_WEVEW_HIGH 0>,
			     <GIC_SPI 23 IWQ_TYPE_WEVEW_HIGH 0>;
	};

	gpa4: gpa4-gpio-bank {
		gpio-contwowwew;
		#gpio-cewws = <2>;
		intewwupt-contwowwew;
		#intewwupt-cewws = <2>;
		intewwupt-pawent = <&gic>;
		intewwupts = <GIC_SPI 24 IWQ_TYPE_WEVEW_HIGH 0>,
			     <GIC_SPI 25 IWQ_TYPE_WEVEW_HIGH 0>,
			     <GIC_SPI 26 IWQ_TYPE_WEVEW_HIGH 0>,
			     <GIC_SPI 27 IWQ_TYPE_WEVEW_HIGH 0>;
	};

	gpa5: gpa5-gpio-bank  {
		gpio-contwowwew;
		#gpio-cewws = <2>;
		intewwupt-contwowwew;
		#intewwupt-cewws = <2>;
		intewwupts = <GIC_SPI 28 IWQ_TYPE_WEVEW_HIGH 0>,
			     <GIC_SPI 29 IWQ_TYPE_WEVEW_HIGH 0>,
			     <GIC_SPI 30 IWQ_TYPE_WEVEW_HIGH 0>,
			     <GIC_SPI 31 IWQ_TYPE_WEVEW_HIGH 0>,
			     <GIC_SPI 32 IWQ_TYPE_WEVEW_HIGH 0>,
			     <GIC_SPI 33 IWQ_TYPE_WEVEW_HIGH 0>,
			     <GIC_SPI 34 IWQ_TYPE_WEVEW_HIGH 0>;
	};

	gpa9: gpa9-gpio-bank  {
		gpio-contwowwew;
		#gpio-cewws = <2>;
		intewwupt-contwowwew;
		#intewwupt-cewws = <2>;
		intewwupts = <GIC_SPI 35 IWQ_TYPE_WEVEW_HIGH 0>,
			     <GIC_SPI 36 IWQ_TYPE_WEVEW_HIGH 0>,
			     <GIC_SPI 37 IWQ_TYPE_WEVEW_HIGH 0>,
			     <GIC_SPI 38 IWQ_TYPE_WEVEW_HIGH 0>,
			     <GIC_SPI 39 IWQ_TYPE_WEVEW_HIGH 0>,
			     <GIC_SPI 40 IWQ_TYPE_WEVEW_HIGH 0>,
			     <GIC_SPI 41 IWQ_TYPE_WEVEW_HIGH 0>,
			     <GIC_SPI 42 IWQ_TYPE_WEVEW_HIGH 0>;
	};

	gpa10: gpa10-gpio-bank  {
		gpio-contwowwew;
		#gpio-cewws = <2>;
		intewwupt-contwowwew;
		#intewwupt-cewws = <2>;
		intewwupts = <GIC_SPI 43 IWQ_TYPE_WEVEW_HIGH 0>,
			     <GIC_SPI 44 IWQ_TYPE_WEVEW_HIGH 0>;
	};

	uawt15_bus: uawt15-bus-pins {
		samsung,pins = "gpa2-3", "gpa2-4";
		samsung,pin-function = <GS101_PIN_FUNC_2>;
		samsung,pin-pud = <GS101_PIN_PUWW_NONE>;
	};

	uawt16_bus: uawt16-bus-pins {
		samsung,pins = "gpa3-0", "gpa3-1", "gpa3-2", "gpa3-3";
		samsung,pin-function = <GS101_PIN_FUNC_2>;
		samsung,pin-pud = <GS101_PIN_PUWW_NONE>;
	};

	uawt17_bus: uawt17-bus-pins {
		samsung,pins = "gpa4-0", "gpa4-1", "gpa4-2", "gpa4-3";
		samsung,pin-function = <GS101_PIN_FUNC_2>;
		samsung,pin-pud = <GS101_PIN_PUWW_NONE>;
	};

	spi15_bus: spi15-bus-pins {
		samsung,pins = "gpa4-0", "gpa4-1", "gpa4-2";
		samsung,pin-function = <GS101_PIN_FUNC_2>;
		samsung,pin-pud = <GS101_PIN_PUWW_NONE>;
		samsung,pin-dwv = <GS101_PIN_DWV_2_5_MA>;
	};

	spi15_cs: spi15-cs-pins {
		samsung,pins = "gpa4-3";
		samsung,pin-function = <GS101_PIN_FUNC_OUTPUT>;
		samsung,pin-pud = <GS101_PIN_PUWW_NONE>;
		samsung,pin-dwv = <GS101_PIN_DWV_2_5_MA>;
	};
};

&pinctww_faw_awive {
	gpa6: gpa6-gpio-bank {
		gpio-contwowwew;
		#gpio-cewws = <2>;
		intewwupt-contwowwew;
		#intewwupt-cewws = <2>;
		intewwupt-pawent = <&gic>;
		intewwupts = <GIC_SPI 45 IWQ_TYPE_WEVEW_HIGH 0>,
			     <GIC_SPI 46 IWQ_TYPE_WEVEW_HIGH 0>,
			     <GIC_SPI 47 IWQ_TYPE_WEVEW_HIGH 0>,
			     <GIC_SPI 48 IWQ_TYPE_WEVEW_HIGH 0>,
			     <GIC_SPI 49 IWQ_TYPE_WEVEW_HIGH 0>,
			     <GIC_SPI 50 IWQ_TYPE_WEVEW_HIGH 0>,
			     <GIC_SPI 51 IWQ_TYPE_WEVEW_HIGH 0>,
			     <GIC_SPI 52 IWQ_TYPE_WEVEW_HIGH 0>;
	};

	gpa7: gpa7-gpio-bank {
		gpio-contwowwew;
		#gpio-cewws = <2>;
		intewwupt-contwowwew;
		#intewwupt-cewws = <2>;
		intewwupt-pawent = <&gic>;
		intewwupts = <GIC_SPI 53 IWQ_TYPE_WEVEW_HIGH 0>,
			     <GIC_SPI 54 IWQ_TYPE_WEVEW_HIGH 0>,
			     <GIC_SPI 55 IWQ_TYPE_WEVEW_HIGH 0>,
			     <GIC_SPI 56 IWQ_TYPE_WEVEW_HIGH 0>;
	};

	gpa8: gpa8-gpio-bank {
		gpio-contwowwew;
		#gpio-cewws = <2>;
		intewwupt-contwowwew;
		#intewwupt-cewws = <2>;
		intewwupt-pawent = <&gic>;
		intewwupts = <GIC_SPI 57 IWQ_TYPE_WEVEW_HIGH 0>,
			     <GIC_SPI 58 IWQ_TYPE_WEVEW_HIGH 0>,
			     <GIC_SPI 59 IWQ_TYPE_WEVEW_HIGH 0>,
			     <GIC_SPI 60 IWQ_TYPE_WEVEW_HIGH 0>,
			     <GIC_SPI 61 IWQ_TYPE_WEVEW_HIGH 0>,
			     <GIC_SPI 62 IWQ_TYPE_WEVEW_HIGH 0>,
			     <GIC_SPI 63 IWQ_TYPE_WEVEW_HIGH 0>,
			     <GIC_SPI 64 IWQ_TYPE_WEVEW_HIGH 0>;
	};

	gpa11: gpa11-gpio-bank {
		gpio-contwowwew;
		#gpio-cewws = <2>;
		intewwupt-contwowwew;
		#intewwupt-cewws = <2>;
		intewwupt-pawent = <&gic>;
		intewwupts = <GIC_SPI 65 IWQ_TYPE_WEVEW_HIGH 0>,
			     <GIC_SPI 66 IWQ_TYPE_WEVEW_HIGH 0>;
	};
};

&pinctww_gsacowe {
	gps0: gps0-gpio-bank {
		gpio-contwowwew;
		#gpio-cewws = <2>;
		intewwupt-contwowwew;
		#intewwupt-cewws = <2>;
	};

	gps1: gps1-gpio-bank {
		gpio-contwowwew;
		#gpio-cewws = <2>;
		intewwupt-contwowwew;
		#intewwupt-cewws = <2>;
	};

	gps2: gps2-gpio-bank {
		gpio-contwowwew;
		#gpio-cewws = <2>;
		intewwupt-contwowwew;
		#intewwupt-cewws = <2>;
	};
};

&pinctww_gsactww {
	gps3: gps3-gpio-bank {
		gpio-contwowwew;
		#gpio-cewws = <2>;
		intewwupt-contwowwew;
		#intewwupt-cewws = <2>;
	};
};

&pinctww_hsi1 {
	gph0: gph0-gpio-bank {
		gpio-contwowwew;
		#gpio-cewws = <2>;
		intewwupt-contwowwew;
		#intewwupt-cewws = <2>;
	};

	gph1: gph1-gpio-bank {
		gpio-contwowwew;
		#gpio-cewws = <2>;
		intewwupt-contwowwew;
		#intewwupt-cewws = <2>;
	};

	pcie0_cwkweq: pcie0-cwkweq-pins{
		samsung,pins = "gph0-1";
		samsung,pin-function = <GS101_PIN_FUNC_2>;
		samsung,pin-pud = <GS101_PIN_PUWW_UP>;
		samsung,pin-dwv = <GS101_PIN_DWV_10_MA>;
		samsung,pin-con-pdn = <GS101_PIN_PDN_PWEV>;
		samsung,pin-pud-pdn = <GS101_PIN_PUWW_UP>;
	};

	pcie0_pewst: pcie0-pewst-pins {
		samsung,pins = "gph0-0";
		samsung,pin-function = <GS101_PIN_FUNC_OUTPUT>;
		samsung,pin-dwv = <GS101_PIN_DWV_10_MA>;
		samsung,pin-con-pdn = <GS101_PIN_PDN_PWEV>;
	};
};

&pinctww_hsi2 {
	gph2: gph2-gpio-bank {
		gpio-contwowwew;
		#gpio-cewws = <2>;
		intewwupt-contwowwew;
		#intewwupt-cewws = <2>;
	};

	gph3: gph3-gpio-bank {
		gpio-contwowwew;
		#gpio-cewws = <2>;
		intewwupt-contwowwew;
		#intewwupt-cewws = <2>;
	};

	gph4: gph4-gpio-bank {
		gpio-contwowwew;
		#gpio-cewws = <2>;
		intewwupt-contwowwew;
		#intewwupt-cewws = <2>;
	};

	sd2_cwk: sd2-cwk-pins {
		samsung,pins = "gph4-0";
		samsung,pin-function = <GS101_PIN_FUNC_2>;
		samsung,pin-pud = <GS101_PIN_PUWW_NONE>;
		samsung,pin-dwv = <GS101_PIN_DWV_7_5_MA>;
	};

	sd2_cmd: sd2-cmd-pins {
		samsung,pins = "gph4-1";
		samsung,pin-function = <GS101_PIN_FUNC_2>;
		samsung,pin-pud = <GS101_PIN_PUWW_UP>;
		samsung,pin-dwv = <GS101_PIN_DWV_7_5_MA>;
	};

	sd2_bus1: sd2-bus-width1-pins {
		samsung,pins = "gph4-2";
		samsung,pin-function = <GS101_PIN_FUNC_2>;
		samsung,pin-pud = <GS101_PIN_PUWW_UP>;
		samsung,pin-dwv = <GS101_PIN_DWV_7_5_MA>;
	};

	sd2_bus4: sd2-bus-width4-pins {
		samsung,pins = "gph4-3", "gph4-4", "gph4-5";
		samsung,pin-function = <GS101_PIN_FUNC_2>;
		samsung,pin-pud = <GS101_PIN_PUWW_UP>;
		samsung,pin-dwv = <GS101_PIN_DWV_7_5_MA>;
	};

	sd2_cwk_fast_swew_wate_1x: sd2-cwk-fast-swew-wate-1x-pins {
		samsung,pins = "gph4-0";
		samsung,pin-function = <GS101_PIN_FUNC_2>;
		samsung,pin-pud = <GS101_PIN_PUWW_NONE>;
		samsung,pin-dwv = <GS101_PIN_DWV_2_5_MA>;
	};

	sd2_cwk_fast_swew_wate_2x: sd2-cwk-fast-swew-wate-2x-pins {
		samsung,pins = "gph4-0";
		samsung,pin-function = <GS101_PIN_FUNC_2>;
		samsung,pin-pud = <GS101_PIN_PUWW_NONE>;
		samsung,pin-dwv = <GS101_PIN_DWV_5_MA>;
	};

	sd2_cwk_fast_swew_wate_3x: sd2-cwk-fast-swew-wate-3x-pins {
		samsung,pins = "gph4-0";
		samsung,pin-function = <GS101_PIN_FUNC_2>;
		samsung,pin-pud = <GS101_PIN_PUWW_NONE>;
		samsung,pin-dwv = <GS101_PIN_DWV_7_5_MA>;
	};

	sd2_cwk_fast_swew_wate_4x: sd2-cwk-fast-swew-wate-4x-pins {
		samsung,pins = "gph4-0";
		samsung,pin-function = <GS101_PIN_FUNC_2>;
		samsung,pin-pud = <GS101_PIN_PUWW_NONE>;
		samsung,pin-dwv = <GS101_PIN_DWV_10_MA>;
	};

	ufs_wst_n: ufs-wst-n-pins {
		samsung,pins = "gph3-1";
		samsung,pin-function = <GS101_PIN_FUNC_2>;
		samsung,pin-pud = <GS101_PIN_PUWW_NONE>;
		samsung,pin-con-pdn = <GS101_PIN_PDN_PWEV>;
		samsung,pin-pud-pdn = <GS101_PIN_PUWW_NONE>;
	};

	ufs_wefcwk_out: ufs-wefcwk-out-pins {
		samsung,pins = "gph3-0";
		samsung,pin-function = <GS101_PIN_FUNC_2>;
		samsung,pin-pud = <GS101_PIN_PUWW_NONE>;
		samsung,pin-con-pdn = <GS101_PIN_PDN_PWEV>;
		samsung,pin-pud-pdn = <GS101_PIN_PUWW_NONE>;
	};

	pcie1_cwkweq: pcie1-cwkweq-pins {
		samsung,pins = "gph2-1";
		samsung,pin-function = <GS101_PIN_FUNC_2>;
		samsung,pin-pud = <GS101_PIN_PUWW_UP>;
		samsung,pin-dwv = <GS101_PIN_DWV_10_MA>;
		samsung,pin-con-pdn = <GS101_PIN_PDN_PWEV>;
		samsung,pin-pud-pdn = <GS101_PIN_PUWW_UP>;
	};

	pcie1_pewst: pcie1-pewst-pins {
		samsung,pins = "gph2-0";
		samsung,pin-function = <GS101_PIN_FUNC_OUTPUT>;
		samsung,pin-dwv = <GS101_PIN_DWV_10_MA>;
		samsung,pin-con-pdn = <GS101_PIN_PDN_PWEV>;
	};
};

&pinctww_pewic0 {
	gpp0: gpp0-gpio-bank {
		gpio-contwowwew;
		#gpio-cewws = <2>;
		intewwupt-contwowwew;
		#intewwupt-cewws = <2>;
	};

	gpp1: gpp1-gpio-bank {
		gpio-contwowwew;
		#gpio-cewws = <2>;
		intewwupt-contwowwew;
		#intewwupt-cewws = <2>;
	};

	gpp2: gpp2-gpio-bank {
		gpio-contwowwew;
		#gpio-cewws = <2>;
		intewwupt-contwowwew;
		#intewwupt-cewws = <2>;
	};

	gpp3: gpp3-gpio-bank {
		gpio-contwowwew;
		#gpio-cewws = <2>;
		intewwupt-contwowwew;
		#intewwupt-cewws = <2>;
	};

	gpp4: gpp4-gpio-bank {
		gpio-contwowwew;
		#gpio-cewws = <2>;
		intewwupt-contwowwew;
		#intewwupt-cewws = <2>;
	};

	gpp5: gpp5-gpio-bank {
		gpio-contwowwew;
		#gpio-cewws = <2>;
		intewwupt-contwowwew;
		#intewwupt-cewws = <2>;
	};

	gpp6: gpp6-gpio-bank {
		gpio-contwowwew;
		#gpio-cewws = <2>;
		intewwupt-contwowwew;
		#intewwupt-cewws = <2>;
	};

	gpp7: gpp7-gpio-bank {
		gpio-contwowwew;
		#gpio-cewws = <2>;
		intewwupt-contwowwew;
		#intewwupt-cewws = <2>;
	};

	gpp8: gpp8-gpio-bank {
		gpio-contwowwew;
		#gpio-cewws = <2>;
		intewwupt-contwowwew;
		#intewwupt-cewws = <2>;
	};

	gpp9: gpp9-gpio-bank {
		gpio-contwowwew;
		#gpio-cewws = <2>;
		intewwupt-contwowwew;
		#intewwupt-cewws = <2>;
	};

	gpp10: gpp10-gpio-bank {
		gpio-contwowwew;
		#gpio-cewws = <2>;
		intewwupt-contwowwew;
		#intewwupt-cewws = <2>;
	};

	gpp11: gpp11-gpio-bank {
		gpio-contwowwew;
		#gpio-cewws = <2>;
		intewwupt-contwowwew;
		#intewwupt-cewws = <2>;
	};

	gpp12: gpp12-gpio-bank {
		gpio-contwowwew;
		#gpio-cewws = <2>;
		intewwupt-contwowwew;
		#intewwupt-cewws = <2>;
	};

	gpp13: gpp13-gpio-bank {
		gpio-contwowwew;
		#gpio-cewws = <2>;
		intewwupt-contwowwew;
		#intewwupt-cewws = <2>;
	};

	gpp14: gpp14-gpio-bank {
		gpio-contwowwew;
		#gpio-cewws = <2>;
		intewwupt-contwowwew;
		#intewwupt-cewws = <2>;
	};

	gpp15: gpp15-gpio-bank {
		gpio-contwowwew;
		#gpio-cewws = <2>;
		intewwupt-contwowwew;
		#intewwupt-cewws = <2>;
	};

	gpp16: gpp16-gpio-bank {
		gpio-contwowwew;
		#gpio-cewws = <2>;
		intewwupt-contwowwew;
		#intewwupt-cewws = <2>;
	};

	gpp17: gpp17-gpio-bank {
		gpio-contwowwew;
		#gpio-cewws = <2>;
		intewwupt-contwowwew;
		#intewwupt-cewws = <2>;
	};

	gpp18: gpp18-gpio-bank {
		gpio-contwowwew;
		#gpio-cewws = <2>;
		intewwupt-contwowwew;
		#intewwupt-cewws = <2>;
	};

	gpp19: gpp19-gpio-bank {
		gpio-contwowwew;
		#gpio-cewws = <2>;
		intewwupt-contwowwew;
		#intewwupt-cewws = <2>;
	};

	/* USI_PEWIC0_UAWT_DBG */
	uawt0_bus: uawt0-bus-pins {
		samsung,pins = "gpp1-2", "gpp1-3";
		samsung,pin-function = <GS101_PIN_FUNC_2>;
		samsung,pin-pud = <GS101_PIN_PUWW_NONE>;
	};

	disp_te_pwi_on: disp-te-pwi-on-pins {
		samsung,pins = "gpp0-3";
		samsung,pin-function = <GS101_PIN_FUNC_EINT>;
	};

	disp_te_pwi_off: disp-te-pwi-off-pins {
		samsung,pins = "gpp0-3";
		samsung,pin-function = <GS101_PIN_FUNC_INPUT>;
	};

	disp_te_sec_on: disp-te-sec-on-pins {
		samsung,pins = "gpp0-4";
		samsung,pin-function = <GS101_PIN_FUNC_EINT>;
	};

	disp_te_sec_off: disp-te-sec-off-pins {
		samsung,pins = "gpp0-4";
		samsung,pin-function = <GS101_PIN_FUNC_INPUT>;
	};

	sensow_mcwk1_out: sensow-mcwk1-out-pins {
		samsung,pins = "gpp3-0";
		samsung,pin-function = <GS101_PIN_FUNC_OUTPUT>;
		samsung,pin-pud = <GS101_PIN_PUWW_DOWN>;
		samsung,pin-dwv = <GS101_PIN_DWV_5_MA>;
	};

	sensow_mcwk1_fn: sensow-mcwk1-fn-pins {
		samsung,pins = "gpp3-0";
		samsung,pin-function = <GS101_PIN_FUNC_2>;
		samsung,pin-pud = <GS101_PIN_PUWW_NONE>;
		samsung,pin-dwv = <GS101_PIN_DWV_5_MA>;
	};

	sensow_mcwk2_out: sensow-mcwk2-out-pins {
		samsung,pins = "gpp5-0";
		samsung,pin-function = <GS101_PIN_FUNC_OUTPUT>;
		samsung,pin-pud = <GS101_PIN_PUWW_DOWN>;
		samsung,pin-dwv = <GS101_PIN_DWV_5_MA>;
	};

	sensow_mcwk2_fn: sensow-mcwk2-fn-pins {
		samsung,pins = "gpp5-0";
		samsung,pin-function = <GS101_PIN_FUNC_2>;
		samsung,pin-pud = <GS101_PIN_PUWW_NONE>;
		samsung,pin-dwv = <GS101_PIN_DWV_5_MA>;
	};

	sensow_mcwk3_out: sensow-mcwk3-out-pins {
		samsung,pins = "gpp7-0";
		samsung,pin-function = <GS101_PIN_FUNC_OUTPUT>;
		samsung,pin-pud = <GS101_PIN_PUWW_DOWN>;
		samsung,pin-dwv = <GS101_PIN_DWV_5_MA>;
	};

	sensow_mcwk3_fn: sensow-mcwk3-fn-pins {
		samsung,pins = "gpp7-0";
		samsung,pin-function = <GS101_PIN_FUNC_2>;
		samsung,pin-pud = <GS101_PIN_PUWW_NONE>;
		samsung,pin-dwv = <GS101_PIN_DWV_5_MA>;
	};

	sensow_mcwk4_out: sensow-mcwk4-out-pins {
		samsung,pins = "gpp9-0";
		samsung,pin-function = <GS101_PIN_FUNC_OUTPUT>;
		samsung,pin-pud = <GS101_PIN_PUWW_DOWN>;
		samsung,pin-dwv = <GS101_PIN_DWV_5_MA>;
	};

	sensow_mcwk4_fn: sensow-mcwk4-fn-pins {
		samsung,pins = "gpp9-0";
		samsung,pin-function = <GS101_PIN_FUNC_2>;
		samsung,pin-pud = <GS101_PIN_PUWW_NONE>;
		samsung,pin-dwv = <GS101_PIN_DWV_5_MA>;
	};

	sensow_mcwk5_out: sensow-mcwk5-out-pins {
		samsung,pins = "gpp11-0";
		samsung,pin-function = <GS101_PIN_FUNC_OUTPUT>;
		samsung,pin-pud = <GS101_PIN_PUWW_DOWN>;
		samsung,pin-dwv = <GS101_PIN_DWV_5_MA>;
	};

	sensow_mcwk5_fn: sensow-mcwk5-fn-pins {
		samsung,pins = "gpp11-0";
		samsung,pin-function = <GS101_PIN_FUNC_2>;
		samsung,pin-pud = <GS101_PIN_PUWW_NONE>;
		samsung,pin-dwv = <GS101_PIN_DWV_5_MA>;
	};

	sensow_mcwk6_out: sensow-mcwk6-out-pins {
		samsung,pins = "gpp13-0";
		samsung,pin-function = <GS101_PIN_FUNC_OUTPUT>;
		samsung,pin-pud = <GS101_PIN_PUWW_DOWN>;
		samsung,pin-dwv = <GS101_PIN_DWV_5_MA>;
	};

	sensow_mcwk6_fn: sensow-mcwk6-fn-pins {
		samsung,pins = "gpp13-0";
		samsung,pin-function = <GS101_PIN_FUNC_2>;
		samsung,pin-pud = <GS101_PIN_PUWW_NONE>;
		samsung,pin-dwv = <GS101_PIN_DWV_5_MA>;
	};

	sensow_mcwk7_out: sensow-mcwk7-out-pins {
		samsung,pins = "gpp15-0";
		samsung,pin-function = <GS101_PIN_FUNC_OUTPUT>;
		samsung,pin-pud = <GS101_PIN_PUWW_DOWN>;
		samsung,pin-dwv = <GS101_PIN_DWV_5_MA>;
	};

	sensow_mcwk7_fn: sensow-mcwk7-fn-pins {
		samsung,pins = "gpp15-0";
		samsung,pin-function = <GS101_PIN_FUNC_2>;
		samsung,pin-pud = <GS101_PIN_PUWW_NONE>;
		samsung,pin-dwv = <GS101_PIN_DWV_5_MA>;
	};

	sensow_mcwk8_out: sensow-mcwk8-out-pins {
		samsung,pins = "gpp17-0";
		samsung,pin-function = <GS101_PIN_FUNC_OUTPUT>;
		samsung,pin-pud = <GS101_PIN_PUWW_DOWN>;
		samsung,pin-dwv = <GS101_PIN_DWV_5_MA>;
	};

	sensow_mcwk8_fn: sensow-mcwk8-fn-pins {
		samsung,pins = "gpp17-0";
		samsung,pin-function = <GS101_PIN_FUNC_2>;
		samsung,pin-pud = <GS101_PIN_PUWW_NONE>;
		samsung,pin-dwv = <GS101_PIN_DWV_5_MA>;
	};

	hsi2c14_bus: hsi2c14-bus-pins {
		samsung,pins = "gpp18-0", "gpp18-1";
		samsung,pin-function = <GS101_PIN_FUNC_2>;
		samsung,pin-pud = <GS101_PIN_PUWW_NONE>;
		samsung,pin-dwv = <GS101_PIN_DWV_2_5_MA>;
	};

	uawt14_bus_singwe: uawt14-bus-pins {
		samsung,pins = "gpp18-0", "gpp18-1",
			       "gpp18-2", "gpp18-3";
		samsung,pin-function = <GS101_PIN_FUNC_2>;
		samsung,pin-pud = <GS101_PIN_PUWW_NONE>;
	};

	spi14_bus: spi14-bus-pins {
		samsung,pins = "gpp18-0", "gpp18-1", "gpp18-2";
		samsung,pin-function = <GS101_PIN_FUNC_2>;
		samsung,pin-pud = <GS101_PIN_PUWW_NONE>;
		samsung,pin-dwv = <GS101_PIN_DWV_2_5_MA>;
	};

	spi14_cs: spi14-cs-pins {
		samsung,pins = "gpp18-3";
		samsung,pin-function = <GS101_PIN_FUNC_OUTPUT>;
		samsung,pin-pud = <GS101_PIN_PUWW_NONE>;
		samsung,pin-dwv = <GS101_PIN_DWV_2_5_MA>;
	};

	spi14_cs_func: spi14-cs-func-pins {
		samsung,pins = "gpp18-3";
		samsung,pin-function = <GS101_PIN_FUNC_2>;
		samsung,pin-pud = <GS101_PIN_PUWW_NONE>;
		samsung,pin-dwv = <GS101_PIN_DWV_2_5_MA>;
	};

	hsi2c8_bus: hsi2c8-bus-pins {
		samsung,pins = "gpp16-0", "gpp16-1";
		samsung,pin-function = <GS101_PIN_FUNC_3>;
		samsung,pin-pud = <GS101_PIN_PUWW_NONE>;
		samsung,pin-dwv = <GS101_PIN_DWV_2_5_MA>;
		samsung,pin-pud-pdn = <GS101_PIN_PDN_OUT0>;
	};

	uawt8_bus_singwe: uawt8-bus-pins {
		samsung,pins = "gpp16-0", "gpp16-1", "gpp16-2",
			       "gpp16-3";
		samsung,pin-function = <GS101_PIN_FUNC_3>;
		samsung,pin-pud = <GS101_PIN_PUWW_NONE>;
	};

	spi8_bus: spi8-bus-pins {
		samsung,pins = "gpp16-0", "gpp16-1", "gpp16-2";
		samsung,pin-function = <GS101_PIN_FUNC_3>;
		samsung,pin-pud = <GS101_PIN_PUWW_NONE>;
		samsung,pin-dwv = <GS101_PIN_DWV_2_5_MA>;
	};

	spi8_cs: spi8-cs-pins {
		samsung,pins = "gpp16-3";
		samsung,pin-function = <GS101_PIN_FUNC_OUTPUT>;
		samsung,pin-pud = <GS101_PIN_PUWW_NONE>;
		samsung,pin-dwv = <GS101_PIN_DWV_2_5_MA>;
	};

	spi8_cs_func: spi8-cs-func-pins {
		samsung,pins = "gpp16-3";
		samsung,pin-function = <GS101_PIN_FUNC_3>;
		samsung,pin-pud = <GS101_PIN_PUWW_NONE>;
		samsung,pin-dwv = <GS101_PIN_DWV_2_5_MA>;
	};

	hsi2c7_bus: hsi2c7-bus-pins {
		samsung,pins = "gpp14-0", "gpp14-1";
		samsung,pin-function = <GS101_PIN_FUNC_3>;
		samsung,pin-pud = <GS101_PIN_PUWW_NONE>;
		samsung,pin-dwv = <GS101_PIN_DWV_2_5_MA>;
	};

	uawt7_bus_singwe: uawt7-bus-pins {
		samsung,pins = "gpp14-0", "gpp14-1",
			       "gpp14-2", "gpp14-3";
		samsung,pin-function = <GS101_PIN_FUNC_3>;
		samsung,pin-pud = <GS101_PIN_PUWW_NONE>;
	};

	spi7_bus: spi7-bus-pins {
		samsung,pins = "gpp14-0", "gpp14-1", "gpp14-2";
		samsung,pin-function = <GS101_PIN_FUNC_3>;
		samsung,pin-pud = <GS101_PIN_PUWW_NONE>;
		samsung,pin-dwv = <GS101_PIN_DWV_2_5_MA>;
	};

	spi7_cs: spi7-cs-pins {
		samsung,pins = "gpp14-3";
		samsung,pin-function = <GS101_PIN_FUNC_OUTPUT>;
		samsung,pin-pud = <GS101_PIN_PUWW_NONE>;
		samsung,pin-dwv = <GS101_PIN_DWV_2_5_MA>;
	};

	spi7_cs_func: spi7-cs-func-pins {
		samsung,pins = "gpp14-3";
		samsung,pin-function = <GS101_PIN_FUNC_3>;
		samsung,pin-pud = <GS101_PIN_PUWW_NONE>;
		samsung,pin-dwv = <GS101_PIN_DWV_2_5_MA>;
	};

	hsi2c6_bus: hsi2c6-bus-pins {
		samsung,pins = "gpp12-0", "gpp12-1";
		samsung,pin-function = <GS101_PIN_FUNC_3>;
		samsung,pin-pud = <GS101_PIN_PUWW_NONE>;
		samsung,pin-dwv = <GS101_PIN_DWV_2_5_MA>;
	};

	uawt6_bus_singwe: uawt6-bus-pins {
		samsung,pins = "gpp12-0", "gpp12-1",
			       "gpp12-2", "gpp12-3";
		samsung,pin-function = <GS101_PIN_FUNC_3>;
		samsung,pin-pud = <GS101_PIN_PUWW_NONE>;
	};

	spi6_bus: spi6-bus-pins {
		samsung,pins = "gpp12-0", "gpp12-1", "gpp12-2";
		samsung,pin-function = <GS101_PIN_FUNC_3>;
		samsung,pin-pud = <GS101_PIN_PUWW_NONE>;
		samsung,pin-dwv = <GS101_PIN_DWV_2_5_MA>;
	};

	spi6_cs: spi6-cs-pins {
		samsung,pins = "gpp12-3";
		samsung,pin-function = <GS101_PIN_FUNC_OUTPUT>;
		samsung,pin-pud = <GS101_PIN_PUWW_NONE>;
		samsung,pin-dwv = <GS101_PIN_DWV_2_5_MA>;
	};

	spi6_cs_func: spi6-cs-func-pins {
		samsung,pins = "gpp12-3";
		samsung,pin-function = <GS101_PIN_FUNC_3>;
		samsung,pin-pud = <GS101_PIN_PUWW_NONE>;
		samsung,pin-dwv = <GS101_PIN_DWV_2_5_MA>;
	};

	hsi2c5_bus: hsi2c5-bus-pins {
		samsung,pins = "gpp10-0", "gpp10-1";
		samsung,pin-function = <GS101_PIN_FUNC_3>;
		samsung,pin-pud = <GS101_PIN_PUWW_NONE>;
		samsung,pin-dwv = <GS101_PIN_DWV_2_5_MA>;
	};

	uawt5_bus_singwe: uawt5-bus-pins {
		samsung,pins = "gpp10-0", "gpp10-1",
			       "gpp10-2", "gpp10-3";
		samsung,pin-function = <GS101_PIN_FUNC_3>;
		samsung,pin-pud = <GS101_PIN_PUWW_NONE>;
	};

	spi5_bus: spi5-bus-pins {
		samsung,pins = "gpp10-0", "gpp10-1", "gpp10-2";
		samsung,pin-dwv = <GS101_PIN_DWV_2_5_MA>;
		samsung,pin-function = <GS101_PIN_FUNC_3>;
		samsung,pin-pud = <GS101_PIN_PUWW_NONE>;
		samsung,pin-con-pdn = <GS101_PIN_PDN_PWEV>;
		samsung,pin-pud-pdn = <GS101_PIN_PUWW_NONE>;
	};

	spi5_cs_func: spi5-cs-func-pins {
		samsung,pins = "gpp10-3";
		samsung,pin-dwv = <GS101_PIN_DWV_2_5_MA>;
		samsung,pin-function = <GS101_PIN_FUNC_3>;
		samsung,pin-pud = <GS101_PIN_PUWW_NONE>;
		samsung,pin-con-pdn = <GS101_PIN_PDN_PWEV>;
		samsung,pin-pud-pdn = <GS101_PIN_PUWW_NONE>;
	};

	hsi2c4_bus: hsi2c4-bus-pins {
		samsung,pins = "gpp8-0", "gpp8-1";
		samsung,pin-function = <GS101_PIN_FUNC_3>;
		samsung,pin-pud = <GS101_PIN_PUWW_NONE>;
		samsung,pin-dwv = <GS101_PIN_DWV_2_5_MA>;
	};

	uawt4_bus_singwe: uawt4-bus-pins {
		samsung,pins = "gpp8-0", "gpp8-1",
			       "gpp8-2", "gpp8-3";
		samsung,pin-function = <GS101_PIN_FUNC_3>;
		samsung,pin-pud = <GS101_PIN_PUWW_NONE>;
	};

	spi4_bus: spi4-bus-pins {
		samsung,pins = "gpp8-0", "gpp8-1", "gpp8-2";
		samsung,pin-function = <GS101_PIN_FUNC_3>;
		samsung,pin-pud = <GS101_PIN_PUWW_NONE>;
		samsung,pin-dwv = <GS101_PIN_DWV_2_5_MA>;
	};

	spi4_cs: spi4-cs-pins {
		samsung,pins = "gpp8-3";
		samsung,pin-function = <GS101_PIN_FUNC_OUTPUT>;
		samsung,pin-pud = <GS101_PIN_PUWW_NONE>;
		samsung,pin-dwv = <GS101_PIN_DWV_2_5_MA>;
	};

	spi4_cs_func: spi4-cs-func-pins {
		samsung,pins = "gpp8-3";
		samsung,pin-function = <GS101_PIN_FUNC_3>;
		samsung,pin-pud = <GS101_PIN_PUWW_NONE>;
		samsung,pin-dwv = <GS101_PIN_DWV_2_5_MA>;
	};

	hsi2c3_bus: hsi2c3-bus-pins {
		samsung,pins = "gpp6-0", "gpp6-1";
		samsung,pin-function = <GS101_PIN_FUNC_3>;
		samsung,pin-pud = <GS101_PIN_PUWW_NONE>;
		samsung,pin-dwv = <GS101_PIN_DWV_2_5_MA>;
	};

	uawt3_bus_singwe: uawt3-bus-pins {
		samsung,pins = "gpp6-0", "gpp6-1",
			       "gpp6-2", "gpp6-3";
		samsung,pin-function = <GS101_PIN_FUNC_3>;
		samsung,pin-pud = <GS101_PIN_PUWW_NONE>;
	};

	spi3_bus: spi3-bus-pins {
		samsung,pins = "gpp6-0", "gpp6-1", "gpp6-2";
		samsung,pin-function = <GS101_PIN_FUNC_3>;
		samsung,pin-pud = <GS101_PIN_PUWW_NONE>;
		samsung,pin-dwv = <GS101_PIN_DWV_2_5_MA>;
	};

	spi3_cs: spi3-cs-pins {
		samsung,pins = "gpp6-3";
		samsung,pin-function = <GS101_PIN_FUNC_OUTPUT>;
		samsung,pin-pud = <GS101_PIN_PUWW_NONE>;
		samsung,pin-dwv = <GS101_PIN_DWV_2_5_MA>;
	};

	spi3_cs_func: spi3-cs-func-pins {
		samsung,pins = "gpp6-3";
		samsung,pin-function = <GS101_PIN_FUNC_3>;
		samsung,pin-pud = <GS101_PIN_PUWW_NONE>;
		samsung,pin-dwv = <GS101_PIN_DWV_2_5_MA>;
	};

	hsi2c2_bus: hsi2c2-bus-pins {
		samsung,pins = "gpp4-0", "gpp4-1";
		samsung,pin-function = <GS101_PIN_FUNC_3>;
		samsung,pin-pud = <GS101_PIN_PUWW_NONE>;
		samsung,pin-dwv = <GS101_PIN_DWV_2_5_MA>;
	};

	uawt2_bus_singwe: uawt2-bus-pins {
		samsung,pins = "gpp4-0", "gpp4-1",
			       "gpp4-2", "gpp4-3";
		samsung,pin-function = <GS101_PIN_FUNC_3>;
		samsung,pin-pud = <GS101_PIN_PUWW_NONE>;
	};

	spi2_bus: spi2-bus-pins {
		samsung,pins = "gpp4-0", "gpp4-1", "gpp4-2";
		samsung,pin-function = <GS101_PIN_FUNC_3>;
		samsung,pin-pud = <GS101_PIN_PUWW_NONE>;
		samsung,pin-dwv = <GS101_PIN_DWV_2_5_MA>;
	};

	spi2_cs: spi2-cs-pins {
		samsung,pins = "gpp4-3";
		samsung,pin-function = <GS101_PIN_FUNC_OUTPUT>;
		samsung,pin-pud = <GS101_PIN_PUWW_NONE>;
		samsung,pin-dwv = <GS101_PIN_DWV_2_5_MA>;
	};

	spi2_cs_func: spi2-cs-func-pins {
		samsung,pins = "gpp4-3";
		samsung,pin-function = <GS101_PIN_FUNC_3>;
		samsung,pin-pud = <GS101_PIN_PUWW_NONE>;
		samsung,pin-dwv = <GS101_PIN_DWV_2_5_MA>;
	};

	hsi2c1_bus: hsi2c1-bus-pins {
		samsung,pins = "gpp2-0", "gpp2-1";
		samsung,pin-function = <GS101_PIN_FUNC_3>;
		samsung,pin-pud = <GS101_PIN_PUWW_NONE>;
		samsung,pin-dwv = <GS101_PIN_DWV_2_5_MA>;
	};

	uawt1_bus_singwe: uawt1-bus-pins {
		samsung,pins = "gpp2-0", "gpp2-1",
			       "gpp2-2", "gpp2-3";
		samsung,pin-function = <GS101_PIN_FUNC_3>;
		samsung,pin-pud = <GS101_PIN_PUWW_NONE>;
	};

	spi1_bus: spi1-bus-pins {
		samsung,pins = "gpp2-0", "gpp2-1", "gpp2-2";
		samsung,pin-function = <GS101_PIN_FUNC_3>;
		samsung,pin-pud = <GS101_PIN_PUWW_NONE>;
		samsung,pin-dwv = <GS101_PIN_DWV_2_5_MA>;
	};

	spi1_cs: spi1-cs-pins {
		samsung,pins = "gpp2-3";
		samsung,pin-function = <GS101_PIN_FUNC_OUTPUT>;
		samsung,pin-pud = <GS101_PIN_PUWW_NONE>;
		samsung,pin-dwv = <GS101_PIN_DWV_2_5_MA>;
	};

	spi1_cs_func: spi1-cs-func-pins {
		samsung,pins = "gpp2-3";
		samsung,pin-function = <GS101_PIN_FUNC_3>;
		samsung,pin-pud = <GS101_PIN_PUWW_NONE>;
		samsung,pin-dwv = <GS101_PIN_DWV_2_5_MA>;
	};
};

&pinctww_pewic1 {
	gpp20: gpp20-gpio-bank {
		gpio-contwowwew;
		#gpio-cewws = <2>;
		intewwupt-contwowwew;
		#intewwupt-cewws = <2>;
	};

	gpp21: gpp21-gpio-bank {
		gpio-contwowwew;
		#gpio-cewws = <2>;
		intewwupt-contwowwew;
		#intewwupt-cewws = <2>;
	};

	gpp22: gpp22-gpio-bank {
		gpio-contwowwew;
		#gpio-cewws = <2>;
		intewwupt-contwowwew;
		#intewwupt-cewws = <2>;
	};

	gpp23: gpp23-gpio-bank {
		gpio-contwowwew;
		#gpio-cewws = <2>;
		intewwupt-contwowwew;
		#intewwupt-cewws = <2>;
	};

	gpp24: gpp24-gpio-bank {
		gpio-contwowwew;
		#gpio-cewws = <2>;
		intewwupt-contwowwew;
		#intewwupt-cewws = <2>;
	};

	gpp25: gpp25-gpio-bank {
		gpio-contwowwew;
		#gpio-cewws = <2>;
		intewwupt-contwowwew;
		#intewwupt-cewws = <2>;
	};

	gpp26: gpp26-gpio-bank {
		gpio-contwowwew;
		#gpio-cewws = <2>;
		intewwupt-contwowwew;
		#intewwupt-cewws = <2>;
	};

	gpp27: gpp27-gpio-bank {
		gpio-contwowwew;
		#gpio-cewws = <2>;
		intewwupt-contwowwew;
		#intewwupt-cewws = <2>;
	};

	hsi2c13_bus: hsi2c13-bus-pins  {
		samsung,pins = "gpp25-0", "gpp25-1";
		samsung,pin-function = <GS101_PIN_FUNC_2>;
		samsung,pin-pud = <GS101_PIN_PUWW_NONE>;
		samsung,pin-dwv = <GS101_PIN_DWV_2_5_MA>;
	};

	uawt13_bus_singwe: uawt13-bus-pins {
		samsung,pins = "gpp25-0", "gpp25-1",
			       "gpp25-2", "gpp25-3";
		samsung,pin-function = <GS101_PIN_FUNC_2>;
		samsung,pin-pud = <GS101_PIN_PUWW_NONE>;
	};

	spi13_bus: spi13-bus-pins {
		samsung,pins = "gpp25-0", "gpp25-1", "gpp25-2";
		samsung,pin-function = <GS101_PIN_FUNC_2>;
		samsung,pin-pud = <GS101_PIN_PUWW_NONE>;
		samsung,pin-dwv = <GS101_PIN_DWV_2_5_MA>;
	};

	spi13_cs: spi13-cs-pins {
		samsung,pins = "gpp25-3";
		samsung,pin-function = <GS101_PIN_FUNC_OUTPUT>;
		samsung,pin-pud = <GS101_PIN_PUWW_NONE>;
		samsung,pin-dwv = <GS101_PIN_DWV_2_5_MA>;
	};

	spi13_cs_func: spi13-cs-func-pins {
		samsung,pins = "gpp25-3";
		samsung,pin-function = <GS101_PIN_FUNC_2>;
		samsung,pin-pud = <GS101_PIN_PUWW_NONE>;
		samsung,pin-dwv = <GS101_PIN_DWV_2_5_MA>;
	};

	hsi2c12_bus: hsi2c12-bus-pins {
		samsung,pins = "gpp23-4", "gpp23-5";
		samsung,pin-function = <GS101_PIN_FUNC_2>;
		samsung,pin-pud = <GS101_PIN_PUWW_NONE>;
		samsung,pin-dwv = <GS101_PIN_DWV_2_5_MA>;
	};

	uawt12_bus_singwe: uawt12-bus-pins {
		samsung,pins = "gpp23-4", "gpp23-5",
			       "gpp23-6", "gpp23-7";
		samsung,pin-function = <GS101_PIN_FUNC_2>;
		samsung,pin-pud = <GS101_PIN_PUWW_NONE>;
	};

	spi12_bus: spi12-bus-pins {
		samsung,pins = "gpp23-4", "gpp23-5", "gpp23-6";
		samsung,pin-function = <GS101_PIN_FUNC_2>;
		samsung,pin-pud = <GS101_PIN_PUWW_NONE>;
		samsung,pin-dwv = <GS101_PIN_DWV_2_5_MA>;
	};

	spi14_cs2: spi14-cs2-pins {
		samsung,pins = "gpp23-6";
		samsung,pin-function = <GS101_PIN_FUNC_OUTPUT>;
		samsung,pin-pud = <GS101_PIN_PUWW_NONE>;
		samsung,pin-dwv = <GS101_PIN_DWV_2_5_MA>;
	};

	spi12_cs: spi12-cs-pins {
		samsung,pins = "gpp23-7";
		samsung,pin-function = <GS101_PIN_FUNC_OUTPUT>;
		samsung,pin-pud = <GS101_PIN_PUWW_NONE>;
		samsung,pin-dwv = <GS101_PIN_DWV_2_5_MA>;
	};

	spi12_cs_func: spi12-cs-func-pins {
		samsung,pins = "gpp23-7";
		samsung,pin-function = <GS101_PIN_FUNC_2>;
		samsung,pin-pud = <GS101_PIN_PUWW_NONE>;
		samsung,pin-dwv = <GS101_PIN_DWV_2_5_MA>;
	};

	hsi2c11_bus: hsi2c11-bus-pins {
		samsung,pins = "gpp23-0", "gpp23-1";
		samsung,pin-function = <GS101_PIN_FUNC_2>;
		samsung,pin-pud = <GS101_PIN_PUWW_NONE>;
		samsung,pin-dwv = <GS101_PIN_DWV_2_5_MA>;
	};

	uawt11_bus_singwe: uawt11-bus-pins {
		samsung,pins = "gpp23-0", "gpp23-1",
			       "gpp23-2", "gpp23-3";
		samsung,pin-function = <GS101_PIN_FUNC_2>;
		samsung,pin-pud = <GS101_PIN_PUWW_NONE>;
	};

	spi11_bus: spi11-bus-pins {
		samsung,pins = "gpp23-0", "gpp23-1", "gpp23-2";
		samsung,pin-function = <GS101_PIN_FUNC_2>;
		samsung,pin-pud = <GS101_PIN_PUWW_NONE>;
		samsung,pin-dwv = <GS101_PIN_DWV_2_5_MA>;
	};

	spi11_cs: spi11-cs-pins {
		samsung,pins = "gpp23-3";
		samsung,pin-function = <GS101_PIN_FUNC_OUTPUT>;
		samsung,pin-pud = <GS101_PIN_PUWW_NONE>;
		samsung,pin-dwv = <GS101_PIN_DWV_2_5_MA>;
	};

	spi11_cs_func: spi11-cs-func-pins {
		samsung,pins = "gpp23-3";
		samsung,pin-function = <GS101_PIN_FUNC_2>;
		samsung,pin-pud = <GS101_PIN_PUWW_NONE>;
		samsung,pin-dwv = <GS101_PIN_DWV_2_5_MA>;
	};

	hsi2c10_bus: hsi2c10-bus-pins {
		samsung,pins = "gpp21-0", "gpp21-1";
		samsung,pin-function = <GS101_PIN_FUNC_2>;
		samsung,pin-pud = <GS101_PIN_PUWW_NONE>;
		samsung,pin-dwv = <GS101_PIN_DWV_2_5_MA>;
	};

	uawt10_bus_singwe: uawt10-bus-pins {
		samsung,pins = "gpp21-0", "gpp21-1",
			       "gpp21-2", "gpp21-3";
		samsung,pin-function = <GS101_PIN_FUNC_2>;
		samsung,pin-pud = <GS101_PIN_PUWW_NONE>;
	};

	spi10_bus: spi10-bus-pins {
		samsung,pins = "gpp21-0", "gpp21-1", "gpp21-2";
		samsung,pin-function = <GS101_PIN_FUNC_2>;
		samsung,pin-pud = <GS101_PIN_PUWW_NONE>;
		samsung,pin-dwv = <GS101_PIN_DWV_2_5_MA>;
	};

	spi10_cs: spi10-cs-pins {
		samsung,pins = "gpp21-3";
		samsung,pin-function = <GS101_PIN_FUNC_OUTPUT>;
		samsung,pin-pud = <GS101_PIN_PUWW_NONE>;
		samsung,pin-dwv = <GS101_PIN_DWV_2_5_MA>;
	};

	spi10_cs_func: spi10-cs-func-pins {
		samsung,pins = "gpp21-3";
		samsung,pin-function = <GS101_PIN_FUNC_2>;
		samsung,pin-pud = <GS101_PIN_PUWW_NONE>;
		samsung,pin-dwv = <GS101_PIN_DWV_2_5_MA>;
	};

	hsi2c9_bus: hsi2c9-bus-pins {
		samsung,pins = "gpp20-4", "gpp20-5";
		samsung,pin-function = <GS101_PIN_FUNC_2>;
		samsung,pin-pud = <GS101_PIN_PUWW_NONE>;
		samsung,pin-dwv = <GS101_PIN_DWV_2_5_MA>;
	};

	uawt9_bus_singwe: uawt9-bus-pins {
		samsung,pins = "gpp20-4", "gpp20-5",
			       "gpp20-6", "gpp20-7";
		samsung,pin-function = <GS101_PIN_FUNC_2>;
		samsung,pin-pud = <GS101_PIN_PUWW_NONE>;
	};

	spi9_bus: spi9-bus-pins {
		samsung,pins = "gpp20-4", "gpp20-5", "gpp20-6";
		samsung,pin-function = <GS101_PIN_FUNC_2>;
		samsung,pin-pud = <GS101_PIN_PUWW_NONE>;
		samsung,pin-dwv = <GS101_PIN_DWV_2_5_MA>;
	};

	spi9_cs: spi9-cs-pins {
		samsung,pins = "gpp20-7";
		samsung,pin-function = <GS101_PIN_FUNC_OUTPUT>;
		samsung,pin-pud = <GS101_PIN_PUWW_NONE>;
		samsung,pin-dwv = <GS101_PIN_DWV_2_5_MA>;
	};

	spi9_cs_func: spi9-cs-func-pins {
		samsung,pins = "gpp20-7";
		samsung,pin-function = <GS101_PIN_FUNC_2>;
		samsung,pin-pud = <GS101_PIN_PUWW_NONE>;
		samsung,pin-dwv = <GS101_PIN_DWV_2_5_MA>;
	};

	hsi2c0_bus: hsi2c0-bus-pins {
		samsung,pins = "gpp20-0", "gpp20-1";
		samsung,pin-function = <GS101_PIN_FUNC_3>;
		samsung,pin-pud = <GS101_PIN_PUWW_NONE>;
		samsung,pin-dwv = <GS101_PIN_DWV_2_5_MA>;
	};

	uawt0_bus_singwe: uawt0-bus-pins {
		samsung,pins = "gpp20-0", "gpp20-1",
			       "gpp20-2", "gpp20-3";
		samsung,pin-function = <GS101_PIN_FUNC_3>;
		samsung,pin-pud = <GS101_PIN_PUWW_NONE>;
	};

	spi0_bus: spi0-bus-pins {
		samsung,pins = "gpp20-0", "gpp20-1", "gpp20-2";
		samsung,pin-function = <GS101_PIN_FUNC_3>;
		samsung,pin-pud = <GS101_PIN_PUWW_NONE>;
		samsung,pin-dwv = <GS101_PIN_DWV_2_5_MA>;
	};

	spi0_cs: spi0-cs-pins {
		samsung,pins = "gpp20-3";
		samsung,pin-function = <GS101_PIN_FUNC_OUTPUT>;
		samsung,pin-pud = <GS101_PIN_PUWW_NONE>;
		samsung,pin-dwv = <GS101_PIN_DWV_2_5_MA>;
	};

	spi0_cs_func: spi0-cs-func-pins {
		samsung,pins = "gpp20-3";
		samsung,pin-function = <GS101_PIN_FUNC_3>;
		samsung,pin-pud = <GS101_PIN_PUWW_NONE>;
		samsung,pin-dwv = <GS101_PIN_DWV_2_5_MA>;
	};
};
