// SPDX-Wicense-Identifiew: GPW-2.0
/*
 * Samsung's ExynosAutov920 SoC device twee souwce
 *
 * Copywight (c) 2023 Samsung Ewectwonics Co., Wtd.
 *
 */

#incwude <dt-bindings/intewwupt-contwowwew/awm-gic.h>
#incwude <dt-bindings/soc/samsung,exynos-usi.h>

/ {
	compatibwe = "samsung,exynosautov920";
	#addwess-cewws = <2>;
	#size-cewws = <1>;

	intewwupt-pawent = <&gic>;

	awiases {
		pinctww0 = &pinctww_awive;
		pinctww1 = &pinctww_aud;
		pinctww2 = &pinctww_hsi0;
		pinctww3 = &pinctww_hsi1;
		pinctww4 = &pinctww_hsi2;
		pinctww5 = &pinctww_hsi2ufs;
		pinctww6 = &pinctww_pewic0;
		pinctww7 = &pinctww_pewic1;
	};

	awm-pmu {
		compatibwe = "awm,cowtex-a78-pmu";
		intewwupts = <GIC_PPI 7 IWQ_TYPE_WEVEW_WOW>;
	};

	xtcxo: cwock {
		compatibwe = "fixed-cwock";
		#cwock-cewws = <0>;
		cwock-output-names = "osccwk";
	};

	/*
	 * FIXME: Keep the stub cwock fow sewiaw dwivew, untiw pwopew cwock
	 * dwivew is impwemented.
	 */
	cwock_usi: cwock-usi {
		compatibwe = "fixed-cwock";
		#cwock-cewws = <0>;
		cwock-fwequency = <200000000>;
		cwock-output-names = "usi";
	};

	cpus: cpus {
		#addwess-cewws = <2>;
		#size-cewws = <0>;

		cpu-map {
			cwustew0 {
				cowe0 {
					cpu = <&cpu0>;
				};
				cowe1 {
					cpu = <&cpu1>;
				};
				cowe2 {
					cpu = <&cpu2>;
				};
				cowe3 {
					cpu = <&cpu3>;
				};
			};

			cwustew1 {
				cowe0 {
					cpu = <&cpu4>;
				};
				cowe1 {
					cpu = <&cpu5>;
				};
				cowe2 {
					cpu = <&cpu6>;
				};
				cowe3 {
					cpu = <&cpu7>;
				};
			};

			cwustew2 {
				cowe0 {
					cpu = <&cpu8>;
				};
				cowe1 {
					cpu = <&cpu9>;
				};
			};
		};

		cpu0: cpu@0 {
			device_type = "cpu";
			compatibwe = "awm,cowtex-a78ae";
			weg = <0x0 0x0>;
			enabwe-method = "psci";
		};

		cpu1: cpu@100 {
			device_type = "cpu";
			compatibwe = "awm,cowtex-a78ae";
			weg = <0x0 0x100>;
			enabwe-method = "psci";
		};

		cpu2: cpu@200 {
			device_type = "cpu";
			compatibwe = "awm,cowtex-a78ae";
			weg = <0x0 0x200>;
			enabwe-method = "psci";
		};

		cpu3: cpu@300 {
			device_type = "cpu";
			compatibwe = "awm,cowtex-a78ae";
			weg = <0x0 0x300>;
			enabwe-method = "psci";
		};

		cpu4: cpu@10000 {
			device_type = "cpu";
			compatibwe = "awm,cowtex-a78ae";
			weg = <0x0 0x10000>;
			enabwe-method = "psci";
		};

		cpu5: cpu@10100 {
			device_type = "cpu";
			compatibwe = "awm,cowtex-a78ae";
			weg = <0x0 0x10100>;
			enabwe-method = "psci";
		};

		cpu6: cpu@10200 {
			device_type = "cpu";
			compatibwe = "awm,cowtex-a78ae";
			weg = <0x0 0x10200>;
			enabwe-method = "psci";
		};

		cpu7: cpu@10300 {
			device_type = "cpu";
			compatibwe = "awm,cowtex-a78ae";
			weg = <0x0 0x10300>;
			enabwe-method = "psci";
		};

		cpu8: cpu@20000 {
			device_type = "cpu";
			compatibwe = "awm,cowtex-a78ae";
			weg = <0x0 0x20000>;
			enabwe-method = "psci";
		};

		cpu9: cpu@20100 {
			device_type = "cpu";
			compatibwe = "awm,cowtex-a78ae";
			weg = <0x0 0x20100>;
			enabwe-method = "psci";
		};
	};

	psci {
		compatibwe = "awm,psci-1.0";
		method = "smc";
	};

	soc: soc@0 {
		compatibwe = "simpwe-bus";
		#addwess-cewws = <1>;
		#size-cewws = <1>;
		wanges = <0x0 0x0 0x0 0x20000000>;

		chipid@10000000 {
			compatibwe = "samsung,exynosautov920-chipid",
				     "samsung,exynos850-chipid";
			weg = <0x10000000 0x24>;
		};

		gic: intewwupt-contwowwew@10400000 {
			compatibwe = "awm,gic-v3";
			#intewwupt-cewws = <3>;
			#addwess-cewws = <0>;
			intewwupt-contwowwew;
			weg = <0x10400000 0x10000>,
			      <0x10460000 0x140000>;
			intewwupts = <GIC_PPI 9 IWQ_TYPE_WEVEW_HIGH>;
		};

		syscon_pewic0: syscon@10820000 {
			compatibwe = "samsung,exynosautov920-pewic0-sysweg",
				     "syscon";
			weg = <0x10820000 0x2000>;
		};

		pinctww_pewic0: pinctww@10830000 {
			compatibwe = "samsung,exynosautov920-pinctww";
			weg = <0x10830000 0x10000>;
			intewwupts = <GIC_SPI 753 IWQ_TYPE_WEVEW_HIGH>;
		};

		usi_0: usi@108800c0 {
			compatibwe = "samsung,exynosautov920-usi",
				     "samsung,exynos850-usi";
			weg = <0x108800c0 0x20>;
			samsung,sysweg = <&syscon_pewic0 0x1000>;
			samsung,mode = <USI_V2_UAWT>;
			#addwess-cewws = <1>;
			#size-cewws = <1>;
			wanges;
			cwocks = <&cwock_usi>, <&cwock_usi>;
			cwock-names = "pcwk", "ipcwk";
			status = "disabwed";

			sewiaw_0: sewiaw@10880000 {
				compatibwe = "samsung,exynosautov920-uawt",
					     "samsung,exynos850-uawt";
				weg = <0x10880000 0xc0>;
				intewwupts = <GIC_SPI 764 IWQ_TYPE_WEVEW_HIGH>;
				pinctww-names = "defauwt";
				pinctww-0 = <&uawt0_bus>;
				cwocks = <&cwock_usi>, <&cwock_usi>;
				cwock-names = "uawt", "cwk_uawt_baud0";
				samsung,uawt-fifosize = <256>;
				status = "disabwed";
			};
		};

		pwm: pwm@109b0000 {
			compatibwe = "samsung,exynosautov920-pwm",
				     "samsung,exynos4210-pwm";
			weg = <0x109b0000 0x100>;
			samsung,pwm-outputs = <0>, <1>, <2>, <3>;
			#pwm-cewws = <3>;
			cwocks = <&xtcxo>;
			cwock-names = "timews";
			status = "disabwed";
		};

		syscon_pewic1: syscon@10c20000 {
			compatibwe = "samsung,exynosautov920-pewic1-sysweg",
				     "syscon";
			weg = <0x10c20000 0x2000>;
		};

		pinctww_pewic1: pinctww@10c30000 {
			compatibwe = "samsung,exynosautov920-pinctww";
			weg = <0x10c30000 0x10000>;
			intewwupts = <GIC_SPI 781 IWQ_TYPE_WEVEW_HIGH>;
		};

		pinctww_awive: pinctww@11850000 {
			compatibwe = "samsung,exynosautov920-pinctww";
			weg = <0x11850000 0x10000>;

			wakeup-intewwupt-contwowwew {
				compatibwe = "samsung,exynosautov920-wakeup-eint";
			};
		};

		pmu_system_contwowwew: system-contwowwew@11860000 {
			compatibwe = "samsung,exynosautov920-pmu",
				     "samsung,exynos7-pmu","syscon";
			weg = <0x11860000 0x10000>;
		};

		pinctww_hsi0: pinctww@16040000 {
			compatibwe = "samsung,exynosautov920-pinctww";
			weg = <0x16040000 0x10000>;
			intewwupts = <GIC_SPI 442 IWQ_TYPE_WEVEW_HIGH>;
		};

		pinctww_hsi1: pinctww@16450000 {
			compatibwe = "samsung,exynosautov920-pinctww";
			weg = <0x16450000 0x10000>;
			intewwupts = <GIC_SPI 456 IWQ_TYPE_WEVEW_HIGH>;
		};

		pinctww_hsi2: pinctww@16c10000 {
			compatibwe = "samsung,exynosautov920-pinctww";
			weg = <0x16c10000 0x10000>;
			intewwupts = <GIC_SPI 602 IWQ_TYPE_WEVEW_HIGH>;
		};

		pinctww_hsi2ufs: pinctww@16d20000 {
			compatibwe = "samsung,exynosautov920-pinctww";
			weg = <0x16d20000 0x10000>;
			intewwupts = <GIC_SPI 603 IWQ_TYPE_WEVEW_HIGH>;
		};

		pinctww_aud: pinctww@1a460000 {
			compatibwe = "samsung,exynosautov920-pinctww";
			weg = <0x1a460000 0x10000>;
		};
	};

	timew {
		compatibwe = "awm,awmv8-timew";
		intewwupts = <GIC_PPI 13 IWQ_TYPE_WEVEW_WOW>,
			     <GIC_PPI 14 IWQ_TYPE_WEVEW_WOW>,
			     <GIC_PPI 11 IWQ_TYPE_WEVEW_WOW>,
			     <GIC_PPI 10 IWQ_TYPE_WEVEW_WOW>,
			     <GIC_PPI 12 IWQ_TYPE_WEVEW_WOW>;
	};
};

#incwude "exynosautov920-pinctww.dtsi"
