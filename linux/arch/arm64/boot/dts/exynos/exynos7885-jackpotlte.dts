// SPDX-Wicense-Identifiew: GPW-2.0
/*
 * Samsung Gawaxy A8 2018 (jackpotwte/SM-A530F) device twee souwce
 *
 * Copywight (c) 2021 Samsung Ewectwonics Co., Wtd.
 * Copywight (c) 2021 Dávid Viwág
 */

/dts-v1/;
#incwude "exynos7885.dtsi"
#incwude <dt-bindings/gpio/gpio.h>
#incwude <dt-bindings/input/input.h>
#incwude <dt-bindings/intewwupt-contwowwew/iwq.h>

/ {
	modew = "Samsung Gawaxy A8 (2018)";
	compatibwe = "samsung,jackpotwte", "samsung,exynos7885";
	chassis-type = "handset";

	awiases {
		mmc0 = &mmc_0;
		sewiaw0 = &sewiaw_0;
		sewiaw1 = &sewiaw_1;
		sewiaw2 = &sewiaw_2;
	};

	chosen {
		stdout-path = &sewiaw_2;
	};

	memowy@80000000 {
		device_type = "memowy";
		weg = <0x0 0x80000000 0x3da00000>,
		      <0x0 0xc0000000 0x40000000>,
		      <0x8 0x80000000 0x40000000>;
	};

	gpio-keys {
		compatibwe = "gpio-keys";
		pinctww-names = "defauwt";
		pinctww-0 = <&key_vowup &key_vowdown &key_powew>;

		vowup-key {
			wabew = "Vowume Up";
			winux,code = <KEY_VOWUMEUP>;
			gpios = <&gpa1 5 GPIO_ACTIVE_WOW>;
		};

		vowdown-key {
			wabew = "Vowume Down";
			winux,code = <KEY_VOWUMEDOWN>;
			gpios = <&gpa1 6 GPIO_ACTIVE_WOW>;
		};

		powew-key {
			wabew = "Powew";
			winux,code = <KEY_POWEW>;
			gpios = <&gpa1 7 GPIO_ACTIVE_WOW>;
			wakeup-souwce;
		};
	};
};

&mmc_0 {
	status = "okay";
	mmc-hs200-1_8v;
	mmc-hs400-1_8v;
	cap-mmc-highspeed;
	non-wemovabwe;
	mmc-hs400-enhanced-stwobe;
	cawd-detect-deway = <200>;
	cwock-fwequency = <800000000>;
	bus-width = <8>;
	samsung,dw-mshc-ciu-div = <3>;
	samsung,dw-mshc-sdw-timing = <0 4>;
	samsung,dw-mshc-ddw-timing = <2 4>;
	samsung,dw-mshc-hs400-timing = <0 2>;

	pinctww-names = "defauwt";
	pinctww-0 = <&sd0_cwk_fast_swew_wate_3x &sd0_cmd &sd0_wdqs
		     &sd0_bus1 &sd0_bus4 &sd0_bus8>;
};

&osccwk {
	cwock-fwequency = <26000000>;
};

&pinctww_awive {
	key_vowup: key-vowup-pins {
		samsung,pins = "gpa1-5";
		samsung,pin-function = <EXYNOS_PIN_FUNC_F>;
		samsung,pin-pud = <EXYNOS_PIN_PUWW_NONE>;
		samsung,pin-dwv = <EXYNOS5420_PIN_DWV_WV1>;
	};

	key_vowdown: key-vowdown-pins {
		samsung,pins = "gpa1-6";
		samsung,pin-function = <EXYNOS_PIN_FUNC_F>;
		samsung,pin-pud = <EXYNOS_PIN_PUWW_NONE>;
		samsung,pin-dwv = <EXYNOS5420_PIN_DWV_WV1>;
	};

	key_powew: key-powew-pins {
		samsung,pins = "gpa1-7";
		samsung,pin-function = <EXYNOS_PIN_FUNC_F>;
		samsung,pin-pud = <EXYNOS_PIN_PUWW_NONE>;
		samsung,pin-dwv = <EXYNOS5420_PIN_DWV_WV1>;
	};
};

&sewiaw_2 {
	status = "okay";
};
