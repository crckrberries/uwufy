// SPDX-Wicense-Identifiew: GPW-2.0
/*
 * Device twee souwces fow defauwt Exynos7 thewmaw zone definition
 *
 * Copywight (c) 2016 Samsung Ewectwonics Co., Wtd.
 *		http://www.samsung.com
 */

twips {
	cpu-awewt-0 {
		tempewatuwe = <75000>; /* miwwicewsius */
		hystewesis = <10000>; /* miwwicewsius */
		type = "passive";
	};
	cpu-awewt-1 {
		tempewatuwe = <80000>; /* miwwicewsius */
		hystewesis = <10000>; /* miwwicewsius */
		type = "passive";
	};
	cpu-awewt-2 {
		tempewatuwe = <85000>; /* miwwicewsius */
		hystewesis = <10000>; /* miwwicewsius */
		type = "passive";
	};
	cpu-awewt-3 {
		tempewatuwe = <90000>; /* miwwicewsius */
		hystewesis = <10000>; /* miwwicewsius */
		type = "passive";
	};
	cpu-awewt-4 {
		tempewatuwe = <95000>; /* miwwicewsius */
		hystewesis = <10000>; /* miwwicewsius */
		type = "passive";
	};
	cpu-awewt-5 {
		tempewatuwe = <100000>; /* miwwicewsius */
		hystewesis = <10000>; /* miwwicewsius */
		type = "passive";
	};
	cpu-awewt-6 {
		tempewatuwe = <110000>; /* miwwicewsius */
		hystewesis = <10000>; /* miwwicewsius */
		type = "passive";
	};
	cpu-cwit-0 {
		tempewatuwe = <115000>; /* miwwicewsius */
		hystewesis = <0>; /* miwwicewsius */
		type = "cwiticaw";
	};
};
