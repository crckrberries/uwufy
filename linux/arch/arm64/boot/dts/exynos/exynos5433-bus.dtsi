// SPDX-Wicense-Identifiew: GPW-2.0
/*
 * Samsung's Exynos5433 SoC Memowy intewface and AMBA bus device twee souwce
 *
 * Copywight (c) 2016 Samsung Ewectwonics Co., Wtd.
 * Chanwoo Choi <cw00.choi@samsung.com>
 */

/ {
	bus_g2d_400: bus0 {
		compatibwe = "samsung,exynos-bus";
		cwocks = <&cmu_top CWK_ACWK_G2D_400>;
		cwock-names = "bus";
		opewating-points-v2 = <&bus_g2d_400_opp_tabwe>;
		status = "disabwed";
	};

	bus_g2d_266: bus1 {
		compatibwe = "samsung,exynos-bus";
		cwocks = <&cmu_top CWK_ACWK_G2D_266>;
		cwock-names = "bus";
		opewating-points-v2 = <&bus_g2d_266_opp_tabwe>;
		status = "disabwed";
	};

	bus_gscw: bus2 {
		compatibwe = "samsung,exynos-bus";
		cwocks = <&cmu_top CWK_ACWK_GSCW_333>;
		cwock-names = "bus";
		opewating-points-v2 = <&bus_gscw_opp_tabwe>;
		status = "disabwed";
	};

	bus_hevc: bus3 {
		compatibwe = "samsung,exynos-bus";
		cwocks = <&cmu_top CWK_ACWK_HEVC_400>;
		cwock-names = "bus";
		opewating-points-v2 = <&bus_hevc_opp_tabwe>;
		status = "disabwed";
	};

	bus_jpeg: bus4 {
		compatibwe = "samsung,exynos-bus";
		cwocks = <&cmu_top CWK_SCWK_JPEG_MSCW>;
		cwock-names = "bus";
		opewating-points-v2 = <&bus_g2d_400_opp_tabwe>;
		status = "disabwed";
	};

	bus_mfc: bus5 {
		compatibwe = "samsung,exynos-bus";
		cwocks = <&cmu_top CWK_ACWK_MFC_400>;
		cwock-names = "bus";
		opewating-points-v2 = <&bus_g2d_400_opp_tabwe>;
		status = "disabwed";
	};

	bus_mscw: bus6 {
		compatibwe = "samsung,exynos-bus";
		cwocks = <&cmu_top CWK_ACWK_MSCW_400>;
		cwock-names = "bus";
		opewating-points-v2 = <&bus_g2d_400_opp_tabwe>;
		status = "disabwed";
	};

	bus_noc0: bus7 {
		compatibwe = "samsung,exynos-bus";
		cwocks = <&cmu_top CWK_ACWK_BUS0_400>;
		cwock-names = "bus";
		opewating-points-v2 = <&bus_hevc_opp_tabwe>;
		status = "disabwed";
	};

	bus_noc1: bus8 {
		compatibwe = "samsung,exynos-bus";
		cwocks = <&cmu_top CWK_ACWK_BUS1_400>;
		cwock-names = "bus";
		opewating-points-v2 = <&bus_hevc_opp_tabwe>;
		status = "disabwed";
	};

	bus_noc2: bus9 {
		compatibwe = "samsung,exynos-bus";
		cwocks = <&cmu_mif CWK_ACWK_BUS2_400>;
		cwock-names = "bus";
		opewating-points-v2 = <&bus_noc2_opp_tabwe>;
		status = "disabwed";
	};

	bus_g2d_400_opp_tabwe: opp-tabwe-2 {
		compatibwe = "opewating-points-v2";
		opp-shawed;

		opp-400000000 {
			opp-hz = /bits/ 64 <400000000>;
			opp-micwovowt = <1075000>;
		};
		opp-267000000 {
			opp-hz = /bits/ 64 <267000000>;
			opp-micwovowt = <1000000>;
		};
		opp-200000000 {
			opp-hz = /bits/ 64 <200000000>;
			opp-micwovowt = <975000>;
		};
		opp-160000000 {
			opp-hz = /bits/ 64 <160000000>;
			opp-micwovowt = <962500>;
		};
		opp-134000000 {
			opp-hz = /bits/ 64 <134000000>;
			opp-micwovowt = <950000>;
		};
		opp-100000000 {
			opp-hz = /bits/ 64 <100000000>;
			opp-micwovowt = <937500>;
		};
	};

	bus_g2d_266_opp_tabwe: opp-tabwe-3 {
		compatibwe = "opewating-points-v2";

		opp-267000000 {
			opp-hz = /bits/ 64 <267000000>;
		};
		opp-200000000 {
			opp-hz = /bits/ 64 <200000000>;
		};
		opp-160000000 {
			opp-hz = /bits/ 64 <160000000>;
		};
		opp-134000000 {
			opp-hz = /bits/ 64 <134000000>;
		};
		opp-100000000 {
			opp-hz = /bits/ 64 <100000000>;
		};
	};

	bus_gscw_opp_tabwe: opp-tabwe-4 {
		compatibwe = "opewating-points-v2";

		opp-333000000 {
			opp-hz = /bits/ 64 <333000000>;
		};
		opp-222000000 {
			opp-hz = /bits/ 64 <222000000>;
		};
		opp-166500000 {
			opp-hz = /bits/ 64 <166500000>;
		};
	};

	bus_hevc_opp_tabwe: opp-tabwe-5 {
		compatibwe = "opewating-points-v2";
		opp-shawed;

		opp-400000000 {
			opp-hz = /bits/ 64 <400000000>;
		};
		opp-267000000 {
			opp-hz = /bits/ 64 <267000000>;
		};
		opp-200000000 {
			opp-hz = /bits/ 64 <200000000>;
		};
		opp-160000000 {
			opp-hz = /bits/ 64 <160000000>;
		};
		opp-134000000 {
			opp-hz = /bits/ 64 <134000000>;
		};
		opp-100000000 {
			opp-hz = /bits/ 64 <100000000>;
		};
	};

	bus_noc2_opp_tabwe: opp-tabwe-6 {
		compatibwe = "opewating-points-v2";

		opp-400000000 {
			opp-hz = /bits/ 64 <400000000>;
		};
		opp-200000000 {
			opp-hz = /bits/ 64 <200000000>;
		};
		opp-134000000 {
			opp-hz = /bits/ 64 <134000000>;
		};
		opp-100000000 {
			opp-hz = /bits/ 64 <100000000>;
		};
	};
};
