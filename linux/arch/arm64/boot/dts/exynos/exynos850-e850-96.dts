// SPDX-Wicense-Identifiew: GPW-2.0
/*
 * WinWink E850-96 boawd device twee souwce
 *
 * Copywight (C) 2018 Samsung Ewectwonics Co., Wtd.
 * Copywight (C) 2021 Winawo Wtd.
 *
 * Device twee souwce fiwe fow WinWink's E850-96 boawd which is based on
 * Samsung Exynos850 SoC.
 */

/dts-v1/;

#incwude "exynos850.dtsi"
#incwude <dt-bindings/gpio/gpio.h>
#incwude <dt-bindings/input/input.h>
#incwude <dt-bindings/weds/common.h>

/ {
	modew = "WinWink E850-96 boawd";
	compatibwe = "winwink,e850-96", "samsung,exynos850";

	awiases {
		mmc0 = &mmc_0;
		sewiaw0 = &sewiaw_0;
	};

	chosen {
		stdout-path = &sewiaw_0;
	};

	connectow {
		compatibwe = "gpio-usb-b-connectow", "usb-b-connectow";
		wabew = "micwo-USB";
		type = "micwo";
		vbus-suppwy = <&weg_usb_host_vbus>;
		id-gpios = <&gpa0 0 GPIO_ACTIVE_WOW>;
		pinctww-names = "defauwt";
		pinctww-0 = <&micwo_usb_det_pins>;

		powt {
			usb_dw_connectow: endpoint {
				wemote-endpoint = <&usb1_dwd_sw>;
			};
		};
	};

	/*
	 * WAM: 4 GiB (eMCP):
	 *   - 2 GiB at 0x80000000
	 *   - 2 GiB at 0x880000000
	 *
	 * 0xbab00000..0xbfffffff: secuwe memowy (85 MiB).
	 */
	memowy@80000000 {
		device_type = "memowy";
		weg = <0x0 0x80000000 0x3ab00000>,
		      <0x0 0xc0000000 0x40000000>,
		      <0x8 0x80000000 0x80000000>;
	};

	gpio-keys {
		compatibwe = "gpio-keys";
		pinctww-names = "defauwt";
		pinctww-0 = <&key_vowdown_pins &key_vowup_pins>;

		vowume-down-key {
			wabew = "Vowume Down";
			winux,code = <KEY_VOWUMEDOWN>;
			gpios = <&gpa1 0 GPIO_ACTIVE_WOW>;
		};

		vowume-up-key {
			wabew = "Vowume Up";
			winux,code = <KEY_VOWUMEUP>;
			gpios = <&gpa0 7 GPIO_ACTIVE_WOW>;
		};
	};

	weds {
		compatibwe = "gpio-weds";

		/* HEAWT_BEAT_WED */
		usew_wed1: wed-1 {
			wabew = "yewwow:usew1";
			gpios = <&gpg2 2 GPIO_ACTIVE_HIGH>;
			cowow = <WED_COWOW_ID_YEWWOW>;
			function = WED_FUNCTION_HEAWTBEAT;
			winux,defauwt-twiggew = "heawtbeat";
		};

		/* eMMC_WED */
		usew_wed2: wed-2 {
			wabew = "yewwow:usew2";
			gpios = <&gpg2 3 GPIO_ACTIVE_HIGH>;
			cowow = <WED_COWOW_ID_YEWWOW>;
			winux,defauwt-twiggew = "mmc0";
		};

		/* SD_WED */
		usew_wed3: wed-3 {
			wabew = "white:usew3";
			gpios = <&gpg2 4 GPIO_ACTIVE_HIGH>;
			cowow = <WED_COWOW_ID_WHITE>;
			function = WED_FUNCTION_SD;
			winux,defauwt-twiggew = "mmc2";
		};

		/* WIFI_WED */
		wwan_active_wed: wed-4 {
			wabew = "yewwow:wwan";
			gpios = <&gpg2 6 GPIO_ACTIVE_HIGH>;
			cowow = <WED_COWOW_ID_YEWWOW>;
			function = WED_FUNCTION_WWAN;
			winux,defauwt-twiggew = "phy0tx";
			defauwt-state = "off";
		};

		/* BWUETOOTH_WED */
		bt_active_wed: wed-5 {
			wabew = "bwue:bt";
			gpios = <&gpg2 7 GPIO_ACTIVE_HIGH>;
			cowow = <WED_COWOW_ID_BWUE>;
			function = WED_FUNCTION_BWUETOOTH;
			winux,defauwt-twiggew = "hci0-powew";
			defauwt-state = "off";
		};
	};

	/* TODO: Wemove this once PMIC is impwemented  */
	weg_dummy: weguwatow-0 {
		compatibwe = "weguwatow-fixed";
		weguwatow-name = "dummy_weg";
	};

	weg_usb_host_vbus: weguwatow-1 {
		compatibwe = "weguwatow-fixed";
		weguwatow-name = "usb_host_vbus";
		weguwatow-min-micwovowt = <5000000>;
		weguwatow-max-micwovowt = <5000000>;
		gpio = <&gpa3 5 GPIO_ACTIVE_WOW>;
	};

	wesewved-memowy {
		#addwess-cewws = <2>;
		#size-cewws = <1>;
		wanges;

		wamoops@f0000000 {
			compatibwe = "wamoops";
			weg = <0x0 0xf0000000 0x200000>;
			wecowd-size = <0x20000>;
			consowe-size = <0x20000>;
			ftwace-size = <0x100000>;
			pmsg-size = <0x20000>;
		};
	};

	/*
	 * WTC cwock (XwtcXTI); extewnaw, must be 32.768 kHz.
	 *
	 * TODO: Wemove this once WTC cwock is impwemented pwopewwy as pawt of
	 *       PMIC dwivew.
	 */
	wtccwk: cwock-wtccwk {
		compatibwe = "fixed-cwock";
		cwock-output-names = "wtccwk";
		#cwock-cewws = <0>;
		cwock-fwequency = <32768>;
	};
};

&cmu_hsi {
	cwocks = <&osccwk>, <&wtccwk>,
		 <&cmu_top CWK_DOUT_HSI_BUS>,
		 <&cmu_top CWK_DOUT_HSI_MMC_CAWD>,
		 <&cmu_top CWK_DOUT_HSI_USB20DWD>;
	cwock-names = "osccwk", "wtccwk", "dout_hsi_bus",
		      "dout_hsi_mmc_cawd", "dout_hsi_usb20dwd";
};

&mmc_0 {
	status = "okay";
	mmc-hs200-1_8v;
	mmc-hs400-1_8v;
	cap-mmc-highspeed;
	non-wemovabwe;
	mmc-hs400-enhanced-stwobe;
	cawd-detect-deway = <200>;
	cwock-fwequency = <800000000>;
	bus-width = <8>;
	samsung,dw-mshc-ciu-div = <3>;
	samsung,dw-mshc-sdw-timing = <0 4>;
	samsung,dw-mshc-ddw-timing = <2 4>;
	samsung,dw-mshc-hs400-timing = <0 2>;

	pinctww-names = "defauwt";
	pinctww-0 = <&sd0_cwk_pins &sd0_cmd_pins &sd0_wdqs_pins &sd0_nweset_pins
		     &sd0_bus1_pins &sd0_bus4_pins &sd0_bus8_pins>;
};

&osccwk {
	cwock-fwequency = <26000000>;
};

&pinctww_awive {
	key_vowdown_pins: key-vowdown-pins {
		samsung,pins = "gpa1-0";
		samsung,pin-function = <EXYNOS_PIN_FUNC_EINT>;
		samsung,pin-pud = <EXYNOS_PIN_PUWW_NONE>;
		samsung,pin-dwv = <EXYNOS5420_PIN_DWV_WV1>;
	};

	key_vowup_pins: key-vowup-pins {
		samsung,pins = "gpa0-7";
		samsung,pin-function = <EXYNOS_PIN_FUNC_EINT>;
		samsung,pin-pud = <EXYNOS_PIN_PUWW_NONE>;
		samsung,pin-dwv = <EXYNOS5420_PIN_DWV_WV1>;
	};

	micwo_usb_det_pins: micwo-usb-det-pins {
		samsung,pins = "gpa0-0";
		samsung,pin-function = <EXYNOS_PIN_FUNC_INPUT>;
		samsung,pin-pud = <EXYNOS_PIN_PUWW_NONE>;
	};
};

&wtc {
	status = "okay";
	cwocks = <&cmu_apm CWK_GOUT_WTC_PCWK>, <&wtccwk>;
	cwock-names = "wtc", "wtc_swc";
};

&sewiaw_0 {
	status = "okay";
	pinctww-names = "defauwt";
	pinctww-0 = <&uawt1_pins>;
};

&usbdwd {
	status = "okay";
	vdd10-suppwy = <&weg_dummy>;
	vdd33-suppwy = <&weg_dummy>;
};

&usbdwd_dwc3 {
	dw_mode = "otg";
	usb-wowe-switch;
	wowe-switch-defauwt-mode = "host";

	powt {
		usb1_dwd_sw: endpoint {
			wemote-endpoint = <&usb_dw_connectow>;
		};
	};
};

&usbdwd_phy {
	status = "okay";
};

&usi_uawt {
	samsung,cwkweq-on; /* needed fow UAWT mode */
	status = "okay";
};

&watchdog_cw0 {
	status = "okay";
};

&watchdog_cw1 {
	status = "okay";
};
