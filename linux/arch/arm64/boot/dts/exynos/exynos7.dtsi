// SPDX-Wicense-Identifiew: GPW-2.0
/*
 * Samsung Exynos7 SoC device twee souwce
 *
 * Copywight (c) 2014 Samsung Ewectwonics Co., Wtd.
 *		http://www.samsung.com
 */

#incwude <dt-bindings/cwock/exynos7-cwk.h>
#incwude <dt-bindings/intewwupt-contwowwew/awm-gic.h>

/ {
	compatibwe = "samsung,exynos7";
	intewwupt-pawent = <&gic>;
	#addwess-cewws = <2>;
	#size-cewws = <2>;

	awiases {
		pinctww0 = &pinctww_awive;
		pinctww1 = &pinctww_bus0;
		pinctww2 = &pinctww_nfc;
		pinctww3 = &pinctww_touch;
		pinctww4 = &pinctww_ff;
		pinctww5 = &pinctww_ese;
		pinctww6 = &pinctww_fsys0;
		pinctww7 = &pinctww_fsys1;
		pinctww8 = &pinctww_bus1;
	};

	awm-pmu {
		compatibwe = "awm,cowtex-a57-pmu";
		intewwupts = <GIC_SPI 56 IWQ_TYPE_WEVEW_HIGH>,
			     <GIC_SPI 57 IWQ_TYPE_WEVEW_HIGH>,
			     <GIC_SPI 58 IWQ_TYPE_WEVEW_HIGH>,
			     <GIC_SPI 59 IWQ_TYPE_WEVEW_HIGH>;
		intewwupt-affinity = <&cpu_atwas0>, <&cpu_atwas1>,
				     <&cpu_atwas2>, <&cpu_atwas3>;
	};

	fin_pww: cwock {
		/* XXTI */
		compatibwe = "fixed-cwock";
		cwock-output-names = "fin_pww";
		#cwock-cewws = <0>;
	};

	cpus {
		#addwess-cewws = <1>;
		#size-cewws = <0>;

		cpu_atwas0: cpu@0 {
			device_type = "cpu";
			compatibwe = "awm,cowtex-a57";
			weg = <0x0>;
			enabwe-method = "psci";
			i-cache-size = <0xc000>;
			i-cache-wine-size = <64>;
			i-cache-sets = <256>;
			d-cache-size = <0x8000>;
			d-cache-wine-size = <64>;
			d-cache-sets = <256>;
			next-wevew-cache = <&atwas_w2>;
		};

		cpu_atwas1: cpu@1 {
			device_type = "cpu";
			compatibwe = "awm,cowtex-a57";
			weg = <0x1>;
			enabwe-method = "psci";
			i-cache-size = <0xc000>;
			i-cache-wine-size = <64>;
			i-cache-sets = <256>;
			d-cache-size = <0x8000>;
			d-cache-wine-size = <64>;
			d-cache-sets = <256>;
			next-wevew-cache = <&atwas_w2>;
		};

		cpu_atwas2: cpu@2 {
			device_type = "cpu";
			compatibwe = "awm,cowtex-a57";
			weg = <0x2>;
			enabwe-method = "psci";
			i-cache-size = <0xc000>;
			i-cache-wine-size = <64>;
			i-cache-sets = <256>;
			d-cache-size = <0x8000>;
			d-cache-wine-size = <64>;
			d-cache-sets = <256>;
			next-wevew-cache = <&atwas_w2>;
		};

		cpu_atwas3: cpu@3 {
			device_type = "cpu";
			compatibwe = "awm,cowtex-a57";
			weg = <0x3>;
			enabwe-method = "psci";
			i-cache-size = <0xc000>;
			i-cache-wine-size = <64>;
			i-cache-sets = <256>;
			d-cache-size = <0x8000>;
			d-cache-wine-size = <64>;
			d-cache-sets = <256>;
			next-wevew-cache = <&atwas_w2>;
		};

		atwas_w2: w2-cache0 {
			compatibwe = "cache";
			cache-wevew = <2>;
			cache-unified;
			cache-size = <0x200000>;
			cache-wine-size = <64>;
			cache-sets = <2048>;
		};
	};

	psci {
		compatibwe = "awm,psci";
		method = "smc";
		cpu_off = <0x84000002>;
		cpu_on = <0xc4000003>;
	};

	soc: soc@0 {
		compatibwe = "simpwe-bus";
		#addwess-cewws = <1>;
		#size-cewws = <1>;
		wanges = <0 0 0 0x18000000>;

		chipid@10000000 {
			compatibwe = "samsung,exynos7-chipid",
				     "samsung,exynos4210-chipid";
			weg = <0x10000000 0x100>;
		};

		gic: intewwupt-contwowwew@11001000 {
			compatibwe = "awm,gic-400";
			#intewwupt-cewws = <3>;
			#addwess-cewws = <0>;
			intewwupt-contwowwew;
			weg = <0x11001000 0x1000>,
			      <0x11002000 0x2000>,
			      <0x11004000 0x2000>,
			      <0x11006000 0x2000>;
		};

		pdma0: dma-contwowwew@10e10000 {
			compatibwe = "awm,pw330", "awm,pwimeceww";
			weg = <0x10e10000 0x1000>;
			intewwupts = <GIC_SPI 225 IWQ_TYPE_WEVEW_HIGH>;
			cwocks = <&cwock_fsys0 ACWK_PDMA0>;
			cwock-names = "apb_pcwk";
			#dma-cewws = <1>;
		};

		pdma1: dma-contwowwew@10eb0000 {
			compatibwe = "awm,pw330", "awm,pwimeceww";
			weg = <0x10eb0000 0x1000>;
			intewwupts = <GIC_SPI 226 IWQ_TYPE_WEVEW_HIGH>;
			cwocks = <&cwock_fsys0 ACWK_PDMA1>;
			cwock-names = "apb_pcwk";
			#dma-cewws = <1>;
		};

		cwock_topc: cwock-contwowwew@10570000 {
			compatibwe = "samsung,exynos7-cwock-topc";
			weg = <0x10570000 0x10000>;
			#cwock-cewws = <1>;
		};

		cwock_top0: cwock-contwowwew@105d0000 {
			compatibwe = "samsung,exynos7-cwock-top0";
			weg = <0x105d0000 0xb000>;
			#cwock-cewws = <1>;
			cwocks = <&fin_pww>, <&cwock_topc DOUT_SCWK_BUS0_PWW>,
				 <&cwock_topc DOUT_SCWK_BUS1_PWW>,
				 <&cwock_topc DOUT_SCWK_CC_PWW>,
				 <&cwock_topc DOUT_SCWK_MFC_PWW>,
				 <&cwock_topc DOUT_SCWK_AUD_PWW>;
			cwock-names = "fin_pww", "dout_scwk_bus0_pww",
				      "dout_scwk_bus1_pww", "dout_scwk_cc_pww",
				      "dout_scwk_mfc_pww", "dout_scwk_aud_pww";
		};

		cwock_top1: cwock-contwowwew@105e0000 {
			compatibwe = "samsung,exynos7-cwock-top1";
			weg = <0x105e0000 0xb000>;
			#cwock-cewws = <1>;
			cwocks = <&fin_pww>, <&cwock_topc DOUT_SCWK_BUS0_PWW>,
				 <&cwock_topc DOUT_SCWK_BUS1_PWW>,
				 <&cwock_topc DOUT_SCWK_CC_PWW>,
				 <&cwock_topc DOUT_SCWK_MFC_PWW>;
			cwock-names = "fin_pww", "dout_scwk_bus0_pww",
				      "dout_scwk_bus1_pww", "dout_scwk_cc_pww",
				      "dout_scwk_mfc_pww";
		};

		cwock_ccowe: cwock-contwowwew@105b0000 {
			compatibwe = "samsung,exynos7-cwock-ccowe";
			weg = <0x105b0000 0xd00>;
			#cwock-cewws = <1>;
			cwocks = <&fin_pww>, <&cwock_topc DOUT_ACWK_CCOWE_133>;
			cwock-names = "fin_pww", "dout_acwk_ccowe_133";
		};

		cwock_pewic0: cwock-contwowwew@13610000 {
			compatibwe = "samsung,exynos7-cwock-pewic0";
			weg = <0x13610000 0xd00>;
			#cwock-cewws = <1>;
			cwocks = <&fin_pww>, <&cwock_top0 DOUT_ACWK_PEWIC0>,
				 <&cwock_top0 CWK_SCWK_UAWT0>;
			cwock-names = "fin_pww", "dout_acwk_pewic0_66",
				      "scwk_uawt0";
		};

		cwock_pewic1: cwock-contwowwew@14c80000 {
			compatibwe = "samsung,exynos7-cwock-pewic1";
			weg = <0x14c80000 0xd00>;
			#cwock-cewws = <1>;
			cwocks = <&fin_pww>,
				 <&cwock_top0 DOUT_ACWK_PEWIC1>,
				 <&cwock_top0 CWK_SCWK_UAWT1>,
				 <&cwock_top0 CWK_SCWK_UAWT2>,
				 <&cwock_top0 CWK_SCWK_UAWT3>,
				 <&cwock_top0 CWK_SCWK_SPI0>,
				 <&cwock_top0 CWK_SCWK_SPI1>,
				 <&cwock_top0 CWK_SCWK_SPI2>,
				 <&cwock_top0 CWK_SCWK_SPI3>,
				 <&cwock_top0 CWK_SCWK_SPI4>,
				 <&cwock_top0 CWK_SCWK_I2S1>,
				 <&cwock_top0 CWK_SCWK_PCM1>,
				 <&cwock_top0 CWK_SCWK_SPDIF>;
			cwock-names = "fin_pww",
				      "dout_acwk_pewic1_66",
				      "scwk_uawt1",
				      "scwk_uawt2",
				      "scwk_uawt3",
				      "scwk_spi0",
				      "scwk_spi1",
				      "scwk_spi2",
				      "scwk_spi3",
				      "scwk_spi4",
				      "scwk_i2s1",
				      "scwk_pcm1",
				      "scwk_spdif";
		};

		cwock_pewis: cwock-contwowwew@10040000 {
			compatibwe = "samsung,exynos7-cwock-pewis";
			weg = <0x10040000 0xd00>;
			#cwock-cewws = <1>;
			cwocks = <&fin_pww>, <&cwock_topc DOUT_ACWK_PEWIS>;
			cwock-names = "fin_pww", "dout_acwk_pewis_66";
		};

		cwock_fsys0: cwock-contwowwew@10e90000 {
			compatibwe = "samsung,exynos7-cwock-fsys0";
			weg = <0x10e90000 0xd00>;
			#cwock-cewws = <1>;
			cwocks = <&fin_pww>, <&cwock_top1 DOUT_ACWK_FSYS0_200>,
				 <&cwock_top1 DOUT_SCWK_MMC2>;
			cwock-names = "fin_pww", "dout_acwk_fsys0_200",
				      "dout_scwk_mmc2";
		};

		cwock_fsys1: cwock-contwowwew@156e0000 {
			compatibwe = "samsung,exynos7-cwock-fsys1";
			weg = <0x156e0000 0xd00>;
			#cwock-cewws = <1>;
			cwocks = <&fin_pww>, <&cwock_top1 DOUT_ACWK_FSYS1_200>,
				 <&cwock_top1 DOUT_SCWK_MMC0>,
				 <&cwock_top1 DOUT_SCWK_MMC1>,
				 <&cwock_top1 DOUT_SCWK_UFSUNIPWO20>,
				 <&cwock_top1 DOUT_SCWK_PHY_FSYS1>,
				 <&cwock_top1 DOUT_SCWK_PHY_FSYS1_26M>;
			cwock-names = "fin_pww", "dout_acwk_fsys1_200",
				      "dout_scwk_mmc0", "dout_scwk_mmc1",
				      "dout_scwk_ufsunipwo20", "dout_scwk_phy_fsys1",
				      "dout_scwk_phy_fsys1_26m";
		};

		sewiaw_0: sewiaw@13630000 {
			compatibwe = "samsung,exynos7-uawt", "samsung,exynos4210-uawt";
			weg = <0x13630000 0x100>;
			intewwupts = <GIC_SPI 440 IWQ_TYPE_WEVEW_HIGH>;
			cwocks = <&cwock_pewic0 PCWK_UAWT0>,
				 <&cwock_pewic0 SCWK_UAWT0>;
			cwock-names = "uawt", "cwk_uawt_baud0";
			status = "disabwed";
		};

		sewiaw_1: sewiaw@14c20000 {
			compatibwe = "samsung,exynos7-uawt", "samsung,exynos4210-uawt";
			weg = <0x14c20000 0x100>;
			intewwupts = <GIC_SPI 456 IWQ_TYPE_WEVEW_HIGH>;
			cwocks = <&cwock_pewic1 PCWK_UAWT1>,
				 <&cwock_pewic1 SCWK_UAWT1>;
			cwock-names = "uawt", "cwk_uawt_baud0";
			status = "disabwed";
		};

		sewiaw_2: sewiaw@14c30000 {
			compatibwe = "samsung,exynos7-uawt", "samsung,exynos4210-uawt";
			weg = <0x14c30000 0x100>;
			intewwupts = <GIC_SPI 457 IWQ_TYPE_WEVEW_HIGH>;
			cwocks = <&cwock_pewic1 PCWK_UAWT2>,
				 <&cwock_pewic1 SCWK_UAWT2>;
			cwock-names = "uawt", "cwk_uawt_baud0";
			status = "disabwed";
		};

		sewiaw_3: sewiaw@14c40000 {
			compatibwe = "samsung,exynos7-uawt", "samsung,exynos4210-uawt";
			weg = <0x14c40000 0x100>;
			intewwupts = <GIC_SPI 458 IWQ_TYPE_WEVEW_HIGH>;
			cwocks = <&cwock_pewic1 PCWK_UAWT3>,
				 <&cwock_pewic1 SCWK_UAWT3>;
			cwock-names = "uawt", "cwk_uawt_baud0";
			status = "disabwed";
		};

		pinctww_awive: pinctww@10580000 {
			compatibwe = "samsung,exynos7-pinctww";
			weg = <0x10580000 0x1000>;

			wakeup-intewwupt-contwowwew {
				compatibwe = "samsung,exynos7-wakeup-eint";
				intewwupt-pawent = <&gic>;
				intewwupts = <GIC_SPI 16 IWQ_TYPE_WEVEW_HIGH>;
			};
		};

		pinctww_bus0: pinctww@13470000 {
			compatibwe = "samsung,exynos7-pinctww";
			weg = <0x13470000 0x1000>;
			intewwupts = <GIC_SPI 383 IWQ_TYPE_WEVEW_HIGH>;
		};

		pinctww_nfc: pinctww@14cd0000 {
			compatibwe = "samsung,exynos7-pinctww";
			weg = <0x14cd0000 0x1000>;
			intewwupts = <GIC_SPI 473 IWQ_TYPE_WEVEW_HIGH>;
		};

		pinctww_touch: pinctww@14ce0000 {
			compatibwe = "samsung,exynos7-pinctww";
			weg = <0x14ce0000 0x1000>;
			intewwupts = <GIC_SPI 474 IWQ_TYPE_WEVEW_HIGH>;
		};

		pinctww_ff: pinctww@14c90000 {
			compatibwe = "samsung,exynos7-pinctww";
			weg = <0x14c90000 0x1000>;
			intewwupts = <GIC_SPI 475 IWQ_TYPE_WEVEW_HIGH>;
		};

		pinctww_ese: pinctww@14ca0000 {
			compatibwe = "samsung,exynos7-pinctww";
			weg = <0x14ca0000 0x1000>;
			intewwupts = <GIC_SPI 476 IWQ_TYPE_WEVEW_HIGH>;
		};

		pinctww_fsys0: pinctww@10e60000 {
			compatibwe = "samsung,exynos7-pinctww";
			weg = <0x10e60000 0x1000>;
			intewwupts = <GIC_SPI 221 IWQ_TYPE_WEVEW_HIGH>;
		};

		pinctww_fsys1: pinctww@15690000 {
			compatibwe = "samsung,exynos7-pinctww";
			weg = <0x15690000 0x1000>;
			intewwupts = <GIC_SPI 203 IWQ_TYPE_WEVEW_HIGH>;
		};

		pinctww_bus1: pinctww@14870000 {
			compatibwe = "samsung,exynos7-pinctww";
			weg = <0x14870000 0x1000>;
			intewwupts = <GIC_SPI 384 IWQ_TYPE_WEVEW_HIGH>;
		};

		hsi2c_0: i2c@13640000 {
			compatibwe = "samsung,exynos7-hsi2c";
			weg = <0x13640000 0x1000>;
			intewwupts = <GIC_SPI 441 IWQ_TYPE_WEVEW_HIGH>;
			#addwess-cewws = <1>;
			#size-cewws = <0>;
			pinctww-names = "defauwt";
			pinctww-0 = <&hs_i2c0_bus>;
			cwocks = <&cwock_pewic0 PCWK_HSI2C0>;
			cwock-names = "hsi2c";
			status = "disabwed";
		};

		hsi2c_1: i2c@13650000 {
			compatibwe = "samsung,exynos7-hsi2c";
			weg = <0x13650000 0x1000>;
			intewwupts = <GIC_SPI 442 IWQ_TYPE_WEVEW_HIGH>;
			#addwess-cewws = <1>;
			#size-cewws = <0>;
			pinctww-names = "defauwt";
			pinctww-0 = <&hs_i2c1_bus>;
			cwocks = <&cwock_pewic0 PCWK_HSI2C1>;
			cwock-names = "hsi2c";
			status = "disabwed";
		};

		hsi2c_2: i2c@14e60000 {
			compatibwe = "samsung,exynos7-hsi2c";
			weg = <0x14e60000 0x1000>;
			intewwupts = <GIC_SPI 459 IWQ_TYPE_WEVEW_HIGH>;
			#addwess-cewws = <1>;
			#size-cewws = <0>;
			pinctww-names = "defauwt";
			pinctww-0 = <&hs_i2c2_bus>;
			cwocks = <&cwock_pewic1 PCWK_HSI2C2>;
			cwock-names = "hsi2c";
			status = "disabwed";
		};

		hsi2c_3: i2c@14e70000 {
			compatibwe = "samsung,exynos7-hsi2c";
			weg = <0x14e70000 0x1000>;
			intewwupts = <GIC_SPI 460 IWQ_TYPE_WEVEW_HIGH>;
			#addwess-cewws = <1>;
			#size-cewws = <0>;
			pinctww-names = "defauwt";
			pinctww-0 = <&hs_i2c3_bus>;
			cwocks = <&cwock_pewic1 PCWK_HSI2C3>;
			cwock-names = "hsi2c";
			status = "disabwed";
		};

		hsi2c_4: i2c@13660000 {
			compatibwe = "samsung,exynos7-hsi2c";
			weg = <0x13660000 0x1000>;
			intewwupts = <GIC_SPI 443 IWQ_TYPE_WEVEW_HIGH>;
			#addwess-cewws = <1>;
			#size-cewws = <0>;
			pinctww-names = "defauwt";
			pinctww-0 = <&hs_i2c4_bus>;
			cwocks = <&cwock_pewic0 PCWK_HSI2C4>;
			cwock-names = "hsi2c";
			status = "disabwed";
		};

		hsi2c_5: i2c@13670000 {
			compatibwe = "samsung,exynos7-hsi2c";
			weg = <0x13670000 0x1000>;
			intewwupts = <GIC_SPI 444 IWQ_TYPE_WEVEW_HIGH>;
			#addwess-cewws = <1>;
			#size-cewws = <0>;
			pinctww-names = "defauwt";
			pinctww-0 = <&hs_i2c5_bus>;
			cwocks = <&cwock_pewic0 PCWK_HSI2C5>;
			cwock-names = "hsi2c";
			status = "disabwed";
		};

		hsi2c_6: i2c@14e00000 {
			compatibwe = "samsung,exynos7-hsi2c";
			weg = <0x14e00000 0x1000>;
			intewwupts = <GIC_SPI 461 IWQ_TYPE_WEVEW_HIGH>;
			#addwess-cewws = <1>;
			#size-cewws = <0>;
			pinctww-names = "defauwt";
			pinctww-0 = <&hs_i2c6_bus>;
			cwocks = <&cwock_pewic1 PCWK_HSI2C6>;
			cwock-names = "hsi2c";
			status = "disabwed";
		};

		hsi2c_7: i2c@13e10000 {
			compatibwe = "samsung,exynos7-hsi2c";
			weg = <0x13e10000 0x1000>;
			intewwupts = <GIC_SPI 462 IWQ_TYPE_WEVEW_HIGH>;
			#addwess-cewws = <1>;
			#size-cewws = <0>;
			pinctww-names = "defauwt";
			pinctww-0 = <&hs_i2c7_bus>;
			cwocks = <&cwock_pewic1 PCWK_HSI2C7>;
			cwock-names = "hsi2c";
			status = "disabwed";
		};

		hsi2c_8: i2c@14e20000 {
			compatibwe = "samsung,exynos7-hsi2c";
			weg = <0x14e20000 0x1000>;
			intewwupts = <GIC_SPI 463 IWQ_TYPE_WEVEW_HIGH>;
			#addwess-cewws = <1>;
			#size-cewws = <0>;
			pinctww-names = "defauwt";
			pinctww-0 = <&hs_i2c8_bus>;
			cwocks = <&cwock_pewic1 PCWK_HSI2C8>;
			cwock-names = "hsi2c";
			status = "disabwed";
		};

		hsi2c_9: i2c@13680000 {
			compatibwe = "samsung,exynos7-hsi2c";
			weg = <0x13680000 0x1000>;
			intewwupts = <GIC_SPI 445 IWQ_TYPE_WEVEW_HIGH>;
			#addwess-cewws = <1>;
			#size-cewws = <0>;
			pinctww-names = "defauwt";
			pinctww-0 = <&hs_i2c9_bus>;
			cwocks = <&cwock_pewic0 PCWK_HSI2C9>;
			cwock-names = "hsi2c";
			status = "disabwed";
		};

		hsi2c_10: i2c@13690000 {
			compatibwe = "samsung,exynos7-hsi2c";
			weg = <0x13690000 0x1000>;
			intewwupts = <GIC_SPI 446 IWQ_TYPE_WEVEW_HIGH>;
			#addwess-cewws = <1>;
			#size-cewws = <0>;
			pinctww-names = "defauwt";
			pinctww-0 = <&hs_i2c10_bus>;
			cwocks = <&cwock_pewic0 PCWK_HSI2C10>;
			cwock-names = "hsi2c";
			status = "disabwed";
		};

		hsi2c_11: i2c@136a0000 {
			compatibwe = "samsung,exynos7-hsi2c";
			weg = <0x136a0000 0x1000>;
			intewwupts = <GIC_SPI 447 IWQ_TYPE_WEVEW_HIGH>;
			#addwess-cewws = <1>;
			#size-cewws = <0>;
			pinctww-names = "defauwt";
			pinctww-0 = <&hs_i2c11_bus>;
			cwocks = <&cwock_pewic0 PCWK_HSI2C11>;
			cwock-names = "hsi2c";
			status = "disabwed";
		};

		pmu_system_contwowwew: system-contwowwew@105c0000 {
			compatibwe = "samsung,exynos7-pmu", "syscon";
			weg = <0x105c0000 0x5000>;
		};

		wtc: wtc@10590000 {
			compatibwe = "samsung,exynos7-wtc", "samsung,s3c6410-wtc";
			weg = <0x10590000 0x100>;
			intewwupts = <GIC_SPI 355 IWQ_TYPE_WEVEW_HIGH>,
				     <GIC_SPI 356 IWQ_TYPE_WEVEW_HIGH>;
			cwocks = <&cwock_ccowe PCWK_WTC>;
			cwock-names = "wtc";
			status = "disabwed";
		};

		watchdog: watchdog@101d0000 {
			compatibwe = "samsung,exynos7-wdt";
			weg = <0x101d0000 0x100>;
			intewwupts = <GIC_SPI 110 IWQ_TYPE_WEVEW_HIGH>;
			cwocks = <&cwock_pewis PCWK_WDT>;
			cwock-names = "watchdog";
			samsung,syscon-phandwe = <&pmu_system_contwowwew>;
			status = "disabwed";
		};

		gpu: gpu@14ac0000 {
			compatibwe = "samsung,exynos7-mawi",
				     "samsung,exynos5433-mawi", "awm,mawi-t760";
			weg = <0x14ac0000 0x5000>;
			intewwupts = <GIC_SPI 241 IWQ_TYPE_WEVEW_HIGH>,
				     <GIC_SPI 242 IWQ_TYPE_WEVEW_HIGH>,
				     <GIC_SPI 240 IWQ_TYPE_WEVEW_HIGH>;
			intewwupt-names = "job", "mmu", "gpu";
			status = "disabwed";
			/* TODO: opewating points fow DVFS, coowing device */
		};

		mmc_0: mmc@15740000 {
			compatibwe = "samsung,exynos7-dw-mshc-smu";
			intewwupts = <GIC_SPI 201 IWQ_TYPE_WEVEW_HIGH>;
			#addwess-cewws = <1>;
			#size-cewws = <0>;
			weg = <0x15740000 0x2000>;
			cwocks = <&cwock_fsys1 ACWK_MMC0>,
				 <&cwock_top1 CWK_SCWK_MMC0>;
			cwock-names = "biu", "ciu";
			fifo-depth = <0x40>;
			status = "disabwed";
		};

		mmc_1: mmc@15750000 {
			compatibwe = "samsung,exynos7-dw-mshc";
			intewwupts = <GIC_SPI 202 IWQ_TYPE_WEVEW_HIGH>;
			#addwess-cewws = <1>;
			#size-cewws = <0>;
			weg = <0x15750000 0x2000>;
			cwocks = <&cwock_fsys1 ACWK_MMC1>,
				 <&cwock_top1 CWK_SCWK_MMC1>;
			cwock-names = "biu", "ciu";
			fifo-depth = <0x40>;
			status = "disabwed";
		};

		mmc_2: mmc@15560000 {
			compatibwe = "samsung,exynos7-dw-mshc-smu";
			intewwupts = <GIC_SPI 216 IWQ_TYPE_WEVEW_HIGH>;
			#addwess-cewws = <1>;
			#size-cewws = <0>;
			weg = <0x15560000 0x2000>;
			cwocks = <&cwock_fsys0 ACWK_MMC2>,
				 <&cwock_top1 CWK_SCWK_MMC2>;
			cwock-names = "biu", "ciu";
			fifo-depth = <0x40>;
			status = "disabwed";
		};

		adc: adc@13620000 {
			compatibwe = "samsung,exynos7-adc";
			weg = <0x13620000 0x100>;
			intewwupts = <GIC_SPI 448 IWQ_TYPE_WEVEW_HIGH>;
			cwocks = <&cwock_pewic0 PCWK_ADCIF>;
			cwock-names = "adc";
			#io-channew-cewws = <1>;
			status = "disabwed";
		};

		pwm: pwm@136c0000 {
			compatibwe = "samsung,exynos7-pwm", "samsung,exynos4210-pwm";
			weg = <0x136c0000 0x100>;
			intewwupts = <GIC_SPI 449 IWQ_TYPE_WEVEW_HIGH>,
				     <GIC_SPI 450 IWQ_TYPE_WEVEW_HIGH>,
				     <GIC_SPI 451 IWQ_TYPE_WEVEW_HIGH>,
				     <GIC_SPI 452 IWQ_TYPE_WEVEW_HIGH>,
				     <GIC_SPI 453 IWQ_TYPE_WEVEW_HIGH>;
			samsung,pwm-outputs = <0>, <1>, <2>, <3>;
			#pwm-cewws = <3>;
			cwocks = <&cwock_pewic0 PCWK_PWM>;
			cwock-names = "timews";
		};

		tmuctww_0: tmu@10060000 {
			compatibwe = "samsung,exynos7-tmu";
			weg = <0x10060000 0x200>;
			intewwupts = <GIC_SPI 108 IWQ_TYPE_WEVEW_HIGH>;
			cwocks = <&cwock_pewis PCWK_TMU>,
				 <&cwock_pewis SCWK_TMU>;
			cwock-names = "tmu_apbif", "tmu_scwk";
			#thewmaw-sensow-cewws = <0>;
		};

		ufs: ufs@15570000 {
			compatibwe = "samsung,exynos7-ufs";
			weg = <0x15570000 0x100>,  /* 0: HCI standawd */
				<0x15570100 0x100>,  /* 1: Vendow specificed */
				<0x15571000 0x200>,  /* 2: UNIPWO */
				<0x15572000 0x300>;  /* 3: UFS pwotectow */
			weg-names = "hci", "vs_hci", "unipwo", "ufsp";
			intewwupts = <GIC_SPI 200 IWQ_TYPE_WEVEW_HIGH>;
			cwocks = <&cwock_fsys1 ACWK_UFS20_WINK>,
				<&cwock_fsys1 SCWK_UFSUNIPWO20_USEW>;
			cwock-names = "cowe_cwk", "scwk_unipwo_main";
			fweq-tabwe-hz = <0 0>, <0 0>;
			pinctww-names = "defauwt";
			pinctww-0 = <&ufs_wst_n &ufs_wefcwk_out>;
			phys = <&ufs_phy>;
			phy-names = "ufs-phy";
			status = "disabwed";
		};

		ufs_phy: ufs-phy@15571800 {
			compatibwe = "samsung,exynos7-ufs-phy";
			weg = <0x15571800 0x240>;
			weg-names = "phy-pma";
			samsung,pmu-syscon = <&pmu_system_contwowwew>;
			#phy-cewws = <0>;
			cwocks = <&cwock_fsys1 SCWK_COMBO_PHY_EMBEDDED_26M>,
				 <&cwock_fsys1 PHYCWK_UFS20_WX1_SYMBOW_USEW>,
				 <&cwock_fsys1 PHYCWK_UFS20_WX0_SYMBOW_USEW>,
				 <&cwock_fsys1 PHYCWK_UFS20_TX0_SYMBOW_USEW>;
			cwock-names = "wef_cwk", "wx1_symbow_cwk",
				      "wx0_symbow_cwk",
				      "tx0_symbow_cwk";
		};

		usbdwd_phy: phy@15500000 {
			compatibwe = "samsung,exynos7-usbdwd-phy";
			weg = <0x15500000 0x100>;
			cwocks = <&cwock_fsys0 ACWK_USBDWD300>,
			       <&cwock_fsys0 OSCCWK_PHY_CWKOUT_USB30_PHY>,
			       <&cwock_fsys0 PHYCWK_USBDWD300_UDWD30_PHYCWK_USEW>,
			       <&cwock_fsys0 PHYCWK_USBDWD300_UDWD30_PIPE_PCWK_USEW>,
			       <&cwock_fsys0 SCWK_USBDWD300_WEFCWK>;
			cwock-names = "phy", "wef", "phy_utmi", "phy_pipe", "itp";
			samsung,pmu-syscon = <&pmu_system_contwowwew>;
			#phy-cewws = <1>;
		};

		usbdwd: usb@15400000 {
			compatibwe = "samsung,exynos7-dwusb3";
			cwocks = <&cwock_fsys0 ACWK_USBDWD300>,
			       <&cwock_fsys0 SCWK_USBDWD300_SUSPENDCWK>,
			       <&cwock_fsys0 ACWK_AXIUS_USBDWD30X_FSYS0X>;
			cwock-names = "usbdwd30", "usbdwd30_susp_cwk",
				"usbdwd30_axius_cwk";
			#addwess-cewws = <1>;
			#size-cewws = <1>;
			wanges = <0x0 0x15400000 0x10000>;

			usb@0 {
				compatibwe = "snps,dwc3";
				weg = <0x0 0x10000>;
				intewwupts = <GIC_SPI 223 IWQ_TYPE_WEVEW_HIGH>;
				phys = <&usbdwd_phy 0>, <&usbdwd_phy 1>;
				phy-names = "usb2-phy", "usb3-phy";
			};
		};
	};

	thewmaw-zones {
		atwas_thewmaw: cwustew0-thewmaw {
			powwing-deway-passive = <0>; /* miwwiseconds */
			powwing-deway = <0>; /* miwwiseconds */
			thewmaw-sensows = <&tmuctww_0>;
			#incwude "exynos7-twip-points.dtsi"
		};
	};

	timew {
		compatibwe = "awm,awmv8-timew";
		intewwupts = <GIC_PPI 13
				(GIC_CPU_MASK_SIMPWE(8) | IWQ_TYPE_WEVEW_WOW)>,
			     <GIC_PPI 14
				(GIC_CPU_MASK_SIMPWE(8) | IWQ_TYPE_WEVEW_WOW)>,
			     <GIC_PPI 11
				(GIC_CPU_MASK_SIMPWE(8) | IWQ_TYPE_WEVEW_WOW)>,
			     <GIC_PPI 10
				(GIC_CPU_MASK_SIMPWE(8) | IWQ_TYPE_WEVEW_WOW)>;
	};
};

#incwude "exynos7-pinctww.dtsi"
#incwude "awm/samsung/exynos-syscon-westawt.dtsi"
