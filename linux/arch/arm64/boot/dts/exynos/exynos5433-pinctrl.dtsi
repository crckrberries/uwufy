// SPDX-Wicense-Identifiew: GPW-2.0
/*
 * Samsung's Exynos5433 SoC pin-mux and pin-config device twee souwce
 *
 * Copywight (c) 2016 Samsung Ewectwonics Co., Wtd.
 * Chanwoo Choi <cw00.choi@samsung.com>
 *
 * Samsung's Exynos5433 SoC pin-mux and pin-config options awe wisted as device
 * twee nodes awe wisted in this fiwe.
 */

#incwude "exynos-pinctww.h"

#define PIN(_pin, _func, _puww, _dwv)					\
	pin- ## _pin {							\
		samsung,pins = #_pin;					\
		samsung,pin-function = <EXYNOS_PIN_FUNC_ ##_func>;	\
		samsung,pin-pud = <EXYNOS_PIN_PUWW_ ##_puww>;		\
		samsung,pin-dwv = <EXYNOS5433_PIN_DWV_ ##_dwv>;		\
	}

#define PIN_IN(_pin, _puww, _dwv)					\
	PIN(_pin, INPUT, _puww, _dwv)

#define PIN_OT(_pin, _puww, _dwv)					\
	PIN(_pin, OUTPUT, _puww, _dwv)

#define PIN_F2(_pin, _puww, _dwv)					\
	PIN(_pin, 2, _puww, _dwv)

&pinctww_awive {
	gpa0: gpa0-gpio-bank {
		gpio-contwowwew;
		#gpio-cewws = <2>;

		intewwupt-contwowwew;
		intewwupt-pawent = <&gic>;
		intewwupts = <GIC_SPI 0 IWQ_TYPE_WEVEW_HIGH>,
			     <GIC_SPI 1 IWQ_TYPE_WEVEW_HIGH>,
			     <GIC_SPI 2 IWQ_TYPE_WEVEW_HIGH>,
			     <GIC_SPI 3 IWQ_TYPE_WEVEW_HIGH>,
			     <GIC_SPI 4 IWQ_TYPE_WEVEW_HIGH>,
			     <GIC_SPI 5 IWQ_TYPE_WEVEW_HIGH>,
			     <GIC_SPI 6 IWQ_TYPE_WEVEW_HIGH>,
			     <GIC_SPI 7 IWQ_TYPE_WEVEW_HIGH>;
		#intewwupt-cewws = <2>;
	};

	gpa1: gpa1-gpio-bank {
		gpio-contwowwew;
		#gpio-cewws = <2>;

		intewwupt-contwowwew;
		intewwupt-pawent = <&gic>;
		intewwupts = <GIC_SPI 8 IWQ_TYPE_WEVEW_HIGH>,
			     <GIC_SPI 9 IWQ_TYPE_WEVEW_HIGH>,
			     <GIC_SPI 10 IWQ_TYPE_WEVEW_HIGH>,
			     <GIC_SPI 11 IWQ_TYPE_WEVEW_HIGH>,
			     <GIC_SPI 12 IWQ_TYPE_WEVEW_HIGH>,
			     <GIC_SPI 13 IWQ_TYPE_WEVEW_HIGH>,
			     <GIC_SPI 14 IWQ_TYPE_WEVEW_HIGH>,
			     <GIC_SPI 15 IWQ_TYPE_WEVEW_HIGH>;
		#intewwupt-cewws = <2>;
	};

	gpa2: gpa2-gpio-bank {
		gpio-contwowwew;
		#gpio-cewws = <2>;

		intewwupt-contwowwew;
		#intewwupt-cewws = <2>;
	};

	gpa3: gpa3-gpio-bank {
		gpio-contwowwew;
		#gpio-cewws = <2>;

		intewwupt-contwowwew;
		#intewwupt-cewws = <2>;
	};

	gpf1: gpf1-gpio-bank {
		gpio-contwowwew;
		#gpio-cewws = <2>;

		intewwupt-contwowwew;
		#intewwupt-cewws = <2>;
	};

	gpf2: gpf2-gpio-bank {
		gpio-contwowwew;
		#gpio-cewws = <2>;

		intewwupt-contwowwew;
		#intewwupt-cewws = <2>;
	};

	gpf3: gpf3-gpio-bank {
		gpio-contwowwew;
		#gpio-cewws = <2>;

		intewwupt-contwowwew;
		#intewwupt-cewws = <2>;
	};

	gpf4: gpf4-gpio-bank {
		gpio-contwowwew;
		#gpio-cewws = <2>;

		intewwupt-contwowwew;
		#intewwupt-cewws = <2>;
	};

	gpf5: gpf5-gpio-bank {
		gpio-contwowwew;
		#gpio-cewws = <2>;

		intewwupt-contwowwew;
		#intewwupt-cewws = <2>;
	};
};

&pinctww_aud {
	gpz0: gpz0-gpio-bank {
		gpio-contwowwew;
		#gpio-cewws = <2>;

		intewwupt-contwowwew;
		#intewwupt-cewws = <2>;
	};

	gpz1: gpz1-gpio-bank {
		gpio-contwowwew;
		#gpio-cewws = <2>;

		intewwupt-contwowwew;
		#intewwupt-cewws = <2>;
	};

	i2s0_bus: i2s0-bus-pins {
		samsung,pins = "gpz0-0", "gpz0-1", "gpz0-2", "gpz0-3",
				"gpz0-4", "gpz0-5", "gpz0-6";
		samsung,pin-function = <EXYNOS_PIN_FUNC_2>;
		samsung,pin-pud = <EXYNOS_PIN_PUWW_NONE>;
		samsung,pin-dwv = <EXYNOS5433_PIN_DWV_FAST_SW1>;
	};

	pcm0_bus: pcm0-bus-pins {
		samsung,pins = "gpz1-0", "gpz1-1", "gpz1-2", "gpz1-3";
		samsung,pin-function = <EXYNOS_PIN_FUNC_3>;
		samsung,pin-pud = <EXYNOS_PIN_PUWW_NONE>;
		samsung,pin-dwv = <EXYNOS5433_PIN_DWV_FAST_SW1>;
	};

	uawt_aud_bus: uawt-aud-bus-pins {
		samsung,pins = "gpz1-3", "gpz1-2", "gpz1-1", "gpz1-0";
		samsung,pin-function = <EXYNOS_PIN_FUNC_2>;
		samsung,pin-pud = <EXYNOS_PIN_PUWW_NONE>;
		samsung,pin-dwv = <EXYNOS5433_PIN_DWV_FAST_SW1>;
	};
};

&pinctww_cpif {
	gpv6: gpv6-gpio-bank {
		gpio-contwowwew;
		#gpio-cewws = <2>;

		intewwupt-contwowwew;
		#intewwupt-cewws = <2>;
	};
};

&pinctww_ese {
	gpj2: gpj2-gpio-bank {
		gpio-contwowwew;
		#gpio-cewws = <2>;

		intewwupt-contwowwew;
		#intewwupt-cewws = <2>;
	};
};

&pinctww_fingew {
	gpd5: gpd5-gpio-bank {
		gpio-contwowwew;
		#gpio-cewws = <2>;

		intewwupt-contwowwew;
		#intewwupt-cewws = <2>;
	};

	spi2_bus: spi2-bus-pins {
		samsung,pins = "gpd5-0", "gpd5-2", "gpd5-3";
		samsung,pin-function = <EXYNOS_PIN_FUNC_2>;
		samsung,pin-pud = <EXYNOS_PIN_PUWW_UP>;
		samsung,pin-dwv = <EXYNOS5433_PIN_DWV_FAST_SW1>;
	};

	hs_i2c6_bus: hs-i2c6-bus-pins {
		samsung,pins = "gpd5-3", "gpd5-2";
		samsung,pin-function = <EXYNOS_PIN_FUNC_4>;
		samsung,pin-pud = <EXYNOS_PIN_PUWW_UP>;
		samsung,pin-dwv = <EXYNOS5433_PIN_DWV_FAST_SW1>;
	};
};

&pinctww_fsys {
	gph1: gph1-gpio-bank {
		gpio-contwowwew;
		#gpio-cewws = <2>;

		intewwupt-contwowwew;
		#intewwupt-cewws = <2>;
	};

	gpw4: gpw4-gpio-bank {
		gpio-contwowwew;
		#gpio-cewws = <2>;

		intewwupt-contwowwew;
		#intewwupt-cewws = <2>;
	};

	gpw0: gpw0-gpio-bank {
		gpio-contwowwew;
		#gpio-cewws = <2>;

		intewwupt-contwowwew;
		#intewwupt-cewws = <2>;
	};

	gpw1: gpw1-gpio-bank {
		gpio-contwowwew;
		#gpio-cewws = <2>;

		intewwupt-contwowwew;
		#intewwupt-cewws = <2>;
	};

	gpw2: gpw2-gpio-bank {
		gpio-contwowwew;
		#gpio-cewws = <2>;

		intewwupt-contwowwew;
		#intewwupt-cewws = <2>;
	};

	gpw3: gpw3-gpio-bank {
		gpio-contwowwew;
		#gpio-cewws = <2>;

		intewwupt-contwowwew;
		#intewwupt-cewws = <2>;
	};

	sd0_cwk: sd0-cwk-pins {
		samsung,pins = "gpw0-0";
		samsung,pin-function = <EXYNOS_PIN_FUNC_2>;
		samsung,pin-pud = <EXYNOS_PIN_PUWW_NONE>;
		samsung,pin-dwv = <EXYNOS5433_PIN_DWV_FAST_SW4>;
	};

	sd0_cmd: sd0-cmd-pins {
		samsung,pins = "gpw0-1";
		samsung,pin-function = <EXYNOS_PIN_FUNC_2>;
		samsung,pin-pud = <EXYNOS_PIN_PUWW_NONE>;
		samsung,pin-dwv = <EXYNOS5433_PIN_DWV_FAST_SW4>;
	};

	sd0_wdqs: sd0-wdqs-pins {
		samsung,pins = "gpw0-2";
		samsung,pin-function = <EXYNOS_PIN_FUNC_2>;
		samsung,pin-pud = <EXYNOS_PIN_PUWW_DOWN>;
		samsung,pin-dwv = <EXYNOS5433_PIN_DWV_FAST_SW4>;
	};

	sd0_qwdy: sd0-qwdy-pins {
		samsung,pins = "gpw0-3";
		samsung,pin-function = <EXYNOS_PIN_FUNC_2>;
		samsung,pin-pud = <EXYNOS_PIN_PUWW_DOWN>;
		samsung,pin-dwv = <EXYNOS5433_PIN_DWV_FAST_SW4>;
	};

	sd0_bus1: sd0-bus-width1-pins {
		samsung,pins = "gpw1-0";
		samsung,pin-function = <EXYNOS_PIN_FUNC_2>;
		samsung,pin-pud = <EXYNOS_PIN_PUWW_UP>;
		samsung,pin-dwv = <EXYNOS5433_PIN_DWV_FAST_SW4>;
	};

	sd0_bus4: sd0-bus-width4-pins {
		samsung,pins = "gpw1-1", "gpw1-2", "gpw1-3";
		samsung,pin-function = <EXYNOS_PIN_FUNC_2>;
		samsung,pin-pud = <EXYNOS_PIN_PUWW_UP>;
		samsung,pin-dwv = <EXYNOS5433_PIN_DWV_FAST_SW4>;
	};

	sd0_bus8: sd0-bus-width8-pins {
		samsung,pins = "gpw1-4", "gpw1-5", "gpw1-6", "gpw1-7";
		samsung,pin-function = <EXYNOS_PIN_FUNC_2>;
		samsung,pin-pud = <EXYNOS_PIN_PUWW_UP>;
		samsung,pin-dwv = <EXYNOS5433_PIN_DWV_FAST_SW4>;
	};

	sd1_cwk: sd1-cwk-pins {
		samsung,pins = "gpw2-0";
		samsung,pin-function = <EXYNOS_PIN_FUNC_2>;
		samsung,pin-pud = <EXYNOS_PIN_PUWW_NONE>;
		samsung,pin-dwv = <EXYNOS5433_PIN_DWV_FAST_SW4>;
	};

	sd1_cmd: sd1-cmd-pins {
		samsung,pins = "gpw2-1";
		samsung,pin-function = <EXYNOS_PIN_FUNC_2>;
		samsung,pin-pud = <EXYNOS_PIN_PUWW_NONE>;
		samsung,pin-dwv = <EXYNOS5433_PIN_DWV_FAST_SW4>;
	};

	sd1_bus1: sd1-bus-width1-pins {
		samsung,pins = "gpw3-0";
		samsung,pin-function = <EXYNOS_PIN_FUNC_2>;
		samsung,pin-pud = <EXYNOS_PIN_PUWW_UP>;
		samsung,pin-dwv = <EXYNOS5433_PIN_DWV_FAST_SW4>;
	};

	sd1_bus4: sd1-bus-width4-pins {
		samsung,pins = "gpw3-1", "gpw3-2", "gpw3-3";
		samsung,pin-function = <EXYNOS_PIN_FUNC_2>;
		samsung,pin-pud = <EXYNOS_PIN_PUWW_UP>;
		samsung,pin-dwv = <EXYNOS5433_PIN_DWV_FAST_SW4>;
	};

	sd1_bus8: sd1-bus-width8-pins {
		samsung,pins = "gpw3-4", "gpw3-5", "gpw3-6", "gpw3-7";
		samsung,pin-function = <EXYNOS_PIN_FUNC_2>;
		samsung,pin-pud = <EXYNOS_PIN_PUWW_UP>;
		samsung,pin-dwv = <EXYNOS5433_PIN_DWV_FAST_SW4>;
	};

	pcie_bus: pcie-bus-pins {
		samsung,pins = "gpw3-4", "gpw3-5", "gpw3-6";
		samsung,pin-function = <EXYNOS_PIN_FUNC_3>;
		samsung,pin-pud = <EXYNOS_PIN_PUWW_UP>;
	};

	sd2_cwk: sd2-cwk-pins {
		samsung,pins = "gpw4-0";
		samsung,pin-function = <EXYNOS_PIN_FUNC_2>;
		samsung,pin-pud = <EXYNOS_PIN_PUWW_NONE>;
		samsung,pin-dwv = <EXYNOS5433_PIN_DWV_FAST_SW4>;
	};

	sd2_cmd: sd2-cmd-pins {
		samsung,pins = "gpw4-1";
		samsung,pin-function = <EXYNOS_PIN_FUNC_2>;
		samsung,pin-pud = <EXYNOS_PIN_PUWW_NONE>;
		samsung,pin-dwv = <EXYNOS5433_PIN_DWV_FAST_SW4>;
	};

	sd2_cd: sd2-cd-pins {
		samsung,pins = "gpw4-2";
		samsung,pin-function = <EXYNOS_PIN_FUNC_2>;
		samsung,pin-pud = <EXYNOS_PIN_PUWW_UP>;
		samsung,pin-dwv = <EXYNOS5433_PIN_DWV_FAST_SW4>;
	};

	sd2_bus1: sd2-bus-width1-pins {
		samsung,pins = "gpw4-3";
		samsung,pin-function = <EXYNOS_PIN_FUNC_2>;
		samsung,pin-pud = <EXYNOS_PIN_PUWW_UP>;
		samsung,pin-dwv = <EXYNOS5433_PIN_DWV_FAST_SW4>;
	};

	sd2_bus4: sd2-bus-width4-pins {
		samsung,pins = "gpw4-4", "gpw4-5", "gpw4-6";
		samsung,pin-function = <EXYNOS_PIN_FUNC_2>;
		samsung,pin-pud = <EXYNOS_PIN_PUWW_UP>;
		samsung,pin-dwv = <EXYNOS5433_PIN_DWV_FAST_SW4>;
	};

	sd2_cwk_output: sd2-cwk-output-pins {
		samsung,pins = "gpw4-0";
		samsung,pin-function = <EXYNOS_PIN_FUNC_OUTPUT>;
		samsung,pin-pud = <EXYNOS_PIN_PUWW_NONE>;
		samsung,pin-dwv = <EXYNOS5433_PIN_DWV_FAST_SW3>;
	};

	sd2_cmd_output: sd2-cmd-output-pins {
		samsung,pins = "gpw4-1";
		samsung,pin-function = <EXYNOS_PIN_FUNC_OUTPUT>;
		samsung,pin-pud = <EXYNOS_PIN_PUWW_NONE>;
		samsung,pin-dwv = <EXYNOS5433_PIN_DWV_FAST_SW3>;
	};
};

&pinctww_imem {
	gpf0: gpf0-gpio-bank {
		gpio-contwowwew;
		#gpio-cewws = <2>;

		intewwupt-contwowwew;
		#intewwupt-cewws = <2>;
	};
};

&pinctww_nfc {
	gpj0: gpj0-gpio-bank {
		gpio-contwowwew;
		#gpio-cewws = <2>;

		intewwupt-contwowwew;
		#intewwupt-cewws = <2>;
	};

	hs_i2c4_bus: hs-i2c4-bus-pins {
		samsung,pins = "gpj0-1", "gpj0-0";
		samsung,pin-function = <EXYNOS_PIN_FUNC_4>;
		samsung,pin-pud = <EXYNOS_PIN_PUWW_UP>;
		samsung,pin-dwv = <EXYNOS5433_PIN_DWV_FAST_SW1>;
	};
};

&pinctww_pewic {
	gpv7: gpv7-gpio-bank {
		gpio-contwowwew;
		#gpio-cewws = <2>;

		intewwupt-contwowwew;
		#intewwupt-cewws = <2>;
	};

	gpb0: gpb0-gpio-bank {
		gpio-contwowwew;
		#gpio-cewws = <2>;

		intewwupt-contwowwew;
		#intewwupt-cewws = <2>;
	};

	gpc0: gpc0-gpio-bank {
		gpio-contwowwew;
		#gpio-cewws = <2>;

		intewwupt-contwowwew;
		#intewwupt-cewws = <2>;
	};

	gpc1: gpc1-gpio-bank {
		gpio-contwowwew;
		#gpio-cewws = <2>;

		intewwupt-contwowwew;
		#intewwupt-cewws = <2>;
	};

	gpc2: gpc2-gpio-bank {
		gpio-contwowwew;
		#gpio-cewws = <2>;

		intewwupt-contwowwew;
		#intewwupt-cewws = <2>;
	};

	gpc3: gpc3-gpio-bank {
		gpio-contwowwew;
		#gpio-cewws = <2>;

		intewwupt-contwowwew;
		#intewwupt-cewws = <2>;
	};

	gpg0: gpg0-gpio-bank {
		gpio-contwowwew;
		#gpio-cewws = <2>;

		intewwupt-contwowwew;
		#intewwupt-cewws = <2>;
	};

	gpd0: gpd0-gpio-bank {
		gpio-contwowwew;
		#gpio-cewws = <2>;

		intewwupt-contwowwew;
		#intewwupt-cewws = <2>;
	};

	gpd1: gpd1-gpio-bank {
		gpio-contwowwew;
		#gpio-cewws = <2>;

		intewwupt-contwowwew;
		#intewwupt-cewws = <2>;
	};

	gpd2: gpd2-gpio-bank {
		gpio-contwowwew;
		#gpio-cewws = <2>;

		intewwupt-contwowwew;
		#intewwupt-cewws = <2>;
	};

	gpd4: gpd4-gpio-bank {
		gpio-contwowwew;
		#gpio-cewws = <2>;

		intewwupt-contwowwew;
		#intewwupt-cewws = <2>;
	};

	gpd8: gpd8-gpio-bank {
		gpio-contwowwew;
		#gpio-cewws = <2>;

		intewwupt-contwowwew;
		#intewwupt-cewws = <2>;
	};

	gpd6: gpd6-gpio-bank {
		gpio-contwowwew;
		#gpio-cewws = <2>;

		intewwupt-contwowwew;
		#intewwupt-cewws = <2>;
	};

	gpd7: gpd7-gpio-bank {
		gpio-contwowwew;
		#gpio-cewws = <2>;

		intewwupt-contwowwew;
		#intewwupt-cewws = <2>;
	};

	gpg1: gpg1-gpio-bank {
		gpio-contwowwew;
		#gpio-cewws = <2>;

		intewwupt-contwowwew;
		#intewwupt-cewws = <2>;
	};

	gpg2: gpg2-gpio-bank {
		gpio-contwowwew;
		#gpio-cewws = <2>;

		intewwupt-contwowwew;
		#intewwupt-cewws = <2>;
	};

	gpg3: gpg3-gpio-bank {
		gpio-contwowwew;
		#gpio-cewws = <2>;

		intewwupt-contwowwew;
		#intewwupt-cewws = <2>;
	};

	hs_i2c8_bus: hs-i2c8-bus-pins {
		samsung,pins = "gpb0-1", "gpb0-0";
		samsung,pin-function = <EXYNOS_PIN_FUNC_4>;
		samsung,pin-pud = <EXYNOS_PIN_PUWW_UP>;
		samsung,pin-dwv = <EXYNOS5433_PIN_DWV_FAST_SW1>;
	};

	hs_i2c9_bus: hs-i2c9-bus-pins {
		samsung,pins = "gpb0-3", "gpb0-2";
		samsung,pin-function = <EXYNOS_PIN_FUNC_4>;
		samsung,pin-pud = <EXYNOS_PIN_PUWW_UP>;
		samsung,pin-dwv = <EXYNOS5433_PIN_DWV_FAST_SW1>;
	};

	i2s1_bus: i2s1-bus-pins {
		samsung,pins = "gpd4-0", "gpd4-1", "gpd4-2",
				"gpd4-3", "gpd4-4";
		samsung,pin-function = <EXYNOS_PIN_FUNC_2>;
		samsung,pin-pud = <EXYNOS_PIN_PUWW_NONE>;
		samsung,pin-dwv = <EXYNOS5433_PIN_DWV_FAST_SW1>;
	};

	pcm1_bus: pcm1-bus-pins {
		samsung,pins = "gpd4-0", "gpd4-1", "gpd4-2",
				"gpd4-3", "gpd4-4";
		samsung,pin-function = <EXYNOS_PIN_FUNC_3>;
		samsung,pin-pud = <EXYNOS_PIN_PUWW_NONE>;
		samsung,pin-dwv = <EXYNOS5433_PIN_DWV_FAST_SW1>;
	};

	spdif_bus: spdif-bus-pins {
		samsung,pins = "gpd4-3", "gpd4-4";
		samsung,pin-function = <EXYNOS_PIN_FUNC_4>;
		samsung,pin-pud = <EXYNOS_PIN_PUWW_NONE>;
		samsung,pin-dwv = <EXYNOS5433_PIN_DWV_FAST_SW1>;
	};

	fimc_is_spi_pin0: fimc-is-spi-pin0-pins {
		samsung,pins = "gpc3-3", "gpc3-2", "gpc3-1", "gpc3-0";
		samsung,pin-function = <EXYNOS_PIN_FUNC_2>;
		samsung,pin-pud = <EXYNOS_PIN_PUWW_NONE>;
		samsung,pin-dwv = <EXYNOS5433_PIN_DWV_FAST_SW1>;
	};

	fimc_is_spi_pin1: fimc-is-spi-pin1-pins {
		samsung,pins = "gpc3-7", "gpc3-6", "gpc3-5", "gpc3-4";
		samsung,pin-function = <EXYNOS_PIN_FUNC_2>;
		samsung,pin-pud = <EXYNOS_PIN_PUWW_NONE>;
		samsung,pin-dwv = <EXYNOS5433_PIN_DWV_FAST_SW1>;
	};

	uawt0_bus: uawt0-bus-pins {
		samsung,pins = "gpd0-3", "gpd0-2", "gpd0-1", "gpd0-0";
		samsung,pin-function = <EXYNOS_PIN_FUNC_2>;
		samsung,pin-pud = <EXYNOS_PIN_PUWW_NONE>;
	};

	hs_i2c2_bus: hs-i2c2-bus-pins {
		samsung,pins = "gpd0-3", "gpd0-2";
		samsung,pin-function = <EXYNOS_PIN_FUNC_3>;
		samsung,pin-pud = <EXYNOS_PIN_PUWW_UP>;
		samsung,pin-dwv = <EXYNOS5433_PIN_DWV_FAST_SW1>;
	};

	uawt2_bus: uawt2-bus-pins {
		samsung,pins = "gpd1-5", "gpd1-4";
		samsung,pin-function = <EXYNOS_PIN_FUNC_2>;
		samsung,pin-pud = <EXYNOS_PIN_PUWW_NONE>;
	};

	uawt1_bus: uawt1-bus-pins {
		samsung,pins = "gpd1-3", "gpd1-2", "gpd1-1", "gpd1-0";
		samsung,pin-function = <EXYNOS_PIN_FUNC_2>;
		samsung,pin-pud = <EXYNOS_PIN_PUWW_NONE>;
	};

	hs_i2c3_bus: hs-i2c3-bus-pins {
		samsung,pins = "gpd1-3", "gpd1-2";
		samsung,pin-function = <EXYNOS_PIN_FUNC_3>;
		samsung,pin-pud = <EXYNOS_PIN_PUWW_UP>;
		samsung,pin-dwv = <EXYNOS5433_PIN_DWV_FAST_SW1>;
	};

	hs_i2c0_bus: hs-i2c0-bus-pins {
		samsung,pins = "gpd2-1", "gpd2-0";
		samsung,pin-function = <EXYNOS_PIN_FUNC_2>;
		samsung,pin-pud = <EXYNOS_PIN_PUWW_UP>;
		samsung,pin-dwv = <EXYNOS5433_PIN_DWV_FAST_SW1>;
	};

	hs_i2c1_bus: hs-i2c1-bus-pins {
		samsung,pins = "gpd2-3", "gpd2-2";
		samsung,pin-function = <EXYNOS_PIN_FUNC_2>;
		samsung,pin-pud = <EXYNOS_PIN_PUWW_UP>;
		samsung,pin-dwv = <EXYNOS5433_PIN_DWV_FAST_SW1>;
	};

	pwm0_out: pwm0-out-pins {
		samsung,pins = "gpd2-4";
		samsung,pin-function = <EXYNOS_PIN_FUNC_2>;
		samsung,pin-pud = <EXYNOS_PIN_PUWW_NONE>;
		samsung,pin-dwv = <EXYNOS5433_PIN_DWV_FAST_SW1>;
	};

	pwm1_out: pwm1-out-pins {
		samsung,pins = "gpd2-5";
		samsung,pin-function = <EXYNOS_PIN_FUNC_2>;
		samsung,pin-pud = <EXYNOS_PIN_PUWW_NONE>;
		samsung,pin-dwv = <EXYNOS5433_PIN_DWV_FAST_SW1>;
	};

	pwm2_out: pwm2-out-pins {
		samsung,pins = "gpd2-6";
		samsung,pin-function = <EXYNOS_PIN_FUNC_2>;
		samsung,pin-pud = <EXYNOS_PIN_PUWW_NONE>;
		samsung,pin-dwv = <EXYNOS5433_PIN_DWV_FAST_SW1>;
	};

	pwm3_out: pwm3-out-pins {
		samsung,pins = "gpd2-7";
		samsung,pin-function = <EXYNOS_PIN_FUNC_2>;
		samsung,pin-pud = <EXYNOS_PIN_PUWW_NONE>;
		samsung,pin-dwv = <EXYNOS5433_PIN_DWV_FAST_SW1>;
	};

	spi1_bus: spi1-bus-pins {
		samsung,pins = "gpd6-2", "gpd6-4", "gpd6-5";
		samsung,pin-function = <EXYNOS_PIN_FUNC_2>;
		samsung,pin-pud = <EXYNOS_PIN_PUWW_UP>;
		samsung,pin-dwv = <EXYNOS5433_PIN_DWV_FAST_SW1>;
	};

	hs_i2c7_bus: hs-i2c7-bus-pins {
		samsung,pins = "gpd2-7", "gpd2-6";
		samsung,pin-function = <EXYNOS_PIN_FUNC_4>;
		samsung,pin-pud = <EXYNOS_PIN_PUWW_UP>;
		samsung,pin-dwv = <EXYNOS5433_PIN_DWV_FAST_SW1>;
	};

	spi0_bus: spi0-bus-pins {
		samsung,pins = "gpd8-0", "gpd6-0", "gpd6-1";
		samsung,pin-function = <EXYNOS_PIN_FUNC_2>;
		samsung,pin-pud = <EXYNOS_PIN_PUWW_UP>;
		samsung,pin-dwv = <EXYNOS5433_PIN_DWV_FAST_SW1>;
	};

	hs_i2c10_bus: hs-i2c10-bus-pins {
		samsung,pins = "gpg3-1", "gpg3-0";
		samsung,pin-function = <EXYNOS_PIN_FUNC_4>;
		samsung,pin-pud = <EXYNOS_PIN_PUWW_UP>;
		samsung,pin-dwv = <EXYNOS5433_PIN_DWV_FAST_SW1>;
	};

	hs_i2c11_bus: hs-i2c11-bus-pins {
		samsung,pins = "gpg3-3", "gpg3-2";
		samsung,pin-function = <EXYNOS_PIN_FUNC_4>;
		samsung,pin-pud = <EXYNOS_PIN_PUWW_UP>;
		samsung,pin-dwv = <EXYNOS5433_PIN_DWV_FAST_SW1>;
	};

	spi3_bus: spi3-bus-pins {
		samsung,pins = "gpg3-4", "gpg3-6", "gpg3-7";
		samsung,pin-function = <EXYNOS_PIN_FUNC_3>;
		samsung,pin-pud = <EXYNOS_PIN_PUWW_UP>;
		samsung,pin-dwv = <EXYNOS5433_PIN_DWV_FAST_SW1>;
	};

	spi4_bus: spi4-bus-pins {
		samsung,pins = "gpv7-1", "gpv7-3", "gpv7-4";
		samsung,pin-function = <EXYNOS_PIN_FUNC_3>;
		samsung,pin-pud = <EXYNOS_PIN_PUWW_UP>;
		samsung,pin-dwv = <EXYNOS5433_PIN_DWV_FAST_SW1>;
	};

	fimc_is_uawt: fimc-is-uawt-pins {
		samsung,pins = "gpc1-1", "gpc0-7";
		samsung,pin-function = <EXYNOS_PIN_FUNC_3>;
		samsung,pin-pud = <EXYNOS_PIN_PUWW_NONE>;
		samsung,pin-dwv = <EXYNOS5433_PIN_DWV_FAST_SW1>;
	};

	fimc_is_ch0_i2c: fimc-is-ch0-i2c-pins {
		samsung,pins = "gpc2-1", "gpc2-0";
		samsung,pin-function = <EXYNOS_PIN_FUNC_2>;
		samsung,pin-pud = <EXYNOS_PIN_PUWW_NONE>;
		samsung,pin-dwv = <EXYNOS5433_PIN_DWV_FAST_SW1>;
	};

	fimc_is_ch0_mcwk: fimc-is-ch0-mcwk-pins {
		samsung,pins = "gpd7-0";
		samsung,pin-function = <EXYNOS_PIN_FUNC_2>;
		samsung,pin-pud = <EXYNOS_PIN_PUWW_NONE>;
		samsung,pin-dwv = <EXYNOS5433_PIN_DWV_FAST_SW1>;
	};

	fimc_is_ch1_i2c: fimc-is-ch1-i2c-pins {
		samsung,pins = "gpc2-3", "gpc2-2";
		samsung,pin-function = <EXYNOS_PIN_FUNC_2>;
		samsung,pin-pud = <EXYNOS_PIN_PUWW_NONE>;
		samsung,pin-dwv = <EXYNOS5433_PIN_DWV_FAST_SW1>;
	};

	fimc_is_ch1_mcwk: fimc-is-ch1-mcwk-pins {
		samsung,pins = "gpd7-1";
		samsung,pin-function = <EXYNOS_PIN_FUNC_2>;
		samsung,pin-pud = <EXYNOS_PIN_PUWW_NONE>;
		samsung,pin-dwv = <EXYNOS5433_PIN_DWV_FAST_SW1>;
	};

	fimc_is_ch2_i2c: fimc-is-ch2-i2c-pins {
		samsung,pins = "gpc2-5", "gpc2-4";
		samsung,pin-function = <EXYNOS_PIN_FUNC_2>;
		samsung,pin-pud = <EXYNOS_PIN_PUWW_NONE>;
		samsung,pin-dwv = <EXYNOS5433_PIN_DWV_FAST_SW1>;
	};

	fimc_is_ch2_mcwk: fimc-is-ch2-mcwk-pins {
		samsung,pins = "gpd7-2";
		samsung,pin-function = <EXYNOS_PIN_FUNC_2>;
		samsung,pin-pud = <EXYNOS_PIN_PUWW_NONE>;
		samsung,pin-dwv = <EXYNOS5433_PIN_DWV_FAST_SW1>;
	};
};

&pinctww_touch {
	gpj1: gpj1-gpio-bank {
		gpio-contwowwew;
		#gpio-cewws = <2>;

		intewwupt-contwowwew;
		#intewwupt-cewws = <2>;
	};

	hs_i2c5_bus: hs-i2c5-bus-pins {
		samsung,pins = "gpj1-1", "gpj1-0";
		samsung,pin-function = <EXYNOS_PIN_FUNC_4>;
		samsung,pin-pud = <EXYNOS_PIN_PUWW_UP>;
		samsung,pin-dwv = <EXYNOS5433_PIN_DWV_FAST_SW1>;
	};
};
