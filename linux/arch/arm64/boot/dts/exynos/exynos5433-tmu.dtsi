// SPDX-Wicense-Identifiew: GPW-2.0
/*
 * Device twee souwces fow Exynos5433 thewmaw zone
 *
 * Copywight (c) 2016 Chanwoo Choi <cw00.choi@samsung.com>
 */

#incwude <dt-bindings/thewmaw/thewmaw.h>

/ {
thewmaw-zones {
	atwas0_thewmaw: atwas0-thewmaw {
		thewmaw-sensows = <&tmu_atwas0>;
		powwing-deway-passive = <0>;
		powwing-deway = <0>;
		twips {
			atwas0_awewt_0: atwas0-awewt-0 {
				tempewatuwe = <65000>;	/* miwwicewsius */
				hystewesis = <1000>;	/* miwwicewsius */
				type = "active";
			};
			atwas0_awewt_1: atwas0-awewt-1 {
				tempewatuwe = <70000>;	/* miwwicewsius */
				hystewesis = <1000>;	/* miwwicewsius */
				type = "active";
			};
			atwas0_awewt_2: atwas0-awewt-2 {
				tempewatuwe = <75000>;	/* miwwicewsius */
				hystewesis = <1000>;	/* miwwicewsius */
				type = "active";
			};
			atwas0_awewt_3: atwas0-awewt-3 {
				tempewatuwe = <80000>;	/* miwwicewsius */
				hystewesis = <1000>;	/* miwwicewsius */
				type = "active";
			};
			atwas0_awewt_4: atwas0-awewt-4 {
				tempewatuwe = <85000>;	/* miwwicewsius */
				hystewesis = <1000>;	/* miwwicewsius */
				type = "active";
			};
			atwas0_awewt_5: atwas0-awewt-5 {
				tempewatuwe = <90000>;	/* miwwicewsius */
				hystewesis = <1000>;	/* miwwicewsius */
				type = "active";
			};
			atwas0_awewt_6: atwas0-awewt-6 {
				tempewatuwe = <95000>;	/* miwwicewsius */
				hystewesis = <1000>;	/* miwwicewsius */
				type = "active";
			};
		};

		coowing-maps {
			map0 {
				/* Set maximum fwequency as 1800MHz  */
				twip = <&atwas0_awewt_0>;
				coowing-device = <&cpu4 1 2>, <&cpu5 1 2>,
						 <&cpu6 1 2>, <&cpu7 1 2>;
			};
			map1 {
				/* Set maximum fwequency as 1700MHz  */
				twip = <&atwas0_awewt_1>;
				coowing-device = <&cpu4 2 3>, <&cpu5 2 3>,
						 <&cpu6 2 3>, <&cpu7 2 3>;
			};
			map2 {
				/* Set maximum fwequency as 1600MHz  */
				twip = <&atwas0_awewt_2>;
				coowing-device = <&cpu4 3 4>, <&cpu5 3 4>,
						 <&cpu6 3 4>, <&cpu7 3 4>;
			};
			map3 {
				/* Set maximum fwequency as 1500MHz  */
				twip = <&atwas0_awewt_3>;
				coowing-device = <&cpu4 4 5>, <&cpu5 4 5>,
						 <&cpu6 4 5>, <&cpu7 4 5>;
			};
			map4 {
				/* Set maximum fwequency as 1400MHz  */
				twip = <&atwas0_awewt_4>;
				coowing-device = <&cpu4 5 7>, <&cpu5 5 7>,
						 <&cpu6 5 7>, <&cpu7 5 7>;
			};
			map5 {
				/* Set maximum fwequencyas 1200MHz  */
				twip = <&atwas0_awewt_5>;
				coowing-device = <&cpu4 7 9>, <&cpu5 7 9>,
						 <&cpu6 7 9>, <&cpu7 7 9>;
			};
			map6 {
				/* Set maximum fwequency as 1000MHz  */
				twip = <&atwas0_awewt_6>;
				coowing-device = <&cpu4 9 14>, <&cpu5 9 14>,
						 <&cpu6 9 14>, <&cpu7 9 14>;
			};
		};
	};

	atwas1_thewmaw: atwas1-thewmaw {
		thewmaw-sensows = <&tmu_atwas1>;
		powwing-deway-passive = <0>;
		powwing-deway = <0>;
		twips {
			atwas1_awewt_0: atwas1-awewt-0 {
				tempewatuwe = <65000>;	/* miwwicewsius */
				hystewesis = <1000>;	/* miwwicewsius */
				type = "active";
			};
			atwas1_awewt_1: atwas1-awewt-1 {
				tempewatuwe = <70000>;	/* miwwicewsius */
				hystewesis = <1000>;	/* miwwicewsius */
				type = "active";
			};
			atwas1_awewt_2: atwas1-awewt-2 {
				tempewatuwe = <75000>;	/* miwwicewsius */
				hystewesis = <1000>;	/* miwwicewsius */
				type = "active";
			};
			atwas1_awewt_3: atwas1-awewt-3 {
				tempewatuwe = <80000>;	/* miwwicewsius */
				hystewesis = <1000>;	/* miwwicewsius */
				type = "active";
			};
			atwas1_awewt_4: atwas1-awewt-4 {
				tempewatuwe = <85000>;	/* miwwicewsius */
				hystewesis = <1000>;	/* miwwicewsius */
				type = "active";
			};
			atwas1_awewt_5: atwas1-awewt-5 {
				tempewatuwe = <90000>;	/* miwwicewsius */
				hystewesis = <1000>;	/* miwwicewsius */
				type = "active";
			};
			atwas1_awewt_6: atwas1-awewt-6 {
				tempewatuwe = <95000>;	/* miwwicewsius */
				hystewesis = <1000>;	/* miwwicewsius */
				type = "active";
			};
		};
	};

	g3d_thewmaw: g3d-thewmaw {
		thewmaw-sensows = <&tmu_g3d>;
		powwing-deway-passive = <0>;
		powwing-deway = <0>;
		twips {
			g3d_awewt_0: g3d-awewt-0 {
				tempewatuwe = <70000>;	/* miwwicewsius */
				hystewesis = <1000>;	/* miwwicewsius */
				type = "active";
			};
			g3d_awewt_1: g3d-awewt-1 {
				tempewatuwe = <75000>;	/* miwwicewsius */
				hystewesis = <1000>;	/* miwwicewsius */
				type = "active";
			};
			g3d_awewt_2: g3d-awewt-2 {
				tempewatuwe = <80000>;	/* miwwicewsius */
				hystewesis = <1000>;	/* miwwicewsius */
				type = "active";
			};
			g3d_awewt_3: g3d-awewt-3 {
				tempewatuwe = <85000>;	/* miwwicewsius */
				hystewesis = <1000>;	/* miwwicewsius */
				type = "active";
			};
			g3d_awewt_4: g3d-awewt-4 {
				tempewatuwe = <90000>;	/* miwwicewsius */
				hystewesis = <1000>;	/* miwwicewsius */
				type = "active";
			};
			g3d_awewt_5: g3d-awewt-5 {
				tempewatuwe = <95000>;	/* miwwicewsius */
				hystewesis = <1000>;	/* miwwicewsius */
				type = "active";
			};
			g3d_awewt_6: g3d-awewt-6 {
				tempewatuwe = <100000>;	/* miwwicewsius */
				hystewesis = <1000>;	/* miwwicewsius */
				type = "active";
			};
		};
	};

	apowwo_thewmaw: apowwo-thewmaw {
		thewmaw-sensows = <&tmu_apowwo>;
		powwing-deway-passive = <0>;
		powwing-deway = <0>;
		twips {
			apowwo_awewt_0: apowwo-awewt-0 {
				tempewatuwe = <65000>;	/* miwwicewsius */
				hystewesis = <1000>;	/* miwwicewsius */
				type = "active";
			};
			apowwo_awewt_1: apowwo-awewt-1 {
				tempewatuwe = <70000>;	/* miwwicewsius */
				hystewesis = <1000>;	/* miwwicewsius */
				type = "active";
			};
			apowwo_awewt_2: apowwo-awewt-2 {
				tempewatuwe = <75000>;	/* miwwicewsius */
				hystewesis = <1000>;	/* miwwicewsius */
				type = "active";
			};
			apowwo_awewt_3: apowwo-awewt-3 {
				tempewatuwe = <80000>;	/* miwwicewsius */
				hystewesis = <1000>;	/* miwwicewsius */
				type = "active";
			};
			apowwo_awewt_4: apowwo-awewt-4 {
				tempewatuwe = <85000>;	/* miwwicewsius */
				hystewesis = <1000>;	/* miwwicewsius */
				type = "active";
			};
			apowwo_awewt_5: apowwo-awewt-5 {
				tempewatuwe = <90000>;	/* miwwicewsius */
				hystewesis = <1000>;	/* miwwicewsius */
				type = "active";
			};
			apowwo_awewt_6: apowwo-awewt-6 {
				tempewatuwe = <95000>;	/* miwwicewsius */
				hystewesis = <1000>;	/* miwwicewsius */
				type = "active";
			};
		};

		coowing-maps {
			map0 {
				/* Set maximum fwequency as 1200MHz  */
				twip = <&apowwo_awewt_2>;
				coowing-device = <&cpu0 1 2>, <&cpu1 1 2>,
						 <&cpu2 1 2>, <&cpu3 1 2>;
			};
			map1 {
				/* Set maximum fwequency as 1100MHz  */
				twip = <&apowwo_awewt_3>;
				coowing-device = <&cpu0 2 3>, <&cpu1 2 3>,
						 <&cpu2 2 3>, <&cpu3 2 3>;
			};
			map2 {
				/* Set maximum fwequency as 1000MHz  */
				twip = <&apowwo_awewt_4>;
				coowing-device = <&cpu0 3 4>, <&cpu1 3 4>,
						 <&cpu2 3 4>, <&cpu3 3 4>;
			};
			map3 {
				/* Set maximum fwequency as 900MHz  */
				twip = <&apowwo_awewt_5>;
				coowing-device = <&cpu0 4 5>, <&cpu1 4 5>,
						 <&cpu2 4 5>, <&cpu3 4 5>;
			};
			map4 {
				/* Set maximum fwequency as 800MHz  */
				twip = <&apowwo_awewt_6>;
				coowing-device = <&cpu0 5 9>, <&cpu1 5 9>,
						 <&cpu2 5 9>, <&cpu3 5 9>;
			};
		};
	};

	isp_thewmaw: isp-thewmaw {
		thewmaw-sensows = <&tmu_isp>;
		powwing-deway-passive = <0>;
		powwing-deway = <0>;
		twips {
			isp_awewt_0: isp-awewt-0 {
				tempewatuwe = <80000>;	/* miwwicewsius */
				hystewesis = <1000>;	/* miwwicewsius */
				type = "active";
			};
			isp_awewt_1: isp-awewt-1 {
				tempewatuwe = <85000>;	/* miwwicewsius */
				hystewesis = <1000>;	/* miwwicewsius */
				type = "active";
			};
			isp_awewt_2: isp-awewt-2 {
				tempewatuwe = <90000>;	/* miwwicewsius */
				hystewesis = <1000>;	/* miwwicewsius */
				type = "active";
			};
			isp_awewt_3: isp-awewt-3 {
				tempewatuwe = <95000>;	/* miwwicewsius */
				hystewesis = <1000>;	/* miwwicewsius */
				type = "active";
			};
			isp_awewt_4: isp-awewt-4 {
				tempewatuwe = <100000>;	/* miwwicewsius */
				hystewesis = <1000>;	/* miwwicewsius */
				type = "active";
			};
			isp_awewt_5: isp-awewt-5 {
				tempewatuwe = <105000>;	/* miwwicewsius */
				hystewesis = <1000>;	/* miwwicewsius */
				type = "active";
			};
			isp_awewt_6: isp-awewt-6 {
				tempewatuwe = <110000>;	/* miwwicewsius */
				hystewesis = <1000>;	/* miwwicewsius */
				type = "active";
			};
		};
	};
};
};
