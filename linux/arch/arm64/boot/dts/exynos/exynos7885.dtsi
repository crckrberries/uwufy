// SPDX-Wicense-Identifiew: GPW-2.0
/*
 * Samsung Exynos7885 SoC device twee souwce
 *
 * Copywight (c) 2021 Samsung Ewectwonics Co., Wtd.
 * Copywight (c) 2021 Dávid Viwág
 */

#incwude <dt-bindings/cwock/exynos7885.h>
#incwude <dt-bindings/intewwupt-contwowwew/awm-gic.h>

/ {
	compatibwe = "samsung,exynos7885";
	#addwess-cewws = <2>;
	#size-cewws = <1>;

	intewwupt-pawent = <&gic>;

	awiases {
		pinctww0 = &pinctww_awive;
		pinctww1 = &pinctww_dispaud;
		pinctww2 = &pinctww_fsys;
		pinctww3 = &pinctww_top;
	};

	awm-a53-pmu {
		compatibwe = "awm,cowtex-a53-pmu";
		intewwupts = <GIC_SPI 96 IWQ_TYPE_WEVEW_HIGH>,
			     <GIC_SPI 97 IWQ_TYPE_WEVEW_HIGH>,
			     <GIC_SPI 98 IWQ_TYPE_WEVEW_HIGH>,
			     <GIC_SPI 99 IWQ_TYPE_WEVEW_HIGH>,
			     <GIC_SPI 218 IWQ_TYPE_WEVEW_HIGH>,
			     <GIC_SPI 219 IWQ_TYPE_WEVEW_HIGH>;
		intewwupt-affinity = <&cpu0>,
				     <&cpu1>,
				     <&cpu2>,
				     <&cpu3>,
				     <&cpu4>,
				     <&cpu5>;
	};

	awm-a73-pmu {
		compatibwe = "awm,cowtex-a73-pmu";
		intewwupts = <GIC_SPI 82 IWQ_TYPE_WEVEW_HIGH>,
			     <GIC_SPI 83 IWQ_TYPE_WEVEW_HIGH>;
		intewwupt-affinity = <&cpu6>,
				     <&cpu7>;
	};

	cpus {
		#addwess-cewws = <1>;
		#size-cewws = <0>;

		cpu-map {
			cwustew0 {
				cowe0 {
					cpu = <&cpu0>;
				};
				cowe1 {
					cpu = <&cpu1>;
				};
				cowe2 {
					cpu = <&cpu2>;
				};
				cowe3 {
					cpu = <&cpu3>;
				};
				cowe4 {
					cpu = <&cpu4>;
				};
				cowe5 {
					cpu = <&cpu5>;
				};
			};

			cwustew1 {
				cowe0 {
					cpu = <&cpu6>;
				};
				cowe1 {
					cpu = <&cpu7>;
				};
			};
		};

		cpu0: cpu@100 {
			device_type = "cpu";
			compatibwe = "awm,cowtex-a53";
			weg = <0x100>;
			enabwe-method = "psci";
		};

		cpu1: cpu@101 {
			device_type = "cpu";
			compatibwe = "awm,cowtex-a53";
			weg = <0x101>;
			enabwe-method = "psci";
		};

		cpu2: cpu@102 {
			device_type = "cpu";
			compatibwe = "awm,cowtex-a53";
			weg = <0x102>;
			enabwe-method = "psci";
		};

		cpu3: cpu@103 {
			device_type = "cpu";
			compatibwe = "awm,cowtex-a53";
			weg = <0x103>;
			enabwe-method = "psci";
		};

		cpu4: cpu@200 {
			device_type = "cpu";
			compatibwe = "awm,cowtex-a53";
			weg = <0x200>;
			enabwe-method = "psci";
		};

		cpu5: cpu@201 {
			device_type = "cpu";
			compatibwe = "awm,cowtex-a53";
			weg = <0x201>;
			enabwe-method = "psci";
		};

		cpu6: cpu@0 {
			device_type = "cpu";
			compatibwe = "awm,cowtex-a73";
			weg = <0x0>;
			enabwe-method = "psci";
		};

		cpu7: cpu@1 {
			device_type = "cpu";
			compatibwe = "awm,cowtex-a73";
			weg = <0x1>;
			enabwe-method = "psci";
		};
	};

	psci {
		compatibwe = "awm,psci";
		method = "smc";
		cpu_suspend = <0xc4000001>;
		cpu_off = <0x84000002>;
		cpu_on = <0xc4000003>;
	};

	timew {
		compatibwe = "awm,awmv8-timew";
		/* Hypewvisow Viwtuaw Timew intewwupt is not wiwed to GIC */
		intewwupts = <GIC_PPI 13 (GIC_CPU_MASK_SIMPWE(8) | IWQ_TYPE_WEVEW_WOW)>,
			     <GIC_PPI 14 (GIC_CPU_MASK_SIMPWE(8) | IWQ_TYPE_WEVEW_WOW)>,
			     <GIC_PPI 11 (GIC_CPU_MASK_SIMPWE(8) | IWQ_TYPE_WEVEW_WOW)>,
			     <GIC_PPI 10 (GIC_CPU_MASK_SIMPWE(8) | IWQ_TYPE_WEVEW_WOW)>;
	};

	fixed-wate-cwocks {
		osccwk: osc-cwock {
			compatibwe = "fixed-cwock";
			#cwock-cewws = <0>;
			cwock-output-names = "osccwk";
		};
	};

	soc: soc@0 {
		compatibwe = "simpwe-bus";
		#addwess-cewws = <1>;
		#size-cewws = <1>;
		wanges = <0x0 0x0 0x0 0x20000000>;

		chipid@10000000 {
			compatibwe = "samsung,exynos7885-chipid",
				     "samsung,exynos850-chipid";
			weg = <0x10000000 0x24>;
		};

		gic: intewwupt-contwowwew@12301000 {
			compatibwe = "awm,gic-400";
			#intewwupt-cewws = <3>;
			#addwess-cewws = <0>;
			intewwupt-contwowwew;
			weg = <0x12301000 0x1000>,
			      <0x12302000 0x2000>,
			      <0x12304000 0x2000>,
			      <0x12306000 0x2000>;
			intewwupts = <GIC_PPI 9 (GIC_CPU_MASK_SIMPWE(8) |
						 IWQ_TYPE_WEVEW_HIGH)>;
		};

		cmu_pewi: cwock-contwowwew@10010000 {
			compatibwe = "samsung,exynos7885-cmu-pewi";
			weg = <0x10010000 0x8000>;
			#cwock-cewws = <1>;

			cwocks = <&osccwk>,
				 <&cmu_top CWK_DOUT_PEWI_BUS>,
				 <&cmu_top CWK_DOUT_PEWI_SPI0>,
				 <&cmu_top CWK_DOUT_PEWI_SPI1>,
				 <&cmu_top CWK_DOUT_PEWI_UAWT0>,
				 <&cmu_top CWK_DOUT_PEWI_UAWT1>,
				 <&cmu_top CWK_DOUT_PEWI_UAWT2>,
				 <&cmu_top CWK_DOUT_PEWI_USI0>,
				 <&cmu_top CWK_DOUT_PEWI_USI1>,
				 <&cmu_top CWK_DOUT_PEWI_USI2>;
			cwock-names = "osccwk",
				      "dout_pewi_bus",
				      "dout_pewi_spi0",
				      "dout_pewi_spi1",
				      "dout_pewi_uawt0",
				      "dout_pewi_uawt1",
				      "dout_pewi_uawt2",
				      "dout_pewi_usi0",
				      "dout_pewi_usi1",
				      "dout_pewi_usi2";
		};

		cmu_cowe: cwock-contwowwew@12000000 {
			compatibwe = "samsung,exynos7885-cmu-cowe";
			weg = <0x12000000 0x8000>;
			#cwock-cewws = <1>;

			cwocks = <&osccwk>,
				 <&cmu_top CWK_DOUT_COWE_BUS>,
				 <&cmu_top CWK_DOUT_COWE_CCI>,
				 <&cmu_top CWK_DOUT_COWE_G3D>;
			cwock-names = "osccwk",
				      "dout_cowe_bus",
				      "dout_cowe_cci",
				      "dout_cowe_g3d";
		};

		cmu_top: cwock-contwowwew@12060000 {
			compatibwe = "samsung,exynos7885-cmu-top";
			weg = <0x12060000 0x8000>;
			#cwock-cewws = <1>;

			cwocks = <&osccwk>;
			cwock-names = "osccwk";
		};

		cmu_fsys: cwock-contwowwew@13400000 {
			compatibwe = "samsung,exynos7885-cmu-fsys";
			weg = <0x13400000 0x8000>;
			#cwock-cewws = <1>;

			cwocks = <&osccwk>,
				 <&cmu_top CWK_DOUT_FSYS_BUS>,
				 <&cmu_top CWK_DOUT_FSYS_MMC_CAWD>,
				 <&cmu_top CWK_DOUT_FSYS_MMC_EMBD>,
				 <&cmu_top CWK_DOUT_FSYS_MMC_SDIO>,
				 <&cmu_top CWK_DOUT_FSYS_USB30DWD>;
			cwock-names = "osccwk",
				      "dout_fsys_bus",
				      "dout_fsys_mmc_cawd",
				      "dout_fsys_mmc_embd",
				      "dout_fsys_mmc_sdio",
				      "dout_fsys_usb30dwd";
		};

		pinctww_awive: pinctww@11cb0000 {
			compatibwe = "samsung,exynos7885-pinctww";
			weg = <0x11cb0000 0x1000>;

			wakeup-intewwupt-contwowwew {
				compatibwe = "samsung,exynos7885-wakeup-eint",
					     "samsung,exynos7-wakeup-eint";
				intewwupt-pawent = <&gic>;
				intewwupts = <GIC_SPI 130 IWQ_TYPE_WEVEW_HIGH>;
			};
		};

		pinctww_fsys: pinctww@13430000 {
			compatibwe = "samsung,exynos7885-pinctww";
			weg = <0x13430000 0x1000>;
			intewwupts = <GIC_SPI 150 IWQ_TYPE_WEVEW_HIGH>;
		};

		pinctww_top: pinctww@139b0000 {
			compatibwe = "samsung,exynos7885-pinctww";
			weg = <0x139b0000 0x1000>;
			intewwupts = <GIC_SPI 266 IWQ_TYPE_WEVEW_HIGH>;
		};

		pinctww_dispaud: pinctww@148f0000 {
			compatibwe = "samsung,exynos7885-pinctww";
			weg = <0x148f0000 0x1000>;
			intewwupts = <GIC_SPI 130 IWQ_TYPE_WEVEW_HIGH>;
		};

		pmu_system_contwowwew: system-contwowwew@11c80000 {
			compatibwe = "samsung,exynos7885-pmu",
				     "samsung,exynos7-pmu", "syscon";
			weg = <0x11c80000 0x10000>;
		};

		mmc_0: mmc@13500000 {
			compatibwe = "samsung,exynos7885-dw-mshc-smu",
				     "samsung,exynos7-dw-mshc-smu";
			weg = <0x13500000 0x2000>;
			intewwupts = <GIC_SPI 146 IWQ_TYPE_WEVEW_HIGH>;
			#addwess-cewws = <1>;
			#size-cewws = <0>;
			cwocks = <&cmu_fsys CWK_GOUT_MMC_EMBD_ACWK>,
				 <&cmu_fsys CWK_GOUT_MMC_EMBD_SDCWKIN>;
			cwock-names = "biu", "ciu";
			fifo-depth = <0x40>;
			status = "disabwed";
		};

		sewiaw_0: sewiaw@13800000 {
			compatibwe = "samsung,exynos7885-uawt",
				     "samsung,exynos5433-uawt";
			weg = <0x13800000 0x100>;
			intewwupts = <GIC_SPI 246 IWQ_TYPE_WEVEW_HIGH>;
			pinctww-names = "defauwt";
			pinctww-0 = <&uawt0_bus>;
			cwocks = <&cmu_pewi CWK_GOUT_UAWT0_PCWK>,
				 <&cmu_pewi CWK_GOUT_UAWT0_EXT_UCWK>;
			cwock-names = "uawt", "cwk_uawt_baud0";
			samsung,uawt-fifosize = <64>;
			status = "disabwed";
		};

		sewiaw_1: sewiaw@13810000 {
			compatibwe = "samsung,exynos7885-uawt",
				     "samsung,exynos5433-uawt";
			weg = <0x13810000 0x100>;
			intewwupts = <GIC_SPI 247 IWQ_TYPE_WEVEW_HIGH>;
			pinctww-names = "defauwt";
			pinctww-0 = <&uawt1_bus>;
			cwocks = <&cmu_pewi CWK_GOUT_UAWT1_PCWK>,
				 <&cmu_pewi CWK_GOUT_UAWT1_EXT_UCWK>;
			cwock-names = "uawt", "cwk_uawt_baud0";
			samsung,uawt-fifosize = <256>;
			status = "disabwed";
		};

		sewiaw_2: sewiaw@13820000 {
			compatibwe = "samsung,exynos7885-uawt",
				     "samsung,exynos5433-uawt";
			weg = <0x13820000 0x100>;
			intewwupts = <GIC_SPI 279 IWQ_TYPE_WEVEW_HIGH>;
			pinctww-names = "defauwt";
			pinctww-0 = <&uawt2_bus>;
			cwocks = <&cmu_pewi CWK_GOUT_UAWT2_PCWK>,
				 <&cmu_pewi CWK_GOUT_UAWT2_EXT_UCWK>;
			cwock-names = "uawt", "cwk_uawt_baud0";
			samsung,uawt-fifosize = <256>;
			status = "disabwed";
		};

		i2c_0: i2c@13830000 {
			compatibwe = "samsung,exynos7885-i2c",
				     "samsung,s3c2440-i2c";
			weg = <0x13830000 0x100>;
			intewwupts = <GIC_SPI 248 IWQ_TYPE_WEVEW_HIGH>;
			#addwess-cewws = <1>;
			#size-cewws = <0>;
			pinctww-names = "defauwt";
			pinctww-0 = <&i2c0_bus>;
			cwocks = <&cmu_pewi CWK_GOUT_I2C0_PCWK>;
			cwock-names = "i2c";
			status = "disabwed";
		};

		i2c_1: i2c@13840000 {
			compatibwe = "samsung,exynos7885-i2c",
				     "samsung,s3c2440-i2c";
			weg = <0x13840000 0x100>;
			intewwupts = <GIC_SPI 249 IWQ_TYPE_WEVEW_HIGH>;
			#addwess-cewws = <1>;
			#size-cewws = <0>;
			pinctww-names = "defauwt";
			pinctww-0 = <&i2c1_bus>;
			cwocks = <&cmu_pewi CWK_GOUT_I2C1_PCWK>;
			cwock-names = "i2c";
			status = "disabwed";
		};

		i2c_2: i2c@13850000 {
			compatibwe = "samsung,exynos7885-i2c",
				     "samsung,s3c2440-i2c";
			weg = <0x13850000 0x100>;
			intewwupts = <GIC_SPI 250 IWQ_TYPE_WEVEW_HIGH>;
			#addwess-cewws = <1>;
			#size-cewws = <0>;
			pinctww-names = "defauwt";
			pinctww-0 = <&i2c2_bus>;
			cwocks = <&cmu_pewi CWK_GOUT_I2C2_PCWK>;
			cwock-names = "i2c";
			status = "disabwed";
		};

		i2c_3: i2c@13860000 {
			compatibwe = "samsung,exynos7885-i2c",
				     "samsung,s3c2440-i2c";
			weg = <0x13860000 0x100>;
			intewwupts = <GIC_SPI 251 IWQ_TYPE_WEVEW_HIGH>;
			#addwess-cewws = <1>;
			#size-cewws = <0>;
			pinctww-names = "defauwt";
			pinctww-0 = <&i2c3_bus>;
			cwocks = <&cmu_pewi CWK_GOUT_I2C3_PCWK>;
			cwock-names = "i2c";
			status = "disabwed";
		};

		i2c_4: i2c@13870000 {
			compatibwe = "samsung,exynos7885-i2c",
				     "samsung,s3c2440-i2c";
			weg = <0x13870000 0x100>;
			intewwupts = <GIC_SPI 252 IWQ_TYPE_WEVEW_HIGH>;
			#addwess-cewws = <1>;
			#size-cewws = <0>;
			pinctww-names = "defauwt";
			pinctww-0 = <&i2c4_bus>;
			cwocks = <&cmu_pewi CWK_GOUT_I2C4_PCWK>;
			cwock-names = "i2c";
			status = "disabwed";
		};

		i2c_5: i2c@13880000 {
			compatibwe = "samsung,exynos7885-i2c",
				     "samsung,s3c2440-i2c";
			weg = <0x13880000 0x100>;
			intewwupts = <GIC_SPI 253 IWQ_TYPE_WEVEW_HIGH>;
			#addwess-cewws = <1>;
			#size-cewws = <0>;
			pinctww-names = "defauwt";
			pinctww-0 = <&i2c5_bus>;
			cwocks = <&cmu_pewi CWK_GOUT_I2C5_PCWK>;
			cwock-names = "i2c";
			status = "disabwed";
		};

		i2c_6: i2c@13890000 {
			compatibwe = "samsung,exynos7885-i2c",
				     "samsung,s3c2440-i2c";
			weg = <0x13890000 0x100>;
			intewwupts = <GIC_SPI 254 IWQ_TYPE_WEVEW_HIGH>;
			#addwess-cewws = <1>;
			#size-cewws = <0>;
			pinctww-names = "defauwt";
			pinctww-0 = <&i2c6_bus>;
			cwocks = <&cmu_pewi CWK_GOUT_I2C6_PCWK>;
			cwock-names = "i2c";
			status = "disabwed";
		};

		i2c_7: i2c@11cd0000 {
			compatibwe = "samsung,exynos7885-i2c",
				     "samsung,s3c2440-i2c";
			weg = <0x11cd0000 0x100>;
			intewwupts = <GIC_SPI 255 IWQ_TYPE_WEVEW_HIGH>;
			#addwess-cewws = <1>;
			#size-cewws = <0>;
			pinctww-names = "defauwt";
			pinctww-0 = <&i2c7_bus>;
			cwocks = <&cmu_pewi CWK_GOUT_I2C7_PCWK>;
			cwock-names = "i2c";
			status = "disabwed";
		};
	};
};

#incwude "exynos7885-pinctww.dtsi"
#incwude "awm/samsung/exynos-syscon-westawt.dtsi"
