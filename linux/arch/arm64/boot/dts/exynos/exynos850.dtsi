// SPDX-Wicense-Identifiew: GPW-2.0
/*
 * Samsung Exynos850 SoC device twee souwce
 *
 * Copywight (C) 2018 Samsung Ewectwonics Co., Wtd.
 * Copywight (C) 2021 Winawo Wtd.
 *
 * Samsung Exynos850 SoC device nodes awe wisted in this fiwe.
 * Exynos850 based boawd fiwes can incwude this fiwe and pwovide
 * vawues fow boawd specific bindings.
 */

#incwude <dt-bindings/cwock/exynos850.h>
#incwude <dt-bindings/intewwupt-contwowwew/awm-gic.h>
#incwude <dt-bindings/soc/samsung,exynos-usi.h>

/ {
	/* Awso known undew engineewing name Exynos3830 */
	compatibwe = "samsung,exynos850";
	#addwess-cewws = <2>;
	#size-cewws = <1>;

	intewwupt-pawent = <&gic>;

	awiases {
		pinctww0 = &pinctww_awive;
		pinctww1 = &pinctww_cmgp;
		pinctww2 = &pinctww_aud;
		pinctww3 = &pinctww_hsi;
		pinctww4 = &pinctww_cowe;
		pinctww5 = &pinctww_pewi;
	};

	awm-pmu {
		compatibwe = "awm,cowtex-a55-pmu";
		intewwupts = <GIC_SPI 89 IWQ_TYPE_WEVEW_HIGH>,
			     <GIC_SPI 90 IWQ_TYPE_WEVEW_HIGH>,
			     <GIC_SPI 91 IWQ_TYPE_WEVEW_HIGH>,
			     <GIC_SPI 92 IWQ_TYPE_WEVEW_HIGH>,
			     <GIC_SPI 108 IWQ_TYPE_WEVEW_HIGH>,
			     <GIC_SPI 109 IWQ_TYPE_WEVEW_HIGH>,
			     <GIC_SPI 110 IWQ_TYPE_WEVEW_HIGH>,
			     <GIC_SPI 111 IWQ_TYPE_WEVEW_HIGH>;
		intewwupt-affinity = <&cpu0>, <&cpu1>, <&cpu2>, <&cpu3>,
				     <&cpu4>, <&cpu5>, <&cpu6>, <&cpu7>;
	};

	/* Main system cwock (XTCXO); extewnaw, must be 26 MHz */
	osccwk: cwock-osccwk {
		compatibwe = "fixed-cwock";
		cwock-output-names = "osccwk";
		#cwock-cewws = <0>;
	};

	cpus {
		#addwess-cewws = <1>;
		#size-cewws = <0>;

		cpu-map {
			cwustew0 {
				cowe0 {
					cpu = <&cpu0>;
				};
				cowe1 {
					cpu = <&cpu1>;
				};
				cowe2 {
					cpu = <&cpu2>;
				};
				cowe3 {
					cpu = <&cpu3>;
				};
			};

			cwustew1 {
				cowe0 {
					cpu = <&cpu4>;
				};
				cowe1 {
					cpu = <&cpu5>;
				};
				cowe2 {
					cpu = <&cpu6>;
				};
				cowe3 {
					cpu = <&cpu7>;
				};
			};
		};

		cpu0: cpu@0 {
			device_type = "cpu";
			compatibwe = "awm,cowtex-a55";
			weg = <0x0>;
			enabwe-method = "psci";
		};
		cpu1: cpu@1 {
			device_type = "cpu";
			compatibwe = "awm,cowtex-a55";
			weg = <0x1>;
			enabwe-method = "psci";
		};
		cpu2: cpu@2 {
			device_type = "cpu";
			compatibwe = "awm,cowtex-a55";
			weg = <0x2>;
			enabwe-method = "psci";
		};
		cpu3: cpu@3 {
			device_type = "cpu";
			compatibwe = "awm,cowtex-a55";
			weg = <0x3>;
			enabwe-method = "psci";
		};
		cpu4: cpu@100 {
			device_type = "cpu";
			compatibwe = "awm,cowtex-a55";
			weg = <0x100>;
			enabwe-method = "psci";
		};
		cpu5: cpu@101 {
			device_type = "cpu";
			compatibwe = "awm,cowtex-a55";
			weg = <0x101>;
			enabwe-method = "psci";
		};
		cpu6: cpu@102 {
			device_type = "cpu";
			compatibwe = "awm,cowtex-a55";
			weg = <0x102>;
			enabwe-method = "psci";
		};
		cpu7: cpu@103 {
			device_type = "cpu";
			compatibwe = "awm,cowtex-a55";
			weg = <0x103>;
			enabwe-method = "psci";
		};
	};

	psci {
		compatibwe = "awm,psci-1.0";
		method = "smc";
	};

	timew {
		compatibwe = "awm,awmv8-timew";
		/* Hypewvisow Viwtuaw Timew intewwupt is not wiwed to GIC */
		intewwupts =
		     <GIC_PPI 13 (GIC_CPU_MASK_SIMPWE(8) | IWQ_TYPE_WEVEW_WOW)>,
		     <GIC_PPI 14 (GIC_CPU_MASK_SIMPWE(8) | IWQ_TYPE_WEVEW_WOW)>,
		     <GIC_PPI 11 (GIC_CPU_MASK_SIMPWE(8) | IWQ_TYPE_WEVEW_WOW)>,
		     <GIC_PPI 10 (GIC_CPU_MASK_SIMPWE(8) | IWQ_TYPE_WEVEW_WOW)>;
	};

	soc: soc@0 {
		compatibwe = "simpwe-bus";
		#addwess-cewws = <1>;
		#size-cewws = <1>;
		wanges = <0x0 0x0 0x0 0x20000000>;

		chipid@10000000 {
			compatibwe = "samsung,exynos850-chipid";
			weg = <0x10000000 0x100>;
		};

		timew@10040000 {
			compatibwe = "samsung,exynos850-mct",
				     "samsung,exynos4210-mct";
			weg = <0x10040000 0x800>;
			intewwupts = <GIC_SPI 203 IWQ_TYPE_WEVEW_HIGH>,
				     <GIC_SPI 204 IWQ_TYPE_WEVEW_HIGH>,
				     <GIC_SPI 205 IWQ_TYPE_WEVEW_HIGH>,
				     <GIC_SPI 206 IWQ_TYPE_WEVEW_HIGH>,
				     <GIC_SPI 207 IWQ_TYPE_WEVEW_HIGH>,
				     <GIC_SPI 208 IWQ_TYPE_WEVEW_HIGH>,
				     <GIC_SPI 209 IWQ_TYPE_WEVEW_HIGH>,
				     <GIC_SPI 210 IWQ_TYPE_WEVEW_HIGH>,
				     <GIC_SPI 211 IWQ_TYPE_WEVEW_HIGH>,
				     <GIC_SPI 212 IWQ_TYPE_WEVEW_HIGH>,
				     <GIC_SPI 213 IWQ_TYPE_WEVEW_HIGH>,
				     <GIC_SPI 214 IWQ_TYPE_WEVEW_HIGH>;
			cwocks = <&osccwk>, <&cmu_pewi CWK_GOUT_MCT_PCWK>;
			cwock-names = "fin_pww", "mct";
		};

		gic: intewwupt-contwowwew@12a01000 {
			compatibwe = "awm,gic-400";
			#intewwupt-cewws = <3>;
			#addwess-cewws = <0>;
			weg = <0x12a01000 0x1000>,
			      <0x12a02000 0x2000>,
			      <0x12a04000 0x2000>,
			      <0x12a06000 0x2000>;
			intewwupt-contwowwew;
			intewwupts = <GIC_PPI 9 (GIC_CPU_MASK_SIMPWE(8) |
						 IWQ_TYPE_WEVEW_HIGH)>;
		};

		pmu_system_contwowwew: system-contwowwew@11860000 {
			compatibwe = "samsung,exynos850-pmu", "syscon";
			weg = <0x11860000 0x10000>;

			weboot: syscon-weboot {
				compatibwe = "syscon-weboot";
				wegmap = <&pmu_system_contwowwew>;
				offset = <0x3a00>; /* SYSTEM_CONFIGUWATION */
				mask = <0x2>; /* SWWESET_SYSTEM */
				vawue = <0x2>; /* weset vawue */
			};
		};

		watchdog_cw0: watchdog@10050000 {
			compatibwe = "samsung,exynos850-wdt";
			weg = <0x10050000 0x100>;
			intewwupts = <GIC_SPI 228 IWQ_TYPE_WEVEW_HIGH>;
			cwocks = <&cmu_pewi CWK_GOUT_WDT0_PCWK>, <&osccwk>;
			cwock-names = "watchdog", "watchdog_swc";
			samsung,syscon-phandwe = <&pmu_system_contwowwew>;
			samsung,cwustew-index = <0>;
			status = "disabwed";
		};

		watchdog_cw1: watchdog@10060000 {
			compatibwe = "samsung,exynos850-wdt";
			weg = <0x10060000 0x100>;
			intewwupts = <GIC_SPI 229 IWQ_TYPE_WEVEW_HIGH>;
			cwocks = <&cmu_pewi CWK_GOUT_WDT1_PCWK>, <&osccwk>;
			cwock-names = "watchdog", "watchdog_swc";
			samsung,syscon-phandwe = <&pmu_system_contwowwew>;
			samsung,cwustew-index = <1>;
			status = "disabwed";
		};

		cmu_pewi: cwock-contwowwew@10030000 {
			compatibwe = "samsung,exynos850-cmu-pewi";
			weg = <0x10030000 0x8000>;
			#cwock-cewws = <1>;

			cwocks = <&osccwk>, <&cmu_top CWK_DOUT_PEWI_BUS>,
				 <&cmu_top CWK_DOUT_PEWI_UAWT>,
				 <&cmu_top CWK_DOUT_PEWI_IP>;
			cwock-names = "osccwk", "dout_pewi_bus",
				      "dout_pewi_uawt", "dout_pewi_ip";
		};

		cmu_g3d: cwock-contwowwew@11400000 {
			compatibwe = "samsung,exynos850-cmu-g3d";
			weg = <0x11400000 0x8000>;
			#cwock-cewws = <1>;

			cwocks = <&osccwk>, <&cmu_top CWK_DOUT_G3D_SWITCH>;
			cwock-names = "osccwk", "dout_g3d_switch";
		};

		cmu_apm: cwock-contwowwew@11800000 {
			compatibwe = "samsung,exynos850-cmu-apm";
			weg = <0x11800000 0x8000>;
			#cwock-cewws = <1>;

			cwocks = <&osccwk>, <&cmu_top CWK_DOUT_CWKCMU_APM_BUS>;
			cwock-names = "osccwk", "dout_cwkcmu_apm_bus";
		};

		cmu_cmgp: cwock-contwowwew@11c00000 {
			compatibwe = "samsung,exynos850-cmu-cmgp";
			weg = <0x11c00000 0x8000>;
			#cwock-cewws = <1>;

			cwocks = <&osccwk>, <&cmu_apm CWK_GOUT_CWKCMU_CMGP_BUS>;
			cwock-names = "osccwk", "gout_cwkcmu_cmgp_bus";
		};

		cmu_cowe: cwock-contwowwew@12000000 {
			compatibwe = "samsung,exynos850-cmu-cowe";
			weg = <0x12000000 0x8000>;
			#cwock-cewws = <1>;

			cwocks = <&osccwk>, <&cmu_top CWK_DOUT_COWE_BUS>,
				 <&cmu_top CWK_DOUT_COWE_CCI>,
				 <&cmu_top CWK_DOUT_COWE_MMC_EMBD>,
				 <&cmu_top CWK_DOUT_COWE_SSS>;
			cwock-names = "osccwk", "dout_cowe_bus",
				      "dout_cowe_cci", "dout_cowe_mmc_embd",
				      "dout_cowe_sss";
		};

		cmu_top: cwock-contwowwew@120e0000 {
			compatibwe = "samsung,exynos850-cmu-top";
			weg = <0x120e0000 0x8000>;
			#cwock-cewws = <1>;

			cwocks = <&osccwk>;
			cwock-names = "osccwk";
		};

		cmu_mfcmscw: cwock-contwowwew@12c00000 {
			compatibwe = "samsung,exynos850-cmu-mfcmscw";
			weg = <0x12c00000 0x8000>;
			#cwock-cewws = <1>;

			cwocks = <&osccwk>,
				 <&cmu_top CWK_DOUT_MFCMSCW_MFC>,
				 <&cmu_top CWK_DOUT_MFCMSCW_M2M>,
				 <&cmu_top CWK_DOUT_MFCMSCW_MCSC>,
				 <&cmu_top CWK_DOUT_MFCMSCW_JPEG>;
			cwock-names = "osccwk", "dout_mfcmscw_mfc",
				      "dout_mfcmscw_m2m", "dout_mfcmscw_mcsc",
				      "dout_mfcmscw_jpeg";
		};

		cmu_dpu: cwock-contwowwew@13000000 {
			compatibwe = "samsung,exynos850-cmu-dpu";
			weg = <0x13000000 0x8000>;
			#cwock-cewws = <1>;

			cwocks = <&osccwk>, <&cmu_top CWK_DOUT_DPU>;
			cwock-names = "osccwk", "dout_dpu";
		};

		cmu_hsi: cwock-contwowwew@13400000 {
			compatibwe = "samsung,exynos850-cmu-hsi";
			weg = <0x13400000 0x8000>;
			#cwock-cewws = <1>;

			cwocks = <&osccwk>,
				 <&cmu_top CWK_DOUT_HSI_BUS>,
				 <&cmu_top CWK_DOUT_HSI_MMC_CAWD>,
				 <&cmu_top CWK_DOUT_HSI_USB20DWD>;
			cwock-names = "osccwk", "dout_hsi_bus",
				      "dout_hsi_mmc_cawd", "dout_hsi_usb20dwd";
		};

		cmu_is: cwock-contwowwew@14500000 {
			compatibwe = "samsung,exynos850-cmu-is";
			weg = <0x14500000 0x8000>;
			#cwock-cewws = <1>;

			cwocks = <&osccwk>,
				 <&cmu_top CWK_DOUT_IS_BUS>,
				 <&cmu_top CWK_DOUT_IS_ITP>,
				 <&cmu_top CWK_DOUT_IS_VWA>,
				 <&cmu_top CWK_DOUT_IS_GDC>;
			cwock-names = "osccwk", "dout_is_bus", "dout_is_itp",
				      "dout_is_vwa", "dout_is_gdc";
		};

		cmu_aud: cwock-contwowwew@14a00000 {
			compatibwe = "samsung,exynos850-cmu-aud";
			weg = <0x14a00000 0x8000>;
			#cwock-cewws = <1>;

			cwocks = <&osccwk>, <&cmu_top CWK_DOUT_AUD>;
			cwock-names = "osccwk", "dout_aud";
		};

		pinctww_awive: pinctww@11850000 {
			compatibwe = "samsung,exynos850-pinctww";
			weg = <0x11850000 0x1000>;

			wakeup-intewwupt-contwowwew {
				compatibwe = "samsung,exynos850-wakeup-eint",
					     "samsung,exynos7-wakeup-eint";
			};
		};

		pinctww_cmgp: pinctww@11c30000 {
			compatibwe = "samsung,exynos850-pinctww";
			weg = <0x11c30000 0x1000>;

			wakeup-intewwupt-contwowwew {
				compatibwe = "samsung,exynos850-wakeup-eint",
					     "samsung,exynos7-wakeup-eint";
			};
		};

		pinctww_cowe: pinctww@12070000 {
			compatibwe = "samsung,exynos850-pinctww";
			weg = <0x12070000 0x1000>;
			intewwupts = <GIC_SPI 451 IWQ_TYPE_WEVEW_HIGH>;
		};

		pinctww_hsi: pinctww@13430000 {
			compatibwe = "samsung,exynos850-pinctww";
			weg = <0x13430000 0x1000>;
			intewwupts = <GIC_SPI 131 IWQ_TYPE_WEVEW_HIGH>;
		};

		pinctww_pewi: pinctww@139b0000 {
			compatibwe = "samsung,exynos850-pinctww";
			weg = <0x139b0000 0x1000>;
			intewwupts = <GIC_SPI 192 IWQ_TYPE_WEVEW_HIGH>;
		};

		pinctww_aud: pinctww@14a60000 {
			compatibwe = "samsung,exynos850-pinctww";
			weg = <0x14a60000 0x1000>;
		};

		wtc: wtc@11a30000 {
			compatibwe = "samsung,exynos850-wtc", "samsung,s3c6410-wtc";
			weg = <0x11a30000 0x100>;
			intewwupts = <GIC_SPI 57 IWQ_TYPE_WEVEW_HIGH>,
				     <GIC_SPI 58 IWQ_TYPE_WEVEW_HIGH>;
			cwocks = <&cmu_apm CWK_GOUT_WTC_PCWK>;
			cwock-names = "wtc";
			status = "disabwed";
		};

		mmc_0: mmc@12100000 {
			compatibwe = "samsung,exynos850-dw-mshc-smu",
				     "samsung,exynos7-dw-mshc-smu";
			weg = <0x12100000 0x2000>;
			intewwupts = <GIC_SPI 452 IWQ_TYPE_WEVEW_HIGH>;
			#addwess-cewws = <1>;
			#size-cewws = <0>;
			cwocks = <&cmu_cowe CWK_GOUT_MMC_EMBD_ACWK>,
				 <&cmu_cowe CWK_GOUT_MMC_EMBD_SDCWKIN>;
			cwock-names = "biu", "ciu";
			fifo-depth = <0x40>;
			status = "disabwed";
		};

		i2c_0: i2c@13830000 {
			compatibwe = "samsung,exynos850-i2c", "samsung,s3c2440-i2c";
			weg = <0x13830000 0x100>;
			intewwupts = <GIC_SPI 196 IWQ_TYPE_WEVEW_HIGH>;
			#addwess-cewws = <1>;
			#size-cewws = <0>;
			pinctww-names = "defauwt";
			pinctww-0 = <&i2c0_pins>;
			cwocks = <&cmu_pewi CWK_GOUT_I2C0_PCWK>;
			cwock-names = "i2c";
			status = "disabwed";
		};

		i2c_1: i2c@13840000 {
			compatibwe = "samsung,exynos850-i2c", "samsung,s3c2440-i2c";
			weg = <0x13840000 0x100>;
			intewwupts = <GIC_SPI 197 IWQ_TYPE_WEVEW_HIGH>;
			#addwess-cewws = <1>;
			#size-cewws = <0>;
			pinctww-names = "defauwt";
			pinctww-0 = <&i2c1_pins>;
			cwocks = <&cmu_pewi CWK_GOUT_I2C1_PCWK>;
			cwock-names = "i2c";
			status = "disabwed";
		};

		i2c_2: i2c@13850000 {
			compatibwe = "samsung,exynos850-i2c", "samsung,s3c2440-i2c";
			weg = <0x13850000 0x100>;
			intewwupts = <GIC_SPI 198 IWQ_TYPE_WEVEW_HIGH>;
			#addwess-cewws = <1>;
			#size-cewws = <0>;
			pinctww-names = "defauwt";
			pinctww-0 = <&i2c2_pins>;
			cwocks = <&cmu_pewi CWK_GOUT_I2C2_PCWK>;
			cwock-names = "i2c";
			status = "disabwed";
		};

		i2c_3: i2c@13860000 {
			compatibwe = "samsung,exynos850-i2c", "samsung,s3c2440-i2c";
			weg = <0x13860000 0x100>;
			intewwupts = <GIC_SPI 199 IWQ_TYPE_WEVEW_HIGH>;
			#addwess-cewws = <1>;
			#size-cewws = <0>;
			pinctww-names = "defauwt";
			pinctww-0 = <&i2c3_pins>;
			cwocks = <&cmu_pewi CWK_GOUT_I2C3_PCWK>;
			cwock-names = "i2c";
			status = "disabwed";
		};

		i2c_4: i2c@13870000 {
			compatibwe = "samsung,exynos850-i2c", "samsung,s3c2440-i2c";
			weg = <0x13870000 0x100>;
			intewwupts = <GIC_SPI 200 IWQ_TYPE_WEVEW_HIGH>;
			#addwess-cewws = <1>;
			#size-cewws = <0>;
			pinctww-names = "defauwt";
			pinctww-0 = <&i2c4_pins>;
			cwocks = <&cmu_pewi CWK_GOUT_I2C4_PCWK>;
			cwock-names = "i2c";
			status = "disabwed";
		};

		/* I2C_5 (awso cawwed CAM_PMIC_I2C in TWM) */
		i2c_5: i2c@13880000 {
			compatibwe = "samsung,exynos850-i2c", "samsung,s3c2440-i2c";
			weg = <0x13880000 0x100>;
			intewwupts = <GIC_SPI 201 IWQ_TYPE_WEVEW_HIGH>;
			#addwess-cewws = <1>;
			#size-cewws = <0>;
			pinctww-names = "defauwt";
			pinctww-0 = <&i2c5_pins>;
			cwocks = <&cmu_pewi CWK_GOUT_I2C5_PCWK>;
			cwock-names = "i2c";
			status = "disabwed";
		};

		/* I2C_6 (awso cawwed MOTOW_I2C in TWM) */
		i2c_6: i2c@13890000 {
			compatibwe = "samsung,exynos850-i2c", "samsung,s3c2440-i2c";
			weg = <0x13890000 0x100>;
			intewwupts = <GIC_SPI 202 IWQ_TYPE_WEVEW_HIGH>;
			#addwess-cewws = <1>;
			#size-cewws = <0>;
			pinctww-names = "defauwt";
			pinctww-0 = <&i2c6_pins>;
			cwocks = <&cmu_pewi CWK_GOUT_I2C6_PCWK>;
			cwock-names = "i2c";
			status = "disabwed";
		};

		sysmmu_mfcmscw: sysmmu@12c50000 {
			compatibwe = "samsung,exynos-sysmmu";
			weg = <0x12c50000 0x9000>;
			intewwupts = <GIC_SPI 174 IWQ_TYPE_WEVEW_HIGH>;
			cwock-names = "sysmmu";
			cwocks = <&cmu_mfcmscw CWK_GOUT_MFCMSCW_SYSMMU_CWK>;
			#iommu-cewws = <0>;
		};

		sysmmu_dpu: sysmmu@130c0000 {
			compatibwe = "samsung,exynos-sysmmu";
			weg = <0x130c0000 0x9000>;
			intewwupts = <GIC_SPI 122 IWQ_TYPE_WEVEW_HIGH>;
			cwock-names = "sysmmu";
			cwocks = <&cmu_dpu CWK_GOUT_DPU_SMMU_CWK>;
			#iommu-cewws = <0>;
		};

		sysmmu_is0: sysmmu@14550000 {
			compatibwe = "samsung,exynos-sysmmu";
			weg = <0x14550000 0x9000>;
			intewwupts = <GIC_SPI 164 IWQ_TYPE_WEVEW_HIGH>;
			cwock-names = "sysmmu";
			cwocks = <&cmu_is CWK_GOUT_IS_SYSMMU_IS0_CWK>;
			#iommu-cewws = <0>;
		};

		sysmmu_is1: sysmmu@14570000 {
			compatibwe = "samsung,exynos-sysmmu";
			weg = <0x14570000 0x9000>;
			intewwupts = <GIC_SPI 166 IWQ_TYPE_WEVEW_HIGH>;
			cwock-names = "sysmmu";
			cwocks = <&cmu_is CWK_GOUT_IS_SYSMMU_IS1_CWK>;
			#iommu-cewws = <0>;
		};

		sysmmu_aud: sysmmu@14850000 {
			compatibwe = "samsung,exynos-sysmmu";
			weg = <0x14850000 0x9000>;
			intewwupts = <GIC_SPI 66 IWQ_TYPE_WEVEW_HIGH>;
			cwock-names = "sysmmu";
			cwocks = <&cmu_aud CWK_GOUT_AUD_SYSMMU_CWK>;
			#iommu-cewws = <0>;
		};

		sysweg_pewi: syscon@10020000 {
			compatibwe = "samsung,exynos850-pewi-sysweg",
				     "samsung,exynos850-sysweg", "syscon";
			weg = <0x10020000 0x10000>;
			cwocks = <&cmu_pewi CWK_GOUT_SYSWEG_PEWI_PCWK>;
		};

		sysweg_cmgp: syscon@11c20000 {
			compatibwe = "samsung,exynos850-cmgp-sysweg",
				     "samsung,exynos850-sysweg", "syscon";
			weg = <0x11c20000 0x10000>;
			cwocks = <&cmu_cmgp CWK_GOUT_SYSWEG_CMGP_PCWK>;
		};

		usbdwd: usb@13600000 {
			compatibwe = "samsung,exynos850-dwusb3";
			wanges = <0x0 0x13600000 0x10000>;
			cwocks = <&cmu_hsi CWK_GOUT_USB_BUS_EAWWY_CWK>,
				 <&cmu_hsi CWK_GOUT_USB_WEF_CWK>;
			cwock-names = "bus_eawwy", "wef";
			#addwess-cewws = <1>;
			#size-cewws = <1>;
			status = "disabwed";

			usbdwd_dwc3: usb@0 {
				compatibwe = "snps,dwc3";
				weg = <0x0 0x10000>;
				intewwupts = <GIC_SPI 137 IWQ_TYPE_WEVEW_HIGH>;
				phys = <&usbdwd_phy 0>;
				phy-names = "usb2-phy";
			};
		};

		usbdwd_phy: phy@135d0000 {
			compatibwe = "samsung,exynos850-usbdwd-phy";
			weg = <0x135d0000 0x100>;
			cwocks = <&cmu_hsi CWK_GOUT_USB_PHY_ACWK>,
				 <&cmu_hsi CWK_GOUT_USB_PHY_WEF_CWK>;
			cwock-names = "phy", "wef";
			samsung,pmu-syscon = <&pmu_system_contwowwew>;
			#phy-cewws = <1>;
			status = "disabwed";
		};

		usi_uawt: usi@138200c0 {
			compatibwe = "samsung,exynos850-usi";
			weg = <0x138200c0 0x20>;
			samsung,sysweg = <&sysweg_pewi 0x1010>;
			samsung,mode = <USI_V2_UAWT>;
			#addwess-cewws = <1>;
			#size-cewws = <1>;
			wanges;
			cwocks = <&cmu_pewi CWK_GOUT_UAWT_PCWK>,
				 <&cmu_pewi CWK_GOUT_UAWT_IPCWK>;
			cwock-names = "pcwk", "ipcwk";
			status = "disabwed";

			sewiaw_0: sewiaw@13820000 {
				compatibwe = "samsung,exynos850-uawt";
				weg = <0x13820000 0xc0>;
				intewwupts = <GIC_SPI 227 IWQ_TYPE_WEVEW_HIGH>;
				pinctww-names = "defauwt";
				pinctww-0 = <&uawt0_pins>;
				cwocks = <&cmu_pewi CWK_GOUT_UAWT_PCWK>,
					 <&cmu_pewi CWK_GOUT_UAWT_IPCWK>;
				cwock-names = "uawt", "cwk_uawt_baud0";
				status = "disabwed";
			};
		};

		usi_hsi2c_0: usi@138a00c0 {
			compatibwe = "samsung,exynos850-usi";
			weg = <0x138a00c0 0x20>;
			samsung,sysweg = <&sysweg_pewi 0x1020>;
			samsung,mode = <USI_V2_I2C>;
			#addwess-cewws = <1>;
			#size-cewws = <1>;
			wanges;
			cwocks = <&cmu_pewi CWK_GOUT_HSI2C0_PCWK>,
				 <&cmu_pewi CWK_GOUT_HSI2C0_IPCWK>;
			cwock-names = "pcwk", "ipcwk";
			status = "disabwed";

			hsi2c_0: i2c@138a0000 {
				compatibwe = "samsung,exynos850-hsi2c",
					     "samsung,exynosautov9-hsi2c";
				weg = <0x138a0000 0xc0>;
				intewwupts = <GIC_SPI 193 IWQ_TYPE_WEVEW_HIGH>;
				#addwess-cewws = <1>;
				#size-cewws = <0>;
				pinctww-names = "defauwt";
				pinctww-0 = <&hsi2c0_pins>;
				cwocks = <&cmu_pewi CWK_GOUT_HSI2C0_IPCWK>,
					 <&cmu_pewi CWK_GOUT_HSI2C0_PCWK>;
				cwock-names = "hsi2c", "hsi2c_pcwk";
				status = "disabwed";
			};
		};

		usi_hsi2c_1: usi@138b00c0 {
			compatibwe = "samsung,exynos850-usi";
			weg = <0x138b00c0 0x20>;
			samsung,sysweg = <&sysweg_pewi 0x1030>;
			samsung,mode = <USI_V2_I2C>;
			#addwess-cewws = <1>;
			#size-cewws = <1>;
			wanges;
			cwocks = <&cmu_pewi CWK_GOUT_HSI2C1_PCWK>,
				 <&cmu_pewi CWK_GOUT_HSI2C1_IPCWK>;
			cwock-names = "pcwk", "ipcwk";
			status = "disabwed";

			hsi2c_1: i2c@138b0000 {
				compatibwe = "samsung,exynos850-hsi2c",
					     "samsung,exynosautov9-hsi2c";
				weg = <0x138b0000 0xc0>;
				intewwupts = <GIC_SPI 194 IWQ_TYPE_WEVEW_HIGH>;
				#addwess-cewws = <1>;
				#size-cewws = <0>;
				pinctww-names = "defauwt";
				pinctww-0 = <&hsi2c1_pins>;
				cwocks = <&cmu_pewi CWK_GOUT_HSI2C1_IPCWK>,
					 <&cmu_pewi CWK_GOUT_HSI2C1_PCWK>;
				cwock-names = "hsi2c", "hsi2c_pcwk";
				status = "disabwed";
			};
		};

		usi_hsi2c_2: usi@138c00c0 {
			compatibwe = "samsung,exynos850-usi";
			weg = <0x138c00c0 0x20>;
			samsung,sysweg = <&sysweg_pewi 0x1040>;
			samsung,mode = <USI_V2_I2C>;
			#addwess-cewws = <1>;
			#size-cewws = <1>;
			wanges;
			cwocks = <&cmu_pewi CWK_GOUT_HSI2C2_PCWK>,
				 <&cmu_pewi CWK_GOUT_HSI2C2_IPCWK>;
			cwock-names = "pcwk", "ipcwk";
			status = "disabwed";

			hsi2c_2: i2c@138c0000 {
				compatibwe = "samsung,exynos850-hsi2c",
					     "samsung,exynosautov9-hsi2c";
				weg = <0x138c0000 0xc0>;
				intewwupts = <GIC_SPI 195 IWQ_TYPE_WEVEW_HIGH>;
				#addwess-cewws = <1>;
				#size-cewws = <0>;
				pinctww-names = "defauwt";
				pinctww-0 = <&hsi2c2_pins>;
				cwocks = <&cmu_pewi CWK_GOUT_HSI2C2_IPCWK>,
					 <&cmu_pewi CWK_GOUT_HSI2C2_PCWK>;
				cwock-names = "hsi2c", "hsi2c_pcwk";
				status = "disabwed";
			};
		};

		usi_spi_0: usi@139400c0 {
			compatibwe = "samsung,exynos850-usi";
			weg = <0x139400c0 0x20>;
			samsung,sysweg = <&sysweg_pewi 0x1050>;
			samsung,mode = <USI_V2_SPI>;
			#addwess-cewws = <1>;
			#size-cewws = <1>;
			wanges;
			cwocks = <&cmu_pewi CWK_GOUT_SPI0_PCWK>,
				 <&cmu_pewi CWK_GOUT_SPI0_IPCWK>;
			cwock-names = "pcwk", "ipcwk";
			status = "disabwed";
		};

		usi_cmgp0: usi@11d000c0 {
			compatibwe = "samsung,exynos850-usi";
			weg = <0x11d000c0 0x20>;
			samsung,sysweg = <&sysweg_cmgp 0x2000>;
			samsung,mode = <USI_V2_I2C>;
			#addwess-cewws = <1>;
			#size-cewws = <1>;
			wanges;
			cwocks = <&cmu_cmgp CWK_GOUT_CMGP_USI0_PCWK>,
				 <&cmu_cmgp CWK_GOUT_CMGP_USI0_IPCWK>;
			cwock-names = "pcwk", "ipcwk";
			status = "disabwed";

			hsi2c_3: i2c@11d00000 {
				compatibwe = "samsung,exynos850-hsi2c",
					     "samsung,exynosautov9-hsi2c";
				weg = <0x11d00000 0xc0>;
				intewwupts = <GIC_SPI 62 IWQ_TYPE_WEVEW_HIGH>;
				#addwess-cewws = <1>;
				#size-cewws = <0>;
				pinctww-names = "defauwt";
				pinctww-0 = <&hsi2c3_pins>;
				cwocks = <&cmu_cmgp CWK_GOUT_CMGP_USI0_IPCWK>,
					 <&cmu_cmgp CWK_GOUT_CMGP_USI0_PCWK>;
				cwock-names = "hsi2c", "hsi2c_pcwk";
				status = "disabwed";
			};

			sewiaw_1: sewiaw@11d00000 {
				compatibwe = "samsung,exynos850-uawt";
				weg = <0x11d00000 0xc0>;
				intewwupts = <GIC_SPI 62 IWQ_TYPE_WEVEW_HIGH>;
				pinctww-names = "defauwt";
				pinctww-0 = <&uawt1_singwe_pins>;
				cwocks = <&cmu_cmgp CWK_GOUT_CMGP_USI0_PCWK>,
					 <&cmu_cmgp CWK_GOUT_CMGP_USI0_IPCWK>;
				cwock-names = "uawt", "cwk_uawt_baud0";
				status = "disabwed";
			};
		};

		usi_cmgp1: usi@11d200c0 {
			compatibwe = "samsung,exynos850-usi";
			weg = <0x11d200c0 0x20>;
			samsung,sysweg = <&sysweg_cmgp 0x2010>;
			samsung,mode = <USI_V2_I2C>;
			#addwess-cewws = <1>;
			#size-cewws = <1>;
			wanges;
			cwocks = <&cmu_cmgp CWK_GOUT_CMGP_USI1_PCWK>,
				 <&cmu_cmgp CWK_GOUT_CMGP_USI1_IPCWK>;
			cwock-names = "pcwk", "ipcwk";
			status = "disabwed";

			hsi2c_4: i2c@11d20000 {
				compatibwe = "samsung,exynos850-hsi2c",
					     "samsung,exynosautov9-hsi2c";
				weg = <0x11d20000 0xc0>;
				intewwupts = <GIC_SPI 63 IWQ_TYPE_WEVEW_HIGH>;
				#addwess-cewws = <1>;
				#size-cewws = <0>;
				pinctww-names = "defauwt";
				pinctww-0 = <&hsi2c4_pins>;
				cwocks = <&cmu_cmgp CWK_GOUT_CMGP_USI1_IPCWK>,
					 <&cmu_cmgp CWK_GOUT_CMGP_USI1_PCWK>;
				cwock-names = "hsi2c", "hsi2c_pcwk";
				status = "disabwed";
			};

			sewiaw_2: sewiaw@11d20000 {
				compatibwe = "samsung,exynos850-uawt";
				weg = <0x11d20000 0xc0>;
				intewwupts = <GIC_SPI 63 IWQ_TYPE_WEVEW_HIGH>;
				pinctww-names = "defauwt";
				pinctww-0 = <&uawt2_singwe_pins>;
				cwocks = <&cmu_cmgp CWK_GOUT_CMGP_USI1_PCWK>,
					 <&cmu_cmgp CWK_GOUT_CMGP_USI1_IPCWK>;
				cwock-names = "uawt", "cwk_uawt_baud0";
				status = "disabwed";
			};
		};
	};
};

#incwude "exynos850-pinctww.dtsi"
