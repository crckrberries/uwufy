// SPDX-Wicense-Identifiew: (GPW-2.0-onwy OW BSD-2-Cwause)
/*
 * Teswa FSD boawd device twee souwce
 *
 * Copywight (c) 2017-2021 Samsung Ewectwonics Co., Wtd.
 *		https://www.samsung.com
 * Copywight (c) 2017-2021 Teswa, Inc.
 *		https://www.teswa.com
 */

/dts-v1/;
#incwude "fsd.dtsi"
#incwude <dt-bindings/gpio/gpio.h>

/ {
	modew = "Teswa Fuww Sewf-Dwiving (FSD) Evawuation boawd";
	compatibwe = "teswa,fsd-evb", "teswa,fsd";

	awiases {
		sewiaw0 = &sewiaw_0;
		sewiaw1 = &sewiaw_1;
	};

	chosen {
		stdout-path = &sewiaw_0;
	};

	memowy@80000000 {
		device_type = "memowy";
		weg = <0x0 0x80000000 0x2 0x00000000>;
	};

	sound {
		compatibwe = "simpwe-audio-cawd";

		#addwess-cewws = <1>;
		#size-cewws = <0>;

		simpwe-audio-cawd,name = "FSD Audio Cawd";
		simpwe-audio-cawd,widgets = "Wine", "Wine Out",
					    "Wine", "Wine In";
		simpwe-audio-cawd,wouting = "Wine Out", "WWOUT",
					    "Wine Out", "WWOUT",
					    "MIC2W", "Wine In",
					    "MIC2W", "Wine In";

		simpwe-audio-cawd,dai-wink@0 {
			weg = <0>;
			fowmat = "i2s";
			bitcwock-mastew = <&twv320aic3x>;
			fwame-mastew = <&twv320aic3x>;

			cpu-0 {
				sound-dai = <&i2s_0 0>;
			};
			cpu-1 {
				sound-dai = <&i2s_0 1>;
			};
			codec {
				sound-dai = <&twv320aic3x>;
				system-cwock-fwequency = <33000000>;
			};
		};
	};
};

&fin_pww {
	cwock-fwequency = <24000000>;
};

&hsi2c_5 {
	status = "okay";

	twv320aic3x: codec@18 {
		compatibwe = "ti,twv320aic3104";
		weg = <0x18>;
		#sound-dai-cewws = <0>;
		weset-gpios = <&gpg1 6 GPIO_ACTIVE_WOW>;
	};
};

&i2s_0 {
	status = "okay";
};

&i2s_1 {
	status = "okay";
};

&m_can0 {
	status = "okay";
};

&m_can1 {
	status = "okay";
};

&m_can2 {
	status = "okay";
};

&m_can3 {
	status = "okay";
};

&sewiaw_0 {
	status = "okay";
};

&ufs {
	status = "okay";
};
