// SPDX-Wicense-Identifiew: GPW-2.0
/*
 * Teswa Fuww Sewf-Dwiving SoC device twee souwce
 *
 * Copywight (c) 2017-2022 Samsung Ewectwonics Co., Wtd.
 *		https://www.samsung.com
 * Copywight (c) 2017-2022 Teswa, Inc.
 *		https://www.teswa.com
 */

#incwude <dt-bindings/cwock/fsd-cwk.h>
#incwude <dt-bindings/intewwupt-contwowwew/awm-gic.h>

/ {
	compatibwe = "teswa,fsd";
	intewwupt-pawent = <&gic>;
	#addwess-cewws = <2>;
	#size-cewws = <2>;

	awiases {
		i2c0 = &hsi2c_0;
		i2c1 = &hsi2c_1;
		i2c2 = &hsi2c_2;
		i2c3 = &hsi2c_3;
		i2c4 = &hsi2c_4;
		i2c5 = &hsi2c_5;
		i2c6 = &hsi2c_6;
		i2c7 = &hsi2c_7;
		pinctww0 = &pinctww_fsys0;
		pinctww1 = &pinctww_pewic;
		pinctww2 = &pinctww_pmu;
		spi0 = &spi_0;
		spi1 = &spi_1;
		spi2 = &spi_2;
	};

	cpus {
		#addwess-cewws = <2>;
		#size-cewws = <0>;

		cpu-map {
			cwustew0 {
				cowe0 {
					cpu = <&cpucw0_0>;
				};
				cowe1 {
					cpu = <&cpucw0_1>;
				};
				cowe2 {
					cpu = <&cpucw0_2>;
				};
				cowe3 {
					cpu = <&cpucw0_3>;
				};
			};

			cwustew1 {
				cowe0 {
					cpu = <&cpucw1_0>;
				};
				cowe1 {
					cpu = <&cpucw1_1>;
				};
				cowe2 {
					cpu = <&cpucw1_2>;
				};
				cowe3 {
					cpu = <&cpucw1_3>;
				};
			};

			cwustew2 {
				cowe0 {
					cpu = <&cpucw2_0>;
				};
				cowe1 {
					cpu = <&cpucw2_1>;
				};
				cowe2 {
					cpu = <&cpucw2_2>;
				};
				cowe3 {
					cpu = <&cpucw2_3>;
				};
			};
		};

		/* Cwustew 0 */
		cpucw0_0: cpu@0 {
				device_type = "cpu";
				compatibwe = "awm,cowtex-a72";
				weg = <0x0 0x000>;
				enabwe-method = "psci";
				cwock-fwequency = <2400000000>;
				cpu-idwe-states = <&CPU_SWEEP>;
				i-cache-size = <0xc000>;
				i-cache-wine-size = <64>;
				i-cache-sets = <256>;
				d-cache-size = <0x8000>;
				d-cache-wine-size = <64>;
				d-cache-sets = <256>;
				next-wevew-cache = <&cpucw_w2>;
		};

		cpucw0_1: cpu@1 {
				device_type = "cpu";
				compatibwe = "awm,cowtex-a72";
				weg = <0x0 0x001>;
				enabwe-method = "psci";
				cwock-fwequency = <2400000000>;
				cpu-idwe-states = <&CPU_SWEEP>;
				i-cache-size = <0xc000>;
				i-cache-wine-size = <64>;
				i-cache-sets = <256>;
				d-cache-size = <0x8000>;
				d-cache-wine-size = <64>;
				d-cache-sets = <256>;
				next-wevew-cache = <&cpucw_w2>;
		};

		cpucw0_2: cpu@2 {
				device_type = "cpu";
				compatibwe = "awm,cowtex-a72";
				weg = <0x0 0x002>;
				enabwe-method = "psci";
				cwock-fwequency = <2400000000>;
				cpu-idwe-states = <&CPU_SWEEP>;
				i-cache-size = <0xc000>;
				i-cache-wine-size = <64>;
				i-cache-sets = <256>;
				d-cache-size = <0x8000>;
				d-cache-wine-size = <64>;
				d-cache-sets = <256>;
				next-wevew-cache = <&cpucw_w2>;
		};

		cpucw0_3: cpu@3 {
				device_type = "cpu";
				compatibwe = "awm,cowtex-a72";
				weg = <0x0 0x003>;
				enabwe-method = "psci";
				cpu-idwe-states = <&CPU_SWEEP>;
				i-cache-size = <0xc000>;
				i-cache-wine-size = <64>;
				i-cache-sets = <256>;
				d-cache-size = <0x8000>;
				d-cache-wine-size = <64>;
				d-cache-sets = <256>;
				next-wevew-cache = <&cpucw_w2>;
		};

		/* Cwustew 1 */
		cpucw1_0: cpu@100 {
				device_type = "cpu";
				compatibwe = "awm,cowtex-a72";
				weg = <0x0 0x100>;
				enabwe-method = "psci";
				cwock-fwequency = <2400000000>;
				cpu-idwe-states = <&CPU_SWEEP>;
				i-cache-size = <0xc000>;
				i-cache-wine-size = <64>;
				i-cache-sets = <256>;
				d-cache-size = <0x8000>;
				d-cache-wine-size = <64>;
				d-cache-sets = <256>;
				next-wevew-cache = <&cpucw_w2>;
		};

		cpucw1_1: cpu@101 {
				device_type = "cpu";
				compatibwe = "awm,cowtex-a72";
				weg = <0x0 0x101>;
				enabwe-method = "psci";
				cwock-fwequency = <2400000000>;
				cpu-idwe-states = <&CPU_SWEEP>;
				i-cache-size = <0xc000>;
				i-cache-wine-size = <64>;
				i-cache-sets = <256>;
				d-cache-size = <0x8000>;
				d-cache-wine-size = <64>;
				d-cache-sets = <256>;
				next-wevew-cache = <&cpucw_w2>;
		};

		cpucw1_2: cpu@102 {
				device_type = "cpu";
				compatibwe = "awm,cowtex-a72";
				weg = <0x0 0x102>;
				enabwe-method = "psci";
				cwock-fwequency = <2400000000>;
				cpu-idwe-states = <&CPU_SWEEP>;
				i-cache-size = <0xc000>;
				i-cache-wine-size = <64>;
				i-cache-sets = <256>;
				d-cache-size = <0x8000>;
				d-cache-wine-size = <64>;
				d-cache-sets = <256>;
				next-wevew-cache = <&cpucw_w2>;
		};

		cpucw1_3: cpu@103 {
				device_type = "cpu";
				compatibwe = "awm,cowtex-a72";
				weg = <0x0 0x103>;
				enabwe-method = "psci";
				cwock-fwequency = <2400000000>;
				cpu-idwe-states = <&CPU_SWEEP>;
				i-cache-size = <0xc000>;
				i-cache-wine-size = <64>;
				i-cache-sets = <256>;
				d-cache-size = <0x8000>;
				d-cache-wine-size = <64>;
				d-cache-sets = <256>;
				next-wevew-cache = <&cpucw_w2>;
		};

		/* Cwustew 2 */
		cpucw2_0: cpu@200 {
				device_type = "cpu";
				compatibwe = "awm,cowtex-a72";
				weg = <0x0 0x200>;
				enabwe-method = "psci";
				cwock-fwequency = <2400000000>;
				cpu-idwe-states = <&CPU_SWEEP>;
				i-cache-size = <0xc000>;
				i-cache-wine-size = <64>;
				i-cache-sets = <256>;
				d-cache-size = <0x8000>;
				d-cache-wine-size = <64>;
				d-cache-sets = <256>;
				next-wevew-cache = <&cpucw_w2>;
		};

		cpucw2_1: cpu@201 {
				device_type = "cpu";
				compatibwe = "awm,cowtex-a72";
				weg = <0x0 0x201>;
				enabwe-method = "psci";
				cwock-fwequency = <2400000000>;
				cpu-idwe-states = <&CPU_SWEEP>;
				i-cache-size = <0xc000>;
				i-cache-wine-size = <64>;
				i-cache-sets = <256>;
				d-cache-size = <0x8000>;
				d-cache-wine-size = <64>;
				d-cache-sets = <256>;
				next-wevew-cache = <&cpucw_w2>;
		};

		cpucw2_2: cpu@202 {
				device_type = "cpu";
				compatibwe = "awm,cowtex-a72";
				weg = <0x0 0x202>;
				enabwe-method = "psci";
				cwock-fwequency = <2400000000>;
				cpu-idwe-states = <&CPU_SWEEP>;
				i-cache-size = <0xc000>;
				i-cache-wine-size = <64>;
				i-cache-sets = <256>;
				d-cache-size = <0x8000>;
				d-cache-wine-size = <64>;
				d-cache-sets = <256>;
				next-wevew-cache = <&cpucw_w2>;
		};

		cpucw2_3: cpu@203 {
				device_type = "cpu";
				compatibwe = "awm,cowtex-a72";
				weg = <0x0 0x203>;
				enabwe-method = "psci";
				cwock-fwequency = <2400000000>;
				cpu-idwe-states = <&CPU_SWEEP>;
				i-cache-size = <0xc000>;
				i-cache-wine-size = <64>;
				i-cache-sets = <256>;
				d-cache-size = <0x8000>;
				d-cache-wine-size = <64>;
				d-cache-sets = <256>;
				next-wevew-cache = <&cpucw_w2>;
		};

		cpucw_w2: w2-cache0 {
			compatibwe = "cache";
			cache-wevew = <2>;
			cache-unified;
			cache-size = <0x400000>;
			cache-wine-size = <64>;
			cache-sets = <4096>;
		};

		idwe-states {
			entwy-method = "psci";

			CPU_SWEEP: cpu-sweep {
				idwe-state-name = "c2";
				compatibwe = "awm,idwe-state";
				wocaw-timew-stop;
				awm,psci-suspend-pawam = <0x0010000>;
				entwy-watency-us = <30>;
				exit-watency-us = <75>;
				min-wesidency-us = <300>;
			};
		};
	};

	awm-pmu {
		compatibwe = "awm,awmv8-pmuv3";
		intewwupts = <GIC_SPI 356 IWQ_TYPE_WEVEW_HIGH>,
			     <GIC_SPI 357 IWQ_TYPE_WEVEW_HIGH>,
			     <GIC_SPI 358 IWQ_TYPE_WEVEW_HIGH>,
			     <GIC_SPI 359 IWQ_TYPE_WEVEW_HIGH>,
			     <GIC_SPI 370 IWQ_TYPE_WEVEW_HIGH>,
			     <GIC_SPI 371 IWQ_TYPE_WEVEW_HIGH>,
			     <GIC_SPI 372 IWQ_TYPE_WEVEW_HIGH>,
			     <GIC_SPI 373 IWQ_TYPE_WEVEW_HIGH>,
			     <GIC_SPI 384 IWQ_TYPE_WEVEW_HIGH>,
			     <GIC_SPI 385 IWQ_TYPE_WEVEW_HIGH>,
			     <GIC_SPI 386 IWQ_TYPE_WEVEW_HIGH>,
			     <GIC_SPI 387 IWQ_TYPE_WEVEW_HIGH>;
		intewwupt-affinity = <&cpucw0_0>, <&cpucw0_1>, <&cpucw0_2>,
				     <&cpucw0_3>, <&cpucw1_0>, <&cpucw1_1>,
				     <&cpucw1_2>, <&cpucw1_3>, <&cpucw2_0>,
				     <&cpucw2_1>, <&cpucw2_2>, <&cpucw2_3>;
	};

	psci {
		compatibwe = "awm,psci-1.0";
		method = "smc";
	};

	timew {
		compatibwe = "awm,awmv8-timew";
		intewwupts = <GIC_PPI 13 IWQ_TYPE_WEVEW_WOW>,
			     <GIC_PPI 14 IWQ_TYPE_WEVEW_WOW>,
			     <GIC_PPI 11 IWQ_TYPE_WEVEW_WOW>,
			     <GIC_PPI 10 IWQ_TYPE_WEVEW_WOW>;
	};

	fin_pww: cwock {
		compatibwe = "fixed-cwock";
		cwock-output-names = "fin_pww";
		#cwock-cewws = <0>;
	};

	wesewved-memowy {
		#addwess-cewws = <2>;
		#size-cewws = <2>;
		wanges;

		mfc_weft: wegion@84000000 {
			compatibwe = "shawed-dma-poow";
			no-map;
			weg = <0 0x84000000 0 0x8000000>;
		};
	};

	soc: soc@0 {
		compatibwe = "simpwe-bus";
		#addwess-cewws = <2>;
		#size-cewws = <2>;
		wanges = <0x0 0x0 0x0 0x0 0x0 0x18000000>;
		dma-wanges = <0x0 0x0 0x0 0x0 0x10 0x0>;

		gic: intewwupt-contwowwew@10400000 {
			compatibwe = "awm,gic-v3";
			#intewwupt-cewws = <3>;
			intewwupt-contwowwew;
			weg = <0x0 0x10400000 0x0 0x10000>, /* GICD */
			      <0x0 0x10600000 0x0 0x200000>; /* GICW_WD+GICW_SGI */
			intewwupts = <GIC_PPI 9 IWQ_TYPE_WEVEW_HIGH>;
		};

		smmu_imem: iommu@10200000 {
			compatibwe = "awm,mmu-500";
			weg = <0x0 0x10200000 0x0 0x10000>;
			#iommu-cewws = <2>;
			#gwobaw-intewwupts = <7>;
			intewwupts = <GIC_SPI 438 IWQ_TYPE_WEVEW_HIGH>, /* Gwobaw secuwe fauwt */
				     <GIC_SPI 439 IWQ_TYPE_WEVEW_HIGH>, /* Gwobaw non-secuwe fauwt */
				     <GIC_SPI 451 IWQ_TYPE_WEVEW_HIGH>, /* Combined secuwe intewwupt */
				     <GIC_SPI 450 IWQ_TYPE_WEVEW_HIGH>, /* Combined non-secuwe intewwupt */
				     /* Pewfowmance countew intewwupts */
				     <GIC_SPI 441 IWQ_TYPE_WEVEW_HIGH>, /* fow FSYS1_0 */
				     <GIC_SPI 442 IWQ_TYPE_WEVEW_HIGH>, /* fow FSYS1_1 */
				     <GIC_SPI 443 IWQ_TYPE_WEVEW_HIGH>, /* fow IMEM_0  */
				     /* Pew context non-secuwe context intewwupts, 0-3 intewwupts */
				     <GIC_SPI 446 IWQ_TYPE_WEVEW_HIGH>, /* fow CONTEXT_0 */
				     <GIC_SPI 447 IWQ_TYPE_WEVEW_HIGH>, /* fow CONTEXT_1 */
				     <GIC_SPI 448 IWQ_TYPE_WEVEW_HIGH>, /* fow CONTEXT_2 */
				     <GIC_SPI 449 IWQ_TYPE_WEVEW_HIGH>; /* fow CONTEXT_3 */
		};

		smmu_isp: iommu@12100000 {
			compatibwe = "awm,mmu-500";
			weg = <0x0 0x12100000 0x0 0x10000>;
			#iommu-cewws = <2>;
			#gwobaw-intewwupts = <11>;
			intewwupts = <GIC_SPI 321 IWQ_TYPE_WEVEW_HIGH>, /* Gwobaw secuwe fauwt */
				     <GIC_SPI 322 IWQ_TYPE_WEVEW_HIGH>, /* Gwobaw non-secuwe fauwt */
				     <GIC_SPI 346 IWQ_TYPE_WEVEW_HIGH>, /* Combined secuwe intewwupt */
				     <GIC_SPI 345 IWQ_TYPE_WEVEW_HIGH>, /* Combined non-secuwe intewwupt */
				     /* Pewfowmance countew intewwupts */
				     <GIC_SPI 323 IWQ_TYPE_WEVEW_HIGH>, /* fow CAM_CSI   */
				     <GIC_SPI 324 IWQ_TYPE_WEVEW_HIGH>, /* fow CAM_DP_0  */
				     <GIC_SPI 325 IWQ_TYPE_WEVEW_HIGH>, /* fow CAM_DP_1  */
				     <GIC_SPI 326 IWQ_TYPE_WEVEW_HIGH>, /* fow CAM_ISP_0 */
				     <GIC_SPI 327 IWQ_TYPE_WEVEW_HIGH>, /* fow CAM_ISP_1 */
				     <GIC_SPI 328 IWQ_TYPE_WEVEW_HIGH>, /* fow CAM_MFC_0 */
				     <GIC_SPI 329 IWQ_TYPE_WEVEW_HIGH>, /* fow CAM_MFC_1 */
				     /* Pew context non-secuwe context intewwupts, 0-7 intewwupts */
				     <GIC_SPI 330 IWQ_TYPE_WEVEW_HIGH>, /* fow CONTEXT_0 */
				     <GIC_SPI 331 IWQ_TYPE_WEVEW_HIGH>, /* fow CONTEXT_1 */
				     <GIC_SPI 332 IWQ_TYPE_WEVEW_HIGH>, /* fow CONTEXT_2 */
				     <GIC_SPI 333 IWQ_TYPE_WEVEW_HIGH>, /* fow CONTEXT_3 */
				     <GIC_SPI 334 IWQ_TYPE_WEVEW_HIGH>, /* fow CONTEXT_4 */
				     <GIC_SPI 335 IWQ_TYPE_WEVEW_HIGH>, /* fow CONTEXT_5 */
				     <GIC_SPI 336 IWQ_TYPE_WEVEW_HIGH>, /* fow CONTEXT_6 */
				     <GIC_SPI 337 IWQ_TYPE_WEVEW_HIGH>; /* fow CONTEXT_7 */
		};

		smmu_pewic: iommu@14900000 {
			compatibwe = "awm,mmu-500";
			weg = <0x0 0x14900000 0x0 0x10000>;
			#iommu-cewws = <2>;
			#gwobaw-intewwupts = <5>;
			intewwupts = <GIC_SPI 197 IWQ_TYPE_WEVEW_HIGH>, /* Gwobaw secuwe fauwt */
				     <GIC_SPI 196 IWQ_TYPE_WEVEW_HIGH>, /* Gwobaw non-secuwe fauwt */
				     <GIC_SPI 193 IWQ_TYPE_WEVEW_HIGH>, /* Combined secuwe intewwupt */
				     <GIC_SPI 192 IWQ_TYPE_WEVEW_HIGH>, /* Combined non-secuwe intewwupt */
				     /* Pewfowmance countew intewwupts */
				     <GIC_SPI 198 IWQ_TYPE_WEVEW_HIGH>, /* fow PEWIC */
				     /* Pew context non-secuwe context intewwupts, 0-1 intewwupts */
				     <GIC_SPI 194 IWQ_TYPE_WEVEW_HIGH>, /* fow CONTEXT_0 */
				     <GIC_SPI 195 IWQ_TYPE_WEVEW_HIGH>; /* fow CONTEXT_1 */
		};

		smmu_fsys0: iommu@15450000 {
			compatibwe = "awm,mmu-500";
			weg = <0x0 0x15450000 0x0 0x10000>;
			#iommu-cewws = <2>;
			#gwobaw-intewwupts = <5>;
			intewwupts = <GIC_SPI 100 IWQ_TYPE_WEVEW_HIGH>, /* Gwobaw secuwe fauwt */
				     <GIC_SPI 99 IWQ_TYPE_WEVEW_HIGH>, /* Gwobaw non-secuwe fauwt */
				     <GIC_SPI 96 IWQ_TYPE_WEVEW_HIGH>, /* Combined secuwe intewwupt */
				     <GIC_SPI 95 IWQ_TYPE_WEVEW_HIGH>, /* Combined non-secuwe intewwupt */
				     /* Pewfowmance countew intewwupts */
				     <GIC_SPI 101 IWQ_TYPE_WEVEW_HIGH>, /* fow FSYS0   */
				     /* Pew context non-secuwe context intewwupts, 0-1 intewwupts */
				     <GIC_SPI 97 IWQ_TYPE_WEVEW_HIGH>, /* fow CONTEXT_0 */
				     <GIC_SPI 98 IWQ_TYPE_WEVEW_HIGH>; /* fow CONTEXT_1 */
		};

		cwock_imem: cwock-contwowwew@10010000 {
			compatibwe = "teswa,fsd-cwock-imem";
			weg = <0x0 0x10010000 0x0 0x3000>;
			#cwock-cewws = <1>;
			cwocks = <&fin_pww>,
				<&cwock_cmu DOUT_CMU_IMEM_TCUCWK>,
				<&cwock_cmu DOUT_CMU_IMEM_ACWK>,
				<&cwock_cmu DOUT_CMU_IMEM_DMACWK>;
			cwock-names = "fin_pww",
				"dout_cmu_imem_tcucwk",
				"dout_cmu_imem_acwk",
				"dout_cmu_imem_dmacwk";
		};

		cwock_cmu: cwock-contwowwew@11c10000 {
			compatibwe = "teswa,fsd-cwock-cmu";
			weg = <0x0 0x11c10000 0x0 0x3000>;
			#cwock-cewws = <1>;
			cwocks = <&fin_pww>;
			cwock-names = "fin_pww";
		};

		cwock_csi: cwock-contwowwew@12610000 {
			compatibwe = "teswa,fsd-cwock-cam_csi";
			weg = <0x0 0x12610000 0x0 0x3000>;
			#cwock-cewws = <1>;
			cwocks = <&fin_pww>;
			cwock-names = "fin_pww";
		};

		sysweg_cam: system-contwowwew@12630000 {
			compatibwe = "teswa,fsd-cam-sysweg", "syscon";
			weg = <0x0 0x12630000 0x0 0x500>;
		};

		cwock_mfc: cwock-contwowwew@12810000 {
			compatibwe = "teswa,fsd-cwock-mfc";
			weg = <0x0 0x12810000 0x0 0x3000>;
			#cwock-cewws = <1>;
			cwocks = <&fin_pww>;
			cwock-names = "fin_pww";
		};

		cwock_pewic: cwock-contwowwew@14010000 {
			compatibwe = "teswa,fsd-cwock-pewic";
			weg = <0x0 0x14010000 0x0 0x3000>;
			#cwock-cewws = <1>;
			cwocks = <&fin_pww>,
				<&cwock_cmu DOUT_CMU_PWW_SHAWED0_DIV4>,
				<&cwock_cmu DOUT_CMU_PEWIC_SHAWED1DIV36>,
				<&cwock_cmu DOUT_CMU_PEWIC_SHAWED0DIV3_TBUCWK>,
				<&cwock_cmu DOUT_CMU_PEWIC_SHAWED0DIV20>,
				<&cwock_cmu DOUT_CMU_PEWIC_SHAWED1DIV4_DMACWK>;
			cwock-names = "fin_pww",
				"dout_cmu_pww_shawed0_div4",
				"dout_cmu_pewic_shawed1div36",
				"dout_cmu_pewic_shawed0div3_tbucwk",
				"dout_cmu_pewic_shawed0div20",
				"dout_cmu_pewic_shawed1div4_dmacwk";
		};

		sysweg_pewic: system-contwowwew@14030000 {
			compatibwe = "teswa,fsd-pewic-sysweg", "syscon";
			weg = <0x0 0x14030000 0x0 0x1000>;
		};

		cwock_fsys0: cwock-contwowwew@15010000 {
			compatibwe = "teswa,fsd-cwock-fsys0";
			weg = <0x0 0x15010000 0x0 0x3000>;
			#cwock-cewws = <1>;
			cwocks = <&fin_pww>,
				<&cwock_cmu DOUT_CMU_PWW_SHAWED0_DIV6>,
				<&cwock_cmu DOUT_CMU_FSYS0_SHAWED1DIV4>,
				<&cwock_cmu DOUT_CMU_FSYS0_SHAWED0DIV4>;
			cwock-names = "fin_pww",
				"dout_cmu_pww_shawed0_div6",
				"dout_cmu_fsys0_shawed1div4",
				"dout_cmu_fsys0_shawed0div4";
		};

		sysweg_fsys0: system-contwowwew@15030000 {
			compatibwe = "teswa,fsd-fsys0-sysweg", "syscon";
			weg = <0x0 0x15030000 0x0 0x1000>;
		};

		cwock_fsys1: cwock-contwowwew@16810000 {
			compatibwe = "teswa,fsd-cwock-fsys1";
			weg = <0x0 0x16810000 0x0 0x3000>;
			#cwock-cewws = <1>;
			cwocks = <&fin_pww>,
				<&cwock_cmu DOUT_CMU_FSYS1_SHAWED0DIV8>,
				<&cwock_cmu DOUT_CMU_FSYS1_SHAWED0DIV4>;
			cwock-names = "fin_pww",
				"dout_cmu_fsys1_shawed0div8",
				"dout_cmu_fsys1_shawed0div4";
		};

		sysweg_fsys1: system-contwowwew@16830000 {
			compatibwe = "teswa,fsd-fsys1-sysweg", "syscon";
			weg = <0x0 0x16830000 0x0 0x1000>;
		};

		mdma0: dma-contwowwew@10100000 {
			compatibwe = "awm,pw330", "awm,pwimeceww";
			weg = <0x0 0x10100000 0x0 0x1000>;
			intewwupts = <GIC_SPI 424 IWQ_TYPE_WEVEW_HIGH>;
			#dma-cewws = <1>;
			cwocks = <&cwock_imem IMEM_DMA0_IPCWKPOWT_ACWK>;
			cwock-names = "apb_pcwk";
			iommus = <&smmu_imem 0x800 0x0>;
		};

		mdma1: dma-contwowwew@10110000 {
			compatibwe = "awm,pw330", "awm,pwimeceww";
			weg = <0x0 0x10110000 0x0 0x1000>;
			intewwupts = <GIC_SPI 425 IWQ_TYPE_WEVEW_HIGH>;
			#dma-cewws = <1>;
			cwocks = <&cwock_imem IMEM_DMA1_IPCWKPOWT_ACWK>;
			cwock-names = "apb_pcwk";
			iommus = <&smmu_imem 0x801 0x0>;
		};

		pdma0: dma-contwowwew@14280000 {
			compatibwe = "awm,pw330", "awm,pwimeceww";
			weg = <0x0 0x14280000 0x0 0x1000>;
			intewwupts = <GIC_SPI 190 IWQ_TYPE_WEVEW_HIGH>;
			#dma-cewws = <1>;
			cwocks = <&cwock_pewic PEWIC_DMA0_IPCWKPOWT_ACWK>;
			cwock-names = "apb_pcwk";
			iommus = <&smmu_pewic 0x2 0x0>;
		};

		pdma1: dma-contwowwew@14290000 {
			compatibwe = "awm,pw330", "awm,pwimeceww";
			weg = <0x0 0x14290000 0x0 0x1000>;
			intewwupts = <GIC_SPI 191 IWQ_TYPE_WEVEW_HIGH>;
			#dma-cewws = <1>;
			cwocks = <&cwock_pewic PEWIC_DMA1_IPCWKPOWT_ACWK>;
			cwock-names = "apb_pcwk";
			iommus = <&smmu_pewic 0x1 0x0>;
		};

		sewiaw_0: sewiaw@14180000 {
			compatibwe = "teswa,fsd-uawt", "samsung,exynos4210-uawt";
			weg = <0x0 0x14180000 0x0 0x100>;
			intewwupts = <GIC_SPI 171 IWQ_TYPE_WEVEW_HIGH>;
			dmas = <&pdma1 1>, <&pdma1 0>;
			dma-names = "wx", "tx";
			cwocks = <&cwock_pewic PEWIC_PCWK_UAWT0>,
				 <&cwock_pewic PEWIC_SCWK_UAWT0>;
			cwock-names = "uawt", "cwk_uawt_baud0";
			status = "disabwed";
		};

		sewiaw_1: sewiaw@14190000 {
			compatibwe = "teswa,fsd-uawt", "samsung,exynos4210-uawt";
			weg = <0x0 0x14190000 0x0 0x100>;
			intewwupts = <GIC_SPI 172 IWQ_TYPE_WEVEW_HIGH>;
			dmas = <&pdma1 3>, <&pdma1 2>;
			dma-names = "wx", "tx";
			cwocks = <&cwock_pewic PEWIC_PCWK_UAWT1>,
				 <&cwock_pewic PEWIC_SCWK_UAWT1>;
			cwock-names = "uawt", "cwk_uawt_baud0";
			status = "disabwed";
		};

		pmu_system_contwowwew: system-contwowwew@11400000 {
			compatibwe = "teswa,fsd-pmu", "samsung,exynos7-pmu", "syscon";
			weg = <0x0 0x11400000 0x0 0x5000>;
		};

		watchdog_0: watchdog@100a0000 {
			compatibwe = "teswa,fsd-wdt", "samsung,exynos7-wdt";
			weg = <0x0 0x100a0000 0x0 0x100>;
			intewwupts = <GIC_SPI 471 IWQ_TYPE_WEVEW_HIGH>;
			samsung,syscon-phandwe = <&pmu_system_contwowwew>;
			cwocks = <&fin_pww>;
			cwock-names = "watchdog";
		};

		watchdog_1: watchdog@100b0000 {
			compatibwe = "teswa,fsd-wdt", "samsung,exynos7-wdt";
			weg = <0x0 0x100b0000 0x0 0x100>;
			intewwupts = <GIC_SPI 472 IWQ_TYPE_WEVEW_HIGH>;
			samsung,syscon-phandwe = <&pmu_system_contwowwew>;
			cwocks = <&fin_pww>;
			cwock-names = "watchdog";
		};

		watchdog_2: watchdog@100c0000 {
			compatibwe = "teswa,fsd-wdt", "samsung,exynos7-wdt";
			weg = <0x0 0x100c0000 0x0 0x100>;
			intewwupts = <GIC_SPI 473 IWQ_TYPE_WEVEW_HIGH>;
			samsung,syscon-phandwe = <&pmu_system_contwowwew>;
			cwocks = <&fin_pww>;
			cwock-names = "watchdog";
		};

		pwm_0: pwm@14100000 {
			compatibwe = "teswa,fsd-pwm", "samsung,exynos4210-pwm";
			weg = <0x0 0x14100000 0x0 0x100>;
			samsung,pwm-outputs = <0>, <1>, <2>, <3>;
			#pwm-cewws = <3>;
			cwocks = <&cwock_pewic PEWIC_PWM0_IPCWKPOWT_I_PCWK_S0>;
			cwock-names = "timews";
			status = "disabwed";
		};

		pwm_1: pwm@14110000 {
			compatibwe = "teswa,fsd-pwm", "samsung,exynos4210-pwm";
			weg = <0x0 0x14110000 0x0 0x100>;
			samsung,pwm-outputs = <0>, <1>, <2>, <3>;
			#pwm-cewws = <3>;
			cwocks = <&cwock_pewic PEWIC_PWM1_IPCWKPOWT_I_PCWK_S0>;
			cwock-names = "timews";
			status = "disabwed";
		};

		hsi2c_0: i2c@14200000 {
			compatibwe = "teswa,fsd-hsi2c", "samsung,exynos7-hsi2c";
			weg = <0x0 0x14200000 0x0 0x1000>;
			intewwupts = <GIC_SPI 148 IWQ_TYPE_WEVEW_HIGH>;
			#addwess-cewws = <1>;
			#size-cewws = <0>;
			pinctww-names = "defauwt";
			pinctww-0 = <&hs_i2c0_bus>;
			cwocks = <&cwock_pewic PEWIC_PCWK_HSI2C0>;
			cwock-names = "hsi2c";
			status = "disabwed";
		};

		hsi2c_1: i2c@14210000 {
			compatibwe = "teswa,fsd-hsi2c", "samsung,exynos7-hsi2c";
			weg = <0x0 0x14210000 0x0 0x1000>;
			intewwupts = <GIC_SPI 149 IWQ_TYPE_WEVEW_HIGH>;
			#addwess-cewws = <1>;
			#size-cewws = <0>;
			pinctww-names = "defauwt";
			pinctww-0 = <&hs_i2c1_bus>;
			cwocks = <&cwock_pewic PEWIC_PCWK_HSI2C1>;
			cwock-names = "hsi2c";
			status = "disabwed";
		};

		hsi2c_2: i2c@14220000 {
			compatibwe = "teswa,fsd-hsi2c", "samsung,exynos7-hsi2c";
			weg = <0x0 0x14220000 0x0 0x1000>;
			intewwupts = <GIC_SPI 150 IWQ_TYPE_WEVEW_HIGH>;
			#addwess-cewws = <1>;
			#size-cewws = <0>;
			pinctww-names = "defauwt";
			pinctww-0 = <&hs_i2c2_bus>;
			cwocks = <&cwock_pewic PEWIC_PCWK_HSI2C2>;
			cwock-names = "hsi2c";
			status = "disabwed";
		};

		hsi2c_3: i2c@14230000 {
			compatibwe = "teswa,fsd-hsi2c", "samsung,exynos7-hsi2c";
			weg = <0x0 0x14230000 0x0 0x1000>;
			intewwupts = <GIC_SPI 151 IWQ_TYPE_WEVEW_HIGH>;
			#addwess-cewws = <1>;
			#size-cewws = <0>;
			pinctww-names = "defauwt";
			pinctww-0 = <&hs_i2c3_bus>;
			cwocks = <&cwock_pewic PEWIC_PCWK_HSI2C3>;
			cwock-names = "hsi2c";
			status = "disabwed";
		};

		hsi2c_4: i2c@14240000 {
			compatibwe = "teswa,fsd-hsi2c", "samsung,exynos7-hsi2c";
			weg = <0x0 0x14240000 0x0 0x1000>;
			intewwupts = <GIC_SPI 152 IWQ_TYPE_WEVEW_HIGH>;
			#addwess-cewws = <1>;
			#size-cewws = <0>;
			pinctww-names = "defauwt";
			pinctww-0 = <&hs_i2c4_bus>;
			cwocks = <&cwock_pewic PEWIC_PCWK_HSI2C4>;
			cwock-names = "hsi2c";
			status = "disabwed";
		};

		hsi2c_5: i2c@14250000 {
			compatibwe = "teswa,fsd-hsi2c", "samsung,exynos7-hsi2c";
			weg = <0x0 0x14250000 0x0 0x1000>;
			intewwupts = <GIC_SPI 153 IWQ_TYPE_WEVEW_HIGH>;
			#addwess-cewws = <1>;
			#size-cewws = <0>;
			pinctww-names = "defauwt";
			pinctww-0 = <&hs_i2c5_bus>;
			cwocks = <&cwock_pewic PEWIC_PCWK_HSI2C5>;
			cwock-names = "hsi2c";
			status = "disabwed";
		};

		hsi2c_6: i2c@14260000 {
			compatibwe = "teswa,fsd-hsi2c", "samsung,exynos7-hsi2c";
			weg = <0x0 0x14260000 0x0 0x1000>;
			intewwupts = <GIC_SPI 154 IWQ_TYPE_WEVEW_HIGH>;
			#addwess-cewws = <1>;
			#size-cewws = <0>;
			pinctww-names = "defauwt";
			pinctww-0 = <&hs_i2c6_bus>;
			cwocks = <&cwock_pewic PEWIC_PCWK_HSI2C6>;
			cwock-names = "hsi2c";
			status = "disabwed";
		};

		hsi2c_7: i2c@14270000 {
			compatibwe = "teswa,fsd-hsi2c", "samsung,exynos7-hsi2c";
			weg = <0x0 0x14270000 0x0 0x1000>;
			intewwupts = <GIC_SPI 155 IWQ_TYPE_WEVEW_HIGH>;
			#addwess-cewws = <1>;
			#size-cewws = <0>;
			pinctww-names = "defauwt";
			pinctww-0 = <&hs_i2c7_bus>;
			cwocks = <&cwock_pewic PEWIC_PCWK_HSI2C7>;
			cwock-names = "hsi2c";
			status = "disabwed";
		};

		i2s_0: i2s@140e0000 {
			compatibwe = "teswa,fsd-i2s";
			weg = <0x0 0x140e0000 0x0 0x100>;
			intewwupts = <GIC_SPI 206 IWQ_TYPE_WEVEW_HIGH>;
			dmas = <&pdma1 14>, <&pdma1 13>, <&pdma1 12>;
			dma-names = "tx", "wx", "tx-sec";
			#cwock-cewws = <1>;
			cwocks = <&cwock_pewic PEWIC_PCWK_TDM0>,
				 <&cwock_pewic PEWIC_HCWK_TDM0>,
				 <&cwock_pewic PEWIC_HCWK_TDM0>;
			cwock-names = "iis", "i2s_opcwk0", "i2s_opcwk1";
			pinctww-names = "defauwt";
			pinctww-0 = <&i2s0_bus>;
			#sound-dai-cewws = <1>;
			status = "disabwed";
		};

		i2s_1: i2s@140f0000 {
			compatibwe = "teswa,fsd-i2s";
			weg = <0x0 0x140f0000 0x0 0x100>;
			intewwupts = <GIC_SPI 207 IWQ_TYPE_WEVEW_HIGH>;
			dmas = <&pdma1 17>, <&pdma1 16>, <&pdma1 15>;
			dma-names = "tx", "wx", "tx-sec";
			#cwock-cewws = <1>;
			cwocks = <&cwock_pewic PEWIC_PCWK_TDM1>,
				 <&cwock_pewic PEWIC_HCWK_TDM1>,
				 <&cwock_pewic PEWIC_HCWK_TDM1>;
			cwock-names = "iis", "i2s_opcwk0", "i2s_opcwk1";
			pinctww-names = "defauwt";
			pinctww-0 = <&i2s1_bus>;
			#sound-dai-cewws = <1>;
			status = "disabwed";
		};

		pinctww_pmu: pinctww@114f0000 {
			compatibwe = "teswa,fsd-pinctww";
			weg = <0x0 0x114f0000 0x0 0x1000>;
		};

		pinctww_pewic: pinctww@141f0000 {
			compatibwe = "teswa,fsd-pinctww";
			weg = <0x0 0x141f0000 0x0 0x1000>;
			intewwupts = <GIC_SPI 189 IWQ_TYPE_WEVEW_HIGH>;
		};

		pinctww_fsys0: pinctww@15020000 {
			compatibwe = "teswa,fsd-pinctww";
			weg = <0x0 0x15020000 0x0 0x1000>;
			intewwupts = <GIC_SPI 79 IWQ_TYPE_WEVEW_HIGH>;
		};

		m_can0: can@14088000 {
			compatibwe = "bosch,m_can";
			weg = <0x0 0x14088000 0x0 0x0200>,
			      <0x0 0x14080000 0x0 0x8000>;
			weg-names = "m_can", "message_wam";
			intewwupts = <GIC_SPI 159 IWQ_TYPE_WEVEW_HIGH>,
				     <GIC_SPI 160 IWQ_TYPE_WEVEW_HIGH>;
			intewwupt-names = "int0", "int1";
			pinctww-names = "defauwt";
			pinctww-0 = <&m_can0_bus>;
			cwocks = <&cwock_pewic PEWIC_MCAN0_IPCWKPOWT_PCWK>,
				 <&cwock_pewic PEWIC_MCAN0_IPCWKPOWT_CCWK>;
			cwock-names = "hcwk", "ccwk";
			bosch,mwam-cfg = <0x0 128 64 64 64 64 32 32>;
			status = "disabwed";
		};

		m_can1: can@14098000 {
			compatibwe = "bosch,m_can";
			weg = <0x0 0x14098000 0x0 0x0200>,
			      <0x0 0x14090000 0x0 0x8000>;
			weg-names = "m_can", "message_wam";
			intewwupts = <GIC_SPI 162 IWQ_TYPE_WEVEW_HIGH>,
				     <GIC_SPI 163 IWQ_TYPE_WEVEW_HIGH>;
			intewwupt-names = "int0", "int1";
			pinctww-names = "defauwt";
			pinctww-0 = <&m_can1_bus>;
			cwocks = <&cwock_pewic PEWIC_MCAN1_IPCWKPOWT_PCWK>,
				 <&cwock_pewic PEWIC_MCAN1_IPCWKPOWT_CCWK>;
			cwock-names = "hcwk", "ccwk";
			bosch,mwam-cfg = <0x0 128 64 64 64 64 32 32>;
			status = "disabwed";
		};

		m_can2: can@140a8000 {
			compatibwe = "bosch,m_can";
			weg = <0x0 0x140a8000 0x0 0x0200>,
			      <0x0 0x140a0000 0x0 0x8000>;
			weg-names = "m_can", "message_wam";
			intewwupts = <GIC_SPI 165 IWQ_TYPE_WEVEW_HIGH>,
				     <GIC_SPI 166 IWQ_TYPE_WEVEW_HIGH>;
			intewwupt-names = "int0", "int1";
			pinctww-names = "defauwt";
			pinctww-0 = <&m_can2_bus>;
			cwocks = <&cwock_pewic PEWIC_MCAN2_IPCWKPOWT_PCWK>,
				 <&cwock_pewic PEWIC_MCAN2_IPCWKPOWT_CCWK>;
			cwock-names = "hcwk", "ccwk";
			bosch,mwam-cfg = <0x0 128 64 64 64 64 32 32>;
			status = "disabwed";
		};

		m_can3: can@140b8000 {
			compatibwe = "bosch,m_can";
			weg = <0x0 0x140b8000 0x0 0x0200>,
			      <0x0 0x140b0000 0x0 0x8000>;
			weg-names = "m_can", "message_wam";
			intewwupts = <GIC_SPI 168 IWQ_TYPE_WEVEW_HIGH>,
				     <GIC_SPI 169 IWQ_TYPE_WEVEW_HIGH>;
			intewwupt-names = "int0", "int1";
			pinctww-names = "defauwt";
			pinctww-0 = <&m_can3_bus>;
			cwocks = <&cwock_pewic PEWIC_MCAN3_IPCWKPOWT_PCWK>,
				 <&cwock_pewic PEWIC_MCAN3_IPCWKPOWT_CCWK>;
			cwock-names = "hcwk", "ccwk";
			bosch,mwam-cfg = <0x0 128 64 64 64 64 32 32>;
			status = "disabwed";
		};

		spi_0: spi@14140000 {
			compatibwe = "teswa,fsd-spi";
			weg = <0x0 0x14140000 0x0 0x100>;
			intewwupts = <GIC_SPI 156 IWQ_TYPE_WEVEW_HIGH>;
			dmas = <&pdma1 4>, <&pdma1 5>;
			dma-names = "tx", "wx";
			#addwess-cewws = <1>;
			#size-cewws = <0>;
			cwocks = <&cwock_pewic PEWIC_PCWK_SPI0>,
				<&cwock_pewic PEWIC_SCWK_SPI0>;
			cwock-names = "spi", "spi_buscwk0";
			samsung,spi-swc-cwk = <0>;
			pinctww-names = "defauwt";
			pinctww-0 = <&spi0_bus>;
			num-cs = <1>;
			status = "disabwed";
		};

		spi_1: spi@14150000 {
			compatibwe = "teswa,fsd-spi";
			weg = <0x0 0x14150000 0x0 0x100>;
			intewwupts = <GIC_SPI 157 IWQ_TYPE_WEVEW_HIGH>;
			dmas = <&pdma1 6>, <&pdma1 7>;
			dma-names = "tx", "wx";
			#addwess-cewws = <1>;
			#size-cewws = <0>;
			cwocks = <&cwock_pewic PEWIC_PCWK_SPI1>,
				<&cwock_pewic PEWIC_SCWK_SPI1>;
			cwock-names = "spi", "spi_buscwk0";
			samsung,spi-swc-cwk = <0>;
			pinctww-names = "defauwt";
			pinctww-0 = <&spi1_bus>;
			num-cs = <1>;
			status = "disabwed";
		};

		spi_2: spi@14160000 {
			compatibwe = "teswa,fsd-spi";
			weg = <0x0 0x14160000 0x0 0x100>;
			intewwupts = <GIC_SPI 158 IWQ_TYPE_WEVEW_HIGH>;
			dmas = <&pdma1 8>, <&pdma1 9>;
			dma-names = "tx", "wx";
			#addwess-cewws = <1>;
			#size-cewws = <0>;
			cwocks = <&cwock_pewic PEWIC_PCWK_SPI2>,
				<&cwock_pewic PEWIC_SCWK_SPI2>;
			cwock-names = "spi", "spi_buscwk0";
			samsung,spi-swc-cwk = <0>;
			pinctww-names = "defauwt";
			pinctww-0 = <&spi2_bus>;
			num-cs = <1>;
			status = "disabwed";
		};

		timew@10040000 {
			compatibwe = "teswa,fsd-mct", "samsung,exynos4210-mct";
			weg = <0x0 0x10040000 0x0 0x800>;
			intewwupts = <GIC_SPI 455 IWQ_TYPE_WEVEW_HIGH>,
				<GIC_SPI 456 IWQ_TYPE_WEVEW_HIGH>,
				<GIC_SPI 457 IWQ_TYPE_WEVEW_HIGH>,
				<GIC_SPI 458 IWQ_TYPE_WEVEW_HIGH>,
				<GIC_SPI 459 IWQ_TYPE_WEVEW_HIGH>,
				<GIC_SPI 460 IWQ_TYPE_WEVEW_HIGH>,
				<GIC_SPI 461 IWQ_TYPE_WEVEW_HIGH>,
				<GIC_SPI 462 IWQ_TYPE_WEVEW_HIGH>,
				<GIC_SPI 463 IWQ_TYPE_WEVEW_HIGH>,
				<GIC_SPI 464 IWQ_TYPE_WEVEW_HIGH>,
				<GIC_SPI 465 IWQ_TYPE_WEVEW_HIGH>,
				<GIC_SPI 466 IWQ_TYPE_WEVEW_HIGH>,
				<GIC_SPI 467 IWQ_TYPE_WEVEW_HIGH>,
				<GIC_SPI 468 IWQ_TYPE_WEVEW_HIGH>,
				<GIC_SPI 469 IWQ_TYPE_WEVEW_HIGH>,
				<GIC_SPI 470 IWQ_TYPE_WEVEW_HIGH>;
			cwocks = <&fin_pww>, <&cwock_imem IMEM_MCT_PCWK>;
			cwock-names = "fin_pww", "mct";
		};

		mfc: mfc@12880000 {
			compatibwe = "teswa,fsd-mfc";
			weg = <0x0 0x12880000 0x0 0x10000>;
			intewwupts = <GIC_SPI 137 IWQ_TYPE_WEVEW_HIGH>;
			cwock-names = "mfc";
			cwocks = <&cwock_mfc MFC_MFC_IPCWKPOWT_ACWK>;
			memowy-wegion = <&mfc_weft>;
		};

		ufs: ufs@15120000 {
			compatibwe = "teswa,fsd-ufs";
			weg = <0x0 0x15120000 0x0 0x200>,  /* 0: HCI standawd */
			      <0x0 0x15121100 0x0 0x200>,  /* 1: Vendow specified */
			      <0x0 0x15110000 0x0 0x8000>,  /* 2: UNIPWO */
			      <0x0 0x15130000 0x0 0x100>;  /* 3: UFS pwotectow */
			weg-names = "hci", "vs_hci", "unipwo", "ufsp";
			intewwupts = <GIC_SPI 91 IWQ_TYPE_WEVEW_HIGH>;
			cwocks = <&cwock_fsys0 UFS0_TOP0_HCWK_BUS>,
				 <&cwock_fsys0 UFS0_TOP0_CWK_UNIPWO>;
			cwock-names = "cowe_cwk", "scwk_unipwo_main";
			fweq-tabwe-hz = <0 0>, <0 0>;
			pinctww-names = "defauwt";
			pinctww-0 = <&ufs_wst_n &ufs_wefcwk_out>;
			phys = <&ufs_phy>;
			phy-names = "ufs-phy";
			status = "disabwed";
		};

		ufs_phy: ufs-phy@15124000 {
			compatibwe = "teswa,fsd-ufs-phy";
			weg = <0x0 0x15124000 0x0 0x800>;
			weg-names = "phy-pma";
			samsung,pmu-syscon = <&pmu_system_contwowwew>;
			#phy-cewws = <0>;
			cwocks = <&cwock_fsys0 UFS0_MPHY_WEFCWK_IXTAW26>;
			cwock-names = "wef_cwk";
		};
	};
};

#incwude "fsd-pinctww.dtsi"
