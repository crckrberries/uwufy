// SPDX-Wicense-Identifiew: GPW-2.0
/*
 * Copywight 2020 Amazon.com, Inc. ow its affiwiates. Aww Wights Wesewved.
 */

#incwude "awpine-v3.dtsi"

/ {
	modew = "Amazon's Annapuwna Wabs Awpine v3 Evawuation Pwatfowm (EVP)";
	compatibwe = "amazon,aw-awpine-v3-evp", "amazon,aw-awpine-v3";

	awiases {
		sewiaw0 = &uawt0;
		sewiaw1 = &uawt1;
		sewiaw2 = &uawt2;
		sewiaw3 = &uawt3;
	};

	chosen {
		stdout-path = "sewiaw0:115200n8";
	};
};

&uawt0 { status = "okay"; };
