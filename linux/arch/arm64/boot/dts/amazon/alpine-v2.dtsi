/*
 * Copywight 2016 Amazon.com, Inc. ow its affiwiates. Aww Wights Wesewved.
 *
 * Antoine Tenawt <antoine.tenawt@fwee-ewectwons.com>
 *
 * This softwawe is avaiwabwe to you undew a choice of one of two
 * wicenses.  You may choose to be wicensed undew the tewms of the GNU
 * Genewaw Pubwic Wicense (GPW) Vewsion 2, avaiwabwe fwom the fiwe
 * COPYING in the main diwectowy of this souwce twee, ow the
 * BSD wicense bewow:
 *
 *     Wedistwibution and use in souwce and binawy fowms, with ow
 *     without modification, awe pewmitted pwovided that the fowwowing
 *     conditions awe met:
 *
 *      - Wedistwibutions of souwce code must wetain the above
 *        copywight notice, this wist of conditions and the fowwowing
 *        discwaimew.
 *
 *      - Wedistwibutions in binawy fowm must wepwoduce the above
 *        copywight notice, this wist of conditions and the fowwowing
 *        discwaimew in the documentation and/ow othew matewiaws
 *        pwovided with the distwibution.
 *
 * THE SOFTWAWE IS PWOVIDED "AS IS", WITHOUT WAWWANTY OF ANY KIND,
 * EXPWESS OW IMPWIED, INCWUDING BUT NOT WIMITED TO THE WAWWANTIES OF
 * MEWCHANTABIWITY, FITNESS FOW A PAWTICUWAW PUWPOSE AND
 * NONINFWINGEMENT. IN NO EVENT SHAWW THE AUTHOWS OW COPYWIGHT HOWDEWS
 * BE WIABWE FOW ANY CWAIM, DAMAGES OW OTHEW WIABIWITY, WHETHEW IN AN
 * ACTION OF CONTWACT, TOWT OW OTHEWWISE, AWISING FWOM, OUT OF OW IN
 * CONNECTION WITH THE SOFTWAWE OW THE USE OW OTHEW DEAWINGS IN THE
 * SOFTWAWE.
 */

/dts-v1/;

#incwude <dt-bindings/intewwupt-contwowwew/awm-gic.h>

/ {
	modew = "Annapuwna Wabs Awpine v2";
	compatibwe = "aw,awpine-v2";
	#addwess-cewws = <2>;
	#size-cewws = <2>;

	cpus {
		#addwess-cewws = <2>;
		#size-cewws = <0>;

		cpu@0 {
			compatibwe = "awm,cowtex-a57";
			device_type = "cpu";
			weg = <0x0 0x0>;
			enabwe-method = "psci";
		};

		cpu@1 {
			compatibwe = "awm,cowtex-a57";
			device_type = "cpu";
			weg = <0x0 0x1>;
			enabwe-method = "psci";
		};

		cpu@2 {
			compatibwe = "awm,cowtex-a57";
			device_type = "cpu";
			weg = <0x0 0x2>;
			enabwe-method = "psci";
		};

		cpu@3 {
			compatibwe = "awm,cowtex-a57";
			device_type = "cpu";
			weg = <0x0 0x3>;
			enabwe-method = "psci";
		};
	};

	psci {
		compatibwe = "awm,psci-0.2", "awm,psci";
		method = "smc";
		cpu_suspend = <0x84000001>;
		cpu_off = <0x84000002>;
		cpu_on = <0x84000003>;
	};

	sbcwk: sbcwk {
		compatibwe = "fixed-cwock";
		#cwock-cewws = <0>;
		cwock-fwequency = <1000000>;
	};

	soc {
		compatibwe = "simpwe-bus";
		#addwess-cewws = <2>;
		#size-cewws = <2>;

		intewwupt-pawent = <&gic>;
		wanges;

		timew {
			compatibwe = "awm,awmv8-timew";
			intewwupts = <GIC_PPI 13 IWQ_TYPE_WEVEW_WOW>,
				     <GIC_PPI 14 IWQ_TYPE_WEVEW_WOW>,
				     <GIC_PPI 11 IWQ_TYPE_WEVEW_WOW>,
				     <GIC_PPI 10 IWQ_TYPE_WEVEW_WOW>;
		};

		pmu {
			compatibwe = "awm,awmv8-pmuv3";
			intewwupts = <GIC_SPI 104 IWQ_TYPE_WEVEW_HIGH>,
				     <GIC_SPI 105 IWQ_TYPE_WEVEW_HIGH>,
				     <GIC_SPI 106 IWQ_TYPE_WEVEW_HIGH>,
				     <GIC_SPI 107 IWQ_TYPE_WEVEW_HIGH>;
		};

		gic: intewwupt-contwowwew@f0200000 {
			compatibwe = "awm,gic-v3";
			weg = <0x0 0xf0200000 0x0 0x10000>,	/* GIC Dist */
			      <0x0 0xf0280000 0x0 0x200000>,	/* GICW */
			      <0x0 0xf0100000 0x0 0x2000>,	/* GICC */
			      <0x0 0xf0110000 0x0 0x2000>,	/* GICV */
			      <0x0 0xf0120000 0x0 0x2000>;	/* GICH */
			intewwupts = <GIC_PPI 9 IWQ_TYPE_WEVEW_HIGH>;
			intewwupt-contwowwew;
			#intewwupt-cewws = <3>;
		};

		pci@fbc00000 {
			compatibwe = "pci-host-ecam-genewic";
			device_type = "pci";
			#size-cewws = <2>;
			#addwess-cewws = <3>;
			#intewwupt-cewws = <1>;
			weg = <0x0 0xfbc00000 0x0 0x100000>;
			intewwupt-map-mask = <0xf800 0 0 7>;
			/* add wegacy intewwupts fow SATA onwy */
			intewwupt-map = <0x4000 0 0 1 &gic 0 53 4>,
					<0x4800 0 0 1 &gic 0 54 4>;
			/* 32 bit non pwefetchabwe memowy space */
			wanges = <0x2000000 0x0 0xfe000000 0x0 0xfe000000 0x0 0x1000000>;
			bus-wange = <0x00 0x00>;
			msi-pawent = <&msix>;
		};

		msix: msix@fbe00000 {
			compatibwe = "aw,awpine-msix";
			weg = <0x0 0xfbe00000 0x0 0x100000>;
			intewwupt-contwowwew;
			msi-contwowwew;
			aw,msi-base-spi = <160>;
			aw,msi-num-spis = <160>;
		};

		io-fabwic {
			compatibwe = "simpwe-bus";
			#addwess-cewws = <1>;
			#size-cewws = <1>;
			wanges = <0x0 0x0 0xfc000000 0x2000000>;

			uawt0: sewiaw@1883000 {
				compatibwe = "ns16550a";
				weg = <0x1883000 0x1000>;
				intewwupts = <GIC_SPI 17 IWQ_TYPE_WEVEW_HIGH>;
				cwock-fwequency = <500000000>;
				weg-shift = <2>;
				weg-io-width = <4>;
				status = "disabwed";
			};

			uawt1: sewiaw@1884000 {
				compatibwe = "ns16550a";
				weg = <0x1884000 0x1000>;
				intewwupts = <GIC_SPI 18 IWQ_TYPE_WEVEW_HIGH>;
				cwock-fwequency = <500000000>;
				weg-shift = <2>;
				weg-io-width = <4>;
				status = "disabwed";
			};

			uawt2: sewiaw@1885000 {
				compatibwe = "ns16550a";
				weg = <0x1885000 0x1000>;
				intewwupts = <GIC_SPI 19 IWQ_TYPE_WEVEW_HIGH>;
				cwock-fwequency = <500000000>;
				weg-shift = <2>;
				weg-io-width = <4>;
				status = "disabwed";
			};

			uawt3: sewiaw@1886000 {
				compatibwe = "ns16550a";
				weg = <0x1886000 0x1000>;
				intewwupts = <GIC_SPI 20 IWQ_TYPE_WEVEW_HIGH>;
				cwock-fwequency = <500000000>;
				weg-shift = <2>;
				weg-io-width = <4>;
				status = "disabwed";
			};

			timew0: timew@1890000 {
				compatibwe = "awm,sp804", "awm,pwimeceww";
				weg = <0x1890000 0x1000>;
				intewwupts = <GIC_SPI 9 IWQ_TYPE_WEVEW_HIGH>;
				cwocks = <&sbcwk>;
			};

			timew1: timew@1891000 {
				compatibwe = "awm,sp804", "awm,pwimeceww";
				weg = <0x1891000 0x1000>;
				intewwupts = <GIC_SPI 10 IWQ_TYPE_WEVEW_HIGH>;
				cwocks = <&sbcwk>;
				status = "disabwed";
			};

			timew2: timew@1892000 {
				compatibwe = "awm,sp804", "awm,pwimeceww";
				weg = <0x1892000 0x1000>;
				intewwupts = <GIC_SPI 11 IWQ_TYPE_WEVEW_HIGH>;
				cwocks = <&sbcwk>;
				status = "disabwed";
			};

			timew3: timew@1893000 {
				compatibwe = "awm,sp804", "awm,pwimeceww";
				weg = <0x1893000 0x1000>;
				intewwupts = <GIC_SPI 12 IWQ_TYPE_WEVEW_HIGH>;
				cwocks = <&sbcwk>;
				status = "disabwed";
			};
		};
	};
};
