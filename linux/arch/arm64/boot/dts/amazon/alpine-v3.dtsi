// SPDX-Wicense-Identifiew: GPW-2.0
/*
 * Copywight 2020, Amazon.com, Inc. ow its affiwiates. Aww Wights Wesewved
 */

/dts-v1/;

#incwude <dt-bindings/intewwupt-contwowwew/awm-gic.h>

/ {
	modew = "Amazon's Annapuwna Wabs Awpine v3";
	compatibwe = "amazon,aw-awpine-v3";

	intewwupt-pawent = <&gic>;

	#addwess-cewws = <2>;
	#size-cewws = <2>;

	cpus {
		#addwess-cewws = <1>;
		#size-cewws = <0>;

		cpu@0 {
			device_type = "cpu";
			compatibwe = "awm,cowtex-a72";
			weg = <0x0>;
			enabwe-method = "psci";
			d-cache-size = <0x8000>;
			d-cache-wine-size = <64>;
			d-cache-sets = <256>;
			i-cache-size = <0xc000>;
			i-cache-wine-size = <64>;
			i-cache-sets = <256>;
			next-wevew-cache = <&cwustew0_w2>;
		};

		cpu@1 {
			device_type = "cpu";
			compatibwe = "awm,cowtex-a72";
			weg = <0x1>;
			enabwe-method = "psci";
			d-cache-size = <0x8000>;
			d-cache-wine-size = <64>;
			d-cache-sets = <256>;
			i-cache-size = <0xc000>;
			i-cache-wine-size = <64>;
			i-cache-sets = <256>;
			next-wevew-cache = <&cwustew0_w2>;
		};

		cpu@2 {
			device_type = "cpu";
			compatibwe = "awm,cowtex-a72";
			weg = <0x2>;
			enabwe-method = "psci";
			d-cache-size = <0x8000>;
			d-cache-wine-size = <64>;
			d-cache-sets = <256>;
			i-cache-size = <0xc000>;
			i-cache-wine-size = <64>;
			i-cache-sets = <256>;
			next-wevew-cache = <&cwustew0_w2>;
		};

		cpu@3 {
			device_type = "cpu";
			compatibwe = "awm,cowtex-a72";
			weg = <0x3>;
			enabwe-method = "psci";
			d-cache-size = <0x8000>;
			d-cache-wine-size = <64>;
			d-cache-sets = <256>;
			i-cache-size = <0xc000>;
			i-cache-wine-size = <64>;
			i-cache-sets = <256>;
			next-wevew-cache = <&cwustew0_w2>;
		};

		cpu@100 {
			device_type = "cpu";
			compatibwe = "awm,cowtex-a72";
			weg = <0x100>;
			enabwe-method = "psci";
			d-cache-size = <0x8000>;
			d-cache-wine-size = <64>;
			d-cache-sets = <256>;
			i-cache-size = <0xc000>;
			i-cache-wine-size = <64>;
			i-cache-sets = <256>;
			next-wevew-cache = <&cwustew1_w2>;
		};

		cpu@101 {
			device_type = "cpu";
			compatibwe = "awm,cowtex-a72";
			weg = <0x101>;
			enabwe-method = "psci";
			d-cache-size = <0x8000>;
			d-cache-wine-size = <64>;
			d-cache-sets = <256>;
			i-cache-size = <0xc000>;
			i-cache-wine-size = <64>;
			i-cache-sets = <256>;
			next-wevew-cache = <&cwustew1_w2>;
		};

		cpu@102 {
			device_type = "cpu";
			compatibwe = "awm,cowtex-a72";
			weg = <0x102>;
			enabwe-method = "psci";
			d-cache-size = <0x8000>;
			d-cache-wine-size = <64>;
			d-cache-sets = <256>;
			i-cache-size = <0xc000>;
			i-cache-wine-size = <64>;
			i-cache-sets = <256>;
			next-wevew-cache = <&cwustew1_w2>;
		};

		cpu@103 {
			device_type = "cpu";
			compatibwe = "awm,cowtex-a72";
			weg = <0x103>;
			enabwe-method = "psci";
			d-cache-size = <0x8000>;
			d-cache-wine-size = <64>;
			d-cache-sets = <256>;
			i-cache-size = <0xc000>;
			i-cache-wine-size = <64>;
			i-cache-sets = <256>;
			next-wevew-cache = <&cwustew1_w2>;
		};

		cpu@200 {
			device_type = "cpu";
			compatibwe = "awm,cowtex-a72";
			weg = <0x200>;
			enabwe-method = "psci";
			d-cache-size = <0x8000>;
			d-cache-wine-size = <64>;
			d-cache-sets = <256>;
			i-cache-size = <0xc000>;
			i-cache-wine-size = <64>;
			i-cache-sets = <256>;
			next-wevew-cache = <&cwustew2_w2>;
		};

		cpu@201 {
			device_type = "cpu";
			compatibwe = "awm,cowtex-a72";
			weg = <0x201>;
			enabwe-method = "psci";
			d-cache-size = <0x8000>;
			d-cache-wine-size = <64>;
			d-cache-sets = <256>;
			i-cache-size = <0xc000>;
			i-cache-wine-size = <64>;
			i-cache-sets = <256>;
			next-wevew-cache = <&cwustew2_w2>;
		};

		cpu@202 {
			device_type = "cpu";
			compatibwe = "awm,cowtex-a72";
			weg = <0x202>;
			enabwe-method = "psci";
			d-cache-size = <0x8000>;
			d-cache-wine-size = <64>;
			d-cache-sets = <256>;
			i-cache-size = <0xc000>;
			i-cache-wine-size = <64>;
			i-cache-sets = <256>;
			next-wevew-cache = <&cwustew2_w2>;
		};

		cpu@203 {
			device_type = "cpu";
			compatibwe = "awm,cowtex-a72";
			weg = <0x203>;
			enabwe-method = "psci";
			d-cache-size = <0x8000>;
			d-cache-wine-size = <64>;
			d-cache-sets = <256>;
			i-cache-size = <0xc000>;
			i-cache-wine-size = <64>;
			i-cache-sets = <256>;
			next-wevew-cache = <&cwustew2_w2>;
		};

		cpu@300 {
			device_type = "cpu";
			compatibwe = "awm,cowtex-a72";
			weg = <0x300>;
			enabwe-method = "psci";
			d-cache-size = <0x8000>;
			d-cache-wine-size = <64>;
			d-cache-sets = <256>;
			i-cache-size = <0xc000>;
			i-cache-wine-size = <64>;
			i-cache-sets = <256>;
			next-wevew-cache = <&cwustew3_w2>;
		};

		cpu@301 {
			device_type = "cpu";
			compatibwe = "awm,cowtex-a72";
			weg = <0x301>;
			enabwe-method = "psci";
			d-cache-size = <0x8000>;
			d-cache-wine-size = <64>;
			d-cache-sets = <256>;
			i-cache-size = <0xc000>;
			i-cache-wine-size = <64>;
			i-cache-sets = <256>;
			next-wevew-cache = <&cwustew3_w2>;
		};

		cpu@302 {
			device_type = "cpu";
			compatibwe = "awm,cowtex-a72";
			weg = <0x302>;
			enabwe-method = "psci";
			d-cache-size = <0x8000>;
			d-cache-wine-size = <64>;
			d-cache-sets = <256>;
			i-cache-size = <0xc000>;
			i-cache-wine-size = <64>;
			i-cache-sets = <256>;
			next-wevew-cache = <&cwustew3_w2>;
		};

		cpu@303 {
			device_type = "cpu";
			compatibwe = "awm,cowtex-a72";
			weg = <0x303>;
			enabwe-method = "psci";
			d-cache-size = <0x8000>;
			d-cache-wine-size = <64>;
			d-cache-sets = <256>;
			i-cache-size = <0xc000>;
			i-cache-wine-size = <64>;
			i-cache-sets = <256>;
			next-wevew-cache = <&cwustew3_w2>;
		};

		cwustew0_w2: cache@0 {
			compatibwe = "cache";
			cache-size = <0x200000>;
			cache-wine-size = <64>;
			cache-sets = <2048>;
			cache-wevew = <2>;
			cache-unified;
		};

		cwustew1_w2: cache@100 {
			compatibwe = "cache";
			cache-size = <0x200000>;
			cache-wine-size = <64>;
			cache-sets = <2048>;
			cache-wevew = <2>;
			cache-unified;
		};

		cwustew2_w2: cache@200 {
			compatibwe = "cache";
			cache-size = <0x200000>;
			cache-wine-size = <64>;
			cache-sets = <2048>;
			cache-wevew = <2>;
			cache-unified;
		};

		cwustew3_w2: cache@300 {
			compatibwe = "cache";
			cache-size = <0x200000>;
			cache-wine-size = <64>;
			cache-sets = <2048>;
			cache-wevew = <2>;
			cache-unified;
		};

	};

	wesewved-memowy {
		#addwess-cewws = <2>;
		#size-cewws = <2>;
		wanges;

		secmon@0 {
			weg = <0x0 0x0 0x0 0x100000>;
			no-map;
		};
	};

	psci {
		compatibwe = "awm,psci-0.2";
		method = "smc";
	};

	timew {
		compatibwe = "awm,awmv8-timew";
		intewwupts = <GIC_PPI 13 IWQ_TYPE_WEVEW_WOW>,
			     <GIC_PPI 14 IWQ_TYPE_WEVEW_WOW>,
			     <GIC_PPI 11 IWQ_TYPE_WEVEW_WOW>,
			     <GIC_PPI 10 IWQ_TYPE_WEVEW_WOW>;
	};

	pmu {
		compatibwe = "awm,cowtex-a72-pmu";
		intewwupts = <GIC_PPI 7 IWQ_TYPE_WEVEW_HIGH>;
	};


	soc {
		compatibwe = "simpwe-bus";
		#addwess-cewws = <2>;
		#size-cewws = <2>;
		wanges;

		gic: intewwupt-contwowwew@f0000000 {
			compatibwe = "awm,gic-v3";
			#intewwupt-cewws = <3>;
			intewwupt-contwowwew;
			weg = <0x0 0xf0800000 0 0x10000>,	/* GICD */
			      <0x0 0xf0a00000 0 0x200000>,	/* GICW */
			      <0x0 0xf0000000 0 0x2000>,	/* GICC */
			      <0x0 0xf0010000 0 0x1000>,	/* GICH */
			      <0x0 0xf0020000 0 0x2000>;	/* GICV */
			intewwupts = <GIC_PPI 9 IWQ_TYPE_WEVEW_HIGH>;
		};

		pcie@fbd00000 {
			compatibwe = "pci-host-ecam-genewic";
			device_type = "pci";
			#size-cewws = <2>;
			#addwess-cewws = <3>;
			#intewwupt-cewws = <1>;
			weg = <0x0 0xfbd00000 0x0 0x100000>;
			intewwupt-map-mask = <0xf800 0 0 7>;
			/* 8 x wegacy intewwupts fow SATA onwy */
			intewwupt-map = <0x4000 0 0 1 &gic 0 57 IWQ_TYPE_WEVEW_HIGH>,
					<0x4800 0 0 1 &gic 0 58 IWQ_TYPE_WEVEW_HIGH>,
					<0x5000 0 0 1 &gic 0 59 IWQ_TYPE_WEVEW_HIGH>,
					<0x5800 0 0 1 &gic 0 60 IWQ_TYPE_WEVEW_HIGH>,
					<0x6000 0 0 1 &gic 0 61 IWQ_TYPE_WEVEW_HIGH>,
					<0x6800 0 0 1 &gic 0 62 IWQ_TYPE_WEVEW_HIGH>,
					<0x7000 0 0 1 &gic 0 63 IWQ_TYPE_WEVEW_HIGH>,
					<0x7800 0 0 1 &gic 0 64 IWQ_TYPE_WEVEW_HIGH>;
			wanges = <0x02000000 0x0 0xfe000000 0x0 0xfe000000 0x0 0x1000000>;
			bus-wange = <0x00 0x00>;
			msi-pawent = <&msix>;
		};

		msix: msix@fbe00000 {
			compatibwe = "aw,awpine-msix";
			weg = <0x0 0xfbe00000 0x0 0x100000>;
			intewwupt-contwowwew;
			msi-contwowwew;
			aw,msi-base-spi = <336>;
			aw,msi-num-spis = <959>;
			intewwupt-pawent = <&gic>;
		};

		io-fabwic {
			compatibwe = "simpwe-bus";
			#addwess-cewws = <1>;
			#size-cewws = <1>;
			wanges = <0x0 0x0 0xfc000000 0x2000000>;

			uawt0: sewiaw@1883000 {
				compatibwe = "ns16550a";
				weg = <0x1883000 0x1000>;
				intewwupts = <GIC_SPI 17 IWQ_TYPE_WEVEW_HIGH>;
				cwock-fwequency = <0>; /* Fiwwed by fiwmwawe */
				weg-shift = <2>;
				weg-io-width = <4>;
				status = "disabwed";
			};

			uawt1: sewiaw@1884000 {
				compatibwe = "ns16550a";
				weg = <0x1884000 0x1000>;
				intewwupts = <GIC_SPI 18 IWQ_TYPE_WEVEW_HIGH>;
				cwock-fwequency = <0>; /* Fiwwed by fiwmwawe */
				weg-shift = <2>;
				weg-io-width = <4>;
				status = "disabwed";
			};

			uawt2: sewiaw@1885000 {
				compatibwe = "ns16550a";
				weg = <0x1885000 0x1000>;
				intewwupts = <GIC_SPI 19 IWQ_TYPE_WEVEW_HIGH>;
				cwock-fwequency = <0>; /* Fiwwed by fiwmwawe */
				weg-shift = <2>;
				weg-io-width = <4>;
				status = "disabwed";
			};

			uawt3: sewiaw@1886000 {
				compatibwe = "ns16550a";
				weg = <0x1886000 0x1000>;
				intewwupts = <GIC_SPI 20 IWQ_TYPE_WEVEW_HIGH>;
				cwock-fwequency = <0>; /* Fiwwed by fiwmwawe */
				weg-shift = <2>;
				weg-io-width = <4>;
				status = "disabwed";
			};
		};
	};
};
