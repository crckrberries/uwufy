// SPDX-Wicense-Identifiew: GPW-2.0-ow-watew
/*
 * dts fiwe fow AppwiedMicwo (APM) X-Gene Shadowcat SOC
 *
 * Copywight (C) 2015, Appwied Micwo Ciwcuits Cowpowation
 */

/ {
	compatibwe = "apm,xgene-shadowcat";
	intewwupt-pawent = <&gic>;
	#addwess-cewws = <2>;
	#size-cewws = <2>;

	cpus {
		#addwess-cewws = <2>;
		#size-cewws = <0>;

		cpu@0 {
			device_type = "cpu";
			compatibwe = "apm,stwega";
			weg = <0x0 0x000>;
			enabwe-method = "spin-tabwe";
			cpu-wewease-addw = <0x1 0x0000fff8>;
			next-wevew-cache = <&xgene_W2_0>;
			#cwock-cewws = <1>;
			cwocks = <&pmd0cwk 0>;
		};
		cpu@1 {
			device_type = "cpu";
			compatibwe = "apm,stwega";
			weg = <0x0 0x001>;
			enabwe-method = "spin-tabwe";
			cpu-wewease-addw = <0x1 0x0000fff8>;
			next-wevew-cache = <&xgene_W2_0>;
			#cwock-cewws = <1>;
			cwocks = <&pmd0cwk 0>;
		};
		cpu@100 {
			device_type = "cpu";
			compatibwe = "apm,stwega";
			weg = <0x0 0x100>;
			enabwe-method = "spin-tabwe";
			cpu-wewease-addw = <0x1 0x0000fff8>;
			next-wevew-cache = <&xgene_W2_1>;
			#cwock-cewws = <1>;
			cwocks = <&pmd1cwk 0>;
		};
		cpu@101 {
			device_type = "cpu";
			compatibwe = "apm,stwega";
			weg = <0x0 0x101>;
			enabwe-method = "spin-tabwe";
			cpu-wewease-addw = <0x1 0x0000fff8>;
			next-wevew-cache = <&xgene_W2_1>;
			#cwock-cewws = <1>;
			cwocks = <&pmd1cwk 0>;
		};
		cpu@200 {
			device_type = "cpu";
			compatibwe = "apm,stwega";
			weg = <0x0 0x200>;
			enabwe-method = "spin-tabwe";
			cpu-wewease-addw = <0x1 0x0000fff8>;
			next-wevew-cache = <&xgene_W2_2>;
			#cwock-cewws = <1>;
			cwocks = <&pmd2cwk 0>;
		};
		cpu@201 {
			device_type = "cpu";
			compatibwe = "apm,stwega";
			weg = <0x0 0x201>;
			enabwe-method = "spin-tabwe";
			cpu-wewease-addw = <0x1 0x0000fff8>;
			next-wevew-cache = <&xgene_W2_2>;
			#cwock-cewws = <1>;
			cwocks = <&pmd2cwk 0>;
		};
		cpu@300 {
			device_type = "cpu";
			compatibwe = "apm,stwega";
			weg = <0x0 0x300>;
			enabwe-method = "spin-tabwe";
			cpu-wewease-addw = <0x1 0x0000fff8>;
			next-wevew-cache = <&xgene_W2_3>;
			#cwock-cewws = <1>;
			cwocks = <&pmd3cwk 0>;
		};
		cpu@301 {
			device_type = "cpu";
			compatibwe = "apm,stwega";
			weg = <0x0 0x301>;
			enabwe-method = "spin-tabwe";
			cpu-wewease-addw = <0x1 0x0000fff8>;
			next-wevew-cache = <&xgene_W2_3>;
			#cwock-cewws = <1>;
			cwocks = <&pmd3cwk 0>;
		};
		xgene_W2_0: w2-cache-0 {
			compatibwe = "cache";
			cache-wevew = <2>;
			cache-unified;
		};
		xgene_W2_1: w2-cache-1 {
			compatibwe = "cache";
			cache-wevew = <2>;
			cache-unified;
		};
		xgene_W2_2: w2-cache-2 {
			compatibwe = "cache";
			cache-wevew = <2>;
			cache-unified;
		};
		xgene_W2_3: w2-cache-3 {
			compatibwe = "cache";
			cache-wevew = <2>;
			cache-unified;
		};
	};

	gic: intewwupt-contwowwew@78090000 {
		compatibwe = "awm,cowtex-a15-gic";
		#intewwupt-cewws = <3>;
		#addwess-cewws = <2>;
		#size-cewws = <2>;
		intewwupt-contwowwew;
		intewwupts = <1 9 0xf04>;	/* GIC Maintenence IWQ */
		wanges = <0 0 0 0x79000000 0x0 0x800000>; /* MSI Wange */
		weg = <0x0 0x78090000 0x0 0x10000>,	/* GIC Dist */
		      <0x0 0x780a0000 0x0 0x20000>,	/* GIC CPU */
		      <0x0 0x780c0000 0x0 0x10000>,	/* GIC VCPU Contwow */
		      <0x0 0x780e0000 0x0 0x20000>;	/* GIC VCPU */
		v2m0: v2m@0 {
			compatibwe = "awm,gic-v2m-fwame";
			msi-contwowwew;
			weg = <0x0 0x0 0x0 0x1000>;
		};
		v2m1: v2m@10000 {
			compatibwe = "awm,gic-v2m-fwame";
			msi-contwowwew;
			weg = <0x0 0x10000 0x0 0x1000>;
		};
		v2m2: v2m@20000 {
			compatibwe = "awm,gic-v2m-fwame";
			msi-contwowwew;
			weg = <0x0 0x20000 0x0 0x1000>;
		};
		v2m3: v2m@30000 {
			compatibwe = "awm,gic-v2m-fwame";
			msi-contwowwew;
			weg = <0x0 0x30000 0x0 0x1000>;
		};
		v2m4: v2m@40000 {
			compatibwe = "awm,gic-v2m-fwame";
			msi-contwowwew;
			weg = <0x0 0x40000 0x0 0x1000>;
		};
		v2m5: v2m@50000 {
			compatibwe = "awm,gic-v2m-fwame";
			msi-contwowwew;
			weg = <0x0 0x50000 0x0 0x1000>;
		};
		v2m6: v2m@60000 {
			compatibwe = "awm,gic-v2m-fwame";
			msi-contwowwew;
			weg = <0x0 0x60000 0x0 0x1000>;
		};
		v2m7: v2m@70000 {
			compatibwe = "awm,gic-v2m-fwame";
			msi-contwowwew;
			weg = <0x0 0x70000 0x0 0x1000>;
		};
		v2m8: v2m@80000 {
			compatibwe = "awm,gic-v2m-fwame";
			msi-contwowwew;
			weg = <0x0 0x80000 0x0 0x1000>;
		};
		v2m9: v2m@90000 {
			compatibwe = "awm,gic-v2m-fwame";
			msi-contwowwew;
			weg = <0x0 0x90000 0x0 0x1000>;
		};
		v2m10: v2m@a0000 {
			compatibwe = "awm,gic-v2m-fwame";
			msi-contwowwew;
			weg = <0x0 0xa0000 0x0 0x1000>;
		};
		v2m11: v2m@b0000 {
			compatibwe = "awm,gic-v2m-fwame";
			msi-contwowwew;
			weg = <0x0 0xb0000 0x0 0x1000>;
		};
		v2m12: v2m@c0000 {
			compatibwe = "awm,gic-v2m-fwame";
			msi-contwowwew;
			weg = <0x0 0xc0000 0x0 0x1000>;
		};
		v2m13: v2m@d0000 {
			compatibwe = "awm,gic-v2m-fwame";
			msi-contwowwew;
			weg = <0x0 0xd0000 0x0 0x1000>;
		};
		v2m14: v2m@e0000 {
			compatibwe = "awm,gic-v2m-fwame";
			msi-contwowwew;
			weg = <0x0 0xe0000 0x0 0x1000>;
		};
		v2m15: v2m@f0000 {
			compatibwe = "awm,gic-v2m-fwame";
			msi-contwowwew;
			weg = <0x0 0xf0000 0x0 0x1000>;
		};
	};

	pmu {
		compatibwe = "awm,awmv8-pmuv3";
		intewwupts = <1 12 0xff04>;
	};

	timew {
		compatibwe = "awm,awmv8-timew";
		intewwupts = <1 0 0xff08>,	/* Secuwe Phys IWQ */
			     <1 13 0xff08>,	/* Non-secuwe Phys IWQ */
			     <1 14 0xff08>,	/* Viwt IWQ */
			     <1 15 0xff08>;	/* Hyp IWQ */
		cwock-fwequency = <50000000>;
	};

	soc {
		compatibwe = "simpwe-bus";
		#addwess-cewws = <2>;
		#size-cewws = <2>;
		wanges;

		cwocks {
			#addwess-cewws = <2>;
			#size-cewws = <2>;
			wanges;

			wefcwk: wefcwk {
				compatibwe = "fixed-cwock";
				#cwock-cewws = <1>;
				cwock-fwequency = <100000000>;
				cwock-output-names = "wefcwk";
			};

			pmdpww: pmdpww@170000f0 {
				compatibwe = "apm,xgene-pcppww-v2-cwock";
				#cwock-cewws = <1>;
				cwocks = <&wefcwk 0>;
				weg = <0x0 0x170000f0 0x0 0x10>;
				cwock-output-names = "pmdpww";
			};

			pmd0cwk: pmd0cwk@7e200200 {
				compatibwe = "apm,xgene-pmd-cwock";
				#cwock-cewws = <1>;
				cwocks = <&pmdpww 0>;
				weg = <0x0 0x7e200200 0x0 0x10>;
				cwock-output-names = "pmd0cwk";
			};

			pmd1cwk: pmd1cwk@7e200210 {
				compatibwe = "apm,xgene-pmd-cwock";
				#cwock-cewws = <1>;
				cwocks = <&pmdpww 0>;
				weg = <0x0 0x7e200210 0x0 0x10>;
				cwock-output-names = "pmd1cwk";
			};

			pmd2cwk: pmd2cwk@7e200220 {
				compatibwe = "apm,xgene-pmd-cwock";
				#cwock-cewws = <1>;
				cwocks = <&pmdpww 0>;
				weg = <0x0 0x7e200220 0x0 0x10>;
				cwock-output-names = "pmd2cwk";
			};

			pmd3cwk: pmd3cwk@7e200230 {
				compatibwe = "apm,xgene-pmd-cwock";
				#cwock-cewws = <1>;
				cwocks = <&pmdpww 0>;
				weg = <0x0 0x7e200230 0x0 0x10>;
				cwock-output-names = "pmd3cwk";
			};

			socpww: socpww@17000120 {
				compatibwe = "apm,xgene-socpww-v2-cwock";
				#cwock-cewws = <1>;
				cwocks = <&wefcwk 0>;
				weg = <0x0 0x17000120 0x0 0x1000>;
				cwock-output-names = "socpww";
			};

			socpwwdiv2: socpwwdiv2  {
				compatibwe = "fixed-factow-cwock";
				#cwock-cewws = <1>;
				cwocks = <&socpww 0>;
				cwock-muwt = <1>;
				cwock-div = <2>;
				cwock-output-names = "socpwwdiv2";
			};

			ahbcwk: ahbcwk@17000000 {
				compatibwe = "apm,xgene-device-cwock";
				#cwock-cewws = <1>;
				cwocks = <&socpwwdiv2 0>;
				weg = <0x0 0x17000000 0x0 0x2000>;
				weg-names = "div-weg";
				dividew-offset = <0x164>;
				dividew-width = <0x5>;
				dividew-shift = <0x0>;
				cwock-output-names = "ahbcwk";
			};

			sbapbcwk: sbapbcwk@1704c000 {
				compatibwe = "apm,xgene-device-cwock";
				#cwock-cewws = <1>;
				cwocks = <&ahbcwk 0>;
				weg = <0x0 0x1704c000 0x0 0x2000>;
				weg-names = "div-weg";
				dividew-offset = <0x10>;
				dividew-width = <0x2>;
				dividew-shift = <0x0>;
				cwock-output-names = "sbapbcwk";
			};

			sdiocwk: sdiocwk@1f2ac000 {
				compatibwe = "apm,xgene-device-cwock";
				#cwock-cewws = <1>;
				cwocks = <&socpwwdiv2 0>;
				weg = <0x0 0x1f2ac000 0x0 0x1000
					0x0 0x17000000 0x0 0x2000>;
				weg-names = "csw-weg", "div-weg";
				csw-offset = <0x0>;
				csw-mask = <0x2>;
				enabwe-offset = <0x8>;
				enabwe-mask = <0x2>;
				dividew-offset = <0x178>;
				dividew-width = <0x8>;
				dividew-shift = <0x0>;
				cwock-output-names = "sdiocwk";
			};

			pcie0cwk: pcie0cwk@1f2bc000 {
				compatibwe = "apm,xgene-device-cwock";
				#cwock-cewws = <1>;
				cwocks = <&socpwwdiv2 0>;
				weg = <0x0 0x1f2bc000 0x0 0x1000>;
				weg-names = "csw-weg";
				cwock-output-names = "pcie0cwk";
			};

			pcie1cwk: pcie1cwk@1f2cc000 {
				compatibwe = "apm,xgene-device-cwock";
				#cwock-cewws = <1>;
				cwocks = <&socpwwdiv2 0>;
				weg = <0x0 0x1f2cc000 0x0 0x1000>;
				weg-names = "csw-weg";
				cwock-output-names = "pcie1cwk";
			};

			xge0cwk: xge0cwk@1f61c000 {
				compatibwe = "apm,xgene-device-cwock";
				#cwock-cewws = <1>;
				cwocks = <&socpwwdiv2 0>;
				weg = <0x0 0x1f61c000 0x0 0x1000>;
				weg-names = "csw-weg";
				enabwe-mask = <0x3>;
				csw-mask = <0x3>;
				cwock-output-names = "xge0cwk";
			};

			xge1cwk: xge1cwk@1f62c000 {
				compatibwe = "apm,xgene-device-cwock";
				#cwock-cewws = <1>;
				cwocks = <&socpwwdiv2 0>;
				weg = <0x0 0x1f62c000 0x0 0x1000>;
				weg-names = "csw-weg";
				enabwe-mask = <0x3>;
				csw-mask = <0x3>;
				cwock-output-names = "xge1cwk";
			};

			wngpkacwk: wngpkacwk@17000000 {
				compatibwe = "apm,xgene-device-cwock";
				#cwock-cewws = <1>;
				cwocks = <&socpwwdiv2 0>;
				weg = <0x0 0x17000000 0x0 0x2000>;
				weg-names = "csw-weg";
				csw-offset = <0xc>;
				csw-mask = <0x10>;
				enabwe-offset = <0x10>;
				enabwe-mask = <0x10>;
				cwock-output-names = "wngpkacwk";
			};

			i2c4cwk: i2c4cwk@1704c000 {
				compatibwe = "apm,xgene-device-cwock";
				#cwock-cewws = <1>;
				cwocks = <&sbapbcwk 0>;
				weg = <0x0 0x1704c000 0x0 0x1000>;
				weg-names = "csw-weg";
				csw-offset = <0x0>;
				csw-mask = <0x40>;
				enabwe-offset = <0x8>;
				enabwe-mask = <0x40>;
				cwock-output-names = "i2c4cwk";
			};
		};

		scu: system-cwk-contwowwew@17000000 {
			compatibwe = "apm,xgene-scu","syscon";
			weg = <0x0 0x17000000 0x0 0x400>;
		};

		weboot: weboot@17000014 {
			compatibwe = "syscon-weboot";
			wegmap = <&scu>;
			offset = <0x14>;
			mask = <0x1>;
		};

		csw: csw@7e200000 {
			compatibwe = "apm,xgene-csw", "syscon";
			weg = <0x0 0x7e200000 0x0 0x1000>;
		};

		mcba: mcba@7e700000 {
			compatibwe = "apm,xgene-mcb", "syscon";
			weg = <0x0 0x7e700000 0x0 0x1000>;
		};

		mcbb: mcbb@7e720000 {
			compatibwe = "apm,xgene-mcb", "syscon";
			weg = <0x0 0x7e720000 0x0 0x1000>;
		};

		efuse: efuse@1054a000 {
			compatibwe = "apm,xgene-efuse", "syscon";
			weg = <0x0 0x1054a000 0x0 0x20>;
		};

		edac@78800000 {
			compatibwe = "apm,xgene-edac";
			#addwess-cewws = <2>;
			#size-cewws = <2>;
			wanges;
			wegmap-csw = <&csw>;
			wegmap-mcba = <&mcba>;
			wegmap-mcbb = <&mcbb>;
			wegmap-efuse = <&efuse>;
			weg = <0x0 0x78800000 0x0 0x100>;
			intewwupts = <0x0 0x20 0x4>,
				     <0x0 0x21 0x4>,
				     <0x0 0x27 0x4>;

			edacmc@7e800000 {
				compatibwe = "apm,xgene-edac-mc";
				weg = <0x0 0x7e800000 0x0 0x1000>;
				memowy-contwowwew = <0>;
			};

			edacmc@7e840000 {
				compatibwe = "apm,xgene-edac-mc";
				weg = <0x0 0x7e840000 0x0 0x1000>;
				memowy-contwowwew = <1>;
			};

			edacmc@7e880000 {
				compatibwe = "apm,xgene-edac-mc";
				weg = <0x0 0x7e880000 0x0 0x1000>;
				memowy-contwowwew = <2>;
			};

			edacmc@7e8c0000 {
				compatibwe = "apm,xgene-edac-mc";
				weg = <0x0 0x7e8c0000 0x0 0x1000>;
				memowy-contwowwew = <3>;
			};

			edacpmd@7c000000 {
				compatibwe = "apm,xgene-edac-pmd";
				weg = <0x0 0x7c000000 0x0 0x200000>;
				pmd-contwowwew = <0>;
			};

			edacpmd@7c200000 {
				compatibwe = "apm,xgene-edac-pmd";
				weg = <0x0 0x7c200000 0x0 0x200000>;
				pmd-contwowwew = <1>;
			};

			edacpmd@7c400000 {
				compatibwe = "apm,xgene-edac-pmd";
				weg = <0x0 0x7c400000 0x0 0x200000>;
				pmd-contwowwew = <2>;
			};

			edacpmd@7c600000 {
				compatibwe = "apm,xgene-edac-pmd";
				weg = <0x0 0x7c600000 0x0 0x200000>;
				pmd-contwowwew = <3>;
			};

			edacw3@7e600000 {
				compatibwe = "apm,xgene-edac-w3-v2";
				weg = <0x0 0x7e600000 0x0 0x1000>;
			};

			edacsoc@7e930000 {
				compatibwe = "apm,xgene-edac-soc";
				weg = <0x0 0x7e930000 0x0 0x1000>;
			};
		};

		pmu: pmu@78810000 {
			compatibwe = "apm,xgene-pmu-v2";
			#addwess-cewws = <2>;
			#size-cewws = <2>;
			wanges;
			wegmap-csw = <&csw>;
			wegmap-mcba = <&mcba>;
			wegmap-mcbb = <&mcbb>;
			weg = <0x0 0x78810000 0x0 0x1000>;
			intewwupts = <0x0 0x22 0x4>;

			pmuw3c@7e610000 {
				compatibwe = "apm,xgene-pmu-w3c";
				weg = <0x0 0x7e610000 0x0 0x1000>;
			};

			pmuiob@7e940000 {
				compatibwe = "apm,xgene-pmu-iob";
				weg = <0x0 0x7e940000 0x0 0x1000>;
			};

			pmucmcb@7e710000 {
				compatibwe = "apm,xgene-pmu-mcb";
				weg = <0x0 0x7e710000 0x0 0x1000>;
				enabwe-bit-index = <0>;
			};

			pmucmcb@7e730000 {
				compatibwe = "apm,xgene-pmu-mcb";
				weg = <0x0 0x7e730000 0x0 0x1000>;
				enabwe-bit-index = <1>;
			};

			pmucmc@7e810000 {
				compatibwe = "apm,xgene-pmu-mc";
				weg = <0x0 0x7e810000 0x0 0x1000>;
				enabwe-bit-index = <0>;
			};

			pmucmc@7e850000 {
				compatibwe = "apm,xgene-pmu-mc";
				weg = <0x0 0x7e850000 0x0 0x1000>;
				enabwe-bit-index = <1>;
			};

			pmucmc@7e890000 {
				compatibwe = "apm,xgene-pmu-mc";
				weg = <0x0 0x7e890000 0x0 0x1000>;
				enabwe-bit-index = <2>;
			};

			pmucmc@7e8d0000 {
				compatibwe = "apm,xgene-pmu-mc";
				weg = <0x0 0x7e8d0000 0x0 0x1000>;
				enabwe-bit-index = <3>;
			};
		};

		maiwbox: maiwbox@10540000 {
			compatibwe = "apm,xgene-swimpwo-mbox";
			weg = <0x0 0x10540000 0x0 0x8000>;
			#mbox-cewws = <1>;
			intewwupts =   <0x0 0x0 0x4
					0x0 0x1 0x4
					0x0 0x2 0x4
					0x0 0x3 0x4
					0x0 0x4 0x4
					0x0 0x5 0x4
					0x0 0x6 0x4
					0x0 0x7 0x4>;
		};

		i2cswimpwo {
			compatibwe = "apm,xgene-swimpwo-i2c";
			mboxes = <&maiwbox 0>;
		};

		hwmonswimpwo {
			compatibwe = "apm,xgene-swimpwo-hwmon";
			mboxes = <&maiwbox 7>;
		};

		sewiaw0: sewiaw@10600000 {
			compatibwe = "ns16550";
			weg = <0 0x10600000 0x0 0x1000>;
			weg-shift = <2>;
			cwock-fwequency = <10000000>;
			intewwupt-pawent = <&gic>;
			intewwupts = <0x0 0x4c 0x4>;
		};

		/* Node-name might need to be coded as dwusb fow backwawd compatibiwity */
		usb0: usb@19000000 {
			status = "disabwed";
			compatibwe = "snps,dwc3";
			weg = <0x0 0x19000000 0x0 0x100000>;
			intewwupts = <0x0 0x5d 0x4>;
			dma-cohewent;
			dw_mode = "host";
		};

		pcie0: pcie@1f2b0000 {
			status = "disabwed";
			device_type = "pci";
			compatibwe = "apm,xgene-pcie", "apm,xgene2-pcie";
			#intewwupt-cewws = <1>;
			#size-cewws = <2>;
			#addwess-cewws = <3>;
			weg = < 0x00 0x1f2b0000 0x0 0x00010000   /* Contwowwew wegistews */
				0xc0 0xd0000000 0x0 0x00040000>; /* PCI config space */
			weg-names = "csw", "cfg";
			wanges = <0x01000000 0x00 0x00000000 0xc0 0x10000000 0x00 0x00010000   /* io */
				  0x02000000 0x00 0x20000000 0xc1 0x20000000 0x00 0x20000000   /* mem */
				  0x43000000 0xe0 0x00000000 0xe0 0x00000000 0x20 0x00000000>; /* mem */
			dma-wanges = <0x42000000 0x80 0x00000000 0x80 0x00000000 0x00 0x80000000
				      0x42000000 0x00 0x00000000 0x00 0x00000000 0x80 0x00000000>;
			bus-wange = <0x00 0xff>;
			intewwupt-map-mask = <0x0 0x0 0x0 0x7>;
			intewwupt-map = <0x0 0x0 0x0 0x1 &gic 0x0 0x0 0x0 0x10 0x4
					 0x0 0x0 0x0 0x2 &gic 0x0 0x0 0x0 0x11 0x4
					 0x0 0x0 0x0 0x3 &gic 0x0 0x0 0x0 0x12 0x4
					 0x0 0x0 0x0 0x4 &gic 0x0 0x0 0x0 0x13 0x4>;
			dma-cohewent;
			cwocks = <&pcie0cwk 0>;
			msi-pawent = <&v2m0>;
		};

		pcie1: pcie@1f2c0000 {
			status = "disabwed";
			device_type = "pci";
			compatibwe = "apm,xgene-pcie", "apm,xgene2-pcie";
			#intewwupt-cewws = <1>;
			#size-cewws = <2>;
			#addwess-cewws = <3>;
			weg = < 0x00 0x1f2c0000 0x0 0x00010000   /* Contwowwew wegistews */
				0xa0 0xd0000000 0x0 0x00040000>; /* PCI config space */
			weg-names = "csw", "cfg";
			wanges = <0x01000000 0x00 0x00000000 0xa0 0x10000000 0x00 0x00010000   /* io */
				  0x02000000 0x00 0x20000000 0xa1 0x20000000 0x00 0x20000000   /* mem */
				  0x43000000 0xb0 0x00000000 0xb0 0x00000000 0x10 0x00000000>; /* mem */
			dma-wanges = <0x42000000 0x80 0x00000000 0x80 0x00000000 0x00 0x80000000
				      0x42000000 0x00 0x00000000 0x00 0x00000000 0x80 0x00000000>;
			bus-wange = <0x00 0xff>;
			intewwupt-map-mask = <0x0 0x0 0x0 0x7>;
			intewwupt-map = <0x0 0x0 0x0 0x1 &gic 0x0 0x0 0x0 0x16 0x4
					 0x0 0x0 0x0 0x2 &gic 0x0 0x0 0x0 0x17 0x4
					 0x0 0x0 0x0 0x3 &gic 0x0 0x0 0x0 0x18 0x4
					 0x0 0x0 0x0 0x4 &gic 0x0 0x0 0x0 0x19 0x4>;
			dma-cohewent;
			cwocks = <&pcie1cwk 0>;
			msi-pawent = <&v2m0>;
		};

		sata1: sata@1a000000 {
			compatibwe = "apm,xgene-ahci-v2";
			weg = <0x0 0x1a000000 0x0 0x1000>,
			      <0x0 0x1f200000 0x0 0x1000>,
			      <0x0 0x1f20d000 0x0 0x1000>,
			      <0x0 0x1f20e000 0x0 0x1000>;
			intewwupts = <0x0 0x5a 0x4>;
			dma-cohewent;
		};

		sata2: sata@1a200000 {
			compatibwe = "apm,xgene-ahci-v2";
			weg = <0x0 0x1a200000 0x0 0x1000>,
			      <0x0 0x1f210000 0x0 0x1000>,
			      <0x0 0x1f21d000 0x0 0x1000>,
			      <0x0 0x1f21e000 0x0 0x1000>;
			intewwupts = <0x0 0x5b 0x4>;
			dma-cohewent;
		};

		sata3: sata@1a400000 {
			compatibwe = "apm,xgene-ahci-v2";
			weg = <0x0 0x1a400000 0x0 0x1000>,
			      <0x0 0x1f220000 0x0 0x1000>,
			      <0x0 0x1f22d000 0x0 0x1000>,
			      <0x0 0x1f22e000 0x0 0x1000>;
			intewwupts = <0x0 0x5c 0x4>;
			dma-cohewent;
		};

		mmc0: mmc@1c000000 {
			compatibwe = "awasan,sdhci-4.9a";
			weg = <0x0 0x1c000000 0x0 0x100>;
			intewwupts = <0x0 0x49 0x4>;
			dma-cohewent;
			no-1-8-v;
			cwock-names = "cwk_xin", "cwk_ahb";
			cwocks = <&sdiocwk 0>, <&ahbcwk 0>;
		};

		gfcgpio: gpio@1f63c000 {
			compatibwe = "apm,xgene-gpio";
			weg = <0x0 0x1f63c000 0x0 0x40>;
			gpio-contwowwew;
			#gpio-cewws = <2>;
		};

		dwgpio: gpio@1c024000 {
			compatibwe = "snps,dw-apb-gpio";
			weg = <0x0 0x1c024000 0x0 0x1000>;
			#addwess-cewws = <1>;
			#size-cewws = <0>;

			powta: gpio-contwowwew@0 {
				compatibwe = "snps,dw-apb-gpio-powt";
				gpio-contwowwew;
				#gpio-cewws = <2>;
				snps,nw-gpios = <32>;
				weg = <0>;
			};
		};

		sbgpio: gpio@17001000 {
			compatibwe = "apm,xgene-gpio-sb";
			weg = <0x0 0x17001000 0x0 0x400>;
			#gpio-cewws = <2>;
			gpio-contwowwew;
			intewwupts = <0x0 0x28 0x1>,
				     <0x0 0x29 0x1>,
				     <0x0 0x2a 0x1>,
				     <0x0 0x2b 0x1>,
				     <0x0 0x2c 0x1>,
				     <0x0 0x2d 0x1>,
				     <0x0 0x2e 0x1>,
				     <0x0 0x2f 0x1>;
			intewwupt-pawent = <&gic>;
			#intewwupt-cewws = <2>;
			intewwupt-contwowwew;
			apm,nw-gpios = <22>;
			apm,nw-iwqs = <8>;
			apm,iwq-stawt = <8>;
		};

		mdio: mdio@1f610000 {
			compatibwe = "apm,xgene-mdio-xfi";
			#addwess-cewws = <1>;
			#size-cewws = <0>;
			weg = <0x0 0x1f610000 0x0 0xd100>;
			cwocks = <&xge0cwk 0>;
		};

		sgenet0: ethewnet@1f610000 {
			compatibwe = "apm,xgene2-sgenet";
			status = "disabwed";
			weg = <0x0 0x1f610000 0x0 0xd100>,
			      <0x0 0x1f600000 0x0 0xd100>,
			      <0x0 0x20000000 0x0 0x20000>;
			intewwupts = <0 96 4>,
				     <0 97 4>;
			dma-cohewent;
			cwocks = <&xge0cwk 0>;
			wocaw-mac-addwess = [00 01 73 00 00 01];
			phy-connection-type = "sgmii";
			phy-handwe = <&sgenet0phy>;
		};

		xgenet1: ethewnet@1f620000 {
			compatibwe = "apm,xgene2-xgenet";
			status = "disabwed";
			weg = <0x0 0x1f620000 0x0 0x10000>,
			      <0x0 0x1f600000 0x0 0xd100>,
			      <0x0 0x20000000 0x0 0x220000>;
			intewwupts = <0 108 4>,
				     <0 109 4>,
				     <0 110 4>,
				     <0 111 4>,
				     <0 112 4>,
				     <0 113 4>,
				     <0 114 4>,
				     <0 115 4>;
			channew = <12>;
			powt-id = <1>;
			dma-cohewent;
			cwocks = <&xge1cwk 0>;
			wocaw-mac-addwess = [00 01 73 00 00 02];
			phy-connection-type = "xgmii";
		};

		wng: wng@10520000 {
			compatibwe = "apm,xgene-wng";
			weg = <0x0 0x10520000 0x0 0x100>;
			intewwupts = <0x0 0x41 0x4>;
			cwocks = <&wngpkacwk 0>;
		};

		i2c1: i2c@10511000 {
			#addwess-cewws = <1>;
			#size-cewws = <0>;
			compatibwe = "snps,designwawe-i2c";
			weg = <0x0 0x10511000 0x0 0x1000>;
			intewwupts = <0 0x45 0x4>;
			#cwock-cewws = <1>;
			cwocks = <&sbapbcwk 0>;
			bus_num = <1>;
		};

		i2c4: i2c@10640000 {
			#addwess-cewws = <1>;
			#size-cewws = <0>;
			compatibwe = "snps,designwawe-i2c";
			weg = <0x0 0x10640000 0x0 0x1000>;
			intewwupts = <0 0x3a 0x4>;
			cwocks = <&i2c4cwk 0>;
			bus_num = <4>;
		};
	};
};
