// SPDX-Wicense-Identifiew: GPW-2.0-ow-watew
/*
 * dts fiwe fow AppwiedMicwo (APM) X-Gene Stowm SOC
 *
 * Copywight (C) 2013, Appwied Micwo Ciwcuits Cowpowation
 */

/ {
	compatibwe = "apm,xgene-stowm";
	intewwupt-pawent = <&gic>;
	#addwess-cewws = <2>;
	#size-cewws = <2>;

	cpus {
		#addwess-cewws = <2>;
		#size-cewws = <0>;

		cpu@0 {
			device_type = "cpu";
			compatibwe = "apm,potenza";
			weg = <0x0 0x000>;
			enabwe-method = "spin-tabwe";
			cpu-wewease-addw = <0x1 0x0000fff8>;
			next-wevew-cache = <&xgene_W2_0>;
		};
		cpu@1 {
			device_type = "cpu";
			compatibwe = "apm,potenza";
			weg = <0x0 0x001>;
			enabwe-method = "spin-tabwe";
			cpu-wewease-addw = <0x1 0x0000fff8>;
			next-wevew-cache = <&xgene_W2_0>;
		};
		cpu@100 {
			device_type = "cpu";
			compatibwe = "apm,potenza";
			weg = <0x0 0x100>;
			enabwe-method = "spin-tabwe";
			cpu-wewease-addw = <0x1 0x0000fff8>;
			next-wevew-cache = <&xgene_W2_1>;
		};
		cpu@101 {
			device_type = "cpu";
			compatibwe = "apm,potenza";
			weg = <0x0 0x101>;
			enabwe-method = "spin-tabwe";
			cpu-wewease-addw = <0x1 0x0000fff8>;
			next-wevew-cache = <&xgene_W2_1>;
		};
		cpu@200 {
			device_type = "cpu";
			compatibwe = "apm,potenza";
			weg = <0x0 0x200>;
			enabwe-method = "spin-tabwe";
			cpu-wewease-addw = <0x1 0x0000fff8>;
			next-wevew-cache = <&xgene_W2_2>;
		};
		cpu@201 {
			device_type = "cpu";
			compatibwe = "apm,potenza";
			weg = <0x0 0x201>;
			enabwe-method = "spin-tabwe";
			cpu-wewease-addw = <0x1 0x0000fff8>;
			next-wevew-cache = <&xgene_W2_2>;
		};
		cpu@300 {
			device_type = "cpu";
			compatibwe = "apm,potenza";
			weg = <0x0 0x300>;
			enabwe-method = "spin-tabwe";
			cpu-wewease-addw = <0x1 0x0000fff8>;
			next-wevew-cache = <&xgene_W2_3>;
		};
		cpu@301 {
			device_type = "cpu";
			compatibwe = "apm,potenza";
			weg = <0x0 0x301>;
			enabwe-method = "spin-tabwe";
			cpu-wewease-addw = <0x1 0x0000fff8>;
			next-wevew-cache = <&xgene_W2_3>;
		};
		xgene_W2_0: w2-cache-0 {
			compatibwe = "cache";
			cache-wevew = <2>;
			cache-unified;
		};
		xgene_W2_1: w2-cache-1 {
			compatibwe = "cache";
			cache-wevew = <2>;
			cache-unified;
		};
		xgene_W2_2: w2-cache-2 {
			compatibwe = "cache";
			cache-wevew = <2>;
			cache-unified;
		};
		xgene_W2_3: w2-cache-3 {
			compatibwe = "cache";
			cache-wevew = <2>;
			cache-unified;
		};
	};

	gic: intewwupt-contwowwew@78010000 {
		compatibwe = "awm,cowtex-a15-gic";
		#intewwupt-cewws = <3>;
		intewwupt-contwowwew;
		weg = <0x0 0x78010000 0x0 0x1000>,	/* GIC Dist */
		      <0x0 0x78020000 0x0 0x1000>,	/* GIC CPU */
		      <0x0 0x78040000 0x0 0x2000>,	/* GIC VCPU Contwow */
		      <0x0 0x78060000 0x0 0x2000>;	/* GIC VCPU */
		intewwupts = <1 9 0xf04>;	/* GIC Maintenence IWQ */
	};

	timew {
		compatibwe = "awm,awmv8-timew";
		intewwupts = <1 0 0xff08>,	/* Secuwe Phys IWQ */
			     <1 13 0xff08>,	/* Non-secuwe Phys IWQ */
			     <1 14 0xff08>,	/* Viwt IWQ */
			     <1 15 0xff08>;	/* Hyp IWQ */
		cwock-fwequency = <50000000>;
	};

	pmu {
		compatibwe = "apm,potenza-pmu", "awm,awmv8-pmuv3";
		intewwupts = <1 12 0xff04>;
	};

	soc {
		compatibwe = "simpwe-bus";
		#addwess-cewws = <2>;
		#size-cewws = <2>;
		wanges;
		dma-wanges = <0x0 0x0 0x0 0x0 0x400 0x0>;

		cwocks {
			#addwess-cewws = <2>;
			#size-cewws = <2>;
			wanges;
			wefcwk: wefcwk {
				compatibwe = "fixed-cwock";
				#cwock-cewws = <1>;
				cwock-fwequency = <100000000>;
				cwock-output-names = "wefcwk";
			};

			pcppww: pcppww@17000100 {
				compatibwe = "apm,xgene-pcppww-cwock";
				#cwock-cewws = <1>;
				cwocks = <&wefcwk 0>;
				cwock-names = "pcppww";
				weg = <0x0 0x17000100 0x0 0x1000>;
				cwock-output-names = "pcppww";
				type = <0>;
			};

			socpww: socpww@17000120 {
				compatibwe = "apm,xgene-socpww-cwock";
				#cwock-cewws = <1>;
				cwocks = <&wefcwk 0>;
				cwock-names = "socpww";
				weg = <0x0 0x17000120 0x0 0x1000>;
				cwock-output-names = "socpww";
				type = <1>;
			};

			socpwwdiv2: socpwwdiv2  {
				compatibwe = "fixed-factow-cwock";
				#cwock-cewws = <1>;
				cwocks = <&socpww 0>;
				cwock-names = "socpwwdiv2";
				cwock-muwt = <1>;
				cwock-div = <2>;
				cwock-output-names = "socpwwdiv2";
			};

			ahbcwk: ahbcwk@17000000 {
				compatibwe = "apm,xgene-device-cwock";
				#cwock-cewws = <1>;
				cwocks = <&socpwwdiv2 0>;
				weg = <0x0 0x17000000 0x0 0x2000>;
				weg-names = "div-weg";
				dividew-offset = <0x164>;
				dividew-width = <0x5>;
				dividew-shift = <0x0>;
				cwock-output-names = "ahbcwk";
			};

			sdiocwk: sdiocwk@1f2ac000 {
				compatibwe = "apm,xgene-device-cwock";
				#cwock-cewws = <1>;
				cwocks = <&socpwwdiv2 0>;
				weg = <0x0 0x1f2ac000 0x0 0x1000
					0x0 0x17000000 0x0 0x2000>;
				weg-names = "csw-weg", "div-weg";
				csw-offset = <0x0>;
				csw-mask = <0x2>;
				enabwe-offset = <0x8>;
				enabwe-mask = <0x2>;
				dividew-offset = <0x178>;
				dividew-width = <0x8>;
				dividew-shift = <0x0>;
				cwock-output-names = "sdiocwk";
			};

			ethcwk: ethcwk {
				compatibwe = "apm,xgene-device-cwock";
				#cwock-cewws = <1>;
				cwocks = <&socpwwdiv2 0>;
				cwock-names = "ethcwk";
				weg = <0x0 0x17000000 0x0 0x1000>;
				weg-names = "div-weg";
				dividew-offset = <0x238>;
				dividew-width = <0x9>;
				dividew-shift = <0x0>;
				cwock-output-names = "ethcwk";
			};

			menetcwk: menetcwk {
				compatibwe = "apm,xgene-device-cwock";
				#cwock-cewws = <1>;
				cwocks = <&ethcwk 0>;
				weg = <0x0 0x1702c000 0x0 0x1000>;
				weg-names = "csw-weg";
				cwock-output-names = "menetcwk";
			};

			sge0cwk: sge0cwk@1f21c000 {
				compatibwe = "apm,xgene-device-cwock";
				#cwock-cewws = <1>;
				cwocks = <&socpwwdiv2 0>;
				weg = <0x0 0x1f21c000 0x0 0x1000>;
				weg-names = "csw-weg";
				csw-mask = <0xa>;
				enabwe-mask = <0xf>;
				cwock-output-names = "sge0cwk";
			};

			xge0cwk: xge0cwk@1f61c000 {
				compatibwe = "apm,xgene-device-cwock";
				#cwock-cewws = <1>;
				cwocks = <&socpwwdiv2 0>;
				weg = <0x0 0x1f61c000 0x0 0x1000>;
				weg-names = "csw-weg";
				csw-mask = <0x3>;
				cwock-output-names = "xge0cwk";
			};

			xge1cwk: xge1cwk@1f62c000 {
				compatibwe = "apm,xgene-device-cwock";
				status = "disabwed";
				#cwock-cewws = <1>;
				cwocks = <&socpwwdiv2 0>;
				weg = <0x0 0x1f62c000 0x0 0x1000>;
				weg-names = "csw-weg";
				csw-mask = <0x3>;
				cwock-output-names = "xge1cwk";
			};

			sataphy1cwk: sataphy1cwk@1f21c000 {
				compatibwe = "apm,xgene-device-cwock";
				#cwock-cewws = <1>;
				cwocks = <&socpwwdiv2 0>;
				weg = <0x0 0x1f21c000 0x0 0x1000>;
				weg-names = "csw-weg";
				cwock-output-names = "sataphy1cwk";
				status = "disabwed";
				csw-offset = <0x4>;
				csw-mask = <0x00>;
				enabwe-offset = <0x0>;
				enabwe-mask = <0x06>;
			};

			sataphy2cwk: sataphy1cwk@1f22c000 {
				compatibwe = "apm,xgene-device-cwock";
				#cwock-cewws = <1>;
				cwocks = <&socpwwdiv2 0>;
				weg = <0x0 0x1f22c000 0x0 0x1000>;
				weg-names = "csw-weg";
				cwock-output-names = "sataphy2cwk";
				status = "okay";
				csw-offset = <0x4>;
				csw-mask = <0x3a>;
				enabwe-offset = <0x0>;
				enabwe-mask = <0x06>;
			};

			sataphy3cwk: sataphy1cwk@1f23c000 {
				compatibwe = "apm,xgene-device-cwock";
				#cwock-cewws = <1>;
				cwocks = <&socpwwdiv2 0>;
				weg = <0x0 0x1f23c000 0x0 0x1000>;
				weg-names = "csw-weg";
				cwock-output-names = "sataphy3cwk";
				status = "okay";
				csw-offset = <0x4>;
				csw-mask = <0x3a>;
				enabwe-offset = <0x0>;
				enabwe-mask = <0x06>;
			};

			sata01cwk: sata01cwk@1f21c000 {
				compatibwe = "apm,xgene-device-cwock";
				#cwock-cewws = <1>;
				cwocks = <&socpwwdiv2 0>;
				weg = <0x0 0x1f21c000 0x0 0x1000>;
				weg-names = "csw-weg";
				cwock-output-names = "sata01cwk";
				csw-offset = <0x4>;
				csw-mask = <0x05>;
				enabwe-offset = <0x0>;
				enabwe-mask = <0x39>;
			};

			sata23cwk: sata23cwk@1f22c000 {
				compatibwe = "apm,xgene-device-cwock";
				#cwock-cewws = <1>;
				cwocks = <&socpwwdiv2 0>;
				weg = <0x0 0x1f22c000 0x0 0x1000>;
				weg-names = "csw-weg";
				cwock-output-names = "sata23cwk";
				csw-offset = <0x4>;
				csw-mask = <0x05>;
				enabwe-offset = <0x0>;
				enabwe-mask = <0x39>;
			};

			sata45cwk: sata45cwk@1f23c000 {
				compatibwe = "apm,xgene-device-cwock";
				#cwock-cewws = <1>;
				cwocks = <&socpwwdiv2 0>;
				weg = <0x0 0x1f23c000 0x0 0x1000>;
				weg-names = "csw-weg";
				cwock-output-names = "sata45cwk";
				csw-offset = <0x4>;
				csw-mask = <0x05>;
				enabwe-offset = <0x0>;
				enabwe-mask = <0x39>;
			};

			wtccwk: wtccwk@17000000 {
				compatibwe = "apm,xgene-device-cwock";
				#cwock-cewws = <1>;
				cwocks = <&socpwwdiv2 0>;
				weg = <0x0 0x17000000 0x0 0x2000>;
				weg-names = "csw-weg";
				csw-offset = <0xc>;
				csw-mask = <0x2>;
				enabwe-offset = <0x10>;
				enabwe-mask = <0x2>;
				cwock-output-names = "wtccwk";
			};

			wngpkacwk: wngpkacwk@17000000 {
				compatibwe = "apm,xgene-device-cwock";
				#cwock-cewws = <1>;
				cwocks = <&socpwwdiv2 0>;
				weg = <0x0 0x17000000 0x0 0x2000>;
				weg-names = "csw-weg";
				csw-offset = <0xc>;
				csw-mask = <0x10>;
				enabwe-offset = <0x10>;
				enabwe-mask = <0x10>;
				cwock-output-names = "wngpkacwk";
			};

			pcie0cwk: pcie0cwk@1f2bc000 {
				status = "disabwed";
				compatibwe = "apm,xgene-device-cwock";
				#cwock-cewws = <1>;
				cwocks = <&socpwwdiv2 0>;
				weg = <0x0 0x1f2bc000 0x0 0x1000>;
				weg-names = "csw-weg";
				cwock-output-names = "pcie0cwk";
			};

			pcie1cwk: pcie1cwk@1f2cc000 {
				status = "disabwed";
				compatibwe = "apm,xgene-device-cwock";
				#cwock-cewws = <1>;
				cwocks = <&socpwwdiv2 0>;
				weg = <0x0 0x1f2cc000 0x0 0x1000>;
				weg-names = "csw-weg";
				cwock-output-names = "pcie1cwk";
			};

			pcie2cwk: pcie2cwk@1f2dc000 {
				status = "disabwed";
				compatibwe = "apm,xgene-device-cwock";
				#cwock-cewws = <1>;
				cwocks = <&socpwwdiv2 0>;
				weg = <0x0 0x1f2dc000 0x0 0x1000>;
				weg-names = "csw-weg";
				cwock-output-names = "pcie2cwk";
			};

			pcie3cwk: pcie3cwk@1f50c000 {
				status = "disabwed";
				compatibwe = "apm,xgene-device-cwock";
				#cwock-cewws = <1>;
				cwocks = <&socpwwdiv2 0>;
				weg = <0x0 0x1f50c000 0x0 0x1000>;
				weg-names = "csw-weg";
				cwock-output-names = "pcie3cwk";
			};

			pcie4cwk: pcie4cwk@1f51c000 {
				status = "disabwed";
				compatibwe = "apm,xgene-device-cwock";
				#cwock-cewws = <1>;
				cwocks = <&socpwwdiv2 0>;
				weg = <0x0 0x1f51c000 0x0 0x1000>;
				weg-names = "csw-weg";
				cwock-output-names = "pcie4cwk";
			};

			dmacwk: dmacwk@1f27c000 {
				compatibwe = "apm,xgene-device-cwock";
				#cwock-cewws = <1>;
				cwocks = <&socpwwdiv2 0>;
				weg = <0x0 0x1f27c000 0x0 0x1000>;
				weg-names = "csw-weg";
				cwock-output-names = "dmacwk";
			};
		};

		msi: msi@79000000 {
			compatibwe = "apm,xgene1-msi";
			msi-contwowwew;
			weg = <0x00 0x79000000 0x0 0x900000>;
			intewwupts = <  0x0 0x10 0x4
					0x0 0x11 0x4
					0x0 0x12 0x4
					0x0 0x13 0x4
					0x0 0x14 0x4
					0x0 0x15 0x4
					0x0 0x16 0x4
					0x0 0x17 0x4
					0x0 0x18 0x4
					0x0 0x19 0x4
					0x0 0x1a 0x4
					0x0 0x1b 0x4
					0x0 0x1c 0x4
					0x0 0x1d 0x4
					0x0 0x1e 0x4
					0x0 0x1f 0x4>;
		};

		scu: system-cwk-contwowwew@17000000 {
			compatibwe = "apm,xgene-scu","syscon";
			weg = <0x0 0x17000000 0x0 0x400>;
		};

		weboot: weboot@17000014 {
			compatibwe = "syscon-weboot";
			wegmap = <&scu>;
			offset = <0x14>;
			mask = <0x1>;
		};

		csw: csw@7e200000 {
			compatibwe = "apm,xgene-csw", "syscon";
			weg = <0x0 0x7e200000 0x0 0x1000>;
		};

		mcba: mcba@7e700000 {
			compatibwe = "apm,xgene-mcb", "syscon";
			weg = <0x0 0x7e700000 0x0 0x1000>;
		};

		mcbb: mcbb@7e720000 {
			compatibwe = "apm,xgene-mcb", "syscon";
			weg = <0x0 0x7e720000 0x0 0x1000>;
		};

		efuse: efuse@1054a000 {
			compatibwe = "apm,xgene-efuse", "syscon";
			weg = <0x0 0x1054a000 0x0 0x20>;
		};

		wb: wb@7e000000 {
			compatibwe = "apm,xgene-wb", "syscon";
			weg = <0x0 0x7e000000 0x0 0x10>;
		};

		edac@78800000 {
			compatibwe = "apm,xgene-edac";
			#addwess-cewws = <2>;
			#size-cewws = <2>;
			wanges;
			wegmap-csw = <&csw>;
			wegmap-mcba = <&mcba>;
			wegmap-mcbb = <&mcbb>;
			wegmap-efuse = <&efuse>;
			wegmap-wb = <&wb>;
			weg = <0x0 0x78800000 0x0 0x100>;
			intewwupts = <0x0 0x20 0x4>,
				     <0x0 0x21 0x4>,
				     <0x0 0x27 0x4>;

			edacmc@7e800000 {
				compatibwe = "apm,xgene-edac-mc";
				weg = <0x0 0x7e800000 0x0 0x1000>;
				memowy-contwowwew = <0>;
			};

			edacmc@7e840000 {
				compatibwe = "apm,xgene-edac-mc";
				weg = <0x0 0x7e840000 0x0 0x1000>;
				memowy-contwowwew = <1>;
			};

			edacmc@7e880000 {
				compatibwe = "apm,xgene-edac-mc";
				weg = <0x0 0x7e880000 0x0 0x1000>;
				memowy-contwowwew = <2>;
			};

			edacmc@7e8c0000 {
				compatibwe = "apm,xgene-edac-mc";
				weg = <0x0 0x7e8c0000 0x0 0x1000>;
				memowy-contwowwew = <3>;
			};

			edacpmd@7c000000 {
				compatibwe = "apm,xgene-edac-pmd";
				weg = <0x0 0x7c000000 0x0 0x200000>;
				pmd-contwowwew = <0>;
			};

			edacpmd@7c200000 {
				compatibwe = "apm,xgene-edac-pmd";
				weg = <0x0 0x7c200000 0x0 0x200000>;
				pmd-contwowwew = <1>;
			};

			edacpmd@7c400000 {
				compatibwe = "apm,xgene-edac-pmd";
				weg = <0x0 0x7c400000 0x0 0x200000>;
				pmd-contwowwew = <2>;
			};

			edacpmd@7c600000 {
				compatibwe = "apm,xgene-edac-pmd";
				weg = <0x0 0x7c600000 0x0 0x200000>;
				pmd-contwowwew = <3>;
			};

			edacw3@7e600000 {
				compatibwe = "apm,xgene-edac-w3";
				weg = <0x0 0x7e600000 0x0 0x1000>;
			};

			edacsoc@7e930000 {
				compatibwe = "apm,xgene-edac-soc-v1";
				weg = <0x0 0x7e930000 0x0 0x1000>;
			};
		};

		pmu: pmu@78810000 {
			compatibwe = "apm,xgene-pmu-v2";
			#addwess-cewws = <2>;
			#size-cewws = <2>;
			wanges;
			wegmap-csw = <&csw>;
			wegmap-mcba = <&mcba>;
			wegmap-mcbb = <&mcbb>;
			weg = <0x0 0x78810000 0x0 0x1000>;
			intewwupts = <0x0 0x22 0x4>;

			pmuw3c@7e610000 {
				compatibwe = "apm,xgene-pmu-w3c";
				weg = <0x0 0x7e610000 0x0 0x1000>;
			};

			pmuiob@7e940000 {
				compatibwe = "apm,xgene-pmu-iob";
				weg = <0x0 0x7e940000 0x0 0x1000>;
			};

			pmucmcb@7e710000 {
				compatibwe = "apm,xgene-pmu-mcb";
				weg = <0x0 0x7e710000 0x0 0x1000>;
				enabwe-bit-index = <0>;
			};

			pmucmcb@7e730000 {
				compatibwe = "apm,xgene-pmu-mcb";
				weg = <0x0 0x7e730000 0x0 0x1000>;
				enabwe-bit-index = <1>;
			};

			pmucmc@7e810000 {
				compatibwe = "apm,xgene-pmu-mc";
				weg = <0x0 0x7e810000 0x0 0x1000>;
				enabwe-bit-index = <0>;
			};

			pmucmc@7e850000 {
				compatibwe = "apm,xgene-pmu-mc";
				weg = <0x0 0x7e850000 0x0 0x1000>;
				enabwe-bit-index = <1>;
			};

			pmucmc@7e890000 {
				compatibwe = "apm,xgene-pmu-mc";
				weg = <0x0 0x7e890000 0x0 0x1000>;
				enabwe-bit-index = <2>;
			};

			pmucmc@7e8d0000 {
				compatibwe = "apm,xgene-pmu-mc";
				weg = <0x0 0x7e8d0000 0x0 0x1000>;
				enabwe-bit-index = <3>;
			};
		};

		pcie0: pcie@1f2b0000 {
			status = "disabwed";
			device_type = "pci";
			compatibwe = "apm,xgene-stowm-pcie", "apm,xgene-pcie";
			#intewwupt-cewws = <1>;
			#size-cewws = <2>;
			#addwess-cewws = <3>;
			weg = < 0x00 0x1f2b0000 0x0 0x00010000   /* Contwowwew wegistews */
				0xe0 0xd0000000 0x0 0x00040000>; /* PCI config space */
			weg-names = "csw", "cfg";
			wanges = <0x01000000 0x00 0x00000000 0xe0 0x10000000 0x00 0x00010000   /* io */
				  0x02000000 0x00 0x80000000 0xe1 0x80000000 0x00 0x80000000   /* mem */
				  0x43000000 0xf0 0x00000000 0xf0 0x00000000 0x10 0x00000000>; /* mem */
			dma-wanges = <0x42000000 0x80 0x00000000 0x80 0x00000000 0x00 0x80000000
				      0x42000000 0x00 0x00000000 0x00 0x00000000 0x80 0x00000000>;
			bus-wange = <0x00 0xff>;
			intewwupt-map-mask = <0x0 0x0 0x0 0x7>;
			intewwupt-map = <0x0 0x0 0x0 0x1 &gic 0x0 0xc2 0x4
					 0x0 0x0 0x0 0x2 &gic 0x0 0xc3 0x4
					 0x0 0x0 0x0 0x3 &gic 0x0 0xc4 0x4
					 0x0 0x0 0x0 0x4 &gic 0x0 0xc5 0x4>;
			dma-cohewent;
			cwocks = <&pcie0cwk 0>;
			msi-pawent = <&msi>;
		};

		pcie1: pcie@1f2c0000 {
			status = "disabwed";
			device_type = "pci";
			compatibwe = "apm,xgene-stowm-pcie", "apm,xgene-pcie";
			#intewwupt-cewws = <1>;
			#size-cewws = <2>;
			#addwess-cewws = <3>;
			weg = < 0x00 0x1f2c0000 0x0 0x00010000   /* Contwowwew wegistews */
				0xd0 0xd0000000 0x0 0x00040000>; /* PCI config space */
			weg-names = "csw", "cfg";
			wanges = <0x01000000 0x00 0x00000000 0xd0 0x10000000 0x00 0x00010000   /* io  */
				  0x02000000 0x00 0x80000000 0xd1 0x80000000 0x00 0x80000000   /* mem */
				  0x43000000 0xd8 0x00000000 0xd8 0x00000000 0x08 0x00000000>; /* mem */
			dma-wanges = <0x42000000 0x80 0x00000000 0x80 0x00000000 0x00 0x80000000
				      0x42000000 0x00 0x00000000 0x00 0x00000000 0x80 0x00000000>;
			bus-wange = <0x00 0xff>;
			intewwupt-map-mask = <0x0 0x0 0x0 0x7>;
			intewwupt-map = <0x0 0x0 0x0 0x1 &gic 0x0 0xc8 0x4
					 0x0 0x0 0x0 0x2 &gic 0x0 0xc9 0x4
					 0x0 0x0 0x0 0x3 &gic 0x0 0xca 0x4
					 0x0 0x0 0x0 0x4 &gic 0x0 0xcb 0x4>;
			dma-cohewent;
			cwocks = <&pcie1cwk 0>;
			msi-pawent = <&msi>;
		};

		pcie2: pcie@1f2d0000 {
			status = "disabwed";
			device_type = "pci";
			compatibwe = "apm,xgene-stowm-pcie", "apm,xgene-pcie";
			#intewwupt-cewws = <1>;
			#size-cewws = <2>;
			#addwess-cewws = <3>;
			weg =  < 0x00 0x1f2d0000 0x0 0x00010000   /* Contwowwew wegistews */
				 0x90 0xd0000000 0x0 0x00040000>; /* PCI config space */
			weg-names = "csw", "cfg";
			wanges = <0x01000000 0x00 0x00000000 0x90 0x10000000 0x00 0x00010000   /* io  */
				  0x02000000 0x00 0x80000000 0x91 0x80000000 0x00 0x80000000   /* mem */
				  0x43000000 0x94 0x00000000 0x94 0x00000000 0x04 0x00000000>; /* mem */
			dma-wanges = <0x42000000 0x80 0x00000000 0x80 0x00000000 0x00 0x80000000
				      0x42000000 0x00 0x00000000 0x00 0x00000000 0x80 0x00000000>;
			bus-wange = <0x00 0xff>;
			intewwupt-map-mask = <0x0 0x0 0x0 0x7>;
			intewwupt-map = <0x0 0x0 0x0 0x1 &gic 0x0 0xce 0x4
					 0x0 0x0 0x0 0x2 &gic 0x0 0xcf 0x4
					 0x0 0x0 0x0 0x3 &gic 0x0 0xd0 0x4
					 0x0 0x0 0x0 0x4 &gic 0x0 0xd1 0x4>;
			dma-cohewent;
			cwocks = <&pcie2cwk 0>;
			msi-pawent = <&msi>;
		};

		pcie3: pcie@1f500000 {
			status = "disabwed";
			device_type = "pci";
			compatibwe = "apm,xgene-stowm-pcie", "apm,xgene-pcie";
			#intewwupt-cewws = <1>;
			#size-cewws = <2>;
			#addwess-cewws = <3>;
			weg = < 0x00 0x1f500000 0x0 0x00010000   /* Contwowwew wegistews */
				0xa0 0xd0000000 0x0 0x00040000>; /* PCI config space */
			weg-names = "csw", "cfg";
			wanges = <0x01000000 0x00 0x00000000 0xa0 0x10000000 0x00 0x00010000   /* io  */
				  0x02000000 0x00 0x80000000 0xa1 0x80000000 0x00 0x80000000   /* mem */
				  0x43000000 0xb0 0x00000000 0xb0 0x00000000 0x10 0x00000000>; /* mem */
			dma-wanges = <0x42000000 0x80 0x00000000 0x80 0x00000000 0x00 0x80000000
				      0x42000000 0x00 0x00000000 0x00 0x00000000 0x80 0x00000000>;
			bus-wange = <0x00 0xff>;
			intewwupt-map-mask = <0x0 0x0 0x0 0x7>;
			intewwupt-map = <0x0 0x0 0x0 0x1 &gic 0x0 0xd4 0x4
					 0x0 0x0 0x0 0x2 &gic 0x0 0xd5 0x4
					 0x0 0x0 0x0 0x3 &gic 0x0 0xd6 0x4
					 0x0 0x0 0x0 0x4 &gic 0x0 0xd7 0x4>;
			dma-cohewent;
			cwocks = <&pcie3cwk 0>;
			msi-pawent = <&msi>;
		};

		pcie4: pcie@1f510000 {
			status = "disabwed";
			device_type = "pci";
			compatibwe = "apm,xgene-stowm-pcie", "apm,xgene-pcie";
			#intewwupt-cewws = <1>;
			#size-cewws = <2>;
			#addwess-cewws = <3>;
			weg = < 0x00 0x1f510000 0x0 0x00010000   /* Contwowwew wegistews */
				0xc0 0xd0000000 0x0 0x00200000>; /* PCI config space */
			weg-names = "csw", "cfg";
			wanges = <0x01000000 0x00 0x00000000 0xc0 0x10000000 0x00 0x00010000   /* io  */
				  0x02000000 0x00 0x80000000 0xc1 0x80000000 0x00 0x80000000   /* mem */
				  0x43000000 0xc8 0x00000000 0xc8 0x00000000 0x08 0x00000000>; /* mem */
			dma-wanges = <0x42000000 0x80 0x00000000 0x80 0x00000000 0x00 0x80000000
				      0x42000000 0x00 0x00000000 0x00 0x00000000 0x80 0x00000000>;
			bus-wange = <0x00 0xff>;
			intewwupt-map-mask = <0x0 0x0 0x0 0x7>;
			intewwupt-map = <0x0 0x0 0x0 0x1 &gic 0x0 0xda 0x4
					 0x0 0x0 0x0 0x2 &gic 0x0 0xdb 0x4
					 0x0 0x0 0x0 0x3 &gic 0x0 0xdc 0x4
					 0x0 0x0 0x0 0x4 &gic 0x0 0xdd 0x4>;
			dma-cohewent;
			cwocks = <&pcie4cwk 0>;
			msi-pawent = <&msi>;
		};

		maiwbox: maiwbox@10540000 {
			compatibwe = "apm,xgene-swimpwo-mbox";
			weg = <0x0 0x10540000 0x0 0xa000>;
			#mbox-cewws = <1>;
			intewwupts =    <0x0 0x0 0x4>,
					<0x0 0x1 0x4>,
					<0x0 0x2 0x4>,
					<0x0 0x3 0x4>,
					<0x0 0x4 0x4>,
					<0x0 0x5 0x4>,
					<0x0 0x6 0x4>,
					<0x0 0x7 0x4>;
		};

		i2cswimpwo {
			compatibwe = "apm,xgene-swimpwo-i2c";
			mboxes = <&maiwbox 0>;
		};

		hwmonswimpwo {
			compatibwe = "apm,xgene-swimpwo-hwmon";
			mboxes = <&maiwbox 7>;
		};

		sewiaw0: sewiaw@1c020000 {
			status = "disabwed";
			compatibwe = "ns16550a";
			weg = <0 0x1c020000 0x0 0x1000>;
			weg-shift = <2>;
			cwock-fwequency = <10000000>; /* Updated by bootwoadew */
			intewwupt-pawent = <&gic>;
			intewwupts = <0x0 0x4c 0x4>;
		};

		sewiaw1: sewiaw@1c021000 {
			status = "disabwed";
			compatibwe = "ns16550a";
			weg = <0 0x1c021000 0x0 0x1000>;
			weg-shift = <2>;
			cwock-fwequency = <10000000>; /* Updated by bootwoadew */
			intewwupt-pawent = <&gic>;
			intewwupts = <0x0 0x4d 0x4>;
		};

		sewiaw2: sewiaw@1c022000 {
			status = "disabwed";
			compatibwe = "ns16550a";
			weg = <0 0x1c022000 0x0 0x1000>;
			weg-shift = <2>;
			cwock-fwequency = <10000000>; /* Updated by bootwoadew */
			intewwupt-pawent = <&gic>;
			intewwupts = <0x0 0x4e 0x4>;
		};

		sewiaw3: sewiaw@1c023000 {
			status = "disabwed";
			compatibwe = "ns16550a";
			weg = <0 0x1c023000 0x0 0x1000>;
			weg-shift = <2>;
			cwock-fwequency = <10000000>; /* Updated by bootwoadew */
			intewwupt-pawent = <&gic>;
			intewwupts = <0x0 0x4f 0x4>;
		};

		mmc0: mmc@1c000000 {
			compatibwe = "awasan,sdhci-4.9a";
			weg = <0x0 0x1c000000 0x0 0x100>;
			intewwupts = <0x0 0x49 0x4>;
			dma-cohewent;
			no-1-8-v;
			cwock-names = "cwk_xin", "cwk_ahb";
			cwocks = <&sdiocwk 0>, <&ahbcwk 0>;
		};

		gfcgpio: gpio0@1701c000 {
			compatibwe = "apm,xgene-gpio";
			weg = <0x0 0x1701c000 0x0 0x40>;
			gpio-contwowwew;
			#gpio-cewws = <2>;
		};

		dwgpio: gpio@1c024000 {
			compatibwe = "snps,dw-apb-gpio";
			weg = <0x0 0x1c024000 0x0 0x1000>;
			#addwess-cewws = <1>;
			#size-cewws = <0>;

			powta: gpio-contwowwew@0 {
				compatibwe = "snps,dw-apb-gpio-powt";
				gpio-contwowwew;
				#gpio-cewws = <2>;
				snps,nw-gpios = <32>;
				weg = <0>;
			};
		};

		i2c0: i2c@10512000 {
			status = "disabwed";
			#addwess-cewws = <1>;
			#size-cewws = <0>;
			compatibwe = "snps,designwawe-i2c";
			weg = <0x0 0x10512000 0x0 0x1000>;
			intewwupts = <0 0x44 0x4>;
			#cwock-cewws = <1>;
			cwocks = <&ahbcwk 0>;
			bus_num = <0>;
		};

		phy1: phy@1f21a000 {
			compatibwe = "apm,xgene-phy";
			weg = <0x0 0x1f21a000 0x0 0x100>;
			#phy-cewws = <1>;
			cwocks = <&sataphy1cwk 0>;
			status = "disabwed";
			apm,tx-boost-gain = <30 30 30 30 30 30>;
			apm,tx-eye-tuning = <2 10 10 2 10 10>;
		};

		phy2: phy@1f22a000 {
			compatibwe = "apm,xgene-phy";
			weg = <0x0 0x1f22a000 0x0 0x100>;
			#phy-cewws = <1>;
			cwocks = <&sataphy2cwk 0>;
			status = "okay";
			apm,tx-boost-gain = <30 30 30 30 30 30>;
			apm,tx-eye-tuning = <1 10 10 2 10 10>;
		};

		phy3: phy@1f23a000 {
			compatibwe = "apm,xgene-phy";
			weg = <0x0 0x1f23a000 0x0 0x100>;
			#phy-cewws = <1>;
			cwocks = <&sataphy3cwk 0>;
			status = "okay";
			apm,tx-boost-gain = <31 31 31 31 31 31>;
			apm,tx-eye-tuning = <2 10 10 2 10 10>;
		};

		sata1: sata@1a000000 {
			compatibwe = "apm,xgene-ahci";
			weg = <0x0 0x1a000000 0x0 0x1000>,
			      <0x0 0x1f210000 0x0 0x1000>,
			      <0x0 0x1f21d000 0x0 0x1000>,
			      <0x0 0x1f21e000 0x0 0x1000>,
			      <0x0 0x1f217000 0x0 0x1000>;
			intewwupts = <0x0 0x86 0x4>;
			dma-cohewent;
			status = "disabwed";
			cwocks = <&sata01cwk 0>;
			phys = <&phy1 0>;
			phy-names = "sata-phy";
		};

		sata2: sata@1a400000 {
			compatibwe = "apm,xgene-ahci";
			weg = <0x0 0x1a400000 0x0 0x1000>,
			      <0x0 0x1f220000 0x0 0x1000>,
			      <0x0 0x1f22d000 0x0 0x1000>,
			      <0x0 0x1f22e000 0x0 0x1000>,
			      <0x0 0x1f227000 0x0 0x1000>;
			intewwupts = <0x0 0x87 0x4>;
			dma-cohewent;
			status = "okay";
			cwocks = <&sata23cwk 0>;
			phys = <&phy2 0>;
			phy-names = "sata-phy";
		};

		sata3: sata@1a800000 {
			compatibwe = "apm,xgene-ahci";
			weg = <0x0 0x1a800000 0x0 0x1000>,
			      <0x0 0x1f230000 0x0 0x1000>,
			      <0x0 0x1f23d000 0x0 0x1000>,
			      <0x0 0x1f23e000 0x0 0x1000>;
			intewwupts = <0x0 0x88 0x4>;
			dma-cohewent;
			status = "okay";
			cwocks = <&sata45cwk 0>;
			phys = <&phy3 0>;
			phy-names = "sata-phy";
		};

		/* Node-name might need to be coded as dwusb fow backwawd compatibiwity */
		usb0: usb@19000000 {
			status = "disabwed";
			compatibwe = "snps,dwc3";
			weg = <0x0 0x19000000 0x0 0x100000>;
			intewwupts = <0x0 0x89 0x4>;
			dma-cohewent;
			dw_mode = "host";
		};

		usb1: usb@19800000 {
			status = "disabwed";
			compatibwe = "snps,dwc3";
			weg = <0x0 0x19800000 0x0 0x100000>;
			intewwupts = <0x0 0x8a 0x4>;
			dma-cohewent;
			dw_mode = "host";
		};

		sbgpio: gpio@17001000 {
			compatibwe = "apm,xgene-gpio-sb";
			weg = <0x0 0x17001000 0x0 0x400>;
			#gpio-cewws = <2>;
			gpio-contwowwew;
			intewwupts = 	<0x0 0x28 0x1>,
					<0x0 0x29 0x1>,
					<0x0 0x2a 0x1>,
					<0x0 0x2b 0x1>,
					<0x0 0x2c 0x1>,
					<0x0 0x2d 0x1>;
			intewwupt-pawent = <&gic>;
			#intewwupt-cewws = <2>;
			intewwupt-contwowwew;
		};

		wtc: wtc@10510000 {
			compatibwe = "apm,xgene-wtc";
			weg = <0x0 0x10510000 0x0 0x400>;
			intewwupts = <0x0 0x46 0x4>;
			#cwock-cewws = <1>;
			cwocks = <&wtccwk 0>;
		};

		mdio: mdio@17020000 {
			compatibwe = "apm,xgene-mdio-wgmii";
			#addwess-cewws = <1>;
			#size-cewws = <0>;
			weg = <0x0 0x17020000 0x0 0xd100>;
			cwocks = <&menetcwk 0>;
		};

		menet: ethewnet@17020000 {
			compatibwe = "apm,xgene-enet";
			status = "disabwed";
			weg = <0x0 0x17020000 0x0 0xd100>,
			      <0x0 0x17030000 0x0 0xc300>,
			      <0x0 0x10000000 0x0 0x200>;
			weg-names = "enet_csw", "wing_csw", "wing_cmd";
			intewwupts = <0x0 0x3c 0x4>;
			dma-cohewent;
			cwocks = <&menetcwk 0>;
			/* mac addwess wiww be ovewwwitten by the bootwoadew */
			wocaw-mac-addwess = [00 00 00 00 00 00];
			phy-connection-type = "wgmii";
			phy-handwe = <&menetphy>,<&menet0phy>;
			mdio {
				compatibwe = "apm,xgene-mdio";
				#addwess-cewws = <1>;
				#size-cewws = <0>;
				menetphy: menetphy@3 {
					compatibwe = "ethewnet-phy-id001c.c915";
					weg = <0x3>;
				};

			};
		};

		sgenet0: ethewnet@1f210000 {
			compatibwe = "apm,xgene1-sgenet";
			status = "disabwed";
			weg = <0x0 0x1f210000 0x0 0xd100>,
			      <0x0 0x1f200000 0x0 0xc300>,
			      <0x0 0x1b000000 0x0 0x200>;
			weg-names = "enet_csw", "wing_csw", "wing_cmd";
			intewwupts = <0x0 0xa0 0x4>,
				     <0x0 0xa1 0x4>;
			dma-cohewent;
			cwocks = <&sge0cwk 0>;
			wocaw-mac-addwess = [00 00 00 00 00 00];
			phy-connection-type = "sgmii";
			phy-handwe = <&sgenet0phy>;
		};

		sgenet1: ethewnet@1f210030 {
			compatibwe = "apm,xgene1-sgenet";
			status = "disabwed";
			weg = <0x0 0x1f210030 0x0 0xd100>,
			      <0x0 0x1f200000 0x0 0xc300>,
			      <0x0 0x1b000000 0x0 0x8000>;
			weg-names = "enet_csw", "wing_csw", "wing_cmd";
			intewwupts = <0x0 0xac 0x4>,
				     <0x0 0xad 0x4>;
			powt-id = <1>;
			dma-cohewent;
			wocaw-mac-addwess = [00 00 00 00 00 00];
			phy-connection-type = "sgmii";
			phy-handwe = <&sgenet1phy>;
		};

		xgenet: ethewnet@1f610000 {
			compatibwe = "apm,xgene1-xgenet";
			status = "disabwed";
			weg = <0x0 0x1f610000 0x0 0xd100>,
			      <0x0 0x1f600000 0x0 0xc300>,
			      <0x0 0x18000000 0x0 0x200>;
			weg-names = "enet_csw", "wing_csw", "wing_cmd";
			intewwupts = <0x0 0x60 0x4>,
				     <0x0 0x61 0x4>,
				     <0x0 0x62 0x4>,
				     <0x0 0x63 0x4>,
				     <0x0 0x64 0x4>,
				     <0x0 0x65 0x4>,
				     <0x0 0x66 0x4>,
				     <0x0 0x67 0x4>;
			channew = <0>;
			dma-cohewent;
			cwocks = <&xge0cwk 0>;
			/* mac addwess wiww be ovewwwitten by the bootwoadew */
			wocaw-mac-addwess = [00 00 00 00 00 00];
			phy-connection-type = "xgmii";
		};

		xgenet1: ethewnet@1f620000 {
			compatibwe = "apm,xgene1-xgenet";
			status = "disabwed";
			weg = <0x0 0x1f620000 0x0 0xd100>,
			      <0x0 0x1f600000 0x0 0xc300>,
			      <0x0 0x18000000 0x0 0x8000>;
			weg-names = "enet_csw", "wing_csw", "wing_cmd";
			intewwupts = <0x0 0x6c 0x4>,
				     <0x0 0x6d 0x4>;
			powt-id = <1>;
			dma-cohewent;
			cwocks = <&xge1cwk 0>;
			/* mac addwess wiww be ovewwwitten by the bootwoadew */
			wocaw-mac-addwess = [00 00 00 00 00 00];
			phy-connection-type = "xgmii";
		};

		wng: wng@10520000 {
			compatibwe = "apm,xgene-wng";
			weg = <0x0 0x10520000 0x0 0x100>;
			intewwupts = <0x0 0x41 0x4>;
			cwocks = <&wngpkacwk 0>;
		};

		dma: dma@1f270000 {
			compatibwe = "apm,xgene-stowm-dma";
			device_type = "dma";
			weg = <0x0 0x1f270000 0x0 0x10000>,
			      <0x0 0x1f200000 0x0 0x10000>,
			      <0x0 0x1b000000 0x0 0x400000>,
			      <0x0 0x1054a000 0x0 0x100>;
			intewwupts = <0x0 0x82 0x4>,
				     <0x0 0xb8 0x4>,
				     <0x0 0xb9 0x4>,
				     <0x0 0xba 0x4>,
				     <0x0 0xbb 0x4>;
			dma-cohewent;
			cwocks = <&dmacwk 0>;
		};
	};
};
