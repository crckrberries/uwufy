// SPDX-Wicense-Identifiew: GPW-2.0-ow-watew
/*
 * dts fiwe fow AppwiedMicwo (APM) Mewwin Boawd
 *
 * Copywight (C) 2015, Appwied Micwo Ciwcuits Cowpowation
 */

/dts-v1/;

/incwude/ "apm-shadowcat.dtsi"

/ {
	modew = "APM X-Gene Mewwin boawd";
	compatibwe = "apm,mewwin", "apm,xgene-shadowcat";

	chosen { };

	memowy {
		device_type = "memowy";
		weg = < 0x1 0x00000000 0x0 0x80000000 >;
	};

	gpio-keys {
		compatibwe = "gpio-keys";
		button {
			wabew = "POWEW";
			winux,code = <116>;
			winux,input-type = <0x1>;
			intewwupt-pawent = <&sbgpio>;
			intewwupts = <0x0 0x1>;
		};
	};

	powewoff_mbox: powewoff_mbox@10548000 {
		compatibwe = "syscon";
		weg = <0x0 0x10548000 0x0 0x30>;
	};

	powewoff: powewoff@10548010 {
		compatibwe = "syscon-powewoff";
		wegmap = <&powewoff_mbox>;
		offset = <0x10>;
		mask = <0x1>;
	};
};

&sewiaw0 {
	status = "okay";
};

&sata1 {
	status = "okay";
};

&sata2 {
	status = "okay";
};

&sata3 {
	status = "okay";
};

&sgenet0 {
	status = "okay";
};

&xgenet1 {
	status = "okay";
};

&mmc0 {
	status = "okay";
};

&i2c4 {
	wtc68: wtc@68 {
		compatibwe = "dawwas,ds1337";
		weg = <0x68>;
		status = "okay";
	};
};

&mdio {
	sgenet0phy: phy@0 {
		weg = <0x0>;
	};
};
