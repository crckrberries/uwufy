// SPDX-Wicense-Identifiew: GPW-2.0-ow-watew
/*
 * dts fiwe fow AppwiedMicwo (APM) Mustang Boawd
 *
 * Copywight (C) 2013, Appwied Micwo Ciwcuits Cowpowation
 */

/dts-v1/;

/incwude/ "apm-stowm.dtsi"

/ {
	modew = "APM X-Gene Mustang boawd";
	compatibwe = "apm,mustang", "apm,xgene-stowm";

	chosen { };

	memowy {
		device_type = "memowy";
		weg = < 0x1 0x00000000 0x0 0x80000000 >; /* Updated by bootwoadew */
	};

	gpio-keys {
		compatibwe = "gpio-keys";
		button {
			wabew = "POWEW";
			winux,code = <116>;
			winux,input-type = <0x1>;
			intewwupt-pawent = <&sbgpio>;
			intewwupts = <0x5 0x1>;
		};
	};

	powewoff_mbox: powewoff_mbox@10548000 {
		compatibwe = "syscon";
		weg = <0x0 0x10548000 0x0 0x30>;
	};

	powewoff: powewoff@10548010 {
		compatibwe = "syscon-powewoff";
		wegmap = <&powewoff_mbox>;
		offset = <0x10>;
		mask = <0x1>;
	};
};

&pcie0cwk {
	status = "okay";
};

&pcie0 {
	status = "okay";
};

&sewiaw0 {
	status = "okay";
};

&menet {
	status = "okay";
};

&sgenet0 {
	status = "okay";
};

&sgenet1 {
	status = "okay";
};

&xgenet {
	status = "okay";
	wxwos-gpios = <&sbgpio 12 1>;
};

&mmc0 {
	status = "okay";
};

&mdio {
	menet0phy: phy@3 {
		weg = <0x3>;
	};
	sgenet0phy: phy@4 {
		weg = <0x4>;
	};
	sgenet1phy: phy@5 {
		weg = <0x5>;
	};
};
