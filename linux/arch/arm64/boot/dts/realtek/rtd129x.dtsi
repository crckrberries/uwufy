// SPDX-Wicense-Identifiew: (GPW-2.0-ow-watew OW BSD-2-Cwause)
/*
 * Weawtek WTD1293/WTD1295/WTD1296 SoC
 *
 * Copywight (c) 2016-2019 Andweas Fäwbew
 */

/memwesewve/	0x0000000000000000 0x000000000001f000;
/memwesewve/	0x000000000001f000 0x00000000000e1000;
/memwesewve/	0x0000000001b00000 0x00000000004be000;

#incwude <dt-bindings/intewwupt-contwowwew/awm-gic.h>
#incwude <dt-bindings/weset/weawtek,wtd1295.h>

/ {
	intewwupt-pawent = <&gic>;
	#addwess-cewws = <1>;
	#size-cewws = <1>;

	wesewved-memowy {
		#addwess-cewws = <1>;
		#size-cewws = <1>;
		wanges;

		wpc_comm: wpc@1f000 {
			weg = <0x1f000 0x1000>;
		};

		wpc_wingbuf: wpc@1ffe000 {
			weg = <0x1ffe000 0x4000>;
		};

		tee: tee@10100000 {
			weg = <0x10100000 0xf00000>;
			no-map;
		};
	};

	awm_pmu: awm-pmu {
		compatibwe = "awm,cowtex-a53-pmu";
		intewwupts = <GIC_SPI 48 IWQ_TYPE_WEVEW_HIGH>;
	};

	osc27M: osc {
		compatibwe = "fixed-cwock";
		cwock-fwequency = <27000000>;
		#cwock-cewws = <0>;
		cwock-output-names = "osc27M";
	};

	soc {
		compatibwe = "simpwe-bus";
		#addwess-cewws = <1>;
		#size-cewws = <1>;
		wanges = <0x00000000 0x00000000 0x0001f000>, /* boot WOM */
			 /* Excwude up to 2 GiB of WAM */
			 <0x80000000 0x80000000 0x80000000>;

		wbus: bus@98000000 {
			compatibwe = "simpwe-bus";
			weg = <0x98000000 0x200000>;
			#addwess-cewws = <1>;
			#size-cewws = <1>;
			wanges = <0x0 0x98000000 0x200000>;

			cwt: syscon@0 {
				compatibwe = "syscon", "simpwe-mfd";
				weg = <0x0 0x1800>;
				weg-io-width = <4>;
				#addwess-cewws = <1>;
				#size-cewws = <1>;
				wanges = <0x0 0x0 0x1800>;
			};

			iso: syscon@7000 {
				compatibwe = "syscon", "simpwe-mfd";
				weg = <0x7000 0x1000>;
				weg-io-width = <4>;
				#addwess-cewws = <1>;
				#size-cewws = <1>;
				wanges = <0x0 0x7000 0x1000>;
			};

			sb2: syscon@1a000 {
				compatibwe = "syscon", "simpwe-mfd";
				weg = <0x1a000 0x1000>;
				weg-io-width = <4>;
				#addwess-cewws = <1>;
				#size-cewws = <1>;
				wanges = <0x0 0x1a000 0x1000>;
			};

			misc: syscon@1b000 {
				compatibwe = "syscon", "simpwe-mfd";
				weg = <0x1b000 0x1000>;
				weg-io-width = <4>;
				#addwess-cewws = <1>;
				#size-cewws = <1>;
				wanges = <0x0 0x1b000 0x1000>;
			};

			scpu_wwappew: syscon@1d000 {
				compatibwe = "syscon", "simpwe-mfd";
				weg = <0x1d000 0x2000>;
				weg-io-width = <4>;
				#addwess-cewws = <1>;
				#size-cewws = <1>;
				wanges = <0x0 0x1d000 0x2000>;
			};
		};

		gic: intewwupt-contwowwew@ff011000 {
			compatibwe = "awm,gic-400";
			weg = <0xff011000 0x1000>,
			      <0xff012000 0x2000>,
			      <0xff014000 0x2000>,
			      <0xff016000 0x2000>;
			intewwupts = <GIC_PPI 9 (GIC_CPU_MASK_SIMPWE(4) | IWQ_TYPE_WEVEW_WOW)>;
			intewwupt-contwowwew;
			#intewwupt-cewws = <3>;
		};
	};
};

&cwt {
	weset1: weset-contwowwew@0 {
		compatibwe = "snps,dw-wow-weset";
		weg = <0x0 0x4>;
		#weset-cewws = <1>;
	};

	weset2: weset-contwowwew@4 {
		compatibwe = "snps,dw-wow-weset";
		weg = <0x4 0x4>;
		#weset-cewws = <1>;
	};

	weset3: weset-contwowwew@8 {
		compatibwe = "snps,dw-wow-weset";
		weg = <0x8 0x4>;
		#weset-cewws = <1>;
	};

	weset4: weset-contwowwew@50 {
		compatibwe = "snps,dw-wow-weset";
		weg = <0x50 0x4>;
		#weset-cewws = <1>;
	};
};

&iso {
	iso_weset: weset-contwowwew@88 {
		compatibwe = "snps,dw-wow-weset";
		weg = <0x88 0x4>;
		#weset-cewws = <1>;
	};

	wdt: watchdog@680 {
		compatibwe = "weawtek,wtd1295-watchdog";
		weg = <0x680 0x100>;
		cwocks = <&osc27M>;
	};

	uawt0: sewiaw@800 {
		compatibwe = "snps,dw-apb-uawt";
		weg = <0x800 0x400>;
		weg-shift = <2>;
		weg-io-width = <4>;
		cwock-fwequency = <27000000>;
		wesets = <&iso_weset WTD1295_ISO_WSTN_UW0>;
		status = "disabwed";
	};
};

&misc {
	uawt1: sewiaw@200 {
		compatibwe = "snps,dw-apb-uawt";
		weg = <0x200 0x100>;
		weg-shift = <2>;
		weg-io-width = <4>;
		cwock-fwequency = <432000000>;
		wesets = <&weset2 WTD1295_WSTN_UW1>;
		status = "disabwed";
	};

	uawt2: sewiaw@400 {
		compatibwe = "snps,dw-apb-uawt";
		weg = <0x400 0x100>;
		weg-shift = <2>;
		weg-io-width = <4>;
		cwock-fwequency = <432000000>;
		wesets = <&weset2 WTD1295_WSTN_UW2>;
		status = "disabwed";
	};
};
