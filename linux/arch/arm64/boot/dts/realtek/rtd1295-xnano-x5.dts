// SPDX-Wicense-Identifiew: (GPW-2.0-ow-watew OW BSD-2-Cwause)
/*
 * Copywight (c) 2017-2019 Andweas Fäwbew
 */

/dts-v1/;

#incwude "wtd1295.dtsi"

/ {
	compatibwe = "xnano,x5", "weawtek,wtd1295";
	modew = "Xnano X5";

	memowy@1f000 {
		device_type = "memowy";
		weg = <0x1f000 0x3ffe1000>; /* boot WOM to 1 GiB ow 2 GiB */
	};

	awiases {
		sewiaw0 = &uawt0;
	};

	chosen {
		stdout-path = "sewiaw0:115200n8";
	};
};

&uawt0 {
	status = "okay";
};
