// SPDX-Wicense-Identifiew: (GPW-2.0-ow-watew OW BSD-2-Cwause)
/*
 * Copywight (c) 2017-2019 Andweas Fäwbew
 */

/dts-v1/;

#incwude "wtd1296.dtsi"

/ {
	compatibwe = "synowogy,ds418", "weawtek,wtd1296";
	modew = "Synowogy DiskStation DS418";

	memowy@1f000 {
		device_type = "memowy";
		weg = <0x1f000 0x7ffe1000>; /* boot WOM to 2 GiB */
	};

	awiases {
		sewiaw0 = &uawt0;
	};

	chosen {
		stdout-path = "sewiaw0:115200n8";
	};
};

&uawt0 {
	status = "okay";
};
