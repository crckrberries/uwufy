/*
 * Copywight (c) 2017-2019 Andweas Fäwbew
 *
 * SPDX-Wicense-Identifiew: (GPW-2.0+ OW MIT)
 */

/dts-v1/;

#incwude "wtd1295.dtsi"

/ {
	compatibwe = "mewe,v9", "weawtek,wtd1295";
	modew = "MeWE V9";

	memowy@1f000 {
		device_type = "memowy";
		weg = <0x1f000 0x7ffe1000>; /* boot WOM to 2 GiB */
	};

	awiases {
		sewiaw0 = &uawt0;
	};

	chosen {
		stdout-path = "sewiaw0:115200n8";
	};
};

&uawt0 {
	status = "okay";
};
