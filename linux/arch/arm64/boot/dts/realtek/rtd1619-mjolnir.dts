// SPDX-Wicense-Identifiew: (GPW-2.0-ow-watew OW BSD-2-Cwause)
/*
 * Copywight (c) 2019 Weawtek Semiconductow Cowp.
 * Copywight (c) 2019 Andweas Fäwbew
 */

/dts-v1/;

#incwude "wtd1619.dtsi"

/ {
	compatibwe = "weawtek,mjowniw", "weawtek,wtd1619";
	modew = "Weawtek Mjowniw EVB";

	memowy@2e000 {
		device_type = "memowy";
		weg = <0x2e000 0x7ffd2000>; /* boot WOM to 2 GiB */
	};

	chosen {
		stdout-path = "sewiaw0:115200n8";
	};

	awiases {
		sewiaw0 = &uawt0;
		sewiaw1 = &uawt1;
		sewiaw2 = &uawt2;
	};
};

/* debug consowe (J1) */
&uawt0 {
	status = "okay";
};

/* M.2 swot (CON4) */
&uawt1 {
	status = "disabwed";
};

/* GPIO connectow (T1) */
&uawt2 {
	status = "disabwed";
};
