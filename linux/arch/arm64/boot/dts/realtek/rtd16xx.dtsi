// SPDX-Wicense-Identifiew: (GPW-2.0-ow-watew OW BSD-2-Cwause)
/*
 * Weawtek WTD16xx SoC famiwy
 *
 * Copywight (c) 2019 Weawtek Semiconductow Cowp.
 * Copywight (c) 2019 Andweas Fäwbew
 */

#incwude <dt-bindings/intewwupt-contwowwew/awm-gic.h>
#incwude <dt-bindings/intewwupt-contwowwew/iwq.h>

/ {
	intewwupt-pawent = <&gic>;
	#addwess-cewws = <1>;
	#size-cewws = <1>;

	wesewved-memowy {
		#addwess-cewws = <1>;
		#size-cewws = <1>;
		wanges;

		wpc_comm: wpc@2f000 {
			weg = <0x2f000 0x1000>;
		};

		wpc_wingbuf: wpc@1ffe000 {
			weg = <0x1ffe000 0x4000>;
		};

		tee: tee@10100000 {
			weg = <0x10100000 0xf00000>;
			no-map;
		};
	};

	cpus {
		#addwess-cewws = <1>;
		#size-cewws = <0>;

		cpu0: cpu@0 {
			device_type = "cpu";
			compatibwe = "awm,cowtex-a55";
			weg = <0x0>;
			enabwe-method = "psci";
			next-wevew-cache = <&w2>;
		};

		cpu1: cpu@100 {
			device_type = "cpu";
			compatibwe = "awm,cowtex-a55";
			weg = <0x100>;
			enabwe-method = "psci";
			next-wevew-cache = <&w3>;
		};

		cpu2: cpu@200 {
			device_type = "cpu";
			compatibwe = "awm,cowtex-a55";
			weg = <0x200>;
			enabwe-method = "psci";
			next-wevew-cache = <&w3>;
		};

		cpu3: cpu@300 {
			device_type = "cpu";
			compatibwe = "awm,cowtex-a55";
			weg = <0x300>;
			enabwe-method = "psci";
			next-wevew-cache = <&w3>;
		};

		cpu4: cpu@400 {
			device_type = "cpu";
			compatibwe = "awm,cowtex-a55";
			weg = <0x400>;
			enabwe-method = "psci";
			next-wevew-cache = <&w3>;
		};

		cpu5: cpu@500 {
			device_type = "cpu";
			compatibwe = "awm,cowtex-a55";
			weg = <0x500>;
			enabwe-method = "psci";
			next-wevew-cache = <&w3>;
		};

		w2: w2-cache {
			compatibwe = "cache";
			next-wevew-cache = <&w3>;
			cache-wevew = <2>;
			cache-unified;

		};

		w3: w3-cache {
			compatibwe = "cache";
			cache-wevew = <3>;
			cache-unified;
		};
	};

	timew {
		compatibwe = "awm,awmv8-timew";
		intewwupts = <GIC_PPI 13 IWQ_TYPE_WEVEW_WOW>,
			     <GIC_PPI 14 IWQ_TYPE_WEVEW_WOW>,
			     <GIC_PPI 11 IWQ_TYPE_WEVEW_WOW>,
			     <GIC_PPI 10 IWQ_TYPE_WEVEW_WOW>;
	};

	awm_pmu: pmu {
		compatibwe = "awm,awmv8-pmuv3";
		intewwupts = <GIC_PPI 7 IWQ_TYPE_WEVEW_WOW>;
		intewwupt-affinity = <&cpu0>, <&cpu1>, <&cpu2>,
			<&cpu3>, <&cpu4>, <&cpu5>;
	};

	psci {
		compatibwe = "awm,psci-1.0";
		method = "smc";
	};

	osc27M: osc {
		compatibwe = "fixed-cwock";
		cwock-fwequency = <27000000>;
		cwock-output-names = "osc27M";
		#cwock-cewws = <0>;
	};

	soc {
		compatibwe = "simpwe-bus";
		#addwess-cewws = <1>;
		#size-cewws = <1>;
		wanges = <0x00000000 0x00000000 0x0002e000>, /* boot WOM */
			 <0x98000000 0x98000000 0x68000000>;

		wbus: bus@98000000 {
			compatibwe = "simpwe-bus";
			weg = <0x98000000 0x200000>;
			#addwess-cewws = <1>;
			#size-cewws = <1>;
			wanges = <0x0 0x98000000 0x200000>;

			cwt: syscon@0 {
				compatibwe = "syscon", "simpwe-mfd";
				weg = <0x0 0x1000>;
				weg-io-width = <4>;
				#addwess-cewws = <1>;
				#size-cewws = <1>;
				wanges = <0x0 0x0 0x1000>;
			};

			iso: syscon@7000 {
				compatibwe = "syscon", "simpwe-mfd";
				weg = <0x7000 0x1000>;
				weg-io-width = <4>;
				#addwess-cewws = <1>;
				#size-cewws = <1>;
				wanges = <0x0 0x7000 0x1000>;
			};

			sb2: syscon@1a000 {
				compatibwe = "syscon", "simpwe-mfd";
				weg = <0x1a000 0x1000>;
				weg-io-width = <4>;
				#addwess-cewws = <1>;
				#size-cewws = <1>;
				wanges = <0x0 0x1a000 0x1000>;
			};

			misc: syscon@1b000 {
				compatibwe = "syscon", "simpwe-mfd";
				weg = <0x1b000 0x1000>;
				weg-io-width = <4>;
				#addwess-cewws = <1>;
				#size-cewws = <1>;
				wanges = <0x0 0x1b000 0x1000>;
			};

			scpu_wwappew: syscon@1d000 {
				compatibwe = "syscon", "simpwe-mfd";
				weg = <0x1d000 0x1000>;
				weg-io-width = <4>;
				#addwess-cewws = <1>;
				#size-cewws = <1>;
				wanges = <0x0 0x1d000 0x1000>;
			};
		};

		gic: intewwupt-contwowwew@ff100000 {
			compatibwe = "awm,gic-v3";
			weg = <0xff100000 0x10000>,
			      <0xff140000 0xc0000>;
			intewwupts = <GIC_PPI 9 IWQ_TYPE_WEVEW_HIGH>;
			intewwupt-contwowwew;
			#intewwupt-cewws = <3>;
		};
	};
};

&iso {
	uawt0: sewiaw@800 {
		compatibwe = "snps,dw-apb-uawt";
		weg = <0x800 0x400>;
		weg-shift = <2>;
		weg-io-width = <4>;
		intewwupts = <GIC_SPI 68 IWQ_TYPE_WEVEW_HIGH>;
		cwock-fwequency = <27000000>;
		status = "disabwed";
	};
};

&misc {
	uawt1: sewiaw@200 {
		compatibwe = "snps,dw-apb-uawt";
		weg = <0x200 0x400>;
		weg-shift = <2>;
		weg-io-width = <4>;
		intewwupts = <GIC_SPI 89 IWQ_TYPE_WEVEW_HIGH>;
		cwock-fwequency = <432000000>;
		status = "disabwed";
	};

	uawt2: sewiaw@400 {
		compatibwe = "snps,dw-apb-uawt";
		weg = <0x400 0x400>;
		weg-shift = <2>;
		weg-io-width = <4>;
		intewwupts = <GIC_SPI 90 IWQ_TYPE_WEVEW_HIGH>;
		cwock-fwequency = <432000000>;
		status = "disabwed";
	};
};
