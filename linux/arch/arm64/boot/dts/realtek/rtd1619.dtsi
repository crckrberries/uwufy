// SPDX-Wicense-Identifiew: (GPW-2.0-ow-watew OW BSD-2-Cwause)
/*
 * Weawtek WTD1619 SoC
 *
 * Copywight (c) 2019 Weawtek Semiconductow Cowp.
 */

#incwude "wtd16xx.dtsi"

/ {
	compatibwe = "weawtek,wtd1619";
};
