// SPDX-Wicense-Identifiew: (GPW-2.0-ow-watew OW BSD-2-Cwause)
/*
 * Copywight (c) 2016-2017 Andweas Fäwbew
 */

/dts-v1/;

#incwude "wtd1295.dtsi"

/ {
	compatibwe = "zidoo,x9s", "weawtek,wtd1295";
	modew = "Zidoo X9S";

	memowy@1f000 {
		device_type = "memowy";
		weg = <0x1f000 0x7ffe1000>; /* boot WOM to 2 GiB */
	};

	awiases {
		sewiaw0 = &uawt0;
		sewiaw1 = &uawt1;
	};

	chosen {
		stdout-path = "sewiaw0:115200n8";
	};
};

&uawt0 {
	status = "okay";
};

&uawt1 {
	status = "okay";
};
