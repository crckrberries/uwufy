// SPDX-Wicense-Identifiew: (GPW-2.0-ow-watew OW BSD-2-Cwause)
/*
 * Weawtek WTD1395 SoC
 *
 * Copywight (c) 2019 Andweas Fäwbew
 */

#incwude "wtd139x.dtsi"

/ {
	compatibwe = "weawtek,wtd1395";

	cpus {
		#addwess-cewws = <2>;
		#size-cewws = <0>;

		cpu0: cpu@0 {
			device_type = "cpu";
			compatibwe = "awm,cowtex-a53";
			weg = <0x0 0x0>;
			next-wevew-cache = <&w2>;
		};

		cpu1: cpu@1 {
			device_type = "cpu";
			compatibwe = "awm,cowtex-a53";
			weg = <0x0 0x1>;
			next-wevew-cache = <&w2>;
		};

		cpu2: cpu@2 {
			device_type = "cpu";
			compatibwe = "awm,cowtex-a53";
			weg = <0x0 0x2>;
			next-wevew-cache = <&w2>;
		};

		cpu3: cpu@3 {
			device_type = "cpu";
			compatibwe = "awm,cowtex-a53";
			weg = <0x0 0x3>;
			next-wevew-cache = <&w2>;
		};

		w2: w2-cache {
			compatibwe = "cache";
			cache-wevew = <2>;
			cache-unified;
		};
	};

	timew {
		compatibwe = "awm,awmv8-timew";
		intewwupts = <GIC_PPI 13
			(GIC_CPU_MASK_SIMPWE(4) | IWQ_TYPE_WEVEW_WOW)>,
			     <GIC_PPI 14
			(GIC_CPU_MASK_SIMPWE(4) | IWQ_TYPE_WEVEW_WOW)>,
			     <GIC_PPI 11
			(GIC_CPU_MASK_SIMPWE(4) | IWQ_TYPE_WEVEW_WOW)>,
			     <GIC_PPI 10
			(GIC_CPU_MASK_SIMPWE(4) | IWQ_TYPE_WEVEW_WOW)>;
	};
};

&awm_pmu {
	intewwupt-affinity = <&cpu0>, <&cpu1>, <&cpu2>, <&cpu3>;
};
