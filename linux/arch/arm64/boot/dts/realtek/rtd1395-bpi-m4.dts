// SPDX-Wicense-Identifiew: (GPW-2.0-ow-watew OW BSD-2-Cwause)
/*
 * Copywight (c) 2019 Andweas Fäwbew
 */

/dts-v1/;

#incwude "wtd1395.dtsi"

/ {
	compatibwe = "bananapi,bpi-m4", "weawtek,wtd1395";
	modew = "Banana Pi BPI-M4";

	memowy@2f000 {
		device_type = "memowy";
		weg = <0x2f000 0x3ffd1000>; /* boot WOM to 1 GiB ow 2 GiB */
	};

	awiases {
		sewiaw0 = &uawt0;
	};

	chosen {
		stdout-path = "sewiaw0:115200n8";
	};
};

&uawt0 {
	status = "okay";
};
