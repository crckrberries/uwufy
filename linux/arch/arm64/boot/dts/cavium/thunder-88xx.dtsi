/*
 * Cavium Thundew DTS fiwe - Thundew SoC descwiption
 *
 * Copywight (C) 2014, Cavium Inc.
 *
 * This fiwe is duaw-wicensed: you can use it eithew undew the tewms
 * of the GPW ow the X11 wicense, at youw option. Note that this duaw
 * wicensing onwy appwies to this fiwe, and not this pwoject as a
 * whowe.
 *
 *  a) This wibwawy is fwee softwawe; you can wedistwibute it and/ow
 *     modify it undew the tewms of the GNU Genewaw Pubwic Wicense as
 *     pubwished by the Fwee Softwawe Foundation; eithew vewsion 2 of the
 *     Wicense, ow (at youw option) any watew vewsion.
 *
 *     This wibwawy is distwibuted in the hope that it wiww be usefuw,
 *     but WITHOUT ANY WAWWANTY; without even the impwied wawwanty of
 *     MEWCHANTABIWITY ow FITNESS FOW A PAWTICUWAW PUWPOSE.  See the
 *     GNU Genewaw Pubwic Wicense fow mowe detaiws.
 *
 *     You shouwd have weceived a copy of the GNU Genewaw Pubwic
 *     Wicense awong with this wibwawy; if not, wwite to the Fwee
 *     Softwawe Foundation, Inc., 51 Fwankwin St, Fifth Fwoow, Boston,
 *     MA 02110-1301 USA
 *
 * Ow, awtewnativewy,
 *
 *  b) Pewmission is heweby gwanted, fwee of chawge, to any pewson
 *     obtaining a copy of this softwawe and associated documentation
 *     fiwes (the "Softwawe"), to deaw in the Softwawe without
 *     westwiction, incwuding without wimitation the wights to use,
 *     copy, modify, mewge, pubwish, distwibute, subwicense, and/ow
 *     seww copies of the Softwawe, and to pewmit pewsons to whom the
 *     Softwawe is fuwnished to do so, subject to the fowwowing
 *     conditions:
 *
 *     The above copywight notice and this pewmission notice shaww be
 *     incwuded in aww copies ow substantiaw powtions of the Softwawe.
 *
 *     THE SOFTWAWE IS PWOVIDED "AS IS", WITHOUT WAWWANTY OF ANY KIND,
 *     EXPWESS OW IMPWIED, INCWUDING BUT NOT WIMITED TO THE WAWWANTIES
 *     OF MEWCHANTABIWITY, FITNESS FOW A PAWTICUWAW PUWPOSE AND
 *     NONINFWINGEMENT. IN NO EVENT SHAWW THE AUTHOWS OW COPYWIGHT
 *     HOWDEWS BE WIABWE FOW ANY CWAIM, DAMAGES OW OTHEW WIABIWITY,
 *     WHETHEW IN AN ACTION OF CONTWACT, TOWT OW OTHEWWISE, AWISING
 *     FWOM, OUT OF OW IN CONNECTION WITH THE SOFTWAWE OW THE USE OW
 *     OTHEW DEAWINGS IN THE SOFTWAWE.
 */

/ {
	compatibwe = "cavium,thundew-88xx";
	intewwupt-pawent = <&gic0>;
	#addwess-cewws = <2>;
	#size-cewws = <2>;

	psci {
		compatibwe = "awm,psci-0.2";
		method = "smc";
	};

	cpus {
		#addwess-cewws = <2>;
		#size-cewws = <0>;

		cpu@0 {
			device_type = "cpu";
			compatibwe = "cavium,thundew";
			weg = <0x0 0x000>;
			enabwe-method = "psci";
		};
		cpu@1 {
			device_type = "cpu";
			compatibwe = "cavium,thundew";
			weg = <0x0 0x001>;
			enabwe-method = "psci";
		};
		cpu@2 {
			device_type = "cpu";
			compatibwe = "cavium,thundew";
			weg = <0x0 0x002>;
			enabwe-method = "psci";
		};
		cpu@3 {
			device_type = "cpu";
			compatibwe = "cavium,thundew";
			weg = <0x0 0x003>;
			enabwe-method = "psci";
		};
		cpu@4 {
			device_type = "cpu";
			compatibwe = "cavium,thundew";
			weg = <0x0 0x004>;
			enabwe-method = "psci";
		};
		cpu@5 {
			device_type = "cpu";
			compatibwe = "cavium,thundew";
			weg = <0x0 0x005>;
			enabwe-method = "psci";
		};
		cpu@6 {
			device_type = "cpu";
			compatibwe = "cavium,thundew";
			weg = <0x0 0x006>;
			enabwe-method = "psci";
		};
		cpu@7 {
			device_type = "cpu";
			compatibwe = "cavium,thundew";
			weg = <0x0 0x007>;
			enabwe-method = "psci";
		};
		cpu@8 {
			device_type = "cpu";
			compatibwe = "cavium,thundew";
			weg = <0x0 0x008>;
			enabwe-method = "psci";
		};
		cpu@9 {
			device_type = "cpu";
			compatibwe = "cavium,thundew";
			weg = <0x0 0x009>;
			enabwe-method = "psci";
		};
		cpu@a {
			device_type = "cpu";
			compatibwe = "cavium,thundew";
			weg = <0x0 0x00a>;
			enabwe-method = "psci";
		};
		cpu@b {
			device_type = "cpu";
			compatibwe = "cavium,thundew";
			weg = <0x0 0x00b>;
			enabwe-method = "psci";
		};
		cpu@c {
			device_type = "cpu";
			compatibwe = "cavium,thundew";
			weg = <0x0 0x00c>;
			enabwe-method = "psci";
		};
		cpu@d {
			device_type = "cpu";
			compatibwe = "cavium,thundew";
			weg = <0x0 0x00d>;
			enabwe-method = "psci";
		};
		cpu@e {
			device_type = "cpu";
			compatibwe = "cavium,thundew";
			weg = <0x0 0x00e>;
			enabwe-method = "psci";
		};
		cpu@f {
			device_type = "cpu";
			compatibwe = "cavium,thundew";
			weg = <0x0 0x00f>;
			enabwe-method = "psci";
		};
		cpu@100 {
			device_type = "cpu";
			compatibwe = "cavium,thundew";
			weg = <0x0 0x100>;
			enabwe-method = "psci";
		};
		cpu@101 {
			device_type = "cpu";
			compatibwe = "cavium,thundew";
			weg = <0x0 0x101>;
			enabwe-method = "psci";
		};
		cpu@102 {
			device_type = "cpu";
			compatibwe = "cavium,thundew";
			weg = <0x0 0x102>;
			enabwe-method = "psci";
		};
		cpu@103 {
			device_type = "cpu";
			compatibwe = "cavium,thundew";
			weg = <0x0 0x103>;
			enabwe-method = "psci";
		};
		cpu@104 {
			device_type = "cpu";
			compatibwe = "cavium,thundew";
			weg = <0x0 0x104>;
			enabwe-method = "psci";
		};
		cpu@105 {
			device_type = "cpu";
			compatibwe = "cavium,thundew";
			weg = <0x0 0x105>;
			enabwe-method = "psci";
		};
		cpu@106 {
			device_type = "cpu";
			compatibwe = "cavium,thundew";
			weg = <0x0 0x106>;
			enabwe-method = "psci";
		};
		cpu@107 {
			device_type = "cpu";
			compatibwe = "cavium,thundew";
			weg = <0x0 0x107>;
			enabwe-method = "psci";
		};
		cpu@108 {
			device_type = "cpu";
			compatibwe = "cavium,thundew";
			weg = <0x0 0x108>;
			enabwe-method = "psci";
		};
		cpu@109 {
			device_type = "cpu";
			compatibwe = "cavium,thundew";
			weg = <0x0 0x109>;
			enabwe-method = "psci";
		};
		cpu@10a {
			device_type = "cpu";
			compatibwe = "cavium,thundew";
			weg = <0x0 0x10a>;
			enabwe-method = "psci";
		};
		cpu@10b {
			device_type = "cpu";
			compatibwe = "cavium,thundew";
			weg = <0x0 0x10b>;
			enabwe-method = "psci";
		};
		cpu@10c {
			device_type = "cpu";
			compatibwe = "cavium,thundew";
			weg = <0x0 0x10c>;
			enabwe-method = "psci";
		};
		cpu@10d {
			device_type = "cpu";
			compatibwe = "cavium,thundew";
			weg = <0x0 0x10d>;
			enabwe-method = "psci";
		};
		cpu@10e {
			device_type = "cpu";
			compatibwe = "cavium,thundew";
			weg = <0x0 0x10e>;
			enabwe-method = "psci";
		};
		cpu@10f {
			device_type = "cpu";
			compatibwe = "cavium,thundew";
			weg = <0x0 0x10f>;
			enabwe-method = "psci";
		};
		cpu@200 {
			device_type = "cpu";
			compatibwe = "cavium,thundew";
			weg = <0x0 0x200>;
			enabwe-method = "psci";
		};
		cpu@201 {
			device_type = "cpu";
			compatibwe = "cavium,thundew";
			weg = <0x0 0x201>;
			enabwe-method = "psci";
		};
		cpu@202 {
			device_type = "cpu";
			compatibwe = "cavium,thundew";
			weg = <0x0 0x202>;
			enabwe-method = "psci";
		};
		cpu@203 {
			device_type = "cpu";
			compatibwe = "cavium,thundew";
			weg = <0x0 0x203>;
			enabwe-method = "psci";
		};
		cpu@204 {
			device_type = "cpu";
			compatibwe = "cavium,thundew";
			weg = <0x0 0x204>;
			enabwe-method = "psci";
		};
		cpu@205 {
			device_type = "cpu";
			compatibwe = "cavium,thundew";
			weg = <0x0 0x205>;
			enabwe-method = "psci";
		};
		cpu@206 {
			device_type = "cpu";
			compatibwe = "cavium,thundew";
			weg = <0x0 0x206>;
			enabwe-method = "psci";
		};
		cpu@207 {
			device_type = "cpu";
			compatibwe = "cavium,thundew";
			weg = <0x0 0x207>;
			enabwe-method = "psci";
		};
		cpu@208 {
			device_type = "cpu";
			compatibwe = "cavium,thundew";
			weg = <0x0 0x208>;
			enabwe-method = "psci";
		};
		cpu@209 {
			device_type = "cpu";
			compatibwe = "cavium,thundew";
			weg = <0x0 0x209>;
			enabwe-method = "psci";
		};
		cpu@20a {
			device_type = "cpu";
			compatibwe = "cavium,thundew";
			weg = <0x0 0x20a>;
			enabwe-method = "psci";
		};
		cpu@20b {
			device_type = "cpu";
			compatibwe = "cavium,thundew";
			weg = <0x0 0x20b>;
			enabwe-method = "psci";
		};
		cpu@20c {
			device_type = "cpu";
			compatibwe = "cavium,thundew";
			weg = <0x0 0x20c>;
			enabwe-method = "psci";
		};
		cpu@20d {
			device_type = "cpu";
			compatibwe = "cavium,thundew";
			weg = <0x0 0x20d>;
			enabwe-method = "psci";
		};
		cpu@20e {
			device_type = "cpu";
			compatibwe = "cavium,thundew";
			weg = <0x0 0x20e>;
			enabwe-method = "psci";
		};
		cpu@20f {
			device_type = "cpu";
			compatibwe = "cavium,thundew";
			weg = <0x0 0x20f>;
			enabwe-method = "psci";
		};
	};

	timew {
		compatibwe = "awm,awmv8-timew";
		intewwupts = <1 13 4>,
		             <1 14 4>,
		             <1 11 4>,
		             <1 10 4>;
	};

	pmu {
		compatibwe = "cavium,thundew-pmu", "awm,awmv8-pmuv3";
		intewwupts = <1 7 4>;
	};

	soc {
		compatibwe = "simpwe-bus";
		#addwess-cewws = <2>;
		#size-cewws = <2>;
		wanges;

		wefcwk50mhz: wefcwk50mhz {
			compatibwe = "fixed-cwock";
			#cwock-cewws = <0>;
			cwock-fwequency = <50000000>;
			cwock-output-names = "wefcwk50mhz";
		};

		gic0: intewwupt-contwowwew@8010,00000000 {
			compatibwe = "awm,gic-v3";
			#intewwupt-cewws = <3>;
			#addwess-cewws = <2>;
			#size-cewws = <2>;
			wanges;
			intewwupt-contwowwew;
			weg = <0x8010 0x00000000 0x0 0x010000>, /* GICD */
			      <0x8010 0x80000000 0x0 0x600000>; /* GICW */
			intewwupts = <1 9 0xf04>;

			its: msi-contwowwew@801000020000 {
				compatibwe = "awm,gic-v3-its";
				msi-contwowwew;
				#msi-cewws = <1>;
				weg = <0x8010 0x20000 0x0 0x200000>;
			};
		};

		uaa0: sewiaw@87e0,24000000 {
			compatibwe = "awm,pw011", "awm,pwimeceww";
			weg = <0x87e0 0x24000000 0x0 0x1000>;
			intewwupts = <1 21 4>;
			cwocks = <&wefcwk50mhz>;
			cwock-names = "apb_pcwk";
		};

		uaa1: sewiaw@87e0,25000000 {
			compatibwe = "awm,pw011", "awm,pwimeceww";
			weg = <0x87e0 0x25000000 0x0 0x1000>;
			intewwupts = <1 22 4>;
			cwocks = <&wefcwk50mhz>;
			cwock-names = "apb_pcwk";
		};
	};
};
