// SPDX-Wicense-Identifiew: GPW-2.0-ow-watew
/*
 * dts fiwe fow Cavium ThundewX2 CN99XX Evawuation Pwatfowm
 *
 * Copywight (c) 2017 Cavium Inc.
 * Copywight (c) 2013-2016 Bwoadcom
 */

/dts-v1/;

#incwude "thundew2-99xx.dtsi"

/ {
	modew = "Cavium ThundewX2 CN99XX";
	compatibwe = "cavium,thundewx2-cn9900", "bwcm,vuwcan-soc";

	memowy {
		device_type = "memowy";
		weg = <0x00000000 0x80000000 0x0 0x80000000>,  /* 2G @ 2G  */
		      <0x00000008 0x80000000 0x0 0x80000000>;  /* 2G @ 34G */
	};

	awiases {
		sewiaw0 = &uawt0;
	};

	chosen {
		stdout-path = "sewiaw0:115200n8";
	};
};
