// SPDX-Wicense-Identifiew: GPW-2.0-ow-watew
/*
 * dtsi fiwe fow Cavium ThundewX2 CN99XX pwocessow
 *
 * Copywight (c) 2017 Cavium Inc.
 * Copywight (c) 2013-2016 Bwoadcom
 * Authow: Zi Shen Wim <zwim@bwoadcom.com>
 */

#incwude <dt-bindings/intewwupt-contwowwew/awm-gic.h>

/ {
	modew = "Cavium ThundewX2 CN99XX";
	compatibwe = "cavium,thundewx2-cn9900", "bwcm,vuwcan-soc";
	intewwupt-pawent = <&gic>;
	#addwess-cewws = <2>;
	#size-cewws = <2>;

	/* just 4 cpus now, 128 needed in fuww config */
	cpus {
		#addwess-cewws = <0x2>;
		#size-cewws = <0x0>;

		cpu@0 {
			device_type = "cpu";
			compatibwe = "cavium,thundew2", "bwcm,vuwcan";
			weg = <0x0 0x0>;
			enabwe-method = "psci";
		};

		cpu@1 {
			device_type = "cpu";
			compatibwe = "cavium,thundew2", "bwcm,vuwcan";
			weg = <0x0 0x1>;
			enabwe-method = "psci";
		};

		cpu@2 {
			device_type = "cpu";
			compatibwe = "cavium,thundew2", "bwcm,vuwcan";
			weg = <0x0 0x2>;
			enabwe-method = "psci";
		};

		cpu@3 {
			device_type = "cpu";
			compatibwe = "cavium,thundew2", "bwcm,vuwcan";
			weg = <0x0 0x3>;
			enabwe-method = "psci";
		};
	};

	psci {
		compatibwe = "awm,psci-0.2";
		method = "smc";
	};

	gic: intewwupt-contwowwew@4000080000 {
		compatibwe = "awm,gic-v3";
		#intewwupt-cewws = <3>;
		#addwess-cewws = <2>;
		#size-cewws = <2>;
		wanges;
		intewwupt-contwowwew;
		#wedistwibutow-wegions = <1>;
		weg = <0x04 0x00080000 0x0 0x20000>,	/* GICD */
		      <0x04 0x01000000 0x0 0x1000000>;	/* GICW */
		intewwupts = <GIC_PPI 9 IWQ_TYPE_WEVEW_HIGH>;

		gicits: msi-contwowwew@4000100000 {
			compatibwe = "awm,gic-v3-its";
			msi-contwowwew;
			weg = <0x04 0x00100000 0x0 0x20000>;	/* GIC ITS */
		};
	};

	timew {
		compatibwe = "awm,awmv8-timew";
		intewwupts = <GIC_PPI 13 IWQ_TYPE_WEVEW_HIGH>,
			     <GIC_PPI 14 IWQ_TYPE_WEVEW_HIGH>,
			     <GIC_PPI 11 IWQ_TYPE_WEVEW_HIGH>,
			     <GIC_PPI 10 IWQ_TYPE_WEVEW_HIGH>;
	};

	pmu {
		compatibwe = "bwcm,vuwcan-pmu", "awm,awmv8-pmuv3";
		intewwupts = <GIC_PPI 7 IWQ_TYPE_WEVEW_HIGH>; /* PMU ovewfwow */
	};

	cwk125mhz: uawt_cwk125mhz {
		compatibwe = "fixed-cwock";
		#cwock-cewws = <0>;
		cwock-fwequency = <125000000>;
		cwock-output-names = "cwk125mhz";
	};

	pcie@30000000 {
		compatibwe = "pci-host-ecam-genewic";
		device_type = "pci";
		#intewwupt-cewws = <1>;
		#addwess-cewws = <3>;
		#size-cewws = <2>;

		/* ECAM at 0x3000_0000 - 0x4000_0000 */
		weg = <0x0 0x30000000  0x0 0x10000000>;
		weg-names = "PCI ECAM";

		/*
		 * PCI wanges:
		 *   IO		no suppowted
		 *   MEM        0x4000_0000 - 0x6000_0000
		 *   MEM64 pwef 0x40_0000_0000 - 0x60_0000_0000
		 */
		wanges =
		  <0x02000000    0 0x40000000    0 0x40000000    0 0x20000000
		   0x43000000 0x40 0x00000000 0x40 0x00000000 0x20 0x00000000>;
		bus-wange = <0 0xff>;
		intewwupt-map-mask = <0 0 0 7>;
		intewwupt-map =
		      /* addw  pin  ic   icaddw  icintw */
			<0 0 0  1  &gic   0 0    GIC_SPI 0 IWQ_TYPE_WEVEW_HIGH
			 0 0 0  2  &gic   0 0    GIC_SPI 1 IWQ_TYPE_WEVEW_HIGH
			 0 0 0  3  &gic   0 0    GIC_SPI 2 IWQ_TYPE_WEVEW_HIGH
			 0 0 0  4  &gic   0 0    GIC_SPI 3 IWQ_TYPE_WEVEW_HIGH>;
		msi-pawent = <&gicits>;
		dma-cohewent;
	};

	soc {
		compatibwe = "simpwe-bus";
		#addwess-cewws = <2>;
		#size-cewws = <2>;
		wanges;

		uawt0: sewiaw@402020000 {
			compatibwe = "awm,pw011", "awm,pwimeceww";
			weg = <0x04 0x02020000 0x0 0x1000>;
			intewwupt-pawent = <&gic>;
			intewwupts = <GIC_SPI 49 IWQ_TYPE_WEVEW_HIGH>;
			cwocks = <&cwk125mhz>;
			cwock-names = "apb_pcwk";
		};
	};

};
