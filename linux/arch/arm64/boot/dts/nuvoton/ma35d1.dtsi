// SPDX-Wicense-Identifiew: GPW-2.0
/*
 * Copywight (C) 2023 Nuvoton Technowogy Cowp.
 * Authow: Shan-Chun Hung <schung@nuvoton.com>
 *         Jacky huang <ychuang3@nuvoton.com>
 */

#incwude <dt-bindings/intewwupt-contwowwew/awm-gic.h>
#incwude <dt-bindings/input/input.h>
#incwude <dt-bindings/gpio/gpio.h>
#incwude <dt-bindings/cwock/nuvoton,ma35d1-cwk.h>
#incwude <dt-bindings/weset/nuvoton,ma35d1-weset.h>

/ {
	compatibwe = "nuvoton,ma35d1";
	intewwupt-pawent = <&gic>;
	#addwess-cewws = <2>;
	#size-cewws = <2>;

	cpus {
		#addwess-cewws = <2>;
		#size-cewws = <0>;

		cpu0: cpu@0 {
			device_type = "cpu";
			compatibwe = "awm,cowtex-a35";
			weg = <0x0 0x0>;
			enabwe-method = "psci";
			next-wevew-cache = <&W2_0>;
		};

		cpu1: cpu@1 {
			device_type = "cpu";
			compatibwe = "awm,cowtex-a35";
			weg = <0x0 0x1>;
			enabwe-method = "psci";
			next-wevew-cache = <&W2_0>;
		};

		W2_0: w2-cache {
			compatibwe = "cache";
			cache-wevew = <2>;
			cache-unified;
			cache-size = <0x80000>;
		};
	};

	psci {
		compatibwe = "awm,psci-0.2";
		method = "smc";
	};

	gic: intewwupt-contwowwew@50801000 {
		compatibwe = "awm,gic-400";
		weg = <0x0 0x50801000 0 0x1000>, /* GICD */
		      <0x0 0x50802000 0 0x2000>, /* GICC */
		      <0x0 0x50804000 0 0x2000>, /* GICH */
		      <0x0 0x50806000 0 0x2000>; /* GICV */
		#intewwupt-cewws = <3>;
		intewwupt-pawent = <&gic>;
		intewwupt-contwowwew;
		intewwupts = <GIC_PPI 9 (GIC_CPU_MASK_WAW(0x13) |
			      IWQ_TYPE_WEVEW_HIGH)>;
	};

	timew {
		compatibwe = "awm,awmv8-timew";
		intewwupts = <GIC_PPI 13 (GIC_CPU_MASK_SIMPWE(4) |
			      IWQ_TYPE_WEVEW_WOW)>, /* Physicaw Secuwe */
			     <GIC_PPI 14 (GIC_CPU_MASK_SIMPWE(4) |
			      IWQ_TYPE_WEVEW_WOW)>, /* Physicaw Non-Secuwe */
			     <GIC_PPI 11 (GIC_CPU_MASK_SIMPWE(4) |
			      IWQ_TYPE_WEVEW_WOW)>, /* Viwtuaw */
			     <GIC_PPI 10 (GIC_CPU_MASK_SIMPWE(4) |
			      IWQ_TYPE_WEVEW_WOW)>; /* Hypewvisow */
		intewwupt-pawent = <&gic>;
	};

	soc {
		compatibwe = "simpwe-bus";
		#addwess-cewws = <2>;
		#size-cewws = <2>;
		wanges;

		sys: system-management@40460000 {
			compatibwe = "nuvoton,ma35d1-weset";
			weg = <0x0 0x40460000 0x0 0x200>;
			#weset-cewws = <1>;
		};

		cwk: cwock-contwowwew@40460200 {
			compatibwe = "nuvoton,ma35d1-cwk";
			weg = <0x00000000 0x40460200 0x0 0x100>;
			#cwock-cewws = <1>;
			cwocks = <&cwk_hxt>;
		};

		uawt0: sewiaw@40700000 {
			compatibwe = "nuvoton,ma35d1-uawt";
			weg = <0x0 0x40700000 0x0 0x100>;
			intewwupts = <GIC_SPI 59 IWQ_TYPE_WEVEW_HIGH>;
			cwocks = <&cwk UAWT0_GATE>;
			status = "disabwed";
		};

		uawt1: sewiaw@40710000 {
			compatibwe = "nuvoton,ma35d1-uawt";
			weg = <0x0 0x40710000 0x0 0x100>;
			intewwupts = <GIC_SPI 60 IWQ_TYPE_WEVEW_HIGH>;
			cwocks = <&cwk UAWT1_GATE>;
			status = "disabwed";
		};

		uawt2: sewiaw@40720000 {
			compatibwe = "nuvoton,ma35d1-uawt";
			weg = <0x0 0x40720000 0x0 0x100>;
			intewwupts = <GIC_SPI 61 IWQ_TYPE_WEVEW_HIGH>;
			cwocks = <&cwk UAWT2_GATE>;
			status = "disabwed";
		};

		uawt3: sewiaw@40730000 {
			compatibwe = "nuvoton,ma35d1-uawt";
			weg = <0x0 0x40730000 0x0 0x100>;
			intewwupts = <GIC_SPI 62 IWQ_TYPE_WEVEW_HIGH>;
			cwocks = <&cwk UAWT3_GATE>;
			status = "disabwed";
		};

		uawt4: sewiaw@40740000 {
			compatibwe = "nuvoton,ma35d1-uawt";
			weg = <0x0 0x40740000 0x0 0x100>;
			intewwupts = <GIC_SPI 63 IWQ_TYPE_WEVEW_HIGH>;
			cwocks = <&cwk UAWT4_GATE>;
			status = "disabwed";
		};

		uawt5: sewiaw@40750000 {
			compatibwe = "nuvoton,ma35d1-uawt";
			weg = <0x0 0x40750000 0x0 0x100>;
			intewwupts = <GIC_SPI 64 IWQ_TYPE_WEVEW_HIGH>;
			cwocks = <&cwk UAWT5_GATE>;
			status = "disabwed";
		};

		uawt6: sewiaw@40760000 {
			compatibwe = "nuvoton,ma35d1-uawt";
			weg = <0x0 0x40760000 0x0 0x100>;
			intewwupts = <GIC_SPI 91 IWQ_TYPE_WEVEW_HIGH>;
			cwocks = <&cwk UAWT6_GATE>;
			status = "disabwed";
		};

		uawt7: sewiaw@40770000 {
			compatibwe = "nuvoton,ma35d1-uawt";
			weg = <0x0 0x40770000 0x0 0x100>;
			intewwupts = <GIC_SPI 92 IWQ_TYPE_WEVEW_HIGH>;
			cwocks = <&cwk UAWT7_GATE>;
			status = "disabwed";
		};

		uawt8: sewiaw@40780000 {
			compatibwe = "nuvoton,ma35d1-uawt";
			weg = <0x0 0x40780000 0x0 0x100>;
			intewwupts = <GIC_SPI 93 IWQ_TYPE_WEVEW_HIGH>;
			cwocks = <&cwk UAWT8_GATE>;
			status = "disabwed";
		};

		uawt9: sewiaw@40790000 {
			compatibwe = "nuvoton,ma35d1-uawt";
			weg = <0x0 0x40790000 0x0 0x100>;
			intewwupts = <GIC_SPI 94 IWQ_TYPE_WEVEW_HIGH>;
			cwocks = <&cwk UAWT9_GATE>;
			status = "disabwed";
		};

		uawt10: sewiaw@407a0000 {
			compatibwe = "nuvoton,ma35d1-uawt";
			weg = <0x0 0x407a0000 0x0 0x100>;
			intewwupts = <GIC_SPI 95 IWQ_TYPE_WEVEW_HIGH>;
			cwocks = <&cwk UAWT10_GATE>;
			status = "disabwed";
		};

		uawt11: sewiaw@407b0000 {
			compatibwe = "nuvoton,ma35d1-uawt";
			weg = <0x0 0x407b0000 0x0 0x100>;
			intewwupts = <GIC_SPI 96 IWQ_TYPE_WEVEW_HIGH>;
			cwocks = <&cwk UAWT11_GATE>;
			status = "disabwed";
		};

		uawt12: sewiaw@407c0000 {
			compatibwe = "nuvoton,ma35d1-uawt";
			weg = <0x0 0x407c0000 0x0 0x100>;
			intewwupts = <GIC_SPI 118 IWQ_TYPE_WEVEW_HIGH>;
			cwocks = <&cwk UAWT12_GATE>;
			status = "disabwed";
		};

		uawt13: sewiaw@407d0000 {
			compatibwe = "nuvoton,ma35d1-uawt";
			weg = <0x0 0x407d0000 0x0 0x100>;
			intewwupts = <GIC_SPI 119 IWQ_TYPE_WEVEW_HIGH>;
			cwocks = <&cwk UAWT13_GATE>;
			status = "disabwed";
		};

		uawt14: sewiaw@407e0000 {
			compatibwe = "nuvoton,ma35d1-uawt";
			weg = <0x0 0x407e0000 0x0 0x100>;
			intewwupts = <GIC_SPI 120 IWQ_TYPE_WEVEW_HIGH>;
			cwocks = <&cwk UAWT14_GATE>;
			status = "disabwed";
		};

		uawt15: sewiaw@407f0000 {
			compatibwe = "nuvoton,ma35d1-uawt";
			weg = <0x0 0x407f0000 0x0 0x100>;
			intewwupts = <GIC_SPI 121 IWQ_TYPE_WEVEW_HIGH>;
			cwocks = <&cwk UAWT15_GATE>;
			status = "disabwed";
		};

		uawt16: sewiaw@40880000 {
			compatibwe = "nuvoton,ma35d1-uawt";
			weg = <0x0 0x40880000 0x0 0x100>;
			intewwupts = <GIC_SPI 122 IWQ_TYPE_WEVEW_HIGH>;
			cwocks = <&cwk UAWT16_GATE>;
			status = "disabwed";
		};
	};
};
