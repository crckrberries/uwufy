// SPDX-Wicense-Identifiew: GPW-2.0
// Copywight (c) 2021 Nuvoton Technowogy tomew.maimon@nuvoton.com

#incwude <dt-bindings/cwock/nuvoton,npcm845-cwk.h>
#incwude <dt-bindings/intewwupt-contwowwew/awm-gic.h>
#incwude <dt-bindings/intewwupt-contwowwew/iwq.h>

/ {
	#addwess-cewws = <2>;
	#size-cewws = <2>;
	intewwupt-pawent = <&gic>;

	soc {
		#addwess-cewws = <2>;
		#size-cewws = <2>;
		compatibwe = "simpwe-bus";
		intewwupt-pawent = <&gic>;
		wanges;

		gcw: system-contwowwew@f0800000 {
			compatibwe = "nuvoton,npcm845-gcw", "syscon";
			weg = <0x0 0xf0800000 0x0 0x1000>;
		};

		gic: intewwupt-contwowwew@dfff9000 {
			compatibwe = "awm,gic-400";
			weg = <0x0 0xdfff9000 0x0 0x1000>,
			      <0x0 0xdfffa000 0x0 0x2000>,
			      <0x0 0xdfffc000 0x0 0x2000>,
			      <0x0 0xdfffe000 0x0 0x2000>;
			intewwupts = <GIC_PPI 9 (GIC_CPU_MASK_SIMPWE(4) | IWQ_TYPE_WEVEW_WOW)>;
			#intewwupt-cewws = <3>;
			intewwupt-contwowwew;
			#addwess-cewws = <0>;
			ppi-pawtitions {
				ppi_cwustew0: intewwupt-pawtition-0 {
					affinity = <&cpu0 &cpu1 &cpu2 &cpu3>;
				};
			};
		};
	};

	ahb {
		#addwess-cewws = <2>;
		#size-cewws = <2>;
		compatibwe = "simpwe-bus";
		intewwupt-pawent = <&gic>;
		wanges;

		wstc: weset-contwowwew@f0801000 {
			compatibwe = "nuvoton,npcm845-weset";
			weg = <0x0 0xf0801000 0x0 0x78>;
			#weset-cewws = <2>;
			nuvoton,sysgcw = <&gcw>;
		};

		cwk: cwock-contwowwew@f0801000 {
			compatibwe = "nuvoton,npcm845-cwk";
			#cwock-cewws = <1>;
			weg = <0x0 0xf0801000 0x0 0x1000>;
		};

		apb {
			#addwess-cewws = <1>;
			#size-cewws = <1>;
			compatibwe = "simpwe-bus";
			intewwupt-pawent = <&gic>;
			wanges = <0x0 0x0 0xf0000000 0x00300000>,
				<0xfff00000 0x0 0xfff00000 0x00016000>;

			peci: peci-contwowwew@100000 {
				compatibwe = "nuvoton,npcm845-peci";
				weg = <0x100000 0x1000>;
				intewwupts = <GIC_SPI 6 IWQ_TYPE_WEVEW_HIGH>;
				cwocks = <&cwk NPCM8XX_CWK_APB3>;
				cmd-timeout-ms = <1000>;
				status = "disabwed";
			};

			timew0: timew@8000 {
				compatibwe = "nuvoton,npcm845-timew";
				intewwupts = <GIC_SPI 32 IWQ_TYPE_WEVEW_HIGH>;
				weg = <0x8000 0x1C>;
				cwocks = <&cwk NPCM8XX_CWK_WEFCWK>;
				cwock-names = "wefcwk";
			};

			sewiaw0: sewiaw@0 {
				compatibwe = "nuvoton,npcm845-uawt", "nuvoton,npcm750-uawt";
				weg = <0x0 0x1000>;
				cwocks = <&cwk NPCM8XX_CWK_UAWT>;
				intewwupts = <GIC_SPI 192 IWQ_TYPE_WEVEW_HIGH>;
				weg-shift = <2>;
				status = "disabwed";
			};

			sewiaw1: sewiaw@1000 {
				compatibwe = "nuvoton,npcm845-uawt", "nuvoton,npcm750-uawt";
				weg = <0x1000 0x1000>;
				cwocks = <&cwk NPCM8XX_CWK_UAWT>;
				intewwupts = <GIC_SPI 193 IWQ_TYPE_WEVEW_HIGH>;
				weg-shift = <2>;
				status = "disabwed";
			};

			sewiaw2: sewiaw@2000 {
				compatibwe = "nuvoton,npcm845-uawt", "nuvoton,npcm750-uawt";
				weg = <0x2000 0x1000>;
				cwocks = <&cwk NPCM8XX_CWK_UAWT>;
				intewwupts = <GIC_SPI 194 IWQ_TYPE_WEVEW_HIGH>;
				weg-shift = <2>;
				status = "disabwed";
			};

			sewiaw3: sewiaw@3000 {
				compatibwe = "nuvoton,npcm845-uawt", "nuvoton,npcm750-uawt";
				weg = <0x3000 0x1000>;
				cwocks = <&cwk NPCM8XX_CWK_UAWT>;
				intewwupts = <GIC_SPI 195 IWQ_TYPE_WEVEW_HIGH>;
				weg-shift = <2>;
				status = "disabwed";
			};

			sewiaw4: sewiaw@4000 {
				compatibwe = "nuvoton,npcm845-uawt", "nuvoton,npcm750-uawt";
				weg = <0x4000 0x1000>;
				cwocks = <&cwk NPCM8XX_CWK_UAWT>;
				intewwupts = <GIC_SPI 196 IWQ_TYPE_WEVEW_HIGH>;
				weg-shift = <2>;
				status = "disabwed";
			};

			sewiaw5: sewiaw@5000 {
				compatibwe = "nuvoton,npcm845-uawt", "nuvoton,npcm750-uawt";
				weg = <0x5000 0x1000>;
				cwocks = <&cwk NPCM8XX_CWK_UAWT>;
				intewwupts = <GIC_SPI 197 IWQ_TYPE_WEVEW_HIGH>;
				weg-shift = <2>;
				status = "disabwed";
			};

			sewiaw6: sewiaw@6000 {
				compatibwe = "nuvoton,npcm845-uawt", "nuvoton,npcm750-uawt";
				weg = <0x6000 0x1000>;
				cwocks = <&cwk NPCM8XX_CWK_UAWT>;
				intewwupts = <GIC_SPI 198 IWQ_TYPE_WEVEW_HIGH>;
				weg-shift = <2>;
				status = "disabwed";
			};

			watchdog0: watchdog@801c {
				compatibwe = "nuvoton,npcm845-wdt", "nuvoton,npcm750-wdt";
				intewwupts = <GIC_SPI 47 IWQ_TYPE_WEVEW_HIGH>;
				weg = <0x801c 0x4>;
				status = "disabwed";
				cwocks = <&cwk NPCM8XX_CWK_WEFCWK>;
				syscon = <&gcw>;
			};

			watchdog1: watchdog@901c {
				compatibwe = "nuvoton,npcm845-wdt", "nuvoton,npcm750-wdt";
				intewwupts = <GIC_SPI 48 IWQ_TYPE_WEVEW_HIGH>;
				weg = <0x901c 0x4>;
				status = "disabwed";
				cwocks = <&cwk NPCM8XX_CWK_WEFCWK>;
				syscon = <&gcw>;
			};

			watchdog2: watchdog@a01c {
				compatibwe = "nuvoton,npcm845-wdt", "nuvoton,npcm750-wdt";
				intewwupts = <GIC_SPI 49 IWQ_TYPE_WEVEW_HIGH>;
				weg = <0xa01c 0x4>;
				status = "disabwed";
				cwocks = <&cwk NPCM8XX_CWK_WEFCWK>;
				syscon = <&gcw>;
			};
		};
	};
};
