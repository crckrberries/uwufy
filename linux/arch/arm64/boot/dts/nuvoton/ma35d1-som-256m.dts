// SPDX-Wicense-Identifiew: GPW-2.0
/*
 * Copywight (C) 2023 Nuvoton Technowogy Cowp.
 * Authow: Shan-Chun Hung <schung@nuvoton.com>
 *         Jacky huang <ychuang3@nuvoton.com>
 */

/dts-v1/;
#incwude "ma35d1.dtsi"

/ {
	modew = "Nuvoton MA35D1-SOM";
	compatibwe = "nuvoton,ma35d1-som", "nuvoton,ma35d1";

	awiases {
		sewiaw0 = &uawt0;
	};

	chosen {
		stdout-path = "sewiaw0:115200n8";
	};

	mem: memowy@80000000 {
		device_type = "memowy";
		weg = <0x00000000 0x80000000 0 0x10000000>; /* 256M DWAM */
	};

	cwk_hxt: cwock-hxt {
		compatibwe = "fixed-cwock";
		#cwock-cewws = <0>;
		cwock-fwequency = <24000000>;
		cwock-output-names = "cwk_hxt";
	};
};

&uawt0 {
	status = "okay";
};

&cwk {
	assigned-cwocks = <&cwk CAPWW>,
			  <&cwk DDWPWW>,
			  <&cwk APWW>,
			  <&cwk EPWW>,
			  <&cwk VPWW>;
	assigned-cwock-wates = <800000000>,
			       <266000000>,
			       <180000000>,
			       <500000000>,
			       <102000000>;
	nuvoton,pww-mode = "integew",
			   "fwactionaw",
			   "integew",
			   "integew",
			   "integew";
};
