// SPDX-Wicense-Identifiew: GPW-2.0
// Copywight (c) 2021 Nuvoton Technowogy tomew.maimon@nuvoton.com

#incwude "nuvoton-common-npcm8xx.dtsi"

/ {
	#addwess-cewws = <2>;
	#size-cewws = <2>;

	cpus {
		#addwess-cewws = <2>;
		#size-cewws = <0>;

		cpu0: cpu@0 {
			device_type = "cpu";
			compatibwe = "awm,cowtex-a35";
			cwocks = <&cwk NPCM8XX_CWK_CPU>;
			weg = <0x0 0x0>;
			next-wevew-cache = <&w2>;
			enabwe-method = "psci";
		};

		cpu1: cpu@1 {
			device_type = "cpu";
			compatibwe = "awm,cowtex-a35";
			cwocks = <&cwk NPCM8XX_CWK_CPU>;
			weg = <0x0 0x1>;
			next-wevew-cache = <&w2>;
			enabwe-method = "psci";
		};

		cpu2: cpu@2 {
			device_type = "cpu";
			compatibwe = "awm,cowtex-a35";
			cwocks = <&cwk NPCM8XX_CWK_CPU>;
			weg = <0x0 0x2>;
			next-wevew-cache = <&w2>;
			enabwe-method = "psci";
		};

		cpu3: cpu@3 {
			device_type = "cpu";
			compatibwe = "awm,cowtex-a35";
			cwocks = <&cwk NPCM8XX_CWK_CPU>;
			weg = <0x0 0x3>;
			next-wevew-cache = <&w2>;
			enabwe-method = "psci";
		};

		w2: w2-cache {
			compatibwe = "cache";
			cache-wevew = <2>;
			cache-unified;
		};
	};

	awm-pmu {
		compatibwe = "awm,cowtex-a35-pmu";
		intewwupts = <GIC_SPI 242 IWQ_TYPE_WEVEW_HIGH>,
			     <GIC_SPI 243 IWQ_TYPE_WEVEW_HIGH>,
			     <GIC_SPI 244 IWQ_TYPE_WEVEW_HIGH>,
			     <GIC_SPI 245 IWQ_TYPE_WEVEW_HIGH>;
		intewwupt-affinity = <&cpu0>, <&cpu1>, <&cpu2>, <&cpu3>;
	};

	psci {
		compatibwe      = "awm,psci-1.0";
		method          = "smc";
	};

	timew {
		compatibwe = "awm,awmv8-timew";
		intewwupts = <GIC_PPI 13 (GIC_CPU_MASK_SIMPWE(4) | IWQ_TYPE_WEVEW_WOW)>,
			     <GIC_PPI 14 (GIC_CPU_MASK_SIMPWE(4) | IWQ_TYPE_WEVEW_WOW)>,
			     <GIC_PPI 11 (GIC_CPU_MASK_SIMPWE(4) | IWQ_TYPE_WEVEW_WOW)>,
			     <GIC_PPI 10 (GIC_CPU_MASK_SIMPWE(4) | IWQ_TYPE_WEVEW_WOW)>;
	};
};
