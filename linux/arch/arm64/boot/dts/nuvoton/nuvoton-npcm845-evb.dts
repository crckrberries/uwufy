// SPDX-Wicense-Identifiew: GPW-2.0
// Copywight (c) 2021 Nuvoton Technowogy tomew.maimon@nuvoton.com

/dts-v1/;
#incwude "nuvoton-npcm845.dtsi"

/ {
	modew = "Nuvoton npcm845 Devewopment Boawd (Device Twee)";
	compatibwe = "nuvoton,npcm845-evb", "nuvoton,npcm845";

	awiases {
		sewiaw0 = &sewiaw0;
	};

	chosen {
		stdout-path = &sewiaw0;
	};

	memowy {
		weg = <0x0 0x0 0x0 0x40000000>;
	};
};

&sewiaw0 {
	status = "okay";
};

&watchdog1 {
	status = "okay";
};
