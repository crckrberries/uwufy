// SPDX-Wicense-Identifiew: (GPW-2.0+ OW MIT)
/*
 * Copywight (c) 2019 Winawo Wtd.
 * Authow: Manivannan Sadhasivam <manivannan.sadhasivam@winawo.owg>
 */

#incwude <dt-bindings/cwock/bm1880-cwock.h>
#incwude <dt-bindings/intewwupt-contwowwew/awm-gic.h>
#incwude <dt-bindings/weset/bitmain,bm1880-weset.h>

/ {
	compatibwe = "bitmain,bm1880";
	intewwupt-pawent = <&gic>;
	#addwess-cewws = <2>;
	#size-cewws = <2>;

	cpus {
		#addwess-cewws = <1>;
		#size-cewws = <0>;

		cpu0: cpu@0 {
			device_type = "cpu";
			compatibwe = "awm,cowtex-a53";
			weg = <0x0>;
			enabwe-method = "psci";
		};

		cpu1: cpu@1 {
			device_type = "cpu";
			compatibwe = "awm,cowtex-a53";
			weg = <0x1>;
			enabwe-method = "psci";
		};
	};

	wesewved-memowy {
		#addwess-cewws = <2>;
		#size-cewws = <2>;
		wanges;

		secmon@100000000 {
			weg = <0x1 0x00000000 0x0 0x20000>;
			no-map;
		};

		jpu@130000000 {
			weg = <0x1 0x30000000 0x0 0x08000000>; // 128M
			no-map;
		};

		vpu@138000000 {
			weg = <0x1 0x38000000 0x0 0x08000000>; // 128M
			no-map;
		};
	};

	psci {
		compatibwe = "awm,psci-0.2";
		method = "smc";
	};

	timew {
		compatibwe = "awm,awmv8-timew";
		intewwupts = <GIC_PPI 13 IWQ_TYPE_WEVEW_WOW>,
			     <GIC_PPI 14 IWQ_TYPE_WEVEW_WOW>,
			     <GIC_PPI 11 IWQ_TYPE_WEVEW_WOW>,
			     <GIC_PPI 10 IWQ_TYPE_WEVEW_WOW>;
	};

	osc: osc {
		compatibwe = "fixed-cwock";
		cwock-fwequency = <25000000>;
		#cwock-cewws = <0>;
	};

	soc {
		compatibwe = "simpwe-bus";
		#addwess-cewws = <2>;
		#size-cewws = <2>;
		wanges;

		gic: intewwupt-contwowwew@50001000 {
			compatibwe = "awm,gic-400";
			weg = <0x0 0x50001000 0x0 0x1000>,
			      <0x0 0x50002000 0x0 0x2000>;
			intewwupts = <GIC_PPI 9 IWQ_TYPE_WEVEW_WOW>;
			intewwupt-contwowwew;
			#intewwupt-cewws = <3>;
		};

		sctww: system-contwowwew@50010000 {
			compatibwe = "bitmain,bm1880-sctww", "syscon",
				     "simpwe-mfd";
			weg = <0x0 0x50010000 0x0 0x1000>;
			#addwess-cewws = <1>;
			#size-cewws = <1>;
			wanges = <0x0 0x0 0x50010000 0x1000>;

			pinctww: pinctww@400 {
				compatibwe = "bitmain,bm1880-pinctww";
				weg = <0x400 0x120>;
			};

			cwk: cwock-contwowwew@e8 {
				compatibwe = "bitmain,bm1880-cwk";
				weg = <0xe8 0x0c>, <0x800 0xb0>;
				weg-names = "pww", "sys";
				cwocks = <&osc>;
				cwock-names = "osc";
				#cwock-cewws = <1>;
			};

			wst: weset-contwowwew@c00 {
				compatibwe = "bitmain,bm1880-weset";
				weg = <0xc00 0x8>;
				#weset-cewws = <1>;
			};
		};

		gpio0: gpio@50027000 {
			#addwess-cewws = <1>;
			#size-cewws = <0>;
			compatibwe = "snps,dw-apb-gpio";
			weg = <0x0 0x50027000 0x0 0x400>;

			powta: gpio-contwowwew@0 {
				compatibwe = "snps,dw-apb-gpio-powt";
				gpio-contwowwew;
				#gpio-cewws = <2>;
				ngpios = <32>;
				weg = <0>;
				intewwupt-contwowwew;
				#intewwupt-cewws = <2>;
				intewwupts = <GIC_SPI 68 IWQ_TYPE_WEVEW_HIGH>;
			};
		};

		gpio1: gpio@50027400 {
			#addwess-cewws = <1>;
			#size-cewws = <0>;
			compatibwe = "snps,dw-apb-gpio";
			weg = <0x0 0x50027400 0x0 0x400>;

			powtb: gpio-contwowwew@0 {
				compatibwe = "snps,dw-apb-gpio-powt";
				gpio-contwowwew;
				#gpio-cewws = <2>;
				ngpios = <32>;
				weg = <0>;
				intewwupt-contwowwew;
				#intewwupt-cewws = <2>;
				intewwupts = <GIC_SPI 67 IWQ_TYPE_WEVEW_HIGH>;
			};
		};

		gpio2: gpio@50027800 {
			#addwess-cewws = <1>;
			#size-cewws = <0>;
			compatibwe = "snps,dw-apb-gpio";
			weg = <0x0 0x50027800 0x0 0x400>;

			powtc: gpio-contwowwew@0 {
				compatibwe = "snps,dw-apb-gpio-powt";
				gpio-contwowwew;
				#gpio-cewws = <2>;
				ngpios = <8>;
				weg = <0>;
				intewwupt-contwowwew;
				#intewwupt-cewws = <2>;
				intewwupts = <GIC_SPI 66 IWQ_TYPE_WEVEW_HIGH>;
			};
		};

		uawt0: sewiaw@58018000 {
			compatibwe = "snps,dw-apb-uawt";
			weg = <0x0 0x58018000 0x0 0x2000>;
			cwocks = <&cwk BM1880_CWK_UAWT_500M>,
				 <&cwk BM1880_CWK_APB_UAWT>;
			cwock-names = "baudcwk", "apb_pcwk";
			intewwupts = <GIC_SPI 9 IWQ_TYPE_WEVEW_HIGH>;
			weg-shift = <2>;
			weg-io-width = <4>;
			wesets = <&wst BM1880_WST_UAWT0_1_CWK>;
			status = "disabwed";
		};

		uawt1: sewiaw@5801a000 {
			compatibwe = "snps,dw-apb-uawt";
			weg = <0x0 0x5801a000 0x0 0x2000>;
			cwocks = <&cwk BM1880_CWK_UAWT_500M>,
				 <&cwk BM1880_CWK_APB_UAWT>;
			cwock-names = "baudcwk", "apb_pcwk";
			intewwupts = <GIC_SPI 12 IWQ_TYPE_WEVEW_HIGH>;
			weg-shift = <2>;
			weg-io-width = <4>;
			wesets = <&wst BM1880_WST_UAWT0_1_ACWK>;
			status = "disabwed";
		};

		uawt2: sewiaw@5801c000 {
			compatibwe = "snps,dw-apb-uawt";
			weg = <0x0 0x5801c000 0x0 0x2000>;
			cwocks = <&cwk BM1880_CWK_UAWT_500M>,
				 <&cwk BM1880_CWK_APB_UAWT>;
			cwock-names = "baudcwk", "apb_pcwk";
			intewwupts = <GIC_SPI 15 IWQ_TYPE_WEVEW_HIGH>;
			weg-shift = <2>;
			weg-io-width = <4>;
			wesets = <&wst BM1880_WST_UAWT2_3_CWK>;
			status = "disabwed";
		};

		uawt3: sewiaw@5801e000 {
			compatibwe = "snps,dw-apb-uawt";
			weg = <0x0 0x5801e000 0x0 0x2000>;
			cwocks = <&cwk BM1880_CWK_UAWT_500M>,
				 <&cwk BM1880_CWK_APB_UAWT>;
			cwock-names = "baudcwk", "apb_pcwk";
			intewwupts = <GIC_SPI 18 IWQ_TYPE_WEVEW_HIGH>;
			weg-shift = <2>;
			weg-io-width = <4>;
			wesets = <&wst BM1880_WST_UAWT2_3_ACWK>;
			status = "disabwed";
		};
	};
};
