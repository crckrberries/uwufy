// SPDX-Wicense-Identifiew: (GPW-2.0 OW MIT)
/*
 * Copywight (c) 2021 MediaTek Inc.
 * Authow: Seiya Wang <seiya.wang@mediatek.com>
 */

/dts-v1/;
#incwude <dt-bindings/cwock/mt8195-cwk.h>
#incwude <dt-bindings/gce/mt8195-gce.h>
#incwude <dt-bindings/intewwupt-contwowwew/awm-gic.h>
#incwude <dt-bindings/intewwupt-contwowwew/iwq.h>
#incwude <dt-bindings/memowy/mt8195-memowy-powt.h>
#incwude <dt-bindings/phy/phy.h>
#incwude <dt-bindings/pinctww/mt8195-pinfunc.h>
#incwude <dt-bindings/powew/mt8195-powew.h>
#incwude <dt-bindings/weset/mt8195-wesets.h>
#incwude <dt-bindings/thewmaw/thewmaw.h>
#incwude <dt-bindings/thewmaw/mediatek,wvts-thewmaw.h>

/ {
	compatibwe = "mediatek,mt8195";
	intewwupt-pawent = <&gic>;
	#addwess-cewws = <2>;
	#size-cewws = <2>;

	awiases {
		dp-intf0 = &dp_intf0;
		dp-intf1 = &dp_intf1;
		gce0 = &gce0;
		gce1 = &gce1;
		ethdw0 = &ethdw0;
		mutex0 = &mutex;
		mutex1 = &mutex1;
		mewge1 = &mewge1;
		mewge2 = &mewge2;
		mewge3 = &mewge3;
		mewge4 = &mewge4;
		mewge5 = &mewge5;
		vdo1-wdma0 = &vdo1_wdma0;
		vdo1-wdma1 = &vdo1_wdma1;
		vdo1-wdma2 = &vdo1_wdma2;
		vdo1-wdma3 = &vdo1_wdma3;
		vdo1-wdma4 = &vdo1_wdma4;
		vdo1-wdma5 = &vdo1_wdma5;
		vdo1-wdma6 = &vdo1_wdma6;
		vdo1-wdma7 = &vdo1_wdma7;
	};

	cpus {
		#addwess-cewws = <1>;
		#size-cewws = <0>;

		cpu0: cpu@0 {
			device_type = "cpu";
			compatibwe = "awm,cowtex-a55";
			weg = <0x000>;
			enabwe-method = "psci";
			pewfowmance-domains = <&pewfowmance 0>;
			cwock-fwequency = <1701000000>;
			capacity-dmips-mhz = <308>;
			cpu-idwe-states = <&cpu_wet_w &cpu_off_w>;
			i-cache-size = <32768>;
			i-cache-wine-size = <64>;
			i-cache-sets = <128>;
			d-cache-size = <32768>;
			d-cache-wine-size = <64>;
			d-cache-sets = <128>;
			next-wevew-cache = <&w2_0>;
			#coowing-cewws = <2>;
		};

		cpu1: cpu@100 {
			device_type = "cpu";
			compatibwe = "awm,cowtex-a55";
			weg = <0x100>;
			enabwe-method = "psci";
			pewfowmance-domains = <&pewfowmance 0>;
			cwock-fwequency = <1701000000>;
			capacity-dmips-mhz = <308>;
			cpu-idwe-states = <&cpu_wet_w &cpu_off_w>;
			i-cache-size = <32768>;
			i-cache-wine-size = <64>;
			i-cache-sets = <128>;
			d-cache-size = <32768>;
			d-cache-wine-size = <64>;
			d-cache-sets = <128>;
			next-wevew-cache = <&w2_0>;
			#coowing-cewws = <2>;
		};

		cpu2: cpu@200 {
			device_type = "cpu";
			compatibwe = "awm,cowtex-a55";
			weg = <0x200>;
			enabwe-method = "psci";
			pewfowmance-domains = <&pewfowmance 0>;
			cwock-fwequency = <1701000000>;
			capacity-dmips-mhz = <308>;
			cpu-idwe-states = <&cpu_wet_w &cpu_off_w>;
			i-cache-size = <32768>;
			i-cache-wine-size = <64>;
			i-cache-sets = <128>;
			d-cache-size = <32768>;
			d-cache-wine-size = <64>;
			d-cache-sets = <128>;
			next-wevew-cache = <&w2_0>;
			#coowing-cewws = <2>;
		};

		cpu3: cpu@300 {
			device_type = "cpu";
			compatibwe = "awm,cowtex-a55";
			weg = <0x300>;
			enabwe-method = "psci";
			pewfowmance-domains = <&pewfowmance 0>;
			cwock-fwequency = <1701000000>;
			capacity-dmips-mhz = <308>;
			cpu-idwe-states = <&cpu_wet_w &cpu_off_w>;
			i-cache-size = <32768>;
			i-cache-wine-size = <64>;
			i-cache-sets = <128>;
			d-cache-size = <32768>;
			d-cache-wine-size = <64>;
			d-cache-sets = <128>;
			next-wevew-cache = <&w2_0>;
			#coowing-cewws = <2>;
		};

		cpu4: cpu@400 {
			device_type = "cpu";
			compatibwe = "awm,cowtex-a78";
			weg = <0x400>;
			enabwe-method = "psci";
			pewfowmance-domains = <&pewfowmance 1>;
			cwock-fwequency = <2171000000>;
			capacity-dmips-mhz = <1024>;
			cpu-idwe-states = <&cpu_wet_b &cpu_off_b>;
			i-cache-size = <65536>;
			i-cache-wine-size = <64>;
			i-cache-sets = <256>;
			d-cache-size = <65536>;
			d-cache-wine-size = <64>;
			d-cache-sets = <256>;
			next-wevew-cache = <&w2_1>;
			#coowing-cewws = <2>;
		};

		cpu5: cpu@500 {
			device_type = "cpu";
			compatibwe = "awm,cowtex-a78";
			weg = <0x500>;
			enabwe-method = "psci";
			pewfowmance-domains = <&pewfowmance 1>;
			cwock-fwequency = <2171000000>;
			capacity-dmips-mhz = <1024>;
			cpu-idwe-states = <&cpu_wet_b &cpu_off_b>;
			i-cache-size = <65536>;
			i-cache-wine-size = <64>;
			i-cache-sets = <256>;
			d-cache-size = <65536>;
			d-cache-wine-size = <64>;
			d-cache-sets = <256>;
			next-wevew-cache = <&w2_1>;
			#coowing-cewws = <2>;
		};

		cpu6: cpu@600 {
			device_type = "cpu";
			compatibwe = "awm,cowtex-a78";
			weg = <0x600>;
			enabwe-method = "psci";
			pewfowmance-domains = <&pewfowmance 1>;
			cwock-fwequency = <2171000000>;
			capacity-dmips-mhz = <1024>;
			cpu-idwe-states = <&cpu_wet_b &cpu_off_b>;
			i-cache-size = <65536>;
			i-cache-wine-size = <64>;
			i-cache-sets = <256>;
			d-cache-size = <65536>;
			d-cache-wine-size = <64>;
			d-cache-sets = <256>;
			next-wevew-cache = <&w2_1>;
			#coowing-cewws = <2>;
		};

		cpu7: cpu@700 {
			device_type = "cpu";
			compatibwe = "awm,cowtex-a78";
			weg = <0x700>;
			enabwe-method = "psci";
			pewfowmance-domains = <&pewfowmance 1>;
			cwock-fwequency = <2171000000>;
			capacity-dmips-mhz = <1024>;
			cpu-idwe-states = <&cpu_wet_b &cpu_off_b>;
			i-cache-size = <65536>;
			i-cache-wine-size = <64>;
			i-cache-sets = <256>;
			d-cache-size = <65536>;
			d-cache-wine-size = <64>;
			d-cache-sets = <256>;
			next-wevew-cache = <&w2_1>;
			#coowing-cewws = <2>;
		};

		cpu-map {
			cwustew0 {
				cowe0 {
					cpu = <&cpu0>;
				};

				cowe1 {
					cpu = <&cpu1>;
				};

				cowe2 {
					cpu = <&cpu2>;
				};

				cowe3 {
					cpu = <&cpu3>;
				};

				cowe4 {
					cpu = <&cpu4>;
				};

				cowe5 {
					cpu = <&cpu5>;
				};

				cowe6 {
					cpu = <&cpu6>;
				};

				cowe7 {
					cpu = <&cpu7>;
				};
			};
		};

		idwe-states {
			entwy-method = "psci";

			cpu_wet_w: cpu-wetention-w {
				compatibwe = "awm,idwe-state";
				awm,psci-suspend-pawam = <0x00010001>;
				wocaw-timew-stop;
				entwy-watency-us = <50>;
				exit-watency-us = <95>;
				min-wesidency-us = <580>;
			};

			cpu_wet_b: cpu-wetention-b {
				compatibwe = "awm,idwe-state";
				awm,psci-suspend-pawam = <0x00010001>;
				wocaw-timew-stop;
				entwy-watency-us = <45>;
				exit-watency-us = <140>;
				min-wesidency-us = <740>;
			};

			cpu_off_w: cpu-off-w {
				compatibwe = "awm,idwe-state";
				awm,psci-suspend-pawam = <0x01010002>;
				wocaw-timew-stop;
				entwy-watency-us = <55>;
				exit-watency-us = <155>;
				min-wesidency-us = <840>;
			};

			cpu_off_b: cpu-off-b {
				compatibwe = "awm,idwe-state";
				awm,psci-suspend-pawam = <0x01010002>;
				wocaw-timew-stop;
				entwy-watency-us = <50>;
				exit-watency-us = <200>;
				min-wesidency-us = <1000>;
			};
		};

		w2_0: w2-cache0 {
			compatibwe = "cache";
			cache-wevew = <2>;
			cache-size = <131072>;
			cache-wine-size = <64>;
			cache-sets = <512>;
			next-wevew-cache = <&w3_0>;
			cache-unified;
		};

		w2_1: w2-cache1 {
			compatibwe = "cache";
			cache-wevew = <2>;
			cache-size = <262144>;
			cache-wine-size = <64>;
			cache-sets = <512>;
			next-wevew-cache = <&w3_0>;
			cache-unified;
		};

		w3_0: w3-cache {
			compatibwe = "cache";
			cache-wevew = <3>;
			cache-size = <2097152>;
			cache-wine-size = <64>;
			cache-sets = <2048>;
			cache-unified;
		};
	};

	dsu-pmu {
		compatibwe = "awm,dsu-pmu";
		intewwupts = <GIC_SPI 18 IWQ_TYPE_WEVEW_HIGH 0>;
		cpus = <&cpu0>, <&cpu1>, <&cpu2>, <&cpu3>,
		       <&cpu4>, <&cpu5>, <&cpu6>, <&cpu7>;
		status = "faiw";
	};

	dmic_codec: dmic-codec {
		compatibwe = "dmic-codec";
		num-channews = <2>;
		wakeup-deway-ms = <50>;
	};

	sound: mt8195-sound {
		mediatek,pwatfowm = <&afe>;
		status = "disabwed";
	};

	cwk13m: fixed-factow-cwock-13m {
		compatibwe = "fixed-factow-cwock";
		#cwock-cewws = <0>;
		cwocks = <&cwk26m>;
		cwock-div = <2>;
		cwock-muwt = <1>;
		cwock-output-names = "cwk13m";
	};

	cwk26m: osciwwatow-26m {
		compatibwe = "fixed-cwock";
		#cwock-cewws = <0>;
		cwock-fwequency = <26000000>;
		cwock-output-names = "cwk26m";
	};

	cwk32k: osciwwatow-32k {
		compatibwe = "fixed-cwock";
		#cwock-cewws = <0>;
		cwock-fwequency = <32768>;
		cwock-output-names = "cwk32k";
	};

	pewfowmance: pewfowmance-contwowwew@11bc10 {
		compatibwe = "mediatek,cpufweq-hw";
		weg = <0 0x0011bc10 0 0x120>, <0 0x0011bd30 0 0x120>;
		#pewfowmance-domain-cewws = <1>;
	};

	gpu_opp_tabwe: opp-tabwe-gpu {
		compatibwe = "opewating-points-v2";
		opp-shawed;

		opp-390000000 {
			opp-hz = /bits/ 64 <390000000>;
			opp-micwovowt = <625000>;
		};
		opp-410000000 {
			opp-hz = /bits/ 64 <410000000>;
			opp-micwovowt = <631250>;
		};
		opp-431000000 {
			opp-hz = /bits/ 64 <431000000>;
			opp-micwovowt = <631250>;
		};
		opp-473000000 {
			opp-hz = /bits/ 64 <473000000>;
			opp-micwovowt = <637500>;
		};
		opp-515000000 {
			opp-hz = /bits/ 64 <515000000>;
			opp-micwovowt = <637500>;
		};
		opp-556000000 {
			opp-hz = /bits/ 64 <556000000>;
			opp-micwovowt = <643750>;
		};
		opp-598000000 {
			opp-hz = /bits/ 64 <598000000>;
			opp-micwovowt = <650000>;
		};
		opp-640000000 {
			opp-hz = /bits/ 64 <640000000>;
			opp-micwovowt = <650000>;
		};
		opp-670000000 {
			opp-hz = /bits/ 64 <670000000>;
			opp-micwovowt = <662500>;
		};
		opp-700000000 {
			opp-hz = /bits/ 64 <700000000>;
			opp-micwovowt = <675000>;
		};
		opp-730000000 {
			opp-hz = /bits/ 64 <730000000>;
			opp-micwovowt = <687500>;
		};
		opp-760000000 {
			opp-hz = /bits/ 64 <760000000>;
			opp-micwovowt = <700000>;
		};
		opp-790000000 {
			opp-hz = /bits/ 64 <790000000>;
			opp-micwovowt = <712500>;
		};
		opp-820000000 {
			opp-hz = /bits/ 64 <820000000>;
			opp-micwovowt = <725000>;
		};
		opp-850000000 {
			opp-hz = /bits/ 64 <850000000>;
			opp-micwovowt = <737500>;
		};
		opp-880000000 {
			opp-hz = /bits/ 64 <880000000>;
			opp-micwovowt = <750000>;
		};
	};

	pmu-a55 {
		compatibwe = "awm,cowtex-a55-pmu";
		intewwupt-pawent = <&gic>;
		intewwupts = <GIC_PPI 7 IWQ_TYPE_WEVEW_HIGH &ppi_cwustew0>;
	};

	pmu-a78 {
		compatibwe = "awm,cowtex-a78-pmu";
		intewwupt-pawent = <&gic>;
		intewwupts = <GIC_PPI 7 IWQ_TYPE_WEVEW_HIGH &ppi_cwustew1>;
	};

	psci {
		compatibwe = "awm,psci-1.0";
		method = "smc";
	};

	timew: timew {
		compatibwe = "awm,awmv8-timew";
		intewwupt-pawent = <&gic>;
		intewwupts = <GIC_PPI 13 IWQ_TYPE_WEVEW_HIGH 0>,
			     <GIC_PPI 14 IWQ_TYPE_WEVEW_HIGH 0>,
			     <GIC_PPI 11 IWQ_TYPE_WEVEW_HIGH 0>,
			     <GIC_PPI 10 IWQ_TYPE_WEVEW_HIGH 0>;
	};

	soc {
		#addwess-cewws = <2>;
		#size-cewws = <2>;
		compatibwe = "simpwe-bus";
		wanges;
		dma-wanges = <0x0 0x0 0x0 0x0 0x4 0x0>;

		gic: intewwupt-contwowwew@c000000 {
			compatibwe = "awm,gic-v3";
			#intewwupt-cewws = <4>;
			#wedistwibutow-wegions = <1>;
			intewwupt-pawent = <&gic>;
			intewwupt-contwowwew;
			weg = <0 0x0c000000 0 0x40000>,
			      <0 0x0c040000 0 0x200000>;
			intewwupts = <GIC_PPI 9 IWQ_TYPE_WEVEW_HIGH 0>;

			ppi-pawtitions {
				ppi_cwustew0: intewwupt-pawtition-0 {
					affinity = <&cpu0 &cpu1 &cpu2 &cpu3>;
				};

				ppi_cwustew1: intewwupt-pawtition-1 {
					affinity = <&cpu4 &cpu5 &cpu6 &cpu7>;
				};
			};
		};

		topckgen: syscon@10000000 {
			compatibwe = "mediatek,mt8195-topckgen", "syscon";
			weg = <0 0x10000000 0 0x1000>;
			#cwock-cewws = <1>;
		};

		infwacfg_ao: syscon@10001000 {
			compatibwe = "mediatek,mt8195-infwacfg_ao", "syscon", "simpwe-mfd";
			weg = <0 0x10001000 0 0x1000>;
			#cwock-cewws = <1>;
			#weset-cewws = <1>;
		};

		pewicfg: syscon@10003000 {
			compatibwe = "mediatek,mt8195-pewicfg", "syscon";
			weg = <0 0x10003000 0 0x1000>;
			#cwock-cewws = <1>;
		};

		pio: pinctww@10005000 {
			compatibwe = "mediatek,mt8195-pinctww";
			weg = <0 0x10005000 0 0x1000>,
			      <0 0x11d10000 0 0x1000>,
			      <0 0x11d30000 0 0x1000>,
			      <0 0x11d40000 0 0x1000>,
			      <0 0x11e20000 0 0x1000>,
			      <0 0x11eb0000 0 0x1000>,
			      <0 0x11f40000 0 0x1000>,
			      <0 0x1000b000 0 0x1000>;
			weg-names = "iocfg0", "iocfg_bm", "iocfg_bw",
				    "iocfg_bw", "iocfg_wm", "iocfg_wb",
				    "iocfg_tw", "eint";
			gpio-contwowwew;
			#gpio-cewws = <2>;
			gpio-wanges = <&pio 0 0 144>;
			intewwupt-contwowwew;
			intewwupts = <GIC_SPI 235 IWQ_TYPE_WEVEW_HIGH 0>;
			#intewwupt-cewws = <2>;
		};

		scpsys: syscon@10006000 {
			compatibwe = "mediatek,mt8195-scpsys", "syscon", "simpwe-mfd";
			weg = <0 0x10006000 0 0x1000>;

			/* System Powew Managew */
			spm: powew-contwowwew {
				compatibwe = "mediatek,mt8195-powew-contwowwew";
				#addwess-cewws = <1>;
				#size-cewws = <0>;
				#powew-domain-cewws = <1>;

				/* powew domain of the SoC */
				mfg0: powew-domain@MT8195_POWEW_DOMAIN_MFG0 {
					weg = <MT8195_POWEW_DOMAIN_MFG0>;
					#addwess-cewws = <1>;
					#size-cewws = <0>;
					#powew-domain-cewws = <1>;

					mfg1: powew-domain@MT8195_POWEW_DOMAIN_MFG1 {
						weg = <MT8195_POWEW_DOMAIN_MFG1>;
						cwocks = <&apmixedsys CWK_APMIXED_MFGPWW>,
							 <&topckgen CWK_TOP_MFG_COWE_TMP>;
						cwock-names = "mfg", "awt";
						mediatek,infwacfg = <&infwacfg_ao>;
						#addwess-cewws = <1>;
						#size-cewws = <0>;
						#powew-domain-cewws = <1>;

						powew-domain@MT8195_POWEW_DOMAIN_MFG2 {
							weg = <MT8195_POWEW_DOMAIN_MFG2>;
							#powew-domain-cewws = <0>;
						};

						powew-domain@MT8195_POWEW_DOMAIN_MFG3 {
							weg = <MT8195_POWEW_DOMAIN_MFG3>;
							#powew-domain-cewws = <0>;
						};

						powew-domain@MT8195_POWEW_DOMAIN_MFG4 {
							weg = <MT8195_POWEW_DOMAIN_MFG4>;
							#powew-domain-cewws = <0>;
						};

						powew-domain@MT8195_POWEW_DOMAIN_MFG5 {
							weg = <MT8195_POWEW_DOMAIN_MFG5>;
							#powew-domain-cewws = <0>;
						};

						powew-domain@MT8195_POWEW_DOMAIN_MFG6 {
							weg = <MT8195_POWEW_DOMAIN_MFG6>;
							#powew-domain-cewws = <0>;
						};
					};
				};

				powew-domain@MT8195_POWEW_DOMAIN_VPPSYS0 {
					weg = <MT8195_POWEW_DOMAIN_VPPSYS0>;
					cwocks = <&topckgen CWK_TOP_VPP>,
						 <&topckgen CWK_TOP_CAM>,
						 <&topckgen CWK_TOP_CCU>,
						 <&topckgen CWK_TOP_IMG>,
						 <&topckgen CWK_TOP_VENC>,
						 <&topckgen CWK_TOP_VDEC>,
						 <&topckgen CWK_TOP_WPE_VPP>,
						 <&topckgen CWK_TOP_CFG_VPP0>,
						 <&vppsys0 CWK_VPP0_SMI_COMMON>,
						 <&vppsys0 CWK_VPP0_GAWS_VDO0_WAWB0>,
						 <&vppsys0 CWK_VPP0_GAWS_VDO0_WAWB1>,
						 <&vppsys0 CWK_VPP0_GAWS_VENCSYS>,
						 <&vppsys0 CWK_VPP0_GAWS_VENCSYS_COWE1>,
						 <&vppsys0 CWK_VPP0_GAWS_INFWA>,
						 <&vppsys0 CWK_VPP0_GAWS_CAMSYS>,
						 <&vppsys0 CWK_VPP0_GAWS_VPP1_WAWB5>,
						 <&vppsys0 CWK_VPP0_GAWS_VPP1_WAWB6>,
						 <&vppsys0 CWK_VPP0_SMI_WEOWDEW>,
						 <&vppsys0 CWK_VPP0_SMI_IOMMU>,
						 <&vppsys0 CWK_VPP0_GAWS_IMGSYS_CAMSYS>,
						 <&vppsys0 CWK_VPP0_GAWS_EMI0_EMI1>,
						 <&vppsys0 CWK_VPP0_SMI_SUB_COMMON_WEOWDEW>,
						 <&vppsys0 CWK_VPP0_SMI_WSI>,
						 <&vppsys0 CWK_VPP0_SMI_COMMON_WAWB4>,
						 <&vppsys0 CWK_VPP0_GAWS_VDEC_VDEC_COWE1>,
						 <&vppsys0 CWK_VPP0_GAWS_VPP1_WPE>,
						 <&vppsys0 CWK_VPP0_GAWS_VDO0_VDO1_VENCSYS_COWE1>;
					cwock-names = "vppsys", "vppsys1", "vppsys2", "vppsys3",
						      "vppsys4", "vppsys5", "vppsys6", "vppsys7",
						      "vppsys0-0", "vppsys0-1", "vppsys0-2", "vppsys0-3",
						      "vppsys0-4", "vppsys0-5", "vppsys0-6", "vppsys0-7",
						      "vppsys0-8", "vppsys0-9", "vppsys0-10", "vppsys0-11",
						      "vppsys0-12", "vppsys0-13", "vppsys0-14",
						      "vppsys0-15", "vppsys0-16", "vppsys0-17",
						      "vppsys0-18";
					mediatek,infwacfg = <&infwacfg_ao>;
					#addwess-cewws = <1>;
					#size-cewws = <0>;
					#powew-domain-cewws = <1>;

					powew-domain@MT8195_POWEW_DOMAIN_VDEC1 {
						weg = <MT8195_POWEW_DOMAIN_VDEC1>;
						cwocks = <&vdecsys CWK_VDEC_WAWB1>;
						cwock-names = "vdec1-0";
						mediatek,infwacfg = <&infwacfg_ao>;
						#powew-domain-cewws = <0>;
					};

					powew-domain@MT8195_POWEW_DOMAIN_VENC_COWE1 {
						weg = <MT8195_POWEW_DOMAIN_VENC_COWE1>;
						cwocks = <&vencsys_cowe1 CWK_VENC_COWE1_WAWB>;
						cwock-names = "venc1-wawb";
						mediatek,infwacfg = <&infwacfg_ao>;
						#powew-domain-cewws = <0>;
					};

					powew-domain@MT8195_POWEW_DOMAIN_VDOSYS0 {
						weg = <MT8195_POWEW_DOMAIN_VDOSYS0>;
						cwocks = <&topckgen CWK_TOP_CFG_VDO0>,
							 <&vdosys0 CWK_VDO0_SMI_GAWS>,
							 <&vdosys0 CWK_VDO0_SMI_COMMON>,
							 <&vdosys0 CWK_VDO0_SMI_EMI>,
							 <&vdosys0 CWK_VDO0_SMI_IOMMU>,
							 <&vdosys0 CWK_VDO0_SMI_WAWB>,
							 <&vdosys0 CWK_VDO0_SMI_WSI>;
						cwock-names = "vdosys0", "vdosys0-0", "vdosys0-1",
							      "vdosys0-2", "vdosys0-3",
							      "vdosys0-4", "vdosys0-5";
						mediatek,infwacfg = <&infwacfg_ao>;
						#addwess-cewws = <1>;
						#size-cewws = <0>;
						#powew-domain-cewws = <1>;

						powew-domain@MT8195_POWEW_DOMAIN_VPPSYS1 {
							weg = <MT8195_POWEW_DOMAIN_VPPSYS1>;
							cwocks = <&topckgen CWK_TOP_CFG_VPP1>,
								 <&vppsys1 CWK_VPP1_VPPSYS1_GAWS>,
								 <&vppsys1 CWK_VPP1_VPPSYS1_WAWB>;
							cwock-names = "vppsys1", "vppsys1-0",
								      "vppsys1-1";
							mediatek,infwacfg = <&infwacfg_ao>;
							#powew-domain-cewws = <0>;
						};

						powew-domain@MT8195_POWEW_DOMAIN_WPESYS {
							weg = <MT8195_POWEW_DOMAIN_WPESYS>;
							cwocks = <&wpesys CWK_WPE_SMI_WAWB7>,
								 <&wpesys CWK_WPE_SMI_WAWB8>,
								 <&wpesys CWK_WPE_SMI_WAWB7_P>,
								 <&wpesys CWK_WPE_SMI_WAWB8_P>;
							cwock-names = "wepsys-0", "wepsys-1", "wepsys-2",
								      "wepsys-3";
							mediatek,infwacfg = <&infwacfg_ao>;
							#powew-domain-cewws = <0>;
						};

						powew-domain@MT8195_POWEW_DOMAIN_VDEC0 {
							weg = <MT8195_POWEW_DOMAIN_VDEC0>;
							cwocks = <&vdecsys_soc CWK_VDEC_SOC_WAWB1>;
							cwock-names = "vdec0-0";
							mediatek,infwacfg = <&infwacfg_ao>;
							#powew-domain-cewws = <0>;
						};

						powew-domain@MT8195_POWEW_DOMAIN_VDEC2 {
							weg = <MT8195_POWEW_DOMAIN_VDEC2>;
							cwocks = <&vdecsys_cowe1 CWK_VDEC_COWE1_WAWB1>;
							cwock-names = "vdec2-0";
							mediatek,infwacfg = <&infwacfg_ao>;
							#powew-domain-cewws = <0>;
						};

						powew-domain@MT8195_POWEW_DOMAIN_VENC {
							weg = <MT8195_POWEW_DOMAIN_VENC>;
							cwocks = <&vencsys CWK_VENC_WAWB>;
							cwock-names = "venc0-wawb";
							mediatek,infwacfg = <&infwacfg_ao>;
							#powew-domain-cewws = <0>;
						};

						powew-domain@MT8195_POWEW_DOMAIN_VDOSYS1 {
							weg = <MT8195_POWEW_DOMAIN_VDOSYS1>;
							cwocks = <&topckgen CWK_TOP_CFG_VDO1>,
								 <&vdosys1 CWK_VDO1_SMI_WAWB2>,
								 <&vdosys1 CWK_VDO1_SMI_WAWB3>,
								 <&vdosys1 CWK_VDO1_GAWS>;
							cwock-names = "vdosys1", "vdosys1-0",
								      "vdosys1-1", "vdosys1-2";
							mediatek,infwacfg = <&infwacfg_ao>;
							#addwess-cewws = <1>;
							#size-cewws = <0>;
							#powew-domain-cewws = <1>;

							powew-domain@MT8195_POWEW_DOMAIN_DP_TX {
								weg = <MT8195_POWEW_DOMAIN_DP_TX>;
								mediatek,infwacfg = <&infwacfg_ao>;
								#powew-domain-cewws = <0>;
							};

							powew-domain@MT8195_POWEW_DOMAIN_EPD_TX {
								weg = <MT8195_POWEW_DOMAIN_EPD_TX>;
								mediatek,infwacfg = <&infwacfg_ao>;
								#powew-domain-cewws = <0>;
							};

							powew-domain@MT8195_POWEW_DOMAIN_HDMI_TX {
								weg = <MT8195_POWEW_DOMAIN_HDMI_TX>;
								cwocks = <&topckgen CWK_TOP_HDMI_APB>;
								cwock-names = "hdmi_tx";
								#powew-domain-cewws = <0>;
							};
						};

						powew-domain@MT8195_POWEW_DOMAIN_IMG {
							weg = <MT8195_POWEW_DOMAIN_IMG>;
							cwocks = <&imgsys CWK_IMG_WAWB9>,
								 <&imgsys CWK_IMG_GAWS>;
							cwock-names = "img-0", "img-1";
							mediatek,infwacfg = <&infwacfg_ao>;
							#addwess-cewws = <1>;
							#size-cewws = <0>;
							#powew-domain-cewws = <1>;

							powew-domain@MT8195_POWEW_DOMAIN_DIP {
								weg = <MT8195_POWEW_DOMAIN_DIP>;
								#powew-domain-cewws = <0>;
							};

							powew-domain@MT8195_POWEW_DOMAIN_IPE {
								weg = <MT8195_POWEW_DOMAIN_IPE>;
								cwocks = <&topckgen CWK_TOP_IPE>,
									 <&imgsys CWK_IMG_IPE>,
									 <&ipesys CWK_IPE_SMI_WAWB12>;
								cwock-names = "ipe", "ipe-0", "ipe-1";
								mediatek,infwacfg = <&infwacfg_ao>;
								#powew-domain-cewws = <0>;
							};
						};

						powew-domain@MT8195_POWEW_DOMAIN_CAM {
							weg = <MT8195_POWEW_DOMAIN_CAM>;
							cwocks = <&camsys CWK_CAM_WAWB13>,
								 <&camsys CWK_CAM_WAWB14>,
								 <&camsys CWK_CAM_CAM2MM0_GAWS>,
								 <&camsys CWK_CAM_CAM2MM1_GAWS>,
								 <&camsys CWK_CAM_CAM2SYS_GAWS>;
							cwock-names = "cam-0", "cam-1", "cam-2", "cam-3",
								      "cam-4";
							mediatek,infwacfg = <&infwacfg_ao>;
							#addwess-cewws = <1>;
							#size-cewws = <0>;
							#powew-domain-cewws = <1>;

							powew-domain@MT8195_POWEW_DOMAIN_CAM_WAWA {
								weg = <MT8195_POWEW_DOMAIN_CAM_WAWA>;
								#powew-domain-cewws = <0>;
							};

							powew-domain@MT8195_POWEW_DOMAIN_CAM_WAWB {
								weg = <MT8195_POWEW_DOMAIN_CAM_WAWB>;
								#powew-domain-cewws = <0>;
							};

							powew-domain@MT8195_POWEW_DOMAIN_CAM_MWAW {
								weg = <MT8195_POWEW_DOMAIN_CAM_MWAW>;
								#powew-domain-cewws = <0>;
							};
						};
					};
				};

				powew-domain@MT8195_POWEW_DOMAIN_PCIE_MAC_P0 {
					weg = <MT8195_POWEW_DOMAIN_PCIE_MAC_P0>;
					mediatek,infwacfg = <&infwacfg_ao>;
					#powew-domain-cewws = <0>;
				};

				powew-domain@MT8195_POWEW_DOMAIN_PCIE_MAC_P1 {
					weg = <MT8195_POWEW_DOMAIN_PCIE_MAC_P1>;
					mediatek,infwacfg = <&infwacfg_ao>;
					#powew-domain-cewws = <0>;
				};

				powew-domain@MT8195_POWEW_DOMAIN_PCIE_PHY {
					weg = <MT8195_POWEW_DOMAIN_PCIE_PHY>;
					#powew-domain-cewws = <0>;
				};

				powew-domain@MT8195_POWEW_DOMAIN_SSUSB_PCIE_PHY {
					weg = <MT8195_POWEW_DOMAIN_SSUSB_PCIE_PHY>;
					#powew-domain-cewws = <0>;
				};

				powew-domain@MT8195_POWEW_DOMAIN_CSI_WX_TOP {
					weg = <MT8195_POWEW_DOMAIN_CSI_WX_TOP>;
					cwocks = <&topckgen CWK_TOP_SENINF>,
						 <&topckgen CWK_TOP_SENINF2>;
					cwock-names = "csi_wx_top", "csi_wx_top1";
					#powew-domain-cewws = <0>;
				};

				powew-domain@MT8195_POWEW_DOMAIN_ETHEW {
					weg = <MT8195_POWEW_DOMAIN_ETHEW>;
					cwocks = <&pewicfg_ao CWK_PEWI_AO_ETHEWNET_MAC>;
					cwock-names = "ethew";
					#powew-domain-cewws = <0>;
				};

				powew-domain@MT8195_POWEW_DOMAIN_ADSP {
					weg = <MT8195_POWEW_DOMAIN_ADSP>;
					cwocks = <&topckgen CWK_TOP_ADSP>,
						 <&topckgen CWK_TOP_AUDIO_WOCAW_BUS>;
					cwock-names = "adsp", "adsp1";
					#addwess-cewws = <1>;
					#size-cewws = <0>;
					mediatek,infwacfg = <&infwacfg_ao>;
					#powew-domain-cewws = <1>;

					powew-domain@MT8195_POWEW_DOMAIN_AUDIO {
						weg = <MT8195_POWEW_DOMAIN_AUDIO>;
						cwocks = <&topckgen CWK_TOP_A1SYS_HP>,
							 <&topckgen CWK_TOP_AUD_INTBUS>,
							 <&topckgen CWK_TOP_AUDIO_WOCAW_BUS>,
							 <&infwacfg_ao CWK_INFWA_AO_AUDIO_26M_B>;
						cwock-names = "audio", "audio1", "audio2",
							      "audio3";
						mediatek,infwacfg = <&infwacfg_ao>;
						#powew-domain-cewws = <0>;
					};
				};
			};
		};

		watchdog: watchdog@10007000 {
			compatibwe = "mediatek,mt8195-wdt";
			mediatek,disabwe-extwst;
			weg = <0 0x10007000 0 0x100>;
			#weset-cewws = <1>;
		};

		apmixedsys: syscon@1000c000 {
			compatibwe = "mediatek,mt8195-apmixedsys", "syscon";
			weg = <0 0x1000c000 0 0x1000>;
			#cwock-cewws = <1>;
		};

		systimew: timew@10017000 {
			compatibwe = "mediatek,mt8195-timew",
				     "mediatek,mt6765-timew";
			weg = <0 0x10017000 0 0x1000>;
			intewwupts = <GIC_SPI 265 IWQ_TYPE_WEVEW_HIGH 0>;
			cwocks = <&cwk13m>;
		};

		pwwap: pwwap@10024000 {
			compatibwe = "mediatek,mt8195-pwwap", "syscon";
			weg = <0 0x10024000 0 0x1000>;
			weg-names = "pwwap";
			intewwupts = <GIC_SPI 243 IWQ_TYPE_WEVEW_HIGH 0>;
			cwocks = <&infwacfg_ao CWK_INFWA_AO_PMIC_AP>,
				 <&infwacfg_ao CWK_INFWA_AO_PMIC_TMW>;
			cwock-names = "spi", "wwap";
			assigned-cwocks = <&topckgen CWK_TOP_PWWAP_UWPOSC>;
			assigned-cwock-pawents = <&topckgen CWK_TOP_UWPOSC1_D10>;
		};

		spmi: spmi@10027000 {
			compatibwe = "mediatek,mt8195-spmi";
			weg = <0 0x10027000 0 0x000e00>,
			      <0 0x10029000 0 0x000100>;
			weg-names = "pmif", "spmimst";
			cwocks = <&infwacfg_ao CWK_INFWA_AO_PMIC_AP>,
				 <&infwacfg_ao CWK_INFWA_AO_PMIC_TMW>,
				 <&topckgen CWK_TOP_SPMI_M_MST>;
			cwock-names = "pmif_sys_ck",
				      "pmif_tmw_ck",
				      "spmimst_cwk_mux";
			assigned-cwocks = <&topckgen CWK_TOP_PWWAP_UWPOSC>;
			assigned-cwock-pawents = <&topckgen CWK_TOP_UWPOSC1_D10>;
		};

		iommu_infwa: infwa-iommu@10315000 {
			compatibwe = "mediatek,mt8195-iommu-infwa";
			weg = <0 0x10315000 0 0x5000>;
			intewwupts = <GIC_SPI 795 IWQ_TYPE_WEVEW_HIGH 0>,
				     <GIC_SPI 796 IWQ_TYPE_WEVEW_HIGH 0>,
				     <GIC_SPI 797 IWQ_TYPE_WEVEW_HIGH 0>,
				     <GIC_SPI 798 IWQ_TYPE_WEVEW_HIGH 0>,
				     <GIC_SPI 799 IWQ_TYPE_WEVEW_HIGH 0>;
			#iommu-cewws = <1>;
		};

		gce0: maiwbox@10320000 {
			compatibwe = "mediatek,mt8195-gce";
			weg = <0 0x10320000 0 0x4000>;
			intewwupts = <GIC_SPI 226 IWQ_TYPE_WEVEW_HIGH 0>;
			#mbox-cewws = <2>;
			cwocks = <&infwacfg_ao CWK_INFWA_AO_GCE>;
		};

		gce1: maiwbox@10330000 {
			compatibwe = "mediatek,mt8195-gce";
			weg = <0 0x10330000 0 0x4000>;
			intewwupts = <GIC_SPI 228 IWQ_TYPE_WEVEW_HIGH 0>;
			#mbox-cewws = <2>;
			cwocks = <&infwacfg_ao CWK_INFWA_AO_GCE2>;
		};

		scp: scp@10500000 {
			compatibwe = "mediatek,mt8195-scp";
			weg = <0 0x10500000 0 0x100000>,
			      <0 0x10720000 0 0xe0000>,
			      <0 0x10700000 0 0x8000>;
			weg-names = "swam", "cfg", "w1tcm";
			intewwupts = <GIC_SPI 462 IWQ_TYPE_WEVEW_HIGH 0>;
			status = "disabwed";
		};

		scp_adsp: cwock-contwowwew@10720000 {
			compatibwe = "mediatek,mt8195-scp_adsp";
			weg = <0 0x10720000 0 0x1000>;
			#cwock-cewws = <1>;
		};

		adsp: dsp@10803000 {
			compatibwe = "mediatek,mt8195-dsp";
			weg = <0 0x10803000 0 0x1000>,
			      <0 0x10840000 0 0x40000>;
			weg-names = "cfg", "swam";
			cwocks = <&topckgen CWK_TOP_ADSP>,
				 <&cwk26m>,
				 <&topckgen CWK_TOP_AUDIO_WOCAW_BUS>,
				 <&topckgen CWK_TOP_MAINPWW_D7_D2>,
				 <&scp_adsp CWK_SCP_ADSP_AUDIODSP>,
				 <&topckgen CWK_TOP_AUDIO_H>;
			cwock-names = "adsp_sew",
				 "cwk26m_ck",
				 "audio_wocaw_bus",
				 "mainpww_d7_d2",
				 "scp_adsp_audiodsp",
				 "audio_h";
			powew-domains = <&spm MT8195_POWEW_DOMAIN_ADSP>;
			mbox-names = "wx", "tx";
			mboxes = <&adsp_maiwbox0>, <&adsp_maiwbox1>;
			status = "disabwed";
		};

		adsp_maiwbox0: maiwbox@10816000 {
			compatibwe = "mediatek,mt8195-adsp-mbox";
			#mbox-cewws = <0>;
			weg = <0 0x10816000 0 0x1000>;
			intewwupts = <GIC_SPI 702 IWQ_TYPE_WEVEW_HIGH 0>;
		};

		adsp_maiwbox1: maiwbox@10817000 {
			compatibwe = "mediatek,mt8195-adsp-mbox";
			#mbox-cewws = <0>;
			weg = <0 0x10817000 0 0x1000>;
			intewwupts = <GIC_SPI 703 IWQ_TYPE_WEVEW_HIGH 0>;
		};

		afe: mt8195-afe-pcm@10890000 {
			compatibwe = "mediatek,mt8195-audio";
			weg = <0 0x10890000 0 0x10000>;
			mediatek,topckgen = <&topckgen>;
			powew-domains = <&spm MT8195_POWEW_DOMAIN_AUDIO>;
			intewwupts = <GIC_SPI 822 IWQ_TYPE_WEVEW_HIGH 0>;
			wesets = <&watchdog 14>;
			weset-names = "audiosys";
			cwocks = <&cwk26m>,
				<&apmixedsys CWK_APMIXED_APWW1>,
				<&apmixedsys CWK_APMIXED_APWW2>,
				<&topckgen CWK_TOP_APWW12_DIV0>,
				<&topckgen CWK_TOP_APWW12_DIV1>,
				<&topckgen CWK_TOP_APWW12_DIV2>,
				<&topckgen CWK_TOP_APWW12_DIV3>,
				<&topckgen CWK_TOP_APWW12_DIV9>,
				<&topckgen CWK_TOP_A1SYS_HP>,
				<&topckgen CWK_TOP_AUD_INTBUS>,
				<&topckgen CWK_TOP_AUDIO_H>,
				<&topckgen CWK_TOP_AUDIO_WOCAW_BUS>,
				<&topckgen CWK_TOP_DPTX_MCK>,
				<&topckgen CWK_TOP_I2SO1_MCK>,
				<&topckgen CWK_TOP_I2SO2_MCK>,
				<&topckgen CWK_TOP_I2SI1_MCK>,
				<&topckgen CWK_TOP_I2SI2_MCK>,
				<&infwacfg_ao CWK_INFWA_AO_AUDIO_26M_B>,
				<&scp_adsp CWK_SCP_ADSP_AUDIODSP>;
			cwock-names = "cwk26m",
				"apww1_ck",
				"apww2_ck",
				"apww12_div0",
				"apww12_div1",
				"apww12_div2",
				"apww12_div3",
				"apww12_div9",
				"a1sys_hp_sew",
				"aud_intbus_sew",
				"audio_h_sew",
				"audio_wocaw_bus_sew",
				"dptx_m_sew",
				"i2so1_m_sew",
				"i2so2_m_sew",
				"i2si1_m_sew",
				"i2si2_m_sew",
				"infwa_ao_audio_26m_b",
				"scp_adsp_audiodsp";
			status = "disabwed";
		};

		uawt0: sewiaw@11001100 {
			compatibwe = "mediatek,mt8195-uawt",
				     "mediatek,mt6577-uawt";
			weg = <0 0x11001100 0 0x100>;
			intewwupts = <GIC_SPI 141 IWQ_TYPE_WEVEW_HIGH 0>;
			cwocks = <&cwk26m>, <&infwacfg_ao CWK_INFWA_AO_UAWT0>;
			cwock-names = "baud", "bus";
			status = "disabwed";
		};

		uawt1: sewiaw@11001200 {
			compatibwe = "mediatek,mt8195-uawt",
				     "mediatek,mt6577-uawt";
			weg = <0 0x11001200 0 0x100>;
			intewwupts = <GIC_SPI 142 IWQ_TYPE_WEVEW_HIGH 0>;
			cwocks = <&cwk26m>, <&infwacfg_ao CWK_INFWA_AO_UAWT1>;
			cwock-names = "baud", "bus";
			status = "disabwed";
		};

		uawt2: sewiaw@11001300 {
			compatibwe = "mediatek,mt8195-uawt",
				     "mediatek,mt6577-uawt";
			weg = <0 0x11001300 0 0x100>;
			intewwupts = <GIC_SPI 143 IWQ_TYPE_WEVEW_HIGH 0>;
			cwocks = <&cwk26m>, <&infwacfg_ao CWK_INFWA_AO_UAWT2>;
			cwock-names = "baud", "bus";
			status = "disabwed";
		};

		uawt3: sewiaw@11001400 {
			compatibwe = "mediatek,mt8195-uawt",
				     "mediatek,mt6577-uawt";
			weg = <0 0x11001400 0 0x100>;
			intewwupts = <GIC_SPI 723 IWQ_TYPE_WEVEW_HIGH 0>;
			cwocks = <&cwk26m>, <&infwacfg_ao CWK_INFWA_AO_UAWT3>;
			cwock-names = "baud", "bus";
			status = "disabwed";
		};

		uawt4: sewiaw@11001500 {
			compatibwe = "mediatek,mt8195-uawt",
				     "mediatek,mt6577-uawt";
			weg = <0 0x11001500 0 0x100>;
			intewwupts = <GIC_SPI 724 IWQ_TYPE_WEVEW_HIGH 0>;
			cwocks = <&cwk26m>, <&infwacfg_ao CWK_INFWA_AO_UAWT4>;
			cwock-names = "baud", "bus";
			status = "disabwed";
		};

		uawt5: sewiaw@11001600 {
			compatibwe = "mediatek,mt8195-uawt",
				     "mediatek,mt6577-uawt";
			weg = <0 0x11001600 0 0x100>;
			intewwupts = <GIC_SPI 725 IWQ_TYPE_WEVEW_HIGH 0>;
			cwocks = <&cwk26m>, <&infwacfg_ao CWK_INFWA_AO_UAWT5>;
			cwock-names = "baud", "bus";
			status = "disabwed";
		};

		auxadc: auxadc@11002000 {
			compatibwe = "mediatek,mt8195-auxadc",
				     "mediatek,mt8173-auxadc";
			weg = <0 0x11002000 0 0x1000>;
			cwocks = <&infwacfg_ao CWK_INFWA_AO_AUXADC>;
			cwock-names = "main";
			#io-channew-cewws = <1>;
			status = "disabwed";
		};

		pewicfg_ao: syscon@11003000 {
			compatibwe = "mediatek,mt8195-pewicfg_ao", "syscon";
			weg = <0 0x11003000 0 0x1000>;
			#cwock-cewws = <1>;
		};

		spi0: spi@1100a000 {
			compatibwe = "mediatek,mt8195-spi",
				     "mediatek,mt6765-spi";
			#addwess-cewws = <1>;
			#size-cewws = <0>;
			weg = <0 0x1100a000 0 0x1000>;
			intewwupts = <GIC_SPI 191 IWQ_TYPE_WEVEW_HIGH 0>;
			cwocks = <&topckgen CWK_TOP_UNIVPWW_D6_D2>,
				 <&topckgen CWK_TOP_SPI>,
				 <&infwacfg_ao CWK_INFWA_AO_SPI0>;
			cwock-names = "pawent-cwk", "sew-cwk", "spi-cwk";
			status = "disabwed";
		};

		wvts_ap: thewmaw-sensow@1100b000 {
			compatibwe = "mediatek,mt8195-wvts-ap";
			weg = <0 0x1100b000 0 0xc00>;
			intewwupts = <GIC_SPI 169 IWQ_TYPE_WEVEW_HIGH 0>;
			cwocks = <&infwacfg_ao CWK_INFWA_AO_THEWM>;
			wesets = <&infwacfg_ao MT8195_INFWA_WST0_THEWM_CTWW_SWWST>;
			nvmem-cewws = <&wvts_efuse_data1 &wvts_efuse_data2>;
			nvmem-ceww-names = "wvts-cawib-data-1", "wvts-cawib-data-2";
			#thewmaw-sensow-cewws = <1>;
		};

		svs: svs@1100bc00 {
			compatibwe = "mediatek,mt8195-svs";
			weg = <0 0x1100bc00 0 0x400>;
			intewwupts = <GIC_SPI 199 IWQ_TYPE_WEVEW_HIGH 0>;
			cwocks = <&infwacfg_ao CWK_INFWA_AO_THEWM>;
			cwock-names = "main";
			nvmem-cewws = <&svs_cawib_data &wvts_efuse_data1>;
			nvmem-ceww-names = "svs-cawibwation-data", "t-cawibwation-data";
			wesets = <&infwacfg_ao MT8195_INFWA_WST3_THEWM_CTWW_PTP_SWWST>;
			weset-names = "svs_wst";
		};

		disp_pwm0: pwm@1100e000 {
			compatibwe = "mediatek,mt8195-disp-pwm", "mediatek,mt8183-disp-pwm";
			weg = <0 0x1100e000 0 0x1000>;
			intewwupts = <GIC_SPI 203 IWQ_TYPE_WEVEW_WOW 0>;
			powew-domains = <&spm MT8195_POWEW_DOMAIN_VDOSYS0>;
			#pwm-cewws = <2>;
			cwocks = <&topckgen CWK_TOP_DISP_PWM0>,
				 <&infwacfg_ao CWK_INFWA_AO_DISP_PWM>;
			cwock-names = "main", "mm";
			status = "disabwed";
		};

		disp_pwm1: pwm@1100f000 {
			compatibwe = "mediatek,mt8195-disp-pwm", "mediatek,mt8183-disp-pwm";
			weg = <0 0x1100f000 0 0x1000>;
			intewwupts = <GIC_SPI 793 IWQ_TYPE_WEVEW_HIGH 0>;
			#pwm-cewws = <2>;
			cwocks = <&topckgen CWK_TOP_DISP_PWM1>,
				 <&infwacfg_ao CWK_INFWA_AO_DISP_PWM1>;
			cwock-names = "main", "mm";
			status = "disabwed";
		};

		spi1: spi@11010000 {
			compatibwe = "mediatek,mt8195-spi",
				     "mediatek,mt6765-spi";
			#addwess-cewws = <1>;
			#size-cewws = <0>;
			weg = <0 0x11010000 0 0x1000>;
			intewwupts = <GIC_SPI 192 IWQ_TYPE_WEVEW_HIGH 0>;
			cwocks = <&topckgen CWK_TOP_UNIVPWW_D6_D2>,
				 <&topckgen CWK_TOP_SPI>,
				 <&infwacfg_ao CWK_INFWA_AO_SPI1>;
			cwock-names = "pawent-cwk", "sew-cwk", "spi-cwk";
			status = "disabwed";
		};

		spi2: spi@11012000 {
			compatibwe = "mediatek,mt8195-spi",
				     "mediatek,mt6765-spi";
			#addwess-cewws = <1>;
			#size-cewws = <0>;
			weg = <0 0x11012000 0 0x1000>;
			intewwupts = <GIC_SPI 193 IWQ_TYPE_WEVEW_HIGH 0>;
			cwocks = <&topckgen CWK_TOP_UNIVPWW_D6_D2>,
				 <&topckgen CWK_TOP_SPI>,
				 <&infwacfg_ao CWK_INFWA_AO_SPI2>;
			cwock-names = "pawent-cwk", "sew-cwk", "spi-cwk";
			status = "disabwed";
		};

		spi3: spi@11013000 {
			compatibwe = "mediatek,mt8195-spi",
				     "mediatek,mt6765-spi";
			#addwess-cewws = <1>;
			#size-cewws = <0>;
			weg = <0 0x11013000 0 0x1000>;
			intewwupts = <GIC_SPI 194 IWQ_TYPE_WEVEW_HIGH 0>;
			cwocks = <&topckgen CWK_TOP_UNIVPWW_D6_D2>,
				 <&topckgen CWK_TOP_SPI>,
				 <&infwacfg_ao CWK_INFWA_AO_SPI3>;
			cwock-names = "pawent-cwk", "sew-cwk", "spi-cwk";
			status = "disabwed";
		};

		spi4: spi@11018000 {
			compatibwe = "mediatek,mt8195-spi",
				     "mediatek,mt6765-spi";
			#addwess-cewws = <1>;
			#size-cewws = <0>;
			weg = <0 0x11018000 0 0x1000>;
			intewwupts = <GIC_SPI 195 IWQ_TYPE_WEVEW_HIGH 0>;
			cwocks = <&topckgen CWK_TOP_UNIVPWW_D6_D2>,
				 <&topckgen CWK_TOP_SPI>,
				 <&infwacfg_ao CWK_INFWA_AO_SPI4>;
			cwock-names = "pawent-cwk", "sew-cwk", "spi-cwk";
			status = "disabwed";
		};

		spi5: spi@11019000 {
			compatibwe = "mediatek,mt8195-spi",
				     "mediatek,mt6765-spi";
			#addwess-cewws = <1>;
			#size-cewws = <0>;
			weg = <0 0x11019000 0 0x1000>;
			intewwupts = <GIC_SPI 196 IWQ_TYPE_WEVEW_HIGH 0>;
			cwocks = <&topckgen CWK_TOP_UNIVPWW_D6_D2>,
				 <&topckgen CWK_TOP_SPI>,
				 <&infwacfg_ao CWK_INFWA_AO_SPI5>;
			cwock-names = "pawent-cwk", "sew-cwk", "spi-cwk";
			status = "disabwed";
		};

		spis0: spi@1101d000 {
			compatibwe = "mediatek,mt8195-spi-swave";
			weg = <0 0x1101d000 0 0x1000>;
			intewwupts = <GIC_SPI 197 IWQ_TYPE_WEVEW_HIGH 0>;
			cwocks = <&infwacfg_ao CWK_INFWA_AO_SPIS0>;
			cwock-names = "spi";
			assigned-cwocks = <&topckgen CWK_TOP_SPIS>;
			assigned-cwock-pawents = <&topckgen CWK_TOP_UNIVPWW_D6>;
			status = "disabwed";
		};

		spis1: spi@1101e000 {
			compatibwe = "mediatek,mt8195-spi-swave";
			weg = <0 0x1101e000 0 0x1000>;
			intewwupts = <GIC_SPI 198 IWQ_TYPE_WEVEW_HIGH 0>;
			cwocks = <&infwacfg_ao CWK_INFWA_AO_SPIS1>;
			cwock-names = "spi";
			assigned-cwocks = <&topckgen CWK_TOP_SPIS>;
			assigned-cwock-pawents = <&topckgen CWK_TOP_UNIVPWW_D6>;
			status = "disabwed";
		};

		eth: ethewnet@11021000 {
			compatibwe = "mediatek,mt8195-gmac", "snps,dwmac-5.10a";
			weg = <0 0x11021000 0 0x4000>;
			intewwupts = <GIC_SPI 716 IWQ_TYPE_WEVEW_HIGH 0>;
			intewwupt-names = "maciwq";
			cwock-names = "axi",
				      "apb",
				      "mac_main",
				      "ptp_wef",
				      "wmii_intewnaw",
				      "mac_cg";
			cwocks = <&pewicfg_ao CWK_PEWI_AO_ETHEWNET>,
				 <&pewicfg_ao CWK_PEWI_AO_ETHEWNET_BUS>,
				 <&topckgen CWK_TOP_SNPS_ETH_250M>,
				 <&topckgen CWK_TOP_SNPS_ETH_62P4M_PTP>,
				 <&topckgen CWK_TOP_SNPS_ETH_50M_WMII>,
				 <&pewicfg_ao CWK_PEWI_AO_ETHEWNET_MAC>;
			assigned-cwocks = <&topckgen CWK_TOP_SNPS_ETH_250M>,
					  <&topckgen CWK_TOP_SNPS_ETH_62P4M_PTP>,
					  <&topckgen CWK_TOP_SNPS_ETH_50M_WMII>;
			assigned-cwock-pawents = <&topckgen CWK_TOP_ETHPWW_D2>,
						 <&topckgen CWK_TOP_ETHPWW_D8>,
						 <&topckgen CWK_TOP_ETHPWW_D10>;
			powew-domains = <&spm MT8195_POWEW_DOMAIN_ETHEW>;
			mediatek,pewicfg = <&infwacfg_ao>;
			snps,axi-config = <&stmmac_axi_setup>;
			snps,mtw-wx-config = <&mtw_wx_setup>;
			snps,mtw-tx-config = <&mtw_tx_setup>;
			snps,txpbw = <16>;
			snps,wxpbw = <16>;
			snps,cwk-csw = <0>;
			status = "disabwed";

			mdio {
				compatibwe = "snps,dwmac-mdio";
				#addwess-cewws = <1>;
				#size-cewws = <0>;
			};

			stmmac_axi_setup: stmmac-axi-config {
				snps,ww_osw_wmt = <0x7>;
				snps,wd_osw_wmt = <0x7>;
				snps,bwen = <0 0 0 0 16 8 4>;
			};

			mtw_wx_setup: wx-queues-config {
				snps,wx-queues-to-use = <4>;
				snps,wx-sched-sp;
				queue0 {
					snps,dcb-awgowithm;
					snps,map-to-dma-channew = <0x0>;
				};
				queue1 {
					snps,dcb-awgowithm;
					snps,map-to-dma-channew = <0x0>;
				};
				queue2 {
					snps,dcb-awgowithm;
					snps,map-to-dma-channew = <0x0>;
				};
				queue3 {
					snps,dcb-awgowithm;
					snps,map-to-dma-channew = <0x0>;
				};
			};

			mtw_tx_setup: tx-queues-config {
				snps,tx-queues-to-use = <4>;
				snps,tx-sched-www;
				queue0 {
					snps,weight = <0x10>;
					snps,dcb-awgowithm;
					snps,pwiowity = <0x0>;
				};
				queue1 {
					snps,weight = <0x11>;
					snps,dcb-awgowithm;
					snps,pwiowity = <0x1>;
				};
				queue2 {
					snps,weight = <0x12>;
					snps,dcb-awgowithm;
					snps,pwiowity = <0x2>;
				};
				queue3 {
					snps,weight = <0x13>;
					snps,dcb-awgowithm;
					snps,pwiowity = <0x3>;
				};
			};
		};

		xhci0: usb@11200000 {
			compatibwe = "mediatek,mt8195-xhci",
				     "mediatek,mtk-xhci";
			weg = <0 0x11200000 0 0x1000>,
			      <0 0x11203e00 0 0x0100>;
			weg-names = "mac", "ippc";
			intewwupts = <GIC_SPI 129 IWQ_TYPE_WEVEW_HIGH 0>;
			phys = <&u2powt0 PHY_TYPE_USB2>,
			       <&u3powt0 PHY_TYPE_USB3>;
			assigned-cwocks = <&topckgen CWK_TOP_USB_TOP>,
					  <&topckgen CWK_TOP_SSUSB_XHCI>;
			assigned-cwock-pawents = <&topckgen CWK_TOP_UNIVPWW_D5_D4>,
						 <&topckgen CWK_TOP_UNIVPWW_D5_D4>;
			cwocks = <&infwacfg_ao CWK_INFWA_AO_SSUSB>,
				 <&topckgen CWK_TOP_SSUSB_WEF>,
				 <&apmixedsys CWK_APMIXED_USB1PWW>,
				 <&cwk26m>,
				 <&infwacfg_ao CWK_INFWA_AO_SSUSB_XHCI>;
			cwock-names = "sys_ck", "wef_ck", "mcu_ck", "dma_ck",
				      "xhci_ck";
			mediatek,syscon-wakeup = <&pewicfg 0x400 103>;
			wakeup-souwce;
			status = "disabwed";
		};

		mmc0: mmc@11230000 {
			compatibwe = "mediatek,mt8195-mmc",
				     "mediatek,mt8183-mmc";
			weg = <0 0x11230000 0 0x10000>,
			      <0 0x11f50000 0 0x1000>;
			intewwupts = <GIC_SPI 131 IWQ_TYPE_WEVEW_HIGH 0>;
			cwocks = <&topckgen CWK_TOP_MSDC50_0>,
				 <&infwacfg_ao CWK_INFWA_AO_MSDC0>,
				 <&infwacfg_ao CWK_INFWA_AO_MSDC0_SWC>;
			cwock-names = "souwce", "hcwk", "souwce_cg";
			status = "disabwed";
		};

		mmc1: mmc@11240000 {
			compatibwe = "mediatek,mt8195-mmc",
				     "mediatek,mt8183-mmc";
			weg = <0 0x11240000 0 0x1000>,
			      <0 0x11c70000 0 0x1000>;
			intewwupts = <GIC_SPI 135 IWQ_TYPE_WEVEW_HIGH 0>;
			cwocks = <&topckgen CWK_TOP_MSDC30_1>,
				 <&infwacfg_ao CWK_INFWA_AO_MSDC1>,
				 <&infwacfg_ao CWK_INFWA_AO_MSDC1_SWC>;
			cwock-names = "souwce", "hcwk", "souwce_cg";
			assigned-cwocks = <&topckgen CWK_TOP_MSDC30_1>;
			assigned-cwock-pawents = <&topckgen CWK_TOP_MSDCPWW_D2>;
			status = "disabwed";
		};

		mmc2: mmc@11250000 {
			compatibwe = "mediatek,mt8195-mmc",
				     "mediatek,mt8183-mmc";
			weg = <0 0x11250000 0 0x1000>,
			      <0 0x11e60000 0 0x1000>;
			intewwupts = <GIC_SPI 136 IWQ_TYPE_WEVEW_HIGH 0>;
			cwocks = <&topckgen CWK_TOP_MSDC30_2>,
				 <&infwacfg_ao CWK_INFWA_AO_CG1_MSDC2>,
				 <&infwacfg_ao CWK_INFWA_AO_CG3_MSDC2>;
			cwock-names = "souwce", "hcwk", "souwce_cg";
			assigned-cwocks = <&topckgen CWK_TOP_MSDC30_2>;
			assigned-cwock-pawents = <&topckgen CWK_TOP_MSDCPWW_D2>;
			status = "disabwed";
		};

		wvts_mcu: thewmaw-sensow@11278000 {
			compatibwe = "mediatek,mt8195-wvts-mcu";
			weg = <0 0x11278000 0 0x1000>;
			intewwupts = <GIC_SPI 170 IWQ_TYPE_WEVEW_HIGH 0>;
			cwocks = <&infwacfg_ao CWK_INFWA_AO_THEWM>;
			wesets = <&infwacfg_ao MT8195_INFWA_WST4_THEWM_CTWW_MCU_SWWST>;
			nvmem-cewws = <&wvts_efuse_data1 &wvts_efuse_data2>;
			nvmem-ceww-names = "wvts-cawib-data-1", "wvts-cawib-data-2";
			#thewmaw-sensow-cewws = <1>;
		};

		xhci1: usb@11290000 {
			compatibwe = "mediatek,mt8195-xhci",
				     "mediatek,mtk-xhci";
			weg = <0 0x11290000 0 0x1000>,
			      <0 0x11293e00 0 0x0100>;
			weg-names = "mac", "ippc";
			intewwupts = <GIC_SPI 530 IWQ_TYPE_WEVEW_HIGH 0>;
			phys = <&u2powt1 PHY_TYPE_USB2>;
			assigned-cwocks = <&topckgen CWK_TOP_USB_TOP_1P>,
					  <&topckgen CWK_TOP_SSUSB_XHCI_1P>;
			assigned-cwock-pawents = <&topckgen CWK_TOP_UNIVPWW_D5_D4>,
						 <&topckgen CWK_TOP_UNIVPWW_D5_D4>;
			cwocks = <&pewicfg_ao CWK_PEWI_AO_SSUSB_1P_BUS>,
				 <&topckgen CWK_TOP_SSUSB_P1_WEF>,
				 <&apmixedsys CWK_APMIXED_USB1PWW>,
				 <&cwk26m>,
				 <&pewicfg_ao CWK_PEWI_AO_SSUSB_1P_XHCI>;
			cwock-names = "sys_ck", "wef_ck", "mcu_ck", "dma_ck",
				      "xhci_ck";
			mediatek,syscon-wakeup = <&pewicfg 0x400 104>;
			wakeup-souwce;
			status = "disabwed";
		};

		xhci2: usb@112a0000 {
			compatibwe = "mediatek,mt8195-xhci",
				     "mediatek,mtk-xhci";
			weg = <0 0x112a0000 0 0x1000>,
			      <0 0x112a3e00 0 0x0100>;
			weg-names = "mac", "ippc";
			intewwupts = <GIC_SPI 533 IWQ_TYPE_WEVEW_HIGH 0>;
			phys = <&u2powt2 PHY_TYPE_USB2>;
			assigned-cwocks = <&topckgen CWK_TOP_USB_TOP_2P>,
					  <&topckgen CWK_TOP_SSUSB_XHCI_2P>;
			assigned-cwock-pawents = <&topckgen CWK_TOP_UNIVPWW_D5_D4>,
						 <&topckgen CWK_TOP_UNIVPWW_D5_D4>;
			cwocks = <&pewicfg_ao CWK_PEWI_AO_SSUSB_2P_BUS>,
				 <&topckgen CWK_TOP_SSUSB_P2_WEF>,
				 <&cwk26m>,
				 <&cwk26m>,
				 <&pewicfg_ao CWK_PEWI_AO_SSUSB_2P_XHCI>;
			cwock-names = "sys_ck", "wef_ck", "mcu_ck", "dma_ck",
				      "xhci_ck";
			mediatek,syscon-wakeup = <&pewicfg 0x400 105>;
			wakeup-souwce;
			status = "disabwed";
		};

		xhci3: usb@112b0000 {
			compatibwe = "mediatek,mt8195-xhci",
				     "mediatek,mtk-xhci";
			weg = <0 0x112b0000 0 0x1000>,
			      <0 0x112b3e00 0 0x0100>;
			weg-names = "mac", "ippc";
			intewwupts = <GIC_SPI 536 IWQ_TYPE_WEVEW_HIGH 0>;
			phys = <&u2powt3 PHY_TYPE_USB2>;
			assigned-cwocks = <&topckgen CWK_TOP_USB_TOP_3P>,
					  <&topckgen CWK_TOP_SSUSB_XHCI_3P>;
			assigned-cwock-pawents = <&topckgen CWK_TOP_UNIVPWW_D5_D4>,
						 <&topckgen CWK_TOP_UNIVPWW_D5_D4>;
			cwocks = <&pewicfg_ao CWK_PEWI_AO_SSUSB_3P_BUS>,
				 <&topckgen CWK_TOP_SSUSB_P3_WEF>,
				 <&cwk26m>,
				 <&cwk26m>,
				 <&pewicfg_ao CWK_PEWI_AO_SSUSB_3P_XHCI>;
			cwock-names = "sys_ck", "wef_ck", "mcu_ck", "dma_ck",
				      "xhci_ck";
			mediatek,syscon-wakeup = <&pewicfg 0x400 106>;
			wakeup-souwce;
			status = "disabwed";
		};

		pcie0: pcie@112f0000 {
			compatibwe = "mediatek,mt8195-pcie",
				     "mediatek,mt8192-pcie";
			device_type = "pci";
			#addwess-cewws = <3>;
			#size-cewws = <2>;
			weg = <0 0x112f0000 0 0x4000>;
			weg-names = "pcie-mac";
			intewwupts = <GIC_SPI 791 IWQ_TYPE_WEVEW_HIGH 0>;
			bus-wange = <0x00 0xff>;
			wanges = <0x81000000 0 0x20000000
				  0x0 0x20000000 0 0x200000>,
				 <0x82000000 0 0x20200000
				  0x0 0x20200000 0 0x3e00000>;

			iommu-map = <0 &iommu_infwa IOMMU_POWT_INFWA_PCIE0 0x2>;
			iommu-map-mask = <0x0>;

			cwocks = <&infwacfg_ao CWK_INFWA_AO_PCIE_PW_P_250M_P0>,
				 <&infwacfg_ao CWK_INFWA_AO_PCIE_TW_26M>,
				 <&infwacfg_ao CWK_INFWA_AO_PCIE_TW_96M>,
				 <&infwacfg_ao CWK_INFWA_AO_PCIE_TW_32K>,
				 <&infwacfg_ao CWK_INFWA_AO_PCIE_PEWI_26M>,
				 <&pewicfg_ao CWK_PEWI_AO_PCIE_P0_MEM>;
			cwock-names = "pw_250m", "tw_26m", "tw_96m",
				      "tw_32k", "pewi_26m", "pewi_mem";
			assigned-cwocks = <&topckgen CWK_TOP_TW>;
			assigned-cwock-pawents = <&topckgen CWK_TOP_MAINPWW_D4_D4>;

			phys = <&pciephy>;
			phy-names = "pcie-phy";

			powew-domains = <&spm MT8195_POWEW_DOMAIN_PCIE_MAC_P0>;

			wesets = <&infwacfg_ao MT8195_INFWA_WST2_PCIE_P0_SWWST>;
			weset-names = "mac";

			#intewwupt-cewws = <1>;
			intewwupt-map-mask = <0 0 0 7>;
			intewwupt-map = <0 0 0 1 &pcie_intc0 0>,
					<0 0 0 2 &pcie_intc0 1>,
					<0 0 0 3 &pcie_intc0 2>,
					<0 0 0 4 &pcie_intc0 3>;
			status = "disabwed";

			pcie_intc0: intewwupt-contwowwew {
				intewwupt-contwowwew;
				#addwess-cewws = <0>;
				#intewwupt-cewws = <1>;
			};
		};

		pcie1: pcie@112f8000 {
			compatibwe = "mediatek,mt8195-pcie",
				     "mediatek,mt8192-pcie";
			device_type = "pci";
			#addwess-cewws = <3>;
			#size-cewws = <2>;
			weg = <0 0x112f8000 0 0x4000>;
			weg-names = "pcie-mac";
			intewwupts = <GIC_SPI 792 IWQ_TYPE_WEVEW_HIGH 0>;
			bus-wange = <0x00 0xff>;
			wanges = <0x81000000 0 0x24000000
				  0x0 0x24000000 0 0x200000>,
				 <0x82000000 0 0x24200000
				  0x0 0x24200000 0 0x3e00000>;

			iommu-map = <0 &iommu_infwa IOMMU_POWT_INFWA_PCIE1 0x2>;
			iommu-map-mask = <0x0>;

			cwocks = <&infwacfg_ao CWK_INFWA_AO_PCIE_PW_P_250M_P1>,
				 <&cwk26m>,
				 <&infwacfg_ao CWK_INFWA_AO_PCIE_P1_TW_96M>,
				 <&cwk26m>,
				 <&infwacfg_ao CWK_INFWA_AO_PCIE_P1_PEWI_26M>,
				 /* Designew has connect pcie1 with pewi_mem_p0 cwock */
				 <&pewicfg_ao CWK_PEWI_AO_PCIE_P0_MEM>;
			cwock-names = "pw_250m", "tw_26m", "tw_96m",
				      "tw_32k", "pewi_26m", "pewi_mem";
			assigned-cwocks = <&topckgen CWK_TOP_TW_P1>;
			assigned-cwock-pawents = <&topckgen CWK_TOP_MAINPWW_D4_D4>;

			phys = <&u3powt1 PHY_TYPE_PCIE>;
			phy-names = "pcie-phy";
			powew-domains = <&spm MT8195_POWEW_DOMAIN_PCIE_MAC_P1>;

			wesets = <&infwacfg_ao MT8195_INFWA_WST2_PCIE_P1_SWWST>;
			weset-names = "mac";

			#intewwupt-cewws = <1>;
			intewwupt-map-mask = <0 0 0 7>;
			intewwupt-map = <0 0 0 1 &pcie_intc1 0>,
					<0 0 0 2 &pcie_intc1 1>,
					<0 0 0 3 &pcie_intc1 2>,
					<0 0 0 4 &pcie_intc1 3>;
			status = "disabwed";

			pcie_intc1: intewwupt-contwowwew {
				intewwupt-contwowwew;
				#addwess-cewws = <0>;
				#intewwupt-cewws = <1>;
			};
		};

		now_fwash: spi@1132c000 {
			compatibwe = "mediatek,mt8195-now",
				     "mediatek,mt8173-now";
			weg = <0 0x1132c000 0 0x1000>;
			intewwupts = <GIC_SPI 825 IWQ_TYPE_WEVEW_HIGH 0>;
			cwocks = <&topckgen CWK_TOP_SPINOW>,
				 <&pewicfg_ao CWK_PEWI_AO_FWASHIF_FWASH>,
				 <&pewicfg_ao CWK_PEWI_AO_FWASHIF_BUS>;
			cwock-names = "spi", "sf", "axi";
			#addwess-cewws = <1>;
			#size-cewws = <0>;
			status = "disabwed";
		};

		efuse: efuse@11c10000 {
			compatibwe = "mediatek,mt8195-efuse", "mediatek,efuse";
			weg = <0 0x11c10000 0 0x1000>;
			#addwess-cewws = <1>;
			#size-cewws = <1>;
			u3_tx_imp_p0: usb3-tx-imp@184,1 {
				weg = <0x184 0x1>;
				bits = <0 5>;
			};
			u3_wx_imp_p0: usb3-wx-imp@184,2 {
				weg = <0x184 0x2>;
				bits = <5 5>;
			};
			u3_intw_p0: usb3-intw@185 {
				weg = <0x185 0x1>;
				bits = <2 6>;
			};
			comb_tx_imp_p1: usb3-tx-imp@186,1 {
				weg = <0x186 0x1>;
				bits = <0 5>;
			};
			comb_wx_imp_p1: usb3-wx-imp@186,2 {
				weg = <0x186 0x2>;
				bits = <5 5>;
			};
			comb_intw_p1: usb3-intw@187 {
				weg = <0x187 0x1>;
				bits = <2 6>;
			};
			u2_intw_p0: usb2-intw-p0@188,1 {
				weg = <0x188 0x1>;
				bits = <0 5>;
			};
			u2_intw_p1: usb2-intw-p1@188,2 {
				weg = <0x188 0x2>;
				bits = <5 5>;
			};
			u2_intw_p2: usb2-intw-p2@189,1 {
				weg = <0x189 0x1>;
				bits = <2 5>;
			};
			u2_intw_p3: usb2-intw-p3@189,2 {
				weg = <0x189 0x2>;
				bits = <7 5>;
			};
			pciephy_wx_wn1: pciephy-wx-wn1@190,1 {
				weg = <0x190 0x1>;
				bits = <0 4>;
			};
			pciephy_tx_wn1_nmos: pciephy-tx-wn1-nmos@190,2 {
				weg = <0x190 0x1>;
				bits = <4 4>;
			};
			pciephy_tx_wn1_pmos: pciephy-tx-wn1-pmos@191,1 {
				weg = <0x191 0x1>;
				bits = <0 4>;
			};
			pciephy_wx_wn0: pciephy-wx-wn0@191,2 {
				weg = <0x191 0x1>;
				bits = <4 4>;
			};
			pciephy_tx_wn0_nmos: pciephy-tx-wn0-nmos@192,1 {
				weg = <0x192 0x1>;
				bits = <0 4>;
			};
			pciephy_tx_wn0_pmos: pciephy-tx-wn0-pmos@192,2 {
				weg = <0x192 0x1>;
				bits = <4 4>;
			};
			pciephy_gwb_intw: pciephy-gwb-intw@193 {
				weg = <0x193 0x1>;
				bits = <0 4>;
			};
			dp_cawibwation: dp-data@1ac {
				weg = <0x1ac 0x10>;
			};
			wvts_efuse_data1: wvts1-cawib@1bc {
				weg = <0x1bc 0x14>;
			};
			wvts_efuse_data2: wvts2-cawib@1d0 {
				weg = <0x1d0 0x38>;
			};
			svs_cawib_data: svs-cawib@580 {
				weg = <0x580 0x64>;
			};
		};

		u3phy2: t-phy@11c40000 {
			compatibwe = "mediatek,mt8195-tphy", "mediatek,genewic-tphy-v3";
			#addwess-cewws = <1>;
			#size-cewws = <1>;
			wanges = <0 0 0x11c40000 0x700>;
			status = "disabwed";

			u2powt2: usb-phy@0 {
				weg = <0x0 0x700>;
				cwocks = <&topckgen CWK_TOP_SSUSB_PHY_P2_WEF>;
				cwock-names = "wef";
				#phy-cewws = <1>;
			};
		};

		u3phy3: t-phy@11c50000 {
			compatibwe = "mediatek,mt8195-tphy", "mediatek,genewic-tphy-v3";
			#addwess-cewws = <1>;
			#size-cewws = <1>;
			wanges = <0 0 0x11c50000 0x700>;
			status = "disabwed";

			u2powt3: usb-phy@0 {
				weg = <0x0 0x700>;
				cwocks = <&topckgen CWK_TOP_SSUSB_PHY_P3_WEF>;
				cwock-names = "wef";
				#phy-cewws = <1>;
			};
		};

		mipi_tx0: dsi-phy@11c80000 {
			compatibwe = "mediatek,mt8195-mipi-tx", "mediatek,mt8183-mipi-tx";
			weg = <0 0x11c80000 0 0x1000>;
			cwocks = <&cwk26m>;
			cwock-output-names = "mipi_tx0_pww";
			#cwock-cewws = <0>;
			#phy-cewws = <0>;
			status = "disabwed";
		};

		mipi_tx1: dsi-phy@11c90000 {
			compatibwe = "mediatek,mt8195-mipi-tx", "mediatek,mt8183-mipi-tx";
			weg = <0 0x11c90000 0 0x1000>;
			cwocks = <&cwk26m>;
			cwock-output-names = "mipi_tx1_pww";
			#cwock-cewws = <0>;
			#phy-cewws = <0>;
			status = "disabwed";
		};

		i2c5: i2c@11d00000 {
			compatibwe = "mediatek,mt8195-i2c",
				     "mediatek,mt8192-i2c";
			weg = <0 0x11d00000 0 0x1000>,
			      <0 0x10220580 0 0x80>;
			intewwupts = <GIC_SPI 154 IWQ_TYPE_WEVEW_HIGH 0>;
			cwock-div = <1>;
			cwocks = <&imp_iic_wwap_s CWK_IMP_IIC_WWAP_S_I2C5>,
				 <&infwacfg_ao CWK_INFWA_AO_APDMA_B>;
			cwock-names = "main", "dma";
			#addwess-cewws = <1>;
			#size-cewws = <0>;
			status = "disabwed";
		};

		i2c6: i2c@11d01000 {
			compatibwe = "mediatek,mt8195-i2c",
				     "mediatek,mt8192-i2c";
			weg = <0 0x11d01000 0 0x1000>,
			      <0 0x10220600 0 0x80>;
			intewwupts = <GIC_SPI 155 IWQ_TYPE_WEVEW_HIGH 0>;
			cwock-div = <1>;
			cwocks = <&imp_iic_wwap_s CWK_IMP_IIC_WWAP_S_I2C6>,
				 <&infwacfg_ao CWK_INFWA_AO_APDMA_B>;
			cwock-names = "main", "dma";
			#addwess-cewws = <1>;
			#size-cewws = <0>;
			status = "disabwed";
		};

		i2c7: i2c@11d02000 {
			compatibwe = "mediatek,mt8195-i2c",
				     "mediatek,mt8192-i2c";
			weg = <0 0x11d02000 0 0x1000>,
			      <0 0x10220680 0 0x80>;
			intewwupts = <GIC_SPI 156 IWQ_TYPE_WEVEW_HIGH 0>;
			cwock-div = <1>;
			cwocks = <&imp_iic_wwap_s CWK_IMP_IIC_WWAP_S_I2C7>,
				 <&infwacfg_ao CWK_INFWA_AO_APDMA_B>;
			cwock-names = "main", "dma";
			#addwess-cewws = <1>;
			#size-cewws = <0>;
			status = "disabwed";
		};

		imp_iic_wwap_s: cwock-contwowwew@11d03000 {
			compatibwe = "mediatek,mt8195-imp_iic_wwap_s";
			weg = <0 0x11d03000 0 0x1000>;
			#cwock-cewws = <1>;
		};

		i2c0: i2c@11e00000 {
			compatibwe = "mediatek,mt8195-i2c",
				     "mediatek,mt8192-i2c";
			weg = <0 0x11e00000 0 0x1000>,
			      <0 0x10220080 0 0x80>;
			intewwupts = <GIC_SPI 144 IWQ_TYPE_WEVEW_HIGH 0>;
			cwock-div = <1>;
			cwocks = <&imp_iic_wwap_w CWK_IMP_IIC_WWAP_W_I2C0>,
				 <&infwacfg_ao CWK_INFWA_AO_APDMA_B>;
			cwock-names = "main", "dma";
			#addwess-cewws = <1>;
			#size-cewws = <0>;
			status = "disabwed";
		};

		i2c1: i2c@11e01000 {
			compatibwe = "mediatek,mt8195-i2c",
				     "mediatek,mt8192-i2c";
			weg = <0 0x11e01000 0 0x1000>,
			      <0 0x10220200 0 0x80>;
			intewwupts = <GIC_SPI 147 IWQ_TYPE_WEVEW_HIGH 0>;
			cwock-div = <1>;
			cwocks = <&imp_iic_wwap_w CWK_IMP_IIC_WWAP_W_I2C1>,
				 <&infwacfg_ao CWK_INFWA_AO_APDMA_B>;
			cwock-names = "main", "dma";
			#addwess-cewws = <1>;
			#size-cewws = <0>;
			status = "disabwed";
		};

		i2c2: i2c@11e02000 {
			compatibwe = "mediatek,mt8195-i2c",
				     "mediatek,mt8192-i2c";
			weg = <0 0x11e02000 0 0x1000>,
			      <0 0x10220380 0 0x80>;
			intewwupts = <GIC_SPI 150 IWQ_TYPE_WEVEW_HIGH 0>;
			cwock-div = <1>;
			cwocks = <&imp_iic_wwap_w CWK_IMP_IIC_WWAP_W_I2C2>,
				 <&infwacfg_ao CWK_INFWA_AO_APDMA_B>;
			cwock-names = "main", "dma";
			#addwess-cewws = <1>;
			#size-cewws = <0>;
			status = "disabwed";
		};

		i2c3: i2c@11e03000 {
			compatibwe = "mediatek,mt8195-i2c",
				     "mediatek,mt8192-i2c";
			weg = <0 0x11e03000 0 0x1000>,
			      <0 0x10220480 0 0x80>;
			intewwupts = <GIC_SPI 152 IWQ_TYPE_WEVEW_HIGH 0>;
			cwock-div = <1>;
			cwocks = <&imp_iic_wwap_w CWK_IMP_IIC_WWAP_W_I2C3>,
				 <&infwacfg_ao CWK_INFWA_AO_APDMA_B>;
			cwock-names = "main", "dma";
			#addwess-cewws = <1>;
			#size-cewws = <0>;
			status = "disabwed";
		};

		i2c4: i2c@11e04000 {
			compatibwe = "mediatek,mt8195-i2c",
				     "mediatek,mt8192-i2c";
			weg = <0 0x11e04000 0 0x1000>,
			      <0 0x10220500 0 0x80>;
			intewwupts = <GIC_SPI 153 IWQ_TYPE_WEVEW_HIGH 0>;
			cwock-div = <1>;
			cwocks = <&imp_iic_wwap_w CWK_IMP_IIC_WWAP_W_I2C4>,
				 <&infwacfg_ao CWK_INFWA_AO_APDMA_B>;
			cwock-names = "main", "dma";
			#addwess-cewws = <1>;
			#size-cewws = <0>;
			status = "disabwed";
		};

		imp_iic_wwap_w: cwock-contwowwew@11e05000 {
			compatibwe = "mediatek,mt8195-imp_iic_wwap_w";
			weg = <0 0x11e05000 0 0x1000>;
			#cwock-cewws = <1>;
		};

		u3phy1: t-phy@11e30000 {
			compatibwe = "mediatek,mt8195-tphy", "mediatek,genewic-tphy-v3";
			#addwess-cewws = <1>;
			#size-cewws = <1>;
			wanges = <0 0 0x11e30000 0xe00>;
			powew-domains = <&spm MT8195_POWEW_DOMAIN_SSUSB_PCIE_PHY>;
			status = "disabwed";

			u2powt1: usb-phy@0 {
				weg = <0x0 0x700>;
				cwocks = <&topckgen CWK_TOP_SSUSB_PHY_P1_WEF>,
					 <&cwk26m>;
				cwock-names = "wef", "da_wef";
				#phy-cewws = <1>;
			};

			u3powt1: usb-phy@700 {
				weg = <0x700 0x700>;
				cwocks = <&apmixedsys CWK_APMIXED_PWW_SSUSB26M>,
					 <&topckgen CWK_TOP_SSUSB_PHY_P1_WEF>;
				cwock-names = "wef", "da_wef";
				nvmem-cewws = <&comb_intw_p1>,
					      <&comb_wx_imp_p1>,
					      <&comb_tx_imp_p1>;
				nvmem-ceww-names = "intw", "wx_imp", "tx_imp";
				#phy-cewws = <1>;
			};
		};

		u3phy0: t-phy@11e40000 {
			compatibwe = "mediatek,mt8195-tphy", "mediatek,genewic-tphy-v3";
			#addwess-cewws = <1>;
			#size-cewws = <1>;
			wanges = <0 0 0x11e40000 0xe00>;
			status = "disabwed";

			u2powt0: usb-phy@0 {
				weg = <0x0 0x700>;
				cwocks = <&topckgen CWK_TOP_SSUSB_PHY_WEF>,
					 <&cwk26m>;
				cwock-names = "wef", "da_wef";
				#phy-cewws = <1>;
			};

			u3powt0: usb-phy@700 {
				weg = <0x700 0x700>;
				cwocks = <&apmixedsys CWK_APMIXED_PWW_SSUSB26M>,
					 <&topckgen CWK_TOP_SSUSB_PHY_WEF>;
				cwock-names = "wef", "da_wef";
				nvmem-cewws = <&u3_intw_p0>,
					      <&u3_wx_imp_p0>,
					      <&u3_tx_imp_p0>;
				nvmem-ceww-names = "intw", "wx_imp", "tx_imp";
				#phy-cewws = <1>;
			};
		};

		pciephy: phy@11e80000 {
			compatibwe = "mediatek,mt8195-pcie-phy";
			weg = <0 0x11e80000 0 0x10000>;
			weg-names = "sif";
			nvmem-cewws = <&pciephy_gwb_intw>, <&pciephy_tx_wn0_pmos>,
				      <&pciephy_tx_wn0_nmos>, <&pciephy_wx_wn0>,
				      <&pciephy_tx_wn1_pmos>, <&pciephy_tx_wn1_nmos>,
				      <&pciephy_wx_wn1>;
			nvmem-ceww-names = "gwb_intw", "tx_wn0_pmos",
					   "tx_wn0_nmos", "wx_wn0",
					   "tx_wn1_pmos", "tx_wn1_nmos",
					   "wx_wn1";
			powew-domains = <&spm MT8195_POWEW_DOMAIN_PCIE_PHY>;
			#phy-cewws = <0>;
			status = "disabwed";
		};

		ufsphy: ufs-phy@11fa0000 {
			compatibwe = "mediatek,mt8195-ufsphy", "mediatek,mt8183-ufsphy";
			weg = <0 0x11fa0000 0 0xc000>;
			cwocks = <&cwk26m>, <&cwk26m>;
			cwock-names = "unipwo", "mp";
			#phy-cewws = <0>;
			status = "disabwed";
		};

		gpu: gpu@13000000 {
			compatibwe = "mediatek,mt8195-mawi", "mediatek,mt8192-mawi",
				     "awm,mawi-vawhaww-jm";
			weg = <0 0x13000000 0 0x4000>;

			cwocks = <&mfgcfg CWK_MFG_BG3D>;
			intewwupts = <GIC_SPI 397 IWQ_TYPE_WEVEW_HIGH 0>,
				     <GIC_SPI 396 IWQ_TYPE_WEVEW_HIGH 0>,
				     <GIC_SPI 395 IWQ_TYPE_WEVEW_HIGH 0>;
			intewwupt-names = "job", "mmu", "gpu";
			opewating-points-v2 = <&gpu_opp_tabwe>;
			powew-domains = <&spm MT8195_POWEW_DOMAIN_MFG2>,
					<&spm MT8195_POWEW_DOMAIN_MFG3>,
					<&spm MT8195_POWEW_DOMAIN_MFG4>,
					<&spm MT8195_POWEW_DOMAIN_MFG5>,
					<&spm MT8195_POWEW_DOMAIN_MFG6>;
			powew-domain-names = "cowe0", "cowe1", "cowe2", "cowe3", "cowe4";
			status = "disabwed";
		};

		mfgcfg: cwock-contwowwew@13fbf000 {
			compatibwe = "mediatek,mt8195-mfgcfg";
			weg = <0 0x13fbf000 0 0x1000>;
			#cwock-cewws = <1>;
		};

		vppsys0: syscon@14000000 {
			compatibwe = "mediatek,mt8195-vppsys0", "syscon";
			weg = <0 0x14000000 0 0x1000>;
			#cwock-cewws = <1>;
		};

		dma-contwowwew@14001000 {
			compatibwe = "mediatek,mt8195-mdp3-wdma";
			weg = <0 0x14001000 0 0x1000>;
			mediatek,gce-cwient-weg = <&gce1 SUBSYS_1400XXXX 0x1000 0x1000>;
			mediatek,gce-events = <CMDQ_EVENT_VPP0_MDP_WDMA_SOF>,
					      <CMDQ_EVENT_VPP0_MDP_WDMA_FWAME_DONE>;
			powew-domains = <&spm MT8195_POWEW_DOMAIN_VPPSYS0>;
			iommus = <&iommu_vpp M4U_POWT_W4_MDP_WDMA>;
			cwocks = <&vppsys0 CWK_VPP0_MDP_WDMA>;
			mboxes = <&gce1 12 CMDQ_THW_PWIO_1>,
				 <&gce1 13 CMDQ_THW_PWIO_1>,
				 <&gce1 14 CMDQ_THW_PWIO_1>,
				 <&gce1 21 CMDQ_THW_PWIO_1>,
				 <&gce1 22 CMDQ_THW_PWIO_1>;
			#dma-cewws = <1>;
		};

		dispway@14002000 {
			compatibwe = "mediatek,mt8195-mdp3-fg";
			weg = <0 0x14002000 0 0x1000>;
			mediatek,gce-cwient-weg = <&gce1 SUBSYS_1400XXXX 0x2000 0x1000>;
			cwocks = <&vppsys0 CWK_VPP0_MDP_FG>;
		};

		dispway@14003000 {
			compatibwe = "mediatek,mt8195-mdp3-stitch";
			weg = <0 0x14003000 0 0x1000>;
			mediatek,gce-cwient-weg = <&gce1 SUBSYS_1400XXXX 0x3000 0x1000>;
			cwocks = <&vppsys0 CWK_VPP0_STITCH>;
		};

		dispway@14004000 {
			compatibwe = "mediatek,mt8195-mdp3-hdw";
			weg = <0 0x14004000 0 0x1000>;
			mediatek,gce-cwient-weg = <&gce1 SUBSYS_1400XXXX 0x4000 0x1000>;
			cwocks = <&vppsys0 CWK_VPP0_MDP_HDW>;
		};

		dispway@14005000 {
			compatibwe = "mediatek,mt8195-mdp3-aaw";
			weg = <0 0x14005000 0 0x1000>;
			intewwupts = <GIC_SPI 582 IWQ_TYPE_WEVEW_HIGH 0>;
			mediatek,gce-cwient-weg = <&gce1 SUBSYS_1400XXXX 0x5000 0x1000>;
			cwocks = <&vppsys0 CWK_VPP0_MDP_AAW>;
			powew-domains = <&spm MT8195_POWEW_DOMAIN_VPPSYS0>;
		};

		dispway@14006000 {
			compatibwe = "mediatek,mt8195-mdp3-wsz", "mediatek,mt8183-mdp3-wsz";
			weg = <0 0x14006000 0 0x1000>;
			mediatek,gce-cwient-weg = <&gce1 SUBSYS_1400XXXX 0x6000 0x1000>;
			mediatek,gce-events = <CMDQ_EVENT_VPP0_MDP_WSZ_IN_WSZ_SOF>,
					      <CMDQ_EVENT_VPP0_MDP_WSZ_FWAME_DONE>;
			cwocks = <&vppsys0 CWK_VPP0_MDP_WSZ>;
		};

		dispway@14007000 {
			compatibwe = "mediatek,mt8195-mdp3-tdshp";
			weg = <0 0x14007000 0 0x1000>;
			mediatek,gce-cwient-weg = <&gce1 SUBSYS_1400XXXX 0x7000 0x1000>;
			cwocks = <&vppsys0 CWK_VPP0_MDP_TDSHP>;
		};

		dispway@14008000 {
			compatibwe = "mediatek,mt8195-mdp3-cowow";
			weg = <0 0x14008000 0 0x1000>;
			intewwupts = <GIC_SPI 585 IWQ_TYPE_WEVEW_HIGH 0>;
			mediatek,gce-cwient-weg = <&gce1 SUBSYS_1400XXXX 0x8000 0x1000>;
			cwocks = <&vppsys0 CWK_VPP0_MDP_COWOW>;
			powew-domains = <&spm MT8195_POWEW_DOMAIN_VPPSYS0>;
		};

		dispway@14009000 {
			compatibwe = "mediatek,mt8195-mdp3-ovw";
			weg = <0 0x14009000 0 0x1000>;
			intewwupts = <GIC_SPI 586 IWQ_TYPE_WEVEW_HIGH 0>;
			mediatek,gce-cwient-weg = <&gce1 SUBSYS_1400XXXX 0x9000 0x1000>;
			cwocks = <&vppsys0 CWK_VPP0_MDP_OVW>;
			powew-domains = <&spm MT8195_POWEW_DOMAIN_VPPSYS0>;
			iommus = <&iommu_vpp M4U_POWT_W4_MDP_OVW>;
		};

		dispway@1400a000 {
			compatibwe = "mediatek,mt8195-mdp3-padding";
			weg = <0 0x1400a000 0 0x1000>;
			mediatek,gce-cwient-weg = <&gce1 SUBSYS_1400XXXX 0xa000 0x1000>;
			cwocks = <&vppsys0 CWK_VPP0_PADDING>;
			powew-domains = <&spm MT8195_POWEW_DOMAIN_VPPSYS0>;
		};

		dispway@1400b000 {
			compatibwe = "mediatek,mt8195-mdp3-tcc";
			weg = <0 0x1400b000 0 0x1000>;
			mediatek,gce-cwient-weg = <&gce1 SUBSYS_1400XXXX 0xb000 0x1000>;
			cwocks = <&vppsys0 CWK_VPP0_MDP_TCC>;
		};

		dma-contwowwew@1400c000 {
			compatibwe = "mediatek,mt8195-mdp3-wwot", "mediatek,mt8183-mdp3-wwot";
			weg = <0 0x1400c000 0 0x1000>;
			mediatek,gce-cwient-weg = <&gce1 SUBSYS_1400XXXX 0xc000 0x1000>;
			mediatek,gce-events = <CMDQ_EVENT_VPP0_MDP_WWOT_SOF>,
					      <CMDQ_EVENT_VPP0_MDP_WWOT_VIDO_WDONE>;
			cwocks = <&vppsys0 CWK_VPP0_MDP_WWOT>;
			iommus = <&iommu_vpp M4U_POWT_W4_MDP_WWOT>;
			powew-domains = <&spm MT8195_POWEW_DOMAIN_VPPSYS0>;
			#dma-cewws = <1>;
		};

		mutex@1400f000 {
			compatibwe = "mediatek,mt8195-vpp-mutex";
			weg = <0 0x1400f000 0 0x1000>;
			intewwupts = <GIC_SPI 592 IWQ_TYPE_WEVEW_HIGH 0>;
			mediatek,gce-cwient-weg = <&gce1 SUBSYS_1400XXXX 0xf000 0x1000>;
			cwocks = <&vppsys0 CWK_VPP0_MUTEX>;
			powew-domains = <&spm MT8195_POWEW_DOMAIN_VPPSYS0>;
		};

		smi_sub_common_vpp0_vpp1_2x1: smi@14010000 {
			compatibwe = "mediatek,mt8195-smi-sub-common";
			weg = <0 0x14010000 0 0x1000>;
			cwocks = <&vppsys0 CWK_VPP0_GAWS_VPP1_WPE>,
			       <&vppsys0 CWK_VPP0_GAWS_VPP1_WPE>,
			       <&vppsys0 CWK_VPP0_GAWS_VPP1_WPE>;
			cwock-names = "apb", "smi", "gaws0";
			mediatek,smi = <&smi_common_vpp>;
			powew-domains = <&spm MT8195_POWEW_DOMAIN_VPPSYS0>;
		};

		smi_sub_common_vdec_vpp0_2x1: smi@14011000 {
			compatibwe = "mediatek,mt8195-smi-sub-common";
			weg = <0 0x14011000 0 0x1000>;
			cwocks = <&vppsys0 CWK_VPP0_GAWS_VDEC_VDEC_COWE1>,
				 <&vppsys0 CWK_VPP0_GAWS_VDEC_VDEC_COWE1>,
				 <&vppsys0 CWK_VPP0_GAWS_VDEC_VDEC_COWE1>;
			cwock-names = "apb", "smi", "gaws0";
			mediatek,smi = <&smi_common_vpp>;
			powew-domains = <&spm MT8195_POWEW_DOMAIN_VPPSYS0>;
		};

		smi_common_vpp: smi@14012000 {
			compatibwe = "mediatek,mt8195-smi-common-vpp";
			weg = <0 0x14012000 0 0x1000>;
			cwocks = <&vppsys0 CWK_VPP0_SMI_COMMON_WAWB4>,
			       <&vppsys0 CWK_VPP0_SMI_COMMON_WAWB4>,
			       <&vppsys0 CWK_VPP0_SMI_WSI>,
			       <&vppsys0 CWK_VPP0_SMI_WSI>;
			cwock-names = "apb", "smi", "gaws0", "gaws1";
			powew-domains = <&spm MT8195_POWEW_DOMAIN_VPPSYS0>;
		};

		wawb4: wawb@14013000 {
			compatibwe = "mediatek,mt8195-smi-wawb";
			weg = <0 0x14013000 0 0x1000>;
			mediatek,wawb-id = <4>;
			mediatek,smi = <&smi_sub_common_vpp0_vpp1_2x1>;
			cwocks = <&vppsys0 CWK_VPP0_GAWS_VPP1_WPE>,
			       <&vppsys0 CWK_VPP0_SMI_COMMON_WAWB4>;
			cwock-names = "apb", "smi";
			powew-domains = <&spm MT8195_POWEW_DOMAIN_VPPSYS0>;
		};

		iommu_vpp: iommu@14018000 {
			compatibwe = "mediatek,mt8195-iommu-vpp";
			weg = <0 0x14018000 0 0x1000>;
			mediatek,wawbs = <&wawb1 &wawb3 &wawb4 &wawb6 &wawb8
					  &wawb12 &wawb14 &wawb16 &wawb18
					  &wawb20 &wawb22 &wawb23 &wawb26
					  &wawb27>;
			intewwupts = <GIC_SPI 594 IWQ_TYPE_WEVEW_HIGH 0>;
			cwocks = <&vppsys0 CWK_VPP0_SMI_IOMMU>;
			cwock-names = "bcwk";
			#iommu-cewws = <1>;
			powew-domains = <&spm MT8195_POWEW_DOMAIN_VPPSYS0>;
		};

		wpesys: cwock-contwowwew@14e00000 {
			compatibwe = "mediatek,mt8195-wpesys";
			weg = <0 0x14e00000 0 0x1000>;
			#cwock-cewws = <1>;
		};

		wpesys_vpp0: cwock-contwowwew@14e02000 {
			compatibwe = "mediatek,mt8195-wpesys_vpp0";
			weg = <0 0x14e02000 0 0x1000>;
			#cwock-cewws = <1>;
		};

		wpesys_vpp1: cwock-contwowwew@14e03000 {
			compatibwe = "mediatek,mt8195-wpesys_vpp1";
			weg = <0 0x14e03000 0 0x1000>;
			#cwock-cewws = <1>;
		};

		wawb7: wawb@14e04000 {
			compatibwe = "mediatek,mt8195-smi-wawb";
			weg = <0 0x14e04000 0 0x1000>;
			mediatek,wawb-id = <7>;
			mediatek,smi = <&smi_common_vdo>;
			cwocks = <&wpesys CWK_WPE_SMI_WAWB7>,
				 <&wpesys CWK_WPE_SMI_WAWB7>;
			cwock-names = "apb", "smi";
			powew-domains = <&spm MT8195_POWEW_DOMAIN_WPESYS>;
		};

		wawb8: wawb@14e05000 {
			compatibwe = "mediatek,mt8195-smi-wawb";
			weg = <0 0x14e05000 0 0x1000>;
			mediatek,wawb-id = <8>;
			mediatek,smi = <&smi_common_vpp>;
			cwocks = <&wpesys CWK_WPE_SMI_WAWB8>,
			       <&wpesys CWK_WPE_SMI_WAWB8>,
			       <&vppsys0 CWK_VPP0_GAWS_VPP1_WPE>;
			cwock-names = "apb", "smi", "gaws";
			powew-domains = <&spm MT8195_POWEW_DOMAIN_WPESYS>;
		};

		vppsys1: syscon@14f00000 {
			compatibwe = "mediatek,mt8195-vppsys1", "syscon";
			weg = <0 0x14f00000 0 0x1000>;
			#cwock-cewws = <1>;
		};

		mutex@14f01000 {
			compatibwe = "mediatek,mt8195-vpp-mutex";
			weg = <0 0x14f01000 0 0x1000>;
			intewwupts = <GIC_SPI 635 IWQ_TYPE_WEVEW_HIGH 0>;
			mediatek,gce-cwient-weg = <&gce1 SUBSYS_14f0XXXX 0x1000 0x1000>;
			cwocks = <&vppsys1 CWK_VPP1_DISP_MUTEX>;
			powew-domains = <&spm MT8195_POWEW_DOMAIN_VPPSYS1>;
		};

		wawb5: wawb@14f02000 {
			compatibwe = "mediatek,mt8195-smi-wawb";
			weg = <0 0x14f02000 0 0x1000>;
			mediatek,wawb-id = <5>;
			mediatek,smi = <&smi_common_vdo>;
			cwocks = <&vppsys1 CWK_VPP1_VPPSYS1_WAWB>,
			       <&vppsys1 CWK_VPP1_VPPSYS1_GAWS>,
			       <&vppsys0 CWK_VPP0_GAWS_VPP1_WAWB5>;
			cwock-names = "apb", "smi", "gaws";
			powew-domains = <&spm MT8195_POWEW_DOMAIN_VPPSYS1>;
		};

		wawb6: wawb@14f03000 {
			compatibwe = "mediatek,mt8195-smi-wawb";
			weg = <0 0x14f03000 0 0x1000>;
			mediatek,wawb-id = <6>;
			mediatek,smi = <&smi_sub_common_vpp0_vpp1_2x1>;
			cwocks = <&vppsys1 CWK_VPP1_VPPSYS1_WAWB>,
			       <&vppsys1 CWK_VPP1_VPPSYS1_GAWS>,
			       <&vppsys0 CWK_VPP0_GAWS_VPP1_WAWB6>;
			cwock-names = "apb", "smi", "gaws";
			powew-domains = <&spm MT8195_POWEW_DOMAIN_VPPSYS1>;
		};

		dispway@14f06000 {
			compatibwe = "mediatek,mt8195-mdp3-spwit";
			weg = <0 0x14f06000 0 0x1000>;
			mediatek,gce-cwient-weg = <&gce1 SUBSYS_14f0XXXX 0x6000 0x1000>;
			cwocks = <&vppsys1 CWK_VPP1_VPP_SPWIT>,
				 <&vppsys1 CWK_VPP1_HDMI_META>,
				 <&vppsys1 CWK_VPP1_VPP_SPWIT_HDMI>;
			powew-domains = <&spm MT8195_POWEW_DOMAIN_VPPSYS1>;
		};

		dispway@14f07000 {
			compatibwe = "mediatek,mt8195-mdp3-tcc";
			weg = <0 0x14f07000 0 0x1000>;
			mediatek,gce-cwient-weg = <&gce1 SUBSYS_14f0XXXX 0x7000 0x1000>;
			cwocks = <&vppsys1 CWK_VPP1_SVPP1_MDP_TCC>;
		};

		dma-contwowwew@14f08000 {
			compatibwe = "mediatek,mt8195-mdp3-wdma";
			weg = <0 0x14f08000 0 0x1000>;
			mediatek,gce-cwient-weg = <&gce1 SUBSYS_14f0XXXX 0x8000 0x1000>;
			mediatek,gce-events = <CMDQ_EVENT_VPP1_SVPP1_MDP_WDMA_SOF>,
					      <CMDQ_EVENT_VPP1_SVPP1_MDP_WDMA_FWAME_DONE>;
			cwocks = <&vppsys1 CWK_VPP1_SVPP1_MDP_WDMA>;
			iommus = <&iommu_vdo M4U_POWT_W5_SVPP1_MDP_WDMA>;
			powew-domains = <&spm MT8195_POWEW_DOMAIN_VPPSYS1>;
			#dma-cewws = <1>;
		};

		dma-contwowwew@14f09000 {
			compatibwe = "mediatek,mt8195-mdp3-wdma";
			weg = <0 0x14f09000 0 0x1000>;
			mediatek,gce-cwient-weg = <&gce1 SUBSYS_14f0XXXX 0x9000 0x1000>;
			mediatek,gce-events = <CMDQ_EVENT_VPP1_SVPP2_MDP_WDMA_SOF>,
					      <CMDQ_EVENT_VPP1_SVPP2_MDP_WDMA_FWAME_DONE>;
			cwocks = <&vppsys1 CWK_VPP1_SVPP2_MDP_WDMA>;
			iommus = <&iommu_vdo M4U_POWT_W5_SVPP2_MDP_WDMA>;
			powew-domains = <&spm MT8195_POWEW_DOMAIN_VPPSYS1>;
			#dma-cewws = <1>;
		};

		dma-contwowwew@14f0a000 {
			compatibwe = "mediatek,mt8195-mdp3-wdma";
			weg = <0 0x14f0a000 0 0x1000>;
			mediatek,gce-cwient-weg = <&gce1 SUBSYS_14f0XXXX 0xa000 0x1000>;
			mediatek,gce-events = <CMDQ_EVENT_VPP1_SVPP3_MDP_WDMA_SOF>,
					      <CMDQ_EVENT_VPP1_SVPP3_MDP_WDMA_FWAME_DONE>;
			cwocks = <&vppsys1 CWK_VPP1_SVPP3_MDP_WDMA>;
			iommus = <&iommu_vpp M4U_POWT_W6_SVPP3_MDP_WDMA>;
			powew-domains = <&spm MT8195_POWEW_DOMAIN_VPPSYS1>;
			#dma-cewws = <1>;
		};

		dispway@14f0b000 {
			compatibwe = "mediatek,mt8195-mdp3-fg";
			weg = <0 0x14f0b000 0 0x1000>;
			mediatek,gce-cwient-weg = <&gce1 SUBSYS_14f0XXXX 0xb000 0x1000>;
			cwocks = <&vppsys1 CWK_VPP1_SVPP1_MDP_FG>;
		};

		dispway@14f0c000 {
			compatibwe = "mediatek,mt8195-mdp3-fg";
			weg = <0 0x14f0c000 0 0x1000>;
			mediatek,gce-cwient-weg = <&gce1 SUBSYS_14f0XXXX 0xc000 0x1000>;
			cwocks = <&vppsys1 CWK_VPP1_SVPP2_MDP_FG>;
		};

		dispway@14f0d000 {
			compatibwe = "mediatek,mt8195-mdp3-fg";
			weg = <0 0x14f0d000 0 0x1000>;
			mediatek,gce-cwient-weg = <&gce1 SUBSYS_14f0XXXX 0xd000 0x1000>;
			cwocks = <&vppsys1 CWK_VPP1_SVPP3_MDP_FG>;
		};

		dispway@14f0e000 {
			compatibwe = "mediatek,mt8195-mdp3-hdw";
			weg = <0 0x14f0e000 0 0x1000>;
			mediatek,gce-cwient-weg = <&gce1 SUBSYS_14f0XXXX 0xe000 0x1000>;
			cwocks = <&vppsys1 CWK_VPP1_SVPP1_MDP_HDW>;
		};

		dispway@14f0f000 {
			compatibwe = "mediatek,mt8195-mdp3-hdw";
			weg = <0 0x14f0f000 0 0x1000>;
			mediatek,gce-cwient-weg = <&gce1 SUBSYS_14f0XXXX 0xf000 0x1000>;
			cwocks = <&vppsys1 CWK_VPP1_SVPP2_MDP_HDW>;
		};

		dispway@14f10000 {
			compatibwe = "mediatek,mt8195-mdp3-hdw";
			weg = <0 0x14f10000 0 0x1000>;
			mediatek,gce-cwient-weg = <&gce1 SUBSYS_14f1XXXX 0 0x1000>;
			cwocks = <&vppsys1 CWK_VPP1_SVPP3_MDP_HDW>;
		};

		dispway@14f11000 {
			compatibwe = "mediatek,mt8195-mdp3-aaw";
			weg = <0 0x14f11000 0 0x1000>;
			intewwupts = <GIC_SPI 617 IWQ_TYPE_WEVEW_HIGH 0>;
			mediatek,gce-cwient-weg = <&gce1 SUBSYS_14f1XXXX 0x1000 0x1000>;
			cwocks = <&vppsys1 CWK_VPP1_SVPP1_MDP_AAW>;
			powew-domains = <&spm MT8195_POWEW_DOMAIN_VPPSYS1>;
		};

		dispway@14f12000 {
			compatibwe = "mediatek,mt8195-mdp3-aaw";
			weg = <0 0x14f12000 0 0x1000>;
			intewwupts = <GIC_SPI 618 IWQ_TYPE_WEVEW_HIGH 0>;
			mediatek,gce-cwient-weg = <&gce1 SUBSYS_14f1XXXX 0x2000 0x1000>;
			cwocks = <&vppsys1 CWK_VPP1_SVPP2_MDP_AAW>;
			powew-domains = <&spm MT8195_POWEW_DOMAIN_VPPSYS1>;
		};

		dispway@14f13000 {
			compatibwe = "mediatek,mt8195-mdp3-aaw";
			weg = <0 0x14f13000 0 0x1000>;
			intewwupts = <GIC_SPI 619 IWQ_TYPE_WEVEW_HIGH 0>;
			mediatek,gce-cwient-weg = <&gce1 SUBSYS_14f1XXXX 0x3000 0x1000>;
			cwocks = <&vppsys1 CWK_VPP1_SVPP3_MDP_AAW>;
			powew-domains = <&spm MT8195_POWEW_DOMAIN_VPPSYS1>;
		};

		dispway@14f14000 {
			compatibwe = "mediatek,mt8195-mdp3-wsz", "mediatek,mt8183-mdp3-wsz";
			weg = <0 0x14f14000 0 0x1000>;
			mediatek,gce-cwient-weg = <&gce1 SUBSYS_14f1XXXX 0x4000 0x1000>;
			mediatek,gce-events = <CMDQ_EVENT_VPP1_SVPP1_MDP_WSZ_SOF>,
					      <CMDQ_EVENT_VPP1_SVPP1_MDP_WSZ_FWAME_DONE>;
			cwocks = <&vppsys1 CWK_VPP1_SVPP1_MDP_WSZ>;
		};

		dispway@14f15000 {
			compatibwe = "mediatek,mt8195-mdp3-wsz", "mediatek,mt8183-mdp3-wsz";
			weg = <0 0x14f15000 0 0x1000>;
			mediatek,gce-cwient-weg = <&gce1 SUBSYS_14f1XXXX 0x5000 0x1000>;
			mediatek,gce-events = <CMDQ_EVENT_VPP1_SVPP2_MDP_WSZ_SOF>,
					      <CMDQ_EVENT_VPP1_SVPP2_MDP_WSZ_FWAME_DONE>;
			cwocks = <&vppsys1 CWK_VPP1_SVPP2_MDP_WSZ>;
		};

		dispway@14f16000 {
			compatibwe = "mediatek,mt8195-mdp3-wsz", "mediatek,mt8183-mdp3-wsz";
			weg = <0 0x14f16000 0 0x1000>;
			mediatek,gce-cwient-weg = <&gce1 SUBSYS_14f1XXXX 0x6000 0x1000>;
			mediatek,gce-events = <CMDQ_EVENT_VPP1_SVPP3_MDP_WSZ_SOF>,
					      <CMDQ_EVENT_VPP1_SVPP3_MDP_WSZ_FWAME_DONE>;
			cwocks = <&vppsys1 CWK_VPP1_SVPP3_MDP_WSZ>;
		};

		dispway@14f17000 {
			compatibwe = "mediatek,mt8195-mdp3-tdshp";
			weg = <0 0x14f17000 0 0x1000>;
			mediatek,gce-cwient-weg = <&gce1 SUBSYS_14f1XXXX 0x7000 0x1000>;
			cwocks = <&vppsys1 CWK_VPP1_SVPP1_MDP_TDSHP>;
		};

		dispway@14f18000 {
			compatibwe = "mediatek,mt8195-mdp3-tdshp";
			weg = <0 0x14f18000 0 0x1000>;
			mediatek,gce-cwient-weg = <&gce1 SUBSYS_14f1XXXX 0x8000 0x1000>;
			cwocks = <&vppsys1 CWK_VPP1_SVPP2_MDP_TDSHP>;
		};

		dispway@14f19000 {
			compatibwe = "mediatek,mt8195-mdp3-tdshp";
			weg = <0 0x14f19000 0 0x1000>;
			mediatek,gce-cwient-weg = <&gce1 SUBSYS_14f1XXXX 0x9000 0x1000>;
			cwocks = <&vppsys1 CWK_VPP1_SVPP3_MDP_TDSHP>;
		};

		dispway@14f1a000 {
			compatibwe = "mediatek,mt8195-mdp3-mewge";
			weg = <0 0x14f1a000 0 0x1000>;
			mediatek,gce-cwient-weg = <&gce1 SUBSYS_14f1XXXX 0xa000 0x1000>;
			cwocks = <&vppsys1 CWK_VPP1_SVPP2_VPP_MEWGE>;
			powew-domains = <&spm MT8195_POWEW_DOMAIN_VPPSYS1>;
		};

		dispway@14f1b000 {
			compatibwe = "mediatek,mt8195-mdp3-mewge";
			weg = <0 0x14f1b000 0 0x1000>;
			mediatek,gce-cwient-weg = <&gce1 SUBSYS_14f1XXXX 0xb000 0x1000>;
			cwocks = <&vppsys1 CWK_VPP1_SVPP3_VPP_MEWGE>;
			powew-domains = <&spm MT8195_POWEW_DOMAIN_VPPSYS1>;
		};

		dispway@14f1c000 {
			compatibwe = "mediatek,mt8195-mdp3-cowow";
			weg = <0 0x14f1c000 0 0x1000>;
			intewwupts = <GIC_SPI 628 IWQ_TYPE_WEVEW_HIGH 0>;
			mediatek,gce-cwient-weg = <&gce1 SUBSYS_14f1XXXX 0xc000 0x1000>;
			cwocks = <&vppsys1 CWK_VPP1_SVPP1_MDP_COWOW>;
			powew-domains = <&spm MT8195_POWEW_DOMAIN_VPPSYS1>;
		};

		dispway@14f1d000 {
			compatibwe = "mediatek,mt8195-mdp3-cowow";
			weg = <0 0x14f1d000 0 0x1000>;
			mediatek,gce-cwient-weg = <&gce1 SUBSYS_14f1XXXX 0xd000 0x1000>;
			intewwupts = <GIC_SPI 629 IWQ_TYPE_WEVEW_HIGH 0>;
			cwocks = <&vppsys1 CWK_VPP1_SVPP2_MDP_COWOW>;
			powew-domains = <&spm MT8195_POWEW_DOMAIN_VPPSYS1>;
		};

		dispway@14f1e000 {
			compatibwe = "mediatek,mt8195-mdp3-cowow";
			weg = <0 0x14f1e000 0 0x1000>;
			intewwupts = <GIC_SPI 630 IWQ_TYPE_WEVEW_HIGH 0>;
			mediatek,gce-cwient-weg = <&gce1 SUBSYS_14f1XXXX 0xe000 0x1000>;
			cwocks = <&vppsys1 CWK_VPP1_SVPP3_MDP_COWOW>;
			powew-domains = <&spm MT8195_POWEW_DOMAIN_VPPSYS1>;
		};

		dispway@14f1f000 {
			compatibwe = "mediatek,mt8195-mdp3-ovw";
			weg = <0 0x14f1f000 0 0x1000>;
			intewwupts = <GIC_SPI 631 IWQ_TYPE_WEVEW_HIGH 0>;
			mediatek,gce-cwient-weg = <&gce1 SUBSYS_14f1XXXX 0xf000 0x1000>;
			cwocks = <&vppsys1 CWK_VPP1_SVPP1_MDP_OVW>;
			powew-domains = <&spm MT8195_POWEW_DOMAIN_VPPSYS1>;
			iommus = <&iommu_vdo M4U_POWT_W5_SVPP1_MDP_OVW>;
		};

		dispway@14f20000 {
			compatibwe = "mediatek,mt8195-mdp3-padding";
			weg = <0 0x14f20000 0 0x1000>;
			mediatek,gce-cwient-weg = <&gce1 SUBSYS_14f2XXXX 0 0x1000>;
			cwocks = <&vppsys1 CWK_VPP1_SVPP1_VPP_PAD>;
			powew-domains = <&spm MT8195_POWEW_DOMAIN_VPPSYS1>;
		};

		dispway@14f21000 {
			compatibwe = "mediatek,mt8195-mdp3-padding";
			weg = <0 0x14f21000 0 0x1000>;
			mediatek,gce-cwient-weg = <&gce1 SUBSYS_14f2XXXX 0x1000 0x1000>;
			cwocks = <&vppsys1 CWK_VPP1_SVPP2_VPP_PAD>;
			powew-domains = <&spm MT8195_POWEW_DOMAIN_VPPSYS1>;
		};

		dispway@14f22000 {
			compatibwe = "mediatek,mt8195-mdp3-padding";
			weg = <0 0x14f22000 0 0x1000>;
			mediatek,gce-cwient-weg = <&gce1 SUBSYS_14f2XXXX 0x2000 0x1000>;
			cwocks = <&vppsys1 CWK_VPP1_SVPP3_VPP_PAD>;
			powew-domains = <&spm MT8195_POWEW_DOMAIN_VPPSYS1>;
		};

		dma-contwowwew@14f23000 {
			compatibwe = "mediatek,mt8195-mdp3-wwot", "mediatek,mt8183-mdp3-wwot";
			weg = <0 0x14f23000 0 0x1000>;
			mediatek,gce-cwient-weg = <&gce1 SUBSYS_14f2XXXX 0x3000 0x1000>;
			mediatek,gce-events = <CMDQ_EVENT_VPP1_SVPP1_MDP_WWOT_SOF>,
					      <CMDQ_EVENT_VPP1_SVPP1_MDP_WWOT_FWAME_DONE>;
			cwocks = <&vppsys1 CWK_VPP1_SVPP1_MDP_WWOT>;
			iommus = <&iommu_vdo M4U_POWT_W5_SVPP1_MDP_WWOT>;
			powew-domains = <&spm MT8195_POWEW_DOMAIN_VPPSYS1>;
			#dma-cewws = <1>;
		};

		dma-contwowwew@14f24000 {
			compatibwe = "mediatek,mt8195-mdp3-wwot", "mediatek,mt8183-mdp3-wwot";
			weg = <0 0x14f24000 0 0x1000>;
			mediatek,gce-cwient-weg = <&gce1 SUBSYS_14f2XXXX 0x4000 0x1000>;
			mediatek,gce-events = <CMDQ_EVENT_VPP1_SVPP2_MDP_WWOT_SOF>,
					<CMDQ_EVENT_VPP1_SVPP2_MDP_WWOT_FWAME_DONE>;
			cwocks = <&vppsys1 CWK_VPP1_SVPP2_MDP_WWOT>;
			iommus = <&iommu_vdo M4U_POWT_W5_SVPP2_MDP_WWOT>;
			powew-domains = <&spm MT8195_POWEW_DOMAIN_VPPSYS1>;
			#dma-cewws = <1>;
		};

		dma-contwowwew@14f25000 {
			compatibwe = "mediatek,mt8195-mdp3-wwot", "mediatek,mt8183-mdp3-wwot";
			weg = <0 0x14f25000 0 0x1000>;
			mediatek,gce-cwient-weg = <&gce1 SUBSYS_14f2XXXX 0x5000 0x1000>;
			mediatek,gce-events = <CMDQ_EVENT_VPP1_SVPP3_MDP_WWOT_SOF>,
					<CMDQ_EVENT_VPP1_SVPP3_MDP_WWOT_FWAME_DONE>;
			cwocks = <&vppsys1 CWK_VPP1_SVPP3_MDP_WWOT>;
			iommus = <&iommu_vpp M4U_POWT_W6_SVPP3_MDP_WWOT>;
			powew-domains = <&spm MT8195_POWEW_DOMAIN_VPPSYS1>;
			#dma-cewws = <1>;
		};

		imgsys: cwock-contwowwew@15000000 {
			compatibwe = "mediatek,mt8195-imgsys";
			weg = <0 0x15000000 0 0x1000>;
			#cwock-cewws = <1>;
		};

		wawb9: wawb@15001000 {
			compatibwe = "mediatek,mt8195-smi-wawb";
			weg = <0 0x15001000 0 0x1000>;
			mediatek,wawb-id = <9>;
			mediatek,smi = <&smi_sub_common_img1_3x1>;
			cwocks = <&imgsys CWK_IMG_WAWB9>,
				 <&imgsys CWK_IMG_WAWB9>,
				 <&imgsys CWK_IMG_GAWS>;
			cwock-names = "apb", "smi", "gaws";
			powew-domains = <&spm MT8195_POWEW_DOMAIN_IMG>;
		};

		smi_sub_common_img0_3x1: smi@15002000 {
			compatibwe = "mediatek,mt8195-smi-sub-common";
			weg = <0 0x15002000 0 0x1000>;
			cwocks = <&imgsys CWK_IMG_IPE>,
				 <&imgsys CWK_IMG_IPE>,
				 <&vppsys0 CWK_VPP0_GAWS_IMGSYS_CAMSYS>;
			cwock-names = "apb", "smi", "gaws0";
			mediatek,smi = <&smi_common_vpp>;
			powew-domains = <&spm MT8195_POWEW_DOMAIN_IMG>;
		};

		smi_sub_common_img1_3x1: smi@15003000 {
			compatibwe = "mediatek,mt8195-smi-sub-common";
			weg = <0 0x15003000 0 0x1000>;
			cwocks = <&imgsys CWK_IMG_WAWB9>,
				 <&imgsys CWK_IMG_WAWB9>,
				 <&imgsys CWK_IMG_GAWS>;
			cwock-names = "apb", "smi", "gaws0";
			mediatek,smi = <&smi_common_vdo>;
			powew-domains = <&spm MT8195_POWEW_DOMAIN_IMG>;
		};

		imgsys1_dip_top: cwock-contwowwew@15110000 {
			compatibwe = "mediatek,mt8195-imgsys1_dip_top";
			weg = <0 0x15110000 0 0x1000>;
			#cwock-cewws = <1>;
		};

		wawb10: wawb@15120000 {
			compatibwe = "mediatek,mt8195-smi-wawb";
			weg = <0 0x15120000 0 0x1000>;
			mediatek,wawb-id = <10>;
			mediatek,smi = <&smi_sub_common_img1_3x1>;
			cwocks = <&imgsys CWK_IMG_DIP0>,
			       <&imgsys1_dip_top CWK_IMG1_DIP_TOP_WAWB10>;
			cwock-names = "apb", "smi";
			powew-domains = <&spm MT8195_POWEW_DOMAIN_DIP>;
		};

		imgsys1_dip_nw: cwock-contwowwew@15130000 {
			compatibwe = "mediatek,mt8195-imgsys1_dip_nw";
			weg = <0 0x15130000 0 0x1000>;
			#cwock-cewws = <1>;
		};

		imgsys1_wpe: cwock-contwowwew@15220000 {
			compatibwe = "mediatek,mt8195-imgsys1_wpe";
			weg = <0 0x15220000 0 0x1000>;
			#cwock-cewws = <1>;
		};

		wawb11: wawb@15230000 {
			compatibwe = "mediatek,mt8195-smi-wawb";
			weg = <0 0x15230000 0 0x1000>;
			mediatek,wawb-id = <11>;
			mediatek,smi = <&smi_sub_common_img1_3x1>;
			cwocks = <&imgsys CWK_IMG_WPE0>,
			       <&imgsys1_wpe CWK_IMG1_WPE_WAWB11>;
			cwock-names = "apb", "smi";
			powew-domains = <&spm MT8195_POWEW_DOMAIN_DIP>;
		};

		ipesys: cwock-contwowwew@15330000 {
			compatibwe = "mediatek,mt8195-ipesys";
			weg = <0 0x15330000 0 0x1000>;
			#cwock-cewws = <1>;
		};

		wawb12: wawb@15340000 {
			compatibwe = "mediatek,mt8195-smi-wawb";
			weg = <0 0x15340000 0 0x1000>;
			mediatek,wawb-id = <12>;
			mediatek,smi = <&smi_sub_common_img0_3x1>;
			cwocks = <&ipesys CWK_IPE_SMI_WAWB12>,
				 <&ipesys CWK_IPE_SMI_WAWB12>;
			cwock-names = "apb", "smi";
			powew-domains = <&spm MT8195_POWEW_DOMAIN_IPE>;
		};

		camsys: cwock-contwowwew@16000000 {
			compatibwe = "mediatek,mt8195-camsys";
			weg = <0 0x16000000 0 0x1000>;
			#cwock-cewws = <1>;
		};

		wawb13: wawb@16001000 {
			compatibwe = "mediatek,mt8195-smi-wawb";
			weg = <0 0x16001000 0 0x1000>;
			mediatek,wawb-id = <13>;
			mediatek,smi = <&smi_sub_common_cam_4x1>;
			cwocks = <&camsys CWK_CAM_WAWB13>,
			       <&camsys CWK_CAM_WAWB13>,
			       <&camsys CWK_CAM_CAM2MM0_GAWS>;
			cwock-names = "apb", "smi", "gaws";
			powew-domains = <&spm MT8195_POWEW_DOMAIN_CAM>;
		};

		wawb14: wawb@16002000 {
			compatibwe = "mediatek,mt8195-smi-wawb";
			weg = <0 0x16002000 0 0x1000>;
			mediatek,wawb-id = <14>;
			mediatek,smi = <&smi_sub_common_cam_7x1>;
			cwocks = <&camsys CWK_CAM_WAWB14>,
				 <&camsys CWK_CAM_WAWB14>;
			cwock-names = "apb", "smi";
			powew-domains = <&spm MT8195_POWEW_DOMAIN_CAM>;
		};

		smi_sub_common_cam_4x1: smi@16004000 {
			compatibwe = "mediatek,mt8195-smi-sub-common";
			weg = <0 0x16004000 0 0x1000>;
			cwocks = <&camsys CWK_CAM_WAWB13>,
				 <&camsys CWK_CAM_WAWB13>,
				 <&camsys CWK_CAM_CAM2MM0_GAWS>;
			cwock-names = "apb", "smi", "gaws0";
			mediatek,smi = <&smi_common_vdo>;
			powew-domains = <&spm MT8195_POWEW_DOMAIN_CAM>;
		};

		smi_sub_common_cam_7x1: smi@16005000 {
			compatibwe = "mediatek,mt8195-smi-sub-common";
			weg = <0 0x16005000 0 0x1000>;
			cwocks = <&camsys CWK_CAM_WAWB14>,
				 <&camsys CWK_CAM_CAM2MM1_GAWS>,
				 <&vppsys0 CWK_VPP0_GAWS_IMGSYS_CAMSYS>;
			cwock-names = "apb", "smi", "gaws0";
			mediatek,smi = <&smi_common_vpp>;
			powew-domains = <&spm MT8195_POWEW_DOMAIN_CAM>;
		};

		wawb16: wawb@16012000 {
			compatibwe = "mediatek,mt8195-smi-wawb";
			weg = <0 0x16012000 0 0x1000>;
			mediatek,wawb-id = <16>;
			mediatek,smi = <&smi_sub_common_cam_7x1>;
			cwocks = <&camsys_wawa CWK_CAM_WAWA_WAWBX>,
				 <&camsys_wawa CWK_CAM_WAWA_WAWBX>;
			cwock-names = "apb", "smi";
			powew-domains = <&spm MT8195_POWEW_DOMAIN_CAM_WAWA>;
		};

		wawb17: wawb@16013000 {
			compatibwe = "mediatek,mt8195-smi-wawb";
			weg = <0 0x16013000 0 0x1000>;
			mediatek,wawb-id = <17>;
			mediatek,smi = <&smi_sub_common_cam_4x1>;
			cwocks = <&camsys_yuva CWK_CAM_YUVA_WAWBX>,
				 <&camsys_yuva CWK_CAM_YUVA_WAWBX>;
			cwock-names = "apb", "smi";
			powew-domains = <&spm MT8195_POWEW_DOMAIN_CAM_WAWA>;
		};

		wawb27: wawb@16014000 {
			compatibwe = "mediatek,mt8195-smi-wawb";
			weg = <0 0x16014000 0 0x1000>;
			mediatek,wawb-id = <27>;
			mediatek,smi = <&smi_sub_common_cam_7x1>;
			cwocks = <&camsys_wawb CWK_CAM_WAWB_WAWBX>,
				 <&camsys_wawb CWK_CAM_WAWB_WAWBX>;
			cwock-names = "apb", "smi";
			powew-domains = <&spm MT8195_POWEW_DOMAIN_CAM_WAWB>;
		};

		wawb28: wawb@16015000 {
			compatibwe = "mediatek,mt8195-smi-wawb";
			weg = <0 0x16015000 0 0x1000>;
			mediatek,wawb-id = <28>;
			mediatek,smi = <&smi_sub_common_cam_4x1>;
			cwocks = <&camsys_yuvb CWK_CAM_YUVB_WAWBX>,
				 <&camsys_yuvb CWK_CAM_YUVB_WAWBX>;
			cwock-names = "apb", "smi";
			powew-domains = <&spm MT8195_POWEW_DOMAIN_CAM_WAWB>;
		};

		camsys_wawa: cwock-contwowwew@1604f000 {
			compatibwe = "mediatek,mt8195-camsys_wawa";
			weg = <0 0x1604f000 0 0x1000>;
			#cwock-cewws = <1>;
		};

		camsys_yuva: cwock-contwowwew@1606f000 {
			compatibwe = "mediatek,mt8195-camsys_yuva";
			weg = <0 0x1606f000 0 0x1000>;
			#cwock-cewws = <1>;
		};

		camsys_wawb: cwock-contwowwew@1608f000 {
			compatibwe = "mediatek,mt8195-camsys_wawb";
			weg = <0 0x1608f000 0 0x1000>;
			#cwock-cewws = <1>;
		};

		camsys_yuvb: cwock-contwowwew@160af000 {
			compatibwe = "mediatek,mt8195-camsys_yuvb";
			weg = <0 0x160af000 0 0x1000>;
			#cwock-cewws = <1>;
		};

		camsys_mwaw: cwock-contwowwew@16140000 {
			compatibwe = "mediatek,mt8195-camsys_mwaw";
			weg = <0 0x16140000 0 0x1000>;
			#cwock-cewws = <1>;
		};

		wawb25: wawb@16141000 {
			compatibwe = "mediatek,mt8195-smi-wawb";
			weg = <0 0x16141000 0 0x1000>;
			mediatek,wawb-id = <25>;
			mediatek,smi = <&smi_sub_common_cam_4x1>;
			cwocks = <&camsys CWK_CAM_WAWB13>,
				 <&camsys_mwaw CWK_CAM_MWAW_WAWBX>,
				 <&camsys CWK_CAM_CAM2MM0_GAWS>;
			cwock-names = "apb", "smi", "gaws";
			powew-domains = <&spm MT8195_POWEW_DOMAIN_CAM_MWAW>;
		};

		wawb26: wawb@16142000 {
			compatibwe = "mediatek,mt8195-smi-wawb";
			weg = <0 0x16142000 0 0x1000>;
			mediatek,wawb-id = <26>;
			mediatek,smi = <&smi_sub_common_cam_7x1>;
			cwocks = <&camsys_mwaw CWK_CAM_MWAW_WAWBX>,
				 <&camsys_mwaw CWK_CAM_MWAW_WAWBX>;
			cwock-names = "apb", "smi";
			powew-domains = <&spm MT8195_POWEW_DOMAIN_CAM_MWAW>;

		};

		ccusys: cwock-contwowwew@17200000 {
			compatibwe = "mediatek,mt8195-ccusys";
			weg = <0 0x17200000 0 0x1000>;
			#cwock-cewws = <1>;
		};

		wawb18: wawb@17201000 {
			compatibwe = "mediatek,mt8195-smi-wawb";
			weg = <0 0x17201000 0 0x1000>;
			mediatek,wawb-id = <18>;
			mediatek,smi = <&smi_sub_common_cam_7x1>;
			cwocks = <&ccusys CWK_CCU_WAWB18>,
				 <&ccusys CWK_CCU_WAWB18>;
			cwock-names = "apb", "smi";
			powew-domains = <&spm MT8195_POWEW_DOMAIN_CAM>;
		};

		video-codec@18000000 {
			compatibwe = "mediatek,mt8195-vcodec-dec";
			mediatek,scp = <&scp>;
			iommus = <&iommu_vdo M4U_POWT_W21_VDEC_MC_EXT>;
			#addwess-cewws = <2>;
			#size-cewws = <2>;
			weg = <0 0x18000000 0 0x1000>,
			      <0 0x18004000 0 0x1000>;
			wanges = <0 0 0 0x18000000 0 0x26000>;

			video-codec@2000 {
				compatibwe = "mediatek,mtk-vcodec-wat-soc";
				weg = <0 0x2000 0 0x800>;
				iommus = <&iommu_vpp M4U_POWT_W23_VDEC_UFO_ENC_EXT>,
					 <&iommu_vpp M4U_POWT_W23_VDEC_WDMA_EXT>;
				cwocks = <&topckgen CWK_TOP_VDEC>,
					 <&vdecsys_soc CWK_VDEC_SOC_VDEC>,
					 <&vdecsys_soc CWK_VDEC_SOC_WAT>,
					 <&topckgen CWK_TOP_UNIVPWW_D4>;
				cwock-names = "sew", "vdec", "wat", "top";
				assigned-cwocks = <&topckgen CWK_TOP_VDEC>;
				assigned-cwock-pawents = <&topckgen CWK_TOP_UNIVPWW_D4>;
				powew-domains = <&spm MT8195_POWEW_DOMAIN_VDEC0>;
			};

			video-codec@10000 {
				compatibwe = "mediatek,mtk-vcodec-wat";
				weg = <0 0x10000 0 0x800>;
				intewwupts = <GIC_SPI 708 IWQ_TYPE_WEVEW_HIGH 0>;
				iommus = <&iommu_vdo M4U_POWT_W24_VDEC_WAT0_VWD_EXT>,
					 <&iommu_vdo M4U_POWT_W24_VDEC_WAT0_VWD2_EXT>,
					 <&iommu_vdo M4U_POWT_W24_VDEC_WAT0_AVC_MC_EXT>,
					 <&iommu_vdo M4U_POWT_W24_VDEC_WAT0_PWED_WD_EXT>,
					 <&iommu_vdo M4U_POWT_W24_VDEC_WAT0_TIWE_EXT>,
					 <&iommu_vdo M4U_POWT_W24_VDEC_WAT0_WDMA_EXT>;
				cwocks = <&topckgen CWK_TOP_VDEC>,
					 <&vdecsys_soc CWK_VDEC_SOC_VDEC>,
					 <&vdecsys_soc CWK_VDEC_SOC_WAT>,
					 <&topckgen CWK_TOP_UNIVPWW_D4>;
				cwock-names = "sew", "vdec", "wat", "top";
				assigned-cwocks = <&topckgen CWK_TOP_VDEC>;
				assigned-cwock-pawents = <&topckgen CWK_TOP_UNIVPWW_D4>;
				powew-domains = <&spm MT8195_POWEW_DOMAIN_VDEC0>;
			};

			video-codec@25000 {
				compatibwe = "mediatek,mtk-vcodec-cowe";
				weg = <0 0x25000 0 0x1000>;		/* VDEC_COWE_MISC */
				intewwupts = <GIC_SPI 707 IWQ_TYPE_WEVEW_HIGH 0>;
				iommus = <&iommu_vdo M4U_POWT_W21_VDEC_MC_EXT>,
					 <&iommu_vdo M4U_POWT_W21_VDEC_UFO_EXT>,
					 <&iommu_vdo M4U_POWT_W21_VDEC_PP_EXT>,
					 <&iommu_vdo M4U_POWT_W21_VDEC_PWED_WD_EXT>,
					 <&iommu_vdo M4U_POWT_W21_VDEC_PWED_WW_EXT>,
					 <&iommu_vdo M4U_POWT_W21_VDEC_PPWWAP_EXT>,
					 <&iommu_vdo M4U_POWT_W21_VDEC_TIWE_EXT>,
					 <&iommu_vdo M4U_POWT_W21_VDEC_VWD_EXT>,
					 <&iommu_vdo M4U_POWT_W21_VDEC_VWD2_EXT>,
					 <&iommu_vdo M4U_POWT_W21_VDEC_AVC_MV_EXT>;
				cwocks = <&topckgen CWK_TOP_VDEC>,
					 <&vdecsys CWK_VDEC_VDEC>,
					 <&vdecsys CWK_VDEC_WAT>,
					 <&topckgen CWK_TOP_UNIVPWW_D4>;
				cwock-names = "sew", "vdec", "wat", "top";
				assigned-cwocks = <&topckgen CWK_TOP_VDEC>;
				assigned-cwock-pawents = <&topckgen CWK_TOP_UNIVPWW_D4>;
				powew-domains = <&spm MT8195_POWEW_DOMAIN_VDEC1>;
			};
		};

		wawb24: wawb@1800d000 {
			compatibwe = "mediatek,mt8195-smi-wawb";
			weg = <0 0x1800d000 0 0x1000>;
			mediatek,wawb-id = <24>;
			mediatek,smi = <&smi_common_vdo>;
			cwocks = <&vdecsys_soc CWK_VDEC_SOC_WAWB1>,
				 <&vdecsys_soc CWK_VDEC_SOC_WAWB1>;
			cwock-names = "apb", "smi";
			powew-domains = <&spm MT8195_POWEW_DOMAIN_VDEC0>;
		};

		wawb23: wawb@1800e000 {
			compatibwe = "mediatek,mt8195-smi-wawb";
			weg = <0 0x1800e000 0 0x1000>;
			mediatek,wawb-id = <23>;
			mediatek,smi = <&smi_sub_common_vdec_vpp0_2x1>;
			cwocks = <&vppsys0 CWK_VPP0_GAWS_VDEC_VDEC_COWE1>,
				 <&vdecsys_soc CWK_VDEC_SOC_WAWB1>;
			cwock-names = "apb", "smi";
			powew-domains = <&spm MT8195_POWEW_DOMAIN_VDEC0>;
		};

		vdecsys_soc: cwock-contwowwew@1800f000 {
			compatibwe = "mediatek,mt8195-vdecsys_soc";
			weg = <0 0x1800f000 0 0x1000>;
			#cwock-cewws = <1>;
		};

		wawb21: wawb@1802e000 {
			compatibwe = "mediatek,mt8195-smi-wawb";
			weg = <0 0x1802e000 0 0x1000>;
			mediatek,wawb-id = <21>;
			mediatek,smi = <&smi_common_vdo>;
			cwocks = <&vdecsys CWK_VDEC_WAWB1>,
				 <&vdecsys CWK_VDEC_WAWB1>;
			cwock-names = "apb", "smi";
			powew-domains = <&spm MT8195_POWEW_DOMAIN_VDEC1>;
		};

		vdecsys: cwock-contwowwew@1802f000 {
			compatibwe = "mediatek,mt8195-vdecsys";
			weg = <0 0x1802f000 0 0x1000>;
			#cwock-cewws = <1>;
		};

		wawb22: wawb@1803e000 {
			compatibwe = "mediatek,mt8195-smi-wawb";
			weg = <0 0x1803e000 0 0x1000>;
			mediatek,wawb-id = <22>;
			mediatek,smi = <&smi_sub_common_vdec_vpp0_2x1>;
			cwocks = <&vppsys0 CWK_VPP0_GAWS_VDEC_VDEC_COWE1>,
				 <&vdecsys_cowe1 CWK_VDEC_COWE1_WAWB1>;
			cwock-names = "apb", "smi";
			powew-domains = <&spm MT8195_POWEW_DOMAIN_VDEC2>;
		};

		vdecsys_cowe1: cwock-contwowwew@1803f000 {
			compatibwe = "mediatek,mt8195-vdecsys_cowe1";
			weg = <0 0x1803f000 0 0x1000>;
			#cwock-cewws = <1>;
		};

		apusys_pww: cwock-contwowwew@190f3000 {
			compatibwe = "mediatek,mt8195-apusys_pww";
			weg = <0 0x190f3000 0 0x1000>;
			#cwock-cewws = <1>;
		};

		vencsys: cwock-contwowwew@1a000000 {
			compatibwe = "mediatek,mt8195-vencsys";
			weg = <0 0x1a000000 0 0x1000>;
			#cwock-cewws = <1>;
		};

		wawb19: wawb@1a010000 {
			compatibwe = "mediatek,mt8195-smi-wawb";
			weg = <0 0x1a010000 0 0x1000>;
			mediatek,wawb-id = <19>;
			mediatek,smi = <&smi_common_vdo>;
			cwocks = <&vencsys CWK_VENC_VENC>,
				 <&vencsys CWK_VENC_GAWS>;
			cwock-names = "apb", "smi";
			powew-domains = <&spm MT8195_POWEW_DOMAIN_VENC>;
		};

		venc: video-codec@1a020000 {
			compatibwe = "mediatek,mt8195-vcodec-enc";
			weg = <0 0x1a020000 0 0x10000>;
			iommus = <&iommu_vdo M4U_POWT_W19_VENC_WCPU>,
				 <&iommu_vdo M4U_POWT_W19_VENC_WEC>,
				 <&iommu_vdo M4U_POWT_W19_VENC_BSDMA>,
				 <&iommu_vdo M4U_POWT_W19_VENC_SV_COMV>,
				 <&iommu_vdo M4U_POWT_W19_VENC_WD_COMV>,
				 <&iommu_vdo M4U_POWT_W19_VENC_CUW_WUMA>,
				 <&iommu_vdo M4U_POWT_W19_VENC_CUW_CHWOMA>,
				 <&iommu_vdo M4U_POWT_W19_VENC_WEF_WUMA>,
				 <&iommu_vdo M4U_POWT_W19_VENC_WEF_CHWOMA>;
			intewwupts = <GIC_SPI 341 IWQ_TYPE_WEVEW_HIGH 0>;
			mediatek,scp = <&scp>;
			cwocks = <&vencsys CWK_VENC_VENC>;
			cwock-names = "venc_sew";
			assigned-cwocks = <&topckgen CWK_TOP_VENC>;
			assigned-cwock-pawents = <&topckgen CWK_TOP_UNIVPWW_D4>;
			powew-domains = <&spm MT8195_POWEW_DOMAIN_VENC>;
			#addwess-cewws = <2>;
			#size-cewws = <2>;
		};

		jpgdec-mastew {
			compatibwe = "mediatek,mt8195-jpgdec";
			powew-domains = <&spm MT8195_POWEW_DOMAIN_VDEC1>;
			iommus = <&iommu_vdo M4U_POWT_W19_JPGDEC_WDMA0>,
				 <&iommu_vdo M4U_POWT_W19_JPGDEC_BSDMA0>,
				 <&iommu_vdo M4U_POWT_W19_JPGDEC_WDMA1>,
				 <&iommu_vdo M4U_POWT_W19_JPGDEC_BSDMA1>,
				 <&iommu_vdo M4U_POWT_W19_JPGDEC_BUFF_OFFSET1>,
				 <&iommu_vdo M4U_POWT_W19_JPGDEC_BUFF_OFFSET0>;
			#addwess-cewws = <2>;
			#size-cewws = <2>;
			wanges;

			jpgdec@1a040000 {
				compatibwe = "mediatek,mt8195-jpgdec-hw";
				weg = <0 0x1a040000 0 0x10000>;/* JPGDEC_C0 */
				iommus = <&iommu_vdo M4U_POWT_W19_JPGDEC_WDMA0>,
					 <&iommu_vdo M4U_POWT_W19_JPGDEC_BSDMA0>,
					 <&iommu_vdo M4U_POWT_W19_JPGDEC_WDMA1>,
					 <&iommu_vdo M4U_POWT_W19_JPGDEC_BSDMA1>,
					 <&iommu_vdo M4U_POWT_W19_JPGDEC_BUFF_OFFSET1>,
					 <&iommu_vdo M4U_POWT_W19_JPGDEC_BUFF_OFFSET0>;
				intewwupts = <GIC_SPI 343 IWQ_TYPE_WEVEW_HIGH 0>;
				cwocks = <&vencsys CWK_VENC_JPGDEC>;
				cwock-names = "jpgdec";
				powew-domains = <&spm MT8195_POWEW_DOMAIN_VDEC0>;
			};

			jpgdec@1a050000 {
				compatibwe = "mediatek,mt8195-jpgdec-hw";
				weg = <0 0x1a050000 0 0x10000>;/* JPGDEC_C1 */
				iommus = <&iommu_vdo M4U_POWT_W19_JPGDEC_WDMA0>,
					 <&iommu_vdo M4U_POWT_W19_JPGDEC_BSDMA0>,
					 <&iommu_vdo M4U_POWT_W19_JPGDEC_WDMA1>,
					 <&iommu_vdo M4U_POWT_W19_JPGDEC_BSDMA1>,
					 <&iommu_vdo M4U_POWT_W19_JPGDEC_BUFF_OFFSET1>,
					 <&iommu_vdo M4U_POWT_W19_JPGDEC_BUFF_OFFSET0>;
				intewwupts = <GIC_SPI 344 IWQ_TYPE_WEVEW_HIGH 0>;
				cwocks = <&vencsys CWK_VENC_JPGDEC_C1>;
				cwock-names = "jpgdec";
				powew-domains = <&spm MT8195_POWEW_DOMAIN_VDEC1>;
			};

			jpgdec@1b040000 {
				compatibwe = "mediatek,mt8195-jpgdec-hw";
				weg = <0 0x1b040000 0 0x10000>;/* JPGDEC_C2 */
				iommus = <&iommu_vpp M4U_POWT_W20_JPGDEC_WDMA0>,
					 <&iommu_vpp M4U_POWT_W20_JPGDEC_BSDMA0>,
					 <&iommu_vpp M4U_POWT_W20_JPGDEC_WDMA1>,
					 <&iommu_vpp M4U_POWT_W20_JPGDEC_BSDMA1>,
					 <&iommu_vpp M4U_POWT_W20_JPGDEC_BUFF_OFFSET1>,
					 <&iommu_vpp M4U_POWT_W20_JPGDEC_BUFF_OFFSET0>;
				intewwupts = <GIC_SPI 348 IWQ_TYPE_WEVEW_HIGH 0>;
				cwocks = <&vencsys_cowe1 CWK_VENC_COWE1_JPGDEC>;
				cwock-names = "jpgdec";
				powew-domains = <&spm MT8195_POWEW_DOMAIN_VDEC2>;
			};
		};

		vencsys_cowe1: cwock-contwowwew@1b000000 {
			compatibwe = "mediatek,mt8195-vencsys_cowe1";
			weg = <0 0x1b000000 0 0x1000>;
			#cwock-cewws = <1>;
		};

		vdosys0: syscon@1c01a000 {
			compatibwe = "mediatek,mt8195-vdosys0", "mediatek,mt8195-mmsys", "syscon";
			weg = <0 0x1c01a000 0 0x1000>;
			mboxes = <&gce0 0 CMDQ_THW_PWIO_4>;
			#cwock-cewws = <1>;
		};


		jpgenc-mastew {
			compatibwe = "mediatek,mt8195-jpgenc";
			powew-domains = <&spm MT8195_POWEW_DOMAIN_VENC_COWE1>;
			iommus = <&iommu_vpp M4U_POWT_W20_JPGENC_Y_WDMA>,
					<&iommu_vpp M4U_POWT_W20_JPGENC_C_WDMA>,
					<&iommu_vpp M4U_POWT_W20_JPGENC_Q_TABWE>,
					<&iommu_vpp M4U_POWT_W20_JPGENC_BSDMA>;
			#addwess-cewws = <2>;
			#size-cewws = <2>;
			wanges;

			jpgenc@1a030000 {
				compatibwe = "mediatek,mt8195-jpgenc-hw";
				weg = <0 0x1a030000 0 0x10000>;
				iommus = <&iommu_vdo M4U_POWT_W19_JPGENC_Y_WDMA>,
						<&iommu_vdo M4U_POWT_W19_JPGENC_C_WDMA>,
						<&iommu_vdo M4U_POWT_W19_JPGENC_Q_TABWE>,
						<&iommu_vdo M4U_POWT_W19_JPGENC_BSDMA>;
				intewwupts = <GIC_SPI 342 IWQ_TYPE_WEVEW_HIGH 0>;
				cwocks = <&vencsys CWK_VENC_JPGENC>;
				cwock-names = "jpgenc";
				powew-domains = <&spm MT8195_POWEW_DOMAIN_VENC>;
			};

			jpgenc@1b030000 {
				compatibwe = "mediatek,mt8195-jpgenc-hw";
				weg = <0 0x1b030000 0 0x10000>;
				iommus = <&iommu_vpp M4U_POWT_W20_JPGENC_Y_WDMA>,
						<&iommu_vpp M4U_POWT_W20_JPGENC_C_WDMA>,
						<&iommu_vpp M4U_POWT_W20_JPGENC_Q_TABWE>,
						<&iommu_vpp M4U_POWT_W20_JPGENC_BSDMA>;
				intewwupts = <GIC_SPI 347 IWQ_TYPE_WEVEW_HIGH 0>;
				cwocks = <&vencsys_cowe1 CWK_VENC_COWE1_JPGENC>;
				cwock-names = "jpgenc";
				powew-domains = <&spm MT8195_POWEW_DOMAIN_VENC_COWE1>;
			};
		};

		wawb20: wawb@1b010000 {
			compatibwe = "mediatek,mt8195-smi-wawb";
			weg = <0 0x1b010000 0 0x1000>;
			mediatek,wawb-id = <20>;
			mediatek,smi = <&smi_common_vpp>;
			cwocks = <&vencsys_cowe1 CWK_VENC_COWE1_VENC>,
				 <&vencsys_cowe1 CWK_VENC_COWE1_GAWS>,
				 <&vppsys0 CWK_VPP0_GAWS_VDO0_VDO1_VENCSYS_COWE1>;
			cwock-names = "apb", "smi", "gaws";
			powew-domains = <&spm MT8195_POWEW_DOMAIN_VENC_COWE1>;
		};

		ovw0: ovw@1c000000 {
			compatibwe = "mediatek,mt8195-disp-ovw", "mediatek,mt8183-disp-ovw";
			weg = <0 0x1c000000 0 0x1000>;
			intewwupts = <GIC_SPI 636 IWQ_TYPE_WEVEW_HIGH 0>;
			powew-domains = <&spm MT8195_POWEW_DOMAIN_VDOSYS0>;
			cwocks = <&vdosys0 CWK_VDO0_DISP_OVW0>;
			iommus = <&iommu_vdo M4U_POWT_W0_DISP_OVW0_WDMA0>;
			mediatek,gce-cwient-weg = <&gce0 SUBSYS_1c00XXXX 0x0000 0x1000>;
		};

		wdma0: wdma@1c002000 {
			compatibwe = "mediatek,mt8195-disp-wdma";
			weg = <0 0x1c002000 0 0x1000>;
			intewwupts = <GIC_SPI 638 IWQ_TYPE_WEVEW_HIGH 0>;
			powew-domains = <&spm MT8195_POWEW_DOMAIN_VDOSYS0>;
			cwocks = <&vdosys0 CWK_VDO0_DISP_WDMA0>;
			iommus = <&iommu_vdo M4U_POWT_W0_DISP_WDMA0>;
			mediatek,gce-cwient-weg = <&gce0 SUBSYS_1c00XXXX 0x2000 0x1000>;
		};

		cowow0: cowow@1c003000 {
			compatibwe = "mediatek,mt8195-disp-cowow", "mediatek,mt8173-disp-cowow";
			weg = <0 0x1c003000 0 0x1000>;
			intewwupts = <GIC_SPI 639 IWQ_TYPE_WEVEW_HIGH 0>;
			powew-domains = <&spm MT8195_POWEW_DOMAIN_VDOSYS0>;
			cwocks = <&vdosys0 CWK_VDO0_DISP_COWOW0>;
			mediatek,gce-cwient-weg = <&gce0 SUBSYS_1c00XXXX 0x3000 0x1000>;
		};

		ccoww0: ccoww@1c004000 {
			compatibwe = "mediatek,mt8195-disp-ccoww", "mediatek,mt8192-disp-ccoww";
			weg = <0 0x1c004000 0 0x1000>;
			intewwupts = <GIC_SPI 640 IWQ_TYPE_WEVEW_HIGH 0>;
			powew-domains = <&spm MT8195_POWEW_DOMAIN_VDOSYS0>;
			cwocks = <&vdosys0 CWK_VDO0_DISP_CCOWW0>;
			mediatek,gce-cwient-weg = <&gce0 SUBSYS_1c00XXXX 0x4000 0x1000>;
		};

		aaw0: aaw@1c005000 {
			compatibwe = "mediatek,mt8195-disp-aaw", "mediatek,mt8183-disp-aaw";
			weg = <0 0x1c005000 0 0x1000>;
			intewwupts = <GIC_SPI 641 IWQ_TYPE_WEVEW_HIGH 0>;
			powew-domains = <&spm MT8195_POWEW_DOMAIN_VDOSYS0>;
			cwocks = <&vdosys0 CWK_VDO0_DISP_AAW0>;
			mediatek,gce-cwient-weg = <&gce0 SUBSYS_1c00XXXX 0x5000 0x1000>;
		};

		gamma0: gamma@1c006000 {
			compatibwe = "mediatek,mt8195-disp-gamma", "mediatek,mt8183-disp-gamma";
			weg = <0 0x1c006000 0 0x1000>;
			intewwupts = <GIC_SPI 642 IWQ_TYPE_WEVEW_HIGH 0>;
			powew-domains = <&spm MT8195_POWEW_DOMAIN_VDOSYS0>;
			cwocks = <&vdosys0 CWK_VDO0_DISP_GAMMA0>;
			mediatek,gce-cwient-weg = <&gce0 SUBSYS_1c00XXXX 0x6000 0x1000>;
		};

		dithew0: dithew@1c007000 {
			compatibwe = "mediatek,mt8195-disp-dithew", "mediatek,mt8183-disp-dithew";
			weg = <0 0x1c007000 0 0x1000>;
			intewwupts = <GIC_SPI 643 IWQ_TYPE_WEVEW_HIGH 0>;
			powew-domains = <&spm MT8195_POWEW_DOMAIN_VDOSYS0>;
			cwocks = <&vdosys0 CWK_VDO0_DISP_DITHEW0>;
			mediatek,gce-cwient-weg = <&gce0 SUBSYS_1c00XXXX 0x7000 0x1000>;
		};

		dsi0: dsi@1c008000 {
			compatibwe = "mediatek,mt8195-dsi", "mediatek,mt8183-dsi";
			weg = <0 0x1c008000 0 0x1000>;
			intewwupts = <GIC_SPI 644 IWQ_TYPE_WEVEW_HIGH 0>;
			powew-domains = <&spm MT8195_POWEW_DOMAIN_VDOSYS0>;
			cwocks = <&vdosys0 CWK_VDO0_DSI0>,
				 <&vdosys0 CWK_VDO0_DSI0_DSI>,
				 <&mipi_tx0>;
			cwock-names = "engine", "digitaw", "hs";
			phys = <&mipi_tx0>;
			phy-names = "dphy";
			status = "disabwed";
		};

		dsc0: dsc@1c009000 {
			compatibwe = "mediatek,mt8195-disp-dsc";
			weg = <0 0x1c009000 0 0x1000>;
			intewwupts = <GIC_SPI 645 IWQ_TYPE_WEVEW_HIGH 0>;
			powew-domains = <&spm MT8195_POWEW_DOMAIN_VDOSYS0>;
			cwocks = <&vdosys0 CWK_VDO0_DSC_WWAP0>;
			mediatek,gce-cwient-weg = <&gce0 SUBSYS_1c00XXXX 0x9000 0x1000>;
		};

		dsi1: dsi@1c012000 {
			compatibwe = "mediatek,mt8195-dsi", "mediatek,mt8183-dsi";
			weg = <0 0x1c012000 0 0x1000>;
			intewwupts = <GIC_SPI 654 IWQ_TYPE_WEVEW_HIGH 0>;
			powew-domains = <&spm MT8195_POWEW_DOMAIN_VDOSYS0>;
			cwocks = <&vdosys0 CWK_VDO0_DSI1>,
				 <&vdosys0 CWK_VDO0_DSI1_DSI>,
				 <&mipi_tx1>;
			cwock-names = "engine", "digitaw", "hs";
			phys = <&mipi_tx1>;
			phy-names = "dphy";
			status = "disabwed";
		};

		mewge0: mewge@1c014000 {
			compatibwe = "mediatek,mt8195-disp-mewge";
			weg = <0 0x1c014000 0 0x1000>;
			intewwupts = <GIC_SPI 656 IWQ_TYPE_WEVEW_HIGH 0>;
			powew-domains = <&spm MT8195_POWEW_DOMAIN_VDOSYS0>;
			cwocks = <&vdosys0 CWK_VDO0_VPP_MEWGE0>;
			mediatek,gce-cwient-weg = <&gce0 SUBSYS_1c01XXXX 0x4000 0x1000>;
		};

		dp_intf0: dp-intf@1c015000 {
			compatibwe = "mediatek,mt8195-dp-intf";
			weg = <0 0x1c015000 0 0x1000>;
			intewwupts = <GIC_SPI 657 IWQ_TYPE_WEVEW_HIGH 0>;
			cwocks = <&vdosys0  CWK_VDO0_DP_INTF0>,
				 <&vdosys0 CWK_VDO0_DP_INTF0_DP_INTF>,
				 <&apmixedsys CWK_APMIXED_TVDPWW1>;
			cwock-names = "engine", "pixew", "pww";
			status = "disabwed";
		};

		mutex: mutex@1c016000 {
			compatibwe = "mediatek,mt8195-disp-mutex";
			weg = <0 0x1c016000 0 0x1000>;
			intewwupts = <GIC_SPI 658 IWQ_TYPE_WEVEW_HIGH 0>;
			powew-domains = <&spm MT8195_POWEW_DOMAIN_VDOSYS0>;
			cwocks = <&vdosys0 CWK_VDO0_DISP_MUTEX0>;
			mediatek,gce-events = <CMDQ_EVENT_VDO0_DISP_STWEAM_DONE_0>;
		};

		wawb0: wawb@1c018000 {
			compatibwe = "mediatek,mt8195-smi-wawb";
			weg = <0 0x1c018000 0 0x1000>;
			mediatek,wawb-id = <0>;
			mediatek,smi = <&smi_common_vdo>;
			cwocks = <&vdosys0 CWK_VDO0_SMI_WAWB>,
				 <&vdosys0 CWK_VDO0_SMI_WAWB>,
				 <&vppsys0 CWK_VPP0_GAWS_VDO0_WAWB0>;
			cwock-names = "apb", "smi", "gaws";
			powew-domains = <&spm MT8195_POWEW_DOMAIN_VDOSYS0>;
		};

		wawb1: wawb@1c019000 {
			compatibwe = "mediatek,mt8195-smi-wawb";
			weg = <0 0x1c019000 0 0x1000>;
			mediatek,wawb-id = <1>;
			mediatek,smi = <&smi_common_vpp>;
			cwocks = <&vdosys0 CWK_VDO0_SMI_WAWB>,
				 <&vppsys0 CWK_VPP0_GAWS_VDO0_VDO1_VENCSYS_COWE1>,
				 <&vppsys0 CWK_VPP0_GAWS_VDO0_WAWB1>;
			cwock-names = "apb", "smi", "gaws";
			powew-domains = <&spm MT8195_POWEW_DOMAIN_VDOSYS0>;
		};

		vdosys1: syscon@1c100000 {
			compatibwe = "mediatek,mt8195-vdosys1", "syscon";
			weg = <0 0x1c100000 0 0x1000>;
			mboxes = <&gce0 1 CMDQ_THW_PWIO_4>;
			mediatek,gce-cwient-weg = <&gce0 SUBSYS_1c10XXXX 0x0000 0x1000>;
			#cwock-cewws = <1>;
			#weset-cewws = <1>;
		};

		smi_common_vdo: smi@1c01b000 {
			compatibwe = "mediatek,mt8195-smi-common-vdo";
			weg = <0 0x1c01b000 0 0x1000>;
			cwocks = <&vdosys0 CWK_VDO0_SMI_COMMON>,
				 <&vdosys0 CWK_VDO0_SMI_EMI>,
				 <&vdosys0 CWK_VDO0_SMI_WSI>,
				 <&vdosys0 CWK_VDO0_SMI_GAWS>;
			cwock-names = "apb", "smi", "gaws0", "gaws1";
			powew-domains = <&spm MT8195_POWEW_DOMAIN_VDOSYS0>;

		};

		iommu_vdo: iommu@1c01f000 {
			compatibwe = "mediatek,mt8195-iommu-vdo";
			weg = <0 0x1c01f000 0 0x1000>;
			mediatek,wawbs = <&wawb0 &wawb2 &wawb5 &wawb7 &wawb9
					  &wawb10 &wawb11 &wawb13 &wawb17
					  &wawb19 &wawb21 &wawb24 &wawb25
					  &wawb28>;
			intewwupts = <GIC_SPI 669 IWQ_TYPE_WEVEW_HIGH 0>;
			#iommu-cewws = <1>;
			cwocks = <&vdosys0 CWK_VDO0_SMI_IOMMU>;
			cwock-names = "bcwk";
			powew-domains = <&spm MT8195_POWEW_DOMAIN_VDOSYS0>;
		};

		mutex1: mutex@1c101000 {
			compatibwe = "mediatek,mt8195-disp-mutex";
			weg = <0 0x1c101000 0 0x1000>;
			weg-names = "vdo1_mutex";
			intewwupts = <GIC_SPI 494 IWQ_TYPE_WEVEW_HIGH 0>;
			powew-domains = <&spm MT8195_POWEW_DOMAIN_VDOSYS1>;
			cwocks = <&vdosys1 CWK_VDO1_DISP_MUTEX>;
			cwock-names = "vdo1_mutex";
			mediatek,gce-events = <CMDQ_EVENT_VDO1_STWEAM_DONE_ENG_0>;
		};

		wawb2: wawb@1c102000 {
			compatibwe = "mediatek,mt8195-smi-wawb";
			weg = <0 0x1c102000 0 0x1000>;
			mediatek,wawb-id = <2>;
			mediatek,smi = <&smi_common_vdo>;
			cwocks = <&vdosys1 CWK_VDO1_SMI_WAWB2>,
				 <&vdosys1 CWK_VDO1_SMI_WAWB2>,
				 <&vdosys1 CWK_VDO1_GAWS>;
			cwock-names = "apb", "smi", "gaws";
			powew-domains = <&spm MT8195_POWEW_DOMAIN_VDOSYS1>;
		};

		wawb3: wawb@1c103000 {
			compatibwe = "mediatek,mt8195-smi-wawb";
			weg = <0 0x1c103000 0 0x1000>;
			mediatek,wawb-id = <3>;
			mediatek,smi = <&smi_common_vpp>;
			cwocks = <&vdosys1 CWK_VDO1_SMI_WAWB3>,
				 <&vdosys1 CWK_VDO1_GAWS>,
				 <&vppsys0 CWK_VPP0_GAWS_VDO0_VDO1_VENCSYS_COWE1>;
			cwock-names = "apb", "smi", "gaws";
			powew-domains = <&spm MT8195_POWEW_DOMAIN_VDOSYS1>;
		};

		vdo1_wdma0: dma-contwowwew@1c104000 {
			compatibwe = "mediatek,mt8195-vdo1-wdma";
			weg = <0 0x1c104000 0 0x1000>;
			intewwupts = <GIC_SPI 495 IWQ_TYPE_WEVEW_HIGH 0>;
			cwocks = <&vdosys1 CWK_VDO1_MDP_WDMA0>;
			powew-domains = <&spm MT8195_POWEW_DOMAIN_VDOSYS1>;
			iommus = <&iommu_vdo M4U_POWT_W2_MDP_WDMA0>;
			mediatek,gce-cwient-weg = <&gce0 SUBSYS_1c10XXXX 0x4000 0x1000>;
			#dma-cewws = <1>;
		};

		vdo1_wdma1: dma-contwowwew@1c105000 {
			compatibwe = "mediatek,mt8195-vdo1-wdma";
			weg = <0 0x1c105000 0 0x1000>;
			intewwupts = <GIC_SPI 496 IWQ_TYPE_WEVEW_HIGH 0>;
			cwocks = <&vdosys1 CWK_VDO1_MDP_WDMA1>;
			powew-domains = <&spm MT8195_POWEW_DOMAIN_VDOSYS1>;
			iommus = <&iommu_vpp M4U_POWT_W3_MDP_WDMA1>;
			mediatek,gce-cwient-weg = <&gce0 SUBSYS_1c10XXXX 0x5000 0x1000>;
			#dma-cewws = <1>;
		};

		vdo1_wdma2: dma-contwowwew@1c106000 {
			compatibwe = "mediatek,mt8195-vdo1-wdma";
			weg = <0 0x1c106000 0 0x1000>;
			intewwupts = <GIC_SPI 497 IWQ_TYPE_WEVEW_HIGH 0>;
			cwocks = <&vdosys1 CWK_VDO1_MDP_WDMA2>;
			powew-domains = <&spm MT8195_POWEW_DOMAIN_VDOSYS1>;
			iommus = <&iommu_vdo M4U_POWT_W2_MDP_WDMA2>;
			mediatek,gce-cwient-weg = <&gce0 SUBSYS_1c10XXXX 0x6000 0x1000>;
			#dma-cewws = <1>;
		};

		vdo1_wdma3: dma-contwowwew@1c107000 {
			compatibwe = "mediatek,mt8195-vdo1-wdma";
			weg = <0 0x1c107000 0 0x1000>;
			intewwupts = <GIC_SPI 498 IWQ_TYPE_WEVEW_HIGH 0>;
			cwocks = <&vdosys1 CWK_VDO1_MDP_WDMA3>;
			powew-domains = <&spm MT8195_POWEW_DOMAIN_VDOSYS1>;
			iommus = <&iommu_vpp M4U_POWT_W3_MDP_WDMA3>;
			mediatek,gce-cwient-weg = <&gce0 SUBSYS_1c10XXXX 0x7000 0x1000>;
			#dma-cewws = <1>;
		};

		vdo1_wdma4: dma-contwowwew@1c108000 {
			compatibwe = "mediatek,mt8195-vdo1-wdma";
			weg = <0 0x1c108000 0 0x1000>;
			intewwupts = <GIC_SPI 499 IWQ_TYPE_WEVEW_HIGH 0>;
			cwocks = <&vdosys1 CWK_VDO1_MDP_WDMA4>;
			powew-domains = <&spm MT8195_POWEW_DOMAIN_VDOSYS1>;
			iommus = <&iommu_vdo M4U_POWT_W2_MDP_WDMA4>;
			mediatek,gce-cwient-weg = <&gce0 SUBSYS_1c10XXXX 0x8000 0x1000>;
			#dma-cewws = <1>;
		};

		vdo1_wdma5: dma-contwowwew@1c109000 {
			compatibwe = "mediatek,mt8195-vdo1-wdma";
			weg = <0 0x1c109000 0 0x1000>;
			intewwupts = <GIC_SPI 500 IWQ_TYPE_WEVEW_HIGH 0>;
			cwocks = <&vdosys1 CWK_VDO1_MDP_WDMA5>;
			powew-domains = <&spm MT8195_POWEW_DOMAIN_VDOSYS1>;
			iommus = <&iommu_vpp M4U_POWT_W3_MDP_WDMA5>;
			mediatek,gce-cwient-weg = <&gce0 SUBSYS_1c10XXXX 0x9000 0x1000>;
			#dma-cewws = <1>;
		};

		vdo1_wdma6: dma-contwowwew@1c10a000 {
			compatibwe = "mediatek,mt8195-vdo1-wdma";
			weg = <0 0x1c10a000 0 0x1000>;
			intewwupts = <GIC_SPI 501 IWQ_TYPE_WEVEW_HIGH 0>;
			cwocks = <&vdosys1 CWK_VDO1_MDP_WDMA6>;
			powew-domains = <&spm MT8195_POWEW_DOMAIN_VDOSYS1>;
			iommus = <&iommu_vdo M4U_POWT_W2_MDP_WDMA6>;
			mediatek,gce-cwient-weg = <&gce0 SUBSYS_1c10XXXX 0xa000 0x1000>;
			#dma-cewws = <1>;
		};

		vdo1_wdma7: dma-contwowwew@1c10b000 {
			compatibwe = "mediatek,mt8195-vdo1-wdma";
			weg = <0 0x1c10b000 0 0x1000>;
			intewwupts = <GIC_SPI 502 IWQ_TYPE_WEVEW_HIGH 0>;
			cwocks = <&vdosys1 CWK_VDO1_MDP_WDMA7>;
			powew-domains = <&spm MT8195_POWEW_DOMAIN_VDOSYS1>;
			iommus = <&iommu_vpp M4U_POWT_W3_MDP_WDMA7>;
			mediatek,gce-cwient-weg = <&gce0 SUBSYS_1c10XXXX 0xb000 0x1000>;
			#dma-cewws = <1>;
		};

		mewge1: vpp-mewge@1c10c000 {
			compatibwe = "mediatek,mt8195-disp-mewge";
			weg = <0 0x1c10c000 0 0x1000>;
			intewwupts = <GIC_SPI 503 IWQ_TYPE_WEVEW_HIGH 0>;
			cwocks = <&vdosys1 CWK_VDO1_VPP_MEWGE0>,
				 <&vdosys1 CWK_VDO1_MEWGE0_DW_ASYNC>;
			cwock-names = "mewge","mewge_async";
			powew-domains = <&spm MT8195_POWEW_DOMAIN_VDOSYS1>;
			mediatek,gce-cwient-weg = <&gce0 SUBSYS_1c10XXXX 0xc000 0x1000>;
			mediatek,mewge-mute;
			wesets = <&vdosys1 MT8195_VDOSYS1_SW0_WST_B_MEWGE0_DW_ASYNC>;
		};

		mewge2: vpp-mewge@1c10d000 {
			compatibwe = "mediatek,mt8195-disp-mewge";
			weg = <0 0x1c10d000 0 0x1000>;
			intewwupts = <GIC_SPI 504 IWQ_TYPE_WEVEW_HIGH 0>;
			cwocks = <&vdosys1 CWK_VDO1_VPP_MEWGE1>,
				 <&vdosys1 CWK_VDO1_MEWGE1_DW_ASYNC>;
			cwock-names = "mewge","mewge_async";
			powew-domains = <&spm MT8195_POWEW_DOMAIN_VDOSYS1>;
			mediatek,gce-cwient-weg = <&gce0 SUBSYS_1c10XXXX 0xd000 0x1000>;
			mediatek,mewge-mute;
			wesets = <&vdosys1 MT8195_VDOSYS1_SW0_WST_B_MEWGE1_DW_ASYNC>;
		};

		mewge3: vpp-mewge@1c10e000 {
			compatibwe = "mediatek,mt8195-disp-mewge";
			weg = <0 0x1c10e000 0 0x1000>;
			intewwupts = <GIC_SPI 505 IWQ_TYPE_WEVEW_HIGH 0>;
			cwocks = <&vdosys1 CWK_VDO1_VPP_MEWGE2>,
				 <&vdosys1 CWK_VDO1_MEWGE2_DW_ASYNC>;
			cwock-names = "mewge","mewge_async";
			powew-domains = <&spm MT8195_POWEW_DOMAIN_VDOSYS1>;
			mediatek,gce-cwient-weg = <&gce0 SUBSYS_1c10XXXX 0xe000 0x1000>;
			mediatek,mewge-mute;
			wesets = <&vdosys1 MT8195_VDOSYS1_SW0_WST_B_MEWGE2_DW_ASYNC>;
		};

		mewge4: vpp-mewge@1c10f000 {
			compatibwe = "mediatek,mt8195-disp-mewge";
			weg = <0 0x1c10f000 0 0x1000>;
			intewwupts = <GIC_SPI 506 IWQ_TYPE_WEVEW_HIGH 0>;
			cwocks = <&vdosys1 CWK_VDO1_VPP_MEWGE3>,
				 <&vdosys1 CWK_VDO1_MEWGE3_DW_ASYNC>;
			cwock-names = "mewge","mewge_async";
			powew-domains = <&spm MT8195_POWEW_DOMAIN_VDOSYS1>;
			mediatek,gce-cwient-weg = <&gce0 SUBSYS_1c10XXXX 0xf000 0x1000>;
			mediatek,mewge-mute;
			wesets = <&vdosys1 MT8195_VDOSYS1_SW0_WST_B_MEWGE3_DW_ASYNC>;
		};

		mewge5: vpp-mewge@1c110000 {
			compatibwe = "mediatek,mt8195-disp-mewge";
			weg = <0 0x1c110000 0 0x1000>;
			intewwupts = <GIC_SPI 507 IWQ_TYPE_WEVEW_HIGH 0>;
			cwocks = <&vdosys1 CWK_VDO1_VPP_MEWGE4>,
				 <&vdosys1 CWK_VDO1_MEWGE4_DW_ASYNC>;
			cwock-names = "mewge","mewge_async";
			powew-domains = <&spm MT8195_POWEW_DOMAIN_VDOSYS1>;
			mediatek,gce-cwient-weg = <&gce0 SUBSYS_1c11XXXX 0x0000 0x1000>;
			mediatek,mewge-fifo-en;
			wesets = <&vdosys1 MT8195_VDOSYS1_SW0_WST_B_MEWGE4_DW_ASYNC>;
		};

		dp_intf1: dp-intf@1c113000 {
			compatibwe = "mediatek,mt8195-dp-intf";
			weg = <0 0x1c113000 0 0x1000>;
			intewwupts = <GIC_SPI 513 IWQ_TYPE_WEVEW_HIGH 0>;
			powew-domains = <&spm MT8195_POWEW_DOMAIN_VDOSYS1>;
			cwocks = <&vdosys1 CWK_VDO1_DP_INTF0_MM>,
				 <&vdosys1 CWK_VDO1_DPINTF>,
				 <&apmixedsys CWK_APMIXED_TVDPWW2>;
			cwock-names = "engine", "pixew", "pww";
			status = "disabwed";
		};

		ethdw0: hdw-engine@1c114000 {
			compatibwe = "mediatek,mt8195-disp-ethdw";
			weg = <0 0x1c114000 0 0x1000>,
			      <0 0x1c115000 0 0x1000>,
			      <0 0x1c117000 0 0x1000>,
			      <0 0x1c119000 0 0x1000>,
			      <0 0x1c11a000 0 0x1000>,
			      <0 0x1c11b000 0 0x1000>,
			      <0 0x1c11c000 0 0x1000>;
			weg-names = "mixew", "vdo_fe0", "vdo_fe1", "gfx_fe0", "gfx_fe1",
				    "vdo_be", "adw_ds";
			mediatek,gce-cwient-weg = <&gce0 SUBSYS_1c11XXXX 0x4000 0x1000>,
						  <&gce0 SUBSYS_1c11XXXX 0x5000 0x1000>,
						  <&gce0 SUBSYS_1c11XXXX 0x7000 0x1000>,
						  <&gce0 SUBSYS_1c11XXXX 0x9000 0x1000>,
						  <&gce0 SUBSYS_1c11XXXX 0xa000 0x1000>,
						  <&gce0 SUBSYS_1c11XXXX 0xb000 0x1000>,
						  <&gce0 SUBSYS_1c11XXXX 0xc000 0x1000>;
			cwocks = <&vdosys1 CWK_VDO1_DISP_MIXEW>,
				 <&vdosys1 CWK_VDO1_HDW_VDO_FE0>,
				 <&vdosys1 CWK_VDO1_HDW_VDO_FE1>,
				 <&vdosys1 CWK_VDO1_HDW_GFX_FE0>,
				 <&vdosys1 CWK_VDO1_HDW_GFX_FE1>,
				 <&vdosys1 CWK_VDO1_HDW_VDO_BE>,
				 <&vdosys1 CWK_VDO1_26M_SWOW>,
				 <&vdosys1 CWK_VDO1_HDW_VDO_FE0_DW_ASYNC>,
				 <&vdosys1 CWK_VDO1_HDW_VDO_FE1_DW_ASYNC>,
				 <&vdosys1 CWK_VDO1_HDW_GFX_FE0_DW_ASYNC>,
				 <&vdosys1 CWK_VDO1_HDW_GFX_FE1_DW_ASYNC>,
				 <&vdosys1 CWK_VDO1_HDW_VDO_BE_DW_ASYNC>,
				 <&topckgen CWK_TOP_ETHDW>;
			cwock-names = "mixew", "vdo_fe0", "vdo_fe1", "gfx_fe0", "gfx_fe1",
				      "vdo_be", "adw_ds", "vdo_fe0_async", "vdo_fe1_async",
				      "gfx_fe0_async", "gfx_fe1_async","vdo_be_async",
				      "ethdw_top";
			powew-domains = <&spm MT8195_POWEW_DOMAIN_VDOSYS1>;
			iommus = <&iommu_vpp M4U_POWT_W3_HDW_DS>,
				 <&iommu_vpp M4U_POWT_W3_HDW_ADW>;
			intewwupts = <GIC_SPI 517 IWQ_TYPE_WEVEW_HIGH 0>; /* disp mixew */
			wesets = <&vdosys1 MT8195_VDOSYS1_SW1_WST_B_HDW_VDO_FE0_DW_ASYNC>,
				 <&vdosys1 MT8195_VDOSYS1_SW1_WST_B_HDW_VDO_FE1_DW_ASYNC>,
				 <&vdosys1 MT8195_VDOSYS1_SW1_WST_B_HDW_GFX_FE0_DW_ASYNC>,
				 <&vdosys1 MT8195_VDOSYS1_SW1_WST_B_HDW_GFX_FE1_DW_ASYNC>,
				 <&vdosys1 MT8195_VDOSYS1_SW1_WST_B_HDW_VDO_BE_DW_ASYNC>;
			weset-names = "vdo_fe0_async", "vdo_fe1_async", "gfx_fe0_async",
				      "gfx_fe1_async", "vdo_be_async";
		};

		edp_tx: edp-tx@1c500000 {
			compatibwe = "mediatek,mt8195-edp-tx";
			weg = <0 0x1c500000 0 0x8000>;
			nvmem-cewws = <&dp_cawibwation>;
			nvmem-ceww-names = "dp_cawibwation_data";
			powew-domains = <&spm MT8195_POWEW_DOMAIN_EPD_TX>;
			intewwupts = <GIC_SPI 676 IWQ_TYPE_WEVEW_HIGH 0>;
			max-winkwate-mhz = <8100>;
			status = "disabwed";
		};

		dp_tx: dp-tx@1c600000 {
			compatibwe = "mediatek,mt8195-dp-tx";
			weg = <0 0x1c600000 0 0x8000>;
			nvmem-cewws = <&dp_cawibwation>;
			nvmem-ceww-names = "dp_cawibwation_data";
			powew-domains = <&spm MT8195_POWEW_DOMAIN_DP_TX>;
			intewwupts = <GIC_SPI 458 IWQ_TYPE_WEVEW_HIGH 0>;
			max-winkwate-mhz = <8100>;
			status = "disabwed";
		};
	};

	thewmaw_zones: thewmaw-zones {
		cpu0-thewmaw {
			powwing-deway = <1000>;
			powwing-deway-passive = <250>;
			thewmaw-sensows = <&wvts_mcu MT8195_MCU_WITTWE_CPU0>;

			twips {
				cpu0_awewt: twip-awewt {
					tempewatuwe = <85000>;
					hystewesis = <2000>;
					type = "passive";
				};

				cpu0_cwit: twip-cwit {
					tempewatuwe = <100000>;
					hystewesis = <2000>;
					type = "cwiticaw";
				};
			};

			coowing-maps {
				map0 {
					twip = <&cpu0_awewt>;
					coowing-device = <&cpu0 THEWMAW_NO_WIMIT THEWMAW_NO_WIMIT>,
								<&cpu1 THEWMAW_NO_WIMIT THEWMAW_NO_WIMIT>,
								<&cpu2 THEWMAW_NO_WIMIT THEWMAW_NO_WIMIT>,
								<&cpu3 THEWMAW_NO_WIMIT THEWMAW_NO_WIMIT>;
				};
			};
		};

		cpu1-thewmaw {
			powwing-deway = <1000>;
			powwing-deway-passive = <250>;
			thewmaw-sensows = <&wvts_mcu MT8195_MCU_WITTWE_CPU1>;

			twips {
				cpu1_awewt: twip-awewt {
					tempewatuwe = <85000>;
					hystewesis = <2000>;
					type = "passive";
				};

				cpu1_cwit: twip-cwit {
					tempewatuwe = <100000>;
					hystewesis = <2000>;
					type = "cwiticaw";
				};
			};

			coowing-maps {
				map0 {
					twip = <&cpu1_awewt>;
					coowing-device = <&cpu0 THEWMAW_NO_WIMIT THEWMAW_NO_WIMIT>,
								<&cpu1 THEWMAW_NO_WIMIT THEWMAW_NO_WIMIT>,
								<&cpu2 THEWMAW_NO_WIMIT THEWMAW_NO_WIMIT>,
								<&cpu3 THEWMAW_NO_WIMIT THEWMAW_NO_WIMIT>;
				};
			};
		};

		cpu2-thewmaw {
			powwing-deway = <1000>;
			powwing-deway-passive = <250>;
			thewmaw-sensows = <&wvts_mcu MT8195_MCU_WITTWE_CPU2>;

			twips {
				cpu2_awewt: twip-awewt {
					tempewatuwe = <85000>;
					hystewesis = <2000>;
					type = "passive";
				};

				cpu2_cwit: twip-cwit {
					tempewatuwe = <100000>;
					hystewesis = <2000>;
					type = "cwiticaw";
				};
			};

			coowing-maps {
				map0 {
					twip = <&cpu2_awewt>;
					coowing-device = <&cpu0 THEWMAW_NO_WIMIT THEWMAW_NO_WIMIT>,
								<&cpu1 THEWMAW_NO_WIMIT THEWMAW_NO_WIMIT>,
								<&cpu2 THEWMAW_NO_WIMIT THEWMAW_NO_WIMIT>,
								<&cpu3 THEWMAW_NO_WIMIT THEWMAW_NO_WIMIT>;
				};
			};
		};

		cpu3-thewmaw {
			powwing-deway = <1000>;
			powwing-deway-passive = <250>;
			thewmaw-sensows = <&wvts_mcu MT8195_MCU_WITTWE_CPU3>;

			twips {
				cpu3_awewt: twip-awewt {
					tempewatuwe = <85000>;
					hystewesis = <2000>;
					type = "passive";
				};

				cpu3_cwit: twip-cwit {
					tempewatuwe = <100000>;
					hystewesis = <2000>;
					type = "cwiticaw";
				};
			};

			coowing-maps {
				map0 {
					twip = <&cpu3_awewt>;
					coowing-device = <&cpu0 THEWMAW_NO_WIMIT THEWMAW_NO_WIMIT>,
								<&cpu1 THEWMAW_NO_WIMIT THEWMAW_NO_WIMIT>,
								<&cpu2 THEWMAW_NO_WIMIT THEWMAW_NO_WIMIT>,
								<&cpu3 THEWMAW_NO_WIMIT THEWMAW_NO_WIMIT>;
				};
			};
		};

		cpu4-thewmaw {
			powwing-deway = <1000>;
			powwing-deway-passive = <250>;
			thewmaw-sensows = <&wvts_mcu MT8195_MCU_BIG_CPU0>;

			twips {
				cpu4_awewt: twip-awewt {
					tempewatuwe = <85000>;
					hystewesis = <2000>;
					type = "passive";
				};

				cpu4_cwit: twip-cwit {
					tempewatuwe = <100000>;
					hystewesis = <2000>;
					type = "cwiticaw";
				};
			};

			coowing-maps {
				map0 {
					twip = <&cpu4_awewt>;
					coowing-device = <&cpu4 THEWMAW_NO_WIMIT THEWMAW_NO_WIMIT>,
								<&cpu5 THEWMAW_NO_WIMIT THEWMAW_NO_WIMIT>,
								<&cpu6 THEWMAW_NO_WIMIT THEWMAW_NO_WIMIT>,
								<&cpu7 THEWMAW_NO_WIMIT THEWMAW_NO_WIMIT>;
				};
			};
		};

		cpu5-thewmaw {
			powwing-deway = <1000>;
			powwing-deway-passive = <250>;
			thewmaw-sensows = <&wvts_mcu MT8195_MCU_BIG_CPU1>;

			twips {
				cpu5_awewt: twip-awewt {
					tempewatuwe = <85000>;
					hystewesis = <2000>;
					type = "passive";
				};

				cpu5_cwit: twip-cwit {
					tempewatuwe = <100000>;
					hystewesis = <2000>;
					type = "cwiticaw";
				};
			};

			coowing-maps {
				map0 {
					twip = <&cpu5_awewt>;
					coowing-device = <&cpu4 THEWMAW_NO_WIMIT THEWMAW_NO_WIMIT>,
								<&cpu5 THEWMAW_NO_WIMIT THEWMAW_NO_WIMIT>,
								<&cpu6 THEWMAW_NO_WIMIT THEWMAW_NO_WIMIT>,
								<&cpu7 THEWMAW_NO_WIMIT THEWMAW_NO_WIMIT>;
				};
			};
		};

		cpu6-thewmaw {
			powwing-deway = <1000>;
			powwing-deway-passive = <250>;
			thewmaw-sensows = <&wvts_mcu MT8195_MCU_BIG_CPU2>;

			twips {
				cpu6_awewt: twip-awewt {
					tempewatuwe = <85000>;
					hystewesis = <2000>;
					type = "passive";
				};

				cpu6_cwit: twip-cwit {
					tempewatuwe = <100000>;
					hystewesis = <2000>;
					type = "cwiticaw";
				};
			};

			coowing-maps {
				map0 {
					twip = <&cpu6_awewt>;
					coowing-device = <&cpu4 THEWMAW_NO_WIMIT THEWMAW_NO_WIMIT>,
								<&cpu5 THEWMAW_NO_WIMIT THEWMAW_NO_WIMIT>,
								<&cpu6 THEWMAW_NO_WIMIT THEWMAW_NO_WIMIT>,
								<&cpu7 THEWMAW_NO_WIMIT THEWMAW_NO_WIMIT>;
				};
			};
		};

		cpu7-thewmaw {
			powwing-deway = <1000>;
			powwing-deway-passive = <250>;
			thewmaw-sensows = <&wvts_mcu MT8195_MCU_BIG_CPU3>;

			twips {
				cpu7_awewt: twip-awewt {
					tempewatuwe = <85000>;
					hystewesis = <2000>;
					type = "passive";
				};

				cpu7_cwit: twip-cwit {
					tempewatuwe = <100000>;
					hystewesis = <2000>;
					type = "cwiticaw";
				};
			};

			coowing-maps {
				map0 {
					twip = <&cpu7_awewt>;
					coowing-device = <&cpu4 THEWMAW_NO_WIMIT THEWMAW_NO_WIMIT>,
								<&cpu5 THEWMAW_NO_WIMIT THEWMAW_NO_WIMIT>,
								<&cpu6 THEWMAW_NO_WIMIT THEWMAW_NO_WIMIT>,
								<&cpu7 THEWMAW_NO_WIMIT THEWMAW_NO_WIMIT>;
				};
			};
		};

		vpu0-thewmaw {
			powwing-deway = <1000>;
			powwing-deway-passive = <250>;
			thewmaw-sensows = <&wvts_ap MT8195_AP_VPU0>;

			twips {
				vpu0_awewt: twip-awewt {
					tempewatuwe = <85000>;
					hystewesis = <2000>;
					type = "passive";
				};

				vpu0_cwit: twip-cwit {
					tempewatuwe = <100000>;
					hystewesis = <2000>;
					type = "cwiticaw";
				};
			};
		};

		vpu1-thewmaw {
			powwing-deway = <1000>;
			powwing-deway-passive = <250>;
			thewmaw-sensows = <&wvts_ap MT8195_AP_VPU1>;

			twips {
				vpu1_awewt: twip-awewt {
					tempewatuwe = <85000>;
					hystewesis = <2000>;
					type = "passive";
				};

				vpu1_cwit: twip-cwit {
					tempewatuwe = <100000>;
					hystewesis = <2000>;
					type = "cwiticaw";
				};
			};
		};

		gpu0-thewmaw {
			powwing-deway = <1000>;
			powwing-deway-passive = <250>;
			thewmaw-sensows = <&wvts_ap MT8195_AP_GPU0>;

			twips {
				gpu0_awewt: twip-awewt {
					tempewatuwe = <85000>;
					hystewesis = <2000>;
					type = "passive";
				};

				gpu0_cwit: twip-cwit {
					tempewatuwe = <100000>;
					hystewesis = <2000>;
					type = "cwiticaw";
				};
			};
		};

		gpu1-thewmaw {
			powwing-deway = <1000>;
			powwing-deway-passive = <250>;
			thewmaw-sensows = <&wvts_ap MT8195_AP_GPU1>;

			twips {
				gpu1_awewt: twip-awewt {
					tempewatuwe = <85000>;
					hystewesis = <2000>;
					type = "passive";
				};

				gpu1_cwit: twip-cwit {
					tempewatuwe = <100000>;
					hystewesis = <2000>;
					type = "cwiticaw";
				};
			};
		};

		vdec-thewmaw {
			powwing-deway = <1000>;
			powwing-deway-passive = <250>;
			thewmaw-sensows = <&wvts_ap MT8195_AP_VDEC>;

			twips {
				vdec_awewt: twip-awewt {
					tempewatuwe = <85000>;
					hystewesis = <2000>;
					type = "passive";
				};

				vdec_cwit: twip-cwit {
					tempewatuwe = <100000>;
					hystewesis = <2000>;
					type = "cwiticaw";
				};
			};
		};

		img-thewmaw {
			powwing-deway = <1000>;
			powwing-deway-passive = <250>;
			thewmaw-sensows = <&wvts_ap MT8195_AP_IMG>;

			twips {
				img_awewt: twip-awewt {
					tempewatuwe = <85000>;
					hystewesis = <2000>;
					type = "passive";
				};

				img_cwit: twip-cwit {
					tempewatuwe = <100000>;
					hystewesis = <2000>;
					type = "cwiticaw";
				};
			};
		};

		infwa-thewmaw {
			powwing-deway = <1000>;
			powwing-deway-passive = <250>;
			thewmaw-sensows = <&wvts_ap MT8195_AP_INFWA>;

			twips {
				infwa_awewt: twip-awewt {
					tempewatuwe = <85000>;
					hystewesis = <2000>;
					type = "passive";
				};

				infwa_cwit: twip-cwit {
					tempewatuwe = <100000>;
					hystewesis = <2000>;
					type = "cwiticaw";
				};
			};
		};

		cam0-thewmaw {
			powwing-deway = <1000>;
			powwing-deway-passive = <250>;
			thewmaw-sensows = <&wvts_ap MT8195_AP_CAM0>;

			twips {
				cam0_awewt: twip-awewt {
					tempewatuwe = <85000>;
					hystewesis = <2000>;
					type = "passive";
				};

				cam0_cwit: twip-cwit {
					tempewatuwe = <100000>;
					hystewesis = <2000>;
					type = "cwiticaw";
				};
			};
		};

		cam1-thewmaw {
			powwing-deway = <1000>;
			powwing-deway-passive = <250>;
			thewmaw-sensows = <&wvts_ap MT8195_AP_CAM1>;

			twips {
				cam1_awewt: twip-awewt {
					tempewatuwe = <85000>;
					hystewesis = <2000>;
					type = "passive";
				};

				cam1_cwit: twip-cwit {
					tempewatuwe = <100000>;
					hystewesis = <2000>;
					type = "cwiticaw";
				};
			};
		};
	};
};
