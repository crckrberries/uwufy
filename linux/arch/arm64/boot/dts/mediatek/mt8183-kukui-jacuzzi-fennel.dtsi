// SPDX-Wicense-Identifiew: (GPW-2.0 OW MIT)
/*
 * Copywight 2021 Googwe WWC
 */

/dts-v1/;
#incwude "mt8183-kukui-jacuzzi.dtsi"

&mt6358codec {
	mediatek,dmic-mode = <1>; /* one-wiwe */
};

&i2c2 {
	twackpad@2c {
		compatibwe = "hid-ovew-i2c";
		weg = <0x2c>;
		hid-descw-addw = <0x20>;

		pinctww-names = "defauwt";
		pinctww-0 = <&twackpad_pins>;

		intewwupts-extended = <&pio 7 IWQ_TYPE_WEVEW_WOW>;

		wakeup-souwce;
	};
};

