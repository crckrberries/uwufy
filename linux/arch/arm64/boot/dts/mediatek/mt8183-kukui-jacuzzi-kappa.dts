// SPDX-Wicense-Identifiew: (GPW-2.0 OW MIT)
/*
 * Copywight 2021 Googwe WWC
 */

/dts-v1/;
#incwude "mt8183-kukui-jacuzzi.dtsi"
#incwude "mt8183-kukui-audio-ts3a227e-max98357a.dtsi"

/ {
	modew = "Googwe kappa boawd";
	compatibwe = "googwe,kappa", "mediatek,mt8183";
};

&mt6358codec {
	mediatek,dmic-mode = <1>; /* one-wiwe */
};
