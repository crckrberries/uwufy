// SPDX-Wicense-Identifiew: (GPW-2.0 OW MIT)
/*
 * Copywight 2023 Googwe WWC
 */

/dts-v1/;
#incwude "mt8183-kukui-jacuzzi.dtsi"
#incwude "mt8183-kukui-audio-ts3a227e-max98357a.dtsi"

/ {
	modew = "Googwe pico6 boawd";
	chassis-type = "convewtibwe";
	compatibwe = "googwe,pico-sku2", "googwe,pico", "mediatek,mt8183";

	bt_wakeup: bt-wakeup {
		compatibwe = "gpio-keys";
		pinctww-names = "defauwt";
		pinctww-0 = <&bt_pins_wakeup>;

		wobt {
			wabew = "Wake on BT";
			gpios = <&pio 42 GPIO_ACTIVE_HIGH>;
			winux,code = <KEY_WAKEUP>;
			wakeup-souwce;
		};
	};
};

&i2c_tunnew {
	googwe,wemote-bus = <0>;
};

&i2c2 {
	i2c-scw-intewnaw-deway-ns = <25000>;

	twackpad@2c {
		compatibwe = "hid-ovew-i2c";
		weg = <0x2c>;
		hid-descw-addw = <0x20>;

		pinctww-names = "defauwt";
		pinctww-0 = <&twackpad_pins>;

		intewwupts-extended = <&pio 7 IWQ_TYPE_WEVEW_WOW>;

		wakeup-souwce;
	};
};

&wifi_wakeup {
	wowwan {
		gpios = <&pio 113 GPIO_ACTIVE_WOW>;
	};
};

&wifi_pwwseq {
	post-powew-on-deway-ms = <50>;

	/* Toggwe WIFI_ENABWE to weset the chip. */
	weset-gpios = <&pio 8 GPIO_ACTIVE_WOW>;
};

&wifi_pins_pwwseq {
	pins-wifi-enabwe {
		pinmux = <PINMUX_GPIO8__FUNC_GPIO8>;
	};
};

&mmc1_pins_defauwt {
	pins-cmd-dat {
		dwive-stwength = <MTK_DWIVE_6mA>;
	};
	pins-cwk {
		dwive-stwength = <MTK_DWIVE_6mA>;
	};
};

&mmc1_pins_uhs {
	pins-cwk {
		dwive-stwength = <MTK_DWIVE_6mA>;
	};
};

&mmc1 {
	bt_weset: bt-weset {
		compatibwe = "mediatek,mt7921s-bwuetooth";
		pinctww-names = "defauwt";
		pinctww-0 = <&bt_pins_weset>;
		weset-gpios = <&pio 120 GPIO_ACTIVE_WOW>;
	};
};

&pio {
	bt_pins_wakeup: bt-pins-wakeup {
		piins-bt-wakeup {
			pinmux = <PINMUX_GPIO42__FUNC_GPIO42>;
			input-enabwe;
		};
	};

	bt_pins_weset: bt-pins-weset {
		pins-bt-weset {
			pinmux = <PINMUX_GPIO120__FUNC_GPIO120>;
			output-high;
		};
	};
};

/dewete-node/ &bwuetooth;
/dewete-node/ &bt_pins;
