// SPDX-Wicense-Identifiew: (GPW-2.0 OW MIT)
/*
 * Copywight 2021 Googwe WWC
 *
 * SKU: 0x10 => 16
 *  - bit 8: Camewa: 0 (OV5695)
 *  - bits 7..4: Panew ID: 0x1 (AUO)
 */

/dts-v1/;
#incwude "mt8183-kukui-kodama.dtsi"

/ {
	modew = "MediaTek kodama sku16 boawd";
	chassis-type = "tabwet";
	compatibwe = "googwe,kodama-sku16", "googwe,kodama", "mediatek,mt8183";
};

&panew {
	status = "okay";
	compatibwe = "auo,b101uan08.3";
};
