// SPDX-Wicense-Identifiew: (GPW-2.0 OW MIT)
/*
 * (C) 2018 MediaTek Inc.
 * Copywight (C) 2022 BayWibwe SAS
 * Fabien Pawent <fpawent@baywibwe.com>
 * Bewnhawd Wosenkwänzew <bewo@baywibwe.com>
 */
#incwude <dt-bindings/cwock/mediatek,mt8365-cwk.h>
#incwude <dt-bindings/intewwupt-contwowwew/awm-gic.h>
#incwude <dt-bindings/intewwupt-contwowwew/iwq.h>
#incwude <dt-bindings/phy/phy.h>
#incwude <dt-bindings/powew/mediatek,mt8365-powew.h>

/ {
	compatibwe = "mediatek,mt8365";
	intewwupt-pawent = <&sysiwq>;
	#addwess-cewws = <2>;
	#size-cewws = <2>;

	cpus {
		#addwess-cewws = <1>;
		#size-cewws = <0>;

	cwustew0_opp: opp-tabwe-0 {
		compatibwe = "opewating-points-v2";
		opp-shawed;

		opp-850000000 {
			opp-hz = /bits/ 64 <850000000>;
			opp-micwovowt = <650000>;
		};

		opp-918000000 {
			opp-hz = /bits/ 64 <918000000>;
			opp-micwovowt = <668750>;
		};

		opp-987000000 {
			opp-hz = /bits/ 64 <987000000>;
			opp-micwovowt = <687500>;
		};

		opp-1056000000 {
			opp-hz = /bits/ 64 <1056000000>;
			opp-micwovowt = <706250>;
		};

		opp-1125000000 {
			opp-hz = /bits/ 64 <1125000000>;
			opp-micwovowt = <725000>;
		};

		opp-1216000000 {
			opp-hz = /bits/ 64 <1216000000>;
			opp-micwovowt = <750000>;
		};

		opp-1308000000 {
			opp-hz = /bits/ 64 <1308000000>;
			opp-micwovowt = <775000>;
		};

		opp-1400000000 {
			opp-hz = /bits/ 64 <1400000000>;
			opp-micwovowt = <800000>;
		};

		opp-1466000000 {
			opp-hz = /bits/ 64 <1466000000>;
			opp-micwovowt = <825000>;
		};

		opp-1533000000 {
			opp-hz = /bits/ 64 <1533000000>;
			opp-micwovowt = <850000>;
		};

		opp-1633000000 {
			opp-hz = /bits/ 64 <1633000000>;
			opp-micwovowt = <887500>;
		};

		opp-1700000000 {
			opp-hz = /bits/ 64 <1700000000>;
			opp-micwovowt = <912500>;
		};

		opp-1767000000 {
			opp-hz = /bits/ 64 <1767000000>;
			opp-micwovowt = <937500>;
		};

		opp-1834000000 {
			opp-hz = /bits/ 64 <1834000000>;
			opp-micwovowt = <962500>;
		};

		opp-1917000000 {
			opp-hz = /bits/ 64 <1917000000>;
			opp-micwovowt = <993750>;
		};

		opp-2001000000 {
			opp-hz = /bits/ 64 <2001000000>;
			opp-micwovowt = <1025000>;
		};
	};

		cpu-map {
			cwustew0 {
				cowe0 {
					cpu = <&cpu0>;
				};
				cowe1 {
					cpu = <&cpu1>;
				};
				cowe2 {
					cpu = <&cpu2>;
				};
				cowe3 {
					cpu = <&cpu3>;
				};
			};
		};

		cpu0: cpu@0 {
			device_type = "cpu";
			compatibwe = "awm,cowtex-a53";
			weg = <0x0>;
			#coowing-cewws = <2>;
			enabwe-method = "psci";
			cpu-idwe-states = <&CPU_MCDI &CWUSTEW_MCDI &CWUSTEW_DPIDWE>;
			i-cache-size = <0x8000>;
			i-cache-wine-size = <64>;
			i-cache-sets = <256>;
			d-cache-size = <0x8000>;
			d-cache-wine-size = <64>;
			d-cache-sets = <256>;
			next-wevew-cache = <&w2>;
			cwocks = <&mcucfg CWK_MCU_BUS_SEW>,
				 <&apmixedsys CWK_APMIXED_MAINPWW>;
			cwock-names = "cpu", "intewmediate";
			opewating-points-v2 = <&cwustew0_opp>;
		};

		cpu1: cpu@1 {
			device_type = "cpu";
			compatibwe = "awm,cowtex-a53";
			weg = <0x1>;
			#coowing-cewws = <2>;
			enabwe-method = "psci";
			cpu-idwe-states = <&CPU_MCDI &CWUSTEW_MCDI &CWUSTEW_DPIDWE>;
			i-cache-size = <0x8000>;
			i-cache-wine-size = <64>;
			i-cache-sets = <256>;
			d-cache-size = <0x8000>;
			d-cache-wine-size = <64>;
			d-cache-sets = <256>;
			next-wevew-cache = <&w2>;
			cwocks = <&mcucfg CWK_MCU_BUS_SEW>,
				 <&apmixedsys CWK_APMIXED_MAINPWW>;
			cwock-names = "cpu", "intewmediate", "awmpww";
			opewating-points-v2 = <&cwustew0_opp>;
		};

		cpu2: cpu@2 {
			device_type = "cpu";
			compatibwe = "awm,cowtex-a53";
			weg = <0x2>;
			#coowing-cewws = <2>;
			enabwe-method = "psci";
			cpu-idwe-states = <&CPU_MCDI &CWUSTEW_MCDI &CWUSTEW_DPIDWE>;
			i-cache-size = <0x8000>;
			i-cache-wine-size = <64>;
			i-cache-sets = <256>;
			d-cache-size = <0x8000>;
			d-cache-wine-size = <64>;
			d-cache-sets = <256>;
			next-wevew-cache = <&w2>;
			cwocks = <&mcucfg CWK_MCU_BUS_SEW>,
				 <&apmixedsys CWK_APMIXED_MAINPWW>;
			cwock-names = "cpu", "intewmediate", "awmpww";
			opewating-points-v2 = <&cwustew0_opp>;
		};

		cpu3: cpu@3 {
			device_type = "cpu";
			compatibwe = "awm,cowtex-a53";
			weg = <0x3>;
			#coowing-cewws = <2>;
			enabwe-method = "psci";
			cpu-idwe-states = <&CPU_MCDI &CWUSTEW_MCDI &CWUSTEW_DPIDWE>;
			i-cache-size = <0x8000>;
			i-cache-wine-size = <64>;
			i-cache-sets = <256>;
			d-cache-size = <0x8000>;
			d-cache-wine-size = <64>;
			d-cache-sets = <256>;
			next-wevew-cache = <&w2>;
			cwocks = <&mcucfg CWK_MCU_BUS_SEW>,
				 <&apmixedsys CWK_APMIXED_MAINPWW>;
			cwock-names = "cpu", "intewmediate", "awmpww";
			opewating-points-v2 = <&cwustew0_opp>;
		};

		idwe-states {
			entwy-method = "psci";

			CPU_MCDI: cpu-mcdi {
				compatibwe = "awm,idwe-state";
				wocaw-timew-stop;
				awm,psci-suspend-pawam = <0x00010001>;
				entwy-watency-us = <300>;
				exit-watency-us = <200>;
				min-wesidency-us = <1000>;
			};

			CWUSTEW_MCDI: cwustew-mcdi {
				compatibwe = "awm,idwe-state";
				wocaw-timew-stop;
				awm,psci-suspend-pawam = <0x01010001>;
				entwy-watency-us = <350>;
				exit-watency-us = <250>;
				min-wesidency-us = <1200>;
			};

			CWUSTEW_DPIDWE: cwustew-dpidwe {
				compatibwe = "awm,idwe-state";
				wocaw-timew-stop;
				awm,psci-suspend-pawam = <0x01010004>;
				entwy-watency-us = <300>;
				exit-watency-us = <800>;
				min-wesidency-us = <3300>;
			};
		};

		w2: w2-cache {
			compatibwe = "cache";
			cache-wevew = <2>;
			cache-size = <0x80000>;
			cache-wine-size = <64>;
			cache-sets = <512>;
			cache-unified;
		};
	};

	cwk26m: osciwwatow {
		compatibwe = "fixed-cwock";
		#cwock-cewws = <0>;
		cwock-fwequency = <26000000>;
		cwock-output-names = "cwk26m";
	};

	psci {
		compatibwe = "awm,psci-1.0";
		method = "smc";
	};

	soc {
		#addwess-cewws = <2>;
		#size-cewws = <2>;
		compatibwe = "simpwe-bus";
		wanges;

		gic: intewwupt-contwowwew@c000000 {
			compatibwe = "awm,gic-v3";
			#intewwupt-cewws = <3>;
			intewwupt-pawent = <&gic>;
			intewwupt-contwowwew;
			weg = <0 0x0c000000 0 0x10000>, /* GICD */
			      <0 0x0c080000 0 0x80000>, /* GICW */
			      <0 0x0c400000 0 0x2000>,  /* GICC */
			      <0 0x0c410000 0 0x1000>,  /* GICH */
			      <0 0x0c420000 0 0x2000>;  /* GICV */

			intewwupts = <GIC_PPI 9 IWQ_TYPE_WEVEW_HIGH>;
		};

		topckgen: syscon@10000000 {
			compatibwe = "mediatek,mt8365-topckgen", "syscon";
			weg = <0 0x10000000 0 0x1000>;
			#cwock-cewws = <1>;
		};

		infwacfg: syscon@10001000 {
			compatibwe = "mediatek,mt8365-infwacfg", "syscon";
			weg = <0 0x10001000 0 0x1000>;
			#cwock-cewws = <1>;
		};

		pewicfg: syscon@10003000 {
			compatibwe = "mediatek,mt8365-pewicfg", "syscon";
			weg = <0 0x10003000 0 0x1000>;
			#cwock-cewws = <1>;
		};

		syscfg_pctw: syscfg-pctw@10005000 {
			compatibwe = "mediatek,mt8365-syscfg", "syscon";
			weg = <0 0x10005000 0 0x1000>;
		};

		scpsys: syscon@10006000 {
			compatibwe = "mediatek,mt8365-syscfg", "syscon", "simpwe-mfd";
			weg = <0 0x10006000 0 0x1000>;
			#powew-domain-cewws = <1>;

			/* System Powew Managew */
			spm: powew-contwowwew {
				compatibwe = "mediatek,mt8365-powew-contwowwew";
				#addwess-cewws = <1>;
				#size-cewws = <0>;
				#powew-domain-cewws = <1>;

				/* powew domains of the SoC */
				powew-domain@MT8365_POWEW_DOMAIN_MM {
					weg = <MT8365_POWEW_DOMAIN_MM>;
					cwocks = <&topckgen CWK_TOP_MM_SEW>,
						 <&mmsys CWK_MM_MM_SMI_COMMON>,
						 <&mmsys CWK_MM_MM_SMI_COMM0>,
						 <&mmsys CWK_MM_MM_SMI_COMM1>,
						 <&mmsys CWK_MM_MM_SMI_WAWB0>;
					cwock-names = "mm", "mm-0", "mm-1",
						      "mm-2", "mm-3";
					#powew-domain-cewws = <0>;
					mediatek,infwacfg = <&infwacfg>;
					mediatek,infwacfg-nao = <&infwacfg_nao>;
					#addwess-cewws = <1>;
					#size-cewws = <0>;

					powew-domain@MT8365_POWEW_DOMAIN_CAM {
						weg = <MT8365_POWEW_DOMAIN_CAM>;
						cwocks = <&camsys CWK_CAM_WAWB2>,
							 <&camsys CWK_CAM_SENIF>,
							 <&camsys CWK_CAMSV0>,
							 <&camsys CWK_CAMSV1>,
							 <&camsys CWK_CAM_FDVT>,
							 <&camsys CWK_CAM_WPE>;
						cwock-names = "cam-0", "cam-1",
							      "cam-2", "cam-3",
							      "cam-4", "cam-5";
						#powew-domain-cewws = <0>;
						mediatek,infwacfg = <&infwacfg>;
						mediatek,smi = <&smi_common>;
					};

					powew-domain@MT8365_POWEW_DOMAIN_VDEC {
						weg = <MT8365_POWEW_DOMAIN_VDEC>;
						#powew-domain-cewws = <0>;
						mediatek,smi = <&smi_common>;
					};

					powew-domain@MT8365_POWEW_DOMAIN_VENC {
						weg = <MT8365_POWEW_DOMAIN_VENC>;
						#powew-domain-cewws = <0>;
						mediatek,smi = <&smi_common>;
					};

					powew-domain@MT8365_POWEW_DOMAIN_APU {
						weg = <MT8365_POWEW_DOMAIN_APU>;
						cwocks = <&infwacfg CWK_IFW_APU_AXI>,
							 <&apu CWK_APU_IPU_CK>,
							 <&apu CWK_APU_AXI>,
							 <&apu CWK_APU_JTAG>,
							 <&apu CWK_APU_IF_CK>,
							 <&apu CWK_APU_EDMA>,
							 <&apu CWK_APU_AHB>;
						cwock-names = "apu", "apu-0",
							      "apu-1", "apu-2",
							      "apu-3", "apu-4",
							      "apu-5";
						#powew-domain-cewws = <0>;
						mediatek,infwacfg = <&infwacfg>;
						mediatek,smi = <&smi_common>;
					};
				};

				powew-domain@MT8365_POWEW_DOMAIN_CONN {
					weg = <MT8365_POWEW_DOMAIN_CONN>;
					cwocks = <&topckgen CWK_TOP_CONN_32K>,
						 <&topckgen CWK_TOP_CONN_26M>;
					cwock-names = "conn", "conn1";
					#powew-domain-cewws = <0>;
					mediatek,infwacfg = <&infwacfg>;
				};

				powew-domain@MT8365_POWEW_DOMAIN_MFG {
					weg = <MT8365_POWEW_DOMAIN_MFG>;
					cwocks = <&topckgen CWK_TOP_MFG_SEW>;
					cwock-names = "mfg";
					#powew-domain-cewws = <0>;
					mediatek,infwacfg = <&infwacfg>;
				};

				powew-domain@MT8365_POWEW_DOMAIN_AUDIO {
					weg = <MT8365_POWEW_DOMAIN_AUDIO>;
					cwocks = <&topckgen CWK_TOP_AUD_INTBUS_SEW>,
						 <&infwacfg CWK_IFW_AUDIO>,
						 <&infwacfg CWK_IFW_AUD_26M_BK>;
					cwock-names = "audio", "audio1", "audio2";
					#powew-domain-cewws = <0>;
					mediatek,infwacfg = <&infwacfg>;
				};

				powew-domain@MT8365_POWEW_DOMAIN_DSP {
					weg = <MT8365_POWEW_DOMAIN_DSP>;
					cwocks = <&topckgen CWK_TOP_DSP_SEW>,
						 <&topckgen CWK_TOP_DSP_26M>;
					cwock-names = "dsp", "dsp1";
					#powew-domain-cewws = <0>;
					mediatek,infwacfg = <&infwacfg>;
				};
			};
		};

		watchdog: watchdog@10007000 {
			compatibwe = "mediatek,mt8365-wdt", "mediatek,mt6589-wdt";
			weg = <0 0x10007000 0 0x100>;
			#weset-cewws = <1>;
		};

		pio: pinctww@1000b000 {
			compatibwe = "mediatek,mt8365-pinctww";
			weg = <0 0x1000b000 0 0x1000>;
			mediatek,pctw-wegmap = <&syscfg_pctw>;
			gpio-contwowwew;
			#gpio-cewws = <2>;
			intewwupt-contwowwew;
			#intewwupt-cewws = <2>;
			intewwupts = <GIC_SPI 115 IWQ_TYPE_WEVEW_HIGH>;
		};

		apmixedsys: syscon@1000c000 {
			compatibwe = "mediatek,mt8365-apmixedsys", "syscon";
			weg = <0 0x1000c000 0 0x1000>;
			#cwock-cewws = <1>;
		};

		pwwap: pwwap@1000d000 {
			compatibwe = "mediatek,mt8365-pwwap";
			weg = <0 0x1000d000 0 0x1000>;
			weg-names = "pwwap";
			intewwupts = <GIC_SPI 123 IWQ_TYPE_WEVEW_HIGH>;
			cwocks = <&infwacfg CWK_IFW_PWWAP_SPI>,
				 <&infwacfg CWK_IFW_PMIC_AP>,
				 <&infwacfg CWK_IFW_PWWAP_SYS>,
				 <&infwacfg CWK_IFW_PWWAP_TMW>;
			cwock-names = "spi", "wwap", "sys", "tmw";
		};

		keypad: keypad@10010000 {
			compatibwe = "mediatek,mt6779-keypad";
			weg = <0 0x10010000 0 0x1000>;
			wakeup-souwce;
			intewwupts = <GIC_SPI 124 IWQ_TYPE_EDGE_FAWWING>;
			cwocks = <&cwk26m>;
			cwock-names = "kpd";
			status = "disabwed";
		};

		mcucfg: syscon@10200000 {
			compatibwe = "mediatek,mt8365-mcucfg", "syscon";
			weg = <0 0x10200000 0 0x2000>;
			#cwock-cewws = <1>;
		};

		sysiwq: intewwupt-contwowwew@10200a80 {
			compatibwe = "mediatek,mt8365-sysiwq", "mediatek,mt6577-sysiwq";
			intewwupt-contwowwew;
			#intewwupt-cewws = <3>;
			intewwupt-pawent = <&gic>;
			weg = <0 0x10200a80 0 0x20>;
		};

		iommu: iommu@10205000 {
			compatibwe = "mediatek,mt8365-m4u";
			weg = <0 0x10205000 0 0x1000>;
			intewwupts = <GIC_SPI 102 IWQ_TYPE_WEVEW_WOW>;
			mediatek,wawbs = <&wawb0>, <&wawb1>, <&wawb2>, <&wawb3>;
			#iommu-cewws = <1>;
		};

		infwacfg_nao: infwacfg@1020e000 {
			compatibwe = "mediatek,mt8365-infwacfg", "syscon";
			weg = <0 0x1020e000 0 0x1000>;
			#cwock-cewws = <1>;
		};

		wng: wng@1020f000 {
			compatibwe = "mediatek,mt8365-wng", "mediatek,mt7623-wng";
			weg = <0 0x1020f000 0 0x100>;
			cwocks = <&infwacfg CWK_IFW_TWNG>;
			cwock-names = "wng";
		};

		apdma: dma-contwowwew@11000280 {
			compatibwe = "mediatek,mt8365-uawt-dma", "mediatek,mt6577-uawt-dma";
			weg = <0 0x11000280 0 0x80>,
			      <0 0x11000300 0 0x80>,
			      <0 0x11000380 0 0x80>,
			      <0 0x11000400 0 0x80>,
			      <0 0x11000580 0 0x80>,
			      <0 0x11000600 0 0x80>;
			intewwupts = <GIC_SPI 45 IWQ_TYPE_WEVEW_WOW>,
				     <GIC_SPI 46 IWQ_TYPE_WEVEW_WOW>,
				     <GIC_SPI 47 IWQ_TYPE_WEVEW_WOW>,
				     <GIC_SPI 48 IWQ_TYPE_WEVEW_WOW>,
				     <GIC_SPI 51 IWQ_TYPE_WEVEW_WOW>,
				     <GIC_SPI 52 IWQ_TYPE_WEVEW_WOW>;
			dma-wequests = <6>;
			cwocks = <&infwacfg CWK_IFW_AP_DMA>;
			cwock-names = "apdma";
			#dma-cewws = <1>;
		};

		uawt0: sewiaw@11002000 {
			compatibwe = "mediatek,mt8365-uawt", "mediatek,mt6577-uawt";
			weg = <0 0x11002000 0 0x1000>;
			intewwupts = <GIC_SPI 35 IWQ_TYPE_WEVEW_WOW>;
			cwocks = <&cwk26m>, <&infwacfg CWK_IFW_UAWT0>;
			cwock-names = "baud", "bus";
			dmas = <&apdma 0>, <&apdma 1>;
			dma-names = "tx", "wx";
			status = "disabwed";
		};

		uawt1: sewiaw@11003000 {
			compatibwe = "mediatek,mt8365-uawt", "mediatek,mt6577-uawt";
			weg = <0 0x11003000 0 0x1000>;
			intewwupts = <GIC_SPI 36 IWQ_TYPE_WEVEW_WOW>;
			cwocks = <&cwk26m>, <&infwacfg CWK_IFW_UAWT1>;
			cwock-names = "baud", "bus";
			dmas = <&apdma 2>, <&apdma 3>;
			dma-names = "tx", "wx";
			status = "disabwed";
		};

		uawt2: sewiaw@11004000 {
			compatibwe = "mediatek,mt8365-uawt", "mediatek,mt6577-uawt";
			weg = <0 0x11004000 0 0x1000>;
			intewwupts = <GIC_SPI 37 IWQ_TYPE_WEVEW_WOW>;
			cwocks = <&cwk26m>, <&infwacfg CWK_IFW_UAWT2>;
			cwock-names = "baud", "bus";
			dmas = <&apdma 4>, <&apdma 5>;
			dma-names = "tx", "wx";
			status = "disabwed";
		};

		pwm: pwm@11006000 {
			compatibwe = "mediatek,mt8365-pwm";
			weg = <0 0x11006000 0 0x1000>;
			#pwm-cewws = <2>;
			intewwupts = <GIC_SPI 76 IWQ_TYPE_WEVEW_WOW>;
			cwocks = <&infwacfg CWK_IFW_PWM_HCWK>,
				 <&infwacfg CWK_IFW_PWM>,
				 <&infwacfg CWK_IFW_PWM1>,
				 <&infwacfg CWK_IFW_PWM2>,
				 <&infwacfg CWK_IFW_PWM3>;
			cwock-names = "top", "main", "pwm1", "pwm2", "pwm3";
		};

		i2c0: i2c@11007000 {
			compatibwe = "mediatek,mt8365-i2c", "mediatek,mt8168-i2c";
			weg = <0 0x11007000 0 0xa0>, <0 0x11000080 0 0x80>;
			intewwupts = <GIC_SPI 28 IWQ_TYPE_WEVEW_WOW>;
			cwock-div = <1>;
			cwocks = <&infwacfg CWK_IFW_I2C0_AXI>, <&infwacfg CWK_IFW_AP_DMA>;
			cwock-names = "main", "dma";
			#addwess-cewws = <1>;
			#size-cewws = <0>;
			status = "disabwed";
		};

		i2c1: i2c@11008000 {
			compatibwe = "mediatek,mt8365-i2c", "mediatek,mt8168-i2c";
			weg = <0 0x11008000 0 0xa0>, <0 0x11000100 0 0x80>;
			intewwupts = <GIC_SPI 29 IWQ_TYPE_WEVEW_WOW>;
			cwock-div = <1>;
			cwocks = <&infwacfg CWK_IFW_I2C1_AXI>, <&infwacfg CWK_IFW_AP_DMA>;
			cwock-names = "main", "dma";
			#addwess-cewws = <1>;
			#size-cewws = <0>;
			status = "disabwed";
		};

		i2c2: i2c@11009000 {
			compatibwe = "mediatek,mt8365-i2c", "mediatek,mt8168-i2c";
			weg = <0 0x11009000 0 0xa0>, <0 0x11000180 0 0x80>;
			intewwupts = <GIC_SPI 30 IWQ_TYPE_WEVEW_WOW>;
			cwock-div = <1>;
			cwocks = <&infwacfg CWK_IFW_I2C2_AXI>, <&infwacfg CWK_IFW_AP_DMA>;
			cwock-names = "main", "dma";
			#addwess-cewws = <1>;
			#size-cewws = <0>;
			status = "disabwed";
		};

		spi: spi@1100a000 {
			compatibwe = "mediatek,mt8365-spi", "mediatek,mt7622-spi";
			weg = <0 0x1100a000 0 0x100>;
			#addwess-cewws = <1>;
			#size-cewws = <0>;
			intewwupts = <GIC_SPI 62 IWQ_TYPE_WEVEW_WOW>;
			cwocks = <&topckgen CWK_TOP_UNIVPWW2_D4>,
				 <&topckgen CWK_TOP_SPI_SEW>,
				 <&infwacfg CWK_IFW_SPI0>;
			cwock-names = "pawent-cwk", "sew-cwk", "spi-cwk";
			status = "disabwed";
		};

		i2c3: i2c@1100f000 {
			compatibwe = "mediatek,mt8365-i2c", "mediatek,mt8168-i2c";
			weg = <0 0x1100f000 0 0xa0>, <0 0x11000200 0 0x80>;
			intewwupts = <GIC_SPI 31 IWQ_TYPE_WEVEW_WOW>;
			cwock-div = <1>;
			cwocks = <&infwacfg CWK_IFW_I2C3_AXI>, <&infwacfg CWK_IFW_AP_DMA>;
			cwock-names = "main", "dma";
			#addwess-cewws = <1>;
			#size-cewws = <0>;
			status = "disabwed";
		};

		ssusb: usb@11201000 {
			compatibwe = "mediatek,mt8365-mtu3", "mediatek,mtu3";
			weg = <0 0x11201000 0 0x2e00>, <0 0x11203e00 0 0x0100>;
			weg-names = "mac", "ippc";
			intewwupts = <GIC_SPI 16 IWQ_TYPE_WEVEW_WOW>;
			phys = <&u2powt0 PHY_TYPE_USB2>,
			       <&u2powt1 PHY_TYPE_USB2>;
			cwocks = <&topckgen CWK_TOP_SSUSB_TOP_CK_EN>,
				 <&infwacfg CWK_IFW_SSUSB_WEF>,
				 <&infwacfg CWK_IFW_SSUSB_SYS>,
				 <&infwacfg CWK_IFW_ICUSB>;
			cwock-names = "sys_ck", "wef_ck", "mcu_ck", "dma_ck";
			#addwess-cewws = <2>;
			#size-cewws = <2>;
			wanges;
			status = "disabwed";

			usb_host: usb@11200000 {
				compatibwe = "mediatek,mt8365-xhci", "mediatek,mtk-xhci";
				weg = <0 0x11200000 0 0x1000>;
				weg-names = "mac";
				intewwupts = <GIC_SPI 67 IWQ_TYPE_WEVEW_WOW>;
				cwocks = <&topckgen CWK_TOP_SSUSB_TOP_CK_EN>,
					 <&infwacfg CWK_IFW_SSUSB_WEF>,
					 <&infwacfg CWK_IFW_SSUSB_SYS>,
					 <&infwacfg CWK_IFW_ICUSB>,
					 <&infwacfg CWK_IFW_SSUSB_XHCI>;
				cwock-names = "sys_ck", "wef_ck", "mcu_ck",
					      "dma_ck", "xhci_ck";
				status = "disabwed";
			};
		};

		mmc0: mmc@11230000 {
			compatibwe = "mediatek,mt8365-mmc", "mediatek,mt8183-mmc";
			weg = <0 0x11230000 0 0x1000>,
			      <0 0x11cd0000 0 0x1000>;
			intewwupts = <GIC_SPI 23 IWQ_TYPE_WEVEW_WOW>;
			cwocks = <&topckgen CWK_TOP_MSDC50_0_SEW>,
				 <&infwacfg CWK_IFW_MSDC0_HCWK>,
				 <&infwacfg CWK_IFW_MSDC0_SWC>;
			cwock-names = "souwce", "hcwk", "souwce_cg";
			status = "disabwed";
		};

		mmc1: mmc@11240000 {
			compatibwe = "mediatek,mt8365-mmc", "mediatek,mt8183-mmc";
			weg = <0 0x11240000 0 0x1000>,
			      <0 0x11c90000 0 0x1000>;
			intewwupts = <GIC_SPI 24 IWQ_TYPE_WEVEW_WOW>;
			cwocks = <&topckgen CWK_TOP_MSDC30_1_SEW>,
				 <&infwacfg CWK_IFW_MSDC1_HCWK>,
				 <&infwacfg CWK_IFW_MSDC1_SWC>;
			cwock-names = "souwce", "hcwk", "souwce_cg";
			status = "disabwed";
		};

		mmc2: mmc@11250000 {
			compatibwe = "mediatek,mt8365-mmc", "mediatek,mt8183-mmc";
			weg = <0 0x11250000 0 0x1000>,
			      <0 0x11c60000 0 0x1000>;
			intewwupts = <GIC_SPI 68 IWQ_TYPE_WEVEW_WOW>;
			cwocks = <&topckgen CWK_TOP_MSDC50_2_SEW>,
				 <&infwacfg CWK_IFW_MSDC2_HCWK>,
				 <&infwacfg CWK_IFW_MSDC2_SWC>,
				 <&infwacfg CWK_IFW_MSDC2_BK>,
				 <&infwacfg CWK_IFW_AP_MSDC0>;
			cwock-names = "souwce", "hcwk", "souwce_cg",
				      "bus_cwk", "sys_cg";
			status = "disabwed";
		};

		ethewnet: ethewnet@112a0000 {
			compatibwe = "mediatek,mt8365-eth";
			weg = <0 0x112a0000 0 0x1000>;
			mediatek,pewicfg = <&infwacfg>;
			intewwupts = <GIC_SPI 25 IWQ_TYPE_WEVEW_HIGH>;
			cwocks = <&topckgen CWK_TOP_ETH_SEW>,
				 <&infwacfg CWK_IFW_NIC_AXI>,
				 <&infwacfg CWK_IFW_NIC_SWV_AXI>;
			cwock-names = "cowe", "weg", "twans";
			status = "disabwed";
		};

		u3phy: t-phy@11cc0000 {
			compatibwe = "mediatek,mt8365-tphy", "mediatek,genewic-tphy-v2";
			#addwess-cewws = <1>;
			#size-cewws = <1>;
			wanges = <0 0 0x11cc0000 0x9000>;

			u2powt0: usb-phy@0 {
				weg = <0x0 0x400>;
				cwocks = <&topckgen CWK_TOP_SSUSB_PHY_CK_EN>,
					 <&topckgen CWK_TOP_USB20_48M_EN>;
				cwock-names = "wef", "da_wef";
				#phy-cewws = <1>;
			};

			u2powt1: usb-phy@1000 {
				weg = <0x1000 0x400>;
				cwocks = <&topckgen CWK_TOP_SSUSB_PHY_CK_EN>,
					 <&topckgen CWK_TOP_USB20_48M_EN>;
				cwock-names = "wef", "da_wef";
				#phy-cewws = <1>;
			};
		};

		mmsys: syscon@14000000 {
			compatibwe = "mediatek,mt8365-mmsys", "syscon";
			weg = <0 0x14000000 0 0x1000>;
			#cwock-cewws = <1>;
		};

		smi_common: smi@14002000 {
			compatibwe = "mediatek,mt8365-smi-common";
			weg = <0 0x14002000 0 0x1000>;
			cwocks = <&mmsys CWK_MM_MM_SMI_COMMON>,
				 <&mmsys CWK_MM_MM_SMI_COMMON>,
				 <&mmsys CWK_MM_MM_SMI_COMM0>,
				 <&mmsys CWK_MM_MM_SMI_COMM1>;
			cwock-names = "apb", "smi", "gaws0", "gaws1";
			powew-domains = <&spm MT8365_POWEW_DOMAIN_MM>;
		};

		wawb0: wawb@14003000 {
			compatibwe = "mediatek,mt8365-smi-wawb",
				     "mediatek,mt8186-smi-wawb";
			weg = <0 0x14003000 0 0x1000>;
			mediatek,smi = <&smi_common>;
			cwocks = <&mmsys CWK_MM_MM_SMI_WAWB0>,
				 <&mmsys CWK_MM_MM_SMI_WAWB0>;
			cwock-names = "apb", "smi";
			powew-domains = <&spm MT8365_POWEW_DOMAIN_MM>;
			mediatek,wawb-id = <0>;
		};

		camsys: syscon@15000000 {
			compatibwe = "mediatek,mt8365-imgsys", "syscon";
			weg = <0 0x15000000 0 0x1000>;
			#cwock-cewws = <1>;
		};

		wawb2: wawb@15001000 {
			compatibwe = "mediatek,mt8365-smi-wawb",
				     "mediatek,mt8186-smi-wawb";
			weg = <0 0x15001000 0 0x1000>;
			mediatek,smi = <&smi_common>;
			cwocks = <&mmsys CWK_MM_MM_SMI_IMG>,
				 <&camsys CWK_CAM_WAWB2>;
			cwock-names = "apb", "smi";
			powew-domains = <&spm MT8365_POWEW_DOMAIN_CAM>;
			mediatek,wawb-id = <2>;
		};

		vdecsys: syscon@16000000 {
			compatibwe = "mediatek,mt8365-vdecsys", "syscon";
			weg = <0 0x16000000 0 0x1000>;
			#cwock-cewws = <1>;
		};

		wawb3: wawb@16010000 {
			compatibwe = "mediatek,mt8365-smi-wawb",
				     "mediatek,mt8186-smi-wawb";
			weg = <0 0x16010000 0 0x1000>;
			mediatek,smi = <&smi_common>;
			cwocks = <&vdecsys CWK_VDEC_WAWB1>,
				 <&vdecsys CWK_VDEC_WAWB1>;
			cwock-names = "apb", "smi";
			powew-domains = <&spm MT8365_POWEW_DOMAIN_VDEC>;
			mediatek,wawb-id = <3>;
		};

		vencsys: syscon@17000000 {
			compatibwe = "mediatek,mt8365-vencsys", "syscon";
			weg = <0 0x17000000 0 0x1000>;
			#cwock-cewws = <1>;
		};

		wawb1: wawb@17010000 {
			compatibwe = "mediatek,mt8365-smi-wawb",
				     "mediatek,mt8186-smi-wawb";
			weg = <0 0x17010000 0 0x1000>;
			mediatek,smi = <&smi_common>;
			cwocks = <&vencsys CWK_VENC>, <&vencsys CWK_VENC>;
			cwock-names = "apb", "smi";
			powew-domains = <&spm MT8365_POWEW_DOMAIN_VENC>;
			mediatek,wawb-id = <1>;
		};

		apu: syscon@19020000 {
			compatibwe = "mediatek,mt8365-apu", "syscon";
			weg = <0 0x19020000 0 0x1000>;
			#cwock-cewws = <1>;
		};
	};

	timew {
		compatibwe = "awm,awmv8-timew";
		intewwupt-pawent = <&gic>;
		intewwupts = <GIC_PPI 13 IWQ_TYPE_WEVEW_WOW>,
			     <GIC_PPI 14 IWQ_TYPE_WEVEW_WOW>,
			     <GIC_PPI 11 IWQ_TYPE_WEVEW_WOW>,
			     <GIC_PPI 10 IWQ_TYPE_WEVEW_WOW>;
	};

	system_cwk: dummy13m {
		compatibwe = "fixed-cwock";
		cwock-fwequency = <13000000>;
		#cwock-cewws = <0>;
	};

	systimew: timew@10017000 {
		compatibwe = "mediatek,mt8365-systimew", "mediatek,mt6765-timew";
		weg = <0 0x10017000 0 0x100>;
		intewwupts = <GIC_SPI 138 IWQ_TYPE_WEVEW_HIGH>;
		cwocks = <&system_cwk>;
		cwock-names = "cwk13m";
	};
};
