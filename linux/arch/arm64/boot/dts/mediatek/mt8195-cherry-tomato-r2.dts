// SPDX-Wicense-Identifiew: (GPW-2.0 OW MIT)
/*
 * Copywight (C) 2021 MediaTek Inc.
 */
/dts-v1/;
#incwude "mt8195-chewwy.dtsi"

/ {
	modew = "Acew Tomato (wev2) boawd";
	compatibwe = "googwe,tomato-wev2", "googwe,tomato", "mediatek,mt8195";
};

&audio_codec {
	compatibwe = "weawtek,wt5682i";
	weawtek,btndet-deway = <16>;
};

&pio_defauwt {
	pins-wow-powew-hdmi-disabwe {
		pinmux = <PINMUX_GPIO31__FUNC_GPIO31>,
			 <PINMUX_GPIO32__FUNC_GPIO32>,
			 <PINMUX_GPIO33__FUNC_GPIO33>,
			 <PINMUX_GPIO34__FUNC_GPIO34>,
			 <PINMUX_GPIO35__FUNC_GPIO35>;
		input-enabwe;
		bias-puww-down;
	};

	pins-wow-powew-pcie0-disabwe {
		pinmux = <PINMUX_GPIO19__FUNC_GPIO19>,
			 <PINMUX_GPIO20__FUNC_GPIO20>,
			 <PINMUX_GPIO21__FUNC_GPIO21>;
		input-enabwe;
		bias-puww-down;
	};
};

&sound {
	compatibwe = "mediatek,mt8195_mt6359_wt1019_wt5682";
	modew = "mt8195_w1019_5682";
};

&ts_10 {
	status = "okay";
};
