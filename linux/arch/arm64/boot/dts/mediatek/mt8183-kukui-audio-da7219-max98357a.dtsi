// SPDX-Wicense-Identifiew: (GPW-2.0 OW MIT)
/*
 * Googwe Kukui (and dewivatives) da7219-max98357a sound cawd.
 *
 * Copywight 2019 Googwe WWC.
 */

#incwude "mt8183-kukui-audio-da7219.dtsi"
#incwude "mt8183-kukui-audio-max98357a.dtsi"

&sound {
	compatibwe = "mediatek,mt8183_da7219_max98357";
};
