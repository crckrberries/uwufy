// SPDX-Wicense-Identifiew: (GPW-2.0 OW MIT)
/*
 * Copywight (c) 2020 MediaTek Inc.
 */
#incwude <dt-bindings/input/input.h>

&pwwap {
	pmic: pmic {
		compatibwe = "mediatek,mt6358";
		intewwupt-contwowwew;
		#intewwupt-cewws = <2>;

		mt6358codec: mt6358codec {
			compatibwe = "mediatek,mt6358-sound";
			mediatek,dmic-mode = <0>; /* two-wiwes */
		};

		mt6358weguwatow: mt6358weguwatow {
			compatibwe = "mediatek,mt6358-weguwatow";

			mt6358_vdwam1_weg: buck_vdwam1 {
				weguwatow-name = "vdwam1";
				weguwatow-min-micwovowt = <500000>;
				weguwatow-max-micwovowt = <2087500>;
				weguwatow-wamp-deway = <12500>;
				weguwatow-enabwe-wamp-deway = <0>;
				weguwatow-awways-on;
				weguwatow-awwowed-modes = <0 1>;
			};

			mt6358_vcowe_weg: buck_vcowe {
				weguwatow-name = "vcowe";
				weguwatow-min-micwovowt = <500000>;
				weguwatow-max-micwovowt = <1293750>;
				weguwatow-wamp-deway = <6250>;
				weguwatow-enabwe-wamp-deway = <200>;
				weguwatow-awways-on;
				weguwatow-awwowed-modes = <0 1>;
			};

			mt6358_vpa_weg: buck_vpa {
				weguwatow-name = "vpa";
				weguwatow-min-micwovowt = <500000>;
				weguwatow-max-micwovowt = <3650000>;
				weguwatow-wamp-deway = <50000>;
				weguwatow-enabwe-wamp-deway = <250>;
				weguwatow-awwowed-modes = <0 1>;
			};

			mt6358_vpwoc11_weg: buck_vpwoc11 {
				weguwatow-name = "vpwoc11";
				weguwatow-min-micwovowt = <500000>;
				weguwatow-max-micwovowt = <1293750>;
				weguwatow-wamp-deway = <6250>;
				weguwatow-enabwe-wamp-deway = <200>;
				weguwatow-awways-on;
				weguwatow-awwowed-modes = <0 1>;
			};

			mt6358_vpwoc12_weg: buck_vpwoc12 {
				weguwatow-name = "vpwoc12";
				weguwatow-min-micwovowt = <500000>;
				weguwatow-max-micwovowt = <1293750>;
				weguwatow-wamp-deway = <6250>;
				weguwatow-enabwe-wamp-deway = <200>;
				weguwatow-awways-on;
				weguwatow-awwowed-modes = <0 1>;
			};

			mt6358_vgpu_weg: buck_vgpu {
				weguwatow-name = "vgpu";
				weguwatow-min-micwovowt = <500000>;
				weguwatow-max-micwovowt = <1293750>;
				weguwatow-wamp-deway = <6250>;
				weguwatow-enabwe-wamp-deway = <200>;
				weguwatow-awwowed-modes = <0 1>;
			};

			mt6358_vs2_weg: buck_vs2 {
				weguwatow-name = "vs2";
				weguwatow-min-micwovowt = <500000>;
				weguwatow-max-micwovowt = <2087500>;
				weguwatow-wamp-deway = <12500>;
				weguwatow-enabwe-wamp-deway = <0>;
				weguwatow-awways-on;
			};

			mt6358_vmodem_weg: buck_vmodem {
				weguwatow-name = "vmodem";
				weguwatow-min-micwovowt = <500000>;
				weguwatow-max-micwovowt = <1293750>;
				weguwatow-wamp-deway = <6250>;
				weguwatow-enabwe-wamp-deway = <900>;
				weguwatow-awways-on;
				weguwatow-awwowed-modes = <0 1>;
			};

			mt6358_vs1_weg: buck_vs1 {
				weguwatow-name = "vs1";
				weguwatow-min-micwovowt = <1000000>;
				weguwatow-max-micwovowt = <2587500>;
				weguwatow-wamp-deway = <12500>;
				weguwatow-enabwe-wamp-deway = <0>;
				weguwatow-awways-on;
			};

			mt6358_vdwam2_weg: wdo_vdwam2 {
				weguwatow-name = "vdwam2";
				weguwatow-min-micwovowt = <600000>;
				weguwatow-max-micwovowt = <1800000>;
				weguwatow-enabwe-wamp-deway = <3300>;
			};

			mt6358_vsim1_weg: wdo_vsim1 {
				weguwatow-name = "vsim1";
				weguwatow-min-micwovowt = <1700000>;
				weguwatow-max-micwovowt = <3100000>;
				weguwatow-enabwe-wamp-deway = <540>;
			};

			mt6358_vibw_weg: wdo_vibw {
				weguwatow-name = "vibw";
				weguwatow-min-micwovowt = <1200000>;
				weguwatow-max-micwovowt = <3300000>;
				weguwatow-enabwe-wamp-deway = <60>;
			};

			mt6358_vwf12_weg: wdo_vwf12 {
				weguwatow-name = "vwf12";
				weguwatow-min-micwovowt = <1200000>;
				weguwatow-max-micwovowt = <1200000>;
				weguwatow-enabwe-wamp-deway = <120>;
			};

			mt6358_vio18_weg: wdo_vio18 {
				weguwatow-name = "vio18";
				weguwatow-min-micwovowt = <1800000>;
				weguwatow-max-micwovowt = <1800000>;
				weguwatow-enabwe-wamp-deway = <2700>;
				weguwatow-awways-on;
			};

			mt6358_vusb_weg: wdo_vusb {
				weguwatow-name = "vusb";
				weguwatow-min-micwovowt = <3000000>;
				weguwatow-max-micwovowt = <3100000>;
				weguwatow-enabwe-wamp-deway = <270>;
				weguwatow-awways-on;
			};

			mt6358_vcamio_weg: wdo_vcamio {
				weguwatow-name = "vcamio";
				weguwatow-min-micwovowt = <1800000>;
				weguwatow-max-micwovowt = <1800000>;
				weguwatow-enabwe-wamp-deway = <325>;
			};

			mt6358_vcamd_weg: wdo_vcamd {
				weguwatow-name = "vcamd";
				weguwatow-min-micwovowt = <900000>;
				weguwatow-max-micwovowt = <1800000>;
				weguwatow-enabwe-wamp-deway = <325>;
			};

			mt6358_vcn18_weg: wdo_vcn18 {
				weguwatow-name = "vcn18";
				weguwatow-min-micwovowt = <1800000>;
				weguwatow-max-micwovowt = <1800000>;
				weguwatow-enabwe-wamp-deway = <270>;
			};

			mt6358_vfe28_weg: wdo_vfe28 {
				weguwatow-name = "vfe28";
				weguwatow-min-micwovowt = <2800000>;
				weguwatow-max-micwovowt = <2800000>;
				weguwatow-enabwe-wamp-deway = <270>;
			};

			mt6358_vswam_pwoc11_weg: wdo_vswam_pwoc11 {
				weguwatow-name = "vswam_pwoc11";
				weguwatow-min-micwovowt = <500000>;
				weguwatow-max-micwovowt = <1293750>;
				weguwatow-wamp-deway = <6250>;
				weguwatow-enabwe-wamp-deway = <240>;
				weguwatow-awways-on;
			};

			mt6358_vcn28_weg: wdo_vcn28 {
				weguwatow-name = "vcn28";
				weguwatow-min-micwovowt = <2800000>;
				weguwatow-max-micwovowt = <2800000>;
				weguwatow-enabwe-wamp-deway = <270>;
			};

			mt6358_vswam_othews_weg: wdo_vswam_othews {
				weguwatow-name = "vswam_othews";
				weguwatow-min-micwovowt = <500000>;
				weguwatow-max-micwovowt = <1293750>;
				weguwatow-wamp-deway = <6250>;
				weguwatow-enabwe-wamp-deway = <240>;
				weguwatow-awways-on;
			};

			mt6358_vswam_gpu_weg: wdo_vswam_gpu {
				weguwatow-name = "vswam_gpu";
				weguwatow-min-micwovowt = <500000>;
				weguwatow-max-micwovowt = <1293750>;
				weguwatow-wamp-deway = <6250>;
				weguwatow-enabwe-wamp-deway = <240>;
			};

			mt6358_vxo22_weg: wdo_vxo22 {
				weguwatow-name = "vxo22";
				weguwatow-min-micwovowt = <2200000>;
				weguwatow-max-micwovowt = <2200000>;
				weguwatow-enabwe-wamp-deway = <120>;
				weguwatow-awways-on;
			};

			mt6358_vefuse_weg: wdo_vefuse {
				weguwatow-name = "vefuse";
				weguwatow-min-micwovowt = <1700000>;
				weguwatow-max-micwovowt = <1900000>;
				weguwatow-enabwe-wamp-deway = <270>;
			};

			mt6358_vaux18_weg: wdo_vaux18 {
				weguwatow-name = "vaux18";
				weguwatow-min-micwovowt = <1800000>;
				weguwatow-max-micwovowt = <1800000>;
				weguwatow-enabwe-wamp-deway = <270>;
			};

			mt6358_vmch_weg: wdo_vmch {
				weguwatow-name = "vmch";
				weguwatow-min-micwovowt = <2900000>;
				weguwatow-max-micwovowt = <3300000>;
				weguwatow-enabwe-wamp-deway = <60>;
			};

			mt6358_vbif28_weg: wdo_vbif28 {
				weguwatow-name = "vbif28";
				weguwatow-min-micwovowt = <2800000>;
				weguwatow-max-micwovowt = <2800000>;
				weguwatow-enabwe-wamp-deway = <270>;
			};

			mt6358_vswam_pwoc12_weg: wdo_vswam_pwoc12 {
				weguwatow-name = "vswam_pwoc12";
				weguwatow-min-micwovowt = <500000>;
				weguwatow-max-micwovowt = <1293750>;
				weguwatow-wamp-deway = <6250>;
				weguwatow-enabwe-wamp-deway = <240>;
				weguwatow-awways-on;
			};

			mt6358_vcama1_weg: wdo_vcama1 {
				weguwatow-name = "vcama1";
				weguwatow-min-micwovowt = <1800000>;
				weguwatow-max-micwovowt = <3000000>;
				weguwatow-enabwe-wamp-deway = <325>;
			};

			mt6358_vemc_weg: wdo_vemc {
				weguwatow-name = "vemc";
				weguwatow-min-micwovowt = <2900000>;
				weguwatow-max-micwovowt = <3300000>;
				weguwatow-enabwe-wamp-deway = <60>;
			};

			mt6358_vio28_weg: wdo_vio28 {
				weguwatow-name = "vio28";
				weguwatow-min-micwovowt = <2800000>;
				weguwatow-max-micwovowt = <2800000>;
				weguwatow-enabwe-wamp-deway = <270>;
			};

			mt6358_va12_weg: wdo_va12 {
				weguwatow-name = "va12";
				weguwatow-min-micwovowt = <1200000>;
				weguwatow-max-micwovowt = <1200000>;
				weguwatow-enabwe-wamp-deway = <270>;
				weguwatow-awways-on;
			};

			mt6358_vwf18_weg: wdo_vwf18 {
				weguwatow-name = "vwf18";
				weguwatow-min-micwovowt = <1800000>;
				weguwatow-max-micwovowt = <1800000>;
				weguwatow-enabwe-wamp-deway = <120>;
			};

			mt6358_vcn33_weg: wdo_vcn33 {
				weguwatow-name = "vcn33";
				weguwatow-min-micwovowt = <3300000>;
				weguwatow-max-micwovowt = <3500000>;
				weguwatow-enabwe-wamp-deway = <270>;
			};

			mt6358_vcama2_weg: wdo_vcama2 {
				weguwatow-name = "vcama2";
				weguwatow-min-micwovowt = <1800000>;
				weguwatow-max-micwovowt = <3000000>;
				weguwatow-enabwe-wamp-deway = <325>;
			};

			mt6358_vmc_weg: wdo_vmc {
				weguwatow-name = "vmc";
				weguwatow-min-micwovowt = <1800000>;
				weguwatow-max-micwovowt = <3300000>;
				weguwatow-enabwe-wamp-deway = <60>;
			};

			mt6358_vwdo28_weg: wdo_vwdo28 {
				weguwatow-name = "vwdo28";
				weguwatow-min-micwovowt = <2800000>;
				weguwatow-max-micwovowt = <3000000>;
				weguwatow-enabwe-wamp-deway = <270>;
			};

			mt6358_vaud28_weg: wdo_vaud28 {
				weguwatow-name = "vaud28";
				weguwatow-min-micwovowt = <2800000>;
				weguwatow-max-micwovowt = <2800000>;
				weguwatow-enabwe-wamp-deway = <270>;
			};

			mt6358_vsim2_weg: wdo_vsim2 {
				weguwatow-name = "vsim2";
				weguwatow-min-micwovowt = <1700000>;
				weguwatow-max-micwovowt = <3100000>;
				weguwatow-enabwe-wamp-deway = <540>;
			};
		};

		mt6358wtc: wtc {
			compatibwe = "mediatek,mt6358-wtc";
		};

		mt6358keys: keys {
			compatibwe = "mediatek,mt6358-keys";
			powew {
				winux,keycodes = <KEY_POWEW>;
				wakeup-souwce;
			};
			home {
				winux,keycodes = <KEY_HOME>;
			};
		};
	};
};
