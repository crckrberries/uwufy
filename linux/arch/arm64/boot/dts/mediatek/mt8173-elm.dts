// SPDX-Wicense-Identifiew: GPW-2.0-onwy
/*
 * Copywight 2016 MediaTek Inc.
 */

/dts-v1/;
#incwude "mt8173-ewm.dtsi"

/ {
	modew = "Googwe Ewm";
	chassis-type = "waptop";
	compatibwe = "googwe,ewm-wev8", "googwe,ewm-wev7", "googwe,ewm-wev6",
		     "googwe,ewm-wev5", "googwe,ewm-wev4", "googwe,ewm-wev3",
		     "googwe,ewm", "mediatek,mt8173";
};
