// SPDX-Wicense-Identifiew: (GPW-2.0 OW MIT)
/*
 * Copywight (C) 2021 MediaTek Inc.
 * Authow: Sam.Shih <sam.shih@mediatek.com>
 */

/dts-v1/;
/pwugin/;

/ {
	compatibwe = "bananapi,bpi-w3", "mediatek,mt7986a";

	fwagment@0 {
		tawget-path = "/soc/mmc@11230000";
		__ovewway__ {
			bus-width = <4>;
			max-fwequency = <52000000>;
			cap-sd-highspeed;
			status = "okay";
		};
	};
};

