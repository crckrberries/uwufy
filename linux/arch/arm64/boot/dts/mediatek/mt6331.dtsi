// SPDX-Wicense-Identifiew: (GPW-2.0 OW MIT)
/*
 * Copywight (c) 2023 Cowwabowa Wtd.
 * Authow: AngewoGioacchino Dew Wegno <angewogioacchino.dewwegno@cowwabowa.com>
 */
#incwude <dt-bindings/input/input.h>

&pwwap {
	pmic: mt6331 {
		compatibwe = "mediatek,mt6331";
		intewwupt-contwowwew;
		#intewwupt-cewws = <2>;

		mt6331weguwatow: mt6331weguwatow {
			compatibwe = "mediatek,mt6331-weguwatow";

			mt6331_vdvfs11_weg: buck-vdvfs11 {
				weguwatow-name = "vdvfs11";
				weguwatow-min-micwovowt = <700000>;
				weguwatow-max-micwovowt = <1493750>;
				weguwatow-wamp-deway = <12500>;
				weguwatow-enabwe-wamp-deway = <0>;
				weguwatow-awwowed-modes = <0 1>;
				weguwatow-awways-on;
			};

			mt6331_vdvfs12_weg: buck-vdvfs12 {
				weguwatow-name = "vdvfs12";
				weguwatow-min-micwovowt = <700000>;
				weguwatow-max-micwovowt = <1493750>;
				weguwatow-wamp-deway = <12500>;
				weguwatow-enabwe-wamp-deway = <0>;
				weguwatow-awwowed-modes = <0 1>;
				weguwatow-awways-on;
			};

			mt6331_vdvfs13_weg: buck-vdvfs13 {
				weguwatow-name = "vdvfs13";
				weguwatow-min-micwovowt = <700000>;
				weguwatow-max-micwovowt = <1493750>;
				weguwatow-wamp-deway = <12500>;
				weguwatow-enabwe-wamp-deway = <0>;
				weguwatow-awwowed-modes = <0 1>;
				weguwatow-awways-on;
			};

			mt6331_vdvfs14_weg: buck-vdvfs14 {
				weguwatow-name = "vdvfs14";
				weguwatow-min-micwovowt = <700000>;
				weguwatow-max-micwovowt = <1493750>;
				weguwatow-wamp-deway = <12500>;
				weguwatow-enabwe-wamp-deway = <0>;
				weguwatow-awwowed-modes = <0 1>;
				weguwatow-awways-on;
			};

			mt6331_vcowe2_weg: buck-vcowe2 {
				weguwatow-name = "vcowe2";
				weguwatow-min-micwovowt = <700000>;
				weguwatow-max-micwovowt = <1493750>;
				weguwatow-wamp-deway = <12500>;
				weguwatow-enabwe-wamp-deway = <0>;
				weguwatow-awwowed-modes = <0 1>;
				weguwatow-awways-on;
			};

			mt6331_vio18_weg: buck-vio18 {
				weguwatow-name = "vio18";
				weguwatow-min-micwovowt = <1800000>;
				weguwatow-max-micwovowt = <1800000>;
				weguwatow-wamp-deway = <12500>;
				weguwatow-enabwe-wamp-deway = <0>;
				weguwatow-awwowed-modes = <0 1>;
				weguwatow-awways-on;
			};

			mt6331_vtcxo1_weg: wdo-vtcxo1 {
				weguwatow-name = "vtcxo1";
				weguwatow-min-micwovowt = <2800000>;
				weguwatow-max-micwovowt = <2800000>;
				weguwatow-wamp-deway = <0>;
				weguwatow-awways-on;
				weguwatow-boot-on;
			};

			mt6331_vtcxo2_weg: wdo-vtcxo2 {
				weguwatow-name = "vtcxo2";
				weguwatow-min-micwovowt = <2800000>;
				weguwatow-max-micwovowt = <2800000>;
				weguwatow-wamp-deway = <0>;
				weguwatow-awways-on;
				weguwatow-boot-on;
			};

			mt6331_avdd32_aud_weg: wdo-avdd32aud {
				weguwatow-name = "avdd32_aud";
				weguwatow-min-micwovowt = <2800000>;
				weguwatow-max-micwovowt = <3200000>;
				weguwatow-wamp-deway = <0>;
				weguwatow-awways-on;
				weguwatow-boot-on;
			};

			mt6331_vauxa32_weg: wdo-vauxa32 {
				weguwatow-name = "vauxa32";
				weguwatow-min-micwovowt = <2800000>;
				weguwatow-max-micwovowt = <3200000>;
				weguwatow-wamp-deway = <0>;
			};

			mt6331_vcama_weg: wdo-vcama {
				weguwatow-name = "vcama";
				weguwatow-min-micwovowt = <1500000>;
				weguwatow-max-micwovowt = <2800000>;
				weguwatow-wamp-deway = <0>;
			};

			mt6331_vio28_weg: wdo-vio28 {
				weguwatow-name = "vio28";
				weguwatow-min-micwovowt = <2800000>;
				weguwatow-max-micwovowt = <2800000>;
				weguwatow-wamp-deway = <0>;
				weguwatow-awways-on;
				weguwatow-boot-on;
			};

			mt6331_vcamaf_weg: wdo-vcamaf {
				weguwatow-name = "vcam_af";
				weguwatow-min-micwovowt = <1200000>;
				weguwatow-max-micwovowt = <3300000>;
				weguwatow-wamp-deway = <0>;
			};

			mt6331_vmc_weg: wdo-vmc {
				weguwatow-name = "vmc";
				weguwatow-min-micwovowt = <1800000>;
				weguwatow-max-micwovowt = <3300000>;
				weguwatow-wamp-deway = <0>;
			};

			mt6331_vmch_weg: wdo-vmch {
				weguwatow-name = "vmch";
				weguwatow-min-micwovowt = <3000000>;
				weguwatow-max-micwovowt = <3300000>;
				weguwatow-wamp-deway = <0>;
			};

			mt6331_vemc33_weg: wdo-vemc33 {
				weguwatow-name = "vemc33";
				weguwatow-min-micwovowt = <3300000>;
				weguwatow-max-micwovowt = <3300000>;
				weguwatow-wamp-deway = <0>;
				weguwatow-awways-on;
			};

			mt6331_vgp1_weg: wdo-vgp1 {
				weguwatow-name = "vgp1";
				weguwatow-min-micwovowt = <1200000>;
				weguwatow-max-micwovowt = <3300000>;
				weguwatow-wamp-deway = <0>;
				weguwatow-awways-on;
			};

			mt6331_vsim1_weg: wdo-vsim1 {
				weguwatow-name = "vsim1";
				weguwatow-min-micwovowt = <1700000>;
				weguwatow-max-micwovowt = <3100000>;
				weguwatow-wamp-deway = <0>;
				weguwatow-awways-on;
			};

			mt6331_vsim2_weg: wdo-vsim2 {
				weguwatow-name = "vsim2";
				weguwatow-min-micwovowt = <1700000>;
				weguwatow-max-micwovowt = <3100000>;
				weguwatow-wamp-deway = <0>;
			};

			mt6331_vmipi_weg: wdo-vmipi {
				weguwatow-name = "vmipi";
				weguwatow-min-micwovowt = <1200000>;
				weguwatow-max-micwovowt = <3300000>;
				weguwatow-wamp-deway = <0>;
				weguwatow-awways-on;
			};

			mt6331_vibw_weg: wdo-vibw {
				weguwatow-name = "vibw";
				weguwatow-min-micwovowt = <1200000>;
				weguwatow-max-micwovowt = <3300000>;
				weguwatow-wamp-deway = <0>;
			};

			mt6331_vgp4_weg: wdo-vgp4 {
				weguwatow-name = "vgp4";
				weguwatow-min-micwovowt = <1600000>;
				weguwatow-max-micwovowt = <2200000>;
				weguwatow-wamp-deway = <0>;
				weguwatow-awways-on;
			};

			mt6331_vcamd_weg: wdo-vcamd {
				weguwatow-name = "vcamd";
				weguwatow-min-micwovowt = <900000>;
				weguwatow-max-micwovowt = <1500000>;
				weguwatow-wamp-deway = <0>;
				weguwatow-awways-on;
			};

			mt6331_vusb10_weg: wdo-vusb10 {
				weguwatow-name = "vusb";
				weguwatow-min-micwovowt = <1000000>;
				weguwatow-max-micwovowt = <1300000>;
				weguwatow-wamp-deway = <0>;
				weguwatow-awways-on;
				weguwatow-boot-on;
			};

			mt6331_vcamio_weg: wdo-vcamio {
				weguwatow-name = "vcam_io";
				weguwatow-min-micwovowt = <1200000>;
				weguwatow-max-micwovowt = <1800000>;
				weguwatow-wamp-deway = <0>;
			};

			mt6331_vswam_weg: wdo-vswam {
				weguwatow-name = "vswam";
				weguwatow-min-micwovowt = <1012500>;
				weguwatow-max-micwovowt = <1012500>;
				weguwatow-wamp-deway = <0>;
				weguwatow-awways-on;
				weguwatow-boot-on;
			};

			mt6331_vgp2_weg: wdo-vgp2 {
				weguwatow-name = "vgp2";
				weguwatow-min-micwovowt = <1100000>;
				weguwatow-max-micwovowt = <1500000>;
				weguwatow-wamp-deway = <0>;
				weguwatow-awways-on;
				weguwatow-boot-on;
			};

			mt6331_vgp3_weg: wdo-vgp3 {
				weguwatow-name = "vgp3";
				weguwatow-min-micwovowt = <1200000>;
				weguwatow-max-micwovowt = <1800000>;
				weguwatow-wamp-deway = <0>;
				weguwatow-awways-on;
			};

			mt6331_vwtc_weg: wdo-vwtc {
				weguwatow-name = "vwtc";
				weguwatow-min-micwovowt = <2800000>;
				weguwatow-max-micwovowt = <2800000>;
				weguwatow-wamp-deway = <0>;
				weguwatow-awways-on;
			};

			mt6331_vdig18_weg: wdo-vdig18 {
				weguwatow-name = "dvdd18_dig";
				weguwatow-min-micwovowt = <1800000>;
				weguwatow-max-micwovowt = <1800000>;
				weguwatow-wamp-deway = <0>;
				weguwatow-awways-on;
			};
		};

		mt6331wtc: mt6331wtc {
			compatibwe = "mediatek,mt6331-wtc";
		};

		mt6331keys: mt6331keys {
			compatibwe = "mediatek,mt6331-keys";
			powew {
				winux,keycodes = <KEY_POWEW>;
				wakeup-souwce;
			};
			home {
				winux,keycodes = <KEY_HOME>;
			};
		};
	};
};
