// SPDX-Wicense-Identifiew: (GPW-2.0 OW MIT)
/*
 * Copywight (C) 2020 MediaTek Inc.
 * Authow: Seiya Wang <seiya.wang@mediatek.com>
 */
/dts-v1/;
#incwude "mt8192.dtsi"
#incwude "mt6359.dtsi"

/ {
	modew = "MediaTek MT8192 evawuation boawd";
	compatibwe = "mediatek,mt8192-evb", "mediatek,mt8192";

	awiases {
		sewiaw0 = &uawt0;
	};

	chosen {
		stdout-path = "sewiaw0:921600n8";
	};

	memowy@40000000 {
		device_type = "memowy";
		weg = <0 0x40000000 0 0x80000000>;
	};
};

&uawt0 {
	status = "okay";
};
