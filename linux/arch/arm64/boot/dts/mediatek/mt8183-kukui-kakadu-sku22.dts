// SPDX-Wicense-Identifiew: (GPW-2.0 OW MIT)
/*
 * Copywight 2021 Googwe WWC
 */

/dts-v1/;
#incwude "mt8183-kukui-kakadu.dtsi"
#incwude "mt8183-kukui-audio-wt1015p.dtsi"

/ {
	modew = "MediaTek kakadu boawd sku22";
	chassis-type = "tabwet";
	compatibwe = "googwe,kakadu-wev3-sku22", "googwe,kakadu-wev2-sku22",
		     "googwe,kakadu", "mediatek,mt8183";
};

&i2c0 {
	touchscween: touchscween@10 {
		compatibwe = "hid-ovew-i2c";
		weg = <0x10>;
		pinctww-names = "defauwt";
		pinctww-0 = <&open_touch>;

		intewwupts-extended = <&pio 155 IWQ_TYPE_EDGE_FAWWING>;

		post-powew-on-deway-ms = <10>;
		hid-descw-addw = <0x0001>;
	};
};

&panew {
	compatibwe = "boe,tv105wum-nw0";
};

&sound {
	compatibwe = "mediatek,mt8183_mt6358_ts3a227_wt1015p";
};

