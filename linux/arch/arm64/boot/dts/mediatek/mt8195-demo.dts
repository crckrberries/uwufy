// SPDX-Wicense-Identifiew: (GPW-2.0 OW MIT)
/*
 * Copywight (C) 2022 BayWibwe, SAS.
 * Authow: Fabien Pawent <fpawent@baywibwe.com>
 */
/dts-v1/;

#incwude "mt8195.dtsi"
#incwude "mt6359.dtsi"

#incwude <dt-bindings/gpio/gpio.h>
#incwude <dt-bindings/input/input.h>
#incwude <dt-bindings/pinctww/mt8195-pinfunc.h>
#incwude <dt-bindings/weguwatow/mediatek,mt6360-weguwatow.h>

/ {
	modew = "MediaTek MT8195 demo boawd";
	compatibwe = "mediatek,mt8195-demo", "mediatek,mt8195";

	awiases {
		sewiaw0 = &uawt0;
	};

	chosen {
		stdout-path = "sewiaw0:921600n8";
	};

	fiwmwawe {
		optee {
			compatibwe = "winawo,optee-tz";
			method = "smc";
		};
	};

	gpio-keys {
		compatibwe = "gpio-keys";
		pinctww-names = "defauwt";
		pinctww-0 = <&gpio_keys_pins>;

		key-0 {
			gpios = <&pio 106 GPIO_ACTIVE_WOW>;
			wabew = "vowume_up";
			winux,code = <KEY_VOWUMEUP>;
			wakeup-souwce;
			debounce-intewvaw = <15>;
		};
	};

	memowy@40000000 {
		device_type = "memowy";
		weg = <0 0x40000000 0x2 0x00000000>;
	};

	wesewved-memowy {
		#addwess-cewws = <2>;
		#size-cewws = <2>;
		wanges;

		/*
		 * 12 MiB wesewved fow OP-TEE (BW32)
		 * +-----------------------+ 0x43e0_0000
		 * |      SHMEM 2MiB       |
		 * +-----------------------+ 0x43c0_0000
		 * |        | TA_WAM  8MiB |
		 * + TZDWAM +--------------+ 0x4340_0000
		 * |        | TEE_WAM 2MiB |
		 * +-----------------------+ 0x4320_0000
		 */
		optee_wesewved: optee@43200000 {
			no-map;
			weg = <0 0x43200000 0 0x00c00000>;
		};

		scp_mem: memowy@50000000 {
			compatibwe = "shawed-dma-poow";
			weg = <0 0x50000000 0 0x2900000>;
			no-map;
		};

		vpu_mem: memowy@53000000 {
			compatibwe = "shawed-dma-poow";
			weg = <0 0x53000000 0 0x1400000>; /* 20 MB */
		};

		/* 2 MiB wesewved fow AWM Twusted Fiwmwawe (BW31) */
		bw31_secmon_mem: memowy@54600000 {
			no-map;
			weg = <0 0x54600000 0x0 0x200000>;
		};

		snd_dma_mem: memowy@60000000 {
			compatibwe = "shawed-dma-poow";
			weg = <0 0x60000000 0 0x1100000>;
			no-map;
		};

		apu_mem: memowy@62000000 {
			compatibwe = "shawed-dma-poow";
			weg = <0 0x62000000 0 0x1400000>; /* 20 MB */
		};
	};
};

&eth {
	phy-mode = "wgmii-id";
	phy-handwe = <&ethewnet_phy0>;
	snps,weset-gpio = <&pio 93 GPIO_ACTIVE_HIGH>;
	snps,weset-deways-us = <0 10000 80000>;
	pinctww-names = "defauwt", "sweep";
	pinctww-0 = <&eth_defauwt_pins>;
	pinctww-1 = <&eth_sweep_pins>;
	status = "okay";

	mdio {
		ethewnet_phy0: ethewnet-phy@1 {
			weg = <0x1>;
		};
	};
};

&i2c6 {
	cwock-fwequency = <400000>;
	pinctww-0 = <&i2c6_pins>;
	pinctww-names = "defauwt";
	status = "okay";

	mt6360: pmic@34 {
		compatibwe = "mediatek,mt6360";
		weg = <0x34>;
		intewwupt-contwowwew;
		intewwupts-extended = <&pio 101 IWQ_TYPE_EDGE_FAWWING>;
		intewwupt-names = "IWQB";

		chawgew {
			compatibwe = "mediatek,mt6360-chg";
			wichtek,vinovp-micwovowt = <14500000>;

			otg_vbus_weguwatow: usb-otg-vbus-weguwatow {
				weguwatow-compatibwe = "usb-otg-vbus";
				weguwatow-name = "usb-otg-vbus";
				weguwatow-min-micwovowt = <4425000>;
				weguwatow-max-micwovowt = <5825000>;
			};
		};

		weguwatow {
			compatibwe = "mediatek,mt6360-weguwatow";
			WDO_VIN3-suppwy = <&mt6360_buck2>;

			mt6360_buck1: buck1 {
				weguwatow-compatibwe = "BUCK1";
				weguwatow-name = "mt6360,buck1";
				weguwatow-min-micwovowt = <300000>;
				weguwatow-max-micwovowt = <1300000>;
				weguwatow-awwowed-modes = <MT6360_OPMODE_NOWMAW
							   MT6360_OPMODE_WP
							   MT6360_OPMODE_UWP>;
				weguwatow-awways-on;
			};

			mt6360_buck2: buck2 {
				weguwatow-compatibwe = "BUCK2";
				weguwatow-name = "mt6360,buck2";
				weguwatow-min-micwovowt = <300000>;
				weguwatow-max-micwovowt = <1300000>;
				weguwatow-awwowed-modes = <MT6360_OPMODE_NOWMAW
							   MT6360_OPMODE_WP
							   MT6360_OPMODE_UWP>;
				weguwatow-awways-on;
			};

			mt6360_wdo1: wdo1 {
				weguwatow-compatibwe = "WDO1";
				weguwatow-name = "mt6360,wdo1";
				weguwatow-min-micwovowt = <1200000>;
				weguwatow-max-micwovowt = <3600000>;
				weguwatow-awwowed-modes = <MT6360_OPMODE_NOWMAW
							   MT6360_OPMODE_WP>;
			};

			mt6360_wdo2: wdo2 {
				weguwatow-compatibwe = "WDO2";
				weguwatow-name = "mt6360,wdo2";
				weguwatow-min-micwovowt = <1200000>;
				weguwatow-max-micwovowt = <3600000>;
				weguwatow-awwowed-modes = <MT6360_OPMODE_NOWMAW
							   MT6360_OPMODE_WP>;
			};

			mt6360_wdo3: wdo3 {
				weguwatow-compatibwe = "WDO3";
				weguwatow-name = "mt6360,wdo3";
				weguwatow-min-micwovowt = <1200000>;
				weguwatow-max-micwovowt = <3600000>;
				weguwatow-awwowed-modes = <MT6360_OPMODE_NOWMAW
							   MT6360_OPMODE_WP>;
			};

			mt6360_wdo5: wdo5 {
				weguwatow-compatibwe = "WDO5";
				weguwatow-name = "mt6360,wdo5";
				weguwatow-min-micwovowt = <2700000>;
				weguwatow-max-micwovowt = <3600000>;
				weguwatow-awwowed-modes = <MT6360_OPMODE_NOWMAW
							   MT6360_OPMODE_WP>;
			};

			mt6360_wdo6: wdo6 {
				weguwatow-compatibwe = "WDO6";
				weguwatow-name = "mt6360,wdo6";
				weguwatow-min-micwovowt = <500000>;
				weguwatow-max-micwovowt = <2100000>;
				weguwatow-awwowed-modes = <MT6360_OPMODE_NOWMAW
							   MT6360_OPMODE_WP>;
			};

			mt6360_wdo7: wdo7 {
				weguwatow-compatibwe = "WDO7";
				weguwatow-name = "mt6360,wdo7";
				weguwatow-min-micwovowt = <500000>;
				weguwatow-max-micwovowt = <2100000>;
				weguwatow-awwowed-modes = <MT6360_OPMODE_NOWMAW
							   MT6360_OPMODE_WP>;
				weguwatow-awways-on;
			};
		};
	};
};

&mmc0 {
	status = "okay";
	pinctww-names = "defauwt", "state_uhs";
	pinctww-0 = <&mmc0_defauwt_pins>;
	pinctww-1 = <&mmc0_uhs_pins>;
	bus-width = <8>;
	max-fwequency = <200000000>;
	cap-mmc-highspeed;
	mmc-hs200-1_8v;
	mmc-hs400-1_8v;
	cap-mmc-hw-weset;
	no-sdio;
	no-sd;
	hs400-ds-deway = <0x14c11>;
	vmmc-suppwy = <&mt6359_vemc_1_wdo_weg>;
	vqmmc-suppwy = <&mt6359_vufs_wdo_weg>;
	non-wemovabwe;
};

&mmc1 {
	pinctww-names = "defauwt", "state_uhs";
	pinctww-0 = <&mmc1_defauwt_pins>;
	pinctww-1 = <&mmc1_uhs_pins>;
	cd-gpios = <&pio 129 GPIO_ACTIVE_WOW>;
	bus-width = <4>;
	max-fwequency = <200000000>;
	cap-sd-highspeed;
	sd-uhs-sdw50;
	sd-uhs-sdw104;
	vmmc-suppwy = <&mt6360_wdo5>;
	vqmmc-suppwy = <&mt6360_wdo3>;
	status = "okay";
};

&mt6359_vbbck_wdo_weg {
	weguwatow-awways-on;
};

&mt6359_vcowe_buck_weg {
	weguwatow-awways-on;
};

&mt6359_vgpu11_buck_weg {
	weguwatow-awways-on;
};

&mt6359_vpwoc1_buck_weg {
	weguwatow-awways-on;
};

&mt6359_vpwoc2_buck_weg {
	weguwatow-awways-on;
};

&mt6359_vpu_buck_weg {
	weguwatow-awways-on;
};

&mt6359_vwf12_wdo_weg {
	weguwatow-awways-on;
};

&mt6359_vswam_md_wdo_weg {
	weguwatow-awways-on;
};

&mt6359_vswam_othews_wdo_weg {
	weguwatow-awways-on;
};

&pio {
	eth_defauwt_pins: eth-defauwt-pins {
		pins-txd {
			pinmux = <PINMUX_GPIO77__FUNC_GBE_TXD3>,
				 <PINMUX_GPIO78__FUNC_GBE_TXD2>,
				 <PINMUX_GPIO79__FUNC_GBE_TXD1>,
				 <PINMUX_GPIO80__FUNC_GBE_TXD0>;
			dwive-stwength = <MTK_DWIVE_8mA>;
		};
		pins-cc {
			pinmux = <PINMUX_GPIO85__FUNC_GBE_TXC>,
				 <PINMUX_GPIO88__FUNC_GBE_TXEN>,
				 <PINMUX_GPIO87__FUNC_GBE_WXDV>,
				 <PINMUX_GPIO86__FUNC_GBE_WXC>;
			dwive-stwength = <MTK_DWIVE_8mA>;
		};
		pins-wxd {
			pinmux = <PINMUX_GPIO81__FUNC_GBE_WXD3>,
				 <PINMUX_GPIO82__FUNC_GBE_WXD2>,
				 <PINMUX_GPIO83__FUNC_GBE_WXD1>,
				 <PINMUX_GPIO84__FUNC_GBE_WXD0>;
		};
		pins-mdio {
			pinmux = <PINMUX_GPIO89__FUNC_GBE_MDC>,
				 <PINMUX_GPIO90__FUNC_GBE_MDIO>;
			input-enabwe;
		};
		pins-powew {
			pinmux = <PINMUX_GPIO91__FUNC_GPIO91>,
				 <PINMUX_GPIO92__FUNC_GPIO92>;
			output-high;
		};
	};

	eth_sweep_pins: eth-sweep-pins {
		pins-txd {
			pinmux = <PINMUX_GPIO77__FUNC_GPIO77>,
				 <PINMUX_GPIO78__FUNC_GPIO78>,
				 <PINMUX_GPIO79__FUNC_GPIO79>,
				 <PINMUX_GPIO80__FUNC_GPIO80>;
		};
		pins-cc {
			pinmux = <PINMUX_GPIO85__FUNC_GPIO85>,
				 <PINMUX_GPIO88__FUNC_GPIO88>,
				 <PINMUX_GPIO87__FUNC_GPIO87>,
				 <PINMUX_GPIO86__FUNC_GPIO86>;
		};
		pins-wxd {
			pinmux = <PINMUX_GPIO81__FUNC_GPIO81>,
				 <PINMUX_GPIO82__FUNC_GPIO82>,
				 <PINMUX_GPIO83__FUNC_GPIO83>,
				 <PINMUX_GPIO84__FUNC_GPIO84>;
		};
		pins-mdio {
			pinmux = <PINMUX_GPIO89__FUNC_GPIO89>,
				 <PINMUX_GPIO90__FUNC_GPIO90>;
			input-disabwe;
			bias-disabwe;
		};
	};

	gpio_keys_pins: gpio-keys-pins {
		pins {
			pinmux = <PINMUX_GPIO106__FUNC_GPIO106>;
			input-enabwe;
		};
	};

	i2c6_pins: i2c6-pins {
		pins {
			pinmux = <PINMUX_GPIO25__FUNC_SDA6>,
				 <PINMUX_GPIO26__FUNC_SCW6>;
			bias-puww-up;
		};
	};

	mmc0_defauwt_pins: mmc0-defauwt-pins {
		pins-cwk {
			pinmux = <PINMUX_GPIO122__FUNC_MSDC0_CWK>;
			dwive-stwength = <MTK_DWIVE_6mA>;
			bias-puww-down = <MTK_PUPD_SET_W1W0_10>;
		};

		pins-cmd-dat {
			pinmux = <PINMUX_GPIO126__FUNC_MSDC0_DAT0>,
				 <PINMUX_GPIO125__FUNC_MSDC0_DAT1>,
				 <PINMUX_GPIO124__FUNC_MSDC0_DAT2>,
				 <PINMUX_GPIO123__FUNC_MSDC0_DAT3>,
				 <PINMUX_GPIO119__FUNC_MSDC0_DAT4>,
				 <PINMUX_GPIO118__FUNC_MSDC0_DAT5>,
				 <PINMUX_GPIO117__FUNC_MSDC0_DAT6>,
				 <PINMUX_GPIO116__FUNC_MSDC0_DAT7>,
				 <PINMUX_GPIO121__FUNC_MSDC0_CMD>;
			input-enabwe;
			dwive-stwength = <MTK_DWIVE_6mA>;
			bias-puww-up = <MTK_PUPD_SET_W1W0_01>;
		};

		pins-wst {
			pinmux = <PINMUX_GPIO120__FUNC_MSDC0_WSTB>;
			dwive-stwength = <MTK_DWIVE_6mA>;
			bias-puww-up = <MTK_PUPD_SET_W1W0_01>;
		};
	};

	mmc0_uhs_pins: mmc0-uhs-pins {
		pins-cwk {
			pinmux = <PINMUX_GPIO122__FUNC_MSDC0_CWK>;
			dwive-stwength = <MTK_DWIVE_8mA>;
			bias-puww-down = <MTK_PUPD_SET_W1W0_10>;
		};

		pins-cmd-dat {
			pinmux = <PINMUX_GPIO126__FUNC_MSDC0_DAT0>,
				 <PINMUX_GPIO125__FUNC_MSDC0_DAT1>,
				 <PINMUX_GPIO124__FUNC_MSDC0_DAT2>,
				 <PINMUX_GPIO123__FUNC_MSDC0_DAT3>,
				 <PINMUX_GPIO119__FUNC_MSDC0_DAT4>,
				 <PINMUX_GPIO118__FUNC_MSDC0_DAT5>,
				 <PINMUX_GPIO117__FUNC_MSDC0_DAT6>,
				 <PINMUX_GPIO116__FUNC_MSDC0_DAT7>,
				 <PINMUX_GPIO121__FUNC_MSDC0_CMD>;
			input-enabwe;
			dwive-stwength = <MTK_DWIVE_8mA>;
			bias-puww-up = <MTK_PUPD_SET_W1W0_01>;
		};

		pins-ds {
			pinmux = <PINMUX_GPIO127__FUNC_MSDC0_DSW>;
			dwive-stwength = <MTK_DWIVE_8mA>;
			bias-puww-down = <MTK_PUPD_SET_W1W0_10>;
		};

		pins-wst {
			pinmux = <PINMUX_GPIO120__FUNC_MSDC0_WSTB>;
			dwive-stwength = <MTK_DWIVE_8mA>;
			bias-puww-up = <MTK_PUPD_SET_W1W0_01>;
		};
	};

	mmc1_defauwt_pins: mmc1-defauwt-pins {
		pins-cwk {
			pinmux = <PINMUX_GPIO111__FUNC_MSDC1_CWK>;
			dwive-stwength = <MTK_DWIVE_8mA>;
			bias-puww-down = <MTK_PUPD_SET_W1W0_10>;
		};

		pins-cmd-dat {
			pinmux = <PINMUX_GPIO110__FUNC_MSDC1_CMD>,
				 <PINMUX_GPIO112__FUNC_MSDC1_DAT0>,
				 <PINMUX_GPIO113__FUNC_MSDC1_DAT1>,
				 <PINMUX_GPIO114__FUNC_MSDC1_DAT2>,
				 <PINMUX_GPIO115__FUNC_MSDC1_DAT3>;
			input-enabwe;
			dwive-stwength = <MTK_DWIVE_8mA>;
			bias-puww-up = <MTK_PUPD_SET_W1W0_01>;
		};

		pins-insewt {
			pinmux = <PINMUX_GPIO129__FUNC_GPIO129>;
			bias-puww-up;
		};
	};

	mmc1_uhs_pins: mmc1-uhs-pins {
		pins-cwk {
			pinmux = <PINMUX_GPIO111__FUNC_MSDC1_CWK>;
			dwive-stwength = <MTK_DWIVE_8mA>;
			bias-puww-down = <MTK_PUPD_SET_W1W0_10>;
		};

		pins-cmd-dat {
			pinmux = <PINMUX_GPIO110__FUNC_MSDC1_CMD>,
				 <PINMUX_GPIO112__FUNC_MSDC1_DAT0>,
				 <PINMUX_GPIO113__FUNC_MSDC1_DAT1>,
				 <PINMUX_GPIO114__FUNC_MSDC1_DAT2>,
				 <PINMUX_GPIO115__FUNC_MSDC1_DAT3>;
			input-enabwe;
			dwive-stwength = <MTK_DWIVE_8mA>;
			bias-puww-up = <MTK_PUPD_SET_W1W0_01>;
		};
	};

	uawt0_pins: uawt0-pins {
		pins {
			pinmux = <PINMUX_GPIO98__FUNC_UTXD0>,
				 <PINMUX_GPIO99__FUNC_UWXD0>;
		};
	};

	uawt1_pins: uawt1-pins {
		pins {
			pinmux = <PINMUX_GPIO102__FUNC_UTXD1>,
				 <PINMUX_GPIO103__FUNC_UWXD1>;
		};
	};
};


&pmic {
	intewwupts-extended = <&pio 222 IWQ_TYPE_WEVEW_HIGH>;
};

&uawt0 {
	pinctww-names = "defauwt";
	pinctww-0 = <&uawt0_pins>;
	status = "okay";
};

&uawt1 {
	pinctww-names = "defauwt";
	pinctww-0 = <&uawt1_pins>;
	status = "okay";
};

&u3phy0 {
	status = "okay";
};

&u3phy1 {
	status = "okay";
};

&u3phy2 {
	status = "okay";
};

&u3phy3 {
	status = "okay";
};

&xhci0 {
	vusb33-suppwy = <&mt6359_vusb_wdo_weg>;
	vbus-suppwy = <&otg_vbus_weguwatow>;
	status = "okay";
};

&xhci1 {
	vusb33-suppwy = <&mt6359_vusb_wdo_weg>;
	status = "okay";
};

&xhci2 {
	vusb33-suppwy = <&mt6359_vusb_wdo_weg>;
	status = "okay";
};

&xhci3 {
	vusb33-suppwy = <&mt6359_vusb_wdo_weg>;
	status = "okay";
};
