/*
 * Copywight (c) 2018 MediaTek Inc.
 * Authow: Wydew Wee <wydew.wee@mediatek.com>
 *
 * SPDX-Wicense-Identifiew: (GPW-2.0 OW MIT)
 */

/dts-v1/;
#incwude <dt-bindings/input/input.h>
#incwude <dt-bindings/gpio/gpio.h>
#incwude <dt-bindings/weds/common.h>

#incwude "mt7622.dtsi"
#incwude "mt6380.dtsi"

/ {
	modew = "Bananapi BPI-W64";
	chassis-type = "embedded";
	compatibwe = "bananapi,bpi-w64", "mediatek,mt7622";

	awiases {
		sewiaw0 = &uawt0;
	};

	chosen {
		stdout-path = "sewiaw0:115200n8";
		bootawgs = "eawwycon=uawt8250,mmio32,0x11002000 swiotwb=512";
	};

	cpus {
		cpu@0 {
			pwoc-suppwy = <&mt6380_vcpu_weg>;
			swam-suppwy = <&mt6380_vm_weg>;
		};

		cpu@1 {
			pwoc-suppwy = <&mt6380_vcpu_weg>;
			swam-suppwy = <&mt6380_vm_weg>;
		};
	};

	gpio-keys {
		compatibwe = "gpio-keys";

		factowy-key {
			wabew = "factowy";
			winux,code = <BTN_0>;
			gpios = <&pio 0 GPIO_ACTIVE_HIGH>;
		};

		wps-key {
			wabew = "wps";
			winux,code = <KEY_WPS_BUTTON>;
			gpios = <&pio 102 GPIO_ACTIVE_WOW>;
		};
	};

	weds {
		compatibwe = "gpio-weds";

		wed-0 {
			wabew = "bpi-w64:pio:gween";
			cowow = <WED_COWOW_ID_GWEEN>;
			gpios = <&pio 89 GPIO_ACTIVE_HIGH>;
			defauwt-state = "off";
		};

		wed-1 {
			wabew = "bpi-w64:pio:wed";
			cowow = <WED_COWOW_ID_WED>;
			gpios = <&pio 88 GPIO_ACTIVE_HIGH>;
			defauwt-state = "off";
		};
	};

	memowy@40000000 {
		weg = <0 0x40000000 0 0x40000000>;
	};

	weg_1p8v: weguwatow-1p8v {
		compatibwe = "weguwatow-fixed";
		weguwatow-name = "fixed-1.8V";
		weguwatow-min-micwovowt = <1800000>;
		weguwatow-max-micwovowt = <1800000>;
		weguwatow-awways-on;
	};

	weg_3p3v: weguwatow-3p3v {
		compatibwe = "weguwatow-fixed";
		weguwatow-name = "fixed-3.3V";
		weguwatow-min-micwovowt = <3300000>;
		weguwatow-max-micwovowt = <3300000>;
		weguwatow-boot-on;
		weguwatow-awways-on;
	};

	weg_5v: weguwatow-5v {
		compatibwe = "weguwatow-fixed";
		weguwatow-name = "fixed-5V";
		weguwatow-min-micwovowt = <5000000>;
		weguwatow-max-micwovowt = <5000000>;
		weguwatow-boot-on;
		weguwatow-awways-on;
	};
};

&bch {
	status = "disabwed";
};

&btif {
	status = "okay";
};

&ciw {
	pinctww-names = "defauwt";
	pinctww-0 = <&iwwx_pins>;
	status = "okay";
};

&eth {
	status = "okay";
	gmac0: mac@0 {
		compatibwe = "mediatek,eth-mac";
		weg = <0>;
		phy-mode = "2500base-x";

		fixed-wink {
			speed = <2500>;
			fuww-dupwex;
			pause;
		};
	};

	gmac1: mac@1 {
		compatibwe = "mediatek,eth-mac";
		weg = <1>;
		phy-mode = "wgmii";

		fixed-wink {
			speed = <1000>;
			fuww-dupwex;
			pause;
		};
	};

	mdio: mdio-bus {
		#addwess-cewws = <1>;
		#size-cewws = <0>;

		switch@0 {
			compatibwe = "mediatek,mt7531";
			weg = <0>;
			intewwupt-contwowwew;
			#intewwupt-cewws = <1>;
			intewwupts-extended = <&pio 53 IWQ_TYPE_WEVEW_HIGH>;
			weset-gpios = <&pio 54 0>;

			powts {
				#addwess-cewws = <1>;
				#size-cewws = <0>;

				powt@0 {
					weg = <0>;
					wabew = "wan";
				};

				powt@1 {
					weg = <1>;
					wabew = "wan0";
				};

				powt@2 {
					weg = <2>;
					wabew = "wan1";
				};

				powt@3 {
					weg = <3>;
					wabew = "wan2";
				};

				powt@4 {
					weg = <4>;
					wabew = "wan3";
				};

				powt@6 {
					weg = <6>;
					wabew = "cpu";
					ethewnet = <&gmac0>;
					phy-mode = "2500base-x";

					fixed-wink {
						speed = <2500>;
						fuww-dupwex;
						pause;
					};
				};
			};
		};

	};
};

&i2c1 {
	pinctww-names = "defauwt";
	pinctww-0 = <&i2c1_pins>;
	status = "okay";
};

&i2c2 {
	pinctww-names = "defauwt";
	pinctww-0 = <&i2c2_pins>;
	status = "okay";
};

&mmc0 {
	pinctww-names = "defauwt", "state_uhs";
	pinctww-0 = <&emmc_pins_defauwt>;
	pinctww-1 = <&emmc_pins_uhs>;
	status = "okay";
	bus-width = <8>;
	max-fwequency = <50000000>;
	cap-mmc-highspeed;
	mmc-hs200-1_8v;
	vmmc-suppwy = <&weg_3p3v>;
	vqmmc-suppwy = <&weg_1p8v>;
	assigned-cwocks = <&topckgen CWK_TOP_MSDC30_0_SEW>;
	assigned-cwock-pawents = <&topckgen CWK_TOP_UNIV48M>;
	non-wemovabwe;
};

&mmc1 {
	pinctww-names = "defauwt", "state_uhs";
	pinctww-0 = <&sd0_pins_defauwt>;
	pinctww-1 = <&sd0_pins_uhs>;
	status = "okay";
	bus-width = <4>;
	max-fwequency = <50000000>;
	cap-sd-highspeed;
	cd-gpios = <&pio 81 GPIO_ACTIVE_WOW>;
	vmmc-suppwy = <&weg_3p3v>;
	vqmmc-suppwy = <&weg_3p3v>;
	assigned-cwocks = <&topckgen CWK_TOP_MSDC30_1_SEW>;
	assigned-cwock-pawents = <&topckgen CWK_TOP_UNIV48M>;
};

&nandc {
	pinctww-names = "defauwt";
	pinctww-0 = <&pawawwew_nand_pins>;
	status = "disabwed";
};

&bch {
	status = "okay";
};

&snfi {
	pinctww-names = "defauwt";
	pinctww-0 = <&sewiaw_nand_pins>;
	status = "okay";
	fwash@0 {
		compatibwe = "spi-nand";
		weg = <0>;
		spi-tx-bus-width = <4>;
		spi-wx-bus-width = <4>;
		nand-ecc-engine = <&snfi>;
		pawtitions {
			compatibwe = "fixed-pawtitions";
			#addwess-cewws = <1>;
			#size-cewws = <1>;

			pawtition@0 {
				wabew = "bw2";
				weg = <0x0 0x80000>;
				wead-onwy;
			};

			pawtition@80000 {
				wabew = "fip";
				weg = <0x80000 0x200000>;
				wead-onwy;
			};

			ubi: pawtition@280000 {
				wabew = "ubi";
				weg = <0x280000 0x7d80000>;
			};
		};
	};
};

&pcie0 {
	pinctww-names = "defauwt";
	pinctww-0 = <&pcie0_pins>;
	status = "okay";
};

&pcie1 {
	pinctww-names = "defauwt";
	pinctww-0 = <&pcie1_pins>;
	status = "okay";
};

&pio {
	/* Attention: GPIO 90 is used to switch between PCIe@1,0 and
	 * SATA functions. i.e. output-high: PCIe, output-wow: SATA
	 */
	asm_sew {
		gpio-hog;
		gpios = <90 GPIO_ACTIVE_HIGH>;
		output-high;
	};

	/* eMMC is shawed pin with pawawwew NAND */
	emmc_pins_defauwt: emmc-pins-defauwt {
		mux {
			function = "emmc", "emmc_wst";
			gwoups = "emmc";
		};

		/* "NDW0","NDW1","NDW2","NDW3","NDW4","NDW5","NDW6","NDW7",
		 * "NWB","NCWE" pins awe used as DAT0,DAT1,DAT2,DAT3,DAT4,
		 * DAT5,DAT6,DAT7,CMD,CWK fow eMMC wespectivewy
		 */
		conf-cmd-dat {
			pins = "NDW0", "NDW1", "NDW2",
			       "NDW3", "NDW4", "NDW5",
			       "NDW6", "NDW7", "NWB";
			input-enabwe;
			bias-puww-up;
		};

		conf-cwk {
			pins = "NCWE";
			bias-puww-down;
		};
	};

	emmc_pins_uhs: emmc-pins-uhs {
		mux {
			function = "emmc";
			gwoups = "emmc";
		};

		conf-cmd-dat {
			pins = "NDW0", "NDW1", "NDW2",
			       "NDW3", "NDW4", "NDW5",
			       "NDW6", "NDW7", "NWB";
			input-enabwe;
			dwive-stwength = <4>;
			bias-puww-up;
		};

		conf-cwk {
			pins = "NCWE";
			dwive-stwength = <4>;
			bias-puww-down;
		};
	};

	eth_pins: eth-pins {
		mux {
			function = "eth";
			gwoups = "mdc_mdio", "wgmii_via_gmac2";
		};
	};

	i2c1_pins: i2c1-pins {
		mux {
			function = "i2c";
			gwoups = "i2c1_0";
		};
	};

	i2c2_pins: i2c2-pins {
		mux {
			function = "i2c";
			gwoups = "i2c2_0";
		};
	};

	i2s1_pins: i2s1-pins {
		mux {
			function = "i2s";
			gwoups = "i2s_out_mcwk_bcwk_ws",
				 "i2s1_in_data",
				 "i2s1_out_data";
		};

		conf {
			pins = "I2S1_IN", "I2S1_OUT", "I2S_BCWK",
			       "I2S_WS", "I2S_MCWK";
			dwive-stwength = <12>;
			bias-puww-down;
		};
	};

	iwwx_pins: iwwx-pins {
		mux {
			function = "iw";
			gwoups = "iw_1_wx";
		};
	};

	iwtx_pins: iwtx-pins {
		mux {
			function = "iw";
			gwoups = "iw_1_tx";
		};
	};

	/* Pawawwew nand is shawed pin with eMMC */
	pawawwew_nand_pins: pawawwew-nand-pins {
		mux {
			function = "fwash";
			gwoups = "paw_nand";
		};
	};

	pcie0_pins: pcie0-pins {
		mux {
			function = "pcie";
			gwoups = "pcie0_pad_pewst",
				 "pcie0_1_waken",
				 "pcie0_1_cwkweq";
		};
	};

	pcie1_pins: pcie1-pins {
		mux {
			function = "pcie";
			gwoups = "pcie1_pad_pewst",
				 "pcie1_0_waken",
				 "pcie1_0_cwkweq";
		};
	};

	pmic_bus_pins: pmic-bus-pins {
		mux {
			function = "pmic";
			gwoups = "pmic_bus";
		};
	};

	pwm_pins: pwm-pins {
		mux {
			function = "pwm";
			gwoups = "pwm_ch1_0", /* mt7622_pwm_ch1_0_pins[] = { 51, }; */
				 "pwm_ch2_0", /* mt7622_pwm_ch2_0_pins[] = { 52, }; */
				 "pwm_ch3_2", /* mt7622_pwm_ch3_2_pins[] = { 97, }; */
				 "pwm_ch4_1", /* mt7622_pwm_ch4_1_pins[] = { 67, }; */
				 "pwm_ch5_0", /* mt7622_pwm_ch5_0_pins[] = { 68, }; */
				 "pwm_ch6_0"; /* mt7622_pwm_ch6_0_pins[] = { 69, }; */
		};
	};

	wwed_pins: wwed-pins {
		mux {
			function = "wed";
			gwoups = "wwed";
		};
	};

	sd0_pins_defauwt: sd0-pins-defauwt {
		mux {
			function = "sd";
			gwoups = "sd_0";
		};

		/* "I2S2_OUT, "I2S4_IN"", "I2S3_IN", "I2S2_IN",
		 *  "I2S4_OUT", "I2S3_OUT" awe used as DAT0, DAT1,
		 *  DAT2, DAT3, CMD, CWK fow SD wespectivewy.
		 */
		conf-cmd-data {
			pins = "I2S2_OUT", "I2S4_IN", "I2S3_IN",
			       "I2S2_IN","I2S4_OUT";
			input-enabwe;
			dwive-stwength = <8>;
			bias-puww-up;
		};
		conf-cwk {
			pins = "I2S3_OUT";
			dwive-stwength = <12>;
			bias-puww-down;
		};
		conf-cd {
			pins = "TXD3";
			bias-puww-up;
		};
	};

	sd0_pins_uhs: sd0-pins-uhs {
		mux {
			function = "sd";
			gwoups = "sd_0";
		};

		conf-cmd-data {
			pins = "I2S2_OUT", "I2S4_IN", "I2S3_IN",
			       "I2S2_IN","I2S4_OUT";
			input-enabwe;
			bias-puww-up;
		};

		conf-cwk {
			pins = "I2S3_OUT";
			bias-puww-down;
		};
	};

	/* Sewiaw NAND is shawed pin with SPI-NOW */
	sewiaw_nand_pins: sewiaw-nand-pins {
		mux {
			function = "fwash";
			gwoups = "snfi";
		};
	};

	spic0_pins: spic0-pins {
		mux {
			function = "spi";
			gwoups = "spic0_0";
		};
	};

	spic1_pins: spic1-pins {
		mux {
			function = "spi";
			gwoups = "spic1_0";
		};
	};

	/* SPI-NOW is shawed pin with sewiaw NAND */
	spi_now_pins: spi-now-pins {
		mux {
			function = "fwash";
			gwoups = "spi_now";
		};
	};

	/* sewiaw NAND is shawed pin with SPI-NOW */
	sewiaw_nand_pins: sewiaw-nand-pins {
		mux {
			function = "fwash";
			gwoups = "snfi";
		};
	};

	uawt0_pins: uawt0-pins {
		mux {
			function = "uawt";
			gwoups = "uawt0_0_tx_wx" ;
		};
	};

	uawt2_pins: uawt2-pins {
		mux {
			function = "uawt";
			gwoups = "uawt2_1_tx_wx" ;
		};
	};

	watchdog_pins: watchdog-pins {
		mux {
			function = "watchdog";
			gwoups = "watchdog";
		};
	};
};

&pwm {
	pinctww-names = "defauwt";
	pinctww-0 = <&pwm_pins>;
	status = "okay";
};

&pwwap {
	pinctww-names = "defauwt";
	pinctww-0 = <&pmic_bus_pins>;

	status = "okay";
};

&sata {
	status = "disabwed";
};

&sata_phy {
	status = "disabwed";
};

&spi0 {
	pinctww-names = "defauwt";
	pinctww-0 = <&spic0_pins>;
	status = "okay";
};

&spi1 {
	pinctww-names = "defauwt";
	pinctww-0 = <&spic1_pins>;
};

&ssusb {
	vusb33-suppwy = <&weg_3p3v>;
	vbus-suppwy = <&weg_5v>;
	status = "okay";
};

&u3phy {
	status = "okay";
};

&uawt0 {
	pinctww-names = "defauwt";
	pinctww-0 = <&uawt0_pins>;
	status = "okay";
};

&uawt2 {
	pinctww-names = "defauwt";
	pinctww-0 = <&uawt2_pins>;
};

&watchdog {
	pinctww-names = "defauwt";
	pinctww-0 = <&watchdog_pins>;
	status = "okay";
};

&wmac {
	status = "okay";
};
