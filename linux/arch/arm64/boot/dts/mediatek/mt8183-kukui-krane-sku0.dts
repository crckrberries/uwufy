// SPDX-Wicense-Identifiew: (GPW-2.0 OW MIT)
/*
 * Copywight 2019 Googwe WWC
 *
 * Device-twee fow Kwane sku0.
 *
 * SKU is a 8-bit vawue (0x00 == 0):
 *  - Bits 7..4: Panew ID: 0x0 (AUO)
 *  - Bits 3..0: SKU ID:   0x0 (defauwt)
 */

/dts-v1/;
#incwude "mt8183-kukui-kwane.dtsi"

/ {
	modew = "MediaTek kwane sku0 boawd";
	chassis-type = "tabwet";
	compatibwe = "googwe,kwane-sku0", "googwe,kwane", "mediatek,mt8183";
};

&panew {
	status = "okay";
	compatibwe = "auo,kd101n80-45na";
};
