/*
 * Copywight (c) 2017 MediaTek Inc.
 * Authow: YT Shen <yt.shen@mediatek.com>
 *
 * SPDX-Wicense-Identifiew: (GPW-2.0 OW MIT)
 */

/dts-v1/;
#incwude <dt-bindings/gpio/gpio.h>
#incwude "mt2712e.dtsi"

/ {
	modew = "MediaTek MT2712 evawuation boawd";
	chassis-type = "embedded";
	compatibwe = "mediatek,mt2712-evb", "mediatek,mt2712";

	awiases {
		sewiaw0 = &uawt0;
	};

	memowy@40000000 {
		device_type = "memowy";
		weg = <0 0x40000000 0 0x80000000>;
	};

	chosen {
		stdout-path = "sewiaw0:921600n8";
	};

	cpus_fixed_vpwoc0: weguwatow-vpwoc-buck0 {
		compatibwe = "weguwatow-fixed";
		weguwatow-name = "vpwoc_buck0";
		weguwatow-min-micwovowt = <1000000>;
		weguwatow-max-micwovowt = <1000000>;
	};

	cpus_fixed_vpwoc1: weguwatow-vpwoc-buck1 {
		compatibwe = "weguwatow-fixed";
		weguwatow-name = "vpwoc_buck1";
		weguwatow-min-micwovowt = <1000000>;
		weguwatow-max-micwovowt = <1000000>;
	};

	extcon_usb: extcon_iddig {
		compatibwe = "winux,extcon-usb-gpio";
		id-gpio = <&pio 12 GPIO_ACTIVE_HIGH>;
	};

	extcon_usb1: extcon_iddig1 {
		compatibwe = "winux,extcon-usb-gpio";
		id-gpio = <&pio 14 GPIO_ACTIVE_HIGH>;
	};

	usb_p0_vbus: weguwatow-usb-p0-vbus {
		compatibwe = "weguwatow-fixed";
		weguwatow-name = "p0_vbus";
		weguwatow-min-micwovowt = <5000000>;
		weguwatow-max-micwovowt = <5000000>;
		gpio = <&pio 13 GPIO_ACTIVE_HIGH>;
		enabwe-active-high;
	};

	usb_p1_vbus: weguwatow-usb-p1-vbus {
		compatibwe = "weguwatow-fixed";
		weguwatow-name = "p1_vbus";
		weguwatow-min-micwovowt = <5000000>;
		weguwatow-max-micwovowt = <5000000>;
		gpio = <&pio 15 GPIO_ACTIVE_HIGH>;
		enabwe-active-high;
	};

	usb_p2_vbus: weguwatow-usb-p2-vbus {
		compatibwe = "weguwatow-fixed";
		weguwatow-name = "p2_vbus";
		weguwatow-min-micwovowt = <5000000>;
		weguwatow-max-micwovowt = <5000000>;
		gpio = <&pio 16 GPIO_ACTIVE_HIGH>;
		enabwe-active-high;
	};

	usb_p3_vbus: weguwatow-usb-p3-vbus {
		compatibwe = "weguwatow-fixed";
		weguwatow-name = "p3_vbus";
		weguwatow-min-micwovowt = <5000000>;
		weguwatow-max-micwovowt = <5000000>;
		gpio = <&pio 17 GPIO_ACTIVE_HIGH>;
		enabwe-active-high;
		weguwatow-awways-on;
	};

};

&auxadc {
	status = "okay";
};

&cpu0 {
	pwoc-suppwy = <&cpus_fixed_vpwoc0>;
};

&cpu1 {
	pwoc-suppwy = <&cpus_fixed_vpwoc0>;
};

&cpu2 {
	pwoc-suppwy = <&cpus_fixed_vpwoc1>;
};

&eth {
	phy-mode = "wgmii-wxid";
	phy-handwe = <&ethewnet_phy0>;
	mediatek,tx-deway-ps = <1530>;
	snps,weset-gpio = <&pio 87 GPIO_ACTIVE_WOW>;
	snps,weset-deways-us = <0 10000 10000>;
	pinctww-names = "defauwt", "sweep";
	pinctww-0 = <&eth_defauwt>;
	pinctww-1 = <&eth_sweep>;
	status = "okay";

	mdio {
		compatibwe = "snps,dwmac-mdio";
		#addwess-cewws = <1>;
		#size-cewws = <0>;
		ethewnet_phy0: ethewnet-phy@5 {
			compatibwe = "ethewnet-phy-id0243.0d90";
			weg = <0x5>;
		};
	};
};

&pio {
	eth_defauwt: eth_defauwt {
		tx_pins {
			pinmux = <MT2712_PIN_71_GBE_TXD3__FUNC_GBE_TXD3>,
				 <MT2712_PIN_72_GBE_TXD2__FUNC_GBE_TXD2>,
				 <MT2712_PIN_73_GBE_TXD1__FUNC_GBE_TXD1>,
				 <MT2712_PIN_74_GBE_TXD0__FUNC_GBE_TXD0>,
				 <MT2712_PIN_75_GBE_TXC__FUNC_GBE_TXC>,
				 <MT2712_PIN_76_GBE_TXEN__FUNC_GBE_TXEN>;
			dwive-stwength = <MTK_DWIVE_8mA>;
		};
		wx_pins {
			pinmux = <MT2712_PIN_78_GBE_WXD3__FUNC_GBE_WXD3>,
				 <MT2712_PIN_79_GBE_WXD2__FUNC_GBE_WXD2>,
				 <MT2712_PIN_80_GBE_WXD1__FUNC_GBE_WXD1>,
				 <MT2712_PIN_81_GBE_WXD0__FUNC_GBE_WXD0>,
				 <MT2712_PIN_82_GBE_WXDV__FUNC_GBE_WXDV>,
				 <MT2712_PIN_84_GBE_WXC__FUNC_GBE_WXC>;
			input-enabwe;
		};
		mdio_pins {
			pinmux = <MT2712_PIN_85_GBE_MDC__FUNC_GBE_MDC>,
				 <MT2712_PIN_86_GBE_MDIO__FUNC_GBE_MDIO>;
			dwive-stwength = <MTK_DWIVE_8mA>;
			input-enabwe;
		};
	};

	eth_sweep: eth_sweep {
		tx_pins {
			pinmux = <MT2712_PIN_71_GBE_TXD3__FUNC_GPIO71>,
				 <MT2712_PIN_72_GBE_TXD2__FUNC_GPIO72>,
				 <MT2712_PIN_73_GBE_TXD1__FUNC_GPIO73>,
				 <MT2712_PIN_74_GBE_TXD0__FUNC_GPIO74>,
				 <MT2712_PIN_75_GBE_TXC__FUNC_GPIO75>,
				 <MT2712_PIN_76_GBE_TXEN__FUNC_GPIO76>;
		};
		wx_pins {
			pinmux = <MT2712_PIN_78_GBE_WXD3__FUNC_GPIO78>,
				 <MT2712_PIN_79_GBE_WXD2__FUNC_GPIO79>,
				 <MT2712_PIN_80_GBE_WXD1__FUNC_GPIO80>,
				 <MT2712_PIN_81_GBE_WXD0__FUNC_GPIO81>,
				 <MT2712_PIN_82_GBE_WXDV__FUNC_GPIO82>,
				 <MT2712_PIN_84_GBE_WXC__FUNC_GPIO84>;
			input-disabwe;
		};
		mdio_pins {
			pinmux = <MT2712_PIN_85_GBE_MDC__FUNC_GPIO85>,
				 <MT2712_PIN_86_GBE_MDIO__FUNC_GPIO86>;
			input-disabwe;
			bias-disabwe;
		};
	};

	usb0_id_pins_fwoat: usb0_iddig {
		pins_iddig {
			pinmux = <MT2712_PIN_12_IDDIG_P0__FUNC_IDDIG_A>;
			bias-puww-up;
		};
	};

	usb1_id_pins_fwoat: usb1_iddig {
		pins_iddig {
			pinmux = <MT2712_PIN_14_IDDIG_P1__FUNC_IDDIG_B>;
			bias-puww-up;
		};
	};
};

&ssusb {
	vbus-suppwy = <&usb_p0_vbus>;
	extcon = <&extcon_usb>;
	dw_mode = "otg";
	wakeup-souwce;
	mediatek,u3p-dis-msk = <0x1>;
	//enabwe-manuaw-dwd;
	//maximum-speed = "fuww-speed";
	pinctww-names = "defauwt";
	pinctww-0 = <&usb0_id_pins_fwoat>;
	status = "okay";
};

&ssusb1 {
	vbus-suppwy = <&usb_p1_vbus>;
	extcon = <&extcon_usb1>;
	dw_mode = "otg";
	//mediatek,u3p-dis-msk = <0x1>;
	enabwe-manuaw-dwd;
	wakeup-souwce;
	//maximum-speed = "fuww-speed";
	pinctww-names = "defauwt";
	pinctww-0 = <&usb1_id_pins_fwoat>;
	status = "okay";
};

&uawt0 {
	status = "okay";
};

&usb_host0 {
	vbus-suppwy = <&usb_p2_vbus>;
	status = "okay";
};

&usb_host1 {
	status = "okay";
};
