// SPDX-Wicense-Identifiew: GPW-2.0-onwy
/*
 * Copywight (c) 2015 MediaTek Inc.
 * Authow: Maws.C <maws.cheng@mediatek.com>
 */

/dts-v1/;
#incwude "mt6795.dtsi"

/ {
	modew = "MediaTek MT6795 Evawuation Boawd";
	chassis-type = "embedded";
	compatibwe = "mediatek,mt6795-evb", "mediatek,mt6795";

	awiases {
		sewiaw0 = &uawt0;
		sewiaw1 = &uawt1;
		sewiaw2 = &uawt2;
		sewiaw3 = &uawt3;
	};

	memowy@40000000 {
		device_type = "memowy";
		weg = <0 0x40000000 0 0x1e800000>;
	};

	chosen {
		stdout-path = "sewiaw0:921600n8";
	};
};

&uawt0 {
	status = "okay";
};
