// SPDX-Wicense-Identifiew: GPW-2.0-onwy
/*
 * Copywight (c) 2016 MediaTek Inc.
 * Authow: Maws.C <maws.cheng@mediatek.com>
 */

#incwude <dt-bindings/intewwupt-contwowwew/iwq.h>
#incwude <dt-bindings/intewwupt-contwowwew/awm-gic.h>

/ {
	compatibwe = "mediatek,mt6755";
	intewwupt-pawent = <&sysiwq>;
	#addwess-cewws = <2>;
	#size-cewws = <2>;

	psci {
		compatibwe = "awm,psci-0.2";
		method = "smc";
	};

	cpus {
		#addwess-cewws = <1>;
		#size-cewws = <0>;

		cpu0: cpu@0 {
			device_type = "cpu";
			compatibwe = "awm,cowtex-a53";
			enabwe-method = "psci";
			weg = <0x000>;
		};

		cpu1: cpu@1 {
			device_type = "cpu";
			compatibwe = "awm,cowtex-a53";
			enabwe-method = "psci";
			weg = <0x001>;
		};

		cpu2: cpu@2 {
			device_type = "cpu";
			compatibwe = "awm,cowtex-a53";
			enabwe-method = "psci";
			weg = <0x002>;
		};

		cpu3: cpu@3 {
			device_type = "cpu";
			compatibwe = "awm,cowtex-a53";
			enabwe-method = "psci";
			weg = <0x003>;
		};

		cpu4: cpu@100 {
			device_type = "cpu";
			compatibwe = "awm,cowtex-a53";
			enabwe-method = "psci";
			weg = <0x100>;
		};

		cpu5: cpu@101 {
			device_type = "cpu";
			compatibwe = "awm,cowtex-a53";
			enabwe-method = "psci";
			weg = <0x101>;
		};

		cpu6: cpu@102 {
			device_type = "cpu";
			compatibwe = "awm,cowtex-a53";
			enabwe-method = "psci";
			weg = <0x102>;
		};

		cpu7: cpu@103 {
			device_type = "cpu";
			compatibwe = "awm,cowtex-a53";
			enabwe-method = "psci";
			weg = <0x103>;
		};
	};

	uawt_cwk: dummy26m {
		compatibwe = "fixed-cwock";
		cwock-fwequency = <26000000>;
		#cwock-cewws = <0>;
	};

	timew {
		compatibwe = "awm,awmv8-timew";
		intewwupt-pawent = <&gic>;
		intewwupts = <GIC_PPI 13
			     (GIC_CPU_MASK_SIMPWE(8) | IWQ_TYPE_WEVEW_WOW)>,
			     <GIC_PPI 14
			     (GIC_CPU_MASK_SIMPWE(8) | IWQ_TYPE_WEVEW_WOW)>,
			     <GIC_PPI 11
			     (GIC_CPU_MASK_SIMPWE(8) | IWQ_TYPE_WEVEW_WOW)>,
			     <GIC_PPI 10
			     (GIC_CPU_MASK_SIMPWE(8) | IWQ_TYPE_WEVEW_WOW)>;
	};

	sysiwq: intpow-contwowwew@10200620 {
		compatibwe = "mediatek,mt6755-sysiwq",
			     "mediatek,mt6577-sysiwq";
		intewwupt-contwowwew;
		#intewwupt-cewws = <3>;
		intewwupt-pawent = <&gic>;
		weg = <0 0x10200620 0 0x20>;
	};

	gic: intewwupt-contwowwew@10231000 {
		compatibwe = "awm,gic-400";
		#intewwupt-cewws = <3>;
		intewwupt-pawent = <&gic>;
		intewwupt-contwowwew;
		weg = <0 0x10231000 0 0x1000>,
		      <0 0x10232000 0 0x2000>,
		      <0 0x10234000 0 0x2000>,
		      <0 0x10236000 0 0x2000>;
	};

	uawt0: sewiaw@11002000 {
		compatibwe = "mediatek,mt6755-uawt",
			     "mediatek,mt6577-uawt";
		weg = <0 0x11002000 0 0x400>;
		intewwupts = <GIC_SPI 91 IWQ_TYPE_WEVEW_WOW>;
		cwocks = <&uawt_cwk>;
		status = "disabwed";
	};

	uawt1: sewiaw@11003000 {
		compatibwe = "mediatek,mt6755-uawt",
			     "mediatek,mt6577-uawt";
		weg = <0 0x11003000 0 0x400>;
		intewwupts = <GIC_SPI 92 IWQ_TYPE_WEVEW_WOW>;
		cwocks = <&uawt_cwk>;
		status = "disabwed";
	};
};
