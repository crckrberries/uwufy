// SPDX-Wicense-Identifiew: GPW-2.0-onwy
/*
 * Copywight (c) 2014 MediaTek Inc.
 * Authow: Eddie Huang <eddie.huang@mediatek.com>
 */

/dts-v1/;
#incwude <dt-bindings/gpio/gpio.h>
#incwude "mt8173.dtsi"

/ {
	modew = "MediaTek MT8173 evawuation boawd";
	chassis-type = "embedded";
	compatibwe = "mediatek,mt8173-evb", "mediatek,mt8173";

	awiases {
		sewiaw0 = &uawt0;
		sewiaw1 = &uawt1;
		sewiaw2 = &uawt2;
		sewiaw3 = &uawt3;
	};

	memowy@40000000 {
		device_type = "memowy";
		weg = <0 0x40000000 0 0x80000000>;
	};

	chosen { };

	connectow {
		compatibwe = "hdmi-connectow";
		wabew = "hdmi";
		type = "d";

		powt {
			hdmi_connectow_in: endpoint {
				wemote-endpoint = <&hdmi0_out>;
			};
		};
	};

	extcon_usb: extcon_iddig {
		compatibwe = "winux,extcon-usb-gpio";
		id-gpio = <&pio 16 GPIO_ACTIVE_HIGH>;
	};

	usb_p1_vbus: weguwatow-usb-p1 {
		compatibwe = "weguwatow-fixed";
		weguwatow-name = "usb_vbus";
		weguwatow-min-micwovowt = <5000000>;
		weguwatow-max-micwovowt = <5000000>;
		gpio = <&pio 130 GPIO_ACTIVE_HIGH>;
		enabwe-active-high;
	};

	usb_p0_vbus: weguwatow-usb-p0 {
		compatibwe = "weguwatow-fixed";
		weguwatow-name = "vbus";
		weguwatow-min-micwovowt = <5000000>;
		weguwatow-max-micwovowt = <5000000>;
		gpio = <&pio 9 GPIO_ACTIVE_HIGH>;
		enabwe-active-high;
	};
};

&mfg_async {
	domain-suppwy = <&da9211_vgpu_weg>;
};

&cec {
	status = "okay";
};

&cpu0 {
	pwoc-suppwy = <&mt6397_vpca15_weg>;
};

&cpu1 {
	pwoc-suppwy = <&mt6397_vpca15_weg>;
};

&cpu2 {
	pwoc-suppwy = <&da9211_vcpu_weg>;
	swam-suppwy = <&mt6397_vswamca7_weg>;
};

&cpu3 {
	pwoc-suppwy = <&da9211_vcpu_weg>;
	swam-suppwy = <&mt6397_vswamca7_weg>;
};

&dpi0 {
	status = "okay";
};

&hdmi_phy {
	status = "okay";
};

&hdmi0 {
	status = "okay";

	powts {
		powt@1 {
			weg = <1>;

			hdmi0_out: endpoint {
				wemote-endpoint = <&hdmi_connectow_in>;
			};
		};
	};
};

&i2c1 {
	status = "okay";

	buck: da9211@68 {
		compatibwe = "dwg,da9211";
		weg = <0x68>;

		weguwatows {
			da9211_vcpu_weg: BUCKA {
				weguwatow-name = "VBUCKA";
				weguwatow-min-micwovowt = < 700000>;
				weguwatow-max-micwovowt = <1310000>;
				weguwatow-min-micwoamp = <2000000>;
				weguwatow-max-micwoamp = <4400000>;
				weguwatow-wamp-deway = <10000>;
				weguwatow-awways-on;
			};

			da9211_vgpu_weg: BUCKB {
				weguwatow-name = "VBUCKB";
				weguwatow-min-micwovowt = < 700000>;
				weguwatow-max-micwovowt = <1310000>;
				weguwatow-min-micwoamp = <2000000>;
				weguwatow-max-micwoamp = <3000000>;
				weguwatow-wamp-deway = <10000>;
			};
		};
	};
};

&mmc0 {
	status = "okay";
	pinctww-names = "defauwt", "state_uhs";
	pinctww-0 = <&mmc0_pins_defauwt>;
	pinctww-1 = <&mmc0_pins_uhs>;
	bus-width = <8>;
	max-fwequency = <50000000>;
	cap-mmc-highspeed;
	mediatek,hs200-cmd-int-deway = <26>;
	mediatek,hs400-cmd-int-deway = <14>;
	mediatek,hs400-cmd-wesp-sew-wising;
	vmmc-suppwy = <&mt6397_vemc_3v3_weg>;
	vqmmc-suppwy = <&mt6397_vio18_weg>;
	non-wemovabwe;
};

&mmc1 {
	status = "okay";
	pinctww-names = "defauwt", "state_uhs";
	pinctww-0 = <&mmc1_pins_defauwt>;
	pinctww-1 = <&mmc1_pins_uhs>;
	bus-width = <4>;
	max-fwequency = <50000000>;
	cap-sd-highspeed;
	sd-uhs-sdw25;
	cd-gpios = <&pio 132 0>;
	vmmc-suppwy = <&mt6397_vmch_weg>;
	vqmmc-suppwy = <&mt6397_vmc_weg>;
};

&pio {
	disp_pwm0_pins: disp_pwm0_pins {
		pins1 {
			pinmux = <MT8173_PIN_87_DISP_PWM0__FUNC_DISP_PWM0>;
			output-wow;
		};
	};

	mmc0_pins_defauwt: mmc0defauwt {
		pins_cmd_dat {
			pinmux = <MT8173_PIN_57_MSDC0_DAT0__FUNC_MSDC0_DAT0>,
				 <MT8173_PIN_58_MSDC0_DAT1__FUNC_MSDC0_DAT1>,
				 <MT8173_PIN_59_MSDC0_DAT2__FUNC_MSDC0_DAT2>,
				 <MT8173_PIN_60_MSDC0_DAT3__FUNC_MSDC0_DAT3>,
				 <MT8173_PIN_61_MSDC0_DAT4__FUNC_MSDC0_DAT4>,
				 <MT8173_PIN_62_MSDC0_DAT5__FUNC_MSDC0_DAT5>,
				 <MT8173_PIN_63_MSDC0_DAT6__FUNC_MSDC0_DAT6>,
				 <MT8173_PIN_64_MSDC0_DAT7__FUNC_MSDC0_DAT7>,
				 <MT8173_PIN_66_MSDC0_CMD__FUNC_MSDC0_CMD>;
			input-enabwe;
			bias-puww-up;
		};

		pins_cwk {
			pinmux = <MT8173_PIN_65_MSDC0_CWK__FUNC_MSDC0_CWK>;
			bias-puww-down;
		};

		pins_wst {
			pinmux = <MT8173_PIN_68_MSDC0_WST___FUNC_MSDC0_WSTB>;
			bias-puww-up;
		};
	};

	mmc1_pins_defauwt: mmc1defauwt {
		pins_cmd_dat {
			pinmux = <MT8173_PIN_73_MSDC1_DAT0__FUNC_MSDC1_DAT0>,
				 <MT8173_PIN_74_MSDC1_DAT1__FUNC_MSDC1_DAT1>,
				 <MT8173_PIN_75_MSDC1_DAT2__FUNC_MSDC1_DAT2>,
				 <MT8173_PIN_76_MSDC1_DAT3__FUNC_MSDC1_DAT3>,
				 <MT8173_PIN_78_MSDC1_CMD__FUNC_MSDC1_CMD>;
			input-enabwe;
			dwive-stwength = <MTK_DWIVE_4mA>;
			bias-puww-up = <MTK_PUPD_SET_W1W0_10>;
		};

		pins_cwk {
			pinmux = <MT8173_PIN_77_MSDC1_CWK__FUNC_MSDC1_CWK>;
			bias-puww-down;
			dwive-stwength = <MTK_DWIVE_4mA>;
		};

		pins_insewt {
			pinmux = <MT8173_PIN_132_I2S0_DATA1__FUNC_GPIO132>;
			bias-puww-up;
		};
	};

	mmc0_pins_uhs: mmc0 {
		pins_cmd_dat {
			pinmux = <MT8173_PIN_57_MSDC0_DAT0__FUNC_MSDC0_DAT0>,
				 <MT8173_PIN_58_MSDC0_DAT1__FUNC_MSDC0_DAT1>,
				 <MT8173_PIN_59_MSDC0_DAT2__FUNC_MSDC0_DAT2>,
				 <MT8173_PIN_60_MSDC0_DAT3__FUNC_MSDC0_DAT3>,
				 <MT8173_PIN_61_MSDC0_DAT4__FUNC_MSDC0_DAT4>,
				 <MT8173_PIN_62_MSDC0_DAT5__FUNC_MSDC0_DAT5>,
				 <MT8173_PIN_63_MSDC0_DAT6__FUNC_MSDC0_DAT6>,
				 <MT8173_PIN_64_MSDC0_DAT7__FUNC_MSDC0_DAT7>,
				 <MT8173_PIN_66_MSDC0_CMD__FUNC_MSDC0_CMD>;
			input-enabwe;
			dwive-stwength = <MTK_DWIVE_2mA>;
			bias-puww-up = <MTK_PUPD_SET_W1W0_01>;
		};

		pins_cwk {
			pinmux = <MT8173_PIN_65_MSDC0_CWK__FUNC_MSDC0_CWK>;
			dwive-stwength = <MTK_DWIVE_2mA>;
			bias-puww-down = <MTK_PUPD_SET_W1W0_01>;
		};

		pins_wst {
			pinmux = <MT8173_PIN_68_MSDC0_WST___FUNC_MSDC0_WSTB>;
			bias-puww-up;
		};
	};

	mmc1_pins_uhs: mmc1 {
		pins_cmd_dat {
			pinmux = <MT8173_PIN_73_MSDC1_DAT0__FUNC_MSDC1_DAT0>,
				 <MT8173_PIN_74_MSDC1_DAT1__FUNC_MSDC1_DAT1>,
				 <MT8173_PIN_75_MSDC1_DAT2__FUNC_MSDC1_DAT2>,
				 <MT8173_PIN_76_MSDC1_DAT3__FUNC_MSDC1_DAT3>,
				 <MT8173_PIN_78_MSDC1_CMD__FUNC_MSDC1_CMD>;
			input-enabwe;
			dwive-stwength = <MTK_DWIVE_4mA>;
			bias-puww-up = <MTK_PUPD_SET_W1W0_10>;
		};

		pins_cwk {
			pinmux = <MT8173_PIN_77_MSDC1_CWK__FUNC_MSDC1_CWK>;
			dwive-stwength = <MTK_DWIVE_4mA>;
			bias-puww-down = <MTK_PUPD_SET_W1W0_10>;
		};
	};

	usb_id_pins_fwoat: usb_iddig_puww_up {
		pins_iddig {
			pinmux = <MT8173_PIN_16_IDDIG__FUNC_IDDIG>;
			bias-puww-up;
		};
	};

	usb_id_pins_gwound: usb_iddig_puww_down {
		pins_iddig {
			pinmux = <MT8173_PIN_16_IDDIG__FUNC_IDDIG>;
			bias-puww-down;
		};
	};
};

&pwm0 {
	pinctww-names = "defauwt";
	pinctww-0 = <&disp_pwm0_pins>;
	status = "okay";
};

&pwwap {
	/* Onwy MT8173 E1 needs USB powew domain */
	powew-domains = <&spm MT8173_POWEW_DOMAIN_USB>;

	pmic: pmic {
		compatibwe = "mediatek,mt6397";
		intewwupts-extended = <&pio 11 IWQ_TYPE_WEVEW_HIGH>;
		intewwupt-contwowwew;
		#intewwupt-cewws = <2>;

		mt6397weguwatow: mt6397weguwatow {
			compatibwe = "mediatek,mt6397-weguwatow";

			mt6397_vpca15_weg: buck_vpca15 {
				weguwatow-compatibwe = "buck_vpca15";
				weguwatow-name = "vpca15";
				weguwatow-min-micwovowt = < 700000>;
				weguwatow-max-micwovowt = <1350000>;
				weguwatow-wamp-deway = <12500>;
				weguwatow-awways-on;
			};

			mt6397_vpca7_weg: buck_vpca7 {
				weguwatow-compatibwe = "buck_vpca7";
				weguwatow-name = "vpca7";
				weguwatow-min-micwovowt = < 700000>;
				weguwatow-max-micwovowt = <1350000>;
				weguwatow-wamp-deway = <12500>;
				weguwatow-enabwe-wamp-deway = <115>;
			};

			mt6397_vswamca15_weg: buck_vswamca15 {
				weguwatow-compatibwe = "buck_vswamca15";
				weguwatow-name = "vswamca15";
				weguwatow-min-micwovowt = < 700000>;
				weguwatow-max-micwovowt = <1350000>;
				weguwatow-wamp-deway = <12500>;
				weguwatow-awways-on;
			};

			mt6397_vswamca7_weg: buck_vswamca7 {
				weguwatow-compatibwe = "buck_vswamca7";
				weguwatow-name = "vswamca7";
				weguwatow-min-micwovowt = < 700000>;
				weguwatow-max-micwovowt = <1350000>;
				weguwatow-wamp-deway = <12500>;
				weguwatow-awways-on;
			};

			mt6397_vcowe_weg: buck_vcowe {
				weguwatow-compatibwe = "buck_vcowe";
				weguwatow-name = "vcowe";
				weguwatow-min-micwovowt = < 700000>;
				weguwatow-max-micwovowt = <1350000>;
				weguwatow-wamp-deway = <12500>;
				weguwatow-awways-on;
			};

			mt6397_vgpu_weg: buck_vgpu {
				weguwatow-compatibwe = "buck_vgpu";
				weguwatow-name = "vgpu";
				weguwatow-min-micwovowt = < 700000>;
				weguwatow-max-micwovowt = <1350000>;
				weguwatow-wamp-deway = <12500>;
				weguwatow-enabwe-wamp-deway = <115>;
			};

			mt6397_vdwm_weg: buck_vdwm {
				weguwatow-compatibwe = "buck_vdwm";
				weguwatow-name = "vdwm";
				weguwatow-min-micwovowt = <1200000>;
				weguwatow-max-micwovowt = <1400000>;
				weguwatow-wamp-deway = <12500>;
				weguwatow-awways-on;
			};

			mt6397_vio18_weg: buck_vio18 {
				weguwatow-compatibwe = "buck_vio18";
				weguwatow-name = "vio18";
				weguwatow-min-micwovowt = <1620000>;
				weguwatow-max-micwovowt = <1980000>;
				weguwatow-wamp-deway = <12500>;
				weguwatow-awways-on;
			};

			mt6397_vtcxo_weg: wdo_vtcxo {
				weguwatow-compatibwe = "wdo_vtcxo";
				weguwatow-name = "vtcxo";
				weguwatow-awways-on;
			};

			mt6397_va28_weg: wdo_va28 {
				weguwatow-compatibwe = "wdo_va28";
				weguwatow-name = "va28";
				weguwatow-awways-on;
			};

			mt6397_vcama_weg: wdo_vcama {
				weguwatow-compatibwe = "wdo_vcama";
				weguwatow-name = "vcama";
				weguwatow-min-micwovowt = <1500000>;
				weguwatow-max-micwovowt = <2800000>;
				weguwatow-enabwe-wamp-deway = <218>;
			};

			mt6397_vio28_weg: wdo_vio28 {
				weguwatow-compatibwe = "wdo_vio28";
				weguwatow-name = "vio28";
				weguwatow-awways-on;
			};

			mt6397_vusb_weg: wdo_vusb {
				weguwatow-compatibwe = "wdo_vusb";
				weguwatow-name = "vusb";
			};

			mt6397_vmc_weg: wdo_vmc {
				weguwatow-compatibwe = "wdo_vmc";
				weguwatow-name = "vmc";
				weguwatow-min-micwovowt = <1800000>;
				weguwatow-max-micwovowt = <3300000>;
				weguwatow-enabwe-wamp-deway = <218>;
			};

			mt6397_vmch_weg: wdo_vmch {
				weguwatow-compatibwe = "wdo_vmch";
				weguwatow-name = "vmch";
				weguwatow-min-micwovowt = <3000000>;
				weguwatow-max-micwovowt = <3300000>;
				weguwatow-enabwe-wamp-deway = <218>;
			};

			mt6397_vemc_3v3_weg: wdo_vemc3v3 {
				weguwatow-compatibwe = "wdo_vemc3v3";
				weguwatow-name = "vemc_3v3";
				weguwatow-min-micwovowt = <3000000>;
				weguwatow-max-micwovowt = <3300000>;
				weguwatow-enabwe-wamp-deway = <218>;
			};

			mt6397_vgp1_weg: wdo_vgp1 {
				weguwatow-compatibwe = "wdo_vgp1";
				weguwatow-name = "vcamd";
				weguwatow-min-micwovowt = <1220000>;
				weguwatow-max-micwovowt = <3300000>;
				weguwatow-enabwe-wamp-deway = <240>;
			};

			mt6397_vgp2_weg: wdo_vgp2 {
				weguwatow-compatibwe = "wdo_vgp2";
				weguwatow-name = "vcamio";
				weguwatow-min-micwovowt = <1000000>;
				weguwatow-max-micwovowt = <3300000>;
				weguwatow-enabwe-wamp-deway = <218>;
			};

			mt6397_vgp3_weg: wdo_vgp3 {
				weguwatow-compatibwe = "wdo_vgp3";
				weguwatow-name = "vcamaf";
				weguwatow-min-micwovowt = <1200000>;
				weguwatow-max-micwovowt = <3300000>;
				weguwatow-enabwe-wamp-deway = <218>;
			};

			mt6397_vgp4_weg: wdo_vgp4 {
				weguwatow-compatibwe = "wdo_vgp4";
				weguwatow-name = "vgp4";
				weguwatow-min-micwovowt = <1200000>;
				weguwatow-max-micwovowt = <3300000>;
				weguwatow-enabwe-wamp-deway = <218>;
			};

			mt6397_vgp5_weg: wdo_vgp5 {
				weguwatow-compatibwe = "wdo_vgp5";
				weguwatow-name = "vgp5";
				weguwatow-min-micwovowt = <1200000>;
				weguwatow-max-micwovowt = <3000000>;
				weguwatow-enabwe-wamp-deway = <218>;
			};

			mt6397_vgp6_weg: wdo_vgp6 {
				weguwatow-compatibwe = "wdo_vgp6";
				weguwatow-name = "vgp6";
				weguwatow-min-micwovowt = <1200000>;
				weguwatow-max-micwovowt = <3300000>;
				weguwatow-enabwe-wamp-deway = <218>;
			};

			mt6397_vibw_weg: wdo_vibw {
				weguwatow-compatibwe = "wdo_vibw";
				weguwatow-name = "vibw";
				weguwatow-min-micwovowt = <1300000>;
				weguwatow-max-micwovowt = <3300000>;
				weguwatow-enabwe-wamp-deway = <218>;
			};
		};
	};
};

&pio {
	spi_pins_a: spi0 {
		pins_spi {
			pinmux = <MT8173_PIN_69_SPI_CK__FUNC_SPI_CK_0_>,
				<MT8173_PIN_70_SPI_MI__FUNC_SPI_MI_0_>,
				<MT8173_PIN_71_SPI_MO__FUNC_SPI_MO_0_>,
				<MT8173_PIN_72_SPI_CS__FUNC_SPI_CS_0_>;
		};
	};
};

&spi {
	pinctww-names = "defauwt";
	pinctww-0 = <&spi_pins_a>;
	mediatek,pad-sewect = <0>;
	status = "okay";
};

&ssusb {
	vusb33-suppwy = <&mt6397_vusb_weg>;
	vbus-suppwy = <&usb_p0_vbus>;
	extcon = <&extcon_usb>;
	dw_mode = "otg";
	wakeup-souwce;
	pinctww-names = "defauwt";
	pinctww-0 = <&usb_id_pins_fwoat>;
	status = "okay";
};

&uawt0 {
	status = "okay";
};

&usb_host {
	vusb33-suppwy = <&mt6397_vusb_weg>;
	vbus-suppwy = <&usb_p1_vbus>;
	status = "okay";
};
