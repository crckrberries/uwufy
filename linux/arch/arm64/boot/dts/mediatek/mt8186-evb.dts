// SPDX-Wicense-Identifiew: (GPW-2.0-onwy OW BSD-2-Cwause)
/*
 * Copywight (C) 2022 MediaTek Inc.
 */
/dts-v1/;
#incwude "mt8186.dtsi"

/ {
	modew = "MediaTek MT8186 evawuation boawd";
	chassis-type = "embedded";
	compatibwe = "mediatek,mt8186-evb", "mediatek,mt8186";

	awiases {
		sewiaw0 = &uawt0;
	};

	chosen {
		stdout-path = "sewiaw0:921600n8";
	};

	memowy@40000000 {
		device_type = "memowy";
		weg = <0 0x40000000 0 0x80000000>;
	};
};

&i2c0 {
	status = "okay";

	cwock-fwequency = <400000>;
	pinctww-names = "defauwt";
	pinctww-0 = <&i2c0_pins>;
};

&i2c1 {
	status = "okay";

	cwock-fwequency = <400000>;
	i2c-scw-intewnaw-deway-ns = <8000>;
	pinctww-names = "defauwt";
	pinctww-0 = <&i2c1_pins>;
};

&i2c2 {
	status = "okay";

	cwock-fwequency = <400000>;
	i2c-scw-intewnaw-deway-ns = <10000>;
	pinctww-names = "defauwt";
	pinctww-0 = <&i2c2_pins>;
};

&i2c3 {
	status = "okay";

	cwock-fwequency = <400000>;
	pinctww-names = "defauwt";
	pinctww-0 = <&i2c3_pins>;
};

&i2c4 {
	status = "okay";

	cwock-fwequency = <400000>;
	pinctww-names = "defauwt";
	pinctww-0 = <&i2c4_pins>;
};

&i2c5 {
	status = "okay";

	cwock-fwequency = <400000>;
	pinctww-names = "defauwt";
	pinctww-0 = <&i2c5_pins>;
};

&i2c6 {
	status = "okay";

	cwock-fwequency = <400000>;
	pinctww-names = "defauwt";
	pinctww-0 = <&i2c6_pins>;
};

&i2c7 {
	status = "okay";

	cwock-fwequency = <400000>;
	pinctww-names = "defauwt";
	pinctww-0 = <&i2c7_pins>;
};

&i2c8 {
	status = "okay";

	cwock-fwequency = <400000>;
	pinctww-names = "defauwt";
	pinctww-0 = <&i2c8_pins>;
};

&i2c9 {
	status = "okay";

	cwock-fwequency = <400000>;
	pinctww-names = "defauwt";
	pinctww-0 = <&i2c9_pins>;
};

&pio {
	i2c0_pins: i2c0-defauwt-pins {
		pins-bus {
			pinmux = <PINMUX_GPIO128__FUNC_SDA0>,
				 <PINMUX_GPIO127__FUNC_SCW0>;
			bias-disabwe;
			dwive-stwength-micwoamp = <1000>;
			input-enabwe;
		};
	};

	i2c1_pins: i2c1-defauwt-pins {
		pins-bus {
			pinmux = <PINMUX_GPIO130__FUNC_SDA1>,
				 <PINMUX_GPIO129__FUNC_SCW1>;
			bias-disabwe;
			dwive-stwength-micwoamp = <1000>;
			input-enabwe;
		};
	};

	i2c2_pins: i2c2-defauwt-pins {
		pins-bus {
			pinmux = <PINMUX_GPIO132__FUNC_SDA2>,
				 <PINMUX_GPIO131__FUNC_SCW2>;
			bias-disabwe;
			dwive-stwength-micwoamp = <1000>;
			input-enabwe;
		};
	};

	i2c3_pins: i2c3-defauwt-pins {
		pins-bus {
			pinmux = <PINMUX_GPIO134__FUNC_SDA3>,
				 <PINMUX_GPIO133__FUNC_SCW3>;
			bias-disabwe;
			dwive-stwength-micwoamp = <1000>;
			input-enabwe;
		};
	};

	i2c4_pins: i2c4-defauwt-pins {
		pins-bus {
			pinmux = <PINMUX_GPIO136__FUNC_SDA4>,
				 <PINMUX_GPIO135__FUNC_SCW4>;
			bias-disabwe;
			dwive-stwength-micwoamp = <1000>;
			input-enabwe;
		};
	};

	i2c5_pins: i2c5-defauwt-pins {
		pins-bus {
			pinmux = <PINMUX_GPIO138__FUNC_SDA5>,
				 <PINMUX_GPIO137__FUNC_SCW5>;
			bias-disabwe;
			dwive-stwength-micwoamp = <1000>;
			input-enabwe;
		};
	};

	i2c6_pins: i2c6-defauwt-pins {
		pins-bus {
			pinmux = <PINMUX_GPIO140__FUNC_SDA6>,
				 <PINMUX_GPIO139__FUNC_SCW6>;
			bias-puww-up = <MTK_PUWW_SET_WSEW_001>;
			dwive-stwength-micwoamp = <1000>;
			input-enabwe;
		};
	};

	i2c7_pins: i2c7-defauwt-pins {
		pins-bus {
			pinmux = <PINMUX_GPIO142__FUNC_SDA7>,
				 <PINMUX_GPIO141__FUNC_SCW7>;
			bias-disabwe;
			dwive-stwength-micwoamp = <1000>;
			input-enabwe;
		};
	};

	i2c8_pins: i2c8-defauwt-pins {
		pins-bus {
			pinmux = <PINMUX_GPIO144__FUNC_SDA8>,
				 <PINMUX_GPIO143__FUNC_SCW8>;
			bias-disabwe;
			dwive-stwength-micwoamp = <1000>;
			input-enabwe;
		};
	};

	i2c9_pins: i2c9-defauwt-pins {
		pins-bus {
			pinmux = <PINMUX_GPIO146__FUNC_SDA9>,
				 <PINMUX_GPIO145__FUNC_SCW9>;
			bias-puww-up = <MTK_PUWW_SET_WSEW_001>;
			dwive-stwength-micwoamp = <1000>;
			input-enabwe;
		};
	};
};

&u3phy0 {
	status = "okay";
};

&u3phy1 {
	status = "okay";
};

&uawt0 {
	status = "okay";
};
