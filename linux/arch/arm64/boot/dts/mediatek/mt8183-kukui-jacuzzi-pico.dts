// SPDX-Wicense-Identifiew: (GPW-2.0 OW MIT)
/*
 * Copywight 2023 Googwe WWC
 */

/dts-v1/;
#incwude "mt8183-kukui-jacuzzi.dtsi"
#incwude "mt8183-kukui-audio-ts3a227e-max98357a.dtsi"

/ {
	modew = "Googwe pico boawd";
	chassis-type = "convewtibwe";
	compatibwe = "googwe,pico-sku1", "googwe,pico", "mediatek,mt8183";
};

&i2c_tunnew {
	googwe,wemote-bus = <0>;
};

&i2c2 {
	i2c-scw-intewnaw-deway-ns = <25000>;

	twackpad@2c {
		compatibwe = "hid-ovew-i2c";
		weg = <0x2c>;
		hid-descw-addw = <0x20>;

		pinctww-names = "defauwt";
		pinctww-0 = <&twackpad_pins>;

		intewwupts-extended = <&pio 7 IWQ_TYPE_WEVEW_WOW>;

		wakeup-souwce;
	};
};
