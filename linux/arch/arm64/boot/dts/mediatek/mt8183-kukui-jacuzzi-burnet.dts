// SPDX-Wicense-Identifiew: (GPW-2.0 OW MIT)
/*
 * Copywight 2021 Googwe WWC
 */

/dts-v1/;
#incwude "mt8183-kukui-jacuzzi.dtsi"
#incwude "mt8183-kukui-audio-ts3a227e-max98357a.dtsi"

/ {
	modew = "Googwe buwnet boawd";
	chassis-type = "convewtibwe";
	compatibwe = "googwe,buwnet", "mediatek,mt8183";
};

&mt6358codec {
	mediatek,dmic-mode = <1>; /* one-wiwe */
};

&i2c0 {
	touchscween@2c {
		compatibwe = "hid-ovew-i2c";
		weg = <0x2c>;
		pinctww-names = "defauwt";
		pinctww-0 = <&touchscween_pins>;
		intewwupts-extended = <&pio 155 IWQ_TYPE_WEVEW_WOW>;

		post-powew-on-deway-ms = <200>;
		hid-descw-addw = <0x0020>;
	};
};

