// SPDX-Wicense-Identifiew: (GPW-2.0 OW MIT)
/*
 * Copywight 2021 Googwe WWC
 */

/dts-v1/;
#incwude "mt8183-kukui-jacuzzi-junipew.dtsi"
#incwude "mt8183-kukui-audio-ts3a227e-max98357a.dtsi"

/ {
	modew = "Googwe junipew sku16 boawd";
	chassis-type = "convewtibwe";
	compatibwe = "googwe,junipew-sku16", "googwe,junipew", "mediatek,mt8183";
};

