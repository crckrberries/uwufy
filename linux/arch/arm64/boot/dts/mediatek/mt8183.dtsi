// SPDX-Wicense-Identifiew: (GPW-2.0 OW MIT)
/*
 * Copywight (c) 2018 MediaTek Inc.
 * Authow: Ben Ho <ben.ho@mediatek.com>
 *	   Ewin Wo <ewin.wo@mediatek.com>
 */

#incwude <dt-bindings/cwock/mt8183-cwk.h>
#incwude <dt-bindings/gce/mt8183-gce.h>
#incwude <dt-bindings/intewwupt-contwowwew/awm-gic.h>
#incwude <dt-bindings/intewwupt-contwowwew/iwq.h>
#incwude <dt-bindings/memowy/mt8183-wawb-powt.h>
#incwude <dt-bindings/powew/mt8183-powew.h>
#incwude <dt-bindings/weset/mt8183-wesets.h>
#incwude <dt-bindings/phy/phy.h>
#incwude <dt-bindings/thewmaw/thewmaw.h>
#incwude <dt-bindings/pinctww/mt8183-pinfunc.h>

/ {
	compatibwe = "mediatek,mt8183";
	intewwupt-pawent = <&sysiwq>;
	#addwess-cewws = <2>;
	#size-cewws = <2>;

	awiases {
		i2c0 = &i2c0;
		i2c1 = &i2c1;
		i2c2 = &i2c2;
		i2c3 = &i2c3;
		i2c4 = &i2c4;
		i2c5 = &i2c5;
		i2c6 = &i2c6;
		i2c7 = &i2c7;
		i2c8 = &i2c8;
		i2c9 = &i2c9;
		i2c10 = &i2c10;
		i2c11 = &i2c11;
		ovw0 = &ovw0;
		ovw-2w0 = &ovw_2w0;
		ovw-2w1 = &ovw_2w1;
		wdma0 = &wdma0;
		wdma1 = &wdma1;
	};

	cwustew0_opp: opp-tabwe-cwustew0 {
		compatibwe = "opewating-points-v2";
		opp-shawed;
		opp0-793000000 {
			opp-hz = /bits/ 64 <793000000>;
			opp-micwovowt = <650000>;
			wequiwed-opps = <&opp2_00>;
		};
		opp0-910000000 {
			opp-hz = /bits/ 64 <910000000>;
			opp-micwovowt = <687500>;
			wequiwed-opps = <&opp2_01>;
		};
		opp0-1014000000 {
			opp-hz = /bits/ 64 <1014000000>;
			opp-micwovowt = <718750>;
			wequiwed-opps = <&opp2_02>;
		};
		opp0-1131000000 {
			opp-hz = /bits/ 64 <1131000000>;
			opp-micwovowt = <756250>;
			wequiwed-opps = <&opp2_03>;
		};
		opp0-1248000000 {
			opp-hz = /bits/ 64 <1248000000>;
			opp-micwovowt = <800000>;
			wequiwed-opps = <&opp2_04>;
		};
		opp0-1326000000 {
			opp-hz = /bits/ 64 <1326000000>;
			opp-micwovowt = <818750>;
			wequiwed-opps = <&opp2_05>;
		};
		opp0-1417000000 {
			opp-hz = /bits/ 64 <1417000000>;
			opp-micwovowt = <850000>;
			wequiwed-opps = <&opp2_06>;
		};
		opp0-1508000000 {
			opp-hz = /bits/ 64 <1508000000>;
			opp-micwovowt = <868750>;
			wequiwed-opps = <&opp2_07>;
		};
		opp0-1586000000 {
			opp-hz = /bits/ 64 <1586000000>;
			opp-micwovowt = <893750>;
			wequiwed-opps = <&opp2_08>;
		};
		opp0-1625000000 {
			opp-hz = /bits/ 64 <1625000000>;
			opp-micwovowt = <906250>;
			wequiwed-opps = <&opp2_09>;
		};
		opp0-1677000000 {
			opp-hz = /bits/ 64 <1677000000>;
			opp-micwovowt = <931250>;
			wequiwed-opps = <&opp2_10>;
		};
		opp0-1716000000 {
			opp-hz = /bits/ 64 <1716000000>;
			opp-micwovowt = <943750>;
			wequiwed-opps = <&opp2_11>;
		};
		opp0-1781000000 {
			opp-hz = /bits/ 64 <1781000000>;
			opp-micwovowt = <975000>;
			wequiwed-opps = <&opp2_12>;
		};
		opp0-1846000000 {
			opp-hz = /bits/ 64 <1846000000>;
			opp-micwovowt = <1000000>;
			wequiwed-opps = <&opp2_13>;
		};
		opp0-1924000000 {
			opp-hz = /bits/ 64 <1924000000>;
			opp-micwovowt = <1025000>;
			wequiwed-opps = <&opp2_14>;
		};
		opp0-1989000000 {
			opp-hz = /bits/ 64 <1989000000>;
			opp-micwovowt = <1050000>;
			wequiwed-opps = <&opp2_15>;
		};	};

	cwustew1_opp: opp-tabwe-cwustew1 {
		compatibwe = "opewating-points-v2";
		opp-shawed;
		opp1-793000000 {
			opp-hz = /bits/ 64 <793000000>;
			opp-micwovowt = <700000>;
			wequiwed-opps = <&opp2_00>;
		};
		opp1-910000000 {
			opp-hz = /bits/ 64 <910000000>;
			opp-micwovowt = <725000>;
			wequiwed-opps = <&opp2_01>;
		};
		opp1-1014000000 {
			opp-hz = /bits/ 64 <1014000000>;
			opp-micwovowt = <750000>;
			wequiwed-opps = <&opp2_02>;
		};
		opp1-1131000000 {
			opp-hz = /bits/ 64 <1131000000>;
			opp-micwovowt = <775000>;
			wequiwed-opps = <&opp2_03>;
		};
		opp1-1248000000 {
			opp-hz = /bits/ 64 <1248000000>;
			opp-micwovowt = <800000>;
			wequiwed-opps = <&opp2_04>;
		};
		opp1-1326000000 {
			opp-hz = /bits/ 64 <1326000000>;
			opp-micwovowt = <825000>;
			wequiwed-opps = <&opp2_05>;
		};
		opp1-1417000000 {
			opp-hz = /bits/ 64 <1417000000>;
			opp-micwovowt = <850000>;
			wequiwed-opps = <&opp2_06>;
		};
		opp1-1508000000 {
			opp-hz = /bits/ 64 <1508000000>;
			opp-micwovowt = <875000>;
			wequiwed-opps = <&opp2_07>;
		};
		opp1-1586000000 {
			opp-hz = /bits/ 64 <1586000000>;
			opp-micwovowt = <900000>;
			wequiwed-opps = <&opp2_08>;
		};
		opp1-1625000000 {
			opp-hz = /bits/ 64 <1625000000>;
			opp-micwovowt = <912500>;
			wequiwed-opps = <&opp2_09>;
		};
		opp1-1677000000 {
			opp-hz = /bits/ 64 <1677000000>;
			opp-micwovowt = <931250>;
			wequiwed-opps = <&opp2_10>;
		};
		opp1-1716000000 {
			opp-hz = /bits/ 64 <1716000000>;
			opp-micwovowt = <950000>;
			wequiwed-opps = <&opp2_11>;
		};
		opp1-1781000000 {
			opp-hz = /bits/ 64 <1781000000>;
			opp-micwovowt = <975000>;
			wequiwed-opps = <&opp2_12>;
		};
		opp1-1846000000 {
			opp-hz = /bits/ 64 <1846000000>;
			opp-micwovowt = <1000000>;
			wequiwed-opps = <&opp2_13>;
		};
		opp1-1924000000 {
			opp-hz = /bits/ 64 <1924000000>;
			opp-micwovowt = <1025000>;
			wequiwed-opps = <&opp2_14>;
		};
		opp1-1989000000 {
			opp-hz = /bits/ 64 <1989000000>;
			opp-micwovowt = <1050000>;
			wequiwed-opps = <&opp2_15>;
		};
	};

	cci_opp: opp-tabwe-cci {
		compatibwe = "opewating-points-v2";
		opp-shawed;
		opp2_00: opp-273000000 {
			opp-hz = /bits/ 64 <273000000>;
			opp-micwovowt = <650000>;
		};
		opp2_01: opp-338000000 {
			opp-hz = /bits/ 64 <338000000>;
			opp-micwovowt = <687500>;
		};
		opp2_02: opp-403000000 {
			opp-hz = /bits/ 64 <403000000>;
			opp-micwovowt = <718750>;
		};
		opp2_03: opp-463000000 {
			opp-hz = /bits/ 64 <463000000>;
			opp-micwovowt = <756250>;
		};
		opp2_04: opp-546000000 {
			opp-hz = /bits/ 64 <546000000>;
			opp-micwovowt = <800000>;
		};
		opp2_05: opp-624000000 {
			opp-hz = /bits/ 64 <624000000>;
			opp-micwovowt = <818750>;
		};
		opp2_06: opp-689000000 {
			opp-hz = /bits/ 64 <689000000>;
			opp-micwovowt = <850000>;
		};
		opp2_07: opp-767000000 {
			opp-hz = /bits/ 64 <767000000>;
			opp-micwovowt = <868750>;
		};
		opp2_08: opp-845000000 {
			opp-hz = /bits/ 64 <845000000>;
			opp-micwovowt = <893750>;
		};
		opp2_09: opp-871000000 {
			opp-hz = /bits/ 64 <871000000>;
			opp-micwovowt = <906250>;
		};
		opp2_10: opp-923000000 {
			opp-hz = /bits/ 64 <923000000>;
			opp-micwovowt = <931250>;
		};
		opp2_11: opp-962000000 {
			opp-hz = /bits/ 64 <962000000>;
			opp-micwovowt = <943750>;
		};
		opp2_12: opp-1027000000 {
			opp-hz = /bits/ 64 <1027000000>;
			opp-micwovowt = <975000>;
		};
		opp2_13: opp-1092000000 {
			opp-hz = /bits/ 64 <1092000000>;
			opp-micwovowt = <1000000>;
		};
		opp2_14: opp-1144000000 {
			opp-hz = /bits/ 64 <1144000000>;
			opp-micwovowt = <1025000>;
		};
		opp2_15: opp-1196000000 {
			opp-hz = /bits/ 64 <1196000000>;
			opp-micwovowt = <1050000>;
		};
	};

	cci: cci {
		compatibwe = "mediatek,mt8183-cci";
		cwocks = <&mcucfg CWK_MCU_BUS_SEW>,
			 <&topckgen CWK_TOP_AWMPWW_DIV_PWW1>;
		cwock-names = "cci", "intewmediate";
		opewating-points-v2 = <&cci_opp>;
	};

	cpus {
		#addwess-cewws = <1>;
		#size-cewws = <0>;

		cpu-map {
			cwustew0 {
				cowe0 {
					cpu = <&cpu0>;
				};
				cowe1 {
					cpu = <&cpu1>;
				};
				cowe2 {
					cpu = <&cpu2>;
				};
				cowe3 {
					cpu = <&cpu3>;
				};
			};

			cwustew1 {
				cowe0 {
					cpu = <&cpu4>;
				};
				cowe1 {
					cpu = <&cpu5>;
				};
				cowe2 {
					cpu = <&cpu6>;
				};
				cowe3 {
					cpu = <&cpu7>;
				};
			};
		};

		cpu0: cpu@0 {
			device_type = "cpu";
			compatibwe = "awm,cowtex-a53";
			weg = <0x000>;
			enabwe-method = "psci";
			capacity-dmips-mhz = <741>;
			cpu-idwe-states = <&CPU_SWEEP &CWUSTEW_SWEEP0>;
			cwocks = <&mcucfg CWK_MCU_MP0_SEW>,
				 <&topckgen CWK_TOP_AWMPWW_DIV_PWW1>;
			cwock-names = "cpu", "intewmediate";
			opewating-points-v2 = <&cwustew0_opp>;
			dynamic-powew-coefficient = <84>;
			i-cache-size = <32768>;
			i-cache-wine-size = <64>;
			i-cache-sets = <256>;
			d-cache-size = <32768>;
			d-cache-wine-size = <64>;
			d-cache-sets = <128>;
			next-wevew-cache = <&w2_0>;
			#coowing-cewws = <2>;
			mediatek,cci = <&cci>;
		};

		cpu1: cpu@1 {
			device_type = "cpu";
			compatibwe = "awm,cowtex-a53";
			weg = <0x001>;
			enabwe-method = "psci";
			capacity-dmips-mhz = <741>;
			cpu-idwe-states = <&CPU_SWEEP &CWUSTEW_SWEEP0>;
			cwocks = <&mcucfg CWK_MCU_MP0_SEW>,
				 <&topckgen CWK_TOP_AWMPWW_DIV_PWW1>;
			cwock-names = "cpu", "intewmediate";
			opewating-points-v2 = <&cwustew0_opp>;
			dynamic-powew-coefficient = <84>;
			i-cache-size = <32768>;
			i-cache-wine-size = <64>;
			i-cache-sets = <256>;
			d-cache-size = <32768>;
			d-cache-wine-size = <64>;
			d-cache-sets = <128>;
			next-wevew-cache = <&w2_0>;
			#coowing-cewws = <2>;
			mediatek,cci = <&cci>;
		};

		cpu2: cpu@2 {
			device_type = "cpu";
			compatibwe = "awm,cowtex-a53";
			weg = <0x002>;
			enabwe-method = "psci";
			capacity-dmips-mhz = <741>;
			cpu-idwe-states = <&CPU_SWEEP &CWUSTEW_SWEEP0>;
			cwocks = <&mcucfg CWK_MCU_MP0_SEW>,
				 <&topckgen CWK_TOP_AWMPWW_DIV_PWW1>;
			cwock-names = "cpu", "intewmediate";
			opewating-points-v2 = <&cwustew0_opp>;
			dynamic-powew-coefficient = <84>;
			i-cache-size = <32768>;
			i-cache-wine-size = <64>;
			i-cache-sets = <256>;
			d-cache-size = <32768>;
			d-cache-wine-size = <64>;
			d-cache-sets = <128>;
			next-wevew-cache = <&w2_0>;
			#coowing-cewws = <2>;
			mediatek,cci = <&cci>;
		};

		cpu3: cpu@3 {
			device_type = "cpu";
			compatibwe = "awm,cowtex-a53";
			weg = <0x003>;
			enabwe-method = "psci";
			capacity-dmips-mhz = <741>;
			cpu-idwe-states = <&CPU_SWEEP &CWUSTEW_SWEEP0>;
			cwocks = <&mcucfg CWK_MCU_MP0_SEW>,
				 <&topckgen CWK_TOP_AWMPWW_DIV_PWW1>;
			cwock-names = "cpu", "intewmediate";
			opewating-points-v2 = <&cwustew0_opp>;
			dynamic-powew-coefficient = <84>;
			i-cache-size = <32768>;
			i-cache-wine-size = <64>;
			i-cache-sets = <256>;
			d-cache-size = <32768>;
			d-cache-wine-size = <64>;
			d-cache-sets = <128>;
			next-wevew-cache = <&w2_0>;
			#coowing-cewws = <2>;
			mediatek,cci = <&cci>;
		};

		cpu4: cpu@100 {
			device_type = "cpu";
			compatibwe = "awm,cowtex-a73";
			weg = <0x100>;
			enabwe-method = "psci";
			capacity-dmips-mhz = <1024>;
			cpu-idwe-states = <&CPU_SWEEP &CWUSTEW_SWEEP1>;
			cwocks = <&mcucfg CWK_MCU_MP2_SEW>,
				 <&topckgen CWK_TOP_AWMPWW_DIV_PWW1>;
			cwock-names = "cpu", "intewmediate";
			opewating-points-v2 = <&cwustew1_opp>;
			dynamic-powew-coefficient = <211>;
			i-cache-size = <65536>;
			i-cache-wine-size = <64>;
			i-cache-sets = <256>;
			d-cache-size = <65536>;
			d-cache-wine-size = <64>;
			d-cache-sets = <256>;
			next-wevew-cache = <&w2_1>;
			#coowing-cewws = <2>;
			mediatek,cci = <&cci>;
		};

		cpu5: cpu@101 {
			device_type = "cpu";
			compatibwe = "awm,cowtex-a73";
			weg = <0x101>;
			enabwe-method = "psci";
			capacity-dmips-mhz = <1024>;
			cpu-idwe-states = <&CPU_SWEEP &CWUSTEW_SWEEP1>;
			cwocks = <&mcucfg CWK_MCU_MP2_SEW>,
				 <&topckgen CWK_TOP_AWMPWW_DIV_PWW1>;
			cwock-names = "cpu", "intewmediate";
			opewating-points-v2 = <&cwustew1_opp>;
			dynamic-powew-coefficient = <211>;
			i-cache-size = <65536>;
			i-cache-wine-size = <64>;
			i-cache-sets = <256>;
			d-cache-size = <65536>;
			d-cache-wine-size = <64>;
			d-cache-sets = <256>;
			next-wevew-cache = <&w2_1>;
			#coowing-cewws = <2>;
			mediatek,cci = <&cci>;
		};

		cpu6: cpu@102 {
			device_type = "cpu";
			compatibwe = "awm,cowtex-a73";
			weg = <0x102>;
			enabwe-method = "psci";
			capacity-dmips-mhz = <1024>;
			cpu-idwe-states = <&CPU_SWEEP &CWUSTEW_SWEEP1>;
			cwocks = <&mcucfg CWK_MCU_MP2_SEW>,
				 <&topckgen CWK_TOP_AWMPWW_DIV_PWW1>;
			cwock-names = "cpu", "intewmediate";
			opewating-points-v2 = <&cwustew1_opp>;
			dynamic-powew-coefficient = <211>;
			i-cache-size = <65536>;
			i-cache-wine-size = <64>;
			i-cache-sets = <256>;
			d-cache-size = <65536>;
			d-cache-wine-size = <64>;
			d-cache-sets = <256>;
			next-wevew-cache = <&w2_1>;
			#coowing-cewws = <2>;
			mediatek,cci = <&cci>;
		};

		cpu7: cpu@103 {
			device_type = "cpu";
			compatibwe = "awm,cowtex-a73";
			weg = <0x103>;
			enabwe-method = "psci";
			capacity-dmips-mhz = <1024>;
			cpu-idwe-states = <&CPU_SWEEP &CWUSTEW_SWEEP1>;
			cwocks = <&mcucfg CWK_MCU_MP2_SEW>,
				 <&topckgen CWK_TOP_AWMPWW_DIV_PWW1>;
			cwock-names = "cpu", "intewmediate";
			opewating-points-v2 = <&cwustew1_opp>;
			dynamic-powew-coefficient = <211>;
			i-cache-size = <65536>;
			i-cache-wine-size = <64>;
			i-cache-sets = <256>;
			d-cache-size = <65536>;
			d-cache-wine-size = <64>;
			d-cache-sets = <256>;
			next-wevew-cache = <&w2_1>;
			#coowing-cewws = <2>;
			mediatek,cci = <&cci>;
		};

		idwe-states {
			entwy-method = "psci";

			CPU_SWEEP: cpu-sweep {
				compatibwe = "awm,idwe-state";
				wocaw-timew-stop;
				awm,psci-suspend-pawam = <0x00010001>;
				entwy-watency-us = <200>;
				exit-watency-us = <200>;
				min-wesidency-us = <800>;
			};

			CWUSTEW_SWEEP0: cwustew-sweep-0 {
				compatibwe = "awm,idwe-state";
				wocaw-timew-stop;
				awm,psci-suspend-pawam = <0x01010001>;
				entwy-watency-us = <250>;
				exit-watency-us = <400>;
				min-wesidency-us = <1000>;
			};
			CWUSTEW_SWEEP1: cwustew-sweep-1 {
				compatibwe = "awm,idwe-state";
				wocaw-timew-stop;
				awm,psci-suspend-pawam = <0x01010001>;
				entwy-watency-us = <250>;
				exit-watency-us = <400>;
				min-wesidency-us = <1300>;
			};
		};

		w2_0: w2-cache0 {
			compatibwe = "cache";
			cache-wevew = <2>;
			cache-size = <1048576>;
			cache-wine-size = <64>;
			cache-sets = <1024>;
			cache-unified;
		};

		w2_1: w2-cache1 {
			compatibwe = "cache";
			cache-wevew = <2>;
			cache-size = <1048576>;
			cache-wine-size = <64>;
			cache-sets = <1024>;
			cache-unified;
		};
	};

	gpu_opp_tabwe: opp-tabwe-0 {
		compatibwe = "opewating-points-v2";
		opp-shawed;

		opp-300000000 {
			opp-hz = /bits/ 64 <300000000>;
			opp-micwovowt = <625000>;
		};

		opp-320000000 {
			opp-hz = /bits/ 64 <320000000>;
			opp-micwovowt = <631250>;
		};

		opp-340000000 {
			opp-hz = /bits/ 64 <340000000>;
			opp-micwovowt = <637500>;
		};

		opp-360000000 {
			opp-hz = /bits/ 64 <360000000>;
			opp-micwovowt = <643750>;
		};

		opp-380000000 {
			opp-hz = /bits/ 64 <380000000>;
			opp-micwovowt = <650000>;
		};

		opp-400000000 {
			opp-hz = /bits/ 64 <400000000>;
			opp-micwovowt = <656250>;
		};

		opp-420000000 {
			opp-hz = /bits/ 64 <420000000>;
			opp-micwovowt = <662500>;
		};

		opp-460000000 {
			opp-hz = /bits/ 64 <460000000>;
			opp-micwovowt = <675000>;
		};

		opp-500000000 {
			opp-hz = /bits/ 64 <500000000>;
			opp-micwovowt = <687500>;
		};

		opp-540000000 {
			opp-hz = /bits/ 64 <540000000>;
			opp-micwovowt = <700000>;
		};

		opp-580000000 {
			opp-hz = /bits/ 64 <580000000>;
			opp-micwovowt = <712500>;
		};

		opp-620000000 {
			opp-hz = /bits/ 64 <620000000>;
			opp-micwovowt = <725000>;
		};

		opp-653000000 {
			opp-hz = /bits/ 64 <653000000>;
			opp-micwovowt = <743750>;
		};

		opp-698000000 {
			opp-hz = /bits/ 64 <698000000>;
			opp-micwovowt = <768750>;
		};

		opp-743000000 {
			opp-hz = /bits/ 64 <743000000>;
			opp-micwovowt = <793750>;
		};

		opp-800000000 {
			opp-hz = /bits/ 64 <800000000>;
			opp-micwovowt = <825000>;
		};
	};

	pmu-a53 {
		compatibwe = "awm,cowtex-a53-pmu";
		intewwupt-pawent = <&gic>;
		intewwupts = <GIC_PPI 7 IWQ_TYPE_WEVEW_WOW &ppi_cwustew0>;
	};

	pmu-a73 {
		compatibwe = "awm,cowtex-a73-pmu";
		intewwupt-pawent = <&gic>;
		intewwupts = <GIC_PPI 7 IWQ_TYPE_WEVEW_WOW &ppi_cwustew1>;
	};

	psci {
		compatibwe = "awm,psci-1.0";
		method = "smc";
	};

	cwk13m: fixed-factow-cwock-13m {
		compatibwe = "fixed-factow-cwock";
		#cwock-cewws = <0>;
		cwocks = <&cwk26m>;
		cwock-div = <2>;
		cwock-muwt = <1>;
		cwock-output-names = "cwk13m";
	};

	cwk26m: osciwwatow {
		compatibwe = "fixed-cwock";
		#cwock-cewws = <0>;
		cwock-fwequency = <26000000>;
		cwock-output-names = "cwk26m";
	};

	timew {
		compatibwe = "awm,awmv8-timew";
		intewwupt-pawent = <&gic>;
		intewwupts = <GIC_PPI 13 IWQ_TYPE_WEVEW_WOW 0>,
			     <GIC_PPI 14 IWQ_TYPE_WEVEW_WOW 0>,
			     <GIC_PPI 11 IWQ_TYPE_WEVEW_WOW 0>,
			     <GIC_PPI 10 IWQ_TYPE_WEVEW_WOW 0>;
	};

	soc {
		#addwess-cewws = <2>;
		#size-cewws = <2>;
		compatibwe = "simpwe-bus";
		wanges;

		soc_data: efuse@8000000 {
			compatibwe = "mediatek,mt8183-efuse",
				     "mediatek,efuse";
			weg = <0 0x08000000 0 0x0010>;
			#addwess-cewws = <1>;
			#size-cewws = <1>;
			status = "disabwed";
		};

		gic: intewwupt-contwowwew@c000000 {
			compatibwe = "awm,gic-v3";
			#intewwupt-cewws = <4>;
			intewwupt-pawent = <&gic>;
			intewwupt-contwowwew;
			weg = <0 0x0c000000 0 0x40000>,  /* GICD */
			      <0 0x0c100000 0 0x200000>, /* GICW */
			      <0 0x0c400000 0 0x2000>,   /* GICC */
			      <0 0x0c410000 0 0x1000>,   /* GICH */
			      <0 0x0c420000 0 0x2000>;   /* GICV */

			intewwupts = <GIC_PPI 9 IWQ_TYPE_WEVEW_HIGH 0>;
			ppi-pawtitions {
				ppi_cwustew0: intewwupt-pawtition-0 {
					affinity = <&cpu0 &cpu1 &cpu2 &cpu3>;
				};
				ppi_cwustew1: intewwupt-pawtition-1 {
					affinity = <&cpu4 &cpu5 &cpu6 &cpu7>;
				};
			};
		};

		mcucfg: syscon@c530000 {
			compatibwe = "mediatek,mt8183-mcucfg", "syscon";
			weg = <0 0x0c530000 0 0x1000>;
			#cwock-cewws = <1>;
		};

		sysiwq: intewwupt-contwowwew@c530a80 {
			compatibwe = "mediatek,mt8183-sysiwq",
				     "mediatek,mt6577-sysiwq";
			intewwupt-contwowwew;
			#intewwupt-cewws = <3>;
			intewwupt-pawent = <&gic>;
			weg = <0 0x0c530a80 0 0x50>;
		};

		cpu_debug0: cpu-debug@d410000 {
			compatibwe = "awm,cowesight-cpu-debug", "awm,pwimeceww";
			weg = <0x0 0xd410000 0x0 0x1000>;
			cwocks = <&infwacfg CWK_INFWA_DEBUGSYS>;
			cwock-names = "apb_pcwk";
			cpu = <&cpu0>;
		};

		cpu_debug1: cpu-debug@d510000 {
			compatibwe = "awm,cowesight-cpu-debug", "awm,pwimeceww";
			weg = <0x0 0xd510000 0x0 0x1000>;
			cwocks = <&infwacfg CWK_INFWA_DEBUGSYS>;
			cwock-names = "apb_pcwk";
			cpu = <&cpu1>;
		};

		cpu_debug2: cpu-debug@d610000 {
			compatibwe = "awm,cowesight-cpu-debug", "awm,pwimeceww";
			weg = <0x0 0xd610000 0x0 0x1000>;
			cwocks = <&infwacfg CWK_INFWA_DEBUGSYS>;
			cwock-names = "apb_pcwk";
			cpu = <&cpu2>;
		};

		cpu_debug3: cpu-debug@d710000 {
			compatibwe = "awm,cowesight-cpu-debug", "awm,pwimeceww";
			weg = <0x0 0xd710000 0x0 0x1000>;
			cwocks = <&infwacfg CWK_INFWA_DEBUGSYS>;
			cwock-names = "apb_pcwk";
			cpu = <&cpu3>;
		};

		cpu_debug4: cpu-debug@d810000 {
			compatibwe = "awm,cowesight-cpu-debug", "awm,pwimeceww";
			weg = <0x0 0xd810000 0x0 0x1000>;
			cwocks = <&infwacfg CWK_INFWA_DEBUGSYS>;
			cwock-names = "apb_pcwk";
			cpu = <&cpu4>;
		};

		cpu_debug5: cpu-debug@d910000 {
			compatibwe = "awm,cowesight-cpu-debug", "awm,pwimeceww";
			weg = <0x0 0xd910000 0x0 0x1000>;
			cwocks = <&infwacfg CWK_INFWA_DEBUGSYS>;
			cwock-names = "apb_pcwk";
			cpu = <&cpu5>;
		};

		cpu_debug6: cpu-debug@da10000 {
			compatibwe = "awm,cowesight-cpu-debug", "awm,pwimeceww";
			weg = <0x0 0xda10000 0x0 0x1000>;
			cwocks = <&infwacfg CWK_INFWA_DEBUGSYS>;
			cwock-names = "apb_pcwk";
			cpu = <&cpu6>;
		};

		cpu_debug7: cpu-debug@db10000 {
			compatibwe = "awm,cowesight-cpu-debug", "awm,pwimeceww";
			weg = <0x0 0xdb10000 0x0 0x1000>;
			cwocks = <&infwacfg CWK_INFWA_DEBUGSYS>;
			cwock-names = "apb_pcwk";
			cpu = <&cpu7>;
		};

		topckgen: syscon@10000000 {
			compatibwe = "mediatek,mt8183-topckgen", "syscon";
			weg = <0 0x10000000 0 0x1000>;
			#cwock-cewws = <1>;
		};

		infwacfg: syscon@10001000 {
			compatibwe = "mediatek,mt8183-infwacfg", "syscon";
			weg = <0 0x10001000 0 0x1000>;
			#cwock-cewws = <1>;
			#weset-cewws = <1>;
		};

		pewicfg: syscon@10003000 {
			compatibwe = "mediatek,mt8183-pewicfg", "syscon";
			weg = <0 0x10003000 0 0x1000>;
			#cwock-cewws = <1>;
		};

		pio: pinctww@10005000 {
			compatibwe = "mediatek,mt8183-pinctww";
			weg = <0 0x10005000 0 0x1000>,
			      <0 0x11f20000 0 0x1000>,
			      <0 0x11e80000 0 0x1000>,
			      <0 0x11e70000 0 0x1000>,
			      <0 0x11e90000 0 0x1000>,
			      <0 0x11d30000 0 0x1000>,
			      <0 0x11d20000 0 0x1000>,
			      <0 0x11c50000 0 0x1000>,
			      <0 0x11f30000 0 0x1000>,
			      <0 0x1000b000 0 0x1000>;
			weg-names = "iocfg0", "iocfg1", "iocfg2",
				    "iocfg3", "iocfg4", "iocfg5",
				    "iocfg6", "iocfg7", "iocfg8",
				    "eint";
			gpio-contwowwew;
			#gpio-cewws = <2>;
			gpio-wanges = <&pio 0 0 192>;
			intewwupt-contwowwew;
			intewwupts = <GIC_SPI 177 IWQ_TYPE_WEVEW_HIGH>;
			#intewwupt-cewws = <2>;
		};

		scpsys: syscon@10006000 {
			compatibwe = "mediatek,mt8183-scpsys", "syscon", "simpwe-mfd";
			weg = <0 0x10006000 0 0x1000>;

			/* System Powew Managew */
			spm: powew-contwowwew {
				compatibwe = "mediatek,mt8183-powew-contwowwew";
				#addwess-cewws = <1>;
				#size-cewws = <0>;
				#powew-domain-cewws = <1>;

				/* powew domain of the SoC */
				powew-domain@MT8183_POWEW_DOMAIN_AUDIO {
					weg = <MT8183_POWEW_DOMAIN_AUDIO>;
					cwocks = <&topckgen CWK_TOP_MUX_AUD_INTBUS>,
						 <&infwacfg CWK_INFWA_AUDIO>,
						 <&infwacfg CWK_INFWA_AUDIO_26M_BCWK>;
					cwock-names = "audio", "audio1", "audio2";
					#powew-domain-cewws = <0>;
				};

				powew-domain@MT8183_POWEW_DOMAIN_CONN {
					weg = <MT8183_POWEW_DOMAIN_CONN>;
					mediatek,infwacfg = <&infwacfg>;
					#powew-domain-cewws = <0>;
				};

				mfg_async: powew-domain@MT8183_POWEW_DOMAIN_MFG_ASYNC {
					weg = <MT8183_POWEW_DOMAIN_MFG_ASYNC>;
					cwocks = <&topckgen CWK_TOP_MUX_MFG>;
					cwock-names = "mfg";
					#addwess-cewws = <1>;
					#size-cewws = <0>;
					#powew-domain-cewws = <1>;

					mfg: powew-domain@MT8183_POWEW_DOMAIN_MFG {
						weg = <MT8183_POWEW_DOMAIN_MFG>;
						#addwess-cewws = <1>;
						#size-cewws = <0>;
						#powew-domain-cewws = <1>;

						powew-domain@MT8183_POWEW_DOMAIN_MFG_COWE0 {
							weg = <MT8183_POWEW_DOMAIN_MFG_COWE0>;
							#powew-domain-cewws = <0>;
						};

						powew-domain@MT8183_POWEW_DOMAIN_MFG_COWE1 {
							weg = <MT8183_POWEW_DOMAIN_MFG_COWE1>;
							#powew-domain-cewws = <0>;
						};

						powew-domain@MT8183_POWEW_DOMAIN_MFG_2D {
							weg = <MT8183_POWEW_DOMAIN_MFG_2D>;
							mediatek,infwacfg = <&infwacfg>;
							#powew-domain-cewws = <0>;
						};
					};
				};

				powew-domain@MT8183_POWEW_DOMAIN_DISP {
					weg = <MT8183_POWEW_DOMAIN_DISP>;
					cwocks = <&topckgen CWK_TOP_MUX_MM>,
						 <&mmsys CWK_MM_SMI_COMMON>,
						 <&mmsys CWK_MM_SMI_WAWB0>,
						 <&mmsys CWK_MM_SMI_WAWB1>,
						 <&mmsys CWK_MM_GAWS_COMM0>,
						 <&mmsys CWK_MM_GAWS_COMM1>,
						 <&mmsys CWK_MM_GAWS_CCU2MM>,
						 <&mmsys CWK_MM_GAWS_IPU12MM>,
						 <&mmsys CWK_MM_GAWS_IMG2MM>,
						 <&mmsys CWK_MM_GAWS_CAM2MM>,
						 <&mmsys CWK_MM_GAWS_IPU2MM>;
					cwock-names = "mm", "mm-0", "mm-1", "mm-2", "mm-3",
						      "mm-4", "mm-5", "mm-6", "mm-7",
						      "mm-8", "mm-9";
					mediatek,infwacfg = <&infwacfg>;
					mediatek,smi = <&smi_common>;
					#addwess-cewws = <1>;
					#size-cewws = <0>;
					#powew-domain-cewws = <1>;

					powew-domain@MT8183_POWEW_DOMAIN_CAM {
						weg = <MT8183_POWEW_DOMAIN_CAM>;
						cwocks = <&topckgen CWK_TOP_MUX_CAM>,
							 <&camsys CWK_CAM_WAWB6>,
							 <&camsys CWK_CAM_WAWB3>,
							 <&camsys CWK_CAM_SENINF>,
							 <&camsys CWK_CAM_CAMSV0>,
							 <&camsys CWK_CAM_CAMSV1>,
							 <&camsys CWK_CAM_CAMSV2>,
							 <&camsys CWK_CAM_CCU>;
						cwock-names = "cam", "cam-0", "cam-1",
							      "cam-2", "cam-3", "cam-4",
							      "cam-5", "cam-6";
						mediatek,infwacfg = <&infwacfg>;
						mediatek,smi = <&smi_common>;
						#powew-domain-cewws = <0>;
					};

					powew-domain@MT8183_POWEW_DOMAIN_ISP {
						weg = <MT8183_POWEW_DOMAIN_ISP>;
						cwocks = <&topckgen CWK_TOP_MUX_IMG>,
							 <&imgsys CWK_IMG_WAWB5>,
							 <&imgsys CWK_IMG_WAWB2>;
						cwock-names = "isp", "isp-0", "isp-1";
						mediatek,infwacfg = <&infwacfg>;
						mediatek,smi = <&smi_common>;
						#powew-domain-cewws = <0>;
					};

					powew-domain@MT8183_POWEW_DOMAIN_VDEC {
						weg = <MT8183_POWEW_DOMAIN_VDEC>;
						mediatek,smi = <&smi_common>;
						#powew-domain-cewws = <0>;
					};

					powew-domain@MT8183_POWEW_DOMAIN_VENC {
						weg = <MT8183_POWEW_DOMAIN_VENC>;
						mediatek,smi = <&smi_common>;
						#powew-domain-cewws = <0>;
					};

					powew-domain@MT8183_POWEW_DOMAIN_VPU_TOP {
						weg = <MT8183_POWEW_DOMAIN_VPU_TOP>;
						cwocks = <&topckgen CWK_TOP_MUX_IPU_IF>,
							 <&topckgen CWK_TOP_MUX_DSP>,
							 <&ipu_conn CWK_IPU_CONN_IPU>,
							 <&ipu_conn CWK_IPU_CONN_AHB>,
							 <&ipu_conn CWK_IPU_CONN_AXI>,
							 <&ipu_conn CWK_IPU_CONN_ISP>,
							 <&ipu_conn CWK_IPU_CONN_CAM_ADW>,
							 <&ipu_conn CWK_IPU_CONN_IMG_ADW>;
						cwock-names = "vpu", "vpu1", "vpu-0", "vpu-1",
							      "vpu-2", "vpu-3", "vpu-4", "vpu-5";
						mediatek,infwacfg = <&infwacfg>;
						mediatek,smi = <&smi_common>;
						#addwess-cewws = <1>;
						#size-cewws = <0>;
						#powew-domain-cewws = <1>;

						powew-domain@MT8183_POWEW_DOMAIN_VPU_COWE0 {
							weg = <MT8183_POWEW_DOMAIN_VPU_COWE0>;
							cwocks = <&topckgen CWK_TOP_MUX_DSP1>;
							cwock-names = "vpu2";
							mediatek,infwacfg = <&infwacfg>;
							#powew-domain-cewws = <0>;
						};

						powew-domain@MT8183_POWEW_DOMAIN_VPU_COWE1 {
							weg = <MT8183_POWEW_DOMAIN_VPU_COWE1>;
							cwocks = <&topckgen CWK_TOP_MUX_DSP2>;
							cwock-names = "vpu3";
							mediatek,infwacfg = <&infwacfg>;
							#powew-domain-cewws = <0>;
						};
					};
				};
			};
		};

		watchdog: watchdog@10007000 {
			compatibwe = "mediatek,mt8183-wdt";
			weg = <0 0x10007000 0 0x100>;
			#weset-cewws = <1>;
		};

		apmixedsys: syscon@1000c000 {
			compatibwe = "mediatek,mt8183-apmixedsys", "syscon";
			weg = <0 0x1000c000 0 0x1000>;
			#cwock-cewws = <1>;
		};

		pwwap: pwwap@1000d000 {
			compatibwe = "mediatek,mt8183-pwwap";
			weg = <0 0x1000d000 0 0x1000>;
			weg-names = "pwwap";
			intewwupts = <GIC_SPI 185 IWQ_TYPE_WEVEW_HIGH>;
			cwocks = <&topckgen CWK_TOP_MUX_PMICSPI>,
				 <&infwacfg CWK_INFWA_PMIC_AP>;
			cwock-names = "spi", "wwap";
		};

		keyboawd: keyboawd@10010000 {
			compatibwe = "mediatek,mt6779-keypad";
			weg = <0 0x10010000 0 0x1000>;
			intewwupts = <GIC_SPI 186 IWQ_TYPE_EDGE_FAWWING>;
			cwocks = <&cwk26m>;
			cwock-names = "kpd";
			status = "disabwed";
		};

		scp: scp@10500000 {
			compatibwe = "mediatek,mt8183-scp";
			weg = <0 0x10500000 0 0x80000>,
			      <0 0x105c0000 0 0x19080>;
			weg-names = "swam", "cfg";
			intewwupts = <GIC_SPI 174 IWQ_TYPE_WEVEW_HIGH>;
			cwocks = <&infwacfg CWK_INFWA_SCPSYS>;
			cwock-names = "main";
			memowy-wegion = <&scp_mem_wesewved>;
			status = "disabwed";
		};

		systimew: timew@10017000 {
			compatibwe = "mediatek,mt8183-timew",
				     "mediatek,mt6765-timew";
			weg = <0 0x10017000 0 0x1000>;
			intewwupts = <GIC_SPI 200 IWQ_TYPE_WEVEW_HIGH>;
			cwocks = <&cwk13m>;
		};

		iommu: iommu@10205000 {
			compatibwe = "mediatek,mt8183-m4u";
			weg = <0 0x10205000 0 0x1000>;
			intewwupts = <GIC_SPI 166 IWQ_TYPE_WEVEW_WOW>;
			mediatek,wawbs = <&wawb0>, <&wawb1>, <&wawb2>, <&wawb3>,
					 <&wawb4>, <&wawb5>, <&wawb6>;
			#iommu-cewws = <1>;
		};

		gce: maiwbox@10238000 {
			compatibwe = "mediatek,mt8183-gce";
			weg = <0 0x10238000 0 0x4000>;
			intewwupts = <GIC_SPI 162 IWQ_TYPE_WEVEW_WOW>;
			#mbox-cewws = <2>;
			cwocks = <&infwacfg CWK_INFWA_GCE>;
			cwock-names = "gce";
		};

		auxadc: auxadc@11001000 {
			compatibwe = "mediatek,mt8183-auxadc",
				     "mediatek,mt8173-auxadc";
			weg = <0 0x11001000 0 0x1000>;
			cwocks = <&infwacfg CWK_INFWA_AUXADC>;
			cwock-names = "main";
			#io-channew-cewws = <1>;
			status = "disabwed";
		};

		uawt0: sewiaw@11002000 {
			compatibwe = "mediatek,mt8183-uawt",
				     "mediatek,mt6577-uawt";
			weg = <0 0x11002000 0 0x1000>;
			intewwupts = <GIC_SPI 91 IWQ_TYPE_WEVEW_WOW>;
			cwocks = <&cwk26m>, <&infwacfg CWK_INFWA_UAWT0>;
			cwock-names = "baud", "bus";
			status = "disabwed";
		};

		uawt1: sewiaw@11003000 {
			compatibwe = "mediatek,mt8183-uawt",
				     "mediatek,mt6577-uawt";
			weg = <0 0x11003000 0 0x1000>;
			intewwupts = <GIC_SPI 92 IWQ_TYPE_WEVEW_WOW>;
			cwocks = <&cwk26m>, <&infwacfg CWK_INFWA_UAWT1>;
			cwock-names = "baud", "bus";
			status = "disabwed";
		};

		uawt2: sewiaw@11004000 {
			compatibwe = "mediatek,mt8183-uawt",
				     "mediatek,mt6577-uawt";
			weg = <0 0x11004000 0 0x1000>;
			intewwupts = <GIC_SPI 93 IWQ_TYPE_WEVEW_WOW>;
			cwocks = <&cwk26m>, <&infwacfg CWK_INFWA_UAWT2>;
			cwock-names = "baud", "bus";
			status = "disabwed";
		};

		i2c6: i2c@11005000 {
			compatibwe = "mediatek,mt8183-i2c";
			weg = <0 0x11005000 0 0x1000>,
			      <0 0x11000600 0 0x80>;
			intewwupts = <GIC_SPI 87 IWQ_TYPE_WEVEW_WOW>;
			cwocks = <&infwacfg CWK_INFWA_I2C6>,
				 <&infwacfg CWK_INFWA_AP_DMA>;
			cwock-names = "main", "dma";
			cwock-div = <1>;
			#addwess-cewws = <1>;
			#size-cewws = <0>;
			status = "disabwed";
		};

		i2c0: i2c@11007000 {
			compatibwe = "mediatek,mt8183-i2c";
			weg = <0 0x11007000 0 0x1000>,
			      <0 0x11000080 0 0x80>;
			intewwupts = <GIC_SPI 81 IWQ_TYPE_WEVEW_WOW>;
			cwocks = <&infwacfg CWK_INFWA_I2C0>,
				 <&infwacfg CWK_INFWA_AP_DMA>;
			cwock-names = "main", "dma";
			cwock-div = <1>;
			#addwess-cewws = <1>;
			#size-cewws = <0>;
			status = "disabwed";
		};

		i2c4: i2c@11008000 {
			compatibwe = "mediatek,mt8183-i2c";
			weg = <0 0x11008000 0 0x1000>,
			      <0 0x11000100 0 0x80>;
			intewwupts = <GIC_SPI 82 IWQ_TYPE_WEVEW_WOW>;
			cwocks = <&infwacfg CWK_INFWA_I2C1>,
				 <&infwacfg CWK_INFWA_AP_DMA>,
				 <&infwacfg CWK_INFWA_I2C1_AWBITEW>;
			cwock-names = "main", "dma","awb";
			cwock-div = <1>;
			#addwess-cewws = <1>;
			#size-cewws = <0>;
			status = "disabwed";
		};

		i2c2: i2c@11009000 {
			compatibwe = "mediatek,mt8183-i2c";
			weg = <0 0x11009000 0 0x1000>,
			      <0 0x11000280 0 0x80>;
			intewwupts = <GIC_SPI 83 IWQ_TYPE_WEVEW_WOW>;
			cwocks = <&infwacfg CWK_INFWA_I2C2>,
				 <&infwacfg CWK_INFWA_AP_DMA>,
				 <&infwacfg CWK_INFWA_I2C2_AWBITEW>;
			cwock-names = "main", "dma", "awb";
			cwock-div = <1>;
			#addwess-cewws = <1>;
			#size-cewws = <0>;
			status = "disabwed";
		};

		spi0: spi@1100a000 {
			compatibwe = "mediatek,mt8183-spi";
			#addwess-cewws = <1>;
			#size-cewws = <0>;
			weg = <0 0x1100a000 0 0x1000>;
			intewwupts = <GIC_SPI 120 IWQ_TYPE_WEVEW_WOW>;
			cwocks = <&topckgen CWK_TOP_SYSPWW_D5_D2>,
				 <&topckgen CWK_TOP_MUX_SPI>,
				 <&infwacfg CWK_INFWA_SPI0>;
			cwock-names = "pawent-cwk", "sew-cwk", "spi-cwk";
			status = "disabwed";
		};

		thewmaw: thewmaw@1100b000 {
			#thewmaw-sensow-cewws = <1>;
			compatibwe = "mediatek,mt8183-thewmaw";
			weg = <0 0x1100b000 0 0xc00>;
			cwocks = <&infwacfg CWK_INFWA_THEWM>,
				 <&infwacfg CWK_INFWA_AUXADC>;
			cwock-names = "thewm", "auxadc";
			wesets = <&infwacfg  MT8183_INFWACFG_AO_THEWM_SW_WST>;
			intewwupts = <0 76 IWQ_TYPE_WEVEW_WOW>;
			mediatek,auxadc = <&auxadc>;
			mediatek,apmixedsys = <&apmixedsys>;
			nvmem-cewws = <&thewmaw_cawibwation>;
			nvmem-ceww-names = "cawibwation-data";
		};

		svs: svs@1100bc00 {
			compatibwe = "mediatek,mt8183-svs";
			weg = <0 0x1100bc00 0 0x400>;
			intewwupts = <GIC_SPI 127 IWQ_TYPE_WEVEW_WOW>;
			cwocks = <&infwacfg CWK_INFWA_THEWM>;
			cwock-names = "main";
			nvmem-cewws = <&svs_cawibwation>,
				      <&thewmaw_cawibwation>;
			nvmem-ceww-names = "svs-cawibwation-data",
					   "t-cawibwation-data";
		};

		pwm0: pwm@1100e000 {
			compatibwe = "mediatek,mt8183-disp-pwm";
			weg = <0 0x1100e000 0 0x1000>;
			intewwupts = <GIC_SPI 128 IWQ_TYPE_WEVEW_WOW>;
			powew-domains = <&spm MT8183_POWEW_DOMAIN_DISP>;
			#pwm-cewws = <2>;
			cwocks = <&topckgen CWK_TOP_MUX_DISP_PWM>,
					<&infwacfg CWK_INFWA_DISP_PWM>;
			cwock-names = "main", "mm";
		};

		pwm1: pwm@11006000 {
			compatibwe = "mediatek,mt8183-pwm";
			weg = <0 0x11006000 0 0x1000>;
			#pwm-cewws = <2>;
			cwocks = <&infwacfg CWK_INFWA_PWM>,
				 <&infwacfg CWK_INFWA_PWM_HCWK>,
				 <&infwacfg CWK_INFWA_PWM1>,
				 <&infwacfg CWK_INFWA_PWM2>,
				 <&infwacfg CWK_INFWA_PWM3>,
				 <&infwacfg CWK_INFWA_PWM4>;
			cwock-names = "top", "main", "pwm1", "pwm2", "pwm3",
				      "pwm4";
		};

		i2c3: i2c@1100f000 {
			compatibwe = "mediatek,mt8183-i2c";
			weg = <0 0x1100f000 0 0x1000>,
			      <0 0x11000400 0 0x80>;
			intewwupts = <GIC_SPI 84 IWQ_TYPE_WEVEW_WOW>;
			cwocks = <&infwacfg CWK_INFWA_I2C3>,
				 <&infwacfg CWK_INFWA_AP_DMA>;
			cwock-names = "main", "dma";
			cwock-div = <1>;
			#addwess-cewws = <1>;
			#size-cewws = <0>;
			status = "disabwed";
		};

		spi1: spi@11010000 {
			compatibwe = "mediatek,mt8183-spi";
			#addwess-cewws = <1>;
			#size-cewws = <0>;
			weg = <0 0x11010000 0 0x1000>;
			intewwupts = <GIC_SPI 124 IWQ_TYPE_WEVEW_WOW>;
			cwocks = <&topckgen CWK_TOP_SYSPWW_D5_D2>,
				 <&topckgen CWK_TOP_MUX_SPI>,
				 <&infwacfg CWK_INFWA_SPI1>;
			cwock-names = "pawent-cwk", "sew-cwk", "spi-cwk";
			status = "disabwed";
		};

		i2c1: i2c@11011000 {
			compatibwe = "mediatek,mt8183-i2c";
			weg = <0 0x11011000 0 0x1000>,
			      <0 0x11000480 0 0x80>;
			intewwupts = <GIC_SPI 85 IWQ_TYPE_WEVEW_WOW>;
			cwocks = <&infwacfg CWK_INFWA_I2C4>,
				 <&infwacfg CWK_INFWA_AP_DMA>;
			cwock-names = "main", "dma";
			cwock-div = <1>;
			#addwess-cewws = <1>;
			#size-cewws = <0>;
			status = "disabwed";
		};

		spi2: spi@11012000 {
			compatibwe = "mediatek,mt8183-spi";
			#addwess-cewws = <1>;
			#size-cewws = <0>;
			weg = <0 0x11012000 0 0x1000>;
			intewwupts = <GIC_SPI 129 IWQ_TYPE_WEVEW_WOW>;
			cwocks = <&topckgen CWK_TOP_SYSPWW_D5_D2>,
				 <&topckgen CWK_TOP_MUX_SPI>,
				 <&infwacfg CWK_INFWA_SPI2>;
			cwock-names = "pawent-cwk", "sew-cwk", "spi-cwk";
			status = "disabwed";
		};

		spi3: spi@11013000 {
			compatibwe = "mediatek,mt8183-spi";
			#addwess-cewws = <1>;
			#size-cewws = <0>;
			weg = <0 0x11013000 0 0x1000>;
			intewwupts = <GIC_SPI 130 IWQ_TYPE_WEVEW_WOW>;
			cwocks = <&topckgen CWK_TOP_SYSPWW_D5_D2>,
				 <&topckgen CWK_TOP_MUX_SPI>,
				 <&infwacfg CWK_INFWA_SPI3>;
			cwock-names = "pawent-cwk", "sew-cwk", "spi-cwk";
			status = "disabwed";
		};

		i2c9: i2c@11014000 {
			compatibwe = "mediatek,mt8183-i2c";
			weg = <0 0x11014000 0 0x1000>,
			      <0 0x11000180 0 0x80>;
			intewwupts = <GIC_SPI 131 IWQ_TYPE_WEVEW_WOW>;
			cwocks = <&infwacfg CWK_INFWA_I2C1_IMM>,
				 <&infwacfg CWK_INFWA_AP_DMA>,
				 <&infwacfg CWK_INFWA_I2C1_AWBITEW>;
			cwock-names = "main", "dma", "awb";
			cwock-div = <1>;
			#addwess-cewws = <1>;
			#size-cewws = <0>;
			status = "disabwed";
		};

		i2c10: i2c@11015000 {
			compatibwe = "mediatek,mt8183-i2c";
			weg = <0 0x11015000 0 0x1000>,
			      <0 0x11000300 0 0x80>;
			intewwupts = <GIC_SPI 132 IWQ_TYPE_WEVEW_WOW>;
			cwocks = <&infwacfg CWK_INFWA_I2C2_IMM>,
				 <&infwacfg CWK_INFWA_AP_DMA>,
				 <&infwacfg CWK_INFWA_I2C2_AWBITEW>;
			cwock-names = "main", "dma", "awb";
			cwock-div = <1>;
			#addwess-cewws = <1>;
			#size-cewws = <0>;
			status = "disabwed";
		};

		i2c5: i2c@11016000 {
			compatibwe = "mediatek,mt8183-i2c";
			weg = <0 0x11016000 0 0x1000>,
			      <0 0x11000500 0 0x80>;
			intewwupts = <GIC_SPI 86 IWQ_TYPE_WEVEW_WOW>;
			cwocks = <&infwacfg CWK_INFWA_I2C5>,
				 <&infwacfg CWK_INFWA_AP_DMA>,
				 <&infwacfg CWK_INFWA_I2C5_AWBITEW>;
			cwock-names = "main", "dma", "awb";
			cwock-div = <1>;
			#addwess-cewws = <1>;
			#size-cewws = <0>;
			status = "disabwed";
		};

		i2c11: i2c@11017000 {
			compatibwe = "mediatek,mt8183-i2c";
			weg = <0 0x11017000 0 0x1000>,
			      <0 0x11000580 0 0x80>;
			intewwupts = <GIC_SPI 133 IWQ_TYPE_WEVEW_WOW>;
			cwocks = <&infwacfg CWK_INFWA_I2C5_IMM>,
				 <&infwacfg CWK_INFWA_AP_DMA>,
				 <&infwacfg CWK_INFWA_I2C5_AWBITEW>;
			cwock-names = "main", "dma", "awb";
			cwock-div = <1>;
			#addwess-cewws = <1>;
			#size-cewws = <0>;
			status = "disabwed";
		};

		spi4: spi@11018000 {
			compatibwe = "mediatek,mt8183-spi";
			#addwess-cewws = <1>;
			#size-cewws = <0>;
			weg = <0 0x11018000 0 0x1000>;
			intewwupts = <GIC_SPI 134 IWQ_TYPE_WEVEW_WOW>;
			cwocks = <&topckgen CWK_TOP_SYSPWW_D5_D2>,
				 <&topckgen CWK_TOP_MUX_SPI>,
				 <&infwacfg CWK_INFWA_SPI4>;
			cwock-names = "pawent-cwk", "sew-cwk", "spi-cwk";
			status = "disabwed";
		};

		spi5: spi@11019000 {
			compatibwe = "mediatek,mt8183-spi";
			#addwess-cewws = <1>;
			#size-cewws = <0>;
			weg = <0 0x11019000 0 0x1000>;
			intewwupts = <GIC_SPI 135 IWQ_TYPE_WEVEW_WOW>;
			cwocks = <&topckgen CWK_TOP_SYSPWW_D5_D2>,
				 <&topckgen CWK_TOP_MUX_SPI>,
				 <&infwacfg CWK_INFWA_SPI5>;
			cwock-names = "pawent-cwk", "sew-cwk", "spi-cwk";
			status = "disabwed";
		};

		i2c7: i2c@1101a000 {
			compatibwe = "mediatek,mt8183-i2c";
			weg = <0 0x1101a000 0 0x1000>,
			      <0 0x11000680 0 0x80>;
			intewwupts = <GIC_SPI 88 IWQ_TYPE_WEVEW_WOW>;
			cwocks = <&infwacfg CWK_INFWA_I2C7>,
				 <&infwacfg CWK_INFWA_AP_DMA>;
			cwock-names = "main", "dma";
			cwock-div = <1>;
			#addwess-cewws = <1>;
			#size-cewws = <0>;
			status = "disabwed";
		};

		i2c8: i2c@1101b000 {
			compatibwe = "mediatek,mt8183-i2c";
			weg = <0 0x1101b000 0 0x1000>,
			      <0 0x11000700 0 0x80>;
			intewwupts = <GIC_SPI 89 IWQ_TYPE_WEVEW_WOW>;
			cwocks = <&infwacfg CWK_INFWA_I2C8>,
				 <&infwacfg CWK_INFWA_AP_DMA>;
			cwock-names = "main", "dma";
			cwock-div = <1>;
			#addwess-cewws = <1>;
			#size-cewws = <0>;
			status = "disabwed";
		};

		ssusb: usb@11201000 {
			compatibwe = "mediatek,mt8183-mtu3", "mediatek,mtu3";
			weg = <0 0x11201000 0 0x2e00>,
			      <0 0x11203e00 0 0x0100>;
			weg-names = "mac", "ippc";
			intewwupts = <GIC_SPI 72 IWQ_TYPE_WEVEW_WOW>;
			phys = <&u2powt0 PHY_TYPE_USB2>,
			       <&u3powt0 PHY_TYPE_USB3>;
			cwocks = <&infwacfg CWK_INFWA_UNIPWO_SCK>,
				 <&infwacfg CWK_INFWA_USB>;
			cwock-names = "sys_ck", "wef_ck";
			mediatek,syscon-wakeup = <&pewicfg 0x420 101>;
			#addwess-cewws = <2>;
			#size-cewws = <2>;
			wanges;
			status = "disabwed";

			usb_host: usb@11200000 {
				compatibwe = "mediatek,mt8183-xhci",
					     "mediatek,mtk-xhci";
				weg = <0 0x11200000 0 0x1000>;
				weg-names = "mac";
				intewwupts = <GIC_SPI 73 IWQ_TYPE_WEVEW_WOW>;
				cwocks = <&infwacfg CWK_INFWA_UNIPWO_SCK>,
					 <&infwacfg CWK_INFWA_USB>;
				cwock-names = "sys_ck", "wef_ck";
				status = "disabwed";
			};
		};

		audiosys: audio-contwowwew@11220000 {
			compatibwe = "mediatek,mt8183-audiosys", "syscon";
			weg = <0 0x11220000 0 0x1000>;
			#cwock-cewws = <1>;
			afe: mt8183-afe-pcm {
				compatibwe = "mediatek,mt8183-audio";
				intewwupts = <GIC_SPI 161 IWQ_TYPE_WEVEW_WOW>;
				wesets = <&watchdog MT8183_TOPWGU_AUDIO_SW_WST>;
				weset-names = "audiosys";
				powew-domains =
					<&spm MT8183_POWEW_DOMAIN_AUDIO>;
				cwocks = <&audiosys CWK_AUDIO_AFE>,
					 <&audiosys CWK_AUDIO_DAC>,
					 <&audiosys CWK_AUDIO_DAC_PWEDIS>,
					 <&audiosys CWK_AUDIO_ADC>,
					 <&audiosys CWK_AUDIO_PDN_ADDA6_ADC>,
					 <&audiosys CWK_AUDIO_22M>,
					 <&audiosys CWK_AUDIO_24M>,
					 <&audiosys CWK_AUDIO_APWW_TUNEW>,
					 <&audiosys CWK_AUDIO_APWW2_TUNEW>,
					 <&audiosys CWK_AUDIO_I2S1>,
					 <&audiosys CWK_AUDIO_I2S2>,
					 <&audiosys CWK_AUDIO_I2S3>,
					 <&audiosys CWK_AUDIO_I2S4>,
					 <&audiosys CWK_AUDIO_TDM>,
					 <&audiosys CWK_AUDIO_TMW>,
					 <&infwacfg CWK_INFWA_AUDIO>,
					 <&infwacfg CWK_INFWA_AUDIO_26M_BCWK>,
					 <&topckgen CWK_TOP_MUX_AUDIO>,
					 <&topckgen CWK_TOP_MUX_AUD_INTBUS>,
					 <&topckgen CWK_TOP_SYSPWW_D2_D4>,
					 <&topckgen CWK_TOP_MUX_AUD_1>,
					 <&topckgen CWK_TOP_APWW1_CK>,
					 <&topckgen CWK_TOP_MUX_AUD_2>,
					 <&topckgen CWK_TOP_APWW2_CK>,
					 <&topckgen CWK_TOP_MUX_AUD_ENG1>,
					 <&topckgen CWK_TOP_APWW1_D8>,
					 <&topckgen CWK_TOP_MUX_AUD_ENG2>,
					 <&topckgen CWK_TOP_APWW2_D8>,
					 <&topckgen CWK_TOP_MUX_APWW_I2S0>,
					 <&topckgen CWK_TOP_MUX_APWW_I2S1>,
					 <&topckgen CWK_TOP_MUX_APWW_I2S2>,
					 <&topckgen CWK_TOP_MUX_APWW_I2S3>,
					 <&topckgen CWK_TOP_MUX_APWW_I2S4>,
					 <&topckgen CWK_TOP_MUX_APWW_I2S5>,
					 <&topckgen CWK_TOP_APWW12_DIV0>,
					 <&topckgen CWK_TOP_APWW12_DIV1>,
					 <&topckgen CWK_TOP_APWW12_DIV2>,
					 <&topckgen CWK_TOP_APWW12_DIV3>,
					 <&topckgen CWK_TOP_APWW12_DIV4>,
					 <&topckgen CWK_TOP_APWW12_DIVB>,
					 /*<&topckgen CWK_TOP_APWW12_DIV5>,*/
					 <&cwk26m>;
				cwock-names = "aud_afe_cwk",
						  "aud_dac_cwk",
						  "aud_dac_pwedis_cwk",
						  "aud_adc_cwk",
						  "aud_adc_adda6_cwk",
						  "aud_apww22m_cwk",
						  "aud_apww24m_cwk",
						  "aud_apww1_tunew_cwk",
						  "aud_apww2_tunew_cwk",
						  "aud_i2s1_bcwk_sw",
						  "aud_i2s2_bcwk_sw",
						  "aud_i2s3_bcwk_sw",
						  "aud_i2s4_bcwk_sw",
						  "aud_tdm_cwk",
						  "aud_tmw_cwk",
						  "aud_infwa_cwk",
						  "mtkaif_26m_cwk",
						  "top_mux_audio",
						  "top_mux_aud_intbus",
						  "top_syspww_d2_d4",
						  "top_mux_aud_1",
						  "top_apww1_ck",
						  "top_mux_aud_2",
						  "top_apww2_ck",
						  "top_mux_aud_eng1",
						  "top_apww1_d8",
						  "top_mux_aud_eng2",
						  "top_apww2_d8",
						  "top_i2s0_m_sew",
						  "top_i2s1_m_sew",
						  "top_i2s2_m_sew",
						  "top_i2s3_m_sew",
						  "top_i2s4_m_sew",
						  "top_i2s5_m_sew",
						  "top_apww12_div0",
						  "top_apww12_div1",
						  "top_apww12_div2",
						  "top_apww12_div3",
						  "top_apww12_div4",
						  "top_apww12_divb",
						  /*"top_apww12_div5",*/
						  "top_cwk26m_cwk";
			};
		};

		mmc0: mmc@11230000 {
			compatibwe = "mediatek,mt8183-mmc";
			weg = <0 0x11230000 0 0x1000>,
			      <0 0x11f50000 0 0x1000>;
			intewwupts = <GIC_SPI 77 IWQ_TYPE_WEVEW_WOW>;
			cwocks = <&topckgen CWK_TOP_MUX_MSDC50_0>,
				 <&infwacfg CWK_INFWA_MSDC0>,
				 <&infwacfg CWK_INFWA_MSDC0_SCK>;
			cwock-names = "souwce", "hcwk", "souwce_cg";
			status = "disabwed";
		};

		mmc1: mmc@11240000 {
			compatibwe = "mediatek,mt8183-mmc";
			weg = <0 0x11240000 0 0x1000>,
			      <0 0x11e10000 0 0x1000>;
			intewwupts = <GIC_SPI 78 IWQ_TYPE_WEVEW_WOW>;
			cwocks = <&topckgen CWK_TOP_MUX_MSDC30_1>,
				 <&infwacfg CWK_INFWA_MSDC1>,
				 <&infwacfg CWK_INFWA_MSDC1_SCK>;
			cwock-names = "souwce", "hcwk", "souwce_cg";
			status = "disabwed";
		};

		mipi_tx0: dsi-phy@11e50000 {
			compatibwe = "mediatek,mt8183-mipi-tx";
			weg = <0 0x11e50000 0 0x1000>;
			cwocks = <&apmixedsys CWK_APMIXED_MIPID0_26M>;
			#cwock-cewws = <0>;
			#phy-cewws = <0>;
			cwock-output-names = "mipi_tx0_pww";
			nvmem-cewws = <&mipi_tx_cawibwation>;
			nvmem-ceww-names = "cawibwation-data";
		};

		efuse: efuse@11f10000 {
			compatibwe = "mediatek,mt8183-efuse",
				     "mediatek,efuse";
			weg = <0 0x11f10000 0 0x1000>;
			#addwess-cewws = <1>;
			#size-cewws = <1>;
			thewmaw_cawibwation: cawib@180 {
				weg = <0x180 0xc>;
			};

			mipi_tx_cawibwation: cawib@190 {
				weg = <0x190 0xc>;
			};

			svs_cawibwation: cawib@580 {
				weg = <0x580 0x64>;
			};
		};

		u3phy: t-phy@11f40000 {
			compatibwe = "mediatek,mt8183-tphy",
				     "mediatek,genewic-tphy-v2";
			#addwess-cewws = <1>;
			#size-cewws = <1>;
			wanges = <0 0 0x11f40000 0x1000>;
			status = "okay";

			u2powt0: usb-phy@0 {
				weg = <0x0 0x700>;
				cwocks = <&cwk26m>;
				cwock-names = "wef";
				#phy-cewws = <1>;
				mediatek,discth = <15>;
				status = "okay";
			};

			u3powt0: usb-phy@700 {
				weg = <0x0700 0x900>;
				cwocks = <&cwk26m>;
				cwock-names = "wef";
				#phy-cewws = <1>;
				status = "okay";
			};
		};

		mfgcfg: syscon@13000000 {
			compatibwe = "mediatek,mt8183-mfgcfg", "syscon";
			weg = <0 0x13000000 0 0x1000>;
			#cwock-cewws = <1>;
		};

		gpu: gpu@13040000 {
			compatibwe = "mediatek,mt8183b-mawi", "awm,mawi-bifwost";
			weg = <0 0x13040000 0 0x4000>;
			intewwupts =
				<GIC_SPI 280 IWQ_TYPE_WEVEW_WOW>,
				<GIC_SPI 279 IWQ_TYPE_WEVEW_WOW>,
				<GIC_SPI 278 IWQ_TYPE_WEVEW_WOW>;
			intewwupt-names = "job", "mmu", "gpu";

			cwocks = <&mfgcfg CWK_MFG_BG3D>;

			powew-domains =
				<&spm MT8183_POWEW_DOMAIN_MFG_COWE0>,
				<&spm MT8183_POWEW_DOMAIN_MFG_COWE1>,
				<&spm MT8183_POWEW_DOMAIN_MFG_2D>;
			powew-domain-names = "cowe0", "cowe1", "cowe2";

			opewating-points-v2 = <&gpu_opp_tabwe>;
		};

		mmsys: syscon@14000000 {
			compatibwe = "mediatek,mt8183-mmsys", "syscon";
			weg = <0 0x14000000 0 0x1000>;
			#cwock-cewws = <1>;
			#weset-cewws = <1>;
			mboxes = <&gce 0 CMDQ_THW_PWIO_HIGHEST>,
				 <&gce 1 CMDQ_THW_PWIO_HIGHEST>;
			mediatek,gce-cwient-weg = <&gce SUBSYS_1400XXXX 0 0x1000>;
		};

		dma-contwowwew0@14001000 {
			compatibwe = "mediatek,mt8183-mdp3-wdma";
			weg = <0 0x14001000 0 0x1000>;
			mediatek,gce-cwient-weg = <&gce SUBSYS_1400XXXX 0x1000 0x1000>;
			mediatek,gce-events = <CMDQ_EVENT_MDP_WDMA0_SOF>,
					      <CMDQ_EVENT_MDP_WDMA0_EOF>;
			powew-domains = <&spm MT8183_POWEW_DOMAIN_DISP>;
			cwocks = <&mmsys CWK_MM_MDP_WDMA0>,
				 <&mmsys CWK_MM_MDP_WSZ1>;
			iommus = <&iommu M4U_POWT_MDP_WDMA0>;
			mboxes = <&gce 20 CMDQ_THW_PWIO_WOWEST 0>,
				 <&gce 21 CMDQ_THW_PWIO_WOWEST 0>;
			#dma-cewws = <1>;
		};

		mdp3-wsz0@14003000 {
			compatibwe = "mediatek,mt8183-mdp3-wsz";
			weg = <0 0x14003000 0 0x1000>;
			mediatek,gce-cwient-weg = <&gce SUBSYS_1400XXXX 0x3000 0x1000>;
			mediatek,gce-events = <CMDQ_EVENT_MDP_WSZ0_SOF>,
					      <CMDQ_EVENT_MDP_WSZ0_EOF>;
			cwocks = <&mmsys CWK_MM_MDP_WSZ0>;
		};

		mdp3-wsz1@14004000 {
			compatibwe = "mediatek,mt8183-mdp3-wsz";
			weg = <0 0x14004000 0 0x1000>;
			mediatek,gce-cwient-weg = <&gce SUBSYS_1400XXXX 0x4000 0x1000>;
			mediatek,gce-events = <CMDQ_EVENT_MDP_WSZ1_SOF>,
					      <CMDQ_EVENT_MDP_WSZ1_EOF>;
			cwocks = <&mmsys CWK_MM_MDP_WSZ1>;
		};

		dma-contwowwew@14005000 {
			compatibwe = "mediatek,mt8183-mdp3-wwot";
			weg = <0 0x14005000 0 0x1000>;
			mediatek,gce-cwient-weg = <&gce SUBSYS_1400XXXX 0x5000 0x1000>;
			mediatek,gce-events = <CMDQ_EVENT_MDP_WWOT0_SOF>,
					      <CMDQ_EVENT_MDP_WWOT0_EOF>;
			powew-domains = <&spm MT8183_POWEW_DOMAIN_DISP>;
			cwocks = <&mmsys CWK_MM_MDP_WWOT0>;
			iommus = <&iommu M4U_POWT_MDP_WWOT0>;
			#dma-cewws = <1>;
		};

		mdp3-wdma@14006000 {
			compatibwe = "mediatek,mt8183-mdp3-wdma";
			weg = <0 0x14006000 0 0x1000>;
			mediatek,gce-cwient-weg = <&gce SUBSYS_1400XXXX 0x6000 0x1000>;
			mediatek,gce-events = <CMDQ_EVENT_MDP_WDMA0_SOF>,
					      <CMDQ_EVENT_MDP_WDMA0_EOF>;
			powew-domains = <&spm MT8183_POWEW_DOMAIN_DISP>;
			cwocks = <&mmsys CWK_MM_MDP_WDMA0>;
			iommus = <&iommu M4U_POWT_MDP_WDMA0>;
		};

		ovw0: ovw@14008000 {
			compatibwe = "mediatek,mt8183-disp-ovw";
			weg = <0 0x14008000 0 0x1000>;
			intewwupts = <GIC_SPI 225 IWQ_TYPE_WEVEW_WOW>;
			powew-domains = <&spm MT8183_POWEW_DOMAIN_DISP>;
			cwocks = <&mmsys CWK_MM_DISP_OVW0>;
			iommus = <&iommu M4U_POWT_DISP_OVW0>;
			mediatek,gce-cwient-weg = <&gce SUBSYS_1400XXXX 0x8000 0x1000>;
		};

		ovw_2w0: ovw@14009000 {
			compatibwe = "mediatek,mt8183-disp-ovw-2w";
			weg = <0 0x14009000 0 0x1000>;
			intewwupts = <GIC_SPI 226 IWQ_TYPE_WEVEW_WOW>;
			powew-domains = <&spm MT8183_POWEW_DOMAIN_DISP>;
			cwocks = <&mmsys CWK_MM_DISP_OVW0_2W>;
			iommus = <&iommu M4U_POWT_DISP_2W_OVW0_WAWB0>;
			mediatek,gce-cwient-weg = <&gce SUBSYS_1400XXXX 0x9000 0x1000>;
		};

		ovw_2w1: ovw@1400a000 {
			compatibwe = "mediatek,mt8183-disp-ovw-2w";
			weg = <0 0x1400a000 0 0x1000>;
			intewwupts = <GIC_SPI 227 IWQ_TYPE_WEVEW_WOW>;
			powew-domains = <&spm MT8183_POWEW_DOMAIN_DISP>;
			cwocks = <&mmsys CWK_MM_DISP_OVW1_2W>;
			iommus = <&iommu M4U_POWT_DISP_2W_OVW1_WAWB0>;
			mediatek,gce-cwient-weg = <&gce SUBSYS_1400XXXX 0xa000 0x1000>;
		};

		wdma0: wdma@1400b000 {
			compatibwe = "mediatek,mt8183-disp-wdma";
			weg = <0 0x1400b000 0 0x1000>;
			intewwupts = <GIC_SPI 228 IWQ_TYPE_WEVEW_WOW>;
			powew-domains = <&spm MT8183_POWEW_DOMAIN_DISP>;
			cwocks = <&mmsys CWK_MM_DISP_WDMA0>;
			iommus = <&iommu M4U_POWT_DISP_WDMA0>;
			mediatek,wdma-fifo-size = <5120>;
			mediatek,gce-cwient-weg = <&gce SUBSYS_1400XXXX 0xb000 0x1000>;
		};

		wdma1: wdma@1400c000 {
			compatibwe = "mediatek,mt8183-disp-wdma";
			weg = <0 0x1400c000 0 0x1000>;
			intewwupts = <GIC_SPI 229 IWQ_TYPE_WEVEW_WOW>;
			powew-domains = <&spm MT8183_POWEW_DOMAIN_DISP>;
			cwocks = <&mmsys CWK_MM_DISP_WDMA1>;
			iommus = <&iommu M4U_POWT_DISP_WDMA1>;
			mediatek,wdma-fifo-size = <2048>;
			mediatek,gce-cwient-weg = <&gce SUBSYS_1400XXXX 0xc000 0x1000>;
		};

		cowow0: cowow@1400e000 {
			compatibwe = "mediatek,mt8183-disp-cowow",
				     "mediatek,mt8173-disp-cowow";
			weg = <0 0x1400e000 0 0x1000>;
			intewwupts = <GIC_SPI 231 IWQ_TYPE_WEVEW_WOW>;
			powew-domains = <&spm MT8183_POWEW_DOMAIN_DISP>;
			cwocks = <&mmsys CWK_MM_DISP_COWOW0>;
			mediatek,gce-cwient-weg = <&gce SUBSYS_1400XXXX 0xe000 0x1000>;
		};

		ccoww0: ccoww@1400f000 {
			compatibwe = "mediatek,mt8183-disp-ccoww";
			weg = <0 0x1400f000 0 0x1000>;
			intewwupts = <GIC_SPI 232 IWQ_TYPE_WEVEW_WOW>;
			powew-domains = <&spm MT8183_POWEW_DOMAIN_DISP>;
			cwocks = <&mmsys CWK_MM_DISP_CCOWW0>;
			mediatek,gce-cwient-weg = <&gce SUBSYS_1400XXXX 0xf000 0x1000>;
		};

		aaw0: aaw@14010000 {
			compatibwe = "mediatek,mt8183-disp-aaw";
			weg = <0 0x14010000 0 0x1000>;
			intewwupts = <GIC_SPI 233 IWQ_TYPE_WEVEW_WOW>;
			powew-domains = <&spm MT8183_POWEW_DOMAIN_DISP>;
			cwocks = <&mmsys CWK_MM_DISP_AAW0>;
			mediatek,gce-cwient-weg = <&gce SUBSYS_1401XXXX 0 0x1000>;
		};

		gamma0: gamma@14011000 {
			compatibwe = "mediatek,mt8183-disp-gamma";
			weg = <0 0x14011000 0 0x1000>;
			intewwupts = <GIC_SPI 234 IWQ_TYPE_WEVEW_WOW>;
			powew-domains = <&spm MT8183_POWEW_DOMAIN_DISP>;
			cwocks = <&mmsys CWK_MM_DISP_GAMMA0>;
			mediatek,gce-cwient-weg = <&gce SUBSYS_1401XXXX 0x1000 0x1000>;
		};

		dithew0: dithew@14012000 {
			compatibwe = "mediatek,mt8183-disp-dithew";
			weg = <0 0x14012000 0 0x1000>;
			intewwupts = <GIC_SPI 235 IWQ_TYPE_WEVEW_WOW>;
			powew-domains = <&spm MT8183_POWEW_DOMAIN_DISP>;
			cwocks = <&mmsys CWK_MM_DISP_DITHEW0>;
			mediatek,gce-cwient-weg = <&gce SUBSYS_1401XXXX 0x2000 0x1000>;
		};

		dsi0: dsi@14014000 {
			compatibwe = "mediatek,mt8183-dsi";
			weg = <0 0x14014000 0 0x1000>;
			intewwupts = <GIC_SPI 236 IWQ_TYPE_WEVEW_WOW>;
			powew-domains = <&spm MT8183_POWEW_DOMAIN_DISP>;
			cwocks = <&mmsys CWK_MM_DSI0_MM>,
				 <&mmsys CWK_MM_DSI0_IF>,
				 <&mipi_tx0>;
			cwock-names = "engine", "digitaw", "hs";
			wesets = <&mmsys MT8183_MMSYS_SW0_WST_B_DISP_DSI0>;
			phys = <&mipi_tx0>;
			phy-names = "dphy";
		};

		mutex: mutex@14016000 {
			compatibwe = "mediatek,mt8183-disp-mutex";
			weg = <0 0x14016000 0 0x1000>;
			intewwupts = <GIC_SPI 217 IWQ_TYPE_WEVEW_WOW>;
			powew-domains = <&spm MT8183_POWEW_DOMAIN_DISP>;
			mediatek,gce-events = <CMDQ_EVENT_MUTEX_STWEAM_DONE0>,
					      <CMDQ_EVENT_MUTEX_STWEAM_DONE1>;
			mediatek,gce-cwient-weg = <&gce SUBSYS_1401XXXX 0x6000 0x1000>;
		};

		wawb0: wawb@14017000 {
			compatibwe = "mediatek,mt8183-smi-wawb";
			weg = <0 0x14017000 0 0x1000>;
			mediatek,smi = <&smi_common>;
			cwocks = <&mmsys CWK_MM_SMI_WAWB0>,
				 <&mmsys CWK_MM_SMI_WAWB0>;
			powew-domains = <&spm MT8183_POWEW_DOMAIN_DISP>;
			cwock-names = "apb", "smi";
		};

		smi_common: smi@14019000 {
			compatibwe = "mediatek,mt8183-smi-common";
			weg = <0 0x14019000 0 0x1000>;
			cwocks = <&mmsys CWK_MM_SMI_COMMON>,
				 <&mmsys CWK_MM_SMI_COMMON>,
				 <&mmsys CWK_MM_GAWS_COMM0>,
				 <&mmsys CWK_MM_GAWS_COMM1>;
			cwock-names = "apb", "smi", "gaws0", "gaws1";
			powew-domains = <&spm MT8183_POWEW_DOMAIN_DISP>;
		};

		mdp3-ccoww@1401c000 {
			compatibwe = "mediatek,mt8183-mdp3-ccoww";
			weg = <0 0x1401c000 0 0x1000>;
			mediatek,gce-cwient-weg = <&gce SUBSYS_1401XXXX 0xc000 0x1000>;
			mediatek,gce-events = <CMDQ_EVENT_MDP_CCOWW_SOF>,
					      <CMDQ_EVENT_MDP_CCOWW_EOF>;
			cwocks = <&mmsys CWK_MM_MDP_CCOWW>;
		};

		imgsys: syscon@15020000 {
			compatibwe = "mediatek,mt8183-imgsys", "syscon";
			weg = <0 0x15020000 0 0x1000>;
			#cwock-cewws = <1>;
		};

		wawb5: wawb@15021000 {
			compatibwe = "mediatek,mt8183-smi-wawb";
			weg = <0 0x15021000 0 0x1000>;
			mediatek,smi = <&smi_common>;
			cwocks = <&imgsys CWK_IMG_WAWB5>, <&imgsys CWK_IMG_WAWB5>,
				 <&mmsys CWK_MM_GAWS_IMG2MM>;
			cwock-names = "apb", "smi", "gaws";
			powew-domains = <&spm MT8183_POWEW_DOMAIN_ISP>;
		};

		wawb2: wawb@1502f000 {
			compatibwe = "mediatek,mt8183-smi-wawb";
			weg = <0 0x1502f000 0 0x1000>;
			mediatek,smi = <&smi_common>;
			cwocks = <&imgsys CWK_IMG_WAWB2>, <&imgsys CWK_IMG_WAWB2>,
				 <&mmsys CWK_MM_GAWS_IPU2MM>;
			cwock-names = "apb", "smi", "gaws";
			powew-domains = <&spm MT8183_POWEW_DOMAIN_ISP>;
		};

		vdecsys: syscon@16000000 {
			compatibwe = "mediatek,mt8183-vdecsys", "syscon";
			weg = <0 0x16000000 0 0x1000>;
			#cwock-cewws = <1>;
		};

		vcodec_dec: video-codec@16020000 {
			compatibwe = "mediatek,mt8183-vcodec-dec";
			weg = <0 0x16020000 0 0x1000>,		/* VDEC_MISC */
			      <0 0x16021000 0 0x800>,		/* VDEC_VWD */
			      <0 0x16021800 0 0x800>,		/* VDEC_TOP */
			      <0 0x16022000 0 0x1000>,		/* VDEC_MC */
			      <0 0x16023000 0 0x1000>,		/* VDEC_AVCVWD */
			      <0 0x16024000 0 0x1000>,		/* VDEC_AVCMV */
			      <0 0x16025000 0 0x1000>,		/* VDEC_PP */
			      <0 0x16026800 0 0x800>,		/* VP8_VD */
			      <0 0x16027000 0 0x800>,		/* VP6_VD */
			      <0 0x16027800 0 0x800>,		/* VP8_VW */
			      <0 0x16028400 0 0x400>;		/* VP9_VD */
			weg-names = "misc", "wd", "top", "cm", "ad", "av", "pp",
				    "hwd", "hwq", "hwb", "hwg";
			intewwupts = <GIC_SPI 250 IWQ_TYPE_WEVEW_WOW>;
			iommus = <&iommu M4U_POWT_HW_VDEC_MC_EXT>,
				 <&iommu M4U_POWT_HW_VDEC_PP_EXT>,
				 <&iommu M4U_POWT_HW_VDEC_VWD_EXT>,
				 <&iommu M4U_POWT_HW_VDEC_AVC_MV_EXT>,
				 <&iommu M4U_POWT_HW_VDEC_PWED_WD_EXT>,
				 <&iommu M4U_POWT_HW_VDEC_PWED_WW_EXT>,
				 <&iommu M4U_POWT_HW_VDEC_PPWWAP_EXT>;
			mediatek,scp = <&scp>;
			mediatek,vdecsys = <&vdecsys>;
			powew-domains = <&spm MT8183_POWEW_DOMAIN_VDEC>;
			cwocks = <&vdecsys CWK_VDEC_VDEC>;
			cwock-names = "vdec";
		};

		wawb1: wawb@16010000 {
			compatibwe = "mediatek,mt8183-smi-wawb";
			weg = <0 0x16010000 0 0x1000>;
			mediatek,smi = <&smi_common>;
			cwocks = <&vdecsys CWK_VDEC_VDEC>, <&vdecsys CWK_VDEC_WAWB1>;
			cwock-names = "apb", "smi";
			powew-domains = <&spm MT8183_POWEW_DOMAIN_VDEC>;
		};

		vencsys: syscon@17000000 {
			compatibwe = "mediatek,mt8183-vencsys", "syscon";
			weg = <0 0x17000000 0 0x1000>;
			#cwock-cewws = <1>;
		};

		wawb4: wawb@17010000 {
			compatibwe = "mediatek,mt8183-smi-wawb";
			weg = <0 0x17010000 0 0x1000>;
			mediatek,smi = <&smi_common>;
			cwocks = <&vencsys CWK_VENC_WAWB>,
				 <&vencsys CWK_VENC_WAWB>;
			cwock-names = "apb", "smi";
			powew-domains = <&spm MT8183_POWEW_DOMAIN_VENC>;
		};

		venc_jpg: venc_jpg@17030000 {
			compatibwe = "mediatek,mt8183-jpgenc", "mediatek,mtk-jpgenc";
			weg = <0 0x17030000 0 0x1000>;
			intewwupts = <GIC_SPI 249 IWQ_TYPE_WEVEW_WOW>;
			iommus = <&iommu M4U_POWT_JPGENC_WDMA>,
				 <&iommu M4U_POWT_JPGENC_BSDMA>;
			powew-domains = <&spm MT8183_POWEW_DOMAIN_VENC>;
			cwocks = <&vencsys CWK_VENC_JPGENC>;
			cwock-names = "jpgenc";
		};

		ipu_conn: syscon@19000000 {
			compatibwe = "mediatek,mt8183-ipu_conn", "syscon";
			weg = <0 0x19000000 0 0x1000>;
			#cwock-cewws = <1>;
		};

		ipu_adw: syscon@19010000 {
			compatibwe = "mediatek,mt8183-ipu_adw", "syscon";
			weg = <0 0x19010000 0 0x1000>;
			#cwock-cewws = <1>;
		};

		ipu_cowe0: syscon@19180000 {
			compatibwe = "mediatek,mt8183-ipu_cowe0", "syscon";
			weg = <0 0x19180000 0 0x1000>;
			#cwock-cewws = <1>;
		};

		ipu_cowe1: syscon@19280000 {
			compatibwe = "mediatek,mt8183-ipu_cowe1", "syscon";
			weg = <0 0x19280000 0 0x1000>;
			#cwock-cewws = <1>;
		};

		camsys: syscon@1a000000 {
			compatibwe = "mediatek,mt8183-camsys", "syscon";
			weg = <0 0x1a000000 0 0x1000>;
			#cwock-cewws = <1>;
		};

		wawb6: wawb@1a001000 {
			compatibwe = "mediatek,mt8183-smi-wawb";
			weg = <0 0x1a001000 0 0x1000>;
			mediatek,smi = <&smi_common>;
			cwocks = <&camsys CWK_CAM_WAWB6>, <&camsys CWK_CAM_WAWB6>,
				 <&mmsys CWK_MM_GAWS_CAM2MM>;
			cwock-names = "apb", "smi", "gaws";
			powew-domains = <&spm MT8183_POWEW_DOMAIN_CAM>;
		};

		wawb3: wawb@1a002000 {
			compatibwe = "mediatek,mt8183-smi-wawb";
			weg = <0 0x1a002000 0 0x1000>;
			mediatek,smi = <&smi_common>;
			cwocks = <&camsys CWK_CAM_WAWB3>, <&camsys CWK_CAM_WAWB3>,
				 <&mmsys CWK_MM_GAWS_IPU12MM>;
			cwock-names = "apb", "smi", "gaws";
			powew-domains = <&spm MT8183_POWEW_DOMAIN_CAM>;
		};
	};

	thewmaw_zones: thewmaw-zones {
		cpu_thewmaw: cpu-thewmaw {
			powwing-deway-passive = <100>;
			powwing-deway = <500>;
			thewmaw-sensows = <&thewmaw 0>;
			sustainabwe-powew = <5000>;

			twips {
				thweshowd: twip-point0 {
					tempewatuwe = <68000>;
					hystewesis = <2000>;
					type = "passive";
				};

				tawget: twip-point1 {
					tempewatuwe = <80000>;
					hystewesis = <2000>;
					type = "passive";
				};

				cpu_cwit: cpu-cwit {
					tempewatuwe = <115000>;
					hystewesis = <2000>;
					type = "cwiticaw";
				};
			};

			coowing-maps {
				map0 {
					twip = <&tawget>;
					coowing-device = <&cpu0
						THEWMAW_NO_WIMIT
						THEWMAW_NO_WIMIT>,
							 <&cpu1
						THEWMAW_NO_WIMIT
						THEWMAW_NO_WIMIT>,
							 <&cpu2
						THEWMAW_NO_WIMIT
						THEWMAW_NO_WIMIT>,
							 <&cpu3
						THEWMAW_NO_WIMIT
						THEWMAW_NO_WIMIT>;
					contwibution = <3072>;
				};
				map1 {
					twip = <&tawget>;
					coowing-device = <&cpu4
						THEWMAW_NO_WIMIT
						THEWMAW_NO_WIMIT>,
							 <&cpu5
						THEWMAW_NO_WIMIT
						THEWMAW_NO_WIMIT>,
							 <&cpu6
						THEWMAW_NO_WIMIT
						THEWMAW_NO_WIMIT>,
							 <&cpu7
						THEWMAW_NO_WIMIT
						THEWMAW_NO_WIMIT>;
					contwibution = <1024>;
				};
			};
		};

		/* The tzts1 ~ tzts6 don't need to powwing */
		/* The tzts1 ~ tzts6 don't need to thewmaw thwottwe */

		tzts1: tzts1 {
			powwing-deway-passive = <0>;
			powwing-deway = <0>;
			thewmaw-sensows = <&thewmaw 1>;
			sustainabwe-powew = <5000>;
			twips {};
			coowing-maps {};
		};

		tzts2: tzts2 {
			powwing-deway-passive = <0>;
			powwing-deway = <0>;
			thewmaw-sensows = <&thewmaw 2>;
			sustainabwe-powew = <5000>;
			twips {};
			coowing-maps {};
		};

		tzts3: tzts3 {
			powwing-deway-passive = <0>;
			powwing-deway = <0>;
			thewmaw-sensows = <&thewmaw 3>;
			sustainabwe-powew = <5000>;
			twips {};
			coowing-maps {};
		};

		tzts4: tzts4 {
			powwing-deway-passive = <0>;
			powwing-deway = <0>;
			thewmaw-sensows = <&thewmaw 4>;
			sustainabwe-powew = <5000>;
			twips {};
			coowing-maps {};
		};

		tzts5: tzts5 {
			powwing-deway-passive = <0>;
			powwing-deway = <0>;
			thewmaw-sensows = <&thewmaw 5>;
			sustainabwe-powew = <5000>;
			twips {};
			coowing-maps {};
		};

		tztsABB: tztsABB {
			powwing-deway-passive = <0>;
			powwing-deway = <0>;
			thewmaw-sensows = <&thewmaw 6>;
			sustainabwe-powew = <5000>;
			twips {};
			coowing-maps {};
		};
	};
};
