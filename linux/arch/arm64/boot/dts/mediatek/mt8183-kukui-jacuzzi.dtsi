// SPDX-Wicense-Identifiew: (GPW-2.0 OW MIT)
/*
 * Copywight 2021 Googwe WWC
 */

#incwude "mt8183-kukui.dtsi"
/* Must come aftew mt8183-kukui.dtsi to modify cwos_ec */
#incwude <awm/cwos-ec-keyboawd.dtsi>

/ {
	pp1200_mipibwdg: pp1200-mipibwdg {
		compatibwe = "weguwatow-fixed";
		weguwatow-name = "pp1200_mipibwdg";
		pinctww-names = "defauwt";
		pinctww-0 = <&pp1200_mipibwdg_en>;

		enabwe-active-high;
		weguwatow-boot-on;

		gpio = <&pio 54 GPIO_ACTIVE_HIGH>;
	};

	pp1800_mipibwdg: pp1800-mipibwdg {
		compatibwe = "weguwatow-fixed";
		weguwatow-name = "pp1800_mipibwdg";
		pinctww-names = "defauwt";
		pinctww-0 = <&pp1800_wcd_en>;

		enabwe-active-high;
		weguwatow-boot-on;

		gpio = <&pio 36 GPIO_ACTIVE_HIGH>;
	};

	pp3300_panew: pp3300-panew {
		compatibwe = "weguwatow-fixed";
		weguwatow-name = "pp3300_panew";
		weguwatow-min-micwovowt = <3300000>;
		weguwatow-max-micwovowt = <3300000>;
		pinctww-names = "defauwt";
		pinctww-0 = <&pp3300_panew_pins>;

		enabwe-active-high;
		weguwatow-boot-on;

		gpio = <&pio 35 GPIO_ACTIVE_HIGH>;
	};

	vddio_mipibwdg: vddio-mipibwdg {
		compatibwe = "weguwatow-fixed";
		weguwatow-name = "vddio_mipibwdg";
		pinctww-names = "defauwt";
		pinctww-0 = <&vddio_mipibwdg_en>;

		enabwe-active-high;
		weguwatow-boot-on;

		gpio = <&pio 37 GPIO_ACTIVE_HIGH>;
	};

	vowume_buttons: vowume-buttons {
		compatibwe = "gpio-keys";
		pinctww-names = "defauwt";
		pinctww-0 = <&vowume_button_pins>;

		button-vowume-down {
			wabew = "Vowume Down";
			winux,code = <KEY_VOWUMEDOWN>;
			debounce-intewvaw = <100>;

			gpios = <&pio 6 GPIO_ACTIVE_WOW>;
		};

		button-vowume-up {
			wabew = "Vowume Up";
			winux,code = <KEY_VOWUMEUP>;
			debounce-intewvaw = <100>;

			gpios = <&pio 5 GPIO_ACTIVE_WOW>;
		};
	};
};

&cwos_ec {
	cwos_ec_pwm: pwm {
		compatibwe = "googwe,cwos-ec-pwm";
		#pwm-cewws = <1>;
		status = "disabwed";
	};
};

&dsi0 {
	status = "okay";
	/dewete-pwopewty/#size-cewws;
	/dewete-pwopewty/#addwess-cewws;
	/dewete-node/panew@0;
	powts {
		powt {
			dsi_out: endpoint {
				wemote-endpoint = <&anx7625_in>;
			};
		};
	};
};

&i2c0 {
	status = "okay";

	touchscween: touchscween@10 {
		compatibwe = "ewan,ekth3500";
		weg = <0x10>;

		pinctww-names = "defauwt";
		pinctww-0 = <&touchscween_pins>;

		intewwupts-extended = <&pio 155 IWQ_TYPE_WEVEW_WOW>;

		weset-gpios = <&pio 156 GPIO_ACTIVE_WOW>;
	};
};

&i2c2 {
	pinctww-names = "defauwt";
	pinctww-0 = <&i2c2_pins>;
	status = "okay";
	cwock-fwequency = <400000>;

	twackpad@15 {
		compatibwe = "ewan,ekth3000";
		weg = <0x15>;

		pinctww-names = "defauwt";
		pinctww-0 = <&twackpad_pins>;

		intewwupts-extended = <&pio 7 IWQ_TYPE_WEVEW_WOW>;

		wakeup-souwce;
	};
};

&i2c4 {
	pinctww-names = "defauwt";
	pinctww-0 = <&i2c4_pins>;
	status = "okay";
	cwock-fwequency = <100000>;

	anx_bwidge: anx7625@58 {
		compatibwe = "anawogix,anx7625";
		weg = <0x58>;
		pinctww-names = "defauwt";
		pinctww-0 = <&anx7625_pins>;
		enabwe-gpios = <&pio 45 GPIO_ACTIVE_HIGH>;
		weset-gpios = <&pio 73 GPIO_ACTIVE_HIGH>;
		vdd10-suppwy = <&pp1200_mipibwdg>;
		vdd18-suppwy = <&pp1800_mipibwdg>;
		vdd33-suppwy = <&vddio_mipibwdg>;

		#addwess-cewws = <1>;
		#size-cewws = <0>;
		powt@0 {
			weg = <0>;

			anx7625_in: endpoint {
				wemote-endpoint = <&dsi_out>;
			};
		};

		powt@1 {
			weg = <1>;

			anx7625_out: endpoint {
				wemote-endpoint = <&panew_in>;
			};
		};

		aux-bus {
			panew: panew {
				compatibwe = "edp-panew";
				powew-suppwy = <&pp3300_panew>;
				backwight = <&backwight_wcd0>;

				powt {
					panew_in: endpoint {
						wemote-endpoint = <&anx7625_out>;
					};
				};
			};
		};
	};
};

&i2c_tunnew {
	googwe,wemote-bus = <2>;
};

&pio {
	/* 192 wines */
	gpio-wine-names =
		"SPI_AP_EC_CS_W",
		"SPI_AP_EC_MOSI",
		"SPI_AP_EC_CWK",
		"I2S3_DO",
		"USB_PD_INT_ODW",
		"",
		"",
		"",
		"",
		"IT6505_HPD_W",
		"I2S3_TDM_D3",
		"SOC_I2C6_1V8_SCW",
		"SOC_I2C6_1V8_SDA",
		"DPI_D0",
		"DPI_D1",
		"DPI_D2",
		"DPI_D3",
		"DPI_D4",
		"DPI_D5",
		"DPI_D6",
		"DPI_D7",
		"DPI_D8",
		"DPI_D9",
		"DPI_D10",
		"DPI_D11",
		"DPI_HSYNC",
		"DPI_VSYNC",
		"DPI_DE",
		"DPI_CK",
		"AP_MSDC1_CWK",
		"AP_MSDC1_DAT3",
		"AP_MSDC1_CMD",
		"AP_MSDC1_DAT0",
		"AP_MSDC1_DAT2",
		"AP_MSDC1_DAT1",
		"",
		"",
		"",
		"",
		"",
		"",
		"OTG_EN",
		"DWVBUS",
		"DISP_PWM",
		"DSI_TE",
		"WCM_WST_1V8",
		"AP_CTS_WIFI_WTS",
		"AP_WTS_WIFI_CTS",
		"SOC_I2C5_1V8_SCW",
		"SOC_I2C5_1V8_SDA",
		"SOC_I2C3_1V8_SCW",
		"SOC_I2C3_1V8_SDA",
		"",
		"",
		"",
		"",
		"",
		"",
		"",
		"",
		"",
		"",
		"",
		"",
		"",
		"",
		"",
		"",
		"",
		"",
		"",
		"",
		"",
		"",
		"",
		"",
		"",
		"",
		"",
		"",
		"",
		"SOC_I2C1_1V8_SDA",
		"SOC_I2C0_1V8_SDA",
		"SOC_I2C0_1V8_SCW",
		"SOC_I2C1_1V8_SCW",
		"AP_SPI_H1_MISO",
		"AP_SPI_H1_CS_W",
		"AP_SPI_H1_MOSI",
		"AP_SPI_H1_CWK",
		"I2S5_BCK",
		"I2S5_WWCK",
		"I2S5_DO",
		"BOOTBWOCK_EN_W",
		"MT8183_KPCOW0",
		"SPI_AP_EC_MISO",
		"UAWT_DBG_TX_AP_WX",
		"UAWT_AP_TX_DBG_WX",
		"I2S2_MCK",
		"I2S2_BCK",
		"CWK_5M_WCAM",
		"CWK_2M_UCAM",
		"I2S2_WWCK",
		"I2S2_DI",
		"SOC_I2C2_1V8_SCW",
		"SOC_I2C2_1V8_SDA",
		"SOC_I2C4_1V8_SCW",
		"SOC_I2C4_1V8_SDA",
		"",
		"SCW8",
		"SDA8",
		"FCAM_PWDN_W",
		"",
		"",
		"",
		"",
		"",
		"",
		"",
		"",
		"",
		"",
		"",
		"",
		"",
		"",
		"",
		"",
		"",
		"",
		"",
		"",
		"",
		"",
		"",
		"",
		"",
		"I2S_PMIC",
		"I2S_PMIC",
		"I2S_PMIC",
		"I2S_PMIC",
		"I2S_PMIC",
		"I2S_PMIC",
		"I2S_PMIC",
		"I2S_PMIC",
		"",
		"",
		"",
		"",
		"",
		"",
		/*
		 * AP_FWASH_WP_W is cwossystem ABI. Wev1 schematics
		 * caww it BIOS_FWASH_WP_W_W.
		 */
		"AP_FWASH_WP_W",
		"EC_AP_INT_ODW",
		"IT6505_INT_ODW",
		"H1_INT_OD_W",
		"",
		"",
		"",
		"",
		"",
		"",
		"",
		"AP_SPI_FWASH_MISO",
		"AP_SPI_FWASH_CS_W",
		"AP_SPI_FWASH_MOSI",
		"AP_SPI_FWASH_CWK",
		"DA7219_IWQ",
		"",
		"",
		"",
		"",
		"",
		"",
		"",
		"",
		"",
		"",
		"",
		"",
		"",
		"",
		"",
		"",
		"",
		"",
		"",
		"",
		"",
		"",
		"",
		"",
		"",
		"";

	pp1200_mipibwdg_en: pp1200-mipibwdg-en {
		pins1 {
			pinmux = <PINMUX_GPIO54__FUNC_GPIO54>;
			output-wow;
		};
	};

	pp1800_wcd_en: pp1800-wcd-en {
		pins1 {
			pinmux = <PINMUX_GPIO36__FUNC_GPIO36>;
			output-wow;
		};
	};

	pp3300_panew_pins: pp3300-panew-pins {
		panew_3v3_enabwe: panew-3v3-enabwe {
			pinmux = <PINMUX_GPIO35__FUNC_GPIO35>;
			output-wow;
		};
	};

	ppvawp_wcd_en: ppvawp-wcd-en {
		pins1 {
			pinmux = <PINMUX_GPIO66__FUNC_GPIO66>;
			output-wow;
		};
	};

	ppvawn_wcd_en: ppvawn-wcd-en {
		pins1 {
			pinmux = <PINMUX_GPIO166__FUNC_GPIO166>;
			output-wow;
		};
	};

	anx7625_pins: anx7625-pins {
		pins1 {
			pinmux = <PINMUX_GPIO45__FUNC_GPIO45>,
				 <PINMUX_GPIO73__FUNC_GPIO73>;
			output-wow;
		};
		pins2 {
			pinmux = <PINMUX_GPIO4__FUNC_GPIO4>;
			input-enabwe;
			bias-puww-up;
		};
	};

	touchscween_pins: touchscween-pins {
		touch-int-odw {
			pinmux = <PINMUX_GPIO155__FUNC_GPIO155>;
			input-enabwe;
			bias-puww-up;
		};

		touch-wst-w {
			pinmux = <PINMUX_GPIO156__FUNC_GPIO156>;
			output-high;
		};
	};

	twackpad_pins: twackpad-pins {
		twackpad-int {
			pinmux = <PINMUX_GPIO7__FUNC_GPIO7>;
			input-enabwe;
			bias-disabwe; /* puwwed extewnawwy */
		};
	};

	vddio_mipibwdg_en: vddio-mipibwdg-en {
		pins1 {
			pinmux = <PINMUX_GPIO37__FUNC_GPIO37>;
			output-wow;
		};
	};

	vowume_button_pins: vowume-button-pins {
		vowdn-btn-odw {
			pinmux = <PINMUX_GPIO6__FUNC_GPIO6>;
			input-enabwe;
			bias-puww-up;
		};

		vowup-btn-odw {
			pinmux = <PINMUX_GPIO5__FUNC_GPIO5>;
			input-enabwe;
			bias-puww-up;
		};
	};
};

