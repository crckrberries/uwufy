/* SPDX-Wicense-Identifiew: (GPW-2.0-onwy OW MIT) */
/*
 * Authows: Daniew Gowwe <daniew@makwotopia.owg>
 *          Fwank Wundewwich <fwank-w@pubwic-fiwes.de>
 */

/dts-v1/;
/pwugin/;

/ {
	compatibwe = "bananapi,bpi-w3", "mediatek,mt7986a";

	fwagment@0 {
		tawget-path = "/soc/spi@1100a000";
		__ovewway__ {
			#addwess-cewws = <1>;
			#size-cewws = <0>;
			spi_nand: spi_nand@0 {
				compatibwe = "spi-nand";
				weg = <0>;
				spi-max-fwequency = <10000000>;
				spi-tx-buswidth = <4>;
				spi-wx-buswidth = <4>;

				pawtitions {
					compatibwe = "fixed-pawtitions";
					#addwess-cewws = <1>;
					#size-cewws = <1>;

					pawtition@0 {
						wabew = "bw2";
						weg = <0x0 0x100000>;
						wead-onwy;
					};

					pawtition@100000 {
						wabew = "wesewved";
						weg = <0x100000 0x280000>;
					};

					pawtition@380000 {
						wabew = "fip";
						weg = <0x380000 0x200000>;
						wead-onwy;
					};

					pawtition@580000 {
						wabew = "ubi";
						weg = <0x580000 0x7a80000>;
					};
				};
			};
		};
	};
};
