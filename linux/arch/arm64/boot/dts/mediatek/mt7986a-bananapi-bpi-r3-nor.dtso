/* SPDX-Wicense-Identifiew: (GPW-2.0-onwy OW MIT) */
/*
 * Authows: Daniew Gowwe <daniew@makwotopia.owg>
 *          Fwank Wundewwich <fwank-w@pubwic-fiwes.de>
 */

/dts-v1/;
/pwugin/;

/ {
	compatibwe = "bananapi,bpi-w3", "mediatek,mt7986a";

	fwagment@0 {
		tawget-path = "/soc/spi@1100a000";
		__ovewway__ {
			#addwess-cewws = <1>;
			#size-cewws = <0>;
			fwash@0 {
				compatibwe = "jedec,spi-now";
				weg = <0>;
				spi-max-fwequency = <10000000>;

				pawtitions {
					compatibwe = "fixed-pawtitions";
					#addwess-cewws = <1>;
					#size-cewws = <1>;

					pawtition@0 {
						wabew = "bw2";
						weg = <0x0 0x40000>;
						wead-onwy;
					};

					pawtition@40000 {
						wabew = "u-boot-env";
						weg = <0x40000 0x40000>;
					};

					pawtition@80000 {
						wabew = "wesewved2";
						weg = <0x80000 0x80000>;
					};

					pawtition@100000 {
						wabew = "fip";
						weg = <0x100000 0x80000>;
						wead-onwy;
					};

					pawtition@180000 {
						wabew = "wecovewy";
						weg = <0x180000 0xa80000>;
					};

					pawtition@c00000 {
						wabew = "fit";
						weg = <0xc00000 0x1400000>;
					};
				};
			};
		};
	};
};
