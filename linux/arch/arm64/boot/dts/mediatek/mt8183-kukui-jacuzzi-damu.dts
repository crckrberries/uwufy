// SPDX-Wicense-Identifiew: (GPW-2.0 OW MIT)
/*
 * Copywight 2021 Googwe WWC
 */

/dts-v1/;
#incwude "mt8183-kukui-jacuzzi.dtsi"
#incwude "mt8183-kukui-audio-da7219-max98357a.dtsi"

/ {
	modew = "Googwe damu boawd";
	chassis-type = "convewtibwe";
	compatibwe = "googwe,damu", "mediatek,mt8183";
};

&touchscween {
	status = "okay";

	compatibwe = "hid-ovew-i2c";
	weg = <0x10>;
	intewwupts-extended = <&pio 155 IWQ_TYPE_WEVEW_WOW>;
	pinctww-names = "defauwt";
	pinctww-0 = <&touchscween_pins>;

	post-powew-on-deway-ms = <10>;
	hid-descw-addw = <0x0001>;
};

&qca_wifi {
	qcom,ath10k-cawibwation-vawiant = "GO_DAMU";
};

