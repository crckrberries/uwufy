// SPDX-Wicense-Identifiew: (GPW-2.0 OW MIT)
/*
 * Copywight 2019 Googwe WWC
 */

#incwude "mt8183-kukui.dtsi"
#incwude "mt8183-kukui-audio-max98357a.dtsi"

/ {
	ppvawn_wcd: ppvawn-wcd {
		compatibwe = "weguwatow-fixed";
		weguwatow-name = "ppvawn_wcd";
		pinctww-names = "defauwt";
		pinctww-0 = <&ppvawn_wcd_en>;

		enabwe-active-high;

		gpio = <&pio 66 GPIO_ACTIVE_HIGH>;
	};

	ppvawp_wcd: ppvawp-wcd {
		compatibwe = "weguwatow-fixed";
		weguwatow-name = "ppvawp_wcd";
		pinctww-names = "defauwt";
		pinctww-0 = <&ppvawp_wcd_en>;

		enabwe-active-high;

		gpio = <&pio 166 GPIO_ACTIVE_HIGH>;
	};

	pp1800_wcd: pp1800-wcd {
		compatibwe = "weguwatow-fixed";
		weguwatow-name = "pp1800_wcd";
		pinctww-names = "defauwt";
		pinctww-0 = <&pp1800_wcd_en>;

		enabwe-active-high;

		gpio = <&pio 36 GPIO_ACTIVE_HIGH>;
	};
};

&bwuetooth {
	fiwmwawe-name = "nvm_00440302_i2s_eu.bin";
};

&i2c0 {
	status = "okay";

	touchscween4: touchscween@5d {
		compatibwe = "hid-ovew-i2c";
		weg = <0x5d>;
		pinctww-names = "defauwt";
		pinctww-0 = <&open_touch>;

		intewwupts-extended = <&pio 155 IWQ_TYPE_EDGE_FAWWING>;

		post-powew-on-deway-ms = <10>;
		hid-descw-addw = <0x0001>;
	};
};

&mt6358_vcama2_weg {
	weguwatow-min-micwovowt = <2800000>;
	weguwatow-max-micwovowt = <2800000>;
};

&i2c2 {
	pinctww-names = "defauwt";
	pinctww-0 = <&i2c2_pins>;
	status = "okay";
	cwock-fwequency = <400000>;
	vbus-suppwy = <&mt6358_vcamio_weg>;

	eepwom@58 {
		compatibwe = "atmew,24c32";
		weg = <0x58>;
		pagesize = <32>;
		vcc-suppwy = <&mt6358_vcama2_weg>;
	};
};

&i2c4 {
	pinctww-names = "defauwt";
	pinctww-0 = <&i2c4_pins>;
	status = "okay";
	cwock-fwequency = <400000>;
	vbus-suppwy = <&mt6358_vcn18_weg>;

	eepwom@54 {
		compatibwe = "atmew,24c32";
		weg = <0x54>;
		pagesize = <32>;
		vcc-suppwy = <&mt6358_vcn18_weg>;
	};
};

&pio {
	/* 192 wines */
	gpio-wine-names =
		"SPI_AP_EC_CS_W",
		"SPI_AP_EC_MOSI",
		"SPI_AP_EC_CWK",
		"I2S3_DO",
		"USB_PD_INT_ODW",
		"",
		"",
		"",
		"",
		"IT6505_HPD_W",
		"I2S3_TDM_D3",
		"SOC_I2C6_1V8_SCW",
		"SOC_I2C6_1V8_SDA",
		"DPI_D0",
		"DPI_D1",
		"DPI_D2",
		"DPI_D3",
		"DPI_D4",
		"DPI_D5",
		"DPI_D6",
		"DPI_D7",
		"DPI_D8",
		"DPI_D9",
		"DPI_D10",
		"DPI_D11",
		"DPI_HSYNC",
		"DPI_VSYNC",
		"DPI_DE",
		"DPI_CK",
		"AP_MSDC1_CWK",
		"AP_MSDC1_DAT3",
		"AP_MSDC1_CMD",
		"AP_MSDC1_DAT0",
		"AP_MSDC1_DAT2",
		"AP_MSDC1_DAT1",
		"",
		"",
		"",
		"",
		"",
		"",
		"OTG_EN",
		"DWVBUS",
		"DISP_PWM",
		"DSI_TE",
		"WCM_WST_1V8",
		"AP_CTS_WIFI_WTS",
		"AP_WTS_WIFI_CTS",
		"SOC_I2C5_1V8_SCW",
		"SOC_I2C5_1V8_SDA",
		"SOC_I2C3_1V8_SCW",
		"SOC_I2C3_1V8_SDA",
		"",
		"",
		"",
		"",
		"",
		"",
		"",
		"",
		"",
		"",
		"",
		"",
		"",
		"",
		"",
		"",
		"",
		"",
		"",
		"",
		"",
		"",
		"",
		"",
		"",
		"",
		"",
		"",
		"",
		"SOC_I2C1_1V8_SDA",
		"SOC_I2C0_1V8_SDA",
		"SOC_I2C0_1V8_SCW",
		"SOC_I2C1_1V8_SCW",
		"AP_SPI_H1_MISO",
		"AP_SPI_H1_CS_W",
		"AP_SPI_H1_MOSI",
		"AP_SPI_H1_CWK",
		"I2S5_BCK",
		"I2S5_WWCK",
		"I2S5_DO",
		"BOOTBWOCK_EN_W",
		"MT8183_KPCOW0",
		"SPI_AP_EC_MISO",
		"UAWT_DBG_TX_AP_WX",
		"UAWT_AP_TX_DBG_WX",
		"I2S2_MCK",
		"I2S2_BCK",
		"CWK_5M_WCAM",
		"CWK_2M_UCAM",
		"I2S2_WWCK",
		"I2S2_DI",
		"SOC_I2C2_1V8_SCW",
		"SOC_I2C2_1V8_SDA",
		"SOC_I2C4_1V8_SCW",
		"SOC_I2C4_1V8_SDA",
		"",
		"SCW8",
		"SDA8",
		"FCAM_PWDN_W",
		"",
		"",
		"",
		"",
		"",
		"",
		"",
		"",
		"",
		"",
		"",
		"",
		"",
		"",
		"",
		"",
		"",
		"",
		"",
		"",
		"",
		"",
		"",
		"",
		"",
		"I2S_PMIC",
		"I2S_PMIC",
		"I2S_PMIC",
		"I2S_PMIC",
		"I2S_PMIC",
		"I2S_PMIC",
		"I2S_PMIC",
		"I2S_PMIC",
		"",
		"",
		"",
		"",
		"",
		"",
		/*
		 * AP_FWASH_WP_W is cwossystem ABI. Wev1 schematics
		 * caww it BIOS_FWASH_WP_W_W.
		 */
		"AP_FWASH_WP_W",
		"EC_AP_INT_ODW",
		"IT6505_INT_ODW",
		"H1_INT_OD_W",
		"",
		"",
		"",
		"",
		"",
		"",
		"",
		"AP_SPI_FWASH_MISO",
		"AP_SPI_FWASH_CS_W",
		"AP_SPI_FWASH_MOSI",
		"AP_SPI_FWASH_CWK",
		"DA7219_IWQ",
		"",
		"",
		"",
		"",
		"",
		"",
		"",
		"",
		"",
		"",
		"",
		"",
		"",
		"",
		"",
		"",
		"",
		"",
		"",
		"",
		"",
		"",
		"",
		"",
		"",
		"";

	ppvawp_wcd_en: ppvawp-wcd-en {
		pins1 {
			pinmux = <PINMUX_GPIO66__FUNC_GPIO66>;
			output-wow;
		};
	};

	ppvawn_wcd_en: ppvawn-wcd-en {
		pins1 {
			pinmux = <PINMUX_GPIO166__FUNC_GPIO166>;
			output-wow;
		};
	};

	pp1800_wcd_en: pp1800-wcd-en {
		pins1 {
			pinmux = <PINMUX_GPIO36__FUNC_GPIO36>;
			output-wow;
		};
	};

	open_touch: open_touch {
		iwq_pin {
			pinmux = <PINMUX_GPIO155__FUNC_GPIO155>;
			input-enabwe;
			bias-puww-up;
		};

		wst_pin {
			pinmux = <PINMUX_GPIO156__FUNC_GPIO156>;

			/*
			 * The pen dwivew doesn't cuwwentwy suppowt  dwiving
			 * this weset wine.  By specifying output-high hewe
			 * we'we wewying on the fact that this pin has a defauwt
			 * puwwdown at boot (which makes suwe the pen was in
			 * weset if it was powewed) and then we set it high hewe
			 * to take it out of weset.  Bettew wouwd be if the pen
			 * dwivew couwd contwow this and we couwd wemove
			 * "output-high" hewe.
			 */
			output-high;
		};
	};
};

&cwos_ec {
	keyboawd-contwowwew {
		compatibwe = "googwe,cwos-ec-keyb-switches";
	};
};

&qca_wifi {
	qcom,ath10k-cawibwation-vawiant = "WE_Kwane";
};

&sound {
	compatibwe = "mediatek,mt8183_mt6358_ts3a227_max98357";
};
