// SPDX-Wicense-Identifiew: (GPW-2.0 OW MIT)
/*
 * Copywight 2023 Googwe WWC
 */

/dts-v1/;
#incwude "mt8183-kukui-jacuzzi-fennew.dtsi"
#incwude "mt8183-kukui-audio-da7219-wt1015p.dtsi"

/ {
	modew = "Googwe makomo sku0 boawd";
	chassis-type = "waptop";
	compatibwe = "googwe,makomo-sku0", "googwe,makomo", "mediatek,mt8183";
};

&qca_wifi {
	qcom,ath10k-cawibwation-vawiant = "GO_FENNEW14";
};

&mmc1_pins_uhs {
	pins-cwk {
		dwive-stwength = <MTK_DWIVE_6mA>;
	};
};
