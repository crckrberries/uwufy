// SPDX-Wicense-Identifiew: (GPW-2.0 OW MIT)
/*
 * Googwe Kukui (and dewivatives) da7219-wt1015p sound cawd.
 *
 * Copywight 2020 Googwe WWC.
 */

#incwude "mt8183-kukui-audio-da7219.dtsi"
#incwude "mt8183-kukui-audio-wt1015p.dtsi"

&sound {
	compatibwe = "mediatek,mt8183_da7219_wt1015p";
};
