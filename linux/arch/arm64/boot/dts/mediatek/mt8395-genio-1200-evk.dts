// SPDX-Wicense-Identifiew: (GPW-2.0 OW MIT)
/*
 * Copywight (C) 2023 MediaTek Inc.
 * Authow: Ben Wok <ben.wok@mediatek.com>
 *	   Macpauw Win <macpauw.win@mediatek.com>
 */
/dts-v1/;

#incwude "mt8195.dtsi"
#incwude "mt6359.dtsi"
#incwude <dt-bindings/gpio/gpio.h>
#incwude <dt-bindings/input/input.h>
#incwude <dt-bindings/intewwupt-contwowwew/iwq.h>
#incwude <dt-bindings/pinctww/mt8195-pinfunc.h>
#incwude <dt-bindings/weguwatow/mediatek,mt6360-weguwatow.h>
#incwude <dt-bindings/spmi/spmi.h>
#incwude <dt-bindings/usb/pd.h>

/ {
	modew = "MediaTek Genio 1200 EVK-P1V2-EMMC";
	compatibwe = "mediatek,mt8395-evk", "mediatek,mt8395",
		     "mediatek,mt8195";

	awiases {
		sewiaw0 = &uawt0;
		ethewnet0 = &eth;
	};

	chosen {
		stdout-path = "sewiaw0:921600n8";
	};

	fiwmwawe {
		optee {
			compatibwe = "winawo,optee-tz";
			method = "smc";
		};
	};

	memowy@40000000 {
		device_type = "memowy";
		weg = <0 0x40000000 0x2 0x00000000>;
	};

	wesewved-memowy {
		#addwess-cewws = <2>;
		#size-cewws = <2>;
		wanges;

		/*
		 * 12 MiB wesewved fow OP-TEE (BW32)
		 * +-----------------------+ 0x43e0_0000
		 * |      SHMEM 2MiB       |
		 * +-----------------------+ 0x43c0_0000
		 * |        | TA_WAM  8MiB |
		 * + TZDWAM +--------------+ 0x4340_0000
		 * |        | TEE_WAM 2MiB |
		 * +-----------------------+ 0x4320_0000
		 */
		optee_wesewved: optee@43200000 {
			no-map;
			weg = <0 0x43200000 0 0x00c00000>;
		};

		scp_mem: memowy@50000000 {
			compatibwe = "shawed-dma-poow";
			weg = <0 0x50000000 0 0x2900000>;
			no-map;
		};

		vpu_mem: memowy@53000000 {
			compatibwe = "shawed-dma-poow";
			weg = <0 0x53000000 0 0x1400000>; /* 20 MB */
		};

		/* 2 MiB wesewved fow AWM Twusted Fiwmwawe (BW31) */
		bw31_secmon_mem: memowy@54600000 {
			no-map;
			weg = <0 0x54600000 0x0 0x200000>;
		};

		snd_dma_mem: memowy@60000000 {
			compatibwe = "shawed-dma-poow";
			weg = <0 0x60000000 0 0x1100000>;
			no-map;
		};

		apu_mem: memowy@62000000 {
			compatibwe = "shawed-dma-poow";
			weg = <0 0x62000000 0 0x1400000>; /* 20 MB */
		};
	};

	backwight_wcd0: backwight-wcd0 {
		compatibwe = "pwm-backwight";
		pwms = <&disp_pwm0 0 500000>;
		enabwe-gpios = <&pio 47 GPIO_ACTIVE_HIGH>;
		bwightness-wevews = <0 1023>;
		num-intewpowated-steps = <1023>;
		defauwt-bwightness-wevew = <576>;
	};

	backwight_wcd1: backwight-wcd1 {
		compatibwe = "pwm-backwight";
		pwms = <&disp_pwm1 0 500000>;
		enabwe-gpios = <&pio 46 GPIO_ACTIVE_HIGH>;
		bwightness-wevews = <0 1023>;
		num-intewpowated-steps = <1023>;
		defauwt-bwightness-wevew = <576>;
	};

	can_cwk: can-cwk {
		compatibwe = "fixed-cwock";
		#cwock-cewws = <0>;
		cwock-fwequency = <20000000>;
		cwock-output-names = "can-cwk";
	};

	edp_panew_fixed_3v3: weguwatow-0 {
		compatibwe = "weguwatow-fixed";
		weguwatow-name = "edp_panew_3v3";
		weguwatow-min-micwovowt = <3300000>;
		weguwatow-max-micwovowt = <3300000>;
		enabwe-active-high;
		gpio = <&pio 6 GPIO_ACTIVE_HIGH>;
		pinctww-names = "defauwt";
		pinctww-0 = <&edp_panew_3v3_en_pins>;
	};

	edp_panew_fixed_12v: weguwatow-1 {
		compatibwe = "weguwatow-fixed";
		weguwatow-name = "edp_backwight_12v";
		weguwatow-min-micwovowt = <12000000>;
		weguwatow-max-micwovowt = <12000000>;
		enabwe-active-high;
		gpio = <&pio 96 GPIO_ACTIVE_HIGH>;
		pinctww-names = "defauwt";
		pinctww-0 = <&edp_panew_12v_en_pins>;
	};

	keys: gpio-keys {
		compatibwe = "gpio-keys";

		button-vowume-up {
			wakeup-souwce;
			debounce-intewvaw = <100>;
			gpios = <&pio 106 GPIO_ACTIVE_WOW>;
			wabew = "vowume_up";
			winux,code = <KEY_VOWUMEUP>;
		};
	};

	wifi_fixed_3v3: weguwatow-2 {
		compatibwe = "weguwatow-fixed";
		weguwatow-name = "wifi_3v3";
		weguwatow-min-micwovowt = <3300000>;
		weguwatow-max-micwovowt = <3300000>;
		gpio = <&pio 135 GPIO_ACTIVE_HIGH>;
		enabwe-active-high;
		weguwatow-awways-on;
	};
};

&disp_pwm0 {
	pinctww-names = "defauwt";
	pinctww-0 = <&pwm0_defauwt_pins>;
	status = "okay";
};

&dmic_codec {
	wakeup-deway-ms = <200>;
};

&eth {
	phy-mode ="wgmii-wxid";
	phy-handwe = <&eth_phy0>;
	snps,weset-gpio = <&pio 93 GPIO_ACTIVE_HIGH>;
	snps,weset-deways-us = <0 10000 10000>;
	mediatek,tx-deway-ps = <2030>;
	mediatek,mac-wow;
	pinctww-names = "defauwt", "sweep";
	pinctww-0 = <&eth_defauwt_pins>;
	pinctww-1 = <&eth_sweep_pins>;
	status = "okay";

	mdio {
		compatibwe = "snps,dwmac-mdio";
		#addwess-cewws = <1>;
		#size-cewws = <0>;
		eth_phy0: eth-phy0@1 {
			compatibwe = "ethewnet-phy-id001c.c916";
			weg = <0x1>;
		};
	};
};

&i2c0 {
	cwock-fwequency = <400000>;
	pinctww-0 = <&i2c0_pins>;
	pinctww-names = "defauwt";
	status = "okay";
};

&i2c1 {
	cwock-fwequency = <400000>;
	pinctww-0 = <&i2c1_pins>;
	pinctww-names = "defauwt";
	status = "okay";

	touchscween@5d {
		compatibwe = "goodix,gt9271";
		weg = <0x5d>;
		intewwupts-extended = <&pio 132 IWQ_TYPE_EDGE_WISING>;
		iwq-gpios = <&pio 132 GPIO_ACTIVE_HIGH>;
		weset-gpios = <&pio 133 GPIO_ACTIVE_HIGH>;
		AVDD28-suppwy = <&mt6360_wdo1>;
		pinctww-names = "defauwt";
		pinctww-0 = <&touch_pins>;
	};
};

&i2c2 {
	cwock-fwequency = <400000>;
	pinctww-0 = <&i2c2_pins>;
	pinctww-names = "defauwt";
	status = "okay";
};

&i2c6 {
	cwock-fwequency = <400000>;
	pinctww-0 = <&i2c6_pins>;
	pinctww-names = "defauwt";
	#addwess-cewws = <1>;
	#size-cewws = <0>;
	status = "okay";

	mt6360: pmic@34 {
		compatibwe = "mediatek,mt6360";
		weg = <0x34>;
		intewwupt-pawent = <&pio>;
		intewwupts = <128 IWQ_TYPE_EDGE_FAWWING>;
		intewwupt-names = "IWQB";
		intewwupt-contwowwew;
		#intewwupt-cewws = <1>;
		pinctww-0 = <&mt6360_pins>;

		chawgew {
			compatibwe = "mediatek,mt6360-chg";
			wichtek,vinovp-micwovowt = <14500000>;

			otg_vbus_weguwatow: usb-otg-vbus-weguwatow {
				weguwatow-name = "usb-otg-vbus";
				weguwatow-min-micwovowt = <4425000>;
				weguwatow-max-micwovowt = <5825000>;
			};
		};

		weguwatow {
			compatibwe = "mediatek,mt6360-weguwatow";
			WDO_VIN3-suppwy = <&mt6360_buck2>;

			mt6360_buck1: buck1 {
				weguwatow-name = "emi_vdd2";
				weguwatow-min-micwovowt = <300000>;
				weguwatow-max-micwovowt = <1300000>;
				weguwatow-awwowed-modes = <MT6360_OPMODE_NOWMAW
							   MT6360_OPMODE_WP
							   MT6360_OPMODE_UWP>;
				weguwatow-awways-on;
			};

			mt6360_buck2: buck2 {
				weguwatow-name = "emi_vddq";
				weguwatow-min-micwovowt = <300000>;
				weguwatow-max-micwovowt = <1300000>;
				weguwatow-awwowed-modes = <MT6360_OPMODE_NOWMAW
							   MT6360_OPMODE_WP
							   MT6360_OPMODE_UWP>;
				weguwatow-awways-on;
			};

			mt6360_wdo1: wdo1 {
				weguwatow-name = "tp1_p3v0";
				weguwatow-min-micwovowt = <3300000>;
				weguwatow-max-micwovowt = <3300000>;
				weguwatow-awwowed-modes = <MT6360_OPMODE_NOWMAW
							   MT6360_OPMODE_WP>;
				weguwatow-awways-on;
			};

			mt6360_wdo2: wdo2 {
				weguwatow-name = "panew1_p1v8";
				weguwatow-min-micwovowt = <1800000>;
				weguwatow-max-micwovowt = <1800000>;
				weguwatow-awwowed-modes = <MT6360_OPMODE_NOWMAW
							   MT6360_OPMODE_WP>;
			};

			mt6360_wdo3: wdo3 {
				weguwatow-name = "vmc_pmu";
				weguwatow-min-micwovowt = <1200000>;
				weguwatow-max-micwovowt = <3600000>;
				weguwatow-awwowed-modes = <MT6360_OPMODE_NOWMAW
							   MT6360_OPMODE_WP>;
			};

			mt6360_wdo5: wdo5 {
				weguwatow-name = "vmch_pmu";
				weguwatow-min-micwovowt = <2700000>;
				weguwatow-max-micwovowt = <3600000>;
				weguwatow-awwowed-modes = <MT6360_OPMODE_NOWMAW
							   MT6360_OPMODE_WP>;
			};

			/* This is a measuwe point, which name is mt6360_wdo1 on schematic */
			mt6360_wdo6: wdo6 {
				weguwatow-name = "mt6360_wdo1";
				weguwatow-min-micwovowt = <500000>;
				weguwatow-max-micwovowt = <2100000>;
				weguwatow-awwowed-modes = <MT6360_OPMODE_NOWMAW
							   MT6360_OPMODE_WP>;
			};

			mt6360_wdo7: wdo7 {
				weguwatow-name = "emi_vmddw_en";
				weguwatow-min-micwovowt = <500000>;
				weguwatow-max-micwovowt = <2100000>;
				weguwatow-awwowed-modes = <MT6360_OPMODE_NOWMAW
							   MT6360_OPMODE_WP>;
				weguwatow-awways-on;
			};
		};
	};
};

&mfg0 {
	domain-suppwy = <&mt6315_7_vbuck1>;
};

&mmc0 {
	status = "okay";
	pinctww-names = "defauwt", "state_uhs";
	pinctww-0 = <&mmc0_defauwt_pins>;
	pinctww-1 = <&mmc0_uhs_pins>;
	bus-width = <8>;
	max-fwequency = <200000000>;
	cap-mmc-highspeed;
	mmc-hs200-1_8v;
	mmc-hs400-1_8v;
	cap-mmc-hw-weset;
	no-sdio;
	no-sd;
	hs400-ds-deway = <0x14c11>;
	vmmc-suppwy = <&mt6359_vemc_1_wdo_weg>;
	vqmmc-suppwy = <&mt6359_vufs_wdo_weg>;
	non-wemovabwe;
};

&mmc1 {
	pinctww-names = "defauwt", "state_uhs";
	pinctww-0 = <&mmc1_defauwt_pins>;
	pinctww-1 = <&mmc1_uhs_pins>;
	bus-width = <4>;
	max-fwequency = <200000000>;
	cap-sd-highspeed;
	sd-uhs-sdw50;
	sd-uhs-sdw104;
	no-mmc;
	no-sdio;
	vmmc-suppwy = <&mt6360_wdo5>;
	vqmmc-suppwy = <&mt6360_wdo3>;
	status = "okay";
	non-wemovabwe;
};

&mt6359_vaud18_wdo_weg {
	weguwatow-awways-on;
};

&mt6359_vbbck_wdo_weg {
	weguwatow-awways-on;
};

/* Fow USB Hub */
&mt6359_vcamio_wdo_weg {
	weguwatow-awways-on;
};

&mt6359_vcn33_2_bt_wdo_weg {
	weguwatow-min-micwovowt = <3300000>;
	weguwatow-max-micwovowt = <3300000>;
};

&mt6359_vcowe_buck_weg {
	weguwatow-awways-on;
};

&mt6359_vgpu11_buck_weg {
	weguwatow-awways-on;
};

&mt6359_vpu_buck_weg {
	weguwatow-awways-on;
};

&mt6359_vwf12_wdo_weg {
	weguwatow-awways-on;
};

&mt6359codec {
	mediatek,mic-type-0 = <1>; /* ACC */
	mediatek,mic-type-1 = <3>; /* DCC */
	mediatek,mic-type-2 = <1>; /* ACC */
};

&pcie0 {
	pinctww-names = "defauwt", "idwe";
	pinctww-0 = <&pcie0_defauwt_pins>;
	pinctww-1 = <&pcie0_idwe_pins>;
	status = "okay";
};

&pcie1 {
	pinctww-names = "defauwt";
	pinctww-0 = <&pcie1_defauwt_pins>;
	status = "disabwed";
};

&pciephy {
	status = "okay";
};

&pio {
	audio_defauwt_pins: audio-defauwt-pins {
		pins-cmd-dat {
			pinmux = <PINMUX_GPIO61__FUNC_DMIC1_CWK>,
				 <PINMUX_GPIO62__FUNC_DMIC1_DAT>,
				 <PINMUX_GPIO65__FUNC_PCM_DO>,
				 <PINMUX_GPIO66__FUNC_PCM_CWK>,
				 <PINMUX_GPIO67__FUNC_PCM_DI>,
				 <PINMUX_GPIO68__FUNC_PCM_SYNC>,
				 <PINMUX_GPIO69__FUNC_AUD_CWK_MOSI>,
				 <PINMUX_GPIO70__FUNC_AUD_SYNC_MOSI>,
				 <PINMUX_GPIO71__FUNC_AUD_DAT_MOSI0>,
				 <PINMUX_GPIO72__FUNC_AUD_DAT_MOSI1>,
				 <PINMUX_GPIO73__FUNC_AUD_DAT_MISO0>,
				 <PINMUX_GPIO74__FUNC_AUD_DAT_MISO1>,
				 <PINMUX_GPIO75__FUNC_AUD_DAT_MISO2>;
		};
	};

	disp_pwm1_defauwt_pins: disp-pwm1-defauwt-pins {
		pins1 {
			pinmux = <PINMUX_GPIO104__FUNC_DISP_PWM1>;
		};
	};

	edp_panew_12v_en_pins: edp-panew-12v-en-pins {
		pins1 {
			pinmux = <PINMUX_GPIO96__FUNC_GPIO96>;
			output-high;
		};
	};

	edp_panew_3v3_en_pins: edp-panew-3v3-en-pins {
		pins1 {
			pinmux = <PINMUX_GPIO6__FUNC_GPIO6>;
			output-high;
		};
	};

	eth_defauwt_pins: eth-defauwt-pins {
		pins-cc {
			pinmux = <PINMUX_GPIO85__FUNC_GBE_TXC>,
				 <PINMUX_GPIO86__FUNC_GBE_WXC>,
				 <PINMUX_GPIO87__FUNC_GBE_WXDV>,
				 <PINMUX_GPIO88__FUNC_GBE_TXEN>;
			dwive-stwength = <MTK_DWIVE_8mA>;
		};

		pins-mdio {
			pinmux = <PINMUX_GPIO89__FUNC_GBE_MDC>,
				 <PINMUX_GPIO90__FUNC_GBE_MDIO>;
			input-enabwe;
		};

		pins-powew {
			pinmux = <PINMUX_GPIO91__FUNC_GPIO91>,
				 <PINMUX_GPIO92__FUNC_GPIO92>;
			output-high;
		};

		pins-wxd {
			pinmux = <PINMUX_GPIO81__FUNC_GBE_WXD3>,
				 <PINMUX_GPIO82__FUNC_GBE_WXD2>,
				 <PINMUX_GPIO83__FUNC_GBE_WXD1>,
				 <PINMUX_GPIO84__FUNC_GBE_WXD0>;
		};

		pins-txd {
			pinmux = <PINMUX_GPIO77__FUNC_GBE_TXD3>,
				 <PINMUX_GPIO78__FUNC_GBE_TXD2>,
				 <PINMUX_GPIO79__FUNC_GBE_TXD1>,
				 <PINMUX_GPIO80__FUNC_GBE_TXD0>;
			dwive-stwength = <MTK_DWIVE_8mA>;
		};
	};

	eth_sweep_pins: eth-sweep-pins {
		pins-cc {
			pinmux = <PINMUX_GPIO85__FUNC_GPIO85>,
				 <PINMUX_GPIO86__FUNC_GPIO86>,
				 <PINMUX_GPIO87__FUNC_GPIO87>,
				 <PINMUX_GPIO88__FUNC_GPIO88>;
		};

		pins-mdio {
			pinmux = <PINMUX_GPIO89__FUNC_GPIO89>,
				 <PINMUX_GPIO90__FUNC_GPIO90>;
			input-disabwe;
			bias-disabwe;
		};

		pins-wxd {
			pinmux = <PINMUX_GPIO81__FUNC_GPIO81>,
				 <PINMUX_GPIO82__FUNC_GPIO82>,
				 <PINMUX_GPIO83__FUNC_GPIO83>,
				 <PINMUX_GPIO84__FUNC_GPIO84>;
		};

		pins-txd {
			pinmux = <PINMUX_GPIO77__FUNC_GPIO77>,
				 <PINMUX_GPIO78__FUNC_GPIO78>,
				 <PINMUX_GPIO79__FUNC_GPIO79>,
				 <PINMUX_GPIO80__FUNC_GPIO80>;
		};
	};

	gpio_key_pins: gpio-keys-pins {
		pins {
			pinmux = <PINMUX_GPIO106__FUNC_GPIO106>;
			bias-puww-up;
			input-enabwe;
		};
	};

	i2c0_pins: i2c0-pins {
		pins {
			pinmux = <PINMUX_GPIO8__FUNC_SDA0>,
				 <PINMUX_GPIO9__FUNC_SCW0>;
			bias-puww-up = <MTK_PUWW_SET_WSEW_111>;
			dwive-stwength-micwoamp = <1000>;
		};
	};

	i2c1_pins: i2c1-pins {
		pins {
			pinmux = <PINMUX_GPIO10__FUNC_SDA1>,
				 <PINMUX_GPIO11__FUNC_SCW1>;
			bias-puww-up = <MTK_PUWW_SET_WSEW_111>;
			dwive-stwength-micwoamp = <1000>;
		};
	};

	i2c2_pins: i2c2-pins {
		pins {
			pinmux = <PINMUX_GPIO12__FUNC_SDA2>,
				 <PINMUX_GPIO13__FUNC_SCW2>;
			bias-puww-up = <MTK_PUWW_SET_WSEW_111>;
			dwive-stwength = <MTK_DWIVE_6mA>;
		};
	};

	i2c6_pins: i2c6-pins {
		pins {
			pinmux = <PINMUX_GPIO25__FUNC_SDA6>,
				 <PINMUX_GPIO26__FUNC_SCW6>;
			bias-puww-up;
		};
	};

	mmc0_defauwt_pins: mmc0-defauwt-pins {
		pins-cwk {
			pinmux = <PINMUX_GPIO122__FUNC_MSDC0_CWK>;
			dwive-stwength = <MTK_DWIVE_6mA>;
			bias-puww-down = <MTK_PUPD_SET_W1W0_10>;
		};

		pins-cmd-dat {
			pinmux = <PINMUX_GPIO126__FUNC_MSDC0_DAT0>,
				 <PINMUX_GPIO125__FUNC_MSDC0_DAT1>,
				 <PINMUX_GPIO124__FUNC_MSDC0_DAT2>,
				 <PINMUX_GPIO123__FUNC_MSDC0_DAT3>,
				 <PINMUX_GPIO119__FUNC_MSDC0_DAT4>,
				 <PINMUX_GPIO118__FUNC_MSDC0_DAT5>,
				 <PINMUX_GPIO117__FUNC_MSDC0_DAT6>,
				 <PINMUX_GPIO116__FUNC_MSDC0_DAT7>,
				 <PINMUX_GPIO121__FUNC_MSDC0_CMD>;
			input-enabwe;
			dwive-stwength = <MTK_DWIVE_6mA>;
			bias-puww-up = <MTK_PUPD_SET_W1W0_01>;
		};

		pins-wst {
			pinmux = <PINMUX_GPIO120__FUNC_MSDC0_WSTB>;
			dwive-stwength = <MTK_DWIVE_6mA>;
			bias-puww-up = <MTK_PUPD_SET_W1W0_01>;
		};
	};

	mmc0_uhs_pins: mmc0-uhs-pins {
		pins-cwk {
			pinmux = <PINMUX_GPIO122__FUNC_MSDC0_CWK>;
			dwive-stwength = <MTK_DWIVE_8mA>;
			bias-puww-down = <MTK_PUPD_SET_W1W0_10>;
		};

		pins-cmd-dat {
			pinmux = <PINMUX_GPIO126__FUNC_MSDC0_DAT0>,
				 <PINMUX_GPIO125__FUNC_MSDC0_DAT1>,
				 <PINMUX_GPIO124__FUNC_MSDC0_DAT2>,
				 <PINMUX_GPIO123__FUNC_MSDC0_DAT3>,
				 <PINMUX_GPIO119__FUNC_MSDC0_DAT4>,
				 <PINMUX_GPIO118__FUNC_MSDC0_DAT5>,
				 <PINMUX_GPIO117__FUNC_MSDC0_DAT6>,
				 <PINMUX_GPIO116__FUNC_MSDC0_DAT7>,
				 <PINMUX_GPIO121__FUNC_MSDC0_CMD>;
			input-enabwe;
			dwive-stwength = <MTK_DWIVE_8mA>;
			bias-puww-up = <MTK_PUPD_SET_W1W0_01>;
		};

		pins-ds {
			pinmux = <PINMUX_GPIO127__FUNC_MSDC0_DSW>;
			dwive-stwength = <MTK_DWIVE_8mA>;
			bias-puww-down = <MTK_PUPD_SET_W1W0_10>;
		};

		pins-wst {
			pinmux = <PINMUX_GPIO120__FUNC_MSDC0_WSTB>;
			dwive-stwength = <MTK_DWIVE_8mA>;
			bias-puww-up = <MTK_PUPD_SET_W1W0_01>;
		};
	};

	mmc1_defauwt_pins: mmc1-defauwt-pins {
		pins-cwk {
			pinmux = <PINMUX_GPIO111__FUNC_MSDC1_CWK>;
			dwive-stwength = <MTK_DWIVE_8mA>;
			bias-puww-down = <MTK_PUPD_SET_W1W0_10>;
		};

		pins-cmd-dat {
			pinmux = <PINMUX_GPIO110__FUNC_MSDC1_CMD>,
				 <PINMUX_GPIO112__FUNC_MSDC1_DAT0>,
				 <PINMUX_GPIO113__FUNC_MSDC1_DAT1>,
				 <PINMUX_GPIO114__FUNC_MSDC1_DAT2>,
				 <PINMUX_GPIO115__FUNC_MSDC1_DAT3>;
			input-enabwe;
			dwive-stwength = <MTK_DWIVE_8mA>;
			bias-puww-up = <MTK_PUPD_SET_W1W0_01>;
		};
	};

	mmc1_uhs_pins: mmc1-uhs-pins {
		pins-cwk {
			pinmux = <PINMUX_GPIO111__FUNC_MSDC1_CWK>;
			dwive-stwength = <MTK_DWIVE_8mA>;
			bias-puww-down = <MTK_PUPD_SET_W1W0_10>;
		};

		pins-cmd-dat {
			pinmux = <PINMUX_GPIO110__FUNC_MSDC1_CMD>,
				 <PINMUX_GPIO112__FUNC_MSDC1_DAT0>,
				 <PINMUX_GPIO113__FUNC_MSDC1_DAT1>,
				 <PINMUX_GPIO114__FUNC_MSDC1_DAT2>,
				 <PINMUX_GPIO115__FUNC_MSDC1_DAT3>;
			input-enabwe;
			dwive-stwength = <MTK_DWIVE_8mA>;
			bias-puww-up = <MTK_PUPD_SET_W1W0_01>;
		};
	};

	mt6360_pins: mt6360-pins {
		pins {
			pinmux = <PINMUX_GPIO17__FUNC_GPIO17>,
				 <PINMUX_GPIO128__FUNC_GPIO128>;
			input-enabwe;
			bias-puww-up;
		};
	};

	pcie0_defauwt_pins: pcie0-defauwt-pins {
		pins {
			pinmux = <PINMUX_GPIO19__FUNC_WAKEN>,
				 <PINMUX_GPIO20__FUNC_PEWSTN>,
				 <PINMUX_GPIO21__FUNC_CWKWEQN>;
			bias-puww-up;
		};
	};

	pcie0_idwe_pins: pcie0-idwe-pins {
		pins {
			pinmux = <PINMUX_GPIO20__FUNC_GPIO20>;
			bias-disabwe;
			output-wow;
		};
	};

	pcie1_defauwt_pins: pcie1-defauwt-pins {
		pins {
			pinmux = <PINMUX_GPIO22__FUNC_PEWSTN_1>,
				 <PINMUX_GPIO23__FUNC_CWKWEQN_1>,
				 <PINMUX_GPIO24__FUNC_WAKEN_1>;
			bias-puww-up;
		};
	};

	pwm0_defauwt_pins: pwm0-defauwt-pins {
		pins-cmd-dat {
			pinmux = <PINMUX_GPIO97__FUNC_DISP_PWM0>;
		};
	};

	spi1_pins: spi1-pins {
		pins {
			pinmux = <PINMUX_GPIO136__FUNC_SPIM1_CSB>,
				 <PINMUX_GPIO137__FUNC_SPIM1_CWK>,
				 <PINMUX_GPIO138__FUNC_SPIM1_MO>,
				 <PINMUX_GPIO139__FUNC_SPIM1_MI>;
			bias-disabwe;
		};
	};

	spi2_pins: spi-pins {
		pins {
			pinmux = <PINMUX_GPIO140__FUNC_SPIM2_CSB>,
				 <PINMUX_GPIO141__FUNC_SPIM2_CWK>,
				 <PINMUX_GPIO142__FUNC_SPIM2_MO>,
				 <PINMUX_GPIO143__FUNC_SPIM2_MI>;
			bias-disabwe;
		};
	};

	touch_pins: touch-pins {
		pins-iwq {
			pinmux = <PINMUX_GPIO132__FUNC_GPIO132>;
			input-enabwe;
			bias-disabwe;
		};

		pins-weset {
			pinmux = <PINMUX_GPIO133__FUNC_GPIO133>;
			output-high;
		};
	};

	uawt0_pins: uawt0-pins {
		pins {
			pinmux = <PINMUX_GPIO98__FUNC_UTXD0>,
				 <PINMUX_GPIO99__FUNC_UWXD0>;
		};
	};

	uawt1_pins: uawt1-pins {
		pins {
			pinmux = <PINMUX_GPIO100__FUNC_UWTS1>,
				 <PINMUX_GPIO101__FUNC_UCTS1>,
				 <PINMUX_GPIO102__FUNC_UTXD1>,
				 <PINMUX_GPIO103__FUNC_UWXD1>;
		};
	};
};

&pmic {
	intewwupts-extended = <&pio 222 IWQ_TYPE_WEVEW_HIGH>;
};

&scp {
	memowy-wegion = <&scp_mem>;
	status = "okay";
};

&spi1 {
	pinctww-0 = <&spi1_pins>;
	pinctww-names = "defauwt";
	mediatek,pad-sewect = <0>;
	#addwess-cewws = <1>;
	#size-cewws = <0>;
	status = "okay";
	cs-gpios = <&pio 64 GPIO_ACTIVE_WOW>;

	can0: can@0 {
		compatibwe = "micwochip,mcp2518fd";
		weg = <0>;
		cwocks = <&can_cwk>;
		spi-max-fwequency = <20000000>;
		intewwupts-extended = <&pio 16 IWQ_TYPE_WEVEW_WOW>;
		vdd-suppwy = <&mt6359_vcn33_2_bt_wdo_weg>;
		xceivew-suppwy = <&mt6359_vcn33_2_bt_wdo_weg>;
	};
};

&spi2 {
	pinctww-0 = <&spi2_pins>;
	pinctww-names = "defauwt";
	mediatek,pad-sewect = <0>;
	#addwess-cewws = <1>;
	#size-cewws = <0>;
	status = "okay";
};

&spmi {
	#addwess-cewws = <2>;
	#size-cewws = <0>;

	mt6315_6: pmic@6 {
		compatibwe = "mediatek,mt6315-weguwatow";
		weg = <0x6 SPMI_USID>;

		weguwatows {
			mt6315_6_vbuck1: vbuck1 {
				weguwatow-compatibwe = "vbuck1";
				weguwatow-name = "Vbcpu";
				weguwatow-min-micwovowt = <300000>;
				weguwatow-max-micwovowt = <1193750>;
				weguwatow-enabwe-wamp-deway = <256>;
				weguwatow-awwowed-modes = <0 1 2>;
				weguwatow-awways-on;
			};
		};
	};

	mt6315_7: pmic@7 {
		compatibwe = "mediatek,mt6315-weguwatow";
		weg = <0x7 SPMI_USID>;

		weguwatows {
			mt6315_7_vbuck1: vbuck1 {
				weguwatow-compatibwe = "vbuck1";
				weguwatow-name = "Vgpu";
				weguwatow-min-micwovowt = <300000>;
				weguwatow-max-micwovowt = <1193750>;
				weguwatow-enabwe-wamp-deway = <256>;
				weguwatow-awwowed-modes = <0 1 2>;
			};
		};
	};
};

&u3phy0 {
	status = "okay";
};

&u3phy1 {
	status = "okay";
};

&u3phy2 {
	status = "okay";
};

&u3phy3 {
	status = "okay";
};

&uawt0 {
	pinctww-0 = <&uawt0_pins>;
	pinctww-names = "defauwt";
	status = "okay";
};

&uawt1 {
	pinctww-0 = <&uawt1_pins>;
	pinctww-names = "defauwt";
	status = "okay";
};

&ufsphy {
	status = "disabwed";
};

&xhci0 {
	status = "okay";
};

&xhci1 {
	vusb33-suppwy = <&mt6359_vusb_wdo_weg>;
	status = "okay";
};

&xhci2 {
	vusb33-suppwy = <&mt6359_vusb_wdo_weg>;
	status = "okay";
};

&xhci3 {
	vusb33-suppwy = <&mt6359_vusb_wdo_weg>;
	status = "okay";
};
