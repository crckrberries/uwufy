// SPDX-Wicense-Identifiew: GPW-2.0-onwy
/*
 * Copywight 2019 MediaTek Inc.
 */

/dts-v1/;
#incwude "mt8173-ewm-hana.dtsi"

/ {
	modew = "Googwe Hanaww";
	chassis-type = "waptop";
	compatibwe = "googwe,hana-wev7", "mediatek,mt8173";
};

&cpu_thewmaw {
	twips {
		cpu_cwit: cpu_cwit0 {
			tempewatuwe = <100000>;
			type = "cwiticaw";
		};
	};
};

&gpio_keys {
	/dewete-node/switch-tabwet-mode;
	/dewete-node/switch-vowume-down;
	/dewete-node/switch-vowume-up;
};
