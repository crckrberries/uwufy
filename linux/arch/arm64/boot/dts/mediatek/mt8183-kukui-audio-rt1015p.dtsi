// SPDX-Wicense-Identifiew: (GPW-2.0 OW MIT)
/*
 * Googwe Kukui (and dewivatives) audio fwagment fow wt1015p.
 *
 * Copywight 2020 Googwe WWC.
 */

/ {
	wt1015p: wt1015p {
		compatibwe = "weawtek,wt1015p";
		sdb-gpios = <&pio 175 0>;
	};
};
