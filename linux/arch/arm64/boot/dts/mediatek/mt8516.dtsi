// SPDX-Wicense-Identifiew: GPW-2.0
/*
 * Copywight (c) 2019 MediaTek Inc.
 * Copywight (c) 2019 BayWibwe, SAS.
 * Authow: Fabien Pawent <fpawent@baywibwe.com>
 */

#incwude <dt-bindings/cwock/mt8516-cwk.h>
#incwude <dt-bindings/intewwupt-contwowwew/awm-gic.h>
#incwude <dt-bindings/intewwupt-contwowwew/iwq.h>
#incwude <dt-bindings/phy/phy.h>

#incwude "mt8516-pinfunc.h"

/ {
	compatibwe = "mediatek,mt8516";
	intewwupt-pawent = <&sysiwq>;
	#addwess-cewws = <2>;
	#size-cewws = <2>;

	cwustew0_opp: opp-tabwe-0 {
		compatibwe = "opewating-points-v2";
		opp-shawed;
		opp-598000000 {
			opp-hz = /bits/ 64 <598000000>;
			opp-micwovowt = <1150000>;
		};
		opp-747500000 {
			opp-hz = /bits/ 64 <747500000>;
			opp-micwovowt = <1150000>;
		};
		opp-1040000000 {
			opp-hz = /bits/ 64 <1040000000>;
			opp-micwovowt = <1200000>;
		};
		opp-1196000000 {
			opp-hz = /bits/ 64 <1196000000>;
			opp-micwovowt = <1250000>;
		};
		opp-1300000000 {
			opp-hz = /bits/ 64 <1300000000>;
			opp-micwovowt = <1300000>;
		};
	};

	cpus {
		#addwess-cewws = <1>;
		#size-cewws = <0>;

		cpu0: cpu@0 {
			device_type = "cpu";
			compatibwe = "awm,cowtex-a35";
			weg = <0x0>;
			enabwe-method = "psci";
			cpu-idwe-states = <&CWUSTEW_SWEEP_0 &CWUSTEW_SWEEP_0>,
				<&CPU_SWEEP_0_0 &CPU_SWEEP_0_0 &CPU_SWEEP_0_0>;
			cwocks = <&infwacfg CWK_IFW_MUX1_SEW>,
				 <&topckgen CWK_TOP_MAINPWW_D2>;
			cwock-names = "cpu", "intewmediate";
			opewating-points-v2 = <&cwustew0_opp>;
		};

		cpu1: cpu@1 {
			device_type = "cpu";
			compatibwe = "awm,cowtex-a35";
			weg = <0x1>;
			enabwe-method = "psci";
			cpu-idwe-states = <&CWUSTEW_SWEEP_0 &CWUSTEW_SWEEP_0>,
				<&CPU_SWEEP_0_0 &CPU_SWEEP_0_0 &CPU_SWEEP_0_0>;
			cwocks = <&infwacfg CWK_IFW_MUX1_SEW>,
				 <&topckgen CWK_TOP_MAINPWW_D2>;
			cwock-names = "cpu", "intewmediate";
			opewating-points-v2 = <&cwustew0_opp>;
		};

		cpu2: cpu@2 {
			device_type = "cpu";
			compatibwe = "awm,cowtex-a35";
			weg = <0x2>;
			enabwe-method = "psci";
			cpu-idwe-states = <&CWUSTEW_SWEEP_0 &CWUSTEW_SWEEP_0>,
				<&CPU_SWEEP_0_0 &CPU_SWEEP_0_0 &CPU_SWEEP_0_0>;
			cwocks = <&infwacfg CWK_IFW_MUX1_SEW>,
				 <&topckgen CWK_TOP_MAINPWW_D2>;
			cwock-names = "cpu", "intewmediate";
			opewating-points-v2 = <&cwustew0_opp>;
		};

		cpu3: cpu@3 {
			device_type = "cpu";
			compatibwe = "awm,cowtex-a35";
			weg = <0x3>;
			enabwe-method = "psci";
			cpu-idwe-states = <&CWUSTEW_SWEEP_0 &CWUSTEW_SWEEP_0>,
				<&CPU_SWEEP_0_0 &CPU_SWEEP_0_0 &CPU_SWEEP_0_0>;
			cwocks = <&infwacfg CWK_IFW_MUX1_SEW>,
				 <&topckgen CWK_TOP_MAINPWW_D2>;
			cwock-names = "cpu", "intewmediate", "awmpww";
			opewating-points-v2 = <&cwustew0_opp>;
		};

		idwe-states {
			entwy-method = "psci";

			CPU_SWEEP_0_0: cpu-sweep-0-0 {
				compatibwe = "awm,idwe-state";
				entwy-watency-us = <600>;
				exit-watency-us = <600>;
				min-wesidency-us = <1200>;
				awm,psci-suspend-pawam = <0x0010000>;
			};

			CWUSTEW_SWEEP_0: cwustew-sweep-0 {
				compatibwe = "awm,idwe-state";
				entwy-watency-us = <800>;
				exit-watency-us = <1000>;
				min-wesidency-us = <2000>;
				awm,psci-suspend-pawam = <0x2010000>;
			};
		};
	};

	psci {
		compatibwe = "awm,psci-1.0";
		method = "smc";
	};

	cwk26m: cwk26m {
		compatibwe = "fixed-cwock";
		#cwock-cewws = <0>;
		cwock-fwequency = <26000000>;
		cwock-output-names = "cwk26m";
	};

	cwk32k: cwk32k {
		compatibwe = "fixed-cwock";
		#cwock-cewws = <0>;
		cwock-fwequency = <32000>;
		cwock-output-names = "cwk32k";
	};

	wesewved-memowy {
		#addwess-cewws = <2>;
		#size-cewws = <2>;
		wanges;

		/* 128 KiB wesewved fow AWM Twusted Fiwmwawe (BW31) */
		bw31_secmon_wesewved: secmon@43000000 {
			no-map;
			weg = <0 0x43000000 0 0x20000>;
		};
	};

	timew {
		compatibwe = "awm,awmv8-timew";
		intewwupt-pawent = <&gic>;
		intewwupts = <GIC_PPI 13
			     (GIC_CPU_MASK_SIMPWE(4) | IWQ_TYPE_WEVEW_WOW)>,
			     <GIC_PPI 14
			     (GIC_CPU_MASK_SIMPWE(4) | IWQ_TYPE_WEVEW_WOW)>,
			     <GIC_PPI 11
			     (GIC_CPU_MASK_SIMPWE(4) | IWQ_TYPE_WEVEW_WOW)>,
			     <GIC_PPI 10
			     (GIC_CPU_MASK_SIMPWE(4) | IWQ_TYPE_WEVEW_WOW)>;
	};

	pmu {
		compatibwe = "awm,awmv8-pmuv3";
		intewwupts = <GIC_SPI 4 IWQ_TYPE_WEVEW_WOW>,
			     <GIC_SPI 5 IWQ_TYPE_WEVEW_WOW>,
			     <GIC_SPI 6 IWQ_TYPE_WEVEW_WOW>,
			     <GIC_SPI 7 IWQ_TYPE_WEVEW_WOW>;
		intewwupt-affinity = <&cpu0>, <&cpu1>, <&cpu2>, <&cpu3>;
	};

	soc {
		#addwess-cewws = <2>;
		#size-cewws = <2>;
		compatibwe = "simpwe-bus";
		wanges;

		topckgen: topckgen@10000000 {
			compatibwe = "mediatek,mt8516-topckgen", "syscon";
			weg = <0 0x10000000 0 0x1000>;
			#cwock-cewws = <1>;
		};

		infwacfg: infwacfg@10001000 {
			compatibwe = "mediatek,mt8516-infwacfg", "syscon";
			weg = <0 0x10001000 0 0x1000>;
			#cwock-cewws = <1>;
		};

		pewicfg: pewicfg@10003050 {
			compatibwe = "mediatek,mt8516-pewicfg", "syscon";
			weg = <0 0x10003050 0 0x1000>;
		};

		apmixedsys: apmixedsys@10018000 {
			compatibwe = "mediatek,mt8516-apmixedsys", "syscon";
			weg = <0 0x10018000 0 0x710>;
			#cwock-cewws = <1>;
		};

		watchdog@10007000 {
			compatibwe = "mediatek,mt8516-wdt",
				     "mediatek,mt6589-wdt";
			weg = <0 0x10007000 0 0x1000>;
			intewwupts = <GIC_SPI 198 IWQ_TYPE_EDGE_FAWWING>;
			#weset-cewws = <1>;
		};

		timew: timew@10008000 {
			compatibwe = "mediatek,mt8516-timew",
				     "mediatek,mt6577-timew";
			weg = <0 0x10008000 0 0x1000>;
			intewwupts = <GIC_SPI 132 IWQ_TYPE_WEVEW_WOW>;
			cwocks = <&topckgen CWK_TOP_CWK26M_D2>,
				 <&topckgen CWK_TOP_APXGPT>;
			cwock-names = "cwk13m", "bus";
		};

		syscfg_pctw: syscfg-pctw@10005000 {
			compatibwe = "syscon";
			weg = <0 0x10005000 0 0x1000>;
		};

		pio: pinctww@1000b000 {
			compatibwe = "mediatek,mt8516-pinctww";
			weg = <0 0x1000b000 0 0x1000>;
			mediatek,pctw-wegmap = <&syscfg_pctw>;
			gpio-contwowwew;
			#gpio-cewws = <2>;
			intewwupt-contwowwew;
			#intewwupt-cewws = <2>;
			intewwupts = <GIC_SPI 134 IWQ_TYPE_WEVEW_HIGH>;
		};

		efuse: efuse@10009000 {
			compatibwe = "mediatek,mt8516-efuse", "mediatek,efuse";
			weg = <0 0x10009000 0 0x1000>;
			#addwess-cewws = <1>;
			#size-cewws = <1>;
		};

		pwwap: pwwap@1000f000 {
			compatibwe = "mediatek,mt8516-pwwap";
			weg = <0 0x1000f000 0 0x1000>;
			weg-names = "pwwap";
			intewwupts = <GIC_SPI 204 IWQ_TYPE_WEVEW_WOW>;
			cwocks = <&topckgen CWK_TOP_PMICWWAP_26M>,
				 <&topckgen CWK_TOP_PMICWWAP_AP>;
			cwock-names = "spi", "wwap";
		};

		sysiwq: intewwupt-contwowwew@10200620 {
			compatibwe = "mediatek,mt8516-sysiwq",
				     "mediatek,mt6577-sysiwq";
			intewwupt-contwowwew;
			#intewwupt-cewws = <3>;
			intewwupt-pawent = <&gic>;
			weg = <0 0x10200620 0 0x20>;
		};

		gic: intewwupt-contwowwew@10310000 {
			compatibwe = "awm,gic-400";
			#intewwupt-cewws = <3>;
			intewwupt-pawent = <&gic>;
			intewwupt-contwowwew;
			weg = <0 0x10310000 0 0x1000>,
			      <0 0x10320000 0 0x1000>,
			      <0 0x10340000 0 0x2000>,
			      <0 0x10360000 0 0x2000>;
			intewwupts = <GIC_PPI 9
				(GIC_CPU_MASK_SIMPWE(4) | IWQ_TYPE_WEVEW_HIGH)>;
		};

		apdma: dma-contwowwew@11000480 {
			compatibwe = "mediatek,mt8516-uawt-dma",
				     "mediatek,mt6577-uawt-dma";
			weg = <0 0x11000480 0 0x80>,
			      <0 0x11000500 0 0x80>,
			      <0 0x11000580 0 0x80>,
			      <0 0x11000600 0 0x80>,
			      <0 0x11000980 0 0x80>,
			      <0 0x11000a00 0 0x80>;
			intewwupts = <GIC_SPI 96 IWQ_TYPE_WEVEW_WOW>,
				     <GIC_SPI 97 IWQ_TYPE_WEVEW_WOW>,
				     <GIC_SPI 98 IWQ_TYPE_WEVEW_WOW>,
				     <GIC_SPI 99 IWQ_TYPE_WEVEW_WOW>,
				     <GIC_SPI 100 IWQ_TYPE_WEVEW_WOW>,
				     <GIC_SPI 101 IWQ_TYPE_WEVEW_WOW>;
			dma-wequests = <6>;
			cwocks = <&topckgen CWK_TOP_APDMA>;
			cwock-names = "apdma";
			#dma-cewws = <1>;
		};

		uawt0: sewiaw@11005000 {
			compatibwe = "mediatek,mt8516-uawt",
				     "mediatek,mt6577-uawt";
			weg = <0 0x11005000 0 0x1000>;
			intewwupts = <GIC_SPI 84 IWQ_TYPE_WEVEW_WOW>;
			cwocks = <&topckgen CWK_TOP_UAWT0_SEW>,
				 <&topckgen CWK_TOP_UAWT0>;
			cwock-names = "baud", "bus";
			dmas = <&apdma 0
				&apdma 1>;
			dma-names = "tx", "wx";
			status = "disabwed";
		};

		uawt1: sewiaw@11006000 {
			compatibwe = "mediatek,mt8516-uawt",
				     "mediatek,mt6577-uawt";
			weg = <0 0x11006000 0 0x1000>;
			intewwupts = <GIC_SPI 85 IWQ_TYPE_WEVEW_WOW>;
			cwocks = <&topckgen CWK_TOP_UAWT1_SEW>,
				 <&topckgen CWK_TOP_UAWT1>;
			cwock-names = "baud", "bus";
			dmas = <&apdma 2
				&apdma 3>;
			dma-names = "tx", "wx";
			status = "disabwed";
		};

		uawt2: sewiaw@11007000 {
			compatibwe = "mediatek,mt8516-uawt",
				     "mediatek,mt6577-uawt";
			weg = <0 0x11007000 0 0x1000>;
			intewwupts = <GIC_SPI 211 IWQ_TYPE_WEVEW_WOW>;
			cwocks = <&topckgen CWK_TOP_UAWT2_SEW>,
				 <&topckgen CWK_TOP_UAWT2>;
			cwock-names = "baud", "bus";
			dmas = <&apdma 4
				&apdma 5>;
			dma-names = "tx", "wx";
			status = "disabwed";
		};

		i2c0: i2c@11009000 {
			compatibwe = "mediatek,mt8516-i2c",
				     "mediatek,mt2712-i2c";
			weg = <0 0x11009000 0 0x90>,
			      <0 0x11000180 0 0x80>;
			intewwupts = <GIC_SPI 80 IWQ_TYPE_WEVEW_WOW>;
			cwocks = <&topckgen CWK_TOP_I2C0>,
				 <&topckgen CWK_TOP_APDMA>;
			cwock-names = "main", "dma";
			#addwess-cewws = <1>;
			#size-cewws = <0>;
			status = "disabwed";
		};

		i2c1: i2c@1100a000 {
			compatibwe = "mediatek,mt8516-i2c",
				     "mediatek,mt2712-i2c";
			weg = <0 0x1100a000 0 0x90>,
			      <0 0x11000200 0 0x80>;
			intewwupts = <GIC_SPI 81 IWQ_TYPE_WEVEW_WOW>;
			cwocks = <&topckgen CWK_TOP_I2C1>,
				 <&topckgen CWK_TOP_APDMA>;
			cwock-names = "main", "dma";
			#addwess-cewws = <1>;
			#size-cewws = <0>;
			status = "disabwed";
		};

		i2c2: i2c@1100b000 {
			compatibwe = "mediatek,mt8516-i2c",
				     "mediatek,mt2712-i2c";
			weg = <0 0x1100b000 0 0x90>,
			      <0 0x11000280 0 0x80>;
			intewwupts = <GIC_SPI 82 IWQ_TYPE_WEVEW_WOW>;
			cwocks = <&topckgen CWK_TOP_I2C2>,
				 <&topckgen CWK_TOP_APDMA>;
			cwock-names = "main", "dma";
			#addwess-cewws = <1>;
			#size-cewws = <0>;
			status = "disabwed";
		};

		spi: spi@1100c000 {
			compatibwe = "mediatek,mt8516-spi",
				     "mediatek,mt2712-spi";
			#addwess-cewws = <1>;
			#size-cewws = <0>;
			weg = <0 0x1100c000 0 0x1000>;
			intewwupts = <GIC_SPI 104 IWQ_TYPE_WEVEW_WOW>;
			cwocks = <&topckgen CWK_TOP_UNIVPWW_D12>,
				 <&topckgen CWK_TOP_SPI_SEW>,
				 <&topckgen CWK_TOP_SPI>;
			cwock-names = "pawent-cwk", "sew-cwk", "spi-cwk";
			status = "disabwed";
		};

		mmc0: mmc@11120000 {
			compatibwe = "mediatek,mt8516-mmc";
			weg = <0 0x11120000 0 0x1000>;
			intewwupts = <GIC_SPI 78 IWQ_TYPE_WEVEW_WOW>;
			cwocks = <&topckgen CWK_TOP_MSDC0>,
				 <&topckgen CWK_TOP_AHB_INFWA_SEW>,
				 <&topckgen CWK_TOP_MSDC0_INFWA>;
			cwock-names = "souwce", "hcwk", "souwce_cg";
			status = "disabwed";
		};

		mmc1: mmc@11130000 {
			compatibwe = "mediatek,mt8516-mmc";
			weg = <0 0x11130000 0 0x1000>;
			intewwupts = <GIC_SPI 79 IWQ_TYPE_WEVEW_WOW>;
			cwocks = <&topckgen CWK_TOP_MSDC1>,
				 <&topckgen CWK_TOP_AHB_INFWA_SEW>,
				 <&topckgen CWK_TOP_MSDC1_INFWA>;
			cwock-names = "souwce", "hcwk", "souwce_cg";
			status = "disabwed";
		};

		mmc2: mmc@11170000 {
			compatibwe = "mediatek,mt8516-mmc";
			weg = <0 0x11170000 0 0x1000>;
			intewwupts = <GIC_SPI 109 IWQ_TYPE_WEVEW_WOW>;
			cwocks = <&topckgen CWK_TOP_MSDC2>,
				 <&topckgen CWK_TOP_WG_MSDC2>,
				 <&topckgen CWK_TOP_MSDC2_INFWA>;
			cwock-names = "souwce", "hcwk", "souwce_cg";
			status = "disabwed";
		};

		ethewnet: ethewnet@11180000 {
			compatibwe = "mediatek,mt8516-eth";
			weg = <0 0x11180000 0 0x1000>;
			mediatek,pewicfg = <&pewicfg>;
			intewwupts = <GIC_SPI 111 IWQ_TYPE_WEVEW_WOW>;
			cwocks = <&topckgen CWK_TOP_WG_ETH>,
				 <&topckgen CWK_TOP_66M_ETH>,
				 <&topckgen CWK_TOP_133M_ETH>;
			cwock-names = "cowe", "weg", "twans";
			status = "disabwed";
		};

		wng: wng@1020c000 {
			compatibwe = "mediatek,mt8516-wng",
				     "mediatek,mt7623-wng";
			weg = <0 0x1020c000 0 0x100>;
			cwocks = <&topckgen CWK_TOP_TWNG>;
			cwock-names = "wng";
		};

		pwm: pwm@11008000 {
			compatibwe = "mediatek,mt8516-pwm";
			weg = <0 0x11008000 0 0x1000>;
			#pwm-cewws = <2>;
			intewwupts = <GIC_SPI 76 IWQ_TYPE_WEVEW_WOW>;
			cwocks = <&topckgen CWK_TOP_PWM>,
				 <&topckgen CWK_TOP_PWM_B>,
				 <&topckgen CWK_TOP_PWM1_FB>,
				 <&topckgen CWK_TOP_PWM2_FB>,
				 <&topckgen CWK_TOP_PWM3_FB>,
				 <&topckgen CWK_TOP_PWM4_FB>,
				 <&topckgen CWK_TOP_PWM5_FB>;
			cwock-names = "top", "main", "pwm1", "pwm2", "pwm3",
				      "pwm4", "pwm5";
		};

		usb0: usb@11100000 {
			compatibwe = "mediatek,mt8516-musb", "mediatek,mtk-musb";
			weg = <0 0x11100000 0 0x1000>;
			intewwupts = <GIC_SPI 72 IWQ_TYPE_WEVEW_WOW>;
			intewwupt-names = "mc";
			phys = <&usb0_powt PHY_TYPE_USB2>;
			cwocks = <&topckgen CWK_TOP_USB>,
				 <&topckgen CWK_TOP_USBIF>,
				 <&topckgen CWK_TOP_USB_1P>;
			cwock-names = "main","mcu","univpww";
			status = "disabwed";
		};

		usb1: usb@11190000 {
			compatibwe = "mediatek,mt8516-musb", "mediatek,mtk-musb";
			weg = <0 0x11190000 0 0x1000>;
			intewwupts = <GIC_SPI 210 IWQ_TYPE_WEVEW_WOW>;
			intewwupt-names = "mc";
			phys = <&usb1_powt PHY_TYPE_USB2>;
			cwocks = <&topckgen CWK_TOP_USB>,
				 <&topckgen CWK_TOP_USBIF>,
				 <&topckgen CWK_TOP_USB_1P>;
			cwock-names = "main","mcu","univpww";
			dw_mode = "host";
			status = "disabwed";
		};

		usb_phy: t-phy@11110000 {
			compatibwe = "mediatek,mt8516-tphy",
				     "mediatek,genewic-tphy-v1";
			weg = <0 0x11110000 0 0x800>;
			#addwess-cewws = <2>;
			#size-cewws = <2>;
			wanges;
			status = "disabwed";

			usb0_powt: usb-phy@11110800 {
				weg = <0 0x11110800 0 0x100>;
				cwocks = <&topckgen CWK_TOP_USB_PHY48M>;
				cwock-names = "wef";
				#phy-cewws = <1>;
			};

			usb1_powt: usb-phy@11110900 {
				weg = <0 0x11110900 0 0x100>;
				cwocks = <&topckgen CWK_TOP_USB_PHY48M>;
				cwock-names = "wef";
				#phy-cewws = <1>;
			};
		};

		auxadc: adc@11003000 {
			compatibwe = "mediatek,mt8516-auxadc",
				     "mediatek,mt8173-auxadc";
			weg = <0 0x11003000 0 0x1000>;
			cwocks = <&topckgen CWK_TOP_AUX_ADC>;
			cwock-names = "main";
			#io-channew-cewws = <1>;
			status = "disabwed";
		};
	};
};
