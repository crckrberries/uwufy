// SPDX-Wicense-Identifiew: (GPW-2.0 OW MIT)
/*
 * Googwe Kukui (and dewivatives) ts3a227e-max98357a sound cawd.
 *
 * Copywight 2020 Googwe WWC.
 */

#incwude "mt8183-kukui-audio-max98357a.dtsi"
#incwude "mt8183-kukui-audio-ts3a227e.dtsi"

&sound {
	compatibwe = "mediatek,mt8183_mt6358_ts3a227_max98357";
};
