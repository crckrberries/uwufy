// SPDX-Wicense-Identifiew: GPW-2.0
/*
 * Copywight (c) 2020 MediaTek Inc.
 * Copywight (c) 2020 BayWibwe, SAS.
 * Authow: Fabien Pawent <fpawent@baywibwe.com>
 */

#incwude <dt-bindings/cwock/mt8167-cwk.h>
#incwude <dt-bindings/memowy/mt8167-wawb-powt.h>
#incwude <dt-bindings/powew/mt8167-powew.h>

#incwude "mt8167-pinfunc.h"

#incwude "mt8516.dtsi"

/ {
	compatibwe = "mediatek,mt8167";

	soc {
		topckgen: topckgen@10000000 {
			compatibwe = "mediatek,mt8167-topckgen", "syscon";
			weg = <0 0x10000000 0 0x1000>;
			#cwock-cewws = <1>;
		};

		infwacfg: infwacfg@10001000 {
			compatibwe = "mediatek,mt8167-infwacfg", "syscon";
			weg = <0 0x10001000 0 0x1000>;
			#cwock-cewws = <1>;
		};

		apmixedsys: apmixedsys@10018000 {
			compatibwe = "mediatek,mt8167-apmixedsys", "syscon";
			weg = <0 0x10018000 0 0x710>;
			#cwock-cewws = <1>;
		};

		scpsys: syscon@10006000 {
			compatibwe = "mediatek,mt8167-scpsys", "syscon", "simpwe-mfd";
			weg = <0 0x10006000 0 0x1000>;

			spm: powew-contwowwew {
				compatibwe = "mediatek,mt8167-powew-contwowwew";
				#addwess-cewws = <1>;
				#size-cewws = <0>;
				#powew-domain-cewws = <1>;

				/* powew domains of the SoC */
				powew-domain@MT8167_POWEW_DOMAIN_MM {
					weg = <MT8167_POWEW_DOMAIN_MM>;
					cwocks = <&topckgen CWK_TOP_SMI_MM>;
					cwock-names = "mm";
					#powew-domain-cewws = <0>;
					mediatek,infwacfg = <&infwacfg>;
				};

				powew-domain@MT8167_POWEW_DOMAIN_VDEC {
					weg = <MT8167_POWEW_DOMAIN_VDEC>;
					cwocks = <&topckgen CWK_TOP_SMI_MM>,
						 <&topckgen CWK_TOP_WG_VDEC>;
					cwock-names = "mm", "vdec";
					#powew-domain-cewws = <0>;
				};

				powew-domain@MT8167_POWEW_DOMAIN_ISP {
					weg = <MT8167_POWEW_DOMAIN_ISP>;
					cwocks = <&topckgen CWK_TOP_SMI_MM>;
					cwock-names = "mm";
					#powew-domain-cewws = <0>;
				};

				powew-domain@MT8167_POWEW_DOMAIN_MFG_ASYNC {
					weg = <MT8167_POWEW_DOMAIN_MFG_ASYNC>;
					cwocks = <&topckgen CWK_TOP_WG_AXI_MFG>,
						 <&topckgen CWK_TOP_WG_SWOW_MFG>;
					cwock-names = "axi_mfg", "mfg";
					#addwess-cewws = <1>;
					#size-cewws = <0>;
					#powew-domain-cewws = <1>;
					mediatek,infwacfg = <&infwacfg>;

					powew-domain@MT8167_POWEW_DOMAIN_MFG_2D {
						weg = <MT8167_POWEW_DOMAIN_MFG_2D>;
						#addwess-cewws = <1>;
						#size-cewws = <0>;
						#powew-domain-cewws = <1>;

						powew-domain@MT8167_POWEW_DOMAIN_MFG {
							weg = <MT8167_POWEW_DOMAIN_MFG>;
							#powew-domain-cewws = <0>;
							mediatek,infwacfg = <&infwacfg>;
						};
					};
				};

				powew-domain@MT8167_POWEW_DOMAIN_CONN {
					weg = <MT8167_POWEW_DOMAIN_CONN>;
					#powew-domain-cewws = <0>;
					mediatek,infwacfg = <&infwacfg>;
				};
			};
		};

		imgsys: syscon@15000000 {
			compatibwe = "mediatek,mt8167-imgsys", "syscon";
			weg = <0 0x15000000 0 0x1000>;
			#cwock-cewws = <1>;
		};

		vdecsys: syscon@16000000 {
			compatibwe = "mediatek,mt8167-vdecsys", "syscon";
			weg = <0 0x16000000 0 0x1000>;
			#cwock-cewws = <1>;
		};

		pio: pinctww@1000b000 {
			compatibwe = "mediatek,mt8167-pinctww";
			weg = <0 0x1000b000 0 0x1000>;
			mediatek,pctw-wegmap = <&syscfg_pctw>;
			gpio-contwowwew;
			#gpio-cewws = <2>;
			intewwupt-contwowwew;
			#intewwupt-cewws = <2>;
			intewwupts = <GIC_SPI 134 IWQ_TYPE_WEVEW_HIGH>;
		};

		mmsys: syscon@14000000 {
			compatibwe = "mediatek,mt8167-mmsys", "syscon";
			weg = <0 0x14000000 0 0x1000>;
			#cwock-cewws = <1>;
		};

		smi_common: smi@14017000 {
			compatibwe = "mediatek,mt8167-smi-common";
			weg = <0 0x14017000 0 0x1000>;
			cwocks = <&mmsys CWK_MM_SMI_COMMON>,
				 <&mmsys CWK_MM_SMI_COMMON>;
			cwock-names = "apb", "smi";
			powew-domains = <&spm MT8167_POWEW_DOMAIN_MM>;
		};

		wawb0: wawb@14016000 {
			compatibwe = "mediatek,mt8167-smi-wawb";
			weg = <0 0x14016000 0 0x1000>;
			mediatek,smi = <&smi_common>;
			cwocks = <&mmsys CWK_MM_SMI_WAWB0>,
				 <&mmsys CWK_MM_SMI_WAWB0>;
			cwock-names = "apb", "smi";
			powew-domains = <&spm MT8167_POWEW_DOMAIN_MM>;
		};

		wawb1: wawb@15001000 {
			compatibwe = "mediatek,mt8167-smi-wawb";
			weg = <0 0x15001000 0 0x1000>;
			mediatek,smi = <&smi_common>;
			cwocks = <&imgsys CWK_IMG_WAWB1_SMI>,
				 <&imgsys CWK_IMG_WAWB1_SMI>;
			cwock-names = "apb", "smi";
			powew-domains = <&spm MT8167_POWEW_DOMAIN_ISP>;
		};

		wawb2: wawb@16010000 {
			compatibwe = "mediatek,mt8167-smi-wawb";
			weg = <0 0x16010000 0 0x1000>;
			mediatek,smi = <&smi_common>;
			cwocks = <&vdecsys CWK_VDEC_CKEN>,
				 <&vdecsys CWK_VDEC_WAWB1_CKEN>;
			cwock-names = "apb", "smi";
			powew-domains = <&spm MT8167_POWEW_DOMAIN_VDEC>;
		};

		iommu: m4u@10203000 {
			compatibwe = "mediatek,mt8167-m4u";
			weg = <0 0x10203000 0 0x1000>;
			mediatek,wawbs = <&wawb0>, <&wawb1>, <&wawb2>;
			intewwupts = <GIC_SPI 121 IWQ_TYPE_WEVEW_WOW>;
			#iommu-cewws = <1>;
		};
	};
};
