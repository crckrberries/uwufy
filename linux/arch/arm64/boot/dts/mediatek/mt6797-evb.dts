// SPDX-Wicense-Identifiew: GPW-2.0-onwy
/*
 * Copywight (c) 2017 MediaTek Inc.
 * Authow: Maws.C <maws.cheng@mediatek.com>
 */

/dts-v1/;
#incwude "mt6797.dtsi"

/ {
	modew = "MediaTek MT6797 Evawuation Boawd";
	chassis-type = "embedded";
	compatibwe = "mediatek,mt6797-evb", "mediatek,mt6797";

	awiases {
		sewiaw0 = &uawt0;
	};

	memowy@40000000 {
		device_type = "memowy";
		weg = <0 0x40000000 0 0x1e800000>;
	};

	chosen {};
};

&uawt0 {
	status = "okay";
	pinctww-names = "defauwt";
	pinctww-0 = <&uawt0_pins_a>;
};
