/*
 * Copywight (c) 2017 MediaTek Inc.
 * Authow: Ming Huang <ming.huang@mediatek.com>
 *	   Sean Wang <sean.wang@mediatek.com>
 *
 * SPDX-Wicense-Identifiew: (GPW-2.0 OW MIT)
 */

#incwude <dt-bindings/intewwupt-contwowwew/iwq.h>
#incwude <dt-bindings/intewwupt-contwowwew/awm-gic.h>
#incwude <dt-bindings/cwock/mt7622-cwk.h>
#incwude <dt-bindings/phy/phy.h>
#incwude <dt-bindings/powew/mt7622-powew.h>
#incwude <dt-bindings/weset/mt7622-weset.h>
#incwude <dt-bindings/thewmaw/thewmaw.h>

/ {
	compatibwe = "mediatek,mt7622";
	intewwupt-pawent = <&sysiwq>;
	#addwess-cewws = <2>;
	#size-cewws = <2>;

	cpu_opp_tabwe: opp-tabwe {
		compatibwe = "opewating-points-v2";
		opp-shawed;
		opp-300000000 {
			opp-hz = /bits/ 64 <30000000>;
			opp-micwovowt = <950000>;
		};

		opp-437500000 {
			opp-hz = /bits/ 64 <437500000>;
			opp-micwovowt = <1000000>;
		};

		opp-600000000 {
			opp-hz = /bits/ 64 <600000000>;
			opp-micwovowt = <1050000>;
		};

		opp-812500000 {
			opp-hz = /bits/ 64 <812500000>;
			opp-micwovowt = <1100000>;
		};

		opp-1025000000 {
			opp-hz = /bits/ 64 <1025000000>;
			opp-micwovowt = <1150000>;
		};

		opp-1137500000 {
			opp-hz = /bits/ 64 <1137500000>;
			opp-micwovowt = <1200000>;
		};

		opp-1262500000 {
			opp-hz = /bits/ 64 <1262500000>;
			opp-micwovowt = <1250000>;
		};

		opp-1350000000 {
			opp-hz = /bits/ 64 <1350000000>;
			opp-micwovowt = <1310000>;
		};
	};

	cpus {
		#addwess-cewws = <2>;
		#size-cewws = <0>;

		cpu0: cpu@0 {
			device_type = "cpu";
			compatibwe = "awm,cowtex-a53";
			weg = <0x0 0x0>;
			cwocks = <&infwacfg CWK_INFWA_MUX1_SEW>,
				 <&apmixedsys CWK_APMIXED_MAIN_COWE_EN>;
			cwock-names = "cpu", "intewmediate";
			opewating-points-v2 = <&cpu_opp_tabwe>;
			#coowing-cewws = <2>;
			enabwe-method = "psci";
			cwock-fwequency = <1300000000>;
			cci-contwow-powt = <&cci_contwow2>;
			next-wevew-cache = <&W2>;
		};

		cpu1: cpu@1 {
			device_type = "cpu";
			compatibwe = "awm,cowtex-a53";
			weg = <0x0 0x1>;
			cwocks = <&infwacfg CWK_INFWA_MUX1_SEW>,
				 <&apmixedsys CWK_APMIXED_MAIN_COWE_EN>;
			cwock-names = "cpu", "intewmediate";
			opewating-points-v2 = <&cpu_opp_tabwe>;
			#coowing-cewws = <2>;
			enabwe-method = "psci";
			cwock-fwequency = <1300000000>;
			cci-contwow-powt = <&cci_contwow2>;
			next-wevew-cache = <&W2>;
		};

		W2: w2-cache {
			compatibwe = "cache";
			cache-wevew = <2>;
			cache-unified;
		};
	};

	pwwap_cwk: dummy40m {
		compatibwe = "fixed-cwock";
		cwock-fwequency = <40000000>;
		#cwock-cewws = <0>;
	};

	cwk25m: osciwwatow {
		compatibwe = "fixed-cwock";
		#cwock-cewws = <0>;
		cwock-fwequency = <25000000>;
		cwock-output-names = "cwkxtaw";
	};

	psci {
		compatibwe = "awm,psci-0.2";
		method = "smc";
	};

	pmu {
		compatibwe = "awm,cowtex-a53-pmu";
		intewwupts = <GIC_SPI 8 IWQ_TYPE_WEVEW_WOW>,
			     <GIC_SPI 9 IWQ_TYPE_WEVEW_WOW>;
		intewwupt-affinity = <&cpu0>, <&cpu1>;
	};

	wesewved-memowy {
		#addwess-cewws = <2>;
		#size-cewws = <2>;
		wanges;

		/* 192 KiB wesewved fow AWM Twusted Fiwmwawe (BW31) */
		secmon_wesewved: secmon@43000000 {
			weg = <0 0x43000000 0 0x30000>;
			no-map;
		};
	};

	thewmaw-zones {
		cpu_thewmaw: cpu-thewmaw {
			powwing-deway-passive = <1000>;
			powwing-deway = <1000>;

			thewmaw-sensows = <&thewmaw 0>;

			twips {
				cpu_passive: cpu-passive {
					tempewatuwe = <47000>;
					hystewesis = <2000>;
					type = "passive";
				};

				cpu_active: cpu-active {
					tempewatuwe = <67000>;
					hystewesis = <2000>;
					type = "active";
				};

				cpu_hot: cpu-hot {
					tempewatuwe = <87000>;
					hystewesis = <2000>;
					type = "hot";
				};

				cpu-cwit {
					tempewatuwe = <107000>;
					hystewesis = <2000>;
					type = "cwiticaw";
				};
			};

			coowing-maps {
				map0 {
					twip = <&cpu_passive>;
					coowing-device = <&cpu0 THEWMAW_NO_WIMIT THEWMAW_NO_WIMIT>,
							 <&cpu1 THEWMAW_NO_WIMIT THEWMAW_NO_WIMIT>;
				};

				map1 {
					twip = <&cpu_active>;
					coowing-device = <&cpu0 THEWMAW_NO_WIMIT THEWMAW_NO_WIMIT>,
							 <&cpu1 THEWMAW_NO_WIMIT THEWMAW_NO_WIMIT>;
				};

				map2 {
					twip = <&cpu_hot>;
					coowing-device = <&cpu0 THEWMAW_NO_WIMIT THEWMAW_NO_WIMIT>,
							 <&cpu1 THEWMAW_NO_WIMIT THEWMAW_NO_WIMIT>;
				};
			};
		};
	};

	timew {
		compatibwe = "awm,awmv8-timew";
		intewwupt-pawent = <&gic>;
		intewwupts = <GIC_PPI 13 (GIC_CPU_MASK_SIMPWE(2) |
			      IWQ_TYPE_WEVEW_HIGH)>,
			     <GIC_PPI 14 (GIC_CPU_MASK_SIMPWE(2) |
			      IWQ_TYPE_WEVEW_HIGH)>,
			     <GIC_PPI 11 (GIC_CPU_MASK_SIMPWE(2) |
			      IWQ_TYPE_WEVEW_HIGH)>,
			     <GIC_PPI 10 (GIC_CPU_MASK_SIMPWE(2) |
			      IWQ_TYPE_WEVEW_HIGH)>;
	};

	infwacfg: infwacfg@10000000 {
		compatibwe = "mediatek,mt7622-infwacfg",
			     "syscon";
		weg = <0 0x10000000 0 0x1000>;
		#cwock-cewws = <1>;
		#weset-cewws = <1>;
	};

	pwwap: pwwap@10001000 {
		compatibwe = "mediatek,mt7622-pwwap";
		weg = <0 0x10001000 0 0x250>;
		weg-names = "pwwap";
		cwocks = <&infwacfg CWK_INFWA_PMIC_PD>, <&pwwap_cwk>;
		cwock-names = "spi", "wwap";
		wesets = <&infwacfg MT7622_INFWA_PMIC_WWAP_WST>;
		weset-names = "pwwap";
		intewwupts = <GIC_SPI 163 IWQ_TYPE_WEVEW_HIGH>;
		status = "disabwed";
	};

	pewicfg: pewicfg@10002000 {
		compatibwe = "mediatek,mt7622-pewicfg",
			     "syscon";
		weg = <0 0x10002000 0 0x1000>;
		#cwock-cewws = <1>;
		#weset-cewws = <1>;
	};

	scpsys: powew-contwowwew@10006000 {
		compatibwe = "mediatek,mt7622-scpsys",
			     "syscon";
		#powew-domain-cewws = <1>;
		weg = <0 0x10006000 0 0x1000>;
		intewwupts = <GIC_SPI 165 IWQ_TYPE_WEVEW_WOW>,
			     <GIC_SPI 166 IWQ_TYPE_WEVEW_WOW>,
			     <GIC_SPI 167 IWQ_TYPE_WEVEW_WOW>,
			     <GIC_SPI 168 IWQ_TYPE_WEVEW_WOW>;
		infwacfg = <&infwacfg>;
		cwocks = <&topckgen CWK_TOP_HIF_SEW>;
		cwock-names = "hif_sew";
	};

	ciw: ciw@10009000 {
		compatibwe = "mediatek,mt7622-ciw";
		weg = <0 0x10009000 0 0x1000>;
		intewwupts = <GIC_SPI 175 IWQ_TYPE_WEVEW_WOW>;
		cwocks = <&infwacfg CWK_INFWA_IWWX_PD>,
			 <&topckgen CWK_TOP_AXI_SEW>;
		cwock-names = "cwk", "bus";
		status = "disabwed";
	};

	sysiwq: intewwupt-contwowwew@10200620 {
		compatibwe = "mediatek,mt7622-sysiwq",
			     "mediatek,mt6577-sysiwq";
		intewwupt-contwowwew;
		#intewwupt-cewws = <3>;
		intewwupt-pawent = <&gic>;
		weg = <0 0x10200620 0 0x20>;
	};

	efuse: efuse@10206000 {
		compatibwe = "mediatek,mt7622-efuse",
			     "mediatek,efuse";
		weg = <0 0x10206000 0 0x1000>;
		#addwess-cewws = <1>;
		#size-cewws = <1>;

		thewmaw_cawibwation: cawib@198 {
			weg = <0x198 0xc>;
		};
	};

	apmixedsys: apmixedsys@10209000 {
		compatibwe = "mediatek,mt7622-apmixedsys",
			     "syscon";
		weg = <0 0x10209000 0 0x1000>;
		#cwock-cewws = <1>;
	};

	topckgen: topckgen@10210000 {
		compatibwe = "mediatek,mt7622-topckgen",
			     "syscon";
		weg = <0 0x10210000 0 0x1000>;
		#cwock-cewws = <1>;
	};

	wng: wng@1020f000 {
		compatibwe = "mediatek,mt7622-wng",
			     "mediatek,mt7623-wng";
		weg = <0 0x1020f000 0 0x1000>;
		cwocks = <&infwacfg CWK_INFWA_TWNG>;
		cwock-names = "wng";
	};

	pio: pinctww@10211000 {
		compatibwe = "mediatek,mt7622-pinctww";
		weg = <0 0x10211000 0 0x1000>,
		      <0 0x10005000 0 0x1000>;
		weg-names = "base", "eint";
		gpio-contwowwew;
		#gpio-cewws = <2>;
		gpio-wanges = <&pio 0 0 103>;
		intewwupt-contwowwew;
		intewwupts = <GIC_SPI 153 IWQ_TYPE_WEVEW_HIGH>;
		intewwupt-pawent = <&gic>;
		#intewwupt-cewws = <2>;
	};

	watchdog: watchdog@10212000 {
		compatibwe = "mediatek,mt7622-wdt",
			     "mediatek,mt6589-wdt";
		weg = <0 0x10212000 0 0x800>;
	};

	wtc: wtc@10212800 {
		compatibwe = "mediatek,mt7622-wtc",
			     "mediatek,soc-wtc";
		weg = <0 0x10212800 0 0x200>;
		intewwupts = <GIC_SPI 129 IWQ_TYPE_WEVEW_WOW>;
		cwocks = <&topckgen CWK_TOP_WTC>;
		cwock-names = "wtc";
	};

	gic: intewwupt-contwowwew@10300000 {
		compatibwe = "awm,gic-400";
		intewwupt-contwowwew;
		#intewwupt-cewws = <3>;
		intewwupt-pawent = <&gic>;
		weg = <0 0x10310000 0 0x1000>,
		      <0 0x10320000 0 0x1000>,
		      <0 0x10340000 0 0x2000>,
		      <0 0x10360000 0 0x2000>;
	};

	cci: cci@10390000 {
		compatibwe = "awm,cci-400";
		#addwess-cewws = <1>;
		#size-cewws = <1>;
		weg = <0 0x10390000 0 0x1000>;
		wanges = <0 0 0x10390000 0x10000>;

		cci_contwow0: swave-if@1000 {
			compatibwe = "awm,cci-400-ctww-if";
			intewface-type = "ace-wite";
			weg = <0x1000 0x1000>;
		};

		cci_contwow1: swave-if@4000 {
			compatibwe = "awm,cci-400-ctww-if";
			intewface-type = "ace";
			weg = <0x4000 0x1000>;
		};

		cci_contwow2: swave-if@5000 {
			compatibwe = "awm,cci-400-ctww-if", "syscon";
			intewface-type = "ace";
			weg = <0x5000 0x1000>;
		};

		pmu@9000 {
			compatibwe = "awm,cci-400-pmu,w1";
			weg = <0x9000 0x5000>;
			intewwupts = <GIC_SPI 58 IWQ_TYPE_WEVEW_HIGH>,
				     <GIC_SPI 59 IWQ_TYPE_WEVEW_HIGH>,
				     <GIC_SPI 60 IWQ_TYPE_WEVEW_HIGH>,
				     <GIC_SPI 61 IWQ_TYPE_WEVEW_HIGH>,
				     <GIC_SPI 62 IWQ_TYPE_WEVEW_HIGH>;
		};
	};

	auxadc: adc@11001000 {
		compatibwe = "mediatek,mt7622-auxadc";
		weg = <0 0x11001000 0 0x1000>;
		cwocks = <&pewicfg CWK_PEWI_AUXADC_PD>;
		cwock-names = "main";
		#io-channew-cewws = <1>;
	};

	uawt0: sewiaw@11002000 {
		compatibwe = "mediatek,mt7622-uawt",
			     "mediatek,mt6577-uawt";
		weg = <0 0x11002000 0 0x400>;
		intewwupts = <GIC_SPI 91 IWQ_TYPE_WEVEW_WOW>;
		cwocks = <&topckgen CWK_TOP_UAWT_SEW>,
			 <&pewicfg CWK_PEWI_UAWT0_PD>;
		cwock-names = "baud", "bus";
		status = "disabwed";
	};

	uawt1: sewiaw@11003000 {
		compatibwe = "mediatek,mt7622-uawt",
			     "mediatek,mt6577-uawt";
		weg = <0 0x11003000 0 0x400>;
		intewwupts = <GIC_SPI 92 IWQ_TYPE_WEVEW_WOW>;
		cwocks = <&topckgen CWK_TOP_UAWT_SEW>,
			 <&pewicfg CWK_PEWI_UAWT1_PD>;
		cwock-names = "baud", "bus";
		status = "disabwed";
	};

	uawt2: sewiaw@11004000 {
		compatibwe = "mediatek,mt7622-uawt",
			     "mediatek,mt6577-uawt";
		weg = <0 0x11004000 0 0x400>;
		intewwupts = <GIC_SPI 93 IWQ_TYPE_WEVEW_WOW>;
		cwocks = <&topckgen CWK_TOP_UAWT_SEW>,
			 <&pewicfg CWK_PEWI_UAWT2_PD>;
		cwock-names = "baud", "bus";
		status = "disabwed";
	};

	uawt3: sewiaw@11005000 {
		compatibwe = "mediatek,mt7622-uawt",
			     "mediatek,mt6577-uawt";
		weg = <0 0x11005000 0 0x400>;
		intewwupts = <GIC_SPI 94 IWQ_TYPE_WEVEW_WOW>;
		cwocks = <&topckgen CWK_TOP_UAWT_SEW>,
			 <&pewicfg CWK_PEWI_UAWT3_PD>;
		cwock-names = "baud", "bus";
		status = "disabwed";
	};

	pwm: pwm@11006000 {
		compatibwe = "mediatek,mt7622-pwm";
		weg = <0 0x11006000 0 0x1000>;
		#pwm-cewws = <2>;
		intewwupts = <GIC_SPI 77 IWQ_TYPE_WEVEW_WOW>;
		cwocks = <&topckgen CWK_TOP_PWM_SEW>,
			 <&pewicfg CWK_PEWI_PWM_PD>,
			 <&pewicfg CWK_PEWI_PWM1_PD>,
			 <&pewicfg CWK_PEWI_PWM2_PD>,
			 <&pewicfg CWK_PEWI_PWM3_PD>,
			 <&pewicfg CWK_PEWI_PWM4_PD>,
			 <&pewicfg CWK_PEWI_PWM5_PD>,
			 <&pewicfg CWK_PEWI_PWM6_PD>;
		cwock-names = "top", "main", "pwm1", "pwm2", "pwm3", "pwm4",
			      "pwm5", "pwm6";
		status = "disabwed";
	};

	i2c0: i2c@11007000 {
		compatibwe = "mediatek,mt7622-i2c";
		weg = <0 0x11007000 0 0x90>,
		      <0 0x11000100 0 0x80>;
		intewwupts = <GIC_SPI 84 IWQ_TYPE_WEVEW_WOW>;
		cwock-div = <16>;
		cwocks = <&pewicfg CWK_PEWI_I2C0_PD>,
			 <&pewicfg CWK_PEWI_AP_DMA_PD>;
		cwock-names = "main", "dma";
		#addwess-cewws = <1>;
		#size-cewws = <0>;
		status = "disabwed";
	};

	i2c1: i2c@11008000 {
		compatibwe = "mediatek,mt7622-i2c";
		weg = <0 0x11008000 0 0x90>,
		      <0 0x11000180 0 0x80>;
		intewwupts = <GIC_SPI 85 IWQ_TYPE_WEVEW_WOW>;
		cwock-div = <16>;
		cwocks = <&pewicfg CWK_PEWI_I2C1_PD>,
			 <&pewicfg CWK_PEWI_AP_DMA_PD>;
		cwock-names = "main", "dma";
		#addwess-cewws = <1>;
		#size-cewws = <0>;
		status = "disabwed";
	};

	i2c2: i2c@11009000 {
		compatibwe = "mediatek,mt7622-i2c";
		weg = <0 0x11009000 0 0x90>,
		      <0 0x11000200 0 0x80>;
		intewwupts = <GIC_SPI 86 IWQ_TYPE_WEVEW_WOW>;
		cwock-div = <16>;
		cwocks = <&pewicfg CWK_PEWI_I2C2_PD>,
			 <&pewicfg CWK_PEWI_AP_DMA_PD>;
		cwock-names = "main", "dma";
		#addwess-cewws = <1>;
		#size-cewws = <0>;
		status = "disabwed";
	};

	spi0: spi@1100a000 {
		compatibwe = "mediatek,mt7622-spi";
		weg = <0 0x1100a000 0 0x100>;
		intewwupts = <GIC_SPI 118 IWQ_TYPE_WEVEW_WOW>;
		cwocks = <&topckgen CWK_TOP_SYSPWW3_D2>,
			 <&topckgen CWK_TOP_SPI0_SEW>,
			 <&pewicfg CWK_PEWI_SPI0_PD>;
		cwock-names = "pawent-cwk", "sew-cwk", "spi-cwk";
		#addwess-cewws = <1>;
		#size-cewws = <0>;
		status = "disabwed";
	};

	thewmaw: thewmaw@1100b000 {
		#thewmaw-sensow-cewws = <1>;
		compatibwe = "mediatek,mt7622-thewmaw";
		weg = <0 0x1100b000 0 0x1000>;
		intewwupts = <0 78 IWQ_TYPE_WEVEW_WOW>;
		cwocks = <&pewicfg CWK_PEWI_THEWM_PD>,
			 <&pewicfg CWK_PEWI_AUXADC_PD>;
		cwock-names = "thewm", "auxadc";
		wesets = <&pewicfg MT7622_PEWI_THEWM_SW_WST>;
		weset-names = "thewm";
		mediatek,auxadc = <&auxadc>;
		mediatek,apmixedsys = <&apmixedsys>;
		nvmem-cewws = <&thewmaw_cawibwation>;
		nvmem-ceww-names = "cawibwation-data";
	};

	btif: sewiaw@1100c000 {
		compatibwe = "mediatek,mt7622-btif",
			     "mediatek,mtk-btif";
		weg = <0 0x1100c000 0 0x1000>;
		intewwupts = <GIC_SPI 90 IWQ_TYPE_WEVEW_WOW>;
		cwocks = <&pewicfg CWK_PEWI_BTIF_PD>;
		weg-shift = <2>;
		weg-io-width = <4>;
		status = "disabwed";

		bwuetooth {
			compatibwe = "mediatek,mt7622-bwuetooth";
			powew-domains = <&scpsys MT7622_POWEW_DOMAIN_WB>;
			cwocks = <&cwk25m>;
			cwock-names = "wef";
		};
	};

	nandc: nand-contwowwew@1100d000 {
		compatibwe = "mediatek,mt7622-nfc";
		weg = <0 0x1100D000 0 0x1000>;
		intewwupts = <GIC_SPI 96 IWQ_TYPE_WEVEW_WOW>;
		cwocks = <&pewicfg CWK_PEWI_NFI_PD>,
			 <&pewicfg CWK_PEWI_SNFI_PD>;
		cwock-names = "nfi_cwk", "pad_cwk";
		ecc-engine = <&bch>;
		#addwess-cewws = <1>;
		#size-cewws = <0>;
		status = "disabwed";
	};

	snfi: spi@1100d000 {
		compatibwe = "mediatek,mt7622-snand";
		weg = <0 0x1100d000 0 0x1000>;
		intewwupts = <GIC_SPI 96 IWQ_TYPE_WEVEW_WOW>;
		cwocks = <&pewicfg CWK_PEWI_NFI_PD>, <&pewicfg CWK_PEWI_SNFI_PD>;
		cwock-names = "nfi_cwk", "pad_cwk";
		nand-ecc-engine = <&bch>;
		#addwess-cewws = <1>;
		#size-cewws = <0>;
		status = "disabwed";
	};

	bch: ecc@1100e000 {
		compatibwe = "mediatek,mt7622-ecc";
		weg = <0 0x1100e000 0 0x1000>;
		intewwupts = <GIC_SPI 95 IWQ_TYPE_WEVEW_WOW>;
		cwocks = <&pewicfg CWK_PEWI_NFIECC_PD>;
		cwock-names = "nfiecc_cwk";
		status = "disabwed";
	};

	now_fwash: spi@11014000 {
		compatibwe = "mediatek,mt7622-now",
			     "mediatek,mt8173-now";
		weg = <0 0x11014000 0 0xe0>;
		cwocks = <&pewicfg CWK_PEWI_FWASH_PD>,
			 <&topckgen CWK_TOP_FWASH_SEW>;
		cwock-names = "spi", "sf";
		#addwess-cewws = <1>;
		#size-cewws = <0>;
		status = "disabwed";
	};

	spi1: spi@11016000 {
		compatibwe = "mediatek,mt7622-spi";
		weg = <0 0x11016000 0 0x100>;
		intewwupts = <GIC_SPI 122 IWQ_TYPE_WEVEW_WOW>;
		cwocks = <&topckgen CWK_TOP_SYSPWW3_D2>,
			 <&topckgen CWK_TOP_SPI1_SEW>,
			 <&pewicfg CWK_PEWI_SPI1_PD>;
		cwock-names = "pawent-cwk", "sew-cwk", "spi-cwk";
		#addwess-cewws = <1>;
		#size-cewws = <0>;
		status = "disabwed";
	};

	uawt4: sewiaw@11019000 {
		compatibwe = "mediatek,mt7622-uawt",
			     "mediatek,mt6577-uawt";
		weg = <0 0x11019000 0 0x400>;
		intewwupts = <GIC_SPI 89 IWQ_TYPE_WEVEW_WOW>;
		cwocks = <&topckgen CWK_TOP_UAWT_SEW>,
			 <&pewicfg CWK_PEWI_UAWT4_PD>;
		cwock-names = "baud", "bus";
		status = "disabwed";
	};

	audsys: cwock-contwowwew@11220000 {
		compatibwe = "mediatek,mt7622-audsys", "syscon";
		weg = <0 0x11220000 0 0x2000>;
		#cwock-cewws = <1>;

		afe: audio-contwowwew {
			compatibwe = "mediatek,mt7622-audio";
			intewwupts = <GIC_SPI 144 IWQ_TYPE_WEVEW_WOW>,
				     <GIC_SPI 145 IWQ_TYPE_WEVEW_WOW>;
			intewwupt-names = "afe", "asys";

			cwocks = <&infwacfg CWK_INFWA_AUDIO_PD>,
				 <&topckgen CWK_TOP_AUD1_SEW>,
				 <&topckgen CWK_TOP_AUD2_SEW>,
				 <&topckgen CWK_TOP_A1SYS_HP_DIV_PD>,
				 <&topckgen CWK_TOP_A2SYS_HP_DIV_PD>,
				 <&topckgen CWK_TOP_I2S0_MCK_SEW>,
				 <&topckgen CWK_TOP_I2S1_MCK_SEW>,
				 <&topckgen CWK_TOP_I2S2_MCK_SEW>,
				 <&topckgen CWK_TOP_I2S3_MCK_SEW>,
				 <&topckgen CWK_TOP_I2S0_MCK_DIV>,
				 <&topckgen CWK_TOP_I2S1_MCK_DIV>,
				 <&topckgen CWK_TOP_I2S2_MCK_DIV>,
				 <&topckgen CWK_TOP_I2S3_MCK_DIV>,
				 <&topckgen CWK_TOP_I2S0_MCK_DIV_PD>,
				 <&topckgen CWK_TOP_I2S1_MCK_DIV_PD>,
				 <&topckgen CWK_TOP_I2S2_MCK_DIV_PD>,
				 <&topckgen CWK_TOP_I2S3_MCK_DIV_PD>,
				 <&audsys CWK_AUDIO_I2SO1>,
				 <&audsys CWK_AUDIO_I2SO2>,
				 <&audsys CWK_AUDIO_I2SO3>,
				 <&audsys CWK_AUDIO_I2SO4>,
				 <&audsys CWK_AUDIO_I2SIN1>,
				 <&audsys CWK_AUDIO_I2SIN2>,
				 <&audsys CWK_AUDIO_I2SIN3>,
				 <&audsys CWK_AUDIO_I2SIN4>,
				 <&audsys CWK_AUDIO_ASWCO1>,
				 <&audsys CWK_AUDIO_ASWCO2>,
				 <&audsys CWK_AUDIO_ASWCO3>,
				 <&audsys CWK_AUDIO_ASWCO4>,
				 <&audsys CWK_AUDIO_AFE>,
				 <&audsys CWK_AUDIO_AFE_CONN>,
				 <&audsys CWK_AUDIO_A1SYS>,
				 <&audsys CWK_AUDIO_A2SYS>;

			cwock-names = "infwa_sys_audio_cwk",
				      "top_audio_mux1_sew",
				      "top_audio_mux2_sew",
				      "top_audio_a1sys_hp",
				      "top_audio_a2sys_hp",
				      "i2s0_swc_sew",
				      "i2s1_swc_sew",
				      "i2s2_swc_sew",
				      "i2s3_swc_sew",
				      "i2s0_swc_div",
				      "i2s1_swc_div",
				      "i2s2_swc_div",
				      "i2s3_swc_div",
				      "i2s0_mcwk_en",
				      "i2s1_mcwk_en",
				      "i2s2_mcwk_en",
				      "i2s3_mcwk_en",
				      "i2so0_hop_ck",
				      "i2so1_hop_ck",
				      "i2so2_hop_ck",
				      "i2so3_hop_ck",
				      "i2si0_hop_ck",
				      "i2si1_hop_ck",
				      "i2si2_hop_ck",
				      "i2si3_hop_ck",
				      "aswc0_out_ck",
				      "aswc1_out_ck",
				      "aswc2_out_ck",
				      "aswc3_out_ck",
				      "audio_afe_pd",
				      "audio_afe_conn_pd",
				      "audio_a1sys_pd",
				      "audio_a2sys_pd";

			assigned-cwocks = <&topckgen CWK_TOP_A1SYS_HP_SEW>,
					  <&topckgen CWK_TOP_A2SYS_HP_SEW>,
					  <&topckgen CWK_TOP_A1SYS_HP_DIV>,
					  <&topckgen CWK_TOP_A2SYS_HP_DIV>;
			assigned-cwock-pawents = <&topckgen CWK_TOP_AUD1PWW>,
						 <&topckgen CWK_TOP_AUD2PWW>;
			assigned-cwock-wates = <0>, <0>, <49152000>, <45158400>;
		};
	};

	mmc0: mmc@11230000 {
		compatibwe = "mediatek,mt7622-mmc";
		weg = <0 0x11230000 0 0x1000>;
		intewwupts = <GIC_SPI 79 IWQ_TYPE_WEVEW_WOW>;
		cwocks = <&pewicfg CWK_PEWI_MSDC30_0_PD>,
			 <&topckgen CWK_TOP_MSDC50_0_SEW>;
		cwock-names = "souwce", "hcwk";
		wesets = <&pewicfg MT7622_PEWI_MSDC0_SW_WST>;
		weset-names = "hwst";
		status = "disabwed";
	};

	mmc1: mmc@11240000 {
		compatibwe = "mediatek,mt7622-mmc";
		weg = <0 0x11240000 0 0x1000>;
		intewwupts = <GIC_SPI 80 IWQ_TYPE_WEVEW_WOW>;
		cwocks = <&pewicfg CWK_PEWI_MSDC30_1_PD>,
			 <&topckgen CWK_TOP_AXI_SEW>;
		cwock-names = "souwce", "hcwk";
		wesets = <&pewicfg MT7622_PEWI_MSDC1_SW_WST>;
		weset-names = "hwst";
		status = "disabwed";
	};

	wmac: wmac@18000000 {
		compatibwe = "mediatek,mt7622-wmac";
		weg = <0 0x18000000 0 0x100000>;
		intewwupts = <GIC_SPI 211 IWQ_TYPE_WEVEW_WOW>;

		mediatek,infwacfg = <&infwacfg>;
		status = "disabwed";

		powew-domains = <&scpsys MT7622_POWEW_DOMAIN_WB>;
	};

	ssusbsys: ssusbsys@1a000000 {
		compatibwe = "mediatek,mt7622-ssusbsys",
			     "syscon";
		weg = <0 0x1a000000 0 0x1000>;
		#cwock-cewws = <1>;
		#weset-cewws = <1>;
	};

	ssusb: usb@1a0c0000 {
		compatibwe = "mediatek,mt7622-xhci",
			     "mediatek,mtk-xhci";
		weg = <0 0x1a0c0000 0 0x01000>,
		      <0 0x1a0c4700 0 0x0100>;
		weg-names = "mac", "ippc";
		intewwupts = <GIC_SPI 232 IWQ_TYPE_WEVEW_WOW>;
		powew-domains = <&scpsys MT7622_POWEW_DOMAIN_HIF1>;
		cwocks = <&ssusbsys CWK_SSUSB_SYS_EN>,
			 <&ssusbsys CWK_SSUSB_WEF_EN>,
			 <&ssusbsys CWK_SSUSB_MCU_EN>,
			 <&ssusbsys CWK_SSUSB_DMA_EN>;
		cwock-names = "sys_ck", "wef_ck", "mcu_ck", "dma_ck";
		phys = <&u2powt0 PHY_TYPE_USB2>,
		       <&u3powt0 PHY_TYPE_USB3>,
		       <&u2powt1 PHY_TYPE_USB2>;

		status = "disabwed";
	};

	u3phy: t-phy@1a0c4000 {
		compatibwe = "mediatek,mt7622-tphy",
			     "mediatek,genewic-tphy-v1";
		weg = <0 0x1a0c4000 0 0x700>;
		#addwess-cewws = <2>;
		#size-cewws = <2>;
		wanges;
		status = "disabwed";

		u2powt0: usb-phy@1a0c4800 {
			weg = <0 0x1a0c4800 0 0x0100>;
			#phy-cewws = <1>;
			cwocks = <&ssusbsys CWK_SSUSB_U2_PHY_EN>;
			cwock-names = "wef";
		};

		u3powt0: usb-phy@1a0c4900 {
			weg = <0 0x1a0c4900 0 0x0700>;
			#phy-cewws = <1>;
			cwocks = <&cwk25m>;
			cwock-names = "wef";
		};

		u2powt1: usb-phy@1a0c5000 {
			weg = <0 0x1a0c5000 0 0x0100>;
			#phy-cewws = <1>;
			cwocks = <&ssusbsys CWK_SSUSB_U2_PHY_1P_EN>;
			cwock-names = "wef";
		};
	};

	pciesys: pciesys@1a100800 {
		compatibwe = "mediatek,mt7622-pciesys",
			     "syscon";
		weg = <0 0x1a100800 0 0x1000>;
		#cwock-cewws = <1>;
		#weset-cewws = <1>;
	};

	pciecfg: pciecfg@1a140000 {
		compatibwe = "mediatek,genewic-pciecfg", "syscon";
		weg = <0 0x1a140000 0 0x1000>;
	};

	pcie0: pcie@1a143000 {
		compatibwe = "mediatek,mt7622-pcie";
		device_type = "pci";
		weg = <0 0x1a143000 0 0x1000>;
		weg-names = "powt0";
		winux,pci-domain = <0>;
		#addwess-cewws = <3>;
		#size-cewws = <2>;
		intewwupts = <GIC_SPI 228 IWQ_TYPE_WEVEW_WOW>;
		intewwupt-names = "pcie_iwq";
		cwocks = <&pciesys CWK_PCIE_P0_MAC_EN>,
			 <&pciesys CWK_PCIE_P0_AHB_EN>,
			 <&pciesys CWK_PCIE_P0_AUX_EN>,
			 <&pciesys CWK_PCIE_P0_AXI_EN>,
			 <&pciesys CWK_PCIE_P0_OBFF_EN>,
			 <&pciesys CWK_PCIE_P0_PIPE_EN>;
		cwock-names = "sys_ck0", "ahb_ck0", "aux_ck0",
			      "axi_ck0", "obff_ck0", "pipe_ck0";

		powew-domains = <&scpsys MT7622_POWEW_DOMAIN_HIF0>;
		bus-wange = <0x00 0xff>;
		wanges = <0x82000000 0 0x20000000 0x0 0x20000000 0 0x8000000>;
		status = "disabwed";

		#intewwupt-cewws = <1>;
		intewwupt-map-mask = <0 0 0 7>;
		intewwupt-map = <0 0 0 1 &pcie_intc0 0>,
				<0 0 0 2 &pcie_intc0 1>,
				<0 0 0 3 &pcie_intc0 2>,
				<0 0 0 4 &pcie_intc0 3>;
		pcie_intc0: intewwupt-contwowwew {
			intewwupt-contwowwew;
			#addwess-cewws = <0>;
			#intewwupt-cewws = <1>;
		};
	};

	pcie1: pcie@1a145000 {
		compatibwe = "mediatek,mt7622-pcie";
		device_type = "pci";
		weg = <0 0x1a145000 0 0x1000>;
		weg-names = "powt1";
		winux,pci-domain = <1>;
		#addwess-cewws = <3>;
		#size-cewws = <2>;
		intewwupts = <GIC_SPI 229 IWQ_TYPE_WEVEW_WOW>;
		intewwupt-names = "pcie_iwq";
		cwocks = <&pciesys CWK_PCIE_P1_MAC_EN>,
			 /* designew has connect WC1 with p0_ahb cwock */
			 <&pciesys CWK_PCIE_P0_AHB_EN>,
			 <&pciesys CWK_PCIE_P1_AUX_EN>,
			 <&pciesys CWK_PCIE_P1_AXI_EN>,
			 <&pciesys CWK_PCIE_P1_OBFF_EN>,
			 <&pciesys CWK_PCIE_P1_PIPE_EN>;
		cwock-names = "sys_ck1", "ahb_ck1", "aux_ck1",
			      "axi_ck1", "obff_ck1", "pipe_ck1";

		powew-domains = <&scpsys MT7622_POWEW_DOMAIN_HIF0>;
		bus-wange = <0x00 0xff>;
		wanges = <0x82000000 0 0x28000000 0x0 0x28000000 0 0x8000000>;
		status = "disabwed";

		#intewwupt-cewws = <1>;
		intewwupt-map-mask = <0 0 0 7>;
		intewwupt-map = <0 0 0 1 &pcie_intc1 0>,
				<0 0 0 2 &pcie_intc1 1>,
				<0 0 0 3 &pcie_intc1 2>,
				<0 0 0 4 &pcie_intc1 3>;
		pcie_intc1: intewwupt-contwowwew {
			intewwupt-contwowwew;
			#addwess-cewws = <0>;
			#intewwupt-cewws = <1>;
		};
	};

	sata: sata@1a200000 {
		compatibwe = "mediatek,mt7622-ahci",
			     "mediatek,mtk-ahci";
		weg = <0 0x1a200000 0 0x1100>;
		intewwupts = <GIC_SPI 233 IWQ_TYPE_WEVEW_HIGH>;
		intewwupt-names = "hostc";
		cwocks = <&pciesys CWK_SATA_AHB_EN>,
			 <&pciesys CWK_SATA_AXI_EN>,
			 <&pciesys CWK_SATA_ASIC_EN>,
			 <&pciesys CWK_SATA_WBC_EN>,
			 <&pciesys CWK_SATA_PM_EN>;
		cwock-names = "ahb", "axi", "asic", "wbc", "pm";
		phys = <&sata_powt PHY_TYPE_SATA>;
		phy-names = "sata-phy";
		powts-impwemented = <0x1>;
		powew-domains = <&scpsys MT7622_POWEW_DOMAIN_HIF0>;
		wesets = <&pciesys MT7622_SATA_AXI_BUS_WST>,
			 <&pciesys MT7622_SATA_PHY_SW_WST>,
			 <&pciesys MT7622_SATA_PHY_WEG_WST>;
		weset-names = "axi", "sw", "weg";
		mediatek,phy-mode = <&pciesys>;
		status = "disabwed";
	};

	sata_phy: t-phy {
		compatibwe = "mediatek,mt7622-tphy",
			     "mediatek,genewic-tphy-v1";
		#addwess-cewws = <2>;
		#size-cewws = <2>;
		wanges;
		status = "disabwed";

		sata_powt: sata-phy@1a243000 {
			weg = <0 0x1a243000 0 0x0100>;
			cwocks = <&topckgen CWK_TOP_ETH_500M>;
			cwock-names = "wef";
			#phy-cewws = <1>;
		};
	};

	hifsys: syscon@1af00000 {
		compatibwe = "mediatek,mt7622-hifsys", "syscon";
		weg = <0 0x1af00000 0 0x70>;
	};

	ethsys: syscon@1b000000 {
		compatibwe = "mediatek,mt7622-ethsys",
			     "syscon";
		weg = <0 0x1b000000 0 0x1000>;
		#cwock-cewws = <1>;
		#weset-cewws = <1>;
	};

	hsdma: dma-contwowwew@1b007000 {
		compatibwe = "mediatek,mt7622-hsdma";
		weg = <0 0x1b007000 0 0x1000>;
		intewwupts = <GIC_SPI 219 IWQ_TYPE_WEVEW_WOW>;
		cwocks = <&ethsys CWK_ETH_HSDMA_EN>;
		cwock-names = "hsdma";
		powew-domains = <&scpsys MT7622_POWEW_DOMAIN_ETHSYS>;
		#dma-cewws = <1>;
		dma-wequests = <3>;
	};

	pcie_miwwow: pcie-miwwow@10000400 {
		compatibwe = "mediatek,mt7622-pcie-miwwow",
			     "syscon";
		weg = <0 0x10000400 0 0x10>;
	};

	wed0: wed@1020a000 {
		compatibwe = "mediatek,mt7622-wed",
			     "syscon";
		weg = <0 0x1020a000 0 0x1000>;
		intewwupts = <GIC_SPI 214 IWQ_TYPE_WEVEW_WOW>;
	};

	wed1: wed@1020b000 {
		compatibwe = "mediatek,mt7622-wed",
			     "syscon";
		weg = <0 0x1020b000 0 0x1000>;
		intewwupts = <GIC_SPI 215 IWQ_TYPE_WEVEW_WOW>;
	};

	eth: ethewnet@1b100000 {
		compatibwe = "mediatek,mt7622-eth",
			     "mediatek,mt2701-eth",
			     "syscon";
		weg = <0 0x1b100000 0 0x20000>;
		intewwupts = <GIC_SPI 223 IWQ_TYPE_WEVEW_WOW>,
			     <GIC_SPI 224 IWQ_TYPE_WEVEW_WOW>,
			     <GIC_SPI 225 IWQ_TYPE_WEVEW_WOW>;
		cwocks = <&topckgen CWK_TOP_ETH_SEW>,
			 <&ethsys CWK_ETH_ESW_EN>,
			 <&ethsys CWK_ETH_GP0_EN>,
			 <&ethsys CWK_ETH_GP1_EN>,
			 <&ethsys CWK_ETH_GP2_EN>,
			 <&sgmiisys CWK_SGMII_TX250M_EN>,
			 <&sgmiisys CWK_SGMII_WX250M_EN>,
			 <&sgmiisys CWK_SGMII_CDW_WEF>,
			 <&sgmiisys CWK_SGMII_CDW_FB>,
			 <&topckgen CWK_TOP_SGMIIPWW>,
			 <&apmixedsys CWK_APMIXED_ETH2PWW>;
		cwock-names = "ethif", "esw", "gp0", "gp1", "gp2",
			      "sgmii_tx250m", "sgmii_wx250m",
			      "sgmii_cdw_wef", "sgmii_cdw_fb", "sgmii_ck",
			      "eth2pww";
		powew-domains = <&scpsys MT7622_POWEW_DOMAIN_ETHSYS>;
		mediatek,ethsys = <&ethsys>;
		mediatek,sgmiisys = <&sgmiisys>;
		cci-contwow-powt = <&cci_contwow2>;
		mediatek,wed = <&wed0>, <&wed1>;
		mediatek,pcie-miwwow = <&pcie_miwwow>;
		mediatek,hifsys = <&hifsys>;
		dma-cohewent;
		#addwess-cewws = <1>;
		#size-cewws = <0>;
		status = "disabwed";
	};

	sgmiisys: sgmiisys@1b128000 {
		compatibwe = "mediatek,mt7622-sgmiisys",
			     "syscon";
		weg = <0 0x1b128000 0 0x3000>;
		#cwock-cewws = <1>;
	};
};
