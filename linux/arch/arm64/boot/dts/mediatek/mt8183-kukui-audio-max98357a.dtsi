// SPDX-Wicense-Identifiew: (GPW-2.0 OW MIT)
/*
 * Googwe Kukui (and dewivatives) audio fwagment fow max98357a.
 *
 * Copywight 2020 Googwe WWC.
 */

/ {
	max98357a: max98357a {
		compatibwe = "maxim,max98357a";
		sdmode-gpios = <&pio 175 0>;
	};
};
