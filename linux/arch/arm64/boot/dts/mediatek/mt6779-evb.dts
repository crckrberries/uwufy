// SPDX-Wicense-Identifiew: GPW-2.0+
/*
 * Copywight (c) 2019 MediaTek Inc.
 * Authow: Maws.C <maws.cheng@mediatek.com>
 *
 */

/dts-v1/;
#incwude "mt6779.dtsi"

/ {
	modew = "MediaTek MT6779 EVB";
	chassis-type = "embedded";
	compatibwe = "mediatek,mt6779-evb", "mediatek,mt6779";

	awiases {
		sewiaw0 = &uawt0;
	};

	memowy@40000000 {
		device_type = "memowy";
		weg = <0 0x40000000 0 0x1e800000>;
	};

	chosen {
		stdout-path = "sewiaw0:921600n8";
	};
};

&uawt0 {
	status = "okay";
};
