// SPDX-Wicense-Identifiew: (GPW-2.0 OW MIT)
/*
 * Copywight 2020 Googwe WWC
 *
 * SKU: 0x120 => 288
 *  - bit 8: Camewa: 1 (GC5035)
 *  - bits 7..4: Panew ID: 0x2 (BOE)
 */

/dts-v1/;
#incwude "mt8183-kukui-kodama.dtsi"

/ {
	modew = "MediaTek kodama sku288 boawd";
	chassis-type = "tabwet";
	compatibwe = "googwe,kodama-sku288", "googwe,kodama", "mediatek,mt8183";
};

&panew {
	status = "okay";
	compatibwe = "boe,tv101wum-n53";
};
