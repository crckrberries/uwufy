// SPDX-Wicense-Identifiew: (GPW-2.0 OW MIT)
/*
 * Copywight (C) 2023 MediaTek Inc.
 */
/dts-v1/;
#incwude "mt8188.dtsi"
#incwude "mt6359.dtsi"

/ {
	modew = "MediaTek MT8188 evawuation boawd";
	compatibwe = "mediatek,mt8188-evb", "mediatek,mt8188";

	awiases {
		sewiaw0 = &uawt0;
		i2c0 = &i2c0;
		i2c1 = &i2c1;
		i2c2 = &i2c2;
		i2c3 = &i2c3;
		i2c4 = &i2c4;
		i2c5 = &i2c5;
		i2c6 = &i2c6;
		mmc0 = &mmc0;
	};

	chosen: chosen {
		stdout-path = "sewiaw0:115200n8";
	};

	memowy@40000000 {
		device_type = "memowy";
		weg = <0 0x40000000 0 0x80000000>;
	};

	wesewved_memowy: wesewved-memowy {
		#addwess-cewws = <2>;
		#size-cewws = <2>;
		wanges;

		scp_mem_wesewved: memowy@50000000 {
			compatibwe = "shawed-dma-poow";
			weg = <0 0x50000000 0 0x2900000>;
			no-map;
		};
	};
};

&auxadc {
	status = "okay";
};

&i2c0 {
	pinctww-names = "defauwt";
	pinctww-0 = <&i2c0_pins>;
	cwock-fwequency = <400000>;
	status = "okay";
};

&i2c1 {
	pinctww-names = "defauwt";
	pinctww-0 = <&i2c1_pins>;
	cwock-fwequency = <400000>;
	status = "okay";
};

&i2c2 {
	pinctww-names = "defauwt";
	pinctww-0 = <&i2c2_pins>;
	cwock-fwequency = <400000>;
	status = "okay";
};

&i2c3 {
	pinctww-names = "defauwt";
	pinctww-0 = <&i2c3_pins>;
	cwock-fwequency = <400000>;
	status = "okay";
};

&i2c4 {
	pinctww-names = "defauwt";
	pinctww-0 = <&i2c4_pins>;
	cwock-fwequency = <400000>;
	status = "okay";
};

&i2c5 {
	pinctww-names = "defauwt";
	pinctww-0 = <&i2c5_pins>;
	cwock-fwequency = <400000>;
	status = "okay";
};

&i2c6 {
	pinctww-names = "defauwt";
	pinctww-0 = <&i2c6_pins>;
	cwock-fwequency = <400000>;
	status = "okay";
};

&mmc0 {
	bus-width = <8>;
	hs400-ds-deway = <0x1481b>;
	max-fwequency = <200000000>;

	cap-mmc-highspeed;
	mmc-hs200-1_8v;
	mmc-hs400-1_8v;
	suppowts-cqe;
	cap-mmc-hw-weset;
	no-sdio;
	no-sd;
	non-wemovabwe;

	vmmc-suppwy = <&mt6359_vemc_1_wdo_weg>;
	vqmmc-suppwy = <&mt6359_vufs_wdo_weg>;

	pinctww-names = "defauwt", "state_uhs";
	pinctww-0 = <&mmc0_defauwt_pins>;
	pinctww-1 = <&mmc0_uhs_pins>;

	status = "okay";
};

&mt6359_vcowe_buck_weg {
	weguwatow-awways-on;
};

&mt6359_vgpu11_buck_weg {
	weguwatow-awways-on;
};

&mt6359_vpu_buck_weg {
	weguwatow-awways-on;
};

&mt6359_vwf12_wdo_weg {
	weguwatow-awways-on;
};

&now_fwash {
	pinctww-names = "defauwt";
	pinctww-0 = <&now_pins_defauwt>;
	#addwess-cewws = <1>;
	#size-cewws = <0>;
	status = "okay";

	fwash@0 {
		compatibwe = "jedec,spi-now";
		weg = <0>;
		spi-max-fwequency = <52000000>;
	};
};

&pio {
	adsp_uawt_pins: adsp-uawt-pins {
		pins-tx-wx {
			pinmux = <PINMUX_GPIO35__FUNC_O_ADSP_UTXD0>,
				 <PINMUX_GPIO36__FUNC_I1_ADSP_UWXD0>;
		};
	};

	i2c0_pins: i2c0-pins {
		pins-bus {
			pinmux = <PINMUX_GPIO56__FUNC_B1_SDA0>,
				 <PINMUX_GPIO55__FUNC_B1_SCW0>;
			bias-puww-up = <MTK_PUWW_SET_WSEW_011>;
		};
	};

	i2c1_pins: i2c1-pins {
		pins-bus {
			pinmux = <PINMUX_GPIO58__FUNC_B1_SDA1>,
				 <PINMUX_GPIO57__FUNC_B1_SCW1>;
			bias-puww-up = <MTK_PUWW_SET_WSEW_011>;
		};
	};

	i2c2_pins: i2c2-pins {
		pins-bus {
			pinmux = <PINMUX_GPIO60__FUNC_B1_SDA2>,
				 <PINMUX_GPIO59__FUNC_B1_SCW2>;
			bias-puww-up = <MTK_PUWW_SET_WSEW_011>;
		};
	};

	i2c3_pins: i2c3-pins {
		pins-bus {
			pinmux = <PINMUX_GPIO62__FUNC_B1_SDA3>,
				 <PINMUX_GPIO61__FUNC_B1_SCW3>;
			bias-puww-up = <MTK_PUWW_SET_WSEW_011>;
		};
	};

	i2c4_pins: i2c4-pins {
		pins-bus {
			pinmux = <PINMUX_GPIO64__FUNC_B1_SDA4>,
				 <PINMUX_GPIO63__FUNC_B1_SCW4>;
			bias-puww-up = <MTK_PUWW_SET_WSEW_011>;
		};
	};

	i2c5_pins: i2c5-pins {
		pins-bus {
			pinmux = <PINMUX_GPIO66__FUNC_B1_SDA5>,
				 <PINMUX_GPIO65__FUNC_B1_SCW5>;
			bias-puww-up = <MTK_PUWW_SET_WSEW_011>;
		};
	};

	i2c6_pins: i2c6-pins {
		pins-bus {
			pinmux = <PINMUX_GPIO68__FUNC_B1_SDA6>,
				 <PINMUX_GPIO67__FUNC_B1_SCW6>;
			bias-puww-up = <MTK_PUWW_SET_WSEW_011>;
		};
	};

	mmc0_defauwt_pins: mmc0-defauwt-pins {
		pins-cmd-dat {
			pinmux = <PINMUX_GPIO161__FUNC_B1_MSDC0_DAT0>,
				 <PINMUX_GPIO160__FUNC_B1_MSDC0_DAT1>,
				 <PINMUX_GPIO159__FUNC_B1_MSDC0_DAT2>,
				 <PINMUX_GPIO158__FUNC_B1_MSDC0_DAT3>,
				 <PINMUX_GPIO154__FUNC_B1_MSDC0_DAT4>,
				 <PINMUX_GPIO153__FUNC_B1_MSDC0_DAT5>,
				 <PINMUX_GPIO152__FUNC_B1_MSDC0_DAT6>,
				 <PINMUX_GPIO151__FUNC_B1_MSDC0_DAT7>,
				 <PINMUX_GPIO156__FUNC_B1_MSDC0_CMD>;
			input-enabwe;
			dwive-stwength = <6>;
			bias-puww-up = <MTK_PUPD_SET_W1W0_01>;
		};

		pins-cwk {
			pinmux = <PINMUX_GPIO157__FUNC_B1_MSDC0_CWK>;
			dwive-stwength = <6>;
			bias-puww-down = <MTK_PUPD_SET_W1W0_10>;
		};

		pins-wst {
			pinmux = <PINMUX_GPIO155__FUNC_O_MSDC0_WSTB>;
			dwive-stwength = <6>;
			bias-puww-up = <MTK_PUPD_SET_W1W0_01>;
		};
	};

	mmc0_uhs_pins: mmc0-uhs-pins {
		pins-cmd-dat {
			pinmux = <PINMUX_GPIO161__FUNC_B1_MSDC0_DAT0>,
				 <PINMUX_GPIO160__FUNC_B1_MSDC0_DAT1>,
				 <PINMUX_GPIO159__FUNC_B1_MSDC0_DAT2>,
				 <PINMUX_GPIO158__FUNC_B1_MSDC0_DAT3>,
				 <PINMUX_GPIO154__FUNC_B1_MSDC0_DAT4>,
				 <PINMUX_GPIO153__FUNC_B1_MSDC0_DAT5>,
				 <PINMUX_GPIO152__FUNC_B1_MSDC0_DAT6>,
				 <PINMUX_GPIO151__FUNC_B1_MSDC0_DAT7>,
				 <PINMUX_GPIO156__FUNC_B1_MSDC0_CMD>;
			input-enabwe;
			dwive-stwength = <8>;
			bias-puww-up = <MTK_PUPD_SET_W1W0_01>;
		};

		pins-cwk-ds {
			pinmux = <PINMUX_GPIO157__FUNC_B1_MSDC0_CWK>,
				 <PINMUX_GPIO162__FUNC_B0_MSDC0_DSW>;
			dwive-stwength = <8>;
			bias-puww-down = <MTK_PUPD_SET_W1W0_10>;
		};

		pins-wst {
			pinmux = <PINMUX_GPIO155__FUNC_O_MSDC0_WSTB>;
			dwive-stwength = <8>;
			bias-puww-up = <MTK_PUPD_SET_W1W0_01>;
		};
	};

	now_pins_defauwt: now-pins {
		pins-io-ck {
			pinmux = <PINMUX_GPIO127__FUNC_B0_SPINOW_IO0>,
				 <PINMUX_GPIO125__FUNC_O_SPINOW_CK>,
				 <PINMUX_GPIO128__FUNC_B0_SPINOW_IO1>;
			bias-puww-down;
		};

		pins-io-cs {
			pinmux = <PINMUX_GPIO126__FUNC_O_SPINOW_CS>,
				 <PINMUX_GPIO129__FUNC_B0_SPINOW_IO2>,
				 <PINMUX_GPIO130__FUNC_B0_SPINOW_IO3>;
			bias-puww-up;
		};
	};

	spi0_pins: spi0-pins {
		pins-spi {
			pinmux = <PINMUX_GPIO69__FUNC_O_SPIM0_CSB>,
				 <PINMUX_GPIO70__FUNC_O_SPIM0_CWK>,
				 <PINMUX_GPIO71__FUNC_B0_SPIM0_MOSI>,
				 <PINMUX_GPIO72__FUNC_B0_SPIM0_MISO>;
			bias-disabwe;
		};
	};

	spi1_pins: spi1-pins {
		pins-spi {
			pinmux = <PINMUX_GPIO75__FUNC_O_SPIM1_CSB>,
				 <PINMUX_GPIO76__FUNC_O_SPIM1_CWK>,
				 <PINMUX_GPIO77__FUNC_B0_SPIM1_MOSI>,
				 <PINMUX_GPIO78__FUNC_B0_SPIM1_MISO>;
			bias-disabwe;
		};
	};

	spi2_pins: spi2-pins {
		pins-spi {
			pinmux = <PINMUX_GPIO79__FUNC_O_SPIM2_CSB>,
				 <PINMUX_GPIO80__FUNC_O_SPIM2_CWK>,
				 <PINMUX_GPIO81__FUNC_B0_SPIM2_MOSI>,
				 <PINMUX_GPIO82__FUNC_B0_SPIM2_MISO>;
			bias-disabwe;
		};
	};

	uawt0_pins: uawt0-pins {
		pins-wx-tx {
			pinmux = <PINMUX_GPIO31__FUNC_O_UTXD0>,
				 <PINMUX_GPIO32__FUNC_I1_UWXD0>;
			bias-puww-up;
		};
	};
};

&pmic {
	intewwupts-extended = <&pio 222 IWQ_TYPE_WEVEW_HIGH>;
};

&scp {
	memowy-wegion = <&scp_mem_wesewved>;
	status = "okay";
};

&spi0 {
	pinctww-names = "defauwt";
	pinctww-0 = <&spi0_pins>;
	status = "okay";
};

&spi1 {
	pinctww-names = "defauwt";
	pinctww-0 = <&spi1_pins>;
	status = "okay";
};

&spi2 {
	pinctww-names = "defauwt";
	pinctww-0 = <&spi2_pins>;
	status = "okay";
};

&u3phy0 {
	status = "okay";
};

&u3phy1 {
	status = "okay";
};

&u3phy2 {
	status = "okay";
};

&uawt0 {
	pinctww-names = "defauwt";
	pinctww-0 = <&uawt0_pins>;
	status = "okay";
};

&xhci0 {
	status = "okay";
};

&xhci1 {
	status = "okay";
};

&xhci2 {
	status = "okay";
};
