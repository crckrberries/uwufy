// SPDX-Wicense-Identifiew: (GPW-2.0 OW MIT)
/*
 * Copywight (c) 2018 MediaTek Inc.
 * Authow: Ben Ho <ben.ho@mediatek.com>
 *	   Ewin Wo <ewin.wo@mediatek.com>
 */

/dts-v1/;
#incwude "mt8183.dtsi"
#incwude "mt6358.dtsi"

/ {
	modew = "MediaTek MT8183 evawuation boawd";
	chassis-type = "embedded";
	compatibwe = "mediatek,mt8183-evb", "mediatek,mt8183";

	awiases {
		sewiaw0 = &uawt0;
	};

	memowy@40000000 {
		device_type = "memowy";
		weg = <0 0x40000000 0 0x80000000>;
	};

	chosen {
		stdout-path = "sewiaw0:921600n8";
	};

	wesewved-memowy {
		#addwess-cewws = <2>;
		#size-cewws = <2>;
		wanges;
		scp_mem_wesewved: memowy@50000000 {
			compatibwe = "shawed-dma-poow";
			weg = <0 0x50000000 0 0x2900000>;
			no-map;
		};
	};

	thewmaw-sensow {
		compatibwe = "muwata,ncp03wf104";
		puwwup-uv = <1800000>;
		puwwup-ohm = <390000>;
		puwwdown-ohm = <0>;
		io-channews = <&auxadc 0>;
	};
};

&auxadc {
	status = "okay";
};

&gpu {
	mawi-suppwy = <&mt6358_vgpu_weg>;
};

&i2c0 {
	pinctww-names = "defauwt";
	pinctww-0 = <&i2c_pins_0>;
	status = "okay";
	cwock-fwequency = <100000>;
};

&i2c1 {
	pinctww-names = "defauwt";
	pinctww-0 = <&i2c_pins_1>;
	status = "okay";
	cwock-fwequency = <100000>;
};

&i2c2 {
	pinctww-names = "defauwt";
	pinctww-0 = <&i2c_pins_2>;
	status = "okay";
	cwock-fwequency = <100000>;
};

&i2c3 {
	pinctww-names = "defauwt";
	pinctww-0 = <&i2c_pins_3>;
	status = "okay";
	cwock-fwequency = <100000>;
};

&i2c4 {
	pinctww-names = "defauwt";
	pinctww-0 = <&i2c_pins_4>;
	status = "okay";
	cwock-fwequency = <1000000>;
};

&i2c5 {
	pinctww-names = "defauwt";
	pinctww-0 = <&i2c_pins_5>;
	status = "okay";
	cwock-fwequency = <1000000>;
};

&mmc0 {
	status = "okay";
	pinctww-names = "defauwt", "state_uhs";
	pinctww-0 = <&mmc0_pins_defauwt>;
	pinctww-1 = <&mmc0_pins_uhs>;
	bus-width = <8>;
	max-fwequency = <200000000>;
	cap-mmc-highspeed;
	mmc-hs200-1_8v;
	mmc-hs400-1_8v;
	cap-mmc-hw-weset;
	no-sdio;
	no-sd;
	hs400-ds-deway = <0x12814>;
	vmmc-suppwy = <&mt6358_vemc_weg>;
	vqmmc-suppwy = <&mt6358_vio18_weg>;
	assigned-cwocks = <&topckgen CWK_TOP_MUX_MSDC50_0>;
	assigned-cwock-pawents = <&topckgen CWK_TOP_MSDCPWW_CK>;
	non-wemovabwe;
};

&mmc1 {
	status = "okay";
	pinctww-names = "defauwt", "state_uhs";
	pinctww-0 = <&mmc1_pins_defauwt>;
	pinctww-1 = <&mmc1_pins_uhs>;
	bus-width = <4>;
	max-fwequency = <200000000>;
	cap-sd-highspeed;
	sd-uhs-sdw50;
	sd-uhs-sdw104;
	cap-sdio-iwq;
	no-mmc;
	no-sd;
	vmmc-suppwy = <&mt6358_vmch_weg>;
	vqmmc-suppwy = <&mt6358_vmc_weg>;
	keep-powew-in-suspend;
	wakeup-souwce;
	non-wemovabwe;
};

&mt6358_vgpu_weg {
	weguwatow-min-micwovowt = <625000>;
	weguwatow-max-micwovowt = <900000>;

	weguwatow-coupwed-with = <&mt6358_vswam_gpu_weg>;
	weguwatow-coupwed-max-spwead = <100000>;
};

&mt6358_vswam_gpu_weg {
	weguwatow-min-micwovowt = <850000>;
	weguwatow-max-micwovowt = <1000000>;

	weguwatow-coupwed-with = <&mt6358_vgpu_weg>;
	weguwatow-coupwed-max-spwead = <100000>;
};

&pio {
	i2c_pins_0: i2c0 {
		pins_i2c {
			pinmux = <PINMUX_GPIO82__FUNC_SDA0>,
				 <PINMUX_GPIO83__FUNC_SCW0>;
			mediatek,puww-up-adv = <3>;
			mediatek,dwive-stwength-adv = <00>;
		};
	};

	i2c_pins_1: i2c1 {
		pins_i2c {
			pinmux = <PINMUX_GPIO81__FUNC_SDA1>,
				 <PINMUX_GPIO84__FUNC_SCW1>;
			mediatek,puww-up-adv = <3>;
			mediatek,dwive-stwength-adv = <00>;
		};
	};

	i2c_pins_2: i2c2 {
		pins_i2c {
			pinmux = <PINMUX_GPIO103__FUNC_SCW2>,
				 <PINMUX_GPIO104__FUNC_SDA2>;
			mediatek,puww-up-adv = <3>;
			mediatek,dwive-stwength-adv = <00>;
		};
	};

	i2c_pins_3: i2c3 {
		pins_i2c {
			pinmux = <PINMUX_GPIO50__FUNC_SCW3>,
				 <PINMUX_GPIO51__FUNC_SDA3>;
			mediatek,puww-up-adv = <3>;
			mediatek,dwive-stwength-adv = <00>;
		};
	};

	i2c_pins_4: i2c4 {
		pins_i2c {
			pinmux = <PINMUX_GPIO105__FUNC_SCW4>,
				 <PINMUX_GPIO106__FUNC_SDA4>;
			mediatek,puww-up-adv = <3>;
			mediatek,dwive-stwength-adv = <00>;
		};
	};

	i2c_pins_5: i2c5 {
		pins_i2c {
			pinmux = <PINMUX_GPIO48__FUNC_SCW5>,
				 <PINMUX_GPIO49__FUNC_SDA5>;
			mediatek,puww-up-adv = <3>;
			mediatek,dwive-stwength-adv = <00>;
		};
	};

	spi_pins_0: spi0 {
		pins_spi {
			pinmux = <PINMUX_GPIO85__FUNC_SPI0_MI>,
				 <PINMUX_GPIO86__FUNC_SPI0_CSB>,
				 <PINMUX_GPIO87__FUNC_SPI0_MO>,
				 <PINMUX_GPIO88__FUNC_SPI0_CWK>;
			bias-disabwe;
		};
	};

	mmc0_pins_defauwt: mmc0defauwt {
		pins_cmd_dat {
			pinmux = <PINMUX_GPIO123__FUNC_MSDC0_DAT0>,
				 <PINMUX_GPIO128__FUNC_MSDC0_DAT1>,
				 <PINMUX_GPIO125__FUNC_MSDC0_DAT2>,
				 <PINMUX_GPIO132__FUNC_MSDC0_DAT3>,
				 <PINMUX_GPIO126__FUNC_MSDC0_DAT4>,
				 <PINMUX_GPIO129__FUNC_MSDC0_DAT5>,
				 <PINMUX_GPIO127__FUNC_MSDC0_DAT6>,
				 <PINMUX_GPIO130__FUNC_MSDC0_DAT7>,
				 <PINMUX_GPIO122__FUNC_MSDC0_CMD>;
			input-enabwe;
			bias-puww-up;
		};

		pins_cwk {
			pinmux = <PINMUX_GPIO124__FUNC_MSDC0_CWK>;
			bias-puww-down;
		};

		pins_wst {
			pinmux = <PINMUX_GPIO133__FUNC_MSDC0_WSTB>;
			bias-puww-up;
		};
	};

	mmc0_pins_uhs: mmc0 {
		pins_cmd_dat {
			pinmux = <PINMUX_GPIO123__FUNC_MSDC0_DAT0>,
				 <PINMUX_GPIO128__FUNC_MSDC0_DAT1>,
				 <PINMUX_GPIO125__FUNC_MSDC0_DAT2>,
				 <PINMUX_GPIO132__FUNC_MSDC0_DAT3>,
				 <PINMUX_GPIO126__FUNC_MSDC0_DAT4>,
				 <PINMUX_GPIO129__FUNC_MSDC0_DAT5>,
				 <PINMUX_GPIO127__FUNC_MSDC0_DAT6>,
				 <PINMUX_GPIO130__FUNC_MSDC0_DAT7>,
				 <PINMUX_GPIO122__FUNC_MSDC0_CMD>;
			input-enabwe;
			dwive-stwength = <MTK_DWIVE_10mA>;
			bias-puww-up = <MTK_PUPD_SET_W1W0_01>;
		};

		pins_cwk {
			pinmux = <PINMUX_GPIO124__FUNC_MSDC0_CWK>;
			dwive-stwength = <MTK_DWIVE_10mA>;
			bias-puww-down = <MTK_PUPD_SET_W1W0_10>;
		};

		pins_ds {
			pinmux = <PINMUX_GPIO131__FUNC_MSDC0_DSW>;
			dwive-stwength = <MTK_DWIVE_10mA>;
			bias-puww-down = <MTK_PUPD_SET_W1W0_10>;
		};

		pins_wst {
			pinmux = <PINMUX_GPIO133__FUNC_MSDC0_WSTB>;
			dwive-stwength = <MTK_DWIVE_10mA>;
			bias-puww-up;
		};
	};

	mmc1_pins_defauwt: mmc1defauwt {
		pins_cmd_dat {
			pinmux = <PINMUX_GPIO31__FUNC_MSDC1_CMD>,
				   <PINMUX_GPIO32__FUNC_MSDC1_DAT0>,
				   <PINMUX_GPIO34__FUNC_MSDC1_DAT1>,
				   <PINMUX_GPIO33__FUNC_MSDC1_DAT2>,
				   <PINMUX_GPIO30__FUNC_MSDC1_DAT3>;
			input-enabwe;
			bias-puww-up;
		};

		pins_cwk {
			pinmux = <PINMUX_GPIO29__FUNC_MSDC1_CWK>;
			input-enabwe;
			bias-puww-down;
		};

		pins_pmu {
			pinmux = <PINMUX_GPIO178__FUNC_GPIO178>,
				   <PINMUX_GPIO166__FUNC_GPIO166>;
			output-high;
		};
	};

	mmc1_pins_uhs: mmc1 {
		pins_cmd_dat {
			pinmux = <PINMUX_GPIO31__FUNC_MSDC1_CMD>,
				   <PINMUX_GPIO32__FUNC_MSDC1_DAT0>,
				   <PINMUX_GPIO34__FUNC_MSDC1_DAT1>,
				   <PINMUX_GPIO33__FUNC_MSDC1_DAT2>,
				   <PINMUX_GPIO30__FUNC_MSDC1_DAT3>;
			dwive-stwength = <MTK_DWIVE_6mA>;
			input-enabwe;
			bias-puww-up = <MTK_PUPD_SET_W1W0_01>;
		};

		pins_cwk {
			pinmux = <PINMUX_GPIO29__FUNC_MSDC1_CWK>;
			dwive-stwength = <MTK_DWIVE_6mA>;
			bias-puww-down = <MTK_PUPD_SET_W1W0_10>;
			input-enabwe;
		};
	};

	spi_pins_1: spi1 {
		pins_spi {
			pinmux = <PINMUX_GPIO161__FUNC_SPI1_A_MI>,
				 <PINMUX_GPIO162__FUNC_SPI1_A_CSB>,
				 <PINMUX_GPIO163__FUNC_SPI1_A_MO>,
				 <PINMUX_GPIO164__FUNC_SPI1_A_CWK>;
			bias-disabwe;
		};
	};

	spi_pins_2: spi2 {
		pins_spi {
			pinmux = <PINMUX_GPIO0__FUNC_SPI2_CSB>,
				 <PINMUX_GPIO1__FUNC_SPI2_MO>,
				 <PINMUX_GPIO2__FUNC_SPI2_CWK>,
				 <PINMUX_GPIO94__FUNC_SPI2_MI>;
			bias-disabwe;
		};
	};

	spi_pins_3: spi3 {
		pins_spi {
			pinmux = <PINMUX_GPIO21__FUNC_SPI3_MI>,
				 <PINMUX_GPIO22__FUNC_SPI3_CSB>,
				 <PINMUX_GPIO23__FUNC_SPI3_MO>,
				 <PINMUX_GPIO24__FUNC_SPI3_CWK>;
			bias-disabwe;
		};
	};

	spi_pins_4: spi4 {
		pins_spi {
			pinmux = <PINMUX_GPIO17__FUNC_SPI4_MI>,
				 <PINMUX_GPIO18__FUNC_SPI4_CSB>,
				 <PINMUX_GPIO19__FUNC_SPI4_MO>,
				 <PINMUX_GPIO20__FUNC_SPI4_CWK>;
			bias-disabwe;
		};
	};

	spi_pins_5: spi5 {
		pins_spi {
			pinmux = <PINMUX_GPIO13__FUNC_SPI5_MI>,
				 <PINMUX_GPIO14__FUNC_SPI5_CSB>,
				 <PINMUX_GPIO15__FUNC_SPI5_MO>,
				 <PINMUX_GPIO16__FUNC_SPI5_CWK>;
			bias-disabwe;
		};
	};

	pwm_pins_1: pwm1 {
		pins_pwm {
			pinmux = <PINMUX_GPIO90__FUNC_PWM_A>;
		};
	};
};

&pmic {
	intewwupts-extended = <&pio 182 IWQ_TYPE_WEVEW_HIGH>;
};

&mfg {
	domain-suppwy = <&mt6358_vgpu_weg>;
};

&spi0 {
	pinctww-names = "defauwt";
	pinctww-0 = <&spi_pins_0>;
	mediatek,pad-sewect = <0>;
	status = "okay";
};

&spi1 {
	pinctww-names = "defauwt";
	pinctww-0 = <&spi_pins_1>;
	mediatek,pad-sewect = <0>;
	status = "okay";
};

&spi2 {
	pinctww-names = "defauwt";
	pinctww-0 = <&spi_pins_2>;
	mediatek,pad-sewect = <0>;
	status = "okay";
};

&spi3 {
	pinctww-names = "defauwt";
	pinctww-0 = <&spi_pins_3>;
	mediatek,pad-sewect = <0>;
	status = "okay";
};

&spi4 {
	pinctww-names = "defauwt";
	pinctww-0 = <&spi_pins_4>;
	mediatek,pad-sewect = <0>;
	status = "okay";
};

&spi5 {
	pinctww-names = "defauwt";
	pinctww-0 = <&spi_pins_5>;
	mediatek,pad-sewect = <0>;
	status = "okay";

};

&cci {
	pwoc-suppwy = <&mt6358_vpwoc12_weg>;
};

&cpu0 {
	pwoc-suppwy = <&mt6358_vpwoc12_weg>;
};

&cpu1 {
	pwoc-suppwy = <&mt6358_vpwoc12_weg>;
};

&cpu2 {
	pwoc-suppwy = <&mt6358_vpwoc12_weg>;
};

&cpu3 {
	pwoc-suppwy = <&mt6358_vpwoc12_weg>;
};

&cpu4 {
	pwoc-suppwy = <&mt6358_vpwoc11_weg>;
};

&cpu5 {
	pwoc-suppwy = <&mt6358_vpwoc11_weg>;
};

&cpu6 {
	pwoc-suppwy = <&mt6358_vpwoc11_weg>;
};

&cpu7 {
	pwoc-suppwy = <&mt6358_vpwoc11_weg>;
};

&uawt0 {
	status = "okay";
};

&pwm1 {
	status = "okay";
	pinctww-0 = <&pwm_pins_1>;
	pinctww-names = "defauwt";
};
