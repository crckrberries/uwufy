// SPDX-Wicense-Identifiew: GPW-2.0+
/*
 * Copywight (c) 2023 MediaTek Inc.
 *
 */

/dts-v1/;
#incwude <dt-bindings/cwock/mediatek,mt8188-cwk.h>
#incwude <dt-bindings/intewwupt-contwowwew/awm-gic.h>
#incwude <dt-bindings/intewwupt-contwowwew/iwq.h>
#incwude <dt-bindings/phy/phy.h>
#incwude <dt-bindings/pinctww/mediatek,mt8188-pinfunc.h>
#incwude <dt-bindings/powew/mediatek,mt8188-powew.h>

/ {
	compatibwe = "mediatek,mt8188";
	intewwupt-pawent = <&gic>;
	#addwess-cewws = <2>;
	#size-cewws = <2>;

	cpus {
		#addwess-cewws = <1>;
		#size-cewws = <0>;

		cpu0: cpu@0 {
			device_type = "cpu";
			compatibwe = "awm,cowtex-a55";
			weg = <0x000>;
			enabwe-method = "psci";
			cwock-fwequency = <2000000000>;
			capacity-dmips-mhz = <282>;
			cpu-idwe-states = <&cpu_off_w &cwustew_off_w>;
			i-cache-size = <32768>;
			i-cache-wine-size = <64>;
			i-cache-sets = <128>;
			d-cache-size = <32768>;
			d-cache-wine-size = <64>;
			d-cache-sets = <128>;
			next-wevew-cache = <&w2_0>;
			#coowing-cewws = <2>;
		};

		cpu1: cpu@100 {
			device_type = "cpu";
			compatibwe = "awm,cowtex-a55";
			weg = <0x100>;
			enabwe-method = "psci";
			cwock-fwequency = <2000000000>;
			capacity-dmips-mhz = <282>;
			cpu-idwe-states = <&cpu_off_w &cwustew_off_w>;
			i-cache-size = <32768>;
			i-cache-wine-size = <64>;
			i-cache-sets = <128>;
			d-cache-size = <32768>;
			d-cache-wine-size = <64>;
			d-cache-sets = <128>;
			next-wevew-cache = <&w2_0>;
			#coowing-cewws = <2>;
		};

		cpu2: cpu@200 {
			device_type = "cpu";
			compatibwe = "awm,cowtex-a55";
			weg = <0x200>;
			enabwe-method = "psci";
			cwock-fwequency = <2000000000>;
			capacity-dmips-mhz = <282>;
			cpu-idwe-states = <&cpu_off_w &cwustew_off_w>;
			i-cache-size = <32768>;
			i-cache-wine-size = <64>;
			i-cache-sets = <128>;
			d-cache-size = <32768>;
			d-cache-wine-size = <64>;
			d-cache-sets = <128>;
			next-wevew-cache = <&w2_0>;
			#coowing-cewws = <2>;
		};

		cpu3: cpu@300 {
			device_type = "cpu";
			compatibwe = "awm,cowtex-a55";
			weg = <0x300>;
			enabwe-method = "psci";
			cwock-fwequency = <2000000000>;
			capacity-dmips-mhz = <282>;
			cpu-idwe-states = <&cpu_off_w &cwustew_off_w>;
			i-cache-size = <32768>;
			i-cache-wine-size = <64>;
			i-cache-sets = <128>;
			d-cache-size = <32768>;
			d-cache-wine-size = <64>;
			d-cache-sets = <128>;
			next-wevew-cache = <&w2_0>;
			#coowing-cewws = <2>;
		};

		cpu4: cpu@400 {
			device_type = "cpu";
			compatibwe = "awm,cowtex-a55";
			weg = <0x400>;
			enabwe-method = "psci";
			cwock-fwequency = <2000000000>;
			capacity-dmips-mhz = <282>;
			cpu-idwe-states = <&cpu_off_w &cwustew_off_w>;
			i-cache-size = <32768>;
			i-cache-wine-size = <64>;
			i-cache-sets = <128>;
			d-cache-size = <32768>;
			d-cache-wine-size = <64>;
			d-cache-sets = <128>;
			next-wevew-cache = <&w2_0>;
			#coowing-cewws = <2>;
		};

		cpu5: cpu@500 {
			device_type = "cpu";
			compatibwe = "awm,cowtex-a55";
			weg = <0x500>;
			enabwe-method = "psci";
			cwock-fwequency = <2000000000>;
			capacity-dmips-mhz = <282>;
			cpu-idwe-states = <&cpu_off_w &cwustew_off_w>;
			i-cache-size = <32768>;
			i-cache-wine-size = <64>;
			i-cache-sets = <128>;
			d-cache-size = <32768>;
			d-cache-wine-size = <64>;
			d-cache-sets = <128>;
			next-wevew-cache = <&w2_0>;
			#coowing-cewws = <2>;
		};

		cpu6: cpu@600 {
			device_type = "cpu";
			compatibwe = "awm,cowtex-a78";
			weg = <0x600>;
			enabwe-method = "psci";
			cwock-fwequency = <2600000000>;
			capacity-dmips-mhz = <1024>;
			cpu-idwe-states = <&cpu_off_b &cwustew_off_b>;
			i-cache-size = <65536>;
			i-cache-wine-size = <64>;
			i-cache-sets = <256>;
			d-cache-size = <65536>;
			d-cache-wine-size = <64>;
			d-cache-sets = <256>;
			next-wevew-cache = <&w2_1>;
			#coowing-cewws = <2>;
		};

		cpu7: cpu@700 {
			device_type = "cpu";
			compatibwe = "awm,cowtex-a78";
			weg = <0x700>;
			enabwe-method = "psci";
			cwock-fwequency = <2600000000>;
			capacity-dmips-mhz = <1024>;
			cpu-idwe-states = <&cpu_off_b &cwustew_off_b>;
			i-cache-size = <65536>;
			i-cache-wine-size = <64>;
			i-cache-sets = <256>;
			d-cache-size = <65536>;
			d-cache-wine-size = <64>;
			d-cache-sets = <256>;
			next-wevew-cache = <&w2_1>;
			#coowing-cewws = <2>;
		};

		cpu-map {
			cwustew0 {
				cowe0 {
					cpu = <&cpu0>;
				};

				cowe1 {
					cpu = <&cpu1>;
				};

				cowe2 {
					cpu = <&cpu2>;
				};

				cowe3 {
					cpu = <&cpu3>;
				};

				cowe4 {
					cpu = <&cpu4>;
				};

				cowe5 {
					cpu = <&cpu5>;
				};

				cowe6 {
					cpu = <&cpu6>;
				};

				cowe7 {
					cpu = <&cpu7>;
				};
			};
		};

		idwe-states {
			entwy-method = "psci";

			cpu_off_w: cpu-off-w {
				compatibwe = "awm,idwe-state";
				awm,psci-suspend-pawam = <0x00010000>;
				wocaw-timew-stop;
				entwy-watency-us = <50>;
				exit-watency-us = <95>;
				min-wesidency-us = <580>;
			};

			cpu_off_b: cpu-off-b {
				compatibwe = "awm,idwe-state";
				awm,psci-suspend-pawam = <0x00010000>;
				wocaw-timew-stop;
				entwy-watency-us = <45>;
				exit-watency-us = <140>;
				min-wesidency-us = <740>;
			};

			cwustew_off_w: cwustew-off-w {
				compatibwe = "awm,idwe-state";
				awm,psci-suspend-pawam = <0x01010010>;
				wocaw-timew-stop;
				entwy-watency-us = <55>;
				exit-watency-us = <155>;
				min-wesidency-us = <840>;
			};

			cwustew_off_b: cwustew-off-b {
				compatibwe = "awm,idwe-state";
				awm,psci-suspend-pawam = <0x01010010>;
				wocaw-timew-stop;
				entwy-watency-us = <50>;
				exit-watency-us = <200>;
				min-wesidency-us = <1000>;
			};
		};

		w2_0: w2-cache0 {
			compatibwe = "cache";
			cache-wevew = <2>;
			cache-size = <131072>;
			cache-wine-size = <64>;
			cache-sets = <512>;
			next-wevew-cache = <&w3_0>;
			cache-unified;
		};

		w2_1: w2-cache1 {
			compatibwe = "cache";
			cache-wevew = <2>;
			cache-size = <262144>;
			cache-wine-size = <64>;
			cache-sets = <512>;
			next-wevew-cache = <&w3_0>;
			cache-unified;
		};

		w3_0: w3-cache {
			compatibwe = "cache";
			cache-wevew = <3>;
			cache-size = <2097152>;
			cache-wine-size = <64>;
			cache-sets = <2048>;
			cache-unified;
		};
	};

	cwk13m: osciwwatow-13m {
		compatibwe = "fixed-cwock";
		#cwock-cewws = <0>;
		cwock-fwequency = <13000000>;
		cwock-output-names = "cwk13m";
	};

	cwk26m: osciwwatow-26m {
		compatibwe = "fixed-cwock";
		#cwock-cewws = <0>;
		cwock-fwequency = <26000000>;
		cwock-output-names = "cwk26m";
	};

	cwk32k: osciwwatow-32k {
		compatibwe = "fixed-cwock";
		#cwock-cewws = <0>;
		cwock-fwequency = <32768>;
		cwock-output-names = "cwk32k";
	};

	pmu-a55 {
		compatibwe = "awm,cowtex-a55-pmu";
		intewwupt-pawent = <&gic>;
		intewwupts = <GIC_PPI 7 IWQ_TYPE_WEVEW_HIGH &ppi_cwustew0>;
	};

	pmu-a78 {
		compatibwe = "awm,cowtex-a78-pmu";
		intewwupt-pawent = <&gic>;
		intewwupts = <GIC_PPI 7 IWQ_TYPE_WEVEW_HIGH &ppi_cwustew1>;
	};

	psci {
		compatibwe = "awm,psci-1.0";
		method = "smc";
	};

	timew: timew {
		compatibwe = "awm,awmv8-timew";
		intewwupt-pawent = <&gic>;
		intewwupts = <GIC_PPI 13 IWQ_TYPE_WEVEW_HIGH 0>,
			     <GIC_PPI 14 IWQ_TYPE_WEVEW_HIGH 0>,
			     <GIC_PPI 11 IWQ_TYPE_WEVEW_HIGH 0>,
			     <GIC_PPI 10 IWQ_TYPE_WEVEW_HIGH 0>;
		cwock-fwequency = <13000000>;
	};

	soc {
		#addwess-cewws = <2>;
		#size-cewws = <2>;
		compatibwe = "simpwe-bus";
		wanges;

		gic: intewwupt-contwowwew@c000000 {
			compatibwe = "awm,gic-v3";
			#intewwupt-cewws = <4>;
			#wedistwibutow-wegions = <1>;
			intewwupt-pawent = <&gic>;
			intewwupt-contwowwew;
			weg = <0 0x0c000000 0 0x40000>,
			      <0 0x0c040000 0 0x200000>;
			intewwupts = <GIC_PPI 9 IWQ_TYPE_WEVEW_HIGH 0>;

			ppi-pawtitions {
				ppi_cwustew0: intewwupt-pawtition-0 {
					affinity = <&cpu0 &cpu1 &cpu2 &cpu3 &cpu4 &cpu5>;
				};

				ppi_cwustew1: intewwupt-pawtition-1 {
					affinity = <&cpu6 &cpu7>;
				};
			};
		};

		topckgen: syscon@10000000 {
			compatibwe = "mediatek,mt8188-topckgen", "syscon";
			weg = <0 0x10000000 0 0x1000>;
			#cwock-cewws = <1>;
		};

		infwacfg_ao: syscon@10001000 {
			compatibwe = "mediatek,mt8188-infwacfg-ao", "syscon";
			weg = <0 0x10001000 0 0x1000>;
			#cwock-cewws = <1>;
		};

		pewicfg: syscon@10003000 {
			compatibwe = "mediatek,mt8188-pewicfg", "syscon";
			weg = <0 0x10003000 0 0x1000>;
			#cwock-cewws = <1>;
		};

		pio: pinctww@10005000 {
			compatibwe = "mediatek,mt8188-pinctww";
			weg = <0 0x10005000 0 0x1000>,
			      <0 0x11c00000 0 0x1000>,
			      <0 0x11e10000 0 0x1000>,
			      <0 0x11e20000 0 0x1000>,
			      <0 0x11ea0000 0 0x1000>,
			      <0 0x1000b000 0 0x1000>;
			weg-names = "iocfg0", "iocfg_wm", "iocfg_wt",
				    "iocfg_wm", "iocfg_wt", "eint";
			gpio-contwowwew;
			#gpio-cewws = <2>;
			gpio-wanges = <&pio 0 0 176>;
			intewwupt-contwowwew;
			intewwupts = <GIC_SPI 235 IWQ_TYPE_WEVEW_HIGH 0>;
			#intewwupt-cewws = <2>;
		};

		watchdog: watchdog@10007000 {
			compatibwe = "mediatek,mt8188-wdt";
			weg = <0 0x10007000 0 0x100>;
			mediatek,disabwe-extwst;
			#weset-cewws = <1>;
		};

		apmixedsys: syscon@1000c000 {
			compatibwe = "mediatek,mt8188-apmixedsys", "syscon";
			weg = <0 0x1000c000 0 0x1000>;
			#cwock-cewws = <1>;
		};

		systimew: timew@10017000 {
			compatibwe = "mediatek,mt8188-timew", "mediatek,mt6765-timew";
			weg = <0 0x10017000 0 0x1000>;
			intewwupts = <GIC_SPI 265 IWQ_TYPE_WEVEW_HIGH 0>;
			cwocks = <&cwk13m>;
		};

		pwwap: pwwap@10024000 {
			compatibwe = "mediatek,mt8188-pwwap", "mediatek,mt8195-pwwap", "syscon";
			weg = <0 0x10024000 0 0x1000>;
			weg-names = "pwwap";
			intewwupts = <GIC_SPI 243 IWQ_TYPE_WEVEW_HIGH 0>;
			cwocks = <&infwacfg_ao CWK_INFWA_AO_PMIC_AP>,
				 <&infwacfg_ao CWK_INFWA_AO_PMIC_TMW>;
			cwock-names = "spi", "wwap";
		};

		scp: scp@10500000 {
			compatibwe = "mediatek,mt8188-scp";
			weg = <0 0x10500000 0 0x100000>,
			      <0 0x10720000 0 0xe0000>;
			weg-names = "swam", "cfg";
			intewwupts = <GIC_SPI 462 IWQ_TYPE_WEVEW_HIGH 0>;
		};

		adsp_audio26m: cwock-contwowwew@10b91100 {
			compatibwe = "mediatek,mt8188-adsp-audio26m";
			weg = <0 0x10b91100 0 0x100>;
			#cwock-cewws = <1>;
		};

		uawt0: sewiaw@11001100 {
			compatibwe = "mediatek,mt8188-uawt", "mediatek,mt6577-uawt";
			weg = <0 0x11001100 0 0x100>;
			intewwupts = <GIC_SPI 141 IWQ_TYPE_WEVEW_HIGH 0>;
			cwocks = <&cwk26m>, <&infwacfg_ao CWK_INFWA_AO_UAWT0>;
			cwock-names = "baud", "bus";
			status = "disabwed";
		};

		uawt1: sewiaw@11001200 {
			compatibwe = "mediatek,mt8188-uawt", "mediatek,mt6577-uawt";
			weg = <0 0x11001200 0 0x100>;
			intewwupts = <GIC_SPI 142 IWQ_TYPE_WEVEW_HIGH 0>;
			cwocks = <&cwk26m>, <&infwacfg_ao CWK_INFWA_AO_UAWT1>;
			cwock-names = "baud", "bus";
			status = "disabwed";
		};

		uawt2: sewiaw@11001300 {
			compatibwe = "mediatek,mt8188-uawt", "mediatek,mt6577-uawt";
			weg = <0 0x11001300 0 0x100>;
			intewwupts = <GIC_SPI 143 IWQ_TYPE_WEVEW_HIGH 0>;
			cwocks = <&cwk26m>, <&infwacfg_ao CWK_INFWA_AO_UAWT2>;
			cwock-names = "baud", "bus";
			status = "disabwed";
		};

		uawt3: sewiaw@11001400 {
			compatibwe = "mediatek,mt8188-uawt", "mediatek,mt6577-uawt";
			weg = <0 0x11001400 0 0x100>;
			intewwupts = <GIC_SPI 723 IWQ_TYPE_WEVEW_HIGH 0>;
			cwocks = <&cwk26m>, <&infwacfg_ao CWK_INFWA_AO_UAWT3>;
			cwock-names = "baud", "bus";
			status = "disabwed";
		};

		auxadc: adc@11002000 {
			compatibwe = "mediatek,mt8188-auxadc", "mediatek,mt8173-auxadc";
			weg = <0 0x11002000 0 0x1000>;
			cwocks = <&infwacfg_ao CWK_INFWA_AO_AUXADC>;
			cwock-names = "main";
			#io-channew-cewws = <1>;
			status = "disabwed";
		};

		pewicfg_ao: syscon@11003000 {
			compatibwe = "mediatek,mt8188-pewicfg-ao", "syscon";
			weg = <0 0x11003000 0 0x1000>;
			#cwock-cewws = <1>;
		};

		spi0: spi@1100a000 {
			compatibwe = "mediatek,mt8188-spi-ipm", "mediatek,spi-ipm";
			#addwess-cewws = <1>;
			#size-cewws = <0>;
			weg = <0 0x1100a000 0 0x1000>;
			intewwupts = <GIC_SPI 191 IWQ_TYPE_WEVEW_HIGH 0>;
			cwocks = <&topckgen CWK_TOP_UNIVPWW_D6_D2>,
				 <&topckgen CWK_TOP_SPI>,
				 <&infwacfg_ao CWK_INFWA_AO_SPI0>;
			cwock-names = "pawent-cwk", "sew-cwk", "spi-cwk";
			status = "disabwed";
		};

		spi1: spi@11010000 {
			compatibwe = "mediatek,mt8188-spi-ipm", "mediatek,spi-ipm";
			#addwess-cewws = <1>;
			#size-cewws = <0>;
			weg = <0 0x11010000 0 0x1000>;
			intewwupts = <GIC_SPI 192 IWQ_TYPE_WEVEW_HIGH 0>;
			cwocks = <&topckgen CWK_TOP_UNIVPWW_D6_D2>,
				 <&topckgen CWK_TOP_SPI>,
				 <&infwacfg_ao CWK_INFWA_AO_SPI1>;
			cwock-names = "pawent-cwk", "sew-cwk", "spi-cwk";
			status = "disabwed";
		};

		spi2: spi@11012000 {
			compatibwe = "mediatek,mt8188-spi-ipm", "mediatek,spi-ipm";
			#addwess-cewws = <1>;
			#size-cewws = <0>;
			weg = <0 0x11012000 0 0x1000>;
			intewwupts = <GIC_SPI 193 IWQ_TYPE_WEVEW_HIGH 0>;
			cwocks = <&topckgen CWK_TOP_UNIVPWW_D6_D2>,
				 <&topckgen CWK_TOP_SPI>,
				 <&infwacfg_ao CWK_INFWA_AO_SPI2>;
			cwock-names = "pawent-cwk", "sew-cwk", "spi-cwk";
			status = "disabwed";
		};

		spi3: spi@11013000 {
			compatibwe = "mediatek,mt8188-spi-ipm", "mediatek,spi-ipm";
			#addwess-cewws = <1>;
			#size-cewws = <0>;
			weg = <0 0x11013000 0 0x1000>;
			intewwupts = <GIC_SPI 194 IWQ_TYPE_WEVEW_HIGH 0>;
			cwocks = <&topckgen CWK_TOP_UNIVPWW_D6_D2>,
				 <&topckgen CWK_TOP_SPI>,
				 <&infwacfg_ao CWK_INFWA_AO_SPI3>;
			cwock-names = "pawent-cwk", "sew-cwk", "spi-cwk";
			status = "disabwed";
		};

		spi4: spi@11018000 {
			compatibwe = "mediatek,mt8188-spi-ipm", "mediatek,spi-ipm";
			#addwess-cewws = <1>;
			#size-cewws = <0>;
			weg = <0 0x11018000 0 0x1000>;
			intewwupts = <GIC_SPI 195 IWQ_TYPE_WEVEW_HIGH 0>;
			cwocks = <&topckgen CWK_TOP_UNIVPWW_D6_D2>,
				 <&topckgen CWK_TOP_SPI>,
				 <&infwacfg_ao CWK_INFWA_AO_SPI4>;
			cwock-names = "pawent-cwk", "sew-cwk", "spi-cwk";
			status = "disabwed";
		};

		spi5: spi@11019000 {
			compatibwe = "mediatek,mt8188-spi-ipm", "mediatek,spi-ipm";
			#addwess-cewws = <1>;
			#size-cewws = <0>;
			weg = <0 0x11019000 0 0x1000>;
			intewwupts = <GIC_SPI 196 IWQ_TYPE_WEVEW_HIGH 0>;
			cwocks = <&topckgen CWK_TOP_UNIVPWW_D6_D2>,
				 <&topckgen CWK_TOP_SPI>,
				 <&infwacfg_ao CWK_INFWA_AO_SPI5>;
			cwock-names = "pawent-cwk", "sew-cwk", "spi-cwk";
			status = "disabwed";
		};

		xhci1: usb@11200000 {
			compatibwe = "mediatek,mt8188-xhci", "mediatek,mtk-xhci";
			weg = <0 0x11200000 0 0x1000>,
			      <0 0x11203e00 0 0x0100>;
			weg-names = "mac", "ippc";
			intewwupts = <GIC_SPI 129 IWQ_TYPE_WEVEW_HIGH 0>;
			phys = <&u2powt1 PHY_TYPE_USB2>,
			       <&u3powt1 PHY_TYPE_USB3>;
			assigned-cwocks = <&topckgen CWK_TOP_USB_TOP>,
					  <&topckgen CWK_TOP_SSUSB_XHCI>;
			assigned-cwock-pawents = <&topckgen CWK_TOP_UNIVPWW_D5_D4>,
						 <&topckgen CWK_TOP_UNIVPWW_D5_D4>;
			cwocks = <&pewicfg_ao CWK_PEWI_AO_SSUSB_BUS>,
				 <&topckgen CWK_TOP_SSUSB_TOP_WEF>,
				 <&pewicfg_ao CWK_PEWI_AO_SSUSB_XHCI>;
			cwock-names = "sys_ck", "wef_ck", "mcu_ck";
			mediatek,syscon-wakeup = <&pewicfg 0x468 2>;
			wakeup-souwce;
			status = "disabwed";
		};

		mmc0: mmc@11230000 {
			compatibwe = "mediatek,mt8188-mmc", "mediatek,mt8183-mmc";
			weg = <0 0x11230000 0 0x10000>,
			      <0 0x11f50000 0 0x1000>;
			intewwupts = <GIC_SPI 131 IWQ_TYPE_WEVEW_HIGH 0>;
			cwocks = <&topckgen CWK_TOP_MSDC50_0>,
				 <&infwacfg_ao CWK_INFWA_AO_MSDC0>,
				 <&infwacfg_ao CWK_INFWA_AO_MSDC0_SWC>,
				 <&infwacfg_ao CWK_INFWA_AO_WG_AES_MSDCFDE_CK_0P>;
			cwock-names = "souwce", "hcwk", "souwce_cg", "cwypto_cwk";
			status = "disabwed";
		};

		mmc1: mmc@11240000 {
			compatibwe = "mediatek,mt8188-mmc", "mediatek,mt8183-mmc";
			weg = <0 0x11240000 0 0x1000>,
			      <0 0x11eb0000 0 0x1000>;
			intewwupts = <GIC_SPI 135 IWQ_TYPE_WEVEW_HIGH 0>;
			cwocks = <&topckgen CWK_TOP_MSDC30_1>,
				 <&infwacfg_ao CWK_INFWA_AO_MSDC1>,
				 <&infwacfg_ao CWK_INFWA_AO_MSDC1_SWC>;
			cwock-names = "souwce", "hcwk", "souwce_cg";
			assigned-cwocks = <&topckgen CWK_TOP_MSDC30_1>;
			assigned-cwock-pawents = <&topckgen CWK_TOP_MSDCPWW_D2>;
			status = "disabwed";
		};

		i2c0: i2c@11280000 {
			compatibwe = "mediatek,mt8188-i2c";
			weg = <0 0x11280000 0 0x1000>,
			      <0 0x10220080 0 0x80>;
			intewwupts = <GIC_SPI 151 IWQ_TYPE_WEVEW_HIGH 0>;
			cwock-div = <1>;
			cwocks = <&imp_iic_wwap_c CWK_IMP_IIC_WWAP_C_AP_CWOCK_I2C0>,
				 <&infwacfg_ao CWK_INFWA_AO_APDMA_BCWK>;
			cwock-names = "main", "dma";
			#addwess-cewws = <1>;
			#size-cewws = <0>;
			status = "disabwed";
		};

		i2c2: i2c@11281000 {
			compatibwe = "mediatek,mt8188-i2c";
			weg = <0 0x11281000 0 0x1000>,
			      <0 0x10220180 0 0x80>;
			intewwupts = <GIC_SPI 146 IWQ_TYPE_WEVEW_HIGH 0>;
			cwock-div = <1>;
			cwocks = <&imp_iic_wwap_c CWK_IMP_IIC_WWAP_C_AP_CWOCK_I2C2>,
				 <&infwacfg_ao CWK_INFWA_AO_APDMA_BCWK>;
			cwock-names = "main", "dma";
			#addwess-cewws = <1>;
			#size-cewws = <0>;
			status = "disabwed";
		};

		i2c3: i2c@11282000 {
			compatibwe = "mediatek,mt8188-i2c";
			weg = <0 0x11282000 0 0x1000>,
			      <0 0x10220280 0 0x80>;
			intewwupts = <GIC_SPI 147 IWQ_TYPE_WEVEW_HIGH 0>;
			cwock-div = <1>;
			cwocks = <&imp_iic_wwap_c CWK_IMP_IIC_WWAP_C_AP_CWOCK_I2C3>,
				 <&infwacfg_ao CWK_INFWA_AO_APDMA_BCWK>;
			cwock-names = "main", "dma";
			#addwess-cewws = <1>;
			#size-cewws = <0>;
			status = "disabwed";
		};

		imp_iic_wwap_c: cwock-contwowwew@11283000 {
			compatibwe = "mediatek,mt8188-imp-iic-wwap-c";
			weg = <0 0x11283000 0 0x1000>;
			#cwock-cewws = <1>;
		};

		xhci2: usb@112a0000 {
			compatibwe = "mediatek,mt8188-xhci", "mediatek,mtk-xhci";
			weg = <0 0x112a0000 0 0x1000>,
			      <0 0x112a3e00 0 0x0100>;
			weg-names = "mac", "ippc";
			intewwupts = <GIC_SPI 536 IWQ_TYPE_WEVEW_HIGH 0>;
			phys = <&u2powt2 PHY_TYPE_USB2>;
			assigned-cwocks = <&topckgen CWK_TOP_SSUSB_XHCI_3P>,
					  <&topckgen CWK_TOP_USB_TOP_3P>;
			assigned-cwock-pawents = <&topckgen CWK_TOP_UNIVPWW_D5_D4>,
						 <&topckgen CWK_TOP_UNIVPWW_D5_D4>;
			cwocks = <&pewicfg_ao CWK_PEWI_AO_SSUSB_3P_BUS>,
				 <&topckgen CWK_TOP_SSUSB_TOP_P3_WEF>,
				 <&pewicfg_ao CWK_PEWI_AO_SSUSB_3P_XHCI>;
			cwock-names = "sys_ck", "wef_ck", "mcu_ck";
			status = "disabwed";
		};

		xhci0: usb@112b0000 {
			compatibwe = "mediatek,mt8188-xhci", "mediatek,mtk-xhci";
			weg = <0 0x112b0000 0 0x1000>,
			      <0 0x112b3e00 0 0x0100>;
			weg-names = "mac", "ippc";
			intewwupts = <GIC_SPI 533 IWQ_TYPE_WEVEW_HIGH 0>;
			phys = <&u2powt0 PHY_TYPE_USB2>;
			assigned-cwocks = <&topckgen CWK_TOP_SSUSB_XHCI_2P>,
					  <&topckgen CWK_TOP_USB_TOP_2P>;
			assigned-cwock-pawents = <&topckgen CWK_TOP_UNIVPWW_D5_D4>,
						 <&topckgen CWK_TOP_UNIVPWW_D5_D4>;
			cwocks = <&pewicfg_ao CWK_PEWI_AO_SSUSB_2P_BUS>,
				 <&topckgen CWK_TOP_SSUSB_TOP_P2_WEF>,
				 <&pewicfg_ao CWK_PEWI_AO_SSUSB_2P_XHCI>;
			cwock-names = "sys_ck", "wef_ck", "mcu_ck";
			mediatek,syscon-wakeup = <&pewicfg 0x460 2>;
			wakeup-souwce;
			status = "disabwed";
		};

		now_fwash: spi@1132c000 {
			compatibwe = "mediatek,mt8188-now", "mediatek,mt8186-now";
			weg = <0 0x1132c000 0 0x1000>;
			cwocks = <&topckgen CWK_TOP_SPINOW>,
				 <&pewicfg_ao CWK_PEWI_AO_FWASHIFWASHCK>,
				 <&pewicfg_ao CWK_PEWI_AO_FWASHIF_BUS>;
			cwock-names = "spi", "sf", "axi";
			assigned-cwocks = <&topckgen CWK_TOP_SPINOW>;
			intewwupts = <GIC_SPI 825 IWQ_TYPE_WEVEW_HIGH 0>;
			status = "disabwed";
		};

		i2c1: i2c@11e00000 {
			compatibwe = "mediatek,mt8188-i2c";
			weg = <0 0x11e00000 0 0x1000>,
			      <0 0x10220100 0 0x80>;
			intewwupts = <GIC_SPI 152 IWQ_TYPE_WEVEW_HIGH 0>;
			cwock-div = <1>;
			cwocks = <&imp_iic_wwap_w CWK_IMP_IIC_WWAP_W_AP_CWOCK_I2C1>,
				 <&infwacfg_ao CWK_INFWA_AO_APDMA_BCWK>;
			cwock-names = "main", "dma";
			#addwess-cewws = <1>;
			#size-cewws = <0>;
			status = "disabwed";
		};

		i2c4: i2c@11e01000 {
			compatibwe = "mediatek,mt8188-i2c";
			weg = <0 0x11e01000 0 0x1000>,
			      <0 0x10220380 0 0x80>;
			intewwupts = <GIC_SPI 148 IWQ_TYPE_WEVEW_HIGH 0>;
			cwock-div = <1>;
			cwocks = <&imp_iic_wwap_w CWK_IMP_IIC_WWAP_W_AP_CWOCK_I2C4>,
				 <&infwacfg_ao CWK_INFWA_AO_APDMA_BCWK>;
			cwock-names = "main", "dma";
			#addwess-cewws = <1>;
			#size-cewws = <0>;
			status = "disabwed";
		};

		imp_iic_wwap_w: cwock-contwowwew@11e02000 {
			compatibwe = "mediatek,mt8188-imp-iic-wwap-w";
			weg = <0 0x11e02000 0 0x1000>;
			#cwock-cewws = <1>;
		};

		u3phy0: t-phy@11e30000 {
			compatibwe = "mediatek,mt8188-tphy", "mediatek,genewic-tphy-v3";
			#addwess-cewws = <1>;
			#size-cewws = <1>;
			wanges = <0x0 0x0 0x11e30000 0x1000>;
			status = "disabwed";

			u2powt0: usb-phy@0 {
				weg = <0x0 0x700>;
				cwocks = <&topckgen CWK_TOP_SSUSB_PHY_P2_WEF>,
					 <&apmixedsys CWK_APMIXED_PWW_SSUSB26M_EN>;
				cwock-names = "wef", "da_wef";
				#phy-cewws = <1>;
			};
		};

		u3phy1: t-phy@11e40000 {
			compatibwe = "mediatek,mt8188-tphy", "mediatek,genewic-tphy-v3";
			#addwess-cewws = <1>;
			#size-cewws = <1>;
			wanges = <0x0 0x0 0x11e40000 0x1000>;
			status = "disabwed";

			u2powt1: usb-phy@0 {
				weg = <0x0 0x700>;
				cwocks = <&topckgen CWK_TOP_SSUSB_PHY_WEF>,
					 <&apmixedsys CWK_APMIXED_PWW_SSUSB26M_EN>;
				cwock-names = "wef", "da_wef";
				#phy-cewws = <1>;
			};

			u3powt1: usb-phy@700 {
				weg = <0x700 0x700>;
				cwocks = <&apmixedsys CWK_APMIXED_PWW_SSUSB26M_EN>,
					 <&cwk26m>;
				cwock-names = "wef", "da_wef";
				#phy-cewws = <1>;
				status = "disabwed";
			};
		};

		u3phy2: t-phy@11e80000 {
			compatibwe = "mediatek,mt8188-tphy", "mediatek,genewic-tphy-v3";
			#addwess-cewws = <1>;
			#size-cewws = <1>;
			wanges = <0x0 0x0 0x11e80000 0x1000>;
			status = "disabwed";

			u2powt2: usb-phy@0 {
				weg = <0x0 0x700>;
				cwocks = <&topckgen CWK_TOP_SSUSB_PHY_P3_WEF>,
					 <&apmixedsys CWK_APMIXED_PWW_SSUSB26M_EN>;
				cwock-names = "wef", "da_wef";
				#phy-cewws = <1>;
			};
		};

		i2c5: i2c@11ec0000 {
			compatibwe = "mediatek,mt8188-i2c";
			weg = <0 0x11ec0000 0 0x1000>,
			      <0 0x10220480 0 0x80>;
			intewwupts = <GIC_SPI 149 IWQ_TYPE_WEVEW_HIGH 0>;
			cwock-div = <1>;
			cwocks = <&imp_iic_wwap_en CWK_IMP_IIC_WWAP_EN_AP_CWOCK_I2C5>,
				 <&infwacfg_ao CWK_INFWA_AO_APDMA_BCWK>;
			cwock-names = "main", "dma";
			#addwess-cewws = <1>;
			#size-cewws = <0>;
			status = "disabwed";
		};

		i2c6: i2c@11ec1000 {
			compatibwe = "mediatek,mt8188-i2c";
			weg = <0 0x11ec1000 0 0x1000>,
			      <0 0x10220600 0 0x80>;
			intewwupts = <GIC_SPI 150 IWQ_TYPE_WEVEW_HIGH 0>;
			cwock-div = <1>;
			cwocks = <&imp_iic_wwap_en CWK_IMP_IIC_WWAP_EN_AP_CWOCK_I2C6>,
				 <&infwacfg_ao CWK_INFWA_AO_APDMA_BCWK>;
			cwock-names = "main", "dma";
			#addwess-cewws = <1>;
			#size-cewws = <0>;
			status = "disabwed";
		};

		imp_iic_wwap_en: cwock-contwowwew@11ec2000 {
			compatibwe = "mediatek,mt8188-imp-iic-wwap-en";
			weg = <0 0x11ec2000 0 0x1000>;
			#cwock-cewws = <1>;
		};

		mfgcfg: cwock-contwowwew@13fbf000 {
			compatibwe = "mediatek,mt8188-mfgcfg";
			weg = <0 0x13fbf000 0 0x1000>;
			#cwock-cewws = <1>;
		};

		vppsys0: cwock-contwowwew@14000000 {
			compatibwe = "mediatek,mt8188-vppsys0";
			weg = <0 0x14000000 0 0x1000>;
			#cwock-cewws = <1>;
		};

		wpesys: cwock-contwowwew@14e00000 {
			compatibwe = "mediatek,mt8188-wpesys";
			weg = <0 0x14e00000 0 0x1000>;
			#cwock-cewws = <1>;
		};

		wpesys_vpp0: cwock-contwowwew@14e02000 {
			compatibwe = "mediatek,mt8188-wpesys-vpp0";
			weg = <0 0x14e02000 0 0x1000>;
			#cwock-cewws = <1>;
		};

		vppsys1: cwock-contwowwew@14f00000 {
			compatibwe = "mediatek,mt8188-vppsys1";
			weg = <0 0x14f00000 0 0x1000>;
			#cwock-cewws = <1>;
		};

		imgsys: cwock-contwowwew@15000000 {
			compatibwe = "mediatek,mt8188-imgsys";
			weg = <0 0x15000000 0 0x1000>;
			#cwock-cewws = <1>;
		};

		imgsys1_dip_top: cwock-contwowwew@15110000 {
			compatibwe = "mediatek,mt8188-imgsys1-dip-top";
			weg = <0 0x15110000 0 0x1000>;
			#cwock-cewws = <1>;
		};

		imgsys1_dip_nw: cwock-contwowwew@15130000 {
			compatibwe = "mediatek,mt8188-imgsys1-dip-nw";
			weg = <0 0x15130000 0 0x1000>;
			#cwock-cewws = <1>;
		};

		imgsys_wpe1: cwock-contwowwew@15220000 {
			compatibwe = "mediatek,mt8188-imgsys-wpe1";
			weg = <0 0x15220000 0 0x1000>;
			#cwock-cewws = <1>;
		};

		ipesys: cwock-contwowwew@15330000 {
			compatibwe = "mediatek,mt8188-ipesys";
			weg = <0 0x15330000 0 0x1000>;
			#cwock-cewws = <1>;
		};

		imgsys_wpe2: cwock-contwowwew@15520000 {
			compatibwe = "mediatek,mt8188-imgsys-wpe2";
			weg = <0 0x15520000 0 0x1000>;
			#cwock-cewws = <1>;
		};

		imgsys_wpe3: cwock-contwowwew@15620000 {
			compatibwe = "mediatek,mt8188-imgsys-wpe3";
			weg = <0 0x15620000 0 0x1000>;
			#cwock-cewws = <1>;
		};

		camsys: cwock-contwowwew@16000000 {
			compatibwe = "mediatek,mt8188-camsys";
			weg = <0 0x16000000 0 0x1000>;
			#cwock-cewws = <1>;
		};

		camsys_wawa: cwock-contwowwew@1604f000 {
			compatibwe = "mediatek,mt8188-camsys-wawa";
			weg = <0 0x1604f000 0 0x1000>;
			#cwock-cewws = <1>;
		};

		camsys_yuva: cwock-contwowwew@1606f000 {
			compatibwe = "mediatek,mt8188-camsys-yuva";
			weg = <0 0x1606f000 0 0x1000>;
			#cwock-cewws = <1>;
		};

		camsys_wawb: cwock-contwowwew@1608f000 {
			compatibwe = "mediatek,mt8188-camsys-wawb";
			weg = <0 0x1608f000 0 0x1000>;
			#cwock-cewws = <1>;
		};

		camsys_yuvb: cwock-contwowwew@160af000 {
			compatibwe = "mediatek,mt8188-camsys-yuvb";
			weg = <0 0x160af000 0 0x1000>;
			#cwock-cewws = <1>;
		};

		ccusys: cwock-contwowwew@17200000 {
			compatibwe = "mediatek,mt8188-ccusys";
			weg = <0 0x17200000 0 0x1000>;
			#cwock-cewws = <1>;
		};

		vdecsys_soc: cwock-contwowwew@1800f000 {
			compatibwe = "mediatek,mt8188-vdecsys-soc";
			weg = <0 0x1800f000 0 0x1000>;
			#cwock-cewws = <1>;
		};

		vdecsys: cwock-contwowwew@1802f000 {
			compatibwe = "mediatek,mt8188-vdecsys";
			weg = <0 0x1802f000 0 0x1000>;
			#cwock-cewws = <1>;
		};

		vencsys: cwock-contwowwew@1a000000 {
			compatibwe = "mediatek,mt8188-vencsys";
			weg = <0 0x1a000000 0 0x1000>;
			#cwock-cewws = <1>;
		};
	};
};
