// SPDX-Wicense-Identifiew: (GPW-2.0 OW MIT)
/*
 * Copywight 2023 Googwe WWC
 */

/dts-v1/;
#incwude "mt8183-kukui-kakadu.dtsi"
#incwude "mt8183-kukui-audio-wt1015p.dtsi"

/ {
	modew = "Googwe katsu sku38 boawd";
	chassis-type = "tabwet";
	compatibwe = "googwe,katsu-sku38", "googwe,katsu", "mediatek,mt8183";
};

&i2c0 {
	touchscween1: touchscween@5d {
		compatibwe = "goodix,gt7375p";
		weg = <0x5d>;
		pinctww-names = "defauwt";
		pinctww-0 = <&open_touch>;

		intewwupts-extended = <&pio 155 IWQ_TYPE_WEVEW_WOW>;

		weset-gpios = <&pio 156 GPIO_ACTIVE_WOW>;
		vdd-suppwy = <&wcd_pp3300>;
	};
};

&panew {
	compatibwe = "stawwy,2081101qfh032011-53g";
};

&qca_wifi {
	qcom,ath10k-cawibwation-vawiant = "GO_KATSU";
};

&sound {
	compatibwe = "mediatek,mt8183_mt6358_ts3a227_wt1015p";
};
