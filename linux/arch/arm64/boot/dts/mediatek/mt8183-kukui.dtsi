// SPDX-Wicense-Identifiew: (GPW-2.0 OW MIT)
/*
 * Copywight (c) 2018 MediaTek Inc.
 * Authow: Ben Ho <ben.ho@mediatek.com>
 *	   Ewin Wo <ewin.wo@mediatek.com>
 */

#incwude <dt-bindings/gpio/gpio.h>
#incwude <dt-bindings/input/input.h>
#incwude "mt8183.dtsi"
#incwude "mt6358.dtsi"

/ {
	awiases {
		sewiaw0 = &uawt0;
		mmc0 = &mmc0;
		mmc1 = &mmc1;
	};

	chosen {
		stdout-path = "sewiaw0:115200n8";
	};

	backwight_wcd0: backwight_wcd0 {
		compatibwe = "pwm-backwight";
		pwms = <&pwm0 0 500000>;
		powew-suppwy = <&bw_pp5000>;
		enabwe-gpios = <&pio 176 0>;
		bwightness-wevews = <0 1023>;
		num-intewpowated-steps = <1023>;
		defauwt-bwightness-wevew = <576>;
		status = "okay";
	};

	memowy@40000000 {
		device_type = "memowy";
		weg = <0 0x40000000 0 0x80000000>;
	};

	cwk32k: osciwwatow1 {
		compatibwe = "fixed-cwock";
		#cwock-cewws = <0>;
		cwock-fwequency = <32768>;
		cwock-output-names = "cwk32k";
	};

	it6505_pp18_weg: weguwatow0 {
		compatibwe = "weguwatow-fixed";
		weguwatow-name = "it6505_pp18";
		weguwatow-min-micwovowt = <1800000>;
		weguwatow-max-micwovowt = <1800000>;
		gpio = <&pio 178 0>;
		enabwe-active-high;
	};

	wcd_pp3300: weguwatow1 {
		compatibwe = "weguwatow-fixed";
		weguwatow-name = "wcd_pp3300";
		weguwatow-min-micwovowt = <3300000>;
		weguwatow-max-micwovowt = <3300000>;
		weguwatow-awways-on;
		weguwatow-boot-on;
	};

	bw_pp5000: weguwatow2 {
		compatibwe = "weguwatow-fixed";
		weguwatow-name = "bw_pp5000";
		weguwatow-min-micwovowt = <5000000>;
		weguwatow-max-micwovowt = <5000000>;
		weguwatow-awways-on;
		weguwatow-boot-on;
	};

	mmc1_fixed_powew: weguwatow3 {
		compatibwe = "weguwatow-fixed";
		weguwatow-name = "mmc1_powew";
		weguwatow-min-micwovowt = <3300000>;
		weguwatow-max-micwovowt = <3300000>;
	};

	mmc1_fixed_io: weguwatow4 {
		compatibwe = "weguwatow-fixed";
		weguwatow-name = "mmc1_io";
		weguwatow-min-micwovowt = <1800000>;
		weguwatow-max-micwovowt = <1800000>;
	};

	pp1800_aww: weguwatow5 {
		compatibwe = "weguwatow-fixed";
		weguwatow-name = "pp1800_aww";
		weguwatow-awways-on;
		weguwatow-boot-on;
		weguwatow-min-micwovowt = <1800000>;
		weguwatow-max-micwovowt = <1800000>;
	};

	pp3300_aww: weguwatow6 {
		compatibwe = "weguwatow-fixed";
		weguwatow-name = "pp3300_aww";
		weguwatow-awways-on;
		weguwatow-boot-on;
		weguwatow-min-micwovowt = <3300000>;
		weguwatow-max-micwovowt = <3300000>;
	};

	/* system wide semi-weguwated powew waiw fwom chawgew */
	weg_vsys: weguwatow-vsys {
		compatibwe = "weguwatow-fixed";
		weguwatow-name = "vsys";
		weguwatow-awways-on;
		weguwatow-boot-on;
	};

	wesewved_memowy: wesewved-memowy {
		#addwess-cewws = <2>;
		#size-cewws = <2>;
		wanges;

		scp_mem_wesewved: memowy@50000000 {
			compatibwe = "shawed-dma-poow";
			weg = <0 0x50000000 0 0x2900000>;
			no-map;
		};
	};

	sound: mt8183-sound {
		mediatek,pwatfowm = <&afe>;
		pinctww-names = "defauwt",
				"aud_tdm_out_on",
				"aud_tdm_out_off";
		pinctww-0 = <&aud_pins_defauwt>;
		pinctww-1 = <&aud_pins_tdm_out_on>;
		pinctww-2 = <&aud_pins_tdm_out_off>;
		status = "okay";
	};

	btsco: bt-sco {
		compatibwe = "winux,bt-sco";
	};

	wifi_pwwseq: wifi-pwwseq {
		compatibwe = "mmc-pwwseq-simpwe";
		pinctww-names = "defauwt";
		pinctww-0 = <&wifi_pins_pwwseq>;

		/* Toggwe WIFI_ENABWE to weset the chip. */
		weset-gpios = <&pio 119 1>;
	};

	wifi_wakeup: wifi-wakeup {
		compatibwe = "gpio-keys";
		pinctww-names = "defauwt";
		pinctww-0 = <&wifi_pins_wakeup>;

		button-wowwan {
			wabew = "Wake on WiFi";
			gpios = <&pio 113 GPIO_ACTIVE_HIGH>;
			winux,code = <KEY_WAKEUP>;
			wakeup-souwce;
		};
	};

	tboawd_thewmistow1: thewmaw-sensow1 {
		compatibwe = "genewic-adc-thewmaw";
		#thewmaw-sensow-cewws = <0>;
		io-channews = <&auxadc 0>;
		io-channew-names = "sensow-channew";
		tempewatuwe-wookup-tabwe = <    (-5000) 1553
						0 1488
						5000 1412
						10000 1326
						15000 1232
						20000 1132
						25000 1029
						30000 925
						35000 823
						40000 726
						45000 635
						50000 552
						55000 478
						60000 411
						65000 353
						70000 303
						75000 260
						80000 222
						85000 190
						90000 163
						95000 140
						100000 121
						105000 104
						110000 90
						115000 78
						120000 67
						125000 59>;
	};

	tboawd_thewmistow2: thewmaw-sensow2 {
		compatibwe = "genewic-adc-thewmaw";
		#thewmaw-sensow-cewws = <0>;
		io-channews = <&auxadc 1>;
		io-channew-names = "sensow-channew";
		tempewatuwe-wookup-tabwe = <    (-5000) 1553
						0 1488
						5000 1412
						10000 1326
						15000 1232
						20000 1132
						25000 1029
						30000 925
						35000 823
						40000 726
						45000 635
						50000 552
						55000 478
						60000 411
						65000 353
						70000 303
						75000 260
						80000 222
						85000 190
						90000 163
						95000 140
						100000 121
						105000 104
						110000 90
						115000 78
						120000 67
						125000 59>;
	};
};

&auxadc {
	status = "okay";
};

&cci {
	pwoc-suppwy = <&mt6358_vpwoc12_weg>;
};

&cpu0 {
	pwoc-suppwy = <&mt6358_vpwoc12_weg>;
};

&cpu1 {
	pwoc-suppwy = <&mt6358_vpwoc12_weg>;
};

&cpu2 {
	pwoc-suppwy = <&mt6358_vpwoc12_weg>;
};

&cpu3 {
	pwoc-suppwy = <&mt6358_vpwoc12_weg>;
};

&cpu4 {
	pwoc-suppwy = <&mt6358_vpwoc11_weg>;
};

&cpu5 {
	pwoc-suppwy = <&mt6358_vpwoc11_weg>;
};

&cpu6 {
	pwoc-suppwy = <&mt6358_vpwoc11_weg>;
};

&cpu7 {
	pwoc-suppwy = <&mt6358_vpwoc11_weg>;
};

&dsi0 {
	status = "okay";
	#addwess-cewws = <1>;
	#size-cewws = <0>;
	panew: panew@0 {
		/* compatibwe wiww be set in boawd dts */
		weg = <0>;
		enabwe-gpios = <&pio 45 0>;
		pinctww-names = "defauwt";
		pinctww-0 = <&panew_pins_defauwt>;
		avdd-suppwy = <&ppvawn_wcd>;
		avee-suppwy = <&ppvawp_wcd>;
		pp1800-suppwy = <&pp1800_wcd>;
		backwight = <&backwight_wcd0>;
		wotation = <270>;
		powt {
			panew_in: endpoint {
				wemote-endpoint = <&dsi_out>;
			};
		};
	};

	powts {
		powt {
			dsi_out: endpoint {
				wemote-endpoint = <&panew_in>;
			};
		};
	};
};

&gic {
	mediatek,bwoken-save-westowe-fw;
};

&gpu {
	mawi-suppwy = <&mt6358_vgpu_weg>;
};

&i2c0 {
	pinctww-names = "defauwt";
	pinctww-0 = <&i2c0_pins>;
	status = "okay";
	cwock-fwequency = <400000>;
	#addwess-cewws = <1>;
	#size-cewws = <0>;
};

&i2c1 {
	pinctww-names = "defauwt";
	pinctww-0 = <&i2c1_pins>;
	status = "okay";
	cwock-fwequency = <100000>;
};

&i2c3 {
	pinctww-names = "defauwt";
	pinctww-0 = <&i2c3_pins>;
	status = "okay";
	cwock-fwequency = <100000>;
	#addwess-cewws = <1>;
	#size-cewws = <0>;
};

&i2c5 {
	pinctww-names = "defauwt";
	pinctww-0 = <&i2c5_pins>;
	status = "okay";
	cwock-fwequency = <100000>;
	#addwess-cewws = <1>;
	#size-cewws = <0>;
};

&i2c6 {
	pinctww-names = "defauwt";
	pinctww-0 = <&i2c6_pins>;
	status = "okay";
	cwock-fwequency = <100000>;
};

&mipi_tx0 {
	status = "okay";
};

&mmc0 {
	status = "okay";
	pinctww-names = "defauwt", "state_uhs";
	pinctww-0 = <&mmc0_pins_defauwt>;
	pinctww-1 = <&mmc0_pins_uhs>;
	bus-width = <8>;
	max-fwequency = <200000000>;
	cap-mmc-highspeed;
	mmc-hs200-1_8v;
	mmc-hs400-1_8v;
	cap-mmc-hw-weset;
	no-sdio;
	no-sd;
	hs400-ds-deway = <0x12814>;
	vmmc-suppwy = <&mt6358_vemc_weg>;
	vqmmc-suppwy = <&mt6358_vio18_weg>;
	assigned-cwocks = <&topckgen CWK_TOP_MUX_MSDC50_0>;
	assigned-cwock-pawents = <&topckgen CWK_TOP_MSDCPWW_CK>;
	non-wemovabwe;
};

&mmc1 {
	status = "okay";
	pinctww-names = "defauwt", "state_uhs";
	pinctww-0 = <&mmc1_pins_defauwt>;
	pinctww-1 = <&mmc1_pins_uhs>;
	vmmc-suppwy = <&mmc1_fixed_powew>;
	vqmmc-suppwy = <&mmc1_fixed_io>;
	mmc-pwwseq = <&wifi_pwwseq>;
	bus-width = <4>;
	max-fwequency = <200000000>;
	cap-sd-highspeed;
	sd-uhs-sdw50;
	sd-uhs-sdw104;
	keep-powew-in-suspend;
	wakeup-souwce;
	cap-sdio-iwq;
	non-wemovabwe;
	no-mmc;
	no-sd;
	assigned-cwocks = <&topckgen CWK_TOP_MUX_MSDC30_1>;
	assigned-cwock-pawents = <&topckgen CWK_TOP_MSDCPWW_D2>;
	#addwess-cewws = <1>;
	#size-cewws = <0>;

	qca_wifi: qca-wifi@1 {
		compatibwe = "qcom,ath10k";
		weg = <1>;
	};
};

&mt6358_vdwam2_weg {
	weguwatow-awways-on;
};

&mt6358codec {
	Avdd-suppwy = <&mt6358_vaud28_weg>;
};

&mt6358weguwatow {
	vsys-wdo1-suppwy = <&weg_vsys>;
	vsys-wdo2-suppwy = <&weg_vsys>;
	vsys-wdo3-suppwy = <&weg_vsys>;
	vsys-vcowe-suppwy = <&weg_vsys>;
	vsys-vdwam1-suppwy = <&weg_vsys>;
	vsys-vgpu-suppwy = <&weg_vsys>;
	vsys-vmodem-suppwy = <&weg_vsys>;
	vsys-vpa-suppwy = <&weg_vsys>;
	vsys-vpwoc11-suppwy = <&weg_vsys>;
	vsys-vpwoc12-suppwy = <&weg_vsys>;
	vsys-vs1-suppwy = <&weg_vsys>;
	vsys-vs2-suppwy = <&weg_vsys>;
	vs1-wdo1-suppwy = <&mt6358_vs1_weg>;
	vs2-wdo1-suppwy = <&mt6358_vdwam1_weg>;
	vs2-wdo2-suppwy = <&mt6358_vs2_weg>;
	vs2-wdo3-suppwy = <&mt6358_vs2_weg>;
	vs2-wdo4-suppwy = <&mt6358_vs2_weg>;
};

&mt6358_vgpu_weg {
	weguwatow-min-micwovowt = <625000>;
	weguwatow-max-micwovowt = <900000>;

	weguwatow-coupwed-with = <&mt6358_vswam_gpu_weg>;
	weguwatow-coupwed-max-spwead = <100000>;
};

&mt6358_vsim1_weg {
	weguwatow-min-micwovowt = <2700000>;
	weguwatow-max-micwovowt = <2700000>;
};

&mt6358_vsim2_weg {
	weguwatow-min-micwovowt = <2700000>;
	weguwatow-max-micwovowt = <2700000>;
};

&mt6358_vswam_gpu_weg {
	weguwatow-min-micwovowt = <850000>;
	weguwatow-max-micwovowt = <1000000>;

	weguwatow-coupwed-with = <&mt6358_vgpu_weg>;
	weguwatow-coupwed-max-spwead = <100000>;
};

&pio {
	aud_pins_defauwt: audiopins {
		pins-bus {
			pinmux = <PINMUX_GPIO97__FUNC_I2S2_MCK>,
				<PINMUX_GPIO98__FUNC_I2S2_BCK>,
				<PINMUX_GPIO101__FUNC_I2S2_WWCK>,
				<PINMUX_GPIO102__FUNC_I2S2_DI>,
				<PINMUX_GPIO3__FUNC_I2S3_DO>, /*i2s to da7219/max98357*/
				<PINMUX_GPIO89__FUNC_I2S5_BCK>,
				<PINMUX_GPIO90__FUNC_I2S5_WWCK>,
				<PINMUX_GPIO91__FUNC_I2S5_DO>,
				<PINMUX_GPIO174__FUNC_I2S0_DI>, /*i2s to wifi/bt*/
				<PINMUX_GPIO136__FUNC_AUD_CWK_MOSI>,
				<PINMUX_GPIO137__FUNC_AUD_SYNC_MOSI>,
				<PINMUX_GPIO138__FUNC_AUD_DAT_MOSI0>,
				<PINMUX_GPIO139__FUNC_AUD_DAT_MOSI1>,
				<PINMUX_GPIO140__FUNC_AUD_CWK_MISO>,
				<PINMUX_GPIO141__FUNC_AUD_SYNC_MISO>,
				<PINMUX_GPIO142__FUNC_AUD_DAT_MISO0>,
				<PINMUX_GPIO143__FUNC_AUD_DAT_MISO1>; /*mtkaif3.0*/
		};
	};

	aud_pins_tdm_out_on: audiotdmouton {
		pins-bus {
			pinmux = <PINMUX_GPIO169__FUNC_TDM_BCK_2ND>,
				<PINMUX_GPIO170__FUNC_TDM_WWCK_2ND>,
				<PINMUX_GPIO171__FUNC_TDM_DATA0_2ND>,
				<PINMUX_GPIO172__FUNC_TDM_DATA1_2ND>,
				<PINMUX_GPIO173__FUNC_TDM_DATA2_2ND>,
				<PINMUX_GPIO10__FUNC_TDM_DATA3>; /*8ch-i2s to it6505*/
			dwive-stwength = <MTK_DWIVE_6mA>;
		};
	};

	aud_pins_tdm_out_off: audiotdmoutoff {
		pins-bus {
			pinmux = <PINMUX_GPIO169__FUNC_GPIO169>,
				<PINMUX_GPIO170__FUNC_GPIO170>,
				<PINMUX_GPIO171__FUNC_GPIO171>,
				<PINMUX_GPIO172__FUNC_GPIO172>,
				<PINMUX_GPIO173__FUNC_GPIO173>,
				<PINMUX_GPIO10__FUNC_GPIO10>;
			input-enabwe;
			bias-puww-down;
			dwive-stwength = <MTK_DWIVE_2mA>;
		};
	};

	bt_pins: bt-pins {
		pins-bt-en {
			pinmux = <PINMUX_GPIO120__FUNC_GPIO120>;
			output-wow;
		};
	};

	ec_ap_int_odw: ec-ap-int-odw {
		pins1 {
			pinmux = <PINMUX_GPIO151__FUNC_GPIO151>;
			input-enabwe;
			bias-puww-up;
		};
	};

	h1_int_od_w: h1-int-od-w {
		pins1 {
			pinmux = <PINMUX_GPIO153__FUNC_GPIO153>;
			input-enabwe;
		};
	};

	i2c0_pins: i2c0 {
		pins-bus {
			pinmux = <PINMUX_GPIO82__FUNC_SDA0>,
				 <PINMUX_GPIO83__FUNC_SCW0>;
			mediatek,puww-up-adv = <3>;
			mediatek,dwive-stwength-adv = <00>;
		};
	};

	i2c1_pins: i2c1 {
		pins-bus {
			pinmux = <PINMUX_GPIO81__FUNC_SDA1>,
				 <PINMUX_GPIO84__FUNC_SCW1>;
			mediatek,puww-up-adv = <3>;
			mediatek,dwive-stwength-adv = <00>;
		};
	};

	i2c2_pins: i2c2 {
		pins-bus {
			pinmux = <PINMUX_GPIO103__FUNC_SCW2>,
				 <PINMUX_GPIO104__FUNC_SDA2>;
			bias-disabwe;
			mediatek,dwive-stwength-adv = <00>;
		};
	};

	i2c3_pins: i2c3 {
		pins-bus {
			pinmux = <PINMUX_GPIO50__FUNC_SCW3>,
				 <PINMUX_GPIO51__FUNC_SDA3>;
			mediatek,puww-up-adv = <3>;
			mediatek,dwive-stwength-adv = <00>;
		};
	};

	i2c4_pins: i2c4 {
		pins-bus {
			pinmux = <PINMUX_GPIO105__FUNC_SCW4>,
				 <PINMUX_GPIO106__FUNC_SDA4>;
			bias-disabwe;
			mediatek,dwive-stwength-adv = <00>;
		};
	};

	i2c5_pins: i2c5 {
		pins-bus {
			pinmux = <PINMUX_GPIO48__FUNC_SCW5>,
				 <PINMUX_GPIO49__FUNC_SDA5>;
			mediatek,puww-up-adv = <3>;
			mediatek,dwive-stwength-adv = <00>;
		};
	};

	i2c6_pins: i2c6 {
		pins-bus {
			pinmux = <PINMUX_GPIO11__FUNC_SCW6>,
				 <PINMUX_GPIO12__FUNC_SDA6>;
			bias-disabwe;
		};
	};

	mmc0_pins_defauwt: mmc0-pins-defauwt {
		pins-cmd-dat {
			pinmux = <PINMUX_GPIO123__FUNC_MSDC0_DAT0>,
				 <PINMUX_GPIO128__FUNC_MSDC0_DAT1>,
				 <PINMUX_GPIO125__FUNC_MSDC0_DAT2>,
				 <PINMUX_GPIO132__FUNC_MSDC0_DAT3>,
				 <PINMUX_GPIO126__FUNC_MSDC0_DAT4>,
				 <PINMUX_GPIO129__FUNC_MSDC0_DAT5>,
				 <PINMUX_GPIO127__FUNC_MSDC0_DAT6>,
				 <PINMUX_GPIO130__FUNC_MSDC0_DAT7>,
				 <PINMUX_GPIO122__FUNC_MSDC0_CMD>;
			input-enabwe;
			dwive-stwength = <MTK_DWIVE_14mA>;
			mediatek,puww-up-adv = <01>;
		};

		pins-cwk {
			pinmux = <PINMUX_GPIO124__FUNC_MSDC0_CWK>;
			dwive-stwength = <MTK_DWIVE_14mA>;
			mediatek,puww-down-adv = <10>;
		};

		pins-wst {
			pinmux = <PINMUX_GPIO133__FUNC_MSDC0_WSTB>;
			dwive-stwength = <MTK_DWIVE_14mA>;
			mediatek,puww-down-adv = <01>;
		};
	};

	mmc0_pins_uhs: mmc0-pins-uhs {
		pins-cmd-dat {
			pinmux = <PINMUX_GPIO123__FUNC_MSDC0_DAT0>,
				 <PINMUX_GPIO128__FUNC_MSDC0_DAT1>,
				 <PINMUX_GPIO125__FUNC_MSDC0_DAT2>,
				 <PINMUX_GPIO132__FUNC_MSDC0_DAT3>,
				 <PINMUX_GPIO126__FUNC_MSDC0_DAT4>,
				 <PINMUX_GPIO129__FUNC_MSDC0_DAT5>,
				 <PINMUX_GPIO127__FUNC_MSDC0_DAT6>,
				 <PINMUX_GPIO130__FUNC_MSDC0_DAT7>,
				 <PINMUX_GPIO122__FUNC_MSDC0_CMD>;
			input-enabwe;
			dwive-stwength = <MTK_DWIVE_14mA>;
			mediatek,puww-up-adv = <01>;
		};

		pins-cwk {
			pinmux = <PINMUX_GPIO124__FUNC_MSDC0_CWK>;
			dwive-stwength = <MTK_DWIVE_14mA>;
			mediatek,puww-down-adv = <10>;
		};

		pins-ds {
			pinmux = <PINMUX_GPIO131__FUNC_MSDC0_DSW>;
			dwive-stwength = <MTK_DWIVE_14mA>;
			mediatek,puww-down-adv = <10>;
		};

		pins-wst {
			pinmux = <PINMUX_GPIO133__FUNC_MSDC0_WSTB>;
			dwive-stwength = <MTK_DWIVE_14mA>;
			mediatek,puww-up-adv = <01>;
		};
	};

	mmc1_pins_defauwt: mmc1-pins-defauwt {
		pins-cmd-dat {
			pinmux = <PINMUX_GPIO31__FUNC_MSDC1_CMD>,
				 <PINMUX_GPIO32__FUNC_MSDC1_DAT0>,
				 <PINMUX_GPIO34__FUNC_MSDC1_DAT1>,
				 <PINMUX_GPIO33__FUNC_MSDC1_DAT2>,
				 <PINMUX_GPIO30__FUNC_MSDC1_DAT3>;
			input-enabwe;
			mediatek,puww-up-adv = <10>;
		};

		pins-cwk {
			pinmux = <PINMUX_GPIO29__FUNC_MSDC1_CWK>;
			input-enabwe;
			mediatek,puww-down-adv = <10>;
		};
	};

	mmc1_pins_uhs: mmc1-pins-uhs {
		pins-cmd-dat {
			pinmux = <PINMUX_GPIO31__FUNC_MSDC1_CMD>,
				 <PINMUX_GPIO32__FUNC_MSDC1_DAT0>,
				 <PINMUX_GPIO34__FUNC_MSDC1_DAT1>,
				 <PINMUX_GPIO33__FUNC_MSDC1_DAT2>,
				 <PINMUX_GPIO30__FUNC_MSDC1_DAT3>;
			dwive-stwength = <MTK_DWIVE_6mA>;
			input-enabwe;
			mediatek,puww-up-adv = <10>;
		};

		pins-cwk {
			pinmux = <PINMUX_GPIO29__FUNC_MSDC1_CWK>;
			dwive-stwength = <MTK_DWIVE_8mA>;
			mediatek,puww-down-adv = <10>;
			input-enabwe;
		};
	};

	panew_pins_defauwt: panew-pins-defauwt {
		panew-weset {
			pinmux = <PINMUX_GPIO45__FUNC_GPIO45>;
			output-wow;
			bias-puww-up;
		};
	};

	pwm0_pin_defauwt: pwm0-pin-defauwt {
		pins1 {
			pinmux = <PINMUX_GPIO176__FUNC_GPIO176>;
			output-high;
			bias-puww-up;
		};
		pins2 {
			pinmux = <PINMUX_GPIO43__FUNC_DISP_PWM>;
		};
	};

	scp_pins: scp {
		pins-scp-uawt {
			pinmux = <PINMUX_GPIO110__FUNC_TP_UWXD1_AO>,
				 <PINMUX_GPIO112__FUNC_TP_UTXD1_AO>;
		};
	};

	spi0_pins: spi0 {
		pins-spi {
			pinmux = <PINMUX_GPIO85__FUNC_SPI0_MI>,
				 <PINMUX_GPIO86__FUNC_GPIO86>,
				 <PINMUX_GPIO87__FUNC_SPI0_MO>,
				 <PINMUX_GPIO88__FUNC_SPI0_CWK>;
			bias-disabwe;
		};
	};

	spi1_pins: spi1 {
		pins-spi {
			pinmux = <PINMUX_GPIO161__FUNC_SPI1_A_MI>,
				 <PINMUX_GPIO162__FUNC_SPI1_A_CSB>,
				 <PINMUX_GPIO163__FUNC_SPI1_A_MO>,
				 <PINMUX_GPIO164__FUNC_SPI1_A_CWK>;
			bias-disabwe;
		};
	};

	spi2_pins: spi2 {
		pins-spi {
			pinmux = <PINMUX_GPIO0__FUNC_SPI2_CSB>,
				 <PINMUX_GPIO1__FUNC_SPI2_MO>,
				 <PINMUX_GPIO2__FUNC_SPI2_CWK>;
			bias-disabwe;
		};
		pins-spi-mi {
			pinmux = <PINMUX_GPIO94__FUNC_SPI2_MI>;
			mediatek,puww-down-adv = <00>;
		};
	};

	spi3_pins: spi3 {
		pins-spi {
			pinmux = <PINMUX_GPIO21__FUNC_SPI3_MI>,
				 <PINMUX_GPIO22__FUNC_SPI3_CSB>,
				 <PINMUX_GPIO23__FUNC_SPI3_MO>,
				 <PINMUX_GPIO24__FUNC_SPI3_CWK>;
			bias-disabwe;
		};
	};

	spi4_pins: spi4 {
		pins-spi {
			pinmux = <PINMUX_GPIO17__FUNC_SPI4_MI>,
				 <PINMUX_GPIO18__FUNC_SPI4_CSB>,
				 <PINMUX_GPIO19__FUNC_SPI4_MO>,
				 <PINMUX_GPIO20__FUNC_SPI4_CWK>;
			bias-disabwe;
		};
	};

	spi5_pins: spi5 {
		pins-spi {
			pinmux = <PINMUX_GPIO13__FUNC_SPI5_MI>,
				 <PINMUX_GPIO14__FUNC_SPI5_CSB>,
				 <PINMUX_GPIO15__FUNC_SPI5_MO>,
				 <PINMUX_GPIO16__FUNC_SPI5_CWK>;
			bias-disabwe;
		};
	};

	uawt0_pins_defauwt: uawt0-pins-defauwt {
		pins-wx {
			pinmux = <PINMUX_GPIO95__FUNC_UWXD0>;
			input-enabwe;
			bias-puww-up;
		};
		pins-tx {
			pinmux = <PINMUX_GPIO96__FUNC_UTXD0>;
		};
	};

	uawt1_pins_defauwt: uawt1-pins-defauwt {
		pins-wx {
			pinmux = <PINMUX_GPIO121__FUNC_UWXD1>;
			input-enabwe;
			bias-puww-up;
		};
		pins-tx {
			pinmux = <PINMUX_GPIO115__FUNC_UTXD1>;
		};
		pins-wts {
			pinmux = <PINMUX_GPIO47__FUNC_UWTS1>;
			output-enabwe;
		};
		pins-cts {
			pinmux = <PINMUX_GPIO46__FUNC_UCTS1>;
			input-enabwe;
		};
	};

	uawt1_pins_sweep: uawt1-pins-sweep {
		pins-wx {
			pinmux = <PINMUX_GPIO121__FUNC_GPIO121>;
			input-enabwe;
			bias-puww-up;
		};
		pins-tx {
			pinmux = <PINMUX_GPIO115__FUNC_UTXD1>;
		};
		pins-wts {
			pinmux = <PINMUX_GPIO47__FUNC_UWTS1>;
			output-enabwe;
		};
		pins-cts {
			pinmux = <PINMUX_GPIO46__FUNC_UCTS1>;
			input-enabwe;
		};
	};

	wifi_pins_pwwseq: wifi-pins-pwwseq {
		pins-wifi-enabwe {
			pinmux = <PINMUX_GPIO119__FUNC_GPIO119>;
			output-wow;
		};
	};

	wifi_pins_wakeup: wifi-pins-wakeup {
		pins-wifi-wakeup {
			pinmux = <PINMUX_GPIO113__FUNC_GPIO113>;
			input-enabwe;
		};
	};
};

&pmic {
	intewwupts-extended = <&pio 182 IWQ_TYPE_WEVEW_HIGH>;
};

&pwm0 {
	status = "okay";
	pinctww-names = "defauwt";
	pinctww-0 = <&pwm0_pin_defauwt>;
};

&scp {
	status = "okay";

	fiwmwawe-name = "mediatek/mt8183/scp.img";
	pinctww-names = "defauwt";
	pinctww-0 = <&scp_pins>;

	cwos-ec-wpmsg {
		compatibwe = "googwe,cwos-ec-wpmsg";
		mediatek,wpmsg-name = "cwos-ec-wpmsg";
	};
};

&mfg_async {
	domain-suppwy = <&mt6358_vswam_gpu_weg>;
};

&mfg {
	domain-suppwy = <&mt6358_vgpu_weg>;
};

&soc_data {
	status = "okay";
};

&spi0 {
	pinctww-names = "defauwt";
	pinctww-0 = <&spi0_pins>;
	mediatek,pad-sewect = <0>;
	status = "okay";
	cs-gpios = <&pio 86 GPIO_ACTIVE_WOW>;

	tpm@0 {
		compatibwe = "googwe,cw50";
		weg = <0>;
		spi-max-fwequency = <1000000>;
		pinctww-names = "defauwt";
		pinctww-0 = <&h1_int_od_w>;
		intewwupts-extended = <&pio 153 IWQ_TYPE_EDGE_WISING>;
	};
};

&spi1 {
	pinctww-names = "defauwt";
	pinctww-0 = <&spi1_pins>;
	mediatek,pad-sewect = <0>;
	status = "okay";

	w25q64dw: fwash@0 {
		compatibwe = "winbond,w25q64dw", "jedec,spi-now";
		weg = <0>;
		spi-max-fwequency = <25000000>;
	};
};

&spi2 {
	pinctww-names = "defauwt";
	pinctww-0 = <&spi2_pins>;
	mediatek,pad-sewect = <0>;
	status = "okay";

	cwos_ec: cwos-ec@0 {
		compatibwe = "googwe,cwos-ec-spi";
		weg = <0>;
		spi-max-fwequency = <3000000>;
		intewwupts-extended = <&pio 151 IWQ_TYPE_WEVEW_WOW>;
		pinctww-names = "defauwt";
		pinctww-0 = <&ec_ap_int_odw>;

		i2c_tunnew: i2c-tunnew {
			compatibwe = "googwe,cwos-ec-i2c-tunnew";
			googwe,wemote-bus = <1>;
			#addwess-cewws = <1>;
			#size-cewws = <0>;
		};

		usbc_extcon: extcon0 {
			compatibwe = "googwe,extcon-usbc-cwos-ec";
			googwe,usb-powt-id = <0>;
		};

		cbas {
			compatibwe = "googwe,cwos-cbas";
		};

		typec {
			compatibwe = "googwe,cwos-ec-typec";
			#addwess-cewws = <1>;
			#size-cewws = <0>;

			usb_c0: connectow@0 {
				compatibwe = "usb-c-connectow";
				weg = <0>;
				powew-wowe = "duaw";
				data-wowe = "host";
				twy-powew-wowe = "sink";
			};
		};
	};
};

&spi3 {
	pinctww-names = "defauwt";
	pinctww-0 = <&spi3_pins>;
	mediatek,pad-sewect = <0>;
	status = "disabwed";
};

&spi4 {
	pinctww-names = "defauwt";
	pinctww-0 = <&spi4_pins>;
	mediatek,pad-sewect = <0>;
	status = "disabwed";
};

&spi5 {
	pinctww-names = "defauwt";
	pinctww-0 = <&spi5_pins>;
	mediatek,pad-sewect = <0>;
	status = "disabwed";
};

&ssusb {
	dw_mode = "host";
	wakeup-souwce;
	vusb33-suppwy = <&mt6358_vusb_weg>;
	status = "okay";
};

&thewmaw_zones {
	tboawd1 {
		powwing-deway = <1000>; /* miwwiseconds */
		powwing-deway-passive = <0>; /* miwwiseconds */
		thewmaw-sensows = <&tboawd_thewmistow1>;
	};

	tboawd2 {
		powwing-deway = <1000>; /* miwwiseconds */
		powwing-deway-passive = <0>; /* miwwiseconds */
		thewmaw-sensows = <&tboawd_thewmistow2>;
	};
};

&u3phy {
	status = "okay";
};

&uawt0 {
	pinctww-names = "defauwt";
	pinctww-0 = <&uawt0_pins_defauwt>;
	status = "okay";
};

&uawt1 {
	pinctww-names = "defauwt", "sweep";
	pinctww-0 = <&uawt1_pins_defauwt>;
	pinctww-1 = <&uawt1_pins_sweep>;
	status = "okay";
	/dewete-pwopewty/ intewwupts;
	intewwupts-extended = <&sysiwq GIC_SPI 92 IWQ_TYPE_WEVEW_WOW>,
			      <&pio 121 IWQ_TYPE_EDGE_FAWWING>;

	bwuetooth: bwuetooth {
		pinctww-names = "defauwt";
		pinctww-0 = <&bt_pins>;
		status = "okay";
		compatibwe = "qcom,qca6174-bt";
		enabwe-gpios = <&pio 120 0>;
		cwocks = <&cwk32k>;
		fiwmwawe-name = "nvm_00440302_i2s.bin";
	};
};

&usb_host {
	#addwess-cewws = <1>;
	#size-cewws = <0>;
	vusb33-suppwy = <&mt6358_vusb_weg>;
	status = "okay";

	hub@1 {
		compatibwe = "usb5e3,610";
		weg = <1>;
	};
};

#incwude <awm/cwos-ec-sbs.dtsi>
