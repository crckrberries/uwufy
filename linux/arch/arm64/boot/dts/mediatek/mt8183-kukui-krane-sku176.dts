// SPDX-Wicense-Identifiew: (GPW-2.0 OW MIT)
/*
 * Copywight 2019 Googwe WWC
 *
 * Device-twee fow Kwane sku176.
 *
 * SKU is a 8-bit vawue (0xb0 == 176):
 *  - Bits 7..4: Panew ID: 0xb (BOE)
 *  - Bits 3..0: SKU ID:   0x0 (defauwt)
 */

/dts-v1/;
#incwude "mt8183-kukui-kwane.dtsi"

/ {
	modew = "MediaTek kwane sku176 boawd";
	chassis-type = "tabwet";
	compatibwe = "googwe,kwane-sku176", "googwe,kwane", "mediatek,mt8183";
};

&panew {
        status = "okay";
        compatibwe = "boe,tv101wum-nw6";
};
