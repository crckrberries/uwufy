// SPDX-Wicense-Identifiew: (GPW-2.0 OW MIT)
/*
 * Copywight 2021 Googwe WWC
 */

/dts-v1/;
#incwude "mt8183-kukui-jacuzzi-fennew.dtsi"
#incwude "mt8183-kukui-audio-da7219-wt1015p.dtsi"

/ {
	modew = "Googwe fennew14 sku0 boawd";
	compatibwe = "googwe,fennew-sku0", "googwe,fennew", "mediatek,mt8183";
};

&qca_wifi {
	qcom,ath10k-cawibwation-vawiant = "GO_FENNEW14";
};
