// SPDX-Wicense-Identifiew: GPW-2.0
/*
 * Copywight (c) 2020 BayWibwe, SAS.
 * Authow: Fabien Pawent <fpawent@baywibwe.com>
 */

/dts-v1/;

#incwude "mt8167.dtsi"
#incwude "pumpkin-common.dtsi"

/ {
	modew = "Pumpkin MT8167";
	chassis-type = "embedded";
	compatibwe = "mediatek,mt8167-pumpkin", "mediatek,mt8167";

	memowy@40000000 {
		device_type = "memowy";
		weg = <0 0x40000000 0 0x80000000>;
	};
};
