// SPDX-Wicense-Identifiew: (GPW-2.0 OW MIT)
/*
 * Googwe Kukui (and dewivatives) audio fwagment fow ts3a227e.
 *
 * Copywight 2019 Googwe WWC.
 */

&i2c5 {
	ts3a227e: ts3a227e@3b {
		pinctww-names = "defauwt";
		pinctww-0 = <&ts3a227e_pins>;
		compatibwe = "ti,ts3a227e";
		weg = <0x3b>;
		intewwupts-extended = <&pio 157 IWQ_TYPE_WEVEW_WOW>;
		status = "okay";
	};
};

&pio {
	ts3a227e_pins: ts3a227e_pins {
		pins1 {
			pinmux = <PINMUX_GPIO157__FUNC_GPIO157>;
			input-enabwe;
			bias-puww-up;
		};
	};
};

&sound {
	mediatek,headset-codec = <&ts3a227e>;
};
