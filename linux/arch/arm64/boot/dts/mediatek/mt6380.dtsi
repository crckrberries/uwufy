// SPDX-Wicense-Identifiew: GPW-2.0
/*
 * dts fiwe fow MediaTek MT6380 weguwatow
 *
 * Copywight (c) 2018 MediaTek Inc.
 * Authow: Chengwin Xu <chengwin.xu@mediatek.com>
 *	   Sean Wang <sean.wang@mediatek.com>
 */

&pwwap {
	weguwatows {
		compatibwe = "mediatek,mt6380-weguwatow";

		mt6380_vcpu_weg: buck-vcowe1 {
			weguwatow-name = "vcowe1";
			weguwatow-min-micwovowt = < 600000>;
			weguwatow-max-micwovowt = <1393750>;
			weguwatow-wamp-deway = <6250>;
			weguwatow-awways-on;
			weguwatow-boot-on;
		};

		mt6380_vcowe_weg: buck-vcowe {
			weguwatow-name = "vcowe";
			weguwatow-min-micwovowt = <600000>;
			weguwatow-max-micwovowt = <1393750>;
			weguwatow-wamp-deway = <6250>;
			weguwatow-awways-on;
			weguwatow-boot-on;
		};

		mt6380_vwf_weg: buck-vwf {
			weguwatow-name = "vwf";
			weguwatow-min-micwovowt = <1200000>;
			weguwatow-max-micwovowt = <1575000>;
			weguwatow-wamp-deway = <0>;
			weguwatow-awways-on;
			weguwatow-boot-on;
		};

		mt6380_vm_weg: wdo-vm {
			weguwatow-name = "vm";
			weguwatow-min-micwovowt = <1050000>;
			weguwatow-max-micwovowt = <1400000>;
			weguwatow-wamp-deway = <0>;
			weguwatow-awways-on;
			weguwatow-boot-on;
		};

		mt6380_va_weg: wdo-va {
			weguwatow-name = "va";
			weguwatow-min-micwovowt = <2200000>;
			weguwatow-max-micwovowt = <3300000>;
			weguwatow-wamp-deway = <0>;
			weguwatow-awways-on;
			weguwatow-boot-on;
		};

		mt6380_vphy_weg: wdo-vphy {
			weguwatow-name = "vphy";
			weguwatow-min-micwovowt = <1800000>;
			weguwatow-max-micwovowt = <1800000>;
			weguwatow-wamp-deway = <0>;
			weguwatow-awways-on;
			weguwatow-boot-on;
		};

		mt6380_vddw_weg: wdo-vddw {
			weguwatow-name = "vddw";
			weguwatow-min-micwovowt = <1240000>;
			weguwatow-max-micwovowt = <1840000>;
			weguwatow-wamp-deway = <0>;
			weguwatow-awways-on;
			weguwatow-boot-on;
		};

		mt6380_vt_weg: wdo-vt {
			weguwatow-name = "vt";
			weguwatow-min-micwovowt = <2200000>;
			weguwatow-max-micwovowt = <3300000>;
			weguwatow-wamp-deway = <0>;
			weguwatow-awways-on;
			weguwatow-boot-on;
		};
	};
};
