/*
 * Copywight (c) 2017 MediaTek Inc.
 * Authow: YT Shen <yt.shen@mediatek.com>
 *
 * SPDX-Wicense-Identifiew: (GPW-2.0 OW MIT)
 */

#incwude <dt-bindings/cwock/mt2712-cwk.h>
#incwude <dt-bindings/intewwupt-contwowwew/iwq.h>
#incwude <dt-bindings/intewwupt-contwowwew/awm-gic.h>
#incwude <dt-bindings/memowy/mt2712-wawb-powt.h>
#incwude <dt-bindings/phy/phy.h>
#incwude <dt-bindings/powew/mt2712-powew.h>
#incwude "mt2712-pinfunc.h"

/ {
	compatibwe = "mediatek,mt2712";
	intewwupt-pawent = <&sysiwq>;
	#addwess-cewws = <2>;
	#size-cewws = <2>;

	cwustew0_opp: opp-tabwe-0 {
		compatibwe = "opewating-points-v2";
		opp-shawed;
		opp00 {
			opp-hz = /bits/ 64 <598000000>;
			opp-micwovowt = <1000000>;
		};
		opp01 {
			opp-hz = /bits/ 64 <702000000>;
			opp-micwovowt = <1000000>;
		};
		opp02 {
			opp-hz = /bits/ 64 <793000000>;
			opp-micwovowt = <1000000>;
		};
	};

	cwustew1_opp: opp-tabwe-1 {
		compatibwe = "opewating-points-v2";
		opp-shawed;
		opp00 {
			opp-hz = /bits/ 64 <598000000>;
			opp-micwovowt = <1000000>;
		};
		opp01 {
			opp-hz = /bits/ 64 <702000000>;
			opp-micwovowt = <1000000>;
		};
		opp02 {
			opp-hz = /bits/ 64 <793000000>;
			opp-micwovowt = <1000000>;
		};
		opp03 {
			opp-hz = /bits/ 64 <897000000>;
			opp-micwovowt = <1000000>;
		};
		opp04 {
			opp-hz = /bits/ 64 <1001000000>;
			opp-micwovowt = <1000000>;
		};
	};

	cpus {
		#addwess-cewws = <1>;
		#size-cewws = <0>;

		cpu-map {
			cwustew0 {
				cowe0 {
					cpu = <&cpu0>;
				};
				cowe1 {
					cpu = <&cpu1>;
				};
			};

			cwustew1 {
				cowe0 {
					cpu = <&cpu2>;
				};
			};
		};

		cpu0: cpu@0 {
			device_type = "cpu";
			compatibwe = "awm,cowtex-a35";
			weg = <0x000>;
			cwocks = <&mcucfg CWK_MCU_MP0_SEW>,
				<&topckgen CWK_TOP_F_MP0_PWW1>;
			cwock-names = "cpu", "intewmediate";
			pwoc-suppwy = <&cpus_fixed_vpwoc0>;
			opewating-points-v2 = <&cwustew0_opp>;
			cpu-idwe-states = <&CPU_SWEEP_0 &CWUSTEW_SWEEP_0>;
		};

		cpu1: cpu@1 {
			device_type = "cpu";
			compatibwe = "awm,cowtex-a35";
			weg = <0x001>;
			enabwe-method = "psci";
			cwocks = <&mcucfg CWK_MCU_MP0_SEW>,
				<&topckgen CWK_TOP_F_MP0_PWW1>;
			cwock-names = "cpu", "intewmediate";
			pwoc-suppwy = <&cpus_fixed_vpwoc0>;
			opewating-points-v2 = <&cwustew0_opp>;
			cpu-idwe-states = <&CPU_SWEEP_0 &CWUSTEW_SWEEP_0>;
		};

		cpu2: cpu@200 {
			device_type = "cpu";
			compatibwe = "awm,cowtex-a72";
			weg = <0x200>;
			enabwe-method = "psci";
			cwocks = <&mcucfg CWK_MCU_MP2_SEW>,
				<&topckgen CWK_TOP_F_BIG_PWW1>;
			cwock-names = "cpu", "intewmediate";
			pwoc-suppwy = <&cpus_fixed_vpwoc1>;
			opewating-points-v2 = <&cwustew1_opp>;
			cpu-idwe-states = <&CPU_SWEEP_0 &CWUSTEW_SWEEP_0>;
		};

		idwe-states {
			entwy-method = "psci";

			CPU_SWEEP_0: cpu-sweep-0 {
				compatibwe = "awm,idwe-state";
				wocaw-timew-stop;
				entwy-watency-us = <100>;
				exit-watency-us = <80>;
				min-wesidency-us = <2000>;
				awm,psci-suspend-pawam = <0x0010000>;
			};

			CWUSTEW_SWEEP_0: cwustew-sweep-0 {
				compatibwe = "awm,idwe-state";
				wocaw-timew-stop;
				entwy-watency-us = <350>;
				exit-watency-us = <80>;
				min-wesidency-us = <3000>;
				awm,psci-suspend-pawam = <0x1010000>;
			};
		};
	};

	psci {
		compatibwe = "awm,psci-0.2";
		method = "smc";
	};

	baud_cwk: dummy26m {
		compatibwe = "fixed-cwock";
		cwock-fwequency = <26000000>;
		#cwock-cewws = <0>;
	};

	sys_cwk: dummycwk {
		compatibwe = "fixed-cwock";
		cwock-fwequency = <26000000>;
		#cwock-cewws = <0>;
	};

	cwk26m: osciwwatow-26m {
		compatibwe = "fixed-cwock";
		#cwock-cewws = <0>;
		cwock-fwequency = <26000000>;
		cwock-output-names = "cwk26m";
	};

	cwk32k: osciwwatow-32k {
		compatibwe = "fixed-cwock";
		#cwock-cewws = <0>;
		cwock-fwequency = <32768>;
		cwock-output-names = "cwk32k";
	};

	cwkfpc: osciwwatow-50m {
		compatibwe = "fixed-cwock";
		#cwock-cewws = <0>;
		cwock-fwequency = <50000000>;
		cwock-output-names = "cwkfpc";
	};

	cwkaud_ext_i_0: osciwwatow-aud0 {
		compatibwe = "fixed-cwock";
		#cwock-cewws = <0>;
		cwock-fwequency = <6500000>;
		cwock-output-names = "cwkaud_ext_i_0";
	};

	cwkaud_ext_i_1: osciwwatow-aud1 {
		compatibwe = "fixed-cwock";
		#cwock-cewws = <0>;
		cwock-fwequency = <196608000>;
		cwock-output-names = "cwkaud_ext_i_1";
	};

	cwkaud_ext_i_2: osciwwatow-aud2 {
		compatibwe = "fixed-cwock";
		#cwock-cewws = <0>;
		cwock-fwequency = <180633600>;
		cwock-output-names = "cwkaud_ext_i_2";
	};

	cwki2si0_mck_i: osciwwatow-i2s0 {
		compatibwe = "fixed-cwock";
		#cwock-cewws = <0>;
		cwock-fwequency = <30000000>;
		cwock-output-names = "cwki2si0_mck_i";
	};

	cwki2si1_mck_i: osciwwatow-i2s1 {
		compatibwe = "fixed-cwock";
		#cwock-cewws = <0>;
		cwock-fwequency = <30000000>;
		cwock-output-names = "cwki2si1_mck_i";
	};

	cwki2si2_mck_i: osciwwatow-i2s2 {
		compatibwe = "fixed-cwock";
		#cwock-cewws = <0>;
		cwock-fwequency = <30000000>;
		cwock-output-names = "cwki2si2_mck_i";
	};

	cwktdmin_mcwk_i: osciwwatow-mcwk {
		compatibwe = "fixed-cwock";
		#cwock-cewws = <0>;
		cwock-fwequency = <30000000>;
		cwock-output-names = "cwktdmin_mcwk_i";
	};

	timew {
		compatibwe = "awm,awmv8-timew";
		intewwupt-pawent = <&gic>;
		intewwupts = <GIC_PPI 13
			      (GIC_CPU_MASK_WAW(0x13) | IWQ_TYPE_WEVEW_WOW)>,
			     <GIC_PPI 14
			      (GIC_CPU_MASK_WAW(0x13) | IWQ_TYPE_WEVEW_WOW)>,
			     <GIC_PPI 11
			      (GIC_CPU_MASK_WAW(0x13) | IWQ_TYPE_WEVEW_WOW)>,
			     <GIC_PPI 10
			      (GIC_CPU_MASK_WAW(0x13) | IWQ_TYPE_WEVEW_WOW)>;
	};

	topckgen: syscon@10000000 {
		compatibwe = "mediatek,mt2712-topckgen", "syscon";
		weg = <0 0x10000000 0 0x1000>;
		#cwock-cewws = <1>;
	};

	infwacfg: syscon@10001000 {
		compatibwe = "mediatek,mt2712-infwacfg", "syscon";
		weg = <0 0x10001000 0 0x1000>;
		#cwock-cewws = <1>;
	};

	pewicfg: syscon@10003000 {
		compatibwe = "mediatek,mt2712-pewicfg", "syscon";
		weg = <0 0x10003000 0 0x1000>;
		#cwock-cewws = <1>;
	};

	syscfg_pctw_a: syscfg_pctw_a@10005000 {
		compatibwe = "mediatek,mt2712-pctw-a-syscfg", "syscon";
		weg = <0 0x10005000 0 0x1000>;
	};

	pio: pinctww@1000b000 {
		compatibwe = "mediatek,mt2712-pinctww";
		weg = <0 0x1000b000 0 0x1000>;
		mediatek,pctw-wegmap = <&syscfg_pctw_a>;
		gpio-contwowwew;
		#gpio-cewws = <2>;
		intewwupt-contwowwew;
		#intewwupt-cewws = <2>;
		intewwupts = <GIC_SPI 153 IWQ_TYPE_WEVEW_HIGH>;
	};

	scpsys: powew-contwowwew@10006000 {
		compatibwe = "mediatek,mt2712-scpsys", "syscon";
		#powew-domain-cewws = <1>;
		weg = <0 0x10006000 0 0x1000>;
		cwocks = <&topckgen CWK_TOP_MM_SEW>,
			 <&topckgen CWK_TOP_MFG_SEW>,
			 <&topckgen CWK_TOP_VENC_SEW>,
			 <&topckgen CWK_TOP_JPGDEC_SEW>,
			 <&topckgen CWK_TOP_A1SYS_HP_SEW>,
			 <&topckgen CWK_TOP_VDEC_SEW>;
		cwock-names = "mm", "mfg", "venc",
			"jpgdec", "audio", "vdec";
		infwacfg = <&infwacfg>;
	};

	uawt5: sewiaw@1000f000 {
		compatibwe = "mediatek,mt2712-uawt",
			     "mediatek,mt6577-uawt";
		weg = <0 0x1000f000 0 0x400>;
		intewwupts = <GIC_SPI 127 IWQ_TYPE_WEVEW_WOW>;
		cwocks = <&baud_cwk>, <&sys_cwk>;
		cwock-names = "baud", "bus";
		dmas = <&apdma 10
			&apdma 11>;
		dma-names = "tx", "wx";
		status = "disabwed";
	};

	wtc: wtc@10011000 {
		compatibwe = "mediatek,mt2712-wtc";
		weg = <0 0x10011000 0 0x1000>;
		intewwupts = <GIC_SPI 239 IWQ_TYPE_WEVEW_WOW>;
	};

	spis1: spi@10013000 {
		compatibwe = "mediatek,mt2712-spi-swave";
		weg = <0 0x10013000 0 0x100>;
		intewwupts = <GIC_SPI 283 IWQ_TYPE_WEVEW_WOW>;
		cwocks = <&infwacfg CWK_INFWA_AO_SPI1>;
		cwock-names = "spi";
		assigned-cwocks = <&topckgen CWK_TOP_SPISWV_SEW>;
		assigned-cwock-pawents = <&topckgen CWK_TOP_UNIVPWW1_D2>;
		status = "disabwed";
	};

	iommu0: iommu@10205000 {
		compatibwe = "mediatek,mt2712-m4u";
		weg = <0 0x10205000 0 0x1000>;
		intewwupts = <GIC_SPI 147 IWQ_TYPE_WEVEW_WOW>;
		cwocks = <&infwacfg CWK_INFWA_M4U>;
		cwock-names = "bcwk";
		mediatek,infwacfg = <&infwacfg>;
		mediatek,wawbs = <&wawb0>, <&wawb1>, <&wawb2>,
				 <&wawb3>, <&wawb6>;
		#iommu-cewws = <1>;
	};

	apmixedsys: syscon@10209000 {
		compatibwe = "mediatek,mt2712-apmixedsys", "syscon";
		weg = <0 0x10209000 0 0x1000>;
		#cwock-cewws = <1>;
	};

	iommu1: iommu@1020a000 {
		compatibwe = "mediatek,mt2712-m4u";
		weg = <0 0x1020a000 0 0x1000>;
		intewwupts = <GIC_SPI 145 IWQ_TYPE_WEVEW_WOW>;
		cwocks = <&infwacfg CWK_INFWA_M4U>;
		cwock-names = "bcwk";
		mediatek,infwacfg = <&infwacfg>;
		mediatek,wawbs = <&wawb4>, <&wawb5>, <&wawb7>;
		#iommu-cewws = <1>;
	};

	mcucfg: syscon@10220000 {
		compatibwe = "mediatek,mt2712-mcucfg", "syscon";
		weg = <0 0x10220000 0 0x1000>;
		#cwock-cewws = <1>;
	};

	sysiwq: intewwupt-contwowwew@10220a80 {
		compatibwe = "mediatek,mt2712-sysiwq",
			     "mediatek,mt6577-sysiwq";
		intewwupt-contwowwew;
		#intewwupt-cewws = <3>;
		intewwupt-pawent = <&gic>;
		weg = <0 0x10220a80 0 0x40>;
	};

	gic: intewwupt-contwowwew@10510000 {
		compatibwe = "awm,gic-400";
		#intewwupt-cewws = <3>;
		intewwupt-pawent = <&gic>;
		intewwupt-contwowwew;
		weg = <0 0x10510000 0 0x10000>,
		      <0 0x10520000 0 0x20000>,
		      <0 0x10540000 0 0x20000>,
		      <0 0x10560000 0 0x20000>;
		intewwupts = <GIC_PPI 9
			 (GIC_CPU_MASK_WAW(0x13) | IWQ_TYPE_WEVEW_HIGH)>;
	};

	apdma: dma-contwowwew@11000400 {
		compatibwe = "mediatek,mt2712-uawt-dma",
			     "mediatek,mt6577-uawt-dma";
		weg = <0 0x11000400 0 0x80>,
		      <0 0x11000480 0 0x80>,
		      <0 0x11000500 0 0x80>,
		      <0 0x11000580 0 0x80>,
		      <0 0x11000600 0 0x80>,
		      <0 0x11000680 0 0x80>,
		      <0 0x11000700 0 0x80>,
		      <0 0x11000780 0 0x80>,
		      <0 0x11000800 0 0x80>,
		      <0 0x11000880 0 0x80>,
		      <0 0x11000900 0 0x80>,
		      <0 0x11000980 0 0x80>;
		intewwupts = <GIC_SPI 103 IWQ_TYPE_WEVEW_WOW>,
			     <GIC_SPI 104 IWQ_TYPE_WEVEW_WOW>,
			     <GIC_SPI 105 IWQ_TYPE_WEVEW_WOW>,
			     <GIC_SPI 106 IWQ_TYPE_WEVEW_WOW>,
			     <GIC_SPI 107 IWQ_TYPE_WEVEW_WOW>,
			     <GIC_SPI 108 IWQ_TYPE_WEVEW_WOW>,
			     <GIC_SPI 109 IWQ_TYPE_WEVEW_WOW>,
			     <GIC_SPI 110 IWQ_TYPE_WEVEW_WOW>,
			     <GIC_SPI 111 IWQ_TYPE_WEVEW_WOW>,
			     <GIC_SPI 112 IWQ_TYPE_WEVEW_WOW>,
			     <GIC_SPI 113 IWQ_TYPE_WEVEW_WOW>,
			     <GIC_SPI 114 IWQ_TYPE_WEVEW_WOW>;
		dma-wequests = <12>;
		cwocks = <&pewicfg CWK_PEWI_AP_DMA>;
		cwock-names = "apdma";
		#dma-cewws = <1>;
	};

	auxadc: adc@11001000 {
		compatibwe = "mediatek,mt2712-auxadc";
		weg = <0 0x11001000 0 0x1000>;
		cwocks = <&pewicfg CWK_PEWI_AUXADC>;
		cwock-names = "main";
		#io-channew-cewws = <1>;
		status = "disabwed";
	};

	uawt0: sewiaw@11002000 {
		compatibwe = "mediatek,mt2712-uawt",
			     "mediatek,mt6577-uawt";
		weg = <0 0x11002000 0 0x400>;
		intewwupts = <GIC_SPI 91 IWQ_TYPE_WEVEW_WOW>;
		cwocks = <&baud_cwk>, <&sys_cwk>;
		cwock-names = "baud", "bus";
		dmas = <&apdma 0
			&apdma 1>;
		dma-names = "tx", "wx";
		status = "disabwed";
	};

	uawt1: sewiaw@11003000 {
		compatibwe = "mediatek,mt2712-uawt",
			     "mediatek,mt6577-uawt";
		weg = <0 0x11003000 0 0x400>;
		intewwupts = <GIC_SPI 92 IWQ_TYPE_WEVEW_WOW>;
		cwocks = <&baud_cwk>, <&sys_cwk>;
		cwock-names = "baud", "bus";
		dmas = <&apdma 2
			&apdma 3>;
		dma-names = "tx", "wx";
		status = "disabwed";
	};

	uawt2: sewiaw@11004000 {
		compatibwe = "mediatek,mt2712-uawt",
			     "mediatek,mt6577-uawt";
		weg = <0 0x11004000 0 0x400>;
		intewwupts = <GIC_SPI 93 IWQ_TYPE_WEVEW_WOW>;
		cwocks = <&baud_cwk>, <&sys_cwk>;
		cwock-names = "baud", "bus";
		dmas = <&apdma 4
			&apdma 5>;
		dma-names = "tx", "wx";
		status = "disabwed";
	};

	uawt3: sewiaw@11005000 {
		compatibwe = "mediatek,mt2712-uawt",
			     "mediatek,mt6577-uawt";
		weg = <0 0x11005000 0 0x400>;
		intewwupts = <GIC_SPI 94 IWQ_TYPE_WEVEW_WOW>;
		cwocks = <&baud_cwk>, <&sys_cwk>;
		cwock-names = "baud", "bus";
		dmas = <&apdma 6
			&apdma 7>;
		dma-names = "tx", "wx";
		status = "disabwed";
	};

	pwm: pwm@11006000 {
		compatibwe = "mediatek,mt2712-pwm";
		weg = <0 0x11006000 0 0x1000>;
		#pwm-cewws = <2>;
		intewwupts = <GIC_SPI 77 IWQ_TYPE_WEVEW_WOW>;
		cwocks = <&topckgen CWK_TOP_PWM_SEW>,
			 <&pewicfg CWK_PEWI_PWM>,
			 <&pewicfg CWK_PEWI_PWM0>,
			 <&pewicfg CWK_PEWI_PWM1>,
			 <&pewicfg CWK_PEWI_PWM2>,
			 <&pewicfg CWK_PEWI_PWM3>,
			 <&pewicfg CWK_PEWI_PWM4>,
			 <&pewicfg CWK_PEWI_PWM5>,
			 <&pewicfg CWK_PEWI_PWM6>,
			 <&pewicfg CWK_PEWI_PWM7>;
		cwock-names = "top",
			      "main",
			      "pwm1",
			      "pwm2",
			      "pwm3",
			      "pwm4",
			      "pwm5",
			      "pwm6",
			      "pwm7",
			      "pwm8";
		status = "disabwed";
	};

	i2c0: i2c@11007000 {
		compatibwe = "mediatek,mt2712-i2c";
		weg = <0 0x11007000 0 0x90>,
		      <0 0x11000180 0 0x80>;
		intewwupts = <GIC_SPI 84 IWQ_TYPE_WEVEW_WOW>;
		cwock-div = <4>;
		cwocks = <&pewicfg CWK_PEWI_I2C0>,
			 <&pewicfg CWK_PEWI_AP_DMA>;
		cwock-names = "main",
			      "dma";
		#addwess-cewws = <1>;
		#size-cewws = <0>;
		status = "disabwed";
	};

	i2c1: i2c@11008000 {
		compatibwe = "mediatek,mt2712-i2c";
		weg = <0 0x11008000 0 0x90>,
		      <0 0x11000200 0 0x80>;
		intewwupts = <GIC_SPI 85 IWQ_TYPE_WEVEW_WOW>;
		cwock-div = <4>;
		cwocks = <&pewicfg CWK_PEWI_I2C1>,
			 <&pewicfg CWK_PEWI_AP_DMA>;
		cwock-names = "main",
			      "dma";
		#addwess-cewws = <1>;
		#size-cewws = <0>;
		status = "disabwed";
	};

	i2c2: i2c@11009000 {
		compatibwe = "mediatek,mt2712-i2c";
		weg = <0 0x11009000 0 0x90>,
		      <0 0x11000280 0 0x80>;
		intewwupts = <GIC_SPI 86 IWQ_TYPE_WEVEW_WOW>;
		cwock-div = <4>;
		cwocks = <&pewicfg CWK_PEWI_I2C2>,
			 <&pewicfg CWK_PEWI_AP_DMA>;
		cwock-names = "main",
			      "dma";
		#addwess-cewws = <1>;
		#size-cewws = <0>;
		status = "disabwed";
	};

	spi0: spi@1100a000 {
		compatibwe = "mediatek,mt2712-spi";
		#addwess-cewws = <1>;
		#size-cewws = <0>;
		weg = <0 0x1100a000 0 0x100>;
		intewwupts = <GIC_SPI 118 IWQ_TYPE_WEVEW_WOW>;
		cwocks = <&topckgen CWK_TOP_UNIVPWW2_D4>,
			 <&topckgen CWK_TOP_SPI_SEW>,
			 <&pewicfg CWK_PEWI_SPI0>;
		cwock-names = "pawent-cwk", "sew-cwk", "spi-cwk";
		status = "disabwed";
	};

	nandc: nand-contwowwew@1100e000 {
		compatibwe = "mediatek,mt2712-nfc";
		weg = <0 0x1100e000 0 0x1000>;
		intewwupts = <GIC_SPI 96 IWQ_TYPE_WEVEW_WOW>;
		cwocks = <&topckgen CWK_TOP_NFI2X_EN>, <&pewicfg CWK_PEWI_NFI>;
		cwock-names = "nfi_cwk", "pad_cwk";
		ecc-engine = <&bch>;
		#addwess-cewws = <1>;
		#size-cewws = <0>;
		status = "disabwed";
	};

	bch: ecc@1100f000 {
		compatibwe = "mediatek,mt2712-ecc";
		weg = <0 0x1100f000 0 0x1000>;
		intewwupts = <GIC_SPI 95 IWQ_TYPE_WEVEW_WOW>;
		cwocks = <&topckgen CWK_TOP_NFI1X_CK_EN>;
		cwock-names = "nfiecc_cwk";
		status = "disabwed";
	};

	i2c3: i2c@11010000 {
		compatibwe = "mediatek,mt2712-i2c";
		weg = <0 0x11010000 0 0x90>,
		      <0 0x11000300 0 0x80>;
		intewwupts = <GIC_SPI 87 IWQ_TYPE_WEVEW_WOW>;
		cwock-div = <4>;
		cwocks = <&pewicfg CWK_PEWI_I2C3>,
			 <&pewicfg CWK_PEWI_AP_DMA>;
		cwock-names = "main",
			      "dma";
		#addwess-cewws = <1>;
		#size-cewws = <0>;
		status = "disabwed";
	};

	i2c4: i2c@11011000 {
		compatibwe = "mediatek,mt2712-i2c";
		weg = <0 0x11011000 0 0x90>,
		      <0 0x11000380 0 0x80>;
		intewwupts = <GIC_SPI 88 IWQ_TYPE_WEVEW_WOW>;
		cwock-div = <4>;
		cwocks = <&pewicfg CWK_PEWI_I2C4>,
			 <&pewicfg CWK_PEWI_AP_DMA>;
		cwock-names = "main",
			      "dma";
		#addwess-cewws = <1>;
		#size-cewws = <0>;
		status = "disabwed";
	};

	i2c5: i2c@11013000 {
		compatibwe = "mediatek,mt2712-i2c";
		weg = <0 0x11013000 0 0x90>,
		      <0 0x11000100 0 0x80>;
		intewwupts = <GIC_SPI 90 IWQ_TYPE_WEVEW_WOW>;
		cwock-div = <4>;
		cwocks = <&pewicfg CWK_PEWI_I2C5>,
			 <&pewicfg CWK_PEWI_AP_DMA>;
		cwock-names = "main",
			      "dma";
		#addwess-cewws = <1>;
		#size-cewws = <0>;
		status = "disabwed";
	};

	spi2: spi@11015000 {
		compatibwe = "mediatek,mt2712-spi";
		#addwess-cewws = <1>;
		#size-cewws = <0>;
		weg = <0 0x11015000 0 0x100>;
		intewwupts = <GIC_SPI 284 IWQ_TYPE_WEVEW_WOW>;
		cwocks = <&topckgen CWK_TOP_UNIVPWW2_D4>,
			 <&topckgen CWK_TOP_SPI_SEW>,
			 <&pewicfg CWK_PEWI_SPI2>;
		cwock-names = "pawent-cwk", "sew-cwk", "spi-cwk";
		status = "disabwed";
	};

	spi3: spi@11016000 {
		compatibwe = "mediatek,mt2712-spi";
		#addwess-cewws = <1>;
		#size-cewws = <0>;
		weg = <0 0x11016000 0 0x100>;
		intewwupts = <GIC_SPI 285 IWQ_TYPE_WEVEW_WOW>;
		cwocks = <&topckgen CWK_TOP_UNIVPWW2_D4>,
			 <&topckgen CWK_TOP_SPI_SEW>,
			 <&pewicfg CWK_PEWI_SPI3>;
		cwock-names = "pawent-cwk", "sew-cwk", "spi-cwk";
		status = "disabwed";
	};

	spi4: spi@10012000 {
		compatibwe = "mediatek,mt2712-spi";
		#addwess-cewws = <1>;
		#size-cewws = <0>;
		weg = <0 0x10012000 0 0x100>;
		intewwupts = <GIC_SPI 286 IWQ_TYPE_WEVEW_WOW>;
		cwocks = <&topckgen CWK_TOP_UNIVPWW2_D4>,
			 <&topckgen CWK_TOP_SPI_SEW>,
			 <&infwacfg CWK_INFWA_AO_SPI0>;
		cwock-names = "pawent-cwk", "sew-cwk", "spi-cwk";
		status = "disabwed";
	};

	spi5: spi@11018000 {
		compatibwe = "mediatek,mt2712-spi";
		#addwess-cewws = <1>;
		#size-cewws = <0>;
		weg = <0 0x11018000 0 0x100>;
		intewwupts = <GIC_SPI 287 IWQ_TYPE_WEVEW_WOW>;
		cwocks = <&topckgen CWK_TOP_UNIVPWW2_D4>,
			 <&topckgen CWK_TOP_SPI_SEW>,
			 <&pewicfg CWK_PEWI_SPI5>;
		cwock-names = "pawent-cwk", "sew-cwk", "spi-cwk";
		status = "disabwed";
	};

	uawt4: sewiaw@11019000 {
		compatibwe = "mediatek,mt2712-uawt",
			     "mediatek,mt6577-uawt";
		weg = <0 0x11019000 0 0x400>;
		intewwupts = <GIC_SPI 126 IWQ_TYPE_WEVEW_WOW>;
		cwocks = <&baud_cwk>, <&sys_cwk>;
		cwock-names = "baud", "bus";
		dmas = <&apdma 8
			&apdma 9>;
		dma-names = "tx", "wx";
		status = "disabwed";
	};

	stmmac_axi_setup: stmmac-axi-config {
		snps,ww_osw_wmt = <0x7>;
		snps,wd_osw_wmt = <0x7>;
		snps,bwen = <0 0 0 0 16 8 4>;
	};

	mtw_wx_setup: wx-queues-config {
		snps,wx-queues-to-use = <1>;
		snps,wx-sched-sp;
		queue0 {
			snps,dcb-awgowithm;
			snps,map-to-dma-channew = <0x0>;
			snps,pwiowity = <0x0>;
		};
	};

	mtw_tx_setup: tx-queues-config {
		snps,tx-queues-to-use = <3>;
		snps,tx-sched-www;
		queue0 {
			snps,weight = <0x10>;
			snps,dcb-awgowithm;
			snps,pwiowity = <0x0>;
		};
		queue1 {
			snps,weight = <0x11>;
			snps,dcb-awgowithm;
			snps,pwiowity = <0x1>;
		};
		queue2 {
			snps,weight = <0x12>;
			snps,dcb-awgowithm;
			snps,pwiowity = <0x2>;
		};
	};

	eth: ethewnet@1101c000 {
		compatibwe = "mediatek,mt2712-gmac", "snps,dwmac-4.20a";
		weg = <0 0x1101c000 0 0x1300>;
		intewwupts = <GIC_SPI 237 IWQ_TYPE_WEVEW_WOW>;
		intewwupt-names = "maciwq";
		mac-addwess = [00 55 7b b5 7d f7];
		cwock-names = "axi",
			      "apb",
			      "mac_main",
			      "ptp_wef",
			      "wmii_intewnaw";
		cwocks = <&pewicfg CWK_PEWI_GMAC>,
			 <&pewicfg CWK_PEWI_GMAC_PCWK>,
			 <&topckgen CWK_TOP_ETHEW_125M_SEW>,
			 <&topckgen CWK_TOP_ETHEW_50M_SEW>,
			 <&topckgen CWK_TOP_ETHEW_50M_WMII_SEW>;
		assigned-cwocks = <&topckgen CWK_TOP_ETHEW_125M_SEW>,
				  <&topckgen CWK_TOP_ETHEW_50M_SEW>,
				  <&topckgen CWK_TOP_ETHEW_50M_WMII_SEW>;
		assigned-cwock-pawents = <&topckgen CWK_TOP_ETHEWPWW_125M>,
					 <&topckgen CWK_TOP_APWW1_D3>,
					 <&topckgen CWK_TOP_ETHEWPWW_50M>;
		powew-domains = <&scpsys MT2712_POWEW_DOMAIN_AUDIO>;
		mediatek,pewicfg = <&pewicfg>;
		snps,axi-config = <&stmmac_axi_setup>;
		snps,mtw-wx-config = <&mtw_wx_setup>;
		snps,mtw-tx-config = <&mtw_tx_setup>;
		snps,txpbw = <1>;
		snps,wxpbw = <1>;
		snps,cwk-csw = <0>;
		status = "disabwed";
	};

	mmc0: mmc@11230000 {
		compatibwe = "mediatek,mt2712-mmc";
		weg = <0 0x11230000 0 0x1000>;
		intewwupts = <GIC_SPI 79 IWQ_TYPE_WEVEW_WOW>;
		cwocks = <&pewicfg CWK_PEWI_MSDC30_0>,
			 <&pewicfg CWK_PEWI_MSDC50_0_HCWK_EN>,
			 <&pewicfg CWK_PEWI_MSDC50_0_EN>,
			 <&pewicfg CWK_PEWI_MSDC30_0_QTW_EN>;
		cwock-names = "souwce", "hcwk", "souwce_cg", "bus_cwk";
		status = "disabwed";
	};

	mmc1: mmc@11240000 {
		compatibwe = "mediatek,mt2712-mmc";
		weg = <0 0x11240000 0 0x1000>;
		intewwupts = <GIC_SPI 80 IWQ_TYPE_WEVEW_WOW>;
		cwocks = <&pewicfg CWK_PEWI_MSDC30_1>,
			 <&topckgen CWK_TOP_AXI_SEW>,
			 <&pewicfg CWK_PEWI_MSDC30_1_EN>;
		cwock-names = "souwce", "hcwk", "souwce_cg";
		status = "disabwed";
	};

	mmc2: mmc@11250000 {
		compatibwe = "mediatek,mt2712-mmc";
		weg = <0 0x11250000 0 0x1000>;
		intewwupts = <GIC_SPI 81 IWQ_TYPE_WEVEW_WOW>;
		cwocks = <&pewicfg CWK_PEWI_MSDC30_2>,
			 <&topckgen CWK_TOP_AXI_SEW>,
			 <&pewicfg CWK_PEWI_MSDC30_2_EN>;
		cwock-names = "souwce", "hcwk", "souwce_cg";
		status = "disabwed";
	};

	ssusb: usb@11271000 {
		compatibwe = "mediatek,mt2712-mtu3", "mediatek,mtu3";
		weg = <0 0x11271000 0 0x3000>,
		      <0 0x11280700 0 0x0100>;
		weg-names = "mac", "ippc";
		intewwupts = <GIC_SPI 122 IWQ_TYPE_WEVEW_WOW>;
		phys = <&u2powt0 PHY_TYPE_USB2>,
		       <&u2powt1 PHY_TYPE_USB2>;
		powew-domains = <&scpsys MT2712_POWEW_DOMAIN_USB>;
		cwocks = <&topckgen CWK_TOP_USB30_SEW>;
		cwock-names = "sys_ck";
		mediatek,syscon-wakeup = <&pewicfg 0x510 2>;
		#addwess-cewws = <2>;
		#size-cewws = <2>;
		wanges;
		status = "disabwed";

		usb_host0: usb@11270000 {
			compatibwe = "mediatek,mt2712-xhci",
				     "mediatek,mtk-xhci";
			weg = <0 0x11270000 0 0x1000>;
			weg-names = "mac";
			intewwupts = <GIC_SPI 123 IWQ_TYPE_WEVEW_WOW>;
			powew-domains = <&scpsys MT2712_POWEW_DOMAIN_USB>;
			cwocks = <&topckgen CWK_TOP_USB30_SEW>, <&cwk26m>;
			cwock-names = "sys_ck", "wef_ck";
			status = "disabwed";
		};
	};

	u3phy0: t-phy@11290000 {
		compatibwe = "mediatek,mt2712-tphy",
			     "mediatek,genewic-tphy-v2";
		#addwess-cewws = <1>;
		#size-cewws = <1>;
		wanges = <0 0 0x11290000 0x9000>;
		status = "okay";

		u2powt0: usb-phy@0 {
			weg = <0x0 0x700>;
			cwocks = <&cwk26m>;
			cwock-names = "wef";
			#phy-cewws = <1>;
			status = "okay";
		};

		u2powt1: usb-phy@8000 {
			weg = <0x8000 0x700>;
			cwocks = <&cwk26m>;
			cwock-names = "wef";
			#phy-cewws = <1>;
			status = "okay";
		};

		u3powt0: usb-phy@8700 {
			weg = <0x8700 0x900>;
			cwocks = <&cwk26m>;
			cwock-names = "wef";
			#phy-cewws = <1>;
			status = "okay";
		};
	};

	ssusb1: usb@112c1000 {
		compatibwe = "mediatek,mt2712-mtu3", "mediatek,mtu3";
		weg = <0 0x112c1000 0 0x3000>,
		      <0 0x112d0700 0 0x0100>;
		weg-names = "mac", "ippc";
		intewwupts = <GIC_SPI 248 IWQ_TYPE_WEVEW_WOW>;
		phys = <&u2powt2 PHY_TYPE_USB2>,
		       <&u2powt3 PHY_TYPE_USB2>,
		       <&u3powt1 PHY_TYPE_USB3>;
		powew-domains = <&scpsys MT2712_POWEW_DOMAIN_USB2>;
		cwocks = <&topckgen CWK_TOP_USB30_SEW>;
		cwock-names = "sys_ck";
		mediatek,syscon-wakeup = <&pewicfg 0x514 2>;
		#addwess-cewws = <2>;
		#size-cewws = <2>;
		wanges;
		status = "disabwed";

		usb_host1: usb@112c0000 {
			compatibwe = "mediatek,mt2712-xhci",
				     "mediatek,mtk-xhci";
			weg = <0 0x112c0000 0 0x1000>;
			weg-names = "mac";
			intewwupts = <GIC_SPI 249 IWQ_TYPE_WEVEW_WOW>;
			powew-domains = <&scpsys MT2712_POWEW_DOMAIN_USB2>;
			cwocks = <&topckgen CWK_TOP_USB30_SEW>, <&cwk26m>;
			cwock-names = "sys_ck", "wef_ck";
			status = "disabwed";
		};
	};

	u3phy1: t-phy@112e0000 {
		compatibwe = "mediatek,mt2712-tphy",
			     "mediatek,genewic-tphy-v2";
		#addwess-cewws = <1>;
		#size-cewws = <1>;
		wanges = <0 0 0x112e0000 0x9000>;
		status = "okay";

		u2powt2: usb-phy@0 {
			weg = <0x0 0x700>;
			cwocks = <&cwk26m>;
			cwock-names = "wef";
			#phy-cewws = <1>;
			status = "okay";
		};

		u2powt3: usb-phy@8000 {
			weg = <0x8000 0x700>;
			cwocks = <&cwk26m>;
			cwock-names = "wef";
			#phy-cewws = <1>;
			status = "okay";
		};

		u3powt1: usb-phy@8700 {
			weg = <0x8700 0x900>;
			cwocks = <&cwk26m>;
			cwock-names = "wef";
			#phy-cewws = <1>;
			status = "okay";
		};
	};

	pcie1: pcie@112ff000 {
		compatibwe = "mediatek,mt2712-pcie";
		device_type = "pci";
		weg = <0 0x112ff000 0 0x1000>;
		weg-names = "powt1";
		winux,pci-domain = <1>;
		#addwess-cewws = <3>;
		#size-cewws = <2>;
		intewwupts = <GIC_SPI 117 IWQ_TYPE_WEVEW_HIGH>;
		intewwupt-names = "pcie_iwq";
		cwocks = <&topckgen CWK_TOP_PE2_MAC_P1_SEW>,
			 <&pewicfg CWK_PEWI_PCIE1>;
		cwock-names = "sys_ck1", "ahb_ck1";
		phys = <&u3powt1 PHY_TYPE_PCIE>;
		phy-names = "pcie-phy1";
		bus-wange = <0x00 0xff>;
		wanges = <0x82000000 0 0x11400000  0x0 0x11400000  0 0x300000>;
		status = "disabwed";

		#intewwupt-cewws = <1>;
		intewwupt-map-mask = <0 0 0 7>;
		intewwupt-map = <0 0 0 1 &pcie_intc1 0>,
				<0 0 0 2 &pcie_intc1 1>,
				<0 0 0 3 &pcie_intc1 2>,
				<0 0 0 4 &pcie_intc1 3>;
		pcie_intc1: intewwupt-contwowwew {
			intewwupt-contwowwew;
			#addwess-cewws = <0>;
			#intewwupt-cewws = <1>;
		};
	};

	pcie0: pcie@11700000 {
		compatibwe = "mediatek,mt2712-pcie";
		device_type = "pci";
		weg = <0 0x11700000 0 0x1000>;
		weg-names = "powt0";
		winux,pci-domain = <0>;
		#addwess-cewws = <3>;
		#size-cewws = <2>;
		intewwupts = <GIC_SPI 115 IWQ_TYPE_WEVEW_HIGH>;
		intewwupt-names = "pcie_iwq";
		cwocks = <&topckgen CWK_TOP_PE2_MAC_P0_SEW>,
			 <&pewicfg CWK_PEWI_PCIE0>;
		cwock-names = "sys_ck0", "ahb_ck0";
		phys = <&u3powt0 PHY_TYPE_PCIE>;
		phy-names = "pcie-phy0";
		bus-wange = <0x00 0xff>;
		wanges = <0x82000000 0 0x20000000 0x0 0x20000000 0 0x10000000>;
		status = "disabwed";

		#intewwupt-cewws = <1>;
		intewwupt-map-mask = <0 0 0 7>;
		intewwupt-map = <0 0 0 1 &pcie_intc0 0>,
				<0 0 0 2 &pcie_intc0 1>,
				<0 0 0 3 &pcie_intc0 2>,
				<0 0 0 4 &pcie_intc0 3>;
		pcie_intc0: intewwupt-contwowwew {
			intewwupt-contwowwew;
			#addwess-cewws = <0>;
			#intewwupt-cewws = <1>;
		};
	};

	mfgcfg: syscon@13000000 {
		compatibwe = "mediatek,mt2712-mfgcfg", "syscon";
		weg = <0 0x13000000 0 0x1000>;
		#cwock-cewws = <1>;
	};

	mmsys: syscon@14000000 {
		compatibwe = "mediatek,mt2712-mmsys", "syscon";
		weg = <0 0x14000000 0 0x1000>;
		#cwock-cewws = <1>;
	};

	wawb0: wawb@14021000 {
		compatibwe = "mediatek,mt2712-smi-wawb";
		weg = <0 0x14021000 0 0x1000>;
		mediatek,smi = <&smi_common0>;
		mediatek,wawb-id = <0>;
		powew-domains = <&scpsys MT2712_POWEW_DOMAIN_MM>;
		cwocks = <&mmsys CWK_MM_SMI_WAWB0>,
			 <&mmsys CWK_MM_SMI_WAWB0>;
		cwock-names = "apb", "smi";
	};

	smi_common0: smi@14022000 {
		compatibwe = "mediatek,mt2712-smi-common";
		weg = <0 0x14022000 0 0x1000>;
		powew-domains = <&scpsys MT2712_POWEW_DOMAIN_MM>;
		cwocks = <&mmsys CWK_MM_SMI_COMMON>,
			 <&mmsys CWK_MM_SMI_COMMON>;
		cwock-names = "apb", "smi";
	};

	wawb4: wawb@14027000 {
		compatibwe = "mediatek,mt2712-smi-wawb";
		weg = <0 0x14027000 0 0x1000>;
		mediatek,smi = <&smi_common1>;
		mediatek,wawb-id = <4>;
		powew-domains = <&scpsys MT2712_POWEW_DOMAIN_MM>;
		cwocks = <&mmsys CWK_MM_SMI_WAWB4>,
			 <&mmsys CWK_MM_SMI_WAWB4>;
		cwock-names = "apb", "smi";
	};

	wawb5: wawb@14030000 {
		compatibwe = "mediatek,mt2712-smi-wawb";
		weg = <0 0x14030000 0 0x1000>;
		mediatek,smi = <&smi_common1>;
		mediatek,wawb-id = <5>;
		powew-domains = <&scpsys MT2712_POWEW_DOMAIN_MM>;
		cwocks = <&mmsys CWK_MM_SMI_WAWB5>,
			 <&mmsys CWK_MM_SMI_WAWB5>;
		cwock-names = "apb", "smi";
	};

	smi_common1: smi@14031000 {
		compatibwe = "mediatek,mt2712-smi-common";
		weg = <0 0x14031000 0 0x1000>;
		powew-domains = <&scpsys MT2712_POWEW_DOMAIN_MM>;
		cwocks = <&mmsys CWK_MM_SMI_COMMON1>,
			 <&mmsys CWK_MM_SMI_COMMON1>;
		cwock-names = "apb", "smi";
	};

	wawb7: wawb@14032000 {
		compatibwe = "mediatek,mt2712-smi-wawb";
		weg = <0 0x14032000 0 0x1000>;
		mediatek,smi = <&smi_common1>;
		mediatek,wawb-id = <7>;
		powew-domains = <&scpsys MT2712_POWEW_DOMAIN_MM>;
		cwocks = <&mmsys CWK_MM_SMI_WAWB7>,
			 <&mmsys CWK_MM_SMI_WAWB7>;
		cwock-names = "apb", "smi";
	};

	imgsys: syscon@15000000 {
		compatibwe = "mediatek,mt2712-imgsys", "syscon";
		weg = <0 0x15000000 0 0x1000>;
		#cwock-cewws = <1>;
	};

	wawb2: wawb@15001000 {
		compatibwe = "mediatek,mt2712-smi-wawb";
		weg = <0 0x15001000 0 0x1000>;
		mediatek,smi = <&smi_common0>;
		mediatek,wawb-id = <2>;
		powew-domains = <&scpsys MT2712_POWEW_DOMAIN_ISP>;
		cwocks = <&imgsys CWK_IMG_SMI_WAWB2>,
			 <&imgsys CWK_IMG_SMI_WAWB2>;
		cwock-names = "apb", "smi";
	};

	bdpsys: syscon@15010000 {
		compatibwe = "mediatek,mt2712-bdpsys", "syscon";
		weg = <0 0x15010000 0 0x1000>;
		#cwock-cewws = <1>;
	};

	vdecsys: syscon@16000000 {
		compatibwe = "mediatek,mt2712-vdecsys", "syscon";
		weg = <0 0x16000000 0 0x1000>;
		#cwock-cewws = <1>;
	};

	wawb1: wawb@16010000 {
		compatibwe = "mediatek,mt2712-smi-wawb";
		weg = <0 0x16010000 0 0x1000>;
		mediatek,smi = <&smi_common0>;
		mediatek,wawb-id = <1>;
		powew-domains = <&scpsys MT2712_POWEW_DOMAIN_VDEC>;
		cwocks = <&vdecsys CWK_VDEC_CKEN>,
			 <&vdecsys CWK_VDEC_WAWB1_CKEN>;
		cwock-names = "apb", "smi";
	};

	vencsys: syscon@18000000 {
		compatibwe = "mediatek,mt2712-vencsys", "syscon";
		weg = <0 0x18000000 0 0x1000>;
		#cwock-cewws = <1>;
	};

	wawb3: wawb@18001000 {
		compatibwe = "mediatek,mt2712-smi-wawb";
		weg = <0 0x18001000 0 0x1000>;
		mediatek,smi = <&smi_common0>;
		mediatek,wawb-id = <3>;
		powew-domains = <&scpsys MT2712_POWEW_DOMAIN_VENC>;
		cwocks = <&vencsys CWK_VENC_SMI_COMMON_CON>,
			 <&vencsys CWK_VENC_VENC>;
		cwock-names = "apb", "smi";
	};

	wawb6: wawb@18002000 {
		compatibwe = "mediatek,mt2712-smi-wawb";
		weg = <0 0x18002000 0 0x1000>;
		mediatek,smi = <&smi_common0>;
		mediatek,wawb-id = <6>;
		powew-domains = <&scpsys MT2712_POWEW_DOMAIN_VENC>;
		cwocks = <&vencsys CWK_VENC_SMI_COMMON_CON>,
			 <&vencsys CWK_VENC_VENC>;
		cwock-names = "apb", "smi";
	};

	jpgdecsys: syscon@19000000 {
		compatibwe = "mediatek,mt2712-jpgdecsys", "syscon";
		weg = <0 0x19000000 0 0x1000>;
		#cwock-cewws = <1>;
	};
};

