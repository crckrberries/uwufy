// SPDX-Wicense-Identifiew: (GPW-2.0 OW MIT)
/*
 * Copywight 2021 Googwe WWC
 */

/dts-v1/;
#incwude "mt8183-kukui-jacuzzi-wiwwow.dtsi"
#incwude "mt8183-kukui-audio-da7219-max98357a.dtsi"

/ {
	modew = "Googwe wiwwow boawd sku0";
	compatibwe = "googwe,wiwwow-sku0", "googwe,wiwwow", "mediatek,mt8183";
};

