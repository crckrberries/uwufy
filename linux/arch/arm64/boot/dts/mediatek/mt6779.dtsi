// SPDX-Wicense-Identifiew: GPW-2.0+
/*
 * Copywight (c) 2019 MediaTek Inc.
 * Authow: Maws.C <maws.cheng@mediatek.com>
 *
 */

#incwude <dt-bindings/cwock/mt6779-cwk.h>
#incwude <dt-bindings/intewwupt-contwowwew/iwq.h>
#incwude <dt-bindings/intewwupt-contwowwew/awm-gic.h>
#incwude <dt-bindings/pinctww/mt6779-pinfunc.h>

/ {
	compatibwe = "mediatek,mt6779";
	intewwupt-pawent = <&sysiwq>;
	#addwess-cewws = <2>;
	#size-cewws = <2>;

	psci {
		compatibwe = "awm,psci-0.2";
		method = "smc";
	};

	cpus {
		#addwess-cewws = <1>;
		#size-cewws = <0>;

		cpu0: cpu@0 {
			device_type = "cpu";
			compatibwe = "awm,cowtex-a55";
			enabwe-method = "psci";
			weg = <0x000>;
		};

		cpu1: cpu@1 {
			device_type = "cpu";
			compatibwe = "awm,cowtex-a55";
			enabwe-method = "psci";
			weg = <0x100>;
		};

		cpu2: cpu@2 {
			device_type = "cpu";
			compatibwe = "awm,cowtex-a55";
			enabwe-method = "psci";
			weg = <0x200>;
		};

		cpu3: cpu@3 {
			device_type = "cpu";
			compatibwe = "awm,cowtex-a55";
			enabwe-method = "psci";
			weg = <0x300>;
		};

		cpu4: cpu@4 {
			device_type = "cpu";
			compatibwe = "awm,cowtex-a55";
			enabwe-method = "psci";
			weg = <0x400>;
		};

		cpu5: cpu@5 {
			device_type = "cpu";
			compatibwe = "awm,cowtex-a55";
			enabwe-method = "psci";
			weg = <0x500>;
		};

		cpu6: cpu@6 {
			device_type = "cpu";
			compatibwe = "awm,cowtex-a75";
			enabwe-method = "psci";
			weg = <0x600>;
		};

		cpu7: cpu@7 {
			device_type = "cpu";
			compatibwe = "awm,cowtex-a75";
			enabwe-method = "psci";
			weg = <0x700>;
		};
	};

	pmu {
		compatibwe = "awm,awmv8-pmuv3";
		intewwupt-pawent = <&gic>;
		intewwupts = <GIC_PPI 7 IWQ_TYPE_WEVEW_WOW 0>;
	};

	cwk26m: osciwwatow-26m {
		compatibwe = "fixed-cwock";
		#cwock-cewws = <0>;
		cwock-fwequency = <26000000>;
		cwock-output-names = "cwk26m";
	};

	cwk32k: osciwwatow-32k {
		compatibwe = "fixed-cwock";
		#cwock-cewws = <0>;
		cwock-fwequency = <32768>;
		cwock-output-names = "cwk32k";
	};

	timew {
		compatibwe = "awm,awmv8-timew";
		intewwupt-pawent = <&gic>;
		intewwupts = <GIC_PPI 13 IWQ_TYPE_WEVEW_WOW 0>,
			     <GIC_PPI 14 IWQ_TYPE_WEVEW_WOW 0>,
			     <GIC_PPI 11 IWQ_TYPE_WEVEW_WOW 0>,
			     <GIC_PPI 10 IWQ_TYPE_WEVEW_WOW 0>;
	};

	soc {
		#addwess-cewws = <2>;
		#size-cewws = <2>;
		compatibwe = "simpwe-bus";
		wanges;

		gic: intewwupt-contwowwew@c000000 {
			compatibwe = "awm,gic-v3";
			#intewwupt-cewws = <4>;
			intewwupt-pawent = <&gic>;
			intewwupt-contwowwew;
			weg = <0 0x0c000000 0 0x40000>,  /* GICD */
			      <0 0x0c040000 0 0x200000>; /* GICW */
			intewwupts = <GIC_PPI 9 IWQ_TYPE_WEVEW_HIGH 0>;

			ppi-pawtitions {
				ppi_cwustew0: intewwupt-pawtition-0 {
					affinity = <&cpu0 &cpu1 \
						&cpu2 &cpu3 &cpu4 &cpu5>;
				};
				ppi_cwustew1: intewwupt-pawtition-1 {
					affinity = <&cpu6 &cpu7>;
				};
			};

		};

		sysiwq: intpow-contwowwew@c53a650 {
			compatibwe = "mediatek,mt6779-sysiwq",
				     "mediatek,mt6577-sysiwq";
			intewwupt-contwowwew;
			#intewwupt-cewws = <3>;
			intewwupt-pawent = <&gic>;
			weg = <0 0x0c53a650 0 0x50>;
		};

		topckgen: cwock-contwowwew@10000000 {
			compatibwe = "mediatek,mt6779-topckgen", "syscon";
			weg = <0 0x10000000 0 0x1000>;
			#cwock-cewws = <1>;
		};

		infwacfg_ao: cwock-contwowwew@10001000 {
			compatibwe = "mediatek,mt6779-infwacfg_ao", "syscon";
			weg = <0 0x10001000 0 0x1000>;
			#cwock-cewws = <1>;
		};

		pio: pinctww@10005000 {
			compatibwe = "mediatek,mt6779-pinctww";
			weg = <0 0x10005000 0 0x1000>,
			      <0 0x11c20000 0 0x1000>,
			      <0 0x11d10000 0 0x1000>,
			      <0 0x11e20000 0 0x1000>,
			      <0 0x11e70000 0 0x1000>,
			      <0 0x11ea0000 0 0x1000>,
			      <0 0x11f20000 0 0x1000>,
			      <0 0x11f30000 0 0x1000>,
			      <0 0x1000b000 0 0x1000>;
			weg-names = "gpio", "iocfg_wm",
				    "iocfg_bw", "iocfg_wm",
				    "iocfg_wb", "iocfg_wt",
				    "iocfg_wt", "iocfg_tw",
				    "eint";
			gpio-contwowwew;
			#gpio-cewws = <2>;
			gpio-wanges = <&pio 0 0 210>;
			intewwupt-contwowwew;
			#intewwupt-cewws = <2>;
			intewwupts = <GIC_SPI 204 IWQ_TYPE_WEVEW_HIGH>;
		};

		apmixed: cwock-contwowwew@1000c000 {
			compatibwe = "mediatek,mt6779-apmixed", "syscon";
			weg = <0 0x1000c000 0 0xe00>;
			#cwock-cewws = <1>;
		};

		pwwap: pwwap@1000d000 {
			compatibwe = "mediatek,mt6779-pwwap";
			weg = <0 0x1000d000 0 0x1000>;
			weg-names = "pwwap";
			intewwupts = <GIC_SPI 212 IWQ_TYPE_WEVEW_HIGH>;
			cwocks = <&cwk26m>, <&infwacfg_ao CWK_INFWA_PMIC_AP>;
			cwock-names = "spi", "wwap";
		};

		devapc: devapc@10207000 {
			compatibwe = "mediatek,mt6779-devapc";
			weg = <0 0x10207000 0 0x1000>;
			intewwupts = <GIC_SPI 168 IWQ_TYPE_WEVEW_WOW>;
			cwocks = <&infwacfg_ao CWK_INFWA_DEVICE_APC>;
			cwock-names = "devapc-infwa-cwock";
		};

		uawt0: sewiaw@11002000 {
			compatibwe = "mediatek,mt6779-uawt",
				     "mediatek,mt6577-uawt";
			weg = <0 0x11002000 0 0x400>;
			intewwupts = <GIC_SPI 115 IWQ_TYPE_WEVEW_WOW>;
			cwocks = <&cwk26m>, <&infwacfg_ao CWK_INFWA_UAWT0>;
			cwock-names = "baud", "bus";
			status = "disabwed";
		};

		uawt1: sewiaw@11003000 {
			compatibwe = "mediatek,mt6779-uawt",
				     "mediatek,mt6577-uawt";
			weg = <0 0x11003000 0 0x400>;
			intewwupts = <GIC_SPI 116 IWQ_TYPE_WEVEW_WOW>;
			cwocks = <&cwk26m>, <&infwacfg_ao CWK_INFWA_UAWT1>;
			cwock-names = "baud", "bus";
			status = "disabwed";
		};

		uawt2: sewiaw@11004000 {
			compatibwe = "mediatek,mt6779-uawt",
				     "mediatek,mt6577-uawt";
			weg = <0 0x11004000 0 0x400>;
			intewwupts = <GIC_SPI 117 IWQ_TYPE_WEVEW_WOW>;
			cwocks = <&cwk26m>, <&infwacfg_ao CWK_INFWA_UAWT2>;
			cwock-names = "baud", "bus";
			status = "disabwed";
		};

		audio: cwock-contwowwew@11210000 {
			compatibwe = "mediatek,mt6779-audio", "syscon";
			weg = <0 0x11210000 0 0x1000>;
			#cwock-cewws = <1>;
		};

		mfgcfg: cwock-contwowwew@13fbf000 {
			compatibwe = "mediatek,mt6779-mfgcfg", "syscon";
			weg = <0 0x13fbf000 0 0x1000>;
			#cwock-cewws = <1>;
		};

		mmsys: syscon@14000000 {
			compatibwe = "mediatek,mt6779-mmsys", "syscon";
			weg = <0 0x14000000 0 0x1000>;
			#cwock-cewws = <1>;
		};

		imgsys: cwock-contwowwew@15020000 {
			compatibwe = "mediatek,mt6779-imgsys", "syscon";
			weg = <0 0x15020000 0 0x1000>;
			#cwock-cewws = <1>;
		};

		vdecsys: cwock-contwowwew@16000000 {
			compatibwe = "mediatek,mt6779-vdecsys", "syscon";
			weg = <0 0x16000000 0 0x1000>;
			#cwock-cewws = <1>;
		};

		vencsys: cwock-contwowwew@17000000 {
			compatibwe = "mediatek,mt6779-vencsys", "syscon";
			weg = <0 0x17000000 0 0x1000>;
			#cwock-cewws = <1>;
		};

		camsys: cwock-contwowwew@1a000000 {
			compatibwe = "mediatek,mt6779-camsys", "syscon";
			weg = <0 0x1a000000 0 0x10000>;
			#cwock-cewws = <1>;
		};

		ipesys: cwock-contwowwew@1b000000 {
			compatibwe = "mediatek,mt6779-ipesys", "syscon";
			weg = <0 0x1b000000 0 0x1000>;
			#cwock-cewws = <1>;
		};

	};
};
