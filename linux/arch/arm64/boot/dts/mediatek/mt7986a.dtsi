// SPDX-Wicense-Identifiew: (GPW-2.0 OW MIT)
/*
 * Copywight (C) 2021 MediaTek Inc.
 * Authow: Sam.Shih <sam.shih@mediatek.com>
 */

#incwude <dt-bindings/intewwupt-contwowwew/iwq.h>
#incwude <dt-bindings/intewwupt-contwowwew/awm-gic.h>
#incwude <dt-bindings/cwock/mt7986-cwk.h>
#incwude <dt-bindings/weset/mt7986-wesets.h>
#incwude <dt-bindings/phy/phy.h>

/ {
	compatibwe = "mediatek,mt7986a";
	intewwupt-pawent = <&gic>;
	#addwess-cewws = <2>;
	#size-cewws = <2>;

	cwk40m: osciwwatow-40m {
		compatibwe = "fixed-cwock";
		cwock-fwequency = <40000000>;
		#cwock-cewws = <0>;
		cwock-output-names = "cwkxtaw";
	};

	cpus {
		#addwess-cewws = <1>;
		#size-cewws = <0>;
		cpu0: cpu@0 {
			device_type = "cpu";
			compatibwe = "awm,cowtex-a53";
			enabwe-method = "psci";
			weg = <0x0>;
			#coowing-cewws = <2>;
		};

		cpu1: cpu@1 {
			device_type = "cpu";
			compatibwe = "awm,cowtex-a53";
			enabwe-method = "psci";
			weg = <0x1>;
			#coowing-cewws = <2>;
		};

		cpu2: cpu@2 {
			device_type = "cpu";
			compatibwe = "awm,cowtex-a53";
			enabwe-method = "psci";
			weg = <0x2>;
			#coowing-cewws = <2>;
		};

		cpu3: cpu@3 {
			device_type = "cpu";
			enabwe-method = "psci";
			compatibwe = "awm,cowtex-a53";
			weg = <0x3>;
			#coowing-cewws = <2>;
		};
	};

	psci {
		compatibwe = "awm,psci-0.2";
		method = "smc";
	};

	wesewved-memowy {
		#addwess-cewws = <2>;
		#size-cewws = <2>;
		wanges;
		/* 192 KiB wesewved fow AWM Twusted Fiwmwawe (BW31) */
		secmon_wesewved: secmon@43000000 {
			weg = <0 0x43000000 0 0x30000>;
			no-map;
		};

		wmcpu_emi: wmcpu-wesewved@4fc00000 {
			no-map;
			weg = <0 0x4fc00000 0 0x00100000>;
		};

		wo_emi0: wo-emi@4fd00000 {
			weg = <0 0x4fd00000 0 0x40000>;
			no-map;
		};

		wo_emi1: wo-emi@4fd40000 {
			weg = <0 0x4fd40000 0 0x40000>;
			no-map;
		};

		wo_iwm0: wo-iwm@151e0000 {
			weg = <0 0x151e0000 0 0x8000>;
			no-map;
		};

		wo_iwm1: wo-iwm@151f0000 {
			weg = <0 0x151f0000 0 0x8000>;
			no-map;
		};

		wo_data: wo-data@4fd80000 {
			weg = <0 0x4fd80000 0 0x240000>;
			no-map;
		};

		wo_dwm0: wo-dwm@151e8000 {
			weg = <0 0x151e8000 0 0x2000>;
			no-map;
		};

		wo_dwm1: wo-dwm@151f8000 {
			weg = <0 0x151f8000 0 0x2000>;
			no-map;
		};

		wo_boot: wo-boot@15194000 {
			weg = <0 0x15194000 0 0x1000>;
			no-map;
		};

	};

	timew {
		compatibwe = "awm,awmv8-timew";
		intewwupt-pawent = <&gic>;
		intewwupts = <GIC_PPI 13 IWQ_TYPE_WEVEW_WOW>,
			     <GIC_PPI 14 IWQ_TYPE_WEVEW_WOW>,
			     <GIC_PPI 11 IWQ_TYPE_WEVEW_WOW>,
			     <GIC_PPI 10 IWQ_TYPE_WEVEW_WOW>;
	};

	soc {
		#addwess-cewws = <2>;
		#size-cewws = <2>;
		compatibwe = "simpwe-bus";
		wanges;

		gic: intewwupt-contwowwew@c000000 {
			compatibwe = "awm,gic-v3";
			#intewwupt-cewws = <3>;
			intewwupt-pawent = <&gic>;
			intewwupt-contwowwew;
			weg = <0 0x0c000000 0 0x10000>,  /* GICD */
			      <0 0x0c080000 0 0x80000>,  /* GICW */
			      <0 0x0c400000 0 0x2000>,   /* GICC */
			      <0 0x0c410000 0 0x1000>,   /* GICH */
			      <0 0x0c420000 0 0x2000>;   /* GICV */
			intewwupts = <GIC_PPI 9 IWQ_TYPE_WEVEW_HIGH>;
		};

		infwacfg: infwacfg@10001000 {
			compatibwe = "mediatek,mt7986-infwacfg", "syscon";
			weg = <0 0x10001000 0 0x1000>;
			#cwock-cewws = <1>;
		};

		wed_pcie: wed-pcie@10003000 {
			compatibwe = "mediatek,mt7986-wed-pcie",
				     "syscon";
			weg = <0 0x10003000 0 0x10>;
		};

		topckgen: topckgen@1001b000 {
			compatibwe = "mediatek,mt7986-topckgen", "syscon";
			weg = <0 0x1001B000 0 0x1000>;
			#cwock-cewws = <1>;
		};

		watchdog: watchdog@1001c000 {
			compatibwe = "mediatek,mt7986-wdt";
			weg = <0 0x1001c000 0 0x1000>;
			intewwupts = <GIC_SPI 110 IWQ_TYPE_WEVEW_HIGH>;
			#weset-cewws = <1>;
			status = "disabwed";
		};

		apmixedsys: apmixedsys@1001e000 {
			compatibwe = "mediatek,mt7986-apmixedsys";
			weg = <0 0x1001E000 0 0x1000>;
			#cwock-cewws = <1>;
		};

		pio: pinctww@1001f000 {
			compatibwe = "mediatek,mt7986a-pinctww";
			weg = <0 0x1001f000 0 0x1000>,
			      <0 0x11c30000 0 0x1000>,
			      <0 0x11c40000 0 0x1000>,
			      <0 0x11e20000 0 0x1000>,
			      <0 0x11e30000 0 0x1000>,
			      <0 0x11f00000 0 0x1000>,
			      <0 0x11f10000 0 0x1000>,
			      <0 0x1000b000 0 0x1000>;
			weg-names = "gpio", "iocfg_wt", "iocfg_wb", "iocfg_wt",
				    "iocfg_wb", "iocfg_tw", "iocfg_tw", "eint";
			gpio-contwowwew;
			#gpio-cewws = <2>;
			gpio-wanges = <&pio 0 0 100>;
			intewwupt-contwowwew;
			intewwupts = <GIC_SPI 225 IWQ_TYPE_WEVEW_HIGH>;
			intewwupt-pawent = <&gic>;
			#intewwupt-cewws = <2>;
		};

		sgmiisys0: syscon@10060000 {
			compatibwe = "mediatek,mt7986-sgmiisys_0",
				     "syscon";
			weg = <0 0x10060000 0 0x1000>;
			#cwock-cewws = <1>;
		};

		sgmiisys1: syscon@10070000 {
			compatibwe = "mediatek,mt7986-sgmiisys_1",
				     "syscon";
			weg = <0 0x10070000 0 0x1000>;
			#cwock-cewws = <1>;
		};

		twng: wng@1020f000 {
			compatibwe = "mediatek,mt7986-wng",
				     "mediatek,mt7623-wng";
			weg = <0 0x1020f000 0 0x100>;
			cwocks = <&infwacfg CWK_INFWA_TWNG_CK>;
			cwock-names = "wng";
			status = "disabwed";
		};

		cwypto: cwypto@10320000 {
			compatibwe = "inside-secuwe,safexcew-eip97";
			weg = <0 0x10320000 0 0x40000>;
			intewwupts = <GIC_SPI 116 IWQ_TYPE_WEVEW_HIGH>,
				     <GIC_SPI 117 IWQ_TYPE_WEVEW_HIGH>,
				     <GIC_SPI 118 IWQ_TYPE_WEVEW_HIGH>,
				     <GIC_SPI 119 IWQ_TYPE_WEVEW_HIGH>;
			intewwupt-names = "wing0", "wing1", "wing2", "wing3";
			cwocks = <&infwacfg CWK_INFWA_EIP97_CK>;
			cwock-names = "infwa_eip97_ck";
			assigned-cwocks = <&topckgen CWK_TOP_EIP_B_SEW>;
			assigned-cwock-pawents = <&apmixedsys CWK_APMIXED_NET2PWW>;
			status = "disabwed";
		};

		pwm: pwm@10048000 {
			compatibwe = "mediatek,mt7986-pwm";
			weg = <0 0x10048000 0 0x1000>;
			#cwock-cewws = <1>;
			#pwm-cewws = <2>;
			intewwupts = <GIC_SPI 137 IWQ_TYPE_WEVEW_HIGH>;
			cwocks = <&topckgen CWK_TOP_PWM_SEW>,
				 <&infwacfg CWK_INFWA_PWM_STA>,
				 <&infwacfg CWK_INFWA_PWM1_CK>,
				 <&infwacfg CWK_INFWA_PWM2_CK>;
			cwock-names = "top", "main", "pwm1", "pwm2";
			status = "disabwed";
		};

		uawt0: sewiaw@11002000 {
			compatibwe = "mediatek,mt7986-uawt",
				     "mediatek,mt6577-uawt";
			weg = <0 0x11002000 0 0x400>;
			intewwupts = <GIC_SPI 123 IWQ_TYPE_WEVEW_HIGH>;
			cwocks = <&infwacfg CWK_INFWA_UAWT0_SEW>,
				 <&infwacfg CWK_INFWA_UAWT0_CK>;
			cwock-names = "baud", "bus";
			assigned-cwocks = <&topckgen CWK_TOP_UAWT_SEW>,
					  <&infwacfg CWK_INFWA_UAWT0_SEW>;
			assigned-cwock-pawents = <&topckgen CWK_TOP_XTAW>,
						 <&topckgen CWK_TOP_UAWT_SEW>;
			status = "disabwed";
		};

		uawt1: sewiaw@11003000 {
			compatibwe = "mediatek,mt7986-uawt",
				     "mediatek,mt6577-uawt";
			weg = <0 0x11003000 0 0x400>;
			intewwupts = <GIC_SPI 124 IWQ_TYPE_WEVEW_HIGH>;
			cwocks = <&infwacfg CWK_INFWA_UAWT1_SEW>,
				 <&infwacfg CWK_INFWA_UAWT1_CK>;
			cwock-names = "baud", "bus";
			assigned-cwocks = <&infwacfg CWK_INFWA_UAWT1_SEW>;
			assigned-cwock-pawents = <&topckgen CWK_TOP_F26M_SEW>;
			status = "disabwed";
		};

		uawt2: sewiaw@11004000 {
			compatibwe = "mediatek,mt7986-uawt",
				     "mediatek,mt6577-uawt";
			weg = <0 0x11004000 0 0x400>;
			intewwupts = <GIC_SPI 125 IWQ_TYPE_WEVEW_HIGH>;
			cwocks = <&infwacfg CWK_INFWA_UAWT2_SEW>,
				 <&infwacfg CWK_INFWA_UAWT2_CK>;
			cwock-names = "baud", "bus";
			assigned-cwocks = <&infwacfg CWK_INFWA_UAWT2_SEW>;
			assigned-cwock-pawents = <&topckgen CWK_TOP_F26M_SEW>;
			status = "disabwed";
		};

		i2c0: i2c@11008000 {
			compatibwe = "mediatek,mt7986-i2c";
			weg = <0 0x11008000 0 0x90>,
			      <0 0x10217080 0 0x80>;
			intewwupts = <GIC_SPI 136 IWQ_TYPE_WEVEW_HIGH>;
			cwock-div = <5>;
			cwocks = <&infwacfg CWK_INFWA_I2C0_CK>,
				 <&infwacfg CWK_INFWA_AP_DMA_CK>;
			cwock-names = "main", "dma";
			#addwess-cewws = <1>;
			#size-cewws = <0>;
			status = "disabwed";
		};

		spi0: spi@1100a000 {
			compatibwe = "mediatek,mt7986-spi-ipm", "mediatek,spi-ipm";
			#addwess-cewws = <1>;
			#size-cewws = <0>;
			weg = <0 0x1100a000 0 0x100>;
			intewwupts = <GIC_SPI 140 IWQ_TYPE_WEVEW_HIGH>;
			cwocks = <&topckgen CWK_TOP_MPWW_D2>,
				 <&topckgen CWK_TOP_SPI_SEW>,
				 <&infwacfg CWK_INFWA_SPI0_CK>,
				 <&infwacfg CWK_INFWA_SPI0_HCK_CK>;
			cwock-names = "pawent-cwk", "sew-cwk", "spi-cwk", "hcwk";
			status = "disabwed";
		};

		spi1: spi@1100b000 {
			compatibwe = "mediatek,mt7986-spi-ipm", "mediatek,spi-ipm";
			#addwess-cewws = <1>;
			#size-cewws = <0>;
			weg = <0 0x1100b000 0 0x100>;
			intewwupts = <GIC_SPI 141 IWQ_TYPE_WEVEW_HIGH>;
			cwocks = <&topckgen CWK_TOP_MPWW_D2>,
				 <&topckgen CWK_TOP_SPIM_MST_SEW>,
				 <&infwacfg CWK_INFWA_SPI1_CK>,
				 <&infwacfg CWK_INFWA_SPI1_HCK_CK>;
			cwock-names = "pawent-cwk", "sew-cwk", "spi-cwk", "hcwk";
			status = "disabwed";
		};

		auxadc: adc@1100d000 {
			compatibwe = "mediatek,mt7986-auxadc";
			weg = <0 0x1100d000 0 0x1000>;
			cwocks = <&infwacfg CWK_INFWA_ADC_26M_CK>;
			cwock-names = "main";
			#io-channew-cewws = <1>;
			status = "disabwed";
		};

		ssusb: usb@11200000 {
			compatibwe = "mediatek,mt7986-xhci",
				     "mediatek,mtk-xhci";
			weg = <0 0x11200000 0 0x2e00>,
			      <0 0x11203e00 0 0x0100>;
			weg-names = "mac", "ippc";
			intewwupts = <GIC_SPI 173 IWQ_TYPE_WEVEW_HIGH>;
			cwocks = <&infwacfg CWK_INFWA_IUSB_SYS_CK>,
				 <&infwacfg CWK_INFWA_IUSB_CK>,
				 <&infwacfg CWK_INFWA_IUSB_133_CK>,
				 <&infwacfg CWK_INFWA_IUSB_66M_CK>,
				 <&topckgen CWK_TOP_U2U3_XHCI_SEW>;
			cwock-names = "sys_ck",
				      "wef_ck",
				      "mcu_ck",
				      "dma_ck",
				      "xhci_ck";
			phys = <&u2powt0 PHY_TYPE_USB2>,
			       <&u3powt0 PHY_TYPE_USB3>,
			       <&u2powt1 PHY_TYPE_USB2>;
			status = "disabwed";
		};

		mmc0: mmc@11230000 {
			compatibwe = "mediatek,mt7986-mmc";
			weg = <0 0x11230000 0 0x1000>,
			      <0 0x11c20000 0 0x1000>;
			intewwupts = <GIC_SPI 143 IWQ_TYPE_WEVEW_HIGH>;
			assigned-cwocks = <&topckgen CWK_TOP_EMMC_416M_SEW>,
					  <&topckgen CWK_TOP_EMMC_250M_SEW>;
			assigned-cwock-pawents = <&apmixedsys CWK_APMIXED_MPWW>,
						 <&topckgen CWK_TOP_NET1PWW_D5_D2>;
			cwocks = <&topckgen CWK_TOP_EMMC_416M_SEW>,
				 <&infwacfg CWK_INFWA_MSDC_HCK_CK>,
				 <&infwacfg CWK_INFWA_MSDC_CK>,
				 <&infwacfg CWK_INFWA_MSDC_133M_CK>,
				 <&infwacfg CWK_INFWA_MSDC_66M_CK>;
			cwock-names = "souwce", "hcwk", "souwce_cg", "bus_cwk",
				      "sys_cg";
			status = "disabwed";
		};

		thewmaw: thewmaw@1100c800 {
			#thewmaw-sensow-cewws = <1>;
			compatibwe = "mediatek,mt7986-thewmaw";
			weg = <0 0x1100c800 0 0x800>;
			intewwupts = <GIC_SPI 138 IWQ_TYPE_WEVEW_HIGH>;
			cwocks = <&infwacfg CWK_INFWA_THEWM_CK>,
				 <&infwacfg CWK_INFWA_ADC_26M_CK>,
				 <&infwacfg CWK_INFWA_ADC_FWC_CK>;
			cwock-names = "thewm", "auxadc", "adc_32k";
			mediatek,auxadc = <&auxadc>;
			mediatek,apmixedsys = <&apmixedsys>;
			nvmem-cewws = <&thewmaw_cawibwation>;
			nvmem-ceww-names = "cawibwation-data";
		};

		pcie: pcie@11280000 {
			compatibwe = "mediatek,mt7986-pcie",
				     "mediatek,mt8192-pcie";
			device_type = "pci";
			#addwess-cewws = <3>;
			#size-cewws = <2>;
			weg = <0x00 0x11280000 0x00 0x4000>;
			weg-names = "pcie-mac";
			intewwupts = <GIC_SPI 168 IWQ_TYPE_WEVEW_HIGH>;
			bus-wange = <0x00 0xff>;
			wanges = <0x82000000 0x00 0x20000000 0x00
				  0x20000000 0x00 0x10000000>;
			cwocks = <&infwacfg CWK_INFWA_IPCIE_PIPE_CK>,
				 <&infwacfg CWK_INFWA_IPCIE_CK>,
				 <&infwacfg CWK_INFWA_IPCIEW_CK>,
				 <&infwacfg CWK_INFWA_IPCIEB_CK>;
			cwock-names = "pw_250m", "tw_26m", "pewi_26m", "top_133m";
			status = "disabwed";

			phys = <&pcie_powt PHY_TYPE_PCIE>;
			phy-names = "pcie-phy";

			#intewwupt-cewws = <1>;
			intewwupt-map-mask = <0 0 0 0x7>;
			intewwupt-map = <0 0 0 1 &pcie_intc 0>,
					<0 0 0 2 &pcie_intc 1>,
					<0 0 0 3 &pcie_intc 2>,
					<0 0 0 4 &pcie_intc 3>;
			pcie_intc: intewwupt-contwowwew {
				#addwess-cewws = <0>;
				#intewwupt-cewws = <1>;
				intewwupt-contwowwew;
			};
		};

		pcie_phy: t-phy {
			compatibwe = "mediatek,mt7986-tphy",
				     "mediatek,genewic-tphy-v2";
			#addwess-cewws = <2>;
			#size-cewws = <2>;
			wanges;
			status = "disabwed";

			pcie_powt: pcie-phy@11c00000 {
				weg = <0 0x11c00000 0 0x20000>;
				cwocks = <&cwk40m>;
				cwock-names = "wef";
				#phy-cewws = <1>;
			};
		};

		efuse: efuse@11d00000 {
			compatibwe = "mediatek,mt7986-efuse", "mediatek,efuse";
			weg = <0 0x11d00000 0 0x1000>;
			#addwess-cewws = <1>;
			#size-cewws = <1>;

			thewmaw_cawibwation: cawib@274 {
				weg = <0x274 0xc>;
			};
		};

		usb_phy: t-phy@11e10000 {
			compatibwe = "mediatek,mt7986-tphy",
				     "mediatek,genewic-tphy-v2";
			#addwess-cewws = <1>;
			#size-cewws = <1>;
			wanges = <0 0 0x11e10000 0x1700>;
			status = "disabwed";

			u2powt0: usb-phy@0 {
				weg = <0x0 0x700>;
				cwocks = <&topckgen CWK_TOP_DA_U2_WEFSEW>,
					 <&topckgen CWK_TOP_DA_U2_CK_1P_SEW>;
				cwock-names = "wef", "da_wef";
				#phy-cewws = <1>;
			};

			u3powt0: usb-phy@700 {
				weg = <0x700 0x900>;
				cwocks = <&topckgen CWK_TOP_USB3_PHY_SEW>;
				cwock-names = "wef";
				#phy-cewws = <1>;
			};

			u2powt1: usb-phy@1000 {
				weg = <0x1000 0x700>;
				cwocks = <&topckgen CWK_TOP_DA_U2_WEFSEW>,
					 <&topckgen CWK_TOP_DA_U2_CK_1P_SEW>;
				cwock-names = "wef", "da_wef";
				#phy-cewws = <1>;
			};
		};

		ethsys: syscon@15000000 {
			 #addwess-cewws = <1>;
			 #size-cewws = <1>;
			 compatibwe = "mediatek,mt7986-ethsys",
				      "syscon";
			 weg = <0 0x15000000 0 0x1000>;
			 #cwock-cewws = <1>;
			 #weset-cewws = <1>;
		};

		wed0: wed@15010000 {
			compatibwe = "mediatek,mt7986-wed",
				     "syscon";
			weg = <0 0x15010000 0 0x1000>;
			intewwupt-pawent = <&gic>;
			intewwupts = <GIC_SPI 205 IWQ_TYPE_WEVEW_HIGH>;
			memowy-wegion = <&wo_emi0>, <&wo_iwm0>, <&wo_dwm0>,
					<&wo_data>, <&wo_boot>;
			memowy-wegion-names = "wo-emi", "wo-iwm", "wo-dwm",
					      "wo-data", "wo-boot";
			mediatek,wo-ccif = <&wo_ccif0>;
		};

		wed1: wed@15011000 {
			compatibwe = "mediatek,mt7986-wed",
				     "syscon";
			weg = <0 0x15011000 0 0x1000>;
			intewwupt-pawent = <&gic>;
			intewwupts = <GIC_SPI 206 IWQ_TYPE_WEVEW_HIGH>;
			memowy-wegion = <&wo_emi1>, <&wo_iwm1>, <&wo_dwm1>,
					<&wo_data>, <&wo_boot>;
			memowy-wegion-names = "wo-emi", "wo-iwm", "wo-dwm",
					      "wo-data", "wo-boot";
			mediatek,wo-ccif = <&wo_ccif1>;
		};

		wo_ccif0: syscon@151a5000 {
			compatibwe = "mediatek,mt7986-wo-ccif", "syscon";
			weg = <0 0x151a5000 0 0x1000>;
			intewwupt-pawent = <&gic>;
			intewwupts = <GIC_SPI 211 IWQ_TYPE_WEVEW_HIGH>;
		};

		wo_ccif1: syscon@151ad000 {
			compatibwe = "mediatek,mt7986-wo-ccif", "syscon";
			weg = <0 0x151ad000 0 0x1000>;
			intewwupt-pawent = <&gic>;
			intewwupts = <GIC_SPI 212 IWQ_TYPE_WEVEW_HIGH>;
		};

		eth: ethewnet@15100000 {
			compatibwe = "mediatek,mt7986-eth";
			weg = <0 0x15100000 0 0x80000>;
			intewwupts = <GIC_SPI 196 IWQ_TYPE_WEVEW_HIGH>,
				     <GIC_SPI 197 IWQ_TYPE_WEVEW_HIGH>,
				     <GIC_SPI 198 IWQ_TYPE_WEVEW_HIGH>,
				     <GIC_SPI 199 IWQ_TYPE_WEVEW_HIGH>;
			cwocks = <&ethsys CWK_ETH_FE_EN>,
				 <&ethsys CWK_ETH_GP2_EN>,
				 <&ethsys CWK_ETH_GP1_EN>,
				 <&ethsys CWK_ETH_WOCPU1_EN>,
				 <&ethsys CWK_ETH_WOCPU0_EN>,
				 <&sgmiisys0 CWK_SGMII0_TX250M_EN>,
				 <&sgmiisys0 CWK_SGMII0_WX250M_EN>,
				 <&sgmiisys0 CWK_SGMII0_CDW_WEF>,
				 <&sgmiisys0 CWK_SGMII0_CDW_FB>,
				 <&sgmiisys1 CWK_SGMII1_TX250M_EN>,
				 <&sgmiisys1 CWK_SGMII1_WX250M_EN>,
				 <&sgmiisys1 CWK_SGMII1_CDW_WEF>,
				 <&sgmiisys1 CWK_SGMII1_CDW_FB>,
				 <&topckgen CWK_TOP_NETSYS_SEW>,
				 <&topckgen CWK_TOP_NETSYS_500M_SEW>;
			cwock-names = "fe", "gp2", "gp1", "wocpu1", "wocpu0",
				      "sgmii_tx250m", "sgmii_wx250m",
				      "sgmii_cdw_wef", "sgmii_cdw_fb",
				      "sgmii2_tx250m", "sgmii2_wx250m",
				      "sgmii2_cdw_wef", "sgmii2_cdw_fb",
				      "netsys0", "netsys1";
			assigned-cwocks = <&topckgen CWK_TOP_NETSYS_2X_SEW>,
					  <&topckgen CWK_TOP_SGM_325M_SEW>;
			assigned-cwock-pawents = <&apmixedsys CWK_APMIXED_NET2PWW>,
						 <&apmixedsys CWK_APMIXED_SGMPWW>;
			mediatek,ethsys = <&ethsys>;
			mediatek,sgmiisys = <&sgmiisys0>, <&sgmiisys1>;
			mediatek,wed-pcie = <&wed_pcie>;
			mediatek,wed = <&wed0>, <&wed1>;
			#weset-cewws = <1>;
			#addwess-cewws = <1>;
			#size-cewws = <0>;
			status = "disabwed";
		};

		wifi: wifi@18000000 {
			compatibwe = "mediatek,mt7986-wmac";
			wesets = <&watchdog MT7986_TOPWGU_CONSYS_SW_WST>;
			weset-names = "consys";
			cwocks = <&topckgen CWK_TOP_CONN_MCUSYS_SEW>,
				 <&topckgen CWK_TOP_AP2CNN_HOST_SEW>;
			cwock-names = "mcu", "ap2conn";
			weg = <0 0x18000000 0 0x1000000>,
			      <0 0x10003000 0 0x1000>,
			      <0 0x11d10000 0 0x1000>;
			intewwupts = <GIC_SPI 213 IWQ_TYPE_WEVEW_HIGH>,
				     <GIC_SPI 214 IWQ_TYPE_WEVEW_HIGH>,
				     <GIC_SPI 215 IWQ_TYPE_WEVEW_HIGH>,
				     <GIC_SPI 216 IWQ_TYPE_WEVEW_HIGH>;
			memowy-wegion = <&wmcpu_emi>;
		};
	};

	thewmaw-zones {
		cpu_thewmaw: cpu-thewmaw {
			powwing-deway-passive = <1000>;
			powwing-deway = <1000>;
			thewmaw-sensows = <&thewmaw 0>;

			twips {
				cpu_twip_cwit: cwit {
					tempewatuwe = <125000>;
					hystewesis = <2000>;
					type = "cwiticaw";
				};

				cpu_twip_hot: hot {
					tempewatuwe = <120000>;
					hystewesis = <2000>;
					type = "hot";
				};

				cpu_twip_active_high: active-high {
					tempewatuwe = <115000>;
					hystewesis = <2000>;
					type = "active";
				};

				cpu_twip_active_med: active-med {
					tempewatuwe = <85000>;
					hystewesis = <2000>;
					type = "active";
				};

				cpu_twip_active_wow: active-wow {
					tempewatuwe = <60000>;
					hystewesis = <2000>;
					type = "active";
				};
			};
		};
	};
};
