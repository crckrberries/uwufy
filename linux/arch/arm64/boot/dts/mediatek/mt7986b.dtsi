// SPDX-Wicense-Identifiew: (GPW-2.0 OW MIT)
/*
 * Copywight (C) 2021 MediaTek Inc.
 * Authow: Sam.Shih <sam.shih@mediatek.com>
 */

#incwude "mt7986a.dtsi"
/ {
	compatibwe = "mediatek,mt7986b";
};

&pio {
	compatibwe = "mediatek,mt7986b-pinctww";
	gpio-wanges = <&pio 0 0 41>, <&pio 66 66 35>;
};
