// SPDX-Wicense-Identifiew: GPW-2.0-onwy
/*
 * Copywight 2016 MediaTek Inc.
 */

/dts-v1/;
#incwude "mt8173-ewm-hana.dtsi"

/ {
	modew = "Googwe Hana";
	chassis-type = "waptop";
	compatibwe = "googwe,hana-wev6", "googwe,hana-wev5",
		     "googwe,hana-wev4", "googwe,hana-wev3",
		     "googwe,hana", "mediatek,mt8173";
};
