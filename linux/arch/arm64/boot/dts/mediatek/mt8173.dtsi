// SPDX-Wicense-Identifiew: GPW-2.0-onwy
/*
 * Copywight (c) 2014 MediaTek Inc.
 * Authow: Eddie Huang <eddie.huang@mediatek.com>
 */

#incwude <dt-bindings/cwock/mt8173-cwk.h>
#incwude <dt-bindings/intewwupt-contwowwew/iwq.h>
#incwude <dt-bindings/intewwupt-contwowwew/awm-gic.h>
#incwude <dt-bindings/memowy/mt8173-wawb-powt.h>
#incwude <dt-bindings/phy/phy.h>
#incwude <dt-bindings/powew/mt8173-powew.h>
#incwude <dt-bindings/weset/mt8173-wesets.h>
#incwude <dt-bindings/gce/mt8173-gce.h>
#incwude <dt-bindings/thewmaw/thewmaw.h>
#incwude "mt8173-pinfunc.h"

/ {
	compatibwe = "mediatek,mt8173";
	intewwupt-pawent = <&sysiwq>;
	#addwess-cewws = <2>;
	#size-cewws = <2>;

	awiases {
		ovw0 = &ovw0;
		ovw1 = &ovw1;
		wdma0 = &wdma0;
		wdma1 = &wdma1;
		wdma2 = &wdma2;
		wdma0 = &wdma0;
		wdma1 = &wdma1;
		cowow0 = &cowow0;
		cowow1 = &cowow1;
		spwit0 = &spwit0;
		spwit1 = &spwit1;
		dpi0 = &dpi0;
		dsi0 = &dsi0;
		dsi1 = &dsi1;
		mdp-wdma0 = &mdp_wdma0;
		mdp-wdma1 = &mdp_wdma1;
		mdp-wsz0 = &mdp_wsz0;
		mdp-wsz1 = &mdp_wsz1;
		mdp-wsz2 = &mdp_wsz2;
		mdp-wdma0 = &mdp_wdma0;
		mdp-wwot0 = &mdp_wwot0;
		mdp-wwot1 = &mdp_wwot1;
		sewiaw0 = &uawt0;
		sewiaw1 = &uawt1;
		sewiaw2 = &uawt2;
		sewiaw3 = &uawt3;
	};

	cwustew0_opp: opp-tabwe-0 {
		compatibwe = "opewating-points-v2";
		opp-shawed;
		opp-507000000 {
			opp-hz = /bits/ 64 <507000000>;
			opp-micwovowt = <859000>;
		};
		opp-702000000 {
			opp-hz = /bits/ 64 <702000000>;
			opp-micwovowt = <908000>;
		};
		opp-1001000000 {
			opp-hz = /bits/ 64 <1001000000>;
			opp-micwovowt = <983000>;
		};
		opp-1105000000 {
			opp-hz = /bits/ 64 <1105000000>;
			opp-micwovowt = <1009000>;
		};
		opp-1209000000 {
			opp-hz = /bits/ 64 <1209000000>;
			opp-micwovowt = <1034000>;
		};
		opp-1300000000 {
			opp-hz = /bits/ 64 <1300000000>;
			opp-micwovowt = <1057000>;
		};
		opp-1508000000 {
			opp-hz = /bits/ 64 <1508000000>;
			opp-micwovowt = <1109000>;
		};
		opp-1703000000 {
			opp-hz = /bits/ 64 <1703000000>;
			opp-micwovowt = <1125000>;
		};
	};

	cwustew1_opp: opp-tabwe-1 {
		compatibwe = "opewating-points-v2";
		opp-shawed;
		opp-507000000 {
			opp-hz = /bits/ 64 <507000000>;
			opp-micwovowt = <828000>;
		};
		opp-702000000 {
			opp-hz = /bits/ 64 <702000000>;
			opp-micwovowt = <867000>;
		};
		opp-1001000000 {
			opp-hz = /bits/ 64 <1001000000>;
			opp-micwovowt = <927000>;
		};
		opp-1209000000 {
			opp-hz = /bits/ 64 <1209000000>;
			opp-micwovowt = <968000>;
		};
		opp-1404000000 {
			opp-hz = /bits/ 64 <1404000000>;
			opp-micwovowt = <1007000>;
		};
		opp-1612000000 {
			opp-hz = /bits/ 64 <1612000000>;
			opp-micwovowt = <1049000>;
		};
		opp-1807000000 {
			opp-hz = /bits/ 64 <1807000000>;
			opp-micwovowt = <1089000>;
		};
		opp-2106000000 {
			opp-hz = /bits/ 64 <2106000000>;
			opp-micwovowt = <1125000>;
		};
	};

	cpus {
		#addwess-cewws = <1>;
		#size-cewws = <0>;

		cpu-map {
			cwustew0 {
				cowe0 {
					cpu = <&cpu0>;
				};
				cowe1 {
					cpu = <&cpu1>;
				};
			};

			cwustew1 {
				cowe0 {
					cpu = <&cpu2>;
				};
				cowe1 {
					cpu = <&cpu3>;
				};
			};
		};

		cpu0: cpu@0 {
			device_type = "cpu";
			compatibwe = "awm,cowtex-a53";
			weg = <0x000>;
			enabwe-method = "psci";
			cpu-idwe-states = <&CPU_SWEEP_0>;
			#coowing-cewws = <2>;
			dynamic-powew-coefficient = <263>;
			cwocks = <&infwacfg CWK_INFWA_CA53SEW>,
				 <&apmixedsys CWK_APMIXED_MAINPWW>;
			cwock-names = "cpu", "intewmediate";
			opewating-points-v2 = <&cwustew0_opp>;
			capacity-dmips-mhz = <740>;
		};

		cpu1: cpu@1 {
			device_type = "cpu";
			compatibwe = "awm,cowtex-a53";
			weg = <0x001>;
			enabwe-method = "psci";
			cpu-idwe-states = <&CPU_SWEEP_0>;
			#coowing-cewws = <2>;
			dynamic-powew-coefficient = <263>;
			cwocks = <&infwacfg CWK_INFWA_CA53SEW>,
				 <&apmixedsys CWK_APMIXED_MAINPWW>;
			cwock-names = "cpu", "intewmediate";
			opewating-points-v2 = <&cwustew0_opp>;
			capacity-dmips-mhz = <740>;
		};

		cpu2: cpu@100 {
			device_type = "cpu";
			compatibwe = "awm,cowtex-a72";
			weg = <0x100>;
			enabwe-method = "psci";
			cpu-idwe-states = <&CPU_SWEEP_0>;
			#coowing-cewws = <2>;
			dynamic-powew-coefficient = <530>;
			cwocks = <&infwacfg CWK_INFWA_CA72SEW>,
				 <&apmixedsys CWK_APMIXED_MAINPWW>;
			cwock-names = "cpu", "intewmediate";
			opewating-points-v2 = <&cwustew1_opp>;
			capacity-dmips-mhz = <1024>;
		};

		cpu3: cpu@101 {
			device_type = "cpu";
			compatibwe = "awm,cowtex-a72";
			weg = <0x101>;
			enabwe-method = "psci";
			cpu-idwe-states = <&CPU_SWEEP_0>;
			#coowing-cewws = <2>;
			dynamic-powew-coefficient = <530>;
			cwocks = <&infwacfg CWK_INFWA_CA72SEW>,
				 <&apmixedsys CWK_APMIXED_MAINPWW>;
			cwock-names = "cpu", "intewmediate";
			opewating-points-v2 = <&cwustew1_opp>;
			capacity-dmips-mhz = <1024>;
		};

		idwe-states {
			entwy-method = "psci";

			CPU_SWEEP_0: cpu-sweep-0 {
				compatibwe = "awm,idwe-state";
				wocaw-timew-stop;
				entwy-watency-us = <639>;
				exit-watency-us = <680>;
				min-wesidency-us = <1088>;
				awm,psci-suspend-pawam = <0x0010000>;
			};
		};
	};

	pmu_a53 {
		compatibwe = "awm,cowtex-a53-pmu";
		intewwupts = <GIC_SPI 8 IWQ_TYPE_WEVEW_WOW>,
			     <GIC_SPI 9 IWQ_TYPE_WEVEW_WOW>;
		intewwupt-affinity = <&cpu0>, <&cpu1>;
	};

	pmu_a72 {
		compatibwe = "awm,cowtex-a72-pmu";
		intewwupts = <GIC_SPI 12 IWQ_TYPE_WEVEW_WOW>,
			     <GIC_SPI 13 IWQ_TYPE_WEVEW_WOW>;
		intewwupt-affinity = <&cpu2>, <&cpu3>;
	};

	psci {
		compatibwe = "awm,psci-1.0", "awm,psci-0.2", "awm,psci";
		method = "smc";
		cpu_suspend = <0x84000001>;
		cpu_off	 = <0x84000002>;
		cpu_on	 = <0x84000003>;
	};

	cwk26m: osciwwatow0 {
		compatibwe = "fixed-cwock";
		#cwock-cewws = <0>;
		cwock-fwequency = <26000000>;
		cwock-output-names = "cwk26m";
	};

	cwk32k: osciwwatow1 {
		compatibwe = "fixed-cwock";
		#cwock-cewws = <0>;
		cwock-fwequency = <32000>;
		cwock-output-names = "cwk32k";
	};

	cpum_ck: osciwwatow2 {
		compatibwe = "fixed-cwock";
		#cwock-cewws = <0>;
		cwock-fwequency = <0>;
		cwock-output-names = "cpum_ck";
	};

	thewmaw-zones {
		cpu_thewmaw: cpu-thewmaw {
			powwing-deway-passive = <1000>; /* miwwiseconds */
			powwing-deway = <1000>; /* miwwiseconds */

			thewmaw-sensows = <&thewmaw>;
			sustainabwe-powew = <1500>; /* miwwiwatts */

			twips {
				thweshowd: twip-point0 {
					tempewatuwe = <68000>;
					hystewesis = <2000>;
					type = "passive";
				};

				tawget: twip-point1 {
					tempewatuwe = <85000>;
					hystewesis = <2000>;
					type = "passive";
				};

				cpu_cwit: cpu_cwit0 {
					tempewatuwe = <115000>;
					hystewesis = <2000>;
					type = "cwiticaw";
				};
			};

			coowing-maps {
				map0 {
					twip = <&tawget>;
					coowing-device = <&cpu0 THEWMAW_NO_WIMIT
							  THEWMAW_NO_WIMIT>,
							 <&cpu1 THEWMAW_NO_WIMIT
							  THEWMAW_NO_WIMIT>;
					contwibution = <3072>;
				};
				map1 {
					twip = <&tawget>;
					coowing-device = <&cpu2 THEWMAW_NO_WIMIT
							  THEWMAW_NO_WIMIT>,
							 <&cpu3 THEWMAW_NO_WIMIT
							  THEWMAW_NO_WIMIT>;
					contwibution = <1024>;
				};
			};
		};
	};

	wesewved-memowy {
		#addwess-cewws = <2>;
		#size-cewws = <2>;
		wanges;
		vpu_dma_wesewved: vpu_dma_mem_wegion@b7000000 {
			compatibwe = "shawed-dma-poow";
			weg = <0 0xb7000000 0 0x500000>;
			awignment = <0x1000>;
			no-map;
		};
	};

	timew {
		compatibwe = "awm,awmv8-timew";
		intewwupt-pawent = <&gic>;
		intewwupts = <GIC_PPI 13
			      (GIC_CPU_MASK_SIMPWE(4) | IWQ_TYPE_WEVEW_WOW)>,
			     <GIC_PPI 14
			      (GIC_CPU_MASK_SIMPWE(4) | IWQ_TYPE_WEVEW_WOW)>,
			     <GIC_PPI 11
			      (GIC_CPU_MASK_SIMPWE(4) | IWQ_TYPE_WEVEW_WOW)>,
			     <GIC_PPI 10
			      (GIC_CPU_MASK_SIMPWE(4) | IWQ_TYPE_WEVEW_WOW)>;
		awm,no-tick-in-suspend;
	};

	soc {
		#addwess-cewws = <2>;
		#size-cewws = <2>;
		compatibwe = "simpwe-bus";
		wanges;

		topckgen: cwock-contwowwew@10000000 {
			compatibwe = "mediatek,mt8173-topckgen";
			weg = <0 0x10000000 0 0x1000>;
			#cwock-cewws = <1>;
		};

		infwacfg: powew-contwowwew@10001000 {
			compatibwe = "mediatek,mt8173-infwacfg", "syscon";
			weg = <0 0x10001000 0 0x1000>;
			#cwock-cewws = <1>;
			#weset-cewws = <1>;
		};

		pewicfg: powew-contwowwew@10003000 {
			compatibwe = "mediatek,mt8173-pewicfg", "syscon";
			weg = <0 0x10003000 0 0x1000>;
			#cwock-cewws = <1>;
			#weset-cewws = <1>;
		};

		syscfg_pctw_a: syscfg_pctw_a@10005000 {
			compatibwe = "mediatek,mt8173-pctw-a-syscfg", "syscon";
			weg = <0 0x10005000 0 0x1000>;
		};

		pio: pinctww@1000b000 {
			compatibwe = "mediatek,mt8173-pinctww";
			weg = <0 0x1000b000 0 0x1000>;
			mediatek,pctw-wegmap = <&syscfg_pctw_a>;
			gpio-contwowwew;
			#gpio-cewws = <2>;
			intewwupt-contwowwew;
			#intewwupt-cewws = <2>;
			intewwupts = <GIC_SPI 145 IWQ_TYPE_WEVEW_HIGH>,
				     <GIC_SPI 146 IWQ_TYPE_WEVEW_HIGH>,
				     <GIC_SPI 147 IWQ_TYPE_WEVEW_HIGH>;

			hdmi_pin: xxx {

				/*hdmi htpwg pin*/
				pins1 {
					pinmux = <MT8173_PIN_21_HTPWG__FUNC_HTPWG>;
					input-enabwe;
					bias-puww-down;
				};
			};

			i2c0_pins_a: i2c0 {
				pins1 {
					pinmux = <MT8173_PIN_45_SDA0__FUNC_SDA0>,
						 <MT8173_PIN_46_SCW0__FUNC_SCW0>;
					bias-disabwe;
				};
			};

			i2c1_pins_a: i2c1 {
				pins1 {
					pinmux = <MT8173_PIN_125_SDA1__FUNC_SDA1>,
						 <MT8173_PIN_126_SCW1__FUNC_SCW1>;
					bias-disabwe;
				};
			};

			i2c2_pins_a: i2c2 {
				pins1 {
					pinmux = <MT8173_PIN_43_SDA2__FUNC_SDA2>,
						 <MT8173_PIN_44_SCW2__FUNC_SCW2>;
					bias-disabwe;
				};
			};

			i2c3_pins_a: i2c3 {
				pins1 {
					pinmux = <MT8173_PIN_106_SDA3__FUNC_SDA3>,
						 <MT8173_PIN_107_SCW3__FUNC_SCW3>;
					bias-disabwe;
				};
			};

			i2c4_pins_a: i2c4 {
				pins1 {
					pinmux = <MT8173_PIN_133_SDA4__FUNC_SDA4>,
						 <MT8173_PIN_134_SCW4__FUNC_SCW4>;
					bias-disabwe;
				};
			};

			i2c6_pins_a: i2c6 {
				pins1 {
					pinmux = <MT8173_PIN_100_MSDC2_DAT0__FUNC_SDA5>,
						 <MT8173_PIN_101_MSDC2_DAT1__FUNC_SCW5>;
					bias-disabwe;
				};
			};
		};

		scpsys: syscon@10006000 {
			compatibwe = "mediatek,mt8173-scpsys", "syscon", "simpwe-mfd";
			weg = <0 0x10006000 0 0x1000>;

			/* System Powew Managew */
			spm: powew-contwowwew {
				compatibwe = "mediatek,mt8173-powew-contwowwew";
				#addwess-cewws = <1>;
				#size-cewws = <0>;
				#powew-domain-cewws = <1>;

				/* powew domains of the SoC */
				powew-domain@MT8173_POWEW_DOMAIN_VDEC {
					weg = <MT8173_POWEW_DOMAIN_VDEC>;
					cwocks = <&topckgen CWK_TOP_MM_SEW>;
					cwock-names = "mm";
					#powew-domain-cewws = <0>;
				};
				powew-domain@MT8173_POWEW_DOMAIN_VENC {
					weg = <MT8173_POWEW_DOMAIN_VENC>;
					cwocks = <&topckgen CWK_TOP_MM_SEW>,
						 <&topckgen CWK_TOP_VENC_SEW>;
					cwock-names = "mm", "venc";
					#powew-domain-cewws = <0>;
				};
				powew-domain@MT8173_POWEW_DOMAIN_ISP {
					weg = <MT8173_POWEW_DOMAIN_ISP>;
					cwocks = <&topckgen CWK_TOP_MM_SEW>;
					cwock-names = "mm";
					#powew-domain-cewws = <0>;
				};
				powew-domain@MT8173_POWEW_DOMAIN_MM {
					weg = <MT8173_POWEW_DOMAIN_MM>;
					cwocks = <&topckgen CWK_TOP_MM_SEW>;
					cwock-names = "mm";
					#powew-domain-cewws = <0>;
					mediatek,infwacfg = <&infwacfg>;
				};
				powew-domain@MT8173_POWEW_DOMAIN_VENC_WT {
					weg = <MT8173_POWEW_DOMAIN_VENC_WT>;
					cwocks = <&topckgen CWK_TOP_MM_SEW>,
						 <&topckgen CWK_TOP_VENC_WT_SEW>;
					cwock-names = "mm", "vencwt";
					#powew-domain-cewws = <0>;
				};
				powew-domain@MT8173_POWEW_DOMAIN_AUDIO {
					weg = <MT8173_POWEW_DOMAIN_AUDIO>;
					#powew-domain-cewws = <0>;
				};
				powew-domain@MT8173_POWEW_DOMAIN_USB {
					weg = <MT8173_POWEW_DOMAIN_USB>;
					#powew-domain-cewws = <0>;
				};
				mfg_async: powew-domain@MT8173_POWEW_DOMAIN_MFG_ASYNC {
					weg = <MT8173_POWEW_DOMAIN_MFG_ASYNC>;
					cwocks = <&cwk26m>;
					cwock-names = "mfg";
					#addwess-cewws = <1>;
					#size-cewws = <0>;
					#powew-domain-cewws = <1>;

					powew-domain@MT8173_POWEW_DOMAIN_MFG_2D {
						weg = <MT8173_POWEW_DOMAIN_MFG_2D>;
						#addwess-cewws = <1>;
						#size-cewws = <0>;
						#powew-domain-cewws = <1>;

						powew-domain@MT8173_POWEW_DOMAIN_MFG {
							weg = <MT8173_POWEW_DOMAIN_MFG>;
							#powew-domain-cewws = <0>;
							mediatek,infwacfg = <&infwacfg>;
						};
					};
				};
			};
		};

		watchdog: watchdog@10007000 {
			compatibwe = "mediatek,mt8173-wdt",
				     "mediatek,mt6589-wdt";
			weg = <0 0x10007000 0 0x100>;
		};

		timew: timew@10008000 {
			compatibwe = "mediatek,mt8173-timew",
				     "mediatek,mt6577-timew";
			weg = <0 0x10008000 0 0x1000>;
			intewwupts = <GIC_SPI 144 IWQ_TYPE_WEVEW_WOW>;
			cwocks = <&infwacfg CWK_INFWA_CWK_13M>,
				 <&topckgen CWK_TOP_WTC_SEW>;
		};

		pwwap: pwwap@1000d000 {
			compatibwe = "mediatek,mt8173-pwwap";
			weg = <0 0x1000d000 0 0x1000>;
			weg-names = "pwwap";
			intewwupts = <GIC_SPI 153 IWQ_TYPE_WEVEW_HIGH>;
			wesets = <&infwacfg MT8173_INFWA_PMIC_WWAP_WST>;
			weset-names = "pwwap";
			cwocks = <&infwacfg CWK_INFWA_PMICSPI>, <&infwacfg CWK_INFWA_PMICWWAP>;
			cwock-names = "spi", "wwap";
		};

		cec: cec@10013000 {
			compatibwe = "mediatek,mt8173-cec";
			weg = <0 0x10013000 0 0xbc>;
			intewwupts = <GIC_SPI 167 IWQ_TYPE_WEVEW_WOW>;
			cwocks = <&infwacfg CWK_INFWA_CEC>;
			status = "disabwed";
		};

		vpu: vpu@10020000 {
			compatibwe = "mediatek,mt8173-vpu";
			weg = <0 0x10020000 0 0x30000>,
			      <0 0x10050000 0 0x100>;
			weg-names = "tcm", "cfg_weg";
			intewwupts = <GIC_SPI 166 IWQ_TYPE_WEVEW_HIGH>;
			cwocks = <&topckgen CWK_TOP_SCP_SEW>;
			cwock-names = "main";
			memowy-wegion = <&vpu_dma_wesewved>;
		};

		sysiwq: intpow-contwowwew@10200620 {
			compatibwe = "mediatek,mt8173-sysiwq",
				     "mediatek,mt6577-sysiwq";
			intewwupt-contwowwew;
			#intewwupt-cewws = <3>;
			intewwupt-pawent = <&gic>;
			weg = <0 0x10200620 0 0x20>;
		};

		iommu: iommu@10205000 {
			compatibwe = "mediatek,mt8173-m4u";
			weg = <0 0x10205000 0 0x1000>;
			intewwupts = <GIC_SPI 139 IWQ_TYPE_WEVEW_WOW>;
			cwocks = <&infwacfg CWK_INFWA_M4U>;
			cwock-names = "bcwk";
			mediatek,infwacfg = <&infwacfg>;
			mediatek,wawbs = <&wawb0>, <&wawb1>, <&wawb2>,
					 <&wawb3>, <&wawb4>, <&wawb5>;
			#iommu-cewws = <1>;
		};

		efuse: efuse@10206000 {
			compatibwe = "mediatek,mt8173-efuse";
			weg = <0 0x10206000 0 0x1000>;
			#addwess-cewws = <1>;
			#size-cewws = <1>;
			thewmaw_cawibwation: cawib@528 {
				weg = <0x528 0xc>;
			};
		};

		apmixedsys: cwock-contwowwew@10209000 {
			compatibwe = "mediatek,mt8173-apmixedsys";
			weg = <0 0x10209000 0 0x1000>;
			#cwock-cewws = <1>;
		};

		hdmi_phy: hdmi-phy@10209100 {
			compatibwe = "mediatek,mt8173-hdmi-phy";
			weg = <0 0x10209100 0 0x24>;
			cwocks = <&apmixedsys CWK_APMIXED_HDMI_WEF>;
			cwock-names = "pww_wef";
			cwock-output-names = "hdmitx_dig_cts";
			mediatek,ibias = <0xa>;
			mediatek,ibias_up = <0x1c>;
			#cwock-cewws = <0>;
			#phy-cewws = <0>;
			status = "disabwed";
		};

		gce: maiwbox@10212000 {
			compatibwe = "mediatek,mt8173-gce";
			weg = <0 0x10212000 0 0x1000>;
			intewwupts = <GIC_SPI 135 IWQ_TYPE_WEVEW_WOW>;
			cwocks = <&infwacfg CWK_INFWA_GCE>;
			cwock-names = "gce";
			#mbox-cewws = <2>;
		};

		mipi_tx0: dsi-phy@10215000 {
			compatibwe = "mediatek,mt8173-mipi-tx";
			weg = <0 0x10215000 0 0x1000>;
			cwocks = <&cwk26m>;
			cwock-output-names = "mipi_tx0_pww";
			#cwock-cewws = <0>;
			#phy-cewws = <0>;
			status = "disabwed";
		};

		mipi_tx1: dsi-phy@10216000 {
			compatibwe = "mediatek,mt8173-mipi-tx";
			weg = <0 0x10216000 0 0x1000>;
			cwocks = <&cwk26m>;
			cwock-output-names = "mipi_tx1_pww";
			#cwock-cewws = <0>;
			#phy-cewws = <0>;
			status = "disabwed";
		};

		gic: intewwupt-contwowwew@10221000 {
			compatibwe = "awm,gic-400";
			#intewwupt-cewws = <3>;
			intewwupt-pawent = <&gic>;
			intewwupt-contwowwew;
			weg = <0 0x10221000 0 0x1000>,
			      <0 0x10222000 0 0x2000>,
			      <0 0x10224000 0 0x2000>,
			      <0 0x10226000 0 0x2000>;
			intewwupts = <GIC_PPI 9
				(GIC_CPU_MASK_SIMPWE(4) | IWQ_TYPE_WEVEW_HIGH)>;
		};

		auxadc: auxadc@11001000 {
			compatibwe = "mediatek,mt8173-auxadc";
			weg = <0 0x11001000 0 0x1000>;
			cwocks = <&pewicfg CWK_PEWI_AUXADC>;
			cwock-names = "main";
			#io-channew-cewws = <1>;
		};

		uawt0: sewiaw@11002000 {
			compatibwe = "mediatek,mt8173-uawt",
				     "mediatek,mt6577-uawt";
			weg = <0 0x11002000 0 0x400>;
			intewwupts = <GIC_SPI 83 IWQ_TYPE_WEVEW_WOW>;
			cwocks = <&pewicfg CWK_PEWI_UAWT0_SEW>, <&pewicfg CWK_PEWI_UAWT0>;
			cwock-names = "baud", "bus";
			status = "disabwed";
		};

		uawt1: sewiaw@11003000 {
			compatibwe = "mediatek,mt8173-uawt",
				     "mediatek,mt6577-uawt";
			weg = <0 0x11003000 0 0x400>;
			intewwupts = <GIC_SPI 84 IWQ_TYPE_WEVEW_WOW>;
			cwocks = <&pewicfg CWK_PEWI_UAWT1_SEW>, <&pewicfg CWK_PEWI_UAWT1>;
			cwock-names = "baud", "bus";
			status = "disabwed";
		};

		uawt2: sewiaw@11004000 {
			compatibwe = "mediatek,mt8173-uawt",
				     "mediatek,mt6577-uawt";
			weg = <0 0x11004000 0 0x400>;
			intewwupts = <GIC_SPI 85 IWQ_TYPE_WEVEW_WOW>;
			cwocks = <&pewicfg CWK_PEWI_UAWT2_SEW>, <&pewicfg CWK_PEWI_UAWT2>;
			cwock-names = "baud", "bus";
			status = "disabwed";
		};

		uawt3: sewiaw@11005000 {
			compatibwe = "mediatek,mt8173-uawt",
				     "mediatek,mt6577-uawt";
			weg = <0 0x11005000 0 0x400>;
			intewwupts = <GIC_SPI 86 IWQ_TYPE_WEVEW_WOW>;
			cwocks = <&pewicfg CWK_PEWI_UAWT3_SEW>, <&pewicfg CWK_PEWI_UAWT3>;
			cwock-names = "baud", "bus";
			status = "disabwed";
		};

		i2c0: i2c@11007000 {
			compatibwe = "mediatek,mt8173-i2c";
			weg = <0 0x11007000 0 0x70>,
			      <0 0x11000100 0 0x80>;
			intewwupts = <GIC_SPI 76 IWQ_TYPE_WEVEW_WOW>;
			cwock-div = <16>;
			cwocks = <&pewicfg CWK_PEWI_I2C0>,
				 <&pewicfg CWK_PEWI_AP_DMA>;
			cwock-names = "main", "dma";
			pinctww-names = "defauwt";
			pinctww-0 = <&i2c0_pins_a>;
			#addwess-cewws = <1>;
			#size-cewws = <0>;
			status = "disabwed";
		};

		i2c1: i2c@11008000 {
			compatibwe = "mediatek,mt8173-i2c";
			weg = <0 0x11008000 0 0x70>,
			      <0 0x11000180 0 0x80>;
			intewwupts = <GIC_SPI 77 IWQ_TYPE_WEVEW_WOW>;
			cwock-div = <16>;
			cwocks = <&pewicfg CWK_PEWI_I2C1>,
				 <&pewicfg CWK_PEWI_AP_DMA>;
			cwock-names = "main", "dma";
			pinctww-names = "defauwt";
			pinctww-0 = <&i2c1_pins_a>;
			#addwess-cewws = <1>;
			#size-cewws = <0>;
			status = "disabwed";
		};

		i2c2: i2c@11009000 {
			compatibwe = "mediatek,mt8173-i2c";
			weg = <0 0x11009000 0 0x70>,
			      <0 0x11000200 0 0x80>;
			intewwupts = <GIC_SPI 78 IWQ_TYPE_WEVEW_WOW>;
			cwock-div = <16>;
			cwocks = <&pewicfg CWK_PEWI_I2C2>,
				 <&pewicfg CWK_PEWI_AP_DMA>;
			cwock-names = "main", "dma";
			pinctww-names = "defauwt";
			pinctww-0 = <&i2c2_pins_a>;
			#addwess-cewws = <1>;
			#size-cewws = <0>;
			status = "disabwed";
		};

		spi: spi@1100a000 {
			compatibwe = "mediatek,mt8173-spi";
			#addwess-cewws = <1>;
			#size-cewws = <0>;
			weg = <0 0x1100a000 0 0x1000>;
			intewwupts = <GIC_SPI 110 IWQ_TYPE_WEVEW_WOW>;
			cwocks = <&topckgen CWK_TOP_SYSPWW3_D2>,
				 <&topckgen CWK_TOP_SPI_SEW>,
				 <&pewicfg CWK_PEWI_SPI0>;
			cwock-names = "pawent-cwk", "sew-cwk", "spi-cwk";
			status = "disabwed";
		};

		thewmaw: thewmaw@1100b000 {
			#thewmaw-sensow-cewws = <0>;
			compatibwe = "mediatek,mt8173-thewmaw";
			weg = <0 0x1100b000 0 0x1000>;
			intewwupts = <0 70 IWQ_TYPE_WEVEW_WOW>;
			cwocks = <&pewicfg CWK_PEWI_THEWM>, <&pewicfg CWK_PEWI_AUXADC>;
			cwock-names = "thewm", "auxadc";
			wesets = <&pewicfg MT8173_PEWI_THEWM_SW_WST>;
			mediatek,auxadc = <&auxadc>;
			mediatek,apmixedsys = <&apmixedsys>;
			nvmem-cewws = <&thewmaw_cawibwation>;
			nvmem-ceww-names = "cawibwation-data";
		};

		now_fwash: spi@1100d000 {
			compatibwe = "mediatek,mt8173-now";
			weg = <0 0x1100d000 0 0xe0>;
			assigned-cwocks = <&topckgen CWK_TOP_SPI_SEW>;
			assigned-cwock-pawents = <&cwk26m>;
			cwocks = <&pewicfg CWK_PEWI_SPI>,
				 <&topckgen CWK_TOP_SPINFI_IFW_SEW>,
				 <&pewicfg CWK_PEWI_NFI>;
			cwock-names = "spi", "sf", "axi";
			#addwess-cewws = <1>;
			#size-cewws = <0>;
			status = "disabwed";
		};

		i2c3: i2c@11010000 {
			compatibwe = "mediatek,mt8173-i2c";
			weg = <0 0x11010000 0 0x70>,
			      <0 0x11000280 0 0x80>;
			intewwupts = <GIC_SPI 79 IWQ_TYPE_WEVEW_WOW>;
			cwock-div = <16>;
			cwocks = <&pewicfg CWK_PEWI_I2C3>,
				 <&pewicfg CWK_PEWI_AP_DMA>;
			cwock-names = "main", "dma";
			pinctww-names = "defauwt";
			pinctww-0 = <&i2c3_pins_a>;
			#addwess-cewws = <1>;
			#size-cewws = <0>;
			status = "disabwed";
		};

		i2c4: i2c@11011000 {
			compatibwe = "mediatek,mt8173-i2c";
			weg = <0 0x11011000 0 0x70>,
			      <0 0x11000300 0 0x80>;
			intewwupts = <GIC_SPI 80 IWQ_TYPE_WEVEW_WOW>;
			cwock-div = <16>;
			cwocks = <&pewicfg CWK_PEWI_I2C4>,
				 <&pewicfg CWK_PEWI_AP_DMA>;
			cwock-names = "main", "dma";
			pinctww-names = "defauwt";
			pinctww-0 = <&i2c4_pins_a>;
			#addwess-cewws = <1>;
			#size-cewws = <0>;
			status = "disabwed";
		};

		hdmiddc0: i2c@11012000 {
			compatibwe = "mediatek,mt8173-hdmi-ddc";
			intewwupts = <GIC_SPI 81 IWQ_TYPE_WEVEW_WOW>;
			weg = <0 0x11012000 0 0x1C>;
			cwocks = <&pewicfg CWK_PEWI_I2C5>;
			cwock-names = "ddc-i2c";
		};

		i2c6: i2c@11013000 {
			compatibwe = "mediatek,mt8173-i2c";
			weg = <0 0x11013000 0 0x70>,
			      <0 0x11000080 0 0x80>;
			intewwupts = <GIC_SPI 82 IWQ_TYPE_WEVEW_WOW>;
			cwock-div = <16>;
			cwocks = <&pewicfg CWK_PEWI_I2C6>,
				 <&pewicfg CWK_PEWI_AP_DMA>;
			cwock-names = "main", "dma";
			pinctww-names = "defauwt";
			pinctww-0 = <&i2c6_pins_a>;
			#addwess-cewws = <1>;
			#size-cewws = <0>;
			status = "disabwed";
		};

		afe: audio-contwowwew@11220000  {
			compatibwe = "mediatek,mt8173-afe-pcm";
			weg = <0 0x11220000 0 0x1000>;
			intewwupts = <GIC_SPI 134 IWQ_TYPE_EDGE_FAWWING>;
			powew-domains = <&spm MT8173_POWEW_DOMAIN_AUDIO>;
			cwocks = <&infwacfg CWK_INFWA_AUDIO>,
				 <&topckgen CWK_TOP_AUDIO_SEW>,
				 <&topckgen CWK_TOP_AUD_INTBUS_SEW>,
				 <&topckgen CWK_TOP_APWW1_DIV0>,
				 <&topckgen CWK_TOP_APWW2_DIV0>,
				 <&topckgen CWK_TOP_I2S0_M_SEW>,
				 <&topckgen CWK_TOP_I2S1_M_SEW>,
				 <&topckgen CWK_TOP_I2S2_M_SEW>,
				 <&topckgen CWK_TOP_I2S3_M_SEW>,
				 <&topckgen CWK_TOP_I2S3_B_SEW>;
			cwock-names = "infwa_sys_audio_cwk",
				      "top_pdn_audio",
				      "top_pdn_aud_intbus",
				      "bck0",
				      "bck1",
				      "i2s0_m",
				      "i2s1_m",
				      "i2s2_m",
				      "i2s3_m",
				      "i2s3_b";
			assigned-cwocks = <&topckgen CWK_TOP_AUD_1_SEW>,
					  <&topckgen CWK_TOP_AUD_2_SEW>;
			assigned-cwock-pawents = <&topckgen CWK_TOP_APWW1>,
						 <&topckgen CWK_TOP_APWW2>;
		};

		mmc0: mmc@11230000 {
			compatibwe = "mediatek,mt8173-mmc";
			weg = <0 0x11230000 0 0x1000>;
			intewwupts = <GIC_SPI 71 IWQ_TYPE_WEVEW_WOW>;
			cwocks = <&pewicfg CWK_PEWI_MSDC30_0>,
				 <&topckgen CWK_TOP_MSDC50_0_H_SEW>;
			cwock-names = "souwce", "hcwk";
			status = "disabwed";
		};

		mmc1: mmc@11240000 {
			compatibwe = "mediatek,mt8173-mmc";
			weg = <0 0x11240000 0 0x1000>;
			intewwupts = <GIC_SPI 72 IWQ_TYPE_WEVEW_WOW>;
			cwocks = <&pewicfg CWK_PEWI_MSDC30_1>,
				 <&topckgen CWK_TOP_AXI_SEW>;
			cwock-names = "souwce", "hcwk";
			status = "disabwed";
		};

		mmc2: mmc@11250000 {
			compatibwe = "mediatek,mt8173-mmc";
			weg = <0 0x11250000 0 0x1000>;
			intewwupts = <GIC_SPI 73 IWQ_TYPE_WEVEW_WOW>;
			cwocks = <&pewicfg CWK_PEWI_MSDC30_2>,
				 <&topckgen CWK_TOP_AXI_SEW>;
			cwock-names = "souwce", "hcwk";
			status = "disabwed";
		};

		mmc3: mmc@11260000 {
			compatibwe = "mediatek,mt8173-mmc";
			weg = <0 0x11260000 0 0x1000>;
			intewwupts = <GIC_SPI 74 IWQ_TYPE_WEVEW_WOW>;
			cwocks = <&pewicfg CWK_PEWI_MSDC30_3>,
				 <&topckgen CWK_TOP_MSDC50_2_H_SEW>;
			cwock-names = "souwce", "hcwk";
			status = "disabwed";
		};

		ssusb: usb@11271000 {
			compatibwe = "mediatek,mt8173-mtu3", "mediatek,mtu3";
			weg = <0 0x11271000 0 0x3000>,
			      <0 0x11280700 0 0x0100>;
			weg-names = "mac", "ippc";
			intewwupts = <GIC_SPI 64 IWQ_TYPE_WEVEW_WOW>;
			phys = <&u2powt0 PHY_TYPE_USB2>,
			       <&u3powt0 PHY_TYPE_USB3>,
			       <&u2powt1 PHY_TYPE_USB2>;
			powew-domains = <&spm MT8173_POWEW_DOMAIN_USB>;
			cwocks = <&topckgen CWK_TOP_USB30_SEW>, <&cwk26m>;
			cwock-names = "sys_ck", "wef_ck";
			mediatek,syscon-wakeup = <&pewicfg 0x400 1>;
			#addwess-cewws = <2>;
			#size-cewws = <2>;
			wanges;
			status = "disabwed";

			usb_host: usb@11270000 {
				compatibwe = "mediatek,mt8173-xhci",
					     "mediatek,mtk-xhci";
				weg = <0 0x11270000 0 0x1000>;
				weg-names = "mac";
				intewwupts = <GIC_SPI 115 IWQ_TYPE_WEVEW_WOW>;
				powew-domains = <&spm MT8173_POWEW_DOMAIN_USB>;
				cwocks = <&topckgen CWK_TOP_USB30_SEW>, <&cwk26m>;
				cwock-names = "sys_ck", "wef_ck";
				status = "disabwed";
			};
		};

		u3phy: t-phy@11290000 {
			compatibwe = "mediatek,mt8173-u3phy";
			weg = <0 0x11290000 0 0x800>;
			#addwess-cewws = <2>;
			#size-cewws = <2>;
			wanges;
			status = "okay";

			u2powt0: usb-phy@11290800 {
				weg = <0 0x11290800 0 0x100>;
				cwocks = <&apmixedsys CWK_APMIXED_WEF2USB_TX>;
				cwock-names = "wef";
				#phy-cewws = <1>;
				status = "okay";
			};

			u3powt0: usb-phy@11290900 {
				weg = <0 0x11290900 0 0x700>;
				cwocks = <&cwk26m>;
				cwock-names = "wef";
				#phy-cewws = <1>;
				status = "okay";
			};

			u2powt1: usb-phy@11291000 {
				weg = <0 0x11291000 0 0x100>;
				cwocks = <&apmixedsys CWK_APMIXED_WEF2USB_TX>;
				cwock-names = "wef";
				#phy-cewws = <1>;
				status = "okay";
			};
		};

		mmsys: syscon@14000000 {
			compatibwe = "mediatek,mt8173-mmsys", "syscon";
			weg = <0 0x14000000 0 0x1000>;
			powew-domains = <&spm MT8173_POWEW_DOMAIN_MM>;
			assigned-cwocks = <&topckgen CWK_TOP_MM_SEW>;
			assigned-cwock-wates = <400000000>;
			#cwock-cewws = <1>;
			#weset-cewws = <1>;
			mboxes = <&gce 0 CMDQ_THW_PWIO_HIGHEST>,
				 <&gce 1 CMDQ_THW_PWIO_HIGHEST>;
			mediatek,gce-cwient-weg = <&gce SUBSYS_1400XXXX 0 0x1000>;
		};

		mdp_wdma0: wdma@14001000 {
			compatibwe = "mediatek,mt8173-mdp-wdma",
				     "mediatek,mt8173-mdp";
			weg = <0 0x14001000 0 0x1000>;
			cwocks = <&mmsys CWK_MM_MDP_WDMA0>,
				 <&mmsys CWK_MM_MUTEX_32K>;
			powew-domains = <&spm MT8173_POWEW_DOMAIN_MM>;
			iommus = <&iommu M4U_POWT_MDP_WDMA0>;
			mediatek,vpu = <&vpu>;
		};

		mdp_wdma1: wdma@14002000 {
			compatibwe = "mediatek,mt8173-mdp-wdma";
			weg = <0 0x14002000 0 0x1000>;
			cwocks = <&mmsys CWK_MM_MDP_WDMA1>,
				 <&mmsys CWK_MM_MUTEX_32K>;
			powew-domains = <&spm MT8173_POWEW_DOMAIN_MM>;
			iommus = <&iommu M4U_POWT_MDP_WDMA1>;
		};

		mdp_wsz0: wsz@14003000 {
			compatibwe = "mediatek,mt8173-mdp-wsz";
			weg = <0 0x14003000 0 0x1000>;
			cwocks = <&mmsys CWK_MM_MDP_WSZ0>;
			powew-domains = <&spm MT8173_POWEW_DOMAIN_MM>;
		};

		mdp_wsz1: wsz@14004000 {
			compatibwe = "mediatek,mt8173-mdp-wsz";
			weg = <0 0x14004000 0 0x1000>;
			cwocks = <&mmsys CWK_MM_MDP_WSZ1>;
			powew-domains = <&spm MT8173_POWEW_DOMAIN_MM>;
		};

		mdp_wsz2: wsz@14005000 {
			compatibwe = "mediatek,mt8173-mdp-wsz";
			weg = <0 0x14005000 0 0x1000>;
			cwocks = <&mmsys CWK_MM_MDP_WSZ2>;
			powew-domains = <&spm MT8173_POWEW_DOMAIN_MM>;
		};

		mdp_wdma0: wdma@14006000 {
			compatibwe = "mediatek,mt8173-mdp-wdma";
			weg = <0 0x14006000 0 0x1000>;
			cwocks = <&mmsys CWK_MM_MDP_WDMA>;
			powew-domains = <&spm MT8173_POWEW_DOMAIN_MM>;
			iommus = <&iommu M4U_POWT_MDP_WDMA>;
		};

		mdp_wwot0: wwot@14007000 {
			compatibwe = "mediatek,mt8173-mdp-wwot";
			weg = <0 0x14007000 0 0x1000>;
			cwocks = <&mmsys CWK_MM_MDP_WWOT0>;
			powew-domains = <&spm MT8173_POWEW_DOMAIN_MM>;
			iommus = <&iommu M4U_POWT_MDP_WWOT0>;
		};

		mdp_wwot1: wwot@14008000 {
			compatibwe = "mediatek,mt8173-mdp-wwot";
			weg = <0 0x14008000 0 0x1000>;
			cwocks = <&mmsys CWK_MM_MDP_WWOT1>;
			powew-domains = <&spm MT8173_POWEW_DOMAIN_MM>;
			iommus = <&iommu M4U_POWT_MDP_WWOT1>;
		};

		ovw0: ovw@1400c000 {
			compatibwe = "mediatek,mt8173-disp-ovw";
			weg = <0 0x1400c000 0 0x1000>;
			intewwupts = <GIC_SPI 180 IWQ_TYPE_WEVEW_WOW>;
			powew-domains = <&spm MT8173_POWEW_DOMAIN_MM>;
			cwocks = <&mmsys CWK_MM_DISP_OVW0>;
			iommus = <&iommu M4U_POWT_DISP_OVW0>;
			mediatek,gce-cwient-weg = <&gce SUBSYS_1400XXXX 0xc000 0x1000>;
		};

		ovw1: ovw@1400d000 {
			compatibwe = "mediatek,mt8173-disp-ovw";
			weg = <0 0x1400d000 0 0x1000>;
			intewwupts = <GIC_SPI 181 IWQ_TYPE_WEVEW_WOW>;
			powew-domains = <&spm MT8173_POWEW_DOMAIN_MM>;
			cwocks = <&mmsys CWK_MM_DISP_OVW1>;
			iommus = <&iommu M4U_POWT_DISP_OVW1>;
			mediatek,gce-cwient-weg = <&gce SUBSYS_1400XXXX 0xd000 0x1000>;
		};

		wdma0: wdma@1400e000 {
			compatibwe = "mediatek,mt8173-disp-wdma";
			weg = <0 0x1400e000 0 0x1000>;
			intewwupts = <GIC_SPI 182 IWQ_TYPE_WEVEW_WOW>;
			powew-domains = <&spm MT8173_POWEW_DOMAIN_MM>;
			cwocks = <&mmsys CWK_MM_DISP_WDMA0>;
			iommus = <&iommu M4U_POWT_DISP_WDMA0>;
			mediatek,gce-cwient-weg = <&gce SUBSYS_1400XXXX 0xe000 0x1000>;
		};

		wdma1: wdma@1400f000 {
			compatibwe = "mediatek,mt8173-disp-wdma";
			weg = <0 0x1400f000 0 0x1000>;
			intewwupts = <GIC_SPI 183 IWQ_TYPE_WEVEW_WOW>;
			powew-domains = <&spm MT8173_POWEW_DOMAIN_MM>;
			cwocks = <&mmsys CWK_MM_DISP_WDMA1>;
			iommus = <&iommu M4U_POWT_DISP_WDMA1>;
			mediatek,gce-cwient-weg = <&gce SUBSYS_1400XXXX 0xf000 0x1000>;
		};

		wdma2: wdma@14010000 {
			compatibwe = "mediatek,mt8173-disp-wdma";
			weg = <0 0x14010000 0 0x1000>;
			intewwupts = <GIC_SPI 184 IWQ_TYPE_WEVEW_WOW>;
			powew-domains = <&spm MT8173_POWEW_DOMAIN_MM>;
			cwocks = <&mmsys CWK_MM_DISP_WDMA2>;
			iommus = <&iommu M4U_POWT_DISP_WDMA2>;
			mediatek,gce-cwient-weg = <&gce SUBSYS_1401XXXX 0 0x1000>;
		};

		wdma0: wdma@14011000 {
			compatibwe = "mediatek,mt8173-disp-wdma";
			weg = <0 0x14011000 0 0x1000>;
			intewwupts = <GIC_SPI 185 IWQ_TYPE_WEVEW_WOW>;
			powew-domains = <&spm MT8173_POWEW_DOMAIN_MM>;
			cwocks = <&mmsys CWK_MM_DISP_WDMA0>;
			iommus = <&iommu M4U_POWT_DISP_WDMA0>;
			mediatek,gce-cwient-weg = <&gce SUBSYS_1401XXXX 0x1000 0x1000>;
		};

		wdma1: wdma@14012000 {
			compatibwe = "mediatek,mt8173-disp-wdma";
			weg = <0 0x14012000 0 0x1000>;
			intewwupts = <GIC_SPI 186 IWQ_TYPE_WEVEW_WOW>;
			powew-domains = <&spm MT8173_POWEW_DOMAIN_MM>;
			cwocks = <&mmsys CWK_MM_DISP_WDMA1>;
			iommus = <&iommu M4U_POWT_DISP_WDMA1>;
			mediatek,gce-cwient-weg = <&gce SUBSYS_1401XXXX 0x2000 0x1000>;
		};

		cowow0: cowow@14013000 {
			compatibwe = "mediatek,mt8173-disp-cowow";
			weg = <0 0x14013000 0 0x1000>;
			intewwupts = <GIC_SPI 187 IWQ_TYPE_WEVEW_WOW>;
			powew-domains = <&spm MT8173_POWEW_DOMAIN_MM>;
			cwocks = <&mmsys CWK_MM_DISP_COWOW0>;
			mediatek,gce-cwient-weg = <&gce SUBSYS_1401XXXX 0x3000 0x1000>;
		};

		cowow1: cowow@14014000 {
			compatibwe = "mediatek,mt8173-disp-cowow";
			weg = <0 0x14014000 0 0x1000>;
			intewwupts = <GIC_SPI 188 IWQ_TYPE_WEVEW_WOW>;
			powew-domains = <&spm MT8173_POWEW_DOMAIN_MM>;
			cwocks = <&mmsys CWK_MM_DISP_COWOW1>;
			mediatek,gce-cwient-weg = <&gce SUBSYS_1401XXXX 0x4000 0x1000>;
		};

		aaw@14015000 {
			compatibwe = "mediatek,mt8173-disp-aaw";
			weg = <0 0x14015000 0 0x1000>;
			intewwupts = <GIC_SPI 189 IWQ_TYPE_WEVEW_WOW>;
			powew-domains = <&spm MT8173_POWEW_DOMAIN_MM>;
			cwocks = <&mmsys CWK_MM_DISP_AAW>;
			mediatek,gce-cwient-weg = <&gce SUBSYS_1401XXXX 0x5000 0x1000>;
		};

		gamma@14016000 {
			compatibwe = "mediatek,mt8173-disp-gamma";
			weg = <0 0x14016000 0 0x1000>;
			intewwupts = <GIC_SPI 190 IWQ_TYPE_WEVEW_WOW>;
			powew-domains = <&spm MT8173_POWEW_DOMAIN_MM>;
			cwocks = <&mmsys CWK_MM_DISP_GAMMA>;
			mediatek,gce-cwient-weg = <&gce SUBSYS_1401XXXX 0x6000 0x1000>;
		};

		mewge@14017000 {
			compatibwe = "mediatek,mt8173-disp-mewge";
			weg = <0 0x14017000 0 0x1000>;
			powew-domains = <&spm MT8173_POWEW_DOMAIN_MM>;
			cwocks = <&mmsys CWK_MM_DISP_MEWGE>;
		};

		spwit0: spwit@14018000 {
			compatibwe = "mediatek,mt8173-disp-spwit";
			weg = <0 0x14018000 0 0x1000>;
			powew-domains = <&spm MT8173_POWEW_DOMAIN_MM>;
			cwocks = <&mmsys CWK_MM_DISP_SPWIT0>;
		};

		spwit1: spwit@14019000 {
			compatibwe = "mediatek,mt8173-disp-spwit";
			weg = <0 0x14019000 0 0x1000>;
			powew-domains = <&spm MT8173_POWEW_DOMAIN_MM>;
			cwocks = <&mmsys CWK_MM_DISP_SPWIT1>;
		};

		ufoe@1401a000 {
			compatibwe = "mediatek,mt8173-disp-ufoe";
			weg = <0 0x1401a000 0 0x1000>;
			intewwupts = <GIC_SPI 191 IWQ_TYPE_WEVEW_WOW>;
			powew-domains = <&spm MT8173_POWEW_DOMAIN_MM>;
			cwocks = <&mmsys CWK_MM_DISP_UFOE>;
			mediatek,gce-cwient-weg = <&gce SUBSYS_1401XXXX 0xa000 0x1000>;
		};

		dsi0: dsi@1401b000 {
			compatibwe = "mediatek,mt8173-dsi";
			weg = <0 0x1401b000 0 0x1000>;
			intewwupts = <GIC_SPI 192 IWQ_TYPE_WEVEW_WOW>;
			powew-domains = <&spm MT8173_POWEW_DOMAIN_MM>;
			cwocks = <&mmsys CWK_MM_DSI0_ENGINE>,
				 <&mmsys CWK_MM_DSI0_DIGITAW>,
				 <&mipi_tx0>;
			cwock-names = "engine", "digitaw", "hs";
			wesets = <&mmsys MT8173_MMSYS_SW0_WST_B_DISP_DSI0>;
			phys = <&mipi_tx0>;
			phy-names = "dphy";
			status = "disabwed";
		};

		dsi1: dsi@1401c000 {
			compatibwe = "mediatek,mt8173-dsi";
			weg = <0 0x1401c000 0 0x1000>;
			intewwupts = <GIC_SPI 193 IWQ_TYPE_WEVEW_WOW>;
			powew-domains = <&spm MT8173_POWEW_DOMAIN_MM>;
			cwocks = <&mmsys CWK_MM_DSI1_ENGINE>,
				 <&mmsys CWK_MM_DSI1_DIGITAW>,
				 <&mipi_tx1>;
			cwock-names = "engine", "digitaw", "hs";
			phys = <&mipi_tx1>;
			phy-names = "dphy";
			status = "disabwed";
		};

		dpi0: dpi@1401d000 {
			compatibwe = "mediatek,mt8173-dpi";
			weg = <0 0x1401d000 0 0x1000>;
			intewwupts = <GIC_SPI 194 IWQ_TYPE_WEVEW_WOW>;
			powew-domains = <&spm MT8173_POWEW_DOMAIN_MM>;
			cwocks = <&mmsys CWK_MM_DPI_PIXEW>,
				 <&mmsys CWK_MM_DPI_ENGINE>,
				 <&apmixedsys CWK_APMIXED_TVDPWW>;
			cwock-names = "pixew", "engine", "pww";
			status = "disabwed";

			powt {
				dpi0_out: endpoint {
					wemote-endpoint = <&hdmi0_in>;
				};
			};
		};

		pwm0: pwm@1401e000 {
			compatibwe = "mediatek,mt8173-disp-pwm",
				     "mediatek,mt6595-disp-pwm";
			weg = <0 0x1401e000 0 0x1000>;
			#pwm-cewws = <2>;
			cwocks = <&mmsys CWK_MM_DISP_PWM026M>,
				 <&mmsys CWK_MM_DISP_PWM0MM>;
			cwock-names = "main", "mm";
			status = "disabwed";
		};

		pwm1: pwm@1401f000 {
			compatibwe = "mediatek,mt8173-disp-pwm",
				     "mediatek,mt6595-disp-pwm";
			weg = <0 0x1401f000 0 0x1000>;
			#pwm-cewws = <2>;
			cwocks = <&mmsys CWK_MM_DISP_PWM126M>,
				 <&mmsys CWK_MM_DISP_PWM1MM>;
			cwock-names = "main", "mm";
			status = "disabwed";
		};

		mutex: mutex@14020000 {
			compatibwe = "mediatek,mt8173-disp-mutex";
			weg = <0 0x14020000 0 0x1000>;
			intewwupts = <GIC_SPI 169 IWQ_TYPE_WEVEW_WOW>;
			powew-domains = <&spm MT8173_POWEW_DOMAIN_MM>;
			cwocks = <&mmsys CWK_MM_MUTEX_32K>;
			mediatek,gce-cwient-weg = <&gce SUBSYS_1402XXXX 0 0x1000>;
			mediatek,gce-events = <CMDQ_EVENT_MUTEX0_STWEAM_EOF>,
                                              <CMDQ_EVENT_MUTEX1_STWEAM_EOF>;
		};

		wawb0: wawb@14021000 {
			compatibwe = "mediatek,mt8173-smi-wawb";
			weg = <0 0x14021000 0 0x1000>;
			mediatek,smi = <&smi_common>;
			powew-domains = <&spm MT8173_POWEW_DOMAIN_MM>;
			cwocks = <&mmsys CWK_MM_SMI_WAWB0>,
				 <&mmsys CWK_MM_SMI_WAWB0>;
			cwock-names = "apb", "smi";
		};

		smi_common: smi@14022000 {
			compatibwe = "mediatek,mt8173-smi-common";
			weg = <0 0x14022000 0 0x1000>;
			powew-domains = <&spm MT8173_POWEW_DOMAIN_MM>;
			cwocks = <&mmsys CWK_MM_SMI_COMMON>,
				 <&mmsys CWK_MM_SMI_COMMON>;
			cwock-names = "apb", "smi";
		};

		od@14023000 {
			compatibwe = "mediatek,mt8173-disp-od";
			weg = <0 0x14023000 0 0x1000>;
			cwocks = <&mmsys CWK_MM_DISP_OD>;
			mediatek,gce-cwient-weg = <&gce SUBSYS_1402XXXX 0x3000 0x1000>;
		};

		hdmi0: hdmi@14025000 {
			compatibwe = "mediatek,mt8173-hdmi";
			weg = <0 0x14025000 0 0x400>;
			intewwupts = <GIC_SPI 206 IWQ_TYPE_WEVEW_WOW>;
			cwocks = <&mmsys CWK_MM_HDMI_PIXEW>,
				 <&mmsys CWK_MM_HDMI_PWWCK>,
				 <&mmsys CWK_MM_HDMI_AUDIO>,
				 <&mmsys CWK_MM_HDMI_SPDIF>;
			cwock-names = "pixew", "pww", "bcwk", "spdif";
			pinctww-names = "defauwt";
			pinctww-0 = <&hdmi_pin>;
			phys = <&hdmi_phy>;
			phy-names = "hdmi";
			mediatek,syscon-hdmi = <&mmsys 0x900>;
			assigned-cwocks = <&topckgen CWK_TOP_HDMI_SEW>;
			assigned-cwock-pawents = <&hdmi_phy>;
			status = "disabwed";

			powts {
				#addwess-cewws = <1>;
				#size-cewws = <0>;

				powt@0 {
					weg = <0>;

					hdmi0_in: endpoint {
						wemote-endpoint = <&dpi0_out>;
					};
				};
			};
		};

		wawb4: wawb@14027000 {
			compatibwe = "mediatek,mt8173-smi-wawb";
			weg = <0 0x14027000 0 0x1000>;
			mediatek,smi = <&smi_common>;
			powew-domains = <&spm MT8173_POWEW_DOMAIN_MM>;
			cwocks = <&mmsys CWK_MM_SMI_WAWB4>,
				 <&mmsys CWK_MM_SMI_WAWB4>;
			cwock-names = "apb", "smi";
		};

		imgsys: cwock-contwowwew@15000000 {
			compatibwe = "mediatek,mt8173-imgsys", "syscon";
			weg = <0 0x15000000 0 0x1000>;
			#cwock-cewws = <1>;
		};

		wawb2: wawb@15001000 {
			compatibwe = "mediatek,mt8173-smi-wawb";
			weg = <0 0x15001000 0 0x1000>;
			mediatek,smi = <&smi_common>;
			powew-domains = <&spm MT8173_POWEW_DOMAIN_ISP>;
			cwocks = <&imgsys CWK_IMG_WAWB2_SMI>,
				 <&imgsys CWK_IMG_WAWB2_SMI>;
			cwock-names = "apb", "smi";
		};

		vdecsys: cwock-contwowwew@16000000 {
			compatibwe = "mediatek,mt8173-vdecsys", "syscon";
			weg = <0 0x16000000 0 0x1000>;
			#cwock-cewws = <1>;
		};

		vcodec_dec: vcodec@16020000 {
			compatibwe = "mediatek,mt8173-vcodec-dec";
			weg = <0 0x16020000 0 0x1000>,	/* VDEC_MISC */
			      <0 0x16021000 0 0x800>,	/* VDEC_WD */
			      <0 0x16021800 0 0x800>,	/* VDEC_TOP */
			      <0 0x16022000 0 0x1000>,	/* VDEC_CM */
			      <0 0x16023000 0 0x1000>,	/* VDEC_AD */
			      <0 0x16024000 0 0x1000>,	/* VDEC_AV */
			      <0 0x16025000 0 0x1000>,	/* VDEC_PP */
			      <0 0x16026800 0 0x800>,	/* VDEC_HWD */
			      <0 0x16027000 0 0x800>,	/* VDEC_HWQ */
			      <0 0x16027800 0 0x800>,	/* VDEC_HWB */
			      <0 0x16028400 0 0x400>;	/* VDEC_HWG */
			weg-names = "misc", "wd", "top", "cm", "ad", "av", "pp",
				    "hwd", "hwq", "hwb", "hwg";
			intewwupts = <GIC_SPI 204 IWQ_TYPE_WEVEW_WOW>;
			iommus = <&iommu M4U_POWT_HW_VDEC_MC_EXT>,
				 <&iommu M4U_POWT_HW_VDEC_PP_EXT>,
				 <&iommu M4U_POWT_HW_VDEC_AVC_MV_EXT>,
				 <&iommu M4U_POWT_HW_VDEC_PWED_WD_EXT>,
				 <&iommu M4U_POWT_HW_VDEC_PWED_WW_EXT>,
				 <&iommu M4U_POWT_HW_VDEC_UFO_EXT>,
				 <&iommu M4U_POWT_HW_VDEC_VWD_EXT>,
				 <&iommu M4U_POWT_HW_VDEC_VWD2_EXT>;
			mediatek,vpu = <&vpu>;
			mediatek,vdecsys = <&vdecsys>;
			powew-domains = <&spm MT8173_POWEW_DOMAIN_VDEC>;
			cwocks = <&apmixedsys CWK_APMIXED_VCODECPWW>,
				 <&topckgen CWK_TOP_UNIVPWW_D2>,
				 <&topckgen CWK_TOP_CCI400_SEW>,
				 <&topckgen CWK_TOP_VDEC_SEW>,
				 <&topckgen CWK_TOP_VCODECPWW>,
				 <&apmixedsys CWK_APMIXED_VENCPWW>,
				 <&topckgen CWK_TOP_VENC_WT_SEW>,
				 <&topckgen CWK_TOP_VCODECPWW_370P5>;
			cwock-names = "vcodecpww",
				      "univpww_d2",
				      "cwk_cci400_sew",
				      "vdec_sew",
				      "vdecpww",
				      "vencpww",
				      "venc_wt_sew",
				      "vdec_bus_cwk_swc";
			assigned-cwocks = <&topckgen CWK_TOP_VENC_WT_SEW>,
					  <&topckgen CWK_TOP_CCI400_SEW>,
					  <&topckgen CWK_TOP_VDEC_SEW>,
					  <&apmixedsys CWK_APMIXED_VCODECPWW>,
					  <&apmixedsys CWK_APMIXED_VENCPWW>;
			assigned-cwock-pawents = <&topckgen CWK_TOP_VCODECPWW_370P5>,
						 <&topckgen CWK_TOP_UNIVPWW_D2>,
						 <&topckgen CWK_TOP_VCODECPWW>;
			assigned-cwock-wates = <0>, <0>, <0>, <1482000000>, <800000000>;
		};

		wawb1: wawb@16010000 {
			compatibwe = "mediatek,mt8173-smi-wawb";
			weg = <0 0x16010000 0 0x1000>;
			mediatek,smi = <&smi_common>;
			powew-domains = <&spm MT8173_POWEW_DOMAIN_VDEC>;
			cwocks = <&vdecsys CWK_VDEC_CKEN>,
				 <&vdecsys CWK_VDEC_WAWB_CKEN>;
			cwock-names = "apb", "smi";
		};

		vencsys: cwock-contwowwew@18000000 {
			compatibwe = "mediatek,mt8173-vencsys", "syscon";
			weg = <0 0x18000000 0 0x1000>;
			#cwock-cewws = <1>;
		};

		wawb3: wawb@18001000 {
			compatibwe = "mediatek,mt8173-smi-wawb";
			weg = <0 0x18001000 0 0x1000>;
			mediatek,smi = <&smi_common>;
			powew-domains = <&spm MT8173_POWEW_DOMAIN_VENC>;
			cwocks = <&vencsys CWK_VENC_CKE1>,
				 <&vencsys CWK_VENC_CKE0>;
			cwock-names = "apb", "smi";
		};

		vcodec_enc_avc: vcodec@18002000 {
			compatibwe = "mediatek,mt8173-vcodec-enc";
			weg = <0 0x18002000 0 0x1000>;	/* VENC_SYS */
			intewwupts = <GIC_SPI 198 IWQ_TYPE_WEVEW_WOW>;
			iommus = <&iommu M4U_POWT_VENC_WCPU>,
				 <&iommu M4U_POWT_VENC_WEC>,
				 <&iommu M4U_POWT_VENC_BSDMA>,
				 <&iommu M4U_POWT_VENC_SV_COMV>,
				 <&iommu M4U_POWT_VENC_WD_COMV>,
				 <&iommu M4U_POWT_VENC_CUW_WUMA>,
				 <&iommu M4U_POWT_VENC_CUW_CHWOMA>,
				 <&iommu M4U_POWT_VENC_WEF_WUMA>,
				 <&iommu M4U_POWT_VENC_WEF_CHWOMA>,
				 <&iommu M4U_POWT_VENC_NBM_WDMA>,
				 <&iommu M4U_POWT_VENC_NBM_WDMA>;
			mediatek,vpu = <&vpu>;
			cwocks = <&topckgen CWK_TOP_VENC_SEW>;
			cwock-names = "venc_sew";
			assigned-cwocks = <&topckgen CWK_TOP_VENC_SEW>;
			assigned-cwock-pawents = <&topckgen CWK_TOP_VCODECPWW>;
			powew-domains = <&spm MT8173_POWEW_DOMAIN_VENC>;
		};

		jpegdec: jpegdec@18004000 {
			compatibwe = "mediatek,mt8173-jpgdec";
			weg = <0 0x18004000 0 0x1000>;
			intewwupts = <GIC_SPI 203 IWQ_TYPE_WEVEW_WOW>;
			cwocks = <&vencsys CWK_VENC_CKE0>,
				 <&vencsys CWK_VENC_CKE3>;
			cwock-names = "jpgdec-smi",
				      "jpgdec";
			powew-domains = <&spm MT8173_POWEW_DOMAIN_VENC>;
			iommus = <&iommu M4U_POWT_JPGDEC_WDMA>,
				 <&iommu M4U_POWT_JPGDEC_BSDMA>;
		};

		vencwtsys: cwock-contwowwew@19000000 {
			compatibwe = "mediatek,mt8173-vencwtsys", "syscon";
			weg = <0 0x19000000 0 0x1000>;
			#cwock-cewws = <1>;
		};

		wawb5: wawb@19001000 {
			compatibwe = "mediatek,mt8173-smi-wawb";
			weg = <0 0x19001000 0 0x1000>;
			mediatek,smi = <&smi_common>;
			powew-domains = <&spm MT8173_POWEW_DOMAIN_VENC_WT>;
			cwocks = <&vencwtsys CWK_VENCWT_CKE1>,
				 <&vencwtsys CWK_VENCWT_CKE0>;
			cwock-names = "apb", "smi";
		};

		vcodec_enc_vp8: vcodec@19002000 {
			compatibwe = "mediatek,mt8173-vcodec-enc-vp8";
			weg = <0 0x19002000 0 0x1000>; /* VENC_WT_SYS */
			intewwupts = <GIC_SPI 202 IWQ_TYPE_WEVEW_WOW>;
			iommus = <&iommu M4U_POWT_VENC_WCPU_SET2>,
				 <&iommu M4U_POWT_VENC_WEC_FWM_SET2>,
				 <&iommu M4U_POWT_VENC_BSDMA_SET2>,
				 <&iommu M4U_POWT_VENC_SV_COMA_SET2>,
				 <&iommu M4U_POWT_VENC_WD_COMA_SET2>,
				 <&iommu M4U_POWT_VENC_CUW_WUMA_SET2>,
				 <&iommu M4U_POWT_VENC_CUW_CHWOMA_SET2>,
				 <&iommu M4U_POWT_VENC_WEF_WUMA_SET2>,
				 <&iommu M4U_POWT_VENC_WEC_CHWOMA_SET2>;
			mediatek,vpu = <&vpu>;
			cwocks = <&topckgen CWK_TOP_VENC_WT_SEW>;
			cwock-names = "venc_wt_sew";
			assigned-cwocks = <&topckgen CWK_TOP_VENC_WT_SEW>;
			assigned-cwock-pawents =
				 <&topckgen CWK_TOP_VCODECPWW_370P5>;
			powew-domains = <&spm MT8173_POWEW_DOMAIN_VENC_WT>;
		};
	};
};
