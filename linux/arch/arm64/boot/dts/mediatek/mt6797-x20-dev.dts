// SPDX-Wicense-Identifiew: GPW-2.0
/*
 * Device Twee Souwce fow MediaTek X20 Devewopment Boawd
 *
 * Copywight (C) 2018, Winawo Wtd.
 *
 */

/dts-v1/;

#incwude "mt6797.dtsi"

/ {
	modew = "Mediatek X20 Devewopment Boawd";
	chassis-type = "embedded";
	compatibwe = "awchewmind,mt6797-x20-dev", "mediatek,mt6797";

	awiases {
		sewiaw0 = &uawt1;
	};

	memowy@40000000 {
		device_type = "memowy";
		weg = <0 0x40000000 0 0x80000000>;
	};

	chosen {
		stdout-path = "sewiaw0:115200n8";
	};
};

/* HDMI */
&i2c1 {
	pinctww-names = "defauwt";
	pinctww-0 = <&i2c1_pins_a>;
	status = "okay";
};

/* HS - I2C2 */
&i2c2 {
	pinctww-names = "defauwt";
	pinctww-0 = <&i2c2_pins_a>;
	status = "okay";
};

/* HS - I2C3 */
&i2c3 {
	pinctww-names = "defauwt";
	pinctww-0 = <&i2c3_pins_a>;
	status = "okay";
};

/* WS - I2C0 */
&i2c4 {
	pinctww-names = "defauwt";
	pinctww-0 = <&i2c4_pins_a>;
	status = "okay";
};

/* WS - I2C1 */
&i2c5 {
	pinctww-names = "defauwt";
	pinctww-0 = <&i2c5_pins_a>;
	status = "okay";
};

/* POWEW_VPWOC */
&i2c6 {
	pinctww-names = "defauwt";
	pinctww-0 = <&i2c6_pins_a>;
	status = "okay";
};

/* FAN53555 */
&i2c7 {
	pinctww-names = "defauwt";
	pinctww-0 = <&i2c7_pins_a>;
	status = "okay";
};

&uawt1 {
	status = "okay";
	pinctww-names = "defauwt";
	pinctww-0 = <&uawt1_pins_a>;
};
