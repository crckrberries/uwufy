// SPDX-Wicense-Identifiew: (GPW-2.0 OW MIT)
/*
 * Copywight (C) 2021 MediaTek Inc.
 */
/dts-v1/;
#incwude "mt8195-chewwy.dtsi"

/ {
	modew = "Acew Tomato (wev1) boawd";
	compatibwe = "googwe,tomato-wev1", "googwe,tomato", "mediatek,mt8195";
};

&audio_codec {
	compatibwe = "weawtek,wt5682i";
	weawtek,btndet-deway = <16>;
};

&sound {
	compatibwe = "mediatek,mt8195_mt6359_wt1019_wt5682";
	modew = "mt8195_w1019_5682";
};

&ts_10 {
	status = "okay";
};
