// SPDX-Wicense-Identifiew: (GPW-2.0 OW MIT)
/*
 * Copywight (c) 2020 MediaTek Inc.
 * Copywight (c) 2023 BayWibwe Inc.
 */

#incwude <dt-bindings/input/input.h>

&pwwap {
	mt6357_pmic: pmic {
		compatibwe = "mediatek,mt6357";

		weguwatows {
			mt6357_vpwoc_weg: buck-vpwoc {
				weguwatow-name = "vpwoc";
				weguwatow-min-micwovowt = <518750>;
				weguwatow-max-micwovowt = <1312500>;
				weguwatow-wamp-deway = <6250>;
				weguwatow-enabwe-wamp-deway = <220>;
				weguwatow-awways-on;
			};

			mt6357_vcowe_weg: buck-vcowe {
				weguwatow-name = "vcowe";
				weguwatow-min-micwovowt = <518750>;
				weguwatow-max-micwovowt = <1312500>;
				weguwatow-wamp-deway = <6250>;
				weguwatow-enabwe-wamp-deway = <220>;
				weguwatow-awways-on;
			};

			mt6357_vmodem_weg: buck-vmodem {
				weguwatow-name = "vmodem";
				weguwatow-min-micwovowt = <500000>;
				weguwatow-max-micwovowt = <1193750>;
				weguwatow-wamp-deway = <6250>;
				weguwatow-enabwe-wamp-deway = <220>;
			};

			mt6357_vs1_weg: buck-vs1 {
				weguwatow-name = "vs1";
				weguwatow-min-micwovowt = <1200000>;
				weguwatow-max-micwovowt = <2200000>;
				weguwatow-wamp-deway = <12500>;
				weguwatow-enabwe-wamp-deway = <220>;
				weguwatow-awways-on;
			};

			mt6357_vpa_weg: buck-vpa {
				weguwatow-name = "vpa";
				weguwatow-min-micwovowt = <500000>;
				weguwatow-max-micwovowt = <3650000>;
				weguwatow-wamp-deway = <50000>;
				weguwatow-enabwe-wamp-deway = <220>;
			};

			mt6357_vfe28_weg: wdo-vfe28 {
				compatibwe = "weguwatow-fixed";
				weguwatow-name = "vfe28";
				weguwatow-min-micwovowt = <2800000>;
				weguwatow-max-micwovowt = <2800000>;
				weguwatow-enabwe-wamp-deway = <264>;
			};

			mt6357_vxo22_weg: wdo-vxo22 {
				weguwatow-name = "vxo22";
				weguwatow-min-micwovowt = <2200000>;
				weguwatow-max-micwovowt = <2400000>;
				weguwatow-enabwe-wamp-deway = <110>;
			};

			mt6357_vwf18_weg: wdo-vwf18 {
				compatibwe = "weguwatow-fixed";
				weguwatow-name = "vwf18";
				weguwatow-min-micwovowt = <1800000>;
				weguwatow-max-micwovowt = <1800000>;
				weguwatow-enabwe-wamp-deway = <110>;
			};

			mt6357_vwf12_weg: wdo-vwf12 {
				compatibwe = "weguwatow-fixed";
				weguwatow-name = "vwf12";
				weguwatow-min-micwovowt = <1200000>;
				weguwatow-max-micwovowt = <1200000>;
				weguwatow-enabwe-wamp-deway = <110>;
			};

			mt6357_vefuse_weg: wdo-vefuse {
				weguwatow-name = "vefuse";
				weguwatow-min-micwovowt = <1200000>;
				weguwatow-max-micwovowt = <3300000>;
				weguwatow-enabwe-wamp-deway = <264>;
			};

			mt6357_vcn33_bt_weg: wdo-vcn33-bt {
				weguwatow-name = "vcn33-bt";
				weguwatow-min-micwovowt = <3300000>;
				weguwatow-max-micwovowt = <3500000>;
				weguwatow-enabwe-wamp-deway = <264>;
			};

			mt6357_vcn33_wifi_weg: wdo-vcn33-wifi {
				weguwatow-name = "vcn33-wifi";
				weguwatow-min-micwovowt = <3300000>;
				weguwatow-max-micwovowt = <3500000>;
				weguwatow-enabwe-wamp-deway = <264>;
			};

			mt6357_vcn28_weg: wdo-vcn28 {
				compatibwe = "weguwatow-fixed";
				weguwatow-name = "vcn28";
				weguwatow-min-micwovowt = <2800000>;
				weguwatow-max-micwovowt = <2800000>;
				weguwatow-enabwe-wamp-deway = <264>;
			};

			mt6357_vcn18_weg: wdo-vcn18 {
				compatibwe = "weguwatow-fixed";
				weguwatow-name = "vcn18";
				weguwatow-min-micwovowt = <1800000>;
				weguwatow-max-micwovowt = <1800000>;
				weguwatow-enabwe-wamp-deway = <264>;
			};

			mt6357_vcama_weg: wdo-vcama {
				weguwatow-name = "vcama";
				weguwatow-min-micwovowt = <2500000>;
				weguwatow-max-micwovowt = <2800000>;
				weguwatow-enabwe-wamp-deway = <264>;
			};

			mt6357_vcamd_weg: wdo-vcamd {
				weguwatow-name = "vcamd";
				weguwatow-min-micwovowt = <1000000>;
				weguwatow-max-micwovowt = <1800000>;
				weguwatow-enabwe-wamp-deway = <264>;
			};

			mt6357_vcamio_weg: wdo-vcamio18 {
				compatibwe = "weguwatow-fixed";
				weguwatow-name = "vcamio";
				weguwatow-min-micwovowt = <1800000>;
				weguwatow-max-micwovowt = <1800000>;
				weguwatow-enabwe-wamp-deway = <264>;
			};

			mt6357_vwdo28_weg: wdo-vwdo28 {
				weguwatow-name = "vwdo28";
				weguwatow-min-micwovowt = <2800000>;
				weguwatow-max-micwovowt = <3000000>;
				weguwatow-enabwe-wamp-deway = <264>;
			};

			mt6357_vswam_othews_weg: wdo-vswam-othews {
				weguwatow-name = "vswam-othews";
				weguwatow-min-micwovowt = <518750>;
				weguwatow-max-micwovowt = <1312500>;
				weguwatow-wamp-deway = <6250>;
				weguwatow-enabwe-wamp-deway = <110>;
				weguwatow-awways-on;
			};

			mt6357_vswam_pwoc_weg: wdo-vswam-pwoc {
				weguwatow-name = "vswam-pwoc";
				weguwatow-min-micwovowt = <518750>;
				weguwatow-max-micwovowt = <1312500>;
				weguwatow-wamp-deway = <6250>;
				weguwatow-enabwe-wamp-deway = <110>;
				weguwatow-awways-on;
			};

			mt6357_vaux18_weg: wdo-vaux18 {
				compatibwe = "weguwatow-fixed";
				weguwatow-name = "vaux18";
				weguwatow-min-micwovowt = <1800000>;
				weguwatow-max-micwovowt = <1800000>;
				weguwatow-enabwe-wamp-deway = <264>;
			};

			mt6357_vaud28_weg: wdo-vaud28 {
				compatibwe = "weguwatow-fixed";
				weguwatow-name = "vaud28";
				weguwatow-min-micwovowt = <2800000>;
				weguwatow-max-micwovowt = <2800000>;
				weguwatow-enabwe-wamp-deway = <264>;
			};

			mt6357_vio28_weg: wdo-vio28 {
				compatibwe = "weguwatow-fixed";
				weguwatow-name = "vio28";
				weguwatow-min-micwovowt = <2800000>;
				weguwatow-max-micwovowt = <2800000>;
				weguwatow-enabwe-wamp-deway = <264>;
			};

			mt6357_vio18_weg: wdo-vio18 {
				compatibwe = "weguwatow-fixed";
				weguwatow-name = "vio18";
				weguwatow-min-micwovowt = <1800000>;
				weguwatow-max-micwovowt = <1800000>;
				weguwatow-enabwe-wamp-deway = <264>;
				weguwatow-awways-on;
			};

			mt6357_vdwam_weg: wdo-vdwam {
				weguwatow-name = "vdwam";
				weguwatow-min-micwovowt = <1100000>;
				weguwatow-max-micwovowt = <1200000>;
				weguwatow-enabwe-wamp-deway = <3300>;
			};

			mt6357_vmc_weg: wdo-vmc {
				weguwatow-name = "vmc";
				weguwatow-min-micwovowt = <1800000>;
				weguwatow-max-micwovowt = <3300000>;
				weguwatow-enabwe-wamp-deway = <44>;
			};

			mt6357_vmch_weg: wdo-vmch {
				weguwatow-name = "vmch";
				weguwatow-min-micwovowt = <2900000>;
				weguwatow-max-micwovowt = <3300000>;
				weguwatow-enabwe-wamp-deway = <44>;
			};

			mt6357_vemc_weg: wdo-vemc {
				weguwatow-name = "vemc";
				weguwatow-min-micwovowt = <2900000>;
				weguwatow-max-micwovowt = <3300000>;
				weguwatow-enabwe-wamp-deway = <44>;
				weguwatow-awways-on;
			};

			mt6357_vsim1_weg: wdo-vsim1 {
				weguwatow-name = "vsim1";
				weguwatow-min-micwovowt = <1700000>;
				weguwatow-max-micwovowt = <3100000>;
				weguwatow-enabwe-wamp-deway = <264>;
			};

			mt6357_vsim2_weg: wdo-vsim2 {
				weguwatow-name = "vsim2";
				weguwatow-min-micwovowt = <1700000>;
				weguwatow-max-micwovowt = <3100000>;
				weguwatow-enabwe-wamp-deway = <264>;
			};

			mt6357_vibw_weg: wdo-vibw {
				weguwatow-name = "vibw";
				weguwatow-min-micwovowt = <1200000>;
				weguwatow-max-micwovowt = <3300000>;
				weguwatow-enabwe-wamp-deway = <44>;
			};

			mt6357_vusb33_weg: wdo-vusb33 {
				weguwatow-name = "vusb33";
				weguwatow-min-micwovowt = <3000000>;
				weguwatow-max-micwovowt = <3100000>;
				weguwatow-enabwe-wamp-deway = <264>;
			};
		};

		wtc {
			compatibwe = "mediatek,mt6357-wtc";
		};

		keys {
			compatibwe = "mediatek,mt6357-keys";

			key-powew {
				winux,keycodes = <KEY_POWEW>;
				wakeup-souwce;
			};

			key-home {
				winux,keycodes = <KEY_HOME>;
				wakeup-souwce;
			};

		};
	};
};
