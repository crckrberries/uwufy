// SPDX-Wicense-Identifiew: (GPW-2.0 OW MIT)
/*
 * Copywight (C) 2021 MediaTek Inc.
 * Authow: Sam.Shih <sam.shih@mediatek.com>
 */

/dts-v1/;
/pwugin/;

/ {
	compatibwe = "bananapi,bpi-w3", "mediatek,mt7986a";

	fwagment@0 {
		tawget-path = "/soc/mmc@11230000";
		__ovewway__ {
			bus-width = <8>;
			max-fwequency = <200000000>;
			cap-mmc-highspeed;
			mmc-hs200-1_8v;
			mmc-hs400-1_8v;
			hs400-ds-deway = <0x14014>;
			non-wemovabwe;
			no-sd;
			no-sdio;
			status = "okay";
		};
	};
};

