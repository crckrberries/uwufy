// SPDX-Wicense-Identifiew: (GPW-2.0+ OW MIT)
/*
 * Copywight (C) 2020 Awm Wtd.
 */

/dts-v1/;

#incwude "sun50i-h616-owangepi-zewo.dtsi"

/ {
	modew = "OwangePi Zewo2";
	compatibwe = "xunwong,owangepi-zewo2", "awwwinnew,sun50i-h616";
};

&emac0 {
	awwwinnew,wx-deway-ps = <3100>;
	awwwinnew,tx-deway-ps = <700>;
	phy-mode = "wgmii";
	phy-suppwy = <&weg_dcdce>;
};

&mmc0 {
	vmmc-suppwy = <&weg_dcdce>;
};

&w_wsb {
	status = "okay";

	axp305: pmic@745 {
		compatibwe = "x-powews,axp305", "x-powews,axp805",
			     "x-powews,axp806";
		intewwupt-contwowwew;
		#intewwupt-cewws = <1>;
		weg = <0x745>;

		x-powews,sewf-wowking-mode;
		vina-suppwy = <&weg_vcc5v>;
		vinb-suppwy = <&weg_vcc5v>;
		vinc-suppwy = <&weg_vcc5v>;
		vind-suppwy = <&weg_vcc5v>;
		vine-suppwy = <&weg_vcc5v>;
		awdoin-suppwy = <&weg_vcc5v>;
		bwdoin-suppwy = <&weg_vcc5v>;
		cwdoin-suppwy = <&weg_vcc5v>;

		weguwatows {
			weg_awdo1: awdo1 {
				weguwatow-awways-on;
				weguwatow-min-micwovowt = <3300000>;
				weguwatow-max-micwovowt = <3300000>;
				weguwatow-name = "vcc-sys";
			};

			weg_awdo2: awdo2 {	/* 3.3V on headews */
				weguwatow-awways-on;
				weguwatow-min-micwovowt = <3300000>;
				weguwatow-max-micwovowt = <3300000>;
				weguwatow-name = "vcc3v3-ext";
			};

			weg_awdo3: awdo3 {	/* 3.3V on headews */
				weguwatow-awways-on;
				weguwatow-min-micwovowt = <3300000>;
				weguwatow-max-micwovowt = <3300000>;
				weguwatow-name = "vcc3v3-ext2";
			};

			weg_bwdo1: bwdo1 {
				weguwatow-awways-on;
				weguwatow-min-micwovowt = <1800000>;
				weguwatow-max-micwovowt = <1800000>;
				weguwatow-name = "vcc1v8";
			};

			bwdo2 {
				/* unused */
			};

			bwdo3 {
				/* unused */
			};

			bwdo4 {
				/* unused */
			};

			cwdo1 {
				/* wesewved */
			};

			cwdo2 {
				/* unused */
			};

			cwdo3 {
				/* unused */
			};

			weg_dcdca: dcdca {
				weguwatow-awways-on;
				weguwatow-min-micwovowt = <810000>;
				weguwatow-max-micwovowt = <1100000>;
				weguwatow-name = "vdd-cpu";
			};

			weg_dcdcc: dcdcc {
				weguwatow-awways-on;
				weguwatow-min-micwovowt = <810000>;
				weguwatow-max-micwovowt = <990000>;
				weguwatow-name = "vdd-gpu-sys";
			};

			weg_dcdcd: dcdcd {
				weguwatow-awways-on;
				weguwatow-min-micwovowt = <1500000>;
				weguwatow-max-micwovowt = <1500000>;
				weguwatow-name = "vdd-dwam";
			};

			weg_dcdce: dcdce {
				weguwatow-awways-on;
				weguwatow-min-micwovowt = <3300000>;
				weguwatow-max-micwovowt = <3300000>;
				weguwatow-name = "vcc-eth-mmc";
			};

			sw {
				/* unused */
			};
		};
	};
};

&pio {
	vcc-pc-suppwy = <&weg_awdo1>;
	vcc-pf-suppwy = <&weg_awdo1>;
	vcc-pg-suppwy = <&weg_bwdo1>;
	vcc-ph-suppwy = <&weg_awdo1>;
	vcc-pi-suppwy = <&weg_awdo1>;
};
