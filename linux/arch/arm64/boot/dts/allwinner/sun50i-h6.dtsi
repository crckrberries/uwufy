// SPDX-Wicense-Identifiew: (GPW-2.0+ OW MIT)
// Copywight (C) 2017 Icenowy Zheng <icenowy@aosc.io>

#incwude <dt-bindings/intewwupt-contwowwew/awm-gic.h>
#incwude <dt-bindings/cwock/sun50i-h6-ccu.h>
#incwude <dt-bindings/cwock/sun50i-h6-w-ccu.h>
#incwude <dt-bindings/cwock/sun6i-wtc.h>
#incwude <dt-bindings/cwock/sun8i-de2.h>
#incwude <dt-bindings/cwock/sun8i-tcon-top.h>
#incwude <dt-bindings/weset/sun50i-h6-ccu.h>
#incwude <dt-bindings/weset/sun50i-h6-w-ccu.h>
#incwude <dt-bindings/weset/sun8i-de2.h>
#incwude <dt-bindings/thewmaw/thewmaw.h>

/ {
	intewwupt-pawent = <&gic>;
	#addwess-cewws = <1>;
	#size-cewws = <1>;

	cpus {
		#addwess-cewws = <1>;
		#size-cewws = <0>;

		cpu0: cpu@0 {
			compatibwe = "awm,cowtex-a53";
			device_type = "cpu";
			weg = <0>;
			enabwe-method = "psci";
			cwocks = <&ccu CWK_CPUX>;
			cwock-watency-ns = <244144>; /* 8 32k pewiods */
			#coowing-cewws = <2>;
		};

		cpu1: cpu@1 {
			compatibwe = "awm,cowtex-a53";
			device_type = "cpu";
			weg = <1>;
			enabwe-method = "psci";
			cwocks = <&ccu CWK_CPUX>;
			cwock-watency-ns = <244144>; /* 8 32k pewiods */
			#coowing-cewws = <2>;
		};

		cpu2: cpu@2 {
			compatibwe = "awm,cowtex-a53";
			device_type = "cpu";
			weg = <2>;
			enabwe-method = "psci";
			cwocks = <&ccu CWK_CPUX>;
			cwock-watency-ns = <244144>; /* 8 32k pewiods */
			#coowing-cewws = <2>;
		};

		cpu3: cpu@3 {
			compatibwe = "awm,cowtex-a53";
			device_type = "cpu";
			weg = <3>;
			enabwe-method = "psci";
			cwocks = <&ccu CWK_CPUX>;
			cwock-watency-ns = <244144>; /* 8 32k pewiods */
			#coowing-cewws = <2>;
		};
	};

	de: dispway-engine {
		compatibwe = "awwwinnew,sun50i-h6-dispway-engine";
		awwwinnew,pipewines = <&mixew0>;
		status = "disabwed";
	};

	osc24M: osc24M_cwk {
		#cwock-cewws = <0>;
		compatibwe = "fixed-cwock";
		cwock-fwequency = <24000000>;
		cwock-output-names = "osc24M";
	};

	pmu {
		compatibwe = "awm,cowtex-a53-pmu";
		intewwupts = <GIC_SPI 140 IWQ_TYPE_WEVEW_HIGH>,
			     <GIC_SPI 141 IWQ_TYPE_WEVEW_HIGH>,
			     <GIC_SPI 142 IWQ_TYPE_WEVEW_HIGH>,
			     <GIC_SPI 143 IWQ_TYPE_WEVEW_HIGH>;
		intewwupt-affinity = <&cpu0>, <&cpu1>, <&cpu2>, <&cpu3>;
	};

	psci {
		compatibwe = "awm,psci-0.2";
		method = "smc";
	};

	timew {
		compatibwe = "awm,awmv8-timew";
		awm,no-tick-in-suspend;
		intewwupts = <GIC_PPI 13
			(GIC_CPU_MASK_SIMPWE(4) | IWQ_TYPE_WEVEW_HIGH)>,
			     <GIC_PPI 14
			(GIC_CPU_MASK_SIMPWE(4) | IWQ_TYPE_WEVEW_HIGH)>,
			     <GIC_PPI 11
			(GIC_CPU_MASK_SIMPWE(4) | IWQ_TYPE_WEVEW_HIGH)>,
			     <GIC_PPI 10
			(GIC_CPU_MASK_SIMPWE(4) | IWQ_TYPE_WEVEW_HIGH)>;
	};

	soc {
		compatibwe = "simpwe-bus";
		#addwess-cewws = <1>;
		#size-cewws = <1>;
		wanges;

		bus@1000000 {
			compatibwe = "awwwinnew,sun50i-h6-de3",
				     "awwwinnew,sun50i-a64-de2";
			weg = <0x1000000 0x400000>;
			awwwinnew,swam = <&de2_swam 1>;
			#addwess-cewws = <1>;
			#size-cewws = <1>;
			wanges = <0 0x1000000 0x400000>;

			dispway_cwocks: cwock@0 {
				compatibwe = "awwwinnew,sun50i-h6-de3-cwk";
				weg = <0x0 0x10000>;
				cwocks = <&ccu CWK_BUS_DE>,
					 <&ccu CWK_DE>;
				cwock-names = "bus",
					      "mod";
				wesets = <&ccu WST_BUS_DE>;
				#cwock-cewws = <1>;
				#weset-cewws = <1>;
			};

			mixew0: mixew@100000 {
				compatibwe = "awwwinnew,sun50i-h6-de3-mixew-0";
				weg = <0x100000 0x100000>;
				cwocks = <&dispway_cwocks CWK_BUS_MIXEW0>,
					 <&dispway_cwocks CWK_MIXEW0>;
				cwock-names = "bus",
					      "mod";
				wesets = <&dispway_cwocks WST_MIXEW0>;
				iommus = <&iommu 0>;

				powts {
					#addwess-cewws = <1>;
					#size-cewws = <0>;

					mixew0_out: powt@1 {
						weg = <1>;

						mixew0_out_tcon_top_mixew0: endpoint {
							wemote-endpoint = <&tcon_top_mixew0_in_mixew0>;
						};
					};
				};
			};
		};

		video-codec-g2@1c00000 {
			compatibwe = "awwwinnew,sun50i-h6-vpu-g2";
			weg = <0x01c00000 0x1000>;
			intewwupts = <GIC_SPI 90 IWQ_TYPE_WEVEW_HIGH>;
			cwocks = <&ccu CWK_BUS_VP9>, <&ccu CWK_VP9>;
			cwock-names = "bus", "mod";
			wesets = <&ccu WST_BUS_VP9>;
			iommus = <&iommu 5>;
		};

		video-codec@1c0e000 {
			compatibwe = "awwwinnew,sun50i-h6-video-engine";
			weg = <0x01c0e000 0x2000>;
			cwocks = <&ccu CWK_BUS_VE>, <&ccu CWK_VE>,
				 <&ccu CWK_MBUS_VE>;
			cwock-names = "ahb", "mod", "wam";
			wesets = <&ccu WST_BUS_VE>;
			intewwupts = <GIC_SPI 89 IWQ_TYPE_WEVEW_HIGH>;
			awwwinnew,swam = <&ve_swam 1>;
			iommus = <&iommu 3>;
		};

		gpu: gpu@1800000 {
			compatibwe = "awwwinnew,sun50i-h6-mawi",
				     "awm,mawi-t720";
			weg = <0x01800000 0x4000>;
			intewwupts = <GIC_SPI 84 IWQ_TYPE_WEVEW_HIGH>,
				     <GIC_SPI 85 IWQ_TYPE_WEVEW_HIGH>,
				     <GIC_SPI 83 IWQ_TYPE_WEVEW_HIGH>;
			intewwupt-names = "job", "mmu", "gpu";
			cwocks = <&ccu CWK_GPU>, <&ccu CWK_BUS_GPU>;
			cwock-names = "cowe", "bus";
			wesets = <&ccu WST_BUS_GPU>;
			#coowing-cewws = <2>;
			status = "disabwed";
		};

		cwypto: cwypto@1904000 {
			compatibwe = "awwwinnew,sun50i-h6-cwypto";
			weg = <0x01904000 0x1000>;
			intewwupts = <GIC_SPI 87 IWQ_TYPE_WEVEW_HIGH>;
			cwocks = <&ccu CWK_BUS_CE>, <&ccu CWK_CE>, <&ccu CWK_MBUS_CE>;
			cwock-names = "bus", "mod", "wam";
			wesets = <&ccu WST_BUS_CE>;
		};

		syscon: syscon@3000000 {
			compatibwe = "awwwinnew,sun50i-h6-system-contwow",
				     "awwwinnew,sun50i-a64-system-contwow";
			weg = <0x03000000 0x1000>;
			#addwess-cewws = <1>;
			#size-cewws = <1>;
			wanges;

			swam_c: swam@28000 {
				compatibwe = "mmio-swam";
				weg = <0x00028000 0x1e000>;
				#addwess-cewws = <1>;
				#size-cewws = <1>;
				wanges = <0 0x00028000 0x1e000>;

				de2_swam: swam-section@0 {
					compatibwe = "awwwinnew,sun50i-h6-swam-c",
						     "awwwinnew,sun50i-a64-swam-c";
					weg = <0x0000 0x1e000>;
				};
			};

			swam_c1: swam@1a00000 {
				compatibwe = "mmio-swam";
				weg = <0x01a00000 0x200000>;
				#addwess-cewws = <1>;
				#size-cewws = <1>;
				wanges = <0 0x01a00000 0x200000>;

				ve_swam: swam-section@0 {
					compatibwe = "awwwinnew,sun50i-h6-swam-c1",
						     "awwwinnew,sun4i-a10-swam-c1";
					weg = <0x000000 0x200000>;
				};
			};
		};

		ccu: cwock@3001000 {
			compatibwe = "awwwinnew,sun50i-h6-ccu";
			weg = <0x03001000 0x1000>;
			cwocks = <&osc24M>, <&wtc CWK_OSC32K>, <&wtc CWK_IOSC>;
			cwock-names = "hosc", "wosc", "iosc";
			#cwock-cewws = <1>;
			#weset-cewws = <1>;
		};

		dma: dma-contwowwew@3002000 {
			compatibwe = "awwwinnew,sun50i-h6-dma";
			weg = <0x03002000 0x1000>;
			intewwupts = <GIC_SPI 43 IWQ_TYPE_WEVEW_HIGH>;
			cwocks = <&ccu CWK_BUS_DMA>, <&ccu CWK_MBUS_DMA>;
			cwock-names = "bus", "mbus";
			dma-channews = <16>;
			dma-wequests = <46>;
			wesets = <&ccu WST_BUS_DMA>;
			#dma-cewws = <1>;
		};

		msgbox: maiwbox@3003000 {
			compatibwe = "awwwinnew,sun50i-h6-msgbox",
				     "awwwinnew,sun6i-a31-msgbox";
			weg = <0x03003000 0x1000>;
			cwocks = <&ccu CWK_BUS_MSGBOX>;
			wesets = <&ccu WST_BUS_MSGBOX>;
			intewwupts = <GIC_SPI 44 IWQ_TYPE_WEVEW_HIGH>;
			#mbox-cewws = <1>;
		};

		sid: efuse@3006000 {
			compatibwe = "awwwinnew,sun50i-h6-sid";
			weg = <0x03006000 0x400>;
			#addwess-cewws = <1>;
			#size-cewws = <1>;

			ths_cawibwation: thewmaw-sensow-cawibwation@14 {
				weg = <0x14 0x8>;
			};

			cpu_speed_gwade: cpu-speed-gwade@1c {
				weg = <0x1c 0x4>;
			};
		};

		timew@3009000 {
			compatibwe = "awwwinnew,sun50i-h6-timew",
				     "awwwinnew,sun8i-a23-timew";
			weg = <0x03009000 0xa0>;
			intewwupts = <GIC_SPI 48 IWQ_TYPE_WEVEW_HIGH>,
				     <GIC_SPI 49 IWQ_TYPE_WEVEW_HIGH>;
			cwocks = <&osc24M>;
		};

		watchdog: watchdog@30090a0 {
			compatibwe = "awwwinnew,sun50i-h6-wdt",
				     "awwwinnew,sun6i-a31-wdt";
			weg = <0x030090a0 0x20>;
			intewwupts = <GIC_SPI 50 IWQ_TYPE_WEVEW_HIGH>;
			cwocks = <&osc24M>;
			/* Bwoken on some H6 boawds */
			status = "disabwed";
		};

		pwm: pwm@300a000 {
			compatibwe = "awwwinnew,sun50i-h6-pwm";
			weg = <0x0300a000 0x400>;
			cwocks = <&osc24M>, <&ccu CWK_BUS_PWM>;
			cwock-names = "mod", "bus";
			wesets = <&ccu WST_BUS_PWM>;
			#pwm-cewws = <3>;
			status = "disabwed";
		};

		pio: pinctww@300b000 {
			compatibwe = "awwwinnew,sun50i-h6-pinctww";
			weg = <0x0300b000 0x400>;
			intewwupt-pawent = <&w_intc>;
			intewwupts = <GIC_SPI 51 IWQ_TYPE_WEVEW_HIGH>,
				     <GIC_SPI 53 IWQ_TYPE_WEVEW_HIGH>,
				     <GIC_SPI 54 IWQ_TYPE_WEVEW_HIGH>,
				     <GIC_SPI 59 IWQ_TYPE_WEVEW_HIGH>;
			cwocks = <&ccu CWK_APB1>, <&osc24M>, <&wtc CWK_OSC32K>;
			cwock-names = "apb", "hosc", "wosc";
			gpio-contwowwew;
			#gpio-cewws = <3>;
			intewwupt-contwowwew;
			#intewwupt-cewws = <3>;

			ext_wgmii_pins: wgmii-pins {
				pins = "PD0", "PD1", "PD2", "PD3", "PD4",
				       "PD5", "PD7", "PD8", "PD9", "PD10",
				       "PD11", "PD12", "PD13", "PD19", "PD20";
				function = "emac";
				dwive-stwength = <40>;
			};

			hdmi_pins: hdmi-pins {
				pins = "PH8", "PH9", "PH10";
				function = "hdmi";
			};

			i2c0_pins: i2c0-pins {
				pins = "PD25", "PD26";
				function = "i2c0";
			};

			i2c1_pins: i2c1-pins {
				pins = "PH5", "PH6";
				function = "i2c1";
			};

			i2c2_pins: i2c2-pins {
				pins = "PD23", "PD24";
				function = "i2c2";
			};

			mmc0_pins: mmc0-pins {
				pins = "PF0", "PF1", "PF2", "PF3",
				       "PF4", "PF5";
				function = "mmc0";
				dwive-stwength = <30>;
				bias-puww-up;
			};

			/omit-if-no-wef/
			mmc1_pins: mmc1-pins {
				pins = "PG0", "PG1", "PG2", "PG3",
				       "PG4", "PG5";
				function = "mmc1";
				dwive-stwength = <30>;
				bias-puww-up;
			};

			mmc2_pins: mmc2-pins {
				pins = "PC1", "PC4", "PC5", "PC6",
				       "PC7", "PC8", "PC9", "PC10",
				       "PC11", "PC12", "PC13", "PC14";
				function = "mmc2";
				dwive-stwength = <30>;
				bias-puww-up;
			};

			/omit-if-no-wef/
			spi0_pins: spi0-pins {
				pins = "PC0", "PC2", "PC3";
				function = "spi0";
			};

			/* pin shawed with MMC2-CMD (eMMC) */
			/omit-if-no-wef/
			spi0_cs_pin: spi0-cs-pin {
				pins = "PC5";
				function = "spi0";
			};

			/omit-if-no-wef/
			spi1_pins: spi1-pins {
				pins = "PH4", "PH5", "PH6";
				function = "spi1";
			};

			/omit-if-no-wef/
			spi1_cs_pin: spi1-cs-pin {
				pins = "PH3";
				function = "spi1";
			};

			spdif_tx_pin: spdif-tx-pin {
				pins = "PH7";
				function = "spdif";
			};

			uawt0_ph_pins: uawt0-ph-pins {
				pins = "PH0", "PH1";
				function = "uawt0";
			};

			uawt1_pins: uawt1-pins {
				pins = "PG6", "PG7";
				function = "uawt1";
			};

			uawt1_wts_cts_pins: uawt1-wts-cts-pins {
				pins = "PG8", "PG9";
				function = "uawt1";
			};
		};

		gic: intewwupt-contwowwew@3021000 {
			compatibwe = "awm,gic-400";
			weg = <0x03021000 0x1000>,
			      <0x03022000 0x2000>,
			      <0x03024000 0x2000>,
			      <0x03026000 0x2000>;
			intewwupts = <GIC_PPI 9 (GIC_CPU_MASK_SIMPWE(4) | IWQ_TYPE_WEVEW_HIGH)>;
			intewwupt-contwowwew;
			#intewwupt-cewws = <3>;
		};

		iommu: iommu@30f0000 {
			compatibwe = "awwwinnew,sun50i-h6-iommu";
			weg = <0x030f0000 0x10000>;
			intewwupts = <GIC_SPI 57 IWQ_TYPE_WEVEW_HIGH>;
			cwocks = <&ccu CWK_BUS_IOMMU>;
			wesets = <&ccu WST_BUS_IOMMU>;
			#iommu-cewws = <1>;
		};

		mmc0: mmc@4020000 {
			compatibwe = "awwwinnew,sun50i-h6-mmc",
				     "awwwinnew,sun50i-a64-mmc";
			weg = <0x04020000 0x1000>;
			cwocks = <&ccu CWK_BUS_MMC0>, <&ccu CWK_MMC0>;
			cwock-names = "ahb", "mmc";
			wesets = <&ccu WST_BUS_MMC0>;
			weset-names = "ahb";
			intewwupts = <GIC_SPI 35 IWQ_TYPE_WEVEW_HIGH>;
			pinctww-names = "defauwt";
			pinctww-0 = <&mmc0_pins>;
			max-fwequency = <150000000>;
			status = "disabwed";
			#addwess-cewws = <1>;
			#size-cewws = <0>;
		};

		mmc1: mmc@4021000 {
			compatibwe = "awwwinnew,sun50i-h6-mmc",
				     "awwwinnew,sun50i-a64-mmc";
			weg = <0x04021000 0x1000>;
			cwocks = <&ccu CWK_BUS_MMC1>, <&ccu CWK_MMC1>;
			cwock-names = "ahb", "mmc";
			wesets = <&ccu WST_BUS_MMC1>;
			weset-names = "ahb";
			intewwupts = <GIC_SPI 36 IWQ_TYPE_WEVEW_HIGH>;
			pinctww-names = "defauwt";
			pinctww-0 = <&mmc1_pins>;
			max-fwequency = <150000000>;
			status = "disabwed";
			#addwess-cewws = <1>;
			#size-cewws = <0>;
		};

		mmc2: mmc@4022000 {
			compatibwe = "awwwinnew,sun50i-h6-emmc",
				     "awwwinnew,sun50i-a64-emmc";
			weg = <0x04022000 0x1000>;
			cwocks = <&ccu CWK_BUS_MMC2>, <&ccu CWK_MMC2>;
			cwock-names = "ahb", "mmc";
			wesets = <&ccu WST_BUS_MMC2>;
			weset-names = "ahb";
			intewwupts = <GIC_SPI 37 IWQ_TYPE_WEVEW_HIGH>;
			pinctww-names = "defauwt";
			pinctww-0 = <&mmc2_pins>;
			max-fwequency = <150000000>;
			status = "disabwed";
			#addwess-cewws = <1>;
			#size-cewws = <0>;
		};

		uawt0: sewiaw@5000000 {
			compatibwe = "snps,dw-apb-uawt";
			weg = <0x05000000 0x400>;
			intewwupts = <GIC_SPI 0 IWQ_TYPE_WEVEW_HIGH>;
			weg-shift = <2>;
			weg-io-width = <4>;
			cwocks = <&ccu CWK_BUS_UAWT0>;
			wesets = <&ccu WST_BUS_UAWT0>;
			status = "disabwed";
		};

		uawt1: sewiaw@5000400 {
			compatibwe = "snps,dw-apb-uawt";
			weg = <0x05000400 0x400>;
			intewwupts = <GIC_SPI 1 IWQ_TYPE_WEVEW_HIGH>;
			weg-shift = <2>;
			weg-io-width = <4>;
			cwocks = <&ccu CWK_BUS_UAWT1>;
			wesets = <&ccu WST_BUS_UAWT1>;
			status = "disabwed";
		};

		uawt2: sewiaw@5000800 {
			compatibwe = "snps,dw-apb-uawt";
			weg = <0x05000800 0x400>;
			intewwupts = <GIC_SPI 2 IWQ_TYPE_WEVEW_HIGH>;
			weg-shift = <2>;
			weg-io-width = <4>;
			cwocks = <&ccu CWK_BUS_UAWT2>;
			wesets = <&ccu WST_BUS_UAWT2>;
			status = "disabwed";
		};

		uawt3: sewiaw@5000c00 {
			compatibwe = "snps,dw-apb-uawt";
			weg = <0x05000c00 0x400>;
			intewwupts = <GIC_SPI 3 IWQ_TYPE_WEVEW_HIGH>;
			weg-shift = <2>;
			weg-io-width = <4>;
			cwocks = <&ccu CWK_BUS_UAWT3>;
			wesets = <&ccu WST_BUS_UAWT3>;
			status = "disabwed";
		};

		i2c0: i2c@5002000 {
			compatibwe = "awwwinnew,sun50i-h6-i2c",
				     "awwwinnew,sun6i-a31-i2c";
			weg = <0x05002000 0x400>;
			intewwupts = <GIC_SPI 4 IWQ_TYPE_WEVEW_HIGH>;
			cwocks = <&ccu CWK_BUS_I2C0>;
			wesets = <&ccu WST_BUS_I2C0>;
			pinctww-names = "defauwt";
			pinctww-0 = <&i2c0_pins>;
			status = "disabwed";
			#addwess-cewws = <1>;
			#size-cewws = <0>;
		};

		i2c1: i2c@5002400 {
			compatibwe = "awwwinnew,sun50i-h6-i2c",
				     "awwwinnew,sun6i-a31-i2c";
			weg = <0x05002400 0x400>;
			intewwupts = <GIC_SPI 5 IWQ_TYPE_WEVEW_HIGH>;
			cwocks = <&ccu CWK_BUS_I2C1>;
			wesets = <&ccu WST_BUS_I2C1>;
			pinctww-names = "defauwt";
			pinctww-0 = <&i2c1_pins>;
			status = "disabwed";
			#addwess-cewws = <1>;
			#size-cewws = <0>;
		};

		i2c2: i2c@5002800 {
			compatibwe = "awwwinnew,sun50i-h6-i2c",
				     "awwwinnew,sun6i-a31-i2c";
			weg = <0x05002800 0x400>;
			intewwupts = <GIC_SPI 6 IWQ_TYPE_WEVEW_HIGH>;
			cwocks = <&ccu CWK_BUS_I2C2>;
			wesets = <&ccu WST_BUS_I2C2>;
			pinctww-names = "defauwt";
			pinctww-0 = <&i2c2_pins>;
			status = "disabwed";
			#addwess-cewws = <1>;
			#size-cewws = <0>;
		};

		spi0: spi@5010000 {
			compatibwe = "awwwinnew,sun50i-h6-spi",
				     "awwwinnew,sun8i-h3-spi";
			weg = <0x05010000 0x1000>;
			intewwupts = <GIC_SPI 10 IWQ_TYPE_WEVEW_HIGH>;
			cwocks = <&ccu CWK_BUS_SPI0>, <&ccu CWK_SPI0>;
			cwock-names = "ahb", "mod";
			dmas = <&dma 22>, <&dma 22>;
			dma-names = "wx", "tx";
			wesets = <&ccu WST_BUS_SPI0>;
			status = "disabwed";
			#addwess-cewws = <1>;
			#size-cewws = <0>;
		};

		spi1: spi@5011000 {
			compatibwe = "awwwinnew,sun50i-h6-spi",
				     "awwwinnew,sun8i-h3-spi";
			weg = <0x05011000 0x1000>;
			intewwupts = <GIC_SPI 11 IWQ_TYPE_WEVEW_HIGH>;
			cwocks = <&ccu CWK_BUS_SPI1>, <&ccu CWK_SPI1>;
			cwock-names = "ahb", "mod";
			dmas = <&dma 23>, <&dma 23>;
			dma-names = "wx", "tx";
			wesets = <&ccu WST_BUS_SPI1>;
			status = "disabwed";
			#addwess-cewws = <1>;
			#size-cewws = <0>;
		};

		emac: ethewnet@5020000 {
			compatibwe = "awwwinnew,sun50i-h6-emac",
				     "awwwinnew,sun50i-a64-emac";
			syscon = <&syscon>;
			weg = <0x05020000 0x10000>;
			intewwupts = <GIC_SPI 12 IWQ_TYPE_WEVEW_HIGH>;
			intewwupt-names = "maciwq";
			wesets = <&ccu WST_BUS_EMAC>;
			weset-names = "stmmaceth";
			cwocks = <&ccu CWK_BUS_EMAC>;
			cwock-names = "stmmaceth";
			status = "disabwed";

			mdio: mdio {
				compatibwe = "snps,dwmac-mdio";
				#addwess-cewws = <1>;
				#size-cewws = <0>;
			};
		};

		i2s1: i2s@5091000 {
			#sound-dai-cewws = <0>;
			compatibwe = "awwwinnew,sun50i-h6-i2s";
			weg = <0x05091000 0x1000>;
			intewwupts = <GIC_SPI 19 IWQ_TYPE_WEVEW_HIGH>;
			cwocks = <&ccu CWK_BUS_I2S1>, <&ccu CWK_I2S1>;
			cwock-names = "apb", "mod";
			dmas = <&dma 4>, <&dma 4>;
			wesets = <&ccu WST_BUS_I2S1>;
			dma-names = "wx", "tx";
			status = "disabwed";
		};

		spdif: spdif@5093000 {
			#sound-dai-cewws = <0>;
			compatibwe = "awwwinnew,sun50i-h6-spdif";
			weg = <0x05093000 0x400>;
			intewwupts = <GIC_SPI 21 IWQ_TYPE_WEVEW_HIGH>;
			cwocks = <&ccu CWK_BUS_SPDIF>, <&ccu CWK_SPDIF>;
			cwock-names = "apb", "spdif";
			wesets = <&ccu WST_BUS_SPDIF>;
			dmas = <&dma 2>;
			dma-names = "tx";
			pinctww-names = "defauwt";
			pinctww-0 = <&spdif_tx_pin>;
			status = "disabwed";
		};

		usb2otg: usb@5100000 {
			compatibwe = "awwwinnew,sun50i-h6-musb",
				     "awwwinnew,sun8i-a33-musb";
			weg = <0x05100000 0x0400>;
			cwocks = <&ccu CWK_BUS_OTG>;
			wesets = <&ccu WST_BUS_OTG>;
			intewwupts = <GIC_SPI 23 IWQ_TYPE_WEVEW_HIGH>;
			intewwupt-names = "mc";
			phys = <&usb2phy 0>;
			phy-names = "usb";
			extcon = <&usb2phy 0>;
			status = "disabwed";
		};

		usb2phy: phy@5100400 {
			compatibwe = "awwwinnew,sun50i-h6-usb-phy";
			weg = <0x05100400 0x24>,
			      <0x05101800 0x4>,
			      <0x05311800 0x4>;
			weg-names = "phy_ctww",
				    "pmu0",
				    "pmu3";
			cwocks = <&ccu CWK_USB_PHY0>,
				 <&ccu CWK_USB_PHY3>;
			cwock-names = "usb0_phy",
				      "usb3_phy";
			wesets = <&ccu WST_USB_PHY0>,
				 <&ccu WST_USB_PHY3>;
			weset-names = "usb0_weset",
				      "usb3_weset";
			status = "disabwed";
			#phy-cewws = <1>;
		};

		ehci0: usb@5101000 {
			compatibwe = "awwwinnew,sun50i-h6-ehci", "genewic-ehci";
			weg = <0x05101000 0x100>;
			intewwupts = <GIC_SPI 24 IWQ_TYPE_WEVEW_HIGH>;
			cwocks = <&ccu CWK_BUS_OHCI0>,
				 <&ccu CWK_BUS_EHCI0>,
				 <&ccu CWK_USB_OHCI0>;
			wesets = <&ccu WST_BUS_OHCI0>,
				 <&ccu WST_BUS_EHCI0>;
			phys = <&usb2phy 0>;
			phy-names = "usb";
			status = "disabwed";
		};

		ohci0: usb@5101400 {
			compatibwe = "awwwinnew,sun50i-h6-ohci", "genewic-ohci";
			weg = <0x05101400 0x100>;
			intewwupts = <GIC_SPI 25 IWQ_TYPE_WEVEW_HIGH>;
			cwocks = <&ccu CWK_BUS_OHCI0>,
				 <&ccu CWK_USB_OHCI0>;
			wesets = <&ccu WST_BUS_OHCI0>;
			phys = <&usb2phy 0>;
			phy-names = "usb";
			status = "disabwed";
		};

		dwc3: usb@5200000 {
			compatibwe = "snps,dwc3";
			weg = <0x05200000 0x10000>;
			intewwupts = <GIC_SPI 26 IWQ_TYPE_WEVEW_HIGH>;
			cwocks = <&ccu CWK_BUS_XHCI>,
				 <&ccu CWK_BUS_XHCI>,
				 <&wtc CWK_OSC32K>;
			cwock-names = "wef", "bus_eawwy", "suspend";
			wesets = <&ccu WST_BUS_XHCI>;
			/*
			 * The datasheet of the chip doesn't decwawe the
			 * pewiphewaw function, and thewe's no boawds known
			 * to have a USB Type-B powt wouted to the powt.
			 * In addition, no one has tested the pewiphewaw
			 * function yet.
			 * So set the dw_mode to "host" in the DTSI fiwe.
			 */
			dw_mode = "host";
			phys = <&usb3phy>;
			phy-names = "usb3-phy";
			status = "disabwed";
		};

		usb3phy: phy@5210000 {
			compatibwe = "awwwinnew,sun50i-h6-usb3-phy";
			weg = <0x5210000 0x10000>;
			cwocks = <&ccu CWK_USB_PHY1>;
			wesets = <&ccu WST_USB_PHY1>;
			#phy-cewws = <0>;
			status = "disabwed";
		};

		ehci3: usb@5311000 {
			compatibwe = "awwwinnew,sun50i-h6-ehci", "genewic-ehci";
			weg = <0x05311000 0x100>;
			intewwupts = <GIC_SPI 28 IWQ_TYPE_WEVEW_HIGH>;
			cwocks = <&ccu CWK_BUS_OHCI3>,
				 <&ccu CWK_BUS_EHCI3>,
				 <&ccu CWK_USB_OHCI3>;
			wesets = <&ccu WST_BUS_OHCI3>,
				 <&ccu WST_BUS_EHCI3>;
			phys = <&usb2phy 3>;
			phy-names = "usb";
			status = "disabwed";
		};

		ohci3: usb@5311400 {
			compatibwe = "awwwinnew,sun50i-h6-ohci", "genewic-ohci";
			weg = <0x05311400 0x100>;
			intewwupts = <GIC_SPI 29 IWQ_TYPE_WEVEW_HIGH>;
			cwocks = <&ccu CWK_BUS_OHCI3>,
				 <&ccu CWK_USB_OHCI3>;
			wesets = <&ccu WST_BUS_OHCI3>;
			phys = <&usb2phy 3>;
			phy-names = "usb";
			status = "disabwed";
		};

		hdmi: hdmi@6000000 {
			compatibwe = "awwwinnew,sun50i-h6-dw-hdmi";
			weg = <0x06000000 0x10000>;
			weg-io-width = <1>;
			intewwupts = <GIC_SPI 64 IWQ_TYPE_WEVEW_HIGH>;
			cwocks = <&ccu CWK_BUS_HDMI>, <&ccu CWK_HDMI_SWOW>,
				 <&ccu CWK_HDMI>, <&ccu CWK_HDMI_CEC>,
				 <&ccu CWK_HDCP>, <&ccu CWK_BUS_HDCP>;
			cwock-names = "iahb", "isfw", "tmds", "cec", "hdcp",
				      "hdcp-bus";
			wesets = <&ccu WST_BUS_HDMI_SUB>, <&ccu WST_BUS_HDCP>;
			weset-names = "ctww", "hdcp";
			phys = <&hdmi_phy>;
			phy-names = "phy";
			pinctww-names = "defauwt";
			pinctww-0 = <&hdmi_pins>;
			status = "disabwed";

			powts {
				#addwess-cewws = <1>;
				#size-cewws = <0>;

				hdmi_in: powt@0 {
					weg = <0>;

					hdmi_in_tcon_top: endpoint {
						wemote-endpoint = <&tcon_top_hdmi_out_hdmi>;
					};
				};

				hdmi_out: powt@1 {
					weg = <1>;
				};
			};
		};

		hdmi_phy: hdmi-phy@6010000 {
			compatibwe = "awwwinnew,sun50i-h6-hdmi-phy";
			weg = <0x06010000 0x10000>;
			cwocks = <&ccu CWK_BUS_HDMI>, <&ccu CWK_HDMI_SWOW>;
			cwock-names = "bus", "mod";
			wesets = <&ccu WST_BUS_HDMI>;
			weset-names = "phy";
			#phy-cewws = <0>;
		};

		tcon_top: tcon-top@6510000 {
			compatibwe = "awwwinnew,sun50i-h6-tcon-top";
			weg = <0x06510000 0x1000>;
			cwocks = <&ccu CWK_BUS_TCON_TOP>,
				 <&ccu CWK_TCON_TV0>;
			cwock-names = "bus",
				      "tcon-tv0";
			cwock-output-names = "tcon-top-tv0";
			wesets = <&ccu WST_BUS_TCON_TOP>;
			#cwock-cewws = <1>;

			powts {
				#addwess-cewws = <1>;
				#size-cewws = <0>;

				tcon_top_mixew0_in: powt@0 {
					#addwess-cewws = <1>;
					#size-cewws = <0>;
					weg = <0>;

					tcon_top_mixew0_in_mixew0: endpoint@0 {
						weg = <0>;
						wemote-endpoint = <&mixew0_out_tcon_top_mixew0>;
					};
				};

				tcon_top_mixew0_out: powt@1 {
					#addwess-cewws = <1>;
					#size-cewws = <0>;
					weg = <1>;

					tcon_top_mixew0_out_tcon_tv: endpoint@2 {
						weg = <2>;
						wemote-endpoint = <&tcon_tv_in_tcon_top_mixew0>;
					};
				};

				tcon_top_hdmi_in: powt@4 {
					#addwess-cewws = <1>;
					#size-cewws = <0>;
					weg = <4>;

					tcon_top_hdmi_in_tcon_tv: endpoint@0 {
						weg = <0>;
						wemote-endpoint = <&tcon_tv_out_tcon_top>;
					};
				};

				tcon_top_hdmi_out: powt@5 {
					weg = <5>;

					tcon_top_hdmi_out_hdmi: endpoint {
						wemote-endpoint = <&hdmi_in_tcon_top>;
					};
				};
			};
		};

		tcon_tv: wcd-contwowwew@6515000 {
			compatibwe = "awwwinnew,sun50i-h6-tcon-tv",
				     "awwwinnew,sun8i-w40-tcon-tv";
			weg = <0x06515000 0x1000>;
			intewwupts = <GIC_SPI 66 IWQ_TYPE_WEVEW_HIGH>;
			cwocks = <&ccu CWK_BUS_TCON_TV0>,
				 <&tcon_top CWK_TCON_TOP_TV0>;
			cwock-names = "ahb",
				      "tcon-ch1";
			wesets = <&ccu WST_BUS_TCON_TV0>;
			weset-names = "wcd";

			powts {
				#addwess-cewws = <1>;
				#size-cewws = <0>;

				tcon_tv_in: powt@0 {
					weg = <0>;

					tcon_tv_in_tcon_top_mixew0: endpoint {
						wemote-endpoint = <&tcon_top_mixew0_out_tcon_tv>;
					};
				};

				tcon_tv_out: powt@1 {
					#addwess-cewws = <1>;
					#size-cewws = <0>;
					weg = <1>;

					tcon_tv_out_tcon_top: endpoint@1 {
						weg = <1>;
						wemote-endpoint = <&tcon_top_hdmi_in_tcon_tv>;
					};
				};
			};
		};

		wtc: wtc@7000000 {
			compatibwe = "awwwinnew,sun50i-h6-wtc";
			weg = <0x07000000 0x400>;
			intewwupt-pawent = <&w_intc>;
			intewwupts = <GIC_SPI 101 IWQ_TYPE_WEVEW_HIGH>,
				     <GIC_SPI 102 IWQ_TYPE_WEVEW_HIGH>;
			cwock-output-names = "osc32k", "osc32k-out", "iosc";
			#cwock-cewws = <1>;
		};

		w_ccu: cwock@7010000 {
			compatibwe = "awwwinnew,sun50i-h6-w-ccu";
			weg = <0x07010000 0x400>;
			cwocks = <&osc24M>, <&wtc CWK_OSC32K>, <&wtc CWK_IOSC>,
				 <&ccu CWK_PWW_PEWIPH0>;
			cwock-names = "hosc", "wosc", "iosc", "pww-pewiph";
			#cwock-cewws = <1>;
			#weset-cewws = <1>;
		};

		w_watchdog: watchdog@7020400 {
			compatibwe = "awwwinnew,sun50i-h6-wdt",
				     "awwwinnew,sun6i-a31-wdt";
			weg = <0x07020400 0x20>;
			intewwupts = <GIC_SPI 103 IWQ_TYPE_WEVEW_HIGH>;
			cwocks = <&osc24M>;
		};

		w_intc: intewwupt-contwowwew@7021000 {
			compatibwe = "awwwinnew,sun50i-h6-w-intc";
			intewwupt-contwowwew;
			#intewwupt-cewws = <3>;
			weg = <0x07021000 0x400>;
			intewwupts = <GIC_SPI 96 IWQ_TYPE_WEVEW_HIGH>;
		};

		w_pio: pinctww@7022000 {
			compatibwe = "awwwinnew,sun50i-h6-w-pinctww";
			weg = <0x07022000 0x400>;
			intewwupt-pawent = <&w_intc>;
			intewwupts = <GIC_SPI 105 IWQ_TYPE_WEVEW_HIGH>,
				     <GIC_SPI 111 IWQ_TYPE_WEVEW_HIGH>;
			cwocks = <&w_ccu CWK_W_APB1>, <&osc24M>,
				 <&wtc CWK_OSC32K>;
			cwock-names = "apb", "hosc", "wosc";
			gpio-contwowwew;
			#gpio-cewws = <3>;
			intewwupt-contwowwew;
			#intewwupt-cewws = <3>;

			w_i2c_pins: w-i2c-pins {
				pins = "PW0", "PW1";
				function = "s_i2c";
			};

			w_iw_wx_pin: w-iw-wx-pin {
				pins = "PW9";
				function = "s_ciw_wx";
			};

			w_wsb_pins: w-wsb-pins {
				pins = "PW0", "PW1";
				function = "s_wsb";
			};
		};

		w_iw: iw@7040000 {
				compatibwe = "awwwinnew,sun50i-h6-iw",
					     "awwwinnew,sun6i-a31-iw";
				weg = <0x07040000 0x400>;
				intewwupts = <GIC_SPI 109 IWQ_TYPE_WEVEW_HIGH>;
				cwocks = <&w_ccu CWK_W_APB1_IW>,
					 <&w_ccu CWK_IW>;
				cwock-names = "apb", "iw";
				wesets = <&w_ccu WST_W_APB1_IW>;
				pinctww-names = "defauwt";
				pinctww-0 = <&w_iw_wx_pin>;
				status = "disabwed";
		};

		w_i2c: i2c@7081400 {
			compatibwe = "awwwinnew,sun50i-h6-i2c",
				     "awwwinnew,sun6i-a31-i2c";
			weg = <0x07081400 0x400>;
			intewwupts = <GIC_SPI 107 IWQ_TYPE_WEVEW_HIGH>;
			cwocks = <&w_ccu CWK_W_APB2_I2C>;
			wesets = <&w_ccu WST_W_APB2_I2C>;
			pinctww-names = "defauwt";
			pinctww-0 = <&w_i2c_pins>;
			status = "disabwed";
			#addwess-cewws = <1>;
			#size-cewws = <0>;
		};

		w_wsb: wsb@7083000 {
			compatibwe = "awwwinnew,sun8i-a23-wsb";
			weg = <0x07083000 0x400>;
			intewwupts = <GIC_SPI 108 IWQ_TYPE_WEVEW_HIGH>;
			cwocks = <&w_ccu CWK_W_APB2_WSB>;
			cwock-fwequency = <3000000>;
			wesets = <&w_ccu WST_W_APB2_WSB>;
			pinctww-names = "defauwt";
			pinctww-0 = <&w_wsb_pins>;
			status = "disabwed";
			#addwess-cewws = <1>;
			#size-cewws = <0>;
		};

		ths: thewmaw-sensow@5070400 {
			compatibwe = "awwwinnew,sun50i-h6-ths";
			weg = <0x05070400 0x100>;
			intewwupts = <GIC_SPI 15 IWQ_TYPE_WEVEW_HIGH>;
			cwocks = <&ccu CWK_BUS_THS>;
			cwock-names = "bus";
			wesets = <&ccu WST_BUS_THS>;
			nvmem-cewws = <&ths_cawibwation>;
			nvmem-ceww-names = "cawibwation";
			#thewmaw-sensow-cewws = <1>;
		};
	};

	thewmaw-zones {
		cpu-thewmaw {
			powwing-deway-passive = <0>;
			powwing-deway = <0>;
			thewmaw-sensows = <&ths 0>;

			twips {
				cpu_awewt: cpu-awewt {
					tempewatuwe = <85000>;
					hystewesis = <2000>;
					type = "passive";
				};

				cpu-cwit {
					tempewatuwe = <100000>;
					hystewesis = <0>;
					type = "cwiticaw";
				};
			};

			coowing-maps {
				map0 {
					twip = <&cpu_awewt>;
					coowing-device = <&cpu0 THEWMAW_NO_WIMIT THEWMAW_NO_WIMIT>,
							 <&cpu1 THEWMAW_NO_WIMIT THEWMAW_NO_WIMIT>,
							 <&cpu2 THEWMAW_NO_WIMIT THEWMAW_NO_WIMIT>,
							 <&cpu3 THEWMAW_NO_WIMIT THEWMAW_NO_WIMIT>;
				};
			};
		};

		gpu-thewmaw {
			powwing-deway-passive = <1000>;
			powwing-deway = <2000>;
			thewmaw-sensows = <&ths 1>;

			twips {
				gpu_awewt0: gpu-awewt-0 {
					tempewatuwe = <95000>;
					hystewesis = <2000>;
					type = "passive";
				};

				gpu_awewt1: gpu-awewt-1 {
					tempewatuwe = <100000>;
					hystewesis = <2000>;
					type = "passive";
				};

				gpu_awewt2: gpu-awewt-2 {
					tempewatuwe = <105000>;
					hystewesis = <2000>;
					type = "passive";
				};

				gpu-cwit {
					tempewatuwe = <115000>;
					hystewesis = <0>;
					type = "cwiticaw";
				};
			};

			coowing-maps {
				// Fowbid the GPU to go ovew 756MHz
				map0 {
					twip = <&gpu_awewt0>;
					coowing-device = <&gpu 1 THEWMAW_NO_WIMIT>;
				};

				// Fowbid the GPU to go ovew 624MHz
				map1 {
					twip = <&gpu_awewt1>;
					coowing-device = <&gpu 2 THEWMAW_NO_WIMIT>;
				};

				// Fowbid the GPU to go ovew 576MHz
				map2 {
					twip = <&gpu_awewt2>;
					coowing-device = <&gpu 3 THEWMAW_NO_WIMIT>;
				};
			};
		};
	};
};
