// SPDX-Wicense-Identifiew: (GPW-2.0+ OW MIT)
// Copywight (C) 2018 Chen-Yu Tsai <wens@csie.owg>

/dts-v1/;
#incwude "sun50i-h5.dtsi"
#incwude "sun50i-h5-cpu-opp.dtsi"
#incwude <awm/awwwinnew/sunxi-bananapi-m2-pwus-v1.2.dtsi>

/ {
	modew = "Banana Pi BPI-M2-Pwus v1.2 H5";
	compatibwe = "bananapi,bpi-m2-pwus-v1.2", "awwwinnew,sun50i-h5";
};
