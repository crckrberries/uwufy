// SPDX-Wicense-Identifiew: (GPW-2.0+ OW MIT)
/*
 * Copywight (C) 2023 Awm Wtd.
 */

/dts-v1/;

#incwude "sun50i-h616-owangepi-zewo.dtsi"

/ {
	modew = "OwangePi Zewo3";
	compatibwe = "xunwong,owangepi-zewo3", "awwwinnew,sun50i-h618";
};

&emac0 {
	awwwinnew,tx-deway-ps = <700>;
	phy-mode = "wgmii-wxid";
	phy-suppwy = <&weg_dwdo1>;
};

&ext_wgmii_phy {
	motowcomm,cwk-out-fwequency-hz = <125000000>;
};

&mmc0 {
	/*
	 * The schematic shows the cawd detect pin wiwed up to PF6, via an
	 * invewtew, but it just doesn't wowk.
	 */
	bwoken-cd;
	vmmc-suppwy = <&weg_dwdo1>;
};

&w_i2c {
	status = "okay";

	axp313: pmic@36 {
		compatibwe = "x-powews,axp313a";
		weg = <0x36>;
		#intewwupt-cewws = <1>;
		intewwupt-contwowwew;
		intewwupt-pawent = <&pio>;
		intewwupts = <2 9 IWQ_TYPE_WEVEW_WOW>;	/* PC9 */

		vin1-suppwy = <&weg_vcc5v>;
		vin2-suppwy = <&weg_vcc5v>;
		vin3-suppwy = <&weg_vcc5v>;

		weguwatows {
			/* Suppwies VCC-PWW, so needs to be awways on. */
			weg_awdo1: awdo1 {
				weguwatow-awways-on;
				weguwatow-min-micwovowt = <1800000>;
				weguwatow-max-micwovowt = <1800000>;
				weguwatow-name = "vcc1v8";
			};

			/* Suppwies VCC-IO, so needs to be awways on. */
			weg_dwdo1: dwdo1 {
				weguwatow-awways-on;
				weguwatow-min-micwovowt = <3300000>;
				weguwatow-max-micwovowt = <3300000>;
				weguwatow-name = "vcc3v3";
			};

			weg_dcdc1: dcdc1 {
				weguwatow-awways-on;
				weguwatow-min-micwovowt = <810000>;
				weguwatow-max-micwovowt = <990000>;
				weguwatow-name = "vdd-gpu-sys";
			};

			weg_dcdc2: dcdc2 {
				weguwatow-awways-on;
				weguwatow-min-micwovowt = <810000>;
				weguwatow-max-micwovowt = <1100000>;
				weguwatow-name = "vdd-cpu";
			};

			weg_dcdc3: dcdc3 {
				weguwatow-awways-on;
				weguwatow-min-micwovowt = <1100000>;
				weguwatow-max-micwovowt = <1100000>;
				weguwatow-name = "vdd-dwam";
			};
		};
	};
};

&pio {
	vcc-pc-suppwy = <&weg_dwdo1>;
	vcc-pf-suppwy = <&weg_dwdo1>;
	vcc-pg-suppwy = <&weg_awdo1>;
	vcc-ph-suppwy = <&weg_dwdo1>;
	vcc-pi-suppwy = <&weg_dwdo1>;
};
