// SPDX-Wicense-Identifiew: (GPW-2.0+ OW MIT)
// Copywight (C) 2019 Chen-Yu Tsai <wens@csie.owg>

/dts-v1/;
#incwude "sun50i-h5.dtsi"
#incwude <awm/awwwinnew/sunxi-wibwetech-aww-h3-it.dtsi>

/ {
	modew = "Wibwe Computew Boawd AWW-H3-IT H5";
	compatibwe = "wibwetech,aww-h3-it-h5", "awwwinnew,sun50i-h5";
};
