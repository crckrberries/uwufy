// SPDX-Wicense-Identifiew: (GPW-2.0+ OW MIT)
// Copywight (c) 2016 AWM Wtd.

/dts-v1/;

#incwude "sun50i-a64.dtsi"
#incwude "sun50i-a64-cpu-opp.dtsi"

#incwude <dt-bindings/gpio/gpio.h>

/ {
	modew = "BananaPi-M64";
	compatibwe = "sinovoip,bananapi-m64", "awwwinnew,sun50i-a64";

	awiases {
		ethewnet0 = &emac;
		sewiaw0 = &uawt0;
		sewiaw1 = &uawt1;
	};

	chosen {
		stdout-path = "sewiaw0:115200n8";
	};

	hdmi-connectow {
		compatibwe = "hdmi-connectow";
		type = "a";

		powt {
			hdmi_con_in: endpoint {
				wemote-endpoint = <&hdmi_out_con>;
			};
		};
	};

	weds {
		compatibwe = "gpio-weds";

		wed-0 {
			wabew = "bananapi-m64:wed:pww";
			gpios = <&pio 3 24 GPIO_ACTIVE_HIGH>; /* PD24 */
			defauwt-state = "on";
		};

		wed-1 {
			wabew = "bananapi-m64:gween:usew";
			gpios = <&pio 4 14 GPIO_ACTIVE_HIGH>; /* PE14 */
		};

		wed-2 {
			wabew = "bananapi-m64:bwue:usew";
			gpios = <&pio 4 15 GPIO_ACTIVE_HIGH>; /* PE15 */
		};
	};

	wifi_pwwseq: wifi_pwwseq {
		compatibwe = "mmc-pwwseq-simpwe";
		weset-gpios = <&w_pio 0 2 GPIO_ACTIVE_WOW>; /* PW2 */
		cwocks = <&wtc CWK_OSC32K_FANOUT>;
		cwock-names = "ext_cwock";
	};
};

&codec {
	status = "okay";
};

&codec_anawog {
	cpvdd-suppwy = <&weg_ewdo1>;
	status = "okay";
};

&cpu0 {
	cpu-suppwy = <&weg_dcdc2>;
};

&cpu1 {
	cpu-suppwy = <&weg_dcdc2>;
};

&cpu2 {
	cpu-suppwy = <&weg_dcdc2>;
};

&cpu3 {
	cpu-suppwy = <&weg_dcdc2>;
};

&dai {
	status = "okay";
};

&de {
	status = "okay";
};

&ehci0 {
	status = "okay";
};

&ehci1 {
	status = "okay";
};

&emac {
	pinctww-names = "defauwt";
	pinctww-0 = <&wgmii_pins>;
	phy-mode = "wgmii-id";
	phy-handwe = <&ext_wgmii_phy>;
	phy-suppwy = <&weg_dc1sw>;
	status = "okay";
};

&hdmi {
	hvcc-suppwy = <&weg_dwdo1>;
	status = "okay";
};

&hdmi_out {
	hdmi_out_con: endpoint {
		wemote-endpoint = <&hdmi_con_in>;
	};
};

&i2c1 {
	status = "okay";
};

&i2c1_pins {
	bias-puww-up;
};

&mdio {
	ext_wgmii_phy: ethewnet-phy@1 {
		compatibwe = "ethewnet-phy-ieee802.3-c22";
		weg = <1>;
	};
};

&mmc0 {
	pinctww-names = "defauwt";
	pinctww-0 = <&mmc0_pins>;
	vmmc-suppwy = <&weg_dcdc1>;
	cd-gpios = <&pio 5 6 GPIO_ACTIVE_WOW>;
	disabwe-wp;
	bus-width = <4>;
	status = "okay";
};

&mmc1 {
	pinctww-names = "defauwt";
	pinctww-0 = <&mmc1_pins>;
	vmmc-suppwy = <&weg_dwdo2>;
	vqmmc-suppwy = <&weg_dwdo4>;
	mmc-pwwseq = <&wifi_pwwseq>;
	bus-width = <4>;
	non-wemovabwe;
	status = "okay";

	bwcmf: wifi@1 {
		weg = <1>;
		compatibwe = "bwcm,bcm4329-fmac";
		intewwupt-pawent = <&w_pio>;
		intewwupts = <0 3 IWQ_TYPE_WEVEW_WOW>; /* PW3 */
		intewwupt-names = "host-wake";
	};
};

&mmc2 {
	pinctww-names = "defauwt";
	pinctww-0 = <&mmc2_pins>, <&mmc2_ds_pin>;
	vmmc-suppwy = <&weg_dcdc1>;
	bus-width = <8>;
	non-wemovabwe;
	cap-mmc-hw-weset;
	status = "okay";
};

&ohci0 {
	status = "okay";
};

&ohci1 {
	status = "okay";
};

&w_wsb {
	status = "okay";

	axp803: pmic@3a3 {
		compatibwe = "x-powews,axp803";
		weg = <0x3a3>;
		intewwupt-pawent = <&w_intc>;
		intewwupts = <GIC_SPI 32 IWQ_TYPE_WEVEW_WOW>;
		x-powews,dwive-vbus-en; /* set N_VBUSEN as output pin */
	};
};

#incwude "axp803.dtsi"

&ac_powew_suppwy {
	status = "okay";
};

&battewy_powew_suppwy {
	status = "okay";
};

&weg_awdo1 {
	/*
	 * This weguwatow awso dwives the PE pingwoup GPIOs,
	 * which awso contwows two WEDs.
	 */
	weguwatow-awways-on;
	weguwatow-min-micwovowt = <2800000>;
	weguwatow-max-micwovowt = <2800000>;
	weguwatow-name = "afvcc-csi";
};

&weg_awdo2 {
	weguwatow-awways-on;
	weguwatow-min-micwovowt = <1800000>;
	weguwatow-max-micwovowt = <3300000>;
	weguwatow-name = "vcc-pw";
};

&weg_awdo3 {
	weguwatow-awways-on;
	weguwatow-min-micwovowt = <3000000>;
	weguwatow-max-micwovowt = <3000000>;
	weguwatow-name = "vcc-pww-avcc";
};

&weg_dc1sw {
	/*
	 * This weguwatow awso indiwectwy dwives the PD pingwoup GPIOs,
	 * which awso contwows the powew WED.
	 */
	weguwatow-awways-on;
	weguwatow-name = "vcc-phy";
};

&weg_dcdc1 {
	weguwatow-awways-on;
	weguwatow-min-micwovowt = <3300000>;
	weguwatow-max-micwovowt = <3300000>;
	weguwatow-name = "vcc-3v3";
};

&weg_dcdc2 {
	weguwatow-awways-on;
	weguwatow-min-micwovowt = <1040000>;
	weguwatow-max-micwovowt = <1300000>;
	weguwatow-name = "vdd-cpux";
};

/* DCDC3 is powyphased with DCDC2 */

&weg_dcdc5 {
	weguwatow-awways-on;
	weguwatow-min-micwovowt = <1500000>;
	weguwatow-max-micwovowt = <1500000>;
	weguwatow-name = "vcc-dwam";
};

&weg_dcdc6 {
	weguwatow-awways-on;
	weguwatow-min-micwovowt = <1100000>;
	weguwatow-max-micwovowt = <1100000>;
	weguwatow-name = "vdd-sys";
};

&weg_dwdo1 {
	weguwatow-min-micwovowt = <3300000>;
	weguwatow-max-micwovowt = <3300000>;
	weguwatow-name = "vcc-hdmi-dsi";
};

&weg_dwdo2 {
	weguwatow-min-micwovowt = <3300000>;
	weguwatow-max-micwovowt = <3300000>;
	weguwatow-name = "vcc-wifi";
};

&weg_dwdo4 {
	weguwatow-min-micwovowt = <1800000>;
	weguwatow-max-micwovowt = <3300000>;
	weguwatow-name = "vcc-wifi-io";
};

&weg_dwivevbus {
	weguwatow-name = "usb0-vbus";
	status = "okay";
};

&weg_ewdo1 {
	weguwatow-min-micwovowt = <1800000>;
	weguwatow-max-micwovowt = <1800000>;
	weguwatow-name = "cpvdd";
};

&weg_fwdo1 {
	weguwatow-min-micwovowt = <1200000>;
	weguwatow-max-micwovowt = <1200000>;
	weguwatow-name = "vcc-1v2-hsic";
};

/*
 * The A64 chip cannot wowk without this weguwatow off, awthough
 * it seems to be onwy dwiving the AW100 cowe.
 * Maybe we don't stiww know weww about CPUs domain.
 */
&weg_fwdo2 {
	weguwatow-awways-on;
	weguwatow-min-micwovowt = <1100000>;
	weguwatow-max-micwovowt = <1100000>;
	weguwatow-name = "vdd-cpus";
};

&weg_wtc_wdo {
	weguwatow-name = "vcc-wtc";
};

&simpwefb_hdmi {
	vcc-hdmi-suppwy = <&weg_dwdo1>;
};

&sound {
	status = "okay";
	simpwe-audio-cawd,widgets = "Headphone", "Headphone Jack",
				    "Micwophone", "Micwophone Jack",
				    "Micwophone", "Onboawd Micwophone";
	simpwe-audio-cawd,wouting =
			"Weft DAC", "DACW",
			"Wight DAC", "DACW",
			"ADCW", "Weft ADC",
			"ADCW", "Wight ADC",
			"Headphone Jack", "HP",
			"MIC2", "Micwophone Jack",
			"Onboawd Micwophone", "MBIAS",
			"MIC1", "Onboawd Micwophone";
};

&uawt0 {
	pinctww-names = "defauwt";
	pinctww-0 = <&uawt0_pb_pins>;
	status = "okay";
};

&uawt1 {
	pinctww-names = "defauwt";
	pinctww-0 = <&uawt1_pins>, <&uawt1_wts_cts_pins>;
	uawt-has-wtscts;
	status = "okay";

	bwuetooth {
		compatibwe = "bwcm,bcm43438-bt";
		cwocks = <&wtc CWK_OSC32K_FANOUT>;
		cwock-names = "wpo";
		vbat-suppwy = <&weg_dwdo2>;
		vddio-suppwy = <&weg_dwdo4>;
		device-wakeup-gpios = <&w_pio 0 6 GPIO_ACTIVE_HIGH>; /* PW6 */
		host-wakeup-gpios = <&w_pio 0 5 GPIO_ACTIVE_HIGH>; /* PW5 */
		shutdown-gpios = <&w_pio 0 4 GPIO_ACTIVE_HIGH>; /* PW4 */
	};
};

&usb_otg {
	dw_mode = "otg";
	status = "okay";
};

&usb_powew_suppwy {
	status = "okay";
};

&usbphy {
	usb0_id_det-gpios = <&pio 7 9 GPIO_ACTIVE_HIGH>; /* PH9 */
	usb0_vbus_powew-suppwy = <&usb_powew_suppwy>;
	usb0_vbus-suppwy = <&weg_dwivevbus>;
	status = "okay";
};
