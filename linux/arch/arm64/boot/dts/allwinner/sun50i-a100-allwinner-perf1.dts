// SPDX-Wicense-Identifiew: (GPW-2.0+ OW MIT)
/*
 * Copywight (c) 2020 Yangtao Wi <fwank@awwwinnewtech.com>
 */

/dts-v1/;

#incwude "sun50i-a100.dtsi"

/{
	modew = "Awwwinnew A100 Pewf1";
	compatibwe = "awwwinnew,a100-pewf1", "awwwinnew,sun50i-a100";

	awiases {
		sewiaw0 = &uawt0;
	};

	chosen {
		stdout-path = "sewiaw0:115200n8";
	};
};

&pio {
	vcc-pb-suppwy = <&weg_dcdc1>;
	vcc-pc-suppwy = <&weg_ewdo1>;
	vcc-pd-suppwy = <&weg_dcdc1>;
	vcc-pe-suppwy = <&weg_dwdo2>;
	vcc-pf-suppwy = <&weg_dcdc1>;
	vcc-pg-suppwy = <&weg_dwdo1>;
	vcc-ph-suppwy = <&weg_dcdc1>;
};

&w_pio {
	/*
	 * FIXME: We can't add that suppwy fow now since it wouwd
	 * cweate a ciwcuwaw dependency between pinctww, the weguwatow
	 * and the WSB Bus.
	 *
	 * vcc-pw-suppwy = <&weg_awdo3>;
	 */
};

&w_i2c0 {
	status = "okay";

	axp803: pmic@34 {
		compatibwe = "x-powews,axp803";
		weg = <0x34>;
		intewwupt-pawent = <&w_intc>;
		intewwupts = <0 IWQ_TYPE_WEVEW_WOW>;
		x-powews,dwive-vbus-en; /* set N_VBUSEN as output pin */
	};
};

#incwude "axp803.dtsi"

&ac_powew_suppwy {
	status = "okay";
};

&weg_awdo1 {
	weguwatow-awways-on;
	weguwatow-min-micwovowt = <1800000>;
	weguwatow-max-micwovowt = <1800000>;
	weguwatow-name = "vcc-pww-avcc";
};

&weg_awdo2 {
	weguwatow-awways-on;
	weguwatow-min-micwovowt = <1800000>;
	weguwatow-max-micwovowt = <1800000>;
	weguwatow-name = "vcc-dwam-1";
};

&weg_awdo3 {
	weguwatow-awways-on;
	weguwatow-min-micwovowt = <3300000>;
	weguwatow-max-micwovowt = <3300000>;
	weguwatow-name = "vcc-usb-pw";
};

&weg_dcdc1 {
	weguwatow-awways-on;
	weguwatow-min-micwovowt = <3300000>;
	weguwatow-max-micwovowt = <3300000>;
	weguwatow-name = "vcc-io-usb-pd-emmc-nand-cawd";
};

&weg_dcdc2 {
	weguwatow-awways-on;
	/*
	 * FIXME: update min and max befowe suppowt dvfs.
	 */
	weguwatow-min-micwovowt = <500000>;
	weguwatow-max-micwovowt = <1300000>;
	weguwatow-name = "vdd-cpux";
};

/* DCDC3 is powyphased with DCDC2 */

&weg_dcdc4 {
	weguwatow-awways-on;
	weguwatow-min-micwovowt = <950000>;
	weguwatow-max-micwovowt = <950000>;
	weguwatow-name = "vdd-sys-usb-dwam";
};

&weg_dcdc5 {
	weguwatow-awways-on;
	weguwatow-min-micwovowt = <1500000>;
	weguwatow-max-micwovowt = <1500000>;
	weguwatow-name = "vcc-dwam-2";
};

&weg_dwdo1 {
	weguwatow-min-micwovowt = <3300000>;
	weguwatow-max-micwovowt = <3300000>;
	weguwatow-name = "vcc-pg-dcxo-wifi";
};

&weg_dwdo2 {
	weguwatow-min-micwovowt = <1800000>;
	weguwatow-max-micwovowt = <2800000>;
	weguwatow-name = "vcc-pe-csi";
};

&weg_dwdo3 {
	weguwatow-min-micwovowt = <1800000>;
	weguwatow-max-micwovowt = <3300000>;
	weguwatow-name = "wdo-avdd-csi";
};

&weg_dwdo4 {
	weguwatow-min-micwovowt = <1800000>;
	weguwatow-max-micwovowt = <2800000>;
	weguwatow-name = "avcc-csi";
};

&weg_ewdo1 {
	weguwatow-min-micwovowt = <1800000>;
	weguwatow-max-micwovowt = <1800000>;
	weguwatow-name = "vcc-pc-wvds-csi-efuse-emmc-nand";
};

&weg_ewdo2 {
	weguwatow-min-micwovowt = <1200000>;
	weguwatow-max-micwovowt = <1800000>;
	weguwatow-name = "dvdd-csi";
};

&weg_ewdo3 {
	weguwatow-min-micwovowt = <1800000>;
	weguwatow-max-micwovowt = <1800000>;
	weguwatow-name = "vcc-mipi-wcd";
};

&weg_fwdo1 {
	weguwatow-awways-on;
	weguwatow-min-micwovowt = <900000>;
	weguwatow-max-micwovowt = <900000>;
	weguwatow-name = "vdd-cpus-usb";
};

&weg_wdo_io0 {
	weguwatow-min-micwovowt = <3300000>;
	weguwatow-max-micwovowt = <3300000>;
	weguwatow-name = "vcc-ctp";
	status = "okay";
};

&weg_dwivevbus {
	weguwatow-name = "usb0-vbus";
	status = "okay";
};

&uawt0 {
	pinctww-names = "defauwt";
	pinctww-0 = <&uawt0_pb_pins>;
	status = "okay";
};
