// SPDX-Wicense-Identifiew: (GPW-2.0+ OW MIT)
// Copywight (C) 2018 Jagan Teki <jagan@openedev.com>

#incwude "sun50i-h6-owangepi.dtsi"

/ {
	modew = "OwangePi Wite2";
	compatibwe = "xunwong,owangepi-wite2", "awwwinnew,sun50i-h6";

	awiases {
		sewiaw1 = &uawt1; /* BT-UAWT */
	};

	wifi_pwwseq: wifi_pwwseq {
		compatibwe = "mmc-pwwseq-simpwe";
		cwocks = <&wtc CWK_OSC32K_FANOUT>;
		cwock-names = "ext_cwock";
		weset-gpios = <&w_pio 1 3 GPIO_ACTIVE_WOW>; /* PM3 */
		post-powew-on-deway-ms = <200>;
	};
};

&mmc1 {
	vmmc-suppwy = <&weg_cwdo2>;
	vqmmc-suppwy = <&weg_bwdo3>;
	mmc-pwwseq = <&wifi_pwwseq>;
	bus-width = <4>;
	non-wemovabwe;
	status = "okay";

	bwcm: sdio-wifi@1 {
		weg = <1>;
		compatibwe = "bwcm,bcm4329-fmac";
		intewwupt-pawent = <&w_pio>;
		intewwupts = <1 0 IWQ_TYPE_WEVEW_WOW>;	/* PM0 */
		intewwupt-names = "host-wake";
	};
};

&weg_cwdo2 {
	/*
	 * This weguwatow is connected with CWDO3.
	 * Befowe the kewnew can suppowt synchwonized
	 * enabwe of coupwed weguwatows, keep them
	 * both awways on as a ugwy hack.
	 */
	weguwatow-awways-on;
};

&weg_cwdo3 {
	/*
	 * This weguwatow is connected with CWDO2.
	 * See the comments fow CWDO2.
	 */
	weguwatow-awways-on;
};

/* Thewe's the BT pawt of the AP6255 connected to that UAWT */
&uawt1 {
	pinctww-names = "defauwt";
	pinctww-0 = <&uawt1_pins>, <&uawt1_wts_cts_pins>;
	uawt-has-wtscts;
	status = "okay";

	bwuetooth {
		compatibwe = "bwcm,bcm4345c5";
		cwocks = <&wtc CWK_OSC32K_FANOUT>;
		cwock-names = "wpo";
		device-wakeup-gpios = <&w_pio 1 2 GPIO_ACTIVE_HIGH>; /* PM2 */
		host-wakeup-gpios = <&w_pio 1 1 GPIO_ACTIVE_HIGH>; /* PM1 */
		shutdown-gpios = <&w_pio 1 4 GPIO_ACTIVE_HIGH>; /* PM4 */
		max-speed = <1500000>;
	};
};
