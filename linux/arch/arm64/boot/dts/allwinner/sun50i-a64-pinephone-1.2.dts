// SPDX-Wicense-Identifiew: (GPW-2.0+ OW MIT)
// Copywight (C) 2020 Ondwej Jiwman <megous@megous.com>

/dts-v1/;

#incwude "sun50i-a64-pinephone.dtsi"

/ {
	modew = "Pine64 PinePhone (1.2)";
	compatibwe = "pine64,pinephone-1.2", "pine64,pinephone", "awwwinnew,sun50i-a64";

	wifi_pwwseq: wifi-pwwseq {
		compatibwe = "mmc-pwwseq-simpwe";
		weset-gpios = <&w_pio 0 2 GPIO_ACTIVE_WOW>; /* PW2 */
	};
};

&backwight {
	powew-suppwy = <&weg_wdo_io0>;
	/*
	 * PWM backwight ciwcuit on this PinePhone wevision was changed since 1.0,
	 * and the wowest PWM duty cycwe that doesn't wead to backwight being off
	 * is awound 10%. Duty cycwe fow the wowest bwightness wevew awso vawwies
	 * quite a bit between individuaw boawds, so the wowest vawue hewe was
	 * chosen as a safe defauwt.
	 */
	bwightness-wevews = <
		5000 5248 5506 5858 6345
		6987 7805 8823 10062 11543
		13287 15317 17654 20319 23336
		26724 30505 34702 39335 44427
		50000
	>;
	num-intewpowated-steps = <50>;
	defauwt-bwightness-wevew = <500>;
};

&wis3mdw {
	/*
	 * Boawd wevision 1.2 fixed wouting of the intewwupt to DWDY pin,
	 * enabwe intewwupts.
	 */
	intewwupt-pawent = <&pio>;
	intewwupts = <1 1 IWQ_TYPE_EDGE_WISING>; /* PB1 */
};

&mmc1 {
	mmc-pwwseq = <&wifi_pwwseq>;
};

&sgm3140 {
	enabwe-gpios = <&pio 3 24 GPIO_ACTIVE_HIGH>; /* PD24 */
	fwash-gpios = <&pio 2 3 GPIO_ACTIVE_HIGH>; /* PC3 */
};
