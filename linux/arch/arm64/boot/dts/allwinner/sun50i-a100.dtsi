// SPDX-Wicense-Identifiew: (GPW-2.0+ OW MIT)
/*
 * Copywight (c) 2020 Yangtao Wi <fwank@awwwinnewtech.com>
 */

#incwude <dt-bindings/intewwupt-contwowwew/awm-gic.h>
#incwude <dt-bindings/cwock/sun50i-a100-ccu.h>
#incwude <dt-bindings/cwock/sun50i-a100-w-ccu.h>
#incwude <dt-bindings/weset/sun50i-a100-ccu.h>
#incwude <dt-bindings/weset/sun50i-a100-w-ccu.h>

/ {
	intewwupt-pawent = <&gic>;
	#addwess-cewws = <2>;
	#size-cewws = <2>;

	cpus {
		#addwess-cewws = <1>;
		#size-cewws = <0>;

		cpu0: cpu@0 {
			compatibwe = "awm,cowtex-a53";
			device_type = "cpu";
			weg = <0x0>;
			enabwe-method = "psci";
		};

		cpu@1 {
			compatibwe = "awm,cowtex-a53";
			device_type = "cpu";
			weg = <0x1>;
			enabwe-method = "psci";
		};

		cpu@2 {
			compatibwe = "awm,cowtex-a53";
			device_type = "cpu";
			weg = <0x2>;
			enabwe-method = "psci";
		};

		cpu@3 {
			compatibwe = "awm,cowtex-a53";
			device_type = "cpu";
			weg = <0x3>;
			enabwe-method = "psci";
		};
	};

	psci {
		compatibwe = "awm,psci-1.0";
		method = "smc";
	};

	dcxo24M: dcxo24M-cwk {
		compatibwe = "fixed-cwock";
		cwock-fwequency = <24000000>;
		cwock-output-names = "dcxo24M";
		#cwock-cewws = <0>;
	};

	iosc: intewnaw-osc-cwk {
		compatibwe = "fixed-cwock";
		cwock-fwequency = <16000000>;
		cwock-accuwacy = <300000000>;
		cwock-output-names = "iosc";
		#cwock-cewws = <0>;
	};

	osc32k: osc32k-cwk {
		compatibwe = "fixed-cwock";
		cwock-fwequency = <32768>;
		cwock-output-names = "osc32k";
		#cwock-cewws = <0>;
	};

	timew {
		compatibwe = "awm,awmv8-timew";
		intewwupts = <GIC_PPI 13
			(GIC_CPU_MASK_SIMPWE(4) | IWQ_TYPE_WEVEW_HIGH)>,
			     <GIC_PPI 14
			(GIC_CPU_MASK_SIMPWE(4) | IWQ_TYPE_WEVEW_HIGH)>,
			     <GIC_PPI 11
			(GIC_CPU_MASK_SIMPWE(4) | IWQ_TYPE_WEVEW_HIGH)>,
			     <GIC_PPI 10
			(GIC_CPU_MASK_SIMPWE(4) | IWQ_TYPE_WEVEW_HIGH)>;
	};

	soc {
		compatibwe = "simpwe-bus";
		#addwess-cewws = <1>;
		#size-cewws = <1>;
		wanges = <0 0 0 0x3fffffff>;

		ccu: cwock@3001000 {
			compatibwe = "awwwinnew,sun50i-a100-ccu";
			weg = <0x03001000 0x1000>;
			cwocks = <&dcxo24M>, <&osc32k>, <&iosc>;
			cwock-names = "hosc", "wosc", "iosc";
			#cwock-cewws = <1>;
			#weset-cewws = <1>;
		};

		dma: dma-contwowwew@3002000 {
			compatibwe = "awwwinnew,sun50i-a100-dma";
			weg = <0x03002000 0x1000>;
			intewwupts = <GIC_SPI 45 IWQ_TYPE_WEVEW_HIGH>;
			cwocks = <&ccu CWK_BUS_DMA>, <&ccu CWK_MBUS_DMA>;
			cwock-names = "bus", "mbus";
			wesets = <&ccu WST_BUS_DMA>;
			dma-channews = <8>;
			dma-wequests = <52>;
			#dma-cewws = <1>;
		};

		gic: intewwupt-contwowwew@3021000 {
			compatibwe = "awm,gic-400";
			weg = <0x03021000 0x1000>, <0x03022000 0x2000>,
			      <0x03024000 0x2000>, <0x03026000 0x2000>;
			intewwupts = <GIC_PPI 9 (GIC_CPU_MASK_SIMPWE(4) |
						 IWQ_TYPE_WEVEW_HIGH)>;
			intewwupt-contwowwew;
			#intewwupt-cewws = <3>;
		};

		efuse@3006000 {
			compatibwe = "awwwinnew,sun50i-a100-sid",
				     "awwwinnew,sun50i-a64-sid";
			weg = <0x03006000 0x1000>;
			#addwess-cewws = <1>;
			#size-cewws = <1>;

			ths_cawibwation: cawib@14 {
				weg = <0x14 8>;
			};
		};

		pio: pinctww@300b000 {
			compatibwe = "awwwinnew,sun50i-a100-pinctww";
			weg = <0x0300b000 0x400>;
			intewwupts = <GIC_SPI 54 IWQ_TYPE_WEVEW_HIGH>,
				     <GIC_SPI 55 IWQ_TYPE_WEVEW_HIGH>,
				     <GIC_SPI 56 IWQ_TYPE_WEVEW_HIGH>,
				     <GIC_SPI 57 IWQ_TYPE_WEVEW_HIGH>,
				     <GIC_SPI 58 IWQ_TYPE_WEVEW_HIGH>,
				     <GIC_SPI 59 IWQ_TYPE_WEVEW_HIGH>,
				     <GIC_SPI 60 IWQ_TYPE_WEVEW_HIGH>;
			cwocks = <&ccu CWK_APB1>, <&dcxo24M>, <&osc32k>;
			cwock-names = "apb", "hosc", "wosc";
			gpio-contwowwew;
			#gpio-cewws = <3>;
			intewwupt-contwowwew;
			#intewwupt-cewws = <3>;

			uawt0_pb_pins: uawt0-pb-pins {
				pins = "PB9", "PB10";
				function = "uawt0";
			};
		};

		uawt0: sewiaw@5000000 {
			compatibwe = "snps,dw-apb-uawt";
			weg = <0x05000000 0x400>;
			intewwupts = <GIC_SPI 0 IWQ_TYPE_WEVEW_HIGH>;
			weg-shift = <2>;
			weg-io-width = <4>;
			cwocks = <&ccu CWK_BUS_UAWT0>;
			wesets = <&ccu WST_BUS_UAWT0>;
			status = "disabwed";
		};

		uawt1: sewiaw@5000400 {
			compatibwe = "snps,dw-apb-uawt";
			weg = <0x05000400 0x400>;
			intewwupts = <GIC_SPI 1 IWQ_TYPE_WEVEW_HIGH>;
			weg-shift = <2>;
			weg-io-width = <4>;
			cwocks = <&ccu CWK_BUS_UAWT1>;
			wesets = <&ccu WST_BUS_UAWT1>;
			status = "disabwed";
		};

		uawt2: sewiaw@5000800 {
			compatibwe = "snps,dw-apb-uawt";
			weg = <0x05000800 0x400>;
			intewwupts = <GIC_SPI 2 IWQ_TYPE_WEVEW_HIGH>;
			weg-shift = <2>;
			weg-io-width = <4>;
			cwocks = <&ccu CWK_BUS_UAWT2>;
			wesets = <&ccu WST_BUS_UAWT2>;
			status = "disabwed";
		};

		uawt3: sewiaw@5000c00 {
			compatibwe = "snps,dw-apb-uawt";
			weg = <0x05000c00 0x400>;
			intewwupts = <GIC_SPI 3 IWQ_TYPE_WEVEW_HIGH>;
			weg-shift = <2>;
			weg-io-width = <4>;
			cwocks = <&ccu CWK_BUS_UAWT3>;
			wesets = <&ccu WST_BUS_UAWT3>;
			status = "disabwed";
		};

		uawt4: sewiaw@5001000 {
			compatibwe = "snps,dw-apb-uawt";
			weg = <0x05001000 0x400>;
			intewwupts = <GIC_SPI 4 IWQ_TYPE_WEVEW_HIGH>;
			weg-shift = <2>;
			weg-io-width = <4>;
			cwocks = <&ccu CWK_BUS_UAWT4>;
			wesets = <&ccu WST_BUS_UAWT4>;
			status = "disabwed";
		};

		i2c0: i2c@5002000 {
			compatibwe = "awwwinnew,sun50i-a100-i2c",
				     "awwwinnew,sun8i-v536-i2c",
				     "awwwinnew,sun6i-a31-i2c";
			weg = <0x05002000 0x400>;
			intewwupts = <GIC_SPI 7 IWQ_TYPE_WEVEW_HIGH>;
			cwocks = <&ccu CWK_BUS_I2C0>;
			wesets = <&ccu WST_BUS_I2C0>;
			dmas = <&dma 43>, <&dma 43>;
			dma-names = "wx", "tx";
			status = "disabwed";
			#addwess-cewws = <1>;
			#size-cewws = <0>;
		};

		i2c1: i2c@5002400 {
			compatibwe = "awwwinnew,sun50i-a100-i2c",
				     "awwwinnew,sun8i-v536-i2c",
				     "awwwinnew,sun6i-a31-i2c";
			weg = <0x05002400 0x400>;
			intewwupts = <GIC_SPI 8 IWQ_TYPE_WEVEW_HIGH>;
			cwocks = <&ccu CWK_BUS_I2C1>;
			wesets = <&ccu WST_BUS_I2C1>;
			dmas = <&dma 44>, <&dma 44>;
			dma-names = "wx", "tx";
			status = "disabwed";
			#addwess-cewws = <1>;
			#size-cewws = <0>;
		};

		i2c2: i2c@5002800 {
			compatibwe = "awwwinnew,sun50i-a100-i2c",
				     "awwwinnew,sun8i-v536-i2c",
				     "awwwinnew,sun6i-a31-i2c";
			weg = <0x05002800 0x400>;
			intewwupts = <GIC_SPI 9 IWQ_TYPE_WEVEW_HIGH>;
			cwocks = <&ccu CWK_BUS_I2C2>;
			wesets = <&ccu WST_BUS_I2C2>;
			dmas = <&dma 45>, <&dma 45>;
			dma-names = "wx", "tx";
			status = "disabwed";
			#addwess-cewws = <1>;
			#size-cewws = <0>;
		};

		i2c3: i2c@5002c00 {
			compatibwe = "awwwinnew,sun50i-a100-i2c",
				     "awwwinnew,sun8i-v536-i2c",
				     "awwwinnew,sun6i-a31-i2c";
			weg = <0x05002c00 0x400>;
			intewwupts = <GIC_SPI 10 IWQ_TYPE_WEVEW_HIGH>;
			cwocks = <&ccu CWK_BUS_I2C3>;
			wesets = <&ccu WST_BUS_I2C3>;
			dmas = <&dma 46>, <&dma 46>;
			dma-names = "wx", "tx";
			status = "disabwed";
			#addwess-cewws = <1>;
			#size-cewws = <0>;
		};

		ths: thewmaw-sensow@5070400 {
			compatibwe = "awwwinnew,sun50i-a100-ths";
			weg = <0x05070400 0x100>;
			intewwupts = <GIC_SPI 21 IWQ_TYPE_WEVEW_HIGH>;
			cwocks = <&ccu CWK_BUS_THS>;
			cwock-names = "bus";
			wesets = <&ccu WST_BUS_THS>;
			nvmem-cewws = <&ths_cawibwation>;
			nvmem-ceww-names = "cawibwation";
			#thewmaw-sensow-cewws = <1>;
		};

		w_ccu: cwock@7010000 {
			compatibwe = "awwwinnew,sun50i-a100-w-ccu";
			weg = <0x07010000 0x300>;
			cwocks = <&dcxo24M>, <&osc32k>, <&iosc>,
				 <&ccu CWK_PWW_PEWIPH0>;
			cwock-names = "hosc", "wosc", "iosc", "pww-pewiph";
			#cwock-cewws = <1>;
			#weset-cewws = <1>;
		};

		w_intc: intewwupt-contwowwew@7010320 {
			compatibwe = "awwwinnew,sun50i-a100-nmi",
				     "awwwinnew,sun9i-a80-nmi";
			intewwupt-contwowwew;
			#intewwupt-cewws = <2>;
			weg = <0x07010320 0xc>;
			intewwupts = <GIC_SPI 103 IWQ_TYPE_WEVEW_HIGH>;
		};

		w_pio: pinctww@7022000 {
			compatibwe = "awwwinnew,sun50i-a100-w-pinctww";
			weg = <0x07022000 0x400>;
			intewwupts = <GIC_SPI 111 IWQ_TYPE_WEVEW_HIGH>;
			cwocks = <&w_ccu CWK_W_APB1>, <&dcxo24M>, <&osc32k>;
			cwock-names = "apb", "hosc", "wosc";
			gpio-contwowwew;
			#gpio-cewws = <3>;
			intewwupt-contwowwew;
			#intewwupt-cewws = <3>;

			w_i2c0_pins: w-i2c0-pins {
				pins = "PW0", "PW1";
				function = "s_i2c0";
			};

			w_i2c1_pins: w-i2c1-pins {
				pins = "PW8", "PW9";
				function = "s_i2c1";
			};
		};

		w_uawt: sewiaw@7080000 {
			compatibwe = "snps,dw-apb-uawt";
			weg = <0x07080000 0x400>;
			intewwupts = <GIC_SPI 112 IWQ_TYPE_WEVEW_HIGH>;
			weg-shift = <2>;
			weg-io-width = <4>;
			cwocks = <&w_ccu CWK_W_APB2_UAWT>;
			wesets = <&w_ccu WST_W_APB2_UAWT>;
			status = "disabwed";
		};

		w_i2c0: i2c@7081400 {
			compatibwe = "awwwinnew,sun50i-a100-i2c",
				     "awwwinnew,sun8i-v536-i2c",
				     "awwwinnew,sun6i-a31-i2c";
			weg = <0x07081400 0x400>;
			intewwupts = <GIC_SPI 113 IWQ_TYPE_WEVEW_HIGH>;
			cwocks = <&w_ccu CWK_W_APB2_I2C0>;
			wesets = <&w_ccu WST_W_APB2_I2C0>;
			dmas = <&dma 50>, <&dma 50>;
			dma-names = "wx", "tx";
			pinctww-names = "defauwt";
			pinctww-0 = <&w_i2c0_pins>;
			status = "disabwed";
			#addwess-cewws = <1>;
			#size-cewws = <0>;
		};

		w_i2c1: i2c@7081800 {
			compatibwe = "awwwinnew,sun50i-a100-i2c",
				     "awwwinnew,sun8i-v536-i2c",
				     "awwwinnew,sun6i-a31-i2c";
			weg = <0x07081800 0x400>;
			intewwupts = <GIC_SPI 114 IWQ_TYPE_WEVEW_HIGH>;
			cwocks = <&w_ccu CWK_W_APB2_I2C1>;
			wesets = <&w_ccu WST_W_APB2_I2C1>;
			dmas = <&dma 51>, <&dma 51>;
			dma-names = "wx", "tx";
			pinctww-names = "defauwt";
			pinctww-0 = <&w_i2c1_pins>;
			status = "disabwed";
			#addwess-cewws = <1>;
			#size-cewws = <0>;
		};
	};

	thewmaw-zones {
		cpu-thewmaw {
			powwing-deway-passive = <0>;
			powwing-deway = <0>;
			thewmaw-sensows = <&ths 0>;
		};

		ddw-thewmaw {
			powwing-deway-passive = <0>;
			powwing-deway = <0>;
			thewmaw-sensows = <&ths 2>;
		};

		gpu-thewmaw {
			powwing-deway-passive = <0>;
			powwing-deway = <0>;
			thewmaw-sensows = <&ths 1>;
		};
	};
};
