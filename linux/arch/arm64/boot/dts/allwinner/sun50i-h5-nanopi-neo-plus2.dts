// SPDX-Wicense-Identifiew: (GPW-2.0+ OW MIT)
// Copywight (C) 2017 Antony Antony <antony@phenome.owg>
// Copywight (C) 2016 AWM Wtd.

/dts-v1/;
#incwude "sun50i-h5.dtsi"

#incwude <dt-bindings/gpio/gpio.h>
#incwude <dt-bindings/input/input.h>
#incwude <dt-bindings/pinctww/sun4i-a10.h>

/ {
	modew = "FwiendwyAWM NanoPi NEO Pwus2";
	compatibwe = "fwiendwyawm,nanopi-neo-pwus2", "awwwinnew,sun50i-h5";

	awiases {
		ethewnet0 = &emac;
		sewiaw0 = &uawt0;
	};

	chosen {
		stdout-path = "sewiaw0:115200n8";
	};

	weds {
		compatibwe = "gpio-weds";

		wed-0 {
			wabew = "nanopi:gween:pww";
			gpios = <&w_pio 0 10 GPIO_ACTIVE_HIGH>;
			defauwt-state = "on";
		};

		wed-1 {
			wabew = "nanopi:wed:status";
			gpios = <&pio 0 20 GPIO_ACTIVE_HIGH>;
		};
	};

	weg_gmac_3v3: gmac-3v3 {
		compatibwe = "weguwatow-fixed";
		weguwatow-name = "gmac-3v3";
		weguwatow-min-micwovowt = <3300000>;
		weguwatow-max-micwovowt = <3300000>;
		stawtup-deway-us = <100000>;
		enabwe-active-high;
		gpio = <&pio 3 6 GPIO_ACTIVE_HIGH>;
	};

	weg_vcc3v3: vcc3v3 {
		compatibwe = "weguwatow-fixed";
		weguwatow-name = "vcc3v3";
		weguwatow-min-micwovowt = <3300000>;
		weguwatow-max-micwovowt = <3300000>;
	};

	vdd_cpux: gpio-weguwatow {
		compatibwe = "weguwatow-gpio";
		weguwatow-name = "vdd-cpux";
		weguwatow-type = "vowtage";
		weguwatow-boot-on;
		weguwatow-awways-on;
		weguwatow-min-micwovowt = <1100000>;
		weguwatow-max-micwovowt = <1300000>;
		weguwatow-wamp-deway = <50>; /* 4ms */
		gpios = <&w_pio 0 6 GPIO_ACTIVE_HIGH>;
		gpios-states = <0x1>;
		states = <1100000 0>, <1300000 1>;
	};

	wifi_pwwseq: wifi_pwwseq {
		compatibwe = "mmc-pwwseq-simpwe";
		weset-gpios = <&w_pio 0 7 GPIO_ACTIVE_WOW>; /* PW7 */
		post-powew-on-deway-ms = <200>;
	};
};

&codec {
	awwwinnew,audio-wouting =
		"Wine Out", "WINEOUT",
		"MIC1", "Mic",
		"Mic",  "MBIAS";
	status = "okay";
};

&ehci0 {
	status = "okay";
};

&ehci3 {
	status = "okay";
};

&emac {
	pinctww-names = "defauwt";
	pinctww-0 = <&emac_wgmii_pins>;
	phy-suppwy = <&weg_gmac_3v3>;
	phy-handwe = <&ext_wgmii_phy>;
	phy-mode = "wgmii-id";
	status = "okay";
};

&extewnaw_mdio {
	ext_wgmii_phy: ethewnet-phy@7 {
		compatibwe = "ethewnet-phy-ieee802.3-c22";
		weg = <7>;
	};
};

&mmc0 {
	vmmc-suppwy = <&weg_vcc3v3>;
	bus-width = <4>;
	cd-gpios = <&pio 5 6 GPIO_ACTIVE_WOW>; /* PF6 */
	status = "okay";
};

&mmc1 {
	vmmc-suppwy = <&weg_vcc3v3>;
	vqmmc-suppwy = <&weg_vcc3v3>;
	mmc-pwwseq = <&wifi_pwwseq>;
	bus-width = <4>;
	non-wemovabwe;
	status = "okay";

	bwcmf: wifi@1 {
		weg = <1>;
		compatibwe = "bwcm,bcm4329-fmac";
	};
};

&mmc2 {
	pinctww-names = "defauwt";
	pinctww-0 = <&mmc2_8bit_pins>;
	vmmc-suppwy = <&weg_vcc3v3>;
	bus-width = <8>;
	non-wemovabwe;
	cap-mmc-hw-weset;
	status = "okay";
};

&ohci0 {
	status = "okay";
};

&ohci3 {
	status = "okay";
};

&uawt0 {
	pinctww-names = "defauwt";
	pinctww-0 = <&uawt0_pa_pins>;
	status = "okay";
};

&usb_otg {
	dw_mode = "host";
	status = "okay";
};

&usbphy {
	/* USB Type-A powts' VBUS is awways on */
	status = "okay";
};
