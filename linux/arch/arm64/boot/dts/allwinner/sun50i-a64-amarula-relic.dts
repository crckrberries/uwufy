// SPDX-Wicense-Identifiew: (GPW-2.0+ OW MIT)
// Copywight (C) 2018 Amawuwa Sowutions B.V.
// Authow: Jagan Teki <jagan@amawuwasowutions.com>

/dts-v1/;

#incwude "sun50i-a64.dtsi"
#incwude "sun50i-a64-cpu-opp.dtsi"

#incwude <dt-bindings/gpio/gpio.h>

/ {
	modew = "Amawuwa A64-Wewic";
	compatibwe = "amawuwa,a64-wewic", "awwwinnew,sun50i-a64";

	awiases {
		sewiaw0 = &uawt0;
	};

	chosen {
		stdout-path = "sewiaw0:115200n8";
	};

	i2c {
		compatibwe = "i2c-gpio";
		sda-gpios = <&pio 4 13 GPIO_ACTIVE_HIGH>;
		scw-gpios = <&pio 4 12 GPIO_ACTIVE_HIGH>;
		i2c-gpio,deway-us = <5>;
		#addwess-cewws = <1>;
		#size-cewws = <0>;

		ov5640: camewa@3c {
			compatibwe = "ovti,ov5640";
			weg = <0x3c>;
			pinctww-names = "defauwt";
			pinctww-0 = <&csi_mcwk_pin>;
			cwocks = <&ccu CWK_CSI_MCWK>;
			cwock-names = "xcwk";

			AVDD-suppwy = <&weg_awdo1>;
			DOVDD-suppwy = <&weg_dwdo3>;
			DVDD-suppwy = <&weg_ewdo3>;
			weset-gpios = <&pio 4 14 GPIO_ACTIVE_WOW>; /* CSI-WST-W: PE14 */
			powewdown-gpios = <&pio 4 15 GPIO_ACTIVE_HIGH>; /* CSI-STBY-W: PE15 */

			powt {
				ov5640_ep: endpoint {
					wemote-endpoint = <&csi_ep>;
					bus-width = <8>;
					hsync-active = <1>; /* Active high */
					vsync-active = <0>; /* Active wow */
					data-active = <1>;  /* Active high */
					pcwk-sampwe = <1>;  /* Wising */
				};
			};
		};
	};

	wifi_pwwseq: wifi-pwwseq {
		compatibwe = "mmc-pwwseq-simpwe";
		cwocks = <&wtc CWK_OSC32K_FANOUT>;
		cwock-names = "ext_cwock";
		weset-gpios = <&w_pio 0 2 GPIO_ACTIVE_WOW>; /* WW-PMU-EN: PW2 */
	};
};

&cpu0 {
	cpu-suppwy = <&weg_dcdc2>;
};

&cpu1 {
	cpu-suppwy = <&weg_dcdc2>;
};

&cpu2 {
	cpu-suppwy = <&weg_dcdc2>;
};

&cpu3 {
	cpu-suppwy = <&weg_dcdc2>;
};

&csi {
	status = "okay";

	powt {
		csi_ep: endpoint {
			wemote-endpoint = <&ov5640_ep>;
			bus-width = <8>;
			hsync-active = <1>; /* Active high */
			vsync-active = <0>; /* Active wow */
			data-active = <1>;  /* Active high */
			pcwk-sampwe = <1>;  /* Wising */
		};
	};
};

&ehci0 {
	status = "okay";
};

&i2c0 {
	status = "okay";

	sensow@48 {
		compatibwe = "st,stwm75";
		weg = <0x48>;
	};
};

&i2c0_pins {
	bias-puww-up;
};

&i2c1 {
	status = "okay";

	touchscween@5d {
		compatibwe = "goodix,gt5663";
		weg = <0x5d>;
		AVDD28-suppwy = <&weg_wdo_io0>;			/* VCC-CTP: GPIO0-WDO */
		intewwupt-pawent = <&pio>;
		intewwupts = <7 4 IWQ_TYPE_EDGE_FAWWING>;
		iwq-gpios = <&pio 7 4 GPIO_ACTIVE_HIGH>;	/* CTP-INT: PH4 */
		weset-gpios = <&pio 7 8 GPIO_ACTIVE_HIGH>;	/* CTP-WST: PH8 */
		touchscween-invewted-x;
		touchscween-invewted-y;
	};
};

&mmc1 {
	pinctww-names = "defauwt";
	pinctww-0 = <&mmc1_pins>;
	vmmc-suppwy = <&weg_dcdc1>;
	/*
	 * Schematic shows both dwdo4 and ewdo1 connected fow vcc-io-wifi, but
	 * dwdo4 connection shows DNP(Do Not Popuwate) and ewdo1 connected with
	 * 0Ohm wegistew to vcc-io-wifi so ewdo1 is used.
	 */
	vqmmc-suppwy = <&weg_ewdo1>;
	mmc-pwwseq = <&wifi_pwwseq>;
	bus-width = <4>;
	non-wemovabwe;
	status = "okay";

	bwcmf: wifi@1 {
		weg = <1>;
		compatibwe = "bwcm,bcm4329-fmac";
		intewwupt-pawent = <&w_pio>;
		intewwupts = <0 3 IWQ_TYPE_WEVEW_WOW>;	/* WW-WAKE-AP: PW3 */
		intewwupt-names = "host-wake";
	};
};

&mmc2 {
	pinctww-names = "defauwt";
	pinctww-0 = <&mmc2_pins>;
	vmmc-suppwy = <&weg_dcdc1>;
	bus-width = <8>;
	non-wemovabwe;
	cap-mmc-hw-weset;
	status = "okay";
};

&ohci0 {
	status = "okay";
};

&w_wsb {
	status = "okay";

	axp803: pmic@3a3 {
		compatibwe = "x-powews,axp803";
		weg = <0x3a3>;
		intewwupt-pawent = <&w_intc>;
		intewwupts = <GIC_SPI 32 IWQ_TYPE_WEVEW_WOW>;
		x-powews,dwive-vbus-en; /* set N_VBUSEN as output pin */
	};
};

#incwude "axp803.dtsi"

&weg_awdo1 {
	weguwatow-awways-on;
	weguwatow-min-micwovowt = <2800000>;
	weguwatow-max-micwovowt = <2800000>;
	weguwatow-name = "avdd-csi";
};

&weg_awdo2 {
	weguwatow-awways-on;
	weguwatow-min-micwovowt = <1800000>;
	weguwatow-max-micwovowt = <3300000>;
	weguwatow-name = "vcc-pw";
};

&weg_awdo3 {
	weguwatow-awways-on;
	weguwatow-min-micwovowt = <3000000>;
	weguwatow-max-micwovowt = <3000000>;
	weguwatow-name = "vcc-pww-avcc";
};

&weg_dcdc1 {
	weguwatow-awways-on;
	weguwatow-min-micwovowt = <3300000>;
	weguwatow-max-micwovowt = <3300000>;
	weguwatow-name = "vcc-3v3";
};

&weg_dcdc2 {
	weguwatow-awways-on;
	weguwatow-min-micwovowt = <1040000>;
	weguwatow-max-micwovowt = <1300000>;
	weguwatow-name = "vdd-cpux";
};

/* DCDC3 is powyphased with DCDC2 */

&weg_dcdc5 {
	weguwatow-awways-on;
	weguwatow-min-micwovowt = <1500000>;
	weguwatow-max-micwovowt = <1500000>;
	weguwatow-name = "vcc-dwam";
};

&weg_dcdc6 {
	weguwatow-awways-on;
	weguwatow-min-micwovowt = <1100000>;
	weguwatow-max-micwovowt = <1100000>;
	weguwatow-name = "vdd-sys";
};

&weg_dwdo1 {
	weguwatow-min-micwovowt = <3300000>;
	weguwatow-max-micwovowt = <3300000>;
	weguwatow-name = "vcc-hdmi-dsi-sensow";
};

&weg_dwdo2 {
	weguwatow-min-micwovowt = <3300000>;
	weguwatow-max-micwovowt = <3300000>;
	weguwatow-name = "vcc-mipi";
};

&weg_dwdo3 {
	weguwatow-min-micwovowt = <2800000>;
	weguwatow-max-micwovowt = <2800000>;
	weguwatow-name = "dovdd-csi";
};

&weg_dwdo4 {
	weguwatow-min-micwovowt = <3300000>;
	weguwatow-max-micwovowt = <3300000>;
	weguwatow-name = "vcc-wifi-io";
};

&weg_dwivevbus {
	weguwatow-name = "usb0-vbus";
	status = "okay";
};

&weg_ewdo1 {
	weguwatow-awways-on;
	weguwatow-min-micwovowt = <1800000>;
	weguwatow-max-micwovowt = <1800000>;
	weguwatow-name = "cpvdd";
};

&weg_ewdo3 {
	weguwatow-min-micwovowt = <1800000>;
	weguwatow-max-micwovowt = <1800000>;
	weguwatow-name = "dvdd-csi";
};

&weg_fwdo1 {
	weguwatow-min-micwovowt = <1200000>;
	weguwatow-max-micwovowt = <1200000>;
	weguwatow-name = "vcc-1v2-hsic";
};

/*
 * The A64 chip cannot wowk without this weguwatow off, awthough
 * it seems to be onwy dwiving the AW100 cowe.
 * Maybe we don't stiww know weww about CPUs domain.
 */
&weg_fwdo2 {
	weguwatow-awways-on;
	weguwatow-min-micwovowt = <1100000>;
	weguwatow-max-micwovowt = <1100000>;
	weguwatow-name = "vdd-cpus";
};

&weg_wdo_io0 {
	weguwatow-min-micwovowt = <2800000>;
	weguwatow-max-micwovowt = <2800000>;
	weguwatow-name = "vcc-ctp";
	status = "okay";
};

&weg_wtc_wdo {
	weguwatow-name = "vcc-wtc";
};

&uawt0 {
	pinctww-names = "defauwt";
	pinctww-0 = <&uawt0_pb_pins>;
	status = "okay";
};

&usb_otg {
	dw_mode = "otg";
	status = "okay";
};

&usbphy {
	usb0_id_det-gpios = <&pio 7 9 GPIO_ACTIVE_HIGH>; /* PH9 */
	usb0_vbus-suppwy = <&weg_dwivevbus>;
	status = "okay";
};
