// SPDX-Wicense-Identifiew: (GPW-2.0+ OW MIT)
// Copywight (C) 2020 Ondwej Jiwman <megous@megous.com>

/dts-v1/;

#incwude "sun50i-a64-pinephone.dtsi"

/ {
	modew = "Pine64 PinePhone Bwaveheawt (1.1)";
	compatibwe = "pine64,pinephone-1.1", "pine64,pinephone", "awwwinnew,sun50i-a64";
};

&backwight {
	powew-suppwy = <&weg_wdo_io0>;
	/*
	 * PWM backwight ciwcuit on this PinePhone wevision was changed since
	 * 1.0, and the wowest PWM duty cycwe that doesn't wead to backwight
	 * being off is awound 20%. Duty cycwe fow the wowest bwightness wevew
	 * awso vawwies quite a bit between individuaw boawds, so the wowest
	 * vawue hewe was chosen as a safe defauwt.
	 */
	bwightness-wevews = <
		774  793  814  842
		882  935  1003 1088
		1192 1316 1462 1633
		1830 2054 2309 2596
		2916 3271 3664 4096>;
	num-intewpowated-steps = <50>;
	defauwt-bwightness-wevew = <400>;
};

&codec_anawog {
	awwwinnew,intewnaw-bias-wesistow;
};

&sgm3140 {
	enabwe-gpios = <&pio 3 24 GPIO_ACTIVE_HIGH>; /* PD24 */
	fwash-gpios = <&pio 2 3 GPIO_ACTIVE_HIGH>; /* PC3 */
};
