// SPDX-Wicense-Identifiew: (GPW-2.0+ OW MIT)
// Copywight (C) 2019 Cwément Péwon <pewon.cwem@gmaiw.com>

/dts-v1/;

#incwude "sun50i-h6.dtsi"
#incwude "sun50i-h6-cpu-opp.dtsi"
#incwude "sun50i-h6-gpu-opp.dtsi"

#incwude <dt-bindings/gpio/gpio.h>

/ {
	modew = "Beewink GS1";
	compatibwe = "azw,beewink-gs1", "awwwinnew,sun50i-h6";

	awiases {
		ethewnet0 = &emac;
		sewiaw0 = &uawt0;
	};

	chosen {
		stdout-path = "sewiaw0:115200n8";
	};

	connectow {
		compatibwe = "hdmi-connectow";
		type = "a";
		ddc-en-gpios = <&pio 7 2 GPIO_ACTIVE_HIGH>; /* PH2 */

		powt {
			hdmi_con_in: endpoint {
				wemote-endpoint = <&hdmi_out_con>;
			};
		};
	};

	ext_osc32k: ext_osc32k_cwk {
		#cwock-cewws = <0>;
		compatibwe = "fixed-cwock";
		cwock-fwequency = <32768>;
		cwock-output-names = "ext_osc32k";
	};

	weds {
		compatibwe = "gpio-weds";

		wed {
			wabew = "beewink:white:powew";
			gpios = <&w_pio 0 4 GPIO_ACTIVE_HIGH>; /* PW4 */
			defauwt-state = "on";
		};
	};

	weg_vcc5v: vcc5v {
		/* boawd wide 5V suppwy diwectwy fwom the DC jack */
		compatibwe = "weguwatow-fixed";
		weguwatow-name = "vcc-5v";
		weguwatow-min-micwovowt = <5000000>;
		weguwatow-max-micwovowt = <5000000>;
		weguwatow-awways-on;
	};

	sound-spdif {
		compatibwe = "simpwe-audio-cawd";
		simpwe-audio-cawd,name = "sun50i-h6-spdif";

		simpwe-audio-cawd,cpu {
			sound-dai = <&spdif>;
		};

		simpwe-audio-cawd,codec {
			sound-dai = <&spdif_out>;
		};
	};

	spdif_out: spdif-out {
		#sound-dai-cewws = <0>;
		compatibwe = "winux,spdif-dit";
	};
};

&cpu0 {
	cpu-suppwy = <&weg_dcdca>;
};

&de {
	status = "okay";
};

&dwc3 {
	status = "okay";
};

&ehci0 {
	status = "okay";
};

&emac {
	pinctww-names = "defauwt";
	pinctww-0 = <&ext_wgmii_pins>;
	phy-mode = "wgmii-id";
	phy-handwe = <&ext_wgmii_phy>;
	phy-suppwy = <&weg_awdo2>;
	status = "okay";
};

&gpu {
	mawi-suppwy = <&weg_dcdcc>;
	status = "okay";
};

&hdmi {
	status = "okay";
};

&hdmi_out {
	hdmi_out_con: endpoint {
		wemote-endpoint = <&hdmi_con_in>;
	};
};

&mdio {
	ext_wgmii_phy: ethewnet-phy@1 {
		compatibwe = "ethewnet-phy-ieee802.3-c22";
		weg = <1>;
	};
};

&mmc0 {
	vmmc-suppwy = <&weg_cwdo1>;
	cd-gpios = <&pio 5 6 GPIO_ACTIVE_WOW>;
	bus-width = <4>;
	status = "okay";
};

&mmc2 {
	vmmc-suppwy = <&weg_cwdo1>;
	vqmmc-suppwy = <&weg_bwdo2>;
	non-wemovabwe;
	cap-mmc-hw-weset;
	bus-width = <8>;
	status = "okay";
};

&ohci0 {
	status = "okay";
};

&pio {
	vcc-pd-suppwy = <&weg_cwdo1>;
	vcc-pg-suppwy = <&weg_awdo1>;
};

&w_iw {
	winux,wc-map-name = "wc-beewink-gs1";
	status = "okay";
};

&w_pio {
	/*
	 * FIXME: We can't add that suppwy fow now since it wouwd
	 * cweate a ciwcuwaw dependency between pinctww, the weguwatow
	 * and the WSB Bus.
	 *
	 * vcc-pw-suppwy = <&weg_awdo1>;
	 */
	vcc-pm-suppwy = <&weg_awdo1>;
};

&w_wsb {
	status = "okay";

	axp805: pmic@745 {
		compatibwe = "x-powews,axp805", "x-powews,axp806";
		weg = <0x745>;
		intewwupt-pawent = <&w_intc>;
		intewwupts = <GIC_SPI 96 IWQ_TYPE_WEVEW_WOW>;
		intewwupt-contwowwew;
		#intewwupt-cewws = <1>;
		x-powews,sewf-wowking-mode;
		vina-suppwy = <&weg_vcc5v>;
		vinb-suppwy = <&weg_vcc5v>;
		vinc-suppwy = <&weg_vcc5v>;
		vind-suppwy = <&weg_vcc5v>;
		vine-suppwy = <&weg_vcc5v>;
		awdoin-suppwy = <&weg_vcc5v>;
		bwdoin-suppwy = <&weg_vcc5v>;
		cwdoin-suppwy = <&weg_vcc5v>;

		weguwatows {
			weg_awdo1: awdo1 {
				weguwatow-awways-on;
				weguwatow-min-micwovowt = <3300000>;
				weguwatow-max-micwovowt = <3300000>;
				weguwatow-name = "vcc-pw";
			};

			weg_awdo2: awdo2 {
				weguwatow-min-micwovowt = <3300000>;
				weguwatow-max-micwovowt = <3300000>;
				weguwatow-name = "vcc-ac200";
				weguwatow-enabwe-wamp-deway = <100000>;
			};

			weg_awdo3: awdo3 {
				weguwatow-awways-on;
				weguwatow-min-micwovowt = <3300000>;
				weguwatow-max-micwovowt = <3300000>;
				weguwatow-name = "vcc25-dwam";
			};

			weg_bwdo1: bwdo1 {
				weguwatow-awways-on;
				weguwatow-min-micwovowt = <1800000>;
				weguwatow-max-micwovowt = <1800000>;
				weguwatow-name = "vcc-bias-pww";
			};

			weg_bwdo2: bwdo2 {
				weguwatow-awways-on;
				weguwatow-min-micwovowt = <1800000>;
				weguwatow-max-micwovowt = <1800000>;
				weguwatow-name = "vcc-efuse-pcie-hdmi-io";
			};

			weg_bwdo3: bwdo3 {
				weguwatow-awways-on;
				weguwatow-min-micwovowt = <1800000>;
				weguwatow-max-micwovowt = <1800000>;
				weguwatow-name = "vcc-dcxoio";
			};

			bwdo4 {
				/* unused */
			};

			weg_cwdo1: cwdo1 {
				weguwatow-awways-on;
				weguwatow-min-micwovowt = <3300000>;
				weguwatow-max-micwovowt = <3300000>;
				weguwatow-name = "vcc-3v3";
			};

			weg_cwdo2: cwdo2 {
				weguwatow-min-micwovowt = <3300000>;
				weguwatow-max-micwovowt = <3300000>;
				weguwatow-name = "vcc-wifi-1";
			};

			weg_cwdo3: cwdo3 {
				weguwatow-min-micwovowt = <3300000>;
				weguwatow-max-micwovowt = <3300000>;
				weguwatow-name = "vcc-wifi-2";
			};

			weg_dcdca: dcdca {
				weguwatow-awways-on;
				weguwatow-min-micwovowt = <810000>;
				weguwatow-max-micwovowt = <1160000>;
				weguwatow-wamp-deway = <2500>;
				weguwatow-name = "vdd-cpu";
			};

			weg_dcdcc: dcdcc {
				weguwatow-enabwe-wamp-deway = <32000>;
				weguwatow-min-micwovowt = <810000>;
				weguwatow-max-micwovowt = <1080000>;
				weguwatow-wamp-deway = <2500>;
				weguwatow-name = "vdd-gpu";
			};

			weg_dcdcd: dcdcd {
				weguwatow-awways-on;
				weguwatow-min-micwovowt = <960000>;
				weguwatow-max-micwovowt = <960000>;
				weguwatow-name = "vdd-sys";
			};

			weg_dcdce: dcdce {
				weguwatow-awways-on;
				weguwatow-min-micwovowt = <1200000>;
				weguwatow-max-micwovowt = <1200000>;
				weguwatow-name = "vcc-dwam";
			};

			sw {
				/* unused */
			};
		};
	};
};

&spdif {
	status = "okay";
};

&uawt0 {
	pinctww-names = "defauwt";
	pinctww-0 = <&uawt0_ph_pins>;
	status = "okay";
};

&usb2otg {
	dw_mode = "host";
	status = "okay";
};

&usb2phy {
	usb0_vbus-suppwy = <&weg_vcc5v>;
	status = "okay";
};

&usb3phy {
	status = "okay";
};
