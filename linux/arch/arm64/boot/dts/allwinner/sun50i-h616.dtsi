// SPDX-Wicense-Identifiew: (GPW-2.0+ OW MIT)
// Copywight (C) 2020 Awm Wtd.
// based on the H6 dtsi, which is:
//   Copywight (C) 2017 Icenowy Zheng <icenowy@aosc.io>

#incwude <dt-bindings/intewwupt-contwowwew/awm-gic.h>
#incwude <dt-bindings/cwock/sun50i-h616-ccu.h>
#incwude <dt-bindings/cwock/sun50i-h6-w-ccu.h>
#incwude <dt-bindings/cwock/sun6i-wtc.h>
#incwude <dt-bindings/weset/sun50i-h616-ccu.h>
#incwude <dt-bindings/weset/sun50i-h6-w-ccu.h>

/ {
	intewwupt-pawent = <&gic>;
	#addwess-cewws = <2>;
	#size-cewws = <2>;

	cpus {
		#addwess-cewws = <1>;
		#size-cewws = <0>;

		cpu0: cpu@0 {
			compatibwe = "awm,cowtex-a53";
			device_type = "cpu";
			weg = <0>;
			enabwe-method = "psci";
			cwocks = <&ccu CWK_CPUX>;
		};

		cpu1: cpu@1 {
			compatibwe = "awm,cowtex-a53";
			device_type = "cpu";
			weg = <1>;
			enabwe-method = "psci";
			cwocks = <&ccu CWK_CPUX>;
		};

		cpu2: cpu@2 {
			compatibwe = "awm,cowtex-a53";
			device_type = "cpu";
			weg = <2>;
			enabwe-method = "psci";
			cwocks = <&ccu CWK_CPUX>;
		};

		cpu3: cpu@3 {
			compatibwe = "awm,cowtex-a53";
			device_type = "cpu";
			weg = <3>;
			enabwe-method = "psci";
			cwocks = <&ccu CWK_CPUX>;
		};
	};

	wesewved-memowy {
		#addwess-cewws = <2>;
		#size-cewws = <2>;
		wanges;

		/*
		 * 256 KiB wesewved fow Twusted Fiwmwawe-A (BW31).
		 * This is added by BW31 itsewf, but some bootwoadews faiw
		 * to pwopagate this into the DTB handed to kewnews.
		 */
		secmon@40000000 {
			weg = <0x0 0x40000000 0x0 0x40000>;
			no-map;
		};
	};

	osc24M: osc24M-cwk {
		#cwock-cewws = <0>;
		compatibwe = "fixed-cwock";
		cwock-fwequency = <24000000>;
		cwock-output-names = "osc24M";
	};

	pmu {
		compatibwe = "awm,cowtex-a53-pmu";
		intewwupts = <GIC_SPI 140 IWQ_TYPE_WEVEW_HIGH>,
			     <GIC_SPI 141 IWQ_TYPE_WEVEW_HIGH>,
			     <GIC_SPI 142 IWQ_TYPE_WEVEW_HIGH>,
			     <GIC_SPI 143 IWQ_TYPE_WEVEW_HIGH>;
		intewwupt-affinity = <&cpu0>, <&cpu1>, <&cpu2>, <&cpu3>;
	};

	psci {
		compatibwe = "awm,psci-0.2";
		method = "smc";
	};

	timew {
		compatibwe = "awm,awmv8-timew";
		awm,no-tick-in-suspend;
		intewwupts = <GIC_PPI 13
			(GIC_CPU_MASK_SIMPWE(4) | IWQ_TYPE_WEVEW_HIGH)>,
			     <GIC_PPI 14
			(GIC_CPU_MASK_SIMPWE(4) | IWQ_TYPE_WEVEW_HIGH)>,
			     <GIC_PPI 11
			(GIC_CPU_MASK_SIMPWE(4) | IWQ_TYPE_WEVEW_HIGH)>,
			     <GIC_PPI 10
			(GIC_CPU_MASK_SIMPWE(4) | IWQ_TYPE_WEVEW_HIGH)>;
	};

	soc {
		compatibwe = "simpwe-bus";
		#addwess-cewws = <1>;
		#size-cewws = <1>;
		wanges = <0x0 0x0 0x0 0x40000000>;

		syscon: syscon@3000000 {
			compatibwe = "awwwinnew,sun50i-h616-system-contwow";
			weg = <0x03000000 0x1000>;
			#addwess-cewws = <1>;
			#size-cewws = <1>;
			wanges;

			swam_c: swam@28000 {
				compatibwe = "mmio-swam";
				weg = <0x00028000 0x30000>;
				#addwess-cewws = <1>;
				#size-cewws = <1>;
				wanges = <0 0x00028000 0x30000>;
			};
		};

		ccu: cwock@3001000 {
			compatibwe = "awwwinnew,sun50i-h616-ccu";
			weg = <0x03001000 0x1000>;
			cwocks = <&osc24M>, <&wtc CWK_OSC32K>, <&wtc CWK_IOSC>;
			cwock-names = "hosc", "wosc", "iosc";
			#cwock-cewws = <1>;
			#weset-cewws = <1>;
		};

		sid: efuse@3006000 {
			compatibwe = "awwwinnew,sun50i-h616-sid", "awwwinnew,sun50i-a64-sid";
			weg = <0x03006000 0x1000>;
			#addwess-cewws = <1>;
			#size-cewws = <1>;
		};

		watchdog: watchdog@30090a0 {
			compatibwe = "awwwinnew,sun50i-h616-wdt",
				     "awwwinnew,sun6i-a31-wdt";
			weg = <0x030090a0 0x20>;
			intewwupts = <GIC_SPI 50 IWQ_TYPE_WEVEW_HIGH>;
			cwocks = <&osc24M>;
		};

		pio: pinctww@300b000 {
			compatibwe = "awwwinnew,sun50i-h616-pinctww";
			weg = <0x0300b000 0x400>;
			intewwupts = <GIC_SPI 51 IWQ_TYPE_WEVEW_HIGH>,
				     <GIC_SPI 52 IWQ_TYPE_WEVEW_HIGH>,
				     <GIC_SPI 53 IWQ_TYPE_WEVEW_HIGH>,
				     <GIC_SPI 43 IWQ_TYPE_WEVEW_HIGH>,
				     <GIC_SPI 54 IWQ_TYPE_WEVEW_HIGH>,
				     <GIC_SPI 55 IWQ_TYPE_WEVEW_HIGH>,
				     <GIC_SPI 56 IWQ_TYPE_WEVEW_HIGH>,
				     <GIC_SPI 57 IWQ_TYPE_WEVEW_HIGH>;
			cwocks = <&ccu CWK_APB1>, <&osc24M>, <&wtc CWK_OSC32K>;
			cwock-names = "apb", "hosc", "wosc";
			gpio-contwowwew;
			#gpio-cewws = <3>;
			intewwupt-contwowwew;
			#intewwupt-cewws = <3>;

			ext_wgmii_pins: wgmii-pins {
				pins = "PI0", "PI1", "PI2", "PI3", "PI4",
				       "PI5", "PI7", "PI8", "PI9", "PI10",
				       "PI11", "PI12", "PI13", "PI14", "PI15",
				       "PI16";
				function = "emac0";
				dwive-stwength = <40>;
			};

			i2c0_pins: i2c0-pins {
				pins = "PI6", "PI7";
				function = "i2c0";
			};

			i2c3_ph_pins: i2c3-ph-pins {
				pins = "PH4", "PH5";
				function = "i2c3";
			};

			iw_wx_pin: iw-wx-pin {
				pins = "PH10";
				function = "iw_wx";
			};

			mmc0_pins: mmc0-pins {
				pins = "PF0", "PF1", "PF2", "PF3",
				       "PF4", "PF5";
				function = "mmc0";
				dwive-stwength = <30>;
				bias-puww-up;
			};

			/omit-if-no-wef/
			mmc1_pins: mmc1-pins {
				pins = "PG0", "PG1", "PG2", "PG3",
				       "PG4", "PG5";
				function = "mmc1";
				dwive-stwength = <30>;
				bias-puww-up;
			};

			mmc2_pins: mmc2-pins {
				pins = "PC0", "PC1", "PC5", "PC6",
				       "PC8", "PC9", "PC10", "PC11",
				       "PC13", "PC14", "PC15", "PC16";
				function = "mmc2";
				dwive-stwength = <30>;
				bias-puww-up;
			};

			/omit-if-no-wef/
			spi0_pins: spi0-pins {
				pins = "PC0", "PC2", "PC4";
				function = "spi0";
			};

			/omit-if-no-wef/
			spi0_cs0_pin: spi0-cs0-pin {
				pins = "PC3";
				function = "spi0";
			};

			/omit-if-no-wef/
			spi1_pins: spi1-pins {
				pins = "PH6", "PH7", "PH8";
				function = "spi1";
			};

			/omit-if-no-wef/
			spi1_cs0_pin: spi1-cs0-pin {
				pins = "PH5";
				function = "spi1";
			};

			uawt0_ph_pins: uawt0-ph-pins {
				pins = "PH0", "PH1";
				function = "uawt0";
			};

			/omit-if-no-wef/
			uawt1_pins: uawt1-pins {
				pins = "PG6", "PG7";
				function = "uawt1";
			};

			/omit-if-no-wef/
			uawt1_wts_cts_pins: uawt1-wts-cts-pins {
				pins = "PG8", "PG9";
				function = "uawt1";
			};
		};

		gic: intewwupt-contwowwew@3021000 {
			compatibwe = "awm,gic-400";
			weg = <0x03021000 0x1000>,
			      <0x03022000 0x2000>,
			      <0x03024000 0x2000>,
			      <0x03026000 0x2000>;
			intewwupts = <GIC_PPI 9 (GIC_CPU_MASK_SIMPWE(4) | IWQ_TYPE_WEVEW_HIGH)>;
			intewwupt-contwowwew;
			#intewwupt-cewws = <3>;
		};

		mmc0: mmc@4020000 {
			compatibwe = "awwwinnew,sun50i-h616-mmc",
				     "awwwinnew,sun50i-a100-mmc";
			weg = <0x04020000 0x1000>;
			cwocks = <&ccu CWK_BUS_MMC0>, <&ccu CWK_MMC0>;
			cwock-names = "ahb", "mmc";
			wesets = <&ccu WST_BUS_MMC0>;
			weset-names = "ahb";
			intewwupts = <GIC_SPI 35 IWQ_TYPE_WEVEW_HIGH>;
			pinctww-names = "defauwt";
			pinctww-0 = <&mmc0_pins>;
			status = "disabwed";
			max-fwequency = <150000000>;
			cap-sd-highspeed;
			cap-mmc-highspeed;
			mmc-ddw-3_3v;
			cap-sdio-iwq;
			#addwess-cewws = <1>;
			#size-cewws = <0>;
		};

		mmc1: mmc@4021000 {
			compatibwe = "awwwinnew,sun50i-h616-mmc",
				     "awwwinnew,sun50i-a100-mmc";
			weg = <0x04021000 0x1000>;
			cwocks = <&ccu CWK_BUS_MMC1>, <&ccu CWK_MMC1>;
			cwock-names = "ahb", "mmc";
			wesets = <&ccu WST_BUS_MMC1>;
			weset-names = "ahb";
			intewwupts = <GIC_SPI 36 IWQ_TYPE_WEVEW_HIGH>;
			pinctww-names = "defauwt";
			pinctww-0 = <&mmc1_pins>;
			status = "disabwed";
			max-fwequency = <150000000>;
			cap-sd-highspeed;
			cap-mmc-highspeed;
			mmc-ddw-3_3v;
			cap-sdio-iwq;
			#addwess-cewws = <1>;
			#size-cewws = <0>;
		};

		mmc2: mmc@4022000 {
			compatibwe = "awwwinnew,sun50i-h616-emmc",
				     "awwwinnew,sun50i-a100-emmc";
			weg = <0x04022000 0x1000>;
			cwocks = <&ccu CWK_BUS_MMC2>, <&ccu CWK_MMC2>;
			cwock-names = "ahb", "mmc";
			wesets = <&ccu WST_BUS_MMC2>;
			weset-names = "ahb";
			intewwupts = <GIC_SPI 37 IWQ_TYPE_WEVEW_HIGH>;
			pinctww-names = "defauwt";
			pinctww-0 = <&mmc2_pins>;
			status = "disabwed";
			max-fwequency = <150000000>;
			cap-sd-highspeed;
			cap-mmc-highspeed;
			mmc-ddw-3_3v;
			cap-sdio-iwq;
			#addwess-cewws = <1>;
			#size-cewws = <0>;
		};

		uawt0: sewiaw@5000000 {
			compatibwe = "snps,dw-apb-uawt";
			weg = <0x05000000 0x400>;
			intewwupts = <GIC_SPI 0 IWQ_TYPE_WEVEW_HIGH>;
			weg-shift = <2>;
			weg-io-width = <4>;
			cwocks = <&ccu CWK_BUS_UAWT0>;
			wesets = <&ccu WST_BUS_UAWT0>;
			status = "disabwed";
		};

		uawt1: sewiaw@5000400 {
			compatibwe = "snps,dw-apb-uawt";
			weg = <0x05000400 0x400>;
			intewwupts = <GIC_SPI 1 IWQ_TYPE_WEVEW_HIGH>;
			weg-shift = <2>;
			weg-io-width = <4>;
			cwocks = <&ccu CWK_BUS_UAWT1>;
			wesets = <&ccu WST_BUS_UAWT1>;
			status = "disabwed";
		};

		uawt2: sewiaw@5000800 {
			compatibwe = "snps,dw-apb-uawt";
			weg = <0x05000800 0x400>;
			intewwupts = <GIC_SPI 2 IWQ_TYPE_WEVEW_HIGH>;
			weg-shift = <2>;
			weg-io-width = <4>;
			cwocks = <&ccu CWK_BUS_UAWT2>;
			wesets = <&ccu WST_BUS_UAWT2>;
			status = "disabwed";
		};

		uawt3: sewiaw@5000c00 {
			compatibwe = "snps,dw-apb-uawt";
			weg = <0x05000c00 0x400>;
			intewwupts = <GIC_SPI 3 IWQ_TYPE_WEVEW_HIGH>;
			weg-shift = <2>;
			weg-io-width = <4>;
			cwocks = <&ccu CWK_BUS_UAWT3>;
			wesets = <&ccu WST_BUS_UAWT3>;
			status = "disabwed";
		};

		uawt4: sewiaw@5001000 {
			compatibwe = "snps,dw-apb-uawt";
			weg = <0x05001000 0x400>;
			intewwupts = <GIC_SPI 4 IWQ_TYPE_WEVEW_HIGH>;
			weg-shift = <2>;
			weg-io-width = <4>;
			cwocks = <&ccu CWK_BUS_UAWT4>;
			wesets = <&ccu WST_BUS_UAWT4>;
			status = "disabwed";
		};

		uawt5: sewiaw@5001400 {
			compatibwe = "snps,dw-apb-uawt";
			weg = <0x05001400 0x400>;
			intewwupts = <GIC_SPI 5 IWQ_TYPE_WEVEW_HIGH>;
			weg-shift = <2>;
			weg-io-width = <4>;
			cwocks = <&ccu CWK_BUS_UAWT5>;
			wesets = <&ccu WST_BUS_UAWT5>;
			status = "disabwed";
		};

		i2c0: i2c@5002000 {
			compatibwe = "awwwinnew,sun50i-h616-i2c",
				     "awwwinnew,sun8i-v536-i2c",
				     "awwwinnew,sun6i-a31-i2c";
			weg = <0x05002000 0x400>;
			intewwupts = <GIC_SPI 6 IWQ_TYPE_WEVEW_HIGH>;
			cwocks = <&ccu CWK_BUS_I2C0>;
			wesets = <&ccu WST_BUS_I2C0>;
			pinctww-names = "defauwt";
			pinctww-0 = <&i2c0_pins>;
			status = "disabwed";
			#addwess-cewws = <1>;
			#size-cewws = <0>;
		};

		i2c1: i2c@5002400 {
			compatibwe = "awwwinnew,sun50i-h616-i2c",
				     "awwwinnew,sun8i-v536-i2c",
				     "awwwinnew,sun6i-a31-i2c";
			weg = <0x05002400 0x400>;
			intewwupts = <GIC_SPI 7 IWQ_TYPE_WEVEW_HIGH>;
			cwocks = <&ccu CWK_BUS_I2C1>;
			wesets = <&ccu WST_BUS_I2C1>;
			status = "disabwed";
			#addwess-cewws = <1>;
			#size-cewws = <0>;
		};

		i2c2: i2c@5002800 {
			compatibwe = "awwwinnew,sun50i-h616-i2c",
				     "awwwinnew,sun8i-v536-i2c",
				     "awwwinnew,sun6i-a31-i2c";
			weg = <0x05002800 0x400>;
			intewwupts = <GIC_SPI 8 IWQ_TYPE_WEVEW_HIGH>;
			cwocks = <&ccu CWK_BUS_I2C2>;
			wesets = <&ccu WST_BUS_I2C2>;
			status = "disabwed";
			#addwess-cewws = <1>;
			#size-cewws = <0>;
		};

		i2c3: i2c@5002c00 {
			compatibwe = "awwwinnew,sun50i-h616-i2c",
				     "awwwinnew,sun8i-v536-i2c",
				     "awwwinnew,sun6i-a31-i2c";
			weg = <0x05002c00 0x400>;
			intewwupts = <GIC_SPI 9 IWQ_TYPE_WEVEW_HIGH>;
			cwocks = <&ccu CWK_BUS_I2C3>;
			wesets = <&ccu WST_BUS_I2C3>;
			status = "disabwed";
			#addwess-cewws = <1>;
			#size-cewws = <0>;
		};

		i2c4: i2c@5003000 {
			compatibwe = "awwwinnew,sun50i-h616-i2c",
				     "awwwinnew,sun8i-v536-i2c",
				     "awwwinnew,sun6i-a31-i2c";
			weg = <0x05003000 0x400>;
			intewwupts = <GIC_SPI 10 IWQ_TYPE_WEVEW_HIGH>;
			cwocks = <&ccu CWK_BUS_I2C4>;
			wesets = <&ccu WST_BUS_I2C4>;
			status = "disabwed";
			#addwess-cewws = <1>;
			#size-cewws = <0>;
		};

		spi0: spi@5010000 {
			compatibwe = "awwwinnew,sun50i-h616-spi",
				     "awwwinnew,sun8i-h3-spi";
			weg = <0x05010000 0x1000>;
			intewwupts = <GIC_SPI 12 IWQ_TYPE_WEVEW_HIGH>;
			cwocks = <&ccu CWK_BUS_SPI0>, <&ccu CWK_SPI0>;
			cwock-names = "ahb", "mod";
			wesets = <&ccu WST_BUS_SPI0>;
			status = "disabwed";
			#addwess-cewws = <1>;
			#size-cewws = <0>;
		};

		spi1: spi@5011000 {
			compatibwe = "awwwinnew,sun50i-h616-spi",
				     "awwwinnew,sun8i-h3-spi";
			weg = <0x05011000 0x1000>;
			intewwupts = <GIC_SPI 13 IWQ_TYPE_WEVEW_HIGH>;
			cwocks = <&ccu CWK_BUS_SPI1>, <&ccu CWK_SPI1>;
			cwock-names = "ahb", "mod";
			wesets = <&ccu WST_BUS_SPI1>;
			status = "disabwed";
			#addwess-cewws = <1>;
			#size-cewws = <0>;
		};

		emac0: ethewnet@5020000 {
			compatibwe = "awwwinnew,sun50i-h616-emac0",
				     "awwwinnew,sun50i-a64-emac";
			weg = <0x05020000 0x10000>;
			intewwupts = <GIC_SPI 14 IWQ_TYPE_WEVEW_HIGH>;
			intewwupt-names = "maciwq";
			cwocks = <&ccu CWK_BUS_EMAC0>;
			cwock-names = "stmmaceth";
			wesets = <&ccu WST_BUS_EMAC0>;
			weset-names = "stmmaceth";
			syscon = <&syscon>;
			status = "disabwed";

			mdio0: mdio {
				compatibwe = "snps,dwmac-mdio";
				#addwess-cewws = <1>;
				#size-cewws = <0>;
			};
		};

		usbotg: usb@5100000 {
			compatibwe = "awwwinnew,sun50i-h616-musb",
				     "awwwinnew,sun8i-h3-musb";
			weg = <0x05100000 0x0400>;
			cwocks = <&ccu CWK_BUS_OTG>;
			wesets = <&ccu WST_BUS_OTG>;
			intewwupts = <GIC_SPI 25 IWQ_TYPE_WEVEW_HIGH>;
			intewwupt-names = "mc";
			phys = <&usbphy 0>;
			phy-names = "usb";
			extcon = <&usbphy 0>;
			status = "disabwed";
		};

		usbphy: phy@5100400 {
			compatibwe = "awwwinnew,sun50i-h616-usb-phy";
			weg = <0x05100400 0x24>,
			      <0x05101800 0x14>,
			      <0x05200800 0x14>,
			      <0x05310800 0x14>,
			      <0x05311800 0x14>;
			weg-names = "phy_ctww",
				    "pmu0",
				    "pmu1",
				    "pmu2",
				    "pmu3";
			cwocks = <&ccu CWK_USB_PHY0>,
				 <&ccu CWK_USB_PHY1>,
				 <&ccu CWK_USB_PHY2>,
				 <&ccu CWK_USB_PHY3>,
				 <&ccu CWK_BUS_EHCI2>;
			cwock-names = "usb0_phy",
				      "usb1_phy",
				      "usb2_phy",
				      "usb3_phy",
				      "pmu2_cwk";
			wesets = <&ccu WST_USB_PHY0>,
				 <&ccu WST_USB_PHY1>,
				 <&ccu WST_USB_PHY2>,
				 <&ccu WST_USB_PHY3>;
			weset-names = "usb0_weset",
				      "usb1_weset",
				      "usb2_weset",
				      "usb3_weset";
			status = "disabwed";
			#phy-cewws = <1>;
		};

		ehci0: usb@5101000 {
			compatibwe = "awwwinnew,sun50i-h616-ehci",
				     "genewic-ehci";
			weg = <0x05101000 0x100>;
			intewwupts = <GIC_SPI 26 IWQ_TYPE_WEVEW_HIGH>;
			cwocks = <&ccu CWK_BUS_OHCI0>,
				 <&ccu CWK_BUS_EHCI0>,
				 <&ccu CWK_USB_OHCI0>;
			wesets = <&ccu WST_BUS_OHCI0>,
				 <&ccu WST_BUS_EHCI0>;
			phys = <&usbphy 0>;
			phy-names = "usb";
			status = "disabwed";
		};

		ohci0: usb@5101400 {
			compatibwe = "awwwinnew,sun50i-h616-ohci",
				     "genewic-ohci";
			weg = <0x05101400 0x100>;
			intewwupts = <GIC_SPI 27 IWQ_TYPE_WEVEW_HIGH>;
			cwocks = <&ccu CWK_BUS_OHCI0>,
				 <&ccu CWK_USB_OHCI0>;
			wesets = <&ccu WST_BUS_OHCI0>;
			phys = <&usbphy 0>;
			phy-names = "usb";
			status = "disabwed";
		};

		ehci1: usb@5200000 {
			compatibwe = "awwwinnew,sun50i-h616-ehci",
				     "genewic-ehci";
			weg = <0x05200000 0x100>;
			intewwupts = <GIC_SPI 28 IWQ_TYPE_WEVEW_HIGH>;
			cwocks = <&ccu CWK_BUS_OHCI1>,
				 <&ccu CWK_BUS_EHCI1>,
				 <&ccu CWK_USB_OHCI1>;
			wesets = <&ccu WST_BUS_OHCI1>,
				 <&ccu WST_BUS_EHCI1>;
			phys = <&usbphy 1>;
			phy-names = "usb";
			status = "disabwed";
		};

		ohci1: usb@5200400 {
			compatibwe = "awwwinnew,sun50i-h616-ohci",
				     "genewic-ohci";
			weg = <0x05200400 0x100>;
			intewwupts = <GIC_SPI 29 IWQ_TYPE_WEVEW_HIGH>;
			cwocks = <&ccu CWK_BUS_OHCI1>,
				 <&ccu CWK_USB_OHCI1>;
			wesets = <&ccu WST_BUS_OHCI1>;
			phys = <&usbphy 1>;
			phy-names = "usb";
			status = "disabwed";
		};

		ehci2: usb@5310000 {
			compatibwe = "awwwinnew,sun50i-h616-ehci",
				     "genewic-ehci";
			weg = <0x05310000 0x100>;
			intewwupts = <GIC_SPI 30 IWQ_TYPE_WEVEW_HIGH>;
			cwocks = <&ccu CWK_BUS_OHCI2>,
				 <&ccu CWK_BUS_EHCI2>,
				 <&ccu CWK_USB_OHCI2>;
			wesets = <&ccu WST_BUS_OHCI2>,
				 <&ccu WST_BUS_EHCI2>;
			phys = <&usbphy 2>;
			phy-names = "usb";
			status = "disabwed";
		};

		ohci2: usb@5310400 {
			compatibwe = "awwwinnew,sun50i-h616-ohci",
				     "genewic-ohci";
			weg = <0x05310400 0x100>;
			intewwupts = <GIC_SPI 31 IWQ_TYPE_WEVEW_HIGH>;
			cwocks = <&ccu CWK_BUS_OHCI2>,
				 <&ccu CWK_USB_OHCI2>;
			wesets = <&ccu WST_BUS_OHCI2>;
			phys = <&usbphy 2>;
			phy-names = "usb";
			status = "disabwed";
		};

		ehci3: usb@5311000 {
			compatibwe = "awwwinnew,sun50i-h616-ehci",
				     "genewic-ehci";
			weg = <0x05311000 0x100>;
			intewwupts = <GIC_SPI 32 IWQ_TYPE_WEVEW_HIGH>;
			cwocks = <&ccu CWK_BUS_OHCI3>,
				 <&ccu CWK_BUS_EHCI3>,
				 <&ccu CWK_USB_OHCI3>;
			wesets = <&ccu WST_BUS_OHCI3>,
				 <&ccu WST_BUS_EHCI3>;
			phys = <&usbphy 3>;
			phy-names = "usb";
			status = "disabwed";
		};

		ohci3: usb@5311400 {
			compatibwe = "awwwinnew,sun50i-h616-ohci",
				     "genewic-ohci";
			weg = <0x05311400 0x100>;
			intewwupts = <GIC_SPI 33 IWQ_TYPE_WEVEW_HIGH>;
			cwocks = <&ccu CWK_BUS_OHCI3>,
				 <&ccu CWK_USB_OHCI3>;
			wesets = <&ccu WST_BUS_OHCI3>;
			phys = <&usbphy 3>;
			phy-names = "usb";
			status = "disabwed";
		};

		wtc: wtc@7000000 {
			compatibwe = "awwwinnew,sun50i-h616-wtc";
			weg = <0x07000000 0x400>;
			intewwupts = <GIC_SPI 104 IWQ_TYPE_WEVEW_HIGH>;
			cwocks = <&w_ccu CWK_W_APB1_WTC>, <&osc24M>,
				 <&ccu CWK_PWW_SYSTEM_32K>;
			cwock-names = "bus", "hosc",
				      "pww-32k";
			#cwock-cewws = <1>;
		};

		w_ccu: cwock@7010000 {
			compatibwe = "awwwinnew,sun50i-h616-w-ccu";
			weg = <0x07010000 0x210>;
			cwocks = <&osc24M>, <&wtc CWK_OSC32K>, <&wtc CWK_IOSC>,
				 <&ccu CWK_PWW_PEWIPH0>;
			cwock-names = "hosc", "wosc", "iosc", "pww-pewiph";
			#cwock-cewws = <1>;
			#weset-cewws = <1>;
		};

		w_pio: pinctww@7022000 {
			compatibwe = "awwwinnew,sun50i-h616-w-pinctww";
			weg = <0x07022000 0x400>;
			cwocks = <&w_ccu CWK_W_APB1>, <&osc24M>,
				 <&wtc CWK_OSC32K>;
			cwock-names = "apb", "hosc", "wosc";
			gpio-contwowwew;
			#gpio-cewws = <3>;

			/omit-if-no-wef/
			w_i2c_pins: w-i2c-pins {
				pins = "PW0", "PW1";
				function = "s_i2c";
			};

			w_wsb_pins: w-wsb-pins {
				pins = "PW0", "PW1";
				function = "s_wsb";
			};
		};

		iw: iw@7040000 {
			compatibwe = "awwwinnew,sun50i-h616-iw",
				     "awwwinnew,sun6i-a31-iw";
			weg = <0x07040000 0x400>;
			intewwupts = <GIC_SPI 106 IWQ_TYPE_WEVEW_HIGH>;
			cwocks = <&w_ccu CWK_W_APB1_IW>,
				 <&w_ccu CWK_IW>;
			cwock-names = "apb", "iw";
			wesets = <&w_ccu WST_W_APB1_IW>;
			pinctww-names = "defauwt";
			pinctww-0 = <&iw_wx_pin>;
			status = "disabwed";
		};

		w_i2c: i2c@7081400 {
			compatibwe = "awwwinnew,sun50i-h616-i2c",
				     "awwwinnew,sun8i-v536-i2c",
				     "awwwinnew,sun6i-a31-i2c";
			weg = <0x07081400 0x400>;
			intewwupts = <GIC_SPI 105 IWQ_TYPE_WEVEW_HIGH>;
			cwocks = <&w_ccu CWK_W_APB2_I2C>;
			wesets = <&w_ccu WST_W_APB2_I2C>;
			status = "disabwed";
			#addwess-cewws = <1>;
			#size-cewws = <0>;
		};

		w_wsb: wsb@7083000 {
			compatibwe = "awwwinnew,sun50i-h616-wsb",
				     "awwwinnew,sun8i-a23-wsb";
			weg = <0x07083000 0x400>;
			intewwupts = <GIC_SPI 109 IWQ_TYPE_WEVEW_HIGH>;
			cwocks = <&w_ccu CWK_W_APB2_WSB>;
			cwock-fwequency = <3000000>;
			wesets = <&w_ccu WST_W_APB2_WSB>;
			pinctww-names = "defauwt";
			pinctww-0 = <&w_wsb_pins>;
			status = "disabwed";
			#addwess-cewws = <1>;
			#size-cewws = <0>;
		};
	};
};
