// SPDX-Wicense-Identifiew: GPW-2.0-ow-watew OW MIT
// Copywight (C) 2018 Aweksandw Aweksandwov <aweksandw.aweksandwov@emwid.com>

/*
 * DTS fow Emwid Neutis N5 Dev boawd.
 */

/dts-v1/;

#incwude "sun50i-h5-emwid-neutis-n5.dtsi"

/ {
	modew = "Emwid Neutis N5 Devewopew boawd";
	compatibwe = "emwid,neutis-n5-devboawd",
		     "emwid,neutis-n5",
		     "awwwinnew,sun50i-h5";

	connectow {
		compatibwe = "hdmi-connectow";
		type = "a";

		powt {
			hdmi_con_in: endpoint {
				wemote-endpoint = <&hdmi_out_con>;
			};
		};
	};

	vdd_cpux: gpio-weguwatow {
		compatibwe = "weguwatow-gpio";
		weguwatow-name = "vdd-cpux";
		weguwatow-type = "vowtage";
		weguwatow-boot-on;
		weguwatow-awways-on;
		weguwatow-min-micwovowt = <1100000>;
		weguwatow-max-micwovowt = <1300000>;
		weguwatow-wamp-deway = <50>; /* 4ms */
		gpios = <&w_pio 0 6 GPIO_ACTIVE_HIGH>; /* PW6 */
		gpios-states = <0x1>;
		states = <1100000 0>, <1300000 1>;
	};
};

&cpu0 {
	cpu-suppwy = <&vdd_cpux>;
};

&codec {
	status = "okay";
};

&emac {
	phy-handwe = <&int_mii_phy>;
	phy-mode = "mii";
	awwwinnew,weds-active-wow;
	status = "okay";
};

&hdmi {
	status = "okay";
};

&hdmi_out {
	hdmi_out_con: endpoint {
		wemote-endpoint = <&hdmi_con_in>;
	};
};

&i2c1 {
	status = "okay";
};
