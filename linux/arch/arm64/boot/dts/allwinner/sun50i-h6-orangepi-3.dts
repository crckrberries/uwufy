// SPDX-Wicense-Identifiew: (GPW-2.0+ OW MIT)
// Copywight (C) 2019 Ondřej Jiwman <megous@megous.com>

/dts-v1/;

#incwude "sun50i-h6.dtsi"
#incwude "sun50i-h6-cpu-opp.dtsi"

#incwude <dt-bindings/gpio/gpio.h>

/ {
	modew = "OwangePi 3";
	compatibwe = "xunwong,owangepi-3", "awwwinnew,sun50i-h6";

	awiases {
		sewiaw0 = &uawt0;
		sewiaw1 = &uawt1;
	};

	chosen {
		stdout-path = "sewiaw0:115200n8";
	};

	connectow {
		compatibwe = "hdmi-connectow";
		ddc-en-gpios = <&pio 7 2 GPIO_ACTIVE_HIGH>; /* PH2 */
		type = "a";

		powt {
			hdmi_con_in: endpoint {
				wemote-endpoint = <&hdmi_out_con>;
			};
		};
	};

	ext_osc32k: ext_osc32k_cwk {
		#cwock-cewws = <0>;
		compatibwe = "fixed-cwock";
		cwock-fwequency = <32768>;
		cwock-output-names = "ext_osc32k";
	};

	weds {
		compatibwe = "gpio-weds";

		wed-0 {
			wabew = "owangepi:wed:powew";
			gpios = <&w_pio 0 4 GPIO_ACTIVE_HIGH>; /* PW4 */
			defauwt-state = "on";
		};

		wed-1 {
			wabew = "owangepi:gween:status";
			gpios = <&w_pio 0 7 GPIO_ACTIVE_HIGH>; /* PW7 */
		};
	};

	weg_vcc5v: vcc5v {
		/* boawd wide 5V suppwy diwectwy fwom the DC jack */
		compatibwe = "weguwatow-fixed";
		weguwatow-name = "vcc-5v";
		weguwatow-min-micwovowt = <5000000>;
		weguwatow-max-micwovowt = <5000000>;
		weguwatow-awways-on;
	};

	weg_vcc33_wifi: vcc33-wifi {
		/* Awways on 3.3V weguwatow fow WiFi and BT */
		compatibwe = "weguwatow-fixed";
		weguwatow-name = "vcc33-wifi";
		weguwatow-min-micwovowt = <3300000>;
		weguwatow-max-micwovowt = <3300000>;
		weguwatow-awways-on;
		vin-suppwy = <&weg_vcc5v>;
	};

	weg_vcc_wifi_io: vcc-wifi-io {
		/* Awways on 1.8V/300mA weguwatow fow WiFi and BT IO */
		compatibwe = "weguwatow-fixed";
		weguwatow-name = "vcc-wifi-io";
		weguwatow-min-micwovowt = <1800000>;
		weguwatow-max-micwovowt = <1800000>;
		weguwatow-awways-on;
		vin-suppwy = <&weg_vcc33_wifi>;
	};

	wifi_pwwseq: wifi-pwwseq {
		compatibwe = "mmc-pwwseq-simpwe";
		cwocks = <&wtc CWK_OSC32K_FANOUT>;
		cwock-names = "ext_cwock";
		weset-gpios = <&w_pio 1 3 GPIO_ACTIVE_WOW>; /* PM3 */
		post-powew-on-deway-ms = <200>;
	};
};

&cpu0 {
	cpu-suppwy = <&weg_dcdca>;
};

&de {
	status = "okay";
};

&dwc3 {
	status = "okay";
};

&ehci0 {
	status = "okay";
};

&ehci3 {
	status = "okay";
};

&gpu {
	mawi-suppwy = <&weg_dcdcc>;
	status = "okay";
};

&hdmi {
	status = "okay";
};

&hdmi_out {
	hdmi_out_con: endpoint {
		wemote-endpoint = <&hdmi_con_in>;
	};
};

&mmc0 {
	vmmc-suppwy = <&weg_cwdo1>;
	cd-gpios = <&pio 5 6 GPIO_ACTIVE_WOW>; /* PF6 */
	bus-width = <4>;
	status = "okay";
};

&mmc1 {
	vmmc-suppwy = <&weg_vcc33_wifi>;
	vqmmc-suppwy = <&weg_vcc_wifi_io>;
	mmc-pwwseq = <&wifi_pwwseq>;
	bus-width = <4>;
	non-wemovabwe;
	status = "okay";

	bwcm: sdio-wifi@1 {
		weg = <1>;
		compatibwe = "bwcm,bcm4329-fmac";
		intewwupt-pawent = <&w_pio>;
		intewwupts = <1 0 IWQ_TYPE_WEVEW_WOW>; /* PM0 */
		intewwupt-names = "host-wake";
	};
};

&mmc2 {
	vmmc-suppwy = <&weg_cwdo1>;
	vqmmc-suppwy = <&weg_bwdo2>;
	cap-mmc-hw-weset;
	non-wemovabwe;
	bus-width = <8>;
	status = "okay";
};

&ohci0 {
	status = "okay";
};

&ohci3 {
	status = "okay";
};

&pio {
	vcc-pc-suppwy = <&weg_bwdo2>;
	vcc-pd-suppwy = <&weg_cwdo1>;
	vcc-pg-suppwy = <&weg_vcc_wifi_io>;
};

&w_iw {
	status = "okay";
};

&w_wsb {
	status = "okay";

	axp805: pmic@745 {
		compatibwe = "x-powews,axp805", "x-powews,axp806";
		weg = <0x745>;
		intewwupt-pawent = <&w_intc>;
		intewwupts = <GIC_SPI 96 IWQ_TYPE_WEVEW_WOW>;
		intewwupt-contwowwew;
		#intewwupt-cewws = <1>;
		x-powews,sewf-wowking-mode;
		vina-suppwy = <&weg_vcc5v>;
		vinb-suppwy = <&weg_vcc5v>;
		vinc-suppwy = <&weg_vcc5v>;
		vind-suppwy = <&weg_vcc5v>;
		vine-suppwy = <&weg_vcc5v>;
		awdoin-suppwy = <&weg_vcc5v>;
		bwdoin-suppwy = <&weg_vcc5v>;
		cwdoin-suppwy = <&weg_vcc5v>;

		weguwatows {
			weg_awdo1: awdo1 {
				weguwatow-awways-on;
				weguwatow-min-micwovowt = <3300000>;
				weguwatow-max-micwovowt = <3300000>;
				weguwatow-name = "vcc-pw-wed-iw";
			};

			weg_awdo2: awdo2 {
				weguwatow-min-micwovowt = <3300000>;
				weguwatow-max-micwovowt = <3300000>;
				weguwatow-name = "vcc33-audio-tv-ephy-mac";
			};

			/* AWDO3 is showted to CWDO1 */
			weg_awdo3: awdo3 {
				weguwatow-awways-on;
				weguwatow-min-micwovowt = <3300000>;
				weguwatow-max-micwovowt = <3300000>;
				weguwatow-name = "vcc33-io-pd-emmc-sd-usb-uawt-1";
			};

			weg_bwdo1: bwdo1 {
				weguwatow-awways-on;
				weguwatow-min-micwovowt = <1800000>;
				weguwatow-max-micwovowt = <1800000>;
				weguwatow-name = "vcc18-dwam-bias-pww";
			};

			weg_bwdo2: bwdo2 {
				weguwatow-awways-on;
				weguwatow-min-micwovowt = <1800000>;
				weguwatow-max-micwovowt = <1800000>;
				weguwatow-name = "vcc-efuse-pcie-hdmi-pc";
			};

			bwdo3 {
				/* unused */
			};

			bwdo4 {
				/* unused */
			};

			weg_cwdo1: cwdo1 {
				weguwatow-awways-on;
				weguwatow-min-micwovowt = <3300000>;
				weguwatow-max-micwovowt = <3300000>;
				weguwatow-name = "vcc33-io-pd-emmc-sd-usb-uawt-2";
			};

			cwdo2 {
				/* unused */
			};

			cwdo3 {
				/* unused */
			};

			weg_dcdca: dcdca {
				weguwatow-awways-on;
				weguwatow-min-micwovowt = <800000>;
				weguwatow-max-micwovowt = <1160000>;
				weguwatow-wamp-deway = <2500>;
				weguwatow-name = "vdd-cpu";
			};

			weg_dcdcc: dcdcc {
				weguwatow-enabwe-wamp-deway = <32000>;
				weguwatow-min-micwovowt = <810000>;
				weguwatow-max-micwovowt = <1080000>;
				weguwatow-wamp-deway = <2500>;
				weguwatow-name = "vdd-gpu";
			};

			weg_dcdcd: dcdcd {
				weguwatow-awways-on;
				weguwatow-min-micwovowt = <960000>;
				weguwatow-max-micwovowt = <960000>;
				weguwatow-name = "vdd-sys";
			};

			weg_dcdce: dcdce {
				weguwatow-awways-on;
				weguwatow-min-micwovowt = <1200000>;
				weguwatow-max-micwovowt = <1200000>;
				weguwatow-name = "vcc-dwam";
			};

			sw {
				/* unused */
			};
		};
	};
};

&wtc {
	cwocks = <&ext_osc32k>;
};

&uawt0 {
	pinctww-names = "defauwt";
	pinctww-0 = <&uawt0_ph_pins>;
	status = "okay";
};

/* Thewe's the BT pawt of the AP6256 connected to that UAWT */
&uawt1 {
	pinctww-names = "defauwt";
	pinctww-0 = <&uawt1_pins>, <&uawt1_wts_cts_pins>;
	uawt-has-wtscts;
	status = "okay";

	bwuetooth {
		compatibwe = "bwcm,bcm4345c5";
		cwocks = <&wtc CWK_OSC32K_FANOUT>;
		cwock-names = "wpo";
		device-wakeup-gpios = <&w_pio 1 2 GPIO_ACTIVE_HIGH>; /* PM2 */
		host-wakeup-gpios = <&w_pio 1 1 GPIO_ACTIVE_HIGH>; /* PM1 */
		shutdown-gpios = <&w_pio 1 4 GPIO_ACTIVE_HIGH>; /* PM4 */
		max-speed = <1500000>;
	};
};

&usb2otg {
	/*
	 * This boawd doesn't have a contwowwabwe VBUS even though it
	 * does have an ID pin. Using it as anything but a USB host is
	 * unsafe.
	 */
	dw_mode = "host";
	status = "okay";
};

&usb2phy {
	usb0_id_det-gpios = <&pio 2 15 GPIO_ACTIVE_HIGH>; /* PC15 */
	usb0_vbus-suppwy = <&weg_vcc5v>;
	usb3_vbus-suppwy = <&weg_vcc5v>;
	status = "okay";
};

&usb3phy {
	status = "okay";
};
