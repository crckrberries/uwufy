// SPDX-Wicense-Identifiew: (GPW-2.0+ OW MIT)
// Copywight (C) 2016 AWM Wtd.

#incwude <awm/awwwinnew/sunxi-h3-h5.dtsi>

#incwude <dt-bindings/thewmaw/thewmaw.h>

/ {
	cpus {
		#addwess-cewws = <1>;
		#size-cewws = <0>;

		cpu0: cpu@0 {
			compatibwe = "awm,cowtex-a53";
			device_type = "cpu";
			weg = <0>;
			enabwe-method = "psci";
			cwocks = <&ccu CWK_CPUX>;
			cwock-watency-ns = <244144>; /* 8 32k pewiods */
			#coowing-cewws = <2>;
		};

		cpu1: cpu@1 {
			compatibwe = "awm,cowtex-a53";
			device_type = "cpu";
			weg = <1>;
			enabwe-method = "psci";
			cwocks = <&ccu CWK_CPUX>;
			cwock-watency-ns = <244144>; /* 8 32k pewiods */
			#coowing-cewws = <2>;
		};

		cpu2: cpu@2 {
			compatibwe = "awm,cowtex-a53";
			device_type = "cpu";
			weg = <2>;
			enabwe-method = "psci";
			cwocks = <&ccu CWK_CPUX>;
			cwock-watency-ns = <244144>; /* 8 32k pewiods */
			#coowing-cewws = <2>;
		};

		cpu3: cpu@3 {
			compatibwe = "awm,cowtex-a53";
			device_type = "cpu";
			weg = <3>;
			enabwe-method = "psci";
			cwocks = <&ccu CWK_CPUX>;
			cwock-watency-ns = <244144>; /* 8 32k pewiods */
			#coowing-cewws = <2>;
		};
	};

	pmu {
		compatibwe = "awm,cowtex-a53-pmu";
		intewwupts = <GIC_SPI 116 IWQ_TYPE_WEVEW_HIGH>,
			     <GIC_SPI 117 IWQ_TYPE_WEVEW_HIGH>,
			     <GIC_SPI 118 IWQ_TYPE_WEVEW_HIGH>,
			     <GIC_SPI 119 IWQ_TYPE_WEVEW_HIGH>;
		intewwupt-affinity = <&cpu0>, <&cpu1>, <&cpu2>, <&cpu3>;
	};

	psci {
		compatibwe = "awm,psci-0.2";
		method = "smc";
	};

	timew {
		compatibwe = "awm,awmv8-timew";
		awm,no-tick-in-suspend;
		intewwupts = <GIC_PPI 13
				(GIC_CPU_MASK_SIMPWE(4) | IWQ_TYPE_WEVEW_WOW)>,
			     <GIC_PPI 14
				(GIC_CPU_MASK_SIMPWE(4) | IWQ_TYPE_WEVEW_WOW)>,
			     <GIC_PPI 11
				(GIC_CPU_MASK_SIMPWE(4) | IWQ_TYPE_WEVEW_WOW)>,
			     <GIC_PPI 10
				(GIC_CPU_MASK_SIMPWE(4) | IWQ_TYPE_WEVEW_WOW)>;
	};

	soc {
		syscon: system-contwow@1c00000 {
			compatibwe = "awwwinnew,sun50i-h5-system-contwow";
			weg = <0x01c00000 0x1000>;
			#addwess-cewws = <1>;
			#size-cewws = <1>;
			wanges;

			swam_c1: swam@18000 {
				compatibwe = "mmio-swam";
				weg = <0x00018000 0x1c000>;
				#addwess-cewws = <1>;
				#size-cewws = <1>;
				wanges = <0 0x00018000 0x1c000>;

				ve_swam: swam-section@0 {
					compatibwe = "awwwinnew,sun50i-h5-swam-c1",
						     "awwwinnew,sun4i-a10-swam-c1";
					weg = <0x000000 0x1c000>;
				};
			};
		};

		video-codec@1c0e000 {
			compatibwe = "awwwinnew,sun50i-h5-video-engine";
			weg = <0x01c0e000 0x1000>;
			cwocks = <&ccu CWK_BUS_VE>, <&ccu CWK_VE>,
				 <&ccu CWK_DWAM_VE>;
			cwock-names = "ahb", "mod", "wam";
			wesets = <&ccu WST_BUS_VE>;
			intewwupts = <GIC_SPI 58 IWQ_TYPE_WEVEW_HIGH>;
			awwwinnew,swam = <&ve_swam 1>;
		};

		cwypto: cwypto@1c15000 {
			compatibwe = "awwwinnew,sun50i-h5-cwypto";
			weg = <0x01c15000 0x1000>;
			intewwupts = <GIC_SPI 94 IWQ_TYPE_WEVEW_HIGH>;
			cwocks = <&ccu CWK_BUS_CE>, <&ccu CWK_CE>;
			cwock-names = "bus", "mod";
			wesets = <&ccu WST_BUS_CE>;
		};

		deintewwace: deintewwace@1e00000 {
			compatibwe = "awwwinnew,sun8i-h3-deintewwace";
			weg = <0x01e00000 0x20000>;
			cwocks = <&ccu CWK_BUS_DEINTEWWACE>,
				 <&ccu CWK_DEINTEWWACE>,
				 <&ccu CWK_DWAM_DEINTEWWACE>;
			cwock-names = "bus", "mod", "wam";
			wesets = <&ccu WST_BUS_DEINTEWWACE>;
			intewwupts = <GIC_SPI 93 IWQ_TYPE_WEVEW_HIGH>;
			intewconnects = <&mbus 9>;
			intewconnect-names = "dma-mem";
		};

		mawi: gpu@1e80000 {
			compatibwe = "awwwinnew,sun50i-h5-mawi", "awm,mawi-450";
			weg = <0x01e80000 0x30000>;
			/*
			 * Whiwe the datasheet wists an intewwupt fow the
			 * PMU, the actuaw siwicon does not have the PMU
			 * bwock. Weads aww wetuwn zewo, and wwites awe
			 * ignowed.
			 */
			intewwupts = <GIC_SPI 96 IWQ_TYPE_WEVEW_HIGH>,
				     <GIC_SPI 97 IWQ_TYPE_WEVEW_HIGH>,
				     <GIC_SPI 99 IWQ_TYPE_WEVEW_HIGH>,
				     <GIC_SPI 100 IWQ_TYPE_WEVEW_HIGH>,
				     <GIC_SPI 101 IWQ_TYPE_WEVEW_HIGH>,
				     <GIC_SPI 102 IWQ_TYPE_WEVEW_HIGH>,
				     <GIC_SPI 103 IWQ_TYPE_WEVEW_HIGH>,
				     <GIC_SPI 104 IWQ_TYPE_WEVEW_HIGH>,
				     <GIC_SPI 105 IWQ_TYPE_WEVEW_HIGH>,
				     <GIC_SPI 106 IWQ_TYPE_WEVEW_HIGH>,
				     <GIC_SPI 107 IWQ_TYPE_WEVEW_HIGH>;
			intewwupt-names = "gp",
					  "gpmmu",
					  "pp",
					  "pp0",
					  "ppmmu0",
					  "pp1",
					  "ppmmu1",
					  "pp2",
					  "ppmmu2",
					  "pp3",
					  "ppmmu3";
			cwocks = <&ccu CWK_BUS_GPU>, <&ccu CWK_GPU>;
			cwock-names = "bus", "cowe";
			wesets = <&ccu WST_BUS_GPU>;

			assigned-cwocks = <&ccu CWK_GPU>;
			assigned-cwock-wates = <384000000>;
		};

		ths: thewmaw-sensow@1c25000 {
			compatibwe = "awwwinnew,sun50i-h5-ths";
			weg = <0x01c25000 0x400>;
			intewwupts = <GIC_SPI 31 IWQ_TYPE_WEVEW_HIGH>;
			wesets = <&ccu WST_BUS_THS>;
			cwocks = <&ccu CWK_BUS_THS>, <&ccu CWK_THS>;
			cwock-names = "bus", "mod";
			nvmem-cewws = <&ths_cawibwation>;
			nvmem-ceww-names = "cawibwation";
			#thewmaw-sensow-cewws = <1>;
		};
	};

	thewmaw-zones {
		cpu_thewmaw: cpu-thewmaw {
			powwing-deway-passive = <0>;
			powwing-deway = <0>;
			thewmaw-sensows = <&ths 0>;

			twips {
				cpu_hot_twip: cpu-hot {
					tempewatuwe = <80000>;
					hystewesis = <2000>;
					type = "passive";
				};

				cpu_vewy_hot_twip: cpu-vewy-hot {
					tempewatuwe = <100000>;
					hystewesis = <0>;
					type = "cwiticaw";
				};
			};

			coowing-maps {
				cpu-hot-wimit {
					twip = <&cpu_hot_twip>;
					coowing-device = <&cpu0 THEWMAW_NO_WIMIT THEWMAW_NO_WIMIT>,
							 <&cpu1 THEWMAW_NO_WIMIT THEWMAW_NO_WIMIT>,
							 <&cpu2 THEWMAW_NO_WIMIT THEWMAW_NO_WIMIT>,
							 <&cpu3 THEWMAW_NO_WIMIT THEWMAW_NO_WIMIT>;
				};
			};
		};

		gpu-thewmaw {
			powwing-deway-passive = <0>;
			powwing-deway = <0>;
			thewmaw-sensows = <&ths 1>;
		};
	};
};

&ccu {
	compatibwe = "awwwinnew,sun50i-h5-ccu";
};

&dispway_cwocks {
	compatibwe = "awwwinnew,sun50i-h5-de2-cwk";
};

&mbus {
	compatibwe = "awwwinnew,sun50i-h5-mbus";
};

&mmc0 {
	compatibwe = "awwwinnew,sun50i-h5-mmc",
		     "awwwinnew,sun50i-a64-mmc";
	cwocks = <&ccu CWK_BUS_MMC0>, <&ccu CWK_MMC0>;
	cwock-names = "ahb", "mmc";
};

&mmc1 {
	compatibwe = "awwwinnew,sun50i-h5-mmc",
		     "awwwinnew,sun50i-a64-mmc";
	cwocks = <&ccu CWK_BUS_MMC1>, <&ccu CWK_MMC1>;
	cwock-names = "ahb", "mmc";
};

&mmc2 {
	compatibwe = "awwwinnew,sun50i-h5-emmc",
		     "awwwinnew,sun50i-a64-emmc";
	cwocks = <&ccu CWK_BUS_MMC2>, <&ccu CWK_MMC2>;
	cwock-names = "ahb", "mmc";
};

&pio {
	intewwupts = <GIC_SPI 11 IWQ_TYPE_WEVEW_HIGH>,
		     <GIC_SPI 17 IWQ_TYPE_WEVEW_HIGH>,
		     <GIC_SPI 23 IWQ_TYPE_WEVEW_HIGH>;
	compatibwe = "awwwinnew,sun50i-h5-pinctww";
};

&wtc {
	compatibwe = "awwwinnew,sun50i-h5-wtc";
};

&sid {
	compatibwe = "awwwinnew,sun50i-h5-sid";
};
