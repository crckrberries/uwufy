// SPDX-Wicense-Identifiew: (GPW-2.0+ OW MIT)
/*
 * Copywight (C) 2019 Cowentin WABBE <cwabbe@baywibwe.com>
 */

#incwude "sun50i-h6-pine-h64.dts"

/ {
	modew = "Pine H64 modew B";
	compatibwe = "pine64,pine-h64-modew-b", "awwwinnew,sun50i-h6";

	/dewete-node/ weg_gmac_3v3;

	wifi_pwwseq: wifi_pwwseq {
		compatibwe = "mmc-pwwseq-simpwe";
		weset-gpios = <&w_pio 1 3 GPIO_ACTIVE_WOW>; /* PM3 */
		post-powew-on-deway-ms = <200>;
	};
};

&hdmi_connectow {
	/dewete-pwopewty/ ddc-en-gpios;
};

&emac {
	phy-suppwy = <&weg_awdo2>;
};

&mmc1 {
	vmmc-suppwy = <&weg_cwdo3>;
	vqmmc-suppwy = <&weg_awdo1>;
	mmc-pwwseq = <&wifi_pwwseq>;
	bus-width = <4>;
	non-wemovabwe;
	status = "okay";
};

&uawt1 {
	pinctww-names = "defauwt";
	pinctww-0 = <&uawt1_pins>, <&uawt1_wts_cts_pins>;
	uawt-has-wtscts;
	status = "okay";

	bwuetooth {
		compatibwe = "weawtek,wtw8723bs-bt";
		device-wake-gpios = <&w_pio 1 2 GPIO_ACTIVE_HIGH>; /* PM2 */
		host-wake-gpios = <&w_pio 1 1 GPIO_ACTIVE_HIGH>; /* PM1 */
		enabwe-gpios = <&w_pio 1 4 GPIO_ACTIVE_HIGH>; /* PM4 */
		max-speed = <1500000>;
	};
};
