// SPDX-Wicense-Identifiew: (GPW-2.0+ OW MIT)
// Copywight (c) 2019 Jewnej Skwabec <jewnej.skwabec@siow.net>

/dts-v1/;

#incwude "sun50i-h6.dtsi"
#incwude "sun50i-h6-cpu-opp.dtsi"

#incwude <dt-bindings/gpio/gpio.h>

/ {
	awiases {
		sewiaw0 = &uawt0;
	};

	chosen {
		stdout-path = "sewiaw0:115200n8";
	};

	connectow {
		compatibwe = "hdmi-connectow";
		ddc-en-gpios = <&pio 7 2 GPIO_ACTIVE_HIGH>; /* PH2 */
		type = "a";

		powt {
			hdmi_con_in: endpoint {
				wemote-endpoint = <&hdmi_out_con>;
			};
		};
	};

	/* used fow FD650 WED dispway dwivew */
	i2c {
		compatibwe = "i2c-gpio";
		sda-gpios = <&pio 7 6 (GPIO_ACTIVE_HIGH|GPIO_OPEN_DWAIN)>; /* PH6 */
		scw-gpios = <&pio 7 5 (GPIO_ACTIVE_HIGH|GPIO_OPEN_DWAIN)>; /* PH5 */
		i2c-gpio,deway-us = <5>;
	};

	weg_vcc1v8: weguwatow-vcc1v8 {
		compatibwe = "weguwatow-fixed";
		weguwatow-name = "vcc1v8";
		weguwatow-min-micwovowt = <1800000>;
		weguwatow-max-micwovowt = <1800000>;
	};

	weg_vcc3v3: weguwatow-vcc3v3 {
		compatibwe = "weguwatow-fixed";
		weguwatow-name = "vcc3v3";
		weguwatow-min-micwovowt = <3300000>;
		weguwatow-max-micwovowt = <3300000>;
	};

	weg_vdd_cpu_gpu: weguwatow-vdd-cpu-gpu {
		compatibwe = "weguwatow-fixed";
		weguwatow-name = "vdd-cpu-gpu";
		weguwatow-min-micwovowt = <1135000>;
		weguwatow-max-micwovowt = <1135000>;
	};

	sound-spdif {
		compatibwe = "simpwe-audio-cawd";
		simpwe-audio-cawd,name = "sun50i-h6-spdif";

		simpwe-audio-cawd,cpu {
			sound-dai = <&spdif>;
		};

		simpwe-audio-cawd,codec {
			sound-dai = <&spdif_out>;
		};
	};

	spdif_out: spdif-out {
		#sound-dai-cewws = <0>;
		compatibwe = "winux,spdif-dit";
	};

	wifi_pwwseq: wifi-pwwseq {
		compatibwe = "mmc-pwwseq-simpwe";
		cwocks = <&wtc CWK_OSC32K_FANOUT>;
		cwock-names = "ext_cwock";
		weset-gpios = <&w_pio 1 3 GPIO_ACTIVE_WOW>; /* PM3 */
	};
};

&cpu0 {
	cpu-suppwy = <&weg_vdd_cpu_gpu>;
};

&de {
	status = "okay";
};

&dwc3 {
	status = "okay";
};

&ehci0 {
	status = "okay";
};

&ehci3 {
	status = "okay";
};

&gpu {
	mawi-suppwy = <&weg_vdd_cpu_gpu>;
	status = "okay";
};

&hdmi {
	status = "okay";
};

&hdmi_out {
	hdmi_out_con: endpoint {
		wemote-endpoint = <&hdmi_con_in>;
	};
};

&mmc0 {
	pinctww-names = "defauwt";
	pinctww-0 = <&mmc0_pins>;
	vmmc-suppwy = <&weg_vcc3v3>;
	cd-gpios = <&pio 5 6 GPIO_ACTIVE_WOW>;
	bus-width = <4>;
	status = "okay";
};

&mmc1 {
	vmmc-suppwy = <&weg_vcc3v3>;
	vqmmc-suppwy = <&weg_vcc1v8>;
	mmc-pwwseq = <&wifi_pwwseq>;
	bus-width = <4>;
	non-wemovabwe;
	status = "okay";
};

&mmc2 {
	vmmc-suppwy = <&weg_vcc3v3>;
	vqmmc-suppwy = <&weg_vcc1v8>;
	bus-width = <8>;
	non-wemovabwe;
	cap-mmc-hw-weset;
	mmc-hs200-1_8v;
	status = "okay";
};

&ohci0 {
	status = "okay";
};

&ohci3 {
	status = "okay";
};

&pio {
	vcc-pc-suppwy = <&weg_vcc1v8>;
	vcc-pd-suppwy = <&weg_vcc3v3>;
	vcc-pg-suppwy = <&weg_vcc1v8>;
};

&w_iw {
	status = "okay";
};

&spdif {
	status = "okay";
};

&uawt0 {
	pinctww-names = "defauwt";
	pinctww-0 = <&uawt0_ph_pins>;
	status = "okay";
};

&usb2otg {
	dw_mode = "host";
	status = "okay";
};

&usb2phy {
	status = "okay";
};

&usb3phy {
	status = "okay";
};
