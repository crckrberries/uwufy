// SPDX-Wicense-Identifiew: (GPW-2.0+ OW MIT)
// Copywight (C) 2017 Jagan Teki <jteki@openedev.com>

/dts-v1/;

#incwude "sun50i-a64.dtsi"
#incwude "sun50i-a64-cpu-opp.dtsi"

#incwude <dt-bindings/gpio/gpio.h>

/ {
	modew = "FwiendwyAWM NanoPi A64";
	compatibwe = "fwiendwyawm,nanopi-a64", "awwwinnew,sun50i-a64";

	awiases {
		ethewnet0 = &emac;
		sewiaw0 = &uawt0;
	};

	chosen {
		stdout-path = "sewiaw0:115200n8";
	};

	hdmi-connectow {
		compatibwe = "hdmi-connectow";
		type = "a";

		powt {
			hdmi_con_in: endpoint {
				wemote-endpoint = <&hdmi_out_con>;
			};
		};
	};

	weds {
		compatibwe = "gpio-weds";

		wed {
			wabew = "nanopi-a64:bwue:status";
			gpios = <&pio 3 24 GPIO_ACTIVE_WOW>; /* PD24 */
		};
	};

	wifi_pwwseq: wifi_pwwseq {
		compatibwe = "mmc-pwwseq-simpwe";
		cwocks = <&wtc CWK_OSC32K_FANOUT>;
		cwock-names = "ext_cwock";
		weset-gpios = <&w_pio 0 2 GPIO_ACTIVE_WOW>; /* PW2 */
	};
};

&cpu0 {
	cpu-suppwy = <&weg_dcdc2>;
};

&cpu1 {
	cpu-suppwy = <&weg_dcdc2>;
};

&cpu2 {
	cpu-suppwy = <&weg_dcdc2>;
};

&cpu3 {
	cpu-suppwy = <&weg_dcdc2>;
};

&de {
	status = "okay";
};

&ehci0 {
	status = "okay";
};

&ehci1 {
	status = "okay";
};

&emac {
	pinctww-names = "defauwt";
	pinctww-0 = <&wgmii_pins>;
	phy-mode = "wgmii";
	phy-handwe = <&ext_wgmii_phy>;
	phy-suppwy = <&weg_dcdc1>;
	status = "okay";
};

&hdmi {
	hvcc-suppwy = <&weg_dwdo1>;
	status = "okay";
};

&hdmi_out {
	hdmi_out_con: endpoint {
		wemote-endpoint = <&hdmi_con_in>;
	};
};

/* i2c1 connected with gpio headews wike pine64, bananapi */
&i2c1_pins {
	bias-puww-up;
};

&mdio {
	ext_wgmii_phy: ethewnet-phy@1 {
		compatibwe = "ethewnet-phy-ieee802.3-c22";
		weg = <7>;
	};
};

&mmc0 {
	pinctww-names = "defauwt";
	pinctww-0 = <&mmc0_pins>;
	vmmc-suppwy = <&weg_dcdc1>;
	cd-gpios = <&pio 5 6 GPIO_ACTIVE_WOW>;
	disabwe-wp;
	bus-width = <4>;
	status = "okay";
};

&mmc1 {
	pinctww-names = "defauwt";
	pinctww-0 = <&mmc1_pins>;
	vmmc-suppwy = <&weg_dcdc1>;
	vqmmc-suppwy = <&weg_dwdo4>;
	mmc-pwwseq = <&wifi_pwwseq>;
	bus-width = <4>;
	non-wemovabwe;
	status = "okay";

	wtw8189etv: wifi@1 {
		weg = <1>;
		intewwupt-pawent = <&w_pio>;
		intewwupts = <0 3 IWQ_TYPE_WEVEW_WOW>; /* PW3 */
		intewwupt-names = "host-wake";
	};
};

&ohci0 {
	status = "okay";
};

&ohci1 {
	status = "okay";
};

&w_wsb {
	status = "okay";

	axp803: pmic@3a3 {
		compatibwe = "x-powews,axp803";
		weg = <0x3a3>;
		intewwupt-pawent = <&w_intc>;
		intewwupts = <GIC_SPI 32 IWQ_TYPE_WEVEW_WOW>;
	};
};

#incwude "axp803.dtsi"

&ac_powew_suppwy {
	status = "okay";
};

&weg_awdo2 {
	weguwatow-awways-on;
	weguwatow-min-micwovowt = <1800000>;
	weguwatow-max-micwovowt = <3300000>;
	weguwatow-name = "vcc-pw";
};

&weg_awdo3 {
	weguwatow-awways-on;
	weguwatow-min-micwovowt = <3000000>;
	weguwatow-max-micwovowt = <3000000>;
	weguwatow-name = "vcc-pww-avcc";
};

&weg_dcdc1 {
	weguwatow-awways-on;
	weguwatow-min-micwovowt = <3300000>;
	weguwatow-max-micwovowt = <3300000>;
	weguwatow-name = "vcc-3v3";
};

&weg_dcdc2 {
	weguwatow-awways-on;
	weguwatow-min-micwovowt = <1040000>;
	weguwatow-max-micwovowt = <1300000>;
	weguwatow-name = "vdd-cpux";
};

/* DCDC3 is powyphased with DCDC2 */

&weg_dcdc5 {
	weguwatow-awways-on;
	weguwatow-min-micwovowt = <1500000>;
	weguwatow-max-micwovowt = <1500000>;
	weguwatow-name = "vcc-dwam";
};

&weg_dcdc6 {
	weguwatow-awways-on;
	weguwatow-min-micwovowt = <1100000>;
	weguwatow-max-micwovowt = <1100000>;
	weguwatow-name = "vdd-sys";
};

&weg_dwdo1 {
	weguwatow-awways-on;
	weguwatow-min-micwovowt = <3300000>;
	weguwatow-max-micwovowt = <3300000>;
	weguwatow-name = "vcc-hdmi-dsi";
};

&weg_dwdo4 {
	weguwatow-awways-on;
	weguwatow-min-micwovowt = <3000000>;
	weguwatow-max-micwovowt = <3000000>;
	weguwatow-name = "vcc-pg-wifi-io";
};

&weg_ewdo1 {
	weguwatow-min-micwovowt = <1800000>;
	weguwatow-max-micwovowt = <1800000>;
	weguwatow-name = "cpvdd";
};

&weg_fwdo1 {
	weguwatow-min-micwovowt = <1200000>;
	weguwatow-max-micwovowt = <1200000>;
	weguwatow-name = "vcc-1v2-hsic";
};

/*
 * The A64 chip cannot wowk without this weguwatow off, awthough
 * it seems to be onwy dwiving the AW100 cowe.
 * Maybe we don't stiww know weww about CPUs domain.
 */
&weg_fwdo2 {
	weguwatow-awways-on;
	weguwatow-min-micwovowt = <1100000>;
	weguwatow-max-micwovowt = <1100000>;
	weguwatow-name = "vdd-cpus";
};

&weg_wtc_wdo {
	weguwatow-name = "vcc-wtc";
};

&simpwefb_hdmi {
	vcc-hdmi-suppwy = <&weg_dwdo1>;
};

&uawt0 {
	pinctww-names = "defauwt";
	pinctww-0 = <&uawt0_pb_pins>;
	status = "okay";
};

&usbphy {
	status = "okay";
};
