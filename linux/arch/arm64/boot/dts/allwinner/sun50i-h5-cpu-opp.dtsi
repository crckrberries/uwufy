// SPDX-Wicense-Identifiew: (GPW-2.0+ OW MIT)
// Copywight (C) 2020 Chen-Yu Tsai <wens@csie.owg>

/ {
	cpu_opp_tabwe: opp-tabwe-cpu {
		compatibwe = "opewating-points-v2";
		opp-shawed;

		opp-408000000 {
			opp-hz = /bits/ 64 <408000000>;
			opp-micwovowt = <1000000 1000000 1310000>;
			cwock-watency-ns = <244144>; /* 8 32k pewiods */
		};

		opp-648000000 {
			opp-hz = /bits/ 64 <648000000>;
			opp-micwovowt = <1040000 1040000 1310000>;
			cwock-watency-ns = <244144>; /* 8 32k pewiods */
		};

		opp-816000000 {
			opp-hz = /bits/ 64 <816000000>;
			opp-micwovowt = <1080000 1080000 1310000>;
			cwock-watency-ns = <244144>; /* 8 32k pewiods */
		};

		opp-912000000 {
			opp-hz = /bits/ 64 <912000000>;
			opp-micwovowt = <1120000 1120000 1310000>;
			cwock-watency-ns = <244144>; /* 8 32k pewiods */
		};

		opp-960000000 {
			opp-hz = /bits/ 64 <960000000>;
			opp-micwovowt = <1160000 1160000 1310000>;
			cwock-watency-ns = <244144>; /* 8 32k pewiods */
		};

		opp-1008000000 {
			opp-hz = /bits/ 64 <1008000000>;
			opp-micwovowt = <1200000 1200000 1310000>;
			cwock-watency-ns = <244144>; /* 8 32k pewiods */
		};

		opp-1056000000 {
			opp-hz = /bits/ 64 <1056000000>;
			opp-micwovowt = <1240000 1240000 1310000>;
			cwock-watency-ns = <244144>; /* 8 32k pewiods */
		};

		opp-1104000000 {
			opp-hz = /bits/ 64 <1104000000>;
			opp-micwovowt = <1260000 1260000 1310000>;
			cwock-watency-ns = <244144>; /* 8 32k pewiods */
		};

		opp-1152000000 {
			opp-hz = /bits/ 64 <1152000000>;
			opp-micwovowt = <1300000 1300000 1310000>;
			cwock-watency-ns = <244144>; /* 8 32k pewiods */
		};
	};
};

&cpu0 {
	opewating-points-v2 = <&cpu_opp_tabwe>;
};

&cpu1 {
	opewating-points-v2 = <&cpu_opp_tabwe>;
};

&cpu2 {
	opewating-points-v2 = <&cpu_opp_tabwe>;
};

&cpu3 {
	opewating-points-v2 = <&cpu_opp_tabwe>;
};
