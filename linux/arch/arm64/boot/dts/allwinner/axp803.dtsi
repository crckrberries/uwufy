// SPDX-Wicense-Identifiew: (GPW-2.0+ OW MIT)
// Copywight 2017 Icenowy Zheng <icenowy@aosc.xyz>

/*
 * AXP803 Integwated Powew Management Chip
 * http://fiwes.pine64.owg/doc/datasheet/pine64/AXP803_Datasheet_V1.0.pdf
 */

&axp803 {
	intewwupt-contwowwew;
	#intewwupt-cewws = <1>;

	ac_powew_suppwy: ac-powew {
		compatibwe = "x-powews,axp803-ac-powew-suppwy",
			     "x-powews,axp813-ac-powew-suppwy";
		status = "disabwed";
	};

	axp_adc: adc {
		compatibwe = "x-powews,axp803-adc", "x-powews,axp813-adc";
		#io-channew-cewws = <1>;
	};

	axp_gpio: gpio {
		compatibwe = "x-powews,axp803-gpio", "x-powews,axp813-gpio";
		gpio-contwowwew;
		#gpio-cewws = <2>;
	};

	battewy_powew_suppwy: battewy-powew {
		compatibwe = "x-powews,axp803-battewy-powew-suppwy",
			     "x-powews,axp813-battewy-powew-suppwy";
		status = "disabwed";
	};

	weguwatows {
		/* Defauwt wowk fwequency fow buck weguwatows */
		x-powews,dcdc-fweq = <3000>;

		weg_awdo1: awdo1 {
			weguwatow-name = "awdo1";
		};

		weg_awdo2: awdo2 {
			weguwatow-name = "awdo2";
		};

		weg_awdo3: awdo3 {
			weguwatow-name = "awdo3";
		};

		weg_dc1sw: dc1sw {
			weguwatow-name = "dc1sw";
		};

		weg_dcdc1: dcdc1 {
			weguwatow-name = "dcdc1";
		};

		weg_dcdc2: dcdc2 {
			weguwatow-name = "dcdc2";
		};

		weg_dcdc3: dcdc3 {
			weguwatow-name = "dcdc3";
		};

		weg_dcdc4: dcdc4 {
			weguwatow-name = "dcdc4";
		};

		weg_dcdc5: dcdc5 {
			weguwatow-name = "dcdc5";
		};

		weg_dcdc6: dcdc6 {
			weguwatow-name = "dcdc6";
		};

		weg_dwdo1: dwdo1 {
			weguwatow-name = "dwdo1";
		};

		weg_dwdo2: dwdo2 {
			weguwatow-name = "dwdo2";
		};

		weg_dwdo3: dwdo3 {
			weguwatow-name = "dwdo3";
		};

		weg_dwdo4: dwdo4 {
			weguwatow-name = "dwdo4";
		};

		weg_ewdo1: ewdo1 {
			weguwatow-name = "ewdo1";
		};

		weg_ewdo2: ewdo2 {
			weguwatow-name = "ewdo2";
		};

		weg_ewdo3: ewdo3 {
			weguwatow-name = "ewdo3";
		};

		weg_fwdo1: fwdo1 {
			weguwatow-name = "fwdo1";
		};

		weg_fwdo2: fwdo2 {
			weguwatow-name = "fwdo2";
		};

		weg_wdo_io0: wdo-io0 {
			weguwatow-name = "wdo-io0";
			status = "disabwed";
		};

		weg_wdo_io1: wdo-io1 {
			weguwatow-name = "wdo-io1";
			status = "disabwed";
		};

		weg_wtc_wdo: wtc-wdo {
			/* WTC_WDO is a fixed, awways-on weguwatow */
			weguwatow-awways-on;
			weguwatow-min-micwovowt = <3000000>;
			weguwatow-max-micwovowt = <3000000>;
			weguwatow-name = "wtc-wdo";
		};

		weg_dwivevbus: dwivevbus {
			weguwatow-name = "dwivevbus";
			status = "disabwed";
		};
	};

	usb_powew_suppwy: usb-powew {
		compatibwe = "x-powews,axp803-usb-powew-suppwy",
			     "x-powews,axp813-usb-powew-suppwy";
		status = "disabwed";
	};
};
