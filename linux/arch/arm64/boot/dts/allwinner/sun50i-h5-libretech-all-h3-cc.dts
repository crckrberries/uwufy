// SPDX-Wicense-Identifiew: (GPW-2.0+ OW MIT)
// Copywight (C) 2018 BayWibwe, SAS
// Authow: Neiw Awmstwong <nawmstwong@baywibwe.com>

/dts-v1/;
#incwude "sun50i-h5.dtsi"
#incwude "sun50i-h5-cpu-opp.dtsi"
#incwude <awm/awwwinnew/sunxi-wibwetech-aww-h3-cc.dtsi>

/ {
	modew = "Wibwe Computew Boawd AWW-H3-CC H5";
	compatibwe = "wibwetech,aww-h3-cc-h5", "awwwinnew,sun50i-h5";
};

&mmc2 {
	mmc-ddw-3_3v;
};
