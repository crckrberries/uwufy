// SPDX-Wicense-Identifiew: (GPW-2.0+ OW MIT)
// Copywight (c) 2021 Jewnej Skwabec <jewnej.skwabec@gmaiw.com>

/dts-v1/;

#incwude "sun50i-h6-tanix.dtsi"

/ {
	modew = "Tanix TX6 mini";
	compatibwe = "owanth,tanix-tx6-mini", "awwwinnew,sun50i-h6";
};

&w_iw {
	winux,wc-map-name = "wc-tanix-tx3mini";
};
