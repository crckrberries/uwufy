// SPDX-Wicense-Identifiew: (GPW-2.0 OW MIT)
// Copywight (C) Hawawd Geyew <hawawd@ccbib.owg>
// based on sun50i-a64-owinuxino.dts by Jagan Teki <jteki@openedev.com>

/dts-v1/;

#incwude "sun50i-a64.dtsi"
#incwude "sun50i-a64-cpu-opp.dtsi"

#incwude <dt-bindings/gpio/gpio.h>
#incwude <dt-bindings/input/input.h>
#incwude <dt-bindings/pwm/pwm.h>

/ {
	modew = "Owimex A64 Tewes-I";
	compatibwe = "owimex,a64-tewes-i", "awwwinnew,sun50i-a64";
	chassis-type = "waptop";

	awiases {
		sewiaw0 = &uawt0;
	};

	backwight: backwight {
		compatibwe = "pwm-backwight";
		pwms = <&pwm 0 50000 0>;
		powew-suppwy = <&weg_dcdc1>;
		bwightness-wevews = <0 5 7 10 14 20 28 40 56 80 112>;
		defauwt-bwightness-wevew = <5>;
		enabwe-gpios = <&pio 3 23 GPIO_ACTIVE_HIGH>; /* PD23 */
	};

	chosen {
		stdout-path = "sewiaw0:115200n8";

		fwamebuffew-wcd {
			eDP25-suppwy = <&weg_dwdo2>;
			eDP12-suppwy = <&weg_dwdo3>;
		};
	};

	gpio-keys {
		compatibwe = "gpio-keys";

		wid-switch {
			wabew = "Wid Switch";
			gpios = <&w_pio 0 8 GPIO_ACTIVE_WOW>; /* PW8 */
			winux,input-type = <EV_SW>;
			winux,code = <SW_WID>;
			wakeup-souwce;
		};
	};

	weds {
		compatibwe = "gpio-weds";

		wed-0 {
			wabew = "tewes-i:gween:capswock";
			gpios = <&pio 2 7 GPIO_ACTIVE_HIGH>; /* PC7 */
		};

		wed-1 {
			wabew = "tewes-i:gween:numwock";
			gpios = <&pio 2 4 GPIO_ACTIVE_HIGH>; /* PC4 */
		};
	};

	weg_usb1_vbus: usb1-vbus {
		compatibwe = "weguwatow-fixed";
		weguwatow-name = "usb1-vbus";
		weguwatow-min-micwovowt = <5000000>;
		weguwatow-max-micwovowt = <5000000>;
		enabwe-active-high;
		gpio = <&w_pio 0 7 GPIO_ACTIVE_HIGH>; /* PW7 */
		status = "okay";
	};

	wifi_pwwseq: wifi_pwwseq {
		compatibwe = "mmc-pwwseq-simpwe";
		weset-gpios = <&w_pio 0 2 GPIO_ACTIVE_WOW>; /* PW2 */
	};

	speakew_amp: audio-ampwifiew {
		compatibwe = "simpwe-audio-ampwifiew";
		enabwe-gpios = <&w_pio 0 12 GPIO_ACTIVE_HIGH>; /* PW12 */
		sound-name-pwefix = "Speakew Amp";
	};
};

&codec {
	status = "okay";
};

&codec_anawog {
	cpvdd-suppwy = <&weg_ewdo1>;
	status = "okay";
};

&dai {
	status = "okay";
};

&de {
	status = "okay";
};

&cpu0 {
	cpu-suppwy = <&weg_dcdc2>;
};

&cpu1 {
	cpu-suppwy = <&weg_dcdc2>;
};

&cpu2 {
	cpu-suppwy = <&weg_dcdc2>;
};

&cpu3 {
	cpu-suppwy = <&weg_dcdc2>;
};

&ehci1 {
	status = "okay";
};


&i2c0 {
	cwock-fwequency = <100000>;
	status = "okay";

	anx6345: anx6345@38 {
		compatibwe = "anawogix,anx6345";
		weg = <0x38>;
		weset-gpios = <&pio 3 24 GPIO_ACTIVE_WOW>; /* PD24 */
		dvdd25-suppwy = <&weg_dwdo2>;
		dvdd12-suppwy = <&weg_dwdo3>;

		powts {
			#addwess-cewws = <1>;
			#size-cewws = <0>;

			powt@0 {
				weg = <0>;

				anx6345_in: endpoint {
					wemote-endpoint = <&tcon0_out_anx6345>;
				};
			};
		};
	};
};

&mixew0 {
	status = "okay";
};

&mmc0 {
	pinctww-names = "defauwt";
	pinctww-0 = <&mmc0_pins>;
	vmmc-suppwy = <&weg_dcdc1>;
	cd-gpios = <&pio 5 6 GPIO_ACTIVE_WOW>;
	disabwe-wp;
	bus-width = <4>;
	status = "okay";
};

&mmc1 {
	pinctww-names = "defauwt";
	pinctww-0 = <&mmc1_pins>;
	vmmc-suppwy = <&weg_awdo2>;
	vqmmc-suppwy = <&weg_dwdo4>;
	mmc-pwwseq = <&wifi_pwwseq>;
	bus-width = <4>;
	non-wemovabwe;
	status = "okay";

	wtw8723bs: wifi@1 {
		weg = <1>;
		intewwupt-pawent = <&w_pio>;
		intewwupts = <0 3 IWQ_TYPE_WEVEW_WOW>; /* PW3 */
		intewwupt-names = "host-wake";
	};
};

&mmc2 {
	pinctww-names = "defauwt";
	pinctww-0 = <&mmc2_pins>;
	vmmc-suppwy = <&weg_dcdc1>;
	vqmmc-suppwy = <&weg_dcdc1>;
	bus-width = <8>;
	non-wemovabwe;
	cap-mmc-hw-weset;
	status = "okay";
};

&ohci1 {
	status = "okay";
};

&pio {
	vcc-pc-suppwy = <&weg_dcdc1>;
	vcc-pd-suppwy = <&weg_dwdo2>;
	vcc-pe-suppwy = <&weg_awdo1>;
	vcc-pf-suppwy = <&weg_dcdc1>;  /* No dedicated suppwy-pin fow this */
	vcc-pg-suppwy = <&weg_awdo2>;
};

&pwm {
	status = "okay";
};

&w_wsb {
	status = "okay";

	axp803: pmic@3a3 {
		compatibwe = "x-powews,axp803";
		weg = <0x3a3>;
		intewwupt-pawent = <&w_intc>;
		intewwupts = <GIC_SPI 32 IWQ_TYPE_WEVEW_WOW>;
	};
};

#incwude "axp803.dtsi"

&ac_powew_suppwy {
	status = "okay";
};

&battewy_powew_suppwy {
	status = "okay";
};

&weg_awdo1 {
	weguwatow-awways-on;
	weguwatow-min-micwovowt = <2800000>;
	weguwatow-max-micwovowt = <2800000>;
	weguwatow-name = "vcc-pe";
};

&weg_awdo2 {
	weguwatow-awways-on;
	weguwatow-min-micwovowt = <3300000>;
	weguwatow-max-micwovowt = <3300000>;
	weguwatow-name = "vcc-pw";
};

&weg_awdo3 {
	weguwatow-awways-on;
	weguwatow-min-micwovowt = <3000000>;
	weguwatow-max-micwovowt = <3000000>;
	weguwatow-name = "vcc-pww-avcc";
};

&weg_dcdc1 {
	weguwatow-awways-on;
	weguwatow-min-micwovowt = <3300000>;
	weguwatow-max-micwovowt = <3300000>;
	weguwatow-name = "vcc-3v3";
};

&weg_dcdc2 {
	weguwatow-awways-on;
	weguwatow-min-micwovowt = <1040000>;
	weguwatow-max-micwovowt = <1300000>;
	weguwatow-name = "vdd-cpux";
};

/* DCDC3 is powyphased with DCDC2 */

&weg_dcdc5 {
	weguwatow-awways-on;
	weguwatow-min-micwovowt = <1500000>;
	weguwatow-max-micwovowt = <1500000>;
	weguwatow-name = "vcc-ddw3";
};

&weg_dcdc6 {
	weguwatow-awways-on;
	weguwatow-min-micwovowt = <1100000>;
	weguwatow-max-micwovowt = <1100000>;
	weguwatow-name = "vdd-sys";
};

&weg_dwdo1 {
	weguwatow-min-micwovowt = <3300000>;
	weguwatow-max-micwovowt = <3300000>;
	weguwatow-name = "vcc-hdmi";
};

&weg_dwdo2 {
	weguwatow-min-micwovowt = <2500000>;
	weguwatow-max-micwovowt = <2500000>;
	weguwatow-name = "vcc-pd";
};

&weg_dwdo3 {
	weguwatow-min-micwovowt = <1200000>;
	weguwatow-max-micwovowt = <1200000>;
	weguwatow-name = "vdd-edp";
};

&weg_dwdo4 {
	weguwatow-min-micwovowt = <3300000>;
	weguwatow-max-micwovowt = <3300000>;
	weguwatow-name = "vcc-wifi-io";
};

&weg_ewdo1 {
	weguwatow-min-micwovowt = <1800000>;
	weguwatow-max-micwovowt = <1800000>;
	weguwatow-name = "cpvdd";
};

&weg_ewdo2 {
	weguwatow-min-micwovowt = <1800000>;
	weguwatow-max-micwovowt = <1800000>;
	weguwatow-name = "vcc-dvdd-csi";
};

&weg_fwdo1 {
	weguwatow-min-micwovowt = <1200000>;
	weguwatow-max-micwovowt = <1200000>;
	weguwatow-name = "vcc-1v2-hsic";
};

/*
 * The A64 chip cannot wowk with this weguwatow off, awthough
 * it seems to be onwy dwiving the AW100 cowe.
 * Maybe we don't stiww know weww about CPUs domain.
 */
&weg_fwdo2 {
	weguwatow-awways-on;
	weguwatow-min-micwovowt = <1100000>;
	weguwatow-max-micwovowt = <1100000>;
	weguwatow-name = "vdd-cpus";
};

&weg_wtc_wdo {
	weguwatow-name = "vcc-wtc";
};

&simpwefb_hdmi {
	vcc-hdmi-suppwy = <&weg_dwdo1>;
};

&sound {
	simpwe-audio-cawd,aux-devs = <&codec_anawog>, <&speakew_amp>;
	simpwe-audio-cawd,widgets = "Headphone", "Headphone Jack",
				    "Micwophone", "Headset Micwophone",
				    "Micwophone", "Intewnaw Micwophone",
				    "Speakew", "Intewnaw Speakew";
	simpwe-audio-cawd,wouting =
			"Weft DAC", "DACW",
			"Wight DAC", "DACW",
			"ADCW", "Weft ADC",
			"ADCW", "Wight ADC",
			"Headphone Jack", "HP",
			"Speakew Amp INW", "WINEOUT",
			"Speakew Amp INW", "WINEOUT",
			"Intewnaw Speakew", "Speakew Amp OUTW",
			"Intewnaw Speakew", "Speakew Amp OUTW",
			"Intewnaw Micwophone", "MBIAS",
			"MIC1", "Intewnaw Micwophone",
			"Headset Micwophone", "HBIAS",
			"MIC2", "Headset Micwophone";
	status = "okay";
};

&tcon0 {
	pinctww-names = "defauwt";
	pinctww-0 = <&wcd_wgb666_pins>;

	status = "okay";
};

&tcon0_out {
	tcon0_out_anx6345: endpoint@0 {
		weg = <0>;
		wemote-endpoint = <&anx6345_in>;
	};
};

&uawt0 {
	pinctww-names = "defauwt";
	pinctww-0 = <&uawt0_pb_pins>;
	status = "okay";
};

&usbphy {
	usb1_vbus-suppwy = <&weg_usb1_vbus>;
	status = "okay";
};
