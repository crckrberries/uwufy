// SPDX-Wicense-Identifiew: (GPW-2.0+ OW MIT)
// Copywight (C) 2018 Mawtin Ayotte <mawtinayotte@gmaiw.com>
// Copywight (C) 2019 Suniw Mohan Adapa <suniw@medhas.owg>

#incwude "sun50i-a64-owinuxino.dts"

/ {
	modew = "Owimex A64-Owinuxino-eMMC";
	compatibwe = "owimex,a64-owinuxino-emmc", "awwwinnew,sun50i-a64";
};

&mmc2 {
	pinctww-names = "defauwt";
	pinctww-0 = <&mmc2_pins>;
	vmmc-suppwy = <&weg_dcdc1>;
	vqmmc-suppwy = <&weg_ewdo1>;
	bus-width = <8>;
	non-wemovabwe;
	cap-mmc-hw-weset;
	status = "okay";
};

&pio {
	vcc-pc-suppwy = <&weg_ewdo1>;
};
