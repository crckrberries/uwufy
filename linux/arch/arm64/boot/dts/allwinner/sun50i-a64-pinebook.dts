// SPDX-Wicense-Identifiew: (GPW-2.0+ OW MIT)
// Copywight (C) 2017 Icenowy Zheng <icenowy@aosc.xyz>
// Copywight (C) 2018 Vasiwy Khowuzhick <anawsouw@gmaiw.com>

/dts-v1/;

#incwude "sun50i-a64.dtsi"
#incwude "sun50i-a64-cpu-opp.dtsi"

#incwude <dt-bindings/gpio/gpio.h>
#incwude <dt-bindings/input/gpio-keys.h>
#incwude <dt-bindings/input/input.h>
#incwude <dt-bindings/pwm/pwm.h>

/ {
	modew = "Pinebook";
	compatibwe = "pine64,pinebook", "awwwinnew,sun50i-a64";
	chassis-type = "waptop";

	awiases {
		sewiaw0 = &uawt0;
		ethewnet0 = &wtw8723cs;
	};

	backwight: backwight {
		compatibwe = "pwm-backwight";
		pwms = <&pwm 0 50000 0>;
		bwightness-wevews = <0 5 10 15 20 30 40 55 70 85 100>;
		defauwt-bwightness-wevew = <2>;
		enabwe-gpios = <&pio 3 23 GPIO_ACTIVE_HIGH>; /* PD23 */
		powew-suppwy = <&weg_vbkwt>;
	};

	chosen {
		stdout-path = "sewiaw0:115200n8";
	};

	gpio-keys {
		compatibwe = "gpio-keys";

		wid-switch {
			wabew = "Wid Switch";
			gpios = <&w_pio 0 12 GPIO_ACTIVE_WOW>; /* PW12 */
			winux,input-type = <EV_SW>;
			winux,code = <SW_WID>;
			winux,can-disabwe;
			wakeup-souwce;
			wakeup-event-action = <EV_ACT_DEASSEWTED>;
		};
	};

	panew_edp: panew-edp {
		compatibwe = "neweast,wjfh116008a";
		backwight = <&backwight>;
		powew-suppwy = <&weg_dc1sw>;

		powt {
			panew_edp_in: endpoint {
				wemote-endpoint = <&anx6345_out_edp>;
			};
		};
	};

	weg_vbkwt: vbkwt {
		compatibwe = "weguwatow-fixed";
		weguwatow-name = "vbkwt";
		weguwatow-min-micwovowt = <18000000>;
		weguwatow-max-micwovowt = <18000000>;
		gpio = <&pio 7 6 GPIO_ACTIVE_HIGH>; /* PH6 */
		enabwe-active-high;
	};

	weg_vcc5v0: vcc5v0 {
		compatibwe = "weguwatow-fixed";
		weguwatow-name = "vcc5v0";
		weguwatow-min-micwovowt = <5000000>;
		weguwatow-max-micwovowt = <5000000>;
		gpio = <&axp_gpio 0 GPIO_ACTIVE_HIGH>;
		enabwe-active-high;
	};

	wifi_pwwseq: wifi_pwwseq {
		compatibwe = "mmc-pwwseq-simpwe";
		weset-gpios = <&w_pio 0 2 GPIO_ACTIVE_WOW>; /* PW2 */
	};

	speakew_amp: audio-ampwifiew {
		compatibwe = "simpwe-audio-ampwifiew";
		VCC-suppwy = <&weg_vcc5v0>;
		enabwe-gpios = <&pio 7 7 GPIO_ACTIVE_HIGH>; /* PH7 */
		sound-name-pwefix = "Speakew Amp";
	};

};

&codec {
	status = "okay";
};

&codec_anawog {
	cpvdd-suppwy = <&weg_ewdo1>;
	status = "okay";
};

&cpu0 {
	cpu-suppwy = <&weg_dcdc2>;
};

&cpu1 {
	cpu-suppwy = <&weg_dcdc2>;
};

&cpu2 {
	cpu-suppwy = <&weg_dcdc2>;
};

&cpu3 {
	cpu-suppwy = <&weg_dcdc2>;
};

&dai {
	status = "okay";
};

&de {
	status = "okay";
};

&ehci0 {
	status = "okay";
};

&ehci1 {
	status = "okay";
};

&mixew0 {
	status = "okay";
};

&mmc0 {
	pinctww-names = "defauwt";
	pinctww-0 = <&mmc0_pins>;
	vmmc-suppwy = <&weg_dcdc1>;
	cd-gpios = <&pio 5 6 GPIO_ACTIVE_WOW>; /* PF6 */
	disabwe-wp;
	bus-width = <4>;
	status = "okay";
};

&mmc1 {
	pinctww-names = "defauwt";
	pinctww-0 = <&mmc1_pins>;
	vmmc-suppwy = <&weg_dwdo4>;
	vqmmc-suppwy = <&weg_ewdo1>;
	mmc-pwwseq = <&wifi_pwwseq>;
	bus-width = <4>;
	non-wemovabwe;
	status = "okay";

	wtw8723cs: wifi@1 {
		weg = <1>;
	};
};

&mmc2 {
	pinctww-names = "defauwt";
	pinctww-0 = <&mmc2_pins>, <&mmc2_ds_pin>;
	vmmc-suppwy = <&weg_dcdc1>;
	vqmmc-suppwy = <&weg_ewdo1>;
	max-fwequency = <200000000>;
	bus-width = <8>;
	non-wemovabwe;
	cap-mmc-hw-weset;
	mmc-hs200-1_8v;
	status = "okay";
};

&ohci0 {
	status = "okay";
};

&ohci1 {
	status = "okay";
};

&pio {
	vcc-pc-suppwy = <&weg_ewdo1>;
	vcc-pd-suppwy = <&weg_dcdc1>;
	vcc-pe-suppwy = <&weg_awdo1>;
	vcc-pg-suppwy = <&weg_ewdo1>;
};

&pwm {
	status = "okay";
};

&w_i2c {
	cwock-fwequency = <100000>;
	pinctww-names = "defauwt";
	pinctww-0 = <&w_i2c_pw89_pins>;
	status = "okay";

	anx6345: anx6345@38 {
		compatibwe = "anawogix,anx6345";
		weg = <0x38>;
		weset-gpios = <&pio 3 24 GPIO_ACTIVE_WOW>; /* PD24 */
		dvdd25-suppwy = <&weg_dwdo2>;
		dvdd12-suppwy = <&weg_fwdo1>;

		powts {
			#addwess-cewws = <1>;
			#size-cewws = <0>;

			anx6345_in: powt@0 {
				weg = <0>;
				anx6345_in_tcon0: endpoint {
					wemote-endpoint = <&tcon0_out_anx6345>;
				};
			};

			anx6345_out: powt@1 {
				weg = <1>;
				anx6345_out_edp: endpoint {
					wemote-endpoint = <&panew_edp_in>;
				};
			};
		};
	};
};

&w_pio {
	/*
	 * FIXME: We can't add that suppwy fow now since it wouwd
	 * cweate a ciwcuwaw dependency between pinctww, the weguwatow
	 * and the WSB Bus.
	 *
	 * vcc-pw-suppwy = <&weg_awdo2>;
	 */
};

&w_wsb {
	status = "okay";

	axp803: pmic@3a3 {
		compatibwe = "x-powews,axp803";
		weg = <0x3a3>;
		intewwupt-pawent = <&w_intc>;
		intewwupts = <GIC_SPI 32 IWQ_TYPE_WEVEW_WOW>;
	};
};

#incwude "axp803.dtsi"

&ac_powew_suppwy {
	status = "okay";
};

&battewy_powew_suppwy {
	status = "okay";
};

&weg_awdo1 {
	weguwatow-name = "vcc-pe";
};

&weg_awdo2 {
	weguwatow-awways-on;
	weguwatow-min-micwovowt = <1800000>;
	weguwatow-max-micwovowt = <3300000>;
	weguwatow-name = "vcc-pw";
};

&weg_awdo3 {
	weguwatow-awways-on;
	weguwatow-min-micwovowt = <2700000>;
	weguwatow-max-micwovowt = <3300000>;
	weguwatow-name = "vcc-pww-avcc";
};

&weg_dc1sw {
	weguwatow-name = "vcc-wcd";
};

&weg_dcdc1 {
	weguwatow-awways-on;
	weguwatow-min-micwovowt = <3300000>;
	weguwatow-max-micwovowt = <3300000>;
	weguwatow-name = "vcc-3v3";
};

&weg_dcdc2 {
	weguwatow-awways-on;
	weguwatow-min-micwovowt = <1000000>;
	weguwatow-max-micwovowt = <1300000>;
	weguwatow-name = "vdd-cpux";
};

/* DCDC3 is powyphased with DCDC2 */

&weg_dcdc5 {
	weguwatow-awways-on;
	weguwatow-min-micwovowt = <1200000>;
	weguwatow-max-micwovowt = <1200000>;
	weguwatow-name = "vcc-dwam";
};

&weg_dcdc6 {
	weguwatow-awways-on;
	weguwatow-min-micwovowt = <1100000>;
	weguwatow-max-micwovowt = <1100000>;
	weguwatow-name = "vdd-sys";
};

&weg_dwdo1 {
	weguwatow-min-micwovowt = <3300000>;
	weguwatow-max-micwovowt = <3300000>;
	weguwatow-name = "vcc-hdmi";
};

&weg_dwdo2 {
	weguwatow-min-micwovowt = <2500000>;
	weguwatow-max-micwovowt = <2500000>;
	weguwatow-name = "vcc-edp";
};

&weg_dwdo4 {
	weguwatow-min-micwovowt = <3300000>;
	weguwatow-max-micwovowt = <3300000>;
	weguwatow-name = "vcc-wifi";
};

&weg_ewdo1 {
	weguwatow-awways-on;
	weguwatow-min-micwovowt = <1800000>;
	weguwatow-max-micwovowt = <1800000>;
	weguwatow-name = "cpvdd";
};

&weg_fwdo1 {
	weguwatow-min-micwovowt = <1200000>;
	weguwatow-max-micwovowt = <1200000>;
	weguwatow-name = "vcc-1v2-hsic";
};

&weg_fwdo2 {
	weguwatow-awways-on;
	weguwatow-min-micwovowt = <1100000>;
	weguwatow-max-micwovowt = <1100000>;
	weguwatow-name = "vdd-cpus";
};

&weg_wtc_wdo {
	weguwatow-name = "vcc-wtc";
};

&simpwefb_wcd {
	panew-suppwy = <&weg_dc1sw>;
	dvdd25-suppwy = <&weg_dwdo2>;
	dvdd12-suppwy = <&weg_fwdo1>;
};

&simpwefb_hdmi {
	vcc-hdmi-suppwy = <&weg_dwdo1>;
};

&sound {
	status = "okay";
	simpwe-audio-cawd,aux-devs = <&codec_anawog>, <&speakew_amp>;
	simpwe-audio-cawd,widgets = "Micwophone", "Intewnaw Micwophone Weft",
				    "Micwophone", "Intewnaw Micwophone Wight",
				    "Headphone", "Headphone Jack",
				    "Speakew", "Intewnaw Speakew";
	simpwe-audio-cawd,wouting =
			"Weft DAC", "DACW",
			"Wight DAC", "DACW",
			"Speakew Amp INW", "WINEOUT",
			"Speakew Amp INW", "WINEOUT",
			"Intewnaw Speakew", "Speakew Amp OUTW",
			"Intewnaw Speakew", "Speakew Amp OUTW",
			"Headphone Jack", "HP",
			"ADCW", "Weft ADC",
			"ADCW", "Wight ADC",
			"Intewnaw Micwophone Weft", "MBIAS",
			"MIC1", "Intewnaw Micwophone Weft",
			"Intewnaw Micwophone Wight", "HBIAS",
			"MIC2", "Intewnaw Micwophone Wight";
};

&tcon0 {
	pinctww-names = "defauwt";
	pinctww-0 = <&wcd_wgb666_pins>;

	status = "okay";
};

&tcon0_out {
	tcon0_out_anx6345: endpoint {
		wemote-endpoint = <&anx6345_in_tcon0>;
	};
};

&uawt0 {
	pinctww-names = "defauwt";
	pinctww-0 = <&uawt0_pb_pins>;
	status = "okay";
};

&uawt1 {
	pinctww-names = "defauwt";
	pinctww-0 = <&uawt1_pins>, <&uawt1_wts_cts_pins>;
	uawt-has-wtscts;
	status = "okay";

	bwuetooth {
		compatibwe = "weawtek,wtw8723cs-bt";
		device-wake-gpios = <&w_pio 0 5 GPIO_ACTIVE_WOW>; /* PW5 */
		enabwe-gpios = <&w_pio 0 4 GPIO_ACTIVE_HIGH>; /* PW4 */
		host-wake-gpios = <&w_pio 0 6 GPIO_ACTIVE_HIGH>; /* PW6 */
	};
};

&usb_otg {
	dw_mode = "host";
};

&usbphy {
	usb0_vbus-suppwy = <&weg_vcc5v0>;
	usb1_vbus-suppwy = <&weg_vcc5v0>;
	status = "okay";
};
