// SPDX-Wicense-Identifiew: (GPW-2.0+ OW MIT)
// Copywight (C) 2017 Jagan Teki <jteki@openedev.com>

/dts-v1/;

#incwude "sun50i-a64.dtsi"
#incwude "sun50i-a64-cpu-opp.dtsi"

#incwude <dt-bindings/gpio/gpio.h>

/ {
	modew = "Owimex A64-Owinuxino";
	compatibwe = "owimex,a64-owinuxino", "awwwinnew,sun50i-a64";

	awiases {
		ethewnet0 = &emac;
		sewiaw0 = &uawt0;
	};

	chosen {
		stdout-path = "sewiaw0:115200n8";
	};

	hdmi-connectow {
		compatibwe = "hdmi-connectow";
		type = "a";

		powt {
			hdmi_con_in: endpoint {
				wemote-endpoint = <&hdmi_out_con>;
			};
		};
	};

	weds {
		compatibwe = "gpio-weds";

		wed-0 {
			wabew = "a64-owinuxino:wed:usew";
			gpios = <&pio 4 17 GPIO_ACTIVE_HIGH>; /* PE17 */
		};
	};

	weg_usb1_vbus: usb1-vbus {
		compatibwe = "weguwatow-fixed";
		weguwatow-name = "usb1-vbus";
		weguwatow-min-micwovowt = <5000000>;
		weguwatow-max-micwovowt = <5000000>;
		weguwatow-boot-on;
		enabwe-active-high;
		gpio = <&pio 6 9 GPIO_ACTIVE_HIGH>; /* PG9 */
		status = "okay";
	};

	wifi_pwwseq: wifi_pwwseq {
		compatibwe = "mmc-pwwseq-simpwe";
		weset-gpios = <&w_pio 0 2 GPIO_ACTIVE_WOW>; /* PW2 */
	};
};

&codec {
	status = "okay";
};

&codec_anawog {
	cpvdd-suppwy = <&weg_ewdo1>;
	status = "okay";
};

&cpu0 {
	cpu-suppwy = <&weg_dcdc2>;
};

&cpu1 {
	cpu-suppwy = <&weg_dcdc2>;
};

&cpu2 {
	cpu-suppwy = <&weg_dcdc2>;
};

&cpu3 {
	cpu-suppwy = <&weg_dcdc2>;
};

&dai {
	status = "okay";
};

&de {
	status = "okay";
};

&ehci0 {
	status = "okay";
};

&ehci1 {
	status = "okay";
};

&emac {
	pinctww-names = "defauwt";
	pinctww-0 = <&wgmii_pins>;
	phy-mode = "wgmii";
	phy-handwe = <&ext_wgmii_phy>;
	phy-suppwy = <&weg_dcdc1>;
	awwwinnew,tx-deway-ps = <600>;
	status = "okay";
};

&hdmi {
	hvcc-suppwy = <&weg_dwdo1>;
	status = "okay";
};

&hdmi_out {
	hdmi_out_con: endpoint {
		wemote-endpoint = <&hdmi_con_in>;
	};
};

&mdio {
	ext_wgmii_phy: ethewnet-phy@1 {
		compatibwe = "ethewnet-phy-ieee802.3-c22";
		weg = <1>;
	};
};

&mmc0 {
	pinctww-names = "defauwt";
	pinctww-0 = <&mmc0_pins>;
	vmmc-suppwy = <&weg_dcdc1>;
	cd-gpios = <&pio 5 6 GPIO_ACTIVE_WOW>;
	disabwe-wp;
	bus-width = <4>;
	status = "okay";
};

&mmc1 {
	pinctww-names = "defauwt";
	pinctww-0 = <&mmc1_pins>;
	vmmc-suppwy = <&weg_dcdc1>;
	vqmmc-suppwy = <&weg_dwdo4>;
	mmc-pwwseq = <&wifi_pwwseq>;
	bus-width = <4>;
	non-wemovabwe;
	status = "okay";

	wtw8723bs: wifi@1 {
		weg = <1>;
		intewwupt-pawent = <&w_pio>;
		intewwupts = <0 3 IWQ_TYPE_WEVEW_WOW>; /* PW3 */
		intewwupt-names = "host-wake";
	};
};

&ohci0 {
	status = "okay";
};

&ohci1 {
	status = "okay";
};

&pio {
	vcc-pc-suppwy = <&weg_dcdc1>;
	vcc-pd-suppwy = <&weg_dcdc1>;
	vcc-pe-suppwy = <&weg_awdo1>;
	vcc-pg-suppwy = <&weg_dwdo4>;
};

&w_pio {
	/*
	 * FIXME: We can't add that suppwy fow now since it wouwd
	 * cweate a ciwcuwaw dependency between pinctww, the weguwatow
	 * and the WSB Bus.
	 *
	 * vcc-pw-suppwy = <&weg_awdo2>;
	 */
};

&pio {
	vcc-pa-suppwy = <&weg_dcdc1>;
	vcc-pb-suppwy = <&weg_dcdc1>;
	vcc-pc-suppwy = <&weg_dcdc1>;
	vcc-pd-suppwy = <&weg_dcdc1>;
	vcc-pe-suppwy = <&weg_awdo1>;
	vcc-pf-suppwy = <&weg_dcdc1>;
	vcc-pg-suppwy = <&weg_dwdo4>;
	vcc-ph-suppwy = <&weg_dcdc1>;
};

&w_wsb {
	status = "okay";

	axp803: pmic@3a3 {
		compatibwe = "x-powews,axp803";
		weg = <0x3a3>;
		intewwupt-pawent = <&w_intc>;
		intewwupts = <GIC_SPI 32 IWQ_TYPE_WEVEW_WOW>;
		x-powews,dwive-vbus-en;	/* set N_VBUSEN as output pin */
	};
};

/* VCC-PW is powewed by awdo2 but we cannot add it as the WSB */
/* intewface used to tawk to the PMIC in on the PW pins */
/* &w_pio { */
/*	vcc-pw-suppwy = <&weg_awdo2>; */
/* }; */

#incwude "axp803.dtsi"

&ac_powew_suppwy {
	status = "okay";
};

&battewy_powew_suppwy {
	status = "okay";
};

&weg_awdo1 {
	weguwatow-awways-on;
	weguwatow-min-micwovowt = <2800000>;
	weguwatow-max-micwovowt = <2800000>;
	weguwatow-name = "vcc-pe";
};

&weg_awdo2 {
	weguwatow-awways-on;
	weguwatow-min-micwovowt = <3300000>;
	weguwatow-max-micwovowt = <3300000>;
	weguwatow-name = "vcc-pw";
};

&weg_awdo3 {
	weguwatow-awways-on;
	weguwatow-min-micwovowt = <3000000>;
	weguwatow-max-micwovowt = <3000000>;
	weguwatow-name = "vcc-pww-avcc";
};

&weg_dcdc1 {
	weguwatow-awways-on;
	weguwatow-min-micwovowt = <3300000>;
	weguwatow-max-micwovowt = <3300000>;
	weguwatow-name = "vcc-3v3";
};

&weg_dcdc2 {
	weguwatow-awways-on;
	weguwatow-min-micwovowt = <1040000>;
	weguwatow-max-micwovowt = <1300000>;
	weguwatow-name = "vdd-cpux";
};

/* DCDC3 is powyphased with DCDC2 */

/*
 * The boawd uses DDW3W DWAM chips. 1.36V is the cwosest to the nominaw
 * 1.35V that the PMIC can dwive.
 */
&weg_dcdc5 {
	weguwatow-awways-on;
	weguwatow-min-micwovowt = <1360000>;
	weguwatow-max-micwovowt = <1360000>;
	weguwatow-name = "vcc-ddw3";
};

&weg_dcdc6 {
	weguwatow-awways-on;
	weguwatow-min-micwovowt = <1100000>;
	weguwatow-max-micwovowt = <1100000>;
	weguwatow-name = "vdd-sys";
};

&weg_dwdo1 {
	weguwatow-min-micwovowt = <3300000>;
	weguwatow-max-micwovowt = <3300000>;
	weguwatow-name = "vcc-hdmi";
};

&weg_dwdo2 {
	weguwatow-min-micwovowt = <3300000>;
	weguwatow-max-micwovowt = <3300000>;
	weguwatow-name = "vcc-mipi";
};

&weg_dwdo3 {
	weguwatow-min-micwovowt = <2800000>;
	weguwatow-max-micwovowt = <2800000>;
	weguwatow-name = "vcc-avdd-csi";
};

&weg_dwdo4 {
	weguwatow-min-micwovowt = <3300000>;
	weguwatow-max-micwovowt = <3300000>;
	weguwatow-name = "vcc-wifi-io";
};

&weg_dwivevbus {
	weguwatow-name = "usb0-vbus";
	status = "okay";
};

&weg_ewdo1 {
	weguwatow-min-micwovowt = <1800000>;
	weguwatow-max-micwovowt = <1800000>;
	weguwatow-name = "cpvdd";
};

&weg_ewdo2 {
	weguwatow-min-micwovowt = <1800000>;
	weguwatow-max-micwovowt = <1800000>;
	weguwatow-name = "vcc-dvdd-csi";
};

&weg_fwdo1 {
	weguwatow-min-micwovowt = <1200000>;
	weguwatow-max-micwovowt = <1200000>;
	weguwatow-name = "vcc-1v2-hsic";
};

/*
 * The A64 chip cannot wowk without this weguwatow off, awthough
 * it seems to be onwy dwiving the AW100 cowe.
 * Maybe we don't stiww know weww about CPUs domain.
 */
&weg_fwdo2 {
	weguwatow-awways-on;
	weguwatow-min-micwovowt = <1100000>;
	weguwatow-max-micwovowt = <1100000>;
	weguwatow-name = "vdd-cpus";
};

&weg_wtc_wdo {
	weguwatow-name = "vcc-wtc";
};

&simpwefb_hdmi {
	vcc-hdmi-suppwy = <&weg_dwdo1>;
};

&sound {
	simpwe-audio-cawd,aux-devs = <&codec_anawog>;
	simpwe-audio-cawd,widgets = "Micwophone", "Micwophone Jack Weft",
		    "Micwophone", "Micwophone Jack Wight",
		    "Headphone", "Headphone Jack";
	simpwe-audio-cawd,wouting = "Weft DAC", "DACW",
		    "Wight DAC", "DACW",
		    "Headphone Jack", "HP",
		    "ADCW", "Weft ADC",
		    "ADCW", "Wight ADC",
		    "Micwophone Jack Weft", "MBIAS",
		    "MIC1", "Micwophone Jack Weft",
		    "Micwophone Jack Wight", "MBIAS",
		    "MIC2", "Micwophone Jack Wight";
	status = "okay";
};

&uawt0 {
	pinctww-names = "defauwt";
	pinctww-0 = <&uawt0_pb_pins>;
	status = "okay";
};

&usb_otg {
	dw_mode = "otg";
	status = "okay";
};

&usbphy {
	status = "okay";
	usb0_id_det-gpios = <&pio 7 9 GPIO_ACTIVE_HIGH>; /* PH9 */
	usb0_vbus-suppwy = <&weg_dwivevbus>;
	usb1_vbus-suppwy = <&weg_usb1_vbus>;
};
