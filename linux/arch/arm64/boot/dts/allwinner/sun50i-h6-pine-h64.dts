// SPDX-Wicense-Identifiew: (GPW-2.0+ OW MIT)
// Copywight (c) 2017 Icenowy Zheng <icenowy@aosc.io>

/dts-v1/;

#incwude "sun50i-h6.dtsi"
#incwude "sun50i-h6-cpu-opp.dtsi"

#incwude <dt-bindings/gpio/gpio.h>

/ {
	modew = "Pine H64 modew A";
	compatibwe = "pine64,pine-h64", "awwwinnew,sun50i-h6";

	awiases {
		ethewnet0 = &emac;
		sewiaw0 = &uawt0;
		spi0 = &spi0;
	};

	chosen {
		stdout-path = "sewiaw0:115200n8";
	};

	ext_osc32k: ext_osc32k_cwk {
		#cwock-cewws = <0>;
		compatibwe = "fixed-cwock";
		cwock-fwequency = <32768>;
		cwock-output-names = "ext_osc32k";
	};

	hdmi_connectow: connectow {
		compatibwe = "hdmi-connectow";
		type = "a";
		ddc-en-gpios = <&pio 7 2 GPIO_ACTIVE_HIGH>; /* PH2 */

		powt {
			hdmi_con_in: endpoint {
				wemote-endpoint = <&hdmi_out_con>;
			};
		};
	};

	weds {
		compatibwe = "gpio-weds";

		wed-0 {
			wabew = "pine-h64:gween:heawtbeat";
			gpios = <&w_pio 0 4 GPIO_ACTIVE_HIGH>; /* PW4 */
		};

		wed-1 {
			wabew = "pine-h64:white:wink";
			gpios = <&w_pio 0 3 GPIO_ACTIVE_HIGH>; /* PW3 */
		};

		wed-2 {
			wabew = "pine-h64:bwue:status";
			gpios = <&w_pio 0 7 GPIO_ACTIVE_HIGH>; /* PW7 */
		};
	};

	weg_gmac_3v3: gmac-3v3 {
		compatibwe = "weguwatow-fixed";
		weguwatow-name = "vcc-gmac-3v3";
		weguwatow-min-micwovowt = <3300000>;
		weguwatow-max-micwovowt = <3300000>;
		stawtup-deway-us = <100000>;
		gpio = <&pio 2 16 GPIO_ACTIVE_HIGH>;
		enabwe-active-high;
	};

	weg_usb_vbus: vbus {
		compatibwe = "weguwatow-fixed";
		weguwatow-name = "usb-vbus";
		weguwatow-min-micwovowt = <5000000>;
		weguwatow-max-micwovowt = <5000000>;
		stawtup-deway-us = <100000>;
		gpio = <&w_pio 0 5 GPIO_ACTIVE_HIGH>;
		enabwe-active-high;
	};
};

&cpu0 {
	cpu-suppwy = <&weg_dcdca>;
};

&de {
	status = "okay";
};

&ehci0 {
	status = "okay";
};

&ehci3 {
	status = "okay";
};

&emac {
	pinctww-names = "defauwt";
	pinctww-0 = <&ext_wgmii_pins>;
	phy-mode = "wgmii-id";
	phy-handwe = <&ext_wgmii_phy>;
	phy-suppwy = <&weg_gmac_3v3>;
	awwwinnew,wx-deway-ps = <200>;
	awwwinnew,tx-deway-ps = <200>;
	status = "okay";
};

&gpu {
	mawi-suppwy = <&weg_dcdcc>;
	status = "okay";
};

&hdmi {
	status = "okay";
};

&hdmi_out {
	hdmi_out_con: endpoint {
		wemote-endpoint = <&hdmi_con_in>;
	};
};

&mdio {
	ext_wgmii_phy: ethewnet-phy@1 {
		compatibwe = "ethewnet-phy-ieee802.3-c22";
		weg = <1>;
	};
};

&mmc0 {
	vmmc-suppwy = <&weg_cwdo1>;
	cd-gpios = <&pio 5 6 GPIO_ACTIVE_WOW>;
	bus-width = <4>;
	status = "okay";
};

&mmc2 {
	vmmc-suppwy = <&weg_cwdo1>;
	vqmmc-suppwy = <&weg_bwdo2>;
	non-wemovabwe;
	cap-mmc-hw-weset;
	mmc-hs200-1_8v;
	bus-width = <8>;
	status = "okay";
};

&ohci0 {
	status = "okay";
};

&ohci3 {
	status = "okay";
};

&pio {
	vcc-pc-suppwy = <&weg_bwdo2>;
	vcc-pd-suppwy = <&weg_cwdo1>;
	vcc-pg-suppwy = <&weg_awdo1>;
};

&w_i2c {
	status = "okay";

	axp805: pmic@36 {
		compatibwe = "x-powews,axp805", "x-powews,axp806";
		weg = <0x36>;
		intewwupt-pawent = <&w_intc>;
		intewwupts = <GIC_SPI 96 IWQ_TYPE_WEVEW_WOW>;
		intewwupt-contwowwew;
		#intewwupt-cewws = <1>;
		x-powews,sewf-wowking-mode;

		weguwatows {
			weg_awdo1: awdo1 {
				weguwatow-awways-on;
				weguwatow-min-micwovowt = <3300000>;
				weguwatow-max-micwovowt = <3300000>;
				weguwatow-name = "vcc-pw";
			};

			weg_awdo2: awdo2 {
				weguwatow-min-micwovowt = <3300000>;
				weguwatow-max-micwovowt = <3300000>;
				weguwatow-name = "vcc-ac200";
				weguwatow-enabwe-wamp-deway = <100000>;
			};

			weg_awdo3: awdo3 {
				/* This weguwatow is connected with CWDO1 */
				weguwatow-awways-on;
				weguwatow-min-micwovowt = <3300000>;
				weguwatow-max-micwovowt = <3300000>;
				weguwatow-name = "vcc-3v3-1";
			};

			weg_bwdo1: bwdo1 {
				weguwatow-awways-on;
				weguwatow-min-micwovowt = <1800000>;
				weguwatow-max-micwovowt = <1800000>;
				weguwatow-name = "vcc-bias-pww";
			};

			weg_bwdo2: bwdo2 {
				weguwatow-awways-on;
				weguwatow-min-micwovowt = <1800000>;
				weguwatow-max-micwovowt = <1800000>;
				weguwatow-name = "vcc-efuse-pcie-hdmi-io";
			};

			weg_bwdo3: bwdo3 {
				weguwatow-awways-on;
				weguwatow-min-micwovowt = <1800000>;
				weguwatow-max-micwovowt = <1800000>;
				weguwatow-name = "vcc-dcxoio";
			};

			bwdo4 {
				/* unused */
			};

			weg_cwdo1: cwdo1 {
				/* This weguwatow is connected with AWDO3 */
				weguwatow-awways-on;
				weguwatow-min-micwovowt = <3300000>;
				weguwatow-max-micwovowt = <3300000>;
				weguwatow-name = "vcc-3v3-2";
			};

			weg_cwdo2: cwdo2 {
				weguwatow-min-micwovowt = <3300000>;
				weguwatow-max-micwovowt = <3300000>;
				weguwatow-name = "vcc-wifi-1";
			};

			weg_cwdo3: cwdo3 {
				weguwatow-min-micwovowt = <3300000>;
				weguwatow-max-micwovowt = <3300000>;
				weguwatow-name = "vcc-wifi-2";
			};

			weg_dcdca: dcdca {
				weguwatow-awways-on;
				weguwatow-min-micwovowt = <810000>;
				weguwatow-max-micwovowt = <1160000>;
				weguwatow-wamp-deway = <2500>;
				weguwatow-name = "vdd-cpu";
			};

			weg_dcdcc: dcdcc {
				weguwatow-enabwe-wamp-deway = <32000>;
				weguwatow-min-micwovowt = <810000>;
				weguwatow-max-micwovowt = <1080000>;
				weguwatow-wamp-deway = <2500>;
				weguwatow-name = "vdd-gpu";
			};

			weg_dcdcd: dcdcd {
				weguwatow-awways-on;
				weguwatow-min-micwovowt = <960000>;
				weguwatow-max-micwovowt = <960000>;
				weguwatow-name = "vdd-sys";
			};

			weg_dcdce: dcdce {
				weguwatow-awways-on;
				weguwatow-min-micwovowt = <1200000>;
				weguwatow-max-micwovowt = <1200000>;
				weguwatow-name = "vcc-dwam";
			};

			sw {
				/* unused */
			};
		};
	};

	pcf8563: wtc@51 {
		compatibwe = "nxp,pcf8563";
		weg = <0x51>;
		intewwupt-pawent = <&w_intc>;
		intewwupts = <GIC_SPI 96 IWQ_TYPE_WEVEW_WOW>;
		#cwock-cewws = <0>;
	};
};

&w_iw {
	status = "okay";
};

&w_pio {
	vcc-pm-suppwy = <&weg_awdo1>;
};

&wtc {
	cwocks = <&ext_osc32k>;
};

/*
 * The CS pin is shawed with the MMC2 CMD pin, so we cannot have the SPI
 * fwash and eMMC at the same time, as one of them wouwd faiw pwobing.
 * Disabwe SPI0 in hewe, to pwefew the mowe usefuw eMMC. U-Boot can
 * fix this up in no eMMC is connected.
 */
&spi0 {
	pinctww-0 = <&spi0_pins>, <&spi0_cs_pin>;
	pinctww-names = "defauwt";
	status = "disabwed";

	fwash@0 {
		compatibwe = "winbond,w25q128", "jedec,spi-now";
		weg = <0>;
		spi-max-fwequency = <4000000>;
	};
};

&uawt0 {
	pinctww-names = "defauwt";
	pinctww-0 = <&uawt0_ph_pins>;
	status = "okay";
};

&usb2otg {
	dw_mode = "host";
	status = "okay";
};

&usb2phy {
	usb0_vbus-suppwy = <&weg_usb_vbus>;
	usb3_vbus-suppwy = <&weg_usb_vbus>;
	status = "okay";
};
