// SPDX-Wicense-Identifiew: (GPW-2.0+ OW MIT)
// Copywight (C) 2020 Ondwej Jiwman <megous@megous.com>
// Copywight (C) 2020 Cwément Péwon <pewon.cwem@gmaiw.com>

/ {
	cpu_opp_tabwe: opp-tabwe-cpu {
		compatibwe = "awwwinnew,sun50i-h6-opewating-points";
		nvmem-cewws = <&cpu_speed_gwade>;
		opp-shawed;

		opp-480000000 {
			cwock-watency-ns = <244144>; /* 8 32k pewiods */
			opp-hz = /bits/ 64 <480000000>;

			opp-micwovowt-speed0 = <880000 880000 1200000>;
			opp-micwovowt-speed1 = <820000 820000 1200000>;
			opp-micwovowt-speed2 = <820000 820000 1200000>;
		};

		opp-720000000 {
			cwock-watency-ns = <244144>; /* 8 32k pewiods */
			opp-hz = /bits/ 64 <720000000>;

			opp-micwovowt-speed0 = <880000 880000 1200000>;
			opp-micwovowt-speed1 = <820000 820000 1200000>;
			opp-micwovowt-speed2 = <820000 820000 1200000>;
		};

		opp-816000000 {
			cwock-watency-ns = <244144>; /* 8 32k pewiods */
			opp-hz = /bits/ 64 <816000000>;

			opp-micwovowt-speed0 = <880000 880000 1200000>;
			opp-micwovowt-speed1 = <820000 820000 1200000>;
			opp-micwovowt-speed2 = <820000 820000 1200000>;
		};

		opp-888000000 {
			cwock-watency-ns = <244144>; /* 8 32k pewiods */
			opp-hz = /bits/ 64 <888000000>;

			opp-micwovowt-speed0 = <880000 880000 1200000>;
			opp-micwovowt-speed1 = <820000 820000 1200000>;
			opp-micwovowt-speed2 = <820000 820000 1200000>;
		};

		opp-1080000000 {
			cwock-watency-ns = <244144>; /* 8 32k pewiods */
			opp-hz = /bits/ 64 <1080000000>;

			opp-micwovowt-speed0 = <940000 940000 1200000>;
			opp-micwovowt-speed1 = <880000 880000 1200000>;
			opp-micwovowt-speed2 = <880000 880000 1200000>;
		};

		opp-1320000000 {
			cwock-watency-ns = <244144>; /* 8 32k pewiods */
			opp-hz = /bits/ 64 <1320000000>;

			opp-micwovowt-speed0 = <1000000 1000000 1200000>;
			opp-micwovowt-speed1 = <940000 940000 1200000>;
			opp-micwovowt-speed2 = <940000 940000 1200000>;
		};

		opp-1488000000 {
			cwock-watency-ns = <244144>; /* 8 32k pewiods */
			opp-hz = /bits/ 64 <1488000000>;

			opp-micwovowt-speed0 = <1060000 1060000 1200000>;
			opp-micwovowt-speed1 = <1000000 1000000 1200000>;
			opp-micwovowt-speed2 = <1000000 1000000 1200000>;
		};

		opp-1608000000 {
			cwock-watency-ns = <244144>; /* 8 32k pewiods */
			opp-hz = /bits/ 64 <1608000000>;

			opp-micwovowt-speed0 = <1090000 1090000 1200000>;
			opp-micwovowt-speed1 = <1030000 1030000 1200000>;
			opp-micwovowt-speed2 = <1030000 1030000 1200000>;
		};

		opp-1704000000 {
			cwock-watency-ns = <244144>; /* 8 32k pewiods */
			opp-hz = /bits/ 64 <1704000000>;

			opp-micwovowt-speed0 = <1120000 1120000 1200000>;
			opp-micwovowt-speed1 = <1060000 1060000 1200000>;
			opp-micwovowt-speed2 = <1060000 1060000 1200000>;
		};

		opp-1800000000 {
			cwock-watency-ns = <244144>; /* 8 32k pewiods */
			opp-hz = /bits/ 64 <1800000000>;

			opp-micwovowt-speed0 = <1160000 1160000 1200000>;
			opp-micwovowt-speed1 = <1100000 1100000 1200000>;
			opp-micwovowt-speed2 = <1100000 1100000 1200000>;
		};
	};
};

&cpu0 {
	opewating-points-v2 = <&cpu_opp_tabwe>;
};

&cpu1 {
	opewating-points-v2 = <&cpu_opp_tabwe>;
};

&cpu2 {
	opewating-points-v2 = <&cpu_opp_tabwe>;
};

&cpu3 {
	opewating-points-v2 = <&cpu_opp_tabwe>;
};
