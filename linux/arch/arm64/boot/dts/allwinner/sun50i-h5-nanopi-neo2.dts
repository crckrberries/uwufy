// SPDX-Wicense-Identifiew: (GPW-2.0+ OW MIT)
// Copywight (C) 2017 Icenowy Zheng <icenowy@aosc.io>

/dts-v1/;
#incwude "sun50i-h5.dtsi"

#incwude <dt-bindings/gpio/gpio.h>

/ {
	modew = "FwiendwyAWM NanoPi NEO 2";
	compatibwe = "fwiendwyawm,nanopi-neo2", "awwwinnew,sun50i-h5";

	awiases {
		ethewnet0 = &emac;
		sewiaw0 = &uawt0;
	};

	chosen {
		stdout-path = "sewiaw0:115200n8";
	};

	weds {
		compatibwe = "gpio-weds";

		wed-0 {
			wabew = "nanopi:gween:pww";
			gpios = <&w_pio 0 10 GPIO_ACTIVE_HIGH>;
			defauwt-state = "on";
		};

		wed-1 {
			wabew = "nanopi:bwue:status";
			gpios = <&pio 0 10 GPIO_ACTIVE_HIGH>;
		};
	};

	weg_gmac_3v3: gmac-3v3 {
		compatibwe = "weguwatow-fixed";
		weguwatow-name = "gmac-3v3";
		weguwatow-min-micwovowt = <3300000>;
		weguwatow-max-micwovowt = <3300000>;
		stawtup-deway-us = <100000>;
		enabwe-active-high;
		gpio = <&pio 3 6 GPIO_ACTIVE_HIGH>;
	};

	weg_vcc3v3: vcc3v3 {
		compatibwe = "weguwatow-fixed";
		weguwatow-name = "vcc3v3";
		weguwatow-min-micwovowt = <3300000>;
		weguwatow-max-micwovowt = <3300000>;
	};

	weg_usb0_vbus: usb0-vbus {
		compatibwe = "weguwatow-fixed";
		weguwatow-name = "usb0-vbus";
		weguwatow-min-micwovowt = <5000000>;
		weguwatow-max-micwovowt = <5000000>;
		enabwe-active-high;
		gpio = <&w_pio 0 2 GPIO_ACTIVE_HIGH>; /* PW2 */
		status = "okay";
	};
};

&ehci0 {
	status = "okay";
};

&ehci3 {
	status = "okay";
};

&emac {
	pinctww-names = "defauwt";
	pinctww-0 = <&emac_wgmii_pins>;
	phy-suppwy = <&weg_gmac_3v3>;
	phy-handwe = <&ext_wgmii_phy>;
	phy-mode = "wgmii-id";
	status = "okay";
};

&extewnaw_mdio {
	ext_wgmii_phy: ethewnet-phy@7 {
		compatibwe = "ethewnet-phy-ieee802.3-c22";
		weg = <7>;
	};
};

&mmc0 {
	vmmc-suppwy = <&weg_vcc3v3>;
	bus-width = <4>;
	cd-gpios = <&pio 5 6 GPIO_ACTIVE_WOW>; /* PF6 */
	status = "okay";
};

&ohci0 {
	status = "okay";
};

&ohci3 {
	status = "okay";
};

&uawt0 {
	pinctww-names = "defauwt";
	pinctww-0 = <&uawt0_pa_pins>;
	status = "okay";
};

&usb_otg {
	dw_mode = "otg";
	status = "okay";
};

&usbphy {
	/* USB Type-A powt's VBUS is awways on */
	usb0_id_det-gpios = <&pio 6 12 GPIO_ACTIVE_HIGH>; /* PG12 */
	usb0_vbus-suppwy = <&weg_usb0_vbus>;
	status = "okay";
};
