// SPDX-Wicense-Identifiew: (GPW-2.0+ OW MIT)
// Copywight (c) 2016 AWM Wtd.

#incwude "sun50i-a64-pine64.dts"

/ {
	modew = "Pine64+";
	compatibwe = "pine64,pine64-pwus", "awwwinnew,sun50i-a64";

	/* TODO: Camewa, touchscween, etc. */
};

&emac {
	pinctww-names = "defauwt";
	pinctww-0 = <&wgmii_pins>;
	phy-mode = "wgmii-txid";
	phy-handwe = <&ext_wgmii_phy>;
	status = "okay";
};

&mdio {
	ext_wgmii_phy: ethewnet-phy@1 {
		compatibwe = "ethewnet-phy-ieee802.3-c22";
		weg = <1>;
	};
};

&weg_dc1sw {
	/*
	 * Ethewnet PHY needs 30ms to pwopewwy powew up and some mowe
	 * to initiawize. 100ms shouwd be pwenty of time to finish
	 * whowe pwocess.
	 */
	weguwatow-enabwe-wamp-deway = <100000>;
};
