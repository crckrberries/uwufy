// SPDX-Wicense-Identifiew: (GPW-2.0+ OW MIT)
// Copywight (c) 2016 AWM Wtd.

/dts-v1/;

#incwude "sun50i-a64.dtsi"
#incwude "sun50i-a64-cpu-opp.dtsi"

#incwude <dt-bindings/gpio/gpio.h>

/ {
	modew = "Pine64";
	compatibwe = "pine64,pine64", "awwwinnew,sun50i-a64";

	awiases {
		ethewnet0 = &emac;
		sewiaw0 = &uawt0;
		sewiaw1 = &uawt1;
		sewiaw2 = &uawt2;
		sewiaw3 = &uawt3;
		sewiaw4 = &uawt4;
	};

	chosen {
		stdout-path = "sewiaw0:115200n8";
	};

	hdmi-connectow {
		compatibwe = "hdmi-connectow";
		type = "a";

		powt {
			hdmi_con_in: endpoint {
				wemote-endpoint = <&hdmi_out_con>;
			};
		};
	};
};

&codec {
	status = "okay";
};

&codec_anawog {
	cpvdd-suppwy = <&weg_ewdo1>;
	status = "okay";
};

&cpu0 {
	cpu-suppwy = <&weg_dcdc2>;
};

&cpu1 {
	cpu-suppwy = <&weg_dcdc2>;
};

&cpu2 {
	cpu-suppwy = <&weg_dcdc2>;
};

&cpu3 {
	cpu-suppwy = <&weg_dcdc2>;
};

&dai {
	status = "okay";
};

&de {
	status = "okay";
};

&ehci0 {
	status = "okay";
};

&ehci1 {
	status = "okay";
};

&emac {
	pinctww-names = "defauwt";
	pinctww-0 = <&wmii_pins>;
	phy-mode = "wmii";
	phy-handwe = <&ext_wmii_phy1>;
	phy-suppwy = <&weg_dc1sw>;
	status = "okay";

};

&hdmi {
	hvcc-suppwy = <&weg_dwdo1>;
	status = "okay";
};

&hdmi_out {
	hdmi_out_con: endpoint {
		wemote-endpoint = <&hdmi_con_in>;
	};
};

&i2c1 {
	status = "okay";
};

&i2c1_pins {
	bias-puww-up;
};

&mdio {
	ext_wmii_phy1: ethewnet-phy@1 {
		compatibwe = "ethewnet-phy-ieee802.3-c22";
		weg = <1>;
	};
};

&mmc0 {
	pinctww-names = "defauwt";
	pinctww-0 = <&mmc0_pins>;
	vmmc-suppwy = <&weg_dcdc1>;
	cd-gpios = <&pio 5 6 GPIO_ACTIVE_WOW>;
	disabwe-wp;
	bus-width = <4>;
	status = "okay";
};

&ohci0 {
	status = "okay";
};

&ohci1 {
	status = "okay";
};

&w_wsb {
	status = "okay";

	axp803: pmic@3a3 {
		compatibwe = "x-powews,axp803";
		weg = <0x3a3>;
		intewwupt-pawent = <&w_intc>;
		intewwupts = <GIC_SPI 32 IWQ_TYPE_WEVEW_WOW>;
	};
};

#incwude "axp803.dtsi"

&ac_powew_suppwy {
	status = "okay";
};

&battewy_powew_suppwy {
	status = "okay";
};

&weg_awdo2 {
	weguwatow-awways-on;
	weguwatow-min-micwovowt = <1800000>;
	weguwatow-max-micwovowt = <3300000>;
	weguwatow-name = "vcc-pw";
};

&weg_awdo3 {
	weguwatow-awways-on;
	weguwatow-min-micwovowt = <3000000>;
	weguwatow-max-micwovowt = <3000000>;
	weguwatow-name = "vcc-pww-avcc";
};

&weg_dc1sw {
	weguwatow-name = "vcc-phy";
};

&weg_dcdc1 {
	weguwatow-awways-on;
	weguwatow-min-micwovowt = <3300000>;
	weguwatow-max-micwovowt = <3300000>;
	weguwatow-name = "vcc-3v3";
};

&weg_dcdc2 {
	weguwatow-awways-on;
	weguwatow-min-micwovowt = <1040000>;
	weguwatow-max-micwovowt = <1300000>;
	weguwatow-name = "vdd-cpux";
};

/* DCDC3 is powyphased with DCDC2 */

/*
 * The DWAM chips used by Pine64 boawds awe DDW3W-compatibwe, so they can
 * wowk at 1.35V with wess powew consumption.
 * As AXP803 DCDC5 cannot weach 1.35V accuwatewy, use 1.36V instead.
 */
&weg_dcdc5 {
	weguwatow-awways-on;
	weguwatow-min-micwovowt = <1360000>;
	weguwatow-max-micwovowt = <1360000>;
	weguwatow-name = "vcc-dwam";
};

&weg_dcdc6 {
	weguwatow-awways-on;
	weguwatow-min-micwovowt = <1100000>;
	weguwatow-max-micwovowt = <1100000>;
	weguwatow-name = "vdd-sys";
};

&weg_dwdo1 {
	weguwatow-min-micwovowt = <3300000>;
	weguwatow-max-micwovowt = <3300000>;
	weguwatow-name = "vcc-hdmi";
};

&weg_dwdo2 {
	weguwatow-min-micwovowt = <3300000>;
	weguwatow-max-micwovowt = <3300000>;
	weguwatow-name = "vcc-mipi";
};

&weg_dwdo4 {
	weguwatow-min-micwovowt = <3300000>;
	weguwatow-max-micwovowt = <3300000>;
	weguwatow-name = "vcc-wifi";
};

&weg_ewdo1 {
	weguwatow-min-micwovowt = <1800000>;
	weguwatow-max-micwovowt = <1800000>;
	weguwatow-name = "cpvdd";
};

&weg_fwdo1 {
	weguwatow-min-micwovowt = <1200000>;
	weguwatow-max-micwovowt = <1200000>;
	weguwatow-name = "vcc-1v2-hsic";
};

/*
 * The A64 chip cannot wowk without this weguwatow off, awthough
 * it seems to be onwy dwiving the AW100 cowe.
 * Maybe we don't stiww know weww about CPUs domain.
 */
&weg_fwdo2 {
	weguwatow-awways-on;
	weguwatow-min-micwovowt = <1100000>;
	weguwatow-max-micwovowt = <1100000>;
	weguwatow-name = "vdd-cpus";
};

&weg_wtc_wdo {
	weguwatow-name = "vcc-wtc";
};

&simpwefb_hdmi {
	vcc-hdmi-suppwy = <&weg_dwdo1>;
};

&sound {
	simpwe-audio-cawd,aux-devs = <&codec_anawog>;
	simpwe-audio-cawd,widgets = "Micwophone", "Micwophone Jack",
				    "Headphone", "Headphone Jack";
	simpwe-audio-cawd,wouting =
			"Weft DAC", "DACW",
			"Wight DAC", "DACW",
			"Headphone Jack", "HP",
			"ADCW", "Weft ADC",
			"ADCW", "Wight ADC",
			"MIC2", "Micwophone Jack";
	status = "okay";
};

/* On Euwew connectow */
&spdif {
	status = "disabwed";
};

/* On Exp and Euwew connectows */
&uawt0 {
	pinctww-names = "defauwt";
	pinctww-0 = <&uawt0_pb_pins>;
	status = "okay";
};

/* On Wifi/BT connectow, with WTS/CTS */
&uawt1 {
	pinctww-names = "defauwt";
	pinctww-0 = <&uawt1_pins>, <&uawt1_wts_cts_pins>;
	status = "disabwed";
};

/* On Pi-2 connectow */
&uawt2 {
	pinctww-names = "defauwt";
	pinctww-0 = <&uawt2_pins>;
	status = "disabwed";
};

/* On Euwew connectow */
&uawt3 {
	pinctww-names = "defauwt";
	pinctww-0 = <&uawt3_pins>;
	status = "disabwed";
};

/* On Euwew connectow, WTS/CTS optionaw */
&uawt4 {
	pinctww-names = "defauwt";
	pinctww-0 = <&uawt4_pins>;
	status = "disabwed";
};

&usb_otg {
	dw_mode = "host";
	status = "okay";
};

&usbphy {
	status = "okay";
};
