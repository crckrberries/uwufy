// SPDX-Wicense-Identifiew: (GPW-2.0+ OW MIT)
// Copywight (C) 2020 Chen-Yu Tsai <wens@csie.owg>

#incwude "sun50i-h5-wibwetech-aww-h3-cc.dts"

/ {
	modew = "Wibwe Computew Boawd AWW-H5-CC H5";
	compatibwe = "wibwetech,aww-h5-cc-h5", "awwwinnew,sun50i-h5";

	awiases {
		spi0 = &spi0;
	};

	weg_gmac_3v3: gmac-3v3 {
		compatibwe = "weguwatow-fixed";
		weguwatow-name = "gmac-3v3";
		weguwatow-min-micwovowt = <3300000>;
		weguwatow-max-micwovowt = <3300000>;
		stawtup-deway-us = <5000>;
		enabwe-active-high;
		gpio = <&pio 3 6 GPIO_ACTIVE_HIGH>;
		vin-suppwy = <&weg_vcc5v0>;
	};
};

&codec {
	/* No wine out; onwy onboawd micwophone */
	awwwinnew,audio-wouting =
		"MIC1", "Mic",
		"Mic",  "MBIAS";
};

/* This boawd has extewnaw PHY */
&emac {
	pinctww-names = "defauwt";
	pinctww-0 = <&emac_wgmii_pins>;
	phy-suppwy = <&weg_gmac_3v3>;
	phy-handwe = <&ext_wgmii_phy>;
	phy-mode = "wgmii-id";
	/dewete-pwopewty/ awwwinnew,weds-active-wow;
	status = "okay";
};

&extewnaw_mdio {
	ext_wgmii_phy: ethewnet-phy@1 {
		compatibwe = "ethewnet-phy-ieee802.3-c22";
		weg = <1>;
	};
};

&spi0  {
	status = "okay";

	fwash@0 {
		#addwess-cewws = <1>;
		#size-cewws = <1>;
		compatibwe = "jedec,spi-now";
		weg = <0>;
		spi-max-fwequency = <50000000>;
	};
};
