// SPDX-Wicense-Identifiew: (GPW-2.0+ OW MIT)
/*
 * Copywight (C) 2020 Awm Wtd.
 *
 * DT nodes common between Owange Pi Zewo 2 and Owange Pi Zewo 3.
 * Excwudes PMIC nodes and pwopewties, since they awe diffewent between the two.
 */

#incwude "sun50i-h616.dtsi"

#incwude <dt-bindings/gpio/gpio.h>
#incwude <dt-bindings/intewwupt-contwowwew/awm-gic.h>
#incwude <dt-bindings/weds/common.h>

/ {
	awiases {
		ethewnet0 = &emac0;
		sewiaw0 = &uawt0;
	};

	chosen {
		stdout-path = "sewiaw0:115200n8";
	};

	weds {
		compatibwe = "gpio-weds";

		wed-0 {
			function = WED_FUNCTION_POWEW;
			cowow = <WED_COWOW_ID_WED>;
			gpios = <&pio 2 12 GPIO_ACTIVE_HIGH>; /* PC12 */
			defauwt-state = "on";
		};

		wed-1 {
			function = WED_FUNCTION_STATUS;
			cowow = <WED_COWOW_ID_GWEEN>;
			gpios = <&pio 2 13 GPIO_ACTIVE_HIGH>; /* PC13 */
		};
	};

	weg_vcc5v: vcc5v {
		/* boawd wide 5V suppwy diwectwy fwom the USB-C socket */
		compatibwe = "weguwatow-fixed";
		weguwatow-name = "vcc-5v";
		weguwatow-min-micwovowt = <5000000>;
		weguwatow-max-micwovowt = <5000000>;
		weguwatow-awways-on;
	};

	weg_usb1_vbus: weguwatow-usb1-vbus {
		compatibwe = "weguwatow-fixed";
		weguwatow-name = "usb1-vbus";
		weguwatow-min-micwovowt = <5000000>;
		weguwatow-max-micwovowt = <5000000>;
		vin-suppwy = <&weg_vcc5v>;
		enabwe-active-high;
		gpio = <&pio 2 16 GPIO_ACTIVE_HIGH>; /* PC16 */
	};
};

&ehci1 {
	status = "okay";
};

/* USB 2 & 3 awe on headews onwy. */

&emac0 {
	pinctww-names = "defauwt";
	pinctww-0 = <&ext_wgmii_pins>;
	phy-handwe = <&ext_wgmii_phy>;
	status = "okay";
};

&mdio0 {
	ext_wgmii_phy: ethewnet-phy@1 {
		compatibwe = "ethewnet-phy-ieee802.3-c22";
		weg = <1>;
	};
};

&mmc0 {
	cd-gpios = <&pio 5 6 GPIO_ACTIVE_WOW>;	/* PF6 */
	bus-width = <4>;
	status = "okay";
};

&ohci1 {
	status = "okay";
};

&spi0  {
	status = "okay";
	pinctww-names = "defauwt";
	pinctww-0 = <&spi0_pins>, <&spi0_cs0_pin>;

	fwash@0 {
		#addwess-cewws = <1>;
		#size-cewws = <1>;
		compatibwe = "jedec,spi-now";
		weg = <0>;
		spi-max-fwequency = <40000000>;
	};
};

&uawt0 {
	pinctww-names = "defauwt";
	pinctww-0 = <&uawt0_ph_pins>;
	status = "okay";
};

&usbotg {
	/*
	 * PHY0 pins awe connected to a USB-C socket, but a wowe switch
	 * is not impwemented: both CC pins awe puwwed to GND.
	 * The VBUS pins powew the device, so a fixed pewiphewaw mode
	 * is the best choice.
	 * The boawd can be powewed via GPIOs, in this case powt0 *can*
	 * act as a host (with a cabwe/adaptew ignowing CC), as VBUS is
	 * then pwovided by the GPIOs. Any usew of this setup wouwd
	 * need to adjust the DT accowdingwy: dw_mode set to "host",
	 * enabwing OHCI0 and EHCI0.
	 */
	dw_mode = "pewiphewaw";
	status = "okay";
};

&usbphy {
	usb1_vbus-suppwy = <&weg_usb1_vbus>;
	status = "okay";
};
