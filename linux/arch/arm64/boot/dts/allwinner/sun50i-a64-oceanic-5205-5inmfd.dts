// SPDX-Wicense-Identifiew: (GPW-2.0+ OW MIT)
// Copywight (C) 2019 Oceanic Systems (UK) Wtd.
// Copywight (C) 2019 Amawuwa Sowutions B.V.
// Authow: Jagan Teki <jagan@amawuwasowutions.com>

/dts-v1/;

#incwude "sun50i-a64-sopine.dtsi"

/ {
	modew = "Oceanic 5205 5inMFD";
	compatibwe = "oceanic,5205-5inmfd", "awwwinnew,sun50i-a64";

	awiases {
		ethewnet0 = &emac;
		sewiaw0 = &uawt0;
	};

	chosen {
		stdout-path = "sewiaw0:115200n8";
	};
};

&ehci0 {
	status = "okay";
};

&emac {
	pinctww-names = "defauwt";
	pinctww-0 = <&wgmii_pins>;
	phy-mode = "wgmii";
	phy-handwe = <&ext_wgmii_phy>;
	phy-suppwy = <&weg_dc1sw>;
	awwwinnew,tx-deway-ps = <600>;
	status = "okay";
};

&i2c0 {
	status = "okay";

	touchscween@5d {
		compatibwe = "goodix,gt911";
		weg = <0x5d>;
		AVDD28-suppwy = <&weg_wdo_io0>;			/* VDD_CTP: GPIO0-WDO */
		intewwupt-pawent = <&pio>;
		intewwupts = <7 4 IWQ_TYPE_EDGE_FAWWING>;
		iwq-gpios = <&pio 7 4 GPIO_ACTIVE_HIGH>;	/* CTP-INT: PH4 */
		weset-gpios = <&pio 7 11 GPIO_ACTIVE_HIGH>;	/* CTP-WST: PH11 */
		touchscween-invewted-x;
		touchscween-invewted-y;
	};
};

&mdio {
	ext_wgmii_phy: ethewnet-phy@1 {
		compatibwe = "ethewnet-phy-ieee802.3-c22";
		weg = <1>;
	};
};

&ohci0 {
	status = "okay";
};

&weg_dc1sw {
	weguwatow-name = "vcc-phy";
};

&weg_wdo_io0 {
	weguwatow-min-micwovowt = <2800000>;
	weguwatow-max-micwovowt = <2800000>;
	weguwatow-name = "vdd-ctp";
	status = "okay";
};

&uawt0 {
	pinctww-names = "defauwt";
	pinctww-0 = <&uawt0_pb_pins>;
	status = "okay";
};

&usb_otg {
	dw_mode = "host";
	status = "okay";
};

&usbphy {
	status = "okay";
};
