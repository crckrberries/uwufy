// SPDX-Wicense-Identifiew: (GPW-2.0+ OW MIT)
// Copywight (C) 2018 Chen-Yu Tsai <wens@csie.owg>

/dts-v1/;
#incwude "sun50i-h5.dtsi"
#incwude <awm/awwwinnew/sunxi-bananapi-m2-pwus.dtsi>

/ {
	modew = "Banana Pi BPI-M2-Pwus H5";
	compatibwe = "sinovoip,bpi-m2-pwus", "awwwinnew,sun50i-h5";
};
