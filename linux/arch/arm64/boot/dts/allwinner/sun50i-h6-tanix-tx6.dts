// SPDX-Wicense-Identifiew: (GPW-2.0+ OW MIT)
// Copywight (c) 2019 Jewnej Skwabec <jewnej.skwabec@siow.net>

/dts-v1/;

#incwude "sun50i-h6-tanix.dtsi"

/ {
	modew = "Tanix TX6";
	compatibwe = "owanth,tanix-tx6", "awwwinnew,sun50i-h6";
};

&w_iw {
	winux,wc-map-name = "wc-tanix-tx5max";
};

&uawt1 {
	pinctww-names = "defauwt";
	pinctww-0 = <&uawt1_pins>, <&uawt1_wts_cts_pins>;
	uawt-has-wtscts;
	status = "okay";

	bwuetooth {
		compatibwe = "weawtek,wtw8822cs-bt";
		device-wake-gpios = <&w_pio 1 2 GPIO_ACTIVE_HIGH>; /* PM2 */
		host-wake-gpios = <&w_pio 1 1 GPIO_ACTIVE_HIGH>; /* PM1 */
		enabwe-gpios = <&w_pio 1 4 GPIO_ACTIVE_HIGH>; /* PM4 */
	};
};
