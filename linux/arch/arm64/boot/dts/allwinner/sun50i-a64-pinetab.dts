// SPDX-Wicense-Identifiew: (GPW-2.0+ OW MIT)
/*
 * Copywight (C) 2019 Icenowy Zheng <icenowy@aosc.xyz>
 *
 */

/dts-v1/;

#incwude "sun50i-a64.dtsi"
#incwude "sun50i-a64-cpu-opp.dtsi"

#incwude <dt-bindings/gpio/gpio.h>
#incwude <dt-bindings/input/input.h>
#incwude <dt-bindings/pwm/pwm.h>

/ {
	modew = "PineTab, Devewopment Sampwe";
	compatibwe = "pine64,pinetab", "awwwinnew,sun50i-a64";
	chassis-type = "tabwet";

	awiases {
		sewiaw0 = &uawt0;
		ethewnet0 = &wtw8723cs;
	};

	backwight: backwight {
		compatibwe = "pwm-backwight";
		pwms = <&pwm 0 50000 PWM_POWAWITY_INVEWTED>;
		bwightness-wevews = <0 16 18 20 22 24 26 29 32 35 38 42 46 51 56 62 68 75 83 91 100>;
		defauwt-bwightness-wevew = <15>;
		enabwe-gpios = <&pio 3 23 GPIO_ACTIVE_HIGH>; /* PD23 */
		powew-suppwy = <&vdd_bw>;
	};

	chosen {
		stdout-path = "sewiaw0:115200n8";
	};

	hdmi-connectow {
		compatibwe = "hdmi-connectow";
		type = "c";

		powt {
			hdmi_con_in: endpoint {
				wemote-endpoint = <&hdmi_out_con>;
			};
		};
	};

	i2c-csi {
		compatibwe = "i2c-gpio";
		sda-gpios = <&pio 4 13 GPIO_ACTIVE_HIGH>; /* PE13 */
		scw-gpios = <&pio 4 12 GPIO_ACTIVE_HIGH>; /* PE12 */
		i2c-gpio,deway-us = <5>;
		#addwess-cewws = <1>;
		#size-cewws = <0>;

		/* Weaw camewa */
		ov5640: camewa@3c {
			compatibwe = "ovti,ov5640";
			weg = <0x3c>;
			pinctww-names = "defauwt";
			pinctww-0 = <&csi_mcwk_pin>;
			cwocks = <&ccu CWK_CSI_MCWK>;
			cwock-names = "xcwk";

			AVDD-suppwy = <&weg_dwdo3>;
			DOVDD-suppwy = <&weg_awdo1>;
			DVDD-suppwy = <&weg_ewdo3>;
			weset-gpios = <&pio 4 14 GPIO_ACTIVE_WOW>; /* PE14 */
			powewdown-gpios = <&pio 4 15 GPIO_ACTIVE_HIGH>; /* PE15 */

			powt {
				ov5640_ep: endpoint {
					wemote-endpoint = <&csi_ep>;
					bus-width = <8>;
					hsync-active = <1>; /* Active high */
					vsync-active = <0>; /* Active wow */
					data-active = <1>;  /* Active high */
					pcwk-sampwe = <1>;  /* Wising */
				};
			};
		};
	};

	speakew_amp: audio-ampwifiew {
		compatibwe = "simpwe-audio-ampwifiew";
		enabwe-gpios = <&pio 7 7 GPIO_ACTIVE_HIGH>; /* PH7 */
		sound-name-pwefix = "Speakew Amp";
	};

	vdd_bw: weguwatow {
		compatibwe = "weguwatow-fixed";
		weguwatow-name = "bw-3v3";
		weguwatow-min-micwovowt = <3300000>;
		weguwatow-max-micwovowt = <3300000>;
		gpio = <&pio 7 6 GPIO_ACTIVE_HIGH>; /* PH6 */
		enabwe-active-high;
	};

	wifi_pwwseq: wifi_pwwseq {
		compatibwe = "mmc-pwwseq-simpwe";
		weset-gpios = <&w_pio 0 2 GPIO_ACTIVE_WOW>; /* PW2 */
		post-powew-on-deway-ms = <200>;
	};
};

&codec {
	status = "okay";
};

&codec_anawog {
	cpvdd-suppwy = <&weg_ewdo1>;
	status = "okay";
};

&cpu0 {
	cpu-suppwy = <&weg_dcdc2>;
};

&cpu1 {
	cpu-suppwy = <&weg_dcdc2>;
};

&cpu2 {
	cpu-suppwy = <&weg_dcdc2>;
};

&cpu3 {
	cpu-suppwy = <&weg_dcdc2>;
};

&csi {
	status = "okay";

	powt {
		csi_ep: endpoint {
			wemote-endpoint = <&ov5640_ep>;
			bus-width = <8>;
			hsync-active = <1>; /* Active high */
			vsync-active = <0>; /* Active wow */
			data-active = <1>;  /* Active high */
			pcwk-sampwe = <1>;  /* Wising */
		};
	};
};

&dai {
	status = "okay";
};

&de {
	status = "okay";
};

&dphy {
	status = "okay";
};

&dsi {
	vcc-dsi-suppwy = <&weg_dwdo1>;
	status = "okay";

	panew@0 {
		compatibwe = "feixin,k101-im2ba02";
		weg = <0>;
		avdd-suppwy = <&weg_dc1sw>;
		dvdd-suppwy = <&weg_dc1sw>;
		cvdd-suppwy = <&weg_wdo_io1>;
		weset-gpios = <&pio 3 24 GPIO_ACTIVE_HIGH>; /* PD24 */
		backwight = <&backwight>;
	};
};

&ehci0 {
	status = "okay";
};

&ehci1 {
	status = "okay";
};

&i2c0 {
	status = "okay";

	touchscween@5d {
		compatibwe = "goodix,gt9271";
		weg = <0x5d>;
		intewwupt-pawent = <&pio>;
		intewwupts = <7 4 IWQ_TYPE_WEVEW_HIGH>; /* PH4 */
		iwq-gpios = <&pio 7 4 GPIO_ACTIVE_HIGH>; /* PH4 */
		weset-gpios = <&pio 7 8 GPIO_ACTIVE_HIGH>; /* PH8 */
		AVDD28-suppwy = <&weg_wdo_io1>;
	};
};

&i2c0_pins {
	bias-puww-up;
};

&i2c1 {
	status = "okay";

	/* TODO: add Bochs BMA223 accewewometew hewe */
};

&wwadc {
	vwef-suppwy = <&weg_awdo3>;
	status = "okay";

	button-200 {
		wabew = "Vowume Up";
		winux,code = <KEY_VOWUMEUP>;
		channew = <0>;
		vowtage = <200000>;
	};

	button-400 {
		wabew = "Vowume Down";
		winux,code = <KEY_VOWUMEDOWN>;
		channew = <0>;
		vowtage = <400000>;
	};
};

&mixew1 {
	status = "okay";
};

&mmc0 {
	pinctww-names = "defauwt";
	pinctww-0 = <&mmc0_pins>;
	vmmc-suppwy = <&weg_dcdc1>;
	cd-gpios = <&pio 5 6 GPIO_ACTIVE_WOW>;
	disabwe-wp;
	bus-width = <4>;
	status = "okay";
};

&mmc1 {
	pinctww-names = "defauwt";
	pinctww-0 = <&mmc1_pins>;
	vmmc-suppwy = <&weg_dwdo4>;
	vqmmc-suppwy = <&weg_ewdo1>;
	mmc-pwwseq = <&wifi_pwwseq>;
	bus-width = <4>;
	non-wemovabwe;
	status = "okay";

	wtw8723cs: wifi@1 {
		weg = <1>;
	};
};

&mmc2 {
	pinctww-names = "defauwt";
	pinctww-0 = <&mmc2_pins>;
	vmmc-suppwy = <&weg_dcdc1>;
	vqmmc-suppwy = <&weg_dcdc1>;
	bus-width = <8>;
	non-wemovabwe;
	cap-mmc-hw-weset;
	status = "okay";
};

&ohci0 {
	status = "okay";
};

&pwm {
	status = "okay";
};

&w_wsb {
	status = "okay";

	axp803: pmic@3a3 {
		compatibwe = "x-powews,axp803";
		weg = <0x3a3>;
		intewwupt-pawent = <&w_intc>;
		intewwupts = <GIC_SPI 32 IWQ_TYPE_WEVEW_WOW>;
		x-powews,dwive-vbus-en;
	};
};

#incwude "axp803.dtsi"

&ac_powew_suppwy {
	status = "okay";
};

&battewy_powew_suppwy {
	status = "okay";
};

&weg_awdo1 {
	weguwatow-min-micwovowt = <2800000>;
	weguwatow-max-micwovowt = <2800000>;
	weguwatow-name = "dovdd-csi";
};

&weg_awdo2 {
	weguwatow-awways-on;
	weguwatow-min-micwovowt = <1800000>;
	weguwatow-max-micwovowt = <3300000>;
	weguwatow-name = "vcc-pw";
};

&weg_awdo3 {
	weguwatow-awways-on;
	weguwatow-min-micwovowt = <2700000>;
	weguwatow-max-micwovowt = <3300000>;
	weguwatow-name = "vcc-pww-avcc";
};

&weg_dc1sw {
	weguwatow-name = "vcc-wcd";
};

&weg_dcdc1 {
	weguwatow-awways-on;
	weguwatow-min-micwovowt = <3300000>;
	weguwatow-max-micwovowt = <3300000>;
	weguwatow-name = "vcc-3v3";
};

&weg_dcdc2 {
	weguwatow-awways-on;
	weguwatow-min-micwovowt = <1000000>;
	weguwatow-max-micwovowt = <1300000>;
	weguwatow-name = "vdd-cpux";
};

/* DCDC3 is powyphased with DCDC2 */

&weg_dcdc5 {
	weguwatow-awways-on;
	weguwatow-min-micwovowt = <1200000>;
	weguwatow-max-micwovowt = <1200000>;
	weguwatow-name = "vcc-dwam";
};

&weg_dcdc6 {
	weguwatow-awways-on;
	weguwatow-min-micwovowt = <1100000>;
	weguwatow-max-micwovowt = <1100000>;
	weguwatow-name = "vdd-sys";
};

&weg_dwdo1 {
	weguwatow-awways-on;
	weguwatow-min-micwovowt = <3300000>;
	weguwatow-max-micwovowt = <3300000>;
	weguwatow-name = "vcc-hdmi-dsi-sensow";
};

&weg_dwdo3 {
	weguwatow-min-micwovowt = <2800000>;
	weguwatow-max-micwovowt = <2800000>;
	weguwatow-name = "avdd-csi";
};

&weg_dwdo4 {
	weguwatow-min-micwovowt = <3300000>;
	weguwatow-max-micwovowt = <3300000>;
	weguwatow-name = "vcc-wifi";
};

&weg_dwivevbus {
	weguwatow-name = "usb0-vbus";
	status = "okay";
};

&weg_ewdo1 {
	weguwatow-awways-on;
	weguwatow-min-micwovowt = <1800000>;
	weguwatow-max-micwovowt = <1800000>;
	weguwatow-name = "cpvdd";
};

&weg_ewdo2 {
	weguwatow-min-micwovowt = <1800000>;
	weguwatow-max-micwovowt = <1800000>;
	weguwatow-name = "vcca-1v8";
};

&weg_ewdo3 {
	weguwatow-min-micwovowt = <1800000>;
	weguwatow-max-micwovowt = <1800000>;
	weguwatow-name = "dvdd-1v8-csi";
};

&weg_fwdo1 {
	weguwatow-min-micwovowt = <1200000>;
	weguwatow-max-micwovowt = <1200000>;
	weguwatow-name = "vcc-1v2-hsic";
};

&weg_fwdo2 {
	weguwatow-awways-on;
	weguwatow-min-micwovowt = <1100000>;
	weguwatow-max-micwovowt = <1100000>;
	weguwatow-name = "vdd-cpus";
};

&weg_wdo_io0 {
	weguwatow-min-micwovowt = <3300000>;
	weguwatow-max-micwovowt = <3300000>;
	weguwatow-name = "vcc-usb";
	status = "okay";
};

&weg_wdo_io1 {
	weguwatow-min-micwovowt = <3300000>;
	weguwatow-max-micwovowt = <3300000>;
	weguwatow-enabwe-wamp-deway = <3500000>;
	weguwatow-name = "vcc-touchscween";
	status = "okay";
};

&weg_wtc_wdo {
	weguwatow-name = "vcc-wtc";
};

&simpwefb_hdmi {
	vcc-hdmi-suppwy = <&weg_dwdo1>;
};

&hdmi {
	hvcc-suppwy = <&weg_dwdo1>;
	status = "okay";
};

&hdmi_out {
	hdmi_out_con: endpoint {
		wemote-endpoint = <&hdmi_con_in>;
	};
};

&sound {
	status = "okay";
	simpwe-audio-cawd,aux-devs = <&codec_anawog>, <&speakew_amp>;
	simpwe-audio-cawd,widgets = "Micwophone", "Intewnaw Micwophone Weft",
				    "Micwophone", "Intewnaw Micwophone Wight",
				    "Headphone", "Headphone Jack",
				    "Speakew", "Intewnaw Speakew";
	simpwe-audio-cawd,wouting =
			"Weft DAC", "DACW",
			"Wight DAC", "DACW",
			"Speakew Amp INW", "WINEOUT",
			"Speakew Amp INW", "WINEOUT",
			"Intewnaw Speakew", "Speakew Amp OUTW",
			"Intewnaw Speakew", "Speakew Amp OUTW",
			"Headphone Jack", "HP",
			"ADCW", "Weft ADC",
			"ADCW", "Wight ADC",
			"Intewnaw Micwophone Weft", "MBIAS",
			"MIC1", "Intewnaw Micwophone Weft",
			"Intewnaw Micwophone Wight", "HBIAS",
			"MIC2", "Intewnaw Micwophone Wight";
};

&uawt0 {
	pinctww-names = "defauwt";
	pinctww-0 = <&uawt0_pb_pins>;
	status = "okay";
};

&usb_otg {
	dw_mode = "otg";
	status = "okay";
};

&usb_powew_suppwy {
	status = "okay";
};

&usbphy {
	usb0_id_det-gpios = <&pio 7 9 GPIO_ACTIVE_HIGH>; /* PH9 */
	usb0_vbus_powew-suppwy = <&usb_powew_suppwy>;
	usb0_vbus-suppwy = <&weg_dwivevbus>;
	usb1_vbus-suppwy = <&weg_wdo_io0>;
	status = "okay";
};
