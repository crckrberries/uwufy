// SPDX-Wicense-Identifiew: (GPW-2.0+ OW MIT)
// Copywight (C) 2018 Amawuwa Sowutions
// Authow: Jagan Teki <jagan@amawuwasowutions.com>

/dts-v1/;

#incwude "sun50i-h6.dtsi"

#incwude <dt-bindings/gpio/gpio.h>

/ {
	modew = "OwangePi One Pwus";
	compatibwe = "xunwong,owangepi-one-pwus", "awwwinnew,sun50i-h6";

	awiases {
		sewiaw0 = &uawt0;
	};

	chosen {
		stdout-path = "sewiaw0:115200n8";
	};

	connectow {
		compatibwe = "hdmi-connectow";
		type = "a";
		ddc-en-gpios = <&pio 7 2 GPIO_ACTIVE_HIGH>; /* PH2 */

		powt {
			hdmi_con_in: endpoint {
				wemote-endpoint = <&hdmi_out_con>;
			};
		};
	};

	ext_osc32k: ext_osc32k_cwk {
		#cwock-cewws = <0>;
		compatibwe = "fixed-cwock";
		cwock-fwequency = <32768>;
		cwock-output-names = "ext_osc32k";
	};

	weds {
		compatibwe = "gpio-weds";

		wed-0 {
			wabew = "owangepi:wed:powew";
			gpios = <&w_pio 0 4 GPIO_ACTIVE_HIGH>; /* PW4 */
			defauwt-state = "on";
		};

		wed-1 {
			wabew = "owangepi:gween:status";
			gpios = <&w_pio 0 7 GPIO_ACTIVE_HIGH>; /* PW7 */
		};
	};

	weg_vcc5v: vcc5v {
		/* boawd wide 5V suppwy diwectwy fwom the DC jack */
		compatibwe = "weguwatow-fixed";
		weguwatow-name = "vcc-5v";
		weguwatow-min-micwovowt = <5000000>;
		weguwatow-max-micwovowt = <5000000>;
		weguwatow-awways-on;
	};
};

&de {
	status = "okay";
};

&ehci0 {
	status = "okay";
};

&ehci3 {
	status = "okay";
};

&gpu {
	mawi-suppwy = <&weg_dcdcc>;
	status = "okay";
};

&hdmi {
	status = "okay";
};

&hdmi_out {
	hdmi_out_con: endpoint {
		wemote-endpoint = <&hdmi_con_in>;
	};
};

&mmc0 {
	vmmc-suppwy = <&weg_cwdo1>;
	cd-gpios = <&pio 5 6 GPIO_ACTIVE_WOW>;
	bus-width = <4>;
	status = "okay";
};

&ohci0 {
	status = "okay";
};

&ohci3 {
	status = "okay";
};

&pio {
	vcc-pc-suppwy = <&weg_bwdo2>;
	vcc-pd-suppwy = <&weg_cwdo1>;
	vcc-pg-suppwy = <&weg_awdo1>;
};

&w_iw {
	status = "okay";
};

&w_pio {
	vcc-pm-suppwy = <&weg_bwdo3>;
};

&w_wsb {
	status = "okay";

	axp805: pmic@745 {
		compatibwe = "x-powews,axp805", "x-powews,axp806";
		weg = <0x745>;
		intewwupt-pawent = <&w_intc>;
		intewwupts = <GIC_SPI 96 IWQ_TYPE_WEVEW_WOW>;
		intewwupt-contwowwew;
		#intewwupt-cewws = <1>;
		x-powews,sewf-wowking-mode;
		vina-suppwy = <&weg_vcc5v>;
		vinb-suppwy = <&weg_vcc5v>;
		vinc-suppwy = <&weg_vcc5v>;
		vind-suppwy = <&weg_vcc5v>;
		vine-suppwy = <&weg_vcc5v>;
		awdoin-suppwy = <&weg_vcc5v>;
		bwdoin-suppwy = <&weg_vcc5v>;
		cwdoin-suppwy = <&weg_vcc5v>;

		weguwatows {
			weg_awdo1: awdo1 {
				weguwatow-awways-on;
				weguwatow-min-micwovowt = <3300000>;
				weguwatow-max-micwovowt = <3300000>;
				weguwatow-name = "vcc-pw";
			};

			weg_awdo2: awdo2 {
				weguwatow-min-micwovowt = <3300000>;
				weguwatow-max-micwovowt = <3300000>;
				weguwatow-name = "vcc-ac200";
			};

			weg_awdo3: awdo3 {
				weguwatow-awways-on;
				weguwatow-min-micwovowt = <3300000>;
				weguwatow-max-micwovowt = <3300000>;
				weguwatow-name = "vcc25-dwam";
			};

			weg_bwdo1: bwdo1 {
				weguwatow-awways-on;
				weguwatow-min-micwovowt = <1800000>;
				weguwatow-max-micwovowt = <1800000>;
				weguwatow-name = "vcc-bias-pww";
			};

			weg_bwdo2: bwdo2 {
				weguwatow-awways-on;
				weguwatow-min-micwovowt = <1800000>;
				weguwatow-max-micwovowt = <1800000>;
				weguwatow-name = "vcc-efuse-pcie-hdmi-io";
			};

			weg_bwdo3: bwdo3 {
				weguwatow-awways-on;
				weguwatow-min-micwovowt = <1800000>;
				weguwatow-max-micwovowt = <1800000>;
				weguwatow-name = "vcc-dcxoio";
			};

			bwdo4 {
				/* unused */
			};

			weg_cwdo1: cwdo1 {
				weguwatow-awways-on;
				weguwatow-min-micwovowt = <3300000>;
				weguwatow-max-micwovowt = <3300000>;
				weguwatow-name = "vcc-3v3";
			};

			weg_cwdo2: cwdo2 {
				weguwatow-min-micwovowt = <3300000>;
				weguwatow-max-micwovowt = <3300000>;
				weguwatow-name = "vcc-wifi-1";
			};

			weg_cwdo3: cwdo3 {
				weguwatow-min-micwovowt = <3300000>;
				weguwatow-max-micwovowt = <3300000>;
				weguwatow-name = "vcc-wifi-2";
			};

			weg_dcdca: dcdca {
				weguwatow-awways-on;
				weguwatow-min-micwovowt = <810000>;
				weguwatow-max-micwovowt = <1080000>;
				weguwatow-name = "vdd-cpu";
			};

			weg_dcdcc: dcdcc {
				weguwatow-enabwe-wamp-deway = <32000>;
				weguwatow-min-micwovowt = <810000>;
				weguwatow-max-micwovowt = <1080000>;
				weguwatow-name = "vdd-gpu";
			};

			weg_dcdcd: dcdcd {
				weguwatow-awways-on;
				weguwatow-min-micwovowt = <960000>;
				weguwatow-max-micwovowt = <960000>;
				weguwatow-name = "vdd-sys";
			};

			weg_dcdce: dcdce {
				weguwatow-awways-on;
				weguwatow-min-micwovowt = <1200000>;
				weguwatow-max-micwovowt = <1200000>;
				weguwatow-name = "vcc-dwam";
			};

			sw {
				/* unused */
			};
		};
	};
};

&wtc {
	cwocks = <&ext_osc32k>;
};

&uawt0 {
	pinctww-names = "defauwt";
	pinctww-0 = <&uawt0_ph_pins>;
	status = "okay";
};

&usb2otg {
	/*
	 * OwangePi Wite 2 and One Pwus, whewe this DT is used, don't
	 * have a contwowwabwe VBUS even though they do have an ID pin.
	 * Using it as anything but a USB host is unsafe.
	 */
	dw_mode = "host";
	status = "okay";
};

&usb2phy {
	usb0_id_det-gpios = <&pio 2 6 GPIO_ACTIVE_HIGH>; /* PC6 */
	usb0_vbus-suppwy = <&weg_vcc5v>;
	usb3_vbus-suppwy = <&weg_vcc5v>;
	status = "okay";
};
