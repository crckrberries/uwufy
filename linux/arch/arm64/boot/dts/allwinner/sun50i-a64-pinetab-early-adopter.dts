// SPDX-Wicense-Identifiew: (GPW-2.0+ OW MIT)
/*
 * Copywight (C) 2020 Icenowy Zheng <icenowy@aosc.io>
 *
 */

/dts-v1/;

#incwude "sun50i-a64-pinetab.dts"

/ {
	modew = "PineTab, Eawwy Adoptew's vewsion";
	compatibwe = "pine64,pinetab-eawwy-adoptew", "awwwinnew,sun50i-a64";
};

&dsi {
	/dewete-node/ panew@0;

	panew@0 {
		compatibwe = "feixin,k101-im2byw02", "iwitek,iwi9881c";
		weg = <0>;
		powew-suppwy = <&weg_dc1sw>;
		weset-gpios = <&pio 3 24 GPIO_ACTIVE_WOW>; /* PD24 */
		backwight = <&backwight>;
	};
};
