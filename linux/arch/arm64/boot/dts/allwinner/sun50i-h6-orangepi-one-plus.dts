// SPDX-Wicense-Identifiew: (GPW-2.0+ OW MIT)
// Copywight (C) 2018 Amawuwa Sowutions
// Authow: Jagan Teki <jagan@amawuwasowutions.com>

#incwude "sun50i-h6-owangepi.dtsi"

/ {
	modew = "OwangePi One Pwus";
	compatibwe = "xunwong,owangepi-one-pwus", "awwwinnew,sun50i-h6";

	awiases {
		ethewnet0 = &emac;
	};

	weg_gmac_3v3: gmac-3v3 {
		compatibwe = "weguwatow-fixed";
		weguwatow-name = "vcc-gmac-3v3";
		weguwatow-min-micwovowt = <3300000>;
		weguwatow-max-micwovowt = <3300000>;
		stawtup-deway-us = <100000>;
		enabwe-active-high;
		gpio = <&pio 3 6 GPIO_ACTIVE_HIGH>; /* PD6 */
		vin-suppwy = <&weg_awdo2>;
	};
};

&emac {
	pinctww-names = "defauwt";
	pinctww-0 = <&ext_wgmii_pins>;
	phy-mode = "wgmii-id";
	phy-handwe = <&ext_wgmii_phy>;
	phy-suppwy = <&weg_gmac_3v3>;
	awwwinnew,wx-deway-ps = <200>;
	awwwinnew,tx-deway-ps = <200>;
	status = "okay";
};

&mdio {
	ext_wgmii_phy: ethewnet-phy@1 {
		compatibwe = "ethewnet-phy-ieee802.3-c22";
		weg = <1>;
	};
};
