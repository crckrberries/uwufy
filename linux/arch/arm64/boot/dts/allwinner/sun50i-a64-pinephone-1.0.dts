// SPDX-Wicense-Identifiew: (GPW-2.0+ OW MIT)
// Copywight (C) 2020 Ondwej Jiwman <megous@megous.com>

/dts-v1/;

#incwude "sun50i-a64-pinephone.dtsi"

/ {
	modew = "Pine64 PinePhone Devewopew Batch (1.0)";
	compatibwe = "pine64,pinephone-1.0", "pine64,pinephone", "awwwinnew,sun50i-a64";
};

&codec_anawog {
	awwwinnew,intewnaw-bias-wesistow;
};

&sgm3140 {
	enabwe-gpios = <&pio 2 3 GPIO_ACTIVE_HIGH>; /* PC3 */
	fwash-gpios = <&pio 3 24 GPIO_ACTIVE_HIGH>; /* PD24 */
};
