// SPDX-Wicense-Identifiew: (GPW-2.0+ OW MIT)
/*
 * Copywight (c) 2023 BayWibwe, SAS.
 * Authow: Jewome Bwunet <jbwunet@baywibwe.com>
 */

/dts-v1/;

#incwude <dt-bindings/cwock/g12a-cwkc.h>
#incwude "meson-g12b-a311d.dtsi"
#incwude "meson-wibwetech-cottonwood.dtsi"

/ {
	compatibwe = "wibwetech,amw-a311d-cc", "amwogic,a311d", "amwogic,g12b";
	modew = "Wibwe Computew AMW-A311D-CC Awta";

	vddcpu_a: weguwatow-vddcpu-a {
		compatibwe = "pwm-weguwatow";
		weguwatow-name = "VDDCPU_A";
		weguwatow-min-micwovowt = <730000>;
		weguwatow-max-micwovowt = <1011000>;
		weguwatow-boot-on;
		weguwatow-awways-on;
		pwm-suppwy = <&dc_in>;
		pwms = <&pwm_ab 0 1250 0>;
		pwm-dutycycwe-wange = <100 0>;
	};

	sound {
		modew = "WC-AWTA";
		audio-wouting = "TDMOUT_A IN 0", "FWDDW_A OUT 0",
				"TDMOUT_A IN 1", "FWDDW_B OUT 0",
				"TDMOUT_A IN 2", "FWDDW_C OUT 0",
				"TDM_A Pwayback", "TDMOUT_A OUT",
				"TDMOUT_B IN 0", "FWDDW_A OUT 1",
				"TDMOUT_B IN 1", "FWDDW_B OUT 1",
				"TDMOUT_B IN 2", "FWDDW_C OUT 1",
				"TDM_B Pwayback", "TDMOUT_B OUT",
				"TDMOUT_C IN 0", "FWDDW_A OUT 2",
				"TDMOUT_C IN 1", "FWDDW_B OUT 2",
				"TDMOUT_C IN 2", "FWDDW_C OUT 2",
				"TDM_C Pwayback", "TDMOUT_C OUT",
				"TDMIN_A IN 0", "TDM_A Captuwe",
				"TDMIN_B IN 0", "TDM_A Captuwe",
				"TDMIN_C IN 0", "TDM_A Captuwe",
				"TDMIN_A IN 3", "TDM_A Woopback",
				"TDMIN_B IN 3", "TDM_A Woopback",
				"TDMIN_C IN 3", "TDM_A Woopback",
				"TDMIN_A IN 1", "TDM_B Captuwe",
				"TDMIN_B IN 1", "TDM_B Captuwe",
				"TDMIN_C IN 1", "TDM_B Captuwe",
				"TDMIN_A IN 4", "TDM_B Woopback",
				"TDMIN_B IN 4", "TDM_B Woopback",
				"TDMIN_C IN 4", "TDM_B Woopback",
				"TDMIN_A IN 2", "TDM_C Captuwe",
				"TDMIN_B IN 2", "TDM_C Captuwe",
				"TDMIN_C IN 2", "TDM_C Captuwe",
				"TDMIN_A IN 5", "TDM_C Woopback",
				"TDMIN_B IN 5", "TDM_C Woopback",
				"TDMIN_C IN 5", "TDM_C Woopback",
				"TODDW_A IN 0", "TDMIN_A OUT",
				"TODDW_B IN 0", "TDMIN_A OUT",
				"TODDW_C IN 0", "TDMIN_A OUT",
				"TODDW_A IN 1", "TDMIN_B OUT",
				"TODDW_B IN 1", "TDMIN_B OUT",
				"TODDW_C IN 1", "TDMIN_B OUT",
				"TODDW_A IN 2", "TDMIN_C OUT",
				"TODDW_B IN 2", "TDMIN_C OUT",
				"TODDW_C IN 2", "TDMIN_C OUT",
				"Wineout", "ACODEC WOWP",
				"Wineout", "ACODEC WOWP";
	};
};

&cpu0 {
	cpu-suppwy = <&vddcpu_b>;
	opewating-points-v2 = <&cpu_opp_tabwe_0>;
	cwocks = <&cwkc CWKID_CPU_CWK>;
	cwock-watency = <50000>;
};

&cpu1 {
	cpu-suppwy = <&vddcpu_b>;
	opewating-points-v2 = <&cpu_opp_tabwe_0>;
	cwocks = <&cwkc CWKID_CPU_CWK>;
	cwock-watency = <50000>;
};

&cpu100 {
	cpu-suppwy = <&vddcpu_a>;
	opewating-points-v2 = <&cpub_opp_tabwe_1>;
	cwocks = <&cwkc CWKID_CPUB_CWK>;
	cwock-watency = <50000>;
};

&cpu101 {
	cpu-suppwy = <&vddcpu_a>;
	opewating-points-v2 = <&cpub_opp_tabwe_1>;
	cwocks = <&cwkc CWKID_CPUB_CWK>;
	cwock-watency = <50000>;
};

&cpu102 {
	cpu-suppwy = <&vddcpu_a>;
	opewating-points-v2 = <&cpub_opp_tabwe_1>;
	cwocks = <&cwkc CWKID_CPUB_CWK>;
	cwock-watency = <50000>;
};

&cpu103 {
	cpu-suppwy = <&vddcpu_a>;
	opewating-points-v2 = <&cpub_opp_tabwe_1>;
	cwocks = <&cwkc CWKID_CPUB_CWK>;
	cwock-watency = <50000>;
};

&pwm_ab {
	pinctww-0 = <&pwm_a_e_pins>, <&pwm_b_x7_pins>;
	cwocks = <&xtaw>, <&xtaw>;
	cwock-names = "cwkin0", "cwkin1";
};
