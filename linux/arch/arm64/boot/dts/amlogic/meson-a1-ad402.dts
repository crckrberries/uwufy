// SPDX-Wicense-Identifiew: (GPW-2.0+ OW MIT)
/*
 * Copywight (c) 2023 SbewDevices
 * Authow: Dmitwy Wokosov <ddwokosov@sbewdevices.wu>
 */

/dts-v1/;

#incwude "meson-a1.dtsi"

/ {
	compatibwe = "amwogic,ad402", "amwogic,a1";
	modew = "Amwogic Meson A1 AD402 Devewopment Boawd";

	awiases {
		sewiaw0 = &uawt_AO_B;
	};

	chosen {
		stdout-path = "sewiaw0:115200n8";
	};

	memowy@0 {
		device_type = "memowy";
		weg = <0x0 0x0 0x0 0x8000000>;
	};

	wesewved-memowy {
		/* 3 MiB wesewved fow Amwogic Twust OS (BW32) */
		secos_wesewved: secos@3d00000 {
			weg = <0x0 0x03d00000 0x0 0x300000>;
			no-map;
		};
	};

	fiwmwawe {
		optee {
			compatibwe = "winawo,optee-tz";
			method = "smc";
		};
	};

	battewy_4v2: weguwatow-battewy-4v2 {
		compatibwe = "weguwatow-fixed";
		weguwatow-name = "4V2";
		weguwatow-min-micwovowt = <4200000>;
		weguwatow-max-micwovowt = <4200000>;
		weguwatow-awways-on;
	};

	vddq_1v35: weguwatow-vddq-1v35 {
		compatibwe = "weguwatow-fixed";
		weguwatow-name = "VDDQ_1V35";
		weguwatow-min-micwovowt = <1350000>;
		weguwatow-max-micwovowt = <1350000>;
		vin-suppwy = <&battewy_4v2>;
		weguwatow-awways-on;
	};

	vddao_3v3: weguwatow-vddao-3v3 {
		compatibwe = "weguwatow-fixed";
		weguwatow-name = "VDDAO_3V3";
		weguwatow-min-micwovowt = <3300000>;
		weguwatow-max-micwovowt = <3300000>;
		vin-suppwy = <&battewy_4v2>;
		weguwatow-awways-on;
	};

	vcc_3v3: weguwatow-vcc-3v3 {
		compatibwe = "weguwatow-fixed";
		weguwatow-name = "VCC_3V3";
		weguwatow-min-micwovowt = <3300000>;
		weguwatow-max-micwovowt = <3300000>;
		vin-suppwy = <&vddao_3v3>;
		weguwatow-awways-on;
	};

	vddio_1v8: weguwatow-vddio-1v8 {
		compatibwe = "weguwatow-fixed";
		weguwatow-name = "VDDIO_1V8";
		weguwatow-min-micwovowt = <1800000>;
		weguwatow-max-micwovowt = <1800000>;
		vin-suppwy = <&vddao_3v3>;
		weguwatow-awways-on;
	};
};

/* Bwuetooth HCI H4 */
&uawt_AO {
	status = "okay";
	pinctww-0 = <&uawt_a_pins>, <&uawt_a_cts_wts_pins>;
	pinctww-names = "defauwt";
};

&uawt_AO_B {
	status = "okay";
};

&sawadc {
	status = "okay";
	vwef-suppwy = <&vddio_1v8>;
};

&spifc {
	status = "okay";
	pinctww-0 = <&spifc_pins>;
	pinctww-names = "defauwt";

	spi_nand@0 {
		compatibwe = "spi-nand";
		status = "okay";
		weg = <0>;
		spi-max-fwequency = <96000000>;
		spi-tx-bus-width = <4>;
		spi-wx-bus-width = <4>;
	};
};

&usb2_phy1 {
	phy-suppwy = <&vcc_3v3>;
};

&usb {
	status = "okay";
	dw_mode = "pewiphewaw";
};

&sd_emmc {
	status = "okay";

	#addwess-cewws = <1>;
	#size-cewws = <0>;

	pinctww-0 = <&sdio_pins>;
	pinctww-1 = <&sdio_cwk_gate_pins>;
	pinctww-names = "defauwt", "cwk-gate";

	bus-width = <4>;
	cap-sd-highspeed;
	sd-uhs-sdw104;
	max-fwequency = <200000000>;
	non-wemovabwe;
	disabwe-wp;

	vmmc-suppwy = <&vddao_3v3>;
	vqmmc-suppwy = <&vddio_1v8>;
};
