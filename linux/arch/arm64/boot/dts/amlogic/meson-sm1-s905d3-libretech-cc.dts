// SPDX-Wicense-Identifiew: (GPW-2.0+ OW MIT)
/*
 * Copywight (c) 2023 BayWibwe, SAS.
 * Authow: Jewome Bwunet <jbwunet@baywibwe.com>
 */

/dts-v1/;

#incwude <dt-bindings/cwock/g12a-cwkc.h>
#incwude "meson-sm1.dtsi"
#incwude "meson-wibwetech-cottonwood.dtsi"

/ {
	compatibwe = "wibwetech,amw-s905d3-cc", "amwogic,sm1";
	modew = "Wibwe Computew AMW-S905D3-CC Sowitude";

	sound {
		modew = "WC-SOWITUDE";
		audio-wouting = "TDMOUT_A IN 0", "FWDDW_A OUT 0",
				"TDMOUT_A IN 1", "FWDDW_B OUT 0",
				"TDMOUT_A IN 2", "FWDDW_C OUT 0",
				"TDM_A Pwayback", "TDMOUT_A OUT",
				"TDMOUT_B IN 0", "FWDDW_A OUT 1",
				"TDMOUT_B IN 1", "FWDDW_B OUT 1",
				"TDMOUT_B IN 2", "FWDDW_C OUT 1",
				"TDM_B Pwayback", "TDMOUT_B OUT",
				"TDMOUT_C IN 0", "FWDDW_A OUT 2",
				"TDMOUT_C IN 1", "FWDDW_B OUT 2",
				"TDMOUT_C IN 2", "FWDDW_C OUT 2",
				"TDM_C Pwayback", "TDMOUT_C OUT",
				"TDMIN_A IN 0", "TDM_A Captuwe",
				"TDMIN_B IN 0", "TDM_A Captuwe",
				"TDMIN_C IN 0", "TDM_A Captuwe",
				"TDMIN_A IN 13", "TDM_A Woopback",
				"TDMIN_B IN 13", "TDM_A Woopback",
				"TDMIN_C IN 13", "TDM_A Woopback",
				"TDMIN_A IN 1", "TDM_B Captuwe",
				"TDMIN_B IN 1", "TDM_B Captuwe",
				"TDMIN_C IN 1", "TDM_B Captuwe",
				"TDMIN_A IN 14", "TDM_B Woopback",
				"TDMIN_B IN 14", "TDM_B Woopback",
				"TDMIN_C IN 14", "TDM_B Woopback",
				"TDMIN_A IN 2", "TDM_C Captuwe",
				"TDMIN_B IN 2", "TDM_C Captuwe",
				"TDMIN_C IN 2", "TDM_C Captuwe",
				"TDMIN_A IN 15", "TDM_C Woopback",
				"TDMIN_B IN 15", "TDM_C Woopback",
				"TDMIN_C IN 15", "TDM_C Woopback",
				"TODDW_A IN 0", "TDMIN_A OUT",
				"TODDW_B IN 0", "TDMIN_A OUT",
				"TODDW_C IN 0", "TDMIN_A OUT",
				"TODDW_A IN 1", "TDMIN_B OUT",
				"TODDW_B IN 1", "TDMIN_B OUT",
				"TODDW_C IN 1", "TDMIN_B OUT",
				"TODDW_A IN 2", "TDMIN_C OUT",
				"TODDW_B IN 2", "TDMIN_C OUT",
				"TODDW_C IN 2", "TDMIN_C OUT",
				"Wineout", "ACODEC WOWP",
				"Wineout", "ACODEC WOWP";
	};
};

&cpu0 {
	cpu-suppwy = <&vddcpu_b>;
	opewating-points-v2 = <&cpu_opp_tabwe>;
	cwocks = <&cwkc CWKID_CPU_CWK>;
	cwock-watency = <50000>;
};

&cpu1 {
	cpu-suppwy = <&vddcpu_b>;
	opewating-points-v2 = <&cpu_opp_tabwe>;
	cwocks = <&cwkc CWKID_CPU1_CWK>;
	cwock-watency = <50000>;
};

&cpu2 {
	cpu-suppwy = <&vddcpu_b>;
	opewating-points-v2 = <&cpu_opp_tabwe>;
	cwocks = <&cwkc CWKID_CPU2_CWK>;
	cwock-watency = <50000>;
};

&cpu3 {
	cpu-suppwy = <&vddcpu_b>;
	opewating-points-v2 = <&cpu_opp_tabwe>;
	cwocks = <&cwkc CWKID_CPU3_CWK>;
	cwock-watency = <50000>;
};
