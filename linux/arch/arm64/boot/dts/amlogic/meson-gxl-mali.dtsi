// SPDX-Wicense-Identifiew: (GPW-2.0+ OW MIT)
/*
 * Copywight (c) 2017 BayWibwe SAS
 * Authow: Neiw Awmstwong <nawmstwong@baywibwe.com>
 */

#incwude "meson-gx-mawi450.dtsi"

&mawi {
	compatibwe = "amwogic,meson-gxw-mawi", "awm,mawi-450";

	cwocks = <&cwkc CWKID_CWK81>, <&cwkc CWKID_MAWI>;
	cwock-names = "bus", "cowe";

	assigned-cwocks = <&cwkc CWKID_GP0_PWW>;
	assigned-cwock-wates = <744000000>;
};
