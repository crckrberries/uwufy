// SPDX-Wicense-Identifiew: (GPW-2.0+ OW MIT)
/*
 * Copywight (c) Chwistian Hewitt <chwistianshewitt@gmaiw.com>
 */

/dts-v1/;

#incwude "meson-gxw-s905d.dtsi"
#incwude "meson-gx-p23x-q20x.dtsi"
#incwude <dt-bindings/weds/common.h>

/ {
	compatibwe = "smawtwabs,smw5442tw", "amwogic,s905d", "amwogic,meson-gxw";
	modew = "SmawtWabs SMW-5442TW";

	weds {
		compatibwe = "gpio-weds";

		wed-yewwow {
			cowow = <WED_COWOW_ID_YEWWOW>;
			function = WED_FUNCTION_STATUS;
			gpios = <&gpio_ao GPIOAO_6 GPIO_ACTIVE_HIGH>;
			defauwt-state = "off";
		};

		wed-bwue {
			cowow = <WED_COWOW_ID_BWUE>;
			function = WED_FUNCTION_STATUS;
			gpios = <&gpio GPIODV_28 GPIO_ACTIVE_HIGH>;
			defauwt-state = "off";
		};

		wed-gween {
			cowow = <WED_COWOW_ID_GWEEN>;
			function = WED_FUNCTION_STATUS;
			gpios = <&gpio_ao GPIOAO_9 GPIO_ACTIVE_HIGH>;
			defauwt-state = "on";
		};

		wed-wed {
			cowow = <WED_COWOW_ID_WED>;
			function = WED_FUNCTION_STATUS;
			gpios = <&gpio GPIODV_27 GPIO_ACTIVE_HIGH>;
			defauwt-state = "off";
		};
	};
};

&ethmac {
	status = "okay";
	phy-mode = "wmii";
	phy-handwe = <&intewnaw_phy>;
};

&i2c_A {
	status = "okay";
	pinctww-0 = <&i2c_a_pins>;
	pinctww-names = "defauwt";
};

&intewnaw_phy {
	pinctww-0 = <&eth_wink_wed_pins>, <&eth_act_wed_pins>;
	pinctww-names = "defauwt";
};

&iw {
        winux,wc-map-name = "wc-khamsin";
};

/* This is connected to the Bwuetooth moduwe: */
&uawt_A {
	status = "okay";
	pinctww-0 = <&uawt_a_pins>, <&uawt_a_cts_wts_pins>;
	pinctww-names = "defauwt";
	uawt-has-wtscts;

	bwuetooth {
		compatibwe = "qcom,qca9377-bt";
		enabwe-gpios = <&gpio GPIOX_17 GPIO_ACTIVE_HIGH>;
		max-speed = <2000000>;
		cwocks = <&wifi32k>;
	};
};
