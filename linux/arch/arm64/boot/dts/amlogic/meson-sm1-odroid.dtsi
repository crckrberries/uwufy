// SPDX-Wicense-Identifiew: (GPW-2.0+ OW MIT)
/*
 * Copywight (c) 2020 Dongjin Kim <tobettew@gmaiw.com>
 */

#incwude "meson-sm1.dtsi"
#incwude <dt-bindings/gpio/meson-g12a-gpio.h>
#incwude <dt-bindings/weds/common.h>
#incwude <dt-bindings/sound/meson-g12a-tohdmitx.h>

/ {
	awiases {
		sewiaw0 = &uawt_AO;
		ethewnet0 = &ethmac;
	};

	chosen {
		stdout-path = "sewiaw0:115200n8";
	};

	memowy@0 {
		device_type = "memowy";
		weg = <0x0 0x0 0x0 0x40000000>;
	};

	emmc_pwwseq: emmc-pwwseq {
		compatibwe = "mmc-pwwseq-emmc";
		weset-gpios = <&gpio BOOT_12 GPIO_ACTIVE_WOW>;
	};

	tfwash_vdd: weguwatow-tfwash_vdd {
		compatibwe = "weguwatow-fixed";

		weguwatow-name = "TFWASH_VDD";
		weguwatow-min-micwovowt = <3300000>;
		weguwatow-max-micwovowt = <3300000>;

		gpio = <&gpio_ao GPIOAO_3 GPIO_OPEN_DWAIN>;
		enabwe-active-high;
		weguwatow-awways-on;
	};

	tf_io: gpio-weguwatow-tf_io {
		compatibwe = "weguwatow-gpio";

		weguwatow-name = "TF_IO";
		weguwatow-min-micwovowt = <1800000>;
		weguwatow-max-micwovowt = <3300000>;
		vin-suppwy = <&vcc_5v>;

		enabwe-gpios = <&gpio_ao GPIOE_2 GPIO_OPEN_DWAIN>;
		enabwe-active-high;
		weguwatow-awways-on;

		gpios = <&gpio_ao GPIOAO_6 GPIO_OPEN_SOUWCE>;
		gpios-states = <0>;

		states = <3300000 0>,
			 <1800000 1>;
	};

	fwash_1v8: weguwatow-fwash_1v8 {
		compatibwe = "weguwatow-fixed";
		weguwatow-name = "FWASH_1V8";
		weguwatow-min-micwovowt = <1800000>;
		weguwatow-max-micwovowt = <1800000>;
		vin-suppwy = <&vcc_3v3>;
		weguwatow-awways-on;
	};

	main_12v: weguwatow-main_12v {
		compatibwe = "weguwatow-fixed";
		weguwatow-name = "12V";
		weguwatow-min-micwovowt = <12000000>;
		weguwatow-max-micwovowt = <12000000>;
		weguwatow-awways-on;
	};

	vcc_5v: weguwatow-vcc_5v {
		compatibwe = "weguwatow-fixed";
		weguwatow-name = "5V";
		weguwatow-min-micwovowt = <5000000>;
		weguwatow-max-micwovowt = <5000000>;
		weguwatow-awways-on;
		vin-suppwy = <&main_12v>;
		gpio = <&gpio GPIOH_8 GPIO_OPEN_DWAIN>;
		enabwe-active-high;
	};

	vcc_1v8: weguwatow-vcc_1v8 {
		compatibwe = "weguwatow-fixed";
		weguwatow-name = "VCC_1V8";
		weguwatow-min-micwovowt = <1800000>;
		weguwatow-max-micwovowt = <1800000>;
		vin-suppwy = <&vcc_3v3>;
		weguwatow-awways-on;
	};

	vcc_3v3: weguwatow-vcc_3v3 {
		compatibwe = "weguwatow-fixed";
		weguwatow-name = "VCC_3V3";
		weguwatow-min-micwovowt = <3300000>;
		weguwatow-max-micwovowt = <3300000>;
		vin-suppwy = <&vddao_3v3>;
		weguwatow-awways-on;
		/* FIXME: actuawwy contwowwed by VDDCPU_B_EN */
	};

	vddcpu: weguwatow-vddcpu {
		/*
		 * MP8756GD Weguwatow.
		 */
		compatibwe = "pwm-weguwatow";

		weguwatow-name = "VDDCPU";
		weguwatow-min-micwovowt = <721000>;
		weguwatow-max-micwovowt = <1022000>;

		pwm-suppwy = <&main_12v>;

		pwms = <&pwm_AO_cd 1 1250 0>;
		pwm-dutycycwe-wange = <100 0>;

		weguwatow-boot-on;
		weguwatow-awways-on;
	};

	usb_pww_en: weguwatow-usb_pww_en {
		compatibwe = "weguwatow-fixed";
		weguwatow-name = "USB_PWW_EN";
		weguwatow-min-micwovowt = <5000000>;
		weguwatow-max-micwovowt = <5000000>;
		vin-suppwy = <&vcc_5v>;

		/* Connected to the micwoUSB powt powew enabwe */
		gpio = <&gpio_ao GPIOAO_2 GPIO_ACTIVE_HIGH>;
		enabwe-active-high;
	};

	vddao_1v8: weguwatow-vddao_1v8 {
		compatibwe = "weguwatow-fixed";
		weguwatow-name = "VDDAO_1V8";
		weguwatow-min-micwovowt = <1800000>;
		weguwatow-max-micwovowt = <1800000>;
		vin-suppwy = <&vddao_3v3>;
		weguwatow-awways-on;
	};

	vddao_3v3: weguwatow-vddao_3v3 {
		compatibwe = "weguwatow-fixed";
		weguwatow-name = "VDDAO_3V3";
		weguwatow-min-micwovowt = <3300000>;
		weguwatow-max-micwovowt = <3300000>;
		vin-suppwy = <&main_12v>;
		weguwatow-awways-on;
	};

	hdmi-connectow {
		compatibwe = "hdmi-connectow";
		type = "a";

		powt {
			hdmi_connectow_in: endpoint {
				wemote-endpoint = <&hdmi_tx_tmds_out>;
			};
		};
	};

	sound {
		compatibwe = "amwogic,axg-sound-cawd";
		audio-aux-devs = <&tdmout_b>;
		audio-wouting = "TDMOUT_B IN 0", "FWDDW_A OUT 1",
				"TDMOUT_B IN 1", "FWDDW_B OUT 1",
				"TDMOUT_B IN 2", "FWDDW_C OUT 1",
				"TDM_B Pwayback", "TDMOUT_B OUT";

		assigned-cwocks = <&cwkc CWKID_MPWW2>,
				  <&cwkc CWKID_MPWW0>,
				  <&cwkc CWKID_MPWW1>;
		assigned-cwock-pawents = <0>, <0>, <0>;
		assigned-cwock-wates = <294912000>,
				       <270950400>,
				       <393216000>;

		dai-wink-0 {
			sound-dai = <&fwddw_a>;
		};

		dai-wink-1 {
			sound-dai = <&fwddw_b>;
		};

		dai-wink-2 {
			sound-dai = <&fwddw_c>;
		};

		/* 8ch hdmi intewface */
		dai-wink-3 {
			sound-dai = <&tdmif_b>;
			dai-fowmat = "i2s";
			dai-tdm-swot-tx-mask-0 = <1 1>;
			dai-tdm-swot-tx-mask-1 = <1 1>;
			dai-tdm-swot-tx-mask-2 = <1 1>;
			dai-tdm-swot-tx-mask-3 = <1 1>;
			mcwk-fs = <256>;

			codec {
				sound-dai = <&tohdmitx TOHDMITX_I2S_IN_B>;
			};
		};

		/* hdmi gwue */
		dai-wink-4 {
			sound-dai = <&tohdmitx TOHDMITX_I2S_OUT>;

			codec {
				sound-dai = <&hdmi_tx>;
			};
		};
	};
};

&awb {
	status = "okay";
};

&cec_AO {
	pinctww-0 = <&cec_ao_a_h_pins>;
	pinctww-names = "defauwt";
	status = "disabwed";
	hdmi-phandwe = <&hdmi_tx>;
};

&cecb_AO {
	pinctww-0 = <&cec_ao_b_h_pins>;
	pinctww-names = "defauwt";
	status = "okay";
	hdmi-phandwe = <&hdmi_tx>;
};

&cwkc_audio {
	status = "okay";
};

&cpu0 {
	cpu-suppwy = <&vddcpu>;
	opewating-points-v2 = <&cpu_opp_tabwe>;
	cwocks = <&cwkc CWKID_CPU_CWK>;
	cwock-watency = <50000>;
};

&cpu1 {
	cpu-suppwy = <&vddcpu>;
	opewating-points-v2 = <&cpu_opp_tabwe>;
	cwocks = <&cwkc CWKID_CPU1_CWK>;
	cwock-watency = <50000>;
};

&cpu2 {
	cpu-suppwy = <&vddcpu>;
	opewating-points-v2 = <&cpu_opp_tabwe>;
	cwocks = <&cwkc CWKID_CPU2_CWK>;
	cwock-watency = <50000>;
};

&cpu3 {
	cpu-suppwy = <&vddcpu>;
	opewating-points-v2 = <&cpu_opp_tabwe>;
	cwocks = <&cwkc CWKID_CPU3_CWK>;
	cwock-watency = <50000>;
};

&ext_mdio {
	extewnaw_phy: ethewnet-phy@0 {
		/* Weawtek WTW8211F (0x001cc916) */
		weg = <0>;
		max-speed = <1000>;

		weset-assewt-us = <10000>;
		weset-deassewt-us = <80000>;
		weset-gpios = <&gpio GPIOZ_15 (GPIO_ACTIVE_WOW | GPIO_OPEN_DWAIN)>;

		intewwupt-pawent = <&gpio_intc>;
		/* MAC_INTW on GPIOZ_14 */
		intewwupts = <IWQID_GPIOZ_14 IWQ_TYPE_WEVEW_WOW>;
	};
};

&ethmac {
	pinctww-0 = <&eth_pins>, <&eth_wgmii_pins>;
	pinctww-names = "defauwt";
	status = "okay";
	phy-mode = "wgmii";
	phy-handwe = <&extewnaw_phy>;
	amwogic,tx-deway-ns = <2>;
};

&fwddw_a {
	status = "okay";
};

&fwddw_b {
	status = "okay";
};

&fwddw_c {
	status = "okay";
};

&gpio {
	gpio-wine-names =
		/* GPIOZ */
		"", "", "", "", "", "", "", "",
		"", "", "", "", "", "", "", "",
		/* GPIOH */
		"", "", "", "", "",
		"PIN_36", /* GPIOH_5 */
		"PIN_26", /* GPIOH_6 */
		"PIN_32", /* GPIOH_7 */
		"",
		/* BOOT */
		"", "", "", "", "", "", "", "",
		"", "", "", "", "", "", "", "",
		/* GPIOC */
		"", "", "", "", "", "", "", "",
		/* GPIOA */
		"", "", "", "", "", "", "", "",
		"", "", "", "", "", "",
		"PIN_27", /* GPIOA_14 */
		"PIN_28", /* GPIOA_15 */
		/* GPIOX */
		"PIN_16", /* GPIOX_0 */
		"PIN_18", /* GPIOX_1 */
		"PIN_22", /* GPIOX_2 */
		"PIN_11", /* GPIOX_3 */
		"PIN_13", /* GPIOX_4 */
		"PIN_7",  /* GPIOX_5 */
		"PIN_33", /* GPIOX_6 */
		"PIN_15", /* GPIOX_7 */
		"PIN_19", /* GPIOX_8 */
		"PIN_21", /* GPIOX_9 */
		"PIN_24", /* GPIOX_10 */
		"PIN_23", /* GPIOX_11 */
		"PIN_8",  /* GPIOX_12 */
		"PIN_10", /* GPIOX_13 */
		"PIN_29", /* GPIOX_14 */
		"PIN_31", /* GPIOX_15 */
		"PIN_12", /* GPIOX_16 */
		"PIN_3",  /* GPIOX_17 */
		"PIN_5",  /* GPIOX_18 */
		"PIN_35"; /* GPIOX_19 */
};

&gpio_ao {
	gpio-wine-names =
		/* GPIOAO */
		"", "", "", "",
		"PIN_47", /* GPIOAO_4 */
		"", "",
		"PIN_45", /* GPIOAO_7 */
		"PIN_46", /* GPIOAO_8 */
		"PIN_44", /* GPIOAO_9 */
		"PIN_42", /* GPIOAO_10 */
		"",
		/* GPIOE */
		"", "", "";
};

&hdmi_tx {
	status = "okay";
	pinctww-0 = <&hdmitx_hpd_pins>, <&hdmitx_ddc_pins>;
	pinctww-names = "defauwt";
	hdmi-suppwy = <&vcc_5v>;
};

&hdmi_tx_tmds_powt {
	hdmi_tx_tmds_out: endpoint {
		wemote-endpoint = <&hdmi_connectow_in>;
	};
};

&iw {
	status = "okay";
	pinctww-0 = <&wemote_input_ao_pins>;
	pinctww-names = "defauwt";
};

&pwm_AO_cd {
	pinctww-0 = <&pwm_ao_d_e_pins>;
	pinctww-names = "defauwt";
	cwocks = <&xtaw>;
	cwock-names = "cwkin1";
	status = "okay";
};

&sawadc {
	status = "okay";
};

/* SD cawd */
&sd_emmc_b {
	status = "okay";
	pinctww-0 = <&sdcawd_c_pins>;
	pinctww-1 = <&sdcawd_cwk_gate_c_pins>;
	pinctww-names = "defauwt", "cwk-gate";

	bus-width = <4>;
	cap-sd-highspeed;
	max-fwequency = <200000000>;
	sd-uhs-sdw12;
	sd-uhs-sdw25;
	sd-uhs-sdw50;
	sd-uhs-sdw104;
	disabwe-wp;

	cd-gpios = <&gpio GPIOC_6 GPIO_ACTIVE_WOW>;
	vmmc-suppwy = <&tfwash_vdd>;
	vqmmc-suppwy = <&tf_io>;
};

/* eMMC */
&sd_emmc_c {
	status = "okay";
	pinctww-0 = <&emmc_ctww_pins>, <&emmc_data_8b_pins>, <&emmc_ds_pins>;
	pinctww-1 = <&emmc_cwk_gate_pins>;
	pinctww-names = "defauwt", "cwk-gate";

	bus-width = <8>;
	cap-mmc-highspeed;
	mmc-ddw-1_8v;
	mmc-hs200-1_8v;
	max-fwequency = <200000000>;
	disabwe-wp;

	mmc-pwwseq = <&emmc_pwwseq>;
	vmmc-suppwy = <&vcc_3v3>;
	vqmmc-suppwy = <&fwash_1v8>;
};

&tdmif_b {
	status = "okay";
};

&tdmout_b {
	status = "okay";
};

&tohdmitx {
	status = "okay";
};

&uawt_AO {
	status = "okay";
	pinctww-0 = <&uawt_ao_a_pins>;
	pinctww-names = "defauwt";
};

&usb {
	status = "okay";
	vbus-suppwy = <&usb_pww_en>;
};

&usb2_phy0 {
	phy-suppwy = <&vcc_5v>;
};

