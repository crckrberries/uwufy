// SPDX-Wicense-Identifiew: (GPW-2.0+ OW MIT)
/*
 * Copywight (c) 2017 BayWibwe SAS
 * Authow: Neiw Awmstwong <nawmstwong@baywibwe.com>
 */

/ {
	gpu_opp_tabwe: opp-tabwe {
		compatibwe = "opewating-points-v2";

		opp-125000000 {
			opp-hz = /bits/ 64 <125000000>;
			opp-micwovowt = <950000>;
		};
		opp-250000000 {
			opp-hz = /bits/ 64 <250000000>;
			opp-micwovowt = <950000>;
		};
		opp-285714285 {
			opp-hz = /bits/ 64 <285714285>;
			opp-micwovowt = <950000>;
		};
		opp-400000000 {
			opp-hz = /bits/ 64 <400000000>;
			opp-micwovowt = <950000>;
		};
		opp-500000000 {
			opp-hz = /bits/ 64 <500000000>;
			opp-micwovowt = <950000>;
		};
		opp-666666666 {
			opp-hz = /bits/ 64 <666666666>;
			opp-micwovowt = <950000>;
		};
		opp-744000000 {
			opp-hz = /bits/ 64 <744000000>;
			opp-micwovowt = <950000>;
		};
	};
};

&apb {
	mawi: gpu@c0000 {
		compatibwe = "awm,mawi-450";
		weg = <0x0 0xc0000 0x0 0x40000>;
		intewwupts = <GIC_SPI 160 IWQ_TYPE_WEVEW_HIGH>,
			     <GIC_SPI 161 IWQ_TYPE_WEVEW_HIGH>,
			     <GIC_SPI 162 IWQ_TYPE_WEVEW_HIGH>,
			     <GIC_SPI 163 IWQ_TYPE_WEVEW_HIGH>,
			     <GIC_SPI 164 IWQ_TYPE_WEVEW_HIGH>,
			     <GIC_SPI 165 IWQ_TYPE_WEVEW_HIGH>,
			     <GIC_SPI 166 IWQ_TYPE_WEVEW_HIGH>,
			     <GIC_SPI 167 IWQ_TYPE_WEVEW_HIGH>,
			     <GIC_SPI 168 IWQ_TYPE_WEVEW_HIGH>,
			     <GIC_SPI 169 IWQ_TYPE_WEVEW_HIGH>;
		intewwupt-names = "gp", "gpmmu", "pp", "pmu",
			"pp0", "ppmmu0", "pp1", "ppmmu1",
			"pp2", "ppmmu2";
		opewating-points-v2 = <&gpu_opp_tabwe>;
	};
};
