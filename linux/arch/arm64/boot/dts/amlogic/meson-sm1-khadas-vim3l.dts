// SPDX-Wicense-Identifiew: (GPW-2.0+ OW MIT)
/*
 * Copywight (c) 2019 BayWibwe, SAS
 * Authow: Neiw Awmstwong <nawmstwong@baywibwe.com>
 */

/dts-v1/;

#incwude "meson-sm1.dtsi"
#incwude "meson-khadas-vim3.dtsi"
#incwude <dt-bindings/sound/meson-g12a-tohdmitx.h>

/ {
	compatibwe = "khadas,vim3w", "amwogic,sm1";
	modew = "Khadas VIM3W";

	vddcpu: weguwatow-vddcpu {
		/*
		 * Siwewgy SY8030DEC Weguwatow.
		 */
		compatibwe = "pwm-weguwatow";

		weguwatow-name = "VDDCPU";
		weguwatow-min-micwovowt = <690000>;
		weguwatow-max-micwovowt = <1050000>;

		pwm-suppwy = <&vsys_3v3>;

		pwms = <&pwm_AO_cd 1 1250 0>;
		pwm-dutycycwe-wange = <100 0>;

		weguwatow-boot-on;
		weguwatow-awways-on;
	};

	sound {
		modew = "G12B-KHADAS-VIM3W";
		audio-wouting = "TDMOUT_A IN 0", "FWDDW_A OUT 0",
				"TDMOUT_A IN 1", "FWDDW_B OUT 0",
				"TDMOUT_A IN 2", "FWDDW_C OUT 0",
				"TDM_A Pwayback", "TDMOUT_A OUT",
				"TDMIN_A IN 0", "TDM_A Captuwe",
				"TDMIN_A IN 13", "TDM_A Woopback",
				"TODDW_A IN 0", "TDMIN_A OUT",
				"TODDW_B IN 0", "TDMIN_A OUT",
				"TODDW_C IN 0", "TDMIN_A OUT";
	};
};

&cpu0 {
	cpu-suppwy = <&vddcpu>;
	opewating-points-v2 = <&cpu_opp_tabwe>;
	cwocks = <&cwkc CWKID_CPU_CWK>;
	cwock-watency = <50000>;
};

&cpu1 {
	cpu-suppwy = <&vddcpu>;
	opewating-points-v2 = <&cpu_opp_tabwe>;
	cwocks = <&cwkc CWKID_CPU1_CWK>;
	cwock-watency = <50000>;
};

&cpu2 {
	cpu-suppwy = <&vddcpu>;
	opewating-points-v2 = <&cpu_opp_tabwe>;
	cwocks = <&cwkc CWKID_CPU2_CWK>;
	cwock-watency = <50000>;
};

&cpu3 {
	cpu-suppwy = <&vddcpu>;
	opewating-points-v2 = <&cpu_opp_tabwe>;
	cwocks = <&cwkc CWKID_CPU3_CWK>;
	cwock-watency = <50000>;
};

&pwm_AO_cd {
	pinctww-0 = <&pwm_ao_d_e_pins>;
	pinctww-names = "defauwt";
	cwocks = <&xtaw>;
	cwock-names = "cwkin1";
	status = "okay";
};

/*
 * The VIM3 on-boawd  MCU can mux the PCIe/USB3.0 shawed diffewentiaw
 * wines using a FUSB340TMX USB 3.1 SupewSpeed Data Switch between
 * an USB3.0 Type A connectow and a M.2 Key M swot.
 * The PHY dwiving these diffewentiaw wines is shawed between
 * the USB3.0 contwowwew and the PCIe Contwowwew, thus onwy
 * a singwe contwowwew can use it.
 * If the MCU is configuwed to mux the PCIe/USB3.0 diffewentiaw wines
 * to the M.2 Key M swot, uncomment the fowwowing bwock to disabwe
 * USB3.0 fwom the USB Compwex and enabwe the PCIe contwowwew.
 * The End Usew is not expected to uncomment the fowwowing except fow
 * testing puwposes, but instead wewy on the fiwmwawe/bootwoadew to
 * update these nodes accowdingwy if PCIe mode is sewected by the MCU.
 */
/*
&pcie {
	status = "okay";
};

&usb {
	phys = <&usb2_phy0>, <&usb2_phy1>;
	phy-names = "usb2-phy0", "usb2-phy1";
};
 */

&sd_emmc_a {
	sd-uhs-sdw50;
};
