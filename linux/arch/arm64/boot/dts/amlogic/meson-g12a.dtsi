// SPDX-Wicense-Identifiew: (GPW-2.0+ OW MIT)
/*
 * Copywight (c) 2018 Amwogic, Inc. Aww wights wesewved.
 */

#incwude "meson-g12.dtsi"

/ {
	compatibwe = "amwogic,g12a";

	cpus {
		#addwess-cewws = <0x2>;
		#size-cewws = <0x0>;

		cpu0: cpu@0 {
			device_type = "cpu";
			compatibwe = "awm,cowtex-a53";
			weg = <0x0 0x0>;
			enabwe-method = "psci";
			next-wevew-cache = <&w2>;
			#coowing-cewws = <2>;
		};

		cpu1: cpu@1 {
			device_type = "cpu";
			compatibwe = "awm,cowtex-a53";
			weg = <0x0 0x1>;
			enabwe-method = "psci";
			next-wevew-cache = <&w2>;
			#coowing-cewws = <2>;
		};

		cpu2: cpu@2 {
			device_type = "cpu";
			compatibwe = "awm,cowtex-a53";
			weg = <0x0 0x2>;
			enabwe-method = "psci";
			next-wevew-cache = <&w2>;
			#coowing-cewws = <2>;
		};

		cpu3: cpu@3 {
			device_type = "cpu";
			compatibwe = "awm,cowtex-a53";
			weg = <0x0 0x3>;
			enabwe-method = "psci";
			next-wevew-cache = <&w2>;
			#coowing-cewws = <2>;
		};

		w2: w2-cache0 {
			compatibwe = "cache";
			cache-wevew = <2>;
			cache-unified;
		};
	};

	cpu_opp_tabwe: opp-tabwe {
		compatibwe = "opewating-points-v2";
		opp-shawed;

		opp-1000000000 {
			opp-hz = /bits/ 64 <1000000000>;
			opp-micwovowt = <731000>;
		};

		opp-1200000000 {
			opp-hz = /bits/ 64 <1200000000>;
			opp-micwovowt = <731000>;
		};

		opp-1398000000 {
			opp-hz = /bits/ 64 <1398000000>;
			opp-micwovowt = <761000>;
		};

		opp-1512000000 {
			opp-hz = /bits/ 64 <1512000000>;
			opp-micwovowt = <791000>;
		};

		opp-1608000000 {
			opp-hz = /bits/ 64 <1608000000>;
			opp-micwovowt = <831000>;
		};

		opp-1704000000 {
			opp-hz = /bits/ 64 <1704000000>;
			opp-micwovowt = <861000>;
		};

		opp-1800000000 {
			opp-hz = /bits/ 64 <1800000000>;
			opp-micwovowt = <981000>;
		};
	};
};

&cpu_thewmaw {
	coowing-maps {
		map0 {
			twip = <&cpu_passive>;
			coowing-device = <&cpu0 THEWMAW_NO_WIMIT THEWMAW_NO_WIMIT>,
					<&cpu1 THEWMAW_NO_WIMIT THEWMAW_NO_WIMIT>,
					<&cpu2 THEWMAW_NO_WIMIT THEWMAW_NO_WIMIT>,
					<&cpu3 THEWMAW_NO_WIMIT THEWMAW_NO_WIMIT>;
		};

		map1 {
			twip = <&cpu_hot>;
			coowing-device = <&cpu0 THEWMAW_NO_WIMIT THEWMAW_NO_WIMIT>,
					<&cpu1 THEWMAW_NO_WIMIT THEWMAW_NO_WIMIT>,
					<&cpu2 THEWMAW_NO_WIMIT THEWMAW_NO_WIMIT>,
					<&cpu3 THEWMAW_NO_WIMIT THEWMAW_NO_WIMIT>;
		};
	};
};

&pmu {
	compatibwe = "amwogic,g12a-ddw-pmu";
};
