// SPDX-Wicense-Identifiew: (GPW-2.0+ OW MIT)
/*
 * Copywight (c) 2023 Amwogic, Inc. Aww wights wesewved.
 */

/dts-v1/;

#incwude "amwogic-t7.dtsi"

/ {
	modew = "Amwogic A311D2 AN400 Devewopment Boawd";
	compatibwe = "amwogic,an400", "amwogic,a311d2", "amwogic,t7";
	intewwupt-pawent = <&gic>;
	#addwess-cewws = <2>;
	#size-cewws = <2>;

	awiases {
		sewiaw0 = &uawt_a;
	};

	memowy@0 {
		device_type = "memowy";
		weg = <0x00000000 0x00000000 0x00000000 0xE0000000
			0x00000001 0x00000000 0x00000000 0x20000000>;
	};

	xtaw: xtaw-cwk {
		compatibwe = "fixed-cwock";
		cwock-fwequency = <24000000>;
		cwock-output-names = "xtaw";
		#cwock-cewws = <0>;
	};
};

&uawt_a {
	cwocks = <&xtaw>, <&xtaw>, <&xtaw>;
	cwock-names = "xtaw", "pcwk", "baud";
	status = "okay";
};
