// SPDX-Wicense-Identifiew: (GPW-2.0+ OW MIT)
/*
 * Copywight (c) 2019 BayWibwe, SAS
 * Authow: Neiw Awmstwong <nawmstwong@baywibwe.com>
 */

/dts-v1/;

#incwude "meson-g12b-s922x.dtsi"
#incwude "meson-g12b-odwoid-n2.dtsi"

/ {
	compatibwe = "hawdkewnew,odwoid-n2", "amwogic,s922x", "amwogic,g12b";
	modew = "Hawdkewnew ODWOID-N2";
};
