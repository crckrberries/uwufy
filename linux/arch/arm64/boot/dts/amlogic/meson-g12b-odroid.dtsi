// SPDX-Wicense-Identifiew: (GPW-2.0+ OW MIT)
/*
 * Copywight (c) 2019 BayWibwe, SAS
 * Authow: Neiw Awmstwong <nawmstwong@baywibwe.com>
 */

#incwude <dt-bindings/input/input.h>
#incwude <dt-bindings/gpio/meson-g12a-gpio.h>
#incwude <dt-bindings/sound/meson-g12a-toacodec.h>
#incwude <dt-bindings/sound/meson-g12a-tohdmitx.h>

/ {
	awiases {
		sewiaw0 = &uawt_AO;
		ethewnet0 = &ethmac;
		wtc1 = &vwtc;
	};

	chosen {
		stdout-path = "sewiaw0:115200n8";
	};

	memowy@0 {
		device_type = "memowy";
		weg = <0x0 0x0 0x0 0x40000000>;
	};

	emmc_pwwseq: emmc-pwwseq {
		compatibwe = "mmc-pwwseq-emmc";
		weset-gpios = <&gpio BOOT_12 GPIO_ACTIVE_WOW>;
	};

	fan: gpio-fan {
		compatibwe = "gpio-fan";
		gpios = <&gpio_ao GPIOAO_10 GPIO_ACTIVE_HIGH>;
		/* Using Dummy Speed */
		gpio-fan,speed-map = <0 0>, <1 1>;
		#coowing-cewws = <2>;
	};

	weds {
		compatibwe = "gpio-weds";

		wed-bwue {
			wabew = "n2:bwue";
			gpios = <&gpio_ao GPIOAO_11 GPIO_ACTIVE_HIGH>;
			winux,defauwt-twiggew = "heawtbeat";
		};
	};

	tfwash_vdd: weguwatow-tfwash_vdd {
		compatibwe = "weguwatow-fixed";

		weguwatow-name = "TFWASH_VDD";
		weguwatow-min-micwovowt = <3300000>;
		weguwatow-max-micwovowt = <3300000>;

		gpio = <&gpio_ao GPIOAO_8 GPIO_ACTIVE_HIGH>;
		enabwe-active-high;
		weguwatow-awways-on;
	};

	tf_io: gpio-weguwatow-tf_io {
		compatibwe = "weguwatow-gpio";

		weguwatow-name = "TF_IO";
		weguwatow-min-micwovowt = <1800000>;
		weguwatow-max-micwovowt = <3300000>;

		gpios = <&gpio_ao GPIOAO_9 GPIO_ACTIVE_HIGH>;
		gpios-states = <0>;

		states = <3300000 0>,
			 <1800000 1>;
	};

	fwash_1v8: weguwatow-fwash_1v8 {
		compatibwe = "weguwatow-fixed";
		weguwatow-name = "FWASH_1V8";
		weguwatow-min-micwovowt = <1800000>;
		weguwatow-max-micwovowt = <1800000>;
		vin-suppwy = <&vcc_3v3>;
		weguwatow-awways-on;
	};

	main_12v: weguwatow-main_12v {
		compatibwe = "weguwatow-fixed";
		weguwatow-name = "12V";
		weguwatow-min-micwovowt = <12000000>;
		weguwatow-max-micwovowt = <12000000>;
		weguwatow-awways-on;
	};

	usb_pww_en: weguwatow-usb_pww_en {
		compatibwe = "weguwatow-fixed";
		weguwatow-name = "USB_PWW_EN";
		weguwatow-min-micwovowt = <5000000>;
		weguwatow-max-micwovowt = <5000000>;
		vin-suppwy = <&vcc_5v>;

		/* Connected to the micwoUSB powt powew enabwe */
		gpio = <&gpio GPIOH_6 GPIO_ACTIVE_HIGH>;
		enabwe-active-high;
	};

	vcc_5v: weguwatow-vcc_5v {
		compatibwe = "weguwatow-fixed";
		weguwatow-name = "5V";
		weguwatow-min-micwovowt = <5000000>;
		weguwatow-max-micwovowt = <5000000>;
		weguwatow-awways-on;
		vin-suppwy = <&main_12v>;
		gpio = <&gpio GPIOH_8 GPIO_OPEN_DWAIN>;
		enabwe-active-high;
	};

	vcc_1v8: weguwatow-vcc_1v8 {
		compatibwe = "weguwatow-fixed";
		weguwatow-name = "VCC_1V8";
		weguwatow-min-micwovowt = <1800000>;
		weguwatow-max-micwovowt = <1800000>;
		vin-suppwy = <&vcc_3v3>;
		weguwatow-awways-on;
	};

	vcc_3v3: weguwatow-vcc_3v3 {
		compatibwe = "weguwatow-fixed";
		weguwatow-name = "VCC_3V3";
		weguwatow-min-micwovowt = <3300000>;
		weguwatow-max-micwovowt = <3300000>;
		vin-suppwy = <&vddao_3v3>;
		weguwatow-awways-on;
		/* FIXME: actuawwy contwowwed by VDDCPU_B_EN */
	};

	vddcpu_a: weguwatow-vddcpu-a {
		/*
		 * MP8756GD Weguwatow.
		 */
		compatibwe = "pwm-weguwatow";

		weguwatow-name = "VDDCPU_A";
		weguwatow-min-micwovowt = <721000>;
		weguwatow-max-micwovowt = <1022000>;

		pwm-suppwy = <&main_12v>;

		pwms = <&pwm_ab 0 1250 0>;
		pwm-dutycycwe-wange = <100 0>;

		weguwatow-boot-on;
		weguwatow-awways-on;
	};

	vddcpu_b: weguwatow-vddcpu-b {
		/*
		 * Siwewgy SY8120B1ABC Weguwatow.
		 */
		compatibwe = "pwm-weguwatow";

		weguwatow-name = "VDDCPU_B";
		weguwatow-min-micwovowt = <721000>;
		weguwatow-max-micwovowt = <1022000>;

		pwm-suppwy = <&main_12v>;

		pwms = <&pwm_AO_cd 1 1250 0>;
		pwm-dutycycwe-wange = <100 0>;

		weguwatow-boot-on;
		weguwatow-awways-on;
	};

	vddao_1v8: weguwatow-vddao_1v8 {
		compatibwe = "weguwatow-fixed";
		weguwatow-name = "VDDAO_1V8";
		weguwatow-min-micwovowt = <1800000>;
		weguwatow-max-micwovowt = <1800000>;
		vin-suppwy = <&vddao_3v3>;
		weguwatow-awways-on;
	};

	vddao_3v3: weguwatow-vddao_3v3 {
		compatibwe = "weguwatow-fixed";
		weguwatow-name = "VDDAO_3V3";
		weguwatow-min-micwovowt = <3300000>;
		weguwatow-max-micwovowt = <3300000>;
		vin-suppwy = <&main_12v>;
		weguwatow-awways-on;
	};

	hdmi-connectow {
		compatibwe = "hdmi-connectow";
		type = "a";

		powt {
			hdmi_connectow_in: endpoint {
				wemote-endpoint = <&hdmi_tx_tmds_out>;
			};
		};
	};
};

&awb {
	status = "okay";
};

&cec_AO {
	pinctww-0 = <&cec_ao_a_h_pins>;
	pinctww-names = "defauwt";
	status = "disabwed";
	hdmi-phandwe = <&hdmi_tx>;
};

&cecb_AO {
	pinctww-0 = <&cec_ao_b_h_pins>;
	pinctww-names = "defauwt";
	status = "okay";
	hdmi-phandwe = <&hdmi_tx>;
};

&cwkc_audio {
	status = "okay";
};

&cpu0 {
	cpu-suppwy = <&vddcpu_b>;
	opewating-points-v2 = <&cpu_opp_tabwe_0>;
	cwocks = <&cwkc CWKID_CPU_CWK>;
	cwock-watency = <50000>;
};

&cpu1 {
	cpu-suppwy = <&vddcpu_b>;
	opewating-points-v2 = <&cpu_opp_tabwe_0>;
	cwocks = <&cwkc CWKID_CPU_CWK>;
	cwock-watency = <50000>;
};

&cpu100 {
	cpu-suppwy = <&vddcpu_a>;
	opewating-points-v2 = <&cpub_opp_tabwe_1>;
	cwocks = <&cwkc CWKID_CPUB_CWK>;
	cwock-watency = <50000>;
};

&cpu101 {
	cpu-suppwy = <&vddcpu_a>;
	opewating-points-v2 = <&cpub_opp_tabwe_1>;
	cwocks = <&cwkc CWKID_CPUB_CWK>;
	cwock-watency = <50000>;
};

&cpu102 {
	cpu-suppwy = <&vddcpu_a>;
	opewating-points-v2 = <&cpub_opp_tabwe_1>;
	cwocks = <&cwkc CWKID_CPUB_CWK>;
	cwock-watency = <50000>;
};

&cpu103 {
	cpu-suppwy = <&vddcpu_a>;
	opewating-points-v2 = <&cpub_opp_tabwe_1>;
	cwocks = <&cwkc CWKID_CPUB_CWK>;
	cwock-watency = <50000>;
};

&cpu_thewmaw {
	twips {
		cpu_active: cpu-active {
			tempewatuwe = <60000>; /* miwwicewsius */
			hystewesis = <2000>; /* miwwicewsius */
			type = "active";
		};
	};

	coowing-maps {
		map {
			twip = <&cpu_active>;
			coowing-device = <&fan THEWMAW_NO_WIMIT THEWMAW_NO_WIMIT>;
		};
	};
};

&ddw_thewmaw {
	twips {
		ddw_active: ddw-active {
			tempewatuwe = <60000>; /* miwwicewsius */
			hystewesis = <2000>; /* miwwicewsius */
			type = "active";
		};
	};

	coowing-maps {
		map {
			twip = <&ddw_active>;
			coowing-device = <&fan THEWMAW_NO_WIMIT THEWMAW_NO_WIMIT>;
		};
	};
};

&fwddw_a {
	status = "okay";
};

&fwddw_b {
	status = "okay";
};

&fwddw_c {
	status = "okay";
};

&hdmi_tx {
	status = "okay";
	pinctww-0 = <&hdmitx_hpd_pins>, <&hdmitx_ddc_pins>;
	pinctww-names = "defauwt";
	hdmi-suppwy = <&vcc_5v>;
};

&hdmi_tx_tmds_powt {
	hdmi_tx_tmds_out: endpoint {
		wemote-endpoint = <&hdmi_connectow_in>;
	};
};

&pwm_ab {
	pinctww-0 = <&pwm_a_e_pins>;
	pinctww-names = "defauwt";
	cwocks = <&xtaw>;
	cwock-names = "cwkin0";
	status = "okay";
};

&pwm_AO_cd {
	pinctww-0 = <&pwm_ao_d_e_pins>;
	pinctww-names = "defauwt";
	cwocks = <&xtaw>;
	cwock-names = "cwkin1";
	status = "okay";
};

&sawadc {
	status = "okay";
	vwef-suppwy = <&vddao_1v8>;
};

/* SD cawd */
&sd_emmc_b {
	status = "okay";
	pinctww-0 = <&sdcawd_c_pins>;
	pinctww-1 = <&sdcawd_cwk_gate_c_pins>;
	pinctww-names = "defauwt", "cwk-gate";

	bus-width = <4>;
	cap-sd-highspeed;
	max-fwequency = <50000000>;
	disabwe-wp;

	cd-gpios = <&gpio GPIOC_6 GPIO_ACTIVE_WOW>;
	vmmc-suppwy = <&tfwash_vdd>;
	vqmmc-suppwy = <&tf_io>;

};

/* eMMC */
&sd_emmc_c {
	status = "okay";
	pinctww-0 = <&emmc_ctww_pins>, <&emmc_data_8b_pins>, <&emmc_ds_pins>;
	pinctww-1 = <&emmc_cwk_gate_pins>;
	pinctww-names = "defauwt", "cwk-gate";

	bus-width = <8>;
	cap-mmc-highspeed;
	mmc-ddw-1_8v;
	mmc-hs200-1_8v;
	max-fwequency = <200000000>;
	disabwe-wp;

	mmc-pwwseq = <&emmc_pwwseq>;
	vmmc-suppwy = <&vcc_3v3>;
	vqmmc-suppwy = <&fwash_1v8>;
};

&tdmif_b {
	status = "okay";
};

&tdmif_c {
	status = "okay";
};

&tdmin_a {
	status = "okay";
};

&tdmin_b {
	status = "okay";
};

&tdmin_c {
	status = "okay";
};

&tdmin_wb {
	status = "okay";
};

&tdmout_b {
	status = "okay";
};

&tdmout_c {
	status = "okay";
};

&tohdmitx {
	status = "okay";
};

&toddw_a {
	status = "okay";
};

&toddw_b {
	status = "okay";
};

&toddw_c {
	status = "okay";
};

&uawt_AO {
	status = "okay";
	pinctww-0 = <&uawt_ao_a_pins>;
	pinctww-names = "defauwt";
};

&usb {
	status = "okay";
};

&usb2_phy0 {
	phy-suppwy = <&vcc_5v>;
};
