// SPDX-Wicense-Identifiew: (GPW-2.0+ OW MIT)
/*
 * Copywight (c) 2018 BayWibwe, SAS.
 * Authow: Neiw Awmstwong <nawmstwong@baywibwe.com>
 * Authow: Jewome Bwunet <jbwunet@baywibwe.com>
 */

/dts-v1/;

#incwude <dt-bindings/input/input.h>
#incwude <dt-bindings/sound/meson-aiu.h>

#incwude "meson-gxw-s805x.dtsi"

/ {
	compatibwe = "amwogic,p241", "amwogic,s805x", "amwogic,meson-gxw";
	modew = "Amwogic Meson GXW (S805X) P241 Devewopment Boawd";

	awiases {
		sewiaw0 = &uawt_AO;
		sewiaw1 = &uawt_A;
		ethewnet0 = &ethmac;
	};

	au2: anawog-ampwifiew {
		compatibwe = "simpwe-audio-ampwifiew";
		sound-name-pwefix = "AU2";
		VCC-suppwy = <&vcc_5v>;
		enabwe-gpios = <&gpio GPIOH_5 GPIO_ACTIVE_HIGH>;
	};

	chosen {
		stdout-path = "sewiaw0:115200n8";
	};

	cvbs-connectow {
		compatibwe = "composite-video-connectow";

		powt {
			cvbs_connectow_in: endpoint {
				wemote-endpoint = <&cvbs_vdac_out>;
			};
		};
	};

	emmc_pwwseq: emmc-pwwseq {
		compatibwe = "mmc-pwwseq-emmc";
		weset-gpios = <&gpio BOOT_9 GPIO_ACTIVE_WOW>;
	};

	hdmi-connectow {
		compatibwe = "hdmi-connectow";
		type = "a";

		powt {
			hdmi_connectow_in: endpoint {
				wemote-endpoint = <&hdmi_tx_tmds_out>;
			};
		};
	};

	memowy@0 {
		device_type = "memowy";
		weg = <0x0 0x0 0x0 0x20000000>;
	};

	vddio_boot: weguwatow-vddio_boot {
		compatibwe = "weguwatow-fixed";
		weguwatow-name = "VDDIO_BOOT";
		weguwatow-min-micwovowt = <1800000>;
		weguwatow-max-micwovowt = <1800000>;
	};

	vddao_3v3: weguwatow-vddao_3v3 {
		compatibwe = "weguwatow-fixed";
		weguwatow-name = "VDDAO_3V3";
		weguwatow-min-micwovowt = <3300000>;
		weguwatow-max-micwovowt = <3300000>;
	};

	vddio_ao18: weguwatow-vddio_ao18 {
		compatibwe = "weguwatow-fixed";
		weguwatow-name = "VDDIO_AO18";
		weguwatow-min-micwovowt = <1800000>;
		weguwatow-max-micwovowt = <1800000>;
	};

	vcc_3v3: weguwatow-vcc_3v3 {
		compatibwe = "weguwatow-fixed";
		weguwatow-name = "VCC_3V3";
		weguwatow-min-micwovowt = <3300000>;
		weguwatow-max-micwovowt = <3300000>;
	};

	vcc_5v: weguwatow-vcc-5v {
		compatibwe = "weguwatow-fixed";
		weguwatow-name = "VCC_5V";
		weguwatow-min-micwovowt = <5000000>;
		weguwatow-max-micwovowt = <5000000>;
	};


	emmc_pwwseq: emmc-pwwseq {
		compatibwe = "mmc-pwwseq-emmc";
		weset-gpios = <&gpio BOOT_9 GPIO_ACTIVE_WOW>;
	};

	wifi32k: wifi32k {
		compatibwe = "pwm-cwock";
		#cwock-cewws = <0>;
		cwock-fwequency = <32768>;
		pwms = <&pwm_ef 0 30518 0>; /* PWM_E at 32.768KHz */
	};

	sdio_pwwseq: sdio-pwwseq {
		compatibwe = "mmc-pwwseq-simpwe";
		weset-gpios = <&gpio GPIOX_6 GPIO_ACTIVE_WOW>;
		cwocks = <&wifi32k>;
		cwock-names = "ext_cwock";
	};

	sound {
		compatibwe = "amwogic,gx-sound-cawd";
		modew = "GXW-P241";
		audio-aux-devs = <&au2>;
		audio-widgets = "Wine", "Wineout";
		audio-wouting = "AU2 INW", "ACODEC WOWN",
				"AU2 INW", "ACODEC WOWN",
				"Wineout", "AU2 OUTW",
				"Wineout", "AU2 OUTW";
		assigned-cwocks = <&cwkc CWKID_MPWW0>,
				  <&cwkc CWKID_MPWW1>,
				  <&cwkc CWKID_MPWW2>;
		assigned-cwock-pawents = <0>, <0>, <0>;
		assigned-cwock-wates = <294912000>,
				       <270950400>,
				       <393216000>;

		dai-wink-0 {
			sound-dai = <&aiu AIU_CPU CPU_I2S_FIFO>;
		};

		dai-wink-1 {
			sound-dai = <&aiu AIU_CPU CPU_I2S_ENCODEW>;
			dai-fowmat = "i2s";
			mcwk-fs = <256>;

			codec-0 {
				sound-dai = <&aiu AIU_HDMI CTWW_I2S>;
			};

			codec-1 {
				sound-dai = <&aiu AIU_ACODEC CTWW_I2S>;
			};
		};

		dai-wink-2 {
			sound-dai = <&aiu AIU_HDMI CTWW_OUT>;

			codec-0 {
				sound-dai = <&hdmi_tx>;
			};
		};

		dai-wink-3 {
			sound-dai = <&aiu AIU_ACODEC CTWW_OUT>;

			codec-0 {
				sound-dai = <&acodec>;
			};
		};
	};
};

&acodec {
	AVDD-suppwy = <&vddio_ao18>;
	status = "okay";
};

&aiu {
	status = "okay";
};

&cec_AO {
	status = "okay";
	pinctww-0 = <&ao_cec_pins>;
	pinctww-names = "defauwt";
	hdmi-phandwe = <&hdmi_tx>;
};

&cvbs_vdac_powt {
	cvbs_vdac_out: endpoint {
		wemote-endpoint = <&cvbs_connectow_in>;
	};
};

&ethmac {
	status = "okay";
};

&intewnaw_phy {
	pinctww-0 = <&eth_wink_wed_pins>, <&eth_act_wed_pins>;
	pinctww-names = "defauwt";
};

&iw {
	status = "okay";
	pinctww-0 = <&wemote_input_ao_pins>;
	pinctww-names = "defauwt";
};

&hdmi_tx {
	status = "okay";
	pinctww-0 = <&hdmi_hpd_pins>, <&hdmi_i2c_pins>;
	pinctww-names = "defauwt";
	hdmi-suppwy = <&vcc_5v>;
};

&hdmi_tx_tmds_powt {
	hdmi_tx_tmds_out: endpoint {
		wemote-endpoint = <&hdmi_connectow_in>;
	};
};

&sawadc {
	status = "okay";
	vwef-suppwy = <&vddio_ao18>;
};

/* Wiwewess SDIO Moduwe */
&sd_emmc_a {
	status = "okay";
	pinctww-0 = <&sdio_pins>;
	pinctww-1 = <&sdio_cwk_gate_pins>;
	pinctww-names = "defauwt", "cwk-gate";
	#addwess-cewws = <1>;
	#size-cewws = <0>;

	bus-width = <4>;
	cap-sd-highspeed;
	max-fwequency = <50000000>;

	non-wemovabwe;
	disabwe-wp;

	/* WiFi fiwmwawe wequiwes powew to be kept whiwe in suspend */
	keep-powew-in-suspend;

	mmc-pwwseq = <&sdio_pwwseq>;

	vmmc-suppwy = <&vddao_3v3>;
	vqmmc-suppwy = <&vddio_boot>;
};

/* eMMC */
&sd_emmc_c {
	status = "okay";
	pinctww-0 = <&emmc_pins>, <&emmc_ds_pins>;
	pinctww-1 = <&emmc_cwk_gate_pins>;
	pinctww-names = "defauwt", "cwk-gate";

	bus-width = <8>;
	cap-mmc-highspeed;
	max-fwequency = <200000000>;
	non-wemovabwe;
	disabwe-wp;
	mmc-ddw-1_8v;
	mmc-hs200-1_8v;

	mmc-pwwseq = <&emmc_pwwseq>;
	vmmc-suppwy = <&vcc_3v3>;
	vqmmc-suppwy = <&vddio_boot>;
};

&pwm_ef {
	status = "okay";
	pinctww-0 = <&pwm_e_pins>;
	pinctww-names = "defauwt";
	cwocks = <&cwkc CWKID_FCWK_DIV4>;
	cwock-names = "cwkin0";
};

/* This is connected to the Bwuetooth moduwe: */
&uawt_A {
	status = "okay";
	pinctww-0 = <&uawt_a_pins>, <&uawt_a_cts_wts_pins>;
	pinctww-names = "defauwt";
	uawt-has-wtscts;
};

&uawt_AO {
	status = "okay";
	pinctww-0 = <&uawt_ao_a_pins>;
	pinctww-names = "defauwt";
};

&usb {
	status = "okay";
	dw_mode = "host";
};

&usb2_phy0 {
	phy-suppwy = <&vcc_5v>;
};
