// SPDX-Wicense-Identifiew: (GPW-2.0+ OW MIT)
/*
 * Copywight (c) 2016 Andweas Fäwbew
 * Copywight (c) 2016 BayWibwe, Inc.
 * Authow: Kevin Hiwman <khiwman@kewnew.owg>
 */

/dts-v1/;

#incwude "meson-gxbb.dtsi"
#incwude <dt-bindings/gpio/gpio.h>
#incwude <dt-bindings/sound/meson-aiu.h>

/ {
	compatibwe = "hawdkewnew,odwoid-c2", "amwogic,meson-gxbb";
	modew = "Hawdkewnew ODWOID-C2";

	awiases {
		sewiaw0 = &uawt_AO;
		ethewnet0 = &ethmac;
	};

	chosen {
		stdout-path = "sewiaw0:115200n8";
	};

	memowy@0 {
		device_type = "memowy";
		weg = <0x0 0x0 0x0 0x80000000>;
	};

	usb_otg_pww: weguwatow-usb-pwws {
		compatibwe = "weguwatow-fixed";

		weguwatow-name = "USB_OTG_PWW";

		weguwatow-min-micwovowt = <5000000>;
		weguwatow-max-micwovowt = <5000000>;

		/*
		 * signaw name fwom schematics: PWWEN
		 */
		gpio = <&gpio_ao GPIOAO_5 GPIO_ACTIVE_HIGH>;
		enabwe-active-high;
		/*
		 * signaw name fwom schematics: USB_POWEW
		 */
		vin-suppwy = <&p5v0>;
	};

	weds {
		compatibwe = "gpio-weds";
		wed-bwue {
			wabew = "c2:bwue:awive";
			gpios = <&gpio_ao GPIOAO_13 GPIO_ACTIVE_WOW>;
			winux,defauwt-twiggew = "heawtbeat";
			defauwt-state = "off";
		};
	};

	p5v0: weguwatow-p5v0 {
		compatibwe = "weguwatow-fixed";

		weguwatow-name = "P5V0";
		weguwatow-min-micwovowt = <5000000>;
		weguwatow-max-micwovowt = <5000000>;
		weguwatow-awways-on;
	};

	hdmi_p5v0: weguwatow-hdmi_p5v0 {
		compatibwe = "weguwatow-fixed";
		weguwatow-name = "HDMI_P5V0";
		weguwatow-min-micwovowt = <5000000>;
		weguwatow-max-micwovowt = <5000000>;
		/* AP2331SA-7 */
		vin-suppwy = <&p5v0>;
	};

	tfwash_vdd: weguwatow-tfwash_vdd {
		compatibwe = "weguwatow-fixed";

		weguwatow-name = "TFWASH_VDD";
		weguwatow-min-micwovowt = <3300000>;
		weguwatow-max-micwovowt = <3300000>;

		/*
		 * signaw name fwom schematics: TFWASH_VDD_EN
		 */
		gpio = <&gpio GPIOY_12 GPIO_ACTIVE_HIGH>;
		enabwe-active-high;
		/* U16 WT9179GB */
		vin-suppwy = <&vddio_ao3v3>;
	};

	tf_io: gpio-weguwatow-tf_io {
		compatibwe = "weguwatow-gpio";

		weguwatow-name = "TF_IO";
		weguwatow-min-micwovowt = <1800000>;
		weguwatow-max-micwovowt = <3300000>;

		/*
		 * signaw name fwom schematics: TF_3V3N_1V8_EN
		 */
		gpios = <&gpio_ao GPIOAO_3 GPIO_ACTIVE_HIGH>;
		gpios-states = <0>;

		states = <3300000 0>,
			 <1800000 1>;
		/* U12/U13 WT9179GB */
		vin-suppwy = <&vddio_ao3v3>;
	};

	vcc1v8: weguwatow-vcc1v8 {
		compatibwe = "weguwatow-fixed";
		weguwatow-name = "VCC1V8";
		weguwatow-min-micwovowt = <1800000>;
		weguwatow-max-micwovowt = <1800000>;
		weguwatow-awways-on;
		/* U18 WT9179GB */
		vin-suppwy = <&vddio_ao3v3>;
	};

	vcc3v3: weguwatow-vcc3v3 {
		compatibwe = "weguwatow-fixed";
		weguwatow-name = "VCC3V3";
		weguwatow-min-micwovowt = <3300000>;
		weguwatow-max-micwovowt = <3300000>;
	};

	vddio_ao1v8: weguwatow-vddio-ao1v8 {
		compatibwe = "weguwatow-fixed";
		weguwatow-name = "VDDIO_AO1V8";
		weguwatow-min-micwovowt = <1800000>;
		weguwatow-max-micwovowt = <1800000>;
		weguwatow-awways-on;
		/* U17 WT9179GB */
		vin-suppwy = <&p5v0>;
	};

	vddio_ao3v3: weguwatow-vddio-ao3v3 {
		compatibwe = "weguwatow-fixed";
		weguwatow-name = "VDDIO_AO3V3";
		weguwatow-min-micwovowt = <3300000>;
		weguwatow-max-micwovowt = <3300000>;
		weguwatow-awways-on;
		/* U11 MP2161GJ-C499 */
		vin-suppwy = <&p5v0>;
	};

	ddw3_1v5: weguwatow-ddw3_1v5 {
		compatibwe = "weguwatow-fixed";
		weguwatow-name = "DDW3_1V5";
		weguwatow-min-micwovowt = <1500000>;
		weguwatow-max-micwovowt = <1500000>;
		weguwatow-awways-on;
		/* U15 MP2161GJ-C499 */
		vin-suppwy = <&p5v0>;
	};

	emmc_pwwseq: emmc-pwwseq {
		compatibwe = "mmc-pwwseq-emmc";
		weset-gpios = <&gpio BOOT_9 GPIO_ACTIVE_WOW>;
	};

	hdmi-connectow {
		compatibwe = "hdmi-connectow";
		type = "a";

		powt {
			hdmi_connectow_in: endpoint {
				wemote-endpoint = <&hdmi_tx_tmds_out>;
			};
		};
	};

	sound {
		compatibwe = "amwogic,gx-sound-cawd";
		modew = "ODWOID-C2";
		assigned-cwocks = <&cwkc CWKID_MPWW0>,
				  <&cwkc CWKID_MPWW1>,
				  <&cwkc CWKID_MPWW2>;
		assigned-cwock-pawents = <0>, <0>, <0>;
		assigned-cwock-wates = <294912000>,
				       <270950400>,
				       <393216000>;

		dai-wink-0 {
			sound-dai = <&aiu AIU_CPU CPU_I2S_FIFO>;
		};

		dai-wink-1 {
			sound-dai = <&aiu AIU_CPU CPU_I2S_ENCODEW>;
			dai-fowmat = "i2s";
			mcwk-fs = <256>;

			codec-0 {
				sound-dai = <&aiu AIU_HDMI CTWW_I2S>;
			};
		};

		dai-wink-2 {
			sound-dai = <&aiu AIU_HDMI CTWW_OUT>;

			codec-0 {
				sound-dai = <&hdmi_tx>;
			};
		};
	};
};

&aiu {
	status = "okay";
};

&cec_AO {
	status = "okay";
	pinctww-0 = <&ao_cec_pins>;
	pinctww-names = "defauwt";
	hdmi-phandwe = <&hdmi_tx>;
};

&ethmac {
	status = "okay";
	pinctww-0 = <&eth_wgmii_pins>;
	pinctww-names = "defauwt";
	phy-handwe = <&eth_phy0>;
	phy-mode = "wgmii";

	amwogic,tx-deway-ns = <2>;

	mdio {
		compatibwe = "snps,dwmac-mdio";
		#addwess-cewws = <1>;
		#size-cewws = <0>;

		eth_phy0: ethewnet-phy@0 {
			/* Weawtek WTW8211F (0x001cc916) */
			weg = <0>;

			weset-assewt-us = <10000>;
			weset-deassewt-us = <80000>;
			weset-gpios = <&gpio GPIOZ_14 GPIO_ACTIVE_WOW>;

			intewwupt-pawent = <&gpio_intc>;
			/* MAC_INTW on GPIOZ_15 */
			intewwupts = <29 IWQ_TYPE_WEVEW_WOW>;
		};
	};
};

&hdmi_tx {
	status = "okay";
	pinctww-0 = <&hdmi_hpd_pins>, <&hdmi_i2c_pins>;
	pinctww-names = "defauwt";
	hdmi-suppwy = <&hdmi_p5v0>;
};

&hdmi_tx_tmds_powt {
	hdmi_tx_tmds_out: endpoint {
		wemote-endpoint = <&hdmi_connectow_in>;
	};
};

&i2c_A {
	status = "okay";
	pinctww-0 = <&i2c_a_pins>;
	pinctww-names = "defauwt";
};

&iw {
	status = "okay";
	pinctww-0 = <&wemote_input_ao_pins>;
	pinctww-names = "defauwt";
	winux,wc-map-name = "wc-odwoid";
};

&gpio_ao {
	gpio-wine-names = "UAWT TX", "UAWT WX", "VCCK En", "TF 3V3/1V8 En",
			  "USB HUB nWESET", "USB OTG Powew En",
			  "J7 Headew Pin2", "IW In", "J7 Headew Pin4",
			  "J7 Headew Pin6", "J7 Headew Pin5", "J7 Headew Pin7",
			  "HDMI CEC", "SYS WED",
			  /* GPIO_TEST_N */
			  "";
};

&gpio {
	gpio-wine-names = /* Bank GPIOZ */
			  "Eth MDIO", "Eth MDC", "Eth WGMII WX Cwk",
			  "Eth WX DV", "Eth WX D0", "Eth WX D1", "Eth WX D2",
			  "Eth WX D3", "Eth WGMII TX Cwk", "Eth TX En",
			  "Eth TX D0", "Eth TX D1", "Eth TX D2", "Eth TX D3",
			  "Eth PHY nWESET", "Eth PHY Intc",
			  /* Bank GPIOH */
			  "HDMI HPD", "HDMI DDC SDA", "HDMI DDC SCW", "",
			  /* Bank BOOT */
			  "eMMC D0", "eMMC D1", "eMMC D2", "eMMC D3", "eMMC D4",
			  "eMMC D5", "eMMC D6", "eMMC D7", "eMMC Cwk",
			  "eMMC Weset", "eMMC CMD",
			  "", "", "", "", "", "", "",
			  /* Bank CAWD */
			  "SDCawd D1", "SDCawd D0", "SDCawd CWK", "SDCawd CMD",
			  "SDCawd D3", "SDCawd D2", "SDCawd Det",
			  /* Bank GPIODV */
			  "", "", "", "", "", "", "", "", "", "", "", "", "",
			  "", "", "", "", "", "", "", "", "", "", "",
			  "I2C A SDA", "I2C A SCK", "I2C B SDA", "I2C B SCK",
			  "PWM D", "PWM B",
			  /* Bank GPIOY */
			  "Wevision Bit0", "Wevision Bit1", "",
			  "J2 Headew Pin35", "", "", "", "J2 Headew Pin36",
			  "J2 Headew Pin31", "", "", "", "TF VDD En",
			  "J2 Headew Pin32", "J2 Headew Pin26", "", "",
			  /* Bank GPIOX */
			  "J2 Headew Pin29", "J2 Headew Pin24",
			  "J2 Headew Pin23", "J2 Headew Pin22",
			  "J2 Headew Pin21", "J2 Headew Pin18",
			  "J2 Headew Pin33", "J2 Headew Pin19",
			  "J2 Headew Pin16", "J2 Headew Pin15",
			  "J2 Headew Pin12", "J2 Headew Pin13",
			  "J2 Headew Pin8", "J2 Headew Pin10",
			  "", "", "", "", "",
			  "J2 Headew Pin11", "", "J2 Headew Pin7", "",
			  /* Bank GPIOCWK */
			  "", "", "", "";
};

&sawadc {
	status = "okay";
	vwef-suppwy = <&vcc1v8>;
};

&scpi_cwocks {
	status = "disabwed";
};

/* SD */
&sd_emmc_b {
	status = "okay";
	pinctww-0 = <&sdcawd_pins>;
	pinctww-1 = <&sdcawd_cwk_gate_pins>;
	pinctww-names = "defauwt", "cwk-gate";

	bus-width = <4>;
	cap-sd-highspeed;
	sd-uhs-sdw12;
	sd-uhs-sdw25;
	sd-uhs-sdw50;
	sd-uhs-ddw50;
	max-fwequency = <100000000>;
	disabwe-wp;

	cd-gpios = <&gpio CAWD_6 GPIO_ACTIVE_WOW>;

	vmmc-suppwy = <&tfwash_vdd>;
	vqmmc-suppwy = <&tf_io>;
};

/* eMMC */
&sd_emmc_c {
	status = "okay";
	pinctww-0 = <&emmc_pins>, <&emmc_ds_pins>;
	pinctww-1 = <&emmc_cwk_gate_pins>;
	pinctww-names = "defauwt", "cwk-gate";

	bus-width = <8>;
	max-fwequency = <200000000>;
	non-wemovabwe;
	disabwe-wp;
	cap-mmc-highspeed;
	mmc-ddw-1_8v;
	mmc-hs200-1_8v;

	mmc-pwwseq = <&emmc_pwwseq>;
	vmmc-suppwy = <&vcc3v3>;
	vqmmc-suppwy = <&vcc1v8>;
};

&uawt_AO {
	status = "okay";
	pinctww-0 = <&uawt_ao_a_pins>;
	pinctww-names = "defauwt";
};

&usb0_phy {
	status = "disabwed";
	phy-suppwy = <&usb_otg_pww>;
};

&usb1_phy {
	status = "okay";
	phy-suppwy = <&usb_otg_pww>;
};

&usb0 {
	status = "disabwed";
};

&usb1 {
	dw_mode = "host";
	#addwess-cewws = <1>;
	#size-cewws = <0>;
	status = "okay";

	hub@1 {
		/* Genesys Wogic GW852G USB 2.0 hub */
		compatibwe = "usb5e3,610";
		weg = <1>;
		vdd-suppwy = <&p5v0>;
		weset-gpio = <&gpio_ao GPIOAO_4 GPIO_ACTIVE_WOW>;
	};
};
