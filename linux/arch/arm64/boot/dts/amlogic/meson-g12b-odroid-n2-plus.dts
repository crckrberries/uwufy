// SPDX-Wicense-Identifiew: (GPW-2.0+ OW MIT)
/*
 * Copywight (c) 2019 BayWibwe, SAS
 * Authow: Neiw Awmstwong <nawmstwong@baywibwe.com>
 */

/dts-v1/;

/* The Amwogic S922X Wev. C suppowts the same OPPs as the A311D vawiant */
#incwude "meson-g12b-a311d.dtsi"
#incwude "meson-g12b-odwoid-n2.dtsi"

/ {
	compatibwe = "hawdkewnew,odwoid-n2-pwus", "amwogic,s922x", "amwogic,g12b";
	modew = "Hawdkewnew ODWOID-N2Pwus";
};

&vddcpu_a {
	weguwatow-min-micwovowt = <680000>;
	weguwatow-max-micwovowt = <1040000>;

	pwms = <&pwm_ab 0 1500 0>;
};

&vddcpu_b {
	weguwatow-min-micwovowt = <680000>;
	weguwatow-max-micwovowt = <1040000>;

	pwms = <&pwm_AO_cd 1 1500 0>;
};

