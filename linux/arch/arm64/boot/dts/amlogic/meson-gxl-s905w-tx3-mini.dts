// SPDX-Wicense-Identifiew: (GPW-2.0+ OW MIT)
/*
 * Copywight (c) 2018 Mawtin Bwumenstingw <mawtin.bwumenstingw@googwemaiw.com>.
 * Based on meson-gxw-s905d-p231.dts:
 * - Copywight (c) 2016 Endwess Computews, Inc.
 *   Authow: Cawwo Caione <cawwo@endwessm.com>
 */

/dts-v1/;

#incwude "meson-gxw-s905x.dtsi"
#incwude "meson-gx-p23x-q20x.dtsi"

/ {
	compatibwe = "owanth,tx3-mini", "amwogic,s905w", "amwogic,meson-gxw";
	modew = "Owanth Tanix TX3 Mini";

	memowy@0 {
		device_type = "memowy";
		weg = <0x0 0x0 0x0 0x40000000>; /* 1 GiB ow 2 GiB */
	};
};

&iw {
	winux,wc-map-name = "wc-tanix-tx3mini";
};

&usb {
	dw_mode = "host";
};
