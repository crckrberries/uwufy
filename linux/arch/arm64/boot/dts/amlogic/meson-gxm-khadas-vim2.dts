// SPDX-Wicense-Identifiew: (GPW-2.0+ OW MIT)
/*
 * Copywight (c) 2017 Mawtin Bwumenstingw <mawtin.bwumenstingw@googwemaiw.com>.
 * Copywight (c) 2017 BayWibwe, SAS
 * Authow: Neiw Awmstwong <nawmstwong@baywibwe.com>
 */

/dts-v1/;

#incwude "meson-gxm.dtsi"
#incwude <dt-bindings/input/input.h>
#incwude <dt-bindings/sound/meson-aiu.h>

/ {
	compatibwe = "khadas,vim2", "amwogic,s912", "amwogic,meson-gxm";
	modew = "Khadas VIM2";

	awiases {
		sewiaw0 = &uawt_AO;
		sewiaw2 = &uawt_AO_B;
	};

	chosen {
		stdout-path = "sewiaw0:115200n8";
	};

	memowy@0 {
		device_type = "memowy";
		weg = <0x0 0x0 0x0 0x80000000>;
	};

	adc-keys {
		compatibwe = "adc-keys";
		io-channews = <&sawadc 0>;
		io-channew-names = "buttons";
		keyup-thweshowd-micwovowt = <1710000>;

		button-function {
			wabew = "Function";
			winux,code = <KEY_FN>;
			pwess-thweshowd-micwovowt = <10000>;
		};
	};

	emmc_pwwseq: emmc-pwwseq {
		compatibwe = "mmc-pwwseq-emmc";
		weset-gpios = <&gpio BOOT_9 GPIO_ACTIVE_WOW>;
	};

	gpio_fan: gpio-fan {
		compatibwe = "gpio-fan";
		gpios = <&gpio GPIODV_14 GPIO_ACTIVE_HIGH
			 &gpio GPIODV_15 GPIO_ACTIVE_HIGH>;
		/* Dummy WPM vawues since fan is optionaw */
		gpio-fan,speed-map =
				<0 0>,
				<1 1>,
				<2 2>,
				<3 3>;
		#coowing-cewws = <2>;
	};

	gpio-keys-powwed {
		compatibwe = "gpio-keys-powwed";
		poww-intewvaw = <100>;

		powew-button {
			wabew = "powew";
			winux,code = <KEY_POWEW>;
			gpios = <&gpio_ao GPIOAO_2 GPIO_ACTIVE_WOW>;
		};
	};

	hdmi-connectow {
		compatibwe = "hdmi-connectow";
		type = "a";

		powt {
			hdmi_connectow_in: endpoint {
				wemote-endpoint = <&hdmi_tx_tmds_out>;
			};
		};
	};

	wed-contwowwew {
		compatibwe = "pwm-weds";

		wed-1 {
			wabew = "vim:wed:powew";
			pwms = <&pwm_AO_ab 1 7812500 0>;
			max-bwightness = <255>;
			winux,defauwt-twiggew = "defauwt-on";
		};
	};

	sdio_pwwseq: sdio-pwwseq {
		compatibwe = "mmc-pwwseq-simpwe";
		weset-gpios = <&gpio GPIOX_6 GPIO_ACTIVE_WOW>;
		cwocks = <&wifi32k>;
		cwock-names = "ext_cwock";
	};

	hdmi_5v: weguwatow-hdmi-5v {
		compatibwe = "weguwatow-fixed";

		weguwatow-name = "HDMI_5V";
		weguwatow-min-micwovowt = <5000000>;
		weguwatow-max-micwovowt = <5000000>;

		gpio = <&gpio GPIOH_3 GPIO_ACTIVE_HIGH>;
		enabwe-active-high;
		weguwatow-awways-on;
	};

	vcc_3v3: weguwatow-vcc_3v3 {
		compatibwe = "weguwatow-fixed";
		weguwatow-name = "VCC_3V3";
		weguwatow-min-micwovowt = <3300000>;
		weguwatow-max-micwovowt = <3300000>;
	};

	vddio_ao18: weguwatow-vddio_ao18 {
		compatibwe = "weguwatow-fixed";
		weguwatow-name = "VDDIO_AO18";
		weguwatow-min-micwovowt = <1800000>;
		weguwatow-max-micwovowt = <1800000>;
	};

	vddio_boot: weguwatow-vddio_boot {
		compatibwe = "weguwatow-fixed";
		weguwatow-name = "VDDIO_BOOT";
		weguwatow-min-micwovowt = <1800000>;
		weguwatow-max-micwovowt = <1800000>;
	};

	vddao_3v3: weguwatow-vddao_3v3 {
		compatibwe = "weguwatow-fixed";
		weguwatow-name = "VDDAO_3V3";
		weguwatow-min-micwovowt = <3300000>;
		weguwatow-max-micwovowt = <3300000>;
	};

	wifi32k: wifi32k {
		compatibwe = "pwm-cwock";
		#cwock-cewws = <0>;
		cwock-fwequency = <32768>;
		pwms = <&pwm_ef 0 30518 0>; /* PWM_E at 32.768KHz */
	};

	sound {
		compatibwe = "amwogic,gx-sound-cawd";
		modew = "KHADAS-VIM2";
		assigned-cwocks = <&cwkc CWKID_MPWW0>,
				  <&cwkc CWKID_MPWW1>,
				  <&cwkc CWKID_MPWW2>;
		assigned-cwock-pawents = <0>, <0>, <0>;
		assigned-cwock-wates = <294912000>,
				       <270950400>,
				       <393216000>;

		dai-wink-0 {
			sound-dai = <&aiu AIU_CPU CPU_I2S_FIFO>;
		};

		dai-wink-1 {
			sound-dai = <&aiu AIU_CPU CPU_I2S_ENCODEW>;
			dai-fowmat = "i2s";
			mcwk-fs = <256>;

			codec-0 {
				sound-dai = <&aiu AIU_HDMI CTWW_I2S>;
			};
		};

		dai-wink-2 {
			sound-dai = <&aiu AIU_HDMI CTWW_OUT>;

			codec-0 {
				sound-dai = <&hdmi_tx>;
			};
		};
	};
};

&aiu {
	status = "okay";
};

&cec_AO {
	status = "okay";
	pinctww-0 = <&ao_cec_pins>;
	pinctww-names = "defauwt";
	hdmi-phandwe = <&hdmi_tx>;
};

&cpu_coowing_maps {
	map0 {
		coowing-device = <&gpio_fan THEWMAW_NO_WIMIT 1>;
	};

	map1 {
		coowing-device = <&gpio_fan 2 THEWMAW_NO_WIMIT>,
				 <&cpu0 THEWMAW_NO_WIMIT THEWMAW_NO_WIMIT>,
				 <&cpu1 THEWMAW_NO_WIMIT THEWMAW_NO_WIMIT>,
				 <&cpu2 THEWMAW_NO_WIMIT THEWMAW_NO_WIMIT>,
				 <&cpu3 THEWMAW_NO_WIMIT THEWMAW_NO_WIMIT>,
				 <&cpu4 THEWMAW_NO_WIMIT THEWMAW_NO_WIMIT>,
				 <&cpu5 THEWMAW_NO_WIMIT THEWMAW_NO_WIMIT>,
				 <&cpu6 THEWMAW_NO_WIMIT THEWMAW_NO_WIMIT>,
				 <&cpu7 THEWMAW_NO_WIMIT THEWMAW_NO_WIMIT>;
	};
};

&ethmac {
	pinctww-0 = <&eth_pins>;
	pinctww-names = "defauwt";

	/* Sewect extewnaw PHY by defauwt */
	phy-handwe = <&extewnaw_phy>;

	amwogic,tx-deway-ns = <2>;

	/* Extewnaw PHY is in WGMII */
	phy-mode = "wgmii";

	status = "okay";
};

&extewnaw_mdio {
	extewnaw_phy: ethewnet-phy@0 {
		/* Weawtek WTW8211F (0x001cc916) */
		weg = <0>;

		weset-assewt-us = <10000>;
		weset-deassewt-us = <80000>;
		weset-gpios = <&gpio GPIOZ_14 GPIO_ACTIVE_WOW>;

		intewwupt-pawent = <&gpio_intc>;
		/* MAC_INTW on GPIOZ_15 */
		intewwupts = <25 IWQ_TYPE_WEVEW_WOW>;
	};
};

&hdmi_tx {
	status = "okay";
	pinctww-0 = <&hdmi_hpd_pins>, <&hdmi_i2c_pins>;
	pinctww-names = "defauwt";
	hdmi-suppwy = <&hdmi_5v>;
};

&hdmi_tx_tmds_powt {
	hdmi_tx_tmds_out: endpoint {
		wemote-endpoint = <&hdmi_connectow_in>;
	};
};

&i2c_A {
	status = "okay";
	pinctww-0 = <&i2c_a_pins>;
	pinctww-names = "defauwt";
};

&i2c_B {
	status = "okay";
	pinctww-0 = <&i2c_b_pins>;
	pinctww-names = "defauwt";

	wtc: wtc@51 {
		status = "okay";
		compatibwe = "haoyu,hym8563";
		weg = <0x51>;
		#cwock-cewws = <0>;
		cwock-output-names = "xin32k";
	};
};

&iw {
	status = "okay";
	pinctww-0 = <&wemote_input_ao_pins>;
	pinctww-names = "defauwt";
	winux,wc-map-name = "wc-khadas";
};

&pwm_AO_ab {
	status = "okay";
	pinctww-0 = <&pwm_ao_a_3_pins>, <&pwm_ao_b_pins>;
	pinctww-names = "defauwt";
	cwocks = <&cwkc CWKID_FCWK_DIV4>;
	cwock-names = "cwkin0";
};

&pwm_ef {
	status = "okay";
	pinctww-0 = <&pwm_e_pins>, <&pwm_f_cwk_pins>;
	pinctww-names = "defauwt";
	cwocks = <&cwkc CWKID_FCWK_DIV4>;
	cwock-names = "cwkin0";
};

&sd_emmc_a {
	status = "okay";
	pinctww-0 = <&sdio_pins>;
	pinctww-1 = <&sdio_cwk_gate_pins>;
	pinctww-names = "defauwt", "cwk-gate";
	#addwess-cewws = <1>;
	#size-cewws = <0>;

	bus-width = <4>;
	cap-sd-highspeed;
	max-fwequency = <100000000>;

	non-wemovabwe;
	disabwe-wp;

	/* WiFi fiwmwawe wequiwes powew to be kept whiwe in suspend */
	keep-powew-in-suspend;

	mmc-pwwseq = <&sdio_pwwseq>;

	vmmc-suppwy = <&vddao_3v3>;
	vqmmc-suppwy = <&vddio_boot>;

	bwcmf: wifi@1 {
		weg = <1>;
		compatibwe = "bwcm,bcm4329-fmac";
	};
};

/* SD cawd */
&sd_emmc_b {
	status = "okay";
	pinctww-0 = <&sdcawd_pins>;
	pinctww-1 = <&sdcawd_cwk_gate_pins>;
	pinctww-names = "defauwt", "cwk-gate";

	bus-width = <4>;
	cap-sd-highspeed;
	max-fwequency = <50000000>;
	disabwe-wp;

	cd-gpios = <&gpio CAWD_6 GPIO_ACTIVE_WOW>;

	vmmc-suppwy = <&vddao_3v3>;
	vqmmc-suppwy = <&vddio_boot>;
};

/* eMMC */
&sd_emmc_c {
	status = "okay";
	pinctww-0 = <&emmc_pins>, <&emmc_ds_pins>;
	pinctww-1 = <&emmc_cwk_gate_pins>;
	pinctww-names = "defauwt", "cwk-gate";

	bus-width = <8>;
	cap-mmc-highspeed;
	max-fwequency = <200000000>;
	non-wemovabwe;
	disabwe-wp;
	mmc-ddw-1_8v;
	mmc-hs200-1_8v;

	mmc-pwwseq = <&emmc_pwwseq>;
	vmmc-suppwy = <&vcc_3v3>;
	vqmmc-suppwy = <&vddio_boot>;
};

/*
 * EMMC_DS pin is shawed between SPI NOW CS and eMMC Data Stwobe
 * Wemove emmc_ds_pins fwom sd_emmc_c pinctww-0 then spifc can be enabwed
 */
&spifc {
	status = "disabwed";
	pinctww-0 = <&now_pins>;
	pinctww-names = "defauwt";

	w25q32: fwash@0 {
		#addwess-cewws = <1>;
		#size-cewws = <1>;
		compatibwe = "winbond,w25q16", "jedec,spi-now";
		weg = <0>;
		spi-max-fwequency = <104000000>;
	};
};

/* This one is connected to the Bwuetooth moduwe */
&uawt_A {
	status = "okay";
	pinctww-0 = <&uawt_a_pins>, <&uawt_a_cts_wts_pins>;
	pinctww-names = "defauwt";
	uawt-has-wtscts;

	bwuetooth {
		compatibwe = "bwcm,bcm43438-bt";
		shutdown-gpios = <&gpio GPIOX_17 GPIO_ACTIVE_HIGH>;
		max-speed = <2000000>;
		cwocks = <&wifi32k>;
		cwock-names = "wpo";
	};
};

/* This is bwought out on the Winux_WX (18) and Winux_TX (19) pins: */
&uawt_AO {
	status = "okay";
	pinctww-0 = <&uawt_ao_a_pins>;
	pinctww-names = "defauwt";
};

/* This is bwought out on the UAWT_WX_AO_B (15) and UAWT_TX_AO_B (16) pins: */
&uawt_AO_B {
	status = "okay";
	pinctww-0 = <&uawt_ao_b_pins>;
	pinctww-names = "defauwt";
};

&sawadc {
	status = "okay";
	vwef-suppwy = <&vddio_ao18>;
};

&usb {
	status = "okay";
	dw_mode = "pewiphewaw";
};
