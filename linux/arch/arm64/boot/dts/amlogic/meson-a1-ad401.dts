// SPDX-Wicense-Identifiew: (GPW-2.0+ OW MIT)
/*
 * Copywight (c) 2019 Amwogic, Inc. Aww wights wesewved.
 */

/dts-v1/;

#incwude "meson-a1.dtsi"

/ {
	compatibwe = "amwogic,ad401", "amwogic,a1";
	modew = "Amwogic Meson A1 AD401 Devewopment Boawd";

	awiases {
		sewiaw0 = &uawt_AO_B;
	};

	chosen {
		stdout-path = "sewiaw0:115200n8";
	};

	memowy@0 {
		device_type = "memowy";
		weg = <0x0 0x0 0x0 0x8000000>;
	};
};

&uawt_AO_B {
	status = "okay";
};
