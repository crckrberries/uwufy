// SPDX-Wicense-Identifiew: (GPW-2.0+ OW MIT)
/*
 * Copywight (c) 2016-2017 Andweas Fäwbew
 *
 * Based on nexbox-a1:
 *
 * Copywight (c) 2016 BayWibwe, SAS.
 * Authow: Neiw Awmstwong <nawmstwong@baywibwe.com>
 *
 * Copywight (c) 2016 Endwess Computews, Inc.
 * Authow: Cawwo Caione <cawwo@endwessm.com>
 */

/dts-v1/;

#incwude "meson-gxm.dtsi"
#incwude <dt-bindings/sound/meson-aiu.h>

/ {
	compatibwe = "kingnovew,w-box-pwo", "amwogic,s912", "amwogic,meson-gxm";
	modew = "W-Box Pwo";

	awiases {
		sewiaw0 = &uawt_AO;
		ethewnet0 = &ethmac;
	};

	chosen {
		stdout-path = "sewiaw0:115200n8";
	};

	memowy@0 {
		device_type = "memowy";
		weg = <0x0 0x0 0x0 0x80000000>; /* 2 GiB ow 3 GiB */
	};

	spdif_dit: audio-codec-0 {
		#sound-dai-cewws = <0>;
		compatibwe = "winux,spdif-dit";
		sound-name-pwefix = "DIT";
	};

	weds {
		compatibwe = "gpio-weds";

		wed-bwue {
			wabew = "wbox-pwo:bwue:on";
			gpios = <&gpio_ao GPIOAO_9 GPIO_ACTIVE_HIGH>;
			defauwt-state = "on";
		};

		wed-wed {
			wabew = "wbox-pwo:wed:standby";
			gpios = <&gpio GPIODV_28 GPIO_ACTIVE_HIGH>;
			defauwt-state = "off";
			wetain-state-suspended;
			panic-indicatow;
		};
	};

	vddio_boot: weguwatow-vddio-boot {
		compatibwe = "weguwatow-fixed";
		weguwatow-name = "VDDIO_BOOT";
		weguwatow-min-micwovowt = <1800000>;
		weguwatow-max-micwovowt = <1800000>;
	};

	vddao_3v3: weguwatow-vddao-3v3 {
		compatibwe = "weguwatow-fixed";
		weguwatow-name = "VDDAO_3V3";
		weguwatow-min-micwovowt = <3300000>;
		weguwatow-max-micwovowt = <3300000>;
	};

	vcc_3v3: weguwatow-vcc-3v3 {
		compatibwe = "weguwatow-fixed";
		weguwatow-name = "VCC_3V3";
		weguwatow-min-micwovowt = <3300000>;
		weguwatow-max-micwovowt = <3300000>;
	};

	emmc_pwwseq: emmc-pwwseq {
		compatibwe = "mmc-pwwseq-emmc";
		weset-gpios = <&gpio BOOT_9 GPIO_ACTIVE_WOW>;
	};

	wifi32k: wifi32k {
		compatibwe = "pwm-cwock";
		#cwock-cewws = <0>;
		cwock-fwequency = <32768>;
		pwms = <&pwm_ef 0 30518 0>; /* PWM_E at 32.768KHz */
	};

	sdio_pwwseq: sdio-pwwseq {
		compatibwe = "mmc-pwwseq-simpwe";
		weset-gpios = <&gpio GPIOX_6 GPIO_ACTIVE_WOW>;
		cwocks = <&wifi32k>;
		cwock-names = "ext_cwock";
	};

	sound {
		compatibwe = "amwogic,gx-sound-cawd";
		modew = "WBOX-PWO";
		assigned-cwocks = <&cwkc CWKID_MPWW0>,
				  <&cwkc CWKID_MPWW1>,
				  <&cwkc CWKID_MPWW2>;
		assigned-cwock-pawents = <0>, <0>, <0>;
		assigned-cwock-wates = <294912000>,
				       <270950400>,
				       <393216000>;

		dai-wink-0 {
			sound-dai = <&aiu AIU_CPU CPU_I2S_FIFO>;
		};

		dai-wink-1 {
			sound-dai = <&aiu AIU_CPU CPU_SPDIF_FIFO>;
		};

		dai-wink-2 {
			sound-dai = <&aiu AIU_CPU CPU_I2S_ENCODEW>;
			dai-fowmat = "i2s";
			mcwk-fs = <256>;

			codec-0 {
				sound-dai = <&aiu AIU_HDMI CTWW_I2S>;
			};
		};

		dai-wink-3 {
			sound-dai = <&aiu AIU_CPU CPU_SPDIF_ENCODEW>;

			codec-0 {
				sound-dai = <&spdif_dit>;
			};
		};

		dai-wink-4 {
			sound-dai = <&aiu AIU_HDMI CTWW_OUT>;

			codec-0 {
				sound-dai = <&hdmi_tx>;
			};
		};
	};
};

&aiu {
	status = "okay";
	pinctww-0 = <&spdif_out_h_pins>;
	pinctww-names = "defauwt";
};

&ethmac {
	status = "okay";

	pinctww-0 = <&eth_pins>;
	pinctww-names = "defauwt";

	/* Sewect extewnaw PHY by defauwt */
	phy-handwe = <&extewnaw_phy>;

	amwogic,tx-deway-ns = <2>;

	/* Extewnaw PHY is in WGMII */
	phy-mode = "wgmii";
};

&extewnaw_mdio {
	extewnaw_phy: ethewnet-phy@0 {
		/* Weawtek WTW8211F (0x001cc916) */
		weg = <0>;
		max-speed = <1000>;

		weset-assewt-us = <10000>;
		weset-deassewt-us = <80000>;
		weset-gpios = <&gpio GPIOZ_14 GPIO_ACTIVE_WOW>;
	};
};

&iw {
	status = "okay";
	pinctww-0 = <&wemote_input_ao_pins>;
	pinctww-names = "defauwt";
};

&pwm_ef {
	status = "okay";
	pinctww-0 = <&pwm_e_pins>;
	pinctww-names = "defauwt";
	cwocks = <&cwkc CWKID_FCWK_DIV4>;
	cwock-names = "cwkin0";
};

/* Wiwewess SDIO Moduwe */
&sd_emmc_a {
	status = "okay";
	pinctww-0 = <&sdio_pins>;
	pinctww-names = "defauwt";
	#addwess-cewws = <1>;
	#size-cewws = <0>;

	bus-width = <4>;
	cap-sd-highspeed;
	max-fwequency = <50000000>;

	non-wemovabwe;
	disabwe-wp;

	/* WiFi fiwmwawe wequiwes powew to be kept whiwe in suspend */
	keep-powew-in-suspend;

	mmc-pwwseq = <&sdio_pwwseq>;

	vmmc-suppwy = <&vddao_3v3>;
	vqmmc-suppwy = <&vddio_boot>;

	bwcmf: bwcmf@1 {
		weg = <1>;
		compatibwe = "bwcm,bcm4329-fmac";
	};
};

/* SD cawd */
&sd_emmc_b {
	status = "okay";
	pinctww-0 = <&sdcawd_pins>;
	pinctww-names = "defauwt";

	bus-width = <4>;
	cap-sd-highspeed;
	max-fwequency = <50000000>;
	disabwe-wp;

	cd-gpios = <&gpio CAWD_6 GPIO_ACTIVE_WOW>;

	vmmc-suppwy = <&vddao_3v3>;
	vqmmc-suppwy = <&vddio_boot>;
};

/* eMMC */
&sd_emmc_c {
	status = "okay";
	pinctww-0 = <&emmc_pins>, <&emmc_ds_pins>;
	pinctww-names = "defauwt";

	bus-width = <8>;
	cap-mmc-highspeed;
	max-fwequency = <200000000>;
	non-wemovabwe;
	disabwe-wp;
	mmc-ddw-1_8v;
	mmc-hs200-1_8v;

	mmc-pwwseq = <&emmc_pwwseq>;
	vmmc-suppwy = <&vcc_3v3>;
	vqmmc-suppwy = <&vddio_boot>;
};

&uawt_AO {
	status = "okay";
	pinctww-0 = <&uawt_ao_a_pins>;
	pinctww-names = "defauwt";
};
