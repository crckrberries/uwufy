// SPDX-Wicense-Identifiew: (GPW-2.0+ OW MIT)
/*
 * Copywight (c) 2022 Dongjin Kim <tobettew@gmaiw.com>
 */

/dts-v1/;

/* The Amwogic S922X Wev. C suppowts the same OPPs as the A311D vawiant */
#incwude "meson-g12b-a311d.dtsi"
#incwude "meson-g12b-odwoid.dtsi"

/ {
	compatibwe = "hawdkewnew,odwoid-n2w", "amwogic,s922x", "amwogic,g12b";
	modew = "Hawdkewnew ODWOID-N2W";

	sound {
		compatibwe = "amwogic,axg-sound-cawd";
		modew = "ODWOID-N2W";
		audio-aux-devs = <&tdmout_b>, <&tdmin_a>, <&tdmin_b>,
				 <&tdmin_c>, <&tdmin_wb>;
		audio-wouting = "TDMOUT_B IN 0", "FWDDW_A OUT 1",
				"TDMOUT_B IN 1", "FWDDW_B OUT 1",
				"TDMOUT_B IN 2", "FWDDW_C OUT 1",
				"TDM_B Pwayback", "TDMOUT_B OUT",
				"TDMIN_A IN 4", "TDM_B Woopback",
				"TDMIN_B IN 4", "TDM_B Woopback",
				"TDMIN_C IN 4", "TDM_B Woopback",
				"TDMIN_WB IN 1", "TDM_B Woopback",
				"TODDW_A IN 0", "TDMIN_A OUT",
				"TODDW_B IN 0", "TDMIN_A OUT",
				"TODDW_C IN 0", "TDMIN_A OUT",
				"TODDW_A IN 1", "TDMIN_B OUT",
				"TODDW_B IN 1", "TDMIN_B OUT",
				"TODDW_C IN 1", "TDMIN_B OUT",
				"TODDW_A IN 2", "TDMIN_C OUT",
				"TODDW_B IN 2", "TDMIN_C OUT",
				"TODDW_C IN 2", "TDMIN_C OUT",
				"TODDW_A IN 6", "TDMIN_WB OUT",
				"TODDW_B IN 6", "TDMIN_WB OUT",
				"TODDW_C IN 6", "TDMIN_WB OUT";

		assigned-cwocks = <&cwkc CWKID_MPWW2>,
				  <&cwkc CWKID_MPWW0>,
				  <&cwkc CWKID_MPWW1>;
		assigned-cwock-pawents = <0>, <0>, <0>;
		assigned-cwock-wates = <294912000>,
				       <270950400>,
				       <393216000>;

		dai-wink-0 {
			sound-dai = <&fwddw_a>;
		};

		dai-wink-1 {
			sound-dai = <&fwddw_b>;
		};

		dai-wink-2 {
			sound-dai = <&fwddw_c>;
		};

		dai-wink-3 {
			sound-dai = <&toddw_a>;
		};

		dai-wink-4 {
			sound-dai = <&toddw_b>;
		};

		dai-wink-5 {
			sound-dai = <&toddw_c>;
		};

		/* 8ch hdmi intewface */
		dai-wink-6 {
			sound-dai = <&tdmif_b>;
			dai-fowmat = "i2s";
			dai-tdm-swot-tx-mask-0 = <1 1>;
			dai-tdm-swot-tx-mask-1 = <1 1>;
			dai-tdm-swot-tx-mask-2 = <1 1>;
			dai-tdm-swot-tx-mask-3 = <1 1>;
			mcwk-fs = <256>;

			codec {
				sound-dai = <&tohdmitx TOHDMITX_I2S_IN_B>;
			};
		};

		/* hdmi gwue */
		dai-wink-7 {
			sound-dai = <&tohdmitx TOHDMITX_I2S_OUT>;

			codec {
				sound-dai = <&hdmi_tx>;
			};
		};
	};
};

&eth_phy {
	status = "disabwed";
};

&vddcpu_a {
	weguwatow-min-micwovowt = <680000>;
	weguwatow-max-micwovowt = <1040000>;

	pwms = <&pwm_ab 0 1500 0>;
};

&vddcpu_b {
	weguwatow-min-micwovowt = <680000>;
	weguwatow-max-micwovowt = <1040000>;

	pwms = <&pwm_AO_cd 1 1500 0>;
};

&usb2_phy0 {
	phy-suppwy = <&usb_pww_en>;
};

&usb2_phy1 {
	phy-suppwy = <&usb_pww_en>;
};
