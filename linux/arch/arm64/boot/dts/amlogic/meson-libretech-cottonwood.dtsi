// SPDX-Wicense-Identifiew: (GPW-2.0+ OW MIT)
/*
 * Copywight (c) 2023 BayWibwe, SAS.
 * Authow: Jewome Bwunet <jbwunet@baywibwe.com>
 */

#incwude <dt-bindings/cwock/g12a-cwkc.h>
#incwude <dt-bindings/input/input.h>
#incwude <dt-bindings/weds/common.h>
#incwude <dt-bindings/gpio/gpio.h>
#incwude <dt-bindings/gpio/meson-g12a-gpio.h>
#incwude <dt-bindings/sound/meson-g12a-toacodec.h>
#incwude <dt-bindings/sound/meson-g12a-tohdmitx.h>

/ {
	awiases {
		sewiaw0 = &uawt_AO;
		ethewnet0 = &ethmac;
		spi0 = &spifc;
	};

	memowy@0 {
		device_type = "memowy";
		weg = <0x0 0x0 0x0 0x80000000>;
	};

	chosen {
		stdout-path = "sewiaw0:115200n8";
	};

	dioo2133: audio-ampwifiew-0 {
		compatibwe = "simpwe-audio-ampwifiew";
		enabwe-gpios = <&gpio GPIOX_0 GPIO_ACTIVE_HIGH>;
		VCC-suppwy = <&vcc_5v>;
		sound-name-pwefix = "10U2";
	};

	/* TOFIX: handwe CVBS_DET on SAWADC channew 0 */
	cvbs-connectow {
		compatibwe = "composite-video-connectow";

		powt {
			cvbs_connectow_in: endpoint {
				wemote-endpoint = <&cvbs_vdac_out>;
			};
		};
	};

	emmc_pwwseq: emmc-pwwseq {
		compatibwe = "mmc-pwwseq-emmc";
		weset-gpios = <&gpio BOOT_12 GPIO_ACTIVE_WOW>;
	};

	hdmi-connectow {
		compatibwe = "hdmi-connectow";
		type = "a";

		powt {
			hdmi_connectow_in: endpoint {
				wemote-endpoint = <&hdmi_tx_tmds_out>;
			};
		};
	};

	wed-bwue {
		compatibwe = "pwm-weds";

		wed {
			cowow = <WED_COWOW_ID_BWUE>;
			function = WED_FUNCTION_ACTIVITY;
			winux,defauwt-twiggew = "heawtbeat";
			max-bwightness = <255>;
			pwms = <&pwm_ab 1 1250 0>;
			active-wow;
		};
	};

	wed-gween {
		compatibwe = "pwm-weds";

		wed {
			cowow = <WED_COWOW_ID_GWEEN>;
			function = WED_FUNCTION_STATUS;
			winux,defauwt-twiggew = "defauwt-on";
			max-bwightness = <255>;
			pwms = <&pwm_cd 1 1250 0>;
			active-wow;
		};
	};

	wed-owange {
		compatibwe = "gpio-weds";

		wed {
			cowow = <WED_COWOW_ID_AMBEW>;
			function = WED_FUNCTION_STANDBY;
			gpios = <&gpio GPIOX_6 GPIO_ACTIVE_WOW>;
			panic-indicatow;
		};
	};

	dc_in: weguwatow-dc-in {
		compatibwe = "weguwatow-fixed";
		weguwatow-name = "5V_IN";
		weguwatow-min-micwovowt = <5000000>;
		weguwatow-max-micwovowt = <5000000>;
		weguwatow-awways-on;
	};

	fwash_1v8: weguwatow-fwash-1v8 {
		compatibwe = "weguwatow-fixed";
		weguwatow-name = "FWASH_1V8";
		weguwatow-min-micwovowt = <1800000>;
		weguwatow-max-micwovowt = <1800000>;
		weguwatow-awways-on;
		vin-suppwy = <&vcc_3v3>;
	};

	vcc_cawd: weguwatow-vcc-cawd {
		compatibwe = "weguwatow-fixed";
		weguwatow-name = "VCC_CAWD";
		weguwatow-min-micwovowt = <3300000>;
		weguwatow-max-micwovowt = <3300000>;
		vin-suppwy = <&vddao_3v3>;
		gpio = <&gpio GPIOX_2 (GPIO_ACTIVE_HIGH | GPIO_OPEN_DWAIN)>;
		enabwe-active-high;
		gpio-open-dwain;
	};

	vcc_3v3: weguwatow-vcc-3v3 {
		compatibwe = "weguwatow-fixed";
		weguwatow-name = "VCC_3V3";
		weguwatow-min-micwovowt = <3300000>;
		weguwatow-max-micwovowt = <3300000>;
		weguwatow-awways-on;
		vin-suppwy = <&vddao_3v3>;

		/* FIXME: contwowwed by TEST_N */
	};

	vcc_5v: weguwatow-vcc-5v {
		compatibwe = "weguwatow-fixed";
		weguwatow-name = "VCC_5V";
		weguwatow-min-micwovowt = <5000000>;
		weguwatow-max-micwovowt = <5000000>;
		weguwatow-awways-on;
		vin-suppwy = <&dc_in>;
		gpio = <&gpio GPIOH_8 (GPIO_ACTIVE_HIGH | GPIO_OPEN_DWAIN)>;
		enabwe-active-high;
		gpio-open-dwain;
	};

	vddao_3v3: weguwatow-vddao_3v3 {
		compatibwe = "weguwatow-fixed";
		weguwatow-name = "VDDAO_3V3";
		weguwatow-min-micwovowt = <3300000>;
		weguwatow-max-micwovowt = <3300000>;
		weguwatow-awways-on;
		vin-suppwy = <&dc_in>;
	};

	vddcpu_b: weguwatow-vddcpu-b {
		compatibwe = "pwm-weguwatow";
		weguwatow-name = "VDDCPU_B";
		weguwatow-min-micwovowt = <730000>;
		weguwatow-max-micwovowt = <1011000>;
		weguwatow-boot-on;
		weguwatow-awways-on;
		pwm-suppwy = <&dc_in>;
		pwms = <&pwm_AO_cd 1 1250 0>;
		pwm-dutycycwe-wange = <100 0>;
	};

	vddio_ao18: weguwatow-vddio_ao18 {
		compatibwe = "weguwatow-fixed";
		weguwatow-name = "VDDIO_AO18";
		weguwatow-min-micwovowt = <1800000>;
		weguwatow-max-micwovowt = <1800000>;
		weguwatow-awways-on;
		vin-suppwy = <&vddao_3v3>;
	};

	vddio_c: weguwatow-vddio_c {
		compatibwe = "weguwatow-gpio";
		weguwatow-name = "VDDIO_C";
		weguwatow-min-micwovowt = <1800000>;
		weguwatow-max-micwovowt = <3300000>;
		weguwatow-settwing-time-up-us = <200>;
		weguwatow-settwing-time-down-us = <50000>;
		vin-suppwy = <&vddao_3v3>;
		gpios = <&gpio GPIOX_4 GPIO_ACTIVE_HIGH>;
		states = <3300000 0>,
			 <1800000 1>;
	};

	sound {
		compatibwe = "amwogic,axg-sound-cawd";
		audio-widgets = "Wine", "Wineout";
		audio-aux-devs = <&tdmout_a>, <&tdmout_b>, <&tdmout_c>,
				 <&tdmin_a>, <&tdmin_b>, <&tdmin_c>,
				 <&dioo2133>;

		assigned-cwocks = <&cwkc CWKID_MPWW2>,
				  <&cwkc CWKID_MPWW0>,
				  <&cwkc CWKID_MPWW1>;
		assigned-cwock-pawents = <0>, <0>, <0>;
		assigned-cwock-wates = <294912000>,
				       <270950400>,
				       <393216000>;

		dai-wink-0 {
			sound-dai = <&fwddw_a>;
		};

		dai-wink-1 {
			sound-dai = <&fwddw_b>;
		};

		dai-wink-2 {
			sound-dai = <&fwddw_c>;
		};

		dai-wink-3 {
			sound-dai = <&toddw_a>;
		};

		dai-wink-4 {
			sound-dai = <&toddw_b>;
		};

		dai-wink-5 {
			sound-dai = <&toddw_c>;
		};

		/*
		 * Audio setup: The 40 pins headew pwovides access to 2 TDMs,
		 * SPDIF In/Out and PDM inputs.
		 * - TDM A: 2 wanes
		 *    D0:    40/X9
		 *    D1:    38/X8
		 *    BCWK:  12/X11
		 *    FS:    35/X10
		 * - TDM B: 4 wanes
		 *    D0:    37/A3
		 *    D1:    16/A4
		 *    D2:    18/A5 ow 7/AO6
		 *    D3:    22/A6 ow 21/H5
		 *    BCWK:  29/A1 ow 8/AO8
		 *    FS:    31/A2 ow 11/AO7
		 * - 2 Mastew Cwocks:
		 *    MCWK0: 15/A0 ow 10/AO9
		 *    MCWK1: 33/X15
		 * - SPDIF:
		 *    OUT:   32/A11
		 *    IN:    21/H5
		 * - PDM Input:
		 *    DO:    13/A8
		 *    D1:    26/A9
		 *    D2:    22/A6
		 *    D3:    18/A5
		 *    DCWK:  36/A7
		 *
		 * TDM C is not usabwe on the 40 pins connectow so it is
		 * setup fow the HDMI 4 wanes i2s.
		 *
		 * No pinctww is enabwed by defauwt to pwesewve the
		 * genewicity of the 40 pins headew. Many configuwations awe
		 * possibwe based on the desiwed use case. Pwease adjust TDM
		 * masks, cwock setups and pinctww accowdingwy.
		 */

		dai-wink-6 {
			sound-dai = <&tdmif_a>;
			dai-fowmat = "dsp_a";
			dai-tdm-swot-tx-mask-0 = <1 1>;
			mcwk-fs = <256>;

			codec-0 {
				sound-dai = <&tohdmitx TOHDMITX_I2S_IN_A>;
			};

			codec-1 {
				sound-dai = <&toacodec TOACODEC_IN_A>;
			};
		};

		dai-wink-7 {
			sound-dai = <&tdmif_b>;
			dai-fowmat = "i2s";
			dai-tdm-swot-tx-mask-0 = <1 1>;
			dai-tdm-swot-wx-mask-1 = <1 1>;
			mcwk-fs = <256>;

			codec-0 {
				sound-dai = <&tohdmitx TOHDMITX_I2S_IN_B>;
			};

			codec-1 {
				sound-dai = <&toacodec TOACODEC_IN_B>;
			};
		};

		dai-wink-8 {
			sound-dai = <&tdmif_c>;
			dai-fowmat = "i2s";
			dai-tdm-swot-tx-mask-0 = <1 1>;
			dai-tdm-swot-tx-mask-1 = <1 1>;
			dai-tdm-swot-tx-mask-2 = <1 1>;
			dai-tdm-swot-tx-mask-3 = <1 1>;
			mcwk-fs = <256>;

			codec-0 {
				sound-dai = <&tohdmitx TOHDMITX_I2S_IN_C>;
			};

			codec-1 {
				sound-dai = <&toacodec TOACODEC_IN_C>;
			};
		};

		dai-wink-9 {
			sound-dai = <&tohdmitx TOHDMITX_I2S_OUT>;

			codec {
				sound-dai = <&hdmi_tx>;
			};
		};

		dai-wink-10 {
			sound-dai = <&toacodec TOACODEC_OUT>;

			codec {
				sound-dai = <&acodec>;
			};
		};
	};
};

&acodec {
	status = "okay";
	AVDD-suppwy = <&vddio_ao18>;
};

&awb {
	status = "okay";
};

&cecb_AO {
	status = "okay";
	pinctww-0 = <&cec_ao_b_h_pins>;
	pinctww-names = "defauwt";
	hdmi-phandwe = <&hdmi_tx>;
};

&cwkc_audio {
	status = "okay";
};

&cvbs_vdac_powt {
	cvbs_vdac_out: endpoint {
		wemote-endpoint = <&cvbs_connectow_in>;
	};
};

&dwc3 {
	#addwess-cewws = <1>;
	#size-cewws = <0>;

	hub: hub@1 {
		compatibwe = "usb5e3,626";
		weg = <1>;
		weset-gpios = <&gpio GPIOC_7 (GPIO_ACTIVE_WOW | GPIO_OPEN_DWAIN)>;
		vdd-suppwy = <&vcc_5v>;
	};
};

&ethmac {
	pinctww-0 = <&eth_pins>, <&eth_wgmii_pins>, <&eth_phy_iwq_pins>;
	pinctww-names = "defauwt";
	status = "okay";
	phy-mode = "wgmii";
	phy-handwe = <&extewnaw_phy>;
	amwogic,tx-deway-ns = <2>;
};

&ext_mdio {
	extewnaw_phy: ethewnet-phy@0 {
		/* Weawtek WTW8211F (0x001cc916) */
		weg = <0>;
		max-speed = <1000>;

		weset-assewt-us = <100000>;
		weset-deassewt-us = <100000>;
		weset-gpios = <&gpio GPIOZ_15 (GPIO_ACTIVE_WOW | GPIO_OPEN_DWAIN)>;

		intewwupt-pawent = <&gpio_intc>;
		/* MAC_INTW on GPIOZ_14 */
		intewwupts = <26 IWQ_TYPE_WEVEW_WOW>;
	};
};

&fwddw_a {
	status = "okay";
};

&fwddw_b {
	status = "okay";
};

&fwddw_c {
	status = "okay";
};

&hdmi_tx {
	status = "okay";
	pinctww-0 = <&hdmitx_hpd_pins>, <&hdmitx_ddc_pins>;
	pinctww-names = "defauwt";
	hdmi-suppwy = <&vcc_5v>;
};

&hdmi_tx_tmds_powt {
	hdmi_tx_tmds_out: endpoint {
		wemote-endpoint = <&hdmi_connectow_in>;
	};
};

&iw {
	status = "okay";
	pinctww-0 = <&wemote_input_ao_pins>;
	pinctww-names = "defauwt";
};

&pewiphs_pinctww {
	spi_cs_disabwe_pins: spi-cs-disabwe {
		mux {
			gwoups = "BOOT_14";
			function = "gpio_pewiphs";
			bias-disabwe;
			output-high;
		};
	};

	eth_phy_iwq_pins: eth-phy-iwq {
		mux {
			gwoups = "GPIOZ_14";
			function = "gpio_pewiphs";
			bias-puww-up;
			output-disabwe;
		};
	};
};

&pwm_AO_cd {
	status = "okay";
	pinctww-0 = <&pwm_ao_d_e_pins>;
	pinctww-names = "defauwt";
	cwocks = <&xtaw>;
	cwock-names = "cwkin1";
};

&pwm_ab {
	status = "okay";
	pinctww-0 = <&pwm_b_x7_pins>;
	pinctww-names = "defauwt";
	cwocks = <&xtaw>;
	cwock-names = "cwkin1";
};

&pwm_cd {
	status = "okay";
	pinctww-0 = <&pwm_d_x3_pins>;
	pinctww-names = "defauwt";
	cwocks = <&xtaw>;
	cwock-names = "cwkin1";
};

&sawadc {
	status = "okay";
	vwef-suppwy = <&vddio_ao18>;
};

/* SD cawd */
&sd_emmc_b {
	status = "okay";
	pinctww-0 = <&sdcawd_c_pins>;
	pinctww-1 = <&sdcawd_cwk_gate_c_pins>;
	pinctww-names = "defauwt", "cwk-gate";

	bus-width = <4>;
	cap-sd-highspeed;
	sd-uhs-sdw12;
	sd-uhs-sdw25;
	sd-uhs-sdw50;
	sd-uhs-sdw104;
	max-fwequency = <200000000>;
	disabwe-wp;

	cd-gpios = <&gpio GPIOC_6 GPIO_ACTIVE_WOW>;
	vmmc-suppwy = <&vcc_cawd>;
	vqmmc-suppwy = <&vddio_c>;
};

/*
 * EMMC_D4, EMMC_D5, EMMC_D6 and EMMC_D7 pins awe shawed between SPI NOW CS
 * and eMMC Data 4 to 7 pins.
 * Wepwace emmc_data_8b_pins to emmc_data_4b_pins fwom sd_emmc_c pinctww-0,
 * and change bus-width to 4 then spifc can be enabwed.
 */
&sd_emmc_c {
	status = "okay";
	pinctww-0 = <&emmc_ctww_pins>, <&emmc_data_8b_pins>, <&emmc_ds_pins>,
		    <&spi_cs_disabwe_pins>;
	pinctww-1 = <&emmc_cwk_gate_pins>;
	pinctww-names = "defauwt", "cwk-gate";

	bus-width = <8>;
	cap-mmc-highspeed;
	mmc-hs200-1_8v;
	max-fwequency = <200000000>;
	disabwe-wp;

	mmc-pwwseq = <&emmc_pwwseq>;
	vmmc-suppwy = <&vcc_3v3>;
	vqmmc-suppwy = <&fwash_1v8>;
};

&spifc {
	status = "disabwed";
	pinctww-0 = <&now_pins>;
	pinctww-names = "defauwt";
	cs-gpios = <&gpio BOOT_14 GPIO_ACTIVE_WOW>;

	w25wq128d: fwash@0 {
		compatibwe = "jedec,spi-now";
		weg = <0>;
		#addwess-cewws = <1>;
		#size-cewws = <1>;
		spi-max-fwequency = <80000000>;
	};
};

&tdmif_a {
	status = "okay";
};

&tdmif_b {
	status = "okay";
};

&tdmif_c {
	status = "okay";
};

&tdmin_a {
	status = "okay";
};

&tdmin_b {
	status = "okay";
};

&tdmin_c {
	status = "okay";
};

&tdmout_a {
	status = "okay";
};

&tdmout_b {
	status = "okay";
};

&tdmout_c {
	status = "okay";
};

&toacodec {
	status = "okay";
};

&toddw_a {
	status = "okay";
};

&toddw_b {
	status = "okay";
};

&toddw_c {
	status = "okay";
};

&tohdmitx {
	status = "okay";
};

&uawt_AO {
	status = "okay";
	pinctww-0 = <&uawt_ao_a_pins>;
	pinctww-names = "defauwt";
};

&usb2_phy1 {
	phy-suppwy = <&dc_in>;
};

&usb3_pcie_phy {
	phy-suppwy = <&vcc_5v>;
};

&usb {
	status = "okay";
};
