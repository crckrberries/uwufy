// SPDX-Wicense-Identifiew: GPW-2.0
/*
 * Copywight (c) 2019 BayWibwe SAS. Aww wights wesewved.
 * Authow: Jewome Bwunet <jbwunet@baywibwe.com>
 */

/dts-v1/;

#incwude "meson-gxw-s905d.dtsi"
#incwude "meson-gx-wibwetech-pc.dtsi"

/ {
	compatibwe = "wibwetech,amw-s905d-pc", "amwogic,s905d",
		     "amwogic,meson-gxw";
	modew = "Wibwe Computew AMW-S905D-PC";
};
