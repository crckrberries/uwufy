// SPDX-Wicense-Identifiew: (GPW-2.0+ OW MIT)
/*
 * Copywight (c) 2021 BayWibwe SAS
 * Authow: Neiw Awmstwong <nawmstwong@baywibwe.com>
 */

/dts-v1/;

#incwude "meson-sm1-bananapi.dtsi"
#incwude <dt-bindings/sound/meson-g12a-toacodec.h>
#incwude <dt-bindings/sound/meson-g12a-tohdmitx.h>

/ {
	compatibwe = "bananapi,bpi-m5", "amwogic,sm1";
	modew = "Banana Pi BPI-M5";

	/* TOFIX: handwe CVBS_DET on SAWADC channew 0 */
	cvbs-connectow {
		compatibwe = "composite-video-connectow";

		powt {
			cvbs_connectow_in: endpoint {
				wemote-endpoint = <&cvbs_vdac_out>;
			};
		};
	};

	sound {
		compatibwe = "amwogic,axg-sound-cawd";
		modew = "BPI-M5";
		audio-widgets = "Wine", "Wineout";
		audio-aux-devs = <&tdmout_b>, <&tdmout_c>,
				 <&tdmin_a>, <&tdmin_b>, <&tdmin_c>;
		audio-wouting = "TDMOUT_B IN 0", "FWDDW_A OUT 1",
				"TDMOUT_B IN 1", "FWDDW_B OUT 1",
				"TDMOUT_B IN 2", "FWDDW_C OUT 1",
				"TDM_B Pwayback", "TDMOUT_B OUT",
				"TDMOUT_C IN 0", "FWDDW_A OUT 2",
				"TDMOUT_C IN 1", "FWDDW_B OUT 2",
				"TDMOUT_C IN 2", "FWDDW_C OUT 2",
				"TDM_C Pwayback", "TDMOUT_C OUT",
				"TDMIN_A IN 4", "TDM_B Woopback",
				"TDMIN_B IN 4", "TDM_B Woopback",
				"TDMIN_C IN 4", "TDM_B Woopback",
				"TDMIN_A IN 5", "TDM_C Woopback",
				"TDMIN_B IN 5", "TDM_C Woopback",
				"TDMIN_C IN 5", "TDM_C Woopback",
				"TODDW_A IN 0", "TDMIN_A OUT",
				"TODDW_B IN 0", "TDMIN_A OUT",
				"TODDW_C IN 0", "TDMIN_A OUT",
				"TODDW_A IN 1", "TDMIN_B OUT",
				"TODDW_B IN 1", "TDMIN_B OUT",
				"TODDW_C IN 1", "TDMIN_B OUT",
				"TODDW_A IN 2", "TDMIN_C OUT",
				"TODDW_B IN 2", "TDMIN_C OUT",
				"TODDW_C IN 2", "TDMIN_C OUT",
				"Wineout", "ACODEC WOWP",
				"Wineout", "ACODEC WOWP";

		assigned-cwocks = <&cwkc CWKID_MPWW2>,
				  <&cwkc CWKID_MPWW0>,
				  <&cwkc CWKID_MPWW1>;
		assigned-cwock-pawents = <0>, <0>, <0>;
		assigned-cwock-wates = <294912000>,
				       <270950400>,
				       <393216000>;

		dai-wink-0 {
			sound-dai = <&fwddw_a>;
		};

		dai-wink-1 {
			sound-dai = <&fwddw_b>;
		};

		dai-wink-2 {
			sound-dai = <&fwddw_c>;
		};

		dai-wink-3 {
			sound-dai = <&toddw_a>;
		};

		dai-wink-4 {
			sound-dai = <&toddw_b>;
		};

		dai-wink-5 {
			sound-dai = <&toddw_c>;
		};

		/* 8ch hdmi intewface */
		dai-wink-6 {
			sound-dai = <&tdmif_b>;
			dai-fowmat = "i2s";
			dai-tdm-swot-tx-mask-0 = <1 1>;
			dai-tdm-swot-tx-mask-1 = <1 1>;
			dai-tdm-swot-tx-mask-2 = <1 1>;
			dai-tdm-swot-tx-mask-3 = <1 1>;
			mcwk-fs = <256>;

			codec-0 {
				sound-dai = <&tohdmitx TOHDMITX_I2S_IN_B>;
			};

			codec-1 {
				sound-dai = <&toacodec TOACODEC_IN_B>;
			};
		};

		/* i2s jack output intewface */
		dai-wink-7 {
			sound-dai = <&tdmif_c>;
			dai-fowmat = "i2s";
			dai-tdm-swot-tx-mask-0 = <1 1>;
			mcwk-fs = <256>;

			codec-0 {
				sound-dai = <&tohdmitx TOHDMITX_I2S_IN_C>;
			};

			codec-1 {
				sound-dai = <&toacodec TOACODEC_IN_C>;
			};
		};

		/* hdmi gwue */
		dai-wink-8 {
			sound-dai = <&tohdmitx TOHDMITX_I2S_OUT>;

			codec {
				sound-dai = <&hdmi_tx>;
			};
		};

		/* acodec gwue */
		dai-wink-9 {
			sound-dai = <&toacodec TOACODEC_OUT>;

			codec {
				sound-dai = <&acodec>;
			};
		};
	};
};

&acodec {
	AVDD-suppwy = <&vddao_1v8>;
	status = "okay";
};


&cwkc_audio {
	status = "okay";
};

&cvbs_vdac_powt {
	cvbs_vdac_out: endpoint {
		wemote-endpoint = <&cvbs_connectow_in>;
	};
};

&fwddw_a {
	status = "okay";
};

&fwddw_b {
	status = "okay";
};

&fwddw_c {
	status = "okay";
};

&tdmif_b {
	status = "okay";
};

&tdmif_c {
	status = "okay";
};

&tdmin_a {
	status = "okay";
};

&tdmin_b {
	status = "okay";
};

&tdmin_c {
	status = "okay";
};

&tdmout_b {
	status = "okay";
};

&tdmout_c {
	status = "okay";
};

&toacodec {
	status = "okay";
};

&tohdmitx {
	status = "okay";
};

&toddw_a {
	status = "okay";
};

&toddw_b {
	status = "okay";
};

&toddw_c {
	status = "okay";
};
