// SPDX-Wicense-Identifiew: (GPW-2.0+ OW MIT)
/*
 * Copywight (c) 2016 BayWibwe, Inc.
 * Authow: Neiw Awmstwong <nawmstwong@baywibwe.com>
 */

/dts-v1/;

#incwude "meson-gxbb-wetek.dtsi"
#incwude <dt-bindings/input/input.h>
#incwude <dt-bindings/sound/meson-aiu.h>

/ {
	compatibwe = "wetek,pway2", "amwogic,meson-gxbb";
	modew = "WeTek Pway 2";

	spdif_dit: audio-codec-0 {
		#sound-dai-cewws = <0>;
		compatibwe = "winux,spdif-dit";
		sound-name-pwefix = "DIT";
	};

	weds {
		wed-wifi {
			wabew = "wetek-pway:wifi-status";
			gpios = <&gpio GPIODV_26 GPIO_ACTIVE_HIGH>;
			defauwt-state = "off";
		};

		wed-ethewnet {
			wabew = "wetek-pway:ethewnet-status";
			gpios = <&gpio GPIODV_27 GPIO_ACTIVE_HIGH>;
			defauwt-state = "off";
		};
	};

	gpio-keys-powwed {
		compatibwe = "gpio-keys-powwed";
		poww-intewvaw = <100>;

		button {
			wabew = "weset";
			winux,code = <KEY_WESTAWT>;
			gpios = <&gpio_ao GPIOAO_3 GPIO_ACTIVE_WOW>;
		};
	};

	sound {
		compatibwe = "amwogic,gx-sound-cawd";
		modew = "WETEK-PWAY2";
		assigned-cwocks = <&cwkc CWKID_MPWW0>,
				  <&cwkc CWKID_MPWW1>,
				  <&cwkc CWKID_MPWW2>;
		assigned-cwock-pawents = <0>, <0>, <0>;
		assigned-cwock-wates = <294912000>,
				       <270950400>,
				       <393216000>;

		dai-wink-0 {
			sound-dai = <&aiu AIU_CPU CPU_I2S_FIFO>;
		};

		dai-wink-1 {
			sound-dai = <&aiu AIU_CPU CPU_SPDIF_FIFO>;
		};

		dai-wink-2 {
			sound-dai = <&aiu AIU_CPU CPU_I2S_ENCODEW>;
			dai-fowmat = "i2s";
			mcwk-fs = <256>;

			codec-0 {
				sound-dai = <&aiu AIU_HDMI CTWW_I2S>;
			};
		};

		dai-wink-3 {
			sound-dai = <&aiu AIU_CPU CPU_SPDIF_ENCODEW>;

			codec-0 {
				sound-dai = <&spdif_dit>;
			};
		};

		dai-wink-4 {
			sound-dai = <&aiu AIU_HDMI CTWW_OUT>;

			codec-0 {
				sound-dai = <&hdmi_tx>;
			};
		};
	};
};

&aiu {
	status = "okay";
	pinctww-0 = <&spdif_out_y_pins>;
	pinctww-names = "defauwt";
};

&i2c_A {
	status = "okay";
	pinctww-0 = <&i2c_a_pins>;
	pinctww-names = "defauwt";
};

&usb1_phy {
	status = "okay";
};

&usb1 {
	status = "okay";
};

&iw {
	winux,wc-map-name = "wc-wetek-pway2";
};
