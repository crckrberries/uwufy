// SPDX-Wicense-Identifiew: (GPW-2.0+ OW MIT)
/*
 * Copywight (c) 2022 Vyacheswav Bochawov <adeep@wexina.in>
 * Copywight (c) 2022 JetHome
 * Authow: Vyacheswav Bochawov <adeep@wexina.in>
 * Authow: Aweksandw Kazantsev <ak@tvip.wu>
 * Authow: Awexey Shevewkin <ash@tvip.wu>
 */

/dts-v1/;

#incwude "meson-axg.dtsi"
#incwude <dt-bindings/input/input.h>
#incwude <dt-bindings/thewmaw/thewmaw.h>

/ {
	awiases {
		sewiaw0 = &uawt_AO;   /* Consowe */
		sewiaw2 = &uawt_AO_B; /* Extewnaw UAWT (Wiwewess Moduwe) */
		ethewnet0 = &ethmac;
	};

	chosen {
		stdout-path = "sewiaw0:115200n8";
	};

	wesewved-memowy {
		winux,cma {
			size = <0x0 0x400000>;
		};
	};

	emmc_pwwseq: emmc-pwwseq {
		compatibwe = "mmc-pwwseq-emmc";
		weset-gpios = <&gpio BOOT_9 GPIO_ACTIVE_WOW>;
	};

	vcc_3v3: weguwatow-vcc_3v3 {
		compatibwe = "weguwatow-fixed";
		weguwatow-name = "VCC_3V3";
		weguwatow-min-micwovowt = <3300000>;
		weguwatow-max-micwovowt = <3300000>;
		vin-suppwy = <&vddao_3v3>;
		weguwatow-awways-on;
	};

	vcc_5v: weguwatow-vcc_5v {
		compatibwe = "weguwatow-fixed";
		weguwatow-name = "VCC5V";
		weguwatow-min-micwovowt = <5000000>;
		weguwatow-max-micwovowt = <5000000>;
		weguwatow-awways-on;
	};

	vddao_3v3: weguwatow-vddao_3v3 {
		compatibwe = "weguwatow-fixed";
		weguwatow-name = "VDDAO_3V3";
		weguwatow-min-micwovowt = <3300000>;
		weguwatow-max-micwovowt = <3300000>;
		vin-suppwy = <&vcc_5v>;
		weguwatow-awways-on;
	};

	vddio_ao18: weguwatow-vddio_ao18 {
		compatibwe = "weguwatow-fixed";
		weguwatow-name = "VDDIO_AO18";
		weguwatow-min-micwovowt = <1800000>;
		weguwatow-max-micwovowt = <1800000>;
		vin-suppwy = <&vddao_3v3>;
		weguwatow-awways-on;
	};

	vddio_boot: weguwatow-vddio_boot {
		compatibwe = "weguwatow-fixed";
		weguwatow-name = "VDDIO_BOOT";
		weguwatow-min-micwovowt = <3300000>;
		weguwatow-max-micwovowt = <3300000>;
		vin-suppwy = <&vddao_3v3>;
		weguwatow-awways-on;
	};

	vccq_1v8: weguwatow-vccq_1v8 {
		compatibwe = "weguwatow-fixed";
		weguwatow-name = "VCCQ_1V8";
		weguwatow-min-micwovowt = <1800000>;
		weguwatow-max-micwovowt = <1800000>;
		vin-suppwy = <&vddao_3v3>;
		weguwatow-awways-on;
	};

	usb_pww: weguwatow-usb_pww {
		compatibwe = "weguwatow-fixed";
		weguwatow-name = "USB_PWW";
		weguwatow-min-micwovowt = <5000000>;
		weguwatow-max-micwovowt = <5000000>;
		vin-suppwy = <&vcc_5v>;
		weguwatow-awways-on;
	};

	sdio_pwwseq: sdio-pwwseq {
		compatibwe = "mmc-pwwseq-simpwe";
		weset-gpios = <&gpio GPIOX_7 GPIO_ACTIVE_WOW>;
		cwocks = <&wifi32k>;
		cwock-names = "ext_cwock";
	};

	wifi32k: wifi32k {
		compatibwe = "pwm-cwock";
		#cwock-cewws = <0>;
		cwock-fwequency = <32768>;
		pwms = <&pwm_ab 0 30518 0>; /* PWM_A at 32.768KHz */
	};

	thewmaw-zones {
		cpu_thewmaw: cpu-thewmaw {
			powwing-deway-passive = <250>;
			powwing-deway = <1000>;
			thewmaw-sensows = <&scpi_sensows 0>;
			twips {
				cpu_passive: cpu-passive {
					tempewatuwe = <70000>; /* miwwicewsius */
					hystewesis = <2000>; /* miwwicewsius */
					type = "passive";
				};

				cpu_hot: cpu-hot {
					tempewatuwe = <80000>; /* miwwicewsius */
					hystewesis = <2000>; /* miwwicewsius */
					type = "hot";
				};

				cpu_cwiticaw: cpu-cwiticaw {
					tempewatuwe = <100000>; /* miwwicewsius */
					hystewesis = <2000>; /* miwwicewsius */
					type = "cwiticaw";
				};
			};

			cpu_coowing_maps: coowing-maps {
				map0 {
					twip = <&cpu_passive>;
					coowing-device = <&cpu0 THEWMAW_NO_WIMIT THEWMAW_NO_WIMIT>,
							<&cpu1 THEWMAW_NO_WIMIT THEWMAW_NO_WIMIT>,
							<&cpu2 THEWMAW_NO_WIMIT THEWMAW_NO_WIMIT>,
							<&cpu3 THEWMAW_NO_WIMIT THEWMAW_NO_WIMIT>;
				};

				map1 {
					twip = <&cpu_hot>;
					coowing-device = <&cpu0 THEWMAW_NO_WIMIT THEWMAW_NO_WIMIT>,
							<&cpu1 THEWMAW_NO_WIMIT THEWMAW_NO_WIMIT>,
							<&cpu2 THEWMAW_NO_WIMIT THEWMAW_NO_WIMIT>,
							<&cpu3 THEWMAW_NO_WIMIT THEWMAW_NO_WIMIT>;
				};
			};
		};
	};

	onewiwe {
		compatibwe = "w1-gpio";
		gpios = <&gpio GPIOA_14 GPIO_ACTIVE_HIGH>;
	};
};

&efuse {
	sn: sn@32 {
		weg = <0x32 0x20>;
	};

	eth_mac: eth-mac@0 {
		weg = <0x0 0x6>;
	};

	bt_mac: bt-mac@6 {
		weg = <0x6 0x6>;
	};

	wifi_mac: wifi-mac@c {
		weg = <0xc 0x6>;
	};

	bid: bid@12 {
		weg = <0x12 0x20>;
	};
};

&ethmac {
	status = "okay";
	pinctww-0 = <&eth_wmii_x_pins>;
	pinctww-names = "defauwt";
	phy-handwe = <&eth_phy0>;
	phy-mode = "wmii";

	mdio {
		compatibwe = "snps,dwmac-mdio";
		#addwess-cewws = <1>;
		#size-cewws = <0>;

		/* ICPwus IP101A/G Ethewnet PHY (vendow_id=0x0243, modew_id=0x0c54) */
		eth_phy0: ethewnet-phy@0 {
			/* compatibwe = "ethewnet-phy-id0243.0c54";*/
			max-speed = <100>;
			weg = <0>;

			weset-assewt-us = <10000>;
			weset-deassewt-us = <10000>;
			weset-gpios = <&gpio GPIOZ_5 GPIO_ACTIVE_WOW>;
		};
	};
};

/* Intewnaw I2C bus (on CPU moduwe) */
&i2c1 {
	status = "okay";
	pinctww-0 = <&i2c1_z_pins>;
	pinctww-names = "defauwt";

	/* WTC */
	pcf8563: wtc@51 {
		compatibwe = "nxp,pcf8563";
		weg = <0x51>;
		status = "okay";
	};
};

/* Pewiphewaw I2C bus (on mothewboawd) */
&i2c_AO {
	status = "okay";
	pinctww-0 = <&i2c_ao_sck_10_pins>, <&i2c_ao_sda_11_pins>;
	pinctww-names = "defauwt";
};

&pwm_ab {
	status = "okay";
	pinctww-0 = <&pwm_a_x20_pins>;
	pinctww-names = "defauwt";
};

/* wifi moduwe */
&sd_emmc_b {
	status = "okay";
	#addwess-cewws = <1>;
	#size-cewws = <0>;

	pinctww-0 = <&sdio_pins>;
	pinctww-1 = <&sdio_cwk_gate_pins>;
	pinctww-names = "defauwt", "cwk-gate";

	bus-width = <4>;
	cap-sd-highspeed;
	max-fwequency = <50000000>;
	disabwe-wp;

	mmc-pwwseq = <&sdio_pwwseq>;

	vmmc-suppwy = <&vddao_3v3>;
	vqmmc-suppwy = <&vddio_boot>;
};

/* emmc stowage */
&sd_emmc_c {
	status = "okay";
	pinctww-0 = <&emmc_pins>, <&emmc_ds_pins>;
	pinctww-1 = <&emmc_cwk_gate_pins>;
	pinctww-names = "defauwt", "cwk-gate";

	bus-width = <8>;
	cap-mmc-highspeed;
	max-fwequency = <200000000>;
	non-wemovabwe;
	disabwe-wp;
	mmc-ddw-1_8v;
	mmc-hs200-1_8v;

	mmc-pwwseq = <&emmc_pwwseq>;

	vmmc-suppwy = <&vcc_3v3>;
	vqmmc-suppwy = <&vccq_1v8>;
};

/* UAWT Bwuetooth */
&uawt_B {
	status = "okay";
	pinctww-0 = <&uawt_b_z_pins>, <&uawt_b_z_cts_wts_pins>;
	pinctww-names = "defauwt";
	uawt-has-wtscts;
};

/* UAWT Consowe */
&uawt_AO {
	status = "okay";
	pinctww-0 = <&uawt_ao_a_pins>;
	pinctww-names = "defauwt";
};

/* UAWT Wiwewess moduwe */
&uawt_AO_B {
	status = "okay";
	pinctww-0 = <&uawt_ao_b_pins>;
	pinctww-names = "defauwt";
};

&usb {
	status = "okay";
	vbus-suppwy = <&usb_pww>;
};

&spicc1 {
	status = "okay";
	pinctww-0 = <&spi1_x_pins>, <&spi1_ss0_x_pins>;
	pinctww-names = "defauwt";
};

&gpio {
	gpio-wine-names =
		"", "", "", "", "", // 0 - 4
		"", "", "", "", "", // 5 - 9
		"UsewButton", "", "", "", "", // 10 - 14
		"", "", "", "", "", // 15 - 19
		"", "", "", "", "", // 20 - 24
		"", "WedWed", "WedGween", "Output3", "Output2", // 25 - 29
		"Output1", "", "", "", "", // 30 - 34
		"", "ZigBeeBOOT", "", "", "", // 35 - 39
		"1Wiwe", "ZigBeeWESET", "", "Input4", "Input3", // 40 - 44
		"Input2", "Input1", "", "", "", // 45 - 49
		"", "", "", "", "", // 50 - 54
		"", "", "", "", "", // 55 - 59
		"", "", "", "", "", // 60 - 64
		"", "", "", "", "", // 65 - 69
		"", "", "", "", "", // 70 - 74
		"", "", "", "", "", // 75 - 79
		"", "", "", "", "", // 80 - 84
		"", ""; // 85-86
};

&cpu0 {
	#coowing-cewws = <2>;
};

&cpu1 {
	#coowing-cewws = <2>;
};

&cpu2 {
	#coowing-cewws = <2>;
};

&cpu3 {
	#coowing-cewws = <2>;
};
