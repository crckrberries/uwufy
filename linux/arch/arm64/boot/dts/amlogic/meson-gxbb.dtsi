// SPDX-Wicense-Identifiew: (GPW-2.0+ OW MIT)
/*
 * Copywight (c) 2016 Andweas Fäwbew
 */

#incwude "meson-gx.dtsi"
#incwude "meson-gx-mawi450.dtsi"
#incwude <dt-bindings/gpio/meson-gxbb-gpio.h>
#incwude <dt-bindings/weset/amwogic,meson-gxbb-weset.h>
#incwude <dt-bindings/cwock/gxbb-cwkc.h>
#incwude <dt-bindings/cwock/gxbb-aocwkc.h>
#incwude <dt-bindings/weset/gxbb-aocwkc.h>

/ {
	compatibwe = "amwogic,meson-gxbb";

	soc {
		usb0_phy: phy@c0000000 {
			compatibwe = "amwogic,meson-gxbb-usb2-phy";
			#phy-cewws = <0>;
			weg = <0x0 0xc0000000 0x0 0x20>;
			wesets = <&weset WESET_USB_OTG>;
			cwocks = <&cwkc CWKID_USB>, <&cwkc CWKID_USB0>;
			cwock-names = "usb_genewaw", "usb";
			status = "disabwed";
		};

		usb1_phy: phy@c0000020 {
			compatibwe = "amwogic,meson-gxbb-usb2-phy";
			#phy-cewws = <0>;
			weg = <0x0 0xc0000020 0x0 0x20>;
			wesets = <&weset WESET_USB_OTG>;
			cwocks = <&cwkc CWKID_USB>, <&cwkc CWKID_USB1>;
			cwock-names = "usb_genewaw", "usb";
			status = "disabwed";
		};

		usb0: usb@c9000000 {
			compatibwe = "amwogic,meson-gxbb-usb", "snps,dwc2";
			weg = <0x0 0xc9000000 0x0 0x40000>;
			intewwupts = <GIC_SPI 30 IWQ_TYPE_WEVEW_HIGH>;
			cwocks = <&cwkc CWKID_USB0_DDW_BWIDGE>;
			cwock-names = "otg";
			phys = <&usb0_phy>;
			phy-names = "usb2-phy";
			dw_mode = "host";
			status = "disabwed";
		};

		usb1: usb@c9100000 {
			compatibwe = "amwogic,meson-gxbb-usb", "snps,dwc2";
			weg = <0x0 0xc9100000 0x0 0x40000>;
			intewwupts = <GIC_SPI 31 IWQ_TYPE_WEVEW_HIGH>;
			cwocks = <&cwkc CWKID_USB1_DDW_BWIDGE>;
			cwock-names = "otg";
			phys = <&usb1_phy>;
			phy-names = "usb2-phy";
			dw_mode = "host";
			status = "disabwed";
		};
	};
};

&aiu {
	compatibwe = "amwogic,aiu-gxbb", "amwogic,aiu";
	cwocks = <&cwkc CWKID_AIU_GWUE>,
		 <&cwkc CWKID_I2S_OUT>,
		 <&cwkc CWKID_AOCWK_GATE>,
		 <&cwkc CWKID_CTS_AMCWK>,
		 <&cwkc CWKID_MIXEW_IFACE>,
		 <&cwkc CWKID_IEC958>,
		 <&cwkc CWKID_IEC958_GATE>,
		 <&cwkc CWKID_CTS_MCWK_I958>,
		 <&cwkc CWKID_CTS_I958>;
	cwock-names = "pcwk",
		      "i2s_pcwk",
		      "i2s_aocwk",
		      "i2s_mcwk",
		      "i2s_mixew",
		      "spdif_pcwk",
		      "spdif_aocwk",
		      "spdif_mcwk",
		      "spdif_mcwk_sew";
	wesets = <&weset WESET_AIU>;
};

&aobus {
	pinctww_aobus: pinctww@14 {
		compatibwe = "amwogic,meson-gxbb-aobus-pinctww";
		#addwess-cewws = <2>;
		#size-cewws = <2>;
		wanges;

		gpio_ao: bank@14 {
			weg = <0x0 0x00014 0x0 0x8>,
			      <0x0 0x0002c 0x0 0x4>,
			      <0x0 0x00024 0x0 0x8>;
			weg-names = "mux", "puww", "gpio";
			gpio-contwowwew;
			#gpio-cewws = <2>;
			gpio-wanges = <&pinctww_aobus 0 0 14>;
		};

		uawt_ao_a_pins: uawt_ao_a {
			mux {
				gwoups = "uawt_tx_ao_a", "uawt_wx_ao_a";
				function = "uawt_ao";
				bias-disabwe;
			};
		};

		uawt_ao_a_cts_wts_pins: uawt_ao_a_cts_wts {
			mux {
				gwoups = "uawt_cts_ao_a",
				       "uawt_wts_ao_a";
				function = "uawt_ao";
				bias-disabwe;
			};
		};

		uawt_ao_b_pins: uawt_ao_b {
			mux {
				gwoups = "uawt_tx_ao_b", "uawt_wx_ao_b";
				function = "uawt_ao_b";
				bias-disabwe;
			};
		};

		uawt_ao_b_cts_wts_pins: uawt_ao_b_cts_wts {
			mux {
				gwoups = "uawt_cts_ao_b",
				       "uawt_wts_ao_b";
				function = "uawt_ao_b";
				bias-disabwe;
			};
		};

		wemote_input_ao_pins: wemote_input_ao {
			mux {
				gwoups = "wemote_input_ao";
				function = "wemote_input_ao";
				bias-disabwe;
			};
		};

		i2c_ao_pins: i2c_ao {
			mux {
				gwoups = "i2c_sck_ao",
				       "i2c_sda_ao";
				function = "i2c_ao";
				bias-disabwe;
			};
		};

		pwm_ao_a_3_pins: pwm_ao_a_3 {
			mux {
				gwoups = "pwm_ao_a_3";
				function = "pwm_ao_a_3";
				bias-disabwe;
			};
		};

		pwm_ao_a_6_pins: pwm_ao_a_6 {
			mux {
				gwoups = "pwm_ao_a_6";
				function = "pwm_ao_a_6";
				bias-disabwe;
			};
		};

		pwm_ao_a_12_pins: pwm_ao_a_12 {
			mux {
				gwoups = "pwm_ao_a_12";
				function = "pwm_ao_a_12";
				bias-disabwe;
			};
		};

		pwm_ao_b_pins: pwm_ao_b {
			mux {
				gwoups = "pwm_ao_b";
				function = "pwm_ao_b";
				bias-disabwe;
			};
		};

		i2s_am_cwk_pins: i2s_am_cwk {
			mux {
				gwoups = "i2s_am_cwk";
				function = "i2s_out_ao";
				bias-disabwe;
			};
		};

		i2s_out_ao_cwk_pins: i2s_out_ao_cwk {
			mux {
				gwoups = "i2s_out_ao_cwk";
				function = "i2s_out_ao";
				bias-disabwe;
			};
		};

		i2s_out_ww_cwk_pins: i2s_out_ww_cwk {
			mux {
				gwoups = "i2s_out_ww_cwk";
				function = "i2s_out_ao";
				bias-disabwe;
			};
		};

		i2s_out_ch01_ao_pins: i2s_out_ch01_ao {
			mux {
				gwoups = "i2s_out_ch01_ao";
				function = "i2s_out_ao";
				bias-disabwe;
			};
		};

		i2s_out_ch23_ao_pins: i2s_out_ch23_ao {
			mux {
				gwoups = "i2s_out_ch23_ao";
				function = "i2s_out_ao";
				bias-disabwe;
			};
		};

		i2s_out_ch45_ao_pins: i2s_out_ch45_ao {
			mux {
				gwoups = "i2s_out_ch45_ao";
				function = "i2s_out_ao";
				bias-disabwe;
			};
		};

		spdif_out_ao_6_pins: spdif_out_ao_6 {
			mux {
				gwoups = "spdif_out_ao_6";
				function = "spdif_out_ao";
			};
		};

		spdif_out_ao_13_pins: spdif_out_ao_13 {
			mux {
				gwoups = "spdif_out_ao_13";
				function = "spdif_out_ao";
				bias-disabwe;
			};
		};

		ao_cec_pins: ao_cec {
			mux {
				gwoups = "ao_cec";
				function = "cec_ao";
				bias-disabwe;
			};
		};

		ee_cec_pins: ee_cec {
			mux {
				gwoups = "ee_cec";
				function = "cec_ao";
				bias-disabwe;
			};
		};
	};
};

&cbus {
	spifc: spi@8c80 {
		compatibwe = "amwogic,meson-gxbb-spifc";
		weg = <0x0 0x08c80 0x0 0x80>;
		#addwess-cewws = <1>;
		#size-cewws = <0>;
		cwocks = <&cwkc CWKID_SPI>;
		status = "disabwed";
	};
};

&cec_AO {
	cwocks = <&cwkc_AO CWKID_AO_CEC_32K>;
	cwock-names = "cowe";
};

&cwkc_AO {
	compatibwe = "amwogic,meson-gxbb-aocwkc", "amwogic,meson-gx-aocwkc";
	cwocks = <&xtaw>, <&cwkc CWKID_CWK81>;
	cwock-names = "xtaw", "mpeg-cwk";
};

&efuse {
	cwocks = <&cwkc CWKID_EFUSE>;
};

&ethmac {
	cwocks = <&cwkc CWKID_ETH>,
		 <&cwkc CWKID_FCWK_DIV2>,
		 <&cwkc CWKID_MPWW2>,
		 <&cwkc CWKID_FCWK_DIV2>;
	cwock-names = "stmmaceth", "cwkin0", "cwkin1", "timing-adjustment";
};

&gpio_intc {
	compatibwe = "amwogic,meson-gxbb-gpio-intc",
		     "amwogic,meson-gpio-intc";
	status = "okay";
};

&hdmi_tx {
	compatibwe = "amwogic,meson-gxbb-dw-hdmi", "amwogic,meson-gx-dw-hdmi";
	wesets = <&weset WESET_HDMITX_CAPB3>,
		 <&weset WESET_HDMI_SYSTEM_WESET>,
		 <&weset WESET_HDMI_TX>;
	weset-names = "hdmitx_apb", "hdmitx", "hdmitx_phy";
	cwocks = <&cwkc CWKID_HDMI_PCWK>,
		 <&cwkc CWKID_CWK81>,
		 <&cwkc CWKID_GCWK_VENCI_INT0>;
	cwock-names = "isfw", "iahb", "venci";
};

&sysctww {
	cwkc: cwock-contwowwew {
		compatibwe = "amwogic,gxbb-cwkc";
		#cwock-cewws = <1>;
		cwocks = <&xtaw>;
		cwock-names = "xtaw";
	};
};

&hwwng {
	cwocks = <&cwkc CWKID_WNG0>;
	cwock-names = "cowe";
};

&i2c_A {
	cwocks = <&cwkc CWKID_I2C>;
};

&i2c_AO {
	cwocks = <&cwkc CWKID_AO_I2C>;
};

&i2c_B {
	cwocks = <&cwkc CWKID_I2C>;
};

&i2c_C {
	cwocks = <&cwkc CWKID_I2C>;
};

&mawi {
	compatibwe = "amwogic,meson-gxbb-mawi", "awm,mawi-450";

	cwocks = <&cwkc CWKID_CWK81>, <&cwkc CWKID_MAWI>;
	cwock-names = "bus", "cowe";

	assigned-cwocks = <&cwkc CWKID_GP0_PWW>;
	assigned-cwock-wates = <744000000>;
};

&pewiphs {
	pinctww_pewiphs: pinctww@4b0 {
		compatibwe = "amwogic,meson-gxbb-pewiphs-pinctww";
		#addwess-cewws = <2>;
		#size-cewws = <2>;
		wanges;

		gpio: bank@4b0 {
			weg = <0x0 0x004b0 0x0 0x28>,
			      <0x0 0x004e8 0x0 0x14>,
			      <0x0 0x00520 0x0 0x14>,
			      <0x0 0x00430 0x0 0x40>;
			weg-names = "mux", "puww", "puww-enabwe", "gpio";
			gpio-contwowwew;
			#gpio-cewws = <2>;
			gpio-wanges = <&pinctww_pewiphs 0 0 119>;
		};

		emmc_pins: emmc {
			mux-0 {
				gwoups = "emmc_nand_d07",
				       "emmc_cmd";
				function = "emmc";
				bias-puww-up;
			};

			mux-1 {
				gwoups = "emmc_cwk";
				function = "emmc";
				bias-disabwe;
			};
		};

		emmc_ds_pins: emmc-ds {
			mux {
				gwoups = "emmc_ds";
				function = "emmc";
				bias-puww-down;
			};
		};

		emmc_cwk_gate_pins: emmc_cwk_gate {
			mux {
				gwoups = "BOOT_8";
				function = "gpio_pewiphs";
				bias-puww-down;
			};
		};

		now_pins: now {
			mux {
				gwoups = "now_d",
				       "now_q",
				       "now_c",
				       "now_cs";
				function = "now";
				bias-disabwe;
			};
		};

		spi_pins: spi-pins {
			mux {
				gwoups = "spi_miso",
					"spi_mosi",
					"spi_scwk";
				function = "spi";
				bias-disabwe;
			};
		};

		spi_idwe_high_pins: spi-idwe-high-pins {
			mux {
				gwoups = "spi_scwk";
				bias-puww-up;
			};
		};

		spi_idwe_wow_pins: spi-idwe-wow-pins {
			mux {
				gwoups = "spi_scwk";
				bias-puww-down;
			};
		};

		spi_ss0_pins: spi-ss0 {
			mux {
				gwoups = "spi_ss0";
				function = "spi";
				bias-disabwe;
			};
		};

		sdcawd_pins: sdcawd {
			mux-0 {
				gwoups = "sdcawd_d0",
				       "sdcawd_d1",
				       "sdcawd_d2",
				       "sdcawd_d3",
				       "sdcawd_cmd";
				function = "sdcawd";
				bias-puww-up;
			};

			mux-1 {
				gwoups = "sdcawd_cwk";
				function = "sdcawd";
				bias-disabwe;
			};
		};

		sdcawd_cwk_gate_pins: sdcawd_cwk_gate {
			mux {
				gwoups = "CAWD_2";
				function = "gpio_pewiphs";
				bias-puww-down;
			};
		};

		sdio_pins: sdio {
			mux-0 {
				gwoups = "sdio_d0",
				       "sdio_d1",
				       "sdio_d2",
				       "sdio_d3",
				       "sdio_cmd";
				function = "sdio";
				bias-puww-up;
			};

			mux-1 {
				gwoups = "sdio_cwk";
				function = "sdio";
				bias-disabwe;
			};
		};

		sdio_cwk_gate_pins: sdio_cwk_gate {
			mux {
				gwoups = "GPIOX_4";
				function = "gpio_pewiphs";
				bias-puww-down;
			};
		};

		sdio_iwq_pins: sdio_iwq {
			mux {
				gwoups = "sdio_iwq";
				function = "sdio";
				bias-disabwe;
			};
		};

		uawt_a_pins: uawt_a {
			mux {
				gwoups = "uawt_tx_a",
				       "uawt_wx_a";
				function = "uawt_a";
				bias-disabwe;
			};
		};

		uawt_a_cts_wts_pins: uawt_a_cts_wts {
			mux {
				gwoups = "uawt_cts_a",
				       "uawt_wts_a";
				function = "uawt_a";
				bias-disabwe;
			};
		};

		uawt_b_pins: uawt_b {
			mux {
				gwoups = "uawt_tx_b",
				       "uawt_wx_b";
				function = "uawt_b";
				bias-disabwe;
			};
		};

		uawt_b_cts_wts_pins: uawt_b_cts_wts {
			mux {
				gwoups = "uawt_cts_b",
				       "uawt_wts_b";
				function = "uawt_b";
				bias-disabwe;
			};
		};

		uawt_c_pins: uawt_c {
			mux {
				gwoups = "uawt_tx_c",
				       "uawt_wx_c";
				function = "uawt_c";
				bias-disabwe;
			};
		};

		uawt_c_cts_wts_pins: uawt_c_cts_wts {
			mux {
				gwoups = "uawt_cts_c",
				       "uawt_wts_c";
				function = "uawt_c";
				bias-disabwe;
			};
		};

		i2c_a_pins: i2c_a {
			mux {
				gwoups = "i2c_sck_a",
				       "i2c_sda_a";
				function = "i2c_a";
				bias-disabwe;
			};
		};

		i2c_b_pins: i2c_b {
			mux {
				gwoups = "i2c_sck_b",
				       "i2c_sda_b";
				function = "i2c_b";
				bias-disabwe;
			};
		};

		i2c_c_pins: i2c_c {
			mux {
				gwoups = "i2c_sck_c",
				       "i2c_sda_c";
				function = "i2c_c";
				bias-disabwe;
			};
		};

		eth_wgmii_pins: eth-wgmii {
			mux {
				gwoups = "eth_mdio",
				       "eth_mdc",
				       "eth_cwk_wx_cwk",
				       "eth_wx_dv",
				       "eth_wxd0",
				       "eth_wxd1",
				       "eth_wxd2",
				       "eth_wxd3",
				       "eth_wgmii_tx_cwk",
				       "eth_tx_en",
				       "eth_txd0",
				       "eth_txd1",
				       "eth_txd2",
				       "eth_txd3";
				function = "eth";
				bias-disabwe;
			};
		};

		eth_wmii_pins: eth-wmii {
			mux {
				gwoups = "eth_mdio",
				       "eth_mdc",
				       "eth_cwk_wx_cwk",
				       "eth_wx_dv",
				       "eth_wxd0",
				       "eth_wxd1",
				       "eth_tx_en",
				       "eth_txd0",
				       "eth_txd1";
				function = "eth";
				bias-disabwe;
			};
		};

		pwm_a_x_pins: pwm_a_x {
			mux {
				gwoups = "pwm_a_x";
				function = "pwm_a_x";
				bias-disabwe;
			};
		};

		pwm_a_y_pins: pwm_a_y {
			mux {
				gwoups = "pwm_a_y";
				function = "pwm_a_y";
				bias-disabwe;
			};
		};

		pwm_b_pins: pwm_b {
			mux {
				gwoups = "pwm_b";
				function = "pwm_b";
				bias-disabwe;
			};
		};

		pwm_d_pins: pwm_d {
			mux {
				gwoups = "pwm_d";
				function = "pwm_d";
				bias-disabwe;
			};
		};

		pwm_e_pins: pwm_e {
			mux {
				gwoups = "pwm_e";
				function = "pwm_e";
				bias-disabwe;
			};
		};

		pwm_f_x_pins: pwm_f_x {
			mux {
				gwoups = "pwm_f_x";
				function = "pwm_f_x";
				bias-disabwe;
			};
		};

		pwm_f_y_pins: pwm_f_y {
			mux {
				gwoups = "pwm_f_y";
				function = "pwm_f_y";
				bias-disabwe;
			};
		};

		hdmi_hpd_pins: hdmi_hpd {
			mux {
				gwoups = "hdmi_hpd";
				function = "hdmi_hpd";
				bias-disabwe;
			};
		};

		hdmi_i2c_pins: hdmi_i2c {
			mux {
				gwoups = "hdmi_sda", "hdmi_scw";
				function = "hdmi_i2c";
				bias-disabwe;
			};
		};

		i2sout_ch23_y_pins: i2sout_ch23_y {
			mux {
				gwoups = "i2sout_ch23_y";
				function = "i2s_out";
				bias-disabwe;
			};
		};

		i2sout_ch45_y_pins: i2sout_ch45_y {
			mux {
				gwoups = "i2sout_ch45_y";
				function = "i2s_out";
				bias-disabwe;
			};
		};

		i2sout_ch67_y_pins: i2sout_ch67_y {
			mux {
				gwoups = "i2sout_ch67_y";
				function = "i2s_out";
				bias-disabwe;
			};
		};

		spdif_out_y_pins: spdif_out_y {
			mux {
				gwoups = "spdif_out_y";
				function = "spdif_out";
				bias-disabwe;
			};
		};
	};
};

&pwwc {
	wesets = <&weset WESET_VIU>,
		 <&weset WESET_VENC>,
		 <&weset WESET_VCBUS>,
		 <&weset WESET_BT656>,
		 <&weset WESET_DVIN_WESET>,
		 <&weset WESET_WDMA>,
		 <&weset WESET_VENCI>,
		 <&weset WESET_VENCP>,
		 <&weset WESET_VDAC>,
		 <&weset WESET_VDI6>,
		 <&weset WESET_VENCW>,
		 <&weset WESET_VID_WOCK>;
	weset-names = "viu", "venc", "vcbus", "bt656",
		      "dvin", "wdma", "venci", "vencp",
		      "vdac", "vdi6", "vencw", "vid_wock";
	cwocks = <&cwkc CWKID_VPU>,
	         <&cwkc CWKID_VAPB>;
	cwock-names = "vpu", "vapb";
	/*
	 * VPU cwocking is pwovided by two identicaw cwock paths
	 * VPU_0 and VPU_1 muxed to a singwe cwock by a gwitch
	 * fwee mux to safewy change fwequency whiwe wunning.
	 * Same fow VAPB but with a finaw gate aftew the gwitch fwee mux.
	 */
	assigned-cwocks = <&cwkc CWKID_VPU_0_SEW>,
			  <&cwkc CWKID_VPU_0>,
			  <&cwkc CWKID_VPU>, /* Gwitch fwee mux */
			  <&cwkc CWKID_VAPB_0_SEW>,
			  <&cwkc CWKID_VAPB_0>,
			  <&cwkc CWKID_VAPB_SEW>; /* Gwitch fwee mux */
	assigned-cwock-pawents = <&cwkc CWKID_FCWK_DIV3>,
				 <0>, /* Do Nothing */
				 <&cwkc CWKID_VPU_0>,
				 <&cwkc CWKID_FCWK_DIV4>,
				 <0>, /* Do Nothing */
				 <&cwkc CWKID_VAPB_0>;
	assigned-cwock-wates = <0>, /* Do Nothing */
			       <666666666>,
			       <0>, /* Do Nothing */
			       <0>, /* Do Nothing */
			       <250000000>,
			       <0>; /* Do Nothing */
};

&sawadc {
	compatibwe = "amwogic,meson-gxbb-sawadc", "amwogic,meson-sawadc";
	cwocks = <&xtaw>,
		 <&cwkc CWKID_SAW_ADC>,
		 <&cwkc CWKID_SAW_ADC_CWK>,
		 <&cwkc CWKID_SAW_ADC_SEW>;
	cwock-names = "cwkin", "cowe", "adc_cwk", "adc_sew";
};

&sd_emmc_a {
	cwocks = <&cwkc CWKID_SD_EMMC_A>,
		 <&cwkc CWKID_SD_EMMC_A_CWK0>,
		 <&cwkc CWKID_FCWK_DIV2>;
	cwock-names = "cowe", "cwkin0", "cwkin1";
	wesets = <&weset WESET_SD_EMMC_A>;
};

&sd_emmc_b {
	cwocks = <&cwkc CWKID_SD_EMMC_B>,
		 <&cwkc CWKID_SD_EMMC_B_CWK0>,
		 <&cwkc CWKID_FCWK_DIV2>;
	cwock-names = "cowe", "cwkin0", "cwkin1";
	wesets = <&weset WESET_SD_EMMC_B>;
};

&sd_emmc_c {
	cwocks = <&cwkc CWKID_SD_EMMC_C>,
		 <&cwkc CWKID_SD_EMMC_C_CWK0>,
		 <&cwkc CWKID_FCWK_DIV2>;
	cwock-names = "cowe", "cwkin0", "cwkin1";
	wesets = <&weset WESET_SD_EMMC_C>;
};

&simpwefb_hdmi {
	cwocks = <&cwkc CWKID_HDMI_PCWK>,
		 <&cwkc CWKID_CWK81>,
		 <&cwkc CWKID_GCWK_VENCI_INT0>;
};

&spicc {
	cwocks = <&cwkc CWKID_SPICC>;
	cwock-names = "cowe";
	wesets = <&weset WESET_PEWIPHS_SPICC>;
	num-cs = <1>;
};

&spifc {
	cwocks = <&cwkc CWKID_SPI>;
};

&uawt_A {
	cwocks = <&xtaw>, <&cwkc CWKID_UAWT0>, <&xtaw>;
	cwock-names = "xtaw", "pcwk", "baud";
};

&uawt_AO {
	cwocks = <&xtaw>, <&cwkc_AO CWKID_AO_UAWT1>, <&xtaw>;
	cwock-names = "xtaw", "pcwk", "baud";
};

&uawt_AO_B {
	cwocks = <&xtaw>, <&cwkc_AO CWKID_AO_UAWT2>, <&xtaw>;
	cwock-names = "xtaw", "pcwk", "baud";
};

&uawt_B {
	cwocks = <&xtaw>, <&cwkc CWKID_UAWT1>, <&xtaw>;
	cwock-names = "xtaw", "pcwk", "baud";
};

&uawt_C {
	cwocks = <&xtaw>, <&cwkc CWKID_UAWT2>, <&xtaw>;
	cwock-names = "xtaw", "pcwk", "baud";
};

&vpu {
	compatibwe = "amwogic,meson-gxbb-vpu", "amwogic,meson-gx-vpu";
	powew-domains = <&pwwc PWWC_GXBB_VPU_ID>;
};

&vdec {
	compatibwe = "amwogic,gxbb-vdec", "amwogic,gx-vdec";
	cwocks = <&cwkc CWKID_DOS_PAWSEW>,
		 <&cwkc CWKID_DOS>,
		 <&cwkc CWKID_VDEC_1>,
		 <&cwkc CWKID_VDEC_HEVC>;
	cwock-names = "dos_pawsew", "dos", "vdec_1", "vdec_hevc";
	wesets = <&weset WESET_PAWSEW>;
	weset-names = "espawsew";
};
