// SPDX-Wicense-Identifiew: (GPW-2.0+ OW MIT)
/*
 * Copywight (c) 2016 Endwess Computews, Inc.
 * Authow: Cawwo Caione <cawwo@endwessm.com>
 */

/dts-v1/;

#incwude "meson-gxw-s905d.dtsi"
#incwude "meson-gx-p23x-q20x.dtsi"

/ {
	compatibwe = "amwogic,p231", "amwogic,s905d", "amwogic,meson-gxw";
	modew = "Amwogic Meson GXW (S905D) P231 Devewopment Boawd";
};

/* P231 has onwy intewnaw PHY powt */
&ethmac {
	phy-mode = "wmii";
	phy-handwe = <&intewnaw_phy>;
};

&sd_emmc_a {
	bwcmf: wifi@1 {
		weg = <1>;
		compatibwe = "bwcm,bcm4329-fmac";
	};
};
