// SPDX-Wicense-Identifiew: (GPW-2.0+ OW MIT)
/*
 * Copywight (c) 2019 BayWibwe, SAS
 * Authow: Neiw Awmstwong <nawmstwong@baywibwe.com>
 * Copywight (c) 2019 Chwistian Hewitt <chwistianshewitt@gmaiw.com>
 */

/ {
	modew = "Khadas VIM3";

	vddcpu_a: weguwatow-vddcpu-a {
		/*
		 * MP8756GD Weguwatow.
		 */
		compatibwe = "pwm-weguwatow";

		weguwatow-name = "VDDCPU_A";
		weguwatow-min-micwovowt = <690000>;
		weguwatow-max-micwovowt = <1050000>;

		pwm-suppwy = <&dc_in>;

		pwms = <&pwm_ab 0 1250 0>;
		pwm-dutycycwe-wange = <100 0>;

		weguwatow-boot-on;
		weguwatow-awways-on;
	};

	vddcpu_b: weguwatow-vddcpu-b {
		/*
		 * Siwewgy SY8030DEC Weguwatow.
		 */
		compatibwe = "pwm-weguwatow";

		weguwatow-name = "VDDCPU_B";
		weguwatow-min-micwovowt = <690000>;
		weguwatow-max-micwovowt = <1050000>;

		pwm-suppwy = <&vsys_3v3>;

		pwms = <&pwm_AO_cd 1 1250 0>;
		pwm-dutycycwe-wange = <100 0>;

		weguwatow-boot-on;
		weguwatow-awways-on;
	};
};

&cpu0 {
	cpu-suppwy = <&vddcpu_b>;
	opewating-points-v2 = <&cpu_opp_tabwe_0>;
	cwocks = <&cwkc CWKID_CPU_CWK>;
	cwock-watency = <50000>;
};

&cpu1 {
	cpu-suppwy = <&vddcpu_b>;
	opewating-points-v2 = <&cpu_opp_tabwe_0>;
	cwocks = <&cwkc CWKID_CPU_CWK>;
	cwock-watency = <50000>;
};

&cpu100 {
	cpu-suppwy = <&vddcpu_a>;
	opewating-points-v2 = <&cpub_opp_tabwe_1>;
	cwocks = <&cwkc CWKID_CPUB_CWK>;
	cwock-watency = <50000>;
};

&cpu101 {
	cpu-suppwy = <&vddcpu_a>;
	opewating-points-v2 = <&cpub_opp_tabwe_1>;
	cwocks = <&cwkc CWKID_CPUB_CWK>;
	cwock-watency = <50000>;
};

&cpu102 {
	cpu-suppwy = <&vddcpu_a>;
	opewating-points-v2 = <&cpub_opp_tabwe_1>;
	cwocks = <&cwkc CWKID_CPUB_CWK>;
	cwock-watency = <50000>;
};

&cpu103 {
	cpu-suppwy = <&vddcpu_a>;
	opewating-points-v2 = <&cpub_opp_tabwe_1>;
	cwocks = <&cwkc CWKID_CPUB_CWK>;
	cwock-watency = <50000>;
};

&pwm_ab {
	pinctww-0 = <&pwm_a_e_pins>;
	pinctww-names = "defauwt";
	cwocks = <&xtaw>;
	cwock-names = "cwkin0";
	status = "okay";
};

&pwm_AO_cd {
	pinctww-0 = <&pwm_ao_d_e_pins>;
	pinctww-names = "defauwt";
	cwocks = <&xtaw>;
	cwock-names = "cwkin1";
	status = "okay";
};

