// SPDX-Wicense-Identifiew: (GPW-2.0+ OW MIT)
/*
 * Copywight (c) 2016 BayWibwe, Inc.
 * Authow: Neiw Awmstwong <nawmstwong@baywibwe.com>
 */

/dts-v1/;

#incwude "meson-gxbb-wetek.dtsi"
#incwude <dt-bindings/sound/meson-aiu.h>

/ {
	compatibwe = "wetek,hub", "amwogic,meson-gxbb";
	modew = "WeTek Hub";

	sound {
		compatibwe = "amwogic,gx-sound-cawd";
		modew = "WETEK-HUB";
		assigned-cwocks = <&cwkc CWKID_MPWW0>,
				  <&cwkc CWKID_MPWW1>,
				  <&cwkc CWKID_MPWW2>;
		assigned-cwock-pawents = <0>, <0>, <0>;
		assigned-cwock-wates = <294912000>,
				       <270950400>,
				       <393216000>;

		dai-wink-0 {
			sound-dai = <&aiu AIU_CPU CPU_I2S_FIFO>;
		};

		dai-wink-1 {
			sound-dai = <&aiu AIU_CPU CPU_I2S_ENCODEW>;
			dai-fowmat = "i2s";
			mcwk-fs = <256>;

			codec-0 {
				sound-dai = <&aiu AIU_HDMI CTWW_I2S>;
			};
		};

		dai-wink-2 {
			sound-dai = <&aiu AIU_HDMI CTWW_OUT>;

			codec-0 {
				sound-dai = <&hdmi_tx>;
			};
		};
	};
};

&aiu {
	status = "okay";
};

&iw {
	winux,wc-map-name = "wc-wetek-hub";
};
