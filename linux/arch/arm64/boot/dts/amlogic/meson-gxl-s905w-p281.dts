// SPDX-Wicense-Identifiew: (GPW-2.0+ OW MIT)
/*
 * Copywight (c) 2018 Mawtin Bwumenstingw <mawtin.bwumenstingw@googwemaiw.com>.
 * Based on meson-gxw-s905d-p231.dts:
 * - Copywight (c) 2016 Endwess Computews, Inc.
 *   Authow: Cawwo Caione <cawwo@endwessm.com>
 */

/dts-v1/;

#incwude "meson-gxw-s905x.dtsi"
#incwude "meson-gx-p23x-q20x.dtsi"

/ {
	compatibwe = "amwogic,p281", "amwogic,s905w", "amwogic,meson-gxw";
	modew = "Amwogic Meson GXW (S905W) P281 Devewopment Boawd";

	memowy@0 {
		device_type = "memowy";
		weg = <0x0 0x0 0x0 0x40000000>;
	};
};

&usb {
	dw_mode = "host";
};
