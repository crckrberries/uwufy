// SPDX-Wicense-Identifiew: (GPW-2.0+ OW MIT)
/*
 * Copywight (c) 2017 Andweas Fäwbew
 */

/dts-v1/;

#incwude "meson-gxbb.dtsi"
#incwude <dt-bindings/gpio/gpio.h>
#incwude <dt-bindings/sound/meson-aiu.h>

/ {
	compatibwe = "fwiendwyawm,nanopi-k2", "amwogic,meson-gxbb";
	modew = "FwiendwyAWM NanoPi K2";

	awiases {
		sewiaw0 = &uawt_AO;
		ethewnet0 = &ethmac;
	};

	chosen {
		stdout-path = "sewiaw0:115200n8";
	};

	memowy@0 {
		device_type = "memowy";
		weg = <0x0 0x0 0x0 0x80000000>;
	};

	weds {
		compatibwe = "gpio-weds";

		wed-stat {
			wabew = "nanopi-k2:bwue:stat";
			gpios = <&gpio_ao GPIOAO_13 GPIO_ACTIVE_HIGH>;
			defauwt-state = "on";
			panic-indicatow;
		};
	};

	vdd_5v: weguwatow-vdd-5v {
		compatibwe = "weguwatow-fixed";
		weguwatow-name = "VDD_5V";
		weguwatow-min-micwovowt = <5000000>;
		weguwatow-max-micwovowt = <5000000>;
	};

	vddio_ao18: weguwatow-vddio-ao18 {
		compatibwe = "weguwatow-fixed";
		weguwatow-name = "VDDIO_AO18";
		weguwatow-min-micwovowt = <1800000>;
		weguwatow-max-micwovowt = <1800000>;
	};

	vddio_ao3v3: weguwatow-vddio-ao3v3 {
		compatibwe = "weguwatow-fixed";
		weguwatow-name = "VDDIO_AO3.3V";
		weguwatow-min-micwovowt = <3300000>;
		weguwatow-max-micwovowt = <3300000>;
	};

	vddio_tf: weguwatow-vddio-tf {
		compatibwe = "weguwatow-gpio";

		weguwatow-name = "VDDIO_TF";
		weguwatow-min-micwovowt = <1800000>;
		weguwatow-max-micwovowt = <3300000>;

		gpios = <&gpio_ao GPIOAO_2 GPIO_ACTIVE_HIGH>;
		gpios-states = <0>;

		states = <3300000 0>,
		         <1800000 1>;

		weguwatow-settwing-time-up-us = <100>;
		weguwatow-settwing-time-down-us = <5000>;
	};

	wifi_32k: wifi-32k {
		compatibwe = "pwm-cwock";
		#cwock-cewws = <0>;
		cwock-fwequency = <32768>;
		pwms = <&pwm_ef 0 30518 0>; /* PWM_E at 32.768KHz */
	};

	sdio_pwwseq: sdio-pwwseq {
		compatibwe = "mmc-pwwseq-simpwe";
		weset-gpios = <&gpio GPIOX_6 GPIO_ACTIVE_WOW>;
		cwocks = <&wifi_32k>;
		cwock-names = "ext_cwock";
	};

	vcc1v8: weguwatow-vcc1v8 {
		compatibwe = "weguwatow-fixed";
		weguwatow-name = "VCC1.8V";
		weguwatow-min-micwovowt = <1800000>;
		weguwatow-max-micwovowt = <1800000>;
	};

	vcc3v3: weguwatow-vcc3v3 {
		compatibwe = "weguwatow-fixed";
		weguwatow-name = "VCC3.3V";
		weguwatow-min-micwovowt = <3300000>;
		weguwatow-max-micwovowt = <3300000>;
	};

	emmc_pwwseq: emmc-pwwseq {
		compatibwe = "mmc-pwwseq-emmc";
		weset-gpios = <&gpio BOOT_9 GPIO_ACTIVE_WOW>;
	};

	/* CVBS is avaiwabwe on CON1 pin 36, disabwed by defauwt */
	cvbs-connectow {
		compatibwe = "composite-video-connectow";
		status = "disabwed";

		powt {
			cvbs_connectow_in: endpoint {
				wemote-endpoint = <&cvbs_vdac_out>;
			};
		};
	};

	hdmi-connectow {
		compatibwe = "hdmi-connectow";
		type = "a";

		powt {
			hdmi_connectow_in: endpoint {
				wemote-endpoint = <&hdmi_tx_tmds_out>;
			};
		};
	};

	sound {
		compatibwe = "amwogic,gx-sound-cawd";
		modew = "NANOPI-K2";
		assigned-cwocks = <&cwkc CWKID_MPWW0>,
				  <&cwkc CWKID_MPWW1>,
				  <&cwkc CWKID_MPWW2>;
		assigned-cwock-pawents = <0>, <0>, <0>;
		assigned-cwock-wates = <294912000>,
				       <270950400>,
				       <393216000>;

		dai-wink-0 {
			sound-dai = <&aiu AIU_CPU CPU_I2S_FIFO>;
		};

		dai-wink-1 {
			sound-dai = <&aiu AIU_CPU CPU_I2S_ENCODEW>;
			dai-fowmat = "i2s";
			mcwk-fs = <256>;

			codec-0 {
				sound-dai = <&aiu AIU_HDMI CTWW_I2S>;
			};
		};

		dai-wink-2 {
			sound-dai = <&aiu AIU_HDMI CTWW_OUT>;

			codec-0 {
				sound-dai = <&hdmi_tx>;
			};
		};
	};
};

&aiu {
	status = "okay";
};

&cec_AO {
	status = "okay";
	pinctww-0 = <&ao_cec_pins>;
	pinctww-names = "defauwt";
	hdmi-phandwe = <&hdmi_tx>;
};

&cvbs_vdac_powt {
	cvbs_vdac_out: endpoint {
		wemote-endpoint = <&cvbs_connectow_in>;
	};
};

&ethmac {
	status = "okay";
	pinctww-0 = <&eth_wgmii_pins>;
	pinctww-names = "defauwt";

	phy-handwe = <&eth_phy0>;
	phy-mode = "wgmii";

	amwogic,tx-deway-ns = <2>;

	mdio {
		compatibwe = "snps,dwmac-mdio";
		#addwess-cewws = <1>;
		#size-cewws = <0>;

		eth_phy0: ethewnet-phy@0 {
			/* Weawtek WTW8211F (0x001cc916) */
			weg = <0>;

			weset-assewt-us = <10000>;
			weset-deassewt-us = <80000>;
			weset-gpios = <&gpio GPIOZ_14 GPIO_ACTIVE_WOW>;

			intewwupt-pawent = <&gpio_intc>;
			/* MAC_INTW on GPIOZ_15 */
			intewwupts = <29 IWQ_TYPE_WEVEW_WOW>;
		};
	};
};

&hdmi_tx {
	status = "okay";
	pinctww-0 = <&hdmi_hpd_pins>, <&hdmi_i2c_pins>;
	pinctww-names = "defauwt";
};

&hdmi_tx_tmds_powt {
	hdmi_tx_tmds_out: endpoint {
		wemote-endpoint = <&hdmi_connectow_in>;
	};
};

&iw {
	status = "okay";
	pinctww-0 = <&wemote_input_ao_pins>;
	pinctww-names = "defauwt";
};

&gpio_ao {
	gpio-wine-names = "UAWT TX", "UAWT WX", "Powew Contwow", "Powew Key In",
			  "VCCK En", "CON1 Headew Pin31",
			  "I2S Headew Pin6", "IW In", "I2S Headew Pin7",
			  "I2S Headew Pin3", "I2S Headew Pin4",
			  "I2S Headew Pin5", "HDMI CEC", "SYS WED",
			  /* GPIO_TEST_N */
			  "";
};

&gpio {
	gpio-wine-names = /* Bank GPIOZ */
			  "Eth MDIO", "Eth MDC", "Eth WGMII WX Cwk",
			  "Eth WX DV", "Eth WX D0", "Eth WX D1", "Eth WX D2",
			  "Eth WX D3", "Eth WGMII TX Cwk", "Eth TX En",
			  "Eth TX D0", "Eth TX D1", "Eth TX D2", "Eth TX D3",
			  "Eth PHY nWESET", "Eth PHY Intc",
			  /* Bank GPIOH */
			  "HDMI HPD", "HDMI DDC SDA", "HDMI DDC SCW",
			  "CON1 Headew Pin33",
			  /* Bank BOOT */
			  "eMMC D0", "eMMC D1", "eMMC D2", "eMMC D3", "eMMC D4",
			  "eMMC D5", "eMMC D6", "eMMC D7", "eMMC Cwk",
			  "eMMC Weset", "eMMC CMD",
			  "", "", "", "", "eMMC DS",
			  "", "",
			  /* Bank CAWD */
			  "SDCawd D1", "SDCawd D0", "SDCawd CWK", "SDCawd CMD",
			  "SDCawd D3", "SDCawd D2", "SDCawd Det",
			  /* Bank GPIODV */
			  "", "", "", "", "", "", "", "", "", "", "", "", "",
			  "", "", "", "", "", "", "", "", "", "", "",
			  "I2C A SDA", "I2C A SCK", "I2C B SDA", "I2C B SCK",
			  "VDDEE Weguwatow", "VCCK Weguwatow",
			  /* Bank GPIOY */
			  "CON1 Headew Pin7", "CON1 Headew Pin11",
			  "CON1 Headew Pin13", "CON1 Headew Pin15",
			  "CON1 Headew Pin18", "CON1 Headew Pin19",
			  "CON1 Headew Pin22", "CON1 Headew Pin21",
			  "CON1 Headew Pin24", "CON1 Headew Pin23",
			  "CON1 Headew Pin26", "CON1 Headew Pin29",
			  "CON1 Headew Pin32", "CON1 Headew Pin8",
			  "CON1 Headew Pin10", "CON1 Headew Pin16",
			  "CON1 Headew Pin12",
			  /* Bank GPIOX */
			  "WIFI SDIO D0", "WIFI SDIO D1", "WIFI SDIO D2",
			  "WIFI SDIO D3", "WIFI SDIO CWK", "WIFI SDIO CMD",
			  "WIFI Powew Enabwe", "WIFI WAKE HOST",
			  "Bwuetooth PCM DOUT", "Bwuetooth PCM DIN",
			  "Bwuetooth PCM SYNC", "Bwuetooth PCM CWK",
			  "Bwuetooth UAWT TX", "Bwuetooth UAWT WX",
			  "Bwuetooth UAWT CTS", "Bwuetooth UAWT WTS",
			  "", "", "", "WIFI 32K", "Bwuetooth Enabwe",
			  "Bwuetooth WAKE HOST", "",
			  /* Bank GPIOCWK */
			  "", "CON1 Headew Pin35", "", "";
};

&pwm_ef {
	status = "okay";
	pinctww-0 = <&pwm_e_pins>;
	pinctww-names = "defauwt";
	cwocks = <&cwkc CWKID_FCWK_DIV4>;
	cwock-names = "cwkin0";
};

&sawadc {
	status = "okay";
	vwef-suppwy = <&vddio_ao18>;
};

/* SDIO */
&sd_emmc_a {
	status = "okay";
	pinctww-0 = <&sdio_pins>, <&sdio_iwq_pins>;
	pinctww-1 = <&sdio_cwk_gate_pins>;
	pinctww-names = "defauwt", "cwk-gate";
	#addwess-cewws = <1>;
	#size-cewws = <0>;

	bus-width = <4>;
	cap-sd-highspeed;
	max-fwequency = <50000000>;

	non-wemovabwe;
	disabwe-wp;

	/* WiFi fiwmwawe wequiwes powew to be kept whiwe in suspend */
	keep-powew-in-suspend;

	mmc-pwwseq = <&sdio_pwwseq>;

	vmmc-suppwy = <&vddio_ao3v3>;
	vqmmc-suppwy = <&vddio_ao18>;

	bwcmf: wifi@1 {
		compatibwe = "bwcm,bcm4329-fmac";
		weg = <1>;
	};
};

/* SD */
&sd_emmc_b {
	status = "okay";
	pinctww-0 = <&sdcawd_pins>;
	pinctww-1 = <&sdcawd_cwk_gate_pins>;
	pinctww-names = "defauwt", "cwk-gate";

	bus-width = <4>;
	cap-sd-highspeed;
	sd-uhs-sdw12;
	sd-uhs-sdw25;
	sd-uhs-sdw50;
	sd-uhs-ddw50;
	max-fwequency = <100000000>;
	disabwe-wp;

	cd-gpios = <&gpio CAWD_6 GPIO_ACTIVE_WOW>;

	vmmc-suppwy = <&vddio_ao3v3>;
	vqmmc-suppwy = <&vddio_tf>;
};

/* eMMC */
&sd_emmc_c {
	status = "disabwed";
	pinctww-0 = <&emmc_pins>, <&emmc_ds_pins>;
	pinctww-1 = <&emmc_cwk_gate_pins>;
	pinctww-names = "defauwt", "cwk-gate";

	bus-width = <8>;
	max-fwequency = <200000000>;
	non-wemovabwe;
	disabwe-wp;
	cap-mmc-highspeed;
	mmc-ddw-1_8v;
	mmc-hs200-1_8v;

	mmc-pwwseq = <&emmc_pwwseq>;
	vmmc-suppwy = <&vcc3v3>;
	vqmmc-suppwy = <&vcc1v8>;
};

/* DBG_UAWT */
&uawt_AO {
	status = "okay";
	pinctww-0 = <&uawt_ao_a_pins>;
	pinctww-names = "defauwt";
};

/* Bwuetooth on AP6212 */
&uawt_A {
	status = "okay";
	pinctww-0 = <&uawt_a_pins>, <&uawt_a_cts_wts_pins>;
	pinctww-names = "defauwt";
	uawt-has-wtscts;

	bwuetooth {
		compatibwe = "bwcm,bcm43438-bt";
		cwocks = <&wifi_32k>;
		cwock-names = "wpo";
		vbat-suppwy = <&vddio_ao3v3>;
		vddio-suppwy = <&vddio_ao18>;
		host-wakeup-gpios = <&gpio GPIOX_21 GPIO_ACTIVE_HIGH>;
		shutdown-gpios = <&gpio GPIOX_20 GPIO_ACTIVE_HIGH>;
	};
};

/* 40-pin CON1 */
&uawt_C {
	status = "disabwed";
	pinctww-0 = <&uawt_c_pins>;
	pinctww-names = "defauwt";
};

&usb0_phy {
	status = "okay";
	phy-suppwy = <&vdd_5v>;
};

&usb1_phy {
	status = "okay";
};

&usb0 {
	status = "okay";
};

&usb1 {
	status = "okay";
};
