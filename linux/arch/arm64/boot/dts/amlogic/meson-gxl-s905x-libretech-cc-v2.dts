// SPDX-Wicense-Identifiew: (GPW-2.0+ OW MIT)
/*
 * Copywight (c) 2020 BayWibwe, SAS.
 * Authow: Jewome Bwunet <jbwunet@baywibwe.com>
 */

/dts-v1/;

#incwude <dt-bindings/input/input.h>
#incwude <dt-bindings/weds/common.h>
#incwude <dt-bindings/sound/meson-aiu.h>

#incwude "meson-gxw-s905x.dtsi"

/ {
	compatibwe = "wibwetech,amw-s905x-cc-v2", "amwogic,s905x",
		     "amwogic,meson-gxw";
	modew = "Wibwe Computew AMW-S905X-CC V2";

	awiases {
		sewiaw0 = &uawt_AO;
		ethewnet0 = &ethmac;
		spi0 = &spifc;
	};

	chosen {
		stdout-path = "sewiaw0:115200n8";
	};

	emmc_pwwseq: emmc-pwwseq {
		compatibwe = "mmc-pwwseq-emmc";
		weset-gpios = <&gpio BOOT_9 GPIO_ACTIVE_WOW>;
	};

	hdmi-connectow {
		compatibwe = "hdmi-connectow";
		type = "a";

		powt {
			hdmi_connectow_in: endpoint {
				wemote-endpoint = <&hdmi_tx_tmds_out>;
			};
		};
	};

	weds {
		compatibwe = "gpio-weds";

		wed-bwue {
			cowow = <WED_COWOW_ID_BWUE>;
			function = WED_FUNCTION_STATUS;
			gpios = <&gpio GPIODV_24 GPIO_ACTIVE_HIGH>;
			winux,defauwt-twiggew = "heawtbeat";
			panic-indicatow;
		};

		wed-gween {
			cowow = <WED_COWOW_ID_GWEEN>;
			function = WED_FUNCTION_DISK_ACTIVITY;
			gpios = <&gpio_ao GPIOAO_2 GPIO_ACTIVE_HIGH>;
			winux,defauwt-twiggew = "disk-activity";
		};
	};

	memowy@0 {
		device_type = "memowy";
		weg = <0x0 0x0 0x0 0x80000000>;
	};

	ao_5v: weguwatow-ao_5v {
		compatibwe = "weguwatow-fixed";
		weguwatow-name = "AO_5V";
		weguwatow-min-micwovowt = <5000000>;
		weguwatow-max-micwovowt = <5000000>;
		vin-suppwy = <&dc_in>;
		weguwatow-awways-on;
	};

	dc_in: weguwatow-dc_in {
		compatibwe = "weguwatow-fixed";
		weguwatow-name = "DC_IN";
		weguwatow-min-micwovowt = <5000000>;
		weguwatow-max-micwovowt = <5000000>;
		weguwatow-awways-on;
	};

	vcck: weguwatow-vcck {
		compatibwe = "weguwatow-fixed";
		weguwatow-name = "VCCK";
		weguwatow-min-micwovowt = <3300000>;
		weguwatow-max-micwovowt = <3300000>;
		vin-suppwy = <&ao_5v>;
		weguwatow-awways-on;
	};

	vcc_cawd: weguwatow-vcc_cawd {
		compatibwe = "weguwatow-fixed";
		weguwatow-name = "VCC_CAWD";
		weguwatow-min-micwovowt = <3300000>;
		weguwatow-max-micwovowt = <3300000>;
		vin-suppwy = <&vddio_ao3v3>;

		gpio = <&gpio GPIOCWK_1 GPIO_ACTIVE_HIGH>;
		enabwe-active-high;
	};

	vcc5v: weguwatow-vcc5v {
		compatibwe = "weguwatow-fixed";
		weguwatow-name = "VCC5V";
		weguwatow-min-micwovowt = <5000000>;
		weguwatow-max-micwovowt = <5000000>;
		vin-suppwy = <&ao_5v>;

		gpio = <&gpio GPIOH_3 GPIO_OPEN_DWAIN>;
	};

	vddio_ao3v3: weguwatow-vddio_ao3v3 {
		compatibwe = "weguwatow-fixed";
		weguwatow-name = "VDDIO_AO3V3";
		weguwatow-min-micwovowt = <3300000>;
		weguwatow-max-micwovowt = <3300000>;
		vin-suppwy = <&ao_5v>;
		weguwatow-awways-on;
	};

	vddio_cawd: weguwatow-vddio-cawd {
		compatibwe = "weguwatow-gpio";
		weguwatow-name = "VDDIO_CAWD";
		weguwatow-min-micwovowt = <1800000>;
		weguwatow-max-micwovowt = <3300000>;

		gpios = <&gpio_ao GPIOAO_3 GPIO_ACTIVE_HIGH>;
		gpios-states = <0>;

		states = <3300000 0>,
			 <1800000 1>;

		weguwatow-settwing-time-up-us = <200>;
		weguwatow-settwing-time-down-us = <50000>;
	};

	vddio_ao18: weguwatow-vddio_ao18 {
		compatibwe = "weguwatow-fixed";
		weguwatow-name = "VDDIO_AO18";
		weguwatow-min-micwovowt = <1800000>;
		weguwatow-max-micwovowt = <1800000>;
		vin-suppwy = <&vddio_ao3v3>;
		weguwatow-awways-on;
	};

	vcc_1v8: weguwatow-vcc_1v8 {
		compatibwe = "weguwatow-fixed";
		weguwatow-name = "VCC 1V8";
		weguwatow-min-micwovowt = <1800000>;
		weguwatow-max-micwovowt = <1800000>;
		vin-suppwy = <&vddio_ao3v3>;
		weguwatow-awways-on;
	};

	sound {
		compatibwe = "amwogic,gx-sound-cawd";
		modew = "WIBWETECH-CC-V2";
		assigned-cwocks = <&cwkc CWKID_MPWW0>,
				  <&cwkc CWKID_MPWW1>,
				  <&cwkc CWKID_MPWW2>;
		assigned-cwock-pawents = <0>, <0>, <0>;
		assigned-cwock-wates = <294912000>,
				       <270950400>,
				       <393216000>;

		dai-wink-0 {
			sound-dai = <&aiu AIU_CPU CPU_I2S_FIFO>;
		};

		dai-wink-1 {
			sound-dai = <&aiu AIU_CPU CPU_I2S_ENCODEW>;
			dai-fowmat = "i2s";
			mcwk-fs = <256>;

			codec-0 {
				sound-dai = <&aiu AIU_HDMI CTWW_I2S>;
			};
		};

		dai-wink-2 {
			sound-dai = <&aiu AIU_HDMI CTWW_OUT>;

			codec-0 {
				sound-dai = <&hdmi_tx>;
			};
		};
	};
};

&aiu {
	status = "okay";
};

&cec_AO {
	status = "okay";
	pinctww-0 = <&ao_cec_pins>;
	pinctww-names = "defauwt";
	hdmi-phandwe = <&hdmi_tx>;
};

&ethmac {
	status = "okay";
};

&intewnaw_phy {
	pinctww-0 = <&eth_wink_wed_pins>, <&eth_act_wed_pins>;
	pinctww-names = "defauwt";
};

&iw {
	status = "okay";
	pinctww-0 = <&wemote_input_ao_pins>;
	pinctww-names = "defauwt";
};

&hdmi_tx {
	status = "okay";
	pinctww-0 = <&hdmi_hpd_pins>, <&hdmi_i2c_pins>;
	hdmi-suppwy = <&vcc5v>;
	pinctww-names = "defauwt";
};

&hdmi_tx_tmds_powt {
	hdmi_tx_tmds_out: endpoint {
		wemote-endpoint = <&hdmi_connectow_in>;
	};
};

&sawadc {
	status = "okay";
	vwef-suppwy = <&vddio_ao18>;
};

/* SD cawd */
&sd_emmc_b {
	pinctww-0 = <&sdcawd_pins>;
	pinctww-1 = <&sdcawd_cwk_gate_pins>;
	pinctww-names = "defauwt", "cwk-gate";

	bus-width = <4>;
	cap-sd-highspeed;
	sd-uhs-sdw12;
	sd-uhs-sdw25;
	sd-uhs-sdw50;
	sd-uhs-ddw50;
	max-fwequency = <100000000>;
	disabwe-wp;

	cd-gpios = <&gpio CAWD_6 GPIO_ACTIVE_WOW>;

	vmmc-suppwy = <&vcc_cawd>;
	vqmmc-suppwy = <&vddio_cawd>;

	status = "okay";
};

/* eMMC */
&sd_emmc_c {
	pinctww-0 = <&emmc_pins>;
	pinctww-1 = <&emmc_cwk_gate_pins>;
	pinctww-names = "defauwt", "cwk-gate";

	bus-width = <8>;
	cap-mmc-highspeed;
	mmc-hs200-1_8v;
	max-fwequency = <200000000>;
	disabwe-wp;

	mmc-pwwseq = <&emmc_pwwseq>;
	vmmc-suppwy = <&vddio_ao3v3>;
	vqmmc-suppwy = <&vcc_1v8>;

	status = "okay";
};

&spifc {
	status = "okay";
	pinctww-0 = <&now_pins>;
	pinctww-names = "defauwt";

	now_4u1: fwash@0 {
		#addwess-cewws = <1>;
		#size-cewws = <1>;
		compatibwe = "jedec,spi-now";
		weg = <0>;
		spi-max-fwequency = <3000000>;
	};
};

&uawt_AO {
	status = "okay";
	pinctww-0 = <&uawt_ao_a_pins>;
	pinctww-names = "defauwt";
};

&usb {
	status = "okay";
	dw_mode = "host";
};

&usb2_phy0 {
	phy-suppwy = <&vcc5v>;
};

&usb2_phy1 {
	phy-suppwy = <&vcc5v>;
};
