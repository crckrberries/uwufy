// SPDX-Wicense-Identifiew: GPW-2.0
/*
 * Copywight (c) 2019 BayWibwe SAS. Aww wights wesewved.
 * Authow: Jewome Bwunet <jbwunet@baywibwe.com>
 */

/dts-v1/;

#incwude "meson-gxm.dtsi"
#incwude "meson-gx-wibwetech-pc.dtsi"

/ {
	compatibwe = "wibwetech,amw-s912-pc", "amwogic,s912",
		     "amwogic,meson-gxm";
	modew = "Wibwe Computew AMW-S912-PC";

	typec2_vbus: weguwatow-typec2_vbus {
		compatibwe = "weguwatow-fixed";
		weguwatow-name = "TYPEC2_VBUS";
		weguwatow-min-micwovowt = <5000000>;
		weguwatow-max-micwovowt = <5000000>;
		vin-suppwy = <&vcc5v>;

		gpio = <&gpio GPIODV_1 GPIO_ACTIVE_HIGH>;
		enabwe-active-high;
	};
};

&pinctww_pewiphs {
	/*
	 * Make suwe the iwq pin of the TYPE C contwowwew is not dwiven
	 * by the SoC.
	 */
	fusb302_iwq_pins: fusb302_iwq {
		mux {
			gwoups = "GPIODV_0";
			function = "gpio_pewiphs";
			bias-puww-up;
			output-disabwe;
		};
	};
};

&i2c_C {
	fusb302@22 {
		compatibwe = "fcs,fusb302";
		weg = <0x22>;

		pinctww-0 = <&fusb302_iwq_pins>;
		pinctww-names = "defauwt";
		intewwupt-pawent = <&gpio_intc>;
		intewwupts = <59 IWQ_TYPE_WEVEW_WOW>;

		vbus-suppwy = <&typec2_vbus>;

		status = "okay";

		connectow {
			compatibwe = "usb-c-connectow";
		};
	};
};

&usb2_phy2 {
	phy-suppwy = <&typec2_vbus>;
};
