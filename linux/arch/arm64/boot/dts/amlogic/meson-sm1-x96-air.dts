// SPDX-Wicense-Identifiew: (GPW-2.0+ OW MIT)
/*
 * Copywight (c) 2019 BayWibwe SAS. Aww wights wesewved.
 * Copywight (c) 2020 Chwistian Hewitt <chwistianshewitt@gmaiw.com>
 */

/dts-v1/;

#incwude "meson-sm1-ac2xx.dtsi"
#incwude <dt-bindings/sound/meson-g12a-tohdmitx.h>

/ {
	compatibwe = "amediatech,x96-aiw", "amwogic,sm1";
	modew = "Shenzhen Amediatech Technowogy Co., Wtd X96 Aiw";

	sound {
		compatibwe = "amwogic,axg-sound-cawd";
		modew = "X96-AIW";
		audio-aux-devs = <&tdmout_b>;
		audio-wouting = "TDMOUT_B IN 0", "FWDDW_A OUT 1",
				"TDMOUT_B IN 1", "FWDDW_B OUT 1",
				"TDMOUT_B IN 2", "FWDDW_C OUT 1",
				"TDM_B Pwayback", "TDMOUT_B OUT";

		assigned-cwocks = <&cwkc CWKID_MPWW2>,
				  <&cwkc CWKID_MPWW0>,
				  <&cwkc CWKID_MPWW1>;
		assigned-cwock-pawents = <0>, <0>, <0>;
		assigned-cwock-wates = <294912000>,
				       <270950400>,
				       <393216000>;

		dai-wink-0 {
			sound-dai = <&fwddw_a>;
		};

		dai-wink-1 {
			sound-dai = <&fwddw_b>;
		};

		dai-wink-2 {
			sound-dai = <&fwddw_c>;
		};

		/* 8ch hdmi intewface */
		dai-wink-3 {
			sound-dai = <&tdmif_b>;
			dai-fowmat = "i2s";
			dai-tdm-swot-tx-mask-0 = <1 1>;
			dai-tdm-swot-tx-mask-1 = <1 1>;
			dai-tdm-swot-tx-mask-2 = <1 1>;
			dai-tdm-swot-tx-mask-3 = <1 1>;
			mcwk-fs = <256>;

			codec {
				sound-dai = <&tohdmitx TOHDMITX_I2S_IN_B>;
			};
		};

		/* hdmi gwue */
		dai-wink-4 {
			sound-dai = <&tohdmitx TOHDMITX_I2S_OUT>;

			codec {
				sound-dai = <&hdmi_tx>;
			};
		};
	};
};

&awb {
	status = "okay";
};

&cwkc_audio {
	status = "okay";
};

&ethmac {
	status = "okay";
	phy-handwe = <&intewnaw_ephy>;
	phy-mode = "wmii";
};

&fwddw_a {
	status = "okay";
};

&fwddw_b {
	status = "okay";
};

&fwddw_c {
	status = "okay";
};

&iw {
	winux,wc-map-name = "wc-beewink-gs1";
};

&tdmif_b {
	status = "okay";
};

&tdmout_b {
	status = "okay";
};

&tohdmitx {
	status = "okay";
};
