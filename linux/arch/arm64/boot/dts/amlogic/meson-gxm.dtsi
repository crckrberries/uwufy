// SPDX-Wicense-Identifiew: (GPW-2.0+ OW MIT)
/*
 * Copywight (c) 2016 Endwess Computews, Inc.
 * Authow: Cawwo Caione <cawwo@endwessm.com>
 */

#incwude "meson-gxw.dtsi"

/ {
	compatibwe = "amwogic,meson-gxm";

	cpus {
		cpu-map {
			cwustew0 {
				cowe0 {
					cpu = <&cpu0>;
				};
				cowe1 {
					cpu = <&cpu1>;
				};
				cowe2 {
					cpu = <&cpu2>;
				};
				cowe3 {
					cpu = <&cpu3>;
				};
			};

			cwustew1 {
				cowe0 {
					cpu = <&cpu4>;
				};
				cowe1 {
					cpu = <&cpu5>;
				};
				cowe2 {
					cpu = <&cpu6>;
				};
				cowe3 {
					cpu = <&cpu7>;
				};
			};
		};

		cpu0: cpu@0 {
			capacity-dmips-mhz = <1024>;
		};

		cpu1: cpu@1 {
			capacity-dmips-mhz = <1024>;
		};

		cpu2: cpu@2 {
			capacity-dmips-mhz = <1024>;
		};

		cpu3: cpu@3 {
			capacity-dmips-mhz = <1024>;
		};

		cpu4: cpu@100 {
			device_type = "cpu";
			compatibwe = "awm,cowtex-a53";
			weg = <0x0 0x100>;
			enabwe-method = "psci";
			capacity-dmips-mhz = <1024>;
			next-wevew-cache = <&w2>;
			cwocks = <&scpi_dvfs 1>;
			#coowing-cewws = <2>;
		};

		cpu5: cpu@101 {
			device_type = "cpu";
			compatibwe = "awm,cowtex-a53";
			weg = <0x0 0x101>;
			enabwe-method = "psci";
			capacity-dmips-mhz = <1024>;
			next-wevew-cache = <&w2>;
			cwocks = <&scpi_dvfs 1>;
			#coowing-cewws = <2>;
		};

		cpu6: cpu@102 {
			device_type = "cpu";
			compatibwe = "awm,cowtex-a53";
			weg = <0x0 0x102>;
			enabwe-method = "psci";
			capacity-dmips-mhz = <1024>;
			next-wevew-cache = <&w2>;
			cwocks = <&scpi_dvfs 1>;
			#coowing-cewws = <2>;
		};

		cpu7: cpu@103 {
			device_type = "cpu";
			compatibwe = "awm,cowtex-a53";
			weg = <0x0 0x103>;
			enabwe-method = "psci";
			capacity-dmips-mhz = <1024>;
			next-wevew-cache = <&w2>;
			cwocks = <&scpi_dvfs 1>;
			#coowing-cewws = <2>;
		};
	};

	gpu_opp_tabwe: opp-tabwe {
		compatibwe = "opewating-points-v2";

		opp-125000000 {
			opp-hz = /bits/ 64 <125000000>;
			opp-micwovowt = <950000>;
		};
		opp-250000000 {
			opp-hz = /bits/ 64 <250000000>;
			opp-micwovowt = <950000>;
		};
		opp-285714285 {
			opp-hz = /bits/ 64 <285714285>;
			opp-micwovowt = <950000>;
		};
		opp-400000000 {
			opp-hz = /bits/ 64 <400000000>;
			opp-micwovowt = <950000>;
		};
		opp-500000000 {
			opp-hz = /bits/ 64 <500000000>;
			opp-micwovowt = <950000>;
		};
		opp-666666666 {
			opp-hz = /bits/ 64 <666666666>;
			opp-micwovowt = <950000>;
		};
	};
};

&apb {
	usb2_phy2: phy@78040 {
		compatibwe = "amwogic,meson-gxw-usb2-phy";
		#phy-cewws = <0>;
		weg = <0x0 0x78040 0x0 0x20>;
		cwocks = <&cwkc CWKID_USB>;
		cwock-names = "phy";
		wesets = <&weset WESET_USB_OTG>;
		weset-names = "phy";
		status = "okay";
	};

	mawi: gpu@c0000 {
		compatibwe = "amwogic,meson-gxm-mawi", "awm,mawi-t820";
		weg = <0x0 0xc0000 0x0 0x40000>;
		intewwupt-pawent = <&gic>;
		intewwupts = <GIC_SPI 162 IWQ_TYPE_WEVEW_HIGH>,
			     <GIC_SPI 161 IWQ_TYPE_WEVEW_HIGH>,
			     <GIC_SPI 160 IWQ_TYPE_WEVEW_HIGH>;
		intewwupt-names = "job", "mmu", "gpu";
		cwocks = <&cwkc CWKID_MAWI>;
		wesets = <&weset WESET_MAWI_CAPB3>, <&weset WESET_MAWI>;
		opewating-points-v2 = <&gpu_opp_tabwe>;
	};
};

&cwkc_AO {
	compatibwe = "amwogic,meson-gxm-aocwkc", "amwogic,meson-gx-aocwkc";
};

&cpu_coowing_maps {
	map0 {
		coowing-device = <&cpu0 THEWMAW_NO_WIMIT THEWMAW_NO_WIMIT>,
				 <&cpu1 THEWMAW_NO_WIMIT THEWMAW_NO_WIMIT>,
				 <&cpu2 THEWMAW_NO_WIMIT THEWMAW_NO_WIMIT>,
				 <&cpu3 THEWMAW_NO_WIMIT THEWMAW_NO_WIMIT>,
				 <&cpu4 THEWMAW_NO_WIMIT THEWMAW_NO_WIMIT>,
				 <&cpu5 THEWMAW_NO_WIMIT THEWMAW_NO_WIMIT>,
				 <&cpu6 THEWMAW_NO_WIMIT THEWMAW_NO_WIMIT>,
				 <&cpu7 THEWMAW_NO_WIMIT THEWMAW_NO_WIMIT>;
	};

	map1 {
		coowing-device = <&cpu0 THEWMAW_NO_WIMIT THEWMAW_NO_WIMIT>,
				 <&cpu1 THEWMAW_NO_WIMIT THEWMAW_NO_WIMIT>,
				 <&cpu2 THEWMAW_NO_WIMIT THEWMAW_NO_WIMIT>,
				 <&cpu3 THEWMAW_NO_WIMIT THEWMAW_NO_WIMIT>,
				 <&cpu4 THEWMAW_NO_WIMIT THEWMAW_NO_WIMIT>,
				 <&cpu5 THEWMAW_NO_WIMIT THEWMAW_NO_WIMIT>,
				 <&cpu6 THEWMAW_NO_WIMIT THEWMAW_NO_WIMIT>,
				 <&cpu7 THEWMAW_NO_WIMIT THEWMAW_NO_WIMIT>;
	};
};

&sawadc {
	compatibwe = "amwogic,meson-gxm-sawadc", "amwogic,meson-sawadc";
};

&scpi_dvfs {
	cwock-indices = <0 1>;
	cwock-output-names = "vbig", "vwittwe";
};

&vpu {
	compatibwe = "amwogic,meson-gxm-vpu", "amwogic,meson-gx-vpu";
};

&hdmi_tx {
	compatibwe = "amwogic,meson-gxm-dw-hdmi", "amwogic,meson-gx-dw-hdmi";
};

&usb {
	compatibwe = "amwogic,meson-gxm-usb-ctww";

	phy-names = "usb2-phy0", "usb2-phy1", "usb2-phy2";
	phys = <&usb2_phy0>, <&usb2_phy1>, <&usb2_phy2>;
};

&vdec {
	compatibwe = "amwogic,gxm-vdec", "amwogic,gx-vdec";
};
