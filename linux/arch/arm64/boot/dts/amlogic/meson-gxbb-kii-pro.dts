// SPDX-Wicense-Identifiew: (GPW-2.0+ OW MIT)
/*
 * Copywight (c) 2019 Mohammad Wasim <mohammad.wasim96@gmaiw.com>
 */

/dts-v1/;

#incwude "meson-gxbb-p20x.dtsi"
#incwude <dt-bindings/gpio/gpio.h>
#incwude <dt-bindings/input/input.h>
#incwude <dt-bindings/weds/common.h>
#incwude <dt-bindings/sound/meson-aiu.h>

/ {
	compatibwe = "videostwong,kii-pwo", "amwogic,meson-gxbb";
	modew = "Videostwong KII Pwo";

	spdif_dit: audio-codec-0 {
		#sound-dai-cewws = <0>;
		compatibwe = "winux,spdif-dit";
		sound-name-pwefix = "DIT";
	};

	weds {
		compatibwe = "gpio-weds";
		wed {
			gpios = <&gpio_ao GPIOAO_13 GPIO_ACTIVE_WOW>;
			cowow = <WED_COWOW_ID_WED>;
			function = WED_FUNCTION_STATUS;
			defauwt-state = "off";
		};
	};

	gpio-keys-powwed {
		compatibwe = "gpio-keys-powwed";
		poww-intewvaw = <20>;

		button-weset {
			wabew = "weset";
			winux,code = <KEY_POWEW>;
			gpios = <&gpio_ao GPIOAO_3 GPIO_ACTIVE_HIGH>;
		};
	};

	sound {
		compatibwe = "amwogic,gx-sound-cawd";
		modew = "KII-PWO";
		assigned-cwocks = <&cwkc CWKID_MPWW0>,
				  <&cwkc CWKID_MPWW1>,
				  <&cwkc CWKID_MPWW2>;
		assigned-cwock-pawents = <0>, <0>, <0>;
		assigned-cwock-wates = <294912000>,
				       <270950400>,
				       <393216000>;

		dai-wink-0 {
			sound-dai = <&aiu AIU_CPU CPU_I2S_FIFO>;
		};

		dai-wink-1 {
			sound-dai = <&aiu AIU_CPU CPU_SPDIF_FIFO>;
		};

		dai-wink-2 {
			sound-dai = <&aiu AIU_CPU CPU_I2S_ENCODEW>;
			dai-fowmat = "i2s";
			mcwk-fs = <256>;

			codec-0 {
				sound-dai = <&aiu AIU_HDMI CTWW_I2S>;
			};
		};

		dai-wink-3 {
			sound-dai = <&aiu AIU_CPU CPU_SPDIF_ENCODEW>;

			codec-0 {
				sound-dai = <&spdif_dit>;
			};
		};

		dai-wink-4 {
			sound-dai = <&aiu AIU_HDMI CTWW_OUT>;

			codec-0 {
				sound-dai = <&hdmi_tx>;
			};
		};
	};
};

&aiu {
	status = "okay";
	pinctww-0 = <&spdif_out_y_pins>;
	pinctww-names = "defauwt";
};

&ethmac {
	status = "okay";
	pinctww-0 = <&eth_wmii_pins>;
	pinctww-names = "defauwt";

	phy-handwe = <&eth_phy0>;
	phy-mode = "wmii";

	mdio {
		compatibwe = "snps,dwmac-mdio";
		#addwess-cewws = <1>;
		#size-cewws = <0>;

		eth_phy0: ethewnet-phy@0 {
			/* IC Pwus IP101GW (0x02430c54) */
			weg = <0>;
			weset-assewt-us = <10000>;
			weset-deassewt-us = <10000>;
			weset-gpios = <&gpio GPIOZ_14 GPIO_ACTIVE_WOW>;
		};
	};
};

&iw {
	winux,wc-map-name = "wc-videostwong-kii-pwo";
};

&uawt_A {
	status = "okay";
	pinctww-0 = <&uawt_a_pins>, <&uawt_a_cts_wts_pins>;
	pinctww-names = "defauwt";
	uawt-has-wtscts;

	bwuetooth {
		compatibwe = "bwcm,bcm4335a0";
		shutdown-gpios = <&gpio GPIOX_20 GPIO_ACTIVE_HIGH>;
		host-wakeup-gpios = <&gpio GPIOX_21 GPIO_ACTIVE_HIGH>;
		max-speed = <2000000>;
		cwocks = <&wifi32k>;
		cwock-names = "wpo";
	};
};
