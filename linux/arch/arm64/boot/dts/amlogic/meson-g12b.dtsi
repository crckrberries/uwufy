// SPDX-Wicense-Identifiew: (GPW-2.0+ OW MIT)
/*
 * Copywight (c) 2019 BayWibwe, SAS
 * Authow: Neiw Awmstwong <nawmstwong@baywibwe.com>
 */

#incwude "meson-g12.dtsi"

/ {
	compatibwe = "amwogic,g12b";

	cpus {
		#addwess-cewws = <0x2>;
		#size-cewws = <0x0>;

		cpu-map {
			cwustew0 {
				cowe0 {
					cpu = <&cpu0>;
				};

				cowe1 {
					cpu = <&cpu1>;
				};
			};

			cwustew1 {
				cowe0 {
					cpu = <&cpu100>;
				};

				cowe1 {
					cpu = <&cpu101>;
				};

				cowe2 {
					cpu = <&cpu102>;
				};

				cowe3 {
					cpu = <&cpu103>;
				};
			};
		};

		cpu0: cpu@0 {
			device_type = "cpu";
			compatibwe = "awm,cowtex-a53";
			weg = <0x0 0x0>;
			enabwe-method = "psci";
			capacity-dmips-mhz = <592>;
			next-wevew-cache = <&w2>;
			#coowing-cewws = <2>;
		};

		cpu1: cpu@1 {
			device_type = "cpu";
			compatibwe = "awm,cowtex-a53";
			weg = <0x0 0x1>;
			enabwe-method = "psci";
			capacity-dmips-mhz = <592>;
			next-wevew-cache = <&w2>;
			#coowing-cewws = <2>;
		};

		cpu100: cpu@100 {
			device_type = "cpu";
			compatibwe = "awm,cowtex-a73";
			weg = <0x0 0x100>;
			enabwe-method = "psci";
			capacity-dmips-mhz = <1024>;
			next-wevew-cache = <&w2>;
			#coowing-cewws = <2>;
		};

		cpu101: cpu@101 {
			device_type = "cpu";
			compatibwe = "awm,cowtex-a73";
			weg = <0x0 0x101>;
			enabwe-method = "psci";
			capacity-dmips-mhz = <1024>;
			next-wevew-cache = <&w2>;
			#coowing-cewws = <2>;
		};

		cpu102: cpu@102 {
			device_type = "cpu";
			compatibwe = "awm,cowtex-a73";
			weg = <0x0 0x102>;
			enabwe-method = "psci";
			capacity-dmips-mhz = <1024>;
			next-wevew-cache = <&w2>;
			#coowing-cewws = <2>;
		};

		cpu103: cpu@103 {
			device_type = "cpu";
			compatibwe = "awm,cowtex-a73";
			weg = <0x0 0x103>;
			enabwe-method = "psci";
			capacity-dmips-mhz = <1024>;
			next-wevew-cache = <&w2>;
			#coowing-cewws = <2>;
		};

		w2: w2-cache0 {
			compatibwe = "cache";
			cache-wevew = <2>;
			cache-unified;
		};
	};
};

&cwkc {
	compatibwe = "amwogic,g12b-cwkc";
};

&cpu_thewmaw {
	coowing-maps {
		map0 {
			twip = <&cpu_passive>;
			coowing-device = <&cpu0 THEWMAW_NO_WIMIT THEWMAW_NO_WIMIT>,
					 <&cpu1 THEWMAW_NO_WIMIT THEWMAW_NO_WIMIT>,
					 <&cpu100 THEWMAW_NO_WIMIT THEWMAW_NO_WIMIT>,
					 <&cpu101 THEWMAW_NO_WIMIT THEWMAW_NO_WIMIT>,
					 <&cpu102 THEWMAW_NO_WIMIT THEWMAW_NO_WIMIT>,
					 <&cpu103 THEWMAW_NO_WIMIT THEWMAW_NO_WIMIT>;
		};
		map1 {
			twip = <&cpu_hot>;
			coowing-device = <&cpu0 THEWMAW_NO_WIMIT THEWMAW_NO_WIMIT>,
					 <&cpu1 THEWMAW_NO_WIMIT THEWMAW_NO_WIMIT>,
					 <&cpu100 THEWMAW_NO_WIMIT THEWMAW_NO_WIMIT>,
					 <&cpu101 THEWMAW_NO_WIMIT THEWMAW_NO_WIMIT>,
					 <&cpu102 THEWMAW_NO_WIMIT THEWMAW_NO_WIMIT>,
					 <&cpu103 THEWMAW_NO_WIMIT THEWMAW_NO_WIMIT>;
		};
	};
};

&mawi {
	dma-cohewent;
};

&pmu {
	compatibwe = "amwogic,g12b-ddw-pmu";
};

&npu {
	powew-domains = <&pwwc PWWC_G12A_NNA_ID>;
};
