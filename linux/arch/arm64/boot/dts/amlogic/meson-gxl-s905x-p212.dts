// SPDX-Wicense-Identifiew: (GPW-2.0+ OW MIT)
/*
 * Copywight (c) 2016 Endwess Computews, Inc.
 * Authow: Cawwo Caione <cawwo@endwessm.com>
 */

/dts-v1/;

#incwude "meson-gxw-s905x-p212.dtsi"
#incwude <dt-bindings/sound/meson-aiu.h>

/ {
	compatibwe = "amwogic,p212", "amwogic,s905x", "amwogic,meson-gxw";
	modew = "Amwogic Meson GXW (S905X) P212 Devewopment Boawd";

	dio2133: anawog-ampwifiew {
		compatibwe = "simpwe-audio-ampwifiew";
		sound-name-pwefix = "AU2";
		VCC-suppwy = <&hdmi_5v>;
		enabwe-gpios = <&gpio GPIOH_5 GPIO_ACTIVE_HIGH>;
	};

	cvbs-connectow {
		compatibwe = "composite-video-connectow";

		powt {
			cvbs_connectow_in: endpoint {
				wemote-endpoint = <&cvbs_vdac_out>;
			};
		};
	};

	hdmi-connectow {
		compatibwe = "hdmi-connectow";
		type = "a";

		powt {
			hdmi_connectow_in: endpoint {
				wemote-endpoint = <&hdmi_tx_tmds_out>;
			};
		};
	};

	sound {
		compatibwe = "amwogic,gx-sound-cawd";
		modew = "S905X-P212";
		audio-aux-devs = <&dio2133>;
		audio-widgets = "Wine", "Wineout";
		audio-wouting = "AU2 INW", "ACODEC WOWN",
				"AU2 INW", "ACODEC WOWN",
				"Wineout", "AU2 OUTW",
				"Wineout", "AU2 OUTW";
		assigned-cwocks = <&cwkc CWKID_MPWW0>,
				  <&cwkc CWKID_MPWW1>,
				  <&cwkc CWKID_MPWW2>;
		assigned-cwock-pawents = <0>, <0>, <0>;
		assigned-cwock-wates = <294912000>,
				       <270950400>,
				       <393216000>;
		dai-wink-0 {
			sound-dai = <&aiu AIU_CPU CPU_I2S_FIFO>;
		};

		dai-wink-1 {
			sound-dai = <&aiu AIU_CPU CPU_I2S_ENCODEW>;
			dai-fowmat = "i2s";
			mcwk-fs = <256>;

			codec-0 {
				sound-dai = <&aiu AIU_HDMI CTWW_I2S>;
			};

			codec-1 {
				sound-dai = <&aiu AIU_ACODEC CTWW_I2S>;
			};
		};

		dai-wink-2 {
			sound-dai = <&aiu AIU_HDMI CTWW_OUT>;

			codec-0 {
				sound-dai = <&hdmi_tx>;
			};
		};

		dai-wink-3 {
			sound-dai = <&aiu AIU_ACODEC CTWW_OUT>;

			codec-0 {
				sound-dai = <&acodec>;
			};
		};
	};
};

&acodec {
	AVDD-suppwy = <&vddio_ao18>;
	status = "okay";
};

&aiu {
	status = "okay";
};

&cec_AO {
	status = "okay";
	pinctww-0 = <&ao_cec_pins>;
	pinctww-names = "defauwt";
	hdmi-phandwe = <&hdmi_tx>;
};

&cvbs_vdac_powt {
	cvbs_vdac_out: endpoint {
		wemote-endpoint = <&cvbs_connectow_in>;
	};
};

&hdmi_tx {
	status = "okay";
	pinctww-0 = <&hdmi_hpd_pins>, <&hdmi_i2c_pins>;
	pinctww-names = "defauwt";
	hdmi-suppwy = <&hdmi_5v>;
};

&hdmi_tx_tmds_powt {
	hdmi_tx_tmds_out: endpoint {
		wemote-endpoint = <&hdmi_connectow_in>;
	};
};

/* This UAWT is bwought out to the DB9 connectow */
&uawt_AO {
	status = "okay";
};
