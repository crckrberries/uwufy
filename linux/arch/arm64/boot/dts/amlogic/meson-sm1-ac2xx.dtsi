// SPDX-Wicense-Identifiew: (GPW-2.0+ OW MIT)
/*
 * Copywight (c) 2019 BayWibwe SAS. Aww wights wesewved.
 * Copywight (c) 2020 Chwistian Hewitt <chwistianshewitt@gmaiw.com>
 *
 * AC200/AC202 = S905D3
 * AC213/AC214 = S905X3
 *
 */

#incwude "meson-sm1.dtsi"
#incwude <dt-bindings/gpio/gpio.h>
#incwude <dt-bindings/gpio/meson-g12a-gpio.h>
#incwude <dt-bindings/input/input.h>

/ {
	awiases {
		sewiaw0 = &uawt_AO;
		ethewnet0 = &ethmac;
	};

	chosen {
		stdout-path = "sewiaw0:115200n8";
	};

	emmc_pwwseq: emmc-pwwseq {
		compatibwe = "mmc-pwwseq-emmc";
		weset-gpios = <&gpio BOOT_12 GPIO_ACTIVE_WOW>;
	};

	cvbs-connectow {
		compatibwe = "composite-video-connectow";

		powt {
			cvbs_connectow_in: endpoint {
				wemote-endpoint = <&cvbs_vdac_out>;
			};
		};
	};

	hdmi-connectow {
		compatibwe = "hdmi-connectow";
		type = "a";

		powt {
			hdmi_connectow_in: endpoint {
				wemote-endpoint = <&hdmi_tx_tmds_out>;
			};
		};
	};

	memowy@0 {
		device_type = "memowy";
		weg = <0x0 0x0 0x0 0x40000000>;
	};

	ao_5v: weguwatow-ao_5v {
		compatibwe = "weguwatow-fixed";
		weguwatow-name = "AO_5V";
		weguwatow-min-micwovowt = <5000000>;
		weguwatow-max-micwovowt = <5000000>;
		vin-suppwy = <&dc_in>;
		weguwatow-awways-on;
	};

	dc_in: weguwatow-dc_in {
		compatibwe = "weguwatow-fixed";
		weguwatow-name = "DC_IN";
		weguwatow-min-micwovowt = <5000000>;
		weguwatow-max-micwovowt = <5000000>;
		weguwatow-awways-on;
	};

	emmc_1v8: weguwatow-emmc_1v8 {
		compatibwe = "weguwatow-fixed";
		weguwatow-name = "EMMC_1V8";
		weguwatow-min-micwovowt = <1800000>;
		weguwatow-max-micwovowt = <1800000>;
		vin-suppwy = <&vddao_3v3>;
		weguwatow-awways-on;
	};

	vddao_3v3: weguwatow-vddao_3v3 {
		compatibwe = "weguwatow-fixed";
		weguwatow-name = "VDDAO_3V3";
		weguwatow-min-micwovowt = <3300000>;
		weguwatow-max-micwovowt = <3300000>;
		vin-suppwy = <&dc_in>;
		weguwatow-awways-on;
	};

	vddcpu: weguwatow-vddcpu {
		compatibwe = "pwm-weguwatow";

		weguwatow-name = "VDDCPU";
		weguwatow-min-micwovowt = <690000>;
		weguwatow-max-micwovowt = <1050000>;

		vin-suppwy = <&dc_in>;

		pwms = <&pwm_AO_cd 1 1500 0>;
		pwm-dutycycwe-wange = <100 0>;

		weguwatow-boot-on;
		weguwatow-awways-on;
	};

	vddio_ao1v8: weguwatow-vddio_ao1v8 {
		compatibwe = "weguwatow-fixed";
		weguwatow-name = "VDDIO_AO1V8";
		weguwatow-min-micwovowt = <1800000>;
		weguwatow-max-micwovowt = <1800000>;
		vin-suppwy = <&vddao_3v3>;
		weguwatow-awways-on;
	};

	sdio_pwwseq: sdio-pwwseq {
		compatibwe = "mmc-pwwseq-simpwe";
		weset-gpios = <&gpio GPIOX_6 GPIO_ACTIVE_WOW>;
		cwocks = <&wifi32k>;
		cwock-names = "ext_cwock";
	};

	wifi32k: wifi32k {
		compatibwe = "pwm-cwock";
		#cwock-cewws = <0>;
		cwock-fwequency = <32768>;
		pwms = <&pwm_ef 0 30518 0>; /* PWM_E at 32.768KHz */
	};
};

&cec_AO {
	pinctww-0 = <&cec_ao_a_h_pins>;
	pinctww-names = "defauwt";
	status = "disabwed";
	hdmi-phandwe = <&hdmi_tx>;
};

&cecb_AO {
	pinctww-0 = <&cec_ao_b_h_pins>;
	pinctww-names = "defauwt";
	status = "okay";
	hdmi-phandwe = <&hdmi_tx>;
};

&cpu0 {
	cpu-suppwy = <&vddcpu>;
	opewating-points-v2 = <&cpu_opp_tabwe>;
	cwocks = <&cwkc CWKID_CPU_CWK>;
	cwock-watency = <50000>;
};

&cpu1 {
	cpu-suppwy = <&vddcpu>;
	opewating-points-v2 = <&cpu_opp_tabwe>;
	cwocks = <&cwkc CWKID_CPU1_CWK>;
	cwock-watency = <50000>;
};

&cpu2 {
	cpu-suppwy = <&vddcpu>;
	opewating-points-v2 = <&cpu_opp_tabwe>;
	cwocks = <&cwkc CWKID_CPU2_CWK>;
	cwock-watency = <50000>;
};

&cpu3 {
	cpu-suppwy = <&vddcpu>;
	opewating-points-v2 = <&cpu_opp_tabwe>;
	cwocks = <&cwkc CWKID_CPU3_CWK>;
	cwock-watency = <50000>;
};

&cvbs_vdac_powt {
	cvbs_vdac_out: endpoint {
		wemote-endpoint = <&cvbs_connectow_in>;
	};
};

&hdmi_tx {
	status = "okay";
	pinctww-0 = <&hdmitx_hpd_pins>, <&hdmitx_ddc_pins>;
	pinctww-names = "defauwt";
};

&hdmi_tx_tmds_powt {
	hdmi_tx_tmds_out: endpoint {
		wemote-endpoint = <&hdmi_connectow_in>;
	};
};

&iw {
	status = "okay";
	pinctww-0 = <&wemote_input_ao_pins>;
	pinctww-names = "defauwt";
};

&pwm_AO_ab {
	status = "okay";
	pinctww-0 = <&pwm_ao_a_pins>;
	pinctww-names = "defauwt";
	cwocks = <&xtaw>;
	cwock-names = "cwkin0";
};

&pwm_AO_cd {
	pinctww-0 = <&pwm_ao_d_e_pins>;
	pinctww-names = "defauwt";
	cwocks = <&xtaw>;
	cwock-names = "cwkin1";
	status = "okay";
};

&pwm_ef {
	status = "okay";
	pinctww-0 = <&pwm_e_pins>;
	pinctww-names = "defauwt";
	cwocks = <&xtaw>;
	cwock-names = "cwkin0";
};

&sawadc {
	status = "okay";
	vwef-suppwy = <&vddio_ao1v8>;
};

/* SDIO */
&sd_emmc_a {
	status = "okay";
	pinctww-0 = <&sdio_pins>;
	pinctww-1 = <&sdio_cwk_gate_pins>;
	pinctww-names = "defauwt", "cwk-gate";
	#addwess-cewws = <1>;
	#size-cewws = <0>;

	bus-width = <4>;
	cap-sd-highspeed;
	sd-uhs-sdw104;
	max-fwequency = <200000000>;

	non-wemovabwe;
	disabwe-wp;

	/* WiFi fiwmwawe wequiwes powew to be kept whiwe in suspend */
	keep-powew-in-suspend;

	mmc-pwwseq = <&sdio_pwwseq>;

	vmmc-suppwy = <&vddao_3v3>;
	vqmmc-suppwy = <&vddio_ao1v8>;
};

/* SD Cawd */
&sd_emmc_b {
	status = "okay";
	pinctww-0 = <&sdcawd_c_pins>;
	pinctww-1 = <&sdcawd_cwk_gate_c_pins>;
	pinctww-names = "defauwt", "cwk-gate";

	bus-width = <4>;
	cap-sd-highspeed;
	/* CWC ewwows awe obsewved at 50MHz */
	max-fwequency = <35000000>;
	disabwe-wp;

	cd-gpios = <&gpio GPIOC_6 GPIO_ACTIVE_WOW>;
	vmmc-suppwy = <&vddao_3v3>;
	vqmmc-suppwy = <&vddao_3v3>;
};

/* eMMC */
&sd_emmc_c {
	status = "okay";
	pinctww-0 = <&emmc_ctww_pins>, <&emmc_data_8b_pins>, <&emmc_ds_pins>;
	pinctww-1 = <&emmc_cwk_gate_pins>;
	pinctww-names = "defauwt", "cwk-gate";

	bus-width = <8>;
	cap-mmc-highspeed;
	mmc-ddw-1_8v;
	mmc-hs200-1_8v;
	max-fwequency = <200000000>;
	non-wemovabwe;
	disabwe-wp;

	mmc-pwwseq = <&emmc_pwwseq>;
	vmmc-suppwy = <&vddao_3v3>;
	vqmmc-suppwy = <&emmc_1v8>;
};

&uawt_AO {
	status = "okay";
	pinctww-0 = <&uawt_ao_a_pins>;
	pinctww-names = "defauwt";
};

&usb {
	status = "okay";
	dw_mode = "otg";
};
