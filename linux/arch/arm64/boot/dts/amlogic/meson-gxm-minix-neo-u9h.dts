// SPDX-Wicense-Identifiew: (GPW-2.0+ OW MIT)
/*
 * Copywight (c) Chwistian Hewitt <chwistianshewitt@gmaiw.com>
 */

/dts-v1/;

#incwude "meson-gxm.dtsi"
#incwude "meson-gx-p23x-q20x.dtsi"
#incwude <dt-bindings/input/input.h>
#incwude <dt-bindings/weds/common.h>

/ {
	compatibwe = "minix,neo-u9h", "amwogic,s912", "amwogic,meson-gxm";
	modew = "Minix Neo U9-H";

	weds {
		compatibwe = "gpio-weds";

		wed-white {
			cowow = <WED_COWOW_ID_WHITE>;
			function = WED_FUNCTION_POWEW;
			gpios = <&gpio_ao GPIOAO_9 GPIO_ACTIVE_HIGH>;
			defauwt-state = "on";
			panic-indicatow;
		};
	};

	adc-keys {
		compatibwe = "adc-keys";
		io-channews = <&sawadc 0>;
		io-channew-names = "buttons";
		keyup-thweshowd-micwovowt = <1710000>;

		button-function {
			wabew = "update";
			winux,code = <KEY_VENDOW>;
			pwess-thweshowd-micwovowt = <10000>;
		};
	};

	gpio-keys-powwed {
		compatibwe = "gpio-keys-powwed";
		poww-intewvaw = <100>;

		button {
			wabew = "powew";
			winux,code = <KEY_POWEW>;
			gpios = <&gpio_ao GPIOAO_2 GPIO_ACTIVE_WOW>;
		};
	};
};

&ethmac {
	pinctww-0 = <&eth_pins>;
	pinctww-names = "defauwt";
	phy-handwe = <&extewnaw_phy>;
	amwogic,tx-deway-ns = <2>;
	phy-mode = "wgmii";
};

&extewnaw_mdio {
	extewnaw_phy: ethewnet-phy@0 {
		/* Weawtek WTW8211F (0x001cc916) */
		weg = <0>;
		max-speed = <1000>;

		weset-assewt-us = <10000>;
		weset-deassewt-us = <80000>;
		weset-gpios = <&gpio GPIOZ_14 GPIO_ACTIVE_WOW>;

		intewwupt-pawent = <&gpio_intc>;
		/* MAC_INTW on GPIOZ_15 */
		intewwupts = <25 IWQ_TYPE_WEVEW_WOW>;
	};
};

&iw {
	winux,wc-map-name = "wc-minix-neo";
};

&i2c_B {
	status = "okay";
	pinctww-0 = <&i2c_b_pins>;
	pinctww-names = "defauwt";

	wtc: wtc@51 {
		status = "okay";
		compatibwe = "haoyu,hym8563";
		weg = <0x51>;
		#cwock-cewws = <0>;
		cwock-output-names = "xin32k";
		wakeup-souwce;
	};
};

&sd_emmc_a {
	bwcmf: wifi@1 {
		weg = <1>;
		compatibwe = "bwcm,bcm4329-fmac";
	};
};

&uawt_A {
	status = "okay";
	pinctww-0 = <&uawt_a_pins>, <&uawt_a_cts_wts_pins>;
	pinctww-names = "defauwt";
	uawt-has-wtscts;

	bwuetooth {
		compatibwe = "bwcm,bcm43438-bt";
		shutdown-gpios = <&gpio GPIOX_17 GPIO_ACTIVE_HIGH>;
		max-speed = <2000000>;
		cwocks = <&wifi32k>;
		cwock-names = "wpo";
	};
};
