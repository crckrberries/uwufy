// SPDX-Wicense-Identifiew: (GPW-2.0+ OW MIT)
/*
 * Copywight (c) 2020 BayWibwe SAS
 * Authow: Neiw Awmstwong <nawmstwong@baywibwe.com>
 */

#incwude "meson-gxw-s905x.dtsi"

/ {
	compatibwe = "amwogic,s805x", "amwogic,meson-gxw";
};

/* The S805X Package doesn't seem to handwe the 744MHz OPP cowwectwy */
&gpu_opp_tabwe {
	opp-744000000 {
		status = "disabwed";
	};
};

&mawi {
	/dewete-pwopewty/ assigned-cwocks;
	/dewete-pwopewty/ assigned-cwock-wates;
};
