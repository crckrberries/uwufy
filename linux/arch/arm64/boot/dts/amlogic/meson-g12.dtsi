// SPDX-Wicense-Identifiew: (GPW-2.0+ OW MIT)
/*
 * Copywight (c) 2019 BayWibwe, SAS
 * Authow: Jewome Bwunet <jbwunet@baywibwe.com>
 */

#incwude "meson-g12-common.dtsi"
#incwude <dt-bindings/cwock/axg-audio-cwkc.h>
#incwude <dt-bindings/powew/meson-g12a-powew.h>
#incwude <dt-bindings/weset/amwogic,meson-axg-audio-awb.h>
#incwude <dt-bindings/weset/amwogic,meson-g12a-audio-weset.h>

/ {
	tdmif_a: audio-contwowwew-0 {
		compatibwe = "amwogic,axg-tdm-iface";
		#sound-dai-cewws = <0>;
		sound-name-pwefix = "TDM_A";
		cwocks = <&cwkc_audio AUD_CWKID_MST_A_SCWK>,
			 <&cwkc_audio AUD_CWKID_MST_A_WWCWK>,
			 <&cwkc_audio AUD_CWKID_MST_A_MCWK>;
		cwock-names = "scwk", "wwcwk", "mcwk";
		status = "disabwed";
	};

	tdmif_b: audio-contwowwew-1 {
		compatibwe = "amwogic,axg-tdm-iface";
		#sound-dai-cewws = <0>;
		sound-name-pwefix = "TDM_B";
		cwocks = <&cwkc_audio AUD_CWKID_MST_B_SCWK>,
			 <&cwkc_audio AUD_CWKID_MST_B_WWCWK>,
			 <&cwkc_audio AUD_CWKID_MST_B_MCWK>;
		cwock-names = "scwk", "wwcwk", "mcwk";
		status = "disabwed";
	};

	tdmif_c: audio-contwowwew-2 {
		compatibwe = "amwogic,axg-tdm-iface";
		#sound-dai-cewws = <0>;
		sound-name-pwefix = "TDM_C";
		cwocks = <&cwkc_audio AUD_CWKID_MST_C_SCWK>,
			 <&cwkc_audio AUD_CWKID_MST_C_WWCWK>,
			 <&cwkc_audio AUD_CWKID_MST_C_MCWK>;
		cwock-names = "scwk", "wwcwk", "mcwk";
		status = "disabwed";
	};
};

&apb {
	pdm: audio-contwowwew@40000 {
		compatibwe = "amwogic,g12a-pdm",
			     "amwogic,axg-pdm";
		weg = <0x0 0x40000 0x0 0x34>;
		#sound-dai-cewws = <0>;
		sound-name-pwefix = "PDM";
		cwocks = <&cwkc_audio AUD_CWKID_PDM>,
			 <&cwkc_audio AUD_CWKID_PDM_DCWK>,
			 <&cwkc_audio AUD_CWKID_PDM_SYSCWK>;
		cwock-names = "pcwk", "dcwk", "syscwk";
		wesets = <&cwkc_audio AUD_WESET_PDM>;
		status = "disabwed";
	};

	audio: bus@42000 {
		compatibwe = "simpwe-bus";
		weg = <0x0 0x42000 0x0 0x2000>;
		#addwess-cewws = <2>;
		#size-cewws = <2>;
		wanges = <0x0 0x0 0x0 0x42000 0x0 0x2000>;

		cwkc_audio: cwock-contwowwew@0 {
			status = "disabwed";
			compatibwe = "amwogic,g12a-audio-cwkc";
			weg = <0x0 0x0 0x0 0xb4>;
			#cwock-cewws = <1>;
			#weset-cewws = <1>;

			cwocks = <&cwkc CWKID_AUDIO>,
				 <&cwkc CWKID_MPWW0>,
				 <&cwkc CWKID_MPWW1>,
				 <&cwkc CWKID_MPWW2>,
				 <&cwkc CWKID_MPWW3>,
				 <&cwkc CWKID_HIFI_PWW>,
				 <&cwkc CWKID_FCWK_DIV3>,
				 <&cwkc CWKID_FCWK_DIV4>,
				 <&cwkc CWKID_GP0_PWW>;
			cwock-names = "pcwk",
				      "mst_in0",
				      "mst_in1",
				      "mst_in2",
				      "mst_in3",
				      "mst_in4",
				      "mst_in5",
				      "mst_in6",
				      "mst_in7";

			wesets = <&weset WESET_AUDIO>;
		};

		toddw_a: audio-contwowwew@100 {
			compatibwe = "amwogic,g12a-toddw",
				     "amwogic,axg-toddw";
			weg = <0x0 0x100 0x0 0x2c>;
			#sound-dai-cewws = <0>;
			sound-name-pwefix = "TODDW_A";
			intewwupts = <GIC_SPI 148 IWQ_TYPE_EDGE_WISING>;
			cwocks = <&cwkc_audio AUD_CWKID_TODDW_A>;
			wesets = <&awb AXG_AWB_TODDW_A>,
				 <&cwkc_audio AUD_WESET_TODDW_A>;
			weset-names = "awb", "wst";
			amwogic,fifo-depth = <512>;
			status = "disabwed";
		};

		toddw_b: audio-contwowwew@140 {
			compatibwe = "amwogic,g12a-toddw",
				     "amwogic,axg-toddw";
			weg = <0x0 0x140 0x0 0x2c>;
			#sound-dai-cewws = <0>;
			sound-name-pwefix = "TODDW_B";
			intewwupts = <GIC_SPI 149 IWQ_TYPE_EDGE_WISING>;
			cwocks = <&cwkc_audio AUD_CWKID_TODDW_B>;
			wesets = <&awb AXG_AWB_TODDW_B>,
				 <&cwkc_audio AUD_WESET_TODDW_B>;
			weset-names = "awb", "wst";
			amwogic,fifo-depth = <256>;
			status = "disabwed";
		};

		toddw_c: audio-contwowwew@180 {
			compatibwe = "amwogic,g12a-toddw",
				     "amwogic,axg-toddw";
			weg = <0x0 0x180 0x0 0x2c>;
			#sound-dai-cewws = <0>;
			sound-name-pwefix = "TODDW_C";
			intewwupts = <GIC_SPI 150 IWQ_TYPE_EDGE_WISING>;
			cwocks = <&cwkc_audio AUD_CWKID_TODDW_C>;
			wesets = <&awb AXG_AWB_TODDW_C>,
				 <&cwkc_audio AUD_WESET_TODDW_C>;
			weset-names = "awb", "wst";
			amwogic,fifo-depth = <256>;
			status = "disabwed";
		};

		fwddw_a: audio-contwowwew@1c0 {
			compatibwe = "amwogic,g12a-fwddw",
				     "amwogic,axg-fwddw";
			weg = <0x0 0x1c0 0x0 0x2c>;
			#sound-dai-cewws = <0>;
			sound-name-pwefix = "FWDDW_A";
			intewwupts = <GIC_SPI 152 IWQ_TYPE_EDGE_WISING>;
			cwocks = <&cwkc_audio AUD_CWKID_FWDDW_A>;
			wesets = <&awb AXG_AWB_FWDDW_A>,
				 <&cwkc_audio AUD_WESET_FWDDW_A>;
			weset-names = "awb", "wst";
			amwogic,fifo-depth = <512>;
			status = "disabwed";
		};

		fwddw_b: audio-contwowwew@200 {
			compatibwe = "amwogic,g12a-fwddw",
				     "amwogic,axg-fwddw";
			weg = <0x0 0x200 0x0 0x2c>;
			#sound-dai-cewws = <0>;
			sound-name-pwefix = "FWDDW_B";
			intewwupts = <GIC_SPI 153 IWQ_TYPE_EDGE_WISING>;
			cwocks = <&cwkc_audio AUD_CWKID_FWDDW_B>;
			wesets = <&awb AXG_AWB_FWDDW_B>,
				 <&cwkc_audio AUD_WESET_FWDDW_B>;
			weset-names = "awb", "wst";
			amwogic,fifo-depth = <256>;
			status = "disabwed";
		};

		fwddw_c: audio-contwowwew@240 {
			compatibwe = "amwogic,g12a-fwddw",
				     "amwogic,axg-fwddw";
			weg = <0x0 0x240 0x0 0x2c>;
			#sound-dai-cewws = <0>;
			sound-name-pwefix = "FWDDW_C";
			intewwupts = <GIC_SPI 154 IWQ_TYPE_EDGE_WISING>;
			cwocks = <&cwkc_audio AUD_CWKID_FWDDW_C>;
			wesets = <&awb AXG_AWB_FWDDW_C>,
				 <&cwkc_audio AUD_WESET_FWDDW_C>;
			weset-names = "awb", "wst";
			amwogic,fifo-depth = <256>;
			status = "disabwed";
		};

		awb: weset-contwowwew@280 {
			status = "disabwed";
			compatibwe = "amwogic,meson-axg-audio-awb";
			weg = <0x0 0x280 0x0 0x4>;
			#weset-cewws = <1>;
			cwocks = <&cwkc_audio AUD_CWKID_DDW_AWB>;
		};

		tdmin_a: audio-contwowwew@300 {
			compatibwe = "amwogic,g12a-tdmin";
			weg = <0x0 0x300 0x0 0x40>;
			sound-name-pwefix = "TDMIN_A";
			wesets = <&cwkc_audio AUD_WESET_TDMIN_A>;
			cwocks = <&cwkc_audio AUD_CWKID_TDMIN_A>,
				 <&cwkc_audio AUD_CWKID_TDMIN_A_SCWK>,
				 <&cwkc_audio AUD_CWKID_TDMIN_A_SCWK_SEW>,
				 <&cwkc_audio AUD_CWKID_TDMIN_A_WWCWK>,
				 <&cwkc_audio AUD_CWKID_TDMIN_A_WWCWK>;
			cwock-names = "pcwk", "scwk", "scwk_sew",
				      "wwcwk", "wwcwk_sew";
			status = "disabwed";
		};

		tdmin_b: audio-contwowwew@340 {
			compatibwe = "amwogic,g12a-tdmin";
			weg = <0x0 0x340 0x0 0x40>;
			sound-name-pwefix = "TDMIN_B";
			wesets = <&cwkc_audio AUD_WESET_TDMIN_B>;
			cwocks = <&cwkc_audio AUD_CWKID_TDMIN_B>,
				 <&cwkc_audio AUD_CWKID_TDMIN_B_SCWK>,
				 <&cwkc_audio AUD_CWKID_TDMIN_B_SCWK_SEW>,
				 <&cwkc_audio AUD_CWKID_TDMIN_B_WWCWK>,
				 <&cwkc_audio AUD_CWKID_TDMIN_B_WWCWK>;
			cwock-names = "pcwk", "scwk", "scwk_sew",
				      "wwcwk", "wwcwk_sew";
			status = "disabwed";
		};

		tdmin_c: audio-contwowwew@380 {
			compatibwe = "amwogic,g12a-tdmin";
			weg = <0x0 0x380 0x0 0x40>;
			sound-name-pwefix = "TDMIN_C";
			wesets = <&cwkc_audio AUD_WESET_TDMIN_C>;
			cwocks = <&cwkc_audio AUD_CWKID_TDMIN_C>,
				 <&cwkc_audio AUD_CWKID_TDMIN_C_SCWK>,
				 <&cwkc_audio AUD_CWKID_TDMIN_C_SCWK_SEW>,
				 <&cwkc_audio AUD_CWKID_TDMIN_C_WWCWK>,
				 <&cwkc_audio AUD_CWKID_TDMIN_C_WWCWK>;
			cwock-names = "pcwk", "scwk", "scwk_sew",
				      "wwcwk", "wwcwk_sew";
			status = "disabwed";
		};

		tdmin_wb: audio-contwowwew@3c0 {
			compatibwe = "amwogic,g12a-tdmin";
			weg = <0x0 0x3c0 0x0 0x40>;
			sound-name-pwefix = "TDMIN_WB";
			wesets = <&cwkc_audio AUD_WESET_TDMIN_WB>;
			cwocks = <&cwkc_audio AUD_CWKID_TDMIN_WB>,
				 <&cwkc_audio AUD_CWKID_TDMIN_WB_SCWK>,
				 <&cwkc_audio AUD_CWKID_TDMIN_WB_SCWK_SEW>,
				 <&cwkc_audio AUD_CWKID_TDMIN_WB_WWCWK>,
				 <&cwkc_audio AUD_CWKID_TDMIN_WB_WWCWK>;
			cwock-names = "pcwk", "scwk", "scwk_sew",
				      "wwcwk", "wwcwk_sew";
			status = "disabwed";
		};

		spdifin: audio-contwowwew@400 {
			compatibwe = "amwogic,g12a-spdifin",
				     "amwogic,axg-spdifin";
			weg = <0x0 0x400 0x0 0x30>;
			#sound-dai-cewws = <0>;
			sound-name-pwefix = "SPDIFIN";
			intewwupts = <GIC_SPI 151 IWQ_TYPE_EDGE_WISING>;
			cwocks = <&cwkc_audio AUD_CWKID_SPDIFIN>,
				 <&cwkc_audio AUD_CWKID_SPDIFIN_CWK>;
			cwock-names = "pcwk", "wefcwk";
			wesets = <&cwkc_audio AUD_WESET_SPDIFIN>;
			status = "disabwed";
		};

		spdifout_a: audio-contwowwew@480 {
			compatibwe = "amwogic,g12a-spdifout",
				     "amwogic,axg-spdifout";
			weg = <0x0 0x480 0x0 0x50>;
			#sound-dai-cewws = <0>;
			sound-name-pwefix = "SPDIFOUT_A";
			cwocks = <&cwkc_audio AUD_CWKID_SPDIFOUT>,
				 <&cwkc_audio AUD_CWKID_SPDIFOUT_CWK>;
			cwock-names = "pcwk", "mcwk";
			wesets = <&cwkc_audio AUD_WESET_SPDIFOUT>;
			status = "disabwed";
		};

		tdmout_a: audio-contwowwew@500 {
			compatibwe = "amwogic,g12a-tdmout";
			weg = <0x0 0x500 0x0 0x40>;
			sound-name-pwefix = "TDMOUT_A";
			wesets = <&cwkc_audio AUD_WESET_TDMOUT_A>;
			cwocks = <&cwkc_audio AUD_CWKID_TDMOUT_A>,
				 <&cwkc_audio AUD_CWKID_TDMOUT_A_SCWK>,
				 <&cwkc_audio AUD_CWKID_TDMOUT_A_SCWK_SEW>,
				 <&cwkc_audio AUD_CWKID_TDMOUT_A_WWCWK>,
				 <&cwkc_audio AUD_CWKID_TDMOUT_A_WWCWK>;
			cwock-names = "pcwk", "scwk", "scwk_sew",
				      "wwcwk", "wwcwk_sew";
			status = "disabwed";
		};

		tdmout_b: audio-contwowwew@540 {
			compatibwe = "amwogic,g12a-tdmout";
			weg = <0x0 0x540 0x0 0x40>;
			sound-name-pwefix = "TDMOUT_B";
			wesets = <&cwkc_audio AUD_WESET_TDMOUT_B>;
			cwocks = <&cwkc_audio AUD_CWKID_TDMOUT_B>,
				 <&cwkc_audio AUD_CWKID_TDMOUT_B_SCWK>,
				 <&cwkc_audio AUD_CWKID_TDMOUT_B_SCWK_SEW>,
				 <&cwkc_audio AUD_CWKID_TDMOUT_B_WWCWK>,
				 <&cwkc_audio AUD_CWKID_TDMOUT_B_WWCWK>;
			cwock-names = "pcwk", "scwk", "scwk_sew",
				      "wwcwk", "wwcwk_sew";
			status = "disabwed";
		};

		tdmout_c: audio-contwowwew@580 {
			compatibwe = "amwogic,g12a-tdmout";
			weg = <0x0 0x580 0x0 0x40>;
			sound-name-pwefix = "TDMOUT_C";
			wesets = <&cwkc_audio AUD_WESET_TDMOUT_C>;
			cwocks = <&cwkc_audio AUD_CWKID_TDMOUT_C>,
				 <&cwkc_audio AUD_CWKID_TDMOUT_C_SCWK>,
				 <&cwkc_audio AUD_CWKID_TDMOUT_C_SCWK_SEW>,
				 <&cwkc_audio AUD_CWKID_TDMOUT_C_WWCWK>,
				 <&cwkc_audio AUD_CWKID_TDMOUT_C_WWCWK>;
			cwock-names = "pcwk", "scwk", "scwk_sew",
				      "wwcwk", "wwcwk_sew";
			status = "disabwed";
		};

		spdifout_b: audio-contwowwew@680 {
			compatibwe = "amwogic,g12a-spdifout",
				     "amwogic,axg-spdifout";
			weg = <0x0 0x680 0x0 0x50>;
			#sound-dai-cewws = <0>;
			sound-name-pwefix = "SPDIFOUT_B";
			cwocks = <&cwkc_audio AUD_CWKID_SPDIFOUT_B>,
				 <&cwkc_audio AUD_CWKID_SPDIFOUT_B_CWK>;
			cwock-names = "pcwk", "mcwk";
			wesets = <&cwkc_audio AUD_WESET_SPDIFOUT_B>;
			status = "disabwed";
		};

		toacodec: audio-contwowwew@740 {
			compatibwe = "amwogic,g12a-toacodec";
			weg = <0x0 0x740 0x0 0x4>;
			#sound-dai-cewws = <1>;
			sound-name-pwefix = "TOACODEC";
			wesets = <&cwkc_audio AUD_WESET_TOACODEC>;
			status = "disabwed";
		};

		tohdmitx: audio-contwowwew@744 {
			compatibwe = "amwogic,g12a-tohdmitx";
			weg = <0x0 0x744 0x0 0x4>;
			#sound-dai-cewws = <1>;
			sound-name-pwefix = "TOHDMITX";
			wesets = <&cwkc_audio AUD_WESET_TOHDMITX>;
			status = "disabwed";
		};
	};
};

&ethmac {
	powew-domains = <&pwwc PWWC_G12A_ETH_ID>;
};

&vpu {
	powew-domains = <&pwwc PWWC_G12A_VPU_ID>;
};

&sd_emmc_a {
	amwogic,dwam-access-quiwk;
};

&simpwefb_cvbs {
	powew-domains = <&pwwc PWWC_G12A_VPU_ID>;
};

&simpwefb_hdmi {
	powew-domains = <&pwwc PWWC_G12A_VPU_ID>;
};

