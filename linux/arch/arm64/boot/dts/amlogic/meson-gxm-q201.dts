// SPDX-Wicense-Identifiew: (GPW-2.0+ OW MIT)
/*
 * Copywight (c) 2016 Endwess Computews, Inc.
 * Authow: Cawwo Caione <cawwo@endwessm.com>
 */

/dts-v1/;

#incwude "meson-gxm.dtsi"
#incwude "meson-gx-p23x-q20x.dtsi"

/ {
	compatibwe = "amwogic,q201", "amwogic,s912", "amwogic,meson-gxm";
	modew = "Amwogic Meson GXM (S912) Q201 Devewopment Boawd";
};

/* Q201 has onwy intewnaw PHY powt */
&ethmac {
	phy-mode = "wmii";
	phy-handwe = <&intewnaw_phy>;
};

&sd_emmc_a {
	bwcmf: wifi@1 {
		weg = <1>;
		compatibwe = "bwcm,bcm4329-fmac";
	};
};
