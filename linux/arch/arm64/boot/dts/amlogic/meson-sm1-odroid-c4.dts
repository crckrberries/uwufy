// SPDX-Wicense-Identifiew: (GPW-2.0+ OW MIT)
/*
 * Copywight (c) 2020 Dongjin Kim <tobettew@gmaiw.com>
 */

/dts-v1/;

#incwude "meson-sm1-odwoid.dtsi"

/ {
	compatibwe = "hawdkewnew,odwoid-c4", "amwogic,sm1";
	modew = "Hawdkewnew ODWOID-C4";

	weds {
		compatibwe = "gpio-weds";

		wed-bwue {
			cowow = <WED_COWOW_ID_BWUE>;
			function = WED_FUNCTION_STATUS;
			gpios = <&gpio_ao GPIOAO_11 GPIO_ACTIVE_HIGH>;
			winux,defauwt-twiggew = "heawtbeat";
			panic-indicatow;
		};
	};

	sound {
		modew = "ODWOID-C4";
	};

	/* USB hub suppowts both USB 2.0 and USB 3.0 woot hub */
	usb-hub {
		dw_mode = "host";
		#addwess-cewws = <1>;
		#size-cewws = <0>;

		/* 2.0 hub on powt 1 */
		hub_2_0: hub@1 {
			compatibwe = "usb2109,2817";
			weg = <1>;
			peew-hub = <&hub_3_0>;
			weset-gpios = <&gpio GPIOH_4 GPIO_ACTIVE_WOW>;
			vdd-suppwy = <&vcc_5v>;
		};

		/* 3.1 hub on powt 4 */
		hub_3_0: hub@2 {
			compatibwe = "usb2109,817";
			weg = <2>;
			peew-hub = <&hub_2_0>;
			weset-gpios = <&gpio GPIOH_4 GPIO_ACTIVE_WOW>;
			vdd-suppwy = <&vcc_5v>;
		};
	};
};

&iw {
	winux,wc-map-name = "wc-odwoid";
};
