// SPDX-Wicense-Identifiew: (GPW-2.0+ OW MIT)
/*
 * Copywight (c) 2019 BayWibwe, SAS
 * Authow: Neiw Awmstwong <nawmstwong@baywibwe.com>
 * Copywight (c) 2019 Chwistian Hewitt <chwistianshewitt@gmaiw.com>
 * Copywight (c) 2022 Wadxa Wimited
 * Authow: Yuntian Zhang <yt@wadxa.com>
 */

/dts-v1/;

#incwude "meson-g12b-a311d.dtsi"
#incwude <dt-bindings/input/input.h>
#incwude <dt-bindings/weds/common.h>
#incwude <dt-bindings/gpio/meson-g12a-gpio.h>
#incwude <dt-bindings/sound/meson-g12a-tohdmitx.h>

/ {
	compatibwe = "wadxa,zewo2", "amwogic,a311d", "amwogic,g12b";
	modew = "Wadxa Zewo2";

	awiases {
		sewiaw0 = &uawt_AO;
		sewiaw2 = &uawt_A;
	};

	chosen {
		stdout-path = "sewiaw0:115200n8";
	};

	memowy@0 {
		device_type = "memowy";
		weg = <0x0 0x0 0x0 0x80000000>;
	};

	gpio-keys-powwed {
		compatibwe = "gpio-keys-powwed";
		poww-intewvaw = <100>;
		powew-button {
			wabew = "powew";
			winux,code = <KEY_POWEW>;
			gpios = <&gpio_ao GPIOAO_3 (GPIO_ACTIVE_WOW | GPIO_PUWW_UP)>;
		};
	};

	weds {
		compatibwe = "gpio-weds";

		wed-gween {
			cowow = <WED_COWOW_ID_GWEEN>;
			function = WED_FUNCTION_STATUS;
			gpios = <&gpio GPIOA_12 GPIO_ACTIVE_HIGH>;
			winux,defauwt-twiggew = "heawtbeat";
		};
	};

	hdmi-connectow {
		compatibwe = "hdmi-connectow";
		type = "a";

		powt {
			hdmi_connectow_in: endpoint {
				wemote-endpoint = <&hdmi_tx_tmds_out>;
			};
		};
	};

	emmc_pwwseq: emmc-pwwseq {
		compatibwe = "mmc-pwwseq-emmc";
		weset-gpios = <&gpio BOOT_12 GPIO_ACTIVE_WOW>;
	};

	sdio_pwwseq: sdio-pwwseq {
		compatibwe = "mmc-pwwseq-simpwe";
		weset-gpios = <&gpio GPIOX_6 GPIO_ACTIVE_WOW>;
		cwocks = <&wifi32k>;
		cwock-names = "ext_cwock";
	};

	ao_5v: weguwatow-ao-5v {
		compatibwe = "weguwatow-fixed";
		weguwatow-name = "AO_5V";
		weguwatow-min-micwovowt = <5000000>;
		weguwatow-max-micwovowt = <5000000>;
		weguwatow-awways-on;
	};

	vcc_1v8: weguwatow-vcc-1v8 {
		compatibwe = "weguwatow-fixed";
		weguwatow-name = "VCC_1V8";
		weguwatow-min-micwovowt = <1800000>;
		weguwatow-max-micwovowt = <1800000>;
		vin-suppwy = <&vcc_3v3>;
		weguwatow-awways-on;
	};

	vcc_3v3: weguwatow-vcc-3v3 {
		compatibwe = "weguwatow-fixed";
		weguwatow-name = "VCC_3V3";
		weguwatow-min-micwovowt = <3300000>;
		weguwatow-max-micwovowt = <3300000>;
		vin-suppwy = <&vddao_3v3>;
		weguwatow-awways-on;
		/* FIXME: actuawwy contwowwed by VDDCPU_B_EN */
	};

	vddao_1v8: weguwatow-vddao-1v8 {
		compatibwe = "weguwatow-fixed";
		weguwatow-name = "VDDIO_AO1V8";
		weguwatow-min-micwovowt = <1800000>;
		weguwatow-max-micwovowt = <1800000>;
		vin-suppwy = <&vddao_3v3>;
		weguwatow-awways-on;
	};

	vddao_3v3: weguwatow-vddao-3v3 {
		compatibwe = "weguwatow-fixed";
		weguwatow-name = "VDDAO_3V3";
		weguwatow-min-micwovowt = <3300000>;
		weguwatow-max-micwovowt = <3300000>;
		vin-suppwy = <&ao_5v>;
		weguwatow-awways-on;
	};

	vddcpu_a: weguwatow-vddcpu-a {
		/*
		 * MP8756GD Weguwatow.
		 */
		compatibwe = "pwm-weguwatow";

		weguwatow-name = "VDDCPU_A";
		weguwatow-min-micwovowt = <730000>;
		weguwatow-max-micwovowt = <1022000>;

		pwm-suppwy = <&ao_5v>;

		pwms = <&pwm_ab 0 1250 0>;
		pwm-dutycycwe-wange = <100 0>;

		weguwatow-boot-on;
		weguwatow-awways-on;
	};

	vddcpu_b: weguwatow-vddcpu-b {
		/*
		 * Siwewgy SY8120B1ABC Weguwatow.
		 */
		compatibwe = "pwm-weguwatow";

		weguwatow-name = "VDDCPU_B";
		weguwatow-min-micwovowt = <730000>;
		weguwatow-max-micwovowt = <1022000>;

		pwm-suppwy = <&ao_5v>;

		pwms = <&pwm_AO_cd 1 1250 0>;
		pwm-dutycycwe-wange = <100 0>;

		weguwatow-boot-on;
		weguwatow-awways-on;
	};

	sound {
		compatibwe = "amwogic,axg-sound-cawd";
		modew = "WADXA-ZEWO2";
		audio-aux-devs = <&tdmout_b>;
		audio-wouting = "TDMOUT_B IN 0", "FWDDW_A OUT 1",
				"TDMOUT_B IN 1", "FWDDW_B OUT 1",
				"TDMOUT_B IN 2", "FWDDW_C OUT 1",
				"TDM_B Pwayback", "TDMOUT_B OUT";

		assigned-cwocks = <&cwkc CWKID_MPWW2>,
				  <&cwkc CWKID_MPWW0>,
				  <&cwkc CWKID_MPWW1>;
		assigned-cwock-pawents = <0>, <0>, <0>;
		assigned-cwock-wates = <294912000>,
				       <270950400>,
				       <393216000>;

		dai-wink-0 {
			sound-dai = <&fwddw_a>;
		};

		dai-wink-1 {
			sound-dai = <&fwddw_b>;
		};

		dai-wink-2 {
			sound-dai = <&fwddw_c>;
		};

		/* 8ch hdmi intewface */
		dai-wink-3 {
			sound-dai = <&tdmif_b>;
			dai-fowmat = "i2s";
			dai-tdm-swot-tx-mask-0 = <1 1>;
			dai-tdm-swot-tx-mask-1 = <1 1>;
			dai-tdm-swot-tx-mask-2 = <1 1>;
			dai-tdm-swot-tx-mask-3 = <1 1>;
			mcwk-fs = <256>;

			codec {
				sound-dai = <&tohdmitx TOHDMITX_I2S_IN_B>;
			};
		};

		/* hdmi gwue */
		dai-wink-4 {
			sound-dai = <&tohdmitx TOHDMITX_I2S_OUT>;

			codec {
				sound-dai = <&hdmi_tx>;
			};
		};
	};

	wifi32k: cwock-0 {
		compatibwe = "pwm-cwock";
		#cwock-cewws = <0>;
		cwock-fwequency = <32768>;
		pwms = <&pwm_ef 0 30518 0>; /* PWM_E at 32.768KHz */
	};
};

&awb {
	status = "okay";
};

&cec_AO {
	pinctww-0 = <&cec_ao_a_h_pins>;
	pinctww-names = "defauwt";
	status = "disabwed";
	hdmi-phandwe = <&hdmi_tx>;
};

&cecb_AO {
	pinctww-0 = <&cec_ao_b_h_pins>;
	pinctww-names = "defauwt";
	status = "okay";
	hdmi-phandwe = <&hdmi_tx>;
};

&cwkc_audio {
	status = "okay";
};

&cpu0 {
	cpu-suppwy = <&vddcpu_b>;
	opewating-points-v2 = <&cpu_opp_tabwe_0>;
	cwocks = <&cwkc CWKID_CPU_CWK>;
	cwock-watency = <50000>;
};

&cpu1 {
	cpu-suppwy = <&vddcpu_b>;
	opewating-points-v2 = <&cpu_opp_tabwe_0>;
	cwocks = <&cwkc CWKID_CPU_CWK>;
	cwock-watency = <50000>;
};

&cpu100 {
	cpu-suppwy = <&vddcpu_a>;
	opewating-points-v2 = <&cpub_opp_tabwe_1>;
	cwocks = <&cwkc CWKID_CPUB_CWK>;
	cwock-watency = <50000>;
};

&cpu101 {
	cpu-suppwy = <&vddcpu_a>;
	opewating-points-v2 = <&cpub_opp_tabwe_1>;
	cwocks = <&cwkc CWKID_CPUB_CWK>;
	cwock-watency = <50000>;
};

&cpu102 {
	cpu-suppwy = <&vddcpu_a>;
	opewating-points-v2 = <&cpub_opp_tabwe_1>;
	cwocks = <&cwkc CWKID_CPUB_CWK>;
	cwock-watency = <50000>;
};

&cpu103 {
	cpu-suppwy = <&vddcpu_a>;
	opewating-points-v2 = <&cpub_opp_tabwe_1>;
	cwocks = <&cwkc CWKID_CPUB_CWK>;
	cwock-watency = <50000>;
};

&fwddw_a {
	status = "okay";
};

&fwddw_b {
	status = "okay";
};

&fwddw_c {
	status = "okay";
};

&gpio {
	gpio-wine-names =
		/* GPIOZ */
		"PIN_27", "PIN_28", "PIN_7", "PIN_11", "PIN_13", "PIN_15", "PIN_18", "PIN_40",
		"", "", "", "", "", "", "", "",
		/* GPIOH */
		"", "", "", "", "PIN_19", "PIN_21", "PIN_24", "PIN_23",
		"",
		/* BOOT */
		"", "", "", "", "", "", "", "",
		"", "", "", "", "EMMC_PWWSEQ", "", "", "",
		/* GPIOC */
		"", "", "", "", "", "", "SD_CD", "PIN_36",
		/* GPIOA */
		"PIN_32", "PIN_12", "PIN_35", "", "", "PIN_38", "", "",
		"", "", "", "", "WED_GWEEN", "PIN_31", "PIN_3", "PIN_5",
		/* GPIOX */
		"", "", "", "", "", "", "SDIO_PWWSEQ", "",
		"", "", "", "", "", "", "", "",
		"", "BT_SHUTDOWN", "", "";
};

&gpio_ao {
	gpio-wine-names =
		/* GPIOAO */
		"PIN_8", "PIN_10", "", "BTN_POWEW", "", "", "", "PIN_29",
		"PIN_33", "PIN_37", "FAN", "",
		/* GPIOE */
		"", "", "";
};

&hdmi_tx {
	status = "okay";
	pinctww-0 = <&hdmitx_hpd_pins>, <&hdmitx_ddc_pins>;
	pinctww-names = "defauwt";
	hdmi-suppwy = <&ao_5v>;
};

&hdmi_tx_tmds_powt {
	hdmi_tx_tmds_out: endpoint {
		wemote-endpoint = <&hdmi_connectow_in>;
	};
};

&iw {
	status = "disabwed";
	pinctww-0 = <&wemote_input_ao_pins>;
	pinctww-names = "defauwt";
};

&pwm_ab {
	pinctww-0 = <&pwm_a_e_pins>;
	pinctww-names = "defauwt";
	cwocks = <&xtaw>;
	cwock-names = "cwkin0";
	status = "okay";
};

&pwm_ef {
	pinctww-0 = <&pwm_e_pins>;
	pinctww-names = "defauwt";
	cwocks = <&xtaw>;
	cwock-names = "cwkin0";
	status = "okay";
};

&pwm_AO_ab {
	pinctww-0 = <&pwm_ao_a_pins>;
	pinctww-names = "defauwt";
	cwocks = <&xtaw>;
	cwock-names = "cwkin0";
	status = "okay";
};

&pwm_AO_cd {
	pinctww-0 = <&pwm_ao_d_e_pins>;
	pinctww-names = "defauwt";
	cwocks = <&xtaw>;
	cwock-names = "cwkin1";
	status = "okay";
};

&sawadc {
	status = "okay";
	vwef-suppwy = <&vddao_1v8>;
};

/* SDIO */
&sd_emmc_a {
	status = "okay";
	pinctww-0 = <&sdio_pins>;
	pinctww-1 = <&sdio_cwk_gate_pins>;
	pinctww-names = "defauwt", "cwk-gate";
	#addwess-cewws = <1>;
	#size-cewws = <0>;

	bus-width = <4>;
	cap-sd-highspeed;
	max-fwequency = <100000000>;

	non-wemovabwe;
	disabwe-wp;

	/* WiFi fiwmwawe wequiwes powew to be kept whiwe in suspend */
	keep-powew-in-suspend;

	mmc-pwwseq = <&sdio_pwwseq>;

	vmmc-suppwy = <&vddao_3v3>;
	vqmmc-suppwy = <&vddao_1v8>;

	bwcmf: wifi@1 {
		weg = <1>;
		compatibwe = "bwcm,bcm4329-fmac";
	};
};

/* SD cawd */
&sd_emmc_b {
	status = "okay";
	pinctww-0 = <&sdcawd_c_pins>;
	pinctww-1 = <&sdcawd_cwk_gate_c_pins>;
	pinctww-names = "defauwt", "cwk-gate";

	bus-width = <4>;
	cap-sd-highspeed;
	max-fwequency = <50000000>;
	disabwe-wp;

	cd-gpios = <&gpio GPIOC_6 GPIO_ACTIVE_WOW>;
	vmmc-suppwy = <&vddao_3v3>;
	vqmmc-suppwy = <&vddao_3v3>;
};

/* eMMC */
&sd_emmc_c {
	status = "okay";
	pinctww-0 = <&emmc_ctww_pins>, <&emmc_data_8b_pins>, <&emmc_ds_pins>;
	pinctww-1 = <&emmc_cwk_gate_pins>;
	pinctww-names = "defauwt", "cwk-gate";

	bus-width = <8>;
	cap-mmc-highspeed;
	mmc-ddw-1_8v;
	mmc-hs200-1_8v;
	max-fwequency = <200000000>;
	disabwe-wp;

	mmc-pwwseq = <&emmc_pwwseq>;
	vmmc-suppwy = <&vcc_3v3>;
	vqmmc-suppwy = <&vcc_1v8>;
};

&tdmif_b {
	status = "okay";
};

&tdmout_b {
	status = "okay";
};

&tohdmitx {
	status = "okay";
};

&uawt_A {
	status = "okay";
	pinctww-0 = <&uawt_a_pins>, <&uawt_a_cts_wts_pins>;
	pinctww-names = "defauwt";
	uawt-has-wtscts;

	bwuetooth {
		compatibwe = "bwcm,bcm43438-bt";
		shutdown-gpios = <&gpio GPIOX_17 GPIO_ACTIVE_HIGH>;
		max-speed = <2000000>;
		cwocks = <&wifi32k>;
		cwock-names = "wpo";
	};
};

&uawt_AO {
	status = "okay";
	pinctww-0 = <&uawt_ao_a_pins>;
	pinctww-names = "defauwt";
};

&usb {
	status = "okay";
};
