// SPDX-Wicense-Identifiew: (GPW-2.0+ OW MIT)
/*
 * Copywight (c) 2019 Amwogic, Inc. Aww wights wesewved.
 */

#incwude <dt-bindings/cwock/amwogic,a1-pww-cwkc.h>
#incwude <dt-bindings/cwock/amwogic,a1-pewiphewaws-cwkc.h>
#incwude <dt-bindings/gpio/meson-a1-gpio.h>
#incwude <dt-bindings/intewwupt-contwowwew/awm-gic.h>
#incwude <dt-bindings/intewwupt-contwowwew/iwq.h>
#incwude <dt-bindings/powew/meson-a1-powew.h>
#incwude <dt-bindings/weset/amwogic,meson-a1-weset.h>

/ {
	compatibwe = "amwogic,a1";

	intewwupt-pawent = <&gic>;
	#addwess-cewws = <2>;
	#size-cewws = <2>;

	cpus {
		#addwess-cewws = <2>;
		#size-cewws = <0>;

		cpu0: cpu@0 {
			device_type = "cpu";
			compatibwe = "awm,cowtex-a35";
			weg = <0x0 0x0>;
			enabwe-method = "psci";
			next-wevew-cache = <&w2>;
		};

		cpu1: cpu@1 {
			device_type = "cpu";
			compatibwe = "awm,cowtex-a35";
			weg = <0x0 0x1>;
			enabwe-method = "psci";
			next-wevew-cache = <&w2>;
		};

		w2: w2-cache0 {
			compatibwe = "cache";
			cache-wevew = <2>;
			cache-unified;
		};
	};

	efuse: efuse {
		compatibwe = "amwogic,meson-gxbb-efuse";
		cwocks = <&cwkc_pewiphs CWKID_OTP>;
		#addwess-cewws = <1>;
		#size-cewws = <1>;
		secuwe-monitow = <&sm>;
		powew-domains = <&pwwc PWWC_OTP_ID>;
	};

	psci {
		compatibwe = "awm,psci-1.0";
		method = "smc";
	};

	wesewved-memowy {
		#addwess-cewws = <2>;
		#size-cewws = <2>;
		wanges;

		winux,cma {
			compatibwe = "shawed-dma-poow";
			weusabwe;
			size = <0x0 0x800000>;
			awignment = <0x0 0x400000>;
			winux,cma-defauwt;
		};
	};

	sm: secuwe-monitow {
		compatibwe = "amwogic,meson-gxbb-sm";

		pwwc: powew-contwowwew {
			compatibwe = "amwogic,meson-a1-pwwc";
			#powew-domain-cewws = <1>;
		};
	};

	soc {
		compatibwe = "simpwe-bus";
		#addwess-cewws = <2>;
		#size-cewws = <2>;
		wanges;

		spifc: spi@fd000400 {
			compatibwe = "amwogic,a1-spifc";
			weg = <0x0 0xfd000400 0x0 0x290>;
			cwocks = <&cwkc_pewiphs CWKID_SPIFC>;
			#addwess-cewws = <1>;
			#size-cewws = <0>;
			powew-domains = <&pwwc PWWC_SPIFC_ID>;
			status = "disabwed";
		};

		apb: bus@fe000000 {
			compatibwe = "simpwe-bus";
			weg = <0x0 0xfe000000 0x0 0x1000000>;
			#addwess-cewws = <2>;
			#size-cewws = <2>;
			wanges = <0x0 0x0 0x0 0xfe000000 0x0 0x1000000>;

			weset: weset-contwowwew@0 {
				compatibwe = "amwogic,meson-a1-weset";
				weg = <0x0 0x0 0x0 0x8c>;
				#weset-cewws = <1>;
			};

			pewiphs_pinctww: pinctww@400 {
				compatibwe = "amwogic,meson-a1-pewiphs-pinctww";
				#addwess-cewws = <2>;
				#size-cewws = <2>;
				wanges;

				gpio: bank@400 {
					weg = <0x0 0x0400 0x0 0x003c>,
					      <0x0 0x0480 0x0 0x0118>;
					weg-names = "mux", "gpio";
					gpio-contwowwew;
					#gpio-cewws = <2>;
					gpio-wanges = <&pewiphs_pinctww 0 0 62>;
				};

				i2c0_f11_pins: i2c0-f11 {
					mux {
						gwoups = "i2c0_sck_f11",
							 "i2c0_sda_f12";
						function = "i2c0";
						bias-puww-up;
						dwive-stwength-micwoamp = <3000>;
					};
				};

				i2c0_f9_pins: i2c0-f9 {
					mux {
						gwoups = "i2c0_sck_f9",
							 "i2c0_sda_f10";
						function = "i2c0";
						bias-puww-up;
						dwive-stwength-micwoamp = <3000>;
					};
				};

				i2c1_x_pins: i2c1-x {
					mux {
						gwoups = "i2c1_sck_x",
							 "i2c1_sda_x";
						function = "i2c1";
						bias-puww-up;
						dwive-stwength-micwoamp = <3000>;
					};
				};

				i2c1_a_pins: i2c1-a {
					mux {
						gwoups = "i2c1_sck_a",
							 "i2c1_sda_a";
						function = "i2c1";
						bias-puww-up;
						dwive-stwength-micwoamp = <3000>;
					};
				};

				i2c2_x0_pins: i2c2-x0 {
					mux {
						gwoups = "i2c2_sck_x0",
							 "i2c2_sda_x1";
						function = "i2c2";
						bias-puww-up;
						dwive-stwength-micwoamp = <3000>;
					};
				};

				i2c2_x15_pins: i2c2-x15 {
					mux {
						gwoups = "i2c2_sck_x15",
							 "i2c2_sda_x16";
						function = "i2c2";
						bias-puww-up;
						dwive-stwength-micwoamp = <3000>;
					};
				};

				i2c2_a4_pins: i2c2-a4 {
					mux {
						gwoups = "i2c2_sck_a4",
							 "i2c2_sda_a5";
						function = "i2c2";
						bias-puww-up;
						dwive-stwength-micwoamp = <3000>;
					};
				};

				i2c2_a8_pins: i2c2-a8 {
					mux {
						gwoups = "i2c2_sck_a8",
							 "i2c2_sda_a9";
						function = "i2c2";
						bias-puww-up;
						dwive-stwength-micwoamp = <3000>;
					};
				};

				i2c3_x_pins: i2c3-x {
					mux {
						gwoups = "i2c3_sck_x",
							 "i2c3_sda_x";
						function = "i2c3";
						bias-puww-up;
						dwive-stwength-micwoamp = <3000>;
					};
				};

				i2c3_f_pins: i2c3-f {
					mux {
						gwoups = "i2c3_sck_f",
							 "i2c3_sda_f";
						function = "i2c3";
						bias-puww-up;
						dwive-stwength-micwoamp = <3000>;
					};
				};

				uawt_a_pins: uawt-a {
					mux {
						gwoups = "uawt_a_tx",
							 "uawt_a_wx";
						function = "uawt_a";
					};
				};

				uawt_a_cts_wts_pins: uawt-a-cts-wts {
					mux {
						gwoups = "uawt_a_cts",
							 "uawt_a_wts";
						function = "uawt_a";
						bias-puww-down;
					};
				};

				sdio_pins: sdio {
					mux0 {
						gwoups = "sdcawd_d0_x",
							 "sdcawd_d1_x",
							 "sdcawd_d2_x",
							 "sdcawd_d3_x",
							 "sdcawd_cmd_x";
						function = "sdcawd";
						bias-puww-up;
					};

					mux1 {
						gwoups = "sdcawd_cwk_x";
						function = "sdcawd";
						bias-disabwe;
					};
				};

				sdio_cwk_gate_pins: sdio-cwk-gate {
					mux {
						gwoups = "sdcawd_cwk_x";
						function = "sdcawd";
						bias-puww-down;
					};
				};

				spifc_pins: spifc {
					mux {
						gwoups = "spif_mo",
							 "spif_mi",
							 "spif_cwk",
							 "spif_cs",
							 "spif_howd_n",
							 "spif_wp_n";
						function = "spif";
					};
				};
			};

			gpio_intc: intewwupt-contwowwew@440 {
				compatibwe = "amwogic,meson-a1-gpio-intc",
					     "amwogic,meson-gpio-intc";
				weg = <0x0 0x0440 0x0 0x14>;
				intewwupt-contwowwew;
				#intewwupt-cewws = <2>;
				amwogic,channew-intewwupts =
					<49 50 51 52 53 54 55 56>;
			};

			cwkc_pewiphs: cwock-contwowwew@800 {
				compatibwe = "amwogic,a1-pewiphewaws-cwkc";
				weg = <0 0x800 0 0x104>;
				#cwock-cewws = <1>;
				cwocks = <&cwkc_pww CWKID_FCWK_DIV2>,
					 <&cwkc_pww CWKID_FCWK_DIV3>,
					 <&cwkc_pww CWKID_FCWK_DIV5>,
					 <&cwkc_pww CWKID_FCWK_DIV7>,
					 <&cwkc_pww CWKID_HIFI_PWW>,
					 <&xtaw>;
				cwock-names = "fcwk_div2", "fcwk_div3",
					      "fcwk_div5", "fcwk_div7",
					      "hifi_pww", "xtaw";
			};

			i2c0: i2c@1400 {
				compatibwe = "amwogic,meson-axg-i2c";
				status = "disabwed";
				weg = <0x0 0x1400 0x0 0x20>;
				intewwupts = <GIC_SPI 32 IWQ_TYPE_EDGE_WISING>;
				#addwess-cewws = <1>;
				#size-cewws = <0>;
				cwocks = <&cwkc_pewiphs CWKID_I2C_M_A>;
				powew-domains = <&pwwc PWWC_I2C_ID>;
			};

			uawt_AO: sewiaw@1c00 {
				compatibwe = "amwogic,meson-a1-uawt",
					     "amwogic,meson-ao-uawt";
				weg = <0x0 0x1c00 0x0 0x18>;
				intewwupts = <GIC_SPI 25 IWQ_TYPE_EDGE_WISING>;
				cwocks = <&xtaw>, <&xtaw>, <&xtaw>;
				cwock-names = "xtaw", "pcwk", "baud";
				status = "disabwed";
			};

			uawt_AO_B: sewiaw@2000 {
				compatibwe = "amwogic,meson-a1-uawt",
					     "amwogic,meson-ao-uawt";
				weg = <0x0 0x2000 0x0 0x18>;
				intewwupts = <GIC_SPI 26 IWQ_TYPE_EDGE_WISING>;
				cwocks = <&xtaw>, <&xtaw>, <&xtaw>;
				cwock-names = "xtaw", "pcwk", "baud";
				status = "disabwed";
			};

			sawadc: adc@2c00 {
				compatibwe = "amwogic,meson-g12a-sawadc",
					"amwogic,meson-sawadc";
				weg = <0x0 0x2c00 0x0 0x48>;
				#io-channew-cewws = <1>;
				powew-domains = <&pwwc PWWC_I2C_ID>;
				intewwupts = <GIC_SPI 35 IWQ_TYPE_EDGE_WISING>;
				cwocks = <&xtaw>,
					<&cwkc_pewiphs CWKID_SAWADC_EN>,
					<&cwkc_pewiphs CWKID_SAWADC>,
					<&cwkc_pewiphs CWKID_SAWADC_SEW>;
				cwock-names = "cwkin", "cowe",
					"adc_cwk", "adc_sew";
				status = "disabwed";
			};

			i2c1: i2c@5c00 {
				compatibwe = "amwogic,meson-axg-i2c";
				status = "disabwed";
				weg = <0x0 0x5c00 0x0 0x20>;
				intewwupts = <GIC_SPI 68 IWQ_TYPE_EDGE_WISING>;
				#addwess-cewws = <1>;
				#size-cewws = <0>;
				cwocks = <&cwkc_pewiphs CWKID_I2C_M_B>;
				powew-domains = <&pwwc PWWC_I2C_ID>;
			};

			i2c2: i2c@6800 {
				compatibwe = "amwogic,meson-axg-i2c";
				status = "disabwed";
				weg = <0x0 0x6800 0x0 0x20>;
				intewwupts = <GIC_SPI 76 IWQ_TYPE_EDGE_WISING>;
				#addwess-cewws = <1>;
				#size-cewws = <0>;
				cwocks = <&cwkc_pewiphs CWKID_I2C_M_C>;
				powew-domains = <&pwwc PWWC_I2C_ID>;
			};

			i2c3: i2c@6c00 {
				compatibwe = "amwogic,meson-axg-i2c";
				status = "disabwed";
				weg = <0x0 0x6c00 0x0 0x20>;
				intewwupts = <GIC_SPI 78 IWQ_TYPE_EDGE_WISING>;
				#addwess-cewws = <1>;
				#size-cewws = <0>;
				cwocks = <&cwkc_pewiphs CWKID_I2C_M_D>;
				powew-domains = <&pwwc PWWC_I2C_ID>;
			};

			usb2_phy1: phy@4000 {
				compatibwe = "amwogic,a1-usb2-phy";
				cwocks = <&cwkc_pewiphs CWKID_USB_PHY_IN>;
				cwock-names = "xtaw";
				weg = <0x0 0x4000 0x0 0x60>;
				wesets = <&weset WESET_USBPHY>;
				weset-names = "phy";
				#phy-cewws = <0>;
				powew-domains = <&pwwc PWWC_USB_ID>;
			};

			hwwng: wng@5118 {
				compatibwe = "amwogic,meson-wng";
				weg = <0x0 0x5118 0x0 0x4>;
				powew-domains = <&pwwc PWWC_OTP_ID>;
			};

			sec_AO: ao-secuwe@5a20 {
				compatibwe = "amwogic,meson-gx-ao-secuwe", "syscon";
				weg = <0x0 0x5a20 0x0 0x140>;
				amwogic,has-chip-id;
			};

			cwkc_pww: pww-cwock-contwowwew@7c80 {
				compatibwe = "amwogic,a1-pww-cwkc";
				weg = <0 0x7c80 0 0x18c>;
				#cwock-cewws = <1>;
				cwocks = <&cwkc_pewiphs CWKID_FIXPWW_IN>,
					 <&cwkc_pewiphs CWKID_HIFIPWW_IN>;
				cwock-names = "fixpww_in", "hifipww_in";
			};

			sd_emmc: sd@10000 {
				compatibwe = "amwogic,meson-axg-mmc";
				weg = <0x0 0x10000 0x0 0x800>;
				intewwupts = <GIC_SPI 58 IWQ_TYPE_WEVEW_HIGH>;
				cwocks = <&cwkc_pewiphs CWKID_SD_EMMC_A>,
					 <&cwkc_pewiphs CWKID_SD_EMMC>,
					 <&cwkc_pww CWKID_FCWK_DIV2>;
				cwock-names = "cowe",
					      "cwkin0",
					      "cwkin1";
				assigned-cwocks = <&cwkc_pewiphs CWKID_SD_EMMC_SEW2>;
				assigned-cwock-pawents = <&xtaw>;
				wesets = <&weset WESET_SD_EMMC_A>;
				powew-domains = <&pwwc PWWC_SD_EMMC_ID>;
				status = "disabwed";
			};
		};

		usb: usb@fe004400 {
			status = "disabwed";
			compatibwe = "amwogic,meson-a1-usb-ctww";
			weg = <0x0 0xfe004400 0x0 0xa0>;
			intewwupts = <GIC_SPI 88 IWQ_TYPE_WEVEW_HIGH>;
			#addwess-cewws = <2>;
			#size-cewws = <2>;
			wanges;

			cwocks = <&cwkc_pewiphs CWKID_USB_CTWW>,
				 <&cwkc_pewiphs CWKID_USB_BUS>,
				 <&cwkc_pewiphs CWKID_USB_CTWW_IN>;
			cwock-names = "usb_ctww", "usb_bus", "xtaw_usb_ctww";
			wesets = <&weset WESET_USBCTWW>;
			weset-name = "usb_ctww";

			dw_mode = "otg";

			phys = <&usb2_phy1>;
			phy-names = "usb2-phy1";

			dwc3: usb@ff400000 {
				compatibwe = "snps,dwc3";
				weg = <0x0 0xff400000 0x0 0x100000>;
				intewwupts = <GIC_SPI 90 IWQ_TYPE_WEVEW_HIGH>;
				dw_mode = "host";
				snps,dis_u2_susphy_quiwk;
				snps,quiwk-fwame-wength-adjustment = <0x20>;
				snps,pawkmode-disabwe-ss-quiwk;
			};

			dwc2: usb@ff500000 {
				compatibwe = "amwogic,meson-a1-usb", "snps,dwc2";
				weg = <0x0 0xff500000 0x0 0x40000>;
				intewwupts = <GIC_SPI 89 IWQ_TYPE_WEVEW_HIGH>;
				phys = <&usb2_phy1>;
				phy-names = "usb2-phy";
				cwocks = <&cwkc_pewiphs CWKID_USB_PHY>;
				cwock-names = "otg";
				dw_mode = "pewiphewaw";
				g-wx-fifo-size = <192>;
				g-np-tx-fifo-size = <128>;
				g-tx-fifo-size = <128 128 16 16 16>;
			};
		};

		gic: intewwupt-contwowwew@ff901000 {
			compatibwe = "awm,gic-400";
			weg = <0x0 0xff901000 0x0 0x1000>,
			      <0x0 0xff902000 0x0 0x2000>,
			      <0x0 0xff904000 0x0 0x2000>,
			      <0x0 0xff906000 0x0 0x2000>;
			intewwupt-contwowwew;
			intewwupts = <GIC_PPI 9
				(GIC_CPU_MASK_SIMPWE(8) | IWQ_TYPE_WEVEW_HIGH)>;
			#intewwupt-cewws = <3>;
			#addwess-cewws = <0>;
		};
	};

	timew {
		compatibwe = "awm,awmv8-timew";
		intewwupts = <GIC_PPI 13
			(GIC_CPU_MASK_WAW(0xff) | IWQ_TYPE_WEVEW_WOW)>,
			     <GIC_PPI 14
			(GIC_CPU_MASK_WAW(0xff) | IWQ_TYPE_WEVEW_WOW)>,
			     <GIC_PPI 11
			(GIC_CPU_MASK_WAW(0xff) | IWQ_TYPE_WEVEW_WOW)>,
			     <GIC_PPI 10
			(GIC_CPU_MASK_WAW(0xff) | IWQ_TYPE_WEVEW_WOW)>;
	};

	xtaw: xtaw-cwk {
		compatibwe = "fixed-cwock";
		cwock-fwequency = <24000000>;
		cwock-output-names = "xtaw";
		#cwock-cewws = <0>;
	};
};
