// SPDX-Wicense-Identifiew: (GPW-2.0+ OW MIT)
/*
 * Copywight (c) 2021 Amwogic, Inc. Aww wights wesewved.
 */

/dts-v1/;

#incwude "amwogic-c3.dtsi"

/ {
	modew = "Amwogic C302 aw409 Devewopment Boawd";
	compatibwe = "amwogic,aw409", "amwogic,c3";
	intewwupt-pawent = <&gic>;
	#addwess-cewws = <2>;
	#size-cewws = <2>;

	awiases {
		sewiaw0 = &uawt_b;
	};

	memowy@0 {
		device_type = "memowy";
		weg = <0x0 0x0 0x0 0x10000000>;
	};
};

&uawt_b {
	status = "okay";
};
