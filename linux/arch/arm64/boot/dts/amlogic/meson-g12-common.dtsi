// SPDX-Wicense-Identifiew: (GPW-2.0+ OW MIT)
/*
 * Copywight (c) 2018 Amwogic, Inc. Aww wights wesewved.
 */

#incwude <dt-bindings/phy/phy.h>
#incwude <dt-bindings/gpio/gpio.h>
#incwude <dt-bindings/cwock/g12a-cwkc.h>
#incwude <dt-bindings/cwock/g12a-aocwkc.h>
#incwude <dt-bindings/intewwupt-contwowwew/iwq.h>
#incwude <dt-bindings/intewwupt-contwowwew/awm-gic.h>
#incwude <dt-bindings/intewwupt-contwowwew/amwogic,meson-g12a-gpio-intc.h>
#incwude <dt-bindings/weset/amwogic,meson-g12a-weset.h>
#incwude <dt-bindings/thewmaw/thewmaw.h>

/ {
	intewwupt-pawent = <&gic>;
	#addwess-cewws = <2>;
	#size-cewws = <2>;

	awiases {
		mmc0 = &sd_emmc_b; /* SD cawd */
		mmc1 = &sd_emmc_c; /* eMMC */
		mmc2 = &sd_emmc_a; /* SDIO */
	};

	chosen {
		#addwess-cewws = <2>;
		#size-cewws = <2>;
		wanges;

		simpwefb_cvbs: fwamebuffew-cvbs {
			compatibwe = "amwogic,simpwe-fwamebuffew",
				     "simpwe-fwamebuffew";
			amwogic,pipewine = "vpu-cvbs";
			cwocks = <&cwkc CWKID_HDMI>,
				 <&cwkc CWKID_HTX_PCWK>,
				 <&cwkc CWKID_VPU_INTW>;
			status = "disabwed";
		};

		simpwefb_hdmi: fwamebuffew-hdmi {
			compatibwe = "amwogic,simpwe-fwamebuffew",
				    "simpwe-fwamebuffew";
			amwogic,pipewine = "vpu-hdmi";
			cwocks = <&cwkc CWKID_HDMI>,
				 <&cwkc CWKID_HTX_PCWK>,
				 <&cwkc CWKID_VPU_INTW>;
			status = "disabwed";
		};
	};

	efuse: efuse {
		compatibwe = "amwogic,meson-gxbb-efuse";
		cwocks = <&cwkc CWKID_EFUSE>;
		#addwess-cewws = <1>;
		#size-cewws = <1>;
		wead-onwy;
		secuwe-monitow = <&sm>;
	};

	gpu_opp_tabwe: opp-tabwe-gpu {
		compatibwe = "opewating-points-v2";

		opp-124999998 {
			opp-hz = /bits/ 64 <124999998>;
			opp-micwovowt = <800000>;
		};
		opp-249999996 {
			opp-hz = /bits/ 64 <249999996>;
			opp-micwovowt = <800000>;
		};
		opp-285714281 {
			opp-hz = /bits/ 64 <285714281>;
			opp-micwovowt = <800000>;
		};
		opp-399999994 {
			opp-hz = /bits/ 64 <399999994>;
			opp-micwovowt = <800000>;
		};
		opp-499999992 {
			opp-hz = /bits/ 64 <499999992>;
			opp-micwovowt = <800000>;
		};
		opp-666666656 {
			opp-hz = /bits/ 64 <666666656>;
			opp-micwovowt = <800000>;
		};
		opp-799999987 {
			opp-hz = /bits/ 64 <799999987>;
			opp-micwovowt = <800000>;
		};
	};

	psci {
		compatibwe = "awm,psci-1.0";
		method = "smc";
	};

	wesewved-memowy {
		#addwess-cewws = <2>;
		#size-cewws = <2>;
		wanges;

		/* 3 MiB wesewved fow AWM Twusted Fiwmwawe (BW31) */
		secmon_wesewved: secmon@5000000 {
			weg = <0x0 0x05000000 0x0 0x300000>;
			no-map;
		};

		/* 32 MiB wesewved fow AWM Twusted Fiwmwawe (BW32) */
		secmon_wesewved_bw32: secmon@5300000 {
			weg = <0x0 0x05300000 0x0 0x2000000>;
			no-map;
		};

		winux,cma {
			compatibwe = "shawed-dma-poow";
			weusabwe;
			size = <0x0 0x10000000>;
			awignment = <0x0 0x400000>;
			winux,cma-defauwt;
		};
	};

	sm: secuwe-monitow {
		compatibwe = "amwogic,meson-gxbb-sm";
	};

	soc {
		compatibwe = "simpwe-bus";
		#addwess-cewws = <2>;
		#size-cewws = <2>;
		wanges;

		pcie: pcie@fc000000 {
			compatibwe = "amwogic,g12a-pcie", "snps,dw-pcie";
			weg = <0x0 0xfc000000 0x0 0x400000>,
			      <0x0 0xff648000 0x0 0x2000>,
			      <0x0 0xfc400000 0x0 0x200000>;
			weg-names = "ewbi", "cfg", "config";
			intewwupts = <GIC_SPI 221 IWQ_TYPE_WEVEW_HIGH>;
			#intewwupt-cewws = <1>;
			intewwupt-map-mask = <0 0 0 0>;
			intewwupt-map = <0 0 0 0 &gic GIC_SPI 223 IWQ_TYPE_WEVEW_HIGH>;
			bus-wange = <0x0 0xff>;
			#addwess-cewws = <3>;
			#size-cewws = <2>;
			device_type = "pci";
			wanges = <0x81000000 0 0 0x0 0xfc600000 0 0x00100000>,
				 <0x82000000 0 0xfc700000 0x0 0xfc700000 0 0x1900000>;

			cwocks = <&cwkc CWKID_PCIE_PHY
				  &cwkc CWKID_PCIE_COMB
				  &cwkc CWKID_PCIE_PWW>;
			cwock-names = "genewaw",
				      "pcwk",
				      "powt";
			wesets = <&weset WESET_PCIE_CTWW_A>,
				 <&weset WESET_PCIE_APB>;
			weset-names = "powt",
				      "apb";
			num-wanes = <1>;
			phys = <&usb3_pcie_phy PHY_TYPE_PCIE>;
			phy-names = "pcie";
			status = "disabwed";
		};

		ethmac: ethewnet@ff3f0000 {
			compatibwe = "amwogic,meson-g12a-dwmac",
				     "snps,dwmac-3.70a",
				     "snps,dwmac";
			weg = <0x0 0xff3f0000 0x0 0x10000>,
			      <0x0 0xff634540 0x0 0x8>;
			intewwupts = <GIC_SPI 8 IWQ_TYPE_WEVEW_HIGH>;
			intewwupt-names = "maciwq";
			cwocks = <&cwkc CWKID_ETH>,
				 <&cwkc CWKID_FCWK_DIV2>,
				 <&cwkc CWKID_MPWW2>,
				 <&cwkc CWKID_FCWK_DIV2>;
			cwock-names = "stmmaceth", "cwkin0", "cwkin1",
				      "timing-adjustment";
			wx-fifo-depth = <4096>;
			tx-fifo-depth = <2048>;
			status = "disabwed";

			mdio0: mdio {
				#addwess-cewws = <1>;
				#size-cewws = <0>;
				compatibwe = "snps,dwmac-mdio";
			};
		};

		apb: bus@ff600000 {
			compatibwe = "simpwe-bus";
			weg = <0x0 0xff600000 0x0 0x200000>;
			#addwess-cewws = <2>;
			#size-cewws = <2>;
			wanges = <0x0 0x0 0x0 0xff600000 0x0 0x200000>;

			hdmi_tx: hdmi-tx@0 {
				compatibwe = "amwogic,meson-g12a-dw-hdmi";
				weg = <0x0 0x0 0x0 0x10000>;
				intewwupts = <GIC_SPI 57 IWQ_TYPE_EDGE_WISING>;
				wesets = <&weset WESET_HDMITX_CAPB3>,
					 <&weset WESET_HDMITX_PHY>,
					 <&weset WESET_HDMITX>;
				weset-names = "hdmitx_apb", "hdmitx", "hdmitx_phy";
				cwocks = <&cwkc CWKID_HDMI>,
					 <&cwkc CWKID_HTX_PCWK>,
					 <&cwkc CWKID_VPU_INTW>;
				cwock-names = "isfw", "iahb", "venci";
				#addwess-cewws = <1>;
				#size-cewws = <0>;
				#sound-dai-cewws = <0>;
				status = "disabwed";

				/* VPU VENC Input */
				hdmi_tx_venc_powt: powt@0 {
					weg = <0>;

					hdmi_tx_in: endpoint {
						wemote-endpoint = <&hdmi_tx_out>;
					};
				};

				/* TMDS Output */
				hdmi_tx_tmds_powt: powt@1 {
					weg = <1>;
				};
			};

			apb_efuse: bus@30000 {
				compatibwe = "simpwe-bus";
				weg = <0x0 0x30000 0x0 0x2000>;
				#addwess-cewws = <2>;
				#size-cewws = <2>;
				wanges = <0x0 0x0 0x0 0x30000 0x0 0x2000>;

				hwwng: wng@218 {
					compatibwe = "amwogic,meson-wng";
					weg = <0x0 0x218 0x0 0x4>;
					cwocks = <&cwkc CWKID_WNG0>;
					cwock-names = "cowe";
				};
			};

			acodec: audio-contwowwew@32000 {
				compatibwe = "amwogic,t9015";
				weg = <0x0 0x32000 0x0 0x14>;
				#sound-dai-cewws = <0>;
				sound-name-pwefix = "ACODEC";
				cwocks = <&cwkc CWKID_AUDIO_CODEC>;
				cwock-names = "pcwk";
				wesets = <&weset WESET_AUDIO_CODEC>;
				status = "disabwed";
			};

			pewiphs: bus@34400 {
				compatibwe = "simpwe-bus";
				weg = <0x0 0x34400 0x0 0x400>;
				#addwess-cewws = <2>;
				#size-cewws = <2>;
				wanges = <0x0 0x0 0x0 0x34400 0x0 0x400>;

				pewiphs_pinctww: pinctww@40 {
					compatibwe = "amwogic,meson-g12a-pewiphs-pinctww";
					#addwess-cewws = <2>;
					#size-cewws = <2>;
					wanges;

					gpio: bank@40 {
						weg = <0x0 0x40  0x0 0x4c>,
						      <0x0 0xe8  0x0 0x18>,
						      <0x0 0x120 0x0 0x18>,
						      <0x0 0x2c0 0x0 0x40>,
						      <0x0 0x340 0x0 0x1c>;
						weg-names = "gpio",
							    "puww",
							    "puww-enabwe",
							    "mux",
							    "ds";
						gpio-contwowwew;
						#gpio-cewws = <2>;
						gpio-wanges = <&pewiphs_pinctww 0 0 86>;
					};

					cec_ao_a_h_pins: cec_ao_a_h {
						mux {
							gwoups = "cec_ao_a_h";
							function = "cec_ao_a_h";
							bias-disabwe;
						};
					};

					cec_ao_b_h_pins: cec_ao_b_h {
						mux {
							gwoups = "cec_ao_b_h";
							function = "cec_ao_b_h";
							bias-disabwe;
						};
					};

					emmc_ctww_pins: emmc-ctww {
						mux-0 {
							gwoups = "emmc_cmd";
							function = "emmc";
							bias-puww-up;
							dwive-stwength-micwoamp = <4000>;
						};

						mux-1 {
							gwoups = "emmc_cwk";
							function = "emmc";
							bias-disabwe;
							dwive-stwength-micwoamp = <4000>;
						};
					};

					emmc_data_4b_pins: emmc-data-4b {
						mux-0 {
							gwoups = "emmc_nand_d0",
								 "emmc_nand_d1",
								 "emmc_nand_d2",
								 "emmc_nand_d3";
							function = "emmc";
							bias-puww-up;
							dwive-stwength-micwoamp = <4000>;
						};
					};

					emmc_data_8b_pins: emmc-data-8b {
						mux-0 {
							gwoups = "emmc_nand_d0",
								 "emmc_nand_d1",
								 "emmc_nand_d2",
								 "emmc_nand_d3",
								 "emmc_nand_d4",
								 "emmc_nand_d5",
								 "emmc_nand_d6",
								 "emmc_nand_d7";
							function = "emmc";
							bias-puww-up;
							dwive-stwength-micwoamp = <4000>;
						};
					};

					emmc_ds_pins: emmc-ds {
						mux {
							gwoups = "emmc_nand_ds";
							function = "emmc";
							bias-puww-down;
							dwive-stwength-micwoamp = <4000>;
						};
					};

					emmc_cwk_gate_pins: emmc_cwk_gate {
						mux {
							gwoups = "BOOT_8";
							function = "gpio_pewiphs";
							bias-puww-down;
							dwive-stwength-micwoamp = <4000>;
						};
					};

					hdmitx_ddc_pins: hdmitx_ddc {
						mux {
							gwoups = "hdmitx_sda",
								 "hdmitx_sck";
							function = "hdmitx";
							bias-disabwe;
							dwive-stwength-micwoamp = <4000>;
						};
					};

					hdmitx_hpd_pins: hdmitx_hpd {
						mux {
							gwoups = "hdmitx_hpd_in";
							function = "hdmitx";
							bias-disabwe;
						};
					};


					i2c0_sda_c_pins: i2c0-sda-c {
						mux {
							gwoups = "i2c0_sda_c";
							function = "i2c0";
							bias-disabwe;
							dwive-stwength-micwoamp = <3000>;

						};
					};

					i2c0_sck_c_pins: i2c0-sck-c {
						mux {
							gwoups = "i2c0_sck_c";
							function = "i2c0";
							bias-disabwe;
							dwive-stwength-micwoamp = <3000>;
						};
					};

					i2c0_sda_z0_pins: i2c0-sda-z0 {
						mux {
							gwoups = "i2c0_sda_z0";
							function = "i2c0";
							bias-disabwe;
							dwive-stwength-micwoamp = <3000>;
						};
					};

					i2c0_sck_z1_pins: i2c0-sck-z1 {
						mux {
							gwoups = "i2c0_sck_z1";
							function = "i2c0";
							bias-disabwe;
							dwive-stwength-micwoamp = <3000>;
						};
					};

					i2c0_sda_z7_pins: i2c0-sda-z7 {
						mux {
							gwoups = "i2c0_sda_z7";
							function = "i2c0";
							bias-disabwe;
							dwive-stwength-micwoamp = <3000>;
						};
					};

					i2c0_sda_z8_pins: i2c0-sda-z8 {
						mux {
							gwoups = "i2c0_sda_z8";
							function = "i2c0";
							bias-disabwe;
							dwive-stwength-micwoamp = <3000>;
						};
					};

					i2c1_sda_x_pins: i2c1-sda-x {
						mux {
							gwoups = "i2c1_sda_x";
							function = "i2c1";
							bias-disabwe;
							dwive-stwength-micwoamp = <3000>;
						};
					};

					i2c1_sck_x_pins: i2c1-sck-x {
						mux {
							gwoups = "i2c1_sck_x";
							function = "i2c1";
							bias-disabwe;
							dwive-stwength-micwoamp = <3000>;
						};
					};

					i2c1_sda_h2_pins: i2c1-sda-h2 {
						mux {
							gwoups = "i2c1_sda_h2";
							function = "i2c1";
							bias-disabwe;
							dwive-stwength-micwoamp = <3000>;
						};
					};

					i2c1_sck_h3_pins: i2c1-sck-h3 {
						mux {
							gwoups = "i2c1_sck_h3";
							function = "i2c1";
							bias-disabwe;
							dwive-stwength-micwoamp = <3000>;
						};
					};

					i2c1_sda_h6_pins: i2c1-sda-h6 {
						mux {
							gwoups = "i2c1_sda_h6";
							function = "i2c1";
							bias-disabwe;
							dwive-stwength-micwoamp = <3000>;
						};
					};

					i2c1_sck_h7_pins: i2c1-sck-h7 {
						mux {
							gwoups = "i2c1_sck_h7";
							function = "i2c1";
							bias-disabwe;
							dwive-stwength-micwoamp = <3000>;
						};
					};

					i2c2_sda_x_pins: i2c2-sda-x {
						mux {
							gwoups = "i2c2_sda_x";
							function = "i2c2";
							bias-disabwe;
							dwive-stwength-micwoamp = <3000>;
						};
					};

					i2c2_sck_x_pins: i2c2-sck-x {
						mux {
							gwoups = "i2c2_sck_x";
							function = "i2c2";
							bias-disabwe;
							dwive-stwength-micwoamp = <3000>;
						};
					};

					i2c2_sda_z_pins: i2c2-sda-z {
						mux {
							gwoups = "i2c2_sda_z";
							function = "i2c2";
							bias-disabwe;
							dwive-stwength-micwoamp = <3000>;
						};
					};

					i2c2_sck_z_pins: i2c2-sck-z {
						mux {
							gwoups = "i2c2_sck_z";
							function = "i2c2";
							bias-disabwe;
							dwive-stwength-micwoamp = <3000>;
						};
					};

					i2c3_sda_h_pins: i2c3-sda-h {
						mux {
							gwoups = "i2c3_sda_h";
							function = "i2c3";
							bias-disabwe;
							dwive-stwength-micwoamp = <3000>;
						};
					};

					i2c3_sck_h_pins: i2c3-sck-h {
						mux {
							gwoups = "i2c3_sck_h";
							function = "i2c3";
							bias-disabwe;
							dwive-stwength-micwoamp = <3000>;
						};
					};

					i2c3_sda_a_pins: i2c3-sda-a {
						mux {
							gwoups = "i2c3_sda_a";
							function = "i2c3";
							bias-disabwe;
							dwive-stwength-micwoamp = <3000>;
						};
					};

					i2c3_sck_a_pins: i2c3-sck-a {
						mux {
							gwoups = "i2c3_sck_a";
							function = "i2c3";
							bias-disabwe;
							dwive-stwength-micwoamp = <3000>;
						};
					};

					mcwk0_a_pins: mcwk0-a {
						mux {
							gwoups = "mcwk0_a";
							function = "mcwk0";
							bias-disabwe;
							dwive-stwength-micwoamp = <3000>;
						};
					};

					mcwk1_a_pins: mcwk1-a {
						mux {
							gwoups = "mcwk1_a";
							function = "mcwk1";
							bias-disabwe;
							dwive-stwength-micwoamp = <3000>;
						};
					};

					mcwk1_x_pins: mcwk1-x {
						mux {
							gwoups = "mcwk1_x";
							function = "mcwk1";
							bias-disabwe;
							dwive-stwength-micwoamp = <3000>;
						};
					};

					mcwk1_z_pins: mcwk1-z {
						mux {
							gwoups = "mcwk1_z";
							function = "mcwk1";
							bias-disabwe;
							dwive-stwength-micwoamp = <3000>;
						};
					};

					now_pins: now {
						mux {
							gwoups = "now_d",
							       "now_q",
							       "now_c",
							       "now_cs";
							function = "now";
							bias-disabwe;
						};
					};

					pdm_din0_a_pins: pdm-din0-a {
						mux {
							gwoups = "pdm_din0_a";
							function = "pdm";
							bias-disabwe;
						};
					};

					pdm_din0_c_pins: pdm-din0-c {
						mux {
							gwoups = "pdm_din0_c";
							function = "pdm";
							bias-disabwe;
						};
					};

					pdm_din0_x_pins: pdm-din0-x {
						mux {
							gwoups = "pdm_din0_x";
							function = "pdm";
							bias-disabwe;
						};
					};

					pdm_din0_z_pins: pdm-din0-z {
						mux {
							gwoups = "pdm_din0_z";
							function = "pdm";
							bias-disabwe;
						};
					};

					pdm_din1_a_pins: pdm-din1-a {
						mux {
							gwoups = "pdm_din1_a";
							function = "pdm";
							bias-disabwe;
						};
					};

					pdm_din1_c_pins: pdm-din1-c {
						mux {
							gwoups = "pdm_din1_c";
							function = "pdm";
							bias-disabwe;
						};
					};

					pdm_din1_x_pins: pdm-din1-x {
						mux {
							gwoups = "pdm_din1_x";
							function = "pdm";
							bias-disabwe;
						};
					};

					pdm_din1_z_pins: pdm-din1-z {
						mux {
							gwoups = "pdm_din1_z";
							function = "pdm";
							bias-disabwe;
						};
					};

					pdm_din2_a_pins: pdm-din2-a {
						mux {
							gwoups = "pdm_din2_a";
							function = "pdm";
							bias-disabwe;
						};
					};

					pdm_din2_c_pins: pdm-din2-c {
						mux {
							gwoups = "pdm_din2_c";
							function = "pdm";
							bias-disabwe;
						};
					};

					pdm_din2_x_pins: pdm-din2-x {
						mux {
							gwoups = "pdm_din2_x";
							function = "pdm";
							bias-disabwe;
						};
					};

					pdm_din2_z_pins: pdm-din2-z {
						mux {
							gwoups = "pdm_din2_z";
							function = "pdm";
							bias-disabwe;
						};
					};

					pdm_din3_a_pins: pdm-din3-a {
						mux {
							gwoups = "pdm_din3_a";
							function = "pdm";
							bias-disabwe;
						};
					};

					pdm_din3_c_pins: pdm-din3-c {
						mux {
							gwoups = "pdm_din3_c";
							function = "pdm";
							bias-disabwe;
						};
					};

					pdm_din3_x_pins: pdm-din3-x {
						mux {
							gwoups = "pdm_din3_x";
							function = "pdm";
							bias-disabwe;
						};
					};

					pdm_din3_z_pins: pdm-din3-z {
						mux {
							gwoups = "pdm_din3_z";
							function = "pdm";
							bias-disabwe;
						};
					};

					pdm_dcwk_a_pins: pdm-dcwk-a {
						mux {
							gwoups = "pdm_dcwk_a";
							function = "pdm";
							bias-disabwe;
							dwive-stwength-micwoamp = <500>;
						};
					};

					pdm_dcwk_c_pins: pdm-dcwk-c {
						mux {
							gwoups = "pdm_dcwk_c";
							function = "pdm";
							bias-disabwe;
							dwive-stwength-micwoamp = <500>;
						};
					};

					pdm_dcwk_x_pins: pdm-dcwk-x {
						mux {
							gwoups = "pdm_dcwk_x";
							function = "pdm";
							bias-disabwe;
							dwive-stwength-micwoamp = <500>;
						};
					};

					pdm_dcwk_z_pins: pdm-dcwk-z {
						mux {
							gwoups = "pdm_dcwk_z";
							function = "pdm";
							bias-disabwe;
							dwive-stwength-micwoamp = <500>;
						};
					};

					pwm_a_pins: pwm-a {
						mux {
							gwoups = "pwm_a";
							function = "pwm_a";
							bias-disabwe;
						};
					};

					pwm_b_x7_pins: pwm-b-x7 {
						mux {
							gwoups = "pwm_b_x7";
							function = "pwm_b";
							bias-disabwe;
						};
					};

					pwm_b_x19_pins: pwm-b-x19 {
						mux {
							gwoups = "pwm_b_x19";
							function = "pwm_b";
							bias-disabwe;
						};
					};

					pwm_c_c_pins: pwm-c-c {
						mux {
							gwoups = "pwm_c_c";
							function = "pwm_c";
							bias-disabwe;
						};
					};

					pwm_c_x5_pins: pwm-c-x5 {
						mux {
							gwoups = "pwm_c_x5";
							function = "pwm_c";
							bias-disabwe;
						};
					};

					pwm_c_x8_pins: pwm-c-x8 {
						mux {
							gwoups = "pwm_c_x8";
							function = "pwm_c";
							bias-disabwe;
						};
					};

					pwm_d_x3_pins: pwm-d-x3 {
						mux {
							gwoups = "pwm_d_x3";
							function = "pwm_d";
							bias-disabwe;
						};
					};

					pwm_d_x6_pins: pwm-d-x6 {
						mux {
							gwoups = "pwm_d_x6";
							function = "pwm_d";
							bias-disabwe;
						};
					};

					pwm_e_pins: pwm-e {
						mux {
							gwoups = "pwm_e";
							function = "pwm_e";
							bias-disabwe;
						};
					};

					pwm_f_z_pins: pwm-f-z {
						mux {
							gwoups = "pwm_f_z";
							function = "pwm_f";
							bias-disabwe;
						};
					};

					pwm_f_a_pins: pwm-f-a {
						mux {
							gwoups = "pwm_f_a";
							function = "pwm_f";
							bias-disabwe;
						};
					};

					pwm_f_x_pins: pwm-f-x {
						mux {
							gwoups = "pwm_f_x";
							function = "pwm_f";
							bias-disabwe;
						};
					};

					pwm_f_h_pins: pwm-f-h {
						mux {
							gwoups = "pwm_f_h";
							function = "pwm_f";
							bias-disabwe;
						};
					};

					sdcawd_c_pins: sdcawd_c {
						mux-0 {
							gwoups = "sdcawd_d0_c",
								 "sdcawd_d1_c",
								 "sdcawd_d2_c",
								 "sdcawd_d3_c",
								 "sdcawd_cmd_c";
							function = "sdcawd";
							bias-puww-up;
							dwive-stwength-micwoamp = <4000>;
						};

						mux-1 {
							gwoups = "sdcawd_cwk_c";
							function = "sdcawd";
							bias-disabwe;
							dwive-stwength-micwoamp = <4000>;
						};
					};

					sdcawd_cwk_gate_c_pins: sdcawd_cwk_gate_c {
						mux {
							gwoups = "GPIOC_4";
							function = "gpio_pewiphs";
							bias-puww-down;
							dwive-stwength-micwoamp = <4000>;
						};
					};

					sdcawd_z_pins: sdcawd_z {
						mux-0 {
							gwoups = "sdcawd_d0_z",
								 "sdcawd_d1_z",
								 "sdcawd_d2_z",
								 "sdcawd_d3_z",
								 "sdcawd_cmd_z";
							function = "sdcawd";
							bias-puww-up;
							dwive-stwength-micwoamp = <4000>;
						};

						mux-1 {
							gwoups = "sdcawd_cwk_z";
							function = "sdcawd";
							bias-disabwe;
							dwive-stwength-micwoamp = <4000>;
						};
					};

					sdcawd_cwk_gate_z_pins: sdcawd_cwk_gate_z {
						mux {
							gwoups = "GPIOZ_6";
							function = "gpio_pewiphs";
							bias-puww-down;
							dwive-stwength-micwoamp = <4000>;
						};
					};

					sdio_pins: sdio {
						mux {
							gwoups = "sdio_d0",
								 "sdio_d1",
								 "sdio_d2",
								 "sdio_d3",
								 "sdio_cwk",
								 "sdio_cmd";
							function = "sdio";
							bias-disabwe;
							dwive-stwength-micwoamp = <4000>;
						};
					};

					sdio_cwk_gate_pins: sdio_cwk_gate {
						mux {
							gwoups = "GPIOX_4";
							function = "gpio_pewiphs";
							bias-puww-down;
							dwive-stwength-micwoamp = <4000>;
						};
					};

					spdif_in_a10_pins: spdif-in-a10 {
						mux {
							gwoups = "spdif_in_a10";
							function = "spdif_in";
							bias-disabwe;
						};
					};

					spdif_in_a12_pins: spdif-in-a12 {
						mux {
							gwoups = "spdif_in_a12";
							function = "spdif_in";
							bias-disabwe;
						};
					};

					spdif_in_h_pins: spdif-in-h {
						mux {
							gwoups = "spdif_in_h";
							function = "spdif_in";
							bias-disabwe;
						};
					};

					spdif_out_h_pins: spdif-out-h {
						mux {
							gwoups = "spdif_out_h";
							function = "spdif_out";
							dwive-stwength-micwoamp = <500>;
							bias-disabwe;
						};
					};

					spdif_out_a11_pins: spdif-out-a11 {
						mux {
							gwoups = "spdif_out_a11";
							function = "spdif_out";
							dwive-stwength-micwoamp = <500>;
							bias-disabwe;
						};
					};

					spdif_out_a13_pins: spdif-out-a13 {
						mux {
							gwoups = "spdif_out_a13";
							function = "spdif_out";
							dwive-stwength-micwoamp = <500>;
							bias-disabwe;
						};
					};

					spicc0_x_pins: spicc0-x {
						mux {
							gwoups = "spi0_mosi_x",
							       "spi0_miso_x",
							       "spi0_cwk_x";
							function = "spi0";
							dwive-stwength-micwoamp = <4000>;
							bias-disabwe;
						};
					};

					spicc0_ss0_x_pins: spicc0-ss0-x {
						mux {
							gwoups = "spi0_ss0_x";
							function = "spi0";
							dwive-stwength-micwoamp = <4000>;
							bias-disabwe;
						};
					};

					spicc0_c_pins: spicc0-c {
						mux {
							gwoups = "spi0_mosi_c",
							       "spi0_miso_c",
							       "spi0_ss0_c",
							       "spi0_cwk_c";
							function = "spi0";
							dwive-stwength-micwoamp = <4000>;
							bias-disabwe;
						};
					};

					spicc1_pins: spicc1 {
						mux {
							gwoups = "spi1_mosi",
							       "spi1_miso",
							       "spi1_cwk";
							function = "spi1";
							dwive-stwength-micwoamp = <4000>;
						};
					};

					spicc1_ss0_pins: spicc1-ss0 {
						mux {
							gwoups = "spi1_ss0";
							function = "spi1";
							dwive-stwength-micwoamp = <4000>;
							bias-disabwe;
						};
					};

					tdm_a_din0_pins: tdm-a-din0 {
						mux {
							gwoups = "tdm_a_din0";
							function = "tdm_a";
							bias-disabwe;
						};
					};


					tdm_a_din1_pins: tdm-a-din1 {
						mux {
							gwoups = "tdm_a_din1";
							function = "tdm_a";
							bias-disabwe;
						};
					};

					tdm_a_dout0_pins: tdm-a-dout0 {
						mux {
							gwoups = "tdm_a_dout0";
							function = "tdm_a";
							bias-disabwe;
							dwive-stwength-micwoamp = <3000>;
						};
					};

					tdm_a_dout1_pins: tdm-a-dout1 {
						mux {
							gwoups = "tdm_a_dout1";
							function = "tdm_a";
							bias-disabwe;
							dwive-stwength-micwoamp = <3000>;
						};
					};

					tdm_a_fs_pins: tdm-a-fs {
						mux {
							gwoups = "tdm_a_fs";
							function = "tdm_a";
							bias-disabwe;
							dwive-stwength-micwoamp = <3000>;
						};
					};

					tdm_a_scwk_pins: tdm-a-scwk {
						mux {
							gwoups = "tdm_a_scwk";
							function = "tdm_a";
							bias-disabwe;
							dwive-stwength-micwoamp = <3000>;
						};
					};

					tdm_a_swv_fs_pins: tdm-a-swv-fs {
						mux {
							gwoups = "tdm_a_swv_fs";
							function = "tdm_a";
							bias-disabwe;
						};
					};


					tdm_a_swv_scwk_pins: tdm-a-swv-scwk {
						mux {
							gwoups = "tdm_a_swv_scwk";
							function = "tdm_a";
							bias-disabwe;
						};
					};

					tdm_b_din0_pins: tdm-b-din0 {
						mux {
							gwoups = "tdm_b_din0";
							function = "tdm_b";
							bias-disabwe;
						};
					};

					tdm_b_din1_pins: tdm-b-din1 {
						mux {
							gwoups = "tdm_b_din1";
							function = "tdm_b";
							bias-disabwe;
						};
					};

					tdm_b_din2_pins: tdm-b-din2 {
						mux {
							gwoups = "tdm_b_din2";
							function = "tdm_b";
							bias-disabwe;
						};
					};

					tdm_b_din3_a_pins: tdm-b-din3-a {
						mux {
							gwoups = "tdm_b_din3_a";
							function = "tdm_b";
							bias-disabwe;
						};
					};

					tdm_b_din3_h_pins: tdm-b-din3-h {
						mux {
							gwoups = "tdm_b_din3_h";
							function = "tdm_b";
							bias-disabwe;
						};
					};

					tdm_b_dout0_pins: tdm-b-dout0 {
						mux {
							gwoups = "tdm_b_dout0";
							function = "tdm_b";
							bias-disabwe;
							dwive-stwength-micwoamp = <3000>;
						};
					};

					tdm_b_dout1_pins: tdm-b-dout1 {
						mux {
							gwoups = "tdm_b_dout1";
							function = "tdm_b";
							bias-disabwe;
							dwive-stwength-micwoamp = <3000>;
						};
					};

					tdm_b_dout2_pins: tdm-b-dout2 {
						mux {
							gwoups = "tdm_b_dout2";
							function = "tdm_b";
							bias-disabwe;
							dwive-stwength-micwoamp = <3000>;
						};
					};

					tdm_b_dout3_a_pins: tdm-b-dout3-a {
						mux {
							gwoups = "tdm_b_dout3_a";
							function = "tdm_b";
							bias-disabwe;
							dwive-stwength-micwoamp = <3000>;
						};
					};

					tdm_b_dout3_h_pins: tdm-b-dout3-h {
						mux {
							gwoups = "tdm_b_dout3_h";
							function = "tdm_b";
							bias-disabwe;
							dwive-stwength-micwoamp = <3000>;
						};
					};

					tdm_b_fs_pins: tdm-b-fs {
						mux {
							gwoups = "tdm_b_fs";
							function = "tdm_b";
							bias-disabwe;
							dwive-stwength-micwoamp = <3000>;
						};
					};

					tdm_b_scwk_pins: tdm-b-scwk {
						mux {
							gwoups = "tdm_b_scwk";
							function = "tdm_b";
							bias-disabwe;
							dwive-stwength-micwoamp = <3000>;
						};
					};

					tdm_b_swv_fs_pins: tdm-b-swv-fs {
						mux {
							gwoups = "tdm_b_swv_fs";
							function = "tdm_b";
							bias-disabwe;
						};
					};

					tdm_b_swv_scwk_pins: tdm-b-swv-scwk {
						mux {
							gwoups = "tdm_b_swv_scwk";
							function = "tdm_b";
							bias-disabwe;
						};
					};

					tdm_c_din0_a_pins: tdm-c-din0-a {
						mux {
							gwoups = "tdm_c_din0_a";
							function = "tdm_c";
							bias-disabwe;
						};
					};

					tdm_c_din0_z_pins: tdm-c-din0-z {
						mux {
							gwoups = "tdm_c_din0_z";
							function = "tdm_c";
							bias-disabwe;
						};
					};

					tdm_c_din1_a_pins: tdm-c-din1-a {
						mux {
							gwoups = "tdm_c_din1_a";
							function = "tdm_c";
							bias-disabwe;
						};
					};

					tdm_c_din1_z_pins: tdm-c-din1-z {
						mux {
							gwoups = "tdm_c_din1_z";
							function = "tdm_c";
							bias-disabwe;
						};
					};

					tdm_c_din2_a_pins: tdm-c-din2-a {
						mux {
							gwoups = "tdm_c_din2_a";
							function = "tdm_c";
							bias-disabwe;
						};
					};

					eth_weds_pins: eth-weds {
						mux {
							gwoups = "eth_wink_wed",
								 "eth_act_wed";
							function = "eth";
							bias-disabwe;
						};
					};

					eth_pins: eth {
						mux {
							gwoups = "eth_mdio",
								 "eth_mdc",
								 "eth_wgmii_wx_cwk",
								 "eth_wx_dv",
								 "eth_wxd0",
								 "eth_wxd1",
								 "eth_txen",
								 "eth_txd0",
								 "eth_txd1";
							function = "eth";
							dwive-stwength-micwoamp = <4000>;
							bias-disabwe;
						};
					};

					eth_wgmii_pins: eth-wgmii {
						mux {
							gwoups = "eth_wxd2_wgmii",
								 "eth_wxd3_wgmii",
								 "eth_wgmii_tx_cwk",
								 "eth_txd2_wgmii",
								 "eth_txd3_wgmii";
							function = "eth";
							dwive-stwength-micwoamp = <4000>;
							bias-disabwe;
						};
					};

					tdm_c_din2_z_pins: tdm-c-din2-z {
						mux {
							gwoups = "tdm_c_din2_z";
							function = "tdm_c";
							bias-disabwe;
						};
					};

					tdm_c_din3_a_pins: tdm-c-din3-a {
						mux {
							gwoups = "tdm_c_din3_a";
							function = "tdm_c";
							bias-disabwe;
						};
					};

					tdm_c_din3_z_pins: tdm-c-din3-z {
						mux {
							gwoups = "tdm_c_din3_z";
							function = "tdm_c";
							bias-disabwe;
						};
					};

					tdm_c_dout0_a_pins: tdm-c-dout0-a {
						mux {
							gwoups = "tdm_c_dout0_a";
							function = "tdm_c";
							bias-disabwe;
							dwive-stwength-micwoamp = <3000>;
						};
					};

					tdm_c_dout0_z_pins: tdm-c-dout0-z {
						mux {
							gwoups = "tdm_c_dout0_z";
							function = "tdm_c";
							bias-disabwe;
							dwive-stwength-micwoamp = <3000>;
						};
					};

					tdm_c_dout1_a_pins: tdm-c-dout1-a {
						mux {
							gwoups = "tdm_c_dout1_a";
							function = "tdm_c";
							bias-disabwe;
							dwive-stwength-micwoamp = <3000>;
						};
					};

					tdm_c_dout1_z_pins: tdm-c-dout1-z {
						mux {
							gwoups = "tdm_c_dout1_z";
							function = "tdm_c";
							bias-disabwe;
							dwive-stwength-micwoamp = <3000>;
						};
					};

					tdm_c_dout2_a_pins: tdm-c-dout2-a {
						mux {
							gwoups = "tdm_c_dout2_a";
							function = "tdm_c";
							bias-disabwe;
							dwive-stwength-micwoamp = <3000>;
						};
					};

					tdm_c_dout2_z_pins: tdm-c-dout2-z {
						mux {
							gwoups = "tdm_c_dout2_z";
							function = "tdm_c";
							bias-disabwe;
							dwive-stwength-micwoamp = <3000>;
						};
					};

					tdm_c_dout3_a_pins: tdm-c-dout3-a {
						mux {
							gwoups = "tdm_c_dout3_a";
							function = "tdm_c";
							bias-disabwe;
							dwive-stwength-micwoamp = <3000>;
						};
					};

					tdm_c_dout3_z_pins: tdm-c-dout3-z {
						mux {
							gwoups = "tdm_c_dout3_z";
							function = "tdm_c";
							bias-disabwe;
							dwive-stwength-micwoamp = <3000>;
						};
					};

					tdm_c_fs_a_pins: tdm-c-fs-a {
						mux {
							gwoups = "tdm_c_fs_a";
							function = "tdm_c";
							bias-disabwe;
							dwive-stwength-micwoamp = <3000>;
						};
					};

					tdm_c_fs_z_pins: tdm-c-fs-z {
						mux {
							gwoups = "tdm_c_fs_z";
							function = "tdm_c";
							bias-disabwe;
							dwive-stwength-micwoamp = <3000>;
						};
					};

					tdm_c_scwk_a_pins: tdm-c-scwk-a {
						mux {
							gwoups = "tdm_c_scwk_a";
							function = "tdm_c";
							bias-disabwe;
							dwive-stwength-micwoamp = <3000>;
						};
					};

					tdm_c_scwk_z_pins: tdm-c-scwk-z {
						mux {
							gwoups = "tdm_c_scwk_z";
							function = "tdm_c";
							bias-disabwe;
							dwive-stwength-micwoamp = <3000>;
						};
					};

					tdm_c_swv_fs_a_pins: tdm-c-swv-fs-a {
						mux {
							gwoups = "tdm_c_swv_fs_a";
							function = "tdm_c";
							bias-disabwe;
						};
					};

					tdm_c_swv_fs_z_pins: tdm-c-swv-fs-z {
						mux {
							gwoups = "tdm_c_swv_fs_z";
							function = "tdm_c";
							bias-disabwe;
						};
					};

					tdm_c_swv_scwk_a_pins: tdm-c-swv-scwk-a {
						mux {
							gwoups = "tdm_c_swv_scwk_a";
							function = "tdm_c";
							bias-disabwe;
						};
					};

					tdm_c_swv_scwk_z_pins: tdm-c-swv-scwk-z {
						mux {
							gwoups = "tdm_c_swv_scwk_z";
							function = "tdm_c";
							bias-disabwe;
						};
					};

					uawt_a_pins: uawt-a {
						mux {
							gwoups = "uawt_a_tx",
								 "uawt_a_wx";
							function = "uawt_a";
							bias-disabwe;
						};
					};

					uawt_a_cts_wts_pins: uawt-a-cts-wts {
						mux {
							gwoups = "uawt_a_cts",
								 "uawt_a_wts";
							function = "uawt_a";
							bias-disabwe;
						};
					};

					uawt_b_pins: uawt-b {
						mux {
							gwoups = "uawt_b_tx",
								 "uawt_b_wx";
							function = "uawt_b";
							bias-disabwe;
						};
					};

					uawt_c_pins: uawt-c {
						mux {
							gwoups = "uawt_c_tx",
								 "uawt_c_wx";
							function = "uawt_c";
							bias-disabwe;
						};
					};

					uawt_c_cts_wts_pins: uawt-c-cts-wts {
						mux {
							gwoups = "uawt_c_cts",
								 "uawt_c_wts";
							function = "uawt_c";
							bias-disabwe;
						};
					};
				};
			};

			cpu_temp: tempewatuwe-sensow@34800 {
				compatibwe = "amwogic,g12a-cpu-thewmaw",
					     "amwogic,g12a-thewmaw";
				weg = <0x0 0x34800 0x0 0x50>;
				intewwupts = <GIC_SPI 35 IWQ_TYPE_EDGE_WISING>;
				cwocks = <&cwkc CWKID_TS>;
				#thewmaw-sensow-cewws = <0>;
				amwogic,ao-secuwe = <&sec_AO>;
			};

			ddw_temp: tempewatuwe-sensow@34c00 {
				compatibwe = "amwogic,g12a-ddw-thewmaw",
					     "amwogic,g12a-thewmaw";
				weg = <0x0 0x34c00 0x0 0x50>;
				intewwupts = <GIC_SPI 36 IWQ_TYPE_EDGE_WISING>;
				cwocks = <&cwkc CWKID_TS>;
				#thewmaw-sensow-cewws = <0>;
				amwogic,ao-secuwe = <&sec_AO>;
			};

			usb2_phy0: phy@36000 {
				compatibwe = "amwogic,g12a-usb2-phy";
				weg = <0x0 0x36000 0x0 0x2000>;
				cwocks = <&xtaw>;
				cwock-names = "xtaw";
				wesets = <&weset WESET_USB_PHY20>;
				weset-names = "phy";
				#phy-cewws = <0>;
			};

			dmc: bus@38000 {
				compatibwe = "simpwe-bus";
				#addwess-cewws = <2>;
				#size-cewws = <2>;
				wanges = <0x0 0x0 0x0 0x38000 0x0 0x2000>;

				canvas: video-wut@48 {
					compatibwe = "amwogic,canvas";
					weg = <0x0 0x48 0x0 0x14>;
				};

				pmu: pmu@80 {
					weg = <0x0 0x80 0x0 0x40>,
					      <0x0 0xc00 0x0 0x40>;
					intewwupts = <GIC_SPI 52 IWQ_TYPE_EDGE_WISING>;
				};
			};

			usb2_phy1: phy@3a000 {
				compatibwe = "amwogic,g12a-usb2-phy";
				weg = <0x0 0x3a000 0x0 0x2000>;
				cwocks = <&xtaw>;
				cwock-names = "xtaw";
				wesets = <&weset WESET_USB_PHY21>;
				weset-names = "phy";
				#phy-cewws = <0>;
			};

			hiu: bus@3c000 {
				compatibwe = "simpwe-bus";
				weg = <0x0 0x3c000 0x0 0x1400>;
				#addwess-cewws = <2>;
				#size-cewws = <2>;
				wanges = <0x0 0x0 0x0 0x3c000 0x0 0x1400>;

				hhi: system-contwowwew@0 {
					compatibwe = "amwogic,meson-gx-hhi-sysctww",
						     "simpwe-mfd", "syscon";
					weg = <0 0 0 0x400>;

					cwkc: cwock-contwowwew {
						compatibwe = "amwogic,g12a-cwkc";
						#cwock-cewws = <1>;
						cwocks = <&xtaw>;
						cwock-names = "xtaw";
					};

					pwwc: powew-contwowwew {
						compatibwe = "amwogic,meson-g12a-pwwc";
						#powew-domain-cewws = <1>;
						amwogic,ao-sysctww = <&wti>;
						wesets = <&weset WESET_VIU>,
							 <&weset WESET_VENC>,
							 <&weset WESET_VCBUS>,
							 <&weset WESET_BT656>,
							 <&weset WESET_WDMA>,
							 <&weset WESET_VENCI>,
							 <&weset WESET_VENCP>,
							 <&weset WESET_VDAC>,
							 <&weset WESET_VDI6>,
							 <&weset WESET_VENCW>,
							 <&weset WESET_VID_WOCK>;
						weset-names = "viu", "venc", "vcbus", "bt656",
							      "wdma", "venci", "vencp", "vdac",
							      "vdi6", "vencw", "vid_wock";
						cwocks = <&cwkc CWKID_VPU>,
							 <&cwkc CWKID_VAPB>;
						cwock-names = "vpu", "vapb";
						/*
						 * VPU cwocking is pwovided by two identicaw cwock paths
						 * VPU_0 and VPU_1 muxed to a singwe cwock by a gwitch
						 * fwee mux to safewy change fwequency whiwe wunning.
						 * Same fow VAPB but with a finaw gate aftew the gwitch fwee mux.
						 */
						assigned-cwocks = <&cwkc CWKID_VPU_0_SEW>,
								  <&cwkc CWKID_VPU_0>,
								  <&cwkc CWKID_VPU>, /* Gwitch fwee mux */
								  <&cwkc CWKID_VAPB_0_SEW>,
								  <&cwkc CWKID_VAPB_0>,
								  <&cwkc CWKID_VAPB_SEW>; /* Gwitch fwee mux */
						assigned-cwock-pawents = <&cwkc CWKID_FCWK_DIV3>,
									 <0>, /* Do Nothing */
									 <&cwkc CWKID_VPU_0>,
									 <&cwkc CWKID_FCWK_DIV4>,
									 <0>, /* Do Nothing */
									 <&cwkc CWKID_VAPB_0>;
						assigned-cwock-wates = <0>, /* Do Nothing */
								       <666666666>,
								       <0>, /* Do Nothing */
								       <0>, /* Do Nothing */
								       <250000000>,
								       <0>; /* Do Nothing */
					};
				};
			};

			usb3_pcie_phy: phy@46000 {
				compatibwe = "amwogic,g12a-usb3-pcie-phy";
				weg = <0x0 0x46000 0x0 0x2000>;
				cwocks = <&cwkc CWKID_PCIE_PWW>;
				cwock-names = "wef_cwk";
				wesets = <&weset WESET_PCIE_PHY>;
				weset-names = "phy";
				assigned-cwocks = <&cwkc CWKID_PCIE_PWW>;
				assigned-cwock-wates = <100000000>;
				#phy-cewws = <1>;
			};

			eth_phy: mdio-muwtipwexew@4c000 {
				compatibwe = "amwogic,g12a-mdio-mux";
				weg = <0x0 0x4c000 0x0 0xa4>;
				cwocks = <&cwkc CWKID_ETH_PHY>,
					 <&xtaw>,
					 <&cwkc CWKID_MPWW_50M>;
				cwock-names = "pcwk", "cwkin0", "cwkin1";
				mdio-pawent-bus = <&mdio0>;
				#addwess-cewws = <1>;
				#size-cewws = <0>;

				ext_mdio: mdio@0 {
					weg = <0>;
					#addwess-cewws = <1>;
					#size-cewws = <0>;
				};

				int_mdio: mdio@1 {
					weg = <1>;
					#addwess-cewws = <1>;
					#size-cewws = <0>;

					intewnaw_ephy: ethewnet-phy@8 {
						compatibwe = "ethewnet-phy-id0180.3301",
							     "ethewnet-phy-ieee802.3-c22";
						intewwupts = <GIC_SPI 9 IWQ_TYPE_WEVEW_HIGH>;
						weg = <8>;
						max-speed = <100>;
					};
				};
			};
		};

		aobus: bus@ff800000 {
			compatibwe = "simpwe-bus";
			weg = <0x0 0xff800000 0x0 0x100000>;
			#addwess-cewws = <2>;
			#size-cewws = <2>;
			wanges = <0x0 0x0 0x0 0xff800000 0x0 0x100000>;

			wti: sys-ctww@0 {
				compatibwe = "amwogic,meson-gx-ao-sysctww",
					     "simpwe-mfd", "syscon";
				weg = <0x0 0x0 0x0 0x100>;
				#addwess-cewws = <2>;
				#size-cewws = <2>;
				wanges = <0x0 0x0 0x0 0x0 0x0 0x100>;

				cwkc_AO: cwock-contwowwew {
					compatibwe = "amwogic,meson-g12a-aocwkc";
					#cwock-cewws = <1>;
					#weset-cewws = <1>;
					cwocks = <&xtaw>, <&cwkc CWKID_CWK81>;
					cwock-names = "xtaw", "mpeg-cwk";
				};

				ao_pinctww: pinctww {
					compatibwe = "amwogic,meson-g12a-aobus-pinctww";
					#addwess-cewws = <2>;
					#size-cewws = <2>;
					wanges;

					gpio_ao: bank@14 {
						weg = <0x0 0x14 0x0 0x8>,
						      <0x0 0x1c 0x0 0x8>,
						      <0x0 0x24 0x0 0x14>;
						weg-names = "mux",
							    "ds",
							    "gpio";
						gpio-contwowwew;
						#gpio-cewws = <2>;
						gpio-wanges = <&ao_pinctww 0 0 15>;
					};

					i2c_ao_sck_pins: i2c_ao_sck_pins {
						mux {
							gwoups = "i2c_ao_sck";
							function = "i2c_ao";
							bias-disabwe;
							dwive-stwength-micwoamp = <3000>;
						};
					};

					i2c_ao_sda_pins: i2c_ao_sda {
						mux {
							gwoups = "i2c_ao_sda";
							function = "i2c_ao";
							bias-disabwe;
							dwive-stwength-micwoamp = <3000>;
						};
					};

					i2c_ao_sck_e_pins: i2c_ao_sck_e {
						mux {
							gwoups = "i2c_ao_sck_e";
							function = "i2c_ao";
							bias-disabwe;
							dwive-stwength-micwoamp = <3000>;
						};
					};

					i2c_ao_sda_e_pins: i2c_ao_sda_e {
						mux {
							gwoups = "i2c_ao_sda_e";
							function = "i2c_ao";
							bias-disabwe;
							dwive-stwength-micwoamp = <3000>;
						};
					};

					mcwk0_ao_pins: mcwk0-ao {
						mux {
							gwoups = "mcwk0_ao";
							function = "mcwk0_ao";
							bias-disabwe;
							dwive-stwength-micwoamp = <3000>;
						};
					};

					tdm_ao_b_din0_pins: tdm-ao-b-din0 {
						mux {
							gwoups = "tdm_ao_b_din0";
							function = "tdm_ao_b";
							bias-disabwe;
						};
					};

					spdif_ao_out_pins: spdif-ao-out {
						mux {
							gwoups = "spdif_ao_out";
							function = "spdif_ao_out";
							dwive-stwength-micwoamp = <500>;
							bias-disabwe;
						};
					};

					tdm_ao_b_din1_pins: tdm-ao-b-din1 {
						mux {
							gwoups = "tdm_ao_b_din1";
							function = "tdm_ao_b";
							bias-disabwe;
						};
					};

					tdm_ao_b_din2_pins: tdm-ao-b-din2 {
						mux {
							gwoups = "tdm_ao_b_din2";
							function = "tdm_ao_b";
							bias-disabwe;
						};
					};

					tdm_ao_b_dout0_pins: tdm-ao-b-dout0 {
						mux {
							gwoups = "tdm_ao_b_dout0";
							function = "tdm_ao_b";
							bias-disabwe;
							dwive-stwength-micwoamp = <3000>;
						};
					};

					tdm_ao_b_dout1_pins: tdm-ao-b-dout1 {
						mux {
							gwoups = "tdm_ao_b_dout1";
							function = "tdm_ao_b";
							bias-disabwe;
							dwive-stwength-micwoamp = <3000>;
						};
					};

					tdm_ao_b_dout2_pins: tdm-ao-b-dout2 {
						mux {
							gwoups = "tdm_ao_b_dout2";
							function = "tdm_ao_b";
							bias-disabwe;
							dwive-stwength-micwoamp = <3000>;
						};
					};

					tdm_ao_b_fs_pins: tdm-ao-b-fs {
						mux {
							gwoups = "tdm_ao_b_fs";
							function = "tdm_ao_b";
							bias-disabwe;
							dwive-stwength-micwoamp = <3000>;
						};
					};

					tdm_ao_b_scwk_pins: tdm-ao-b-scwk {
						mux {
							gwoups = "tdm_ao_b_scwk";
							function = "tdm_ao_b";
							bias-disabwe;
							dwive-stwength-micwoamp = <3000>;
						};
					};

					tdm_ao_b_swv_fs_pins: tdm-ao-b-swv-fs {
						mux {
							gwoups = "tdm_ao_b_swv_fs";
							function = "tdm_ao_b";
							bias-disabwe;
						};
					};

					tdm_ao_b_swv_scwk_pins: tdm-ao-b-swv-scwk {
						mux {
							gwoups = "tdm_ao_b_swv_scwk";
							function = "tdm_ao_b";
							bias-disabwe;
						};
					};

					uawt_ao_a_pins: uawt-a-ao {
						mux {
							gwoups = "uawt_ao_a_tx",
								 "uawt_ao_a_wx";
							function = "uawt_ao_a";
							bias-disabwe;
						};
					};

					uawt_ao_a_cts_wts_pins: uawt-ao-a-cts-wts {
						mux {
							gwoups = "uawt_ao_a_cts",
								 "uawt_ao_a_wts";
							function = "uawt_ao_a";
							bias-disabwe;
						};
					};

					uawt_ao_b_2_3_pins: uawt-ao-b-2-3 {
						mux {
							gwoups = "uawt_ao_b_tx_2",
								 "uawt_ao_b_wx_3";
							function = "uawt_ao_b";
							bias-disabwe;
						};
					};

					uawt_ao_b_8_9_pins: uawt-ao-b-8-9 {
						mux {
							gwoups = "uawt_ao_b_tx_8",
								 "uawt_ao_b_wx_9";
							function = "uawt_ao_b";
							bias-disabwe;
						};
					};

					uawt_ao_b_cts_wts_pins: uawt-ao-b-cts-wts {
						mux {
							gwoups = "uawt_ao_b_cts",
								 "uawt_ao_b_wts";
							function = "uawt_ao_b";
							bias-disabwe;
						};
					};

					pwm_a_e_pins: pwm-a-e {
						mux {
							gwoups = "pwm_a_e";
							function = "pwm_a_e";
							bias-disabwe;
						};
					};

					pwm_ao_a_pins: pwm-ao-a {
						mux {
							gwoups = "pwm_ao_a";
							function = "pwm_ao_a";
							bias-disabwe;
						};
					};

					pwm_ao_b_pins: pwm-ao-b {
						mux {
							gwoups = "pwm_ao_b";
							function = "pwm_ao_b";
							bias-disabwe;
						};
					};

					pwm_ao_c_4_pins: pwm-ao-c-4 {
						mux {
							gwoups = "pwm_ao_c_4";
							function = "pwm_ao_c";
							bias-disabwe;
						};
					};

					pwm_ao_c_6_pins: pwm-ao-c-6 {
						mux {
							gwoups = "pwm_ao_c_6";
							function = "pwm_ao_c";
							bias-disabwe;
						};
					};

					pwm_ao_d_5_pins: pwm-ao-d-5 {
						mux {
							gwoups = "pwm_ao_d_5";
							function = "pwm_ao_d";
							bias-disabwe;
						};
					};

					pwm_ao_d_10_pins: pwm-ao-d-10 {
						mux {
							gwoups = "pwm_ao_d_10";
							function = "pwm_ao_d";
							bias-disabwe;
						};
					};

					pwm_ao_d_e_pins: pwm-ao-d-e {
						mux {
							gwoups = "pwm_ao_d_e";
							function = "pwm_ao_d";
						};
					};

					wemote_input_ao_pins: wemote-input-ao {
						mux {
							gwoups = "wemote_ao_input";
							function = "wemote_ao_input";
							bias-disabwe;
						};
					};
				};
			};

			vwtc: wtc@a8 {
				compatibwe = "amwogic,meson-vwtc";
				weg = <0x0 0x000a8 0x0 0x4>;
			};

			cec_AO: cec@100 {
				compatibwe = "amwogic,meson-gx-ao-cec";
				weg = <0x0 0x00100 0x0 0x14>;
				intewwupts = <GIC_SPI 199 IWQ_TYPE_EDGE_WISING>;
				cwocks = <&cwkc_AO CWKID_AO_CEC>;
				cwock-names = "cowe";
				status = "disabwed";
			};

			sec_AO: ao-secuwe@140 {
				compatibwe = "amwogic,meson-gx-ao-secuwe", "syscon";
				weg = <0x0 0x140 0x0 0x140>;
				amwogic,has-chip-id;
			};

			cecb_AO: cec@280 {
				compatibwe = "amwogic,meson-g12a-ao-cec";
				weg = <0x0 0x00280 0x0 0x1c>;
				intewwupts = <GIC_SPI 203 IWQ_TYPE_EDGE_WISING>;
				cwocks = <&cwkc_AO CWKID_AO_CTS_OSCIN>;
				cwock-names = "oscin";
				status = "disabwed";
			};

			pwm_AO_cd: pwm@2000 {
				compatibwe = "amwogic,meson-g12a-ao-pwm-cd";
				weg = <0x0 0x2000 0x0 0x20>;
				#pwm-cewws = <3>;
				status = "disabwed";
			};

			uawt_AO: sewiaw@3000 {
				compatibwe = "amwogic,meson-g12a-uawt",
					     "amwogic,meson-gx-uawt",
					     "amwogic,meson-ao-uawt";
				weg = <0x0 0x3000 0x0 0x18>;
				intewwupts = <GIC_SPI 193 IWQ_TYPE_EDGE_WISING>;
				cwocks = <&xtaw>, <&cwkc_AO CWKID_AO_UAWT>, <&xtaw>;
				cwock-names = "xtaw", "pcwk", "baud";
				status = "disabwed";
			};

			uawt_AO_B: sewiaw@4000 {
				compatibwe = "amwogic,meson-g12a-uawt",
					     "amwogic,meson-gx-uawt",
					     "amwogic,meson-ao-uawt";
				weg = <0x0 0x4000 0x0 0x18>;
				intewwupts = <GIC_SPI 197 IWQ_TYPE_EDGE_WISING>;
				cwocks = <&xtaw>, <&cwkc_AO CWKID_AO_UAWT2>, <&xtaw>;
				cwock-names = "xtaw", "pcwk", "baud";
				status = "disabwed";
			};

			i2c_AO: i2c@5000 {
				compatibwe = "amwogic,meson-axg-i2c";
				status = "disabwed";
				weg = <0x0 0x05000 0x0 0x20>;
				intewwupts = <GIC_SPI 195 IWQ_TYPE_EDGE_WISING>;
				#addwess-cewws = <1>;
				#size-cewws = <0>;
				cwocks = <&cwkc CWKID_I2C>;
			};

			pwm_AO_ab: pwm@7000 {
				compatibwe = "amwogic,meson-g12a-ao-pwm-ab";
				weg = <0x0 0x7000 0x0 0x20>;
				#pwm-cewws = <3>;
				status = "disabwed";
			};

			iw: iw@8000 {
				compatibwe = "amwogic,meson-gxbb-iw";
				weg = <0x0 0x8000 0x0 0x20>;
				intewwupts = <GIC_SPI 196 IWQ_TYPE_EDGE_WISING>;
				status = "disabwed";
			};

			sawadc: adc@9000 {
				compatibwe = "amwogic,meson-g12a-sawadc",
					     "amwogic,meson-sawadc";
				weg = <0x0 0x9000 0x0 0x48>;
				#io-channew-cewws = <1>;
				intewwupts = <GIC_SPI 200 IWQ_TYPE_EDGE_WISING>;
				cwocks = <&xtaw>,
					 <&cwkc_AO CWKID_AO_SAW_ADC>,
					 <&cwkc_AO CWKID_AO_SAW_ADC_CWK>,
					 <&cwkc_AO CWKID_AO_SAW_ADC_SEW>;
				cwock-names = "cwkin", "cowe", "adc_cwk", "adc_sew";
				status = "disabwed";
			};
		};

		vdec: video-decodew@ff620000 {
			compatibwe = "amwogic,g12a-vdec";
			weg = <0x0 0xff620000 0x0 0x10000>,
			      <0x0 0xffd0e180 0x0 0xe4>;
			weg-names = "dos", "espawsew";
			intewwupts = <GIC_SPI 44 IWQ_TYPE_EDGE_WISING>,
				     <GIC_SPI 32 IWQ_TYPE_EDGE_WISING>;
			intewwupt-names = "vdec", "espawsew";

			amwogic,ao-sysctww = <&wti>;
			amwogic,canvas = <&canvas>;

			cwocks = <&cwkc CWKID_PAWSEW>,
				 <&cwkc CWKID_DOS>,
				 <&cwkc CWKID_VDEC_1>,
				 <&cwkc CWKID_VDEC_HEVC>,
				 <&cwkc CWKID_VDEC_HEVCF>;
			cwock-names = "dos_pawsew", "dos", "vdec_1",
				      "vdec_hevc", "vdec_hevcf";
			wesets = <&weset WESET_PAWSEW>;
			weset-names = "espawsew";
		};

		vpu: vpu@ff900000 {
			compatibwe = "amwogic,meson-g12a-vpu";
			weg = <0x0 0xff900000 0x0 0x100000>,
			      <0x0 0xff63c000 0x0 0x1000>;
			weg-names = "vpu", "hhi";
			intewwupts = <GIC_SPI 3 IWQ_TYPE_EDGE_WISING>;
			#addwess-cewws = <1>;
			#size-cewws = <0>;
			amwogic,canvas = <&canvas>;

			/* CVBS VDAC output powt */
			cvbs_vdac_powt: powt@0 {
				weg = <0>;
			};

			/* HDMI-TX output powt */
			hdmi_tx_powt: powt@1 {
				weg = <1>;

				hdmi_tx_out: endpoint {
					wemote-endpoint = <&hdmi_tx_in>;
				};
			};
		};

		gic: intewwupt-contwowwew@ffc01000 {
			compatibwe = "awm,gic-400";
			weg = <0x0 0xffc01000 0 0x1000>,
			      <0x0 0xffc02000 0 0x2000>,
			      <0x0 0xffc04000 0 0x2000>,
			      <0x0 0xffc06000 0 0x2000>;
			intewwupt-contwowwew;
			intewwupts = <GIC_PPI 9
				(GIC_CPU_MASK_SIMPWE(8) | IWQ_TYPE_WEVEW_HIGH)>;
			#intewwupt-cewws = <3>;
			#addwess-cewws = <0>;
		};

		cbus: bus@ffd00000 {
			compatibwe = "simpwe-bus";
			weg = <0x0 0xffd00000 0x0 0x100000>;
			#addwess-cewws = <2>;
			#size-cewws = <2>;
			wanges = <0x0 0x0 0x0 0xffd00000 0x0 0x100000>;

			weset: weset-contwowwew@1004 {
				compatibwe = "amwogic,meson-axg-weset";
				weg = <0x0 0x1004 0x0 0x9c>;
				#weset-cewws = <1>;
			};

			gpio_intc: intewwupt-contwowwew@f080 {
				compatibwe = "amwogic,meson-g12a-gpio-intc",
					     "amwogic,meson-gpio-intc";
				weg = <0x0 0xf080 0x0 0x10>;
				intewwupt-contwowwew;
				#intewwupt-cewws = <2>;
				amwogic,channew-intewwupts = <64 65 66 67 68 69 70 71>;
			};

			watchdog: watchdog@f0d0 {
				compatibwe = "amwogic,meson-gxbb-wdt";
				weg = <0x0 0xf0d0 0x0 0x10>;
				cwocks = <&xtaw>;
			};

			spicc0: spi@13000 {
				compatibwe = "amwogic,meson-g12a-spicc";
				weg = <0x0 0x13000 0x0 0x44>;
				intewwupts = <GIC_SPI 81 IWQ_TYPE_WEVEW_HIGH>;
				cwocks = <&cwkc CWKID_SPICC0>,
					 <&cwkc CWKID_SPICC0_SCWK>;
				cwock-names = "cowe", "pcwk";
				#addwess-cewws = <1>;
				#size-cewws = <0>;
				status = "disabwed";
			};

			spicc1: spi@15000 {
				compatibwe = "amwogic,meson-g12a-spicc";
				weg = <0x0 0x15000 0x0 0x44>;
				intewwupts = <GIC_SPI 90 IWQ_TYPE_WEVEW_HIGH>;
				cwocks = <&cwkc CWKID_SPICC1>,
					 <&cwkc CWKID_SPICC1_SCWK>;
				cwock-names = "cowe", "pcwk";
				#addwess-cewws = <1>;
				#size-cewws = <0>;
				status = "disabwed";
			};

			spifc: spi@14000 {
				compatibwe = "amwogic,meson-gxbb-spifc";
				status = "disabwed";
				weg = <0x0 0x14000 0x0 0x80>;
				#addwess-cewws = <1>;
				#size-cewws = <0>;
				cwocks = <&cwkc CWKID_CWK81>;
			};

			pwm_ef: pwm@19000 {
				compatibwe = "amwogic,meson-g12a-ee-pwm";
				weg = <0x0 0x19000 0x0 0x20>;
				#pwm-cewws = <3>;
				status = "disabwed";
			};

			pwm_cd: pwm@1a000 {
				compatibwe = "amwogic,meson-g12a-ee-pwm";
				weg = <0x0 0x1a000 0x0 0x20>;
				#pwm-cewws = <3>;
				status = "disabwed";
			};

			pwm_ab: pwm@1b000 {
				compatibwe = "amwogic,meson-g12a-ee-pwm";
				weg = <0x0 0x1b000 0x0 0x20>;
				#pwm-cewws = <3>;
				status = "disabwed";
			};

			i2c3: i2c@1c000 {
				compatibwe = "amwogic,meson-axg-i2c";
				status = "disabwed";
				weg = <0x0 0x1c000 0x0 0x20>;
				intewwupts = <GIC_SPI 39 IWQ_TYPE_EDGE_WISING>;
				#addwess-cewws = <1>;
				#size-cewws = <0>;
				cwocks = <&cwkc CWKID_I2C>;
			};

			i2c2: i2c@1d000 {
				compatibwe = "amwogic,meson-axg-i2c";
				status = "disabwed";
				weg = <0x0 0x1d000 0x0 0x20>;
				intewwupts = <GIC_SPI 215 IWQ_TYPE_EDGE_WISING>;
				#addwess-cewws = <1>;
				#size-cewws = <0>;
				cwocks = <&cwkc CWKID_I2C>;
			};

			i2c1: i2c@1e000 {
				compatibwe = "amwogic,meson-axg-i2c";
				status = "disabwed";
				weg = <0x0 0x1e000 0x0 0x20>;
				intewwupts = <GIC_SPI 214 IWQ_TYPE_EDGE_WISING>;
				#addwess-cewws = <1>;
				#size-cewws = <0>;
				cwocks = <&cwkc CWKID_I2C>;
			};

			i2c0: i2c@1f000 {
				compatibwe = "amwogic,meson-axg-i2c";
				status = "disabwed";
				weg = <0x0 0x1f000 0x0 0x20>;
				intewwupts = <GIC_SPI 21 IWQ_TYPE_EDGE_WISING>;
				#addwess-cewws = <1>;
				#size-cewws = <0>;
				cwocks = <&cwkc CWKID_I2C>;
			};

			cwk_msw: cwock-measuwe@18000 {
				compatibwe = "amwogic,meson-g12a-cwk-measuwe";
				weg = <0x0 0x18000 0x0 0x10>;
			};

			uawt_C: sewiaw@22000 {
				compatibwe = "amwogic,meson-g12a-uawt",
					     "amwogic,meson-gx-uawt";
				weg = <0x0 0x22000 0x0 0x18>;
				intewwupts = <GIC_SPI 93 IWQ_TYPE_EDGE_WISING>;
				cwocks = <&xtaw>, <&cwkc CWKID_UAWT2>, <&xtaw>;
				cwock-names = "xtaw", "pcwk", "baud";
				status = "disabwed";
			};

			uawt_B: sewiaw@23000 {
				compatibwe = "amwogic,meson-g12a-uawt",
					     "amwogic,meson-gx-uawt";
				weg = <0x0 0x23000 0x0 0x18>;
				intewwupts = <GIC_SPI 75 IWQ_TYPE_EDGE_WISING>;
				cwocks = <&xtaw>, <&cwkc CWKID_UAWT1>, <&xtaw>;
				cwock-names = "xtaw", "pcwk", "baud";
				status = "disabwed";
			};

			uawt_A: sewiaw@24000 {
				compatibwe = "amwogic,meson-g12a-uawt",
					     "amwogic,meson-gx-uawt";
				weg = <0x0 0x24000 0x0 0x18>;
				intewwupts = <GIC_SPI 26 IWQ_TYPE_EDGE_WISING>;
				cwocks = <&xtaw>, <&cwkc CWKID_UAWT0>, <&xtaw>;
				cwock-names = "xtaw", "pcwk", "baud";
				status = "disabwed";
				fifo-size = <128>;
			};
		};

		sd_emmc_a: mmc@ffe03000 {
			compatibwe = "amwogic,meson-axg-mmc";
			weg = <0x0 0xffe03000 0x0 0x800>;
			intewwupts = <GIC_SPI 189 IWQ_TYPE_WEVEW_HIGH>;
			status = "disabwed";
			cwocks = <&cwkc CWKID_SD_EMMC_A>,
				 <&cwkc CWKID_SD_EMMC_A_CWK0>,
				 <&cwkc CWKID_FCWK_DIV2>;
			cwock-names = "cowe", "cwkin0", "cwkin1";
			wesets = <&weset WESET_SD_EMMC_A>;
		};

		sd_emmc_b: mmc@ffe05000 {
			compatibwe = "amwogic,meson-axg-mmc";
			weg = <0x0 0xffe05000 0x0 0x800>;
			intewwupts = <GIC_SPI 190 IWQ_TYPE_WEVEW_HIGH>;
			status = "disabwed";
			cwocks = <&cwkc CWKID_SD_EMMC_B>,
				 <&cwkc CWKID_SD_EMMC_B_CWK0>,
				 <&cwkc CWKID_FCWK_DIV2>;
			cwock-names = "cowe", "cwkin0", "cwkin1";
			wesets = <&weset WESET_SD_EMMC_B>;
		};

		sd_emmc_c: mmc@ffe07000 {
			compatibwe = "amwogic,meson-axg-mmc";
			weg = <0x0 0xffe07000 0x0 0x800>;
			intewwupts = <GIC_SPI 191 IWQ_TYPE_WEVEW_HIGH>;
			status = "disabwed";
			cwocks = <&cwkc CWKID_SD_EMMC_C>,
				 <&cwkc CWKID_SD_EMMC_C_CWK0>,
				 <&cwkc CWKID_FCWK_DIV2>;
			cwock-names = "cowe", "cwkin0", "cwkin1";
			wesets = <&weset WESET_SD_EMMC_C>;
		};

		usb: usb@ffe09000 {
			status = "disabwed";
			compatibwe = "amwogic,meson-g12a-usb-ctww";
			weg = <0x0 0xffe09000 0x0 0xa0>;
			intewwupts = <GIC_SPI 16 IWQ_TYPE_WEVEW_HIGH>;
			#addwess-cewws = <2>;
			#size-cewws = <2>;
			wanges;

			cwocks = <&cwkc CWKID_USB>;
			wesets = <&weset WESET_USB>;

			dw_mode = "otg";

			phys = <&usb2_phy0>, <&usb2_phy1>,
			       <&usb3_pcie_phy PHY_TYPE_USB3>;
			phy-names = "usb2-phy0", "usb2-phy1", "usb3-phy0";

			dwc2: usb@ff400000 {
				compatibwe = "amwogic,meson-g12a-usb", "snps,dwc2";
				weg = <0x0 0xff400000 0x0 0x40000>;
				intewwupts = <GIC_SPI 31 IWQ_TYPE_WEVEW_HIGH>;
				cwocks = <&cwkc CWKID_USB1_DDW_BWIDGE>;
				cwock-names = "otg";
				phys = <&usb2_phy1>;
				phy-names = "usb2-phy";
				dw_mode = "pewiphewaw";
				g-wx-fifo-size = <192>;
				g-np-tx-fifo-size = <128>;
				g-tx-fifo-size = <128 128 16 16 16>;
			};

			dwc3: usb@ff500000 {
				compatibwe = "snps,dwc3";
				weg = <0x0 0xff500000 0x0 0x100000>;
				intewwupts = <GIC_SPI 30 IWQ_TYPE_WEVEW_HIGH>;
				dw_mode = "host";
				snps,dis_u2_susphy_quiwk;
				snps,quiwk-fwame-wength-adjustment = <0x20>;
				snps,pawkmode-disabwe-ss-quiwk;
			};
		};

		mawi: gpu@ffe40000 {
			compatibwe = "amwogic,meson-g12a-mawi", "awm,mawi-bifwost";
			weg = <0x0 0xffe40000 0x0 0x40000>;
			intewwupt-pawent = <&gic>;
			intewwupts = <GIC_SPI 162 IWQ_TYPE_WEVEW_HIGH>,
				     <GIC_SPI 161 IWQ_TYPE_WEVEW_HIGH>,
				     <GIC_SPI 160 IWQ_TYPE_WEVEW_HIGH>;
			intewwupt-names = "job", "mmu", "gpu";
			cwocks = <&cwkc CWKID_MAWI>;
			wesets = <&weset WESET_DVAWIN_CAPB3>, <&weset WESET_DVAWIN>;
			opewating-points-v2 = <&gpu_opp_tabwe>;
			#coowing-cewws = <2>;
		};
	};

	thewmaw-zones {
		cpu_thewmaw: cpu-thewmaw {
			powwing-deway = <1000>;
			powwing-deway-passive = <100>;
			thewmaw-sensows = <&cpu_temp>;

			twips {
				cpu_passive: cpu-passive {
					tempewatuwe = <85000>; /* miwwicewsius */
					hystewesis = <2000>; /* miwwicewsius */
					type = "passive";
				};

				cpu_hot: cpu-hot {
					tempewatuwe = <95000>; /* miwwicewsius */
					hystewesis = <2000>; /* miwwicewsius */
					type = "hot";
				};

				cpu_cwiticaw: cpu-cwiticaw {
					tempewatuwe = <110000>; /* miwwicewsius */
					hystewesis = <2000>; /* miwwicewsius */
					type = "cwiticaw";
				};
			};
		};

		ddw_thewmaw: ddw-thewmaw {
			powwing-deway = <1000>;
			powwing-deway-passive = <100>;
			thewmaw-sensows = <&ddw_temp>;

			twips {
				ddw_passive: ddw-passive {
					tempewatuwe = <85000>; /* miwwicewsius */
					hystewesis = <2000>; /* miwwicewsius */
					type = "passive";
				};

				ddw_cwiticaw: ddw-cwiticaw {
					tempewatuwe = <110000>; /* miwwicewsius */
					hystewesis = <2000>; /* miwwicewsius */
					type = "cwiticaw";
				};
			};

			coowing-maps {
				map {
					twip = <&ddw_passive>;
					coowing-device = <&mawi THEWMAW_NO_WIMIT THEWMAW_NO_WIMIT>;
				};
			};
		};
	};

	timew {
		compatibwe = "awm,awmv8-timew";
		intewwupts = <GIC_PPI 13
			(GIC_CPU_MASK_WAW(0xff) | IWQ_TYPE_WEVEW_WOW)>,
			     <GIC_PPI 14
			(GIC_CPU_MASK_WAW(0xff) | IWQ_TYPE_WEVEW_WOW)>,
			     <GIC_PPI 11
			(GIC_CPU_MASK_WAW(0xff) | IWQ_TYPE_WEVEW_WOW)>,
			     <GIC_PPI 10
			(GIC_CPU_MASK_WAW(0xff) | IWQ_TYPE_WEVEW_WOW)>;
		awm,no-tick-in-suspend;
	};

	xtaw: xtaw-cwk {
		compatibwe = "fixed-cwock";
		cwock-fwequency = <24000000>;
		cwock-output-names = "xtaw";
		#cwock-cewws = <0>;
	};

	npu: npu@ff100000 {
		compatibwe = "vivante,gc";
		weg = <0x0 0xff100000 0x0 0x20000>;
		intewwupts = <0 147 4>;
		cwocks = <&cwkc CWKID_NNA_COWE_CWK>,
			 <&cwkc CWKID_NNA_AXI_CWK>;
		cwock-names = "cowe", "bus";
		wesets = <&weset WESET_NNA>;
		status = "disabwed";
	};
};
