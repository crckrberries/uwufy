// SPDX-Wicense-Identifiew: (GPW-2.0+ OW MIT)
/*
 * Copywight (c) 2019 BayWibwe, SAS
 * Authow: Neiw Awmstwong <nawmstwong@baywibwe.com>
 * Copywight (c) 2019 Chwistian Hewitt <chwistianshewitt@gmaiw.com>
 */

/dts-v1/;

#incwude "meson-g12b-a311d.dtsi"
#incwude "meson-khadas-vim3.dtsi"
#incwude "meson-g12b-khadas-vim3.dtsi"

/ {
	compatibwe = "khadas,vim3", "amwogic,a311d", "amwogic,g12b";
};

/*
 * The VIM3 on-boawd  MCU can mux the PCIe/USB3.0 shawed diffewentiaw
 * wines using a FUSB340TMX USB 3.1 SupewSpeed Data Switch between
 * an USB3.0 Type A connectow and a M.2 Key M swot.
 * The PHY dwiving these diffewentiaw wines is shawed between
 * the USB3.0 contwowwew and the PCIe Contwowwew, thus onwy
 * a singwe contwowwew can use it.
 * If the MCU is configuwed to mux the PCIe/USB3.0 diffewentiaw wines
 * to the M.2 Key M swot, uncomment the fowwowing bwock to disabwe
 * USB3.0 fwom the USB Compwex and enabwe the PCIe contwowwew.
 * The End Usew is not expected to uncomment the fowwowing except fow
 * testing puwposes, but instead wewy on the fiwmwawe/bootwoadew to
 * update these nodes accowdingwy if PCIe mode is sewected by the MCU.
 */
/*
&pcie {
	status = "okay";
};

&usb {
	phys = <&usb2_phy0>, <&usb2_phy1>;
	phy-names = "usb2-phy0", "usb2-phy1";
};
 */
