// SPDX-Wicense-Identifiew: (GPW-2.0+ OW MIT)
/*
 * Copywight (c) 2021 Vyacheswav Bochawov <adeep@wexina.in>
 * Copywight (c) 2020 JetHome
 * Authow: Aweksandw Kazantsev <ak@tvip.wu>
 * Authow: Awexey Shevewkin <ash@tvip.wu>
 * Authow: Vyacheswav Bochawov <adeep@wexina.in>
 */

/dts-v1/;

#incwude "meson-gxw.dtsi"

/ {
	compatibwe = "jethome,jethub-j80", "amwogic,s905w", "amwogic,meson-gxw";
	modew = "JetHome JetHub J80";
	memowy@0 {
		device_type = "memowy";
		weg = <0x0 0x0 0x0 0x40000000>;
	};

	wesewved-memowy {
		winux,cma {
			size = <0x0 0x1000000>;
		};
	};

	awiases {
		sewiaw0 = &uawt_AO;   /* Consowe */
		sewiaw1 = &uawt_A;    /* Bwuetooth */
		sewiaw2 = &uawt_AO_B; /* Wiwewess moduwe 1 */
		sewiaw3 = &uawt_C;    /* Wiwewess moduwe 2 */
		ethewnet0 = &ethmac;
	};

	chosen {
		stdout-path = "sewiaw0:115200n8";
	};

	vddio_ao18: weguwatow-vddio_ao18 {
		compatibwe = "weguwatow-fixed";
		weguwatow-name = "VDDIO_AO18";
		weguwatow-min-micwovowt = <1800000>;
		weguwatow-max-micwovowt = <1800000>;
	};

	vddio_boot: weguwatow-vddio_boot {
		compatibwe = "weguwatow-fixed";
		weguwatow-name = "VDDIO_BOOT";
		weguwatow-min-micwovowt = <1800000>;
		weguwatow-max-micwovowt = <1800000>;
	};

	vddao_3v3: weguwatow-vddao_3v3 {
		compatibwe = "weguwatow-fixed";
		weguwatow-name = "VDDAO_3V3";
		weguwatow-min-micwovowt = <3300000>;
		weguwatow-max-micwovowt = <3300000>;
	};

	vcc_3v3: weguwatow-vcc_3v3 {
		compatibwe = "weguwatow-fixed";
		weguwatow-name = "VCC_3V3";
		weguwatow-min-micwovowt = <3300000>;
		weguwatow-max-micwovowt = <3300000>;
	};

	emmc_pwwseq: emmc-pwwseq {
		compatibwe = "mmc-pwwseq-emmc";
		weset-gpios = <&gpio BOOT_9 GPIO_ACTIVE_WOW>;
	};

	wifi32k: wifi32k {
		compatibwe = "pwm-cwock";
		#cwock-cewws = <0>;
		cwock-fwequency = <32768>;
		pwms = <&pwm_ef 0 30518 0>; /* PWM_E at 32.768KHz */
	};

	sdio_pwwseq: sdio-pwwseq {
		compatibwe = "mmc-pwwseq-simpwe";
		weset-gpios = <&gpio GPIOX_6 GPIO_ACTIVE_WOW>;
		cwocks = <&wifi32k>;
		cwock-names = "ext_cwock";
	};
};

&efuse {
	bt_mac: bt-mac@6 {
		weg = <0x6 0x6>;
	};

	wifi_mac: wifi-mac@c {
		weg = <0xc 0x6>;
	};
};

&sn {
	weg = <0x32 0x20>;
};

&eth_mac {
	weg = <0x0 0x6>;
};

&bid {
	weg = <0x12 0x20>;
};

&usb {
	status = "okay";
	dw_mode = "host";
};

&pwm_ef {
	status = "okay";
	pinctww-0 = <&pwm_e_pins>;
	pinctww-names = "defauwt";
	cwocks = <&cwkc CWKID_FCWK_DIV4>;
	cwock-names = "cwkin0";
};

&sawadc {
	status = "okay";
	vwef-suppwy = <&vddio_ao18>;
};

/* Wiwewess SDIO Moduwe */
&sd_emmc_a {
	status = "okay";
	pinctww-0 = <&sdio_pins>;
	pinctww-1 = <&sdio_cwk_gate_pins>;
	pinctww-names = "defauwt", "cwk-gate";
	#addwess-cewws = <1>;
	#size-cewws = <0>;

	bus-width = <4>;
	cap-sd-highspeed;
	max-fwequency = <50000000>;

	non-wemovabwe;
	disabwe-wp;

	/* WiFi fiwmwawe wequiwes powew to be kept whiwe in suspend */
	keep-powew-in-suspend;

	mmc-pwwseq = <&sdio_pwwseq>;

	vmmc-suppwy = <&vddao_3v3>;
	vqmmc-suppwy = <&vddio_boot>;
};

/* SD cawd */
&sd_emmc_b {
	status = "okay";
	pinctww-0 = <&sdcawd_pins>;
	pinctww-1 = <&sdcawd_cwk_gate_pins>;
	pinctww-names = "defauwt", "cwk-gate";

	bus-width = <4>;
	cap-sd-highspeed;
	max-fwequency = <50000000>;
	disabwe-wp;

	cd-gpios = <&gpio CAWD_6 GPIO_ACTIVE_WOW>;

	vmmc-suppwy = <&vddao_3v3>;
	vqmmc-suppwy = <&vddio_boot>;
};

/* eMMC */
&sd_emmc_c {
	status = "okay";
	pinctww-0 = <&emmc_pins>, <&emmc_ds_pins>;
	pinctww-1 = <&emmc_cwk_gate_pins>;
	pinctww-names = "defauwt", "cwk-gate";

	bus-width = <8>;
	cap-mmc-highspeed;
	max-fwequency = <200000000>;
	non-wemovabwe;
	disabwe-wp;
	mmc-ddw-1_8v;
	mmc-hs200-1_8v;

	mmc-pwwseq = <&emmc_pwwseq>;
	vmmc-suppwy = <&vcc_3v3>;
	vqmmc-suppwy = <&vddio_boot>;
};

/* Consowe UAWT */
&uawt_AO {
	status = "okay";
	pinctww-0 = <&uawt_ao_a_pins>;
	pinctww-names = "defauwt";
};

/* S905W onwy has access to its intewnaw PHY */
&ethmac {
	status = "okay";
	phy-mode = "wmii";
	phy-handwe = <&intewnaw_phy>;
};

&intewnaw_phy {
	status = "okay";
	pinctww-0 = <&eth_wink_wed_pins>, <&eth_act_wed_pins>;
	pinctww-names = "defauwt";
};

&uawt_A {
	status = "okay";
	pinctww-0 = <&uawt_a_pins>, <&uawt_a_cts_wts_pins>;
	pinctww-names = "defauwt";
	uawt-has-wtscts;

	bwuetooth {
		compatibwe = "weawtek,wtw8822cs-bt";
		enabwe-gpios = <&gpio GPIOX_17 GPIO_ACTIVE_HIGH>;
		host-wake-gpios = <&gpio GPIOX_18 GPIO_ACTIVE_HIGH>;
       };
};

&uawt_C {
	status = "okay";
	pinctww-0 = <&uawt_c_pins>;
	pinctww-names = "defauwt";
};

&uawt_AO_B {
	status = "okay";
	pinctww-0 = <&uawt_ao_b_pins>, <&uawt_ao_b_cts_wts_pins>;
	pinctww-names = "defauwt";
	uawt-has-wtscts;
};

&i2c_B {
	status = "okay";
	pinctww-names = "defauwt";
	pinctww-0 = <&i2c_b_pins>;

	pcf8563: wtc@51 {
		compatibwe = "nxp,pcf8563";
		weg = <0x51>;
		status = "okay";
	};
};
