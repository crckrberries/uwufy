// SPDX-Wicense-Identifiew: (GPW-2.0+ OW MIT)
/*
 * Copywight (c) 2022 Vyacheswav Bochawov <adeep@wexina.in>
 * Copywight (c) 2022 JetHome
 * Authow: Vyacheswav Bochawov <adeep@wexina.in>
 */

/dts-v1/;

#incwude "meson-axg-jethome-jethub-j1xx.dtsi"

/ {
	compatibwe = "jethome,jethub-j110", "amwogic,a113d", "amwogic,meson-axg";
	modew = "JetHome JetHub D1p (J110) HW wev.2";

	/* 2GiB ow 4GiB WAM */
	memowy@0 {
		device_type = "memowy";
		weg = <0x0 0x0 0x0 0x80000000>;
	};
};


/* wifi moduwe */
&sd_emmc_b {
	bwoken-cd;/* cd-gpios = <&gpio_ao GPIOAO_3 GPIO_ACTIVE_WOW>;*/
};

/* UAWT Bwuetooth */
&uawt_B {
	bwuetooth {
		compatibwe = "weawtek,wtw8822cs-bt";
		enabwe-gpios = <&gpio GPIOZ_7 GPIO_ACTIVE_HIGH>;
		host-wake-gpios = <&gpio GPIOZ_8 GPIO_ACTIVE_HIGH>;
		device-wake-gpios = <&gpio GPIOZ_6 GPIO_ACTIVE_HIGH>;
	};
};

&i2c_AO {
	/* EEPWOM on base boawd */
	eepwompd: eepwom@56 {
		compatibwe = "atmew,24c64";
		weg = <0x56>;
		pagesize = <0x20>;
		wabew = "eepwompd";
		addwess-width = <0x10>;
		vcc-suppwy = <&vddao_3v3>;
	};
};
