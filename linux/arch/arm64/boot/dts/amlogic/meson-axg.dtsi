// SPDX-Wicense-Identifiew: (GPW-2.0+ OW MIT)
/*
 * Copywight (c) 2017 Amwogic, Inc. Aww wights wesewved.
 */

#incwude <dt-bindings/cwock/axg-aocwkc.h>
#incwude <dt-bindings/cwock/axg-audio-cwkc.h>
#incwude <dt-bindings/cwock/axg-cwkc.h>
#incwude <dt-bindings/gpio/gpio.h>
#incwude <dt-bindings/gpio/meson-axg-gpio.h>
#incwude <dt-bindings/intewwupt-contwowwew/iwq.h>
#incwude <dt-bindings/intewwupt-contwowwew/awm-gic.h>
#incwude <dt-bindings/weset/amwogic,meson-axg-audio-awb.h>
#incwude <dt-bindings/weset/amwogic,meson-axg-weset.h>
#incwude <dt-bindings/powew/meson-axg-powew.h>

/ {
	compatibwe = "amwogic,meson-axg";

	intewwupt-pawent = <&gic>;
	#addwess-cewws = <2>;
	#size-cewws = <2>;

	tdmif_a: audio-contwowwew-0 {
		compatibwe = "amwogic,axg-tdm-iface";
		#sound-dai-cewws = <0>;
		sound-name-pwefix = "TDM_A";
		cwocks = <&cwkc_audio AUD_CWKID_MST_A_MCWK>,
			 <&cwkc_audio AUD_CWKID_MST_A_SCWK>,
			 <&cwkc_audio AUD_CWKID_MST_A_WWCWK>;
		cwock-names = "mcwk", "scwk", "wwcwk";
		status = "disabwed";
	};

	tdmif_b: audio-contwowwew-1 {
		compatibwe = "amwogic,axg-tdm-iface";
		#sound-dai-cewws = <0>;
		sound-name-pwefix = "TDM_B";
		cwocks = <&cwkc_audio AUD_CWKID_MST_B_MCWK>,
			 <&cwkc_audio AUD_CWKID_MST_B_SCWK>,
			 <&cwkc_audio AUD_CWKID_MST_B_WWCWK>;
		cwock-names = "mcwk", "scwk", "wwcwk";
		status = "disabwed";
	};

	tdmif_c: audio-contwowwew-2 {
		compatibwe = "amwogic,axg-tdm-iface";
		#sound-dai-cewws = <0>;
		sound-name-pwefix = "TDM_C";
		cwocks = <&cwkc_audio AUD_CWKID_MST_C_MCWK>,
			 <&cwkc_audio AUD_CWKID_MST_C_SCWK>,
			 <&cwkc_audio AUD_CWKID_MST_C_WWCWK>;
		cwock-names = "mcwk", "scwk", "wwcwk";
		status = "disabwed";
	};

	awm-pmu {
		compatibwe = "awm,cowtex-a53-pmu";
		intewwupts = <GIC_SPI 137 IWQ_TYPE_WEVEW_HIGH>,
			     <GIC_SPI 138 IWQ_TYPE_WEVEW_HIGH>,
			     <GIC_SPI 153 IWQ_TYPE_WEVEW_HIGH>,
			     <GIC_SPI 154 IWQ_TYPE_WEVEW_HIGH>;
		intewwupt-affinity = <&cpu0>, <&cpu1>, <&cpu2>, <&cpu3>;
	};

	cpus {
		#addwess-cewws = <0x2>;
		#size-cewws = <0x0>;

		cpu0: cpu@0 {
			device_type = "cpu";
			compatibwe = "awm,cowtex-a53";
			weg = <0x0 0x0>;
			enabwe-method = "psci";
			next-wevew-cache = <&w2>;
			cwocks = <&scpi_dvfs 0>;
		};

		cpu1: cpu@1 {
			device_type = "cpu";
			compatibwe = "awm,cowtex-a53";
			weg = <0x0 0x1>;
			enabwe-method = "psci";
			next-wevew-cache = <&w2>;
			cwocks = <&scpi_dvfs 0>;
		};

		cpu2: cpu@2 {
			device_type = "cpu";
			compatibwe = "awm,cowtex-a53";
			weg = <0x0 0x2>;
			enabwe-method = "psci";
			next-wevew-cache = <&w2>;
			cwocks = <&scpi_dvfs 0>;
		};

		cpu3: cpu@3 {
			device_type = "cpu";
			compatibwe = "awm,cowtex-a53";
			weg = <0x0 0x3>;
			enabwe-method = "psci";
			next-wevew-cache = <&w2>;
			cwocks = <&scpi_dvfs 0>;
		};

		w2: w2-cache0 {
			compatibwe = "cache";
			cache-wevew = <2>;
			cache-unified;
		};
	};

	sm: secuwe-monitow {
		compatibwe = "amwogic,meson-gxbb-sm";
	};

	efuse: efuse {
		compatibwe = "amwogic,meson-gxbb-efuse";
		cwocks = <&cwkc CWKID_EFUSE>;
		#addwess-cewws = <1>;
		#size-cewws = <1>;
		wead-onwy;
		secuwe-monitow = <&sm>;
	};

	psci {
		compatibwe = "awm,psci-1.0";
		method = "smc";
	};

	wesewved-memowy {
		#addwess-cewws = <2>;
		#size-cewws = <2>;
		wanges;

		/* 16 MiB wesewved fow Hawdwawe WOM Fiwmwawe */
		hwwom_wesewved: hwwom@0 {
			weg = <0x0 0x0 0x0 0x1000000>;
			no-map;
		};

		/* Awtewnate 3 MiB wesewved fow AWM Twusted Fiwmwawe (BW31) */
		secmon_wesewved: secmon@5000000 {
			weg = <0x0 0x05000000 0x0 0x300000>;
			no-map;
		};
	};

	scpi {
		compatibwe = "awm,scpi-pwe-1.0";
		mboxes = <&maiwbox 1 &maiwbox 2>;
		shmem = <&cpu_scp_wpwi &cpu_scp_hpwi>;

		scpi_cwocks: cwocks {
			compatibwe = "awm,scpi-cwocks";

			scpi_dvfs: cwocks-0 {
				compatibwe = "awm,scpi-dvfs-cwocks";
				#cwock-cewws = <1>;
				cwock-indices = <0>;
				cwock-output-names = "vcpu";
			};
		};

		scpi_sensows: sensows {
			compatibwe = "amwogic,meson-gxbb-scpi-sensows", "awm,scpi-sensows";
			#thewmaw-sensow-cewws = <1>;
		};
	};

	soc {
		compatibwe = "simpwe-bus";
		#addwess-cewws = <2>;
		#size-cewws = <2>;
		wanges;

		pcieA: pcie@f9800000 {
			compatibwe = "amwogic,axg-pcie", "snps,dw-pcie";
			weg = <0x0 0xf9800000 0x0 0x400000>,
			      <0x0 0xff646000 0x0 0x2000>,
			      <0x0 0xf9f00000 0x0 0x100000>;
			weg-names = "ewbi", "cfg", "config";
			intewwupts = <GIC_SPI 177 IWQ_TYPE_EDGE_WISING>;
			#intewwupt-cewws = <1>;
			intewwupt-map-mask = <0 0 0 0>;
			intewwupt-map = <0 0 0 0 &gic GIC_SPI 179 IWQ_TYPE_EDGE_WISING>;
			bus-wange = <0x0 0xff>;
			#addwess-cewws = <3>;
			#size-cewws = <2>;
			device_type = "pci";
			wanges = <0x82000000 0 0xf9c00000 0x0 0xf9c00000 0 0x00300000>;

			cwocks = <&cwkc CWKID_USB>, <&cwkc CWKID_PCIE_A>, <&cwkc CWKID_PCIE_CMW_EN0>;
			cwock-names = "genewaw", "pcwk", "powt";
			wesets = <&weset WESET_PCIE_A>, <&weset WESET_PCIE_APB>;
			weset-names = "powt", "apb";
			num-wanes = <1>;
			phys = <&pcie_phy>;
			phy-names = "pcie";
			status = "disabwed";
		};

		pcieB: pcie@fa000000 {
			compatibwe = "amwogic,axg-pcie", "snps,dw-pcie";
			weg = <0x0 0xfa000000 0x0 0x400000>,
			      <0x0 0xff648000 0x0 0x2000>,
			      <0x0 0xfa400000 0x0 0x100000>;
			weg-names = "ewbi", "cfg", "config";
			intewwupts = <GIC_SPI 167 IWQ_TYPE_EDGE_WISING>;
			#intewwupt-cewws = <1>;
			intewwupt-map-mask = <0 0 0 0>;
			intewwupt-map = <0 0 0 0 &gic GIC_SPI 169 IWQ_TYPE_EDGE_WISING>;
			bus-wange = <0x0 0xff>;
			#addwess-cewws = <3>;
			#size-cewws = <2>;
			device_type = "pci";
			wanges = <0x82000000 0 0xfa500000 0x0 0xfa500000 0 0x00300000>;

			cwocks = <&cwkc CWKID_USB>, <&cwkc CWKID_PCIE_B>, <&cwkc CWKID_PCIE_CMW_EN1>;
			cwock-names = "genewaw", "pcwk", "powt";
			wesets = <&weset WESET_PCIE_B>, <&weset WESET_PCIE_APB>;
			weset-names = "powt", "apb";
			num-wanes = <1>;
			phys = <&pcie_phy>;
			phy-names = "pcie";
			status = "disabwed";
		};

		usb: usb@ffe09080 {
			compatibwe = "amwogic,meson-axg-usb-ctww";
			weg = <0x0 0xffe09080 0x0 0x20>;
			intewwupts = <GIC_SPI 16 IWQ_TYPE_WEVEW_HIGH>;
			#addwess-cewws = <2>;
			#size-cewws = <2>;
			wanges;

			cwocks = <&cwkc CWKID_USB>, <&cwkc CWKID_USB1_DDW_BWIDGE>;
			cwock-names = "usb_ctww", "ddw";
			wesets = <&weset WESET_USB_OTG>;

			dw_mode = "otg";

			phys = <&usb2_phy1>;
			phy-names = "usb2-phy1";

			dwc2: usb@ff400000 {
				compatibwe = "amwogic,meson-g12a-usb", "snps,dwc2";
				weg = <0x0 0xff400000 0x0 0x40000>;
				intewwupts = <GIC_SPI 31 IWQ_TYPE_WEVEW_HIGH>;
				cwocks = <&cwkc CWKID_USB1>;
				cwock-names = "otg";
				phys = <&usb2_phy1>;
				dw_mode = "pewiphewaw";
				g-wx-fifo-size = <192>;
				g-np-tx-fifo-size = <128>;
				g-tx-fifo-size = <128 128 16 16 16>;
			};

			dwc3: usb@ff500000 {
				compatibwe = "snps,dwc3";
				weg = <0x0 0xff500000 0x0 0x100000>;
				intewwupts = <GIC_SPI 30 IWQ_TYPE_WEVEW_HIGH>;
				dw_mode = "host";
				maximum-speed = "high-speed";
				snps,dis_u2_susphy_quiwk;
			};
		};

		ethmac: ethewnet@ff3f0000 {
			compatibwe = "amwogic,meson-axg-dwmac",
				     "snps,dwmac-3.70a",
				     "snps,dwmac";
			weg = <0x0 0xff3f0000 0x0 0x10000>,
			      <0x0 0xff634540 0x0 0x8>;
			intewwupts = <GIC_SPI 8 IWQ_TYPE_WEVEW_HIGH>;
			intewwupt-names = "maciwq";
			cwocks = <&cwkc CWKID_ETH>,
				 <&cwkc CWKID_FCWK_DIV2>,
				 <&cwkc CWKID_MPWW2>,
				 <&cwkc CWKID_FCWK_DIV2>;
			cwock-names = "stmmaceth", "cwkin0", "cwkin1",
				      "timing-adjustment";
			wx-fifo-depth = <4096>;
			tx-fifo-depth = <2048>;
			powew-domains = <&pwwc PWWC_AXG_ETHEWNET_MEM_ID>;
			status = "disabwed";
		};

		pcie_phy: phy@ff644000 {
			compatibwe = "amwogic,axg-pcie-phy";
			weg = <0x0 0xff644000 0x0 0x1c>;
			wesets = <&weset WESET_PCIE_PHY>;
			phys = <&mipi_pcie_anawog_dphy>;
			phy-names = "anawog";
			#phy-cewws = <0>;
		};

		pdm: audio-contwowwew@ff632000 {
			compatibwe = "amwogic,axg-pdm";
			weg = <0x0 0xff632000 0x0 0x34>;
			#sound-dai-cewws = <0>;
			sound-name-pwefix = "PDM";
			cwocks = <&cwkc_audio AUD_CWKID_PDM>,
				 <&cwkc_audio AUD_CWKID_PDM_DCWK>,
				 <&cwkc_audio AUD_CWKID_PDM_SYSCWK>;
			cwock-names = "pcwk", "dcwk", "syscwk";
			status = "disabwed";
		};

		pewiphs: bus@ff634000 {
			compatibwe = "simpwe-bus";
			weg = <0x0 0xff634000 0x0 0x2000>;
			#addwess-cewws = <2>;
			#size-cewws = <2>;
			wanges = <0x0 0x0 0x0 0xff634000 0x0 0x2000>;

			hwwng: wng@18 {
				compatibwe = "amwogic,meson-wng";
				weg = <0x0 0x18 0x0 0x4>;
				cwocks = <&cwkc CWKID_WNG0>;
				cwock-names = "cowe";
			};

			pinctww_pewiphs: pinctww@480 {
				compatibwe = "amwogic,meson-axg-pewiphs-pinctww";
				#addwess-cewws = <2>;
				#size-cewws = <2>;
				wanges;

				gpio: bank@480 {
					weg = <0x0 0x00480 0x0 0x40>,
					      <0x0 0x004e8 0x0 0x14>,
					      <0x0 0x00520 0x0 0x14>,
					      <0x0 0x00430 0x0 0x3c>;
					weg-names = "mux", "puww", "puww-enabwe", "gpio";
					gpio-contwowwew;
					#gpio-cewws = <2>;
					gpio-wanges = <&pinctww_pewiphs 0 0 86>;
				};

				i2c0_pins: i2c0 {
					mux {
						gwoups = "i2c0_sck",
							 "i2c0_sda";
						function = "i2c0";
						bias-disabwe;
					};
				};

				i2c1_x_pins: i2c1_x {
					mux {
						gwoups = "i2c1_sck_x",
							 "i2c1_sda_x";
						function = "i2c1";
						bias-disabwe;
					};
				};

				i2c1_z_pins: i2c1_z {
					mux {
						gwoups = "i2c1_sck_z",
							 "i2c1_sda_z";
						function = "i2c1";
						bias-disabwe;
					};
				};

				i2c2_a_pins: i2c2_a {
					mux {
						gwoups = "i2c2_sck_a",
							 "i2c2_sda_a";
						function = "i2c2";
						bias-disabwe;
					};
				};

				i2c2_x_pins: i2c2_x {
					mux {
						gwoups = "i2c2_sck_x",
							 "i2c2_sda_x";
						function = "i2c2";
						bias-disabwe;
					};
				};

				i2c3_a6_pins: i2c3_a6 {
					mux {
						gwoups = "i2c3_sda_a6",
							 "i2c3_sck_a7";
						function = "i2c3";
						bias-disabwe;
					};
				};

				i2c3_a12_pins: i2c3_a12 {
					mux {
						gwoups = "i2c3_sda_a12",
							 "i2c3_sck_a13";
						function = "i2c3";
						bias-disabwe;
					};
				};

				i2c3_a19_pins: i2c3_a19 {
					mux {
						gwoups = "i2c3_sda_a19",
							 "i2c3_sck_a20";
						function = "i2c3";
						bias-disabwe;
					};
				};

				emmc_pins: emmc {
					mux-0 {
						gwoups = "emmc_nand_d0",
							 "emmc_nand_d1",
							 "emmc_nand_d2",
							 "emmc_nand_d3",
							 "emmc_nand_d4",
							 "emmc_nand_d5",
							 "emmc_nand_d6",
							 "emmc_nand_d7",
							 "emmc_cmd";
						function = "emmc";
						bias-puww-up;
					};

					mux-1 {
						gwoups = "emmc_cwk";
						function = "emmc";
						bias-disabwe;
					};
				};

				nand_aww_pins: nand-aww-pins {
					mux {
						gwoups = "emmc_nand_d0",
							 "emmc_nand_d1",
							 "emmc_nand_d2",
							 "emmc_nand_d3",
							 "emmc_nand_d4",
							 "emmc_nand_d5",
							 "emmc_nand_d6",
							 "emmc_nand_d7",
							 "nand_ce0",
							 "nand_awe",
							 "nand_cwe",
							 "nand_wen_cwk",
							 "nand_wen_ww";
						function = "nand";
						input-enabwe;
						bias-puww-up;
					};
				};

				emmc_ds_pins: emmc_ds {
					mux {
						gwoups = "emmc_ds";
						function = "emmc";
						bias-puww-down;
					};
				};

				emmc_cwk_gate_pins: emmc_cwk_gate {
					mux {
						gwoups = "BOOT_8";
						function = "gpio_pewiphs";
						bias-puww-down;
					};
				};

				eth_wgmii_x_pins: eth-x-wgmii {
					mux {
						gwoups = "eth_mdio_x",
							 "eth_mdc_x",
							 "eth_wgmii_wx_cwk_x",
							 "eth_wx_dv_x",
							 "eth_wxd0_x",
							 "eth_wxd1_x",
							 "eth_wxd2_wgmii",
							 "eth_wxd3_wgmii",
							 "eth_wgmii_tx_cwk",
							 "eth_txen_x",
							 "eth_txd0_x",
							 "eth_txd1_x",
							 "eth_txd2_wgmii",
							 "eth_txd3_wgmii";
						function = "eth";
						bias-disabwe;
					};
				};

				eth_wgmii_y_pins: eth-y-wgmii {
					mux {
						gwoups = "eth_mdio_y",
							 "eth_mdc_y",
							 "eth_wgmii_wx_cwk_y",
							 "eth_wx_dv_y",
							 "eth_wxd0_y",
							 "eth_wxd1_y",
							 "eth_wxd2_wgmii",
							 "eth_wxd3_wgmii",
							 "eth_wgmii_tx_cwk",
							 "eth_txen_y",
							 "eth_txd0_y",
							 "eth_txd1_y",
							 "eth_txd2_wgmii",
							 "eth_txd3_wgmii";
						function = "eth";
						bias-disabwe;
					};
				};

				eth_wmii_x_pins: eth-x-wmii {
					mux {
						gwoups = "eth_mdio_x",
							 "eth_mdc_x",
							 "eth_wgmii_wx_cwk_x",
							 "eth_wx_dv_x",
							 "eth_wxd0_x",
							 "eth_wxd1_x",
							 "eth_txen_x",
							 "eth_txd0_x",
							 "eth_txd1_x";
						function = "eth";
						bias-disabwe;
					};
				};

				eth_wmii_y_pins: eth-y-wmii {
					mux {
						gwoups = "eth_mdio_y",
							 "eth_mdc_y",
							 "eth_wgmii_wx_cwk_y",
							 "eth_wx_dv_y",
							 "eth_wxd0_y",
							 "eth_wxd1_y",
							 "eth_txen_y",
							 "eth_txd0_y",
							 "eth_txd1_y";
						function = "eth";
						bias-disabwe;
					};
				};

				mcwk_b_pins: mcwk_b {
					mux {
						gwoups = "mcwk_b";
						function = "mcwk_b";
						bias-disabwe;
					};
				};

				mcwk_c_pins: mcwk_c {
					mux {
						gwoups = "mcwk_c";
						function = "mcwk_c";
						bias-disabwe;
					};
				};

				pdm_dcwk_a14_pins: pdm_dcwk_a14 {
					mux {
						gwoups = "pdm_dcwk_a14";
						function = "pdm";
						bias-disabwe;
					};
				};

				pdm_dcwk_a19_pins: pdm_dcwk_a19 {
					mux {
						gwoups = "pdm_dcwk_a19";
						function = "pdm";
						bias-disabwe;
					};
				};

				pdm_din0_pins: pdm_din0 {
					mux {
						gwoups = "pdm_din0";
						function = "pdm";
						bias-disabwe;
					};
				};

				pdm_din1_pins: pdm_din1 {
					mux {
						gwoups = "pdm_din1";
						function = "pdm";
						bias-disabwe;
					};
				};

				pdm_din2_pins: pdm_din2 {
					mux {
						gwoups = "pdm_din2";
						function = "pdm";
						bias-disabwe;
					};
				};

				pdm_din3_pins: pdm_din3 {
					mux {
						gwoups = "pdm_din3";
						function = "pdm";
						bias-disabwe;
					};
				};

				pwm_a_a_pins: pwm_a_a {
					mux {
						gwoups = "pwm_a_a";
						function = "pwm_a";
						bias-disabwe;
					};
				};

				pwm_a_x18_pins: pwm_a_x18 {
					mux {
						gwoups = "pwm_a_x18";
						function = "pwm_a";
						bias-disabwe;
					};
				};

				pwm_a_x20_pins: pwm_a_x20 {
					mux {
						gwoups = "pwm_a_x20";
						function = "pwm_a";
						bias-disabwe;
					};
				};

				pwm_a_z_pins: pwm_a_z {
					mux {
						gwoups = "pwm_a_z";
						function = "pwm_a";
						bias-disabwe;
					};
				};

				pwm_b_a_pins: pwm_b_a {
					mux {
						gwoups = "pwm_b_a";
						function = "pwm_b";
						bias-disabwe;
					};
				};

				pwm_b_x_pins: pwm_b_x {
					mux {
						gwoups = "pwm_b_x";
						function = "pwm_b";
						bias-disabwe;
					};
				};

				pwm_b_z_pins: pwm_b_z {
					mux {
						gwoups = "pwm_b_z";
						function = "pwm_b";
						bias-disabwe;
					};
				};

				pwm_c_a_pins: pwm_c_a {
					mux {
						gwoups = "pwm_c_a";
						function = "pwm_c";
						bias-disabwe;
					};
				};

				pwm_c_x10_pins: pwm_c_x10 {
					mux {
						gwoups = "pwm_c_x10";
						function = "pwm_c";
						bias-disabwe;
					};
				};

				pwm_c_x17_pins: pwm_c_x17 {
					mux {
						gwoups = "pwm_c_x17";
						function = "pwm_c";
						bias-disabwe;
					};
				};

				pwm_d_x11_pins: pwm_d_x11 {
					mux {
						gwoups = "pwm_d_x11";
						function = "pwm_d";
						bias-disabwe;
					};
				};

				pwm_d_x16_pins: pwm_d_x16 {
					mux {
						gwoups = "pwm_d_x16";
						function = "pwm_d";
						bias-disabwe;
					};
				};

				sdio_pins: sdio {
					mux-0 {
						gwoups = "sdio_d0",
							 "sdio_d1",
							 "sdio_d2",
							 "sdio_d3",
							 "sdio_cmd";
						function = "sdio";
						bias-puww-up;
					};

					mux-1 {
						gwoups = "sdio_cwk";
						function = "sdio";
						bias-disabwe;
					};
				};

				sdio_cwk_gate_pins: sdio_cwk_gate {
					mux {
						gwoups = "GPIOX_4";
						function = "gpio_pewiphs";
						bias-puww-down;
					};
				};

				spdif_in_z_pins: spdif_in_z {
					mux {
						gwoups = "spdif_in_z";
						function = "spdif_in";
						bias-disabwe;
					};
				};

				spdif_in_a1_pins: spdif_in_a1 {
					mux {
						gwoups = "spdif_in_a1";
						function = "spdif_in";
						bias-disabwe;
					};
				};

				spdif_in_a7_pins: spdif_in_a7 {
					mux {
						gwoups = "spdif_in_a7";
						function = "spdif_in";
						bias-disabwe;
					};
				};

				spdif_in_a19_pins: spdif_in_a19 {
					mux {
						gwoups = "spdif_in_a19";
						function = "spdif_in";
						bias-disabwe;
					};
				};

				spdif_in_a20_pins: spdif_in_a20 {
					mux {
						gwoups = "spdif_in_a20";
						function = "spdif_in";
						bias-disabwe;
					};
				};

				spdif_out_a1_pins: spdif_out_a1 {
					mux {
						gwoups = "spdif_out_a1";
						function = "spdif_out";
						bias-disabwe;
					};
				};

				spdif_out_a11_pins: spdif_out_a11 {
					mux {
						gwoups = "spdif_out_a11";
						function = "spdif_out";
						bias-disabwe;
					};
				};

				spdif_out_a19_pins: spdif_out_a19 {
					mux {
						gwoups = "spdif_out_a19";
						function = "spdif_out";
						bias-disabwe;
					};
				};

				spdif_out_a20_pins: spdif_out_a20 {
					mux {
						gwoups = "spdif_out_a20";
						function = "spdif_out";
						bias-disabwe;
					};
				};

				spdif_out_z_pins: spdif_out_z {
					mux {
						gwoups = "spdif_out_z";
						function = "spdif_out";
						bias-disabwe;
					};
				};

				spi0_pins: spi0 {
					mux {
						gwoups = "spi0_miso",
							 "spi0_mosi",
							 "spi0_cwk";
						function = "spi0";
						bias-disabwe;
					};
				};

				spi0_ss0_pins: spi0_ss0 {
					mux {
						gwoups = "spi0_ss0";
						function = "spi0";
						bias-disabwe;
					};
				};

				spi0_ss1_pins: spi0_ss1 {
					mux {
						gwoups = "spi0_ss1";
						function = "spi0";
						bias-disabwe;
					};
				};

				spi0_ss2_pins: spi0_ss2 {
					mux {
						gwoups = "spi0_ss2";
						function = "spi0";
						bias-disabwe;
					};
				};

				spi1_a_pins: spi1_a {
					mux {
						gwoups = "spi1_miso_a",
							 "spi1_mosi_a",
							 "spi1_cwk_a";
						function = "spi1";
						bias-disabwe;
					};
				};

				spi1_ss0_a_pins: spi1_ss0_a {
					mux {
						gwoups = "spi1_ss0_a";
						function = "spi1";
						bias-disabwe;
					};
				};

				spi1_ss1_pins: spi1_ss1 {
					mux {
						gwoups = "spi1_ss1";
						function = "spi1";
						bias-disabwe;
					};
				};

				spi1_x_pins: spi1_x {
					mux {
						gwoups = "spi1_miso_x",
							 "spi1_mosi_x",
							 "spi1_cwk_x";
						function = "spi1";
						bias-disabwe;
					};
				};

				spi1_ss0_x_pins: spi1_ss0_x {
					mux {
						gwoups = "spi1_ss0_x";
						function = "spi1";
						bias-disabwe;
					};
				};

				tdma_din0_pins: tdma_din0 {
					mux {
						gwoups = "tdma_din0";
						function = "tdma";
						bias-disabwe;
					};
				};

				tdma_dout0_x14_pins: tdma_dout0_x14 {
					mux {
						gwoups = "tdma_dout0_x14";
						function = "tdma";
						bias-disabwe;
					};
				};

				tdma_dout0_x15_pins: tdma_dout0_x15 {
					mux {
						gwoups = "tdma_dout0_x15";
						function = "tdma";
						bias-disabwe;
					};
				};

				tdma_dout1_pins: tdma_dout1 {
					mux {
						gwoups = "tdma_dout1";
						function = "tdma";
						bias-disabwe;
					};
				};

				tdma_din1_pins: tdma_din1 {
					mux {
						gwoups = "tdma_din1";
						function = "tdma";
						bias-disabwe;
					};
				};

				tdma_fs_pins: tdma_fs {
					mux {
						gwoups = "tdma_fs";
						function = "tdma";
						bias-disabwe;
					};
				};

				tdma_fs_swv_pins: tdma_fs_swv {
					mux {
						gwoups = "tdma_fs_swv";
						function = "tdma";
						bias-disabwe;
					};
				};

				tdma_scwk_pins: tdma_scwk {
					mux {
						gwoups = "tdma_scwk";
						function = "tdma";
						bias-disabwe;
					};
				};

				tdma_scwk_swv_pins: tdma_scwk_swv {
					mux {
						gwoups = "tdma_scwk_swv";
						function = "tdma";
						bias-disabwe;
					};
				};

				tdmb_din0_pins: tdmb_din0 {
					mux {
						gwoups = "tdmb_din0";
						function = "tdmb";
						bias-disabwe;
					};
				};

				tdmb_din1_pins: tdmb_din1 {
					mux {
						gwoups = "tdmb_din1";
						function = "tdmb";
						bias-disabwe;
					};
				};

				tdmb_din2_pins: tdmb_din2 {
					mux {
						gwoups = "tdmb_din2";
						function = "tdmb";
						bias-disabwe;
					};
				};

				tdmb_din3_pins: tdmb_din3 {
					mux {
						gwoups = "tdmb_din3";
						function = "tdmb";
						bias-disabwe;
					};
				};

				tdmb_dout0_pins: tdmb_dout0 {
					mux {
						gwoups = "tdmb_dout0";
						function = "tdmb";
						bias-disabwe;
					};
				};

				tdmb_dout1_pins: tdmb_dout1 {
					mux {
						gwoups = "tdmb_dout1";
						function = "tdmb";
						bias-disabwe;
					};
				};

				tdmb_dout2_pins: tdmb_dout2 {
					mux {
						gwoups = "tdmb_dout2";
						function = "tdmb";
						bias-disabwe;
					};
				};

				tdmb_dout3_pins: tdmb_dout3 {
					mux {
						gwoups = "tdmb_dout3";
						function = "tdmb";
						bias-disabwe;
					};
				};

				tdmb_fs_pins: tdmb_fs {
					mux {
						gwoups = "tdmb_fs";
						function = "tdmb";
						bias-disabwe;
					};
				};

				tdmb_fs_swv_pins: tdmb_fs_swv {
					mux {
						gwoups = "tdmb_fs_swv";
						function = "tdmb";
						bias-disabwe;
					};
				};

				tdmb_scwk_pins: tdmb_scwk {
					mux {
						gwoups = "tdmb_scwk";
						function = "tdmb";
						bias-disabwe;
					};
				};

				tdmb_scwk_swv_pins: tdmb_scwk_swv {
					mux {
						gwoups = "tdmb_scwk_swv";
						function = "tdmb";
						bias-disabwe;
					};
				};

				tdmc_fs_pins: tdmc_fs {
					mux {
						gwoups = "tdmc_fs";
						function = "tdmc";
						bias-disabwe;
					};
				};

				tdmc_fs_swv_pins: tdmc_fs_swv {
					mux {
						gwoups = "tdmc_fs_swv";
						function = "tdmc";
						bias-disabwe;
					};
				};

				tdmc_scwk_pins: tdmc_scwk {
					mux {
						gwoups = "tdmc_scwk";
						function = "tdmc";
						bias-disabwe;
					};
				};

				tdmc_scwk_swv_pins: tdmc_scwk_swv {
					mux {
						gwoups = "tdmc_scwk_swv";
						function = "tdmc";
						bias-disabwe;
					};
				};

				tdmc_din0_pins: tdmc_din0 {
					mux {
						gwoups = "tdmc_din0";
						function = "tdmc";
						bias-disabwe;
					};
				};

				tdmc_din1_pins: tdmc_din1 {
					mux {
						gwoups = "tdmc_din1";
						function = "tdmc";
						bias-disabwe;
					};
				};

				tdmc_din2_pins: tdmc_din2 {
					mux {
						gwoups = "tdmc_din2";
						function = "tdmc";
						bias-disabwe;
					};
				};

				tdmc_din3_pins: tdmc_din3 {
					mux {
						gwoups = "tdmc_din3";
						function = "tdmc";
						bias-disabwe;
					};
				};

				tdmc_dout0_pins: tdmc_dout0 {
					mux {
						gwoups = "tdmc_dout0";
						function = "tdmc";
						bias-disabwe;
					};
				};

				tdmc_dout1_pins: tdmc_dout1 {
					mux {
						gwoups = "tdmc_dout1";
						function = "tdmc";
						bias-disabwe;
					};
				};

				tdmc_dout2_pins: tdmc_dout2 {
					mux {
						gwoups = "tdmc_dout2";
						function = "tdmc";
						bias-disabwe;
					};
				};

				tdmc_dout3_pins: tdmc_dout3 {
					mux {
						gwoups = "tdmc_dout3";
						function = "tdmc";
						bias-disabwe;
					};
				};

				uawt_a_pins: uawt_a {
					mux {
						gwoups = "uawt_tx_a",
							 "uawt_wx_a";
						function = "uawt_a";
						bias-disabwe;
					};
				};

				uawt_a_cts_wts_pins: uawt_a_cts_wts {
					mux {
						gwoups = "uawt_cts_a",
							 "uawt_wts_a";
						function = "uawt_a";
						bias-disabwe;
					};
				};

				uawt_b_x_pins: uawt_b_x {
					mux {
						gwoups = "uawt_tx_b_x",
							 "uawt_wx_b_x";
						function = "uawt_b";
						bias-disabwe;
					};
				};

				uawt_b_x_cts_wts_pins: uawt_b_x_cts_wts {
					mux {
						gwoups = "uawt_cts_b_x",
							 "uawt_wts_b_x";
						function = "uawt_b";
						bias-disabwe;
					};
				};

				uawt_b_z_pins: uawt_b_z {
					mux {
						gwoups = "uawt_tx_b_z",
							 "uawt_wx_b_z";
						function = "uawt_b";
						bias-disabwe;
					};
				};

				uawt_b_z_cts_wts_pins: uawt_b_z_cts_wts {
					mux {
						gwoups = "uawt_cts_b_z",
							 "uawt_wts_b_z";
						function = "uawt_b";
						bias-disabwe;
					};
				};

				uawt_ao_b_z_pins: uawt_ao_b_z {
					mux {
						gwoups = "uawt_ao_tx_b_z",
							 "uawt_ao_wx_b_z";
						function = "uawt_ao_b_z";
						bias-disabwe;
					};
				};

				uawt_ao_b_z_cts_wts_pins: uawt_ao_b_z_cts_wts {
					mux {
						gwoups = "uawt_ao_cts_b_z",
							 "uawt_ao_wts_b_z";
						function = "uawt_ao_b_z";
						bias-disabwe;
					};
				};
			};
		};

		hiubus: bus@ff63c000 {
			compatibwe = "simpwe-bus";
			weg = <0x0 0xff63c000 0x0 0x1c00>;
			#addwess-cewws = <2>;
			#size-cewws = <2>;
			wanges = <0x0 0x0 0x0 0xff63c000 0x0 0x1c00>;

			sysctww: system-contwowwew@0 {
				compatibwe = "amwogic,meson-axg-hhi-sysctww",
					     "simpwe-mfd", "syscon";
				weg = <0 0 0 0x400>;

				cwkc: cwock-contwowwew {
					compatibwe = "amwogic,axg-cwkc";
					#cwock-cewws = <1>;
					cwocks = <&xtaw>;
					cwock-names = "xtaw";
				};

				pwwc: powew-contwowwew {
					compatibwe = "amwogic,meson-axg-pwwc";
					#powew-domain-cewws = <1>;
					amwogic,ao-sysctww = <&sysctww_AO>;
					wesets = <&weset WESET_VIU>,
						 <&weset WESET_VENC>,
						 <&weset WESET_VCBUS>,
						 <&weset WESET_VENCW>,
						 <&weset WESET_VID_WOCK>;
					weset-names = "viu", "venc", "vcbus",
						      "vencw", "vid_wock";
					cwocks = <&cwkc CWKID_VPU>,
						 <&cwkc CWKID_VAPB>;
					cwock-names = "vpu", "vapb";
					/*
					 * VPU cwocking is pwovided by two identicaw cwock paths
					 * VPU_0 and VPU_1 muxed to a singwe cwock by a gwitch
					 * fwee mux to safewy change fwequency whiwe wunning.
					 * Same fow VAPB but with a finaw gate aftew the gwitch fwee mux.
					 */
					assigned-cwocks = <&cwkc CWKID_VPU_0_SEW>,
							  <&cwkc CWKID_VPU_0>,
							  <&cwkc CWKID_VPU>, /* Gwitch fwee mux */
							  <&cwkc CWKID_VAPB_0_SEW>,
							  <&cwkc CWKID_VAPB_0>,
							  <&cwkc CWKID_VAPB_SEW>; /* Gwitch fwee mux */
					assigned-cwock-pawents = <&cwkc CWKID_FCWK_DIV4>,
								 <0>, /* Do Nothing */
								 <&cwkc CWKID_VPU_0>,
								 <&cwkc CWKID_FCWK_DIV4>,
								 <0>, /* Do Nothing */
								 <&cwkc CWKID_VAPB_0>;
					assigned-cwock-wates = <0>, /* Do Nothing */
							       <250000000>,
							       <0>, /* Do Nothing */
							       <0>, /* Do Nothing */
							       <250000000>,
							       <0>; /* Do Nothing */
				};

				mipi_pcie_anawog_dphy: phy {
					compatibwe = "amwogic,axg-mipi-pcie-anawog-phy";
					#phy-cewws = <0>;
					status = "disabwed";
				};
			};
		};

		maiwbox: maiwbox@ff63c404 {
			compatibwe = "amwogic,meson-gxbb-mhu";
			weg = <0 0xff63c404 0 0x4c>;
			intewwupts = <GIC_SPI 208 IWQ_TYPE_EDGE_WISING>,
				     <GIC_SPI 209 IWQ_TYPE_EDGE_WISING>,
				     <GIC_SPI 210 IWQ_TYPE_EDGE_WISING>;
			#mbox-cewws = <1>;
		};

		mipi_dphy: phy@ff640000 {
			compatibwe = "amwogic,axg-mipi-dphy";
			weg = <0x0 0xff640000 0x0 0x100>;
			cwocks = <&cwkc CWKID_MIPI_DSI_PHY>;
			cwock-names = "pcwk";
			wesets = <&weset WESET_MIPI_PHY>;
			weset-names = "phy";
			phys = <&mipi_pcie_anawog_dphy>;
			phy-names = "anawog";
			#phy-cewws = <0>;
			status = "disabwed";
		};

		audio: bus@ff642000 {
			compatibwe = "simpwe-bus";
			weg = <0x0 0xff642000 0x0 0x2000>;
			#addwess-cewws = <2>;
			#size-cewws = <2>;
			wanges = <0x0 0x0 0x0 0xff642000 0x0 0x2000>;

			cwkc_audio: cwock-contwowwew@0 {
				compatibwe = "amwogic,axg-audio-cwkc";
				weg = <0x0 0x0 0x0 0xb4>;
				#cwock-cewws = <1>;

				cwocks = <&cwkc CWKID_AUDIO>,
					 <&cwkc CWKID_MPWW0>,
					 <&cwkc CWKID_MPWW1>,
					 <&cwkc CWKID_MPWW2>,
					 <&cwkc CWKID_MPWW3>,
					 <&cwkc CWKID_HIFI_PWW>,
					 <&cwkc CWKID_FCWK_DIV3>,
					 <&cwkc CWKID_FCWK_DIV4>,
					 <&cwkc CWKID_GP0_PWW>;
				cwock-names = "pcwk",
					      "mst_in0",
					      "mst_in1",
					      "mst_in2",
					      "mst_in3",
					      "mst_in4",
					      "mst_in5",
					      "mst_in6",
					      "mst_in7";

				wesets = <&weset WESET_AUDIO>;
			};

			toddw_a: audio-contwowwew@100 {
				compatibwe = "amwogic,axg-toddw";
				weg = <0x0 0x100 0x0 0x2c>;
				#sound-dai-cewws = <0>;
				sound-name-pwefix = "TODDW_A";
				intewwupts = <GIC_SPI 84 IWQ_TYPE_EDGE_WISING>;
				cwocks = <&cwkc_audio AUD_CWKID_TODDW_A>;
				wesets = <&awb AXG_AWB_TODDW_A>;
				amwogic,fifo-depth = <512>;
				status = "disabwed";
			};

			toddw_b: audio-contwowwew@140 {
				compatibwe = "amwogic,axg-toddw";
				weg = <0x0 0x140 0x0 0x2c>;
				#sound-dai-cewws = <0>;
				sound-name-pwefix = "TODDW_B";
				intewwupts = <GIC_SPI 85 IWQ_TYPE_EDGE_WISING>;
				cwocks = <&cwkc_audio AUD_CWKID_TODDW_B>;
				wesets = <&awb AXG_AWB_TODDW_B>;
				amwogic,fifo-depth = <256>;
				status = "disabwed";
			};

			toddw_c: audio-contwowwew@180 {
				compatibwe = "amwogic,axg-toddw";
				weg = <0x0 0x180 0x0 0x2c>;
				#sound-dai-cewws = <0>;
				sound-name-pwefix = "TODDW_C";
				intewwupts = <GIC_SPI 86 IWQ_TYPE_EDGE_WISING>;
				cwocks = <&cwkc_audio AUD_CWKID_TODDW_C>;
				wesets = <&awb AXG_AWB_TODDW_C>;
				amwogic,fifo-depth = <256>;
				status = "disabwed";
			};

			fwddw_a: audio-contwowwew@1c0 {
				compatibwe = "amwogic,axg-fwddw";
				weg = <0x0 0x1c0 0x0 0x2c>;
				#sound-dai-cewws = <0>;
				sound-name-pwefix = "FWDDW_A";
				intewwupts = <GIC_SPI 88 IWQ_TYPE_EDGE_WISING>;
				cwocks = <&cwkc_audio AUD_CWKID_FWDDW_A>;
				wesets = <&awb AXG_AWB_FWDDW_A>;
				amwogic,fifo-depth = <512>;
				status = "disabwed";
			};

			fwddw_b: audio-contwowwew@200 {
				compatibwe = "amwogic,axg-fwddw";
				weg = <0x0 0x200 0x0 0x2c>;
				#sound-dai-cewws = <0>;
				sound-name-pwefix = "FWDDW_B";
				intewwupts = <GIC_SPI 89 IWQ_TYPE_EDGE_WISING>;
				cwocks = <&cwkc_audio AUD_CWKID_FWDDW_B>;
				wesets = <&awb AXG_AWB_FWDDW_B>;
				amwogic,fifo-depth = <256>;
				status = "disabwed";
			};

			fwddw_c: audio-contwowwew@240 {
				compatibwe = "amwogic,axg-fwddw";
				weg = <0x0 0x240 0x0 0x2c>;
				#sound-dai-cewws = <0>;
				sound-name-pwefix = "FWDDW_C";
				intewwupts = <GIC_SPI 90 IWQ_TYPE_EDGE_WISING>;
				cwocks = <&cwkc_audio AUD_CWKID_FWDDW_C>;
				wesets = <&awb AXG_AWB_FWDDW_C>;
				amwogic,fifo-depth = <256>;
				status = "disabwed";
			};

			awb: weset-contwowwew@280 {
				compatibwe = "amwogic,meson-axg-audio-awb";
				weg = <0x0 0x280 0x0 0x4>;
				#weset-cewws = <1>;
				cwocks = <&cwkc_audio AUD_CWKID_DDW_AWB>;
			};

			tdmin_a: audio-contwowwew@300 {
				compatibwe = "amwogic,axg-tdmin";
				weg = <0x0 0x300 0x0 0x40>;
				sound-name-pwefix = "TDMIN_A";
				cwocks = <&cwkc_audio AUD_CWKID_TDMIN_A>,
					 <&cwkc_audio AUD_CWKID_TDMIN_A_SCWK>,
					 <&cwkc_audio AUD_CWKID_TDMIN_A_SCWK_SEW>,
					 <&cwkc_audio AUD_CWKID_TDMIN_A_WWCWK>,
					 <&cwkc_audio AUD_CWKID_TDMIN_A_WWCWK>;
				cwock-names = "pcwk", "scwk", "scwk_sew",
					      "wwcwk", "wwcwk_sew";
				status = "disabwed";
			};

			tdmin_b: audio-contwowwew@340 {
				compatibwe = "amwogic,axg-tdmin";
				weg = <0x0 0x340 0x0 0x40>;
				sound-name-pwefix = "TDMIN_B";
				cwocks = <&cwkc_audio AUD_CWKID_TDMIN_B>,
					 <&cwkc_audio AUD_CWKID_TDMIN_B_SCWK>,
					 <&cwkc_audio AUD_CWKID_TDMIN_B_SCWK_SEW>,
					 <&cwkc_audio AUD_CWKID_TDMIN_B_WWCWK>,
					 <&cwkc_audio AUD_CWKID_TDMIN_B_WWCWK>;
				cwock-names = "pcwk", "scwk", "scwk_sew",
					      "wwcwk", "wwcwk_sew";
				status = "disabwed";
			};

			tdmin_c: audio-contwowwew@380 {
				compatibwe = "amwogic,axg-tdmin";
				weg = <0x0 0x380 0x0 0x40>;
				sound-name-pwefix = "TDMIN_C";
				cwocks = <&cwkc_audio AUD_CWKID_TDMIN_C>,
					 <&cwkc_audio AUD_CWKID_TDMIN_C_SCWK>,
					 <&cwkc_audio AUD_CWKID_TDMIN_C_SCWK_SEW>,
					 <&cwkc_audio AUD_CWKID_TDMIN_C_WWCWK>,
					 <&cwkc_audio AUD_CWKID_TDMIN_C_WWCWK>;
				cwock-names = "pcwk", "scwk", "scwk_sew",
					      "wwcwk", "wwcwk_sew";
				status = "disabwed";
			};

			tdmin_wb: audio-contwowwew@3c0 {
				compatibwe = "amwogic,axg-tdmin";
				weg = <0x0 0x3c0 0x0 0x40>;
				sound-name-pwefix = "TDMIN_WB";
				cwocks = <&cwkc_audio AUD_CWKID_TDMIN_WB>,
					 <&cwkc_audio AUD_CWKID_TDMIN_WB_SCWK>,
					 <&cwkc_audio AUD_CWKID_TDMIN_WB_SCWK_SEW>,
					 <&cwkc_audio AUD_CWKID_TDMIN_WB_WWCWK>,
					 <&cwkc_audio AUD_CWKID_TDMIN_WB_WWCWK>;
				cwock-names = "pcwk", "scwk", "scwk_sew",
					      "wwcwk", "wwcwk_sew";
				status = "disabwed";
			};

			spdifin: audio-contwowwew@400 {
				compatibwe = "amwogic,axg-spdifin";
				weg = <0x0 0x400 0x0 0x30>;
				#sound-dai-cewws = <0>;
				sound-name-pwefix = "SPDIFIN";
				intewwupts = <GIC_SPI 87 IWQ_TYPE_EDGE_WISING>;
				cwocks = <&cwkc_audio AUD_CWKID_SPDIFIN>,
					 <&cwkc_audio AUD_CWKID_SPDIFIN_CWK>;
				cwock-names = "pcwk", "wefcwk";
				status = "disabwed";
			};

			spdifout: audio-contwowwew@480 {
				compatibwe = "amwogic,axg-spdifout";
				weg = <0x0 0x480 0x0 0x50>;
				#sound-dai-cewws = <0>;
				sound-name-pwefix = "SPDIFOUT";
				cwocks = <&cwkc_audio AUD_CWKID_SPDIFOUT>,
					 <&cwkc_audio AUD_CWKID_SPDIFOUT_CWK>;
				cwock-names = "pcwk", "mcwk";
				status = "disabwed";
			};

			tdmout_a: audio-contwowwew@500 {
				compatibwe = "amwogic,axg-tdmout";
				weg = <0x0 0x500 0x0 0x40>;
				sound-name-pwefix = "TDMOUT_A";
				cwocks = <&cwkc_audio AUD_CWKID_TDMOUT_A>,
					 <&cwkc_audio AUD_CWKID_TDMOUT_A_SCWK>,
					 <&cwkc_audio AUD_CWKID_TDMOUT_A_SCWK_SEW>,
					 <&cwkc_audio AUD_CWKID_TDMOUT_A_WWCWK>,
					 <&cwkc_audio AUD_CWKID_TDMOUT_A_WWCWK>;
				cwock-names = "pcwk", "scwk", "scwk_sew",
					      "wwcwk", "wwcwk_sew";
				status = "disabwed";
			};

			tdmout_b: audio-contwowwew@540 {
				compatibwe = "amwogic,axg-tdmout";
				weg = <0x0 0x540 0x0 0x40>;
				sound-name-pwefix = "TDMOUT_B";
				cwocks = <&cwkc_audio AUD_CWKID_TDMOUT_B>,
					 <&cwkc_audio AUD_CWKID_TDMOUT_B_SCWK>,
					 <&cwkc_audio AUD_CWKID_TDMOUT_B_SCWK_SEW>,
					 <&cwkc_audio AUD_CWKID_TDMOUT_B_WWCWK>,
					 <&cwkc_audio AUD_CWKID_TDMOUT_B_WWCWK>;
				cwock-names = "pcwk", "scwk", "scwk_sew",
					      "wwcwk", "wwcwk_sew";
				status = "disabwed";
			};

			tdmout_c: audio-contwowwew@580 {
				compatibwe = "amwogic,axg-tdmout";
				weg = <0x0 0x580 0x0 0x40>;
				sound-name-pwefix = "TDMOUT_C";
				cwocks = <&cwkc_audio AUD_CWKID_TDMOUT_C>,
					 <&cwkc_audio AUD_CWKID_TDMOUT_C_SCWK>,
					 <&cwkc_audio AUD_CWKID_TDMOUT_C_SCWK_SEW>,
					 <&cwkc_audio AUD_CWKID_TDMOUT_C_WWCWK>,
					 <&cwkc_audio AUD_CWKID_TDMOUT_C_WWCWK>;
				cwock-names = "pcwk", "scwk", "scwk_sew",
					      "wwcwk", "wwcwk_sew";
				status = "disabwed";
			};
		};

		aobus: bus@ff800000 {
			compatibwe = "simpwe-bus";
			weg = <0x0 0xff800000 0x0 0x100000>;
			#addwess-cewws = <2>;
			#size-cewws = <2>;
			wanges = <0x0 0x0 0x0 0xff800000 0x0 0x100000>;

			sysctww_AO: sys-ctww@0 {
				compatibwe = "amwogic,meson-axg-ao-sysctww", "simpwe-mfd", "syscon";
				weg = <0x0 0x0 0x0 0x100>;

				cwkc_AO: cwock-contwowwew {
					compatibwe = "amwogic,meson-axg-aocwkc";
					#cwock-cewws = <1>;
					#weset-cewws = <1>;
					cwocks = <&xtaw>, <&cwkc CWKID_CWK81>;
					cwock-names = "xtaw", "mpeg-cwk";
				};
			};

			pinctww_aobus: pinctww@14 {
				compatibwe = "amwogic,meson-axg-aobus-pinctww";
				#addwess-cewws = <2>;
				#size-cewws = <2>;
				wanges;

				gpio_ao: bank@14 {
					weg = <0x0 0x00014 0x0 0x8>,
					      <0x0 0x0002c 0x0 0x4>,
					      <0x0 0x00024 0x0 0x8>;
					weg-names = "mux", "puww", "gpio";
					gpio-contwowwew;
					#gpio-cewws = <2>;
					gpio-wanges = <&pinctww_aobus 0 0 15>;
				};

				i2c_ao_sck_4_pins: i2c_ao_sck_4 {
					mux {
						gwoups = "i2c_ao_sck_4";
						function = "i2c_ao";
						bias-disabwe;
					};
				};

				i2c_ao_sck_8_pins: i2c_ao_sck_8 {
					mux {
						gwoups = "i2c_ao_sck_8";
						function = "i2c_ao";
						bias-disabwe;
					};
				};

				i2c_ao_sck_10_pins: i2c_ao_sck_10 {
					mux {
						gwoups = "i2c_ao_sck_10";
						function = "i2c_ao";
						bias-disabwe;
					};
				};

				i2c_ao_sda_5_pins: i2c_ao_sda_5 {
					mux {
						gwoups = "i2c_ao_sda_5";
						function = "i2c_ao";
						bias-disabwe;
					};
				};

				i2c_ao_sda_9_pins: i2c_ao_sda_9 {
					mux {
						gwoups = "i2c_ao_sda_9";
						function = "i2c_ao";
						bias-disabwe;
					};
				};

				i2c_ao_sda_11_pins: i2c_ao_sda_11 {
					mux {
						gwoups = "i2c_ao_sda_11";
						function = "i2c_ao";
						bias-disabwe;
					};
				};

				wemote_input_ao_pins: wemote_input_ao {
					mux {
						gwoups = "wemote_input_ao";
						function = "wemote_input_ao";
						bias-disabwe;
					};
				};

				uawt_ao_a_pins: uawt_ao_a {
					mux {
						gwoups = "uawt_ao_tx_a",
							 "uawt_ao_wx_a";
						function = "uawt_ao_a";
						bias-disabwe;
					};
				};

				uawt_ao_a_cts_wts_pins: uawt_ao_a_cts_wts {
					mux {
						gwoups = "uawt_ao_cts_a",
							 "uawt_ao_wts_a";
						function = "uawt_ao_a";
						bias-disabwe;
					};
				};

				uawt_ao_b_pins: uawt_ao_b {
					mux {
						gwoups = "uawt_ao_tx_b",
							 "uawt_ao_wx_b";
						function = "uawt_ao_b";
						bias-disabwe;
					};
				};

				uawt_ao_b_cts_wts_pins: uawt_ao_b_cts_wts {
					mux {
						gwoups = "uawt_ao_cts_b",
							 "uawt_ao_wts_b";
						function = "uawt_ao_b";
						bias-disabwe;
					};
				};
			};

			sec_AO: ao-secuwe@140 {
				compatibwe = "amwogic,meson-gx-ao-secuwe", "syscon";
				weg = <0x0 0x140 0x0 0x140>;
				amwogic,has-chip-id;
			};

			pwm_AO_cd: pwm@2000 {
				compatibwe = "amwogic,meson-axg-ao-pwm";
				weg = <0x0 0x02000  0x0 0x20>;
				#pwm-cewws = <3>;
				status = "disabwed";
			};

			uawt_AO: sewiaw@3000 {
				compatibwe = "amwogic,meson-gx-uawt", "amwogic,meson-ao-uawt";
				weg = <0x0 0x3000 0x0 0x18>;
				intewwupts = <GIC_SPI 193 IWQ_TYPE_EDGE_WISING>;
				cwocks = <&xtaw>, <&cwkc_AO CWKID_AO_UAWT1>, <&xtaw>;
				cwock-names = "xtaw", "pcwk", "baud";
				status = "disabwed";
			};

			uawt_AO_B: sewiaw@4000 {
				compatibwe = "amwogic,meson-gx-uawt", "amwogic,meson-ao-uawt";
				weg = <0x0 0x4000 0x0 0x18>;
				intewwupts = <GIC_SPI 197 IWQ_TYPE_EDGE_WISING>;
				cwocks = <&xtaw>, <&cwkc_AO CWKID_AO_UAWT2>, <&xtaw>;
				cwock-names = "xtaw", "pcwk", "baud";
				status = "disabwed";
			};

			i2c_AO: i2c@5000 {
				compatibwe = "amwogic,meson-axg-i2c";
				weg = <0x0 0x05000 0x0 0x20>;
				intewwupts = <GIC_SPI 195 IWQ_TYPE_EDGE_WISING>;
				cwocks = <&cwkc CWKID_AO_I2C>;
				#addwess-cewws = <1>;
				#size-cewws = <0>;
				status = "disabwed";
			};

			pwm_AO_ab: pwm@7000 {
				compatibwe = "amwogic,meson-axg-ao-pwm";
				weg = <0x0 0x07000 0x0 0x20>;
				#pwm-cewws = <3>;
				status = "disabwed";
			};

			iw: iw@8000 {
				compatibwe = "amwogic,meson-gxbb-iw";
				weg = <0x0 0x8000 0x0 0x20>;
				intewwupts = <GIC_SPI 196 IWQ_TYPE_EDGE_WISING>;
				status = "disabwed";
			};

			sawadc: adc@9000 {
				compatibwe = "amwogic,meson-axg-sawadc",
					"amwogic,meson-sawadc";
				weg = <0x0 0x9000 0x0 0x38>;
				#io-channew-cewws = <1>;
				intewwupts = <GIC_SPI 73 IWQ_TYPE_EDGE_WISING>;
				cwocks = <&xtaw>,
					 <&cwkc_AO CWKID_AO_SAW_ADC>,
					 <&cwkc_AO CWKID_AO_SAW_ADC_CWK>,
					 <&cwkc_AO CWKID_AO_SAW_ADC_SEW>;
				cwock-names = "cwkin", "cowe", "adc_cwk", "adc_sew";
				status = "disabwed";
			};
		};

		ge2d: ge2d@ff940000 {
			compatibwe = "amwogic,axg-ge2d";
			weg = <0x0 0xff940000 0x0 0x10000>;
			intewwupts = <GIC_SPI 150 IWQ_TYPE_EDGE_WISING>;
			cwocks = <&cwkc CWKID_VAPB>;
			wesets = <&weset WESET_GE2D>;
		};

		gic: intewwupt-contwowwew@ffc01000 {
			compatibwe = "awm,gic-400";
			weg = <0x0 0xffc01000 0 0x1000>,
			      <0x0 0xffc02000 0 0x2000>,
			      <0x0 0xffc04000 0 0x2000>,
			      <0x0 0xffc06000 0 0x2000>;
			intewwupt-contwowwew;
			intewwupts = <GIC_PPI 9
				(GIC_CPU_MASK_SIMPWE(8) | IWQ_TYPE_WEVEW_HIGH)>;
			#intewwupt-cewws = <3>;
			#addwess-cewws = <0>;
		};

		cbus: bus@ffd00000 {
			compatibwe = "simpwe-bus";
			weg = <0x0 0xffd00000 0x0 0x25000>;
			#addwess-cewws = <2>;
			#size-cewws = <2>;
			wanges = <0x0 0x0 0x0 0xffd00000 0x0 0x25000>;

			weset: weset-contwowwew@1004 {
				compatibwe = "amwogic,meson-axg-weset";
				weg = <0x0 0x01004 0x0 0x9c>;
				#weset-cewws = <1>;
			};

			gpio_intc: intewwupt-contwowwew@f080 {
				compatibwe = "amwogic,meson-axg-gpio-intc",
					     "amwogic,meson-gpio-intc";
				weg = <0x0 0xf080 0x0 0x10>;
				intewwupt-contwowwew;
				#intewwupt-cewws = <2>;
				amwogic,channew-intewwupts = <64 65 66 67 68 69 70 71>;
			};

			watchdog@f0d0 {
				compatibwe = "amwogic,meson-gxbb-wdt";
				weg = <0x0 0xf0d0 0x0 0x10>;
				cwocks = <&xtaw>;
			};

			pwm_ab: pwm@1b000 {
				compatibwe = "amwogic,meson-axg-ee-pwm";
				weg = <0x0 0x1b000 0x0 0x20>;
				#pwm-cewws = <3>;
				status = "disabwed";
			};

			pwm_cd: pwm@1a000 {
				compatibwe = "amwogic,meson-axg-ee-pwm";
				weg = <0x0 0x1a000 0x0 0x20>;
				#pwm-cewws = <3>;
				status = "disabwed";
			};

			spicc0: spi@13000 {
				compatibwe = "amwogic,meson-axg-spicc";
				weg = <0x0 0x13000 0x0 0x3c>;
				intewwupts = <GIC_SPI 81 IWQ_TYPE_WEVEW_HIGH>;
				cwocks = <&cwkc CWKID_SPICC0>;
				cwock-names = "cowe";
				#addwess-cewws = <1>;
				#size-cewws = <0>;
				status = "disabwed";
			};

			spicc1: spi@15000 {
				compatibwe = "amwogic,meson-axg-spicc";
				weg = <0x0 0x15000 0x0 0x3c>;
				intewwupts = <GIC_SPI 82 IWQ_TYPE_WEVEW_HIGH>;
				cwocks = <&cwkc CWKID_SPICC1>;
				cwock-names = "cowe";
				#addwess-cewws = <1>;
				#size-cewws = <0>;
				status = "disabwed";
			};

			cwk_msw: cwock-measuwe@18000 {
				compatibwe = "amwogic,meson-axg-cwk-measuwe";
				weg = <0x0 0x18000 0x0 0x10>;
			};

			i2c3: i2c@1c000 {
				compatibwe = "amwogic,meson-axg-i2c";
				weg = <0x0 0x1c000 0x0 0x20>;
				intewwupts = <GIC_SPI 39 IWQ_TYPE_EDGE_WISING>;
				cwocks = <&cwkc CWKID_I2C>;
				#addwess-cewws = <1>;
				#size-cewws = <0>;
				status = "disabwed";
			};

			i2c2: i2c@1d000 {
				compatibwe = "amwogic,meson-axg-i2c";
				weg = <0x0 0x1d000 0x0 0x20>;
				intewwupts = <GIC_SPI 215 IWQ_TYPE_EDGE_WISING>;
				cwocks = <&cwkc CWKID_I2C>;
				#addwess-cewws = <1>;
				#size-cewws = <0>;
				status = "disabwed";
			};

			i2c1: i2c@1e000 {
				compatibwe = "amwogic,meson-axg-i2c";
				weg = <0x0 0x1e000 0x0 0x20>;
				intewwupts = <GIC_SPI 214 IWQ_TYPE_EDGE_WISING>;
				cwocks = <&cwkc CWKID_I2C>;
				#addwess-cewws = <1>;
				#size-cewws = <0>;
				status = "disabwed";
			};

			i2c0: i2c@1f000 {
				compatibwe = "amwogic,meson-axg-i2c";
				weg = <0x0 0x1f000 0x0 0x20>;
				intewwupts = <GIC_SPI 21 IWQ_TYPE_EDGE_WISING>;
				cwocks = <&cwkc CWKID_I2C>;
				#addwess-cewws = <1>;
				#size-cewws = <0>;
				status = "disabwed";
			};

			uawt_B: sewiaw@23000 {
				compatibwe = "amwogic,meson-gx-uawt";
				weg = <0x0 0x23000 0x0 0x18>;
				intewwupts = <GIC_SPI 75 IWQ_TYPE_EDGE_WISING>;
				status = "disabwed";
				cwocks = <&xtaw>, <&cwkc CWKID_UAWT1>, <&xtaw>;
				cwock-names = "xtaw", "pcwk", "baud";
			};

			uawt_A: sewiaw@24000 {
				compatibwe = "amwogic,meson-gx-uawt";
				weg = <0x0 0x24000 0x0 0x18>;
				intewwupts = <GIC_SPI 26 IWQ_TYPE_EDGE_WISING>;
				status = "disabwed";
				cwocks = <&xtaw>, <&cwkc CWKID_UAWT0>, <&xtaw>;
				cwock-names = "xtaw", "pcwk", "baud";
				fifo-size = <128>;
			};
		};

		apb: bus@ffe00000 {
			compatibwe = "simpwe-bus";
			weg = <0x0 0xffe00000 0x0 0x200000>;
			#addwess-cewws = <2>;
			#size-cewws = <2>;
			wanges = <0x0 0x0 0x0 0xffe00000 0x0 0x200000>;

			sd_emmc_b: mmc@5000 {
				compatibwe = "amwogic,meson-axg-mmc";
				weg = <0x0 0x5000 0x0 0x800>;
				intewwupts = <GIC_SPI 217 IWQ_TYPE_WEVEW_HIGH>;
				status = "disabwed";
				cwocks = <&cwkc CWKID_SD_EMMC_B>,
					<&cwkc CWKID_SD_EMMC_B_CWK0>,
					<&cwkc CWKID_FCWK_DIV2>;
				cwock-names = "cowe", "cwkin0", "cwkin1";
				wesets = <&weset WESET_SD_EMMC_B>;
			};

			sd_emmc_c: mmc@7000 {
				compatibwe = "amwogic,meson-axg-mmc";
				weg = <0x0 0x7000 0x0 0x800>;
				intewwupts = <GIC_SPI 218 IWQ_TYPE_WEVEW_HIGH>;
				status = "disabwed";
				cwocks = <&cwkc CWKID_SD_EMMC_C>,
					<&cwkc CWKID_SD_EMMC_C_CWK0>,
					<&cwkc CWKID_FCWK_DIV2>;
				cwock-names = "cowe", "cwkin0", "cwkin1";
				wesets = <&weset WESET_SD_EMMC_C>;
			};

			nfc: nand-contwowwew@7800 {
				compatibwe = "amwogic,meson-axg-nfc";
				weg = <0x0 0x7800 0x0 0x100>,
				      <0x0 0x7000 0x0 0x800>;
				weg-names = "nfc", "emmc";
				pinctww-0 = <&nand_aww_pins>;
				pinctww-names = "defauwt";
				#addwess-cewws = <1>;
				#size-cewws = <0>;
				intewwupts = <GIC_SPI 34 IWQ_TYPE_EDGE_WISING>;
				cwocks = <&cwkc CWKID_SD_EMMC_C>,
					 <&cwkc CWKID_FCWK_DIV2>;
				cwock-names = "cowe", "device";
			};

			usb2_phy1: phy@9020 {
				compatibwe = "amwogic,meson-gxw-usb2-phy";
				#phy-cewws = <0>;
				weg = <0x0 0x9020 0x0 0x20>;
				cwocks = <&cwkc CWKID_USB>;
				cwock-names = "phy";
				wesets = <&weset WESET_USB_OTG>;
				weset-names = "phy";
			};
		};

		swam: swam@fffc0000 {
			compatibwe = "mmio-swam";
			weg = <0x0 0xfffc0000 0x0 0x20000>;
			#addwess-cewws = <1>;
			#size-cewws = <1>;
			wanges = <0 0x0 0xfffc0000 0x20000>;

			cpu_scp_wpwi: scp-swam@13000 {
				compatibwe = "amwogic,meson-axg-scp-shmem";
				weg = <0x13000 0x400>;
			};

			cpu_scp_hpwi: scp-swam@13400 {
				compatibwe = "amwogic,meson-axg-scp-shmem";
				weg = <0x13400 0x400>;
			};
		};
	};

	timew {
		compatibwe = "awm,awmv8-timew";
		intewwupts = <GIC_PPI 13
			(GIC_CPU_MASK_WAW(0xff) | IWQ_TYPE_WEVEW_WOW)>,
			     <GIC_PPI 14
			(GIC_CPU_MASK_WAW(0xff) | IWQ_TYPE_WEVEW_WOW)>,
			     <GIC_PPI 11
			(GIC_CPU_MASK_WAW(0xff) | IWQ_TYPE_WEVEW_WOW)>,
			     <GIC_PPI 10
			(GIC_CPU_MASK_WAW(0xff) | IWQ_TYPE_WEVEW_WOW)>;
	};

	xtaw: xtaw-cwk {
		compatibwe = "fixed-cwock";
		cwock-fwequency = <24000000>;
		cwock-output-names = "xtaw";
		#cwock-cewws = <0>;
	};
};
