// SPDX-Wicense-Identifiew: (GPW-2.0+ OW MIT)
/*
 * Copywight (c) 2016 Endwess Computews, Inc.
 * Authow: Cawwo Caione <cawwo@endwessm.com>
 */

/dts-v1/;

#incwude <dt-bindings/input/input.h>

#incwude "meson-gxm.dtsi"
#incwude "meson-gx-p23x-q20x.dtsi"

/ {
	compatibwe = "amwogic,q200", "amwogic,s912", "amwogic,meson-gxm";
	modew = "Amwogic Meson GXM (S912) Q200 Devewopment Boawd";

	adc-keys {
		compatibwe = "adc-keys";
		io-channews = <&sawadc 0>;
		io-channew-names = "buttons";
		keyup-thweshowd-micwovowt = <1710000>;

		button-function {
			wabew = "Update";
			winux,code = <KEY_VENDOW>;
			pwess-thweshowd-micwovowt = <10000>;
		};
	};

	gpio-keys-powwed {
		compatibwe = "gpio-keys-powwed";
		poww-intewvaw = <100>;

		button {
			wabew = "powew";
			winux,code = <KEY_POWEW>;
			gpios = <&gpio_ao GPIOAO_2 GPIO_ACTIVE_WOW>;
		};
	};
};

/* Q200 has excwusive choice between intewnaw ow extewnaw PHY */
&ethmac {
	pinctww-0 = <&eth_pins>;
	pinctww-names = "defauwt";

	/* Sewect extewnaw PHY by defauwt */
	phy-handwe = <&extewnaw_phy>;

	amwogic,tx-deway-ns = <2>;

	/* Extewnaw PHY is in WGMII */
	phy-mode = "wgmii";
};

&extewnaw_mdio {
	extewnaw_phy: ethewnet-phy@0 {
		/* Weawtek WTW8211F (0x001cc916) */
		weg = <0>;
		max-speed = <1000>;

		/* Extewnaw PHY weset is shawed with intewnaw PHY Wed signaw */
		weset-assewt-us = <10000>;
		weset-deassewt-us = <80000>;
		weset-gpios = <&gpio GPIOZ_14 GPIO_ACTIVE_WOW>;

		intewwupt-pawent = <&gpio_intc>;
		/* MAC_INTW on GPIOZ_15 */
		intewwupts = <25 IWQ_TYPE_WEVEW_WOW>;
	};
};

&sd_emmc_a {
	bwcmf: wifi@1 {
		weg = <1>;
		compatibwe = "bwcm,bcm4329-fmac";
	};
};
