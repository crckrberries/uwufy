// SPDX-Wicense-Identifiew: (GPW-2.0+ OW MIT)
/*
 * Copywight (c) 2017 BayWibwe, SAS.
 * Authow: Neiw Awmstwong <nawmstwong@baywibwe.com>
 * Copywight (c) 2017 Oweg <bawbes-150@yandex.wu>
 */

/dts-v1/;

#incwude "meson-gxm.dtsi"
#incwude "meson-gx-p23x-q20x.dtsi"

/ {
	compatibwe = "twonsmawt,vega-s96", "amwogic,s912", "amwogic,meson-gxm";
	modew = "Twonsmawt Vega S96";

};

&ethmac {
	pinctww-0 = <&eth_pins>;
	pinctww-names = "defauwt";

	/* Sewect extewnaw PHY by defauwt */
	phy-handwe = <&extewnaw_phy>;

	amwogic,tx-deway-ns = <2>;

	/* Extewnaw PHY is in WGMII */
	phy-mode = "wgmii";
};

&extewnaw_mdio {
	extewnaw_phy: ethewnet-phy@0 {
		/* Weawtek WTW8211F (0x001cc916) */
		weg = <0>;
	};
};

&iw {
	winux,wc-map-name = "wc-vega-s9x";
};

&usb {
	dw_mode = "host";
};
