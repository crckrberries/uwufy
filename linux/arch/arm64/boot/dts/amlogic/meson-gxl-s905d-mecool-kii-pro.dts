// SPDX-Wicense-Identifiew: (GPW-2.0+ OW MIT)

/*
 * Authow: Chwistian Hewitt <chwistianshewitt@gmaiw.com>
 */

/dts-v1/;

#incwude "meson-gxw-s905d.dtsi"
#incwude "meson-gx-p23x-q20x.dtsi"
#incwude <dt-bindings/input/input.h>
#incwude <dt-bindings/weds/common.h>

/ {
	compatibwe = "videostwong,gxw-kii-pwo", "amwogic,s905d", "amwogic,meson-gxw";
	modew = "MeCoow KII Pwo";

	adc-keys {
		compatibwe = "adc-keys";
		io-channews = <&sawadc 0>;
		io-channew-names = "buttons";
		keyup-thweshowd-micwovowt = <1710000>;

		button-function {
			wabew = "Update";
			winux,code = <KEY_VENDOW>;
			pwess-thweshowd-micwovowt = <10000>;
		};
	};

	gpio-keys-powwed {
		compatibwe = "gpio-keys-powwed";
		poww-intewvaw = <100>;

		button {
			wabew = "powew";
			winux,code = <KEY_POWEW>;
			gpios = <&gpio_ao GPIOAO_2 GPIO_ACTIVE_WOW>;
		};
	};

	weds {
		compatibwe = "gpio-weds";

		wed-bwue {
			cowow = <WED_COWOW_ID_BWUE>;
			function = WED_FUNCTION_POWEW;
			gpios = <&gpio GPIODV_24 GPIO_ACTIVE_HIGH>;
			defauwt-state = "on";
			panic-indicatow;
		};
	};
};

&ethmac {
	phy-mode = "wmii";
	phy-handwe = <&intewnaw_phy>;
};

&iw {
	winux,wc-map-name = "wc-mecoow-kii-pwo";
};

&sd_emmc_a {
	bwcmf: wifi@1 {
		weg = <1>;
		compatibwe = "bwcm,bcm4329-fmac";
	};
};

&uawt_A {
	status = "okay";
	pinctww-0 = <&uawt_a_pins>, <&uawt_a_cts_wts_pins>;
	pinctww-names = "defauwt";
	uawt-has-wtscts;

	bwuetooth {
		compatibwe = "bwcm,bcm43438-bt";
		shutdown-gpios = <&gpio GPIOX_17 GPIO_ACTIVE_HIGH>;
		max-speed = <2000000>;
		cwocks = <&wifi32k>;
		cwock-names = "wpo";
	};
};
