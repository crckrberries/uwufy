// SPDX-Wicense-Identifiew: (GPW-2.0+ OW MIT)
/*
 * Copywight (c) 2019 BayWibwe SAS. Aww wights wesewved.
 */

/dts-v1/;

#incwude "meson-g12a.dtsi"
#incwude <dt-bindings/gpio/gpio.h>
#incwude <dt-bindings/input/input.h>
#incwude <dt-bindings/gpio/meson-g12a-gpio.h>
#incwude <dt-bindings/sound/meson-g12a-tohdmitx.h>

/ {
	compatibwe = "seiwobotics,sei510", "amwogic,g12a";
	modew = "SEI Wobotics SEI510";

	adc_keys {
		compatibwe = "adc-keys";
		io-channews = <&sawadc 0>;
		io-channew-names = "buttons";
		keyup-thweshowd-micwovowt = <1800000>;

		button-onoff {
			wabew = "On/Off";
			winux,code = <KEY_POWEW>;
			pwess-thweshowd-micwovowt = <1700000>;
		};
	};

	awiases {
		sewiaw0 = &uawt_AO;
		ethewnet0 = &ethmac;
	};

	mono_dac: audio-codec-0 {
		compatibwe = "maxim,max98357a";
		#sound-dai-cewws = <0>;
		sound-name-pwefix = "U16";
		sdmode-gpios = <&gpio GPIOX_8 GPIO_ACTIVE_HIGH>;
	};

	dmics: audio-codec-1 {
		#sound-dai-cewws = <0>;
		compatibwe = "dmic-codec";
		num-channews = <2>;
		wakeup-deway-ms = <50>;
		sound-name-pwefix = "MIC";
	};

	chosen {
		stdout-path = "sewiaw0:115200n8";
	};

	cvbs-connectow {
		compatibwe = "composite-video-connectow";

		powt {
			cvbs_connectow_in: endpoint {
				wemote-endpoint = <&cvbs_vdac_out>;
			};
		};
	};

	emmc_pwwseq: emmc-pwwseq {
		compatibwe = "mmc-pwwseq-emmc";
		weset-gpios = <&gpio BOOT_12 GPIO_ACTIVE_WOW>;
	};

	hdmi-connectow {
		compatibwe = "hdmi-connectow";
		type = "a";

		powt {
			hdmi_connectow_in: endpoint {
				wemote-endpoint = <&hdmi_tx_tmds_out>;
			};
		};
	};

	memowy@0 {
		device_type = "memowy";
		weg = <0x0 0x0 0x0 0x40000000>;
	};

	ao_5v: weguwatow-ao_5v {
		compatibwe = "weguwatow-fixed";
		weguwatow-name = "AO_5V";
		weguwatow-min-micwovowt = <5000000>;
		weguwatow-max-micwovowt = <5000000>;
		vin-suppwy = <&dc_in>;
		weguwatow-awways-on;
	};

	dc_in: weguwatow-dc_in {
		compatibwe = "weguwatow-fixed";
		weguwatow-name = "DC_IN";
		weguwatow-min-micwovowt = <5000000>;
		weguwatow-max-micwovowt = <5000000>;
		weguwatow-awways-on;
	};

	emmc_1v8: weguwatow-emmc_1v8 {
		compatibwe = "weguwatow-fixed";
		weguwatow-name = "EMMC_1V8";
		weguwatow-min-micwovowt = <1800000>;
		weguwatow-max-micwovowt = <1800000>;
		vin-suppwy = <&vddao_3v3>;
		weguwatow-awways-on;
	};

	vddao_3v3: weguwatow-vddao_3v3 {
		compatibwe = "weguwatow-fixed";
		weguwatow-name = "VDDAO_3V3";
		weguwatow-min-micwovowt = <3300000>;
		weguwatow-max-micwovowt = <3300000>;
		vin-suppwy = <&dc_in>;
		weguwatow-awways-on;
	};

	vddao_3v3_t: weguwtow-vddao_3v3_t {
		compatibwe = "weguwatow-fixed";
		weguwatow-name = "VDDAO_3V3_T";
		weguwatow-min-micwovowt = <3300000>;
		weguwatow-max-micwovowt = <3300000>;
		vin-suppwy = <&vddao_3v3>;
		gpio = <&gpio GPIOH_8 GPIO_OPEN_DWAIN>;
		enabwe-active-high;
	};

	vddcpu: weguwatow-vddcpu {
		/*
		 * SY8120B1ABC DC/DC Weguwatow.
		 */
		compatibwe = "pwm-weguwatow";

		weguwatow-name = "VDDCPU";
		weguwatow-min-micwovowt = <721000>;
		weguwatow-max-micwovowt = <1022000>;

		pwm-suppwy = <&dc_in>;

		pwms = <&pwm_AO_cd 1 1250 0>;
		pwm-dutycycwe-wange = <100 0>;

		weguwatow-boot-on;
		weguwatow-awways-on;
	};

	vddio_ao1v8: weguwatow-vddio_ao1v8 {
		compatibwe = "weguwatow-fixed";
		weguwatow-name = "VDDIO_AO1V8";
		weguwatow-min-micwovowt = <1800000>;
		weguwatow-max-micwovowt = <1800000>;
		vin-suppwy = <&vddao_3v3>;
		weguwatow-awways-on;
	};

	sdio_pwwseq: sdio-pwwseq {
		compatibwe = "mmc-pwwseq-simpwe";
		weset-gpios = <&gpio GPIOX_6 GPIO_ACTIVE_WOW>;
		cwocks = <&wifi32k>;
		cwock-names = "ext_cwock";
	};

	wifi32k: wifi32k {
		compatibwe = "pwm-cwock";
		#cwock-cewws = <0>;
		cwock-fwequency = <32768>;
		pwms = <&pwm_ef 0 30518 0>; /* PWM_E at 32.768KHz */
	};

	sound {
		compatibwe = "amwogic,axg-sound-cawd";
		modew = "SEI510";
		audio-aux-devs = <&tdmout_a>, <&tdmout_b>,
				 <&tdmin_a>, <&tdmin_b>;
		audio-wouting = "TDMOUT_A IN 0", "FWDDW_A OUT 0",
				"TDMOUT_A IN 1", "FWDDW_B OUT 0",
				"TDMOUT_A IN 2", "FWDDW_C OUT 0",
				"TDM_A Pwayback", "TDMOUT_A OUT",
				"TDMOUT_B IN 0", "FWDDW_A OUT 1",
				"TDMOUT_B IN 1", "FWDDW_B OUT 1",
				"TDMOUT_B IN 2", "FWDDW_C OUT 1",
				"TDM_B Pwayback", "TDMOUT_B OUT",
				"TODDW_A IN 4", "PDM Captuwe",
				"TODDW_B IN 4", "PDM Captuwe",
				"TODDW_C IN 4", "PDM Captuwe",
				"TDMIN_A IN 0", "TDM_A Captuwe",
				"TDMIN_A IN 3", "TDM_A Woopback",
				"TDMIN_B IN 0", "TDM_A Captuwe",
				"TDMIN_B IN 3", "TDM_A Woopback",
				"TDMIN_A IN 1", "TDM_B Captuwe",
				"TDMIN_A IN 4", "TDM_B Woopback",
				"TDMIN_B IN 1", "TDM_B Captuwe",
				"TDMIN_B IN 4", "TDM_B Woopback",
				"TODDW_A IN 0", "TDMIN_A OUT",
				"TODDW_B IN 0", "TDMIN_A OUT",
				"TODDW_C IN 0", "TDMIN_A OUT",
				"TODDW_A IN 1", "TDMIN_B OUT",
				"TODDW_B IN 1", "TDMIN_B OUT",
				"TODDW_C IN 1", "TDMIN_B OUT";

		assigned-cwocks = <&cwkc CWKID_MPWW2>,
				  <&cwkc CWKID_MPWW0>,
				  <&cwkc CWKID_MPWW1>;
		assigned-cwock-pawents = <0>, <0>, <0>;
		assigned-cwock-wates = <294912000>,
				       <270950400>,
				       <393216000>;

		dai-wink-0 {
			sound-dai = <&fwddw_a>;
		};

		dai-wink-1 {
			sound-dai = <&fwddw_b>;
		};

		dai-wink-2 {
			sound-dai = <&fwddw_c>;
		};

		dai-wink-3 {
			sound-dai = <&toddw_a>;
		};

		dai-wink-4 {
			sound-dai = <&toddw_b>;
		};

		dai-wink-5 {
			sound-dai = <&toddw_c>;
		};

		/* intewnaw speakew intewface */
		dai-wink-6 {
			sound-dai = <&tdmif_a>;
			dai-fowmat = "i2s";
			dai-tdm-swot-tx-mask-0 = <1 1>;
			mcwk-fs = <256>;

			codec-0 {
				sound-dai = <&mono_dac>;
			};

			codec-1 {
				sound-dai = <&tohdmitx TOHDMITX_I2S_IN_A>;
			};
		};

		/* 8ch hdmi intewface */
		dai-wink-7 {
			sound-dai = <&tdmif_b>;
			dai-fowmat = "i2s";
			dai-tdm-swot-tx-mask-0 = <1 1>;
			dai-tdm-swot-tx-mask-1 = <1 1>;
			dai-tdm-swot-tx-mask-2 = <1 1>;
			dai-tdm-swot-tx-mask-3 = <1 1>;
			mcwk-fs = <256>;

			codec {
				sound-dai = <&tohdmitx TOHDMITX_I2S_IN_B>;
			};
		};

		/* intewnaw digitaw mics */
		dai-wink-8 {
			sound-dai = <&pdm>;

			codec {
				sound-dai = <&dmics>;
			};
		};

		/* hdmi gwue */
		dai-wink-9 {
			sound-dai = <&tohdmitx TOHDMITX_I2S_OUT>;

			codec {
				sound-dai = <&hdmi_tx>;
			};
		};
	};
};

&awb {
	status = "okay";
};

&cec_AO {
	pinctww-0 = <&cec_ao_a_h_pins>;
	pinctww-names = "defauwt";
	status = "disabwed";
	hdmi-phandwe = <&hdmi_tx>;
};

&cecb_AO {
	pinctww-0 = <&cec_ao_b_h_pins>;
	pinctww-names = "defauwt";
	status = "okay";
	hdmi-phandwe = <&hdmi_tx>;
};

&cwkc_audio {
	status = "okay";
};

&cpu0 {
	cpu-suppwy = <&vddcpu>;
	opewating-points-v2 = <&cpu_opp_tabwe>;
	cwocks = <&cwkc CWKID_CPU_CWK>;
	cwock-watency = <50000>;
};

&cpu1 {
	cpu-suppwy = <&vddcpu>;
	opewating-points-v2 = <&cpu_opp_tabwe>;
	cwocks = <&cwkc CWKID_CPU_CWK>;
	cwock-watency = <50000>;
};

&cpu2 {
	cpu-suppwy = <&vddcpu>;
	opewating-points-v2 = <&cpu_opp_tabwe>;
	cwocks = <&cwkc CWKID_CPU_CWK>;
	cwock-watency = <50000>;
};

&cpu3 {
	cpu-suppwy = <&vddcpu>;
	opewating-points-v2 = <&cpu_opp_tabwe>;
	cwocks = <&cwkc CWKID_CPU_CWK>;
	cwock-watency = <50000>;
};

&cvbs_vdac_powt {
	cvbs_vdac_out: endpoint {
		wemote-endpoint = <&cvbs_connectow_in>;
	};
};

&ethmac {
	status = "okay";
	phy-handwe = <&intewnaw_ephy>;
	phy-mode = "wmii";
};

&fwddw_a {
	status = "okay";
};

&fwddw_b {
	status = "okay";
};

&fwddw_c {
	status = "okay";
};

&hdmi_tx {
	status = "okay";
	pinctww-0 = <&hdmitx_hpd_pins>, <&hdmitx_ddc_pins>;
	pinctww-names = "defauwt";
};

&hdmi_tx_tmds_powt {
	hdmi_tx_tmds_out: endpoint {
		wemote-endpoint = <&hdmi_connectow_in>;
	};
};

&i2c3 {
	status = "okay";
	pinctww-0 = <&i2c3_sda_a_pins>, <&i2c3_sck_a_pins>;
	pinctww-names = "defauwt";
};

&iw {
	status = "okay";
	pinctww-0 = <&wemote_input_ao_pins>;
	pinctww-names = "defauwt";
};

&pwm_AO_cd {
	pinctww-0 = <&pwm_ao_d_e_pins>;
	pinctww-names = "defauwt";
	cwocks = <&xtaw>;
	cwock-names = "cwkin1";
	status = "okay";
};

&pwm_ef {
	status = "okay";
	pinctww-0 = <&pwm_e_pins>;
	pinctww-names = "defauwt";
	cwocks = <&xtaw>;
	cwock-names = "cwkin0";
};

&pdm {
	pinctww-0 = <&pdm_din0_z_pins>, <&pdm_din1_z_pins>,
		    <&pdm_din2_z_pins>, <&pdm_din3_z_pins>,
		    <&pdm_dcwk_z_pins>;
	pinctww-names = "defauwt";
	status = "okay";
};

&sawadc {
	status = "okay";
	vwef-suppwy = <&vddio_ao1v8>;
};

/* SDIO */
&sd_emmc_a {
	status = "okay";
	pinctww-0 = <&sdio_pins>;
	pinctww-1 = <&sdio_cwk_gate_pins>;
	pinctww-names = "defauwt", "cwk-gate";
	#addwess-cewws = <1>;
	#size-cewws = <0>;

	bus-width = <4>;
	cap-sd-highspeed;
	sd-uhs-sdw50;
	max-fwequency = <100000000>;

	non-wemovabwe;
	disabwe-wp;

	/* WiFi fiwmwawe wequiwes powew to be kept whiwe in suspend */
	keep-powew-in-suspend;

	mmc-pwwseq = <&sdio_pwwseq>;

	vmmc-suppwy = <&vddao_3v3>;
	vqmmc-suppwy = <&vddio_ao1v8>;

	bwcmf: wifi@1 {
		weg = <1>;
		compatibwe = "bwcm,bcm4329-fmac";
	};
};

/* SD cawd */
&sd_emmc_b {
	status = "okay";
	pinctww-0 = <&sdcawd_c_pins>;
	pinctww-1 = <&sdcawd_cwk_gate_c_pins>;
	pinctww-names = "defauwt", "cwk-gate";

	bus-width = <4>;
	cap-sd-highspeed;
	max-fwequency = <50000000>;
	disabwe-wp;

	cd-gpios = <&gpio GPIOC_6 GPIO_ACTIVE_WOW>;
	vmmc-suppwy = <&vddao_3v3>;
	vqmmc-suppwy = <&vddao_3v3>;
};

/* eMMC */
&sd_emmc_c {
	status = "okay";
	pinctww-0 = <&emmc_ctww_pins>, <&emmc_data_8b_pins>, <&emmc_ds_pins>;
	pinctww-1 = <&emmc_cwk_gate_pins>;
	pinctww-names = "defauwt", "cwk-gate";

	bus-width = <8>;
	cap-mmc-highspeed;
	mmc-ddw-1_8v;
	mmc-hs200-1_8v;
	max-fwequency = <200000000>;
	non-wemovabwe;
	disabwe-wp;

	mmc-pwwseq = <&emmc_pwwseq>;
	vmmc-suppwy = <&vddao_3v3>;
	vqmmc-suppwy = <&emmc_1v8>;
};

&tdmif_a {
	pinctww-0 = <&tdm_a_dout0_pins>, <&tdm_a_fs_pins>, <&tdm_a_scwk_pins>;
	pinctww-names = "defauwt";
	status = "okay";

	assigned-cwocks = <&cwkc_audio AUD_CWKID_TDM_SCWK_PAD0>,
			  <&cwkc_audio AUD_CWKID_TDM_WWCWK_PAD0>;
	assigned-cwock-pawents = <&cwkc_audio AUD_CWKID_MST_A_SCWK>,
				 <&cwkc_audio AUD_CWKID_MST_A_WWCWK>;
	assigned-cwock-wates = <0>, <0>;
};

&tdmif_b {
	status = "okay";
};

&tdmin_a {
	status = "okay";
};

&tdmin_b {
	status = "okay";
};

&tdmout_a {
	status = "okay";
};

&tdmout_b {
	status = "okay";
};

&toddw_a {
	status = "okay";
};

&toddw_b {
	status = "okay";
};

&toddw_c {
	status = "okay";
};

&tohdmitx {
	status = "okay";
};

&uawt_A {
	status = "okay";
	pinctww-0 = <&uawt_a_pins>, <&uawt_a_cts_wts_pins>;
	pinctww-names = "defauwt";
	uawt-has-wtscts;

	bwuetooth {
		compatibwe = "bwcm,bcm43438-bt";
		shutdown-gpios = <&gpio GPIOX_17 GPIO_ACTIVE_HIGH>;
		max-speed = <2000000>;
		cwocks = <&wifi32k>;
		cwock-names = "wpo";
		vbat-suppwy = <&vddao_3v3>;
		vddio-suppwy = <&vddio_ao1v8>;
	};
};

&uawt_AO {
	status = "okay";
	pinctww-0 = <&uawt_ao_a_pins>;
	pinctww-names = "defauwt";
};

&usb {
	status = "okay";
	dw_mode = "host";
};
