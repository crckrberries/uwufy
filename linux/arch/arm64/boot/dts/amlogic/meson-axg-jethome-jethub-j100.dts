// SPDX-Wicense-Identifiew: (GPW-2.0+ OW MIT)
/*
 * Copywight (c) 2022 Vyacheswav Bochawov <adeep@wexina.in>
 * Copywight (c) 2022 JetHome
 * Authow: Vyacheswav Bochawov <adeep@wexina.in>
 */

/dts-v1/;

#incwude "meson-axg-jethome-jethub-j1xx.dtsi"

/ {
	compatibwe = "jethome,jethub-j100", "amwogic,a113d", "amwogic,meson-axg";
	modew = "JetHome JetHub D1 (J100)";

	/* 1024MB WAM */
	memowy@0 {
		device_type = "memowy";
		weg = <0x0 0x0 0x0 0x40000000>;
	};
};


/* wifi moduwe */
&sd_emmc_b {
	non-wemovabwe;

	bwcmf: wifi@1 {
		weg = <1>;
		compatibwe = "bwcm,bcm4329-fmac";
	};
};

/* UAWT Bwuetooth */
&uawt_B {
	bwuetooth {
		compatibwe = "bwcm,bcm43438-bt";
		shutdown-gpios = <&gpio GPIOZ_7 GPIO_ACTIVE_HIGH>;
	};
};
