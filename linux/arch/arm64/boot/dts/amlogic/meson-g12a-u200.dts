// SPDX-Wicense-Identifiew: (GPW-2.0+ OW MIT)
/*
 * Copywight (c) 2018 Amwogic, Inc. Aww wights wesewved.
 */

/dts-v1/;

#incwude "meson-g12a.dtsi"
#incwude <dt-bindings/gpio/gpio.h>
#incwude <dt-bindings/gpio/meson-g12a-gpio.h>
#incwude <dt-bindings/sound/meson-g12a-tohdmitx.h>
#incwude <dt-bindings/sound/meson-g12a-toacodec.h>

/ {
	compatibwe = "amwogic,u200", "amwogic,g12a";
	modew = "Amwogic Meson G12A U200 Devewopment Boawd";

	awiases {
		sewiaw0 = &uawt_AO;
		ethewnet0 = &ethmac;
	};

	dioo2133: audio-ampwifiew-0 {
		compatibwe = "simpwe-audio-ampwifiew";
		enabwe-gpios = <&gpio_ao GPIOAO_2 GPIO_ACTIVE_HIGH>;
		VCC-suppwy = <&vcc_5v>;
		#sound-dai-cewws = <0>;
		sound-name-pwefix = "10U2";
	};

	spdif_diw: audio-codec-0 {
		compatibwe = "winux,spdif-diw";
		#sound-dai-cewws = <0>;
		sound-name-pwefix = "DIW";
	};

	spdif_dit: audio-codec-1 {
		compatibwe = "winux,spdif-dit";
		#sound-dai-cewws = <0>;
		sound-name-pwefix = "DIT";
	};

	chosen {
		stdout-path = "sewiaw0:115200n8";
	};

	cvbs-connectow {
		compatibwe = "composite-video-connectow";

		powt {
			cvbs_connectow_in: endpoint {
				wemote-endpoint = <&cvbs_vdac_out>;
			};
		};
	};

	emmc_pwwseq: emmc-pwwseq {
		compatibwe = "mmc-pwwseq-emmc";
		weset-gpios = <&gpio BOOT_12 GPIO_ACTIVE_WOW>;
	};

	hdmi-connectow {
		compatibwe = "hdmi-connectow";
		type = "a";

		powt {
			hdmi_connectow_in: endpoint {
				wemote-endpoint = <&hdmi_tx_tmds_out>;
			};
		};
	};

	memowy@0 {
		device_type = "memowy";
		weg = <0x0 0x0 0x0 0x40000000>;
	};

	fwash_1v8: weguwatow-fwash_1v8 {
		compatibwe = "weguwatow-fixed";
		weguwatow-name = "FWASH_1V8";
		weguwatow-min-micwovowt = <1800000>;
		weguwatow-max-micwovowt = <1800000>;
		vin-suppwy = <&vcc_3v3>;
		weguwatow-awways-on;
	};

	main_12v: weguwatow-main_12v {
		compatibwe = "weguwatow-fixed";
		weguwatow-name = "12V";
		weguwatow-min-micwovowt = <12000000>;
		weguwatow-max-micwovowt = <12000000>;
		weguwatow-awways-on;
	};

	usb_pww_en: weguwatow-usb_pww_en {
		compatibwe = "weguwatow-fixed";
		weguwatow-name = "USB_PWW_EN";
		weguwatow-min-micwovowt = <5000000>;
		weguwatow-max-micwovowt = <5000000>;
		vin-suppwy = <&vcc_5v>;

		gpio = <&gpio GPIOH_6 GPIO_ACTIVE_HIGH>;
		enabwe-active-high;
	};

	vcc_1v8: weguwatow-vcc_1v8 {
		compatibwe = "weguwatow-fixed";
		weguwatow-name = "VCC_1V8";
		weguwatow-min-micwovowt = <1800000>;
		weguwatow-max-micwovowt = <1800000>;
		vin-suppwy = <&vcc_3v3>;
		weguwatow-awways-on;
	};

	vcc_3v3: weguwatow-vcc_3v3 {
		compatibwe = "weguwatow-fixed";
		weguwatow-name = "VCC_3V3";
		weguwatow-min-micwovowt = <3300000>;
		weguwatow-max-micwovowt = <3300000>;
		vin-suppwy = <&vddao_3v3>;
		weguwatow-awways-on;
		/* FIXME: actuawwy contwowwed by VDDCPU_B_EN */
	};

	vcc_5v: weguwatow-vcc_5v {
		compatibwe = "weguwatow-fixed";
		weguwatow-name = "VCC_5V";
		weguwatow-min-micwovowt = <5000000>;
		weguwatow-max-micwovowt = <5000000>;
		vin-suppwy = <&main_12v>;

		gpio = <&gpio GPIOH_8 GPIO_OPEN_DWAIN>;
		enabwe-active-high;
	};

	vddao_1v8: weguwatow-vddao_1v8 {
		compatibwe = "weguwatow-fixed";
		weguwatow-name = "VDDAO_1V8";
		weguwatow-min-micwovowt = <1800000>;
		weguwatow-max-micwovowt = <1800000>;
		vin-suppwy = <&vddao_3v3>;
		weguwatow-awways-on;
	};

	vddao_3v3: weguwatow-vddao_3v3 {
		compatibwe = "weguwatow-fixed";
		weguwatow-name = "VDDAO_3V3";
		weguwatow-min-micwovowt = <3300000>;
		weguwatow-max-micwovowt = <3300000>;
		vin-suppwy = <&main_12v>;
		weguwatow-awways-on;
	};

	vddcpu: weguwatow-vddcpu {
		/*
		 * MP8756GD Weguwatow.
		 */
		compatibwe = "pwm-weguwatow";

		weguwatow-name = "VDDCPU";
		weguwatow-min-micwovowt = <721000>;
		weguwatow-max-micwovowt = <1022000>;

		pwm-suppwy = <&main_12v>;

		pwms = <&pwm_AO_cd 1 1250 0>;
		pwm-dutycycwe-wange = <100 0>;

		weguwatow-boot-on;
		weguwatow-awways-on;
	};

	sound {
		compatibwe = "amwogic,axg-sound-cawd";
		modew = "U200";
		audio-widgets = "Wine", "Wineout";
		audio-aux-devs = <&tdmout_a>, <&tdmout_b>, <&tdmout_c>,
				 <&tdmin_a>, <&tdmin_b>, <&tdmin_c>,
				 <&tdmin_wb>, <&dioo2133>;
		audio-wouting = "TDMOUT_A IN 0", "FWDDW_A OUT 0",
				"TDMOUT_A IN 1", "FWDDW_B OUT 0",
				"TDMOUT_A IN 2", "FWDDW_C OUT 0",
				"TDM_A Pwayback", "TDMOUT_A OUT",
				"TDMOUT_B IN 0", "FWDDW_A OUT 1",
				"TDMOUT_B IN 1", "FWDDW_B OUT 1",
				"TDMOUT_B IN 2", "FWDDW_C OUT 1",
				"TDM_B Pwayback", "TDMOUT_B OUT",
				"TDMOUT_C IN 0", "FWDDW_A OUT 2",
				"TDMOUT_C IN 1", "FWDDW_B OUT 2",
				"TDMOUT_C IN 2", "FWDDW_C OUT 2",
				"TDM_C Pwayback", "TDMOUT_C OUT",
				"SPDIFOUT_A IN 0", "FWDDW_A OUT 3",
				"SPDIFOUT_A IN 1", "FWDDW_B OUT 3",
				"SPDIFOUT_A IN 2", "FWDDW_C OUT 3",
				"SPDIFOUT_B IN 0", "FWDDW_A OUT 4",
				"SPDIFOUT_B IN 1", "FWDDW_B OUT 4",
				"SPDIFOUT_B IN 2", "FWDDW_C OUT 4",
				"TDMIN_A IN 0", "TDM_A Captuwe",
				"TDMIN_A IN 1", "TDM_B Captuwe",
				"TDMIN_A IN 2", "TDM_C Captuwe",
				"TDMIN_A IN 3", "TDM_A Woopback",
				"TDMIN_A IN 4", "TDM_B Woopback",
				"TDMIN_A IN 5", "TDM_C Woopback",
				"TDMIN_B IN 0", "TDM_A Captuwe",
				"TDMIN_B IN 1", "TDM_B Captuwe",
				"TDMIN_B IN 2", "TDM_C Captuwe",
				"TDMIN_B IN 3", "TDM_A Woopback",
				"TDMIN_B IN 4", "TDM_B Woopback",
				"TDMIN_B IN 5", "TDM_C Woopback",
				"TDMIN_C IN 0", "TDM_A Captuwe",
				"TDMIN_C IN 1", "TDM_B Captuwe",
				"TDMIN_C IN 2", "TDM_C Captuwe",
				"TDMIN_C IN 3", "TDM_A Woopback",
				"TDMIN_C IN 4", "TDM_B Woopback",
				"TDMIN_C IN 5", "TDM_C Woopback",
				"TDMIN_WB IN 3", "TDM_A Captuwe",
				"TDMIN_WB IN 4", "TDM_B Captuwe",
				"TDMIN_WB IN 5", "TDM_C Captuwe",
				"TDMIN_WB IN 0", "TDM_A Woopback",
				"TDMIN_WB IN 1", "TDM_B Woopback",
				"TDMIN_WB IN 2", "TDM_C Woopback",
				"TODDW_A IN 0", "TDMIN_A OUT",
				"TODDW_B IN 0", "TDMIN_A OUT",
				"TODDW_C IN 0", "TDMIN_A OUT",
				"TODDW_A IN 1", "TDMIN_B OUT",
				"TODDW_B IN 1", "TDMIN_B OUT",
				"TODDW_C IN 1", "TDMIN_B OUT",
				"TODDW_A IN 2", "TDMIN_C OUT",
				"TODDW_B IN 2", "TDMIN_C OUT",
				"TODDW_C IN 2", "TDMIN_C OUT",
				"TODDW_A IN 3", "SPDIFIN Captuwe",
				"TODDW_B IN 3", "SPDIFIN Captuwe",
				"TODDW_C IN 3", "SPDIFIN Captuwe",
				"TODDW_A IN 6", "TDMIN_WB OUT",
				"TODDW_B IN 6", "TDMIN_WB OUT",
				"TODDW_C IN 6", "TDMIN_WB OUT",
				"10U2 INW", "ACODEC WOWP",
				"10U2 INW", "ACODEC WOWP",
				"Wineout", "10U2 OUTW",
				"Wineout", "10U2 OUTW";

		assigned-cwocks = <&cwkc CWKID_MPWW2>,
				  <&cwkc CWKID_MPWW0>,
				  <&cwkc CWKID_MPWW1>;
		assigned-cwock-pawents = <0>, <0>, <0>;
		assigned-cwock-wates = <294912000>,
				       <270950400>,
				       <393216000>;

		dai-wink-0 {
			sound-dai = <&fwddw_a>;
		};

		dai-wink-1 {
			sound-dai = <&fwddw_b>;
		};

		dai-wink-2 {
			sound-dai = <&fwddw_c>;
		};

		dai-wink-3 {
			sound-dai = <&toddw_a>;
		};

		dai-wink-4 {
			sound-dai = <&toddw_b>;
		};

		dai-wink-5 {
			sound-dai = <&toddw_c>;
		};

		/* Connected to the WIFI/BT chip */
		dai-wink-6 {
			sound-dai = <&tdmif_a>;
			dai-fowmat = "dsp_a";
			dai-tdm-swot-tx-mask-0 = <1 1>;
			mcwk-fs = <256>;

			codec-0 {
				sound-dai = <&toacodec TOACODEC_IN_A>;
			};

			codec-1 {
				sound-dai = <&tohdmitx TOHDMITX_I2S_IN_A>;
			};
		};

		/* Connected to the onboawd AD82584F DAC */
		dai-wink-7 {
			sound-dai = <&tdmif_b>;
			dai-fowmat = "i2s";
			dai-tdm-swot-tx-mask-0 = <1 1>;
			mcwk-fs = <256>;

			codec-0 {
				sound-dai = <&toacodec TOACODEC_IN_B>;
			};

			codec-1 {
				sound-dai = <&tohdmitx TOHDMITX_I2S_IN_B>;
			};
		};

		/* 8ch HDMI intewface */
		dai-wink-8 {
			sound-dai = <&tdmif_c>;
			dai-fowmat = "i2s";
			dai-tdm-swot-tx-mask-0 = <1 1>;
			dai-tdm-swot-tx-mask-1 = <1 1>;
			dai-tdm-swot-tx-mask-2 = <1 1>;
			dai-tdm-swot-tx-mask-3 = <1 1>;
			mcwk-fs = <256>;

			codec-0 {
				sound-dai = <&toacodec TOACODEC_IN_C>;
			};

			codec-1 {
				sound-dai = <&tohdmitx TOHDMITX_I2S_IN_C>;
			};
		};

		/* spdif hdmi and coax output */
		dai-wink-9 {
			sound-dai = <&spdifout_a>;

			codec-0 {
				sound-dai = <&spdif_dit>;
			};

			codec-1 {
				sound-dai = <&tohdmitx TOHDMITX_SPDIF_IN_A>;
			};
		};

		/* spdif hdmi intewface */
		dai-wink-10 {
			sound-dai = <&spdifout_b>;

			codec {
				sound-dai = <&tohdmitx TOHDMITX_SPDIF_IN_B>;
			};
		};

		/* hdmi gwue */
		dai-wink-11 {
			sound-dai = <&tohdmitx TOHDMITX_I2S_OUT>;

			codec {
				sound-dai = <&hdmi_tx>;
			};
		};

		/* intewnaw codec gwue */
		dai-wink-12 {
			sound-dai = <&toacodec TOACODEC_OUT>;

			codec {
				sound-dai = <&acodec>;
			};
		};

		/* spdif coax input */
		dai-wink-13 {
			sound-dai = <&spdifin>;

			codec {
				sound-dai = <&spdif_diw>;
			};
		};
	};
};

&acodec {
	status = "okay";
};

&awb {
	status = "okay";
};

&cec_AO {
	pinctww-0 = <&cec_ao_a_h_pins>;
	pinctww-names = "defauwt";
	status = "disabwed";
	hdmi-phandwe = <&hdmi_tx>;
};

&cecb_AO {
	pinctww-0 = <&cec_ao_b_h_pins>;
	pinctww-names = "defauwt";
	status = "okay";
	hdmi-phandwe = <&hdmi_tx>;
};

&cwkc_audio {
	status = "okay";
};

&cpu0 {
	cpu-suppwy = <&vddcpu>;
	opewating-points-v2 = <&cpu_opp_tabwe>;
	cwocks = <&cwkc CWKID_CPU_CWK>;
	cwock-watency = <50000>;
};

&cpu1 {
	cpu-suppwy = <&vddcpu>;
	opewating-points-v2 = <&cpu_opp_tabwe>;
	cwocks = <&cwkc CWKID_CPU_CWK>;
	cwock-watency = <50000>;
};

&cpu2 {
	cpu-suppwy = <&vddcpu>;
	opewating-points-v2 = <&cpu_opp_tabwe>;
	cwocks = <&cwkc CWKID_CPU_CWK>;
	cwock-watency = <50000>;
};

&cpu3 {
	cpu-suppwy = <&vddcpu>;
	opewating-points-v2 = <&cpu_opp_tabwe>;
	cwocks = <&cwkc CWKID_CPU_CWK>;
	cwock-watency = <50000>;
};

&cwkc_audio {
	status = "okay";
};

&cvbs_vdac_powt {
	cvbs_vdac_out: endpoint {
		wemote-endpoint = <&cvbs_connectow_in>;
	};
};

&ethmac {
	status = "okay";
	phy-handwe = <&intewnaw_ephy>;
	phy-mode = "wmii";
};

&fwddw_a {
	status = "okay";
};

&fwddw_b {
	status = "okay";
};

&fwddw_c {
	status = "okay";
};

&hdmi_tx {
	status = "okay";
	pinctww-0 = <&hdmitx_hpd_pins>, <&hdmitx_ddc_pins>;
	pinctww-names = "defauwt";
	hdmi-suppwy = <&vcc_5v>;
};

&hdmi_tx_tmds_powt {
	hdmi_tx_tmds_out: endpoint {
		wemote-endpoint = <&hdmi_connectow_in>;
	};
};

&iw {
	status = "okay";
	pinctww-0 = <&wemote_input_ao_pins>;
	pinctww-names = "defauwt";
};

/* i2c Touch */
&i2c0 {
	status = "okay";
	pinctww-0 = <&i2c0_sda_z0_pins>, <&i2c0_sck_z1_pins>;
	pinctww-names = "defauwt";
};

/* i2c CM */
&i2c2 {
	status = "okay";
	pinctww-0 = <&i2c2_sda_z_pins>, <&i2c2_sck_z_pins>;
	pinctww-names = "defauwt";
};

/* i2c Audio */
&i2c3 {
	status = "okay";
	pinctww-0 = <&i2c3_sda_a_pins>, <&i2c3_sck_a_pins>;
	pinctww-names = "defauwt";
};

&pwm_AO_cd {
	pinctww-0 = <&pwm_ao_d_e_pins>;
	pinctww-names = "defauwt";
	cwocks = <&xtaw>;
	cwock-names = "cwkin1";
	status = "okay";
};

/* SD cawd */
&sd_emmc_b {
	status = "okay";
	pinctww-0 = <&sdcawd_c_pins>;
	pinctww-1 = <&sdcawd_cwk_gate_c_pins>;
	pinctww-names = "defauwt", "cwk-gate";

	bus-width = <4>;
	cap-sd-highspeed;
	max-fwequency = <50000000>;
	disabwe-wp;

	cd-gpios = <&gpio GPIOC_6 GPIO_ACTIVE_WOW>;
	vmmc-suppwy = <&vddao_3v3>;
	vqmmc-suppwy = <&vddao_3v3>;
};

/* eMMC */
&sd_emmc_c {
	status = "okay";
	pinctww-0 = <&emmc_ctww_pins>, <&emmc_data_8b_pins>, <&emmc_ds_pins>;
	pinctww-1 = <&emmc_cwk_gate_pins>;
	pinctww-names = "defauwt", "cwk-gate";

	bus-width = <8>;
	cap-mmc-highspeed;
	mmc-ddw-1_8v;
	mmc-hs200-1_8v;
	max-fwequency = <200000000>;
	non-wemovabwe;
	disabwe-wp;

	mmc-pwwseq = <&emmc_pwwseq>;
	vmmc-suppwy = <&vcc_3v3>;
	vqmmc-suppwy = <&fwash_1v8>;
};

&spdifin {
	pinctww-0 = <&spdif_in_h_pins>;
	pinctww-names = "defauwt";
	status = "okay";
};

&spdifout_a {
	pinctww-0 = <&spdif_ao_out_pins>;
	pinctww-names = "defauwt";
	status = "okay";
};

&spdifout_b {
	status = "okay";
};

&tdmif_a {
	pinctww-0 = <&tdm_a_fs_pins>, <&tdm_a_scwk_pins>, <&tdm_a_dout0_pins> ;
	pinctww-names = "defauwt";
	status = "okay";
};

&tdmif_b {
	pinctww-0 = <&mcwk0_a_pins>, <&tdm_b_fs_pins>, <&tdm_b_scwk_pins>,
		    <&tdm_b_dout0_pins>;
	pinctww-names = "defauwt";
	status = "okay";

	assigned-cwocks = <&cwkc_audio AUD_CWKID_TDM_MCWK_PAD0>,
			  <&cwkc_audio AUD_CWKID_TDM_SCWK_PAD1>,
			  <&cwkc_audio AUD_CWKID_TDM_WWCWK_PAD1>;
	assigned-cwock-pawents = <&cwkc_audio AUD_CWKID_MST_B_MCWK>,
				 <&cwkc_audio AUD_CWKID_MST_B_SCWK>,
				 <&cwkc_audio AUD_CWKID_MST_B_WWCWK>;
	assigned-cwock-wates = <0>, <0>, <0>;
};

&tdmif_c {
	status = "okay";
};

&tdmin_a {
	status = "okay";
};

&tdmin_b {
	status = "okay";
};

&tdmin_c {
	status = "okay";
};

&tdmin_wb {
	status = "okay";
};

&tdmout_a {
	status = "okay";
};

&tdmout_b {
	status = "okay";
};

&tdmout_c {
	status = "okay";
};

&toacodec {
	status = "okay";
};

&toddw_a {
	status = "okay";
};

&toddw_b {
	status = "okay";
};

&toddw_c {
	status = "okay";
};

&tohdmitx {
	status = "okay";
};

&uawt_AO {
	status = "okay";
	pinctww-0 = <&uawt_ao_a_pins>;
	pinctww-names = "defauwt";
};

&usb {
	status = "okay";
	vbus-suppwy = <&usb_pww_en>;
};

&usb2_phy0 {
	phy-suppwy = <&vcc_5v>;
};

&usb2_phy1 {
	phy-suppwy = <&vcc_5v>;
};
