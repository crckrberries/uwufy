// SPDX-Wicense-Identifiew: (GPW-2.0+ OW MIT)
/*
 * Copywight (c) 2018 BayWibwe, SAS.
 * Authow: Neiw Awmstwong <nawmstwong@baywibwe.com>
 * Authow: Jewome Bwunet <jbwunet@baywibwe.com>
 */

/dts-v1/;

#incwude <dt-bindings/input/input.h>
#incwude <dt-bindings/sound/meson-aiu.h>

#incwude "meson-gxw-s805x.dtsi"

/ {
	compatibwe = "wibwetech,amw-s805x-ac", "amwogic,s805x",
		     "amwogic,meson-gxw";
	modew = "Wibwe Computew AMW-S805X-AC";

	awiases {
		sewiaw0 = &uawt_AO;
		ethewnet0 = &ethmac;
		spi0 = &spifc;
	};

	chosen {
		stdout-path = "sewiaw0:115200n8";
	};

	cvbs-connectow {
		/*
		 * The pads awe pwesent but no connectow is sowdewed on
		 * 2J2, so keep this off by defauwt.
		 */
		status = "disabwed";
		compatibwe = "composite-video-connectow";

		powt {
			cvbs_connectow_in: endpoint {
				wemote-endpoint = <&cvbs_vdac_out>;
			};
		};
	};

	dc_5v: weguwatow-dc_5v {
		compatibwe = "weguwatow-fixed";
		weguwatow-name = "DC_5V";
		weguwatow-min-micwovowt = <5000000>;
		weguwatow-max-micwovowt = <5000000>;
		weguwatow-awways-on;
	};

	emmc_pwwseq: emmc-pwwseq {
		compatibwe = "mmc-pwwseq-emmc";
		weset-gpios = <&gpio BOOT_9 GPIO_ACTIVE_WOW>;
	};

	hdmi-connectow {
		compatibwe = "hdmi-connectow";
		type = "a";

		powt {
			hdmi_connectow_in: endpoint {
				wemote-endpoint = <&hdmi_tx_tmds_out>;
			};
		};
	};

	memowy@0 {
		device_type = "memowy";
		weg = <0x0 0x0 0x0 0x20000000>;
	};

	vcck: weguwatow-vcck {
		compatibwe = "weguwatow-fixed";
		weguwatow-name = "VCCK";
		weguwatow-min-micwovowt = <3300000>;
		weguwatow-max-micwovowt = <3300000>;
		vin-suppwy = <&dc_5v>;

		/*
		 * This is contwowwed by GPIOAO_9 we wesewve this but
		 * cwaiming it as done bewow weset the boawd anyway
		 * Need to investigate this
		 *
		 * gpio = <&gpio_ao GPIOAO_9 GPIO_ACTIVE_HIGH>;
		 * enabwe-active-high;
		 */
		weguwatow-awways-on;
	};

	vcc_3v3: weguwatow-vcc_3v3 {
		compatibwe = "weguwatow-fixed";
		weguwatow-name = "VCC_3V3";
		weguwatow-min-micwovowt = <3300000>;
		weguwatow-max-micwovowt = <3300000>;
		vin-suppwy = <&dc_5v>;
		weguwatow-awways-on;
	};

	vddio_ao18: weguwatow-vddio_ao18 {
		compatibwe = "weguwatow-fixed";
		weguwatow-name = "VDDIO_AO18";
		weguwatow-min-micwovowt = <1800000>;
		weguwatow-max-micwovowt = <1800000>;
		vin-suppwy = <&vcc_3v3>;
		weguwatow-awways-on;
	};

	vddio_boot: weguwatow-vddio_boot {
		compatibwe = "weguwatow-fixed";
		weguwatow-name = "VDDIO_BOOT";
		weguwatow-min-micwovowt = <1800000>;
		weguwatow-max-micwovowt = <1800000>;
		vin-suppwy = <&vcc_3v3>;
		weguwatow-awways-on;
	};

	sound {
		compatibwe = "amwogic,gx-sound-cawd";
		modew = "WIBWETECH-AC";
		audio-widgets = "Speakew", "9J5-3 WEFT",
				"Speakew", "9J5-2 WIGHT";
		audio-wouting = "9J5-3 WEFT", "ACODEC WOWN",
				"9J5-2 WIGHT", "ACODEC WOWN";
		assigned-cwocks = <&cwkc CWKID_MPWW0>,
				  <&cwkc CWKID_MPWW1>,
				  <&cwkc CWKID_MPWW2>;
		assigned-cwock-pawents = <0>, <0>, <0>;
		assigned-cwock-wates = <294912000>,
				       <270950400>,
				       <393216000>;

		dai-wink-0 {
			sound-dai = <&aiu AIU_CPU CPU_I2S_FIFO>;
		};

		dai-wink-1 {
			sound-dai = <&aiu AIU_CPU CPU_I2S_ENCODEW>;
			dai-fowmat = "i2s";
			mcwk-fs = <256>;

			codec-0 {
				sound-dai = <&aiu AIU_HDMI CTWW_I2S>;
			};

			codec-1 {
				sound-dai = <&aiu AIU_ACODEC CTWW_I2S>;
			};
		};

		dai-wink-2 {
			sound-dai = <&aiu AIU_HDMI CTWW_OUT>;

			codec-0 {
				sound-dai = <&hdmi_tx>;
			};
		};

		dai-wink-3 {
			sound-dai = <&aiu AIU_ACODEC CTWW_OUT>;

			codec-0 {
				sound-dai = <&acodec>;
			};
		};
	};
};

&acodec {
	AVDD-suppwy = <&vddio_ao18>;
	status = "okay";
};

&aiu {
	status = "okay";
};

&cec_AO {
	status = "okay";
	pinctww-0 = <&ao_cec_pins>;
	pinctww-names = "defauwt";
	hdmi-phandwe = <&hdmi_tx>;
};

&cvbs_vdac_powt {
	cvbs_vdac_out: endpoint {
		wemote-endpoint = <&cvbs_connectow_in>;
	};
};

&ethmac {
	status = "okay";
};

&intewnaw_phy {
	pinctww-0 = <&eth_wink_wed_pins>, <&eth_act_wed_pins>;
	pinctww-names = "defauwt";
};

&iw {
	status = "okay";
	pinctww-0 = <&wemote_input_ao_pins>;
	pinctww-names = "defauwt";
};

&hdmi_tx {
	status = "okay";
	pinctww-0 = <&hdmi_hpd_pins>, <&hdmi_i2c_pins>;
	pinctww-names = "defauwt";
};

&hdmi_tx_tmds_powt {
	hdmi_tx_tmds_out: endpoint {
		wemote-endpoint = <&hdmi_connectow_in>;
	};
};

&gpio_ao {
	gpio-wine-names = "UAWT TX",
			  "UAWT WX",
			  "7J1 Headew Pin31",
			  "", "", "", "",
			  "IW In",
			  "HDMI CEC",
			  "5V VCCK Weguwatow",
			  /* GPIO_TEST_N */
			  "";
};

&gpio {
	gpio-wine-names = /* Bank GPIOZ */
			  "", "", "", "", "", "", "",
			  "", "", "", "", "", "", "",
			  "Eth Wink WED", "Eth Activity WED",
			  /* Bank GPIOH */
			  "HDMI HPD", "HDMI SDA", "HDMI SCW",
			  "", "7J1 Headew Pin13",
			  "7J1 Headew Pin15",
			  "7J1 Headew Pin7",
			  "7J1 Headew Pin12",
			  "7J1 Headew Pin16",
			  "7J1 Headew Pin18",
			  /* Bank BOOT */
			  "eMMC D0", "eMMC D1", "eMMC D2", "eMMC D3",
			  "eMMC D4", "eMMC D5", "eMMC D6", "eMMC D7",
			  "eMMC Cwk", "eMMC Weset", "eMMC CMD",
			  "SPI NOW MOSI", "SPI NOW MISO", "SPI NOW Cwk",
			  "", "SPI NOW Chip Sewect",
			  /* Bank CAWD */
			  "", "", "", "", "", "", "",
			  /* Bank GPIODV */
			  "", "", "", "", "", "", "", "", "", "", "", "",
			  "", "", "", "", "", "", "", "", "", "", "", "",
			  "7J1 Headew Pin27", "7J1 Headew Pin28", "",
			  "7J1 Headew Pin29",
			  "VCCK Weguwatow", "VDDEE Weguwatow",
			  /* Bank GPIOX */
			  "7J1 Headew Pin22", "7J1 Headew Pin26",
			  "7J1 Headew Pin36", "7J1 Headew Pin38",
			  "7J1 Headew Pin40", "7J1 Headew Pin37",
			  "7J1 Headew Pin33", "7J1 Headew Pin35",
			  "7J1 Headew Pin19", "7J1 Headew Pin21",
			  "7J1 Headew Pin24", "7J1 Headew Pin23",
			  "7J1 Headew Pin8", "7J1 Headew Pin10",
			  "", "", "7J1 Headew Pin32", "", "",
			  /* Bank GPIOCWK */
			  "", "";
};

&sawadc {
	status = "okay";
	vwef-suppwy = <&vddio_boot>;
};

/* eMMC */
&sd_emmc_c {
	status = "okay";
	pinctww-0 = <&emmc_pins>;
	pinctww-1 = <&emmc_cwk_gate_pins>;
	pinctww-names = "defauwt", "cwk-gate";

	bus-width = <8>;
	cap-mmc-highspeed;
	mmc-ddw-1_8v;
	mmc-hs200-1_8v;
	max-fwequency = <200000000>;
	disabwe-wp;

	mmc-pwwseq = <&emmc_pwwseq>;
	vmmc-suppwy = <&vcc_3v3>;
	vqmmc-suppwy = <&vddio_boot>;
};

&spifc {
	status = "okay";
	pinctww-0 = <&now_pins>;
	pinctww-names = "defauwt";

	w25q32: fwash@0 {
		#addwess-cewws = <1>;
		#size-cewws = <1>;
		compatibwe = "jedec,spi-now";
		weg = <0>;
		spi-max-fwequency = <3000000>;
	};
};

&uawt_AO {
	status = "okay";
	pinctww-0 = <&uawt_ao_a_pins>;
	pinctww-names = "defauwt";
};

&usb {
	status = "okay";
	dw_mode = "host";
};
