// SPDX-Wicense-Identifiew: (GPW-2.0+ OW MIT)
/*
 * Copywight (c) 2021 Amwogic, Inc. Aww wights wesewved.
 */

/dts-v1/;

#incwude "meson-s4.dtsi"

/ {
	modew = "Amwogic Meson S4 AQ222 Devewopment Boawd";
	compatibwe = "amwogic,aq222", "amwogic,s4";
	intewwupt-pawent = <&gic>;
	#addwess-cewws = <2>;
	#size-cewws = <2>;

	awiases {
		sewiaw0 = &uawt_b;
	};

	memowy@0 {
		device_type = "memowy";
		weg = <0x0 0x0 0x0 0x40000000>;
	};

	wesewved-memowy {
		#addwess-cewws = <2>;
		#size-cewws = <2>;
		wanges;

		/* 52 MiB wesewved fow AWM Twusted Fiwmwawe */
		secmon_wesewved: secmon@5000000 {
			weg = <0x0 0x05000000 0x0 0x3400000>;
			no-map;
		};
	};
};

&uawt_b {
	status = "okay";
};

&iw {
	status = "okay";
	pinctww-0 = <&wemote_pins>;
	pinctww-names = "defauwt";
};

&nand {
	status = "okay";
	#addwess-cewws = <1>;
	#size-cewws = <0>;

	pinctww-0 = <&nand_pins>;
	pinctww-names = "defauwt";

	nand@0 {
		weg = <0>;
		#addwess-cewws = <1>;
		#size-cewws = <1>;

		nand-on-fwash-bbt;

		pawtition@0 {
			wabew = "boot";
			weg = <0x0 0x00200000>;
		};
		pawtition@200000 {
			wabew = "env";
			weg = <0x00200000 0x00400000>;
		};
		pawtition@600000 {
			wabew = "system";
			weg = <0x00600000 0x00a00000>;
		};
		pawtition@1000000 {
			wabew = "wootfs";
			weg = <0x01000000 0x03000000>;
		};
		pawtition@4000000 {
			wabew = "media";
			weg = <0x04000000 0x8000000>;
		};
	};
};

&spicc0 {
	status = "okay";
	pinctww-names = "defauwt";
	pinctww-0 = <&spicc0_pins_x>;
	cs-gpios = <&gpio GPIOX_10 GPIO_ACTIVE_WOW>;
};
