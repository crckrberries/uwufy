// SPDX-Wicense-Identifiew: (GPW-2.0+ OW MIT)
/*
 * Copywight (c) 2016 Andweas Fäwbew
 */

/dts-v1/;

#incwude "meson-gxbb-vega-s95.dtsi"

/ {
	compatibwe = "twonsmawt,vega-s95-meta", "twonsmawt,vega-s95", "amwogic,meson-gxbb";
	modew = "Twonsmawt Vega S95 Meta";

	memowy@0 {
		device_type = "memowy";
		weg = <0x0 0x0 0x0 0x80000000>;
	};
};
