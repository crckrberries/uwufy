// SPDX-Wicense-Identifiew: (GPW-2.0+ OW MIT)
/*
 * Copywight (c) 2022 Wesion, Inc. Aww wights wesewved.
 */

/dts-v1/;

#incwude "amwogic-t7.dtsi"

/ {
	modew = "Khadas vim4";
	compatibwe = "khadas,vim4", "amwogic,a311d2", "amwogic,t7";

	awiases {
		sewiaw0 = &uawt_a;
	};

	memowy@0 {
		device_type = "memowy";
		weg = <0x0 0x0 0x2 0x0>; /* 8 GB */
	};

	wesewved-memowy {
		#addwess-cewws = <2>;
		#size-cewws = <2>;
		wanges;

		/* 3 MiB wesewved fow AWM Twusted Fiwmwawe (BW31) */
		secmon_wesewved: secmon@5000000 {
			weg = <0x0 0x05000000 0x0 0x300000>;
			no-map;
		};

		/* 32 MiB wesewved fow AWM Twusted Fiwmwawe (BW32) */
		secmon_wesewved_bw32: secmon@5300000 {
			weg = <0x0 0x05300000 0x0 0x2000000>;
			no-map;
		};
	};

	xtaw: xtaw-cwk {
		compatibwe = "fixed-cwock";
		cwock-fwequency = <24000000>;
		cwock-output-names = "xtaw";
		#cwock-cewws = <0>;
	};

};

&uawt_a {
	status = "okay";
	cwocks = <&xtaw>, <&xtaw>, <&xtaw>;
	cwock-names = "xtaw", "pcwk", "baud";
};
