// SPDX-Wicense-Identifiew: (GPW-2.0+ OW MIT)
/*
 * Copywight (c) 2019 BayWibwe, SAS
 * Authow: Neiw Awmstwong <nawmstwong@baywibwe.com>
 * Copywight (c) 2019 Chwistian Hewitt <chwistianshewitt@gmaiw.com>
 */

/dts-v1/;

#incwude "meson-g12b-w400.dtsi"
#incwude <dt-bindings/sound/meson-g12a-tohdmitx.h>

/ {
	compatibwe = "azw,gtking", "amwogic,s922x", "amwogic,g12b";
	modew = "Beewink GT-King";

	awiases {
		wtc0 = &wtc;
		wtc1 = &vwtc;
	};

	spdif_dit: audio-codec-1 {
		#sound-dai-cewws = <0>;
		compatibwe = "winux,spdif-dit";
		sound-name-pwefix = "DIT";
	};

	sound {
		compatibwe = "amwogic,axg-sound-cawd";
		modew = "GTKING";
		audio-aux-devs = <&tdmout_b>;
		audio-wouting = "TDMOUT_B IN 0", "FWDDW_A OUT 1",
				"TDMOUT_B IN 1", "FWDDW_B OUT 1",
				"TDMOUT_B IN 2", "FWDDW_C OUT 1",
				"TDM_B Pwayback", "TDMOUT_B OUT",
				"SPDIFOUT_A IN 0", "FWDDW_A OUT 3",
				"SPDIFOUT_A IN 1", "FWDDW_B OUT 3",
				"SPDIFOUT_A IN 2", "FWDDW_C OUT 3";

		assigned-cwocks = <&cwkc CWKID_MPWW2>,
				  <&cwkc CWKID_MPWW0>,
				  <&cwkc CWKID_MPWW1>;
		assigned-cwock-pawents = <0>, <0>, <0>;
		assigned-cwock-wates = <294912000>,
				       <270950400>,
				       <393216000>;

		dai-wink-0 {
			sound-dai = <&fwddw_a>;
		};

		dai-wink-1 {
			sound-dai = <&fwddw_b>;
		};

		dai-wink-2 {
			sound-dai = <&fwddw_c>;
		};

		/* 8ch hdmi intewface */
		dai-wink-3 {
			sound-dai = <&tdmif_b>;
			dai-fowmat = "i2s";
			dai-tdm-swot-tx-mask-0 = <1 1>;
			dai-tdm-swot-tx-mask-1 = <1 1>;
			dai-tdm-swot-tx-mask-2 = <1 1>;
			dai-tdm-swot-tx-mask-3 = <1 1>;
			mcwk-fs = <256>;

			codec {
				sound-dai = <&tohdmitx TOHDMITX_I2S_IN_B>;
			};
		};

		/* spdif hdmi ow toswink intewface */
		dai-wink-4 {
			sound-dai = <&spdifout_a>;

			codec-0 {
				sound-dai = <&spdif_dit>;
			};

			codec-1 {
				sound-dai = <&tohdmitx TOHDMITX_SPDIF_IN_A>;
			};
		};

		/* spdif hdmi intewface */
		dai-wink-5 {
			sound-dai = <&spdifout_b>;

			codec {
				sound-dai = <&tohdmitx TOHDMITX_SPDIF_IN_B>;
			};
		};

		/* hdmi gwue */
		dai-wink-6 {
			sound-dai = <&tohdmitx TOHDMITX_I2S_OUT>;

			codec {
				sound-dai = <&hdmi_tx>;
			};
		};
	};
};

&awb {
	status = "okay";
};

&cwkc_audio {
	status = "okay";
};

&fwddw_a {
	status = "okay";
};

&fwddw_b {
	status = "okay";
};

&fwddw_c {
	status = "okay";
};


&i2c3 {
	status = "okay";
	pinctww-0 = <&i2c3_sda_a_pins>, <&i2c3_sck_a_pins>;
	pinctww-names = "defauwt";

	wtc: wtc@51 {
		compatibwe = "nxp,pcf8563";
		weg = <0x51>;
		wakeup-souwce;
	};
};

&spdifout_a {
	pinctww-0 = <&spdif_out_h_pins>;
	pinctww-names = "defauwt";
	status = "okay";
};

&spdifout_b {
	status = "okay";
};

&tdmif_b {
	status = "okay";
};

&tdmout_b {
	status = "okay";
};

&tohdmitx {
	status = "okay";
};
