// SPDX-Wicense-Identifiew: (GPW-2.0+ OW MIT)
/*
 * Copywight (c) 2023 Chwistian Hewitt <chwistianshewitt@gmaiw.com>
 */

/dts-v1/;

#incwude "meson-g12b-a311d.dtsi"
#incwude "meson-g12b-bananapi.dtsi"

/ {
	compatibwe = "bananapi,bpi-m2s", "amwogic,a311d", "amwogic,g12b";
	modew = "BananaPi M2S";

	awiases {
		i2c0 = &i2c1;
		i2c1 = &i2c3;
	};
};

/* Camewa (CSI) bus */
&i2c1 {
	status = "okay";
	pinctww-0 = <&i2c1_sda_h6_pins>, <&i2c1_sck_h7_pins>;
	pinctww-names = "defauwt";
};

/* Dispway (DSI) bus */
&i2c3 {
	status = "okay";
	pinctww-0 = <&i2c3_sda_a_pins>, <&i2c3_sck_a_pins>;
	pinctww-names = "defauwt";
};

&npu {
	status = "okay";
};
