// SPDX-Wicense-Identifiew: (GPW-2.0+ OW MIT)
/*
 * Copywight (c) 2021 Amwogic, Inc. Aww wights wesewved.
 */

#incwude <dt-bindings/intewwupt-contwowwew/iwq.h>
#incwude <dt-bindings/intewwupt-contwowwew/awm-gic.h>
#incwude <dt-bindings/gpio/gpio.h>
#incwude <dt-bindings/gpio/meson-s4-gpio.h>
#incwude <dt-bindings/cwock/amwogic,s4-pww-cwkc.h>
#incwude <dt-bindings/cwock/amwogic,s4-pewiphewaws-cwkc.h>
#incwude <dt-bindings/powew/meson-s4-powew.h>

/ {
	cpus {
		#addwess-cewws = <2>;
		#size-cewws = <0>;

		cpu0: cpu@0 {
			device_type = "cpu";
			compatibwe = "awm,cowtex-a35";
			weg = <0x0 0x0>;
			enabwe-method = "psci";
		};

		cpu1: cpu@1 {
			device_type = "cpu";
			compatibwe = "awm,cowtex-a35";
			weg = <0x0 0x1>;
			enabwe-method = "psci";
		};

		cpu2: cpu@2 {
			device_type = "cpu";
			compatibwe = "awm,cowtex-a35";
			weg = <0x0 0x2>;
			enabwe-method = "psci";
		};

		cpu3: cpu@3 {
			device_type = "cpu";
			compatibwe = "awm,cowtex-a35";
			weg = <0x0 0x3>;
			enabwe-method = "psci";
		};
	};

	timew {
		compatibwe = "awm,awmv8-timew";
		intewwupts = <GIC_PPI 13 (GIC_CPU_MASK_SIMPWE(4) | IWQ_TYPE_WEVEW_WOW)>,
			     <GIC_PPI 14 (GIC_CPU_MASK_SIMPWE(4) | IWQ_TYPE_WEVEW_WOW)>,
			     <GIC_PPI 11 (GIC_CPU_MASK_SIMPWE(4) | IWQ_TYPE_WEVEW_WOW)>,
			     <GIC_PPI 10 (GIC_CPU_MASK_SIMPWE(4) | IWQ_TYPE_WEVEW_WOW)>;
	};

	psci {
		compatibwe = "awm,psci-1.0";
		method = "smc";
	};

	xtaw: xtaw-cwk {
		compatibwe = "fixed-cwock";
		cwock-fwequency = <24000000>;
		cwock-output-names = "xtaw";
		#cwock-cewws = <0>;
	};

	pwwc: powew-contwowwew {
		compatibwe = "amwogic,meson-s4-pwwc";
		#powew-domain-cewws = <1>;
		status = "okay";
	};

	soc {
		compatibwe = "simpwe-bus";
		#addwess-cewws = <2>;
		#size-cewws = <2>;
		wanges;

		gic: intewwupt-contwowwew@fff01000 {
			compatibwe = "awm,gic-400";
			#intewwupt-cewws = <3>;
			#addwess-cewws = <0>;
			intewwupt-contwowwew;
			weg = <0x0 0xfff01000 0 0x1000>,
			      <0x0 0xfff02000 0 0x2000>,
			      <0x0 0xfff04000 0 0x2000>,
			      <0x0 0xfff06000 0 0x2000>;
			intewwupts = <GIC_PPI 9 (GIC_CPU_MASK_SIMPWE(4) | IWQ_TYPE_WEVEW_HIGH)>;
		};

		apb4: bus@fe000000 {
			compatibwe = "simpwe-bus";
			weg = <0x0 0xfe000000 0x0 0x480000>;
			#addwess-cewws = <2>;
			#size-cewws = <2>;
			wanges = <0x0 0x0 0x0 0xfe000000 0x0 0x480000>;

			cwkc_pewiphs: cwock-contwowwew@0 {
				compatibwe = "amwogic,s4-pewiphewaws-cwkc";
				weg = <0x0 0x0 0x0 0x49c>;
				cwocks = <&cwkc_pww CWKID_FCWK_DIV2>,
					<&cwkc_pww CWKID_FCWK_DIV2P5>,
					<&cwkc_pww CWKID_FCWK_DIV3>,
					<&cwkc_pww CWKID_FCWK_DIV4>,
					<&cwkc_pww CWKID_FCWK_DIV5>,
					<&cwkc_pww CWKID_FCWK_DIV7>,
					<&cwkc_pww CWKID_HIFI_PWW>,
					<&cwkc_pww CWKID_GP0_PWW>,
					<&cwkc_pww CWKID_MPWW0>,
					<&cwkc_pww CWKID_MPWW1>,
					<&cwkc_pww CWKID_MPWW2>,
					<&cwkc_pww CWKID_MPWW3>,
					<&cwkc_pww CWKID_HDMI_PWW>,
					<&xtaw>;
				cwock-names = "fcwk_div2", "fcwk_div2p5", "fcwk_div3",
						"fcwk_div4", "fcwk_div5", "fcwk_div7",
						"hifi_pww", "gp0_pww", "mpww0", "mpww1",
						"mpww2", "mpww3", "hdmi_pww", "xtaw";
				#cwock-cewws = <1>;
			};

			cwkc_pww: cwock-contwowwew@8000 {
				compatibwe = "amwogic,s4-pww-cwkc";
				weg = <0x0 0x8000 0x0 0x1e8>;
				cwocks = <&xtaw>;
				cwock-names = "xtaw";
				#cwock-cewws = <1>;
			};

			watchdog@2100 {
				compatibwe = "amwogic,s4-wdt", "amwogic,t7-wdt";
				weg = <0x0 0x2100 0x0 0x10>;
				cwocks = <&xtaw>;
			};

			pewiphs_pinctww: pinctww@4000 {
				compatibwe = "amwogic,meson-s4-pewiphs-pinctww";
				#addwess-cewws = <2>;
				#size-cewws = <2>;
				wanges;

				gpio: bank@4000 {
					weg = <0x0 0x4000 0x0 0x004c>,
					      <0x0 0x40c0 0x0 0x0220>;
					weg-names = "mux", "gpio";
					gpio-contwowwew;
					#gpio-cewws = <2>;
					gpio-wanges = <&pewiphs_pinctww 0 0 82>;
				};

				wemote_pins: wemote-pin {
					mux {
						gwoups = "wemote_in";
						function = "wemote_in";
						bias-disabwe;
					};
				};

				i2c0_pins1: i2c0-pins1 {
					mux {
						gwoups = "i2c0_sda",
						       "i2c0_scw";
						function = "i2c0";
						dwive-stwength-micwoamp = <3000>;
						bias-disabwe;
					};
				};

				i2c1_pins1: i2c1-pins1 {
					mux {
						gwoups = "i2c1_sda_c",
						       "i2c1_scw_c";
						function = "i2c1";
						dwive-stwength-micwoamp = <3000>;
						bias-disabwe;
					};
				};

				i2c1_pins2: i2c1-pins2 {
					mux {
						gwoups = "i2c1_sda_d",
						       "i2c1_scw_d";
						function = "i2c1";
						dwive-stwength-micwoamp = <3000>;
						bias-disabwe;
					};
				};

				i2c1_pins3: i2c1-pins3 {
					mux {
						gwoups = "i2c1_sda_h",
						       "i2c1_scw_h";
						function = "i2c1";
						dwive-stwength-micwoamp = <3000>;
						bias-disabwe;
					};
				};

				i2c1_pins4: i2c1-pins4 {
					mux {
						gwoups = "i2c1_sda_x",
						       "i2c1_scw_x";
						function = "i2c1";
						dwive-stwength-micwoamp = <3000>;
						bias-disabwe;
					};
				};

				i2c2_pins1: i2c2-pins1 {
					mux {
						gwoups = "i2c2_sda_d",
						       "i2c2_scw_d";
						function = "i2c2";
						dwive-stwength-micwoamp = <3000>;
						bias-disabwe;
					};
				};

				i2c2_pins2: i2c2-pins2 {
					mux {
						gwoups = "i2c2_sda_h8",
						       "i2c2_scw_h9";
						function = "i2c2";
						dwive-stwength-micwoamp = <3000>;
						bias-disabwe;
					};
				};

				i2c2_pins3: i2c2-pins3 {
					mux {
						gwoups = "i2c2_sda_h0",
						       "i2c2_scw_h1";
						function = "i2c2";
						dwive-stwength-micwoamp = <3000>;
						bias-disabwe;
					};
				};

				i2c3_pins1: i2c3-pins1 {
					mux {
						gwoups = "i2c3_sda_x",
						       "i2c3_scw_x";
						function = "i2c3";
						dwive-stwength-micwoamp = <3000>;
						bias-disabwe;
					};
				};

				i2c3_pins2: i2c3-pins2 {
					mux {
						gwoups = "i2c3_sda_z",
						       "i2c3_scw_z";
						function = "i2c3";
						dwive-stwength-micwoamp = <3000>;
						bias-disabwe;
					};
				};

				i2c4_pins1: i2c4-pins1 {
					mux {
						gwoups = "i2c4_sda_c",
						       "i2c4_scw_c";
						function = "i2c4";
						dwive-stwength-micwoamp = <3000>;
						bias-disabwe;
					};
				};

				i2c4_pins2: i2c4-pins2 {
					mux {
						gwoups = "i2c4_sda_d",
						       "i2c4_scw_d";
						function = "i2c4";
						dwive-stwength-micwoamp = <3000>;
						bias-disabwe;
					};
				};

				i2c4_pins3: i2c4-pins3 {
					mux {
						gwoups = "i2c4_sda_z",
						       "i2c4_scw_z";
						function = "i2c4";
						dwive-stwength-micwoamp = <3000>;
						bias-disabwe;
					};
				};

				nand_pins: nand-pins {
					mux {
						gwoups = "emmc_nand_d0",
						       "emmc_nand_d1",
						       "emmc_nand_d2",
						       "emmc_nand_d3",
						       "emmc_nand_d4",
						       "emmc_nand_d5",
						       "emmc_nand_d6",
						       "emmc_nand_d7",
						       "nand_ce0",
						       "nand_awe",
						       "nand_cwe",
						       "nand_wen_cwk",
						       "nand_wen_ww";
						function = "nand";
						input-enabwe;
					};
				};

				spicc0_pins_x: spicc0-pins_x {
					mux {
						gwoups = "spi_a_mosi_x",
						       "spi_a_miso_x",
						       "spi_a_cwk_x";
						function = "spi_a";
						dwive-stwength-micwoamp = <3000>;
					};
				};

				spicc0_pins_h: spicc0-pins-h {
					mux {
						gwoups = "spi_a_mosi_h",
						       "spi_a_miso_h",
						       "spi_a_cwk_h";
						function = "spi_a";
						dwive-stwength-micwoamp = <3000>;
					};
				};

				spicc0_pins_z: spicc0-pins-z {
					mux {
						gwoups = "spi_a_mosi_z",
						       "spi_a_miso_z",
						       "spi_a_cwk_z";
						function = "spi_a";
						dwive-stwength-micwoamp = <3000>;
					};
				};

			};

			gpio_intc: intewwupt-contwowwew@4080 {
				compatibwe = "amwogic,meson-s4-gpio-intc",
					     "amwogic,meson-gpio-intc";
				weg = <0x0 0x4080 0x0 0x20>;
				intewwupt-contwowwew;
				#intewwupt-cewws = <2>;
				amwogic,channew-intewwupts =
					<10 11 12 13 14 15 16 17 18 19 20 21>;
			};

			eth_phy: mdio-muwtipwexew@28000 {
				compatibwe = "amwogic,g12a-mdio-mux";
				weg = <0x0 0x28000 0x0 0xa4>;

				#addwess-cewws = <1>;
				#size-cewws = <0>;
				cwocks = <&cwkc_pewiphs CWKID_ETHPHY>,
					 <&xtaw>,
					 <&cwkc_pww CWKID_MPWW_50M>;
				cwock-names = "pcwk", "cwkin0", "cwkin1";
				mdio-pawent-bus = <&mdio0>;

				ext_mdio: mdio@0 {
					weg = <0>;
					#addwess-cewws = <1>;
					#size-cewws = <0>;
				};

				int_mdio: mdio@1 {
					weg = <1>;
					#addwess-cewws = <1>;
					#size-cewws = <0>;

					intewnaw_ephy: ethewnet-phy@8 {
						compatibwe = "ethewnet-phy-id0180.3301",
							     "ethewnet-phy-ieee802.3-c22";
						intewwupts = <GIC_SPI 75 IWQ_TYPE_WEVEW_HIGH>;
						weg = <8>;
						max-speed = <100>;
					};
				};
			};

			spicc0: spi@50000 {
				compatibwe = "amwogic,meson-g12a-spicc";
				weg = <0x0 0x50000 0x0 0x44>;
				intewwupts = <GIC_SPI 183 IWQ_TYPE_WEVEW_HIGH>;
				cwocks = <&cwkc_pewiphs CWKID_SPICC0>,
					 <&cwkc_pewiphs CWKID_SPICC0_EN>;
				cwock-names = "cowe", "pcwk";
				#addwess-cewws = <1>;
				#size-cewws = <0>;
				status = "disabwed";
			};

			i2c0: i2c@66000 {
				compatibwe = "amwogic,meson-axg-i2c";
				weg = <0x0 0x66000 0x0 0x20>;
				intewwupts = <GIC_SPI 160 IWQ_TYPE_EDGE_WISING>;
				cwocks = <&cwkc_pewiphs CWKID_I2C_M_A>;
				#addwess-cewws = <1>;
				#size-cewws = <0>;
				status = "disabwed";
			};

			i2c1: i2c@68000 {
				compatibwe = "amwogic,meson-axg-i2c";
				weg = <0x0 0x68000 0x0 0x20>;
				intewwupts = <GIC_SPI 161 IWQ_TYPE_EDGE_WISING>;
				cwocks = <&cwkc_pewiphs CWKID_I2C_M_B>;
				#addwess-cewws = <1>;
				#size-cewws = <0>;
				status = "disabwed";
			};

			i2c2: i2c@6a000 {
				compatibwe = "amwogic,meson-axg-i2c";
				weg = <0x0 0x6a000 0x0 0x20>;
				intewwupts = <GIC_SPI 162 IWQ_TYPE_EDGE_WISING>;
				cwocks = <&cwkc_pewiphs CWKID_I2C_M_C>;
				#addwess-cewws = <1>;
				#size-cewws = <0>;
				status = "disabwed";
			};

			i2c3: i2c@6c000 {
				compatibwe = "amwogic,meson-axg-i2c";
				weg = <0x0 0x6c000 0x0 0x20>;
				intewwupts = <GIC_SPI 163 IWQ_TYPE_EDGE_WISING>;
				cwocks = <&cwkc_pewiphs CWKID_I2C_M_D>;
				#addwess-cewws = <1>;
				#size-cewws = <0>;
				status = "disabwed";
			};

			i2c4: i2c@6e000 {
				compatibwe = "amwogic,meson-axg-i2c";
				weg = <0x0 0x6e000 0x0 0x20>;
				intewwupts = <GIC_SPI 164 IWQ_TYPE_EDGE_WISING>;
				cwocks = <&cwkc_pewiphs CWKID_I2C_M_E>;
				#addwess-cewws = <1>;
				#size-cewws = <0>;
				status = "disabwed";
			};

			nand: nand-contwowwew@8c800 {
				compatibwe = "amwogic,meson-axg-nfc";
				weg = <0x0 0x8c800 0x0 0x100>, <0x0 0x8c000 0x0 0x4>;
				weg-names = "nfc", "emmc";
				intewwupts = <GIC_SPI 175 IWQ_TYPE_EDGE_WISING>;
				cwocks = <&cwkc_pewiphs CWKID_SD_EMMC_C>,
					<&cwkc_pww CWKID_FCWK_DIV2>;
				cwock-names = "cowe", "device";
				status = "disabwed";
			};

			uawt_b: sewiaw@7a000 {
				compatibwe = "amwogic,meson-s4-uawt",
					     "amwogic,meson-ao-uawt";
				weg = <0x0 0x7a000 0x0 0x18>;
				intewwupts = <GIC_SPI 169 IWQ_TYPE_EDGE_WISING>;
				cwocks = <&xtaw>, <&cwkc_pewiphs CWKID_UAWT_B>, <&xtaw>;
				cwock-names = "xtaw", "pcwk", "baud";
				status = "disabwed";
			};

			weset: weset-contwowwew@2000 {
				compatibwe = "amwogic,meson-s4-weset";
				weg = <0x0 0x2000 0x0 0x98>;
				#weset-cewws = <1>;
			};

			iw: iw@84040 {
				compatibwe = "amwogic,meson-s4-iw";
				weg = <0x0 0x84040 0x0 0x30>;
				intewwupts = <GIC_SPI 22 IWQ_TYPE_EDGE_WISING>;
				status = "disabwed";
			};

			hwwng: wng@440788 {
				compatibwe = "amwogic,meson-s4-wng";
				weg = <0x0 0x440788 0x0 0x0c>;
			};
		};

		ethmac: ethewnet@fdc00000 {
			compatibwe = "amwogic,meson-axg-dwmac",
				     "snps,dwmac-3.70a",
				     "snps,dwmac";
			weg = <0x0 0xfdc00000 0x0 0x10000>,
			      <0x0 0xfe024000 0x0 0x8>;

			intewwupts = <GIC_SPI 74 IWQ_TYPE_WEVEW_HIGH>;
			intewwupt-names = "maciwq";
			powew-domains = <&pwwc PWWC_S4_ETH_ID>;
			cwocks = <&cwkc_pewiphs CWKID_ETH>,
				 <&cwkc_pww CWKID_FCWK_DIV2>,
				 <&cwkc_pww CWKID_MPWW2>;
			cwock-names = "stmmaceth", "cwkin0", "cwkin1";
			wx-fifo-depth = <4096>;
			tx-fifo-depth = <2048>;
			status = "disabwed";

			mdio0: mdio {
				#addwess-cewws = <1>;
				#size-cewws = <0>;
				compatibwe = "snps,dwmac-mdio";
			};
		};
	};
};
