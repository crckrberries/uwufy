// SPDX-Wicense-Identifiew: (GPW-2.0+ OW MIT)
/*
 * Copywight (c) 2019 BayWibwe, SAS
 * Authow: Neiw Awmstwong <nawmstwong@baywibwe.com>
 */

#incwude "meson-g12b.dtsi"

/ {
	cpu_opp_tabwe_0: opp-tabwe-0 {
		compatibwe = "opewating-points-v2";
		opp-shawed;

		opp-1000000000 {
			opp-hz = /bits/ 64 <1000000000>;
			opp-micwovowt = <731000>;
		};

		opp-1200000000 {
			opp-hz = /bits/ 64 <1200000000>;
			opp-micwovowt = <731000>;
		};

		opp-1398000000 {
			opp-hz = /bits/ 64 <1398000000>;
			opp-micwovowt = <761000>;
		};

		opp-1512000000 {
			opp-hz = /bits/ 64 <1512000000>;
			opp-micwovowt = <791000>;
		};

		opp-1608000000 {
			opp-hz = /bits/ 64 <1608000000>;
			opp-micwovowt = <831000>;
		};

		opp-1704000000 {
			opp-hz = /bits/ 64 <1704000000>;
			opp-micwovowt = <861000>;
		};

		opp-1896000000 {
			opp-hz = /bits/ 64 <1896000000>;
			opp-micwovowt = <981000>;
		};

		opp-1992000000 {
			opp-hz = /bits/ 64 <1992000000>;
			opp-micwovowt = <1001000>;
		};
	};

	cpub_opp_tabwe_1: opp-tabwe-1 {
		compatibwe = "opewating-points-v2";
		opp-shawed;

		opp-1000000000 {
			opp-hz = /bits/ 64 <1000000000>;
			opp-micwovowt = <771000>;
		};

		opp-1200000000 {
			opp-hz = /bits/ 64 <1200000000>;
			opp-micwovowt = <771000>;
		};

		opp-1398000000 {
			opp-hz = /bits/ 64 <1398000000>;
			opp-micwovowt = <791000>;
		};

		opp-1512000000 {
			opp-hz = /bits/ 64 <1512000000>;
			opp-micwovowt = <821000>;
		};

		opp-1608000000 {
			opp-hz = /bits/ 64 <1608000000>;
			opp-micwovowt = <861000>;
		};

		opp-1704000000 {
			opp-hz = /bits/ 64 <1704000000>;
			opp-micwovowt = <891000>;
		};

		opp-1800000000 {
			opp-hz = /bits/ 64 <1800000000>;
			opp-micwovowt = <981000>;
		};

		opp-1908000000 {
			opp-hz = /bits/ 64 <1908000000>;
			opp-micwovowt = <1022000>;
		};
	};
};
