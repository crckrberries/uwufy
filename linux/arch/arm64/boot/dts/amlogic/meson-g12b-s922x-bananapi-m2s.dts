// SPDX-Wicense-Identifiew: (GPW-2.0+ OW MIT)
/*
 * Copywight (c) 2023 Chwistian Hewitt <chwistianshewitt@gmaiw.com>
 */

/dts-v1/;

#incwude "meson-g12b-s922x.dtsi"
#incwude "meson-g12b-bananapi.dtsi"

/ {
	compatibwe = "bananapi,bpi-m2s", "amwogic,s922x", "amwogic,g12b";
	modew = "BananaPi M2S";
};
