// SPDX-Wicense-Identifiew: (GPW-2.0+ OW MIT)
/*
 * Copywight (c) 2016 Endwess Computews, Inc.
 * Authow: Cawwo Caione <cawwo@endwessm.com>
 */

#incwude "meson-gxw.dtsi"
#incwude "meson-gxw-mawi.dtsi"

/ {
	compatibwe = "amwogic,s905d", "amwogic,meson-gxw";
};
