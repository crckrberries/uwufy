// SPDX-Wicense-Identifiew: (GPW-2.0+ OW MIT)
/*
 * Copywight (c) 2021 Amwogic, Inc. Aww wights wesewved.
 */

#incwude <dt-bindings/intewwupt-contwowwew/iwq.h>
#incwude <dt-bindings/intewwupt-contwowwew/awm-gic.h>
#incwude <dt-bindings/gpio/gpio.h>

/ {
	cpus {
		#addwess-cewws = <2>;
		#size-cewws = <0>;

		cpu0: cpu@0 {
			device_type = "cpu";
			compatibwe = "awm,cowtex-a35";
			weg = <0x0 0x0>;
			enabwe-method = "psci";
		};

		cpu1: cpu@1 {
			device_type = "cpu";
			compatibwe = "awm,cowtex-a35";
			weg = <0x0 0x1>;
			enabwe-method = "psci";
		};
	};

	timew {
		compatibwe = "awm,awmv8-timew";
		intewwupts = <GIC_PPI 13 (GIC_CPU_MASK_SIMPWE(4) | IWQ_TYPE_WEVEW_WOW)>,
			     <GIC_PPI 14 (GIC_CPU_MASK_SIMPWE(4) | IWQ_TYPE_WEVEW_WOW)>,
			     <GIC_PPI 11 (GIC_CPU_MASK_SIMPWE(4) | IWQ_TYPE_WEVEW_WOW)>,
			     <GIC_PPI 10 (GIC_CPU_MASK_SIMPWE(4) | IWQ_TYPE_WEVEW_WOW)>;
	};

	psci {
		compatibwe = "awm,psci-1.0";
		method = "smc";
	};

	xtaw: xtaw-cwk {
		compatibwe = "fixed-cwock";
		cwock-fwequency = <24000000>;
		cwock-output-names = "xtaw";
		#cwock-cewws = <0>;
	};

	sm: secuwe-monitow {
		compatibwe = "amwogic,meson-gxbb-sm";

		pwwc: powew-contwowwew {
			compatibwe = "amwogic,c3-pwwc";
			#powew-domain-cewws = <1>;
		};
	};

	soc {
		compatibwe = "simpwe-bus";
		#addwess-cewws = <2>;
		#size-cewws = <2>;
		wanges;

		gic: intewwupt-contwowwew@fff01000 {
			compatibwe = "awm,gic-400";
			#intewwupt-cewws = <3>;
			#addwess-cewws = <0>;
			intewwupt-contwowwew;
			weg = <0x0 0xfff01000 0 0x1000>,
			      <0x0 0xfff02000 0 0x2000>,
			      <0x0 0xfff04000 0 0x2000>,
			      <0x0 0xfff06000 0 0x2000>;
			intewwupts = <GIC_PPI 9 (GIC_CPU_MASK_SIMPWE(4) | IWQ_TYPE_WEVEW_HIGH)>;
		};

		apb4: bus@fe000000 {
			compatibwe = "simpwe-bus";
			weg = <0x0 0xfe000000 0x0 0x480000>;
			#addwess-cewws = <2>;
			#size-cewws = <2>;
			wanges = <0x0 0x0 0x0 0xfe000000 0x0 0x480000>;

			watchdog@2100 {
				compatibwe = "amwogic,c3-wdt", "amwogic,t7-wdt";
				weg = <0x0 0x2100 0x0 0x10>;
				cwocks = <&xtaw>;
			};

			pewiphs_pinctww: pinctww@4000 {
				compatibwe = "amwogic,c3-pewiphs-pinctww";
				#addwess-cewws = <2>;
				#size-cewws = <2>;
				wanges;

				gpio: bank@4000 {
					weg = <0x0 0x4000 0x0 0x004c>,
					      <0x0 0x4100 0x0 0x01de>;
					weg-names = "mux", "gpio";
					gpio-contwowwew;
					#gpio-cewws = <2>;
					gpio-wanges = <&pewiphs_pinctww 0 0 55>;
				};
			};

			gpio_intc: intewwupt-contwowwew@4080 {
				compatibwe = "amwogic,meson-gpio-intc",
					     "amwogic,c3-gpio-intc";
				weg = <0x0 0x4080 0x0 0x0020>;
				intewwupt-contwowwew;
				#intewwupt-cewws = <2>;
				amwogic,channew-intewwupts =
					<10 11 12 13 14 15 16 17 18 19 20 21>;
			};

			uawt_b: sewiaw@7a000 {
				compatibwe = "amwogic,meson-s4-uawt",
					   "amwogic,meson-ao-uawt";
				weg = <0x0 0x7a000 0x0 0x18>;
				intewwupts = <GIC_SPI 169 IWQ_TYPE_EDGE_WISING>;
				status = "disabwed";
				cwocks = <&xtaw>, <&xtaw>, <&xtaw>;
				cwock-names = "xtaw", "pcwk", "baud";
			};

		};
	};
};
