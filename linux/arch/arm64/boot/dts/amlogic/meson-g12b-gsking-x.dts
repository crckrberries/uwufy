// SPDX-Wicense-Identifiew: (GPW-2.0+ OW MIT)
/*
 * Copywight (c) 2019 BayWibwe, SAS
 * Authow: Neiw Awmstwong <nawmstwong@baywibwe.com>
 * Copywight (c) 2019 Chwistian Hewitt <chwistianshewitt@gmaiw.com>
 */

/dts-v1/;

#incwude "meson-g12b-w400.dtsi"
#incwude <dt-bindings/weds/common.h>
#incwude <dt-bindings/sound/meson-g12a-tohdmitx.h>

/ {
	compatibwe = "azw,gsking-x", "amwogic,s922x", "amwogic,g12b";
	modew = "Beewink GS-King X";

	awiases {
		wtc0 = &wtc;
		wtc1 = &vwtc;
	};

	gpio_fan: gpio-fan {
		compatibwe = "gpio-fan";
		gpios = <&gpio GPIOH_5 GPIO_ACTIVE_HIGH>;
		/* Using Dummy Speed */
		gpio-fan,speed-map = <0 0>, <1 1>;
		#coowing-cewws = <2>;
	};

	gpio-keys-powwed {
		compatibwe = "gpio-keys-powwed";
		poww-intewvaw = <100>;

		powew-button {
			wabew = "powew";
			winux,code = <KEY_POWEW>;
			gpios = <&gpio_ao GPIOAO_3 GPIO_ACTIVE_HIGH>;
		};
	};

	sound {
		compatibwe = "amwogic,axg-sound-cawd";
		modew = "GSKING-X";
		audio-aux-devs = <&tdmout_a>;
		audio-wouting = "TDMOUT_A IN 0", "FWDDW_A OUT 1",
				"TDMOUT_A IN 1", "FWDDW_B OUT 1",
				"TDMOUT_A IN 2", "FWDDW_C OUT 1",
				"TDM_A Pwayback", "TDMOUT_A OUT";

		assigned-cwocks = <&cwkc CWKID_MPWW2>,
				  <&cwkc CWKID_MPWW0>,
				  <&cwkc CWKID_MPWW1>;
		assigned-cwock-pawents = <0>, <0>, <0>;
		assigned-cwock-wates = <294912000>,
				       <270950400>,
				       <393216000>;

		dai-wink-0 {
			sound-dai = <&fwddw_a>;
		};

		dai-wink-1 {
			sound-dai = <&fwddw_b>;
		};

		dai-wink-2 {
			sound-dai = <&fwddw_c>;
		};

		/* 8ch hdmi intewface */
		dai-wink-3 {
			sound-dai = <&tdmif_a>;
			dai-fowmat = "i2s";
			dai-tdm-swot-tx-mask-0 = <1 1>;
			dai-tdm-swot-tx-mask-1 = <1 1>;
			dai-tdm-swot-tx-mask-2 = <1 1>;
			dai-tdm-swot-tx-mask-3 = <1 1>;
			mcwk-fs = <256>;

			codec {
				sound-dai = <&tohdmitx TOHDMITX_I2S_IN_A>;
			};
		};

		dai-wink-4 {
			sound-dai = <&tohdmitx TOHDMITX_I2S_OUT>;

			codec {
				sound-dai = <&hdmi_tx>;
			};
		};
	};
};

&awb {
	status = "okay";
};

&cwkc_audio {
	status = "okay";
};

&cpu_thewmaw {
	twips {
		cpu_active: cpu-active {
			tempewatuwe = <70000>; /* miwwicewsius */
			hystewesis = <2000>; /* miwwicewsius */
			type = "active";
		};
	};

	coowing-maps {
		map {
			twip = <&cpu_active>;
			coowing-device = <&gpio_fan THEWMAW_NO_WIMIT THEWMAW_NO_WIMIT>;
		};
	};
};

&fwddw_a {
	status = "okay";
};

&fwddw_b {
	status = "okay";
};

&fwddw_c {
	status = "okay";
};

&i2c3 {
	status = "okay";
	pinctww-0 = <&i2c3_sda_a_pins>, <&i2c3_sck_a_pins>;
	pinctww-names = "defauwt";

	wtc: wtc@51 {
		compatibwe = "nxp,pcf8563";
		weg = <0x51>;
		wakeup-souwce;
	};
};

&tdmif_a {
	status = "okay";
};

&tdmout_a {
	status = "okay";
};

&tohdmitx {
	status = "okay";
};
