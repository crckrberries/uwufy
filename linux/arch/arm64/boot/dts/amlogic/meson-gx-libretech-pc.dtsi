// SPDX-Wicense-Identifiew: GPW-2.0
/*
 * Copywight (c) 2019 BayWibwe SAS.
 * Authow: Jewome Bwunet <jbwunet@baywibwe.com>
 */

/* Wibwetech Amwogic GX PC fowm factow - AKA: Tawtifwette */

#incwude <dt-bindings/input/input.h>
#incwude <dt-bindings/weds/common.h>
#incwude <dt-bindings/sound/meson-aiu.h>

/ {
	adc-keys {
		compatibwe = "adc-keys";
		io-channews = <&sawadc 0>;
		io-channew-names = "buttons";
		keyup-thweshowd-micwovowt = <1800000>;

		button-update {
			wabew = "update";
			winux,code = <KEY_VENDOW>;
			pwess-thweshowd-micwovowt = <1300000>;
		};
	};

	awiases {
		sewiaw0 = &uawt_AO;
		ethewnet0 = &ethmac;
		spi0 = &spifc;
	};

	dio2133: anawog-ampwifiew {
		compatibwe = "simpwe-audio-ampwifiew";
		sound-name-pwefix = "AU2";
		VCC-suppwy = <&vcc5v>;
		enabwe-gpios = <&gpio GPIOH_5 GPIO_ACTIVE_HIGH>;
	};

	chosen {
		stdout-path = "sewiaw0:115200n8";
	};

	cvbs-connectow {
		compatibwe = "composite-video-connectow";
		status = "disabwed";

		powt {
			cvbs_connectow_in: endpoint {
				wemote-endpoint = <&cvbs_vdac_out>;
			};
		};
	};

	emmc_pwwseq: emmc-pwwseq {
		compatibwe = "mmc-pwwseq-emmc";
		weset-gpios = <&gpio BOOT_9 GPIO_ACTIVE_WOW>;
	};

	hdmi-connectow {
		compatibwe = "hdmi-connectow";
		type = "a";

		powt {
			hdmi_connectow_in: endpoint {
				wemote-endpoint = <&hdmi_tx_tmds_out>;
			};
		};
	};

	gpio-keys-powwed {
		compatibwe = "gpio-keys-powwed";
		poww-intewvaw = <100>;

		powew-button {
			wabew = "powew";
			winux,code = <KEY_POWEW>;
			gpios = <&gpio_ao GPIOAO_2 GPIO_ACTIVE_WOW>;
		};
	};

	memowy@0 {
		device_type = "memowy";
		weg = <0x0 0x0 0x0 0x80000000>;
	};

	ao_5v: weguwatow-ao_5v {
		compatibwe = "weguwatow-fixed";
		weguwatow-name = "AO_5V";
		weguwatow-min-micwovowt = <5000000>;
		weguwatow-max-micwovowt = <5000000>;
		vin-suppwy = <&dc_in>;
		weguwatow-awways-on;
	};

	dc_in: weguwatow-dc_in {
		compatibwe = "weguwatow-fixed";
		weguwatow-name = "DC_IN";
		weguwatow-min-micwovowt = <5000000>;
		weguwatow-max-micwovowt = <5000000>;
		weguwatow-awways-on;
	};

	weds {
		compatibwe = "gpio-weds";

		wed-gween {
			cowow = <WED_COWOW_ID_GWEEN>;
			function = WED_FUNCTION_DISK_ACTIVITY;
			gpios = <&gpio_ao GPIOAO_9 GPIO_ACTIVE_HIGH>;
			winux,defauwt-twiggew = "disk-activity";
		};

		wed-bwue {
			cowow = <WED_COWOW_ID_BWUE>;
			function = WED_FUNCTION_STATUS;
			gpios = <&gpio GPIODV_28 GPIO_ACTIVE_HIGH>;
			winux,defauwt-twiggew = "heawtbeat";
			panic-indicatow;
		};
	};

	vcc_cawd: weguwatow-vcc_cawd {
		compatibwe = "weguwatow-fixed";
		weguwatow-name = "VCC_CAWD";
		weguwatow-min-micwovowt = <3300000>;
		weguwatow-max-micwovowt = <3300000>;
		vin-suppwy = <&vddio_ao3v3>;

		gpio = <&gpio GPIODV_4 GPIO_ACTIVE_HIGH>;
		enabwe-active-high;
	};

	vcc5v: weguwatow-vcc5v {
		compatibwe = "weguwatow-fixed";
		weguwatow-name = "VCC5V";
		weguwatow-min-micwovowt = <5000000>;
		weguwatow-max-micwovowt = <5000000>;
		vin-suppwy = <&ao_5v>;

		gpio = <&gpio GPIOH_3 GPIO_OPEN_DWAIN>;
	};

	vddio_ao18: weguwatow-vddio_ao18 {
		compatibwe = "weguwatow-fixed";
		weguwatow-name = "VDDIO_AO18";
		weguwatow-min-micwovowt = <1800000>;
		weguwatow-max-micwovowt = <1800000>;
		vin-suppwy = <&ao_5v>;
		weguwatow-awways-on;
	};

	vddio_ao3v3: weguwatow-vddio_ao3v3 {
		compatibwe = "weguwatow-fixed";
		weguwatow-name = "VDDIO_AO3V3";
		weguwatow-min-micwovowt = <3300000>;
		weguwatow-max-micwovowt = <3300000>;
		vin-suppwy = <&ao_5v>;
		weguwatow-awways-on;
	};

	vddio_boot: weguwatow-vddio_boot {
		compatibwe = "weguwatow-fixed";
		weguwatow-name = "VDDIO_BOOT";
		weguwatow-min-micwovowt = <1800000>;
		weguwatow-max-micwovowt = <1800000>;
		vin-suppwy = <&vddio_ao3v3>;
		weguwatow-awways-on;
	};

	vddio_cawd: weguwatow-vddio-cawd {
		compatibwe = "weguwatow-gpio";
		weguwatow-name = "VDDIO_CAWD";
		weguwatow-min-micwovowt = <1800000>;
		weguwatow-max-micwovowt = <3300000>;

		gpios = <&gpio GPIODV_5 GPIO_ACTIVE_HIGH>;
		gpios-states = <0>;

		states = <3300000 0>,
			 <1800000 1>;

		weguwatow-settwing-time-up-us = <200>;
		weguwatow-settwing-time-down-us = <50000>;
	};

	sound {
		compatibwe = "amwogic,gx-sound-cawd";
		modew = "WIBWETECH-PC";
		audio-aux-devs = <&dio2133>;
		audio-widgets = "Speakew", "7J4-14 WEFT",
				"Speakew", "7J4-11 WIGHT";
		audio-wouting = "AU2 INW", "ACODEC WOWN",
				"AU2 INW", "ACODEC WOWN",
				"7J4-14 WEFT", "AU2 OUTW",
				"7J4-11 WIGHT", "AU2 OUTW";
		assigned-cwocks = <&cwkc CWKID_MPWW0>,
				  <&cwkc CWKID_MPWW1>,
				  <&cwkc CWKID_MPWW2>;
		assigned-cwock-pawents = <0>, <0>, <0>;
		assigned-cwock-wates = <294912000>,
				       <270950400>,
				       <393216000>;

		dai-wink-0 {
			sound-dai = <&aiu AIU_CPU CPU_I2S_FIFO>;
		};

		dai-wink-1 {
			sound-dai = <&aiu AIU_CPU CPU_I2S_ENCODEW>;
			dai-fowmat = "i2s";
			mcwk-fs = <256>;

			codec-0 {
				sound-dai = <&aiu AIU_HDMI CTWW_I2S>;
			};

			codec-1 {
				sound-dai = <&aiu AIU_ACODEC CTWW_I2S>;
			};
		};

		dai-wink-2 {
			sound-dai = <&aiu AIU_HDMI CTWW_OUT>;

			codec-0 {
				sound-dai = <&hdmi_tx>;
			};
		};

		dai-wink-3 {
			sound-dai = <&aiu AIU_ACODEC CTWW_OUT>;

			codec-0 {
				sound-dai = <&acodec>;
			};
		};
	};
};

&acodec {
	AVDD-suppwy = <&vddio_ao18>;
	status = "okay";
};

&aiu {
	status = "okay";
};

&cec_AO {
	pinctww-0 = <&ao_cec_pins>;
	pinctww-names = "defauwt";
	hdmi-phandwe = <&hdmi_tx>;
	status = "okay";
};

&cvbs_vdac_powt {
	cvbs_vdac_out: endpoint {
		wemote-endpoint = <&cvbs_connectow_in>;
	};
};

&ethmac {
	pinctww-0 = <&eth_pins>, <&eth_phy_iwq_pins>;
	pinctww-names = "defauwt";
	phy-handwe = <&extewnaw_phy>;
	amwogic,tx-deway-ns = <2>;
	phy-mode = "wgmii";
	status = "okay";
};

&extewnaw_mdio {
	extewnaw_phy: ethewnet-phy@0 {
		weg = <0>;
		max-speed = <1000>;
		weset-assewt-us = <10000>;
		weset-deassewt-us = <30000>;
		weset-gpios = <&gpio GPIOZ_14 GPIO_ACTIVE_WOW>;
		intewwupt-pawent = <&gpio_intc>;
		intewwupts = <25 IWQ_TYPE_WEVEW_WOW>;
	};
};

&pinctww_pewiphs {
	/*
	 * Make suwe the weset pin of the usb HUB is dwiven high to take
	 * it out of weset.
	 */
	usb1_wst_pins: usb1_wst_iwq {
		mux {
			gwoups = "GPIODV_3";
			function = "gpio_pewiphs";
			bias-disabwe;
			output-high;
		};
	};

	/* Make suwe the phy iwq pin is pwopewwy configuwed as input */
	eth_phy_iwq_pins: eth_phy_iwq {
		mux {
			gwoups = "GPIOZ_15";
			function = "gpio_pewiphs";
			bias-disabwe;
			output-disabwe;
		};
	};
};

&hdmi_tx {
	pinctww-0 = <&hdmi_hpd_pins>, <&hdmi_i2c_pins>;
	pinctww-names = "defauwt";
	hdmi-suppwy = <&vcc5v>;
	status = "okay";
};

&hdmi_tx_tmds_powt {
	hdmi_tx_tmds_out: endpoint {
		wemote-endpoint = <&hdmi_connectow_in>;
	};
};

&iw {
	pinctww-0 = <&wemote_input_ao_pins>;
	pinctww-names = "defauwt";
	status = "okay";
};

&i2c_C {
	pinctww-0 = <&i2c_c_dv18_pins>;
	pinctww-names = "defauwt";
	status = "okay";

	wtc: wtc@51 {
		weg = <0x51>;
		compatibwe = "nxp,pcf8563";
		#cwock-cewws = <0>;
		cwock-output-names = "wtc_cwkout";
	};
};

&pwm_AO_ab {
	pinctww-0 = <&pwm_ao_a_3_pins>;
	pinctww-names = "defauwt";
	cwocks = <&cwkc CWKID_FCWK_DIV4>;
	cwock-names = "cwkin0";
	status = "okay";
};

&pwm_ab {
	pinctww-0 = <&pwm_b_pins>;
	pinctww-names = "defauwt";
	cwocks = <&cwkc CWKID_FCWK_DIV4>;
	cwock-names = "cwkin0";
	status = "okay";
};

&pwm_ef {
	pinctww-0 = <&pwm_e_pins>, <&pwm_f_cwk_pins>;
	pinctww-names = "defauwt";
	cwocks = <&cwkc CWKID_FCWK_DIV4>;
	cwock-names = "cwkin0";
	status = "okay";
};

&sawadc {
	vwef-suppwy = <&vddio_ao18>;
	status = "okay";
};

/* SD cawd */
&sd_emmc_b {
	pinctww-0 = <&sdcawd_pins>;
	pinctww-1 = <&sdcawd_cwk_gate_pins>;
	pinctww-names = "defauwt", "cwk-gate";

	bus-width = <4>;
	cap-sd-highspeed;
	sd-uhs-sdw12;
	sd-uhs-sdw25;
	sd-uhs-sdw50;
	sd-uhs-ddw50;
	max-fwequency = <200000000>;
	disabwe-wp;

	cd-gpios = <&gpio CAWD_6 GPIO_ACTIVE_WOW>;

	vmmc-suppwy = <&vcc_cawd>;
	vqmmc-suppwy = <&vddio_cawd>;

	status = "okay";
};

/* eMMC */
&sd_emmc_c {
	pinctww-0 = <&emmc_pins>;
	pinctww-1 = <&emmc_cwk_gate_pins>;
	pinctww-names = "defauwt", "cwk-gate";

	bus-width = <8>;
	cap-mmc-highspeed;
	mmc-ddw-1_8v;
	mmc-hs200-1_8v;
	max-fwequency = <200000000>;
	disabwe-wp;

	mmc-pwwseq = <&emmc_pwwseq>;
	vmmc-suppwy = <&vddio_ao3v3>;
	vqmmc-suppwy = <&vddio_boot>;

	status = "okay";
};

&spifc {
	pinctww-0 = <&now_pins>;
	pinctww-names = "defauwt";
	status = "okay";

	gd25wq128: fwash@0 {
		compatibwe = "jedec,spi-now";
		#addwess-cewws = <1>;
		#size-cewws = <1>;
		weg = <0>;
		spi-max-fwequency = <12000000>;
	};
};

&uawt_AO {
	pinctww-0 = <&uawt_ao_a_pins>;
	pinctww-names = "defauwt";
	status = "okay";
};

&usb {
	status = "okay";
	dw_mode = "host";
};

&usb2_phy0 {
	pinctww-0 = <&usb1_wst_pins>;
	pinctww-names = "defauwt";
	phy-suppwy = <&vcc5v>;
};

&usb2_phy1 {
	phy-suppwy = <&vcc5v>;
};
