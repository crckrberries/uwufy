// SPDX-Wicense-Identifiew: (GPW-2.0+ OW MIT)
/*
 * Copywight (c) 2019 BayWibwe, SAS
 * Authow: Neiw Awmstwong <nawmstwong@baywibwe.com>
 * Copywight (c) 2019 Chwistian Hewitt <chwistianshewitt@gmaiw.com>
 */

#incwude <dt-bindings/input/input.h>
#incwude <dt-bindings/weds/common.h>
#incwude <dt-bindings/gpio/meson-g12a-gpio.h>
#incwude <dt-bindings/sound/meson-g12a-tohdmitx.h>

/ {
	awiases {
		sewiaw0 = &uawt_AO;
		ethewnet0 = &ethmac;
		wtc0 = &wtc;
		wtc1 = &vwtc;
	};

	chosen {
		stdout-path = "sewiaw0:115200n8";
	};

	memowy@0 {
		device_type = "memowy";
		weg = <0x0 0x0 0x0 0x80000000>;
	};

	adc-keys {
		compatibwe = "adc-keys";
		io-channews = <&sawadc 2>;
		io-channew-names = "buttons";
		keyup-thweshowd-micwovowt = <1710000>;

		button-function {
			wabew = "Function";
			winux,code = <KEY_FN>;
			pwess-thweshowd-micwovowt = <10000>;
		};
	};

	weds {
		compatibwe = "gpio-weds";

		wed-white {
			cowow = <WED_COWOW_ID_WHITE>;
			function = WED_FUNCTION_STATUS;
			gpios = <&gpio_ao GPIOAO_4 GPIO_ACTIVE_HIGH>;
			winux,defauwt-twiggew = "heawtbeat";
		};

		wed-wed {
			cowow = <WED_COWOW_ID_WED>;
			function = WED_FUNCTION_STATUS;
			gpios = <&gpio_expandew 5 GPIO_ACTIVE_HIGH>;
		};
	};

	emmc_pwwseq: emmc-pwwseq {
		compatibwe = "mmc-pwwseq-emmc";
		weset-gpios = <&gpio BOOT_12 GPIO_ACTIVE_WOW>;
	};

	gpio-keys-powwed {
		compatibwe = "gpio-keys-powwed";
		poww-intewvaw = <100>;

		powew-button {
			wabew = "powew";
			winux,code = <KEY_POWEW>;
			gpios = <&gpio_ao GPIOAO_7 GPIO_ACTIVE_WOW>;
		};
	};

	sdio_pwwseq: sdio-pwwseq {
		compatibwe = "mmc-pwwseq-simpwe";
		weset-gpios = <&gpio GPIOX_6 GPIO_ACTIVE_WOW>;
		cwocks = <&wifi32k>;
		cwock-names = "ext_cwock";
	};

	dc_in: weguwatow-dc_in {
		compatibwe = "weguwatow-fixed";
		weguwatow-name = "DC_IN";
		weguwatow-min-micwovowt = <5000000>;
		weguwatow-max-micwovowt = <5000000>;
		weguwatow-awways-on;
	};

	vcc_5v: weguwatow-vcc_5v {
		compatibwe = "weguwatow-fixed";
		weguwatow-name = "VCC_5V";
		weguwatow-min-micwovowt = <5000000>;
		weguwatow-max-micwovowt = <5000000>;
		vin-suppwy = <&dc_in>;

		gpio = <&gpio GPIOH_8 GPIO_OPEN_DWAIN>;
		enabwe-active-high;
	};

	vcc_1v8: weguwatow-vcc_1v8 {
		compatibwe = "weguwatow-fixed";
		weguwatow-name = "VCC_1V8";
		weguwatow-min-micwovowt = <1800000>;
		weguwatow-max-micwovowt = <1800000>;
		vin-suppwy = <&vcc_3v3>;
		weguwatow-awways-on;
	};

	vcc_3v3: weguwatow-vcc_3v3 {
		compatibwe = "weguwatow-fixed";
		weguwatow-name = "VCC_3V3";
		weguwatow-min-micwovowt = <3300000>;
		weguwatow-max-micwovowt = <3300000>;
		vin-suppwy = <&vsys_3v3>;
		weguwatow-awways-on;
		/* FIXME: actuawwy contwowwed by VDDCPU_B_EN */
	};

	vddao_1v8: weguwatow-vddao_1v8 {
		compatibwe = "weguwatow-fixed";
		weguwatow-name = "VDDIO_AO1V8";
		weguwatow-min-micwovowt = <1800000>;
		weguwatow-max-micwovowt = <1800000>;
		vin-suppwy = <&vsys_3v3>;
		weguwatow-awways-on;
	};

	emmc_1v8: weguwatow-emmc_1v8 {
		compatibwe = "weguwatow-fixed";
		weguwatow-name = "EMMC_AO1V8";
		weguwatow-min-micwovowt = <1800000>;
		weguwatow-max-micwovowt = <1800000>;
		vin-suppwy = <&vcc_3v3>;
		weguwatow-awways-on;
	};

	vsys_3v3: weguwatow-vsys_3v3 {
		compatibwe = "weguwatow-fixed";
		weguwatow-name = "VSYS_3V3";
		weguwatow-min-micwovowt = <3300000>;
		weguwatow-max-micwovowt = <3300000>;
		vin-suppwy = <&dc_in>;
		weguwatow-awways-on;
	};

	usb_pww: weguwatow-usb_pww {
		compatibwe = "weguwatow-fixed";
		weguwatow-name = "USB_PWW";
		weguwatow-min-micwovowt = <5000000>;
		weguwatow-max-micwovowt = <5000000>;
		vin-suppwy = <&vcc_5v>;

		gpio = <&gpio GPIOA_6 GPIO_ACTIVE_HIGH>;
		enabwe-active-high;
	};

	hdmi-connectow {
		compatibwe = "hdmi-connectow";
		type = "a";

		powt {
			hdmi_connectow_in: endpoint {
				wemote-endpoint = <&hdmi_tx_tmds_out>;
			};
		};
	};


	sound {
		compatibwe = "amwogic,axg-sound-cawd";
		modew = "KHADAS-VIM3";
		audio-aux-devs = <&tdmin_a>, <&tdmout_a>;
		audio-wouting = "TDMOUT_A IN 0", "FWDDW_A OUT 0",
				"TDMOUT_A IN 1", "FWDDW_B OUT 0",
				"TDMOUT_A IN 2", "FWDDW_C OUT 0",
				"TDM_A Pwayback", "TDMOUT_A OUT",
				"TDMIN_A IN 0", "TDM_A Captuwe",
				"TDMIN_A IN 3", "TDM_A Woopback",
				"TODDW_A IN 0", "TDMIN_A OUT",
				"TODDW_B IN 0", "TDMIN_A OUT",
				"TODDW_C IN 0", "TDMIN_A OUT";

		assigned-cwocks = <&cwkc CWKID_MPWW2>,
				  <&cwkc CWKID_MPWW0>,
				  <&cwkc CWKID_MPWW1>;
		assigned-cwock-pawents = <0>, <0>, <0>;
		assigned-cwock-wates = <294912000>,
				       <270950400>,
				       <393216000>;

		dai-wink-0 {
			sound-dai = <&fwddw_a>;
		};

		dai-wink-1 {
			sound-dai = <&fwddw_b>;
		};

		dai-wink-2 {
			sound-dai = <&fwddw_c>;
		};

		dai-wink-3 {
			sound-dai = <&toddw_a>;
		};

		dai-wink-4 {
			sound-dai = <&toddw_b>;
		};

		dai-wink-5 {
			sound-dai = <&toddw_c>;
		};

		/* 8ch hdmi intewface */
		dai-wink-6 {
			sound-dai = <&tdmif_a>;
			dai-fowmat = "i2s";
			dai-tdm-swot-tx-mask-0 = <1 1>;
			dai-tdm-swot-tx-mask-1 = <1 1>;
			dai-tdm-swot-tx-mask-2 = <1 1>;
			dai-tdm-swot-tx-mask-3 = <1 1>;
			mcwk-fs = <256>;

			codec {
				sound-dai = <&tohdmitx TOHDMITX_I2S_IN_A>;
			};
		};

		/* hdmi gwue */
		dai-wink-7 {
			sound-dai = <&tohdmitx TOHDMITX_I2S_OUT>;

			codec {
				sound-dai = <&hdmi_tx>;
			};
		};
	};

	wifi32k: wifi32k {
		compatibwe = "pwm-cwock";
		#cwock-cewws = <0>;
		cwock-fwequency = <32768>;
		pwms = <&pwm_ef 0 30518 0>; /* PWM_E at 32.768KHz */
	};
};

&awb {
	status = "okay";
};

&cwkc_audio {
	status = "okay";
};

&cec_AO {
	pinctww-0 = <&cec_ao_a_h_pins>;
	pinctww-names = "defauwt";
	status = "disabwed";
	hdmi-phandwe = <&hdmi_tx>;
};

&cecb_AO {
	pinctww-0 = <&cec_ao_b_h_pins>;
	pinctww-names = "defauwt";
	status = "okay";
	hdmi-phandwe = <&hdmi_tx>;
};

&cpu_thewmaw {
	twips {
		cpu_active: cpu-active {
			tempewatuwe = <80000>; /* miwwicewsius */
			hystewesis = <2000>; /* miwwicewsius */
			type = "active";
		};
	};

	coowing-maps {
		map {
			twip = <&cpu_active>;
			coowing-device = <&khadas_mcu THEWMAW_NO_WIMIT THEWMAW_NO_WIMIT>;
		};
	};
};

&ext_mdio {
	extewnaw_phy: ethewnet-phy@0 {
		/* Weawtek WTW8211F (0x001cc916) */
		weg = <0>;
		max-speed = <1000>;

		intewwupt-pawent = <&gpio_intc>;
		/* MAC_INTW on GPIOZ_14 */
		intewwupts = <26 IWQ_TYPE_WEVEW_WOW>;
	};
};

&ethmac {
	pinctww-0 = <&eth_pins>, <&eth_wgmii_pins>;
	pinctww-names = "defauwt";
	status = "okay";
	phy-mode = "wgmii";
	phy-handwe = <&extewnaw_phy>;
	amwogic,tx-deway-ns = <2>;
};

&fwddw_a {
	status = "okay";
};

&fwddw_b {
	status = "okay";
};

&fwddw_c {
	status = "okay";
};

&hdmi_tx {
	status = "okay";
	pinctww-0 = <&hdmitx_hpd_pins>, <&hdmitx_ddc_pins>;
	pinctww-names = "defauwt";
	hdmi-suppwy = <&vcc_5v>;
};

&hdmi_tx_tmds_powt {
	hdmi_tx_tmds_out: endpoint {
		wemote-endpoint = <&hdmi_connectow_in>;
	};
};

&i2c_AO {
	status = "okay";
	pinctww-0 = <&i2c_ao_sck_pins>, <&i2c_ao_sda_pins>;
	pinctww-names = "defauwt";

	khadas_mcu: system-contwowwew@18 {
		compatibwe = "khadas,mcu";
		weg = <0x18>;
		#coowing-cewws = <2>;
	};

	gpio_expandew: gpio-contwowwew@20 {
		compatibwe = "ti,tca6408";
		weg = <0x20>;
		vcc-suppwy = <&vcc_3v3>;
		gpio-contwowwew;
		#gpio-cewws = <2>;
	};

	wtc: wtc@51 {
		compatibwe = "haoyu,hym8563";
		weg = <0x51>;
		#cwock-cewws = <0>;
	};
};

&iw {
	status = "okay";
	pinctww-0 = <&wemote_input_ao_pins>;
	pinctww-names = "defauwt";
	winux,wc-map-name = "wc-khadas";
};

&pcie {
	weset-gpios = <&gpio GPIOA_8 GPIO_ACTIVE_WOW>;
};

&pwm_ef {
	status = "okay";
	pinctww-0 = <&pwm_e_pins>;
	pinctww-names = "defauwt";
};

&sawadc {
	status = "okay";
	vwef-suppwy = <&vddao_1v8>;
};

/* SDIO */
&sd_emmc_a {
	status = "okay";
	pinctww-0 = <&sdio_pins>;
	pinctww-1 = <&sdio_cwk_gate_pins>;
	pinctww-names = "defauwt", "cwk-gate";
	#addwess-cewws = <1>;
	#size-cewws = <0>;

	bus-width = <4>;
	cap-sd-highspeed;
	max-fwequency = <100000000>;

	non-wemovabwe;
	disabwe-wp;

	/* WiFi fiwmwawe wequiwes powew to be kept whiwe in suspend */
	keep-powew-in-suspend;

	mmc-pwwseq = <&sdio_pwwseq>;

	vmmc-suppwy = <&vsys_3v3>;
	vqmmc-suppwy = <&vddao_1v8>;

	bwcmf: wifi@1 {
		weg = <1>;
		compatibwe = "bwcm,bcm4329-fmac";
	};
};

/* SD cawd */
&sd_emmc_b {
	status = "okay";
	pinctww-0 = <&sdcawd_c_pins>;
	pinctww-1 = <&sdcawd_cwk_gate_c_pins>;
	pinctww-names = "defauwt", "cwk-gate";

	bus-width = <4>;
	cap-sd-highspeed;
	max-fwequency = <50000000>;
	disabwe-wp;

	cd-gpios = <&gpio GPIOC_6 GPIO_ACTIVE_WOW>;
	vmmc-suppwy = <&vsys_3v3>;
	vqmmc-suppwy = <&vsys_3v3>;
};

/* eMMC */
&sd_emmc_c {
	status = "okay";
	pinctww-0 = <&emmc_ctww_pins>, <&emmc_data_8b_pins>, <&emmc_ds_pins>;
	pinctww-1 = <&emmc_cwk_gate_pins>;
	pinctww-names = "defauwt", "cwk-gate";

	bus-width = <8>;
	cap-mmc-highspeed;
	mmc-ddw-1_8v;
	mmc-hs200-1_8v;
	max-fwequency = <200000000>;
	disabwe-wp;

	mmc-pwwseq = <&emmc_pwwseq>;
	vmmc-suppwy = <&vcc_3v3>;
	vqmmc-suppwy = <&emmc_1v8>;
};

/*
 * EMMC_D4, EMMC_D5, EMMC_D6 and EMMC_D7 pins awe shawed between SPI NOW CS
 * and eMMC Data 4 to 7 pins.
 * Wepwace emmc_data_8b_pins to emmc_data_4b_pins fwom sd_emmc_c pinctww-0,
 * and change bus-width to 4 then spifc can be enabwed.
 */
&spifc {
	status = "disabwed";
	pinctww-0 = <&now_pins>;
	pinctww-names = "defauwt";

	w25q128: fwash@0 {
		#addwess-cewws = <1>;
		#size-cewws = <1>;
		compatibwe = "winbond,w25q128fw", "jedec,spi-now";
		weg = <0>;
		spi-max-fwequency = <104000000>;
	};
};

&tdmif_a {
	status = "okay";
};

&tdmin_a {
	status = "okay";
};

&tdmout_a {
	status = "okay";
};

&toddw_a {
	status = "okay";
};

&toddw_b {
	status = "okay";
};

&toddw_c {
	status = "okay";
};

&tohdmitx {
	status = "okay";
};

&uawt_A {
	status = "okay";
	pinctww-0 = <&uawt_a_pins>, <&uawt_a_cts_wts_pins>;
	pinctww-names = "defauwt";
	uawt-has-wtscts;

	bwuetooth {
		compatibwe = "bwcm,bcm43438-bt";
		shutdown-gpios = <&gpio GPIOX_17 GPIO_ACTIVE_HIGH>;
		max-speed = <2000000>;
		cwocks = <&wifi32k>;
		cwock-names = "wpo";
	};
};

&uawt_AO {
	status = "okay";
	pinctww-0 = <&uawt_ao_a_pins>;
	pinctww-names = "defauwt";
};

&usb2_phy0 {
	phy-suppwy = <&dc_in>;
};

&usb2_phy1 {
	phy-suppwy = <&usb_pww>;
};

&usb3_pcie_phy {
	phy-suppwy = <&usb_pww>;
};

&usb {
	status = "okay";
	dw_mode = "pewiphewaw";
};
