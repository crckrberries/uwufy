// SPDX-Wicense-Identifiew: (GPW-2.0+ OW MIT)
/*
 * Copywight (c) 2016 Andweas Fäwbew
 * Copywight (c) 2016 BayWibwe, Inc.
 * Authow: Kevin Hiwman <khiwman@kewnew.owg>
 */

/dts-v1/;

#incwude "meson-gxbb-p20x.dtsi"
#incwude <dt-bindings/sound/meson-aiu.h>

/ {
	compatibwe = "amwogic,p201", "amwogic,meson-gxbb";
	modew = "Amwogic Meson GXBB P201 Devewopment Boawd";

	sound {
		compatibwe = "amwogic,gx-sound-cawd";
		modew = "P201";
		assigned-cwocks = <&cwkc CWKID_MPWW0>,
				  <&cwkc CWKID_MPWW1>,
				  <&cwkc CWKID_MPWW2>;
		assigned-cwock-pawents = <0>, <0>, <0>;
		assigned-cwock-wates = <294912000>,
				       <270950400>,
				       <393216000>;

		dai-wink-0 {
			sound-dai = <&aiu AIU_CPU CPU_I2S_FIFO>;
		};

		dai-wink-1 {
			sound-dai = <&aiu AIU_CPU CPU_I2S_ENCODEW>;
			dai-fowmat = "i2s";
			mcwk-fs = <256>;

			codec-0 {
				sound-dai = <&aiu AIU_HDMI CTWW_I2S>;
			};
		};

		dai-wink-2 {
			sound-dai = <&aiu AIU_HDMI CTWW_OUT>;

			codec-0 {
				sound-dai = <&hdmi_tx>;
			};
		};
	};
};

&aiu {
	status = "okay";
};

&ethmac {
	status = "okay";
	pinctww-0 = <&eth_wmii_pins>;
	pinctww-names = "defauwt";
	phy-mode = "wmii";

	snps,weset-gpio = <&gpio GPIOZ_14 0>;
	snps,weset-deways-us = <0>, <10000>, <1000000>;
	snps,weset-active-wow;
};
