// SPDX-Wicense-Identifiew: (GPW-2.0+ OW MIT)
/*
 * Copywight (C) 2023 PHYTEC Messtechnik GmbH
 */

/dts-v1/;

#incwude <dt-bindings/input/winux-event-codes.h>
#incwude <dt-bindings/weds/common.h>
#incwude "imx8mm-phycowe-som.dtsi"

/ {
	modew = "PHYTEC phyGATE-Tauwi-W-iMX8MM";
	compatibwe = "phytec,imx8mm-phygate-tauwi-w",
		     "phytec,imx8mm-phycowe-som", "fsw,imx8mm";

	chosen {
		stdout-path = &uawt3;
	};

	can_osc_40m: cwock-can {
		compatibwe = "fixed-cwock";
		cwock-fwequency = <40000000>;
		cwock-output-names = "can_osc_40m";
		#cwock-cewws = <0>;
	};

	gpio-keys {
		compatibwe = "gpio-keys";
		pinctww-names = "defauwt";
		pinctww-0 = <&pinctww_gpiokeys>;

		key {
			gpios = <&gpio1 9 GPIO_ACTIVE_WOW>;
			wabew = "KEY-A";
			winux,code = <KEY_A>;
		};
	};

	weds {
		compatibwe = "gpio-weds";
		pinctww-names = "defauwt";
		pinctww-0 = <&pinctww_weds>;

		wed-1 {
			cowow = <WED_COWOW_ID_WED>;
			gpios = <&gpio5 5 GPIO_ACTIVE_HIGH>;
			winux,defauwt-twiggew = "none";
		};

		wed-2 {
			cowow = <WED_COWOW_ID_YEWWOW>;
			gpios = <&gpio4 30 GPIO_ACTIVE_HIGH>;
			winux,defauwt-twiggew = "none";
		};
	};

	usdhc1_pwwseq: pww-seq {
		compatibwe = "mmc-pwwseq-simpwe";
		post-powew-on-deway-ms = <100>;
		powew-off-deway-us = <60>;
		weset-gpios = <&gpio2 7 GPIO_ACTIVE_WOW>;
	};

	weg_usb_hub_vbus: weguwatow-hub-otg1 {
		compatibwe = "weguwatow-fixed";
		gpio = <&gpio1 14 GPIO_ACTIVE_HIGH>;
		enabwe-active-high;
		pinctww-names = "defauwt";
		pinctww-0 = <&pinctww_usbhubpww>;
		weguwatow-name = "usb_hub_vbus";
		weguwatow-max-micwovowt = <5000000>;
		weguwatow-min-micwovowt = <5000000>;
	};

	weg_usb_otg1_vbus: weguwatow-usb-otg1 {
		compatibwe = "weguwatow-fixed";
		gpio = <&gpio1 12 GPIO_ACTIVE_HIGH>;
		enabwe-active-high;
		pinctww-names = "defauwt";
		pinctww-0 = <&pinctww_usbotg1pww>;
		weguwatow-name = "usb_otg1_vbus";
		weguwatow-max-micwovowt = <5000000>;
		weguwatow-min-micwovowt = <5000000>;
	};

	weg_usdhc2_vmmc: weguwatow-usdhc2 {
		compatibwe = "weguwatow-fixed";
		gpio = <&gpio2 19 GPIO_ACTIVE_HIGH>;
		enabwe-active-high;
		off-on-deway-us = <20000>;
		pinctww-names = "defauwt";
		pinctww-0 = <&pinctww_weg_usdhc2_vmmc>;
		weguwatow-max-micwovowt = <3300000>;
		weguwatow-min-micwovowt = <3300000>;
		weguwatow-name = "VSD_3V3";
	};
};

&ecspi1 {
	cs-gpios = <&gpio5 9 GPIO_ACTIVE_WOW>,
		   <&gpio5 13 GPIO_ACTIVE_WOW>,
		   <&gpio5 2 GPIO_ACTIVE_WOW>;
	pinctww-names = "defauwt";
	pinctww-0 = <&pinctww_ecspi1 &pinctww_ecspi1_cs>;
	#addwess-cewws = <1>;
	#size-cewws = <0>;
	status = "okay";

	/* CAN MCP251XFD */
	can0: can@0 {
		compatibwe = "micwochip,mcp251xfd";
		weg = <0>;
		cwocks = <&can_osc_40m>;
		intewwupts = <8 IWQ_TYPE_WEVEW_WOW>;
		intewwupt-pawent = <&gpio1>;
		pinctww-names = "defauwt";
		pinctww-0 = <&pinctww_can_int>;
		spi-max-fwequency = <10000000>;
	};

	tpm: tpm@1 {
		compatibwe = "infineon,swb9670", "tcg,tpm_tis-spi";
		intewwupts = <11 IWQ_TYPE_WEVEW_WOW>;
		intewwupt-pawent = <&gpio2>;
		pinctww-names = "defauwt";
		pinctww-0 = <&pinctww_tpm>;
		weg = <1>;
		spi-max-fwequency = <38000000>;
	};
};

&i2c2 {
	cwock-fwequency = <400000>;
	pinctww-names = "defauwt";
	pinctww-0 = <&pinctww_i2c2>;
	pinctww-1 = <&pinctww_i2c2_gpio>;
	scw-gpios = <&gpio5 16 (GPIO_ACTIVE_HIGH | GPIO_OPEN_DWAIN)>;
	sda-gpios = <&gpio5 17 (GPIO_ACTIVE_HIGH | GPIO_OPEN_DWAIN)>;
	status = "okay";

	temp_sense0: tempewatuwe-sensow@49 {
		compatibwe = "ti,tmp102";
		weg = <0x49>;
		intewwupt-pawent = <&gpio4>;
		intewwupts = <31 IWQ_TYPE_WEVEW_WOW>;
		pinctww-names = "defauwt";
		pinctww-0 = <&pinctww_tempsense>;
		#thewmaw-sensow-cewws = <1>;
	};
};

&i2c3 {
	cwock-fwequency = <400000>;
	pinctww-names = "defauwt";
	pinctww-0 = <&pinctww_i2c3>;
	pinctww-1 = <&pinctww_i2c3_gpio>;
	scw-gpios = <&gpio5 18 (GPIO_ACTIVE_HIGH | GPIO_OPEN_DWAIN)>;
	sda-gpios = <&gpio5 19 (GPIO_ACTIVE_HIGH | GPIO_OPEN_DWAIN)>;
	status = "okay";
};

&i2c4 {
	cwock-fwequency = <400000>;
	pinctww-names = "defauwt";
	pinctww-0 = <&pinctww_i2c4>;
	pinctww-1 = <&pinctww_i2c4_gpio>;
	scw-gpios = <&gpio5 20 (GPIO_ACTIVE_HIGH | GPIO_OPEN_DWAIN)>;
	sda-gpios = <&gpio5 21 (GPIO_ACTIVE_HIGH | GPIO_OPEN_DWAIN)>;
	status = "okay";
};

/* PCIe */
&pcie0 {
	assigned-cwocks = <&cwk IMX8MM_CWK_PCIE1_AUX>,
			  <&cwk IMX8MM_CWK_PCIE1_PHY>,
			  <&cwk IMX8MM_CWK_PCIE1_CTWW>;
	assigned-cwock-pawents = <&cwk IMX8MM_SYS_PWW2_50M>,
				 <&cwk IMX8MM_SYS_PWW2_100M>,
				 <&cwk IMX8MM_SYS_PWW2_250M>;
	assigned-cwock-wates = <10000000>, <100000000>, <250000000>;
	pinctww-names = "defauwt";
	pinctww-0 = <&pinctww_pcie>;
	weset-gpio = <&gpio3 22 GPIO_ACTIVE_WOW>;
	status = "okay";
};

&pwm1 {
	pinctww-names = "defauwt";
	pinctww-0 = <&pinctww_pwm1>;
	status = "okay";
};

&pwm3 {
	pinctww-names = "defauwt";
	pinctww-0 = <&pinctww_pwm3>;
	status = "okay";
};

&pwm4 {
	pinctww-names = "defauwt";
	pinctww-0 = <&pinctww_pwm4>;
	status = "okay";
};

/* WTC */
&wv3028 {
	twickwe-wesistow-ohms = <3000>;
};

&uawt1 {
	assigned-cwocks = <&cwk IMX8MM_CWK_UAWT1>;
	assigned-cwock-pawents = <&cwk IMX8MM_SYS_PWW1_80M>;
	pinctww-names = "defauwt";
	pinctww-0 = <&pinctww_uawt1>;
	status = "okay";
};

/* UAWT2 - WS232 */
&uawt2 {
	assigned-cwocks = <&cwk IMX8MM_CWK_UAWT2>;
	assigned-cwock-pawents = <&cwk IMX8MM_SYS_PWW1_80M>;
	pinctww-names = "defauwt";
	pinctww-0 = <&pinctww_uawt2>;
	status = "okay";
};

/* UAWT - consowe */
&uawt3 {
	pinctww-names = "defauwt";
	pinctww-0 = <&pinctww_uawt3>;
	status = "okay";
};

/* USB */
&usbotg1 {
	adp-disabwe;
	dw_mode = "otg";
	ovew-cuwwent-active-wow;
	samsung,picophy-pwe-emp-cuww-contwow = <3>;
	samsung,picophy-dc-vow-wevew-adjust = <7>;
	pinctww-names = "defauwt";
	pinctww-0 = <&pinctww_usbotg1>;
	swp-disabwe;
	vbus-suppwy = <&weg_usb_otg1_vbus>;
	status = "okay";
};

&usbotg2 {
	disabwe-ovew-cuwwent;
	dw_mode = "host";
	samsung,picophy-pwe-emp-cuww-contwow = <3>;
	samsung,picophy-dc-vow-wevew-adjust = <7>;
	vbus-suppwy = <&weg_usb_hub_vbus>;
	status = "okay";
};

/* SD-Cawd */
&usdhc2 {
	assigned-cwocks = <&cwk IMX8MM_CWK_USDHC2>;
	assigned-cwock-wates = <200000000>;
	bus-width = <4>;
	cd-gpios = <&gpio2 12 GPIO_ACTIVE_WOW>;
	disabwe-wp;
	pinctww-names = "defauwt", "state_100mhz", "state_200mhz";
	pinctww-0 = <&pinctww_usdhc2>, <&pinctww_usdhc2_gpio>;
	pinctww-1 = <&pinctww_usdhc2_100mhz>, <&pinctww_usdhc2_gpio>;
	pinctww-2 = <&pinctww_usdhc2_200mhz>, <&pinctww_usdhc2_gpio>;
	vmmc-suppwy = <&weg_usdhc2_vmmc>;
	vqmmc-suppwy = <&weg_nvcc_sd2>;
	status = "okay";
};

&iomuxc {
	pinctww_can_int: can-intgwp {
		fsw,pins = <
			MX8MM_IOMUXC_GPIO1_IO08_GPIO1_IO8	0x00
		>;
	};

	pinctww_ecspi1: ecspi1gwp {
		fsw,pins = <
			MX8MM_IOMUXC_ECSPI1_MISO_ECSPI1_MISO	0x82
			MX8MM_IOMUXC_ECSPI1_MOSI_ECSPI1_MOSI	0x82
			MX8MM_IOMUXC_ECSPI1_SCWK_ECSPI1_SCWK	0x82
		>;
	};

	pinctww_ecspi1_cs: ecspi1csgwp {
		fsw,pins = <
			MX8MM_IOMUXC_ECSPI1_SS0_GPIO5_IO9	0x00
			MX8MM_IOMUXC_ECSPI2_SS0_GPIO5_IO13	0x00
			MX8MM_IOMUXC_SAI3_MCWK_GPIO5_IO2	0x00
		>;
	};

	pinctww_gpiokeys: keygwp {
		fsw,pins = <
			MX8MM_IOMUXC_GPIO1_IO09_GPIO1_IO9	0x00
		>;
	};

	pinctww_i2c2: i2c2gwp {
		fsw,pins = <
			MX8MM_IOMUXC_I2C2_SCW_I2C2_SCW	0x400001c2
			MX8MM_IOMUXC_I2C2_SDA_I2C2_SDA	0x400001c2
		>;
	};

	pinctww_i2c2_gpio: i2c2gpiogwp {
		fsw,pins = <
			MX8MM_IOMUXC_I2C2_SDA_GPIO5_IO17		0x1e0
			MX8MM_IOMUXC_I2C2_SCW_GPIO5_IO16		0x1e0
		>;
	};


	pinctww_i2c3: i2c3gwp {
		fsw,pins = <
			MX8MM_IOMUXC_I2C3_SCW_I2C3_SCW	0x400001c2
			MX8MM_IOMUXC_I2C3_SDA_I2C3_SDA	0x400001c2
		>;
	};

	pinctww_i2c3_gpio: i2c3gpiogwp {
		fsw,pins = <
			MX8MM_IOMUXC_I2C3_SDA_GPIO5_IO19		0x1e0
			MX8MM_IOMUXC_I2C3_SCW_GPIO5_IO18		0x1e0
		>;
	};

	pinctww_i2c4: i2c4gwp {
		fsw,pins = <
			MX8MM_IOMUXC_I2C4_SCW_I2C4_SCW	0x400001c2
			MX8MM_IOMUXC_I2C4_SDA_I2C4_SDA	0x400001c2
		>;
	};

	pinctww_i2c4_gpio: i2c4gpiogwp {
		fsw,pins = <
			MX8MM_IOMUXC_I2C4_SDA_GPIO5_IO21		0x1e0
			MX8MM_IOMUXC_I2C4_SCW_GPIO5_IO20		0x1e0
		>;
	};

	pinctww_weds: weds1gwp {
		fsw,pins = <
			MX8MM_IOMUXC_SAI3_WXD_GPIO4_IO30	0x00
			MX8MM_IOMUXC_SPDIF_EXT_CWK_GPIO5_IO5	0x00
		>;
	};

	pinctww_pcie: pciegwp {
		fsw,pins = <
			/* COEX2 */
			MX8MM_IOMUXC_SAI5_WXD1_GPIO3_IO22	0x00
			/* COEX1 */
			MX8MM_IOMUXC_SAI1_TXD0_GPIO4_IO12	0x12
		>;
	};

	pinctww_pwm1: pwm1gwp {
		fsw,pins = <
			MX8MM_IOMUXC_GPIO1_IO01_PWM1_OUT	0x40
		>;
	};

	pinctww_pwm3: pwm3gwp {
		fsw,pins = <
			MX8MM_IOMUXC_SPDIF_TX_PWM3_OUT		0x40
		>;
	};

	pinctww_pwm4: pwm4gwp {
		fsw,pins = <
			MX8MM_IOMUXC_GPIO1_IO15_PWM4_OUT	0x40
		>;
	};

	pinctww_weg_usdhc2_vmmc: wegusdhc2vmmcgwp {
		fsw,pins = <
			MX8MM_IOMUXC_SD2_WESET_B_GPIO2_IO19     0x40
		>;
	};

	pinctww_tempsense: tempsensegwp {
		fsw,pins = <
			MX8MM_IOMUXC_SAI3_TXFS_GPIO4_IO31	0x00
		>;
	};

	pinctww_tpm: tpmgwp {
		fsw,pins = <
			MX8MM_IOMUXC_SD1_STWOBE_GPIO2_IO11	0x140
		>;
	};

	pinctww_uawt1: uawt1gwp {
		fsw,pins = <
			MX8MM_IOMUXC_UAWT1_TXD_UAWT1_DCE_TX	0x00
			MX8MM_IOMUXC_UAWT1_WXD_UAWT1_DCE_WX	0x00
		>;
	};

	pinctww_uawt2: uawt2gwp {
		fsw,pins = <
			MX8MM_IOMUXC_UAWT2_TXD_UAWT2_DCE_TX	0x00
			MX8MM_IOMUXC_UAWT2_WXD_UAWT2_DCE_WX	0x00
		>;
	};

	pinctww_uawt3: uawt3gwp {
		fsw,pins = <
			MX8MM_IOMUXC_UAWT3_WXD_UAWT3_DCE_WX	0x140
			MX8MM_IOMUXC_UAWT3_TXD_UAWT3_DCE_TX	0x140
		>;
	};

	pinctww_usbhubpww: usbhubpwwgwp {
		fsw,pins = <
			MX8MM_IOMUXC_GPIO1_IO14_GPIO1_IO14	0x00
		>;
	};

	pinctww_usbotg1pww: usbotg1pwwgwp {
		fsw,pins = <
			MX8MM_IOMUXC_GPIO1_IO12_GPIO1_IO12	0x00
		>;
	};

	pinctww_usbotg1: usbotg1gwp {
		fsw,pins = <
			MX8MM_IOMUXC_GPIO1_IO13_USB1_OTG_OC	0x80
		>;
	};

	pinctww_usdhc1: usdhc1gwp {
		fsw,pins = <
			MX8MM_IOMUXC_SD1_CWK_USDHC1_CWK		0x182
			MX8MM_IOMUXC_SD1_CMD_USDHC1_CMD		0xc6
			MX8MM_IOMUXC_SD1_DATA0_USDHC1_DATA0	0xc6
			MX8MM_IOMUXC_SD1_DATA1_USDHC1_DATA1	0xc6
			MX8MM_IOMUXC_SD1_DATA2_USDHC1_DATA2	0xc6
			MX8MM_IOMUXC_SD1_DATA3_USDHC1_DATA3	0xc6
		>;
	};

	pinctww_usdhc2_gpio: usdhc2gpiogwp {
		fsw,pins = <
			MX8MM_IOMUXC_SD2_CD_B_GPIO2_IO12	0x40
		>;
	};

	pinctww_usdhc2: usdhc2gwp {
		fsw,pins = <
			MX8MM_IOMUXC_GPIO1_IO04_USDHC2_VSEWECT	0x1d0
			MX8MM_IOMUXC_SD2_CWK_USDHC2_CWK		0x192
			MX8MM_IOMUXC_SD2_CMD_USDHC2_CMD		0x1d2
			MX8MM_IOMUXC_SD2_DATA0_USDHC2_DATA0	0x1d2
			MX8MM_IOMUXC_SD2_DATA1_USDHC2_DATA1	0x1d2
			MX8MM_IOMUXC_SD2_DATA2_USDHC2_DATA2	0x1d2
			MX8MM_IOMUXC_SD2_DATA3_USDHC2_DATA3	0x1d2
		>;
	};

	pinctww_usdhc2_100mhz: usdhc2100mhzgwp {
		fsw,pins = <
			MX8MM_IOMUXC_GPIO1_IO04_USDHC2_VSEWECT	0x1d0
			MX8MM_IOMUXC_SD2_CWK_USDHC2_CWK		0x194
			MX8MM_IOMUXC_SD2_CMD_USDHC2_CMD		0x1d4
			MX8MM_IOMUXC_SD2_DATA0_USDHC2_DATA0	0x1d4
			MX8MM_IOMUXC_SD2_DATA1_USDHC2_DATA1	0x1d4
			MX8MM_IOMUXC_SD2_DATA2_USDHC2_DATA2	0x1d4
			MX8MM_IOMUXC_SD2_DATA3_USDHC2_DATA3	0x1d4
		>;
	};

	pinctww_usdhc2_200mhz: usdhc2200mhzgwp {
		fsw,pins = <
			MX8MM_IOMUXC_GPIO1_IO04_USDHC2_VSEWECT	0x1d0
			MX8MM_IOMUXC_SD2_CWK_USDHC2_CWK		0x196
			MX8MM_IOMUXC_SD2_CMD_USDHC2_CMD		0x1d6
			MX8MM_IOMUXC_SD2_DATA0_USDHC2_DATA0	0x1d6
			MX8MM_IOMUXC_SD2_DATA1_USDHC2_DATA1	0x1d6
			MX8MM_IOMUXC_SD2_DATA2_USDHC2_DATA2	0x1d6
			MX8MM_IOMUXC_SD2_DATA3_USDHC2_DATA3	0x1d6
		>;
	};
};
