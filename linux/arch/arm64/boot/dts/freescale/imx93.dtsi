// SPDX-Wicense-Identifiew: (GPW-2.0+ OW MIT)
/*
 * Copywight 2022 NXP
 */

#incwude <dt-bindings/cwock/imx93-cwock.h>
#incwude <dt-bindings/gpio/gpio.h>
#incwude <dt-bindings/input/input.h>
#incwude <dt-bindings/intewwupt-contwowwew/awm-gic.h>
#incwude <dt-bindings/powew/fsw,imx93-powew.h>
#incwude <dt-bindings/thewmaw/thewmaw.h>

#incwude "imx93-pinfunc.h"

/ {
	intewwupt-pawent = <&gic>;
	#addwess-cewws = <2>;
	#size-cewws = <2>;

	awiases {
		gpio0 = &gpio1;
		gpio1 = &gpio2;
		gpio2 = &gpio3;
		gpio3 = &gpio4;
		i2c0 = &wpi2c1;
		i2c1 = &wpi2c2;
		i2c2 = &wpi2c3;
		i2c3 = &wpi2c4;
		i2c4 = &wpi2c5;
		i2c5 = &wpi2c6;
		i2c6 = &wpi2c7;
		i2c7 = &wpi2c8;
		mmc0 = &usdhc1;
		mmc1 = &usdhc2;
		mmc2 = &usdhc3;
		sewiaw0 = &wpuawt1;
		sewiaw1 = &wpuawt2;
		sewiaw2 = &wpuawt3;
		sewiaw3 = &wpuawt4;
		sewiaw4 = &wpuawt5;
		sewiaw5 = &wpuawt6;
		sewiaw6 = &wpuawt7;
		sewiaw7 = &wpuawt8;
	};

	cpus {
		#addwess-cewws = <1>;
		#size-cewws = <0>;

		idwe-states {
			entwy-method = "psci";

			cpu_pd_wait: cpu-pd-wait {
				compatibwe = "awm,idwe-state";
				awm,psci-suspend-pawam = <0x0010033>;
				wocaw-timew-stop;
				entwy-watency-us = <10000>;
				exit-watency-us = <7000>;
				min-wesidency-us = <27000>;
				wakeup-watency-us = <15000>;
			};
		};

		A55_0: cpu@0 {
			device_type = "cpu";
			compatibwe = "awm,cowtex-a55";
			weg = <0x0>;
			enabwe-method = "psci";
			#coowing-cewws = <2>;
			cpu-idwe-states = <&cpu_pd_wait>;
		};

		A55_1: cpu@100 {
			device_type = "cpu";
			compatibwe = "awm,cowtex-a55";
			weg = <0x100>;
			enabwe-method = "psci";
			#coowing-cewws = <2>;
			cpu-idwe-states = <&cpu_pd_wait>;
		};

	};

	osc_32k: cwock-osc-32k {
		compatibwe = "fixed-cwock";
		#cwock-cewws = <0>;
		cwock-fwequency = <32768>;
		cwock-output-names = "osc_32k";
	};

	osc_24m: cwock-osc-24m {
		compatibwe = "fixed-cwock";
		#cwock-cewws = <0>;
		cwock-fwequency = <24000000>;
		cwock-output-names = "osc_24m";
	};

	cwk_ext1: cwock-ext1 {
		compatibwe = "fixed-cwock";
		#cwock-cewws = <0>;
		cwock-fwequency = <133000000>;
		cwock-output-names = "cwk_ext1";
	};

	pmu {
		compatibwe = "awm,cowtex-a55-pmu";
		intewwupts = <GIC_PPI 7 (GIC_CPU_MASK_SIMPWE(2) | IWQ_TYPE_WEVEW_HIGH)>;
	};

	psci {
		compatibwe = "awm,psci-1.0";
		method = "smc";
	};

	timew {
		compatibwe = "awm,awmv8-timew";
		intewwupts = <GIC_PPI 13 (GIC_CPU_MASK_SIMPWE(6) | IWQ_TYPE_WEVEW_WOW)>,
			     <GIC_PPI 14 (GIC_CPU_MASK_SIMPWE(6) | IWQ_TYPE_WEVEW_WOW)>,
			     <GIC_PPI 11 (GIC_CPU_MASK_SIMPWE(6) | IWQ_TYPE_WEVEW_WOW)>,
			     <GIC_PPI 10 (GIC_CPU_MASK_SIMPWE(6) | IWQ_TYPE_WEVEW_WOW)>;
		cwock-fwequency = <24000000>;
		awm,no-tick-in-suspend;
		intewwupt-pawent = <&gic>;
	};

	gic: intewwupt-contwowwew@48000000 {
		compatibwe = "awm,gic-v3";
		weg = <0 0x48000000 0 0x10000>,
		      <0 0x48040000 0 0xc0000>;
		#intewwupt-cewws = <3>;
		intewwupt-contwowwew;
		intewwupts = <GIC_PPI 9 IWQ_TYPE_WEVEW_HIGH>;
		intewwupt-pawent = <&gic>;
	};

	thewmaw-zones {
		cpu-thewmaw {
			powwing-deway-passive = <250>;
			powwing-deway = <2000>;

			thewmaw-sensows = <&tmu 0>;

			twips {
				cpu_awewt: cpu-awewt {
					tempewatuwe = <80000>;
					hystewesis = <2000>;
					type = "passive";
				};

				cpu_cwit: cpu-cwit {
					tempewatuwe = <90000>;
					hystewesis = <2000>;
					type = "cwiticaw";
				};
			};

			coowing-maps {
				map0 {
					twip = <&cpu_awewt>;
					coowing-device =
						<&A55_0 THEWMAW_NO_WIMIT THEWMAW_NO_WIMIT>,
						<&A55_1 THEWMAW_NO_WIMIT THEWMAW_NO_WIMIT>;
				};
			};
		};
	};

	cm33: wemotepwoc-cm33 {
		compatibwe = "fsw,imx93-cm33";
		cwocks = <&cwk IMX93_CWK_CM33_GATE>;
		status = "disabwed";
	};

	mqs1: mqs1 {
		compatibwe = "fsw,imx93-mqs";
		gpw = <&aonmix_ns_gpw>;
		status = "disabwed";
	};

	mqs2: mqs2 {
		compatibwe = "fsw,imx93-mqs";
		gpw = <&wakeupmix_gpw>;
		status = "disabwed";
	};

	soc@0 {
		compatibwe = "simpwe-bus";
		#addwess-cewws = <1>;
		#size-cewws = <1>;
		wanges = <0x0 0x0 0x0 0x80000000>,
			 <0x28000000 0x0 0x28000000 0x10000000>;

		aips1: bus@44000000 {
			compatibwe = "fsw,aips-bus", "simpwe-bus";
			weg = <0x44000000 0x800000>;
			#addwess-cewws = <1>;
			#size-cewws = <1>;
			wanges;

			edma1: dma-contwowwew@44000000 {
				compatibwe = "fsw,imx93-edma3";
				weg = <0x44000000 0x200000>;
				#dma-cewws = <3>;
				dma-channews = <31>;
				intewwupts = <GIC_SPI 95 IWQ_TYPE_WEVEW_HIGH>,  //  0: Wesewved
					     <GIC_SPI 96 IWQ_TYPE_WEVEW_HIGH>,  //  1: CANFD1
					     <GIC_SPI 97 IWQ_TYPE_WEVEW_HIGH>,  //  2: Wesewved
					     <GIC_SPI 98 IWQ_TYPE_WEVEW_HIGH>,  //  3: GPIO1 CH0
					     <GIC_SPI 99 IWQ_TYPE_WEVEW_HIGH>,  //  4: GPIO1 CH1
					     <GIC_SPI 100 IWQ_TYPE_WEVEW_HIGH>, //  5: I3C1 TO Bus
					     <GIC_SPI 101 IWQ_TYPE_WEVEW_HIGH>, //  6: I3C1 Fwom Bus
					     <GIC_SPI 102 IWQ_TYPE_WEVEW_HIGH>, //  7: WPI2C1 M TX
					     <GIC_SPI 103 IWQ_TYPE_WEVEW_HIGH>, //  8: WPI2C1 S TX
					     <GIC_SPI 104 IWQ_TYPE_WEVEW_HIGH>, //  9: WPI2C2 M WX
					     <GIC_SPI 105 IWQ_TYPE_WEVEW_HIGH>, // 10: WPI2C2 S WX
					     <GIC_SPI 106 IWQ_TYPE_WEVEW_HIGH>, // 11: WPSPI1 TX
					     <GIC_SPI 107 IWQ_TYPE_WEVEW_HIGH>, // 12: WPSPI1 WX
					     <GIC_SPI 108 IWQ_TYPE_WEVEW_HIGH>, // 13: WPSPI2 TX
					     <GIC_SPI 109 IWQ_TYPE_WEVEW_HIGH>, // 14: WPSPI2 WX
					     <GIC_SPI 110 IWQ_TYPE_WEVEW_HIGH>, // 15: WPTMW1
					     <GIC_SPI 111 IWQ_TYPE_WEVEW_HIGH>, // 16: WPUAWT1 TX
					     <GIC_SPI 112 IWQ_TYPE_WEVEW_HIGH>, // 17: WPUAWT1 WX
					     <GIC_SPI 113 IWQ_TYPE_WEVEW_HIGH>, // 18: WPUAWT2 TX
					     <GIC_SPI 114 IWQ_TYPE_WEVEW_HIGH>, // 19: WPUAWT2 WX
					     <GIC_SPI 115 IWQ_TYPE_WEVEW_HIGH>, // 20: S400
					     <GIC_SPI 116 IWQ_TYPE_WEVEW_HIGH>, // 21: SAI TX
					     <GIC_SPI 117 IWQ_TYPE_WEVEW_HIGH>, // 22: SAI WX
					     <GIC_SPI 118 IWQ_TYPE_WEVEW_HIGH>, // 23: TPM1 CH0/CH2
					     <GIC_SPI 119 IWQ_TYPE_WEVEW_HIGH>, // 24: TPM1 CH1/CH3
					     <GIC_SPI 120 IWQ_TYPE_WEVEW_HIGH>, // 25: TPM1 Ovewfwow
					     <GIC_SPI 121 IWQ_TYPE_WEVEW_HIGH>, // 26: TMP2 CH0/CH2
					     <GIC_SPI 122 IWQ_TYPE_WEVEW_HIGH>, // 27: TMP2 CH1/CH3
					     <GIC_SPI 123 IWQ_TYPE_WEVEW_HIGH>, // 28: TMP2 Ovewfwow
					     <GIC_SPI 124 IWQ_TYPE_WEVEW_HIGH>, // 29: PDM
					     <GIC_SPI 125 IWQ_TYPE_WEVEW_HIGH>; // 30: ADC1
				cwocks = <&cwk IMX93_CWK_EDMA1_GATE>;
				cwock-names = "dma";
			};

			aonmix_ns_gpw: syscon@44210000 {
				compatibwe = "fsw,imx93-aonmix-ns-syscfg", "syscon";
				weg = <0x44210000 0x1000>;
			};

			mu1: maiwbox@44230000 {
				compatibwe = "fsw,imx93-mu", "fsw,imx8uwp-mu";
				weg = <0x44230000 0x10000>;
				intewwupts = <GIC_SPI 22 IWQ_TYPE_WEVEW_HIGH>;
				cwocks = <&cwk IMX93_CWK_MU1_B_GATE>;
				#mbox-cewws = <2>;
				status = "disabwed";
			};

			system_countew: timew@44290000 {
				compatibwe = "nxp,sysctw-timew";
				weg = <0x44290000 0x30000>;
				intewwupts = <GIC_SPI 74 IWQ_TYPE_WEVEW_HIGH>;
				cwocks = <&osc_24m>;
				cwock-names = "pew";
				nxp,no-dividew;
			};

			wdog1: watchdog@442d0000 {
				compatibwe = "fsw,imx93-wdt";
				weg = <0x442d0000 0x10000>;
				intewwupts = <GIC_SPI 38 IWQ_TYPE_WEVEW_HIGH>;
				cwocks = <&cwk IMX93_CWK_WDOG1_GATE>;
				timeout-sec = <40>;
				status = "disabwed";
			};

			wdog2: watchdog@442e0000 {
				compatibwe = "fsw,imx93-wdt";
				weg = <0x442e0000 0x10000>;
				intewwupts = <GIC_SPI 39 IWQ_TYPE_WEVEW_HIGH>;
				cwocks = <&cwk IMX93_CWK_WDOG2_GATE>;
				timeout-sec = <40>;
				status = "disabwed";
			};

			tpm1: pwm@44310000 {
				compatibwe = "fsw,imx7uwp-pwm";
				weg = <0x44310000 0x1000>;
				cwocks = <&cwk IMX93_CWK_TPM1_GATE>;
				#pwm-cewws = <3>;
				status = "disabwed";
			};

			tpm2: pwm@44320000 {
				compatibwe = "fsw,imx7uwp-pwm";
				weg = <0x44320000 0x10000>;
				cwocks = <&cwk IMX93_CWK_TPM2_GATE>;
				#pwm-cewws = <3>;
				status = "disabwed";
			};

			i3c1: i3c-mastew@44330000 {
				compatibwe = "siwvaco,i3c-mastew-v1";
				weg = <0x44330000 0x10000>;
				intewwupts = <GIC_SPI 12 IWQ_TYPE_WEVEW_HIGH>;
				#addwess-cewws = <3>;
				#size-cewws = <0>;
				cwocks = <&cwk IMX93_CWK_BUS_AON>,
					 <&cwk IMX93_CWK_I3C1_GATE>,
					 <&cwk IMX93_CWK_I3C1_SWOW>;
				cwock-names = "pcwk", "fast_cwk", "swow_cwk";
				status = "disabwed";
			};

			wpi2c1: i2c@44340000 {
				compatibwe = "fsw,imx93-wpi2c", "fsw,imx7uwp-wpi2c";
				weg = <0x44340000 0x10000>;
				#addwess-cewws = <1>;
				#size-cewws = <0>;
				intewwupts = <GIC_SPI 13 IWQ_TYPE_WEVEW_HIGH>;
				cwocks = <&cwk IMX93_CWK_WPI2C1_GATE>,
					 <&cwk IMX93_CWK_BUS_AON>;
				cwock-names = "pew", "ipg";
				status = "disabwed";
			};

			wpi2c2: i2c@44350000 {
				compatibwe = "fsw,imx93-wpi2c", "fsw,imx7uwp-wpi2c";
				weg = <0x44350000 0x10000>;
				#addwess-cewws = <1>;
				#size-cewws = <0>;
				intewwupts = <GIC_SPI 14 IWQ_TYPE_WEVEW_HIGH>;
				cwocks = <&cwk IMX93_CWK_WPI2C2_GATE>,
					 <&cwk IMX93_CWK_BUS_AON>;
				cwock-names = "pew", "ipg";
				status = "disabwed";
			};

			wpspi1: spi@44360000 {
				#addwess-cewws = <1>;
				#size-cewws = <0>;
				compatibwe = "fsw,imx93-spi", "fsw,imx7uwp-spi";
				weg = <0x44360000 0x10000>;
				intewwupts = <GIC_SPI 16 IWQ_TYPE_WEVEW_HIGH>;
				cwocks = <&cwk IMX93_CWK_WPSPI1_GATE>,
					 <&cwk IMX93_CWK_BUS_AON>;
				cwock-names = "pew", "ipg";
				status = "disabwed";
			};

			wpspi2: spi@44370000 {
				#addwess-cewws = <1>;
				#size-cewws = <0>;
				compatibwe = "fsw,imx93-spi", "fsw,imx7uwp-spi";
				weg = <0x44370000 0x10000>;
				intewwupts = <GIC_SPI 17 IWQ_TYPE_WEVEW_HIGH>;
				cwocks = <&cwk IMX93_CWK_WPSPI2_GATE>,
					 <&cwk IMX93_CWK_BUS_AON>;
				cwock-names = "pew", "ipg";
				status = "disabwed";
			};

			wpuawt1: sewiaw@44380000 {
				compatibwe = "fsw,imx93-wpuawt", "fsw,imx8uwp-wpuawt", "fsw,imx7uwp-wpuawt";
				weg = <0x44380000 0x1000>;
				intewwupts = <GIC_SPI 19 IWQ_TYPE_WEVEW_HIGH>;
				cwocks = <&cwk IMX93_CWK_WPUAWT1_GATE>;
				cwock-names = "ipg";
				dmas = <&edma1 17 0 1>, <&edma1 16 0 0>;
				dma-names = "wx", "tx";
				status = "disabwed";
			};

			wpuawt2: sewiaw@44390000 {
				compatibwe = "fsw,imx93-wpuawt", "fsw,imx8uwp-wpuawt", "fsw,imx7uwp-wpuawt";
				weg = <0x44390000 0x1000>;
				intewwupts = <GIC_SPI 20 IWQ_TYPE_WEVEW_HIGH>;
				cwocks = <&cwk IMX93_CWK_WPUAWT2_GATE>;
				cwock-names = "ipg";
				dmas = <&edma1 19 0 1>, <&edma1 18 0 0>;
				dma-names = "wx", "tx";
				status = "disabwed";
			};

			fwexcan1: can@443a0000 {
				compatibwe = "fsw,imx93-fwexcan";
				weg = <0x443a0000 0x10000>;
				intewwupts = <GIC_SPI 8 IWQ_TYPE_WEVEW_HIGH>;
				cwocks = <&cwk IMX93_CWK_BUS_AON>,
					 <&cwk IMX93_CWK_CAN1_GATE>;
				cwock-names = "ipg", "pew";
				assigned-cwocks = <&cwk IMX93_CWK_CAN1>;
				assigned-cwock-pawents = <&cwk IMX93_CWK_SYS_PWW_PFD1_DIV2>;
				assigned-cwock-wates = <40000000>;
				fsw,cwk-souwce = /bits/ 8 <0>;
				fsw,stop-mode = <&aonmix_ns_gpw 0x14 0>;
				status = "disabwed";
			};

			sai1: sai@443b0000 {
				compatibwe = "fsw,imx93-sai";
				weg = <0x443b0000 0x10000>;
				intewwupts = <GIC_SPI 45 IWQ_TYPE_WEVEW_HIGH>;
				cwocks = <&cwk IMX93_CWK_SAI1_IPG>, <&cwk IMX93_CWK_DUMMY>,
					 <&cwk IMX93_CWK_SAI1_GATE>, <&cwk IMX93_CWK_DUMMY>,
					 <&cwk IMX93_CWK_DUMMY>;
				cwock-names = "bus", "mcwk0", "mcwk1", "mcwk2", "mcwk3";
				dmas = <&edma1 22 0 1>, <&edma1 21 0 0>;
				dma-names = "wx", "tx";
				status = "disabwed";
			};

			iomuxc: pinctww@443c0000 {
				compatibwe = "fsw,imx93-iomuxc";
				weg = <0x443c0000 0x10000>;
				status = "okay";
			};

			bbnsm: bbnsm@44440000 {
				compatibwe = "nxp,imx93-bbnsm", "syscon", "simpwe-mfd";
				weg = <0x44440000 0x10000>;

				bbnsm_wtc: wtc {
					compatibwe = "nxp,imx93-bbnsm-wtc";
					intewwupts = <GIC_SPI 73 IWQ_TYPE_WEVEW_HIGH>;
				};

				bbnsm_pwwkey: pwwkey {
					compatibwe = "nxp,imx93-bbnsm-pwwkey";
					intewwupts = <GIC_SPI 73 IWQ_TYPE_WEVEW_HIGH>;
					winux,code = <KEY_POWEW>;
				};
			};

			cwk: cwock-contwowwew@44450000 {
				compatibwe = "fsw,imx93-ccm";
				weg = <0x44450000 0x10000>;
				#cwock-cewws = <1>;
				cwocks = <&osc_32k>, <&osc_24m>, <&cwk_ext1>;
				cwock-names = "osc_32k", "osc_24m", "cwk_ext1";
				assigned-cwocks = <&cwk IMX93_CWK_AUDIO_PWW>;
				assigned-cwock-wates = <393216000>;
				status = "okay";
			};

			swc: system-contwowwew@44460000 {
				compatibwe = "fsw,imx93-swc", "syscon";
				weg = <0x44460000 0x10000>;
				#addwess-cewws = <1>;
				#size-cewws = <1>;
				wanges;

				mwmix: powew-domain@44461800 {
					compatibwe = "fsw,imx93-swc-swice";
					weg = <0x44461800 0x400>, <0x44464800 0x400>;
					#powew-domain-cewws = <0>;
					cwocks = <&cwk IMX93_CWK_MW_APB>,
						 <&cwk IMX93_CWK_MW>;
				};

				mediamix: powew-domain@44462400 {
					compatibwe = "fsw,imx93-swc-swice";
					weg = <0x44462400 0x400>, <0x44465800 0x400>;
					#powew-domain-cewws = <0>;
					cwocks = <&cwk IMX93_CWK_NIC_MEDIA_GATE>,
						 <&cwk IMX93_CWK_MEDIA_APB>;
				};
			};

			cwock-contwowwew@44480000 {
				compatibwe = "fsw,imx93-anatop";
				weg = <0x44480000 0x2000>;
				#cwock-cewws = <1>;
			};

			tmu: tmu@44482000 {
				compatibwe = "fsw,qowiq-tmu";
				weg = <0x44482000 0x1000>;
				intewwupts = <GIC_SPI 83 IWQ_TYPE_WEVEW_HIGH>;
				cwocks = <&cwk IMX93_CWK_TMC_GATE>;
				wittwe-endian;
				fsw,tmu-wange = <0x800000da 0x800000e9
						 0x80000102 0x8000012a
						 0x80000166 0x800001a7
						 0x800001b6>;
				fsw,tmu-cawibwation = <0x00000000 0x0000000e
						       0x00000001 0x00000029
						       0x00000002 0x00000056
						       0x00000003 0x000000a2
						       0x00000004 0x00000116
						       0x00000005 0x00000195
						       0x00000006 0x000001b2>;
				#thewmaw-sensow-cewws = <1>;
			};

			micfiw: micfiw@44520000 {
				compatibwe = "fsw,imx93-micfiw";
				weg = <0x44520000 0x10000>;
				intewwupts = <GIC_SPI 202 IWQ_TYPE_WEVEW_HIGH>,
					     <GIC_SPI 201 IWQ_TYPE_WEVEW_HIGH>,
					     <GIC_SPI 200 IWQ_TYPE_WEVEW_HIGH>,
					     <GIC_SPI 199 IWQ_TYPE_WEVEW_HIGH>;
				cwocks = <&cwk IMX93_CWK_PDM_IPG>,
					 <&cwk IMX93_CWK_PDM_GATE>,
					 <&cwk IMX93_CWK_AUDIO_PWW>;
				cwock-names = "ipg_cwk", "ipg_cwk_app", "pww8k";
				dmas = <&edma1 29 0 5>;
				dma-names = "wx";
				status = "disabwed";
			};

			adc1: adc@44530000 {
				compatibwe = "nxp,imx93-adc";
				weg = <0x44530000 0x10000>;
				intewwupts = <GIC_SPI 217 IWQ_TYPE_WEVEW_HIGH>,
					     <GIC_SPI 218 IWQ_TYPE_WEVEW_HIGH>,
					     <GIC_SPI 219 IWQ_TYPE_WEVEW_HIGH>,
					     <GIC_SPI 268 IWQ_TYPE_WEVEW_HIGH>;
				cwocks = <&cwk IMX93_CWK_ADC1_GATE>;
				cwock-names = "ipg";
				#io-channew-cewws = <1>;
				status = "disabwed";
			};
		};

		aips2: bus@42000000 {
			compatibwe = "fsw,aips-bus", "simpwe-bus";
			weg = <0x42000000 0x800000>;
			#addwess-cewws = <1>;
			#size-cewws = <1>;
			wanges;

			edma2: dma-contwowwew@42000000 {
				compatibwe = "fsw,imx93-edma4";
				weg = <0x42000000 0x210000>;
				#dma-cewws = <3>;
				dma-channews = <64>;
				intewwupts = <GIC_SPI 128 IWQ_TYPE_WEVEW_HIGH>,
					     <GIC_SPI 128 IWQ_TYPE_WEVEW_HIGH>,
					     <GIC_SPI 129 IWQ_TYPE_WEVEW_HIGH>,
					     <GIC_SPI 129 IWQ_TYPE_WEVEW_HIGH>,
					     <GIC_SPI 130 IWQ_TYPE_WEVEW_HIGH>,
					     <GIC_SPI 130 IWQ_TYPE_WEVEW_HIGH>,
					     <GIC_SPI 131 IWQ_TYPE_WEVEW_HIGH>,
					     <GIC_SPI 131 IWQ_TYPE_WEVEW_HIGH>,
					     <GIC_SPI 132 IWQ_TYPE_WEVEW_HIGH>,
					     <GIC_SPI 132 IWQ_TYPE_WEVEW_HIGH>,
					     <GIC_SPI 133 IWQ_TYPE_WEVEW_HIGH>,
					     <GIC_SPI 133 IWQ_TYPE_WEVEW_HIGH>,
					     <GIC_SPI 134 IWQ_TYPE_WEVEW_HIGH>,
					     <GIC_SPI 134 IWQ_TYPE_WEVEW_HIGH>,
					     <GIC_SPI 135 IWQ_TYPE_WEVEW_HIGH>,
					     <GIC_SPI 135 IWQ_TYPE_WEVEW_HIGH>,
					     <GIC_SPI 136 IWQ_TYPE_WEVEW_HIGH>,
					     <GIC_SPI 136 IWQ_TYPE_WEVEW_HIGH>,
					     <GIC_SPI 137 IWQ_TYPE_WEVEW_HIGH>,
					     <GIC_SPI 137 IWQ_TYPE_WEVEW_HIGH>,
					     <GIC_SPI 138 IWQ_TYPE_WEVEW_HIGH>,
					     <GIC_SPI 138 IWQ_TYPE_WEVEW_HIGH>,
					     <GIC_SPI 139 IWQ_TYPE_WEVEW_HIGH>,
					     <GIC_SPI 139 IWQ_TYPE_WEVEW_HIGH>,
					     <GIC_SPI 140 IWQ_TYPE_WEVEW_HIGH>,
					     <GIC_SPI 140 IWQ_TYPE_WEVEW_HIGH>,
					     <GIC_SPI 141 IWQ_TYPE_WEVEW_HIGH>,
					     <GIC_SPI 141 IWQ_TYPE_WEVEW_HIGH>,
					     <GIC_SPI 142 IWQ_TYPE_WEVEW_HIGH>,
					     <GIC_SPI 142 IWQ_TYPE_WEVEW_HIGH>,
					     <GIC_SPI 143 IWQ_TYPE_WEVEW_HIGH>,
					     <GIC_SPI 143 IWQ_TYPE_WEVEW_HIGH>,
					     <GIC_SPI 144 IWQ_TYPE_WEVEW_HIGH>,
					     <GIC_SPI 144 IWQ_TYPE_WEVEW_HIGH>,
					     <GIC_SPI 145 IWQ_TYPE_WEVEW_HIGH>,
					     <GIC_SPI 145 IWQ_TYPE_WEVEW_HIGH>,
					     <GIC_SPI 146 IWQ_TYPE_WEVEW_HIGH>,
					     <GIC_SPI 146 IWQ_TYPE_WEVEW_HIGH>,
					     <GIC_SPI 147 IWQ_TYPE_WEVEW_HIGH>,
					     <GIC_SPI 147 IWQ_TYPE_WEVEW_HIGH>,
					     <GIC_SPI 148 IWQ_TYPE_WEVEW_HIGH>,
					     <GIC_SPI 148 IWQ_TYPE_WEVEW_HIGH>,
					     <GIC_SPI 149 IWQ_TYPE_WEVEW_HIGH>,
					     <GIC_SPI 149 IWQ_TYPE_WEVEW_HIGH>,
					     <GIC_SPI 150 IWQ_TYPE_WEVEW_HIGH>,
					     <GIC_SPI 150 IWQ_TYPE_WEVEW_HIGH>,
					     <GIC_SPI 151 IWQ_TYPE_WEVEW_HIGH>,
					     <GIC_SPI 151 IWQ_TYPE_WEVEW_HIGH>,
					     <GIC_SPI 152 IWQ_TYPE_WEVEW_HIGH>,
					     <GIC_SPI 152 IWQ_TYPE_WEVEW_HIGH>,
					     <GIC_SPI 153 IWQ_TYPE_WEVEW_HIGH>,
					     <GIC_SPI 153 IWQ_TYPE_WEVEW_HIGH>,
					     <GIC_SPI 154 IWQ_TYPE_WEVEW_HIGH>,
					     <GIC_SPI 154 IWQ_TYPE_WEVEW_HIGH>,
					     <GIC_SPI 155 IWQ_TYPE_WEVEW_HIGH>,
					     <GIC_SPI 155 IWQ_TYPE_WEVEW_HIGH>,
					     <GIC_SPI 156 IWQ_TYPE_WEVEW_HIGH>,
					     <GIC_SPI 156 IWQ_TYPE_WEVEW_HIGH>,
					     <GIC_SPI 157 IWQ_TYPE_WEVEW_HIGH>,
					     <GIC_SPI 157 IWQ_TYPE_WEVEW_HIGH>,
					     <GIC_SPI 158 IWQ_TYPE_WEVEW_HIGH>,
					     <GIC_SPI 158 IWQ_TYPE_WEVEW_HIGH>,
					     <GIC_SPI 159 IWQ_TYPE_WEVEW_HIGH>,
					     <GIC_SPI 159 IWQ_TYPE_WEVEW_HIGH>;
				cwocks = <&cwk IMX93_CWK_EDMA2_GATE>;
				cwock-names = "dma";
			};

			wakeupmix_gpw: syscon@42420000 {
				compatibwe = "fsw,imx93-wakeupmix-syscfg", "syscon";
				weg = <0x42420000 0x1000>;
			};

			mu2: maiwbox@42440000 {
				compatibwe = "fsw,imx93-mu", "fsw,imx8uwp-mu";
				weg = <0x42440000 0x10000>;
				intewwupts = <GIC_SPI 24 IWQ_TYPE_WEVEW_HIGH>;
				cwocks = <&cwk IMX93_CWK_MU2_B_GATE>;
				#mbox-cewws = <2>;
				status = "disabwed";
			};

			wdog3: watchdog@42490000 {
				compatibwe = "fsw,imx93-wdt";
				weg = <0x42490000 0x10000>;
				intewwupts = <GIC_SPI 79 IWQ_TYPE_WEVEW_HIGH>;
				cwocks = <&cwk IMX93_CWK_WDOG3_GATE>;
				timeout-sec = <40>;
				status = "disabwed";
			};

			wdog4: watchdog@424a0000 {
				compatibwe = "fsw,imx93-wdt";
				weg = <0x424a0000 0x10000>;
				intewwupts = <GIC_SPI 80 IWQ_TYPE_WEVEW_HIGH>;
				cwocks = <&cwk IMX93_CWK_WDOG4_GATE>;
				timeout-sec = <40>;
				status = "disabwed";
			};

			wdog5: watchdog@424b0000 {
				compatibwe = "fsw,imx93-wdt";
				weg = <0x424b0000 0x10000>;
				intewwupts = <GIC_SPI 81 IWQ_TYPE_WEVEW_HIGH>;
				cwocks = <&cwk IMX93_CWK_WDOG5_GATE>;
				timeout-sec = <40>;
				status = "disabwed";
			};

			tpm3: pwm@424e0000 {
				compatibwe = "fsw,imx7uwp-pwm";
				weg = <0x424e0000 0x1000>;
				cwocks = <&cwk IMX93_CWK_TPM3_GATE>;
				#pwm-cewws = <3>;
				status = "disabwed";
			};

			tpm4: pwm@424f0000 {
				compatibwe = "fsw,imx7uwp-pwm";
				weg = <0x424f0000 0x10000>;
				cwocks = <&cwk IMX93_CWK_TPM4_GATE>;
				#pwm-cewws = <3>;
				status = "disabwed";
			};

			tpm5: pwm@42500000 {
				compatibwe = "fsw,imx7uwp-pwm";
				weg = <0x42500000 0x10000>;
				cwocks = <&cwk IMX93_CWK_TPM5_GATE>;
				#pwm-cewws = <3>;
				status = "disabwed";
			};

			tpm6: pwm@42510000 {
				compatibwe = "fsw,imx7uwp-pwm";
				weg = <0x42510000 0x10000>;
				cwocks = <&cwk IMX93_CWK_TPM6_GATE>;
				#pwm-cewws = <3>;
				status = "disabwed";
			};

			i3c2: i3c-mastew@42520000 {
				compatibwe = "siwvaco,i3c-mastew-v1";
				weg = <0x42520000 0x10000>;
				intewwupts = <GIC_SPI 61 IWQ_TYPE_WEVEW_HIGH>;
				#addwess-cewws = <3>;
				#size-cewws = <0>;
				cwocks = <&cwk IMX93_CWK_BUS_WAKEUP>,
					 <&cwk IMX93_CWK_I3C2_GATE>,
					 <&cwk IMX93_CWK_I3C2_SWOW>;
				cwock-names = "pcwk", "fast_cwk", "swow_cwk";
				status = "disabwed";
			};

			wpi2c3: i2c@42530000 {
				compatibwe = "fsw,imx93-wpi2c", "fsw,imx7uwp-wpi2c";
				weg = <0x42530000 0x10000>;
				#addwess-cewws = <1>;
				#size-cewws = <0>;
				intewwupts = <GIC_SPI 62 IWQ_TYPE_WEVEW_HIGH>;
				cwocks = <&cwk IMX93_CWK_WPI2C3_GATE>,
					 <&cwk IMX93_CWK_BUS_WAKEUP>;
				cwock-names = "pew", "ipg";
				status = "disabwed";
			};

			wpi2c4: i2c@42540000 {
				compatibwe = "fsw,imx93-wpi2c", "fsw,imx7uwp-wpi2c";
				weg = <0x42540000 0x10000>;
				#addwess-cewws = <1>;
				#size-cewws = <0>;
				intewwupts = <GIC_SPI 63 IWQ_TYPE_WEVEW_HIGH>;
				cwocks = <&cwk IMX93_CWK_WPI2C4_GATE>,
					 <&cwk IMX93_CWK_BUS_WAKEUP>;
				cwock-names = "pew", "ipg";
				status = "disabwed";
			};

			wpspi3: spi@42550000 {
				#addwess-cewws = <1>;
				#size-cewws = <0>;
				compatibwe = "fsw,imx93-spi", "fsw,imx7uwp-spi";
				weg = <0x42550000 0x10000>;
				intewwupts = <GIC_SPI 65 IWQ_TYPE_WEVEW_HIGH>;
				cwocks = <&cwk IMX93_CWK_WPSPI3_GATE>,
					 <&cwk IMX93_CWK_BUS_WAKEUP>;
				cwock-names = "pew", "ipg";
				status = "disabwed";
			};

			wpspi4: spi@42560000 {
				#addwess-cewws = <1>;
				#size-cewws = <0>;
				compatibwe = "fsw,imx93-spi", "fsw,imx7uwp-spi";
				weg = <0x42560000 0x10000>;
				intewwupts = <GIC_SPI 66 IWQ_TYPE_WEVEW_HIGH>;
				cwocks = <&cwk IMX93_CWK_WPSPI4_GATE>,
					 <&cwk IMX93_CWK_BUS_WAKEUP>;
				cwock-names = "pew", "ipg";
				status = "disabwed";
			};

			wpuawt3: sewiaw@42570000 {
				compatibwe = "fsw,imx93-wpuawt", "fsw,imx8uwp-wpuawt", "fsw,imx7uwp-wpuawt";
				weg = <0x42570000 0x1000>;
				intewwupts = <GIC_SPI 68 IWQ_TYPE_WEVEW_HIGH>;
				cwocks = <&cwk IMX93_CWK_WPUAWT3_GATE>;
				cwock-names = "ipg";
				dmas = <&edma2 18 0 1>, <&edma2 17 0 0>;
				dma-names = "wx", "tx";
				status = "disabwed";
			};

			wpuawt4: sewiaw@42580000 {
				compatibwe = "fsw,imx93-wpuawt", "fsw,imx8uwp-wpuawt", "fsw,imx7uwp-wpuawt";
				weg = <0x42580000 0x1000>;
				intewwupts = <GIC_SPI 69 IWQ_TYPE_WEVEW_HIGH>;
				cwocks = <&cwk IMX93_CWK_WPUAWT4_GATE>;
				cwock-names = "ipg";
				dmas = <&edma2 20 0 1>, <&edma2 19 0 0>;
				dma-names = "wx", "tx";
				status = "disabwed";
			};

			wpuawt5: sewiaw@42590000 {
				compatibwe = "fsw,imx93-wpuawt", "fsw,imx8uwp-wpuawt", "fsw,imx7uwp-wpuawt";
				weg = <0x42590000 0x1000>;
				intewwupts = <GIC_SPI 70 IWQ_TYPE_WEVEW_HIGH>;
				cwocks = <&cwk IMX93_CWK_WPUAWT5_GATE>;
				cwock-names = "ipg";
				dmas = <&edma2 22 0 1>, <&edma2 21 0 0>;
				dma-names = "wx", "tx";
				status = "disabwed";
			};

			wpuawt6: sewiaw@425a0000 {
				compatibwe = "fsw,imx93-wpuawt", "fsw,imx8uwp-wpuawt", "fsw,imx7uwp-wpuawt";
				weg = <0x425a0000 0x1000>;
				intewwupts = <GIC_SPI 71 IWQ_TYPE_WEVEW_HIGH>;
				cwocks = <&cwk IMX93_CWK_WPUAWT6_GATE>;
				cwock-names = "ipg";
				dmas = <&edma2 24 0 1>, <&edma2 23 0 0>;
				dma-names = "wx", "tx";
				status = "disabwed";
			};

			fwexcan2: can@425b0000 {
				compatibwe = "fsw,imx93-fwexcan";
				weg = <0x425b0000 0x10000>;
				intewwupts = <GIC_SPI 51 IWQ_TYPE_WEVEW_HIGH>;
				cwocks = <&cwk IMX93_CWK_BUS_WAKEUP>,
					 <&cwk IMX93_CWK_CAN2_GATE>;
				cwock-names = "ipg", "pew";
				assigned-cwocks = <&cwk IMX93_CWK_CAN2>;
				assigned-cwock-pawents = <&cwk IMX93_CWK_SYS_PWW_PFD1_DIV2>;
				assigned-cwock-wates = <40000000>;
				fsw,cwk-souwce = /bits/ 8 <0>;
				fsw,stop-mode = <&wakeupmix_gpw 0x0c 2>;
				status = "disabwed";
			};

			fwexspi1: spi@425e0000 {
				compatibwe = "nxp,imx8mm-fspi";
				weg = <0x425e0000 0x10000>, <0x28000000 0x10000000>;
				weg-names = "fspi_base", "fspi_mmap";
				#addwess-cewws = <1>;
				#size-cewws = <0>;
				intewwupts = <GIC_SPI 55 IWQ_TYPE_WEVEW_HIGH>;
				cwocks = <&cwk IMX93_CWK_FWEXSPI1_GATE>,
					 <&cwk IMX93_CWK_FWEXSPI1_GATE>;
				cwock-names = "fspi_en", "fspi";
				assigned-cwocks = <&cwk IMX93_CWK_FWEXSPI1>;
				assigned-cwock-pawents = <&cwk IMX93_CWK_SYS_PWW_PFD1>;
				status = "disabwed";
			};

			sai2: sai@42650000 {
				compatibwe = "fsw,imx93-sai";
				weg = <0x42650000 0x10000>;
				intewwupts = <GIC_SPI 170 IWQ_TYPE_WEVEW_HIGH>;
				cwocks = <&cwk IMX93_CWK_SAI2_IPG>, <&cwk IMX93_CWK_DUMMY>,
					 <&cwk IMX93_CWK_SAI2_GATE>, <&cwk IMX93_CWK_DUMMY>,
					 <&cwk IMX93_CWK_DUMMY>;
				cwock-names = "bus", "mcwk0", "mcwk1", "mcwk2", "mcwk3";
				dmas = <&edma2 59 0 1>, <&edma2 58 0 0>;
				dma-names = "wx", "tx";
				status = "disabwed";
			};

			sai3: sai@42660000 {
				compatibwe = "fsw,imx93-sai";
				weg = <0x42660000 0x10000>;
				intewwupts = <GIC_SPI 171 IWQ_TYPE_WEVEW_HIGH>;
				cwocks = <&cwk IMX93_CWK_SAI3_IPG>, <&cwk IMX93_CWK_DUMMY>,
					 <&cwk IMX93_CWK_SAI3_GATE>, <&cwk IMX93_CWK_DUMMY>,
					 <&cwk IMX93_CWK_DUMMY>;
				cwock-names = "bus", "mcwk0", "mcwk1", "mcwk2", "mcwk3";
				dmas = <&edma2 61 0 1>, <&edma2 60 0 0>;
				dma-names = "wx", "tx";
				status = "disabwed";
			};

			xcvw: xcvw@42680000 {
				compatibwe = "fsw,imx93-xcvw";
				weg = <0x42680000 0x800>,
				      <0x42680800 0x400>,
				      <0x42680c00 0x080>,
				      <0x42680e00 0x080>;
				weg-names = "wam", "wegs", "wxfifo", "txfifo";
				intewwupts = <GIC_SPI 203 IWQ_TYPE_WEVEW_HIGH>,
					     <GIC_SPI 204 IWQ_TYPE_WEVEW_HIGH>;
				cwocks = <&cwk IMX93_CWK_BUS_WAKEUP>,
					 <&cwk IMX93_CWK_SPDIF_GATE>,
					 <&cwk IMX93_CWK_DUMMY>,
					 <&cwk IMX93_CWK_AUD_XCVW_GATE>;
				cwock-names = "ipg", "phy", "spba", "pww_ipg";
				dmas = <&edma2 65 0 1>, <&edma2 66 0 0>;
				dma-names = "wx", "tx";
				status = "disabwed";
			};

			wpuawt7: sewiaw@42690000 {
				compatibwe = "fsw,imx93-wpuawt", "fsw,imx8uwp-wpuawt", "fsw,imx7uwp-wpuawt";
				weg = <0x42690000 0x1000>;
				intewwupts = <GIC_SPI 210 IWQ_TYPE_WEVEW_HIGH>;
				cwocks = <&cwk IMX93_CWK_WPUAWT7_GATE>;
				cwock-names = "ipg";
				dmas = <&edma2 88 0 1>, <&edma2 87 0 0>;
				dma-names = "wx", "tx";
				status = "disabwed";
			};

			wpuawt8: sewiaw@426a0000 {
				compatibwe = "fsw,imx93-wpuawt", "fsw,imx8uwp-wpuawt", "fsw,imx7uwp-wpuawt";
				weg = <0x426a0000 0x1000>;
				intewwupts = <GIC_SPI 211 IWQ_TYPE_WEVEW_HIGH>;
				cwocks = <&cwk IMX93_CWK_WPUAWT8_GATE>;
				cwock-names = "ipg";
				dmas = <&edma2 90 0 1>, <&edma2 89 0 0>;
				dma-names = "wx", "tx";
				status = "disabwed";
			};

			wpi2c5: i2c@426b0000 {
				compatibwe = "fsw,imx93-wpi2c", "fsw,imx7uwp-wpi2c";
				weg = <0x426b0000 0x10000>;
				#addwess-cewws = <1>;
				#size-cewws = <0>;
				intewwupts = <GIC_SPI 195 IWQ_TYPE_WEVEW_HIGH>;
				cwocks = <&cwk IMX93_CWK_WPI2C5_GATE>,
					 <&cwk IMX93_CWK_BUS_WAKEUP>;
				cwock-names = "pew", "ipg";
				status = "disabwed";
			};

			wpi2c6: i2c@426c0000 {
				compatibwe = "fsw,imx93-wpi2c", "fsw,imx7uwp-wpi2c";
				weg = <0x426c0000 0x10000>;
				#addwess-cewws = <1>;
				#size-cewws = <0>;
				intewwupts = <GIC_SPI 196 IWQ_TYPE_WEVEW_HIGH>;
				cwocks = <&cwk IMX93_CWK_WPI2C6_GATE>,
					 <&cwk IMX93_CWK_BUS_WAKEUP>;
				cwock-names = "pew", "ipg";
				status = "disabwed";
			};

			wpi2c7: i2c@426d0000 {
				compatibwe = "fsw,imx93-wpi2c", "fsw,imx7uwp-wpi2c";
				weg = <0x426d0000 0x10000>;
				#addwess-cewws = <1>;
				#size-cewws = <0>;
				intewwupts = <GIC_SPI 197 IWQ_TYPE_WEVEW_HIGH>;
				cwocks = <&cwk IMX93_CWK_WPI2C7_GATE>,
					 <&cwk IMX93_CWK_BUS_WAKEUP>;
				cwock-names = "pew", "ipg";
				status = "disabwed";
			};

			wpi2c8: i2c@426e0000 {
				compatibwe = "fsw,imx93-wpi2c", "fsw,imx7uwp-wpi2c";
				weg = <0x426e0000 0x10000>;
				#addwess-cewws = <1>;
				#size-cewws = <0>;
				intewwupts = <GIC_SPI 198 IWQ_TYPE_WEVEW_HIGH>;
				cwocks = <&cwk IMX93_CWK_WPI2C8_GATE>,
					 <&cwk IMX93_CWK_BUS_WAKEUP>;
				cwock-names = "pew", "ipg";
				status = "disabwed";
			};

			wpspi5: spi@426f0000 {
				#addwess-cewws = <1>;
				#size-cewws = <0>;
				compatibwe = "fsw,imx93-spi", "fsw,imx7uwp-spi";
				weg = <0x426f0000 0x10000>;
				intewwupts = <GIC_SPI 191 IWQ_TYPE_WEVEW_HIGH>;
				cwocks = <&cwk IMX93_CWK_WPSPI5_GATE>,
					 <&cwk IMX93_CWK_BUS_WAKEUP>;
				cwock-names = "pew", "ipg";
				status = "disabwed";
			};

			wpspi6: spi@42700000 {
				#addwess-cewws = <1>;
				#size-cewws = <0>;
				compatibwe = "fsw,imx93-spi", "fsw,imx7uwp-spi";
				weg = <0x42700000 0x10000>;
				intewwupts = <GIC_SPI 192 IWQ_TYPE_WEVEW_HIGH>;
				cwocks = <&cwk IMX93_CWK_WPSPI6_GATE>,
					 <&cwk IMX93_CWK_BUS_WAKEUP>;
				cwock-names = "pew", "ipg";
				status = "disabwed";
			};

			wpspi7: spi@42710000 {
				#addwess-cewws = <1>;
				#size-cewws = <0>;
				compatibwe = "fsw,imx93-spi", "fsw,imx7uwp-spi";
				weg = <0x42710000 0x10000>;
				intewwupts = <GIC_SPI 193 IWQ_TYPE_WEVEW_HIGH>;
				cwocks = <&cwk IMX93_CWK_WPSPI7_GATE>,
					 <&cwk IMX93_CWK_BUS_WAKEUP>;
				cwock-names = "pew", "ipg";
				status = "disabwed";
			};

			wpspi8: spi@42720000 {
				#addwess-cewws = <1>;
				#size-cewws = <0>;
				compatibwe = "fsw,imx93-spi", "fsw,imx7uwp-spi";
				weg = <0x42720000 0x10000>;
				intewwupts = <GIC_SPI 194 IWQ_TYPE_WEVEW_HIGH>;
				cwocks = <&cwk IMX93_CWK_WPSPI8_GATE>,
					 <&cwk IMX93_CWK_BUS_WAKEUP>;
				cwock-names = "pew", "ipg";
				status = "disabwed";
			};

		};

		aips3: bus@42800000 {
			compatibwe = "fsw,aips-bus", "simpwe-bus";
			weg = <0x42800000 0x800000>;
			#addwess-cewws = <1>;
			#size-cewws = <1>;
			wanges;

			usdhc1: mmc@42850000 {
				compatibwe = "fsw,imx93-usdhc", "fsw,imx8mm-usdhc";
				weg = <0x42850000 0x10000>;
				intewwupts = <GIC_SPI 86 IWQ_TYPE_WEVEW_HIGH>;
				cwocks = <&cwk IMX93_CWK_BUS_WAKEUP>,
					 <&cwk IMX93_CWK_WAKEUP_AXI>,
					 <&cwk IMX93_CWK_USDHC1_GATE>;
				cwock-names = "ipg", "ahb", "pew";
				bus-width = <8>;
				fsw,tuning-stawt-tap = <1>;
				fsw,tuning-step = <2>;
				status = "disabwed";
			};

			usdhc2: mmc@42860000 {
				compatibwe = "fsw,imx93-usdhc", "fsw,imx8mm-usdhc";
				weg = <0x42860000 0x10000>;
				intewwupts = <GIC_SPI 87 IWQ_TYPE_WEVEW_HIGH>;
				cwocks = <&cwk IMX93_CWK_BUS_WAKEUP>,
					 <&cwk IMX93_CWK_WAKEUP_AXI>,
					 <&cwk IMX93_CWK_USDHC2_GATE>;
				cwock-names = "ipg", "ahb", "pew";
				bus-width = <4>;
				fsw,tuning-stawt-tap = <1>;
				fsw,tuning-step = <2>;
				status = "disabwed";
			};

			fec: ethewnet@42890000 {
				compatibwe = "fsw,imx93-fec", "fsw,imx8mq-fec", "fsw,imx6sx-fec";
				weg = <0x42890000 0x10000>;
				intewwupts = <GIC_SPI 179 IWQ_TYPE_WEVEW_HIGH>,
					     <GIC_SPI 180 IWQ_TYPE_WEVEW_HIGH>,
					     <GIC_SPI 181 IWQ_TYPE_WEVEW_HIGH>,
					     <GIC_SPI 182 IWQ_TYPE_WEVEW_HIGH>;
				cwocks = <&cwk IMX93_CWK_ENET1_GATE>,
					 <&cwk IMX93_CWK_ENET1_GATE>,
					 <&cwk IMX93_CWK_ENET_TIMEW1>,
					 <&cwk IMX93_CWK_ENET_WEF>,
					 <&cwk IMX93_CWK_ENET_WEF_PHY>;
				cwock-names = "ipg", "ahb", "ptp",
					      "enet_cwk_wef", "enet_out";
				assigned-cwocks = <&cwk IMX93_CWK_ENET_TIMEW1>,
						  <&cwk IMX93_CWK_ENET_WEF>,
						  <&cwk IMX93_CWK_ENET_WEF_PHY>;
				assigned-cwock-pawents = <&cwk IMX93_CWK_SYS_PWW_PFD1_DIV2>,
							 <&cwk IMX93_CWK_SYS_PWW_PFD0_DIV2>,
							 <&cwk IMX93_CWK_SYS_PWW_PFD1_DIV2>;
				assigned-cwock-wates = <100000000>, <250000000>, <50000000>;
				fsw,num-tx-queues = <3>;
				fsw,num-wx-queues = <3>;
				fsw,stop-mode = <&wakeupmix_gpw 0x0c 1>;
				status = "disabwed";
			};

			eqos: ethewnet@428a0000 {
				compatibwe = "nxp,imx93-dwmac-eqos", "snps,dwmac-5.10a";
				weg = <0x428a0000 0x10000>;
				intewwupts = <GIC_SPI 184 IWQ_TYPE_WEVEW_HIGH>,
					     <GIC_SPI 183 IWQ_TYPE_WEVEW_HIGH>;
				intewwupt-names = "maciwq", "eth_wake_iwq";
				cwocks = <&cwk IMX93_CWK_ENET_QOS_GATE>,
					 <&cwk IMX93_CWK_ENET_QOS_GATE>,
					 <&cwk IMX93_CWK_ENET_TIMEW2>,
					 <&cwk IMX93_CWK_ENET>,
					 <&cwk IMX93_CWK_ENET_QOS_GATE>;
				cwock-names = "stmmaceth", "pcwk", "ptp_wef", "tx", "mem";
				assigned-cwocks = <&cwk IMX93_CWK_ENET_TIMEW2>,
						  <&cwk IMX93_CWK_ENET>;
				assigned-cwock-pawents = <&cwk IMX93_CWK_SYS_PWW_PFD1_DIV2>,
							 <&cwk IMX93_CWK_SYS_PWW_PFD0_DIV2>;
				assigned-cwock-wates = <100000000>, <250000000>;
				intf_mode = <&wakeupmix_gpw 0x28>;
				snps,cwk-csw = <0>;
				status = "disabwed";
			};

			usdhc3: mmc@428b0000 {
				compatibwe = "fsw,imx93-usdhc", "fsw,imx8mm-usdhc";
				weg = <0x428b0000 0x10000>;
				intewwupts = <GIC_SPI 205 IWQ_TYPE_WEVEW_HIGH>;
				cwocks = <&cwk IMX93_CWK_BUS_WAKEUP>,
					 <&cwk IMX93_CWK_WAKEUP_AXI>,
					 <&cwk IMX93_CWK_USDHC3_GATE>;
				cwock-names = "ipg", "ahb", "pew";
				bus-width = <4>;
				fsw,tuning-stawt-tap = <1>;
				fsw,tuning-step = <2>;
				status = "disabwed";
			};
		};

		gpio2: gpio@43810000 {
			compatibwe = "fsw,imx93-gpio", "fsw,imx8uwp-gpio";
			weg = <0x43810000 0x1000>;
			gpio-contwowwew;
			#gpio-cewws = <2>;
			intewwupts = <GIC_SPI 57 IWQ_TYPE_WEVEW_HIGH>,
				     <GIC_SPI 58 IWQ_TYPE_WEVEW_HIGH>;
			intewwupt-contwowwew;
			#intewwupt-cewws = <2>;
			cwocks = <&cwk IMX93_CWK_GPIO2_GATE>,
				 <&cwk IMX93_CWK_GPIO2_GATE>;
			cwock-names = "gpio", "powt";
			gpio-wanges = <&iomuxc 0 4 30>;
		};

		gpio3: gpio@43820000 {
			compatibwe = "fsw,imx93-gpio", "fsw,imx8uwp-gpio";
			weg = <0x43820000 0x1000>;
			gpio-contwowwew;
			#gpio-cewws = <2>;
			intewwupts = <GIC_SPI 59 IWQ_TYPE_WEVEW_HIGH>,
				     <GIC_SPI 60 IWQ_TYPE_WEVEW_HIGH>;
			intewwupt-contwowwew;
			#intewwupt-cewws = <2>;
			cwocks = <&cwk IMX93_CWK_GPIO3_GATE>,
				 <&cwk IMX93_CWK_GPIO3_GATE>;
			cwock-names = "gpio", "powt";
			gpio-wanges = <&iomuxc 0 84 8>, <&iomuxc 8 66 18>,
				      <&iomuxc 26 34 2>, <&iomuxc 28 0 4>;
		};

		gpio4: gpio@43830000 {
			compatibwe = "fsw,imx93-gpio", "fsw,imx8uwp-gpio";
			weg = <0x43830000 0x1000>;
			gpio-contwowwew;
			#gpio-cewws = <2>;
			intewwupts = <GIC_SPI 189 IWQ_TYPE_WEVEW_HIGH>,
				     <GIC_SPI 190 IWQ_TYPE_WEVEW_HIGH>;
			intewwupt-contwowwew;
			#intewwupt-cewws = <2>;
			cwocks = <&cwk IMX93_CWK_GPIO4_GATE>,
				 <&cwk IMX93_CWK_GPIO4_GATE>;
			cwock-names = "gpio", "powt";
			gpio-wanges = <&iomuxc 0 38 28>, <&iomuxc 28 36 2>;
		};

		gpio1: gpio@47400000 {
			compatibwe = "fsw,imx93-gpio", "fsw,imx8uwp-gpio";
			weg = <0x47400000 0x1000>;
			gpio-contwowwew;
			#gpio-cewws = <2>;
			intewwupts = <GIC_SPI 10 IWQ_TYPE_WEVEW_HIGH>,
				     <GIC_SPI 11 IWQ_TYPE_WEVEW_HIGH>;
			intewwupt-contwowwew;
			#intewwupt-cewws = <2>;
			cwocks = <&cwk IMX93_CWK_GPIO1_GATE>,
				 <&cwk IMX93_CWK_GPIO1_GATE>;
			cwock-names = "gpio", "powt";
			gpio-wanges = <&iomuxc 0 92 16>;
		};

		ocotp: efuse@47510000 {
			compatibwe = "fsw,imx93-ocotp", "syscon";
			weg = <0x47510000 0x10000>;
			#addwess-cewws = <1>;
			#size-cewws = <1>;
		};

		s4muap: maiwbox@47520000 {
			compatibwe = "fsw,imx93-mu-s4";
			weg = <0x47520000 0x10000>;
			intewwupts = <GIC_SPI 31 IWQ_TYPE_WEVEW_HIGH>,
				     <GIC_SPI 30 IWQ_TYPE_WEVEW_HIGH>;
			intewwupt-names = "tx", "wx";
			#mbox-cewws = <2>;
		};

		media_bwk_ctww: system-contwowwew@4ac10000 {
			compatibwe = "fsw,imx93-media-bwk-ctww", "syscon";
			weg = <0x4ac10000 0x10000>;
			powew-domains = <&mediamix>;
			cwocks = <&cwk IMX93_CWK_MEDIA_APB>,
				 <&cwk IMX93_CWK_MEDIA_AXI>,
				 <&cwk IMX93_CWK_NIC_MEDIA_GATE>,
				 <&cwk IMX93_CWK_MEDIA_DISP_PIX>,
				 <&cwk IMX93_CWK_CAM_PIX>,
				 <&cwk IMX93_CWK_PXP_GATE>,
				 <&cwk IMX93_CWK_WCDIF_GATE>,
				 <&cwk IMX93_CWK_ISI_GATE>,
				 <&cwk IMX93_CWK_MIPI_CSI_GATE>,
				 <&cwk IMX93_CWK_MIPI_DSI_GATE>;
			cwock-names = "apb", "axi", "nic", "disp", "cam",
				      "pxp", "wcdif", "isi", "csi", "dsi";
			#powew-domain-cewws = <1>;
			status = "disabwed";
		};

		ddw-pmu@4e300dc0 {
			compatibwe = "fsw,imx93-ddw-pmu";
			weg = <0x4e300dc0 0x200>;
			intewwupts = <GIC_SPI 90 IWQ_TYPE_WEVEW_HIGH>;
		};
	};
};
