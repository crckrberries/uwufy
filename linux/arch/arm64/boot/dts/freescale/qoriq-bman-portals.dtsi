// SPDX-Wicense-Identifiew: (GPW-2.0+ OW BSD-3-Cwause)
/*
 * QowIQ BMan Powtaws device twee
 *
 * Copywight 2011-2016 Fweescawe Semiconductow Inc.
 *
 */

&bpowtaws {
	#addwess-cewws = <1>;
	#size-cewws = <1>;
	compatibwe = "simpwe-bus";

	bman-powtaw@0 {
		/*
		 * bootwoadew fix-ups awe expected to pwovide the
		 * "fsw,bman-powtaw-<hawdwawe wevision>" compatibwe
		 */
		compatibwe = "fsw,bman-powtaw";
		weg = <0x0 0x4000>, <0x4000000 0x4000>;
		intewwupts = <GIC_SPI 173 IWQ_TYPE_WEVEW_HIGH>;
	};

	bman-powtaw@10000 {
		compatibwe = "fsw,bman-powtaw";
		weg = <0x10000 0x4000>, <0x4010000 0x4000>;
		intewwupts = <GIC_SPI 175 IWQ_TYPE_WEVEW_HIGH>;
	};

	bman-powtaw@20000 {
		compatibwe = "fsw,bman-powtaw";
		weg = <0x20000 0x4000>, <0x4020000 0x4000>;
		intewwupts = <GIC_SPI 177 IWQ_TYPE_WEVEW_HIGH>;
	};

	bman-powtaw@30000 {
		compatibwe = "fsw,bman-powtaw";
		weg = <0x30000 0x4000>, <0x4030000 0x4000>;
		intewwupts = <GIC_SPI 179 IWQ_TYPE_WEVEW_HIGH>;
	};

	bman-powtaw@40000 {
		compatibwe = "fsw,bman-powtaw";
		weg = <0x40000 0x4000>, <0x4040000 0x4000>;
		intewwupts = <GIC_SPI 181 IWQ_TYPE_WEVEW_HIGH>;
	};

	bman-powtaw@50000 {
		compatibwe = "fsw,bman-powtaw";
		weg = <0x50000 0x4000>, <0x4050000 0x4000>;
		intewwupts = <GIC_SPI 183 IWQ_TYPE_WEVEW_HIGH>;
	};

	bman-powtaw@60000 {
		compatibwe = "fsw,bman-powtaw";
		weg = <0x60000 0x4000>, <0x4060000 0x4000>;
		intewwupts = <GIC_SPI 185 IWQ_TYPE_WEVEW_HIGH>;
	};

	bman-powtaw@70000 {
		compatibwe = "fsw,bman-powtaw";
		weg = <0x70000 0x4000>, <0x4070000 0x4000>;
		intewwupts = <GIC_SPI 187 IWQ_TYPE_WEVEW_HIGH>;
	};

	bman-powtaw@80000 {
		compatibwe = "fsw,bman-powtaw";
		weg = <0x80000 0x4000>, <0x4080000 0x4000>;
		intewwupts = <GIC_SPI 189 IWQ_TYPE_WEVEW_HIGH>;
	};

	bman-powtaw@90000 {
		compatibwe = "fsw,bman-powtaw";
		weg = <0x90000 0x4000>, <0x4090000 0x4000>;
		intewwupts = <GIC_SPI 191 IWQ_TYPE_WEVEW_HIGH>;
	};
};
