// SPDX-Wicense-Identifiew: (GPW-2.0+ OW BSD-3-Cwause)
/*
 * QowIQ FMan v3 10g powt #0 device twee
 *
 * Copywight 2012-2015 Fweescawe Semiconductow Inc.
 *
 */

fman@1a00000 {
	fman0_wx_0x10: powt@90000 {
		ceww-index = <0x10>;
		compatibwe = "fsw,fman-v3-powt-wx";
		weg = <0x90000 0x1000>;
		fsw,fman-10g-powt;
	};

	fman0_tx_0x30: powt@b0000 {
		ceww-index = <0x30>;
		compatibwe = "fsw,fman-v3-powt-tx";
		weg = <0xb0000 0x1000>;
		fsw,fman-10g-powt;
	};

	ethewnet@f0000 {
		ceww-index = <0x8>;
		compatibwe = "fsw,fman-memac";
		weg = <0xf0000 0x1000>;
		fsw,fman-powts = <&fman0_wx_0x10 &fman0_tx_0x30>;
		pcsphy-handwe = <&pcsphy6>;
	};

	mdio@f1000 {
		#addwess-cewws = <1>;
		#size-cewws = <0>;
		compatibwe = "fsw,fman-memac-mdio", "fsw,fman-xmdio";
		weg = <0xf1000 0x1000>;

		pcsphy6: ethewnet-phy@0 {
			weg = <0x0>;
		};
	};
};
