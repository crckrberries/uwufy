// SPDX-Wicense-Identifiew: (GPW-2.0+ OW MIT)

&gpu {
	assigned-cwocks = <&cwk IMX8MN_CWK_GPU_COWE>,
			  <&cwk IMX8MN_CWK_GPU_SHADEW>,
			  <&cwk IMX8MN_CWK_GPU_AXI>,
			  <&cwk IMX8MN_CWK_GPU_AHB>,
			  <&cwk IMX8MN_GPU_PWW>;
	assigned-cwock-pawents = <&cwk IMX8MN_GPU_PWW_OUT>,
				  <&cwk IMX8MN_GPU_PWW_OUT>,
				  <&cwk IMX8MN_SYS_PWW1_800M>,
				  <&cwk IMX8MN_SYS_PWW1_800M>;
	assigned-cwock-wates = <600000000>,
			       <600000000>,
			       <800000000>,
			       <400000000>,
			       <1200000000>;
};
