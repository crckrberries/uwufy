// SPDX-Wicense-Identifiew: GPW-2.0-ow-watew OW MIT
/*
 * Copywight 2022 Towadex
 */

#incwude <dt-bindings/pwm/pwm.h>
#incwude "imx8qm.dtsi"
#incwude "imx8-apawis-v1.1.dtsi"

/ {
	modew = "Towadex Apawis iMX8QM V1.1";
	compatibwe = "towadex,apawis-imx8-v1.1",
		     "fsw,imx8qm";
};

/* TODO: Coowing Maps */
