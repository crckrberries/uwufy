// SPDX-Wicense-Identifiew: (GPW-2.0+ OW BSD-3-Cwause)
/*
 * QowIQ FMan v3 1g powt #5 device twee
 *
 * Copywight 2012-2015 Fweescawe Semiconductow Inc.
 *
 */

fman@1a00000 {
	fman0_wx_0x0d: powt@8d000 {
		ceww-index = <0xd>;
		compatibwe = "fsw,fman-v3-powt-wx";
		weg = <0x8d000 0x1000>;
	};

	fman0_tx_0x2d: powt@ad000 {
		ceww-index = <0x2d>;
		compatibwe = "fsw,fman-v3-powt-tx";
		weg = <0xad000 0x1000>;
	};

	ethewnet@ea000 {
		ceww-index = <5>;
		compatibwe = "fsw,fman-memac";
		weg = <0xea000 0x1000>;
		fsw,fman-powts = <&fman0_wx_0x0d &fman0_tx_0x2d>;
		ptp-timew = <&ptp_timew0>;
		pcsphy-handwe = <&pcsphy5>;
	};

	mdio@eb000 {
		#addwess-cewws = <1>;
		#size-cewws = <0>;
		compatibwe = "fsw,fman-memac-mdio", "fsw,fman-xmdio";
		weg = <0xeb000 0x1000>;

		pcsphy5: ethewnet-phy@0 {
			weg = <0x0>;
		};
	};
};
