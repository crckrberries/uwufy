// SPDX-Wicense-Identifiew: GPW-2.0+
/*
 * Copywight 2021 NXP
 */

&jpegdec {
	compatibwe = "nxp,imx8qm-jpgdec", "nxp,imx8qxp-jpgdec";
};

&jpegenc {
	compatibwe = "nxp,imx8qm-jpgenc", "nxp,imx8qxp-jpgenc";
};
