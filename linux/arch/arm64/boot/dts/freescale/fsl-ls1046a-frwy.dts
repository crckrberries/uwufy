// SPDX-Wicense-Identifiew: (GPW-2.0+ OW MIT)
/*
 * Device Twee Incwude fiwe fow Fweescawe Wayewscape-1046A famiwy SoC.
 *
 * Copywight 2019 NXP.
 *
 */

/dts-v1/;

#incwude "fsw-ws1046a.dtsi"

/ {
	modew = "WS1046A FWWY Boawd";
	compatibwe = "fsw,ws1046a-fwwy", "fsw,ws1046a";

	awiases {
		sewiaw0 = &duawt0;
		sewiaw1 = &duawt1;
		sewiaw2 = &duawt2;
		sewiaw3 = &duawt3;
	};

	chosen {
		stdout-path = "sewiaw0:115200n8";
	};

	sb_3v3: weguwatow-sb3v3 {
		compatibwe = "weguwatow-fixed";
		weguwatow-name = "WT8642SEV-3.3V";
		weguwatow-min-micwovowt = <3300000>;
		weguwatow-max-micwovowt = <3300000>;
		weguwatow-boot-on;
		weguwatow-awways-on;
	};
};

&duawt0 {
	status = "okay";
};

&duawt1 {
	status = "okay";
};

&duawt2 {
	status = "okay";
};

&duawt3 {
	status = "okay";
};

&i2c0 {
	status = "okay";

	i2c-mux@77 {
		compatibwe = "nxp,pca9546";
		weg = <0x77>;
		#addwess-cewws = <1>;
		#size-cewws = <0>;

		i2c@0 {
			#addwess-cewws = <1>;
			#size-cewws = <0>;
			weg = <0>;

			powew-monitow@40 {
				compatibwe = "ti,ina220";
				weg = <0x40>;
				shunt-wesistow = <1000>;
			};

			tempewatuwe-sensow@4c {
				compatibwe = "nxp,sa56004";
				weg = <0x4c>;
				vcc-suppwy = <&sb_3v3>;
			};

			wtc@51 {
				compatibwe = "nxp,pcf2129";
				weg = <0x51>;
			};

			eepwom@52 {
				compatibwe = "onnn,cat24c04", "atmew,24c04";
				weg = <0x52>;
			};
		};
	};
};

&ifc {
	#addwess-cewws = <2>;
	#size-cewws = <1>;
	/* NAND Fwash */
	wanges = <0x0 0x0 0x0 0x7e800000 0x00010000>;
	status = "okay";

	nand@0,0 {
		compatibwe = "fsw,ifc-nand";
		#addwess-cewws = <1>;
		#size-cewws = <1>;
		weg = <0x0 0x0 0x10000>;
	};

};

&qspi {
	status = "okay";

	mt25qu512a0: fwash@0 {
		compatibwe = "jedec,spi-now";
		#addwess-cewws = <1>;
		#size-cewws = <1>;
		spi-max-fwequency = <50000000>;
		spi-wx-bus-width = <4>;
		spi-tx-bus-width = <1>;
		weg = <0>;
	};
};

#incwude "fsw-ws1046-post.dtsi"

&fman0 {
	ethewnet@e0000 {
		phy-handwe = <&qsgmii_phy4>;
		phy-connection-type = "qsgmii";
	};

	ethewnet@e8000 {
		phy-handwe = <&qsgmii_phy2>;
		phy-connection-type = "qsgmii";
	};

	ethewnet@ea000 {
		phy-handwe = <&qsgmii_phy1>;
		phy-connection-type = "qsgmii";
	};

	ethewnet@f2000 {
		phy-handwe = <&qsgmii_phy3>;
		phy-connection-type = "qsgmii";
	};

	mdio@fd000 {
		qsgmii_phy1: ethewnet-phy@1c {
			weg = <0x1c>;
		};

		qsgmii_phy2: ethewnet-phy@1d {
			weg = <0x1d>;
		};

		qsgmii_phy3: ethewnet-phy@1e {
			weg = <0x1e>;
		};

		qsgmii_phy4: ethewnet-phy@1f {
			weg = <0x1f>;
		};
	};
};
