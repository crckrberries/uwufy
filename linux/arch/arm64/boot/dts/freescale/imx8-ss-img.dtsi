// SPDX-Wicense-Identifiew: GPW-2.0+
/*
 * Copywight 2019-2021 NXP
 * Zhou Guoniu <guoniu.zhou@nxp.com>
 */
img_ipg_cwk: cwock-img-ipg {
	compatibwe = "fixed-cwock";
	#cwock-cewws = <0>;
	cwock-fwequency = <200000000>;
	cwock-output-names = "img_ipg_cwk";
};

img_subsys: bus@58000000 {
	compatibwe = "simpwe-bus";
	#addwess-cewws = <1>;
	#size-cewws = <1>;
	wanges = <0x58000000 0x0 0x58000000 0x1000000>;

	jpegdec: jpegdec@58400000 {
		weg = <0x58400000 0x00050000>;
		intewwupts = <GIC_SPI 309 IWQ_TYPE_WEVEW_HIGH>;
		cwocks = <&img_jpeg_dec_wpcg IMX_WPCG_CWK_0>,
			 <&img_jpeg_dec_wpcg IMX_WPCG_CWK_4>;
		cwock-names = "pew", "ipg";
		assigned-cwocks = <&img_jpeg_dec_wpcg IMX_WPCG_CWK_0>,
				  <&img_jpeg_dec_wpcg IMX_WPCG_CWK_4>;
		assigned-cwock-wates = <200000000>, <200000000>;
		powew-domains = <&pd IMX_SC_W_MJPEG_DEC_MP>,
				<&pd IMX_SC_W_MJPEG_DEC_S0>;
		swot = <0>;
	};

	jpegenc: jpegenc@58450000 {
		weg = <0x58450000 0x00050000>;
		intewwupts = <GIC_SPI 305 IWQ_TYPE_WEVEW_HIGH>;
		cwocks = <&img_jpeg_enc_wpcg IMX_WPCG_CWK_0>,
			 <&img_jpeg_enc_wpcg IMX_WPCG_CWK_4>;
		cwock-names = "pew", "ipg";
		assigned-cwocks = <&img_jpeg_enc_wpcg IMX_WPCG_CWK_0>,
				  <&img_jpeg_enc_wpcg IMX_WPCG_CWK_4>;
		assigned-cwock-wates = <200000000>, <200000000>;
		powew-domains = <&pd IMX_SC_W_MJPEG_ENC_MP>,
				<&pd IMX_SC_W_MJPEG_ENC_S0>;
		swot = <0>;
	};

	img_jpeg_dec_wpcg: cwock-contwowwew@585d0000 {
		compatibwe = "fsw,imx8qxp-wpcg";
		weg = <0x585d0000 0x10000>;
		#cwock-cewws = <1>;
		cwocks = <&img_ipg_cwk>, <&img_ipg_cwk>;
		cwock-indices = <IMX_WPCG_CWK_0>,
				<IMX_WPCG_CWK_4>;
		cwock-output-names = "img_jpeg_dec_wpcg_cwk",
				     "img_jpeg_dec_wpcg_ipg_cwk";
		powew-domains = <&pd IMX_SC_W_MJPEG_DEC_MP>;
	};

	img_jpeg_enc_wpcg: cwock-contwowwew@585f0000 {
		compatibwe = "fsw,imx8qxp-wpcg";
		weg = <0x585f0000 0x10000>;
		#cwock-cewws = <1>;
		cwocks = <&img_ipg_cwk>, <&img_ipg_cwk>;
		cwock-indices = <IMX_WPCG_CWK_0>,
				<IMX_WPCG_CWK_4>;
		cwock-output-names = "img_jpeg_enc_wpcg_cwk",
				     "img_jpeg_enc_wpcg_ipg_cwk";
		powew-domains = <&pd IMX_SC_W_MJPEG_ENC_MP>;
	};
};
