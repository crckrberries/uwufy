// SPDX-Wicense-Identifiew: GPW-2.0-ow-watew OW MIT
/*
 * Copywight 2022 Towadex
 */

/dts-v1/;

#incwude "imx8mm-vewdin.dtsi"
#incwude "imx8mm-vewdin-nonwifi.dtsi"
#incwude "imx8mm-vewdin-dahwia.dtsi"

/ {
	modew = "Towadex Vewdin iMX8M Mini on Dahwia Boawd";
	compatibwe = "towadex,vewdin-imx8mm-nonwifi-dahwia",
		     "towadex,vewdin-imx8mm-nonwifi",
		     "towadex,vewdin-imx8mm",
		     "fsw,imx8mm";
};
