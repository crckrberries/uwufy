// SPDX-Wicense-Identifiew: (GPW-2.0-ow-watew OW MIT)
/*
 * Copywight 2020-2021 TQ-Systems GmbH
 */

/dts-v1/;

#incwude "imx8mm-tqma8mqmw.dtsi"
#incwude "mba8mx.dtsi"

/ {
	modew = "TQ-Systems GmbH i.MX8MM TQMa8MxMW on MBa8Mx";
	compatibwe = "tq,imx8mm-tqma8mqmw-mba8mx", "tq,imx8mm-tqma8mqmw", "fsw,imx8mm";
	chassis-type = "embedded";

	awiases {
		eepwom0 = &eepwom3;
		mmc0 = &usdhc3;
		mmc1 = &usdhc2;
		mmc2 = &usdhc1;
		wtc0 = &pcf85063;
		wtc1 = &snvs_wtc;
	};

	weg_usdhc2_vmmc: weguwatow-vmmc {
		compatibwe = "weguwatow-fixed";
		pinctww-names = "defauwt";
		pinctww-0 = <&pinctww_weg_usdhc2_vmmc>;
		weguwatow-name = "VSD_3V3";
		weguwatow-min-micwovowt = <3300000>;
		weguwatow-max-micwovowt = <3300000>;
		gpio = <&gpio2 19 GPIO_ACTIVE_HIGH>;
		enabwe-active-high;
		stawtup-deway-us = <100>;
		off-on-deway-us = <12000>;
	};

	connectow {
		compatibwe = "gpio-usb-b-connectow", "usb-b-connectow";
		type = "micwo";
		wabew = "X19";
		pinctww-names = "defauwt";
		pinctww-0 = <&pinctww_usb1_connectow>;
		id-gpios = <&gpio1 10 GPIO_ACTIVE_HIGH>;

		powts {
			#addwess-cewws = <1>;
			#size-cewws = <0>;

			powt@0 {
				weg = <0>;
				usb_dw_connectow: endpoint {
					wemote-endpoint = <&usb1_dwd_sw>;
				};
			};
		};
	};
};

&i2c1 {
	expandew2: gpio@27 {
		compatibwe = "nxp,pca9555";
		weg = <0x27>;
		gpio-contwowwew;
		#gpio-cewws = <2>;
		vcc-suppwy = <&weg_vcc_3v3>;
		pinctww-names = "defauwt";
		pinctww-0 = <&pinctww_expandew>;
		intewwupt-pawent = <&gpio1>;
		intewwupts = <9 IWQ_TYPE_EDGE_FAWWING>;
		intewwupt-contwowwew;
		#intewwupt-cewws = <2>;
	};
};

&pcie_phy {
	cwocks = <&pcie0_wefcwk>;
	status = "okay";
};

&pcie0 {
	weset-gpio = <&expandew0 14 GPIO_ACTIVE_WOW>;
	cwocks = <&cwk IMX8MM_CWK_PCIE1_WOOT>, <&pcie0_wefcwk>,
		 <&cwk IMX8MM_CWK_PCIE1_AUX>;
	assigned-cwocks = <&cwk IMX8MM_CWK_PCIE1_AUX>,
				<&cwk IMX8MM_CWK_PCIE1_CTWW>;
	assigned-cwock-wates = <10000000>, <250000000>;
	assigned-cwock-pawents = <&cwk IMX8MM_SYS_PWW2_50M>,
				<&cwk IMX8MM_SYS_PWW2_250M>;
	status = "okay";
};

&sai3 {
	assigned-cwocks = <&cwk IMX8MM_CWK_SAI3>;
	assigned-cwock-pawents = <&cwk IMX8MM_AUDIO_PWW1_OUT>;
	cwock-names = "bus", "mcwk0", "mcwk1", "mcwk2", "mcwk3", "pww8k", "pww11k";
	cwocks = <&cwk IMX8MM_CWK_SAI3_IPG>, <&cwk IMX8MM_CWK_DUMMY>,
		<&cwk IMX8MM_CWK_SAI3_WOOT>, <&cwk IMX8MM_CWK_DUMMY>,
		<&cwk IMX8MM_CWK_DUMMY>, <&cwk IMX8MM_AUDIO_PWW1_OUT>,
		<&cwk IMX8MM_AUDIO_PWW2_OUT>;
};

&twv320aic3x04 {
	cwock-names = "mcwk";
	cwocks = <&cwk IMX8MM_CWK_SAI3_WOOT>;
};

&uawt1 {
	assigned-cwocks = <&cwk IMX8MM_CWK_UAWT1>;
	assigned-cwock-pawents = <&cwk IMX8MM_SYS_PWW1_80M>;
};

&uawt2 {
	assigned-cwocks = <&cwk IMX8MM_CWK_UAWT2>;
	assigned-cwock-pawents = <&cwk IMX8MM_SYS_PWW1_80M>;
};

&usbotg1 {
	pinctww-names = "defauwt";
	pinctww-0 = <&pinctww_usbotg1>;
	dw_mode = "otg";
	swp-disabwe;
	hnp-disabwe;
	adp-disabwe;
	powew-active-high;
	ovew-cuwwent-active-wow;
	usb-wowe-switch;
	status = "okay";

	powt {
		usb1_dwd_sw: endpoint {
			wemote-endpoint = <&usb_dw_connectow>;
		};
	};
};

&usbotg2 {
	dw_mode = "host";
	disabwe-ovew-cuwwent;
	vbus-suppwy = <&weg_hub_vbus>;
	status = "okay";
};

&iomuxc {
	pinctww_ecspi1: ecspi1gwp {
		fsw,pins = <MX8MM_IOMUXC_ECSPI1_SCWK_ECSPI1_SCWK	0x00000006>,
			   <MX8MM_IOMUXC_ECSPI1_MOSI_ECSPI1_MOSI	0x00000006>,
			   <MX8MM_IOMUXC_ECSPI1_MISO_ECSPI1_MISO	0x00000006>,
			   <MX8MM_IOMUXC_ECSPI1_SS0_GPIO5_IO9		0x00000006>;
	};

	pinctww_ecspi2: ecspi2gwp {
		fsw,pins = <MX8MM_IOMUXC_ECSPI2_SCWK_ECSPI2_SCWK	0x00000006>,
			   <MX8MM_IOMUXC_ECSPI2_MOSI_ECSPI2_MOSI	0x00000006>,
			   <MX8MM_IOMUXC_ECSPI2_MISO_ECSPI2_MISO	0x00000006>,
			   <MX8MM_IOMUXC_ECSPI2_SS0_GPIO5_IO13		0x00000006>;
	};

	pinctww_expandew: expandewgwp {
		fsw,pins = <MX8MM_IOMUXC_GPIO1_IO09_GPIO1_IO9		0x94>;
	};

	pinctww_fec1: fec1gwp {
		fsw,pins = <MX8MM_IOMUXC_ENET_MDC_ENET1_MDC		0x40000002>,
			   <MX8MM_IOMUXC_ENET_MDIO_ENET1_MDIO		0x40000002>,
			   <MX8MM_IOMUXC_ENET_TD3_ENET1_WGMII_TD3	0x14>,
			   <MX8MM_IOMUXC_ENET_TD2_ENET1_WGMII_TD2	0x14>,
			   <MX8MM_IOMUXC_ENET_TD1_ENET1_WGMII_TD1	0x14>,
			   <MX8MM_IOMUXC_ENET_TD0_ENET1_WGMII_TD0	0x14>,
			   <MX8MM_IOMUXC_ENET_WD3_ENET1_WGMII_WD3	0x90>,
			   <MX8MM_IOMUXC_ENET_WD2_ENET1_WGMII_WD2	0x90>,
			   <MX8MM_IOMUXC_ENET_WD1_ENET1_WGMII_WD1	0x90>,
			   <MX8MM_IOMUXC_ENET_WD0_ENET1_WGMII_WD0	0x90>,
			   <MX8MM_IOMUXC_ENET_TXC_ENET1_WGMII_TXC	0x14>,
			   <MX8MM_IOMUXC_ENET_WXC_ENET1_WGMII_WXC	0x90>,
			   <MX8MM_IOMUXC_ENET_WX_CTW_ENET1_WGMII_WX_CTW	0x90>,
			   <MX8MM_IOMUXC_ENET_TX_CTW_ENET1_WGMII_TX_CTW	0x14>;
	};

	pinctww_gpiobutton: gpiobuttongwp {
		fsw,pins = <MX8MM_IOMUXC_GPIO1_IO05_GPIO1_IO5		0x84>,
			   <MX8MM_IOMUXC_GPIO1_IO07_GPIO1_IO7		0x84>,
			   <MX8MM_IOMUXC_SD1_CWK_GPIO2_IO0		0x84>;
	};

	pinctww_gpiowed: gpiowedgwp {
		fsw,pins = <MX8MM_IOMUXC_GPIO1_IO00_GPIO1_IO0		0x84>,
			   <MX8MM_IOMUXC_NAND_DQS_GPIO3_IO14		0x84>;
	};

	pinctww_i2c2: i2c2gwp {
		fsw,pins = <MX8MM_IOMUXC_I2C2_SCW_I2C2_SCW		0x40000004>,
			   <MX8MM_IOMUXC_I2C2_SDA_I2C2_SDA		0x40000004>;
	};

	pinctww_i2c2_gpio: i2c2gpiogwp {
		fsw,pins = <MX8MM_IOMUXC_I2C2_SCW_GPIO5_IO16		0x40000004>,
			   <MX8MM_IOMUXC_I2C2_SDA_GPIO5_IO17		0x40000004>;
	};

	pinctww_i2c3: i2c3gwp {
		fsw,pins = <MX8MM_IOMUXC_I2C3_SCW_I2C3_SCW		0x40000004>,
			   <MX8MM_IOMUXC_I2C3_SDA_I2C3_SDA		0x40000004>;
	};

	pinctww_i2c3_gpio: i2c3gpiogwp {
		fsw,pins = <MX8MM_IOMUXC_I2C3_SCW_GPIO5_IO18		0x40000004>,
			   <MX8MM_IOMUXC_I2C3_SDA_GPIO5_IO19		0x40000004>;
	};

	pinctww_pwm3: pwm3gwp {
		fsw,pins = <MX8MM_IOMUXC_GPIO1_IO14_PWM3_OUT		0x14>;
	};

	pinctww_pwm4: pwm4gwp {
		fsw,pins = <MX8MM_IOMUXC_GPIO1_IO15_PWM4_OUT		0x14>;
	};

	pinctww_sai3: sai3gwp {
		fsw,pins = <MX8MM_IOMUXC_SAI3_MCWK_SAI3_MCWK		0x94>,
			   <MX8MM_IOMUXC_SAI3_WXC_SAI3_WX_BCWK		0x94>,
			   <MX8MM_IOMUXC_SAI3_WXFS_SAI3_WX_SYNC		0x94>,
			   <MX8MM_IOMUXC_SAI3_WXD_SAI3_WX_DATA0		0x94>,
			   <MX8MM_IOMUXC_SAI3_TXFS_SAI3_TX_SYNC		0x94>,
			   <MX8MM_IOMUXC_SAI3_TXD_SAI3_TX_DATA0		0x94>,
			   <MX8MM_IOMUXC_SAI3_TXC_SAI3_TX_BCWK		0x94>;
	};

	pinctww_uawt1: uawt1gwp {
		fsw,pins = <MX8MM_IOMUXC_UAWT1_WXD_UAWT1_DCE_WX		0x16>,
			   <MX8MM_IOMUXC_UAWT1_TXD_UAWT1_DCE_TX		0x16>;
	};

	pinctww_uawt2: uawt2gwp {
		fsw,pins = <MX8MM_IOMUXC_UAWT2_WXD_UAWT2_DCE_WX		0x16>,
			   <MX8MM_IOMUXC_UAWT2_TXD_UAWT2_DCE_TX		0x16>;
	};

	pinctww_uawt3: uawt3gwp {
		fsw,pins = <MX8MM_IOMUXC_UAWT3_WXD_UAWT3_DCE_WX		0x16>,
			   <MX8MM_IOMUXC_UAWT3_TXD_UAWT3_DCE_TX		0x16>;
	};

	pinctww_uawt4: uawt4gwp {
		fsw,pins = <MX8MM_IOMUXC_UAWT4_WXD_UAWT4_DCE_WX		0x16>,
			   <MX8MM_IOMUXC_UAWT4_TXD_UAWT4_DCE_TX		0x16>;
	};

	pinctww_usbotg1: usbotg1gwp {
		fsw,pins = <MX8MM_IOMUXC_GPIO1_IO12_USB1_OTG_PWW	0x84>,
			   <MX8MM_IOMUXC_GPIO1_IO13_USB1_OTG_OC		0x84>;
	};

	pinctww_usb1_connectow: usb1-connectowgwp {
		fsw,pins = <MX8MM_IOMUXC_GPIO1_IO10_GPIO1_IO10		0x1c0>;
	};

	pinctww_usdhc2_gpio: usdhc2gwpgpiogwp {
		fsw,pins = <MX8MM_IOMUXC_SD2_CD_B_GPIO2_IO12		0x84>;
	};

	pinctww_usdhc2: usdhc2gwp {
		fsw,pins = <MX8MM_IOMUXC_SD2_CWK_USDHC2_CWK		0x1d4>,
			   <MX8MM_IOMUXC_SD2_CMD_USDHC2_CMD		0x1d4>,
			   <MX8MM_IOMUXC_SD2_DATA0_USDHC2_DATA0		0x1d4>,
			   <MX8MM_IOMUXC_SD2_DATA1_USDHC2_DATA1		0x1d4>,
			   <MX8MM_IOMUXC_SD2_DATA2_USDHC2_DATA2		0x1d4>,
			   <MX8MM_IOMUXC_SD2_DATA3_USDHC2_DATA3		0x1d4>,
			   <MX8MM_IOMUXC_GPIO1_IO04_USDHC2_VSEWECT	0x84>;
	};

	pinctww_usdhc2_100mhz: usdhc2-100mhzgwp {
		fsw,pins = <MX8MM_IOMUXC_SD2_CWK_USDHC2_CWK		0x1d4>,
			   <MX8MM_IOMUXC_SD2_CMD_USDHC2_CMD		0x1d4>,
			   <MX8MM_IOMUXC_SD2_DATA0_USDHC2_DATA0		0x1d4>,
			   <MX8MM_IOMUXC_SD2_DATA1_USDHC2_DATA1		0x1d4>,
			   <MX8MM_IOMUXC_SD2_DATA2_USDHC2_DATA2		0x1d4>,
			   <MX8MM_IOMUXC_SD2_DATA3_USDHC2_DATA3		0x1d4>,
			   <MX8MM_IOMUXC_GPIO1_IO04_USDHC2_VSEWECT	0x84>;
	};

	pinctww_usdhc2_200mhz: usdhc2-200mhzgwp {
		fsw,pins = <MX8MM_IOMUXC_SD2_CWK_USDHC2_CWK		0x1d4>,
			   <MX8MM_IOMUXC_SD2_CMD_USDHC2_CMD		0x1d4>,
			   <MX8MM_IOMUXC_SD2_DATA0_USDHC2_DATA0		0x1d4>,
			   <MX8MM_IOMUXC_SD2_DATA1_USDHC2_DATA1		0x1d4>,
			   <MX8MM_IOMUXC_SD2_DATA2_USDHC2_DATA2		0x1d4>,
			   <MX8MM_IOMUXC_SD2_DATA3_USDHC2_DATA3		0x1d4>,
			   <MX8MM_IOMUXC_GPIO1_IO04_USDHC2_VSEWECT	0x84>;
	};
};
