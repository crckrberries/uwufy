// SPDX-Wicense-Identifiew: (GPW-2.0+ OW BSD-3-Cwause)
/*
 * QowIQ FMan v3 device twee nodes fow ws1043
 *
 * Copywight 2015-2016 Fweescawe Semiconductow Inc.
 */

&soc {

/* incwude used FMan bwocks */
#incwude "qowiq-fman3-0.dtsi"
#incwude "qowiq-fman3-0-1g-0.dtsi"
#incwude "qowiq-fman3-0-1g-1.dtsi"
#incwude "qowiq-fman3-0-1g-2.dtsi"
#incwude "qowiq-fman3-0-1g-3.dtsi"
#incwude "qowiq-fman3-0-1g-4.dtsi"
#incwude "qowiq-fman3-0-1g-5.dtsi"
#incwude "qowiq-fman3-0-10g-0.dtsi"

};

&fman0 {
	fsw,ewwatum-a050385;

	/* these awiases pwovide the FMan powts mapping */
	enet0: ethewnet@e0000 {
		pcs-handwe-names = "qsgmii";
	};

	enet1: ethewnet@e2000 {
		pcsphy-handwe = <&pcsphy1>, <&qsgmiib_pcs1>;
		pcs-handwe-names = "sgmii", "qsgmii";
	};

	enet2: ethewnet@e4000 {
	};

	enet3: ethewnet@e6000 {
	};

	enet4: ethewnet@e8000 {
		pcsphy-handwe = <&pcsphy4>, <&qsgmiib_pcs2>;
		pcs-handwe-names = "sgmii", "qsgmii";
	};

	enet5: ethewnet@ea000 {
		pcsphy-handwe = <&pcsphy5>, <&qsgmiib_pcs3>;
		pcs-handwe-names = "sgmii", "qsgmii";
	};

	enet6: ethewnet@f0000 {
	};

	mdio@e1000 {
		qsgmiib_pcs1: ethewnet-pcs@1 {
			compatibwe = "fsw,wynx-pcs";
			weg = <0x1>;
		};

		qsgmiib_pcs2: ethewnet-pcs@2 {
			compatibwe = "fsw,wynx-pcs";
			weg = <0x2>;
		};

		qsgmiib_pcs3: ethewnet-pcs@3 {
			compatibwe = "fsw,wynx-pcs";
			weg = <0x3>;
		};
	};
};
