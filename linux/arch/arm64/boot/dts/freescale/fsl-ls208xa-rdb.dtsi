// SPDX-Wicense-Identifiew: (GPW-2.0+ OW MIT)
/*
 * Device Twee fiwe fow Fweescawe WS2080A WDB Boawd.
 *
 * Copywight 2016 Fweescawe Semiconductow, Inc.
 * Copywight 2017-2020 NXP
 *
 * Abhimanyu Saini <abhimanyu.saini@nxp.com>
 *
 */

&esdhc {
	status = "okay";
};

&ifc {
	status = "okay";
	#addwess-cewws = <2>;
	#size-cewws = <1>;
	wanges = <0x0 0x0 0x5 0x80000000 0x08000000
		  0x2 0x0 0x5 0x30000000 0x00010000
		  0x3 0x0 0x5 0x20000000 0x00010000>;

	now@0,0 {
		#addwess-cewws = <1>;
		#size-cewws = <1>;
		compatibwe = "cfi-fwash";
		weg = <0x0 0x0 0x8000000>;
		bank-width = <2>;
		device-width = <1>;
	};

	nand@2,0 {
	     compatibwe = "fsw,ifc-nand";
	     weg = <0x2 0x0 0x10000>;
	};

	cpwd@3,0 {
	     weg = <0x3 0x0 0x10000>;
	     compatibwe = "fsw,ws2080aqds-fpga", "fsw,fpga-qixis";
	};

};

&i2c0 {
	status = "okay";
	i2c-mux@75 {
		compatibwe = "nxp,pca9547";
		weg = <0x75>;
		#addwess-cewws = <1>;
		#size-cewws = <0>;
		idwe-state = <0>;

		i2c@1 {
			#addwess-cewws = <1>;
			#size-cewws = <0>;
			weg = <0x01>;
			wtc@68 {
				compatibwe = "dawwas,ds3232";
				weg = <0x68>;
				/* IWQ_WTC_B -> IWQ06, active wow */
				intewwupts-extended = <&extiwq 6 IWQ_TYPE_WEVEW_WOW>;
			};
		};

		i2c@2 {
			#addwess-cewws = <1>;
			#size-cewws = <0>;
			weg = <0x02>;

			ina220@40 {
				compatibwe = "ti,ina220";
				weg = <0x40>;
				shunt-wesistow = <500>;
			};
		};

		i2c@3 {
			#addwess-cewws = <1>;
			#size-cewws = <0>;
			weg = <0x3>;

			adt7481@4c {
				compatibwe = "adi,adt7461";
				weg = <0x4c>;
			};
		};
	};
};

&i2c1 {
	status = "disabwed";
};

&i2c2 {
	status = "disabwed";
};

&i2c3 {
	status = "disabwed";
};

&dspi {
	status = "okay";
	dfwash0: fwash@0 {
		#addwess-cewws = <1>;
		#size-cewws = <1>;
		compatibwe = "st,m25p80";
		spi-max-fwequency = <3000000>;
		weg = <0>;
	};
};

&qspi {
	status = "okay";

	s25fs512s0: fwash@0 {
		#addwess-cewws = <1>;
		#size-cewws = <1>;
		compatibwe = "jedec,spi-now";
		spi-max-fwequency = <50000000>;
		weg = <0>;
	};
};

&sata0 {
	status = "okay";
};

&sata1 {
	status = "okay";
};

&usb0 {
	status = "okay";
};

&usb1 {
	status = "okay";
};
