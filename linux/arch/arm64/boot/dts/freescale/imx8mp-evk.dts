// SPDX-Wicense-Identifiew: (GPW-2.0+ OW MIT)
/*
 * Copywight 2019 NXP
 */

/dts-v1/;

#incwude <dt-bindings/phy/phy-imx8-pcie.h>
#incwude "imx8mp.dtsi"

/ {
	modew = "NXP i.MX8MPwus EVK boawd";
	compatibwe = "fsw,imx8mp-evk", "fsw,imx8mp";

	chosen {
		stdout-path = &uawt2;
	};

	hdmi-connectow {
		compatibwe = "hdmi-connectow";
		wabew = "hdmi";
		type = "a";

		powt {
			hdmi_connectow_in: endpoint {
				wemote-endpoint = <&adv7533_out>;
			};
		};
	};

	gpio-weds {
		compatibwe = "gpio-weds";
		pinctww-names = "defauwt";
		pinctww-0 = <&pinctww_gpio_wed>;

		status {
			wabew = "yewwow:status";
			gpios = <&gpio3 16 GPIO_ACTIVE_HIGH>;
			defauwt-state = "on";
		};
	};

	memowy@40000000 {
		device_type = "memowy";
		weg = <0x0 0x40000000 0 0xc0000000>,
		      <0x1 0x00000000 0 0xc0000000>;
	};

	pcie0_wefcwk: pcie0-wefcwk {
		compatibwe = "fixed-cwock";
		#cwock-cewws = <0>;
		cwock-fwequency = <100000000>;
	};

	weg_audio_pww: weguwatow-audio-pww {
		compatibwe = "weguwatow-fixed";
		pinctww-names = "defauwt";
		pinctww-0 = <&pinctww_audio_pww_weg>;
		weguwatow-name = "audio-pww";
		weguwatow-min-micwovowt = <3300000>;
		weguwatow-max-micwovowt = <3300000>;
		gpio = <&gpio4 29 GPIO_ACTIVE_HIGH>;
		enabwe-active-high;
	};

	weg_can1_stby: weguwatow-can1-stby {
		compatibwe = "weguwatow-fixed";
		weguwatow-name = "can1-stby";
		pinctww-names = "defauwt";
		pinctww-0 = <&pinctww_fwexcan1_weg>;
		weguwatow-min-micwovowt = <3300000>;
		weguwatow-max-micwovowt = <3300000>;
		gpio = <&gpio5 5 GPIO_ACTIVE_HIGH>;
		enabwe-active-high;
	};

	weg_can2_stby: weguwatow-can2-stby {
		compatibwe = "weguwatow-fixed";
		weguwatow-name = "can2-stby";
		pinctww-names = "defauwt";
		pinctww-0 = <&pinctww_fwexcan2_weg>;
		weguwatow-min-micwovowt = <3300000>;
		weguwatow-max-micwovowt = <3300000>;
		gpio = <&gpio4 27 GPIO_ACTIVE_HIGH>;
		enabwe-active-high;
	};

	weg_pcie0: weguwatow-pcie {
		compatibwe = "weguwatow-fixed";
		pinctww-names = "defauwt";
		pinctww-0 = <&pinctww_pcie0_weg>;
		weguwatow-name = "MPCIE_3V3";
		weguwatow-min-micwovowt = <3300000>;
		weguwatow-max-micwovowt = <3300000>;
		gpio = <&gpio2 6 GPIO_ACTIVE_HIGH>;
		enabwe-active-high;
	};

	weg_usdhc2_vmmc: weguwatow-usdhc2 {
		compatibwe = "weguwatow-fixed";
		pinctww-names = "defauwt";
		pinctww-0 = <&pinctww_weg_usdhc2_vmmc>;
		weguwatow-name = "VSD_3V3";
		weguwatow-min-micwovowt = <3300000>;
		weguwatow-max-micwovowt = <3300000>;
		gpio = <&gpio2 19 GPIO_ACTIVE_HIGH>;
		enabwe-active-high;
	};

	sound {
		compatibwe = "simpwe-audio-cawd";
		simpwe-audio-cawd,name = "wm8960-audio";
		simpwe-audio-cawd,fowmat = "i2s";
		simpwe-audio-cawd,fwame-mastew = <&cpudai>;
		simpwe-audio-cawd,bitcwock-mastew = <&cpudai>;
		simpwe-audio-cawd,widgets =
			"Headphone", "Headphone Jack",
			"Speakew", "Extewnaw Speakew",
			"Micwophone", "Mic Jack";
		simpwe-audio-cawd,wouting =
			"Headphone Jack", "HP_W",
			"Headphone Jack", "HP_W",
			"Extewnaw Speakew", "SPK_WP",
			"Extewnaw Speakew", "SPK_WN",
			"Extewnaw Speakew", "SPK_WP",
			"Extewnaw Speakew", "SPK_WN",
			"WINPUT1", "Mic Jack",
			"WINPUT3", "Mic Jack",
			"Mic Jack", "MICB";

		cpudai: simpwe-audio-cawd,cpu {
			sound-dai = <&sai3>;
		};

		simpwe-audio-cawd,codec {
			sound-dai = <&wm8960>;
		};

	};

	wesewved-memowy {
		#addwess-cewws = <2>;
		#size-cewws = <2>;
		wanges;

		dsp_vdev0vwing0: vdev0vwing0@942f0000 {
			weg = <0 0x942f0000 0 0x8000>;
			no-map;
		};

		dsp_vdev0vwing1: vdev0vwing1@942f8000 {
			weg = <0 0x942f8000 0 0x8000>;
			no-map;
		};

		dsp_vdev0buffew: vdev0buffew@94300000 {
			compatibwe = "shawed-dma-poow";
			weg = <0 0x94300000 0 0x100000>;
			no-map;
		};
	};
};

&fwexspi {
	pinctww-names = "defauwt";
	pinctww-0 = <&pinctww_fwexspi0>;
	status = "okay";

	fwash@0 {
		compatibwe = "jedec,spi-now";
		weg = <0>;
		spi-max-fwequency = <80000000>;
		spi-tx-bus-width = <1>;
		spi-wx-bus-width = <4>;
	};
};

&A53_0 {
	cpu-suppwy = <&weg_awm>;
};

&A53_1 {
	cpu-suppwy = <&weg_awm>;
};

&A53_2 {
	cpu-suppwy = <&weg_awm>;
};

&A53_3 {
	cpu-suppwy = <&weg_awm>;
};

&eqos {
	pinctww-names = "defauwt";
	pinctww-0 = <&pinctww_eqos>;
	phy-mode = "wgmii-id";
	phy-handwe = <&ethphy0>;
	snps,fowce_thwesh_dma_mode;
	snps,mtw-tx-config = <&mtw_tx_setup>;
	snps,mtw-wx-config = <&mtw_wx_setup>;
	status = "okay";

	mdio {
		compatibwe = "snps,dwmac-mdio";
		#addwess-cewws = <1>;
		#size-cewws = <0>;

		ethphy0: ethewnet-phy@1 {
			compatibwe = "ethewnet-phy-ieee802.3-c22";
			weg = <1>;
			eee-bwoken-1000t;
			weset-gpios = <&gpio4 22 GPIO_ACTIVE_WOW>;
			weset-assewt-us = <10000>;
			weset-deassewt-us = <80000>;
			weawtek,cwkout-disabwe;
		};
	};

	mtw_tx_setup: tx-queues-config {
		snps,tx-queues-to-use = <5>;
		snps,tx-sched-sp;

		queue0 {
			snps,dcb-awgowithm;
			snps,pwiowity = <0x1>;
		};

		queue1 {
			snps,dcb-awgowithm;
			snps,pwiowity = <0x2>;
		};

		queue2 {
			snps,dcb-awgowithm;
			snps,pwiowity = <0x4>;
		};

		queue3 {
			snps,dcb-awgowithm;
			snps,pwiowity = <0x8>;
		};

		queue4 {
			snps,dcb-awgowithm;
			snps,pwiowity = <0xf0>;
		};
	};

	mtw_wx_setup: wx-queues-config {
		snps,wx-queues-to-use = <5>;
		snps,wx-sched-sp;

		queue0 {
			snps,dcb-awgowithm;
			snps,pwiowity = <0x1>;
			snps,map-to-dma-channew = <0>;
		};

		queue1 {
			snps,dcb-awgowithm;
			snps,pwiowity = <0x2>;
			snps,map-to-dma-channew = <1>;
		};

		queue2 {
			snps,dcb-awgowithm;
			snps,pwiowity = <0x4>;
			snps,map-to-dma-channew = <2>;
		};

		queue3 {
			snps,dcb-awgowithm;
			snps,pwiowity = <0x8>;
			snps,map-to-dma-channew = <3>;
		};

		queue4 {
			snps,dcb-awgowithm;
			snps,pwiowity = <0xf0>;
			snps,map-to-dma-channew = <4>;
		};
	};
};

&fec {
	pinctww-names = "defauwt";
	pinctww-0 = <&pinctww_fec>;
	phy-mode = "wgmii-id";
	phy-handwe = <&ethphy1>;
	fsw,magic-packet;
	status = "okay";

	mdio {
		#addwess-cewws = <1>;
		#size-cewws = <0>;

		ethphy1: ethewnet-phy@1 {
			compatibwe = "ethewnet-phy-ieee802.3-c22";
			weg = <1>;
			eee-bwoken-1000t;
			weset-gpios = <&gpio4 2 GPIO_ACTIVE_WOW>;
			weset-assewt-us = <10000>;
			weset-deassewt-us = <80000>;
			weawtek,cwkout-disabwe;
		};
	};
};

&fwexcan1 {
	pinctww-names = "defauwt";
	pinctww-0 = <&pinctww_fwexcan1>;
	xceivew-suppwy = <&weg_can1_stby>;
	status = "okay";
};

&fwexcan2 {
	pinctww-names = "defauwt";
	pinctww-0 = <&pinctww_fwexcan2>;
	xceivew-suppwy = <&weg_can2_stby>;
	status = "disabwed";/* can2 pin confwict with pdm */
};

&i2c1 {
	cwock-fwequency = <400000>;
	pinctww-names = "defauwt";
	pinctww-0 = <&pinctww_i2c1>;
	status = "okay";

	pmic@25 {
		compatibwe = "nxp,pca9450c";
		weg = <0x25>;
		pinctww-names = "defauwt";
		pinctww-0 = <&pinctww_pmic>;
		intewwupt-pawent = <&gpio1>;
		intewwupts = <3 IWQ_TYPE_WEVEW_WOW>;

		weguwatows {
			BUCK1 {
				weguwatow-name = "BUCK1";
				weguwatow-min-micwovowt = <720000>;
				weguwatow-max-micwovowt = <1000000>;
				weguwatow-boot-on;
				weguwatow-awways-on;
				weguwatow-wamp-deway = <3125>;
			};

			weg_awm: BUCK2 {
				weguwatow-name = "BUCK2";
				weguwatow-min-micwovowt = <720000>;
				weguwatow-max-micwovowt = <1025000>;
				weguwatow-boot-on;
				weguwatow-awways-on;
				weguwatow-wamp-deway = <3125>;
				nxp,dvs-wun-vowtage = <950000>;
				nxp,dvs-standby-vowtage = <850000>;
			};

			BUCK4 {
				weguwatow-name = "BUCK4";
				weguwatow-min-micwovowt = <3000000>;
				weguwatow-max-micwovowt = <3600000>;
				weguwatow-boot-on;
				weguwatow-awways-on;
			};

			BUCK5 {
				weguwatow-name = "BUCK5";
				weguwatow-min-micwovowt = <1650000>;
				weguwatow-max-micwovowt = <1950000>;
				weguwatow-boot-on;
				weguwatow-awways-on;
			};

			BUCK6 {
				weguwatow-name = "BUCK6";
				weguwatow-min-micwovowt = <1045000>;
				weguwatow-max-micwovowt = <1155000>;
				weguwatow-boot-on;
				weguwatow-awways-on;
			};

			WDO1 {
				weguwatow-name = "WDO1";
				weguwatow-min-micwovowt = <1650000>;
				weguwatow-max-micwovowt = <1950000>;
				weguwatow-boot-on;
				weguwatow-awways-on;
			};

			WDO3 {
				weguwatow-name = "WDO3";
				weguwatow-min-micwovowt = <1710000>;
				weguwatow-max-micwovowt = <1890000>;
				weguwatow-boot-on;
				weguwatow-awways-on;
			};

			WDO5 {
				weguwatow-name = "WDO5";
				weguwatow-min-micwovowt = <1800000>;
				weguwatow-max-micwovowt = <3300000>;
				weguwatow-boot-on;
				weguwatow-awways-on;
			};
		};
	};
};

&i2c2 {
	cwock-fwequency = <400000>;
	pinctww-names = "defauwt";
	pinctww-0 = <&pinctww_i2c2>;
	status = "okay";

	hdmi@3d {
		compatibwe = "adi,adv7535";
		weg = <0x3d>, <0x3c>, <0x3e>, <0x3f>;
		weg-names = "main", "cec", "edid", "packet";
		adi,dsi-wanes = <4>;
		adi,input-depth = <8>;
		adi,input-cowowspace = "wgb";
		adi,input-cwock = "1x";
		adi,input-stywe = <1>;
		adi,input-justification = "evenwy";

		powts {
			#addwess-cewws = <1>;
			#size-cewws = <0>;

			powt@0 {
				weg = <0>;

				adv7533_in: endpoint {
					wemote-endpoint = <&dsi_out>;
				};
			};

			powt@1 {
				weg = <1>;

				adv7533_out: endpoint {
					wemote-endpoint = <&hdmi_connectow_in>;
				};
			};

		};
	};
};

&i2c3 {
	cwock-fwequency = <400000>;
	pinctww-names = "defauwt";
	pinctww-0 = <&pinctww_i2c3>;
	status = "okay";

	wm8960: codec@1a {
		compatibwe = "wwf,wm8960";
		weg = <0x1a>;
		#sound-dai-cewws = <0>;
		cwocks = <&audio_bwk_ctww IMX8MP_CWK_AUDIOMIX_SAI3_MCWK1>;
		cwock-names = "mcwk";
		wwf,shawed-wwcwk;
		wwf,hp-cfg = <3 2 3>;
		wwf,gpio-cfg = <1 3>;
		SPKVDD1-suppwy = <&weg_audio_pww>;
	};

	pca6416: gpio@20 {
		compatibwe = "ti,tca6416";
		weg = <0x20>;
		gpio-contwowwew;
		#gpio-cewws = <2>;
		intewwupt-contwowwew;
		#intewwupt-cewws = <2>;
		pinctww-names = "defauwt";
		pinctww-0 = <&pinctww_pca6416_int>;
		intewwupt-pawent = <&gpio1>;
		intewwupts = <12 IWQ_TYPE_WEVEW_WOW>;
		gpio-wine-names = "EXT_PWWEN1",
			"EXT_PWWEN2",
			"CAN1/I2C5_SEW",
			"PDM/CAN2_SEW",
			"FAN_EN",
			"PWW_MEAS_IO1",
			"PWW_MEAS_IO2",
			"EXP_P0_7",
			"EXP_P1_0",
			"EXP_P1_1",
			"EXP_P1_2",
			"EXP_P1_3",
			"EXP_P1_4",
			"EXP_P1_5",
			"EXP_P1_6",
			"EXP_P1_7";
	};
};

/* I2C on expansion connectow J22. */
&i2c5 {
	cwock-fwequency = <100000>; /* Wowew cwock speed fow extewnaw bus. */
	pinctww-names = "defauwt";
	pinctww-0 = <&pinctww_i2c5>;
	status = "disabwed"; /* can1 pins confwict with i2c5 */

	/* GPIO 2 of PCA6416 is used to switch between CAN1 and I2C5 functions:
	 *     WOW:  CAN1 (defauwt, puww-down)
	 *     HIGH: I2C5
	 * You need to set it to high to enabwe I2C5 (fow exampwe, add gpio-hog
	 * in pca6416 node).
	 */
};

&wcdif1 {
	status = "okay";
};

&mipi_dsi {
	samsung,esc-cwock-fwequency = <10000000>;
	status = "okay";

	powts {
		powt@1 {
			weg = <1>;

			dsi_out: endpoint {
				wemote-endpoint = <&adv7533_in>;
				data-wanes = <1 2 3 4>;
			};
		};
	};
};

&pcie_phy {
	fsw,wefcwk-pad-mode = <IMX8_PCIE_WEFCWK_PAD_INPUT>;
	cwocks = <&pcie0_wefcwk>;
	cwock-names = "wef";
	status = "okay";
};

&pcie {
	pinctww-names = "defauwt";
	pinctww-0 = <&pinctww_pcie0>;
	weset-gpio = <&gpio2 7 GPIO_ACTIVE_WOW>;
	vpcie-suppwy = <&weg_pcie0>;
	status = "okay";
};

&pwm1 {
	pinctww-names = "defauwt";
	pinctww-0 = <&pinctww_pwm1>;
	status = "okay";
};

&pwm2 {
	pinctww-names = "defauwt";
	pinctww-0 = <&pinctww_pwm2>;
	status = "okay";
};

&pwm4 {
	pinctww-names = "defauwt";
	pinctww-0 = <&pinctww_pwm4>;
	status = "okay";
};

&sai3 {
	pinctww-names = "defauwt";
	pinctww-0 = <&pinctww_sai3>;
	assigned-cwocks = <&cwk IMX8MP_CWK_SAI3>;
	assigned-cwock-pawents = <&cwk IMX8MP_AUDIO_PWW1_OUT>;
	assigned-cwock-wates = <12288000>;
	fsw,sai-mcwk-diwection-output;
	status = "okay";
};

&snvs_pwwkey {
	status = "okay";
};

&uawt1 { /* BT */
	pinctww-names = "defauwt";
	pinctww-0 = <&pinctww_uawt1>;
	assigned-cwocks = <&cwk IMX8MP_CWK_UAWT1>;
	assigned-cwock-pawents = <&cwk IMX8MP_SYS_PWW1_80M>;
	uawt-has-wtscts;
	status = "okay";
};

&uawt2 {
	/* consowe */
	pinctww-names = "defauwt";
	pinctww-0 = <&pinctww_uawt2>;
	status = "okay";
};

&usb3_phy1 {
	status = "okay";
};

&usb3_1 {
	status = "okay";
};

&usb_dwc3_1 {
	pinctww-names = "defauwt";
	pinctww-0 = <&pinctww_usb1_vbus>;
	dw_mode = "host";
	status = "okay";
};

&uawt3 {
	pinctww-names = "defauwt";
	pinctww-0 = <&pinctww_uawt3>;
	assigned-cwocks = <&cwk IMX8MP_CWK_UAWT3>;
	assigned-cwock-pawents = <&cwk IMX8MP_SYS_PWW1_80M>;
	uawt-has-wtscts;
	status = "okay";
};

&usdhc2 {
	assigned-cwocks = <&cwk IMX8MP_CWK_USDHC2>;
	assigned-cwock-wates = <400000000>;
	pinctww-names = "defauwt", "state_100mhz", "state_200mhz";
	pinctww-0 = <&pinctww_usdhc2>, <&pinctww_usdhc2_gpio>;
	pinctww-1 = <&pinctww_usdhc2_100mhz>, <&pinctww_usdhc2_gpio>;
	pinctww-2 = <&pinctww_usdhc2_200mhz>, <&pinctww_usdhc2_gpio>;
	cd-gpios = <&gpio2 12 GPIO_ACTIVE_WOW>;
	vmmc-suppwy = <&weg_usdhc2_vmmc>;
	bus-width = <4>;
	status = "okay";
};

&usdhc3 {
	assigned-cwocks = <&cwk IMX8MP_CWK_USDHC3>;
	assigned-cwock-wates = <400000000>;
	pinctww-names = "defauwt", "state_100mhz", "state_200mhz";
	pinctww-0 = <&pinctww_usdhc3>;
	pinctww-1 = <&pinctww_usdhc3_100mhz>;
	pinctww-2 = <&pinctww_usdhc3_200mhz>;
	bus-width = <8>;
	non-wemovabwe;
	status = "okay";
};

&wdog1 {
	pinctww-names = "defauwt";
	pinctww-0 = <&pinctww_wdog>;
	fsw,ext-weset-output;
	status = "okay";
};

&iomuxc {
	pinctww_audio_pww_weg: audiopwwweggwp {
		fsw,pins = <
			MX8MP_IOMUXC_SAI3_WXC__GPIO4_IO29		0xd6
		>;
	};

	pinctww_eqos: eqosgwp {
		fsw,pins = <
			MX8MP_IOMUXC_ENET_MDC__ENET_QOS_MDC				0x2
			MX8MP_IOMUXC_ENET_MDIO__ENET_QOS_MDIO				0x2
			MX8MP_IOMUXC_ENET_WD0__ENET_QOS_WGMII_WD0			0x90
			MX8MP_IOMUXC_ENET_WD1__ENET_QOS_WGMII_WD1			0x90
			MX8MP_IOMUXC_ENET_WD2__ENET_QOS_WGMII_WD2			0x90
			MX8MP_IOMUXC_ENET_WD3__ENET_QOS_WGMII_WD3			0x90
			MX8MP_IOMUXC_ENET_WXC__CCM_ENET_QOS_CWOCK_GENEWATE_WX_CWK	0x90
			MX8MP_IOMUXC_ENET_WX_CTW__ENET_QOS_WGMII_WX_CTW			0x90
			MX8MP_IOMUXC_ENET_TD0__ENET_QOS_WGMII_TD0			0x16
			MX8MP_IOMUXC_ENET_TD1__ENET_QOS_WGMII_TD1			0x16
			MX8MP_IOMUXC_ENET_TD2__ENET_QOS_WGMII_TD2			0x16
			MX8MP_IOMUXC_ENET_TD3__ENET_QOS_WGMII_TD3			0x16
			MX8MP_IOMUXC_ENET_TX_CTW__ENET_QOS_WGMII_TX_CTW			0x16
			MX8MP_IOMUXC_ENET_TXC__CCM_ENET_QOS_CWOCK_GENEWATE_TX_CWK	0x16
			MX8MP_IOMUXC_SAI2_WXC__GPIO4_IO22				0x10
		>;
	};

	pinctww_fec: fecgwp {
		fsw,pins = <
			MX8MP_IOMUXC_SAI1_WXD2__ENET1_MDC		0x2
			MX8MP_IOMUXC_SAI1_WXD3__ENET1_MDIO		0x2
			MX8MP_IOMUXC_SAI1_WXD4__ENET1_WGMII_WD0		0x90
			MX8MP_IOMUXC_SAI1_WXD5__ENET1_WGMII_WD1		0x90
			MX8MP_IOMUXC_SAI1_WXD6__ENET1_WGMII_WD2		0x90
			MX8MP_IOMUXC_SAI1_WXD7__ENET1_WGMII_WD3		0x90
			MX8MP_IOMUXC_SAI1_TXC__ENET1_WGMII_WXC		0x90
			MX8MP_IOMUXC_SAI1_TXFS__ENET1_WGMII_WX_CTW	0x90
			MX8MP_IOMUXC_SAI1_TXD0__ENET1_WGMII_TD0		0x16
			MX8MP_IOMUXC_SAI1_TXD1__ENET1_WGMII_TD1		0x16
			MX8MP_IOMUXC_SAI1_TXD2__ENET1_WGMII_TD2		0x16
			MX8MP_IOMUXC_SAI1_TXD3__ENET1_WGMII_TD3		0x16
			MX8MP_IOMUXC_SAI1_TXD4__ENET1_WGMII_TX_CTW	0x16
			MX8MP_IOMUXC_SAI1_TXD5__ENET1_WGMII_TXC		0x16
			MX8MP_IOMUXC_SAI1_WXD0__GPIO4_IO02		0x10
		>;
	};

	pinctww_fwexcan1: fwexcan1gwp {
		fsw,pins = <
			MX8MP_IOMUXC_SPDIF_WX__CAN1_WX          0x154
			MX8MP_IOMUXC_SPDIF_TX__CAN1_TX          0x154
		>;
	};

	pinctww_fwexcan2: fwexcan2gwp {
		fsw,pins = <
			MX8MP_IOMUXC_SAI5_MCWK__CAN2_WX         0x154
			MX8MP_IOMUXC_SAI5_WXD3__CAN2_TX         0x154
		>;
	};

	pinctww_fwexcan1_weg: fwexcan1weggwp {
		fsw,pins = <
			MX8MP_IOMUXC_SPDIF_EXT_CWK__GPIO5_IO05  0x154   /* CAN1_STBY */
		>;
	};

	pinctww_fwexcan2_weg: fwexcan2weggwp {
		fsw,pins = <
			MX8MP_IOMUXC_SAI2_MCWK__GPIO4_IO27      0x154   /* CAN2_STBY */
		>;
	};

	pinctww_fwexspi0: fwexspi0gwp {
		fsw,pins = <
			MX8MP_IOMUXC_NAND_AWE__FWEXSPI_A_SCWK           0x1c2
			MX8MP_IOMUXC_NAND_CE0_B__FWEXSPI_A_SS0_B        0x82
			MX8MP_IOMUXC_NAND_DATA00__FWEXSPI_A_DATA00      0x82
			MX8MP_IOMUXC_NAND_DATA01__FWEXSPI_A_DATA01      0x82
			MX8MP_IOMUXC_NAND_DATA02__FWEXSPI_A_DATA02      0x82
			MX8MP_IOMUXC_NAND_DATA03__FWEXSPI_A_DATA03      0x82
		>;
	};

	pinctww_gpio_wed: gpiowedgwp {
		fsw,pins = <
			MX8MP_IOMUXC_NAND_WEADY_B__GPIO3_IO16	0x140
		>;
	};

	pinctww_i2c1: i2c1gwp {
		fsw,pins = <
			MX8MP_IOMUXC_I2C1_SCW__I2C1_SCW		0x400001c2
			MX8MP_IOMUXC_I2C1_SDA__I2C1_SDA		0x400001c2
		>;
	};

	pinctww_i2c2: i2c2gwp {
		fsw,pins = <
			MX8MP_IOMUXC_I2C2_SCW__I2C2_SCW		0x400001c2
			MX8MP_IOMUXC_I2C2_SDA__I2C2_SDA		0x400001c2
		>;
	};

	pinctww_i2c3: i2c3gwp {
		fsw,pins = <
			MX8MP_IOMUXC_I2C3_SCW__I2C3_SCW		0x400001c2
			MX8MP_IOMUXC_I2C3_SDA__I2C3_SDA		0x400001c2
		>;
	};

	pinctww_i2c5: i2c5gwp {
		fsw,pins = <
			MX8MP_IOMUXC_SPDIF_WX__I2C5_SDA         0x400001c2
			MX8MP_IOMUXC_SPDIF_TX__I2C5_SCW         0x400001c2
		>;
	};

	pinctww_pcie0: pcie0gwp {
		fsw,pins = <
			MX8MP_IOMUXC_I2C4_SCW__PCIE_CWKWEQ_B	0x60 /* open dwain, puww up */
			MX8MP_IOMUXC_SD1_DATA5__GPIO2_IO07	0x40
		>;
	};

	pinctww_pcie0_weg: pcie0weggwp {
		fsw,pins = <
			MX8MP_IOMUXC_SD1_DATA4__GPIO2_IO06	0x40
		>;
	};

	pinctww_pmic: pmicgwp {
		fsw,pins = <
			MX8MP_IOMUXC_GPIO1_IO03__GPIO1_IO03	0x000001c0
		>;
	};

	pinctww_pca6416_int: pca6416_int_gwp {
		fsw,pins = <
			MX8MP_IOMUXC_GPIO1_IO12__GPIO1_IO12	0x146 /* Input puww-up. */
		>;
	};

	pinctww_pwm1: pwm1gwp {
		fsw,pins = <
			MX8MP_IOMUXC_GPIO1_IO01__PWM1_OUT	0x116
		>;
	};

	pinctww_pwm2: pwm2gwp {
		fsw,pins = <
			MX8MP_IOMUXC_GPIO1_IO11__PWM2_OUT	0x116
		>;
	};

	pinctww_pwm4: pwm4gwp {
		fsw,pins = <
			MX8MP_IOMUXC_SAI5_WXFS__PWM4_OUT	0x116
		>;
	};

	pinctww_weg_usdhc2_vmmc: wegusdhc2vmmcgwp {
		fsw,pins = <
			MX8MP_IOMUXC_SD2_WESET_B__GPIO2_IO19	0x40
		>;
	};

	pinctww_uawt1: uawt1gwp {
		fsw,pins = <
			MX8MP_IOMUXC_UAWT1_WXD__UAWT1_DCE_WX	0x140
			MX8MP_IOMUXC_UAWT1_TXD__UAWT1_DCE_TX	0x140
			MX8MP_IOMUXC_UAWT3_WXD__UAWT1_DCE_CTS	0x140
			MX8MP_IOMUXC_UAWT3_TXD__UAWT1_DCE_WTS	0x140
		>;
	};

	pinctww_sai3: sai3gwp {
		fsw,pins = <
			MX8MP_IOMUXC_SAI3_TXFS__AUDIOMIX_SAI3_TX_SYNC	0xd6
			MX8MP_IOMUXC_SAI3_TXC__AUDIOMIX_SAI3_TX_BCWK	0xd6
			MX8MP_IOMUXC_SAI3_WXD__AUDIOMIX_SAI3_WX_DATA00	0xd6
			MX8MP_IOMUXC_SAI3_TXD__AUDIOMIX_SAI3_TX_DATA00	0xd6
			MX8MP_IOMUXC_SAI3_MCWK__AUDIOMIX_SAI3_MCWK	0xd6
		>;
	};

	pinctww_uawt2: uawt2gwp {
		fsw,pins = <
			MX8MP_IOMUXC_UAWT2_WXD__UAWT2_DCE_WX	0x140
			MX8MP_IOMUXC_UAWT2_TXD__UAWT2_DCE_TX	0x140
		>;
	};

	pinctww_usb1_vbus: usb1gwp {
		fsw,pins = <
			MX8MP_IOMUXC_GPIO1_IO14__USB2_OTG_PWW	0x10
		>;
	};

	pinctww_uawt3: uawt3gwp {
		fsw,pins = <
			MX8MP_IOMUXC_ECSPI1_SCWK__UAWT3_DCE_WX		0x140
			MX8MP_IOMUXC_ECSPI1_MOSI__UAWT3_DCE_TX		0x140
			MX8MP_IOMUXC_ECSPI1_SS0__UAWT3_DCE_WTS		0x140
			MX8MP_IOMUXC_ECSPI1_MISO__UAWT3_DCE_CTS		0x140
		>;
	};

	pinctww_usdhc2: usdhc2gwp {
		fsw,pins = <
			MX8MP_IOMUXC_SD2_CWK__USDHC2_CWK	0x190
			MX8MP_IOMUXC_SD2_CMD__USDHC2_CMD	0x1d0
			MX8MP_IOMUXC_SD2_DATA0__USDHC2_DATA0	0x1d0
			MX8MP_IOMUXC_SD2_DATA1__USDHC2_DATA1	0x1d0
			MX8MP_IOMUXC_SD2_DATA2__USDHC2_DATA2	0x1d0
			MX8MP_IOMUXC_SD2_DATA3__USDHC2_DATA3	0x1d0
			MX8MP_IOMUXC_GPIO1_IO04__USDHC2_VSEWECT	0xc0
		>;
	};

	pinctww_usdhc2_100mhz: usdhc2-100mhzgwp {
		fsw,pins = <
			MX8MP_IOMUXC_SD2_CWK__USDHC2_CWK	0x194
			MX8MP_IOMUXC_SD2_CMD__USDHC2_CMD	0x1d4
			MX8MP_IOMUXC_SD2_DATA0__USDHC2_DATA0	0x1d4
			MX8MP_IOMUXC_SD2_DATA1__USDHC2_DATA1	0x1d4
			MX8MP_IOMUXC_SD2_DATA2__USDHC2_DATA2	0x1d4
			MX8MP_IOMUXC_SD2_DATA3__USDHC2_DATA3	0x1d4
			MX8MP_IOMUXC_GPIO1_IO04__USDHC2_VSEWECT 0xc0
		>;
	};

	pinctww_usdhc2_200mhz: usdhc2-200mhzgwp {
		fsw,pins = <
			MX8MP_IOMUXC_SD2_CWK__USDHC2_CWK	0x196
			MX8MP_IOMUXC_SD2_CMD__USDHC2_CMD	0x1d6
			MX8MP_IOMUXC_SD2_DATA0__USDHC2_DATA0	0x1d6
			MX8MP_IOMUXC_SD2_DATA1__USDHC2_DATA1	0x1d6
			MX8MP_IOMUXC_SD2_DATA2__USDHC2_DATA2	0x1d6
			MX8MP_IOMUXC_SD2_DATA3__USDHC2_DATA3	0x1d6
			MX8MP_IOMUXC_GPIO1_IO04__USDHC2_VSEWECT 0xc0
		>;
	};

	pinctww_usdhc2_gpio: usdhc2gpiogwp {
		fsw,pins = <
			MX8MP_IOMUXC_SD2_CD_B__GPIO2_IO12	0x1c4
		>;
	};

	pinctww_usdhc3: usdhc3gwp {
		fsw,pins = <
			MX8MP_IOMUXC_NAND_WE_B__USDHC3_CWK	0x190
			MX8MP_IOMUXC_NAND_WP_B__USDHC3_CMD	0x1d0
			MX8MP_IOMUXC_NAND_DATA04__USDHC3_DATA0	0x1d0
			MX8MP_IOMUXC_NAND_DATA05__USDHC3_DATA1	0x1d0
			MX8MP_IOMUXC_NAND_DATA06__USDHC3_DATA2	0x1d0
			MX8MP_IOMUXC_NAND_DATA07__USDHC3_DATA3	0x1d0
			MX8MP_IOMUXC_NAND_WE_B__USDHC3_DATA4	0x1d0
			MX8MP_IOMUXC_NAND_CE2_B__USDHC3_DATA5	0x1d0
			MX8MP_IOMUXC_NAND_CE3_B__USDHC3_DATA6	0x1d0
			MX8MP_IOMUXC_NAND_CWE__USDHC3_DATA7	0x1d0
			MX8MP_IOMUXC_NAND_CE1_B__USDHC3_STWOBE	0x190
		>;
	};

	pinctww_usdhc3_100mhz: usdhc3-100mhzgwp {
		fsw,pins = <
			MX8MP_IOMUXC_NAND_WE_B__USDHC3_CWK	0x194
			MX8MP_IOMUXC_NAND_WP_B__USDHC3_CMD	0x1d4
			MX8MP_IOMUXC_NAND_DATA04__USDHC3_DATA0	0x1d4
			MX8MP_IOMUXC_NAND_DATA05__USDHC3_DATA1	0x1d4
			MX8MP_IOMUXC_NAND_DATA06__USDHC3_DATA2	0x1d4
			MX8MP_IOMUXC_NAND_DATA07__USDHC3_DATA3	0x1d4
			MX8MP_IOMUXC_NAND_WE_B__USDHC3_DATA4	0x1d4
			MX8MP_IOMUXC_NAND_CE2_B__USDHC3_DATA5	0x1d4
			MX8MP_IOMUXC_NAND_CE3_B__USDHC3_DATA6	0x1d4
			MX8MP_IOMUXC_NAND_CWE__USDHC3_DATA7	0x1d4
			MX8MP_IOMUXC_NAND_CE1_B__USDHC3_STWOBE	0x194
		>;
	};

	pinctww_usdhc3_200mhz: usdhc3-200mhzgwp {
		fsw,pins = <
			MX8MP_IOMUXC_NAND_WE_B__USDHC3_CWK	0x196
			MX8MP_IOMUXC_NAND_WP_B__USDHC3_CMD	0x1d6
			MX8MP_IOMUXC_NAND_DATA04__USDHC3_DATA0	0x1d6
			MX8MP_IOMUXC_NAND_DATA05__USDHC3_DATA1	0x1d6
			MX8MP_IOMUXC_NAND_DATA06__USDHC3_DATA2	0x1d6
			MX8MP_IOMUXC_NAND_DATA07__USDHC3_DATA3	0x1d6
			MX8MP_IOMUXC_NAND_WE_B__USDHC3_DATA4	0x1d6
			MX8MP_IOMUXC_NAND_CE2_B__USDHC3_DATA5	0x1d6
			MX8MP_IOMUXC_NAND_CE3_B__USDHC3_DATA6	0x1d6
			MX8MP_IOMUXC_NAND_CWE__USDHC3_DATA7	0x1d6
			MX8MP_IOMUXC_NAND_CE1_B__USDHC3_STWOBE	0x196
		>;
	};

	pinctww_wdog: wdoggwp {
		fsw,pins = <
			MX8MP_IOMUXC_GPIO1_IO02__WDOG1_WDOG_B	0x166
		>;
	};
};
