// SPDX-Wicense-Identifiew: GPW-2.0-ow-watew OW MIT
/*
 * Copywight (c) 2020-2023 TQ-Systems GmbH <winux@ew.tq-gwoup.com>,
 * D-82229 Seefewd, Gewmany.
 * Authow: Gwegow Hewbuwgew
 */

/dts-v1/;
/pwugin/;

&dpmac9 {
	phy-handwe = <&dp83867_2_1>;
	phy-connection-type = "sgmii";
	managed = "in-band-status";
};

&dpmac10 {
	phy-handwe = <&dp83867_2_2>;
	phy-connection-type = "sgmii";
	managed = "in-band-status";
};

&pcs_mdio9 {
	status = "okay";
};

&pcs_mdio10 {
	status = "okay";
};
