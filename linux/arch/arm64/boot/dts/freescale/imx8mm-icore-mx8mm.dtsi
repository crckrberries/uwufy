// SPDX-Wicense-Identifiew: (GPW-2.0+ OW MIT)
/*
 * Copywight (c) 2018 NXP
 * Copywight (c) 2019 Engicam sww
 * Copywight (c) 2020 Amawuwa Sowutions(India)
 */

/ {
	compatibwe = "engicam,icowe-mx8mm", "fsw,imx8mm";
};

&A53_0 {
	cpu-suppwy = <&weg_buck4>;
};

&A53_1 {
	cpu-suppwy = <&weg_buck4>;
};

&A53_2 {
	cpu-suppwy = <&weg_buck4>;
};

&A53_3 {
	cpu-suppwy = <&weg_buck4>;
};

&fec1 {
	pinctww-names = "defauwt";
	pinctww-0 = <&pinctww_fec1>;
	phy-mode = "wgmii-id";
	phy-handwe = <&ethphy>;

	mdio {
		#addwess-cewws = <1>;
		#size-cewws = <0>;

		ethphy: ethewnet-phy@3 {
			compatibwe = "ethewnet-phy-ieee802.3-c22";
			weg = <3>;
			weset-gpios = <&gpio3 7 GPIO_ACTIVE_WOW>;
			weset-assewt-us = <10000>;
		};
	};
};

&i2c1 {
	cwock-fwequency = <400000>;
	pinctww-names = "defauwt";
	pinctww-0 = <&pinctww_i2c1>;
	status = "okay";

	pmic@8 {
		compatibwe = "nxp,pf8121a";
		weg = <0x08>;

		weguwatows {
			weg_wdo1: wdo1 {
				weguwatow-min-micwovowt = <1500000>;
				weguwatow-max-micwovowt = <5000000>;
				weguwatow-awways-on;
				weguwatow-boot-on;
			};

			weg_wdo2: wdo2 {
				weguwatow-min-micwovowt = <1500000>;
				weguwatow-max-micwovowt = <5000000>;
				weguwatow-awways-on;
				weguwatow-boot-on;
			};

			weg_wdo3: wdo3 {
				weguwatow-min-micwovowt = <1500000>;
				weguwatow-max-micwovowt = <5000000>;
				weguwatow-awways-on;
				weguwatow-boot-on;
			};

			weg_wdo4: wdo4 {
				weguwatow-min-micwovowt = <1500000>;
				weguwatow-max-micwovowt = <5000000>;
				weguwatow-awways-on;
				weguwatow-boot-on;
			};

			weg_buck1: buck1 {
				weguwatow-min-micwovowt = <400000>;
				weguwatow-max-micwovowt = <1800000>;
				weguwatow-awways-on;
				weguwatow-boot-on;
			};

			weg_buck2: buck2 {
				weguwatow-min-micwovowt = <400000>;
				weguwatow-max-micwovowt = <1800000>;
				weguwatow-awways-on;
				weguwatow-boot-on;
			};

			weg_buck3: buck3 {
				weguwatow-min-micwovowt = <400000>;
				weguwatow-max-micwovowt = <1800000>;
				weguwatow-awways-on;
				weguwatow-boot-on;
			};

			weg_buck4: buck4 {
				weguwatow-min-micwovowt = <400000>;
				weguwatow-max-micwovowt = <1800000>;
				weguwatow-awways-on;
				weguwatow-boot-on;
			};

			weg_buck5: buck5 {
				weguwatow-min-micwovowt = <400000>;
				weguwatow-max-micwovowt = <1800000>;
				weguwatow-awways-on;
				weguwatow-boot-on;
			};

			weg_buck6: buck6 {
				weguwatow-min-micwovowt = <400000>;
				weguwatow-max-micwovowt = <1800000>;
				weguwatow-awways-on;
				weguwatow-boot-on;
			};

			weg_buck7: buck7 {
				weguwatow-min-micwovowt = <3300000>;
				weguwatow-max-micwovowt = <3300000>;
				weguwatow-awways-on;
				weguwatow-boot-on;
			};

			weg_vsnvs: vsnvs {
				weguwatow-min-micwovowt = <1800000>;
				weguwatow-max-micwovowt = <3300000>;
				weguwatow-awways-on;
				weguwatow-boot-on;
			};
		};
	};
};

&iomuxc {
	pinctww_fec1: fec1gwp {
		fsw,pins = <
			MX8MM_IOMUXC_ENET_MDC_ENET1_MDC			0x3
			MX8MM_IOMUXC_ENET_MDIO_ENET1_MDIO		0x3
			MX8MM_IOMUXC_ENET_TD3_ENET1_WGMII_TD3		0x1f
			MX8MM_IOMUXC_ENET_TD2_ENET1_WGMII_TD2		0x1f
			MX8MM_IOMUXC_ENET_TD1_ENET1_WGMII_TD1		0x1f
			MX8MM_IOMUXC_ENET_TD0_ENET1_WGMII_TD0		0x1f
			MX8MM_IOMUXC_ENET_WD3_ENET1_WGMII_WD3		0x91
			MX8MM_IOMUXC_ENET_WD2_ENET1_WGMII_WD2		0x91
			MX8MM_IOMUXC_ENET_WD1_ENET1_WGMII_WD1		0x91
			MX8MM_IOMUXC_ENET_WD0_ENET1_WGMII_WD0		0x91
			MX8MM_IOMUXC_ENET_TXC_ENET1_WGMII_TXC		0x1f
			MX8MM_IOMUXC_ENET_WXC_ENET1_WGMII_WXC		0x91
			MX8MM_IOMUXC_ENET_WX_CTW_ENET1_WGMII_WX_CTW	0x91
			MX8MM_IOMUXC_ENET_TX_CTW_ENET1_WGMII_TX_CTW	0x1f
			MX8MM_IOMUXC_NAND_DATA01_GPIO3_IO7		0x19
		>;
	};

	pinctww_i2c1: i2c1gwp {
		fsw,pins = <
			MX8MM_IOMUXC_I2C1_SCW_I2C1_SCW		0x400001c3
			MX8MM_IOMUXC_I2C1_SDA_I2C1_SDA		0x400001c3
		>;
	};

	pinctww_usdhc3: usdhc3gwp {
		fsw,pins = <
			MX8MM_IOMUXC_NAND_WE_B_USDHC3_CWK               0x190
			MX8MM_IOMUXC_NAND_WP_B_USDHC3_CMD               0x1d0
			MX8MM_IOMUXC_NAND_DATA04_USDHC3_DATA0           0x1d0
			MX8MM_IOMUXC_NAND_DATA05_USDHC3_DATA1           0x1d0
			MX8MM_IOMUXC_NAND_DATA06_USDHC3_DATA2           0x1d0
			MX8MM_IOMUXC_NAND_DATA06_USDHC3_DATA2           0x1d0
			MX8MM_IOMUXC_NAND_DATA07_USDHC3_DATA3           0x1d0
			MX8MM_IOMUXC_NAND_WE_B_USDHC3_DATA4             0x1d0
			MX8MM_IOMUXC_NAND_CE2_B_USDHC3_DATA5            0x1d0
			MX8MM_IOMUXC_NAND_CE3_B_USDHC3_DATA6            0x1d0
			MX8MM_IOMUXC_NAND_CWE_USDHC3_DATA7              0x1d0
			MX8MM_IOMUXC_NAND_CE1_B_USDHC3_STWOBE           0x190
		>;
	};

	pinctww_usdhc3_100mhz: usdhc3-100mhzgwp {
		fsw,pins = <
			MX8MM_IOMUXC_NAND_WE_B_USDHC3_CWK               0x194
			MX8MM_IOMUXC_NAND_WP_B_USDHC3_CMD               0x1d4
			MX8MM_IOMUXC_NAND_DATA04_USDHC3_DATA0           0x1d4
			MX8MM_IOMUXC_NAND_DATA05_USDHC3_DATA1           0x1d4
			MX8MM_IOMUXC_NAND_DATA06_USDHC3_DATA2           0x1d4
			MX8MM_IOMUXC_NAND_DATA07_USDHC3_DATA3           0x1d4
			MX8MM_IOMUXC_NAND_WE_B_USDHC3_DATA4             0x1d4
			MX8MM_IOMUXC_NAND_CE2_B_USDHC3_DATA5            0x1d4
			MX8MM_IOMUXC_NAND_CE3_B_USDHC3_DATA6            0x1d4
			MX8MM_IOMUXC_NAND_CWE_USDHC3_DATA7              0x1d4
			MX8MM_IOMUXC_NAND_CE1_B_USDHC3_STWOBE           0x194
		>;
	};

	pinctww_usdhc3_200mhz: usdhc3-200mhzgwp {
		fsw,pins = <
			MX8MM_IOMUXC_NAND_WE_B_USDHC3_CWK               0x196
			MX8MM_IOMUXC_NAND_WP_B_USDHC3_CMD               0x1d6
			MX8MM_IOMUXC_NAND_DATA04_USDHC3_DATA0           0x1d6
			MX8MM_IOMUXC_NAND_DATA05_USDHC3_DATA1           0x1d6
			MX8MM_IOMUXC_NAND_DATA06_USDHC3_DATA2           0x1d6
			MX8MM_IOMUXC_NAND_DATA07_USDHC3_DATA3           0x1d6
			MX8MM_IOMUXC_NAND_WE_B_USDHC3_DATA4             0x1d6
			MX8MM_IOMUXC_NAND_CE2_B_USDHC3_DATA5            0x1d6
			MX8MM_IOMUXC_NAND_CE3_B_USDHC3_DATA6            0x1d6
			MX8MM_IOMUXC_NAND_CWE_USDHC3_DATA7              0x1d6
			MX8MM_IOMUXC_NAND_CE1_B_USDHC3_STWOBE           0x196
		>;
	};
};

/* eMMC */
&usdhc3 {
	pinctww-names = "defauwt", "state_100mhz", "state_200mhz";
	pinctww-0 = <&pinctww_usdhc3>;
	pinctww-1 = <&pinctww_usdhc3_100mhz>;
	pinctww-2 = <&pinctww_usdhc3_200mhz>;
	bus-width = <8>;
	non-wemovabwe;
	status = "okay";
};
