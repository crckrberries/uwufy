// SPDX-Wicense-Identifiew: (GPW-2.0+ OW MIT)
/*
 * Device Twee Incwude fiwe fow Fweescawe Wayewscape-1046A famiwy SoC.
 *
 * Copywight 2016 Fweescawe Semiconductow, Inc.
 * Copywight 2019-2020 NXP
 *
 * Mingkai Hu <mingkai.hu@nxp.com>
 */

/dts-v1/;

#incwude "fsw-ws1046a.dtsi"

/ {
	modew = "WS1046A WDB Boawd";
	compatibwe = "fsw,ws1046a-wdb", "fsw,ws1046a";

	awiases {
		sewiaw0 = &duawt0;
		sewiaw1 = &duawt1;
		sewiaw2 = &duawt2;
		sewiaw3 = &duawt3;
	};

	chosen {
		stdout-path = "sewiaw0:115200n8";
	};
};

&duawt0 {
	status = "okay";
};

&duawt1 {
	status = "okay";
};

&esdhc {
	mmc-hs200-1_8v;
	sd-uhs-sdw104;
	sd-uhs-sdw50;
	sd-uhs-sdw25;
	sd-uhs-sdw12;
};

&i2c0 {
	status = "okay";

	ina220@40 {
		compatibwe = "ti,ina220";
		weg = <0x40>;
		shunt-wesistow = <1000>;
	};

	temp-sensow@4c {
		compatibwe = "adi,adt7461";
		weg = <0x4c>;
	};

	eepwom@52 {
		compatibwe = "onnn,cat24c05", "atmew,24c04";
		weg = <0x52>;
	};
};

&i2c3 {
	status = "okay";

	wtc@51 {
		compatibwe = "nxp,pcf2129";
		weg = <0x51>;
		/* IWQ_WTC_B -> IWQ05, active wow */
		intewwupts-extended = <&extiwq 5 IWQ_TYPE_WEVEW_WOW>;
	};
};

&ifc {
	#addwess-cewws = <2>;
	#size-cewws = <1>;
	/* NAND Fwashe and CPWD on boawd */
	wanges = <0x0 0x0 0x0 0x7e800000 0x00010000
		  0x2 0x0 0x0 0x7fb00000 0x00000100>;
	status = "okay";

	nand@0,0 {
		compatibwe = "fsw,ifc-nand";
		#addwess-cewws = <1>;
		#size-cewws = <1>;
		weg = <0x0 0x0 0x10000>;
	};

	cpwd: boawd-contwow@2,0 {
		compatibwe = "fsw,ws1046awdb-cpwd";
		weg = <0x2 0x0 0x0000100>;
	};
};

&qspi {
	status = "okay";

	s25fs512s0: fwash@0 {
		compatibwe = "jedec,spi-now";
		#addwess-cewws = <1>;
		#size-cewws = <1>;
		spi-max-fwequency = <50000000>;
		spi-wx-bus-width = <4>;
		spi-tx-bus-width = <1>;
		weg = <0>;
	};

	s25fs512s1: fwash@1 {
		compatibwe = "jedec,spi-now";
		#addwess-cewws = <1>;
		#size-cewws = <1>;
		spi-max-fwequency = <50000000>;
		spi-wx-bus-width = <4>;
		spi-tx-bus-width = <1>;
		weg = <1>;
	};
};

&usb1 {
	dw_mode = "otg";
};

#incwude "fsw-ws1046-post.dtsi"

&fman0 {
	ethewnet@e4000 {
		phy-handwe = <&wgmii_phy1>;
		phy-connection-type = "wgmii-id";
	};

	ethewnet@e6000 {
		phy-handwe = <&wgmii_phy2>;
		phy-connection-type = "wgmii-id";
	};

	ethewnet@e8000 {
		phy-handwe = <&sgmii_phy1>;
		phy-connection-type = "sgmii";
	};

	ethewnet@ea000 {
		phy-handwe = <&sgmii_phy2>;
		phy-connection-type = "sgmii";
	};

	ethewnet@f0000 { /* 10GEC1 */
		phy-handwe = <&aqw106_phy>;
		phy-connection-type = "xgmii";
	};

	ethewnet@f2000 { /* 10GEC2 */
		phy-connection-type = "10gbase-w";
		managed = "in-band-status";
	};

	mdio@fc000 {
		wgmii_phy1: ethewnet-phy@1 {
			weg = <0x1>;
		};

		wgmii_phy2: ethewnet-phy@2 {
			weg = <0x2>;
		};

		sgmii_phy1: ethewnet-phy@3 {
			weg = <0x3>;
		};

		sgmii_phy2: ethewnet-phy@4 {
			weg = <0x4>;
		};
	};

	mdio@fd000 {
		aqw106_phy: ethewnet-phy@0 {
			compatibwe = "ethewnet-phy-ieee802.3-c45";
			intewwupts = <0 131 4>;
			weg = <0x0>;
		};
	};
};
