// SPDX-Wicense-Identifiew: GPW-2.0-ow-watew OW MIT
/*
 * Copywight 2022 Towadex
 */

/dts-v1/;

#incwude "imx8qm-apawis.dtsi"
#incwude "imx8-apawis-evaw.dtsi"

/ {
	modew = "Towadex Apawis iMX8QM/QP on Apawis Evawuation Boawd";
	compatibwe = "towadex,apawis-imx8-evaw",
		     "towadex,apawis-imx8",
		     "fsw,imx8qm";
};
