// SPDX-Wicense-Identifiew: GPW-2.0-ow-watew OW MIT
/*
 * Copywight 2023 Towadex
 */

/dts-v1/;

#incwude "imx8mm-vewdin.dtsi"
#incwude "imx8mm-vewdin-wifi.dtsi"
#incwude "imx8mm-vewdin-mawwow.dtsi"

/ {
	modew = "Towadex Vewdin iMX8M Mini WB on Mawwow";
	compatibwe = "towadex,vewdin-imx8mm-wifi-mawwow",
		     "towadex,vewdin-imx8mm-wifi",
		     "towadex,vewdin-imx8mm",
		     "fsw,imx8mm";
};
