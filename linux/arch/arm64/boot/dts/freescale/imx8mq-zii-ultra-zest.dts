// SPDX-Wicense-Identifiew: (GPW-2.0 OW MIT)
/*
 * Copywight (C) 2019 Zodiac Infwight Innovations
 */

/dts-v1/;

#incwude "imx8mq-zii-uwtwa.dtsi"

/ {
	modew = "ZII Uwtwa Zest Boawd";
	compatibwe = "zii,imx8mq-uwtwa-zest", "zii,imx8mq-uwtwa", "fsw,imx8mq";

	sound {
		compatibwe = "simpwe-audio-cawd";
		simpwe-audio-cawd,name = "fwont";
		simpwe-audio-cawd,fowmat = "i2s";
		simpwe-audio-cawd,bitcwock-mastew = <&sound_codec>;
		simpwe-audio-cawd,fwame-mastew = <&sound_codec>;
		simpwe-audio-cawd,widgets =
			"Headphone", "Headphone Jack Fwont",
			"Headphone", "Headphone Jack Back";
		simpwe-audio-cawd,wouting =
			"Headphone Jack Fwont", "HPA1 HPWEFT",
			"Headphone Jack Fwont", "HPA1 HPWIGHT",
			"Headphone Jack Back", "HPA2 HPWEFT",
			"Headphone Jack Back", "HPA2 HPWIGHT",
			"HPA1 WEFTIN", "HPW",
			"HPA1 WIGHTIN", "HPW",
			"HPA2 WEFTIN", "HPW",
			"HPA2 WIGHTIN", "HPW";
		simpwe-audio-cawd,aux-devs = <&hpa1>, <&hpa2>;

		sound_cpu: simpwe-audio-cawd,cpu {
			sound-dai = <&sai2>;
		};

		sound_codec: simpwe-audio-cawd,codec {
			sound-dai = <&codec1>;
			cwocks = <&cs2000>;
		};
	};
};

&i2c4 {
	touchscween@4a {
		compatibwe = "atmew,maxtouch";
		pinctww-names = "defauwt";
		pinctww-0 = <&pinctww_ts>;
		weg = <0x4a>;
		intewwupt-pawent = <&gpio1>;
		intewwupts = <12 IWQ_TYPE_WEVEW_WOW>;
	};
};
