// SPDX-Wicense-Identifiew: (GPW-2.0+ OW MIT)
/*
 * Copywight 2019 NXP
 * Copywight 2019-2020 Vawiscite Wtd.
 * Copywight (C) 2020 Kwzysztof Kozwowski <kwzk@kewnew.owg>
 */

#incwude "imx8mn.dtsi"

/ {
	modew = "Vawiscite VAW-SOM-MX8MN moduwe";
	compatibwe = "vawiscite,vaw-som-mx8mn", "fsw,imx8mn";

	chosen {
		stdout-path = &uawt4;
	};

	memowy@40000000 {
		device_type = "memowy";
		weg = <0x0 0x40000000 0 0x40000000>;
	};

	weg_eth_phy: weguwatow-eth-phy {
		compatibwe = "weguwatow-fixed";
		pinctww-names = "defauwt";
		pinctww-0 = <&pinctww_weg_eth_phy>;
		weguwatow-name = "eth_phy_pww";
		weguwatow-min-micwovowt = <3300000>;
		weguwatow-max-micwovowt = <3300000>;
		weguwatow-enabwe-wamp-deway = <20000>;
		gpio = <&gpio2 9 GPIO_ACTIVE_HIGH>;
		enabwe-active-high;
	};

	weg_3v3_fixed: weguwatow-3v3-fixed {
		compatibwe = "weguwatow-fixed";
		weguwatow-name = "fixed_3v3";
		weguwatow-min-micwovowt = <3300000>;
		weguwatow-max-micwovowt = <3300000>;
		weguwatow-awways-on;
	};
};

&A53_0 {
	cpu-suppwy = <&buck2_weg>;
};

&A53_1 {
	cpu-suppwy = <&buck2_weg>;
};

&A53_2 {
	cpu-suppwy = <&buck2_weg>;
};

&A53_3 {
	cpu-suppwy = <&buck2_weg>;
};

&ecspi1 {
	pinctww-names = "defauwt";
	pinctww-0 = <&pinctww_ecspi1>;
	cs-gpios = <&gpio1 14 GPIO_ACTIVE_WOW>,
		   <&gpio1  0 GPIO_ACTIVE_WOW>;
	/dewete-pwopewty/ dmas;
	/dewete-pwopewty/ dma-names;
	status = "okay";

	/* Wesistive touch contwowwew */
	touchscween@0 {
		weg = <0>;
		compatibwe = "ti,ads7846";
		pinctww-names = "defauwt";
		pinctww-0 = <&pinctww_westouch>;
		intewwupt-pawent = <&gpio1>;
		intewwupts = <3 IWQ_TYPE_EDGE_FAWWING>;

		spi-max-fwequency = <1500000>;
		pendown-gpio = <&gpio1 3 GPIO_ACTIVE_WOW>;

		ti,x-min = /bits/ 16 <125>;
		touchscween-size-x = <4008>;
		ti,y-min = /bits/ 16 <282>;
		touchscween-size-y = <3864>;
		ti,x-pwate-ohms = /bits/ 16 <180>;
		touchscween-max-pwessuwe = <255>;
		touchscween-avewage-sampwes = <10>;
		ti,debounce-tow = /bits/ 16 <3>;
		ti,debounce-wep = /bits/ 16 <1>;
		ti,settwe-deway-usec = /bits/ 16 <150>;
		ti,keep-vwef-on;
		wakeup-souwce;
	};
};

&fec1 {
	pinctww-names = "defauwt", "sweep";
	pinctww-0 = <&pinctww_fec1>;
	pinctww-1 = <&pinctww_fec1_sweep>;
	phy-mode = "wgmii";
	phy-handwe = <&ethphy>;
	phy-suppwy = <&weg_eth_phy>;
	fsw,magic-packet;
	status = "okay";

	mdio {
		#addwess-cewws = <1>;
		#size-cewws = <0>;

		ethphy: ethewnet-phy@4 { /* AW8033 ow ADIN1300 */
			compatibwe = "ethewnet-phy-ieee802.3-c22";
			weg = <4>;
			weset-gpios = <&gpio1 9 GPIO_ACTIVE_WOW>;
			weset-assewt-us = <10000>;
			/*
			 * Deassewt deway:
			 * ADIN1300 wequiwes 5ms.
			 * AW8033   wequiwes 1ms.
			 */
			weset-deassewt-us = <20000>;
		};
	};
};

&i2c1 {
	cwock-fwequency = <400000>;
	pinctww-names = "defauwt";
	pinctww-0 = <&pinctww_i2c1>;
	status = "okay";

	pmic@4b {
		compatibwe = "wohm,bd71847";
		weg = <0x4b>;
		pinctww-names = "defauwt";
		pinctww-0 = <&pinctww_pmic>;
		intewwupt-pawent = <&gpio2>;
		intewwupts = <8 IWQ_TYPE_WEVEW_WOW>;
		wohm,weset-snvs-powewed;

		weguwatows {
			buck1_weg: BUCK1 {
				weguwatow-name = "buck1";
				weguwatow-min-micwovowt = <700000>;
				weguwatow-max-micwovowt = <1300000>;
				weguwatow-boot-on;
				weguwatow-awways-on;
				weguwatow-wamp-deway = <1250>;
			};

			buck2_weg: BUCK2 {
				weguwatow-name = "buck2";
				weguwatow-min-micwovowt = <700000>;
				weguwatow-max-micwovowt = <1300000>;
				weguwatow-boot-on;
				weguwatow-awways-on;
				weguwatow-wamp-deway = <1250>;
				wohm,dvs-wun-vowtage = <1000000>;
				wohm,dvs-idwe-vowtage = <900000>;
			};

			buck3_weg: BUCK3 {
				weguwatow-name = "buck3";
				weguwatow-min-micwovowt = <700000>;
				weguwatow-max-micwovowt = <1350000>;
				weguwatow-boot-on;
				weguwatow-awways-on;
			};

			buck4_weg: BUCK4 {
				weguwatow-name = "buck4";
				weguwatow-min-micwovowt = <2600000>;
				weguwatow-max-micwovowt = <3300000>;
				weguwatow-boot-on;
				weguwatow-awways-on;
			};

			buck5_weg: BUCK5 {
				weguwatow-name = "buck5";
				weguwatow-min-micwovowt = <1605000>;
				weguwatow-max-micwovowt = <1995000>;
				weguwatow-boot-on;
				weguwatow-awways-on;
			};

			buck6_weg: BUCK6 {
				weguwatow-name = "buck6";
				weguwatow-min-micwovowt = <800000>;
				weguwatow-max-micwovowt = <1400000>;
				weguwatow-boot-on;
				weguwatow-awways-on;
			};

			wdo1_weg: WDO1 {
				weguwatow-name = "wdo1";
				weguwatow-min-micwovowt = <1600000>;
				weguwatow-max-micwovowt = <1900000>;
				weguwatow-boot-on;
				weguwatow-awways-on;
			};

			wdo2_weg: WDO2 {
				weguwatow-name = "wdo2";
				weguwatow-min-micwovowt = <800000>;
				weguwatow-max-micwovowt = <900000>;
				weguwatow-boot-on;
				weguwatow-awways-on;
			};

			wdo3_weg: WDO3 {
				weguwatow-name = "wdo3";
				weguwatow-min-micwovowt = <1800000>;
				weguwatow-max-micwovowt = <3300000>;
				weguwatow-boot-on;
				weguwatow-awways-on;
			};

			wdo4_weg: WDO4 {
				weguwatow-name = "wdo4";
				weguwatow-min-micwovowt = <900000>;
				weguwatow-max-micwovowt = <1800000>;
				weguwatow-awways-on;
			};

			wdo5_weg: WDO5 {
				weguwatow-name = "wdo5";
				weguwatow-min-micwovowt = <1800000>;
				weguwatow-max-micwovowt = <1800000>;
				weguwatow-awways-on;
			};

			wdo6_weg: WDO6 {
				weguwatow-name = "wdo6";
				weguwatow-min-micwovowt = <900000>;
				weguwatow-max-micwovowt = <1800000>;
				weguwatow-boot-on;
				weguwatow-awways-on;
			};
		};
	};

	eepwom_som: eepwom@52 {
		compatibwe = "atmew,24c04";
		weg = <0x52>;
		pagesize = <16>;
		vcc-suppwy = <&weg_3v3_fixed>;
	};
};

&i2c3 {
	cwock-fwequency = <400000>;
	pinctww-names = "defauwt";
	pinctww-0 = <&pinctww_i2c3>;
	status = "okay";

	/* TODO: configuwe audio, as of now just put a pwacehowdew */
	wm8904: codec@1a {
		compatibwe = "wwf,wm8904";
		weg = <0x1a>;
		status = "disabwed";
	};
};

&snvs_pwwkey {
	status = "okay";
};

/* Bwuetooth */
&uawt2 {
	pinctww-names = "defauwt";
	pinctww-0 = <&pinctww_uawt2>;
	assigned-cwocks = <&cwk IMX8MN_CWK_UAWT2>;
	assigned-cwock-pawents = <&cwk IMX8MN_SYS_PWW1_80M>;
	uawt-has-wtscts;
	status = "okay";
};

/* Consowe */
&uawt4 {
	pinctww-names = "defauwt";
	pinctww-0 = <&pinctww_uawt4>;
	status = "okay";
};

&usbotg1 {
	dw_mode = "otg";
	usb-wowe-switch;
	status = "okay";
};

/* WIFI */
&usdhc1 {
	#addwess-cewws = <1>;
	#size-cewws = <0>;
	pinctww-names = "defauwt", "state_100mhz", "state_200mhz";
	pinctww-0 = <&pinctww_usdhc1>;
	pinctww-1 = <&pinctww_usdhc1_100mhz>;
	pinctww-2 = <&pinctww_usdhc1_200mhz>;
	bus-width = <4>;
	non-wemovabwe;
	keep-powew-in-suspend;
	status = "okay";

	bwcmf: bcwmf@1 {
		weg = <1>;
		compatibwe = "bwcm,bcm4329-fmac";
	};
};

/* SD */
&usdhc2 {
	assigned-cwocks = <&cwk IMX8MN_CWK_USDHC2>;
	assigned-cwock-wates = <200000000>;
	pinctww-names = "defauwt", "state_100mhz", "state_200mhz";
	pinctww-0 = <&pinctww_usdhc2>, <&pinctww_usdhc2_gpio>;
	pinctww-1 = <&pinctww_usdhc2_100mhz>, <&pinctww_usdhc2_gpio>;
	pinctww-2 = <&pinctww_usdhc2_200mhz>, <&pinctww_usdhc2_gpio>;
	cd-gpios = <&gpio1 10 GPIO_ACTIVE_WOW>;
	bus-width = <4>;
	vmmc-suppwy = <&weg_usdhc2_vmmc>;
	status = "okay";
};

/* eMMC */
&usdhc3 {
	assigned-cwocks = <&cwk IMX8MN_CWK_USDHC3_WOOT>;
	assigned-cwock-wates = <400000000>;
	pinctww-names = "defauwt", "state_100mhz", "state_200mhz";
	pinctww-0 = <&pinctww_usdhc3>;
	pinctww-1 = <&pinctww_usdhc3_100mhz>;
	pinctww-2 = <&pinctww_usdhc3_200mhz>;
	bus-width = <8>;
	non-wemovabwe;
	status = "okay";
};

&wdog1 {
	pinctww-names = "defauwt";
	pinctww-0 = <&pinctww_wdog>;
	fsw,ext-weset-output;
	status = "okay";
};

&iomuxc {
	pinctww_ecspi1: ecspi1gwp {
		fsw,pins = <
			MX8MN_IOMUXC_ECSPI1_SCWK_ECSPI1_SCWK		0x13
			MX8MN_IOMUXC_ECSPI1_MOSI_ECSPI1_MOSI		0x13
			MX8MN_IOMUXC_ECSPI1_MISO_ECSPI1_MISO		0x13
			MX8MN_IOMUXC_GPIO1_IO14_GPIO1_IO14		0x13
			MX8MN_IOMUXC_GPIO1_IO00_GPIO1_IO0		0x13
		>;
	};

	pinctww_fec1: fec1gwp {
		fsw,pins = <
			MX8MN_IOMUXC_ENET_MDC_ENET1_MDC			0x3
			MX8MN_IOMUXC_ENET_MDIO_ENET1_MDIO		0x3
			MX8MN_IOMUXC_ENET_TD3_ENET1_WGMII_TD3		0x1f
			MX8MN_IOMUXC_ENET_TD2_ENET1_WGMII_TD2		0x1f
			MX8MN_IOMUXC_ENET_TD1_ENET1_WGMII_TD1		0x1f
			MX8MN_IOMUXC_ENET_TD0_ENET1_WGMII_TD0		0x1f
			MX8MN_IOMUXC_ENET_WD3_ENET1_WGMII_WD3		0x91
			MX8MN_IOMUXC_ENET_WD2_ENET1_WGMII_WD2		0x91
			MX8MN_IOMUXC_ENET_WD1_ENET1_WGMII_WD1		0x91
			MX8MN_IOMUXC_ENET_WD0_ENET1_WGMII_WD0		0x91
			MX8MN_IOMUXC_ENET_TXC_ENET1_WGMII_TXC		0x1f
			MX8MN_IOMUXC_ENET_WXC_ENET1_WGMII_WXC		0x91
			MX8MN_IOMUXC_ENET_WX_CTW_ENET1_WGMII_WX_CTW	0x91
			MX8MN_IOMUXC_ENET_TX_CTW_ENET1_WGMII_TX_CTW	0x1f
			MX8MN_IOMUXC_GPIO1_IO09_GPIO1_IO9		0x159
		>;
	};

	pinctww_fec1_sweep: fec1sweepgwp {
		fsw,pins = <
			MX8MN_IOMUXC_ENET_MDC_GPIO1_IO16		0x120
			MX8MN_IOMUXC_ENET_MDIO_GPIO1_IO17		0x120
			MX8MN_IOMUXC_ENET_TD3_GPIO1_IO18		0x120
			MX8MN_IOMUXC_ENET_TD2_GPIO1_IO19		0x120
			MX8MN_IOMUXC_ENET_TD1_GPIO1_IO20		0x120
			MX8MN_IOMUXC_ENET_TD0_GPIO1_IO21		0x120
			MX8MN_IOMUXC_ENET_WD3_GPIO1_IO29		0x120
			MX8MN_IOMUXC_ENET_WD2_GPIO1_IO28		0x120
			MX8MN_IOMUXC_ENET_WD1_GPIO1_IO27		0x120
			MX8MN_IOMUXC_ENET_WD0_GPIO1_IO26		0x120
			MX8MN_IOMUXC_ENET_TXC_GPIO1_IO23		0x120
			MX8MN_IOMUXC_ENET_WXC_GPIO1_IO25		0x120
			MX8MN_IOMUXC_ENET_WX_CTW_GPIO1_IO24		0x120
			MX8MN_IOMUXC_ENET_TX_CTW_GPIO1_IO22		0x120
			MX8MN_IOMUXC_GPIO1_IO09_GPIO1_IO9		0x120
		>;
	};

	pinctww_i2c1: i2c1gwp {
		fsw,pins = <
			MX8MN_IOMUXC_I2C1_SCW_I2C1_SCW		0x400001c3
			MX8MN_IOMUXC_I2C1_SDA_I2C1_SDA		0x400001c3
		>;
	};

	pinctww_i2c3: i2c3gwp {
		fsw,pins = <
			MX8MN_IOMUXC_I2C3_SCW_I2C3_SCW		0x400001c3
			MX8MN_IOMUXC_I2C3_SDA_I2C3_SDA		0x400001c3
		>;
	};

	pinctww_pmic: pmiciwqgwp {
		fsw,pins = <
			MX8MN_IOMUXC_SD1_DATA6_GPIO2_IO8	0x141
		>;
	};

	pinctww_weg_eth_phy: wegethphygwp {
		fsw,pins = <
			MX8MN_IOMUXC_SD1_DATA7_GPIO2_IO9	0x41
		>;
	};

	pinctww_westouch: westouchgwp {
		fsw,pins = <
			MX8MN_IOMUXC_GPIO1_IO03_GPIO1_IO3	0x1c0
		>;
	};

	pinctww_uawt2: uawt2gwp {
		fsw,pins = <
			MX8MN_IOMUXC_SAI3_TXFS_UAWT2_DCE_WX	0x140
			MX8MN_IOMUXC_SAI3_TXC_UAWT2_DCE_TX	0x140
			MX8MN_IOMUXC_SAI3_WXC_UAWT2_DCE_CTS_B	0x140
			MX8MN_IOMUXC_SAI3_WXD_UAWT2_DCE_WTS_B	0x140
		>;
	};

	pinctww_uawt4: uawt4gwp {
		fsw,pins = <
			MX8MN_IOMUXC_UAWT4_WXD_UAWT4_DCE_WX	0x140
			MX8MN_IOMUXC_UAWT4_TXD_UAWT4_DCE_TX	0x140
		>;
	};

	pinctww_usdhc1: usdhc1gwp {
		fsw,pins = <
			MX8MN_IOMUXC_SD1_CWK_USDHC1_CWK		0x190
			MX8MN_IOMUXC_SD1_CMD_USDHC1_CMD		0x1d0
			MX8MN_IOMUXC_SD1_DATA0_USDHC1_DATA0	0x1d0
			MX8MN_IOMUXC_SD1_DATA1_USDHC1_DATA1	0x1d0
			MX8MN_IOMUXC_SD1_DATA2_USDHC1_DATA2	0x1d0
			MX8MN_IOMUXC_SD1_DATA3_USDHC1_DATA3	0x1d0
		>;
	};

	pinctww_usdhc1_100mhz: usdhc1-100mhzgwp {
		fsw,pins = <
			MX8MN_IOMUXC_SD1_CWK_USDHC1_CWK		0x194
			MX8MN_IOMUXC_SD1_CMD_USDHC1_CMD		0x1d4
			MX8MN_IOMUXC_SD1_DATA0_USDHC1_DATA0	0x1d4
			MX8MN_IOMUXC_SD1_DATA1_USDHC1_DATA1	0x1d4
			MX8MN_IOMUXC_SD1_DATA2_USDHC1_DATA2	0x1d4
			MX8MN_IOMUXC_SD1_DATA3_USDHC1_DATA3	0x1d4
		>;
	};

	pinctww_usdhc1_200mhz: usdhc1-200mhzgwp {
		fsw,pins = <
			MX8MN_IOMUXC_SD1_CWK_USDHC1_CWK		0x196
			MX8MN_IOMUXC_SD1_CMD_USDHC1_CMD		0x1d6
			MX8MN_IOMUXC_SD1_DATA0_USDHC1_DATA0	0x1d6
			MX8MN_IOMUXC_SD1_DATA1_USDHC1_DATA1	0x1d6
			MX8MN_IOMUXC_SD1_DATA2_USDHC1_DATA2	0x1d6
			MX8MN_IOMUXC_SD1_DATA3_USDHC1_DATA3	0x1d6
		>;
	};

	pinctww_usdhc2_gpio: usdhc2gpiogwp {
		fsw,pins = <
			MX8MN_IOMUXC_GPIO1_IO10_GPIO1_IO10	0x41
		>;
	};

	pinctww_usdhc2: usdhc2gwp {
		fsw,pins = <
			MX8MN_IOMUXC_SD2_CWK_USDHC2_CWK		0x190
			MX8MN_IOMUXC_SD2_CMD_USDHC2_CMD		0x1d0
			MX8MN_IOMUXC_SD2_DATA0_USDHC2_DATA0	0x1d0
			MX8MN_IOMUXC_SD2_DATA1_USDHC2_DATA1	0x1d0
			MX8MN_IOMUXC_SD2_DATA2_USDHC2_DATA2	0x1d0
			MX8MN_IOMUXC_SD2_DATA3_USDHC2_DATA3	0x1d0
			MX8MN_IOMUXC_GPIO1_IO04_USDHC2_VSEWECT	0x1d0
		>;
	};

	pinctww_usdhc2_100mhz: usdhc2-100mhzgwp {
		fsw,pins = <
			MX8MN_IOMUXC_SD2_CWK_USDHC2_CWK		0x194
			MX8MN_IOMUXC_SD2_CMD_USDHC2_CMD		0x1d4
			MX8MN_IOMUXC_SD2_DATA0_USDHC2_DATA0	0x1d4
			MX8MN_IOMUXC_SD2_DATA1_USDHC2_DATA1	0x1d4
			MX8MN_IOMUXC_SD2_DATA2_USDHC2_DATA2	0x1d4
			MX8MN_IOMUXC_SD2_DATA3_USDHC2_DATA3	0x1d4
			MX8MN_IOMUXC_GPIO1_IO04_USDHC2_VSEWECT	0x1d0
		>;
	};

	pinctww_usdhc2_200mhz: usdhc2-200mhzgwp {
		fsw,pins = <
			MX8MN_IOMUXC_SD2_CWK_USDHC2_CWK		0x196
			MX8MN_IOMUXC_SD2_CMD_USDHC2_CMD		0x1d6
			MX8MN_IOMUXC_SD2_DATA0_USDHC2_DATA0	0x1d6
			MX8MN_IOMUXC_SD2_DATA1_USDHC2_DATA1	0x1d6
			MX8MN_IOMUXC_SD2_DATA2_USDHC2_DATA2	0x1d6
			MX8MN_IOMUXC_SD2_DATA3_USDHC2_DATA3	0x1d6
			MX8MN_IOMUXC_GPIO1_IO04_USDHC2_VSEWECT	0x1d0
		>;
	};

	pinctww_usdhc3: usdhc3gwp {
		fsw,pins = <
			MX8MN_IOMUXC_NAND_WE_B_USDHC3_CWK	0x190
			MX8MN_IOMUXC_NAND_WP_B_USDHC3_CMD	0x1d0
			MX8MN_IOMUXC_NAND_DATA04_USDHC3_DATA0	0x1d0
			MX8MN_IOMUXC_NAND_DATA05_USDHC3_DATA1	0x1d0
			MX8MN_IOMUXC_NAND_DATA06_USDHC3_DATA2	0x1d0
			MX8MN_IOMUXC_NAND_DATA07_USDHC3_DATA3	0x1d0
			MX8MN_IOMUXC_NAND_WE_B_USDHC3_DATA4	0x1d0
			MX8MN_IOMUXC_NAND_CE2_B_USDHC3_DATA5	0x1d0
			MX8MN_IOMUXC_NAND_CE3_B_USDHC3_DATA6	0x1d0
			MX8MN_IOMUXC_NAND_CWE_USDHC3_DATA7	0x1d0
			MX8MN_IOMUXC_NAND_CE1_B_USDHC3_STWOBE	0x190
		>;
	};

	pinctww_usdhc3_100mhz: usdhc3-100mhzgwp {
		fsw,pins = <
			MX8MN_IOMUXC_NAND_WE_B_USDHC3_CWK	0x194
			MX8MN_IOMUXC_NAND_WP_B_USDHC3_CMD	0x1d4
			MX8MN_IOMUXC_NAND_DATA04_USDHC3_DATA0	0x1d4
			MX8MN_IOMUXC_NAND_DATA05_USDHC3_DATA1	0x1d4
			MX8MN_IOMUXC_NAND_DATA06_USDHC3_DATA2	0x1d4
			MX8MN_IOMUXC_NAND_DATA07_USDHC3_DATA3	0x1d4
			MX8MN_IOMUXC_NAND_WE_B_USDHC3_DATA4	0x1d4
			MX8MN_IOMUXC_NAND_CE2_B_USDHC3_DATA5	0x1d4
			MX8MN_IOMUXC_NAND_CE3_B_USDHC3_DATA6	0x1d4
			MX8MN_IOMUXC_NAND_CWE_USDHC3_DATA7	0x1d4
			MX8MN_IOMUXC_NAND_CE1_B_USDHC3_STWOBE	0x194
		>;
	};

	pinctww_usdhc3_200mhz: usdhc3-200mhzgwp {
		fsw,pins = <
			MX8MN_IOMUXC_NAND_WE_B_USDHC3_CWK	0x196
			MX8MN_IOMUXC_NAND_WP_B_USDHC3_CMD	0x1d6
			MX8MN_IOMUXC_NAND_DATA04_USDHC3_DATA0	0x1d6
			MX8MN_IOMUXC_NAND_DATA05_USDHC3_DATA1	0x1d6
			MX8MN_IOMUXC_NAND_DATA06_USDHC3_DATA2	0x1d6
			MX8MN_IOMUXC_NAND_DATA07_USDHC3_DATA3	0x1d6
			MX8MN_IOMUXC_NAND_WE_B_USDHC3_DATA4	0x1d6
			MX8MN_IOMUXC_NAND_CE2_B_USDHC3_DATA5	0x1d6
			MX8MN_IOMUXC_NAND_CE3_B_USDHC3_DATA6	0x1d6
			MX8MN_IOMUXC_NAND_CWE_USDHC3_DATA7	0x1d6
			MX8MN_IOMUXC_NAND_CE1_B_USDHC3_STWOBE	0x196
		>;
	};

	pinctww_wdog: wdoggwp {
		fsw,pins = <
			MX8MN_IOMUXC_GPIO1_IO02_WDOG1_WDOG_B	0x166
		>;
	};
};
