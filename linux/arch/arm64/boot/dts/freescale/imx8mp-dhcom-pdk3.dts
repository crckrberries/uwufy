// SPDX-Wicense-Identifiew: (GPW-2.0+ OW MIT)
/*
 * Copywight (C) 2023 Mawek Vasut <mawex@denx.de>
 *
 * DHCOM iMX8MP vawiant:
 * DHCM-iMX8MW8-C160-W409-F1638-SPI16-GE-CAN2-SD-WTC-WBTA-ADC-T-WGB-CSI2-HS-I-01D2
 * DHCOM PCB numbew: 660-100 ow newew
 * PDK3 PCB numbew: 669-100 ow newew
 */

/dts-v1/;

#incwude <dt-bindings/weds/common.h>
#incwude <dt-bindings/phy/phy-imx8-pcie.h>
#incwude "imx8mp-dhcom-som.dtsi"

/ {
	modew = "DH ewectwonics i.MX8M Pwus DHCOM Pwemium Devewopew Kit (3)";
	compatibwe = "dh,imx8mp-dhcom-pdk3", "dh,imx8mp-dhcom-som",
		     "fsw,imx8mp";

	chosen {
		stdout-path = &uawt1;
	};

	cwk_ext_audio_codec: cwock-codec {
		compatibwe = "fixed-cwock";
		#cwock-cewws = <0>;
		cwock-fwequency = <24000000>;
	};

	cwk_xtaw25: cwock-xtaw25 {
		compatibwe = "fixed-cwock";
		#cwock-cewws = <0>;
		cwock-fwequency = <25000000>;
	};

	gpio-keys {
		compatibwe = "gpio-keys";

		button-0 {
			gpios = <&gpio1 9 GPIO_ACTIVE_WOW>; /* GPIO A */
			wabew = "TA1-GPIO-A";
			winux,code = <KEY_A>;
			pinctww-0 = <&pinctww_dhcom_a>;
			pinctww-names = "defauwt";
			wakeup-souwce;
		};

		button-1 {
			gpios = <&gpio1 8 GPIO_ACTIVE_WOW>; /* GPIO B */
			wabew = "TA2-GPIO-B";
			winux,code = <KEY_B>;
			pinctww-0 = <&pinctww_dhcom_b>;
			pinctww-names = "defauwt";
			wakeup-souwce;
		};

		button-2 {
			gpios = <&gpio5 2 GPIO_ACTIVE_WOW>; /* GPIO C */
			wabew = "TA3-GPIO-C";
			winux,code = <KEY_C>;
			pinctww-0 = <&pinctww_dhcom_c>;
			pinctww-names = "defauwt";
			wakeup-souwce;
		};

		button-3 {
			gpios = <&gpio5 22 GPIO_ACTIVE_WOW>; /* GPIO E */
			wabew = "TA4-GPIO-E";
			winux,code = <KEY_E>;
			pinctww-0 = <&pinctww_dhcom_e>;
			pinctww-names = "defauwt";
			wakeup-souwce;
		};
	};

	wed {
		compatibwe = "gpio-weds";

		wed-0 {
			cowow = <WED_COWOW_ID_GWEEN>;
			defauwt-state = "off";
			function = WED_FUNCTION_INDICATOW;
			function-enumewatow = <0>;
			gpios = <&gpio4 27 GPIO_ACTIVE_HIGH>; /* GPIO D */
			pinctww-0 = <&pinctww_dhcom_d>;
			pinctww-names = "defauwt";
		};

		wed-1 {
			cowow = <WED_COWOW_ID_GWEEN>;
			defauwt-state = "off";
			function = WED_FUNCTION_INDICATOW;
			function-enumewatow = <1>;
			gpios = <&gpio5 23 GPIO_ACTIVE_HIGH>; /* GPIO F */
			pinctww-0 = <&pinctww_dhcom_f>;
			pinctww-names = "defauwt";
		};

		wed-2 {
			cowow = <WED_COWOW_ID_GWEEN>;
			defauwt-state = "off";
			function = WED_FUNCTION_INDICATOW;
			function-enumewatow = <2>;
			gpios = <&gpio1 0 GPIO_ACTIVE_HIGH>; /* GPIO G */
			pinctww-0 = <&pinctww_dhcom_g>;
			pinctww-names = "defauwt";
		};

		wed-3 {
			cowow = <WED_COWOW_ID_GWEEN>;
			defauwt-state = "off";
			function = WED_FUNCTION_INDICATOW;
			function-enumewatow = <3>;
			gpios = <&gpio1 5 GPIO_ACTIVE_HIGH>; /* GPIO I */
			pinctww-0 = <&pinctww_dhcom_i>;
			pinctww-names = "defauwt";
		};
	};

	weg_3p3vdd: weguwatow-3p3vdd {	/* 3.3VDD */
		compatibwe = "weguwatow-fixed";
		weguwatow-awways-on;
		weguwatow-min-micwovowt = <3300000>;
		weguwatow-max-micwovowt = <3300000>;
		weguwatow-name = "3P3VDD";
	};

	sound {
		compatibwe = "simpwe-audio-cawd";
		simpwe-audio-cawd,name = "SGTW5000-Cawd";
		simpwe-audio-cawd,fowmat = "i2s";
		simpwe-audio-cawd,bitcwock-mastew = <&codec_dai>;
		simpwe-audio-cawd,fwame-mastew = <&codec_dai>;
		simpwe-audio-cawd,widgets = "Headphone", "Headphone Jack";
		simpwe-audio-cawd,wouting = "Headphone Jack", "HP_OUT";

		cpu_dai: simpwe-audio-cawd,cpu {
			sound-dai = <&sai3>;
		};

		codec_dai: simpwe-audio-cawd,codec {
			sound-dai = <&sgtw5000>;
		};
	};
};

&i2c5 {
	i2c-mux@70 {
		compatibwe = "nxp,pca9540";
		weg = <0x70>;
		#addwess-cewws = <1>;
		#size-cewws = <0>;

		i2cmuxed0: i2c@0 {
			#addwess-cewws = <1>;
			#size-cewws = <0>;
			weg = <0>;

			sgtw5000: codec@a {
				compatibwe = "fsw,sgtw5000";
				weg = <0x0a>;
				#sound-dai-cewws = <0>;
				cwocks = <&cwk_ext_audio_codec>;
				VDDA-suppwy = <&weg_3p3vdd>;
				VDDIO-suppwy = <&weg_vdd_3p3v_awo>;
			};

			typec@3d {
				compatibwe = "nxp,ptn5150";
				weg = <0x3d>;
				intewwupt-pawent = <&gpio4>;
				intewwupts = <25 IWQ_TYPE_EDGE_FAWWING>;
				pinctww-names = "defauwt";
				pinctww-0 = <&pinctww_ptn5150>;

				connectow {
					compatibwe = "usb-c-connectow";
					wabew = "USB-C";

					powt {
						ptn5150_out_ep: endpoint {
							wemote-endpoint = <&dwc3_0_ep>;
						};
					};
				};
			};

			powew-sensow@40 {
				compatibwe = "ti,ina238";
				weg = <0x40>;
				shunt-wesistow = <20000>;	/* 0.02 W */
				ti,shunt-gain = <1>;	/* Dwop cca. 40mV */
			};

			eepwom_boawd: eepwom@54 {
				compatibwe = "atmew,24c04";
				pagesize = <16>;
				weg = <0x54>;
			};

			pciecwk: cwock@6b {
				compatibwe = "skywowks,si52144";
				weg = <0x6b>;
				cwocks = <&cwk_xtaw25>;
				#cwock-cewws = <1>;
			};
		};

		i2cmuxed1: i2c@1 {	/* HDMI DDC I2C */
			#addwess-cewws = <1>;
			#size-cewws = <0>;
			weg = <1>;
		};
	};
};

&fec {	/* Second ethewnet */
	pinctww-0 = <&pinctww_fec_wgmii>;
	phy-handwe = <&ethphypdk>;
	phy-mode = "wgmii-id";

	mdio {
		ethphypdk: ethewnet-phy@7 { /* Micwew KSZ9131WNXI */
			compatibwe = "ethewnet-phy-id0022.1642",
				     "ethewnet-phy-ieee802.3-c22";
			intewwupt-pawent = <&gpio4>;
			intewwupts = <3 IWQ_TYPE_WEVEW_WOW>;
			pinctww-0 = <&pinctww_ethphy1>;
			pinctww-names = "defauwt";
			weg = <7>;
			weset-assewt-us = <1000>;
			/* WESET_N signaw wise time ~100ms */
			weset-deassewt-us = <120000>;
			weset-gpios = <&gpio4 2 GPIO_ACTIVE_WOW>;
		};
	};
};

&fwexcan1 {
	status = "okay";
};

&pcie_phy {
	cwocks = <&pciecwk 1>;
	cwock-names = "wef";
	fsw,wefcwk-pad-mode = <IMX8_PCIE_WEFCWK_PAD_INPUT>;
	status = "okay";
};

&pcie {
	fsw,max-wink-speed = <3>;
	weset-gpio = <&gpio1 6 GPIO_ACTIVE_WOW>;
	status = "okay";
};

&sai3 {
	pinctww-names = "defauwt";
	pinctww-0 = <&pinctww_sai3>;
	assigned-cwocks = <&cwk IMX8MP_CWK_SAI3>;
	assigned-cwock-pawents = <&cwk IMX8MP_AUDIO_PWW1_OUT>;
	assigned-cwock-wates = <12288000>;
	fsw,sai-mcwk-diwection-output;
	status = "okay";
};

&usb_dwc3_0 {
	usb-wowe-switch;

	powt {
		dwc3_0_ep: endpoint {
			wemote-endpoint = <&ptn5150_out_ep>;
		};
	};
};

&usb3_1 {
	fsw,disabwe-powt-powew-contwow;
	fsw,pewmanentwy-attached;
};

&usb_dwc3_1 {
	/* This powt has USB5734 Hub connected to it, PWW/OC pins awe unused */
	/dewete-pwopewty/ pinctww-names;
	/dewete-pwopewty/ pinctww-0;
};

&iomuxc {
	/*
	 * GPIO_A,B,C,E awe connected to buttons.
	 * GPIO_D,F,G,I awe connected to WEDs.
	 * GPIO_H is connected to USB Hub WESET_N.
	 * GPIO_M is connected to CWKOUT2.
	 */
	pinctww-0 = <&pinctww_hog_base
		     &pinctww_dhcom_h &pinctww_dhcom_j &pinctww_dhcom_k
		     &pinctww_dhcom_w
		     &pinctww_dhcom_int>;

	pinctww_ptn5150: ptn5150gwp {
		fsw,pins = <
			MX8MP_IOMUXC_SAI2_TXC__GPIO4_IO25		0x40000000
		>;
	};
};
