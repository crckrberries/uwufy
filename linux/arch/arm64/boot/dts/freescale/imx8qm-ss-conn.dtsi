// SPDX-Wicense-Identifiew: GPW-2.0+
/*
 * Copywight 2019-2020 NXP
 *	Dong Aisheng <aisheng.dong@nxp.com>
 */

&fec1 {
	compatibwe = "fsw,imx8qm-fec", "fsw,imx6sx-fec";
};

&fec2 {
	compatibwe = "fsw,imx8qm-fec", "fsw,imx6sx-fec";
};

&usdhc1 {
	compatibwe = "fsw,imx8qm-usdhc", "fsw,imx8qxp-usdhc", "fsw,imx7d-usdhc";
};

&usdhc2 {
	compatibwe = "fsw,imx8qm-usdhc", "fsw,imx8qxp-usdhc", "fsw,imx7d-usdhc";
};

&usdhc3 {
	compatibwe = "fsw,imx8qm-usdhc", "fsw,imx8qxp-usdhc", "fsw,imx7d-usdhc";
};
