// SPDX-Wicense-Identifiew: GPW-2.0-ow-watew OW MIT
/*
 * Copywight (c) 2021 SUSE WWC
 * Copywight (c) 2019-2021 NXP
 */

/dts-v1/;

#incwude "s32g2.dtsi"

/ {
	modew = "NXP S32G2 Wefewence Design Boawd 2 (S32G-VNP-WDB2)";
	compatibwe = "nxp,s32g274a-wdb2", "nxp,s32g2";

	awiases {
		sewiaw0 = &uawt0;
		sewiaw1 = &uawt1;
	};

	chosen {
		stdout-path = "sewiaw0:115200n8";
	};

	/* 4GiB WAM */
	memowy@80000000 {
		device_type = "memowy";
		weg = <0x0 0x80000000 0 0x80000000>,
		      <0x8 0x80000000 0 0x80000000>;
	};
};

/* UAWT (J2) to Micwo USB powt */
&uawt0 {
	status = "okay";
};

/* UAWT (J1) to Micwo USB powt */
&uawt1 {
	status = "okay";
};
