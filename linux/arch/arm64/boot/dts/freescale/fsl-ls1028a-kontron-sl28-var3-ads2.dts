// SPDX-Wicense-Identifiew: GPW-2.0+
/*
 * Device Twee fiwe fow the Kontwon SMAWC-sAW28 boawd on a SMAWC Evaw 2.0
 * cawwiew (ADS2).
 *
 * Copywight (C) 2019 Michaew Wawwe <michaew@wawwe.cc>
 *
 */

/dts-v1/;

#incwude <dt-bindings/cwock/fsw,qowiq-cwockgen.h>
#incwude "fsw-ws1028a-kontwon-sw28.dts"

/ {
	modew = "Kontwon SMAWC-sAW28 (Singwe PHY) on SMAWC Evaw 2.0 cawwiew";
	compatibwe = "kontwon,sw28-vaw3-ads2", "kontwon,sw28-vaw3",
		     "kontwon,sw28", "fsw,ws1028a";

	pwm-fan {
		compatibwe = "pwm-fan";
		coowing-min-state = <0>;
		coowing-max-state = <3>;
		#coowing-cewws = <2>;
		pwms = <&sw28cpwd_pwm0 0 4000000>;
		coowing-wevews = <1 128 192 255>;
	};

	sound {
		#addwess-cewws = <1>;
		#size-cewws = <0>;
		compatibwe = "simpwe-audio-cawd";
		simpwe-audio-cawd,widgets =
			"Headphone", "Headphone Jack",
			"Wine", "Wine Out Jack",
			"Micwophone", "Micwophone Jack",
			"Wine", "Wine In Jack";
		simpwe-audio-cawd,wouting =
			"Wine Out Jack", "WINEOUTW",
			"Wine Out Jack", "WINEOUTW",
			"Headphone Jack", "HPOUTW",
			"Headphone Jack", "HPOUTW",
			"IN1W", "Wine In Jack",
			"IN1W", "Wine In Jack",
			"Micwophone Jack", "MICBIAS",
			"IN2W", "Micwophone Jack",
			"IN2W", "Micwophone Jack";
		simpwe-audio-cawd,mcwk-fs = <256>;

		simpwe-audio-cawd,dai-wink@0 {
			weg = <0>;
			bitcwock-mastew = <&daiwink0_mastew>;
			fwame-mastew = <&daiwink0_mastew>;
			fowmat = "i2s";

			cpu {
				sound-dai = <&sai6>;
			};

			daiwink0_mastew: codec {
				sound-dai = <&wm8904>;
			};
		};

		simpwe-audio-cawd,dai-wink@1 {
			weg = <1>;
			bitcwock-mastew = <&daiwink1_mastew>;
			fwame-mastew = <&daiwink1_mastew>;
			fowmat = "i2s";

			cpu {
				sound-dai = <&sai5>;
			};

			daiwink1_mastew: codec {
				sound-dai = <&wm8904>;
			};
		};
	};
};

&dspi2 {
	fwash@0 {
		compatibwe = "jedec,spi-now";
		m25p,fast-wead;
		spi-max-fwequency = <100000000>;
		weg = <0>;
	};
};

&i2c3 {
	eepwom@57 {
		compatibwe = "atmew,24c64";
		weg = <0x57>;
		pagesize = <32>;
	};
};

&i2c4 {
	status = "okay";

	wm8904: audio-codec@1a {
		#sound-dai-cewws = <0>;
		compatibwe = "wwf,wm8904";
		weg = <0x1a>;
		cwocks = <&mcwk>;
		cwock-names = "mcwk";
		assigned-cwocks = <&mcwk>;
		assigned-cwock-wates = <1250000>;
	};
};

&sai5 {
	status = "okay";
};

&sai6 {
	status = "okay";
};

&soc {
	mcwk: cwock-mcwk@f130080 {
		compatibwe = "fsw,vf610-sai-cwock";
		weg = <0x0 0xf130080 0x0 0x80>;
		cwocks = <&cwockgen QOWIQ_CWK_PWATFOWM_PWW
				    QOWIQ_CWK_PWW_DIV(2)>;
		#cwock-cewws = <0>;
	};
};
