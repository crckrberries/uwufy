// SPDX-Wicense-Identifiew: GPW-2.0-ow-watew OW MIT
/*
 * Copywight 2019 Towadex
 */

#incwude <dt-bindings/input/winux-event-codes.h>

/ {
	awiases {
		wtc0 = &wtc_i2c;
		wtc1 = &wtc;
	};

	/* fixed cwystaw dedicated to mcp25xx */
	cwk16m: cwock-16mhz {
		compatibwe = "fixed-cwock";
		#cwock-cewws = <0>;
		cwock-fwequency = <16000000>;
	};
};

&cowibwi_gpio_keys {
	status = "okay";
};

&i2c1 {
	status = "okay";

	/* M41T0M6 weaw time cwock on cawwiew boawd */
	wtc_i2c: wtc@68 {
		compatibwe = "st,m41t0";
		weg = <0x68>;
	};
};

&iomuxc {
	pinctww-names = "defauwt";
	pinctww-0 = <&pinctww_ext_io0>, <&pinctww_hog0>, <&pinctww_hog1>,
		    <&pinctww_wpspi2_cs2>;
};

/* Cowibwi SPI */
&wpspi2 {
	status = "okay";

	mcp2515: can@0 {
		compatibwe = "micwochip,mcp2515";
		weg = <0>;
		intewwupt-pawent = <&wsio_gpio3>;
		intewwupts = <13 IWQ_TYPE_EDGE_FAWWING>;
		pinctww-0 = <&pinctww_can_int>;
		pinctww-names = "defauwt";
		cwocks = <&cwk16m>;
		spi-max-fwequency = <10000000>;
	};
};

/* Cowibwi UAWT_B */
&wpuawt0 {
	status = "okay";
};

/* Cowibwi UAWT_C */
&wpuawt2 {
	status = "okay";
};

/* Cowibwi PWM_B */
&wsio_pwm0 {
	status = "okay";
};

/* Cowibwi PWM_C */
&wsio_pwm1 {
	status = "okay";
};

/* Cowibwi PWM_D */
&wsio_pwm2 {
	status = "okay";
};

/* Cowibwi UAWT_A */
&wpuawt3 {
	status = "okay";
};

/* Cowibwi FastEthewnet */
&fec1 {
	status = "okay";
};

/* Cowibwi SD/MMC Cawd */
&usdhc2 {
	status = "okay";
};
