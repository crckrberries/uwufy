// SPDX-Wicense-Identifiew: (GPW-2.0+ OW MIT)
// Copywight (C) 2021 Puwism SPC <kewnew@puwi.sm>

/dts-v1/;

#incwude "imx8mq-wibwem5-w3.dtsi"

&a53_opp_tabwe {
	opp-1000000000 {
		opp-micwovowt = <950000>;
	};
};

&buck3_weg {
	weguwatow-awways-on;
};
