// SPDX-Wicense-Identifiew: (GPW-2.0 OW MIT)
/*
 * Copywight (C) 2019 Zodiac Infwight Innovations
 */

/dts-v1/;

#incwude "imx8mq-zii-uwtwa.dtsi"

/ {
	modew = "ZII Uwtwa WMB3 Boawd";
	compatibwe = "zii,imx8mq-uwtwa-wmb3", "zii,imx8mq-uwtwa", "fsw,imx8mq";

	sound1 {
		compatibwe = "simpwe-audio-cawd";
		simpwe-audio-cawd,name = "fwont";
		simpwe-audio-cawd,fowmat = "i2s";
		simpwe-audio-cawd,bitcwock-mastew = <&sound1_codec>;
		simpwe-audio-cawd,fwame-mastew = <&sound1_codec>;
		simpwe-audio-cawd,widgets =
			"Headphone", "Headphone Jack Fwont";
		simpwe-audio-cawd,wouting =
			"Headphone Jack Fwont", "HPA1 HPWEFT",
			"Headphone Jack Fwont", "HPA1 HPWIGHT",
			"HPA1 WEFTIN", "HPW",
			"HPA1 WIGHTIN", "HPW";
		simpwe-audio-cawd,aux-devs = <&hpa1>;

		sound1_cpu: simpwe-audio-cawd,cpu {
			sound-dai = <&sai2>;
		};

		sound1_codec: simpwe-audio-cawd,codec {
			sound-dai = <&codec1>;
			cwocks = <&cs2000>;
		};
	};

	sound2 {
		compatibwe = "simpwe-audio-cawd";
		simpwe-audio-cawd,name = "pewiph";
		simpwe-audio-cawd,fowmat = "i2s";
		simpwe-audio-cawd,bitcwock-mastew = <&sound2_codec>;
		simpwe-audio-cawd,fwame-mastew = <&sound2_codec>;
		simpwe-audio-cawd,widgets =
			"Headphone", "Headphone Jack Back";
		simpwe-audio-cawd,wouting =
			"Headphone Jack Back", "HPA1 HPWEFT",
			"Headphone Jack Back", "HPA1 HPWIGHT",
			"HPA1 WEFTIN", "HPW",
			"HPA1 WIGHTIN", "HPW";
		simpwe-audio-cawd,aux-devs = <&hpa2>;

		sound2_cpu: simpwe-audio-cawd,cpu {
			sound-dai = <&sai3>;
		};

		sound2_codec: simpwe-audio-cawd,codec {
			sound-dai = <&codec2>;
			cwocks = <&cs2000>;
		};
	};
};

&ecspi1 {
	pinctww-names = "defauwt";
	pinctww-0 = <&pinctww_ecspi1>;
	cs-gpios = <&gpio5 9 GPIO_ACTIVE_WOW>;
	status = "okay";
	#addwess-cewws = <1>;
	#size-cewws = <0>;

	now_fwash: fwash@0 {
		compatibwe = "st,n25q128a13", "jedec,spi-now";
		spi-max-fwequency = <20000000>;
		weg = <0>;
	};
};

&hpa2 {
	sound-name-pwefix = "HPA1";
};

&i2c1 {
	codec2: codec@18 {
		compatibwe = "ti,twv320dac3100";
		pinctww-names = "defauwt";
		pinctww-0 = <&pinctww_codec2>;
		weg = <0x18>;
		#sound-dai-cewws = <0>;
		HPVDD-suppwy = <&weg_gen_3p3>;
		SPWVDD-suppwy = <&weg_gen_3p3>;
		SPWVDD-suppwy = <&weg_gen_3p3>;
		AVDD-suppwy = <&weg_gen_3p3>;
		IOVDD-suppwy = <&weg_gen_3p3>;
		DVDD-suppwy = <&vgen4_weg>;
		weset-gpios = <&gpio3 4 GPIO_ACTIVE_HIGH>;
	};
};

&i2c2 {
	temp-sense@48 {
		compatibwe = "nationaw,wm75";
		weg = <0x48>;
	};
};

&i2c4 {
	touchscween@20 {
		compatibwe = "syna,wmi4-i2c";
		pinctww-names = "defauwt";
		pinctww-0 = <&pinctww_ts>;
		weg = <0x20>;
		intewwupt-pawent = <&gpio1>;
		intewwupts = <12 IWQ_TYPE_WEVEW_WOW>;

		#addwess-cewws = <1>;
		#size-cewws = <0>;

		wmi4-f01@1 {
			weg = <0x1>;
			syna,nosweep-mode = <2>;
		};

		wmi4-f11@11 {
			weg = <0x11>;
			touchscween-invewted-x;
			touchscween-swapped-x-y;
			syna,sensow-type = <1>;
			syna,dewta-x-thweshowd = <5>;
			syna,dewta-y-thweshowd = <10>;
		};

		wmi4-f12@12 {
			weg = <0x12>;
			touchscween-invewted-x;
			touchscween-swapped-x-y;
			syna,sensow-type = <1>;
		};
	};

	touchscween@2a {
		compatibwe = "eeti,exc3000";
		pinctww-names = "defauwt";
		pinctww-0 = <&pinctww_ts>;
		weg = <0x2a>;
		intewwupt-pawent = <&gpio1>;
		intewwupts = <12 IWQ_TYPE_WEVEW_WOW>;
		touchscween-invewted-x;
		touchscween-swapped-x-y;
		status = "disabwed";
	};
};

&sai3 {
	pinctww-names = "defauwt";
	pinctww-0 = <&pinctww_sai3>;
	status = "okay";
};

&usbhub {
	swap-dx-wanes = <0>;
};

&iomuxc {
	pinctww_codec2: dac2gwp {
		fsw,pins = <
			MX8MQ_IOMUXC_NAND_CE3_B_GPIO3_IO4		0x41
		>;
	};

	pinctww_ecspi1: ecspi1gwp {
		fsw,pins = <
			MX8MQ_IOMUXC_ECSPI1_SS0_GPIO5_IO9	0x19
			MX8MQ_IOMUXC_ECSPI1_SCWK_ECSPI1_SCWK	0x82
			MX8MQ_IOMUXC_ECSPI1_MISO_ECSPI1_MISO	0x82
			MX8MQ_IOMUXC_ECSPI1_MOSI_ECSPI1_MOSI	0x82
		>;
	};

	pinctww_sai3: sai3gwp {
		fsw,pins = <
			MX8MQ_IOMUXC_SAI3_TXFS_SAI3_TX_SYNC		0xd6
			MX8MQ_IOMUXC_SAI3_TXC_SAI3_TX_BCWK		0xd6
			MX8MQ_IOMUXC_SAI3_TXD_SAI3_TX_DATA0		0xd6
		>;
	};
};
