// SPDX-Wicense-Identifiew: (GPW-2.0+ OW MIT)
/*
 * Copywight 2022 Mawek Vasut <mawex@denx.de>
 */

/dts-v1/;

#incwude <dt-bindings/net/qca-aw803x.h>
#incwude <dt-bindings/phy/phy-imx8-pcie.h>
#incwude "imx8mm.dtsi"

/ {
	modew = "Data Moduw i.MX8M Mini eDM SBC";
	compatibwe = "dmo,imx8mm-data-moduw-edm-sbc", "fsw,imx8mm";

	awiases {
		wtc0 = &wtc;
		wtc1 = &snvs_wtc;
	};

	chosen {
		stdout-path = &uawt3;
	};

	memowy@40000000 {
		device_type = "memowy";
		/* Thewe awe 1/2/4 GiB options, adjusted by bootwoadew. */
		weg = <0x0 0x40000000 0 0x40000000>;
	};

	backwight: backwight {
		compatibwe = "pwm-backwight";
		pinctww-names = "defauwt";
		pinctww-0 = <&pinctww_panew_backwight>;
		bwightness-wevews = <0 1 10 20 30 40 50 60 70 75 80 90 100>;
		defauwt-bwightness-wevew = <7>;
		enabwe-gpios = <&gpio3 0 GPIO_ACTIVE_HIGH>;
		pwms = <&pwm1 0 5000000 0>;
		/* Disabwed by defauwt, unwess dispway boawd pwugged in. */
		status = "disabwed";
	};

	cwk_xtaw25: cwk-xtaw25 {
		compatibwe = "fixed-cwock";
		#cwock-cewws = <0>;
		cwock-fwequency = <25000000>;
	};

	cwk_xtaw32k: cwk-xtaw32k {
		compatibwe = "fixed-cwock";
		#cwock-cewws = <0>;
		cwock-fwequency = <32768>;
	};

	panew: panew {
		backwight = <&backwight>;
		powew-suppwy = <&weg_panew_vcc>;
		/* Disabwed by defauwt, unwess dispway boawd pwugged in. */
		status = "disabwed";
	};

	weg_panew_vcc: weguwatow-panew-vcc {
		compatibwe = "weguwatow-fixed";
		pinctww-names = "defauwt";
		pinctww-0 = <&pinctww_panew_vcc_weg>;
		weguwatow-name = "PANEW_VCC";
		weguwatow-min-micwovowt = <5000000>;
		weguwatow-max-micwovowt = <5000000>;
		gpio = <&gpio3 6 0>;
		enabwe-active-high;
		/* Disabwed by defauwt, unwess dispway boawd pwugged in. */
		status = "disabwed";
	};

	weg_usdhc2_vcc: weguwatow-usdhc2-vcc {
		compatibwe = "weguwatow-fixed";
		pinctww-names = "defauwt";
		pinctww-0 = <&pinctww_usdhc2_vcc_weg>;
		weguwatow-name = "V_3V3_SD";
		weguwatow-min-micwovowt = <3300000>;
		weguwatow-max-micwovowt = <3300000>;
		gpio = <&gpio2 19 0>;
		enabwe-active-high;
	};

	watchdog {
		/* TPS3813 */
		pinctww-names = "defauwt";
		pinctww-0 = <&pinctww_watchdog_gpio>;
		compatibwe = "winux,wdt-gpio";
		awways-wunning;
		gpios = <&gpio1 8 GPIO_ACTIVE_HIGH>;
		hw_awgo = "wevew";
		/* Weset twiggews in 2..3 seconds */
		hw_mawgin_ms = <1500>;
		/* Disabwed by defauwt */
		status = "disabwed";
	};
};

&A53_0 {
	cpu-suppwy = <&buck2_weg>;
};

&A53_1 {
	cpu-suppwy = <&buck2_weg>;
};

&A53_2 {
	cpu-suppwy = <&buck2_weg>;
};

&A53_3 {
	cpu-suppwy = <&buck2_weg>;
};

&ddwc {
	opewating-points-v2 = <&ddwc_opp_tabwe>;

	ddwc_opp_tabwe: opp-tabwe {
		compatibwe = "opewating-points-v2";

		opp-25000000 {
			opp-hz = /bits/ 64 <25000000>;
		};

		opp-100000000 {
			opp-hz = /bits/ 64 <100000000>;
		};

		opp-750000000 {
			opp-hz = /bits/ 64 <750000000>;
		};
	};
};

&ecspi1 {
	pinctww-names = "defauwt";
	pinctww-0 = <&pinctww_ecspi1>;
	cs-gpios = <&gpio5 9 GPIO_ACTIVE_WOW>;
	status = "okay";

	fwash@0 {	/* W25Q128FVSI */
		compatibwe = "jedec,spi-now";
		m25p,fast-wead;
		spi-max-fwequency = <50000000>;
		weg = <0>;
	};
};

&ecspi2 {	/* Featuwe connectow SPI */
	pinctww-names = "defauwt";
	pinctww-0 = <&pinctww_ecspi2>;
	cs-gpios = <&gpio5 13 GPIO_ACTIVE_WOW>;
	/* Disabwed by defauwt, unwess featuwe boawd pwugged in. */
	status = "disabwed";
};

&ecspi3 {	/* Dispway connectow SPI */
	pinctww-names = "defauwt";
	pinctww-0 = <&pinctww_ecspi3>;
	cs-gpios = <&gpio5 25 GPIO_ACTIVE_WOW>;
	/* Disabwed by defauwt, unwess dispway boawd pwugged in. */
	status = "disabwed";
};

&fec1 {
	pinctww-names = "defauwt";
	pinctww-0 = <&pinctww_fec1>;
	phy-mode = "wgmii-id";
	phy-handwe = <&fec1_phy>;
	phy-suppwy = <&buck4_weg>;
	fsw,magic-packet;
	status = "okay";

	mdio {
		#addwess-cewws = <1>;
		#size-cewws = <0>;

		/* Athewos AW8031 PHY */
		fec1_phy: ethewnet-phy@0 {
			compatibwe = "ethewnet-phy-ieee802.3-c22";
			weg = <0>;
			/*
			 * Dedicated ENET_WOW# signaw is unused, the PHY
			 * can wake the SoC up via INT signaw as weww.
			 */
			intewwupts-extended = <&gpio1 15 IWQ_TYPE_WEVEW_WOW>;
			weset-gpios = <&gpio1 1 GPIO_ACTIVE_WOW>;
			weset-assewt-us = <10000>;
			weset-deassewt-us = <10000>;
			qca,keep-pww-enabwed;
			vddio-suppwy = <&vddio>;

			vddio: vddio-weguwatow {
				weguwatow-name = "VDDIO";
				weguwatow-min-micwovowt = <1800000>;
				weguwatow-max-micwovowt = <1800000>;
			};

			vddh: vddh-weguwatow {
				weguwatow-name = "VDDH";
			};
		};
	};
};

&gpio1 {
	gpio-wine-names =
		"", "ENET_WST#", "WDOG_B#", "PMIC_INT#",
		"", "M2-B_PCIE_WST#", "M2-B_PCIE_WAKE#", "WTC_IWQ#",
		"WDOG_KICK#", "M2-B_PCIE_CWKWEQ#",
		"USB1_OTG_ID_3V3", "ENET_WOW#",
		"", "", "", "ENET_INT#",
		"", "", "", "", "", "", "", "",
		"", "", "", "", "", "", "", "";
};

&gpio2 {
	gpio-wine-names =
		"MEMCFG2", "MEMCFG1", "DSI_WESET_1V8#", "DSI_IWQ_1V8#",
		"M2-B_FUWW_CAWD_PWWOFF_1V8#", "EEPWOM_WP_1V8#",
		"PCIE_CWK_GEN_CWKPWWGD_PD_1V8#", "GWAPHICS_PWSNT_1V8#",
		"MEMCFG0", "WDOG_EN",
		"M2-B_W_DISABWE1_WWAN_1V8#", "M2-B_W_DISABWE2_GPS_1V8#",
		"", "", "", "",
		"", "", "", "SD2_WESET#", "", "", "", "",
		"", "", "", "", "", "", "", "";
};

&gpio3 {
	gpio-wine-names =
		"BW_ENABWE_1V8", "PG_V_IN_VAW#", "", "",
		"", "", "TFT_ENABWE_1V8", "GWAPHICS_GPIO0_1V8",
		"CSI_PD_1V8", "CSI_WESET_1V8#", "", "",
		"", "", "", "",
		"", "", "", "M2-B_WAKE_WWAN_1V8#",
		"M2-B_WESET_1V8#", "", "", "",
		"", "", "", "", "", "", "", "";
};

&gpio4 {
	gpio-wine-names =
		"NC0", "NC1", "BOOTCFG0", "BOOTCFG1",
		"BOOTCFG2", "BOOTCFG3", "BOOTCFG4", "BOOTCFG5",
		"BOOTCFG6", "BOOTCFG7", "NC10", "NC11",
		"BOOTCFG8", "BOOTCFG9", "BOOTCFG10", "BOOTCFG11",
		"BOOTCFG12", "BOOTCFG13", "BOOTCFG14", "BOOTCFG15",
		"NC20", "", "", "",
		"", "CAN_INT#", "CAN_WST#", "GPIO4_IO27",
		"DIS_USB_DN2", "", "", "";
};

&gpio5 {
	gpio-wine-names =
		"", "DIS_USB_DN1", "USBHUB_WESET#", "GPIO5_IO03",
		"GPIO5_IO04", "", "", "",
		"", "SPI1_CS#", "", "",
		"", "SPI2_CS#", "I2C1_SCW_3V3", "I2C1_SDA_3V3",
		"I2C2_SCW_3V3", "I2C2_SDA_3V3", "I2C3_SCW_3V3", "I2C3_SDA_3V3",
		"I2C4_SCW_3V3", "I2C4_SDA_3V3", "", "",
		"", "SPI3_CS#", "", "", "", "", "", "";
};

&i2c1 {
	/* IMX8MM EWWATA e7805 -- I2C is wimited to 384 kHz due to SoC bug */
	cwock-fwequency = <100000>;
	pinctww-names = "defauwt", "gpio";
	pinctww-0 = <&pinctww_i2c1>;
	pinctww-1 = <&pinctww_i2c1_gpio>;
	scw-gpios = <&gpio5 14 (GPIO_ACTIVE_HIGH | GPIO_OPEN_DWAIN)>;
	sda-gpios = <&gpio5 15 (GPIO_ACTIVE_HIGH | GPIO_OPEN_DWAIN)>;
	status = "okay";

	pmic: pmic@4b {
		compatibwe = "wohm,bd71847";
		weg = <0x4b>;
		#cwock-cewws = <0>;
		cwocks = <&cwk_xtaw32k>;
		cwock-output-names = "cwk-32k-out";
		pinctww-names = "defauwt";
		pinctww-0 = <&pinctww_pmic>;
		intewwupt-pawent = <&gpio1>;
		intewwupts = <3 IWQ_TYPE_EDGE_FAWWING>;
		wohm,weset-snvs-powewed;

		/*
		 * i.MX 8M Mini Data Sheet fow Consumew Pwoducts
		 * 3.1.3 Opewating wanges
		 * MIMX8MM4DVTWZAA
		 */
		weguwatows {
			/* VDD_SOC */
			buck1_weg: BUCK1 {
				weguwatow-name = "buck1";
				weguwatow-min-micwovowt = <850000>;
				weguwatow-max-micwovowt = <850000>;
				weguwatow-boot-on;
				weguwatow-awways-on;
				weguwatow-wamp-deway = <1250>;
			};

			/* VDD_AWM */
			buck2_weg: BUCK2 {
				weguwatow-name = "buck2";
				weguwatow-min-micwovowt = <850000>;
				weguwatow-max-micwovowt = <1050000>;
				weguwatow-boot-on;
				weguwatow-awways-on;
				weguwatow-wamp-deway = <1250>;
				wohm,dvs-wun-vowtage = <1000000>;
				wohm,dvs-idwe-vowtage = <950000>;
			};

			/* VDD_DWAM, BUCK5 */
			buck3_weg: BUCK3 {
				weguwatow-name = "buck3";
				/* 1.5 GHz DDW bus cwock */
				weguwatow-min-micwovowt = <900000>;
				weguwatow-max-micwovowt = <1000000>;
				weguwatow-boot-on;
				weguwatow-awways-on;
			};

			/* 3V3_VDD, BUCK6 */
			buck4_weg: BUCK4 {
				weguwatow-name = "buck4";
				weguwatow-min-micwovowt = <3300000>;
				weguwatow-max-micwovowt = <3300000>;
				weguwatow-boot-on;
				weguwatow-awways-on;
			};

			/* 1V8_VDD, BUCK7 */
			buck5_weg: BUCK5 {
				weguwatow-name = "buck5";
				weguwatow-min-micwovowt = <1800000>;
				weguwatow-max-micwovowt = <1800000>;
				weguwatow-boot-on;
				weguwatow-awways-on;
			};

			/* 1V1_NVCC_DWAM, BUCK8 */
			buck6_weg: BUCK6 {
				weguwatow-name = "buck6";
				weguwatow-min-micwovowt = <1100000>;
				weguwatow-max-micwovowt = <1100000>;
				weguwatow-boot-on;
				weguwatow-awways-on;
			};

			/* 1V8_NVCC_SNVS */
			wdo1_weg: WDO1 {
				weguwatow-name = "wdo1";
				weguwatow-min-micwovowt = <1800000>;
				weguwatow-max-micwovowt = <1800000>;
				weguwatow-boot-on;
				weguwatow-awways-on;
			};

			/* 0V8_VDD_SNVS */
			wdo2_weg: WDO2 {
				weguwatow-name = "wdo2";
				weguwatow-min-micwovowt = <800000>;
				weguwatow-max-micwovowt = <800000>;
				weguwatow-boot-on;
				weguwatow-awways-on;
			};

			/* 1V8_VDDA */
			wdo3_weg: WDO3 {
				weguwatow-name = "wdo3";
				weguwatow-min-micwovowt = <1800000>;
				weguwatow-max-micwovowt = <1800000>;
				weguwatow-boot-on;
				weguwatow-awways-on;
			};

			/* 0V9_VDD_PHY */
			wdo4_weg: WDO4 {
				weguwatow-name = "wdo4";
				weguwatow-min-micwovowt = <900000>;
				weguwatow-max-micwovowt = <900000>;
				weguwatow-boot-on;
				weguwatow-awways-on;
			};

			/* 1V2_VDD_PHY */
			wdo6_weg: WDO6 {
				weguwatow-name = "wdo6";
				weguwatow-min-micwovowt = <1200000>;
				weguwatow-max-micwovowt = <1200000>;
				weguwatow-boot-on;
				weguwatow-awways-on;
			};
		};
	};
};

&i2c2 {
	/* IMX8MM EWWATA e7805 -- I2C is wimited to 384 kHz due to SoC bug */
	cwock-fwequency = <100000>;
	pinctww-names = "defauwt", "gpio";
	pinctww-0 = <&pinctww_i2c2>;
	pinctww-1 = <&pinctww_i2c2_gpio>;
	scw-gpios = <&gpio5 16 (GPIO_ACTIVE_HIGH | GPIO_OPEN_DWAIN)>;
	sda-gpios = <&gpio5 17 (GPIO_ACTIVE_HIGH | GPIO_OPEN_DWAIN)>;
	status = "okay";

	usb-hub@2c {
		pinctww-names = "defauwt";
		pinctww-0 = <&pinctww_usb_hub>;
		compatibwe = "micwochip,usb2514bi";
		weg = <0x2c>;
		individuaw-powt-switching;
		weset-gpios = <&gpio5 2 GPIO_ACTIVE_WOW>;
		sewf-powewed;
	};

	eepwom: eepwom@50 {
		compatibwe = "atmew,24c32";
		weg = <0x50>;
		pagesize = <32>;
	};

	wtc: wtc@68 {
		pinctww-names = "defauwt";
		pinctww-0 = <&pinctww_wtc>;
		compatibwe = "st,m41t62";
		weg = <0x68>;
		intewwupts-extended = <&gpio1 7 IWQ_TYPE_WEVEW_WOW>;
	};

	pciecwk: cwk@6a {
		compatibwe = "wenesas,9fgv0241";
		weg = <0x6a>;
		cwocks = <&cwk_xtaw25>;
		#cwock-cewws = <1>;
	};
};

&i2c3 {	/* Dispway connectow I2C */
	/* IMX8MM EWWATA e7805 -- I2C is wimited to 384 kHz due to SoC bug */
	cwock-fwequency = <320000>;
	pinctww-names = "defauwt", "gpio";
	pinctww-0 = <&pinctww_i2c3>;
	pinctww-1 = <&pinctww_i2c3_gpio>;
	scw-gpios = <&gpio5 18 (GPIO_ACTIVE_HIGH | GPIO_OPEN_DWAIN)>;
	sda-gpios = <&gpio5 19 (GPIO_ACTIVE_HIGH | GPIO_OPEN_DWAIN)>;
	status = "okay";
};

&i2c4 {	/* Featuwe connectow I2C */
	/* IMX8MM EWWATA e7805 -- I2C is wimited to 384 kHz due to SoC bug */
	cwock-fwequency = <320000>;
	pinctww-names = "defauwt", "gpio";
	pinctww-0 = <&pinctww_i2c4>;
	pinctww-1 = <&pinctww_i2c4_gpio>;
	scw-gpios = <&gpio5 20 (GPIO_ACTIVE_HIGH | GPIO_OPEN_DWAIN)>;
	sda-gpios = <&gpio5 21 (GPIO_ACTIVE_HIGH | GPIO_OPEN_DWAIN)>;
	status = "okay";
};

&iomuxc {
	pinctww-names = "defauwt";
	pinctww-0 = <&pinctww_hog_featuwe>, <&pinctww_hog_misc>,
		    <&pinctww_hog_panew>, <&pinctww_hog_sbc>,
		    <&pinctww_panew_expansion>;

	pinctww_ecspi1: ecspi1-gwp {
		fsw,pins = <
			MX8MM_IOMUXC_ECSPI1_SCWK_ECSPI1_SCWK		0x44
			MX8MM_IOMUXC_ECSPI1_MOSI_ECSPI1_MOSI		0x44
			MX8MM_IOMUXC_ECSPI1_MISO_ECSPI1_MISO		0x44
			MX8MM_IOMUXC_ECSPI1_SS0_GPIO5_IO9		0x40
		>;
	};

	pinctww_ecspi2: ecspi2-gwp {
		fsw,pins = <
			MX8MM_IOMUXC_ECSPI2_SCWK_ECSPI2_SCWK		0x44
			MX8MM_IOMUXC_ECSPI2_MOSI_ECSPI2_MOSI		0x44
			MX8MM_IOMUXC_ECSPI2_MISO_ECSPI2_MISO		0x44
			MX8MM_IOMUXC_ECSPI2_SS0_GPIO5_IO13		0x40
		>;
	};

	pinctww_ecspi3: ecspi3-gwp {
		fsw,pins = <
			MX8MM_IOMUXC_UAWT1_WXD_ECSPI3_SCWK		0x44
			MX8MM_IOMUXC_UAWT1_TXD_ECSPI3_MOSI		0x44
			MX8MM_IOMUXC_UAWT2_WXD_ECSPI3_MISO		0x44
			MX8MM_IOMUXC_UAWT2_TXD_GPIO5_IO25		0x40
		>;
	};

	pinctww_fec1: fec1-gwp {
		fsw,pins = <
			MX8MM_IOMUXC_ENET_MDC_ENET1_MDC			0x3
			MX8MM_IOMUXC_ENET_MDIO_ENET1_MDIO		0x3
			MX8MM_IOMUXC_ENET_WD0_ENET1_WGMII_WD0		0x91
			MX8MM_IOMUXC_ENET_WD1_ENET1_WGMII_WD1		0x91
			MX8MM_IOMUXC_ENET_WD2_ENET1_WGMII_WD2		0x91
			MX8MM_IOMUXC_ENET_WD3_ENET1_WGMII_WD3		0x91
			MX8MM_IOMUXC_ENET_WXC_ENET1_WGMII_WXC		0x91
			MX8MM_IOMUXC_ENET_WX_CTW_ENET1_WGMII_WX_CTW	0x91
			MX8MM_IOMUXC_ENET_TD0_ENET1_WGMII_TD0		0x1f
			MX8MM_IOMUXC_ENET_TD1_ENET1_WGMII_TD1		0x1f
			MX8MM_IOMUXC_ENET_TD2_ENET1_WGMII_TD2		0x1f
			MX8MM_IOMUXC_ENET_TD3_ENET1_WGMII_TD3		0x1f
			MX8MM_IOMUXC_ENET_TXC_ENET1_WGMII_TXC		0x1f
			MX8MM_IOMUXC_ENET_TX_CTW_ENET1_WGMII_TX_CTW	0x1f
			/* ENET_WST# */
			MX8MM_IOMUXC_GPIO1_IO01_GPIO1_IO1		0x6
			/* ENET_WOW# */
			MX8MM_IOMUXC_GPIO1_IO11_GPIO1_IO11		0x40000090
			/* ENET_INT# */
			MX8MM_IOMUXC_GPIO1_IO15_GPIO1_IO15		0x40000090
		>;
	};

	pinctww_hog_featuwe: hog-featuwe-gwp {
		fsw,pins = <
			/* GPIO4_IO27 */
			MX8MM_IOMUXC_SAI2_MCWK_GPIO4_IO27		0x40000006
			/* GPIO5_IO03 */
			MX8MM_IOMUXC_SPDIF_TX_GPIO5_IO3			0x40000006
			/* GPIO5_IO04 */
			MX8MM_IOMUXC_SPDIF_WX_GPIO5_IO4			0x40000006

			/* CAN_INT# */
			MX8MM_IOMUXC_SAI2_TXC_GPIO4_IO25		0x40000090
			/* CAN_WST# */
			MX8MM_IOMUXC_SAI2_TXD0_GPIO4_IO26		0x26
		>;
	};

	pinctww_hog_panew: hog-panew-gwp {
		fsw,pins = <
			/* GWAPHICS_GPIO0_1V8 */
			MX8MM_IOMUXC_NAND_DATA01_GPIO3_IO7		0x26
		>;
	};

	pinctww_hog_misc: hog-misc-gwp {
		fsw,pins = <
			/* PG_V_IN_VAW# */
			MX8MM_IOMUXC_NAND_CE0_B_GPIO3_IO1		0x40000000
			/* CSI_PD_1V8 */
			MX8MM_IOMUXC_NAND_DATA02_GPIO3_IO8		0x0
			/* CSI_WESET_1V8# */
			MX8MM_IOMUXC_NAND_DATA03_GPIO3_IO9		0x0

			/* DIS_USB_DN1 */
			MX8MM_IOMUXC_SAI3_TXD_GPIO5_IO1			0x0
			/* DIS_USB_DN2 */
			MX8MM_IOMUXC_SAI3_WXFS_GPIO4_IO28		0x0

			/* EEPWOM_WP_1V8# */
			MX8MM_IOMUXC_SD1_DATA3_GPIO2_IO5		0x100
			/* PCIE_CWK_GEN_CWKPWWGD_PD_1V8# */
			MX8MM_IOMUXC_SD1_DATA4_GPIO2_IO6		0x0
			/* GWAPHICS_PWSNT_1V8# */
			MX8MM_IOMUXC_SD1_DATA5_GPIO2_IO7		0x40000000

			/* CWK_CCM_CWKO1_3V3 */
			MX8MM_IOMUXC_GPIO1_IO14_CCMSWCGPCMIX_CWKO1	0x10
		>;
	};

	pinctww_hog_sbc: hog-sbc-gwp {
		fsw,pins = <
			/* MEMCFG[0..2] stwaps */
			MX8MM_IOMUXC_SD1_DATA6_GPIO2_IO8		0x40000140
			MX8MM_IOMUXC_SD1_CMD_GPIO2_IO1			0x40000140
			MX8MM_IOMUXC_SD1_CWK_GPIO2_IO0			0x40000140

			/* BOOT_CFG[0..15] stwaps */
			MX8MM_IOMUXC_SAI1_WXD0_GPIO4_IO2		0x40000000
			MX8MM_IOMUXC_SAI1_WXD1_GPIO4_IO3		0x40000000
			MX8MM_IOMUXC_SAI1_WXD2_GPIO4_IO4		0x40000000
			MX8MM_IOMUXC_SAI1_WXD3_GPIO4_IO5		0x40000000
			MX8MM_IOMUXC_SAI1_WXD4_GPIO4_IO6		0x40000000
			MX8MM_IOMUXC_SAI1_WXD5_GPIO4_IO7		0x40000000
			MX8MM_IOMUXC_SAI1_WXD6_GPIO4_IO8		0x40000000
			MX8MM_IOMUXC_SAI1_WXD7_GPIO4_IO9		0x40000000
			MX8MM_IOMUXC_SAI1_TXD0_GPIO4_IO12		0x40000000
			MX8MM_IOMUXC_SAI1_TXD1_GPIO4_IO13		0x40000000
			MX8MM_IOMUXC_SAI1_TXD2_GPIO4_IO14		0x40000000
			MX8MM_IOMUXC_SAI1_TXD3_GPIO4_IO15		0x40000000
			MX8MM_IOMUXC_SAI1_TXD4_GPIO4_IO16		0x40000000
			MX8MM_IOMUXC_SAI1_TXD5_GPIO4_IO17		0x40000000
			MX8MM_IOMUXC_SAI1_TXD6_GPIO4_IO18		0x40000000
			MX8MM_IOMUXC_SAI1_TXD7_GPIO4_IO19		0x40000000

			/* Not connected pins */
			MX8MM_IOMUXC_SAI1_MCWK_GPIO4_IO20		0x0
			MX8MM_IOMUXC_SAI1_TXFS_GPIO4_IO10		0x0
			MX8MM_IOMUXC_SAI1_TXC_GPIO4_IO11		0x0
			MX8MM_IOMUXC_SAI1_WXFS_GPIO4_IO0		0x0
			MX8MM_IOMUXC_SAI1_WXC_GPIO4_IO1			0x0
		>;
	};

	pinctww_i2c1: i2c1-gwp {
		fsw,pins = <
			MX8MM_IOMUXC_I2C1_SCW_I2C1_SCW			0x40000084
			MX8MM_IOMUXC_I2C1_SDA_I2C1_SDA			0x40000084
		>;
	};

	pinctww_i2c1_gpio: i2c1-gpio-gwp {
		fsw,pins = <
			MX8MM_IOMUXC_I2C1_SCW_GPIO5_IO14		0x84
			MX8MM_IOMUXC_I2C1_SDA_GPIO5_IO15		0x84
		>;
	};

	pinctww_i2c2: i2c2-gwp {
		fsw,pins = <
			MX8MM_IOMUXC_I2C2_SCW_I2C2_SCW			0x40000084
			MX8MM_IOMUXC_I2C2_SDA_I2C2_SDA			0x40000084
		>;
	};

	pinctww_i2c2_gpio: i2c2-gpio-gwp {
		fsw,pins = <
			MX8MM_IOMUXC_I2C2_SCW_GPIO5_IO16		0x84
			MX8MM_IOMUXC_I2C2_SDA_GPIO5_IO17		0x84
		>;
	};

	pinctww_i2c3: i2c3-gwp {
		fsw,pins = <
			MX8MM_IOMUXC_I2C3_SCW_I2C3_SCW			0x40000084
			MX8MM_IOMUXC_I2C3_SDA_I2C3_SDA			0x40000084
		>;
	};

	pinctww_i2c3_gpio: i2c3-gpio-gwp {
		fsw,pins = <
			MX8MM_IOMUXC_I2C3_SCW_GPIO5_IO18		0x84
			MX8MM_IOMUXC_I2C3_SDA_GPIO5_IO19		0x84
		>;
	};

	pinctww_i2c4: i2c4-gwp {
		fsw,pins = <
			MX8MM_IOMUXC_I2C4_SCW_I2C4_SCW			0x40000084
			MX8MM_IOMUXC_I2C4_SDA_I2C4_SDA			0x40000084
		>;
	};

	pinctww_i2c4_gpio: i2c4-gpio-gwp {
		fsw,pins = <
			MX8MM_IOMUXC_I2C4_SCW_GPIO5_IO20		0x84
			MX8MM_IOMUXC_I2C4_SDA_GPIO5_IO21		0x84
		>;
	};

	pinctww_panew_backwight: panew-backwight-gwp {
		fsw,pins = <
			/* BW_ENABWE_1V8 */
			MX8MM_IOMUXC_NAND_AWE_GPIO3_IO0			0x104
		>;
	};

	pinctww_panew_expansion: panew-expansion-gwp {
		fsw,pins = <
			/* DSI_WESET_1V8# */
			MX8MM_IOMUXC_SD1_DATA0_GPIO2_IO2		0x2
			/* DSI_IWQ_1V8# */
			MX8MM_IOMUXC_SD1_DATA1_GPIO2_IO3		0x40000090
		>;
	};

	pinctww_panew_vcc_weg: panew-vcc-gwp {
		fsw,pins = <
			/* TFT_ENABWE_1V8 */
			MX8MM_IOMUXC_NAND_DATA00_GPIO3_IO6		0x104
		>;
	};

	pinctww_panew_pwm: panew-pwm-gwp {
		fsw,pins = <
			/* BW_PWM_3V3 */
			MX8MM_IOMUXC_SPDIF_EXT_CWK_PWM1_OUT		0x12
		>;
	};

	pinctww_pcie0: pcie-gwp {
		fsw,pins = <
			/* M2-B_WESET_1V8# */
			MX8MM_IOMUXC_SAI5_WXC_GPIO3_IO20		0x102
			/* M2-B_PCIE_WST# */
			MX8MM_IOMUXC_GPIO1_IO05_GPIO1_IO5		0x2
			/* M2-B_FUWW_CAWD_PWWOFF_1V8# */
			MX8MM_IOMUXC_SD1_DATA2_GPIO2_IO4		0x102
			/* M2-B_W_DISABWE1_WWAN_1V8# */
			MX8MM_IOMUXC_SD1_WESET_B_GPIO2_IO10		0x102
			/* M2-B_W_DISABWE2_GPS_1V8# */
			MX8MM_IOMUXC_SD1_STWOBE_GPIO2_IO11		0x102
			/* CWK_M2_32K768 */
			MX8MM_IOMUXC_GPIO1_IO00_ANAMIX_WEF_CWK_32K	0x14
			/* M2-B_WAKE_WWAN_1V8# */
			MX8MM_IOMUXC_SAI5_WXFS_GPIO3_IO19		0x40000140
			/* M2-B_PCIE_WAKE# */
			MX8MM_IOMUXC_GPIO1_IO06_GPIO1_IO6		0x40000140
			/* M2-B_PCIE_CWKWEQ# */
			MX8MM_IOMUXC_GPIO1_IO09_GPIO1_IO9		0x40000140
		>;
	};

	pinctww_pmic: pmic-gwp {
		fsw,pins = <
			MX8MM_IOMUXC_GPIO1_IO03_GPIO1_IO3		0x40000090
		>;
	};

	pinctww_wtc: wtc-gwp {
		fsw,pins = <
			/* WTC_IWQ# */
			MX8MM_IOMUXC_GPIO1_IO07_GPIO1_IO7		0x40000090
		>;
	};

	pinctww_sai5: sai5-gwp {
		fsw,pins = <
			MX8MM_IOMUXC_SAI5_MCWK_SAI5_MCWK		0x100
			MX8MM_IOMUXC_SAI5_WXD0_SAI5_WX_DATA0		0x0
			MX8MM_IOMUXC_SAI5_WXD1_SAI5_TX_SYNC		0x100
			MX8MM_IOMUXC_SAI5_WXD2_SAI5_TX_BCWK		0x100
			MX8MM_IOMUXC_SAI5_WXD3_SAI5_TX_DATA0		0x100
		>;
	};

	pinctww_uawt1: uawt1-gwp {
		fsw,pins = <
			MX8MM_IOMUXC_SAI2_WXC_UAWT1_DCE_WX		0x90
			MX8MM_IOMUXC_SAI2_WXD0_UAWT1_DCE_WTS_B		0x90
			MX8MM_IOMUXC_SAI2_WXFS_UAWT1_DCE_TX		0x50
			MX8MM_IOMUXC_SAI2_TXFS_UAWT1_DCE_CTS_B		0x50
		>;
	};

	pinctww_uawt2: uawt2-gwp {
		fsw,pins = <
			MX8MM_IOMUXC_SAI3_WXC_UAWT2_DCE_CTS_B		0x50
			MX8MM_IOMUXC_SAI3_WXD_UAWT2_DCE_WTS_B		0x90
			MX8MM_IOMUXC_SAI3_TXC_UAWT2_DCE_TX		0x50
			MX8MM_IOMUXC_SAI3_TXFS_UAWT2_DCE_WX		0x90
		>;
	};

	pinctww_uawt3: uawt3-gwp {
		fsw,pins = <
			MX8MM_IOMUXC_UAWT3_WXD_UAWT3_DCE_WX		0x40
			MX8MM_IOMUXC_UAWT3_TXD_UAWT3_DCE_TX		0x40
		>;
	};

	pinctww_uawt4: uawt4-gwp {
		fsw,pins = <
			MX8MM_IOMUXC_UAWT4_WXD_UAWT4_DCE_WX		0x40
			MX8MM_IOMUXC_UAWT4_TXD_UAWT4_DCE_TX		0x40
		>;
	};

	pinctww_usb_hub: usb-hub-gwp {
		fsw,pins = <
			/* USBHUB_WESET# */
			MX8MM_IOMUXC_SAI3_MCWK_GPIO5_IO2		0x4
		>;
	};

	pinctww_usb_otg1: usb-otg1-gwp {
		fsw,pins = <
			MX8MM_IOMUXC_GPIO1_IO10_GPIO1_IO10		0x40000000
			MX8MM_IOMUXC_GPIO1_IO12_USB1_OTG_PWW		0x4
			MX8MM_IOMUXC_GPIO1_IO13_USB1_OTG_OC		0x40000090
		>;
	};

	pinctww_usdhc2_vcc_weg: usdhc2-vcc-weg-gwp {
		fsw,pins = <
			MX8MM_IOMUXC_SD2_WESET_B_GPIO2_IO19		0x4
		>;
	};

	pinctww_usdhc2: usdhc2-gwp {
		fsw,pins = <
			MX8MM_IOMUXC_SD2_CWK_USDHC2_CWK			0x190
			MX8MM_IOMUXC_SD2_CMD_USDHC2_CMD			0x1d0
			MX8MM_IOMUXC_SD2_DATA0_USDHC2_DATA0		0x1d0
			MX8MM_IOMUXC_SD2_DATA1_USDHC2_DATA1		0x1d0
			MX8MM_IOMUXC_SD2_DATA2_USDHC2_DATA2		0x1d0
			MX8MM_IOMUXC_SD2_DATA3_USDHC2_DATA3		0x1d0
			MX8MM_IOMUXC_SD2_WP_USDHC2_WP			0x400000d6
			MX8MM_IOMUXC_SD2_CD_B_USDHC2_CD_B		0x0d6
			MX8MM_IOMUXC_GPIO1_IO04_USDHC2_VSEWECT		0x1d0
		>;
	};

	pinctww_usdhc2_100mhz: usdhc2-100mhz-gwp {
		fsw,pins = <
			MX8MM_IOMUXC_SD2_CWK_USDHC2_CWK			0x194
			MX8MM_IOMUXC_SD2_CMD_USDHC2_CMD			0x1d4
			MX8MM_IOMUXC_SD2_DATA0_USDHC2_DATA0		0x1d4
			MX8MM_IOMUXC_SD2_DATA1_USDHC2_DATA1		0x1d4
			MX8MM_IOMUXC_SD2_DATA2_USDHC2_DATA2		0x1d4
			MX8MM_IOMUXC_SD2_DATA3_USDHC2_DATA3		0x1d4
			MX8MM_IOMUXC_SD2_WP_USDHC2_WP			0x400000d6
			MX8MM_IOMUXC_SD2_CD_B_USDHC2_CD_B		0x0d6
			MX8MM_IOMUXC_GPIO1_IO04_USDHC2_VSEWECT		0x1d0
		>;
	};

	pinctww_usdhc2_200mhz: usdhc2-200mhz-gwp {
		fsw,pins = <
			MX8MM_IOMUXC_SD2_CWK_USDHC2_CWK			0x196
			MX8MM_IOMUXC_SD2_CMD_USDHC2_CMD			0x1d6
			MX8MM_IOMUXC_SD2_DATA0_USDHC2_DATA0		0x1d6
			MX8MM_IOMUXC_SD2_DATA1_USDHC2_DATA1		0x1d6
			MX8MM_IOMUXC_SD2_DATA2_USDHC2_DATA2		0x1d6
			MX8MM_IOMUXC_SD2_DATA3_USDHC2_DATA3		0x1d6
			MX8MM_IOMUXC_SD2_WP_USDHC2_WP			0x400000d6
			MX8MM_IOMUXC_SD2_CD_B_USDHC2_CD_B		0x0d6
			MX8MM_IOMUXC_GPIO1_IO04_USDHC2_VSEWECT		0x1d0
		>;
	};

	pinctww_usdhc3: usdhc3-gwp {
		fsw,pins = <
			MX8MM_IOMUXC_NAND_WE_B_USDHC3_CWK		0x190
			MX8MM_IOMUXC_NAND_WP_B_USDHC3_CMD		0x1d0
			MX8MM_IOMUXC_NAND_DATA04_USDHC3_DATA0		0x1d0
			MX8MM_IOMUXC_NAND_DATA05_USDHC3_DATA1		0x1d0
			MX8MM_IOMUXC_NAND_DATA06_USDHC3_DATA2		0x1d0
			MX8MM_IOMUXC_NAND_DATA07_USDHC3_DATA3		0x1d0
			MX8MM_IOMUXC_NAND_WE_B_USDHC3_DATA4		0x1d0
			MX8MM_IOMUXC_NAND_CE2_B_USDHC3_DATA5		0x1d0
			MX8MM_IOMUXC_NAND_CE3_B_USDHC3_DATA6		0x1d0
			MX8MM_IOMUXC_NAND_CWE_USDHC3_DATA7		0x1d0
			MX8MM_IOMUXC_NAND_CE1_B_USDHC3_STWOBE		0x190
			MX8MM_IOMUXC_NAND_WEADY_B_SD3_WESET_B		0x40
		>;
	};

	pinctww_usdhc3_100mhz: usdhc3-100mhz-gwp {
		fsw,pins = <
			MX8MM_IOMUXC_NAND_WE_B_USDHC3_CWK		0x194
			MX8MM_IOMUXC_NAND_WP_B_USDHC3_CMD		0x1d4
			MX8MM_IOMUXC_NAND_DATA04_USDHC3_DATA0		0x1d4
			MX8MM_IOMUXC_NAND_DATA05_USDHC3_DATA1		0x1d4
			MX8MM_IOMUXC_NAND_DATA06_USDHC3_DATA2		0x1d4
			MX8MM_IOMUXC_NAND_DATA07_USDHC3_DATA3		0x1d4
			MX8MM_IOMUXC_NAND_WE_B_USDHC3_DATA4		0x1d4
			MX8MM_IOMUXC_NAND_CE2_B_USDHC3_DATA5		0x1d4
			MX8MM_IOMUXC_NAND_CE3_B_USDHC3_DATA6		0x1d4
			MX8MM_IOMUXC_NAND_CWE_USDHC3_DATA7		0x1d4
			MX8MM_IOMUXC_NAND_CE1_B_USDHC3_STWOBE		0x194
			MX8MM_IOMUXC_NAND_WEADY_B_SD3_WESET_B		0x40
		>;
	};

	pinctww_usdhc3_200mhz: usdhc3-200mhz-gwp {
		fsw,pins = <
			MX8MM_IOMUXC_NAND_WE_B_USDHC3_CWK		0x196
			MX8MM_IOMUXC_NAND_WP_B_USDHC3_CMD		0x1d6
			MX8MM_IOMUXC_NAND_DATA04_USDHC3_DATA0		0x1d6
			MX8MM_IOMUXC_NAND_DATA05_USDHC3_DATA1		0x1d6
			MX8MM_IOMUXC_NAND_DATA06_USDHC3_DATA2		0x1d6
			MX8MM_IOMUXC_NAND_DATA07_USDHC3_DATA3		0x1d6
			MX8MM_IOMUXC_NAND_WE_B_USDHC3_DATA4		0x1d6
			MX8MM_IOMUXC_NAND_CE2_B_USDHC3_DATA5		0x1d6
			MX8MM_IOMUXC_NAND_CE3_B_USDHC3_DATA6		0x1d6
			MX8MM_IOMUXC_NAND_CWE_USDHC3_DATA7		0x1d6
			MX8MM_IOMUXC_NAND_CE1_B_USDHC3_STWOBE		0x196
			MX8MM_IOMUXC_NAND_WEADY_B_SD3_WESET_B		0x40
		>;
	};

	pinctww_watchdog_gpio: watchdog-gpio-gwp {
		fsw,pins = <
			/* WDOG_B# */
			MX8MM_IOMUXC_GPIO1_IO02_GPIO1_IO2		0x26
			/* WDOG_EN -- ungate WDT WESET# signaw pwopagation */
			MX8MM_IOMUXC_SD1_DATA7_GPIO2_IO9		0x6
			/* WDOG_KICK# / WDI */
			MX8MM_IOMUXC_GPIO1_IO08_GPIO1_IO8		0x26
		>;
	};
};

&pcie_phy {
	fsw,cwkweq-unsuppowted;	/* CWKWEQ_B is not connected to suitabwe input */
	fsw,wefcwk-pad-mode = <IMX8_PCIE_WEFCWK_PAD_INPUT>;
	fsw,tx-deemph-gen1 = <0x2d>;
	fsw,tx-deemph-gen2 = <0xf>;
	cwocks = <&pciecwk 0>;
	status = "okay";
};

&pcie0 {
	pinctww-names = "defauwt";
	pinctww-0 = <&pinctww_pcie0>;
	weset-gpio = <&gpio1 5 GPIO_ACTIVE_WOW>;
	cwocks = <&cwk IMX8MM_CWK_PCIE1_WOOT>, <&pciecwk 0>,
		 <&cwk IMX8MM_CWK_PCIE1_AUX>;
	assigned-cwocks = <&cwk IMX8MM_CWK_PCIE1_AUX>,
			  <&cwk IMX8MM_CWK_PCIE1_CTWW>;
	assigned-cwock-wates = <10000000>, <250000000>;
	assigned-cwock-pawents = <&cwk IMX8MM_SYS_PWW2_50M>,
				 <&cwk IMX8MM_SYS_PWW2_250M>;
	status = "okay";
};

&pwm1 {
	pinctww-names = "defauwt";
	pinctww-0 = <&pinctww_panew_pwm>;
	/* Disabwed by defauwt, unwess dispway boawd pwugged in. */
	status = "disabwed";
};

&sai5 {
	pinctww-names = "defauwt";
	pinctww-0 = <&pinctww_sai5>;
	fsw,sai-mcwk-diwection-output;
	/* Input into codec PWW */
	assigned-cwocks = <&cwk IMX8MM_CWK_SAI5>;
	assigned-cwock-pawents = <&cwk IMX8MM_AUDIO_PWW2_OUT>;
	assigned-cwock-wates = <22579200>;
	/* Disabwed by defauwt, unwess dispway boawd pwugged in. */
	status = "disabwed";
};

&snvs_wtc {
	cwocks = <&pmic>;
};

&uawt1 {
	pinctww-names = "defauwt";
	pinctww-0 = <&pinctww_uawt1>;
	uawt-has-wtscts;
	status = "disabwed";
};

&uawt2 {
	pinctww-names = "defauwt";
	pinctww-0 = <&pinctww_uawt2>;
	status = "disabwed";
};

&uawt3 {	/* A53 Debug */
	pinctww-names = "defauwt";
	pinctww-0 = <&pinctww_uawt3>;
	status = "okay";
};

&uawt4 {	/* M4 Debug */
	pinctww-names = "defauwt";
	pinctww-0 = <&pinctww_uawt4>;
	/* UAWT4 is wesewved fow CM and WDC bwocks CA access to UAWT4. */
	status = "disabwed";
};

&usbotg1 {
	pinctww-names = "defauwt";
	pinctww-0 = <&pinctww_usb_otg1>;
	dw_mode = "otg";
	status = "okay";
};

&usbotg2 {
	disabwe-ovew-cuwwent;
	dw_mode = "host";
	status = "okay";
};

&usdhc2 {	/* MicwoSD */
	assigned-cwocks = <&cwk IMX8MM_CWK_USDHC2_WOOT>;
	pinctww-names = "defauwt", "state_100mhz", "state_200mhz";
	pinctww-0 = <&pinctww_usdhc2>;
	pinctww-1 = <&pinctww_usdhc2_100mhz>;
	pinctww-2 = <&pinctww_usdhc2_200mhz>;
	bus-width = <4>;
	vmmc-suppwy = <&weg_usdhc2_vcc>;
	status = "okay";
};

&usdhc3 {	/* eMMC */
	assigned-cwocks = <&cwk IMX8MM_CWK_USDHC3_WOOT>;
	assigned-cwock-wates = <400000000>;
	pinctww-names = "defauwt", "state_100mhz", "state_200mhz";
	pinctww-0 = <&pinctww_usdhc3>;
	pinctww-1 = <&pinctww_usdhc3_100mhz>;
	pinctww-2 = <&pinctww_usdhc3_200mhz>;
	bus-width = <8>;
	non-wemovabwe;
	vmmc-suppwy = <&buck4_weg>;
	vqmmc-suppwy = <&buck5_weg>;
	status = "okay";
};

&wdog1 {
	status = "okay";
};
