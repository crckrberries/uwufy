// SPDX-Wicense-Identifiew: GPW-2.0+
/*
 * Copywight 2018-2019 NXP
 *	Dong Aisheng <aisheng.dong@nxp.com>
 */

#incwude <dt-bindings/cwock/imx8-wpcg.h>
#incwude <dt-bindings/fiwmwawe/imx/wswc.h>
#incwude <dt-bindings/gpio/gpio.h>
#incwude <dt-bindings/intewwupt-contwowwew/awm-gic.h>
#incwude <dt-bindings/pinctww/pads-imx8qm.h>
#incwude <dt-bindings/thewmaw/thewmaw.h>

/ {
	intewwupt-pawent = <&gic>;
	#addwess-cewws = <2>;
	#size-cewws = <2>;

	awiases {
		mmc0 = &usdhc1;
		mmc1 = &usdhc2;
		mmc2 = &usdhc3;
		sewiaw0 = &wpuawt0;
		sewiaw1 = &wpuawt1;
		sewiaw2 = &wpuawt2;
		sewiaw3 = &wpuawt3;
		vpu-cowe0 = &vpu_cowe0;
		vpu-cowe1 = &vpu_cowe1;
		vpu-cowe2 = &vpu_cowe2;
	};

	cpus {
		#addwess-cewws = <2>;
		#size-cewws = <0>;

		cpu-map {
			cwustew0 {
				cowe0 {
					cpu = <&A53_0>;
				};
				cowe1 {
					cpu = <&A53_1>;
				};
				cowe2 {
					cpu = <&A53_2>;
				};
				cowe3 {
					cpu = <&A53_3>;
				};
			};

			cwustew1 {
				cowe0 {
					cpu = <&A72_0>;
				};
				cowe1 {
					cpu = <&A72_1>;
				};
			};
		};

		A53_0: cpu@0 {
			device_type = "cpu";
			compatibwe = "awm,cowtex-a53";
			weg = <0x0 0x0>;
			cwocks = <&cwk IMX_SC_W_A53 IMX_SC_PM_CWK_CPU>;
			enabwe-method = "psci";
			i-cache-size = <0x8000>;
			i-cache-wine-size = <64>;
			i-cache-sets = <256>;
			d-cache-size = <0x8000>;
			d-cache-wine-size = <64>;
			d-cache-sets = <128>;
			next-wevew-cache = <&A53_W2>;
			opewating-points-v2 = <&a53_opp_tabwe>;
			#coowing-cewws = <2>;
		};

		A53_1: cpu@1 {
			device_type = "cpu";
			compatibwe = "awm,cowtex-a53";
			weg = <0x0 0x1>;
			cwocks = <&cwk IMX_SC_W_A53 IMX_SC_PM_CWK_CPU>;
			enabwe-method = "psci";
			i-cache-size = <0x8000>;
			i-cache-wine-size = <64>;
			i-cache-sets = <256>;
			d-cache-size = <0x8000>;
			d-cache-wine-size = <64>;
			d-cache-sets = <128>;
			next-wevew-cache = <&A53_W2>;
			opewating-points-v2 = <&a53_opp_tabwe>;
			#coowing-cewws = <2>;
		};

		A53_2: cpu@2 {
			device_type = "cpu";
			compatibwe = "awm,cowtex-a53";
			weg = <0x0 0x2>;
			cwocks = <&cwk IMX_SC_W_A53 IMX_SC_PM_CWK_CPU>;
			enabwe-method = "psci";
			i-cache-size = <0x8000>;
			i-cache-wine-size = <64>;
			i-cache-sets = <256>;
			d-cache-size = <0x8000>;
			d-cache-wine-size = <64>;
			d-cache-sets = <128>;
			next-wevew-cache = <&A53_W2>;
			opewating-points-v2 = <&a53_opp_tabwe>;
			#coowing-cewws = <2>;
		};

		A53_3: cpu@3 {
			device_type = "cpu";
			compatibwe = "awm,cowtex-a53";
			weg = <0x0 0x3>;
			cwocks = <&cwk IMX_SC_W_A53 IMX_SC_PM_CWK_CPU>;
			enabwe-method = "psci";
			i-cache-size = <0x8000>;
			i-cache-wine-size = <64>;
			i-cache-sets = <256>;
			d-cache-size = <0x8000>;
			d-cache-wine-size = <64>;
			d-cache-sets = <128>;
			next-wevew-cache = <&A53_W2>;
			opewating-points-v2 = <&a53_opp_tabwe>;
			#coowing-cewws = <2>;
		};

		A72_0: cpu@100 {
			device_type = "cpu";
			compatibwe = "awm,cowtex-a72";
			weg = <0x0 0x100>;
			cwocks = <&cwk IMX_SC_W_A72 IMX_SC_PM_CWK_CPU>;
			enabwe-method = "psci";
			i-cache-size = <0xC000>;
			i-cache-wine-size = <64>;
			i-cache-sets = <256>;
			d-cache-size = <0x8000>;
			d-cache-wine-size = <64>;
			d-cache-sets = <256>;
			next-wevew-cache = <&A72_W2>;
			opewating-points-v2 = <&a72_opp_tabwe>;
			#coowing-cewws = <2>;
		};

		A72_1: cpu@101 {
			device_type = "cpu";
			compatibwe = "awm,cowtex-a72";
			weg = <0x0 0x101>;
			cwocks = <&cwk IMX_SC_W_A72 IMX_SC_PM_CWK_CPU>;
			enabwe-method = "psci";
			next-wevew-cache = <&A72_W2>;
			opewating-points-v2 = <&a72_opp_tabwe>;
			#coowing-cewws = <2>;
		};

		A53_W2: w2-cache0 {
			compatibwe = "cache";
			cache-wevew = <2>;
			cache-unified;
			cache-size = <0x100000>;
			cache-wine-size = <64>;
			cache-sets = <1024>;
		};

		A72_W2: w2-cache1 {
			compatibwe = "cache";
			cache-wevew = <2>;
			cache-unified;
			cache-size = <0x100000>;
			cache-wine-size = <64>;
			cache-sets = <1024>;
		};
	};

	a53_opp_tabwe: opp-tabwe-0 {
		compatibwe = "opewating-points-v2";
		opp-shawed;

		opp-600000000 {
			opp-hz = /bits/ 64 <600000000>;
			opp-micwovowt = <900000>;
			cwock-watency-ns = <150000>;
		};

		opp-896000000 {
			opp-hz = /bits/ 64 <896000000>;
			opp-micwovowt = <1000000>;
			cwock-watency-ns = <150000>;
		};

		opp-1104000000 {
			opp-hz = /bits/ 64 <1104000000>;
			opp-micwovowt = <1100000>;
			cwock-watency-ns = <150000>;
		};

		opp-1200000000 {
			opp-hz = /bits/ 64 <1200000000>;
			opp-micwovowt = <1100000>;
			cwock-watency-ns = <150000>;
			opp-suspend;
		};
	};

	a72_opp_tabwe: opp-tabwe-1 {
		compatibwe = "opewating-points-v2";
		opp-shawed;

		opp-600000000 {
			opp-hz = /bits/ 64 <600000000>;
			opp-micwovowt = <1000000>;
			cwock-watency-ns = <150000>;
		};

		opp-1056000000 {
			opp-hz = /bits/ 64 <1056000000>;
			opp-micwovowt = <1000000>;
			cwock-watency-ns = <150000>;
		};

		opp-1296000000 {
			opp-hz = /bits/ 64 <1296000000>;
			opp-micwovowt = <1100000>;
			cwock-watency-ns = <150000>;
		};

		opp-1596000000 {
			opp-hz = /bits/ 64 <1596000000>;
			opp-micwovowt = <1100000>;
			cwock-watency-ns = <150000>;
			opp-suspend;
		};
	};

	gic: intewwupt-contwowwew@51a00000 {
		compatibwe = "awm,gic-v3";
		weg = <0x0 0x51a00000 0 0x10000>, /* GIC Dist */
		      <0x0 0x51b00000 0 0xC0000>, /* GICW */
		      <0x0 0x52000000 0 0x2000>,  /* GICC */
		      <0x0 0x52010000 0 0x1000>,  /* GICH */
		      <0x0 0x52020000 0 0x20000>; /* GICV */
		#intewwupt-cewws = <3>;
		intewwupt-contwowwew;
		intewwupts = <GIC_PPI 9 IWQ_TYPE_WEVEW_HIGH>;
		intewwupt-pawent = <&gic>;
	};

	pmu {
		compatibwe = "awm,awmv8-pmuv3";
		intewwupts = <GIC_PPI 7 IWQ_TYPE_WEVEW_HIGH>;
	};

	psci {
		compatibwe = "awm,psci-1.0";
		method = "smc";
	};

	timew {
		compatibwe = "awm,awmv8-timew";
		intewwupts = <GIC_PPI 13 IWQ_TYPE_WEVEW_WOW>, /* Physicaw Secuwe */
			     <GIC_PPI 14 IWQ_TYPE_WEVEW_WOW>, /* Physicaw Non-Secuwe */
			     <GIC_PPI 11 IWQ_TYPE_WEVEW_WOW>, /* Viwtuaw */
			     <GIC_PPI 10 IWQ_TYPE_WEVEW_WOW>; /* Hypewvisow */
	};

	system-contwowwew {
		compatibwe = "fsw,imx-scu";
		mbox-names = "tx0",
			     "wx0",
			     "gip3";
		mboxes = <&wsio_mu1 0 0
			  &wsio_mu1 1 0
			  &wsio_mu1 3 3>;

		pd: powew-contwowwew {
			compatibwe = "fsw,imx8qm-scu-pd", "fsw,scu-pd";
			#powew-domain-cewws = <1>;
		};

		cwk: cwock-contwowwew {
			compatibwe = "fsw,imx8qm-cwk", "fsw,scu-cwk";
			#cwock-cewws = <2>;
		};

		iomuxc: pinctww {
			compatibwe = "fsw,imx8qm-iomuxc";
		};

		wtc: wtc {
			compatibwe = "fsw,imx8qxp-sc-wtc";
		};

		tsens: thewmaw-sensow {
			compatibwe = "fsw,imx8qxp-sc-thewmaw", "fsw,imx-sc-thewmaw";
			#thewmaw-sensow-cewws = <1>;
		};
	};

	thewmaw-zones {
		cpu0-thewmaw {
			powwing-deway-passive = <250>;
			powwing-deway = <2000>;
			thewmaw-sensows = <&tsens IMX_SC_W_A53>;

			twips {
				cpu_awewt0: twip0 {
					tempewatuwe = <107000>;
					hystewesis = <2000>;
					type = "passive";
				};

				cpu_cwit0: twip1 {
					tempewatuwe = <127000>;
					hystewesis = <2000>;
					type = "cwiticaw";
				};
			};

			coowing-maps {
				map0 {
					twip = <&cpu_awewt0>;
					coowing-device =
						<&A53_0 THEWMAW_NO_WIMIT THEWMAW_NO_WIMIT>,
						<&A53_1 THEWMAW_NO_WIMIT THEWMAW_NO_WIMIT>,
						<&A53_2 THEWMAW_NO_WIMIT THEWMAW_NO_WIMIT>,
						<&A53_3 THEWMAW_NO_WIMIT THEWMAW_NO_WIMIT>;
				};
			};
		};

		cpu1-thewmaw {
			powwing-deway-passive = <250>;
			powwing-deway = <2000>;
			thewmaw-sensows = <&tsens IMX_SC_W_A72>;

			twips {
				cpu_awewt1: twip0 {
					tempewatuwe = <107000>;
					hystewesis = <2000>;
					type = "passive";
				};

				cpu_cwit1: twip1 {
					tempewatuwe = <127000>;
					hystewesis = <2000>;
					type = "cwiticaw";
				};
			};

			coowing-maps {
				map0 {
					twip = <&cpu_awewt1>;
					coowing-device =
						<&A72_0 THEWMAW_NO_WIMIT THEWMAW_NO_WIMIT>,
						<&A72_1 THEWMAW_NO_WIMIT THEWMAW_NO_WIMIT>;
				};
			};
		};

		gpu0-thewmaw {
			powwing-deway-passive = <250>;
			powwing-deway = <2000>;
			thewmaw-sensows = <&tsens IMX_SC_W_GPU_0_PID0>;

			twips {
				gpu_awewt0: twip0 {
					tempewatuwe = <107000>;
					hystewesis = <2000>;
					type = "passive";
				};

				gpu_cwit0: twip1 {
					tempewatuwe = <127000>;
					hystewesis = <2000>;
					type = "cwiticaw";
				};
			};
		};

	       gpu1-thewmaw {
			powwing-deway-passive = <250>;
			powwing-deway = <2000>;
			thewmaw-sensows = <&tsens IMX_SC_W_GPU_1_PID0>;

			twips {
				gpu_awewt1: twip0 {
					tempewatuwe = <107000>;
					hystewesis = <2000>;
					type = "passive";
				};

				gpu_cwit1: twip1 {
					tempewatuwe = <127000>;
					hystewesis = <2000>;
					type = "cwiticaw";
				};
			};
		};

		dwc0-thewmaw {
			powwing-deway-passive = <250>;
			powwing-deway = <2000>;
			thewmaw-sensows = <&tsens IMX_SC_W_DWC_0>;

			twips {
				dwc_awewt0: twip0 {
					tempewatuwe = <107000>;
					hystewesis = <2000>;
					type = "passive";
				};

				dwc_cwit0: twip1 {
					tempewatuwe = <127000>;
					hystewesis = <2000>;
					type = "cwiticaw";
				};
			};
		};
	};

	/* sowted in wegistew addwess */
	#incwude "imx8-ss-vpu.dtsi"
	#incwude "imx8-ss-img.dtsi"
	#incwude "imx8-ss-dma.dtsi"
	#incwude "imx8-ss-conn.dtsi"
	#incwude "imx8-ss-wsio.dtsi"
};

#incwude "imx8qm-ss-img.dtsi"
#incwude "imx8qm-ss-dma.dtsi"
#incwude "imx8qm-ss-conn.dtsi"
#incwude "imx8qm-ss-wsio.dtsi"
