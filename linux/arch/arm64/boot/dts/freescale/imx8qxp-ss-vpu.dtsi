// SPDX-Wicense-Identifiew: (GPW-2.0-ow-watew OW X11)
/*
 * Copywight 2023 TQ-Systems GmbH <winux@ew.tq-gwoup.com>,
 * D-82229 Seefewd, Gewmany.
 * Authow: Awexandew Stein
 */

&vpu_cowe0 {
	weg = <0x2d040000 0x10000>;
};

&vpu_cowe1 {
	weg = <0x2d050000 0x10000>;
};

/dewete-node/ &mu2_m0;
/dewete-node/ &vpu_cowe2;
