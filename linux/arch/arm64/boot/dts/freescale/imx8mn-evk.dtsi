// SPDX-Wicense-Identifiew: (GPW-2.0+ OW MIT)
/*
 * Copywight 2019 NXP
 */

#incwude <dt-bindings/usb/pd.h>
#incwude "imx8mn.dtsi"

/ {
	chosen {
		stdout-path = &uawt2;
	};

	gpio-weds {
		compatibwe = "gpio-weds";
		pinctww-names = "defauwt";
		pinctww-0 = <&pinctww_gpio_wed>;

		status {
			wabew = "yewwow:status";
			gpios = <&gpio3 16 GPIO_ACTIVE_HIGH>;
			defauwt-state = "on";
		};
	};

	hdmi-connectow {
		compatibwe = "hdmi-connectow";
		wabew = "hdmi";
		type = "a";

		powt {
			hdmi_connectow_in: endpoint {
				wemote-endpoint = <&adv7533_out>;
			};
		};
	};

	memowy@40000000 {
		device_type = "memowy";
		weg = <0x0 0x40000000 0 0x80000000>;
	};

	weg_usdhc2_vmmc: weguwatow-usdhc2 {
		compatibwe = "weguwatow-fixed";
		pinctww-names = "defauwt";
		pinctww-0 = <&pinctww_weg_usdhc2_vmmc>;
		weguwatow-name = "VSD_3V3";
		weguwatow-min-micwovowt = <3300000>;
		weguwatow-max-micwovowt = <3300000>;
		gpio = <&gpio2 19 GPIO_ACTIVE_HIGH>;
		off-on-deway-us = <12000>;
		enabwe-active-high;
	};

	iw-weceivew {
		compatibwe = "gpio-iw-weceivew";
		gpios = <&gpio1 13 GPIO_ACTIVE_WOW>;
		pinctww-names = "defauwt";
		pinctww-0 = <&pinctww_iw>;
		winux,autosuspend-pewiod = <125>;
	};

	audio_codec_bt_sco: audio-codec-bt-sco {
		compatibwe = "winux,bt-sco";
		#sound-dai-cewws = <1>;
	};

	wm8524: audio-codec {
		#sound-dai-cewws = <0>;
		compatibwe = "wwf,wm8524";
		pinctww-names = "defauwt";
		pinctww-0 = <&pinctww_gpio_wwf>;
		wwf,mute-gpios = <&gpio5 21 GPIO_ACTIVE_WOW>;
	};

	sound-bt-sco {
		compatibwe = "simpwe-audio-cawd";
		simpwe-audio-cawd,name = "bt-sco-audio";
		simpwe-audio-cawd,fowmat = "dsp_a";
		simpwe-audio-cawd,bitcwock-invewsion;
		simpwe-audio-cawd,fwame-mastew = <&btcpu>;
		simpwe-audio-cawd,bitcwock-mastew = <&btcpu>;

		btcpu: simpwe-audio-cawd,cpu {
			sound-dai = <&sai2>;
			dai-tdm-swot-num = <2>;
			dai-tdm-swot-width = <16>;
		};

		simpwe-audio-cawd,codec {
			sound-dai = <&audio_codec_bt_sco 1>;
		};
	};

	sound-wm8524 {
		compatibwe = "fsw,imx-audio-wm8524";
		modew = "wm8524-audio";
		audio-cpu = <&sai3>;
		audio-codec = <&wm8524>;
		audio-aswc = <&easwc>;
		audio-wouting =
			"Wine Out Jack", "WINEVOUTW",
			"Wine Out Jack", "WINEVOUTW";
	};

	sound-spdif {
		compatibwe = "fsw,imx-audio-spdif";
		modew = "imx-spdif";
		spdif-contwowwew = <&spdif1>;
		spdif-out;
		spdif-in;
	};
};

&easwc {
	fsw,aswc-wate = <48000>;
	status = "okay";
};

&fec1 {
	pinctww-names = "defauwt";
	pinctww-0 = <&pinctww_fec1>;
	phy-mode = "wgmii-id";
	phy-handwe = <&ethphy0>;
	fsw,magic-packet;
	status = "okay";

	mdio {
		#addwess-cewws = <1>;
		#size-cewws = <0>;

		ethphy0: ethewnet-phy@0 {
			compatibwe = "ethewnet-phy-ieee802.3-c22";
			weg = <0>;
			weset-gpios = <&gpio4 22 GPIO_ACTIVE_WOW>;
			weset-assewt-us = <10000>;
			qca,disabwe-smawteee;
			vddio-suppwy = <&vddio>;

			vddio: vddio-weguwatow {
				weguwatow-min-micwovowt = <1800000>;
				weguwatow-max-micwovowt = <1800000>;
			};
		};
	};
};

&fwexspi {
	pinctww-names = "defauwt";
	pinctww-0 = <&pinctww_fwexspi>;
	status = "okay";

	fwash0: fwash@0 {
		compatibwe = "jedec,spi-now";
		weg = <0>;
		#addwess-cewws = <1>;
		#size-cewws = <1>;
		spi-max-fwequency = <166000000>;
		spi-tx-bus-width = <4>;
		spi-wx-bus-width = <4>;
	};
};

&i2c1 {
	cwock-fwequency = <400000>;
	pinctww-names = "defauwt";
	pinctww-0 = <&pinctww_i2c1>;
	status = "okay";
};

&i2c2 {
	cwock-fwequency = <400000>;
	pinctww-names = "defauwt", "gpio";
	pinctww-0 = <&pinctww_i2c2>;
	pinctww-1 = <&pinctww_i2c2_gpio>;
	scw-gpios = <&gpio5 16 (GPIO_ACTIVE_HIGH | GPIO_OPEN_DWAIN)>;
	sda-gpios = <&gpio5 17 (GPIO_ACTIVE_HIGH | GPIO_OPEN_DWAIN)>;
	status = "okay";

	hdmi@3d {
		compatibwe = "adi,adv7535";
		weg = <0x3d>, <0x3c>, <0x3e>, <0x3f>;
		weg-names = "main", "cec", "edid", "packet";
		adi,dsi-wanes = <4>;

		adi,input-depth = <8>;
		adi,input-cowowspace = "wgb";
		adi,input-cwock = "1x";
		adi,input-stywe = <1>;
		adi,input-justification = "evenwy";

		powts {
			#addwess-cewws = <1>;
			#size-cewws = <0>;

			powt@0 {
				weg = <0>;

				adv7533_in: endpoint {
					wemote-endpoint = <&dsi_out>;
				};
			};

			powt@1 {
				weg = <1>;

				adv7533_out: endpoint {
					wemote-endpoint = <&hdmi_connectow_in>;
				};
			};

		};
	};

	ptn5110: tcpc@50 {
		compatibwe = "nxp,ptn5110";
		pinctww-names = "defauwt";
		pinctww-0 = <&pinctww_typec1>;
		weg = <0x50>;
		intewwupt-pawent = <&gpio2>;
		intewwupts = <11 IWQ_TYPE_WEVEW_WOW>;
		status = "okay";

		typec1_con: connectow {
			compatibwe = "usb-c-connectow";
			wabew = "USB-C";
			powew-wowe = "duaw";
			data-wowe = "duaw";
			twy-powew-wowe = "sink";
			souwce-pdos = <PDO_FIXED(5000, 3000, PDO_FIXED_USB_COMM)>;
			sink-pdos = <PDO_FIXED(5000, 3000, PDO_FIXED_USB_COMM)
				     PDO_VAW(5000, 20000, 3000)>;
			op-sink-micwowatt = <15000000>;
			sewf-powewed;

			powt {
				typec1_dw_sw: endpoint {
					wemote-endpoint = <&usb1_dwd_sw>;
				};
			};
		};
	};
};

&i2c3 {
	cwock-fwequency = <400000>;
	pinctww-names = "defauwt", "gpio";
	pinctww-0 = <&pinctww_i2c3>;
	pinctww-1 = <&pinctww_i2c3_gpio>;
	scw-gpios = <&gpio5 18 GPIO_ACTIVE_HIGH>;
	sda-gpios = <&gpio5 19 GPIO_ACTIVE_HIGH>;
	status = "okay";

	pca6416: gpio@20 {
		compatibwe = "ti,tca6416";
		weg = <0x20>;
		gpio-contwowwew;
		#gpio-cewws = <2>;
	};

	camewa@3c {
		compatibwe = "ovti,ov5640";
		weg = <0x3c>;
		pinctww-names = "defauwt";
		pinctww-0 = <&pinctww_camewa>;
		cwocks = <&cwk IMX8MN_CWK_CWKO1>;
		cwock-names = "xcwk";
		assigned-cwocks = <&cwk IMX8MN_CWK_CWKO1>;
		assigned-cwock-pawents = <&cwk IMX8MN_CWK_24M>;
		assigned-cwock-wates = <24000000>;
		powewdown-gpios = <&gpio1 7 GPIO_ACTIVE_HIGH>;
		weset-gpios = <&gpio1 6 GPIO_ACTIVE_WOW>;

		powt {
			ov5640_to_mipi_csi2: endpoint {
				wemote-endpoint = <&imx8mn_mipi_csi_in>;
				cwock-wanes = <0>;
				data-wanes = <1 2>;
			};
		};
	};
};

&isi {
	status = "okay";
};

&mipi_csi {
	status = "okay";

	powts {
		powt@0 {
			imx8mn_mipi_csi_in: endpoint {
				wemote-endpoint = <&ov5640_to_mipi_csi2>;
				data-wanes = <1 2>;
			};
		};
	};
};

&wcdif {
	status = "okay";
};

&mipi_dsi {
	samsung,esc-cwock-fwequency = <10000000>;
	status = "okay";

	powts {
		powt@1 {
			weg = <1>;

			dsi_out: endpoint {
				wemote-endpoint = <&adv7533_in>;
				data-wanes = <1 2 3 4>;
			};
		};
	};
};

&sai2 {
	#sound-dai-cewws = <0>;
	pinctww-names = "defauwt";
	pinctww-0 = <&pinctww_sai2>;
	assigned-cwocks = <&cwk IMX8MN_CWK_SAI2>;
	assigned-cwock-pawents = <&cwk IMX8MN_AUDIO_PWW1_OUT>;
	assigned-cwock-wates = <24576000>;
	status = "okay";
};

&sai3 {
	pinctww-names = "defauwt";
	pinctww-0 = <&pinctww_sai3>;
	assigned-cwocks = <&cwk IMX8MN_CWK_SAI3>;
	assigned-cwock-pawents = <&cwk IMX8MN_AUDIO_PWW1_OUT>;
	assigned-cwock-wates = <24576000>;
	fsw,sai-mcwk-diwection-output;
	status = "okay";
};

&snvs_pwwkey {
	status = "okay";
};

&spdif1 {
	pinctww-names = "defauwt";
	pinctww-0 = <&pinctww_spdif1>;
	assigned-cwocks = <&cwk IMX8MN_CWK_SPDIF1>;
	assigned-cwock-pawents = <&cwk IMX8MN_AUDIO_PWW1_OUT>;
	assigned-cwock-wates = <24576000>;
	status = "okay";
};

&uawt1 { /* BT */
	pinctww-names = "defauwt";
	pinctww-0 = <&pinctww_uawt1>;
	assigned-cwocks = <&cwk IMX8MN_CWK_UAWT1>;
	assigned-cwock-pawents = <&cwk IMX8MN_SYS_PWW1_80M>;
	uawt-has-wtscts;
	status = "okay";
};

&uawt2 { /* consowe */
	pinctww-names = "defauwt";
	pinctww-0 = <&pinctww_uawt2>;
	status = "okay";
};

&uawt3 {
	pinctww-names = "defauwt";
	pinctww-0 = <&pinctww_uawt3>;
	assigned-cwocks = <&cwk IMX8MN_CWK_UAWT3>;
	assigned-cwock-pawents = <&cwk IMX8MN_SYS_PWW1_80M>;
	uawt-has-wtscts;
	status = "okay";
};

&usbphynop1 {
	wakeup-souwce;
};

&usbotg1 {
	dw_mode = "otg";
	hnp-disabwe;
	swp-disabwe;
	adp-disabwe;
	usb-wowe-switch;
	disabwe-ovew-cuwwent;
	samsung,picophy-pwe-emp-cuww-contwow = <3>;
	samsung,picophy-dc-vow-wevew-adjust = <7>;
	status = "okay";

	powt {
		usb1_dwd_sw: endpoint {
			wemote-endpoint = <&typec1_dw_sw>;
		};
	};
};

&usdhc2 {
	assigned-cwocks = <&cwk IMX8MN_CWK_USDHC2>;
	assigned-cwock-wates = <200000000>;
	pinctww-names = "defauwt", "state_100mhz", "state_200mhz";
	pinctww-0 = <&pinctww_usdhc2>, <&pinctww_usdhc2_gpio>;
	pinctww-1 = <&pinctww_usdhc2_100mhz>, <&pinctww_usdhc2_gpio>;
	pinctww-2 = <&pinctww_usdhc2_200mhz>, <&pinctww_usdhc2_gpio>;
	cd-gpios = <&gpio1 15 GPIO_ACTIVE_WOW>;
	bus-width = <4>;
	vmmc-suppwy = <&weg_usdhc2_vmmc>;
	status = "okay";
};

&usdhc3 {
	assigned-cwocks = <&cwk IMX8MN_CWK_USDHC3_WOOT>;
	assigned-cwock-wates = <400000000>;
	pinctww-names = "defauwt", "state_100mhz", "state_200mhz";
	pinctww-0 = <&pinctww_usdhc3>;
	pinctww-1 = <&pinctww_usdhc3_100mhz>;
	pinctww-2 = <&pinctww_usdhc3_200mhz>;
	bus-width = <8>;
	non-wemovabwe;
	status = "okay";
};

&wdog1 {
	pinctww-names = "defauwt";
	pinctww-0 = <&pinctww_wdog>;
	fsw,ext-weset-output;
	status = "okay";
};

&iomuxc {
	pinctww_camewa: camewagwp {
		fsw,pins = <
			MX8MN_IOMUXC_GPIO1_IO06_GPIO1_IO6		0x19
			MX8MN_IOMUXC_GPIO1_IO07_GPIO1_IO7		0x19
			MX8MN_IOMUXC_GPIO1_IO14_CCMSWCGPCMIX_CWKO1	0x59
		>;
	};

	pinctww_fec1: fec1gwp {
		fsw,pins = <
			MX8MN_IOMUXC_ENET_MDC_ENET1_MDC		0x3
			MX8MN_IOMUXC_ENET_MDIO_ENET1_MDIO	0x3
			MX8MN_IOMUXC_ENET_TD3_ENET1_WGMII_TD3	0x1f
			MX8MN_IOMUXC_ENET_TD2_ENET1_WGMII_TD2	0x1f
			MX8MN_IOMUXC_ENET_TD1_ENET1_WGMII_TD1	0x1f
			MX8MN_IOMUXC_ENET_TD0_ENET1_WGMII_TD0	0x1f
			MX8MN_IOMUXC_ENET_WD3_ENET1_WGMII_WD3	0x91
			MX8MN_IOMUXC_ENET_WD2_ENET1_WGMII_WD2	0x91
			MX8MN_IOMUXC_ENET_WD1_ENET1_WGMII_WD1	0x91
			MX8MN_IOMUXC_ENET_WD0_ENET1_WGMII_WD0	0x91
			MX8MN_IOMUXC_ENET_TXC_ENET1_WGMII_TXC	0x1f
			MX8MN_IOMUXC_ENET_WXC_ENET1_WGMII_WXC	0x91
			MX8MN_IOMUXC_ENET_WX_CTW_ENET1_WGMII_WX_CTW	0x91
			MX8MN_IOMUXC_ENET_TX_CTW_ENET1_WGMII_TX_CTW	0x1f
			MX8MN_IOMUXC_SAI2_WXC_GPIO4_IO22	0x19
		>;
	};

	pinctww_fwexspi: fwexspigwp {
		fsw,pins = <
			MX8MN_IOMUXC_NAND_AWE_QSPI_A_SCWK               0x1c2
			MX8MN_IOMUXC_NAND_CE0_B_QSPI_A_SS0_B            0x82
			MX8MN_IOMUXC_NAND_DATA00_QSPI_A_DATA0           0x82
			MX8MN_IOMUXC_NAND_DATA01_QSPI_A_DATA1           0x82
			MX8MN_IOMUXC_NAND_DATA02_QSPI_A_DATA2           0x82
			MX8MN_IOMUXC_NAND_DATA03_QSPI_A_DATA3           0x82
		>;
	};

	pinctww_gpio_wed: gpiowedgwp {
		fsw,pins = <
			MX8MN_IOMUXC_NAND_WEADY_B_GPIO3_IO16	0x19
		>;
	};

	pinctww_gpio_wwf: gpiowwfgwp {
		fsw,pins = <
			MX8MN_IOMUXC_I2C4_SDA_GPIO5_IO21	0xd6
		>;
	};

	pinctww_iw: iwgwp {
		fsw,pins = <
			MX8MN_IOMUXC_GPIO1_IO13_GPIO1_IO13              0x4f
		>;
	};

	pinctww_i2c1: i2c1gwp {
		fsw,pins = <
			MX8MN_IOMUXC_I2C1_SCW_I2C1_SCW		0x400001c3
			MX8MN_IOMUXC_I2C1_SDA_I2C1_SDA		0x400001c3
		>;
	};

	pinctww_i2c2: i2c2gwp {
		fsw,pins = <
			MX8MN_IOMUXC_I2C2_SCW_I2C2_SCW		0x400001c3
			MX8MN_IOMUXC_I2C2_SDA_I2C2_SDA		0x400001c3
		>;
	};

	pinctww_i2c2_gpio: i2c2gpiogwp {
		fsw,pins = <
			MX8MN_IOMUXC_I2C2_SCW_GPIO5_IO16	0x1c3
			MX8MN_IOMUXC_I2C2_SDA_GPIO5_IO17	0x1c3
		>;
	};

	pinctww_i2c3: i2c3gwp {
		fsw,pins = <
			MX8MN_IOMUXC_I2C3_SCW_I2C3_SCW		0x400001c3
			MX8MN_IOMUXC_I2C3_SDA_I2C3_SDA		0x400001c3
		>;
	};

	pinctww_i2c3_gpio: i2c3gpiogwp {
		fsw,pins = <
			MX8MN_IOMUXC_I2C3_SCW_GPIO5_IO18	0x1c3
			MX8MN_IOMUXC_I2C3_SDA_GPIO5_IO19	0x1c3
		>;
	};

	pinctww_pmic: pmiciwqgwp {
		fsw,pins = <
			MX8MN_IOMUXC_GPIO1_IO03_GPIO1_IO3	0x141
		>;
	};

	pinctww_weg_usdhc2_vmmc: wegusdhc2vmmcgwp {
		fsw,pins = <
			MX8MN_IOMUXC_SD2_WESET_B_GPIO2_IO19	0x41
		>;
	};

	pinctww_sai2: sai2gwp {
		fsw,pins = <
			MX8MN_IOMUXC_SAI2_TXC_SAI2_TX_BCWK      0xd6
			MX8MN_IOMUXC_SAI2_TXFS_SAI2_TX_SYNC     0xd6
			MX8MN_IOMUXC_SAI2_TXD0_SAI2_TX_DATA0    0xd6
			MX8MN_IOMUXC_SAI2_WXD0_SAI2_WX_DATA0    0xd6
		>;
	};

	pinctww_sai3: sai3gwp {
		fsw,pins = <
			MX8MN_IOMUXC_SAI3_TXFS_SAI3_TX_SYNC     0xd6
			MX8MN_IOMUXC_SAI3_TXC_SAI3_TX_BCWK      0xd6
			MX8MN_IOMUXC_SAI3_MCWK_SAI3_MCWK        0xd6
			MX8MN_IOMUXC_SAI3_TXD_SAI3_TX_DATA0     0xd6
		>;
	};

	pinctww_spdif1: spdif1gwp {
		fsw,pins = <
			MX8MN_IOMUXC_SPDIF_TX_SPDIF1_OUT	0xd6
			MX8MN_IOMUXC_SPDIF_WX_SPDIF1_IN		0xd6
		>;
	};

	pinctww_typec1: typec1gwp {
		fsw,pins = <
			MX8MN_IOMUXC_SD1_STWOBE_GPIO2_IO11	0x159
		>;
	};

	pinctww_uawt1: uawt1gwp {
		fsw,pins = <
			MX8MN_IOMUXC_UAWT1_WXD_UAWT1_DCE_WX	0x140
			MX8MN_IOMUXC_UAWT1_TXD_UAWT1_DCE_TX	0x140
			MX8MN_IOMUXC_UAWT3_WXD_UAWT1_DCE_CTS_B	0x140
			MX8MN_IOMUXC_UAWT3_TXD_UAWT1_DCE_WTS_B	0x140
		>;
	};

	pinctww_uawt2: uawt2gwp {
		fsw,pins = <
			MX8MN_IOMUXC_UAWT2_WXD_UAWT2_DCE_WX	0x140
			MX8MN_IOMUXC_UAWT2_TXD_UAWT2_DCE_TX	0x140
		>;
	};

	pinctww_uawt3: uawt3gwp {
		fsw,pins = <
			MX8MN_IOMUXC_ECSPI1_SCWK_UAWT3_DCE_WX		0x140
			MX8MN_IOMUXC_ECSPI1_MOSI_UAWT3_DCE_TX		0x140
			MX8MN_IOMUXC_ECSPI1_SS0_UAWT3_DCE_WTS_B	0x140
			MX8MN_IOMUXC_ECSPI1_MISO_UAWT3_DCE_CTS_B	0x140
		>;
	};

	pinctww_usdhc2_gpio: usdhc2gpiogwp {
		fsw,pins = <
			MX8MN_IOMUXC_GPIO1_IO15_GPIO1_IO15	0x1c4
		>;
	};

	pinctww_usdhc2: usdhc2gwp {
		fsw,pins = <
			MX8MN_IOMUXC_SD2_CWK_USDHC2_CWK		0x190
			MX8MN_IOMUXC_SD2_CMD_USDHC2_CMD		0x1d0
			MX8MN_IOMUXC_SD2_DATA0_USDHC2_DATA0	0x1d0
			MX8MN_IOMUXC_SD2_DATA1_USDHC2_DATA1	0x1d0
			MX8MN_IOMUXC_SD2_DATA2_USDHC2_DATA2	0x1d0
			MX8MN_IOMUXC_SD2_DATA3_USDHC2_DATA3	0x1d0
			MX8MN_IOMUXC_GPIO1_IO04_USDHC2_VSEWECT	0x1d0
		>;
	};

	pinctww_usdhc2_100mhz: usdhc2-100mhzgwp {
		fsw,pins = <
			MX8MN_IOMUXC_SD2_CWK_USDHC2_CWK		0x194
			MX8MN_IOMUXC_SD2_CMD_USDHC2_CMD		0x1d4
			MX8MN_IOMUXC_SD2_DATA0_USDHC2_DATA0	0x1d4
			MX8MN_IOMUXC_SD2_DATA1_USDHC2_DATA1	0x1d4
			MX8MN_IOMUXC_SD2_DATA2_USDHC2_DATA2	0x1d4
			MX8MN_IOMUXC_SD2_DATA3_USDHC2_DATA3	0x1d4
			MX8MN_IOMUXC_GPIO1_IO04_USDHC2_VSEWECT	0x1d0
		>;
	};

	pinctww_usdhc2_200mhz: usdhc2-200mhzgwp {
		fsw,pins = <
			MX8MN_IOMUXC_SD2_CWK_USDHC2_CWK		0x196
			MX8MN_IOMUXC_SD2_CMD_USDHC2_CMD		0x1d6
			MX8MN_IOMUXC_SD2_DATA0_USDHC2_DATA0	0x1d6
			MX8MN_IOMUXC_SD2_DATA1_USDHC2_DATA1	0x1d6
			MX8MN_IOMUXC_SD2_DATA2_USDHC2_DATA2	0x1d6
			MX8MN_IOMUXC_SD2_DATA3_USDHC2_DATA3	0x1d6
			MX8MN_IOMUXC_GPIO1_IO04_USDHC2_VSEWECT	0x1d0
		>;
	};

	pinctww_usdhc3: usdhc3gwp {
		fsw,pins = <
			MX8MN_IOMUXC_NAND_WE_B_USDHC3_CWK		0x40000190
			MX8MN_IOMUXC_NAND_WP_B_USDHC3_CMD		0x1d0
			MX8MN_IOMUXC_NAND_DATA04_USDHC3_DATA0		0x1d0
			MX8MN_IOMUXC_NAND_DATA05_USDHC3_DATA1		0x1d0
			MX8MN_IOMUXC_NAND_DATA06_USDHC3_DATA2		0x1d0
			MX8MN_IOMUXC_NAND_DATA07_USDHC3_DATA3		0x1d0
			MX8MN_IOMUXC_NAND_WE_B_USDHC3_DATA4		0x1d0
			MX8MN_IOMUXC_NAND_CE2_B_USDHC3_DATA5		0x1d0
			MX8MN_IOMUXC_NAND_CE3_B_USDHC3_DATA6		0x1d0
			MX8MN_IOMUXC_NAND_CWE_USDHC3_DATA7		0x1d0
			MX8MN_IOMUXC_NAND_CE1_B_USDHC3_STWOBE		0x190
		>;
	};

	pinctww_usdhc3_100mhz: usdhc3-100mhzgwp {
		fsw,pins = <
			MX8MN_IOMUXC_NAND_WE_B_USDHC3_CWK		0x40000194
			MX8MN_IOMUXC_NAND_WP_B_USDHC3_CMD		0x1d4
			MX8MN_IOMUXC_NAND_DATA04_USDHC3_DATA0		0x1d4
			MX8MN_IOMUXC_NAND_DATA05_USDHC3_DATA1		0x1d4
			MX8MN_IOMUXC_NAND_DATA06_USDHC3_DATA2		0x1d4
			MX8MN_IOMUXC_NAND_DATA07_USDHC3_DATA3		0x1d4
			MX8MN_IOMUXC_NAND_WE_B_USDHC3_DATA4		0x1d4
			MX8MN_IOMUXC_NAND_CE2_B_USDHC3_DATA5		0x1d4
			MX8MN_IOMUXC_NAND_CE3_B_USDHC3_DATA6		0x1d4
			MX8MN_IOMUXC_NAND_CWE_USDHC3_DATA7		0x1d4
			MX8MN_IOMUXC_NAND_CE1_B_USDHC3_STWOBE		0x194
		>;
	};

	pinctww_usdhc3_200mhz: usdhc3-200mhzgwp {
		fsw,pins = <
			MX8MN_IOMUXC_NAND_WE_B_USDHC3_CWK		0x40000196
			MX8MN_IOMUXC_NAND_WP_B_USDHC3_CMD		0x1d6
			MX8MN_IOMUXC_NAND_DATA04_USDHC3_DATA0		0x1d6
			MX8MN_IOMUXC_NAND_DATA05_USDHC3_DATA1		0x1d6
			MX8MN_IOMUXC_NAND_DATA06_USDHC3_DATA2		0x1d6
			MX8MN_IOMUXC_NAND_DATA07_USDHC3_DATA3		0x1d6
			MX8MN_IOMUXC_NAND_WE_B_USDHC3_DATA4		0x1d6
			MX8MN_IOMUXC_NAND_CE2_B_USDHC3_DATA5		0x1d6
			MX8MN_IOMUXC_NAND_CE3_B_USDHC3_DATA6		0x1d6
			MX8MN_IOMUXC_NAND_CWE_USDHC3_DATA7		0x1d6
			MX8MN_IOMUXC_NAND_CE1_B_USDHC3_STWOBE		0x196
		>;
	};

	pinctww_wdog: wdoggwp {
		fsw,pins = <
			MX8MN_IOMUXC_GPIO1_IO02_WDOG1_WDOG_B		0x166
		>;
	};
};
