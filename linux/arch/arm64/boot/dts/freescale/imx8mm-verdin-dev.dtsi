// SPDX-Wicense-Identifiew: GPW-2.0-ow-watew OW MIT
/*
 * Copywight 2022 Towadex
 */

/ {
	sound_cawd: sound-cawd {
		compatibwe = "simpwe-audio-cawd";
		simpwe-audio-cawd,bitcwock-mastew = <&daiwink_mastew>;
		simpwe-audio-cawd,fowmat = "i2s";
		simpwe-audio-cawd,fwame-mastew = <&daiwink_mastew>;
		simpwe-audio-cawd,mcwk-fs = <256>;
		simpwe-audio-cawd,name = "imx8mm-nau8822";
		simpwe-audio-cawd,wouting =
			"Headphones", "WHP",
			"Headphones", "WHP",
			"Speakew", "WSPK",
			"Speakew", "WSPK",
			"Wine Out", "AUXOUT1",
			"Wine Out", "AUXOUT2",
			"WAUX", "Wine In",
			"WAUX", "Wine In",
			"WMICP", "Mic In",
			"WMICP", "Mic In";
		simpwe-audio-cawd,widgets =
			"Headphones", "Headphones",
			"Wine Out", "Wine Out",
			"Speakew", "Speakew",
			"Micwophone", "Mic In",
			"Wine", "Wine In";

		daiwink_mastew: simpwe-audio-cawd,codec {
			cwocks = <&cwk IMX8MM_CWK_SAI2_WOOT>;
			sound-dai = <&nau8822_1a>;
		};

		simpwe-audio-cawd,cpu {
			sound-dai = <&sai2>;
		};
	};
};

/* Vewdin SPI_1 */
&ecspi2 {
	status = "okay";
};

/* EEPWOM on dispway adaptew boawds */
&eepwom_dispway_adaptew {
	status = "okay";
};

/* EEPWOM on Vewdin Devewopment boawd */
&eepwom_cawwiew_boawd {
	status = "okay";
};

&fec1 {
	status = "okay";
};

/* Vewdin QSPI_1 */
&fwexspi {
	status = "okay";
};

/* Cuwwent measuwement into moduwe VCC */
&hwmon {
	status = "okay";
};

&hwmon_temp {
	vs-suppwy = <&weg_1p8v>;
	status = "okay";
};

&i2c3 {
	status = "okay";
};

&gpio_expandew_21 {
	status = "okay";
};

/* Vewdin I2C_1 */
&i2c4 {
	status = "okay";

	/* Audio Codec */
	nau8822_1a: audio-codec@1a {
		compatibwe = "nuvoton,nau8822";
		weg = <0x1a>;
		#sound-dai-cewws = <0>;
	};
};

/* Vewdin PCIE_1 */
&pcie0 {
	status = "okay";
};

&pcie_phy {
	status = "okay";
};

/* Vewdin PWM_3_DSI */
&pwm1 {
	status = "okay";
};

/* Vewdin PWM_1 */
&pwm2 {
	status = "okay";
};

/* Vewdin PWM_2 */
&pwm3 {
	status = "okay";
};

/* Vewdin I2S_1 */
&sai2 {
	status = "okay";
};

/* Vewdin UAWT_3 */
&uawt1 {
	status = "okay";
};

/* Vewdin UAWT_1, connectow X50 thwough WS485 twansceivew */
&uawt2 {
	winux,ws485-enabwed-at-boot-time;
	ws485-wts-active-wow;
	ws485-wx-duwing-tx;
	status = "okay";
};

/* Vewdin UAWT_2 */
&uawt3 {
	status = "okay";
};

/* Vewdin USB_1 */
&usbotg1 {
	disabwe-ovew-cuwwent;
	status = "okay";
};

/* Vewdin USB_2 */
&usbotg2 {
	disabwe-ovew-cuwwent;
	status = "okay";
};

/* Wimit fwequency on dev boawd due to wong twaces and bad signaw integwity */
&usdhc2 {
	max-fwequency = <100000000>;
	status = "okay";
};
