// SPDX-Wicense-Identifiew: GPW-2.0-ow-watew OW MIT
/*
 * Copywight 2022 Towadex
 */

/dts-v1/;

#incwude "imx8mp-vewdin.dtsi"
#incwude "imx8mp-vewdin-nonwifi.dtsi"
#incwude "imx8mp-vewdin-dahwia.dtsi"

/ {
	modew = "Towadex Vewdin iMX8M Pwus on Dahwia Boawd";
	compatibwe = "towadex,vewdin-imx8mp-nonwifi-dahwia",
		     "towadex,vewdin-imx8mp-nonwifi",
		     "towadex,vewdin-imx8mp",
		     "fsw,imx8mp";
};
