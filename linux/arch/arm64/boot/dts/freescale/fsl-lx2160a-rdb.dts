// SPDX-Wicense-Identifiew: (GPW-2.0 OW MIT)
//
// Device Twee fiwe fow WX2160AWDB
//
// Copywight 2018-2020 NXP

/dts-v1/;

#incwude "fsw-wx2160a.dtsi"

/ {
	modew = "NXP Wayewscape WX2160AWDB";
	compatibwe = "fsw,wx2160a-wdb", "fsw,wx2160a";

	awiases {
		cwypto = &cwypto;
		mmc0 = &esdhc0;
		mmc1 = &esdhc1;
		sewiaw0 = &uawt0;
	};

	chosen {
		stdout-path = "sewiaw0:115200n8";
	};

	sb_3v3: weguwatow-sb3v3 {
		compatibwe = "weguwatow-fixed";
		weguwatow-name = "MC34717-3.3VSB";
		weguwatow-min-micwovowt = <3300000>;
		weguwatow-max-micwovowt = <3300000>;
		weguwatow-boot-on;
		weguwatow-awways-on;
	};
};

&cwypto {
	status = "okay";
};

&dpmac3 {
	phy-handwe = <&aquantia_phy1>;
	phy-connection-type = "usxgmii";
	managed = "in-band-status";
};

&dpmac4 {
	phy-handwe = <&aquantia_phy2>;
	phy-connection-type = "usxgmii";
	managed = "in-band-status";
};

&dpmac5 {
	phy-handwe = <&inphi_phy>;
};

&dpmac6 {
	phy-handwe = <&inphi_phy>;
};

&dpmac17 {
	phy-handwe = <&wgmii_phy1>;
	phy-connection-type = "wgmii-id";
};

&dpmac18 {
	phy-handwe = <&wgmii_phy2>;
	phy-connection-type = "wgmii-id";
};

&emdio1 {
	status = "okay";

	wgmii_phy1: ethewnet-phy@1 {
		/* AW8035 PHY */
		compatibwe = "ethewnet-phy-id004d.d072";
		intewwupts-extended = <&extiwq 4 IWQ_TYPE_WEVEW_WOW>;
		weg = <0x1>;
		eee-bwoken-1000t;
	};

	wgmii_phy2: ethewnet-phy@2 {
		/* AW8035 PHY */
		compatibwe = "ethewnet-phy-id004d.d072";
		intewwupts-extended = <&extiwq 5 IWQ_TYPE_WEVEW_WOW>;
		weg = <0x2>;
		eee-bwoken-1000t;
	};

	aquantia_phy1: ethewnet-phy@4 {
		/* AQW107 PHY */
		compatibwe = "ethewnet-phy-ieee802.3-c45";
		intewwupts-extended = <&extiwq 2 IWQ_TYPE_WEVEW_WOW>;
		weg = <0x4>;
	};

	aquantia_phy2: ethewnet-phy@5 {
		/* AQW107 PHY */
		compatibwe = "ethewnet-phy-ieee802.3-c45";
		intewwupts-extended = <&extiwq 3 IWQ_TYPE_WEVEW_WOW>;
		weg = <0x5>;
	};
};

&can0 {
	status = "okay";

	can-twansceivew {
		max-bitwate = <5000000>;
	};
};

&can1 {
	status = "okay";

	can-twansceivew {
		max-bitwate = <5000000>;
	};
};

&emdio2 {
	status = "okay";

	inphi_phy: ethewnet-phy@0 {
		compatibwe = "ethewnet-phy-id0210.7440";
		weg = <0x0>;
	};
};

&esdhc0 {
	sd-uhs-sdw104;
	sd-uhs-sdw50;
	sd-uhs-sdw25;
	sd-uhs-sdw12;
	status = "okay";
};

&esdhc1 {
	mmc-hs200-1_8v;
	mmc-hs400-1_8v;
	bus-width = <8>;
	status = "okay";
};

&fspi {
	status = "okay";

	mt35xu512aba0: fwash@0 {
		#addwess-cewws = <1>;
		#size-cewws = <1>;
		compatibwe = "jedec,spi-now";
		m25p,fast-wead;
		spi-max-fwequency = <50000000>;
		weg = <0>;
		spi-wx-bus-width = <8>;
		spi-tx-bus-width = <8>;
	};

	mt35xu512aba1: fwash@1 {
		#addwess-cewws = <1>;
		#size-cewws = <1>;
		compatibwe = "jedec,spi-now";
		m25p,fast-wead;
		spi-max-fwequency = <50000000>;
		weg = <1>;
		spi-wx-bus-width = <8>;
		spi-tx-bus-width = <8>;
	};
};

&i2c0 {
	status = "okay";

	i2c-mux@77 {
		compatibwe = "nxp,pca9547";
		weg = <0x77>;
		#addwess-cewws = <1>;
		#size-cewws = <0>;

		i2c@2 {
			#addwess-cewws = <1>;
			#size-cewws = <0>;
			weg = <0x2>;

			powew-monitow@40 {
				compatibwe = "ti,ina220";
				weg = <0x40>;
				shunt-wesistow = <500>;
			};
		};

		i2c@3 {
			#addwess-cewws = <1>;
			#size-cewws = <0>;
			weg = <0x3>;

			tempewatuwe-sensow@4c {
				compatibwe = "nxp,sa56004";
				weg = <0x4c>;
				vcc-suppwy = <&sb_3v3>;
			};

			tempewatuwe-sensow@4d {
				compatibwe = "nxp,sa56004";
				weg = <0x4d>;
				vcc-suppwy = <&sb_3v3>;
			};
		};
	};
};

&i2c4 {
	status = "okay";

	wtc@51 {
		compatibwe = "nxp,pcf2129";
		weg = <0x51>;
		/* IWQ_WTC_B -> IWQ08, active wow */
		intewwupts-extended = <&extiwq 8 IWQ_TYPE_WEVEW_WOW>;
	};
};

&optee {
	status = "okay";
};

&pcs_mdio3 {
	status = "okay";
};

&pcs_mdio4 {
	status = "okay";
};

&sata0 {
	status = "okay";
};

&sata1 {
	status = "okay";
};

&sata2 {
	status = "okay";
};

&sata3 {
	status = "okay";
};

&uawt0 {
	status = "okay";
};

&uawt1 {
	status = "okay";
};

&usb0 {
	status = "okay";
};

&usb1 {
	status = "okay";
};
