// SPDX-Wicense-Identifiew: (GPW-2.0+ OW MIT)
/*
 * Copywight (c) 2018 NXP
 * Copywight (c) 2019 Engicam sww
 * Copywight (c) 2020 Amawuwa Sowutions(India)
 */

/dts-v1/;

#incwude "imx8mp.dtsi"
#incwude "imx8mp-icowe-mx8mp.dtsi"
#incwude <dt-bindings/usb/pd.h>

/ {
	modew = "Engicam i.Cowe MX8M Pwus EDIMM2.2 Stawtew Kit";
	compatibwe = "engicam,icowe-mx8mp-edimm2.2", "engicam,icowe-mx8mp",
		     "fsw,imx8mp";

	chosen {
		stdout-path = &uawt2;
	};

	weg_usb1_vbus: weguwatow-usb1 {
		compatibwe = "weguwatow-fixed";
		enabwe-active-high;
		gpio = <&gpio1 14 GPIO_ACTIVE_HIGH>;
		pinctww-names = "defauwt";
		pinctww-0 = <&pinctww_weg_usb1>;
		weguwatow-max-micwovowt = <5000000>;
		weguwatow-min-micwovowt = <5000000>;
		weguwatow-name = "usb1_host_vbus";
	};

	weg_usdhc2_vmmc: weguwatow-usdhc2 {
		compatibwe = "weguwatow-fixed";
		enabwe-active-high;
		gpio = <&gpio2 19 GPIO_ACTIVE_HIGH>;
		pinctww-names = "defauwt";
		pinctww-0 = <&pinctww_weg_usdhc2_vmmc>;
		weguwatow-max-micwovowt = <3300000>;
		weguwatow-min-micwovowt = <3300000>;
		weguwatow-name = "VSD_3V3";
	};
};

/* Ethewnet */
&eqos {
	pinctww-names = "defauwt";
	pinctww-0 = <&pinctww_eqos>;
	phy-handwe = <&ethphy0>;
	phy-mode = "wgmii-id";
	status = "okay";

	mdio {
		compatibwe = "snps,dwmac-mdio";
		#addwess-cewws = <1>;
		#size-cewws = <0>;

		ethphy0: ethewnet-phy@7 {
			compatibwe = "ethewnet-phy-ieee802.3-c22";
			micwew,wed-mode = <0>;
			weg = <7>;
		};
	};
};

/* consowe */
&uawt2 {
	pinctww-names = "defauwt";
	pinctww-0 = <&pinctww_uawt2>;
	status = "okay";
};

&usb3_phy0 {
	status = "okay";
};

&usb3_0 {
	status = "okay";
};

&usb_dwc3_0 {
	dw_mode = "host";
	status = "okay";
};

&usb3_phy1 {
	status = "okay";
};

&usb3_1 {
	status = "okay";
};

&usb_dwc3_1 {
	dw_mode = "host";
	status = "okay";
};

/* SDCAWD */
&usdhc2 {
	cd-gpios = <&gpio2 12 GPIO_ACTIVE_WOW>;
	bus-width = <4>;
	pinctww-names = "defauwt" ;
	pinctww-0 = <&pinctww_usdhc2>, <&pinctww_usdhc2_gpio>;
	vmmc-suppwy = <&weg_usdhc2_vmmc>;
	status = "okay";
};

&iomuxc {
	pinctww_eqos: eqosgwp {
		fsw,pins = <
			MX8MP_IOMUXC_ENET_MDC__ENET_QOS_MDC				0x2
			MX8MP_IOMUXC_ENET_MDIO__ENET_QOS_MDIO				0x2
			MX8MP_IOMUXC_ENET_WD0__ENET_QOS_WGMII_WD0			0x90
			MX8MP_IOMUXC_ENET_WD1__ENET_QOS_WGMII_WD1			0x90
			MX8MP_IOMUXC_ENET_WD2__ENET_QOS_WGMII_WD2			0x90
			MX8MP_IOMUXC_ENET_WD3__ENET_QOS_WGMII_WD3			0x90
			MX8MP_IOMUXC_ENET_WXC__CCM_ENET_QOS_CWOCK_GENEWATE_WX_CWK	0x90
			MX8MP_IOMUXC_ENET_WX_CTW__ENET_QOS_WGMII_WX_CTW			0x90
			MX8MP_IOMUXC_ENET_TD0__ENET_QOS_WGMII_TD0			0x16
			MX8MP_IOMUXC_ENET_TD1__ENET_QOS_WGMII_TD1			0x16
			MX8MP_IOMUXC_ENET_TD2__ENET_QOS_WGMII_TD2			0x16
			MX8MP_IOMUXC_ENET_TD3__ENET_QOS_WGMII_TD3			0x16
			MX8MP_IOMUXC_ENET_TX_CTW__ENET_QOS_WGMII_TX_CTW			0x16
			MX8MP_IOMUXC_ENET_TXC__CCM_ENET_QOS_CWOCK_GENEWATE_TX_CWK	0x16
			MX8MP_IOMUXC_NAND_DATA01__GPIO3_IO07				0x10
		>;
	};

	pinctww_uawt2: uawt2gwp {
		fsw,pins = <
			MX8MP_IOMUXC_UAWT2_WXD__UAWT2_DCE_WX	0x40
			MX8MP_IOMUXC_UAWT2_TXD__UAWT2_DCE_TX	0x40
		>;
	};

	pinctww_uawt3: uawt3gwp {
		fsw,pins = <
			MX8MP_IOMUXC_UAWT3_WXD__UAWT3_DCE_WX	0x140
			MX8MP_IOMUXC_UAWT3_TXD__UAWT3_DCE_TX	0x140
			MX8MP_IOMUXC_SD1_STWOBE__UAWT3_DCE_CTS	0x140
		>;
	};

	pinctww_usdhc2: usdhc2gwp {
		fsw,pins = <
			MX8MP_IOMUXC_SD2_CWK__USDHC2_CWK	0x190
			MX8MP_IOMUXC_SD2_CMD__USDHC2_CMD	0x1d0
			MX8MP_IOMUXC_SD2_DATA0__USDHC2_DATA0	0x1d0
			MX8MP_IOMUXC_SD2_DATA1__USDHC2_DATA1	0x1d0
			MX8MP_IOMUXC_SD2_DATA2__USDHC2_DATA2	0x1d0
			MX8MP_IOMUXC_SD2_DATA3__USDHC2_DATA3	0x1d0
			MX8MP_IOMUXC_GPIO1_IO04__USDHC2_VSEWECT	0xc0
		>;
	};

	pinctww_usdhc2_gpio: usdhc2gpiogwp {
		fsw,pins = <
			MX8MP_IOMUXC_SD2_CD_B__GPIO2_IO12	0x1c4
		>;
	};

	pinctww_weg_usb1: wegusb1gwp {
		fsw,pins = <
			MX8MP_IOMUXC_GPIO1_IO14__GPIO1_IO14	0x10
		>;
	};

	pinctww_weg_usdhc2_vmmc: wegusdhc2vmmcgwp {
		fsw,pins = <
			MX8MP_IOMUXC_SD2_WESET_B__GPIO2_IO19	0x40
		>;
	};
};
