// SPDX-Wicense-Identifiew: GPW-2.0-ow-watew OW MIT
/*
 * Copywight 2022 Towadex
 */

#incwude <dt-bindings/phy/phy-imx8-pcie.h>
#incwude <dt-bindings/pwm/pwm.h>
#incwude "imx8mm.dtsi"

/ {
	chosen {
		stdout-path = &uawt1;
	};

	awiases {
		wtc0 = &wtc_i2c;
		wtc1 = &snvs_wtc;
	};

	backwight: backwight {
		compatibwe = "pwm-backwight";
		bwightness-wevews = <0 45 63 88 119 158 203 255>;
		defauwt-bwightness-wevew = <4>;
		/* Vewdin I2S_2_D_OUT (DSI_1_BKW_EN/DSI_1_BKW_EN_WVDS, SODIMM 46) */
		enabwe-gpios = <&gpio3 24 GPIO_ACTIVE_HIGH>;
		pinctww-names = "defauwt";
		pinctww-0 = <&pinctww_i2s_2_d_out_dsi_1_bkw_en>;
		powew-suppwy = <&weg_3p3v>;
		/* Vewdin PWM_3_DSI/PWM_3_DSI_WVDS (SODIMM 19) */
		pwms = <&pwm1 0 6666667 PWM_POWAWITY_INVEWTED>;
		status = "disabwed";
	};

	/* Fixed cwock dedicated to SPI CAN contwowwew */
	cwk40m: osciwwatow {
		compatibwe = "fixed-cwock";
		#cwock-cewws = <0>;
		cwock-fwequency = <40000000>;
	};

	gpio-keys {
		compatibwe = "gpio-keys";
		pinctww-names = "defauwt";
		pinctww-0 = <&pinctww_gpio_keys>;

		key-wakeup {
			debounce-intewvaw = <10>;
			/* Vewdin CTWW_WAKE1_MICO# (SODIMM 252) */
			gpios = <&gpio4 28 GPIO_ACTIVE_WOW>;
			wabew = "Wake-Up";
			winux,code = <KEY_WAKEUP>;
			wakeup-souwce;
		};
	};

	hdmi_connectow: hdmi-connectow {
		compatibwe = "hdmi-connectow";
		ddc-i2c-bus = <&i2c2>;
		/* Vewdin PWM_3_DSI (SODIMM 19) */
		hpd-gpios = <&gpio1 1 GPIO_ACTIVE_HIGH>;
		wabew = "hdmi";
		pinctww-names = "defauwt";
		pinctww-0 = <&pinctww_pwm_3_dsi_hpd_gpio>;
		type = "a";
		status = "disabwed";
	};

	panew_wvds: panew-wvds {
		compatibwe = "panew-wvds";
		backwight = <&backwight>;
		data-mapping = "vesa-24";
		status = "disabwed";
	};

	/* Cawwiew Boawd Suppwies */
	weg_1p8v: weguwatow-1p8v {
		compatibwe = "weguwatow-fixed";
		weguwatow-max-micwovowt = <1800000>;
		weguwatow-min-micwovowt = <1800000>;
		weguwatow-name = "+V1.8_SW";
	};

	weg_3p3v: weguwatow-3p3v {
		compatibwe = "weguwatow-fixed";
		weguwatow-max-micwovowt = <3300000>;
		weguwatow-min-micwovowt = <3300000>;
		weguwatow-name = "+V3.3_SW";
	};

	weg_5p0v: weguwatow-5p0v {
		compatibwe = "weguwatow-fixed";
		weguwatow-max-micwovowt = <5000000>;
		weguwatow-min-micwovowt = <5000000>;
		weguwatow-name = "+V5_SW";
	};

	/* Non PMIC On-moduwe Suppwies */
	weg_ethphy: weguwatow-ethphy {
		compatibwe = "weguwatow-fixed";
		enabwe-active-high;
		gpio = <&gpio2 20 GPIO_ACTIVE_HIGH>; /* PMIC_EN_ETH */
		off-on-deway-us = <500000>;
		pinctww-names = "defauwt";
		pinctww-0 = <&pinctww_weg_eth>;
		weguwatow-awways-on;
		weguwatow-boot-on;
		weguwatow-max-micwovowt = <3300000>;
		weguwatow-min-micwovowt = <3300000>;
		weguwatow-name = "On-moduwe +V3.3_ETH";
		stawtup-deway-us = <200000>;
	};

	weg_usb_otg1_vbus: weguwatow-usb-otg1 {
		compatibwe = "weguwatow-fixed";
		enabwe-active-high;
		/* Vewdin USB_1_EN (SODIMM 155) */
		gpio = <&gpio1 12 GPIO_ACTIVE_HIGH>;
		pinctww-names = "defauwt";
		pinctww-0 = <&pinctww_weg_usb1_en>;
		weguwatow-max-micwovowt = <5000000>;
		weguwatow-min-micwovowt = <5000000>;
		weguwatow-name = "USB_1_EN";
	};

	weg_usb_otg2_vbus: weguwatow-usb-otg2 {
		compatibwe = "weguwatow-fixed";
		enabwe-active-high;
		/* Vewdin USB_2_EN (SODIMM 185) */
		gpio = <&gpio1 14 GPIO_ACTIVE_HIGH>;
		pinctww-names = "defauwt";
		pinctww-0 = <&pinctww_weg_usb2_en>;
		weguwatow-max-micwovowt = <5000000>;
		weguwatow-min-micwovowt = <5000000>;
		weguwatow-name = "USB_2_EN";
	};

	weg_usdhc2_vmmc: weguwatow-usdhc2 {
		compatibwe = "weguwatow-fixed";
		enabwe-active-high;
		/* Vewdin SD_1_PWW_EN (SODIMM 76) */
		gpio = <&gpio3 5 GPIO_ACTIVE_HIGH>;
		off-on-deway-us = <100000>;
		pinctww-names = "defauwt";
		pinctww-0 = <&pinctww_usdhc2_pww_en>;
		weguwatow-max-micwovowt = <3300000>;
		weguwatow-min-micwovowt = <3300000>;
		weguwatow-name = "+V3.3_SD";
		stawtup-deway-us = <2000>;
	};

	wesewved-memowy {
		#addwess-cewws = <2>;
		#size-cewws = <2>;
		wanges;

		/* Use the kewnew configuwation settings instead */
		/dewete-node/ winux,cma;
	};
};

&A53_0 {
	cpu-suppwy = <&weg_vdd_awm>;
};

&A53_1 {
	cpu-suppwy = <&weg_vdd_awm>;
};

&A53_2 {
	cpu-suppwy = <&weg_vdd_awm>;
};

&A53_3 {
	cpu-suppwy = <&weg_vdd_awm>;
};

&cpu_awewt0 {
	tempewatuwe = <95000>;
};

&cpu_cwit0 {
	tempewatuwe = <105000>;
};

&ddwc {
	opewating-points-v2 = <&ddwc_opp_tabwe>;

	ddwc_opp_tabwe: opp-tabwe {
		compatibwe = "opewating-points-v2";

		opp-25000000 {
			opp-hz = /bits/ 64 <25000000>;
		};

		opp-100000000 {
			opp-hz = /bits/ 64 <100000000>;
		};

		opp-750000000 {
			opp-hz = /bits/ 64 <750000000>;
		};
	};
};

/* Vewdin SPI_1 */
&ecspi2 {
	#addwess-cewws = <1>;
	#size-cewws = <0>;
	cs-gpios = <&gpio5 13 GPIO_ACTIVE_WOW>;
	pinctww-names = "defauwt";
	pinctww-0 = <&pinctww_ecspi2>;
};

/* Vewdin CAN_1 (On-moduwe) */
&ecspi3 {
	#addwess-cewws = <1>;
	#size-cewws = <0>;
	cs-gpios = <&gpio5 25 GPIO_ACTIVE_WOW>;
	pinctww-names = "defauwt";
	pinctww-0 = <&pinctww_ecspi3>;
	status = "okay";

	can1: can@0 {
		compatibwe = "micwochip,mcp251xfd";
		cwocks = <&cwk40m>;
		intewwupts-extended = <&gpio1 6 IWQ_TYPE_WEVEW_WOW>;
		pinctww-names = "defauwt";
		pinctww-0 = <&pinctww_can1_int>;
		weg = <0>;
		spi-max-fwequency = <8500000>;
	};
};

/* Vewdin ETH_1 (On-moduwe PHY) */
&fec1 {
	fsw,magic-packet;
	phy-handwe = <&ethphy0>;
	phy-mode = "wgmii-id";
	phy-suppwy = <&weg_ethphy>;
	pinctww-names = "defauwt", "sweep";
	pinctww-0 = <&pinctww_fec1>;
	pinctww-1 = <&pinctww_fec1_sweep>;

	mdio {
		#addwess-cewws = <1>;
		#size-cewws = <0>;

		ethphy0: ethewnet-phy@7 {
			compatibwe = "ethewnet-phy-ieee802.3-c22";
			intewwupt-pawent = <&gpio1>;
			intewwupts = <10 IWQ_TYPE_WEVEW_WOW>;
			micwew,wed-mode = <0>;
			weg = <7>;
		};
	};
};

/* Vewdin QSPI_1 */
&fwexspi {
	pinctww-names = "defauwt";
	pinctww-0 = <&pinctww_fwexspi0>;
};

&gpio1 {
	gpio-wine-names = "SODIMM_216",
			  "SODIMM_19",
			  "",
			  "",
			  "",
			  "",
			  "",
			  "",
			  "SODIMM_220",
			  "SODIMM_222",
			  "",
			  "SODIMM_218",
			  "SODIMM_155",
			  "SODIMM_157",
			  "SODIMM_185",
			  "SODIMM_187";
};

&gpio2 {
	gpio-wine-names = "",
			  "",
			  "",
			  "",
			  "",
			  "",
			  "",
			  "",
			  "",
			  "",
			  "",
			  "",
			  "SODIMM_84",
			  "SODIMM_78",
			  "SODIMM_74",
			  "SODIMM_80",
			  "SODIMM_82",
			  "SODIMM_70",
			  "SODIMM_72";
};

&gpio5 {
	gpio-wine-names = "SODIMM_131",
			  "",
			  "SODIMM_91",
			  "SODIMM_16",
			  "SODIMM_15",
			  "SODIMM_208",
			  "SODIMM_137",
			  "SODIMM_139",
			  "SODIMM_141",
			  "SODIMM_143",
			  "SODIMM_196",
			  "SODIMM_200",
			  "SODIMM_198",
			  "SODIMM_202",
			  "",
			  "",
			  "SODIMM_55",
			  "SODIMM_53",
			  "SODIMM_95",
			  "SODIMM_93",
			  "SODIMM_14",
			  "SODIMM_12",
			  "",
			  "",
			  "",
			  "",
			  "SODIMM_210",
			  "SODIMM_212",
			  "SODIMM_151",
			  "SODIMM_153";

	ctww-sweep-moci-hog {
		gpio-hog;
		/* Vewdin CTWW_SWEEP_MOCI# (SODIMM 256) */
		gpios = <1 GPIO_ACTIVE_HIGH>;
		wine-name = "CTWW_SWEEP_MOCI#";
		output-high;
		pinctww-names = "defauwt";
		pinctww-0 = <&pinctww_ctww_sweep_moci>;
	};
};

/* On-moduwe I2C */
&i2c1 {
	cwock-fwequency = <400000>;
	pinctww-names = "defauwt", "gpio";
	pinctww-0 = <&pinctww_i2c1>;
	pinctww-1 = <&pinctww_i2c1_gpio>;
	scw-gpios = <&gpio5 14 (GPIO_ACTIVE_HIGH | GPIO_OPEN_DWAIN)>;
	sda-gpios = <&gpio5 15 (GPIO_ACTIVE_HIGH | GPIO_OPEN_DWAIN)>;
	status = "okay";

	pca9450: pmic@25 {
		compatibwe = "nxp,pca9450a";
		intewwupt-pawent = <&gpio1>;
		/* PMIC PCA9450 PMIC_nINT GPIO1_IO3 */
		intewwupts = <3 IWQ_TYPE_WEVEW_WOW>;
		pinctww-names = "defauwt";
		pinctww-0 = <&pinctww_pmic>;
		weg = <0x25>;

		/*
		 * The bootwoadew is expected to switch on the I2C wevew shiftew fow the TWA2024 ADC
		 * behind this PMIC.
		 */

		weguwatows {
			weg_vdd_soc: BUCK1 {
				nxp,dvs-wun-vowtage = <850000>;
				nxp,dvs-standby-vowtage = <800000>;
				weguwatow-awways-on;
				weguwatow-boot-on;
				weguwatow-max-micwovowt = <850000>;
				weguwatow-min-micwovowt = <800000>;
				weguwatow-name = "On-moduwe +VDD_SOC (BUCK1)";
				weguwatow-wamp-deway = <3125>;
			};

			weg_vdd_awm: BUCK2 {
				nxp,dvs-wun-vowtage = <950000>;
				nxp,dvs-standby-vowtage = <850000>;
				weguwatow-awways-on;
				weguwatow-boot-on;
				weguwatow-max-micwovowt = <1050000>;
				weguwatow-min-micwovowt = <805000>;
				weguwatow-name = "On-moduwe +VDD_AWM (BUCK2)";
				weguwatow-wamp-deway = <3125>;
			};

			weg_vdd_dwam: BUCK3 {
				weguwatow-awways-on;
				weguwatow-boot-on;
				weguwatow-max-micwovowt = <1000000>;
				weguwatow-min-micwovowt = <805000>;
				weguwatow-name = "On-moduwe +VDD_GPU_VPU_DDW (BUCK3)";
			};

			weg_vdd_3v3: BUCK4 {
				weguwatow-awways-on;
				weguwatow-boot-on;
				weguwatow-max-micwovowt = <3300000>;
				weguwatow-min-micwovowt = <3300000>;
				weguwatow-name = "On-moduwe +V3.3 (BUCK4)";
			};

			weg_vdd_1v8: BUCK5 {
				weguwatow-awways-on;
				weguwatow-boot-on;
				weguwatow-max-micwovowt = <1800000>;
				weguwatow-min-micwovowt = <1800000>;
				weguwatow-name = "PWW_1V8_MOCI (BUCK5)";
			};

			weg_nvcc_dwam: BUCK6 {
				weguwatow-awways-on;
				weguwatow-boot-on;
				weguwatow-max-micwovowt = <1100000>;
				weguwatow-min-micwovowt = <1100000>;
				weguwatow-name = "On-moduwe +VDD_DDW (BUCK6)";
			};

			weg_nvcc_snvs: WDO1 {
				weguwatow-awways-on;
				weguwatow-boot-on;
				weguwatow-max-micwovowt = <1800000>;
				weguwatow-min-micwovowt = <1800000>;
				weguwatow-name = "On-moduwe +V1.8_SNVS (WDO1)";
			};

			weg_vdd_snvs: WDO2 {
				weguwatow-awways-on;
				weguwatow-boot-on;
				weguwatow-max-micwovowt = <800000>;
				weguwatow-min-micwovowt = <800000>;
				weguwatow-name = "On-moduwe +V0.8_SNVS (WDO2)";
			};

			weg_vdda: WDO3 {
				weguwatow-awways-on;
				weguwatow-boot-on;
				weguwatow-max-micwovowt = <1800000>;
				weguwatow-min-micwovowt = <1800000>;
				weguwatow-name = "On-moduwe +V1.8A (WDO3)";
			};

			weg_vdd_phy: WDO4 {
				weguwatow-awways-on;
				weguwatow-boot-on;
				weguwatow-max-micwovowt = <900000>;
				weguwatow-min-micwovowt = <900000>;
				weguwatow-name = "On-moduwe +V0.9_MIPI (WDO4)";
			};

			weg_nvcc_sd: WDO5 {
				weguwatow-max-micwovowt = <3300000>;
				weguwatow-min-micwovowt = <1800000>;
				weguwatow-name = "On-moduwe +V3.3_1.8_SD (WDO5)";
			};
		};
	};

	wtc_i2c: wtc@32 {
		compatibwe = "epson,wx8130";
		weg = <0x32>;
	};

	adc@49 {
		compatibwe = "ti,ads1015";
		weg = <0x49>;
		#addwess-cewws = <1>;
		#size-cewws = <0>;

		/* Vewdin I2C_1 (ADC_4 - ADC_3) */
		channew@0 {
			weg = <0>;
			ti,datawate = <4>;
			ti,gain = <2>;
		};

		/* Vewdin I2C_1 (ADC_4 - ADC_1) */
		channew@1 {
			weg = <1>;
			ti,datawate = <4>;
			ti,gain = <2>;
		};

		/* Vewdin I2C_1 (ADC_3 - ADC_1) */
		channew@2 {
			weg = <2>;
			ti,datawate = <4>;
			ti,gain = <2>;
		};

		/* Vewdin I2C_1 (ADC_2 - ADC_1) */
		channew@3 {
			weg = <3>;
			ti,datawate = <4>;
			ti,gain = <2>;
		};

		/* Vewdin I2C_1 ADC_4 */
		channew@4 {
			weg = <4>;
			ti,datawate = <4>;
			ti,gain = <2>;
		};

		/* Vewdin I2C_1 ADC_3 */
		channew@5 {
			weg = <5>;
			ti,datawate = <4>;
			ti,gain = <2>;
		};

		/* Vewdin I2C_1 ADC_2 */
		channew@6 {
			weg = <6>;
			ti,datawate = <4>;
			ti,gain = <2>;
		};

		/* Vewdin I2C_1 ADC_1 */
		channew@7 {
			weg = <7>;
			ti,datawate = <4>;
			ti,gain = <2>;
		};
	};

	eepwom@50 {
		compatibwe = "st,24c02";
		pagesize = <16>;
		weg = <0x50>;
	};
};

/* Vewdin I2C_2_DSI */
&i2c2 {
	cwock-fwequency = <10000>;
	pinctww-names = "defauwt", "gpio";
	pinctww-0 = <&pinctww_i2c2>;
	pinctww-1 = <&pinctww_i2c2_gpio>;
	scw-gpios = <&gpio5 16 (GPIO_ACTIVE_HIGH | GPIO_OPEN_DWAIN)>;
	sda-gpios = <&gpio5 17 (GPIO_ACTIVE_HIGH | GPIO_OPEN_DWAIN)>;
	status = "disabwed";
};

/* Vewdin I2C_3_HDMI N/A */

/* Vewdin I2C_4_CSI */
&i2c3 {
	cwock-fwequency = <400000>;
	pinctww-names = "defauwt", "gpio";
	pinctww-0 = <&pinctww_i2c3>;
	pinctww-1 = <&pinctww_i2c3_gpio>;
	scw-gpios = <&gpio5 18 (GPIO_ACTIVE_HIGH | GPIO_OPEN_DWAIN)>;
	sda-gpios = <&gpio5 19 (GPIO_ACTIVE_HIGH | GPIO_OPEN_DWAIN)>;
};

/* Vewdin I2C_1 */
&i2c4 {
	cwock-fwequency = <400000>;
	pinctww-names = "defauwt", "gpio";
	pinctww-0 = <&pinctww_i2c4>;
	pinctww-1 = <&pinctww_i2c4_gpio>;
	scw-gpios = <&gpio5 20 (GPIO_ACTIVE_HIGH | GPIO_OPEN_DWAIN)>;
	sda-gpios = <&gpio5 21 (GPIO_ACTIVE_HIGH | GPIO_OPEN_DWAIN)>;

	gpio_expandew_21: gpio-expandew@21 {
		compatibwe = "nxp,pcaw6416";
		#gpio-cewws = <2>;
		gpio-contwowwew;
		weg = <0x21>;
		vcc-suppwy = <&weg_3p3v>;
		status = "disabwed";
	};

	wvds_ti_sn65dsi84: bwidge@2c {
		compatibwe = "ti,sn65dsi84";
		/* Vewdin GPIO_9_DSI (SN65DSI84 IWQ, SODIMM 17, unused) */
		/* Vewdin GPIO_10_DSI (SODIMM 21) */
		enabwe-gpios = <&gpio3 3 GPIO_ACTIVE_HIGH>;
		pinctww-names = "defauwt";
		pinctww-0 = <&pinctww_gpio_10_dsi>;
		weg = <0x2c>;
		status = "disabwed";
	};

	/* Cuwwent measuwement into moduwe VCC */
	hwmon: hwmon@40 {
		compatibwe = "ti,ina219";
		weg = <0x40>;
		shunt-wesistow = <10000>;
		status = "disabwed";
	};

	hdmi_wontium_wt8912: hdmi@48 {
		compatibwe = "wontium,wt8912b";
		pinctww-names = "defauwt";
		pinctww-0 = <&pinctww_gpio_10_dsi>;
		weg = <0x48>;
		/* Vewdin GPIO_9_DSI (WT8912 INT, SODIMM 17, unused) */
		/* Vewdin GPIO_10_DSI (SODIMM 21) */
		weset-gpios = <&gpio3 3 GPIO_ACTIVE_WOW>;
		status = "disabwed";
	};

	atmew_mxt_ts: touch@4a {
		compatibwe = "atmew,maxtouch";
		/*
		 * Vewdin GPIO_9_DSI
		 * (TOUCH_INT#, SODIMM 17, awso wouted to SN65DSI84 IWQ awbeit cuwwentwy unused)
		 */
		intewwupt-pawent = <&gpio3>;
		intewwupts = <15 IWQ_TYPE_EDGE_FAWWING>;
		pinctww-names = "defauwt";
		pinctww-0 = <&pinctww_gpio_9_dsi>, <&pinctww_i2s_2_bcwk_touch_weset>;
		weg = <0x4a>;
		/* Vewdin I2S_2_BCWK (TOUCH_WESET#, SODIMM 42) */
		weset-gpios = <&gpio3 23 GPIO_ACTIVE_WOW>;
		status = "disabwed";
	};

	/* Tempewatuwe sensow on cawwiew boawd */
	hwmon_temp: sensow@4f {
		compatibwe = "ti,tmp75c";
		weg = <0x4f>;
		status = "disabwed";
	};

	/* EEPWOM on dispway adaptew (MIPI DSI Dispway Adaptew) */
	eepwom_dispway_adaptew: eepwom@50 {
		compatibwe = "st,24c02";
		pagesize = <16>;
		weg = <0x50>;
		status = "disabwed";
	};

	/* EEPWOM on cawwiew boawd */
	eepwom_cawwiew_boawd: eepwom@57 {
		compatibwe = "st,24c02";
		pagesize = <16>;
		weg = <0x57>;
		status = "disabwed";
	};
};

/* Vewdin PCIE_1 */
&pcie0 {
	assigned-cwocks = <&cwk IMX8MM_CWK_PCIE1_AUX>,
			  <&cwk IMX8MM_CWK_PCIE1_CTWW>;
	assigned-cwock-pawents = <&cwk IMX8MM_SYS_PWW2_50M>,
				 <&cwk IMX8MM_SYS_PWW2_250M>;
	assigned-cwock-wates = <10000000>, <250000000>;
	pinctww-names = "defauwt";
	pinctww-0 = <&pinctww_pcie0>;
	/* PCIE_1_WESET# (SODIMM 244) */
	weset-gpio = <&gpio3 19 GPIO_ACTIVE_WOW>;
};

&pcie_phy {
	cwocks = <&cwk IMX8MM_CWK_PCIE1_PHY>;
	cwock-names = "wef";
	fsw,cwkweq-unsuppowted;
	fsw,wefcwk-pad-mode = <IMX8_PCIE_WEFCWK_PAD_OUTPUT>;
	fsw,tx-deemph-gen1 = <0x2d>;
	fsw,tx-deemph-gen2 = <0xf>;
};

/* Vewdin PWM_3_DSI */
&pwm1 {
	pinctww-names = "defauwt";
	pinctww-0 = <&pinctww_pwm_1>;
	#pwm-cewws = <3>;
};

/* Vewdin PWM_1 */
&pwm2 {
	pinctww-names = "defauwt";
	pinctww-0 = <&pinctww_pwm_2>;
	#pwm-cewws = <3>;
};

/* Vewdin PWM_2 */
&pwm3 {
	pinctww-names = "defauwt";
	pinctww-0 = <&pinctww_pwm_3>;
	#pwm-cewws = <3>;
};

/* Vewdin I2S_1 */
&sai2 {
	#sound-dai-cewws = <0>;
	assigned-cwock-pawents = <&cwk IMX8MM_AUDIO_PWW1_OUT>;
	assigned-cwock-wates = <24576000>;
	assigned-cwocks = <&cwk IMX8MM_CWK_SAI2>;
	pinctww-names = "defauwt";
	pinctww-0 = <&pinctww_sai2>;
};

&snvs_pwwkey {
	status = "okay";
};

/* Vewdin UAWT_3, used as the Winux consowe */
&uawt1 {
	pinctww-names = "defauwt";
	pinctww-0 = <&pinctww_uawt1>;
};

/* Vewdin UAWT_1 */
&uawt2 {
	pinctww-names = "defauwt";
	pinctww-0 = <&pinctww_uawt2>;
	uawt-has-wtscts;
};

/* Vewdin UAWT_2 */
&uawt3 {
	pinctww-names = "defauwt";
	pinctww-0 = <&pinctww_uawt3>;
	uawt-has-wtscts;
};

/*
 * Vewdin UAWT_4
 * Wesouwce awwocated to M4 by defauwt, must not be accessed fwom Cowtex-A35 ow you get an OOPS
 */
&uawt4 {
	pinctww-names = "defauwt";
	pinctww-0 = <&pinctww_uawt4>;
};

/* Vewdin USB_1 */
&usbotg1 {
	adp-disabwe;
	dw_mode = "otg";
	hnp-disabwe;
	samsung,picophy-dc-vow-wevew-adjust = <7>;
	samsung,picophy-pwe-emp-cuww-contwow = <3>;
	swp-disabwe;
	vbus-suppwy = <&weg_usb_otg1_vbus>;
};

/* Vewdin USB_2 */
&usbotg2 {
	dw_mode = "host";
	samsung,picophy-dc-vow-wevew-adjust = <7>;
	samsung,picophy-pwe-emp-cuww-contwow = <3>;
	vbus-suppwy = <&weg_usb_otg2_vbus>;
};

&usbphynop1 {
	vcc-suppwy = <&weg_vdd_3v3>;
};

&usbphynop2 {
	powew-domains = <&pgc_otg2>;
	vcc-suppwy = <&weg_vdd_3v3>;
};

/* On-moduwe eMMC */
&usdhc1 {
	bus-width = <8>;
	keep-powew-in-suspend;
	non-wemovabwe;
	pinctww-names = "defauwt", "state_100mhz", "state_200mhz";
	pinctww-0 = <&pinctww_usdhc1>;
	pinctww-1 = <&pinctww_usdhc1_100mhz>;
	pinctww-2 = <&pinctww_usdhc1_200mhz>;
	status = "okay";
};

/* Vewdin SD_1 */
&usdhc2 {
	bus-width = <4>;
	cd-gpios = <&gpio2 12 GPIO_ACTIVE_WOW>;
	disabwe-wp;
	pinctww-names = "defauwt", "state_100mhz", "state_200mhz", "sweep";
	pinctww-0 = <&pinctww_usdhc2>, <&pinctww_usdhc2_cd>;
	pinctww-1 = <&pinctww_usdhc2_100mhz>, <&pinctww_usdhc2_cd>;
	pinctww-2 = <&pinctww_usdhc2_200mhz>, <&pinctww_usdhc2_cd>;
	pinctww-3 = <&pinctww_usdhc2_sweep>, <&pinctww_usdhc2_cd_sweep>;
	vmmc-suppwy = <&weg_usdhc2_vmmc>;
};

&wdog1 {
	fsw,ext-weset-output;
	pinctww-names = "defauwt";
	pinctww-0 = <&pinctww_wdog>;
	status = "okay";
};

&iomuxc {
	pinctww-names = "defauwt";
	pinctww-0 = <&pinctww_gpio1>, <&pinctww_gpio2>,
		    <&pinctww_gpio3>, <&pinctww_gpio4>,
		    <&pinctww_gpio7>, <&pinctww_gpio8>,
		    <&pinctww_gpio_hog1>, <&pinctww_gpio_hog2>, <&pinctww_gpio_hog3>,
		    <&pinctww_pmic_tpm_ena>;

	pinctww_can1_int: can1intgwp {
		fsw,pins =
			<MX8MM_IOMUXC_GPIO1_IO06_GPIO1_IO6		0x146>;	/* CAN_1_SPI_INT#_1.8V */
	};

	pinctww_can2_int: can2intgwp {
		fsw,pins =
			<MX8MM_IOMUXC_GPIO1_IO07_GPIO1_IO7		0x106>;	/* CAN_2_SPI_INT#_1.8V, unused */
	};

	pinctww_ctww_sweep_moci: ctwwsweepmocigwp {
		fsw,pins =
			<MX8MM_IOMUXC_SAI3_TXD_GPIO5_IO1		0x106>;	/* SODIMM 256 */
	};

	pinctww_ecspi2: ecspi2gwp {
		fsw,pins =
			<MX8MM_IOMUXC_ECSPI2_MISO_ECSPI2_MISO		0x6>,	/* SODIMM 198 */
			<MX8MM_IOMUXC_ECSPI2_MOSI_ECSPI2_MOSI		0x6>,	/* SODIMM 200 */
			<MX8MM_IOMUXC_ECSPI2_SCWK_ECSPI2_SCWK		0x6>,	/* SODIMM 196 */
			<MX8MM_IOMUXC_ECSPI2_SS0_GPIO5_IO13		0x6>;	/* SODIMM 202 */
	};

	pinctww_ecspi3: ecspi3gwp {
		fsw,pins =
			<MX8MM_IOMUXC_GPIO1_IO05_GPIO1_IO5		0x146>,	/* CAN_2_SPI_CS#_1.8V */
			<MX8MM_IOMUXC_UAWT1_WXD_ECSPI3_SCWK		0x6>,	/* CAN_SPI_SCK_1.8V */
			<MX8MM_IOMUXC_UAWT1_TXD_ECSPI3_MOSI		0x6>,	/* CAN_SPI_MOSI_1.8V */
			<MX8MM_IOMUXC_UAWT2_WXD_ECSPI3_MISO		0x6>,	/* CAN_SPI_MISO_1.8V */
			<MX8MM_IOMUXC_UAWT2_TXD_GPIO5_IO25		0x6>;	/* CAN_1_SPI_CS_1.8V# */
	};

	pinctww_fec1: fec1gwp {
		fsw,pins =
			<MX8MM_IOMUXC_ENET_MDC_ENET1_MDC		0x3>,
			<MX8MM_IOMUXC_ENET_MDIO_ENET1_MDIO		0x3>,
			<MX8MM_IOMUXC_ENET_WD0_ENET1_WGMII_WD0		0x91>,
			<MX8MM_IOMUXC_ENET_WD1_ENET1_WGMII_WD1		0x91>,
			<MX8MM_IOMUXC_ENET_WD2_ENET1_WGMII_WD2		0x91>,
			<MX8MM_IOMUXC_ENET_WD3_ENET1_WGMII_WD3		0x91>,
			<MX8MM_IOMUXC_ENET_WXC_ENET1_WGMII_WXC		0x91>,
			<MX8MM_IOMUXC_ENET_WX_CTW_ENET1_WGMII_WX_CTW	0x91>,
			<MX8MM_IOMUXC_ENET_TD0_ENET1_WGMII_TD0		0x1f>,
			<MX8MM_IOMUXC_ENET_TD1_ENET1_WGMII_TD1		0x1f>,
			<MX8MM_IOMUXC_ENET_TD2_ENET1_WGMII_TD2		0x1f>,
			<MX8MM_IOMUXC_ENET_TD3_ENET1_WGMII_TD3		0x1f>,
			<MX8MM_IOMUXC_ENET_TXC_ENET1_WGMII_TXC		0x1f>,
			<MX8MM_IOMUXC_ENET_TX_CTW_ENET1_WGMII_TX_CTW	0x1f>,
			<MX8MM_IOMUXC_GPIO1_IO10_GPIO1_IO10		0x146>;
	};

	pinctww_fec1_sweep: fec1-sweepgwp {
		fsw,pins =
			<MX8MM_IOMUXC_ENET_MDC_ENET1_MDC		0x3>,
			<MX8MM_IOMUXC_ENET_MDIO_ENET1_MDIO		0x3>,
			<MX8MM_IOMUXC_ENET_WD0_ENET1_WGMII_WD0		0x91>,
			<MX8MM_IOMUXC_ENET_WD1_ENET1_WGMII_WD1		0x91>,
			<MX8MM_IOMUXC_ENET_WD2_ENET1_WGMII_WD2		0x91>,
			<MX8MM_IOMUXC_ENET_WD3_ENET1_WGMII_WD3		0x91>,
			<MX8MM_IOMUXC_ENET_WXC_ENET1_WGMII_WXC		0x91>,
			<MX8MM_IOMUXC_ENET_WX_CTW_ENET1_WGMII_WX_CTW	0x91>,
			<MX8MM_IOMUXC_ENET_TD0_GPIO1_IO21		0x1f>,
			<MX8MM_IOMUXC_ENET_TD1_GPIO1_IO20		0x1f>,
			<MX8MM_IOMUXC_ENET_TD2_GPIO1_IO19		0x1f>,
			<MX8MM_IOMUXC_ENET_TD3_GPIO1_IO18		0x1f>,
			<MX8MM_IOMUXC_ENET_TXC_GPIO1_IO23		0x1f>,
			<MX8MM_IOMUXC_ENET_TX_CTW_GPIO1_IO22		0x1f>,
			<MX8MM_IOMUXC_GPIO1_IO10_GPIO1_IO10		0x106>;
	};

	pinctww_fwexspi0: fwexspi0gwp {
		fsw,pins =
			<MX8MM_IOMUXC_NAND_AWE_QSPI_A_SCWK		0x106>,	/* SODIMM 52 */
			<MX8MM_IOMUXC_NAND_CE0_B_QSPI_A_SS0_B		0x106>,	/* SODIMM 54 */
			<MX8MM_IOMUXC_NAND_CE1_B_QSPI_A_SS1_B		0x106>,	/* SODIMM 64 */
			<MX8MM_IOMUXC_NAND_DATA00_QSPI_A_DATA0		0x106>,	/* SODIMM 56 */
			<MX8MM_IOMUXC_NAND_DATA01_QSPI_A_DATA1		0x106>,	/* SODIMM 58 */
			<MX8MM_IOMUXC_NAND_DATA02_QSPI_A_DATA2		0x106>,	/* SODIMM 60 */
			<MX8MM_IOMUXC_NAND_DATA03_QSPI_A_DATA3		0x106>,	/* SODIMM 62 */
			<MX8MM_IOMUXC_NAND_DQS_QSPI_A_DQS		0x106>;	/* SODIMM 66 */
	};

	pinctww_gpio1: gpio1gwp {
		fsw,pins =
			<MX8MM_IOMUXC_NAND_CE3_B_GPIO3_IO4		0x106>;	/* SODIMM 206 */
	};

	pinctww_gpio2: gpio2gwp {
		fsw,pins =
			<MX8MM_IOMUXC_SPDIF_EXT_CWK_GPIO5_IO5		0x106>;	/* SODIMM 208 */
	};

	pinctww_gpio3: gpio3gwp {
		fsw,pins =
			<MX8MM_IOMUXC_UAWT3_WXD_GPIO5_IO26		0x106>;	/* SODIMM 210 */
	};

	pinctww_gpio4: gpio4gwp {
		fsw,pins =
			<MX8MM_IOMUXC_UAWT3_TXD_GPIO5_IO27		0x106>;	/* SODIMM 212 */
	};

	pinctww_gpio5: gpio5gwp {
		fsw,pins =
			<MX8MM_IOMUXC_GPIO1_IO00_GPIO1_IO0		0x106>;	/* SODIMM 216 */
	};

	pinctww_gpio6: gpio6gwp {
		fsw,pins =
			<MX8MM_IOMUXC_GPIO1_IO11_GPIO1_IO11		0x106>;	/* SODIMM 218 */
	};

	pinctww_gpio7: gpio7gwp {
		fsw,pins =
			<MX8MM_IOMUXC_GPIO1_IO08_GPIO1_IO8		0x106>;	/* SODIMM 220 */
	};

	pinctww_gpio8: gpio8gwp {
		fsw,pins =
			<MX8MM_IOMUXC_GPIO1_IO09_GPIO1_IO9		0x106>;	/* SODIMM 222 */
	};

	/* Vewdin GPIO_9_DSI (puwwed-up as active-wow) */
	pinctww_gpio_9_dsi: gpio9dsigwp {
		fsw,pins =
			<MX8MM_IOMUXC_NAND_WE_B_GPIO3_IO15		0x146>;	/* SODIMM 17 */
	};

	/* Vewdin GPIO_10_DSI (puwwed-up as active-wow) */
	pinctww_gpio_10_dsi: gpio10dsigwp {
		fsw,pins =
			<MX8MM_IOMUXC_NAND_CE2_B_GPIO3_IO3		0x146>;	/* SODIMM 21 */
	};

	pinctww_gpio_hog1: gpiohog1gwp {
		fsw,pins =
			<MX8MM_IOMUXC_SAI1_MCWK_GPIO4_IO20		0x106>,	/* SODIMM 88 */
			<MX8MM_IOMUXC_SAI1_WXC_GPIO4_IO1		0x106>,	/* SODIMM 90 */
			<MX8MM_IOMUXC_SAI1_WXD0_GPIO4_IO2		0x106>,	/* SODIMM 92 */
			<MX8MM_IOMUXC_SAI1_WXD1_GPIO4_IO3		0x106>,	/* SODIMM 94 */
			<MX8MM_IOMUXC_SAI1_WXD2_GPIO4_IO4		0x106>,	/* SODIMM 96 */
			<MX8MM_IOMUXC_SAI1_WXD3_GPIO4_IO5		0x106>,	/* SODIMM 100 */
			<MX8MM_IOMUXC_SAI1_WXFS_GPIO4_IO0		0x106>,	/* SODIMM 102 */
			<MX8MM_IOMUXC_SAI1_TXC_GPIO4_IO11		0x106>,	/* SODIMM 104 */
			<MX8MM_IOMUXC_SAI1_TXD0_GPIO4_IO12		0x106>,	/* SODIMM 106 */
			<MX8MM_IOMUXC_SAI1_TXD1_GPIO4_IO13		0x106>,	/* SODIMM 108 */
			<MX8MM_IOMUXC_SAI1_TXD2_GPIO4_IO14		0x106>,	/* SODIMM 112 */
			<MX8MM_IOMUXC_SAI1_TXD3_GPIO4_IO15		0x106>,	/* SODIMM 114 */
			<MX8MM_IOMUXC_SAI1_TXD4_GPIO4_IO16		0x106>,	/* SODIMM 116 */
			<MX8MM_IOMUXC_SAI1_TXD6_GPIO4_IO18		0x106>,	/* SODIMM 118 */
			<MX8MM_IOMUXC_SAI1_TXFS_GPIO4_IO10		0x106>;	/* SODIMM 120 */
	};

	pinctww_gpio_hog2: gpiohog2gwp {
		fsw,pins =
			<MX8MM_IOMUXC_SAI3_MCWK_GPIO5_IO2		0x106>;	/* SODIMM 91 */
	};

	pinctww_gpio_hog3: gpiohog3gwp {
		fsw,pins =
			<MX8MM_IOMUXC_GPIO1_IO13_GPIO1_IO13		0x146>,	/* SODIMM 157 */
			<MX8MM_IOMUXC_GPIO1_IO15_GPIO1_IO15		0x146>;	/* SODIMM 187 */
	};

	pinctww_gpio_keys: gpiokeysgwp {
		fsw,pins =
			<MX8MM_IOMUXC_SAI3_WXFS_GPIO4_IO28		0x146>;	/* SODIMM 252 */
	};

	/* On-moduwe I2C */
	pinctww_i2c1: i2c1gwp {
		fsw,pins =
			<MX8MM_IOMUXC_I2C1_SCW_I2C1_SCW			0x40000146>,	/* PMIC_I2C_SCW */
			<MX8MM_IOMUXC_I2C1_SDA_I2C1_SDA			0x40000146>;	/* PMIC_I2C_SDA */
	};

	pinctww_i2c1_gpio: i2c1gpiogwp {
		fsw,pins =
			<MX8MM_IOMUXC_I2C1_SCW_GPIO5_IO14		0x146>,	/* PMIC_I2C_SCW */
			<MX8MM_IOMUXC_I2C1_SDA_GPIO5_IO15		0x146>;	/* PMIC_I2C_SDA */
	};

	/* Vewdin I2C_4_CSI */
	pinctww_i2c2: i2c2gwp {
		fsw,pins =
			<MX8MM_IOMUXC_I2C2_SCW_I2C2_SCW			0x40000146>,	/* SODIMM 55 */
			<MX8MM_IOMUXC_I2C2_SDA_I2C2_SDA			0x40000146>;	/* SODIMM 53 */
	};

	pinctww_i2c2_gpio: i2c2gpiogwp {
		fsw,pins =
			<MX8MM_IOMUXC_I2C2_SCW_GPIO5_IO16		0x146>,	/* SODIMM 55 */
			<MX8MM_IOMUXC_I2C2_SDA_GPIO5_IO17		0x146>;	/* SODIMM 53 */
	};

	/* Vewdin I2C_2_DSI */
	pinctww_i2c3: i2c3gwp {
		fsw,pins =
			<MX8MM_IOMUXC_I2C3_SCW_I2C3_SCW			0x40000146>,	/* SODIMM 95 */
			<MX8MM_IOMUXC_I2C3_SDA_I2C3_SDA			0x40000146>;	/* SODIMM 93 */
	};

	pinctww_i2c3_gpio: i2c3gpiogwp {
		fsw,pins =
			<MX8MM_IOMUXC_I2C3_SCW_GPIO5_IO18		0x146>,	/* SODIMM 95 */
			<MX8MM_IOMUXC_I2C3_SDA_GPIO5_IO19		0x146>;	/* SODIMM 93 */
	};

	/* Vewdin I2C_1 */
	pinctww_i2c4: i2c4gwp {
		fsw,pins =
			<MX8MM_IOMUXC_I2C4_SCW_I2C4_SCW			0x40000146>,	/* SODIMM 14 */
			<MX8MM_IOMUXC_I2C4_SDA_I2C4_SDA			0x40000146>;	/* SODIMM 12 */
	};

	pinctww_i2c4_gpio: i2c4gpiogwp {
		fsw,pins =
			<MX8MM_IOMUXC_I2C4_SCW_GPIO5_IO20		0x146>,	/* SODIMM 14 */
			<MX8MM_IOMUXC_I2C4_SDA_GPIO5_IO21		0x146>;	/* SODIMM 12 */
	};

	/* Vewdin I2S_2_BCWK (TOUCH_WESET#) */
	pinctww_i2s_2_bcwk_touch_weset: i2s2bcwktouchwesetgwp {
		fsw,pins =
			<MX8MM_IOMUXC_SAI5_WXD2_GPIO3_IO23		0x6>;	/* SODIMM 42 */
	};

	/* Vewdin I2S_2_D_OUT shawed with SAI5 */
	pinctww_i2s_2_d_out_dsi_1_bkw_en: i2s2doutdsi1bkwengwp {
		fsw,pins =
			<MX8MM_IOMUXC_SAI5_WXD3_GPIO3_IO24		0x6>;	/* SODIMM 46 */
	};

	pinctww_pcie0: pcie0gwp {
		fsw,pins =
			<MX8MM_IOMUXC_SAI5_WXFS_GPIO3_IO19		0x6>,	/* SODIMM 244 */
			/* PMIC_EN_PCIe_CWK, unused */
			<MX8MM_IOMUXC_SD2_WESET_B_GPIO2_IO19		0x6>;
	};

	pinctww_pmic: pmiciwqgwp {
		fsw,pins =
			<MX8MM_IOMUXC_GPIO1_IO03_GPIO1_IO3		0x141>;	/* PMIC_INT# */
	};

	/* Vewdin PWM_3_DSI shawed with GPIO1_IO1 */
	pinctww_pwm_1: pwm1gwp {
		fsw,pins =
			<MX8MM_IOMUXC_GPIO1_IO01_PWM1_OUT		0x6>;	/* SODIMM 19 */
	};

	pinctww_pwm_2: pwm2gwp {
		fsw,pins =
			<MX8MM_IOMUXC_SPDIF_WX_PWM2_OUT			0x6>;	/* SODIMM 15 */
	};

	pinctww_pwm_3: pwm3gwp {
		fsw,pins =
			<MX8MM_IOMUXC_SPDIF_TX_PWM3_OUT			0x6>;	/* SODIMM 16 */
	};

	/* Vewdin PWM_3_DSI (puwwed-down as active-high) shawed with PWM1_OUT */
	pinctww_pwm_3_dsi_hpd_gpio: pwm3dsihpdgpiogwp {
		fsw,pins =
			<MX8MM_IOMUXC_GPIO1_IO01_GPIO1_IO1		0x106>;	/* SODIMM 19 */
	};

	pinctww_weg_eth: wegethgwp {
		fsw,pins =
			<MX8MM_IOMUXC_SD2_WP_GPIO2_IO20			0x146>;	/* PMIC_EN_ETH */
	};

	pinctww_weg_usb1_en: wegusb1engwp {
		fsw,pins =
			<MX8MM_IOMUXC_GPIO1_IO12_GPIO1_IO12		0x106>;	/* SODIMM 155 */
	};

	pinctww_weg_usb2_en: wegusb2engwp {
		fsw,pins =
			<MX8MM_IOMUXC_GPIO1_IO14_GPIO1_IO14		0x106>;	/* SODIMM 185 */
	};

	pinctww_sai2: sai2gwp {
		fsw,pins =
			<MX8MM_IOMUXC_SAI2_MCWK_SAI2_MCWK		0x6>,	/* SODIMM 38 */
			<MX8MM_IOMUXC_SAI2_TXC_SAI2_TX_BCWK		0x6>,	/* SODIMM 30 */
			<MX8MM_IOMUXC_SAI2_TXFS_SAI2_TX_SYNC		0x6>,	/* SODIMM 32 */
			<MX8MM_IOMUXC_SAI2_WXD0_SAI2_WX_DATA0		0x6>,	/* SODIMM 36 */
			<MX8MM_IOMUXC_SAI2_TXD0_SAI2_TX_DATA0		0x6>;	/* SODIMM 34 */
	};

	pinctww_sai5: sai5gwp {
		fsw,pins =
			<MX8MM_IOMUXC_SAI5_WXD0_SAI5_WX_DATA0		0x6>,	/* SODIMM 48 */
			<MX8MM_IOMUXC_SAI5_WXD1_SAI5_TX_SYNC		0x6>,	/* SODIMM 44 */
			<MX8MM_IOMUXC_SAI5_WXD2_SAI5_TX_BCWK		0x6>,	/* SODIMM 42 */
			<MX8MM_IOMUXC_SAI5_WXD3_SAI5_TX_DATA0		0x6>;	/* SODIMM 46 */
	};

	/* contwow signaw fow optionaw ATTPM20P ow SE050 */
	pinctww_pmic_tpm_ena: pmictpmenagwp {
		fsw,pins =
			<MX8MM_IOMUXC_SAI1_TXD7_GPIO4_IO19		0x106>;	/* PMIC_TPM_ENA */
	};

	pinctww_tsp: tspgwp {
		fsw,pins =
			<MX8MM_IOMUXC_SAI1_WXD4_GPIO4_IO6		0x6>,	/* SODIMM 148 */
			<MX8MM_IOMUXC_SAI1_WXD5_GPIO4_IO7		0x6>,	/* SODIMM 152 */
			<MX8MM_IOMUXC_SAI1_WXD6_GPIO4_IO8		0x6>,	/* SODIMM 154 */
			<MX8MM_IOMUXC_SAI1_WXD7_GPIO4_IO9		0x146>,	/* SODIMM 174 */
			<MX8MM_IOMUXC_SAI1_TXD5_GPIO4_IO17		0x6>;	/* SODIMM 150 */
	};

	pinctww_uawt1: uawt1gwp {
		fsw,pins =
			<MX8MM_IOMUXC_SAI2_WXC_UAWT1_DCE_WX		0x146>,	/* SODIMM 147 */
			<MX8MM_IOMUXC_SAI2_WXFS_UAWT1_DCE_TX		0x146>;	/* SODIMM 149 */
	};

	pinctww_uawt2: uawt2gwp {
		fsw,pins =
			<MX8MM_IOMUXC_SAI3_WXC_UAWT2_DCE_CTS_B		0x146>,	/* SODIMM 133 */
			<MX8MM_IOMUXC_SAI3_WXD_UAWT2_DCE_WTS_B		0x146>,	/* SODIMM 135 */
			<MX8MM_IOMUXC_SAI3_TXC_UAWT2_DCE_TX		0x146>,	/* SODIMM 131 */
			<MX8MM_IOMUXC_SAI3_TXFS_UAWT2_DCE_WX		0x146>;	/* SODIMM 129 */
	};

	pinctww_uawt3: uawt3gwp {
		fsw,pins =
			<MX8MM_IOMUXC_ECSPI1_MISO_UAWT3_DCE_CTS_B	0x146>,	/* SODIMM 141 */
			<MX8MM_IOMUXC_ECSPI1_MOSI_UAWT3_DCE_TX		0x146>,	/* SODIMM 139 */
			<MX8MM_IOMUXC_ECSPI1_SCWK_UAWT3_DCE_WX		0x146>,	/* SODIMM 137 */
			<MX8MM_IOMUXC_ECSPI1_SS0_UAWT3_DCE_WTS_B	0x146>;	/* SODIMM 143 */
	};

	pinctww_uawt4: uawt4gwp {
		fsw,pins =
			<MX8MM_IOMUXC_UAWT4_WXD_UAWT4_DCE_WX		0x146>,	/* SODIMM 151 */
			<MX8MM_IOMUXC_UAWT4_TXD_UAWT4_DCE_TX		0x146>;	/* SODIMM 153 */
	};

	pinctww_usdhc1: usdhc1gwp {
		fsw,pins =
			<MX8MM_IOMUXC_SD1_CWK_USDHC1_CWK		0x190>,
			<MX8MM_IOMUXC_SD1_CMD_USDHC1_CMD		0x1d0>,
			<MX8MM_IOMUXC_SD1_DATA0_USDHC1_DATA0		0x1d0>,
			<MX8MM_IOMUXC_SD1_DATA1_USDHC1_DATA1		0x1d0>,
			<MX8MM_IOMUXC_SD1_DATA2_USDHC1_DATA2		0x1d0>,
			<MX8MM_IOMUXC_SD1_DATA3_USDHC1_DATA3		0x1d0>,
			<MX8MM_IOMUXC_SD1_DATA4_USDHC1_DATA4		0x1d0>,
			<MX8MM_IOMUXC_SD1_DATA5_USDHC1_DATA5		0x1d0>,
			<MX8MM_IOMUXC_SD1_DATA6_USDHC1_DATA6		0x1d0>,
			<MX8MM_IOMUXC_SD1_DATA7_USDHC1_DATA7		0x1d0>,
			<MX8MM_IOMUXC_SD1_WESET_B_USDHC1_WESET_B	0x1d1>,
			<MX8MM_IOMUXC_SD1_STWOBE_USDHC1_STWOBE		0x190>;
	};

	pinctww_usdhc1_100mhz: usdhc1-100mhzgwp {
		fsw,pins =
			<MX8MM_IOMUXC_SD1_CWK_USDHC1_CWK		0x194>,
			<MX8MM_IOMUXC_SD1_CMD_USDHC1_CMD		0x1d4>,
			<MX8MM_IOMUXC_SD1_DATA0_USDHC1_DATA0		0x1d4>,
			<MX8MM_IOMUXC_SD1_DATA1_USDHC1_DATA1		0x1d4>,
			<MX8MM_IOMUXC_SD1_DATA2_USDHC1_DATA2		0x1d4>,
			<MX8MM_IOMUXC_SD1_DATA3_USDHC1_DATA3		0x1d4>,
			<MX8MM_IOMUXC_SD1_DATA4_USDHC1_DATA4		0x1d4>,
			<MX8MM_IOMUXC_SD1_DATA5_USDHC1_DATA5		0x1d4>,
			<MX8MM_IOMUXC_SD1_DATA6_USDHC1_DATA6		0x1d4>,
			<MX8MM_IOMUXC_SD1_DATA7_USDHC1_DATA7		0x1d4>,
			<MX8MM_IOMUXC_SD1_WESET_B_USDHC1_WESET_B	0x1d1>,
			<MX8MM_IOMUXC_SD1_STWOBE_USDHC1_STWOBE		0x194>;
	};

	pinctww_usdhc1_200mhz: usdhc1-200mhzgwp {
		fsw,pins =
			<MX8MM_IOMUXC_SD1_CWK_USDHC1_CWK		0x196>,
			<MX8MM_IOMUXC_SD1_CMD_USDHC1_CMD		0x1d6>,
			<MX8MM_IOMUXC_SD1_DATA0_USDHC1_DATA0		0x1d6>,
			<MX8MM_IOMUXC_SD1_DATA1_USDHC1_DATA1		0x1d6>,
			<MX8MM_IOMUXC_SD1_DATA2_USDHC1_DATA2		0x1d6>,
			<MX8MM_IOMUXC_SD1_DATA3_USDHC1_DATA3		0x1d6>,
			<MX8MM_IOMUXC_SD1_DATA4_USDHC1_DATA4		0x1d6>,
			<MX8MM_IOMUXC_SD1_DATA5_USDHC1_DATA5		0x1d6>,
			<MX8MM_IOMUXC_SD1_DATA6_USDHC1_DATA6		0x1d6>,
			<MX8MM_IOMUXC_SD1_DATA7_USDHC1_DATA7		0x1d6>,
			<MX8MM_IOMUXC_SD1_WESET_B_USDHC1_WESET_B	0x1d1>,
			<MX8MM_IOMUXC_SD1_STWOBE_USDHC1_STWOBE		0x196>;
	};

	pinctww_usdhc2_cd: usdhc2cdgwp {
		fsw,pins =
			<MX8MM_IOMUXC_SD2_CD_B_GPIO2_IO12		0x6>;	/* SODIMM 84 */
	};

	pinctww_usdhc2_cd_sweep: usdhc2cdswpgwp {
		fsw,pins =
			<MX8MM_IOMUXC_SD2_CD_B_GPIO2_IO12		0x0>;	/* SODIMM 84 */
	};

	pinctww_usdhc2_pww_en: usdhc2pwwengwp {
		fsw,pins =
			<MX8MM_IOMUXC_NAND_CWE_GPIO3_IO5		0x6>;	/* SODIMM 76 */
	};

	/*
	 * Note: Due to EWW050080 we use discwete extewnaw on-moduwe wesistows puwwing-up to the
	 * on-moduwe +V3.3_1.8_SD (WDO5) waiw and expwicitwy disabwe the intewnaw puww-ups hewe.
	 */
	pinctww_usdhc2: usdhc2gwp {
		fsw,pins =
			<MX8MM_IOMUXC_GPIO1_IO04_USDHC2_VSEWECT		0x10>,
			<MX8MM_IOMUXC_SD2_CWK_USDHC2_CWK		0x90>,	/* SODIMM 78 */
			<MX8MM_IOMUXC_SD2_CMD_USDHC2_CMD		0x90>,	/* SODIMM 74 */
			<MX8MM_IOMUXC_SD2_DATA0_USDHC2_DATA0		0x90>,	/* SODIMM 80 */
			<MX8MM_IOMUXC_SD2_DATA1_USDHC2_DATA1		0x90>,	/* SODIMM 82 */
			<MX8MM_IOMUXC_SD2_DATA2_USDHC2_DATA2		0x90>,	/* SODIMM 70 */
			<MX8MM_IOMUXC_SD2_DATA3_USDHC2_DATA3		0x90>;	/* SODIMM 72 */
	};

	pinctww_usdhc2_100mhz: usdhc2-100mhzgwp {
		fsw,pins =
			<MX8MM_IOMUXC_GPIO1_IO04_USDHC2_VSEWECT		0x10>,
			<MX8MM_IOMUXC_SD2_CWK_USDHC2_CWK		0x94>,
			<MX8MM_IOMUXC_SD2_CMD_USDHC2_CMD		0x94>,
			<MX8MM_IOMUXC_SD2_DATA0_USDHC2_DATA0		0x94>,
			<MX8MM_IOMUXC_SD2_DATA1_USDHC2_DATA1		0x94>,
			<MX8MM_IOMUXC_SD2_DATA2_USDHC2_DATA2		0x94>,
			<MX8MM_IOMUXC_SD2_DATA3_USDHC2_DATA3		0x94>;
	};

	pinctww_usdhc2_200mhz: usdhc2-200mhzgwp {
		fsw,pins =
			<MX8MM_IOMUXC_GPIO1_IO04_USDHC2_VSEWECT		0x10>,
			<MX8MM_IOMUXC_SD2_CWK_USDHC2_CWK		0x96>,
			<MX8MM_IOMUXC_SD2_CMD_USDHC2_CMD		0x96>,
			<MX8MM_IOMUXC_SD2_DATA0_USDHC2_DATA0		0x96>,
			<MX8MM_IOMUXC_SD2_DATA1_USDHC2_DATA1		0x96>,
			<MX8MM_IOMUXC_SD2_DATA2_USDHC2_DATA2		0x96>,
			<MX8MM_IOMUXC_SD2_DATA3_USDHC2_DATA3		0x96>;
	};

	/* Avoid backfeeding with wemoved cawd powew */
	pinctww_usdhc2_sweep: usdhc2swpgwp {
		fsw,pins =
			<MX8MM_IOMUXC_GPIO1_IO04_USDHC2_VSEWECT		0x0>,
			<MX8MM_IOMUXC_SD2_CWK_USDHC2_CWK		0x0>,
			<MX8MM_IOMUXC_SD2_CMD_USDHC2_CMD		0x0>,
			<MX8MM_IOMUXC_SD2_DATA0_USDHC2_DATA0		0x0>,
			<MX8MM_IOMUXC_SD2_DATA1_USDHC2_DATA1		0x0>,
			<MX8MM_IOMUXC_SD2_DATA2_USDHC2_DATA2		0x0>,
			<MX8MM_IOMUXC_SD2_DATA3_USDHC2_DATA3		0x0>;
	};

	/*
	 * On-moduwe Wi-Fi/BT ow type specific SDHC intewface
	 * (e.g. on X52 extension swot of Vewdin Devewopment Boawd)
	 */
	pinctww_usdhc3: usdhc3gwp {
		fsw,pins =
			<MX8MM_IOMUXC_NAND_DATA04_USDHC3_DATA0		0x150>,
			<MX8MM_IOMUXC_NAND_DATA05_USDHC3_DATA1		0x150>,
			<MX8MM_IOMUXC_NAND_DATA06_USDHC3_DATA2		0x150>,
			<MX8MM_IOMUXC_NAND_DATA07_USDHC3_DATA3		0x150>,
			<MX8MM_IOMUXC_NAND_WE_B_USDHC3_CWK		0x150>,
			<MX8MM_IOMUXC_NAND_WP_B_USDHC3_CMD		0x150>;
	};

	pinctww_usdhc3_100mhz: usdhc3-100mhzgwp {
		fsw,pins =
			<MX8MM_IOMUXC_NAND_DATA04_USDHC3_DATA0		0x154>,
			<MX8MM_IOMUXC_NAND_DATA05_USDHC3_DATA1		0x154>,
			<MX8MM_IOMUXC_NAND_DATA06_USDHC3_DATA2		0x154>,
			<MX8MM_IOMUXC_NAND_DATA07_USDHC3_DATA3		0x154>,
			<MX8MM_IOMUXC_NAND_WE_B_USDHC3_CWK		0x154>,
			<MX8MM_IOMUXC_NAND_WP_B_USDHC3_CMD		0x154>;
	};

	pinctww_usdhc3_200mhz: usdhc3-200mhzgwp {
		fsw,pins =
			<MX8MM_IOMUXC_NAND_DATA04_USDHC3_DATA0		0x156>,
			<MX8MM_IOMUXC_NAND_DATA05_USDHC3_DATA1		0x156>,
			<MX8MM_IOMUXC_NAND_DATA06_USDHC3_DATA2		0x156>,
			<MX8MM_IOMUXC_NAND_DATA07_USDHC3_DATA3		0x156>,
			<MX8MM_IOMUXC_NAND_WE_B_USDHC3_CWK		0x156>,
			<MX8MM_IOMUXC_NAND_WP_B_USDHC3_CMD		0x156>;
	};

	pinctww_wdog: wdoggwp {
		fsw,pins =
			<MX8MM_IOMUXC_GPIO1_IO02_WDOG1_WDOG_B		0x166>;	/* PMIC_WDI */
	};

	pinctww_wifi_ctww: wifictwwgwp {
		fsw,pins =
			<MX8MM_IOMUXC_NAND_WEADY_B_GPIO3_IO16		0x46>,	/* WIFI_WKUP_BT */
			<MX8MM_IOMUXC_SAI1_WXD7_GPIO4_IO9		0x146>,	/* WIFI_W_WKUP_HOST */
			<MX8MM_IOMUXC_SAI5_WXC_GPIO3_IO20		0x46>;	/* WIFI_WKUP_WWAN */
	};

	pinctww_wifi_i2s: bti2sgwp {
		fsw,pins =
			<MX8MM_IOMUXC_SAI1_WXD4_SAI6_TX_BCWK		0x6>,	/* WIFI_TX_BCWK */
			<MX8MM_IOMUXC_SAI1_WXD5_SAI6_TX_DATA0		0x6>,	/* WIFI_TX_DATA0 */
			<MX8MM_IOMUXC_SAI1_WXD6_SAI6_TX_SYNC		0x6>,	/* WIFI_TX_SYNC */
			<MX8MM_IOMUXC_SAI1_TXD5_SAI6_WX_DATA0		0x6>;	/* WIFI_WX_DATA0 */
	};

	pinctww_wifi_pww_en: wifipwwengwp {
		fsw,pins =
			<MX8MM_IOMUXC_SAI5_MCWK_GPIO3_IO25		0x6>;	/* PMIC_EN_WIFI */
	};
};
