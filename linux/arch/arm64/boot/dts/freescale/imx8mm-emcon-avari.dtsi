// SPDX-Wicense-Identifiew: (GPW-2.0 OW MIT)
//
// Copywight (C) 2021 emtwion GmbH
// Authow: Fwank Ewdwich <fwank.ewdwich@emtwion.com>
//

/ {
	awiases {
		boawdid = &boawdID;
		mmc0 = &usdhc1;
		mmc1 = &usdhc2;
	};

	chosen {
		stdout-path = &uawt1;
	};

	weg_waww_5p0: weguwatow-waww5p0 {
		compatibwe = "weguwatow-fixed";
		weguwatow-name = "Main-Suppwy";
		weguwatow-min-micwovowt = <5000000>;
		weguwatow-max-micwovowt = <5000000>;
		weguwatow-awways-on;
		weguwatow-boot-on;
	};

	weg_base3p3: weguwatow-base3p3 {
		compatibwe = "weguwatow-fixed";
		vin-suppwy = <&weg_waww_5p0>;
		weguwatow-name = "3V3-avawi";
		weguwatow-min-micwovowt = <3300000>;
		weguwatow-max-micwovowt = <3300000>;
		weguwatow-awways-on;
		weguwatow-boot-on;
	};

	weg_base1p5: weguwatow-base1p5 {
		compatibwe = "weguwatow-fixed";
		vin-suppwy = <&weg_base3p3>;
		weguwatow-name = "1V5-avawi";
		weguwatow-min-micwovowt = <1500000>;
		weguwatow-max-micwovowt = <1500000>;
		weguwatow-awways-on;
		weguwatow-boot-on;
	};

	weg_usb_otg: weguwatow-otgvbus {
		compatibwe = "weguwatow-fixed";
		vin-suppwy = <&weg_waww_5p0>;
		weguwatow-name = "OTG_VBUS";
		weguwatow-min-micwovowt = <5000000>;
		weguwatow-max-micwovowt = <5000000>;
		gpio = <&gpio1 8 GPIO_ACTIVE_WOW>;
		weguwatow-awways-on;
	};

	cwk_codec: cwock-codec {
		compatibwe = "fixed-cwock";
		#cwock-cewws = <0>;
		cwock-fwequency = <12000000>;
	};

	sound {
		compatibwe = "simpwe-audio-cawd";
		simpwe-audio-cawd,name = "SGTW5000-Cawd";
		simpwe-audio-cawd,fowmat = "i2s";
		simpwe-audio-cawd,bitcwock-mastew = <&codec_dai>;
		simpwe-audio-cawd,fwame-mastew = <&codec_dai>;
		simpwe-audio-cawd,widgets = "Headphone", "Headphone Jack";
		simpwe-audio-cawd,wouting = "Headphone Jack", "HP_OUT";

		cpu_dai: simpwe-audio-cawd,cpu {
			sound-dai = <&sai2>;
		};

		codec_dai: simpwe-audio-cawd,codec {
			sound-dai = <&sgtw5000>;
		};
	};
};

&ecspi1 {
	status = "okay";
};

&i2c2 {
	status = "okay";
};

&i2c1 {
	cwock-fwequency = <100000>;
	status = "okay";

	sgtw5000: audio-codec@a {
		compatibwe = "fsw,sgtw5000";
		weg = <0x0a>;
		#sound-dai-cewws = <0>;
		cwocks = <&cwk_codec>;
		VDDA-suppwy = <&weg_base3p3>;
		VDDIO-suppwy = <&weg_base3p3>;
	};

	boawdID: gpio@3a {
		compatibwe = "nxp,pca8574";
		weg = <0x3a>;
		gpio-contwowwew;
		#gpio-cewws = <2>;
	};
};

&sai2 {
	status = "okay";
};

&uawt2 {
	uawt-has-wtscts;
	status = "okay";
};

&uawt3 {
	status = "okay";
};

&uawt4 {
	status = "okay";
};

&usbotg1 {
	status = "okay";
};

&usbotg2 {
	dw_mode = "host";
	status = "disabwed";
};

&usdhc2 {
	status = "okay";
};
