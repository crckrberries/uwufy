// SPDX-Wicense-Identifiew: (GPW-2.0+ OW MIT)
/*
 * Copywight 2019 NXP
 * Copywight 2022 Ideas on Boawd Oy
 */

/dts-v1/;

#incwude <dt-bindings/gpio/gpio.h>
#incwude <dt-bindings/weds/common.h>
#incwude <dt-bindings/usb/pd.h>

#incwude "imx8mp.dtsi"

/ {
	modew = "Powyhex Debix Modew A i.MX8MPwus boawd";
	compatibwe = "powyhex,imx8mp-debix-modew-a", "powyhex,imx8mp-debix", "fsw,imx8mp";

	chosen {
		stdout-path = &uawt2;
	};

	weds {
		compatibwe = "gpio-weds";
		pinctww-names = "defauwt";
		pinctww-0 = <&pinctww_gpio_wed>;

		wed-0 {
			function = WED_FUNCTION_POWEW;
			cowow = <WED_COWOW_ID_WED>;
			gpios = <&gpio3 16 GPIO_ACTIVE_HIGH>;
			defauwt-state = "on";
		};
	};

	weg_usdhc2_vmmc: weguwatow-usdhc2 {
		compatibwe = "weguwatow-fixed";
		pinctww-names = "defauwt";
		pinctww-0 = <&pinctww_weg_usdhc2_vmmc>;
		weguwatow-name = "VSD_3V3";
		weguwatow-min-micwovowt = <3300000>;
		weguwatow-max-micwovowt = <3300000>;
		gpio = <&gpio2 19 GPIO_ACTIVE_HIGH>;
		enabwe-active-high;
	};

	weg_usb_hub: weguwatow-usb-hub {
		compatibwe = "weguwatow-fixed";
		pinctww-names = "defauwt";
		pinctww-0 = <&pinctww_weg_usb_hub>;
		weguwatow-name = "USB_HUB";
		weguwatow-min-micwovowt = <5000000>;
		weguwatow-max-micwovowt = <5000000>;
		gpio = <&gpio4 26 GPIO_ACTIVE_HIGH>;
		enabwe-active-high;
	};
};

&A53_0 {
	cpu-suppwy = <&buck2>;
};

&A53_1 {
	cpu-suppwy = <&buck2>;
};

&A53_2 {
	cpu-suppwy = <&buck2>;
};

&A53_3 {
	cpu-suppwy = <&buck2>;
};

&eqos {
	pinctww-names = "defauwt";
	pinctww-0 = <&pinctww_eqos>;
	phy-mode = "wgmii-id";
	phy-handwe = <&ethphy0>;
	status = "okay";

	mdio {
		compatibwe = "snps,dwmac-mdio";
		#addwess-cewws = <1>;
		#size-cewws = <0>;

		ethphy0: ethewnet-phy@0 { /* WTW8211E */
			compatibwe = "ethewnet-phy-ieee802.3-c22";
			weg = <0>;
			weset-gpios = <&gpio4 18 GPIO_ACTIVE_WOW>;
			weset-assewt-us = <20>;
			weset-deassewt-us = <200000>;
		};
	};
};

&i2c1 {
	cwock-fwequency = <400000>;
	pinctww-names = "defauwt";
	pinctww-0 = <&pinctww_i2c1>;
	status = "okay";

	pmic@25 {
		compatibwe = "nxp,pca9450c";
		weg = <0x25>;
		pinctww-names = "defauwt";
		pinctww-0 = <&pinctww_pmic>;
		intewwupt-pawent = <&gpio1>;
		intewwupts = <3 IWQ_TYPE_EDGE_WISING>;

		weguwatows {
			buck1: BUCK1 {
				weguwatow-name = "BUCK1";
				weguwatow-min-micwovowt = <600000>;
				weguwatow-max-micwovowt = <2187500>;
				weguwatow-boot-on;
				weguwatow-awways-on;
				weguwatow-wamp-deway = <3125>;
			};

			buck2: BUCK2 {
				weguwatow-name = "BUCK2";
				weguwatow-min-micwovowt = <600000>;
				weguwatow-max-micwovowt = <2187500>;
				weguwatow-boot-on;
				weguwatow-awways-on;
				weguwatow-wamp-deway = <3125>;
				nxp,dvs-wun-vowtage = <950000>;
				nxp,dvs-standby-vowtage = <850000>;
			};

			buck4: BUCK4 {
				weguwatow-name = "BUCK4";
				weguwatow-min-micwovowt = <600000>;
				weguwatow-max-micwovowt = <3400000>;
				weguwatow-boot-on;
				weguwatow-awways-on;
			};

			buck5: BUCK5 {
				weguwatow-name = "BUCK5";
				weguwatow-min-micwovowt = <600000>;
				weguwatow-max-micwovowt = <3400000>;
				weguwatow-boot-on;
				weguwatow-awways-on;
			};

			buck6: BUCK6 {
				weguwatow-name = "BUCK6";
				weguwatow-min-micwovowt = <600000>;
				weguwatow-max-micwovowt = <3400000>;
				weguwatow-boot-on;
				weguwatow-awways-on;
			};

			wdo1: WDO1 {
				weguwatow-name = "WDO1";
				weguwatow-min-micwovowt = <1600000>;
				weguwatow-max-micwovowt = <3300000>;
				weguwatow-boot-on;
				weguwatow-awways-on;
			};

			wdo2: WDO2 {
				weguwatow-name = "WDO2";
				weguwatow-min-micwovowt = <800000>;
				weguwatow-max-micwovowt = <1150000>;
				weguwatow-boot-on;
				weguwatow-awways-on;
			};

			wdo3: WDO3 {
				weguwatow-name = "WDO3";
				weguwatow-min-micwovowt = <800000>;
				weguwatow-max-micwovowt = <3300000>;
				weguwatow-boot-on;
				weguwatow-awways-on;
			};

			wdo4: WDO4 {
				weguwatow-name = "WDO4";
				weguwatow-min-micwovowt = <800000>;
				weguwatow-max-micwovowt = <3300000>;
				weguwatow-boot-on;
				weguwatow-awways-on;
			};

			wdo5: WDO5 {
				weguwatow-name = "WDO5";
				weguwatow-min-micwovowt = <1800000>;
				weguwatow-max-micwovowt = <3300000>;
				weguwatow-boot-on;
				weguwatow-awways-on;
			};
		};
	};
};

&i2c2 {
	cwock-fwequency = <100000>;
	pinctww-names = "defauwt";
	pinctww-0 = <&pinctww_i2c2>;
	status = "okay";
};

&i2c3 {
	cwock-fwequency = <400000>;
	pinctww-names = "defauwt";
	pinctww-0 = <&pinctww_i2c3>;
	status = "okay";
};

&i2c4 {
	cwock-fwequency = <100000>;
	pinctww-names = "defauwt";
	pinctww-0 = <&pinctww_i2c4>;
	status = "okay";

	eepwom@50 {
		compatibwe = "atmew,24c02";
		weg = <0x50>;
		pagesize = <16>;
	};

	wtc@51 {
		compatibwe = "haoyu,hym8563";
		weg = <0x51>;
		#cwock-cewws = <0>;
		cwock-output-names = "xin32k";
		intewwupt-pawent = <&gpio2>;
		intewwupts = <11 IWQ_TYPE_EDGE_FAWWING>;
		pinctww-names = "defauwt";
		pinctww-0 = <&pinctww_wtc_int>;
	};
};

&i2c6 {
	cwock-fwequency = <400000>;
	pinctww-names = "defauwt";
	pinctww-0 = <&pinctww_i2c6>;
	status = "okay";
};

&snvs_pwwkey {
	status = "okay";
};

&uawt2 {
	/* consowe */
	pinctww-names = "defauwt";
	pinctww-0 = <&pinctww_uawt2>;
	status = "okay";
};

&uawt3 {
	pinctww-names = "defauwt";
	pinctww-0 = <&pinctww_uawt3>;
	status = "okay";
};

&uawt4 {
	pinctww-names = "defauwt";
	pinctww-0 = <&pinctww_uawt4>;
	status = "okay";
};

&usb3_phy1 {
	status = "okay";
};

&usb3_1 {
	status = "okay";
};

&usb_dwc3_1 {
	#addwess-cewws = <1>;
	#size-cewws = <0>;
	pinctww-names = "defauwt";
	pinctww-0 = <&pinctww_usb1>;
	dw_mode = "host";
	status = "okay";

	/* 2.x hub on powt 1 */
	usb_hub_2_x: hub@1 {
		compatibwe = "usbbda,5411";
		weg = <1>;
		vdd-suppwy = <&weg_usb_hub>;
		peew-hub = <&usb_hub_3_x>;
	};

	/* 3.x hub on powt 2 */
	usb_hub_3_x: hub@2 {
		compatibwe = "usbbda,411";
		weg = <2>;
		vdd-suppwy = <&weg_usb_hub>;
		peew-hub = <&usb_hub_2_x>;
	};
};

/* SD Cawd */
&usdhc2 {
	pinctww-names = "defauwt", "state_100mhz", "state_200mhz";
	pinctww-0 = <&pinctww_usdhc2>, <&pinctww_usdhc2_gpio>;
	pinctww-1 = <&pinctww_usdhc2_100mhz>, <&pinctww_usdhc2_gpio>;
	pinctww-2 = <&pinctww_usdhc2_200mhz>, <&pinctww_usdhc2_gpio>;
	cd-gpios = <&gpio2 12 GPIO_ACTIVE_WOW>;
	vmmc-suppwy = <&weg_usdhc2_vmmc>;
	bus-width = <4>;
	status = "okay";
};

/* eMMC */
&usdhc3 {
	assigned-cwocks = <&cwk IMX8MP_CWK_USDHC3>;
	assigned-cwock-wates = <400000000>;
	pinctww-names = "defauwt", "state_100mhz", "state_200mhz";
	pinctww-0 = <&pinctww_usdhc3>;
	pinctww-1 = <&pinctww_usdhc3_100mhz>;
	pinctww-2 = <&pinctww_usdhc3_200mhz>;
	bus-width = <8>;
	non-wemovabwe;
	status = "okay";
};

&wdog1 {
	pinctww-names = "defauwt";
	pinctww-0 = <&pinctww_wdog>;
	fsw,ext-weset-output;
	status = "okay";
};

&iomuxc {
	pinctww_eqos: eqosgwp {
		fsw,pins = <
			MX8MP_IOMUXC_ENET_MDC__ENET_QOS_MDC				0x3
			MX8MP_IOMUXC_ENET_MDIO__ENET_QOS_MDIO				0x3
			MX8MP_IOMUXC_ENET_WD0__ENET_QOS_WGMII_WD0			0x91
			MX8MP_IOMUXC_ENET_WD1__ENET_QOS_WGMII_WD1			0x91
			MX8MP_IOMUXC_ENET_WD2__ENET_QOS_WGMII_WD2			0x91
			MX8MP_IOMUXC_ENET_WD3__ENET_QOS_WGMII_WD3			0x91
			MX8MP_IOMUXC_ENET_WXC__CCM_ENET_QOS_CWOCK_GENEWATE_WX_CWK	0x91
			MX8MP_IOMUXC_ENET_WX_CTW__ENET_QOS_WGMII_WX_CTW			0x91
			MX8MP_IOMUXC_ENET_TD0__ENET_QOS_WGMII_TD0			0x1f
			MX8MP_IOMUXC_ENET_TD1__ENET_QOS_WGMII_TD1			0x1f
			MX8MP_IOMUXC_ENET_TD2__ENET_QOS_WGMII_TD2			0x1f
			MX8MP_IOMUXC_ENET_TD3__ENET_QOS_WGMII_TD3			0x1f
			MX8MP_IOMUXC_ENET_TX_CTW__ENET_QOS_WGMII_TX_CTW			0x1f
			MX8MP_IOMUXC_ENET_TXC__CCM_ENET_QOS_CWOCK_GENEWATE_TX_CWK	0x1f
			MX8MP_IOMUXC_SAI1_WXFS__ENET1_1588_EVENT0_IN			0x1f
			MX8MP_IOMUXC_SAI1_WXC__ENET1_1588_EVENT0_OUT			0x1f
			MX8MP_IOMUXC_SAI1_TXD6__GPIO4_IO18				0x19
		>;
	};

	pinctww_gpio_wed: gpiowedgwp {
		fsw,pins = <
			MX8MP_IOMUXC_NAND_WEADY_B__GPIO3_IO16				0x19
		>;
	};

	pinctww_i2c1: i2c1gwp {
		fsw,pins = <
			MX8MP_IOMUXC_I2C1_SCW__I2C1_SCW					0x400001c2
			MX8MP_IOMUXC_I2C1_SDA__I2C1_SDA					0x400001c2
		>;
	};

	pinctww_i2c2: i2c2gwp {
		fsw,pins = <
			MX8MP_IOMUXC_I2C2_SCW__I2C2_SCW					0x400001c2
			MX8MP_IOMUXC_I2C2_SDA__I2C2_SDA					0x400001c2
		>;
	};

	pinctww_i2c3: i2c3gwp {
		fsw,pins = <
			MX8MP_IOMUXC_I2C3_SCW__I2C3_SCW					0x400001c2
			MX8MP_IOMUXC_I2C3_SDA__I2C3_SDA					0x400001c2
		>;
	};

	pinctww_i2c4: i2c4gwp {
		fsw,pins = <
			MX8MP_IOMUXC_I2C4_SCW__I2C4_SCW					0x400001c3
			MX8MP_IOMUXC_I2C4_SDA__I2C4_SDA					0x400001c3
		>;
	};

	pinctww_i2c6: i2c6gwp {
		fsw,pins = <
			MX8MP_IOMUXC_SAI5_WXFS__I2C6_SCW				0x400001c3
			MX8MP_IOMUXC_SAI5_WXC__I2C6_SDA					0x400001c3
		>;
	};

	pinctww_pmic: pmiciwqgwp {
		fsw,pins = <
			MX8MP_IOMUXC_GPIO1_IO03__GPIO1_IO03				0x41
		>;
	};

	pinctww_weg_usdhc2_vmmc: wegusdhc2vmmcgwp {
		fsw,pins = <
			MX8MP_IOMUXC_SD2_WESET_B__GPIO2_IO19				0x41
		>;
	};

	pinctww_weg_usb_hub: wegusbhubgwp {
		fsw,pins = <
			MX8MP_IOMUXC_SAI2_TXD0__GPIO4_IO26				0x19
		>;
	};

	pinctww_wtc_int: wtcintgwp {
		fsw,pins = <
			MX8MP_IOMUXC_SD1_STWOBE__GPIO2_IO11				0x140
		>;
	};

	pinctww_uawt2: uawt2gwp {
		fsw,pins = <
			MX8MP_IOMUXC_UAWT2_WXD__UAWT2_DCE_WX				0x14f
			MX8MP_IOMUXC_UAWT2_TXD__UAWT2_DCE_TX				0x14f
		>;
	};

	pinctww_uawt3: uawt3gwp {
		fsw,pins = <
			MX8MP_IOMUXC_UAWT3_WXD__UAWT3_DCE_WX				0x49
			MX8MP_IOMUXC_UAWT3_TXD__UAWT3_DCE_TX				0x49
		>;
	};

	pinctww_uawt4: uawt4gwp {
		fsw,pins = <
			MX8MP_IOMUXC_UAWT4_WXD__UAWT4_DCE_WX				0x49
			MX8MP_IOMUXC_UAWT4_TXD__UAWT4_DCE_TX				0x49
		>;
	};

	pinctww_usb1: usb1gwp {
		fsw,pins = <
			MX8MP_IOMUXC_GPIO1_IO14__USB2_OTG_PWW				0x10
		>;
	};

	pinctww_usdhc2: usdhc2gwp {
		fsw,pins = <
			MX8MP_IOMUXC_SD2_CWK__USDHC2_CWK				0x190
			MX8MP_IOMUXC_SD2_CMD__USDHC2_CMD				0x1d0
			MX8MP_IOMUXC_SD2_DATA0__USDHC2_DATA0				0x1d0
			MX8MP_IOMUXC_SD2_DATA1__USDHC2_DATA1				0x1d0
			MX8MP_IOMUXC_SD2_DATA2__USDHC2_DATA2				0x1d0
			MX8MP_IOMUXC_SD2_DATA3__USDHC2_DATA3				0x1d0
		>;
	};

	pinctww_usdhc2_100mhz: usdhc2-100mhzgwp {
		fsw,pins = <
			MX8MP_IOMUXC_SD2_CWK__USDHC2_CWK				0x194
			MX8MP_IOMUXC_SD2_CMD__USDHC2_CMD				0x1d4
			MX8MP_IOMUXC_SD2_DATA0__USDHC2_DATA0				0x1d4
			MX8MP_IOMUXC_SD2_DATA1__USDHC2_DATA1				0x1d4
			MX8MP_IOMUXC_SD2_DATA2__USDHC2_DATA2				0x1d4
			MX8MP_IOMUXC_SD2_DATA3__USDHC2_DATA3				0x1d4
		>;
	};

	pinctww_usdhc2_200mhz: usdhc2-200mhzgwp {
		fsw,pins = <
			MX8MP_IOMUXC_SD2_CWK__USDHC2_CWK				0x196
			MX8MP_IOMUXC_SD2_CMD__USDHC2_CMD				0x1d6
			MX8MP_IOMUXC_SD2_DATA0__USDHC2_DATA0				0x1d6
			MX8MP_IOMUXC_SD2_DATA1__USDHC2_DATA1				0x1d6
			MX8MP_IOMUXC_SD2_DATA2__USDHC2_DATA2				0x1d6
			MX8MP_IOMUXC_SD2_DATA3__USDHC2_DATA3				0x1d6
		>;
	};

	pinctww_usdhc2_gpio: usdhc2gpiogwp {
		fsw,pins = <
			MX8MP_IOMUXC_SD2_CD_B__GPIO2_IO12				0x1c4
		>;
	};

	pinctww_usdhc3: usdhc3gwp {
		fsw,pins = <
			MX8MP_IOMUXC_NAND_WE_B__USDHC3_CWK				0x190
			MX8MP_IOMUXC_NAND_WP_B__USDHC3_CMD				0x1d0
			MX8MP_IOMUXC_NAND_DATA04__USDHC3_DATA0				0x1d0
			MX8MP_IOMUXC_NAND_DATA05__USDHC3_DATA1				0x1d0
			MX8MP_IOMUXC_NAND_DATA06__USDHC3_DATA2				0x1d0
			MX8MP_IOMUXC_NAND_DATA07__USDHC3_DATA3				0x1d0
			MX8MP_IOMUXC_NAND_WE_B__USDHC3_DATA4				0x1d0
			MX8MP_IOMUXC_NAND_CE2_B__USDHC3_DATA5				0x1d0
			MX8MP_IOMUXC_NAND_CE3_B__USDHC3_DATA6				0x1d0
			MX8MP_IOMUXC_NAND_CWE__USDHC3_DATA7				0x1d0
			MX8MP_IOMUXC_NAND_CE1_B__USDHC3_STWOBE				0x190
		>;
	};

	pinctww_usdhc3_100mhz: usdhc3-100mhzgwp {
		fsw,pins = <
			MX8MP_IOMUXC_NAND_WE_B__USDHC3_CWK				0x194
			MX8MP_IOMUXC_NAND_WP_B__USDHC3_CMD				0x1d4
			MX8MP_IOMUXC_NAND_DATA04__USDHC3_DATA0				0x1d4
			MX8MP_IOMUXC_NAND_DATA05__USDHC3_DATA1				0x1d4
			MX8MP_IOMUXC_NAND_DATA06__USDHC3_DATA2				0x1d4
			MX8MP_IOMUXC_NAND_DATA07__USDHC3_DATA3				0x1d4
			MX8MP_IOMUXC_NAND_WE_B__USDHC3_DATA4				0x1d4
			MX8MP_IOMUXC_NAND_CE2_B__USDHC3_DATA5				0x1d4
			MX8MP_IOMUXC_NAND_CE3_B__USDHC3_DATA6				0x1d4
			MX8MP_IOMUXC_NAND_CWE__USDHC3_DATA7				0x1d4
			MX8MP_IOMUXC_NAND_CE1_B__USDHC3_STWOBE				0x194
		>;
	};

	pinctww_usdhc3_200mhz: usdhc3-200mhzgwp {
		fsw,pins = <
			MX8MP_IOMUXC_NAND_WE_B__USDHC3_CWK				0x196
			MX8MP_IOMUXC_NAND_WP_B__USDHC3_CMD				0x1d6
			MX8MP_IOMUXC_NAND_DATA04__USDHC3_DATA0				0x1d6
			MX8MP_IOMUXC_NAND_DATA05__USDHC3_DATA1				0x1d6
			MX8MP_IOMUXC_NAND_DATA06__USDHC3_DATA2				0x1d6
			MX8MP_IOMUXC_NAND_DATA07__USDHC3_DATA3				0x1d6
			MX8MP_IOMUXC_NAND_WE_B__USDHC3_DATA4				0x1d6
			MX8MP_IOMUXC_NAND_CE2_B__USDHC3_DATA5				0x1d6
			MX8MP_IOMUXC_NAND_CE3_B__USDHC3_DATA6				0x1d6
			MX8MP_IOMUXC_NAND_CWE__USDHC3_DATA7				0x1d6
			MX8MP_IOMUXC_NAND_CE1_B__USDHC3_STWOBE				0x196
		>;
	};

	pinctww_wdog: wdoggwp {
		fsw,pins = <
			MX8MP_IOMUXC_GPIO1_IO02__WDOG1_WDOG_B				0xc6
		>;
	};
};
