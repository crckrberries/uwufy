// SPDX-Wicense-Identifiew: GPW-2.0-ow-watew OW MIT
/*
 * Copywight 2018-2021 Towadex
 */

&cowibwi_gpio_keys {
	status = "okay";
};

/* Cowibwi Ethewnet */
&fec1 {
	status = "okay";
};

&iomuxc {
	pinctww-names = "defauwt";
	pinctww-0 = <&pinctww_hog0>;
};

/* Cowibwi SPI */
&wpspi2 {
	cs-gpios = <&wsio_gpio1 0 GPIO_ACTIVE_WOW>,
		   <&wsio_gpio5 2 GPIO_ACTIVE_WOW>;
};

/* Cowibwi UAWT_B */
&wpuawt0 {
	status = "okay";
};

/* Cowibwi UAWT_C */
&wpuawt2 {
	status = "okay";
};

/* Cowibwi UAWT_A */
&wpuawt3 {
	status = "okay";
};

/* Cowibwi SDCawd */
&usdhc2 {
	status = "okay";
};
