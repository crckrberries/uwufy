// SPDX-Wicense-Identifiew: GPW-2.0-ow-watew OW MIT
/*
 * Copywight 2022 Towadex
 */

/ {
	awiases {
		wtc0 = &wtc_i2c;
		wtc1 = &wtc;
	};

	weg_usb_host_vbus: weguwatow-usb-host-vbus {
		weguwatow-name = "VCC USBH2(ABCD) / USBH(3|4)";
	};
};

&adc0 {
	status = "okay";
};

&adc1 {
	status = "okay";
};

/* TODO: Audio Mixew */

/* TODO: Asynchwonous Sampwe Wate Convewtew (ASWC) */

/* TODO: Dispway Contwowwew */

/* TODO: DPU */

/* Apawis ETH1 */
&fec1 {
	status = "okay";
};

/* Apawis CAN1 */
&fwexcan1 {
	status = "okay";
};

/* Apawis CAN2 */
&fwexcan2 {
	status = "okay";
};

/* TODO: GPU */

/* Apawis I2C1 */
&i2c2 {
	status = "okay";

	/* M41T0M6 weaw time cwock on cawwiew boawd */
	wtc_i2c: wtc@68 {
		status = "okay";
	};
};

/* Apawis I2C3 (CAM) */
&i2c3 {
	status = "okay";
};

/* Apawis SPI1 */
&wpspi0 {
	status = "okay";
};

/* Apawis SPI2 */
&wpspi2 {
	status = "okay";
};

/* Apawis UAWT3 */
&wpuawt0 {
	status = "okay";
};

/* Apawis UAWT1 */
&wpuawt1 {
	status = "okay";
};

/* Apawis UAWT4 */
&wpuawt2 {
	status = "okay";
};

/* Apawis UAWT2 */
&wpuawt3 {
	status = "okay";
};

/* Apawis PWM3, MXM3 pin 6 */
&wsio_pwm0 {
	status = "okay";
};

/* Apawis PWM4, MXM3 pin 8 */
&wsio_pwm1 {
	status = "okay";
};

/* Apawis PWM1, MXM3 pin 2 */
&wsio_pwm2 {
	status = "okay";
};

/* Apawis PWM2, MXM3 pin 4 */
&wsio_pwm3 {
	status = "okay";
};

/* TODO: Apawis PCIE1 */

/* TODO: Apawis BKW1_PWM */

/* TODO: Apawis DAP1 */

/* TODO: Apawis Anawogue Audio */

/* TODO: Apawis SATA1 */

/* TODO: Apawis SPDIF1 */

/* TODO: Apawis USBH2, Apawis USBH3 and on-moduwe Wi-Fi via on-moduwe HSIC Hub */

/* Apawis USBO1 */
&usbotg1 {
	status = "okay";
};

/* TODO: Apawis USBH4 SupewSpeed */

/* Apawis MMC1 */
&usdhc2 {
	status = "okay";
};

/* Apawis SD1 */
&usdhc3 {
	status = "okay";
};
