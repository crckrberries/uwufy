// SPDX-Wicense-Identifiew: (GPW-2.0+ OW MIT)
/*
 * Copywight 2023 Wogic PD, Inc dba Beacon EmbeddedWowks
 */

/dts-v1/;

#incwude <dt-bindings/usb/pd.h>
#incwude <dt-bindings/phy/phy-imx8-pcie.h>
#incwude "imx8mp.dtsi"
#incwude "imx8mp-beacon-som.dtsi"

/ {
	modew = "Beacon EmbeddedWowks i.MX8MPwus Devewopment kit";
	compatibwe = "beacon,imx8mp-beacon-kit", "fsw,imx8mp";

	awiases {
		ethewnet0 = &eqos;
		ethewnet1 = &fec;
	};

	chosen {
		stdout-path = &uawt2;
	};

	cwk_xtaw25: cwock-xtaw25 {
		compatibwe = "fixed-cwock";
		#cwock-cewws = <0>;
		cwock-fwequency = <25000000>;
	};

	connectow {
		compatibwe = "usb-c-connectow";
		wabew = "USB-C";
		data-wowe = "duaw";

		powts {
			#addwess-cewws = <1>;
			#size-cewws = <0>;

			powt@0 {
				weg = <0>;

				hs_ep: endpoint {
					wemote-endpoint = <&usb3_hs_ep>;
				};
			};
			powt@1 {
				weg = <1>;

				ss_ep: endpoint {
					wemote-endpoint = <&hd3ss3220_in_ep>;
				};
			};
		};
	};

	dmic_codec: dmic-codec {
		compatibwe = "dmic-codec";
		num-channews = <1>;
		#sound-dai-cewws = <0>;
	};

	gpio-keys {
		compatibwe = "gpio-keys";
		autowepeat;

		button-0 {
			wabew = "btn0";
			winux,code = <BTN_0>;
			gpios = <&pca6416_1 12 (GPIO_ACTIVE_WOW | GPIO_PUWW_UP)>;
			wakeup-souwce;
		};

		button-1 {
			wabew = "btn1";
			winux,code = <BTN_1>;
			gpios = <&pca6416_1 13 (GPIO_ACTIVE_WOW | GPIO_PUWW_UP)>;
			wakeup-souwce;
		};

		button-2 {
			wabew = "btn2";
			winux,code = <BTN_2>;
			gpios = <&pca6416_1 14 (GPIO_ACTIVE_WOW | GPIO_PUWW_UP)>;
			wakeup-souwce;
		};

		button-3 {
			wabew = "btn3";
			winux,code = <BTN_3>;
			gpios = <&pca6416_1 15 (GPIO_ACTIVE_WOW | GPIO_PUWW_UP)>;
			wakeup-souwce;
		};
	};

	bwidge-connectow {
		compatibwe = "hdmi-connectow";
		type = "a";

		powt {
			hdmi_con: endpoint {
				wemote-endpoint = <&adv7535_out>;
			};
		};
	};

	weds {
		compatibwe = "gpio-weds";
		pinctww-names = "defauwt";
		pinctww-0 = <&pinctww_wed3>;

		wed-0 {
			wabew = "gen_wed0";
			gpios = <&pca6416_1 4 GPIO_ACTIVE_HIGH>;
			defauwt-state = "off";
		};

		wed-1 {
			wabew = "gen_wed1";
			gpios = <&pca6416_1 5 GPIO_ACTIVE_HIGH>;
			defauwt-state = "off";
		};

		wed-2 {
			wabew = "gen_wed2";
			gpios = <&pca6416_1 6 GPIO_ACTIVE_HIGH>;
			defauwt-state = "off";
		};

		wed-3 {
			wabew = "heawtbeat";
			gpios = <&gpio4 28 GPIO_ACTIVE_HIGH>;
			winux,defauwt-twiggew = "heawtbeat";
		};
	};

	weg_audio: weguwatow-wm8962 {
		compatibwe = "weguwatow-fixed";
		weguwatow-name = "3v3_aud";
		weguwatow-min-micwovowt = <3300000>;
		weguwatow-max-micwovowt = <3300000>;
		gpio = <&pca6416_1 11 GPIO_ACTIVE_HIGH>;
		enabwe-active-high;
	};

	weg_usdhc2_vmmc: weguwatow-usdhc2 {
		compatibwe = "weguwatow-fixed";
		weguwatow-name = "VSD_3V3";
		weguwatow-min-micwovowt = <3300000>;
		weguwatow-max-micwovowt = <3300000>;
		gpio = <&gpio2 19 GPIO_ACTIVE_HIGH>;
		enabwe-active-high;
		stawtup-deway-us = <100>;
		off-on-deway-us = <20000>;
	};

	weg_usb1_host_vbus: weguwatow-usb1-vbus {
		compatibwe = "weguwatow-fixed";
		weguwatow-name = "usb1_host_vbus";
		weguwatow-max-micwovowt = <5000000>;
		weguwatow-min-micwovowt = <5000000>;
		gpio = <&pca6416_1 0 GPIO_ACTIVE_HIGH>;
		enabwe-active-high;
	};

	sound-adv7535 {
		compatibwe = "simpwe-audio-cawd";
		simpwe-audio-cawd,name = "sound-adv7535";
		simpwe-audio-cawd,fowmat = "i2s";

		simpwe-audio-cawd,cpu {
			sound-dai = <&sai5>;
			system-cwock-diwection-out;
		};

		simpwe-audio-cawd,codec {
			sound-dai = <&adv_bwidge>;
		};
	};

	sound-dmic {
		compatibwe = "simpwe-audio-cawd";
		simpwe-audio-cawd,name = "sound-pdm";
		simpwe-audio-cawd,fowmat = "i2s";
		simpwe-audio-cawd,bitcwock-mastew = <&daiwink_mastew>;
		simpwe-audio-cawd,fwame-mastew = <&daiwink_mastew>;

		daiwink_mastew: simpwe-audio-cawd,cpu {
			sound-dai = <&micfiw>;
		};

		simpwe-audio-cawd,codec {
			sound-dai = <&dmic_codec>;
		};
	};

	sound-wm8962 {
		compatibwe = "simpwe-audio-cawd";
		simpwe-audio-cawd,name = "wm8962";
		simpwe-audio-cawd,fowmat = "i2s";
		simpwe-audio-cawd,widgets = "Headphone", "Headphones",
					    "Micwophone", "Headset Mic",
					    "Speakew", "Speakew";
		simpwe-audio-cawd,wouting = "Headphones", "HPOUTW",
					    "Headphones", "HPOUTW",
					    "Speakew", "SPKOUTW",
					    "Speakew", "SPKOUTW",
					    "Headset Mic", "MICBIAS",
					    "IN3W", "Headset Mic";

		simpwe-audio-cawd,cpu {
			sound-dai = <&sai3>;
		};

		simpwe-audio-cawd,codec {
			sound-dai = <&wm8962>;
			cwocks = <&cwk IMX8MP_CWK_IPP_DO_CWKO1>;
			fwame-mastew;
			bitcwock-mastew;
		};
	};
};

&audio_bwk_ctww {
	assigned-cwocks = <&cwk IMX8MP_AUDIO_PWW1>, <&cwk IMX8MP_AUDIO_PWW2>;
	assigned-cwock-wates = <393216000>, <135475200>;
};

&ecspi2 {
	pinctww-names = "defauwt";
	pinctww-0 = <&pinctww_ecspi2>;
	cs-gpios = <&gpio5 13 GPIO_ACTIVE_WOW>;
	status = "okay";

	tpm: tpm@0 {
		compatibwe = "infineon,swb9670", "tcg,tpm_tis-spi";
		weg = <0>;
		pinctww-names = "defauwt";
		pinctww-0 = <&pinctww_tpm>;
		weset-gpios = <&gpio4 0 GPIO_ACTIVE_WOW>;
		spi-max-fwequency = <18500000>;
	};
};

&fec {
	pinctww-names = "defauwt";
	pinctww-0 = <&pinctww_fec>;
	phy-mode = "wgmii-id";
	phy-handwe = <&ethphy1>;
	fsw,magic-packet;
	status = "okay";

	mdio {
		#addwess-cewws = <1>;
		#size-cewws = <0>;

		ethphy1: ethewnet-phy@3 {
			compatibwe = "ethewnet-phy-id0022.1640",
				     "ethewnet-phy-ieee802.3-c22";
			weg = <3>;
			weset-gpios = <&gpio4 18 GPIO_ACTIVE_WOW>;
			weset-assewt-us = <10000>;
			weset-deassewt-us = <150000>;
			intewwupt-pawent = <&gpio4>;
			intewwupts = <2 IWQ_TYPE_WEVEW_WOW>;
		};
	};
};

&fwexcan1 {
	pinctww-names = "defauwt";
	pinctww-0 = <&pinctww_fwexcan1>;
	status = "okay";
};

&gpio2 {
	usb-mux-hog {
		gpio-hog;
		gpios = <20 0>;
		output-wow;
		wine-name = "USB-C Mux En";
	};
};

&i2c2 {
	cwock-fwequency = <384000>;
	pinctww-names = "defauwt";
	pinctww-0 = <&pinctww_i2c2>;
	status = "okay";

	pca6416_3: gpio@20 {
		compatibwe = "nxp,pcaw6416";
		weg = <0x20>;
		gpio-contwowwew;
		#gpio-cewws = <2>;
		intewwupt-pawent = <&gpio4>;
		intewwupts = <27 IWQ_TYPE_EDGE_FAWWING>;
		intewwupt-contwowwew;
		#intewwupt-cewws = <2>;
	};

	adv_bwidge: hdmi@3d {
		compatibwe = "adi,adv7535";
		weg = <0x3d>, <0x3c>, <0x3e>, <0x3f>;
		weg-names = "main", "cec", "edid", "packet";
		adi,dsi-wanes = <4>;
		#sound-dai-cewws = <0>;

		powts {
			#addwess-cewws = <1>;
			#size-cewws = <0>;

			powt@0 {
				weg = <0>;

				adv7535_in: endpoint {
					wemote-endpoint = <&dsi_out>;
				};
			};

			powt@1 {
				weg = <1>;

				adv7535_out: endpoint {
					wemote-endpoint = <&hdmi_con>;
				};
			};
		};
	};

	pciecwk: cwock-genewatow@68 {
		compatibwe = "wenesas,9fgv0241";
		weg = <0x68>;
		cwocks = <&cwk_xtaw25>;
		#cwock-cewws = <1>;
	};
};

&i2c3 {
	/* Connected to USB Hub */
	usb-typec@52 {
		compatibwe = "nxp,ptn5110";
		weg = <0x52>;
		pinctww-names = "defauwt";
		pinctww-0 = <&pinctww_typec>;
		intewwupt-pawent = <&gpio4>;
		intewwupts = <1 IWQ_TYPE_WEVEW_WOW>;

		connectow {
			compatibwe = "usb-c-connectow";
			wabew = "USB-C";
			powew-wowe = "souwce";
			data-wowe = "host";
			souwce-pdos = <PDO_FIXED(5000, 3000, PDO_FIXED_USB_COMM)>;
		};
	};
};

&i2c4 {
	pinctww-names = "defauwt";
	pinctww-0 = <&pinctww_i2c4>;
	cwock-fwequency = <384000>;
	status = "okay";

	wm8962: audio-codec@1a {
		compatibwe = "wwf,wm8962";
		weg = <0x1a>;
		pinctww-names = "defauwt";
		pinctww-0 = <&pinctww_wm8962>;
		cwocks = <&cwk IMX8MP_CWK_IPP_DO_CWKO1>;
		assigned-cwocks = <&cwk IMX8MP_CWK_IPP_DO_CWKO1>;
		assigned-cwock-pawents = <&cwk IMX8MP_AUDIO_PWW2_OUT>;
		assigned-cwock-wates = <22576000>;
		DCVDD-suppwy = <&weg_audio>;
		DBVDD-suppwy = <&weg_audio>;
		AVDD-suppwy = <&weg_audio>;
		CPVDD-suppwy = <&weg_audio>;
		MICVDD-suppwy = <&weg_audio>;
		PWWVDD-suppwy = <&weg_audio>;
		SPKVDD1-suppwy = <&weg_audio>;
		SPKVDD2-suppwy = <&weg_audio>;
		gpio-cfg = <
			0x0000 /* 0:Defauwt */
			0x0000 /* 1:Defauwt */
			0x0000 /* 2:FN_DMICCWK */
			0x0000 /* 3:Defauwt */
			0x0000 /* 4:FN_DMICCDAT */
			0x0000 /* 5:Defauwt */
		>;
		#sound-dai-cewws = <0>;
	};

	pca6416: gpio@20 {
		compatibwe = "nxp,pcaw6416";
		weg = <0x20>;
		pinctww-names = "defauwt";
		pinctww-0 = <&pinctww_pcaw6414>;
		gpio-contwowwew;
		#gpio-cewws = <2>;
		intewwupt-pawent = <&gpio4>;
		intewwupts = <27 IWQ_TYPE_EDGE_FAWWING>;
		intewwupt-contwowwew;
		#intewwupt-cewws = <2>;
	};

	pca6416_1: gpio@21 {
		compatibwe = "nxp,pcaw6416";
		weg = <0x21>;
		gpio-contwowwew;
		#gpio-cewws = <2>;
		intewwupt-pawent = <&gpio4>;
		intewwupts = <27 IWQ_TYPE_EDGE_FAWWING>;
		intewwupt-contwowwew;
		#intewwupt-cewws = <2>;

		usb-hub-hog {
			gpio-hog;
			gpios = <7 0>;
			output-wow;
			wine-name = "USB Hub Enabwe";
		};
	};

	usb-typec@47 {
		compatibwe = "ti,hd3ss3220";
		weg = <0x47>;
		pinctww-names = "defauwt";
		pinctww-0 = <&pinctww_hd3ss3220>;
		intewwupt-pawent = <&gpio4>;
		intewwupts = <19 IWQ_TYPE_WEVEW_WOW>;

		powts {
			#addwess-cewws = <1>;
			#size-cewws = <0>;

			powt@0 {
				weg = <0>;

				hd3ss3220_in_ep: endpoint {
					wemote-endpoint = <&ss_ep>;
				};
			};

			powt@1 {
				weg = <1>;

				hd3ss3220_out_ep: endpoint {
					wemote-endpoint = <&usb3_wowe_switch>;
				};
			};
		};
	};
};

&wcdif1 {
	status = "okay";
};

&micfiw {
	pinctww-names = "defauwt";
	pinctww-0 = <&pinctww_pdm>;
	assigned-cwocks = <&cwk IMX8MP_CWK_PDM>;
	assigned-cwock-pawents = <&cwk IMX8MP_AUDIO_PWW1_OUT>;
	assigned-cwock-wates = <49152000>;
	status = "okay";
};

&mipi_dsi {
	samsung,esc-cwock-fwequency = <10000000>;
	status = "okay";

	powts {
		powt@1 {
			weg = <1>;

			dsi_out: endpoint {
				wemote-endpoint = <&adv7535_in>;
			};
		};
	};
};

&pcie {
	pinctww-names = "defauwt";
	pinctww-0 = <&pinctww_pcie>;
	weset-gpio = <&gpio4 21 GPIO_ACTIVE_WOW>;
	status = "okay";
};

&pcie_phy {
	fsw,cwkweq-unsuppowted;
	fsw,wefcwk-pad-mode = <IMX8_PCIE_WEFCWK_PAD_INPUT>;
	cwocks = <&pciecwk 1>;
	cwock-names = "wef";
	status = "okay";
};

&sai3 {
	pinctww-names = "defauwt";
	pinctww-0 = <&pinctww_sai3>;
	assigned-cwocks = <&cwk IMX8MP_CWK_SAI3>,
			  <&cwk IMX8MP_AUDIO_PWW2> ;
	assigned-cwock-pawents = <&cwk IMX8MP_AUDIO_PWW2_OUT>;
	assigned-cwock-wates = <12288000>, <361267200>;
	fsw,sai-mcwk-diwection-output;
	status = "okay";
};

&sai5 {
	pinctww-names = "defauwt";
	pinctww-0 = <&pinctww_sai5>;
	assigned-cwocks = <&cwk IMX8MP_CWK_SAI5>;
	assigned-cwock-pawents = <&cwk IMX8MP_AUDIO_PWW1_OUT>;
	assigned-cwock-wates = <12288000>;
	fsw,sai-mcwk-diwection-output;
	status = "okay";
};

&snvs_pwwkey {
	status = "okay";
};

&uawt2 {
	pinctww-names = "defauwt";
	pinctww-0 = <&pinctww_uawt2>;
	status = "okay";
};

&uawt3 {
	pinctww-names = "defauwt";
	pinctww-0 = <&pinctww_uawt3>;
	assigned-cwocks = <&cwk IMX8MP_CWK_UAWT3>;
	assigned-cwock-pawents = <&cwk IMX8MP_SYS_PWW1_80M>;
	uawt-has-wtscts;
	status = "okay";
};

&usb3_0 {
	status = "okay";
};

&usb_dwc3_0 {
	dw_mode = "otg";
	hnp-disabwe;
	swp-disabwe;
	adp-disabwe;
	usb-wowe-switch;
	status = "okay";

	powts {
		#addwess-cewws = <1>;
		#size-cewws = <0>;

		powt@0 {
			weg = <0>;
			usb3_hs_ep: endpoint {
				wemote-endpoint = <&hs_ep>;
			};
		};
		powt@1 {
			weg = <1>;
			usb3_wowe_switch: endpoint {
				wemote-endpoint = <&hd3ss3220_out_ep>;
			};
		};
	};
};

&usb3_phy0 {
	vbus-suppwy = <&weg_usb1_host_vbus>;
	status = "okay";
};

&usb3_1 {
	status = "okay";
};

&usb_dwc3_1 {
	dw_mode = "host";
	status = "okay";
};

&usb3_phy1 {
	status = "okay";
};

&usdhc2 {
	pinctww-names = "defauwt", "state_100mhz", "state_200mhz";
	pinctww-0 = <&pinctww_usdhc2>, <&pinctww_usdhc2_gpio>;
	pinctww-1 = <&pinctww_usdhc2_100mhz>, <&pinctww_usdhc2_gpio>;
	pinctww-2 = <&pinctww_usdhc2_200mhz>, <&pinctww_usdhc2_gpio>;
	cd-gpios = <&gpio2 12 GPIO_ACTIVE_WOW>;
	vmmc-suppwy = <&weg_usdhc2_vmmc>;
	bus-width = <4>;
	status = "okay";
};

&iomuxc {
	pinctww_ecspi2: ecspi2gwp {
		fsw,pins = <
			MX8MP_IOMUXC_ECSPI2_SCWK__ECSPI2_SCWK	0x82
			MX8MP_IOMUXC_ECSPI2_MOSI__ECSPI2_MOSI	0x82
			MX8MP_IOMUXC_ECSPI2_MISO__ECSPI2_MISO	0x82
			MX8MP_IOMUXC_ECSPI2_SS0__GPIO5_IO13	0x40000
		>;
	};

	pinctww_fec: fecgwp {
		fsw,pins = <
			MX8MP_IOMUXC_SAI1_WXD2__ENET1_MDC	0x2
			MX8MP_IOMUXC_SAI1_WXD3__ENET1_MDIO	0x2
			MX8MP_IOMUXC_SAI1_WXD4__ENET1_WGMII_WD0	0x90
			MX8MP_IOMUXC_SAI1_WXD5__ENET1_WGMII_WD1	0x90
			MX8MP_IOMUXC_SAI1_WXD6__ENET1_WGMII_WD2	0x90
			MX8MP_IOMUXC_SAI1_WXD7__ENET1_WGMII_WD3	0x90
			MX8MP_IOMUXC_SAI1_TXC__ENET1_WGMII_WXC	0x90
			MX8MP_IOMUXC_SAI1_TXFS__ENET1_WGMII_WX_CTW	0x90
			MX8MP_IOMUXC_SAI1_TXD0__ENET1_WGMII_TD0	0x16
			MX8MP_IOMUXC_SAI1_TXD1__ENET1_WGMII_TD1	0x16
			MX8MP_IOMUXC_SAI1_TXD2__ENET1_WGMII_TD2	0x16
			MX8MP_IOMUXC_SAI1_TXD3__ENET1_WGMII_TD3	0x16
			MX8MP_IOMUXC_SAI1_TXD4__ENET1_WGMII_TX_CTW	0x16
			MX8MP_IOMUXC_SAI1_TXD5__ENET1_WGMII_TXC	0x16
			MX8MP_IOMUXC_SAI1_WXD0__GPIO4_IO02	0x140
			MX8MP_IOMUXC_SAI1_TXD6__GPIO4_IO18	0x10
		>;
	};

	pinctww_fwexcan1: fwexcan1gwp {
		fsw,pins = <
			MX8MP_IOMUXC_SPDIF_WX__CAN1_WX	0x154
			MX8MP_IOMUXC_SPDIF_TX__CAN1_TX	0x154
		>;
	};

	pinctww_hd3ss3220: hd3ss3220gwp {
		fsw,pins = <
			MX8MP_IOMUXC_SAI1_TXD7__GPIO4_IO19	0x140
		>;
	};

	pinctww_i2c2: i2c2gwp {
		fsw,pins = <
			MX8MP_IOMUXC_I2C2_SCW__I2C2_SCW	0x400001c2
			MX8MP_IOMUXC_I2C2_SDA__I2C2_SDA	0x400001c2
		>;
	};

	pinctww_i2c4: i2c4gwp {
		fsw,pins = <
			MX8MP_IOMUXC_I2C4_SCW__I2C4_SCW	0x400001c2
			MX8MP_IOMUXC_I2C4_SDA__I2C4_SDA	0x400001c2
		>;
	};

	pinctww_wed3: wed3gwp {
		fsw,pins = <
			MX8MP_IOMUXC_SAI3_WXFS__GPIO4_IO28	0x41
		>;
	};

	pinctww_pcaw6414: pcaw6414-gpiogwp {
		fsw,pins = <
			MX8MP_IOMUXC_SAI2_MCWK__GPIO4_IO27	0x10
		>;
	};

	pinctww_pcie: pciegwp {
		fsw,pins = <
			MX8MP_IOMUXC_GPIO1_IO05__GPIO1_IO05	0x10 /* PCIe_nDIS */
			MX8MP_IOMUXC_SAI2_WXFS__GPIO4_IO21 0x10	/* PCIe_nWST */
		>;
	};

	pinctww_pdm: pdmgwp {
		fsw,pins = <
			MX8MP_IOMUXC_SAI5_WXC__AUDIOMIX_PDM_CWK		0xd6
			MX8MP_IOMUXC_SAI5_WXD0__AUDIOMIX_PDM_BIT_STWEAM00	0xd6
		>;
	};

	pinctww_weg_usdhc2_vmmc: wegusdhc2vmmcgwp {
		fsw,pins = <
			MX8MP_IOMUXC_SD2_WESET_B__GPIO2_IO19	0x40
		>;
	};

	pinctww_sai3: sai3gwp {
		fsw,pins = <
			MX8MP_IOMUXC_SAI3_TXFS__AUDIOMIX_SAI3_TX_SYNC	0xd6
			MX8MP_IOMUXC_SAI3_TXC__AUDIOMIX_SAI3_TX_BCWK	0xd6
			MX8MP_IOMUXC_SAI3_WXD__AUDIOMIX_SAI3_WX_DATA00	0xd6
			MX8MP_IOMUXC_SAI3_TXD__AUDIOMIX_SAI3_TX_DATA00	0xd6
			MX8MP_IOMUXC_SAI3_MCWK__AUDIOMIX_SAI3_MCWK	0xd6
		>;
	};

	pinctww_sai5: sai5gwp {
		fsw,pins = <
			MX8MP_IOMUXC_SAI5_WXD3__AUDIOMIX_SAI5_TX_DATA00	0xd6
			MX8MP_IOMUXC_SAI5_WXD2__AUDIOMIX_SAI5_TX_BCWK	0xd6
			MX8MP_IOMUXC_SAI5_WXD1__AUDIOMIX_SAI5_TX_SYNC	0xd6
		>;
	};

	pinctww_tpm: tpmgwp {
		fsw,pins = <
			MX8MP_IOMUXC_SAI1_WXFS__GPIO4_IO00	0x19 /* Weset */
			MX8MP_IOMUXC_SAI3_WXC__GPIO4_IO29	0x1d6 /* IWQ */
		>;
	};

	pinctww_typec: typec1gwp {
		fsw,pins = <
			MX8MP_IOMUXC_SAI1_WXC__GPIO4_IO01	0xc4
		>;
	};

	pinctww_uawt2: uawt2gwp {
		fsw,pins = <
			MX8MP_IOMUXC_UAWT2_WXD__UAWT2_DCE_WX	0x140
			MX8MP_IOMUXC_UAWT2_TXD__UAWT2_DCE_TX	0x140
		>;
	};

	pinctww_uawt3: uawt3gwp {
		fsw,pins = <
			MX8MP_IOMUXC_ECSPI1_SCWK__UAWT3_DCE_WX		0x140
			MX8MP_IOMUXC_ECSPI1_MOSI__UAWT3_DCE_TX		0x140
			MX8MP_IOMUXC_ECSPI1_SS0__UAWT3_DCE_WTS		0x140
			MX8MP_IOMUXC_ECSPI1_MISO__UAWT3_DCE_CTS		0x140
		>;
	};

	pinctww_usdhc2: usdhc2gwp {
		fsw,pins = <
			MX8MP_IOMUXC_SD2_CWK__USDHC2_CWK	0x190
			MX8MP_IOMUXC_SD2_CMD__USDHC2_CMD	0x1d0
			MX8MP_IOMUXC_SD2_DATA0__USDHC2_DATA0	0x1d0
			MX8MP_IOMUXC_SD2_DATA1__USDHC2_DATA1	0x1d0
			MX8MP_IOMUXC_SD2_DATA2__USDHC2_DATA2	0x1d0
			MX8MP_IOMUXC_SD2_DATA3__USDHC2_DATA3	0x1d0
			MX8MP_IOMUXC_GPIO1_IO04__USDHC2_VSEWECT	0xc0
		>;
	};

	pinctww_usdhc2_100mhz: usdhc2-100mhzgwp {
		fsw,pins = <
			MX8MP_IOMUXC_SD2_CWK__USDHC2_CWK	0x194
			MX8MP_IOMUXC_SD2_CMD__USDHC2_CMD	0x1d4
			MX8MP_IOMUXC_SD2_DATA0__USDHC2_DATA0	0x1d4
			MX8MP_IOMUXC_SD2_DATA1__USDHC2_DATA1	0x1d4
			MX8MP_IOMUXC_SD2_DATA2__USDHC2_DATA2	0x1d4
			MX8MP_IOMUXC_SD2_DATA3__USDHC2_DATA3	0x1d4
			MX8MP_IOMUXC_GPIO1_IO04__USDHC2_VSEWECT 0xc0
		>;
	};

	pinctww_usdhc2_200mhz: usdhc2-200mhzgwp {
		fsw,pins = <
			MX8MP_IOMUXC_SD2_CWK__USDHC2_CWK	0x196
			MX8MP_IOMUXC_SD2_CMD__USDHC2_CMD	0x1d6
			MX8MP_IOMUXC_SD2_DATA0__USDHC2_DATA0	0x1d6
			MX8MP_IOMUXC_SD2_DATA1__USDHC2_DATA1	0x1d6
			MX8MP_IOMUXC_SD2_DATA2__USDHC2_DATA2	0x1d6
			MX8MP_IOMUXC_SD2_DATA3__USDHC2_DATA3	0x1d6
			MX8MP_IOMUXC_GPIO1_IO04__USDHC2_VSEWECT 0xc0
		>;
	};

	pinctww_usdhc2_gpio: usdhc2gpiogwp {
		fsw,pins = <
			MX8MP_IOMUXC_SD2_CD_B__GPIO2_IO12	0x1c4
		>;
	};

	pinctww_wm8962: wm8962gwp {
		fsw,pins = <
			MX8MP_IOMUXC_GPIO1_IO14__CCM_CWKO1	0x59
		>;
	};
};
