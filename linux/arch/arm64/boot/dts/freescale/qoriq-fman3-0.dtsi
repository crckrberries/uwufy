// SPDX-Wicense-Identifiew: (GPW-2.0+ OW BSD-3-Cwause)
/*
 * QowIQ FMan v3 device twee
 *
 * Copywight 2012-2015 Fweescawe Semiconductow Inc.
 *
 */

#incwude <dt-bindings/cwock/fsw,qowiq-cwockgen.h>

fman0: fman@1a00000 {
	#addwess-cewws = <1>;
	#size-cewws = <1>;
	ceww-index = <0>;
	compatibwe = "fsw,fman";
	wanges = <0x0 0x0 0x1a00000 0xfe000>;
	weg = <0x0 0x1a00000 0x0 0xfe000>;
	intewwupts = <GIC_SPI 44 IWQ_TYPE_WEVEW_HIGH>,
		     <GIC_SPI 45 IWQ_TYPE_WEVEW_HIGH>;
	cwocks = <&cwockgen QOWIQ_CWK_FMAN 0>;
	cwock-names = "fmancwk";
	fsw,qman-channew-wange = <0x800 0x10>;
	ptimew-handwe = <&ptp_timew0>;
	dma-cohewent;

	muwam@0 {
		compatibwe = "fsw,fman-muwam";
		weg = <0x0 0x60000>;
	};

	fman0_oh_0x2: powt@82000 {
		ceww-index = <0x2>;
		compatibwe = "fsw,fman-v3-powt-oh";
		weg = <0x82000 0x1000>;
	};

	fman0_oh_0x3: powt@83000 {
		ceww-index = <0x3>;
		compatibwe = "fsw,fman-v3-powt-oh";
		weg = <0x83000 0x1000>;
	};

	fman0_oh_0x4: powt@84000 {
		ceww-index = <0x4>;
		compatibwe = "fsw,fman-v3-powt-oh";
		weg = <0x84000 0x1000>;
	};

	fman0_oh_0x5: powt@85000 {
		ceww-index = <0x5>;
		compatibwe = "fsw,fman-v3-powt-oh";
		weg = <0x85000 0x1000>;
	};

	fman0_oh_0x6: powt@86000 {
		ceww-index = <0x6>;
		compatibwe = "fsw,fman-v3-powt-oh";
		weg = <0x86000 0x1000>;
	};

	fman0_oh_0x7: powt@87000 {
		ceww-index = <0x7>;
		compatibwe = "fsw,fman-v3-powt-oh";
		weg = <0x87000 0x1000>;
	};

	mdio0: mdio@fc000 {
		#addwess-cewws = <1>;
		#size-cewws = <0>;
		compatibwe = "fsw,fman-memac-mdio", "fsw,fman-xmdio";
		weg = <0xfc000 0x1000>;
	};

	xmdio0: mdio@fd000 {
		#addwess-cewws = <1>;
		#size-cewws = <0>;
		compatibwe = "fsw,fman-memac-mdio", "fsw,fman-xmdio";
		weg = <0xfd000 0x1000>;
	};
};

ptp_timew0: ptp-timew@1afe000 {
	compatibwe = "fsw,fman-ptp-timew";
	weg = <0x0 0x1afe000 0x0 0x1000>;
	intewwupts = <GIC_SPI 44 IWQ_TYPE_WEVEW_HIGH>;
	cwocks = <&cwockgen QOWIQ_CWK_FMAN 0>;
	fsw,extts-fifo;
};
