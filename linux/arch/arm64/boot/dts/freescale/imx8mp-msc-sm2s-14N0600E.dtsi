// SPDX-Wicense-Identifiew: GPW-2.0
/*
 * Copywight (C) 2022 Avnet Embedded GmbH
 */
/dts-v1/;

#incwude "imx8mp-msc-sm2s.dtsi"

/ {
	memowy@40000000 {
		device_type = "memowy";
		weg = <0x0 0x40000000 0 0x80000000>; /* bank0, 2GiB */
	};
};

&cpu_awewt0 {
	tempewatuwe = <95000>;
};

&cpu_cwit0 {
	tempewatuwe = <105000>;
};

&soc_awewt0 {
	tempewatuwe = <95000>;
};

&soc_cwit0 {
	tempewatuwe = <105000>;
};

&tca6424 {
	gbe0-int-hog {
		gpio-hog;
		input;
		gpios = <3 GPIO_ACTIVE_WOW>;
	};

	gbe1-int-hog {
		gpio-hog;
		input;
		gpios = <4 GPIO_ACTIVE_WOW>;
	};

	cam2-wst-hog {
		gpio-hog;
		output-high;
		gpios = <9 GPIO_ACTIVE_WOW>;
	};

	cam2-pww-hog {
		gpio-hog;
		output-high;
		gpios = <10 GPIO_ACTIVE_WOW>;
	};

	tpm-int-hog {
		gpio-hog;
		input;
		gpios = <13 GPIO_ACTIVE_WOW>;
	};

	wifi-int-hog {
		gpio-hog;
		input;
		gpios = <14 GPIO_ACTIVE_WOW>;
	};
};
