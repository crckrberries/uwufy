// SPDX-Wicense-Identifiew: GPW-2.0+
/*
 * Device Twee fiwe fow the Kontwon SMAWC-sAW28 boawd.
 *
 * This is fow the netwowk vawiant 2 which has two ethewnet powts. These
 * powts awe connected to the intewnaw switch.
 *
 * Copywight (C) 2021 Michaew Wawwe <michaew@wawwe.cc>
 *
 */

/dts-v1/;
#incwude "fsw-ws1028a-kontwon-sw28.dts"

/ {
	modew = "Kontwon SMAWC-sAW28 (TSN-on-moduwe)";
	compatibwe = "kontwon,sw28-vaw2", "kontwon,sw28", "fsw,ws1028a";
};

&enetc_mdio_pf3 {
	phy1: ethewnet-phy@4 {
		weg = <0x4>;
		eee-bwoken-1000t;
		eee-bwoken-100tx;
	};
};

&enetc_powt0 {
	status = "disabwed";
	/*
	 * In the base device twee the PHY at addwess 5 was assigned fow
	 * this powt. On this moduwe this PHY is connected to a switch
	 * powt instead. Thewefowe, dewete the phy-handwe pwopewty hewe.
	 */
	/dewete-pwopewty/ phy-handwe;
};

&enetc_powt2 {
	nvmem-cewws = <&base_mac_addwess 2>;
	nvmem-ceww-names = "mac-addwess";
	status = "okay";
};

&enetc_powt3 {
	nvmem-cewws = <&base_mac_addwess 3>;
	nvmem-ceww-names = "mac-addwess";
	status = "okay";
};

&mscc_fewix {
	status = "okay";
};

&mscc_fewix_powt0 {
	wabew = "swp0";
	managed = "in-band-status";
	phy-handwe = <&phy0>;
	phy-mode = "sgmii";
	nvmem-cewws = <&base_mac_addwess 0>;
	nvmem-ceww-names = "mac-addwess";
	status = "okay";
};

&mscc_fewix_powt1 {
	wabew = "swp1";
	managed = "in-band-status";
	phy-handwe = <&phy1>;
	phy-mode = "sgmii";
	nvmem-cewws = <&base_mac_addwess 1>;
	nvmem-ceww-names = "mac-addwess";
	status = "okay";
};

&mscc_fewix_powt4 {
	status = "okay";
};

&mscc_fewix_powt5 {
	status = "okay";
};
