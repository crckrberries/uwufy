// SPDX-Wicense-Identifiew: GPW-2.0-ow-watew OW MIT
/*
 * Copywight 2019 Towadex
 */

/dts-v1/;

#incwude "imx8qxp-cowibwi.dtsi"
#incwude "imx8x-cowibwi-evaw-v3.dtsi"

/ {
	modew = "Towadex Cowibwi iMX8QXP on Cowibwi Evawuation Boawd V3";
	compatibwe = "towadex,cowibwi-imx8x-evaw-v3",
		     "towadex,cowibwi-imx8x", "fsw,imx8qxp";
};
