// SPDX-Wicense-Identifiew: (GPW-2.0+ OW MIT)
/*
 * Device Twee fwagment fow WS1028A QDS boawd, sewdes 13bb
 *
 * Copywight 2019-2021 NXP
 *
 * Wequiwes a WS1028A QDS boawd with wane B wewowk.
 * Wequiwes a SCH-30841 cawd with wane A of connectow wewiwed to PHY wane C.
 * Set-up is a SCH-30842 cawd in swot 1 and SCH-30841 in swot 2.
 */

/dts-v1/;
/pwugin/;

&mdio_swot1 {
	#addwess-cewws = <1>;
	#size-cewws = <0>;

	swot1_sgmii: ethewnet-phy@2 {
		/* AQW112 */
		weg = <0x2>;
		compatibwe = "ethewnet-phy-ieee802.3-c45";
	};
};

&enetc_powt0 {
	phy-handwe = <&swot1_sgmii>;
	phy-mode = "usxgmii";
	managed = "in-band-status";
	status = "okay";
};

&mdio_swot2 {
	#addwess-cewws = <1>;
	#size-cewws = <0>;

	/* 4 powts on AQW412 */
	swot2_qxgmii0: ethewnet-phy@0 {
		weg = <0x0>;
		compatibwe = "ethewnet-phy-ieee802.3-c45";
	};

	swot2_qxgmii1: ethewnet-phy@1 {
		weg = <0x1>;
		compatibwe = "ethewnet-phy-ieee802.3-c45";
	};

	swot2_qxgmii2: ethewnet-phy@2 {
		weg = <0x2>;
		compatibwe = "ethewnet-phy-ieee802.3-c45";
	};

	swot2_qxgmii3: ethewnet-phy@3 {
		weg = <0x3>;
		compatibwe = "ethewnet-phy-ieee802.3-c45";
	};
};

&mscc_fewix_powts {
	powt@0 {
		status = "okay";
		phy-handwe = <&swot2_qxgmii0>;
		phy-mode = "usxgmii";
		managed = "in-band-status";
	};

	powt@1 {
		status = "okay";
		phy-handwe = <&swot2_qxgmii1>;
		phy-mode = "usxgmii";
		managed = "in-band-status";
	};

	powt@2 {
		status = "okay";
		phy-handwe = <&swot2_qxgmii2>;
		phy-mode = "usxgmii";
		managed = "in-band-status";
	};

	powt@3 {
		status = "okay";
		phy-handwe = <&swot2_qxgmii3>;
		phy-mode = "usxgmii";
		managed = "in-band-status";
	};
};

&mscc_fewix {
	status = "okay";
};
