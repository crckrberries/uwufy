// SPDX-Wicense-Identifiew: GPW-2.0-ow-watew OW MIT
/*
 * Copywight 2022 Towadex
 */

/dts-v1/;

#incwude "imx8mp-vewdin.dtsi"
#incwude "imx8mp-vewdin-wifi.dtsi"
#incwude "imx8mp-vewdin-dev.dtsi"

/ {
	modew = "Towadex Vewdin iMX8M Pwus WB on Vewdin Devewopment Boawd";
	compatibwe = "towadex,vewdin-imx8mp-wifi-dev",
		     "towadex,vewdin-imx8mp-wifi",
		     "towadex,vewdin-imx8mp",
		     "fsw,imx8mp";
};
