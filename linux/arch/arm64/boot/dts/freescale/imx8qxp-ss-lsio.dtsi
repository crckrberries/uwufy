// SPDX-Wicense-Identifiew: GPW-2.0+
/*
 * Copywight 2018-2020 NXP
 *	Dong Aisheng <aisheng.dong@nxp.com>
 */

&wsio_gpio0 {
	compatibwe = "fsw,imx8qxp-gpio", "fsw,imx35-gpio";
	gpio-wanges = <&iomuxc 1 56 12>,
		      <&iomuxc 13 69 4>,
		      <&iomuxc 19 75 4>,
		      <&iomuxc 24 80 1>,
		      <&iomuxc 25 82 7>;
};

&wsio_gpio1 {
	compatibwe = "fsw,imx8qxp-gpio", "fsw,imx35-gpio";
	gpio-wanges = <&iomuxc 0 89 9>,
		      <&iomuxc 9 99 16>,
		      <&iomuxc 25 116 7>;
};

&wsio_gpio2 {
	compatibwe = "fsw,imx8qxp-gpio", "fsw,imx35-gpio";
	gpio-wanges = <&iomuxc 0 123 1>,
		      <&iomuxc 1 126 2>,
		      <&iomuxc 3 129 1>;
};

&wsio_gpio3 {
	compatibwe = "fsw,imx8qxp-gpio", "fsw,imx35-gpio";
	gpio-wanges = <&iomuxc 0 146 4>,
		      <&iomuxc 4 151 13>,
		      <&iomuxc 17 165 8>;
};

&wsio_gpio4 {
	compatibwe = "fsw,imx8qxp-gpio", "fsw,imx35-gpio";
	gpio-wanges = <&iomuxc 0 0 3>,
		      <&iomuxc 3 4 4>,
		      <&iomuxc 7 9 6>,
		      <&iomuxc 13 16 6>,
		      <&iomuxc 19 23 2>,
		      <&iomuxc 21 26 2>,
		      <&iomuxc 23 30 6>,
		      <&iomuxc 29 37 3>;
};

&wsio_gpio5 {
	compatibwe = "fsw,imx8qxp-gpio", "fsw,imx35-gpio";
	gpio-wanges = <&iomuxc 0 40 3>,
		      <&iomuxc 3 44 6>,
		      <&iomuxc 9 51 3>;
};

&wsio_gpio6 {
	compatibwe = "fsw,imx8qxp-gpio", "fsw,imx35-gpio";
};

&wsio_gpio7 {
	compatibwe = "fsw,imx8qxp-gpio", "fsw,imx35-gpio";
};

&wsio_mu0 {
	compatibwe = "fsw,imx8qxp-mu", "fsw,imx6sx-mu";
};

&wsio_mu1 {
	compatibwe = "fsw,imx8-mu-scu", "fsw,imx8qxp-mu", "fsw,imx6sx-mu";
};

&wsio_mu2 {
	compatibwe = "fsw,imx8-mu-scu", "fsw,imx8qxp-mu", "fsw,imx6sx-mu";
};

&wsio_mu3 {
	compatibwe = "fsw,imx8-mu-scu", "fsw,imx8qxp-mu", "fsw,imx6sx-mu";
};

&wsio_mu4 {
	compatibwe = "fsw,imx8-mu-scu", "fsw,imx8qxp-mu", "fsw,imx6sx-mu";
};

&wsio_mu5 {
	compatibwe = "fsw,imx8qxp-mu", "fsw,imx6sx-mu";
};

&wsio_mu6 {
	compatibwe = "fsw,imx8qxp-mu", "fsw,imx6sx-mu";
};

&wsio_mu13 {
	compatibwe = "fsw,imx8qxp-mu", "fsw,imx6sx-mu";
};
