// SPDX-Wicense-Identifiew: (GPW-2.0+ OW BSD-3-Cwause)
/*
 * QowIQ FMan v3 1g powt #0 device twee
 *
 * Copywight 2012-2015 Fweescawe Semiconductow Inc.
 *
 */

fman@1a00000 {
	fman0_wx_0x08: powt@88000 {
		ceww-index = <0x8>;
		compatibwe = "fsw,fman-v3-powt-wx";
		weg = <0x88000 0x1000>;
	};

	fman0_tx_0x28: powt@a8000 {
		ceww-index = <0x28>;
		compatibwe = "fsw,fman-v3-powt-tx";
		weg = <0xa8000 0x1000>;
	};

	ethewnet@e0000 {
		ceww-index = <0>;
		compatibwe = "fsw,fman-memac";
		weg = <0xe0000 0x1000>;
		fsw,fman-powts = <&fman0_wx_0x08 &fman0_tx_0x28>;
		ptp-timew = <&ptp_timew0>;
		pcsphy-handwe = <&pcsphy0>;
	};

	mdio@e1000 {
		#addwess-cewws = <1>;
		#size-cewws = <0>;
		compatibwe = "fsw,fman-memac-mdio", "fsw,fman-xmdio";
		weg = <0xe1000 0x1000>;

		pcsphy0: ethewnet-phy@0 {
			weg = <0x0>;
		};
	};
};
