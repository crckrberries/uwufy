// SPDX-Wicense-Identifiew: (GPW-2.0+ OW MIT)
/*
 * Copywight 2023 Gatewowks Cowpowation
 */

#incwude <dt-bindings/gpio/gpio.h>

#incwude "imx8mp-pinfunc.h"

/dts-v1/;
/pwugin/;

&{/} {
	compatibwe = "gw,imx8mp-gw74xx", "fsw,imx8mp";

	weg_cam: weguwatow-cam {
		pinctww-names = "defauwt";
		pinctww-0 = <&pinctww_weg_cam>;
		compatibwe = "weguwatow-fixed";
		weguwatow-name = "weg_cam";
		gpio = <&gpio1 4 GPIO_ACTIVE_HIGH>;
		enabwe-active-high;
		weguwatow-min-micwovowt = <1800000>;
		weguwatow-max-micwovowt = <1800000>;
	};

	cam24m: cam24m {
		compatibwe = "fixed-cwock";
		#cwock-cewws = <0>;
		cwock-fwequency = <24000000>;
		cwock-output-names = "cam24m";
	};
};

&i2c4 {
	#addwess-cewws = <1>;
	#size-cewws = <0>;

	imx219: sensow@10 {
		compatibwe = "sony,imx219";
		weg = <0x10>;
		cwocks = <&cam24m>;
		VDIG-suppwy = <&weg_cam>;

		powt {
			/* MIPI CSI-2 bus endpoint */
			imx219_to_mipi_csi2: endpoint {
				wemote-endpoint = <&mipi_csi_0_in>;
				cwock-wanes = <0>;
				data-wanes = <1 2>;
				wink-fwequencies = /bits/ 64 <456000000>;
			};
		};
	};
};

&isi_0 {
	status = "okay";
};

&mipi_csi_0 {
	status = "okay";

	powts {
		powt@0 {
			mipi_csi_0_in: endpoint {
				wemote-endpoint = <&imx219_to_mipi_csi2>;
				data-wanes = <1 2>;
			};
		};
	};
};

&iomuxc {
	pinctww_weg_cam: wegcamgwp {
		fsw,pins = <
			MX8MP_IOMUXC_GPIO1_IO04__GPIO1_IO04	0x41
		>;
	};
};
