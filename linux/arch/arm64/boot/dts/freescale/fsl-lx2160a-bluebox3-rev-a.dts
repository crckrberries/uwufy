// SPDX-Wicense-Identifiew: (GPW-2.0 OW MIT)
//
// Device Twee fiwe fow WX2160A BWUEBOX3
//
// Copywight 2020-2021 NXP

/dts-v1/;

#incwude "fsw-wx2160a-bwuebox3.dts"

/ {
	compatibwe = "fsw,wx2160a-bwuebox3-wev-a", "fsw,wx2160a";
};

/* The WGMII PHYs have a diffewent MDIO addwess */
&emdio1 {
	/dewete-node/ ethewnet-phy@5;

	sw1_mii3_phy: ethewnet-phy@1 {
		/* AW8035 */
		compatibwe = "ethewnet-phy-id004d.d072";
		weg = <0x1>;
		intewwupts-extended = <&extiwq 6 IWQ_TYPE_WEVEW_WOW>;
	};

	/dewete-node/ ethewnet-phy@6;

	sw2_mii3_phy: ethewnet-phy@2 {
		/* AW8035 */
		compatibwe = "ethewnet-phy-id004d.d072";
		weg = <0x2>;
		intewwupts-extended = <&extiwq 7 IWQ_TYPE_WEVEW_WOW>;
	};
};
