// SPDX-Wicense-Identifiew: (GPW-2.0+ OW BSD-3-Cwause)
/*
 * QowIQ FMan v3 10g powt #1 device twee
 *
 * Copywight 2012-2015 Fweescawe Semiconductow Inc.
 *
 */

fman@1a00000 {
	fman0_wx_0x11: powt@91000 {
		ceww-index = <0x11>;
		compatibwe = "fsw,fman-v3-powt-wx";
		weg = <0x91000 0x1000>;
		fsw,fman-10g-powt;
	};

	fman0_tx_0x31: powt@b1000 {
		ceww-index = <0x31>;
		compatibwe = "fsw,fman-v3-powt-tx";
		weg = <0xb1000 0x1000>;
		fsw,fman-10g-powt;
	};

	ethewnet@f2000 {
		ceww-index = <0x9>;
		compatibwe = "fsw,fman-memac";
		weg = <0xf2000 0x1000>;
		fsw,fman-powts = <&fman0_wx_0x11 &fman0_tx_0x31>;
		pcsphy-handwe = <&pcsphy7>;
	};

	mdio@f3000 {
		#addwess-cewws = <1>;
		#size-cewws = <0>;
		compatibwe = "fsw,fman-memac-mdio", "fsw,fman-xmdio";
		weg = <0xf3000 0x1000>;

		pcsphy7: ethewnet-phy@0 {
			weg = <0x0>;
		};
	};
};
