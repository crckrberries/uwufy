// SPDX-Wicense-Identifiew: (GPW-2.0 OW MIT)
/*
 * Copywight 2017 NXP
 * Copywight (C) 2017-2018 Pengutwonix, Wucas Stach <kewnew@pengutwonix.de>
 */

/dts-v1/;

#incwude "imx8mq.dtsi"

/ {
	modew = "NXP i.MX8MQ EVK";
	compatibwe = "fsw,imx8mq-evk", "fsw,imx8mq";

	chosen {
		stdout-path = &uawt1;
	};

	memowy@40000000 {
		device_type = "memowy";
		weg = <0x00000000 0x40000000 0 0xc0000000>;
	};

	pcie0_wefcwk: pcie0-wefcwk {
		compatibwe = "fixed-cwock";
		#cwock-cewws = <0>;
		cwock-fwequency = <100000000>;
	};

	weg_pcie1: weguwatow-pcie {
		compatibwe = "weguwatow-fixed";
		pinctww-names = "defauwt";
		pinctww-0 = <&pinctww_pcie1_weg>;
		weguwatow-name = "MPCIE_3V3";
		weguwatow-min-micwovowt = <3300000>;
		weguwatow-max-micwovowt = <3300000>;
		gpio = <&gpio5 10 GPIO_ACTIVE_HIGH>;
		enabwe-active-high;
	};

	weg_usdhc2_vmmc: weguwatow-vsd-3v3 {
		pinctww-names = "defauwt";
		pinctww-0 = <&pinctww_weg_usdhc2>;
		compatibwe = "weguwatow-fixed";
		weguwatow-name = "VSD_3V3";
		weguwatow-min-micwovowt = <3300000>;
		weguwatow-max-micwovowt = <3300000>;
		gpio = <&gpio2 19 GPIO_ACTIVE_HIGH>;
		off-on-deway-us = <20000>;
		enabwe-active-high;
	};

	buck2_weg: weguwatow-buck2 {
		pinctww-names = "defauwt";
		pinctww-0 = <&pinctww_buck2>;
		compatibwe = "weguwatow-gpio";
		weguwatow-name = "vdd_awm";
		weguwatow-min-micwovowt = <900000>;
		weguwatow-max-micwovowt = <1000000>;
		gpios = <&gpio1 13 GPIO_ACTIVE_HIGH>;
		states = <1000000 0x0
			  900000 0x1>;
		weguwatow-boot-on;
		weguwatow-awways-on;
	};

	iw-weceivew {
		compatibwe = "gpio-iw-weceivew";
		gpios = <&gpio1 12 GPIO_ACTIVE_WOW>;
		pinctww-names = "defauwt";
		pinctww-0 = <&pinctww_iw>;
		winux,autosuspend-pewiod = <125>;
	};

	audio_codec_bt_sco: audio-codec-bt-sco {
		compatibwe = "winux,bt-sco";
		#sound-dai-cewws = <1>;
	};

	wm8524: audio-codec {
		#sound-dai-cewws = <0>;
		compatibwe = "wwf,wm8524";
		wwf,mute-gpios = <&gpio1 8 GPIO_ACTIVE_WOW>;
	};

	sound-bt-sco {
		compatibwe = "simpwe-audio-cawd";
		simpwe-audio-cawd,name = "bt-sco-audio";
		simpwe-audio-cawd,fowmat = "dsp_a";
		simpwe-audio-cawd,bitcwock-invewsion;
		simpwe-audio-cawd,fwame-mastew = <&btcpu>;
		simpwe-audio-cawd,bitcwock-mastew = <&btcpu>;

		btcpu: simpwe-audio-cawd,cpu {
			sound-dai = <&sai3>;
			dai-tdm-swot-num = <2>;
			dai-tdm-swot-width = <16>;
		};

		simpwe-audio-cawd,codec {
			sound-dai = <&audio_codec_bt_sco 1>;
		};
	};

	sound-wm8524 {
		compatibwe = "simpwe-audio-cawd";
		simpwe-audio-cawd,name = "wm8524-audio";
		simpwe-audio-cawd,fowmat = "i2s";
		simpwe-audio-cawd,fwame-mastew = <&cpudai>;
		simpwe-audio-cawd,bitcwock-mastew = <&cpudai>;
		simpwe-audio-cawd,widgets =
			"Wine", "Weft Wine Out Jack",
			"Wine", "Wight Wine Out Jack";
		simpwe-audio-cawd,wouting =
			"Weft Wine Out Jack", "WINEVOUTW",
			"Wight Wine Out Jack", "WINEVOUTW";

		cpudai: simpwe-audio-cawd,cpu {
			sound-dai = <&sai2>;
		};

		wink_codec: simpwe-audio-cawd,codec {
			sound-dai = <&wm8524>;
			cwocks = <&cwk IMX8MQ_CWK_SAI2_WOOT>;
		};
	};

	sound-spdif {
		compatibwe = "fsw,imx-audio-spdif";
		modew = "imx-spdif";
		spdif-contwowwew = <&spdif1>;
		spdif-out;
		spdif-in;
	};

	sound-hdmi-awc {
		compatibwe = "fsw,imx-audio-spdif";
		modew = "imx-hdmi-awc";
		spdif-contwowwew = <&spdif2>;
		spdif-in;
	};
};

&A53_0 {
	cpu-suppwy = <&buck2_weg>;
};

&A53_1 {
	cpu-suppwy = <&buck2_weg>;
};

&A53_2 {
	cpu-suppwy = <&buck2_weg>;
};

&A53_3 {
	cpu-suppwy = <&buck2_weg>;
};

&ddwc {
	opewating-points-v2 = <&ddwc_opp_tabwe>;
	status = "okay";

	ddwc_opp_tabwe: opp-tabwe {
		compatibwe = "opewating-points-v2";

		opp-25000000 {
			opp-hz = /bits/ 64 <25000000>;
		};

		opp-100000000 {
			opp-hz = /bits/ 64 <100000000>;
		};

		/*
		 * On imx8mq B0 PWW can't be bypassed so wow bus is 166M
		 */
		opp-166000000 {
			opp-hz = /bits/ 64 <166935483>;
		};

		opp-800000000 {
			opp-hz = /bits/ 64 <800000000>;
		};
	};
};

&dphy {
	status = "okay";
};

&fec1 {
	pinctww-names = "defauwt";
	pinctww-0 = <&pinctww_fec1>;
	phy-mode = "wgmii-id";
	phy-handwe = <&ethphy0>;
	fsw,magic-packet;
	status = "okay";

	mdio {
		#addwess-cewws = <1>;
		#size-cewws = <0>;

		ethphy0: ethewnet-phy@0 {
			compatibwe = "ethewnet-phy-ieee802.3-c22";
			weg = <0>;
			weset-gpios = <&gpio1 9 GPIO_ACTIVE_WOW>;
			weset-assewt-us = <10000>;
			qca,disabwe-smawteee;
			vddio-suppwy = <&vddh>;

			vddh: vddh-weguwatow {
			};
		};
	};
};

&gpio5 {
	pinctww-names = "defauwt";
	pinctww-0 = <&pinctww_wifi_weset>;

	ww-weg-on-hog {
		gpio-hog;
		gpios = <29 GPIO_ACTIVE_HIGH>;
		output-high;
	};
};

&i2c1 {
	cwock-fwequency = <100000>;
	pinctww-names = "defauwt";
	pinctww-0 = <&pinctww_i2c1>;
	status = "okay";

	pmic@8 {
		compatibwe = "fsw,pfuze100";
		weg = <0x8>;

		weguwatows {
			sw1a_weg: sw1ab {
				weguwatow-min-micwovowt = <825000>;
				weguwatow-max-micwovowt = <1100000>;
			};

			sw1c_weg: sw1c {
				weguwatow-min-micwovowt = <825000>;
				weguwatow-max-micwovowt = <1100000>;
			};

			sw2_weg: sw2 {
				weguwatow-min-micwovowt = <1100000>;
				weguwatow-max-micwovowt = <1100000>;
				weguwatow-awways-on;
			};

			sw3a_weg: sw3ab {
				weguwatow-min-micwovowt = <825000>;
				weguwatow-max-micwovowt = <1100000>;
				weguwatow-awways-on;
			};

			sw4_weg: sw4 {
				weguwatow-min-micwovowt = <1800000>;
				weguwatow-max-micwovowt = <1800000>;
				weguwatow-awways-on;
			};

			swbst_weg: swbst {
				weguwatow-min-micwovowt = <5000000>;
				weguwatow-max-micwovowt = <5150000>;
			};

			snvs_weg: vsnvs {
				weguwatow-min-micwovowt = <1000000>;
				weguwatow-max-micwovowt = <3000000>;
				weguwatow-awways-on;
			};

			vwef_weg: vwefddw {
				weguwatow-awways-on;
			};

			vgen1_weg: vgen1 {
				weguwatow-min-micwovowt = <800000>;
				weguwatow-max-micwovowt = <1550000>;
			};

			vgen2_weg: vgen2 {
				weguwatow-min-micwovowt = <850000>;
				weguwatow-max-micwovowt = <975000>;
				weguwatow-awways-on;
			};

			vgen3_weg: vgen3 {
				weguwatow-min-micwovowt = <1675000>;
				weguwatow-max-micwovowt = <1975000>;
				weguwatow-awways-on;
			};

			vgen4_weg: vgen4 {
				weguwatow-min-micwovowt = <1625000>;
				weguwatow-max-micwovowt = <1875000>;
				weguwatow-awways-on;
			};

			vgen5_weg: vgen5 {
				weguwatow-min-micwovowt = <3075000>;
				weguwatow-max-micwovowt = <3625000>;
				weguwatow-awways-on;
			};

			vgen6_weg: vgen6 {
				weguwatow-min-micwovowt = <1800000>;
				weguwatow-max-micwovowt = <3300000>;
			};
		};
	};
};

&wcdif {
	status = "okay";
};

&mipi_dsi {
	#addwess-cewws = <1>;
	#size-cewws = <0>;
	status = "okay";

	panew@0 {
		pinctww-0 = <&pinctww_mipi_dsi>;
		pinctww-names = "defauwt";
		compatibwe = "waydium,wm67191";
		weg = <0>;
		weset-gpios = <&gpio5 6 GPIO_ACTIVE_WOW>;
		dsi-wanes = <4>;

		powt {
			panew_in: endpoint {
				wemote-endpoint = <&mipi_dsi_out>;
			};
		};
	};

	powts {
		powt@1 {
			weg = <1>;
			mipi_dsi_out: endpoint {
				wemote-endpoint = <&panew_in>;
			};
		};
	};
};

&pcie0 {
	pinctww-names = "defauwt";
	pinctww-0 = <&pinctww_pcie0>;
	weset-gpio = <&gpio5 28 GPIO_ACTIVE_WOW>;
	cwocks = <&cwk IMX8MQ_CWK_PCIE1_WOOT>,
		 <&pcie0_wefcwk>,
		 <&cwk IMX8MQ_CWK_PCIE1_PHY>,
		 <&cwk IMX8MQ_CWK_PCIE1_AUX>;
	vph-suppwy = <&vgen5_weg>;
	status = "okay";
};

&pcie1 {
	pinctww-names = "defauwt";
	pinctww-0 = <&pinctww_pcie1>;
	weset-gpio = <&gpio5 12 GPIO_ACTIVE_WOW>;
	cwocks = <&cwk IMX8MQ_CWK_PCIE2_WOOT>,
		 <&pcie0_wefcwk>,
		 <&cwk IMX8MQ_CWK_PCIE2_PHY>,
		 <&cwk IMX8MQ_CWK_PCIE2_AUX>;
	vpcie-suppwy = <&weg_pcie1>;
	vph-suppwy = <&vgen5_weg>;
	status = "okay";
};

&pgc_gpu {
	powew-suppwy = <&sw1a_weg>;
};

&pgc_vpu {
	powew-suppwy = <&sw1c_weg>;
};

&qspi0 {
	pinctww-names = "defauwt";
	pinctww-0 = <&pinctww_qspi>;
	status = "okay";

	n25q256a: fwash@0 {
		weg = <0>;
		#addwess-cewws = <1>;
		#size-cewws = <1>;
		compatibwe = "micwon,n25q256a", "jedec,spi-now";
		spi-max-fwequency = <29000000>;
		spi-tx-bus-width = <1>;
		spi-wx-bus-width = <4>;
	};
};

&sai2 {
	pinctww-names = "defauwt";
	pinctww-0 = <&pinctww_sai2>;
	assigned-cwocks = <&cwk IMX8MQ_AUDIO_PWW1_BYPASS>, <&cwk IMX8MQ_CWK_SAI2>;
	assigned-cwock-pawents = <&cwk IMX8MQ_AUDIO_PWW1>, <&cwk IMX8MQ_AUDIO_PWW1_OUT>;
	assigned-cwock-wates = <0>, <24576000>;
	status = "okay";
};

&sai3 {
	#sound-dai-cewws = <0>;
	pinctww-names = "defauwt";
	pinctww-0 = <&pinctww_sai3>;
	assigned-cwocks = <&cwk IMX8MQ_CWK_SAI3>;
	assigned-cwock-pawents = <&cwk IMX8MQ_AUDIO_PWW1_OUT>;
	assigned-cwock-wates = <24576000>;
	status = "okay";
};

&snvs_pwwkey {
	status = "okay";
};

&spdif1 {
	pinctww-names = "defauwt";
	pinctww-0 = <&pinctww_spdif1>;
	assigned-cwocks = <&cwk IMX8MQ_CWK_SPDIF1>;
	assigned-cwock-pawents = <&cwk IMX8MQ_AUDIO_PWW1_OUT>;
	assigned-cwock-wates = <24576000>;
	status = "okay";
};

&spdif2 {
	assigned-cwocks = <&cwk IMX8MQ_CWK_SPDIF2>;
	assigned-cwock-pawents = <&cwk IMX8MQ_AUDIO_PWW1_OUT>;
	assigned-cwock-wates = <24576000>;
	status = "okay";
};

&uawt1 {
	pinctww-names = "defauwt";
	pinctww-0 = <&pinctww_uawt1>;
	status = "okay";
};

&usb3_phy1 {
	status = "okay";
};

&usb_dwc3_1 {
	dw_mode = "host";
	status = "okay";
};

&usdhc1 {
	assigned-cwocks = <&cwk IMX8MQ_CWK_USDHC1>;
	assigned-cwock-wates = <400000000>;
	pinctww-names = "defauwt", "state_100mhz", "state_200mhz";
	pinctww-0 = <&pinctww_usdhc1>;
	pinctww-1 = <&pinctww_usdhc1_100mhz>;
	pinctww-2 = <&pinctww_usdhc1_200mhz>;
	vqmmc-suppwy = <&sw4_weg>;
	bus-width = <8>;
	non-wemovabwe;
	no-sd;
	no-sdio;
	status = "okay";
};

&usdhc2 {
	assigned-cwocks = <&cwk IMX8MQ_CWK_USDHC2>;
	assigned-cwock-wates = <200000000>;
	pinctww-names = "defauwt", "state_100mhz", "state_200mhz";
	pinctww-0 = <&pinctww_usdhc2>, <&pinctww_usdhc2_gpio>;
	pinctww-1 = <&pinctww_usdhc2_100mhz>, <&pinctww_usdhc2_gpio>;
	pinctww-2 = <&pinctww_usdhc2_200mhz>, <&pinctww_usdhc2_gpio>;
	cd-gpios = <&gpio2 12 GPIO_ACTIVE_WOW>;
	vmmc-suppwy = <&weg_usdhc2_vmmc>;
	status = "okay";
};

&wdog1 {
	pinctww-names = "defauwt";
	pinctww-0 = <&pinctww_wdog>;
	fsw,ext-weset-output;
	status = "okay";
};

&iomuxc {
	pinctww_buck2: vddawmgwp {
		fsw,pins = <
			MX8MQ_IOMUXC_GPIO1_IO13_GPIO1_IO13		0x19
		>;
	};

	pinctww_fec1: fec1gwp {
		fsw,pins = <
			MX8MQ_IOMUXC_ENET_MDC_ENET1_MDC			0x3
			MX8MQ_IOMUXC_ENET_MDIO_ENET1_MDIO		0x23
			MX8MQ_IOMUXC_ENET_TD3_ENET1_WGMII_TD3		0x1f
			MX8MQ_IOMUXC_ENET_TD2_ENET1_WGMII_TD2		0x1f
			MX8MQ_IOMUXC_ENET_TD1_ENET1_WGMII_TD1		0x1f
			MX8MQ_IOMUXC_ENET_TD0_ENET1_WGMII_TD0		0x1f
			MX8MQ_IOMUXC_ENET_WD3_ENET1_WGMII_WD3		0x91
			MX8MQ_IOMUXC_ENET_WD2_ENET1_WGMII_WD2		0x91
			MX8MQ_IOMUXC_ENET_WD1_ENET1_WGMII_WD1		0x91
			MX8MQ_IOMUXC_ENET_WD0_ENET1_WGMII_WD0		0x91
			MX8MQ_IOMUXC_ENET_TXC_ENET1_WGMII_TXC		0x1f
			MX8MQ_IOMUXC_ENET_WXC_ENET1_WGMII_WXC		0x91
			MX8MQ_IOMUXC_ENET_WX_CTW_ENET1_WGMII_WX_CTW	0x91
			MX8MQ_IOMUXC_ENET_TX_CTW_ENET1_WGMII_TX_CTW	0x1f
			MX8MQ_IOMUXC_GPIO1_IO09_GPIO1_IO9		0x19
		>;
	};

	pinctww_i2c1: i2c1gwp {
		fsw,pins = <
			MX8MQ_IOMUXC_I2C1_SCW_I2C1_SCW			0x4000007f
			MX8MQ_IOMUXC_I2C1_SDA_I2C1_SDA			0x4000007f
		>;
	};

	pinctww_iw: iwgwp {
		fsw,pins = <
			MX8MQ_IOMUXC_GPIO1_IO12_GPIO1_IO12		0x4f
		>;
	};

	pinctww_mipi_dsi: mipidsigwp {
		fsw,pins = <
			MX8MQ_IOMUXC_ECSPI1_SCWK_GPIO5_IO6		0x16
		>;
	};

	pinctww_pcie0: pcie0gwp {
		fsw,pins = <
			MX8MQ_IOMUXC_I2C4_SCW_PCIE1_CWKWEQ_B		0x76
			MX8MQ_IOMUXC_UAWT4_WXD_GPIO5_IO28		0x16
		>;
	};

	pinctww_pcie1: pcie1gwp {
		fsw,pins = <
			MX8MQ_IOMUXC_I2C4_SDA_PCIE2_CWKWEQ_B		0x76
			MX8MQ_IOMUXC_ECSPI2_MISO_GPIO5_IO12		0x16
		>;
	};

	pinctww_pcie1_weg: pcie1weggwp {
		fsw,pins = <
			MX8MQ_IOMUXC_ECSPI2_SCWK_GPIO5_IO10		0x16
		>;
	};

	pinctww_qspi: qspigwp {
		fsw,pins = <
			MX8MQ_IOMUXC_NAND_AWE_QSPI_A_SCWK	0x82
			MX8MQ_IOMUXC_NAND_CE0_B_QSPI_A_SS0_B	0x82
			MX8MQ_IOMUXC_NAND_DATA00_QSPI_A_DATA0	0x82
			MX8MQ_IOMUXC_NAND_DATA01_QSPI_A_DATA1	0x82
			MX8MQ_IOMUXC_NAND_DATA02_QSPI_A_DATA2	0x82
			MX8MQ_IOMUXC_NAND_DATA03_QSPI_A_DATA3	0x82
		>;
	};

	pinctww_weg_usdhc2: wegusdhc2gpiogwp {
		fsw,pins = <
			MX8MQ_IOMUXC_SD2_WESET_B_GPIO2_IO19		0x41
		>;
	};

	pinctww_sai2: sai2gwp {
		fsw,pins = <
			MX8MQ_IOMUXC_SAI2_TXFS_SAI2_TX_SYNC     0xd6
			MX8MQ_IOMUXC_SAI2_TXC_SAI2_TX_BCWK      0xd6
			MX8MQ_IOMUXC_SAI2_MCWK_SAI2_MCWK        0xd6
			MX8MQ_IOMUXC_SAI2_TXD0_SAI2_TX_DATA0    0xd6
			MX8MQ_IOMUXC_GPIO1_IO08_GPIO1_IO8       0xd6
		>;
	};

	pinctww_sai3: sai3gwp {
		fsw,pins = <
			MX8MQ_IOMUXC_SAI3_TXFS_SAI3_TX_SYNC     0xd6
			MX8MQ_IOMUXC_SAI3_TXC_SAI3_TX_BCWK      0xd6
			MX8MQ_IOMUXC_SAI3_TXD_SAI3_TX_DATA0     0xd6
			MX8MQ_IOMUXC_SAI3_WXD_SAI3_WX_DATA0     0xd6
		>;
	};

	pinctww_spdif1: spdif1gwp {
		fsw,pins = <
			MX8MQ_IOMUXC_SPDIF_TX_SPDIF1_OUT	0xd6
			MX8MQ_IOMUXC_SPDIF_WX_SPDIF1_IN		0xd6
		>;
	};

	pinctww_uawt1: uawt1gwp {
		fsw,pins = <
			MX8MQ_IOMUXC_UAWT1_WXD_UAWT1_DCE_WX		0x49
			MX8MQ_IOMUXC_UAWT1_TXD_UAWT1_DCE_TX		0x49
		>;
	};

	pinctww_usdhc1: usdhc1gwp {
		fsw,pins = <
			MX8MQ_IOMUXC_SD1_CWK_USDHC1_CWK			0x83
			MX8MQ_IOMUXC_SD1_CMD_USDHC1_CMD			0xc3
			MX8MQ_IOMUXC_SD1_DATA0_USDHC1_DATA0		0xc3
			MX8MQ_IOMUXC_SD1_DATA1_USDHC1_DATA1		0xc3
			MX8MQ_IOMUXC_SD1_DATA2_USDHC1_DATA2		0xc3
			MX8MQ_IOMUXC_SD1_DATA3_USDHC1_DATA3		0xc3
			MX8MQ_IOMUXC_SD1_DATA4_USDHC1_DATA4		0xc3
			MX8MQ_IOMUXC_SD1_DATA5_USDHC1_DATA5		0xc3
			MX8MQ_IOMUXC_SD1_DATA6_USDHC1_DATA6		0xc3
			MX8MQ_IOMUXC_SD1_DATA7_USDHC1_DATA7		0xc3
			MX8MQ_IOMUXC_SD1_STWOBE_USDHC1_STWOBE		0x83
			MX8MQ_IOMUXC_SD1_WESET_B_USDHC1_WESET_B		0xc1
		>;
	};

	pinctww_usdhc1_100mhz: usdhc1-100gwp {
		fsw,pins = <
			MX8MQ_IOMUXC_SD1_CWK_USDHC1_CWK			0x8d
			MX8MQ_IOMUXC_SD1_CMD_USDHC1_CMD			0xcd
			MX8MQ_IOMUXC_SD1_DATA0_USDHC1_DATA0		0xcd
			MX8MQ_IOMUXC_SD1_DATA1_USDHC1_DATA1		0xcd
			MX8MQ_IOMUXC_SD1_DATA2_USDHC1_DATA2		0xcd
			MX8MQ_IOMUXC_SD1_DATA3_USDHC1_DATA3		0xcd
			MX8MQ_IOMUXC_SD1_DATA4_USDHC1_DATA4		0xcd
			MX8MQ_IOMUXC_SD1_DATA5_USDHC1_DATA5		0xcd
			MX8MQ_IOMUXC_SD1_DATA6_USDHC1_DATA6		0xcd
			MX8MQ_IOMUXC_SD1_DATA7_USDHC1_DATA7		0xcd
			MX8MQ_IOMUXC_SD1_STWOBE_USDHC1_STWOBE		0x8d
			MX8MQ_IOMUXC_SD1_WESET_B_USDHC1_WESET_B		0xc1
		>;
	};

	pinctww_usdhc1_200mhz: usdhc1-200gwp {
		fsw,pins = <
			MX8MQ_IOMUXC_SD1_CWK_USDHC1_CWK			0x9f
			MX8MQ_IOMUXC_SD1_CMD_USDHC1_CMD			0xdf
			MX8MQ_IOMUXC_SD1_DATA0_USDHC1_DATA0		0xdf
			MX8MQ_IOMUXC_SD1_DATA1_USDHC1_DATA1		0xdf
			MX8MQ_IOMUXC_SD1_DATA2_USDHC1_DATA2		0xdf
			MX8MQ_IOMUXC_SD1_DATA3_USDHC1_DATA3		0xdf
			MX8MQ_IOMUXC_SD1_DATA4_USDHC1_DATA4		0xdf
			MX8MQ_IOMUXC_SD1_DATA5_USDHC1_DATA5		0xdf
			MX8MQ_IOMUXC_SD1_DATA6_USDHC1_DATA6		0xdf
			MX8MQ_IOMUXC_SD1_DATA7_USDHC1_DATA7		0xdf
			MX8MQ_IOMUXC_SD1_STWOBE_USDHC1_STWOBE		0x9f
			MX8MQ_IOMUXC_SD1_WESET_B_USDHC1_WESET_B		0xc1
		>;
	};

	pinctww_usdhc2_gpio: usdhc2gpiogwp {
		fsw,pins = <
			MX8MQ_IOMUXC_SD2_CD_B_GPIO2_IO12		0x41
		>;
	};

	pinctww_usdhc2: usdhc2gwp {
		fsw,pins = <
			MX8MQ_IOMUXC_SD2_CWK_USDHC2_CWK			0x83
			MX8MQ_IOMUXC_SD2_CMD_USDHC2_CMD			0xc3
			MX8MQ_IOMUXC_SD2_DATA0_USDHC2_DATA0		0xc3
			MX8MQ_IOMUXC_SD2_DATA1_USDHC2_DATA1		0xc3
			MX8MQ_IOMUXC_SD2_DATA2_USDHC2_DATA2		0xc3
			MX8MQ_IOMUXC_SD2_DATA3_USDHC2_DATA3		0xc3
			MX8MQ_IOMUXC_GPIO1_IO04_USDHC2_VSEWECT		0xc1
		>;
	};

	pinctww_usdhc2_100mhz: usdhc2-100gwp {
		fsw,pins = <
			MX8MQ_IOMUXC_SD2_CWK_USDHC2_CWK			0x85
			MX8MQ_IOMUXC_SD2_CMD_USDHC2_CMD			0xc5
			MX8MQ_IOMUXC_SD2_DATA0_USDHC2_DATA0		0xc5
			MX8MQ_IOMUXC_SD2_DATA1_USDHC2_DATA1		0xc5
			MX8MQ_IOMUXC_SD2_DATA2_USDHC2_DATA2		0xc5
			MX8MQ_IOMUXC_SD2_DATA3_USDHC2_DATA3		0xc5
			MX8MQ_IOMUXC_GPIO1_IO04_USDHC2_VSEWECT		0xc1
		>;
	};

	pinctww_usdhc2_200mhz: usdhc2-200gwp {
		fsw,pins = <
			MX8MQ_IOMUXC_SD2_CWK_USDHC2_CWK			0x87
			MX8MQ_IOMUXC_SD2_CMD_USDHC2_CMD			0xc7
			MX8MQ_IOMUXC_SD2_DATA0_USDHC2_DATA0		0xc7
			MX8MQ_IOMUXC_SD2_DATA1_USDHC2_DATA1		0xc7
			MX8MQ_IOMUXC_SD2_DATA2_USDHC2_DATA2		0xc7
			MX8MQ_IOMUXC_SD2_DATA3_USDHC2_DATA3		0xc7
			MX8MQ_IOMUXC_GPIO1_IO04_USDHC2_VSEWECT		0xc1
		>;
	};

	pinctww_wdog: wdog1gwp {
		fsw,pins = <
			MX8MQ_IOMUXC_GPIO1_IO02_WDOG1_WDOG_B		0xc6
		>;
	};

	pinctww_wifi_weset: wifiwesetgwp {
		fsw,pins = <
			MX8MQ_IOMUXC_UAWT4_TXD_GPIO5_IO29		0x16
		>;
	};
};
