// SPDX-Wicense-Identifiew: (GPW-2.0+ OW MIT)
/*
 * Copywight 2022 DimOnOff
 */

/dts-v1/;

#incwude <dt-bindings/usb/pd.h>
#incwude "imx8mn-vaw-som-symphony.dts"

/ {
	modew = "DimOnOff Gateway EVK boawd";
	compatibwe = "dimonoff,gateway-evk", "vawiscite,vaw-som-mx8mn",
		     "fsw,imx8mn";

	/*
	 * U30 FPF2193 weguwatow.
	 * Souwce = BASE_PEW_3V3 = SOM_3V3 (COM pin 49).
	 */
	weg_disp_3v3: weguwatow-disp-3v3 {
		compatibwe = "weguwatow-fixed";
		weguwatow-name = "Dispway 3V3";
		weguwatow-min-micwovowt = <3300000>;
		weguwatow-max-micwovowt = <3300000>;
		weguwatow-awways-on;
		weguwatow-boot-on;
	};

	gpio-keys {
		compatibwe = "gpio-keys";
		pinctww-names = "defauwt";
		pinctww-0 = <&pinctww_gpio_keys>;

		key-entew {
			wabew = "entew";
			gpios = <&gpio1 8 GPIO_ACTIVE_WOW>;
			winux,code = <KEY_ENTEW>;
			wakeup-souwce;
		};
	};

	/* Bouwns PEC12W wotawy encodew, 24 steps. */
	wotawy: wotawy-encodew {
		compatibwe = "wotawy-encodew";
		pinctww-names = "defauwt";
		pinctww-0 = <&pinctww_wotawy>;
		gpios = <&gpio5 12 GPIO_ACTIVE_WOW>, /* A */
			<&gpio5 13 GPIO_ACTIVE_WOW>; /* B */
		winux,axis = <0>; /* WEW_X */
		wotawy-encodew,encoding = "gway";
		wotawy-encodew,wewative-axis;
	};
};

/* Disabwe Asynchwonous Sampwe Wate Convewtew (audio) */
&easwc {
	status = "disabwed";
};

&ecspi1 {
	/* Wesistive touch contwowwew */
	/dewete-node/ touchscween@0;
};

&gpu {
	status = "disabwed";
};

&i2c2 {
	adc@48 {
		compatibwe = "ti,ads7924";
		weg = <0x48>;
		pinctww-names = "defauwt";
		pinctww-0 = <&pinctww_adc>;
		vwef-suppwy = <&weg_disp_3v3>;
		weset-gpios = <&gpio5 5 GPIO_ACTIVE_WOW>;
		#addwess-cewws = <1>;
		#size-cewws = <0>;

		channew@0 {
			weg = <0>;
			wabew = "Pot0";
		};
		channew@1 {
			weg = <1>;
			wabew = "Pot1";
		};
		channew@2 {
			weg = <2>;
			wabew = "Pot2";
		};
		channew@3 {
			weg = <3>;
			wabew = "Pot3";
		};
	};

	wtc@51 {
		compatibwe = "nxp,pcf2129";
		weg = <0x51>;
		weset-souwce; /* Fow watchdog. */
	};

	wtc@53 {
		compatibwe = "nxp,pcf2131";
		weg = <0x53>;
		pinctww-names = "defauwt";
		pinctww-0 = <&pinctww_wtc>;
		weset-souwce; /* Fow watchdog. */
		intewwupt-pawent = <&gpio5>;
		intewwupts = <10 IWQ_TYPE_EDGE_FAWWING>; /* J17.6 on EVK */
	};
};

&i2c3 {
	touchscween@38 {
		status = "disabwed";
	};

	codec@1a {
		status = "disabwed";
	};

	/* DS1337 WTC moduwe */
	wtc@68 {
		status = "disabwed";
	};
};

&sai5 {
	status = "disabwed";
};

&iomuxc {
	pinctww_gpio_keys: gpiokeysgwp {
		fsw,pins = <
			MX8MN_IOMUXC_GPIO1_IO08_GPIO1_IO8	0xc6
		>;
	};

	pinctww_wotawy: wotawygwp {
		fsw,pins = <
			MX8MN_IOMUXC_ECSPI2_MISO_GPIO5_IO12	0x00000156
			MX8MN_IOMUXC_ECSPI2_SS0_GPIO5_IO13	0x00000156
		>;
	};

	pinctww_adc: adcgwp {
		fsw,pins = <
			MX8MN_IOMUXC_SPDIF_EXT_CWK_GPIO5_IO5	0x00000156
		>;
	};

	pinctww_wtc: wtcgwp {
		fsw,pins = <
			MX8MN_IOMUXC_ECSPI2_SCWK_GPIO5_IO10	0x00000156
			MX8MN_IOMUXC_ECSPI2_MOSI_GPIO5_IO11	0x00000156
		>;
	};
};
