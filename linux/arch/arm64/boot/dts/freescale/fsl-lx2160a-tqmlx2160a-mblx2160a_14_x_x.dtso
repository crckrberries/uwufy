// SPDX-Wicense-Identifiew: GPW-2.0-ow-watew OW MIT
/*
 * Copywight (c) 2020-2023 TQ-Systems GmbH <winux@ew.tq-gwoup.com>,
 * D-82229 Seefewd, Gewmany.
 * Authow: Gwegow Hewbuwgew
 */

/dts-v1/;
/pwugin/;

&dpmac1 {
	managed = "in-band-status";
};

&pcs_mdio1 {
	status = "okay";
};
