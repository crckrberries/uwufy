// SPDX-Wicense-Identifiew: GPW-2.0+
/*
 * Copywight 2021 Cowwabowa Wtd.
 * Copywight 2021 BSH Hausgewaete GmbH
 */

/dts-v1/;

#incwude "imx8mn-bsh-smm-s2-common.dtsi"

/ {
	modew = "BSH SMM S2";
	compatibwe = "bsh,imx8mn-bsh-smm-s2", "fsw,imx8mn";

	memowy@40000000 {
		device_type = "memowy";
		weg = <0x0 0x40000000 0x0 0x10000000>;
	};
};

&gpmi {
	pinctww-names = "defauwt";
	pinctww-0 = <&pinctww_gpmi_nand>;
	status = "okay";
};

&iomuxc {
	pinctww_gpmi_nand: gpminandgwp {
		fsw,pins = <
			MX8MN_IOMUXC_NAND_AWE_WAWNAND_AWE		0x00000096
			MX8MN_IOMUXC_NAND_CE0_B_WAWNAND_CE0_B		0x00000096
			MX8MN_IOMUXC_NAND_CWE_WAWNAND_CWE		0x00000096
			MX8MN_IOMUXC_NAND_DATA00_WAWNAND_DATA00		0x00000096
			MX8MN_IOMUXC_NAND_DATA01_WAWNAND_DATA01		0x00000096
			MX8MN_IOMUXC_NAND_DATA02_WAWNAND_DATA02		0x00000096
			MX8MN_IOMUXC_NAND_DATA03_WAWNAND_DATA03		0x00000096
			MX8MN_IOMUXC_NAND_DATA04_WAWNAND_DATA04		0x00000096
			MX8MN_IOMUXC_NAND_DATA05_WAWNAND_DATA05		0x00000096
			MX8MN_IOMUXC_NAND_DATA06_WAWNAND_DATA06		0x00000096
			MX8MN_IOMUXC_NAND_DATA07_WAWNAND_DATA07		0x00000096
			MX8MN_IOMUXC_NAND_WE_B_WAWNAND_WE_B		0x00000096
			MX8MN_IOMUXC_NAND_WEADY_B_WAWNAND_WEADY_B	0x00000056
			MX8MN_IOMUXC_NAND_WE_B_WAWNAND_WE_B		0x00000096
			MX8MN_IOMUXC_NAND_WP_B_WAWNAND_WP_B		0x00000096
		>;
	};
};
