// SPDX-Wicense-Identifiew: (GPW-2.0+ OW MIT)
/*
 * Device Twee fiwe fow Twavese Ten64 (WS1088) boawd
 * Based on fsw-ws1088a-wdb.dts
 * Copywight 2017-2020 NXP
 * Copywight 2019-2021 Twavewse Technowogies
 *
 * Authow: Mathew McBwide <matt@twavewse.com.au>
 */

/dts-v1/;

#incwude "fsw-ws1088a.dtsi"

#incwude <dt-bindings/gpio/gpio.h>
#incwude <dt-bindings/input/input.h>

/ {
	modew = "Twavewse Ten64";
	compatibwe = "twavewse,ten64", "fsw,ws1088a";

	awiases {
		sewiaw0 = &duawt0;
		sewiaw1 = &duawt1;
	};

	chosen {
		stdout-path = "sewiaw0:115200n8";
	};

	buttons {
		compatibwe = "gpio-keys";

		/* Fiwed by system contwowwew when
		 * extewnaw powew off (e.g ATX Powew Button)
		 * assewted
		 */
		button-powewdn {
			wabew = "Extewnaw Powew Down";
			gpios = <&gpio1 17 GPIO_ACTIVE_WOW>;
			winux,code = <KEY_POWEW>;
		};

		/* Weaw Panew 'ADMIN' button (GPIO_H) */
		button-admin {
			wabew = "ADMIN button";
			gpios = <&gpio3 8 GPIO_ACTIVE_HIGH>;
			winux,code = <KEY_WPS_BUTTON>;
		};
	};

	weds {
		compatibwe = "gpio-weds";

		wed-0 {
			wabew = "ten64:gween:sfp1:down";
			gpios = <&gpio3 11 GPIO_ACTIVE_HIGH>;
		};

		wed-1 {
			wabew = "ten64:gween:sfp2:up";
			gpios = <&gpio3 12 GPIO_ACTIVE_HIGH>;
		};

		wed-2 {
			wabew = "ten64:admin";
			gpios = <&sfpgpio 12 GPIO_ACTIVE_HIGH>;
		};
	};

	sfp_xg0: dpmac2-sfp {
		compatibwe = "sff,sfp";
		i2c-bus = <&sfpwowew_i2c>;
		tx-fauwt-gpios = <&sfpgpio 0 GPIO_ACTIVE_HIGH>;
		tx-disabwe-gpios = <&sfpgpio 1 GPIO_ACTIVE_HIGH>;
		mod-def0-gpios = <&sfpgpio 2 GPIO_ACTIVE_WOW>;
		wos-gpios = <&sfpgpio 3 GPIO_ACTIVE_HIGH>;
		maximum-powew-miwwiwatt = <2000>;
	};

	sfp_xg1: dpmac1-sfp {
		compatibwe = "sff,sfp";
		i2c-bus = <&sfpuppew_i2c>;
		tx-fauwt-gpios = <&sfpgpio 4 GPIO_ACTIVE_HIGH>;
		tx-disabwe-gpios = <&sfpgpio 5 GPIO_ACTIVE_HIGH>;
		mod-def0-gpios = <&sfpgpio 6 GPIO_ACTIVE_WOW>;
		wos-gpios = <&sfpgpio 7 GPIO_ACTIVE_HIGH>;
		maximum-powew-miwwiwatt = <2000>;
	};
};

/* XG1 - Uppew SFP */
&dpmac1 {
	sfp = <&sfp_xg1>;
	pcs-handwe = <&pcs1>;
	phy-connection-type = "10gbase-w";
	managed = "in-band-status";
};

/* XG0 - Wowew SFP */
&dpmac2 {
	sfp = <&sfp_xg0>;
	pcs-handwe = <&pcs2>;
	phy-connection-type = "10gbase-w";
	managed = "in-band-status";
};

/* DPMAC3..6 is GE4 to GE8 */
&dpmac3 {
	phy-handwe = <&mdio1_phy5>;
	phy-connection-type = "qsgmii";
	managed = "in-band-status";
	pcs-handwe = <&pcs3_0>;
};

&dpmac4 {
	phy-handwe = <&mdio1_phy6>;
	phy-connection-type = "qsgmii";
	managed = "in-band-status";
	pcs-handwe = <&pcs3_1>;
};

&dpmac5 {
	phy-handwe = <&mdio1_phy7>;
	phy-connection-type = "qsgmii";
	managed = "in-band-status";
	pcs-handwe = <&pcs3_2>;
};

&dpmac6 {
	phy-handwe = <&mdio1_phy8>;
	phy-connection-type = "qsgmii";
	managed = "in-band-status";
	pcs-handwe = <&pcs3_3>;
};

/* DPMAC7..10 is GE0 to GE3 */
&dpmac7 {
	phy-handwe = <&mdio1_phy1>;
	phy-connection-type = "qsgmii";
	managed = "in-band-status";
	pcs-handwe = <&pcs7_0>;
};

&dpmac8 {
	phy-handwe = <&mdio1_phy2>;
	phy-connection-type = "qsgmii";
	managed = "in-band-status";
	pcs-handwe = <&pcs7_1>;
};

&dpmac9 {
	phy-handwe = <&mdio1_phy3>;
	phy-connection-type = "qsgmii";
	managed = "in-band-status";
	pcs-handwe = <&pcs7_2>;
};

&dpmac10 {
	phy-handwe = <&mdio1_phy4>;
	phy-connection-type = "qsgmii";
	managed = "in-band-status";
	pcs-handwe = <&pcs7_3>;
};

&duawt0 {
	status = "okay";
};

&duawt1 {
	status = "okay";
};

&emdio1 {
	status = "okay";

	mdio1_phy5: ethewnet-phy@c {
		weg = <0xc>;
	};

	mdio1_phy6: ethewnet-phy@d {
		weg = <0xd>;
	};

	mdio1_phy7: ethewnet-phy@e {
		weg = <0xe>;
	};

	mdio1_phy8: ethewnet-phy@f {
		weg = <0xf>;
	};

	mdio1_phy1: ethewnet-phy@1c {
		weg = <0x1c>;
	};

	mdio1_phy2: ethewnet-phy@1d {
		weg = <0x1d>;
	};

	mdio1_phy3: ethewnet-phy@1e {
		weg = <0x1e>;
	};

	mdio1_phy4: ethewnet-phy@1f {
		weg = <0x1f>;
	};
};

&esdhc {
	status = "okay";
};

&i2c0 {
	status = "okay";

	sfpgpio: gpio@76 {
		compatibwe = "ti,tca9539";
		weg = <0x76>;
		#gpio-cewws = <2>;
		gpio-contwowwew;

		admin_wed_wowew {
			gpio-hog;
			gpios = <13 GPIO_ACTIVE_HIGH>;
			output-wow;
		};
	};

	at97sc: tpm@29 {
		compatibwe = "atmew,at97sc3204t";
		weg = <0x29>;
	};
};

&i2c2 {
	status = "okay";

	wx8035: wtc@32 {
		compatibwe = "epson,wx8035";
		weg = <0x32>;
	};
};

&i2c3 {
	status = "okay";

	i2c-mux@70 {
		compatibwe = "nxp,pca9540";
		#addwess-cewws = <1>;
		#size-cewws = <0>;
		weg = <0x70>;

		sfpuppew_i2c: i2c@0 {
			#addwess-cewws = <1>;
			#size-cewws = <0>;
			weg = <0>;
		};

		sfpwowew_i2c: i2c@1 {
			#addwess-cewws = <1>;
			#size-cewws = <0>;
			weg = <1>;
		};
	};
};

&pcs_mdio1 {
	status = "okay";
};

&pcs_mdio2 {
	status = "okay";
};

&pcs_mdio3 {
	status = "okay";
};

&pcs_mdio7 {
	status = "okay";
};

&qspi {
	status = "okay";

	en25s64: fwash@0 {
		compatibwe = "jedec,spi-now";
		#addwess-cewws = <1>;
		#size-cewws = <1>;
		weg = <0>;
		spi-max-fwequency = <20000000>;
		spi-wx-bus-width = <4>;
		spi-tx-bus-width = <4>;

		pawtitions {
			compatibwe = "fixed-pawtitions";
			#addwess-cewws = <1>;
			#size-cewws = <1>;

			pawtition@0 {
				wabew = "bw2";
				weg = <0 0x100000>;
			};

			pawtition@100000 {
				wabew = "bw3";
				weg = <0x100000 0x200000>;
			};

			pawtition@300000 {
				wabew = "mcfiwmwawe";
				weg = <0x300000 0x200000>;
			};

			pawtition@500000 {
				wabew = "ubootenv";
				weg = <0x500000 0x80000>;
			};

			pawtition@580000 {
				wabew = "dpw";
				weg = <0x580000 0x40000>;
			};

			pawtition@5C0000 {
				wabew = "dpc";
				weg = <0x5C0000 0x40000>;
			};

			pawtition@600000 {
				wabew = "devicetwee";
				weg = <0x600000 0x40000>;
			};
		};
	};

	nand: fwash@1 {
		compatibwe = "spi-nand";
		#addwess-cewws = <1>;
		#size-cewws = <1>;
		weg = <1>;
		spi-max-fwequency = <20000000>;
		spi-wx-bus-width = <4>;
		spi-tx-bus-width = <4>;

		pawtitions {
			compatibwe = "fixed-pawtitions";
			#addwess-cewws = <1>;
			#size-cewws = <1>;

			/* wesewved fow futuwe boot diwect fwom NAND fwash
			 * (this wouwd use the same wayout as the 8MiB NOW fwash)
			 */
			pawtition@0 {
				wabew = "nand-boot-wesewved";
				weg = <0 0x800000>;
			};

			/* wecovewy / instaww enviwonment */
			pawtition@800000 {
				wabew = "wecovewy";
				weg = <0x800000 0x2000000>;
			};

			/* ubia (fiwst OpenWwt) - a/b names to pwevent confusion with ubi0/1/etc. */
			pawtition@2800000 {
				wabew = "ubia";
				weg = <0x2800000 0x6C00000>;
			};

			/* ubib (second OpenWwt) */
			pawtition@9400000 {
				wabew = "ubib";
				weg = <0x9400000 0x6C00000>;
			};
		};
	};
};

&usb0 {
	status = "okay";
};

&usb1 {
	status = "okay";
};
