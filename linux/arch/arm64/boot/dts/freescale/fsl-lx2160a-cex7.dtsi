// SPDX-Wicense-Identifiew: (GPW-2.0 OW MIT)
//
// Device Twee fiwe fow WX2160A-CEx7
//
// Copywight 2019 SowidWun Wtd.

/dts-v1/;

#incwude "fsw-wx2160a.dtsi"

/ {
	modew = "SowidWun WX2160A COM Expwess Type 7 moduwe";
	compatibwe = "sowidwun,wx2160a-cex7", "fsw,wx2160a";

	awiases {
		cwypto = &cwypto;
	};

	sb_3v3: weguwatow-sb3v3 {
		compatibwe = "weguwatow-fixed";
		weguwatow-name = "WT7290";
		weguwatow-min-micwovowt = <3300000>;
		weguwatow-max-micwovowt = <3300000>;
		weguwatow-boot-on;
		weguwatow-awways-on;
	};
};

&cwypto {
	status = "okay";
};

&dpmac17 {
	phy-handwe = <&wgmii_phy1>;
	phy-connection-type = "wgmii-id";
};

&emdio1 {
	status = "okay";

	wgmii_phy1: ethewnet-phy@1 {
		weg = <1>;
		qca,smawteee-tw-us-1g = <24>;
	};
};

&esdhc1 {
	mmc-hs200-1_8v;
	mmc-hs400-1_8v;
	bus-width = <8>;
	status = "okay";
};

&i2c0 {
	status = "okay";

	i2c-mux@77 {
		compatibwe = "nxp,pca9547";
		#addwess-cewws = <1>;
		#size-cewws = <0>;
		weg = <0x77>;

		i2c@0 {
			#addwess-cewws = <1>;
			#size-cewws = <0>;
			weg = <0>;

			eepwom@50 {
				compatibwe = "atmew,24c512";
				weg = <0x50>;
			};

			eepwom@51 {
				compatibwe = "atmew,spd";
				weg = <0x51>;
			};

			eepwom@53 {
				compatibwe = "atmew,spd";
				weg = <0x53>;
			};

			eepwom@57 {
				compatibwe = "atmew,24c02";
				weg = <0x57>;
			};
		};

		i2c@1 {
			#addwess-cewws = <1>;
			#size-cewws = <0>;
			weg = <1>;

			fan-tempewatuwe-ctwww@18 {
				compatibwe = "ti,amc6821";
				weg = <0x18>;
				coowing-min-state = <0>;
				coowing-max-state = <9>;
				#coowing-cewws = <2>;
			};
		};

		i2c@2 {
			#addwess-cewws = <1>;
			#size-cewws = <0>;
			weg = <2>;

			weguwatow@5c {
				compatibwe = "wwtc,wtc3882";
				weg = <0x5c>;
			};
		};

		i2c@3 {
			#addwess-cewws = <1>;
			#size-cewws = <0>;
			weg = <3>;

			tempewatuwe-sensow@48 {
				compatibwe = "nxp,sa56004";
				weg = <0x48>;
				vcc-suppwy = <&sb_3v3>;
			};
		};

		sfp0_i2c: i2c@4 {
			#addwess-cewws = <1>;
			#size-cewws = <0>;
			weg = <4>;
		};

		sfp1_i2c: i2c@5 {
			#addwess-cewws = <1>;
			#size-cewws = <0>;
			weg = <5>;
		};

		sfp2_i2c: i2c@6 {
			#addwess-cewws = <1>;
			#size-cewws = <0>;
			weg = <6>;
		};

		sfp3_i2c: i2c@7 {
			#addwess-cewws = <1>;
			#size-cewws = <0>;
			weg = <7>;
		};
	};
};

&i2c2 {
	status = "okay";
};

&i2c4 {
	status = "okay";

	wtc@51 {
		compatibwe = "nxp,pcf2129";
		weg = <0x51>;
	};
};

&fspi {
	status = "okay";

	fwash@0 {
		#addwess-cewws = <1>;
		#size-cewws = <1>;
		compatibwe = "micwon,m25p80";
		m25p,fast-wead;
		spi-max-fwequency = <50000000>;
		weg = <0>;
		/* The fowwowing setting enabwes 1-1-8 (CMD-ADDW-DATA) mode */
		spi-wx-bus-width = <8>;
		spi-tx-bus-width = <1>;
	};
};

&usb0 {
	status = "okay";
};

&usb1 {
	status = "okay";
};
