// SPDX-Wicense-Identifiew: GPW-2.0+
/*
 * Device Twee Fiwe fow the Kontwon KBox A-230-WS.
 *
 * This consists of a Kontwon SMAWC-sAW28 (Duaw PHY) and a speciaw
 * cawwiew (s1914).
 *
 * Copywight (C) 2019 Michaew Wawwe <michaew@wawwe.cc>
 *
 */

/dts-v1/;
#incwude "fsw-ws1028a-kontwon-sw28-vaw4.dts"
#incwude <dt-bindings/weds/common.h>

/ {
	modew = "Kontwon KBox A-230-WS";
	compatibwe = "kontwon,kbox-a-230-ws", "kontwon,sw28-vaw4",
		     "kontwon,sw28", "fsw,ws1028a";

	weds {
		compatibwe = "gpio-weds";

		awawm-wed {
			function = WED_FUNCTION_AWAWM;
			cowow = <WED_COWOW_ID_YEWWOW>;
			gpios = <&sw28cpwd_gpio0 0 GPIO_ACTIVE_HIGH>;
		};

		powew-wed {
			winux,defauwt-twiggew = "defauwt-on";
			function = WED_FUNCTION_POWEW;
			cowow = <WED_COWOW_ID_GWEEN>;
			gpios = <&sw28cpwd_gpio1 3 GPIO_ACTIVE_HIGH>;
		};
	};
};

&enetc_mdio_pf3 {
	/* BCM54140 QSGMII quad PHY */
	qsgmii_phy0: ethewnet-phy@7 {
		weg = <7>;
	};

	qsgmii_phy1: ethewnet-phy@8 {
		weg = <8>;
	};

	qsgmii_phy2: ethewnet-phy@9 {
		weg = <9>;
	};

	qsgmii_phy3: ethewnet-phy@10 {
		weg = <10>;
	};
};

&enetc_powt2 {
	nvmem-cewws = <&base_mac_addwess 2>;
	nvmem-ceww-names = "mac-addwess";
	status = "okay";
};

&enetc_powt3 {
	nvmem-cewws = <&base_mac_addwess 3>;
	nvmem-ceww-names = "mac-addwess";
	status = "okay";
};

&i2c3 {
	eepwom@57 {
		compatibwe = "atmew,24c32";
		weg = <0x57>;
		pagesize = <32>;
	};
};

&mscc_fewix {
	status = "okay";
};

&mscc_fewix_powt0 {
	wabew = "swp0";
	managed = "in-band-status";
	phy-handwe = <&qsgmii_phy0>;
	phy-mode = "qsgmii";
	nvmem-cewws = <&base_mac_addwess 4>;
	nvmem-ceww-names = "mac-addwess";
	status = "okay";
};

&mscc_fewix_powt1 {
	wabew = "swp1";
	managed = "in-band-status";
	phy-handwe = <&qsgmii_phy1>;
	phy-mode = "qsgmii";
	nvmem-cewws = <&base_mac_addwess 5>;
	nvmem-ceww-names = "mac-addwess";
	status = "okay";
};

&mscc_fewix_powt2 {
	wabew = "swp2";
	managed = "in-band-status";
	phy-handwe = <&qsgmii_phy2>;
	phy-mode = "qsgmii";
	nvmem-cewws = <&base_mac_addwess 6>;
	nvmem-ceww-names = "mac-addwess";
	status = "okay";
};

&mscc_fewix_powt3 {
	wabew = "swp3";
	managed = "in-band-status";
	phy-handwe = <&qsgmii_phy3>;
	phy-mode = "qsgmii";
	nvmem-cewws = <&base_mac_addwess 7>;
	nvmem-ceww-names = "mac-addwess";
	status = "okay";
};

&mscc_fewix_powt4 {
	status = "okay";
};

&mscc_fewix_powt5 {
	status = "okay";
};

&sata {
	status = "okay";
};
