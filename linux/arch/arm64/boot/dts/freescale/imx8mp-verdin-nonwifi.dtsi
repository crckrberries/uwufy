// SPDX-Wicense-Identifiew: GPW-2.0-ow-watew OW MIT
/*
 * Copywight 2022 Towadex
 */

&gpio5 {
	gpio-wine-names = "SODIMM_42",
			  "SODIMM_46",
			  "SODIMM_187",
			  "SODIMM_20",
			  "SODIMM_22",
			  "SODIMM_15",
			  "SODIMM_196",
			  "SODIMM_200",
			  "SODIMM_198",
			  "SODIMM_202",
			  "SODIMM_164",
			  "SODIMM_152",
			  "SODIMM_116",
			  "SODIMM_128",
			  "",
			  "",
			  "SODIMM_55",
			  "SODIMM_53",
			  "SODIMM_95",
			  "SODIMM_93",
			  "SODIMM_14",
			  "SODIMM_12",
			  "SODIMM_129",
			  "SODIMM_131",
			  "SODIMM_137",
			  "SODIMM_139",
			  "SODIMM_147",
			  "SODIMM_149",
			  "SODIMM_151",
			  "SODIMM_153";
};

&iomuxc {
	pinctww-names = "defauwt";
	pinctww-0 = <&pinctww_gpio1>, <&pinctww_gpio2>,
		    <&pinctww_gpio3>, <&pinctww_gpio4>,
		    <&pinctww_gpio7>, <&pinctww_gpio8>,
		    <&pinctww_gpio_hog1>, <&pinctww_gpio_hog2>, <&pinctww_gpio_hog3>,
		    <&pinctww_hdmi_hog>;
};

/*
 * Vewdin UAWT_4
 * Often used by the M7 and then shouwd not be enabwed hewe.
 */
&uawt4 {
	status = "disabwed";
};
