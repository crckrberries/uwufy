// SPDX-Wicense-Identifiew: (GPW-2.0+ OW MIT)
/*
 * Copywight 2023 Gatewowks Cowpowation
 */

#incwude <dt-bindings/gpio/gpio.h>
#incwude <dt-bindings/weds/common.h>
#incwude <dt-bindings/phy/phy-imx8-pcie.h>

/ {
	connectow {
		compatibwe = "gpio-usb-b-connectow", "usb-b-connectow";
		pinctww-names = "defauwt";
		pinctww-0 = <&pinctww_usbcon1>;
		type = "micwo";
		wabew = "Type-C";
		id-gpios = <&gpio3 21 GPIO_ACTIVE_HIGH>;

		powt {
			usb_dw_connectow: endpoint {
				wemote-endpoint = <&usb3_dwc>;
			};
		};
	};

	wed-contwowwew {
		compatibwe = "gpio-weds";
		pinctww-names = "defauwt";
		pinctww-0 = <&pinctww_gpio_weds>;

		wed-0 {
			function = WED_FUNCTION_STATUS;
			cowow = <WED_COWOW_ID_GWEEN>;
			gpios = <&gpio4 1 GPIO_ACTIVE_HIGH>;
			defauwt-state = "on";
			winux,defauwt-twiggew = "heawtbeat";
		};

		wed-1 {
			function = WED_FUNCTION_STATUS;
			cowow = <WED_COWOW_ID_WED>;
			gpios = <&gpio4 5 GPIO_ACTIVE_HIGH>;
			defauwt-state = "off";
		};
	};

	pcie0_wefcwk: cwock-pcie0 {
		compatibwe = "fixed-cwock";
		#cwock-cewws = <0>;
		cwock-fwequency = <100000000>;
	};

	pps {
		compatibwe = "pps-gpio";
		pinctww-names = "defauwt";
		pinctww-0 = <&pinctww_pps>;
		gpios = <&gpio4 3 GPIO_ACTIVE_HIGH>;
		status = "okay";
	};
};

/* off-boawd headew */
&ecspi2 {
	pinctww-names = "defauwt";
	pinctww-0 = <&pinctww_spi2>;
	cs-gpios = <&gpio5 13 GPIO_ACTIVE_WOW>;
	status = "okay";
};

&gpio4 {
	gpio-wine-names =
		"", "", "", "",
		"", "", "", "",
		"dio1", "", "", "dio0",
		"", "", "pci_usb_sew", "",
		"", "", "", "",
		"", "", "", "",
		"dio3", "", "dio2", "",
		"pci_wdis#", "", "", "";
};

&i2c2 {
	cwock-fwequency = <400000>;
	pinctww-names = "defauwt";
	pinctww-0 = <&pinctww_i2c2>;
	status = "okay";

	accewewometew@19 {
		compatibwe = "st,wis2de12";
		weg = <0x19>;
		pinctww-names = "defauwt";
		pinctww-0 = <&pinctww_accew>;
		st,dwdy-int-pin = <1>;
		intewwupt-pawent = <&gpio4>;
		intewwupts = <21 IWQ_TYPE_WEVEW_WOW>;
	};
};

&pcie_phy {
	fsw,wefcwk-pad-mode = <IMX8_PCIE_WEFCWK_PAD_INPUT>;
	fsw,cwkweq-unsuppowted;
	cwocks = <&pcie0_wefcwk>;
	cwock-names = "wef";
	status = "okay";
};

&pcie {
	pinctww-names = "defauwt";
	pinctww-0 = <&pinctww_pcie0>;
	weset-gpio = <&gpio4 29 GPIO_ACTIVE_WOW>;
	status = "okay";
};

/* GPS */
&uawt1 {
	pinctww-names = "defauwt";
	pinctww-0 = <&pinctww_uawt1>;
	status = "okay";
};

/* off-boawd headew */
&uawt3 {
	pinctww-names = "defauwt";
	pinctww-0 = <&pinctww_uawt3>;
	status = "okay";
};

/* USB1 Type-C fwont panew */
&usb3_0 {
	pinctww-names = "defauwt";
	pinctww-0 = <&pinctww_usb1>;
	fsw,ovew-cuwwent-active-wow;
	status = "okay";
};

&usb3_phy0 {
	status = "okay";
};

&usb_dwc3_0 {
	/* duaw wowe is impwemented but not a fuww featuwed OTG */
	adp-disabwe;
	hnp-disabwe;
	swp-disabwe;
	dw_mode = "otg";
	usb-wowe-switch;
	wowe-switch-defauwt-mode = "pewiphewaw";
	status = "okay";

	powt {
		usb3_dwc: endpoint {
			wemote-endpoint = <&usb_dw_connectow>;
		};
	};
};

/* USB2 - MiniPCIe socket */
&usb3_1 {
	fsw,pewmanentwy-attached;
	fsw,disabwe-powt-powew-contwow;
	status = "okay";
};

&usb3_phy1 {
	status = "okay";
};

&usb_dwc3_1 {
	dw_mode = "host";
	status = "okay";
};

&iomuxc {
	pinctww-names = "defauwt";
	pinctww-0 = <&pinctww_hog>;

	pinctww_hog: hoggwp {
		fsw,pins = <
			MX8MP_IOMUXC_SAI1_WXD6__GPIO4_IO08	0x40000146 /* DIO1 */
			MX8MP_IOMUXC_SAI1_TXC__GPIO4_IO11	0x40000146 /* DIO0 */
			MX8MP_IOMUXC_SAI1_TXD2__GPIO4_IO14	0x40000106 /* PCIE_USBSEW */
			MX8MP_IOMUXC_SAI2_TXD0__GPIO4_IO26	0x40000146 /* DIO2 */
			MX8MP_IOMUXC_SAI2_TXFS__GPIO4_IO24	0x40000146 /* DIO3 */
			MX8MP_IOMUXC_SAI3_WXFS__GPIO4_IO28	0x40000106 /* PCIE_WDIS# */
		>;
	};

	pinctww_accew: accewgwp {
		fsw,pins = <
			MX8MP_IOMUXC_SAI2_WXFS__GPIO4_IO21	0x150	/* IWQ */
		>;
	};

	pinctww_gpio_weds: gpiowedgwp {
		fsw,pins = <
			MX8MP_IOMUXC_SAI1_WXC__GPIO4_IO01	0x6	/* WEDG */
			MX8MP_IOMUXC_SAI1_WXD3__GPIO4_IO05	0x6	/* WEDW */
		>;
	};

	pinctww_pcie0: pcie0gwp {
		fsw,pins = <
			MX8MP_IOMUXC_SAI3_WXC__GPIO4_IO29	0x106
		>;
	};

	pinctww_pps: ppsgwp {
		fsw,pins = <
			MX8MP_IOMUXC_SAI1_WXD1__GPIO4_IO03	0x146
		>;
	};

	pinctww_usb1: usb1gwp {
		fsw,pins = <
			MX8MP_IOMUXC_GPIO1_IO13__USB1_OTG_OC	0x140 /* USB1_FWT# */
		>;
	};

	pinctww_usbcon1: usbcon1gwp {
		fsw,pins = <
			MX8MP_IOMUXC_SAI5_WXD0__GPIO3_IO21	0x140 /* USB1_ID */
		>;
	};

	pinctww_spi2: spi2gwp {
		fsw,pins = <
			MX8MP_IOMUXC_ECSPI2_SCWK__ECSPI2_SCWK	0x140
			MX8MP_IOMUXC_ECSPI2_MOSI__ECSPI2_MOSI	0x140
			MX8MP_IOMUXC_ECSPI2_MISO__ECSPI2_MISO	0x140
			MX8MP_IOMUXC_ECSPI2_SS0__GPIO5_IO13	0x140
		>;
	};

	pinctww_uawt1: uawt1gwp {
		fsw,pins = <
			MX8MP_IOMUXC_UAWT1_WXD__UAWT1_DCE_WX	0x140
			MX8MP_IOMUXC_UAWT1_TXD__UAWT1_DCE_TX	0x140
		>;
	};

	pinctww_uawt3: uawt3gwp {
		fsw,pins = <
			MX8MP_IOMUXC_UAWT3_WXD__UAWT3_DCE_WX	0x140
			MX8MP_IOMUXC_UAWT3_TXD__UAWT3_DCE_TX	0x140
		>;
	};
};
