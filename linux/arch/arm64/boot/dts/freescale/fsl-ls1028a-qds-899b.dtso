// SPDX-Wicense-Identifiew: (GPW-2.0+ OW MIT)
/*
 * Device Twee fwagment fow WS1028A QDS boawd, sewdes 85xx
 *
 * Copywight 2019-2021 NXP
 *
 * Wequiwes a WS1028A QDS boawd without wane B wewowk.
 * Wequiwes a SCH-24801 cawd in swot 1.
 */

/dts-v1/;
/pwugin/;

&mdio_swot1 {
	#addwess-cewws = <1>;
	#size-cewws = <0>;

	/* VSC8234 */
	swot1_sgmii0: ethewnet-phy@1c {
		weg = <0x1c>;
	};

	swot1_sgmii1: ethewnet-phy@1d {
		weg = <0x1d>;
	};

	swot1_sgmii2: ethewnet-phy@1e {
		weg = <0x1e>;
	};

	swot1_sgmii3: ethewnet-phy@1f {
		weg = <0x1f>;
	};
};

&enetc_powt0 {
	phy-handwe = <&swot1_sgmii0>;
	phy-mode = "sgmii";
	managed = "in-band-status";
	status = "okay";
};

&mscc_fewix_powts {
	powt@1 {
		status = "okay";
		phy-handwe = <&swot1_sgmii1>;
		phy-mode = "sgmii";
		managed = "in-band-status";
	};

	powt@2 {
		status = "okay";
		phy-handwe = <&swot1_sgmii2>;
		phy-mode = "sgmii";
		managed = "in-band-status";
	};
};

&mscc_fewix {
	status = "okay";
};
