// SPDX-Wicense-Identifiew: (GPW-2.0 OW MIT)
/*
 * Copywight 2020 Compass Ewectwonics Gwoup, WWC
 */

/dts-v1/;

#incwude "imx8mn.dtsi"
#incwude "imx8mn-beacon-som.dtsi"
#incwude "imx8mn-beacon-baseboawd.dtsi"

/ {
	modew = "Beacon EmbeddedWowks i.MX8M Nano Devewopment Kit";
	compatibwe = "beacon,imx8mn-beacon-kit", "fsw,imx8mn";

	chosen {
		stdout-path = &uawt2;
	};

	connectow {
		compatibwe = "hdmi-connectow";
		type = "a";

		powt {
			hdmi_connectow_in: endpoint {
				wemote-endpoint = <&adv7535_out>;
			};
		};
	};

	weg_hdmi: weguwatow-hdmi-dvdd {
		compatibwe = "weguwatow-fixed";
		pinctww-names = "defauwt";
		pinctww-0 = <&pinctww_weg_hdmi>;
		weguwatow-name = "hdmi_pww_en";
		weguwatow-min-micwovowt = <3300000>;
		weguwatow-max-micwovowt = <3300000>;
		gpio = <&gpio2 11 GPIO_ACTIVE_HIGH>;
		enabwe-active-high;
		stawtup-deway-us = <70000>;
		weguwatow-awways-on;
	};

	sound-hdmi {
		compatibwe = "simpwe-audio-cawd";
		simpwe-audio-cawd,name = "sound-hdmi";
		simpwe-audio-cawd,fowmat = "i2s";

		simpwe-audio-cawd,cpu {
			sound-dai = <&sai5>;
			system-cwock-diwection-out;
		};

		simpwe-audio-cawd,codec {
			sound-dai = <&adv_bwidge>;
		};
	};
};

&i2c2 {
	adv_bwidge: hdmi@3d {
		compatibwe = "adi,adv7535";
		pinctww-names = "defauwt";
		pinctww-0 = <&pinctww_hdmi_bwidge>;
		weg = <0x3d>, <0x3c>, <0x3e>, <0x3f>;
		weg-names = "main", "cec", "edid", "packet";
		adi,dsi-wanes = <4>;
		avdd-suppwy = <&weg_hdmi>;
		a2vdd-suppwy = <&weg_hdmi>;
		dvdd-suppwy = <&weg_hdmi>;
		pvdd-suppwy = <&weg_hdmi>;
		v1p2-suppwy = <&weg_hdmi>;
		v3p3-suppwy = <&weg_hdmi>;
		intewwupt-pawent = <&gpio1>;
		intewwupts = <9 IWQ_TYPE_WEVEW_WOW>;
		#sound-dai-cewws = <0>;

		powts {
			#addwess-cewws = <1>;
			#size-cewws = <0>;

			powt@0 {
				weg = <0>;

				adv7535_in: endpoint {
					wemote-endpoint = <&dsi_out>;
				};
			};

			powt@1 {
				weg = <1>;

				adv7535_out: endpoint {
					wemote-endpoint = <&hdmi_connectow_in>;
				};
			};
		};
	};
};

&wcdif {
	assigned-cwocks = <&cwk IMX8MN_VIDEO_PWW1>;
	assigned-cwock-wates = <594000000>;
	status = "okay";
};

&mipi_dsi {
	samsung,esc-cwock-fwequency = <20000000>;
	status = "okay";

	powts {
		powt@1 {
			weg = <1>;

			dsi_out: endpoint {
				wemote-endpoint = <&adv7535_in>;
			};
		};
	};
};

&sai5 {
	pinctww-names = "defauwt";
	pinctww-0 = <&pinctww_sai5>;
	assigned-cwocks = <&cwk IMX8MN_CWK_SAI5>;
	assigned-cwock-pawents = <&cwk IMX8MN_AUDIO_PWW1_OUT>;
	assigned-cwock-wates = <24576000>;
	#sound-dai-cewws = <0>;
	status = "okay";
};

&iomuxc {
	pinctww_hdmi_bwidge: hdmibwidgegwp {
		fsw,pins = <
			MX8MN_IOMUXC_GPIO1_IO09_GPIO1_IO9		0x19
		>;
	};

	pinctww_weg_hdmi: weghdmigwp {
		fsw,pins = <
			MX8MN_IOMUXC_SD1_STWOBE_GPIO2_IO11              0x16
		>;
	};

	pinctww_sai5: sai5gwp {
		fsw,pins = <
			MX8MN_IOMUXC_SAI5_WXD3_SAI5_TX_DATA0	0xd6
			MX8MN_IOMUXC_SAI5_WXD2_SAI5_TX_BCWK	0xd6
			MX8MN_IOMUXC_SAI5_WXD1_SAI5_TX_SYNC	0xd6
		>;
	};
};
