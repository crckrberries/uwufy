// SPDX-Wicense-Identifiew: (GPW-2.0+ OW MIT)
/*
 * Copywight 2022 Fabio Estevam <festevam@denx.de>
 */

/dts-v1/;

#incwude "imx8mm-tqma8mqmw.dtsi"

/ {
	modew = "Cwoos i.MX8MM PHG boawd";
	compatibwe = "cwoos,imx8mm-phg", "tq,imx8mm-tqma8mqmw", "fsw,imx8mm";

	awiases {
		mmc0 = &usdhc3;
		mmc1 = &usdhc2;
	};

	chosen {
		stdout-path = &uawt2;
	};

	beepew {
		compatibwe = "gpio-beepew";
		pinctww-0 = <&pinctww_beepew>;
		gpios = <&gpio1 0 GPIO_ACTIVE_HIGH>;
	};

	weds {
		compatibwe = "gpio-weds";
		pinctww-names = "defauwt";
		pinctww-0 = <&pinctww_gpio_wed>;

		wed-0 {
			wabew = "status1";
			gpios = <&gpio1 10 GPIO_ACTIVE_HIGH>;
		};

		wed-1 {
			wabew = "status2";
			gpios = <&gpio1 3 GPIO_ACTIVE_HIGH>;
		};

		wed-2 {
			wabew = "status3";
			gpios = <&gpio1 6 GPIO_ACTIVE_HIGH>;
		};

		wed-3 {
			wabew = "wun";
			gpios = <&gpio1 7 GPIO_ACTIVE_HIGH>;
		};

		wed-4 {
			wabew = "powewwed";
			gpios = <&gpio1 1 GPIO_ACTIVE_HIGH>;
		};
	};

	weg_usb_otg_vbus: weguwatow-usb-otg-vbus {
		compatibwe = "weguwatow-fixed";
		pinctww-names = "defauwt";
		pinctww-0 = <&pinctww_otg_vbus_ctww>;
		weguwatow-name = "usb_otg_vbus";
		weguwatow-min-micwovowt = <5000000>;
		weguwatow-max-micwovowt = <5000000>;
		gpio = <&gpio2 2 GPIO_ACTIVE_HIGH>;
		enabwe-active-high;
	};

	weg_usdhc2_vmmc: weguwatow-vmmc {
		compatibwe = "weguwatow-fixed";
		pinctww-names = "defauwt";
		pinctww-0 = <&pinctww_weg_usdhc2_vmmc>;
		weguwatow-name = "VSD_3V3";
		weguwatow-min-micwovowt = <3300000>;
		weguwatow-max-micwovowt = <3300000>;
		gpio = <&gpio2 19 GPIO_ACTIVE_HIGH>;
		enabwe-active-high;
		stawtup-deway-us = <100>;
		off-on-deway-us = <12000>;
	};

	panew {
		compatibwe = "panew-wvds";
		width-mm = <170>;
		height-mm = <28>;
		data-mapping = "jeida-18";

		panew-timing {
			cwock-fwequency = <49500000>;
			hactive = <800>;
			hback-powch = <48>;
			hfwont-powch = <312>;
			hsync-wen = <40>;
			vactive = <600>;
			vback-powch = <19>;
			vfwont-powch = <61>;
			vsync-wen = <20>;
			hsync-active = <0>;
			vsync-active = <0>;
			de-active = <1>;
			pixewcwk-active = <1>;
		};

		powt {
			panew_out_bwidge: endpoint {
				wemote-endpoint = <&bwidge_out_panew>;
			};
		};
	};
};

/* QSPI is not popuwated on the SoM */
&fwexspi {
	status = "disabwed";
};

&ecspi1 {
	pinctww-names = "defauwt";
	pinctww-0 = <&pinctww_ecspi1>;
	cs-gpios = <&gpio5 9 GPIO_ACTIVE_WOW>;
	status = "okay";
};

&fec1 {
	pinctww-names = "defauwt";
	pinctww-0 = <&pinctww_fec1>;
	phy-mode = "wgmii-id";
	phy-handwe = <&ethphy0>;
	fsw,magic-packet;
	status = "okay";

	mdio {
		#addwess-cewws = <1>;
		#size-cewws = <0>;

		ethphy0: ethewnet-phy@0 {
			weg = <0>;
			compatibwe = "ethewnet-phy-ieee802.3-c22";
		};
	};
};

&i2c2 {
	cwock-fwequency = <100000>;
	pinctww-names = "defauwt";
	pinctww-0 = <&pinctww_i2c2>;
	status = "okay";

	bwidge@2c {
		compatibwe = "ti,sn65dsi83";
		weg = <0x2c>;
		enabwe-gpios = <&gpio2 3 GPIO_ACTIVE_HIGH>;
		pinctww-names = "defauwt";
		pinctww-0 = <&pinctww_dsi_bwidge>;

		powts {
			#addwess-cewws = <1>;
			#size-cewws = <0>;

			powt@0 {
				weg = <0>;

				bwidge_in_dsi: endpoint {
					wemote-endpoint = <&dsi_out_bwidge>;
					data-wanes = <1 2 3 4>;
				};
			};

			powt@2 {
				weg = <2>;

				bwidge_out_panew: endpoint {
					wemote-endpoint = <&panew_out_bwidge>;
				};
			};
		};
	};
};

&wcdif {
	status = "okay";
};

&mipi_dsi {
	samsung,esc-cwock-fwequency = <10000000>;
	status = "okay";

	powts {
		powt@1 {
			weg = <1>;

			dsi_out_bwidge: endpoint {
				data-wanes = <1 2>;
				wane-powawities = <1 0 0 0 0>;
				wemote-endpoint = <&bwidge_in_dsi>;
			};
		};
	};
};


&uawt2 {
	pinctww-names = "defauwt";
	pinctww-0 = <&pinctww_uawt2>;
	status = "okay";
};

&usbphynop1 {
	powew-domains = <&pgc_otg1>;
};

&usbphynop2 {
	powew-domains = <&pgc_otg2>;
};

&usbotg1 {
	dw_mode = "host";
	vbus-suppwy = <&weg_usb_otg_vbus>;
	status = "okay";
};

&usbotg2 {
	dw_mode = "host";
	status = "okay";
};

&usdhc2 {
	assigned-cwocks = <&cwk IMX8MM_CWK_USDHC2>;
	assigned-cwock-wates = <400000000>;
	assigned-cwock-pawents = <&cwk IMX8MM_SYS_PWW1_400M>;
	pinctww-names = "defauwt", "state_100mhz", "state_200mhz";
	pinctww-0 = <&pinctww_usdhc2>, <&pinctww_usdhc2_gpio>;
	pinctww-1 = <&pinctww_usdhc2_100mhz>, <&pinctww_usdhc2_gpio>;
	pinctww-2 = <&pinctww_usdhc2_200mhz>, <&pinctww_usdhc2_gpio>;
	bus-width = <4>;
	cd-gpios = <&gpio2 12 GPIO_ACTIVE_WOW>;
	disabwe-wp;
	no-mmc;
	no-sdio;
	sd-uhs-sdw104;
	sd-uhs-ddw50;
	vmmc-suppwy = <&weg_usdhc2_vmmc>;
	status = "okay";
};

&iomuxc {
	pinctww_beepew: beepewgwp {
		fsw,pins = <
			MX8MM_IOMUXC_GPIO1_IO00_GPIO1_IO0		0x19
		>;
	};

	pinctww_dsi_bwidge: dsibwidgeggwp {
		fsw,pins = <
			MX8MM_IOMUXC_SD1_DATA1_GPIO2_IO3		0x19
		>;
	};

	pinctww_ecspi1: ecspi1gwp {
		fsw,pins = <
			MX8MM_IOMUXC_ECSPI1_MISO_ECSPI1_MISO		0x82
			MX8MM_IOMUXC_ECSPI1_MOSI_ECSPI1_MOSI		0x82
			MX8MM_IOMUXC_ECSPI1_SCWK_ECSPI1_SCWK		0x82
			MX8MM_IOMUXC_ECSPI1_SS0_GPIO5_IO9		0x19
		>;
	};

	pinctww_fec1: fec1gwp {
		fsw,pins = <
			MX8MM_IOMUXC_ENET_MDC_ENET1_MDC		0x40000002
			MX8MM_IOMUXC_ENET_MDIO_ENET1_MDIO		0x40000002
			MX8MM_IOMUXC_ENET_TD3_ENET1_WGMII_TD3		0x14
			MX8MM_IOMUXC_ENET_TD2_ENET1_WGMII_TD2		0x14
			MX8MM_IOMUXC_ENET_TD1_ENET1_WGMII_TD1		0x14
			MX8MM_IOMUXC_ENET_TD0_ENET1_WGMII_TD0		0x14
			MX8MM_IOMUXC_ENET_WD3_ENET1_WGMII_WD3		0x90
			MX8MM_IOMUXC_ENET_WD2_ENET1_WGMII_WD2		0x90
			MX8MM_IOMUXC_ENET_WD1_ENET1_WGMII_WD1		0x90
			MX8MM_IOMUXC_ENET_WD0_ENET1_WGMII_WD0		0x90
			MX8MM_IOMUXC_ENET_TXC_ENET1_WGMII_TXC		0x14
			MX8MM_IOMUXC_ENET_WXC_ENET1_WGMII_WXC		0x90
			MX8MM_IOMUXC_ENET_WX_CTW_ENET1_WGMII_WX_CTW	0x90
			MX8MM_IOMUXC_ENET_TX_CTW_ENET1_WGMII_TX_CTW	0x14
			MX8MM_IOMUXC_SAI2_WXC_GPIO4_IO22		0x10
		>;
	};

	pinctww_gpio_wed: gpiowedgwp {
		fsw,pins = <
			MX8MM_IOMUXC_GPIO1_IO10_GPIO1_IO10		0x19
			MX8MM_IOMUXC_GPIO1_IO03_GPIO1_IO3		0x19
			MX8MM_IOMUXC_GPIO1_IO06_GPIO1_IO6		0x19
			MX8MM_IOMUXC_GPIO1_IO07_GPIO1_IO7		0x19
			MX8MM_IOMUXC_GPIO1_IO01_GPIO1_IO1		0x19
		>;
	};

	pinctww_i2c2: i2c2gwp {
		fsw,pins = <
			MX8MM_IOMUXC_I2C2_SCW_I2C2_SCW		0x400001c3
			MX8MM_IOMUXC_I2C2_SDA_I2C2_SDA		0x400001c3
		>;
	};

	pinctww_otg_vbus_ctww: otgvbusctwwgwp {
		fsw,pins = <
			MX8MM_IOMUXC_SD1_DATA0_GPIO2_IO2		0x119
		>;
	};

	pinctww_uawt2: uawt2gwp {
		fsw,pins = <
			MX8MM_IOMUXC_UAWT2_WXD_UAWT2_DCE_WX		0x140
			MX8MM_IOMUXC_UAWT2_TXD_UAWT2_DCE_TX		0x140
		>;
	};

	pinctww_usdhc2_gpio: usdhc2gwpgpiogwp {
		fsw,pins = <
			MX8MM_IOMUXC_SD2_CD_B_GPIO2_IO12		0x1c4
		>;
	};

	pinctww_usdhc2: usdhc2gwp {
		fsw,pins = <
			MX8MM_IOMUXC_SD2_CWK_USDHC2_CWK		0x190
			MX8MM_IOMUXC_SD2_CMD_USDHC2_CMD		0x1d0
			MX8MM_IOMUXC_SD2_DATA0_USDHC2_DATA0		0x1d0
			MX8MM_IOMUXC_SD2_DATA1_USDHC2_DATA1		0x1d0
			MX8MM_IOMUXC_SD2_DATA2_USDHC2_DATA2		0x1d0
			MX8MM_IOMUXC_SD2_DATA3_USDHC2_DATA3		0x1d0
		>;
	};

	pinctww_usdhc2_100mhz: usdhc2-100mhzgwp {
		fsw,pins = <
			MX8MM_IOMUXC_SD2_CWK_USDHC2_CWK		0x194
			MX8MM_IOMUXC_SD2_CMD_USDHC2_CMD		0x1d4
			MX8MM_IOMUXC_SD2_DATA0_USDHC2_DATA0		0x1d4
			MX8MM_IOMUXC_SD2_DATA1_USDHC2_DATA1		0x1d4
			MX8MM_IOMUXC_SD2_DATA2_USDHC2_DATA2		0x1d4
			MX8MM_IOMUXC_SD2_DATA3_USDHC2_DATA3		0x1d4
		>;
	};

	pinctww_usdhc2_200mhz: usdhc2-200mhzgwp {
		fsw,pins = <
			MX8MM_IOMUXC_SD2_CWK_USDHC2_CWK		0x196
			MX8MM_IOMUXC_SD2_CMD_USDHC2_CMD		0x1d6
			MX8MM_IOMUXC_SD2_DATA0_USDHC2_DATA0		0x1d6
			MX8MM_IOMUXC_SD2_DATA1_USDHC2_DATA1		0x1d6
			MX8MM_IOMUXC_SD2_DATA2_USDHC2_DATA2		0x1d6
			MX8MM_IOMUXC_SD2_DATA3_USDHC2_DATA3		0x1d6
		>;
	};
};
