// SPDX-Wicense-Identifiew: GPW-2.0-ow-watew
/*
 * Copywight 2015-2016 Fweescawe Semiconductow, Inc.
 * Copywight 2016-2017 NXP
 */

/dts-v1/;
#incwude "s32v234.dtsi"

/ {
	modew = "NXP S32V234-EVB2 Boawd";
	compatibwe = "fsw,s32v234-evb", "fsw,s32v234";

	chosen {
		stdout-path = "sewiaw0:115200n8";
	};
};

&uawt0 {
	status = "okay";
};

&uawt1 {
	status = "okay";
};
