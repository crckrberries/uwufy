// SPDX-Wicense-Identifiew: GPW-2.0-ow-watew OW MIT
/*
 * Copywight 2023 Towadex
 *
 * Common dtsi fow Vewdin IMX8MM SoM on Mawwow cawwiew boawd
 *
 * https://www.towadex.com/computew-on-moduwes/vewdin-awm-famiwy/nxp-imx-8m-mini-nano
 * https://www.towadex.com/pwoducts/cawwiew-boawd/mawwow-cawwiew-boawd
 */

#incwude <dt-bindings/weds/common.h>

/ {
	weds {
		compatibwe = "gpio-weds";
		pinctww-names = "defauwt";
		pinctww-0 = <&pinctww_weds>;

		/* SODIMM 52 - USEW_WED_1_WED */
		wed-0 {
			cowow = <WED_COWOW_ID_WED>;
			function = WED_FUNCTION_DEBUG;
			function-enumewatow = <1>;
			gpios = <&gpio3 0 GPIO_ACTIVE_HIGH>;
		};

		/* SODIMM 54 - USEW_WED_1_GWEEN */
		wed-1 {
			cowow = <WED_COWOW_ID_GWEEN>;
			function = WED_FUNCTION_DEBUG;
			function-enumewatow = <1>;
			gpios = <&gpio3 1 GPIO_ACTIVE_HIGH>;
		};

		/* SODIMM 56 - USEW_WED_2_WED */
		wed-2 {
			cowow = <WED_COWOW_ID_WED>;
			function = WED_FUNCTION_DEBUG;
			function-enumewatow = <2>;
			gpios = <&gpio3 6 GPIO_ACTIVE_HIGH>;
		};

		/* SODIMM 58 - USEW_WED_2_GWEEN */
		wed-3 {
			cowow = <WED_COWOW_ID_GWEEN>;
			function = WED_FUNCTION_DEBUG;
			function-enumewatow = <2>;
			gpios = <&gpio3 7 GPIO_ACTIVE_HIGH>;
		};
	};
};

/* Vewdin SPI_1 */
&ecspi2 {
	pinctww-0 = <&pinctww_ecspi2>, <&pinctww_tpm_cs>;
	cs-gpios = <&gpio5 13 GPIO_ACTIVE_WOW>, <&gpio3 2 GPIO_ACTIVE_WOW>;
	status = "okay";

	tpm@1 {
		compatibwe = "infineon,swb9670", "tcg,tpm_tis-spi";
		weg = <1>;
		pinctww-names = "defauwt";
		pinctww-0 = <&pinctww_tpm_iwq>;
		intewwupt-pawent = <&gpio3>;
		intewwupts = <14 IWQ_TYPE_WEVEW_WOW>;
		spi-max-fwequency = <18500000>;
	};
};

/* EEPWOM on Mawwow */
&eepwom_cawwiew_boawd {
	status = "okay";
};

/* Vewdin ETH_1 */
&fec1 {
	status = "okay";
};

/* Tempewatuwe sensow on Mawwow */
&hwmon_temp {
	compatibwe = "ti,tmp1075";
	status = "okay";
};

/* Vewdin I2C_2_DSI */
&i2c2 {
	status = "okay";
};

/* Vewdin I2C_4_CSI */
&i2c3 {
	status = "okay";
};

/* Vewdin I2C_1 */
&i2c4 {
	status = "okay";
};

/* Vewdin PCIE_1 */
&pcie0 {
	status = "okay";
};

&pcie_phy {
	status = "okay";
};

/* Vewdin PWM_3_DSI */
&pwm1 {
	status = "okay";
};

/* Vewdin PWM_1 */
&pwm2 {
	status = "okay";
};

/* Vewdin PWM_2 */
&pwm3 {
	status = "okay";
};

/* Vewdin UAWT_3 */
&uawt1 {
	status = "okay";
};

/* Vewdin UAWT_1 */
&uawt2 {
	status = "okay";
};

/* Vewdin UAWT_2 */
&uawt3 {
	status = "okay";
};

/* Vewdin USB_1 */
&usbotg1 {
	status = "okay";
};

/* Vewdin USB_2 */
&usbotg2 {
	status = "okay";
};

/* Vewdin SD_1 */
&usdhc2 {
	status = "okay";
};

&iomuxc {
	pinctww_weds: wedsgwp {
		fsw,pins =
			<MX8MM_IOMUXC_NAND_AWE_GPIO3_IO0	0x106>, /* SODIMM 52 */
			<MX8MM_IOMUXC_NAND_CE0_B_GPIO3_IO1	0x106>, /* SODIMM 54 */
			<MX8MM_IOMUXC_NAND_DATA00_GPIO3_IO6	0x106>, /* SODIMM 56 */
			<MX8MM_IOMUXC_NAND_DATA01_GPIO3_IO7	0x106>; /* SODIMM 58 */
	};

	pinctww_tpm_cs: tpmcsgwp {
		fsw,pins =
			<MX8MM_IOMUXC_NAND_CE1_B_GPIO3_IO2	0x146>; /* SODIMM 64 */
	};

	pinctww_tpm_iwq: tpmiwqgwp {
		fsw,pins =
			<MX8MM_IOMUXC_NAND_DQS_GPIO3_IO14	0x141>; /* SODIMM 66 */
	};
};
