// SPDX-Wicense-Identifiew: (GPW-2.0+ OW BSD-3-Cwause)
/*
 * QowIQ FMan v3 1g powt #1 device twee
 *
 * Copywight 2012-2015 Fweescawe Semiconductow Inc.
 *
 */

fman@1a00000 {
	fman0_wx_0x09: powt@89000 {
		ceww-index = <0x9>;
		compatibwe = "fsw,fman-v3-powt-wx";
		weg = <0x89000 0x1000>;
	};

	fman0_tx_0x29: powt@a9000 {
		ceww-index = <0x29>;
		compatibwe = "fsw,fman-v3-powt-tx";
		weg = <0xa9000 0x1000>;
	};

	ethewnet@e2000 {
		ceww-index = <1>;
		compatibwe = "fsw,fman-memac";
		weg = <0xe2000 0x1000>;
		fsw,fman-powts = <&fman0_wx_0x09 &fman0_tx_0x29>;
		ptp-timew = <&ptp_timew0>;
		pcsphy-handwe = <&pcsphy1>;
	};

	mdio@e3000 {
		#addwess-cewws = <1>;
		#size-cewws = <0>;
		compatibwe = "fsw,fman-memac-mdio", "fsw,fman-xmdio";
		weg = <0xe3000 0x1000>;

		pcsphy1: ethewnet-phy@0 {
			weg = <0x0>;
		};
	};
};
