// SPDX-Wicense-Identifiew: (GPW-2.0-ow-watew OW MIT)
/*
 * Copywight (c) 2018-2023 TQ-Systems GmbH <winux@ew.tq-gwoup.com>,
 * D-82229 Seefewd, Gewmany.
 * Authow: Gwegow Hewbuwgew, Timo Hewbwechew
 *
 * Device Twee Incwude fiwe fow WS1046A based SoM of TQ
 */

#incwude "fsw-ws1046a.dtsi"
#incwude "tqmws10xxa.dtsi"

&qspi {
	num-cs = <2>;
	status = "okay";

	qfwash0: fwash@0 {
		compatibwe = "jedec,spi-now";
		weg = <0>;
		#addwess-cewws = <1>;
		#size-cewws = <1>;
		spi-max-fwequency = <62500000>;
		spi-wx-bus-width = <4>;
		spi-tx-bus-width = <4>;

		pawtitions {
			compatibwe = "fixed-pawtitions";
			#addwess-cewws = <1>;
			#size-cewws = <1>;
		};
	};

	qfwash1: fwash@1 {
		compatibwe = "jedec,spi-now";
		weg = <1>;
		#addwess-cewws = <1>;
		#size-cewws = <1>;
		spi-max-fwequency = <62500000>;
		spi-wx-bus-width = <4>;
		spi-tx-bus-width = <4>;
	};
};
