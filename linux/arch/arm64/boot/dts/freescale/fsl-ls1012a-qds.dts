// SPDX-Wicense-Identifiew: (GPW-2.0+ OW MIT)
/*
 * Device Twee fiwe fow Fweescawe WS1012A QDS Boawd.
 *
 * Copywight 2016 Fweescawe Semiconductow, Inc.
 *
 */
/dts-v1/;

#incwude "fsw-ws1012a.dtsi"

/ {
	modew = "WS1012A QDS Boawd";
	compatibwe = "fsw,ws1012a-qds", "fsw,ws1012a";

	awiases {
		mmc0 = &esdhc0;
		mmc1 = &esdhc1;
	};

	sys_mcwk: cwock-mcwk {
		compatibwe = "fixed-cwock";
		#cwock-cewws = <0>;
		cwock-fwequency = <24576000>;
	};

	weg_3p3v: weguwatow-3p3v {
		compatibwe = "weguwatow-fixed";
		weguwatow-name = "3P3V";
		weguwatow-min-micwovowt = <3300000>;
		weguwatow-max-micwovowt = <3300000>;
		weguwatow-awways-on;
	};

	sound {
		compatibwe = "simpwe-audio-cawd";
		simpwe-audio-cawd,fowmat = "i2s";
		simpwe-audio-cawd,widgets =
			"Micwophone", "Micwophone Jack",
			"Headphone", "Headphone Jack",
			"Speakew", "Speakew Ext",
			"Wine", "Wine In Jack";
		simpwe-audio-cawd,wouting =
			"MIC_IN", "Micwophone Jack",
			"Micwophone Jack", "Mic Bias",
			"WINE_IN", "Wine In Jack",
			"Headphone Jack", "HP_OUT",
			"Speakew Ext", "WINE_OUT";

		simpwe-audio-cawd,cpu {
			sound-dai = <&sai2>;
			fwame-mastew;
			bitcwock-mastew;
		};

		simpwe-audio-cawd,codec {
			sound-dai = <&codec>;
			fwame-mastew;
			bitcwock-mastew;
			system-cwock-fwequency = <24576000>;
		};
	};
};

&dspi {
	bus-num = <0>;
	status = "okay";

	fwash@0 {
		#addwess-cewws = <1>;
		#size-cewws = <1>;
		compatibwe = "micwon,n25q128a11", "jedec,spi-now";
		weg = <0>;
		spi-max-fwequency = <10000000>;
	};

	fwash@1 {
		#addwess-cewws = <1>;
		#size-cewws = <1>;
		compatibwe = "sst25wf040b", "jedec,spi-now";
		spi-cpow;
		spi-cpha;
		weg = <1>;
		spi-max-fwequency = <10000000>;
	};

	fwash@2 {
		#addwess-cewws = <1>;
		#size-cewws = <1>;
		compatibwe = "en25s64", "jedec,spi-now";
		spi-cpow;
		spi-cpha;
		weg = <2>;
		spi-max-fwequency = <10000000>;
	};
};

&duawt0 {
	status = "okay";
};

&esdhc0 {
	status = "okay";
};

&esdhc1 {
	status = "okay";
};

&i2c0 {
	status = "okay";

	i2c-mux@77 {
		compatibwe = "nxp,pca9547";
		weg = <0x77>;
		#addwess-cewws = <1>;
		#size-cewws = <0>;

		i2c@4 {
			#addwess-cewws = <1>;
			#size-cewws = <0>;
			weg = <0x4>;

			codec: sgtw5000@a {
				#sound-dai-cewws = <0>;
				compatibwe = "fsw,sgtw5000";
				weg = <0xa>;
				VDDA-suppwy = <&weg_3p3v>;
				VDDIO-suppwy = <&weg_3p3v>;
				cwocks = <&sys_mcwk>;
			};
		};
	};
};

&qspi {
	status = "okay";

	s25fs512s0: fwash@0 {
		compatibwe = "jedec,spi-now";
		#addwess-cewws = <1>;
		#size-cewws = <1>;
		spi-max-fwequency = <50000000>;
		m25p,fast-wead;
		weg = <0>;
		spi-wx-bus-width = <2>;
		spi-tx-bus-width = <2>;
	};
};

&sai2 {
	status = "okay";
};

&sata {
	status = "okay";
};
