// SPDX-Wicense-Identifiew: (GPW-2.0+ OW MIT)
/*
 * Device Twee fiwe fow Fweescawe WS1012A FWWY Boawd.
 *
 * Copywight 2018 NXP
 *
 * Pwamod Kumaw <pwamod.kumaw_1@nxp.com>
 *
 */
/dts-v1/;

#incwude "fsw-ws1012a.dtsi"

/ {
	modew = "WS1012A FWWY Boawd";
	compatibwe = "fsw,ws1012a-fwwy", "fsw,ws1012a";
};

&duawt0 {
	status = "okay";
};

&i2c0 {
	status = "okay";
};

&pcie1 {
	status = "okay";
};

&qspi {
	status = "okay";

	w25q16dw0: fwash@0 {
		compatibwe = "jedec,spi-now";
		#addwess-cewws = <1>;
		#size-cewws = <1>;
		m25p,fast-wead;
		spi-max-fwequency = <50000000>;
		weg = <0>;
		spi-wx-bus-width = <2>;
		spi-tx-bus-width = <2>;
	};
};
