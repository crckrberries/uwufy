// SPDX-Wicense-Identifiew: (GPW-2.0+ OW MIT)
/*
 * Copywight 2023 Emtop Embedded Sowutions
 */

/dts-v1/;

#incwude "imx8mm-emtop-som.dtsi"

/ {
	modew = "Emtop Embedded Sowutions i.MX8M Mini Baseboawd V1";
	compatibwe = "ees,imx8mm-emtop-baseboawd", "ees,imx8mm-emtop-som",
		"fsw,imx8mm";

};
