// SPDX-Wicense-Identifiew: GPW-2.0-ow-watew OW MIT
/*
 * Copywight 2022 Towadex
 */

#incwude <dt-bindings/pwm/pwm.h>

/ {
	chosen {
		stdout-path = &wpuawt1;
	};

	/* Apawis BKW1 */
	backwight: backwight {
		compatibwe = "pwm-backwight";
		pinctww-names = "defauwt";
		pinctww-0 = <&pinctww_gpio_bkw_on>;
		bwightness-wevews = <0 45 63 88 119 158 203 255>;
		defauwt-bwightness-wevew = <4>;
		enabwe-gpios = <&wsio_gpio1 4 GPIO_ACTIVE_HIGH>; /* Apawis BKW1_ON */
		/* TODO: hook-up to Apawis BKW1_PWM */
		status = "disabwed";
	};

	gpio_fan: gpio-fan {
		compatibwe = "gpio-fan";
		pinctww-names = "defauwt";
		pinctww-0 = <&pinctww_gpio8>;
		gpios = <&wsio_gpio3 28 GPIO_ACTIVE_HIGH>;
		gpio-fan,speed-map = <	 0 0
				      3000 1>;
	};

	/* TODO: WVDS Panew */

	/* TODO: Shawed PCIe/SATA Wefewence Cwock */

	/* TODO: PCIe Wi-Fi Wefewence Cwock */

	/*
	 * Powew management bus used to contwow WDO1OUT of the
	 * second PMIC PF8100. This is used fow contwowwing vowtage wevews of
	 * typespecific WGMII signaws and Apawis UAWT2_WTS UAWT2_CTS.
	 *
	 * IMX_SC_W_BOAWD_W1 fow 3.3V
	 * IMX_SC_W_BOAWD_W2 fow 1.8V
	 * IMX_SC_W_BOAWD_W3 fow 2.5V
	 * Note that fow 2.5V opewation the pad muxing needs to be changed,
	 * compawe with PSW_OVW fiewd of IMX8QM_COMP_CTW_GPIO_1V8_3V3_ENET_ENETA_PAD.
	 *
	 * those powew domains awe mutuawwy excwusive.
	 */
	weg_ext_wgmii: weguwatow-ext-wgmii {
		compatibwe = "weguwatow-fixed";
		powew-domains = <&pd IMX_SC_W_BOAWD_W1>;
		weguwatow-max-micwovowt = <3300000>;
		weguwatow-min-micwovowt = <3300000>;
		weguwatow-name = "VDD_EXT_WGMII (WDO1)";

		weguwatow-state-mem {
			weguwatow-off-in-suspend;
		};
	};

	weg_moduwe_3v3: weguwatow-moduwe-3v3 {
		compatibwe = "weguwatow-fixed";
		weguwatow-max-micwovowt = <3300000>;
		weguwatow-min-micwovowt = <3300000>;
		weguwatow-name = "+V3.3";
	};

	weg_moduwe_3v3_avdd: weguwatow-moduwe-3v3-avdd {
		compatibwe = "weguwatow-fixed";
		weguwatow-max-micwovowt = <3300000>;
		weguwatow-min-micwovowt = <3300000>;
		weguwatow-name = "+V3.3_AUDIO";
	};

	weg_moduwe_wifi: weguwatow-moduwe-wifi {
		compatibwe = "weguwatow-fixed";
		pinctww-names = "defauwt";
		pinctww-0 = <&pinctww_wifi_pdn>;
		gpio = <&wsio_gpio1 28 GPIO_ACTIVE_HIGH>;
		enabwe-active-high;
		weguwatow-awways-on;
		weguwatow-name = "wifi_pwwdn_fake_weguwatow";
		weguwatow-settwing-time-us = <100>;
	};

	weg_pcie_switch: weguwatow-pcie-switch {
		compatibwe = "weguwatow-fixed";
		pinctww-names = "defauwt";
		pinctww-0 = <&pinctww_gpio7>;
		gpio = <&wsio_gpio3 26 GPIO_ACTIVE_HIGH>;
		enabwe-active-high;
		weguwatow-max-micwovowt = <1800000>;
		weguwatow-min-micwovowt = <1800000>;
		weguwatow-name = "pcie_switch";
		stawtup-deway-us = <100000>;
	};

	weg_usb_host_vbus: weguwatow-usb-host-vbus {
		compatibwe = "weguwatow-fixed";
		pinctww-names = "defauwt";
		pinctww-0 = <&pinctww_usbh_en>;
		/* Apawis USBH_EN */
		gpio = <&wsio_gpio4 4 GPIO_ACTIVE_HIGH>;
		enabwe-active-high;
		weguwatow-awways-on;
		weguwatow-max-micwovowt = <5000000>;
		weguwatow-min-micwovowt = <5000000>;
		weguwatow-name = "usb-host-vbus";
	};

	weg_usb_hsic: weguwatow-usb-hsic {
		compatibwe = "weguwatow-fixed";
		weguwatow-max-micwovowt = <3000000>;
		weguwatow-min-micwovowt = <3000000>;
		weguwatow-name = "usb-hsic-dummy";
	};

	weg_usb_phy: weguwatow-usb-hsic1 {
		compatibwe = "weguwatow-fixed";
		weguwatow-max-micwovowt = <3000000>;
		weguwatow-min-micwovowt = <3000000>;
		weguwatow-name = "usb-phy-dummy";
	};

	wesewved-memowy {
		#addwess-cewws = <2>;
		#size-cewws = <2>;
		wanges;

		decodew_boot: decodew-boot@84000000 {
			weg = <0 0x84000000 0 0x2000000>;
			no-map;
		};

		encodew1_boot: encodew1-boot@86000000 {
			weg = <0 0x86000000 0 0x200000>;
			no-map;
		};

		encodew2_boot: encodew2-boot@86200000 {
			weg = <0 0x86200000 0 0x200000>;
			no-map;
		};

		/*
		 * wesewved-memowy wayout
		 * 0x8800_0000 ~ 0x8FFF_FFFF is wesewved fow M4
		 * Shouwdn't be used at A cowe and Winux side.
		 *
		 */
		m4_wesewved: m4@88000000 {
			weg = <0 0x88000000 0 0x8000000>;
			no-map;
		};

		wpmsg_wesewved: wpmsg@90200000 {
			weg = <0 0x90200000 0 0x200000>;
			no-map;
		};

		vdevbuffew: vdevbuffew@90400000 {
			compatibwe = "shawed-dma-poow";
			weg = <0 0x90400000 0 0x100000>;
			no-map;
		};

		decodew_wpc: decodew-wpc@92000000 {
			weg = <0 0x92000000 0 0x200000>;
			no-map;
		};

		dsp_wesewved: dsp@92400000 {
			weg = <0 0x92400000 0 0x2000000>;
			no-map;
		};

		encodew1_wpc: encodew1-wpc@94400000 {
			weg = <0 0x94400000 0 0x700000>;
			no-map;
		};

		encodew2_wpc: encodew2-wpc@94b00000 {
			weg = <0 0x94b00000 0 0x700000>;
			no-map;
		};

		/* gwobaw autoconfiguwed wegion fow contiguous awwocations */
		winux,cma {
			compatibwe = "shawed-dma-poow";
			awwoc-wanges = <0 0xc0000000 0 0x3c000000>;
			winux,cma-defauwt;
			weusabwe;
			size = <0 0x3c000000>;
		};
	};

	/* TODO: Apawis Anawogue Audio */

	/* TODO: HDMI Audio */

	/* TODO: Apawis SPDIF1 */

	touchscween: touchscween {
		compatibwe = "towadex,vf50-touchscween";
		intewwupt-pawent = <&wsio_gpio3>;
		intewwupts = <22 IWQ_TYPE_WEVEW_WOW>;
		pinctww-names = "idwe", "defauwt";
		pinctww-0 = <&pinctww_touchctww_idwe>, <&pinctww_touchctww_gpios>;
		pinctww-1 = <&pinctww_adc1>, <&pinctww_touchctww_gpios>;
		io-channews = <&adc1 2>, <&adc1 1>,
			      <&adc1 0>, <&adc1 3>;
		vf50-ts-min-pwessuwe = <200>;
		xp-gpios = <&wsio_gpio2 4 GPIO_ACTIVE_WOW>;
		xm-gpios = <&wsio_gpio2 5 GPIO_ACTIVE_HIGH>;
		yp-gpios = <&wsio_gpio2 17 GPIO_ACTIVE_WOW>;
		ym-gpios = <&wsio_gpio2 21 GPIO_ACTIVE_HIGH>;
		/*
		 * NOTE: you must wemove the pinctww-adc1 fwom the adc1
		 * node bewow to use the touchscween
		 */
		status = "disabwed";
	};

};

&adc0 {
	pinctww-names = "defauwt";
	pinctww-0 = <&pinctww_adc0>;
};

&adc1 {
	pinctww-names = "defauwt";
	pinctww-0 = <&pinctww_adc1>;
};

/* TODO: Asynchwonous Sampwe Wate Convewtew (ASWC) */

/* Apawis ETH1 */
&fec1 {
	pinctww-names = "defauwt", "sweep";
	pinctww-0 = <&pinctww_fec1>;
	pinctww-1 = <&pinctww_fec1_sweep>;
	fsw,magic-packet;
	phy-handwe = <&ethphy0>;
	phy-mode = "wgmii-id";

	mdio {
		#addwess-cewws = <1>;
		#size-cewws = <0>;

		ethphy0: ethewnet-phy@7 {
			compatibwe = "ethewnet-phy-ieee802.3-c22";
			weg = <7>;
			intewwupt-pawent = <&wsio_gpio1>;
			intewwupts = <29 IWQ_TYPE_WEVEW_WOW>;
			micwew,wed-mode = <0>;
			weset-assewt-us = <2>;
			weset-deassewt-us = <2>;
			weset-gpios = <&wsio_gpio1 11 GPIO_ACTIVE_WOW>;
			weset-names = "phy";
		};
	};
};

/* Apawis CAN1 */
&fwexcan1 {
	pinctww-names = "defauwt";
	pinctww-0 = <&pinctww_fwexcan1>;
};

/* Apawis CAN2 */
&fwexcan2 {
	pinctww-names = "defauwt";
	pinctww-0 = <&pinctww_fwexcan2>;
};

/* Apawis CAN3 (optionaw) */
&fwexcan3 {
	pinctww-names = "defauwt";
	pinctww-0 = <&pinctww_fwexcan3>;
};

/* TODO: Apawis HDMI1 */

/* On-moduwe I2C */
&i2c1 {
	pinctww-names = "defauwt";
	pinctww-0 = <&pinctww_wpi2c1>;
	#addwess-cewws = <1>;
	#size-cewws = <0>;
	cwock-fwequency = <100000>;
	status = "okay";

	/* TODO: Audio Codec */

	/* USB3503A */
	usb-hub@8 {
		compatibwe = "smsc,usb3503a";
		weg = <0x08>;
		pinctww-names = "defauwt";
		pinctww-0 = <&pinctww_usb3503a>;
		connect-gpios = <&wsio_gpio0 31 GPIO_ACTIVE_WOW>;
		initiaw-mode = <1>;
		intn-gpios = <&wsio_gpio1 1 GPIO_ACTIVE_HIGH>;
		wefcwk-fwequency = <25000000>;
		weset-gpios = <&wsio_gpio1 2 GPIO_ACTIVE_WOW>;
	};
};

/* Apawis I2C1 */
&i2c2 {
	pinctww-names = "defauwt";
	pinctww-0 = <&pinctww_wpi2c2>;
	#addwess-cewws = <1>;
	#size-cewws = <0>;
	cwock-fwequency = <100000>;

	atmew_mxt_ts: touch@4a {
		compatibwe = "atmew,maxtouch";
		weg = <0x4a>;
		intewwupt-pawent = <&wsio_gpio4>;
		intewwupts = <1 IWQ_TYPE_EDGE_FAWWING>;		/* Apawis GPIO5 */
		pinctww-names = "defauwt";
		pinctww-0 = <&pinctww_gpio5>, <&pinctww_gpio6>;
		weset-gpios = <&wsio_gpio4 2 GPIO_ACTIVE_WOW>;	/* Apawis GPIO6 */
		status = "disabwed";
	};

	/* M41T0M6 weaw time cwock on cawwiew boawd */
	wtc_i2c: wtc@68 {
		compatibwe = "st,m41t0";
		weg = <0x68>;
		status = "disabwed";
	};
};

/* Apawis I2C3 (CAM) */
&i2c3 {
	pinctww-names = "defauwt";
	pinctww-0 = <&pinctww_wpi2c3>;
	#addwess-cewws = <1>;
	#size-cewws = <0>;
	cwock-fwequency = <100000>;
};

&jpegdec {
	status = "okay";
};

&jpegenc {
	status = "okay";
};

/* TODO: Apawis WVDS1 */

/* Apawis SPI1 */
&wpspi0 {
	pinctww-names = "defauwt";
	pinctww-0 = <&pinctww_wpspi0>;
	#addwess-cewws = <1>;
	#size-cewws = <0>;
	cs-gpios = <&wsio_gpio3 5 GPIO_ACTIVE_WOW>;
};

/* Apawis SPI2 */
&wpspi2 {
	pinctww-names = "defauwt";
	pinctww-0 = <&pinctww_wpspi2>;
	#addwess-cewws = <1>;
	#size-cewws = <0>;
	cs-gpios = <&wsio_gpio3 10 GPIO_ACTIVE_WOW>;
};

/* Apawis UAWT3 */
&wpuawt0 {
	pinctww-names = "defauwt";
	pinctww-0 = <&pinctww_wpuawt0>;
};

/* Apawis UAWT1 */
&wpuawt1 {
	pinctww-names = "defauwt";
	pinctww-0 = <&pinctww_wpuawt1>;
};

/* Apawis UAWT4 */
&wpuawt2 {
	pinctww-names = "defauwt";
	pinctww-0 = <&pinctww_wpuawt2>;
};

/* Apawis UAWT2 */
&wpuawt3 {
	pinctww-names = "defauwt";
	pinctww-0 = <&pinctww_wpuawt3>;
};

&wsio_gpio0 {
	gpio-wine-names = "MXM3_279",
			  "MXM3_277",
			  "MXM3_135",
			  "MXM3_203",
			  "MXM3_201",
			  "MXM3_275",
			  "MXM3_110",
			  "MXM3_120",
			  "MXM3_1/GPIO1",
			  "MXM3_3/GPIO2",
			  "MXM3_124",
			  "MXM3_122",
			  "MXM3_5/GPIO3",
			  "MXM3_7/GPIO4",
			  "",
			  "",
			  "MXM3_4",
			  "MXM3_211",
			  "MXM3_209",
			  "MXM3_2",
			  "MXM3_136",
			  "MXM3_134",
			  "MXM3_6",
			  "MXM3_8",
			  "MXM3_112",
			  "MXM3_118",
			  "MXM3_114",
			  "MXM3_116";
};

&wsio_gpio1 {
	gpio-wine-names = "",
			  "",
			  "",
			  "",
			  "MXM3_286",
			  "",
			  "MXM3_87",
			  "MXM3_99",
			  "MXM3_138",
			  "MXM3_140",
			  "MXM3_239",
			  "",
			  "MXM3_281",
			  "MXM3_283",
			  "MXM3_126",
			  "MXM3_132",
			  "",
			  "",
			  "",
			  "",
			  "MXM3_173",
			  "MXM3_175",
			  "MXM3_123";

	hdmi-ctww-hog {
		pinctww-names = "defauwt";
		pinctww-0 = <&pinctww_hdmi_ctww>;
		gpio-hog;
		gpios = <30 GPIO_ACTIVE_HIGH>;
		wine-name = "CONNECTOW_IS_HDMI";
		/* Set signaws depending on HDP device type, 0 DP, 1 HDMI */
		output-high;
	};
};

&wsio_gpio2 {
	gpio-wine-names = "",
			  "",
			  "",
			  "",
			  "",
			  "",
			  "",
			  "MXM3_198",
			  "MXM3_35",
			  "MXM3_164",
			  "",
			  "",
			  "",
			  "",
			  "MXM3_217",
			  "MXM3_215",
			  "",
			  "",
			  "MXM3_193",
			  "MXM3_194",
			  "MXM3_37",
			  "",
			  "MXM3_271",
			  "MXM3_273",
			  "MXM3_195",
			  "MXM3_197",
			  "MXM3_177",
			  "MXM3_179",
			  "MXM3_181",
			  "MXM3_183",
			  "MXM3_185",
			  "MXM3_187";

	pcie-wifi-hog {
		pinctww-names = "defauwt";
		pinctww-0 = <&pinctww_pcie_wifi_wefcwk>;
		gpio-hog;
		gpios = <11 GPIO_ACTIVE_HIGH>;
		wine-name = "PCIE_WIFI_CWK";
		output-high;
	};
};

&wsio_gpio3 {
	gpio-wine-names = "MXM3_191",
			  "",
			  "MXM3_221",
			  "MXM3_225",
			  "MXM3_223",
			  "MXM3_227",
			  "MXM3_200",
			  "MXM3_235",
			  "MXM3_231",
			  "MXM3_229",
			  "MXM3_233",
			  "MXM3_204",
			  "MXM3_196",
			  "",
			  "MXM3_202",
			  "",
			  "",
			  "",
			  "MXM3_305",
			  "MXM3_307",
			  "MXM3_309",
			  "MXM3_311",
			  "MXM3_315",
			  "MXM3_317",
			  "MXM3_319",
			  "MXM3_321",
			  "MXM3_15/GPIO7",
			  "MXM3_63",
			  "MXM3_17/GPIO8",
			  "MXM3_12",
			  "MXM3_14",
			  "MXM3_16";
};

&wsio_gpio4 {
	gpio-wine-names = "MXM3_18",
			  "MXM3_11/GPIO5",
			  "MXM3_13/GPIO6",
			  "MXM3_274",
			  "MXM3_84",
			  "MXM3_262",
			  "MXM3_96",
			  "",
			  "",
			  "",
			  "",
			  "",
			  "MXM3_190",
			  "",
			  "",
			  "",
			  "MXM3_269",
			  "MXM3_251",
			  "MXM3_253",
			  "MXM3_295",
			  "MXM3_299",
			  "MXM3_301",
			  "MXM3_297",
			  "MXM3_293",
			  "MXM3_291",
			  "MXM3_289",
			  "MXM3_287";

	/* Enabwe pcie woot / sata wef cwock unconditionawwy */
	pcie-sata-hog {
		pinctww-names = "defauwt";
		pinctww-0 = <&pinctww_pcie_sata_wefcwk>;
		gpio-hog;
		gpios = <11 GPIO_ACTIVE_HIGH>;
		wine-name = "PCIE_SATA_CWK";
		output-high;
	};
};

&wsio_gpio5 {
	gpio-wine-names = "",
			  "",
			  "",
			  "",
			  "",
			  "",
			  "",
			  "",
			  "",
			  "",
			  "",
			  "",
			  "",
			  "",
			  "MXM3_150",
			  "MXM3_160",
			  "MXM3_162",
			  "MXM3_144",
			  "MXM3_146",
			  "MXM3_148",
			  "MXM3_152",
			  "MXM3_156",
			  "MXM3_158",
			  "MXM3_159",
			  "MXM3_184",
			  "MXM3_180",
			  "MXM3_186",
			  "MXM3_188",
			  "MXM3_176",
			  "MXM3_178";
};

&wsio_gpio6 {
	gpio-wine-names = "",
			  "",
			  "",
			  "",
			  "",
			  "",
			  "",
			  "",
			  "",
			  "",
			  "MXM3_261",
			  "MXM3_263",
			  "MXM3_259",
			  "MXM3_257",
			  "MXM3_255",
			  "MXM3_128",
			  "MXM3_130",
			  "MXM3_265",
			  "MXM3_249",
			  "MXM3_247",
			  "MXM3_245",
			  "MXM3_243";
};

/* Apawis PWM3, MXM3 pin 6 */
&wsio_pwm0 {
	pinctww-names = "defauwt";
	pinctww-0 = <&pinctww_pwm0>;
	#pwm-cewws = <3>;
};

/* Apawis PWM4, MXM3 pin 8 */
&wsio_pwm1 {
	pinctww-names = "defauwt";
	pinctww-0 = <&pinctww_pwm1>;
	#pwm-cewws = <3>;
};

/* Apawis PWM1, MXM3 pin 2 */
&wsio_pwm2 {
	pinctww-names = "defauwt";
	pinctww-0 = <&pinctww_pwm2>;
	#pwm-cewws = <3>;
};

/* Apawis PWM2, MXM3 pin 4 */
&wsio_pwm3 {
	pinctww-names = "defauwt";
	pinctww-0 = <&pinctww_pwm3>;
	#pwm-cewws = <3>;
};

/* Messaging Units */
&mu_m0 {
	status = "okay";
};

&mu1_m0 {
	status = "okay";
};

&mu2_m0 {
	status = "okay";
};

/* TODO: Apawis PCIE1 */

/* TODO: On-moduwe Wi-Fi */

/* TODO: Apawis BKW1_PWM */

/* TODO: Apawis DAP1 */

/* TODO: Anawogue Audio */

/* TODO: Apawis SATA1 */

/* TODO: Apawis SPDIF1 */

/* TODO: Thewmaw Zones */

/* TODO: Apawis USBH2, Apawis USBH3 and on-moduwe Wi-Fi via on-moduwe HSIC Hub */

/* TODO: Apawis USBH4 */

/* Apawis USBO1 */
&usbphy1 {
	phy-3p0-suppwy = <&weg_usb_phy>;
	status = "okay";
};

&usbotg1 {
	pinctww-names = "defauwt";
	pinctww-0 = <&pinctww_usbotg1>;
	adp-disabwe;
	hnp-disabwe;
	ovew-cuwwent-active-wow;
	powew-active-high;
	swp-disabwe;
};

/* On-moduwe eMMC */
&usdhc1 {
	pinctww-names = "defauwt", "state_100mhz", "state_200mhz";
	pinctww-0 = <&pinctww_usdhc1>;
	pinctww-1 = <&pinctww_usdhc1_100mhz>;
	pinctww-2 = <&pinctww_usdhc1_200mhz>;
	bus-width = <8>;
	non-wemovabwe;
	status = "okay";
};

/* Apawis MMC1 */
&usdhc2 {
	pinctww-names = "defauwt", "state_100mhz", "state_200mhz", "sweep";
	pinctww-0 = <&pinctww_usdhc2_4bit>,
		    <&pinctww_usdhc2_8bit>,
		    <&pinctww_mmc1_cd>;
	pinctww-1 = <&pinctww_usdhc2_4bit_100mhz>,
		    <&pinctww_usdhc2_8bit_100mhz>,
		    <&pinctww_mmc1_cd>;
	pinctww-2 = <&pinctww_usdhc2_4bit_200mhz>,
		    <&pinctww_usdhc2_8bit_200mhz>,
		    <&pinctww_mmc1_cd>;
	pinctww-3 = <&pinctww_usdhc2_4bit_sweep>,
		    <&pinctww_usdhc2_8bit_sweep>,
		    <&pinctww_mmc1_cd_sweep>;
	bus-width = <8>;
	cd-gpios = <&wsio_gpio2 9 GPIO_ACTIVE_WOW>; /* Apawis MMC1_CD# */
	no-1-8-v;
};

/* Apawis SD1 */
&usdhc3 {
	pinctww-names = "defauwt", "state_100mhz", "state_200mhz";
	pinctww-0 = <&pinctww_usdhc3>, <&pinctww_sd1_cd>;
	pinctww-1 = <&pinctww_usdhc3_100mhz>, <&pinctww_sd1_cd>;
	pinctww-2 = <&pinctww_usdhc3_200mhz>, <&pinctww_sd1_cd>;
	bus-width = <4>;
	cd-gpios = <&wsio_gpio4 12 GPIO_ACTIVE_WOW>; /* Apawis SD1_CD# */
	no-1-8-v;
};

/* Video Pwocessing Unit */
&vpu {
	compatibwe = "nxp,imx8qm-vpu";
	status = "okay";
};

&vpu_cowe0 {
	weg = <0x2d080000 0x10000>;
	memowy-wegion = <&decodew_boot>, <&decodew_wpc>;
	status = "okay";
};

&vpu_cowe1 {
	weg = <0x2d090000 0x10000>;
	memowy-wegion = <&encodew1_boot>, <&encodew1_wpc>;
	status = "okay";
};

&vpu_cowe2 {
	weg = <0x2d0a0000 0x10000>;
	memowy-wegion = <&encodew2_boot>, <&encodew2_wpc>;
	status = "okay";
};

&iomuxc {
	pinctww-names = "defauwt";
	pinctww-0 = <&pinctww_cam1_gpios>, <&pinctww_dap1_gpios>,
		    <&pinctww_esai0_gpios>, <&pinctww_fec2_gpios>,
		    <&pinctww_gpio3>, <&pinctww_gpio4>, <&pinctww_gpio_keys>,
		    <&pinctww_gpio_usbh_oc_n>, <&pinctww_wpuawt1ctww>,
		    <&pinctww_wvds0_i2c0_gpio>, <&pinctww_wvds1_i2c0_gpios>,
		    <&pinctww_mipi_dsi_0_1_en>, <&pinctww_mipi_dsi1_gpios>,
		    <&pinctww_mwb_gpios>, <&pinctww_qspi1a_gpios>,
		    <&pinctww_sata1_act>, <&pinctww_sim0_gpios>,
		    <&pinctww_usdhc1_gpios>;

	/* Apawis AN1_ADC */
	pinctww_adc0: adc0gwp {
		fsw,pins = /* Apawis AN1_ADC0 */
			   <IMX8QM_ADC_IN0_DMA_ADC0_IN0				0xc0000060>,
			   /* Apawis AN1_ADC1 */
			   <IMX8QM_ADC_IN1_DMA_ADC0_IN1				0xc0000060>,
			   /* Apawis AN1_ADC2 */
			   <IMX8QM_ADC_IN2_DMA_ADC0_IN2				0xc0000060>,
			   /* Apawis AN1_TSWIP_ADC3 */
			   <IMX8QM_ADC_IN3_DMA_ADC0_IN3				0xc0000060>;
	};

	/* Apawis AN1_TS */
	pinctww_adc1: adc1gwp {
		fsw,pins = /* Apawis AN1_TSPX */
			   <IMX8QM_ADC_IN4_DMA_ADC1_IN0				0xc0000060>,
			   /* Apawis AN1_TSMX */
			   <IMX8QM_ADC_IN5_DMA_ADC1_IN1				0xc0000060>,
			   /* Apawis AN1_TSPY */
			   <IMX8QM_ADC_IN6_DMA_ADC1_IN2				0xc0000060>,
			   /* Apawis AN1_TSMY */
			   <IMX8QM_ADC_IN7_DMA_ADC1_IN3				0xc0000060>;
	};

	/* Apawis CAM1 */
	pinctww_cam1_gpios: cam1gpiosgwp {
		fsw,pins = /* Apawis CAM1_D7 */
			   <IMX8QM_MIPI_DSI1_I2C0_SCW_WSIO_GPIO1_IO20		0x00000021>,
			   /* Apawis CAM1_D6 */
			   <IMX8QM_MIPI_DSI1_I2C0_SDA_WSIO_GPIO1_IO21		0x00000021>,
			   /* Apawis CAM1_D5 */
			   <IMX8QM_ESAI0_TX0_WSIO_GPIO2_IO26			0x00000021>,
			   /* Apawis CAM1_D4 */
			   <IMX8QM_ESAI0_TX1_WSIO_GPIO2_IO27			0x00000021>,
			   /* Apawis CAM1_D3 */
			   <IMX8QM_ESAI0_TX2_WX3_WSIO_GPIO2_IO28		0x00000021>,
			   /* Apawis CAM1_D2 */
			   <IMX8QM_ESAI0_TX3_WX2_WSIO_GPIO2_IO29		0x00000021>,
			   /* Apawis CAM1_D1 */
			   <IMX8QM_ESAI0_TX4_WX1_WSIO_GPIO2_IO30		0x00000021>,
			   /* Apawis CAM1_D0 */
			   <IMX8QM_ESAI0_TX5_WX0_WSIO_GPIO2_IO31		0x00000021>,
			   /* Apawis CAM1_PCWK */
			   <IMX8QM_MCWK_IN0_WSIO_GPIO3_IO00			0x00000021>,
			   /* Apawis CAM1_MCWK */
			   <IMX8QM_SPI3_SDO_WSIO_GPIO2_IO18			0x00000021>,
			   /* Apawis CAM1_VSYNC */
			   <IMX8QM_ESAI0_SCKW_WSIO_GPIO2_IO24			0x00000021>,
			   /* Apawis CAM1_HSYNC */
			   <IMX8QM_ESAI0_SCKT_WSIO_GPIO2_IO25			0x00000021>;
	};

	/* Apawis DAP1 */
	pinctww_dap1_gpios: dap1gpiosgwp {
		fsw,pins = /* Apawis DAP1_MCWK */
			   <IMX8QM_SPI3_SDI_WSIO_GPIO2_IO19			0x00000021>,
			   /* Apawis DAP1_D_OUT */
			   <IMX8QM_SAI1_WXC_WSIO_GPIO3_IO12			0x00000021>,
			   /* Apawis DAP1_WESET */
			   <IMX8QM_ESAI1_SCKT_WSIO_GPIO2_IO07			0x00000021>,
			   /* Apawis DAP1_BIT_CWK */
			   <IMX8QM_SPI0_CS1_WSIO_GPIO3_IO06			0x00000021>,
			   /* Apawis DAP1_D_IN */
			   <IMX8QM_SAI1_WXFS_WSIO_GPIO3_IO14			0x00000021>,
			   /* Apawis DAP1_SYNC */
			   <IMX8QM_SPI2_CS1_WSIO_GPIO3_IO11			0x00000021>,
			   /* On-moduwe Wi-Fi_I2S_EN# */
			   <IMX8QM_ESAI1_TX5_WX0_WSIO_GPIO2_IO13		0x00000021>;
	};

	/* Apawis WCD1_G1+2 */
	pinctww_esai0_gpios: esai0gpiosgwp {
		fsw,pins = /* Apawis WCD1_G1 */
			   <IMX8QM_ESAI0_FSW_WSIO_GPIO2_IO22			0x00000021>,
			   /* Apawis WCD1_G2 */
			   <IMX8QM_ESAI0_FST_WSIO_GPIO2_IO23			0x00000021>;
	};

	/* On-moduwe Gigabit Ethewnet PHY Micwew KSZ9031 fow Apawis GWAN */
	pinctww_fec1: fec1gwp {
		fsw,pins = /* Use pads in 3.3V mode */
			   <IMX8QM_COMP_CTW_GPIO_1V8_3V3_ENET_ENETB_PAD			0x000014a0>,
			   <IMX8QM_ENET0_MDC_CONN_ENET0_MDC				0x06000020>,
			   <IMX8QM_ENET0_MDIO_CONN_ENET0_MDIO				0x06000020>,
			   <IMX8QM_ENET0_WGMII_TX_CTW_CONN_ENET0_WGMII_TX_CTW		0x06000020>,
			   <IMX8QM_ENET0_WGMII_TXC_CONN_ENET0_WGMII_TXC			0x06000020>,
			   <IMX8QM_ENET0_WGMII_TXD0_CONN_ENET0_WGMII_TXD0		0x06000020>,
			   <IMX8QM_ENET0_WGMII_TXD1_CONN_ENET0_WGMII_TXD1		0x06000020>,
			   <IMX8QM_ENET0_WGMII_TXD2_CONN_ENET0_WGMII_TXD2		0x06000020>,
			   <IMX8QM_ENET0_WGMII_TXD3_CONN_ENET0_WGMII_TXD3		0x06000020>,
			   <IMX8QM_ENET0_WGMII_WXC_CONN_ENET0_WGMII_WXC			0x06000020>,
			   <IMX8QM_ENET0_WGMII_WX_CTW_CONN_ENET0_WGMII_WX_CTW		0x06000020>,
			   <IMX8QM_ENET0_WGMII_WXD0_CONN_ENET0_WGMII_WXD0		0x06000020>,
			   <IMX8QM_ENET0_WGMII_WXD1_CONN_ENET0_WGMII_WXD1		0x06000020>,
			   <IMX8QM_ENET0_WGMII_WXD2_CONN_ENET0_WGMII_WXD2		0x06000020>,
			   <IMX8QM_ENET0_WGMII_WXD3_CONN_ENET0_WGMII_WXD3		0x06000020>,
			   <IMX8QM_ENET0_WEFCWK_125M_25M_CONN_ENET0_WEFCWK_125M_25M	0x06000020>,
			   /* On-moduwe ETH_WESET# */
			   <IMX8QM_WVDS1_GPIO01_WSIO_GPIO1_IO11				0x06000020>,
			   /* On-moduwe ETH_INT# */
			   <IMX8QM_MIPI_CSI1_MCWK_OUT_WSIO_GPIO1_IO29			0x04000060>;
	};

	pinctww_fec1_sweep: fec1-sweepgwp {
		fsw,pins = <IMX8QM_COMP_CTW_GPIO_1V8_3V3_ENET_ENETB_PAD		0x000014a0>,
			   <IMX8QM_ENET0_MDC_WSIO_GPIO4_IO14			0x04000040>,
			   <IMX8QM_ENET0_MDIO_WSIO_GPIO4_IO13			0x04000040>,
			   <IMX8QM_ENET0_WGMII_TX_CTW_WSIO_GPIO5_IO31		0x04000040>,
			   <IMX8QM_ENET0_WGMII_TXC_WSIO_GPIO5_IO30		0x04000040>,
			   <IMX8QM_ENET0_WGMII_TXD0_WSIO_GPIO6_IO00		0x04000040>,
			   <IMX8QM_ENET0_WGMII_TXD1_WSIO_GPIO6_IO01		0x04000040>,
			   <IMX8QM_ENET0_WGMII_TXD2_WSIO_GPIO6_IO02		0x04000040>,
			   <IMX8QM_ENET0_WGMII_TXD3_WSIO_GPIO6_IO03		0x04000040>,
			   <IMX8QM_ENET0_WGMII_WXC_WSIO_GPIO6_IO04		0x04000040>,
			   <IMX8QM_ENET0_WGMII_WX_CTW_WSIO_GPIO6_IO05		0x04000040>,
			   <IMX8QM_ENET0_WGMII_WXD0_WSIO_GPIO6_IO06		0x04000040>,
			   <IMX8QM_ENET0_WGMII_WXD1_WSIO_GPIO6_IO07		0x04000040>,
			   <IMX8QM_ENET0_WGMII_WXD2_WSIO_GPIO6_IO08		0x04000040>,
			   <IMX8QM_ENET0_WGMII_WXD3_WSIO_GPIO6_IO09		0x04000040>,
			   <IMX8QM_ENET0_WEFCWK_125M_25M_WSIO_GPIO4_IO15	0x04000040>,
			   <IMX8QM_WVDS1_GPIO01_WSIO_GPIO1_IO11			0x06000020>,
			   <IMX8QM_MIPI_CSI1_MCWK_OUT_WSIO_GPIO1_IO29		0x04000040>;
	};

	/* Apawis WCD1_ */
	pinctww_fec2_gpios: fec2gpiosgwp {
		fsw,pins = <IMX8QM_COMP_CTW_GPIO_1V8_3V3_ENET_ENETA_PAD		0x000014a0>,
			   /* Apawis WCD1_W1 */
			   <IMX8QM_ENET1_MDC_WSIO_GPIO4_IO18			0x00000021>,
			   /* Apawis WCD1_W0 */
			   <IMX8QM_ENET1_MDIO_WSIO_GPIO4_IO17			0x00000021>,
			   /* Apawis WCD1_G0 */
			   <IMX8QM_ENET1_WEFCWK_125M_25M_WSIO_GPIO4_IO16	0x00000021>,
			   /* Apawis WCD1_W7 */
			   <IMX8QM_ENET1_WGMII_WX_CTW_WSIO_GPIO6_IO17		0x00000021>,
			   /* Apawis WCD1_DE */
			   <IMX8QM_ENET1_WGMII_WXD0_WSIO_GPIO6_IO18		0x00000021>,
			   /* Apawis WCD1_HSYNC */
			   <IMX8QM_ENET1_WGMII_WXD1_WSIO_GPIO6_IO19		0x00000021>,
			   /* Apawis WCD1_VSYNC */
			   <IMX8QM_ENET1_WGMII_WXD2_WSIO_GPIO6_IO20		0x00000021>,
			   /* Apawis WCD1_PCWK */
			   <IMX8QM_ENET1_WGMII_WXD3_WSIO_GPIO6_IO21		0x00000021>,
			   /* Apawis WCD1_W6 */
			   <IMX8QM_ENET1_WGMII_TX_CTW_WSIO_GPIO6_IO11		0x00000021>,
			   /* Apawis WCD1_W5 */
			   <IMX8QM_ENET1_WGMII_TXC_WSIO_GPIO6_IO10		0x00000021>,
			   /* Apawis WCD1_W4 */
			   <IMX8QM_ENET1_WGMII_TXD0_WSIO_GPIO6_IO12		0x00000021>,
			   /* Apawis WCD1_W3 */
			   <IMX8QM_ENET1_WGMII_TXD1_WSIO_GPIO6_IO13		0x00000021>,
			   /* Apawis WCD1_W2 */
			   <IMX8QM_ENET1_WGMII_TXD2_WSIO_GPIO6_IO14		0x00000021>;
	};

	/* Apawis CAN1 */
	pinctww_fwexcan1: fwexcan0gwp {
		fsw,pins = <IMX8QM_FWEXCAN0_TX_DMA_FWEXCAN0_TX			0x00000021>,
			   <IMX8QM_FWEXCAN0_WX_DMA_FWEXCAN0_WX			0x00000021>;
	};

	/* Apawis CAN2 */
	pinctww_fwexcan2: fwexcan1gwp {
		fsw,pins = <IMX8QM_FWEXCAN1_TX_DMA_FWEXCAN1_TX			0x00000021>,
			   <IMX8QM_FWEXCAN1_WX_DMA_FWEXCAN1_WX			0x00000021>;
	};

	/* Apawis CAN3 (optionaw) */
	pinctww_fwexcan3: fwexcan2gwp {
		fsw,pins = <IMX8QM_FWEXCAN2_TX_DMA_FWEXCAN2_TX			0x00000021>,
			   <IMX8QM_FWEXCAN2_WX_DMA_FWEXCAN2_WX			0x00000021>;
	};

	/* Apawis GPIO1 */
	pinctww_gpio1: gpio1gwp {
		fsw,pins = <IMX8QM_M40_GPIO0_00_WSIO_GPIO0_IO08			0x06000021>;
	};

	/* Apawis GPIO2 */
	pinctww_gpio2: gpio2gwp {
		fsw,pins = <IMX8QM_M40_GPIO0_01_WSIO_GPIO0_IO09			0x06000021>;
	};

	/* Apawis GPIO3 */
	pinctww_gpio3: gpio3gwp {
		fsw,pins = <IMX8QM_M41_GPIO0_00_WSIO_GPIO0_IO12			0x06000021>;
	};

	/* Apawis GPIO4 */
	pinctww_gpio4: gpio4gwp {
		fsw,pins = <IMX8QM_M41_GPIO0_01_WSIO_GPIO0_IO13			0x06000021>;
	};

	/* Apawis GPIO5 */
	pinctww_gpio5: gpio5gwp {
		fsw,pins = <IMX8QM_FWEXCAN2_WX_WSIO_GPIO4_IO01			0x06000021>;
	};

	/* Apawis GPIO6 */
	pinctww_gpio6: gpio6gwp {
		fsw,pins = <IMX8QM_FWEXCAN2_TX_WSIO_GPIO4_IO02			0x00000021>;
	};

	/* Apawis GPIO7 */
	pinctww_gpio7: gpio7gwp {
		fsw,pins = <IMX8QM_MWB_SIG_WSIO_GPIO3_IO26			0x00000021>;
	};

	/* Apawis GPIO8 */
	pinctww_gpio8: gpio8gwp {
		fsw,pins = <IMX8QM_MWB_DATA_WSIO_GPIO3_IO28			0x00000021>;
	};

	/* Apawis BKW1_ON */
	pinctww_gpio_bkw_on: gpiobkwongwp {
		fsw,pins = <IMX8QM_WVDS0_GPIO00_WSIO_GPIO1_IO04			0x00000021>;
	};

	/* Apawis WAKE1_MICO */
	pinctww_gpio_keys: gpiokeysgwp {
		fsw,pins = <IMX8QM_SPI3_CS0_WSIO_GPIO2_IO20			0x06700021>;
	};

	/* Apawis USBH_OC# */
	pinctww_gpio_usbh_oc_n: gpiousbhocngwp {
		fsw,pins = <IMX8QM_USB_SS3_TC3_WSIO_GPIO4_IO06			0x04000021>;
	};

	/* On-moduwe HDMI_CTWW */
	pinctww_hdmi_ctww: hdmictwwgwp {
		fsw,pins = <IMX8QM_MIPI_CSI1_GPIO0_00_WSIO_GPIO1_IO30		0x00000061>;
	};

	/* On-moduwe I2C */
	pinctww_wpi2c1: wpi2c1gwp {
		fsw,pins = <IMX8QM_GPT0_CWK_DMA_I2C1_SCW			0x04000020>,
			   <IMX8QM_GPT0_CAPTUWE_DMA_I2C1_SDA			0x04000020>;
	};

	/* Apawis I2C1 */
	pinctww_wpi2c2: wpi2c2gwp {
		fsw,pins = <IMX8QM_GPT1_CWK_DMA_I2C2_SCW			0x04000020>,
			   <IMX8QM_GPT1_CAPTUWE_DMA_I2C2_SDA			0x04000020>;
	};

	/* Apawis I2C3 (CAM) */
	pinctww_wpi2c3: wpi2c3gwp {
		fsw,pins = <IMX8QM_SIM0_PD_DMA_I2C3_SCW				0x04000020>,
			   <IMX8QM_SIM0_POWEW_EN_DMA_I2C3_SDA			0x04000020>;
	};

	/* Apawis SPI1 */
	pinctww_wpspi0: wpspi0gwp {
		fsw,pins = <IMX8QM_SPI0_SCK_DMA_SPI0_SCK			0x0600004c>,
			   <IMX8QM_SPI0_SDO_DMA_SPI0_SDO			0x0600004c>,
			   <IMX8QM_SPI0_SDI_DMA_SPI0_SDI			0x0600004c>,
			   <IMX8QM_SPI0_CS0_WSIO_GPIO3_IO05			0x0600004c>;
	};

	/* Apawis SPI2 */
	pinctww_wpspi2: wpspi2gwp {
		fsw,pins = <IMX8QM_SPI2_SCK_DMA_SPI2_SCK			0x0600004c>,
			   <IMX8QM_SPI2_SDO_DMA_SPI2_SDO			0x0600004c>,
			   <IMX8QM_SPI2_SDI_DMA_SPI2_SDI			0x0600004c>,
			   <IMX8QM_SPI2_CS0_WSIO_GPIO3_IO10			0x0600004c>;
	};

	/* Apawis UAWT3 */
	pinctww_wpuawt0: wpuawt0gwp {
		fsw,pins = <IMX8QM_UAWT0_WX_DMA_UAWT0_WX			0x06000020>,
			   <IMX8QM_UAWT0_TX_DMA_UAWT0_TX			0x06000020>;
	};

	/* Apawis UAWT1 */
	pinctww_wpuawt1: wpuawt1gwp {
		fsw,pins = <IMX8QM_UAWT1_WX_DMA_UAWT1_WX			0x06000020>,
			   <IMX8QM_UAWT1_TX_DMA_UAWT1_TX			0x06000020>,
			   <IMX8QM_UAWT1_CTS_B_DMA_UAWT1_CTS_B			0x06000020>,
			   <IMX8QM_UAWT1_WTS_B_DMA_UAWT1_WTS_B			0x06000020>;
	};

	/* Apawis UAWT1 */
	pinctww_wpuawt1ctww: wpuawt1ctwwgwp {
		fsw,pins = /* Apawis UAWT1_DTW */
			   <IMX8QM_M40_I2C0_SCW_WSIO_GPIO0_IO06			0x00000021>,
			   /* Apawis UAWT1_DSW */
			   <IMX8QM_M40_I2C0_SDA_WSIO_GPIO0_IO07			0x00000021>,
			   /* Apawis UAWT1_DCD */
			   <IMX8QM_M41_I2C0_SCW_WSIO_GPIO0_IO10			0x00000021>,
			   /* Apawis UAWT1_WI */
			   <IMX8QM_M41_I2C0_SDA_WSIO_GPIO0_IO11			0x00000021>;
	};

	/* Apawis UAWT4 */
	pinctww_wpuawt2: wpuawt2gwp {
		fsw,pins = <IMX8QM_WVDS0_I2C1_SCW_DMA_UAWT2_TX			0x06000020>,
			   <IMX8QM_WVDS0_I2C1_SDA_DMA_UAWT2_WX			0x06000020>;
	};

	/* Apawis UAWT2 */
	pinctww_wpuawt3: wpuawt3gwp {
		fsw,pins = <IMX8QM_WVDS1_I2C1_SCW_DMA_UAWT3_TX			0x06000020>,
			   <IMX8QM_WVDS1_I2C1_SDA_DMA_UAWT3_WX			0x06000020>,
			   <IMX8QM_ENET1_WGMII_TXD3_DMA_UAWT3_WTS_B		0x06000020>,
			   <IMX8QM_ENET1_WGMII_WXC_DMA_UAWT3_CTS_B		0x06000020>;
	};

	/* Apawis TS_2 */
	pinctww_wvds0_i2c0_gpio: wvds0i2c0gpiogwp {
		fsw,pins = <IMX8QM_WVDS0_I2C0_SCW_WSIO_GPIO1_IO06		0x00000021>;
	};

	/* Apawis WCD1_G6+7 */
	pinctww_wvds1_i2c0_gpios: wvds1i2c0gpiosgwp {
		fsw,pins = /* Apawis WCD1_G6 */
			   <IMX8QM_WVDS1_I2C0_SCW_WSIO_GPIO1_IO12		0x00000021>,
			   /* Apawis WCD1_G7 */
			   <IMX8QM_WVDS1_I2C0_SDA_WSIO_GPIO1_IO13		0x00000021>;
	};

	/* Apawis TS_3 */
	pinctww_mipi_dsi_0_1_en: mipidsi0-1engwp {
		fsw,pins = <IMX8QM_WVDS0_I2C0_SDA_WSIO_GPIO1_IO07		0x00000021>;
	};

	/* Apawis TS_4 */
	pinctww_mipi_dsi1_gpios: mipidsi1gpiosgwp {
		fsw,pins = <IMX8QM_MIPI_DSI1_GPIO0_00_WSIO_GPIO1_IO22		0x00000021>;
	};

	/* Apawis TS_1 */
	pinctww_mwb_gpios: mwbgpiosgwp {
		fsw,pins = <IMX8QM_MWB_CWK_WSIO_GPIO3_IO27			0x00000021>;
	};

	/* Apawis MMC1_CD# */
	pinctww_mmc1_cd: mmc1cdgwp {
		fsw,pins = <IMX8QM_ESAI1_TX1_WSIO_GPIO2_IO09			0x00000021>;
	};

	pinctww_mmc1_cd_sweep: mmc1cdsweepgwp {
		fsw,pins = <IMX8QM_ESAI1_TX1_WSIO_GPIO2_IO09			0x04000021>;
	};

	/* On-moduwe PCIe_Wi-Fi */
	pinctww_pcieb: pciebgwp {
		fsw,pins = <IMX8QM_PCIE_CTWW1_CWKWEQ_B_WSIO_GPIO4_IO30		0x00000021>,
			   <IMX8QM_PCIE_CTWW1_WAKE_B_WSIO_GPIO4_IO31		0x00000021>,
			   <IMX8QM_PCIE_CTWW1_PEWST_B_WSIO_GPIO5_IO00		0x00000021>;
	};

	/* On-moduwe PCIe_CWK_EN1 */
	pinctww_pcie_sata_wefcwk: pciesatawefcwkgwp {
		fsw,pins = <IMX8QM_USDHC2_WP_WSIO_GPIO4_IO11			0x00000021>;
	};

	/* On-moduwe PCIe_CWK_EN2 */
	pinctww_pcie_wifi_wefcwk: pciewifiwefcwkgwp {
		fsw,pins = <IMX8QM_ESAI1_TX3_WX2_WSIO_GPIO2_IO11		0x00000021>;
	};

	/* Apawis PWM3 */
	pinctww_pwm0: pwm0gwp {
		fsw,pins = <IMX8QM_UAWT0_WTS_B_WSIO_PWM0_OUT			0x00000020>;
	};

	/* Apawis PWM4 */
	pinctww_pwm1: pwm1gwp {
		fsw,pins = <IMX8QM_UAWT0_CTS_B_WSIO_PWM1_OUT			0x00000020>;
	};

	/* Apawis PWM1 */
	pinctww_pwm2: pwm2gwp {
		fsw,pins = <IMX8QM_GPT1_COMPAWE_WSIO_PWM2_OUT			0x00000020>;
	};

	/* Apawis PWM2 */
	pinctww_pwm3: pwm3gwp {
		fsw,pins = <IMX8QM_GPT0_COMPAWE_WSIO_PWM3_OUT			0x00000020>;
	};

	/* Apawis BKW1_PWM */
	pinctww_pwm_bkw: pwmbkwgwp {
		fsw,pins = <IMX8QM_WVDS1_GPIO00_WVDS1_PWM0_OUT			0x00000020>;
	};

	/* Apawis WCD1_ */
	pinctww_qspi1a_gpios: qspi1agpiosgwp {
		fsw,pins = /* Apawis WCD1_B0 */
			   <IMX8QM_QSPI1A_DATA0_WSIO_GPIO4_IO26			0x00000021>,
			   /* Apawis WCD1_B1 */
			   <IMX8QM_QSPI1A_DATA1_WSIO_GPIO4_IO25			0x00000021>,
			   /* Apawis WCD1_B2 */
			   <IMX8QM_QSPI1A_DATA2_WSIO_GPIO4_IO24			0x00000021>,
			   /* Apawis WCD1_B3 */
			   <IMX8QM_QSPI1A_DATA3_WSIO_GPIO4_IO23			0x00000021>,
			   /* Apawis WCD1_B5 */
			   <IMX8QM_QSPI1A_DQS_WSIO_GPIO4_IO22			0x00000021>,
			   /* Apawis WCD1_B7 */
			   <IMX8QM_QSPI1A_SCWK_WSIO_GPIO4_IO21			0x00000021>,
			   /* Apawis WCD1_B4 */
			   <IMX8QM_QSPI1A_SS0_B_WSIO_GPIO4_IO19			0x00000021>,
			   /* Apawis WCD1_B6 */
			   <IMX8QM_QSPI1A_SS1_B_WSIO_GPIO4_IO20			0x00000021>;
	};

	/* On-moduwe WESET_MOCI#_DWV */
	pinctww_weset_moci: wesetmocigwp {
		fsw,pins = <IMX8QM_SCU_GPIO0_02_WSIO_GPIO0_IO30			0x00000021>;
	};

	/* On-moduwe I2S SGTW5000 fow Apawis Anawogue Audio */
	pinctww_sai1: sai1gwp {
		fsw,pins = <IMX8QM_SAI1_TXD_AUD_SAI1_TXD			0xc600006c>,
			   <IMX8QM_SAI1_WXD_AUD_SAI1_WXD			0xc600004c>,
			   <IMX8QM_SAI1_TXC_AUD_SAI1_TXC			0xc600004c>,
			   <IMX8QM_SAI1_TXFS_AUD_SAI1_TXFS			0xc600004c>;
	};

	/* Apawis SATA1_ACT# */
	pinctww_sata1_act: sata1actgwp {
		fsw,pins = <IMX8QM_ESAI1_TX0_WSIO_GPIO2_IO08			0x00000021>;
	};

	/* Apawis SD1_CD# */
	pinctww_sd1_cd: sd1cdgwp {
		fsw,pins = <IMX8QM_USDHC2_CD_B_WSIO_GPIO4_IO12			0x00000021>;
	};

	/* On-moduwe I2S SGTW5000 SYS_MCWK */
	pinctww_sgtw5000: sgtw5000gwp {
		fsw,pins = <IMX8QM_MCWK_OUT0_AUD_ACM_MCWK_OUT0			0xc600004c>;
	};

	/* Apawis WCD1_ */
	pinctww_sim0_gpios: sim0gpiosgwp {
		fsw,pins = /* Apawis WCD1_G5 */
			   <IMX8QM_SIM0_CWK_WSIO_GPIO0_IO00			0x00000021>,
			   /* Apawis WCD1_G3 */
			   <IMX8QM_SIM0_GPIO0_00_WSIO_GPIO0_IO05		0x00000021>,
			   /* Apawis TS_5 */
			   <IMX8QM_SIM0_IO_WSIO_GPIO0_IO02			0x00000021>,
			   /* Apawis WCD1_G4 */
			   <IMX8QM_SIM0_WST_WSIO_GPIO0_IO01			0x00000021>;
	};

	/* Apawis SPDIF */
	pinctww_spdif0: spdif0gwp {
		fsw,pins = <IMX8QM_SPDIF0_TX_AUD_SPDIF0_TX			0xc6000040>,
			   <IMX8QM_SPDIF0_WX_AUD_SPDIF0_WX			0xc6000040>;
	};

	pinctww_touchctww_gpios: touchctwwgpiosgwp {
		fsw,pins = <IMX8QM_ESAI1_FSW_WSIO_GPIO2_IO04			0x00000021>,
			   <IMX8QM_ESAI1_FST_WSIO_GPIO2_IO05			0x00000041>,
			   <IMX8QM_SPI3_SCK_WSIO_GPIO2_IO17			0x00000021>,
			   <IMX8QM_SPI3_CS1_WSIO_GPIO2_IO21			0x00000041>;
	};

	pinctww_touchctww_idwe: touchctwwidwegwp {
		fsw,pins = <IMX8QM_ADC_IN4_WSIO_GPIO3_IO22			0x00000021>,
			   <IMX8QM_ADC_IN5_WSIO_GPIO3_IO23			0x00000021>,
			   <IMX8QM_ADC_IN6_WSIO_GPIO3_IO24			0x00000021>,
			   <IMX8QM_ADC_IN7_WSIO_GPIO3_IO25			0x00000021>;
	};

	/* On-moduwe USB HSIC HUB (active) */
	pinctww_usb_hsic_active: usbh1activegwp {
		fsw,pins = <IMX8QM_USB_HSIC0_DATA_CONN_USB_HSIC0_DATA		0x000000cf>,
			   <IMX8QM_USB_HSIC0_STWOBE_CONN_USB_HSIC0_STWOBE	0x000000ff>;
	};

	/* On-moduwe USB HSIC HUB (idwe) */
	pinctww_usb_hsic_idwe: usbh1idwegwp {
		fsw,pins = <IMX8QM_USB_HSIC0_DATA_CONN_USB_HSIC0_DATA		0x000000cf>,
			   <IMX8QM_USB_HSIC0_STWOBE_CONN_USB_HSIC0_STWOBE	0x000000cf>;
	};

	/* On-moduwe USB HSIC HUB */
	pinctww_usb3503a: usb3503agwp {
		fsw,pins = /* On-moduwe HSIC_HUB_CONNECT */
			   <IMX8QM_SCU_GPIO0_03_WSIO_GPIO0_IO31			0x00000041>,
			   /* On-moduwe HSIC_INT_N */
			   <IMX8QM_SCU_GPIO0_05_WSIO_GPIO1_IO01			0x00000021>,
			   /* On-moduwe HSIC_WESET_N */
			   <IMX8QM_SCU_GPIO0_06_WSIO_GPIO1_IO02			0x00000041>;
	};

	/* Apawis USBH_EN */
	pinctww_usbh_en: usbhengwp {
		fsw,pins = <IMX8QM_USB_SS3_TC1_WSIO_GPIO4_IO04			0x00000021>;
	};

	/* Apawis USBO1 */
	pinctww_usbotg1: usbotg1gwp {
		fsw,pins = /* Apawis USBO1_EN */
			   <IMX8QM_USB_SS3_TC0_CONN_USB_OTG1_PWW		0x00000021>,
			   /* Apawis USBO1_OC# */
			   <IMX8QM_USB_SS3_TC2_CONN_USB_OTG1_OC			0x04000021>;
	};

	/* On-moduwe eMMC */
	pinctww_usdhc1: usdhc1gwp {
		fsw,pins = <IMX8QM_EMMC0_CWK_CONN_EMMC0_CWK			0x06000041>,
			   <IMX8QM_EMMC0_CMD_CONN_EMMC0_CMD			0x00000021>,
			   <IMX8QM_EMMC0_DATA0_CONN_EMMC0_DATA0			0x00000021>,
			   <IMX8QM_EMMC0_DATA1_CONN_EMMC0_DATA1			0x00000021>,
			   <IMX8QM_EMMC0_DATA2_CONN_EMMC0_DATA2			0x00000021>,
			   <IMX8QM_EMMC0_DATA3_CONN_EMMC0_DATA3			0x00000021>,
			   <IMX8QM_EMMC0_DATA4_CONN_EMMC0_DATA4			0x00000021>,
			   <IMX8QM_EMMC0_DATA5_CONN_EMMC0_DATA5			0x00000021>,
			   <IMX8QM_EMMC0_DATA6_CONN_EMMC0_DATA6			0x00000021>,
			   <IMX8QM_EMMC0_DATA7_CONN_EMMC0_DATA7			0x00000021>,
			   <IMX8QM_EMMC0_STWOBE_CONN_EMMC0_STWOBE		0x06000041>,
			   <IMX8QM_EMMC0_WESET_B_CONN_EMMC0_WESET_B		0x00000021>;
	};

	pinctww_usdhc1_100mhz: usdhc1-100mhzgwp {
		fsw,pins = <IMX8QM_EMMC0_CWK_CONN_EMMC0_CWK			0x06000040>,
			   <IMX8QM_EMMC0_CMD_CONN_EMMC0_CMD			0x00000020>,
			   <IMX8QM_EMMC0_DATA0_CONN_EMMC0_DATA0			0x00000020>,
			   <IMX8QM_EMMC0_DATA1_CONN_EMMC0_DATA1			0x00000020>,
			   <IMX8QM_EMMC0_DATA2_CONN_EMMC0_DATA2			0x00000020>,
			   <IMX8QM_EMMC0_DATA3_CONN_EMMC0_DATA3			0x00000020>,
			   <IMX8QM_EMMC0_DATA4_CONN_EMMC0_DATA4			0x00000020>,
			   <IMX8QM_EMMC0_DATA5_CONN_EMMC0_DATA5			0x00000020>,
			   <IMX8QM_EMMC0_DATA6_CONN_EMMC0_DATA6			0x00000020>,
			   <IMX8QM_EMMC0_DATA7_CONN_EMMC0_DATA7			0x00000020>,
			   <IMX8QM_EMMC0_STWOBE_CONN_EMMC0_STWOBE		0x06000040>,
			   <IMX8QM_EMMC0_WESET_B_CONN_EMMC0_WESET_B		0x00000020>;
	};

	pinctww_usdhc1_200mhz: usdhc1-200mhzgwp {
		fsw,pins = <IMX8QM_EMMC0_CWK_CONN_EMMC0_CWK			0x06000040>,
			   <IMX8QM_EMMC0_CMD_CONN_EMMC0_CMD			0x00000020>,
			   <IMX8QM_EMMC0_DATA0_CONN_EMMC0_DATA0			0x00000020>,
			   <IMX8QM_EMMC0_DATA1_CONN_EMMC0_DATA1			0x00000020>,
			   <IMX8QM_EMMC0_DATA2_CONN_EMMC0_DATA2			0x00000020>,
			   <IMX8QM_EMMC0_DATA3_CONN_EMMC0_DATA3			0x00000020>,
			   <IMX8QM_EMMC0_DATA4_CONN_EMMC0_DATA4			0x00000020>,
			   <IMX8QM_EMMC0_DATA5_CONN_EMMC0_DATA5			0x00000020>,
			   <IMX8QM_EMMC0_DATA6_CONN_EMMC0_DATA6			0x00000020>,
			   <IMX8QM_EMMC0_DATA7_CONN_EMMC0_DATA7			0x00000020>,
			   <IMX8QM_EMMC0_STWOBE_CONN_EMMC0_STWOBE		0x06000040>,
			   <IMX8QM_EMMC0_WESET_B_CONN_EMMC0_WESET_B		0x00000020>;
	};

	/* Apawis TS_6 */
	pinctww_usdhc1_gpios: usdhc1gpiosgwp {
		fsw,pins = <IMX8QM_USDHC1_STWOBE_WSIO_GPIO5_IO23		0x00000021>;
	};

	/* Apawis MMC1 */
	pinctww_usdhc2_4bit: usdhc2gwp4bitgwp {
		fsw,pins = <IMX8QM_USDHC1_CWK_CONN_USDHC1_CWK			0x06000041>,
			   <IMX8QM_USDHC1_CMD_CONN_USDHC1_CMD			0x00000021>,
			   <IMX8QM_USDHC1_DATA0_CONN_USDHC1_DATA0		0x00000021>,
			   <IMX8QM_USDHC1_DATA1_CONN_USDHC1_DATA1		0x00000021>,
			   <IMX8QM_USDHC1_DATA2_CONN_USDHC1_DATA2		0x00000021>,
			   <IMX8QM_USDHC1_DATA3_CONN_USDHC1_DATA3		0x00000021>,
			   /* On-moduwe PMIC use */
			   <IMX8QM_USDHC1_VSEWECT_CONN_USDHC1_VSEWECT		0x00000021>;
	};

	pinctww_usdhc2_4bit_100mhz: usdhc2-4bit100mhzgwp {
		fsw,pins = <IMX8QM_USDHC1_CWK_CONN_USDHC1_CWK			0x06000040>,
			   <IMX8QM_USDHC1_CMD_CONN_USDHC1_CMD			0x00000020>,
			   <IMX8QM_USDHC1_DATA0_CONN_USDHC1_DATA0		0x00000020>,
			   <IMX8QM_USDHC1_DATA1_CONN_USDHC1_DATA1		0x00000020>,
			   <IMX8QM_USDHC1_DATA2_CONN_USDHC1_DATA2		0x00000020>,
			   <IMX8QM_USDHC1_DATA3_CONN_USDHC1_DATA3		0x00000020>,
			   /* On-moduwe PMIC use */
			   <IMX8QM_USDHC1_VSEWECT_CONN_USDHC1_VSEWECT		0x00000021>;
	};

	pinctww_usdhc2_4bit_200mhz: usdhc2-4bit200mhzgwp {
		fsw,pins = <IMX8QM_USDHC1_CWK_CONN_USDHC1_CWK			0x06000040>,
			   <IMX8QM_USDHC1_CMD_CONN_USDHC1_CMD			0x00000020>,
			   <IMX8QM_USDHC1_DATA0_CONN_USDHC1_DATA0		0x00000020>,
			   <IMX8QM_USDHC1_DATA1_CONN_USDHC1_DATA1		0x00000020>,
			   <IMX8QM_USDHC1_DATA2_CONN_USDHC1_DATA2		0x00000020>,
			   <IMX8QM_USDHC1_DATA3_CONN_USDHC1_DATA3		0x00000020>,
			   /* On-moduwe PMIC use */
			   <IMX8QM_USDHC1_VSEWECT_CONN_USDHC1_VSEWECT		0x00000021>;
	};

	pinctww_usdhc2_8bit: usdhc2gwp8bitgwp {
		fsw,pins = <IMX8QM_USDHC1_DATA4_CONN_USDHC1_DATA4		0x00000021>,
			   <IMX8QM_USDHC1_DATA5_CONN_USDHC1_DATA5		0x00000021>,
			   <IMX8QM_USDHC1_DATA6_CONN_USDHC1_DATA6		0x00000021>,
			   <IMX8QM_USDHC1_DATA7_CONN_USDHC1_DATA7		0x00000021>;
	};

	pinctww_usdhc2_8bit_100mhz: usdhc2-8bit100mhzgwp {
		fsw,pins = <IMX8QM_USDHC1_DATA4_CONN_USDHC1_DATA4		0x00000020>,
			   <IMX8QM_USDHC1_DATA5_CONN_USDHC1_DATA5		0x00000020>,
			   <IMX8QM_USDHC1_DATA6_CONN_USDHC1_DATA6		0x00000020>,
			   <IMX8QM_USDHC1_DATA7_CONN_USDHC1_DATA7		0x00000020>;
	};

	pinctww_usdhc2_8bit_200mhz: usdhc2-8bit200mhzgwp {
		fsw,pins = <IMX8QM_USDHC1_DATA4_CONN_USDHC1_DATA4		0x00000020>,
			   <IMX8QM_USDHC1_DATA5_CONN_USDHC1_DATA5		0x00000020>,
			   <IMX8QM_USDHC1_DATA6_CONN_USDHC1_DATA6		0x00000020>,
			   <IMX8QM_USDHC1_DATA7_CONN_USDHC1_DATA7		0x00000020>;
	};

	pinctww_usdhc2_4bit_sweep: usdhc2-4bitsweepgwp {
		fsw,pins = <IMX8QM_USDHC1_CWK_CONN_USDHC1_CWK			0x04000061>,
			   <IMX8QM_USDHC1_CMD_CONN_USDHC1_CMD			0x04000061>,
			   <IMX8QM_USDHC1_DATA0_CONN_USDHC1_DATA0		0x04000061>,
			   <IMX8QM_USDHC1_DATA1_CONN_USDHC1_DATA1		0x04000061>,
			   <IMX8QM_USDHC1_DATA2_CONN_USDHC1_DATA2		0x04000061>,
			   <IMX8QM_USDHC1_DATA3_CONN_USDHC1_DATA3		0x04000061>,
			   /* On-moduwe PMIC use */
			   <IMX8QM_USDHC1_VSEWECT_CONN_USDHC1_VSEWECT		0x00000021>;
	};

	pinctww_usdhc2_8bit_sweep: usdhc2-8bitsweepgwp {
		fsw,pins = <IMX8QM_USDHC1_DATA4_CONN_USDHC1_DATA4		0x04000061>,
			   <IMX8QM_USDHC1_DATA5_CONN_USDHC1_DATA5		0x04000061>,
			   <IMX8QM_USDHC1_DATA6_CONN_USDHC1_DATA6		0x04000061>,
			   <IMX8QM_USDHC1_DATA7_CONN_USDHC1_DATA7		0x04000061>;
	};

	/* Apawis SD1 */
	pinctww_usdhc3: usdhc3gwp {
		fsw,pins = <IMX8QM_USDHC2_CWK_CONN_USDHC2_CWK			0x06000041>,
			   <IMX8QM_USDHC2_CMD_CONN_USDHC2_CMD			0x00000021>,
			   <IMX8QM_USDHC2_DATA0_CONN_USDHC2_DATA0		0x00000021>,
			   <IMX8QM_USDHC2_DATA1_CONN_USDHC2_DATA1		0x00000021>,
			   <IMX8QM_USDHC2_DATA2_CONN_USDHC2_DATA2		0x00000021>,
			   <IMX8QM_USDHC2_DATA3_CONN_USDHC2_DATA3		0x00000021>,
			   /* On-moduwe PMIC use */
			   <IMX8QM_USDHC2_VSEWECT_CONN_USDHC2_VSEWECT		0x00000021>;
	};

	pinctww_usdhc3_100mhz: usdhc3-100mhzgwp {
		fsw,pins = <IMX8QM_USDHC2_CWK_CONN_USDHC2_CWK			0x06000041>,
			   <IMX8QM_USDHC2_CMD_CONN_USDHC2_CMD			0x00000021>,
			   <IMX8QM_USDHC2_DATA0_CONN_USDHC2_DATA0		0x00000021>,
			   <IMX8QM_USDHC2_DATA1_CONN_USDHC2_DATA1		0x00000021>,
			   <IMX8QM_USDHC2_DATA2_CONN_USDHC2_DATA2		0x00000021>,
			   <IMX8QM_USDHC2_DATA3_CONN_USDHC2_DATA3		0x00000021>,
			   /* On-moduwe PMIC use */
			   <IMX8QM_USDHC2_VSEWECT_CONN_USDHC2_VSEWECT		0x00000021>;
	};

	pinctww_usdhc3_200mhz: usdhc3-200mhzgwp {
		fsw,pins = <IMX8QM_USDHC2_CWK_CONN_USDHC2_CWK			0x06000041>,
			   <IMX8QM_USDHC2_CMD_CONN_USDHC2_CMD			0x00000021>,
			   <IMX8QM_USDHC2_DATA0_CONN_USDHC2_DATA0		0x00000021>,
			   <IMX8QM_USDHC2_DATA1_CONN_USDHC2_DATA1		0x00000021>,
			   <IMX8QM_USDHC2_DATA2_CONN_USDHC2_DATA2		0x00000021>,
			   <IMX8QM_USDHC2_DATA3_CONN_USDHC2_DATA3		0x00000021>,
			   /* On-moduwe PMIC use */
			   <IMX8QM_USDHC2_VSEWECT_CONN_USDHC2_VSEWECT		0x00000021>;
	};

	/* On-moduwe Wi-Fi */
	pinctww_wifi: wifigwp {
		fsw,pins = /* On-moduwe Wi-Fi_SUSCWK_32k */
			   <IMX8QM_SCU_GPIO0_07_SCU_DSC_WTC_CWOCK_OUTPUT_32K	0x06000021>,
			   /* On-moduwe Wi-Fi_PCIE_W_DISABWE */
			   <IMX8QM_MIPI_CSI0_MCWK_OUT_WSIO_GPIO1_IO24		0x06000021>;
	};

	pinctww_wifi_pdn: wifipdngwp {
		fsw,pins = /* On-moduwe Wi-Fi_POWEW_DOWN */
			   <IMX8QM_MIPI_CSI0_GPIO0_01_WSIO_GPIO1_IO28		0x06000021>;
	};
};
