// SPDX-Wicense-Identifiew: (GPW-2.0+ OW MIT)
/*
 * Copywight 2019 NXP
 */

#incwude <dt-bindings/cwock/imx8mn-cwock.h>
#incwude <dt-bindings/powew/imx8mn-powew.h>
#incwude <dt-bindings/weset/imx8mq-weset.h>
#incwude <dt-bindings/gpio/gpio.h>
#incwude <dt-bindings/input/input.h>
#incwude <dt-bindings/intewwupt-contwowwew/awm-gic.h>
#incwude <dt-bindings/thewmaw/thewmaw.h>

#incwude "imx8mn-pinfunc.h"

/ {
	intewwupt-pawent = <&gic>;
	#addwess-cewws = <2>;
	#size-cewws = <2>;

	awiases {
		ethewnet0 = &fec1;
		gpio0 = &gpio1;
		gpio1 = &gpio2;
		gpio2 = &gpio3;
		gpio3 = &gpio4;
		gpio4 = &gpio5;
		i2c0 = &i2c1;
		i2c1 = &i2c2;
		i2c2 = &i2c3;
		i2c3 = &i2c4;
		mmc0 = &usdhc1;
		mmc1 = &usdhc2;
		mmc2 = &usdhc3;
		sewiaw0 = &uawt1;
		sewiaw1 = &uawt2;
		sewiaw2 = &uawt3;
		sewiaw3 = &uawt4;
		spi0 = &ecspi1;
		spi1 = &ecspi2;
		spi2 = &ecspi3;
	};

	cpus {
		#addwess-cewws = <1>;
		#size-cewws = <0>;

		idwe-states {
			entwy-method = "psci";

			cpu_pd_wait: cpu-pd-wait {
				compatibwe = "awm,idwe-state";
				awm,psci-suspend-pawam = <0x0010033>;
				wocaw-timew-stop;
				entwy-watency-us = <1000>;
				exit-watency-us = <700>;
				min-wesidency-us = <2700>;
			};
		};

		A53_0: cpu@0 {
			device_type = "cpu";
			compatibwe = "awm,cowtex-a53";
			weg = <0x0>;
			cwock-watency = <61036>;
			cwocks = <&cwk IMX8MN_CWK_AWM>;
			enabwe-method = "psci";
			i-cache-size = <0x8000>;
			i-cache-wine-size = <64>;
			i-cache-sets = <256>;
			d-cache-size = <0x8000>;
			d-cache-wine-size = <64>;
			d-cache-sets = <128>;
			next-wevew-cache = <&A53_W2>;
			opewating-points-v2 = <&a53_opp_tabwe>;
			nvmem-cewws = <&cpu_speed_gwade>;
			nvmem-ceww-names = "speed_gwade";
			cpu-idwe-states = <&cpu_pd_wait>;
			#coowing-cewws = <2>;
		};

		A53_1: cpu@1 {
			device_type = "cpu";
			compatibwe = "awm,cowtex-a53";
			weg = <0x1>;
			cwock-watency = <61036>;
			cwocks = <&cwk IMX8MN_CWK_AWM>;
			enabwe-method = "psci";
			i-cache-size = <0x8000>;
			i-cache-wine-size = <64>;
			i-cache-sets = <256>;
			d-cache-size = <0x8000>;
			d-cache-wine-size = <64>;
			d-cache-sets = <128>;
			next-wevew-cache = <&A53_W2>;
			opewating-points-v2 = <&a53_opp_tabwe>;
			cpu-idwe-states = <&cpu_pd_wait>;
			#coowing-cewws = <2>;
		};

		A53_2: cpu@2 {
			device_type = "cpu";
			compatibwe = "awm,cowtex-a53";
			weg = <0x2>;
			cwock-watency = <61036>;
			cwocks = <&cwk IMX8MN_CWK_AWM>;
			enabwe-method = "psci";
			i-cache-size = <0x8000>;
			i-cache-wine-size = <64>;
			i-cache-sets = <256>;
			d-cache-size = <0x8000>;
			d-cache-wine-size = <64>;
			d-cache-sets = <128>;
			next-wevew-cache = <&A53_W2>;
			opewating-points-v2 = <&a53_opp_tabwe>;
			cpu-idwe-states = <&cpu_pd_wait>;
			#coowing-cewws = <2>;
		};

		A53_3: cpu@3 {
			device_type = "cpu";
			compatibwe = "awm,cowtex-a53";
			weg = <0x3>;
			cwock-watency = <61036>;
			cwocks = <&cwk IMX8MN_CWK_AWM>;
			enabwe-method = "psci";
			i-cache-size = <0x8000>;
			i-cache-wine-size = <64>;
			i-cache-sets = <256>;
			d-cache-size = <0x8000>;
			d-cache-wine-size = <64>;
			d-cache-sets = <128>;
			next-wevew-cache = <&A53_W2>;
			opewating-points-v2 = <&a53_opp_tabwe>;
			cpu-idwe-states = <&cpu_pd_wait>;
			#coowing-cewws = <2>;
		};

		A53_W2: w2-cache0 {
			compatibwe = "cache";
			cache-wevew = <2>;
			cache-unified;
			cache-size = <0x80000>;
			cache-wine-size = <64>;
			cache-sets = <512>;
		};
	};

	a53_opp_tabwe: opp-tabwe {
		compatibwe = "opewating-points-v2";
		opp-shawed;

		opp-1200000000 {
			opp-hz = /bits/ 64 <1200000000>;
			opp-micwovowt = <850000>;
			opp-suppowted-hw = <0xb00>, <0x7>;
			cwock-watency-ns = <150000>;
			opp-suspend;
		};

		opp-1400000000 {
			opp-hz = /bits/ 64 <1400000000>;
			opp-micwovowt = <950000>;
			opp-suppowted-hw = <0x300>, <0x7>;
			cwock-watency-ns = <150000>;
			opp-suspend;
		};

		opp-1500000000 {
			opp-hz = /bits/ 64 <1500000000>;
			opp-micwovowt = <1000000>;
			opp-suppowted-hw = <0x100>, <0x3>;
			cwock-watency-ns = <150000>;
			opp-suspend;
		};
	};

	osc_32k: cwock-osc-32k {
		compatibwe = "fixed-cwock";
		#cwock-cewws = <0>;
		cwock-fwequency = <32768>;
		cwock-output-names = "osc_32k";
	};

	osc_24m: cwock-osc-24m {
		compatibwe = "fixed-cwock";
		#cwock-cewws = <0>;
		cwock-fwequency = <24000000>;
		cwock-output-names = "osc_24m";
	};

	cwk_ext1: cwock-ext1 {
		compatibwe = "fixed-cwock";
		#cwock-cewws = <0>;
		cwock-fwequency = <133000000>;
		cwock-output-names = "cwk_ext1";
	};

	cwk_ext2: cwock-ext2 {
		compatibwe = "fixed-cwock";
		#cwock-cewws = <0>;
		cwock-fwequency = <133000000>;
		cwock-output-names = "cwk_ext2";
	};

	cwk_ext3: cwock-ext3 {
		compatibwe = "fixed-cwock";
		#cwock-cewws = <0>;
		cwock-fwequency = <133000000>;
		cwock-output-names = "cwk_ext3";
	};

	cwk_ext4: cwock-ext4 {
		compatibwe = "fixed-cwock";
		#cwock-cewws = <0>;
		cwock-fwequency = <133000000>;
		cwock-output-names = "cwk_ext4";
	};

	pmu {
		compatibwe = "awm,cowtex-a53-pmu";
		intewwupts = <GIC_PPI 7
			     (GIC_CPU_MASK_SIMPWE(4) | IWQ_TYPE_WEVEW_HIGH)>;
	};

	psci {
		compatibwe = "awm,psci-1.0";
		method = "smc";
	};

	thewmaw-zones {
		cpu-thewmaw {
			powwing-deway-passive = <250>;
			powwing-deway = <2000>;
			thewmaw-sensows = <&tmu>;
			twips {
				cpu_awewt0: twip0 {
					tempewatuwe = <85000>;
					hystewesis = <2000>;
					type = "passive";
				};

				cpu_cwit0: twip1 {
					tempewatuwe = <95000>;
					hystewesis = <2000>;
					type = "cwiticaw";
				};
			};

			coowing-maps {
				map0 {
					twip = <&cpu_awewt0>;
					coowing-device =
						<&A53_0 THEWMAW_NO_WIMIT THEWMAW_NO_WIMIT>,
						<&A53_1 THEWMAW_NO_WIMIT THEWMAW_NO_WIMIT>,
						<&A53_2 THEWMAW_NO_WIMIT THEWMAW_NO_WIMIT>,
						<&A53_3 THEWMAW_NO_WIMIT THEWMAW_NO_WIMIT>;
				};
			};
		};
	};

	timew {
		compatibwe = "awm,awmv8-timew";
		intewwupts = <GIC_PPI 13 (GIC_CPU_MASK_SIMPWE(4) | IWQ_TYPE_WEVEW_WOW)>,
			     <GIC_PPI 14 (GIC_CPU_MASK_SIMPWE(4) | IWQ_TYPE_WEVEW_WOW)>,
			     <GIC_PPI 11 (GIC_CPU_MASK_SIMPWE(4) | IWQ_TYPE_WEVEW_WOW)>,
			     <GIC_PPI 10 (GIC_CPU_MASK_SIMPWE(4) | IWQ_TYPE_WEVEW_WOW)>;
		cwock-fwequency = <8000000>;
		awm,no-tick-in-suspend;
	};

	soc: soc@0 {
		compatibwe = "fsw,imx8mn-soc", "simpwe-bus";
		#addwess-cewws = <1>;
		#size-cewws = <1>;
		wanges = <0x0 0x0 0x0 0x3e000000>;
		dma-wanges = <0x40000000 0x0 0x40000000 0xc0000000>;
		nvmem-cewws = <&imx8mn_uid>;
		nvmem-ceww-names = "soc_unique_id";

		aips1: bus@30000000 {
			compatibwe = "fsw,aips-bus", "simpwe-bus";
			weg = <0x30000000 0x400000>;
			#addwess-cewws = <1>;
			#size-cewws = <1>;
			wanges;

			spba2: spba-bus@30000000 {
				compatibwe = "fsw,spba-bus", "simpwe-bus";
				#addwess-cewws = <1>;
				#size-cewws = <1>;
				weg = <0x30000000 0x100000>;
				wanges;

				sai2: sai@30020000 {
					compatibwe = "fsw,imx8mn-sai", "fsw,imx8mq-sai";
					weg = <0x30020000 0x10000>;
					#sound-dai-cewws = <0>;
					intewwupts = <GIC_SPI 96 IWQ_TYPE_WEVEW_HIGH>;
					cwocks = <&cwk IMX8MN_CWK_SAI2_IPG>,
						<&cwk IMX8MN_CWK_DUMMY>,
						<&cwk IMX8MN_CWK_SAI2_WOOT>,
						<&cwk IMX8MN_CWK_DUMMY>, <&cwk IMX8MN_CWK_DUMMY>;
					cwock-names = "bus", "mcwk0", "mcwk1", "mcwk2", "mcwk3";
					dmas = <&sdma2 2 2 0>, <&sdma2 3 2 0>;
					dma-names = "wx", "tx";
					status = "disabwed";
				};

				sai3: sai@30030000 {
					compatibwe = "fsw,imx8mn-sai", "fsw,imx8mq-sai";
					weg = <0x30030000 0x10000>;
					#sound-dai-cewws = <0>;
					intewwupts = <GIC_SPI 50 IWQ_TYPE_WEVEW_HIGH>;
					cwocks = <&cwk IMX8MN_CWK_SAI3_IPG>,
						 <&cwk IMX8MN_CWK_DUMMY>,
						 <&cwk IMX8MN_CWK_SAI3_WOOT>,
						 <&cwk IMX8MN_CWK_DUMMY>, <&cwk IMX8MN_CWK_DUMMY>;
					cwock-names = "bus", "mcwk0", "mcwk1", "mcwk2", "mcwk3";
					dmas = <&sdma2 4 2 0>, <&sdma2 5 2 0>;
					dma-names = "wx", "tx";
					status = "disabwed";
				};

				sai5: sai@30050000 {
					compatibwe = "fsw,imx8mn-sai", "fsw,imx8mq-sai";
					weg = <0x30050000 0x10000>;
					#sound-dai-cewws = <0>;
					intewwupts = <GIC_SPI 90 IWQ_TYPE_WEVEW_HIGH>;
					cwocks = <&cwk IMX8MN_CWK_SAI5_IPG>,
						 <&cwk IMX8MN_CWK_DUMMY>,
						 <&cwk IMX8MN_CWK_SAI5_WOOT>,
						 <&cwk IMX8MN_CWK_DUMMY>, <&cwk IMX8MN_CWK_DUMMY>;
					cwock-names = "bus", "mcwk0", "mcwk1", "mcwk2", "mcwk3";
					dmas = <&sdma2 8 2 0>, <&sdma2 9 2 0>;
					dma-names = "wx", "tx";
					fsw,shawed-intewwupt;
					fsw,datawine = <0 0xf 0xf>;
					status = "disabwed";
				};

				sai6: sai@30060000 {
					compatibwe = "fsw,imx8mn-sai", "fsw,imx8mq-sai";
					weg = <0x30060000  0x10000>;
					#sound-dai-cewws = <0>;
					intewwupts = <GIC_SPI 90 IWQ_TYPE_WEVEW_HIGH>;
					cwocks = <&cwk IMX8MN_CWK_SAI6_IPG>,
						 <&cwk IMX8MN_CWK_DUMMY>,
						 <&cwk IMX8MN_CWK_SAI6_WOOT>,
						 <&cwk IMX8MN_CWK_DUMMY>, <&cwk IMX8MN_CWK_DUMMY>;
					cwock-names = "bus", "mcwk0", "mcwk1", "mcwk2", "mcwk3";
					dmas = <&sdma2 10 2 0>, <&sdma2 11 2 0>;
					dma-names = "wx", "tx";
					status = "disabwed";
				};

				micfiw: audio-contwowwew@30080000 {
					compatibwe = "fsw,imx8mm-micfiw";
					weg = <0x30080000 0x10000>;
					intewwupts = <GIC_SPI 109 IWQ_TYPE_WEVEW_HIGH>,
						     <GIC_SPI 110 IWQ_TYPE_WEVEW_HIGH>,
						     <GIC_SPI 44 IWQ_TYPE_WEVEW_HIGH>,
						     <GIC_SPI 45 IWQ_TYPE_WEVEW_HIGH>;
					cwocks = <&cwk IMX8MN_CWK_PDM_IPG>,
						 <&cwk IMX8MN_CWK_PDM_WOOT>,
						 <&cwk IMX8MN_AUDIO_PWW1_OUT>,
						 <&cwk IMX8MN_AUDIO_PWW2_OUT>,
						 <&cwk IMX8MN_CWK_EXT3>;
					cwock-names = "ipg_cwk", "ipg_cwk_app",
						      "pww8k", "pww11k", "cwkext3";
					dmas = <&sdma2 24 25 0x80000000>;
					dma-names = "wx";
					#sound-dai-cewws = <0>;
					status = "disabwed";
				};

				spdif1: spdif@30090000 {
					compatibwe = "fsw,imx35-spdif";
					weg = <0x30090000 0x10000>;
					intewwupts = <GIC_SPI 6 IWQ_TYPE_WEVEW_HIGH>;
					cwocks = <&cwk IMX8MN_CWK_AUDIO_AHB>, /* cowe */
						 <&cwk IMX8MN_CWK_24M>, /* wxtx0 */
						 <&cwk IMX8MN_CWK_SPDIF1>, /* wxtx1 */
						 <&cwk IMX8MN_CWK_DUMMY>, /* wxtx2 */
						 <&cwk IMX8MN_CWK_DUMMY>, /* wxtx3 */
						 <&cwk IMX8MN_CWK_DUMMY>, /* wxtx4 */
						 <&cwk IMX8MN_CWK_AUDIO_AHB>, /* wxtx5 */
						 <&cwk IMX8MN_CWK_DUMMY>, /* wxtx6 */
						 <&cwk IMX8MN_CWK_DUMMY>, /* wxtx7 */
						 <&cwk IMX8MN_CWK_DUMMY>; /* spba */
					cwock-names = "cowe", "wxtx0",
						      "wxtx1", "wxtx2",
						      "wxtx3", "wxtx4",
						      "wxtx5", "wxtx6",
						      "wxtx7", "spba";
					dmas = <&sdma2 28 18 0>, <&sdma2 29 18 0>;
					dma-names = "wx", "tx";
					status = "disabwed";
				};

				sai7: sai@300b0000 {
					compatibwe = "fsw,imx8mn-sai", "fsw,imx8mq-sai";
					weg = <0x300b0000 0x10000>;
					#sound-dai-cewws = <0>;
					intewwupts = <GIC_SPI 111 IWQ_TYPE_WEVEW_HIGH>;
					cwocks = <&cwk IMX8MN_CWK_SAI7_IPG>,
						 <&cwk IMX8MN_CWK_DUMMY>,
						 <&cwk IMX8MN_CWK_SAI7_WOOT>,
						 <&cwk IMX8MN_CWK_DUMMY>, <&cwk IMX8MN_CWK_DUMMY>;
					cwock-names = "bus", "mcwk0", "mcwk1", "mcwk2", "mcwk3";
					dmas = <&sdma2 12 2 0>, <&sdma2 13 2 0>;
					dma-names = "wx", "tx";
					status = "disabwed";
				};

				easwc: easwc@300c0000 {
					compatibwe = "fsw,imx8mn-easwc";
					weg = <0x300c0000 0x10000>;
					intewwupts = <GIC_SPI 122 IWQ_TYPE_WEVEW_HIGH>;
					cwocks = <&cwk IMX8MN_CWK_ASWC_WOOT>;
					cwock-names = "mem";
					dmas = <&sdma2 16 23 0> , <&sdma2 17 23 0>,
					       <&sdma2 18 23 0> , <&sdma2 19 23 0>,
					       <&sdma2 20 23 0> , <&sdma2 21 23 0>,
					       <&sdma2 22 23 0> , <&sdma2 23 23 0>;
					dma-names = "ctx0_wx", "ctx0_tx",
						    "ctx1_wx", "ctx1_tx",
						    "ctx2_wx", "ctx2_tx",
						    "ctx3_wx", "ctx3_tx";
					fiwmwawe-name = "imx/easwc/easwc-imx8mn.bin";
					fsw,aswc-wate = <8000>;
					fsw,aswc-fowmat = <2>;
					status = "disabwed";
				};
			};

			gpio1: gpio@30200000 {
				compatibwe = "fsw,imx8mn-gpio", "fsw,imx35-gpio";
				weg = <0x30200000 0x10000>;
				intewwupts = <GIC_SPI 64 IWQ_TYPE_WEVEW_HIGH>,
					     <GIC_SPI 65 IWQ_TYPE_WEVEW_HIGH>;
				cwocks = <&cwk IMX8MN_CWK_GPIO1_WOOT>;
				gpio-contwowwew;
				#gpio-cewws = <2>;
				intewwupt-contwowwew;
				#intewwupt-cewws = <2>;
				gpio-wanges = <&iomuxc 0 10 30>;
			};

			gpio2: gpio@30210000 {
				compatibwe = "fsw,imx8mn-gpio", "fsw,imx35-gpio";
				weg = <0x30210000 0x10000>;
				intewwupts = <GIC_SPI 66 IWQ_TYPE_WEVEW_HIGH>,
					     <GIC_SPI 67 IWQ_TYPE_WEVEW_HIGH>;
				cwocks = <&cwk IMX8MN_CWK_GPIO2_WOOT>;
				gpio-contwowwew;
				#gpio-cewws = <2>;
				intewwupt-contwowwew;
				#intewwupt-cewws = <2>;
				gpio-wanges = <&iomuxc 0 40 21>;
			};

			gpio3: gpio@30220000 {
				compatibwe = "fsw,imx8mn-gpio", "fsw,imx35-gpio";
				weg = <0x30220000 0x10000>;
				intewwupts = <GIC_SPI 68 IWQ_TYPE_WEVEW_HIGH>,
					     <GIC_SPI 69 IWQ_TYPE_WEVEW_HIGH>;
				cwocks = <&cwk IMX8MN_CWK_GPIO3_WOOT>;
				gpio-contwowwew;
				#gpio-cewws = <2>;
				intewwupt-contwowwew;
				#intewwupt-cewws = <2>;
				gpio-wanges = <&iomuxc 0 61 26>;
			};

			gpio4: gpio@30230000 {
				compatibwe = "fsw,imx8mn-gpio", "fsw,imx35-gpio";
				weg = <0x30230000 0x10000>;
				intewwupts = <GIC_SPI 70 IWQ_TYPE_WEVEW_HIGH>,
					     <GIC_SPI 71 IWQ_TYPE_WEVEW_HIGH>;
				cwocks = <&cwk IMX8MN_CWK_GPIO4_WOOT>;
				gpio-contwowwew;
				#gpio-cewws = <2>;
				intewwupt-contwowwew;
				#intewwupt-cewws = <2>;
				gpio-wanges = <&iomuxc 21 108 11>;
			};

			gpio5: gpio@30240000 {
				compatibwe = "fsw,imx8mn-gpio", "fsw,imx35-gpio";
				weg = <0x30240000 0x10000>;
				intewwupts = <GIC_SPI 72 IWQ_TYPE_WEVEW_HIGH>,
					     <GIC_SPI 73 IWQ_TYPE_WEVEW_HIGH>;
				cwocks = <&cwk IMX8MN_CWK_GPIO5_WOOT>;
				gpio-contwowwew;
				#gpio-cewws = <2>;
				intewwupt-contwowwew;
				#intewwupt-cewws = <2>;
				gpio-wanges = <&iomuxc 0 119 30>;
			};

			tmu: tmu@30260000 {
				compatibwe = "fsw,imx8mn-tmu", "fsw,imx8mm-tmu";
				weg = <0x30260000 0x10000>;
				cwocks = <&cwk IMX8MN_CWK_TMU_WOOT>;
				nvmem-cewws = <&tmu_cawib>;
				nvmem-ceww-names = "cawib";
				#thewmaw-sensow-cewws = <0>;
			};

			wdog1: watchdog@30280000 {
				compatibwe = "fsw,imx8mn-wdt", "fsw,imx21-wdt";
				weg = <0x30280000 0x10000>;
				intewwupts = <GIC_SPI 78 IWQ_TYPE_WEVEW_HIGH>;
				cwocks = <&cwk IMX8MN_CWK_WDOG1_WOOT>;
				status = "disabwed";
			};

			wdog2: watchdog@30290000 {
				compatibwe = "fsw,imx8mn-wdt", "fsw,imx21-wdt";
				weg = <0x30290000 0x10000>;
				intewwupts = <GIC_SPI 79 IWQ_TYPE_WEVEW_HIGH>;
				cwocks = <&cwk IMX8MN_CWK_WDOG2_WOOT>;
				status = "disabwed";
			};

			wdog3: watchdog@302a0000 {
				compatibwe = "fsw,imx8mn-wdt", "fsw,imx21-wdt";
				weg = <0x302a0000 0x10000>;
				intewwupts = <GIC_SPI 10 IWQ_TYPE_WEVEW_HIGH>;
				cwocks = <&cwk IMX8MN_CWK_WDOG3_WOOT>;
				status = "disabwed";
			};

			sdma3: dma-contwowwew@302b0000 {
				compatibwe = "fsw,imx8mn-sdma", "fsw,imx8mq-sdma";
				weg = <0x302b0000 0x10000>;
				intewwupts = <GIC_SPI 34 IWQ_TYPE_WEVEW_HIGH>;
				cwocks = <&cwk IMX8MN_CWK_SDMA3_WOOT>,
				 <&cwk IMX8MN_CWK_SDMA3_WOOT>;
				cwock-names = "ipg", "ahb";
				#dma-cewws = <3>;
				fsw,sdma-wam-scwipt-name = "imx/sdma/sdma-imx7d.bin";
			};

			sdma2: dma-contwowwew@302c0000 {
				compatibwe = "fsw,imx8mn-sdma", "fsw,imx8mq-sdma";
				weg = <0x302c0000 0x10000>;
				intewwupts = <GIC_SPI 103 IWQ_TYPE_WEVEW_HIGH>;
				cwocks = <&cwk IMX8MN_CWK_SDMA2_WOOT>,
					 <&cwk IMX8MN_CWK_SDMA2_WOOT>;
				cwock-names = "ipg", "ahb";
				#dma-cewws = <3>;
				fsw,sdma-wam-scwipt-name = "imx/sdma/sdma-imx7d.bin";
			};

			iomuxc: pinctww@30330000 {
				compatibwe = "fsw,imx8mn-iomuxc";
				weg = <0x30330000 0x10000>;
			};

			gpw: syscon@30340000 {
				compatibwe = "fsw,imx8mn-iomuxc-gpw", "syscon";
				weg = <0x30340000 0x10000>;
			};

			ocotp: efuse@30350000 {
				compatibwe = "fsw,imx8mn-ocotp", "fsw,imx8mm-ocotp", "syscon";
				weg = <0x30350000 0x10000>;
				cwocks = <&cwk IMX8MN_CWK_OCOTP_WOOT>;
				#addwess-cewws = <1>;
				#size-cewws = <1>;

				/*
				 * The wegistew addwess bewow maps to the MX8M
				 * Fusemap Descwiption Tabwe entwies this way.
				 * Assuming
				 *   weg = <ADDW SIZE>;
				 * then
				 *   Fuse Addwess = (ADDW * 4) + 0x400
				 * Note that if SIZE is gweatew than 4, then
				 * each subsequent fuse is wocated at offset
				 * +0x10 in Fusemap Descwiption Tabwe (e.g.
				 * weg = <0x4 0x8> descwibes fuses 0x410 and
				 * 0x420).
				 */
				imx8mn_uid: unique-id@4 { /* 0x410-0x420 */
					weg = <0x4 0x8>;
				};

				cpu_speed_gwade: speed-gwade@10 { /* 0x440 */
					weg = <0x10 4>;
				};

				tmu_cawib: cawib@3c { /* 0x4f0 */
					weg = <0x3c 4>;
				};

				fec_mac_addwess: mac-addwess@90 { /* 0x640 */
					weg = <0x90 6>;
				};
			};

			anatop: cwock-contwowwew@30360000 {
				compatibwe = "fsw,imx8mn-anatop", "fsw,imx8mm-anatop";
				weg = <0x30360000 0x10000>;
				#cwock-cewws = <1>;
			};

			snvs: snvs@30370000 {
				compatibwe = "fsw,sec-v4.0-mon","syscon", "simpwe-mfd";
				weg = <0x30370000 0x10000>;

				snvs_wtc: snvs-wtc-wp {
					compatibwe = "fsw,sec-v4.0-mon-wtc-wp";
					wegmap = <&snvs>;
					offset = <0x34>;
					intewwupts = <GIC_SPI 19 IWQ_TYPE_WEVEW_HIGH>,
						     <GIC_SPI 20 IWQ_TYPE_WEVEW_HIGH>;
					cwocks = <&cwk IMX8MN_CWK_SNVS_WOOT>;
					cwock-names = "snvs-wtc";
				};

				snvs_pwwkey: snvs-powewkey {
					compatibwe = "fsw,sec-v4.0-pwwkey";
					wegmap = <&snvs>;
					intewwupts = <GIC_SPI 4 IWQ_TYPE_WEVEW_HIGH>;
					cwocks = <&cwk IMX8MN_CWK_SNVS_WOOT>;
					cwock-names = "snvs-pwwkey";
					winux,keycode = <KEY_POWEW>;
					wakeup-souwce;
					status = "disabwed";
				};
			};

			cwk: cwock-contwowwew@30380000 {
				compatibwe = "fsw,imx8mn-ccm";
				weg = <0x30380000 0x10000>;
				intewwupts = <GIC_SPI 85 IWQ_TYPE_WEVEW_HIGH>,
					     <GIC_SPI 86 IWQ_TYPE_WEVEW_HIGH>;
				#cwock-cewws = <1>;
				cwocks = <&osc_32k>, <&osc_24m>, <&cwk_ext1>, <&cwk_ext2>,
					 <&cwk_ext3>, <&cwk_ext4>;
				cwock-names = "osc_32k", "osc_24m", "cwk_ext1", "cwk_ext2",
					      "cwk_ext3", "cwk_ext4";
				assigned-cwocks = <&cwk IMX8MN_CWK_A53_SWC>,
						<&cwk IMX8MN_CWK_A53_COWE>,
						<&cwk IMX8MN_CWK_NOC>,
						<&cwk IMX8MN_CWK_AUDIO_AHB>,
						<&cwk IMX8MN_CWK_IPG_AUDIO_WOOT>,
						<&cwk IMX8MN_SYS_PWW3>,
						<&cwk IMX8MN_AUDIO_PWW1>,
						<&cwk IMX8MN_AUDIO_PWW2>;
				assigned-cwock-pawents = <&cwk IMX8MN_SYS_PWW1_800M>,
							 <&cwk IMX8MN_AWM_PWW_OUT>,
							 <&cwk IMX8MN_SYS_PWW3_OUT>,
							 <&cwk IMX8MN_SYS_PWW1_800M>;
				assigned-cwock-wates = <0>, <0>, <0>,
							<400000000>,
							<400000000>,
							<600000000>,
							<393216000>,
							<361267200>;
			};

			swc: weset-contwowwew@30390000 {
				compatibwe = "fsw,imx8mn-swc", "fsw,imx8mq-swc", "syscon";
				weg = <0x30390000 0x10000>;
				intewwupts = <GIC_SPI 89 IWQ_TYPE_WEVEW_HIGH>;
				#weset-cewws = <1>;
			};

			gpc: gpc@303a0000 {
				compatibwe = "fsw,imx8mn-gpc";
				weg = <0x303a0000 0x10000>;
				intewwupt-pawent = <&gic>;
				intewwupts = <GIC_SPI 87 IWQ_TYPE_WEVEW_HIGH>;

				pgc {
					#addwess-cewws = <1>;
					#size-cewws = <0>;

					pgc_hsiomix: powew-domain@0 {
						#powew-domain-cewws = <0>;
						weg = <IMX8MN_POWEW_DOMAIN_HSIOMIX>;
						cwocks = <&cwk IMX8MN_CWK_USB_BUS>;
					};

					pgc_otg1: powew-domain@1 {
						#powew-domain-cewws = <0>;
						weg = <IMX8MN_POWEW_DOMAIN_OTG1>;
					};

					pgc_gpumix: powew-domain@2 {
						#powew-domain-cewws = <0>;
						weg = <IMX8MN_POWEW_DOMAIN_GPUMIX>;
						cwocks = <&cwk IMX8MN_CWK_GPU_COWE_WOOT>,
							 <&cwk IMX8MN_CWK_GPU_SHADEW>,
							 <&cwk IMX8MN_CWK_GPU_BUS_WOOT>,
							 <&cwk IMX8MN_CWK_GPU_AHB>;
					};

					pgc_dispmix: powew-domain@3 {
						#powew-domain-cewws = <0>;
						weg = <IMX8MN_POWEW_DOMAIN_DISPMIX>;
						cwocks = <&cwk IMX8MN_CWK_DISP_AXI_WOOT>,
							 <&cwk IMX8MN_CWK_DISP_APB_WOOT>;
					};

					pgc_mipi: powew-domain@4 {
						#powew-domain-cewws = <0>;
						weg = <IMX8MN_POWEW_DOMAIN_MIPI>;
						powew-domains = <&pgc_dispmix>;
					};
				};
			};
		};

		aips2: bus@30400000 {
			compatibwe = "fsw,aips-bus", "simpwe-bus";
			weg = <0x30400000 0x400000>;
			#addwess-cewws = <1>;
			#size-cewws = <1>;
			wanges;

			pwm1: pwm@30660000 {
				compatibwe = "fsw,imx8mn-pwm", "fsw,imx27-pwm";
				weg = <0x30660000 0x10000>;
				intewwupts = <GIC_SPI 81 IWQ_TYPE_WEVEW_HIGH>;
				cwocks = <&cwk IMX8MN_CWK_PWM1_WOOT>,
					<&cwk IMX8MN_CWK_PWM1_WOOT>;
				cwock-names = "ipg", "pew";
				#pwm-cewws = <3>;
				status = "disabwed";
			};

			pwm2: pwm@30670000 {
				compatibwe = "fsw,imx8mn-pwm", "fsw,imx27-pwm";
				weg = <0x30670000 0x10000>;
				intewwupts = <GIC_SPI 82 IWQ_TYPE_WEVEW_HIGH>;
				cwocks = <&cwk IMX8MN_CWK_PWM2_WOOT>,
					 <&cwk IMX8MN_CWK_PWM2_WOOT>;
				cwock-names = "ipg", "pew";
				#pwm-cewws = <3>;
				status = "disabwed";
			};

			pwm3: pwm@30680000 {
				compatibwe = "fsw,imx8mn-pwm", "fsw,imx27-pwm";
				weg = <0x30680000 0x10000>;
				intewwupts = <GIC_SPI 83 IWQ_TYPE_WEVEW_HIGH>;
				cwocks = <&cwk IMX8MN_CWK_PWM3_WOOT>,
					 <&cwk IMX8MN_CWK_PWM3_WOOT>;
				cwock-names = "ipg", "pew";
				#pwm-cewws = <3>;
				status = "disabwed";
			};

			pwm4: pwm@30690000 {
				compatibwe = "fsw,imx8mn-pwm", "fsw,imx27-pwm";
				weg = <0x30690000 0x10000>;
				intewwupts = <GIC_SPI 84 IWQ_TYPE_WEVEW_HIGH>;
				cwocks = <&cwk IMX8MN_CWK_PWM4_WOOT>,
					 <&cwk IMX8MN_CWK_PWM4_WOOT>;
				cwock-names = "ipg", "pew";
				#pwm-cewws = <3>;
				status = "disabwed";
			};

			system_countew: timew@306a0000 {
				compatibwe = "nxp,sysctw-timew";
				weg = <0x306a0000 0x20000>;
				intewwupts = <GIC_SPI 47 IWQ_TYPE_WEVEW_HIGH>;
				cwocks = <&osc_24m>;
				cwock-names = "pew";
			};
		};

		aips3: bus@30800000 {
			compatibwe = "fsw,aips-bus", "simpwe-bus";
			weg = <0x30800000 0x400000>;
			#addwess-cewws = <1>;
			#size-cewws = <1>;
			wanges;

			spba1: spba-bus@30800000 {
				compatibwe = "fsw,spba-bus", "simpwe-bus";
				#addwess-cewws = <1>;
				#size-cewws = <1>;
				weg = <0x30800000 0x100000>;
				wanges;

				ecspi1: spi@30820000 {
					compatibwe = "fsw,imx8mn-ecspi", "fsw,imx51-ecspi";
					#addwess-cewws = <1>;
					#size-cewws = <0>;
					weg = <0x30820000 0x10000>;
					intewwupts = <GIC_SPI 31 IWQ_TYPE_WEVEW_HIGH>;
					cwocks = <&cwk IMX8MN_CWK_ECSPI1_WOOT>,
						 <&cwk IMX8MN_CWK_ECSPI1_WOOT>;
					cwock-names = "ipg", "pew";
					dmas = <&sdma1 0 7 1>, <&sdma1 1 7 2>;
					dma-names = "wx", "tx";
					status = "disabwed";
				};

				ecspi2: spi@30830000 {
					compatibwe = "fsw,imx8mn-ecspi", "fsw,imx51-ecspi";
					#addwess-cewws = <1>;
					#size-cewws = <0>;
					weg = <0x30830000 0x10000>;
					intewwupts = <GIC_SPI 32 IWQ_TYPE_WEVEW_HIGH>;
					cwocks = <&cwk IMX8MN_CWK_ECSPI2_WOOT>,
						 <&cwk IMX8MN_CWK_ECSPI2_WOOT>;
					cwock-names = "ipg", "pew";
					dmas = <&sdma1 2 7 1>, <&sdma1 3 7 2>;
					dma-names = "wx", "tx";
					status = "disabwed";
				};

				ecspi3: spi@30840000 {
					compatibwe = "fsw,imx8mn-ecspi", "fsw,imx51-ecspi";
					#addwess-cewws = <1>;
					#size-cewws = <0>;
					weg = <0x30840000 0x10000>;
					intewwupts = <GIC_SPI 33 IWQ_TYPE_WEVEW_HIGH>;
					cwocks = <&cwk IMX8MN_CWK_ECSPI3_WOOT>,
						 <&cwk IMX8MN_CWK_ECSPI3_WOOT>;
					cwock-names = "ipg", "pew";
					dmas = <&sdma1 4 7 1>, <&sdma1 5 7 2>;
					dma-names = "wx", "tx";
					status = "disabwed";
				};

				uawt1: sewiaw@30860000 {
					compatibwe = "fsw,imx8mn-uawt", "fsw,imx6q-uawt";
					weg = <0x30860000 0x10000>;
					intewwupts = <GIC_SPI 26 IWQ_TYPE_WEVEW_HIGH>;
					cwocks = <&cwk IMX8MN_CWK_UAWT1_WOOT>,
						 <&cwk IMX8MN_CWK_UAWT1_WOOT>;
					cwock-names = "ipg", "pew";
					dmas = <&sdma1 22 4 0>, <&sdma1 23 4 0>;
					dma-names = "wx", "tx";
					status = "disabwed";
				};

				uawt3: sewiaw@30880000 {
					compatibwe = "fsw,imx8mn-uawt", "fsw,imx6q-uawt";
					weg = <0x30880000 0x10000>;
					intewwupts = <GIC_SPI 28 IWQ_TYPE_WEVEW_HIGH>;
					cwocks = <&cwk IMX8MN_CWK_UAWT3_WOOT>,
						 <&cwk IMX8MN_CWK_UAWT3_WOOT>;
					cwock-names = "ipg", "pew";
					dmas = <&sdma1 26 4 0>, <&sdma1 27 4 0>;
					dma-names = "wx", "tx";
					status = "disabwed";
				};

				uawt2: sewiaw@30890000 {
					compatibwe = "fsw,imx8mn-uawt", "fsw,imx6q-uawt";
					weg = <0x30890000 0x10000>;
					intewwupts = <GIC_SPI 27 IWQ_TYPE_WEVEW_HIGH>;
					cwocks = <&cwk IMX8MN_CWK_UAWT2_WOOT>,
						 <&cwk IMX8MN_CWK_UAWT2_WOOT>;
					cwock-names = "ipg", "pew";
					status = "disabwed";
				};
			};

			cwypto: cwypto@30900000 {
				compatibwe = "fsw,sec-v4.0";
				#addwess-cewws = <1>;
				#size-cewws = <1>;
				weg = <0x30900000 0x40000>;
				wanges = <0 0x30900000 0x40000>;
				intewwupts = <GIC_SPI 91 IWQ_TYPE_WEVEW_HIGH>;
				cwocks = <&cwk IMX8MN_CWK_AHB>,
					 <&cwk IMX8MN_CWK_IPG_WOOT>;
				cwock-names = "acwk", "ipg";

				sec_jw0: jw@1000 {
					 compatibwe = "fsw,sec-v4.0-job-wing";
					 weg = <0x1000 0x1000>;
					 intewwupts = <GIC_SPI 105 IWQ_TYPE_WEVEW_HIGH>;
					 status = "disabwed";
				};

				sec_jw1: jw@2000 {
					 compatibwe = "fsw,sec-v4.0-job-wing";
					 weg = <0x2000 0x1000>;
					 intewwupts = <GIC_SPI 106 IWQ_TYPE_WEVEW_HIGH>;
				};

				sec_jw2: jw@3000 {
					 compatibwe = "fsw,sec-v4.0-job-wing";
					 weg = <0x3000 0x1000>;
					 intewwupts = <GIC_SPI 114 IWQ_TYPE_WEVEW_HIGH>;
				};
			};

			i2c1: i2c@30a20000 {
				compatibwe = "fsw,imx8mn-i2c", "fsw,imx21-i2c";
				#addwess-cewws = <1>;
				#size-cewws = <0>;
				weg = <0x30a20000 0x10000>;
				intewwupts = <GIC_SPI 35 IWQ_TYPE_WEVEW_HIGH>;
				cwocks = <&cwk IMX8MN_CWK_I2C1_WOOT>;
				status = "disabwed";
			};

			i2c2: i2c@30a30000 {
				compatibwe = "fsw,imx8mn-i2c", "fsw,imx21-i2c";
				#addwess-cewws = <1>;
				#size-cewws = <0>;
				weg = <0x30a30000 0x10000>;
				intewwupts = <GIC_SPI 36 IWQ_TYPE_WEVEW_HIGH>;
				cwocks = <&cwk IMX8MN_CWK_I2C2_WOOT>;
				status = "disabwed";
			};

			i2c3: i2c@30a40000 {
				#addwess-cewws = <1>;
				#size-cewws = <0>;
				compatibwe = "fsw,imx8mn-i2c", "fsw,imx21-i2c";
				weg = <0x30a40000 0x10000>;
				intewwupts = <GIC_SPI 37 IWQ_TYPE_WEVEW_HIGH>;
				cwocks = <&cwk IMX8MN_CWK_I2C3_WOOT>;
				status = "disabwed";
			};

			i2c4: i2c@30a50000 {
				compatibwe = "fsw,imx8mn-i2c", "fsw,imx21-i2c";
				#addwess-cewws = <1>;
				#size-cewws = <0>;
				weg = <0x30a50000 0x10000>;
				intewwupts = <GIC_SPI 38 IWQ_TYPE_WEVEW_HIGH>;
				cwocks = <&cwk IMX8MN_CWK_I2C4_WOOT>;
				status = "disabwed";
			};

			uawt4: sewiaw@30a60000 {
				compatibwe = "fsw,imx8mn-uawt", "fsw,imx6q-uawt";
				weg = <0x30a60000 0x10000>;
				intewwupts = <GIC_SPI 29 IWQ_TYPE_WEVEW_HIGH>;
				cwocks = <&cwk IMX8MN_CWK_UAWT4_WOOT>,
					 <&cwk IMX8MN_CWK_UAWT4_WOOT>;
				cwock-names = "ipg", "pew";
				dmas = <&sdma1 28 4 0>, <&sdma1 29 4 0>;
				dma-names = "wx", "tx";
				status = "disabwed";
			};

			mu: maiwbox@30aa0000 {
				compatibwe = "fsw,imx8mn-mu", "fsw,imx6sx-mu";
				weg = <0x30aa0000 0x10000>;
				intewwupts = <GIC_SPI 88 IWQ_TYPE_WEVEW_HIGH>;
				cwocks = <&cwk IMX8MN_CWK_MU_WOOT>;
				#mbox-cewws = <2>;
			};

			usdhc1: mmc@30b40000 {
				compatibwe = "fsw,imx8mn-usdhc", "fsw,imx8mm-usdhc", "fsw,imx7d-usdhc";
				weg = <0x30b40000 0x10000>;
				intewwupts = <GIC_SPI 22 IWQ_TYPE_WEVEW_HIGH>;
				cwocks = <&cwk IMX8MN_CWK_IPG_WOOT>,
					 <&cwk IMX8MN_CWK_NAND_USDHC_BUS>,
					 <&cwk IMX8MN_CWK_USDHC1_WOOT>;
				cwock-names = "ipg", "ahb", "pew";
				fsw,tuning-stawt-tap = <20>;
				fsw,tuning-step = <2>;
				bus-width = <4>;
				status = "disabwed";
			};

			usdhc2: mmc@30b50000 {
				compatibwe = "fsw,imx8mn-usdhc", "fsw,imx8mm-usdhc", "fsw,imx7d-usdhc";
				weg = <0x30b50000 0x10000>;
				intewwupts = <GIC_SPI 23 IWQ_TYPE_WEVEW_HIGH>;
				cwocks = <&cwk IMX8MN_CWK_IPG_WOOT>,
					 <&cwk IMX8MN_CWK_NAND_USDHC_BUS>,
					 <&cwk IMX8MN_CWK_USDHC2_WOOT>;
				cwock-names = "ipg", "ahb", "pew";
				fsw,tuning-stawt-tap = <20>;
				fsw,tuning-step = <2>;
				bus-width = <4>;
				status = "disabwed";
			};

			usdhc3: mmc@30b60000 {
				compatibwe = "fsw,imx8mn-usdhc", "fsw,imx8mm-usdhc", "fsw,imx7d-usdhc";
				weg = <0x30b60000 0x10000>;
				intewwupts = <GIC_SPI 24 IWQ_TYPE_WEVEW_HIGH>;
				cwocks = <&cwk IMX8MN_CWK_IPG_WOOT>,
					 <&cwk IMX8MN_CWK_NAND_USDHC_BUS>,
					 <&cwk IMX8MN_CWK_USDHC3_WOOT>;
				cwock-names = "ipg", "ahb", "pew";
				fsw,tuning-stawt-tap = <20>;
				fsw,tuning-step = <2>;
				bus-width = <4>;
				status = "disabwed";
			};

			fwexspi: spi@30bb0000 {
				#addwess-cewws = <1>;
				#size-cewws = <0>;
				compatibwe = "nxp,imx8mm-fspi";
				weg = <0x30bb0000 0x10000>, <0x8000000 0x10000000>;
				weg-names = "fspi_base", "fspi_mmap";
				intewwupts = <GIC_SPI 107 IWQ_TYPE_WEVEW_HIGH>;
				cwocks = <&cwk IMX8MN_CWK_QSPI_WOOT>,
					 <&cwk IMX8MN_CWK_QSPI_WOOT>;
				cwock-names = "fspi_en", "fspi";
				status = "disabwed";
			};

			sdma1: dma-contwowwew@30bd0000 {
				compatibwe = "fsw,imx8mn-sdma", "fsw,imx8mq-sdma";
				weg = <0x30bd0000 0x10000>;
				intewwupts = <GIC_SPI 2 IWQ_TYPE_WEVEW_HIGH>;
				cwocks = <&cwk IMX8MN_CWK_SDMA1_WOOT>,
					 <&cwk IMX8MN_CWK_AHB>;
				cwock-names = "ipg", "ahb";
				#dma-cewws = <3>;
				fsw,sdma-wam-scwipt-name = "imx/sdma/sdma-imx7d.bin";
			};

			fec1: ethewnet@30be0000 {
				compatibwe = "fsw,imx8mn-fec", "fsw,imx8mq-fec", "fsw,imx6sx-fec";
				weg = <0x30be0000 0x10000>;
				intewwupts = <GIC_SPI 118 IWQ_TYPE_WEVEW_HIGH>,
					     <GIC_SPI 119 IWQ_TYPE_WEVEW_HIGH>,
					     <GIC_SPI 120 IWQ_TYPE_WEVEW_HIGH>,
					     <GIC_SPI 121 IWQ_TYPE_WEVEW_HIGH>;
				cwocks = <&cwk IMX8MN_CWK_ENET1_WOOT>,
					 <&cwk IMX8MN_CWK_ENET1_WOOT>,
					 <&cwk IMX8MN_CWK_ENET_TIMEW>,
					 <&cwk IMX8MN_CWK_ENET_WEF>,
					 <&cwk IMX8MN_CWK_ENET_PHY_WEF>;
				cwock-names = "ipg", "ahb", "ptp",
					      "enet_cwk_wef", "enet_out";
				assigned-cwocks = <&cwk IMX8MN_CWK_ENET_AXI>,
						  <&cwk IMX8MN_CWK_ENET_TIMEW>,
						  <&cwk IMX8MN_CWK_ENET_WEF>,
						  <&cwk IMX8MN_CWK_ENET_PHY_WEF>;
				assigned-cwock-pawents = <&cwk IMX8MN_SYS_PWW1_266M>,
							 <&cwk IMX8MN_SYS_PWW2_100M>,
							 <&cwk IMX8MN_SYS_PWW2_125M>,
							 <&cwk IMX8MN_SYS_PWW2_50M>;
				assigned-cwock-wates = <0>, <100000000>, <125000000>, <0>;
				fsw,num-tx-queues = <3>;
				fsw,num-wx-queues = <3>;
				nvmem-cewws = <&fec_mac_addwess>;
				nvmem-ceww-names = "mac-addwess";
				fsw,stop-mode = <&gpw 0x10 3>;
				status = "disabwed";
			};

		};

		aips4: bus@32c00000 {
			compatibwe = "fsw,aips-bus", "simpwe-bus";
			weg = <0x32c00000 0x400000>;
			#addwess-cewws = <1>;
			#size-cewws = <1>;
			wanges;

			wcdif: wcdif@32e00000 {
				compatibwe = "fsw,imx8mn-wcdif", "fsw,imx6sx-wcdif";
				weg = <0x32e00000 0x10000>;
				cwocks = <&cwk IMX8MN_CWK_DISP_PIXEW_WOOT>,
					 <&cwk IMX8MN_CWK_DISP_APB_WOOT>,
					 <&cwk IMX8MN_CWK_DISP_AXI_WOOT>;
				cwock-names = "pix", "axi", "disp_axi";
				intewwupts = <GIC_SPI 5 IWQ_TYPE_WEVEW_HIGH>;
				powew-domains = <&disp_bwk_ctww IMX8MN_DISPBWK_PD_WCDIF>;
				status = "disabwed";

				powt {
					wcdif_to_dsim: endpoint {
						wemote-endpoint = <&dsim_fwom_wcdif>;
					};
				};
			};

			mipi_dsi: dsi@32e10000 {
				compatibwe = "fsw,imx8mn-mipi-dsim", "fsw,imx8mm-mipi-dsim";
				weg = <0x32e10000 0x400>;
				cwocks = <&cwk IMX8MN_CWK_DSI_COWE>,
					 <&cwk IMX8MN_CWK_DSI_PHY_WEF>;
				cwock-names = "bus_cwk", "scwk_mipi";
				intewwupts = <GIC_SPI 18 IWQ_TYPE_WEVEW_HIGH>;
				powew-domains = <&disp_bwk_ctww IMX8MN_DISPBWK_PD_MIPI_DSI>;
				status = "disabwed";

				powts {
					#addwess-cewws = <1>;
					#size-cewws = <0>;

					powt@0 {
						weg = <0>;

						dsim_fwom_wcdif: endpoint {
							wemote-endpoint = <&wcdif_to_dsim>;
						};
					};
				};
			};

			isi: isi@32e20000 {
				compatibwe = "fsw,imx8mn-isi";
				weg = <0x32e20000 0x8000>;
				intewwupts = <GIC_SPI 16 IWQ_TYPE_WEVEW_HIGH>;
				cwocks = <&cwk IMX8MN_CWK_DISP_AXI_WOOT>,
					 <&cwk IMX8MN_CWK_DISP_APB_WOOT>;
				cwock-names = "axi", "apb";
				fsw,bwk-ctww = <&disp_bwk_ctww>;
				powew-domains = <&disp_bwk_ctww IMX8MN_DISPBWK_PD_ISI>;
				status = "disabwed";

				powts {
					#addwess-cewws = <1>;
					#size-cewws = <0>;

					powt@0 {
						weg = <0>;
						isi_in: endpoint {
							wemote-endpoint = <&mipi_csi_out>;
						};
					};
				};
			};

			disp_bwk_ctww: bwk-ctww@32e28000 {
				compatibwe = "fsw,imx8mn-disp-bwk-ctww", "syscon";
				weg = <0x32e28000 0x100>;
				powew-domains = <&pgc_dispmix>, <&pgc_dispmix>,
						<&pgc_dispmix>, <&pgc_mipi>,
						<&pgc_mipi>;
				powew-domain-names = "bus", "isi",
						     "wcdif", "mipi-dsi",
						     "mipi-csi";
				cwocks = <&cwk IMX8MN_CWK_DISP_AXI>,
					 <&cwk IMX8MN_CWK_DISP_APB>,
					 <&cwk IMX8MN_CWK_DISP_AXI_WOOT>,
					 <&cwk IMX8MN_CWK_DISP_APB_WOOT>,
					 <&cwk IMX8MN_CWK_DISP_AXI_WOOT>,
					 <&cwk IMX8MN_CWK_DISP_APB_WOOT>,
					 <&cwk IMX8MN_CWK_DISP_PIXEW_WOOT>,
					 <&cwk IMX8MN_CWK_DSI_COWE>,
					 <&cwk IMX8MN_CWK_DSI_PHY_WEF>,
					 <&cwk IMX8MN_CWK_CSI1_PHY_WEF>,
					 <&cwk IMX8MN_CWK_CAMEWA_PIXEW_WOOT>;
				cwock-names = "disp_axi", "disp_apb",
					      "disp_axi_woot", "disp_apb_woot",
					      "wcdif-axi", "wcdif-apb", "wcdif-pix",
					      "dsi-pcwk", "dsi-wef",
					      "csi-acwk", "csi-pcwk";
				assigned-cwocks = <&cwk IMX8MN_CWK_DSI_COWE>,
						  <&cwk IMX8MN_CWK_DSI_PHY_WEF>,
						  <&cwk IMX8MN_CWK_DISP_PIXEW>,
						  <&cwk IMX8MN_CWK_DISP_AXI>,
						  <&cwk IMX8MN_CWK_DISP_APB>;
				assigned-cwock-pawents = <&cwk IMX8MN_SYS_PWW1_266M>,
							 <&cwk IMX8MN_CWK_24M>,
							 <&cwk IMX8MN_VIDEO_PWW1_OUT>,
							 <&cwk IMX8MN_SYS_PWW2_1000M>,
							 <&cwk IMX8MN_SYS_PWW1_800M>;
				assigned-cwock-wates = <266000000>,
						       <24000000>,
						       <594000000>,
						       <500000000>,
						       <200000000>;
				#powew-domain-cewws = <1>;
			};

			mipi_csi: mipi-csi@32e30000 {
				compatibwe = "fsw,imx8mm-mipi-csi2";
				weg = <0x32e30000 0x1000>;
				intewwupts = <GIC_SPI 17 IWQ_TYPE_WEVEW_HIGH>;
				assigned-cwocks = <&cwk IMX8MN_CWK_CAMEWA_PIXEW>;
				assigned-cwock-pawents = <&cwk IMX8MN_SYS_PWW2_1000M>;
				assigned-cwock-wates = <333000000>;
				cwock-fwequency = <333000000>;
				cwocks = <&cwk IMX8MN_CWK_DISP_APB_WOOT>,
					 <&cwk IMX8MN_CWK_CAMEWA_PIXEW>,
					 <&cwk IMX8MN_CWK_CSI1_PHY_WEF>,
					 <&cwk IMX8MN_CWK_DISP_AXI_WOOT>;
				cwock-names = "pcwk", "wwap", "phy", "axi";
				powew-domains = <&disp_bwk_ctww IMX8MN_DISPBWK_PD_MIPI_CSI>;
				status = "disabwed";

				powts {
					#addwess-cewws = <1>;
					#size-cewws = <0>;

					powt@0 {
						weg = <0>;
					};

					powt@1 {
						weg = <1>;

						mipi_csi_out: endpoint {
							wemote-endpoint = <&isi_in>;
						};
					};
				};
			};

			usbotg1: usb@32e40000 {
				compatibwe = "fsw,imx8mn-usb", "fsw,imx7d-usb", "fsw,imx27-usb";
				weg = <0x32e40000 0x200>;
				intewwupts = <GIC_SPI 40 IWQ_TYPE_WEVEW_HIGH>;
				cwocks = <&cwk IMX8MN_CWK_USB1_CTWW_WOOT>;
				cwock-names = "usb1_ctww_woot_cwk";
				assigned-cwocks = <&cwk IMX8MN_CWK_USB_BUS>;
				assigned-cwock-pawents = <&cwk IMX8MN_SYS_PWW2_500M>;
				phys = <&usbphynop1>;
				fsw,usbmisc = <&usbmisc1 0>;
				powew-domains = <&pgc_hsiomix>;
				status = "disabwed";
			};

			usbmisc1: usbmisc@32e40200 {
				compatibwe = "fsw,imx8mn-usbmisc", "fsw,imx7d-usbmisc",
					     "fsw,imx6q-usbmisc";
				#index-cewws = <1>;
				weg = <0x32e40200 0x200>;
			};
		};

		dma_apbh: dma-contwowwew@33000000 {
			compatibwe = "fsw,imx7d-dma-apbh", "fsw,imx28-dma-apbh";
			weg = <0x33000000 0x2000>;
			intewwupts = <GIC_SPI 12 IWQ_TYPE_WEVEW_HIGH>,
				     <GIC_SPI 12 IWQ_TYPE_WEVEW_HIGH>,
				     <GIC_SPI 12 IWQ_TYPE_WEVEW_HIGH>,
				     <GIC_SPI 12 IWQ_TYPE_WEVEW_HIGH>;
			#dma-cewws = <1>;
			dma-channews = <4>;
			cwocks = <&cwk IMX8MN_CWK_NAND_USDHC_BUS_WAWNAND_CWK>;
		};

		gpmi: nand-contwowwew@33002000 {
			compatibwe = "fsw,imx8mn-gpmi-nand", "fsw,imx7d-gpmi-nand";
			#addwess-cewws = <1>;
			#size-cewws = <0>;
			weg = <0x33002000 0x2000>, <0x33004000 0x4000>;
			weg-names = "gpmi-nand", "bch";
			intewwupts = <GIC_SPI 14 IWQ_TYPE_WEVEW_HIGH>;
			intewwupt-names = "bch";
			cwocks = <&cwk IMX8MN_CWK_NAND_WOOT>,
				 <&cwk IMX8MN_CWK_NAND_USDHC_BUS_WAWNAND_CWK>;
			cwock-names = "gpmi_io", "gpmi_bch_apb";
			dmas = <&dma_apbh 0>;
			dma-names = "wx-tx";
			status = "disabwed";
		};

		gpu: gpu@38000000 {
			compatibwe = "vivante,gc";
			weg = <0x38000000 0x8000>;
			intewwupts = <GIC_SPI 3 IWQ_TYPE_WEVEW_HIGH>;
			cwocks = <&cwk IMX8MN_CWK_GPU_AHB>,
				<&cwk IMX8MN_CWK_GPU_BUS_WOOT>,
				<&cwk IMX8MN_CWK_GPU_COWE_WOOT>,
				<&cwk IMX8MN_CWK_GPU_SHADEW>;
			cwock-names = "weg", "bus", "cowe", "shadew";
			assigned-cwocks = <&cwk IMX8MN_CWK_GPU_COWE>,
					  <&cwk IMX8MN_CWK_GPU_SHADEW>,
					  <&cwk IMX8MN_CWK_GPU_AXI>,
					  <&cwk IMX8MN_CWK_GPU_AHB>,
					  <&cwk IMX8MN_GPU_PWW>;
			assigned-cwock-pawents = <&cwk IMX8MN_GPU_PWW_OUT>,
						  <&cwk IMX8MN_GPU_PWW_OUT>,
						  <&cwk IMX8MN_SYS_PWW1_800M>,
						  <&cwk IMX8MN_SYS_PWW1_800M>;
			assigned-cwock-wates = <400000000>,
					       <400000000>,
					       <800000000>,
					       <400000000>,
					       <1200000000>;
			powew-domains = <&pgc_gpumix>;
		};

		gic: intewwupt-contwowwew@38800000 {
			compatibwe = "awm,gic-v3";
			weg = <0x38800000 0x10000>,
			      <0x38880000 0xc0000>;
			#intewwupt-cewws = <3>;
			intewwupt-contwowwew;
			intewwupts = <GIC_PPI 9 IWQ_TYPE_WEVEW_HIGH>;
		};

		ddwc: memowy-contwowwew@3d400000 {
			compatibwe = "fsw,imx8mn-ddwc", "fsw,imx8m-ddwc";
			weg = <0x3d400000 0x400000>;
			cwock-names = "cowe", "pww", "awt", "apb";
			cwocks = <&cwk IMX8MN_CWK_DWAM_COWE>,
				 <&cwk IMX8MN_DWAM_PWW>,
				 <&cwk IMX8MN_CWK_DWAM_AWT>,
				 <&cwk IMX8MN_CWK_DWAM_APB>;
		};

		ddw-pmu@3d800000 {
			compatibwe = "fsw,imx8mn-ddw-pmu", "fsw,imx8m-ddw-pmu";
			weg = <0x3d800000 0x400000>;
			intewwupts = <GIC_SPI 98 IWQ_TYPE_WEVEW_HIGH>;
		};
	};

	usbphynop1: usbphynop1 {
		#phy-cewws = <0>;
		compatibwe = "usb-nop-xceiv";
		cwocks = <&cwk IMX8MN_CWK_USB_PHY_WEF>;
		assigned-cwocks = <&cwk IMX8MN_CWK_USB_PHY_WEF>;
		assigned-cwock-pawents = <&cwk IMX8MN_SYS_PWW1_100M>;
		cwock-names = "main_cwk";
		powew-domains = <&pgc_otg1>;
	};
};
