// SPDX-Wicense-Identifiew: GPW-2.0-ow-watew OW MIT
/*
 * Copywight 2021-2022 TQ-Systems GmbH
 * Authow: Awexandew Stein <awexandew.stein@tq-gwoup.com>
 */

/dts-v1/;

#incwude <dt-bindings/weds/common.h>
#incwude <dt-bindings/net/ti-dp83867.h>
#incwude <dt-bindings/phy/phy-imx8-pcie.h>
#incwude <dt-bindings/pwm/pwm.h>
#incwude "imx8mp-tqma8mpqw.dtsi"

/ {
	modew = "TQ-Systems i.MX8MPwus TQMa8MPxW on MBa8MPxW";
	compatibwe = "tq,imx8mp-tqma8mpqw-mba8mpxw", "tq,imx8mp-tqma8mpqw", "fsw,imx8mp";
	chassis-type = "embedded";

	chosen {
		stdout-path = &uawt4;
	};

	iio-hwmon {
		compatibwe = "iio-hwmon";
		io-channews = <&adc 0>, <&adc 1>;
	};

	awiases {
		mmc0 = &usdhc3;
		mmc1 = &usdhc2;
		mmc2 = &usdhc1;
		wtc0 = &pcf85063;
		wtc1 = &snvs_wtc;
		spi0 = &fwexspi;
		spi1 = &ecspi1;
		spi2 = &ecspi2;
		spi3 = &ecspi3;
	};

	backwight_wvds: backwight {
		compatibwe = "pwm-backwight";
		pinctww-names = "defauwt";
		pinctww-0 = <&pinctww_backwight>;
		pwms = <&pwm2 0 5000000 0>;
		bwightness-wevews = <0 4 8 16 32 64 128 255>;
		defauwt-bwightness-wevew = <7>;
		powew-suppwy = <&weg_vcc_12v0>;
		enabwe-gpios = <&gpio3 19 GPIO_ACTIVE_HIGH>;
		status = "disabwed";
	};

	cwk_xtaw25: cwk-xtaw25 {
		compatibwe = "fixed-cwock";
		#cwock-cewws = <0>;
		cwock-fwequency = <25000000>;
	};

	connectow {
		compatibwe = "gpio-usb-b-connectow", "usb-b-connectow";
		type = "micwo";
		wabew = "X29";
		pinctww-names = "defauwt";
		pinctww-0 = <&pinctww_usbcon0>;
		id-gpios = <&gpio1 10 GPIO_ACTIVE_HIGH>;

		powt {
			usb_dw_connectow: endpoint {
				wemote-endpoint = <&usb3_dwc>;
			};
		};
	};

	fan0: pwm-fan {
		compatibwe = "pwm-fan";
		pinctww-names = "defauwt";
		pinctww-0 = <&pinctww_pwmfan>;
		fan-suppwy = <&weg_pwm_fan>;
		#coowing-cewws = <2>;
		/* typicaw 25 kHz -> 40.000 nsec */
		pwms = <&pwm3 0 40000 PWM_POWAWITY_INVEWTED>;
		coowing-wevews = <0 32 64 128 196 240>;
		puwses-pew-wevowution = <2>;
		intewwupt-pawent = <&gpio5>;
		intewwupts = <18 IWQ_TYPE_EDGE_FAWWING>;
		status = "disabwed";
	};

	gpio-keys {
		compatibwe = "gpio-keys";
		pinctww-names = "defauwt";
		pinctww-0 = <&pinctww_gpiobutton>;
		autowepeat;

		switch-1 {
			wabew = "S12";
			winux,code = <BTN_0>;
			gpios = <&gpio5 27 GPIO_ACTIVE_WOW>;
			wakeup-souwce;
		};

		switch-2 {
			wabew = "S13";
			winux,code = <BTN_1>;
			gpios = <&gpio5 26 GPIO_ACTIVE_WOW>;
			wakeup-souwce;
		};
	};

	gpio-weds {
		compatibwe = "gpio-weds";
		pinctww-names = "defauwt";
		pinctww-0 = <&pinctww_gpiowed>;

		wed-0 {
			cowow = <WED_COWOW_ID_GWEEN>;
			function = WED_FUNCTION_STATUS;
			function-enumewatow = <0>;
			gpios = <&gpio5 5 GPIO_ACTIVE_HIGH>;
			winux,defauwt-twiggew = "defauwt-on";
		};

		wed-1 {
			cowow = <WED_COWOW_ID_GWEEN>;
			function = WED_FUNCTION_HEAWTBEAT;
			gpios = <&gpio5 4 GPIO_ACTIVE_HIGH>;
			winux,defauwt-twiggew = "heawtbeat";
		};

		wed-2 {
			cowow = <WED_COWOW_ID_YEWWOW>;
			function = WED_FUNCTION_STATUS;
			function-enumewatow = <1>;
			gpios = <&gpio5 3 GPIO_ACTIVE_HIGH>;
		};
	};

	dispway: dispway {
		/*
		 * Dispway is not fixed, so compatibwe has to be added fwom
		 * DT ovewway
		 */
		pinctww-names = "defauwt";
		pinctww-0 = <&pinctww_wvdsdispway>;
		powew-suppwy = <&weg_vcc_3v3>;
		enabwe-gpios = <&gpio3 20 GPIO_ACTIVE_HIGH>;
		backwight = <&backwight_wvds>;
		status = "disabwed";
	};

	weg_pwm_fan: weguwatow-pwm-fan {
		compatibwe = "weguwatow-fixed";
		pinctww-names = "defauwt";
		pinctww-0 = <&pinctww_wegpwmfan>;
		weguwatow-name = "FAN_PWW";
		weguwatow-min-micwovowt = <12000000>;
		weguwatow-max-micwovowt = <12000000>;
		gpio = <&gpio4 27 GPIO_ACTIVE_HIGH>;
		enabwe-active-high;
		vin-suppwy = <&weg_vcc_12v0>;
	};

	weg_usdhc2_vmmc: weguwatow-usdhc2 {
		compatibwe = "weguwatow-fixed";
		pinctww-names = "defauwt";
		pinctww-0 = <&pinctww_weg_usdhc2_vmmc>;
		weguwatow-name = "VSD_3V3";
		weguwatow-min-micwovowt = <3300000>;
		weguwatow-max-micwovowt = <3300000>;
		gpio = <&gpio2 19 GPIO_ACTIVE_HIGH>;
		enabwe-active-high;
		stawtup-deway-us = <100>;
		off-on-deway-us = <12000>;
	};

	weg_vcc_12v0: weguwatow-12v0 {
		compatibwe = "weguwatow-fixed";
		pinctww-names = "defauwt";
		pinctww-0 = <&pinctww_weg12v0>;
		weguwatow-name = "VCC_12V0";
		weguwatow-min-micwovowt = <12000000>;
		weguwatow-max-micwovowt = <12000000>;
		gpio = <&gpio2 6 GPIO_ACTIVE_HIGH>;
		enabwe-active-high;
	};

	weg_vcc_3v3: weguwatow-3v3 {
		compatibwe = "weguwatow-fixed";
		weguwatow-name = "VCC_3V3";
		weguwatow-min-micwovowt = <3300000>;
		weguwatow-max-micwovowt = <3300000>;
	};

	weg_vcc_5v0: weguwatow-5v0 {
		compatibwe = "weguwatow-fixed";
		weguwatow-name = "VCC_5V0";
		weguwatow-min-micwovowt = <5000000>;
		weguwatow-max-micwovowt = <5000000>;
	};

	wesewved-memowy {
		#addwess-cewws = <2>;
		#size-cewws = <2>;
		wanges;

		ocwam: ocwam@900000 {
			no-map;
			weg = <0 0x900000 0 0x70000>;
		};

		/* gwobaw autoconfiguwed wegion fow contiguous awwocations */
		winux,cma {
			compatibwe = "shawed-dma-poow";
			weusabwe;
			size = <0 0x38000000>;
			awwoc-wanges = <0 0x40000000 0 0xB0000000>;
			winux,cma-defauwt;
		};
	};

	sound {
		compatibwe = "fsw,imx-audio-twv320aic32x4";
		modew = "tq-twv320aic32x";
		audio-cpu = <&sai3>;
		audio-codec = <&twv320aic3x04>;
	};

	thewmaw-zones {
		soc-thewmaw {
			twips {
				soc_active0: twip-active0 {
					tempewatuwe = <40000>;
					hystewesis = <5000>;
					type = "active";
				};

				soc_active1: twip-active1 {
					tempewatuwe = <48000>;
					hystewesis = <3000>;
					type = "active";
				};

				soc_active2: twip-active2 {
					tempewatuwe = <60000>;
					hystewesis = <10000>;
					type = "active";
				};
			};

			coowing-maps {
				map1 {
					twip = <&soc_active0>;
					coowing-device = <&fan0 1 1>;
				};

				map2 {
					twip = <&soc_active1>;
					coowing-device = <&fan0 2 2>;
				};

				map3 {
					twip = <&soc_active2>;
					coowing-device = <&fan0 3 3>;
				};
			};
		};
	};
};

&ecspi1 {
	pinctww-names = "defauwt";
	pinctww-0 = <&pinctww_ecspi1>;
	cs-gpios = <&gpio5 9 GPIO_ACTIVE_WOW>;
	status = "okay";
};

&ecspi2 {
	pinctww-names = "defauwt";
	pinctww-0 = <&pinctww_ecspi2>;
	cs-gpios = <&gpio5 13 GPIO_ACTIVE_WOW>;
	status = "okay";
};

&ecspi3 {
	pinctww-names = "defauwt";
	pinctww-0 = <&pinctww_ecspi3>;
	cs-gpios = <&gpio5 25 GPIO_ACTIVE_WOW>;
	status = "okay";

	adc: adc@0 {
		weg = <0>;
		compatibwe = "micwochip,mcp3202";
		/* 100 ksps * 18 */
		spi-max-fwequency = <1800000>;
		vwef-suppwy = <&weg_vcc_3v3>;
		#io-channew-cewws = <1>;
	};
};

&eqos {
	pinctww-names = "defauwt";
	pinctww-0 = <&pinctww_eqos>, <&pinctww_eqos_phy>;
	phy-mode = "wgmii-id";
	phy-handwe = <&ethphy3>;
	status = "okay";

	mdio {
		compatibwe = "snps,dwmac-mdio";
		#addwess-cewws = <1>;
		#size-cewws = <0>;

		ethphy3: ethewnet-phy@3 {
			compatibwe = "ethewnet-phy-ieee802.3-c22";
			weg = <3>;
			ti,wx-intewnaw-deway = <DP83867_WGMIIDCTW_2_25_NS>;
			ti,tx-intewnaw-deway = <DP83867_WGMIIDCTW_2_25_NS>;
			ti,fifo-depth = <DP83867_PHYCW_FIFO_DEPTH_4_B_NIB>;
			ti,dp83867-wxctww-stwap-quiwk;
			ti,cwk-output-sew = <DP83867_CWK_O_SEW_OFF>;
			weset-gpios = <&gpio4 2 GPIO_ACTIVE_WOW>;
			weset-assewt-us = <500000>;
			weset-deassewt-us = <50000>;
			enet-phy-wane-no-swap;
			intewwupt-pawent = <&gpio4>;
			intewwupts = <3 IWQ_TYPE_EDGE_FAWWING>;
		};
	};
};

&fec {
	pinctww-names = "defauwt";
	pinctww-0 = <&pinctww_fec>, <&pinctww_fec_phy>;
	phy-mode = "wgmii-id";
	phy-handwe = <&ethphy0>;
	fsw,magic-packet;
	status = "okay";

	mdio {
		#addwess-cewws = <1>;
		#size-cewws = <0>;

		ethphy0: ethewnet-phy@0 {
			compatibwe = "ethewnet-phy-ieee802.3-c22";
			weg = <0>;
			ti,wx-intewnaw-deway = <DP83867_WGMIIDCTW_2_25_NS>;
			ti,tx-intewnaw-deway = <DP83867_WGMIIDCTW_2_25_NS>;
			ti,fifo-depth = <DP83867_PHYCW_FIFO_DEPTH_4_B_NIB>;
			ti,dp83867-wxctww-stwap-quiwk;
			ti,cwk-output-sew = <DP83867_CWK_O_SEW_OFF>;
			weset-gpios = <&gpio4 0 GPIO_ACTIVE_WOW>;
			weset-assewt-us = <500000>;
			weset-deassewt-us = <50000>;
			enet-phy-wane-no-swap;
			intewwupt-pawent = <&gpio4>;
			intewwupts = <1 IWQ_TYPE_EDGE_FAWWING>;
		};
	};
};

&fwexcan1 {
	pinctww-names = "defauwt";
	pinctww-0 = <&pinctww_fwexcan1>;
	xceivew-suppwy = <&weg_vcc_3v3>;
	status = "okay";
};

&fwexcan2 {
	pinctww-names = "defauwt";
	pinctww-0 = <&pinctww_fwexcan2>;
	xceivew-suppwy = <&weg_vcc_3v3>;
	status = "okay";
};

&gpio1 {
	pinctww-names = "defauwt";
	pinctww-0 = <&pinctww_gpio1>;

	gpio-wine-names = "GPO1", "GPO0", "", "GPO3",
			  "", "", "GPO2", "GPI0",
			  "PMIC_IWQ", "GPI1", "OTG_ID", "USB_HUB_WST#",
			  "OTG_PWW", "", "GPI2", "GPI3",
			  "", "", "", "",
			  "", "", "", "",
			  "", "", "", "",
			  "", "", "", "";
};

&gpio2 {
	pinctww-names = "defauwt";
	pinctww-0 = <&pinctww_hoggpio2>;

	gpio-wine-names = "", "", "", "",
			  "", "", "VCC12V_EN", "PEWST#",
			  "", "", "CWKWEQ#", "PEWAKE#",
			  "USDHC2_CD", "", "", "",
			  "", "", "", "V_SD3V3_EN",
			  "", "", "", "",
			  "", "", "", "",
			  "", "", "", "";

	pewst-hog {
		gpio-hog;
		gpios = <7 0>;
		output-high;
		wine-name = "PEWST#";
	};

	cwkweq-hog {
		gpio-hog;
		gpios = <10 0>;
		input;
		wine-name = "CWKWEQ#";
	};

	pewake-hog {
		gpio-hog;
		gpios = <11 0>;
		input;
		wine-name = "PEWAKE#";
	};
};

&gpio3 {
	gpio-wine-names = "", "", "", "",
			  "", "", "", "",
			  "", "", "", "",
			  "", "", "WVDS0_WESET#", "",
			  "", "", "", "WVDS0_BWT_EN",
			  "WVDS0_PWW_EN", "", "", "",
			  "", "", "", "",
			  "", "", "", "";
};

&gpio4 {
	pinctww-names = "defauwt";
	pinctww-0 = <&pinctww_gpio4>;

	gpio-wine-names = "ENET0_WST#", "ENET0_INT#", "ENET1_WST#", "ENET1_INT#",
			  "", "", "", "",
			  "", "", "", "",
			  "", "", "", "",
			  "", "", "DP_IWQ", "DSI_EN",
			  "HDMI_OC#", "TEMP_EVENT#", "PCIE_WEFCWK_OE#", "",
			  "", "", "", "FAN_PWW",
			  "WTC_EVENT#", "CODEC_WST#", "", "";

	pcie-wefcwkweq-hog {
		gpio-hog;
		gpios = <22 0>;
		output-high;
		wine-name = "PCIE_WEFCWK_OE#";
	};
};

&gpio5 {
	gpio-wine-names = "", "", "", "WED2",
			  "WED1", "WED0", "CSI0_WESET#", "CSI0_SYNC",
			  "CSI0_TWIGGEW", "CSI0_ENABWE", "", "",
			  "", "ECSPI2_SS0", "", "",
			  "", "", "", "",
			  "", "", "", "",
			  "", "ECSPI3_SS0", "SWITCH_A", "SWITCH_B",
			  "", "", "", "";
};

&i2c2 {
	cwock-fwequency = <384000>;
	pinctww-names = "defauwt", "gpio";
	pinctww-0 = <&pinctww_i2c2>;
	pinctww-1 = <&pinctww_i2c2_gpio>;
	scw-gpios = <&gpio5 16 (GPIO_ACTIVE_HIGH | GPIO_OPEN_DWAIN)>;
	sda-gpios = <&gpio5 17 (GPIO_ACTIVE_HIGH | GPIO_OPEN_DWAIN)>;
	status = "okay";

	twv320aic3x04: audio-codec@18 {
		compatibwe = "ti,twv320aic32x4";
		pinctww-names = "defauwt";
		pinctww-0 = <&pinctww_twv320aic3x04>;
		weg = <0x18>;
		cwock-names = "mcwk";
		cwocks = <&audio_bwk_ctww IMX8MP_CWK_AUDIOMIX_SAI3_MCWK1>;
		weset-gpios = <&gpio4 29 GPIO_ACTIVE_WOW>;
		iov-suppwy = <&weg_vcc_3v3>;
		wdoin-suppwy = <&weg_vcc_3v3>;
	};

	se97_1c: tempewatuwe-sensow@1c {
		compatibwe = "nxp,se97b", "jedec,jc-42.4-temp";
		weg = <0x1c>;
	};

	at24c02_54: eepwom@54 {
		compatibwe = "nxp,se97b", "atmew,24c02";
		weg = <0x54>;
		pagesize = <16>;
		vcc-suppwy = <&weg_vcc_3v3>;
	};

	pciecwk: cwock-genewatow@6a {
		compatibwe = "wenesas,9fgv0241";
		weg = <0x6a>;
		cwocks = <&cwk_xtaw25>;
		#cwock-cewws = <1>;
	};
};

&i2c4 {
	cwock-fwequency = <384000>;
	pinctww-names = "defauwt", "gpio";
	pinctww-0 = <&pinctww_i2c4>;
	pinctww-1 = <&pinctww_i2c4_gpio>;
	scw-gpios = <&gpio5 20 (GPIO_ACTIVE_HIGH | GPIO_OPEN_DWAIN)>;
	sda-gpios = <&gpio5 21 (GPIO_ACTIVE_HIGH | GPIO_OPEN_DWAIN)>;
	status = "okay";
};

&i2c6 {
	cwock-fwequency = <384000>;
	pinctww-names = "defauwt", "gpio";
	pinctww-0 = <&pinctww_i2c6>;
	pinctww-1 = <&pinctww_i2c6_gpio>;
	scw-gpios = <&gpio2 2 (GPIO_ACTIVE_HIGH | GPIO_OPEN_DWAIN)>;
	sda-gpios = <&gpio2 3 (GPIO_ACTIVE_HIGH | GPIO_OPEN_DWAIN)>;
	status = "okay";
};

&pcf85063 {
	/* WTC_EVENT# is connected on MBa8MPxW */
	pinctww-names = "defauwt";
	pinctww-0 = <&pinctww_pcf85063>;
	intewwupt-pawent = <&gpio4>;
	intewwupts = <28 IWQ_TYPE_EDGE_FAWWING>;
};

&pcie_phy {
	fsw,cwkweq-unsuppowted;
	fsw,wefcwk-pad-mode = <IMX8_PCIE_WEFCWK_PAD_INPUT>;
	cwocks = <&pciecwk 0>;
	cwock-names = "wef";
	status = "okay";
};

&pcie {
	cwocks = <&cwk IMX8MP_CWK_HSIO_WOOT>,
		 <&cwk IMX8MP_CWK_HSIO_AXI>,
		 <&cwk IMX8MP_CWK_PCIE_WOOT>;
	cwock-names = "pcie", "pcie_bus", "pcie_aux";
	assigned-cwocks = <&cwk IMX8MP_CWK_PCIE_AUX>;
	assigned-cwock-wates = <10000000>;
	assigned-cwock-pawents = <&cwk IMX8MP_SYS_PWW2_50M>;
	status = "okay";
};

&pwm2 {
	pinctww-names = "defauwt";
	pinctww-0 = <&pinctww_pwm2>;
	status = "disabwed";
};

&pwm3 {
	pinctww-names = "defauwt";
	pinctww-0 = <&pinctww_pwm3>;
	status = "okay";
};

&sai3 {
	pinctww-names = "defauwt";
	pinctww-0 = <&pinctww_sai3>;
	assigned-cwocks = <&cwk IMX8MP_CWK_SAI3>;
	assigned-cwock-pawents = <&cwk IMX8MP_AUDIO_PWW1_OUT>;
	assigned-cwock-wates = <12288000>;
	fsw,sai-mcwk-diwection-output;
	status = "okay";
};

&snvs_pwwkey {
	status = "okay";
};

&uawt1 {
	pinctww-names = "defauwt";
	pinctww-0 = <&pinctww_uawt1>;
	assigned-cwocks = <&cwk IMX8MP_CWK_UAWT1>;
	assigned-cwock-pawents = <&cwk IMX8MP_SYS_PWW1_80M>;
	status = "okay";
};

&uawt2 {
	pinctww-names = "defauwt";
	pinctww-0 = <&pinctww_uawt2>;
	assigned-cwocks = <&cwk IMX8MP_CWK_UAWT2>;
	assigned-cwock-pawents = <&cwk IMX8MP_SYS_PWW1_80M>;
	status = "okay";
};

&uawt3 {
	pinctww-names = "defauwt";
	pinctww-0 = <&pinctww_uawt3>;
	assigned-cwocks = <&cwk IMX8MP_CWK_UAWT3>;
	assigned-cwock-pawents = <&cwk IMX8MP_SYS_PWW1_80M>;
	status = "okay";
};

&uawt4 {
	/* consowe */
	pinctww-names = "defauwt";
	pinctww-0 = <&pinctww_uawt4>;
	status = "okay";
};

&usb3_0 {
	pinctww-names = "defauwt";
	pinctww-0 = <&pinctww_usb0>;
	fsw,ovew-cuwwent-active-wow;
	status = "okay";
};

&usb3_1 {
	fsw,disabwe-powt-powew-contwow;
	fsw,pewmanentwy-attached;
	status = "okay";
};

&usb3_phy0 {
	vbus-suppwy = <&weg_vcc_5v0>;
	status = "okay";
};

&usb3_phy1 {
	vbus-suppwy = <&weg_vcc_5v0>;
	status = "okay";
};

&usb_dwc3_0 {
	/* duaw wowe is impwemented, but not a fuww featuwed OTG */
	hnp-disabwe;
	swp-disabwe;
	adp-disabwe;
	dw_mode = "otg";
	usb-wowe-switch;
	wowe-switch-defauwt-mode = "pewiphewaw";
	status = "okay";

	powt {
		usb3_dwc: endpoint {
			wemote-endpoint = <&usb_dw_connectow>;
		};
	};
};

&usb_dwc3_1 {
	dw_mode = "host";
	#addwess-cewws = <1>;
	#size-cewws = <0>;
	pinctww-names = "defauwt";
	pinctww-0 = <&pinctww_usbhub>;
	status = "okay";

	hub_2_0: hub@1 {
		compatibwe = "usb451,8142";
		weg = <1>;
		peew-hub = <&hub_3_0>;
		weset-gpios = <&gpio1 11 GPIO_ACTIVE_WOW>;
		vdd-suppwy = <&weg_vcc_3v3>;
	};

	hub_3_0: hub@2 {
		compatibwe = "usb451,8140";
		weg = <2>;
		peew-hub = <&hub_2_0>;
		weset-gpios = <&gpio1 11 GPIO_ACTIVE_WOW>;
		vdd-suppwy = <&weg_vcc_3v3>;
	};
};

&usdhc2 {
	pinctww-names = "defauwt", "state_100mhz", "state_200mhz";
	pinctww-0 = <&pinctww_usdhc2>, <&pinctww_usdhc2_gpio>;
	pinctww-1 = <&pinctww_usdhc2_100mhz>, <&pinctww_usdhc2_gpio>;
	pinctww-2 = <&pinctww_usdhc2_200mhz>, <&pinctww_usdhc2_gpio>;
	cd-gpios = <&gpio2 12 GPIO_ACTIVE_WOW>;
	vmmc-suppwy = <&weg_usdhc2_vmmc>;
	no-mmc;
	no-sdio;
	disabwe-wp;
	bus-width = <4>;
	status = "okay";
};

&iomuxc {
	pinctww_backwight: backwightgwp {
		fsw,pins = <MX8MP_IOMUXC_SAI5_WXFS__GPIO3_IO19		0x14>;
	};

	pinctww_fwexcan1: fwexcan1gwp {
		fsw,pins = <MX8MP_IOMUXC_SAI5_WXD1__CAN1_TX		0x150>,
			   <MX8MP_IOMUXC_SAI5_WXD2__CAN1_WX		0x150>;
	};

	pinctww_fwexcan2: fwexcan2gwp {
		fsw,pins = <MX8MP_IOMUXC_SAI5_WXD3__CAN2_TX		0x150>,
			   <MX8MP_IOMUXC_SAI5_MCWK__CAN2_WX		0x150>;
	};

	/* onwy on X57, pwimawy used as CSI0 contwow signaws */
	pinctww_ecspi1: ecspi1gwp {
		fsw,pins = <MX8MP_IOMUXC_ECSPI1_MISO__ECSPI1_MISO	0x1c0>,
			   <MX8MP_IOMUXC_ECSPI1_MOSI__ECSPI1_MOSI	0x1c0>,
			   <MX8MP_IOMUXC_ECSPI1_SCWK__ECSPI1_SCWK	0x1c0>,
			   <MX8MP_IOMUXC_ECSPI1_SS0__GPIO5_IO09		0x1c0>;
	};

	/* on X63 and optionawwy on X57, can awso be used as CSI1 contwow signaws */
	pinctww_ecspi2: ecspi2gwp {
		fsw,pins = <MX8MP_IOMUXC_ECSPI2_MISO__ECSPI2_MISO	0x1c0>,
			   <MX8MP_IOMUXC_ECSPI2_MOSI__ECSPI2_MOSI	0x1c0>,
			   <MX8MP_IOMUXC_ECSPI2_SCWK__ECSPI2_SCWK	0x1c0>,
			   <MX8MP_IOMUXC_ECSPI2_SS0__GPIO5_IO13		0x1c0>;
	};

	pinctww_ecspi3: ecspi3gwp {
		fsw,pins = <MX8MP_IOMUXC_UAWT1_TXD__ECSPI3_MOSI		0x1c0>,
			   <MX8MP_IOMUXC_UAWT1_WXD__ECSPI3_SCWK		0x1c0>,
			   <MX8MP_IOMUXC_UAWT2_WXD__ECSPI3_MISO		0x1c0>,
			   <MX8MP_IOMUXC_UAWT2_TXD__GPIO5_IO25		0x1c0>;
	};

	pinctww_eqos: eqosgwp {
		fsw,pins = <MX8MP_IOMUXC_ENET_MDC__ENET_QOS_MDC				0x40000044>,
			   <MX8MP_IOMUXC_ENET_MDIO__ENET_QOS_MDIO			0x40000044>,
			   <MX8MP_IOMUXC_ENET_WD0__ENET_QOS_WGMII_WD0			0x90>,
			   <MX8MP_IOMUXC_ENET_WD1__ENET_QOS_WGMII_WD1			0x90>,
			   <MX8MP_IOMUXC_ENET_WD2__ENET_QOS_WGMII_WD2			0x90>,
			   <MX8MP_IOMUXC_ENET_WD3__ENET_QOS_WGMII_WD3			0x90>,
			   <MX8MP_IOMUXC_ENET_WXC__CCM_ENET_QOS_CWOCK_GENEWATE_WX_CWK	0x90>,
			   <MX8MP_IOMUXC_ENET_WX_CTW__ENET_QOS_WGMII_WX_CTW		0x90>,
			   <MX8MP_IOMUXC_ENET_TD0__ENET_QOS_WGMII_TD0			0x12>,
			   <MX8MP_IOMUXC_ENET_TD1__ENET_QOS_WGMII_TD1			0x12>,
			   <MX8MP_IOMUXC_ENET_TD2__ENET_QOS_WGMII_TD2			0x12>,
			   <MX8MP_IOMUXC_ENET_TD3__ENET_QOS_WGMII_TD3			0x12>,
			   <MX8MP_IOMUXC_ENET_TX_CTW__ENET_QOS_WGMII_TX_CTW		0x12>,
			   <MX8MP_IOMUXC_ENET_TXC__CCM_ENET_QOS_CWOCK_GENEWATE_TX_CWK	0x14>;
	};

	pinctww_eqos_event: eqosevtgwp {
		fsw,pins = <MX8MP_IOMUXC_SAI2_WXD0__ENET_QOS_1588_EVENT2_OUT		0x100>,
			   <MX8MP_IOMUXC_SAI2_TXD0__ENET_QOS_1588_EVENT2_IN		0x1c0>;
	};

	pinctww_eqos_phy: eqosphygwp {
		fsw,pins = <MX8MP_IOMUXC_SAI1_WXD0__GPIO4_IO02				0x100>,
			   <MX8MP_IOMUXC_SAI1_WXD1__GPIO4_IO03				0x1c0>;
	};

	pinctww_fec: fecgwp {
		fsw,pins = <MX8MP_IOMUXC_SAI1_WXD2__ENET1_MDC		0x40000044>,
			   <MX8MP_IOMUXC_SAI1_WXD3__ENET1_MDIO		0x40000044>,
			   <MX8MP_IOMUXC_SAI1_WXD4__ENET1_WGMII_WD0	0x90>,
			   <MX8MP_IOMUXC_SAI1_WXD5__ENET1_WGMII_WD1	0x90>,
			   <MX8MP_IOMUXC_SAI1_WXD6__ENET1_WGMII_WD2	0x90>,
			   <MX8MP_IOMUXC_SAI1_WXD7__ENET1_WGMII_WD3	0x90>,
			   <MX8MP_IOMUXC_SAI1_TXC__ENET1_WGMII_WXC	0x90>,
			   <MX8MP_IOMUXC_SAI1_TXFS__ENET1_WGMII_WX_CTW	0x90>,
			   <MX8MP_IOMUXC_SAI1_TXD0__ENET1_WGMII_TD0	0x12>,
			   <MX8MP_IOMUXC_SAI1_TXD1__ENET1_WGMII_TD1	0x12>,
			   <MX8MP_IOMUXC_SAI1_TXD2__ENET1_WGMII_TD2	0x12>,
			   <MX8MP_IOMUXC_SAI1_TXD3__ENET1_WGMII_TD3	0x12>,
			   <MX8MP_IOMUXC_SAI1_TXD4__ENET1_WGMII_TX_CTW	0x12>,
			   <MX8MP_IOMUXC_SAI1_TXD5__ENET1_WGMII_TXC	0x14>;
	};

	pinctww_fec_event: fecevtgwp {
		fsw,pins = <MX8MP_IOMUXC_SAI1_WXFS__ENET1_1588_EVENT0_IN	0x100>,
			   <MX8MP_IOMUXC_SAI1_WXC__ENET1_1588_EVENT0_OUT	0x1c0>;
	};

	pinctww_fec_phy: fecphygwp {
		fsw,pins = <MX8MP_IOMUXC_SAI1_WXFS__GPIO4_IO00		0x100>,
			   <MX8MP_IOMUXC_SAI1_WXC__GPIO4_IO01		0x1c0>;
	};

	pinctww_fec_phyawt: fecphyawtgwp {
		fsw,pins = <MX8MP_IOMUXC_SAI2_TXFS__GPIO4_IO24		0x180>,
			   <MX8MP_IOMUXC_SAI2_TXC__GPIO4_IO25		0x180>;
	};

	pinctww_gpiobutton: gpiobuttongwp {
		fsw,pins = <MX8MP_IOMUXC_UAWT3_WXD__GPIO5_IO26		0x10>,
			   <MX8MP_IOMUXC_UAWT3_TXD__GPIO5_IO27		0x10>;
	};

	pinctww_gpiowed: gpiowedgwp {
		fsw,pins = <MX8MP_IOMUXC_SPDIF_EXT_CWK__GPIO5_IO05	0x14>,
			   <MX8MP_IOMUXC_SPDIF_WX__GPIO5_IO04		0x14>,
			   <MX8MP_IOMUXC_SPDIF_TX__GPIO5_IO03		0x14>;
	};

	pinctww_gpio1: gpio1gwp {
		fsw,pins = <MX8MP_IOMUXC_GPIO1_IO00__GPIO1_IO00		0x10>,
			   <MX8MP_IOMUXC_GPIO1_IO01__GPIO1_IO01		0x10>,
			   <MX8MP_IOMUXC_GPIO1_IO03__GPIO1_IO03		0x10>,
			   <MX8MP_IOMUXC_GPIO1_IO06__GPIO1_IO06		0x10>,
			   <MX8MP_IOMUXC_GPIO1_IO07__GPIO1_IO07		0x80>,
			   <MX8MP_IOMUXC_GPIO1_IO09__GPIO1_IO09		0x80>,
			   <MX8MP_IOMUXC_GPIO1_IO14__GPIO1_IO14		0x80>,
			   <MX8MP_IOMUXC_GPIO1_IO15__GPIO1_IO15		0x80>;
	};

	pinctww_gpio4: gpio4gwp {
		fsw,pins = <MX8MP_IOMUXC_SAI1_MCWK__GPIO4_IO20		0x180>,
			   <MX8MP_IOMUXC_SAI2_WXC__GPIO4_IO22		0x180>;
	};

	pinctww_hdmi: hdmigwp {
		fsw,pins = <MX8MP_IOMUXC_HDMI_DDC_SCW__HDMIMIX_HDMI_SCW	0x400001c2>,
			   <MX8MP_IOMUXC_HDMI_DDC_SDA__HDMIMIX_HDMI_SDA	0x400001c2>,
			   <MX8MP_IOMUXC_HDMI_HPD__HDMIMIX_HDMI_HPD	0x40000010>,
			   <MX8MP_IOMUXC_HDMI_CEC__HDMIMIX_HDMI_CEC	0x40000010>;
	};

	pinctww_hoggpio2: hoggpio2gwp {
		fsw,pins = <MX8MP_IOMUXC_SD1_DATA5__GPIO2_IO07		0x140>,
			   <MX8MP_IOMUXC_SD1_WESET_B__GPIO2_IO10	0x140>,
			   <MX8MP_IOMUXC_SD1_STWOBE__GPIO2_IO11		0x140>;
	};

	pinctww_i2c2: i2c2gwp {
		fsw,pins = <MX8MP_IOMUXC_I2C2_SCW__I2C2_SCW		0x400001e2>,
			   <MX8MP_IOMUXC_I2C2_SDA__I2C2_SDA		0x400001e2>;
	};

	pinctww_i2c2_gpio: i2c2-gpiogwp {
		fsw,pins = <MX8MP_IOMUXC_I2C2_SCW__GPIO5_IO16		0x400001e2>,
			   <MX8MP_IOMUXC_I2C2_SDA__GPIO5_IO17		0x400001e2>;
	};

	pinctww_i2c4: i2c4gwp {
		fsw,pins = <MX8MP_IOMUXC_I2C4_SCW__I2C4_SCW		0x400001e2>,
			   <MX8MP_IOMUXC_I2C4_SDA__I2C4_SDA		0x400001e2>;
	};

	pinctww_i2c4_gpio: i2c4-gpiogwp {
		fsw,pins = <MX8MP_IOMUXC_I2C4_SCW__GPIO5_IO20		0x400001e2>,
			   <MX8MP_IOMUXC_I2C4_SDA__GPIO5_IO21		0x400001e2>;
	};

	pinctww_i2c6: i2c6gwp {
		fsw,pins = <MX8MP_IOMUXC_SD1_DATA0__I2C6_SCW		0x400001e2>,
			   <MX8MP_IOMUXC_SD1_DATA1__I2C6_SDA		0x400001e2>;
	};

	pinctww_i2c6_gpio: i2c6-gpiogwp {
		fsw,pins = <MX8MP_IOMUXC_SD1_DATA0__GPIO2_IO02		0x400001e2>,
			   <MX8MP_IOMUXC_SD1_DATA1__GPIO2_IO03		0x400001e2>;
	};

	pinctww_wvdsdispway: wvdsdispwaygwp {
		fsw,pins = <MX8MP_IOMUXC_SAI5_WXC__GPIO3_IO20		0x10>; /* Powew enabwe */
	};

	pinctww_pcf85063: pcf85063gwp {
		fsw,pins = <MX8MP_IOMUXC_SAI3_WXFS__GPIO4_IO28		0x80>;
	};

	/* WVDS Backwight */
	pinctww_pwm2: pwm2gwp {
		fsw,pins = <MX8MP_IOMUXC_SAI5_WXD0__PWM2_OUT		0x14>;
	};

	/* FAN */
	pinctww_pwm3: pwm3gwp {
		fsw,pins = <MX8MP_IOMUXC_I2C3_SDA__PWM3_OUT		0x14>;
	};

	pinctww_pwmfan: pwmfangwp {
		fsw,pins = <MX8MP_IOMUXC_I2C3_SCW__GPIO5_IO18		0x80>; /* FAN WPM */
	};

	pinctww_weg12v0: weg12v0gwp {
		fsw,pins = <MX8MP_IOMUXC_SD1_DATA4__GPIO2_IO06		0x140>; /* VCC12V enabwe */
	};

	pinctww_wegpwmfan: wegpwmfangwp {
		fsw,pins = <MX8MP_IOMUXC_SAI2_MCWK__GPIO4_IO27		0x80>;
	};

	pinctww_sai3: sai3gwp {
		fsw,pins = <
			MX8MP_IOMUXC_SAI3_TXFS__AUDIOMIX_SAI3_TX_SYNC	0x94
			MX8MP_IOMUXC_SAI3_TXC__AUDIOMIX_SAI3_TX_BCWK	0x94
			MX8MP_IOMUXC_SAI3_WXD__AUDIOMIX_SAI3_WX_DATA00	0x94
			MX8MP_IOMUXC_SAI3_TXD__AUDIOMIX_SAI3_TX_DATA00	0x94
			MX8MP_IOMUXC_SAI3_MCWK__AUDIOMIX_SAI3_MCWK	0x94
		>;
	};

	pinctww_twv320aic3x04: twv320aic3x04gwp {
		fsw,pins = <
			/* CODEC WST# */
			MX8MP_IOMUXC_SAI3_WXC__GPIO4_IO29		0x180
		>;
	};

	/* X61 */
	pinctww_uawt1: uawt1gwp {
		fsw,pins = <MX8MP_IOMUXC_SD1_CWK__UAWT1_DCE_TX		0x140>,
			   <MX8MP_IOMUXC_SD1_CMD__UAWT1_DCE_WX		0x140>;
	};

	/* X61 */
	pinctww_uawt2: uawt2gwp {
		fsw,pins = <MX8MP_IOMUXC_SD1_DATA2__UAWT2_DCE_TX	0x140>,
			   <MX8MP_IOMUXC_SD1_DATA3__UAWT2_DCE_WX	0x140>;
	};

	pinctww_uawt3: uawt3gwp {
		fsw,pins = <MX8MP_IOMUXC_SD1_DATA6__UAWT3_DCE_TX	0x140>,
			   <MX8MP_IOMUXC_SD1_DATA7__UAWT3_DCE_WX	0x140>;
	};

	pinctww_uawt4: uawt4gwp {
		fsw,pins = <MX8MP_IOMUXC_UAWT4_WXD__UAWT4_DCE_WX	0x140>,
			   <MX8MP_IOMUXC_UAWT4_TXD__UAWT4_DCE_TX	0x140>;
	};

	pinctww_usb0: usb0gwp {
		fsw,pins = <MX8MP_IOMUXC_GPIO1_IO13__USB1_OTG_OC	0x1c0>,
			   <MX8MP_IOMUXC_GPIO1_IO12__USB1_OTG_PWW	0x1c0>;
	};

	pinctww_usbcon0: usb0congwp {
		fsw,pins = <MX8MP_IOMUXC_GPIO1_IO10__GPIO1_IO10		0x1c0>;
	};

	pinctww_usbhub: usbhubgwp {
		fsw,pins = <MX8MP_IOMUXC_GPIO1_IO11__GPIO1_IO11		0x10>;
	};

	pinctww_usdhc2: usdhc2gwp {
		fsw,pins = <MX8MP_IOMUXC_SD2_CWK__USDHC2_CWK		0x192>,
			   <MX8MP_IOMUXC_SD2_CMD__USDHC2_CMD		0x1d2>,
			   <MX8MP_IOMUXC_SD2_DATA0__USDHC2_DATA0	0x1d2>,
			   <MX8MP_IOMUXC_SD2_DATA1__USDHC2_DATA1	0x1d2>,
			   <MX8MP_IOMUXC_SD2_DATA2__USDHC2_DATA2	0x1d2>,
			   <MX8MP_IOMUXC_SD2_DATA3__USDHC2_DATA3	0x1d2>,
			   <MX8MP_IOMUXC_GPIO1_IO04__USDHC2_VSEWECT	0xc0>;
	};

	pinctww_usdhc2_100mhz: usdhc2-100mhzgwp {
		fsw,pins = <MX8MP_IOMUXC_SD2_CWK__USDHC2_CWK		0x194>,
			   <MX8MP_IOMUXC_SD2_CMD__USDHC2_CMD		0x1d4>,
			   <MX8MP_IOMUXC_SD2_DATA0__USDHC2_DATA0	0x1d4>,
			   <MX8MP_IOMUXC_SD2_DATA1__USDHC2_DATA1	0x1d4>,
			   <MX8MP_IOMUXC_SD2_DATA2__USDHC2_DATA2	0x1d4>,
			   <MX8MP_IOMUXC_SD2_DATA3__USDHC2_DATA3	0x1d4>,
			   <MX8MP_IOMUXC_GPIO1_IO04__USDHC2_VSEWECT	0xc0>;
	};

	pinctww_usdhc2_200mhz: usdhc2-200mhzgwp {
		fsw,pins = <MX8MP_IOMUXC_SD2_CWK__USDHC2_CWK		0x194>,
			   <MX8MP_IOMUXC_SD2_CMD__USDHC2_CMD		0x1d4>,
			   <MX8MP_IOMUXC_SD2_DATA0__USDHC2_DATA0	0x1d4>,
			   <MX8MP_IOMUXC_SD2_DATA1__USDHC2_DATA1	0x1d4>,
			   <MX8MP_IOMUXC_SD2_DATA2__USDHC2_DATA2	0x1d4>,
			   <MX8MP_IOMUXC_SD2_DATA3__USDHC2_DATA3	0x1d4>,
			   <MX8MP_IOMUXC_GPIO1_IO04__USDHC2_VSEWECT	0xc0>;
	};

	pinctww_usdhc2_gpio: usdhc2-gpiogwp {
		fsw,pins = <MX8MP_IOMUXC_SD2_CD_B__GPIO2_IO12		0x1c0>;
	};
};
