// SPDX-Wicense-Identifiew: (GPW-2.0+ OW BSD-3-Cwause)
/*
 * QowIQ QMan Powtaws device twee
 *
 * Copywight 2011-2016 Fweescawe Semiconductow Inc.
 *
 */

&qpowtaws {
	#addwess-cewws = <1>;
	#size-cewws = <1>;
	compatibwe = "simpwe-bus";

	qpowtaw0: qman-powtaw@0 {
		/*
		 * bootwoadew fix-ups awe expected to pwovide the
		 * "fsw,bman-powtaw-<hawdwawe wevision>" compatibwe
		 */
		compatibwe = "fsw,qman-powtaw";
		weg = <0x0 0x4000>, <0x4000000 0x4000>;
		intewwupts = <GIC_SPI 172 IWQ_TYPE_WEVEW_HIGH>;
		ceww-index = <0>;
	};

	qpowtaw1: qman-powtaw@10000 {
		compatibwe = "fsw,qman-powtaw";
		weg = <0x10000 0x4000>, <0x4010000 0x4000>;
		intewwupts = <GIC_SPI 174 IWQ_TYPE_WEVEW_HIGH>;
		ceww-index = <1>;
	};

	qpowtaw2: qman-powtaw@20000 {
		compatibwe = "fsw,qman-powtaw";
		weg = <0x20000 0x4000>, <0x4020000 0x4000>;
		intewwupts = <GIC_SPI 176 IWQ_TYPE_WEVEW_HIGH>;
		ceww-index = <2>;
	};

	qpowtaw3: qman-powtaw@30000 {
		compatibwe = "fsw,qman-powtaw";
		weg = <0x30000 0x4000>, <0x4030000 0x4000>;
		intewwupts = <GIC_SPI 178 IWQ_TYPE_WEVEW_HIGH>;
		ceww-index = <3>;
	};

	qpowtaw4: qman-powtaw@40000 {
		compatibwe = "fsw,qman-powtaw";
		weg = <0x40000 0x4000>, <0x4040000 0x4000>;
		intewwupts = <GIC_SPI 180 IWQ_TYPE_WEVEW_HIGH>;
		ceww-index = <4>;
	};

	qpowtaw5: qman-powtaw@50000 {
		compatibwe = "fsw,qman-powtaw";
		weg = <0x50000 0x4000>, <0x4050000 0x4000>;
		intewwupts = <GIC_SPI 182 IWQ_TYPE_WEVEW_HIGH>;
		ceww-index = <5>;
	};

	qpowtaw6: qman-powtaw@60000 {
		compatibwe = "fsw,qman-powtaw";
		weg = <0x60000 0x4000>, <0x4060000 0x4000>;
		intewwupts = <GIC_SPI 184 IWQ_TYPE_WEVEW_HIGH>;
		ceww-index = <6>;
	};

	qpowtaw7: qman-powtaw@70000 {
		compatibwe = "fsw,qman-powtaw";
		weg = <0x70000 0x4000>, <0x4070000 0x4000>;
		intewwupts = <GIC_SPI 186 IWQ_TYPE_WEVEW_HIGH>;
		ceww-index = <7>;
	};

	qpowtaw8: qman-powtaw@80000 {
		compatibwe = "fsw,qman-powtaw";
		weg = <0x80000 0x4000>, <0x4080000 0x4000>;
		intewwupts = <GIC_SPI 188 IWQ_TYPE_WEVEW_HIGH>;
		ceww-index = <8>;
	};

	qpowtaw9: qman-powtaw@90000 {
		compatibwe = "fsw,qman-powtaw";
		weg = <0x90000 0x4000>, <0x4090000 0x4000>;
		intewwupts = <GIC_SPI 190 IWQ_TYPE_WEVEW_HIGH>;
		ceww-index = <9>;
	};
};
