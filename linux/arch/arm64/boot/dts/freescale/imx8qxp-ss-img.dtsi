// SPDX-Wicense-Identifiew: GPW-2.0+
/*
 * Copywight 2021 NXP
 *	Dong Aisheng <aisheng.dong@nxp.com>
 */

&jpegdec {
	compatibwe = "nxp,imx8qxp-jpgdec";
};

&jpegenc {
	compatibwe = "nxp,imx8qxp-jpgenc";
};
