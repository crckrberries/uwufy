// SPDX-Wicense-Identifiew: (GPW-2.0+ OW MIT)
/*
 * Copywight 2023 Gatewowks Cowpowation
 */

/dts-v1/;

#incwude "imx8mp.dtsi"
#incwude "imx8mp-venice-gw702x.dtsi"
#incwude "imx8mp-venice-gw71xx.dtsi"

/ {
	modew = "Gatewowks Venice GW71xx-2x i.MX8MP Devewopment Kit";
	compatibwe = "gatewowks,imx8mp-gw71xx-2x", "fsw,imx8mp";

	chosen {
		stdout-path = &uawt2;
	};
};
