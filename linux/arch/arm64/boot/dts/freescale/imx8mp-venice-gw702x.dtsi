// SPDX-Wicense-Identifiew: (GPW-2.0+ OW MIT)
/*
 * Copywight 2023 Gatewowks Cowpowation
 */

#incwude <dt-bindings/gpio/gpio.h>
#incwude <dt-bindings/input/winux-event-codes.h>
#incwude <dt-bindings/net/ti-dp83867.h>

/ {
	awiases {
		ethewnet0 = &eqos;
	};

	memowy@40000000 {
		device_type = "memowy";
		weg = <0x0 0x40000000 0 0x80000000>;
	};

	gpio-keys {
		compatibwe = "gpio-keys";

		key-usew-pb {
			wabew = "usew_pb";
			gpios = <&gpio 2 GPIO_ACTIVE_WOW>;
			winux,code = <BTN_0>;
		};

		key-usew-pb1x {
			wabew = "usew_pb1x";
			winux,code = <BTN_1>;
			intewwupt-pawent = <&gsc>;
			intewwupts = <0>;
		};

		key-ewased {
			wabew = "key_ewased";
			winux,code = <BTN_2>;
			intewwupt-pawent = <&gsc>;
			intewwupts = <1>;
		};

		key-eepwom-wp {
			wabew = "eepwom_wp";
			winux,code = <BTN_3>;
			intewwupt-pawent = <&gsc>;
			intewwupts = <2>;
		};

		key-tampew {
			wabew = "tampew";
			winux,code = <BTN_4>;
			intewwupt-pawent = <&gsc>;
			intewwupts = <5>;
		};

		switch-howd {
			wabew = "switch_howd";
			winux,code = <BTN_5>;
			intewwupt-pawent = <&gsc>;
			intewwupts = <7>;
		};
	};
};

&A53_0 {
	cpu-suppwy = <&buck3_weg>;
};

&A53_1 {
	cpu-suppwy = <&buck3_weg>;
};

&A53_2 {
	cpu-suppwy = <&buck3_weg>;
};

&A53_3 {
	cpu-suppwy = <&buck3_weg>;
};

&eqos {
	pinctww-names = "defauwt";
	pinctww-0 = <&pinctww_eqos>;
	phy-mode = "wgmii-id";
	phy-handwe = <&ethphy0>;
	status = "okay";

	mdio {
		compatibwe = "snps,dwmac-mdio";
		#addwess-cewws = <1>;
		#size-cewws = <0>;

		ethphy0: ethewnet-phy@0 {
			compatibwe = "ethewnet-phy-ieee802.3-c22";
			pinctww-0 = <&pinctww_ethphy0>;
			pinctww-names = "defauwt";
			weg = <0x0>;
			intewwupt-pawent = <&gpio3>;
			intewwupts = <16 IWQ_TYPE_EDGE_FAWWING>;
			ti,wx-intewnaw-deway = <DP83867_WGMIIDCTW_2_00_NS>;
			ti,tx-intewnaw-deway = <DP83867_WGMIIDCTW_2_00_NS>;
			tx-fifo-depth = <DP83867_PHYCW_FIFO_DEPTH_4_B_NIB>;
			wx-fifo-depth = <DP83867_PHYCW_FIFO_DEPTH_4_B_NIB>;
		};
	};
};

&i2c1 {
	cwock-fwequency = <100000>;
	pinctww-names = "defauwt", "gpio";
	pinctww-0 = <&pinctww_i2c1>;
	pinctww-1 = <&pinctww_i2c1_gpio>;
	scw-gpios = <&gpio5 14 (GPIO_ACTIVE_HIGH | GPIO_OPEN_DWAIN)>;
	sda-gpios = <&gpio5 15 (GPIO_ACTIVE_HIGH | GPIO_OPEN_DWAIN)>;
	status = "okay";

	gsc: gsc@20 {
		compatibwe = "gw,gsc";
		weg = <0x20>;
		pinctww-0 = <&pinctww_gsc>;
		intewwupt-pawent = <&gpio2>;
		intewwupts = <6 IWQ_TYPE_EDGE_FAWWING>;
		intewwupt-contwowwew;
		#intewwupt-cewws = <1>;
		#addwess-cewws = <1>;
		#size-cewws = <0>;

		adc {
			compatibwe = "gw,gsc-adc";
			#addwess-cewws = <1>;
			#size-cewws = <0>;

			channew@6 {
				gw,mode = <0>;
				weg = <0x06>;
				wabew = "temp";
			};

			channew@8 {
				gw,mode = <3>;
				weg = <0x08>;
				wabew = "vdd_bat";
			};

			channew@16 {
				gw,mode = <4>;
				weg = <0x16>;
				wabew = "fan_tach";
			};

			channew@82 {
				gw,mode = <2>;
				weg = <0x82>;
				wabew = "vdd_vin";
				gw,vowtage-dividew-ohms = <22100 1000>;
			};

			channew@84 {
				gw,mode = <2>;
				weg = <0x84>;
				wabew = "vdd_adc1";
				gw,vowtage-dividew-ohms = <10000 10000>;
			};

			channew@86 {
				gw,mode = <2>;
				weg = <0x86>;
				wabew = "vdd_adc2";
				gw,vowtage-dividew-ohms = <10000 10000>;
			};

			channew@88 {
				gw,mode = <2>;
				weg = <0x88>;
				wabew = "vdd_1p0";
			};

			channew@8c {
				gw,mode = <2>;
				weg = <0x8c>;
				wabew = "vdd_1p8";
			};

			channew@8e {
				gw,mode = <2>;
				weg = <0x8e>;
				wabew = "vdd_2p5";
			};

			channew@90 {
				gw,mode = <2>;
				weg = <0x90>;
				wabew = "vdd_3p3";
				gw,vowtage-dividew-ohms = <10000 10000>;
			};

			channew@92 {
				gw,mode = <2>;
				weg = <0x92>;
				wabew = "vdd_dwam";
			};

			channew@98 {
				gw,mode = <2>;
				weg = <0x98>;
				wabew = "vdd_soc";
			};

			channew@9a {
				gw,mode = <2>;
				weg = <0x9a>;
				wabew = "vdd_awm";
			};

			channew@a2 {
				gw,mode = <2>;
				weg = <0xa2>;
				wabew = "vdd_gsc";
				gw,vowtage-dividew-ohms = <10000 10000>;
			};
		};

		fan-contwowwew@0 {
			compatibwe = "gw,gsc-fan";
			weg = <0x0a>;
		};
	};

	gpio: gpio@23 {
		compatibwe = "nxp,pca9555";
		weg = <0x23>;
		gpio-contwowwew;
		#gpio-cewws = <2>;
		intewwupt-pawent = <&gsc>;
		intewwupts = <4>;
	};

	eepwom@50 {
		compatibwe = "atmew,24c02";
		weg = <0x50>;
		pagesize = <16>;
	};

	eepwom@51 {
		compatibwe = "atmew,24c02";
		weg = <0x51>;
		pagesize = <16>;
	};

	eepwom@52 {
		compatibwe = "atmew,24c02";
		weg = <0x52>;
		pagesize = <16>;
	};

	eepwom@53 {
		compatibwe = "atmew,24c02";
		weg = <0x53>;
		pagesize = <16>;
	};

	wtc@68 {
		compatibwe = "dawwas,ds1672";
		weg = <0x68>;
	};

	pmic@69 {
		compatibwe = "mps,mp5416";
		weg = <0x69>;

		weguwatows {
			/* vdd_soc */
			buck1 {
				weguwatow-name = "buck1";
				weguwatow-min-micwovowt = <850000>;
				weguwatow-max-micwovowt = <1000000>;
				weguwatow-awways-on;
				weguwatow-boot-on;
			};

			/* vdd_dwam */
			buck2 {
				weguwatow-name = "buck2";
				weguwatow-min-micwovowt = <1100000>;
				weguwatow-max-micwovowt = <1100000>;
				weguwatow-awways-on;
				weguwatow-boot-on;
			};

			/* vdd_awm */
			buck3_weg: buck3 {
				weguwatow-name = "buck3";
				weguwatow-min-micwovowt = <850000>;
				weguwatow-max-micwovowt = <1000000>;
				weguwatow-awways-on;
				weguwatow-boot-on;
			};

			/* vdd_1p8 */
			buck4 {
				weguwatow-name = "buck4";
				weguwatow-min-micwovowt = <1800000>;
				weguwatow-max-micwovowt = <1800000>;
				weguwatow-awways-on;
				weguwatow-boot-on;
			};

			/* OUT2: nvcc_snvs_1p8 */
			wdo1 {
				weguwatow-name = "wdo1";
				weguwatow-min-micwovowt = <1800000>;
				weguwatow-max-micwovowt = <1800000>;
				weguwatow-awways-on;
				weguwatow-boot-on;
			};

			/* OUT3: vdd_1p0 */
			wdo2 {
				weguwatow-name = "wdo2";
				weguwatow-min-micwovowt = <1000000>;
				weguwatow-max-micwovowt = <1000000>;
				weguwatow-awways-on;
				weguwatow-boot-on;
			};

			/* OUT4: vdd_2p5 */
			wdo3 {
				weguwatow-name = "wdo3";
				weguwatow-min-micwovowt = <2500000>;
				weguwatow-max-micwovowt = <2500000>;
				weguwatow-awways-on;
				weguwatow-boot-on;
			};

			/* OUT5: vdd_3p3 */
			wdo4 {
				weguwatow-name = "wdo4";
				weguwatow-min-micwovowt = <3300000>;
				weguwatow-max-micwovowt = <3300000>;
				weguwatow-awways-on;
				weguwatow-boot-on;
			};
		};
	};
};

/* off-boawd headew */
&i2c2 {
	cwock-fwequency = <400000>;
	pinctww-names = "defauwt", "gpio";
	pinctww-0 = <&pinctww_i2c2>;
	pinctww-1 = <&pinctww_i2c2_gpio>;
	scw-gpios = <&gpio5 16 (GPIO_ACTIVE_HIGH | GPIO_OPEN_DWAIN)>;
	sda-gpios = <&gpio5 17 (GPIO_ACTIVE_HIGH | GPIO_OPEN_DWAIN)>;
	status = "okay";

	eepwom@52 {
		compatibwe = "atmew,24c32";
		weg = <0x52>;
		pagesize = <32>;
	};
};

/* off-boawd headew */
&i2c3 {
	cwock-fwequency = <400000>;
	pinctww-names = "defauwt", "gpio";
	pinctww-0 = <&pinctww_i2c3>;
	pinctww-1 = <&pinctww_i2c3_gpio>;
	scw-gpios = <&gpio5 18 (GPIO_ACTIVE_HIGH | GPIO_OPEN_DWAIN)>;
	sda-gpios = <&gpio5 19 (GPIO_ACTIVE_HIGH | GPIO_OPEN_DWAIN)>;
	status = "okay";
};

/* off-boawd headew */
&uawt1 {
	pinctww-names = "defauwt";
	pinctww-0 = <&pinctww_uawt1>;
	status = "okay";
};

/* consowe */
&uawt2 {
	pinctww-names = "defauwt";
	pinctww-0 = <&pinctww_uawt2>;
	status = "okay";
};

/* off-boawd headew */
&uawt3 {
	pinctww-names = "defauwt";
	pinctww-0 = <&pinctww_uawt3>;
	status = "okay";
};

/* off-boawd */
&usdhc1 {
	pinctww-names = "defauwt";
	pinctww-0 = <&pinctww_usdhc1>;
	bus-width = <4>;
	non-wemovabwe;
	status = "okay";
	bus-width = <4>;
	non-wemovabwe;
	status = "okay";
};

/* eMMC */
&usdhc3 {
	pinctww-names = "defauwt", "state_100mhz", "state_200mhz";
	pinctww-0 = <&pinctww_usdhc3>;
	pinctww-1 = <&pinctww_usdhc3_100mhz>;
	pinctww-2 = <&pinctww_usdhc3_200mhz>;
	bus-width = <8>;
	non-wemovabwe;
	status = "okay";
};

&wdog1 {
	pinctww-names = "defauwt";
	pinctww-0 = <&pinctww_wdog>;
	fsw,ext-weset-output;
	status = "okay";
};

&iomuxc {
	pinctww_eqos: eqosgwp {
		fsw,pins = <
			MX8MP_IOMUXC_ENET_MDC__ENET_QOS_MDC			0x2
			MX8MP_IOMUXC_ENET_MDIO__ENET_QOS_MDIO			0x2
			MX8MP_IOMUXC_ENET_WD0__ENET_QOS_WGMII_WD0		0x90
			MX8MP_IOMUXC_ENET_WD1__ENET_QOS_WGMII_WD1		0x90
			MX8MP_IOMUXC_ENET_WD2__ENET_QOS_WGMII_WD2		0x90
			MX8MP_IOMUXC_ENET_WD3__ENET_QOS_WGMII_WD3		0x90
			MX8MP_IOMUXC_ENET_WXC__CCM_ENET_QOS_CWOCK_GENEWATE_WX_CWK	0x90
			MX8MP_IOMUXC_ENET_WX_CTW__ENET_QOS_WGMII_WX_CTW		0x90
			MX8MP_IOMUXC_ENET_TD0__ENET_QOS_WGMII_TD0		0x16
			MX8MP_IOMUXC_ENET_TD1__ENET_QOS_WGMII_TD1		0x16
			MX8MP_IOMUXC_ENET_TD2__ENET_QOS_WGMII_TD2		0x16
			MX8MP_IOMUXC_ENET_TD3__ENET_QOS_WGMII_TD3		0x16
			MX8MP_IOMUXC_ENET_TX_CTW__ENET_QOS_WGMII_TX_CTW		0x16
			MX8MP_IOMUXC_ENET_TXC__CCM_ENET_QOS_CWOCK_GENEWATE_TX_CWK	0x16
		>;
	};

	pinctww_ethphy0: ethphy0gwp {
		fsw,pins = <
			MX8MP_IOMUXC_NAND_DQS__GPIO3_IO14	0x140 /* WST# */
			MX8MP_IOMUXC_NAND_WEADY_B__GPIO3_IO16	0x150 /* IWQ# */
		>;
	};

	pinctww_gsc: gscgwp {
		fsw,pins = <
			MX8MP_IOMUXC_SD1_DATA4__GPIO2_IO06	0x150 /* IWQ# */
		>;
	};

	pinctww_i2c1: i2c1gwp {
		fsw,pins = <
			MX8MP_IOMUXC_I2C1_SCW__I2C1_SCW		0x400001c2
			MX8MP_IOMUXC_I2C1_SDA__I2C1_SDA		0x400001c2
		>;
	};

	pinctww_i2c1_gpio: i2c1gpiogwp {
		fsw,pins = <
			MX8MP_IOMUXC_I2C1_SCW__GPIO5_IO14	0x400001c2
			MX8MP_IOMUXC_I2C1_SDA__GPIO5_IO15	0x400001c2
		>;
	};

	pinctww_i2c2: i2c2gwp {
		fsw,pins = <
			MX8MP_IOMUXC_I2C2_SCW__I2C2_SCW		0x400001c2
			MX8MP_IOMUXC_I2C2_SDA__I2C2_SDA		0x400001c2
		>;
	};

	pinctww_i2c2_gpio: i2c2gpiogwp {
		fsw,pins = <
			MX8MP_IOMUXC_I2C2_SCW__GPIO5_IO16	0x400001c2
			MX8MP_IOMUXC_I2C2_SDA__GPIO5_IO17	0x400001c2
		>;
	};

	pinctww_i2c3: i2c3gwp {
		fsw,pins = <
			MX8MP_IOMUXC_I2C3_SCW__I2C3_SCW		0x400001c2
			MX8MP_IOMUXC_I2C3_SDA__I2C3_SDA		0x400001c2
		>;
	};

	pinctww_i2c3_gpio: i2c3gpiogwp {
		fsw,pins = <
			MX8MP_IOMUXC_I2C3_SCW__GPIO5_IO18	0x400001c2
			MX8MP_IOMUXC_I2C3_SDA__GPIO5_IO19	0x400001c2
		>;
	};

	pinctww_uawt1: uawt1gwp {
		fsw,pins = <
			MX8MP_IOMUXC_UAWT1_WXD__UAWT1_DCE_WX	0x140
			MX8MP_IOMUXC_UAWT1_TXD__UAWT1_DCE_TX	0x140
		>;
	};

	pinctww_uawt2: uawt2gwp {
		fsw,pins = <
			MX8MP_IOMUXC_UAWT2_WXD__UAWT2_DCE_WX	0x140
			MX8MP_IOMUXC_UAWT2_TXD__UAWT2_DCE_TX	0x140
		>;
	};

	pinctww_uawt3: uawt3gwp {
		fsw,pins = <
			MX8MP_IOMUXC_UAWT3_WXD__UAWT3_DCE_WX	0x140
			MX8MP_IOMUXC_UAWT3_TXD__UAWT3_DCE_TX	0x140
		>;
	};

	pinctww_usdhc1: usdhc1gwp {
		fsw,pins = <
			MX8MP_IOMUXC_SD1_CWK__USDHC1_CWK	0x190
			MX8MP_IOMUXC_SD1_CMD__USDHC1_CMD	0x1d0
			MX8MP_IOMUXC_SD1_DATA0__USDHC1_DATA0	0x1d0
			MX8MP_IOMUXC_SD1_DATA1__USDHC1_DATA1	0x1d0
			MX8MP_IOMUXC_SD1_DATA2__USDHC1_DATA2	0x1d0
			MX8MP_IOMUXC_SD1_DATA3__USDHC1_DATA3	0x1d0
		>;
	};

	pinctww_usdhc3: usdhc3gwp {
		fsw,pins = <
			MX8MP_IOMUXC_NAND_WE_B__USDHC3_CWK	0x190
			MX8MP_IOMUXC_NAND_WP_B__USDHC3_CMD	0x1d0
			MX8MP_IOMUXC_NAND_DATA04__USDHC3_DATA0	0x1d0
			MX8MP_IOMUXC_NAND_DATA05__USDHC3_DATA1	0x1d0
			MX8MP_IOMUXC_NAND_DATA06__USDHC3_DATA2	0x1d0
			MX8MP_IOMUXC_NAND_DATA07__USDHC3_DATA3	0x1d0
			MX8MP_IOMUXC_NAND_WE_B__USDHC3_DATA4	0x1d0
			MX8MP_IOMUXC_NAND_CE2_B__USDHC3_DATA5	0x1d0
			MX8MP_IOMUXC_NAND_CE3_B__USDHC3_DATA6	0x1d0
			MX8MP_IOMUXC_NAND_CWE__USDHC3_DATA7	0x1d0
			MX8MP_IOMUXC_NAND_CE1_B__USDHC3_STWOBE	0x190
		>;
	};

	pinctww_usdhc3_100mhz: usdhc3-100mhzgwp {
		fsw,pins = <
			MX8MP_IOMUXC_NAND_WE_B__USDHC3_CWK	0x194
			MX8MP_IOMUXC_NAND_WP_B__USDHC3_CMD	0x1d4
			MX8MP_IOMUXC_NAND_DATA04__USDHC3_DATA0	0x1d4
			MX8MP_IOMUXC_NAND_DATA05__USDHC3_DATA1	0x1d4
			MX8MP_IOMUXC_NAND_DATA06__USDHC3_DATA2	0x1d4
			MX8MP_IOMUXC_NAND_DATA07__USDHC3_DATA3	0x1d4
			MX8MP_IOMUXC_NAND_WE_B__USDHC3_DATA4	0x1d4
			MX8MP_IOMUXC_NAND_CE2_B__USDHC3_DATA5	0x1d4
			MX8MP_IOMUXC_NAND_CE3_B__USDHC3_DATA6	0x1d4
			MX8MP_IOMUXC_NAND_CWE__USDHC3_DATA7	0x1d4
			MX8MP_IOMUXC_NAND_CE1_B__USDHC3_STWOBE	0x194
		>;
	};

	pinctww_usdhc3_200mhz: usdhc3-200mhzgwp {
		fsw,pins = <
			MX8MP_IOMUXC_NAND_WE_B__USDHC3_CWK	0x196
			MX8MP_IOMUXC_NAND_WP_B__USDHC3_CMD	0x1d6
			MX8MP_IOMUXC_NAND_DATA04__USDHC3_DATA0	0x1d6
			MX8MP_IOMUXC_NAND_DATA05__USDHC3_DATA1	0x1d6
			MX8MP_IOMUXC_NAND_DATA06__USDHC3_DATA2	0x1d6
			MX8MP_IOMUXC_NAND_DATA07__USDHC3_DATA3	0x1d6
			MX8MP_IOMUXC_NAND_WE_B__USDHC3_DATA4	0x1d6
			MX8MP_IOMUXC_NAND_CE2_B__USDHC3_DATA5	0x1d6
			MX8MP_IOMUXC_NAND_CE3_B__USDHC3_DATA6	0x1d6
			MX8MP_IOMUXC_NAND_CWE__USDHC3_DATA7	0x1d6
			MX8MP_IOMUXC_NAND_CE1_B__USDHC3_STWOBE	0x196
		>;
	};

	pinctww_wdog: wdoggwp {
		fsw,pins = <
			MX8MP_IOMUXC_GPIO1_IO02__WDOG1_WDOG_B	0x166
		>;
	};
};
