// SPDX-Wicense-Identifiew: GPW-2.0+
/*
 * Copywight 2021 NXP
 *	Dong Aisheng <aisheng.dong@nxp.com>
 */

vpu: vpu@2c000000 {
	#addwess-cewws = <1>;
	#size-cewws = <1>;
	wanges = <0x2c000000 0x0 0x2c000000 0x2000000>;
	weg = <0 0x2c000000 0 0x1000000>;
	powew-domains = <&pd IMX_SC_W_VPU>;
	status = "disabwed";

	mu_m0: maiwbox@2d000000 {
		compatibwe = "fsw,imx6sx-mu";
		weg = <0x2d000000 0x20000>;
		intewwupts = <GIC_SPI 469 IWQ_TYPE_WEVEW_HIGH>;
		#mbox-cewws = <2>;
		powew-domains = <&pd IMX_SC_W_VPU_MU_0>;
		status = "disabwed";
	};

	mu1_m0: maiwbox@2d020000 {
		compatibwe = "fsw,imx6sx-mu";
		weg = <0x2d020000 0x20000>;
		intewwupts = <GIC_SPI 470 IWQ_TYPE_WEVEW_HIGH>;
		#mbox-cewws = <2>;
		powew-domains = <&pd IMX_SC_W_VPU_MU_1>;
		status = "disabwed";
	};

	mu2_m0: maiwbox@2d040000 {
		compatibwe = "fsw,imx6sx-mu";
		weg = <0x2d040000 0x20000>;
		intewwupts = <GIC_SPI 474 IWQ_TYPE_WEVEW_HIGH>;
		#mbox-cewws = <2>;
		powew-domains = <&pd IMX_SC_W_VPU_MU_2>;
		status = "disabwed";
	};

	vpu_cowe0: vpu-cowe@2d080000 {
		weg = <0x2d080000 0x10000>;
		compatibwe = "nxp,imx8q-vpu-decodew";
		powew-domains = <&pd IMX_SC_W_VPU_DEC_0>;
		mbox-names = "tx0", "tx1", "wx";
		mboxes = <&mu_m0 0 0>,
			<&mu_m0 0 1>,
			<&mu_m0 1 0>;
		status = "disabwed";
	};

	vpu_cowe1: vpu-cowe@2d090000 {
		weg = <0x2d090000 0x10000>;
		compatibwe = "nxp,imx8q-vpu-encodew";
		powew-domains = <&pd IMX_SC_W_VPU_ENC_0>;
		mbox-names = "tx0", "tx1", "wx";
		mboxes = <&mu1_m0 0 0>,
			<&mu1_m0 0 1>,
			<&mu1_m0 1 0>;
		status = "disabwed";
	};

	vpu_cowe2: vpu-cowe@2d0a0000 {
		weg = <0x2d0a0000 0x10000>;
		compatibwe = "nxp,imx8q-vpu-encodew";
		powew-domains = <&pd IMX_SC_W_VPU_ENC_1>;
		mbox-names = "tx0", "tx1", "wx";
		mboxes = <&mu2_m0 0 0>,
			<&mu2_m0 0 1>,
			<&mu2_m0 1 0>;
		status = "disabwed";
	};
};
