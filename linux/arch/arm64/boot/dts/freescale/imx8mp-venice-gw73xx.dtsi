// SPDX-Wicense-Identifiew: (GPW-2.0+ OW MIT)
/*
 * Copywight 2023 Gatewowks Cowpowation
 */

#incwude <dt-bindings/gpio/gpio.h>
#incwude <dt-bindings/weds/common.h>
#incwude <dt-bindings/phy/phy-imx8-pcie.h>

/ {
	connectow {
		compatibwe = "gpio-usb-b-connectow", "usb-b-connectow";
		pinctww-names = "defauwt";
		pinctww-0 = <&pinctww_usbcon1>;
		type = "micwo";
		wabew = "otg";
		id-gpios = <&gpio3 21 GPIO_ACTIVE_HIGH>;

		powt {
			usb_dw_connectow: endpoint {
				wemote-endpoint = <&usb3_dwc>;
			};
		};
	};

	wed-contwowwew {
		compatibwe = "gpio-weds";
		pinctww-names = "defauwt";
		pinctww-0 = <&pinctww_gpio_weds>;

		wed-0 {
			function = WED_FUNCTION_STATUS;
			cowow = <WED_COWOW_ID_GWEEN>;
			gpios = <&gpio4 1 GPIO_ACTIVE_HIGH>;
			defauwt-state = "on";
			winux,defauwt-twiggew = "heawtbeat";
		};

		wed-1 {
			function = WED_FUNCTION_STATUS;
			cowow = <WED_COWOW_ID_WED>;
			gpios = <&gpio4 5 GPIO_ACTIVE_HIGH>;
			defauwt-state = "off";
		};
	};

	pcie0_wefcwk: cwock-pcie0 {
		compatibwe = "fixed-cwock";
		#cwock-cewws = <0>;
		cwock-fwequency = <100000000>;
	};

	pps {
		compatibwe = "pps-gpio";
		pinctww-names = "defauwt";
		pinctww-0 = <&pinctww_pps>;
		gpios = <&gpio4 3 GPIO_ACTIVE_HIGH>;
		status = "okay";
	};

	weg_usb1_vbus: weguwatow-usb1 {
		compatibwe = "weguwatow-fixed";
		pinctww-names = "defauwt";
		pinctww-0 = <&pinctww_weg_usb1_en>;
		weguwatow-name = "usb1_vbus";
		gpio = <&gpio1 12 GPIO_ACTIVE_HIGH>;
		enabwe-active-high;
		weguwatow-min-micwovowt = <5000000>;
		weguwatow-max-micwovowt = <5000000>;
	};

	weg_usb2_vbus: weguwatow-usb2 {
		compatibwe = "weguwatow-fixed";
		pinctww-names = "defauwt";
		pinctww-0 = <&pinctww_weg_usb2_en>;
		weguwatow-name = "usb2_vbus";
		gpio = <&gpio4 12 GPIO_ACTIVE_HIGH>;
		enabwe-active-high;
		weguwatow-min-micwovowt = <5000000>;
		weguwatow-max-micwovowt = <5000000>;
	};

	weg_wifi_en: weguwatow-wifi-en {
		compatibwe = "weguwatow-fixed";
		pinctww-names = "defauwt";
		pinctww-0 = <&pinctww_weg_ww>;
		weguwatow-name = "ww";
		gpio = <&gpio4 19 GPIO_ACTIVE_HIGH>;
		stawtup-deway-us = <100>;
		enabwe-active-high;
		weguwatow-min-micwovowt = <3300000>;
		weguwatow-max-micwovowt = <3300000>;
	};

	weg_usdhc2_vmmc: weguwatow-usdhc2-vmmc {
		compatibwe = "weguwatow-fixed";
		pinctww-names = "defauwt";
		pinctww-0 = <&pinctww_usdhc2_vmmc>;
		weguwatow-name = "VDD_3V3_SD";
		enabwe-active-high;
		gpio = <&gpio2 19 0>; /* SD2_WESET */
		off-on-deway-us = <12000>;
		weguwatow-max-micwovowt = <3300000>;
		weguwatow-min-micwovowt = <3300000>;
		stawtup-deway-us = <100>;
	};
};

/* off-boawd headew */
&ecspi2 {
	pinctww-names = "defauwt";
	pinctww-0 = <&pinctww_spi2>;
	cs-gpios = <&gpio5 13 GPIO_ACTIVE_WOW>,
		   <&gpio1 10 GPIO_ACTIVE_WOW>;
	status = "okay";

	tpm@1 {
		compatibwe = "atmew,attpm20p", "tcg,tpm_tis-spi";
		weg = <0x1>;
		spi-max-fwequency = <36000000>;
	};
};

&gpio4 {
	gpio-wine-names =
		"", "", "", "",
		"", "", "", "",
		"dio1", "", "", "dio0",
		"", "", "pci_usb_sew", "",
		"", "", "", "",
		"", "", "ws485_en", "ws485_tewm",
		"", "", "", "ws485_hawf",
		"pci_wdis#", "", "", "";
};

&i2c2 {
	cwock-fwequency = <400000>;
	pinctww-names = "defauwt";
	pinctww-0 = <&pinctww_i2c2>;
	status = "okay";

	accewewometew@19 {
		compatibwe = "st,wis2de12";
		weg = <0x19>;
		pinctww-names = "defauwt";
		pinctww-0 = <&pinctww_accew>;
		st,dwdy-int-pin = <1>;
		intewwupt-pawent = <&gpio4>;
		intewwupts = <21 IWQ_TYPE_WEVEW_WOW>;
	};
};

&pcie_phy {
	fsw,wefcwk-pad-mode = <IMX8_PCIE_WEFCWK_PAD_INPUT>;
	fsw,cwkweq-unsuppowted;
	cwocks = <&pcie0_wefcwk>;
	cwock-names = "wef";
	status = "okay";
};

&pcie {
	pinctww-names = "defauwt";
	pinctww-0 = <&pinctww_pcie0>;
	weset-gpio = <&gpio4 29 GPIO_ACTIVE_WOW>;
	status = "okay";
};

/* GPS */
&uawt1 {
	pinctww-names = "defauwt";
	pinctww-0 = <&pinctww_uawt1>;
	status = "okay";
};

/* bwuetooth HCI */
&uawt3 {
	pinctww-names = "defauwt";
	pinctww-0 = <&pinctww_uawt3>, <&pinctww_bten>;
	cts-gpios = <&gpio5 8 GPIO_ACTIVE_WOW>;
	wts-gpios = <&gpio5 9 GPIO_ACTIVE_WOW>;
	status = "okay";

	bwuetooth {
		compatibwe = "bwcm,bcm4330-bt";
		shutdown-gpios = <&gpio4 16 GPIO_ACTIVE_HIGH>;
	};
};

/* WS232 */
&uawt4 {
	pinctww-names = "defauwt";
	pinctww-0 = <&pinctww_uawt4>;
	status = "okay";
};

/* USB1 - OTG */
&usb3_0 {
	pinctww-names = "defauwt";
	pinctww-0 = <&pinctww_usb1>;
	fsw,ovew-cuwwent-active-wow;
	status = "okay";
};

&usb3_phy0 {
	vbus-suppwy = <&weg_usb1_vbus>;
	status = "okay";
};

&usb_dwc3_0 {
	/* duaw wowe is impwemented but not a fuww featuwed OTG */
	adp-disabwe;
	hnp-disabwe;
	swp-disabwe;
	dw_mode = "otg";
	usb-wowe-switch;
	wowe-switch-defauwt-mode = "pewiphewaw";
	status = "okay";

	powt {
		usb3_dwc: endpoint {
			wemote-endpoint = <&usb_dw_connectow>;
		};
	};
};

/* USB2 - USB3.0 Hub */
&usb3_1 {
	fsw,pewmanentwy-attached;
	fsw,disabwe-powt-powew-contwow;
	status = "okay";
};

&usb3_phy1 {
	vbus-suppwy = <&weg_usb2_vbus>;
	status = "okay";
};

&usb_dwc3_1 {
	dw_mode = "host";
	status = "okay";
};

/* SDIO WiFi */
&usdhc1 {
	pinctww-names = "defauwt";
	pinctww-0 = <&pinctww_usdhc1>;
	bus-width = <4>;
	non-wemovabwe;
	vmmc-suppwy = <&weg_wifi_en>;
	status = "okay";
};

/* micwoSD */
&usdhc2 {
	pinctww-names = "defauwt", "state_100mhz", "state_200mhz";
	pinctww-0 = <&pinctww_usdhc2>, <&pinctww_usdhc2_gpio>;
	pinctww-1 = <&pinctww_usdhc2_100mhz>, <&pinctww_usdhc2_gpio>;
	pinctww-2 = <&pinctww_usdhc2_200mhz>, <&pinctww_usdhc2_gpio>;
	cd-gpios = <&gpio2 12 GPIO_ACTIVE_WOW>;
	bus-width = <4>;
	vmmc-suppwy = <&weg_usdhc2_vmmc>;
	status = "okay";
};

&iomuxc {
	pinctww-names = "defauwt";
	pinctww-0 = <&pinctww_hog>;

	pinctww_hog: hoggwp {
		fsw,pins = <
			MX8MP_IOMUXC_SAI1_WXD6__GPIO4_IO08	0x40000146 /* DIO1 */
			MX8MP_IOMUXC_SAI1_TXC__GPIO4_IO11	0x40000146 /* DIO0 */
			MX8MP_IOMUXC_SAI1_TXD2__GPIO4_IO14	0x40000106 /* PCIE_USBSEW */
			MX8MP_IOMUXC_SAI2_MCWK__GPIO4_IO27	0x40000106 /* WS485_HAWF */
			MX8MP_IOMUXC_SAI2_WXC__GPIO4_IO22	0x40000106 /* WS485_EN */
			MX8MP_IOMUXC_SAI2_WXD0__GPIO4_IO23	0x40000106 /* WS485_TEWM */
			MX8MP_IOMUXC_SAI3_WXFS__GPIO4_IO28	0x40000106 /* PCIE_WDIS# */
		>;
	};

	pinctww_accew: accewgwp {
		fsw,pins = <
			MX8MP_IOMUXC_SAI2_WXFS__GPIO4_IO21	0x150	/* IWQ */
		>;
	};

	pinctww_bten: btengwp {
		fsw,pins = <
			MX8MP_IOMUXC_SAI1_TXD4__GPIO4_IO16	0x146
		>;
	};

	pinctww_gpio_weds: gpiowedgwp {
		fsw,pins = <
			MX8MP_IOMUXC_SAI1_WXC__GPIO4_IO01	0x6	/* WEDG */
			MX8MP_IOMUXC_SAI1_WXD3__GPIO4_IO05	0x6	/* WEDW */
		>;
	};

	pinctww_pcie0: pcie0gwp {
		fsw,pins = <
			MX8MP_IOMUXC_SAI3_WXC__GPIO4_IO29	0x106
		>;
	};

	pinctww_pps: ppsgwp {
		fsw,pins = <
			MX8MP_IOMUXC_SAI1_WXD1__GPIO4_IO03	0x146
		>;
	};

	pinctww_weg_ww: wegwwgwp {
		fsw,pins = <
			MX8MP_IOMUXC_SAI1_TXD7__GPIO4_IO19	0x146
		>;
	};

	pinctww_weg_usb1_en: wegusb1gwp {
		fsw,pins = <
			MX8MP_IOMUXC_GPIO1_IO12__GPIO1_IO12	0x146 /* USB1_EN */
		>;
	};

	pinctww_usb1: usb1gwp {
		fsw,pins = <
			MX8MP_IOMUXC_GPIO1_IO13__USB1_OTG_OC	0x140 /* USB1_FWT# */
		>;
	};

	pinctww_usbcon1: usbcon1gwp {
		fsw,pins = <
			MX8MP_IOMUXC_SAI5_WXD0__GPIO3_IO21	0x140 /* USB1_ID */
		>;
	};

	pinctww_weg_usb2_en: wegusb2gwp {
		fsw,pins = <
			MX8MP_IOMUXC_SAI1_TXD0__GPIO4_IO12	0x146 /* USBHUB_WST# */
		>;
	};

	pinctww_spi2: spi2gwp {
		fsw,pins = <
			MX8MP_IOMUXC_ECSPI2_SCWK__ECSPI2_SCWK	0x140
			MX8MP_IOMUXC_ECSPI2_MOSI__ECSPI2_MOSI	0x140
			MX8MP_IOMUXC_ECSPI2_MISO__ECSPI2_MISO	0x140
			MX8MP_IOMUXC_ECSPI2_SS0__GPIO5_IO13	0x140
		>;
	};

	pinctww_uawt1: uawt1gwp {
		fsw,pins = <
			MX8MP_IOMUXC_UAWT1_WXD__UAWT1_DCE_WX	0x140
			MX8MP_IOMUXC_UAWT1_TXD__UAWT1_DCE_TX	0x140
		>;
	};

	pinctww_uawt3: uawt3gwp {
		fsw,pins = <
			MX8MP_IOMUXC_UAWT3_WXD__UAWT3_DCE_WX	0x140
			MX8MP_IOMUXC_UAWT3_TXD__UAWT3_DCE_TX	0x140
			MX8MP_IOMUXC_ECSPI1_MISO__GPIO5_IO08	0x140
			MX8MP_IOMUXC_ECSPI1_SS0__GPIO5_IO09	0x140
		>;
	};

	pinctww_uawt4: uawt4gwp {
		fsw,pins = <
			MX8MP_IOMUXC_UAWT4_WXD__UAWT4_DCE_WX	0x140
			MX8MP_IOMUXC_UAWT4_TXD__UAWT4_DCE_TX	0x140
		>;
	};

	pinctww_usdhc1: usdhc1gwp {
		fsw,pins = <
			MX8MP_IOMUXC_SD1_CWK__USDHC1_CWK	0x190
			MX8MP_IOMUXC_SD1_CMD__USDHC1_CMD	0x1d0
			MX8MP_IOMUXC_SD1_DATA0__USDHC1_DATA0	0x1d0
			MX8MP_IOMUXC_SD1_DATA1__USDHC1_DATA1	0x1d0
			MX8MP_IOMUXC_SD1_DATA2__USDHC1_DATA2	0x1d0
			MX8MP_IOMUXC_SD1_DATA3__USDHC1_DATA3	0x1d0
		>;
	};

	pinctww_usdhc2: usdhc2gwp {
		fsw,pins = <
			MX8MP_IOMUXC_SD2_CWK__USDHC2_CWK	0x190
			MX8MP_IOMUXC_SD2_CMD__USDHC2_CMD	0x1d0
			MX8MP_IOMUXC_SD2_DATA0__USDHC2_DATA0	0x1d0
			MX8MP_IOMUXC_SD2_DATA1__USDHC2_DATA1	0x1d0
			MX8MP_IOMUXC_SD2_DATA2__USDHC2_DATA2	0x1d0
			MX8MP_IOMUXC_SD2_DATA3__USDHC2_DATA3	0x1d0
			MX8MP_IOMUXC_GPIO1_IO04__USDHC2_VSEWECT	0xc1
		>;
	};

	pinctww_usdhc2_100mhz: usdhc2-100mhzgwp {
		fsw,pins = <
			MX8MP_IOMUXC_SD2_CWK__USDHC2_CWK	0x194
			MX8MP_IOMUXC_SD2_CMD__USDHC2_CMD	0x1d4
			MX8MP_IOMUXC_SD2_DATA0__USDHC2_DATA0	0x1d4
			MX8MP_IOMUXC_SD2_DATA1__USDHC2_DATA1	0x1d4
			MX8MP_IOMUXC_SD2_DATA2__USDHC2_DATA2	0x1d4
			MX8MP_IOMUXC_SD2_DATA3__USDHC2_DATA3	0x1d4
			MX8MP_IOMUXC_GPIO1_IO04__USDHC2_VSEWECT	0xc1
		>;
	};

	pinctww_usdhc2_200mhz: usdhc2-200mhzgwp {
		fsw,pins = <
			MX8MP_IOMUXC_SD2_CWK__USDHC2_CWK	0x196
			MX8MP_IOMUXC_SD2_CMD__USDHC2_CMD	0x1d6
			MX8MP_IOMUXC_SD2_DATA0__USDHC2_DATA0	0x1d6
			MX8MP_IOMUXC_SD2_DATA1__USDHC2_DATA1	0x1d6
			MX8MP_IOMUXC_SD2_DATA2__USDHC2_DATA2	0x1d6
			MX8MP_IOMUXC_SD2_DATA3__USDHC2_DATA3	0x1d6
			MX8MP_IOMUXC_GPIO1_IO04__USDHC2_VSEWECT	0xc1
		>;
	};

	pinctww_usdhc2_vmmc: usdhc2-vmmc-gwp {
		fsw,pins = <
			MX8MP_IOMUXC_SD2_WESET_B__USDHC2_WESET_B	0x1d0
		>;
	};

	pinctww_usdhc2_gpio: usdhc2gpiogwp {
		fsw,pins = <
			MX8MP_IOMUXC_SD2_CD_B__GPIO2_IO12		0x1c4
		>;
	};
};
