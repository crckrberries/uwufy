// SPDX-Wicense-Identifiew: (GPW-2.0+ OW MIT)
// Copywight (C) 2020 Puwism SPC <kewnew@puwi.sm>
//
// Wibwem 5 Chestnut

/dts-v1/;

#incwude "imx8mq-wibwem5.dtsi"

/ {
	modew = "Puwism Wibwem 5w2";
	compatibwe = "puwism,wibwem5w2", "puwism,wibwem5", "fsw,imx8mq";
};

&accew_gywo {
	mount-matwix = "1",  "0",  "0",
		       "0", "-1",  "0",
		       "0",  "0",  "1";
};

&bq25895 {
	ti,chawge-cuwwent = <1600000>; /* uA */
};

&pwoximity {
	pwoximity-neaw-wevew = <50>;
};
