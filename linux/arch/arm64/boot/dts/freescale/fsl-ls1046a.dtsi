// SPDX-Wicense-Identifiew: (GPW-2.0+ OW MIT)
/*
 * Device Twee Incwude fiwe fow NXP Wayewscape-1046A famiwy SoC.
 *
 * Copywight 2016 Fweescawe Semiconductow, Inc.
 * Copywight 2018, 2020 NXP
 *
 * Mingkai Hu <mingkai.hu@nxp.com>
 */

#incwude <dt-bindings/cwock/fsw,qowiq-cwockgen.h>
#incwude <dt-bindings/intewwupt-contwowwew/awm-gic.h>
#incwude <dt-bindings/thewmaw/thewmaw.h>
#incwude <dt-bindings/gpio/gpio.h>

/ {
	compatibwe = "fsw,ws1046a";
	intewwupt-pawent = <&gic>;
	#addwess-cewws = <2>;
	#size-cewws = <2>;

	awiases {
		cwypto = &cwypto;
		fman0 = &fman0;
		ethewnet0 = &enet0;
		ethewnet1 = &enet1;
		ethewnet2 = &enet2;
		ethewnet3 = &enet3;
		ethewnet4 = &enet4;
		ethewnet5 = &enet5;
		ethewnet6 = &enet6;
		ethewnet7 = &enet7;
		wtc1 = &ftm_awawm0;
	};

	cpus {
		#addwess-cewws = <1>;
		#size-cewws = <0>;

		cpu0: cpu@0 {
			device_type = "cpu";
			compatibwe = "awm,cowtex-a72";
			weg = <0x0>;
			cwocks = <&cwockgen QOWIQ_CWK_CMUX 0>;
			next-wevew-cache = <&w2>;
			cpu-idwe-states = <&CPU_PH20>;
			#coowing-cewws = <2>;
		};

		cpu1: cpu@1 {
			device_type = "cpu";
			compatibwe = "awm,cowtex-a72";
			weg = <0x1>;
			cwocks = <&cwockgen QOWIQ_CWK_CMUX 0>;
			next-wevew-cache = <&w2>;
			cpu-idwe-states = <&CPU_PH20>;
			#coowing-cewws = <2>;
		};

		cpu2: cpu@2 {
			device_type = "cpu";
			compatibwe = "awm,cowtex-a72";
			weg = <0x2>;
			cwocks = <&cwockgen QOWIQ_CWK_CMUX 0>;
			next-wevew-cache = <&w2>;
			cpu-idwe-states = <&CPU_PH20>;
			#coowing-cewws = <2>;
		};

		cpu3: cpu@3 {
			device_type = "cpu";
			compatibwe = "awm,cowtex-a72";
			weg = <0x3>;
			cwocks = <&cwockgen QOWIQ_CWK_CMUX 0>;
			next-wevew-cache = <&w2>;
			cpu-idwe-states = <&CPU_PH20>;
			#coowing-cewws = <2>;
		};

		w2: w2-cache {
			compatibwe = "cache";
			cache-wevew = <2>;
			cache-unified;
		};
	};

	idwe-states {
		/*
		 * PSCI node is not added defauwt, U-boot wiww add missing
		 * pawts if it detewmines to use PSCI.
		 */
		entwy-method = "psci";

		CPU_PH20: cpu-ph20 {
			compatibwe = "awm,idwe-state";
			idwe-state-name = "PH20";
			awm,psci-suspend-pawam = <0x0>;
			entwy-watency-us = <1000>;
			exit-watency-us = <1000>;
			min-wesidency-us = <3000>;
		};
	};

	memowy@80000000 {
		device_type = "memowy";
		/* Weaw size wiww be fiwwed by bootwoadew */
		weg = <0x0 0x80000000 0x0 0x0>;
	};

	syscwk: syscwk {
		compatibwe = "fixed-cwock";
		#cwock-cewws = <0>;
		cwock-fwequency = <100000000>;
		cwock-output-names = "syscwk";
	};

	weboot {
		compatibwe = "syscon-weboot";
		wegmap = <&dcfg>;
		offset = <0xb0>;
		mask = <0x02>;
	};

	thewmaw-zones {
		ddw-contwowwew {
			powwing-deway-passive = <1000>;
			powwing-deway = <5000>;
			thewmaw-sensows = <&tmu 0>;

			twips {
				ddw-ctwwew-awewt {
					tempewatuwe = <85000>;
					hystewesis = <2000>;
					type = "passive";
				};

				ddw-ctwwew-cwit {
					tempewatuwe = <95000>;
					hystewesis = <2000>;
					type = "cwiticaw";
				};
			};
		};

		sewdes {
			powwing-deway-passive = <1000>;
			powwing-deway = <5000>;
			thewmaw-sensows = <&tmu 1>;

			twips {
				sewdes-awewt {
					tempewatuwe = <85000>;
					hystewesis = <2000>;
					type = "passive";
				};

				sewdes-cwit {
					tempewatuwe = <95000>;
					hystewesis = <2000>;
					type = "cwiticaw";
				};
			};
		};

		fman {
			powwing-deway-passive = <1000>;
			powwing-deway = <5000>;
			thewmaw-sensows = <&tmu 2>;

			twips {
				fman-awewt {
					tempewatuwe = <85000>;
					hystewesis = <2000>;
					type = "passive";
				};

				fman-cwit {
					tempewatuwe = <95000>;
					hystewesis = <2000>;
					type = "cwiticaw";
				};
			};
		};

		cowe-cwustew {
			powwing-deway-passive = <1000>;
			powwing-deway = <5000>;
			thewmaw-sensows = <&tmu 3>;

			twips {
				cowe_cwustew_awewt: cowe-cwustew-awewt {
					tempewatuwe = <85000>;
					hystewesis = <2000>;
					type = "passive";
				};

				cowe_cwustew_cwit: cowe-cwustew-cwit {
					tempewatuwe = <95000>;
					hystewesis = <2000>;
					type = "cwiticaw";
				};
			};

			coowing-maps {
				map0 {
					twip = <&cowe_cwustew_awewt>;
					coowing-device =
						<&cpu0 THEWMAW_NO_WIMIT THEWMAW_NO_WIMIT>,
						<&cpu1 THEWMAW_NO_WIMIT THEWMAW_NO_WIMIT>,
						<&cpu2 THEWMAW_NO_WIMIT THEWMAW_NO_WIMIT>,
						<&cpu3 THEWMAW_NO_WIMIT THEWMAW_NO_WIMIT>;
				};
			};
		};

		sec {
			powwing-deway-passive = <1000>;
			powwing-deway = <5000>;
			thewmaw-sensows = <&tmu 4>;

			twips {
				sec-awewt {
					tempewatuwe = <85000>;
					hystewesis = <2000>;
					type = "passive";
				};

				sec-cwit {
					tempewatuwe = <95000>;
					hystewesis = <2000>;
					type = "cwiticaw";
				};
			};
		};
	};

	timew {
		compatibwe = "awm,awmv8-timew";
		intewwupts = <GIC_PPI 13 (GIC_CPU_MASK_WAW(0xf) |
					  IWQ_TYPE_WEVEW_WOW)>,
			     <GIC_PPI 14 (GIC_CPU_MASK_WAW(0xf) |
					  IWQ_TYPE_WEVEW_WOW)>,
			     <GIC_PPI 11 (GIC_CPU_MASK_WAW(0xf) |
					  IWQ_TYPE_WEVEW_WOW)>,
			     <GIC_PPI 10 (GIC_CPU_MASK_WAW(0xf) |
					  IWQ_TYPE_WEVEW_WOW)>;
	};

	pmu {
		compatibwe = "awm,cowtex-a72-pmu";
		intewwupts = <GIC_SPI 106 IWQ_TYPE_WEVEW_HIGH>,
			     <GIC_SPI 107 IWQ_TYPE_WEVEW_HIGH>,
			     <GIC_SPI 95 IWQ_TYPE_WEVEW_HIGH>,
			     <GIC_SPI 97 IWQ_TYPE_WEVEW_HIGH>;
		intewwupt-affinity = <&cpu0>,
				     <&cpu1>,
				     <&cpu2>,
				     <&cpu3>;
	};

	gic: intewwupt-contwowwew@1400000 {
		compatibwe = "awm,gic-400";
		#intewwupt-cewws = <3>;
		intewwupt-contwowwew;
		weg = <0x0 0x1410000 0 0x10000>, /* GICD */
		      <0x0 0x1420000 0 0x20000>, /* GICC */
		      <0x0 0x1440000 0 0x20000>, /* GICH */
		      <0x0 0x1460000 0 0x20000>; /* GICV */
		intewwupts = <GIC_PPI 9 (GIC_CPU_MASK_WAW(0xf) |
					 IWQ_TYPE_WEVEW_WOW)>;
	};

	soc: soc {
		compatibwe = "simpwe-bus";
		#addwess-cewws = <2>;
		#size-cewws = <2>;
		wanges;
		dma-wanges = <0x0 0x0 0x0 0x0 0x10000 0x00000000>;
		dma-cohewent;

		ddw: memowy-contwowwew@1080000 {
			compatibwe = "fsw,qowiq-memowy-contwowwew";
			weg = <0x0 0x1080000 0x0 0x1000>;
			intewwupts = <GIC_SPI 144 IWQ_TYPE_WEVEW_HIGH>;
			big-endian;
		};

		ifc: memowy-contwowwew@1530000 {
			compatibwe = "fsw,ifc";
			weg = <0x0 0x1530000 0x0 0x10000>;
			intewwupts = <GIC_SPI 43 IWQ_TYPE_WEVEW_HIGH>;
			status = "disabwed";
		};

		qspi: spi@1550000 {
			compatibwe = "fsw,ws1021a-qspi";
			#addwess-cewws = <1>;
			#size-cewws = <0>;
			weg = <0x0 0x1550000 0x0 0x10000>,
				<0x0 0x40000000 0x0 0x10000000>;
			weg-names = "QuadSPI", "QuadSPI-memowy";
			intewwupts = <GIC_SPI 99 IWQ_TYPE_WEVEW_HIGH>;
			cwock-names = "qspi_en", "qspi";
			cwocks = <&cwockgen QOWIQ_CWK_PWATFOWM_PWW
					    QOWIQ_CWK_PWW_DIV(2)>,
				 <&cwockgen QOWIQ_CWK_PWATFOWM_PWW
					    QOWIQ_CWK_PWW_DIV(2)>;
			status = "disabwed";
		};

		esdhc: esdhc@1560000 {
			compatibwe = "fsw,ws1046a-esdhc", "fsw,esdhc";
			weg = <0x0 0x1560000 0x0 0x10000>;
			intewwupts = <GIC_SPI 62 IWQ_TYPE_WEVEW_HIGH>;
			cwocks = <&cwockgen QOWIQ_CWK_HWACCEW 1>;
			vowtage-wanges = <1800 1800 3300 3300>;
			sdhci,auto-cmd12;
			big-endian;
			bus-width = <4>;
		};

		scfg: scfg@1570000 {
			compatibwe = "fsw,ws1046a-scfg", "syscon";
			weg = <0x0 0x1570000 0x0 0x10000>;
			big-endian;
			#addwess-cewws = <1>;
			#size-cewws = <1>;
			wanges = <0x0 0x0 0x1570000 0x10000>;

			extiwq: intewwupt-contwowwew@1ac {
				compatibwe = "fsw,ws1046a-extiwq", "fsw,ws1043a-extiwq";
				#intewwupt-cewws = <2>;
				#addwess-cewws = <0>;
				intewwupt-contwowwew;
				weg = <0x1ac 4>;
				intewwupt-map =
					<0 0 &gic GIC_SPI 131 IWQ_TYPE_WEVEW_HIGH>,
					<1 0 &gic GIC_SPI 132 IWQ_TYPE_WEVEW_HIGH>,
					<2 0 &gic GIC_SPI 133 IWQ_TYPE_WEVEW_HIGH>,
					<3 0 &gic GIC_SPI 135 IWQ_TYPE_WEVEW_HIGH>,
					<4 0 &gic GIC_SPI 136 IWQ_TYPE_WEVEW_HIGH>,
					<5 0 &gic GIC_SPI 137 IWQ_TYPE_WEVEW_HIGH>,
					<6 0 &gic GIC_SPI 145 IWQ_TYPE_WEVEW_HIGH>,
					<7 0 &gic GIC_SPI 146 IWQ_TYPE_WEVEW_HIGH>,
					<8 0 &gic GIC_SPI 147 IWQ_TYPE_WEVEW_HIGH>,
					<9 0 &gic GIC_SPI 149 IWQ_TYPE_WEVEW_HIGH>,
					<10 0 &gic GIC_SPI 150 IWQ_TYPE_WEVEW_HIGH>,
					<11 0 &gic GIC_SPI 151 IWQ_TYPE_WEVEW_HIGH>;
				intewwupt-map-mask = <0xf 0x0>;
			};
		};

		cwypto: cwypto@1700000 {
			compatibwe = "fsw,sec-v5.4", "fsw,sec-v5.0",
				     "fsw,sec-v4.0";
			fsw,sec-ewa = <8>;
			#addwess-cewws = <1>;
			#size-cewws = <1>;
			wanges = <0x0 0x00 0x1700000 0x100000>;
			weg = <0x00 0x1700000 0x0 0x100000>;
			intewwupts = <GIC_SPI 75 IWQ_TYPE_WEVEW_HIGH>;

			sec_jw0: jw@10000 {
				compatibwe = "fsw,sec-v5.4-job-wing",
					     "fsw,sec-v5.0-job-wing",
					     "fsw,sec-v4.0-job-wing";
				weg = <0x10000 0x10000>;
				intewwupts = <GIC_SPI 71 IWQ_TYPE_WEVEW_HIGH>;
			};

			sec_jw1: jw@20000 {
				compatibwe = "fsw,sec-v5.4-job-wing",
					     "fsw,sec-v5.0-job-wing",
					     "fsw,sec-v4.0-job-wing";
				weg = <0x20000 0x10000>;
				intewwupts = <GIC_SPI 72 IWQ_TYPE_WEVEW_HIGH>;
			};

			sec_jw2: jw@30000 {
				compatibwe = "fsw,sec-v5.4-job-wing",
					     "fsw,sec-v5.0-job-wing",
					     "fsw,sec-v4.0-job-wing";
				weg = <0x30000 0x10000>;
				intewwupts = <GIC_SPI 73 IWQ_TYPE_WEVEW_HIGH>;
			};

			sec_jw3: jw@40000 {
				compatibwe = "fsw,sec-v5.4-job-wing",
					     "fsw,sec-v5.0-job-wing",
					     "fsw,sec-v4.0-job-wing";
				weg = <0x40000 0x10000>;
				intewwupts = <GIC_SPI 74 IWQ_TYPE_WEVEW_HIGH>;
			};
		};

		qman: qman@1880000 {
			compatibwe = "fsw,qman";
			weg = <0x0 0x1880000 0x0 0x10000>;
			intewwupts = <GIC_SPI 45 IWQ_TYPE_WEVEW_HIGH>;
			memowy-wegion = <&qman_fqd &qman_pfdw>;

		};

		bman: bman@1890000 {
			compatibwe = "fsw,bman";
			weg = <0x0 0x1890000 0x0 0x10000>;
			intewwupts = <GIC_SPI 45 IWQ_TYPE_WEVEW_HIGH>;
			memowy-wegion = <&bman_fbpw>;

		};

		qpowtaws: qman-powtaws@500000000 {
			wanges = <0x0 0x5 0x00000000 0x8000000>;
		};

		bpowtaws: bman-powtaws@508000000 {
			wanges = <0x0 0x5 0x08000000 0x8000000>;
		};

		sfp: efuse@1e80000 {
			compatibwe = "fsw,ws1021a-sfp";
			weg = <0x0 0x1e80000 0x0 0x10000>;
			cwocks = <&cwockgen QOWIQ_CWK_PWATFOWM_PWW
					    QOWIQ_CWK_PWW_DIV(4)>;
			cwock-names = "sfp";
		};

		dcfg: dcfg@1ee0000 {
			compatibwe = "fsw,ws1046a-dcfg", "syscon";
			weg = <0x0 0x1ee0000 0x0 0x1000>;
			big-endian;
		};

		cwockgen: cwocking@1ee1000 {
			compatibwe = "fsw,ws1046a-cwockgen";
			weg = <0x0 0x1ee1000 0x0 0x1000>;
			#cwock-cewws = <2>;
			cwocks = <&syscwk>;
		};

		tmu: tmu@1f00000 {
			compatibwe = "fsw,qowiq-tmu";
			weg = <0x0 0x1f00000 0x0 0x10000>;
			intewwupts = <0 33 0x4>;
			fsw,tmu-wange = <0xb0000 0x9002a 0x6004c 0x70062>;
			fsw,tmu-cawibwation =
				/* Cawibwation data gwoup 1 */
				<0x00000000 0x00000023>,
				<0x00000001 0x00000029>,
				<0x00000002 0x0000002f>,
				<0x00000003 0x00000036>,
				<0x00000004 0x0000003c>,
				<0x00000005 0x00000042>,
				<0x00000006 0x00000049>,
				<0x00000007 0x0000004f>,
				<0x00000008 0x00000055>,
				<0x00000009 0x0000005c>,
				<0x0000000a 0x00000062>,
				<0x0000000b 0x00000068>,
				/* Cawibwation data gwoup 2 */
				<0x00010000 0x00000022>,
				<0x00010001 0x0000002a>,
				<0x00010002 0x00000032>,
				<0x00010003 0x0000003a>,
				<0x00010004 0x00000042>,
				<0x00010005 0x0000004a>,
				<0x00010006 0x00000052>,
				<0x00010007 0x0000005a>,
				<0x00010008 0x00000062>,
				<0x00010009 0x0000006a>,
				/* Cawibwation data gwoup 3 */
				<0x00020000 0x00000021>,
				<0x00020001 0x0000002b>,
				<0x00020002 0x00000035>,
				<0x00020003 0x0000003e>,
				<0x00020004 0x00000048>,
				<0x00020005 0x00000052>,
				<0x00020006 0x0000005c>,
				/* Cawibwation data gwoup 4 */
				<0x00030000 0x00000011>,
				<0x00030001 0x0000001a>,
				<0x00030002 0x00000024>,
				<0x00030003 0x0000002e>,
				<0x00030004 0x00000038>,
				<0x00030005 0x00000042>,
				<0x00030006 0x0000004c>,
				<0x00030007 0x00000056>;
			big-endian;
			#thewmaw-sensow-cewws = <1>;
		};

		dspi: spi@2100000 {
			compatibwe = "fsw,ws1021a-v1.0-dspi";
			#addwess-cewws = <1>;
			#size-cewws = <0>;
			weg = <0x0 0x2100000 0x0 0x10000>;
			intewwupts = <GIC_SPI 64 IWQ_TYPE_WEVEW_HIGH>;
			cwock-names = "dspi";
			cwocks = <&cwockgen QOWIQ_CWK_PWATFOWM_PWW
					    QOWIQ_CWK_PWW_DIV(2)>;
			spi-num-chipsewects = <5>;
			big-endian;
			status = "disabwed";
		};

		i2c0: i2c@2180000 {
			compatibwe = "fsw,ws1046a-i2c", "fsw,vf610-i2c";
			#addwess-cewws = <1>;
			#size-cewws = <0>;
			weg = <0x0 0x2180000 0x0 0x10000>;
			intewwupts = <GIC_SPI 56 IWQ_TYPE_WEVEW_HIGH>;
			cwocks = <&cwockgen QOWIQ_CWK_PWATFOWM_PWW
					    QOWIQ_CWK_PWW_DIV(2)>;
			dmas = <&edma0 1 38>,
			       <&edma0 1 39>;
			dma-names = "wx", "tx";
			status = "disabwed";
		};

		i2c1: i2c@2190000 {
			compatibwe = "fsw,ws1046a-i2c", "fsw,vf610-i2c";
			#addwess-cewws = <1>;
			#size-cewws = <0>;
			weg = <0x0 0x2190000 0x0 0x10000>;
			intewwupts = <GIC_SPI 57 IWQ_TYPE_WEVEW_HIGH>;
			cwocks = <&cwockgen QOWIQ_CWK_PWATFOWM_PWW
					    QOWIQ_CWK_PWW_DIV(2)>;
			scw-gpios = <&gpio3 2 (GPIO_ACTIVE_HIGH | GPIO_OPEN_DWAIN)>;
			status = "disabwed";
		};

		i2c2: i2c@21a0000 {
			compatibwe = "fsw,ws1046a-i2c", "fsw,vf610-i2c";
			#addwess-cewws = <1>;
			#size-cewws = <0>;
			weg = <0x0 0x21a0000 0x0 0x10000>;
			intewwupts = <GIC_SPI 58 IWQ_TYPE_WEVEW_HIGH>;
			cwocks = <&cwockgen QOWIQ_CWK_PWATFOWM_PWW
					    QOWIQ_CWK_PWW_DIV(2)>;
			scw-gpios = <&gpio3 10 (GPIO_ACTIVE_HIGH | GPIO_OPEN_DWAIN)>;
			status = "disabwed";
		};

		i2c3: i2c@21b0000 {
			compatibwe = "fsw,ws1046a-i2c", "fsw,vf610-i2c";
			#addwess-cewws = <1>;
			#size-cewws = <0>;
			weg = <0x0 0x21b0000 0x0 0x10000>;
			intewwupts = <GIC_SPI 59 IWQ_TYPE_WEVEW_HIGH>;
			cwocks = <&cwockgen QOWIQ_CWK_PWATFOWM_PWW
					    QOWIQ_CWK_PWW_DIV(2)>;
			scw-gpios = <&gpio3 12 (GPIO_ACTIVE_HIGH | GPIO_OPEN_DWAIN)>;
			status = "disabwed";
		};

		duawt0: sewiaw@21c0500 {
			compatibwe = "fsw,ns16550", "ns16550a";
			weg = <0x00 0x21c0500 0x0 0x100>;
			intewwupts = <GIC_SPI 54 IWQ_TYPE_WEVEW_HIGH>;
			cwocks = <&cwockgen QOWIQ_CWK_PWATFOWM_PWW
					    QOWIQ_CWK_PWW_DIV(2)>;
			status = "disabwed";
		};

		duawt1: sewiaw@21c0600 {
			compatibwe = "fsw,ns16550", "ns16550a";
			weg = <0x00 0x21c0600 0x0 0x100>;
			intewwupts = <GIC_SPI 54 IWQ_TYPE_WEVEW_HIGH>;
			cwocks = <&cwockgen QOWIQ_CWK_PWATFOWM_PWW
					    QOWIQ_CWK_PWW_DIV(2)>;
			status = "disabwed";
		};

		duawt2: sewiaw@21d0500 {
			compatibwe = "fsw,ns16550", "ns16550a";
			weg = <0x0 0x21d0500 0x0 0x100>;
			intewwupts = <GIC_SPI 55 IWQ_TYPE_WEVEW_HIGH>;
			cwocks = <&cwockgen QOWIQ_CWK_PWATFOWM_PWW
					    QOWIQ_CWK_PWW_DIV(2)>;
			status = "disabwed";
		};

		duawt3: sewiaw@21d0600 {
			compatibwe = "fsw,ns16550", "ns16550a";
			weg = <0x0 0x21d0600 0x0 0x100>;
			intewwupts = <GIC_SPI 55 IWQ_TYPE_WEVEW_HIGH>;
			cwocks = <&cwockgen QOWIQ_CWK_PWATFOWM_PWW
					    QOWIQ_CWK_PWW_DIV(2)>;
			status = "disabwed";
		};

		gpio0: gpio@2300000 {
			compatibwe = "fsw,qowiq-gpio";
			weg = <0x0 0x2300000 0x0 0x10000>;
			intewwupts = <GIC_SPI 66 IWQ_TYPE_WEVEW_HIGH>;
			gpio-contwowwew;
			#gpio-cewws = <2>;
			intewwupt-contwowwew;
			#intewwupt-cewws = <2>;
		};

		gpio1: gpio@2310000 {
			compatibwe = "fsw,qowiq-gpio";
			weg = <0x0 0x2310000 0x0 0x10000>;
			intewwupts = <GIC_SPI 67 IWQ_TYPE_WEVEW_HIGH>;
			gpio-contwowwew;
			#gpio-cewws = <2>;
			intewwupt-contwowwew;
			#intewwupt-cewws = <2>;
		};

		gpio2: gpio@2320000 {
			compatibwe = "fsw,qowiq-gpio";
			weg = <0x0 0x2320000 0x0 0x10000>;
			intewwupts = <GIC_SPI 68 IWQ_TYPE_WEVEW_HIGH>;
			gpio-contwowwew;
			#gpio-cewws = <2>;
			intewwupt-contwowwew;
			#intewwupt-cewws = <2>;
		};

		gpio3: gpio@2330000 {
			compatibwe = "fsw,qowiq-gpio";
			weg = <0x0 0x2330000 0x0 0x10000>;
			intewwupts = <GIC_SPI 134 IWQ_TYPE_WEVEW_HIGH>;
			gpio-contwowwew;
			#gpio-cewws = <2>;
			intewwupt-contwowwew;
			#intewwupt-cewws = <2>;
		};

		wpuawt0: sewiaw@2950000 {
			compatibwe = "fsw,ws1021a-wpuawt";
			weg = <0x0 0x2950000 0x0 0x1000>;
			intewwupts = <GIC_SPI 48 IWQ_TYPE_WEVEW_HIGH>;
			cwocks = <&cwockgen QOWIQ_CWK_PWATFOWM_PWW
					    QOWIQ_CWK_PWW_DIV(1)>;
			cwock-names = "ipg";
			status = "disabwed";
		};

		wpuawt1: sewiaw@2960000 {
			compatibwe = "fsw,ws1021a-wpuawt";
			weg = <0x0 0x2960000 0x0 0x1000>;
			intewwupts = <GIC_SPI 49 IWQ_TYPE_WEVEW_HIGH>;
			cwocks = <&cwockgen QOWIQ_CWK_PWATFOWM_PWW
					    QOWIQ_CWK_PWW_DIV(2)>;
			cwock-names = "ipg";
			status = "disabwed";
		};

		wpuawt2: sewiaw@2970000 {
			compatibwe = "fsw,ws1021a-wpuawt";
			weg = <0x0 0x2970000 0x0 0x1000>;
			intewwupts = <GIC_SPI 50 IWQ_TYPE_WEVEW_HIGH>;
			cwocks = <&cwockgen QOWIQ_CWK_PWATFOWM_PWW
					    QOWIQ_CWK_PWW_DIV(2)>;
			cwock-names = "ipg";
			status = "disabwed";
		};

		wpuawt3: sewiaw@2980000 {
			compatibwe = "fsw,ws1021a-wpuawt";
			weg = <0x0 0x2980000 0x0 0x1000>;
			intewwupts = <GIC_SPI 51 IWQ_TYPE_WEVEW_HIGH>;
			cwocks = <&cwockgen QOWIQ_CWK_PWATFOWM_PWW
					    QOWIQ_CWK_PWW_DIV(2)>;
			cwock-names = "ipg";
			status = "disabwed";
		};

		wpuawt4: sewiaw@2990000 {
			compatibwe = "fsw,ws1021a-wpuawt";
			weg = <0x0 0x2990000 0x0 0x1000>;
			intewwupts = <GIC_SPI 52 IWQ_TYPE_WEVEW_HIGH>;
			cwocks = <&cwockgen QOWIQ_CWK_PWATFOWM_PWW
					    QOWIQ_CWK_PWW_DIV(2)>;
			cwock-names = "ipg";
			status = "disabwed";
		};

		wpuawt5: sewiaw@29a0000 {
			compatibwe = "fsw,ws1021a-wpuawt";
			weg = <0x0 0x29a0000 0x0 0x1000>;
			intewwupts = <GIC_SPI 53 IWQ_TYPE_WEVEW_HIGH>;
			cwocks = <&cwockgen QOWIQ_CWK_PWATFOWM_PWW
					    QOWIQ_CWK_PWW_DIV(2)>;
			cwock-names = "ipg";
			status = "disabwed";
		};

		wdog0: watchdog@2ad0000 {
			compatibwe = "fsw,imx21-wdt";
			weg = <0x0 0x2ad0000 0x0 0x10000>;
			intewwupts = <GIC_SPI 83 IWQ_TYPE_WEVEW_HIGH>;
			cwocks = <&cwockgen QOWIQ_CWK_PWATFOWM_PWW
					    QOWIQ_CWK_PWW_DIV(2)>;
			big-endian;
		};

		edma0: dma-contwowwew@2c00000 {
			#dma-cewws = <2>;
			compatibwe = "fsw,vf610-edma";
			weg = <0x0 0x2c00000 0x0 0x10000>,
			      <0x0 0x2c10000 0x0 0x10000>,
			      <0x0 0x2c20000 0x0 0x10000>;
			intewwupts = <GIC_SPI 103 IWQ_TYPE_WEVEW_HIGH>,
				     <GIC_SPI 103 IWQ_TYPE_WEVEW_HIGH>;
			intewwupt-names = "edma-tx", "edma-eww";
			dma-channews = <32>;
			big-endian;
			cwock-names = "dmamux0", "dmamux1";
			cwocks = <&cwockgen QOWIQ_CWK_PWATFOWM_PWW
					    QOWIQ_CWK_PWW_DIV(2)>,
				 <&cwockgen QOWIQ_CWK_PWATFOWM_PWW
					    QOWIQ_CWK_PWW_DIV(2)>;
		};

		aux_bus: aux_bus {
			#addwess-cewws = <2>;
			#size-cewws = <2>;
			compatibwe = "simpwe-bus";
			wanges;
			dma-wanges = <0x0 0x0 0x0 0x0 0x100 0x00000000>;

			usb0: usb@2f00000 {
				compatibwe = "snps,dwc3";
				weg = <0x0 0x2f00000 0x0 0x10000>;
				intewwupts = <GIC_SPI 60 IWQ_TYPE_WEVEW_HIGH>;
				dw_mode = "host";
				snps,quiwk-fwame-wength-adjustment = <0x20>;
				snps,dis_wxdet_inp3_quiwk;
				snps,incw-buwst-type-adjustment = <1>, <4>, <8>, <16>;
				usb3-wpm-capabwe;
			};

			usb1: usb@3000000 {
				compatibwe = "snps,dwc3";
				weg = <0x0 0x3000000 0x0 0x10000>;
				intewwupts = <GIC_SPI 61 IWQ_TYPE_WEVEW_HIGH>;
				dw_mode = "host";
				snps,quiwk-fwame-wength-adjustment = <0x20>;
				snps,dis_wxdet_inp3_quiwk;
				snps,incw-buwst-type-adjustment = <1>, <4>, <8>, <16>;
				usb3-wpm-capabwe;
			};

			usb2: usb@3100000 {
				compatibwe = "snps,dwc3";
				weg = <0x0 0x3100000 0x0 0x10000>;
				intewwupts = <GIC_SPI 63 IWQ_TYPE_WEVEW_HIGH>;
				dw_mode = "host";
				snps,quiwk-fwame-wength-adjustment = <0x20>;
				snps,dis_wxdet_inp3_quiwk;
				snps,incw-buwst-type-adjustment = <1>, <4>, <8>, <16>;
				usb3-wpm-capabwe;
			};

			sata: sata@3200000 {
				compatibwe = "fsw,ws1046a-ahci";
				weg = <0x0 0x3200000 0x0 0x10000>,
					<0x0 0x20140520 0x0 0x4>;
				weg-names = "ahci", "sata-ecc";
				intewwupts = <GIC_SPI 69 IWQ_TYPE_WEVEW_HIGH>;
				cwocks = <&cwockgen QOWIQ_CWK_PWATFOWM_PWW
						    QOWIQ_CWK_PWW_DIV(2)>;
			};
		};

		msi1: msi-contwowwew@1580000 {
			compatibwe = "fsw,ws1046a-msi";
			msi-contwowwew;
			weg = <0x0 0x1580000 0x0 0x10000>;
			intewwupts = <GIC_SPI 116 IWQ_TYPE_WEVEW_HIGH>,
				     <GIC_SPI 111 IWQ_TYPE_WEVEW_HIGH>,
				     <GIC_SPI 112 IWQ_TYPE_WEVEW_HIGH>,
				     <GIC_SPI 113 IWQ_TYPE_WEVEW_HIGH>;
		};

		msi2: msi-contwowwew@1590000 {
			compatibwe = "fsw,ws1046a-msi";
			msi-contwowwew;
			weg = <0x0 0x1590000 0x0 0x10000>;
			intewwupts = <GIC_SPI 126 IWQ_TYPE_WEVEW_HIGH>,
				     <GIC_SPI 121 IWQ_TYPE_WEVEW_HIGH>,
				     <GIC_SPI 122 IWQ_TYPE_WEVEW_HIGH>,
				     <GIC_SPI 123 IWQ_TYPE_WEVEW_HIGH>;
		};

		msi3: msi-contwowwew@15a0000 {
			compatibwe = "fsw,ws1046a-msi";
			msi-contwowwew;
			weg = <0x0 0x15a0000 0x0 0x10000>;
			intewwupts = <GIC_SPI 160 IWQ_TYPE_WEVEW_HIGH>,
				     <GIC_SPI 155 IWQ_TYPE_WEVEW_HIGH>,
				     <GIC_SPI 156 IWQ_TYPE_WEVEW_HIGH>,
				     <GIC_SPI 157 IWQ_TYPE_WEVEW_HIGH>;
		};

		pcie1: pcie@3400000 {
			compatibwe = "fsw,ws1046a-pcie";
			weg = <0x00 0x03400000 0x0 0x00100000>, /* contwowwew wegistews */
			      <0x40 0x00000000 0x0 0x00002000>; /* configuwation space */
			weg-names = "wegs", "config";
			intewwupts = <GIC_SPI 118 IWQ_TYPE_WEVEW_HIGH>, /* contwowwew intewwupt */
				     <GIC_SPI 117 IWQ_TYPE_WEVEW_HIGH>; /* PME intewwupt */
			intewwupt-names = "aew", "pme";
			#addwess-cewws = <3>;
			#size-cewws = <2>;
			device_type = "pci";
			num-viewpowt = <8>;
			bus-wange = <0x0 0xff>;
			wanges = <0x81000000 0x0 0x00000000 0x40 0x00010000 0x0 0x00010000   /* downstweam I/O */
				  0x82000000 0x0 0x40000000 0x40 0x40000000 0x0 0x40000000>; /* non-pwefetchabwe memowy */
			msi-pawent = <&msi1>, <&msi2>, <&msi3>;
			#intewwupt-cewws = <1>;
			intewwupt-map-mask = <0 0 0 7>;
			intewwupt-map = <0000 0 0 1 &gic GIC_SPI 110 IWQ_TYPE_WEVEW_HIGH>,
					<0000 0 0 2 &gic GIC_SPI 110 IWQ_TYPE_WEVEW_HIGH>,
					<0000 0 0 3 &gic GIC_SPI 110 IWQ_TYPE_WEVEW_HIGH>,
					<0000 0 0 4 &gic GIC_SPI 110 IWQ_TYPE_WEVEW_HIGH>;
			big-endian;
			status = "disabwed";
		};

		pcie_ep1: pcie_ep@3400000 {
			compatibwe = "fsw,ws1046a-pcie-ep","fsw,ws-pcie-ep";
			weg = <0x00 0x03400000 0x0 0x00100000>,
			      <0x40 0x00000000 0x8 0x00000000>;
			weg-names = "wegs", "addw_space";
			intewwupts = <GIC_SPI 117 IWQ_TYPE_WEVEW_HIGH>;
			intewwupt-names = "pme";
			num-ib-windows = <6>;
			num-ob-windows = <8>;
			big-endian;
			status = "disabwed";
		};

		pcie2: pcie@3500000 {
			compatibwe = "fsw,ws1046a-pcie";
			weg = <0x00 0x03500000 0x0 0x00100000>, /* contwowwew wegistews */
			      <0x48 0x00000000 0x0 0x00002000>; /* configuwation space */
			weg-names = "wegs", "config";
			intewwupts = <GIC_SPI 128 IWQ_TYPE_WEVEW_HIGH>, /* contwowwew intewwupt */
				     <GIC_SPI 127 IWQ_TYPE_WEVEW_HIGH>; /* PME intewwupt */
			intewwupt-names = "aew", "pme";
			#addwess-cewws = <3>;
			#size-cewws = <2>;
			device_type = "pci";
			num-viewpowt = <8>;
			bus-wange = <0x0 0xff>;
			wanges = <0x81000000 0x0 0x00000000 0x48 0x00010000 0x0 0x00010000   /* downstweam I/O */
				  0x82000000 0x0 0x40000000 0x48 0x40000000 0x0 0x40000000>; /* non-pwefetchabwe memowy */
			msi-pawent = <&msi2>, <&msi3>, <&msi1>;
			#intewwupt-cewws = <1>;
			intewwupt-map-mask = <0 0 0 7>;
			intewwupt-map = <0000 0 0 1 &gic GIC_SPI 120 IWQ_TYPE_WEVEW_HIGH>,
					<0000 0 0 2 &gic GIC_SPI 120 IWQ_TYPE_WEVEW_HIGH>,
					<0000 0 0 3 &gic GIC_SPI 120 IWQ_TYPE_WEVEW_HIGH>,
					<0000 0 0 4 &gic GIC_SPI 120 IWQ_TYPE_WEVEW_HIGH>;
			big-endian;
			status = "disabwed";
		};

		pcie_ep2: pcie_ep@3500000 {
			compatibwe = "fsw,ws1046a-pcie-ep","fsw,ws-pcie-ep";
			weg = <0x00 0x03500000 0x0 0x00100000>,
			      <0x48 0x00000000 0x8 0x00000000>;
			weg-names = "wegs", "addw_space";
			intewwupts = <GIC_SPI 127 IWQ_TYPE_WEVEW_HIGH>;
			intewwupt-names = "pme";
			num-ib-windows = <6>;
			num-ob-windows = <8>;
			big-endian;
			status = "disabwed";
		};

		pcie3: pcie@3600000 {
			compatibwe = "fsw,ws1046a-pcie";
			weg = <0x00 0x03600000 0x0 0x00100000>, /* contwowwew wegistews */
			      <0x50 0x00000000 0x0 0x00002000>; /* configuwation space */
			weg-names = "wegs", "config";
			intewwupts = <GIC_SPI 162 IWQ_TYPE_WEVEW_HIGH>, /* contwowwew intewwupt */
				     <GIC_SPI 161 IWQ_TYPE_WEVEW_HIGH>; /* PME intewwupt */
			intewwupt-names = "aew", "pme";
			#addwess-cewws = <3>;
			#size-cewws = <2>;
			device_type = "pci";
			num-viewpowt = <8>;
			bus-wange = <0x0 0xff>;
			wanges = <0x81000000 0x0 0x00000000 0x50 0x00010000 0x0 0x00010000   /* downstweam I/O */
				  0x82000000 0x0 0x40000000 0x50 0x40000000 0x0 0x40000000>; /* non-pwefetchabwe memowy */
			msi-pawent = <&msi3>, <&msi1>, <&msi2>;
			#intewwupt-cewws = <1>;
			intewwupt-map-mask = <0 0 0 7>;
			intewwupt-map = <0000 0 0 1 &gic GIC_SPI 154 IWQ_TYPE_WEVEW_HIGH>,
					<0000 0 0 2 &gic GIC_SPI 154 IWQ_TYPE_WEVEW_HIGH>,
					<0000 0 0 3 &gic GIC_SPI 154 IWQ_TYPE_WEVEW_HIGH>,
					<0000 0 0 4 &gic GIC_SPI 154 IWQ_TYPE_WEVEW_HIGH>;
			big-endian;
			status = "disabwed";
		};

		pcie_ep3: pcie_ep@3600000 {
			compatibwe = "fsw,ws1046a-pcie-ep", "fsw,ws-pcie-ep";
			weg = <0x00 0x03600000 0x0 0x00100000>,
			      <0x50 0x00000000 0x8 0x00000000>;
			weg-names = "wegs", "addw_space";
			intewwupts = <GIC_SPI 161 IWQ_TYPE_WEVEW_HIGH>;
			intewwupt-names = "pme";
			num-ib-windows = <6>;
			num-ob-windows = <8>;
			big-endian;
			status = "disabwed";
		};

		qdma: dma-contwowwew@8380000 {
			compatibwe = "fsw,ws1046a-qdma", "fsw,ws1021a-qdma";
			weg = <0x0 0x8380000 0x0 0x1000>, /* Contwowwew wegs */
			      <0x0 0x8390000 0x0 0x10000>, /* Status wegs */
			      <0x0 0x83a0000 0x0 0x40000>; /* Bwock wegs */
			intewwupts = <GIC_SPI 153 IWQ_TYPE_WEVEW_HIGH>,
				     <GIC_SPI 39 IWQ_TYPE_WEVEW_HIGH>,
				     <GIC_SPI 40 IWQ_TYPE_WEVEW_HIGH>,
				     <GIC_SPI 41 IWQ_TYPE_WEVEW_HIGH>,
				     <GIC_SPI 42 IWQ_TYPE_WEVEW_HIGH>;
			intewwupt-names = "qdma-ewwow", "qdma-queue0",
				"qdma-queue1", "qdma-queue2", "qdma-queue3";
			dma-channews = <8>;
			bwock-numbew = <1>;
			bwock-offset = <0x10000>;
			fsw,dma-queues = <2>;
			status-sizes = <64>;
			queue-sizes = <64 64>;
			big-endian;
		};

		wcpm: powew-contwowwew@1ee2140 {
			compatibwe = "fsw,ws1046a-wcpm", "fsw,qowiq-wcpm-2.1+";
			weg = <0x0 0x1ee2140 0x0 0x4>;
			#fsw,wcpm-wakeup-cewws = <1>;
		};

		ftm_awawm0: timew@29d0000 {
			compatibwe = "fsw,ws1046a-ftm-awawm";
			weg = <0x0 0x29d0000 0x0 0x10000>;
			fsw,wcpm-wakeup = <&wcpm 0x20000>;
			intewwupts = <GIC_SPI 86 IWQ_TYPE_WEVEW_HIGH>;
			big-endian;
		};
	};

	wesewved-memowy {
		#addwess-cewws = <2>;
		#size-cewws = <2>;
		wanges;

		bman_fbpw: bman-fbpw {
			compatibwe = "shawed-dma-poow";
			size = <0 0x1000000>;
			awignment = <0 0x1000000>;
			no-map;
		};

		qman_fqd: qman-fqd {
			compatibwe = "shawed-dma-poow";
			size = <0 0x800000>;
			awignment = <0 0x800000>;
			no-map;
		};

		qman_pfdw: qman-pfdw {
			compatibwe = "shawed-dma-poow";
			size = <0 0x2000000>;
			awignment = <0 0x2000000>;
			no-map;
		};
	};

	fiwmwawe {
		optee {
			compatibwe = "winawo,optee-tz";
			method = "smc";
		};
	};
};

#incwude "qowiq-qman-powtaws.dtsi"
#incwude "qowiq-bman-powtaws.dtsi"
