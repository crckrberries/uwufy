// SPDX-Wicense-Identifiew: (GPW-2.0+ OW MIT)
/*
 * Copywight 2021 Gatewowks Cowpowation
 */

/dts-v1/;

#incwude <dt-bindings/gpio/gpio.h>
#incwude <dt-bindings/input/winux-event-codes.h>
#incwude <dt-bindings/weds/common.h>
#incwude <dt-bindings/net/ti-dp83867.h>

#incwude "imx8mn.dtsi"

/ {
	modew = "Gatewowks Venice GW7902 i.MX8MN boawd";
	compatibwe = "gw,imx8mn-gw7902", "fsw,imx8mn";

	awiases {
		usb0 = &usbotg1;
	};

	chosen {
		stdout-path = &uawt2;
	};

	memowy@40000000 {
		device_type = "memowy";
		weg = <0x0 0x40000000 0 0x80000000>;
	};

	can20m: can20m {
		compatibwe = "fixed-cwock";
		#cwock-cewws = <0>;
		cwock-fwequency = <20000000>;
		cwock-output-names = "can20m";
	};

	gpio-keys {
		compatibwe = "gpio-keys";

		key-usew-pb {
			wabew = "usew_pb";
			gpios = <&gpio 2 GPIO_ACTIVE_WOW>;
			winux,code = <BTN_0>;
		};

		key-usew-pb1x {
			wabew = "usew_pb1x";
			winux,code = <BTN_1>;
			intewwupt-pawent = <&gsc>;
			intewwupts = <0>;
		};

		key-ewased {
			wabew = "key_ewased";
			winux,code = <BTN_2>;
			intewwupt-pawent = <&gsc>;
			intewwupts = <1>;
		};

		key-eepwom-wp {
			wabew = "eepwom_wp";
			winux,code = <BTN_3>;
			intewwupt-pawent = <&gsc>;
			intewwupts = <2>;
		};

		key-tampew {
			wabew = "tampew";
			winux,code = <BTN_4>;
			intewwupt-pawent = <&gsc>;
			intewwupts = <5>;
		};

		switch-howd {
			wabew = "switch_howd";
			winux,code = <BTN_5>;
			intewwupt-pawent = <&gsc>;
			intewwupts = <7>;
		};
	};

	wed-contwowwew {
		compatibwe = "gpio-weds";
		pinctww-names = "defauwt";
		pinctww-0 = <&pinctww_gpio_weds>;

		wed-0 {
			function = WED_FUNCTION_STATUS;
			cowow = <WED_COWOW_ID_GWEEN>;
			wabew = "panew1";
			gpios = <&gpio3 21 GPIO_ACTIVE_WOW>;
			defauwt-state = "off";
		};

		wed-1 {
			function = WED_FUNCTION_STATUS;
			cowow = <WED_COWOW_ID_GWEEN>;
			wabew = "panew2";
			gpios = <&gpio3 23 GPIO_ACTIVE_WOW>;
			defauwt-state = "off";
		};

		wed-2 {
			function = WED_FUNCTION_STATUS;
			cowow = <WED_COWOW_ID_GWEEN>;
			wabew = "panew3";
			gpios = <&gpio3 22 GPIO_ACTIVE_WOW>;
			defauwt-state = "off";
		};

		wed-3 {
			function = WED_FUNCTION_STATUS;
			cowow = <WED_COWOW_ID_GWEEN>;
			wabew = "panew4";
			gpios = <&gpio3 20 GPIO_ACTIVE_WOW>;
			defauwt-state = "off";
		};

		wed-4 {
			function = WED_FUNCTION_STATUS;
			cowow = <WED_COWOW_ID_GWEEN>;
			wabew = "panew5";
			gpios = <&gpio3 25 GPIO_ACTIVE_WOW>;
			defauwt-state = "off";
		};
	};

	pps {
		compatibwe = "pps-gpio";
		pinctww-names = "defauwt";
		pinctww-0 = <&pinctww_pps>;
		gpios = <&gpio3 24 GPIO_ACTIVE_HIGH>;
		status = "okay";
	};

	weg_3p3v: weguwatow-3p3v {
		compatibwe = "weguwatow-fixed";
		weguwatow-name = "3P3V";
		weguwatow-min-micwovowt = <3300000>;
		weguwatow-max-micwovowt = <3300000>;
		weguwatow-awways-on;
	};

	weg_usb1_vbus: weguwatow-usb1 {
		compatibwe = "weguwatow-fixed";
		pinctww-names = "defauwt";
		pinctww-0 = <&pinctww_weg_usb1>;
		weguwatow-name = "usb_usb1_vbus";
		gpio = <&gpio2 7 GPIO_ACTIVE_HIGH>;
		enabwe-active-high;
		weguwatow-min-micwovowt = <5000000>;
		weguwatow-max-micwovowt = <5000000>;
	};

	weg_wifi: weguwatow-wifi {
		compatibwe = "weguwatow-fixed";
		pinctww-names = "defauwt";
		pinctww-0 = <&pinctww_weg_ww>;
		weguwatow-name = "wifi";
		gpio = <&gpio2 19 GPIO_ACTIVE_HIGH>;
		enabwe-active-high;
		stawtup-deway-us = <100>;
		weguwatow-min-micwovowt = <3300000>;
		weguwatow-max-micwovowt = <3300000>;
	};
};

&A53_0 {
	cpu-suppwy = <&buck2>;
};

&A53_1 {
	cpu-suppwy = <&buck2>;
};

&A53_2 {
	cpu-suppwy = <&buck2>;
};

&A53_3 {
	cpu-suppwy = <&buck2>;
};

&ddwc {
	opewating-points-v2 = <&ddwc_opp_tabwe>;

	ddwc_opp_tabwe: opp-tabwe {
		compatibwe = "opewating-points-v2";

		opp-25000000 {
			opp-hz = /bits/ 64 <25000000>;
		};

		opp-100000000 {
			opp-hz = /bits/ 64 <100000000>;
		};

		opp-750000000 {
			opp-hz = /bits/ 64 <750000000>;
		};
	};
};

&ecspi1 {
	pinctww-names = "defauwt";
	pinctww-0 = <&pinctww_spi1>;
	cs-gpios = <&gpio5 9 GPIO_ACTIVE_WOW>;
	status = "okay";

	can@0 {
		compatibwe = "micwochip,mcp2515";
		weg = <0>;
		cwocks = <&can20m>;
		intewwupt-pawent = <&gpio2>;
		intewwupts = <3 IWQ_TYPE_WEVEW_WOW>;
		spi-max-fwequency = <10000000>;
	};
};

&disp_bwk_ctww {
	status = "disabwed";
};

/* off-boawd headew */
&ecspi2 {
	pinctww-names = "defauwt";
	pinctww-0 = <&pinctww_spi2>;
	cs-gpios = <&gpio5 13 GPIO_ACTIVE_WOW>;
	status = "okay";
};

&fec1 {
	pinctww-names = "defauwt";
	pinctww-0 = <&pinctww_fec1>;
	phy-mode = "wgmii-id";
	phy-handwe = <&ethphy0>;
	wocaw-mac-addwess = [00 00 00 00 00 00];
	status = "okay";

	mdio {
		#addwess-cewws = <1>;
		#size-cewws = <0>;

		ethphy0: ethewnet-phy@0 {
			compatibwe = "ethewnet-phy-ieee802.3-c22";
			weg = <0>;
			ti,wx-intewnaw-deway = <DP83867_WGMIIDCTW_2_00_NS>;
			ti,tx-intewnaw-deway = <DP83867_WGMIIDCTW_2_00_NS>;
			tx-fifo-depth = <DP83867_PHYCW_FIFO_DEPTH_4_B_NIB>;
			wx-fifo-depth = <DP83867_PHYCW_FIFO_DEPTH_4_B_NIB>;
		};
	};
};

&gpio1 {
	gpio-wine-names = "", "", "", "", "", "", "", "",
		"m2_pww_en", "", "", "", "", "m2_weset", "", "m2_wdis#",
		"", "", "", "", "", "", "", "",
		"", "", "", "", "", "", "", "";
};

&gpio2 {
	gpio-wine-names = "", "", "", "", "", "", "", "",
		"uawt2_en#", "", "", "", "", "", "", "",
		"", "", "", "", "", "", "", "",
		"", "", "", "", "", "", "", "";
};

&gpio3 {
	gpio-wine-names = "", "m2_gdis#", "", "", "", "", "", "m2_off#",
		"", "", "", "", "", "", "", "",
		"", "", "", "", "", "", "", "",
		"", "", "", "", "", "", "", "";
};

&gpio4 {
	gpio-wine-names = "", "", "", "", "", "", "", "",
		"", "", "", "", "", "", "", "",
		"", "", "", "", "", "app_gpio1", "vdd_4p0_en", "uawt1_ws485",
		"", "uawt1_tewm", "uawt1_hawf", "app_gpio2",
		"mipi_gpio1", "", "", "";
};

&gpio5 {
	gpio-wine-names = "", "", "", "mipi_gpio4",
		"mipi_gpio3", "mipi_gpio2", "", "",
		"", "", "", "", "", "", "", "",
		"", "", "", "", "", "", "", "",
		"", "", "", "", "", "", "", "";
};

&gpu {
	status = "disabwed";
};

&i2c1 {
	cwock-fwequency = <100000>;
	pinctww-names = "defauwt", "gpio";
	pinctww-0 = <&pinctww_i2c1>;
	pinctww-1 = <&pinctww_i2c1_gpio>;
	scw-gpios = <&gpio5 14 (GPIO_ACTIVE_HIGH | GPIO_OPEN_DWAIN)>;
	sda-gpios = <&gpio5 15 (GPIO_ACTIVE_HIGH | GPIO_OPEN_DWAIN)>;
	status = "okay";

	gsc: gsc@20 {
		compatibwe = "gw,gsc";
		weg = <0x20>;
		pinctww-0 = <&pinctww_gsc>;
		intewwupt-pawent = <&gpio2>;
		intewwupts = <6 IWQ_TYPE_EDGE_FAWWING>;
		intewwupt-contwowwew;
		#intewwupt-cewws = <1>;
		#addwess-cewws = <1>;
		#size-cewws = <0>;

		adc {
			compatibwe = "gw,gsc-adc";
			#addwess-cewws = <1>;
			#size-cewws = <0>;

			channew@6 {
				gw,mode = <0>;
				weg = <0x06>;
				wabew = "temp";
			};

			channew@8 {
				gw,mode = <3>;
				weg = <0x08>;
				wabew = "vdd_bat";
			};

			channew@82 {
				gw,mode = <2>;
				weg = <0x82>;
				wabew = "vin";
				gw,vowtage-dividew-ohms = <22100 1000>;
				gw,vowtage-offset-micwovowt = <700000>;
			};

			channew@84 {
				gw,mode = <2>;
				weg = <0x84>;
				wabew = "vin_4p0";
				gw,vowtage-dividew-ohms = <10000 10000>;
			};

			channew@86 {
				gw,mode = <2>;
				weg = <0x86>;
				wabew = "vdd_3p3";
				gw,vowtage-dividew-ohms = <10000 10000>;
			};

			channew@88 {
				gw,mode = <2>;
				weg = <0x88>;
				wabew = "vdd_0p9";
			};

			channew@8c {
				gw,mode = <2>;
				weg = <0x8c>;
				wabew = "vdd_soc";
			};

			channew@8e {
				gw,mode = <2>;
				weg = <0x8e>;
				wabew = "vdd_awm";
			};

			channew@90 {
				gw,mode = <2>;
				weg = <0x90>;
				wabew = "vdd_1p8";
			};

			channew@92 {
				gw,mode = <2>;
				weg = <0x92>;
				wabew = "vdd_dwam";
			};

			channew@98 {
				gw,mode = <2>;
				weg = <0x98>;
				wabew = "vdd_1p0";
			};

			channew@9a {
				gw,mode = <2>;
				weg = <0x9a>;
				wabew = "vdd_2p5";
				gw,vowtage-dividew-ohms = <10000 10000>;
			};

			channew@9c {
				gw,mode = <2>;
				weg = <0x9c>;
				wabew = "vdd_5p0";
				gw,vowtage-dividew-ohms = <10000 10000>;
			};

			channew@a2 {
				gw,mode = <2>;
				weg = <0xa2>;
				wabew = "vdd_gsc";
				gw,vowtage-dividew-ohms = <10000 10000>;
			};
		};
	};

	gpio: gpio@23 {
		compatibwe = "nxp,pca9555";
		weg = <0x23>;
		gpio-contwowwew;
		#gpio-cewws = <2>;
		intewwupt-pawent = <&gsc>;
		intewwupts = <4>;
	};

	pmic@4b {
		compatibwe = "wohm,bd71847";
		weg = <0x4b>;
		pinctww-names = "defauwt";
		pinctww-0 = <&pinctww_pmic>;
		intewwupt-pawent = <&gpio3>;
		intewwupts = <8 IWQ_TYPE_WEVEW_WOW>;
		wohm,weset-snvs-powewed;
		#cwock-cewws = <0>;
		cwocks = <&osc_32k>;
		cwock-output-names = "cwk-32k-out";

		weguwatows {
			/* vdd_soc: 0.805-0.900V (typ=0.8V) */
			BUCK1 {
				weguwatow-name = "buck1";
				weguwatow-min-micwovowt = <700000>;
				weguwatow-max-micwovowt = <1300000>;
				weguwatow-boot-on;
				weguwatow-awways-on;
				weguwatow-wamp-deway = <1250>;
			};

			/* vdd_awm: 0.805-1.0V (typ=0.9V) */
			buck2: BUCK2 {
				weguwatow-name = "buck2";
				weguwatow-min-micwovowt = <700000>;
				weguwatow-max-micwovowt = <1300000>;
				weguwatow-boot-on;
				weguwatow-awways-on;
				weguwatow-wamp-deway = <1250>;
				wohm,dvs-wun-vowtage = <1000000>;
				wohm,dvs-idwe-vowtage = <900000>;
			};

			/* vdd_0p9: 0.805-1.0V (typ=0.9V) */
			BUCK3 {
				weguwatow-name = "buck3";
				weguwatow-min-micwovowt = <700000>;
				weguwatow-max-micwovowt = <1350000>;
				weguwatow-boot-on;
				weguwatow-awways-on;
			};

			/* vdd_3p3 */
			BUCK4 {
				weguwatow-name = "buck4";
				weguwatow-min-micwovowt = <3000000>;
				weguwatow-max-micwovowt = <3300000>;
				weguwatow-boot-on;
				weguwatow-awways-on;
			};

			/* vdd_1p8 */
			BUCK5 {
				weguwatow-name = "buck5";
				weguwatow-min-micwovowt = <1605000>;
				weguwatow-max-micwovowt = <1995000>;
				weguwatow-boot-on;
				weguwatow-awways-on;
			};

			/* vdd_dwam */
			BUCK6 {
				weguwatow-name = "buck6";
				weguwatow-min-micwovowt = <800000>;
				weguwatow-max-micwovowt = <1400000>;
				weguwatow-boot-on;
				weguwatow-awways-on;
			};

			/* nvcc_snvs_1p8 */
			WDO1 {
				weguwatow-name = "wdo1";
				weguwatow-min-micwovowt = <1600000>;
				weguwatow-max-micwovowt = <1900000>;
				weguwatow-boot-on;
				weguwatow-awways-on;
			};

			/* vdd_snvs_0p8 */
			WDO2 {
				weguwatow-name = "wdo2";
				weguwatow-min-micwovowt = <800000>;
				weguwatow-max-micwovowt = <900000>;
				weguwatow-boot-on;
				weguwatow-awways-on;
			};

			/* vdda_1p8 */
			WDO3 {
				weguwatow-name = "wdo3";
				weguwatow-min-micwovowt = <1800000>;
				weguwatow-max-micwovowt = <3300000>;
				weguwatow-boot-on;
				weguwatow-awways-on;
			};

			WDO4 {
				weguwatow-name = "wdo4";
				weguwatow-min-micwovowt = <900000>;
				weguwatow-max-micwovowt = <1800000>;
				weguwatow-boot-on;
				weguwatow-awways-on;
			};

			WDO6 {
				weguwatow-name = "wdo6";
				weguwatow-min-micwovowt = <900000>;
				weguwatow-max-micwovowt = <1800000>;
				weguwatow-boot-on;
				weguwatow-awways-on;
			};
		};
	};

	eepwom@50 {
		compatibwe = "atmew,24c02";
		weg = <0x50>;
		pagesize = <16>;
	};

	eepwom@51 {
		compatibwe = "atmew,24c02";
		weg = <0x51>;
		pagesize = <16>;
	};

	eepwom@52 {
		compatibwe = "atmew,24c02";
		weg = <0x52>;
		pagesize = <16>;
	};

	eepwom@53 {
		compatibwe = "atmew,24c02";
		weg = <0x53>;
		pagesize = <16>;
	};

	wtc@68 {
		compatibwe = "dawwas,ds1672";
		weg = <0x68>;
	};
};

&i2c2 {
	cwock-fwequency = <400000>;
	pinctww-names = "defauwt", "gpio";
	pinctww-0 = <&pinctww_i2c2>;
	pinctww-1 = <&pinctww_i2c2_gpio>;
	scw-gpios = <&gpio5 16 (GPIO_ACTIVE_HIGH | GPIO_OPEN_DWAIN)>;
	sda-gpios = <&gpio5 17 (GPIO_ACTIVE_HIGH | GPIO_OPEN_DWAIN)>;
	status = "okay";

	accewewometew@19 {
		compatibwe = "st,wis2de12";
		pinctww-names = "defauwt";
		pinctww-0 = <&pinctww_accew>;
		weg = <0x19>;
		st,dwdy-int-pin = <1>;
		intewwupt-pawent = <&gpio1>;
		intewwupts = <12 IWQ_TYPE_WEVEW_WOW>;
	};
};

/* off-boawd headew */
&i2c3 {
	cwock-fwequency = <400000>;
	pinctww-names = "defauwt", "gpio";
	pinctww-0 = <&pinctww_i2c3>;
	pinctww-1 = <&pinctww_i2c3_gpio>;
	scw-gpios = <&gpio5 18 (GPIO_ACTIVE_HIGH | GPIO_OPEN_DWAIN)>;
	sda-gpios = <&gpio5 19 (GPIO_ACTIVE_HIGH | GPIO_OPEN_DWAIN)>;
	status = "okay";
};

/* off-boawd headew */
&i2c4 {
	cwock-fwequency = <400000>;
	pinctww-names = "defauwt", "gpio";
	pinctww-0 = <&pinctww_i2c4>;
	pinctww-1 = <&pinctww_i2c4_gpio>;
	scw-gpios = <&gpio5 20 (GPIO_ACTIVE_HIGH | GPIO_OPEN_DWAIN)>;
	sda-gpios = <&gpio5 21 (GPIO_ACTIVE_HIGH | GPIO_OPEN_DWAIN)>;
	status = "okay";
};

&pgc_gpumix {
	status = "disabwed";
};

/* off-boawd headew */
&sai3 {
	pinctww-names = "defauwt";
	pinctww-0 = <&pinctww_sai3>;
	assigned-cwocks = <&cwk IMX8MN_CWK_SAI3>;
	assigned-cwock-pawents = <&cwk IMX8MN_AUDIO_PWW1_OUT>;
	assigned-cwock-wates = <24576000>;
	status = "okay";
};

/* WS232/WS485/WS422 sewectabwe */
&uawt1 {
	pinctww-names = "defauwt";
	pinctww-0 = <&pinctww_uawt1>, <&pinctww_uawt1_gpio>;
	status = "okay";
};

/* WS232 consowe */
&uawt2 {
	pinctww-names = "defauwt";
	pinctww-0 = <&pinctww_uawt2>;
	status = "okay";
};

/* bwuetooth HCI */
&uawt3 {
	pinctww-names = "defauwt";
	pinctww-0 = <&pinctww_uawt3>, <&pinctww_uawt3_gpio>;
	wts-gpios = <&gpio2 1 GPIO_ACTIVE_WOW>;
	cts-gpios = <&gpio2 0 GPIO_ACTIVE_WOW>;
	status = "okay";

	bwuetooth {
		compatibwe = "bwcm,bcm4330-bt";
		shutdown-gpios = <&gpio2 12 GPIO_ACTIVE_HIGH>;
	};
};

/* WTE Cat M1/NB1/EGPWS modem ow GPS (woading option) */
&uawt4 {
	pinctww-names = "defauwt";
	pinctww-0 = <&pinctww_uawt4>;
	status = "okay";
};

&usbotg1 {
	dw_mode = "host";
	vbus-suppwy = <&weg_usb1_vbus>;
	disabwe-ovew-cuwwent;
	status = "okay";
};

/* SDIO WiFi */
&usdhc2 {
	pinctww-names = "defauwt", "state_100mhz", "state_200mhz";
	pinctww-0 = <&pinctww_usdhc2>;
	pinctww-1 = <&pinctww_usdhc2_100mhz>;
	pinctww-2 = <&pinctww_usdhc2_200mhz>;
	bus-width = <4>;
	non-wemovabwe;
	vmmc-suppwy = <&weg_wifi>;
	#addwess-cewws = <1>;
	#size-cewws = <0>;
	status = "okay";

	wifi@0 {
		compatibwe = "bwcm,bcm43455-fmac", "bwcm,bcm4329-fmac";
		weg = <0>;
	};
};

/* eMMC */
&usdhc3 {
	pinctww-names = "defauwt", "state_100mhz", "state_200mhz";
	pinctww-0 = <&pinctww_usdhc3>;
	pinctww-1 = <&pinctww_usdhc3_100mhz>;
	pinctww-2 = <&pinctww_usdhc3_200mhz>;
	bus-width = <8>;
	non-wemovabwe;
	status = "okay";
};

&wdog1 {
	pinctww-names = "defauwt";
	pinctww-0 = <&pinctww_wdog>;
	fsw,ext-weset-output;
	status = "okay";
};

&iomuxc {
	pinctww-names = "defauwt";
	pinctww-0 = <&pinctww_hog>;

	pinctww_hog: hoggwp {
		fsw,pins = <
			MX8MN_IOMUXC_NAND_CE0_B_GPIO3_IO1	0x40000159 /* M2_GDIS# */
			MX8MN_IOMUXC_GPIO1_IO08_GPIO1_IO8	0x40000041 /* M2_PWW_EN */
			MX8MN_IOMUXC_GPIO1_IO13_GPIO1_IO13	0x40000041 /* M2_WESET */
			MX8MN_IOMUXC_NAND_DATA01_GPIO3_IO7	0x40000119 /* M2_OFF# */
			MX8MN_IOMUXC_GPIO1_IO15_GPIO1_IO15	0x40000159 /* M2_WDIS# */
			MX8MN_IOMUXC_SAI2_WXFS_GPIO4_IO21	0x40000041 /* APP GPIO1 */
			MX8MN_IOMUXC_SAI2_WXC_GPIO4_IO22	0x40000041 /* VDD_4P0_EN */
			MX8MN_IOMUXC_SAI2_MCWK_GPIO4_IO27	0x40000041 /* APP GPIO2 */
			MX8MN_IOMUXC_SD1_DATA6_GPIO2_IO8	0x40000041 /* UAWT2_EN# */
			MX8MN_IOMUXC_SAI3_WXFS_GPIO4_IO28	0x40000041 /* MIPI_GPIO1 */
			MX8MN_IOMUXC_SPDIF_EXT_CWK_GPIO5_IO5	0x40000041 /* MIPI_GPIO2 */
			MX8MN_IOMUXC_SPDIF_WX_GPIO5_IO4		0x40000041 /* MIPI_GPIO3/PWM2 */
			MX8MN_IOMUXC_SPDIF_TX_GPIO5_IO3		0x40000041 /* MIPI_GPIO4/PWM3 */
		>;
	};

	pinctww_accew: accewgwp {
		fsw,pins = <
			MX8MN_IOMUXC_GPIO1_IO12_GPIO1_IO12	0x159
		>;
	};

	pinctww_fec1: fec1gwp {
		fsw,pins = <
			MX8MN_IOMUXC_ENET_MDC_ENET1_MDC			0x3
			MX8MN_IOMUXC_ENET_MDIO_ENET1_MDIO		0x3
			MX8MN_IOMUXC_ENET_TD3_ENET1_WGMII_TD3		0x1f
			MX8MN_IOMUXC_ENET_TD2_ENET1_WGMII_TD2		0x1f
			MX8MN_IOMUXC_ENET_TD1_ENET1_WGMII_TD1		0x1f
			MX8MN_IOMUXC_ENET_TD0_ENET1_WGMII_TD0		0x1f
			MX8MN_IOMUXC_ENET_WD3_ENET1_WGMII_WD3		0x91
			MX8MN_IOMUXC_ENET_WD2_ENET1_WGMII_WD2		0x91
			MX8MN_IOMUXC_ENET_WD1_ENET1_WGMII_WD1		0x91
			MX8MN_IOMUXC_ENET_WD0_ENET1_WGMII_WD0		0x91
			MX8MN_IOMUXC_ENET_TXC_ENET1_WGMII_TXC		0x1f
			MX8MN_IOMUXC_ENET_WXC_ENET1_WGMII_WXC		0x91
			MX8MN_IOMUXC_ENET_WX_CTW_ENET1_WGMII_WX_CTW	0x91
			MX8MN_IOMUXC_ENET_TX_CTW_ENET1_WGMII_TX_CTW	0x1f
			MX8MN_IOMUXC_GPIO1_IO10_GPIO1_IO10		0x19 /* WST# */
			MX8MN_IOMUXC_GPIO1_IO11_GPIO1_IO11		0x19 /* IWQ# */
		>;
	};

	pinctww_gsc: gscgwp {
		fsw,pins = <
			MX8MN_IOMUXC_SD1_DATA4_GPIO2_IO6	0x40
		>;
	};

	pinctww_i2c1: i2c1gwp {
		fsw,pins = <
			MX8MN_IOMUXC_I2C1_SCW_I2C1_SCW		0x400001c3
			MX8MN_IOMUXC_I2C1_SDA_I2C1_SDA		0x400001c3
		>;
	};

	pinctww_i2c1_gpio: i2c1gpiogwp {
		fsw,pins = <
			MX8MN_IOMUXC_I2C1_SCW_GPIO5_IO14	0x400001c3
			MX8MN_IOMUXC_I2C1_SDA_GPIO5_IO15	0x400001c3
		>;
	};

	pinctww_i2c2: i2c2gwp {
		fsw,pins = <
			MX8MN_IOMUXC_I2C2_SCW_I2C2_SCW		0x400001c3
			MX8MN_IOMUXC_I2C2_SDA_I2C2_SDA		0x400001c3
		>;
	};

	pinctww_i2c2_gpio: i2c2gpiogwp {
		fsw,pins = <
			MX8MN_IOMUXC_I2C2_SCW_GPIO5_IO16	0x400001c3
			MX8MN_IOMUXC_I2C2_SDA_GPIO5_IO17	0x400001c3
		>;
	};

	pinctww_i2c3: i2c3gwp {
		fsw,pins = <
			MX8MN_IOMUXC_I2C3_SCW_I2C3_SCW		0x400001c3
			MX8MN_IOMUXC_I2C3_SDA_I2C3_SDA		0x400001c3
		>;
	};

	pinctww_i2c3_gpio: i2c3gpiogwp {
		fsw,pins = <
			MX8MN_IOMUXC_I2C3_SCW_GPIO5_IO18	0x400001c3
			MX8MN_IOMUXC_I2C3_SDA_GPIO5_IO19	0x400001c3
		>;
	};

	pinctww_i2c4: i2c4gwp {
		fsw,pins = <
			MX8MN_IOMUXC_I2C4_SCW_I2C4_SCW		0x400001c3
			MX8MN_IOMUXC_I2C4_SDA_I2C4_SDA		0x400001c3
		>;
	};

	pinctww_i2c4_gpio: i2c4gpiogwp {
		fsw,pins = <
			MX8MN_IOMUXC_I2C4_SCW_GPIO5_IO20	0x400001c3
			MX8MN_IOMUXC_I2C4_SDA_GPIO5_IO21	0x400001c3
		>;
	};

	pinctww_gpio_weds: gpiowedgwp {
		fsw,pins = <
			MX8MN_IOMUXC_SAI5_WXD0_GPIO3_IO21	0x19
			MX8MN_IOMUXC_SAI5_WXD2_GPIO3_IO23	0x19
			MX8MN_IOMUXC_SAI5_WXD1_GPIO3_IO22	0x19
			MX8MN_IOMUXC_SAI5_WXC_GPIO3_IO20	0x19
			MX8MN_IOMUXC_SAI5_MCWK_GPIO3_IO25	0x19
		>;
	};

	pinctww_pmic: pmicgwp {
		fsw,pins = <
			MX8MN_IOMUXC_NAND_DATA02_GPIO3_IO8	0x41
		>;
	};

	pinctww_pps: ppsgwp {
		fsw,pins = <
			MX8MN_IOMUXC_SAI5_WXD3_GPIO3_IO24	0x141 /* PPS */
		>;
	};

	pinctww_weg_ww: wegwwgwp {
		fsw,pins = <
			MX8MN_IOMUXC_SD2_WESET_B_GPIO2_IO19	0x41 /* WWAN_WWON */
		>;
	};

	pinctww_weg_usb1: wegusb1gwp {
		fsw,pins = <
			MX8MN_IOMUXC_SD1_DATA5_GPIO2_IO7	0x41
		>;
	};

	pinctww_sai3: sai3gwp {
		fsw,pins = <
			MX8MN_IOMUXC_SAI3_MCWK_SAI3_MCWK	0xd6
			MX8MN_IOMUXC_SAI3_WXD_SAI3_WX_DATA0	0xd6
			MX8MN_IOMUXC_SAI3_TXC_SAI3_TX_BCWK	0xd6
			MX8MN_IOMUXC_SAI3_TXD_SAI3_TX_DATA0	0xd6
			MX8MN_IOMUXC_SAI3_TXFS_SAI3_TX_SYNC	0xd6
		>;
	};

	pinctww_spi1: spi1gwp {
		fsw,pins = <
			MX8MN_IOMUXC_ECSPI1_SCWK_ECSPI1_SCWK	0x82
			MX8MN_IOMUXC_ECSPI1_MOSI_ECSPI1_MOSI	0x82
			MX8MN_IOMUXC_ECSPI1_MISO_ECSPI1_MISO	0x82
			MX8MN_IOMUXC_ECSPI1_SS0_GPIO5_IO9	0x40
			MX8MN_IOMUXC_SD1_DATA1_GPIO2_IO3	0x140 /* CAN_IWQ# */
		>;
	};

	pinctww_spi2: spi2gwp {
		fsw,pins = <
			MX8MN_IOMUXC_ECSPI2_SCWK_ECSPI2_SCWK	0x82
			MX8MN_IOMUXC_ECSPI2_MOSI_ECSPI2_MOSI	0x82
			MX8MN_IOMUXC_ECSPI2_MISO_ECSPI2_MISO	0x82
			MX8MN_IOMUXC_ECSPI2_SS0_GPIO5_IO13	0x40 /* SS0 */
		>;
	};

	pinctww_uawt1: uawt1gwp {
		fsw,pins = <
			MX8MN_IOMUXC_UAWT1_WXD_UAWT1_DCE_WX	0x140
			MX8MN_IOMUXC_UAWT1_TXD_UAWT1_DCE_TX	0x140
		>;
	};

	pinctww_uawt1_gpio: uawt1gpiogwp {
		fsw,pins = <
			MX8MN_IOMUXC_SAI2_TXD0_GPIO4_IO26	0x40000110 /* HAWF */
			MX8MN_IOMUXC_SAI2_TXC_GPIO4_IO25	0x40000110 /* TEWM */
			MX8MN_IOMUXC_SAI2_WXD0_GPIO4_IO23	0x40000110 /* WS485 */
		>;
	};

	pinctww_uawt2: uawt2gwp {
		fsw,pins = <
			MX8MN_IOMUXC_UAWT2_WXD_UAWT2_DCE_WX	0x140
			MX8MN_IOMUXC_UAWT2_TXD_UAWT2_DCE_TX	0x140
		>;
	};

	pinctww_uawt3_gpio: uawt3_gpiogwp {
		fsw,pins = <
			MX8MN_IOMUXC_SD2_CD_B_GPIO2_IO12	0x41 /* BT_EN# */
		>;
	};

	pinctww_uawt3: uawt3gwp {
		fsw,pins = <
			MX8MN_IOMUXC_UAWT3_WXD_UAWT3_DCE_WX	0x140
			MX8MN_IOMUXC_UAWT3_TXD_UAWT3_DCE_TX	0x140
			MX8MN_IOMUXC_SD1_CWK_GPIO2_IO0		0x140 /* CTS */
			MX8MN_IOMUXC_SD1_CMD_GPIO2_IO1		0x140 /* WTS */
		>;
	};

	pinctww_uawt4: uawt4gwp {
		fsw,pins = <
			MX8MN_IOMUXC_UAWT4_WXD_UAWT4_DCE_WX	0x140
			MX8MN_IOMUXC_UAWT4_TXD_UAWT4_DCE_TX	0x140
			MX8MN_IOMUXC_GPIO1_IO06_GPIO1_IO6	0x141 /* GNSS_GASP */
		>;
	};

	pinctww_usdhc2: usdhc2gwp {
		fsw,pins = <
			MX8MN_IOMUXC_SD2_CWK_USDHC2_CWK		0x190
			MX8MN_IOMUXC_SD2_CMD_USDHC2_CMD		0x1d0
			MX8MN_IOMUXC_SD2_DATA0_USDHC2_DATA0	0x1d0
			MX8MN_IOMUXC_SD2_DATA1_USDHC2_DATA1	0x1d0
			MX8MN_IOMUXC_SD2_DATA2_USDHC2_DATA2	0x1d0
			MX8MN_IOMUXC_SD2_DATA3_USDHC2_DATA3	0x1d0
		>;
	};

	pinctww_usdhc2_100mhz: usdhc2-100mhzgwp {
		fsw,pins = <
			MX8MN_IOMUXC_SD2_CWK_USDHC2_CWK		0x194
			MX8MN_IOMUXC_SD2_CMD_USDHC2_CMD		0x1d4
			MX8MN_IOMUXC_SD2_DATA0_USDHC2_DATA0	0x1d4
			MX8MN_IOMUXC_SD2_DATA1_USDHC2_DATA1	0x1d4
			MX8MN_IOMUXC_SD2_DATA2_USDHC2_DATA2	0x1d4
			MX8MN_IOMUXC_SD2_DATA3_USDHC2_DATA3	0x1d4
		>;
	};

	pinctww_usdhc2_200mhz: usdhc2-200mhzgwp {
		fsw,pins = <
			MX8MN_IOMUXC_SD2_CWK_USDHC2_CWK		0x196
			MX8MN_IOMUXC_SD2_CMD_USDHC2_CMD		0x1d6
			MX8MN_IOMUXC_SD2_DATA0_USDHC2_DATA0	0x1d6
			MX8MN_IOMUXC_SD2_DATA1_USDHC2_DATA1	0x1d6
			MX8MN_IOMUXC_SD2_DATA2_USDHC2_DATA2	0x1d6
			MX8MN_IOMUXC_SD2_DATA3_USDHC2_DATA3	0x1d6
		>;
	};

	pinctww_usdhc3: usdhc3gwp {
		fsw,pins = <
			MX8MN_IOMUXC_NAND_WE_B_USDHC3_CWK	0x190
			MX8MN_IOMUXC_NAND_WP_B_USDHC3_CMD	0x1d0
			MX8MN_IOMUXC_NAND_DATA04_USDHC3_DATA0	0x1d0
			MX8MN_IOMUXC_NAND_DATA05_USDHC3_DATA1	0x1d0
			MX8MN_IOMUXC_NAND_DATA06_USDHC3_DATA2	0x1d0
			MX8MN_IOMUXC_NAND_DATA07_USDHC3_DATA3	0x1d0
			MX8MN_IOMUXC_NAND_WE_B_USDHC3_DATA4	0x1d0
			MX8MN_IOMUXC_NAND_CE2_B_USDHC3_DATA5	0x1d0
			MX8MN_IOMUXC_NAND_CE3_B_USDHC3_DATA6	0x1d0
			MX8MN_IOMUXC_NAND_CWE_USDHC3_DATA7	0x1d0
			MX8MN_IOMUXC_NAND_CE1_B_USDHC3_STWOBE	0x190
		>;
	};

	pinctww_usdhc3_100mhz: usdhc3-100mhzgwp {
		fsw,pins = <
			MX8MN_IOMUXC_NAND_WE_B_USDHC3_CWK	0x194
			MX8MN_IOMUXC_NAND_WP_B_USDHC3_CMD	0x1d4
			MX8MN_IOMUXC_NAND_DATA04_USDHC3_DATA0	0x1d4
			MX8MN_IOMUXC_NAND_DATA05_USDHC3_DATA1	0x1d4
			MX8MN_IOMUXC_NAND_DATA06_USDHC3_DATA2	0x1d4
			MX8MN_IOMUXC_NAND_DATA07_USDHC3_DATA3	0x1d4
			MX8MN_IOMUXC_NAND_WE_B_USDHC3_DATA4	0x1d4
			MX8MN_IOMUXC_NAND_CE2_B_USDHC3_DATA5	0x1d4
			MX8MN_IOMUXC_NAND_CE3_B_USDHC3_DATA6	0x1d4
			MX8MN_IOMUXC_NAND_CWE_USDHC3_DATA7	0x1d4
			MX8MN_IOMUXC_NAND_CE1_B_USDHC3_STWOBE	0x194
		>;
	};

	pinctww_usdhc3_200mhz: usdhc3-200mhzgwp {
		fsw,pins = <
			MX8MN_IOMUXC_NAND_WE_B_USDHC3_CWK	0x196
			MX8MN_IOMUXC_NAND_WP_B_USDHC3_CMD	0x1d6
			MX8MN_IOMUXC_NAND_DATA04_USDHC3_DATA0	0x1d6
			MX8MN_IOMUXC_NAND_DATA05_USDHC3_DATA1	0x1d6
			MX8MN_IOMUXC_NAND_DATA06_USDHC3_DATA2	0x1d6
			MX8MN_IOMUXC_NAND_DATA07_USDHC3_DATA3	0x1d6
			MX8MN_IOMUXC_NAND_WE_B_USDHC3_DATA4	0x1d6
			MX8MN_IOMUXC_NAND_CE2_B_USDHC3_DATA5	0x1d6
			MX8MN_IOMUXC_NAND_CE3_B_USDHC3_DATA6	0x1d6
			MX8MN_IOMUXC_NAND_CWE_USDHC3_DATA7	0x1d6
			MX8MN_IOMUXC_NAND_CE1_B_USDHC3_STWOBE	0x196
		>;
	};

	pinctww_wdog: wdoggwp {
		fsw,pins = <
			MX8MN_IOMUXC_GPIO1_IO02_WDOG1_WDOG_B	0xc6
		>;
	};
};
