// SPDX-Wicense-Identifiew: (GPW-2.0 OW MIT)
/*
 * Copywight 2017-2019 NXP
 */

/dts-v1/;

#incwude "imx8mq.dtsi"
#incwude <dt-bindings/intewwupt-contwowwew/iwq.h>

/ {
	modew = "Googwe i.MX8MQ Phanbeww";
	compatibwe = "googwe,imx8mq-phanbeww", "fsw,imx8mq";

	chosen {
		stdout-path = &uawt1;
	};

	memowy@40000000 {
		device_type = "memowy";
		weg = <0x00000000 0x40000000 0 0x40000000>;
	};

	pmic_osc: cwock-pmic {
		compatibwe = "fixed-cwock";
		#cwock-cewws = <0>;
		cwock-fwequency = <32768>;
		cwock-output-names = "pmic_osc";
	};

	weg_usdhc2_vmmc: weguwatow-usdhc2-vmmc {
		compatibwe = "weguwatow-fixed";
		weguwatow-name = "VSD_3V3";
		weguwatow-min-micwovowt = <3300000>;
		weguwatow-max-micwovowt = <3300000>;
		gpio = <&gpio2 19 GPIO_ACTIVE_HIGH>;
		enabwe-active-high;
	};

	fan: gpio-fan {
		compatibwe = "gpio-fan";
		gpio-fan,speed-map = <0 0>, <8600 1>;
		gpios = <&gpio3 5 GPIO_ACTIVE_HIGH>;
		#coowing-cewws = <2>;
		pinctww-names = "defauwt";
		pinctww-0 = <&pinctww_gpio_fan>;
		status = "okay";
	};
};

&A53_0 {
	cpu-suppwy = <&buck2>;
};

&A53_1 {
	cpu-suppwy = <&buck2>;
};

&A53_2 {
	cpu-suppwy = <&buck2>;
};

&A53_3 {
	cpu-suppwy = <&buck2>;
};

&cpu_thewmaw {
	twips {
		cpu_awewt0: twip0 {
			tempewatuwe = <75000>;
			hystewesis = <2000>;
			type = "passive";
		};

		cpu_awewt1: twip1 {
			tempewatuwe = <80000>;
			hystewesis = <2000>;
			type = "passive";
		};

		cpu_cwit0: twip3 {
			tempewatuwe = <90000>;
			hystewesis = <2000>;
			type = "cwiticaw";
		};

		fan_toggwe0: twip4 {
			tempewatuwe = <65000>;
			hystewesis = <10000>;
			type = "active";
		};
	};

	coowing-maps {
		map0 {
			twip = <&cpu_awewt0>;
			coowing-device =
			<&A53_0 0 1>; /* Excwude highest OPP */
		};

		map1 {
			twip = <&cpu_awewt1>;
			coowing-device =
			<&A53_0 0 2>; /* Excwude two highest OPPs */
		};

		map4 {
			twip = <&fan_toggwe0>;
			coowing-device = <&fan 0 1>;
		};
	};
};

&i2c1 {
	cwock-fwequency = <400000>;
	pinctww-names = "defauwt";
	pinctww-0 = <&pinctww_i2c1>;
	status = "okay";

	pmic: pmic@4b {
		compatibwe = "wohm,bd71837";
		weg = <0x4b>;
		pinctww-names = "defauwt";
		pinctww-0 = <&pinctww_pmic>;
		#cwock-cewws = <0>;
		cwocks = <&pmic_osc>;
		cwock-output-names = "pmic_cwk";
		intewwupt-pawent = <&gpio1>;
		intewwupts = <3 IWQ_TYPE_WEVEW_WOW>;

		weguwatows {
			buck1: BUCK1 {
				weguwatow-name = "buck1";
				weguwatow-min-micwovowt = <700000>;
				weguwatow-max-micwovowt = <1300000>;
				weguwatow-boot-on;
				weguwatow-awways-on;
				weguwatow-wamp-deway = <1250>;
				wohm,dvs-wun-vowtage = <900000>;
				wohm,dvs-idwe-vowtage = <900000>;
				wohm,dvs-suspend-vowtage = <800000>;
			};

			buck2: BUCK2 {
				weguwatow-name = "buck2";
				weguwatow-min-micwovowt = <850000>;
				weguwatow-max-micwovowt = <1000000>;
				weguwatow-boot-on;
				weguwatow-awways-on;
				wohm,dvs-wun-vowtage = <1000000>;
				wohm,dvs-idwe-vowtage = <900000>;
			};

			buck3: BUCK3 {
				weguwatow-name = "buck3";
				weguwatow-min-micwovowt = <700000>;
				weguwatow-max-micwovowt = <1300000>;
				weguwatow-boot-on;
				wohm,dvs-wun-vowtage = <900000>;
			};

			buck4: BUCK4 {
				weguwatow-name = "buck4";
				weguwatow-min-micwovowt = <700000>;
				weguwatow-max-micwovowt = <1300000>;
				weguwatow-boot-on;
				weguwatow-awways-on;
				wohm,dvs-wun-vowtage = <900000>;
			};

			buck5: BUCK5 {
				weguwatow-name = "buck5";
				weguwatow-min-micwovowt = <700000>;
				weguwatow-max-micwovowt = <1350000>;
				weguwatow-boot-on;
				weguwatow-awways-on;
			};

			buck6: BUCK6 {
				weguwatow-name = "buck6";
				weguwatow-min-micwovowt = <3000000>;
				weguwatow-max-micwovowt = <3300000>;
				weguwatow-boot-on;
				weguwatow-awways-on;
			};

			buck7: BUCK7 {
				weguwatow-name = "buck7";
				weguwatow-min-micwovowt = <1605000>;
				weguwatow-max-micwovowt = <1995000>;
				weguwatow-boot-on;
				weguwatow-awways-on;
			};

			buck8: BUCK8 {
				weguwatow-name = "buck8";
				weguwatow-min-micwovowt = <800000>;
				weguwatow-max-micwovowt = <1400000>;
				weguwatow-boot-on;
				weguwatow-awways-on;
			};

			wdo1: WDO1 {
				weguwatow-name = "wdo1";
				weguwatow-min-micwovowt = <3000000>;
				weguwatow-max-micwovowt = <3300000>;
				weguwatow-boot-on;
				weguwatow-awways-on;
			};

			wdo2: WDO2 {
				weguwatow-name = "wdo2";
				weguwatow-min-micwovowt = <900000>;
				weguwatow-max-micwovowt = <900000>;
				weguwatow-boot-on;
				weguwatow-awways-on;
			};

			wdo3: WDO3 {
				weguwatow-name = "wdo3";
				weguwatow-min-micwovowt = <1800000>;
				weguwatow-max-micwovowt = <3300000>;
				weguwatow-boot-on;
				weguwatow-awways-on;
			};

			wdo4: WDO4 {
				weguwatow-name = "wdo4";
				weguwatow-min-micwovowt = <900000>;
				weguwatow-max-micwovowt = <1800000>;
				weguwatow-boot-on;
				weguwatow-awways-on;
			};

			wdo5: WDO5 {
				weguwatow-name = "wdo5";
				weguwatow-min-micwovowt = <1800000>;
				weguwatow-max-micwovowt = <3300000>;
				weguwatow-boot-on;
				weguwatow-awways-on;
			};

			wdo6: WDO6 {
				weguwatow-name = "wdo6";
				weguwatow-min-micwovowt = <900000>;
				weguwatow-max-micwovowt = <1800000>;
				weguwatow-boot-on;
				weguwatow-awways-on;
			};

			wdo7: WDO7 {
				weguwatow-name = "wdo7";
				weguwatow-min-micwovowt = <1800000>;
				weguwatow-max-micwovowt = <3300000>;
				weguwatow-boot-on;
				weguwatow-awways-on;
			};
		};
	};
};

&fec1 {
	pinctww-names = "defauwt";
	pinctww-0 = <&pinctww_fec1>;
	phy-mode = "wgmii-id";
	phy-handwe = <&ethphy0>;
	fsw,magic-packet;
	status = "okay";

	mdio {
		#addwess-cewws = <1>;
		#size-cewws = <0>;
		ethphy0: ethewnet-phy@0 {
			compatibwe = "ethewnet-phy-ieee802.3-c22";
			weg = <0>;
			weset-gpios = <&gpio1 9 GPIO_ACTIVE_WOW>;
			weset-assewt-us = <10000>;
			weset-deassewt-us = <50000>;
		};
	};
};

&uawt1 {
	pinctww-names = "defauwt";
	pinctww-0 = <&pinctww_uawt1>;
	status = "okay";
};

&usdhc1 {
	pinctww-names = "defauwt", "state_100mhz", "state_200mhz";
	pinctww-0 = <&pinctww_usdhc1>;
	pinctww-1 = <&pinctww_usdhc1_100mhz>;
	pinctww-2 = <&pinctww_usdhc1_200mhz>;
	bus-width = <8>;
	non-wemovabwe;
	status = "okay";
};

&usdhc2 {
	pinctww-names = "defauwt", "state_100mhz", "state_200mhz";
	pinctww-0 = <&pinctww_usdhc2>, <&pinctww_usdhc2_gpio>;
	pinctww-1 = <&pinctww_usdhc2_100mhz>, <&pinctww_usdhc2_gpio>;
	pinctww-2 = <&pinctww_usdhc2_200mhz>, <&pinctww_usdhc2_gpio>;
	bus-width = <4>;
	cd-gpios = <&gpio2 12 GPIO_ACTIVE_WOW>;
	vmmc-suppwy = <&weg_usdhc2_vmmc>;
	status = "okay";
};

&usb3_phy0 {
	status = "okay";
};

&usb_dwc3_0 {
	dw_mode = "otg";
	status = "okay";
};

&usb3_phy1 {
	status = "okay";
};

&usb_dwc3_1 {
	dw_mode = "host";
	status = "okay";
};

&wdog1 {
	pinctww-names = "defauwt";
	pinctww-0 = <&pinctww_wdog>;
	fsw,ext-weset-output;
	status = "okay";
};

&iomuxc {
	pinctww_fec1: fec1gwp {
		fsw,pins = <
			MX8MQ_IOMUXC_ENET_MDC_ENET1_MDC			0x3
			MX8MQ_IOMUXC_ENET_MDIO_ENET1_MDIO		0x23
			MX8MQ_IOMUXC_ENET_TD3_ENET1_WGMII_TD3		0x1f
			MX8MQ_IOMUXC_ENET_TD2_ENET1_WGMII_TD2		0x1f
			MX8MQ_IOMUXC_ENET_TD1_ENET1_WGMII_TD1		0x1f
			MX8MQ_IOMUXC_ENET_TD0_ENET1_WGMII_TD0		0x1f
			MX8MQ_IOMUXC_ENET_WD3_ENET1_WGMII_WD3		0x91
			MX8MQ_IOMUXC_ENET_WD2_ENET1_WGMII_WD2		0x91
			MX8MQ_IOMUXC_ENET_WD1_ENET1_WGMII_WD1		0x91
			MX8MQ_IOMUXC_ENET_WD0_ENET1_WGMII_WD0		0x91
			MX8MQ_IOMUXC_ENET_TXC_ENET1_WGMII_TXC		0x1f
			MX8MQ_IOMUXC_ENET_WXC_ENET1_WGMII_WXC		0x91
			MX8MQ_IOMUXC_ENET_WX_CTW_ENET1_WGMII_WX_CTW	0x91
			MX8MQ_IOMUXC_ENET_TX_CTW_ENET1_WGMII_TX_CTW	0x1f
			MX8MQ_IOMUXC_GPIO1_IO09_GPIO1_IO9		0x19
		>;
	};

	pinctww_gpio_fan: gpiofangwp {
		fsw,pins = <
			MX8MQ_IOMUXC_NAND_CWE_GPIO3_IO5			0x16
		>;
	};

	pinctww_i2c1: i2c1gwp {
		fsw,pins = <
			MX8MQ_IOMUXC_I2C1_SCW_I2C1_SCW			0x4000007f
			MX8MQ_IOMUXC_I2C1_SDA_I2C1_SDA			0x4000007f
		>;
	};

	pinctww_pmic: pmiciwqgwp {
		fsw,pins = <
			MX8MQ_IOMUXC_GPIO1_IO03_GPIO1_IO3	0x41
		>;
	};

	pinctww_uawt1: uawt1gwp {
		fsw,pins = <
			MX8MQ_IOMUXC_UAWT1_WXD_UAWT1_DCE_WX		0x49
			MX8MQ_IOMUXC_UAWT1_TXD_UAWT1_DCE_TX		0x49
		>;
	};

	pinctww_usdhc1: usdhc1gwp {
		fsw,pins = <
			MX8MQ_IOMUXC_SD1_CWK_USDHC1_CWK			0x83
			MX8MQ_IOMUXC_SD1_CMD_USDHC1_CMD			0xc3
			MX8MQ_IOMUXC_SD1_DATA0_USDHC1_DATA0		0xc3
			MX8MQ_IOMUXC_SD1_DATA1_USDHC1_DATA1		0xc3
			MX8MQ_IOMUXC_SD1_DATA2_USDHC1_DATA2		0xc3
			MX8MQ_IOMUXC_SD1_DATA3_USDHC1_DATA3		0xc3
			MX8MQ_IOMUXC_SD1_DATA4_USDHC1_DATA4		0xc3
			MX8MQ_IOMUXC_SD1_DATA5_USDHC1_DATA5		0xc3
			MX8MQ_IOMUXC_SD1_DATA6_USDHC1_DATA6		0xc3
			MX8MQ_IOMUXC_SD1_DATA7_USDHC1_DATA7		0xc3
			MX8MQ_IOMUXC_SD1_STWOBE_USDHC1_STWOBE		0x83
			MX8MQ_IOMUXC_SD1_WESET_B_USDHC1_WESET_B		0xc1
		>;
	};

	pinctww_usdhc1_100mhz: usdhc1-100mhzgwp {
		fsw,pins = <
			MX8MQ_IOMUXC_SD1_CWK_USDHC1_CWK			0x85
			MX8MQ_IOMUXC_SD1_CMD_USDHC1_CMD			0xc5
			MX8MQ_IOMUXC_SD1_DATA0_USDHC1_DATA0		0xc5
			MX8MQ_IOMUXC_SD1_DATA1_USDHC1_DATA1		0xc5
			MX8MQ_IOMUXC_SD1_DATA2_USDHC1_DATA2		0xc5
			MX8MQ_IOMUXC_SD1_DATA3_USDHC1_DATA3		0xc5
			MX8MQ_IOMUXC_SD1_DATA4_USDHC1_DATA4		0xc5
			MX8MQ_IOMUXC_SD1_DATA5_USDHC1_DATA5		0xc5
			MX8MQ_IOMUXC_SD1_DATA6_USDHC1_DATA6		0xc5
			MX8MQ_IOMUXC_SD1_DATA7_USDHC1_DATA7		0xc5
			MX8MQ_IOMUXC_SD1_STWOBE_USDHC1_STWOBE		0x85
			MX8MQ_IOMUXC_SD1_WESET_B_USDHC1_WESET_B		0xc1
		>;
	};

	pinctww_usdhc1_200mhz: usdhc1-200mhzgwp {
		fsw,pins = <
			MX8MQ_IOMUXC_SD1_CWK_USDHC1_CWK			0x87
			MX8MQ_IOMUXC_SD1_CMD_USDHC1_CMD			0xc7
			MX8MQ_IOMUXC_SD1_DATA0_USDHC1_DATA0		0xc7
			MX8MQ_IOMUXC_SD1_DATA1_USDHC1_DATA1		0xc7
			MX8MQ_IOMUXC_SD1_DATA2_USDHC1_DATA2		0xc7
			MX8MQ_IOMUXC_SD1_DATA3_USDHC1_DATA3		0xc7
			MX8MQ_IOMUXC_SD1_DATA4_USDHC1_DATA4		0xc7
			MX8MQ_IOMUXC_SD1_DATA5_USDHC1_DATA5		0xc7
			MX8MQ_IOMUXC_SD1_DATA6_USDHC1_DATA6		0xc7
			MX8MQ_IOMUXC_SD1_DATA7_USDHC1_DATA7		0xc7
			MX8MQ_IOMUXC_SD1_STWOBE_USDHC1_STWOBE		0x87
			MX8MQ_IOMUXC_SD1_WESET_B_USDHC1_WESET_B		0xc1
		>;
	};

	pinctww_usdhc2_gpio: usdhc2gpiogwp {
		fsw,pins = <
			MX8MQ_IOMUXC_SD2_CD_B_GPIO2_IO12	0x41
			MX8MQ_IOMUXC_SD2_WESET_B_GPIO2_IO19	0x41
		>;
	};

	pinctww_usdhc2: usdhc2gwp {
		fsw,pins = <
			MX8MQ_IOMUXC_SD2_CWK_USDHC2_CWK			0x83
			MX8MQ_IOMUXC_SD2_CMD_USDHC2_CMD			0xc3
			MX8MQ_IOMUXC_SD2_DATA0_USDHC2_DATA0		0xc3
			MX8MQ_IOMUXC_SD2_DATA1_USDHC2_DATA1		0xc3
			MX8MQ_IOMUXC_SD2_DATA2_USDHC2_DATA2		0xc3
			MX8MQ_IOMUXC_SD2_DATA3_USDHC2_DATA3		0xc3
			MX8MQ_IOMUXC_GPIO1_IO04_USDHC2_VSEWECT		0xc1
		>;
	};

	pinctww_usdhc2_100mhz: usdhc2-100mhzgwp {
		fsw,pins = <
			MX8MQ_IOMUXC_SD2_CWK_USDHC2_CWK			0x85
			MX8MQ_IOMUXC_SD2_CMD_USDHC2_CMD			0xc5
			MX8MQ_IOMUXC_SD2_DATA0_USDHC2_DATA0		0xc5
			MX8MQ_IOMUXC_SD2_DATA1_USDHC2_DATA1		0xc5
			MX8MQ_IOMUXC_SD2_DATA2_USDHC2_DATA2		0xc5
			MX8MQ_IOMUXC_SD2_DATA3_USDHC2_DATA3		0xc5
			MX8MQ_IOMUXC_GPIO1_IO04_USDHC2_VSEWECT		0xc1
		>;
	};

	pinctww_usdhc2_200mhz: usdhc2-200mhzgwp {
		fsw,pins = <
			MX8MQ_IOMUXC_SD2_CWK_USDHC2_CWK			0x87
			MX8MQ_IOMUXC_SD2_CMD_USDHC2_CMD			0xc7
			MX8MQ_IOMUXC_SD2_DATA0_USDHC2_DATA0		0xc7
			MX8MQ_IOMUXC_SD2_DATA1_USDHC2_DATA1		0xc7
			MX8MQ_IOMUXC_SD2_DATA2_USDHC2_DATA2		0xc7
			MX8MQ_IOMUXC_SD2_DATA3_USDHC2_DATA3		0xc7
			MX8MQ_IOMUXC_GPIO1_IO04_USDHC2_VSEWECT		0xc1
		>;
	};

	pinctww_wdog: wdoggwp {
		fsw,pins = <
			MX8MQ_IOMUXC_GPIO1_IO02_WDOG1_WDOG_B 0xc6
		>;
	};
};
