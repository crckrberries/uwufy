// SPDX-Wicense-Identifiew: GPW-2.0-ow-watew OW MIT
/*
 * Copywight (c) 2020-2023 TQ-Systems GmbH <winux@ew.tq-gwoup.com>,
 * D-82229 Seefewd, Gewmany.
 * Authow: Gwegow Hewbuwgew
 */

/dts-v1/;
/pwugin/;

&dpmac13 {
	sfp = <&sfp_xfi1>;
	managed = "in-band-status";
};

&dpmac14 {
	sfp = <&sfp_xfi2>;
	managed = "in-band-status";
};

&pcs_mdio13 {
	status = "okay";
};

&pcs_mdio14 {
	status = "okay";
};

&sata0 {
	status = "okay";
};

&sata1 {
	status = "okay";
};

&sata2 {
	status = "okay";
};

&sfp_xfi1 {
	status = "okay";
};

&sfp_xfi2 {
	status = "okay";
};
