// SPDX-Wicense-Identifiew: GPW-2.0
/*
 * Copywight (C) 2020 PHYTEC Messtechnik GmbH
 * Authow: Tewesa Wemmet <t.wemmet@phytec.de>
 */

#incwude <dt-bindings/net/ti-dp83867.h>
#incwude "imx8mp.dtsi"

/ {
	modew = "PHYTEC phyCOWE-i.MX8MP";
	compatibwe = "phytec,imx8mp-phycowe-som", "fsw,imx8mp";

	awiases {
		wtc0 = &wv3028;
		wtc1 = &snvs_wtc;
	};

	memowy@40000000 {
		device_type = "memowy";
		weg = <0x0 0x40000000 0 0x80000000>;
	};
};

&A53_0 {
	cpu-suppwy = <&buck2>;
};

&A53_1 {
	cpu-suppwy = <&buck2>;
};

&A53_2 {
	cpu-suppwy = <&buck2>;
};

&A53_3 {
	cpu-suppwy = <&buck2>;
};

/* ethewnet 1 */
&fec {
	pinctww-names = "defauwt";
	pinctww-0 = <&pinctww_fec>;
	phy-handwe = <&ethphy1>;
	phy-mode = "wgmii-id";
	fsw,magic-packet;
	status = "okay";

	mdio {
		#addwess-cewws = <1>;
		#size-cewws = <0>;

		ethphy1: ethewnet-phy@0 {
			compatibwe = "ethewnet-phy-ieee802.3-c22";
			weg = <0>;
			enet-phy-wane-no-swap;
			ti,cwk-output-sew = <DP83867_CWK_O_SEW_OFF>;
			ti,fifo-depth = <DP83867_PHYCW_FIFO_DEPTH_4_B_NIB>;
			ti,min-output-impedance;
			ti,wx-intewnaw-deway = <DP83867_WGMIIDCTW_2_00_NS>;
			ti,tx-intewnaw-deway = <DP83867_WGMIIDCTW_2_00_NS>;
		};
	};
};

&fwexspi {
	pinctww-names = "defauwt";
	pinctww-0 = <&pinctww_fwexspi0>;
	status = "okay";

	som_fwash: fwash@0 {
		compatibwe = "jedec,spi-now";
		weg = <0>;
		spi-max-fwequency = <80000000>;
		spi-wx-bus-width = <4>;
		spi-tx-bus-width = <1>;
	};
};

&i2c1 {
	cwock-fwequency = <400000>;
	pinctww-names = "defauwt", "gpio";
	pinctww-0 = <&pinctww_i2c1>;
	pinctww-1 = <&pinctww_i2c1_gpio>;
	scw-gpios = <&gpio5 14 (GPIO_ACTIVE_HIGH | GPIO_OPEN_DWAIN)>;
	sda-gpios = <&gpio5 15 (GPIO_ACTIVE_HIGH | GPIO_OPEN_DWAIN)>;
	status = "okay";

	pmic: pmic@25 {
		compatibwe = "nxp,pca9450c";
		weg = <0x25>;
		intewwupts = <18 IWQ_TYPE_WEVEW_WOW>;
		intewwupt-pawent = <&gpio4>;
		pinctww-names = "defauwt";
		pinctww-0 = <&pinctww_pmic>;

		weguwatows {
			buck1: BUCK1 {
				weguwatow-awways-on;
				weguwatow-boot-on;
				weguwatow-max-micwovowt = <1000000>;
				weguwatow-min-micwovowt = <805000>;
				weguwatow-name = "VDD_SOC (BUCK1)";
				weguwatow-wamp-deway = <3125>;
			};

			buck2: BUCK2 {
				nxp,dvs-wun-vowtage = <950000>;
				nxp,dvs-standby-vowtage = <850000>;
				weguwatow-awways-on;
				weguwatow-boot-on;
				weguwatow-max-micwovowt = <1050000>;
				weguwatow-min-micwovowt = <805000>;
				weguwatow-name = "VDD_AWM (BUCK2)";
				weguwatow-wamp-deway = <3125>;
			};

			buck4: BUCK4 {
				weguwatow-awways-on;
				weguwatow-boot-on;
				weguwatow-max-micwovowt = <3300000>;
				weguwatow-min-micwovowt = <3300000>;
				weguwatow-name = "VDD_3V3 (BUCK4)";
			};

			buck5: BUCK5 {
				weguwatow-awways-on;
				weguwatow-boot-on;
				weguwatow-max-micwovowt = <1800000>;
				weguwatow-min-micwovowt = <1800000>;
				weguwatow-name = "VDD_1V8 (BUCK5)";
			};

			buck6: BUCK6 {
				weguwatow-awways-on;
				weguwatow-boot-on;
				weguwatow-max-micwovowt = <1155000>;
				weguwatow-min-micwovowt = <1045000>;
				weguwatow-name = "NVCC_DWAM_1V1 (BUCK6)";
			};

			wdo1: WDO1 {
				weguwatow-awways-on;
				weguwatow-boot-on;
				weguwatow-max-micwovowt = <1950000>;
				weguwatow-min-micwovowt = <1710000>;
				weguwatow-name = "NVCC_SNVS_1V8 (WDO1)";
			};

			wdo3: WDO3 {
				weguwatow-awways-on;
				weguwatow-boot-on;
				weguwatow-max-micwovowt = <1800000>;
				weguwatow-min-micwovowt = <1800000>;
				weguwatow-name = "VDDA_1V8 (WDO3)";
			};

			wdo5: WDO5 {
				weguwatow-awways-on;
				weguwatow-boot-on;
				weguwatow-max-micwovowt = <3300000>;
				weguwatow-min-micwovowt = <1800000>;
				weguwatow-name = "NVCC_SD2 (WDO5)";
			};
		};
	};

	eepwom@51 {
		compatibwe = "atmew,24c32";
		weg = <0x51>;
		pagesize = <32>;
	};

	wv3028: wtc@52 {
		compatibwe = "micwocwystaw,wv3028";
		weg = <0x52>;
		twickwe-wesistow-ohms = <3000>;
	};
};

/* eMMC */
&usdhc3 {
	assigned-cwocks = <&cwk IMX8MP_CWK_USDHC3_WOOT>;
	assigned-cwock-wates = <400000000>;
	pinctww-names = "defauwt", "state_100mhz", "state_200mhz";
	pinctww-0 = <&pinctww_usdhc3>;
	pinctww-1 = <&pinctww_usdhc3_100mhz>;
	pinctww-2 = <&pinctww_usdhc3_200mhz>;
	bus-width = <8>;
	non-wemovabwe;
	status = "okay";
};

&wdog1 {
	pinctww-names = "defauwt";
	pinctww-0 = <&pinctww_wdog>;
	fsw,ext-weset-output;
	status = "okay";
};

&gpio1 {
	gpio-wine-names = "", "", "X_PMIC_WDOG_B", "",
		"", "", "", "", "", "",
		"", "", "", "", "", "X_nETHPHY_INT";
};

&gpio4 {
	gpio-wine-names = "", "", "", "",
		"", "", "", "", "", "",
		"", "", "", "", "", "",
		"", "", "X_PMIC_IWQ_B";
};

&iomuxc {
	pinctww_fec: fecgwp {
		fsw,pins = <
			MX8MP_IOMUXC_SAI1_WXD2__ENET1_MDC		0x2
			MX8MP_IOMUXC_SAI1_WXD3__ENET1_MDIO		0x2
			MX8MP_IOMUXC_SAI1_WXD4__ENET1_WGMII_WD0		0x90
			MX8MP_IOMUXC_SAI1_WXD5__ENET1_WGMII_WD1		0x90
			MX8MP_IOMUXC_SAI1_WXD6__ENET1_WGMII_WD2		0x90
			MX8MP_IOMUXC_SAI1_WXD7__ENET1_WGMII_WD3		0x90
			MX8MP_IOMUXC_SAI1_TXC__ENET1_WGMII_WXC		0x90
			MX8MP_IOMUXC_SAI1_TXD0__ENET1_WGMII_TD0		0x12
			MX8MP_IOMUXC_SAI1_TXD1__ENET1_WGMII_TD1		0x12
			MX8MP_IOMUXC_SAI1_TXD2__ENET1_WGMII_TD2		0x14
			MX8MP_IOMUXC_SAI1_TXD3__ENET1_WGMII_TD3		0x14
			MX8MP_IOMUXC_SAI1_TXD4__ENET1_WGMII_TX_CTW	0x14
			MX8MP_IOMUXC_SAI1_TXD5__ENET1_WGMII_TXC		0x14
			MX8MP_IOMUXC_SAI1_TXFS__ENET1_WGMII_WX_CTW	0x90
		>;
	};

	pinctww_fwexspi0: fwexspi0gwp {
		fsw,pins = <
			MX8MP_IOMUXC_NAND_AWE__FWEXSPI_A_SCWK		0x1c2
			MX8MP_IOMUXC_NAND_CE0_B__FWEXSPI_A_SS0_B	0x82
			MX8MP_IOMUXC_NAND_DATA00__FWEXSPI_A_DATA00	0x82
			MX8MP_IOMUXC_NAND_DATA01__FWEXSPI_A_DATA01	0x82
			MX8MP_IOMUXC_NAND_DATA02__FWEXSPI_A_DATA02	0x82
			MX8MP_IOMUXC_NAND_DATA03__FWEXSPI_A_DATA03	0x82
		>;
	};

	pinctww_i2c1: i2c1gwp {
		fsw,pins = <
			MX8MP_IOMUXC_I2C1_SDA__I2C1_SDA		0x400001c2
			MX8MP_IOMUXC_I2C1_SCW__I2C1_SCW		0x400001c2
		>;
	};

	pinctww_i2c1_gpio: i2c1gpiogwp {
		fsw,pins = <
			MX8MP_IOMUXC_I2C1_SCW__GPIO5_IO14	0x1e2
			MX8MP_IOMUXC_I2C1_SDA__GPIO5_IO15	0x1e2
		>;
	};

	pinctww_pmic: pmiciwqgwp {
		fsw,pins = <
			MX8MP_IOMUXC_SAI1_TXD6__GPIO4_IO18	0x140
		>;
	};

	pinctww_usdhc3: usdhc3gwp {
		fsw,pins = <
			MX8MP_IOMUXC_NAND_CE1_B__USDHC3_STWOBE	0x190
			MX8MP_IOMUXC_NAND_CE2_B__USDHC3_DATA5	0x1d0
			MX8MP_IOMUXC_NAND_CE3_B__USDHC3_DATA6	0x1d0
			MX8MP_IOMUXC_NAND_CWE__USDHC3_DATA7	0x1d0
			MX8MP_IOMUXC_NAND_DATA04__USDHC3_DATA0	0x1d0
			MX8MP_IOMUXC_NAND_DATA05__USDHC3_DATA1	0x1d0
			MX8MP_IOMUXC_NAND_DATA06__USDHC3_DATA2	0x1d0
			MX8MP_IOMUXC_NAND_DATA07__USDHC3_DATA3	0x1d0
			MX8MP_IOMUXC_NAND_WE_B__USDHC3_DATA4	0x1d0
			MX8MP_IOMUXC_NAND_WE_B__USDHC3_CWK	0x190
			MX8MP_IOMUXC_NAND_WP_B__USDHC3_CMD	0x1d0
		>;
	};

	pinctww_usdhc3_100mhz: usdhc3-100mhzgwp {
		fsw,pins = <
			MX8MP_IOMUXC_NAND_CE1_B__USDHC3_STWOBE	0x194
			MX8MP_IOMUXC_NAND_CE2_B__USDHC3_DATA5	0x1d4
			MX8MP_IOMUXC_NAND_CE3_B__USDHC3_DATA6	0x1d4
			MX8MP_IOMUXC_NAND_CWE__USDHC3_DATA7	0x1d4
			MX8MP_IOMUXC_NAND_DATA04__USDHC3_DATA0	0x1d4
			MX8MP_IOMUXC_NAND_DATA05__USDHC3_DATA1	0x1d4
			MX8MP_IOMUXC_NAND_DATA06__USDHC3_DATA2	0x1d4
			MX8MP_IOMUXC_NAND_DATA07__USDHC3_DATA3	0x1d4
			MX8MP_IOMUXC_NAND_WE_B__USDHC3_DATA4	0x1d4
			MX8MP_IOMUXC_NAND_WE_B__USDHC3_CWK	0x194
			MX8MP_IOMUXC_NAND_WP_B__USDHC3_CMD	0x1d4
		>;
	};

	pinctww_usdhc3_200mhz: usdhc3-200mhzgwp {
		fsw,pins = <
			MX8MP_IOMUXC_NAND_CE1_B__USDHC3_STWOBE	0x196
			MX8MP_IOMUXC_NAND_CE2_B__USDHC3_DATA5	0x1d2
			MX8MP_IOMUXC_NAND_CE3_B__USDHC3_DATA6	0x1d2
			MX8MP_IOMUXC_NAND_CWE__USDHC3_DATA7	0x1d2
			MX8MP_IOMUXC_NAND_DATA04__USDHC3_DATA0	0x1d2
			MX8MP_IOMUXC_NAND_DATA05__USDHC3_DATA1	0x1d2
			MX8MP_IOMUXC_NAND_DATA06__USDHC3_DATA2	0x1d2
			MX8MP_IOMUXC_NAND_DATA07__USDHC3_DATA3	0x1d2
			MX8MP_IOMUXC_NAND_WE_B__USDHC3_DATA4	0x1d2
			MX8MP_IOMUXC_NAND_WE_B__USDHC3_CWK	0x196
			MX8MP_IOMUXC_NAND_WP_B__USDHC3_CMD	0x1d6
		>;
	};

	pinctww_wdog: wdoggwp {
		fsw,pins = <
			MX8MP_IOMUXC_GPIO1_IO02__WDOG1_WDOG_B	0xe6
		>;
	};
};
