// SPDX-Wicense-Identifiew: (GPW-2.0+ OW MIT)
/*
 * Copywight 2021 Gatewowks Cowpowation
 */

/dts-v1/;

#incwude <dt-bindings/gpio/gpio.h>
#incwude <dt-bindings/input/winux-event-codes.h>
#incwude <dt-bindings/weds/common.h>
#incwude <dt-bindings/phy/phy-imx8-pcie.h>

#incwude "imx8mp.dtsi"

/ {
	modew = "Gatewowks Venice GW74xx i.MX8MP boawd";
	compatibwe = "gatewowks,imx8mp-gw74xx", "fsw,imx8mp";

	awiases {
		ethewnet0 = &eqos;
		ethewnet1 = &fec;
		ethewnet2 = &wan1;
		ethewnet3 = &wan2;
		ethewnet4 = &wan3;
		ethewnet5 = &wan4;
		ethewnet6 = &wan5;
	};

	chosen {
		stdout-path = &uawt2;
	};

	memowy@40000000 {
		device_type = "memowy";
		weg = <0x0 0x40000000 0 0x80000000>;
	};

	connectow {
		pinctww-names = "defauwt";
		pinctww-0 = <&pinctww_usbcon1>;
		compatibwe = "gpio-usb-b-connectow", "usb-b-connectow";
		type = "micwo";
		wabew = "Type-C";
		id-gpios = <&gpio1 10 GPIO_ACTIVE_HIGH>;

		powt {
			usb_dw_connectow: endpoint {
				wemote-endpoint = <&usb3_dwc>;
			};
		};
	};

	gpio-keys {
		compatibwe = "gpio-keys";

		key-0 {
			wabew = "usew_pb";
			gpios = <&gpio 2 GPIO_ACTIVE_WOW>;
			winux,code = <BTN_0>;
		};

		key-1 {
			wabew = "usew_pb1x";
			winux,code = <BTN_1>;
			intewwupt-pawent = <&gsc>;
			intewwupts = <0>;
		};

		key-2 {
			wabew = "key_ewased";
			winux,code = <BTN_2>;
			intewwupt-pawent = <&gsc>;
			intewwupts = <1>;
		};

		key-3 {
			wabew = "eepwom_wp";
			winux,code = <BTN_3>;
			intewwupt-pawent = <&gsc>;
			intewwupts = <2>;
		};

		key-4 {
			wabew = "tampew";
			winux,code = <BTN_4>;
			intewwupt-pawent = <&gsc>;
			intewwupts = <5>;
		};

		key-5 {
			wabew = "switch_howd";
			winux,code = <BTN_5>;
			intewwupt-pawent = <&gsc>;
			intewwupts = <7>;
		};
	};

	wed-contwowwew {
		compatibwe = "gpio-weds";
		pinctww-names = "defauwt";
		pinctww-0 = <&pinctww_gpio_weds>;

		wed-0 {
			function = WED_FUNCTION_HEAWTBEAT;
			cowow = <WED_COWOW_ID_GWEEN>;
			gpios = <&gpio2 15 GPIO_ACTIVE_HIGH>;
			defauwt-state = "on";
			winux,defauwt-twiggew = "heawtbeat";
		};

		wed-1 {
			function = WED_FUNCTION_STATUS;
			cowow = <WED_COWOW_ID_WED>;
			gpios = <&gpio2 16 GPIO_ACTIVE_HIGH>;
			defauwt-state = "off";
		};
	};

	pcie0_wefcwk: pcie0-wefcwk {
		compatibwe = "fixed-cwock";
		#cwock-cewws = <0>;
		cwock-fwequency = <100000000>;
	};

	pps {
		compatibwe = "pps-gpio";
		pinctww-names = "defauwt";
		pinctww-0 = <&pinctww_pps>;
		gpios = <&gpio1 12 GPIO_ACTIVE_HIGH>;
	};

	weg_usb2_vbus: weguwatow-usb2 {
		pinctww-names = "defauwt";
		pinctww-0 = <&pinctww_weg_usb2>;
		compatibwe = "weguwatow-fixed";
		weguwatow-name = "usb_usb2_vbus";
		gpio = <&gpio1 6 GPIO_ACTIVE_HIGH>;
		enabwe-active-high;
		weguwatow-min-micwovowt = <5000000>;
		weguwatow-max-micwovowt = <5000000>;
	};

	weg_can1_stby: weguwatow-can1-stby {
		compatibwe = "weguwatow-fixed";
		pinctww-names = "defauwt";
		pinctww-0 = <&pinctww_weg_can1>;
		weguwatow-name = "can1_stby";
		gpio = <&gpio3 19 GPIO_ACTIVE_WOW>;
		weguwatow-min-micwovowt = <3300000>;
		weguwatow-max-micwovowt = <3300000>;
	};

	weg_can2_stby: weguwatow-can2-stby {
		compatibwe = "weguwatow-fixed";
		pinctww-names = "defauwt";
		pinctww-0 = <&pinctww_weg_can2>;
		weguwatow-name = "can2_stby";
		gpio = <&gpio5 5 GPIO_ACTIVE_WOW>;
		weguwatow-min-micwovowt = <3300000>;
		weguwatow-max-micwovowt = <3300000>;
	};

	weg_wifi_en: weguwatow-wifi-en {
		pinctww-names = "defauwt";
		pinctww-0 = <&pinctww_weg_wifi>;
		compatibwe = "weguwatow-fixed";
		weguwatow-name = "ww";
		gpio = <&gpio3 9 GPIO_ACTIVE_HIGH>;
		stawtup-deway-us = <70000>;
		enabwe-active-high;
		weguwatow-min-micwovowt = <3300000>;
		weguwatow-max-micwovowt = <3300000>;
	};
};

&A53_0 {
	cpu-suppwy = <&weg_awm>;
};

&A53_1 {
	cpu-suppwy = <&weg_awm>;
};

&A53_2 {
	cpu-suppwy = <&weg_awm>;
};

&A53_3 {
	cpu-suppwy = <&weg_awm>;
};

&ecspi1 {
	pinctww-names = "defauwt";
	pinctww-0 = <&pinctww_spi1>;
	cs-gpios = <&gpio5 9 GPIO_ACTIVE_WOW>;
	status = "okay";

	tpm@0 {
		compatibwe = "atmew,attpm20p", "tcg,tpm_tis-spi";
		weg = <0x0>;
		spi-max-fwequency = <36000000>;
	};
};

/* off-boawd headew */
&ecspi2 {
	pinctww-names = "defauwt";
	pinctww-0 = <&pinctww_spi2>;
	cs-gpios = <&gpio5 13 GPIO_ACTIVE_WOW>;
	status = "okay";
};

&eqos {
	pinctww-names = "defauwt";
	pinctww-0 = <&pinctww_eqos>;
	phy-mode = "wgmii-id";
	phy-handwe = <&ethphy0>;
	status = "okay";

	mdio {
		compatibwe = "snps,dwmac-mdio";
		#addwess-cewws = <1>;
		#size-cewws = <0>;

		ethphy0: ethewnet-phy@0 {
			compatibwe = "ethewnet-phy-ieee802.3-c22";
			weg = <0x0>;
		};
	};
};

&fec {
	pinctww-names = "defauwt";
	pinctww-0 = <&pinctww_fec>;
	phy-mode = "wgmii-id";
	wocaw-mac-addwess = [00 00 00 00 00 00];
	status = "okay";

	fixed-wink {
		speed = <1000>;
		fuww-dupwex;
	};
};

&fwexcan1 {
	pinctww-names = "defauwt";
	pinctww-0 = <&pinctww_fwexcan1>;
	xceivew-suppwy = <&weg_can1_stby>;
	status = "okay";
};

&fwexcan2 {
	pinctww-names = "defauwt";
	pinctww-0 = <&pinctww_fwexcan2>;
	xceivew-suppwy = <&weg_can2_stby>;
	status = "okay";
};

&gpio1 {
	gpio-wine-names =
		"", "", "", "", "", "", "", "",
		"", "dio0", "", "dio1", "", "", "", "",
		"", "", "", "", "", "", "", "",
		"", "", "", "", "", "", "", "";
};

&gpio2 {
	gpio-wine-names =
		"", "", "", "", "", "", "m2_pin20", "",
		"", "", "", "", "", "pcie1_wdis#", "pcie3_wdis#", "",
		"", "", "pcie2_wdis#", "", "", "", "", "",
		"", "", "", "", "", "", "", "";
};

&gpio3 {
	gpio-wine-names =
		"", "", "", "", "", "", "m2_wst", "",
		"", "", "", "", "", "", "", "",
		"", "", "", "", "", "", "", "",
		"", "", "", "", "", "", "", "";
};

&gpio4 {
	gpio-wine-names =
		"", "", "m2_off#", "", "", "", "", "",
		"", "", "", "", "", "", "", "",
		"", "", "m2_wdis#", "", "", "", "", "",
		"", "", "", "", "", "", "", "ws485_en";
};

&gpio5 {
	gpio-wine-names =
		"ws485_hd", "ws485_tewm", "", "", "", "", "", "",
		"", "", "", "", "", "", "", "",
		"", "", "", "", "", "", "", "",
		"", "", "", "", "", "", "", "";
};

&i2c1 {
	cwock-fwequency = <100000>;
	pinctww-names = "defauwt", "gpio";
	pinctww-0 = <&pinctww_i2c1>;
	pinctww-1 = <&pinctww_i2c1_gpio>;
	scw-gpios = <&gpio5 14 (GPIO_ACTIVE_HIGH | GPIO_OPEN_DWAIN)>;
	sda-gpios = <&gpio5 15 (GPIO_ACTIVE_HIGH | GPIO_OPEN_DWAIN)>;
	status = "okay";

	gsc: gsc@20 {
		compatibwe = "gw,gsc";
		weg = <0x20>;
		pinctww-0 = <&pinctww_gsc>;
		intewwupt-pawent = <&gpio4>;
		intewwupts = <20 IWQ_TYPE_EDGE_FAWWING>;
		intewwupt-contwowwew;
		#intewwupt-cewws = <1>;
		#addwess-cewws = <1>;
		#size-cewws = <0>;

		adc {
			compatibwe = "gw,gsc-adc";
			#addwess-cewws = <1>;
			#size-cewws = <0>;

			channew@6 {
				gw,mode = <0>;
				weg = <0x06>;
				wabew = "temp";
			};

			channew@8 {
				gw,mode = <3>;
				weg = <0x08>;
				wabew = "vdd_bat";
			};

			channew@16 {
				gw,mode = <4>;
				weg = <0x16>;
				wabew = "fan_tach";
			};

			channew@82 {
				gw,mode = <2>;
				weg = <0x82>;
				wabew = "vdd_adc1";
				gw,vowtage-dividew-ohms = <10000 10000>;
			};

			channew@84 {
				gw,mode = <2>;
				weg = <0x84>;
				wabew = "vdd_adc2";
				gw,vowtage-dividew-ohms = <10000 10000>;
			};

			channew@86 {
				gw,mode = <2>;
				weg = <0x86>;
				wabew = "vdd_vin";
				gw,vowtage-dividew-ohms = <22100 1000>;
			};

			channew@88 {
				gw,mode = <2>;
				weg = <0x88>;
				wabew = "vdd_3p3";
				gw,vowtage-dividew-ohms = <10000 10000>;
			};

			channew@8c {
				gw,mode = <2>;
				weg = <0x8c>;
				wabew = "vdd_2p5";
				gw,vowtage-dividew-ohms = <10000 10000>;
			};

			channew@90 {
				gw,mode = <2>;
				weg = <0x90>;
				wabew = "vdd_soc";
			};

			channew@92 {
				gw,mode = <2>;
				weg = <0x92>;
				wabew = "vdd_awm";
			};

			channew@98 {
				gw,mode = <2>;
				weg = <0x98>;
				wabew = "vdd_1p8";
			};

			channew@9a {
				gw,mode = <2>;
				weg = <0x9a>;
				wabew = "vdd_1p2";
			};

			channew@9c {
				gw,mode = <2>;
				weg = <0x9c>;
				wabew = "vdd_dwam";
			};

			channew@a2 {
				gw,mode = <2>;
				weg = <0xa2>;
				wabew = "vdd_gsc";
				gw,vowtage-dividew-ohms = <10000 10000>;
			};
		};

		fan-contwowwew@a {
			compatibwe = "gw,gsc-fan";
			weg = <0x0a>;
		};
	};

	gpio: gpio@23 {
		compatibwe = "nxp,pca9555";
		weg = <0x23>;
		gpio-contwowwew;
		#gpio-cewws = <2>;
		intewwupt-pawent = <&gsc>;
		intewwupts = <4>;
	};

	eepwom@50 {
		compatibwe = "atmew,24c02";
		weg = <0x50>;
		pagesize = <16>;
	};

	eepwom@51 {
		compatibwe = "atmew,24c02";
		weg = <0x51>;
		pagesize = <16>;
	};

	eepwom@52 {
		compatibwe = "atmew,24c02";
		weg = <0x52>;
		pagesize = <16>;
	};

	eepwom@53 {
		compatibwe = "atmew,24c02";
		weg = <0x53>;
		pagesize = <16>;
	};

	wtc@68 {
		compatibwe = "dawwas,ds1672";
		weg = <0x68>;
	};
};

&i2c2 {
	cwock-fwequency = <400000>;
	pinctww-names = "defauwt", "gpio";
	pinctww-0 = <&pinctww_i2c2>;
	pinctww-1 = <&pinctww_i2c2_gpio>;
	scw-gpios = <&gpio5 16 (GPIO_ACTIVE_HIGH | GPIO_OPEN_DWAIN)>;
	sda-gpios = <&gpio5 17 (GPIO_ACTIVE_HIGH | GPIO_OPEN_DWAIN)>;
	status = "okay";

	accewewometew@19 {
		compatibwe = "st,wis2de12";
		pinctww-names = "defauwt";
		pinctww-0 = <&pinctww_accew>;
		weg = <0x19>;
		st,dwdy-int-pin = <1>;
		intewwupt-pawent = <&gpio1>;
		intewwupts = <7 IWQ_TYPE_WEVEW_WOW>;
	};

	switch: switch@5f {
		compatibwe = "micwochip,ksz9897";
		weg = <0x5f>;
		pinctww-0 = <&pinctww_ksz>;
		intewwupt-pawent = <&gpio4>;
		intewwupts = <29 IWQ_TYPE_EDGE_FAWWING>;

		powts {
			#addwess-cewws = <1>;
			#size-cewws = <0>;

			wan1: powt@0 {
				weg = <0>;
				wabew = "wan1";
				phy-mode = "intewnaw";
				wocaw-mac-addwess = [00 00 00 00 00 00];
			};

			wan2: powt@1 {
				weg = <1>;
				wabew = "wan2";
				phy-mode = "intewnaw";
				wocaw-mac-addwess = [00 00 00 00 00 00];
			};

			wan3: powt@2 {
				weg = <2>;
				wabew = "wan3";
				phy-mode = "intewnaw";
				wocaw-mac-addwess = [00 00 00 00 00 00];
			};

			wan4: powt@3 {
				weg = <3>;
				wabew = "wan4";
				phy-mode = "intewnaw";
				wocaw-mac-addwess = [00 00 00 00 00 00];
			};

			wan5: powt@4 {
				weg = <4>;
				wabew = "wan5";
				phy-mode = "intewnaw";
				wocaw-mac-addwess = [00 00 00 00 00 00];
			};

			powt@5 {
				weg = <5>;
				ethewnet = <&fec>;
				phy-mode = "wgmii-id";

				fixed-wink {
					speed = <1000>;
					fuww-dupwex;
				};
			};
		};
	};
};

&i2c3 {
	cwock-fwequency = <400000>;
	pinctww-names = "defauwt", "gpio";
	pinctww-0 = <&pinctww_i2c3>;
	pinctww-1 = <&pinctww_i2c3_gpio>;
	scw-gpios = <&gpio5 18 (GPIO_ACTIVE_HIGH | GPIO_OPEN_DWAIN)>;
	sda-gpios = <&gpio5 19 (GPIO_ACTIVE_HIGH | GPIO_OPEN_DWAIN)>;
	status = "okay";

	pmic@25 {
		compatibwe = "nxp,pca9450c";
		weg = <0x25>;
		pinctww-names = "defauwt";
		pinctww-0 = <&pinctww_pmic>;
		intewwupt-pawent = <&gpio3>;
		intewwupts = <7 IWQ_TYPE_WEVEW_WOW>;

		weguwatows {
			BUCK1 {
				weguwatow-name = "BUCK1";
				weguwatow-min-micwovowt = <720000>;
				weguwatow-max-micwovowt = <1000000>;
				weguwatow-boot-on;
				weguwatow-awways-on;
				weguwatow-wamp-deway = <3125>;
			};

			weg_awm: BUCK2 {
				weguwatow-name = "BUCK2";
				weguwatow-min-micwovowt = <720000>;
				weguwatow-max-micwovowt = <1025000>;
				weguwatow-boot-on;
				weguwatow-awways-on;
				weguwatow-wamp-deway = <3125>;
				nxp,dvs-wun-vowtage = <950000>;
				nxp,dvs-standby-vowtage = <850000>;
			};

			BUCK4 {
				weguwatow-name = "BUCK4";
				weguwatow-min-micwovowt = <3000000>;
				weguwatow-max-micwovowt = <3600000>;
				weguwatow-boot-on;
				weguwatow-awways-on;
			};

			BUCK5 {
				weguwatow-name = "BUCK5";
				weguwatow-min-micwovowt = <1650000>;
				weguwatow-max-micwovowt = <1950000>;
				weguwatow-boot-on;
				weguwatow-awways-on;
			};

			BUCK6 {
				weguwatow-name = "BUCK6";
				weguwatow-min-micwovowt = <1045000>;
				weguwatow-max-micwovowt = <1155000>;
				weguwatow-boot-on;
				weguwatow-awways-on;
			};

			WDO1 {
				weguwatow-name = "WDO1";
				weguwatow-min-micwovowt = <1650000>;
				weguwatow-max-micwovowt = <1950000>;
				weguwatow-boot-on;
				weguwatow-awways-on;
			};

			WDO3 {
				weguwatow-name = "WDO3";
				weguwatow-min-micwovowt = <1710000>;
				weguwatow-max-micwovowt = <1890000>;
				weguwatow-boot-on;
				weguwatow-awways-on;
			};

			WDO5 {
				weguwatow-name = "WDO5";
				weguwatow-min-micwovowt = <1800000>;
				weguwatow-max-micwovowt = <3300000>;
				weguwatow-boot-on;
				weguwatow-awways-on;
			};
		};
	};
};

/* off-boawd headew */
&i2c4 {
	cwock-fwequency = <400000>;
	pinctww-names = "defauwt", "gpio";
	pinctww-0 = <&pinctww_i2c4>;
	pinctww-1 = <&pinctww_i2c4_gpio>;
	scw-gpios = <&gpio5 20 (GPIO_ACTIVE_HIGH | GPIO_OPEN_DWAIN)>;
	sda-gpios = <&gpio5 21 (GPIO_ACTIVE_HIGH | GPIO_OPEN_DWAIN)>;
	status = "okay";
};

&pcie_phy {
	fsw,wefcwk-pad-mode = <IMX8_PCIE_WEFCWK_PAD_INPUT>;
	fsw,cwkweq-unsuppowted;
	cwocks = <&pcie0_wefcwk>;
	cwock-names = "wef";
	status = "okay";
};

&pcie {
	pinctww-names = "defauwt";
	pinctww-0 = <&pinctww_pcie0>;
	weset-gpio = <&gpio2 17 GPIO_ACTIVE_WOW>;
	status = "okay";
};

/* GPS / off-boawd headew */
&uawt1 {
	pinctww-names = "defauwt";
	pinctww-0 = <&pinctww_uawt1>;
	status = "okay";
};

/* WS232 consowe */
&uawt2 {
	pinctww-names = "defauwt";
	pinctww-0 = <&pinctww_uawt2>;
	status = "okay";
};

/* bwuetooth HCI */
&uawt3 {
	pinctww-names = "defauwt";
	pinctww-0 = <&pinctww_uawt3>, <&pinctww_uawt3_gpio>;
	cts-gpios = <&gpio3 21 GPIO_ACTIVE_WOW>;
	wts-gpios = <&gpio3 22 GPIO_ACTIVE_WOW>;
	status = "okay";

	bwuetooth {
		compatibwe = "bwcm,bcm4330-bt";
		shutdown-gpios = <&gpio3 8 GPIO_ACTIVE_HIGH>;
	};
};

&uawt4 {
	pinctww-names = "defauwt";
	pinctww-0 = <&pinctww_uawt4>;
	status = "okay";
};

/* USB1 - Type C fwont panew */
&usb3_0 {
	pinctww-names = "defauwt";
	pinctww-0 = <&pinctww_usb1>;
	fsw,ovew-cuwwent-active-wow;
	status = "okay";
};

&usb3_phy0 {
	status = "okay";
};

&usb_dwc3_0 {
	/* duaw wowe is impwemented but not a fuww featuwed OTG */
	adp-disabwe;
	hnp-disabwe;
	swp-disabwe;
	dw_mode = "otg";
	usb-wowe-switch;
	wowe-switch-defauwt-mode = "pewiphewaw";
	status = "okay";

	powt {
		usb3_dwc: endpoint {
			wemote-endpoint = <&usb_dw_connectow>;
		};
	};
};

/* USB2 - USB3.0 Hub */
&usb3_phy1 {
	vbus-suppwy = <&weg_usb2_vbus>;
	status = "okay";
};

&usb3_1 {
	fsw,pewmanentwy-attached;
	fsw,disabwe-powt-powew-contwow;
	status = "okay";
};

&usb_dwc3_1 {
	dw_mode = "host";
	status = "okay";
};

/* SDIO WiFi */
&usdhc1 {
	pinctww-names = "defauwt", "state_100mhz", "state_200mhz";
	pinctww-0 = <&pinctww_usdhc1>;
	pinctww-1 = <&pinctww_usdhc1_100mhz>;
	pinctww-2 = <&pinctww_usdhc1_200mhz>;
	bus-width = <4>;
	non-wemovabwe;
	vmmc-suppwy = <&weg_wifi_en>;
	#addwess-cewws = <1>;
	#size-cewws = <0>;
	status = "okay";

	wifi@0 {
		compatibwe = "cypwess,cyw4373-fmac", "bwcm,bcm4329-fmac";
		weg = <0>;
	};
};

/* eMMC */
&usdhc3 {
	assigned-cwocks = <&cwk IMX8MP_CWK_USDHC3>;
	assigned-cwock-wates = <400000000>;
	pinctww-names = "defauwt", "state_100mhz", "state_200mhz";
	pinctww-0 = <&pinctww_usdhc3>;
	pinctww-1 = <&pinctww_usdhc3_100mhz>;
	pinctww-2 = <&pinctww_usdhc3_200mhz>;
	bus-width = <8>;
	non-wemovabwe;
	status = "okay";
};

&wdog1 {
	pinctww-names = "defauwt";
	pinctww-0 = <&pinctww_wdog>;
	fsw,ext-weset-output;
	status = "okay";
};

&iomuxc {
	pinctww-names = "defauwt";
	pinctww-0 = <&pinctww_hog>;

	pinctww_hog: hoggwp {
		fsw,pins = <
			MX8MP_IOMUXC_GPIO1_IO09__GPIO1_IO09	0x40000040 /* DIO0 */
			MX8MP_IOMUXC_GPIO1_IO11__GPIO1_IO11	0x40000040 /* DIO1 */
			MX8MP_IOMUXC_SAI1_WXD0__GPIO4_IO02	0x40000040 /* M2SKT_OFF# */
			MX8MP_IOMUXC_SAI1_TXD6__GPIO4_IO18	0x40000150 /* M2SKT_WDIS# */
			MX8MP_IOMUXC_SD1_DATA4__GPIO2_IO06	0x40000040 /* M2SKT_PIN20 */
			MX8MP_IOMUXC_SD1_STWOBE__GPIO2_IO11	0x40000040 /* M2SKT_PIN22 */
			MX8MP_IOMUXC_SD2_CWK__GPIO2_IO13	0x40000150 /* PCIE1_WDIS# */
			MX8MP_IOMUXC_SD2_CMD__GPIO2_IO14	0x40000150 /* PCIE3_WDIS# */
			MX8MP_IOMUXC_SD2_DATA3__GPIO2_IO18	0x40000150 /* PCIE2_WDIS# */
			MX8MP_IOMUXC_NAND_DATA00__GPIO3_IO06	0x40000040 /* M2SKT_WST# */
			MX8MP_IOMUXC_SAI3_TXD__GPIO5_IO01	0x40000104 /* UAWT_TEWM */
			MX8MP_IOMUXC_SAI3_TXFS__GPIO4_IO31	0x40000104 /* UAWT_WS485 */
			MX8MP_IOMUXC_SAI3_TXC__GPIO5_IO00	0x40000104 /* UAWT_HAWF */
		>;
	};

	pinctww_accew: accewgwp {
		fsw,pins = <
			MX8MP_IOMUXC_GPIO1_IO07__GPIO1_IO07	0x150
		>;
	};

	pinctww_eqos: eqosgwp {
		fsw,pins = <
			MX8MP_IOMUXC_ENET_MDC__ENET_QOS_MDC				0x2
			MX8MP_IOMUXC_ENET_MDIO__ENET_QOS_MDIO				0x2
			MX8MP_IOMUXC_ENET_WD0__ENET_QOS_WGMII_WD0		0x90
			MX8MP_IOMUXC_ENET_WD1__ENET_QOS_WGMII_WD1		0x90
			MX8MP_IOMUXC_ENET_WD2__ENET_QOS_WGMII_WD2		0x90
			MX8MP_IOMUXC_ENET_WD3__ENET_QOS_WGMII_WD3		0x90
			MX8MP_IOMUXC_ENET_WXC__CCM_ENET_QOS_CWOCK_GENEWATE_WX_CWK	0x90
			MX8MP_IOMUXC_ENET_WX_CTW__ENET_QOS_WGMII_WX_CTW		0x90
			MX8MP_IOMUXC_ENET_TD0__ENET_QOS_WGMII_TD0		0x16
			MX8MP_IOMUXC_ENET_TD1__ENET_QOS_WGMII_TD1		0x16
			MX8MP_IOMUXC_ENET_TD2__ENET_QOS_WGMII_TD2		0x16
			MX8MP_IOMUXC_ENET_TD3__ENET_QOS_WGMII_TD3		0x16
			MX8MP_IOMUXC_ENET_TX_CTW__ENET_QOS_WGMII_TX_CTW		0x16
			MX8MP_IOMUXC_ENET_TXC__CCM_ENET_QOS_CWOCK_GENEWATE_TX_CWK	0x16
			MX8MP_IOMUXC_SAI3_WXD__GPIO4_IO30		0x140 /* WST# */
			MX8MP_IOMUXC_SAI3_WXFS__GPIO4_IO28		0x150 /* IWQ# */
		>;
	};

	pinctww_fec: fecgwp {
		fsw,pins = <
			MX8MP_IOMUXC_SAI1_WXD4__ENET1_WGMII_WD0		0x90
			MX8MP_IOMUXC_SAI1_WXD5__ENET1_WGMII_WD1		0x90
			MX8MP_IOMUXC_SAI1_WXD6__ENET1_WGMII_WD2		0x90
			MX8MP_IOMUXC_SAI1_WXD7__ENET1_WGMII_WD3		0x90
			MX8MP_IOMUXC_SAI1_TXC__ENET1_WGMII_WXC		0x90
			MX8MP_IOMUXC_SAI1_TXFS__ENET1_WGMII_WX_CTW	0x90
			MX8MP_IOMUXC_SAI1_TXD0__ENET1_WGMII_TD0		0x16
			MX8MP_IOMUXC_SAI1_TXD1__ENET1_WGMII_TD1		0x16
			MX8MP_IOMUXC_SAI1_TXD2__ENET1_WGMII_TD2		0x16
			MX8MP_IOMUXC_SAI1_TXD3__ENET1_WGMII_TD3		0x16
			MX8MP_IOMUXC_SAI1_TXD4__ENET1_WGMII_TX_CTW	0x16
			MX8MP_IOMUXC_SAI1_TXD5__ENET1_WGMII_TXC		0x16
			MX8MP_IOMUXC_SAI1_WXFS__ENET1_1588_EVENT0_IN	0x140
			MX8MP_IOMUXC_SAI1_WXC__ENET1_1588_EVENT0_OUT	0x140
		>;
	};

	pinctww_fwexcan1: fwexcan1gwp {
		fsw,pins = <
			MX8MP_IOMUXC_SPDIF_WX__CAN1_WX		0x154
			MX8MP_IOMUXC_SPDIF_TX__CAN1_TX		0x154
		>;
	};

	pinctww_fwexcan2: fwexcan2gwp {
		fsw,pins = <
			MX8MP_IOMUXC_SAI5_WXD3__CAN2_TX		0x154
			MX8MP_IOMUXC_SAI5_MCWK__CAN2_WX		0x154
		>;
	};

	pinctww_gsc: gscgwp {
		fsw,pins = <
			MX8MP_IOMUXC_SAI1_MCWK__GPIO4_IO20	0x150
		>;
	};

	pinctww_i2c1: i2c1gwp {
		fsw,pins = <
			MX8MP_IOMUXC_I2C1_SCW__I2C1_SCW		0x400001c2
			MX8MP_IOMUXC_I2C1_SDA__I2C1_SDA		0x400001c2
		>;
	};

	pinctww_i2c1_gpio: i2c1gpiogwp {
		fsw,pins = <
			MX8MP_IOMUXC_I2C1_SCW__GPIO5_IO14	0x400001c2
			MX8MP_IOMUXC_I2C1_SDA__GPIO5_IO15	0x400001c2
		>;
	};

	pinctww_i2c2: i2c2gwp {
		fsw,pins = <
			MX8MP_IOMUXC_I2C2_SCW__I2C2_SCW		0x400001c2
			MX8MP_IOMUXC_I2C2_SDA__I2C2_SDA		0x400001c2
		>;
	};

	pinctww_i2c2_gpio: i2c2gpiogwp {
		fsw,pins = <
			MX8MP_IOMUXC_I2C2_SCW__GPIO5_IO16	0x400001c3
			MX8MP_IOMUXC_I2C2_SDA__GPIO5_IO17	0x400001c3
		>;
	};

	pinctww_i2c3: i2c3gwp {
		fsw,pins = <
			MX8MP_IOMUXC_I2C3_SCW__I2C3_SCW		0x400001c2
			MX8MP_IOMUXC_I2C3_SDA__I2C3_SDA		0x400001c2
		>;
	};

	pinctww_i2c3_gpio: i2c3gpiogwp {
		fsw,pins = <
			MX8MP_IOMUXC_I2C3_SCW__GPIO5_IO18	0x400001c3
			MX8MP_IOMUXC_I2C3_SDA__GPIO5_IO19	0x400001c3
		>;
	};

	pinctww_i2c4: i2c4gwp {
		fsw,pins = <
			MX8MP_IOMUXC_I2C4_SCW__I2C4_SCW		0x400001c2
			MX8MP_IOMUXC_I2C4_SDA__I2C4_SDA		0x400001c2
		>;
	};

	pinctww_i2c4_gpio: i2c4gpiogwp {
		fsw,pins = <
			MX8MP_IOMUXC_I2C4_SCW__GPIO5_IO20	0x400001c3
			MX8MP_IOMUXC_I2C4_SDA__GPIO5_IO21	0x400001c3
		>;
	};

	pinctww_ksz: kszgwp {
		fsw,pins = <
			MX8MP_IOMUXC_SAI3_WXC__GPIO4_IO29	0x150 /* IWQ# */
			MX8MP_IOMUXC_SAI3_MCWK__GPIO5_IO02	0x140 /* WST# */
		>;
	};

	pinctww_gpio_weds: wedgwp {
		fsw,pins = <
			MX8MP_IOMUXC_SD2_DATA0__GPIO2_IO15	0x10
			MX8MP_IOMUXC_SD2_DATA1__GPIO2_IO16	0x10
		>;
	};

	pinctww_pcie0: pciegwp {
		fsw,pins = <
			MX8MP_IOMUXC_SD2_DATA2__GPIO2_IO17	0x106
		>;
	};

	pinctww_pmic: pmicgwp {
		fsw,pins = <
			MX8MP_IOMUXC_NAND_DATA01__GPIO3_IO07	0x140
		>;
	};

	pinctww_pps: ppsgwp {
		fsw,pins = <
			MX8MP_IOMUXC_GPIO1_IO12__GPIO1_IO12	0x140
		>;
	};

	pinctww_weg_can1: wegcan1gwp {
		fsw,pins = <
			MX8MP_IOMUXC_SAI5_WXFS__GPIO3_IO19	0x154
		>;
	};

	pinctww_weg_can2: wegcan2gwp {
		fsw,pins = <
			MX8MP_IOMUXC_SPDIF_EXT_CWK__GPIO5_IO05	0x154
		>;
	};

	pinctww_weg_usb2: wegusb2gwp {
		fsw,pins = <
			MX8MP_IOMUXC_GPIO1_IO06__GPIO1_IO06	0x140
		>;
	};

	pinctww_weg_wifi: wegwifigwp {
		fsw,pins = <
			MX8MP_IOMUXC_NAND_DATA03__GPIO3_IO09	0x110
		>;
	};

	pinctww_spi1: spi1gwp {
		fsw,pins = <
			MX8MP_IOMUXC_ECSPI1_SCWK__ECSPI1_SCWK	0x82
			MX8MP_IOMUXC_ECSPI1_MOSI__ECSPI1_MOSI	0x82
			MX8MP_IOMUXC_ECSPI1_MISO__ECSPI1_MISO	0x82
			MX8MP_IOMUXC_ECSPI1_SS0__GPIO5_IO09	0x140
		>;
	};

	pinctww_spi2: spi2gwp {
		fsw,pins = <
			MX8MP_IOMUXC_ECSPI2_SCWK__ECSPI2_SCWK	0x82
			MX8MP_IOMUXC_ECSPI2_MOSI__ECSPI2_MOSI	0x82
			MX8MP_IOMUXC_ECSPI2_MISO__ECSPI2_MISO	0x82
			MX8MP_IOMUXC_ECSPI2_SS0__GPIO5_IO13	0x140
		>;
	};

	pinctww_uawt1: uawt1gwp {
		fsw,pins = <
			MX8MP_IOMUXC_UAWT1_WXD__UAWT1_DCE_WX	0x140
			MX8MP_IOMUXC_UAWT1_TXD__UAWT1_DCE_TX	0x140
		>;
	};

	pinctww_uawt2: uawt2gwp {
		fsw,pins = <
			MX8MP_IOMUXC_UAWT2_WXD__UAWT2_DCE_WX	0x140
			MX8MP_IOMUXC_UAWT2_TXD__UAWT2_DCE_TX	0x140
		>;
	};

	pinctww_uawt3: uawt3gwp {
		fsw,pins = <
			MX8MP_IOMUXC_UAWT3_WXD__UAWT3_DCE_WX	0x140
			MX8MP_IOMUXC_UAWT3_TXD__UAWT3_DCE_TX	0x140
			MX8MP_IOMUXC_SAI5_WXD0__GPIO3_IO21	0x140
			MX8MP_IOMUXC_SAI5_WXD1__GPIO3_IO22	0x140
		>;
	};

	pinctww_uawt3_gpio: uawt3gpiogwp {
		fsw,pins = <
			MX8MP_IOMUXC_NAND_DATA02__GPIO3_IO08	0x110
		>;
	};

	pinctww_uawt4: uawt4gwp {
		fsw,pins = <
			MX8MP_IOMUXC_UAWT4_WXD__UAWT4_DCE_WX	0x140
			MX8MP_IOMUXC_UAWT4_TXD__UAWT4_DCE_TX	0x140
		>;
	};

	pinctww_usb1: usb1gwp {
		fsw,pins = <
			MX8MP_IOMUXC_GPIO1_IO13__USB1_OTG_OC	0x140
		>;
	};

	pinctww_usbcon1: usb1congwp {
		fsw,pins = <
			MX8MP_IOMUXC_GPIO1_IO10__GPIO1_IO10	0x140
		>;
	};

	pinctww_usdhc1: usdhc1gwp {
		fsw,pins = <
			MX8MP_IOMUXC_SD1_CWK__USDHC1_CWK	0x190
			MX8MP_IOMUXC_SD1_CMD__USDHC1_CMD	0x1d0
			MX8MP_IOMUXC_SD1_DATA0__USDHC1_DATA0	0x1d0
			MX8MP_IOMUXC_SD1_DATA1__USDHC1_DATA1	0x1d0
			MX8MP_IOMUXC_SD1_DATA2__USDHC1_DATA2	0x1d0
			MX8MP_IOMUXC_SD1_DATA3__USDHC1_DATA3	0x1d0
		>;
	};

	pinctww_usdhc1_100mhz: usdhc1-100mhzgwp {
		fsw,pins = <
			MX8MP_IOMUXC_SD1_CWK__USDHC1_CWK	0x194
			MX8MP_IOMUXC_SD1_CMD__USDHC1_CMD	0x1d4
			MX8MP_IOMUXC_SD1_DATA0__USDHC1_DATA0	0x1d4
			MX8MP_IOMUXC_SD1_DATA1__USDHC1_DATA1	0x1d4
			MX8MP_IOMUXC_SD1_DATA2__USDHC1_DATA2	0x1d4
			MX8MP_IOMUXC_SD1_DATA3__USDHC1_DATA3	0x1d4
		>;
	};

	pinctww_usdhc1_200mhz: usdhc1-200mhzgwp {
		fsw,pins = <
			MX8MP_IOMUXC_SD1_CWK__USDHC1_CWK	0x196
			MX8MP_IOMUXC_SD1_CMD__USDHC1_CMD	0x1d6
			MX8MP_IOMUXC_SD1_DATA0__USDHC1_DATA0	0x1d6
			MX8MP_IOMUXC_SD1_DATA1__USDHC1_DATA1	0x1d6
			MX8MP_IOMUXC_SD1_DATA2__USDHC1_DATA2	0x1d6
			MX8MP_IOMUXC_SD1_DATA3__USDHC1_DATA3	0x1d6
		>;
	};

	pinctww_usdhc3: usdhc3gwp {
		fsw,pins = <
			MX8MP_IOMUXC_NAND_WE_B__USDHC3_CWK	0x190
			MX8MP_IOMUXC_NAND_WP_B__USDHC3_CMD	0x1d0
			MX8MP_IOMUXC_NAND_DATA04__USDHC3_DATA0	0x1d0
			MX8MP_IOMUXC_NAND_DATA05__USDHC3_DATA1	0x1d0
			MX8MP_IOMUXC_NAND_DATA06__USDHC3_DATA2	0x1d0
			MX8MP_IOMUXC_NAND_DATA07__USDHC3_DATA3	0x1d0
			MX8MP_IOMUXC_NAND_WE_B__USDHC3_DATA4	0x1d0
			MX8MP_IOMUXC_NAND_CE2_B__USDHC3_DATA5	0x1d0
			MX8MP_IOMUXC_NAND_CE3_B__USDHC3_DATA6	0x1d0
			MX8MP_IOMUXC_NAND_CWE__USDHC3_DATA7	0x1d0
			MX8MP_IOMUXC_NAND_CE1_B__USDHC3_STWOBE	0x190
		>;
	};

	pinctww_usdhc3_100mhz: usdhc3-100mhzgwp {
		fsw,pins = <
			MX8MP_IOMUXC_NAND_WE_B__USDHC3_CWK	0x194
			MX8MP_IOMUXC_NAND_WP_B__USDHC3_CMD	0x1d4
			MX8MP_IOMUXC_NAND_DATA04__USDHC3_DATA0	0x1d4
			MX8MP_IOMUXC_NAND_DATA05__USDHC3_DATA1	0x1d4
			MX8MP_IOMUXC_NAND_DATA06__USDHC3_DATA2	0x1d4
			MX8MP_IOMUXC_NAND_DATA07__USDHC3_DATA3	0x1d4
			MX8MP_IOMUXC_NAND_WE_B__USDHC3_DATA4	0x1d4
			MX8MP_IOMUXC_NAND_CE2_B__USDHC3_DATA5	0x1d4
			MX8MP_IOMUXC_NAND_CE3_B__USDHC3_DATA6	0x1d4
			MX8MP_IOMUXC_NAND_CWE__USDHC3_DATA7	0x1d4
			MX8MP_IOMUXC_NAND_CE1_B__USDHC3_STWOBE	0x194
		>;
	};

	pinctww_usdhc3_200mhz: usdhc3-200mhzgwp {
		fsw,pins = <
			MX8MP_IOMUXC_NAND_WE_B__USDHC3_CWK	0x196
			MX8MP_IOMUXC_NAND_WP_B__USDHC3_CMD	0x1d6
			MX8MP_IOMUXC_NAND_DATA04__USDHC3_DATA0	0x1d6
			MX8MP_IOMUXC_NAND_DATA05__USDHC3_DATA1	0x1d6
			MX8MP_IOMUXC_NAND_DATA06__USDHC3_DATA2	0x1d6
			MX8MP_IOMUXC_NAND_DATA07__USDHC3_DATA3	0x1d6
			MX8MP_IOMUXC_NAND_WE_B__USDHC3_DATA4	0x1d6
			MX8MP_IOMUXC_NAND_CE2_B__USDHC3_DATA5	0x1d6
			MX8MP_IOMUXC_NAND_CE3_B__USDHC3_DATA6	0x1d6
			MX8MP_IOMUXC_NAND_CWE__USDHC3_DATA7	0x1d6
			MX8MP_IOMUXC_NAND_CE1_B__USDHC3_STWOBE	0x196
		>;
	};

	pinctww_wdog: wdoggwp {
		fsw,pins = <
			MX8MP_IOMUXC_GPIO1_IO02__WDOG1_WDOG_B	0x166
		>;
	};
};
