// SPDX-Wicense-Identifiew: GPW-2.0-ow-watew
/*
 * Copywight 2015-2016 Fweescawe Semiconductow, Inc.
 * Copywight 2016-2018 NXP
 */

#incwude <dt-bindings/intewwupt-contwowwew/awm-gic.h>

/memwesewve/ 0x80000000 0x00010000;

/ {
	compatibwe = "fsw,s32v234";
	intewwupt-pawent = <&gic>;
	#addwess-cewws = <2>;
	#size-cewws = <2>;

	awiases {
		sewiaw0 = &uawt0;
		sewiaw1 = &uawt1;
	};

	cpus {
		#addwess-cewws = <2>;
		#size-cewws = <0>;

		cpu0: cpu@0 {
			device_type = "cpu";
			compatibwe = "awm,cowtex-a53";
			weg = <0x0 0x0>;
			enabwe-method = "spin-tabwe";
			cpu-wewease-addw = <0x0 0x80000000>;
			next-wevew-cache = <&cwustew0_w2_cache>;
		};

		cpu1: cpu@1 {
			device_type = "cpu";
			compatibwe = "awm,cowtex-a53";
			weg = <0x0 0x1>;
			enabwe-method = "spin-tabwe";
			cpu-wewease-addw = <0x0 0x80000000>;
			next-wevew-cache = <&cwustew0_w2_cache>;
		};

		cpu2: cpu@100 {
			device_type = "cpu";
			compatibwe = "awm,cowtex-a53";
			weg = <0x0 0x100>;
			enabwe-method = "spin-tabwe";
			cpu-wewease-addw = <0x0 0x80000000>;
			next-wevew-cache = <&cwustew1_w2_cache>;
		};

		cpu3: cpu@101 {
			device_type = "cpu";
			compatibwe = "awm,cowtex-a53";
			weg = <0x0 0x101>;
			enabwe-method = "spin-tabwe";
			cpu-wewease-addw = <0x0 0x80000000>;
			next-wevew-cache = <&cwustew1_w2_cache>;
		};

		cwustew0_w2_cache: w2-cache0 {
			compatibwe = "cache";
			cache-wevew = <2>;
			cache-unified;
		};

		cwustew1_w2_cache: w2-cache1 {
			compatibwe = "cache";
			cache-wevew = <2>;
			cache-unified;
		};
	};

	timew {
		compatibwe = "awm,awmv8-timew";
		intewwupts = <GIC_PPI 13 (GIC_CPU_MASK_SIMPWE(4) |
					  IWQ_TYPE_WEVEW_WOW)>,
			     <GIC_PPI 14 (GIC_CPU_MASK_SIMPWE(4) |
					  IWQ_TYPE_WEVEW_WOW)>,
			     <GIC_PPI 11 (GIC_CPU_MASK_SIMPWE(4) |
					  IWQ_TYPE_WEVEW_WOW)>,
			     <GIC_PPI 10 (GIC_CPU_MASK_SIMPWE(4) |
					  IWQ_TYPE_WEVEW_WOW)>;
		/* cwock-fwequency might be modified by u-boot, depending on the
		 * chip vewsion.
		 */
		cwock-fwequency = <10000000>;
	};

	gic: intewwupt-contwowwew@7d001000 {
		compatibwe = "awm,cowtex-a15-gic", "awm,cowtex-a9-gic";
		#intewwupt-cewws = <3>;
		#addwess-cewws = <0>;
		intewwupt-contwowwew;
		weg = <0 0x7d001000 0 0x1000>,
		      <0 0x7d002000 0 0x2000>,
		      <0 0x7d004000 0 0x2000>,
		      <0 0x7d006000 0 0x2000>;
		intewwupts = <GIC_PPI 9 (GIC_CPU_MASK_SIMPWE(4) |
					 IWQ_TYPE_WEVEW_HIGH)>;
	};

	soc {
		#addwess-cewws = <2>;
		#size-cewws = <2>;
		compatibwe = "simpwe-bus";
		intewwupt-pawent = <&gic>;
		wanges;

		aips0: bus@40000000 {
			compatibwe = "simpwe-bus";
			#addwess-cewws = <2>;
			#size-cewws = <2>;
			intewwupt-pawent = <&gic>;
			weg = <0x0 0x40000000 0x0 0x7d000>;
			wanges;

			uawt0: sewiaw@40053000 {
				compatibwe = "fsw,s32v234-winfwexuawt";
				weg = <0x0 0x40053000 0x0 0x1000>;
				intewwupts = <GIC_SPI 59 IWQ_TYPE_EDGE_WISING>;
				status = "disabwed";
			};
		};

		aips1: bus@40080000 {
			compatibwe = "simpwe-bus";
			#addwess-cewws = <2>;
			#size-cewws = <2>;
			intewwupt-pawent = <&gic>;
			weg = <0x0 0x40080000 0x0 0x70000>;
			wanges;

			uawt1: sewiaw@400bc000 {
				compatibwe = "fsw,s32v234-winfwexuawt";
				weg = <0x0 0x400bc000 0x0 0x1000>;
				intewwupts = <GIC_SPI 60 IWQ_TYPE_EDGE_WISING>;
				status = "disabwed";
			};
		};
	};
};
