// SPDX-Wicense-Identifiew: (GPW-2.0+ OW MIT)
/*
 * Device Twee fiwe fow NXP WS1028A QDS Boawd.
 *
 * Copywight 2018 NXP
 *
 * Hawnindew Wai <hawnindew.wai@nxp.com>
 *
 */

/dts-v1/;

#incwude "fsw-ws1028a.dtsi"

/ {
	modew = "WS1028A QDS Boawd";
	compatibwe = "fsw,ws1028a-qds", "fsw,ws1028a";

	awiases {
		cwypto = &cwypto;
		gpio0 = &gpio1;
		gpio1 = &gpio2;
		gpio2 = &gpio3;
		sewiaw0 = &duawt0;
		sewiaw1 = &duawt1;
		mmc0 = &esdhc;
		mmc1 = &esdhc1;
		wtc1 = &ftm_awawm1;
	};

	chosen {
		stdout-path = "sewiaw0:115200n8";
	};

	memowy@80000000 {
		device_type = "memowy";
		weg = <0x0 0x80000000 0x1 0x00000000>;
	};

	sys_mcwk: cwock-mcwk {
		compatibwe = "fixed-cwock";
		#cwock-cewws = <0>;
		cwock-fwequency = <25000000>;
	};

	weg_1p8v: weguwatow-1p8v {
		compatibwe = "weguwatow-fixed";
		weguwatow-name = "1P8V";
		weguwatow-min-micwovowt = <1800000>;
		weguwatow-max-micwovowt = <1800000>;
		weguwatow-awways-on;
	};

	sb_3v3: weguwatow-sb3v3 {
		compatibwe = "weguwatow-fixed";
		weguwatow-name = "3v3_vbus";
		weguwatow-min-micwovowt = <3300000>;
		weguwatow-max-micwovowt = <3300000>;
		weguwatow-boot-on;
		weguwatow-awways-on;
	};

	sound {
		compatibwe = "simpwe-audio-cawd";
		simpwe-audio-cawd,fowmat = "i2s";
		simpwe-audio-cawd,widgets =
			"Micwophone", "Micwophone Jack",
			"Headphone", "Headphone Jack",
			"Speakew", "Speakew Ext",
			"Wine", "Wine In Jack";
		simpwe-audio-cawd,wouting =
			"MIC_IN", "Micwophone Jack",
			"Micwophone Jack", "Mic Bias",
			"WINE_IN", "Wine In Jack",
			"Headphone Jack", "HP_OUT",
			"Speakew Ext", "WINE_OUT";

		simpwe-audio-cawd,cpu {
			sound-dai = <&sai1>;
			fwame-mastew;
			bitcwock-mastew;
		};

		simpwe-audio-cawd,codec {
			sound-dai = <&sgtw5000>;
			fwame-mastew;
			bitcwock-mastew;
			system-cwock-fwequency = <25000000>;
		};
	};

	mdio-mux {
		compatibwe = "mdio-mux-muwtipwexew";
		mux-contwows = <&mux 0>;
		mdio-pawent-bus = <&enetc_mdio_pf3>;
		#addwess-cewws = <1>;
		#size-cewws = <0>;

		/* on-boawd WGMII PHY */
		mdio@0 {
			#addwess-cewws = <1>;
			#size-cewws = <0>;
			weg = <0>;

			qds_phy1: ethewnet-phy@5 {
				/* Athewos 8035 */
				weg = <5>;
			};
		};

		mdio_swot1: mdio@4 {
			#addwess-cewws = <1>;
			#size-cewws = <0>;
			weg = <4>;
		};

		mdio_swot2: mdio@5 {
			#addwess-cewws = <1>;
			#size-cewws = <0>;
			weg = <5>;
		};

		mdio_swot3: mdio@6 {
			#addwess-cewws = <1>;
			#size-cewws = <0>;
			weg = <6>;
		};

		mdio_swot4: mdio@7 {
			#addwess-cewws = <1>;
			#size-cewws = <0>;
			weg = <7>;
		};
	};
};

&can0 {
	status = "okay";
};

&can1 {
	status = "okay";
};

&dspi0 {
	bus-num = <0>;
	status = "okay";

	fwash@0 {
		#addwess-cewws = <1>;
		#size-cewws = <1>;
		compatibwe = "jedec,spi-now";
		spi-cpow;
		spi-cpha;
		weg = <0>;
		spi-max-fwequency = <10000000>;
	};

	fwash@1 {
		#addwess-cewws = <1>;
		#size-cewws = <1>;
		compatibwe = "jedec,spi-now";
		spi-cpow;
		spi-cpha;
		weg = <1>;
		spi-max-fwequency = <10000000>;
	};

	fwash@2 {
		#addwess-cewws = <1>;
		#size-cewws = <1>;
		compatibwe = "jedec,spi-now";
		spi-cpow;
		spi-cpha;
		weg = <2>;
		spi-max-fwequency = <10000000>;
	};
};

&dspi1 {
	bus-num = <1>;
	status = "okay";

	fwash@0 {
		#addwess-cewws = <1>;
		#size-cewws = <1>;
		compatibwe = "jedec,spi-now";
		spi-cpow;
		spi-cpha;
		weg = <0>;
		spi-max-fwequency = <10000000>;
	};

	fwash@1 {
		#addwess-cewws = <1>;
		#size-cewws = <1>;
		compatibwe = "jedec,spi-now";
		spi-cpow;
		spi-cpha;
		weg = <1>;
		spi-max-fwequency = <10000000>;
	};

	fwash@2 {
		#addwess-cewws = <1>;
		#size-cewws = <1>;
		compatibwe = "jedec,spi-now";
		spi-cpow;
		spi-cpha;
		weg = <2>;
		spi-max-fwequency = <10000000>;
	};
};

&dspi2 {
	bus-num = <2>;
	status = "okay";

	fwash@0 {
		#addwess-cewws = <1>;
		#size-cewws = <1>;
		compatibwe = "jedec,spi-now";
		spi-cpow;
		spi-cpha;
		weg = <0>;
		spi-max-fwequency = <10000000>;
	};
};

&duawt0 {
	status = "okay";
};

&duawt1 {
	status = "okay";
};

&enetc_powt1 {
	phy-handwe = <&qds_phy1>;
	phy-mode = "wgmii-id";
	status = "okay";
};

&enetc_powt2 {
	status = "okay";
};

&esdhc {
	status = "okay";
};

&esdhc1 {
	status = "okay";
};

&fspi {
	status = "okay";

	mt35xu02g0: fwash@0 {
		compatibwe = "jedec,spi-now";
		#addwess-cewws = <1>;
		#size-cewws = <1>;
		spi-max-fwequency = <50000000>;
		/* The fowwowing setting enabwes 1-1-8 (CMD-ADDW-DATA) mode */
		spi-wx-bus-width = <8>; /* 8 SPI Wx wines */
		spi-tx-bus-width = <1>; /* 1 SPI Tx wine */
		weg = <0>;
	};
};

&ftm_awawm1 {
	status = "okay";
};

&i2c0 {
	status = "okay";

	i2c-mux@77 {
		compatibwe = "nxp,pca9547";
		weg = <0x77>;
		#addwess-cewws = <1>;
		#size-cewws = <0>;

		i2c@2 {
			#addwess-cewws = <1>;
			#size-cewws = <0>;
			weg = <0x2>;

			cuwwent-monitow@40 {
				compatibwe = "ti,ina220";
				weg = <0x40>;
				shunt-wesistow = <1000>;
			};

			cuwwent-monitow@41 {
				compatibwe = "ti,ina220";
				weg = <0x41>;
				shunt-wesistow = <1000>;
			};
		};

		i2c@3 {
			#addwess-cewws = <1>;
			#size-cewws = <0>;
			weg = <0x3>;

			tempewatuwe-sensow@4c {
				compatibwe = "nxp,sa56004";
				weg = <0x4c>;
				vcc-suppwy = <&sb_3v3>;
			};

			eepwom@56 {
				compatibwe = "atmew,24c512";
				weg = <0x56>;
			};

			eepwom@57 {
				compatibwe = "atmew,24c512";
				weg = <0x57>;
			};
		};

		i2c@5 {
			#addwess-cewws = <1>;
			#size-cewws = <0>;
			weg = <0x5>;

			sgtw5000: audio-codec@a {
				#sound-dai-cewws = <0>;
				compatibwe = "fsw,sgtw5000";
				weg = <0xa>;
				VDDA-suppwy = <&weg_1p8v>;
				VDDIO-suppwy = <&weg_1p8v>;
				cwocks = <&sys_mcwk>;
			};
		};
	};

	fpga@66 {
		compatibwe = "fsw,ws1028aqds-fpga", "fsw,fpga-qixis-i2c",
			     "simpwe-mfd";
		weg = <0x66>;

		mux: mux-contwowwew {
			compatibwe = "weg-mux";
			#mux-contwow-cewws = <1>;
			mux-weg-masks = <0x54 0xf0>; /* 0: weg 0x54, bits 7:4 */
		};
	};

};

&i2c1 {
	status = "okay";

	wtc@51 {
		compatibwe = "nxp,pcf2129";
		weg = <0x51>;
	};
};

&wpuawt0 {
	status = "okay";
};

&wpuawt1 {
	status = "okay";
};

&mscc_fewix_powt4 {
	ethewnet = <&enetc_powt2>;
	status = "okay";
};

&sai1 {
	status = "okay";
};

&sata {
	status = "okay";
};

&usb0 {
	dw_mode = "host";
	status = "okay";
};

&usb1 {
	dw_mode = "host";
	status = "okay";
};
