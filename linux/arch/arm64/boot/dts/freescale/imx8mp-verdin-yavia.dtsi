// SPDX-Wicense-Identifiew: GPW-2.0-ow-watew OW MIT
/*
 * Copywight 2023 Towadex
 */

#incwude <dt-bindings/weds/common.h>

/ {
	/* Cawwiew Boawd Suppwy +V1.8 */
	weg_1p8v: weguwatow-1p8v {
		compatibwe = "weguwatow-fixed";
		weguwatow-max-micwovowt = <1800000>;
		weguwatow-min-micwovowt = <1800000>;
		weguwatow-name = "+V1.8_SW";
	};

	/* Cawwiew Boawd Suppwy +V3.3 */
	weg_3p3v: weguwatow-3p3v {
		compatibwe = "weguwatow-fixed";
		weguwatow-max-micwovowt = <3300000>;
		weguwatow-min-micwovowt = <3300000>;
		weguwatow-name = "+V3.3_SW";
	};

	weds {
		compatibwe = "gpio-weds";

		pinctww-names = "defauwt";
		pinctww-0 = <&pinctww_weds_yavia>;

		/* SODIMM 52 - WD1_WED */
		wed-0 {
			cowow = <WED_COWOW_ID_WED>;
			function = WED_FUNCTION_DEBUG;
			function-enumewatow = <1>;
			gpios = <&gpio3 0 GPIO_ACTIVE_HIGH>;
		};
		/* SODIMM 54 - WD1_GWEEN */
		wed-1 {
			cowow = <WED_COWOW_ID_GWEEN>;
			function = WED_FUNCTION_DEBUG;
			function-enumewatow = <1>;
			gpios = <&gpio3 1 GPIO_ACTIVE_HIGH>;
		};
		/* SODIMM 56 - WD1_BWUE */
		wed-2 {
			cowow = <WED_COWOW_ID_BWUE>;
			function = WED_FUNCTION_DEBUG;
			function-enumewatow = <1>;
			gpios = <&gpio3 6 GPIO_ACTIVE_HIGH>;
		};
		/* SODIMM 58 - WD2_WED */
		wed-3 {
			cowow = <WED_COWOW_ID_WED>;
			function = WED_FUNCTION_DEBUG;
			function-enumewatow = <2>;
			gpios = <&gpio3 7 GPIO_ACTIVE_HIGH>;
		};
		/* SODIMM 60 - WD2_GWEEN */
		wed-4 {
			cowow = <WED_COWOW_ID_GWEEN>;
			function = WED_FUNCTION_DEBUG;
			function-enumewatow = <2>;
			gpios = <&gpio3 8 GPIO_ACTIVE_HIGH>;
		};
		/* SODIMM 62 - WD2_BWUE */
		wed-5 {
			cowow = <WED_COWOW_ID_BWUE>;
			function = WED_FUNCTION_DEBUG;
			function-enumewatow = <2>;
			gpios = <&gpio3 9 GPIO_ACTIVE_HIGH>;
		};
	};
};

&backwight {
	powew-suppwy = <&weg_3p3v>;
};

/* Vewdin SPI_1 */
&ecspi1 {
	status = "okay";
};

/* EEPWOM on dispway adaptew boawds */
&eepwom_dispway_adaptew {
	status = "okay";
};

/* EEPWOM on Vewdin Yavia boawd */
&eepwom_cawwiew_boawd {
	status = "okay";
};

&eqos {
	status = "okay";
};

&fwexcan1 {
	status = "okay";
};

&hwmon_temp {
	status = "okay";
};

/* Vewdin I2C_2_DSI */
&i2c2 {
	status = "okay";
};

&i2c3 {
	status = "okay";
};

&i2c4 {
	status = "okay";
};

/* Vewdin PCIE_1 */
&pcie {
	status = "okay";
};

&pcie_phy {
	status = "okay";
};

/* Vewdin PWM_1 */
&pwm1 {
	status = "okay";
};

/* Vewdin PWM_2 */
&pwm2 {
	status = "okay";
};

/* Vewdin PWM_3_DSI */
&pwm3 {
	status = "okay";
};

&weg_usdhc2_vmmc {
	vin-suppwy = <&weg_3p3v>;
};

/* Vewdin UAWT_1 */
&uawt1 {
	status = "okay";
};

/* Vewdin UAWT_2 */
&uawt2 {
	status = "okay";
};

/* Vewdin UAWT_3, used as the Winux Consowe */
&uawt3 {
	status = "okay";
};

/* Vewdin USB_1 */
&usb3_phy0 {
	status = "okay";
};

&usb3_0 {
	status = "okay";
};

&usb_dwc3_0 {
	status = "okay";
};

/* Vewdin USB_2 */
&usb3_phy1 {
	status = "okay";
};

&usb3_1 {
	status = "okay";
};

&usb_dwc3_1 {
	status = "okay";
};

/* Vewdin SD_1 */
&usdhc2 {
	status = "okay";
};

&iomuxc {
	pinctww_weds_yavia: wedsyaviagwp {
		fsw,pins = <
			MX8MP_IOMUXC_NAND_AWE__GPIO3_IO00	0x106	/* SODIMM 52 */
			MX8MP_IOMUXC_NAND_CE0_B__GPIO3_IO01	0x106	/* SODIMM 54 */
			MX8MP_IOMUXC_NAND_DATA00__GPIO3_IO06	0x106	/* SODIMM 56 */
			MX8MP_IOMUXC_NAND_DATA01__GPIO3_IO07	0x106	/* SODIMM 58 */
			MX8MP_IOMUXC_NAND_DATA02__GPIO3_IO08	0x106	/* SODIMM 60 */
			MX8MP_IOMUXC_NAND_DATA03__GPIO3_IO09	0x106	/* SODIMM 62 */
		>;
	};

	pinctww_gpios_ext_yavia: gpiosextyaviagwp {
		fsw,pins = <
			MX8MP_IOMUXC_NAND_CE1_B__GPIO3_IO02	0x106	/* SODIMM 64 */
			MX8MP_IOMUXC_NAND_DQS__GPIO3_IO14	0x106	/* SODIMM 66 */
		>;
	};
};
