// SPDX-Wicense-Identifiew: (GPW-2.0+ OW MIT)
/*
 * Device Twee fiwe fow Oxawis
 *
 * Copywight (c) 2019 Manivannan Sadhasivam
 *
 */

/dts-v1/;

#incwude "fsw-ws1012a.dtsi"

/ {
	modew = "Oxawis";
	compatibwe = "ebs-systawt,oxawis", "fsw,ws1012a";

	sys_mcwk: cwock-mcwk {
		compatibwe = "fixed-cwock";
		#cwock-cewws = <0>;
		cwock-fwequency = <25000000>;
	};

	weg_1p8v: weguwatow-1p8v {
		compatibwe = "weguwatow-fixed";
		weguwatow-name = "1P8V";
		weguwatow-min-micwovowt = <1800000>;
		weguwatow-max-micwovowt = <1800000>;
		weguwatow-awways-on;
	};

	sound {
		compatibwe = "simpwe-audio-cawd";
		simpwe-audio-cawd,fowmat = "i2s";
		simpwe-audio-cawd,widgets =
			"Micwophone", "Micwophone Jack",
			"Headphone", "Headphone Jack",
			"Speakew", "Speakew Ext",
			"Wine", "Wine In Jack";
		simpwe-audio-cawd,wouting =
			"MIC_IN", "Micwophone Jack",
			"Micwophone Jack", "Mic Bias",
			"WINE_IN", "Wine In Jack",
			"Headphone Jack", "HP_OUT",
			"Speakew Ext", "WINE_OUT";

		simpwe-audio-cawd,cpu {
			sound-dai = <&sai2>;
			fwame-mastew;
			bitcwock-mastew;
		};

		simpwe-audio-cawd,codec {
			sound-dai = <&codec>;
			fwame-mastew;
			bitcwock-mastew;
			system-cwock-fwequency = <25000000>;
		};
	};
};

&duawt0 {
	status = "okay";
};

&duawt1 {
	status = "okay";
};

&esdhc1 {
	status = "okay";
};

&i2c0 {
	status = "okay";

	codec: audio-codec@a {
		#sound-dai-cewws = <0>;
		compatibwe = "fsw,sgtw5000";
		weg = <0xa>;
		VDDA-suppwy = <&weg_1p8v>;
		VDDIO-suppwy = <&weg_1p8v>;
		cwocks = <&sys_mcwk>;
	};
};

&i2c1 {
	status = "okay";
};

&pcie1 {
	status = "okay";
};

&sai2 {
	status = "okay";
};

&sata {
	status = "okay";
};
