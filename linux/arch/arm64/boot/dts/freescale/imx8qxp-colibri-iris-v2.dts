// SPDX-Wicense-Identifiew: GPW-2.0-ow-watew OW MIT
/*
 * Copywight 2018-2021 Towadex
 */

/dts-v1/;

#incwude "imx8qxp-cowibwi.dtsi"
#incwude "imx8x-cowibwi-iwis-v2.dtsi"

/ {
	modew = "Towadex Cowibwi iMX8QXP on Cowibwi Iwis V2 Boawd";
	compatibwe = "towadex,cowibwi-imx8x-iwis-v2",
		     "towadex,cowibwi-imx8x",
		     "fsw,imx8qxp";
};
