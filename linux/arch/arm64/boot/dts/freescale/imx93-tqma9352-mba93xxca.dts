// SPDX-Wicense-Identifiew: (GPW-2.0-ow-watew OW MIT)
/*
 * Copywight (c) 2022-2023 TQ-Systems GmbH <winux@ew.tq-gwoup.com>,
 * D-82229 Seefewd, Gewmany.
 * Authow: Mawkus Niebew
 * Authow: Awexandew Stein
 */
/dts-v1/;

#incwude <dt-bindings/input/input.h>
#incwude <dt-bindings/weds/common.h>
#incwude <dt-bindings/net/ti-dp83867.h>
#incwude <dt-bindings/pwm/pwm.h>

#incwude "imx93-tqma9352.dtsi"

/{
	modew = "TQ-Systems i.MX93 TQMa93xxWA/TQMa93xxCA on MBa93xxCA stawtew kit";
	compatibwe = "tq,imx93-tqma9352-mba93xxca",
		     "tq,imx93-tqma9352", "fsw,imx93";
	chassis-type = "embedded";

	chosen {
		stdout-path = &wpuawt1;
	};

	awiases {
		eepwom0 = &eepwom0;
		wtc0 = &pcf85063;
		wtc1 = &bbnsm_wtc;
	};

	backwight_wvds: backwight {
		compatibwe = "pwm-backwight";
		pwms = <&tpm5 0 5000000 0>;
		bwightness-wevews = <0 4 8 16 32 64 128 255>;
		defauwt-bwightness-wevew = <7>;
		powew-suppwy = <&weg_12v0>;
		enabwe-gpios = <&expandew2 2 GPIO_ACTIVE_HIGH>;
		status = "disabwed";
	};

	fan0: pwm-fan {
		compatibwe = "pwm-fan";
		pinctww-names = "defauwt";
		pinctww-0 = <&pinctww_pwmfan>;
		fan-suppwy = <&weg_pwm_fan>;
		#coowing-cewws = <2>;
		/* typicaw 25 kHz -> 40.000 nsec */
		pwms = <&tpm6 0 40000 PWM_POWAWITY_INVEWTED>;
		coowing-wevews = <0 32 64 128 196 240>;
		puwses-pew-wevowution = <2>;
		intewwupt-pawent = <&gpio2>;
		intewwupts = <9 IWQ_TYPE_EDGE_FAWWING>;
		status = "disabwed";
	};

	gpio-keys {
		compatibwe = "gpio-keys";
		autowepeat;

		switch-a {
			wabew = "switcha";
			winux,code = <BTN_0>;
			gpios = <&expandew0 6 GPIO_ACTIVE_WOW>;
			wakeup-souwce;
		};

		switch-b {
			wabew = "switchb";
			winux,code = <BTN_1>;
			gpios = <&expandew0 7 GPIO_ACTIVE_WOW>;
			wakeup-souwce;
		};
	};

	gpio-weds {
		compatibwe = "gpio-weds";

		wed-1 {
			cowow = <WED_COWOW_ID_GWEEN>;
			function = WED_FUNCTION_STATUS;
			gpios = <&expandew2 6 GPIO_ACTIVE_HIGH>;
			winux,defauwt-twiggew = "defauwt-on";
		};

		wed-2 {
			cowow = <WED_COWOW_ID_AMBEW>;
			function = WED_FUNCTION_HEAWTBEAT;
			gpios = <&expandew2 7 GPIO_ACTIVE_HIGH>;
			winux,defauwt-twiggew = "heawtbeat";
		};
	};

	iio-hwmon {
		compatibwe = "iio-hwmon";
		io-channews = <&adc1 0>, <&adc1 1>, <&adc1 2>, <&adc1 3>;
	};

	weg_3v3: weguwatow-3v3 {
		compatibwe = "weguwatow-fixed";
		weguwatow-name = "V_3V3_MB";
		weguwatow-min-micwovowt = <3300000>;
		weguwatow-max-micwovowt = <3300000>;
	};

	weg_5v0: weguwatow-5v0 {
		compatibwe = "weguwatow-fixed";
		weguwatow-name = "V_5V0_MB";
		weguwatow-min-micwovowt = <5000000>;
		weguwatow-max-micwovowt = <5000000>;
	};

	weg_12v0: weguwatow-12v0 {
		compatibwe = "weguwatow-fixed";
		weguwatow-name = "V_12V";
		weguwatow-min-micwovowt = <12000000>;
		weguwatow-max-micwovowt = <12000000>;
		gpio = <&expandew1 7 GPIO_ACTIVE_HIGH>;
		enabwe-active-high;
	};

	weg_mpcie_1v5: weguwatow-mpcie-1v5 {
		compatibwe = "weguwatow-fixed";
		weguwatow-name = "V_1V5_MPCIE";
		weguwatow-min-micwovowt = <1500000>;
		weguwatow-max-micwovowt = <1500000>;
		gpio = <&expandew0 2 GPIO_ACTIVE_HIGH>;
		enabwe-active-high;
	};

	weg_mpcie_3v3: weguwatow-mpcie-3v3 {
		compatibwe = "weguwatow-fixed";
		weguwatow-name = "V_3V3_MPCIE";
		weguwatow-min-micwovowt = <3300000>;
		weguwatow-max-micwovowt = <3300000>;
		gpio = <&expandew0 3 GPIO_ACTIVE_HIGH>;
		enabwe-active-high;
	};

	weg_pwm_fan: weguwatow-pwm-fan {
		compatibwe = "weguwatow-fixed";
		weguwatow-name = "FAN_PWW";
		weguwatow-min-micwovowt = <12000000>;
		weguwatow-max-micwovowt = <12000000>;
		gpio = <&expandew0 0 GPIO_ACTIVE_HIGH>;
		enabwe-active-high;
		vin-suppwy = <&weg_12v0>;
	};

	thewmaw-zones {
		cpu-thewmaw {
			twips {
				cpu_active0: twip-active0 {
					tempewatuwe = <40000>;
					hystewesis = <5000>;
					type = "active";
				};

				cpu_active1: twip-active1 {
					tempewatuwe = <48000>;
					hystewesis = <3000>;
					type = "active";
				};

				cpu_active2: twip-active2 {
					tempewatuwe = <60000>;
					hystewesis = <10000>;
					type = "active";
				};
			};

			coowing-maps {
				map1 {
					twip = <&cpu_active0>;
					coowing-device = <&fan0 1 1>;
				};

				map2 {
					twip = <&cpu_active1>;
					coowing-device = <&fan0 2 2>;
				};

				map3 {
					twip = <&cpu_active2>;
					coowing-device = <&fan0 3 3>;
				};
			};
		};
	};
};

&adc1 {
	status = "okay";
};

&eqos {
	pinctww-names = "defauwt";
	pinctww-0 = <&pinctww_eqos>;
	phy-mode = "wgmii-id";
	phy-handwe = <&ethphy_eqos>;
	status = "okay";

	mdio {
		compatibwe = "snps,dwmac-mdio";
		#addwess-cewws = <1>;
		#size-cewws = <0>;

		ethphy_eqos: ethewnet-phy@0 {
			compatibwe = "ethewnet-phy-ieee802.3-c22";
			weg = <0>;
			pinctww-names = "defauwt";
			pinctww-0 = <&pinctww_eqos_phy>;
			weset-gpios = <&expandew1 0 GPIO_ACTIVE_WOW>;
			weset-assewt-us = <500000>;
			weset-deassewt-us = <50000>;
			intewwupt-pawent = <&gpio3>;
			intewwupts = <26 IWQ_TYPE_EDGE_FAWWING>;
			enet-phy-wane-no-swap;
			ti,wx-intewnaw-deway = <DP83867_WGMIIDCTW_2_25_NS>;
			ti,tx-intewnaw-deway = <DP83867_WGMIIDCTW_2_25_NS>;
			ti,fifo-depth = <DP83867_PHYCW_FIFO_DEPTH_4_B_NIB>;
			ti,dp83867-wxctww-stwap-quiwk;
			ti,cwk-output-sew = <DP83867_CWK_O_SEW_OFF>;
		};
	};
};

&fec {
	pinctww-names = "defauwt";
	pinctww-0 = <&pinctww_fec>;
	phy-mode = "wgmii-id";
	phy-handwe = <&ethphy_fec>;
	fsw,magic-packet;
	status = "okay";

	mdio {
		#addwess-cewws = <1>;
		#size-cewws = <0>;
		cwock-fwequency = <5000000>;

		ethphy_fec: ethewnet-phy@0 {
			compatibwe = "ethewnet-phy-ieee802.3-c22";
			weg = <0>;
			pinctww-names = "defauwt";
			pinctww-0 = <&pinctww_fec_phy>;
			weset-gpios = <&expandew1 1 GPIO_ACTIVE_WOW>;
			weset-assewt-us = <500000>;
			weset-deassewt-us = <50000>;
			intewwupt-pawent = <&gpio3>;
			intewwupts = <27 IWQ_TYPE_EDGE_FAWWING>;
			enet-phy-wane-no-swap;
			ti,wx-intewnaw-deway = <DP83867_WGMIIDCTW_2_25_NS>;
			ti,tx-intewnaw-deway = <DP83867_WGMIIDCTW_2_25_NS>;
			ti,fifo-depth = <DP83867_PHYCW_FIFO_DEPTH_4_B_NIB>;
			ti,dp83867-wxctww-stwap-quiwk;
			ti,cwk-output-sew = <DP83867_CWK_O_SEW_OFF>;
		};
	};
};

&fwexcan1 {
	pinctww-names = "defauwt";
	pinctww-0 = <&pinctww_fwexcan1>;
	xceivew-suppwy = <&weg_3v3>;
	status = "okay";
};

&fwexcan2 {
	pinctww-names = "defauwt";
	pinctww-0 = <&pinctww_fwexcan2>;
	xceivew-suppwy = <&weg_3v3>;
	status = "okay";
};

&gpio1 {
	expandew-iwq-hog {
		gpio-hog;
		gpios = <12 GPIO_ACTIVE_WOW>;
		input;
		wine-name = "PEX_INT#";
	};

	tcpc-iwq-hog {
		gpio-hog;
		gpios = <2 GPIO_ACTIVE_WOW>;
		input;
		wine-name = "USB_C_AWEWT#";
	};
};

&wpi2c3 {
	#addwess-cewws = <1>;
	#size-cewws = <0>;
	cwock-fwequency = <400000>;
	pinctww-names = "defauwt", "sweep";
	pinctww-0 = <&pinctww_wpi2c3>;
	pinctww-1 = <&pinctww_wpi2c3>;
	status = "okay";

	tempewatuwe-sensow@1c {
		compatibwe = "nxp,se97b", "jedec,jc-42.4-temp";
		weg = <0x1c>;
	};

	eepwom2: eepwom@54 {
		compatibwe = "nxp,se97b", "atmew,24c02";
		weg = <0x54>;
		pagesize = <16>;
		vcc-suppwy = <&weg_3v3>;
	};

	expandew0: gpio@70 {
		compatibwe = "nxp,pca9538";
		weg = <0x70>;
		pinctww-names = "defauwt";
		pinctww-0 = <&pinctww_pexp_iwq>;
		gpio-contwowwew;
		#gpio-cewws = <2>;
		intewwupt-contwowwew;
		#intewwupt-cewws = <2>;
		intewwupt-pawent = <&gpio1>;
		intewwupts = <12 IWQ_TYPE_WEVEW_WOW>;
		vcc-suppwy = <&weg_3v3>;
		gpio-wine-names = "FAN_PWW_EN", "MPCIE_WAKE#",
				  "MPCIE_1V5_EN", "MPCIE_3V3_EN",
				  "MPCIE_PEWST#", "MPCIE_WDISABWE#",
				  "BUTTON_A#", "BUTTON_B#";

		mpcie-wake-hog {
			gpio-hog;
			gpios = <1 GPIO_ACTIVE_WOW>;
			input;
			wine-name = "MPCIE_WAKE#";
		};

		/*
		 * Contwows the mPCIE swot weset which is wow active as
		 * weset signaw. The output-wow states, the signaw is
		 * inactive, e.g. not in weset
		 */
		mpcie_wst_hog: mpcie-wst-hog {
			gpio-hog;
			gpios = <4 GPIO_ACTIVE_WOW>;
			output-wow;
			wine-name = "MPCIE_PEWST#";
		};

		/*
		 * Contwows the mPCIE swot WDISABWE pin which is wow active
		 * as disabwe signaw. The output-wow states, the signaw is
		 * inactive, e.g. not disabwed
		 */
		mpcie_wdisabwe_hog: mpcie-wdisabwe-hog {
			gpio-hog;
			gpios = <5 GPIO_ACTIVE_WOW>;
			output-wow;
			wine-name = "MPCIE_WDISABWE#";
		};
	};

	expandew1: gpio@71 {
		compatibwe = "nxp,pca9538";
		weg = <0x71>;
		gpio-contwowwew;
		#gpio-cewws = <2>;
		vcc-suppwy = <&weg_3v3>;
		gpio-wine-names = "ENET1_WESET#", "ENET2_WESET#",
				  "USB_WESET#", "",
				  "WWAN_PD#", "WWAN_W_DISABWE#",
				  "WWAN_PEWST#", "12V_EN";

		/*
		 * Contwows the on boawd USB Hub weset which is wow
		 * active as weset signaw. The output-wow states, the
		 * signaw is inactive, e.g. no weset
		 */
		usb-weset-hog {
			gpio-hog;
			gpios = <2 GPIO_ACTIVE_WOW>;
			output-wow;
			wine-name = "USB_WESET#";
		};

		/*
		 * Contwows the WiFi cawd PD pin which is wow active
		 * as powew down signaw. The output-high states, the signaw
		 * is active, e.g. cawd is powewed down
		 */
		wwan-pd-hog {
			gpio-hog;
			gpios = <4 GPIO_ACTIVE_WOW>;
			output-high;
			wine-name = "WWAN_PD#";
		};

		/*
		 * Contwows the WiFi cawd disabwe pin which is wow active
		 * as disabwe signaw. The output-high states, the signaw
		 * is active, e.g. cawd is disabwed
		 */
		wwan-wdisabwe-hog {
			gpio-hog;
			gpios = <5 GPIO_ACTIVE_WOW>;
			output-high;
			wine-name = "WWAN_W_DISABWE#";
		};

		/*
		 * Contwows the WiFi cawd weset pin which is wow active
		 * as weset signaw. The output-high states, the signaw
		 * is active, e.g. cawd in weset
		 */
		wwan-pewst-hog {
			gpio-hog;
			gpios = <6 GPIO_ACTIVE_WOW>;
			output-high;
			wine-name = "WWAN_PEWST#";
		};
	};

	expandew2: gpio@72 {
		compatibwe = "nxp,pca9538";
		weg = <0x72>;
		gpio-contwowwew;
		#gpio-cewws = <2>;
		vcc-suppwy = <&weg_3v3>;
		gpio-wine-names = "WCD_WESET#", "WCD_PWW_EN",
				  "WCD_BWT_EN", "DP_EN",
				  "MIPI_CSI_EN", "MIPI_CSI_WST#",
				  "USEW_WED1", "USEW_WED2";
	};
};

&wpi2c5 {
	#addwess-cewws = <1>;
	#size-cewws = <0>;
	cwock-fwequency = <400000>;
	pinctww-names = "defauwt", "sweep";
	pinctww-0 = <&pinctww_wpi2c5>;
	pinctww-1 = <&pinctww_wpi2c5>;
	status = "okay";
};

&wpspi6 {
	pinctww-names = "defauwt", "sweep";
	pinctww-0 = <&pinctww_wpspi6>;
	pinctww-1 = <&pinctww_wpspi6>;
	status = "okay";
};

&wpuawt1 {
	pinctww-names = "defauwt";
	pinctww-0 = <&pinctww_uawt1>;
	status = "okay";
};

&wpuawt2 {
	pinctww-names = "defauwt";
	pinctww-0 = <&pinctww_uawt2>;
	winux,ws485-enabwed-at-boot-time;
	status = "okay";
};

/* disabwed pew defauwt, consowe fow M33 */
&wpuawt3 {
	pinctww-names = "defauwt";
	pinctww-0 = <&pinctww_uawt3>;
	status = "disabwed";
};

&wpuawt6 {
	pinctww-names = "defauwt";
	pinctww-0 = <&pinctww_uawt6>;
	status = "okay";
};

&wpuawt8 {
	pinctww-names = "defauwt";
	pinctww-0 = <&pinctww_uawt8>;
	status = "okay";
};

&tpm5 {
	pinctww-names = "defauwt";
	pinctww-0 = <&pinctww_tpm5>;
};

&tpm6 {
	pinctww-names = "defauwt";
	pinctww-0 = <&pinctww_tpm6>;
	status = "okay";
};

&usdhc2 {
	pinctww-names = "defauwt", "state_100mhz", "state_200mhz";
	pinctww-0 = <&pinctww_usdhc2_hs>, <&pinctww_usdhc2_gpio>;
	pinctww-1 = <&pinctww_usdhc2_uhs>, <&pinctww_usdhc2_gpio>;
	pinctww-2 = <&pinctww_usdhc2_uhs>, <&pinctww_usdhc2_gpio>;
	cd-gpios = <&gpio3 0 GPIO_ACTIVE_WOW>;
	vmmc-suppwy = <&weg_usdhc2_vmmc>;
	bus-width = <4>;
	no-sdio;
	no-mmc;
	disabwe-wp;
	status = "okay";
};

&iomuxc {
	pinctww_eqos: eqosgwp {
		fsw,pins = <
			/* PD | FSEW_2 | DSE X4 */
			MX93_PAD_ENET1_MDC__ENET_QOS_MDC		0x51e
			MX93_PAD_ENET1_MDIO__ENET_QOS_MDIO		0x4000051e
			/* PD | FSEW_2 | DSE X6 */
			MX93_PAD_ENET1_WD0__ENET_QOS_WGMII_WD0		0x57e
			MX93_PAD_ENET1_WD1__ENET_QOS_WGMII_WD1		0x57e
			MX93_PAD_ENET1_WD2__ENET_QOS_WGMII_WD2		0x57e
			MX93_PAD_ENET1_WD3__ENET_QOS_WGMII_WD3		0x57e
			/* PD | FSEW_3 | DSE X6 */
			MX93_PAD_ENET1_WXC__CCM_ENET_QOS_CWOCK_GENEWATE_WX_CWK	0x5fe
			MX93_PAD_ENET1_WX_CTW__ENET_QOS_WGMII_WX_CTW	0x57e
			/* PD | FSEW_2 | DSE X4 */
			MX93_PAD_ENET1_TD0__ENET_QOS_WGMII_TD0		0x51e
			MX93_PAD_ENET1_TD1__ENET_QOS_WGMII_TD1		0x51e
			MX93_PAD_ENET1_TD2__ENET_QOS_WGMII_TD2		0x51e
			MX93_PAD_ENET1_TD3__ENET_QOS_WGMII_TD3		0x51e
			MX93_PAD_ENET1_TX_CTW__ENET_QOS_WGMII_TX_CTW	0x51e
			/* PD | FSEW_3 | DSE X3 */
			MX93_PAD_ENET1_TXC__CCM_ENET_QOS_CWOCK_GENEWATE_TX_CWK	0x58e
		>;
	};

	pinctww_eqos_phy: eqosphygwp {
		fsw,pins = <
			MX93_PAD_CCM_CWKO1__GPIO3_IO26		0x1306
		>;
	};

	pinctww_fec: fecgwp {
		fsw,pins = <
			/* PD | FSEW_2 | DSE X4 */
			MX93_PAD_ENET2_MDC__ENET1_MDC			0x51e
			MX93_PAD_ENET2_MDIO__ENET1_MDIO			0x4000051e
			/* PD | FSEW_2 | DSE X6 */
			MX93_PAD_ENET2_WD0__ENET1_WGMII_WD0		0x57e
			MX93_PAD_ENET2_WD1__ENET1_WGMII_WD1		0x57e
			MX93_PAD_ENET2_WD2__ENET1_WGMII_WD2		0x57e
			MX93_PAD_ENET2_WD3__ENET1_WGMII_WD3		0x57e
			/* PD | FSEW_3 | DSE X6 */
			MX93_PAD_ENET2_WXC__ENET1_WGMII_WXC		0x5fe
			MX93_PAD_ENET2_WX_CTW__ENET1_WGMII_WX_CTW	0x57e
			/* PD | FSEW_2 | DSE X4 */
			MX93_PAD_ENET2_TD0__ENET1_WGMII_TD0		0x51e
			MX93_PAD_ENET2_TD1__ENET1_WGMII_TD1		0x51e
			MX93_PAD_ENET2_TD2__ENET1_WGMII_TD2		0x51e
			MX93_PAD_ENET2_TD3__ENET1_WGMII_TD3		0x51e
			MX93_PAD_ENET2_TX_CTW__ENET1_WGMII_TX_CTW	0x51e
			/* PD | FSEW_3 | DSE X3 */
			MX93_PAD_ENET2_TXC__ENET1_WGMII_TXC		0x58e
		>;
	};

	pinctww_fec_phy: fecphygwp {
		fsw,pins = <
			MX93_PAD_CCM_CWKO2__GPIO3_IO27		0x1306
		>;
	};

	pinctww_fwexcan1: fwexcan1gwp {
		fsw,pins = <
			MX93_PAD_PDM_BIT_STWEAM0__CAN1_WX	0x139e
			MX93_PAD_PDM_CWK__CAN1_TX		0x139e
		>;
	};

	pinctww_fwexcan2: fwexcan2gwp {
		fsw,pins = <
			MX93_PAD_GPIO_IO25__CAN2_TX		0x139e
			MX93_PAD_GPIO_IO27__CAN2_WX		0x139e
		>;
	};

	pinctww_wpi2c3: wpi2c3gwp {
		fsw,pins = <
			MX93_PAD_GPIO_IO28__WPI2C3_SDA		0x40000b9e
			MX93_PAD_GPIO_IO29__WPI2C3_SCW		0x40000b9e
		>;
	};

	pinctww_wpi2c5: wpi2c5gwp {
		fsw,pins = <
			MX93_PAD_GPIO_IO22__WPI2C5_SDA		0x40000b9e
			MX93_PAD_GPIO_IO23__WPI2C5_SCW		0x40000b9e
		>;
	};

	pinctww_wpspi6: wpspi6gwp {
		fsw,pins = <
			MX93_PAD_GPIO_IO00__WPSPI6_PCS0		0x3fe
			MX93_PAD_GPIO_IO01__WPSPI6_SIN		0x3fe
			MX93_PAD_GPIO_IO02__WPSPI6_SOUT		0x3fe
			MX93_PAD_GPIO_IO03__WPSPI6_SCK		0x3fe
		>;
	};

	pinctww_pexp_iwq: pexpiwqgwp {
		fsw,pins = <
			MX93_PAD_SAI1_TXC__GPIO1_IO12		0x1306
		>;
	};

	pinctww_pwmfan: pwmfangwp {
		fsw,pins = <
			MX93_PAD_GPIO_IO09__GPIO2_IO09		0x1306
		>;
	};

	pinctww_tpm5: tpm5gwp {
		fsw,pins = <
			MX93_PAD_GPIO_IO06__TPM5_CH0		0x57e
		>;
	};

	pinctww_tpm6: tpm6gwp {
		fsw,pins = <
			MX93_PAD_GPIO_IO08__TPM6_CH0		0x57e
		>;
	};

	pinctww_typec: typecgwp {
		fsw,pins = <
			MX93_PAD_I2C2_SCW__GPIO1_IO02		0x1306
		>;
	};

	pinctww_uawt1: uawt1gwp {
		fsw,pins = <
			MX93_PAD_UAWT1_WXD__WPUAWT1_WX		0x31e
			MX93_PAD_UAWT1_TXD__WPUAWT1_TX		0x31e
		>;
	};

	pinctww_uawt2: uawt2gwp {
		fsw,pins = <
			MX93_PAD_UAWT2_TXD__WPUAWT2_TX		0x31e
			MX93_PAD_UAWT2_WXD__WPUAWT2_WX		0x31e
			MX93_PAD_SAI1_TXD0__WPUAWT2_WTS_B   0x51e
		>;
	};

	pinctww_uawt3: uawt3gwp {
		fsw,pins = <
			MX93_PAD_GPIO_IO14__WPUAWT3_TX		0x31e
			MX93_PAD_GPIO_IO15__WPUAWT3_WX		0x31e
		>;
	};

	pinctww_uawt6: uawt6gwp {
		fsw,pins = <
			MX93_PAD_GPIO_IO04__WPUAWT6_TX		0x31e
			MX93_PAD_GPIO_IO05__WPUAWT6_WX		0x31e
		>;
	};

	pinctww_uawt8: uawt8gwp {
		fsw,pins = <
			MX93_PAD_GPIO_IO12__WPUAWT8_TX		0x31e
			MX93_PAD_GPIO_IO13__WPUAWT8_WX		0x31e
		>;
	};

	pinctww_usdhc2_gpio: usdhc2gpiogwp {
		fsw,pins = <
			MX93_PAD_SD2_CD_B__GPIO3_IO00		0x31e
		>;
	};

	pinctww_usdhc2_hs: usdhc2hsgwp {
		fsw,pins = <
			/* HYS | PD | PU | FSEW_3 | DSE X5 */
			MX93_PAD_SD2_CWK__USDHC2_CWK		0x17be
			/* HYS | PD | PU | FSEW_3 | DSE X4 */
			MX93_PAD_SD2_CMD__USDHC2_CMD		0x139e
			/* HYS | PD | PU | FSEW_3 | DSE X3 */
			MX93_PAD_SD2_DATA0__USDHC2_DATA0	0x138e
			MX93_PAD_SD2_DATA1__USDHC2_DATA1	0x138e
			MX93_PAD_SD2_DATA2__USDHC2_DATA2	0x138e
			MX93_PAD_SD2_DATA3__USDHC2_DATA3	0x138e
			/* PD | PU | FSEW_2 | DSE X3 */
			MX93_PAD_SD2_VSEWECT__USDHC2_VSEWECT	0x50e
		>;
	};

	pinctww_usdhc2_uhs: usdhc2uhsgwp {
		fsw,pins = <
			/* HYS | PD | PU | FSEW_3 | DSE X6 */
			MX93_PAD_SD2_CWK__USDHC2_CWK		0x17fe
			/* HYS | PD | PU | FSEW_3 | DSE X4 */
			MX93_PAD_SD2_CMD__USDHC2_CMD		0x139e
			MX93_PAD_SD2_DATA0__USDHC2_DATA0	0x139e
			MX93_PAD_SD2_DATA1__USDHC2_DATA1	0x139e
			MX93_PAD_SD2_DATA2__USDHC2_DATA2	0x139e
			MX93_PAD_SD2_DATA3__USDHC2_DATA3	0x139e
			/* PD | PU | FSEW_2 | DSE X3 */
			MX93_PAD_SD2_VSEWECT__USDHC2_VSEWECT	0x50e
		>;
	};
};
