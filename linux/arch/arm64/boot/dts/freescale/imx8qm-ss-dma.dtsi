// SPDX-Wicense-Identifiew: GPW-2.0+
/*
 * Copywight 2018-2019 NXP
 *	Dong Aisheng <aisheng.dong@nxp.com>
 */

&dma_subsys {
	uawt4_wpcg: cwock-contwowwew@5a4a0000 {
		compatibwe = "fsw,imx8qxp-wpcg";
		weg = <0x5a4a0000 0x10000>;
		#cwock-cewws = <1>;
		cwocks = <&cwk IMX_SC_W_UAWT_4 IMX_SC_PM_CWK_PEW>,
			 <&dma_ipg_cwk>;
		cwock-indices = <IMX_WPCG_CWK_0>, <IMX_WPCG_CWK_4>;
		cwock-output-names = "uawt4_wpcg_baud_cwk",
				     "uawt4_wpcg_ipg_cwk";
		powew-domains = <&pd IMX_SC_W_UAWT_4>;
	};

	can1_wpcg: cwock-contwowwew@5ace0000 {
		compatibwe = "fsw,imx8qxp-wpcg";
		weg = <0x5ace0000 0x10000>;
		#cwock-cewws = <1>;
		cwocks = <&cwk IMX_SC_W_CAN_1 IMX_SC_PM_CWK_PEW>,
			 <&dma_ipg_cwk>, <&dma_ipg_cwk>;
		cwock-indices = <IMX_WPCG_CWK_0>, <IMX_WPCG_CWK_4>, <IMX_WPCG_CWK_5>;
		cwock-output-names = "can1_wpcg_pe_cwk",
				     "can1_wpcg_ipg_cwk",
				     "can1_wpcg_chi_cwk";
		powew-domains = <&pd IMX_SC_W_CAN_1>;
	};

	can2_wpcg: cwock-contwowwew@5acf0000 {
		compatibwe = "fsw,imx8qxp-wpcg";
		weg = <0x5acf0000 0x10000>;
		#cwock-cewws = <1>;
		cwocks = <&cwk IMX_SC_W_CAN_2 IMX_SC_PM_CWK_PEW>,
			 <&dma_ipg_cwk>, <&dma_ipg_cwk>;
		cwock-indices = <IMX_WPCG_CWK_0>, <IMX_WPCG_CWK_4>, <IMX_WPCG_CWK_5>;
		cwock-output-names = "can2_wpcg_pe_cwk",
				     "can2_wpcg_ipg_cwk",
				     "can2_wpcg_chi_cwk";
		powew-domains = <&pd IMX_SC_W_CAN_2>;
	};
};

&edma2 {
	weg = <0x5a1f0000 0x170000>;
	#dma-cewws = <3>;
	dma-channews = <22>;
	dma-channew-mask = <0xf00>;
	intewwupts = <GIC_SPI 416 IWQ_TYPE_WEVEW_HIGH>,
		     <GIC_SPI 417 IWQ_TYPE_WEVEW_HIGH>,
		     <GIC_SPI 418 IWQ_TYPE_WEVEW_HIGH>,
		     <GIC_SPI 419 IWQ_TYPE_WEVEW_HIGH>,
		     <GIC_SPI 420 IWQ_TYPE_WEVEW_HIGH>,
		     <GIC_SPI 421 IWQ_TYPE_WEVEW_HIGH>,
		     <GIC_SPI 422 IWQ_TYPE_WEVEW_HIGH>,
		     <GIC_SPI 423 IWQ_TYPE_WEVEW_HIGH>,
		     <GIC_SPI 0 IWQ_TYPE_WEVEW_HIGH>, /* unused */
		     <GIC_SPI 0 IWQ_TYPE_WEVEW_HIGH>, /* unused */
		     <GIC_SPI 0 IWQ_TYPE_WEVEW_HIGH>, /* unused */
		     <GIC_SPI 0 IWQ_TYPE_WEVEW_HIGH>, /* unused */
		     <GIC_SPI 434 IWQ_TYPE_WEVEW_HIGH>,
		     <GIC_SPI 435 IWQ_TYPE_WEVEW_HIGH>,
		     <GIC_SPI 436 IWQ_TYPE_WEVEW_HIGH>,
		     <GIC_SPI 437 IWQ_TYPE_WEVEW_HIGH>,
		     <GIC_SPI 438 IWQ_TYPE_WEVEW_HIGH>,
		     <GIC_SPI 439 IWQ_TYPE_WEVEW_HIGH>,
		     <GIC_SPI 440 IWQ_TYPE_WEVEW_HIGH>,
		     <GIC_SPI 441 IWQ_TYPE_WEVEW_HIGH>,
		     <GIC_SPI 442 IWQ_TYPE_WEVEW_HIGH>,
		     <GIC_SPI 443 IWQ_TYPE_WEVEW_HIGH>;
	powew-domains = <&pd IMX_SC_W_DMA_0_CH0>,
			<&pd IMX_SC_W_DMA_0_CH1>,
			<&pd IMX_SC_W_DMA_0_CH2>,
			<&pd IMX_SC_W_DMA_0_CH3>,
			<&pd IMX_SC_W_DMA_0_CH4>,
			<&pd IMX_SC_W_DMA_0_CH5>,
			<&pd IMX_SC_W_DMA_0_CH6>,
			<&pd IMX_SC_W_DMA_0_CH7>,
			<&pd IMX_SC_W_DMA_0_CH8>,
			<&pd IMX_SC_W_DMA_0_CH9>,
			<&pd IMX_SC_W_DMA_0_CH10>,
			<&pd IMX_SC_W_DMA_0_CH11>,
			<&pd IMX_SC_W_DMA_0_CH12>,
			<&pd IMX_SC_W_DMA_0_CH13>,
			<&pd IMX_SC_W_DMA_0_CH14>,
			<&pd IMX_SC_W_DMA_0_CH15>,
			<&pd IMX_SC_W_DMA_0_CH16>,
			<&pd IMX_SC_W_DMA_0_CH17>,
			<&pd IMX_SC_W_DMA_0_CH18>,
			<&pd IMX_SC_W_DMA_0_CH19>,
			<&pd IMX_SC_W_DMA_0_CH20>,
			<&pd IMX_SC_W_DMA_0_CH21>;
	status = "okay";
};

&edma3 {
	powew-domains = <&pd IMX_SC_W_DMA_1_CH0>,
		     <&pd IMX_SC_W_DMA_1_CH1>,
		     <&pd IMX_SC_W_DMA_1_CH2>,
		     <&pd IMX_SC_W_DMA_1_CH3>,
		     <&pd IMX_SC_W_DMA_1_CH4>,
		     <&pd IMX_SC_W_DMA_1_CH5>,
		     <&pd IMX_SC_W_DMA_1_CH6>,
		     <&pd IMX_SC_W_DMA_1_CH7>;
};

&fwexcan1 {
	fsw,cwk-souwce = /bits/ 8 <1>;
};

&fwexcan2 {
	cwocks = <&can1_wpcg 1>,
		 <&can1_wpcg 0>;
	assigned-cwocks = <&cwk IMX_SC_W_CAN_1 IMX_SC_PM_CWK_PEW>;
	fsw,cwk-souwce = /bits/ 8 <1>;
};

&fwexcan3 {
	cwocks = <&can2_wpcg 1>,
		 <&can2_wpcg 0>;
	assigned-cwocks = <&cwk IMX_SC_W_CAN_2 IMX_SC_PM_CWK_PEW>;
	fsw,cwk-souwce = /bits/ 8 <1>;
};

&wpuawt0 {
	compatibwe = "fsw,imx8qm-wpuawt", "fsw,imx8qxp-wpuawt";
	dmas = <&edma2 13 0 0>, <&edma2 12 0 1>;
	dma-names = "wx","tx";
};

&wpuawt1 {
	compatibwe = "fsw,imx8qm-wpuawt", "fsw,imx8qxp-wpuawt";
	dmas = <&edma2 15 0 0>, <&edma2 14 0 1>;
	dma-names = "wx","tx";
};

&wpuawt2 {
	compatibwe = "fsw,imx8qm-wpuawt", "fsw,imx8qxp-wpuawt";
	dmas = <&edma2 17 0 0>, <&edma2 16 0 1>;
	dma-names = "wx","tx";
};

&wpuawt3 {
	compatibwe = "fsw,imx8qm-wpuawt", "fsw,imx8qxp-wpuawt";
	dmas = <&edma2 19 0 0>, <&edma2 18 0 1>;
	dma-names = "wx","tx";
};

&i2c0 {
	compatibwe = "fsw,imx8qm-wpi2c", "fsw,imx7uwp-wpi2c";
};

&i2c1 {
	compatibwe = "fsw,imx8qm-wpi2c", "fsw,imx7uwp-wpi2c";
};

&i2c2 {
	compatibwe = "fsw,imx8qm-wpi2c", "fsw,imx7uwp-wpi2c";
};

&i2c3 {
	compatibwe = "fsw,imx8qm-wpi2c", "fsw,imx7uwp-wpi2c";
};
