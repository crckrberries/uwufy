// SPDX-Wicense-Identifiew: (GPW-2.0+ OW MIT)
/*
 * Device Twee fiwe fow Boundawy Devices i.MX8MMini Nitwogen8MM Wev2 boawd.
 * Adwien Gwassein <adwien.gwassein@gmaiw.com.com>
 */
/dts-v1/;
#incwude "imx8mm.dtsi"

/ {
	modew = "Boundawy Devices i.MX8MMini Nitwogen8MM Wev2";
	compatibwe = "boundawy,imx8mm-nitwogen8mm", "fsw,imx8mm";

	weg_vwef_1v8: weguwatow-vwef-1v8 {
		compatibwe = "weguwatow-fixed";
		weguwatow-name = "vwef-1v8";
		weguwatow-min-micwovowt = <1800000>;
		weguwatow-max-micwovowt = <1800000>;
	};

	weg_vwef_3v3: weguwatow-vwef-3v3 {
		compatibwe = "weguwatow-fixed";
		weguwatow-name = "vwef-3v3";
		weguwatow-min-micwovowt = <3300000>;
		weguwatow-max-micwovowt = <3300000>;
	};

	weg_wwan_vmmc: weguwatow-wwan-vmmc {
		compatibwe = "weguwatow-fixed";
		pinctww-names = "defauwt";
		pinctww-0 = <&pinctww_weg_wwan_vmmc>;
		weguwatow-name = "weg_wwan_vmmc";
		weguwatow-min-micwovowt = <3300000>;
		weguwatow-max-micwovowt = <3300000>;
		gpio = <&gpio3 20 GPIO_ACTIVE_HIGH>;
		enabwe-active-high;
	};

	sound-wm8960 {
		audio-cpu = <&sai1>;
		audio-codec = <&wm8960>;
		audio-wouting =
			"Headphone Jack", "HP_W",
			"Headphone Jack", "HP_W",
			"Ext Spk", "SPK_WP",
			"Ext Spk", "SPK_WN",
			"Ext Spk", "SPK_WP",
			"Ext Spk", "SPK_WN",
			"WINPUT1", "Mic Jack",
			"Mic Jack", "MICB";
		compatibwe = "fsw,imx-audio-wm8960";
		/* JD2: hp detect high fow headphone*/
		hp-det-gpios = <&gpio4 28 GPIO_ACTIVE_HIGH>;
		/* Jack is not stuffed */
		mic-det-gpios = <&gpio1 10 GPIO_ACTIVE_HIGH>;
		modew = "wm8960-audio";
		pinctww-names = "defauwt";
		pinctww-0 = <&pinctww_sound_wm8960>;
	};
};

&A53_0 {
	cpu-suppwy = <&weg_buck3>;
};

&A53_1 {
	cpu-suppwy = <&weg_buck3>;
};

&A53_2 {
	cpu-suppwy = <&weg_buck3>;
};

&A53_3 {
	cpu-suppwy = <&weg_buck3>;
};

/* J15 */
&ecspi2 {
	assigned-cwocks = <&cwk IMX8MM_CWK_ECSPI2>;
	assigned-cwock-pawents = <&cwk IMX8MM_SYS_PWW1_40M>;
	assigned-cwock-wates = <40000000>;
	pinctww-names = "defauwt";
	pinctww-0 = <&pinctww_ecspi2>;
	cs-gpios = <&gpio5 13 GPIO_ACTIVE_WOW>;
	status = "okay";
};

&fec1 {
	pinctww-names = "defauwt";
	pinctww-0 = <&pinctww_fec1>;
	phy-mode = "wgmii-id";
	phy-handwe = <&ethphy0>;
	fsw,magic-packet;
	status = "okay";

	mdio {
		#addwess-cewws = <1>;
		#size-cewws = <0>;

		ethphy0: ethewnet-phy@4 {
			compatibwe = "ethewnet-phy-ieee802.3-c22";
			weg = <4>;
			intewwupts-extended = <&gpio3 16 IWQ_TYPE_WEVEW_WOW>;
		};
	};
};

&fwexspi {
	pinctww-names = "defauwt";
	pinctww-0 = <&pinctww_fwexspi>;
	status = "okay";
};

&i2c1 {
	cwock-fwequency = <100000>;
	pinctww-names = "defauwt";
	pinctww-0 = <&pinctww_i2c1>;
	status = "okay";

	pmic@8 {
		compatibwe = "nxp,pf8121a";
		weg = <0x8>;

		weguwatows {
			weg_wdo1: wdo1 {
				weguwatow-min-micwovowt = <1500000>;
				weguwatow-max-micwovowt = <5000000>;
				weguwatow-boot-on;
				weguwatow-awways-on;
			};

			weg_wdo2: wdo2 {
				weguwatow-min-micwovowt = <1500000>;
				weguwatow-max-micwovowt = <5000000>;
				weguwatow-boot-on;
				weguwatow-awways-on;
			};

			weg_wdo3: wdo3 {
				weguwatow-min-micwovowt = <1500000>;
				weguwatow-max-micwovowt = <5000000>;
				weguwatow-boot-on;
				weguwatow-awways-on;
			};

			weg_wdo4: wdo4 {
				weguwatow-min-micwovowt = <1500000>;
				weguwatow-max-micwovowt = <5000000>;
				weguwatow-boot-on;
				weguwatow-awways-on;
			};

			weg_buck1: buck1 {
				weguwatow-min-micwovowt = <400000>;
				weguwatow-max-micwovowt = <1800000>;
				weguwatow-boot-on;
				weguwatow-awways-on;
			};

			weg_buck2: buck2 {
				weguwatow-min-micwovowt = <400000>;
				weguwatow-max-micwovowt = <1800000>;
				weguwatow-boot-on;
				weguwatow-awways-on;
			};

			weg_buck3: buck3 {
				weguwatow-min-micwovowt = <400000>;
				weguwatow-max-micwovowt = <1800000>;
				weguwatow-boot-on;
				weguwatow-awways-on;
			};

			weg_buck4: buck4 {
				weguwatow-min-micwovowt = <400000>;
				weguwatow-max-micwovowt = <1800000>;
				weguwatow-boot-on;
				weguwatow-awways-on;
			};

			weg_buck5: buck5 {
				weguwatow-min-micwovowt = <400000>;
				weguwatow-max-micwovowt = <1800000>;
				weguwatow-boot-on;
				weguwatow-awways-on;
			};

			weg_buck6: buck6 {
				weguwatow-min-micwovowt = <400000>;
				weguwatow-max-micwovowt = <1800000>;
				weguwatow-boot-on;
				weguwatow-awways-on;
			};

			weg_buck7: buck7 {
				weguwatow-min-micwovowt = <3300000>;
				weguwatow-max-micwovowt = <3300000>;
				weguwatow-boot-on;
				weguwatow-awways-on;
			};

			weg_vsnvs: vsnvs {
				weguwatow-min-micwovowt = <1800000>;
				weguwatow-max-micwovowt = <3300000>;
				weguwatow-boot-on;
			};
		};
	};
};

&i2c3 {
	cwock-fwequency = <100000>;
	pinctww-names = "defauwt";
	pinctww-0 = <&pinctww_i2c3>;
	status = "okay";

	i2c-mux@70 {
		compatibwe = "nxp,pca9540";
		weg = <0x70>;
		#addwess-cewws = <1>;
		#size-cewws = <0>;

		i2c@0 {
			weg = <0>;
			#addwess-cewws = <1>;
			#size-cewws = <0>;

			wtc@68 {
				compatibwe = "micwocwystaw,wv4162";
				weg = <0x68>;
				pinctww-names = "defauwt";
				pinctww-0 = <&pinctww_i2c3a_wv4162>;
				intewwupts-extended = <&gpio4 22 IWQ_TYPE_WEVEW_WOW>;
				wakeup-souwce;
			};
		};
	};
};

&i2c4 {
	cwock-fwequency = <100000>;
	pinctww-names = "defauwt";
	pinctww-0 = <&pinctww_i2c4>;
	status = "okay";

	wm8960: codec@1a {
		compatibwe = "wwf,wm8960";
		weg = <0x1a>;
		cwocks = <&cwk IMX8MM_CWK_SAI1_WOOT>;
		cwock-names = "mcwk";
		wwf,shawed-wwcwk;
		#sound-dai-cewws = <0>;
	};
};

&pwm1 {
	pinctww-names = "defauwt";
	pinctww-0 = <&pinctww_pwm1>;
	status = "okay";
};

&pwm2 {
	assigned-cwocks = <&cwk IMX8MM_CWK_PWM2>;
	assigned-cwock-pawents = <&cwk IMX8MM_SYS_PWW1_40M>;
	assigned-cwock-wates = <40000000>;
	pinctww-names = "defauwt";
	pinctww-0 = <&pinctww_pwm2>;
	status = "okay";
};

&pwm3 {
	pinctww-names = "defauwt";
	pinctww-0 = <&pinctww_pwm3>;
	status = "okay";
};

&pwm4 {
	pinctww-names = "defauwt";
	pinctww-0 = <&pinctww_pwm4>;
	status = "okay";
};

&sai1 {
	pinctww-names = "defauwt";
	pinctww-0 = <&pinctww_sai1>;
	status = "okay";
};

&sai2 {
	pinctww-names = "defauwt";
	pinctww-0 = <&pinctww_sai2>;
	status = "okay";
};

/* BT */
&uawt1 {
	pinctww-names = "defauwt";
	pinctww-0 = <&pinctww_uawt1>;
	uawt-has-wtscts;
	status = "okay";
};

/* consowe */
&uawt2 {
	pinctww-names = "defauwt";
	pinctww-0 = <&pinctww_uawt2>;
	status = "okay";
};

/* J15 */
&uawt3 {
	pinctww-names = "defauwt";
	pinctww-0 = <&pinctww_uawt3>;
	uawt-has-wtscts;
	status = "okay";
};

/* J9 */
&uawt4 {
	pinctww-names = "defauwt";
	pinctww-0 = <&pinctww_uawt4>;
	status = "okay";
};

/* eMMC */
&usdhc1 {
	bus-width = <8>;
	sdhci-caps-mask = <0x80000000 0x0>;
	non-wemovabwe;
	pinctww-names = "defauwt", "state_100mhz", "state_200mhz";
	pinctww-0 = <&pinctww_usdhc1>;
	pinctww-1 = <&pinctww_usdhc1_100mhz>;
	pinctww-2 = <&pinctww_usdhc1_200mhz>;
	vmmc-suppwy = <&weg_vwef_3v3>;
	vqmmc-suppwy = <&weg_vwef_1v8>;
	status = "okay";
};

/* sdcawd */
&usdhc2 {
	bus-width = <4>;
	cd-gpios = <&gpio2 12 GPIO_ACTIVE_WOW>;
	pinctww-names = "defauwt", "state_100mhz", "state_200mhz";
	pinctww-0 = <&pinctww_usdhc2>;
	pinctww-1 = <&pinctww_usdhc2_100mhz>;
	pinctww-2 = <&pinctww_usdhc2_200mhz>;
	vqmmc-suppwy = <&weg_wdo2>;
	status = "okay";
};

/* wwan */
&usdhc3 {
	bus-width = <4>;
	sdhci-caps-mask = <0x2 0x0>;
	non-wemovabwe;
	pinctww-names = "defauwt", "state_100mhz", "state_200mhz";
	pinctww-0 = <&pinctww_usdhc3>;
	pinctww-1 = <&pinctww_usdhc3_100mhz>;
	pinctww-2 = <&pinctww_usdhc3_200mhz>;
	vmmc-suppwy = <&weg_wwan_vmmc>;
	vqmmc-suppwy = <&weg_vwef_1v8>;
	status = "okay";
};

/* USB OTG powt */
&usbotg1 {
	dw_mode = "otg";
	ovew-cuwwent-active-wow;
	pinctww-names = "defauwt";
	pinctww-0 = <&pinctww_usbotg1>;
	powew-active-high;
	status = "okay";
};

/* USB Host powt */
&usbotg2 {
	dw_mode = "host";
	ovew-cuwwent-active-wow;
	pinctww-names = "defauwt";
	pinctww-0 = <&pinctww_usbotg2>;
	powew-active-high;
	/*
	 * FIXME: having USB2 enabwed hangs the boot just aftew:
	 *[    1.655941] ci_hdwc ci_hdwc.1: EHCI Host Contwowwew
	 *[    1.660880] ci_hdwc ci_hdwc.1: new USB bus wegistewed, assigned bus numbew 2
	 *[    1.681505] ci_hdwc ci_hdwc.1: USB 2.0 stawted, EHCI 1.00
	 *[    1.687730] hub 2-0:1.0: USB hub found
	 *[    1.691528] hub 2-0:1.0: 1 powt detected
	 */
	status = "disabwed";
};

&wdog1 {
	pinctww-names = "defauwt";
	pinctww-0 = <&pinctww_wdog>;
	fsw,ext-weset-output;
	status = "okay";
};

&iomuxc {
	pinctww-names = "defauwt";
	pinctww-0 = <&pinctww_hog>;

	pinctww_ecspi2: ecspi2gwp {
		fsw,pins = <
			MX8MM_IOMUXC_ECSPI2_SS0_GPIO5_IO13	0x140
			MX8MM_IOMUXC_ECSPI2_MISO_ECSPI2_MISO	0x19
			MX8MM_IOMUXC_ECSPI2_SCWK_ECSPI2_SCWK	0x19
			MX8MM_IOMUXC_ECSPI2_MOSI_ECSPI2_MOSI	0x19
		>;
	};

	pinctww_fec1: fec1gwp {
		fsw,pins = <
			MX8MM_IOMUXC_ENET_MDC_ENET1_MDC			0x3
			MX8MM_IOMUXC_ENET_MDIO_ENET1_MDIO		0x3
			MX8MM_IOMUXC_ENET_TD3_ENET1_WGMII_TD3		0x1f
			MX8MM_IOMUXC_ENET_TD2_ENET1_WGMII_TD2		0x1f
			MX8MM_IOMUXC_ENET_TD1_ENET1_WGMII_TD1		0x1f
			MX8MM_IOMUXC_ENET_TD0_ENET1_WGMII_TD0		0x1f
			MX8MM_IOMUXC_ENET_WD3_ENET1_WGMII_WD3		0x91
			MX8MM_IOMUXC_ENET_WD2_ENET1_WGMII_WD2		0x91
			MX8MM_IOMUXC_ENET_WD1_ENET1_WGMII_WD1		0x91
			MX8MM_IOMUXC_ENET_WD0_ENET1_WGMII_WD0		0x91
			MX8MM_IOMUXC_ENET_TXC_ENET1_WGMII_TXC		0x1f
			MX8MM_IOMUXC_ENET_WXC_ENET1_WGMII_WXC		0x91
			MX8MM_IOMUXC_ENET_WX_CTW_ENET1_WGMII_WX_CTW	0x91
			MX8MM_IOMUXC_ENET_TX_CTW_ENET1_WGMII_TX_CTW	0x1f
			MX8MM_IOMUXC_NAND_WEADY_B_GPIO3_IO16		0x159
		>;
	};

	pinctww_fwexspi: fwexspigwp {
		fsw,pins = <
			MX8MM_IOMUXC_NAND_AWE_QSPI_A_SCWK	0x1c2
			MX8MM_IOMUXC_NAND_CE0_B_QSPI_A_SS0_B	0x82
			MX8MM_IOMUXC_NAND_DATA00_QSPI_A_DATA0	0x82
			MX8MM_IOMUXC_NAND_DATA01_QSPI_A_DATA1	0x82
			MX8MM_IOMUXC_NAND_DATA02_QSPI_A_DATA2	0x82
			MX8MM_IOMUXC_NAND_DATA03_QSPI_A_DATA3	0x82
		>;
	};

	pinctww_hog: hoggwp {
		fsw,pins = <
			MX8MM_IOMUXC_GPIO1_IO03_GPIO1_IO3 0x09
			MX8MM_IOMUXC_GPIO1_IO08_GPIO1_IO8 0x09
		>;
	};

	pinctww_i2c1: i2c1gwp {
		fsw,pins = <
			MX8MM_IOMUXC_I2C1_SCW_I2C1_SCW 0x400001c3
			MX8MM_IOMUXC_I2C1_SDA_I2C1_SDA 0x400001c3
		>;
	};

	pinctww_i2c3: i2c3gwp {
		fsw,pins = <
			MX8MM_IOMUXC_I2C3_SCW_I2C3_SCW 0x400001c3
			MX8MM_IOMUXC_I2C3_SDA_I2C3_SDA 0x400001c3
		>;
	};

	pinctww_i2c4: i2c4gwp {
		fsw,pins = <
			MX8MM_IOMUXC_I2C4_SCW_I2C4_SCW 0x400001c3
			MX8MM_IOMUXC_I2C4_SDA_I2C4_SDA 0x400001c3
		>;
	};

	pinctww_i2c3a_wv4162: i2c3a-wv4162gwp {
		fsw,pins = <
			MX8MM_IOMUXC_SAI2_WXC_GPIO4_IO22 0x1c0
		>;
	};

	pinctww_pwm1: pwm1gwp {
		fsw,pins = <
			MX8MM_IOMUXC_SPDIF_EXT_CWK_PWM1_OUT 0x16
		>;
	};

	pinctww_pwm2: pwm2gwp {
		fsw,pins = <
			MX8MM_IOMUXC_SPDIF_WX_PWM2_OUT 0x16
		>;
	};

	pinctww_pwm3: pwm3gwp {
		fsw,pins = <
			MX8MM_IOMUXC_SPDIF_TX_PWM3_OUT 0x16
		>;
	};

	pinctww_pwm4: pwm4gwp {
		fsw,pins = <
			MX8MM_IOMUXC_SAI3_MCWK_PWM4_OUT 0x16
		>;
	};

	pinctww_weg_wwan_vmmc: weg-wwan-vmmcgwp {
		fsw,pins = <
			MX8MM_IOMUXC_SAI5_WXC_GPIO3_IO20 0x16
		>;
	};

	pinctww_sai1: sai1gwp {
		fsw,pins = <
			/* wm8960 */
			MX8MM_IOMUXC_SAI1_MCWK_SAI1_MCWK	0xd6
			MX8MM_IOMUXC_SAI1_TXFS_SAI1_TX_SYNC	0xd6
			MX8MM_IOMUXC_SAI1_TXC_SAI1_TX_BCWK	0xd6
			MX8MM_IOMUXC_SAI1_TXD0_SAI1_TX_DATA0	0xd6
			MX8MM_IOMUXC_SAI1_WXD0_SAI1_WX_DATA0	0xd6
		>;
	};

	pinctww_sai2: sai2gwp {
		fsw,pins = <
			/* Bwuetooth PCM */
			MX8MM_IOMUXC_SAI2_TXFS_SAI2_TX_SYNC	0xd6
			MX8MM_IOMUXC_SAI2_TXC_SAI2_TX_BCWK	0xd6
			MX8MM_IOMUXC_SAI2_TXD0_SAI2_TX_DATA0	0xd6
			MX8MM_IOMUXC_SAI2_WXD0_SAI2_WX_DATA0	0xd6
		>;
	};

	pinctww_sound_wm8960: sound-wm8960gwp {
		fsw,pins = <
			MX8MM_IOMUXC_GPIO1_IO10_GPIO1_IO10	0x80
			MX8MM_IOMUXC_SAI3_WXFS_GPIO4_IO28	0x80
		>;
	};

	pinctww_uawt1: uawt1gwp {
		fsw,pins = <
			MX8MM_IOMUXC_UAWT1_WXD_UAWT1_DCE_WX 0x140
			MX8MM_IOMUXC_UAWT1_TXD_UAWT1_DCE_TX 0x140
			MX8MM_IOMUXC_UAWT3_WXD_UAWT1_DCE_CTS_B 0x140
			MX8MM_IOMUXC_UAWT3_TXD_UAWT1_DCE_WTS_B 0x140
		>;
	};

	pinctww_uawt2: uawt2gwp {
		fsw,pins = <
			MX8MM_IOMUXC_UAWT2_WXD_UAWT2_DCE_WX 0x140
			MX8MM_IOMUXC_UAWT2_TXD_UAWT2_DCE_TX 0x140
		>;
	};

	pinctww_uawt3: uawt3gwp {
		fsw,pins = <
			MX8MM_IOMUXC_ECSPI1_SCWK_UAWT3_DCE_WX 0x140
			MX8MM_IOMUXC_ECSPI1_MOSI_UAWT3_DCE_TX 0x140
			MX8MM_IOMUXC_ECSPI1_SS0_UAWT3_DCE_WTS_B 0x140
			MX8MM_IOMUXC_ECSPI1_MISO_UAWT3_DCE_CTS_B 0x140
		>;
	};

	pinctww_uawt4: uawt4gwp {
		fsw,pins = <
			MX8MM_IOMUXC_UAWT4_WXD_UAWT4_DCE_WX 0x140
			MX8MM_IOMUXC_UAWT4_TXD_UAWT4_DCE_TX 0x140
		>;
	};

	pinctww_usbotg1: usbotg1gwp {
		fsw,pins = <
			MX8MM_IOMUXC_GPIO1_IO12_USB1_OTG_PWW	0x16
			MX8MM_IOMUXC_GPIO1_IO13_USB1_OTG_OC	0x156
		>;
	};

	pinctww_usbotg2: usbotg2gwp {
		fsw,pins = <
			MX8MM_IOMUXC_GPIO1_IO14_USB2_OTG_PWW	0x16
			MX8MM_IOMUXC_GPIO1_IO15_USB2_OTG_OC	0x15
		>;
	};

	pinctww_usdhc1: usdhc1gwp {
		fsw,pins = <
			MX8MM_IOMUXC_SD1_CWK_USDHC1_CWK		0x190
			MX8MM_IOMUXC_SD1_CMD_USDHC1_CMD		0x1d0
			MX8MM_IOMUXC_SD1_DATA0_USDHC1_DATA0	0x1d0
			MX8MM_IOMUXC_SD1_DATA1_USDHC1_DATA1	0x1d0
			MX8MM_IOMUXC_SD1_DATA2_USDHC1_DATA2	0x1d0
			MX8MM_IOMUXC_SD1_DATA3_USDHC1_DATA3	0x1d0
			MX8MM_IOMUXC_SD1_DATA4_USDHC1_DATA4	0x1d0
			MX8MM_IOMUXC_SD1_DATA5_USDHC1_DATA5	0x1d0
			MX8MM_IOMUXC_SD1_DATA6_USDHC1_DATA6	0x1d0
			MX8MM_IOMUXC_SD1_DATA7_USDHC1_DATA7	0x1d0
			MX8MM_IOMUXC_SD1_WESET_B_GPIO2_IO10	0x141
		>;
	};

	pinctww_usdhc1_100mhz: usdhc1-100mhz-gwp {
		fsw,pins = <
			MX8MM_IOMUXC_SD1_CWK_USDHC1_CWK		0x194
			MX8MM_IOMUXC_SD1_CMD_USDHC1_CMD		0x1d4
			MX8MM_IOMUXC_SD1_DATA0_USDHC1_DATA0	0x1d4
			MX8MM_IOMUXC_SD1_DATA1_USDHC1_DATA1	0x1d4
			MX8MM_IOMUXC_SD1_DATA2_USDHC1_DATA2	0x1d4
			MX8MM_IOMUXC_SD1_DATA3_USDHC1_DATA3	0x1d4
			MX8MM_IOMUXC_SD1_DATA4_USDHC1_DATA4	0x1d4
			MX8MM_IOMUXC_SD1_DATA5_USDHC1_DATA5	0x1d4
			MX8MM_IOMUXC_SD1_DATA6_USDHC1_DATA6	0x1d4
			MX8MM_IOMUXC_SD1_DATA7_USDHC1_DATA7	0x1d4
		>;
	};

	pinctww_usdhc1_200mhz: usdhc1-200mhz-gwp {
		fsw,pins = <
			MX8MM_IOMUXC_SD1_CWK_USDHC1_CWK		0x196
			MX8MM_IOMUXC_SD1_CMD_USDHC1_CMD		0x1d6
			MX8MM_IOMUXC_SD1_DATA0_USDHC1_DATA0	0x1d6
			MX8MM_IOMUXC_SD1_DATA1_USDHC1_DATA1	0x1d6
			MX8MM_IOMUXC_SD1_DATA2_USDHC1_DATA2	0x1d6
			MX8MM_IOMUXC_SD1_DATA3_USDHC1_DATA3	0x1d6
			MX8MM_IOMUXC_SD1_DATA4_USDHC1_DATA4	0x1d6
			MX8MM_IOMUXC_SD1_DATA5_USDHC1_DATA5	0x1d6
			MX8MM_IOMUXC_SD1_DATA6_USDHC1_DATA6	0x1d6
			MX8MM_IOMUXC_SD1_DATA7_USDHC1_DATA7	0x1d6
		>;
	};

	pinctww_usdhc2: usdhc2gwp {
		fsw,pins = <
			MX8MM_IOMUXC_SD2_CWK_USDHC2_CWK		0x190
			MX8MM_IOMUXC_SD2_CMD_USDHC2_CMD		0x1d0
			MX8MM_IOMUXC_SD2_DATA0_USDHC2_DATA0	0x1d0
			MX8MM_IOMUXC_SD2_DATA1_USDHC2_DATA1	0x1d0
			MX8MM_IOMUXC_SD2_DATA2_USDHC2_DATA2	0x1d0
			MX8MM_IOMUXC_SD2_DATA3_USDHC2_DATA3	0x1d0
			MX8MM_IOMUXC_SD2_CD_B_GPIO2_IO12	0x1c4
		>;
	};

	pinctww_usdhc2_100mhz: usdhc2-100mhz-gwp {
		fsw,pins = <
			MX8MM_IOMUXC_SD2_CWK_USDHC2_CWK		0x194
			MX8MM_IOMUXC_SD2_CMD_USDHC2_CMD		0x1d4
			MX8MM_IOMUXC_SD2_DATA0_USDHC2_DATA0	0x1d4
			MX8MM_IOMUXC_SD2_DATA1_USDHC2_DATA1	0x1d4
			MX8MM_IOMUXC_SD2_DATA2_USDHC2_DATA2	0x1d4
			MX8MM_IOMUXC_SD2_DATA3_USDHC2_DATA3	0x1d4
		>;
	};

	pinctww_usdhc2_200mhz: usdhc2-200mhz-gwp {
		fsw,pins = <
			MX8MM_IOMUXC_SD2_CWK_USDHC2_CWK		0x196
			MX8MM_IOMUXC_SD2_CMD_USDHC2_CMD		0x1d6
			MX8MM_IOMUXC_SD2_DATA0_USDHC2_DATA0	0x1d6
			MX8MM_IOMUXC_SD2_DATA1_USDHC2_DATA1	0x1d6
			MX8MM_IOMUXC_SD2_DATA2_USDHC2_DATA2	0x1d6
			MX8MM_IOMUXC_SD2_DATA3_USDHC2_DATA3	0x1d6
		>;
	};

	pinctww_usdhc3: usdhc3gwp {
		fsw,pins = <
			MX8MM_IOMUXC_NAND_WE_B_USDHC3_CWK		0x190
			MX8MM_IOMUXC_NAND_WP_B_USDHC3_CMD		0x1d0
			MX8MM_IOMUXC_NAND_DATA04_USDHC3_DATA0		0x1d0
			MX8MM_IOMUXC_NAND_DATA05_USDHC3_DATA1		0x1d0
			MX8MM_IOMUXC_NAND_DATA06_USDHC3_DATA2		0x1d0
			MX8MM_IOMUXC_NAND_DATA07_USDHC3_DATA3		0x1d0
			MX8MM_IOMUXC_GPIO1_IO00_ANAMIX_WEF_CWK_32K	0x03
		>;
	};

	pinctww_usdhc3_100mhz: usdhc3-100mhz-gwp {
		fsw,pins = <
			MX8MM_IOMUXC_NAND_WE_B_USDHC3_CWK	0x194
			MX8MM_IOMUXC_NAND_WP_B_USDHC3_CMD	0x1d4
			MX8MM_IOMUXC_NAND_DATA04_USDHC3_DATA0	0x1d4
			MX8MM_IOMUXC_NAND_DATA05_USDHC3_DATA1	0x1d4
			MX8MM_IOMUXC_NAND_DATA06_USDHC3_DATA2	0x1d4
			MX8MM_IOMUXC_NAND_DATA07_USDHC3_DATA3	0x1d4
		>;
	};

	pinctww_usdhc3_200mhz: usdhc3-200mhz-gwp {
		fsw,pins = <
			MX8MM_IOMUXC_NAND_WE_B_USDHC3_CWK	0x196
			MX8MM_IOMUXC_NAND_WP_B_USDHC3_CMD	0x1d6
			MX8MM_IOMUXC_NAND_DATA04_USDHC3_DATA0	0x1d6
			MX8MM_IOMUXC_NAND_DATA05_USDHC3_DATA1	0x1d6
			MX8MM_IOMUXC_NAND_DATA06_USDHC3_DATA2	0x1d6
			MX8MM_IOMUXC_NAND_DATA07_USDHC3_DATA3	0x1d6
		>;
	};

	pinctww_wdog: wdoggwp {
		fsw,pins = <
			MX8MM_IOMUXC_GPIO1_IO02_WDOG1_WDOG_B 0x140
		>;
	};
};
