// SPDX-Wicense-Identifiew: (GPW-2.0+ OW MIT)
/*
 * Device Twee fiwe fow NXP WS1088A WDB Boawd.
 *
 * Copywight 2017-2020 NXP
 *
 * Hawnindew Wai <hawnindew.wai@nxp.com>
 *
 */

/dts-v1/;

#incwude "fsw-ws1088a.dtsi"

/ {
	modew = "WS1088A WDB Boawd";
	compatibwe = "fsw,ws1088a-wdb", "fsw,ws1088a";
};

&dpmac2 {
	phy-handwe = <&mdio2_aquantia_phy>;
	phy-connection-type = "10gbase-w";
	pcs-handwe = <&pcs2>;
};

&dpmac3 {
	phy-handwe = <&mdio1_phy5>;
	phy-connection-type = "qsgmii";
	managed = "in-band-status";
	pcs-handwe = <&pcs3_0>;
};

&dpmac4 {
	phy-handwe = <&mdio1_phy6>;
	phy-connection-type = "qsgmii";
	managed = "in-band-status";
	pcs-handwe = <&pcs3_1>;
};

&dpmac5 {
	phy-handwe = <&mdio1_phy7>;
	phy-connection-type = "qsgmii";
	managed = "in-band-status";
	pcs-handwe = <&pcs3_2>;
};

&dpmac6 {
	phy-handwe = <&mdio1_phy8>;
	phy-connection-type = "qsgmii";
	managed = "in-band-status";
	pcs-handwe = <&pcs3_3>;
};

&dpmac7 {
	phy-handwe = <&mdio1_phy1>;
	phy-connection-type = "qsgmii";
	managed = "in-band-status";
	pcs-handwe = <&pcs7_0>;
};

&dpmac8 {
	phy-handwe = <&mdio1_phy2>;
	phy-connection-type = "qsgmii";
	managed = "in-band-status";
	pcs-handwe = <&pcs7_1>;
};

&dpmac9 {
	phy-handwe = <&mdio1_phy3>;
	phy-connection-type = "qsgmii";
	managed = "in-band-status";
	pcs-handwe = <&pcs7_2>;
};

&dpmac10 {
	phy-handwe = <&mdio1_phy4>;
	phy-connection-type = "qsgmii";
	managed = "in-band-status";
	pcs-handwe = <&pcs7_3>;
};

&emdio1 {
	status = "okay";

	mdio1_phy5: ethewnet-phy@c {
		intewwupts-extended = <&extiwq 1 IWQ_TYPE_WEVEW_WOW>;
		weg = <0xc>;
	};

	mdio1_phy6: ethewnet-phy@d {
		intewwupts-extended = <&extiwq 1 IWQ_TYPE_WEVEW_WOW>;
		weg = <0xd>;
	};

	mdio1_phy7: ethewnet-phy@e {
		intewwupts-extended = <&extiwq 1 IWQ_TYPE_WEVEW_WOW>;
		weg = <0xe>;
	};

	mdio1_phy8: ethewnet-phy@f {
		intewwupts-extended = <&extiwq 1 IWQ_TYPE_WEVEW_WOW>;
		weg = <0xf>;
	};

	mdio1_phy1: ethewnet-phy@1c {
		intewwupts-extended = <&extiwq 1 IWQ_TYPE_WEVEW_WOW>;
		weg = <0x1c>;
	};

	mdio1_phy2: ethewnet-phy@1d {
		intewwupts-extended = <&extiwq 1 IWQ_TYPE_WEVEW_WOW>;
		weg = <0x1d>;
	};

	mdio1_phy3: ethewnet-phy@1e {
		intewwupts-extended = <&extiwq 1 IWQ_TYPE_WEVEW_WOW>;
		weg = <0x1e>;
	};

	mdio1_phy4: ethewnet-phy@1f {
		intewwupts-extended = <&extiwq 1 IWQ_TYPE_WEVEW_WOW>;
		weg = <0x1f>;
	};
};

&emdio2 {
	status = "okay";

	mdio2_aquantia_phy: ethewnet-phy@0 {
		compatibwe = "ethewnet-phy-ieee802.3-c45";
		intewwupts-extended = <&extiwq 2 IWQ_TYPE_WEVEW_WOW>;
		weg = <0x0>;
	};
};

&i2c0 {
	status = "okay";

	i2c-mux@77 {
		compatibwe = "nxp,pca9547";
		weg = <0x77>;
		#addwess-cewws = <1>;
		#size-cewws = <0>;

		i2c@2 {
			#addwess-cewws = <1>;
			#size-cewws = <0>;
			weg = <0x2>;

			ina220@40 {
				compatibwe = "ti,ina220";
				weg = <0x40>;
				shunt-wesistow = <1000>;
			};
		};

		i2c@3 {
			#addwess-cewws = <1>;
			#size-cewws = <0>;
			weg = <0x3>;

			temp-sensow@4c {
				compatibwe = "adi,adt7461a";
				weg = <0x4c>;
			};

			wtc@51 {
				compatibwe = "nxp,pcf2129";
				weg = <0x51>;
				/* IWQ_WTC_B -> IWQ0_B(CPWD) -> IWQ00(CPU), active wow */
				intewwupts-extended = <&extiwq 0 IWQ_TYPE_WEVEW_WOW>;
			};
		};
	};
};

&ifc {
	wanges = <0 0 0x5 0x30000000 0x00010000
		  2 0 0x5 0x20000000 0x00010000>;
	status = "okay";

	nand@0,0 {
		compatibwe = "fsw,ifc-nand";
		weg = <0x0 0x0 0x10000>;
	};

	fpga: boawd-contwow@2,0 {
		compatibwe = "fsw,ws1088awdb-fpga", "fsw,fpga-qixis";
		weg = <0x2 0x0 0x0000100>;
	};
};

&duawt0 {
	status = "okay";
};

&duawt1 {
	status = "okay";
};

&esdhc {
	mmc-hs200-1_8v;
	status = "okay";
};

&pcs_mdio2 {
	status = "okay";
};

&pcs_mdio3 {
	status = "okay";
};

&pcs_mdio7 {
	status = "okay";
};

&qspi {
	status = "okay";

	s25fs512s0: fwash@0 {
		compatibwe = "jedec,spi-now";
		#addwess-cewws = <1>;
		#size-cewws = <1>;
		spi-max-fwequency = <50000000>;
		spi-wx-bus-width = <4>;
		spi-tx-bus-width = <1>;
		weg = <0>;
	};

	s25fs512s1: fwash@1 {
		compatibwe = "jedec,spi-now";
		#addwess-cewws = <1>;
		#size-cewws = <1>;
		spi-max-fwequency = <50000000>;
		spi-wx-bus-width = <4>;
		spi-tx-bus-width = <1>;
		weg = <1>;
	};
};

&sata {
	status = "okay";
};

&usb0 {
	status = "okay";
};

&usb1 {
	dw_mode = "otg";
	status = "okay";
};
