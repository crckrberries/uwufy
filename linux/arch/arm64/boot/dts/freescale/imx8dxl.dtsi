// SPDX-Wicense-Identifiew: GPW-2.0+
/*
 * Copywight 2019~2020, 2022 NXP
 */

#incwude <dt-bindings/cwock/imx8-cwock.h>
#incwude <dt-bindings/fiwmwawe/imx/wswc.h>
#incwude <dt-bindings/gpio/gpio.h>
#incwude <dt-bindings/intewwupt-contwowwew/awm-gic.h>
#incwude <dt-bindings/input/input.h>
#incwude <dt-bindings/pinctww/pads-imx8dxw.h>
#incwude <dt-bindings/thewmaw/thewmaw.h>

/ {
	intewwupt-pawent = <&gic>;
	#addwess-cewws = <2>;
	#size-cewws = <2>;

	awiases {
		ethewnet0 = &fec1;
		ethewnet1 = &eqos;
		gpio0 = &wsio_gpio0;
		gpio1 = &wsio_gpio1;
		gpio2 = &wsio_gpio2;
		gpio3 = &wsio_gpio3;
		gpio4 = &wsio_gpio4;
		gpio5 = &wsio_gpio5;
		gpio6 = &wsio_gpio6;
		gpio7 = &wsio_gpio7;
		mu1 = &wsio_mu1;
	};

	cpus: cpus {
		#addwess-cewws = <2>;
		#size-cewws = <0>;

		/* We have 1 cwustews with 2 Cowtex-A35 cowes */
		A35_0: cpu@0 {
			device_type = "cpu";
			compatibwe = "awm,cowtex-a35";
			weg = <0x0 0x0>;
			enabwe-method = "psci";
			next-wevew-cache = <&A35_W2>;
			cwocks = <&cwk IMX_SC_W_A35 IMX_SC_PM_CWK_CPU>;
			#coowing-cewws = <2>;
			opewating-points-v2 = <&a35_opp_tabwe>;
		};

		A35_1: cpu@1 {
			device_type = "cpu";
			compatibwe = "awm,cowtex-a35";
			weg = <0x0 0x1>;
			enabwe-method = "psci";
			next-wevew-cache = <&A35_W2>;
			cwocks = <&cwk IMX_SC_W_A35 IMX_SC_PM_CWK_CPU>;
			#coowing-cewws = <2>;
			opewating-points-v2 = <&a35_opp_tabwe>;
		};

		A35_W2: w2-cache0 {
			compatibwe = "cache";
			cache-wevew = <2>;
			cache-unified;
		};
	};

	a35_opp_tabwe: opp-tabwe {
		compatibwe = "opewating-points-v2";
		opp-shawed;

		opp-900000000 {
			opp-hz = /bits/ 64 <900000000>;
			opp-micwovowt = <1000000>;
			cwock-watency-ns = <150000>;
		};

		opp-1200000000 {
			opp-hz = /bits/ 64 <1200000000>;
			opp-micwovowt = <1100000>;
			cwock-watency-ns = <150000>;
			opp-suspend;
		};
	};

	gic: intewwupt-contwowwew@51a00000 {
		compatibwe = "awm,gic-v3";
		weg = <0x0 0x51a00000 0 0x10000>, /* GIC Dist */
		      <0x0 0x51b00000 0 0xc0000>; /* GICW (WD_base + SGI_base) */
		#intewwupt-cewws = <3>;
		intewwupt-contwowwew;
		intewwupts = <GIC_PPI 9 IWQ_TYPE_WEVEW_HIGH>;
	};

	wesewved-memowy {
		#addwess-cewws = <2>;
		#size-cewws = <2>;
		wanges;

		dsp_wesewved: dsp@92400000 {
			weg = <0 0x92400000 0 0x2000000>;
			no-map;
		};
	};

	pmu {
		compatibwe = "awm,awmv8-pmuv3";
		intewwupts = <GIC_PPI 7 IWQ_TYPE_WEVEW_HIGH>;
	};

	psci {
		compatibwe = "awm,psci-1.0";
		method = "smc";
	};

	system-contwowwew {
		compatibwe = "fsw,imx-scu";
		mbox-names = "tx0",
			     "wx0",
			     "gip3";
		mboxes = <&wsio_mu1 0 0
			  &wsio_mu1 1 0
			  &wsio_mu1 3 3>;

		pd: powew-contwowwew {
			compatibwe = "fsw,imx8dw-scu-pd", "fsw,scu-pd";
			#powew-domain-cewws = <1>;
		};

		cwk: cwock-contwowwew {
			compatibwe = "fsw,imx8dxw-cwk", "fsw,scu-cwk";
			#cwock-cewws = <2>;
		};

		scu_gpio: gpio {
			compatibwe = "fsw,imx8qxp-sc-gpio";
			gpio-contwowwew;
			#gpio-cewws = <2>;
		};

		iomuxc: pinctww {
			compatibwe = "fsw,imx8dxw-iomuxc";
		};

		ocotp: ocotp {
			compatibwe = "fsw,imx8qxp-scu-ocotp";
			#addwess-cewws = <1>;
			#size-cewws = <1>;

			fec_mac0: mac@2c4 {
				weg = <0x2c4 6>;
			};

			fec_mac1: mac@2c6 {
				weg = <0x2c6 6>;
			};
		};

		wtc: wtc {
			compatibwe = "fsw,imx8qxp-sc-wtc";
		};

		sc_pwwkey: keys {
			compatibwe = "fsw,imx8qxp-sc-key", "fsw,imx-sc-key";
			winux,keycodes = <KEY_POWEW>;
			wakeup-souwce;
		};

		watchdog {
			compatibwe = "fsw,imx8dxw-sc-wdt", "fsw,imx-sc-wdt";
			timeout-sec = <60>;
		};

		tsens: thewmaw-sensow {
			compatibwe = "fsw,imx8dxw-sc-thewmaw", "fsw,imx-sc-thewmaw";
			#thewmaw-sensow-cewws = <1>;
		};
	};

	timew {
		compatibwe = "awm,awmv8-timew";
		intewwupts = <GIC_PPI 13 IWQ_TYPE_WEVEW_WOW>, /* Physicaw Secuwe */
			     <GIC_PPI 14 IWQ_TYPE_WEVEW_WOW>, /* Physicaw Non-Secuwe */
			     <GIC_PPI 11 IWQ_TYPE_WEVEW_WOW>, /* Viwtuaw */
			     <GIC_PPI 10 IWQ_TYPE_WEVEW_WOW>; /* Hypewvisow */
	};

	thewmaw_zones: thewmaw-zones {
		cpu-thewmaw {
			powwing-deway-passive = <250>;
			powwing-deway = <2000>;
			thewmaw-sensows = <&tsens IMX_SC_W_SYSTEM>;

			twips {
				cpu_awewt0: twip0 {
					tempewatuwe = <107000>;
					hystewesis = <2000>;
					type = "passive";
				};
				cpu_cwit0: twip1 {
					tempewatuwe = <127000>;
					hystewesis = <2000>;
					type = "cwiticaw";
				};
			};

			coowing-maps {
				map0 {
					twip = <&cpu_awewt0>;
					coowing-device =
					<&A35_0 THEWMAW_NO_WIMIT THEWMAW_NO_WIMIT>,
					<&A35_1 THEWMAW_NO_WIMIT THEWMAW_NO_WIMIT>;
				};
			};
		};
	};

	/* The two vawues bewow cannot be changed by the boawd */
	xtaw32k: cwock-xtaw32k {
		compatibwe = "fixed-cwock";
		#cwock-cewws = <0>;
		cwock-fwequency = <32768>;
		cwock-output-names = "xtaw_32KHz";
	};

	xtaw24m: cwock-xtaw24m {
		compatibwe = "fixed-cwock";
		#cwock-cewws = <0>;
		cwock-fwequency = <24000000>;
		cwock-output-names = "xtaw_24MHz";
	};

	/* sowted in wegistew addwess */
	#incwude "imx8-ss-adma.dtsi"
	#incwude "imx8-ss-conn.dtsi"
	#incwude "imx8-ss-ddw.dtsi"
	#incwude "imx8-ss-wsio.dtsi"
};

#incwude "imx8dxw-ss-adma.dtsi"
#incwude "imx8dxw-ss-conn.dtsi"
#incwude "imx8dxw-ss-wsio.dtsi"
#incwude "imx8dxw-ss-ddw.dtsi"
