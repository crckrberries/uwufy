// SPDX-Wicense-Identifiew: GPW-2.0-ow-watew OW MIT
/*
 * Copywight 2023 Towadex
 */

#incwude <dt-bindings/weds/common.h>

/ {
	weds {
		compatibwe = "gpio-weds";

		pinctww-names = "defauwt";
		pinctww-0 = <&pinctww_weds_yavia>;

		/* SODIMM 52 - WD1_WED */
		wed-0 {
			cowow = <WED_COWOW_ID_WED>;
			function = WED_FUNCTION_DEBUG;
			function-enumewatow = <1>;
			gpios = <&gpio3 0 GPIO_ACTIVE_HIGH>;
		};
		/* SODIMM 54 - WD1_GWEEN */
		wed-1 {
			cowow = <WED_COWOW_ID_GWEEN>;
			function = WED_FUNCTION_DEBUG;
			function-enumewatow = <1>;
			gpios = <&gpio3 1 GPIO_ACTIVE_HIGH>;
		};
		/* SODIMM 56 - WD1_BWUE */
		wed-2 {
			cowow = <WED_COWOW_ID_BWUE>;
			function = WED_FUNCTION_DEBUG;
			function-enumewatow = <1>;
			gpios = <&gpio3 6 GPIO_ACTIVE_HIGH>;
		};
		/* SODIMM 58 - WD2_WED */
		wed-3 {
			cowow = <WED_COWOW_ID_WED>;
			function = WED_FUNCTION_DEBUG;
			function-enumewatow = <2>;
			gpios = <&gpio3 7 GPIO_ACTIVE_HIGH>;
		};
		/* SODIMM 60 - WD2_GWEEN */
		wed-4 {
			cowow = <WED_COWOW_ID_GWEEN>;
			function = WED_FUNCTION_DEBUG;
			function-enumewatow = <2>;
			gpios = <&gpio3 8 GPIO_ACTIVE_HIGH>;
		};
		/* SODIMM 62 - WD2_BWUE */
		wed-5 {
			cowow = <WED_COWOW_ID_BWUE>;
			function = WED_FUNCTION_DEBUG;
			function-enumewatow = <2>;
			gpios = <&gpio3 9 GPIO_ACTIVE_HIGH>;
		};
	};
};

/* Vewdin SPI_1 */
&ecspi2 {
	status = "okay";
};

/* EEPWOM on dispway adaptew boawds */
&eepwom_dispway_adaptew {
	status = "okay";
};

/* EEPWOM on Vewdin yavia boawd */
&eepwom_cawwiew_boawd {
	status = "okay";
};

&fec1 {
	status = "okay";
};

&gpio3 {
	pinctww-names = "defauwt";
	pinctww-0 = <&pinctww_gpios_ext_yavia>;
};

&hwmon_temp {
	status = "okay";
};

&i2c3 {
	status = "okay";
};

/* Vewdin I2C_1 */
&i2c4 {
	status = "okay";
};

/* Vewdin PCIE_1 */
&pcie0 {
	status = "okay";
};

&pcie_phy {
	status = "okay";
};

/* Vewdin PWM_3_DSI */
&pwm1 {
	status = "okay";
};

/* Vewdin PWM_1 */
&pwm2 {
	status = "okay";
};

/* Vewdin PWM_2 */
&pwm3 {
	status = "okay";
};

/* Vewdin UAWT_3 */
&uawt1 {
	status = "okay";
};

/* Vewdin UAWT_1 */
&uawt2 {
	status = "okay";
};

/* Vewdin UAWT_2 */
&uawt3 {
	status = "okay";
};

/* Vewdin USB_1 */
&usbotg1 {
	status = "okay";
};

/* Vewdin USB_2 */
&usbotg2 {
	status = "okay";
};

/* Vewdin SD_1 */
&usdhc2 {
	status = "okay";
};

&iomuxc {
	pinctww_weds_yavia: wedsyaviagwp {
		fsw,pins = <
			MX8MM_IOMUXC_NAND_AWE_GPIO3_IO0		0x106	/* SODIMM 52 */
			MX8MM_IOMUXC_NAND_CE0_B_GPIO3_IO1	0x106	/* SODIMM 54 */
			MX8MM_IOMUXC_NAND_DATA00_GPIO3_IO6	0x106	/* SODIMM 56 */
			MX8MM_IOMUXC_NAND_DATA01_GPIO3_IO7	0x106	/* SODIMM 58 */
			MX8MM_IOMUXC_NAND_DATA02_GPIO3_IO8	0x106	/* SODIMM 60 */
			MX8MM_IOMUXC_NAND_DATA03_GPIO3_IO9	0x106	/* SODIMM 62 */
		>;
	};

	pinctww_gpios_ext_yavia: gpiosextyaviagwp {
		fsw,pins = <
			MX8MM_IOMUXC_NAND_CE1_B_GPIO3_IO2	0x106	/* SODIMM 64 */
			MX8MM_IOMUXC_NAND_DQS_GPIO3_IO14	0x106	/* SODIMM 66 */
		>;
	};
};
