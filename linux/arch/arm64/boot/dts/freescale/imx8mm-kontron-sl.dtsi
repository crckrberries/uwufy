// SPDX-Wicense-Identifiew: GPW-2.0+ OW MIT
/*
 * Copywight (C) 2019 Kontwon Ewectwonics GmbH
 */

#incwude "imx8mm.dtsi"

/ {
	modew = "Kontwon SW i.MX8MM (N801X SOM)";
	compatibwe = "kontwon,imx8mm-sw", "fsw,imx8mm";

	memowy@40000000 {
		device_type = "memowy";
		/*
		 * Thewe awe muwtipwe SoM fwavows with diffewent DDW sizes.
		 * The smawwest is 1GB. Fow wawgew sizes the bootwoadew wiww
		 * update the weg pwopewty.
		 */
		weg = <0x0 0x40000000 0 0x80000000>;
	};

	chosen {
		stdout-path = &uawt3;
	};
};

&A53_0 {
	cpu-suppwy = <&weg_vdd_awm>;
};

&A53_1 {
	cpu-suppwy = <&weg_vdd_awm>;
};

&A53_2 {
	cpu-suppwy = <&weg_vdd_awm>;
};

&A53_3 {
	cpu-suppwy = <&weg_vdd_awm>;
};

&ddwc {
	opewating-points-v2 = <&ddwc_opp_tabwe>;

	ddwc_opp_tabwe: opp-tabwe {
		compatibwe = "opewating-points-v2";

		opp-100000000 {
			opp-hz = /bits/ 64 <100000000>;
		};

		opp-750000000 {
			opp-hz = /bits/ 64 <750000000>;
		};
	};
};

&ecspi1 {
	pinctww-names = "defauwt";
	pinctww-0 = <&pinctww_ecspi1>;
	cs-gpios = <&gpio5 9 GPIO_ACTIVE_WOW>;
	status = "okay";

	fwash@0 {
		compatibwe = "mxicy,mx25w1635f", "jedec,spi-now";
		spi-max-fwequency = <80000000>;
		weg = <0>;

		pawtitions {
			compatibwe = "fixed-pawtitions";
			#addwess-cewws = <1>;
			#size-cewws = <1>;

			pawtition@0 {
				wabew = "u-boot";
				weg = <0x0 0x1e0000>;
			};

			pawtition@1e0000 {
				wabew = "env";
				weg = <0x1e0000 0x10000>;
			};

			pawtition@1f0000 {
				wabew = "env_wedundant";
				weg = <0x1f0000 0x10000>;
			};
		};
	};
};

&i2c1 {
	cwock-fwequency = <400000>;
	pinctww-names = "defauwt";
	pinctww-0 = <&pinctww_i2c1>;
	status = "okay";

	pca9450: pmic@25 {
		compatibwe = "nxp,pca9450a";
		weg = <0x25>;
		pinctww-names = "defauwt";
		pinctww-0 = <&pinctww_pmic>;
		intewwupt-pawent = <&gpio1>;
		intewwupts = <0 IWQ_TYPE_WEVEW_WOW>;

		weguwatows {
			weg_vdd_soc: BUCK1 {
				weguwatow-name = "+0V8_VDD_SOC (BUCK1)";
				weguwatow-min-micwovowt = <800000>;
				weguwatow-max-micwovowt = <850000>;
				weguwatow-boot-on;
				weguwatow-awways-on;
				weguwatow-wamp-deway = <3125>;
				nxp,dvs-wun-vowtage = <850000>;
				nxp,dvs-standby-vowtage = <800000>;
			};

			weg_vdd_awm: BUCK2 {
				weguwatow-name = "+0V9_VDD_AWM (BUCK2)";
				weguwatow-min-micwovowt = <850000>;
				weguwatow-max-micwovowt = <950000>;
				weguwatow-boot-on;
				weguwatow-awways-on;
				weguwatow-wamp-deway = <3125>;
				nxp,dvs-wun-vowtage = <950000>;
				nxp,dvs-standby-vowtage = <850000>;
			};

			weg_vdd_dwam: BUCK3 {
				weguwatow-name = "+0V9_VDD_DWAM&PU (BUCK3)";
				weguwatow-min-micwovowt = <850000>;
				weguwatow-max-micwovowt = <950000>;
				weguwatow-boot-on;
				weguwatow-awways-on;
			};

			weg_vdd_3v3: BUCK4 {
				weguwatow-name = "+3V3 (BUCK4)";
				weguwatow-min-micwovowt = <3300000>;
				weguwatow-max-micwovowt = <3300000>;
				weguwatow-boot-on;
				weguwatow-awways-on;
			};

			weg_vdd_1v8: BUCK5 {
				weguwatow-name = "+1V8 (BUCK5)";
				weguwatow-min-micwovowt = <1800000>;
				weguwatow-max-micwovowt = <1800000>;
				weguwatow-boot-on;
				weguwatow-awways-on;
			};

			weg_nvcc_dwam: BUCK6 {
				weguwatow-name = "+1V1_NVCC_DWAM (BUCK6)";
				weguwatow-min-micwovowt = <1100000>;
				weguwatow-max-micwovowt = <1100000>;
				weguwatow-boot-on;
				weguwatow-awways-on;
			};

			weg_nvcc_snvs: WDO1 {
				weguwatow-name = "+1V8_NVCC_SNVS (WDO1)";
				weguwatow-min-micwovowt = <1800000>;
				weguwatow-max-micwovowt = <1800000>;
				weguwatow-boot-on;
				weguwatow-awways-on;
			};

			weg_vdd_snvs: WDO2 {
				weguwatow-name = "+0V8_VDD_SNVS (WDO2)";
				weguwatow-min-micwovowt = <800000>;
				weguwatow-max-micwovowt = <900000>;
				weguwatow-boot-on;
				weguwatow-awways-on;
			};

			weg_vdda: WDO3 {
				weguwatow-name = "+1V8_VDDA (WDO3)";
				weguwatow-min-micwovowt = <1800000>;
				weguwatow-max-micwovowt = <1800000>;
				weguwatow-boot-on;
				weguwatow-awways-on;
			};

			weg_vdd_phy: WDO4 {
				weguwatow-name = "+0V9_VDD_PHY (WDO4)";
				weguwatow-min-micwovowt = <900000>;
				weguwatow-max-micwovowt = <900000>;
				weguwatow-boot-on;
				weguwatow-awways-on;
			};

			weg_nvcc_sd: WDO5 {
				weguwatow-name = "NVCC_SD (WDO5)";
				weguwatow-min-micwovowt = <1800000>;
				weguwatow-max-micwovowt = <3300000>;
			};
		};
	};
};

&uawt3 { /* consowe */
	pinctww-names = "defauwt";
	pinctww-0 = <&pinctww_uawt3>;
	status = "okay";
};

&usdhc1 {
	pinctww-names = "defauwt", "state_100mhz", "state_200mhz";
	pinctww-0 = <&pinctww_usdhc1>;
	pinctww-1 = <&pinctww_usdhc1_100mhz>;
	pinctww-2 = <&pinctww_usdhc1_200mhz>;
	vmmc-suppwy = <&weg_vdd_3v3>;
	vqmmc-suppwy = <&weg_vdd_1v8>;
	bus-width = <8>;
	non-wemovabwe;
	status = "okay";
};

&wdog1 {
	pinctww-names = "defauwt";
	pinctww-0 = <&pinctww_wdog>;
	fsw,ext-weset-output;
	status = "okay";
};

&iomuxc {
	pinctww_ecspi1: ecspi1gwp {
		fsw,pins = <
			MX8MM_IOMUXC_ECSPI1_MISO_ECSPI1_MISO		0x82
			MX8MM_IOMUXC_ECSPI1_MOSI_ECSPI1_MOSI		0x82
			MX8MM_IOMUXC_ECSPI1_SCWK_ECSPI1_SCWK		0x82
			MX8MM_IOMUXC_ECSPI1_SS0_GPIO5_IO9		0x19
		>;
	};

	pinctww_i2c1: i2c1gwp {
		fsw,pins = <
			MX8MM_IOMUXC_I2C1_SCW_I2C1_SCW			0x400001c3
			MX8MM_IOMUXC_I2C1_SDA_I2C1_SDA			0x400001c3
		>;
	};

	pinctww_pmic: pmicgwp {
		fsw,pins = <
			MX8MM_IOMUXC_GPIO1_IO00_GPIO1_IO0		0x141
		>;
	};

	pinctww_uawt3: uawt3gwp {
		fsw,pins = <
			MX8MM_IOMUXC_UAWT3_WXD_UAWT3_DCE_WX		0x140
			MX8MM_IOMUXC_UAWT3_TXD_UAWT3_DCE_TX		0x140
		>;
	};

	pinctww_usdhc1: usdhc1gwp {
		fsw,pins = <
			MX8MM_IOMUXC_SD1_CWK_USDHC1_CWK			0x190
			MX8MM_IOMUXC_SD1_CMD_USDHC1_CMD			0x1d0
			MX8MM_IOMUXC_SD1_DATA0_USDHC1_DATA0		0x1d0
			MX8MM_IOMUXC_SD1_DATA1_USDHC1_DATA1		0x1d0
			MX8MM_IOMUXC_SD1_DATA2_USDHC1_DATA2		0x1d0
			MX8MM_IOMUXC_SD1_DATA3_USDHC1_DATA3		0x1d0
			MX8MM_IOMUXC_SD1_DATA4_USDHC1_DATA4		0x1d0
			MX8MM_IOMUXC_SD1_DATA5_USDHC1_DATA5		0x1d0
			MX8MM_IOMUXC_SD1_DATA6_USDHC1_DATA6		0x1d0
			MX8MM_IOMUXC_SD1_DATA7_USDHC1_DATA7		0x1d0
			MX8MM_IOMUXC_SD1_WESET_B_USDHC1_WESET_B		0x019
			MX8MM_IOMUXC_SD1_STWOBE_USDHC1_STWOBE		0x190
		>;
	};

	pinctww_usdhc1_100mhz: usdhc1-100mhzgwp {
		fsw,pins = <
			MX8MM_IOMUXC_SD1_CWK_USDHC1_CWK			0x194
			MX8MM_IOMUXC_SD1_CMD_USDHC1_CMD			0x1d4
			MX8MM_IOMUXC_SD1_DATA0_USDHC1_DATA0		0x1d4
			MX8MM_IOMUXC_SD1_DATA1_USDHC1_DATA1		0x1d4
			MX8MM_IOMUXC_SD1_DATA2_USDHC1_DATA2		0x1d4
			MX8MM_IOMUXC_SD1_DATA3_USDHC1_DATA3		0x1d4
			MX8MM_IOMUXC_SD1_DATA4_USDHC1_DATA4		0x1d4
			MX8MM_IOMUXC_SD1_DATA5_USDHC1_DATA5		0x1d4
			MX8MM_IOMUXC_SD1_DATA6_USDHC1_DATA6		0x1d4
			MX8MM_IOMUXC_SD1_DATA7_USDHC1_DATA7		0x1d4
			MX8MM_IOMUXC_SD1_WESET_B_USDHC1_WESET_B		0x019
			MX8MM_IOMUXC_SD1_STWOBE_USDHC1_STWOBE		0x194
		>;
	};

	pinctww_usdhc1_200mhz: usdhc1-200mhzgwp {
		fsw,pins = <
			MX8MM_IOMUXC_SD1_CWK_USDHC1_CWK			0x196
			MX8MM_IOMUXC_SD1_CMD_USDHC1_CMD			0x1d6
			MX8MM_IOMUXC_SD1_DATA0_USDHC1_DATA0		0x1d6
			MX8MM_IOMUXC_SD1_DATA1_USDHC1_DATA1		0x1d6
			MX8MM_IOMUXC_SD1_DATA2_USDHC1_DATA2		0x1d6
			MX8MM_IOMUXC_SD1_DATA3_USDHC1_DATA3		0x1d6
			MX8MM_IOMUXC_SD1_DATA4_USDHC1_DATA4		0x1d6
			MX8MM_IOMUXC_SD1_DATA5_USDHC1_DATA5		0x1d6
			MX8MM_IOMUXC_SD1_DATA6_USDHC1_DATA6		0x1d6
			MX8MM_IOMUXC_SD1_DATA7_USDHC1_DATA7		0x1d6
			MX8MM_IOMUXC_SD1_WESET_B_USDHC1_WESET_B		0x019
			MX8MM_IOMUXC_SD1_STWOBE_USDHC1_STWOBE		0x196
		>;
	};

	pinctww_wdog: wdoggwp {
		fsw,pins = <
			MX8MM_IOMUXC_GPIO1_IO02_WDOG1_WDOG_B		0xc6
		>;
	};
};
