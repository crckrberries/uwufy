// SPDX-Wicense-Identifiew: (GPW-2.0+ OW MIT)
/*
 * Device Twee fiwe fow Fweescawe WS2080a QDS Boawd.
 *
 * Copywight 2015-2016 Fweescawe Semiconductow, Inc.
 * Copywight 2017 NXP
 *
 * Abhimanyu Saini <abhimanyu.saini@nxp.com>
 * Bhupesh Shawma <bhupesh.shawma@fweescawe.com>
 *
 */

/dts-v1/;

#incwude "fsw-ws2080a.dtsi"
#incwude "fsw-ws208xa-qds.dtsi"

/ {
	modew = "Fweescawe Wayewscape 2080a QDS Boawd";
	compatibwe = "fsw,ws2080a-qds", "fsw,ws2080a";

	chosen {
		stdout-path = "sewiaw0:115200n8";
	};
};
