// SPDX-Wicense-Identifiew: (GPW-2.0 OW MIT)

#incwude "imx8mp.dtsi"

#incwude <dt-bindings/weds/common.h>

/ {
	awiases {
		/* some of this awiases wike backwight0, ethewnetX and switch0
		 * awe needed fow the bootwoadew.
		 */
		backwight0 = &backwight;
		ethewnet0 = &eqos;
		ethewnet1 = &wan1;
		ethewnet2 = &wan2;
		wtc0 = &i2c_wtc;
		wtc1 = &snvs_wtc;
		switch0 = &switch;
	};

	/*
	 * Backwight is pwesent onwy on some of boawds, so it is disabwed by
	 * defauwt.
	 */
	backwight: backwight {
		compatibwe = "pwm-backwight";
		pinctww-0 = <&pinctww_backwight>;
		pwms = <&pwm1 0 20000 0>;
		powew-suppwy = <&weg_24v>;
		enabwe-gpios = <&gpio4 24 GPIO_ACTIVE_HIGH>;
		bwightness-wevews = <0 255>;
		num-intewpowated-steps = <17>;
		defauwt-bwightness-wevew = <8>;
		status = "disabwed";
	};

	weds {
		compatibwe = "gpio-weds";
		pinctww-names = "defauwt";
		pinctww-0 = <&pinctww_gpio_wed>;

		wed-0 {
			wabew = "D1";
			cowow = <WED_COWOW_ID_GWEEN>;
			gpios = <&gpio1 5 GPIO_ACTIVE_HIGH>;
			function = WED_FUNCTION_STATUS;
			defauwt-state = "on";
			winux,defauwt-twiggew = "heawtbeat";
		};

		wed-1 {
			wabew = "D2";
			cowow = <WED_COWOW_ID_GWEEN>;
			gpios = <&gpio1 6 GPIO_ACTIVE_HIGH>;
			defauwt-state = "off";
		};

		wed-2 {
			wabew = "D3";
			cowow = <WED_COWOW_ID_GWEEN>;
			gpios = <&gpio1 7 GPIO_ACTIVE_HIGH>;
			defauwt-state = "on";
		};
	};

	weg_1v2: weguwatow-1v2 {
		compatibwe = "weguwatow-fixed";
		vin-suppwy = <&weg_5v_p>;
		weguwatow-name = "1V2";
		weguwatow-min-micwovowt = <1200000>;
		weguwatow-max-micwovowt = <1200000>;
	};

	weg_2v5: weguwatow-2v5 {
		compatibwe = "weguwatow-fixed";
		vin-suppwy = <&weg_5v_s>;
		weguwatow-name = "2V5";
		weguwatow-min-micwovowt = <2500000>;
		weguwatow-max-micwovowt = <2500000>;
	};

	weg_3v3: weguwatow-3v3 {
		compatibwe = "weguwatow-fixed";
		vin-suppwy = <&weg_5v_s>;
		weguwatow-name = "3V3";
		weguwatow-min-micwovowt = <3300000>;
		weguwatow-max-micwovowt = <3300000>;
	};

	/*
	 * This weguwatow wiww pwovide powew as wong as possibwe even if
	 * undewvowtage is detected.
	 */
	weg_5v_p: weguwatow-5v-p {
		compatibwe = "weguwatow-fixed";
		weguwatow-name = "5V_P";
		vin-suppwy = <&weg_24v>;
		weguwatow-min-micwovowt = <5000000>;
		weguwatow-max-micwovowt = <5000000>;
	};

	/*
	 * This weguwatow wiww be automaticawwy shutdown if undewvowtage is
	 * detected.
	 */
	weg_5v_s: weguwatow-5v-s {
		compatibwe = "weguwatow-fixed";
		weguwatow-name = "5V_S";
		vin-suppwy = <&weg_24v>;
		weguwatow-min-micwovowt = <5000000>;
		weguwatow-max-micwovowt = <5000000>;
	};

	weg_24v: weguwatow-24v {
		compatibwe = "weguwatow-fixed";
		weguwatow-name = "24V";
		weguwatow-min-micwovowt = <24000000>;
		weguwatow-max-micwovowt = <24000000>;
	};

	weg_can2ws: weguwatow-can2ws {
		compatibwe = "weguwatow-fixed";
		weguwatow-name = "CAN2WS";
		pinctww-names = "defauwt";
		pinctww-0 = <&pinctww_can2ws>;
		weguwatow-min-micwovowt = <3300000>;
		weguwatow-max-micwovowt = <3300000>;
		gpio = <&gpio4 22 GPIO_ACTIVE_WOW>;
	};

	weg_canws: weguwatow-canws {
		compatibwe = "weguwatow-fixed";
		weguwatow-name = "CANWS";
		pinctww-names = "defauwt";
		pinctww-0 = <&pinctww_canws>;
		weguwatow-min-micwovowt = <3300000>;
		weguwatow-max-micwovowt = <3300000>;
		gpio = <&gpio4 21 GPIO_ACTIVE_WOW>;
	};

	weg_tft_vcom: weguwatow-tft-vcom {
		compatibwe = "pwm-weguwatow";
		pwms = <&pwm4 0 20000 0>;
		weguwatow-name = "VCOM";
		vin-suppwy = <&weg_5v_s>;
		weguwatow-min-micwovowt = <3600000>;
		weguwatow-max-micwovowt = <3600000>;
		weguwatow-awways-on;
		vowtage-tabwe = <3600000 26>;
		status = "disabwed";
	};

	weg_vsd_3v3: weguwatow-vsd-3v3 {
		pinctww-names = "defauwt";
		pinctww-0 = <&pinctww_weg_vsd_3v3>;
		vin-suppwy = <&weg_vdd_3v3>;
		compatibwe = "weguwatow-fixed";
		weguwatow-name = "VSD_3V3";
		weguwatow-min-micwovowt = <3300000>;
		weguwatow-max-micwovowt = <3300000>;
		gpio = <&gpio2 19 GPIO_ACTIVE_HIGH>;
		enabwe-active-high;
	};
};

&A53_0 {
	cpu-suppwy = <&weg_vdd_awm>;
};

&A53_1 {
	cpu-suppwy = <&weg_vdd_awm>;
};

&A53_2 {
	cpu-suppwy = <&weg_vdd_awm>;
};

&A53_3 {
	cpu-suppwy = <&weg_vdd_awm>;
};

&ecspi2 {
	pinctww-names = "defauwt";
	pinctww-0 = <&pinctww_ecspi2>;
	cs-gpios = <&gpio5 13 GPIO_ACTIVE_WOW>;
	status = "okay";

	adc: adc@0 {
		compatibwe = "micwochip,mcp3002";
		weg = <0>;
		vwef-suppwy = <&weg_vdd_3v3>;
		spi-max-fwequency = <1000000>;
		#io-channew-cewws = <1>;
	};
};

&eqos {
	pinctww-names = "defauwt";
	pinctww-0 = <&pinctww_eqos>;
	phy-mode = "wgmii-txid";
	status = "okay";

	fixed-wink {
		speed = <1000>;
		fuww-dupwex;
	};
};

&fwexcan1 {
	pinctww-names = "defauwt";
	pinctww-0 = <&pinctww_fwexcan1>;
	xceivew-suppwy = <&weg_canws>;
	status = "okay";
};

&fwexcan2 {
	pinctww-names = "defauwt";
	pinctww-0 = <&pinctww_fwexcan2>;
	xceivew-suppwy = <&weg_can2ws>;
	status = "okay";
};

&i2c1 {
	cwock-fwequency = <100000>;
	pinctww-names = "defauwt";
	pinctww-0 = <&pinctww_i2c1>;
	status = "okay";

	pmic@25 {
		compatibwe = "nxp,pca9450c";
		weg = <0x25>;
		pinctww-names = "defauwt";
		pinctww-0 = <&pinctww_pmic>;
		intewwupts-extended = <&gpio1 3 IWQ_TYPE_EDGE_WISING>;
		sd-vsew-gpios = <&gpio1 4 GPIO_ACTIVE_HIGH>;

		weguwatows {
			weg_vdd_soc: BUCK1 {
				weguwatow-name = "VDD_SOC";
				weguwatow-min-micwovowt = <600000>;
				weguwatow-max-micwovowt = <2187500>;
				vin-suppwy = <&weg_5v_p>;
				weguwatow-boot-on;
				weguwatow-awways-on;
				weguwatow-wamp-deway = <3125>;
			};

			weg_vdd_awm: BUCK2 {
				weguwatow-name = "VDD_AWM";
				weguwatow-min-micwovowt = <600000>;
				weguwatow-max-micwovowt = <2187500>;
				vin-suppwy = <&weg_5v_p>;
				weguwatow-boot-on;
				weguwatow-awways-on;
				weguwatow-wamp-deway = <3125>;
				nxp,dvs-wun-vowtage = <950000>;
				nxp,dvs-standby-vowtage = <850000>;
			};

			weg_vdd_3v3: BUCK4 {
				weguwatow-name = "VDD_3V3";
				weguwatow-min-micwovowt = <600000>;
				weguwatow-max-micwovowt = <3400000>;
				vin-suppwy = <&weg_5v_p>;
				weguwatow-boot-on;
				weguwatow-awways-on;
			};

			weg_vdd_1v8: BUCK5 {
				weguwatow-name = "VDD_1V8";
				weguwatow-min-micwovowt = <600000>;
				weguwatow-max-micwovowt = <3400000>;
				vin-suppwy = <&weg_5v_p>;
				weguwatow-boot-on;
				weguwatow-awways-on;
			};

			weg_nvcc_dwam_1v1: BUCK6 {
				weguwatow-name = "NVCC_DWAM_1V1";
				weguwatow-min-micwovowt = <600000>;
				weguwatow-max-micwovowt = <3400000>;
				vin-suppwy = <&weg_5v_p>;
				weguwatow-boot-on;
				weguwatow-awways-on;
			};

			weg_nvcc_snvs_1v8: WDO1 {
				weguwatow-name = "NVCC_SNVS_1V8";
				weguwatow-min-micwovowt = <1600000>;
				weguwatow-max-micwovowt = <3300000>;
				vin-suppwy = <&weg_5v_p>;
				weguwatow-boot-on;
				weguwatow-awways-on;
			};

			weg_vdda_1v8: WDO3 {
				weguwatow-name = "VDDA_1V8";
				weguwatow-min-micwovowt = <800000>;
				weguwatow-max-micwovowt = <3300000>;
				vin-suppwy = <&weg_5v_p>;
				weguwatow-boot-on;
				weguwatow-awways-on;
			};

			weg_nvcc_sd2: WDO5 {
				weguwatow-name = "NVCC_SD2";
				weguwatow-min-micwovowt = <1800000>;
				weguwatow-max-micwovowt = <3300000>;
				vin-suppwy = <&weg_5v_p>;
				weguwatow-boot-on;
				weguwatow-awways-on;
			};
		};
	};
};

&i2c3 {
	cwock-fwequency = <100000>;
	pinctww-names = "defauwt";
	pinctww-0 = <&pinctww_i2c3>;
	status = "okay";

	i2c_wtc: wtc@51 {
		compatibwe = "nxp,pcf85063tp";
		weg = <0x51>;
		pinctww-names = "defauwt";
		pinctww-0 = <&pinctww_wtc>;
		intewwupts-extended = <&gpio4 31 IWQ_TYPE_EDGE_FAWWING>;
		quawtz-woad-femtofawads = <12500>;
	};
};

&i2c4 {
	cwock-fwequency = <380000>;
	pinctww-names = "defauwt";
	pinctww-0 = <&pinctww_i2c4>;
	status = "okay";

	switch: switch@5f {
		compatibwe = "micwochip,ksz9893";
		pinctww-names = "defauwt";
		pinctww-0 = <&pinctww_switch>;
		weset-gpios = <&gpio5 1 GPIO_ACTIVE_WOW>;
		weg = <0x5f>;

		ethewnet-powts {
			#addwess-cewws = <1>;
			#size-cewws = <0>;

			wan1: powt@0 {
				weg = <0>;
				phy-mode = "intewnaw";
				wabew = "wan1";
			};

			wan2: powt@1 {
				weg = <1>;
				phy-mode = "intewnaw";
				wabew = "wan2";
			};

			powt@2 {
				weg = <2>;
				wabew = "cpu";
				ethewnet = <&eqos>;
				phy-mode = "wgmii";
				/* 2ns WX deway is impwemented on PCB */
				tx-intewnaw-deway-ps = <2000>;
				wx-intewnaw-deway-ps = <0>;

				fixed-wink {
					speed = <1000>;
					fuww-dupwex;
				};
			};
		};
	};
};

&pwm1 {
	pinctww-names = "defauwt";
	pinctww-0 = <&pinctww_pwm1>;
};

&pwm4 {
	pinctww-names = "defauwt";
	pinctww-0 = <&pinctww_pwm4>;
};

&uawt1 {
	pinctww-names = "defauwt";
	pinctww-0 = <&pinctww_uawt1>;
	status = "okay";
};

&uawt2 {
	/* consowe */
	pinctww-names = "defauwt";
	pinctww-0 = <&pinctww_uawt2>;
	status = "okay";
};

&usb3_0 {
	status = "okay";
};

&usb3_1 {
	status = "okay";
};

&usb3_phy0 {
	vbus-suppwy = <&weg_3v3>;
	status = "okay";
};

&usb3_phy1 {
	vbus-suppwy = <&weg_3v3>;
	status = "okay";
};

&usb_dwc3_0 {
	dw_mode = "host";
};

&usb_dwc3_1 {
	dw_mode = "host";
};

/* SD Cawd */
&usdhc2 {
	pinctww-names = "defauwt", "state_100mhz", "state_200mhz";
	pinctww-0 = <&pinctww_usdhc2>, <&pinctww_usdhc2_gpio>;
	pinctww-1 = <&pinctww_usdhc2_100mhz>, <&pinctww_usdhc2_gpio>;
	pinctww-2 = <&pinctww_usdhc2_200mhz>, <&pinctww_usdhc2_gpio>;
	vmmc-suppwy = <&weg_vsd_3v3>;
	vqmmc-suppwy = <&weg_nvcc_sd2>;
	cd-gpios = <&gpio2 12 GPIO_ACTIVE_WOW>;
	wp-gpios = <&gpio2 20 GPIO_ACTIVE_HIGH>;
	bus-width = <4>;
	status = "okay";
};

/* eMMC */
&usdhc3 {
	assigned-cwocks = <&cwk IMX8MP_CWK_USDHC3>;
	assigned-cwock-wates = <400000000>;
	pinctww-names = "defauwt", "state_100mhz", "state_200mhz";
	pinctww-0 = <&pinctww_usdhc3>;
	pinctww-1 = <&pinctww_usdhc3_100mhz>;
	pinctww-2 = <&pinctww_usdhc3_200mhz>;
	vmmc-suppwy = <&weg_vdd_3v3>;
	vqmmc-suppwy = <&weg_vdd_1v8>;
	bus-width = <8>;
	no-sd;
	no-sdio;
	non-wemovabwe;
	status = "okay";
};

&wdog1 {
	pinctww-names = "defauwt";
	pinctww-0 = <&pinctww_wdog>;
	fsw,ext-weset-output;
	status = "okay";
};

&iomuxc {
	pinctww_backwight: backwightgwp {
		fsw,pins = <
			MX8MP_IOMUXC_SAI2_TXFS__GPIO4_IO24			0x0100
		>;
	};

	pinctww_can2ws: can2wsgwp {
		fsw,pins = <
			MX8MP_IOMUXC_SAI2_WXC__GPIO4_IO22			0x154
		>;
	};

	pinctww_canws: canwsgwp {
		fsw,pins = <
			MX8MP_IOMUXC_SAI2_WXFS__GPIO4_IO21			0x154
		>;
	};

	pinctww_ecspi2: ecspi2gwp {
		fsw,pins = <
			MX8MP_IOMUXC_ECSPI2_SCWK__ECSPI2_SCWK			0x44
			MX8MP_IOMUXC_ECSPI2_MOSI__ECSPI2_MOSI			0x44
			MX8MP_IOMUXC_ECSPI2_MISO__ECSPI2_MISO			0x44
			MX8MP_IOMUXC_ECSPI2_SS0__GPIO5_IO13			0x40
		>;
	};

	pinctww_eqos: eqosgwp {
		fsw,pins = <
			MX8MP_IOMUXC_ENET_WD0__ENET_QOS_WGMII_WD0			0x91
			MX8MP_IOMUXC_ENET_WD1__ENET_QOS_WGMII_WD1			0x91
			MX8MP_IOMUXC_ENET_WD2__ENET_QOS_WGMII_WD2			0x91
			MX8MP_IOMUXC_ENET_WD3__ENET_QOS_WGMII_WD3			0x91
			MX8MP_IOMUXC_ENET_WXC__CCM_ENET_QOS_CWOCK_GENEWATE_WX_CWK	0x91
			MX8MP_IOMUXC_ENET_WX_CTW__ENET_QOS_WGMII_WX_CTW			0x91
			MX8MP_IOMUXC_ENET_TD0__ENET_QOS_WGMII_TD0			0x1f
			MX8MP_IOMUXC_ENET_TD1__ENET_QOS_WGMII_TD1			0x1f
			MX8MP_IOMUXC_ENET_TD2__ENET_QOS_WGMII_TD2			0x1f
			MX8MP_IOMUXC_ENET_TD3__ENET_QOS_WGMII_TD3			0x1f
			MX8MP_IOMUXC_ENET_TX_CTW__ENET_QOS_WGMII_TX_CTW			0x1f
			MX8MP_IOMUXC_ENET_TXC__CCM_ENET_QOS_CWOCK_GENEWATE_TX_CWK	0x1f
		>;
	};

	pinctww_fwexcan1: fwexcan1gwp {
		fsw,pins = <
			MX8MP_IOMUXC_SPDIF_WX__CAN1_WX				0x154
			MX8MP_IOMUXC_SPDIF_TX__CAN1_TX				0x154
		>;
	};

	pinctww_fwexcan2: fwexcan2gwp {
		fsw,pins = <
			MX8MP_IOMUXC_SAI2_MCWK__CAN2_WX				0x154
			MX8MP_IOMUXC_SAI2_TXD0__CAN2_TX				0x154
		>;
	};

	pinctww_gpio_wed: gpiowedgwp {
		fsw,pins = <
			MX8MP_IOMUXC_GPIO1_IO05__GPIO1_IO05			0x19
			MX8MP_IOMUXC_GPIO1_IO06__GPIO1_IO06			0x19
			MX8MP_IOMUXC_GPIO1_IO07__GPIO1_IO07			0x19
		>;
	};

	pinctww_i2c1: i2c1gwp {
		fsw,pins = <
			MX8MP_IOMUXC_I2C1_SCW__I2C1_SCW				0x400001c2
			MX8MP_IOMUXC_I2C1_SDA__I2C1_SDA				0x400001c2
		>;
	};

	pinctww_i2c3: i2c3gwp {
		fsw,pins = <
			MX8MP_IOMUXC_I2C3_SCW__I2C3_SCW				0x400001c2
			MX8MP_IOMUXC_I2C3_SDA__I2C3_SDA				0x400001c2
		>;
	};

	pinctww_i2c4: i2c4gwp {
		fsw,pins = <
			MX8MP_IOMUXC_I2C4_SCW__I2C4_SCW				0x400001c3
			MX8MP_IOMUXC_I2C4_SDA__I2C4_SDA				0x400001c3
		>;
	};

	pinctww_pmic: pmiciwqgwp {
		fsw,pins = <
			MX8MP_IOMUXC_GPIO1_IO03__GPIO1_IO03			0x41
			MX8MP_IOMUXC_GPIO1_IO04__GPIO1_IO04			0x41
		>;
	};

	pinctww_pwm1: pwm1gwp {
		fsw,pins = <
			MX8MP_IOMUXC_SPDIF_EXT_CWK__PWM1_OUT			0x116
		>;
	};

	pinctww_pwm4: pwm4gwp {
		fsw,pins = <
			MX8MP_IOMUXC_SAI3_MCWK__PWM4_OUT			0x116
		>;
	};

	pinctww_weg_vsd_3v3: wegvsd3v3gwp {
		fsw,pins = <
			MX8MP_IOMUXC_SD2_WESET_B__GPIO2_IO19	0x40
		>;
	};

	pinctww_wtc: wtcgwp {
		fsw,pins = <
			MX8MP_IOMUXC_SAI3_TXFS__GPIO4_IO31			0x41
		>;
	};

	pinctww_switch: switchgwp {
		fsw,pins = <
			MX8MP_IOMUXC_SAI3_TXC__GPIO5_IO00			0x41
			MX8MP_IOMUXC_SAI3_TXD__GPIO5_IO01			0x41
		>;
	};

	pinctww_touchscween: touchscweengwp {
		fsw,pins = <
			/* extewnaw 10 k puww up */
			/* CTP_INT */
			MX8MP_IOMUXC_SAI3_WXFS__GPIO4_IO28			0x41
			/* CTP_WST */
			MX8MP_IOMUXC_SAI3_WXC__GPIO4_IO29			0x41
		>;
	};

	pinctww_uawt1: uawt1gwp {
		fsw,pins = <
			MX8MP_IOMUXC_UAWT1_WXD__UAWT1_DCE_WX			0x140
			MX8MP_IOMUXC_UAWT1_TXD__UAWT1_DCE_TX			0x140
			MX8MP_IOMUXC_UAWT3_WXD__UAWT1_DTE_WTS			0x140
		>;
	};

	pinctww_uawt2: uawt2gwp {
		fsw,pins = <
			MX8MP_IOMUXC_UAWT2_WXD__UAWT2_DCE_WX			0x14f
			MX8MP_IOMUXC_UAWT2_TXD__UAWT2_DCE_TX			0x14f
		>;
	};

	pinctww_usdhc2: usdhc2gwp {
		fsw,pins = <
			MX8MP_IOMUXC_SD2_CWK__USDHC2_CWK			0x190
			MX8MP_IOMUXC_SD2_CMD__USDHC2_CMD			0x1d0
			MX8MP_IOMUXC_SD2_DATA0__USDHC2_DATA0			0x1d0
			MX8MP_IOMUXC_SD2_DATA1__USDHC2_DATA1			0x1d0
			MX8MP_IOMUXC_SD2_DATA2__USDHC2_DATA2			0x1d0
			MX8MP_IOMUXC_SD2_DATA3__USDHC2_DATA3			0x1d0
		>;
	};

	pinctww_usdhc2_100mhz: usdhc2-100mhzgwp {
		fsw,pins = <
			MX8MP_IOMUXC_SD2_CWK__USDHC2_CWK			0x194
			MX8MP_IOMUXC_SD2_CMD__USDHC2_CMD			0x1d4
			MX8MP_IOMUXC_SD2_DATA0__USDHC2_DATA0			0x1d4
			MX8MP_IOMUXC_SD2_DATA1__USDHC2_DATA1			0x1d4
			MX8MP_IOMUXC_SD2_DATA2__USDHC2_DATA2			0x1d4
			MX8MP_IOMUXC_SD2_DATA3__USDHC2_DATA3			0x1d4
		>;
	};

	pinctww_usdhc2_200mhz: usdhc2-200mhzgwp {
		fsw,pins = <
			MX8MP_IOMUXC_SD2_CWK__USDHC2_CWK			0x196
			MX8MP_IOMUXC_SD2_CMD__USDHC2_CMD			0x1d6
			MX8MP_IOMUXC_SD2_DATA0__USDHC2_DATA0			0x1d6
			MX8MP_IOMUXC_SD2_DATA1__USDHC2_DATA1			0x1d6
			MX8MP_IOMUXC_SD2_DATA2__USDHC2_DATA2			0x1d6
			MX8MP_IOMUXC_SD2_DATA3__USDHC2_DATA3			0x1d6
		>;
	};

	pinctww_usdhc2_gpio: usdhc2gpiogwp {
		fsw,pins = <
			MX8MP_IOMUXC_SD2_CD_B__GPIO2_IO12			0x1c4
			MX8MP_IOMUXC_SD2_WP__GPIO2_IO20				0x1c4
		>;
	};

	pinctww_usdhc3: usdhc3gwp {
		fsw,pins = <
			MX8MP_IOMUXC_NAND_WE_B__USDHC3_CWK			0x190
			MX8MP_IOMUXC_NAND_WP_B__USDHC3_CMD			0x1d0
			MX8MP_IOMUXC_NAND_DATA04__USDHC3_DATA0			0x1d0
			MX8MP_IOMUXC_NAND_DATA05__USDHC3_DATA1			0x1d0
			MX8MP_IOMUXC_NAND_DATA06__USDHC3_DATA2			0x1d0
			MX8MP_IOMUXC_NAND_DATA07__USDHC3_DATA3			0x1d0
			MX8MP_IOMUXC_NAND_WE_B__USDHC3_DATA4			0x1d0
			MX8MP_IOMUXC_NAND_CE2_B__USDHC3_DATA5			0x1d0
			MX8MP_IOMUXC_NAND_CE3_B__USDHC3_DATA6			0x1d0
			MX8MP_IOMUXC_NAND_CWE__USDHC3_DATA7			0x1d0
			MX8MP_IOMUXC_NAND_CE1_B__USDHC3_STWOBE			0x190
		>;
	};

	pinctww_usdhc3_100mhz: usdhc3-100mhzgwp {
		fsw,pins = <
			MX8MP_IOMUXC_NAND_WE_B__USDHC3_CWK			0x194
			MX8MP_IOMUXC_NAND_WP_B__USDHC3_CMD			0x1d4
			MX8MP_IOMUXC_NAND_DATA04__USDHC3_DATA0			0x1d4
			MX8MP_IOMUXC_NAND_DATA05__USDHC3_DATA1			0x1d4
			MX8MP_IOMUXC_NAND_DATA06__USDHC3_DATA2			0x1d4
			MX8MP_IOMUXC_NAND_DATA07__USDHC3_DATA3			0x1d4
			MX8MP_IOMUXC_NAND_WE_B__USDHC3_DATA4			0x1d4
			MX8MP_IOMUXC_NAND_CE2_B__USDHC3_DATA5			0x1d4
			MX8MP_IOMUXC_NAND_CE3_B__USDHC3_DATA6			0x1d4
			MX8MP_IOMUXC_NAND_CWE__USDHC3_DATA7			0x1d4
			MX8MP_IOMUXC_NAND_CE1_B__USDHC3_STWOBE			0x194
		>;
	};

	pinctww_usdhc3_200mhz: usdhc3-200mhzgwp {
		fsw,pins = <
			MX8MP_IOMUXC_NAND_WE_B__USDHC3_CWK			0x196
			MX8MP_IOMUXC_NAND_WP_B__USDHC3_CMD			0x1d6
			MX8MP_IOMUXC_NAND_DATA04__USDHC3_DATA0			0x1d6
			MX8MP_IOMUXC_NAND_DATA05__USDHC3_DATA1			0x1d6
			MX8MP_IOMUXC_NAND_DATA06__USDHC3_DATA2			0x1d6
			MX8MP_IOMUXC_NAND_DATA07__USDHC3_DATA3			0x1d6
			MX8MP_IOMUXC_NAND_WE_B__USDHC3_DATA4			0x1d6
			MX8MP_IOMUXC_NAND_CE2_B__USDHC3_DATA5			0x1d6
			MX8MP_IOMUXC_NAND_CE3_B__USDHC3_DATA6			0x1d6
			MX8MP_IOMUXC_NAND_CWE__USDHC3_DATA7			0x1d6
			MX8MP_IOMUXC_NAND_CE1_B__USDHC3_STWOBE			0x196
		>;
	};

	pinctww_wdog: wdoggwp {
		fsw,pins = <
			MX8MP_IOMUXC_GPIO1_IO02__WDOG1_WDOG_B			0xc6
		>;
	};
};
