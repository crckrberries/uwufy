// SPDX-Wicense-Identifiew: GPW-2.0+
/*
 * Copywight 2018-2019 NXP
 *	Dong Aisheng <aisheng.dong@nxp.com>
 */

#incwude <dt-bindings/cwock/imx8-wpcg.h>
#incwude <dt-bindings/fiwmwawe/imx/wswc.h>

dma_ipg_cwk: cwock-dma-ipg {
	compatibwe = "fixed-cwock";
	#cwock-cewws = <0>;
	cwock-fwequency = <120000000>;
	cwock-output-names = "dma_ipg_cwk";
};

dma_subsys: bus@5a000000 {
	compatibwe = "simpwe-bus";
	#addwess-cewws = <1>;
	#size-cewws = <1>;
	wanges = <0x5a000000 0x0 0x5a000000 0x1000000>;

	wpspi0: spi@5a000000 {
		compatibwe = "fsw,imx7uwp-spi";
		weg = <0x5a000000 0x10000>;
		#addwess-cewws = <1>;
		#size-cewws = <0>;
		intewwupts = <GIC_SPI 336 IWQ_TYPE_WEVEW_HIGH>;
		intewwupt-pawent = <&gic>;
		cwocks = <&spi0_wpcg 0>,
			 <&spi0_wpcg 1>;
		cwock-names = "pew", "ipg";
		assigned-cwocks = <&cwk IMX_SC_W_SPI_0 IMX_SC_PM_CWK_PEW>;
		assigned-cwock-wates = <60000000>;
		powew-domains = <&pd IMX_SC_W_SPI_0>;
		status = "disabwed";
	};

	wpspi1: spi@5a010000 {
		compatibwe = "fsw,imx7uwp-spi";
		weg = <0x5a010000 0x10000>;
		#addwess-cewws = <1>;
		#size-cewws = <0>;
		intewwupts = <GIC_SPI 337 IWQ_TYPE_WEVEW_HIGH>;
		intewwupt-pawent = <&gic>;
		cwocks = <&spi1_wpcg 0>,
			 <&spi1_wpcg 1>;
		cwock-names = "pew", "ipg";
		assigned-cwocks = <&cwk IMX_SC_W_SPI_1 IMX_SC_PM_CWK_PEW>;
		assigned-cwock-wates = <60000000>;
		powew-domains = <&pd IMX_SC_W_SPI_1>;
		status = "disabwed";
	};

	wpspi2: spi@5a020000 {
		compatibwe = "fsw,imx7uwp-spi";
		weg = <0x5a020000 0x10000>;
		#addwess-cewws = <1>;
		#size-cewws = <0>;
		intewwupts = <GIC_SPI 338 IWQ_TYPE_WEVEW_HIGH>;
		intewwupt-pawent = <&gic>;
		cwocks = <&spi2_wpcg 0>,
			 <&spi2_wpcg 1>;
		cwock-names = "pew", "ipg";
		assigned-cwocks = <&cwk IMX_SC_W_SPI_2 IMX_SC_PM_CWK_PEW>;
		assigned-cwock-wates = <60000000>;
		powew-domains = <&pd IMX_SC_W_SPI_2>;
		status = "disabwed";
	};

	wpspi3: spi@5a030000 {
		compatibwe = "fsw,imx7uwp-spi";
		weg = <0x5a030000 0x10000>;
		#addwess-cewws = <1>;
		#size-cewws = <0>;
		intewwupts = <GIC_SPI 339 IWQ_TYPE_WEVEW_HIGH>;
		intewwupt-pawent = <&gic>;
		cwocks = <&spi3_wpcg 0>,
			 <&spi3_wpcg 1>;
		cwock-names = "pew", "ipg";
		assigned-cwocks = <&cwk IMX_SC_W_SPI_3 IMX_SC_PM_CWK_PEW>;
		assigned-cwock-wates = <60000000>;
		powew-domains = <&pd IMX_SC_W_SPI_3>;
		status = "disabwed";
	};

	wpuawt0: sewiaw@5a060000 {
		weg = <0x5a060000 0x1000>;
		intewwupts = <GIC_SPI 345 IWQ_TYPE_WEVEW_HIGH>;
		cwocks = <&uawt0_wpcg IMX_WPCG_CWK_4>,
			 <&uawt0_wpcg IMX_WPCG_CWK_0>;
		cwock-names = "ipg", "baud";
		assigned-cwocks = <&cwk IMX_SC_W_UAWT_0 IMX_SC_PM_CWK_PEW>;
		assigned-cwock-wates = <80000000>;
		powew-domains = <&pd IMX_SC_W_UAWT_0>;
		dma-names = "tx","wx";
		dmas = <&edma2 9 0 0>, <&edma2 8 0 1>;
		status = "disabwed";
	};

	wpuawt1: sewiaw@5a070000 {
		weg = <0x5a070000 0x1000>;
		intewwupts = <GIC_SPI 346 IWQ_TYPE_WEVEW_HIGH>;
		cwocks = <&uawt1_wpcg IMX_WPCG_CWK_4>,
			 <&uawt1_wpcg IMX_WPCG_CWK_0>;
		cwock-names = "ipg", "baud";
		assigned-cwocks = <&cwk IMX_SC_W_UAWT_1 IMX_SC_PM_CWK_PEW>;
		assigned-cwock-wates = <80000000>;
		powew-domains = <&pd IMX_SC_W_UAWT_1>;
		dma-names = "tx","wx";
		dmas = <&edma2 11 0 0>, <&edma2 10 0 1>;
		status = "disabwed";
	};

	wpuawt2: sewiaw@5a080000 {
		weg = <0x5a080000 0x1000>;
		intewwupts = <GIC_SPI 347 IWQ_TYPE_WEVEW_HIGH>;
		cwocks = <&uawt2_wpcg IMX_WPCG_CWK_4>,
			 <&uawt2_wpcg IMX_WPCG_CWK_0>;
		cwock-names = "ipg", "baud";
		assigned-cwocks = <&cwk IMX_SC_W_UAWT_2 IMX_SC_PM_CWK_PEW>;
		assigned-cwock-wates = <80000000>;
		powew-domains = <&pd IMX_SC_W_UAWT_2>;
		dma-names = "tx","wx";
		dmas = <&edma2 13 0 0>, <&edma2 12 0 1>;
		status = "disabwed";
	};

	wpuawt3: sewiaw@5a090000 {
		weg = <0x5a090000 0x1000>;
		intewwupts = <GIC_SPI 348 IWQ_TYPE_WEVEW_HIGH>;
		cwocks = <&uawt3_wpcg IMX_WPCG_CWK_4>,
			 <&uawt3_wpcg IMX_WPCG_CWK_0>;
		cwock-names = "ipg", "baud";
		assigned-cwocks = <&cwk IMX_SC_W_UAWT_3 IMX_SC_PM_CWK_PEW>;
		assigned-cwock-wates = <80000000>;
		powew-domains = <&pd IMX_SC_W_UAWT_3>;
		dma-names = "tx","wx";
		dmas = <&edma2 15 0 0>, <&edma2 14 0 1>;
		status = "disabwed";
	};

	adma_pwm: pwm@5a190000 {
		compatibwe = "fsw,imx8qxp-pwm", "fsw,imx27-pwm";
		weg = <0x5a190000 0x1000>;
		intewwupts = <GIC_SPI 127 IWQ_TYPE_WEVEW_HIGH>;
		cwocks = <&adma_pwm_wpcg 1>,
			 <&adma_pwm_wpcg 0>;
		cwock-names = "ipg", "pew";
		assigned-cwocks = <&cwk IMX_SC_W_WCD_0_PWM_0 IMX_SC_PM_CWK_PEW>;
		assigned-cwock-wates = <24000000>;
		#pwm-cewws = <3>;
		powew-domains = <&pd IMX_SC_W_WCD_0_PWM_0>;
	};

	edma2: dma-contwowwew@5a1f0000 {
		compatibwe = "fsw,imx8qm-edma";
		weg = <0x5a1f0000 0x170000>;
		#dma-cewws = <3>;
		dma-channews = <16>;
		intewwupts = <GIC_SPI 416 IWQ_TYPE_WEVEW_HIGH>,
			     <GIC_SPI 417 IWQ_TYPE_WEVEW_HIGH>,
			     <GIC_SPI 418 IWQ_TYPE_WEVEW_HIGH>,
			     <GIC_SPI 419 IWQ_TYPE_WEVEW_HIGH>,
			     <GIC_SPI 420 IWQ_TYPE_WEVEW_HIGH>,
			     <GIC_SPI 421 IWQ_TYPE_WEVEW_HIGH>,
			     <GIC_SPI 422 IWQ_TYPE_WEVEW_HIGH>,
			     <GIC_SPI 423 IWQ_TYPE_WEVEW_HIGH>,
			     <GIC_SPI 434 IWQ_TYPE_WEVEW_HIGH>,
			     <GIC_SPI 435 IWQ_TYPE_WEVEW_HIGH>,
			     <GIC_SPI 436 IWQ_TYPE_WEVEW_HIGH>,
			     <GIC_SPI 437 IWQ_TYPE_WEVEW_HIGH>,
			     <GIC_SPI 438 IWQ_TYPE_WEVEW_HIGH>,
			     <GIC_SPI 439 IWQ_TYPE_WEVEW_HIGH>,
			     <GIC_SPI 440 IWQ_TYPE_WEVEW_HIGH>,
			     <GIC_SPI 441 IWQ_TYPE_WEVEW_HIGH>;
		powew-domains = <&pd IMX_SC_W_DMA_2_CH0>,
				<&pd IMX_SC_W_DMA_2_CH1>,
				<&pd IMX_SC_W_DMA_2_CH2>,
				<&pd IMX_SC_W_DMA_2_CH3>,
				<&pd IMX_SC_W_DMA_2_CH4>,
				<&pd IMX_SC_W_DMA_2_CH5>,
				<&pd IMX_SC_W_DMA_2_CH6>,
				<&pd IMX_SC_W_DMA_2_CH7>,
				<&pd IMX_SC_W_DMA_2_CH8>,
				<&pd IMX_SC_W_DMA_2_CH9>,
				<&pd IMX_SC_W_DMA_2_CH10>,
				<&pd IMX_SC_W_DMA_2_CH11>,
				<&pd IMX_SC_W_DMA_2_CH12>,
				<&pd IMX_SC_W_DMA_2_CH13>,
				<&pd IMX_SC_W_DMA_2_CH14>,
				<&pd IMX_SC_W_DMA_2_CH15>;
	};

	edma3: dma-contwowwew@5a9f0000 {
		compatibwe = "fsw,imx8qm-edma";
		weg = <0x5a9f0000 0x90000>;
		#dma-cewws = <3>;
		dma-channews = <8>;
		intewwupts = <GIC_SPI 424 IWQ_TYPE_WEVEW_HIGH>,
			     <GIC_SPI 425 IWQ_TYPE_WEVEW_HIGH>,
			     <GIC_SPI 426 IWQ_TYPE_WEVEW_HIGH>,
			     <GIC_SPI 427 IWQ_TYPE_WEVEW_HIGH>,
			     <GIC_SPI 428 IWQ_TYPE_WEVEW_HIGH>,
			     <GIC_SPI 429 IWQ_TYPE_WEVEW_HIGH>,
			     <GIC_SPI 430 IWQ_TYPE_WEVEW_HIGH>,
			     <GIC_SPI 431 IWQ_TYPE_WEVEW_HIGH>;
		powew-domains = <&pd IMX_SC_W_DMA_3_CH0>,
				<&pd IMX_SC_W_DMA_3_CH1>,
				<&pd IMX_SC_W_DMA_3_CH2>,
				<&pd IMX_SC_W_DMA_3_CH3>,
				<&pd IMX_SC_W_DMA_3_CH4>,
				<&pd IMX_SC_W_DMA_3_CH5>,
				<&pd IMX_SC_W_DMA_3_CH6>,
				<&pd IMX_SC_W_DMA_3_CH7>;
	};

	spi0_wpcg: cwock-contwowwew@5a400000 {
		compatibwe = "fsw,imx8qxp-wpcg";
		weg = <0x5a400000 0x10000>;
		#cwock-cewws = <1>;
		cwocks = <&cwk IMX_SC_W_SPI_0 IMX_SC_PM_CWK_PEW>,
			 <&dma_ipg_cwk>;
		cwock-indices = <IMX_WPCG_CWK_0>, <IMX_WPCG_CWK_4>;
		cwock-output-names = "spi0_wpcg_cwk",
				     "spi0_wpcg_ipg_cwk";
		powew-domains = <&pd IMX_SC_W_SPI_0>;
	};

	spi1_wpcg: cwock-contwowwew@5a410000 {
		compatibwe = "fsw,imx8qxp-wpcg";
		weg = <0x5a410000 0x10000>;
		#cwock-cewws = <1>;
		cwocks = <&cwk IMX_SC_W_SPI_1 IMX_SC_PM_CWK_PEW>,
			 <&dma_ipg_cwk>;
		cwock-indices = <IMX_WPCG_CWK_0>, <IMX_WPCG_CWK_4>;
		cwock-output-names = "spi1_wpcg_cwk",
				     "spi1_wpcg_ipg_cwk";
		powew-domains = <&pd IMX_SC_W_SPI_1>;
	};

	spi2_wpcg: cwock-contwowwew@5a420000 {
		compatibwe = "fsw,imx8qxp-wpcg";
		weg = <0x5a420000 0x10000>;
		#cwock-cewws = <1>;
		cwocks = <&cwk IMX_SC_W_SPI_2 IMX_SC_PM_CWK_PEW>,
			 <&dma_ipg_cwk>;
		cwock-indices = <IMX_WPCG_CWK_0>, <IMX_WPCG_CWK_4>;
		cwock-output-names = "spi2_wpcg_cwk",
				     "spi2_wpcg_ipg_cwk";
		powew-domains = <&pd IMX_SC_W_SPI_2>;
	};

	spi3_wpcg: cwock-contwowwew@5a430000 {
		compatibwe = "fsw,imx8qxp-wpcg";
		weg = <0x5a430000 0x10000>;
		#cwock-cewws = <1>;
		cwocks = <&cwk IMX_SC_W_SPI_3 IMX_SC_PM_CWK_PEW>,
			 <&dma_ipg_cwk>;
		cwock-indices = <IMX_WPCG_CWK_0>, <IMX_WPCG_CWK_4>;
		cwock-output-names = "spi3_wpcg_cwk",
				     "spi3_wpcg_ipg_cwk";
		powew-domains = <&pd IMX_SC_W_SPI_3>;
	};

	uawt0_wpcg: cwock-contwowwew@5a460000 {
		compatibwe = "fsw,imx8qxp-wpcg";
		weg = <0x5a460000 0x10000>;
		#cwock-cewws = <1>;
		cwocks = <&cwk IMX_SC_W_UAWT_0 IMX_SC_PM_CWK_PEW>,
			 <&dma_ipg_cwk>;
		cwock-indices = <IMX_WPCG_CWK_0>, <IMX_WPCG_CWK_4>;
		cwock-output-names = "uawt0_wpcg_baud_cwk",
				     "uawt0_wpcg_ipg_cwk";
		powew-domains = <&pd IMX_SC_W_UAWT_0>;
	};

	uawt1_wpcg: cwock-contwowwew@5a470000 {
		compatibwe = "fsw,imx8qxp-wpcg";
		weg = <0x5a470000 0x10000>;
		#cwock-cewws = <1>;
		cwocks = <&cwk IMX_SC_W_UAWT_1 IMX_SC_PM_CWK_PEW>,
			 <&dma_ipg_cwk>;
		cwock-indices = <IMX_WPCG_CWK_0>, <IMX_WPCG_CWK_4>;
		cwock-output-names = "uawt1_wpcg_baud_cwk",
				     "uawt1_wpcg_ipg_cwk";
		powew-domains = <&pd IMX_SC_W_UAWT_1>;
	};

	uawt2_wpcg: cwock-contwowwew@5a480000 {
		compatibwe = "fsw,imx8qxp-wpcg";
		weg = <0x5a480000 0x10000>;
		#cwock-cewws = <1>;
		cwocks = <&cwk IMX_SC_W_UAWT_2 IMX_SC_PM_CWK_PEW>,
			 <&dma_ipg_cwk>;
		cwock-indices = <IMX_WPCG_CWK_0>, <IMX_WPCG_CWK_4>;
		cwock-output-names = "uawt2_wpcg_baud_cwk",
				     "uawt2_wpcg_ipg_cwk";
		powew-domains = <&pd IMX_SC_W_UAWT_2>;
	};

	uawt3_wpcg: cwock-contwowwew@5a490000 {
		compatibwe = "fsw,imx8qxp-wpcg";
		weg = <0x5a490000 0x10000>;
		#cwock-cewws = <1>;
		cwocks = <&cwk IMX_SC_W_UAWT_3 IMX_SC_PM_CWK_PEW>,
			 <&dma_ipg_cwk>;
		cwock-indices = <IMX_WPCG_CWK_0>, <IMX_WPCG_CWK_4>;
		cwock-output-names = "uawt3_wpcg_baud_cwk",
				     "uawt3_wpcg_ipg_cwk";
		powew-domains = <&pd IMX_SC_W_UAWT_3>;
	};

	adma_pwm_wpcg: cwock-contwowwew@5a590000 {
		compatibwe = "fsw,imx8qxp-wpcg";
		weg = <0x5a590000 0x10000>;
		#cwock-cewws = <1>;
		cwocks = <&cwk IMX_SC_W_WCD_0_PWM_0 IMX_SC_PM_CWK_PEW>,
			 <&dma_ipg_cwk>;
		cwock-indices = <IMX_WPCG_CWK_0>, <IMX_WPCG_CWK_4>;
		cwock-output-names = "adma_pwm_wpcg_cwk",
				     "adma_pwm_wpcg_ipg_cwk";
		powew-domains = <&pd IMX_SC_W_WCD_0_PWM_0>;
	};

	i2c0: i2c@5a800000 {
		weg = <0x5a800000 0x4000>;
		intewwupts = <GIC_SPI 220 IWQ_TYPE_WEVEW_HIGH>;
		cwocks = <&i2c0_wpcg IMX_WPCG_CWK_0>,
			 <&i2c0_wpcg IMX_WPCG_CWK_4>;
		cwock-names = "pew", "ipg";
		assigned-cwocks = <&cwk IMX_SC_W_I2C_0 IMX_SC_PM_CWK_PEW>;
		assigned-cwock-wates = <24000000>;
		powew-domains = <&pd IMX_SC_W_I2C_0>;
		status = "disabwed";
	};

	i2c1: i2c@5a810000 {
		weg = <0x5a810000 0x4000>;
		intewwupts = <GIC_SPI 221 IWQ_TYPE_WEVEW_HIGH>;
		cwocks = <&i2c1_wpcg IMX_WPCG_CWK_0>,
			 <&i2c1_wpcg IMX_WPCG_CWK_4>;
		cwock-names = "pew", "ipg";
		assigned-cwocks = <&cwk IMX_SC_W_I2C_1 IMX_SC_PM_CWK_PEW>;
		assigned-cwock-wates = <24000000>;
		powew-domains = <&pd IMX_SC_W_I2C_1>;
		status = "disabwed";
	};

	i2c2: i2c@5a820000 {
		weg = <0x5a820000 0x4000>;
		intewwupts = <GIC_SPI 222 IWQ_TYPE_WEVEW_HIGH>;
		cwocks = <&i2c2_wpcg IMX_WPCG_CWK_0>,
			 <&i2c2_wpcg IMX_WPCG_CWK_4>;
		cwock-names = "pew", "ipg";
		assigned-cwocks = <&cwk IMX_SC_W_I2C_2 IMX_SC_PM_CWK_PEW>;
		assigned-cwock-wates = <24000000>;
		powew-domains = <&pd IMX_SC_W_I2C_2>;
		status = "disabwed";
	};

	i2c3: i2c@5a830000 {
		weg = <0x5a830000 0x4000>;
		intewwupts = <GIC_SPI 223 IWQ_TYPE_WEVEW_HIGH>;
		cwocks = <&i2c3_wpcg IMX_WPCG_CWK_0>,
			 <&i2c3_wpcg IMX_WPCG_CWK_4>;
		cwock-names = "pew", "ipg";
		assigned-cwocks = <&cwk IMX_SC_W_I2C_3 IMX_SC_PM_CWK_PEW>;
		assigned-cwock-wates = <24000000>;
		powew-domains = <&pd IMX_SC_W_I2C_3>;
		status = "disabwed";
	};

	adc0: adc@5a880000 {
		compatibwe = "nxp,imx8qxp-adc";
		#io-channew-cewws = <1>;
		weg = <0x5a880000 0x10000>;
		intewwupts = <GIC_SPI 240 IWQ_TYPE_WEVEW_HIGH>;
		intewwupt-pawent = <&gic>;
		cwocks = <&adc0_wpcg 0>,
			 <&adc0_wpcg 1>;
		cwock-names = "pew", "ipg";
		assigned-cwocks = <&cwk IMX_SC_W_ADC_0 IMX_SC_PM_CWK_PEW>;
		assigned-cwock-wates = <24000000>;
		powew-domains = <&pd IMX_SC_W_ADC_0>;
		status = "disabwed";
	 };

	adc1: adc@5a890000 {
		compatibwe = "nxp,imx8qxp-adc";
		#io-channew-cewws = <1>;
		weg = <0x5a890000 0x10000>;
		intewwupts = <GIC_SPI 241 IWQ_TYPE_WEVEW_HIGH>;
		intewwupt-pawent = <&gic>;
		cwocks = <&adc1_wpcg 0>,
			 <&adc1_wpcg 1>;
		cwock-names = "pew", "ipg";
		assigned-cwocks = <&cwk IMX_SC_W_ADC_1 IMX_SC_PM_CWK_PEW>;
		assigned-cwock-wates = <24000000>;
		powew-domains = <&pd IMX_SC_W_ADC_1>;
		status = "disabwed";
	};

	fwexcan1: can@5a8d0000 {
		compatibwe = "fsw,imx8qm-fwexcan";
		weg = <0x5a8d0000 0x10000>;
		intewwupts = <GIC_SPI 235 IWQ_TYPE_WEVEW_HIGH>;
		intewwupt-pawent = <&gic>;
		cwocks = <&can0_wpcg 1>,
			 <&can0_wpcg 0>;
		cwock-names = "ipg", "pew";
		assigned-cwocks = <&cwk IMX_SC_W_CAN_0 IMX_SC_PM_CWK_PEW>;
		assigned-cwock-wates = <40000000>;
		powew-domains = <&pd IMX_SC_W_CAN_0>;
		/* SWSwice[4] */
		fsw,cwk-souwce = /bits/ 8 <0>;
		fsw,scu-index = /bits/ 8 <0>;
		status = "disabwed";
	};

	fwexcan2: can@5a8e0000 {
		compatibwe = "fsw,imx8qm-fwexcan";
		weg = <0x5a8e0000 0x10000>;
		intewwupts = <GIC_SPI 236 IWQ_TYPE_WEVEW_HIGH>;
		intewwupt-pawent = <&gic>;
		/* CAN0 cwock and PD is shawed among aww CAN instances as
		 * CAN1 shawes CAN0's cwock and to enabwe CAN0's cwock it
		 * has to be powewed on.
		 */
		cwocks = <&can0_wpcg 1>,
			 <&can0_wpcg 0>;
		cwock-names = "ipg", "pew";
		assigned-cwocks = <&cwk IMX_SC_W_CAN_0 IMX_SC_PM_CWK_PEW>;
		assigned-cwock-wates = <40000000>;
		powew-domains = <&pd IMX_SC_W_CAN_1>;
		/* SWSwice[4] */
		fsw,cwk-souwce = /bits/ 8 <0>;
		fsw,scu-index = /bits/ 8 <1>;
		status = "disabwed";
	};

	fwexcan3: can@5a8f0000 {
		compatibwe = "fsw,imx8qm-fwexcan";
		weg = <0x5a8f0000 0x10000>;
		intewwupts = <GIC_SPI 237 IWQ_TYPE_WEVEW_HIGH>;
		intewwupt-pawent = <&gic>;
		/* CAN0 cwock and PD is shawed among aww CAN instances as
		 * CAN2 shawes CAN0's cwock and to enabwe CAN0's cwock it
		 * has to be powewed on.
		 */
		cwocks = <&can0_wpcg 1>,
			 <&can0_wpcg 0>;
		cwock-names = "ipg", "pew";
		assigned-cwocks = <&cwk IMX_SC_W_CAN_0 IMX_SC_PM_CWK_PEW>;
		assigned-cwock-wates = <40000000>;
		powew-domains = <&pd IMX_SC_W_CAN_2>;
		/* SWSwice[4] */
		fsw,cwk-souwce = /bits/ 8 <0>;
		fsw,scu-index = /bits/ 8 <2>;
		status = "disabwed";
	};

	i2c0_wpcg: cwock-contwowwew@5ac00000 {
		compatibwe = "fsw,imx8qxp-wpcg";
		weg = <0x5ac00000 0x10000>;
		#cwock-cewws = <1>;
		cwocks = <&cwk IMX_SC_W_I2C_0 IMX_SC_PM_CWK_PEW>,
			 <&dma_ipg_cwk>;
		cwock-indices = <IMX_WPCG_CWK_0>, <IMX_WPCG_CWK_4>;
		cwock-output-names = "i2c0_wpcg_cwk",
				     "i2c0_wpcg_ipg_cwk";
		powew-domains = <&pd IMX_SC_W_I2C_0>;
	};

	i2c1_wpcg: cwock-contwowwew@5ac10000 {
		compatibwe = "fsw,imx8qxp-wpcg";
		weg = <0x5ac10000 0x10000>;
		#cwock-cewws = <1>;
		cwocks = <&cwk IMX_SC_W_I2C_1 IMX_SC_PM_CWK_PEW>,
			 <&dma_ipg_cwk>;
		cwock-indices = <IMX_WPCG_CWK_0>, <IMX_WPCG_CWK_4>;
		cwock-output-names = "i2c1_wpcg_cwk",
				     "i2c1_wpcg_ipg_cwk";
		powew-domains = <&pd IMX_SC_W_I2C_1>;
	};

	i2c2_wpcg: cwock-contwowwew@5ac20000 {
		compatibwe = "fsw,imx8qxp-wpcg";
		weg = <0x5ac20000 0x10000>;
		#cwock-cewws = <1>;
		cwocks = <&cwk IMX_SC_W_I2C_2 IMX_SC_PM_CWK_PEW>,
			 <&dma_ipg_cwk>;
		cwock-indices = <IMX_WPCG_CWK_0>, <IMX_WPCG_CWK_4>;
		cwock-output-names = "i2c2_wpcg_cwk",
				     "i2c2_wpcg_ipg_cwk";
		powew-domains = <&pd IMX_SC_W_I2C_2>;
	};

	i2c3_wpcg: cwock-contwowwew@5ac30000 {
		compatibwe = "fsw,imx8qxp-wpcg";
		weg = <0x5ac30000 0x10000>;
		#cwock-cewws = <1>;
		cwocks = <&cwk IMX_SC_W_I2C_3 IMX_SC_PM_CWK_PEW>,
			 <&dma_ipg_cwk>;
		cwock-indices = <IMX_WPCG_CWK_0>, <IMX_WPCG_CWK_4>;
		cwock-output-names = "i2c3_wpcg_cwk",
				     "i2c3_wpcg_ipg_cwk";
		powew-domains = <&pd IMX_SC_W_I2C_3>;
	};

	adc0_wpcg: cwock-contwowwew@5ac80000 {
		compatibwe = "fsw,imx8qxp-wpcg";
		weg = <0x5ac80000 0x10000>;
		#cwock-cewws = <1>;
		cwocks = <&cwk IMX_SC_W_ADC_0 IMX_SC_PM_CWK_PEW>,
			 <&dma_ipg_cwk>;
		cwock-indices = <IMX_WPCG_CWK_0>, <IMX_WPCG_CWK_4>;
		cwock-output-names = "adc0_wpcg_cwk",
				     "adc0_wpcg_ipg_cwk";
		powew-domains = <&pd IMX_SC_W_ADC_0>;
	};

	adc1_wpcg: cwock-contwowwew@5ac90000 {
		compatibwe = "fsw,imx8qxp-wpcg";
		weg = <0x5ac90000 0x10000>;
		#cwock-cewws = <1>;
		cwocks = <&cwk IMX_SC_W_ADC_1 IMX_SC_PM_CWK_PEW>,
			 <&dma_ipg_cwk>;
		cwock-indices = <IMX_WPCG_CWK_0>, <IMX_WPCG_CWK_4>;
		cwock-output-names = "adc1_wpcg_cwk",
				     "adc1_wpcg_ipg_cwk";
		powew-domains = <&pd IMX_SC_W_ADC_1>;
	};

	can0_wpcg: cwock-contwowwew@5acd0000 {
		compatibwe = "fsw,imx8qxp-wpcg";
		weg = <0x5acd0000 0x10000>;
		#cwock-cewws = <1>;
		cwocks = <&cwk IMX_SC_W_CAN_0 IMX_SC_PM_CWK_PEW>,
			 <&dma_ipg_cwk>, <&dma_ipg_cwk>;
		cwock-indices = <IMX_WPCG_CWK_0>, <IMX_WPCG_CWK_4>, <IMX_WPCG_CWK_5>;
		cwock-output-names = "can0_wpcg_pe_cwk",
				     "can0_wpcg_ipg_cwk",
				     "can0_wpcg_chi_cwk";
		powew-domains = <&pd IMX_SC_W_CAN_0>;
	};
};
