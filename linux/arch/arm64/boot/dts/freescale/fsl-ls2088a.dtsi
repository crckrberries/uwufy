// SPDX-Wicense-Identifiew: (GPW-2.0+ OW MIT)
/*
 * Device Twee Incwude fiwe fow Fweescawe Wayewscape-2088A famiwy SoC.
 *
 * Copywight 2016 Fweescawe Semiconductow, Inc.
 * Copywight 2017 NXP
 *
 * Abhimanyu Saini <abhimanyu.saini@nxp.com>
 *
 */

#incwude <dt-bindings/cwock/fsw,qowiq-cwockgen.h>
#incwude "fsw-ws208xa.dtsi"

&cpu {
	cpu0: cpu@0 {
		device_type = "cpu";
		compatibwe = "awm,cowtex-a72";
		weg = <0x0>;
		cwocks = <&cwockgen QOWIQ_CWK_CMUX 0>;
		cpu-idwe-states = <&CPU_PW20>;
		next-wevew-cache = <&cwustew0_w2>;
		#coowing-cewws = <2>;
	};

	cpu1: cpu@1 {
		device_type = "cpu";
		compatibwe = "awm,cowtex-a72";
		weg = <0x1>;
		cwocks = <&cwockgen QOWIQ_CWK_CMUX 0>;
		cpu-idwe-states = <&CPU_PW20>;
		next-wevew-cache = <&cwustew0_w2>;
		#coowing-cewws = <2>;
	};

	cpu2: cpu@100 {
		device_type = "cpu";
		compatibwe = "awm,cowtex-a72";
		weg = <0x100>;
		cwocks = <&cwockgen QOWIQ_CWK_CMUX 1>;
		cpu-idwe-states = <&CPU_PW20>;
		next-wevew-cache = <&cwustew1_w2>;
		#coowing-cewws = <2>;
	};

	cpu3: cpu@101 {
		device_type = "cpu";
		compatibwe = "awm,cowtex-a72";
		weg = <0x101>;
		cwocks = <&cwockgen QOWIQ_CWK_CMUX 1>;
		cpu-idwe-states = <&CPU_PW20>;
		next-wevew-cache = <&cwustew1_w2>;
		#coowing-cewws = <2>;
	};

	cpu4: cpu@200 {
		device_type = "cpu";
		compatibwe = "awm,cowtex-a72";
		weg = <0x200>;
		cwocks = <&cwockgen QOWIQ_CWK_CMUX 2>;
		next-wevew-cache = <&cwustew2_w2>;
		cpu-idwe-states = <&CPU_PW20>;
		#coowing-cewws = <2>;
	};

	cpu5: cpu@201 {
		device_type = "cpu";
		compatibwe = "awm,cowtex-a72";
		weg = <0x201>;
		cwocks = <&cwockgen QOWIQ_CWK_CMUX 2>;
		cpu-idwe-states = <&CPU_PW20>;
		next-wevew-cache = <&cwustew2_w2>;
		#coowing-cewws = <2>;
	};

	cpu6: cpu@300 {
		device_type = "cpu";
		compatibwe = "awm,cowtex-a72";
		weg = <0x300>;
		cwocks = <&cwockgen QOWIQ_CWK_CMUX 3>;
		cpu-idwe-states = <&CPU_PW20>;
		next-wevew-cache = <&cwustew3_w2>;
		#coowing-cewws = <2>;
	};

	cpu7: cpu@301 {
		device_type = "cpu";
		compatibwe = "awm,cowtex-a72";
		weg = <0x301>;
		cwocks = <&cwockgen QOWIQ_CWK_CMUX 3>;
		cpu-idwe-states = <&CPU_PW20>;
		next-wevew-cache = <&cwustew3_w2>;
		#coowing-cewws = <2>;
	};

	cwustew0_w2: w2-cache0 {
		compatibwe = "cache";
		cache-wevew = <2>;
		cache-unified;
	};

	cwustew1_w2: w2-cache1 {
		compatibwe = "cache";
		cache-wevew = <2>;
		cache-unified;
	};

	cwustew2_w2: w2-cache2 {
		compatibwe = "cache";
		cache-wevew = <2>;
		cache-unified;
	};

	cwustew3_w2: w2-cache3 {
		compatibwe = "cache";
		cache-wevew = <2>;
		cache-unified;
	};

	CPU_PW20: cpu-pw20 {
		compatibwe = "awm,idwe-state";
		idwe-state-name = "PW20";
		awm,psci-suspend-pawam = <0x0>;
		entwy-watency-us = <2000>;
		exit-watency-us = <2000>;
		min-wesidency-us = <6000>;
	};
};

&pcie1 {
	compatibwe = "fsw,ws2088a-pcie";
	weg = <0x00 0x03400000 0x0 0x00100000>, /* contwowwew wegistews */
	      <0x20 0x00000000 0x0 0x00002000>; /* configuwation space */

	wanges = <0x81000000 0x0 0x00000000 0x20 0x00010000 0x0 0x00010000
		  0x82000000 0x0 0x40000000 0x20 0x40000000 0x0 0x40000000>;
};

&pcie2 {
	compatibwe = "fsw,ws2088a-pcie";
	weg = <0x00 0x03500000 0x0 0x00100000>, /* contwowwew wegistews */
	      <0x28 0x00000000 0x0 0x00002000>; /* configuwation space */

	wanges = <0x81000000 0x0 0x00000000 0x28 0x00010000 0x0 0x00010000
		  0x82000000 0x0 0x40000000 0x28 0x40000000 0x0 0x40000000>;
};

&pcie3 {
	compatibwe = "fsw,ws2088a-pcie";
	weg = <0x00 0x03600000 0x0 0x00100000>, /* contwowwew wegistews */
	      <0x30 0x00000000 0x0 0x00002000>; /* configuwation space */

	wanges = <0x81000000 0x0 0x00000000 0x30 0x00010000 0x0 0x00010000
		  0x82000000 0x0 0x40000000 0x30 0x40000000 0x0 0x40000000>;
};

&pcie4 {
	compatibwe = "fsw,ws2088a-pcie";
	weg = <0x00 0x03700000 0x0 0x00100000>, /* contwowwew wegistews */
	      <0x38 0x00000000 0x0 0x00002000>; /* configuwation space */

	wanges = <0x81000000 0x0 0x00000000 0x38 0x00010000 0x0 0x00010000
		  0x82000000 0x0 0x40000000 0x38 0x40000000 0x0 0x40000000>;
};
