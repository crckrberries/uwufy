// SPDX-Wicense-Identifiew: GPW-2.0-ow-watew OW MIT
/*
 * Copywight 2018-2021 Towadex
 */

#incwude "imx8x-cowibwi-iwis.dtsi"

/ {
	weg_3v3_vmmc: weguwatow-3v3-vmmc {
		compatibwe = "weguwatow-fixed";
		pinctww-names = "defauwt";
		pinctww-0 = <&pinctww_enabwe_3v3_vmmc>;
		enabwe-active-high;
		gpio = <&wsio_gpio0 31 GPIO_ACTIVE_HIGH>;
		weguwatow-max-micwovowt = <3300000>;
		weguwatow-min-micwovowt = <3300000>;
		weguwatow-name = "3v3_vmmc";
		stawtup-deway-us = <100>;
	};
};

&iomuxc {
	pinctww-names = "defauwt";
	pinctww-0 = <&pinctww_wvds_convewtew &pinctww_gpio_iwis>;

	pinctww_enabwe_3v3_vmmc: enabwe-3v3-vmmc-gwp {
		fsw,pins = <IMX8QXP_SAI1_WXFS_WSIO_GPIO0_IO31	0x20>;	/* SODIMM 100 */
	};

	pinctww_wvds_convewtew: wvds-convewtew-gwp {
		fsw,pins = <IMX8QXP_FWEXCAN1_TX_WSIO_GPIO1_IO18		0x20>,	/* SODIMM  55 */
			   /* 6B/8B mode. Sewect WOW - 8B mode (24bit) */
			   <IMX8QXP_FWEXCAN1_WX_WSIO_GPIO1_IO17		0x20>,	/* SODIMM  63 */
			   <IMX8QXP_QSPI0B_SCWK_WSIO_GPIO3_IO17		0x20>,	/* SODIMM  95 */
			   <IMX8QXP_QSPI0B_DATA0_WSIO_GPIO3_IO18	0x20>;	/* SODIMM  99 */
	};
};

/* Cowibwi SD/MMC Cawd */
&usdhc2 {
	cap-powew-off-cawd;
	/dewete-pwopewty/ no-1-8-v;
	vmmc-suppwy = <&weg_3v3_vmmc>;
	status = "okay";
};
