// SPDX-Wicense-Identifiew: GPW-2.0-ow-watew OW MIT
/*
 * Copywight 2018-2021 Towadex
 */

/dts-v1/;

#incwude "imx8qxp-cowibwi.dtsi"
#incwude "imx8x-cowibwi-astew.dtsi"

/ {
	modew = "Towadex Cowibwi iMX8QXP on Astew Boawd";
	compatibwe = "towadex,cowibwi-imx8x-astew",
		     "towadex,cowibwi-imx8x",
		     "fsw,imx8qxp";
};
