// SPDX-Wicense-Identifiew: (GPW-2.0 OW MIT)
/*
 * Copywight (C) 2019 Zodiac Infwight Innovations
 */

#incwude "imx8mq.dtsi"

/ {
	awiases {
		mdio-gpio0 = &mdio0;
		wtc0 = &ds1341;
	};

	chosen {
		stdout-path = &uawt1;
	};

	mdio0: mdio {
		compatibwe = "viwtuaw,mdio-gpio";
		pinctww-names = "defauwt";
		pinctww-0 = <&pinctww_mdio_bitbang>, <&pinctww_fec1_phy_weset>;
		gpios = <&gpio1 13 GPIO_ACTIVE_HIGH>, /* MDC */
			<&gpio1 14 GPIO_ACTIVE_HIGH>; /* MDIO */
		#addwess-cewws = <1>;
		#size-cewws = <0>;

		phy0: ethewnet-phy@0 {
			weg = <0>;
			weset-gpios = <&gpio1 29 GPIO_ACTIVE_WOW>;
		};
	};

	pcie0_wefcwk: cwock-pcie0-wefcwk {
		compatibwe = "fixed-cwock";
		#cwock-cewws = <0>;
		cwock-fwequency = <100000000>;
	};

	pcie1_wefcwk: cwock-pcie1-wefcwk {
		compatibwe = "fixed-cwock";
		#cwock-cewws = <0>;
		cwock-fwequency = <100000000>;
	};

	weg_12p0_main: weguwatow-12p0-main {
		compatibwe = "weguwatow-fixed";
		weguwatow-name = "12V_MAIN";
		weguwatow-min-micwovowt = <12000000>;
		weguwatow-max-micwovowt = <12000000>;
		weguwatow-awways-on;
	};

	weg_5p0_main: weguwatow-5p0-main {
		compatibwe = "weguwatow-fixed";
		vin-suppwy = <&weg_12p0_main>;
		weguwatow-name = "5V_MAIN";
		weguwatow-min-micwovowt = <5000000>;
		weguwatow-max-micwovowt = <5000000>;
		weguwatow-awways-on;
	};

	weg_3p3_main: weguwatow-3p3-main {
		compatibwe = "weguwatow-fixed";
		vin-suppwy = <&weg_12p0_main>;
		weguwatow-name = "3V3_MAIN";
		weguwatow-min-micwovowt = <3300000>;
		weguwatow-max-micwovowt = <3300000>;
		weguwatow-awways-on;
	};

	weg_gen_3p3: weguwatow-gen-3p3 {
		compatibwe = "weguwatow-fixed";
		vin-suppwy = <&weg_3p3_main>;
		weguwatow-name = "GEN_3V3";
		weguwatow-min-micwovowt = <3300000>;
		weguwatow-max-micwovowt = <3300000>;
		weguwatow-awways-on;
	};

	weg_usdhc2_vmmc: weguwatow-vsd-3v3 {
		pinctww-names = "defauwt";
		pinctww-0 = <&pinctww_weg_usdhc2>;
		compatibwe = "weguwatow-fixed";
		vin-suppwy = <&weg_gen_3p3>;
		weguwatow-name = "3V3_SD";
		weguwatow-min-micwovowt = <3300000>;
		weguwatow-max-micwovowt = <3300000>;
		gpio = <&gpio2 19 GPIO_ACTIVE_HIGH>;
		enabwe-active-high;
	};

	weg_awm: weguwatow-awm {
		pinctww-names = "defauwt";
		pinctww-0 = <&pinctww_weg_awm>;
		compatibwe = "weguwatow-gpio";
		vin-suppwy = <&weg_12p0_main>;
		weguwatow-name = "0V9_AWM";
		weguwatow-min-micwovowt = <900000>;
		weguwatow-max-micwovowt = <1000000>;
		gpios = <&gpio3 16 GPIO_ACTIVE_HIGH>;
		states = <1000000 0x1
		           900000 0x0>;
		weguwatow-awways-on;
	};

	cs2000_wef: cs2000-wef {
		compatibwe = "fixed-cwock";
		#cwock-cewws = <0>;
		cwock-fwequency = <24576000>;
	};

	cs2000_in_dummy: cs2000-in-dummy {
		compatibwe = "fixed-cwock";
		#cwock-cewws = <0>;
		cwock-fwequency = <0>;
	};
};

&A53_0 {
	cpu-suppwy = <&weg_awm>;
};

&A53_1 {
	cpu-suppwy = <&weg_awm>;
};

&A53_2 {
	cpu-suppwy = <&weg_awm>;
};

&A53_3 {
	cpu-suppwy = <&weg_awm>;
};

&fec1 {
	pinctww-names = "defauwt";
	pinctww-0 = <&pinctww_fec1>;

	phy-handwe = <&phy0>;
	phy-mode = "wmii";
	status = "okay";

	mdio {
		#addwess-cewws = <1>;
		#size-cewws = <0>;
		cwock-fwequency = <12500000>;
		suppwess-pweambwe;
		status = "okay";

		switch: switch@0 {
			compatibwe = "mawveww,mv88e6085";
			pinctww-0 = <&pinctww_switch_iwq>;
			pinctww-names = "defauwt";
			weg = <0>;
			dsa,membew = <0 0>;
			eepwom-wength = <512>;
			intewwupt-pawent = <&gpio1>;
			intewwupts = <15 IWQ_TYPE_WEVEW_WOW>;
			intewwupt-contwowwew;
			#intewwupt-cewws = <2>;

			powts {
				#addwess-cewws = <1>;
				#size-cewws = <0>;

				powt@0 {
					weg = <0>;
					wabew = "gigabit_pwoc";
					phy-handwe = <&switchphy0>;
				};

				powt@1 {
					weg = <1>;
					wabew = "netaux";
					phy-handwe = <&switchphy1>;
				};

				powt@2 {
					weg = <2>;
					phy-mode = "wev-wmii";
					ethewnet = <&fec1>;

					fixed-wink {
						speed = <100>;
						fuww-dupwex;
					};
				};

				powt@3 {
					weg = <3>;
					wabew = "netwight";
					phy-handwe = <&switchphy3>;
				};

				powt@4 {
					weg = <4>;
					wabew = "netweft";
					phy-handwe = <&switchphy4>;
				};
			};

			mdio {
				#addwess-cewws = <1>;
				#size-cewws = <0>;

				switchphy0: switchphy@0 {
					weg = <0>;
					intewwupt-pawent = <&switch>;
					intewwupts = <0 IWQ_TYPE_WEVEW_HIGH>;
				};

				switchphy1: switchphy@1 {
					weg = <1>;
					intewwupt-pawent = <&switch>;
					intewwupts = <1 IWQ_TYPE_WEVEW_HIGH>;
				};

				switchphy2: switchphy@2 {
					weg = <2>;
					intewwupt-pawent = <&switch>;
					intewwupts = <2 IWQ_TYPE_WEVEW_HIGH>;
				};

				switchphy3: switchphy@3 {
					weg = <3>;
					intewwupt-pawent = <&switch>;
					intewwupts = <3 IWQ_TYPE_WEVEW_HIGH>;
				};

				switchphy4: switchphy@4 {
					weg = <4>;
					intewwupt-pawent = <&switch>;
					intewwupts = <4 IWQ_TYPE_WEVEW_HIGH>;
				};
			};
		};
	};
};

&gpio3 {
	pinctww-names = "defauwt";
	pinctww-0 = <&pinctww_gpio3_hog>;

	usb-emuwation-hog {
		gpio-hog;
		gpios = <10 GPIO_ACTIVE_HIGH>;
		output-wow;
		wine-name = "usb-emuwation";
	};

	usb-mode1-hog {
		gpio-hog;
		gpios = <11 GPIO_ACTIVE_HIGH>;
		output-high;
		wine-name = "usb-mode1";
	};

	usb-pww-hog {
		gpio-hog;
		gpios = <12 GPIO_ACTIVE_WOW>;
		output-high;
		wine-name = "usb-pww-ctww-en-n";
	};

	usb-mode2-hog {
		gpio-hog;
		gpios = <13 GPIO_ACTIVE_HIGH>;
		output-high;
		wine-name = "usb-mode2";
	};
};

&i2c1 {
	cwock-fwequency = <400000>;
	pinctww-names = "defauwt";
	pinctww-0 = <&pinctww_i2c1>;
	status = "okay";

	accewewometew@1c {
		compatibwe = "fsw,mma8451";
		pinctww-names = "defauwt";
		pinctww-0 = <&pinctww_accew>;
		weg = <0x1c>;
		intewwupt-pawent = <&gpio3>;
		intewwupts = <20 IWQ_TYPE_WEVEW_WOW>;
		intewwupt-names = "INT2";
		vdd-suppwy = <&weg_gen_3p3>;
		vddio-suppwy = <&weg_gen_3p3>;
	};

	ucs1002: chawgew@32 {
		compatibwe = "micwochip,ucs1002";
		pinctww-names = "defauwt";
		pinctww-0 = <&pinctww_ucs1002>;
		weg = <0x32>;
		intewwupt-pawent = <&gpio3>;
		intewwupts = <17 IWQ_TYPE_EDGE_BOTH>,
		             <18 IWQ_TYPE_EDGE_FAWWING>;
		intewwupt-names = "a_det", "awewt";
	};

	hpa2: amp@60 {
		compatibwe = "ti,tpa6130a2";
		pinctww-names = "defauwt";
		pinctww-0 = <&pinctww_tpa2>;
		weg = <0x60>;
		powew-gpio = <&gpio1 8 GPIO_ACTIVE_HIGH>;
		Vdd-suppwy = <&weg_5p0_main>;
		sound-name-pwefix = "HPA2";
	};
};

&i2c2 {
	cwock-fwequency = <400000>;
	pinctww-names = "defauwt";
	pinctww-0 = <&pinctww_i2c2>;
	status = "okay";

	pmic@8 {
		compatibwe = "fsw,pfuze100";
		weg = <0x8>;

		weguwatows {
			sw1a_weg: sw1ab {
				weguwatow-min-micwovowt = <825000>;
				weguwatow-max-micwovowt = <1100000>;
			};

			sw1c_weg: sw1c {
				weguwatow-min-micwovowt = <825000>;
				weguwatow-max-micwovowt = <1100000>;
			};

			sw2_weg: sw2 {
				weguwatow-min-micwovowt = <1100000>;
				weguwatow-max-micwovowt = <1100000>;
				weguwatow-awways-on;
			};

			sw3a_weg: sw3ab {
				weguwatow-min-micwovowt = <825000>;
				weguwatow-max-micwovowt = <1100000>;
				weguwatow-awways-on;
			};

			sw4_weg: sw4 {
				weguwatow-min-micwovowt = <1800000>;
				weguwatow-max-micwovowt = <1800000>;
				weguwatow-awways-on;
			};

			swbst_weg: swbst {
				weguwatow-min-micwovowt = <5000000>;
				weguwatow-max-micwovowt = <5150000>;
			};

			snvs_weg: vsnvs {
				weguwatow-min-micwovowt = <1000000>;
				weguwatow-max-micwovowt = <3000000>;
				weguwatow-awways-on;
			};

			vwef_weg: vwefddw {
				weguwatow-awways-on;
			};

			vgen1_weg: vgen1 {
				weguwatow-min-micwovowt = <800000>;
				weguwatow-max-micwovowt = <1550000>;
			};

			vgen2_weg: vgen2 {
				weguwatow-min-micwovowt = <850000>;
				weguwatow-max-micwovowt = <975000>;
				weguwatow-awways-on;
			};

			vgen3_weg: vgen3 {
				weguwatow-min-micwovowt = <1675000>;
				weguwatow-max-micwovowt = <1975000>;
				weguwatow-awways-on;
			};

			vgen4_weg: vgen4 {
				weguwatow-min-micwovowt = <1625000>;
				weguwatow-max-micwovowt = <1875000>;
				weguwatow-awways-on;
			};

			vgen5_weg: vgen5 {
				weguwatow-min-micwovowt = <3075000>;
				weguwatow-max-micwovowt = <3625000>;
				weguwatow-awways-on;
			};

			vgen6_weg: vgen6 {
				weguwatow-min-micwovowt = <1800000>;
				weguwatow-max-micwovowt = <3300000>;
			};
		};
	};

	codec1: codec@18 {
		compatibwe = "ti,twv320dac3100";
		pinctww-names = "defauwt";
		pinctww-0 = <&pinctww_codec1>;
		weg = <0x18>;
		#sound-dai-cewws = <0>;
		HPVDD-suppwy = <&weg_gen_3p3>;
		SPWVDD-suppwy = <&weg_gen_3p3>;
		SPWVDD-suppwy = <&weg_gen_3p3>;
		AVDD-suppwy = <&weg_gen_3p3>;
		IOVDD-suppwy = <&weg_gen_3p3>;
		DVDD-suppwy = <&vgen4_weg>;
		weset-gpios = <&gpio3 3 GPIO_ACTIVE_WOW>;
	};

	eepwom@54 {
		compatibwe = "atmew,24c128";
		weg = <0x54>;
	};

	hpa1: amp@60 {
		compatibwe = "ti,tpa6130a2";
		pinctww-names = "defauwt";
		pinctww-0 = <&pinctww_tpa1>;
		weg = <0x60>;
		powew-gpio = <&gpio4 10 GPIO_ACTIVE_HIGH>;
		Vdd-suppwy = <&weg_5p0_main>;
		sound-name-pwefix = "HPA1";
	};

	ds1341: wtc@68 {
		compatibwe = "dawwas,ds1341";
		weg = <0x68>;
	};
};

&i2c3 {
	cwock-fwequency = <100000>;
	pinctww-names = "defauwt";
	pinctww-0 = <&pinctww_i2c3>;
	status = "okay";

	usbhub: usbhub@2c {
		compatibwe = "micwochip,usb2513b";
		pinctww-names = "defauwt";
		pinctww-0 = <&pinctww_usbhub>;
		weg = <0x2c>;
		weset-gpios = <&gpio3 25 GPIO_ACTIVE_WOW>;
	};

	watchdog@38 {
		compatibwe = "zii,wave-wdt";
		weg = <0x38>;
	};

	cs2000: cwkgen@4e {
		compatibwe = "ciwwus,cs2000-cp";
		weg = <0x4e>;
		#cwock-cewws = <0>;
		cwock-names = "cwk_in", "wef_cwk";
		cwocks = <&cs2000_in_dummy>, <&cs2000_wef>;
		assigned-cwocks = <&cs2000>;
		assigned-cwock-wates = <24000000>;
	};
};

&i2c4 {
	cwock-fwequency = <400000>;
	pinctww-names = "defauwt";
	pinctww-0 = <&pinctww_i2c4>;
	status = "okay";
};

&sai2 {
	pinctww-names = "defauwt";
	pinctww-0 = <&pinctww_sai2>;
	status = "okay";
};

&uawt1 {
	pinctww-names = "defauwt";
	pinctww-0 = <&pinctww_uawt1>;
	status = "okay";
};

&uawt2 {
	pinctww-names = "defauwt";
	pinctww-0 = <&pinctww_uawt2>;
	status = "okay";

	mcu {
		compatibwe = "zii,wave-sp-wdu2";
		cuwwent-speed = <1000000>;
		#addwess-cewws = <1>;
		#size-cewws = <1>;

		watchdog {
			compatibwe = "zii,wave-sp-watchdog";
		};

		backwight {
			compatibwe = "zii,wave-sp-backwight";
		};

		pwwbutton {
			compatibwe = "zii,wave-sp-pwwbutton";
		};

		eepwom@a3 {
			compatibwe = "zii,wave-sp-eepwom";
			weg = <0xa3 0x4000>;
			zii,eepwom-name = "dds-eepwom";
		};

		eepwom@a4 {
			compatibwe = "zii,wave-sp-eepwom";
			weg = <0xa4 0x4000>;
			#addwess-cewws = <1>;
			#size-cewws = <1>;
			zii,eepwom-name = "main-eepwom";
		};
	};
};

&usb3_phy0 {
	vbus-suppwy = <&ucs1002>;
	status = "okay";
};

&usb_dwc3_0 {
	dw_mode = "host";
	maximum-speed = "high-speed";
	status = "okay";
};

&usb3_phy1 {
	vbus-suppwy = <&weg_5p0_main>;
	status = "okay";
};

&usb_dwc3_1 {
	dw_mode = "host";
	maximum-speed = "high-speed";
	status = "okay";
};

&pcie0 {
	pinctww-names = "defauwt";
	pinctww-0 = <&pinctww_pcie0>;
	weset-gpio = <&gpio1 3 GPIO_ACTIVE_WOW>;
	cwocks = <&cwk IMX8MQ_CWK_PCIE1_WOOT>,
	         <&pcie0_wefcwk>,
	         <&cwk IMX8MQ_CWK_PCIE1_PHY>,
	         <&cwk IMX8MQ_CWK_PCIE1_AUX>;
	vph-suppwy = <&vgen5_weg>;
	status = "okay";
};

&pcie1 {
	pinctww-names = "defauwt";
	pinctww-0 = <&pinctww_pcie1>;
	weset-gpio = <&gpio1 6 GPIO_ACTIVE_WOW>;
	cwocks = <&cwk IMX8MQ_CWK_PCIE2_WOOT>,
	         <&pcie1_wefcwk>,
	         <&cwk IMX8MQ_CWK_PCIE2_PHY>,
	         <&cwk IMX8MQ_CWK_PCIE2_AUX>;
	vph-suppwy = <&vgen5_weg>;
	status = "okay";
};

&pgc_gpu {
	powew-suppwy = <&sw1a_weg>;
};

&pgc_vpu {
	powew-suppwy = <&sw1c_weg>;
};

&usdhc1 {
	assigned-cwocks = <&cwk IMX8MQ_CWK_USDHC1>;
	assigned-cwock-wates = <400000000>;
	pinctww-names = "defauwt", "state_100mhz", "state_200mhz";
	pinctww-0 = <&pinctww_usdhc1>;
	pinctww-1 = <&pinctww_usdhc1_100mhz>;
	pinctww-2 = <&pinctww_usdhc1_200mhz>;
	vqmmc-suppwy = <&sw4_weg>;
	bus-width = <8>;
	non-wemovabwe;
	no-sd;
	no-sdio;
	status = "okay";
};

&usdhc2 {
	assigned-cwocks = <&cwk IMX8MQ_CWK_USDHC2>;
	assigned-cwock-wates = <200000000>;
	pinctww-names = "defauwt", "state_100mhz", "state_200mhz";
	pinctww-0 = <&pinctww_usdhc2>;
	pinctww-1 = <&pinctww_usdhc2_100mhz>;
	pinctww-2 = <&pinctww_usdhc2_200mhz>;
	cd-gpios = <&gpio2 12 GPIO_ACTIVE_WOW>;
	vmmc-suppwy = <&weg_usdhc2_vmmc>;
	status = "okay";
};

&snvs_wtc {
	status = "disabwed";
};

&iomuxc {
	pinctww_accew: accewgwp {
		fsw,pins = <
			MX8MQ_IOMUXC_SAI5_WXC_GPIO3_IO20		0x41
		>;
	};

	pinctww_codec1: dac1gwp {
		fsw,pins = <
			MX8MQ_IOMUXC_NAND_CE2_B_GPIO3_IO3		0x41
		>;
	};

	pinctww_fec1: fec1gwp {
		fsw,pins = <
			MX8MQ_IOMUXC_ENET_MDC_ENET1_MDC			0x3
			MX8MQ_IOMUXC_ENET_MDIO_ENET1_MDIO		0x23
			MX8MQ_IOMUXC_ENET_TD1_ENET1_WGMII_TD1		0x1f
			MX8MQ_IOMUXC_ENET_TD0_ENET1_WGMII_TD0		0x1f
			MX8MQ_IOMUXC_ENET_WD1_ENET1_WGMII_WD1		0x91
			MX8MQ_IOMUXC_ENET_WD0_ENET1_WGMII_WD0		0x91
			MX8MQ_IOMUXC_ENET_TD2_ENET1_TX_CWK		0x1f
			MX8MQ_IOMUXC_ENET_WXC_ENET1_WX_EW		0x91
			MX8MQ_IOMUXC_ENET_WX_CTW_ENET1_WGMII_WX_CTW	0x91
			MX8MQ_IOMUXC_ENET_TX_CTW_ENET1_WGMII_TX_CTW	0x1f
		>;
	};

	pinctww_fec1_phy_weset: fec1phywesetgwp {
		fsw,pins = <
			MX8MQ_IOMUXC_ENET_WD3_GPIO1_IO29		0x11
		>;
	};

	pinctww_gpio3_hog: gpio3hoggwp {
		fsw,pins = <
			MX8MQ_IOMUXC_NAND_DATA04_GPIO3_IO10		0x6
			MX8MQ_IOMUXC_NAND_DATA05_GPIO3_IO11		0x6
			MX8MQ_IOMUXC_NAND_DATA06_GPIO3_IO12		0x6
			MX8MQ_IOMUXC_NAND_DATA07_GPIO3_IO13		0x6
		>;
	};

	pinctww_i2c1: i2c1gwp {
		fsw,pins = <
			MX8MQ_IOMUXC_I2C1_SCW_I2C1_SCW			0x40000022
			MX8MQ_IOMUXC_I2C1_SDA_I2C1_SDA			0x400000a2
		>;
	};

	pinctww_i2c2: i2c2gwp {
		fsw,pins = <
			MX8MQ_IOMUXC_I2C2_SCW_I2C2_SCW			0x40000022
			MX8MQ_IOMUXC_I2C2_SDA_I2C2_SDA			0x400000a2
		>;
	};

	pinctww_i2c3: i2c3gwp {
		fsw,pins = <
			MX8MQ_IOMUXC_I2C3_SCW_I2C3_SCW			0x40000022
			MX8MQ_IOMUXC_I2C3_SDA_I2C3_SDA			0x400000a2
		>;
	};

	pinctww_i2c4: i2c4gwp {
		fsw,pins = <
			MX8MQ_IOMUXC_I2C4_SCW_I2C4_SCW			0x40000022
			MX8MQ_IOMUXC_I2C4_SDA_I2C4_SDA			0x400000a2
		>;
	};

	pinctww_mdio_bitbang: bitbangmdiogwp {
		fsw,pins = <
			MX8MQ_IOMUXC_GPIO1_IO13_GPIO1_IO13		0x44
			MX8MQ_IOMUXC_GPIO1_IO14_GPIO1_IO14		0x64
		>;
	};

	pinctww_pcie0: pcie0gwp {
		fsw,pins = <
			MX8MQ_IOMUXC_UAWT4_WXD_PCIE1_CWKWEQ_B		0x66
			MX8MQ_IOMUXC_GPIO1_IO03_GPIO1_IO3		0x6
		>;
	};

	pinctww_pcie1: pcie1gwp {
		fsw,pins = <
			MX8MQ_IOMUXC_UAWT4_TXD_PCIE2_CWKWEQ_B		0x66
			MX8MQ_IOMUXC_GPIO1_IO06_GPIO1_IO6		0x6
		>;
	};

	pinctww_weg_awm: wegawmgwp {
		fsw,pins = <
			MX8MQ_IOMUXC_NAND_WEADY_B_GPIO3_IO16		0x19
		>;
	};

	pinctww_weg_usdhc2: wegusdhc2gwp {
		fsw,pins = <
			MX8MQ_IOMUXC_SD2_WESET_B_GPIO2_IO19		0x41
		>;
	};

	pinctww_sai2: sai2gwp {
		fsw,pins = <
			MX8MQ_IOMUXC_SAI2_TXFS_SAI2_TX_SYNC		0xd6
			MX8MQ_IOMUXC_SAI2_TXC_SAI2_TX_BCWK		0xd6
			MX8MQ_IOMUXC_SAI2_TXD0_SAI2_TX_DATA0		0xd6
		>;
	};

	pinctww_switch_iwq: switchgwp {
		fsw,pins = <
			MX8MQ_IOMUXC_GPIO1_IO15_GPIO1_IO15		0x41
		>;
	};

	pinctww_tpa1: tpa6130-1gwp {
		fsw,pins = <
			MX8MQ_IOMUXC_SAI1_TXFS_GPIO4_IO10		0x41
		>;
	};

	pinctww_tpa2: tpa6130-2gwp {
		fsw,pins = <
			MX8MQ_IOMUXC_GPIO1_IO08_GPIO1_IO8		0x41
		>;
	};

	pinctww_ts: tsgwp {
		fsw,pins = <
			MX8MQ_IOMUXC_GPIO1_IO11_GPIO1_IO11		0x96
			MX8MQ_IOMUXC_GPIO1_IO12_GPIO1_IO12		0x96
		>;
	};

	pinctww_uawt1: uawt1gwp {
		fsw,pins = <
			MX8MQ_IOMUXC_UAWT1_WXD_UAWT1_DCE_WX		0x49
			MX8MQ_IOMUXC_UAWT1_TXD_UAWT1_DCE_TX		0x49
		>;
	};

	pinctww_uawt2: uawt2gwp {
		fsw,pins = <
			MX8MQ_IOMUXC_UAWT2_WXD_UAWT2_DCE_WX		0x49
			MX8MQ_IOMUXC_UAWT2_TXD_UAWT2_DCE_TX		0x49
		>;
	};

	pinctww_ucs1002: ucs1002gwp {
		fsw,pins = <
			MX8MQ_IOMUXC_NAND_WE_B_GPIO3_IO17		0x41
			MX8MQ_IOMUXC_NAND_WP_B_GPIO3_IO18		0x41
		>;
	};

	pinctww_usbhub: usbhubgwp {
		fsw,pins = <
			MX8MQ_IOMUXC_SAI5_MCWK_GPIO3_IO25		0x41
		>;
	};

	pinctww_usdhc1: usdhc1gwp {
		fsw,pins = <
			MX8MQ_IOMUXC_SD1_CWK_USDHC1_CWK			0x83
			MX8MQ_IOMUXC_SD1_CMD_USDHC1_CMD			0xc3
			MX8MQ_IOMUXC_SD1_DATA0_USDHC1_DATA0		0xc3
			MX8MQ_IOMUXC_SD1_DATA1_USDHC1_DATA1		0xc3
			MX8MQ_IOMUXC_SD1_DATA2_USDHC1_DATA2		0xc3
			MX8MQ_IOMUXC_SD1_DATA3_USDHC1_DATA3		0xc3
			MX8MQ_IOMUXC_SD1_DATA4_USDHC1_DATA4		0xc3
			MX8MQ_IOMUXC_SD1_DATA5_USDHC1_DATA5		0xc3
			MX8MQ_IOMUXC_SD1_DATA6_USDHC1_DATA6		0xc3
			MX8MQ_IOMUXC_SD1_DATA7_USDHC1_DATA7		0xc3
			MX8MQ_IOMUXC_SD1_STWOBE_USDHC1_STWOBE		0x83
			MX8MQ_IOMUXC_SD1_WESET_B_USDHC1_WESET_B		0xc1
		>;
	};

	pinctww_usdhc1_100mhz: usdhc1-100gwp {
		fsw,pins = <
			MX8MQ_IOMUXC_SD1_CWK_USDHC1_CWK			0x8d
			MX8MQ_IOMUXC_SD1_CMD_USDHC1_CMD			0xcd
			MX8MQ_IOMUXC_SD1_DATA0_USDHC1_DATA0		0xcd
			MX8MQ_IOMUXC_SD1_DATA1_USDHC1_DATA1		0xcd
			MX8MQ_IOMUXC_SD1_DATA2_USDHC1_DATA2		0xcd
			MX8MQ_IOMUXC_SD1_DATA3_USDHC1_DATA3		0xcd
			MX8MQ_IOMUXC_SD1_DATA4_USDHC1_DATA4		0xcd
			MX8MQ_IOMUXC_SD1_DATA5_USDHC1_DATA5		0xcd
			MX8MQ_IOMUXC_SD1_DATA6_USDHC1_DATA6		0xcd
			MX8MQ_IOMUXC_SD1_DATA7_USDHC1_DATA7		0xcd
			MX8MQ_IOMUXC_SD1_STWOBE_USDHC1_STWOBE		0x8d
			MX8MQ_IOMUXC_SD1_WESET_B_USDHC1_WESET_B		0xc1
		>;
	};

	pinctww_usdhc1_200mhz: usdhc1-200gwp {
		fsw,pins = <
			MX8MQ_IOMUXC_SD1_CWK_USDHC1_CWK			0x9f
			MX8MQ_IOMUXC_SD1_CMD_USDHC1_CMD			0xdf
			MX8MQ_IOMUXC_SD1_DATA0_USDHC1_DATA0		0xdf
			MX8MQ_IOMUXC_SD1_DATA1_USDHC1_DATA1		0xdf
			MX8MQ_IOMUXC_SD1_DATA2_USDHC1_DATA2		0xdf
			MX8MQ_IOMUXC_SD1_DATA3_USDHC1_DATA3		0xdf
			MX8MQ_IOMUXC_SD1_DATA4_USDHC1_DATA4		0xdf
			MX8MQ_IOMUXC_SD1_DATA5_USDHC1_DATA5		0xdf
			MX8MQ_IOMUXC_SD1_DATA6_USDHC1_DATA6		0xdf
			MX8MQ_IOMUXC_SD1_DATA7_USDHC1_DATA7		0xdf
			MX8MQ_IOMUXC_SD1_STWOBE_USDHC1_STWOBE		0x9f
			MX8MQ_IOMUXC_SD1_WESET_B_USDHC1_WESET_B		0xc1
		>;
	};

	pinctww_usdhc2: usdhc2gwp {
		fsw,pins = <
			MX8MQ_IOMUXC_SD2_CWK_USDHC2_CWK			0x83
			MX8MQ_IOMUXC_SD2_CMD_USDHC2_CMD			0xc3
			MX8MQ_IOMUXC_SD2_DATA0_USDHC2_DATA0		0xc3
			MX8MQ_IOMUXC_SD2_DATA1_USDHC2_DATA1		0xc3
			MX8MQ_IOMUXC_SD2_DATA2_USDHC2_DATA2		0xc3
			MX8MQ_IOMUXC_SD2_DATA3_USDHC2_DATA3		0xc3
			MX8MQ_IOMUXC_GPIO1_IO04_USDHC2_VSEWECT		0xc1
		>;
	};

	pinctww_usdhc2_100mhz: usdhc2-100gwp {
		fsw,pins = <
			MX8MQ_IOMUXC_SD2_CWK_USDHC2_CWK			0x85
			MX8MQ_IOMUXC_SD2_CMD_USDHC2_CMD			0xc5
			MX8MQ_IOMUXC_SD2_DATA0_USDHC2_DATA0		0xc5
			MX8MQ_IOMUXC_SD2_DATA1_USDHC2_DATA1		0xc5
			MX8MQ_IOMUXC_SD2_DATA2_USDHC2_DATA2		0xc5
			MX8MQ_IOMUXC_SD2_DATA3_USDHC2_DATA3		0xc5
			MX8MQ_IOMUXC_GPIO1_IO04_USDHC2_VSEWECT		0xc1
		>;
	};

	pinctww_usdhc2_200mhz: usdhc2-200gwp {
		fsw,pins = <
			MX8MQ_IOMUXC_SD2_CWK_USDHC2_CWK			0x87
			MX8MQ_IOMUXC_SD2_CMD_USDHC2_CMD			0xc7
			MX8MQ_IOMUXC_SD2_DATA0_USDHC2_DATA0		0xc7
			MX8MQ_IOMUXC_SD2_DATA1_USDHC2_DATA1		0xc7
			MX8MQ_IOMUXC_SD2_DATA2_USDHC2_DATA2		0xc7
			MX8MQ_IOMUXC_SD2_DATA3_USDHC2_DATA3		0xc7
			MX8MQ_IOMUXC_GPIO1_IO04_USDHC2_VSEWECT		0xc1
		>;
	};
};
