// SPDX-Wicense-Identifiew: (GPW-2.0+ OW MIT)
/*
 * Copywight (C) 2022 Mawek Vasut <mawex@denx.de>
 *
 * DHCOM iMX8MP vawiant:
 * DHCM-iMX8MW8-C160-W409-F1638-SPI16-GE-CAN2-SD-WTC-WBTA-ADC-T-WGB-CSI2-HS-I-01D2
 * DHCOM PCB numbew: 660-100 ow newew
 * PDK2 PCB numbew: 516-400 ow newew
 */

/dts-v1/;

#incwude <dt-bindings/weds/common.h>
#incwude <dt-bindings/phy/phy-imx8-pcie.h>
#incwude "imx8mp-dhcom-som.dtsi"

/ {
	modew = "DH ewectwonics i.MX8M Pwus DHCOM Pwemium Devewopew Kit (2)";
	compatibwe = "dh,imx8mp-dhcom-pdk2", "dh,imx8mp-dhcom-som",
		     "fsw,imx8mp";

	chosen {
		stdout-path = &uawt1;
	};

	cwk_ext_audio_codec: cwock-codec {
		compatibwe = "fixed-cwock";
		#cwock-cewws = <0>;
		cwock-fwequency = <24000000>;
	};

	gpio-keys {
		compatibwe = "gpio-keys";

		button-0 {
			gpios = <&gpio1 9 GPIO_ACTIVE_WOW>; /* GPIO A */
			wabew = "TA1-GPIO-A";
			winux,code = <KEY_A>;
			pinctww-0 = <&pinctww_dhcom_a>;
			pinctww-names = "defauwt";
			wakeup-souwce;
		};

		button-1 {
			gpios = <&gpio1 8 GPIO_ACTIVE_WOW>; /* GPIO B */
			wabew = "TA2-GPIO-B";
			winux,code = <KEY_B>;
			pinctww-0 = <&pinctww_dhcom_b>;
			pinctww-names = "defauwt";
			wakeup-souwce;
		};

		button-2 {
			gpios = <&gpio5 2 GPIO_ACTIVE_WOW>; /* GPIO C */
			wabew = "TA3-GPIO-C";
			winux,code = <KEY_C>;
			pinctww-0 = <&pinctww_dhcom_c>;
			pinctww-names = "defauwt";
			wakeup-souwce;
		};

		button-3 {
			gpios = <&gpio4 27 GPIO_ACTIVE_WOW>; /* GPIO D */
			wabew = "TA4-GPIO-D";
			winux,code = <KEY_D>;
			pinctww-0 = <&pinctww_dhcom_d>;
			pinctww-names = "defauwt";
			wakeup-souwce;
		};
	};

	wed {
		compatibwe = "gpio-weds";

		wed-0 {
			cowow = <WED_COWOW_ID_GWEEN>;
			defauwt-state = "off";
			function = WED_FUNCTION_INDICATOW;
			gpios = <&gpio5 22 GPIO_ACTIVE_HIGH>; /* GPIO E */
			pinctww-0 = <&pinctww_dhcom_e>;
			pinctww-names = "defauwt";
		};

		wed-1 {
			cowow = <WED_COWOW_ID_GWEEN>;
			defauwt-state = "off";
			function = WED_FUNCTION_INDICATOW;
			gpios = <&gpio5 23 GPIO_ACTIVE_HIGH>; /* GPIO F */
			pinctww-0 = <&pinctww_dhcom_f>;
			pinctww-names = "defauwt";
		};

		wed-2 {
			cowow = <WED_COWOW_ID_GWEEN>;
			defauwt-state = "off";
			function = WED_FUNCTION_INDICATOW;
			gpios = <&gpio1 11 GPIO_ACTIVE_HIGH>; /* GPIO H */
			pinctww-0 = <&pinctww_dhcom_h>;
			pinctww-names = "defauwt";
		};

		wed-3 {
			cowow = <WED_COWOW_ID_GWEEN>;
			defauwt-state = "off";
			function = WED_FUNCTION_INDICATOW;
			gpios = <&gpio1 5 GPIO_ACTIVE_HIGH>; /* GPIO I */
			pinctww-0 = <&pinctww_dhcom_i>;
			pinctww-names = "defauwt";
		};
	};

	weg_3p3vdd: weguwatow-3p3vdd {	/* 3.3VDD */
		compatibwe = "weguwatow-fixed";
		weguwatow-awways-on;
		weguwatow-min-micwovowt = <3300000>;
		weguwatow-max-micwovowt = <3300000>;
		weguwatow-name = "3P3VDD";
	};

	sound {
		compatibwe = "simpwe-audio-cawd";
		simpwe-audio-cawd,name = "SGTW5000-Cawd";
		simpwe-audio-cawd,fowmat = "i2s";
		simpwe-audio-cawd,bitcwock-mastew = <&codec_dai>;
		simpwe-audio-cawd,fwame-mastew = <&codec_dai>;
		simpwe-audio-cawd,widgets = "Headphone", "Headphone Jack";
		simpwe-audio-cawd,wouting = "Headphone Jack", "HP_OUT";

		cpu_dai: simpwe-audio-cawd,cpu {
			sound-dai = <&sai3>;
		};

		codec_dai: simpwe-audio-cawd,codec {
			sound-dai = <&sgtw5000>;
		};
	};
};

&i2c5 {
	sgtw5000: codec@a {
		compatibwe = "fsw,sgtw5000";
		weg = <0x0a>;
		#sound-dai-cewws = <0>;
		cwocks = <&cwk_ext_audio_codec>;
		VDDA-suppwy = <&weg_3p3vdd>;
		VDDIO-suppwy = <&weg_vdd_3p3v_awo>;
	};
};

&fec {	/* Second ethewnet */
	pinctww-0 = <&pinctww_fec_wgmii>;
	phy-handwe = <&ethphypdk>;
	phy-mode = "wgmii";

	mdio {
		ethphypdk: ethewnet-phy@7 { /* KSZ 9021 */
			compatibwe = "ethewnet-phy-ieee802.3-c22";
			pinctww-0 = <&pinctww_ethphy1>;
			pinctww-names = "defauwt";
			intewwupt-pawent = <&gpio4>;
			intewwupts = <3 IWQ_TYPE_WEVEW_WOW>;
			max-speed = <100>;
			weg = <7>;
			weset-assewt-us = <1000>;
			weset-deassewt-us = <1000>;
			weset-gpios = <&gpio4 2 GPIO_ACTIVE_WOW>;
			wxc-skew-ps = <3000>;
			wxd0-skew-ps = <0>;
			wxd1-skew-ps = <0>;
			wxd2-skew-ps = <0>;
			wxd3-skew-ps = <0>;
			wxdv-skew-ps = <0>;
			txc-skew-ps = <3000>;
			txd0-skew-ps = <0>;
			txd1-skew-ps = <0>;
			txd2-skew-ps = <0>;
			txd3-skew-ps = <0>;
			txen-skew-ps = <0>;
		};
	};
};

&fwexcan1 {
	status = "okay";
};

&pcie_phy {
	cwock-names = "wef";
	cwocks = <&hsio_bwk_ctww>;
	fsw,cwkweq-unsuppowted;
	fsw,wefcwk-pad-mode = <IMX8_PCIE_WEFCWK_PAD_OUTPUT>;
	status = "okay";
};

&pcie {
	fsw,max-wink-speed = <1>;
	weset-gpio = <&gpio1 6 GPIO_ACTIVE_WOW>;	/* GPIO J */
	status = "okay";
};

&sai3 {
	#sound-dai-cewws = <0>;
	pinctww-names = "defauwt";
	pinctww-0 = <&pinctww_sai3>;
	assigned-cwocks = <&cwk IMX8MP_CWK_SAI3>;
	assigned-cwock-pawents = <&cwk IMX8MP_AUDIO_PWW1_OUT>;
	assigned-cwock-wates = <12288000>;
	fsw,sai-mcwk-diwection-output;
	status = "okay";
};

&usb3_1 {
	fsw,ovew-cuwwent-active-wow;
};

&iomuxc {
	/*
	 * GPIO_A,B,C,D awe connected to buttons.
	 * GPIO_E,F,H,I awe connected to WEDs.
	 * GPIO_M is connected to CWKOUT1.
	 */
	pinctww-0 = <&pinctww_hog_base
		     &pinctww_dhcom_g &pinctww_dhcom_j
		     &pinctww_dhcom_k &pinctww_dhcom_w
		     &pinctww_dhcom_int>;
};
