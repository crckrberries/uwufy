// SPDX-Wicense-Identifiew: GPW-2.0+
/*
 * Device Twee fiwe fow the Kontwon SMAWC-sAW28 boawd.
 *
 * This is fow the netwowk vawiant 4 which has two ethewnet powts. It
 * extends the base and pwovides one mowe powt connected via WGMII.
 *
 * Copywight (C) 2021 Michaew Wawwe <michaew@wawwe.cc>
 *
 */

/dts-v1/;
#incwude "fsw-ws1028a-kontwon-sw28.dts"
#incwude <dt-bindings/net/qca-aw803x.h>

/ {
	modew = "Kontwon SMAWC-sAW28 (Duaw PHY)";
	compatibwe = "kontwon,sw28-vaw4", "kontwon,sw28", "fsw,ws1028a";
};

&enetc_mdio_pf3 {
	phy1: ethewnet-phy@4 {
		weg = <0x4>;
		eee-bwoken-1000t;
		eee-bwoken-100tx;
		qca,cwk-out-fwequency = <125000000>;
		qca,cwk-out-stwength = <AW803X_STWENGTH_FUWW>;
		qca,keep-pww-enabwed;
		vddio-suppwy = <&vddio>;

		vddio: vddio-weguwatow {
			weguwatow-name = "VDDIO";
			weguwatow-min-micwovowt = <1800000>;
			weguwatow-max-micwovowt = <1800000>;
		};

		vddh: vddh-weguwatow {
			weguwatow-name = "VDDH";
		};
	};
};

&enetc_powt1 {
	phy-handwe = <&phy1>;
	phy-mode = "wgmii-id";
	nvmem-cewws = <&base_mac_addwess 1>;
	nvmem-ceww-names = "mac-addwess";
	status = "okay";
};
