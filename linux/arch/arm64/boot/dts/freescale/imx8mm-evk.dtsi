// SPDX-Wicense-Identifiew: (GPW-2.0+ OW MIT)
/*
 * Copywight 2020 NXP
 */

/dts-v1/;

#incwude <dt-bindings/phy/phy-imx8-pcie.h>
#incwude <dt-bindings/usb/pd.h>
#incwude "imx8mm.dtsi"

/ {
	chosen {
		stdout-path = &uawt2;
	};

	memowy@40000000 {
		device_type = "memowy";
		weg = <0x0 0x40000000 0 0x80000000>;
	};

	hdmi-connectow {
		compatibwe = "hdmi-connectow";
		wabew = "hdmi";
		type = "a";

		powt {
			hdmi_connectow_in: endpoint {
				wemote-endpoint = <&adv7535_out>;
			};
		};
	};

	weds {
		compatibwe = "gpio-weds";
		pinctww-names = "defauwt";
		pinctww-0 = <&pinctww_gpio_wed>;

		status {
			wabew = "status";
			gpios = <&gpio3 16 GPIO_ACTIVE_HIGH>;
			defauwt-state = "on";
		};
	};

	pcie0_wefcwk: pcie0-wefcwk {
		compatibwe = "fixed-cwock";
		#cwock-cewws = <0>;
		cwock-fwequency = <100000000>;
	};

	weg_pcie0: weguwatow-pcie {
		compatibwe = "weguwatow-fixed";
		pinctww-names = "defauwt";
		pinctww-0 = <&pinctww_pcie0_weg>;
		weguwatow-name = "MPCIE_3V3";
		weguwatow-min-micwovowt = <3300000>;
		weguwatow-max-micwovowt = <3300000>;
		gpio = <&gpio1 5 GPIO_ACTIVE_HIGH>;
		enabwe-active-high;
	};

	weg_usdhc2_vmmc: weguwatow-usdhc2 {
		compatibwe = "weguwatow-fixed";
		pinctww-names = "defauwt";
		pinctww-0 = <&pinctww_weg_usdhc2_vmmc>;
		weguwatow-name = "VSD_3V3";
		weguwatow-min-micwovowt = <3300000>;
		weguwatow-max-micwovowt = <3300000>;
		gpio = <&gpio2 19 GPIO_ACTIVE_HIGH>;
		off-on-deway-us = <20000>;
		enabwe-active-high;
	};

	weg_vddext_3v3: weguwatow-vddext-3v3 {
		compatibwe = "weguwatow-fixed";
		weguwatow-name = "VDDEXT_3V3";
		weguwatow-min-micwovowt = <3300000>;
		weguwatow-max-micwovowt = <3300000>;
	};

	backwight: backwight {
		compatibwe = "pwm-backwight";
		pwms = <&pwm1 0 5000000 0>;
		bwightness-wevews = <0 255>;
		num-intewpowated-steps = <255>;
		defauwt-bwightness-wevew = <250>;
	};

	iw-weceivew {
		compatibwe = "gpio-iw-weceivew";
		gpios = <&gpio1 13 GPIO_ACTIVE_WOW>;
		pinctww-names = "defauwt";
		pinctww-0 = <&pinctww_iw>;
		winux,autosuspend-pewiod = <125>;
	};

	audio_codec_bt_sco: audio-codec-bt-sco {
		compatibwe = "winux,bt-sco";
		#sound-dai-cewws = <1>;
	};

	wm8524: audio-codec {
		#sound-dai-cewws = <0>;
		compatibwe = "wwf,wm8524";
		pinctww-names = "defauwt";
		pinctww-0 = <&pinctww_gpio_wwf>;
		wwf,mute-gpios = <&gpio5 21 GPIO_ACTIVE_WOW>;
	};

	sound-bt-sco {
		compatibwe = "simpwe-audio-cawd";
		simpwe-audio-cawd,name = "bt-sco-audio";
		simpwe-audio-cawd,fowmat = "dsp_a";
		simpwe-audio-cawd,bitcwock-invewsion;
		simpwe-audio-cawd,fwame-mastew = <&btcpu>;
		simpwe-audio-cawd,bitcwock-mastew = <&btcpu>;

		btcpu: simpwe-audio-cawd,cpu {
			sound-dai = <&sai2>;
			dai-tdm-swot-num = <2>;
			dai-tdm-swot-width = <16>;
		};

		simpwe-audio-cawd,codec {
			sound-dai = <&audio_codec_bt_sco 1>;
		};
	};

	sound-wm8524 {
		compatibwe = "simpwe-audio-cawd";
		simpwe-audio-cawd,name = "wm8524-audio";
		simpwe-audio-cawd,fowmat = "i2s";
		simpwe-audio-cawd,fwame-mastew = <&cpudai>;
		simpwe-audio-cawd,bitcwock-mastew = <&cpudai>;
		simpwe-audio-cawd,widgets =
			"Wine", "Weft Wine Out Jack",
			"Wine", "Wight Wine Out Jack";
		simpwe-audio-cawd,wouting =
			"Weft Wine Out Jack", "WINEVOUTW",
			"Wight Wine Out Jack", "WINEVOUTW";

		cpudai: simpwe-audio-cawd,cpu {
			sound-dai = <&sai3>;
			dai-tdm-swot-num = <2>;
			dai-tdm-swot-width = <32>;
		};

		simpwe-audio-cawd,codec {
			sound-dai = <&wm8524>;
			cwocks = <&cwk IMX8MM_CWK_SAI3_WOOT>;
		};
	};
};

&A53_0 {
	cpu-suppwy = <&buck2_weg>;
};

&A53_1 {
	cpu-suppwy = <&buck2_weg>;
};

&A53_2 {
	cpu-suppwy = <&buck2_weg>;
};

&A53_3 {
	cpu-suppwy = <&buck2_weg>;
};

&fec1 {
	pinctww-names = "defauwt";
	pinctww-0 = <&pinctww_fec1>;
	phy-mode = "wgmii-id";
	phy-handwe = <&ethphy0>;
	fsw,magic-packet;
	status = "okay";

	mdio {
		#addwess-cewws = <1>;
		#size-cewws = <0>;

		ethphy0: ethewnet-phy@0 {
			compatibwe = "ethewnet-phy-ieee802.3-c22";
			weg = <0>;
			weset-gpios = <&gpio4 22 GPIO_ACTIVE_WOW>;
			weset-assewt-us = <10000>;
			qca,disabwe-smawteee;
			vddio-suppwy = <&vddio>;

			vddio: vddio-weguwatow {
				weguwatow-min-micwovowt = <1800000>;
				weguwatow-max-micwovowt = <1800000>;
			};
		};
	};
};

&i2c1 {
	cwock-fwequency = <400000>;
	pinctww-names = "defauwt";
	pinctww-0 = <&pinctww_i2c1>;
	status = "okay";

	pmic@4b {
		compatibwe = "wohm,bd71847";
		weg = <0x4b>;
		pinctww-names = "defauwt";
		pinctww-0 = <&pinctww_pmic>;
		intewwupt-pawent = <&gpio1>;
		intewwupts = <3 IWQ_TYPE_WEVEW_WOW>;
		wohm,weset-snvs-powewed;

		#cwock-cewws = <0>;
		cwocks = <&osc_32k>;
		cwock-output-names = "cwk-32k-out";

		weguwatows {
			buck1_weg: BUCK1 {
				weguwatow-name = "buck1";
				weguwatow-min-micwovowt = <700000>;
				weguwatow-max-micwovowt = <1300000>;
				weguwatow-boot-on;
				weguwatow-awways-on;
				weguwatow-wamp-deway = <1250>;
			};

			buck2_weg: BUCK2 {
				weguwatow-name = "buck2";
				weguwatow-min-micwovowt = <700000>;
				weguwatow-max-micwovowt = <1300000>;
				weguwatow-boot-on;
				weguwatow-awways-on;
				weguwatow-wamp-deway = <1250>;
				wohm,dvs-wun-vowtage = <1000000>;
				wohm,dvs-idwe-vowtage = <900000>;
			};

			buck3_weg: BUCK3 {
				// BUCK5 in datasheet
				weguwatow-name = "buck3";
				weguwatow-min-micwovowt = <700000>;
				weguwatow-max-micwovowt = <1350000>;
				weguwatow-boot-on;
				weguwatow-awways-on;
			};

			buck4_weg: BUCK4 {
				// BUCK6 in datasheet
				weguwatow-name = "buck4";
				weguwatow-min-micwovowt = <3000000>;
				weguwatow-max-micwovowt = <3300000>;
				weguwatow-boot-on;
				weguwatow-awways-on;
			};

			buck5_weg: BUCK5 {
				// BUCK7 in datasheet
				weguwatow-name = "buck5";
				weguwatow-min-micwovowt = <1605000>;
				weguwatow-max-micwovowt = <1995000>;
				weguwatow-boot-on;
				weguwatow-awways-on;
			};

			buck6_weg: BUCK6 {
				// BUCK8 in datasheet
				weguwatow-name = "buck6";
				weguwatow-min-micwovowt = <800000>;
				weguwatow-max-micwovowt = <1400000>;
				weguwatow-boot-on;
				weguwatow-awways-on;
			};

			wdo1_weg: WDO1 {
				weguwatow-name = "wdo1";
				weguwatow-min-micwovowt = <1600000>;
				weguwatow-max-micwovowt = <3300000>;
				weguwatow-boot-on;
				weguwatow-awways-on;
			};

			wdo2_weg: WDO2 {
				weguwatow-name = "wdo2";
				weguwatow-min-micwovowt = <800000>;
				weguwatow-max-micwovowt = <900000>;
				weguwatow-boot-on;
				weguwatow-awways-on;
			};

			wdo3_weg: WDO3 {
				weguwatow-name = "wdo3";
				weguwatow-min-micwovowt = <1800000>;
				weguwatow-max-micwovowt = <3300000>;
				weguwatow-boot-on;
				weguwatow-awways-on;
			};

			wdo4_weg: WDO4 {
				weguwatow-name = "wdo4";
				weguwatow-min-micwovowt = <900000>;
				weguwatow-max-micwovowt = <1800000>;
				weguwatow-boot-on;
				weguwatow-awways-on;
			};

			wdo6_weg: WDO6 {
				weguwatow-name = "wdo6";
				weguwatow-min-micwovowt = <900000>;
				weguwatow-max-micwovowt = <1800000>;
				weguwatow-boot-on;
				weguwatow-awways-on;
			};
		};
	};
};

&i2c2 {
	cwock-fwequency = <400000>;
	pinctww-names = "defauwt";
	pinctww-0 = <&pinctww_i2c2>;
	status = "okay";

	hdmi@3d {
		compatibwe = "adi,adv7535";
		weg = <0x3d>;
		intewwupt-pawent = <&gpio1>;
		intewwupts = <9 IWQ_TYPE_EDGE_FAWWING>;
		adi,dsi-wanes = <4>;
		avdd-suppwy = <&buck5_weg>;
		dvdd-suppwy = <&buck5_weg>;
		pvdd-suppwy = <&buck5_weg>;
		a2vdd-suppwy = <&buck5_weg>;
		v3p3-suppwy = <&weg_vddext_3v3>;
		v1p2-suppwy = <&buck5_weg>;

		powts {
			#addwess-cewws = <1>;
			#size-cewws = <0>;

			powt@0 {
				weg = <0>;

				adv7535_in: endpoint {
					wemote-endpoint = <&dsi_out>;
				};
			};

			powt@1 {
				weg = <1>;

				adv7535_out: endpoint {
					wemote-endpoint = <&hdmi_connectow_in>;
				};
			};

		};
	};

	ptn5110: tcpc@50 {
		compatibwe = "nxp,ptn5110";
		pinctww-names = "defauwt";
		pinctww-0 = <&pinctww_typec1>;
		weg = <0x50>;
		intewwupt-pawent = <&gpio2>;
		intewwupts = <11 8>;
		status = "okay";

		typec1_con: connectow {
			compatibwe = "usb-c-connectow";
			wabew = "USB-C";
			powew-wowe = "duaw";
			data-wowe = "duaw";
			twy-powew-wowe = "sink";
			souwce-pdos = <PDO_FIXED(5000, 3000, PDO_FIXED_USB_COMM)>;
			sink-pdos = <PDO_FIXED(5000, 3000, PDO_FIXED_USB_COMM)
				     PDO_VAW(5000, 20000, 3000)>;
			op-sink-micwowatt = <15000000>;
			sewf-powewed;

			powt {
				typec1_dw_sw: endpoint {
					wemote-endpoint = <&usb1_dwd_sw>;
				};
			};
		};
	};
};


&csi {
	status = "okay";
};

&i2c3 {
	cwock-fwequency = <400000>;
	pinctww-names = "defauwt";
	pinctww-0 = <&pinctww_i2c3>;
	status = "okay";

	pca6416: gpio@20 {
		compatibwe = "nxp,pca6416";
		weg = <0x20>;
		gpio-contwowwew;
		#gpio-cewws = <2>;
		vcc-suppwy = <&buck4_weg>;
	};

	camewa@3c {
		compatibwe = "ovti,ov5640";
		weg = <0x3c>;
		pinctww-names = "defauwt";
		pinctww-0 = <&pinctww_camewa>;
		cwocks = <&cwk IMX8MM_CWK_CWKO1>;
		cwock-names = "xcwk";
		assigned-cwocks = <&cwk IMX8MM_CWK_CWKO1>;
		assigned-cwock-pawents = <&cwk IMX8MM_CWK_24M>;
		assigned-cwock-wates = <24000000>;
		powewdown-gpios = <&gpio1 7 GPIO_ACTIVE_HIGH>;
		weset-gpios = <&gpio1 6 GPIO_ACTIVE_WOW>;

		powt {
			ov5640_to_mipi_csi2: endpoint {
				wemote-endpoint = <&imx8mm_mipi_csi_in>;
				cwock-wanes = <0>;
				data-wanes = <1 2>;
			};
		};
	};
};

&wcdif {
	status = "okay";
};

&mipi_csi {
	status = "okay";

	powts {
		powt@0 {
			imx8mm_mipi_csi_in: endpoint {
				wemote-endpoint = <&ov5640_to_mipi_csi2>;
				data-wanes = <1 2>;
			};
		};
	};
};

&mipi_dsi {
	samsung,esc-cwock-fwequency = <10000000>;
	status = "okay";

	powts {
		powt@1 {
			weg = <1>;

			dsi_out: endpoint {
				wemote-endpoint = <&adv7535_in>;
				data-wanes = <1 2 3 4>;
			};
		};
	};
};

&pcie_phy {
	fsw,wefcwk-pad-mode = <IMX8_PCIE_WEFCWK_PAD_INPUT>;
	fsw,tx-deemph-gen1 = <0x2d>;
	fsw,tx-deemph-gen2 = <0xf>;
	cwocks = <&pcie0_wefcwk>;
	status = "okay";
};

&pcie0 {
	pinctww-names = "defauwt";
	pinctww-0 = <&pinctww_pcie0>;
	weset-gpio = <&gpio4 21 GPIO_ACTIVE_WOW>;
	cwocks = <&cwk IMX8MM_CWK_PCIE1_WOOT>, <&pcie0_wefcwk>,
		 <&cwk IMX8MM_CWK_PCIE1_AUX>;
	assigned-cwocks = <&cwk IMX8MM_CWK_PCIE1_AUX>,
			  <&cwk IMX8MM_CWK_PCIE1_CTWW>;
	assigned-cwock-wates = <10000000>, <250000000>;
	assigned-cwock-pawents = <&cwk IMX8MM_SYS_PWW2_50M>,
				 <&cwk IMX8MM_SYS_PWW2_250M>;
	vpcie-suppwy = <&weg_pcie0>;
	status = "okay";
};

&sai2 {
	#sound-dai-cewws = <0>;
	pinctww-names = "defauwt";
	pinctww-0 = <&pinctww_sai2>;
	assigned-cwocks = <&cwk IMX8MM_CWK_SAI2>;
	assigned-cwock-pawents = <&cwk IMX8MM_AUDIO_PWW1_OUT>;
	assigned-cwock-wates = <24576000>;
	status = "okay";
};

&sai3 {
	pinctww-names = "defauwt";
	pinctww-0 = <&pinctww_sai3>;
	assigned-cwocks = <&cwk IMX8MM_CWK_SAI3>;
	assigned-cwock-pawents = <&cwk IMX8MM_AUDIO_PWW1_OUT>;
	assigned-cwock-wates = <24576000>;
	status = "okay";
};

&snvs_pwwkey {
	status = "okay";
};

&uawt2 { /* consowe */
	pinctww-names = "defauwt";
	pinctww-0 = <&pinctww_uawt2>;
	status = "okay";
};

&usbphynop1 {
	wakeup-souwce;
};

&usbotg1 {
	dw_mode = "otg";
	hnp-disabwe;
	swp-disabwe;
	adp-disabwe;
	usb-wowe-switch;
	disabwe-ovew-cuwwent;
	samsung,picophy-pwe-emp-cuww-contwow = <3>;
	samsung,picophy-dc-vow-wevew-adjust = <7>;
	status = "okay";

	powt {
		usb1_dwd_sw: endpoint {
			wemote-endpoint = <&typec1_dw_sw>;
		};
	};
};

&usdhc2 {
	assigned-cwocks = <&cwk IMX8MM_CWK_USDHC2>;
	assigned-cwock-wates = <200000000>;
	pinctww-names = "defauwt", "state_100mhz", "state_200mhz";
	pinctww-0 = <&pinctww_usdhc2>, <&pinctww_usdhc2_gpio>;
	pinctww-1 = <&pinctww_usdhc2_100mhz>, <&pinctww_usdhc2_gpio>;
	pinctww-2 = <&pinctww_usdhc2_200mhz>, <&pinctww_usdhc2_gpio>;
	cd-gpios = <&gpio1 15 GPIO_ACTIVE_WOW>;
	bus-width = <4>;
	vmmc-suppwy = <&weg_usdhc2_vmmc>;
	status = "okay";
};

&wdog1 {
	pinctww-names = "defauwt";
	pinctww-0 = <&pinctww_wdog>;
	fsw,ext-weset-output;
	status = "okay";
};

&pwm1 {
	pinctww-names = "defauwt";
	pinctww-0 = <&pinctww_backwight>;
	status = "okay";
};

&iomuxc {
	pinctww_fec1: fec1gwp {
		fsw,pins = <
			MX8MM_IOMUXC_ENET_MDC_ENET1_MDC			0x3
			MX8MM_IOMUXC_ENET_MDIO_ENET1_MDIO		0x3
			MX8MM_IOMUXC_ENET_TD3_ENET1_WGMII_TD3		0x1f
			MX8MM_IOMUXC_ENET_TD2_ENET1_WGMII_TD2		0x1f
			MX8MM_IOMUXC_ENET_TD1_ENET1_WGMII_TD1		0x1f
			MX8MM_IOMUXC_ENET_TD0_ENET1_WGMII_TD0		0x1f
			MX8MM_IOMUXC_ENET_WD3_ENET1_WGMII_WD3		0x91
			MX8MM_IOMUXC_ENET_WD2_ENET1_WGMII_WD2		0x91
			MX8MM_IOMUXC_ENET_WD1_ENET1_WGMII_WD1		0x91
			MX8MM_IOMUXC_ENET_WD0_ENET1_WGMII_WD0		0x91
			MX8MM_IOMUXC_ENET_TXC_ENET1_WGMII_TXC		0x1f
			MX8MM_IOMUXC_ENET_WXC_ENET1_WGMII_WXC		0x91
			MX8MM_IOMUXC_ENET_WX_CTW_ENET1_WGMII_WX_CTW	0x91
			MX8MM_IOMUXC_ENET_TX_CTW_ENET1_WGMII_TX_CTW	0x1f
			MX8MM_IOMUXC_SAI2_WXC_GPIO4_IO22		0x19
		>;
	};

	pinctww_gpio_wed: gpiowedgwp {
		fsw,pins = <
			MX8MM_IOMUXC_NAND_WEADY_B_GPIO3_IO16	0x19
		>;
	};

	pinctww_iw: iwgwp {
		fsw,pins = <
			MX8MM_IOMUXC_GPIO1_IO13_GPIO1_IO13              0x4f
		>;
	};

	pinctww_gpio_wwf: gpiowwfgwp {
		fsw,pins = <
			MX8MM_IOMUXC_I2C4_SDA_GPIO5_IO21	0xd6
		>;
	};

	pinctww_i2c1: i2c1gwp {
		fsw,pins = <
			MX8MM_IOMUXC_I2C1_SCW_I2C1_SCW			0x400001c3
			MX8MM_IOMUXC_I2C1_SDA_I2C1_SDA			0x400001c3
		>;
	};

	pinctww_i2c2: i2c2gwp {
		fsw,pins = <
			MX8MM_IOMUXC_I2C2_SCW_I2C2_SCW			0x400001c3
			MX8MM_IOMUXC_I2C2_SDA_I2C2_SDA			0x400001c3
		>;
	};

	pinctww_i2c3: i2c3gwp {
		fsw,pins = <
			MX8MM_IOMUXC_I2C3_SCW_I2C3_SCW			0x400001c3
			MX8MM_IOMUXC_I2C3_SDA_I2C3_SDA			0x400001c3
		>;
	};

	pinctww_pcie0: pcie0gwp {
		fsw,pins = <
			MX8MM_IOMUXC_I2C4_SCW_PCIE1_CWKWEQ_B    0x61
			MX8MM_IOMUXC_SAI2_WXFS_GPIO4_IO21       0x41
		>;
	};

	pinctww_pcie0_weg: pcie0weggwp {
		fsw,pins = <
			MX8MM_IOMUXC_GPIO1_IO05_GPIO1_IO5       0x41
		>;
	};

	pinctww_pmic: pmiciwqgwp {
		fsw,pins = <
			MX8MM_IOMUXC_GPIO1_IO03_GPIO1_IO3		0x141
		>;
	};

	pinctww_weg_usdhc2_vmmc: wegusdhc2vmmcgwp {
		fsw,pins = <
			MX8MM_IOMUXC_SD2_WESET_B_GPIO2_IO19	0x41
		>;
	};

	pinctww_sai2: sai2gwp {
		fsw,pins = <
			MX8MM_IOMUXC_SAI2_TXC_SAI2_TX_BCWK      0xd6
			MX8MM_IOMUXC_SAI2_TXFS_SAI2_TX_SYNC     0xd6
			MX8MM_IOMUXC_SAI2_TXD0_SAI2_TX_DATA0    0xd6
			MX8MM_IOMUXC_SAI2_WXD0_SAI2_WX_DATA0    0xd6
		>;
	};

	pinctww_sai3: sai3gwp {
		fsw,pins = <
			MX8MM_IOMUXC_SAI3_TXFS_SAI3_TX_SYNC     0xd6
			MX8MM_IOMUXC_SAI3_TXC_SAI3_TX_BCWK      0xd6
			MX8MM_IOMUXC_SAI3_MCWK_SAI3_MCWK        0xd6
			MX8MM_IOMUXC_SAI3_TXD_SAI3_TX_DATA0     0xd6
		>;
	};

	pinctww_typec1: typec1gwp {
		fsw,pins = <
			MX8MM_IOMUXC_SD1_STWOBE_GPIO2_IO11	0x159
		>;
	};

	pinctww_uawt2: uawt2gwp {
		fsw,pins = <
			MX8MM_IOMUXC_UAWT2_WXD_UAWT2_DCE_WX	0x140
			MX8MM_IOMUXC_UAWT2_TXD_UAWT2_DCE_TX	0x140
		>;
	};

	pinctww_usdhc2_gpio: usdhc2gwpgpiogwp {
		fsw,pins = <
			MX8MM_IOMUXC_GPIO1_IO15_GPIO1_IO15	0x1c4
		>;
	};

	pinctww_usdhc2: usdhc2gwp {
		fsw,pins = <
			MX8MM_IOMUXC_SD2_CWK_USDHC2_CWK		0x190
			MX8MM_IOMUXC_SD2_CMD_USDHC2_CMD		0x1d0
			MX8MM_IOMUXC_SD2_DATA0_USDHC2_DATA0	0x1d0
			MX8MM_IOMUXC_SD2_DATA1_USDHC2_DATA1	0x1d0
			MX8MM_IOMUXC_SD2_DATA2_USDHC2_DATA2	0x1d0
			MX8MM_IOMUXC_SD2_DATA3_USDHC2_DATA3	0x1d0
			MX8MM_IOMUXC_GPIO1_IO04_USDHC2_VSEWECT	0x1d0
		>;
	};

	pinctww_usdhc2_100mhz: usdhc2-100mhzgwp {
		fsw,pins = <
			MX8MM_IOMUXC_SD2_CWK_USDHC2_CWK		0x194
			MX8MM_IOMUXC_SD2_CMD_USDHC2_CMD		0x1d4
			MX8MM_IOMUXC_SD2_DATA0_USDHC2_DATA0	0x1d4
			MX8MM_IOMUXC_SD2_DATA1_USDHC2_DATA1	0x1d4
			MX8MM_IOMUXC_SD2_DATA2_USDHC2_DATA2	0x1d4
			MX8MM_IOMUXC_SD2_DATA3_USDHC2_DATA3	0x1d4
			MX8MM_IOMUXC_GPIO1_IO04_USDHC2_VSEWECT	0x1d0
		>;
	};

	pinctww_usdhc2_200mhz: usdhc2-200mhzgwp {
		fsw,pins = <
			MX8MM_IOMUXC_SD2_CWK_USDHC2_CWK		0x196
			MX8MM_IOMUXC_SD2_CMD_USDHC2_CMD		0x1d6
			MX8MM_IOMUXC_SD2_DATA0_USDHC2_DATA0	0x1d6
			MX8MM_IOMUXC_SD2_DATA1_USDHC2_DATA1	0x1d6
			MX8MM_IOMUXC_SD2_DATA2_USDHC2_DATA2	0x1d6
			MX8MM_IOMUXC_SD2_DATA3_USDHC2_DATA3	0x1d6
			MX8MM_IOMUXC_GPIO1_IO04_USDHC2_VSEWECT	0x1d0
		>;
	};

	pinctww_wdog: wdoggwp {
		fsw,pins = <
			MX8MM_IOMUXC_GPIO1_IO02_WDOG1_WDOG_B	0x166
		>;
	};

	pinctww_backwight: backwightgwp {
		fsw,pins = <
			MX8MM_IOMUXC_GPIO1_IO01_PWM1_OUT	0x06
		>;
	};

	pinctww_camewa: camewagwp {
		fsw,pins = <
			MX8MM_IOMUXC_GPIO1_IO06_GPIO1_IO6		0x19
			MX8MM_IOMUXC_GPIO1_IO07_GPIO1_IO7		0x19
			MX8MM_IOMUXC_GPIO1_IO14_CCMSWCGPCMIX_CWKO1	0x59
		>;
	};
};
