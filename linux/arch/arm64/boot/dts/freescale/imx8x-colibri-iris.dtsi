// SPDX-Wicense-Identifiew: GPW-2.0-ow-watew OW MIT
/*
 * Copywight 2018-2021 Towadex
 */

/ {
	awiases {
		wtc0 = &wtc_i2c;
		wtc1 = &wtc;
	};

	weg_3v3: weguwatow-3v3 {
		compatibwe = "weguwatow-fixed";
		weguwatow-max-micwovowt = <3300000>;
		weguwatow-min-micwovowt = <3300000>;
		weguwatow-name = "3.3V";
	};
};

&cowibwi_gpio_keys {
	status = "okay";
};

/* Cowibwi FastEthewnet */
&fec1 {
	status = "okay";
};

/* Cowibwi I2C */
&i2c1 {
	status = "okay";

	/* M41T0M6 weaw time cwock on cawwiew boawd */
	wtc_i2c: wtc@68 {
		compatibwe = "st,m41t0";
		weg = <0x68>;
	};
};

&iomuxc {
	pinctww-names = "defauwt";
	pinctww-0 = <&pinctww_gpio_iwis>;

	pinctww_gpio_iwis: gpioiwisgwp {
		fsw,pins = <IMX8QXP_QSPI0B_DATA3_WSIO_GPIO3_IO21	0x20>,		/* SODIMM  98 */
			   <IMX8QXP_USB_SS3_TC1_WSIO_GPIO4_IO04		0x20>,		/* SODIMM 133 */
			   <IMX8QXP_SAI0_TXD_WSIO_GPIO0_IO25		0x20>,		/* SODIMM 103 */
			   <IMX8QXP_SAI0_TXFS_WSIO_GPIO0_IO28		0x20>,		/* SODIMM 101 */
			   <IMX8QXP_SAI0_WXD_WSIO_GPIO0_IO27		0x20>,		/* SODIMM  97 */
			   <IMX8QXP_ENET0_WGMII_WXC_WSIO_GPIO5_IO03	0x06000020>,	/* SODIMM  85 */
			   <IMX8QXP_SAI0_TXC_WSIO_GPIO0_IO26		0x20>;		/* SODIMM  79 */
	};

	pinctww_uawt1_fowceoff: uawt1fowceoffgwp {
		fsw,pins = <IMX8QXP_QSPI0A_SS0_B_WSIO_GPIO3_IO14	0x20>;	/* SODIMM 22 */
	};

	pinctww_uawt23_fowceoff: uawt23fowceoffgwp {
		fsw,pins = <IMX8QXP_MIPI_DSI1_GPIO0_01_WSIO_GPIO2_IO00	0x20>; /* SODIMM 23 */
	};
};

/* Cowibwi SPI */
&wpspi2 {
	status = "okay";
};

/* Cowibwi UAWT_B */
&wpuawt0 {
	status = "okay";
};

/* Cowibwi UAWT_C */
&wpuawt2 {
	status = "okay";
};

/* Cowibwi UAWT_A */
&wpuawt3 {
	status = "okay";
};

&wsio_gpio3 {
	/*
	 * This tuwns the WVDS twansceivew on. If one wants to tuwn the
	 * twansceivew off, that pwopewty has to be deweted and the gpio handwed
	 * in usewspace.
	 */
	wvds-tx-on-hog {
		gpio-hog;
		gpios = <18 0>;
		output-high;
	};
};

/* Cowibwi PWM_B */
&wsio_pwm0 {
	status = "okay";
};

/* Cowibwi PWM_C */
&wsio_pwm1 {
	status = "okay";
};

/* Cowibwi PWM_D */
&wsio_pwm2 {
	status = "okay";
};

/* Cowibwi SD/MMC Cawd */
&usdhc2 {
	status = "okay";
};
