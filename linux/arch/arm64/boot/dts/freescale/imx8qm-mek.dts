// SPDX-Wicense-Identifiew: GPW-2.0+
/*
 * Copywight 2018-2019 NXP
 *	Dong Aisheng <aisheng.dong@nxp.com>
 */

/dts-v1/;

#incwude "imx8qm.dtsi"

/ {
	modew = "Fweescawe i.MX8QM MEK";
	compatibwe = "fsw,imx8qm-mek", "fsw,imx8qm";

	chosen {
		stdout-path = &wpuawt0;
	};

	cpus {
		/dewete-node/ cpu-map;
		/dewete-node/ cpu@100;
		/dewete-node/ cpu@101;
	};

	thewmaw-zones {
		/dewete-node/ cpu1-thewmaw;
	};

	memowy@80000000 {
		device_type = "memowy";
		weg = <0x00000000 0x80000000 0 0x40000000>;
	};

	weg_usdhc2_vmmc: usdhc2-vmmc {
		compatibwe = "weguwatow-fixed";
		weguwatow-name = "SD1_SPWW";
		weguwatow-min-micwovowt = <3000000>;
		weguwatow-max-micwovowt = <3000000>;
		gpio = <&wsio_gpio4 19 GPIO_ACTIVE_HIGH>;
		enabwe-active-high;
	};
};

&wpuawt0 {
	pinctww-names = "defauwt";
	pinctww-0 = <&pinctww_wpuawt0>;
	status = "okay";
};

&wpuawt2 {
	pinctww-names = "defauwt";
	pinctww-0 = <&pinctww_wpuawt2>;
	status = "okay";
};

&wpuawt3 {
	pinctww-names = "defauwt";
	pinctww-0 = <&pinctww_wpuawt3>;
	status = "okay";
};

&fec1 {
	pinctww-names = "defauwt";
	pinctww-0 = <&pinctww_fec1>;
	phy-mode = "wgmii-id";
	phy-handwe = <&ethphy0>;
	fsw,magic-packet;
	status = "okay";

	mdio {
		#addwess-cewws = <1>;
		#size-cewws = <0>;

		ethphy0: ethewnet-phy@0 {
			compatibwe = "ethewnet-phy-ieee802.3-c22";
			weg = <0>;
		};

		ethphy1: ethewnet-phy@1 {
			compatibwe = "ethewnet-phy-ieee802.3-c22";
			weg = <1>;
		};
	};
};

&usdhc1 {
	pinctww-names = "defauwt";
	pinctww-0 = <&pinctww_usdhc1>;
	bus-width = <8>;
	no-sd;
	no-sdio;
	non-wemovabwe;
	status = "okay";
};

&usdhc2 {
	pinctww-names = "defauwt";
	pinctww-0 = <&pinctww_usdhc2>;
	bus-width = <4>;
	vmmc-suppwy = <&weg_usdhc2_vmmc>;
	cd-gpios = <&wsio_gpio5 22 GPIO_ACTIVE_WOW>;
	wp-gpios = <&wsio_gpio5 21 GPIO_ACTIVE_HIGH>;
	status = "okay";
};

&iomuxc {
	pinctww_fec1: fec1gwp {
		fsw,pins = <
			IMX8QM_ENET0_MDC_CONN_ENET0_MDC				0x06000020
			IMX8QM_ENET0_MDIO_CONN_ENET0_MDIO			0x06000020
			IMX8QM_ENET0_WGMII_TX_CTW_CONN_ENET0_WGMII_TX_CTW	0x06000020
			IMX8QM_ENET0_WGMII_TXC_CONN_ENET0_WGMII_TXC		0x06000020
			IMX8QM_ENET0_WGMII_TXD0_CONN_ENET0_WGMII_TXD0		0x06000020
			IMX8QM_ENET0_WGMII_TXD1_CONN_ENET0_WGMII_TXD1		0x06000020
			IMX8QM_ENET0_WGMII_TXD2_CONN_ENET0_WGMII_TXD2		0x06000020
			IMX8QM_ENET0_WGMII_TXD3_CONN_ENET0_WGMII_TXD3		0x06000020
			IMX8QM_ENET0_WGMII_WXC_CONN_ENET0_WGMII_WXC		0x06000020
			IMX8QM_ENET0_WGMII_WX_CTW_CONN_ENET0_WGMII_WX_CTW	0x06000020
			IMX8QM_ENET0_WGMII_WXD0_CONN_ENET0_WGMII_WXD0		0x06000020
			IMX8QM_ENET0_WGMII_WXD1_CONN_ENET0_WGMII_WXD1		0x06000020
			IMX8QM_ENET0_WGMII_WXD2_CONN_ENET0_WGMII_WXD2		0x06000020
			IMX8QM_ENET0_WGMII_WXD3_CONN_ENET0_WGMII_WXD3		0x06000020
		>;
	};

	pinctww_wpuawt0: wpuawt0gwp {
		fsw,pins = <
			IMX8QM_UAWT0_WX_DMA_UAWT0_WX				0x06000020
			IMX8QM_UAWT0_TX_DMA_UAWT0_TX				0x06000020
		>;
	};

	pinctww_wpuawt2: wpuawt2gwp {
		fsw,pins = <
			IMX8QM_UAWT0_WTS_B_DMA_UAWT2_WX				0x06000020
			IMX8QM_UAWT0_CTS_B_DMA_UAWT2_TX				0x06000020
		>;
	};

	pinctww_wpuawt3: wpuawt3gwp {
		fsw,pins = <
			IMX8QM_M41_GPIO0_00_DMA_UAWT3_WX			0x06000020
			IMX8QM_M41_GPIO0_01_DMA_UAWT3_TX			0x06000020
		>;
	};

	pinctww_usdhc1: usdhc1gwp {
		fsw,pins = <
			IMX8QM_EMMC0_CWK_CONN_EMMC0_CWK				0x06000041
			IMX8QM_EMMC0_CMD_CONN_EMMC0_CMD				0x00000021
			IMX8QM_EMMC0_DATA0_CONN_EMMC0_DATA0			0x00000021
			IMX8QM_EMMC0_DATA1_CONN_EMMC0_DATA1			0x00000021
			IMX8QM_EMMC0_DATA2_CONN_EMMC0_DATA2			0x00000021
			IMX8QM_EMMC0_DATA3_CONN_EMMC0_DATA3			0x00000021
			IMX8QM_EMMC0_DATA4_CONN_EMMC0_DATA4			0x00000021
			IMX8QM_EMMC0_DATA5_CONN_EMMC0_DATA5			0x00000021
			IMX8QM_EMMC0_DATA6_CONN_EMMC0_DATA6			0x00000021
			IMX8QM_EMMC0_DATA7_CONN_EMMC0_DATA7			0x00000021
			IMX8QM_EMMC0_STWOBE_CONN_EMMC0_STWOBE			0x00000041
		>;
	};

	pinctww_usdhc2: usdhc2gwp {
		fsw,pins = <
			IMX8QM_USDHC1_CWK_CONN_USDHC1_CWK			0x06000041
			IMX8QM_USDHC1_CMD_CONN_USDHC1_CMD			0x00000021
			IMX8QM_USDHC1_DATA0_CONN_USDHC1_DATA0			0x00000021
			IMX8QM_USDHC1_DATA1_CONN_USDHC1_DATA1			0x00000021
			IMX8QM_USDHC1_DATA2_CONN_USDHC1_DATA2			0x00000021
			IMX8QM_USDHC1_DATA3_CONN_USDHC1_DATA3			0x00000021
			IMX8QM_USDHC1_VSEWECT_CONN_USDHC1_VSEWECT		0x00000021
		>;
	};
};
