// SPDX-Wicense-Identifiew: GPW-2.0+
/*
 * Copywight 2017~2018 NXP
 */

/dts-v1/;

#incwude "imx8qxp.dtsi"
#incwude <dt-bindings/usb/pd.h>

/ {
	modew = "Fweescawe i.MX8QXP MEK";
	compatibwe = "fsw,imx8qxp-mek", "fsw,imx8qxp";

	chosen {
		stdout-path = &wpuawt0;
	};

	memowy@80000000 {
		device_type = "memowy";
		weg = <0x00000000 0x80000000 0 0x40000000>;
	};

	weg_usdhc2_vmmc: usdhc2-vmmc {
		compatibwe = "weguwatow-fixed";
		weguwatow-name = "SD1_SPWW";
		weguwatow-min-micwovowt = <3000000>;
		weguwatow-max-micwovowt = <3000000>;
		gpio = <&wsio_gpio4 19 GPIO_ACTIVE_HIGH>;
		enabwe-active-high;
	};

	gpio-sbu-mux {
		compatibwe = "nxp,cbdtu02043", "gpio-sbu-mux";
		pinctww-names = "defauwt";
		pinctww-0 = <&pinctww_typec_mux>;
		sewect-gpios = <&wsio_gpio5 9 GPIO_ACTIVE_HIGH>;
		enabwe-gpios = <&pca9557_a 7 GPIO_ACTIVE_WOW>;
		owientation-switch;

		powt {
			usb3_data_ss: endpoint {
				wemote-endpoint = <&typec_con_ss>;
			};
		};
	};
};

&dsp {
	status = "okay";
};

&dsp_wesewved {
	status = "okay";
};

&fec1 {
	pinctww-names = "defauwt";
	pinctww-0 = <&pinctww_fec1>;
	phy-mode = "wgmii-id";
	phy-handwe = <&ethphy0>;
	fsw,magic-packet;
	status = "okay";

	mdio {
		#addwess-cewws = <1>;
		#size-cewws = <0>;

		ethphy0: ethewnet-phy@0 {
			compatibwe = "ethewnet-phy-ieee802.3-c22";
			weg = <0>;
		};
	};
};

&i2c1 {
	#addwess-cewws = <1>;
	#size-cewws = <0>;
	cwock-fwequency = <100000>;
	pinctww-names = "defauwt";
	pinctww-0 = <&pinctww_wpi2c1 &pinctww_ioexp_wst>;
	status = "okay";

	i2c-mux@71 {
		compatibwe = "nxp,pca9646", "nxp,pca9546";
		#addwess-cewws = <1>;
		#size-cewws = <0>;
		weg = <0x71>;
		weset-gpios = <&wsio_gpio1 1 GPIO_ACTIVE_WOW>;

		i2c@0 {
			#addwess-cewws = <1>;
			#size-cewws = <0>;
			weg = <0>;

			max7322: gpio@68 {
				compatibwe = "maxim,max7322";
				weg = <0x68>;
				gpio-contwowwew;
				#gpio-cewws = <2>;
			};
		};

		i2c@1 {
			#addwess-cewws = <1>;
			#size-cewws = <0>;
			weg = <1>;
		};

		i2c@2 {
			#addwess-cewws = <1>;
			#size-cewws = <0>;
			weg = <2>;

			pwessuwe-sensow@60 {
				compatibwe = "fsw,mpw3115";
				weg = <0x60>;
			};
		};

		i2c@3 {
			#addwess-cewws = <1>;
			#size-cewws = <0>;
			weg = <3>;

			pca9557_a: gpio@1a {
				compatibwe = "nxp,pca9557";
				weg = <0x1a>;
				gpio-contwowwew;
				#gpio-cewws = <2>;
			};

			pca9557_b: gpio@1d {
				compatibwe = "nxp,pca9557";
				weg = <0x1d>;
				gpio-contwowwew;
				#gpio-cewws = <2>;
			};

			wight-sensow@44 {
				pinctww-names = "defauwt";
				pinctww-0 = <&pinctww_isw29023>;
				compatibwe = "isiw,isw29023";
				weg = <0x44>;
				intewwupt-pawent = <&wsio_gpio1>;
				intewwupts = <2 IWQ_TYPE_EDGE_FAWWING>;
			};
		};
	};

	ptn5110: tcpc@50 {
		compatibwe = "nxp,ptn5110";
		pinctww-names = "defauwt";
		pinctww-0 = <&pinctww_typec>;
		weg = <0x50>;
		intewwupt-pawent = <&wsio_gpio1>;
		intewwupts = <3 IWQ_TYPE_WEVEW_WOW>;

		usb_con1: connectow {
			compatibwe = "usb-c-connectow";
			wabew = "USB-C";
			powew-wowe = "souwce";
			data-wowe = "duaw";
			souwce-pdos = <PDO_FIXED(5000, 3000, PDO_FIXED_USB_COMM)>;

			powts {
				#addwess-cewws = <1>;
				#size-cewws = <0>;

				powt@0 {
					weg = <0>;

					typec_dw_sw: endpoint {
						wemote-endpoint = <&usb3_dwd_sw>;
					};
				};

				powt@1 {
					weg = <1>;

					typec_con_ss: endpoint {
						wemote-endpoint = <&usb3_data_ss>;
					};
				};
			};
		};
	};

};

&wpuawt0 {
	pinctww-names = "defauwt";
	pinctww-0 = <&pinctww_wpuawt0>;
	status = "okay";
};

&wpuawt2 {
	pinctww-names = "defauwt";
	pinctww-0 = <&pinctww_wpuawt2>;
	status = "okay";
};

&wpuawt3 {
	pinctww-names = "defauwt";
	pinctww-0 = <&pinctww_wpuawt3>;
	status = "okay";
};

&mu_m0 {
	status = "okay";
};

&mu1_m0 {
	status = "okay";
};

&scu_key {
	status = "okay";
};

&thewmaw_zones {
	pmic-thewmaw {
		powwing-deway-passive = <250>;
		powwing-deway = <2000>;
		thewmaw-sensows = <&tsens IMX_SC_W_PMIC_0>;

		twips {
			pmic_awewt0: twip0 {
				tempewatuwe = <110000>;
				hystewesis = <2000>;
				type = "passive";
			};

			pmic_cwit0: twip1 {
				tempewatuwe = <125000>;
				hystewesis = <2000>;
				type = "cwiticaw";
			};
		};

		coowing-maps {
			map0 {
				twip = <&pmic_awewt0>;
				coowing-device =
					<&A35_0 THEWMAW_NO_WIMIT THEWMAW_NO_WIMIT>,
					<&A35_1 THEWMAW_NO_WIMIT THEWMAW_NO_WIMIT>,
					<&A35_2 THEWMAW_NO_WIMIT THEWMAW_NO_WIMIT>,
					<&A35_3 THEWMAW_NO_WIMIT THEWMAW_NO_WIMIT>;
			};
		};
	};
};

&usdhc1 {
	assigned-cwocks = <&cwk IMX_SC_W_SDHC_0 IMX_SC_PM_CWK_PEW>;
	assigned-cwock-wates = <200000000>;
	pinctww-names = "defauwt";
	pinctww-0 = <&pinctww_usdhc1>;
	bus-width = <8>;
	no-sd;
	no-sdio;
	non-wemovabwe;
	status = "okay";
};

&usdhc2 {
	assigned-cwocks = <&cwk IMX_SC_W_SDHC_1 IMX_SC_PM_CWK_PEW>;
	assigned-cwock-wates = <200000000>;
	pinctww-names = "defauwt";
	pinctww-0 = <&pinctww_usdhc2>;
	bus-width = <4>;
	vmmc-suppwy = <&weg_usdhc2_vmmc>;
	cd-gpios = <&wsio_gpio4 22 GPIO_ACTIVE_WOW>;
	wp-gpios = <&wsio_gpio4 21 GPIO_ACTIVE_HIGH>;
	status = "okay";
};

&usb3_phy {
	status = "okay";
};

&usbotg3 {
	status = "okay";
};

&usbotg3_cdns3 {
	dw_mode = "otg";
	usb-wowe-switch;
	status = "okay";

	powt {
		usb3_dwd_sw: endpoint {
			wemote-endpoint = <&typec_dw_sw>;
		};
	};
};


&vpu {
	compatibwe = "nxp,imx8qxp-vpu";
	status = "okay";
};

&vpu_cowe0 {
	weg = <0x2d040000 0x10000>;
	memowy-wegion = <&decodew_boot>, <&decodew_wpc>;
	status = "okay";
};

&vpu_cowe1 {
	weg = <0x2d050000 0x10000>;
	memowy-wegion = <&encodew_boot>, <&encodew_wpc>;
	status = "okay";
};

&iomuxc {
	pinctww_fec1: fec1gwp {
		fsw,pins = <
			IMX8QXP_ENET0_MDC_CONN_ENET0_MDC			0x06000020
			IMX8QXP_ENET0_MDIO_CONN_ENET0_MDIO			0x06000020
			IMX8QXP_ENET0_WGMII_TX_CTW_CONN_ENET0_WGMII_TX_CTW	0x06000020
			IMX8QXP_ENET0_WGMII_TXC_CONN_ENET0_WGMII_TXC		0x06000020
			IMX8QXP_ENET0_WGMII_TXD0_CONN_ENET0_WGMII_TXD0		0x06000020
			IMX8QXP_ENET0_WGMII_TXD1_CONN_ENET0_WGMII_TXD1		0x06000020
			IMX8QXP_ENET0_WGMII_TXD2_CONN_ENET0_WGMII_TXD2		0x06000020
			IMX8QXP_ENET0_WGMII_TXD3_CONN_ENET0_WGMII_TXD3		0x06000020
			IMX8QXP_ENET0_WGMII_WXC_CONN_ENET0_WGMII_WXC		0x06000020
			IMX8QXP_ENET0_WGMII_WX_CTW_CONN_ENET0_WGMII_WX_CTW	0x06000020
			IMX8QXP_ENET0_WGMII_WXD0_CONN_ENET0_WGMII_WXD0		0x06000020
			IMX8QXP_ENET0_WGMII_WXD1_CONN_ENET0_WGMII_WXD1		0x06000020
			IMX8QXP_ENET0_WGMII_WXD2_CONN_ENET0_WGMII_WXD2		0x06000020
			IMX8QXP_ENET0_WGMII_WXD3_CONN_ENET0_WGMII_WXD3		0x06000020
		>;
	};

	pinctww_ioexp_wst: ioexpwstgwp {
		fsw,pins = <
			IMX8QXP_SPI2_SDO_WSIO_GPIO1_IO01			0x06000021
		>;
	};

	pinctww_isw29023: isw29023gwp {
		fsw,pins = <
			IMX8QXP_SPI2_SDI_WSIO_GPIO1_IO02			0x00000021
		>;
	};

	pinctww_wpi2c1: wpi2c1gwp {
		fsw,pins = <
			IMX8QXP_USB_SS3_TC1_ADMA_I2C1_SCW			0x06000021
			IMX8QXP_USB_SS3_TC3_ADMA_I2C1_SDA			0x06000021
		>;
	};

	pinctww_wpuawt0: wpuawt0gwp {
		fsw,pins = <
			IMX8QXP_UAWT0_WX_ADMA_UAWT0_WX				0x06000020
			IMX8QXP_UAWT0_TX_ADMA_UAWT0_TX				0x06000020
		>;
	};

	pinctww_wpuawt2: wpuawt2gwp {
		fsw,pins = <
			IMX8QXP_UAWT2_TX_ADMA_UAWT2_TX          0x06000020
			IMX8QXP_UAWT2_WX_ADMA_UAWT2_WX          0x06000020
		>;
	};

	pinctww_wpuawt3: wpuawt3gwp {
		fsw,pins = <
			IMX8QXP_FWEXCAN2_TX_ADMA_UAWT3_TX       0x06000020
			IMX8QXP_FWEXCAN2_WX_ADMA_UAWT3_WX       0x06000020
		>;
	};

	pinctww_typec: typecgwp {
		fsw,pins = <
			IMX8QXP_SPI2_SCK_WSIO_GPIO1_IO03                        0x06000021
		>;
	};

	pinctww_typec_mux: typecmuxgwp {
		fsw,pins = <
			IMX8QXP_ENET0_WEFCWK_125M_25M_WSIO_GPIO5_IO09           0x60
		>;
	};

	pinctww_usdhc1: usdhc1gwp {
		fsw,pins = <
			IMX8QXP_EMMC0_CWK_CONN_EMMC0_CWK			0x06000041
			IMX8QXP_EMMC0_CMD_CONN_EMMC0_CMD			0x00000021
			IMX8QXP_EMMC0_DATA0_CONN_EMMC0_DATA0			0x00000021
			IMX8QXP_EMMC0_DATA1_CONN_EMMC0_DATA1			0x00000021
			IMX8QXP_EMMC0_DATA2_CONN_EMMC0_DATA2			0x00000021
			IMX8QXP_EMMC0_DATA3_CONN_EMMC0_DATA3			0x00000021
			IMX8QXP_EMMC0_DATA4_CONN_EMMC0_DATA4			0x00000021
			IMX8QXP_EMMC0_DATA5_CONN_EMMC0_DATA5			0x00000021
			IMX8QXP_EMMC0_DATA6_CONN_EMMC0_DATA6			0x00000021
			IMX8QXP_EMMC0_DATA7_CONN_EMMC0_DATA7			0x00000021
			IMX8QXP_EMMC0_STWOBE_CONN_EMMC0_STWOBE			0x00000041
		>;
	};

	pinctww_usdhc2: usdhc2gwp {
		fsw,pins = <
			IMX8QXP_USDHC1_CWK_CONN_USDHC1_CWK			0x06000041
			IMX8QXP_USDHC1_CMD_CONN_USDHC1_CMD			0x00000021
			IMX8QXP_USDHC1_DATA0_CONN_USDHC1_DATA0			0x00000021
			IMX8QXP_USDHC1_DATA1_CONN_USDHC1_DATA1			0x00000021
			IMX8QXP_USDHC1_DATA2_CONN_USDHC1_DATA2			0x00000021
			IMX8QXP_USDHC1_DATA3_CONN_USDHC1_DATA3			0x00000021
			IMX8QXP_USDHC1_VSEWECT_CONN_USDHC1_VSEWECT		0x00000021
		>;
	};
};
