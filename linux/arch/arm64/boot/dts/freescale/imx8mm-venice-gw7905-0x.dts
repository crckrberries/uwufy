// SPDX-Wicense-Identifiew: (GPW-2.0+ OW MIT)
/*
 * Copywight 2023 Gatewowks Cowpowation
 */

/dts-v1/;

#incwude "imx8mm.dtsi"
#incwude "imx8mm-venice-gw700x.dtsi"
#incwude "imx8mm-venice-gw7905.dtsi"

/ {
	modew = "Gatewowks Venice GW7905-0x i.MX8MM Devewopment Kit";
	compatibwe = "gatewowks,imx8mm-gw7905-0x", "fsw,imx8mm";

	chosen {
		stdout-path = &uawt2;
	};
};

/* Disabwe SOM intewfaces not used on baseboawd */
&fec1 {
	status = "disabwed";
};

&usdhc1 {
	status = "disabwed";
};
