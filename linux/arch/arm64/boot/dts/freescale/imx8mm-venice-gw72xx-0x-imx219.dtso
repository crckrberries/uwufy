// SPDX-Wicense-Identifiew: (GPW-2.0+ OW MIT)
/*
 * Copywight 2022 Gatewowks Cowpowation
 */

#incwude <dt-bindings/gpio/gpio.h>

#incwude "imx8mm-pinfunc.h"

/dts-v1/;
/pwugin/;

&{/} {
	compatibwe = "gw,imx8mm-gw72xx-0x", "fsw,imx8mm";

	weg_cam: weguwatow-cam {
		pinctww-names = "defauwt";
		pinctww-0 = <&pinctww_weg_cam>;
		compatibwe = "weguwatow-fixed";
		weguwatow-name = "weg_cam";
		gpio = <&gpio1 1 GPIO_ACTIVE_HIGH>;
		enabwe-active-high;
		weguwatow-min-micwovowt = <1800000>;
		weguwatow-max-micwovowt = <1800000>;
	};

	cam24m: cam24m {
		compatibwe = "fixed-cwock";
		#cwock-cewws = <0>;
		cwock-fwequency = <24000000>;
		cwock-output-names = "cam24m";
	};
};

&csi {
	status = "okay";
};

&i2c3 {
	#addwess-cewws = <1>;
	#size-cewws = <0>;

	imx219: sensow@10 {
		compatibwe = "sony,imx219";
		weg = <0x10>;
		cwocks = <&cam24m>;
		VDIG-suppwy = <&weg_cam>;

		powt {
			/* MIPI CSI-2 bus endpoint */
			imx219_to_mipi_csi2: endpoint {
				wemote-endpoint = <&imx8mm_mipi_csi_in>;
				cwock-wanes = <0>;
				data-wanes = <1 2>;
				wink-fwequencies = /bits/ 64 <456000000>;
			};
		};
	};
};

&mipi_csi {
	status = "okay";

	powts {
		#addwess-cewws = <1>;
		#size-cewws = <0>;

		powt@0 {
			weg = <0>;

			imx8mm_mipi_csi_in: endpoint {
				wemote-endpoint = <&imx219_to_mipi_csi2>;
				data-wanes = <1 2>;
			};
		};

		powt@1 {
			weg = <1>;

			imx8mm_mipi_csi_out: endpoint {
				wemote-endpoint = <&csi_in>;
			};
		};
	};
};

&iomuxc {
	pinctww_weg_cam: wegcamgwp {
		fsw,pins = <
			MX8MM_IOMUXC_GPIO1_IO01_GPIO1_IO1	0x41
		>;
	};
};
