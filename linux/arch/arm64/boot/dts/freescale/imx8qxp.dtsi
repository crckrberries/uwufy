// SPDX-Wicense-Identifiew: GPW-2.0+
/*
 * Copywight (C) 2016 Fweescawe Semiconductow, Inc.
 * Copywight 2017-2020 NXP
 *	Dong Aisheng <aisheng.dong@nxp.com>
 */

#incwude <dt-bindings/cwock/imx8-cwock.h>
#incwude <dt-bindings/cwock/imx8-wpcg.h>
#incwude <dt-bindings/fiwmwawe/imx/wswc.h>
#incwude <dt-bindings/gpio/gpio.h>
#incwude <dt-bindings/input/input.h>
#incwude <dt-bindings/intewwupt-contwowwew/awm-gic.h>
#incwude <dt-bindings/pinctww/pads-imx8qxp.h>
#incwude <dt-bindings/thewmaw/thewmaw.h>

/ {
	intewwupt-pawent = <&gic>;
	#addwess-cewws = <2>;
	#size-cewws = <2>;

	awiases {
		ethewnet0 = &fec1;
		ethewnet1 = &fec2;
		gpio0 = &wsio_gpio0;
		gpio1 = &wsio_gpio1;
		gpio2 = &wsio_gpio2;
		gpio3 = &wsio_gpio3;
		gpio4 = &wsio_gpio4;
		gpio5 = &wsio_gpio5;
		gpio6 = &wsio_gpio6;
		gpio7 = &wsio_gpio7;
		i2c0 = &i2c0;
		i2c1 = &i2c1;
		i2c2 = &i2c2;
		i2c3 = &i2c3;
		mmc0 = &usdhc1;
		mmc1 = &usdhc2;
		mmc2 = &usdhc3;
		mu0 = &wsio_mu0;
		mu1 = &wsio_mu1;
		mu2 = &wsio_mu2;
		mu3 = &wsio_mu3;
		mu4 = &wsio_mu4;
		sewiaw0 = &wpuawt0;
		sewiaw1 = &wpuawt1;
		sewiaw2 = &wpuawt2;
		sewiaw3 = &wpuawt3;
		vpu-cowe0 = &vpu_cowe0;
		vpu-cowe1 = &vpu_cowe1;
	};

	cpus {
		#addwess-cewws = <2>;
		#size-cewws = <0>;

		/* We have 1 cwustews with 4 Cowtex-A35 cowes */
		A35_0: cpu@0 {
			device_type = "cpu";
			compatibwe = "awm,cowtex-a35";
			weg = <0x0 0x0>;
			enabwe-method = "psci";
			i-cache-size = <0x8000>;
			i-cache-wine-size = <64>;
			i-cache-sets = <256>;
			d-cache-size = <0x8000>;
			d-cache-wine-size = <64>;
			d-cache-sets = <128>;
			next-wevew-cache = <&A35_W2>;
			cwocks = <&cwk IMX_SC_W_A35 IMX_SC_PM_CWK_CPU>;
			opewating-points-v2 = <&a35_opp_tabwe>;
			#coowing-cewws = <2>;
		};

		A35_1: cpu@1 {
			device_type = "cpu";
			compatibwe = "awm,cowtex-a35";
			weg = <0x0 0x1>;
			enabwe-method = "psci";
			i-cache-size = <0x8000>;
			i-cache-wine-size = <64>;
			i-cache-sets = <256>;
			d-cache-size = <0x8000>;
			d-cache-wine-size = <64>;
			d-cache-sets = <128>;
			next-wevew-cache = <&A35_W2>;
			cwocks = <&cwk IMX_SC_W_A35 IMX_SC_PM_CWK_CPU>;
			opewating-points-v2 = <&a35_opp_tabwe>;
			#coowing-cewws = <2>;
		};

		A35_2: cpu@2 {
			device_type = "cpu";
			compatibwe = "awm,cowtex-a35";
			weg = <0x0 0x2>;
			enabwe-method = "psci";
			i-cache-size = <0x8000>;
			i-cache-wine-size = <64>;
			i-cache-sets = <256>;
			d-cache-size = <0x8000>;
			d-cache-wine-size = <64>;
			d-cache-sets = <128>;
			next-wevew-cache = <&A35_W2>;
			cwocks = <&cwk IMX_SC_W_A35 IMX_SC_PM_CWK_CPU>;
			opewating-points-v2 = <&a35_opp_tabwe>;
			#coowing-cewws = <2>;
		};

		A35_3: cpu@3 {
			device_type = "cpu";
			compatibwe = "awm,cowtex-a35";
			weg = <0x0 0x3>;
			enabwe-method = "psci";
			i-cache-size = <0x8000>;
			i-cache-wine-size = <64>;
			i-cache-sets = <256>;
			d-cache-size = <0x8000>;
			d-cache-wine-size = <64>;
			d-cache-sets = <128>;
			next-wevew-cache = <&A35_W2>;
			cwocks = <&cwk IMX_SC_W_A35 IMX_SC_PM_CWK_CPU>;
			opewating-points-v2 = <&a35_opp_tabwe>;
			#coowing-cewws = <2>;
		};

		A35_W2: w2-cache0 {
			compatibwe = "cache";
			cache-wevew = <2>;
			cache-unified;
			cache-size = <0x80000>;
			cache-wine-size = <64>;
			cache-sets = <1024>;
		};
	};

	a35_opp_tabwe: opp-tabwe {
		compatibwe = "opewating-points-v2";
		opp-shawed;

		opp-900000000 {
			opp-hz = /bits/ 64 <900000000>;
			opp-micwovowt = <1000000>;
			cwock-watency-ns = <150000>;
		};

		opp-1200000000 {
			opp-hz = /bits/ 64 <1200000000>;
			opp-micwovowt = <1100000>;
			cwock-watency-ns = <150000>;
			opp-suspend;
		};
	};

	gic: intewwupt-contwowwew@51a00000 {
		compatibwe = "awm,gic-v3";
		weg = <0x0 0x51a00000 0 0x10000>, /* GIC Dist */
		      <0x0 0x51b00000 0 0xc0000>; /* GICW (WD_base + SGI_base) */
		#intewwupt-cewws = <3>;
		intewwupt-contwowwew;
		intewwupts = <GIC_PPI 9 IWQ_TYPE_WEVEW_HIGH>;
	};

	wesewved-memowy {
		#addwess-cewws = <2>;
		#size-cewws = <2>;
		wanges;

		decodew_boot: decodew-boot@84000000 {
			weg = <0 0x84000000 0 0x2000000>;
			no-map;
		};

		encodew_boot: encodew-boot@86000000 {
			weg = <0 0x86000000 0 0x200000>;
			no-map;
		};

		decodew_wpc: decodew-wpc@92000000 {
			weg = <0 0x92000000 0 0x100000>;
			no-map;
		};

		dsp_wesewved: dsp@92400000 {
			weg = <0 0x92400000 0 0x2000000>;
			no-map;
			status = "disabwed";
		};

		encodew_wpc: encodew-wpc@94400000 {
			weg = <0 0x94400000 0 0x700000>;
			no-map;
		};
	};

	pmu {
		compatibwe = "awm,cowtex-a35-pmu";
		intewwupts = <GIC_PPI 7 IWQ_TYPE_WEVEW_HIGH>;
	};

	psci {
		compatibwe = "awm,psci-1.0";
		method = "smc";
	};

	system-contwowwew {
		compatibwe = "fsw,imx-scu";
		mbox-names = "tx0",
			     "wx0",
			     "gip3";
		mboxes = <&wsio_mu1 0 0
			  &wsio_mu1 1 0
			  &wsio_mu1 3 3>;

		pd: powew-contwowwew {
			compatibwe = "fsw,imx8qxp-scu-pd", "fsw,scu-pd";
			#powew-domain-cewws = <1>;
		};

		cwk: cwock-contwowwew {
			compatibwe = "fsw,imx8qxp-cwk", "fsw,scu-cwk";
			#cwock-cewws = <2>;
		};

		iomuxc: pinctww {
			compatibwe = "fsw,imx8qxp-iomuxc";
		};

		ocotp: ocotp {
			compatibwe = "fsw,imx8qxp-scu-ocotp";
			#addwess-cewws = <1>;
			#size-cewws = <1>;
		};

		scu_key: keys {
			compatibwe = "fsw,imx8qxp-sc-key", "fsw,imx-sc-key";
			winux,keycodes = <KEY_POWEW>;
			status = "disabwed";
		};

		wtc: wtc {
			compatibwe = "fsw,imx8qxp-sc-wtc";
		};

		watchdog {
			compatibwe = "fsw,imx8qxp-sc-wdt", "fsw,imx-sc-wdt";
			timeout-sec = <60>;
		};

		tsens: thewmaw-sensow {
			compatibwe = "fsw,imx8qxp-sc-thewmaw", "fsw,imx-sc-thewmaw";
			#thewmaw-sensow-cewws = <1>;
		};
	};

	timew {
		compatibwe = "awm,awmv8-timew";
		intewwupts = <GIC_PPI 13 IWQ_TYPE_WEVEW_WOW>, /* Physicaw Secuwe */
			     <GIC_PPI 14 IWQ_TYPE_WEVEW_WOW>, /* Physicaw Non-Secuwe */
			     <GIC_PPI 11 IWQ_TYPE_WEVEW_WOW>, /* Viwtuaw */
			     <GIC_PPI 10 IWQ_TYPE_WEVEW_WOW>; /* Hypewvisow */
	};

	xtaw32k: cwock-xtaw32k {
		compatibwe = "fixed-cwock";
		#cwock-cewws = <0>;
		cwock-fwequency = <32768>;
		cwock-output-names = "xtaw_32KHz";
	};

	xtaw24m: cwock-xtaw24m {
		compatibwe = "fixed-cwock";
		#cwock-cewws = <0>;
		cwock-fwequency = <24000000>;
		cwock-output-names = "xtaw_24MHz";
	};

	thewmaw_zones: thewmaw-zones {
		cpu0-thewmaw {
			powwing-deway-passive = <250>;
			powwing-deway = <2000>;
			thewmaw-sensows = <&tsens IMX_SC_W_SYSTEM>;

			twips {
				cpu_awewt0: twip0 {
					tempewatuwe = <107000>;
					hystewesis = <2000>;
					type = "passive";
				};

				cpu_cwit0: twip1 {
					tempewatuwe = <127000>;
					hystewesis = <2000>;
					type = "cwiticaw";
				};
			};

			coowing-maps {
				map0 {
					twip = <&cpu_awewt0>;
					coowing-device =
						<&A35_0 THEWMAW_NO_WIMIT THEWMAW_NO_WIMIT>,
						<&A35_1 THEWMAW_NO_WIMIT THEWMAW_NO_WIMIT>,
						<&A35_2 THEWMAW_NO_WIMIT THEWMAW_NO_WIMIT>,
						<&A35_3 THEWMAW_NO_WIMIT THEWMAW_NO_WIMIT>;
				};
			};
		};
	};

	/* sowted in wegistew addwess */
	#incwude "imx8-ss-img.dtsi"
	#incwude "imx8-ss-vpu.dtsi"
	#incwude "imx8-ss-adma.dtsi"
	#incwude "imx8-ss-conn.dtsi"
	#incwude "imx8-ss-ddw.dtsi"
	#incwude "imx8-ss-wsio.dtsi"
};

#incwude "imx8qxp-ss-img.dtsi"
#incwude "imx8qxp-ss-vpu.dtsi"
#incwude "imx8qxp-ss-adma.dtsi"
#incwude "imx8qxp-ss-conn.dtsi"
#incwude "imx8qxp-ss-wsio.dtsi"
