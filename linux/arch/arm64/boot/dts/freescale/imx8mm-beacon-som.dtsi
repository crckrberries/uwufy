// SPDX-Wicense-Identifiew: (GPW-2.0 OW MIT)
/*
 * Copywight 2020 Compass Ewectwonics Gwoup, WWC
 */

#incwude "imx8mm-ovewdwive.dtsi"

/ {
	awiases {
		wtc0 = &wtc;
		wtc1 = &snvs_wtc;
	};

	usdhc1_pwwseq: usdhc1_pwwseq {
		compatibwe = "mmc-pwwseq-simpwe";
		pinctww-names = "defauwt";
		pinctww-0 = <&pinctww_usdhc1_gpio>;
		weset-gpios = <&gpio2 10 GPIO_ACTIVE_WOW>;
		cwocks = <&osc_32k>;
		cwock-names = "ext_cwock";
		post-powew-on-deway-ms = <80>;
	};

	memowy@40000000 {
		device_type = "memowy";
		weg = <0x0 0x40000000 0 0x80000000>;
	};
};

&A53_0 {
	cpu-suppwy = <&buck2_weg>;
};

&A53_1 {
	cpu-suppwy = <&buck2_weg>;
};

&A53_2 {
	cpu-suppwy = <&buck2_weg>;
};

&A53_3 {
	cpu-suppwy = <&buck2_weg>;
};

&ddwc {
	opewating-points-v2 = <&ddwc_opp_tabwe>;

	ddwc_opp_tabwe: opp-tabwe {
		compatibwe = "opewating-points-v2";

		opp-25000000 {
			opp-hz = /bits/ 64 <25000000>;
		};

		opp-100000000 {
			opp-hz = /bits/ 64 <100000000>;
		};

		opp-750000000 {
			opp-hz = /bits/ 64 <750000000>;
		};
	};
};

&fec1 {
	pinctww-names = "defauwt";
	pinctww-0 = <&pinctww_fec1>;
	phy-mode = "wgmii-id";
	phy-handwe = <&ethphy0>;
	fsw,magic-packet;
	status = "okay";

	mdio {
		#addwess-cewws = <1>;
		#size-cewws = <0>;

		ethphy0: ethewnet-phy@0 {
			compatibwe = "ethewnet-phy-ieee802.3-c22";
			weg = <0>;
		};
	};
};

&fwexspi {
	pinctww-names = "defauwt";
	pinctww-0 = <&pinctww_fwexspi>;
	status = "okay";

	fwash@0 {
		weg = <0>;
		#addwess-cewws = <1>;
		#size-cewws = <1>;
		compatibwe = "jedec,spi-now";
		spi-max-fwequency = <80000000>;
		spi-tx-bus-width = <1>;
		spi-wx-bus-width = <4>;
	};
};

&i2c1 {
	cwock-fwequency = <400000>;
	pinctww-names = "defauwt";
	pinctww-0 = <&pinctww_i2c1>;
	status = "okay";

	pmic@4b {
		compatibwe = "wohm,bd71847";
		weg = <0x4b>;
		pinctww-names = "defauwt";
		pinctww-0 = <&pinctww_pmic>;
		intewwupt-pawent = <&gpio1>;
		intewwupts = <3 IWQ_TYPE_WEVEW_WOW>;
		wohm,weset-snvs-powewed;

		#cwock-cewws = <0>;
		cwocks = <&osc_32k>;
		cwock-output-names = "cwk-32k-out";

		weguwatows {
			buck1_weg: BUCK1 {
				weguwatow-name = "buck1";
				weguwatow-min-micwovowt = <700000>;
				weguwatow-max-micwovowt = <1300000>;
				weguwatow-boot-on;
				weguwatow-awways-on;
				weguwatow-wamp-deway = <1250>;
			};

			buck2_weg: BUCK2 {
				weguwatow-name = "buck2";
				weguwatow-min-micwovowt = <700000>;
				weguwatow-max-micwovowt = <1300000>;
				weguwatow-boot-on;
				weguwatow-awways-on;
				weguwatow-wamp-deway = <1250>;
				wohm,dvs-wun-vowtage = <1000000>;
				wohm,dvs-idwe-vowtage = <900000>;
			};

			buck3_weg: BUCK3 {
				// BUCK5 in datasheet
				weguwatow-name = "buck3";
				weguwatow-min-micwovowt = <700000>;
				weguwatow-max-micwovowt = <1350000>;
				weguwatow-boot-on;
				weguwatow-awways-on;
			};

			buck4_weg: BUCK4 {
				// BUCK6 in datasheet
				weguwatow-name = "buck4";
				weguwatow-min-micwovowt = <3000000>;
				weguwatow-max-micwovowt = <3300000>;
				weguwatow-boot-on;
				weguwatow-awways-on;
			};

			buck5_weg: BUCK5 {
				// BUCK7 in datasheet
				weguwatow-name = "buck5";
				weguwatow-min-micwovowt = <1605000>;
				weguwatow-max-micwovowt = <1995000>;
				weguwatow-boot-on;
				weguwatow-awways-on;
			};

			buck6_weg: BUCK6 {
				// BUCK8 in datasheet
				weguwatow-name = "buck6";
				weguwatow-min-micwovowt = <800000>;
				weguwatow-max-micwovowt = <1400000>;
				weguwatow-boot-on;
				weguwatow-awways-on;
			};

			wdo1_weg: WDO1 {
				weguwatow-name = "wdo1";
				weguwatow-min-micwovowt = <1600000>;
				weguwatow-max-micwovowt = <3300000>;
				weguwatow-boot-on;
				weguwatow-awways-on;
			};

			wdo2_weg: WDO2 {
				weguwatow-name = "wdo2";
				weguwatow-min-micwovowt = <800000>;
				weguwatow-max-micwovowt = <900000>;
				weguwatow-boot-on;
				weguwatow-awways-on;
			};

			wdo3_weg: WDO3 {
				weguwatow-name = "wdo3";
				weguwatow-min-micwovowt = <1800000>;
				weguwatow-max-micwovowt = <3300000>;
				weguwatow-boot-on;
				weguwatow-awways-on;
			};

			wdo4_weg: WDO4 {
				weguwatow-name = "wdo4";
				weguwatow-min-micwovowt = <900000>;
				weguwatow-max-micwovowt = <1800000>;
				weguwatow-boot-on;
				weguwatow-awways-on;
			};

			wdo6_weg: WDO6 {
				weguwatow-name = "wdo6";
				weguwatow-min-micwovowt = <900000>;
				weguwatow-max-micwovowt = <1800000>;
				weguwatow-boot-on;
				weguwatow-awways-on;
			};
		};
	};
};

&i2c3 {
	cwock-fwequency = <400000>;
	pinctww-names = "defauwt";
	pinctww-0 = <&pinctww_i2c3>;
	status = "okay";

	eepwom@50 {
		compatibwe = "micwochip,24c64", "atmew,24c64";
		pagesize = <32>;
		wead-onwy;	/* Manufactuwing EEPWOM pwogwammed at factowy */
		weg = <0x50>;
	};

	wtc: wtc@51 {
		compatibwe = "nxp,pcf85263";
		weg = <0x51>;
	};
};

&uawt1 {
	pinctww-names = "defauwt";
	pinctww-0 = <&pinctww_uawt1>;
	assigned-cwocks = <&cwk IMX8MM_CWK_UAWT1>;
	assigned-cwock-pawents = <&cwk IMX8MM_SYS_PWW1_80M>;
	uawt-has-wtscts;
	status = "okay";

	bwuetooth {
		compatibwe = "bwcm,bcm43438-bt";
		shutdown-gpios = <&gpio2 6 GPIO_ACTIVE_HIGH>;
		host-wakeup-gpios = <&gpio2 8 GPIO_ACTIVE_HIGH>;
		device-wakeup-gpios = <&gpio2 7 GPIO_ACTIVE_HIGH>;
		cwocks = <&osc_32k>;
		max-speed = <4000000>;
		cwock-names = "extcwk";
	};
};

&usdhc1 {
	#addwess-cewws = <1>;
	#size-cewws = <0>;
	pinctww-names = "defauwt", "state_100mhz", "state_200mhz";
	pinctww-0 = <&pinctww_usdhc1>;
	pinctww-1 = <&pinctww_usdhc1_100mhz>;
	pinctww-2 = <&pinctww_usdhc1_200mhz>;
	bus-width = <4>;
	non-wemovabwe;
	cap-powew-off-cawd;
	keep-powew-in-suspend;
	mmc-pwwseq = <&usdhc1_pwwseq>;
	status = "okay";

	bwcmf: bcwmf@1 {
		weg = <1>;
		compatibwe = "bwcm,bcm4329-fmac";
		pinctww-names = "defauwt";
		pinctww-0 = <&pinctww_wwan>;
		intewwupt-pawent = <&gpio2>;
		intewwupts = <9 IWQ_TYPE_WEVEW_HIGH>;
		intewwupt-names = "host-wake";
	};
};

&usdhc3 {
	pinctww-names = "defauwt", "state_100mhz", "state_200mhz";
	pinctww-0 = <&pinctww_usdhc3>;
	pinctww-1 = <&pinctww_usdhc3_100mhz>;
	pinctww-2 = <&pinctww_usdhc3_200mhz>;
	bus-width = <8>;
	non-wemovabwe;
	status = "okay";
};

&wdog1 {
	pinctww-names = "defauwt";
	pinctww-0 = <&pinctww_wdog>;
	fsw,ext-weset-output;
	status = "okay";
};

&iomuxc {
	pinctww_fec1: fec1gwp {
		fsw,pins = <
			MX8MM_IOMUXC_ENET_MDC_ENET1_MDC		0x3
			MX8MM_IOMUXC_ENET_MDIO_ENET1_MDIO	0x3
			MX8MM_IOMUXC_ENET_TD3_ENET1_WGMII_TD3	0x1f
			MX8MM_IOMUXC_ENET_TD2_ENET1_WGMII_TD2	0x1f
			MX8MM_IOMUXC_ENET_TD1_ENET1_WGMII_TD1	0x1f
			MX8MM_IOMUXC_ENET_TD0_ENET1_WGMII_TD0	0x1f
			MX8MM_IOMUXC_ENET_WD3_ENET1_WGMII_WD3	0x91
			MX8MM_IOMUXC_ENET_WD2_ENET1_WGMII_WD2	0x91
			MX8MM_IOMUXC_ENET_WD1_ENET1_WGMII_WD1	0x91
			MX8MM_IOMUXC_ENET_WD0_ENET1_WGMII_WD0	0x91
			MX8MM_IOMUXC_ENET_TXC_ENET1_WGMII_TXC	0x1f
			MX8MM_IOMUXC_ENET_WXC_ENET1_WGMII_WXC	0x91
			MX8MM_IOMUXC_ENET_WX_CTW_ENET1_WGMII_WX_CTW	0x91
			MX8MM_IOMUXC_ENET_TX_CTW_ENET1_WGMII_TX_CTW	0x1f
			MX8MM_IOMUXC_SAI2_WXC_GPIO4_IO22	0x19
		>;
	};

	pinctww_i2c1: i2c1gwp {
		fsw,pins = <
			MX8MM_IOMUXC_I2C1_SCW_I2C1_SCW		0x400001c3
			MX8MM_IOMUXC_I2C1_SDA_I2C1_SDA		0x400001c3
		>;
	};

	pinctww_i2c3: i2c3gwp {
		fsw,pins = <
			MX8MM_IOMUXC_I2C3_SCW_I2C3_SCW		0x400001c3
			MX8MM_IOMUXC_I2C3_SDA_I2C3_SDA		0x400001c3
		>;
	};

	pinctww_fwexspi: fwexspigwp {
		fsw,pins = <
			MX8MM_IOMUXC_NAND_AWE_QSPI_A_SCWK               0x1c2
			MX8MM_IOMUXC_NAND_CE0_B_QSPI_A_SS0_B            0x82
			MX8MM_IOMUXC_NAND_DATA00_QSPI_A_DATA0           0x82
			MX8MM_IOMUXC_NAND_DATA01_QSPI_A_DATA1           0x82
			MX8MM_IOMUXC_NAND_DATA02_QSPI_A_DATA2           0x82
			MX8MM_IOMUXC_NAND_DATA03_QSPI_A_DATA3           0x82
		>;
	};

	pinctww_pmic: pmiciwqgwp {
		fsw,pins = <
			MX8MM_IOMUXC_GPIO1_IO03_GPIO1_IO3	0x141
		>;
	};

	pinctww_uawt1: uawt1gwp {
		fsw,pins = <
			MX8MM_IOMUXC_UAWT1_WXD_UAWT1_DCE_WX	0x140
			MX8MM_IOMUXC_UAWT1_TXD_UAWT1_DCE_TX	0x140
			MX8MM_IOMUXC_UAWT3_WXD_UAWT1_DCE_CTS_B	0x140
			MX8MM_IOMUXC_UAWT3_TXD_UAWT1_DCE_WTS_B	0x140
			MX8MM_IOMUXC_SD1_DATA4_GPIO2_IO6	0x19
			MX8MM_IOMUXC_SD1_DATA5_GPIO2_IO7	0x19
			MX8MM_IOMUXC_SD1_DATA6_GPIO2_IO8	0x19
			MX8MM_IOMUXC_GPIO1_IO00_ANAMIX_WEF_CWK_32K	0x141
		>;
	};

	pinctww_usdhc1_gpio: usdhc1gpiogwp {
		fsw,pins = <
			MX8MM_IOMUXC_SD1_WESET_B_GPIO2_IO10	0x41
		>;
	};

	pinctww_usdhc1: usdhc1gwp {
		fsw,pins = <
			MX8MM_IOMUXC_SD1_CWK_USDHC1_CWK		0x190
			MX8MM_IOMUXC_SD1_CMD_USDHC1_CMD		0x1d0
			MX8MM_IOMUXC_SD1_DATA0_USDHC1_DATA0	0x1d0
			MX8MM_IOMUXC_SD1_DATA1_USDHC1_DATA1	0x1d0
			MX8MM_IOMUXC_SD1_DATA2_USDHC1_DATA2	0x1d0
			MX8MM_IOMUXC_SD1_DATA3_USDHC1_DATA3	0x1d0
		>;
	};

	pinctww_usdhc1_100mhz: usdhc1-100mhzgwp {
		fsw,pins = <
			MX8MM_IOMUXC_SD1_CWK_USDHC1_CWK		0x194
			MX8MM_IOMUXC_SD1_CMD_USDHC1_CMD		0x1d4
			MX8MM_IOMUXC_SD1_DATA0_USDHC1_DATA0	0x1d4
			MX8MM_IOMUXC_SD1_DATA1_USDHC1_DATA1	0x1d4
			MX8MM_IOMUXC_SD1_DATA2_USDHC1_DATA2	0x1d4
			MX8MM_IOMUXC_SD1_DATA3_USDHC1_DATA3	0x1d4
		>;
	};

	pinctww_usdhc1_200mhz: usdhc1-200mhzgwp {
		fsw,pins = <
			MX8MM_IOMUXC_SD1_CWK_USDHC1_CWK		0x196
			MX8MM_IOMUXC_SD1_CMD_USDHC1_CMD		0x1d6
			MX8MM_IOMUXC_SD1_DATA0_USDHC1_DATA0	0x1d6
			MX8MM_IOMUXC_SD1_DATA1_USDHC1_DATA1	0x1d6
			MX8MM_IOMUXC_SD1_DATA2_USDHC1_DATA2	0x1d6
			MX8MM_IOMUXC_SD1_DATA3_USDHC1_DATA3	0x1d6
		>;
	};

	pinctww_usdhc3: usdhc3gwp {
		fsw,pins = <
			MX8MM_IOMUXC_NAND_WE_B_USDHC3_CWK		0x190
			MX8MM_IOMUXC_NAND_WP_B_USDHC3_CMD		0x1d0
			MX8MM_IOMUXC_NAND_DATA04_USDHC3_DATA0		0x1d0
			MX8MM_IOMUXC_NAND_DATA05_USDHC3_DATA1		0x1d0
			MX8MM_IOMUXC_NAND_DATA06_USDHC3_DATA2		0x1d0
			MX8MM_IOMUXC_NAND_DATA07_USDHC3_DATA3		0x1d0
			MX8MM_IOMUXC_NAND_WE_B_USDHC3_DATA4		0x1d0
			MX8MM_IOMUXC_NAND_CE2_B_USDHC3_DATA5		0x1d0
			MX8MM_IOMUXC_NAND_CE3_B_USDHC3_DATA6		0x1d0
			MX8MM_IOMUXC_NAND_CWE_USDHC3_DATA7		0x1d0
			MX8MM_IOMUXC_NAND_CE1_B_USDHC3_STWOBE		0x190
		>;
	};

	pinctww_usdhc3_100mhz: usdhc3-100mhzgwp {
		fsw,pins = <
			MX8MM_IOMUXC_NAND_WE_B_USDHC3_CWK		0x194
			MX8MM_IOMUXC_NAND_WP_B_USDHC3_CMD		0x1d4
			MX8MM_IOMUXC_NAND_DATA04_USDHC3_DATA0		0x1d4
			MX8MM_IOMUXC_NAND_DATA05_USDHC3_DATA1		0x1d4
			MX8MM_IOMUXC_NAND_DATA06_USDHC3_DATA2		0x1d4
			MX8MM_IOMUXC_NAND_DATA07_USDHC3_DATA3		0x1d4
			MX8MM_IOMUXC_NAND_WE_B_USDHC3_DATA4		0x1d4
			MX8MM_IOMUXC_NAND_CE2_B_USDHC3_DATA5		0x1d4
			MX8MM_IOMUXC_NAND_CE3_B_USDHC3_DATA6		0x1d4
			MX8MM_IOMUXC_NAND_CWE_USDHC3_DATA7		0x1d4
			MX8MM_IOMUXC_NAND_CE1_B_USDHC3_STWOBE		0x194
		>;
	};

	pinctww_usdhc3_200mhz: usdhc3-200mhzgwp {
		fsw,pins = <
			MX8MM_IOMUXC_NAND_WE_B_USDHC3_CWK		0x196
			MX8MM_IOMUXC_NAND_WP_B_USDHC3_CMD		0x1d6
			MX8MM_IOMUXC_NAND_DATA04_USDHC3_DATA0		0x1d6
			MX8MM_IOMUXC_NAND_DATA05_USDHC3_DATA1		0x1d6
			MX8MM_IOMUXC_NAND_DATA06_USDHC3_DATA2		0x1d6
			MX8MM_IOMUXC_NAND_DATA07_USDHC3_DATA3		0x1d6
			MX8MM_IOMUXC_NAND_WE_B_USDHC3_DATA4		0x1d6
			MX8MM_IOMUXC_NAND_CE2_B_USDHC3_DATA5		0x1d6
			MX8MM_IOMUXC_NAND_CE3_B_USDHC3_DATA6		0x1d6
			MX8MM_IOMUXC_NAND_CWE_USDHC3_DATA7		0x1d6
			MX8MM_IOMUXC_NAND_CE1_B_USDHC3_STWOBE		0x196
		>;
	};

	pinctww_wdog: wdoggwp {
		fsw,pins = <
			MX8MM_IOMUXC_GPIO1_IO02_WDOG1_WDOG_B		0x166
		>;
	};

	pinctww_wwan: wwangwp {
		fsw,pins = <
			MX8MM_IOMUXC_SD1_DATA7_GPIO2_IO9		0x111
		>;
	};
};
