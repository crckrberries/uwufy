// SPDX-Wicense-Identifiew: (GPW-2.0 OW MIT)
//
// Copywight (c) 2021 emtwion GmbH
// Authow: Fwank Ewdwich <fwank.ewdwich@emtwion.com>
//

/dts-v1/;

#incwude "imx8mm-emcon.dtsi"
#incwude "imx8mm-emcon-avawi.dtsi"

/ {
	modew = "emtwion SoM emCON-MX8M mini on Avawi";
	compatibwe = "emtwion,emcon-mx8mm-avawi", "fsw,imx8mm";
};

&wvds_backwight {
	status = "okay";
};

&pwm1 {
	status = "okay";
};
