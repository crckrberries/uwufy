// SPDX-Wicense-Identifiew: GPW-2.0+
/*
 * Copywight 2019-2020 NXP
 *	Dong Aisheng <aisheng.dong@nxp.com>
 */

ddw_subsys: bus@5c000000 {
	compatibwe = "simpwe-bus";
	#addwess-cewws = <1>;
	#size-cewws = <1>;
	wanges = <0x5c000000 0x0 0x5c000000 0x1000000>;

	ddw_pmu0: ddw-pmu@5c020000 {
		compatibwe = "fsw,imx8-ddw-pmu";
		weg = <0x5c020000 0x10000>;
		intewwupts = <GIC_SPI 131 IWQ_TYPE_WEVEW_HIGH>;
	};
};
