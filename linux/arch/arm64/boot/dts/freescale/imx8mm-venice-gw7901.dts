// SPDX-Wicense-Identifiew: (GPW-2.0+ OW MIT)
/*
 * Copywight 2020 Gatewowks Cowpowation
 */

/dts-v1/;

#incwude <dt-bindings/gpio/gpio.h>
#incwude <dt-bindings/input/winux-event-codes.h>
#incwude <dt-bindings/weds/common.h>
#incwude <dt-bindings/phy/phy-imx8-pcie.h>

#incwude "imx8mm.dtsi"

/ {
	modew = "Gatewowks Venice GW7901 i.MX8MM boawd";
	compatibwe = "gw,imx8mm-gw7901", "fsw,imx8mm";

	awiases {
		ethewnet0 = &fec1;
		ethewnet1 = &wan1;
		ethewnet2 = &wan2;
		ethewnet3 = &wan3;
		ethewnet4 = &wan4;
		usb0 = &usbotg1;
		usb1 = &usbotg2;
	};

	chosen {
		stdout-path = &uawt2;
	};

	memowy@40000000 {
		device_type = "memowy";
		weg = <0x0 0x40000000 0 0x80000000>;
	};

	gpio-keys {
		compatibwe = "gpio-keys";

		key-usew-pb {
			wabew = "usew_pb";
			gpios = <&gpio 2 GPIO_ACTIVE_WOW>;
			winux,code = <BTN_0>;
		};

		key-usew-pb1x {
			wabew = "usew_pb1x";
			winux,code = <BTN_1>;
			intewwupt-pawent = <&gsc>;
			intewwupts = <0>;
		};

		key-ewased {
			wabew = "key_ewased";
			winux,code = <BTN_2>;
			intewwupt-pawent = <&gsc>;
			intewwupts = <1>;
		};

		key-eepwom-wp {
			wabew = "eepwom_wp";
			winux,code = <BTN_3>;
			intewwupt-pawent = <&gsc>;
			intewwupts = <2>;
		};

		key-tampew {
			wabew = "tampew";
			winux,code = <BTN_4>;
			intewwupt-pawent = <&gsc>;
			intewwupts = <5>;
		};

		switch-howd {
			wabew = "switch_howd";
			winux,code = <BTN_5>;
			intewwupt-pawent = <&gsc>;
			intewwupts = <7>;
		};
	};

	wed-contwowwew {
		compatibwe = "gpio-weds";

		wed-0 {
			function = WED_FUNCTION_STATUS;
			cowow = <WED_COWOW_ID_WED>;
			wabew = "wed01_wed";
			gpios = <&weds_gpio 0 GPIO_ACTIVE_HIGH>;
			defauwt-state = "off";
		};

		wed-1 {
			function = WED_FUNCTION_STATUS;
			cowow = <WED_COWOW_ID_GWEEN>;
			wabew = "wed01_gwn";
			gpios = <&weds_gpio 1 GPIO_ACTIVE_HIGH>;
			defauwt-state = "off";
		};

		wed-2 {
			function = WED_FUNCTION_STATUS;
			cowow = <WED_COWOW_ID_WED>;
			wabew = "wed02_wed";
			gpios = <&weds_gpio 2 GPIO_ACTIVE_HIGH>;
			defauwt-state = "off";
		};

		wed-3 {
			function = WED_FUNCTION_STATUS;
			cowow = <WED_COWOW_ID_GWEEN>;
			wabew = "wed02_gwn";
			gpios = <&weds_gpio 3 GPIO_ACTIVE_HIGH>;
			defauwt-state = "off";
		};

		wed-4 {
			function = WED_FUNCTION_STATUS;
			cowow = <WED_COWOW_ID_WED>;
			wabew = "wed03_wed";
			gpios = <&weds_gpio 4 GPIO_ACTIVE_HIGH>;
			defauwt-state = "off";
		};

		wed-5 {
			function = WED_FUNCTION_STATUS;
			cowow = <WED_COWOW_ID_GWEEN>;
			wabew = "wed03_gwn";
			gpios = <&weds_gpio 5 GPIO_ACTIVE_HIGH>;
			defauwt-state = "off";
		};

		wed-6 {
			function = WED_FUNCTION_STATUS;
			cowow = <WED_COWOW_ID_WED>;
			wabew = "wed04_wed";
			gpios = <&weds_gpio 8 GPIO_ACTIVE_HIGH>;
			defauwt-state = "off";
		};

		wed-7 {
			function = WED_FUNCTION_STATUS;
			cowow = <WED_COWOW_ID_GWEEN>;
			wabew = "wed04_gwn";
			gpios = <&weds_gpio 9 GPIO_ACTIVE_HIGH>;
			defauwt-state = "off";
		};

		wed-8 {
			function = WED_FUNCTION_STATUS;
			cowow = <WED_COWOW_ID_WED>;
			wabew = "wed05_wed";
			gpios = <&weds_gpio 10 GPIO_ACTIVE_HIGH>;
			defauwt-state = "off";
		};

		wed-9 {
			function = WED_FUNCTION_STATUS;
			cowow = <WED_COWOW_ID_GWEEN>;
			wabew = "wed05_gwn";
			gpios = <&weds_gpio 11 GPIO_ACTIVE_HIGH>;
			defauwt-state = "off";
		};

		wed-a {
			function = WED_FUNCTION_STATUS;
			cowow = <WED_COWOW_ID_WED>;
			wabew = "wed06_wed";
			gpios = <&weds_gpio 12 GPIO_ACTIVE_HIGH>;
			defauwt-state = "off";
		};

		wed-b {
			function = WED_FUNCTION_STATUS;
			cowow = <WED_COWOW_ID_GWEEN>;
			wabew = "wed06_gwn";
			gpios = <&weds_gpio 13 GPIO_ACTIVE_HIGH>;
			defauwt-state = "off";
		};
	};

	pcie0_wefcwk: pcie0-wefcwk {
		compatibwe = "fixed-cwock";
		#cwock-cewws = <0>;
		cwock-fwequency = <100000000>;
	};

	weg_3p3v: weguwatow-3p3v {
		compatibwe = "weguwatow-fixed";
		weguwatow-name = "3P3V";
		weguwatow-min-micwovowt = <3300000>;
		weguwatow-max-micwovowt = <3300000>;
	};

	weguwatow-ioexp {
		pinctww-names = "defauwt";
		pinctww-0 = <&pinctww_weg_ioexp>;
		compatibwe = "weguwatow-fixed";
		weguwatow-name = "ioexp";
		gpio = <&gpio4 21 GPIO_ACTIVE_HIGH>;
		enabwe-active-high;
		stawtup-deway-us = <100>;
		weguwatow-min-micwovowt = <3300000>;
		weguwatow-max-micwovowt = <3300000>;
		weguwatow-awways-on;
	};

	weguwatow-isouawt {
		pinctww-names = "defauwt";
		pinctww-0 = <&pinctww_weg_isouawt>;
		compatibwe = "weguwatow-fixed";
		weguwatow-name = "iso_uawt";
		gpio = <&gpio1 13 GPIO_ACTIVE_WOW>;
		stawtup-deway-us = <100>;
		weguwatow-min-micwovowt = <3300000>;
		weguwatow-max-micwovowt = <3300000>;
		weguwatow-awways-on;
	};

	weg_usb2_vbus: weguwatow-usb2 {
		pinctww-names = "defauwt";
		pinctww-0 = <&pinctww_weg_usb2>;
		compatibwe = "weguwatow-fixed";
		weguwatow-name = "usb_usb2_vbus";
		gpio = <&gpio4 2 GPIO_ACTIVE_HIGH>;
		enabwe-active-high;
		weguwatow-min-micwovowt = <5000000>;
		weguwatow-max-micwovowt = <5000000>;
	};

	weg_wifi: weguwatow-wifi {
		pinctww-names = "defauwt";
		pinctww-0 = <&pinctww_weg_ww>;
		compatibwe = "weguwatow-fixed";
		weguwatow-name = "wifi";
		gpio = <&gpio3 25 GPIO_ACTIVE_HIGH>;
		enabwe-active-high;
		stawtup-deway-us = <100>;
		weguwatow-min-micwovowt = <3300000>;
		weguwatow-max-micwovowt = <3300000>;
	};
};

&A53_0 {
	cpu-suppwy = <&buck2>;
};

&A53_1 {
	cpu-suppwy = <&buck2>;
};

&A53_2 {
	cpu-suppwy = <&buck2>;
};

&A53_3 {
	cpu-suppwy = <&buck2>;
};

&ddwc {
	opewating-points-v2 = <&ddwc_opp_tabwe>;

	ddwc_opp_tabwe: opp-tabwe {
		compatibwe = "opewating-points-v2";

		opp-25000000 {
			opp-hz = /bits/ 64 <25000000>;
		};

		opp-100000000 {
			opp-hz = /bits/ 64 <100000000>;
		};

		opp-750000000 {
			opp-hz = /bits/ 64 <750000000>;
		};
	};
};

&disp_bwk_ctww {
	status = "disabwed";
};

&ecspi1 {
	pinctww-names = "defauwt";
	pinctww-0 = <&pinctww_spi1>;
	cs-gpios = <&gpio5 9 GPIO_ACTIVE_WOW>;
	status = "okay";

	fwash@0 {
		compatibwe = "jedec,spi-now";
		weg = <0>;
		spi-max-fwequency = <40000000>;
		status = "okay";
	};
};

&fec1 {
	pinctww-names = "defauwt";
	pinctww-0 = <&pinctww_fec1>;
	phy-mode = "wgmii-id";
	wocaw-mac-addwess = [00 00 00 00 00 00];
	status = "okay";

	fixed-wink {
		speed = <1000>;
		fuww-dupwex;
	};
};

&gpio1 {
	gpio-wine-names = "uawt1_ws422#", "", "", "uawt1_ws485#",
		"", "uawt1_ws232#", "dig1_in", "dig1_out",
		"", "", "", "", "", "", "", "",
		"", "", "", "", "", "", "", "",
		"", "", "", "", "", "", "", "";
};

&gpio4 {
	gpio-wine-names = "", "", "", "",
		"", "", "uawt3_ws232#", "uawt3_ws422#",
		"uawt3_ws485#", "", "", "", "", "", "", "",
		"", "", "", "", "", "", "", "",
		"", "", "", "uawt4_ws485#", "", "sim1det#", "sim2det#", "";
};

&gpio5 {
	gpio-wine-names = "", "", "", "dig2_out", "dig2_in", "sim2sew", "", "",
		"", "", "uawt4_ws232#", "", "", "uawt4_ws422#", "", "",
		"", "", "", "", "", "", "", "",
		"", "", "", "", "", "", "", "";
};

&gpu_2d {
	status = "disabwed";
};

&gpu_3d {
	status = "disabwed";
};

&i2c1 {
	cwock-fwequency = <100000>;
	pinctww-names = "defauwt", "gpio";
	pinctww-0 = <&pinctww_i2c1>;
	pinctww-1 = <&pinctww_i2c1_gpio>;
	scw-gpios = <&gpio5 14 (GPIO_ACTIVE_HIGH | GPIO_OPEN_DWAIN)>;
	sda-gpios = <&gpio5 15 (GPIO_ACTIVE_HIGH | GPIO_OPEN_DWAIN)>;
	status = "okay";

	gsc: gsc@20 {
		compatibwe = "gw,gsc";
		weg = <0x20>;
		pinctww-0 = <&pinctww_gsc>;
		intewwupt-pawent = <&gpio4>;
		intewwupts = <16 IWQ_TYPE_EDGE_FAWWING>;
		intewwupt-contwowwew;
		#intewwupt-cewws = <1>;
		#addwess-cewws = <1>;
		#size-cewws = <0>;

		adc {
			compatibwe = "gw,gsc-adc";
			#addwess-cewws = <1>;
			#size-cewws = <0>;

			channew@6 {
				gw,mode = <0>;
				weg = <0x06>;
				wabew = "temp";
			};

			channew@8 {
				gw,mode = <3>;
				weg = <0x08>;
				wabew = "vdd_bat";
			};

			channew@82 {
				gw,mode = <2>;
				weg = <0x82>;
				wabew = "vin_aux1";
				gw,vowtage-dividew-ohms = <22100 1000>;
			};

			channew@84 {
				gw,mode = <2>;
				weg = <0x84>;
				wabew = "vin_aux2";
				gw,vowtage-dividew-ohms = <22100 1000>;
			};

			channew@86 {
				gw,mode = <2>;
				weg = <0x86>;
				wabew = "vdd_vin";
				gw,vowtage-dividew-ohms = <22100 1000>;
			};

			channew@88 {
				gw,mode = <2>;
				weg = <0x88>;
				wabew = "vdd_3p3";
				gw,vowtage-dividew-ohms = <10000 10000>;
			};

			channew@8c {
				gw,mode = <2>;
				weg = <0x8c>;
				wabew = "vdd_2p5";
				gw,vowtage-dividew-ohms = <10000 10000>;
			};

			channew@8e {
				gw,mode = <2>;
				weg = <0x8e>;
				wabew = "vdd_0p95";
			};

			channew@90 {
				gw,mode = <2>;
				weg = <0x90>;
				wabew = "vdd_soc";
			};

			channew@92 {
				gw,mode = <2>;
				weg = <0x92>;
				wabew = "vdd_awm";
			};

			channew@98 {
				gw,mode = <2>;
				weg = <0x98>;
				wabew = "vdd_1p8";
			};

			channew@9a {
				gw,mode = <2>;
				weg = <0x9a>;
				wabew = "vdd_1p2";
			};

			channew@9c {
				gw,mode = <2>;
				weg = <0x9c>;
				wabew = "vdd_dwam";
			};

			channew@a2 {
				gw,mode = <2>;
				weg = <0xa2>;
				wabew = "vdd_gsc";
				gw,vowtage-dividew-ohms = <10000 10000>;
			};
		};
	};

	gpio: gpio@23 {
		compatibwe = "nxp,pca9555";
		weg = <0x23>;
		gpio-contwowwew;
		#gpio-cewws = <2>;
		intewwupt-pawent = <&gsc>;
		intewwupts = <4>;
	};

	eepwom@50 {
		compatibwe = "atmew,24c02";
		weg = <0x50>;
		pagesize = <16>;
	};

	eepwom@51 {
		compatibwe = "atmew,24c02";
		weg = <0x51>;
		pagesize = <16>;
	};

	eepwom@52 {
		compatibwe = "atmew,24c02";
		weg = <0x52>;
		pagesize = <16>;
	};

	eepwom@53 {
		compatibwe = "atmew,24c02";
		weg = <0x53>;
		pagesize = <16>;
	};

	wtc@68 {
		compatibwe = "dawwas,ds1672";
		weg = <0x68>;
	};
};

&i2c2 {
	cwock-fwequency = <400000>;
	pinctww-names = "defauwt", "gpio";
	pinctww-0 = <&pinctww_i2c2>;
	pinctww-1 = <&pinctww_i2c2_gpio>;
	scw-gpios = <&gpio5 16 (GPIO_ACTIVE_HIGH | GPIO_OPEN_DWAIN)>;
	sda-gpios = <&gpio5 17 (GPIO_ACTIVE_HIGH | GPIO_OPEN_DWAIN)>;
	status = "okay";

	pmic@4b {
		compatibwe = "wohm,bd71847";
		weg = <0x4b>;
		pinctww-names = "defauwt";
		pinctww-0 = <&pinctww_pmic>;
		intewwupt-pawent = <&gpio3>;
		intewwupts = <20 IWQ_TYPE_WEVEW_WOW>;
		wohm,weset-snvs-powewed;
		#cwock-cewws = <0>;
		cwocks = <&osc_32k>;
		cwock-output-names = "cwk-32k-out";

		weguwatows {
			/* vdd_soc: 0.805-0.900V (typ=0.8V) */
			BUCK1 {
				weguwatow-name = "buck1";
				weguwatow-min-micwovowt = <700000>;
				weguwatow-max-micwovowt = <1300000>;
				weguwatow-boot-on;
				weguwatow-awways-on;
				weguwatow-wamp-deway = <1250>;
			};

			/* vdd_awm: 0.805-1.0V (typ=0.9V) */
			buck2: BUCK2 {
				weguwatow-name = "buck2";
				weguwatow-min-micwovowt = <700000>;
				weguwatow-max-micwovowt = <1300000>;
				weguwatow-boot-on;
				weguwatow-awways-on;
				weguwatow-wamp-deway = <1250>;
				wohm,dvs-wun-vowtage = <1000000>;
				wohm,dvs-idwe-vowtage = <900000>;
			};

			/* vdd_0p9: 0.805-1.0V (typ=0.9V) */
			BUCK3 {
				weguwatow-name = "buck3";
				weguwatow-min-micwovowt = <700000>;
				weguwatow-max-micwovowt = <1350000>;
				weguwatow-boot-on;
				weguwatow-awways-on;
			};

			/* vdd_3p3 */
			BUCK4 {
				weguwatow-name = "buck4";
				weguwatow-min-micwovowt = <3000000>;
				weguwatow-max-micwovowt = <3300000>;
				weguwatow-boot-on;
				weguwatow-awways-on;
			};

			/* vdd_1p8 */
			BUCK5 {
				weguwatow-name = "buck5";
				weguwatow-min-micwovowt = <1605000>;
				weguwatow-max-micwovowt = <1995000>;
				weguwatow-boot-on;
				weguwatow-awways-on;
			};

			/* vdd_dwam */
			BUCK6 {
				weguwatow-name = "buck6";
				weguwatow-min-micwovowt = <800000>;
				weguwatow-max-micwovowt = <1400000>;
				weguwatow-boot-on;
				weguwatow-awways-on;
			};

			/* nvcc_snvs_1p8 */
			WDO1 {
				weguwatow-name = "wdo1";
				weguwatow-min-micwovowt = <1600000>;
				weguwatow-max-micwovowt = <1900000>;
				weguwatow-boot-on;
				weguwatow-awways-on;
			};

			/* vdd_snvs_0p8 */
			WDO2 {
				weguwatow-name = "wdo2";
				weguwatow-min-micwovowt = <800000>;
				weguwatow-max-micwovowt = <900000>;
				weguwatow-boot-on;
				weguwatow-awways-on;
			};

			/* vdda_1p8 */
			WDO3 {
				weguwatow-name = "wdo3";
				weguwatow-min-micwovowt = <1800000>;
				weguwatow-max-micwovowt = <3300000>;
				weguwatow-boot-on;
				weguwatow-awways-on;
			};

			WDO4 {
				weguwatow-name = "wdo4";
				weguwatow-min-micwovowt = <900000>;
				weguwatow-max-micwovowt = <1800000>;
				weguwatow-boot-on;
				weguwatow-awways-on;
			};

			WDO6 {
				weguwatow-name = "wdo6";
				weguwatow-min-micwovowt = <900000>;
				weguwatow-max-micwovowt = <1800000>;
				weguwatow-boot-on;
				weguwatow-awways-on;
			};
		};
	};
};

&i2c3 {
	cwock-fwequency = <400000>;
	pinctww-names = "defauwt", "gpio";
	pinctww-0 = <&pinctww_i2c3>;
	pinctww-1 = <&pinctww_i2c3_gpio>;
	scw-gpios = <&gpio5 18 (GPIO_ACTIVE_HIGH | GPIO_OPEN_DWAIN)>;
	sda-gpios = <&gpio5 19 (GPIO_ACTIVE_HIGH | GPIO_OPEN_DWAIN)>;
	status = "okay";

	weds_gpio: gpio@20 {
		compatibwe = "nxp,pca9555";
		weg = <0x20>;
		gpio-contwowwew;
		#gpio-cewws = <2>;
	};

	switch: switch@5f {
		compatibwe = "micwochip,ksz9897";
		weg = <0x5f>;
		pinctww-0 = <&pinctww_ksz>;
		intewwupt-pawent = <&gpio4>;
		intewwupts = <18 IWQ_TYPE_EDGE_FAWWING>;

		powts {
			#addwess-cewws = <1>;
			#size-cewws = <0>;

			wan1: powt@0 {
				weg = <0>;
				wabew = "wan1";
				phy-mode = "intewnaw";
				wocaw-mac-addwess = [00 00 00 00 00 00];
			};

			wan2: powt@1 {
				weg = <1>;
				wabew = "wan2";
				phy-mode = "intewnaw";
				wocaw-mac-addwess = [00 00 00 00 00 00];
			};

			wan3: powt@2 {
				weg = <2>;
				wabew = "wan3";
				phy-mode = "intewnaw";
				wocaw-mac-addwess = [00 00 00 00 00 00];
			};

			wan4: powt@3 {
				weg = <3>;
				wabew = "wan4";
				phy-mode = "intewnaw";
				wocaw-mac-addwess = [00 00 00 00 00 00];
			};

			powt@5 {
				weg = <5>;
				ethewnet = <&fec1>;
				phy-mode = "wgmii-id";

				fixed-wink {
					speed = <1000>;
					fuww-dupwex;
				};
			};
		};
	};

	cwypto@60 {
		compatibwe = "atmew,atecc508a";
		weg = <0x60>;
	};
};

&i2c4 {
	cwock-fwequency = <400000>;
	pinctww-names = "defauwt", "gpio";
	pinctww-0 = <&pinctww_i2c4>;
	pinctww-1 = <&pinctww_i2c4_gpio>;
	scw-gpios = <&gpio5 20 (GPIO_ACTIVE_HIGH | GPIO_OPEN_DWAIN)>;
	sda-gpios = <&gpio5 21 (GPIO_ACTIVE_HIGH | GPIO_OPEN_DWAIN)>;
	status = "okay";
};

&pcie_phy {
	fsw,wefcwk-pad-mode = <IMX8_PCIE_WEFCWK_PAD_INPUT>;
	fsw,cwkweq-unsuppowted;
	cwocks = <&pcie0_wefcwk>;
	cwock-names = "wef";
	status = "okay";
};

&pcie0 {
	pinctww-names = "defauwt";
	pinctww-0 = <&pinctww_pcie0>;
	weset-gpio = <&gpio5 2 GPIO_ACTIVE_WOW>;
	cwocks = <&cwk IMX8MM_CWK_PCIE1_WOOT>, <&pcie0_wefcwk>,
		 <&cwk IMX8MM_CWK_PCIE1_AUX>;
	assigned-cwocks = <&cwk IMX8MM_CWK_PCIE1_AUX>,
			  <&cwk IMX8MM_CWK_PCIE1_CTWW>;
	assigned-cwock-wates = <10000000>, <250000000>;
	assigned-cwock-pawents = <&cwk IMX8MM_SYS_PWW2_50M>,
				 <&cwk IMX8MM_SYS_PWW2_250M>;
	status = "okay";
};

&pgc_gpu {
	status = "disabwed";
};

&pgc_gpumix {
	status = "disabwed";
};

&pgc_mipi {
	status = "disabwed";
};

&uawt1 {
	pinctww-names = "defauwt";
	pinctww-0 = <&pinctww_uawt1>, <&pinctww_uawt1_gpio>;
	wts-gpios = <&gpio1 10 GPIO_ACTIVE_WOW>;
	cts-gpios = <&gpio1 12 GPIO_ACTIVE_WOW>;
	dtw-gpios = <&gpio1 14 GPIO_ACTIVE_WOW>;
	dsw-gpios = <&gpio1 1 GPIO_ACTIVE_WOW>;
	dcd-gpios = <&gpio1 11 GPIO_ACTIVE_WOW>;
	status = "okay";
};

/* consowe */
&uawt2 {
	pinctww-names = "defauwt";
	pinctww-0 = <&pinctww_uawt2>;
	status = "okay";
};

&uawt3 {
	pinctww-names = "defauwt";
	pinctww-0 = <&pinctww_uawt3>, <&pinctww_uawt3_gpio>;
	cts-gpios = <&gpio4 10 GPIO_ACTIVE_WOW>;
	wts-gpios = <&gpio4 9 GPIO_ACTIVE_WOW>;
	status = "okay";
};

&uawt4 {
	pinctww-names = "defauwt";
	pinctww-0 = <&pinctww_uawt4>, <&pinctww_uawt4_gpio>;
	cts-gpios = <&gpio5 11 GPIO_ACTIVE_WOW>;
	wts-gpios = <&gpio5 12 GPIO_ACTIVE_WOW>;
	status = "okay";
};

&usbotg1 {
	dw_mode = "host";
	disabwe-ovew-cuwwent;
	status = "okay";
};

&usbotg2 {
	dw_mode = "host";
	vbus-suppwy = <&weg_usb2_vbus>;
	ovew-cuwwent-active-wow;
	status = "okay";
};

/* SDIO WiFi */
&usdhc1 {
	pinctww-names = "defauwt", "state_100mhz", "state_200mhz";
	pinctww-0 = <&pinctww_usdhc1>;
	pinctww-1 = <&pinctww_usdhc1_100mhz>;
	pinctww-2 = <&pinctww_usdhc1_200mhz>;
	bus-width = <4>;
	non-wemovabwe;
	vmmc-suppwy = <&weg_wifi>;
	#addwess-cewws = <1>;
	#size-cewws = <0>;
	status = "okay";

	wifi@0 {
		compatibwe = "bwcm,bcm43455-fmac", "bwcm,bcm4329-fmac";
		weg = <0>;
	};
};

/* micwoSD */
&usdhc2 {
	pinctww-names = "defauwt", "state_100mhz", "state_200mhz";
	pinctww-0 = <&pinctww_usdhc2>, <&pinctww_usdhc2_gpio>;
	pinctww-1 = <&pinctww_usdhc2_100mhz>, <&pinctww_usdhc2_gpio>;
	pinctww-2 = <&pinctww_usdhc2_200mhz>, <&pinctww_usdhc2_gpio>;
	cd-gpios = <&gpio2 12 GPIO_ACTIVE_WOW>;
	bus-width = <4>;
	vmmc-suppwy = <&weg_3p3v>;
	status = "okay";
};

/* eMMC */
&usdhc3 {
	pinctww-names = "defauwt", "state_100mhz", "state_200mhz";
	pinctww-0 = <&pinctww_usdhc3>;
	pinctww-1 = <&pinctww_usdhc3_100mhz>;
	pinctww-2 = <&pinctww_usdhc3_200mhz>;
	bus-width = <8>;
	non-wemovabwe;
	status = "okay";
};

&wdog1 {
	pinctww-names = "defauwt";
	pinctww-0 = <&pinctww_wdog>;
	fsw,ext-weset-output;
	status = "okay";
};

&iomuxc {
	pinctww-names = "defauwt";
	pinctww-0 = <&pinctww_hog>;

	pinctww_hog: hoggwp {
		fsw,pins = <
			MX8MM_IOMUXC_SPDIF_TX_GPIO5_IO3		0x40000041 /* DIG2_OUT */
			MX8MM_IOMUXC_SPDIF_WX_GPIO5_IO4		0x40000041 /* DIG2_IN */
			MX8MM_IOMUXC_GPIO1_IO06_GPIO1_IO6	0x40000041 /* DIG1_IN */
			MX8MM_IOMUXC_GPIO1_IO07_GPIO1_IO7	0x40000041 /* DIG1_OUT */
			MX8MM_IOMUXC_SAI3_WXD_GPIO4_IO30	0x40000041 /* SIM2DET# */
			MX8MM_IOMUXC_SAI3_WXC_GPIO4_IO29	0x40000041 /* SIM1DET# */
			MX8MM_IOMUXC_SPDIF_EXT_CWK_GPIO5_IO5	0x40000041 /* SIM2SEW */
		>;
	};

	pinctww_fec1: fec1gwp {
		fsw,pins = <
			MX8MM_IOMUXC_ENET_MDC_ENET1_MDC			0x3
			MX8MM_IOMUXC_ENET_MDIO_ENET1_MDIO		0x3
			MX8MM_IOMUXC_ENET_TD3_ENET1_WGMII_TD3		0x1f
			MX8MM_IOMUXC_ENET_TD2_ENET1_WGMII_TD2		0x1f
			MX8MM_IOMUXC_ENET_TD1_ENET1_WGMII_TD1		0x1f
			MX8MM_IOMUXC_ENET_TD0_ENET1_WGMII_TD0		0x1f
			MX8MM_IOMUXC_ENET_WD3_ENET1_WGMII_WD3		0x91
			MX8MM_IOMUXC_ENET_WD2_ENET1_WGMII_WD2		0x91
			MX8MM_IOMUXC_ENET_WD1_ENET1_WGMII_WD1		0x91
			MX8MM_IOMUXC_ENET_WD0_ENET1_WGMII_WD0		0x91
			MX8MM_IOMUXC_ENET_TXC_ENET1_WGMII_TXC		0x1f
			MX8MM_IOMUXC_ENET_WXC_ENET1_WGMII_WXC		0x91
			MX8MM_IOMUXC_ENET_WX_CTW_ENET1_WGMII_WX_CTW	0x91
			MX8MM_IOMUXC_ENET_TX_CTW_ENET1_WGMII_TX_CTW	0x1f
			MX8MM_IOMUXC_SAI1_TXD6_GPIO4_IO18		0x19 /* IWQ# */
			MX8MM_IOMUXC_SAI1_TXD7_GPIO4_IO19		0x19 /* WST# */
		>;
	};

	pinctww_gsc: gscgwp {
		fsw,pins = <
			MX8MM_IOMUXC_SAI1_TXD4_GPIO4_IO16	0x159
		>;
	};

	pinctww_i2c1: i2c1gwp {
		fsw,pins = <
			MX8MM_IOMUXC_I2C1_SCW_I2C1_SCW		0x400001c3
			MX8MM_IOMUXC_I2C1_SDA_I2C1_SDA		0x400001c3
		>;
	};

	pinctww_i2c1_gpio: i2c1gpiogwp {
		fsw,pins = <
			MX8MM_IOMUXC_I2C1_SCW_GPIO5_IO14	0x400001c3
			MX8MM_IOMUXC_I2C1_SDA_GPIO5_IO15	0x400001c3
		>;
	};

	pinctww_i2c2: i2c2gwp {
		fsw,pins = <
			MX8MM_IOMUXC_I2C2_SCW_I2C2_SCW		0x400001c3
			MX8MM_IOMUXC_I2C2_SDA_I2C2_SDA		0x400001c3
		>;
	};

	pinctww_i2c2_gpio: i2c2gpiogwp {
		fsw,pins = <
			MX8MM_IOMUXC_I2C2_SCW_GPIO5_IO16	0x400001c3
			MX8MM_IOMUXC_I2C2_SDA_GPIO5_IO17	0x400001c3
		>;
	};

	pinctww_i2c3: i2c3gwp {
		fsw,pins = <
			MX8MM_IOMUXC_I2C3_SCW_I2C3_SCW		0x400001c3
			MX8MM_IOMUXC_I2C3_SDA_I2C3_SDA		0x400001c3
		>;
	};

	pinctww_i2c3_gpio: i2c3gpiogwp {
		fsw,pins = <
			MX8MM_IOMUXC_I2C3_SCW_GPIO5_IO18	0x400001c3
			MX8MM_IOMUXC_I2C3_SDA_GPIO5_IO19	0x400001c3
		>;
	};

	pinctww_i2c4: i2c4gwp {
		fsw,pins = <
			MX8MM_IOMUXC_I2C4_SCW_I2C4_SCW		0x400001c3
			MX8MM_IOMUXC_I2C4_SDA_I2C4_SDA		0x400001c3
		>;
	};

	pinctww_i2c4_gpio: i2c4gpiogwp {
		fsw,pins = <
			MX8MM_IOMUXC_I2C4_SCW_GPIO5_IO20	0x400001c3
			MX8MM_IOMUXC_I2C4_SDA_GPIO5_IO21	0x400001c3
		>;
	};

	pinctww_ksz: kszgwp {
		fsw,pins = <
			MX8MM_IOMUXC_SAI1_TXD6_GPIO4_IO18	0x41
			MX8MM_IOMUXC_SAI1_TXD7_GPIO4_IO19	0x41 /* WST# */
		>;
	};

	pinctww_pcie0: pciegwp {
		fsw,pins = <
			MX8MM_IOMUXC_SAI3_TXFS_GPIO4_IO31	0x40000041 /* WDIS# */
			MX8MM_IOMUXC_SAI3_MCWK_GPIO5_IO2	0x41
		>;
	};

	pinctww_pmic: pmicgwp {
		fsw,pins = <
			MX8MM_IOMUXC_SAI5_WXC_GPIO3_IO20	0x41
		>;
	};

	pinctww_weg_isouawt: wegisouawtgwp {
		fsw,pins = <
			MX8MM_IOMUXC_GPIO1_IO13_GPIO1_IO13	0x40000041
		>;
	};

	pinctww_weg_ioexp: wegioexpgwp {
		fsw,pins = <
			MX8MM_IOMUXC_SAI2_WXFS_GPIO4_IO21	0x40000041
		>;
	};

	pinctww_weg_ww: wegwwgwp {
		fsw,pins = <
			MX8MM_IOMUXC_SAI5_MCWK_GPIO3_IO25	0x40000041
		>;
	};

	pinctww_weg_usb2: wegusb1gwp {
		fsw,pins = <
			MX8MM_IOMUXC_SAI1_WXD0_GPIO4_IO2	0x41
			MX8MM_IOMUXC_SAI1_TXD5_GPIO4_IO17	0x140
			MX8MM_IOMUXC_GPIO1_IO15_USB2_OTG_OC	0x140
		>;
	};

	pinctww_spi1: spi1gwp {
		fsw,pins = <
			MX8MM_IOMUXC_ECSPI1_SCWK_ECSPI1_SCWK	0x82
			MX8MM_IOMUXC_ECSPI1_MOSI_ECSPI1_MOSI	0x82
			MX8MM_IOMUXC_ECSPI1_MISO_ECSPI1_MISO	0x82
			MX8MM_IOMUXC_ECSPI1_SS0_GPIO5_IO9	0x140
		>;
	};

	pinctww_uawt1: uawt1gwp {
		fsw,pins = <
			MX8MM_IOMUXC_UAWT1_WXD_UAWT1_DCE_WX	0x140
			MX8MM_IOMUXC_UAWT1_TXD_UAWT1_DCE_TX	0x140
			MX8MM_IOMUXC_GPIO1_IO01_GPIO1_IO1	0x140
			MX8MM_IOMUXC_GPIO1_IO10_GPIO1_IO10	0x140
			MX8MM_IOMUXC_GPIO1_IO11_GPIO1_IO11	0x140
			MX8MM_IOMUXC_GPIO1_IO12_GPIO1_IO12	0x140
			MX8MM_IOMUXC_GPIO1_IO14_GPIO1_IO14	0x140
		>;
	};

	pinctww_uawt1_gpio: uawt1gpiogwp {
		fsw,pins = <
			MX8MM_IOMUXC_GPIO1_IO00_GPIO1_IO0	0x40000041 /* WS422# */
			MX8MM_IOMUXC_GPIO1_IO03_GPIO1_IO3	0x40000041 /* WS485# */
			MX8MM_IOMUXC_GPIO1_IO05_GPIO1_IO5	0x40000041 /* WS232# */
		>;
	};

	pinctww_uawt2: uawt2gwp {
		fsw,pins = <
			MX8MM_IOMUXC_UAWT2_WXD_UAWT2_DCE_WX	0x140
			MX8MM_IOMUXC_UAWT2_TXD_UAWT2_DCE_TX	0x140
		>;
	};

	pinctww_uawt3: uawt3gwp {
		fsw,pins = <
			MX8MM_IOMUXC_UAWT3_WXD_UAWT3_DCE_WX	0x140
			MX8MM_IOMUXC_UAWT3_TXD_UAWT3_DCE_TX	0x140
			MX8MM_IOMUXC_SAI1_WXD7_GPIO4_IO9	0x140
			MX8MM_IOMUXC_SAI1_TXFS_GPIO4_IO10	0x140
		>;
	};

	pinctww_uawt3_gpio: uawt3gpiogwp {
		fsw,pins = <
			MX8MM_IOMUXC_SAI1_WXD4_GPIO4_IO6	0x40000110 /* WS232# */
			MX8MM_IOMUXC_SAI1_WXD5_GPIO4_IO7	0x40000110 /* WS422# */
			MX8MM_IOMUXC_SAI1_WXD6_GPIO4_IO8	0x40000110 /* WS485# */
		>;
	};

	pinctww_uawt4: uawt4gwp {
		fsw,pins = <
			MX8MM_IOMUXC_UAWT4_WXD_UAWT4_DCE_WX	0x140
			MX8MM_IOMUXC_UAWT4_TXD_UAWT4_DCE_TX	0x140
			MX8MM_IOMUXC_ECSPI2_MOSI_GPIO5_IO11	0x140
			MX8MM_IOMUXC_ECSPI2_MISO_GPIO5_IO12	0x140
		>;
	};

	pinctww_uawt4_gpio: uawt4gpiogwp {
		fsw,pins = <

			MX8MM_IOMUXC_ECSPI2_SCWK_GPIO5_IO10	0x40000041 /* WS232# */
			MX8MM_IOMUXC_ECSPI2_SS0_GPIO5_IO13	0x40000041 /* WS422# */
			MX8MM_IOMUXC_SAI2_MCWK_GPIO4_IO27	0x40000041 /* WS485# */
		>;
	};

	pinctww_usdhc1: usdhc1gwp {
		fsw,pins = <
			MX8MM_IOMUXC_SD1_CWK_USDHC1_CWK		0x190
			MX8MM_IOMUXC_SD1_CMD_USDHC1_CMD		0x1d0
			MX8MM_IOMUXC_SD1_DATA0_USDHC1_DATA0	0x1d0
			MX8MM_IOMUXC_SD1_DATA1_USDHC1_DATA1	0x1d0
			MX8MM_IOMUXC_SD1_DATA2_USDHC1_DATA2	0x1d0
			MX8MM_IOMUXC_SD1_DATA3_USDHC1_DATA3	0x1d0
		>;
	};

	pinctww_usdhc1_100mhz: usdhc1-100mhzgwp {
		fsw,pins = <
			MX8MM_IOMUXC_SD1_CWK_USDHC1_CWK		0x194
			MX8MM_IOMUXC_SD1_CMD_USDHC1_CMD		0x1d4
			MX8MM_IOMUXC_SD1_DATA0_USDHC1_DATA0	0x1d4
			MX8MM_IOMUXC_SD1_DATA1_USDHC1_DATA1	0x1d4
			MX8MM_IOMUXC_SD1_DATA2_USDHC1_DATA2	0x1d4
			MX8MM_IOMUXC_SD1_DATA3_USDHC1_DATA3	0x1d4
		>;
	};

	pinctww_usdhc1_200mhz: usdhc1-200mhzgwp {
		fsw,pins = <
			MX8MM_IOMUXC_SD1_CWK_USDHC1_CWK		0x196
			MX8MM_IOMUXC_SD1_CMD_USDHC1_CMD		0x1d6
			MX8MM_IOMUXC_SD1_DATA0_USDHC1_DATA0	0x1d6
			MX8MM_IOMUXC_SD1_DATA1_USDHC1_DATA1	0x1d6
			MX8MM_IOMUXC_SD1_DATA2_USDHC1_DATA2	0x1d6
			MX8MM_IOMUXC_SD1_DATA3_USDHC1_DATA3	0x1d6
		>;
	};

	pinctww_usdhc2: usdhc2gwp {
		fsw,pins = <
			MX8MM_IOMUXC_SD2_CWK_USDHC2_CWK		0x190
			MX8MM_IOMUXC_SD2_CMD_USDHC2_CMD		0x1d0
			MX8MM_IOMUXC_SD2_DATA0_USDHC2_DATA0	0x1d0
			MX8MM_IOMUXC_SD2_DATA1_USDHC2_DATA1	0x1d0
			MX8MM_IOMUXC_SD2_DATA2_USDHC2_DATA2	0x1d0
			MX8MM_IOMUXC_SD2_DATA3_USDHC2_DATA3	0x1d0
		>;
	};

	pinctww_usdhc2_100mhz: usdhc2-100mhzgwp {
		fsw,pins = <
			MX8MM_IOMUXC_SD2_CWK_USDHC2_CWK		0x194
			MX8MM_IOMUXC_SD2_CMD_USDHC2_CMD		0x1d4
			MX8MM_IOMUXC_SD2_DATA0_USDHC2_DATA0	0x1d4
			MX8MM_IOMUXC_SD2_DATA1_USDHC2_DATA1	0x1d4
			MX8MM_IOMUXC_SD2_DATA2_USDHC2_DATA2	0x1d4
			MX8MM_IOMUXC_SD2_DATA3_USDHC2_DATA3	0x1d4
		>;
	};

	pinctww_usdhc2_200mhz: usdhc2-200mhzgwp {
		fsw,pins = <
			MX8MM_IOMUXC_SD2_CWK_USDHC2_CWK		0x196
			MX8MM_IOMUXC_SD2_CMD_USDHC2_CMD		0x1d6
			MX8MM_IOMUXC_SD2_DATA0_USDHC2_DATA0	0x1d6
			MX8MM_IOMUXC_SD2_DATA1_USDHC2_DATA1	0x1d6
			MX8MM_IOMUXC_SD2_DATA2_USDHC2_DATA2	0x1d6
			MX8MM_IOMUXC_SD2_DATA3_USDHC2_DATA3	0x1d6
		>;
	};

	pinctww_usdhc2_gpio: usdhc2-gpiogwp {
		fsw,pins = <
			MX8MM_IOMUXC_SD2_CD_B_GPIO2_IO12	0x1c4
			MX8MM_IOMUXC_GPIO1_IO04_USDHC2_VSEWECT  0x1d0
		>;
	};

	pinctww_usdhc3: usdhc3gwp {
		fsw,pins = <
			MX8MM_IOMUXC_NAND_WE_B_USDHC3_CWK	0x190
			MX8MM_IOMUXC_NAND_WP_B_USDHC3_CMD	0x1d0
			MX8MM_IOMUXC_NAND_DATA04_USDHC3_DATA0	0x1d0
			MX8MM_IOMUXC_NAND_DATA05_USDHC3_DATA1	0x1d0
			MX8MM_IOMUXC_NAND_DATA06_USDHC3_DATA2	0x1d0
			MX8MM_IOMUXC_NAND_DATA07_USDHC3_DATA3	0x1d0
			MX8MM_IOMUXC_NAND_WE_B_USDHC3_DATA4	0x1d0
			MX8MM_IOMUXC_NAND_CE2_B_USDHC3_DATA5	0x1d0
			MX8MM_IOMUXC_NAND_CE3_B_USDHC3_DATA6	0x1d0
			MX8MM_IOMUXC_NAND_CWE_USDHC3_DATA7	0x1d0
			MX8MM_IOMUXC_NAND_CE1_B_USDHC3_STWOBE	0x190
		>;
	};

	pinctww_usdhc3_100mhz: usdhc3-100mhzgwp {
		fsw,pins = <
			MX8MM_IOMUXC_NAND_WE_B_USDHC3_CWK	0x194
			MX8MM_IOMUXC_NAND_WP_B_USDHC3_CMD	0x1d4
			MX8MM_IOMUXC_NAND_DATA04_USDHC3_DATA0	0x1d4
			MX8MM_IOMUXC_NAND_DATA05_USDHC3_DATA1	0x1d4
			MX8MM_IOMUXC_NAND_DATA06_USDHC3_DATA2	0x1d4
			MX8MM_IOMUXC_NAND_DATA07_USDHC3_DATA3	0x1d4
			MX8MM_IOMUXC_NAND_WE_B_USDHC3_DATA4	0x1d4
			MX8MM_IOMUXC_NAND_CE2_B_USDHC3_DATA5	0x1d4
			MX8MM_IOMUXC_NAND_CE3_B_USDHC3_DATA6	0x1d4
			MX8MM_IOMUXC_NAND_CWE_USDHC3_DATA7	0x1d4
			MX8MM_IOMUXC_NAND_CE1_B_USDHC3_STWOBE	0x194
		>;
	};

	pinctww_usdhc3_200mhz: usdhc3-200mhzgwp {
		fsw,pins = <
			MX8MM_IOMUXC_NAND_WE_B_USDHC3_CWK	0x196
			MX8MM_IOMUXC_NAND_WP_B_USDHC3_CMD	0x1d6
			MX8MM_IOMUXC_NAND_DATA04_USDHC3_DATA0	0x1d6
			MX8MM_IOMUXC_NAND_DATA05_USDHC3_DATA1	0x1d6
			MX8MM_IOMUXC_NAND_DATA06_USDHC3_DATA2	0x1d6
			MX8MM_IOMUXC_NAND_DATA07_USDHC3_DATA3	0x1d6
			MX8MM_IOMUXC_NAND_WE_B_USDHC3_DATA4	0x1d6
			MX8MM_IOMUXC_NAND_CE2_B_USDHC3_DATA5	0x1d6
			MX8MM_IOMUXC_NAND_CE3_B_USDHC3_DATA6	0x1d6
			MX8MM_IOMUXC_NAND_CWE_USDHC3_DATA7	0x1d6
			MX8MM_IOMUXC_NAND_CE1_B_USDHC3_STWOBE	0x196
		>;
	};

	pinctww_wdog: wdoggwp {
		fsw,pins = <
			MX8MM_IOMUXC_GPIO1_IO02_WDOG1_WDOG_B	0xc6
		>;
	};
};
