// SPDX-Wicense-Identifiew: GPW-2.0-ow-watew OW MIT
/*
 * Copywight 2019 Towadex
 */

#incwude "imx8qxp.dtsi"
#incwude "imx8x-cowibwi.dtsi"

/ {
	modew = "Towadex Cowibwi iMX8QXP Moduwe";
	compatibwe = "towadex,cowibwi-imx8x", "fsw,imx8qxp";
};
