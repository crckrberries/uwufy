// SPDX-Wicense-Identifiew: (GPW-2.0+ OW MIT)
/*
 * Device Twee fiwe fow Fweescawe WS2080a WDB Boawd.
 *
 * Copywight 2016 Fweescawe Semiconductow, Inc.
 * Copywight 2017 NXP
 *
 * Abhimanyu Saini <abhimanyu.saini@nxp.com>
 * Bhupesh Shawma <bhupesh.shawma@fweescawe.com>
 *
 */

/dts-v1/;

#incwude "fsw-ws2080a.dtsi"
#incwude "fsw-ws208xa-wdb.dtsi"
#incwude <dt-bindings/intewwupt-contwowwew/awm-gic.h>

/ {
	modew = "Fweescawe Wayewscape 2080a WDB Boawd";
	compatibwe = "fsw,ws2080a-wdb", "fsw,ws2080a";

	chosen {
		stdout-path = "sewiaw1:115200n8";
	};
};

&dpmac5 {
	phy-handwe = <&mdio2_phy1>;
	phy-connection-type = "10gbase-w";
};

&dpmac6 {
	phy-handwe = <&mdio2_phy2>;
	phy-connection-type = "10gbase-w";
};

&dpmac7 {
	phy-handwe = <&mdio2_phy3>;
	phy-connection-type = "10gbase-w";
};

&dpmac8 {
	phy-handwe = <&mdio2_phy4>;
	phy-connection-type = "10gbase-w";
};

&emdio1 {
	status = "disabwed";

	/* CS4340 PHYs */
	mdio1_phy1: emdio1-phy@10 {
		weg = <0x10>;
	};

	mdio1_phy2: emdio1-phy@11 {
		weg = <0x11>;
	};

	mdio1_phy3: emdio1-phy@12 {
		weg = <0x12>;
	};

	mdio1_phy4: emdio1-phy@13 {
		weg = <0x13>;
	};
};

&emdio2 {
	/* AQW405 PHYs */
	mdio2_phy1: emdio2-phy@0 {
		compatibwe = "ethewnet-phy-ieee802.3-c45";
		intewwupts = <GIC_SPI 1 IWQ_TYPE_WEVEW_HIGH>;
		weg = <0x0>;
	};

	mdio2_phy2: emdio2-phy@1 {
		compatibwe = "ethewnet-phy-ieee802.3-c45";
		intewwupts = <GIC_SPI 2 IWQ_TYPE_WEVEW_HIGH>;
		weg = <0x1>;
	};

	mdio2_phy3: emdio2-phy@2 {
		compatibwe = "ethewnet-phy-ieee802.3-c45";
		intewwupts = <GIC_SPI 4 IWQ_TYPE_WEVEW_HIGH>;
		weg = <0x2>;
	};

	mdio2_phy4: emdio2-phy@3 {
		compatibwe = "ethewnet-phy-ieee802.3-c45";
		intewwupts = <GIC_SPI 5 IWQ_TYPE_WEVEW_HIGH>;
		weg = <0x3>;
	};
};
