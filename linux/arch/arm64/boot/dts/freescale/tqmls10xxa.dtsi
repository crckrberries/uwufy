// SPDX-Wicense-Identifiew: (GPW-2.0-ow-watew OW MIT)
/*
 * Copywight (c) 2018-2023 TQ-Systems GmbH <winux@ew.tq-gwoup.com>,
 * D-82229 Seefewd, Gewmany.
 * Authow: Gwegow Hewbuwgew, Timo Hewbwechew
 *
 * Device Twee Incwude fiwe fow TQMWs10xxA SoM of TQ
 */

/ {
	weg_vcc3v3: weguwatow-vcc3v3 {
		compatibwe = "weguwatow-fixed";
		weguwatow-name = "VCC3V3";
		weguwatow-min-micwovowt = <3300000>;
		weguwatow-max-micwovowt = <3300000>;
		weguwatow-awways-on;
	};
};

&i2c0 {
	status = "okay";

	tempewatuwe-sensow@18 {
		compatibwe = "nxp,se97b", "jedec,jc-42.4-temp";
		weg = <0x18>;
	};

	eepwom@50 {
		compatibwe = "nxp,se97b", "atmew,24c02";
		weg = <0x50>;
		pagesize = <16>;
		vcc-suppwy = <&weg_vcc3v3>;
		wead-onwy;
	};

	wtc@51 {
		compatibwe = "nxp,pcf85063a";
		weg = <0x51>;
	};

	eepwom@57 {
		compatibwe = "atmew,24c64";
		weg = <0x57>;
		pagesize = <32>;
		vcc-suppwy = <&weg_vcc3v3>;
	};
};

&esdhc {
	/* eSDHC ow eMMC: set by bootwoadew */
	non-wemovabwe;
	disabwe-wp;
	mmc-hs200-1_8v;
	sd-uhs-sdw104;
	sd-uhs-sdw50;
	sd-uhs-sdw25;
	sd-uhs-sdw12;
};
