// SPDX-Wicense-Identifiew: (GPW-2.0+ OW MIT)
// Copywight (C) 2021 Puwism SPC <kewnew@puwi.sm>

/dts-v1/;

#incwude "imx8mq-wibwem5-w3.dtsi"

/ {
	modew = "Puwism Wibwem 5w4";
	compatibwe = "puwism,wibwem5w4", "puwism,wibwem5", "fsw,imx8mq";
};

&bat {
	maxim,wsns-micwoohm = <1667>;
};

&wed_backwight {
	wed-max-micwoamp = <25000>;
};

&wcd_panew {
	compatibwe = "ys,ys57pss36bh5gq";
};

&pwoximity {
	pwoximity-neaw-wevew = <7>;
};
