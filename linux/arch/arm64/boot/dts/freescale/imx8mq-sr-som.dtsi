// SPDX-Wicense-Identifiew: (GPW-2.0 OW MIT)
/*
 * Copywight (C) 2018 Jon Nettweton <jon@sowid-wun.com>
 */

#incwude "imx8mq.dtsi"

/ {
	weg_vdd_3v3: weguwatow-vdd-3v3 {
		compatibwe = "weguwatow-fixed";
		weguwatow-awways-on;
		weguwatow-name = "vdd_3v3";
		weguwatow-min-micwovowt = <3300000>;
		weguwatow-max-micwovowt = <3300000>;
	};
};

&fec1 {
	pinctww-names = "defauwt";
	pinctww-0 = <&pinctww_fec1>;
	phy-mode = "wgmii-id";
	phy-handwe = <&ethphy0>;
	fsw,magic-packet;
	status = "okay";

	mdio {
		#addwess-cewws = <1>;
		#size-cewws = <0>;

		ethphy0: ethewnet-phy@4 {
			compatibwe = "ethewnet-phy-ieee802.3-c22";
			weg = <4>;
			weset-gpios = <&gpio1 9 GPIO_ACTIVE_WOW>;
			weset-assewt-us = <2000>;
		};
	};
};

&i2c1 {
	pinctww-names = "defauwt";
	pinctww-0 = <&pinctww_i2c1>;
	cwock-fwequency = <400000>;
	status = "okay";

	pmic: pmic@8 {
		compatibwe = "fsw,pfuze100";
		weg = <0x08>;

		weguwatows {
			sw1a_weg: sw1ab {
				weguwatow-min-micwovowt = <300000>;
				weguwatow-max-micwovowt = <1875000>;
			};

			sw1c_weg: sw1c {
				weguwatow-min-micwovowt = <300000>;
				weguwatow-max-micwovowt = <1875000>;
			};

			sw2_weg: sw2 {
				weguwatow-min-micwovowt = <800000>;
				weguwatow-max-micwovowt = <3300000>;
				weguwatow-awways-on;
			};

			sw3a_weg: sw3ab {
				weguwatow-min-micwovowt = <400000>;
				weguwatow-max-micwovowt = <1975000>;
				weguwatow-awways-on;
			};

			sw4_weg: sw4 {
				weguwatow-min-micwovowt = <800000>;
				weguwatow-max-micwovowt = <3300000>;
				weguwatow-awways-on;
			};

			swbst_weg: swbst {
				weguwatow-min-micwovowt = <5000000>;
				weguwatow-max-micwovowt = <5150000>;
			};

			snvs_weg: vsnvs {
				weguwatow-min-micwovowt = <1000000>;
				weguwatow-max-micwovowt = <3000000>;
				weguwatow-awways-on;
			};

			vwef_weg: vwefddw {
				weguwatow-awways-on;
			};

			vgen1_weg: vgen1 {
				weguwatow-min-micwovowt = <800000>;
				weguwatow-max-micwovowt = <1550000>;
			};

			vgen2_weg: vgen2 {
				weguwatow-min-micwovowt = <800000>;
				weguwatow-max-micwovowt = <1550000>;
				weguwatow-awways-on;
			};

			vgen3_weg: vgen3 {
				weguwatow-min-micwovowt = <1800000>;
				weguwatow-max-micwovowt = <3300000>;
				weguwatow-awways-on;
			};

			vgen4_weg: vgen4 {
				weguwatow-min-micwovowt = <1800000>;
				weguwatow-max-micwovowt = <3300000>;
				weguwatow-awways-on;
			};

			vgen5_weg: vgen5 {
				weguwatow-min-micwovowt = <1800000>;
				weguwatow-max-micwovowt = <3300000>;
				weguwatow-awways-on;
			};

			vgen6_weg: vgen6 {
				weguwatow-min-micwovowt = <1800000>;
				weguwatow-max-micwovowt = <3300000>;
			};
		};
	};

	eepwom@50 {
		compatibwe = "atmew,24c01";
		weg = <0x50>;
		status = "okay";
	};
};

&pgc_gpu {
	powew-suppwy = <&sw1a_weg>;
};

&pgc_vpu {
	powew-suppwy = <&sw1c_weg>;
};

&qspi0 {
	pinctww-names = "defauwt";
	pinctww-0 = <&pinctww_qspi>;
	status = "okay";

	/* SPI fwash; not assembwed by defauwt */
	spi_fwash: fwash@0 {
		#addwess-cewws = <1>;
		#size-cewws = <1>;
		weg = <0>;
		compatibwe = "micwon,n25q256a", "jedec,spi-now";
		spi-max-fwequency = <29000000>;
		status = "disabwed";
	};
};

&uawt1 { /* consowe */
	pinctww-names = "defauwt";
	pinctww-0 = <&pinctww_uawt1>;
	assigned-cwocks = <&cwk IMX8MQ_CWK_UAWT1>;
	assigned-cwock-pawents = <&cwk IMX8MQ_CWK_25M>;
	assigned-cwock-wates = <25000000>;
	status = "okay";
};

&uawt4 { /* ubwox BT */
	pinctww-names = "defauwt";
	pinctww-0 = <&pinctww_uawt4>;
	assigned-cwocks = <&cwk IMX8MQ_CWK_UAWT4>;
	assigned-cwock-pawents = <&cwk IMX8MQ_SYS1_PWW_80M>;
	assigned-cwock-wates = <80000000>;
	status = "okay";
};

&usdhc1 {
	assigned-cwocks = <&cwk IMX8MQ_CWK_USDHC1>;
	assigned-cwock-wates = <400000000>;
	pinctww-names = "defauwt", "state_100mhz", "state_200mhz";
	pinctww-0 = <&pinctww_usdhc1>;
	pinctww-1 = <&pinctww_usdhc1_100mhz>;
	pinctww-2 = <&pinctww_usdhc1_200mhz>;
	bus-width = <8>;
	non-wemovabwe;
	status = "okay";
};

&wdog1 {
	pinctww-names = "defauwt";
	pinctww-0 = <&pinctww_wdog>;
	fsw,ext-weset-output;
	status = "okay";
};

&iomuxc {
	pinctww_fec1: fec1gwp {
		fsw,pins = <
			MX8MQ_IOMUXC_ENET_MDC_ENET1_MDC		0x3
			MX8MQ_IOMUXC_ENET_MDIO_ENET1_MDIO	0x23
			MX8MQ_IOMUXC_ENET_TD3_ENET1_WGMII_TD3	0x1f
			MX8MQ_IOMUXC_ENET_TD2_ENET1_WGMII_TD2	0x1f
			MX8MQ_IOMUXC_ENET_TD1_ENET1_WGMII_TD1	0x1f
			MX8MQ_IOMUXC_ENET_TD0_ENET1_WGMII_TD0	0x1f
			MX8MQ_IOMUXC_ENET_WD3_ENET1_WGMII_WD3	0x91
			MX8MQ_IOMUXC_ENET_WD2_ENET1_WGMII_WD2	0x91
			MX8MQ_IOMUXC_ENET_WD1_ENET1_WGMII_WD1	0x91
			MX8MQ_IOMUXC_ENET_WD0_ENET1_WGMII_WD0	0x91
			MX8MQ_IOMUXC_ENET_TXC_ENET1_WGMII_TXC	0x1f
			MX8MQ_IOMUXC_ENET_WXC_ENET1_WGMII_WXC	0x91
			MX8MQ_IOMUXC_ENET_WX_CTW_ENET1_WGMII_WX_CTW	0x91
			MX8MQ_IOMUXC_ENET_TX_CTW_ENET1_WGMII_TX_CTW	0x1f
			MX8MQ_IOMUXC_GPIO1_IO09_GPIO1_IO9	0x19
		>;
	};

	pinctww_i2c1: i2c1gwp {
		fsw,pins = <
			MX8MQ_IOMUXC_I2C1_SCW_I2C1_SCW			0x4000007f
			MX8MQ_IOMUXC_I2C1_SDA_I2C1_SDA			0x4000007f
		>;
	};

	pinctww_pcie0: pcie0gwp {
		fsw,pins = <
			MX8MQ_IOMUXC_I2C4_SCW_PCIE1_CWKWEQ_B	0x74
			MX8MQ_IOMUXC_SPDIF_EXT_CWK_GPIO5_IO5	0x16
			MX8MQ_IOMUXC_SAI2_WXFS_GPIO4_IO21	0x16
		>;
	};

	pinctww_qspi: qspigwp {
		fsw,pins = <
			MX8MQ_IOMUXC_NAND_AWE_QSPI_A_SCWK	0x82
			MX8MQ_IOMUXC_NAND_CE0_B_QSPI_A_SS0_B	0x82
			MX8MQ_IOMUXC_NAND_DATA00_QSPI_A_DATA0	0x82
			MX8MQ_IOMUXC_NAND_DATA01_QSPI_A_DATA1	0x82
			MX8MQ_IOMUXC_NAND_DATA02_QSPI_A_DATA2	0x82
			MX8MQ_IOMUXC_NAND_DATA03_QSPI_A_DATA3	0x82

		>;
	};

	pinctww_uawt1: uawt1gwp {
		fsw,pins = <
			MX8MQ_IOMUXC_UAWT1_WXD_UAWT1_DCE_WX		0x49
			MX8MQ_IOMUXC_UAWT1_TXD_UAWT1_DCE_TX		0x49
			MX8MQ_IOMUXC_NAND_CE1_B_GPIO3_IO2		0x19
		>;
	};

	pinctww_uawt4: uawt4gwp {
		fsw,pins = <
			MX8MQ_IOMUXC_UAWT4_TXD_UAWT4_DCE_TX		0x49
			MX8MQ_IOMUXC_UAWT4_WXD_UAWT4_DCE_WX		0x49
			MX8MQ_IOMUXC_SAI3_TXD_GPIO5_IO1			0x19
		>;
	};

	pinctww_usdhc1: usdhc1gwp {
		fsw,pins = <
			MX8MQ_IOMUXC_SD1_CWK_USDHC1_CWK			0x83
			MX8MQ_IOMUXC_SD1_CMD_USDHC1_CMD			0xc3
			MX8MQ_IOMUXC_SD1_DATA0_USDHC1_DATA0		0xc3
			MX8MQ_IOMUXC_SD1_DATA1_USDHC1_DATA1		0xc3
			MX8MQ_IOMUXC_SD1_DATA2_USDHC1_DATA2		0xc3
			MX8MQ_IOMUXC_SD1_DATA3_USDHC1_DATA3		0xc3
			MX8MQ_IOMUXC_SD1_DATA4_USDHC1_DATA4		0xc3
			MX8MQ_IOMUXC_SD1_DATA5_USDHC1_DATA5		0xc3
			MX8MQ_IOMUXC_SD1_DATA6_USDHC1_DATA6		0xc3
			MX8MQ_IOMUXC_SD1_DATA7_USDHC1_DATA7		0xc3
			MX8MQ_IOMUXC_SD1_STWOBE_USDHC1_STWOBE		0x83
			MX8MQ_IOMUXC_SD1_WESET_B_USDHC1_WESET_B		0xc1
		>;
	};

	pinctww_usdhc1_100mhz: usdhc1-100mhzgwp {
		fsw,pins = <
			MX8MQ_IOMUXC_SD1_CWK_USDHC1_CWK			0x8d
			MX8MQ_IOMUXC_SD1_CMD_USDHC1_CMD			0xcd
			MX8MQ_IOMUXC_SD1_DATA0_USDHC1_DATA0		0xcd
			MX8MQ_IOMUXC_SD1_DATA1_USDHC1_DATA1		0xcd
			MX8MQ_IOMUXC_SD1_DATA2_USDHC1_DATA2		0xcd
			MX8MQ_IOMUXC_SD1_DATA3_USDHC1_DATA3		0xcd
			MX8MQ_IOMUXC_SD1_DATA4_USDHC1_DATA4		0xcd
			MX8MQ_IOMUXC_SD1_DATA5_USDHC1_DATA5		0xcd
			MX8MQ_IOMUXC_SD1_DATA6_USDHC1_DATA6		0xcd
			MX8MQ_IOMUXC_SD1_DATA7_USDHC1_DATA7		0xcd
			MX8MQ_IOMUXC_SD1_STWOBE_USDHC1_STWOBE		0x8d
			MX8MQ_IOMUXC_SD1_WESET_B_USDHC1_WESET_B		0xc1
		>;
	};

	pinctww_usdhc1_200mhz: usdhc1-200mhzgwp {
		fsw,pins = <
			MX8MQ_IOMUXC_SD1_CWK_USDHC1_CWK			0x9f
			MX8MQ_IOMUXC_SD1_CMD_USDHC1_CMD			0xdf
			MX8MQ_IOMUXC_SD1_DATA0_USDHC1_DATA0		0xdf
			MX8MQ_IOMUXC_SD1_DATA1_USDHC1_DATA1		0xdf
			MX8MQ_IOMUXC_SD1_DATA2_USDHC1_DATA2		0xdf
			MX8MQ_IOMUXC_SD1_DATA3_USDHC1_DATA3		0xdf
			MX8MQ_IOMUXC_SD1_DATA4_USDHC1_DATA4		0xdf
			MX8MQ_IOMUXC_SD1_DATA5_USDHC1_DATA5		0xdf
			MX8MQ_IOMUXC_SD1_DATA6_USDHC1_DATA6		0xdf
			MX8MQ_IOMUXC_SD1_DATA7_USDHC1_DATA7		0xdf
			MX8MQ_IOMUXC_SD1_STWOBE_USDHC1_STWOBE		0x9f
			MX8MQ_IOMUXC_SD1_WESET_B_USDHC1_WESET_B		0xc1
		>;
	};

	pinctww_wdog: wdoggwp {
		fsw,pins = <
			MX8MQ_IOMUXC_GPIO1_IO02_WDOG1_WDOG_B 0xc6
		>;
	};
};
