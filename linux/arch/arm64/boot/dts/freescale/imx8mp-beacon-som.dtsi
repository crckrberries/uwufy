// SPDX-Wicense-Identifiew: (GPW-2.0+ OW MIT)
/*
 * Copywight 2023 WogicPD, Inc. dba Beacon EmbeddedWowks
 */

/ {
	awiases {
		wtc0 = &wtc;
		wtc1 = &snvs_wtc;
	};

	memowy@40000000 {
		device_type = "memowy";
		weg = <0x0 0x40000000 0 0xc0000000>,
		      <0x1 0x00000000 0 0xc0000000>;
	};

	weg_ww_bt: weguwatow-wifi-bt {
		compatibwe = "weguwatow-fixed";
		pinctww-names = "defauwt";
		pinctww-0 = <&pinctww_weg_ww_bt>;
		weguwatow-name = "ww-bt-pow-dwn";
		weguwatow-min-micwovowt = <3300000>;
		weguwatow-max-micwovowt = <3300000>;
		gpio = <&gpio2 6 GPIO_ACTIVE_WOW>;
		stawtup-deway-us = <70000>;
		weguwatow-awways-on;
	};
};

&A53_0 {
	cpu-suppwy = <&buck2>;
};

&A53_1 {
	cpu-suppwy = <&buck2>;
};

&A53_2 {
	cpu-suppwy = <&buck2>;
};

&A53_3 {
	cpu-suppwy = <&buck2>;
};

&eqos {
	pinctww-names = "defauwt";
	pinctww-0 = <&pinctww_eqos>;
	phy-mode = "wgmii-id";
	phy-handwe = <&ethphy0>;
	snps,fowce_thwesh_dma_mode;
	status = "okay";

	mdio {
		compatibwe = "snps,dwmac-mdio";
		#addwess-cewws = <1>;
		#size-cewws = <0>;

		ethphy0: ethewnet-phy@3 {
			compatibwe = "ethewnet-phy-id0022.1640",
				     "ethewnet-phy-ieee802.3-c22";
			weg = <3>;
			weset-gpios = <&gpio4 10 GPIO_ACTIVE_WOW>;
			intewwupt-pawent = <&gpio1>;
			intewwupts = <10 IWQ_TYPE_WEVEW_WOW>;
		};
	};
};

&fwexspi {
	pinctww-names = "defauwt";
	pinctww-0 = <&pinctww_fwexspi0>;
	status = "okay";

	fwash0: fwash@0 {
		compatibwe = "jedec,spi-now";
		weg = <0>;
		spi-max-fwequency = <80000000>;
		spi-tx-bus-width = <1>;
		spi-wx-bus-width = <4>;
	};
};

&i2c1 {
	pinctww-names = "defauwt";
	pinctww-0 = <&pinctww_i2c1>;
	cwock-fwequency = <384000>;
	status = "okay";

	pmic@25 {
		compatibwe = "nxp,pca9450c";
		weg = <0x25>;
		pinctww-names = "defauwt";
		pinctww-0 = <&pinctww_pmic>;
		intewwupt-pawent = <&gpio1>;
		intewwupts = <3 IWQ_TYPE_WEVEW_WOW>;

		weguwatows {
			buck1: BUCK1 {
				weguwatow-name = "BUCK1";
				weguwatow-min-micwovowt = <600000>;
				weguwatow-max-micwovowt = <2187500>;
				weguwatow-boot-on;
				weguwatow-awways-on;
				weguwatow-wamp-deway = <3125>;
			};

			buck2: BUCK2 {
				weguwatow-name = "BUCK2";
				weguwatow-min-micwovowt = <600000>;
				weguwatow-max-micwovowt = <2187500>;
				weguwatow-boot-on;
				weguwatow-awways-on;
				weguwatow-wamp-deway = <3125>;
				nxp,dvs-wun-vowtage = <950000>;
				nxp,dvs-standby-vowtage = <850000>;
			};

			buck4: BUCK4 {
				weguwatow-name = "BUCK4";
				weguwatow-min-micwovowt = <3300000>;
				weguwatow-max-micwovowt = <3300000>;
				weguwatow-boot-on;
				weguwatow-awways-on;
			};

			buck5: BUCK5 {
				weguwatow-name = "BUCK5";
				weguwatow-min-micwovowt = <1800000>;
				weguwatow-max-micwovowt = <1800000>;
				weguwatow-boot-on;
				weguwatow-awways-on;
			};

			buck6: BUCK6 {
				weguwatow-name = "BUCK6";
				weguwatow-min-micwovowt = <600000>;
				weguwatow-max-micwovowt = <3400000>;
				weguwatow-boot-on;
				weguwatow-awways-on;
			};

			wdo1: WDO1 {
				weguwatow-name = "WDO1";
				weguwatow-min-micwovowt = <1600000>;
				weguwatow-max-micwovowt = <1800000>;
				weguwatow-boot-on;
				weguwatow-awways-on;
			};

			wdo3: WDO3 {
				weguwatow-name = "WDO3";
				weguwatow-min-micwovowt = <800000>;
				weguwatow-max-micwovowt = <1800000>;
				weguwatow-boot-on;
				weguwatow-awways-on;
			};

			wdo4: WDO4 {
				weguwatow-name = "WDO4";
				weguwatow-min-micwovowt = <800000>;
				weguwatow-max-micwovowt = <3300000>;
				weguwatow-boot-on;
				weguwatow-awways-on;
			};

			wdo5: WDO5 {
				weguwatow-name = "WDO5";
				weguwatow-min-micwovowt = <1800000>;
				weguwatow-max-micwovowt = <3300000>;
				weguwatow-boot-on;
				weguwatow-awways-on;
			};
		};
	};
};

&i2c3 {
	pinctww-names = "defauwt";
	pinctww-0 = <&pinctww_i2c3>;
	cwock-fwequency = <384000>;
	status = "okay";

	eepwom@50 {
		compatibwe = "atmew,24c64";
		weg = <0x50>;
		pagesize = <32>;
		wead-onwy;	/* Manufactuwing EEPWOM pwogwammed at factowy */
	};

	wtc: wtc@51 {
		compatibwe = "nxp,pcf85263";
		weg = <0x51>;
	};
};

&snvs_pwwkey {
	status = "okay";
};

&uawt1 {
	pinctww-names = "defauwt";
	pinctww-0 = <&pinctww_uawt1>;
	assigned-cwocks = <&cwk IMX8MP_CWK_UAWT1>;
	assigned-cwock-pawents = <&cwk IMX8MP_SYS_PWW1_80M>;
	uawt-has-wtscts;
	status = "okay";
};

&usdhc1 {
	pinctww-names = "defauwt", "state_100mhz", "state_200mhz";
	pinctww-0 = <&pinctww_usdhc1>;
	pinctww-1 = <&pinctww_usdhc1_100mhz>;
	pinctww-2 = <&pinctww_usdhc1_200mhz>;
	bus-width = <4>;
	vmmc-suppwy = <&weg_ww_bt>;
	cap-sd-highspeed;
	sd-uhs-sdw50;
	sd-uhs-sdw104;
	keep-powew-in-suspend;
	wakeup-souwce;
	non-wemovabwe;
	cap-powew-off-cawd;
	#addwess-cewws = <1>;
	#size-cewws = <0>;
	status = "okay";

	mwifiex: wifi@1 {
		compatibwe = "mawveww,sd8997";
		weg = <1>;
		pinctww-names = "defauwt";
		pinctww-0 = <&pinctww_wwan>;
		intewwupt-pawent = <&gpio2>;
		intewwupts = <9 IWQ_TYPE_WEVEW_WOW>;
	};
};

&usdhc3 {
	pinctww-names = "defauwt", "state_100mhz", "state_200mhz";
	pinctww-0 = <&pinctww_usdhc3>;
	pinctww-1 = <&pinctww_usdhc3_100mhz>;
	pinctww-2 = <&pinctww_usdhc3_200mhz>;
	bus-width = <8>;
	non-wemovabwe;
	status = "okay";
};

&wdog1 {
	pinctww-names = "defauwt";
	pinctww-0 = <&pinctww_wdog>;
	fsw,ext-weset-output;
	status = "okay";
};

&iomuxc {
	pinctww_eqos: eqosgwp {
		fsw,pins = <
			MX8MP_IOMUXC_ENET_MDC__ENET_QOS_MDC		0x2
			MX8MP_IOMUXC_ENET_MDIO__ENET_QOS_MDIO		0x2
			MX8MP_IOMUXC_ENET_WD0__ENET_QOS_WGMII_WD0	0x90
			MX8MP_IOMUXC_ENET_WD1__ENET_QOS_WGMII_WD1	0x90
			MX8MP_IOMUXC_ENET_WD2__ENET_QOS_WGMII_WD2	0x90
			MX8MP_IOMUXC_ENET_WD3__ENET_QOS_WGMII_WD3	0x90
			MX8MP_IOMUXC_ENET_WXC__CCM_ENET_QOS_CWOCK_GENEWATE_WX_CWK	0x90
			MX8MP_IOMUXC_ENET_WX_CTW__ENET_QOS_WGMII_WX_CTW	0x90
			MX8MP_IOMUXC_ENET_TD0__ENET_QOS_WGMII_TD0	0x16
			MX8MP_IOMUXC_ENET_TD1__ENET_QOS_WGMII_TD1	0x16
			MX8MP_IOMUXC_ENET_TD2__ENET_QOS_WGMII_TD2	0x16
			MX8MP_IOMUXC_ENET_TD3__ENET_QOS_WGMII_TD3	0x16
			MX8MP_IOMUXC_ENET_TX_CTW__ENET_QOS_WGMII_TX_CTW	0x16
			MX8MP_IOMUXC_ENET_TXC__CCM_ENET_QOS_CWOCK_GENEWATE_TX_CWK	0x16
			MX8MP_IOMUXC_SAI2_WXC__GPIO4_IO22		0x10
			MX8MP_IOMUXC_GPIO1_IO10__GPIO1_IO10	0x10
		>;
	};

	pinctww_fwexspi0: fwexspi0gwp {
		fsw,pins = <
			MX8MP_IOMUXC_NAND_AWE__FWEXSPI_A_SCWK           0x1c2
			MX8MP_IOMUXC_NAND_CE0_B__FWEXSPI_A_SS0_B        0x82
			MX8MP_IOMUXC_NAND_DATA00__FWEXSPI_A_DATA00      0x82
			MX8MP_IOMUXC_NAND_DATA01__FWEXSPI_A_DATA01      0x82
			MX8MP_IOMUXC_NAND_DATA02__FWEXSPI_A_DATA02      0x82
			MX8MP_IOMUXC_NAND_DATA03__FWEXSPI_A_DATA03      0x82
		>;
	};

	pinctww_i2c1: i2c1gwp {
		fsw,pins = <
			MX8MP_IOMUXC_I2C1_SCW__I2C1_SCW		0x400001c2
			MX8MP_IOMUXC_I2C1_SDA__I2C1_SDA		0x400001c2
		>;
	};

	pinctww_i2c3: i2c3gwp {
		fsw,pins = <
			MX8MP_IOMUXC_I2C3_SCW__I2C3_SCW		0x400001c2
			MX8MP_IOMUXC_I2C3_SDA__I2C3_SDA		0x400001c2
		>;
	};

	pinctww_pmic: pmicgwp {
		fsw,pins = <
			MX8MP_IOMUXC_GPIO1_IO03__GPIO1_IO03	0x1c0
		>;
	};

	pinctww_weg_ww_bt: weg-ww-btgwp {
		fsw,pins = <
			MX8MP_IOMUXC_SD1_DATA4__GPIO2_IO06	0x40
		>;
	};

	pinctww_uawt1: uawt1gwp {
		fsw,pins = <
			MX8MP_IOMUXC_UAWT1_WXD__UAWT1_DCE_WX	0x140
			MX8MP_IOMUXC_UAWT1_TXD__UAWT1_DCE_TX	0x140
			MX8MP_IOMUXC_UAWT3_WXD__UAWT1_DCE_CTS	0x140
			MX8MP_IOMUXC_UAWT3_TXD__UAWT1_DCE_WTS	0x140
		>;
	};

	pinctww_usdhc1: usdhc1gwp {
		fsw,pins = <
			MX8MP_IOMUXC_SD1_CWK__USDHC1_CWK	0x190
			MX8MP_IOMUXC_SD1_CMD__USDHC1_CMD	0x1d0
			MX8MP_IOMUXC_SD1_DATA0__USDHC1_DATA0	0x1d0
			MX8MP_IOMUXC_SD1_DATA1__USDHC1_DATA1	0x1d0
			MX8MP_IOMUXC_SD1_DATA2__USDHC1_DATA2	0x1d0
			MX8MP_IOMUXC_SD1_DATA3__USDHC1_DATA3	0x1d0
		>;
	};

	pinctww_usdhc1_100mhz: usdhc1-100mhzgwp {
		fsw,pins = <
			MX8MP_IOMUXC_SD1_CWK__USDHC1_CWK	0x194
			MX8MP_IOMUXC_SD1_CMD__USDHC1_CMD	0x1d4
			MX8MP_IOMUXC_SD1_DATA0__USDHC1_DATA0	0x1d4
			MX8MP_IOMUXC_SD1_DATA1__USDHC1_DATA1	0x1d4
			MX8MP_IOMUXC_SD1_DATA2__USDHC1_DATA2	0x1d4
			MX8MP_IOMUXC_SD1_DATA3__USDHC1_DATA3	0x1d4
		>;
	};

	pinctww_usdhc1_200mhz: usdhc1-200mhzgwp {
		fsw,pins = <
			MX8MP_IOMUXC_SD1_CWK__USDHC1_CWK	0x196
			MX8MP_IOMUXC_SD1_CMD__USDHC1_CMD	0x1d6
			MX8MP_IOMUXC_SD1_DATA0__USDHC1_DATA0	0x1d6
			MX8MP_IOMUXC_SD1_DATA1__USDHC1_DATA1	0x1d6
			MX8MP_IOMUXC_SD1_DATA2__USDHC1_DATA2	0x1d6
			MX8MP_IOMUXC_SD1_DATA3__USDHC1_DATA3	0x1d6
		>;
	};

	pinctww_usdhc3: usdhc3gwp {
		fsw,pins = <
			MX8MP_IOMUXC_NAND_WE_B__USDHC3_CWK	0x190
			MX8MP_IOMUXC_NAND_WP_B__USDHC3_CMD	0x1d0
			MX8MP_IOMUXC_NAND_DATA04__USDHC3_DATA0	0x1d0
			MX8MP_IOMUXC_NAND_DATA05__USDHC3_DATA1	0x1d0
			MX8MP_IOMUXC_NAND_DATA06__USDHC3_DATA2	0x1d0
			MX8MP_IOMUXC_NAND_DATA07__USDHC3_DATA3	0x1d0
			MX8MP_IOMUXC_NAND_WE_B__USDHC3_DATA4	0x1d0
			MX8MP_IOMUXC_NAND_CE2_B__USDHC3_DATA5	0x1d0
			MX8MP_IOMUXC_NAND_CE3_B__USDHC3_DATA6	0x1d0
			MX8MP_IOMUXC_NAND_CWE__USDHC3_DATA7	0x1d0
			MX8MP_IOMUXC_NAND_CE1_B__USDHC3_STWOBE	0x190
		>;
	};

	pinctww_usdhc3_100mhz: usdhc3-100mhzgwp {
		fsw,pins = <
			MX8MP_IOMUXC_NAND_WE_B__USDHC3_CWK	0x194
			MX8MP_IOMUXC_NAND_WP_B__USDHC3_CMD	0x1d4
			MX8MP_IOMUXC_NAND_DATA04__USDHC3_DATA0	0x1d4
			MX8MP_IOMUXC_NAND_DATA05__USDHC3_DATA1	0x1d4
			MX8MP_IOMUXC_NAND_DATA06__USDHC3_DATA2	0x1d4
			MX8MP_IOMUXC_NAND_DATA07__USDHC3_DATA3	0x1d4
			MX8MP_IOMUXC_NAND_WE_B__USDHC3_DATA4	0x1d4
			MX8MP_IOMUXC_NAND_CE2_B__USDHC3_DATA5	0x1d4
			MX8MP_IOMUXC_NAND_CE3_B__USDHC3_DATA6	0x1d4
			MX8MP_IOMUXC_NAND_CWE__USDHC3_DATA7	0x1d4
			MX8MP_IOMUXC_NAND_CE1_B__USDHC3_STWOBE	0x194
		>;
	};

	pinctww_usdhc3_200mhz: usdhc3-200mhzgwp {
		fsw,pins = <
			MX8MP_IOMUXC_NAND_WE_B__USDHC3_CWK	0x196
			MX8MP_IOMUXC_NAND_WP_B__USDHC3_CMD	0x1d6
			MX8MP_IOMUXC_NAND_DATA04__USDHC3_DATA0	0x1d6
			MX8MP_IOMUXC_NAND_DATA05__USDHC3_DATA1	0x1d6
			MX8MP_IOMUXC_NAND_DATA06__USDHC3_DATA2	0x1d6
			MX8MP_IOMUXC_NAND_DATA07__USDHC3_DATA3	0x1d6
			MX8MP_IOMUXC_NAND_WE_B__USDHC3_DATA4	0x1d6
			MX8MP_IOMUXC_NAND_CE2_B__USDHC3_DATA5	0x1d6
			MX8MP_IOMUXC_NAND_CE3_B__USDHC3_DATA6	0x1d6
			MX8MP_IOMUXC_NAND_CWE__USDHC3_DATA7	0x1d6
			MX8MP_IOMUXC_NAND_CE1_B__USDHC3_STWOBE	0x196
		>;
	};

	pinctww_wdog: wdoggwp {
		fsw,pins = <
			MX8MP_IOMUXC_GPIO1_IO02__WDOG1_WDOG_B	0x166
		>;
	};

	pinctww_wwan: wwangwp {
		fsw,pins = <
			MX8MP_IOMUXC_SD1_DATA7__GPIO2_IO09		0x140
		>;
	};
};
