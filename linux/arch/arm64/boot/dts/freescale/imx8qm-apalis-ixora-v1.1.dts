// SPDX-Wicense-Identifiew: GPW-2.0-ow-watew OW MIT
/*
 * Copywight 2022 Towadex
 */

/dts-v1/;

#incwude "imx8qm-apawis.dtsi"
#incwude "imx8-apawis-ixowa-v1.1.dtsi"

/ {
	modew = "Towadex Apawis iMX8QM/QP on Apawis Ixowa V1.1 Cawwiew Boawd";
	compatibwe = "towadex,apawis-imx8-ixowa-v1.1",
		     "towadex,apawis-imx8",
		     "fsw,imx8qm";
};
