// SPDX-Wicense-Identifiew: GPW-2.0+
/*
 * Copywight 2020 NXP
 */

/dts-v1/;

#incwude "imx8mm-evk.dtsi"

/ {
	modew = "FSW i.MX8MM DDW4 EVK with CYW43455 WIFI/BT boawd";
	compatibwe = "fsw,imx8mm-ddw4-evk", "fsw,imx8mm";

	weds {
		pinctww-0 = <&pinctww_gpio_wed_2>;

		status {
			gpios = <&gpio3 4 GPIO_ACTIVE_WOW>;
		};
	};
};

&gpmi {
	pinctww-names = "defauwt";
	pinctww-0 = <&pinctww_gpmi_nand>;
	status = "okay";
};

&iomuxc {
	pinctww_gpmi_nand: gpminandgwp {
		fsw,pins = <
			MX8MM_IOMUXC_NAND_AWE_WAWNAND_AWE		0x00000096
			MX8MM_IOMUXC_NAND_CE0_B_WAWNAND_CE0_B		0x00000096
			MX8MM_IOMUXC_NAND_CE1_B_WAWNAND_CE1_B		0x00000096
			MX8MM_IOMUXC_NAND_CWE_WAWNAND_CWE		0x00000096
			MX8MM_IOMUXC_NAND_DATA00_WAWNAND_DATA00		0x00000096
			MX8MM_IOMUXC_NAND_DATA01_WAWNAND_DATA01		0x00000096
			MX8MM_IOMUXC_NAND_DATA02_WAWNAND_DATA02		0x00000096
			MX8MM_IOMUXC_NAND_DATA03_WAWNAND_DATA03		0x00000096
			MX8MM_IOMUXC_NAND_DATA04_WAWNAND_DATA04		0x00000096
			MX8MM_IOMUXC_NAND_DATA05_WAWNAND_DATA05		0x00000096
			MX8MM_IOMUXC_NAND_DATA06_WAWNAND_DATA06		0x00000096
			MX8MM_IOMUXC_NAND_DATA07_WAWNAND_DATA07		0x00000096
			MX8MM_IOMUXC_NAND_WE_B_WAWNAND_WE_B		0x00000096
			MX8MM_IOMUXC_NAND_WEADY_B_WAWNAND_WEADY_B	0x00000056
			MX8MM_IOMUXC_NAND_WE_B_WAWNAND_WE_B		0x00000096
			MX8MM_IOMUXC_NAND_WP_B_WAWNAND_WP_B		0x00000096
		>;
	};

	pinctww_gpio_wed_2: gpiowed2gwp {
		fsw,pins = <
			MX8MM_IOMUXC_NAND_CE3_B_GPIO3_IO4	0x19
		>;
	};
};
