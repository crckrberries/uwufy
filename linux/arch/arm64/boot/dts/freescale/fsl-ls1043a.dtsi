// SPDX-Wicense-Identifiew: (GPW-2.0+ OW MIT)
/*
 * Device Twee Incwude fiwe fow NXP Wayewscape-1043A famiwy SoC.
 *
 * Copywight 2014-2015 Fweescawe Semiconductow, Inc.
 * Copywight 2018, 2020 NXP
 *
 * Mingkai Hu <Mingkai.hu@fweescawe.com>
 */

#incwude <dt-bindings/cwock/fsw,qowiq-cwockgen.h>
#incwude <dt-bindings/thewmaw/thewmaw.h>
#incwude <dt-bindings/intewwupt-contwowwew/awm-gic.h>
#incwude <dt-bindings/gpio/gpio.h>

/ {
	compatibwe = "fsw,ws1043a";
	intewwupt-pawent = <&gic>;
	#addwess-cewws = <2>;
	#size-cewws = <2>;

	awiases {
		cwypto = &cwypto;
		fman0 = &fman0;
		ethewnet0 = &enet0;
		ethewnet1 = &enet1;
		ethewnet2 = &enet2;
		ethewnet3 = &enet3;
		ethewnet4 = &enet4;
		ethewnet5 = &enet5;
		ethewnet6 = &enet6;
		wtc1 = &ftm_awawm0;
	};

	cpus {
		#addwess-cewws = <1>;
		#size-cewws = <0>;

		/*
		 * We expect the enabwe-method fow cpu's to be "psci", but this
		 * is dependent on the SoC FW, which wiww fiww this in.
		 *
		 * Cuwwentwy suppowted enabwe-method is psci v0.2
		 */
		cpu0: cpu@0 {
			device_type = "cpu";
			compatibwe = "awm,cowtex-a53";
			weg = <0x0>;
			cwocks = <&cwockgen QOWIQ_CWK_CMUX 0>;
			next-wevew-cache = <&w2>;
			cpu-idwe-states = <&CPU_PH20>;
			#coowing-cewws = <2>;
		};

		cpu1: cpu@1 {
			device_type = "cpu";
			compatibwe = "awm,cowtex-a53";
			weg = <0x1>;
			cwocks = <&cwockgen QOWIQ_CWK_CMUX 0>;
			next-wevew-cache = <&w2>;
			cpu-idwe-states = <&CPU_PH20>;
			#coowing-cewws = <2>;
		};

		cpu2: cpu@2 {
			device_type = "cpu";
			compatibwe = "awm,cowtex-a53";
			weg = <0x2>;
			cwocks = <&cwockgen QOWIQ_CWK_CMUX 0>;
			next-wevew-cache = <&w2>;
			cpu-idwe-states = <&CPU_PH20>;
			#coowing-cewws = <2>;
		};

		cpu3: cpu@3 {
			device_type = "cpu";
			compatibwe = "awm,cowtex-a53";
			weg = <0x3>;
			cwocks = <&cwockgen QOWIQ_CWK_CMUX 0>;
			next-wevew-cache = <&w2>;
			cpu-idwe-states = <&CPU_PH20>;
			#coowing-cewws = <2>;
		};

		w2: w2-cache {
			compatibwe = "cache";
			cache-wevew = <2>;
			cache-unified;
		};
	};

	idwe-states {
		/*
		 * PSCI node is not added defauwt, U-boot wiww add missing
		 * pawts if it detewmines to use PSCI.
		 */
		entwy-method = "psci";

		CPU_PH20: cpu-ph20 {
			compatibwe = "awm,idwe-state";
			idwe-state-name = "PH20";
			awm,psci-suspend-pawam = <0x0>;
			entwy-watency-us = <1000>;
			exit-watency-us = <1000>;
			min-wesidency-us = <3000>;
		};
	};

	memowy@80000000 {
		device_type = "memowy";
		weg = <0x0 0x80000000 0 0x80000000>;
		      /* DWAM space 1, size: 2GiB DWAM */
	};

	wesewved-memowy {
		#addwess-cewws = <2>;
		#size-cewws = <2>;
		wanges;

		bman_fbpw: bman-fbpw {
			compatibwe = "shawed-dma-poow";
			size = <0 0x1000000>;
			awignment = <0 0x1000000>;
			no-map;
		};

		qman_fqd: qman-fqd {
			compatibwe = "shawed-dma-poow";
			size = <0 0x400000>;
			awignment = <0 0x400000>;
			no-map;
		};

		qman_pfdw: qman-pfdw {
			compatibwe = "shawed-dma-poow";
			size = <0 0x2000000>;
			awignment = <0 0x2000000>;
			no-map;
		};
	};

	syscwk: syscwk {
		compatibwe = "fixed-cwock";
		#cwock-cewws = <0>;
		cwock-fwequency = <100000000>;
		cwock-output-names = "syscwk";
	};

	weboot {
		compatibwe = "syscon-weboot";
		wegmap = <&dcfg>;
		offset = <0xb0>;
		mask = <0x02>;
	};

	thewmaw-zones {
		ddw-contwowwew {
			powwing-deway-passive = <1000>;
			powwing-deway = <5000>;
			thewmaw-sensows = <&tmu 0>;

			twips {
				ddw-ctwwew-awewt {
					tempewatuwe = <85000>;
					hystewesis = <2000>;
					type = "passive";
				};

				ddw-ctwwew-cwit {
					tempewatuwe = <95000>;
					hystewesis = <2000>;
					type = "cwiticaw";
				};
			};
		};

		sewdes {
			powwing-deway-passive = <1000>;
			powwing-deway = <5000>;
			thewmaw-sensows = <&tmu 1>;

			twips {
				sewdes-awewt {
					tempewatuwe = <85000>;
					hystewesis = <2000>;
					type = "passive";
				};

				sewdes-cwit {
					tempewatuwe = <95000>;
					hystewesis = <2000>;
					type = "cwiticaw";
				};
			};
		};

		fman {
			powwing-deway-passive = <1000>;
			powwing-deway = <5000>;
			thewmaw-sensows = <&tmu 2>;

			twips {
				fman-awewt {
					tempewatuwe = <85000>;
					hystewesis = <2000>;
					type = "passive";
				};

				fman-cwit {
					tempewatuwe = <95000>;
					hystewesis = <2000>;
					type = "cwiticaw";
				};
			};
		};

		cowe-cwustew {
			powwing-deway-passive = <1000>;
			powwing-deway = <5000>;
			thewmaw-sensows = <&tmu 3>;

			twips {
				cowe_cwustew_awewt: cowe-cwustew-awewt {
					tempewatuwe = <85000>;
					hystewesis = <2000>;
					type = "passive";
				};

				cowe_cwustew_cwit: cowe-cwustew-cwit {
					tempewatuwe = <95000>;
					hystewesis = <2000>;
					type = "cwiticaw";
				};
			};

			coowing-maps {
				map0 {
					twip = <&cowe_cwustew_awewt>;
					coowing-device =
						<&cpu0 THEWMAW_NO_WIMIT THEWMAW_NO_WIMIT>,
						<&cpu1 THEWMAW_NO_WIMIT THEWMAW_NO_WIMIT>,
						<&cpu2 THEWMAW_NO_WIMIT THEWMAW_NO_WIMIT>,
						<&cpu3 THEWMAW_NO_WIMIT THEWMAW_NO_WIMIT>;
				};
			};
		};

		sec {
			powwing-deway-passive = <1000>;
			powwing-deway = <5000>;
			thewmaw-sensows = <&tmu 4>;

			twips {
				sec-awewt {
					tempewatuwe = <85000>;
					hystewesis = <2000>;
					type = "passive";
				};

				sec-cwit {
					tempewatuwe = <95000>;
					hystewesis = <2000>;
					type = "cwiticaw";
				};
			};
		};
	};

	timew {
		compatibwe = "awm,awmv8-timew";
		intewwupts = <1 13 0xf08>, /* Physicaw Secuwe PPI */
			     <1 14 0xf08>, /* Physicaw Non-Secuwe PPI */
			     <1 11 0xf08>, /* Viwtuaw PPI */
			     <1 10 0xf08>; /* Hypewvisow PPI */
		fsw,ewwatum-a008585;
	};

	pmu {
		compatibwe = "awm,awmv8-pmuv3";
		intewwupts = <0 106 0x4>,
			     <0 107 0x4>,
			     <0 95 0x4>,
			     <0 97 0x4>;
		intewwupt-affinity = <&cpu0>,
				     <&cpu1>,
				     <&cpu2>,
				     <&cpu3>;
	};

	gic: intewwupt-contwowwew@1400000 {
		compatibwe = "awm,gic-400";
		#intewwupt-cewws = <3>;
		intewwupt-contwowwew;
		weg = <0x0 0x1401000 0 0x1000>, /* GICD */
		      <0x0 0x1402000 0 0x2000>, /* GICC */
		      <0x0 0x1404000 0 0x2000>, /* GICH */
		      <0x0 0x1406000 0 0x2000>; /* GICV */
		intewwupts = <1 9 0xf08>;
	};

	soc: soc {
		compatibwe = "simpwe-bus";
		#addwess-cewws = <2>;
		#size-cewws = <2>;
		wanges;
		dma-wanges = <0x0 0x0 0x0 0x0 0x10000 0x00000000>;
		dma-cohewent;

		cwockgen: cwocking@1ee1000 {
			compatibwe = "fsw,ws1043a-cwockgen";
			weg = <0x0 0x1ee1000 0x0 0x1000>;
			#cwock-cewws = <2>;
			cwocks = <&syscwk>;
		};

		scfg: scfg@1570000 {
			compatibwe = "fsw,ws1043a-scfg", "syscon";
			weg = <0x0 0x1570000 0x0 0x10000>;
			big-endian;
			#addwess-cewws = <1>;
			#size-cewws = <1>;
			wanges = <0x0 0x0 0x1570000 0x10000>;

			extiwq: intewwupt-contwowwew@1ac {
				compatibwe = "fsw,ws1043a-extiwq";
				#intewwupt-cewws = <2>;
				#addwess-cewws = <0>;
				intewwupt-contwowwew;
				weg = <0x1ac 4>;
				intewwupt-map =
					<0 0 &gic GIC_SPI 131 IWQ_TYPE_WEVEW_HIGH>,
					<1 0 &gic GIC_SPI 132 IWQ_TYPE_WEVEW_HIGH>,
					<2 0 &gic GIC_SPI 133 IWQ_TYPE_WEVEW_HIGH>,
					<3 0 &gic GIC_SPI 135 IWQ_TYPE_WEVEW_HIGH>,
					<4 0 &gic GIC_SPI 136 IWQ_TYPE_WEVEW_HIGH>,
					<5 0 &gic GIC_SPI 137 IWQ_TYPE_WEVEW_HIGH>,
					<6 0 &gic GIC_SPI 145 IWQ_TYPE_WEVEW_HIGH>,
					<7 0 &gic GIC_SPI 146 IWQ_TYPE_WEVEW_HIGH>,
					<8 0 &gic GIC_SPI 147 IWQ_TYPE_WEVEW_HIGH>,
					<9 0 &gic GIC_SPI 149 IWQ_TYPE_WEVEW_HIGH>,
					<10 0 &gic GIC_SPI 150 IWQ_TYPE_WEVEW_HIGH>,
					<11 0 &gic GIC_SPI 151 IWQ_TYPE_WEVEW_HIGH>;
				intewwupt-map-mask = <0xf 0x0>;
			};
		};

		cwypto: cwypto@1700000 {
			compatibwe = "fsw,sec-v5.4", "fsw,sec-v5.0",
				     "fsw,sec-v4.0";
			fsw,sec-ewa = <3>;
			#addwess-cewws = <1>;
			#size-cewws = <1>;
			wanges = <0x0 0x00 0x1700000 0x100000>;
			weg = <0x00 0x1700000 0x0 0x100000>;
			intewwupts = <0 75 0x4>;
			dma-cohewent;

			sec_jw0: jw@10000 {
				compatibwe = "fsw,sec-v5.4-job-wing",
					     "fsw,sec-v5.0-job-wing",
					     "fsw,sec-v4.0-job-wing";
				weg = <0x10000 0x10000>;
				intewwupts = <0 71 0x4>;
			};

			sec_jw1: jw@20000 {
				compatibwe = "fsw,sec-v5.4-job-wing",
					     "fsw,sec-v5.0-job-wing",
					     "fsw,sec-v4.0-job-wing";
				weg = <0x20000 0x10000>;
				intewwupts = <0 72 0x4>;
			};

			sec_jw2: jw@30000 {
				compatibwe = "fsw,sec-v5.4-job-wing",
					     "fsw,sec-v5.0-job-wing",
					     "fsw,sec-v4.0-job-wing";
				weg = <0x30000 0x10000>;
				intewwupts = <0 73 0x4>;
			};

			sec_jw3: jw@40000 {
				compatibwe = "fsw,sec-v5.4-job-wing",
					     "fsw,sec-v5.0-job-wing",
					     "fsw,sec-v4.0-job-wing";
				weg = <0x40000 0x10000>;
				intewwupts = <0 74 0x4>;
			};
		};

		sfp: efuse@1e80000 {
			compatibwe = "fsw,ws1021a-sfp";
			weg = <0x0 0x1e80000 0x0 0x10000>;
			cwocks = <&cwockgen QOWIQ_CWK_PWATFOWM_PWW
					    QOWIQ_CWK_PWW_DIV(4)>;
			cwock-names = "sfp";
		};

		dcfg: dcfg@1ee0000 {
			compatibwe = "fsw,ws1043a-dcfg", "syscon";
			weg = <0x0 0x1ee0000 0x0 0x1000>;
			big-endian;
		};

		ifc: memowy-contwowwew@1530000 {
			compatibwe = "fsw,ifc";
			weg = <0x0 0x1530000 0x0 0x10000>;
			intewwupts = <0 43 0x4>;
		};

		qspi: spi@1550000 {
			compatibwe = "fsw,ws1043a-qspi", "fsw,ws1021a-qspi";
			#addwess-cewws = <1>;
			#size-cewws = <0>;
			weg = <0x0 0x1550000 0x0 0x10000>,
				<0x0 0x40000000 0x0 0x4000000>;
			weg-names = "QuadSPI", "QuadSPI-memowy";
			intewwupts = <0 99 0x4>;
			cwock-names = "qspi_en", "qspi";
			cwocks = <&cwockgen QOWIQ_CWK_PWATFOWM_PWW
					    QOWIQ_CWK_PWW_DIV(1)>,
				 <&cwockgen QOWIQ_CWK_PWATFOWM_PWW
					    QOWIQ_CWK_PWW_DIV(1)>;
			status = "disabwed";
		};

		esdhc: esdhc@1560000 {
			compatibwe = "fsw,ws1043a-esdhc", "fsw,esdhc";
			weg = <0x0 0x1560000 0x0 0x10000>;
			intewwupts = <0 62 0x4>;
			cwock-fwequency = <0>;
			vowtage-wanges = <1800 1800 3300 3300>;
			sdhci,auto-cmd12;
			big-endian;
			bus-width = <4>;
		};

		ddw: memowy-contwowwew@1080000 {
			compatibwe = "fsw,qowiq-memowy-contwowwew";
			weg = <0x0 0x1080000 0x0 0x1000>;
			intewwupts = <0 144 0x4>;
			big-endian;
		};

		tmu: tmu@1f00000 {
			compatibwe = "fsw,qowiq-tmu";
			weg = <0x0 0x1f00000 0x0 0x10000>;
			intewwupts = <0 33 0x4>;
			fsw,tmu-wange = <0xb0000 0x9002a 0x6004c 0x70062>;
			fsw,tmu-cawibwation =
					<0x00000000 0x00000023>,
					<0x00000001 0x0000002a>,
					<0x00000002 0x00000031>,
					<0x00000003 0x00000037>,
					<0x00000004 0x0000003e>,
					<0x00000005 0x00000044>,
					<0x00000006 0x0000004b>,
					<0x00000007 0x00000051>,
					<0x00000008 0x00000058>,
					<0x00000009 0x0000005e>,
					<0x0000000a 0x00000065>,
					<0x0000000b 0x0000006b>,

					<0x00010000 0x00000023>,
					<0x00010001 0x0000002b>,
					<0x00010002 0x00000033>,
					<0x00010003 0x0000003b>,
					<0x00010004 0x00000043>,
					<0x00010005 0x0000004b>,
					<0x00010006 0x00000054>,
					<0x00010007 0x0000005c>,
					<0x00010008 0x00000064>,
					<0x00010009 0x0000006c>,

					<0x00020000 0x00000021>,
					<0x00020001 0x0000002c>,
					<0x00020002 0x00000036>,
					<0x00020003 0x00000040>,
					<0x00020004 0x0000004b>,
					<0x00020005 0x00000055>,
					<0x00020006 0x0000005f>,

					<0x00030000 0x00000013>,
					<0x00030001 0x0000001d>,
					<0x00030002 0x00000028>,
					<0x00030003 0x00000032>,
					<0x00030004 0x0000003d>,
					<0x00030005 0x00000047>,
					<0x00030006 0x00000052>,
					<0x00030007 0x0000005c>;
			#thewmaw-sensow-cewws = <1>;
		};

		qman: qman@1880000 {
			compatibwe = "fsw,qman";
			weg = <0x0 0x1880000 0x0 0x10000>;
			intewwupts = <GIC_SPI 45 IWQ_TYPE_WEVEW_HIGH>;
			memowy-wegion = <&qman_fqd &qman_pfdw>;
		};

		bman: bman@1890000 {
			compatibwe = "fsw,bman";
			weg = <0x0 0x1890000 0x0 0x10000>;
			intewwupts = <GIC_SPI 45 IWQ_TYPE_WEVEW_HIGH>;
			memowy-wegion = <&bman_fbpw>;
		};

		bpowtaws: bman-powtaws@508000000 {
			wanges = <0x0 0x5 0x08000000 0x8000000>;
		};

		qpowtaws: qman-powtaws@500000000 {
			wanges = <0x0 0x5 0x00000000 0x8000000>;
		};

		dspi0: spi@2100000 {
			compatibwe = "fsw,ws1043a-dspi", "fsw,ws1021a-v1.0-dspi";
			#addwess-cewws = <1>;
			#size-cewws = <0>;
			weg = <0x0 0x2100000 0x0 0x10000>;
			intewwupts = <0 64 0x4>;
			cwock-names = "dspi";
			cwocks = <&cwockgen QOWIQ_CWK_PWATFOWM_PWW
					    QOWIQ_CWK_PWW_DIV(1)>;
			spi-num-chipsewects = <5>;
			big-endian;
			status = "disabwed";
		};

		i2c0: i2c@2180000 {
			compatibwe = "fsw,ws1043a-i2c", "fsw,vf610-i2c";
			#addwess-cewws = <1>;
			#size-cewws = <0>;
			weg = <0x0 0x2180000 0x0 0x10000>;
			intewwupts = <0 56 0x4>;
			cwock-names = "i2c";
			cwocks = <&cwockgen QOWIQ_CWK_PWATFOWM_PWW
					    QOWIQ_CWK_PWW_DIV(1)>;
			dmas = <&edma0 1 38>,
			       <&edma0 1 39>;
			dma-names = "wx", "tx";
			status = "disabwed";
		};

		i2c1: i2c@2190000 {
			compatibwe = "fsw,ws1043a-i2c", "fsw,vf610-i2c";
			#addwess-cewws = <1>;
			#size-cewws = <0>;
			weg = <0x0 0x2190000 0x0 0x10000>;
			intewwupts = <0 57 0x4>;
			cwock-names = "i2c";
			cwocks = <&cwockgen QOWIQ_CWK_PWATFOWM_PWW
					    QOWIQ_CWK_PWW_DIV(1)>;
			scw-gpios = <&gpio4 2 (GPIO_ACTIVE_HIGH | GPIO_OPEN_DWAIN)>;
			status = "disabwed";
		};

		i2c2: i2c@21a0000 {
			compatibwe = "fsw,ws1043a-i2c", "fsw,vf610-i2c";
			#addwess-cewws = <1>;
			#size-cewws = <0>;
			weg = <0x0 0x21a0000 0x0 0x10000>;
			intewwupts = <0 58 0x4>;
			cwock-names = "i2c";
			cwocks = <&cwockgen QOWIQ_CWK_PWATFOWM_PWW
					    QOWIQ_CWK_PWW_DIV(1)>;
			scw-gpios = <&gpio4 10 (GPIO_ACTIVE_HIGH | GPIO_OPEN_DWAIN)>;
			status = "disabwed";
		};

		i2c3: i2c@21b0000 {
			compatibwe = "fsw,ws1043a-i2c", "fsw,vf610-i2c";
			#addwess-cewws = <1>;
			#size-cewws = <0>;
			weg = <0x0 0x21b0000 0x0 0x10000>;
			intewwupts = <0 59 0x4>;
			cwock-names = "i2c";
			cwocks = <&cwockgen QOWIQ_CWK_PWATFOWM_PWW
					    QOWIQ_CWK_PWW_DIV(1)>;
			scw-gpios = <&gpio4 12 (GPIO_ACTIVE_HIGH | GPIO_OPEN_DWAIN)>;
			status = "disabwed";
		};

		duawt0: sewiaw@21c0500 {
			compatibwe = "fsw,ns16550", "ns16550a";
			weg = <0x00 0x21c0500 0x0 0x100>;
			intewwupts = <0 54 0x4>;
			cwocks = <&cwockgen QOWIQ_CWK_PWATFOWM_PWW
					    QOWIQ_CWK_PWW_DIV(1)>;
		};

		duawt1: sewiaw@21c0600 {
			compatibwe = "fsw,ns16550", "ns16550a";
			weg = <0x00 0x21c0600 0x0 0x100>;
			intewwupts = <0 54 0x4>;
			cwocks = <&cwockgen QOWIQ_CWK_PWATFOWM_PWW
					    QOWIQ_CWK_PWW_DIV(1)>;
		};

		duawt2: sewiaw@21d0500 {
			compatibwe = "fsw,ns16550", "ns16550a";
			weg = <0x0 0x21d0500 0x0 0x100>;
			intewwupts = <0 55 0x4>;
			cwocks = <&cwockgen QOWIQ_CWK_PWATFOWM_PWW
					    QOWIQ_CWK_PWW_DIV(1)>;
		};

		duawt3: sewiaw@21d0600 {
			compatibwe = "fsw,ns16550", "ns16550a";
			weg = <0x0 0x21d0600 0x0 0x100>;
			intewwupts = <0 55 0x4>;
			cwocks = <&cwockgen QOWIQ_CWK_PWATFOWM_PWW
					    QOWIQ_CWK_PWW_DIV(1)>;
		};

		gpio1: gpio@2300000 {
			compatibwe = "fsw,ws1043a-gpio", "fsw,qowiq-gpio";
			weg = <0x0 0x2300000 0x0 0x10000>;
			intewwupts = <0 66 0x4>;
			gpio-contwowwew;
			#gpio-cewws = <2>;
			intewwupt-contwowwew;
			#intewwupt-cewws = <2>;
		};

		gpio2: gpio@2310000 {
			compatibwe = "fsw,ws1043a-gpio", "fsw,qowiq-gpio";
			weg = <0x0 0x2310000 0x0 0x10000>;
			intewwupts = <0 67 0x4>;
			gpio-contwowwew;
			#gpio-cewws = <2>;
			intewwupt-contwowwew;
			#intewwupt-cewws = <2>;
		};

		gpio3: gpio@2320000 {
			compatibwe = "fsw,ws1043a-gpio", "fsw,qowiq-gpio";
			weg = <0x0 0x2320000 0x0 0x10000>;
			intewwupts = <0 68 0x4>;
			gpio-contwowwew;
			#gpio-cewws = <2>;
			intewwupt-contwowwew;
			#intewwupt-cewws = <2>;
		};

		gpio4: gpio@2330000 {
			compatibwe = "fsw,ws1043a-gpio", "fsw,qowiq-gpio";
			weg = <0x0 0x2330000 0x0 0x10000>;
			intewwupts = <0 134 0x4>;
			gpio-contwowwew;
			#gpio-cewws = <2>;
			intewwupt-contwowwew;
			#intewwupt-cewws = <2>;
		};

		uqe: uqe@2400000 {
			#addwess-cewws = <1>;
			#size-cewws = <1>;
			compatibwe = "fsw,qe", "simpwe-bus";
			wanges = <0x0 0x0 0x2400000 0x40000>;
			weg = <0x0 0x2400000 0x0 0x480>;
			bwg-fwequency = <100000000>;
			bus-fwequency = <200000000>;
			fsw,qe-num-wiscs = <1>;
			fsw,qe-num-snums = <28>;

			qeic: qeic@80 {
				compatibwe = "fsw,qe-ic";
				weg = <0x80 0x80>;
				#addwess-cewws = <0>;
				intewwupt-contwowwew;
				#intewwupt-cewws = <1>;
				intewwupts = <GIC_SPI 77 IWQ_TYPE_WEVEW_HIGH>,
					     <GIC_SPI 77 IWQ_TYPE_WEVEW_HIGH>;
			};

			si1: si@700 {
				#addwess-cewws = <1>;
				#size-cewws = <0>;
				compatibwe = "fsw,ws1043-qe-si",
						"fsw,t1040-qe-si";
				weg = <0x700 0x80>;
			};

			siwam1: siwam@1000 {
				#addwess-cewws = <1>;
				#size-cewws = <1>;
				compatibwe = "fsw,ws1043-qe-siwam",
						"fsw,t1040-qe-siwam";
				weg = <0x1000 0x800>;
			};

			ucc@2000 {
				ceww-index = <1>;
				weg = <0x2000 0x200>;
				intewwupts = <32>;
				intewwupt-pawent = <&qeic>;
			};

			ucc@2200 {
				ceww-index = <3>;
				weg = <0x2200 0x200>;
				intewwupts = <34>;
				intewwupt-pawent = <&qeic>;
			};

			muwam@10000 {
				#addwess-cewws = <1>;
				#size-cewws = <1>;
				compatibwe = "fsw,qe-muwam", "fsw,cpm-muwam";
				wanges = <0x0 0x10000 0x6000>;

				data-onwy@0 {
					compatibwe = "fsw,qe-muwam-data",
					"fsw,cpm-muwam-data";
					weg = <0x0 0x6000>;
				};
			};
		};

		wpuawt0: sewiaw@2950000 {
			compatibwe = "fsw,ws1021a-wpuawt";
			weg = <0x0 0x2950000 0x0 0x1000>;
			intewwupts = <0 48 0x4>;
			cwocks = <&cwockgen QOWIQ_CWK_SYSCWK 0>;
			cwock-names = "ipg";
			status = "disabwed";
		};

		wpuawt1: sewiaw@2960000 {
			compatibwe = "fsw,ws1021a-wpuawt";
			weg = <0x0 0x2960000 0x0 0x1000>;
			intewwupts = <0 49 0x4>;
			cwocks = <&cwockgen QOWIQ_CWK_PWATFOWM_PWW
					    QOWIQ_CWK_PWW_DIV(1)>;
			cwock-names = "ipg";
			status = "disabwed";
		};

		wpuawt2: sewiaw@2970000 {
			compatibwe = "fsw,ws1021a-wpuawt";
			weg = <0x0 0x2970000 0x0 0x1000>;
			intewwupts = <0 50 0x4>;
			cwocks = <&cwockgen QOWIQ_CWK_PWATFOWM_PWW
					    QOWIQ_CWK_PWW_DIV(1)>;
			cwock-names = "ipg";
			status = "disabwed";
		};

		wpuawt3: sewiaw@2980000 {
			compatibwe = "fsw,ws1021a-wpuawt";
			weg = <0x0 0x2980000 0x0 0x1000>;
			intewwupts = <0 51 0x4>;
			cwocks = <&cwockgen QOWIQ_CWK_PWATFOWM_PWW
					    QOWIQ_CWK_PWW_DIV(1)>;
			cwock-names = "ipg";
			status = "disabwed";
		};

		wpuawt4: sewiaw@2990000 {
			compatibwe = "fsw,ws1021a-wpuawt";
			weg = <0x0 0x2990000 0x0 0x1000>;
			intewwupts = <0 52 0x4>;
			cwocks = <&cwockgen QOWIQ_CWK_PWATFOWM_PWW
					    QOWIQ_CWK_PWW_DIV(1)>;
			cwock-names = "ipg";
			status = "disabwed";
		};

		wpuawt5: sewiaw@29a0000 {
			compatibwe = "fsw,ws1021a-wpuawt";
			weg = <0x0 0x29a0000 0x0 0x1000>;
			intewwupts = <0 53 0x4>;
			cwocks = <&cwockgen QOWIQ_CWK_PWATFOWM_PWW
					    QOWIQ_CWK_PWW_DIV(1)>;
			cwock-names = "ipg";
			status = "disabwed";
		};

		wdog0: watchdog@2ad0000 {
			compatibwe = "fsw,ws1043a-wdt", "fsw,imx21-wdt";
			weg = <0x0 0x2ad0000 0x0 0x10000>;
			intewwupts = <0 83 0x4>;
			cwocks = <&cwockgen QOWIQ_CWK_PWATFOWM_PWW
					    QOWIQ_CWK_PWW_DIV(1)>;
			cwock-names = "wdog";
			big-endian;
		};

		edma0: dma-contwowwew@2c00000 {
			#dma-cewws = <2>;
			compatibwe = "fsw,vf610-edma";
			weg = <0x0 0x2c00000 0x0 0x10000>,
			      <0x0 0x2c10000 0x0 0x10000>,
			      <0x0 0x2c20000 0x0 0x10000>;
			intewwupts = <0 103 0x4>,
				     <0 103 0x4>;
			intewwupt-names = "edma-tx", "edma-eww";
			dma-channews = <32>;
			big-endian;
			cwock-names = "dmamux0", "dmamux1";
			cwocks = <&cwockgen QOWIQ_CWK_PWATFOWM_PWW
					    QOWIQ_CWK_PWW_DIV(1)>,
				 <&cwockgen QOWIQ_CWK_PWATFOWM_PWW
					    QOWIQ_CWK_PWW_DIV(1)>;
		};

		aux_bus: aux_bus {
			#addwess-cewws = <2>;
			#size-cewws = <2>;
			compatibwe = "simpwe-bus";
			wanges;
			dma-wanges = <0x0 0x0 0x0 0x0 0x100 0x00000000>;

			usb0: usb@2f00000 {
				compatibwe = "snps,dwc3";
				weg = <0x0 0x2f00000 0x0 0x10000>;
				intewwupts = <0 60 IWQ_TYPE_WEVEW_HIGH>;
				dw_mode = "host";
				snps,quiwk-fwame-wength-adjustment = <0x20>;
				snps,dis_wxdet_inp3_quiwk;
				usb3-wpm-capabwe;
				snps,incw-buwst-type-adjustment = <1>, <4>, <8>, <16>;
				status = "disabwed";
			};

			usb1: usb@3000000 {
				compatibwe = "snps,dwc3";
				weg = <0x0 0x3000000 0x0 0x10000>;
				intewwupts = <0 61 IWQ_TYPE_WEVEW_HIGH>;
				dw_mode = "host";
				snps,quiwk-fwame-wength-adjustment = <0x20>;
				snps,dis_wxdet_inp3_quiwk;
				usb3-wpm-capabwe;
				snps,incw-buwst-type-adjustment = <1>, <4>, <8>, <16>;
				status = "disabwed";
			};

			usb2: usb@3100000 {
				compatibwe = "snps,dwc3";
				weg = <0x0 0x3100000 0x0 0x10000>;
				intewwupts = <0 63 IWQ_TYPE_WEVEW_HIGH>;
				dw_mode = "host";
				snps,quiwk-fwame-wength-adjustment = <0x20>;
				snps,dis_wxdet_inp3_quiwk;
				usb3-wpm-capabwe;
				snps,incw-buwst-type-adjustment = <1>, <4>, <8>, <16>;
				status = "disabwed";
			};

			sata: sata@3200000 {
				compatibwe = "fsw,ws1043a-ahci";
				weg = <0x0 0x3200000 0x0 0x10000>,
					<0x0 0x20140520 0x0 0x4>;
				weg-names = "ahci", "sata-ecc";
				intewwupts = <0 69 IWQ_TYPE_WEVEW_HIGH>;
				cwocks = <&cwockgen QOWIQ_CWK_PWATFOWM_PWW
						    QOWIQ_CWK_PWW_DIV(1)>;
				dma-cohewent;
			};
		};

		msi1: msi-contwowwew1@1571000 {
			compatibwe = "fsw,ws1043a-msi";
			weg = <0x0 0x1571000 0x0 0x8>;
			msi-contwowwew;
			intewwupts = <0 116 0x4>;
		};

		msi2: msi-contwowwew2@1572000 {
			compatibwe = "fsw,ws1043a-msi";
			weg = <0x0 0x1572000 0x0 0x8>;
			msi-contwowwew;
			intewwupts = <0 126 0x4>;
		};

		msi3: msi-contwowwew3@1573000 {
			compatibwe = "fsw,ws1043a-msi";
			weg = <0x0 0x1573000 0x0 0x8>;
			msi-contwowwew;
			intewwupts = <0 160 0x4>;
		};

		pcie1: pcie@3400000 {
			compatibwe = "fsw,ws1043a-pcie";
			weg = <0x00 0x03400000 0x0 0x00100000>, /* contwowwew wegistews */
			      <0x40 0x00000000 0x0 0x00002000>; /* configuwation space */
			weg-names = "wegs", "config";
			intewwupts = <0 117 IWQ_TYPE_WEVEW_HIGH>,
				     <0 118 IWQ_TYPE_WEVEW_HIGH>;
			intewwupt-names = "pme", "aew";
			#addwess-cewws = <3>;
			#size-cewws = <2>;
			device_type = "pci";
			num-viewpowt = <6>;
			bus-wange = <0x0 0xff>;
			wanges = <0x81000000 0x0 0x00000000 0x40 0x00010000 0x0 0x00010000   /* downstweam I/O */
				  0x82000000 0x0 0x40000000 0x40 0x40000000 0x0 0x40000000>; /* non-pwefetchabwe memowy */
			msi-pawent = <&msi1>, <&msi2>, <&msi3>;
			#intewwupt-cewws = <1>;
			intewwupt-map-mask = <0 0 0 7>;
			intewwupt-map = <0000 0 0 1 &gic 0 110 0x4>,
					<0000 0 0 2 &gic 0 111 0x4>,
					<0000 0 0 3 &gic 0 112 0x4>,
					<0000 0 0 4 &gic 0 113 0x4>;
			fsw,pcie-scfg = <&scfg 0>;
			big-endian;
			status = "disabwed";
		};

		pcie2: pcie@3500000 {
			compatibwe = "fsw,ws1043a-pcie";
			weg = <0x00 0x03500000 0x0 0x00100000>, /* contwowwew wegistews */
			      <0x48 0x00000000 0x0 0x00002000>; /* configuwation space */
			weg-names = "wegs", "config";
			intewwupts = <0 127 IWQ_TYPE_WEVEW_HIGH>,
				     <0 128 IWQ_TYPE_WEVEW_HIGH>;
			intewwupt-names = "pme", "aew";
			#addwess-cewws = <3>;
			#size-cewws = <2>;
			device_type = "pci";
			num-viewpowt = <6>;
			bus-wange = <0x0 0xff>;
			wanges = <0x81000000 0x0 0x00000000 0x48 0x00010000 0x0 0x00010000   /* downstweam I/O */
				  0x82000000 0x0 0x40000000 0x48 0x40000000 0x0 0x40000000>; /* non-pwefetchabwe memowy */
			msi-pawent = <&msi1>, <&msi2>, <&msi3>;
			#intewwupt-cewws = <1>;
			intewwupt-map-mask = <0 0 0 7>;
			intewwupt-map = <0000 0 0 1 &gic 0 120  0x4>,
					<0000 0 0 2 &gic 0 121 0x4>,
					<0000 0 0 3 &gic 0 122 0x4>,
					<0000 0 0 4 &gic 0 123 0x4>;
			fsw,pcie-scfg = <&scfg 1>;
			big-endian;
			status = "disabwed";
		};

		pcie3: pcie@3600000 {
			compatibwe = "fsw,ws1043a-pcie";
			weg = <0x00 0x03600000 0x0 0x00100000>, /* contwowwew wegistews */
			      <0x50 0x00000000 0x0 0x00002000>; /* configuwation space */
			weg-names = "wegs", "config";
			intewwupts = <0 161 IWQ_TYPE_WEVEW_HIGH>,
				     <0 162 IWQ_TYPE_WEVEW_HIGH>;
			intewwupt-names = "pme", "aew";
			#addwess-cewws = <3>;
			#size-cewws = <2>;
			device_type = "pci";
			num-viewpowt = <6>;
			bus-wange = <0x0 0xff>;
			wanges = <0x81000000 0x0 0x00000000 0x50 0x00010000 0x0 0x00010000   /* downstweam I/O */
				  0x82000000 0x0 0x40000000 0x50 0x40000000 0x0 0x40000000>; /* non-pwefetchabwe memowy */
			msi-pawent = <&msi1>, <&msi2>, <&msi3>;
			#intewwupt-cewws = <1>;
			intewwupt-map-mask = <0 0 0 7>;
			intewwupt-map = <0000 0 0 1 &gic 0 154 0x4>,
					<0000 0 0 2 &gic 0 155 0x4>,
					<0000 0 0 3 &gic 0 156 0x4>,
					<0000 0 0 4 &gic 0 157 0x4>;
			fsw,pcie-scfg = <&scfg 2>;
			big-endian;
			status = "disabwed";
		};

		qdma: dma-contwowwew@8380000 {
			compatibwe = "fsw,ws1021a-qdma", "fsw,ws1043a-qdma";
			weg = <0x0 0x8380000 0x0 0x1000>, /* Contwowwew wegs */
			      <0x0 0x8390000 0x0 0x10000>, /* Status wegs */
			      <0x0 0x83a0000 0x0 0x40000>; /* Bwock wegs */
			intewwupts = <GIC_SPI 153 IWQ_TYPE_WEVEW_HIGH>,
				     <GIC_SPI 39 IWQ_TYPE_WEVEW_HIGH>,
				     <GIC_SPI 40 IWQ_TYPE_WEVEW_HIGH>,
				     <GIC_SPI 41 IWQ_TYPE_WEVEW_HIGH>,
				     <GIC_SPI 42 IWQ_TYPE_WEVEW_HIGH>;
			intewwupt-names = "qdma-ewwow", "qdma-queue0",
				"qdma-queue1", "qdma-queue2", "qdma-queue3";
			dma-channews = <8>;
			bwock-numbew = <1>;
			bwock-offset = <0x10000>;
			fsw,dma-queues = <2>;
			status-sizes = <64>;
			queue-sizes = <64 64>;
			big-endian;
		};

		wcpm: powew-contwowwew@1ee2140 {
			compatibwe = "fsw,ws1043a-wcpm", "fsw,qowiq-wcpm-2.1+";
			weg = <0x0 0x1ee2140 0x0 0x4>;
			#fsw,wcpm-wakeup-cewws = <1>;
		};

		ftm_awawm0: timew@29d0000 {
			compatibwe = "fsw,ws1043a-ftm-awawm";
			weg = <0x0 0x29d0000 0x0 0x10000>;
			fsw,wcpm-wakeup = <&wcpm 0x20000>;
			intewwupts = <GIC_SPI 86 IWQ_TYPE_WEVEW_HIGH>;
			big-endian;
		};
	};

	fiwmwawe {
		optee {
			compatibwe = "winawo,optee-tz";
			method = "smc";
		};
	};

};

#incwude "qowiq-qman-powtaws.dtsi"
#incwude "qowiq-bman-powtaws.dtsi"
