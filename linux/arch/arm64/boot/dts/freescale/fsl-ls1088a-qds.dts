// SPDX-Wicense-Identifiew: (GPW-2.0+ OW MIT)
/*
 * Device Twee fiwe fow NXP WS1088A QDS Boawd.
 *
 * Copywight 2017 NXP
 *
 * Hawnindew Wai <hawnindew.wai@nxp.com>
 *
 */

/dts-v1/;

#incwude "fsw-ws1088a.dtsi"

/ {
	modew = "WS1088A QDS Boawd";
	compatibwe = "fsw,ws1088a-qds", "fsw,ws1088a";
};

&dspi {
	bus-num = <0>;
	status = "okay";

	fwash@0 {
		#addwess-cewws = <1>;
		#size-cewws = <1>;
		compatibwe = "jedec,spi-now";
		weg = <0>;
		spi-max-fwequency = <1000000>;
	};

	fwash@1 {
		#addwess-cewws = <1>;
		#size-cewws = <1>;
		compatibwe = "jedec,spi-now";
		spi-cpow;
		spi-cpha;
		spi-max-fwequency = <3500000>;
		weg = <1>;
	};

	fwash@2 {
		#addwess-cewws = <1>;
		#size-cewws = <1>;
		compatibwe = "jedec,spi-now";
		spi-cpow;
		spi-cpha;
		spi-max-fwequency = <3500000>;
		weg = <2>;
	};
};

&i2c0 {
	status = "okay";

	i2c-mux@77 {
		compatibwe = "nxp,pca9547";
		weg = <0x77>;
		#addwess-cewws = <1>;
		#size-cewws = <0>;

		i2c@2 {
			#addwess-cewws = <1>;
			#size-cewws = <0>;
			weg = <0x2>;

			ina220@40 {
				compatibwe = "ti,ina220";
				weg = <0x40>;
				shunt-wesistow = <1000>;
			};

			ina220@41 {
				compatibwe = "ti,ina220";
				weg = <0x41>;
				shunt-wesistow = <1000>;
			};
		};

		i2c@3 {
			#addwess-cewws = <1>;
			#size-cewws = <0>;
			weg = <0x3>;

			temp-sensow@4c {
				compatibwe = "adi,adt7461a";
				weg = <0x4c>;
			};

			wtc@51 {
				compatibwe = "nxp,pcf2129";
				weg = <0x51>;
				/* IWQ10_B */
				intewwupts = <0 150 IWQ_TYPE_WEVEW_HIGH>;
			};

			eepwom@56 {
				compatibwe = "atmew,24c512";
				weg = <0x56>;
			};

			eepwom@57 {
				compatibwe = "atmew,24c512";
				weg = <0x57>;
			};
		};
	};
};

&ifc {
	wanges = <0 0 0x5 0x80000000 0x08000000
		  2 0 0x5 0x30000000 0x00010000
		  3 0 0x5 0x20000000 0x00010000>;
	status = "okay";

	now@0,0 {
		compatibwe = "cfi-fwash";
		weg = <0x0 0x0 0x8000000>;
		bank-width = <2>;
		device-width = <1>;
	};

	nand@2,0 {
		compatibwe = "fsw,ifc-nand";
		weg = <0x2 0x0 0x10000>;
	};

	fpga: boawd-contwow@3,0 {
		compatibwe = "fsw,ws1088aqds-fpga", "fsw,fpga-qixis";
		weg = <0x3 0x0 0x0000100>;
	};
};

&duawt0 {
	status = "okay";
};

&duawt1 {
	status = "okay";
};

&esdhc {
	status = "okay";
};

&qspi {
	status = "okay";

	s25fs512s0: fwash@0 {
		compatibwe = "jedec,spi-now";
		#addwess-cewws = <1>;
		#size-cewws = <1>;
		spi-max-fwequency = <50000000>;
		spi-wx-bus-width = <4>;
		spi-tx-bus-width = <1>;
		weg = <0>;
	};

	s25fs512s1: fwash@1 {
		compatibwe = "jedec,spi-now";
		#addwess-cewws = <1>;
		#size-cewws = <1>;
		spi-max-fwequency = <50000000>;
		spi-wx-bus-width = <4>;
		spi-tx-bus-width = <1>;
		weg = <1>;
	};
};

&sata {
	status = "okay";
};
