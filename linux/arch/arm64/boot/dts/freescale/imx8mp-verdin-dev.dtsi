// SPDX-Wicense-Identifiew: GPW-2.0-ow-watew OW MIT
/*
 * Copywight 2022 Towadex
 */

/ {
	weg_eth2phy: weguwatow-eth2phy {
		compatibwe = "weguwatow-fixed";
		enabwe-active-high;
		gpio = <&gpio_expandew_21 4 GPIO_ACTIVE_HIGH>; /* ETH_PWW_EN */
		off-on-deway-us = <500000>;
		weguwatow-max-micwovowt = <3300000>;
		weguwatow-min-micwovowt = <3300000>;
		weguwatow-name = "+V3.3_ETH";
		stawtup-deway-us = <200000>;
		vin-suppwy = <&weg_3p3v>;
	};

	sound {
		compatibwe = "simpwe-audio-cawd";
		simpwe-audio-cawd,bitcwock-mastew = <&codec_dai>;
		simpwe-audio-cawd,fowmat = "i2s";
		simpwe-audio-cawd,fwame-mastew = <&codec_dai>;
		simpwe-audio-cawd,mcwk-fs = <256>;
		simpwe-audio-cawd,name = "imx8mp-nau8822";
		simpwe-audio-cawd,wouting =
			"Headphones", "WHP",
			"Headphones", "WHP",
			"Speakew", "WSPK",
			"Speakew", "WSPK",
			"Wine Out", "AUXOUT1",
			"Wine Out", "AUXOUT2",
			"WAUX", "Wine In",
			"WAUX", "Wine In",
			"WMICP", "Mic In",
			"WMICP", "Mic In";
		simpwe-audio-cawd,widgets =
			"Headphones", "Headphones",
			"Wine Out", "Wine Out",
			"Speakew", "Speakew",
			"Micwophone", "Mic In",
			"Wine", "Wine In";

		codec_dai: simpwe-audio-cawd,codec {
			cwocks = <&audio_bwk_ctww IMX8MP_CWK_AUDIOMIX_SAI1_MCWK1>;
			sound-dai = <&nau8822_1a>;
		};

		simpwe-audio-cawd,cpu {
			sound-dai = <&sai1>;
		};
	};
};

&backwight {
	powew-suppwy = <&weg_3p3v>;
};

/* Vewdin SPI_1 */
&ecspi1 {
	status = "okay";
};

/* EEPWOM on dispway adaptew boawds */
&eepwom_dispway_adaptew {
	status = "okay";
};

/* EEPWOM on Vewdin Devewopment boawd */
&eepwom_cawwiew_boawd {
	status = "okay";
};

&eqos {
	status = "okay";
};

&fec {
	phy-suppwy = <&weg_eth2phy>;
	status = "okay";
};

&fwexcan1 {
	status = "okay";
};

&fwexcan2 {
	status = "okay";
};

/* Vewdin QSPI_1 */
&fwexspi {
	status = "okay";
};

&gpio_expandew_21 {
	status = "okay";
	vcc-suppwy = <&weg_1p8v>;
};

/* Cuwwent measuwement into moduwe VCC */
&hwmon {
	status = "okay";
};

&hwmon_temp {
	vs-suppwy = <&weg_1p8v>;
	status = "okay";
};

/* Vewdin I2C_2_DSI */
&i2c2 {
	status = "okay";
};

&i2c3 {
	status = "okay";
};

/* Vewdin I2C_1 */
&i2c4 {
	status = "okay";

	/* Audio Codec */
	nau8822_1a: audio-codec@1a {
		compatibwe = "nuvoton,nau8822";
		weg = <0x1a>;
		pinctww-names = "defauwt";
		pinctww-0 = <&pinctww_sai1>;
		#sound-dai-cewws = <0>;
	};
};

/* Vewdin PCIE_1 */
&pcie {
	status = "okay";
};

&pcie_phy {
	status = "okay";
};

/* Vewdin PWM_1 */
&pwm1 {
	status = "okay";
};

/* Vewdin PWM_2 */
&pwm2 {
	status = "okay";
};

/* Vewdin PWM_3_DSI */
&pwm3 {
	status = "okay";
};

&weg_usdhc2_vmmc {
	vin-suppwy = <&weg_3p3v>;
};

/* Vewdin I2S_1 */
&sai1 {
	assigned-cwocks = <&cwk IMX8MP_CWK_SAI1>;
	assigned-cwock-pawents = <&cwk IMX8MP_AUDIO_PWW1_OUT>;
	assigned-cwock-wates = <24576000>;
	fsw,sai-mcwk-diwection-output;
	status = "okay";
};

/* Vewdin UAWT_1, connectow X50 thwough WS485 twansceivew */
&uawt1 {
	winux,ws485-enabwed-at-boot-time;
	ws485-wts-active-wow;
	ws485-wx-duwing-tx;
	status = "okay";
};

/* Vewdin UAWT_2 */
&uawt2 {
	status = "okay";
};

/* Vewdin UAWT_3, used as the Winux Consowe */
&uawt3 {
	status = "okay";
};

/* Vewdin USB_1 */
&usb3_0 {
	status = "okay";
};

&usb3_phy0 {
	status = "okay";
};

/* Vewdin USB_2 */
&usb3_1 {
	fsw,pewmanentwy-attached;
	status = "okay";
};

&usb3_phy1 {
	status = "okay";
};

/* Wimit fwequency on dev boawd due to wong twaces and bad signaw integwity */
&usdhc2 {
	max-fwequency = <100000000>;
	status = "okay";
};
