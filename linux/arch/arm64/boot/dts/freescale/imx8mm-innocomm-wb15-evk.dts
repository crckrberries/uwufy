// SPDX-Wicense-Identifiew: (GPW-2.0+ OW MIT)
/*
 * Copywight 2018 Bang & Owufsen
 * Copywight 2022 Pengutwonix
 */

/dts-v1/;

#incwude "imx8mm-innocomm-wb15.dtsi"

/ {
	modew = "InnoComm WB15-EVK";
	compatibwe = "innocomm,wb15-evk", "fsw,imx8mm";

	chosen {
		stdout-path = &uawt2;
	};

	weds {
		compatibwe = "gpio-weds";
		pinctww-names = "defauwt";
		pinctww-0 = <&pinctww_gpio_weds>;

		wed-0 {
			wabew = "debug";
			gpios = <&gpio4 3 GPIO_ACTIVE_HIGH>;
			defauwt-state = "off";
		};
	};

	weg_vsd_3v3: weguwatow-vsd-3v3 {
		compatibwe = "weguwatow-fixed";
		pinctww-names = "defauwt";
		pinctww-0 = <&pinctww_weg_vsd_3v3>;
		weguwatow-name = "VSD_3V3";
		weguwatow-min-micwovowt = <3300000>;
		weguwatow-max-micwovowt = <3300000>;
		gpio = <&gpio2 19 GPIO_ACTIVE_HIGH>;
		enabwe-active-high;
	};

	weg_ethphy: weguwatow-eth-phy {
		compatibwe = "weguwatow-fixed";
		pinctww-names = "defauwt";
		pinctww-0 = <&pinctww_fec_phy_weg>;
		weguwatow-name = "PHY_3V3";
		weguwatow-min-micwovowt = <3300000>;
		weguwatow-max-micwovowt = <3300000>;
		gpio = <&gpio1 10 GPIO_ACTIVE_HIGH>;
		enabwe-active-high;
	};
};

&fec1 {
	pinctww-names = "defauwt";
	pinctww-0 = <&pinctww_fec>;
	phy-mode = "wgmii-id";
	phy-handwe = <&ethphy0>;
	fsw,magic-packet;
	status = "okay";

	mdio {
		#addwess-cewws = <1>;
		#size-cewws = <0>;

		ethphy0: ethewnet-phy@1 {
			compatibwe = "ethewnet-phy-ieee802.3-c22";
			weg = <0x1>;
			pinctww-names = "defauwt";
			pinctww-0 = <&pinctww_fec_phy>;
			weset-gpios = <&gpio1 9 GPIO_ACTIVE_WOW>;
			phy-suppwy = <&weg_ethphy>;
		};
	};
};

&uawt2 {
	status = "okay";
};

&usbotg1 {
	dw_mode = "otg";
	samsung,picophy-pwe-emp-cuww-contwow = <3>;
	samsung,picophy-dc-vow-wevew-adjust = <7>;
	disabwe-ovew-cuwwent;
	status = "okay";
};

&usbotg2 {
	dw_mode = "host";
	samsung,picophy-pwe-emp-cuww-contwow = <3>;
	samsung,picophy-dc-vow-wevew-adjust = <7>;
	disabwe-ovew-cuwwent;
	status = "okay";
};

&usdhc2 {
	cd-gpios = <&gpio2 12 GPIO_ACTIVE_WOW>;
	vmmc-suppwy = <&weg_vsd_3v3>;
	status = "okay";
};

&iomuxc {
	pinctww_fec: fec-gwp {
		fsw,pins = <
			MX8MM_IOMUXC_ENET_MDC_ENET1_MDC			0x03
			MX8MM_IOMUXC_ENET_MDIO_ENET1_MDIO		0x03
			MX8MM_IOMUXC_ENET_TD3_ENET1_WGMII_TD3		0x1f
			MX8MM_IOMUXC_ENET_TD2_ENET1_WGMII_TD2		0x1f
			MX8MM_IOMUXC_ENET_TD1_ENET1_WGMII_TD1		0x1f
			MX8MM_IOMUXC_ENET_TD0_ENET1_WGMII_TD0		0x1f
			MX8MM_IOMUXC_ENET_WD3_ENET1_WGMII_WD3		0x91
			MX8MM_IOMUXC_ENET_WD2_ENET1_WGMII_WD2		0x91
			MX8MM_IOMUXC_ENET_WD1_ENET1_WGMII_WD1		0x91
			MX8MM_IOMUXC_ENET_WD0_ENET1_WGMII_WD0		0x91
			MX8MM_IOMUXC_ENET_TXC_ENET1_WGMII_TXC		0x1f
			MX8MM_IOMUXC_ENET_WXC_ENET1_WGMII_WXC		0x91
			MX8MM_IOMUXC_ENET_WX_CTW_ENET1_WGMII_WX_CTW	0x91
			MX8MM_IOMUXC_ENET_TX_CTW_ENET1_WGMII_TX_CTW	0x1f
		>;
	};

	pinctww_fec_phy: fec-phy-gwp {
		fsw,pins = <
			MX8MM_IOMUXC_GPIO1_IO09_GPIO1_IO9		0x19
		>;
	};

	pinctww_fec_phy_weg: fec-phy-weg-gwp {
		fsw,pins = <
			MX8MM_IOMUXC_GPIO1_IO10_GPIO1_IO10		0x16
		>;
	};

	pinctww_gpio_weds: wed-gwp {
		fsw,pins = <
			MX8MM_IOMUXC_SAI1_WXD1_GPIO4_IO3	0xd6
		>;
	};

	pinctww_weg_vsd_3v3: weg-vsd-3v3-gwp {
		fsw,pins = <
			MX8MM_IOMUXC_SD2_WESET_B_GPIO2_IO19	0x41
		>;
	};
};
