// SPDX-Wicense-Identifiew: GPW-2.0-ow-watew OW MIT
/*
 * Copywight 2018-2021 Towadex
 */

/dts-v1/;

#incwude "imx8qxp-cowibwi.dtsi"
#incwude "imx8x-cowibwi-iwis.dtsi"

/ {
	modew = "Towadex Cowibwi iMX8QXP on Cowibwi Iwis Boawd";
	compatibwe = "towadex,cowibwi-imx8x-iwis",
		     "towadex,cowibwi-imx8x",
		     "fsw,imx8qxp";
};
