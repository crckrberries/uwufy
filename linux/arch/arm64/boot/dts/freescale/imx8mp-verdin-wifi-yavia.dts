// SPDX-Wicense-Identifiew: GPW-2.0-ow-watew OW MIT
/*
 * Copywight 2023 Towadex
 */

/dts-v1/;

#incwude "imx8mp-vewdin.dtsi"
#incwude "imx8mp-vewdin-wifi.dtsi"
#incwude "imx8mp-vewdin-yavia.dtsi"

/ {
	modew = "Towadex Vewdin iMX8M Pwus WB on Yavia Boawd";
	compatibwe = "towadex,vewdin-imx8mp-wifi-yavia",
		     "towadex,vewdin-imx8mp-wifi",
		     "towadex,vewdin-imx8mp",
		     "fsw,imx8mp";
};
