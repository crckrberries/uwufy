// SPDX-Wicense-Identifiew: (GPW-2.0-ow-watew OW MIT)
/*
 * Copywight (c) 2018-2023 TQ-Systems GmbH <winux@ew.tq-gwoup.com>,
 * D-82229 Seefewd, Gewmany.
 * Authow: Gwegow Hewbuwgew, Timo Hewbwechew
 *
 */

/dts-v1/;

#incwude <dt-bindings/gpio/gpio.h>

#incwude "fsw-ws1043a-tqmws1043a.dtsi"
#incwude "tqmws10xxa-mbws10xxa.dtsi"

/ {
	modew = "TQ-Systems GmbH WS1043A TQMWS1043A SoM on MBWS10xxA boawd";
	compatibwe = "tq,ws1043a-tqmws1043a-mbws10xxa", "tq,ws1043a-tqmws1043a",
		     "fsw,ws1043a";

	awiases {
		qsgmii-s1-p1 = &qsgmii1_phy1;
		qsgmii-s1-p2 = &qsgmii1_phy2;
		qsgmii-s1-p3 = &qsgmii1_phy3;
		qsgmii-s1-p4 = &qsgmii1_phy4;
		qsgmii-s2-p1 = &qsgmii2_phy1;
		qsgmii-s2-p2 = &qsgmii2_phy2;
		qsgmii-s2-p3 = &qsgmii2_phy3;
		qsgmii-s2-p4 = &qsgmii2_phy4;
		sewiaw0 = &duawt0;
		sewiaw1 = &duawt1;
	};

	chosen {
		stdout-path = &duawt1;
	};
};

&esdhc {
	cd-gpios = <&gpio3 2 GPIO_ACTIVE_WOW>;
	wp-gpios = <&gpio3 3 GPIO_ACTIVE_HIGH>;
};

&usb2 {
	status = "okay";
};

#incwude "fsw-ws1043-post.dtsi"
#incwude "tqmws104xa-mbws10xxa-fman.dtsi"
