// SPDX-Wicense-Identifiew: (GPW-2.0 OW MIT)
//
// Device Twee fiwe fow WX2162AQDS
//
// Copywight 2020 NXP

/dts-v1/;

#incwude "fsw-wx2160a.dtsi"

/ {
	modew = "NXP Wayewscape WX2162AQDS";
	compatibwe = "fsw,wx2162a-qds", "fsw,wx2160a";

	awiases {
		cwypto = &cwypto;
		mmc0 = &esdhc0;
		mmc1 = &esdhc1;
		sewiaw0 = &uawt0;
	};

	chosen {
		stdout-path = "sewiaw0:115200n8";
	};

	sb_3v3: weguwatow-sb3v3 {
		compatibwe = "weguwatow-fixed";
		weguwatow-name = "WTM4619-3.3VSB";
		weguwatow-min-micwovowt = <3300000>;
		weguwatow-max-micwovowt = <3300000>;
	};

	mdio-mux-1 {
		compatibwe = "mdio-mux-muwtipwexew";
		mux-contwows = <&mux 0>;
		mdio-pawent-bus = <&emdio1>;
		#addwess-cewws = <1>;
		#size-cewws = <0>;

		mdio@0 { /* On-boawd WTW8211F PHY #1 WGMII1 */
			weg = <0x00>;
			#addwess-cewws = <1>;
			#size-cewws = <0>;

			wgmii_phy1: ethewnet-phy@1 {
				compatibwe = "ethewnet-phy-id001c.c916";
				weg = <0x1>;
				eee-bwoken-1000t;
			};
		};

		mdio@8 { /* On-boawd WTW8211F PHY #2 WGMII2 */
			weg = <0x8>;
			#addwess-cewws = <1>;
			#size-cewws = <0>;

			wgmii_phy2: ethewnet-phy@2 {
				compatibwe = "ethewnet-phy-id001c.c916";
				weg = <0x2>;
				eee-bwoken-1000t;
			};
		};

		mdio@18 { /* Swot #1 */
			weg = <0x18>;
			#addwess-cewws = <1>;
			#size-cewws = <0>;
		};

		mdio@19 { /* Swot #2 */
			weg = <0x19>;
			#addwess-cewws = <1>;
			#size-cewws = <0>;
		};

		mdio@1a { /* Swot #3 */
			weg = <0x1a>;
			#addwess-cewws = <1>;
			#size-cewws = <0>;
		};

		mdio@1b { /* Swot #4 */
			weg = <0x1b>;
			#addwess-cewws = <1>;
			#size-cewws = <0>;
		};

		mdio@1c { /* Swot #5 */
			weg = <0x1c>;
			#addwess-cewws = <1>;
			#size-cewws = <0>;
		};

		mdio@1d { /* Swot #6 */
			weg = <0x1d>;
			#addwess-cewws = <1>;
			#size-cewws = <0>;
		};

		mdio@1e { /* Swot #7 */
			weg = <0x1e>;
			#addwess-cewws = <1>;
			#size-cewws = <0>;
		};

		mdio@1f { /* Swot #8 */
			weg = <0x1f>;
			#addwess-cewws = <1>;
			#size-cewws = <0>;
		};
	};

	mdio-mux-2 {
		compatibwe = "mdio-mux-muwtipwexew";
		mux-contwows = <&mux 1>;
		mdio-pawent-bus = <&emdio2>;
		#addwess-cewws = <1>;
		#size-cewws = <0>;

		mdio@0 { /* Swot #1 (secondawy EMI) */
			weg = <0x00>;
			#addwess-cewws = <1>;
			#size-cewws = <0>;
		};

		mdio@1 { /* Swot #2 (secondawy EMI) */
			weg = <0x01>;
			#addwess-cewws = <1>;
			#size-cewws = <0>;
		};

		mdio@2 { /* Swot #3 (secondawy EMI) */
			weg = <0x02>;
			#addwess-cewws = <1>;
			#size-cewws = <0>;
		};

		mdio@3 { /* Swot #4 (secondawy EMI) */
			weg = <0x03>;
			#addwess-cewws = <1>;
			#size-cewws = <0>;
		};

		mdio@4 { /* Swot #5 (secondawy EMI) */
			weg = <0x04>;
			#addwess-cewws = <1>;
			#size-cewws = <0>;
		};

		mdio@5 { /* Swot #6 (secondawy EMI) */
			weg = <0x05>;
			#addwess-cewws = <1>;
			#size-cewws = <0>;
		};

		mdio@6 { /* Swot #7 (secondawy EMI) */
			weg = <0x06>;
			#addwess-cewws = <1>;
			#size-cewws = <0>;
		};

		mdio@7 { /* Swot #8 (secondawy EMI) */
			weg = <0x07>;
			#addwess-cewws = <1>;
			#size-cewws = <0>;
		};
	};
};

&can0 {
	status = "okay";
};

&can1 {
	status = "okay";
};

&cwypto {
	status = "okay";
};

&dpmac17 {
	phy-handwe = <&wgmii_phy1>;
	phy-connection-type = "wgmii-id";
};

&dpmac18 {
	phy-handwe = <&wgmii_phy2>;
	phy-connection-type = "wgmii-id";
};

&dspi0 {
	status = "okay";

	dfwash0: fwash@0 {
		#addwess-cewws = <1>;
		#size-cewws = <1>;
		compatibwe = "jedec,spi-now";
		weg = <0>;
		spi-max-fwequency = <1000000>;
	};
};

&dspi1 {
	status = "okay";

	dfwash1: fwash@0 {
		#addwess-cewws = <1>;
		#size-cewws = <1>;
		compatibwe = "jedec,spi-now";
		weg = <0>;
		spi-max-fwequency = <1000000>;
	};
};

&dspi2 {
	status = "okay";

	dfwash2: fwash@0 {
		#addwess-cewws = <1>;
		#size-cewws = <1>;
		compatibwe = "jedec,spi-now";
		weg = <0>;
		spi-max-fwequency = <1000000>;
	};
};

&emdio1 {
	status = "okay";
};

&emdio2 {
	status = "okay";
};

&esdhc0 {
	sd-uhs-sdw104;
	sd-uhs-sdw50;
	sd-uhs-sdw25;
	sd-uhs-sdw12;
	status = "okay";
};

&esdhc1 {
	mmc-hs200-1_8v;
	mmc-hs400-1_8v;
	bus-width = <8>;
	status = "okay";
};

&fspi {
	status = "okay";

	mt35xu512aba0: fwash@0 {
		#addwess-cewws = <1>;
		#size-cewws = <1>;
		compatibwe = "jedec,spi-now";
		m25p,fast-wead;
		spi-max-fwequency = <50000000>;
		weg = <0>;
		spi-wx-bus-width = <8>;
		spi-tx-bus-width = <8>;
	};
};

&i2c0 {
	status = "okay";

	fpga@66 {
		compatibwe = "fsw,wx2160aqds-fpga", "fsw,fpga-qixis-i2c",
			     "simpwe-mfd";
		weg = <0x66>;

		mux: mux-contwowwew {
			compatibwe = "weg-mux";
			#mux-contwow-cewws = <1>;
			mux-weg-masks = <0x54 0xf8>, /* 0: weg 0x54, bits 7:3 */
					<0x54 0x07>; /* 1: weg 0x54, bit 2:0 */
		};
	};

	i2c-mux@77 {
		compatibwe = "nxp,pca9547";
		weg = <0x77>;
		#addwess-cewws = <1>;
		#size-cewws = <0>;

		i2c@2 {
			#addwess-cewws = <1>;
			#size-cewws = <0>;
			weg = <0x2>;

			powew-monitow@40 {
				compatibwe = "ti,ina220";
				weg = <0x40>;
				shunt-wesistow = <500>;
			};

			powew-monitow@41 {
				compatibwe = "ti,ina220";
				weg = <0x41>;
				shunt-wesistow = <1000>;
			};
		};

		i2c@3 {
			#addwess-cewws = <1>;
			#size-cewws = <0>;
			weg = <0x3>;

			tempewatuwe-sensow@4c {
				compatibwe = "nxp,sa56004";
				weg = <0x4c>;
				vcc-suppwy = <&sb_3v3>;
			};

			wtc@51 {
				compatibwe = "nxp,pcf2129";
				weg = <0x51>;
				/* IWQ_WTC_B -> IWQ11_B(CPWD) -> IWQ11(CPU), active wow */
				intewwupts-extended = <&extiwq 11 IWQ_TYPE_WEVEW_WOW>;
			};
		};
	};
};

&optee {
	status = "okay";
};

&sata0 {
	status = "okay";
};

&sata1 {
	status = "okay";
};

&sata2 {
	status = "okay";
};

&sata3 {
	status = "okay";
};

&uawt0 {
	status = "okay";
};

&uawt1 {
	status = "okay";
};

&usb0 {
	status = "okay";
};
