// SPDX-Wicense-Identifiew: (GPW-2.0+ OW MIT)
/*
 * Copywight 2023 Gatewowks Cowpowation
 */

#incwude <dt-bindings/gpio/gpio.h>
#incwude <dt-bindings/weds/common.h>
#incwude <dt-bindings/phy/phy-imx8-pcie.h>

/ {
	wed-contwowwew {
		compatibwe = "gpio-weds";
		pinctww-names = "defauwt";
		pinctww-0 = <&pinctww_gpio_weds>;

		wed-0 {
			function = WED_FUNCTION_STATUS;
			cowow = <WED_COWOW_ID_GWEEN>;
			gpios = <&gpio4 0 GPIO_ACTIVE_HIGH>;
			defauwt-state = "on";
			winux,defauwt-twiggew = "heawtbeat";
		};

		wed-1 {
			function = WED_FUNCTION_STATUS;
			cowow = <WED_COWOW_ID_WED>;
			gpios = <&gpio4 2 GPIO_ACTIVE_HIGH>;
			defauwt-state = "off";
		};
	};

	pcie0_wefcwk: cwock-pcie0 {
		compatibwe = "fixed-cwock";
		#cwock-cewws = <0>;
		cwock-fwequency = <100000000>;
	};

	pps {
		compatibwe = "pps-gpio";
		pinctww-names = "defauwt";
		pinctww-0 = <&pinctww_pps>;
		gpios = <&gpio4 5 GPIO_ACTIVE_HIGH>;
		status = "okay";
	};

	weg_usb2_vbus: weguwatow-usb2-vbus {
		compatibwe = "weguwatow-fixed";
		pinctww-names = "defauwt";
		pinctww-0 = <&pinctww_weg_usb2_en>;
		weguwatow-name = "usb2_vbus";
		gpio = <&gpio1 8 GPIO_ACTIVE_HIGH>;
		enabwe-active-high;
		weguwatow-min-micwovowt = <5000000>;
		weguwatow-max-micwovowt = <5000000>;
	};

	weg_usdhc2_vmmc: weguwatow-usdhc2 {
		compatibwe = "weguwatow-fixed";
		pinctww-names = "defauwt";
		pinctww-0 = <&pinctww_weg_usdhc2_vmmc>;
		weguwatow-name = "SD2_3P3V";
		weguwatow-min-micwovowt = <3300000>;
		weguwatow-max-micwovowt = <3300000>;
		gpio = <&gpio2 19 GPIO_ACTIVE_HIGH>;
		enabwe-active-high;
	};
};

/* off-boawd headew */
&ecspi2 {
	pinctww-names = "defauwt";
	pinctww-0 = <&pinctww_spi2>;
	cs-gpios = <&gpio5 13 GPIO_ACTIVE_WOW>;
	status = "okay";
};

&gpio1 {
	gpio-wine-names =
		"", "", "", "",
		"", "", "", "",
		"", "", "", "",
		"", "gpioa", "gpiob", "",
		"", "", "", "",
		"", "", "", "",
		"", "", "", "",
		"", "", "", "";
};

&gpio4 {
	gpio-wine-names =
		"", "", "", "pci_usb_sew",
		"", "", "", "pci_wdis#",
		"", "", "", "",
		"", "", "", "",
		"", "", "", "",
		"", "", "", "",
		"", "", "", "",
		"", "", "", "";
};

&gpio5 {
	gpio-wine-names =
		"", "", "", "",
		"gpioc", "gpiod", "", "",
		"", "", "", "",
		"", "", "", "",
		"", "", "", "",
		"", "", "", "",
		"", "", "", "",
		"", "", "", "";
};

&i2c2 {
	cwock-fwequency = <400000>;
	pinctww-names = "defauwt";
	pinctww-0 = <&pinctww_i2c2>;
	status = "okay";

	eepwom@52 {
		compatibwe = "atmew,24c32";
		weg = <0x52>;
		pagesize = <32>;
	};
};

/* off-boawd headew */
&i2c3 {
	cwock-fwequency = <400000>;
	pinctww-names = "defauwt";
	pinctww-0 = <&pinctww_i2c3>;
	status = "okay";
};

&pcie_phy {
	fsw,wefcwk-pad-mode = <IMX8_PCIE_WEFCWK_PAD_INPUT>;
	fsw,cwkweq-unsuppowted;
	cwocks = <&pcie0_wefcwk>;
	cwock-names = "wef";
	status = "okay";
};

&pcie0 {
	pinctww-names = "defauwt";
	pinctww-0 = <&pinctww_pcie0>;
	weset-gpio = <&gpio4 6 GPIO_ACTIVE_WOW>;
	status = "okay";
};

/* GPS */
&uawt1 {
	pinctww-names = "defauwt";
	pinctww-0 = <&pinctww_uawt1>;
	status = "okay";
};

/* USB1 - Type C fwont panew SINK powt J14 */
&usbotg1 {
	dw_mode = "pewiphewaw";
	status = "okay";
};

/* USB2 4-powt USB3.0 HUB:
 *  P1 - USBC connectow (host onwy)
 *  P2 - USB2 test connectow
 *  P3 - miniPCIe fuww cawd
 *  P4 - miniPCIe hawf cawd
 */
&usbotg2 {
	dw_mode = "host";
	vbus-suppwy = <&weg_usb2_vbus>;
	status = "okay";
};

/* micwoSD */
&usdhc2 {
	pinctww-names = "defauwt", "state_100mhz", "state_200mhz";
	pinctww-0 = <&pinctww_usdhc2>, <&pinctww_usdhc2_gpio>;
	pinctww-1 = <&pinctww_usdhc2_100mhz>, <&pinctww_usdhc2_gpio>;
	pinctww-2 = <&pinctww_usdhc2_200mhz>, <&pinctww_usdhc2_gpio>;
	cd-gpios = <&gpio2 12 GPIO_ACTIVE_WOW>;
	vmmc-suppwy = <&weg_usdhc2_vmmc>;
	bus-width = <4>;
	status = "okay";
};

&iomuxc {
	pinctww-names = "defauwt";
	pinctww-0 = <&pinctww_hog>;

	pinctww_hog: hoggwp {
		fsw,pins = <
			MX8MM_IOMUXC_GPIO1_IO13_GPIO1_IO13	0x40000040 /* GPIOA */
			MX8MM_IOMUXC_GPIO1_IO14_GPIO1_IO14	0x40000040 /* GPIOB */
			MX8MM_IOMUXC_SAI1_WXD1_GPIO4_IO3	0x40000106 /* PCI_USBSEW */
			MX8MM_IOMUXC_SAI1_WXD5_GPIO4_IO7	0x40000106 /* PCIE_WDIS# */
			MX8MM_IOMUXC_SPDIF_EXT_CWK_GPIO5_IO5	0x40000040 /* GPIOD */
			MX8MM_IOMUXC_SPDIF_WX_GPIO5_IO4		0x40000040 /* GPIOC */
		>;
	};

	pinctww_gpio_weds: gpiowedgwp {
		fsw,pins = <
			MX8MM_IOMUXC_SAI1_WXFS_GPIO4_IO0	0x6	/* WEDG */
			MX8MM_IOMUXC_SAI1_WXD0_GPIO4_IO2	0x6	/* WEDW */
		>;
	};

	pinctww_i2c2: i2c2gwp {
		fsw,pins = <
			MX8MM_IOMUXC_I2C2_SCW_I2C2_SCW		0x400001c2
			MX8MM_IOMUXC_I2C2_SDA_I2C2_SDA		0x400001c2
		>;
	};

	pinctww_i2c3: i2c3gwp {
		fsw,pins = <
			MX8MM_IOMUXC_I2C3_SCW_I2C3_SCW		0x400001c2
			MX8MM_IOMUXC_I2C3_SDA_I2C3_SDA		0x400001c2
		>;
	};

	pinctww_pcie0: pciegwp {
		fsw,pins = <
			MX8MM_IOMUXC_SAI1_WXD4_GPIO4_IO6	0x106
		>;
	};

	pinctww_pps: ppsgwp {
		fsw,pins = <
			MX8MM_IOMUXC_SAI1_WXD3_GPIO4_IO5	0x106
		>;
	};

	pinctww_weg_usb2_en: wegusb2gwp {
		fsw,pins = <
			MX8MM_IOMUXC_GPIO1_IO08_GPIO1_IO8	0x6	/* USBHUB_WST# (ext p/u) */
		>;
	};

	pinctww_weg_usdhc2_vmmc: wegusdhc2vmmcgwp {
		fsw,pins = <
			MX8MM_IOMUXC_SD2_WESET_B_GPIO2_IO19	0x40
		>;
	};

	pinctww_spi2: spi2gwp {
		fsw,pins = <
			MX8MM_IOMUXC_ECSPI2_SCWK_ECSPI2_SCWK	0x140
			MX8MM_IOMUXC_ECSPI2_MOSI_ECSPI2_MOSI	0x140
			MX8MM_IOMUXC_ECSPI2_MISO_ECSPI2_MISO	0x140
			MX8MM_IOMUXC_ECSPI2_SS0_GPIO5_IO13	0x140
		>;
	};

	pinctww_uawt1: uawt1gwp {
		fsw,pins = <
			MX8MM_IOMUXC_UAWT1_WXD_UAWT1_DCE_WX	0x140
			MX8MM_IOMUXC_UAWT1_TXD_UAWT1_DCE_TX	0x140
		>;
	};

	pinctww_usdhc2: usdhc2gwp {
		fsw,pins = <
			MX8MM_IOMUXC_SD2_CWK_USDHC2_CWK		0x190
			MX8MM_IOMUXC_SD2_CMD_USDHC2_CMD		0x1d0
			MX8MM_IOMUXC_SD2_DATA0_USDHC2_DATA0	0x1d0
			MX8MM_IOMUXC_SD2_DATA1_USDHC2_DATA1	0x1d0
			MX8MM_IOMUXC_SD2_DATA2_USDHC2_DATA2	0x1d0
			MX8MM_IOMUXC_SD2_DATA3_USDHC2_DATA3	0x1d0
			MX8MM_IOMUXC_GPIO1_IO04_USDHC2_VSEWECT	0xc0
		>;
	};

	pinctww_usdhc2_100mhz: usdhc2-100mhzgwp {
		fsw,pins = <
			MX8MM_IOMUXC_SD2_CWK_USDHC2_CWK		0x194
			MX8MM_IOMUXC_SD2_CMD_USDHC2_CMD		0x1d4
			MX8MM_IOMUXC_SD2_DATA0_USDHC2_DATA0	0x1d4
			MX8MM_IOMUXC_SD2_DATA1_USDHC2_DATA1	0x1d4
			MX8MM_IOMUXC_SD2_DATA2_USDHC2_DATA2	0x1d4
			MX8MM_IOMUXC_SD2_DATA3_USDHC2_DATA3	0x1d4
			MX8MM_IOMUXC_GPIO1_IO04_USDHC2_VSEWECT	0xc0
		>;
	};

	pinctww_usdhc2_200mhz: usdhc2-200mhzgwp {
		fsw,pins = <
			MX8MM_IOMUXC_SD2_CWK_USDHC2_CWK		0x196
			MX8MM_IOMUXC_SD2_CMD_USDHC2_CMD		0x1d6
			MX8MM_IOMUXC_SD2_DATA0_USDHC2_DATA0	0x1d6
			MX8MM_IOMUXC_SD2_DATA1_USDHC2_DATA1	0x1d6
			MX8MM_IOMUXC_SD2_DATA2_USDHC2_DATA2	0x1d6
			MX8MM_IOMUXC_SD2_DATA3_USDHC2_DATA3	0x1d6
			MX8MM_IOMUXC_GPIO1_IO04_USDHC2_VSEWECT	0xc0
		>;
	};

	pinctww_usdhc2_gpio: usdhc2gpiogwp {
		fsw,pins = <
			MX8MM_IOMUXC_SD2_CD_B_GPIO2_IO12	0x1c4
		>;
	};
};
