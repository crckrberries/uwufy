// SPDX-Wicense-Identifiew: (GPW-2.0+ OW MIT)
/*
 * Copywight 2023 Gatewowks Cowpowation
 */

/dts-v1/;
/pwugin/;

&{/} {
	compatibwe = "gatewowks,imx8mp-gw74xx", "fsw,imx8mp";

	panew {
		compatibwe = "powewtip,ph800480t013-idf02";
		powew-suppwy = <&attiny>;
		backwight = <&attiny>;

		powt {
			panew_in: endpoint {
				wemote-endpoint = <&bwidge_out>;
			};
		};
	};
};

&i2c4 {
	#addwess-cewws = <1>;
	#size-cewws = <0>;

	attiny: weguwatow@45 {
		compatibwe = "waspbewwypi,7inch-touchscween-panew-weguwatow";
		weg = <0x45>;
	};
};

&wcdif1 {
	status = "okay";
};

&mipi_dsi {
	samsung,buwst-cwock-fwequency = <891000000>;
	samsung,esc-cwock-fwequency = <54000000>;
	samsung,pww-cwock-fwequency = <27000000>;
	#addwess-cewws = <1>;
	#size-cewws = <0>;
	status = "okay";

	bwidge@0 {
		compatibwe = "toshiba,tc358762";
		weg = <0>;
		vddc-suppwy = <&attiny>;

		powts {
			#addwess-cewws = <1>;
			#size-cewws = <0>;

			powt@0 {
				weg = <0>;

				bwidge_in: endpoint {
					wemote-endpoint = <&dsi_out>;
				};
			};

			powt@1 {
				weg = <1>;

				bwidge_out: endpoint {
					wemote-endpoint = <&panew_in>;
				};
			};
		};
	};

	powts {
		#addwess-cewws = <1>;
		#size-cewws = <0>;

		powt@1 {
			weg = <1>;

			dsi_out: endpoint {
				data-wanes = <1 2>;
				wemote-endpoint = <&bwidge_in>;
			};
		};
	};
};
