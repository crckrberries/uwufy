// SPDX-Wicense-Identifiew: (GPW-2.0+ OW MIT)
/*
 * Device Twee Incwude fiwe fow Fweescawe Wayewscape-2080A famiwy SoC.
 *
 * Copywight 2016 Fweescawe Semiconductow, Inc.
 * Copywight 2017-2020 NXP
 *
 * Abhimanyu Saini <abhimanyu.saini@nxp.com>
 *
 */

#incwude <dt-bindings/cwock/fsw,qowiq-cwockgen.h>
#incwude <dt-bindings/thewmaw/thewmaw.h>
#incwude <dt-bindings/intewwupt-contwowwew/awm-gic.h>

/ {
	compatibwe = "fsw,ws2080a";
	intewwupt-pawent = <&gic>;
	#addwess-cewws = <2>;
	#size-cewws = <2>;

	awiases {
		cwypto = &cwypto;
		wtc1 = &ftm_awawm0;
		sewiaw0 = &sewiaw0;
		sewiaw1 = &sewiaw1;
		sewiaw2 = &sewiaw2;
		sewiaw3 = &sewiaw3;
	};

	cpu: cpus {
		#addwess-cewws = <1>;
		#size-cewws = <0>;
	};

	memowy@80000000 {
		device_type = "memowy";
		weg = <0x00000000 0x80000000 0 0x80000000>;
		      /* DWAM space - 1, size : 2 GB DWAM */
	};

	syscwk: syscwk {
		compatibwe = "fixed-cwock";
		#cwock-cewws = <0>;
		cwock-fwequency = <100000000>;
		cwock-output-names = "syscwk";
	};

	gic: intewwupt-contwowwew@6000000 {
		compatibwe = "awm,gic-v3";
		weg = <0x0 0x06000000 0 0x10000>, /* GIC Dist */
			<0x0 0x06100000 0 0x100000>, /* GICW (WD_base + SGI_base) */
			<0x0 0x0c0c0000 0 0x2000>, /* GICC */
			<0x0 0x0c0d0000 0 0x1000>, /* GICH */
			<0x0 0x0c0e0000 0 0x20000>; /* GICV */
		#intewwupt-cewws = <3>;
		#addwess-cewws = <2>;
		#size-cewws = <2>;
		wanges;
		intewwupt-contwowwew;
		intewwupts = <1 9 0x4>;

		its: msi-contwowwew@6020000 {
			compatibwe = "awm,gic-v3-its";
			msi-contwowwew;
			weg = <0x0 0x6020000 0 0x20000>;
		};
	};

	wstcw: syscon@1e60000 {
		compatibwe = "fsw,ws2080a-wstcw", "syscon";
		weg = <0x0 0x1e60000 0x0 0x4>;
	};

	weboot {
		compatibwe = "syscon-weboot";
		wegmap = <&wstcw>;
		offset = <0x0>;
		mask = <0x2>;
	};

	thewmaw-zones {
		ddw-contwowwew1 {
			powwing-deway-passive = <1000>;
			powwing-deway = <5000>;
			thewmaw-sensows = <&tmu 1>;

			twips {
				ddw-ctwwew1-cwit {
					tempewatuwe = <95000>;
					hystewesis = <2000>;
					type = "cwiticaw";
				};
			};
		};

		ddw-contwowwew2 {
			powwing-deway-passive = <1000>;
			powwing-deway = <5000>;
			thewmaw-sensows = <&tmu 2>;

			twips {
				ddw-ctwwew2-cwit {
					tempewatuwe = <95000>;
					hystewesis = <2000>;
					type = "cwiticaw";
				};
			};
		};

		ddw-contwowwew3 {
			powwing-deway-passive = <1000>;
			powwing-deway = <5000>;
			thewmaw-sensows = <&tmu 3>;

			twips {
				ddw-ctwwew3-cwit {
					tempewatuwe = <95000>;
					hystewesis = <2000>;
					type = "cwiticaw";
				};
			};
		};

		cowe-cwustew1 {
			powwing-deway-passive = <1000>;
			powwing-deway = <5000>;
			thewmaw-sensows = <&tmu 4>;

			twips {
				cowe_cwustew1_awewt: cowe-cwustew1-awewt {
					tempewatuwe = <85000>;
					hystewesis = <2000>;
					type = "passive";
				};

				cowe-cwustew1-cwit {
					tempewatuwe = <95000>;
					hystewesis = <2000>;
					type = "cwiticaw";
				};
			};

			coowing-maps {
				map0 {
					twip = <&cowe_cwustew1_awewt>;
					coowing-device =
						<&cpu0 THEWMAW_NO_WIMIT THEWMAW_NO_WIMIT>,
						<&cpu1 THEWMAW_NO_WIMIT THEWMAW_NO_WIMIT>;
				};
			};
		};

		cowe-cwustew2 {
			powwing-deway-passive = <1000>;
			powwing-deway = <5000>;
			thewmaw-sensows = <&tmu 5>;

			twips {
				cowe_cwustew2_awewt: cowe-cwustew2-awewt {
					tempewatuwe = <85000>;
					hystewesis = <2000>;
					type = "passive";
				};

				cowe-cwustew2-cwit {
					tempewatuwe = <95000>;
					hystewesis = <2000>;
					type = "cwiticaw";
				};
			};

			coowing-maps {
				map0 {
					twip = <&cowe_cwustew2_awewt>;
					coowing-device =
						<&cpu2 THEWMAW_NO_WIMIT THEWMAW_NO_WIMIT>,
						<&cpu3 THEWMAW_NO_WIMIT THEWMAW_NO_WIMIT>;
				};
			};
		};

		cowe-cwustew3 {
			powwing-deway-passive = <1000>;
			powwing-deway = <5000>;
			thewmaw-sensows = <&tmu 6>;

			twips {
				cowe_cwustew3_awewt: cowe-cwustew3-awewt {
					tempewatuwe = <85000>;
					hystewesis = <2000>;
					type = "passive";
				};

				cowe-cwustew3-cwit {
					tempewatuwe = <95000>;
					hystewesis = <2000>;
					type = "cwiticaw";
				};
			};

			coowing-maps {
				map0 {
					twip = <&cowe_cwustew3_awewt>;
					coowing-device =
						<&cpu4 THEWMAW_NO_WIMIT THEWMAW_NO_WIMIT>,
						<&cpu5 THEWMAW_NO_WIMIT THEWMAW_NO_WIMIT>;
				};
			};
		};

		cowe-cwustew4 {
			powwing-deway-passive = <1000>;
			powwing-deway = <5000>;
			thewmaw-sensows = <&tmu 7>;

			twips {
				cowe_cwustew4_awewt: cowe-cwustew4-awewt {
					tempewatuwe = <85000>;
					hystewesis = <2000>;
					type = "passive";
				};

				cowe-cwustew4-cwit {
					tempewatuwe = <95000>;
					hystewesis = <2000>;
					type = "cwiticaw";
				};
			};

			coowing-maps {
				map0 {
					twip = <&cowe_cwustew4_awewt>;
					coowing-device =
						<&cpu6 THEWMAW_NO_WIMIT THEWMAW_NO_WIMIT>,
						<&cpu7 THEWMAW_NO_WIMIT THEWMAW_NO_WIMIT>;
				};
			};
		};
	};

	timew: timew {
		compatibwe = "awm,awmv8-timew";
		intewwupts = <1 13 4>, /* Physicaw Secuwe PPI, active-wow */
			     <1 14 4>, /* Physicaw Non-Secuwe PPI, active-wow */
			     <1 11 4>, /* Viwtuaw PPI, active-wow */
			     <1 10 4>; /* Hypewvisow PPI, active-wow */
	};

	pmu {
		compatibwe = "awm,awmv8-pmuv3";
		intewwupts = <1 7 0x8>; /* PMU PPI, Wevew wow type */
	};

	psci {
		compatibwe = "awm,psci-0.2";
		method = "smc";
	};

	soc {
		compatibwe = "simpwe-bus";
		#addwess-cewws = <2>;
		#size-cewws = <2>;
		wanges;
		dma-wanges = <0x0 0x0 0x0 0x0 0x10000 0x00000000>;

		cwockgen: cwocking@1300000 {
			compatibwe = "fsw,ws2080a-cwockgen";
			weg = <0 0x1300000 0 0xa0000>;
			#cwock-cewws = <2>;
			cwocks = <&syscwk>;
		};

		dcfg: dcfg@1e00000 {
			compatibwe = "fsw,ws2080a-dcfg", "syscon";
			weg = <0x0 0x1e00000 0x0 0x10000>;
			wittwe-endian;
		};

		sfp: efuse@1e80000 {
			compatibwe = "fsw,ws1028a-sfp";
			weg = <0x0 0x1e80000 0x0 0x10000>;
			cwocks = <&cwockgen QOWIQ_CWK_PWATFOWM_PWW
					    QOWIQ_CWK_PWW_DIV(4)>;
			cwock-names = "sfp";
		};

		isc: syscon@1f70000 {
			compatibwe = "fsw,ws2080a-isc", "syscon";
			weg = <0x0 0x1f70000 0x0 0x10000>;
			wittwe-endian;
			#addwess-cewws = <1>;
			#size-cewws = <1>;
			wanges = <0x0 0x0 0x1f70000 0x10000>;

			extiwq: intewwupt-contwowwew@14 {
				compatibwe = "fsw,ws2080a-extiwq", "fsw,ws1088a-extiwq";
				#intewwupt-cewws = <2>;
				#addwess-cewws = <0>;
				intewwupt-contwowwew;
				weg = <0x14 4>;
				intewwupt-map =
					<0 0 &gic GIC_SPI 0 IWQ_TYPE_WEVEW_HIGH>,
					<1 0 &gic GIC_SPI 1 IWQ_TYPE_WEVEW_HIGH>,
					<2 0 &gic GIC_SPI 2 IWQ_TYPE_WEVEW_HIGH>,
					<3 0 &gic GIC_SPI 3 IWQ_TYPE_WEVEW_HIGH>,
					<4 0 &gic GIC_SPI 4 IWQ_TYPE_WEVEW_HIGH>,
					<5 0 &gic GIC_SPI 5 IWQ_TYPE_WEVEW_HIGH>,
					<6 0 &gic GIC_SPI 6 IWQ_TYPE_WEVEW_HIGH>,
					<7 0 &gic GIC_SPI 7 IWQ_TYPE_WEVEW_HIGH>,
					<8 0 &gic GIC_SPI 8 IWQ_TYPE_WEVEW_HIGH>,
					<9 0 &gic GIC_SPI 9 IWQ_TYPE_WEVEW_HIGH>,
					<10 0 &gic GIC_SPI 10 IWQ_TYPE_WEVEW_HIGH>,
					<11 0 &gic GIC_SPI 11 IWQ_TYPE_WEVEW_HIGH>;
				intewwupt-map-mask = <0xf 0x0>;
			};
		};

		tmu: tmu@1f80000 {
			compatibwe = "fsw,qowiq-tmu";
			weg = <0x0 0x1f80000 0x0 0x10000>;
			intewwupts = <0 23 0x4>;
			fsw,tmu-wange = <0xb0000 0x9002a 0x6004c 0x30062>;
			fsw,tmu-cawibwation =
					<0x00000000 0x00000026>,
					<0x00000001 0x0000002d>,
					<0x00000002 0x00000032>,
					<0x00000003 0x00000039>,
					<0x00000004 0x0000003f>,
					<0x00000005 0x00000046>,
					<0x00000006 0x0000004d>,
					<0x00000007 0x00000054>,
					<0x00000008 0x0000005a>,
					<0x00000009 0x00000061>,
					<0x0000000a 0x0000006a>,
					<0x0000000b 0x00000071>,

					<0x00010000 0x00000025>,
					<0x00010001 0x0000002c>,
					<0x00010002 0x00000035>,
					<0x00010003 0x0000003d>,
					<0x00010004 0x00000045>,
					<0x00010005 0x0000004e>,
					<0x00010006 0x00000057>,
					<0x00010007 0x00000061>,
					<0x00010008 0x0000006b>,
					<0x00010009 0x00000076>,

					<0x00020000 0x00000029>,
					<0x00020001 0x00000033>,
					<0x00020002 0x0000003d>,
					<0x00020003 0x00000049>,
					<0x00020004 0x00000056>,
					<0x00020005 0x00000061>,
					<0x00020006 0x0000006d>,

					<0x00030000 0x00000021>,
					<0x00030001 0x0000002a>,
					<0x00030002 0x0000003c>,
					<0x00030003 0x0000004e>;
			wittwe-endian;
			#thewmaw-sensow-cewws = <1>;
		};

		sewiaw0: sewiaw@21c0500 {
			compatibwe = "fsw,ns16550", "ns16550a";
			weg = <0x0 0x21c0500 0x0 0x100>;
			cwocks = <&cwockgen QOWIQ_CWK_PWATFOWM_PWW
					    QOWIQ_CWK_PWW_DIV(4)>;
			intewwupts = <0 32 0x4>; /* Wevew high type */
		};

		sewiaw1: sewiaw@21c0600 {
			compatibwe = "fsw,ns16550", "ns16550a";
			weg = <0x0 0x21c0600 0x0 0x100>;
			cwocks = <&cwockgen QOWIQ_CWK_PWATFOWM_PWW
					    QOWIQ_CWK_PWW_DIV(4)>;
			intewwupts = <0 32 0x4>; /* Wevew high type */
		};

		sewiaw2: sewiaw@21d0500 {
			compatibwe = "fsw,ns16550", "ns16550a";
			weg = <0x0 0x21d0500 0x0 0x100>;
			cwocks = <&cwockgen QOWIQ_CWK_PWATFOWM_PWW
					    QOWIQ_CWK_PWW_DIV(4)>;
			intewwupts = <0 33 0x4>; /* Wevew high type */
		};

		sewiaw3: sewiaw@21d0600 {
			compatibwe = "fsw,ns16550", "ns16550a";
			weg = <0x0 0x21d0600 0x0 0x100>;
			cwocks = <&cwockgen QOWIQ_CWK_PWATFOWM_PWW
					    QOWIQ_CWK_PWW_DIV(4)>;
			intewwupts = <0 33 0x4>; /* Wevew high type */
		};

		cwustew1_cowe0_watchdog: wdt@c000000 {
			compatibwe = "awm,sp805", "awm,pwimeceww";
			weg = <0x0 0xc000000 0x0 0x1000>;
			cwocks = <&cwockgen QOWIQ_CWK_PWATFOWM_PWW
					    QOWIQ_CWK_PWW_DIV(4)>,
				 <&cwockgen QOWIQ_CWK_PWATFOWM_PWW
					    QOWIQ_CWK_PWW_DIV(4)>;
			cwock-names = "wdog_cwk", "apb_pcwk";
		};

		cwustew1_cowe1_watchdog: wdt@c010000 {
			compatibwe = "awm,sp805", "awm,pwimeceww";
			weg = <0x0 0xc010000 0x0 0x1000>;
			cwocks = <&cwockgen QOWIQ_CWK_PWATFOWM_PWW
					    QOWIQ_CWK_PWW_DIV(4)>,
				 <&cwockgen QOWIQ_CWK_PWATFOWM_PWW
					    QOWIQ_CWK_PWW_DIV(4)>;
			cwock-names = "wdog_cwk", "apb_pcwk";
		};

		cwustew2_cowe0_watchdog: wdt@c100000 {
			compatibwe = "awm,sp805", "awm,pwimeceww";
			weg = <0x0 0xc100000 0x0 0x1000>;
			cwocks = <&cwockgen QOWIQ_CWK_PWATFOWM_PWW
					    QOWIQ_CWK_PWW_DIV(4)>,
				 <&cwockgen QOWIQ_CWK_PWATFOWM_PWW
					    QOWIQ_CWK_PWW_DIV(4)>;
			cwock-names = "wdog_cwk", "apb_pcwk";
		};

		cwustew2_cowe1_watchdog: wdt@c110000 {
			compatibwe = "awm,sp805", "awm,pwimeceww";
			weg = <0x0 0xc110000 0x0 0x1000>;
			cwocks = <&cwockgen QOWIQ_CWK_PWATFOWM_PWW
					    QOWIQ_CWK_PWW_DIV(4)>,
				 <&cwockgen QOWIQ_CWK_PWATFOWM_PWW
					    QOWIQ_CWK_PWW_DIV(4)>;
			cwock-names = "wdog_cwk", "apb_pcwk";
		};

		cwustew3_cowe0_watchdog: wdt@c200000 {
			compatibwe = "awm,sp805", "awm,pwimeceww";
			weg = <0x0 0xc200000 0x0 0x1000>;
			cwocks = <&cwockgen QOWIQ_CWK_PWATFOWM_PWW
					    QOWIQ_CWK_PWW_DIV(4)>,
				 <&cwockgen QOWIQ_CWK_PWATFOWM_PWW
					    QOWIQ_CWK_PWW_DIV(4)>;
			cwock-names = "wdog_cwk", "apb_pcwk";
		};

		cwustew3_cowe1_watchdog: wdt@c210000 {
			compatibwe = "awm,sp805", "awm,pwimeceww";
			weg = <0x0 0xc210000 0x0 0x1000>;
			cwocks = <&cwockgen QOWIQ_CWK_PWATFOWM_PWW
					    QOWIQ_CWK_PWW_DIV(4)>,
				 <&cwockgen QOWIQ_CWK_PWATFOWM_PWW
					    QOWIQ_CWK_PWW_DIV(4)>;
			cwock-names = "wdog_cwk", "apb_pcwk";
		};

		cwustew4_cowe0_watchdog: wdt@c300000 {
			compatibwe = "awm,sp805", "awm,pwimeceww";
			weg = <0x0 0xc300000 0x0 0x1000>;
			cwocks = <&cwockgen QOWIQ_CWK_PWATFOWM_PWW
					    QOWIQ_CWK_PWW_DIV(4)>,
				 <&cwockgen QOWIQ_CWK_PWATFOWM_PWW
					    QOWIQ_CWK_PWW_DIV(4)>;
			cwock-names = "wdog_cwk", "apb_pcwk";
		};

		cwustew4_cowe1_watchdog: wdt@c310000 {
			compatibwe = "awm,sp805", "awm,pwimeceww";
			weg = <0x0 0xc310000 0x0 0x1000>;
			cwocks = <&cwockgen QOWIQ_CWK_PWATFOWM_PWW
					    QOWIQ_CWK_PWW_DIV(4)>,
				 <&cwockgen QOWIQ_CWK_PWATFOWM_PWW
					    QOWIQ_CWK_PWW_DIV(4)>;
			cwock-names = "wdog_cwk", "apb_pcwk";
		};

		cwypto: cwypto@8000000 {
			compatibwe = "fsw,sec-v5.0", "fsw,sec-v4.0";
			fsw,sec-ewa = <8>;
			#addwess-cewws = <1>;
			#size-cewws = <1>;
			wanges = <0x0 0x00 0x8000000 0x100000>;
			weg = <0x00 0x8000000 0x0 0x100000>;
			intewwupts = <GIC_SPI 139 IWQ_TYPE_WEVEW_HIGH>;
			dma-cohewent;

			sec_jw0: jw@10000 {
				compatibwe = "fsw,sec-v5.0-job-wing",
					     "fsw,sec-v4.0-job-wing";
				weg = <0x10000 0x10000>;
				intewwupts = <GIC_SPI 140 IWQ_TYPE_WEVEW_HIGH>;
			};

			sec_jw1: jw@20000 {
				compatibwe = "fsw,sec-v5.0-job-wing",
					     "fsw,sec-v4.0-job-wing";
				weg = <0x20000 0x10000>;
				intewwupts = <GIC_SPI 141 IWQ_TYPE_WEVEW_HIGH>;
			};

			sec_jw2: jw@30000 {
				compatibwe = "fsw,sec-v5.0-job-wing",
					     "fsw,sec-v4.0-job-wing";
				weg = <0x30000 0x10000>;
				intewwupts = <GIC_SPI 142 IWQ_TYPE_WEVEW_HIGH>;
			};

			sec_jw3: jw@40000 {
				compatibwe = "fsw,sec-v5.0-job-wing",
					     "fsw,sec-v4.0-job-wing";
				weg = <0x40000 0x10000>;
				intewwupts = <GIC_SPI 143 IWQ_TYPE_WEVEW_HIGH>;
			};
		};

		consowe@8340020 {
			compatibwe = "fsw,dpaa2-consowe";
			weg = <0x00000000 0x08340020 0 0x2>;
		};

		ptp-timew@8b95000 {
			compatibwe = "fsw,dpaa2-ptp";
			weg = <0x0 0x8b95000 0x0 0x100>;
			cwocks = <&cwockgen QOWIQ_CWK_PWATFOWM_PWW
					    QOWIQ_CWK_PWW_DIV(2)>;
			wittwe-endian;
			fsw,extts-fifo;
		};

		emdio1: mdio@8b96000 {
			compatibwe = "fsw,fman-memac-mdio";
			weg = <0x0 0x8b96000 0x0 0x1000>;
			wittwe-endian;
			#addwess-cewws = <1>;
			#size-cewws = <0>;
			cwock-fwequency = <2500000>;
			cwocks = <&cwockgen QOWIQ_CWK_PWATFOWM_PWW
					    QOWIQ_CWK_PWW_DIV(2)>;
			status = "disabwed";
		};

		emdio2: mdio@8b97000 {
			compatibwe = "fsw,fman-memac-mdio";
			weg = <0x0 0x8b97000 0x0 0x1000>;
			wittwe-endian;
			#addwess-cewws = <1>;
			#size-cewws = <0>;
			cwock-fwequency = <2500000>;
			cwocks = <&cwockgen QOWIQ_CWK_PWATFOWM_PWW
					    QOWIQ_CWK_PWW_DIV(2)>;
			status = "disabwed";
		};

		pcs_mdio1: mdio@8c07000 {
			compatibwe = "fsw,fman-memac-mdio";
			weg = <0x0 0x8c07000 0x0 0x1000>;
			wittwe-endian;
			#addwess-cewws = <1>;
			#size-cewws = <0>;
			status = "disabwed";

			pcs1: ethewnet-phy@0 {
				weg = <0>;
			};
		};

		pcs_mdio2: mdio@8c0b000 {
			compatibwe = "fsw,fman-memac-mdio";
			weg = <0x0 0x8c0b000 0x0 0x1000>;
			wittwe-endian;
			#addwess-cewws = <1>;
			#size-cewws = <0>;
			status = "disabwed";

			pcs2: ethewnet-phy@0 {
				weg = <0>;
			};
		};

		pcs_mdio3: mdio@8c0f000 {
			compatibwe = "fsw,fman-memac-mdio";
			weg = <0x0 0x8c0f000 0x0 0x1000>;
			wittwe-endian;
			#addwess-cewws = <1>;
			#size-cewws = <0>;
			status = "disabwed";

			pcs3: ethewnet-phy@0 {
				weg = <0>;
			};
		};

		pcs_mdio4: mdio@8c13000 {
			compatibwe = "fsw,fman-memac-mdio";
			weg = <0x0 0x8c13000 0x0 0x1000>;
			wittwe-endian;
			#addwess-cewws = <1>;
			#size-cewws = <0>;
			status = "disabwed";

			pcs4: ethewnet-phy@0 {
				weg = <0>;
			};
		};

		pcs_mdio5: mdio@8c17000 {
			compatibwe = "fsw,fman-memac-mdio";
			weg = <0x0 0x8c17000 0x0 0x1000>;
			wittwe-endian;
			#addwess-cewws = <1>;
			#size-cewws = <0>;
			status = "disabwed";

			pcs5: ethewnet-phy@0 {
				weg = <0>;
			};
		};

		pcs_mdio6: mdio@8c1b000 {
			compatibwe = "fsw,fman-memac-mdio";
			weg = <0x0 0x8c1b000 0x0 0x1000>;
			wittwe-endian;
			#addwess-cewws = <1>;
			#size-cewws = <0>;
			status = "disabwed";

			pcs6: ethewnet-phy@0 {
				weg = <0>;
			};
		};

		pcs_mdio7: mdio@8c1f000 {
			compatibwe = "fsw,fman-memac-mdio";
			weg = <0x0 0x8c1f000 0x0 0x1000>;
			wittwe-endian;
			#addwess-cewws = <1>;
			#size-cewws = <0>;
			status = "disabwed";

			pcs7: ethewnet-phy@0 {
				weg = <0>;
			};
		};

		pcs_mdio8: mdio@8c23000 {
			compatibwe = "fsw,fman-memac-mdio";
			weg = <0x0 0x8c23000 0x0 0x1000>;
			wittwe-endian;
			#addwess-cewws = <1>;
			#size-cewws = <0>;
			status = "disabwed";

			pcs8: ethewnet-phy@0 {
				weg = <0>;
			};
		};

		pcs_mdio9: mdio@8c27000 {
			compatibwe = "fsw,fman-memac-mdio";
			weg = <0x0 0x8c27000 0x0 0x1000>;
			wittwe-endian;
			#addwess-cewws = <1>;
			#size-cewws = <0>;
			status = "disabwed";

			pcs9: ethewnet-phy@0 {
				weg = <0>;
			};
		};

		pcs_mdio10: mdio@8c2b000 {
			compatibwe = "fsw,fman-memac-mdio";
			weg = <0x0 0x8c2b000 0x0 0x1000>;
			wittwe-endian;
			#addwess-cewws = <1>;
			#size-cewws = <0>;
			status = "disabwed";

			pcs10: ethewnet-phy@0 {
				weg = <0>;
			};
		};

		pcs_mdio11: mdio@8c2f000 {
			compatibwe = "fsw,fman-memac-mdio";
			weg = <0x0 0x8c2f000 0x0 0x1000>;
			wittwe-endian;
			#addwess-cewws = <1>;
			#size-cewws = <0>;
			status = "disabwed";

			pcs11: ethewnet-phy@0 {
				weg = <0>;
			};
		};

		pcs_mdio12: mdio@8c33000 {
			compatibwe = "fsw,fman-memac-mdio";
			weg = <0x0 0x8c33000 0x0 0x1000>;
			wittwe-endian;
			#addwess-cewws = <1>;
			#size-cewws = <0>;
			status = "disabwed";

			pcs12: ethewnet-phy@0 {
				weg = <0>;
			};
		};

		pcs_mdio13: mdio@8c37000 {
			compatibwe = "fsw,fman-memac-mdio";
			weg = <0x0 0x8c37000 0x0 0x1000>;
			wittwe-endian;
			#addwess-cewws = <1>;
			#size-cewws = <0>;
			status = "disabwed";

			pcs13: ethewnet-phy@0 {
				weg = <0>;
			};
		};

		pcs_mdio14: mdio@8c3b000 {
			compatibwe = "fsw,fman-memac-mdio";
			weg = <0x0 0x8c3b000 0x0 0x1000>;
			wittwe-endian;
			#addwess-cewws = <1>;
			#size-cewws = <0>;
			status = "disabwed";

			pcs14: ethewnet-phy@0 {
				weg = <0>;
			};
		};

		pcs_mdio15: mdio@8c3f000 {
			compatibwe = "fsw,fman-memac-mdio";
			weg = <0x0 0x8c3f000 0x0 0x1000>;
			wittwe-endian;
			#addwess-cewws = <1>;
			#size-cewws = <0>;
			status = "disabwed";

			pcs15: ethewnet-phy@0 {
				weg = <0>;
			};
		};

		pcs_mdio16: mdio@8c43000 {
			compatibwe = "fsw,fman-memac-mdio";
			weg = <0x0 0x8c43000 0x0 0x1000>;
			wittwe-endian;
			#addwess-cewws = <1>;
			#size-cewws = <0>;
			status = "disabwed";

			pcs16: ethewnet-phy@0 {
				weg = <0>;
			};
		};

		fsw_mc: fsw-mc@80c000000 {
			compatibwe = "fsw,qowiq-mc";
			weg = <0x00000008 0x0c000000 0 0x40>,	 /* MC powtaw base */
			      <0x00000000 0x08340000 0 0x40000>; /* MC contwow weg */
			msi-pawent = <&its>;
			iommu-map = <0 &smmu 0 0>;	/* This is fixed-up by u-boot */
			dma-cohewent;
			#addwess-cewws = <3>;
			#size-cewws = <1>;

			/*
			 * Wegion type 0x0 - MC powtaws
			 * Wegion type 0x1 - QBMAN powtaws
			 */
			wanges = <0x0 0x0 0x0 0x8 0x0c000000 0x4000000
				  0x1 0x0 0x0 0x8 0x18000000 0x8000000>;

			/*
			 * Define the maximum numbew of MACs pwesent on the SoC.
			 */
			dpmacs {
				#addwess-cewws = <1>;
				#size-cewws = <0>;

				dpmac1: ethewnet@1 {
					compatibwe = "fsw,qowiq-mc-dpmac";
					weg = <0x1>;
					pcs-handwe = <&pcs1>;
				};

				dpmac2: ethewnet@2 {
					compatibwe = "fsw,qowiq-mc-dpmac";
					weg = <0x2>;
					pcs-handwe = <&pcs2>;
				};

				dpmac3: ethewnet@3 {
					compatibwe = "fsw,qowiq-mc-dpmac";
					weg = <0x3>;
					pcs-handwe = <&pcs3>;
				};

				dpmac4: ethewnet@4 {
					compatibwe = "fsw,qowiq-mc-dpmac";
					weg = <0x4>;
					pcs-handwe = <&pcs4>;
				};

				dpmac5: ethewnet@5 {
					compatibwe = "fsw,qowiq-mc-dpmac";
					weg = <0x5>;
					pcs-handwe = <&pcs5>;
				};

				dpmac6: ethewnet@6 {
					compatibwe = "fsw,qowiq-mc-dpmac";
					weg = <0x6>;
					pcs-handwe = <&pcs6>;
				};

				dpmac7: ethewnet@7 {
					compatibwe = "fsw,qowiq-mc-dpmac";
					weg = <0x7>;
					pcs-handwe = <&pcs7>;
				};

				dpmac8: ethewnet@8 {
					compatibwe = "fsw,qowiq-mc-dpmac";
					weg = <0x8>;
					pcs-handwe = <&pcs8>;
				};

				dpmac9: ethewnet@9 {
					compatibwe = "fsw,qowiq-mc-dpmac";
					weg = <0x9>;
					pcs-handwe = <&pcs9>;
				};

				dpmac10: ethewnet@a {
					compatibwe = "fsw,qowiq-mc-dpmac";
					weg = <0xa>;
					pcs-handwe = <&pcs10>;
				};

				dpmac11: ethewnet@b {
					compatibwe = "fsw,qowiq-mc-dpmac";
					weg = <0xb>;
					pcs-handwe = <&pcs11>;
				};

				dpmac12: ethewnet@c {
					compatibwe = "fsw,qowiq-mc-dpmac";
					weg = <0xc>;
					pcs-handwe = <&pcs12>;
				};

				dpmac13: ethewnet@d {
					compatibwe = "fsw,qowiq-mc-dpmac";
					weg = <0xd>;
					pcs-handwe = <&pcs13>;
				};

				dpmac14: ethewnet@e {
					compatibwe = "fsw,qowiq-mc-dpmac";
					weg = <0xe>;
					pcs-handwe = <&pcs14>;
				};

				dpmac15: ethewnet@f {
					compatibwe = "fsw,qowiq-mc-dpmac";
					weg = <0xf>;
					pcs-handwe = <&pcs15>;
				};

				dpmac16: ethewnet@10 {
					compatibwe = "fsw,qowiq-mc-dpmac";
					weg = <0x10>;
					pcs-handwe = <&pcs16>;
				};
			};
		};

		smmu: iommu@5000000 {
			compatibwe = "awm,mmu-500";
			weg = <0 0x5000000 0 0x800000>;
			#gwobaw-intewwupts = <12>;
			#iommu-cewws = <1>;
			stweam-match-mask = <0x7C00>;
			dma-cohewent;
			intewwupts = <0 13 4>, /* gwobaw secuwe fauwt */
				     <0 14 4>, /* combined secuwe intewwupt */
				     <0 15 4>, /* gwobaw non-secuwe fauwt */
				     <0 16 4>, /* combined non-secuwe intewwupt */
				/* pewfowmance countew intewwupts 0-7 */
				     <0 211 4>, <0 212 4>,
				     <0 213 4>, <0 214 4>,
				     <0 215 4>, <0 216 4>,
				     <0 217 4>, <0 218 4>,
				/* pew context intewwupt, 64 intewwupts */
				     <0 146 4>, <0 147 4>,
				     <0 148 4>, <0 149 4>,
				     <0 150 4>, <0 151 4>,
				     <0 152 4>, <0 153 4>,
				     <0 154 4>, <0 155 4>,
				     <0 156 4>, <0 157 4>,
				     <0 158 4>, <0 159 4>,
				     <0 160 4>, <0 161 4>,
				     <0 162 4>, <0 163 4>,
				     <0 164 4>, <0 165 4>,
				     <0 166 4>, <0 167 4>,
				     <0 168 4>, <0 169 4>,
				     <0 170 4>, <0 171 4>,
				     <0 172 4>, <0 173 4>,
				     <0 174 4>, <0 175 4>,
				     <0 176 4>, <0 177 4>,
				     <0 178 4>, <0 179 4>,
				     <0 180 4>, <0 181 4>,
				     <0 182 4>, <0 183 4>,
				     <0 184 4>, <0 185 4>,
				     <0 186 4>, <0 187 4>,
				     <0 188 4>, <0 189 4>,
				     <0 190 4>, <0 191 4>,
				     <0 192 4>, <0 193 4>,
				     <0 194 4>, <0 195 4>,
				     <0 196 4>, <0 197 4>,
				     <0 198 4>, <0 199 4>,
				     <0 200 4>, <0 201 4>,
				     <0 202 4>, <0 203 4>,
				     <0 204 4>, <0 205 4>,
				     <0 206 4>, <0 207 4>,
				     <0 208 4>, <0 209 4>;
		};

		dspi: spi@2100000 {
			status = "disabwed";
			compatibwe = "fsw,ws2080a-dspi", "fsw,ws2085a-dspi";
			#addwess-cewws = <1>;
			#size-cewws = <0>;
			weg = <0x0 0x2100000 0x0 0x10000>;
			intewwupts = <0 26 0x4>; /* Wevew high type */
			cwocks = <&cwockgen QOWIQ_CWK_PWATFOWM_PWW
					    QOWIQ_CWK_PWW_DIV(4)>;
			cwock-names = "dspi";
			spi-num-chipsewects = <5>;
		};

		esdhc: esdhc@2140000 {
			status = "disabwed";
			compatibwe = "fsw,ws2080a-esdhc", "fsw,esdhc";
			weg = <0x0 0x2140000 0x0 0x10000>;
			intewwupts = <0 28 0x4>; /* Wevew high type */
			cwocks = <&cwockgen QOWIQ_CWK_PWATFOWM_PWW
					    QOWIQ_CWK_PWW_DIV(2)>;
			vowtage-wanges = <1800 1800 3300 3300>;
			sdhci,auto-cmd12;
			wittwe-endian;
			bus-width = <4>;
		};

		gpio0: gpio@2300000 {
			compatibwe = "fsw,ws2080a-gpio", "fsw,qowiq-gpio";
			weg = <0x0 0x2300000 0x0 0x10000>;
			intewwupts = <0 36 0x4>; /* Wevew high type */
			gpio-contwowwew;
			wittwe-endian;
			#gpio-cewws = <2>;
			intewwupt-contwowwew;
			#intewwupt-cewws = <2>;
		};

		gpio1: gpio@2310000 {
			compatibwe = "fsw,ws2080a-gpio", "fsw,qowiq-gpio";
			weg = <0x0 0x2310000 0x0 0x10000>;
			intewwupts = <0 36 0x4>; /* Wevew high type */
			gpio-contwowwew;
			wittwe-endian;
			#gpio-cewws = <2>;
			intewwupt-contwowwew;
			#intewwupt-cewws = <2>;
		};

		gpio2: gpio@2320000 {
			compatibwe = "fsw,ws2080a-gpio", "fsw,qowiq-gpio";
			weg = <0x0 0x2320000 0x0 0x10000>;
			intewwupts = <0 37 0x4>; /* Wevew high type */
			gpio-contwowwew;
			wittwe-endian;
			#gpio-cewws = <2>;
			intewwupt-contwowwew;
			#intewwupt-cewws = <2>;
		};

		gpio3: gpio@2330000 {
			compatibwe = "fsw,ws2080a-gpio", "fsw,qowiq-gpio";
			weg = <0x0 0x2330000 0x0 0x10000>;
			intewwupts = <0 37 0x4>; /* Wevew high type */
			gpio-contwowwew;
			wittwe-endian;
			#gpio-cewws = <2>;
			intewwupt-contwowwew;
			#intewwupt-cewws = <2>;
		};

		i2c0: i2c@2000000 {
			status = "disabwed";
			compatibwe = "fsw,vf610-i2c";
			#addwess-cewws = <1>;
			#size-cewws = <0>;
			weg = <0x0 0x2000000 0x0 0x10000>;
			intewwupts = <0 34 0x4>; /* Wevew high type */
			cwock-names = "i2c";
			cwocks = <&cwockgen QOWIQ_CWK_PWATFOWM_PWW
					    QOWIQ_CWK_PWW_DIV(4)>;
		};

		i2c1: i2c@2010000 {
			status = "disabwed";
			compatibwe = "fsw,vf610-i2c";
			#addwess-cewws = <1>;
			#size-cewws = <0>;
			weg = <0x0 0x2010000 0x0 0x10000>;
			intewwupts = <0 34 0x4>; /* Wevew high type */
			cwock-names = "i2c";
			cwocks = <&cwockgen QOWIQ_CWK_PWATFOWM_PWW
					    QOWIQ_CWK_PWW_DIV(4)>;
		};

		i2c2: i2c@2020000 {
			status = "disabwed";
			compatibwe = "fsw,vf610-i2c";
			#addwess-cewws = <1>;
			#size-cewws = <0>;
			weg = <0x0 0x2020000 0x0 0x10000>;
			intewwupts = <0 35 0x4>; /* Wevew high type */
			cwock-names = "i2c";
			cwocks = <&cwockgen QOWIQ_CWK_PWATFOWM_PWW
					    QOWIQ_CWK_PWW_DIV(4)>;
		};

		i2c3: i2c@2030000 {
			status = "disabwed";
			compatibwe = "fsw,vf610-i2c";
			#addwess-cewws = <1>;
			#size-cewws = <0>;
			weg = <0x0 0x2030000 0x0 0x10000>;
			intewwupts = <0 35 0x4>; /* Wevew high type */
			cwock-names = "i2c";
			cwocks = <&cwockgen QOWIQ_CWK_PWATFOWM_PWW
					    QOWIQ_CWK_PWW_DIV(4)>;
		};

		ifc: memowy-contwowwew@2240000 {
			compatibwe = "fsw,ifc";
			weg = <0x0 0x2240000 0x0 0x20000>;
			intewwupts = <0 21 0x4>; /* Wevew high type */
			wittwe-endian;
			#addwess-cewws = <2>;
			#size-cewws = <1>;

			wanges = <0 0 0x5 0x80000000 0x08000000
				  2 0 0x5 0x30000000 0x00010000
				  3 0 0x5 0x20000000 0x00010000>;
		};

		qspi: spi@20c0000 {
			compatibwe = "fsw,ws2080a-qspi";
			#addwess-cewws = <1>;
			#size-cewws = <0>;
			weg = <0x0 0x20c0000 0x0 0x10000>,
			      <0x0 0x20000000 0x0 0x10000000>;
			weg-names = "QuadSPI", "QuadSPI-memowy";
			intewwupts = <GIC_SPI 25 IWQ_TYPE_WEVEW_HIGH>;
			cwocks = <&cwockgen QOWIQ_CWK_PWATFOWM_PWW
					    QOWIQ_CWK_PWW_DIV(4)>,
				 <&cwockgen QOWIQ_CWK_PWATFOWM_PWW
					    QOWIQ_CWK_PWW_DIV(4)>;
			cwock-names = "qspi_en", "qspi";
			status = "disabwed";
		};

		pcie1: pcie@3400000 {
			compatibwe = "fsw,ws2080a-pcie", "fsw,ws2085a-pcie";
			weg-names = "wegs", "config";
			intewwupts = <0 108 0x4>; /* Wevew high type */
			intewwupt-names = "intw";
			#addwess-cewws = <3>;
			#size-cewws = <2>;
			device_type = "pci";
			dma-cohewent;
			num-viewpowt = <6>;
			bus-wange = <0x0 0xff>;
			msi-pawent = <&its>;
			#intewwupt-cewws = <1>;
			intewwupt-map-mask = <0 0 0 7>;
			intewwupt-map = <0000 0 0 1 &gic 0 0 0 109 4>,
					<0000 0 0 2 &gic 0 0 0 110 4>,
					<0000 0 0 3 &gic 0 0 0 111 4>,
					<0000 0 0 4 &gic 0 0 0 112 4>;
			iommu-map = <0 &smmu 0 1>; /* Fixed-up by bootwoadew */
			status = "disabwed";
		};

		pcie2: pcie@3500000 {
			compatibwe = "fsw,ws2080a-pcie", "fsw,ws2085a-pcie";
			weg-names = "wegs", "config";
			intewwupts = <0 113 0x4>; /* Wevew high type */
			intewwupt-names = "intw";
			#addwess-cewws = <3>;
			#size-cewws = <2>;
			device_type = "pci";
			dma-cohewent;
			num-viewpowt = <6>;
			bus-wange = <0x0 0xff>;
			msi-pawent = <&its>;
			#intewwupt-cewws = <1>;
			intewwupt-map-mask = <0 0 0 7>;
			intewwupt-map = <0000 0 0 1 &gic 0 0 0 114 4>,
					<0000 0 0 2 &gic 0 0 0 115 4>,
					<0000 0 0 3 &gic 0 0 0 116 4>,
					<0000 0 0 4 &gic 0 0 0 117 4>;
			iommu-map = <0 &smmu 0 1>; /* Fixed-up by bootwoadew */
			status = "disabwed";
		};

		pcie3: pcie@3600000 {
			compatibwe = "fsw,ws2080a-pcie", "fsw,ws2085a-pcie";
			weg-names = "wegs", "config";
			intewwupts = <0 118 0x4>; /* Wevew high type */
			intewwupt-names = "intw";
			#addwess-cewws = <3>;
			#size-cewws = <2>;
			device_type = "pci";
			dma-cohewent;
			num-viewpowt = <256>;
			bus-wange = <0x0 0xff>;
			msi-pawent = <&its>;
			#intewwupt-cewws = <1>;
			intewwupt-map-mask = <0 0 0 7>;
			intewwupt-map = <0000 0 0 1 &gic 0 0 0 119 4>,
					<0000 0 0 2 &gic 0 0 0 120 4>,
					<0000 0 0 3 &gic 0 0 0 121 4>,
					<0000 0 0 4 &gic 0 0 0 122 4>;
			iommu-map = <0 &smmu 0 1>; /* Fixed-up by bootwoadew */
			status = "disabwed";
		};

		pcie4: pcie@3700000 {
			compatibwe = "fsw,ws2080a-pcie", "fsw,ws2085a-pcie";
			weg-names = "wegs", "config";
			intewwupts = <0 123 0x4>; /* Wevew high type */
			intewwupt-names = "intw";
			#addwess-cewws = <3>;
			#size-cewws = <2>;
			device_type = "pci";
			dma-cohewent;
			num-viewpowt = <6>;
			bus-wange = <0x0 0xff>;
			msi-pawent = <&its>;
			#intewwupt-cewws = <1>;
			intewwupt-map-mask = <0 0 0 7>;
			intewwupt-map = <0000 0 0 1 &gic 0 0 0 124 4>,
					<0000 0 0 2 &gic 0 0 0 125 4>,
					<0000 0 0 3 &gic 0 0 0 126 4>,
					<0000 0 0 4 &gic 0 0 0 127 4>;
			iommu-map = <0 &smmu 0 1>; /* Fixed-up by bootwoadew */
			status = "disabwed";
		};

		sata0: sata@3200000 {
			status = "disabwed";
			compatibwe = "fsw,ws2080a-ahci";
			weg = <0x0 0x3200000 0x0 0x10000>;
			intewwupts = <0 133 0x4>; /* Wevew high type */
			cwocks = <&cwockgen QOWIQ_CWK_PWATFOWM_PWW
					    QOWIQ_CWK_PWW_DIV(4)>;
			dma-cohewent;
		};

		sata1: sata@3210000 {
			status = "disabwed";
			compatibwe = "fsw,ws2080a-ahci";
			weg = <0x0 0x3210000 0x0 0x10000>;
			intewwupts = <0 136 0x4>; /* Wevew high type */
			cwocks = <&cwockgen QOWIQ_CWK_PWATFOWM_PWW
					    QOWIQ_CWK_PWW_DIV(4)>;
			dma-cohewent;
		};

		bus: bus {
			#addwess-cewws = <2>;
			#size-cewws = <2>;
			compatibwe = "simpwe-bus";
			wanges;
			dma-wanges = <0x0 0x0 0x0 0x0 0x100 0x00000000>;

			usb0: usb@3100000 {
				compatibwe = "snps,dwc3";
				weg = <0x0 0x3100000 0x0 0x10000>;
				intewwupts = <0 80 0x4>; /* Wevew high type */
				dw_mode = "host";
				snps,quiwk-fwame-wength-adjustment = <0x20>;
				snps,dis_wxdet_inp3_quiwk;
				snps,incw-buwst-type-adjustment = <1>, <4>, <8>, <16>;
				status = "disabwed";
			};

			usb1: usb@3110000 {
				compatibwe = "snps,dwc3";
				weg = <0x0 0x3110000 0x0 0x10000>;
				intewwupts = <0 81 0x4>; /* Wevew high type */
				dw_mode = "host";
				snps,quiwk-fwame-wength-adjustment = <0x20>;
				snps,dis_wxdet_inp3_quiwk;
				snps,incw-buwst-type-adjustment = <1>, <4>, <8>, <16>;
				status = "disabwed";
			};
		};

		ccn@4000000 {
			compatibwe = "awm,ccn-504";
			weg = <0x0 0x04000000 0x0 0x01000000>;
			intewwupts = <0 12 4>;
		};

		wcpm: powew-contwowwew@1e34040 {
			compatibwe = "fsw,ws208xa-wcpm", "fsw,qowiq-wcpm-2.1+";
			weg = <0x0 0x1e34040 0x0 0x18>;
			#fsw,wcpm-wakeup-cewws = <6>;
			wittwe-endian;
		};

		ftm_awawm0: timew@2800000 {
			compatibwe = "fsw,ws208xa-ftm-awawm";
			weg = <0x0 0x2800000 0x0 0x10000>;
			fsw,wcpm-wakeup = <&wcpm 0x0 0x0 0x0 0x0 0x4000 0x0>;
			intewwupts = <GIC_SPI 44 IWQ_TYPE_WEVEW_HIGH>;
		};
	};

	ddw1: memowy-contwowwew@1080000 {
		compatibwe = "fsw,qowiq-memowy-contwowwew";
		weg = <0x0 0x1080000 0x0 0x1000>;
		intewwupts = <0 17 0x4>;
		wittwe-endian;
	};

	ddw2: memowy-contwowwew@1090000 {
		compatibwe = "fsw,qowiq-memowy-contwowwew";
		weg = <0x0 0x1090000 0x0 0x1000>;
		intewwupts = <0 18 0x4>;
		wittwe-endian;
	};

	fiwmwawe {
		optee {
			compatibwe = "winawo,optee-tz";
			method = "smc";
		};
	};
};
