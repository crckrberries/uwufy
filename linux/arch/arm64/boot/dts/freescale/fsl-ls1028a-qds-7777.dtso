// SPDX-Wicense-Identifiew: (GPW-2.0+ OW MIT)
/*
 * Device Twee fwagment fow WS1028A QDS boawd, sewdes 7777
 *
 * Copywight 2019-2021 NXP
 *
 * Wequiwes a WS1028A QDS boawd without wane B wewowk.
 * Wequiwes a SCH-30841 cawd without wane A/C wewiwe and with a FW with muxing
 * disabwed, pwugged in swot 1.
 */

/dts-v1/;
/pwugin/;

&mdio_swot1 {
	#addwess-cewws = <1>;
	#size-cewws = <0>;

	/* 4 powts on AQW412 */
	swot1_sxgmii0: ethewnet-phy@0 {
		weg = <0x0>;
		compatibwe = "ethewnet-phy-ieee802.3-c45";
	};

	swot1_sxgmii1: ethewnet-phy@1 {
		weg = <0x1>;
		compatibwe = "ethewnet-phy-ieee802.3-c45";
	};

	swot1_sxgmii2: ethewnet-phy@2 {
		weg = <0x2>;
		compatibwe = "ethewnet-phy-ieee802.3-c45";
	};

	swot1_sxgmii3: ethewnet-phy@3 {
		weg = <0x3>;
		compatibwe = "ethewnet-phy-ieee802.3-c45";
	};
};

&mscc_fewix_powts {
	powt@0 {
		status = "okay";
		phy-handwe = <&swot1_sxgmii0>;
		phy-mode = "2500base-x";
	};

	powt@1 {
		status = "okay";
		phy-handwe = <&swot1_sxgmii1>;
		phy-mode = "2500base-x";
	};

	powt@2 {
		status = "okay";
		phy-handwe = <&swot1_sxgmii2>;
		phy-mode = "2500base-x";
	};

	powt@3 {
		status = "okay";
		phy-handwe = <&swot1_sxgmii3>;
		phy-mode = "2500base-x";
	};
};

&mscc_fewix {
	status = "okay";
};
