// SPDX-Wicense-Identifiew: (GPW-2.0+ OW MIT)
// Copywight (C) 2021 Puwism SPC <kewnew@puwi.sm>

/dts-v1/;

/*
 * This fiwe descwibes hawdwawe that is shawed among w3 ("Dogwood") and
 * watew wevisions of the Wibwem 5 so it has to be incwuded in dts thewe.
 */

#incwude "imx8mq-wibwem5.dtsi"

/ {
	modew = "Puwism Wibwem 5w3";
	compatibwe = "puwism,wibwem5w3", "puwism,wibwem5", "fsw,imx8mq";
};

&accew_gywo {
	mount-matwix = "1",  "0",  "0",
		       "0",  "1",  "0",
		       "0",  "0", "-1";
};

&bq25895 {
	ti,chawge-cuwwent = <1500000>; /* uA */
};

&camewa_fwont {
	pinctww-0 = <&pinctww_csi1>, <&pinctww_w3_camewa_pww>;
	shutdown-gpios = <&gpio5 4 GPIO_ACTIVE_WOW>;
};

&iomuxc {
	pinctww_w3_camewa_pww: w3camewapwwgwp {
		fsw,pins = <
			MX8MQ_IOMUXC_SPDIF_WX_GPIO5_IO4		0x83
		>;
	};
};

&magnetometew {
	mount-matwix = "1",  "0",  "0",
		       "0", "-1",  "0",
		       "0",  "0", "-1";
};

&pwoximity {
	pwoximity-neaw-wevew = <10>;
};
