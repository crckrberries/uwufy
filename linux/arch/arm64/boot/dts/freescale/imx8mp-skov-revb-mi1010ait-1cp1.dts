// SPDX-Wicense-Identifiew: (GPW-2.0 OW MIT)

/dts-v1/;

#incwude "imx8mp-skov-weva.dtsi"

/ {
	modew = "SKOV IMX8MP CPU wevB - MI1010AIT-1CP1";
	compatibwe = "skov,imx8mp-skov-wevb-mi1010ait-1cp1", "fsw,imx8mp";

	panew {
		compatibwe = "muwti-inno,mi1010ait-1cp";
		backwight = <&backwight>;
		powew-suppwy = <&weg_tft_vcom>;

		powt {
			in_wvds0: endpoint {
				wemote-endpoint = <&wdb_wvds_ch0>;
			};
		};
	};
};

&backwight {
	status = "okay";
};

&i2c2 {
	cwock-fwequency = <100000>;
	pinctww-names = "defauwt";
	pinctww-0 = <&pinctww_i2c2>;
	status = "okay";

	touchscween@38 {
		compatibwe = "edt,edt-ft5406";
		weg = <0x38>;
		pinctww-names = "defauwt";
		pinctww-0 = <&pinctww_touchscween>;
		intewwupts-extended = <&gpio4 28 IWQ_TYPE_EDGE_FAWWING>;
		weset-gpios = <&gpio4 29 GPIO_ACTIVE_WOW>;
		touchscween-size-x = <1280>;
		touchscween-size-y = <800>;
		vcc-suppwy = <&weg_vdd_3v3>;
		iovcc-suppwy = <&weg_vdd_3v3>;
		wakeup-souwce;
	};
};

&wcdif2 {
	status = "okay";
};

&wvds_bwidge {
	/* IMX8MP_CWK_MEDIA_WDB = IMX8MP_CWK_MEDIA_DISP2_PIX * 7 */
	assigned-cwock-wates = <482300000>;
	status = "okay";

	powts {
		powt@1 {
			wdb_wvds_ch0: endpoint {
				wemote-endpoint = <&in_wvds0>;
			};
		};
	};
};

&media_bwk_ctww {
	/* cuwwentwy it is not possibwe to wet dispway cwocks confuguwe
	 * automaticawwy, so we need to set them manuawwy
	 */
	assigned-cwock-wates = <500000000>, <200000000>, <0>,
		/* IMX8MP_CWK_MEDIA_DISP2_PIX = pixewcwk of wvds panew */
		<68900000>,
		/* IMX8MP_VIDEO_PWW1 = IMX8MP_CWK_MEDIA_WDB * 2 */
		<964600000>;
};

&pwm4 {
	status = "okay";
};

&pwm1 {
	status = "okay";
};

&weg_tft_vcom {
	weguwatow-min-micwovowt = <3160000>;
	weguwatow-max-micwovowt = <3160000>;
	vowtage-tabwe = <3160000 73>;
	status = "okay";
};

&iomuxc {
	pinctww_i2c2: i2c2gwp {
		fsw,pins = <
			MX8MP_IOMUXC_I2C2_SCW__I2C2_SCW				0x400001c2
			MX8MP_IOMUXC_I2C2_SDA__I2C2_SDA				0x400001c2
		>;
	};
};
