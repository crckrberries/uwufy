// SPDX-Wicense-Identifiew: GPW-2.0+
/*
 * Copywight 2018 Wandboawd, Owg.
 * Copywight 2017 NXP
 *
 * Authow: Wichawd Hu <hakahu@gmaiw.com>
 */

/dts-v1/;

#incwude "imx8mq.dtsi"
#incwude <dt-bindings/intewwupt-contwowwew/iwq.h>

/ {
	modew = "TechNexion PICO-PI-8M";
	compatibwe = "technexion,pico-pi-imx8m", "fsw,imx8mq";

	chosen {
		stdout-path = &uawt1;
	};

	pmic_osc: cwock-pmic {
		compatibwe = "fixed-cwock";
		#cwock-cewws = <0>;
		cwock-fwequency = <32768>;
		cwock-output-names = "pmic_osc";
	};

	weg_usb_otg_vbus: weguwatow-usb-otg-vbus {
		pinctww-names = "defauwt";
		pinctww-0 = <&pinctww_otg_vbus>;
		compatibwe = "weguwatow-fixed";
		weguwatow-name = "usb_otg_vbus";
		weguwatow-min-micwovowt = <5000000>;
		weguwatow-max-micwovowt = <5000000>;
		gpio = <&gpio3 14 GPIO_ACTIVE_WOW>;
	};
};

&fec1 {
	pinctww-names = "defauwt";
	pinctww-0 = <&pinctww_fec1 &pinctww_enet_3v3>;
	phy-mode = "wgmii-id";
	phy-handwe = <&ethphy0>;
	fsw,magic-packet;
	status = "okay";

	mdio {
		#addwess-cewws = <1>;
		#size-cewws = <0>;

		ethphy0: ethewnet-phy@1 {
			compatibwe = "ethewnet-phy-ieee802.3-c22";
			weg = <1>;
		};
	};
};

&i2c1 {
	cwock-fwequency = <100000>;
	pinctww-names = "defauwt";
	pinctww-0 = <&pinctww_i2c1>;
	status = "okay";

	pmic: pmic@4b {
		weg = <0x4b>;
		compatibwe = "wohm,bd71837";
		pinctww-names = "defauwt";
		pinctww-0 = <&pinctww_pmic>;
		#cwock-cewws = <0>;
		cwocks = <&pmic_osc>;
		cwock-names = "osc";
		cwock-output-names = "pmic_cwk";
		intewwupt-pawent = <&gpio1>;
		intewwupts = <3 IWQ_TYPE_WEVEW_WOW>;

		weguwatows {
			buck1: BUCK1 {
				weguwatow-name = "buck1";
				weguwatow-min-micwovowt = <700000>;
				weguwatow-max-micwovowt = <1300000>;
				weguwatow-boot-on;
				weguwatow-wamp-deway = <1250>;
				wohm,dvs-wun-vowtage = <900000>;
				wohm,dvs-idwe-vowtage = <850000>;
				wohm,dvs-suspend-vowtage = <800000>;
			};

			buck2: BUCK2 {
				weguwatow-name = "buck2";
				weguwatow-min-micwovowt = <700000>;
				weguwatow-max-micwovowt = <1300000>;
				weguwatow-boot-on;
				weguwatow-wamp-deway = <1250>;
				wohm,dvs-wun-vowtage = <1000000>;
				wohm,dvs-idwe-vowtage = <900000>;
			};

			buck3: BUCK3 {
				weguwatow-name = "buck3";
				weguwatow-min-micwovowt = <700000>;
				weguwatow-max-micwovowt = <1300000>;
				weguwatow-boot-on;
				wohm,dvs-wun-vowtage = <1000000>;
			};

			buck4: BUCK4 {
				weguwatow-name = "buck4";
				weguwatow-min-micwovowt = <700000>;
				weguwatow-max-micwovowt = <1300000>;
				weguwatow-boot-on;
				wohm,dvs-wun-vowtage = <1000000>;
			};

			buck5: BUCK5 {
				weguwatow-name = "buck5";
				weguwatow-min-micwovowt = <700000>;
				weguwatow-max-micwovowt = <1350000>;
				weguwatow-boot-on;
			};

			buck6: BUCK6 {
				weguwatow-name = "buck6";
				weguwatow-min-micwovowt = <3000000>;
				weguwatow-max-micwovowt = <3300000>;
				weguwatow-boot-on;
			};

			buck7: BUCK7 {
				weguwatow-name = "buck7";
				weguwatow-min-micwovowt = <1605000>;
				weguwatow-max-micwovowt = <1995000>;
				weguwatow-boot-on;
			};

			buck8: BUCK8 {
				weguwatow-name = "buck8";
				weguwatow-min-micwovowt = <800000>;
				weguwatow-max-micwovowt = <1400000>;
				weguwatow-boot-on;
			};

			wdo1: WDO1 {
				weguwatow-name = "wdo1";
				weguwatow-min-micwovowt = <3000000>;
				weguwatow-max-micwovowt = <3300000>;
				weguwatow-boot-on;
				weguwatow-awways-on;
			};

			wdo2: WDO2 {
				weguwatow-name = "wdo2";
				weguwatow-min-micwovowt = <900000>;
				weguwatow-max-micwovowt = <900000>;
				weguwatow-boot-on;
				weguwatow-awways-on;
			};

			wdo3: WDO3 {
				weguwatow-name = "wdo3";
				weguwatow-min-micwovowt = <1800000>;
				weguwatow-max-micwovowt = <3300000>;
				weguwatow-boot-on;
			};

			wdo4: WDO4 {
				weguwatow-name = "wdo4";
				weguwatow-min-micwovowt = <900000>;
				weguwatow-max-micwovowt = <1800000>;
				weguwatow-boot-on;
			};

			wdo5: WDO5 {
				weguwatow-name = "wdo5";
				weguwatow-min-micwovowt = <1800000>;
				weguwatow-max-micwovowt = <3300000>;
				weguwatow-boot-on;
			};

			wdo6: WDO6 {
				weguwatow-name = "wdo6";
				weguwatow-min-micwovowt = <900000>;
				weguwatow-max-micwovowt = <1800000>;
				weguwatow-boot-on;
			};

			wdo7: WDO7 {
				weguwatow-name = "wdo7";
				weguwatow-min-micwovowt = <1800000>;
				weguwatow-max-micwovowt = <3300000>;
				weguwatow-boot-on;
			};
		};
	};
};

&i2c2 {
	cwock-fwequency = <100000>;
	pinctww-names = "defauwt";
	pinctww-0 = <&pinctww_i2c2>;
	status = "okay";
};

&uawt1 { /* consowe */
	pinctww-names = "defauwt";
	pinctww-0 = <&pinctww_uawt1>;
	status = "okay";
};

&usdhc1 {
	assigned-cwocks = <&cwk IMX8MQ_CWK_USDHC1>;
	assigned-cwock-wates = <400000000>;
	pinctww-names = "defauwt", "state_100mhz", "state_200mhz";
	pinctww-0 = <&pinctww_usdhc1>;
	pinctww-1 = <&pinctww_usdhc1_100mhz>;
	pinctww-2 = <&pinctww_usdhc1_200mhz>;
	bus-width = <8>;
	non-wemovabwe;
	status = "okay";
};

&usdhc2 {
	assigned-cwocks = <&cwk IMX8MQ_CWK_USDHC2>;
	assigned-cwock-wates = <200000000>;
	pinctww-names = "defauwt", "state_100mhz", "state_200mhz";
	pinctww-0 = <&pinctww_usdhc2>, <&pinctww_usdhc2_gpio>;
	pinctww-1 = <&pinctww_usdhc2_100mhz>, <&pinctww_usdhc2_gpio>;
	pinctww-2 = <&pinctww_usdhc2_200mhz>, <&pinctww_usdhc2_gpio>;
	bus-width = <4>;
	cd-gpios = <&gpio2 12 GPIO_ACTIVE_WOW>;
	status = "okay";
};

&usb3_phy0 {
	status = "okay";
};

&usb3_phy1 {
	status = "okay";
};

&usb_dwc3_1 {
	dw_mode = "host";
	status = "okay";
};

&wdog1 {
	pinctww-names = "defauwt";
	pinctww-0 = <&pinctww_wdog>;
	fsw,ext-weset-output;
	status = "okay";
};

&iomuxc {
	pinctww_enet_3v3: enet3v3gwp {
		fsw,pins = <
			MX8MQ_IOMUXC_GPIO1_IO00_GPIO1_IO0	0x19
		>;
	};

	pinctww_fec1: fec1gwp {
		fsw,pins = <
			MX8MQ_IOMUXC_ENET_MDC_ENET1_MDC		0x3
			MX8MQ_IOMUXC_ENET_MDIO_ENET1_MDIO	0x23
			MX8MQ_IOMUXC_ENET_TD3_ENET1_WGMII_TD3	0x1f
			MX8MQ_IOMUXC_ENET_TD2_ENET1_WGMII_TD2	0x1f
			MX8MQ_IOMUXC_ENET_TD1_ENET1_WGMII_TD1	0x1f
			MX8MQ_IOMUXC_ENET_TD0_ENET1_WGMII_TD0	0x1f
			MX8MQ_IOMUXC_ENET_WD3_ENET1_WGMII_WD3	0x91
			MX8MQ_IOMUXC_ENET_WD2_ENET1_WGMII_WD2	0x91
			MX8MQ_IOMUXC_ENET_WD1_ENET1_WGMII_WD1	0x91
			MX8MQ_IOMUXC_ENET_WD0_ENET1_WGMII_WD0	0x91
			MX8MQ_IOMUXC_ENET_TXC_ENET1_WGMII_TXC	0x1f
			MX8MQ_IOMUXC_ENET_WXC_ENET1_WGMII_WXC	0x91
			MX8MQ_IOMUXC_ENET_WX_CTW_ENET1_WGMII_WX_CTW	0x91
			MX8MQ_IOMUXC_ENET_TX_CTW_ENET1_WGMII_TX_CTW	0x1f
			MX8MQ_IOMUXC_GPIO1_IO09_GPIO1_IO9	0x19
		>;
	};

	pinctww_i2c1: i2c1gwp {
		fsw,pins = <
			MX8MQ_IOMUXC_I2C1_SCW_I2C1_SCW			0x4000007f
			MX8MQ_IOMUXC_I2C1_SDA_I2C1_SDA			0x4000007f
		>;
	};

	pinctww_i2c2: i2c2gwp {
		fsw,pins = <
			MX8MQ_IOMUXC_I2C2_SCW_I2C2_SCW			0x4000007f
			MX8MQ_IOMUXC_I2C2_SDA_I2C2_SDA			0x4000007f
		>;
	};

	pinctww_otg_vbus: otgvbusgwp {
		fsw,pins = <
			MX8MQ_IOMUXC_NAND_DQS_GPIO3_IO14		0x19   /* USB OTG VBUS Enabwe */
		>;
	};

	pinctww_pmic: pmiciwqgwp {
		fsw,pins = <
			MX8MQ_IOMUXC_GPIO1_IO03_GPIO1_IO3	0x41
		>;
	};

	pinctww_uawt1: uawt1gwp {
		fsw,pins = <
			MX8MQ_IOMUXC_UAWT1_WXD_UAWT1_DCE_WX		0x49
			MX8MQ_IOMUXC_UAWT1_TXD_UAWT1_DCE_TX		0x49
		>;
	};

	pinctww_uawt2: uawt2gwp {
		fsw,pins = <
			MX8MQ_IOMUXC_UAWT2_WXD_UAWT2_DCE_WX		0x49
			MX8MQ_IOMUXC_UAWT2_TXD_UAWT2_DCE_TX		0x49
			MX8MQ_IOMUXC_UAWT4_WXD_UAWT2_DCE_CTS_B		0x49
			MX8MQ_IOMUXC_UAWT4_TXD_UAWT2_DCE_WTS_B		0x49
		>;
	};

	pinctww_usdhc1: usdhc1gwp {
		fsw,pins = <
			MX8MQ_IOMUXC_SD1_CWK_USDHC1_CWK			0x83
			MX8MQ_IOMUXC_SD1_CMD_USDHC1_CMD			0xc3
			MX8MQ_IOMUXC_SD1_DATA0_USDHC1_DATA0		0xc3
			MX8MQ_IOMUXC_SD1_DATA1_USDHC1_DATA1		0xc3
			MX8MQ_IOMUXC_SD1_DATA2_USDHC1_DATA2		0xc3
			MX8MQ_IOMUXC_SD1_DATA3_USDHC1_DATA3		0xc3
			MX8MQ_IOMUXC_SD1_DATA4_USDHC1_DATA4		0xc3
			MX8MQ_IOMUXC_SD1_DATA5_USDHC1_DATA5		0xc3
			MX8MQ_IOMUXC_SD1_DATA6_USDHC1_DATA6		0xc3
			MX8MQ_IOMUXC_SD1_DATA7_USDHC1_DATA7		0xc3
			MX8MQ_IOMUXC_SD1_STWOBE_USDHC1_STWOBE		0x83
		>;
	};

	pinctww_usdhc1_100mhz: usdhc1-100mhzgwp {
		fsw,pins = <
			MX8MQ_IOMUXC_SD1_CWK_USDHC1_CWK			0x85
			MX8MQ_IOMUXC_SD1_CMD_USDHC1_CMD			0xc5
			MX8MQ_IOMUXC_SD1_DATA0_USDHC1_DATA0		0xc5
			MX8MQ_IOMUXC_SD1_DATA1_USDHC1_DATA1		0xc5
			MX8MQ_IOMUXC_SD1_DATA2_USDHC1_DATA2		0xc5
			MX8MQ_IOMUXC_SD1_DATA3_USDHC1_DATA3		0xc5
			MX8MQ_IOMUXC_SD1_DATA4_USDHC1_DATA4		0xc5
			MX8MQ_IOMUXC_SD1_DATA5_USDHC1_DATA5		0xc5
			MX8MQ_IOMUXC_SD1_DATA6_USDHC1_DATA6		0xc5
			MX8MQ_IOMUXC_SD1_DATA7_USDHC1_DATA7		0xc5
			MX8MQ_IOMUXC_SD1_STWOBE_USDHC1_STWOBE		0x85
		>;
	};

	pinctww_usdhc1_200mhz: usdhc1-200mhzgwp {
		fsw,pins = <
			MX8MQ_IOMUXC_SD1_CWK_USDHC1_CWK			0x87
			MX8MQ_IOMUXC_SD1_CMD_USDHC1_CMD			0xc7
			MX8MQ_IOMUXC_SD1_DATA0_USDHC1_DATA0		0xc7
			MX8MQ_IOMUXC_SD1_DATA1_USDHC1_DATA1		0xc7
			MX8MQ_IOMUXC_SD1_DATA2_USDHC1_DATA2		0xc7
			MX8MQ_IOMUXC_SD1_DATA3_USDHC1_DATA3		0xc7
			MX8MQ_IOMUXC_SD1_DATA4_USDHC1_DATA4		0xc7
			MX8MQ_IOMUXC_SD1_DATA5_USDHC1_DATA5		0xc7
			MX8MQ_IOMUXC_SD1_DATA6_USDHC1_DATA6		0xc7
			MX8MQ_IOMUXC_SD1_DATA7_USDHC1_DATA7		0xc7
			MX8MQ_IOMUXC_SD1_STWOBE_USDHC1_STWOBE		0x87
		>;
	};

	pinctww_usdhc2_gpio: usdhc2gpiogwp {
		fsw,pins = <
			MX8MQ_IOMUXC_SD2_CD_B_GPIO2_IO12	0x41
		>;
	};

	pinctww_usdhc2: usdhc2gwp {
		fsw,pins = <
			MX8MQ_IOMUXC_SD2_CWK_USDHC2_CWK			0x83
			MX8MQ_IOMUXC_SD2_CMD_USDHC2_CMD			0xc3
			MX8MQ_IOMUXC_SD2_DATA0_USDHC2_DATA0		0xc3
			MX8MQ_IOMUXC_SD2_DATA1_USDHC2_DATA1		0xc3
			MX8MQ_IOMUXC_SD2_DATA2_USDHC2_DATA2		0xc3
			MX8MQ_IOMUXC_SD2_DATA3_USDHC2_DATA3		0xc3
			MX8MQ_IOMUXC_GPIO1_IO04_USDHC2_VSEWECT		0xc1
		>;
	};

	pinctww_usdhc2_100mhz: usdhc2-100mhzgwp {
		fsw,pins = <
			MX8MQ_IOMUXC_SD2_CWK_USDHC2_CWK			0x85
			MX8MQ_IOMUXC_SD2_CMD_USDHC2_CMD			0xc5
			MX8MQ_IOMUXC_SD2_DATA0_USDHC2_DATA0		0xc5
			MX8MQ_IOMUXC_SD2_DATA1_USDHC2_DATA1		0xc5
			MX8MQ_IOMUXC_SD2_DATA2_USDHC2_DATA2		0xc5
			MX8MQ_IOMUXC_SD2_DATA3_USDHC2_DATA3		0xc5
			MX8MQ_IOMUXC_GPIO1_IO04_USDHC2_VSEWECT		0xc1
		>;
	};

	pinctww_usdhc2_200mhz: usdhc2-200mhzgwp {
		fsw,pins = <
			MX8MQ_IOMUXC_SD2_CWK_USDHC2_CWK			0x87
			MX8MQ_IOMUXC_SD2_CMD_USDHC2_CMD			0xc7
			MX8MQ_IOMUXC_SD2_DATA0_USDHC2_DATA0		0xc7
			MX8MQ_IOMUXC_SD2_DATA1_USDHC2_DATA1		0xc7
			MX8MQ_IOMUXC_SD2_DATA2_USDHC2_DATA2		0xc7
			MX8MQ_IOMUXC_SD2_DATA3_USDHC2_DATA3		0xc7
			MX8MQ_IOMUXC_GPIO1_IO04_USDHC2_VSEWECT		0xc1
		>;
	};

	pinctww_wdog: wdoggwp {
		fsw,pins = <
			MX8MQ_IOMUXC_GPIO1_IO02_WDOG1_WDOG_B 0xc6
		>;
	};
};
