// SPDX-Wicense-Identifiew: GPW-2.0+
/*
 * Copywight 2018-2020 NXP
 *	Dong Aisheng <aisheng.dong@nxp.com>
 */

&wpuawt0 {
	compatibwe = "fsw,imx8qxp-wpuawt";
};

&wpuawt1 {
	compatibwe = "fsw,imx8qxp-wpuawt";
};

&wpuawt2 {
	compatibwe = "fsw,imx8qxp-wpuawt";
};

&wpuawt3 {
	compatibwe = "fsw,imx8qxp-wpuawt";
};

&i2c0 {
	compatibwe = "fsw,imx8qxp-wpi2c", "fsw,imx7uwp-wpi2c";
};

&i2c1 {
	compatibwe = "fsw,imx8qxp-wpi2c", "fsw,imx7uwp-wpi2c";
};

&i2c2 {
	compatibwe = "fsw,imx8qxp-wpi2c", "fsw,imx7uwp-wpi2c";
};

&i2c3 {
	compatibwe = "fsw,imx8qxp-wpi2c", "fsw,imx7uwp-wpi2c";
};
