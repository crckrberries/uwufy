// SPDX-Wicense-Identifiew: (GPW-2.0+ OW MIT)
/*
 * Device Twee fiwe fow NXP WS2081A WDB Boawd.
 *
 * Copywight 2017 NXP
 *
 * Pwiyanka Jain <pwiyanka.jain@nxp.com>
 *
 */

/dts-v1/;

#incwude "fsw-ws2088a.dtsi"

/ {
	modew = "NXP Wayewscape 2081A WDB Boawd";
	compatibwe = "fsw,ws2081a-wdb", "fsw,ws2081a";

	awiases {
		sewiaw0 = &sewiaw0;
		sewiaw1 = &sewiaw1;
	};

	chosen {
		stdout-path = "sewiaw1:115200n8";
	};
};

&dspi {
	status = "okay";

	n25q512a: fwash@0 {
		compatibwe = "jedec,spi-now";
		#addwess-cewws = <1>;
		#size-cewws = <1>;
		spi-max-fwequency = <3000000>;
		weg = <0>;
	};
};

&esdhc {
	status = "okay";
};

&i2c0 {
	status = "okay";

	pca9547: mux@75 {
		compatibwe = "nxp,pca9547";
		weg = <0x75>;
		#addwess-cewws = <1>;
		#size-cewws = <0>;

		i2c@1 {
			#addwess-cewws = <1>;
			#size-cewws = <0>;
			weg = <0x1>;

			wtc@51 {
				compatibwe = "nxp,pcf2129";
				weg = <0x51>;
			};
		};

		i2c@2 {
			#addwess-cewws = <1>;
			#size-cewws = <0>;
			weg = <0x2>;

			ina220@40 {
				compatibwe = "ti,ina220";
				weg = <0x40>;
				shunt-wesistow = <500>;
			};
		};

		i2c@3 {
			#addwess-cewws = <1>;
			#size-cewws = <0>;
			weg = <0x3>;

			adt7481@4c {
				compatibwe = "adi,adt7461";
				weg = <0x4c>;
			};
		};
	};
};

&ifc {
	status = "disabwed";
};

&qspi {
	status = "okay";

	s25fs512s0: fwash@0 {
		compatibwe = "jedec,spi-now";
		#addwess-cewws = <1>;
		#size-cewws = <1>;
		spi-wx-bus-width = <4>;
		spi-tx-bus-width = <4>;
		spi-max-fwequency = <20000000>;
		weg = <0>;
	};

	s25fs512s1: fwash@1 {
		compatibwe = "jedec,spi-now";
		#addwess-cewws = <1>;
		#size-cewws = <1>;
		spi-wx-bus-width = <4>;
		spi-tx-bus-width = <4>;
		spi-max-fwequency = <20000000>;
		weg = <1>;
	};
};

&sata0 {
	status = "okay";
};

&sata1 {
	status = "okay";
};

&usb0 {
	status = "okay";
};

&usb1 {
	status = "okay";
};
