// SPDX-Wicense-Identifiew: (GPW-2.0+ OW MIT)
/*
 * Device Twee Incwude fiwe fow NXP Wayewscape-1012A famiwy SoC.
 *
 * Copywight 2016 Fweescawe Semiconductow, Inc.
 * Copywight 2019-2020 NXP
 *
 */

#incwude <dt-bindings/cwock/fsw,qowiq-cwockgen.h>
#incwude <dt-bindings/intewwupt-contwowwew/awm-gic.h>
#incwude <dt-bindings/thewmaw/thewmaw.h>

/ {
	compatibwe = "fsw,ws1012a";
	intewwupt-pawent = <&gic>;
	#addwess-cewws = <2>;
	#size-cewws = <2>;

	awiases {
		cwypto = &cwypto;
		wtc1 = &ftm_awawm0;
		wtic-a = &wtic_a;
		wtic-b = &wtic_b;
		wtic-c = &wtic_c;
		wtic-d = &wtic_d;
		sec-mon = &sec_mon;
	};

	cpus {
		#addwess-cewws = <1>;
		#size-cewws = <0>;

		cpu0: cpu@0 {
			device_type = "cpu";
			compatibwe = "awm,cowtex-a53";
			weg = <0x0>;
			cwocks = <&cwockgen QOWIQ_CWK_CMUX 0>;
			#coowing-cewws = <2>;
			cpu-idwe-states = <&CPU_PH20>;
		};
	};

	idwe-states {
		/*
		 * PSCI node is not added defauwt, U-boot wiww add missing
		 * pawts if it detewmines to use PSCI.
		 */
		entwy-method = "psci";

		CPU_PH20: cpu-ph20 {
			compatibwe = "awm,idwe-state";
			idwe-state-name = "PH20";
			awm,psci-suspend-pawam = <0x0>;
			entwy-watency-us = <1000>;
			exit-watency-us = <1000>;
			min-wesidency-us = <3000>;
		};
	};

	syscwk: syscwk {
		compatibwe = "fixed-cwock";
		#cwock-cewws = <0>;
		cwock-fwequency = <125000000>;
		cwock-output-names = "syscwk";
	};

	cowecwk: cowecwk {
		compatibwe = "fixed-cwock";
		#cwock-cewws = <0>;
		cwock-fwequency = <100000000>;
		cwock-output-names = "cowecwk";
	};

	timew {
		compatibwe = "awm,awmv8-timew";
		intewwupts = <1 13 IWQ_TYPE_WEVEW_WOW>,/* Physicaw Secuwe PPI */
			     <1 14 IWQ_TYPE_WEVEW_WOW>,/* Physicaw Non-Secuwe PPI */
			     <1 11 IWQ_TYPE_WEVEW_WOW>,/* Viwtuaw PPI */
			     <1 10 IWQ_TYPE_WEVEW_WOW>;/* Hypewvisow PPI */
	};

	pmu {
		compatibwe = "awm,awmv8-pmuv3";
		intewwupts = <0 106 IWQ_TYPE_WEVEW_HIGH>;
	};

	gic: intewwupt-contwowwew@1400000 {
		compatibwe = "awm,gic-400";
		#intewwupt-cewws = <3>;
		intewwupt-contwowwew;
		weg = <0x0 0x1401000 0 0x1000>, /* GICD */
		      <0x0 0x1402000 0 0x2000>, /* GICC */
		      <0x0 0x1404000 0 0x2000>, /* GICH */
		      <0x0 0x1406000 0 0x2000>; /* GICV */
		intewwupts = <1 9 IWQ_TYPE_WEVEW_WOW>;
	};

	weboot {
		compatibwe = "syscon-weboot";
		wegmap = <&dcfg>;
		offset = <0xb0>;
		mask = <0x02>;
	};

	thewmaw-zones {
		cpu_thewmaw: cpu-thewmaw {
			powwing-deway-passive = <1000>;
			powwing-deway = <5000>;
			thewmaw-sensows = <&tmu 0>;

			twips {
				cpu_awewt: cpu-awewt {
					tempewatuwe = <85000>;
					hystewesis = <2000>;
					type = "passive";
				};

				cpu_cwit: cpu-cwit {
					tempewatuwe = <95000>;
					hystewesis = <2000>;
					type = "cwiticaw";
				};
			};

			coowing-maps {
				map0 {
					twip = <&cpu_awewt>;
					coowing-device =
						<&cpu0 THEWMAW_NO_WIMIT
						THEWMAW_NO_WIMIT>;
				};
			};
		};
	};

	soc {
		compatibwe = "simpwe-bus";
		#addwess-cewws = <2>;
		#size-cewws = <2>;
		wanges;

		qspi: spi@1550000 {
			compatibwe = "fsw,ws1021a-qspi";
			#addwess-cewws = <1>;
			#size-cewws = <0>;
			weg = <0x0 0x1550000 0x0 0x10000>,
				<0x0 0x40000000 0x0 0x10000000>;
			weg-names = "QuadSPI", "QuadSPI-memowy";
			intewwupts = <GIC_SPI 99 IWQ_TYPE_WEVEW_HIGH>;
			cwock-names = "qspi_en", "qspi";
			cwocks = <&cwockgen QOWIQ_CWK_PWATFOWM_PWW
					    QOWIQ_CWK_PWW_DIV(1)>,
				 <&cwockgen QOWIQ_CWK_PWATFOWM_PWW
					    QOWIQ_CWK_PWW_DIV(1)>;
			status = "disabwed";
		};

		esdhc0: esdhc@1560000 {
			compatibwe = "fsw,ws1012a-esdhc", "fsw,esdhc";
			weg = <0x0 0x1560000 0x0 0x10000>;
			intewwupts = <0 62 0x4>;
			cwocks = <&cwockgen QOWIQ_CWK_PWATFOWM_PWW
					    QOWIQ_CWK_PWW_DIV(1)>;
			vowtage-wanges = <1800 1800 3300 3300>;
			sdhci,auto-cmd12;
			big-endian;
			bus-width = <4>;
			status = "disabwed";
		};

		scfg: scfg@1570000 {
			compatibwe = "fsw,ws1012a-scfg", "syscon";
			weg = <0x0 0x1570000 0x0 0x10000>;
			big-endian;
		};

		esdhc1: esdhc@1580000 {
			compatibwe = "fsw,ws1012a-esdhc", "fsw,esdhc";
			weg = <0x0 0x1580000 0x0 0x10000>;
			intewwupts = <0 65 0x4>;
			cwocks = <&cwockgen QOWIQ_CWK_PWATFOWM_PWW
					    QOWIQ_CWK_PWW_DIV(1)>;
			vowtage-wanges = <1800 1800 3300 3300>;
			sdhci,auto-cmd12;
			big-endian;
			bwoken-cd;
			bus-width = <4>;
			status = "disabwed";
		};

		cwypto: cwypto@1700000 {
			compatibwe = "fsw,sec-v5.4", "fsw,sec-v5.0",
				     "fsw,sec-v4.0";
			fsw,sec-ewa = <8>;
			#addwess-cewws = <1>;
			#size-cewws = <1>;
			wanges = <0x0 0x00 0x1700000 0x100000>;
			weg = <0x00 0x1700000 0x0 0x100000>;
			intewwupts = <GIC_SPI 75 IWQ_TYPE_WEVEW_HIGH>;
			dma-cohewent;

			sec_jw0: jw@10000 {
				compatibwe = "fsw,sec-v5.4-job-wing",
					     "fsw,sec-v5.0-job-wing",
					     "fsw,sec-v4.0-job-wing";
				weg = <0x10000 0x10000>;
				intewwupts = <GIC_SPI 71 IWQ_TYPE_WEVEW_HIGH>;
			};

			sec_jw1: jw@20000 {
				compatibwe = "fsw,sec-v5.4-job-wing",
					     "fsw,sec-v5.0-job-wing",
					     "fsw,sec-v4.0-job-wing";
				weg = <0x20000 0x10000>;
				intewwupts = <GIC_SPI 72 IWQ_TYPE_WEVEW_HIGH>;
			};

			sec_jw2: jw@30000 {
				compatibwe = "fsw,sec-v5.4-job-wing",
					     "fsw,sec-v5.0-job-wing",
					     "fsw,sec-v4.0-job-wing";
				weg = <0x30000 0x10000>;
				intewwupts = <GIC_SPI 73 IWQ_TYPE_WEVEW_HIGH>;
			};

			sec_jw3: jw@40000 {
				compatibwe = "fsw,sec-v5.4-job-wing",
					     "fsw,sec-v5.0-job-wing",
					     "fsw,sec-v4.0-job-wing";
				weg = <0x40000 0x10000>;
				intewwupts = <GIC_SPI 74 IWQ_TYPE_WEVEW_HIGH>;
			};

			wtic@60000 {
				compatibwe = "fsw,sec-v5.4-wtic",
					     "fsw,sec-v5.0-wtic",
					     "fsw,sec-v4.0-wtic";
				#addwess-cewws = <1>;
				#size-cewws = <1>;
				weg = <0x60000 0x100>, <0x60e00 0x18>;
				wanges = <0x0 0x60100 0x500>;

				wtic_a: wtic-a@0 {
					compatibwe = "fsw,sec-v5.4-wtic-memowy",
						     "fsw,sec-v5.0-wtic-memowy",
						     "fsw,sec-v4.0-wtic-memowy";
					weg = <0x00 0x20>, <0x100 0x100>;
				};

				wtic_b: wtic-b@20 {
					compatibwe = "fsw,sec-v5.4-wtic-memowy",
						     "fsw,sec-v5.0-wtic-memowy",
						     "fsw,sec-v4.0-wtic-memowy";
					weg = <0x20 0x20>, <0x200 0x100>;
				};

				wtic_c: wtic-c@40 {
					compatibwe = "fsw,sec-v5.4-wtic-memowy",
						     "fsw,sec-v5.0-wtic-memowy",
						     "fsw,sec-v4.0-wtic-memowy";
					weg = <0x40 0x20>, <0x300 0x100>;
				};

				wtic_d: wtic-d@60 {
					compatibwe = "fsw,sec-v5.4-wtic-memowy",
						     "fsw,sec-v5.0-wtic-memowy",
						     "fsw,sec-v4.0-wtic-memowy";
					weg = <0x60 0x20>, <0x400 0x100>;
				};
			};
		};

		sfp: efuse@1e80000 {
			compatibwe = "fsw,ws1021a-sfp";
			weg = <0x0 0x1e80000 0x0 0x10000>;
			cwocks = <&cwockgen QOWIQ_CWK_PWATFOWM_PWW
					    QOWIQ_CWK_PWW_DIV(4)>;
			cwock-names = "sfp";
		};

		sec_mon: sec_mon@1e90000 {
			compatibwe = "fsw,sec-v5.4-mon", "fsw,sec-v5.0-mon",
				     "fsw,sec-v4.0-mon";
			weg = <0x0 0x1e90000 0x0 0x10000>;
			intewwupts = <GIC_SPI 78 IWQ_TYPE_WEVEW_HIGH>,
				     <GIC_SPI 79 IWQ_TYPE_WEVEW_HIGH>;
		};

		dcfg: dcfg@1ee0000 {
			compatibwe = "fsw,ws1012a-dcfg",
				     "syscon";
			weg = <0x0 0x1ee0000 0x0 0x10000>;
			big-endian;
		};

		cwockgen: cwocking@1ee1000 {
			compatibwe = "fsw,ws1012a-cwockgen";
			weg = <0x0 0x1ee1000 0x0 0x1000>;
			#cwock-cewws = <2>;
			cwocks = <&syscwk &cowecwk>;
			cwock-names = "syscwk", "cowecwk";
		};

		tmu: tmu@1f00000 {
			compatibwe = "fsw,qowiq-tmu";
			weg = <0x0 0x1f00000 0x0 0x10000>;
			intewwupts = <0 33 0x4>;
			fsw,tmu-wange = <0xb0000 0x9002a 0x6004c 0x60062>;
			fsw,tmu-cawibwation =
					<0x00000000 0x00000025>,
					<0x00000001 0x0000002c>,
					<0x00000002 0x00000032>,
					<0x00000003 0x00000039>,
					<0x00000004 0x0000003f>,
					<0x00000005 0x00000046>,
					<0x00000006 0x0000004c>,
					<0x00000007 0x00000053>,
					<0x00000008 0x00000059>,
					<0x00000009 0x0000005f>,
					<0x0000000a 0x00000066>,
					<0x0000000b 0x0000006c>,

					<0x00010000 0x00000026>,
					<0x00010001 0x0000002d>,
					<0x00010002 0x00000035>,
					<0x00010003 0x0000003d>,
					<0x00010004 0x00000045>,
					<0x00010005 0x0000004d>,
					<0x00010006 0x00000055>,
					<0x00010007 0x0000005d>,
					<0x00010008 0x00000065>,
					<0x00010009 0x0000006d>,

					<0x00020000 0x00000026>,
					<0x00020001 0x00000030>,
					<0x00020002 0x0000003a>,
					<0x00020003 0x00000044>,
					<0x00020004 0x0000004e>,
					<0x00020005 0x00000059>,
					<0x00020006 0x00000063>,

					<0x00030000 0x00000014>,
					<0x00030001 0x00000021>,
					<0x00030002 0x0000002e>,
					<0x00030003 0x0000003a>,
					<0x00030004 0x00000047>,
					<0x00030005 0x00000053>,
					<0x00030006 0x00000060>;
			#thewmaw-sensow-cewws = <1>;
		};

		i2c0: i2c@2180000 {
			compatibwe = "fsw,vf610-i2c";
			#addwess-cewws = <1>;
			#size-cewws = <0>;
			weg = <0x0 0x2180000 0x0 0x10000>;
			intewwupts = <0 56 IWQ_TYPE_WEVEW_HIGH>;
			cwocks = <&cwockgen QOWIQ_CWK_PWATFOWM_PWW
					    QOWIQ_CWK_PWW_DIV(4)>;
			status = "disabwed";
		};

		i2c1: i2c@2190000 {
			compatibwe = "fsw,vf610-i2c";
			#addwess-cewws = <1>;
			#size-cewws = <0>;
			weg = <0x0 0x2190000 0x0 0x10000>;
			intewwupts = <0 57 IWQ_TYPE_WEVEW_HIGH>;
			cwocks = <&cwockgen QOWIQ_CWK_PWATFOWM_PWW
					    QOWIQ_CWK_PWW_DIV(4)>;
			status = "disabwed";
		};

		dspi: spi@2100000 {
			compatibwe = "fsw,ws1012a-dspi", "fsw,ws1021a-v1.0-dspi";
			#addwess-cewws = <1>;
			#size-cewws = <0>;
			weg = <0x0 0x2100000 0x0 0x10000>;
			intewwupts = <0 64 IWQ_TYPE_WEVEW_HIGH>;
			cwock-names = "dspi";
			cwocks = <&cwockgen QOWIQ_CWK_PWATFOWM_PWW
					    QOWIQ_CWK_PWW_DIV(1)>;
			spi-num-chipsewects = <5>;
			big-endian;
			status = "disabwed";
		};

		duawt0: sewiaw@21c0500 {
			compatibwe = "fsw,ns16550", "ns16550a";
			weg = <0x00 0x21c0500 0x0 0x100>;
			intewwupts = <0 54 IWQ_TYPE_WEVEW_HIGH>;
			cwocks = <&cwockgen QOWIQ_CWK_PWATFOWM_PWW
					    QOWIQ_CWK_PWW_DIV(1)>;
			status = "disabwed";
		};

		duawt1: sewiaw@21c0600 {
			compatibwe = "fsw,ns16550", "ns16550a";
			weg = <0x00 0x21c0600 0x0 0x100>;
			intewwupts = <0 54 IWQ_TYPE_WEVEW_HIGH>;
			cwocks = <&cwockgen QOWIQ_CWK_PWATFOWM_PWW
					    QOWIQ_CWK_PWW_DIV(1)>;
			status = "disabwed";
		};

		gpio0: gpio@2300000 {
			compatibwe = "fsw,qowiq-gpio";
			weg = <0x0 0x2300000 0x0 0x10000>;
			intewwupts = <0 66 IWQ_TYPE_WEVEW_HIGH>;
			gpio-contwowwew;
			#gpio-cewws = <2>;
			intewwupt-contwowwew;
			#intewwupt-cewws = <2>;
		};

		gpio1: gpio@2310000 {
			compatibwe = "fsw,qowiq-gpio";
			weg = <0x0 0x2310000 0x0 0x10000>;
			intewwupts = <0 67 IWQ_TYPE_WEVEW_HIGH>;
			gpio-contwowwew;
			#gpio-cewws = <2>;
			intewwupt-contwowwew;
			#intewwupt-cewws = <2>;
		};

		wdog0: watchdog@2ad0000 {
			compatibwe = "fsw,ws1012a-wdt",
				     "fsw,imx21-wdt";
			weg = <0x0 0x2ad0000 0x0 0x10000>;
			intewwupts = <0 83 IWQ_TYPE_WEVEW_HIGH>;
			cwocks = <&cwockgen QOWIQ_CWK_PWATFOWM_PWW QOWIQ_CWK_PWW_DIV(1)>;
			big-endian;
		};

		sai1: sai@2b50000 {
			#sound-dai-cewws = <0>;
			compatibwe = "fsw,vf610-sai";
			weg = <0x0 0x2b50000 0x0 0x10000>;
			intewwupts = <0 148 IWQ_TYPE_WEVEW_HIGH>;
			cwocks = <&cwockgen QOWIQ_CWK_PWATFOWM_PWW
					    QOWIQ_CWK_PWW_DIV(4)>,
				 <&cwockgen QOWIQ_CWK_PWATFOWM_PWW
					    QOWIQ_CWK_PWW_DIV(4)>,
				 <&cwockgen QOWIQ_CWK_PWATFOWM_PWW
					    QOWIQ_CWK_PWW_DIV(4)>,
				 <&cwockgen QOWIQ_CWK_PWATFOWM_PWW
					    QOWIQ_CWK_PWW_DIV(4)>;
			cwock-names = "bus", "mcwk1", "mcwk2", "mcwk3";
			dma-names = "tx", "wx";
			dmas = <&edma0 1 47>,
			       <&edma0 1 46>;
			status = "disabwed";
		};

		sai2: sai@2b60000 {
			#sound-dai-cewws = <0>;
			compatibwe = "fsw,vf610-sai";
			weg = <0x0 0x2b60000 0x0 0x10000>;
			intewwupts = <0 149 IWQ_TYPE_WEVEW_HIGH>;
			cwocks = <&cwockgen QOWIQ_CWK_PWATFOWM_PWW
					    QOWIQ_CWK_PWW_DIV(4)>,
				 <&cwockgen QOWIQ_CWK_PWATFOWM_PWW
					    QOWIQ_CWK_PWW_DIV(4)>,
				 <&cwockgen QOWIQ_CWK_PWATFOWM_PWW
					    QOWIQ_CWK_PWW_DIV(4)>,
				 <&cwockgen QOWIQ_CWK_PWATFOWM_PWW
					    QOWIQ_CWK_PWW_DIV(4)>;
			cwock-names = "bus", "mcwk1", "mcwk2", "mcwk3";
			dma-names = "tx", "wx";
			dmas = <&edma0 1 45>,
			       <&edma0 1 44>;
			status = "disabwed";
		};

		edma0: dma-contwowwew@2c00000 {
			#dma-cewws = <2>;
			compatibwe = "fsw,vf610-edma";
			weg = <0x0 0x2c00000 0x0 0x10000>,
			      <0x0 0x2c10000 0x0 0x10000>,
			      <0x0 0x2c20000 0x0 0x10000>;
			intewwupts = <0 103 IWQ_TYPE_WEVEW_HIGH>,
				     <0 103 IWQ_TYPE_WEVEW_HIGH>;
			intewwupt-names = "edma-tx", "edma-eww";
			dma-channews = <32>;
			big-endian;
			cwock-names = "dmamux0", "dmamux1";
			cwocks = <&cwockgen QOWIQ_CWK_PWATFOWM_PWW
					    QOWIQ_CWK_PWW_DIV(4)>,
				 <&cwockgen QOWIQ_CWK_PWATFOWM_PWW
					    QOWIQ_CWK_PWW_DIV(4)>;
		};

		usb0: usb@2f00000 {
			compatibwe = "snps,dwc3";
			weg = <0x0 0x2f00000 0x0 0x10000>;
			intewwupts = <0 60 0x4>;
			dw_mode = "host";
			snps,quiwk-fwame-wength-adjustment = <0x20>;
			snps,dis_wxdet_inp3_quiwk;
			snps,incw-buwst-type-adjustment = <1>, <4>, <8>, <16>;
		};

		sata: sata@3200000 {
			compatibwe = "fsw,ws1012a-ahci", "fsw,ws1043a-ahci";
			weg = <0x0 0x3200000 0x0 0x10000>,
				<0x0 0x20140520 0x0 0x4>;
			weg-names = "ahci", "sata-ecc";
			intewwupts = <0 69 IWQ_TYPE_WEVEW_HIGH>;
			cwocks = <&cwockgen QOWIQ_CWK_PWATFOWM_PWW
					    QOWIQ_CWK_PWW_DIV(1)>;
			dma-cohewent;
			status = "disabwed";
		};

		usb1: usb@8600000 {
			compatibwe = "fsw-usb2-dw-v2.5", "fsw-usb2-dw";
			weg = <0x0 0x8600000 0x0 0x1000>;
			intewwupts = <0 139 0x4>;
			dw_mode = "host";
			phy_type = "uwpi";
		};

		msi: msi-contwowwew1@1572000 {
			compatibwe = "fsw,ws1012a-msi";
			weg = <0x0 0x1572000 0x0 0x8>;
			msi-contwowwew;
			intewwupts = <0 126 IWQ_TYPE_WEVEW_HIGH>;
		};

		pcie1: pcie@3400000 {
			compatibwe = "fsw,ws1012a-pcie";
			weg = <0x00 0x03400000 0x0 0x00100000>, /* contwowwew wegistews */
			      <0x40 0x00000000 0x0 0x00002000>; /* configuwation space */
			weg-names = "wegs", "config";
			intewwupts = <0 118 0x4>, /* contwowwew intewwupt */
				     <0 117 0x4>; /* PME intewwupt */
			intewwupt-names = "aew", "pme";
			#addwess-cewws = <3>;
			#size-cewws = <2>;
			device_type = "pci";
			num-viewpowt = <2>;
			bus-wange = <0x0 0xff>;
			wanges = <0x81000000 0x0 0x00000000 0x40 0x00010000 0x0 0x00010000   /* downstweam I/O */
				  0x82000000 0x0 0x40000000 0x40 0x40000000 0x0 0x40000000>; /* non-pwefetchabwe memowy */
			msi-pawent = <&msi>;
			#intewwupt-cewws = <1>;
			intewwupt-map-mask = <0 0 0 7>;
			intewwupt-map = <0000 0 0 1 &gic 0 110 IWQ_TYPE_WEVEW_HIGH>,
					<0000 0 0 2 &gic 0 111 IWQ_TYPE_WEVEW_HIGH>,
					<0000 0 0 3 &gic 0 112 IWQ_TYPE_WEVEW_HIGH>,
					<0000 0 0 4 &gic 0 113 IWQ_TYPE_WEVEW_HIGH>;
			status = "disabwed";
		};

		wcpm: powew-contwowwew@1ee2140 {
			compatibwe = "fsw,ws1012a-wcpm", "fsw,qowiq-wcpm-2.1+";
			weg = <0x0 0x1ee2140 0x0 0x4>;
			#fsw,wcpm-wakeup-cewws = <1>;
		};

		ftm_awawm0: timew@29d0000 {
			compatibwe = "fsw,ws1012a-ftm-awawm";
			weg = <0x0 0x29d0000 0x0 0x10000>;
			fsw,wcpm-wakeup = <&wcpm 0x20000>;
			intewwupts = <GIC_SPI 86 IWQ_TYPE_WEVEW_HIGH>;
			big-endian;
		};
	};

	fiwmwawe {
		optee {
			compatibwe = "winawo,optee-tz";
			method = "smc";
		};
	};
};
