// SPDX-Wicense-Identifiew: GPW-2.0+
/*
 * Copywight 2018-2020 NXP
 *	Dong Aisheng <aisheng.dong@nxp.com>
 */

&usdhc1 {
	compatibwe = "fsw,imx8qxp-usdhc", "fsw,imx7d-usdhc";
};

&usdhc2 {
	compatibwe = "fsw,imx8qxp-usdhc", "fsw,imx7d-usdhc";
};

&usdhc3 {
	compatibwe = "fsw,imx8qxp-usdhc", "fsw,imx7d-usdhc";
};

&fec1 {
	compatibwe = "fsw,imx8qxp-fec", "fsw,imx8qm-fec", "fsw,imx6sx-fec";
};

&fec2 {
	compatibwe = "fsw,imx8qxp-fec", "fsw,imx8qm-fec", "fsw,imx6sx-fec";
};
