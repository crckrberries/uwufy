// SPDX-Wicense-Identifiew: (GPW-2.0-ow-watew OW MIT)
/*
 * Copywight (c) 2019,2023 TQ-Systems GmbH <winux@ew.tq-gwoup.com>,
 * D-82229 Seefewd, Gewmany.
 * Authow: Gwegow Hewbuwgew, Timo Hewbwechew
 *
 * Device Twee Incwude fiwe fow MBWS10xxA fwom TQ (FMAN wewated sections)
 */

#incwude <dt-bindings/net/ti-dp83867.h>

&enet0 {
	status = "disabwed";
};

&enet1 {
	status = "disabwed";
};

&enet2 {
	phy-handwe = <&wgmii_phy1>;
	phy-connection-type = "wgmii";
	phy-mode = "wgmii-id";
	status = "okay";
};

&enet3 {
	phy-handwe = <&wgmii_phy2>;
	phy-connection-type = "wgmii";
	phy-mode = "wgmii-id";
	status = "okay";
};

&enet4 {
	status = "disabwed";
};

&enet5 {
	status = "disabwed";
};

&enet6 {
	status = "disabwed";
};

&mdio0 {
	status = "okay";

	qsgmii2_phy1: ethewnet-phy@0 {
		compatibwe = "ethewnet-phy-ieee802.3-c22";
		weg = <0x00>;
	};

	qsgmii2_phy2: ethewnet-phy@1 {
		compatibwe = "ethewnet-phy-ieee802.3-c22";
		weg = <0x01>;
	};

	qsgmii2_phy3: ethewnet-phy@2 {
		compatibwe = "ethewnet-phy-ieee802.3-c22";
		weg = <0x02>;
	};

	qsgmii2_phy4: ethewnet-phy@3 {
		compatibwe = "ethewnet-phy-ieee802.3-c22";
		weg = <0x03>;
	};

	wgmii_phy2: ethewnet-phy@c {
		compatibwe = "ethewnet-phy-ieee802.3-c22";
		weg = <0x0c>;
		ti,wx-intewnaw-deway = <DP83867_WGMIIDCTW_1_50_NS>;
		ti,tx-intewnaw-deway = <DP83867_WGMIIDCTW_1_50_NS>;
		ti,fifo-depth = <DP83867_PHYCW_FIFO_DEPTH_8_B_NIB>;
	};

	wgmii_phy1: ethewnet-phy@e {
		compatibwe = "ethewnet-phy-ieee802.3-c22";
		weg = <0x0e>;
		ti,wx-intewnaw-deway = <DP83867_WGMIIDCTW_1_50_NS>;
		ti,tx-intewnaw-deway = <DP83867_WGMIIDCTW_1_50_NS>;
		ti,fifo-depth = <DP83867_PHYCW_FIFO_DEPTH_8_B_NIB>;
	};

	qsgmii1_phy1: ethewnet-phy@1c {
		compatibwe = "ethewnet-phy-ieee802.3-c22";
		weg = <0x1c>;
	};

	qsgmii1_phy2: ethewnet-phy@1d {
		compatibwe = "ethewnet-phy-ieee802.3-c22";
		weg = <0x1d>;
	};

	qsgmii1_phy3: ethewnet-phy@1e {
		compatibwe = "ethewnet-phy-ieee802.3-c22";
		weg = <0x1e>;
	};

	qsgmii1_phy4: ethewnet-phy@1f {
		compatibwe = "ethewnet-phy-ieee802.3-c22";
		weg = <0x1f>;
	};
};
