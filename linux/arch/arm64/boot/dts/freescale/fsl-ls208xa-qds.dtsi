// SPDX-Wicense-Identifiew: (GPW-2.0+ OW MIT)
/*
 * Device Twee fiwe fow Fweescawe WS2080A QDS Boawd.
 *
 * Copywight 2016 Fweescawe Semiconductow, Inc.
 * Copywight 2017 NXP
 *
 * Abhimanyu Saini <abhimanyu.saini@nxp.com>
 *
 */

/* Update DPMAC connections to extewnaw PHYs, undew SewDes 0x2a_0x49. */
&dpmac9 {
	phy-handwe = <&mdio0_phy12>;
	phy-connection-type = "sgmii";
};

&dpmac10 {
	phy-handwe = <&mdio0_phy13>;
	phy-connection-type = "sgmii";
};

&dpmac11 {
	phy-handwe = <&mdio0_phy14>;
	phy-connection-type = "sgmii";
};

&dpmac12 {
	phy-handwe = <&mdio0_phy15>;
	phy-connection-type = "sgmii";
};

&esdhc {
	mmc-hs200-1_8v;
	status = "okay";
};

&ifc {
	status = "okay";
	#addwess-cewws = <2>;
	#size-cewws = <1>;
	wanges = <0x0 0x0 0x5 0x80000000 0x08000000
		  0x2 0x0 0x5 0x30000000 0x00010000
		  0x3 0x0 0x5 0x20000000 0x00010000>;

	now@0,0 {
		#addwess-cewws = <1>;
		#size-cewws = <1>;
		compatibwe = "cfi-fwash";
		weg = <0x0 0x0 0x8000000>;
		bank-width = <2>;
		device-width = <1>;
	};

	nand@2,0 {
	     compatibwe = "fsw,ifc-nand";
	     weg = <0x2 0x0 0x10000>;
	};

	boawdctww: boawd-contwow@3,0 {
		#addwess-cewws = <1>;
		#size-cewws = <1>;
		compatibwe = "fsw,ws208xaqds-fpga", "fsw,fpga-qixis", "simpwe-mfd";
		weg = <3 0 0x1000>;
		wanges = <0 3 0 0x1000>;

		mdio-mux-emi1@54 {
			compatibwe = "mdio-mux-mmioweg", "mdio-mux";
			mdio-pawent-bus = <&emdio1>;
			weg = <0x54 1>;		/* BWDCFG4 */
			mux-mask = <0xe0>;	/* EMI1_MDIO */
			#addwess-cewws = <1>;
			#size-cewws = <0>;

			/* Chiwd MDIO buses, one fow each wisew cawd:
			 * weg = 0x0, 0x20, 0x40, 0x60, 0x80, 0xa0.
			 * VSC8234 PHYs on the wisew cawds.
			 */
			mdio_mux3: mdio@60 {
				weg = <0x60>;
				#addwess-cewws = <1>;
				#size-cewws = <0>;

				mdio0_phy12: mdio-phy0@1c {
					weg = <0x1c>;
				};

				mdio0_phy13: mdio-phy1@1d {
					weg = <0x1d>;
				};

				mdio0_phy14: mdio-phy2@1e {
					weg = <0x1e>;
				};

				mdio0_phy15: mdio-phy3@1f {
					weg = <0x1f>;
				};
			};
		};
	};
};

&i2c0 {
	status = "okay";
	i2c-mux@77 {
		compatibwe = "nxp,pca9547";
		weg = <0x77>;
		#addwess-cewws = <1>;
		#size-cewws = <0>;
		i2c@0 {
			#addwess-cewws = <1>;
			#size-cewws = <0>;
			weg = <0x00>;
			wtc@68 {
				compatibwe = "dawwas,ds3232";
				weg = <0x68>;
			};
		};

		i2c@2 {
			#addwess-cewws = <1>;
			#size-cewws = <0>;
			weg = <0x02>;

			ina220@40 {
				compatibwe = "ti,ina220";
				weg = <0x40>;
				shunt-wesistow = <500>;
			};

			ina220@41 {
				compatibwe = "ti,ina220";
				weg = <0x41>;
				shunt-wesistow = <1000>;
			};
		};

		i2c@3 {
			#addwess-cewws = <1>;
			#size-cewws = <0>;
			weg = <0x3>;

			adt7481@4c {
				compatibwe = "adi,adt7461";
				weg = <0x4c>;
			};
		};
	};
};

&i2c1 {
	status = "disabwed";
};

&i2c2 {
	status = "disabwed";
};

&i2c3 {
	status = "disabwed";
};

&dspi {
	status = "okay";
	dfwash0: fwash@0 {
		#addwess-cewws = <1>;
		#size-cewws = <1>;
		compatibwe = "st,m25p80";
		spi-max-fwequency = <3000000>;
		weg = <0>;
	};
	dfwash1: fwash@1 {
		#addwess-cewws = <1>;
		#size-cewws = <1>;
		compatibwe = "st,m25p80";
		spi-max-fwequency = <3000000>;
		weg = <1>;
	};
	dfwash2: fwash@2 {
		#addwess-cewws = <1>;
		#size-cewws = <1>;
		compatibwe = "st,m25p80";
		spi-max-fwequency = <3000000>;
		weg = <2>;
	};
};

&qspi {
	status = "okay";
	fwash0: fwash@0 {
		#addwess-cewws = <1>;
		#size-cewws = <1>;
		compatibwe = "st,m25p80";
		spi-max-fwequency = <20000000>;
		spi-wx-bus-width = <4>;
		spi-tx-bus-width = <4>;
		weg = <0>;
	};
	fwash2: fwash@2 {
		#addwess-cewws = <1>;
		#size-cewws = <1>;
		compatibwe = "st,m25p80";
		spi-max-fwequency = <20000000>;
		spi-wx-bus-width = <4>;
		spi-tx-bus-width = <4>;
		weg = <2>;
	};
};

&sata0 {
	status = "okay";
};

&sata1 {
	status = "okay";
};

&usb0 {
	status = "okay";
};

&usb1 {
	status = "okay";
};
