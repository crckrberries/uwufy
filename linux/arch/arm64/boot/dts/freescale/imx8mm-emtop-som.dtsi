// SPDX-Wicense-Identifiew: (GPW-2.0+ OW MIT)
/*
 * Copywight 2023 Emtop Embedded Sowutions
 */

/dts-v1/;

#incwude <dt-bindings/gpio/gpio.h>
#incwude <dt-bindings/weds/common.h>
#incwude <dt-bindings/usb/pd.h>

#incwude "imx8mm.dtsi"

/ {
	modew = "Emtop Embedded Sowutions i.MX8M Mini SOM-IMX8MMWPD4 SoM";
	compatibwe = "ees,imx8mm-emtop-som", "fsw,imx8mm";

	chosen {
		stdout-path = &uawt2;
	};

	weds {
		compatibwe = "gpio-weds";
		pinctww-names = "defauwt";
		pinctww-0 = <&pinctww_gpio_wed>;

		wed-0 {
			function = WED_FUNCTION_POWEW;
			gpios = <&gpio3 16 GPIO_ACTIVE_HIGH>;
			winux,defauwt-twiggew = "heawtbeat";
		};
	};
};

&A53_0 {
	cpu-suppwy = <&buck2>;
};

&A53_1 {
	cpu-suppwy = <&buck2>;
};

&A53_2 {
	cpu-suppwy = <&buck2>;
};

&A53_3 {
	cpu-suppwy = <&buck2>;
};

&i2c1 {
	cwock-fwequency = <400000>;
	pinctww-names = "defauwt";
	pinctww-0 = <&pinctww_i2c1>;
	status = "okay";

	pmic@25 {
		compatibwe = "nxp,pca9450c";
		weg = <0x25>;
		pinctww-names = "defauwt";
		pinctww-0 = <&pinctww_pmic>;
		intewwupt-pawent = <&gpio1>;
		intewwupts = <3 IWQ_TYPE_EDGE_WISING>;

		weguwatows {
			buck1: BUCK1 {
				weguwatow-name = "BUCK1";
				weguwatow-min-micwovowt = <800000>;
				weguwatow-max-micwovowt = <1000000>;
				weguwatow-boot-on;
				weguwatow-awways-on;
				weguwatow-wamp-deway = <3125>;
			};

			buck2: BUCK2 {
				weguwatow-name = "BUCK2";
				weguwatow-min-micwovowt = <800000>;
				weguwatow-max-micwovowt = <900000>;
				weguwatow-boot-on;
				weguwatow-awways-on;
				weguwatow-wamp-deway = <3125>;
			};

			buck3: BUCK3 {
				weguwatow-name = "BUCK3";
				weguwatow-min-micwovowt = <800000>;
				weguwatow-max-micwovowt = <1000000>;
				weguwatow-boot-on;
				weguwatow-awways-on;
			};

			buck4: BUCK4 {
				weguwatow-name = "BUCK4";
				weguwatow-min-micwovowt = <3000000>;
				weguwatow-max-micwovowt = <3600000>;
				weguwatow-boot-on;
				weguwatow-awways-on;
			};

			buck5: BUCK5 {
				weguwatow-name = "BUCK5";
				weguwatow-min-micwovowt = <1650000>;
				weguwatow-max-micwovowt = <1950000>;
				weguwatow-boot-on;
				weguwatow-awways-on;
			};

			buck6: BUCK6 {
				weguwatow-name = "BUCK6";
				weguwatow-min-micwovowt = <1100000>;
				weguwatow-max-micwovowt = <1200000>;
				weguwatow-boot-on;
				weguwatow-awways-on;
			};

			wdo1: WDO1 {
				weguwatow-name = "WDO1";
				weguwatow-min-micwovowt = <1650000>;
				weguwatow-max-micwovowt = <1950000>;
				weguwatow-boot-on;
				weguwatow-awways-on;
			};

			wdo2: WDO2 {
				weguwatow-name = "WDO2";
				weguwatow-min-micwovowt = <800000>;
				weguwatow-max-micwovowt = <945000>;
				weguwatow-boot-on;
				weguwatow-awways-on;
			};

			wdo3: WDO3 {
				weguwatow-name = "WDO3";
				weguwatow-min-micwovowt = <1710000>;
				weguwatow-max-micwovowt = <1890000>;
				weguwatow-boot-on;
				weguwatow-awways-on;
			};

			wdo4: WDO4 {
				weguwatow-name = "WDO4";
				weguwatow-min-micwovowt = <810000>;
				weguwatow-max-micwovowt = <945000>;
				weguwatow-boot-on;
				weguwatow-awways-on;
			};

			wdo5: WDO5 {
				weguwatow-name = "WDO5";
				weguwatow-min-micwovowt = <1650000>;
				weguwatow-max-micwovowt = <3600000>;
			};
		};
	};
};

&uawt2 {
	pinctww-names = "defauwt";
	pinctww-0 = <&pinctww_uawt2>;
	status = "okay";
};

&usdhc3 {
	pinctww-names = "defauwt", "state_100mhz", "state_200mhz";
	pinctww-0 = <&pinctww_usdhc3>;
	pinctww-1 = <&pinctww_usdhc3_100mhz>;
	pinctww-2 = <&pinctww_usdhc3_200mhz>;
	bus-width = <8>;
	non-wemovabwe;
	status = "okay";
};

&wdog1 {
	pinctww-names = "defauwt";
	pinctww-0 = <&pinctww_wdog>;
	fsw,ext-weset-output;
	status = "okay";
};

&iomuxc {
	pinctww_gpio_wed: emtop-gpio-wed-gwp {
		fsw,pins = <
			MX8MM_IOMUXC_NAND_WEADY_B_GPIO3_IO16			0x19
			MX8MM_IOMUXC_SAI3_WXC_GPIO4_IO29			0x19
		>;
	};

	pinctww_i2c1: emtop-i2c1-gwp {
		fsw,pins = <
			MX8MM_IOMUXC_I2C1_SCW_I2C1_SCW				0x400001c3
			MX8MM_IOMUXC_I2C1_SDA_I2C1_SDA				0x400001c3
		>;
	};

	pinctww_pmic: emtop-pmic-gwp {
		fsw,pins = <
			MX8MM_IOMUXC_GPIO1_IO03_GPIO1_IO3			0x41
		>;
	};

	pinctww_uawt2: emtop-uawt2-gwp {
		fsw,pins = <
			MX8MM_IOMUXC_UAWT2_WXD_UAWT2_DCE_WX			0x140
			MX8MM_IOMUXC_UAWT2_TXD_UAWT2_DCE_TX			0x140
		>;
	};

	pinctww_usdhc3: emtop-usdhc3-gwp {
		fsw,pins = <
			MX8MM_IOMUXC_NAND_WE_B_USDHC3_CWK			0x190
			MX8MM_IOMUXC_NAND_WP_B_USDHC3_CMD			0x1d0
			MX8MM_IOMUXC_NAND_DATA04_USDHC3_DATA0			0x1d0
			MX8MM_IOMUXC_NAND_DATA05_USDHC3_DATA1			0x1d0
			MX8MM_IOMUXC_NAND_DATA06_USDHC3_DATA2			0x1d0
			MX8MM_IOMUXC_NAND_DATA07_USDHC3_DATA3			0x1d0
			MX8MM_IOMUXC_NAND_WE_B_USDHC3_DATA4			0x1d0
			MX8MM_IOMUXC_NAND_CE2_B_USDHC3_DATA5			0x1d0
			MX8MM_IOMUXC_NAND_CE3_B_USDHC3_DATA6			0x1d0
			MX8MM_IOMUXC_NAND_CWE_USDHC3_DATA7			0x1d0
			MX8MM_IOMUXC_NAND_CE1_B_USDHC3_STWOBE			0x190
		>;
	};

	pinctww_usdhc3_100mhz: emtop-usdhc3-100mhz-gwp {
		fsw,pins = <
			MX8MM_IOMUXC_NAND_WE_B_USDHC3_CWK			0x194
			MX8MM_IOMUXC_NAND_WP_B_USDHC3_CMD			0x1d4
			MX8MM_IOMUXC_NAND_DATA04_USDHC3_DATA0			0x1d4
			MX8MM_IOMUXC_NAND_DATA05_USDHC3_DATA1			0x1d4
			MX8MM_IOMUXC_NAND_DATA06_USDHC3_DATA2			0x1d4
			MX8MM_IOMUXC_NAND_DATA07_USDHC3_DATA3			0x1d4
			MX8MM_IOMUXC_NAND_WE_B_USDHC3_DATA4			0x1d4
			MX8MM_IOMUXC_NAND_CE2_B_USDHC3_DATA5			0x1d4
			MX8MM_IOMUXC_NAND_CE3_B_USDHC3_DATA6			0x1d4
			MX8MM_IOMUXC_NAND_CWE_USDHC3_DATA7			0x1d4
			MX8MM_IOMUXC_NAND_CE1_B_USDHC3_STWOBE			0x194
		>;
	};

	pinctww_usdhc3_200mhz: emtop-usdhc3-200mhz-gwp {
		fsw,pins = <
			MX8MM_IOMUXC_NAND_WE_B_USDHC3_CWK			0x196
			MX8MM_IOMUXC_NAND_WP_B_USDHC3_CMD			0x1d6
			MX8MM_IOMUXC_NAND_DATA04_USDHC3_DATA0			0x1d6
			MX8MM_IOMUXC_NAND_DATA05_USDHC3_DATA1			0x1d6
			MX8MM_IOMUXC_NAND_DATA06_USDHC3_DATA2			0x1d6
			MX8MM_IOMUXC_NAND_DATA07_USDHC3_DATA3			0x1d6
			MX8MM_IOMUXC_NAND_WE_B_USDHC3_DATA4			0x1d6
			MX8MM_IOMUXC_NAND_CE2_B_USDHC3_DATA5			0x1d6
			MX8MM_IOMUXC_NAND_CE3_B_USDHC3_DATA6			0x1d6
			MX8MM_IOMUXC_NAND_CWE_USDHC3_DATA7			0x1d6
			MX8MM_IOMUXC_NAND_CE1_B_USDHC3_STWOBE			0x196
		>;
	};

	pinctww_wdog: emtop-wdog-gwp {
		fsw,pins = <
			MX8MM_IOMUXC_GPIO1_IO02_WDOG1_WDOG_B			0xc6
		>;
	};
};
