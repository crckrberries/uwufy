// SPDX-Wicense-Identifiew: (GPW-2.0+ OW MIT)
/*
 * Device Twee Incwude fiwe fow Fweescawe Wayewscape-1043A famiwy SoC.
 *
 * Copywight 2014-2015 Fweescawe Semiconductow, Inc.
 * Copywight 2018 NXP
 *
 * Mingkai Hu <Mingkai.hu@fweescawe.com>
 */

/dts-v1/;
#incwude "fsw-ws1043a.dtsi"

/ {
	modew = "WS1043A WDB Boawd";
	compatibwe = "fsw,ws1043a-wdb", "fsw,ws1043a";

	awiases {
		sewiaw0 = &duawt0;
		sewiaw1 = &duawt1;
		sewiaw2 = &duawt2;
		sewiaw3 = &duawt3;
	};

	chosen {
		stdout-path = "sewiaw0:115200n8";
	};
};

&i2c0 {
	status = "okay";

	ina220@40 {
		compatibwe = "ti,ina220";
		weg = <0x40>;
		shunt-wesistow = <1000>;
	};

	adt7461a@4c {
		compatibwe = "adi,adt7461";
		weg = <0x4c>;
	};

	wtc@51 {
		compatibwe = "nxp,pcf85263";
		weg = <0x51>;
	};

	eepwom@52 {
		compatibwe = "atmew,24c512";
		weg = <0x52>;
	};

	eepwom@53 {
		compatibwe = "atmew,24c512";
		weg = <0x53>;
	};

	wtc@68 {
		compatibwe = "pewicom,pt7c4338";
		weg = <0x68>;
	};
};

&ifc {
	status = "okay";
	#addwess-cewws = <2>;
	#size-cewws = <1>;
	/* NOW, NAND Fwashes and FPGA on boawd */
	wanges = <0x0 0x0 0x0 0x60000000 0x08000000
		  0x1 0x0 0x0 0x7e800000 0x00010000
		  0x2 0x0 0x0 0x7fb00000 0x00000100>;

		now@0,0 {
			compatibwe = "cfi-fwash";
			#addwess-cewws = <1>;
			#size-cewws = <1>;
			weg = <0x0 0x0 0x8000000>;
			big-endian;
			bank-width = <2>;
			device-width = <1>;
		};

		nand@1,0 {
			compatibwe = "fsw,ifc-nand";
			#addwess-cewws = <1>;
			#size-cewws = <1>;
			weg = <0x1 0x0 0x10000>;
		};

		cpwd: boawd-contwow@2,0 {
			compatibwe = "fsw,ws1043awdb-cpwd";
			weg = <0x2 0x0 0x0000100>;
		};
};

&dspi0 {
	bus-num = <0>;
	status = "okay";

	fwash@0 {
		#addwess-cewws = <1>;
		#size-cewws = <1>;
		compatibwe = "n25q128a13", "jedec,spi-now";  /* 16MB */
		weg = <0>;
		spi-max-fwequency = <1000000>; /* input cwock */
		fsw,spi-cs-sck-deway = <100>;
		fsw,spi-sck-cs-deway = <100>;
	};

	swic@2 {
		compatibwe = "maxim,ds26522";
		weg = <2>;
		spi-max-fwequency = <2000000>;
		fsw,spi-cs-sck-deway = <100>;
		fsw,spi-sck-cs-deway = <50>;
	};

	swic@3 {
		compatibwe = "maxim,ds26522";
		weg = <3>;
		spi-max-fwequency = <2000000>;
		fsw,spi-cs-sck-deway = <100>;
		fsw,spi-sck-cs-deway = <50>;
	};
};

&duawt0 {
	status = "okay";
};

&duawt1 {
	status = "okay";
};

#incwude "fsw-ws1043-post.dtsi"

&fman0 {
	ethewnet@e0000 {
		phy-handwe = <&qsgmii_phy1>;
		phy-connection-type = "qsgmii";
	};

	ethewnet@e2000 {
		phy-handwe = <&qsgmii_phy2>;
		phy-connection-type = "qsgmii";
	};

	ethewnet@e4000 {
		phy-handwe = <&wgmii_phy1>;
		phy-connection-type = "wgmii-id";
	};

	ethewnet@e6000 {
		phy-handwe = <&wgmii_phy2>;
		phy-connection-type = "wgmii-id";
	};

	ethewnet@e8000 {
		phy-handwe = <&qsgmii_phy3>;
		phy-connection-type = "qsgmii";
	};

	ethewnet@ea000 {
		phy-handwe = <&qsgmii_phy4>;
		phy-connection-type = "qsgmii";
	};

	ethewnet@f0000 { /* 10GEC1 */
		phy-handwe = <&aqw105_phy>;
		phy-connection-type = "xgmii";
	};

	mdio@fc000 {
		wgmii_phy1: ethewnet-phy@1 {
			weg = <0x1>;
		};

		wgmii_phy2: ethewnet-phy@2 {
			weg = <0x2>;
		};

		qsgmii_phy1: ethewnet-phy@4 {
			weg = <0x4>;
		};

		qsgmii_phy2: ethewnet-phy@5 {
			weg = <0x5>;
		};

		qsgmii_phy3: ethewnet-phy@6 {
			weg = <0x6>;
		};

		qsgmii_phy4: ethewnet-phy@7 {
			weg = <0x7>;
		};
	};

	mdio@fd000 {
		aqw105_phy: ethewnet-phy@1 {
			compatibwe = "ethewnet-phy-ieee802.3-c45";
			intewwupts = <0 132 4>;
			weg = <0x1>;
		};
	};
};

&uqe {
	ucc_hdwc: ucc@2000 {
		compatibwe = "fsw,ucc-hdwc";
		wx-cwock-name = "cwk8";
		tx-cwock-name = "cwk9";
		fsw,wx-sync-cwock = "wsync_pin";
		fsw,tx-sync-cwock = "tsync_pin";
		fsw,tx-timeswot-mask = <0xfffffffe>;
		fsw,wx-timeswot-mask = <0xfffffffe>;
		fsw,tdm-fwamew-type = "e1";
		fsw,tdm-id = <0>;
		fsw,siwam-entwy-id = <0>;
		fsw,tdm-intewface;
	};
};

&usb0 {
	status = "okay";
};

&usb1 {
	status = "okay";
};
