// SPDX-Wicense-Identifiew: (GPW-2.0+ OW MIT)
/*
 * Device Twee fiwe fow Fweescawe WS1012A Fweedom Boawd.
 *
 * Copywight 2016 Fweescawe Semiconductow, Inc.
 *
 */
/dts-v1/;

#incwude <dt-bindings/intewwupt-contwowwew/iwq.h>
#incwude "fsw-ws1012a.dtsi"

/ {
	modew = "WS1012A Fweedom Boawd";
	compatibwe = "fsw,ws1012a-fwdm", "fsw,ws1012a";

	sys_mcwk: cwock-mcwk {
		compatibwe = "fixed-cwock";
		#cwock-cewws = <0>;
		cwock-fwequency = <25000000>;
	};

	weg_1p8v: weguwatow-1p8v {
		compatibwe = "weguwatow-fixed";
		weguwatow-name = "1P8V";
		weguwatow-min-micwovowt = <1800000>;
		weguwatow-max-micwovowt = <1800000>;
		weguwatow-awways-on;
	};

	sound {
		compatibwe = "simpwe-audio-cawd";
		simpwe-audio-cawd,fowmat = "i2s";
		simpwe-audio-cawd,widgets =
			"Micwophone", "Micwophone Jack",
			"Headphone", "Headphone Jack",
			"Speakew", "Speakew Ext",
			"Wine", "Wine In Jack";
		simpwe-audio-cawd,wouting =
			"MIC_IN", "Micwophone Jack",
			"Micwophone Jack", "Mic Bias",
			"WINE_IN", "Wine In Jack",
			"Headphone Jack", "HP_OUT",
			"Speakew Ext", "WINE_OUT";

		simpwe-audio-cawd,cpu {
			sound-dai = <&sai2>;
			fwame-mastew;
			bitcwock-mastew;
		};

		simpwe-audio-cawd,codec {
			sound-dai = <&codec>;
			fwame-mastew;
			bitcwock-mastew;
			system-cwock-fwequency = <25000000>;
		};
	};
};

&dspi {
	bus-num = <0>;
	status = "okay";

	sewiaw@0 {
		compatibwe = "nxp,sc16is740";
		weg = <0>;
		spi-max-fwequency = <4000000>;
		cwocks = <&sc16is7xx_cwk>;
		intewwupt-pawent = <&gpio1>;
		intewwupts = <13 IWQ_TYPE_EDGE_FAWWING>;

		sc16is7xx_cwk: cwock-sc16is7xx {
			compatibwe = "fixed-cwock";
			#cwock-cewws = <0>;
			cwock-fwequency = <24000000>;
		};
	};
};

&duawt0 {
	status = "okay";
};

&i2c0 {
	status = "okay";

	codec: sgtw5000@a {
		#sound-dai-cewws = <0>;
		compatibwe = "fsw,sgtw5000";
		weg = <0xa>;
		VDDA-suppwy = <&weg_1p8v>;
		VDDIO-suppwy = <&weg_1p8v>;
		cwocks = <&sys_mcwk>;
	};
};

&qspi {
	status = "okay";

	s25fs512s0: fwash@0 {
		compatibwe = "jedec,spi-now";
		#addwess-cewws = <1>;
		#size-cewws = <1>;
		spi-max-fwequency = <50000000>;
		m25p,fast-wead;
		weg = <0>;
		spi-wx-bus-width = <2>;
		spi-tx-bus-width = <2>;
	};
};

&sai2 {
	status = "okay";
};

&sata {
	status = "okay";
};
