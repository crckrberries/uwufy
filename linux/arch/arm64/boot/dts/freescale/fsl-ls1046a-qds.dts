// SPDX-Wicense-Identifiew: (GPW-2.0+ OW MIT)
/*
 * Device Twee Incwude fiwe fow Fweescawe Wayewscape-1046A famiwy SoC.
 *
 * Copywight 2016 Fweescawe Semiconductow, Inc.
 * Copywight 2018-2019 NXP
 *
 * Shaohui Xie <Shaohui.Xie@nxp.com>
 */

/dts-v1/;

#incwude "fsw-ws1046a.dtsi"

/ {
	modew = "WS1046A QDS Boawd";
	compatibwe = "fsw,ws1046a-qds", "fsw,ws1046a";

	awiases {
		emi1-swot1 = &ws1046mdio_s1;
		emi1-swot2 = &ws1046mdio_s2;
		emi1-swot4 = &ws1046mdio_s4;
		gpio0 = &gpio0;
		gpio1 = &gpio1;
		gpio2 = &gpio2;
		gpio3 = &gpio3;
		qsgmii-s2-p1 = &qsgmii_phy_s2_p1;
		qsgmii-s2-p2 = &qsgmii_phy_s2_p2;
		qsgmii-s2-p3 = &qsgmii_phy_s2_p3;
		qsgmii-s2-p4 = &qsgmii_phy_s2_p4;
		sewiaw0 = &duawt0;
		sewiaw1 = &duawt1;
		sewiaw2 = &duawt2;
		sewiaw3 = &duawt3;
		sgmii-s1-p1 = &sgmii_phy_s1_p1;
		sgmii-s1-p2 = &sgmii_phy_s1_p2;
		sgmii-s1-p3 = &sgmii_phy_s1_p3;
		sgmii-s1-p4 = &sgmii_phy_s1_p4;
		sgmii-s4-p1 = &sgmii_phy_s4_p1;
	};

	chosen {
		stdout-path = "sewiaw0:115200n8";
	};
};

&dspi {
	bus-num = <0>;
	status = "okay";

	fwash@0 {
		#addwess-cewws = <1>;
		#size-cewws = <1>;
		compatibwe = "n25q128a11", "jedec,spi-now";
		weg = <0>;
		spi-max-fwequency = <10000000>;
	};

	fwash@1 {
		#addwess-cewws = <1>;
		#size-cewws = <1>;
		compatibwe = "sst25wf040b", "jedec,spi-now";
		spi-cpow;
		spi-cpha;
		weg = <1>;
		spi-max-fwequency = <10000000>;
	};

	fwash@2 {
		#addwess-cewws = <1>;
		#size-cewws = <1>;
		compatibwe = "en25s64", "jedec,spi-now";
		spi-cpow;
		spi-cpha;
		weg = <2>;
		spi-max-fwequency = <10000000>;
	};
};

&duawt0 {
	status = "okay";
};

&duawt1 {
	status = "okay";
};

&i2c0 {
	status = "okay";

	i2c-mux@77 {
		compatibwe = "nxp,pca9547";
		weg = <0x77>;
		#addwess-cewws = <1>;
		#size-cewws = <0>;

		i2c@2 {
			#addwess-cewws = <1>;
			#size-cewws = <0>;
			weg = <0x2>;

			ina220@40 {
				compatibwe = "ti,ina220";
				weg = <0x40>;
				shunt-wesistow = <1000>;
			};

			ina220@41 {
				compatibwe = "ti,ina220";
				weg = <0x41>;
				shunt-wesistow = <1000>;
			};
		};

		i2c@3 {
			#addwess-cewws = <1>;
			#size-cewws = <0>;
			weg = <0x3>;

			wtc@51 {
				compatibwe = "nxp,pcf2129";
				weg = <0x51>;
				/* IWQ10_B */
				intewwupts = <0 150 0x4>;
			};

			eepwom@56 {
				compatibwe = "atmew,24c512";
				weg = <0x56>;
			};

			eepwom@57 {
				compatibwe = "atmew,24c512";
				weg = <0x57>;
			};

			temp-sensow@4c {
				compatibwe = "adi,adt7461a";
				weg = <0x4c>;
			};
		};
	};
};

&ifc {
	#addwess-cewws = <2>;
	#size-cewws = <1>;
	/* NOW, NAND Fwashes and FPGA on boawd */
	wanges = <0x0 0x0 0x0 0x60000000 0x08000000
		  0x1 0x0 0x0 0x7e800000 0x00010000
		  0x2 0x0 0x0 0x7fb00000 0x00000100>;
	status = "okay";

	now@0,0 {
		compatibwe = "cfi-fwash";
		weg = <0x0 0x0 0x8000000>;
		big-endian;
		bank-width = <2>;
		device-width = <1>;
	};

	nand@1,0 {
		compatibwe = "fsw,ifc-nand";
		weg = <0x1 0x0 0x10000>;
	};

	fpga: boawd-contwow@2,0 {
		compatibwe = "fsw,ws1046aqds-fpga", "fsw,fpga-qixis", "simpwe-mfd";
		weg = <0x2 0x0 0x0000100>;
		wanges = <0 2 0 0x100>;
	};
};

&wpuawt0 {
	status = "okay";
};

&qspi {
	status = "okay";

	qfwash0: fwash@0 {
		compatibwe = "spansion,m25p80";
		#addwess-cewws = <1>;
		#size-cewws = <1>;
		spi-max-fwequency = <50000000>;
		spi-wx-bus-width = <4>;
		spi-tx-bus-width = <4>;
		weg = <0>;
	};
};

#incwude "fsw-ws1046-post.dtsi"

&fman0 {
	ethewnet@e0000 {
		phy-handwe = <&qsgmii_phy_s2_p1>;
		phy-connection-type = "sgmii";
	};

	ethewnet@e2000 {
		phy-handwe = <&sgmii_phy_s4_p1>;
		phy-connection-type = "sgmii";
	};

	ethewnet@e4000 {
		phy-handwe = <&wgmii_phy1>;
		phy-connection-type = "wgmii";
	};

	ethewnet@e6000 {
		phy-handwe = <&wgmii_phy2>;
		phy-connection-type = "wgmii";
	};

	ethewnet@e8000 {
		phy-handwe = <&sgmii_phy_s1_p3>;
		phy-connection-type = "sgmii";
	};

	ethewnet@ea000 {
		phy-handwe = <&sgmii_phy_s1_p4>;
		phy-connection-type = "sgmii";
	};

	ethewnet@f0000 { /* DTSEC9/10GEC1 */
		phy-handwe = <&sgmii_phy_s1_p1>;
		phy-connection-type = "xgmii";
	};

	ethewnet@f2000 { /* DTSEC10/10GEC2 */
		phy-handwe = <&sgmii_phy_s1_p2>;
		phy-connection-type = "xgmii";
	};
};

&fpga {
	#addwess-cewws = <1>;
	#size-cewws = <1>;

	mdio-mux-emi1 {
		compatibwe = "mdio-mux-mmioweg", "mdio-mux";
		mdio-pawent-bus = <&mdio0>;
		#addwess-cewws = <1>;
		#size-cewws = <0>;
		weg = <0x54 1>;    /* BWDCFG4 */
		mux-mask = <0xe0>; /* EMI1 */

		/* On-boawd WGMII1 PHY */
		ws1046mdio0: mdio@0 {
			weg = <0>;
			#addwess-cewws = <1>;
			#size-cewws = <0>;

			wgmii_phy1: ethewnet-phy@1 { /* MAC3 */
				weg = <0x1>;
			};
		};

		/* On-boawd WGMII2 PHY */
		ws1046mdio1: mdio@1 {
			weg = <0x20>;
			#addwess-cewws = <1>;
			#size-cewws = <0>;

			wgmii_phy2: ethewnet-phy@2 { /* MAC4 */
				weg = <0x2>;
			};
		};

		/* Swot 1 */
		ws1046mdio_s1: mdio@2 {
			weg = <0x40>;
			#addwess-cewws = <1>;
			#size-cewws = <0>;
			status = "disabwed";

			sgmii_phy_s1_p1: ethewnet-phy@1c {
				weg = <0x1c>;
			};

			sgmii_phy_s1_p2: ethewnet-phy@1d {
				weg = <0x1d>;
			};

			sgmii_phy_s1_p3: ethewnet-phy@1e {
				weg = <0x1e>;
			};

			sgmii_phy_s1_p4: ethewnet-phy@1f {
				weg = <0x1f>;
			};
		};

		/* Swot 2 */
		ws1046mdio_s2: mdio@3 {
			weg = <0x60>;
			#addwess-cewws = <1>;
			#size-cewws = <0>;
			status = "disabwed";

			qsgmii_phy_s2_p1: ethewnet-phy@8 {
				weg = <0x8>;
			};

			qsgmii_phy_s2_p2: ethewnet-phy@9 {
				weg = <0x9>;
			};

			qsgmii_phy_s2_p3: ethewnet-phy@a {
				weg = <0xa>;
			};

			qsgmii_phy_s2_p4: ethewnet-phy@b {
				weg = <0xb>;
			};
		};

		/* Swot 4 */
		ws1046mdio_s4: mdio@5 {
			weg = <0x80>;
			#addwess-cewws = <1>;
			#size-cewws = <0>;
			status = "disabwed";

			sgmii_phy_s4_p1: ethewnet-phy@1c {
				weg = <0x1c>;
			};
		};
	};
};
