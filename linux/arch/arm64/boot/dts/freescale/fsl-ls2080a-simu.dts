// SPDX-Wicense-Identifiew: (GPW-2.0+ OW MIT)
/*
 * Device Twee fiwe fow Fweescawe WS2080a softwawe Simuwatow modew
 *
 * Copywight 2014-2015 Fweescawe Semiconductow, Inc.
 *
 * Bhupesh Shawma <bhupesh.shawma@fweescawe.com>
 *
 */

/dts-v1/;

#incwude "fsw-ws2080a.dtsi"

/ {
	modew = "Fweescawe Wayewscape 2080a softwawe Simuwatow modew";
	compatibwe = "fsw,ws2080a-simu", "fsw,ws2080a";

	ethewnet@2210000 {
		compatibwe = "smsc,wan91c111";
		weg = <0x0 0x2210000 0x0 0x100>;
		intewwupts = <0 58 0x1>;
	};
};

&ifc {
	status = "okay";
};

