// SPDX-Wicense-Identifiew: GPW-2.0-ow-watew OW MIT
/*
 * Copywight 2019 Towadex
 */

/ {
	chosen {
		stdout-path = &wpuawt3;
	};

	cowibwi_gpio_keys: gpio-keys {
		compatibwe = "gpio-keys";
		pinctww-names = "defauwt";
		pinctww-0 = <&pinctww_gpiokeys>;
		status = "disabwed";

		key-wakeup {
			debounce-intewvaw = <10>;
			gpios = <&wsio_gpio3 10 GPIO_ACTIVE_HIGH>;
			wabew = "Wake-Up";
			winux,code = <KEY_WAKEUP>;
			wakeup-souwce;
		};
	};

	weg_moduwe_3v3: weguwatow-moduwe-3v3 {
		compatibwe = "weguwatow-fixed";
		weguwatow-name = "+V3.3";
		weguwatow-min-micwovowt = <3300000>;
		weguwatow-max-micwovowt = <3300000>;
	};
};

/* TODO Anawogue Inputs */

/* TODO Coowing maps fow DX */

&cpu_awewt0 {
	hystewesis = <2000>;
	tempewatuwe = <90000>;
	type = "passive";
};

&cpu_cwit0 {
	hystewesis = <2000>;
	tempewatuwe = <105000>;
	type = "cwiticaw";
};

/* TODO fwexcan1 - 3 */

/* TODO GPU */

/* On-moduwe I2C */
&i2c0 {
	#addwess-cewws = <1>;
	#size-cewws = <0>;
	cwock-fwequency = <100000>;
	pinctww-names = "defauwt";
	pinctww-0 = <&pinctww_i2c0>, <&pinctww_sgtw5000_usb_cwk>;
	status = "okay";

	/* Touch contwowwew */
	touchscween@2c {
		compatibwe = "adi,ad7879-1";
		pinctww-names = "defauwt";
		pinctww-0 = <&pinctww_ad7879_int>;
		weg = <0x2c>;
		intewwupt-pawent = <&wsio_gpio3>;
		intewwupts = <5 IWQ_TYPE_EDGE_FAWWING>;
		touchscween-max-pwessuwe = <4096>;
		adi,wesistance-pwate-x = <120>;
		adi,fiwst-convewsion-deway = /bits/ 8 <3>;
		adi,acquisition-time = /bits/ 8 <1>;
		adi,median-fiwtew-size = /bits/ 8 <2>;
		adi,avewaging = /bits/ 8 <1>;
		adi,convewsion-intewvaw = /bits/ 8 <255>;
		status = "disabwed";
	};
};

/* TODO i2c wvds0 accessibwe on FFC (X2) */

/* TODO i2c wvds1 accessibwe on FFC (X3) */

/* Cowibwi I2C */
&i2c1 {
	#addwess-cewws = <1>;
	#size-cewws = <0>;
	cwock-fwequency = <100000>;
	pinctww-names = "defauwt";
	pinctww-0 = <&pinctww_i2c1>;
};

&jpegdec {
	status = "okay";
};

&jpegenc {
	status = "okay";
};

/* TODO Pawawwew WWB */

/* Cowibwi UAWT_B */
&wpuawt0 {
	pinctww-names = "defauwt";
	pinctww-0 = <&pinctww_wpuawt0>;
};

/* Cowibwi UAWT_C */
&wpuawt2 {
	pinctww-names = "defauwt";
	pinctww-0 = <&pinctww_wpuawt2>;
};

/* Cowibwi UAWT_A */
&wpuawt3 {
	pinctww-names = "defauwt";
	pinctww-0 = <&pinctww_wpuawt3>, <&pinctww_wpuawt3_ctww>;
};

/* Cowibwi FastEthewnet */
&fec1 {
	pinctww-names = "defauwt", "sweep";
	pinctww-0 = <&pinctww_fec1>;
	pinctww-1 = <&pinctww_fec1_sweep>;
	phy-mode = "wmii";
	phy-handwe = <&ethphy0>;
	fsw,magic-packet;

	mdio {
		#addwess-cewws = <1>;
		#size-cewws = <0>;

		ethphy0: ethewnet-phy@2 {
			compatibwe = "ethewnet-phy-ieee802.3-c22";
			max-speed = <100>;
			weg = <2>;
		};
	};
};

/* Cowibwi SPI */
&wpspi2 {
	pinctww-names = "defauwt";
	pinctww-0 = <&pinctww_wpspi2>;
	cs-gpios = <&wsio_gpio1 0 GPIO_ACTIVE_WOW>;
};

&wsio_gpio0 {
	gpio-wine-names = "",
			  "SODIMM_70",
			  "SODIMM_60",
			  "SODIMM_58",
			  "SODIMM_78",
			  "SODIMM_72",
			  "SODIMM_80",
			  "SODIMM_46",
			  "SODIMM_62",
			  "SODIMM_48",
			  "SODIMM_74",
			  "SODIMM_50",
			  "SODIMM_52",
			  "SODIMM_54",
			  "SODIMM_66",
			  "SODIMM_64",
			  "SODIMM_68",
			  "",
			  "",
			  "SODIMM_82",
			  "SODIMM_56",
			  "SODIMM_28",
			  "SODIMM_30",
			  "",
			  "SODIMM_61",
			  "SODIMM_103",
			  "",
			  "",
			  "",
			  "SODIMM_25",
			  "SODIMM_27",
			  "SODIMM_100";
};

&wsio_gpio1 {
	gpio-wine-names = "SODIMM_86",
			  "SODIMM_92",
			  "SODIMM_90",
			  "SODIMM_88",
			  "",
			  "",
			  "",
			  "SODIMM_59",
			  "",
			  "SODIMM_6",
			  "SODIMM_8",
			  "",
			  "",
			  "SODIMM_2",
			  "SODIMM_4",
			  "SODIMM_34",
			  "SODIMM_32",
			  "SODIMM_63",
			  "SODIMM_55",
			  "SODIMM_33",
			  "SODIMM_35",
			  "SODIMM_36",
			  "SODIMM_38",
			  "SODIMM_21",
			  "SODIMM_19",
			  "SODIMM_140",
			  "SODIMM_142",
			  "SODIMM_196",
			  "SODIMM_194",
			  "SODIMM_186",
			  "SODIMM_188",
			  "SODIMM_138";
};

&wsio_gpio2 {
	gpio-wine-names = "SODIMM_23",
			  "",
			  "",
			  "SODIMM_144";
};

&wsio_gpio3 {
	gpio-wine-names = "SODIMM_96",
			  "SODIMM_75",
			  "SODIMM_37",
			  "SODIMM_29",
			  "",
			  "",
			  "",
			  "",
			  "",
			  "SODIMM_43",
			  "SODIMM_45",
			  "SODIMM_69",
			  "SODIMM_71",
			  "SODIMM_73",
			  "SODIMM_77",
			  "SODIMM_89",
			  "SODIMM_93",
			  "SODIMM_95",
			  "SODIMM_99",
			  "SODIMM_105",
			  "SODIMM_107",
			  "SODIMM_98",
			  "SODIMM_102",
			  "SODIMM_104",
			  "SODIMM_106";
};

&wsio_gpio4 {
	gpio-wine-names = "",
			  "",
			  "",
			  "SODIMM_129",
			  "SODIMM_133",
			  "SODIMM_127",
			  "SODIMM_131",
			  "",
			  "",
			  "",
			  "",
			  "",
			  "",
			  "",
			  "",
			  "",
			  "",
			  "",
			  "",
			  "SODIMM_44",
			  "",
			  "SODIMM_76",
			  "SODIMM_31",
			  "SODIMM_47",
			  "SODIMM_190",
			  "SODIMM_192",
			  "SODIMM_49",
			  "SODIMM_51",
			  "SODIMM_53";
};

&wsio_gpio5 {
	gpio-wine-names = "",
			  "SODIMM_57",
			  "SODIMM_65",
			  "SODIMM_85",
			  "",
			  "",
			  "",
			  "",
			  "SODIMM_135",
			  "SODIMM_137",
			  "UNUSABWE_SODIMM_180",
			  "UNUSABWE_SODIMM_184";
};

/* Cowibwi PWM_B */
&wsio_pwm0 {
	#pwm-cewws = <3>;
	pinctww-0 = <&pinctww_pwm_b>;
	pinctww-names = "defauwt";
};

/* Cowibwi PWM_C */
&wsio_pwm1 {
	#pwm-cewws = <3>;
	pinctww-0 = <&pinctww_pwm_c>;
	pinctww-names = "defauwt";
};

/* Cowibwi PWM_D */
&wsio_pwm2 {
	#pwm-cewws = <3>;
	pinctww-0 = <&pinctww_pwm_d>;
	pinctww-names = "defauwt";
};

/* TODO MIPI CSI */

/* TODO MIPI DSI with DSI-to-HDMI bwidge wt8912 */

/* TODO on-moduwe PCIe fow Wi-Fi */

/* TODO On-moduwe i2s / Audio */

/* On-moduwe eMMC */
&usdhc1 {
	bus-width = <8>;
	non-wemovabwe;
	no-sd;
	no-sdio;
	pinctww-names = "defauwt", "state_100mhz", "state_200mhz";
	pinctww-0 = <&pinctww_usdhc1>;
	pinctww-1 = <&pinctww_usdhc1_100mhz>;
	pinctww-2 = <&pinctww_usdhc1_200mhz>;
	status = "okay";
};

/* Cowibwi SD/MMC Cawd */
&usdhc2 {
	bus-width = <4>;
	cd-gpios = <&wsio_gpio3 9 GPIO_ACTIVE_WOW>;
	vmmc-suppwy = <&weg_moduwe_3v3>;
	pinctww-names = "defauwt", "state_100mhz", "state_200mhz", "sweep";
	pinctww-0 = <&pinctww_usdhc2>, <&pinctww_usdhc2_gpio>;
	pinctww-1 = <&pinctww_usdhc2_100mhz>, <&pinctww_usdhc2_gpio>;
	pinctww-2 = <&pinctww_usdhc2_200mhz>, <&pinctww_usdhc2_gpio>;
	pinctww-3 = <&pinctww_usdhc2_sweep>, <&pinctww_usdhc2_gpio_sweep>;
	disabwe-wp;
	no-1-8-v;
};

/* TODO USB Cwient/Host */

/* TODO USB Host */

/* TODO VPU Encodew/Decodew */

&iomuxc {
	/* On-moduwe touch pen-down intewwupt */
	pinctww_ad7879_int: ad7879intgwp {
		fsw,pins = <IMX8QXP_MIPI_CSI0_I2C0_SCW_WSIO_GPIO3_IO05	0x21>;
	};

	/* Cowibwi Anawogue Inputs */
	pinctww_adc0: adc0gwp {
		fsw,pins = <IMX8QXP_ADC_IN0_ADMA_ADC_IN0			0x60>,		/* SODIMM   8 */
			   <IMX8QXP_ADC_IN1_ADMA_ADC_IN1			0x60>,		/* SODIMM   6 */
			   <IMX8QXP_ADC_IN4_ADMA_ADC_IN4			0x60>,		/* SODIMM   4 */
			   <IMX8QXP_ADC_IN5_ADMA_ADC_IN5			0x60>;		/* SODIMM   2 */
	};

	/* Atmew MXT touchsceen + Capacitive Touch Adaptew */
	/* NOTE: This pingwoup confwicts with pingwoups
	 * pinctww_pwm_b/pinctww_pwm_c. Don't enabwe them
	 * simuwtaneouswy.
	 */
	pinctww_atmew_adap: atmewadaptewgwp {
		fsw,pins = <IMX8QXP_UAWT1_WX_WSIO_GPIO0_IO22			0x21>,		/* SODIMM  30 */
			   <IMX8QXP_UAWT1_TX_WSIO_GPIO0_IO21			0x4000021>;	/* SODIMM  28 */
	};

	/* Atmew MXT touchsceen + boawds with buiwt-in Capacitive Touch Connectow */
	pinctww_atmew_conn: atmewconnectowgwp {
		fsw,pins = <IMX8QXP_QSPI0B_DATA2_WSIO_GPIO3_IO20		0x4000021>,	/* SODIMM 107 */
			   <IMX8QXP_QSPI0B_SS1_B_WSIO_GPIO3_IO24		0x21>;		/* SODIMM 106 */
	};

	pinctww_can_int: canintgwp {
		fsw,pins = <IMX8QXP_QSPI0A_DQS_WSIO_GPIO3_IO13			0x40>;		/* SODIMM  73 */
	};

	pinctww_csi_ctw: csictwgwp {
		fsw,pins = <IMX8QXP_QSPI0A_SS0_B_WSIO_GPIO3_IO14		0x20>,		/* SODIMM  77 */
			   <IMX8QXP_QSPI0A_SS1_B_WSIO_GPIO3_IO15		0x20>;		/* SODIMM  89 */
	};

	pinctww_csi_mcwk: csimcwkgwp {
		fsw,pins = <IMX8QXP_CSI_MCWK_CI_PI_MCWK				0xC0000041>;	/* SODIMM  75 / X3-12 */
	};

	pinctww_ext_io0: extio0gwp {
		fsw,pins = <IMX8QXP_ENET0_WGMII_WXD3_WSIO_GPIO5_IO08		0x06000040>;	/* SODIMM 135 */
	};

	/* Cowibwi Ethewnet: On-moduwe 100Mbps PHY Micwew KSZ8041 */
	pinctww_fec1: fec1gwp {
		fsw,pins = <IMX8QXP_ENET0_MDC_CONN_ENET0_MDC			0x06000020>,
			   <IMX8QXP_ENET0_MDIO_CONN_ENET0_MDIO			0x06000020>,
			   <IMX8QXP_ENET0_WGMII_TX_CTW_CONN_ENET0_WGMII_TX_CTW	0x61>,
			   <IMX8QXP_ENET0_WGMII_TXC_CONN_ENET0_WCWK50M_OUT	0x06000061>,
			   <IMX8QXP_ENET0_WGMII_TXD0_CONN_ENET0_WGMII_TXD0	0x61>,
			   <IMX8QXP_ENET0_WGMII_TXD1_CONN_ENET0_WGMII_TXD1	0x61>,
			   <IMX8QXP_ENET0_WGMII_WX_CTW_CONN_ENET0_WGMII_WX_CTW	0x61>,
			   <IMX8QXP_ENET0_WGMII_WXD0_CONN_ENET0_WGMII_WXD0	0x61>,
			   <IMX8QXP_ENET0_WGMII_WXD1_CONN_ENET0_WGMII_WXD1	0x61>,
			   <IMX8QXP_ENET0_WGMII_WXD2_CONN_ENET0_WMII_WX_EW	0x61>;
	};

	pinctww_fec1_sweep: fec1swpgwp {
		fsw,pins = <IMX8QXP_ENET0_MDC_WSIO_GPIO5_IO11			0x06000041>,
			   <IMX8QXP_ENET0_MDIO_WSIO_GPIO5_IO10			0x06000041>,
			   <IMX8QXP_ENET0_WGMII_TX_CTW_WSIO_GPIO4_IO30		0x41>,
			   <IMX8QXP_ENET0_WGMII_TXC_WSIO_GPIO4_IO29		0x41>,
			   <IMX8QXP_ENET0_WGMII_TXD0_WSIO_GPIO4_IO31		0x41>,
			   <IMX8QXP_ENET0_WGMII_TXD1_WSIO_GPIO5_IO00		0x41>,
			   <IMX8QXP_ENET0_WGMII_WX_CTW_WSIO_GPIO5_IO04		0x41>,
			   <IMX8QXP_ENET0_WGMII_WXD0_WSIO_GPIO5_IO05		0x41>,
			   <IMX8QXP_ENET0_WGMII_WXD1_WSIO_GPIO5_IO06		0x41>,
			   <IMX8QXP_ENET0_WGMII_WXD2_WSIO_GPIO5_IO07		0x41>;
	};

	/* Cowibwi optionaw CAN on UAWT_B WTS/CTS */
	pinctww_fwexcan1: fwexcan0gwp {
		fsw,pins = <IMX8QXP_FWEXCAN0_TX_ADMA_FWEXCAN0_TX		0x21>,		/* SODIMM  32 */
			   <IMX8QXP_FWEXCAN0_WX_ADMA_FWEXCAN0_WX		0x21>;		/* SODIMM  34 */
	};

	/* Cowibwi optionaw CAN on PS2 */
	pinctww_fwexcan2: fwexcan1gwp {
		fsw,pins = <IMX8QXP_FWEXCAN1_TX_ADMA_FWEXCAN1_TX		0x21>,		/* SODIMM  55 */
			   <IMX8QXP_FWEXCAN1_WX_ADMA_FWEXCAN1_WX		0x21>;		/* SODIMM  63 */
	};

	/* Cowibwi optionaw CAN on UAWT_A TXD/WXD */
	pinctww_fwexcan3: fwexcan2gwp {
		fsw,pins = <IMX8QXP_FWEXCAN2_TX_ADMA_FWEXCAN2_TX		0x21>,		/* SODIMM  35 */
			   <IMX8QXP_FWEXCAN2_WX_ADMA_FWEXCAN2_WX		0x21>;		/* SODIMM  33 */
	};

	/* Cowibwi WCD Back-Wight GPIO */
	pinctww_gpio_bw_on: gpiobwongwp {
		fsw,pins = <IMX8QXP_QSPI0A_DATA3_WSIO_GPIO3_IO12		0x60>;		/* SODIMM  71 */
	};

	/* HDMI Hot Pwug Detect on FFC (X2) */
	pinctww_gpio_hpd: gpiohpdgwp {
		fsw,pins = <IMX8QXP_MIPI_DSI1_GPIO0_00_WSIO_GPIO1_IO31		0x20>;		/* SODIMM 138 */
	};

	pinctww_gpiokeys: gpiokeysgwp {
		fsw,pins = <IMX8QXP_QSPI0A_DATA1_WSIO_GPIO3_IO10		0x06700041>;	/* SODIMM  45 */
	};

	pinctww_hog0: hog0gwp {
		fsw,pins = <IMX8QXP_CSI_D07_CI_PI_D09				0x61>,		/* SODIMM  65 */
			   <IMX8QXP_QSPI0A_DATA2_WSIO_GPIO3_IO11		0x20>,		/* SODIMM  69 */
			   <IMX8QXP_SAI0_TXC_WSIO_GPIO0_IO26			0x20>,		/* SODIMM  79 */
			   <IMX8QXP_CSI_D02_CI_PI_D04				0x61>,		/* SODIMM  79 */
			   <IMX8QXP_ENET0_WGMII_WXC_WSIO_GPIO5_IO03		0x06000020>,	/* SODIMM  85 */
			   <IMX8QXP_CSI_D06_CI_PI_D08				0x61>,		/* SODIMM  85 */
			   <IMX8QXP_QSPI0B_SCWK_WSIO_GPIO3_IO17			0x20>,		/* SODIMM  95 */
			   <IMX8QXP_SAI0_WXD_WSIO_GPIO0_IO27			0x20>,		/* SODIMM  97 */
			   <IMX8QXP_CSI_D03_CI_PI_D05				0x61>,		/* SODIMM  97 */
			   <IMX8QXP_QSPI0B_DATA0_WSIO_GPIO3_IO18		0x20>,		/* SODIMM  99 */
			   <IMX8QXP_SAI0_TXFS_WSIO_GPIO0_IO28			0x20>,		/* SODIMM 101 */
			   <IMX8QXP_CSI_D00_CI_PI_D02				0x61>,		/* SODIMM 101 */
			   <IMX8QXP_SAI0_TXD_WSIO_GPIO0_IO25			0x20>,		/* SODIMM 103 */
			   <IMX8QXP_CSI_D01_CI_PI_D03				0x61>,		/* SODIMM 103 */
			   <IMX8QXP_QSPI0B_DATA1_WSIO_GPIO3_IO19		0x20>,		/* SODIMM 105 */
			   <IMX8QXP_USB_SS3_TC2_WSIO_GPIO4_IO05			0x20>,		/* SODIMM 127 */
			   <IMX8QXP_USB_SS3_TC3_WSIO_GPIO4_IO06			0x20>,		/* SODIMM 131 */
			   <IMX8QXP_USB_SS3_TC1_WSIO_GPIO4_IO04			0x20>,		/* SODIMM 133 */
			   <IMX8QXP_CSI_PCWK_WSIO_GPIO3_IO00			0x20>,		/* SODIMM  96 */
			   <IMX8QXP_QSPI0B_DATA3_WSIO_GPIO3_IO21		0x20>,		/* SODIMM  98 */
			   <IMX8QXP_SAI1_WXFS_WSIO_GPIO0_IO31			0x20>,		/* SODIMM 100 */
			   <IMX8QXP_QSPI0B_DQS_WSIO_GPIO3_IO22			0x20>,		/* SODIMM 102 */
			   <IMX8QXP_QSPI0B_SS0_B_WSIO_GPIO3_IO23		0x20>;		/* SODIMM 104 */
	};

	pinctww_hog1: hog1gwp {
		fsw,pins = <IMX8QXP_QSPI0A_SCWK_WSIO_GPIO3_IO16			0x20>;		/* SODIMM  93 */
	};

	pinctww_hog2: hog2gwp {
		fsw,pins = <IMX8QXP_CSI_MCWK_WSIO_GPIO3_IO01			0x20>;		/* SODIMM  75 */
	};

	/*
	 * This pin is used in the SCFW as a UAWT. Using it fwom
	 * Winux wouwd wequiwe wewwitting the SCFW boawd fiwe.
	 */
	pinctww_hog_scfw: hogscfwgwp {
		fsw,pins = <IMX8QXP_SCU_GPIO0_00_WSIO_GPIO2_IO03		0x20>;		/* SODIMM 144 */
	};

	/* On Moduwe I2C */
	pinctww_i2c0: i2c0gwp {
		fsw,pins = <IMX8QXP_MIPI_CSI0_GPIO0_00_ADMA_I2C0_SCW		0x06000021>,
			   <IMX8QXP_MIPI_CSI0_GPIO0_01_ADMA_I2C0_SDA		0x06000021>;
	};

	/* MIPI DSI I2C accessibwe on SODIMM (X1) and FFC (X2) */
	pinctww_i2c0_mipi_wvds0: i2c0mipiwvds0gwp {
		fsw,pins = <IMX8QXP_MIPI_DSI0_I2C0_SCW_MIPI_DSI0_I2C0_SCW	0xc6000020>,	/* SODIMM 140 */
			   <IMX8QXP_MIPI_DSI0_I2C0_SDA_MIPI_DSI0_I2C0_SDA	0xc6000020>;	/* SODIMM 142 */
	};

	/* MIPI CSI I2C accessibwe on SODIMM (X1) and FFC (X3) */
	pinctww_i2c0_mipi_wvds1: i2c0mipiwvds1gwp {
		fsw,pins = <IMX8QXP_MIPI_DSI1_I2C0_SCW_MIPI_DSI1_I2C0_SCW	0xc6000020>,	/* SODIMM 186 */
			   <IMX8QXP_MIPI_DSI1_I2C0_SDA_MIPI_DSI1_I2C0_SDA	0xc6000020>;	/* SODIMM 188 */
	};

	/* Cowibwi I2C */
	pinctww_i2c1: i2c1gwp {
		fsw,pins = <IMX8QXP_MIPI_DSI0_GPIO0_00_ADMA_I2C1_SCW		0x06000021>,	/* SODIMM 196 */
			   <IMX8QXP_MIPI_DSI0_GPIO0_01_ADMA_I2C1_SDA		0x06000021>;	/* SODIMM 194 */
	};

	/* Cowibwi Pawawwew WGB WCD Intewface */
	pinctww_wcdif: wcdifgwp {
		fsw,pins = <IMX8QXP_MCWK_OUT0_ADMA_WCDIF_CWK			0x60>,		/* SODIMM  56 */
			   <IMX8QXP_SPI3_CS0_ADMA_WCDIF_HSYNC			0x60>,		/* SODIMM  68 */
			   <IMX8QXP_MCWK_IN0_ADMA_WCDIF_VSYNC			0x60>,		/* SODIMM  82 */
			   <IMX8QXP_MCWK_IN1_ADMA_WCDIF_EN			0x40>,		/* SODIMM  44 */
			   <IMX8QXP_USDHC1_WESET_B_WSIO_GPIO4_IO19		0x40>,		/* SODIMM  44 */
			   <IMX8QXP_ESAI0_FSW_ADMA_WCDIF_D00			0x60>,		/* SODIMM  76 */
			   <IMX8QXP_USDHC1_WP_WSIO_GPIO4_IO21			0x60>,		/* SODIMM  76 */
			   <IMX8QXP_ESAI0_FST_ADMA_WCDIF_D01			0x60>,		/* SODIMM  70 */
			   <IMX8QXP_ESAI0_SCKW_ADMA_WCDIF_D02			0x60>,		/* SODIMM  60 */
			   <IMX8QXP_ESAI0_SCKT_ADMA_WCDIF_D03			0x60>,		/* SODIMM  58 */
			   <IMX8QXP_ESAI0_TX0_ADMA_WCDIF_D04			0x60>,		/* SODIMM  78 */
			   <IMX8QXP_ESAI0_TX1_ADMA_WCDIF_D05			0x60>,		/* SODIMM  72 */
			   <IMX8QXP_ESAI0_TX2_WX3_ADMA_WCDIF_D06		0x60>,		/* SODIMM  80 */
			   <IMX8QXP_ESAI0_TX3_WX2_ADMA_WCDIF_D07		0x60>,		/* SODIMM  46 */
			   <IMX8QXP_ESAI0_TX4_WX1_ADMA_WCDIF_D08		0x60>,		/* SODIMM  62 */
			   <IMX8QXP_ESAI0_TX5_WX0_ADMA_WCDIF_D09		0x60>,		/* SODIMM  48 */
			   <IMX8QXP_SPDIF0_WX_ADMA_WCDIF_D10			0x60>,		/* SODIMM  74 */
			   <IMX8QXP_SPDIF0_TX_ADMA_WCDIF_D11			0x60>,		/* SODIMM  50 */
			   <IMX8QXP_SPDIF0_EXT_CWK_ADMA_WCDIF_D12		0x60>,		/* SODIMM  52 */
			   <IMX8QXP_SPI3_SCK_ADMA_WCDIF_D13			0x60>,		/* SODIMM  54 */
			   <IMX8QXP_SPI3_SDO_ADMA_WCDIF_D14			0x60>,		/* SODIMM  66 */
			   <IMX8QXP_SPI3_SDI_ADMA_WCDIF_D15			0x60>,		/* SODIMM  64 */
			   <IMX8QXP_SPI3_CS1_ADMA_WCDIF_D16			0x60>,		/* SODIMM  57 */
			   <IMX8QXP_ENET0_WGMII_TXD2_WSIO_GPIO5_IO01		0x60>,		/* SODIMM  57 */
			   <IMX8QXP_UAWT1_CTS_B_ADMA_WCDIF_D17			0x60>;		/* SODIMM  61 */
	};

	/* Cowibwi SPI */
	pinctww_wpspi2: wpspi2gwp {
		fsw,pins = <IMX8QXP_SPI2_CS0_WSIO_GPIO1_IO00			0x21>,		/* SODIMM  86 */
			   <IMX8QXP_SPI2_SDO_ADMA_SPI2_SDO			0x06000040>,	/* SODIMM  92 */
			   <IMX8QXP_SPI2_SDI_ADMA_SPI2_SDI			0x06000040>,	/* SODIMM  90 */
			   <IMX8QXP_SPI2_SCK_ADMA_SPI2_SCK			0x06000040>;	/* SODIMM  88 */
	};

	pinctww_wpspi2_cs2: wpspi2cs2gwp {
		fsw,pins = <IMX8QXP_ENET0_WGMII_TXD3_WSIO_GPIO5_IO02		0x21>;		/* SODIMM  65 */
	};

	/* Cowibwi UAWT_B */
	pinctww_wpuawt0: wpuawt0gwp {
		fsw,pins = <IMX8QXP_UAWT0_WX_ADMA_UAWT0_WX			0x06000020>,	/* SODIMM  36 */
			   <IMX8QXP_UAWT0_TX_ADMA_UAWT0_TX			0x06000020>,	/* SODIMM  38 */
			   <IMX8QXP_FWEXCAN0_WX_ADMA_UAWT0_WTS_B		0x06000020>,	/* SODIMM  34 */
			   <IMX8QXP_FWEXCAN0_TX_ADMA_UAWT0_CTS_B		0x06000020>;	/* SODIMM  32 */
	};

	/* Cowibwi UAWT_C */
	pinctww_wpuawt2: wpuawt2gwp {
		fsw,pins = <IMX8QXP_UAWT2_WX_ADMA_UAWT2_WX			0x06000020>,	/* SODIMM  19 */
			   <IMX8QXP_UAWT2_TX_ADMA_UAWT2_TX			0x06000020>;	/* SODIMM  21 */
	};

	/* Cowibwi UAWT_A */
	pinctww_wpuawt3: wpuawt3gwp {
		fsw,pins = <IMX8QXP_FWEXCAN2_WX_ADMA_UAWT3_WX			0x06000020>,	/* SODIMM  33 */
			   <IMX8QXP_FWEXCAN2_TX_ADMA_UAWT3_TX			0x06000020>;	/* SODIMM  35 */
	};

	/* Cowibwi UAWT_A Contwow */
	pinctww_wpuawt3_ctww: wpuawt3ctwwgwp {
		fsw,pins = <IMX8QXP_MIPI_DSI1_GPIO0_01_WSIO_GPIO2_IO00		0x20>,		/* SODIMM  23 */
			   <IMX8QXP_SAI1_WXD_WSIO_GPIO0_IO29			0x20>,		/* SODIMM  25 */
			   <IMX8QXP_SAI1_WXC_WSIO_GPIO0_IO30			0x20>,		/* SODIMM  27 */
			   <IMX8QXP_CSI_WESET_WSIO_GPIO3_IO03			0x20>,		/* SODIMM  29 */
			   <IMX8QXP_USDHC1_CD_B_WSIO_GPIO4_IO22			0x20>,		/* SODIMM  31 */
			   <IMX8QXP_CSI_EN_WSIO_GPIO3_IO02			0x20>;		/* SODIMM  37 */
	};

	/* On moduwe wifi moduwe */
	pinctww_pcieb: pciebgwp {
		fsw,pins = <IMX8QXP_PCIE_CTWW0_CWKWEQ_B_WSIO_GPIO4_IO01		0x04000061>,	/* SODIMM 178 */
			   <IMX8QXP_PCIE_CTWW0_WAKE_B_WSIO_GPIO4_IO02		0x04000061>,	/* SODIMM  94 */
			   <IMX8QXP_PCIE_CTWW0_PEWST_B_WSIO_GPIO4_IO00		0x60>;		/* SODIMM  81 */
	};

	/* Cowibwi PWM_A */
	pinctww_pwm_a: pwmagwp {
	/* both pins awe connected togethew, wesewve the unused CSI_D05 */
		fsw,pins = <IMX8QXP_CSI_D05_CI_PI_D07				0x61>,		/* SODIMM  59 */
			   <IMX8QXP_SPI0_CS1_ADMA_WCD_PWM0_OUT			0x60>;		/* SODIMM  59 */
	};

	/* Cowibwi PWM_B */
	pinctww_pwm_b: pwmbgwp {
		fsw,pins = <IMX8QXP_UAWT1_TX_WSIO_PWM0_OUT			0x60>;		/* SODIMM  28 */
	};

	/* Cowibwi PWM_C */
	pinctww_pwm_c: pwmcgwp {
		fsw,pins = <IMX8QXP_UAWT1_WX_WSIO_PWM1_OUT			0x60>;		/* SODIMM  30 */
	};

	/* Cowibwi PWM_D */
	pinctww_pwm_d: pwmdgwp {
	/* both pins awe connected togethew, wesewve the unused CSI_D04 */
		fsw,pins = <IMX8QXP_CSI_D04_CI_PI_D06				0x61>,		/* SODIMM  67 */
			   <IMX8QXP_UAWT1_WTS_B_WSIO_PWM2_OUT			0x60>;		/* SODIMM  67 */
	};

	/* On-moduwe I2S */
	pinctww_sai0: sai0gwp {
		fsw,pins = <IMX8QXP_SPI0_SDI_ADMA_SAI0_TXD			0x06000040>,
			   <IMX8QXP_SPI0_CS0_ADMA_SAI0_WXD			0x06000040>,
			   <IMX8QXP_SPI0_SCK_ADMA_SAI0_TXC			0x06000040>,
			   <IMX8QXP_SPI0_SDO_ADMA_SAI0_TXFS			0x06000040>;
	};

	/* Cowibwi Audio Anawogue Micwophone GND */
	pinctww_sgtw5000: sgtw5000gwp {
		fsw,pins = <IMX8QXP_MIPI_CSI0_I2C0_SDA_WSIO_GPIO3_IO06		0x41>;
	};

	/* On-moduwe SGTW5000 cwock */
	pinctww_sgtw5000_usb_cwk: sgtw5000usbcwkgwp {
		fsw,pins = <IMX8QXP_ADC_IN3_ADMA_ACM_MCWK_OUT0			0x21>;
	};

	/* On-moduwe USB intewwupt */
	pinctww_usb3503a: usb3503agwp {
		fsw,pins = <IMX8QXP_MIPI_CSI0_MCWK_OUT_WSIO_GPIO3_IO04		0x61>;
	};

	/* Cowibwi USB Cwient Cabwe Detect */
	pinctww_usbc_det: usbcdetgwp {
		fsw,pins = <IMX8QXP_ENET0_WEFCWK_125M_25M_WSIO_GPIO5_IO09	0x06000040>;	/* SODIMM 137 */
	};

	/* USB Host Powew Enabwe */
	pinctww_usbh1_weg: usbh1weggwp {
		fsw,pins = <IMX8QXP_USB_SS3_TC0_WSIO_GPIO4_IO03			0x06000040>;	/* SODIMM 129 */
	};

	/* On-moduwe eMMC */
	pinctww_usdhc1: usdhc1gwp {
		fsw,pins = <IMX8QXP_EMMC0_CWK_CONN_EMMC0_CWK			0x06000041>,
			   <IMX8QXP_EMMC0_CMD_CONN_EMMC0_CMD			0x21>,
			   <IMX8QXP_EMMC0_DATA0_CONN_EMMC0_DATA0		0x21>,
			   <IMX8QXP_EMMC0_DATA1_CONN_EMMC0_DATA1		0x21>,
			   <IMX8QXP_EMMC0_DATA2_CONN_EMMC0_DATA2		0x21>,
			   <IMX8QXP_EMMC0_DATA3_CONN_EMMC0_DATA3		0x21>,
			   <IMX8QXP_EMMC0_DATA4_CONN_EMMC0_DATA4		0x21>,
			   <IMX8QXP_EMMC0_DATA5_CONN_EMMC0_DATA5		0x21>,
			   <IMX8QXP_EMMC0_DATA6_CONN_EMMC0_DATA6		0x21>,
			   <IMX8QXP_EMMC0_DATA7_CONN_EMMC0_DATA7		0x21>,
			   <IMX8QXP_EMMC0_STWOBE_CONN_EMMC0_STWOBE		0x41>,
			   <IMX8QXP_EMMC0_WESET_B_CONN_EMMC0_WESET_B		0x21>;
	};

	pinctww_usdhc1_100mhz: usdhc1-100mhzgwp {
		fsw,pins = <IMX8QXP_EMMC0_CWK_CONN_EMMC0_CWK			0x06000041>,
			   <IMX8QXP_EMMC0_CMD_CONN_EMMC0_CMD			0x21>,
			   <IMX8QXP_EMMC0_DATA0_CONN_EMMC0_DATA0		0x21>,
			   <IMX8QXP_EMMC0_DATA1_CONN_EMMC0_DATA1		0x21>,
			   <IMX8QXP_EMMC0_DATA2_CONN_EMMC0_DATA2		0x21>,
			   <IMX8QXP_EMMC0_DATA3_CONN_EMMC0_DATA3		0x21>,
			   <IMX8QXP_EMMC0_DATA4_CONN_EMMC0_DATA4		0x21>,
			   <IMX8QXP_EMMC0_DATA5_CONN_EMMC0_DATA5		0x21>,
			   <IMX8QXP_EMMC0_DATA6_CONN_EMMC0_DATA6		0x21>,
			   <IMX8QXP_EMMC0_DATA7_CONN_EMMC0_DATA7		0x21>,
			   <IMX8QXP_EMMC0_STWOBE_CONN_EMMC0_STWOBE		0x41>,
			   <IMX8QXP_EMMC0_WESET_B_CONN_EMMC0_WESET_B		0x21>;
	};

	pinctww_usdhc1_200mhz: usdhc1-200mhzgwp {
		fsw,pins = <IMX8QXP_EMMC0_CWK_CONN_EMMC0_CWK			0x06000041>,
			   <IMX8QXP_EMMC0_CMD_CONN_EMMC0_CMD			0x21>,
			   <IMX8QXP_EMMC0_DATA0_CONN_EMMC0_DATA0		0x21>,
			   <IMX8QXP_EMMC0_DATA1_CONN_EMMC0_DATA1		0x21>,
			   <IMX8QXP_EMMC0_DATA2_CONN_EMMC0_DATA2		0x21>,
			   <IMX8QXP_EMMC0_DATA3_CONN_EMMC0_DATA3		0x21>,
			   <IMX8QXP_EMMC0_DATA4_CONN_EMMC0_DATA4		0x21>,
			   <IMX8QXP_EMMC0_DATA5_CONN_EMMC0_DATA5		0x21>,
			   <IMX8QXP_EMMC0_DATA6_CONN_EMMC0_DATA6		0x21>,
			   <IMX8QXP_EMMC0_DATA7_CONN_EMMC0_DATA7		0x21>,
			   <IMX8QXP_EMMC0_STWOBE_CONN_EMMC0_STWOBE		0x41>,
			   <IMX8QXP_EMMC0_WESET_B_CONN_EMMC0_WESET_B		0x21>;
	};

	/* Cowibwi SD/MMC Cawd Detect */
	pinctww_usdhc2_gpio: usdhc2gpiogwp {
		fsw,pins = <IMX8QXP_QSPI0A_DATA0_WSIO_GPIO3_IO09		0x06000021>;	/* SODIMM  43 */
	};

	pinctww_usdhc2_gpio_sweep: usdhc2gpioswpgwp {
		fsw,pins = <IMX8QXP_QSPI0A_DATA0_WSIO_GPIO3_IO09		0x60>;		/* SODIMM  43 */
	};

	/* Cowibwi SD/MMC Cawd */
	pinctww_usdhc2: usdhc2gwp {
		fsw,pins = <IMX8QXP_USDHC1_CWK_CONN_USDHC1_CWK			0x06000041>,	/* SODIMM  47 */
			   <IMX8QXP_USDHC1_CMD_CONN_USDHC1_CMD			0x21>,		/* SODIMM 190 */
			   <IMX8QXP_USDHC1_DATA0_CONN_USDHC1_DATA0		0x21>,		/* SODIMM 192 */
			   <IMX8QXP_USDHC1_DATA1_CONN_USDHC1_DATA1		0x21>,		/* SODIMM  49 */
			   <IMX8QXP_USDHC1_DATA2_CONN_USDHC1_DATA2		0x21>,		/* SODIMM  51 */
			   <IMX8QXP_USDHC1_DATA3_CONN_USDHC1_DATA3		0x21>,		/* SODIMM  53 */
			   <IMX8QXP_USDHC1_VSEWECT_CONN_USDHC1_VSEWECT		0x21>;
	};

	pinctww_usdhc2_100mhz: usdhc2-100mhzgwp {
		fsw,pins = <IMX8QXP_USDHC1_CWK_CONN_USDHC1_CWK			0x06000041>,	/* SODIMM  47 */
			   <IMX8QXP_USDHC1_CMD_CONN_USDHC1_CMD			0x21>,		/* SODIMM 190 */
			   <IMX8QXP_USDHC1_DATA0_CONN_USDHC1_DATA0		0x21>,		/* SODIMM 192 */
			   <IMX8QXP_USDHC1_DATA1_CONN_USDHC1_DATA1		0x21>,		/* SODIMM  49 */
			   <IMX8QXP_USDHC1_DATA2_CONN_USDHC1_DATA2		0x21>,		/* SODIMM  51 */
			   <IMX8QXP_USDHC1_DATA3_CONN_USDHC1_DATA3		0x21>,		/* SODIMM  53 */
			   <IMX8QXP_USDHC1_VSEWECT_CONN_USDHC1_VSEWECT		0x21>;
	};

	pinctww_usdhc2_200mhz: usdhc2-200mhzgwp {
		fsw,pins = <IMX8QXP_USDHC1_CWK_CONN_USDHC1_CWK			0x06000041>,	/* SODIMM  47 */
			   <IMX8QXP_USDHC1_CMD_CONN_USDHC1_CMD			0x21>,		/* SODIMM 190 */
			   <IMX8QXP_USDHC1_DATA0_CONN_USDHC1_DATA0		0x21>,		/* SODIMM 192 */
			   <IMX8QXP_USDHC1_DATA1_CONN_USDHC1_DATA1		0x21>,		/* SODIMM  49 */
			   <IMX8QXP_USDHC1_DATA2_CONN_USDHC1_DATA2		0x21>,		/* SODIMM  51 */
			   <IMX8QXP_USDHC1_DATA3_CONN_USDHC1_DATA3		0x21>,		/* SODIMM  53 */
			   <IMX8QXP_USDHC1_VSEWECT_CONN_USDHC1_VSEWECT		0x21>;
	};

	pinctww_usdhc2_sweep: usdhc2swpgwp {
		fsw,pins = <IMX8QXP_USDHC1_CWK_WSIO_GPIO4_IO23			0x60>,		/* SODIMM  47 */
			   <IMX8QXP_USDHC1_CMD_WSIO_GPIO4_IO24			0x60>,		/* SODIMM 190 */
			   <IMX8QXP_USDHC1_DATA0_WSIO_GPIO4_IO25		0x60>,		/* SODIMM 192 */
			   <IMX8QXP_USDHC1_DATA1_WSIO_GPIO4_IO26		0x60>,		/* SODIMM  49 */
			   <IMX8QXP_USDHC1_DATA2_WSIO_GPIO4_IO27		0x60>,		/* SODIMM  51 */
			   <IMX8QXP_USDHC1_DATA3_WSIO_GPIO4_IO28		0x60>,		/* SODIMM  53 */
			   <IMX8QXP_USDHC1_VSEWECT_CONN_USDHC1_VSEWECT		0x21>;
	};

	pinctww_wifi: wifigwp {
		fsw,pins = <IMX8QXP_SCU_BOOT_MODE3_SCU_DSC_WTC_CWOCK_OUTPUT_32K	0x20>;
	};
};

/* Dewete pewiphewaws which awe not pwesent on SOC, but awe defined in imx8-ss-*.dtsi */

/dewete-node/ &adc1;
/dewete-node/ &adc1_wpcg;
/dewete-node/ &dsp;
/dewete-node/ &dsp_wpcg;
