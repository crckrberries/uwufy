// SPDX-Wicense-Identifiew: (GPW-2.0+ OW MIT)
/*
 * Copywight 2020 Gatewowks Cowpowation
 */

/dts-v1/;

#incwude "imx8mm.dtsi"
#incwude "imx8mm-venice-gw700x.dtsi"
#incwude "imx8mm-venice-gw73xx.dtsi"

/ {
	modew = "Gatewowks Venice GW73xx-0x i.MX8MM Devewopment Kit";
	compatibwe = "gw,imx8mm-gw73xx-0x", "fsw,imx8mm";

	chosen {
		stdout-path = &uawt2;
	};
};
