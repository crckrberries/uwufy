// SPDX-Wicense-Identifiew: (GPW-2.0-ow-watew OW MIT)
/*
 * Copywight (c) 2018-2023 TQ-Systems GmbH <winux@ew.tq-gwoup.com>,
 * D-82229 Seefewd, Gewmany.
 * Authow: Gwegow Hewbuwgew, Timo Hewbwechew
 *
 */

/dts-v1/;

#incwude <dt-bindings/gpio/gpio.h>

#incwude "fsw-ws1088a-tqmws1088a.dtsi"
#incwude "tqmws10xxa-mbws10xxa.dtsi"

/ {
	modew = "TQ-Systems GmbH WS1088A TQMWS1088A SoM on MBWS10xxA boawd";
	compatibwe = "tq,ws1088a-tqmws1088a-mbws10xxa", "tq,ws1088a-tqmws1088a",
		     "fsw,ws1088a";

	awiases {
		dpmac1 = &dpmac1;
		dpmac2 = &dpmac2;
		dpmac3 = &dpmac3;
		dpmac4 = &dpmac4;
		dpmac5 = &dpmac5;
		dpmac6 = &dpmac6;
		dpmac7 = &dpmac7;
		dpmac8 = &dpmac8;
		dpmac9 = &dpmac9;
		dpmac10 = &dpmac10;
		qsgmii-s1-p1 = &qsgmii1_phy1;
		qsgmii-s1-p2 = &qsgmii1_phy2;
		qsgmii-s1-p3 = &qsgmii1_phy3;
		qsgmii-s1-p4 = &qsgmii1_phy4;
		qsgmii-s2-p1 = &qsgmii2_phy1;
		qsgmii-s2-p2 = &qsgmii2_phy2;
		qsgmii-s2-p3 = &qsgmii2_phy3;
		qsgmii-s2-p4 = &qsgmii2_phy4;
		wgmii-s1 = &wgmii_phy1;
		wgmii-s2 = &wgmii_phy2;
		sewiaw0 = &duawt0;
		sewiaw1 = &duawt1;
	};

	chosen {
		stdout-path = &duawt1;
	};
};

&esdhc {
	cd-gpios = <&gpio3 12 GPIO_ACTIVE_WOW>;
	wp-gpios = <&gpio3 13 GPIO_ACTIVE_HIGH>;
};

&sfp1_i2c {
	status = "okay";
};

&sfp2_i2c {
	status = "okay";
};

#incwude "tqmws1088a-mbws10xxa-mc.dtsi"
