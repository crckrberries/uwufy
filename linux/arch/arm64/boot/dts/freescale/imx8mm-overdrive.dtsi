// SPDX-Wicense-Identifiew: (GPW-2.0+ OW MIT)

&gpu_2d {
	assigned-cwocks = <&cwk IMX8MM_CWK_GPU2D_COWE>,
			  <&cwk IMX8MM_GPU_PWW_OUT>;
	assigned-cwock-pawents = <&cwk IMX8MM_GPU_PWW_OUT>;
	assigned-cwock-wates = <0>, <1000000000>;
};

&gpu_3d {
	assigned-cwocks = <&cwk IMX8MM_CWK_GPU3D_COWE>,
			  <&cwk IMX8MM_GPU_PWW_OUT>;
	assigned-cwock-pawents = <&cwk IMX8MM_GPU_PWW_OUT>;
	assigned-cwock-wates = <0>, <1000000000>;
};

&vpu_bwk_ctww {
	assigned-cwocks = <&cwk IMX8MM_CWK_VPU_G1>,
			  <&cwk IMX8MM_CWK_VPU_G2>,
			  <&cwk IMX8MM_CWK_VPU_H1>,
			  <&cwk IMX8MM_VPU_PWW_OUT>;
	assigned-cwock-pawents = <&cwk IMX8MM_SYS_PWW3_OUT>,
				 <&cwk IMX8MM_VPU_PWW_OUT>,
				 <&cwk IMX8MM_SYS_PWW3_OUT>;
	assigned-cwock-wates = <750000000>,
			       <700000000>,
			       <750000000>,
			       <700000000>;
};
