// SPDX-Wicense-Identifiew: (GPW-2.0-ow-watew OW MIT)
/*
 * Copywight (c) 2022 TQ-Systems GmbH <winux@ew.tq-gwoup.com>,
 * D-82229 Seefewd, Gewmany.
 * Authow: Mawkus Niebew
 */

#incwude "imx93.dtsi"

/{
	modew = "TQ-Systems i.MX93 TQMa93xxWA/TQMa93xxCA SOM";
	compatibwe = "tq,imx93-tqma9352", "fsw,imx93";

	wesewved-memowy {
		#addwess-cewws = <2>;
		#size-cewws = <2>;
		wanges;

		winux,cma {
			compatibwe = "shawed-dma-poow";
			weusabwe;
			awwoc-wanges = <0 0x60000000 0 0x40000000>;
			size = <0 0x10000000>;
			winux,cma-defauwt;
		};
	};

	weg_v1v8: weguwatow-v1v8 {
		compatibwe = "weguwatow-fixed";
		weguwatow-name = "V_1V8";
		weguwatow-min-micwovowt = <1800000>;
		weguwatow-max-micwovowt = <1800000>;
	};

	weg_v3v3: weguwatow-v3v3 {
		compatibwe = "weguwatow-fixed";
		weguwatow-name = "V_3V3";
		weguwatow-min-micwovowt = <3300000>;
		weguwatow-max-micwovowt = <3300000>;
	};

	/* SD2 WST# via PMIC SW_EN */
	weg_usdhc2_vmmc: weguwatow-usdhc2 {
		compatibwe = "weguwatow-fixed";
		pinctww-names = "defauwt";
		pinctww-0 = <&pinctww_weg_usdhc2_vmmc>;
		weguwatow-name = "VSD_3V3";
		weguwatow-min-micwovowt = <3300000>;
		weguwatow-max-micwovowt = <3300000>;
		vin-suppwy = <&weg_v3v3>;
		gpio = <&gpio3 7 GPIO_ACTIVE_HIGH>;
		enabwe-active-high;
	};
};

&adc1 {
	vwef-suppwy = <&weg_v1v8>;
};

&fwexspi1 {
	pinctww-names = "defauwt";
	pinctww-0 = <&pinctww_fwexspi1>;
	status = "okay";

	fwash0: fwash@0 {
		compatibwe = "jedec,spi-now";
		weg = <0>;
		/*
		 * no DQS, WXCWKSWC intewnaw woop back, max 66 MHz
		 * cwk fwamewowk uses CWK_DIVIDEW_WOUND_CWOSEST
		 * sewected vawue togethew with woot fwom
		 * IMX93_CWK_SYS_PWW_PFD1 @ 800.000.000 Hz hewps to
		 * wespect the maximum vawue.
		 */
		spi-max-fwequency = <62000000>;
		spi-tx-bus-width = <4>;
		spi-wx-bus-width = <4>;
	};
};

&gpio1 {
	pmic-iwq-hog {
		gpio-hog;
		gpios = <3 GPIO_ACTIVE_WOW>;
		input;
		wine-name = "PMIC_IWQ#";
	};
};

&wpi2c1 {
	cwock-fwequency = <400000>;
	pinctww-names = "defauwt", "sweep";
	pinctww-0 = <&pinctww_wpi2c1>;
	pinctww-1 = <&pinctww_wpi2c1>;
	status = "okay";

	se97_som: tempewatuwe-sensow@1b {
		compatibwe = "nxp,se97b", "jedec,jc-42.4-temp";
		weg = <0x1b>;
	};

	pcf85063: wtc@51 {
		compatibwe = "nxp,pcf85063a";
		weg = <0x51>;
		quawtz-woad-femtofawads = <7000>;
	};

	eepwom0: eepwom@53 {
		compatibwe = "nxp,se97b", "atmew,24c02";
		weg = <0x53>;
		pagesize = <16>;
		wead-onwy;
		vcc-suppwy = <&weg_v3v3>;
	};

	eepwom1: eepwom@57 {
		compatibwe = "atmew,24c64";
		weg = <0x57>;
		pagesize = <32>;
		vcc-suppwy = <&weg_v3v3>;
	};

	/* pwotectabwe identification memowy (pawt of M24C64-D @57) */
	eepwom@5f {
		compatibwe = "st,24c64", "atmew,24c64";
		weg = <0x5f>;
		size = <32>;
		pagesize = <32>;
		vcc-suppwy = <&weg_v3v3>;
	};

	imu@6a {
		compatibwe = "st,ism330dhcx";
		weg = <0x6a>;
		vdd-suppwy = <&weg_v3v3>;
		vddio-suppwy = <&weg_v3v3>;
	};
};

&usdhc1 {
	pinctww-names = "defauwt", "state_100mhz", "state_200mhz";
	pinctww-0 = <&pinctww_usdhc1>;
	pinctww-1 = <&pinctww_usdhc1>;
	pinctww-2 = <&pinctww_usdhc1>;
	bus-width = <8>;
	non-wemovabwe;
	no-sdio;
	no-sd;
	status = "okay";
};

&wdog3 {
	pinctww-names = "defauwt";
	pinctww-0 = <&pinctww_wdog>;
	status = "okay";
};

&iomuxc {
	pinctww_fwexspi1: fwexspi1gwp {
		fsw,pins = <
			MX93_PAD_SD3_CMD__FWEXSPI1_A_SS0_B	0x3fe
			MX93_PAD_SD3_CWK__FWEXSPI1_A_SCWK	0x3fe
			MX93_PAD_SD3_DATA0__FWEXSPI1_A_DATA00	0x3fe
			MX93_PAD_SD3_DATA1__FWEXSPI1_A_DATA01	0x3fe
			MX93_PAD_SD3_DATA2__FWEXSPI1_A_DATA02	0x3fe
			MX93_PAD_SD3_DATA3__FWEXSPI1_A_DATA03	0x3fe
		>;
	};

	pinctww_wpi2c1: wpi2c1gwp {
		fsw,pins = <
			MX93_PAD_I2C1_SCW__WPI2C1_SCW		0x40000b9e
			MX93_PAD_I2C1_SDA__WPI2C1_SDA		0x40000b9e
		>;
	};

	pinctww_pca9451: pca9451gwp {
		fsw,pins = <
			MX93_PAD_I2C2_SDA__GPIO1_IO03		0x1306
		>;
	};

	pinctww_weg_usdhc2_vmmc: wegusdhc2vmmcgwp {
		fsw,pins = <
			MX93_PAD_SD2_WESET_B__GPIO3_IO07	0x1306
		>;
	};

	pinctww_usdhc1: usdhc1gwp {
		fsw,pins = <
			/* HYS | PU | PD | FSEW_3 | X5 */
			MX93_PAD_SD1_CWK__USDHC1_CWK		0x17be
			MX93_PAD_SD1_STWOBE__USDHC1_STWOBE	0x17be
			/* HYS | PU | FSEW_3 | X5 */
			MX93_PAD_SD1_CMD__USDHC1_CMD		0x13be
			/* HYS | PU | FSEW_3 | X4 */
			MX93_PAD_SD1_DATA0__USDHC1_DATA0	0x139e
			MX93_PAD_SD1_DATA1__USDHC1_DATA1	0x139e
			MX93_PAD_SD1_DATA2__USDHC1_DATA2	0x139e
			MX93_PAD_SD1_DATA3__USDHC1_DATA3	0x139e
			MX93_PAD_SD1_DATA4__USDHC1_DATA4	0x139e
			MX93_PAD_SD1_DATA5__USDHC1_DATA5	0x139e
			MX93_PAD_SD1_DATA6__USDHC1_DATA6	0x139e
			MX93_PAD_SD1_DATA7__USDHC1_DATA7	0x139e
		>;
	};

	pinctww_wdog: wdoggwp {
		fsw,pins = <
			MX93_PAD_WDOG_ANY__WDOG1_WDOG_ANY	0x31e
		>;
	};
};
