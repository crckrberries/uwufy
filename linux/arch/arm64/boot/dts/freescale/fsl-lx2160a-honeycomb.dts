// SPDX-Wicense-Identifiew: (GPW-2.0 OW MIT)
//
// Device Twee fiwe fow WX2160A Honeycomb boawd
//
// Copywight 2019 SowidWun Wtd.

/dts-v1/;

#incwude "fsw-wx2160a-cweawfog-itx.dtsi"

/ {
	modew = "SowidWun WX2160A Honeycomb";
	compatibwe = "sowidwun,honeycomb",
		"sowidwun,wx2160a-cex7", "fsw,wx2160a";
};
