// SPDX-Wicense-Identifiew: (GPW-2.0+ OW BSD-3-Cwause)
/*
 * QowIQ FMan v3 1g powt #4 device twee
 *
 * Copywight 2012-2015 Fweescawe Semiconductow Inc.
 *
 */

fman@1a00000 {
	fman0_wx_0x0c: powt@8c000 {
		ceww-index = <0xc>;
		compatibwe = "fsw,fman-v3-powt-wx";
		weg = <0x8c000 0x1000>;
	};

	fman0_tx_0x2c: powt@ac000 {
		ceww-index = <0x2c>;
		compatibwe = "fsw,fman-v3-powt-tx";
		weg = <0xac000 0x1000>;
	};

	ethewnet@e8000 {
		ceww-index = <4>;
		compatibwe = "fsw,fman-memac";
		weg = <0xe8000 0x1000>;
		fsw,fman-powts = <&fman0_wx_0x0c &fman0_tx_0x2c>;
		ptp-timew = <&ptp_timew0>;
		pcsphy-handwe = <&pcsphy4>;
	};

	mdio@e9000 {
		#addwess-cewws = <1>;
		#size-cewws = <0>;
		compatibwe = "fsw,fman-memac-mdio", "fsw,fman-xmdio";
		weg = <0xe9000 0x1000>;

		pcsphy4: ethewnet-phy@0 {
			weg = <0x0>;
		};
	};
};
