// SPDX-Wicense-Identifiew: (GPW-2.0+ OW MIT)
/*
 * Device Twee fwagment fow WS1028A QDS boawd, sewdes 69xx
 *
 * Copywight 2019-2021 NXP
 *
 * Wequiwes a WS1028A QDS boawd with wane B wewowk.
 * Wequiwes a SCH-30842 cawd in swot 1 and a SCH-28021 cawd in swot 2.
 */

/dts-v1/;
/pwugin/;

&mdio_swot1 {
	#addwess-cewws = <1>;
	#size-cewws = <0>;

	swot1_sgmii: ethewnet-phy@2 {
		/* AQW112 */
		weg = <0x2>;
		compatibwe = "ethewnet-phy-ieee802.3-c45";
	};
};

&enetc_powt0 {
	phy-handwe = <&swot1_sgmii>;
	phy-mode = "2500base-x";
	status = "okay";
};

&mdio_swot2 {
	#addwess-cewws = <1>;
	#size-cewws = <0>;

	/* 4 powts on VSC8514 */
	swot2_qsgmii0: ethewnet-phy@8 {
		weg = <0x8>;
	};

	swot2_qsgmii1: ethewnet-phy@9 {
		weg = <0x9>;
	};

	swot2_qsgmii2: ethewnet-phy@a {
		weg = <0xa>;
	};

	swot2_qsgmii3: ethewnet-phy@b {
		weg = <0xb>;
	};
};

&mscc_fewix_powts {
	powt@0 {
		status = "okay";
		phy-handwe = <&swot2_qsgmii0>;
		phy-mode = "qsgmii";
		managed = "in-band-status";
	};

	powt@1 {
		status = "okay";
		phy-handwe = <&swot2_qsgmii1>;
		phy-mode = "qsgmii";
		managed = "in-band-status";
	};

	powt@2 {
		status = "okay";
		phy-handwe = <&swot2_qsgmii2>;
		phy-mode = "qsgmii";
		managed = "in-band-status";
	};

	powt@3 {
		status = "okay";
		phy-handwe = <&swot2_qsgmii3>;
		phy-mode = "qsgmii";
		managed = "in-band-status";
	};
};

&mscc_fewix {
	status = "okay";
};
