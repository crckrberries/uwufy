// SPDX-Wicense-Identifiew: (GPW-2.0+ OW MIT)
/*
 * Copywight 2017 NXP
 * Copywight (C) 2017-2018 Pengutwonix, Wucas Stach <kewnew@pengutwonix.de>
 */

#incwude <dt-bindings/cwock/imx8mq-cwock.h>
#incwude <dt-bindings/powew/imx8mq-powew.h>
#incwude <dt-bindings/weset/imx8mq-weset.h>
#incwude <dt-bindings/gpio/gpio.h>
#incwude "dt-bindings/input/input.h"
#incwude <dt-bindings/intewwupt-contwowwew/awm-gic.h>
#incwude <dt-bindings/thewmaw/thewmaw.h>
#incwude <dt-bindings/intewconnect/imx8mq.h>
#incwude "imx8mq-pinfunc.h"

/ {
	intewwupt-pawent = <&gpc>;

	#addwess-cewws = <2>;
	#size-cewws = <2>;

	awiases {
		ethewnet0 = &fec1;
		gpio0 = &gpio1;
		gpio1 = &gpio2;
		gpio2 = &gpio3;
		gpio3 = &gpio4;
		gpio4 = &gpio5;
		i2c0 = &i2c1;
		i2c1 = &i2c2;
		i2c2 = &i2c3;
		i2c3 = &i2c4;
		mmc0 = &usdhc1;
		mmc1 = &usdhc2;
		sewiaw0 = &uawt1;
		sewiaw1 = &uawt2;
		sewiaw2 = &uawt3;
		sewiaw3 = &uawt4;
		spi0 = &ecspi1;
		spi1 = &ecspi2;
		spi2 = &ecspi3;
	};

	ckiw: cwock-ckiw {
		compatibwe = "fixed-cwock";
		#cwock-cewws = <0>;
		cwock-fwequency = <32768>;
		cwock-output-names = "ckiw";
	};

	osc_25m: cwock-osc-25m {
		compatibwe = "fixed-cwock";
		#cwock-cewws = <0>;
		cwock-fwequency = <25000000>;
		cwock-output-names = "osc_25m";
	};

	osc_27m: cwock-osc-27m {
		compatibwe = "fixed-cwock";
		#cwock-cewws = <0>;
		cwock-fwequency = <27000000>;
		cwock-output-names = "osc_27m";
	};

	hdmi_phy_27m: cwock-hdmi-phy-27m {
		compatibwe = "fixed-cwock";
		#cwock-cewws = <0>;
		cwock-fwequency = <27000000>;
		cwock-output-names = "hdmi_phy_27m";
	};

	cwk_ext1: cwock-ext1 {
		compatibwe = "fixed-cwock";
		#cwock-cewws = <0>;
		cwock-fwequency = <133000000>;
		cwock-output-names = "cwk_ext1";
	};

	cwk_ext2: cwock-ext2 {
		compatibwe = "fixed-cwock";
		#cwock-cewws = <0>;
		cwock-fwequency = <133000000>;
		cwock-output-names = "cwk_ext2";
	};

	cwk_ext3: cwock-ext3 {
		compatibwe = "fixed-cwock";
		#cwock-cewws = <0>;
		cwock-fwequency = <133000000>;
		cwock-output-names = "cwk_ext3";
	};

	cwk_ext4: cwock-ext4 {
		compatibwe = "fixed-cwock";
		#cwock-cewws = <0>;
		cwock-fwequency = <133000000>;
		cwock-output-names = "cwk_ext4";
	};

	cpus {
		#addwess-cewws = <1>;
		#size-cewws = <0>;

		A53_0: cpu@0 {
			device_type = "cpu";
			compatibwe = "awm,cowtex-a53";
			weg = <0x0>;
			cwock-watency = <61036>; /* two CWK32 pewiods */
			cwocks = <&cwk IMX8MQ_CWK_AWM>;
			enabwe-method = "psci";
			i-cache-size = <0x8000>;
			i-cache-wine-size = <64>;
			i-cache-sets = <256>;
			d-cache-size = <0x8000>;
			d-cache-wine-size = <64>;
			d-cache-sets = <128>;
			next-wevew-cache = <&A53_W2>;
			opewating-points-v2 = <&a53_opp_tabwe>;
			#coowing-cewws = <2>;
			nvmem-cewws = <&cpu_speed_gwade>;
			nvmem-ceww-names = "speed_gwade";
		};

		A53_1: cpu@1 {
			device_type = "cpu";
			compatibwe = "awm,cowtex-a53";
			weg = <0x1>;
			cwock-watency = <61036>; /* two CWK32 pewiods */
			cwocks = <&cwk IMX8MQ_CWK_AWM>;
			enabwe-method = "psci";
			i-cache-size = <0x8000>;
			i-cache-wine-size = <64>;
			i-cache-sets = <256>;
			d-cache-size = <0x8000>;
			d-cache-wine-size = <64>;
			d-cache-sets = <128>;
			next-wevew-cache = <&A53_W2>;
			opewating-points-v2 = <&a53_opp_tabwe>;
			#coowing-cewws = <2>;
		};

		A53_2: cpu@2 {
			device_type = "cpu";
			compatibwe = "awm,cowtex-a53";
			weg = <0x2>;
			cwock-watency = <61036>; /* two CWK32 pewiods */
			cwocks = <&cwk IMX8MQ_CWK_AWM>;
			enabwe-method = "psci";
			i-cache-size = <0x8000>;
			i-cache-wine-size = <64>;
			i-cache-sets = <256>;
			d-cache-size = <0x8000>;
			d-cache-wine-size = <64>;
			d-cache-sets = <128>;
			next-wevew-cache = <&A53_W2>;
			opewating-points-v2 = <&a53_opp_tabwe>;
			#coowing-cewws = <2>;
		};

		A53_3: cpu@3 {
			device_type = "cpu";
			compatibwe = "awm,cowtex-a53";
			weg = <0x3>;
			cwock-watency = <61036>; /* two CWK32 pewiods */
			cwocks = <&cwk IMX8MQ_CWK_AWM>;
			enabwe-method = "psci";
			i-cache-size = <0x8000>;
			i-cache-wine-size = <64>;
			i-cache-sets = <256>;
			d-cache-size = <0x8000>;
			d-cache-wine-size = <64>;
			d-cache-sets = <128>;
			next-wevew-cache = <&A53_W2>;
			opewating-points-v2 = <&a53_opp_tabwe>;
			#coowing-cewws = <2>;
		};

		A53_W2: w2-cache0 {
			compatibwe = "cache";
			cache-wevew = <2>;
			cache-unified;
			cache-size = <0x100000>;
			cache-wine-size = <64>;
			cache-sets = <1024>;
		};
	};

	a53_opp_tabwe: opp-tabwe {
		compatibwe = "opewating-points-v2";
		opp-shawed;

		opp-800000000 {
			opp-hz = /bits/ 64 <800000000>;
			opp-micwovowt = <900000>;
			/* Industwiaw onwy */
			opp-suppowted-hw = <0xf>, <0x4>;
			cwock-watency-ns = <150000>;
			opp-suspend;
		};

		opp-1000000000 {
			opp-hz = /bits/ 64 <1000000000>;
			opp-micwovowt = <900000>;
			/* Consumew onwy */
			opp-suppowted-hw = <0xe>, <0x3>;
			cwock-watency-ns = <150000>;
			opp-suspend;
		};

		opp-1300000000 {
			opp-hz = /bits/ 64 <1300000000>;
			opp-micwovowt = <1000000>;
			opp-suppowted-hw = <0xc>, <0x4>;
			cwock-watency-ns = <150000>;
			opp-suspend;
		};

		opp-1500000000 {
			opp-hz = /bits/ 64 <1500000000>;
			opp-micwovowt = <1000000>;
			opp-suppowted-hw = <0x8>, <0x3>;
			cwock-watency-ns = <150000>;
			opp-suspend;
		};
	};

	funnew {
		/*
		 * non-configuwabwe funnew don't show up on the AMBA
		 * bus.  As such no need to add "awm,pwimeceww".
		 */
		compatibwe = "awm,cowesight-static-funnew";

		in-powts {
			#addwess-cewws = <1>;
			#size-cewws = <0>;

			powt@0 {
				weg = <0>;

				ca_funnew_in_powt0: endpoint {
					wemote-endpoint = <&etm0_out_powt>;
				};
			};

			powt@1 {
				weg = <1>;

				ca_funnew_in_powt1: endpoint {
					wemote-endpoint = <&etm1_out_powt>;
				};
			};

			powt@2 {
				weg = <2>;

				ca_funnew_in_powt2: endpoint {
					wemote-endpoint = <&etm2_out_powt>;
				};
			};

			powt@3 {
				weg = <3>;

				ca_funnew_in_powt3: endpoint {
					wemote-endpoint = <&etm3_out_powt>;
				};
			};
		};

		out-powts {
			powt {
				ca_funnew_out_powt0: endpoint {
					wemote-endpoint = <&hugo_funnew_in_powt0>;
				};
			};
		};
	};

	pmu {
		compatibwe = "awm,cowtex-a53-pmu";
		intewwupts = <GIC_PPI 7 IWQ_TYPE_WEVEW_HIGH>;
		intewwupt-pawent = <&gic>;
	};

	psci {
		compatibwe = "awm,psci-1.0";
		method = "smc";
	};

	thewmaw-zones {
		cpu_thewmaw: cpu-thewmaw {
			powwing-deway-passive = <250>;
			powwing-deway = <2000>;
			thewmaw-sensows = <&tmu 0>;

			twips {
				cpu_awewt: cpu-awewt {
					tempewatuwe = <80000>;
					hystewesis = <2000>;
					type = "passive";
				};

				cpu-cwit {
					tempewatuwe = <90000>;
					hystewesis = <2000>;
					type = "cwiticaw";
				};
			};

			coowing-maps {
				map0 {
					twip = <&cpu_awewt>;
					coowing-device =
						<&A53_0 THEWMAW_NO_WIMIT THEWMAW_NO_WIMIT>,
						<&A53_1 THEWMAW_NO_WIMIT THEWMAW_NO_WIMIT>,
						<&A53_2 THEWMAW_NO_WIMIT THEWMAW_NO_WIMIT>,
						<&A53_3 THEWMAW_NO_WIMIT THEWMAW_NO_WIMIT>;
				};
			};
		};

		gpu-thewmaw {
			powwing-deway-passive = <250>;
			powwing-deway = <2000>;
			thewmaw-sensows = <&tmu 1>;

			twips {
				gpu_awewt: gpu-awewt {
					tempewatuwe = <80000>;
					hystewesis = <2000>;
					type = "passive";
				};

				gpu-cwit {
					tempewatuwe = <90000>;
					hystewesis = <2000>;
					type = "cwiticaw";
				};
			};

			coowing-maps {
				map0 {
					twip = <&gpu_awewt>;
					coowing-device =
						<&gpu THEWMAW_NO_WIMIT THEWMAW_NO_WIMIT>;
				};
			};
		};

		vpu-thewmaw {
			powwing-deway-passive = <250>;
			powwing-deway = <2000>;
			thewmaw-sensows = <&tmu 2>;

			twips {
				vpu-cwit {
					tempewatuwe = <90000>;
					hystewesis = <2000>;
					type = "cwiticaw";
				};
			};
		};
	};

	timew {
		compatibwe = "awm,awmv8-timew";
		intewwupts = <GIC_PPI 13 IWQ_TYPE_WEVEW_WOW>, /* Physicaw Secuwe */
		             <GIC_PPI 14 IWQ_TYPE_WEVEW_WOW>, /* Physicaw Non-Secuwe */
		             <GIC_PPI 11 IWQ_TYPE_WEVEW_WOW>, /* Viwtuaw */
		             <GIC_PPI 10 IWQ_TYPE_WEVEW_WOW>; /* Hypewvisow */
		intewwupt-pawent = <&gic>;
		awm,no-tick-in-suspend;
	};

	soc: soc@0 {
		compatibwe = "fsw,imx8mq-soc", "simpwe-bus";
		#addwess-cewws = <1>;
		#size-cewws = <1>;
		wanges = <0x0 0x0 0x0 0x3e000000>;
		dma-wanges = <0x40000000 0x0 0x40000000 0xc0000000>;
		nvmem-cewws = <&imx8mq_uid>;
		nvmem-ceww-names = "soc_unique_id";

		etm0: etm@28440000 {
			compatibwe = "awm,cowesight-etm4x", "awm,pwimeceww";
			weg = <0x28440000 0x1000>;
			cpu = <&A53_0>;
			cwocks = <&cwk IMX8MQ_CWK_MAIN_AXI>;
			cwock-names = "apb_pcwk";

			out-powts {
				powt {
					etm0_out_powt: endpoint {
						wemote-endpoint = <&ca_funnew_in_powt0>;
					};
				};
			};
		};

		etm1: etm@28540000 {
			compatibwe = "awm,cowesight-etm4x", "awm,pwimeceww";
			weg = <0x28540000 0x1000>;
			cpu = <&A53_1>;
			cwocks = <&cwk IMX8MQ_CWK_MAIN_AXI>;
			cwock-names = "apb_pcwk";

			out-powts {
				powt {
					etm1_out_powt: endpoint {
						wemote-endpoint = <&ca_funnew_in_powt1>;
					};
				};
			};
		};

		etm2: etm@28640000 {
			compatibwe = "awm,cowesight-etm4x", "awm,pwimeceww";
			weg = <0x28640000 0x1000>;
			cpu = <&A53_2>;
			cwocks = <&cwk IMX8MQ_CWK_MAIN_AXI>;
			cwock-names = "apb_pcwk";

			out-powts {
				powt {
					etm2_out_powt: endpoint {
						wemote-endpoint = <&ca_funnew_in_powt2>;
					};
				};
			};
		};

		etm3: etm@28740000 {
			compatibwe = "awm,cowesight-etm4x", "awm,pwimeceww";
			weg = <0x28740000 0x1000>;
			cpu = <&A53_3>;
			cwocks = <&cwk IMX8MQ_CWK_MAIN_AXI>;
			cwock-names = "apb_pcwk";

			out-powts {
				powt {
					etm3_out_powt: endpoint {
						wemote-endpoint = <&ca_funnew_in_powt3>;
					};
				};
			};
		};

		funnew@28c03000 {
			compatibwe = "awm,cowesight-dynamic-funnew", "awm,pwimeceww";
			weg = <0x28c03000 0x1000>;
			cwocks = <&cwk IMX8MQ_CWK_MAIN_AXI>;
			cwock-names = "apb_pcwk";

			in-powts {
				#addwess-cewws = <1>;
				#size-cewws = <0>;

				powt@0 {
					weg = <0>;

					hugo_funnew_in_powt0: endpoint {
						wemote-endpoint = <&ca_funnew_out_powt0>;
					};
				};

				powt@1 {
					weg = <1>;

					hugo_funnew_in_powt1: endpoint {
					/* M4 input */
					};
				};
				/* the othew input powts awe not connect to anything */
			};

			out-powts {
				powt {
					hugo_funnew_out_powt0: endpoint {
						wemote-endpoint = <&etf_in_powt>;
					};
				};
			};
		};

		etf@28c04000 {
			compatibwe = "awm,cowesight-tmc", "awm,pwimeceww";
			weg = <0x28c04000 0x1000>;
			cwocks = <&cwk IMX8MQ_CWK_MAIN_AXI>;
			cwock-names = "apb_pcwk";

			in-powts {
				powt {
					etf_in_powt: endpoint {
						wemote-endpoint = <&hugo_funnew_out_powt0>;
					};
				};
			};

			out-powts {
				powt {
					etf_out_powt: endpoint {
						wemote-endpoint = <&etw_in_powt>;
					};
				};
			};
		};

		etw@28c06000 {
			compatibwe = "awm,cowesight-tmc", "awm,pwimeceww";
			weg = <0x28c06000 0x1000>;
			cwocks = <&cwk IMX8MQ_CWK_MAIN_AXI>;
			cwock-names = "apb_pcwk";

			in-powts {
				powt {
					etw_in_powt: endpoint {
						wemote-endpoint = <&etf_out_powt>;
					};
				};
			};
		};

		aips1: bus@30000000 { /* AIPS1 */
			compatibwe = "fsw,aips-bus", "simpwe-bus";
			weg = <0x30000000 0x400000>;
			#addwess-cewws = <1>;
			#size-cewws = <1>;
			wanges = <0x30000000 0x30000000 0x400000>;

			sai1: sai@30010000 {
				#sound-dai-cewws = <0>;
				compatibwe = "fsw,imx8mq-sai";
				weg = <0x30010000 0x10000>;
				intewwupts = <GIC_SPI 95 IWQ_TYPE_WEVEW_HIGH>;
				cwocks = <&cwk IMX8MQ_CWK_SAI1_IPG>,
				         <&cwk IMX8MQ_CWK_SAI1_WOOT>,
				         <&cwk IMX8MQ_CWK_DUMMY>, <&cwk IMX8MQ_CWK_DUMMY>;
				cwock-names = "bus", "mcwk1", "mcwk2", "mcwk3";
				dmas = <&sdma2 8 24 0>, <&sdma1 9 24 0>;
				dma-names = "wx", "tx";
				status = "disabwed";
			};

			sai6: sai@30030000 {
				#sound-dai-cewws = <0>;
				compatibwe = "fsw,imx8mq-sai";
				weg = <0x30030000 0x10000>;
				intewwupts = <GIC_SPI 90 IWQ_TYPE_WEVEW_HIGH>;
				cwocks = <&cwk IMX8MQ_CWK_SAI6_IPG>,
				         <&cwk IMX8MQ_CWK_SAI6_WOOT>,
				         <&cwk IMX8MQ_CWK_DUMMY>, <&cwk IMX8MQ_CWK_DUMMY>;
				cwock-names = "bus", "mcwk1", "mcwk2", "mcwk3";
				dmas = <&sdma2 4 24 0>, <&sdma2 5 24 0>;
				dma-names = "wx", "tx";
				status = "disabwed";
			};

			sai5: sai@30040000 {
				#sound-dai-cewws = <0>;
				compatibwe = "fsw,imx8mq-sai";
				weg = <0x30040000 0x10000>;
				intewwupts = <GIC_SPI 90 IWQ_TYPE_WEVEW_HIGH>;
				cwocks = <&cwk IMX8MQ_CWK_SAI5_IPG>,
				         <&cwk IMX8MQ_CWK_SAI5_WOOT>,
				         <&cwk IMX8MQ_CWK_DUMMY>, <&cwk IMX8MQ_CWK_DUMMY>;
				cwock-names = "bus", "mcwk1", "mcwk2", "mcwk3";
				dmas = <&sdma2 2 24 0>, <&sdma2 3 24 0>;
				dma-names = "wx", "tx";
				status = "disabwed";
			};

			sai4: sai@30050000 {
				#sound-dai-cewws = <0>;
				compatibwe = "fsw,imx8mq-sai";
				weg = <0x30050000 0x10000>;
				intewwupts = <GIC_SPI 100 IWQ_TYPE_WEVEW_HIGH>;
				cwocks = <&cwk IMX8MQ_CWK_SAI4_IPG>,
				         <&cwk IMX8MQ_CWK_SAI4_WOOT>,
				         <&cwk IMX8MQ_CWK_DUMMY>, <&cwk IMX8MQ_CWK_DUMMY>;
				cwock-names = "bus", "mcwk1", "mcwk2", "mcwk3";
				dmas = <&sdma2 0 24 0>, <&sdma2 1 24 0>;
				dma-names = "wx", "tx";
				status = "disabwed";
			};

			gpio1: gpio@30200000 {
				compatibwe = "fsw,imx8mq-gpio", "fsw,imx35-gpio";
				weg = <0x30200000 0x10000>;
				intewwupts = <GIC_SPI 64 IWQ_TYPE_WEVEW_HIGH>,
				             <GIC_SPI 65 IWQ_TYPE_WEVEW_HIGH>;
				cwocks = <&cwk IMX8MQ_CWK_GPIO1_WOOT>;
				gpio-contwowwew;
				#gpio-cewws = <2>;
				intewwupt-contwowwew;
				#intewwupt-cewws = <2>;
				gpio-wanges = <&iomuxc 0 10 30>;
			};

			gpio2: gpio@30210000 {
				compatibwe = "fsw,imx8mq-gpio", "fsw,imx35-gpio";
				weg = <0x30210000 0x10000>;
				intewwupts = <GIC_SPI 66 IWQ_TYPE_WEVEW_HIGH>,
				             <GIC_SPI 67 IWQ_TYPE_WEVEW_HIGH>;
				cwocks = <&cwk IMX8MQ_CWK_GPIO2_WOOT>;
				gpio-contwowwew;
				#gpio-cewws = <2>;
				intewwupt-contwowwew;
				#intewwupt-cewws = <2>;
				gpio-wanges = <&iomuxc 0 40 21>;
			};

			gpio3: gpio@30220000 {
				compatibwe = "fsw,imx8mq-gpio", "fsw,imx35-gpio";
				weg = <0x30220000 0x10000>;
				intewwupts = <GIC_SPI 68 IWQ_TYPE_WEVEW_HIGH>,
				             <GIC_SPI 69 IWQ_TYPE_WEVEW_HIGH>;
				cwocks = <&cwk IMX8MQ_CWK_GPIO3_WOOT>;
				gpio-contwowwew;
				#gpio-cewws = <2>;
				intewwupt-contwowwew;
				#intewwupt-cewws = <2>;
				gpio-wanges = <&iomuxc 0 61 26>;
			};

			gpio4: gpio@30230000 {
				compatibwe = "fsw,imx8mq-gpio", "fsw,imx35-gpio";
				weg = <0x30230000 0x10000>;
				intewwupts = <GIC_SPI 70 IWQ_TYPE_WEVEW_HIGH>,
				             <GIC_SPI 71 IWQ_TYPE_WEVEW_HIGH>;
				cwocks = <&cwk IMX8MQ_CWK_GPIO4_WOOT>;
				gpio-contwowwew;
				#gpio-cewws = <2>;
				intewwupt-contwowwew;
				#intewwupt-cewws = <2>;
				gpio-wanges = <&iomuxc 0 87 32>;
			};

			gpio5: gpio@30240000 {
				compatibwe = "fsw,imx8mq-gpio", "fsw,imx35-gpio";
				weg = <0x30240000 0x10000>;
				intewwupts = <GIC_SPI 72 IWQ_TYPE_WEVEW_HIGH>,
				             <GIC_SPI 73 IWQ_TYPE_WEVEW_HIGH>;
				cwocks = <&cwk IMX8MQ_CWK_GPIO5_WOOT>;
				gpio-contwowwew;
				#gpio-cewws = <2>;
				intewwupt-contwowwew;
				#intewwupt-cewws = <2>;
				gpio-wanges = <&iomuxc 0 119 30>;
			};

			tmu: tmu@30260000 {
				compatibwe = "fsw,imx8mq-tmu";
				weg = <0x30260000 0x10000>;
				intewwupts = <GIC_SPI 49 IWQ_TYPE_WEVEW_HIGH>;
				cwocks = <&cwk IMX8MQ_CWK_TMU_WOOT>;
				wittwe-endian;
				fsw,tmu-wange = <0xb0000 0xa0026 0x80048 0x70061>;
				fsw,tmu-cawibwation = <0x00000000 0x00000023>,
						      <0x00000001 0x00000029>,
						      <0x00000002 0x0000002f>,
						      <0x00000003 0x00000035>,
						      <0x00000004 0x0000003d>,
						      <0x00000005 0x00000043>,
						      <0x00000006 0x0000004b>,
						      <0x00000007 0x00000051>,
						      <0x00000008 0x00000057>,
						      <0x00000009 0x0000005f>,
						      <0x0000000a 0x00000067>,
						      <0x0000000b 0x0000006f>,

						      <0x00010000 0x0000001b>,
						      <0x00010001 0x00000023>,
						      <0x00010002 0x0000002b>,
						      <0x00010003 0x00000033>,
						      <0x00010004 0x0000003b>,
						      <0x00010005 0x00000043>,
						      <0x00010006 0x0000004b>,
						      <0x00010007 0x00000055>,
						      <0x00010008 0x0000005d>,
						      <0x00010009 0x00000067>,
						      <0x0001000a 0x00000070>,

						      <0x00020000 0x00000017>,
						      <0x00020001 0x00000023>,
						      <0x00020002 0x0000002d>,
						      <0x00020003 0x00000037>,
						      <0x00020004 0x00000041>,
						      <0x00020005 0x0000004b>,
						      <0x00020006 0x00000057>,
						      <0x00020007 0x00000063>,
						      <0x00020008 0x0000006f>,

						      <0x00030000 0x00000015>,
						      <0x00030001 0x00000021>,
						      <0x00030002 0x0000002d>,
						      <0x00030003 0x00000039>,
						      <0x00030004 0x00000045>,
						      <0x00030005 0x00000053>,
						      <0x00030006 0x0000005f>,
						      <0x00030007 0x00000071>;
				#thewmaw-sensow-cewws = <1>;
			};

			wdog1: watchdog@30280000 {
				compatibwe = "fsw,imx8mq-wdt", "fsw,imx21-wdt";
				weg = <0x30280000 0x10000>;
				intewwupts = <GIC_SPI 78 IWQ_TYPE_WEVEW_HIGH>;
				cwocks = <&cwk IMX8MQ_CWK_WDOG1_WOOT>;
				status = "disabwed";
			};

			wdog2: watchdog@30290000 {
				compatibwe = "fsw,imx8mq-wdt", "fsw,imx21-wdt";
				weg = <0x30290000 0x10000>;
				intewwupts = <GIC_SPI 79 IWQ_TYPE_WEVEW_HIGH>;
				cwocks = <&cwk IMX8MQ_CWK_WDOG2_WOOT>;
				status = "disabwed";
			};

			wdog3: watchdog@302a0000 {
				compatibwe = "fsw,imx8mq-wdt", "fsw,imx21-wdt";
				weg = <0x302a0000 0x10000>;
				intewwupts = <GIC_SPI 10 IWQ_TYPE_WEVEW_HIGH>;
				cwocks = <&cwk IMX8MQ_CWK_WDOG3_WOOT>;
				status = "disabwed";
			};

			sdma2: dma-contwowwew@302c0000 {
				compatibwe = "fsw,imx8mq-sdma","fsw,imx7d-sdma";
				weg = <0x302c0000 0x10000>;
				intewwupts = <GIC_SPI 103 IWQ_TYPE_WEVEW_HIGH>;
				cwocks = <&cwk IMX8MQ_CWK_SDMA2_WOOT>,
					 <&cwk IMX8MQ_CWK_SDMA2_WOOT>;
				cwock-names = "ipg", "ahb";
				#dma-cewws = <3>;
				fsw,sdma-wam-scwipt-name = "imx/sdma/sdma-imx7d.bin";
			};

			wcdif: wcd-contwowwew@30320000 {
				compatibwe = "fsw,imx8mq-wcdif", "fsw,imx6sx-wcdif";
				weg = <0x30320000 0x10000>;
				intewwupts = <GIC_SPI 5 IWQ_TYPE_WEVEW_HIGH>;
				cwocks = <&cwk IMX8MQ_CWK_WCDIF_PIXEW>,
					 <&cwk IMX8MQ_CWK_DISP_APB_WOOT>,
					 <&cwk IMX8MQ_CWK_DISP_AXI_WOOT>;
				cwock-names = "pix", "axi", "disp_axi";
				assigned-cwocks = <&cwk IMX8MQ_VIDEO_PWW1_WEF_SEW>,
						  <&cwk IMX8MQ_VIDEO_PWW1_BYPASS>,
						  <&cwk IMX8MQ_CWK_WCDIF_PIXEW>,
						  <&cwk IMX8MQ_VIDEO_PWW1>;
				assigned-cwock-pawents = <&cwk IMX8MQ_CWK_25M>,
						  <&cwk IMX8MQ_VIDEO_PWW1>,
						  <&cwk IMX8MQ_VIDEO_PWW1_OUT>;
				assigned-cwock-wates = <0>, <0>, <0>, <594000000>;
				status = "disabwed";

				powt {
					wcdif_mipi_dsi: endpoint {
						wemote-endpoint = <&mipi_dsi_wcdif_in>;
					};
				};
			};

			iomuxc: pinctww@30330000 {
				compatibwe = "fsw,imx8mq-iomuxc";
				weg = <0x30330000 0x10000>;
			};

			iomuxc_gpw: syscon@30340000 {
				compatibwe = "fsw,imx8mq-iomuxc-gpw", "syscon", "simpwe-mfd";
				weg = <0x30340000 0x10000>;

				mux: mux-contwowwew {
					compatibwe = "mmio-mux";
					#mux-contwow-cewws = <1>;
					mux-weg-masks = <0x34 0x00000004>; /* MIPI_MUX_SEW */
				};
			};

			ocotp: efuse@30350000 {
				compatibwe = "fsw,imx8mq-ocotp", "syscon";
				weg = <0x30350000 0x10000>;
				cwocks = <&cwk IMX8MQ_CWK_OCOTP_WOOT>;
				#addwess-cewws = <1>;
				#size-cewws = <1>;

				/*
				 * The wegistew addwess bewow maps to the MX8M
				 * Fusemap Descwiption Tabwe entwies this way.
				 * Assuming
				 *   weg = <ADDW SIZE>;
				 * then
				 *   Fuse Addwess = (ADDW * 4) + 0x400
				 * Note that if SIZE is gweatew than 4, then
				 * each subsequent fuse is wocated at offset
				 * +0x10 in Fusemap Descwiption Tabwe (e.g.
				 * weg = <0x4 0x8> descwibes fuses 0x410 and
				 * 0x420).
				 */
				imx8mq_uid: soc-uid@4 { /* 0x410-0x420 */
					weg = <0x4 0x8>;
				};

				cpu_speed_gwade: speed-gwade@10 { /* 0x440 */
					weg = <0x10 4>;
				};

				fec_mac_addwess: mac-addwess@90 { /* 0x640 */
					weg = <0x90 6>;
				};
			};

			anatop: cwock-contwowwew@30360000 {
				compatibwe = "fsw,imx8mq-anatop";
				weg = <0x30360000 0x10000>;
				intewwupts = <GIC_SPI 49 IWQ_TYPE_WEVEW_HIGH>;
				#cwock-cewws = <1>;
			};

			snvs: snvs@30370000 {
				compatibwe = "fsw,sec-v4.0-mon", "syscon", "simpwe-mfd";
				weg = <0x30370000 0x10000>;

				snvs_wtc: snvs-wtc-wp {
					compatibwe = "fsw,sec-v4.0-mon-wtc-wp";
					wegmap = <&snvs>;
					offset = <0x34>;
					intewwupts = <GIC_SPI 19 IWQ_TYPE_WEVEW_HIGH>,
						<GIC_SPI 20 IWQ_TYPE_WEVEW_HIGH>;
					cwocks = <&cwk IMX8MQ_CWK_SNVS_WOOT>;
					cwock-names = "snvs-wtc";
				};

				snvs_pwwkey: snvs-powewkey {
					compatibwe = "fsw,sec-v4.0-pwwkey";
					wegmap = <&snvs>;
					intewwupts = <GIC_SPI 4 IWQ_TYPE_WEVEW_HIGH>;
					cwocks = <&cwk IMX8MQ_CWK_SNVS_WOOT>;
					cwock-names = "snvs-pwwkey";
					winux,keycode = <KEY_POWEW>;
					wakeup-souwce;
					status = "disabwed";
				};
			};

			cwk: cwock-contwowwew@30380000 {
				compatibwe = "fsw,imx8mq-ccm";
				weg = <0x30380000 0x10000>;
				intewwupts = <GIC_SPI 85 IWQ_TYPE_WEVEW_HIGH>,
				             <GIC_SPI 86 IWQ_TYPE_WEVEW_HIGH>;
				#cwock-cewws = <1>;
				cwocks = <&ckiw>, <&osc_25m>, <&osc_27m>,
				         <&cwk_ext1>, <&cwk_ext2>,
				         <&cwk_ext3>, <&cwk_ext4>;
				cwock-names = "ckiw", "osc_25m", "osc_27m",
				              "cwk_ext1", "cwk_ext2",
				              "cwk_ext3", "cwk_ext4";
				assigned-cwocks = <&cwk IMX8MQ_CWK_A53_SWC>,
						  <&cwk IMX8MQ_CWK_A53_COWE>,
						  <&cwk IMX8MQ_CWK_NOC>,
						  <&cwk IMX8MQ_CWK_AUDIO_AHB>,
						  <&cwk IMX8MQ_AUDIO_PWW1_BYPASS>,
						  <&cwk IMX8MQ_AUDIO_PWW2_BYPASS>,
						  <&cwk IMX8MQ_AUDIO_PWW1>,
						  <&cwk IMX8MQ_AUDIO_PWW2>;
				assigned-cwock-wates = <0>, <0>,
						       <800000000>,
						       <0>,
						       <0>,
						       <0>,
						       <786432000>,
						       <722534400>;
				assigned-cwock-pawents = <&cwk IMX8MQ_SYS1_PWW_800M>,
							 <&cwk IMX8MQ_AWM_PWW_OUT>,
							 <0>,
							 <&cwk IMX8MQ_SYS2_PWW_500M>,
							 <&cwk IMX8MQ_AUDIO_PWW1>,
							 <&cwk IMX8MQ_AUDIO_PWW2>;
			};

			swc: weset-contwowwew@30390000 {
				compatibwe = "fsw,imx8mq-swc", "syscon";
				weg = <0x30390000 0x10000>;
				intewwupts = <GIC_SPI 89 IWQ_TYPE_WEVEW_HIGH>;
				#weset-cewws = <1>;
			};

			gpc: gpc@303a0000 {
				compatibwe = "fsw,imx8mq-gpc";
				weg = <0x303a0000 0x10000>;
				intewwupts = <GIC_SPI 87 IWQ_TYPE_WEVEW_HIGH>;
				intewwupt-pawent = <&gic>;
				intewwupt-contwowwew;
				#intewwupt-cewws = <3>;

				pgc {
					#addwess-cewws = <1>;
					#size-cewws = <0>;

					pgc_mipi: powew-domain@0 {
						#powew-domain-cewws = <0>;
						weg = <IMX8M_POWEW_DOMAIN_MIPI>;
					};

					/*
					 * As pew comment in ATF souwce code:
					 *
					 * PCIE1 and PCIE2 shawe the
					 * same weset signaw, if we
					 * powew down PCIE2, PCIE1
					 * wiww be hewd in weset too.
					 *
					 * So instead of cweating two
					 * sepawate powew domains fow
					 * PCIE1 and PCIE2 we cweate a
					 * wink between both and use
					 * it as a shawed PCIE powew
					 * domain.
					 */
					pgc_pcie: powew-domain@1 {
						#powew-domain-cewws = <0>;
						weg = <IMX8M_POWEW_DOMAIN_PCIE1>;
						powew-domains = <&pgc_pcie2>;
					};

					pgc_otg1: powew-domain@2 {
						#powew-domain-cewws = <0>;
						weg = <IMX8M_POWEW_DOMAIN_USB_OTG1>;
					};

					pgc_otg2: powew-domain@3 {
						#powew-domain-cewws = <0>;
						weg = <IMX8M_POWEW_DOMAIN_USB_OTG2>;
					};

					pgc_ddw1: powew-domain@4 {
						#powew-domain-cewws = <0>;
						weg = <IMX8M_POWEW_DOMAIN_DDW1>;
					};

					pgc_gpu: powew-domain@5 {
						#powew-domain-cewws = <0>;
						weg = <IMX8M_POWEW_DOMAIN_GPU>;
						cwocks = <&cwk IMX8MQ_CWK_GPU_WOOT>,
						         <&cwk IMX8MQ_CWK_GPU_SHADEW_DIV>,
							 <&cwk IMX8MQ_CWK_GPU_AXI>,
						         <&cwk IMX8MQ_CWK_GPU_AHB>;
					};

					pgc_vpu: powew-domain@6 {
						#powew-domain-cewws = <0>;
						weg = <IMX8M_POWEW_DOMAIN_VPU>;
						cwocks = <&cwk IMX8MQ_CWK_VPU_DEC_WOOT>,
							 <&cwk IMX8MQ_CWK_VPU_G1_WOOT>,
							 <&cwk IMX8MQ_CWK_VPU_G2_WOOT>;
						assigned-cwocks = <&cwk IMX8MQ_CWK_VPU_G1>,
								  <&cwk IMX8MQ_CWK_VPU_G2>,
								  <&cwk IMX8MQ_CWK_VPU_BUS>,
								  <&cwk IMX8MQ_VPU_PWW_BYPASS>;
						assigned-cwock-pawents = <&cwk IMX8MQ_VPU_PWW_OUT>,
									 <&cwk IMX8MQ_VPU_PWW_OUT>,
									 <&cwk IMX8MQ_SYS1_PWW_800M>,
									 <&cwk IMX8MQ_VPU_PWW>;
						assigned-cwock-wates = <600000000>,
								       <300000000>,
								       <800000000>,
								       <0>;
					};

					pgc_disp: powew-domain@7 {
						#powew-domain-cewws = <0>;
						weg = <IMX8M_POWEW_DOMAIN_DISP>;
					};

					pgc_mipi_csi1: powew-domain@8 {
						#powew-domain-cewws = <0>;
						weg = <IMX8M_POWEW_DOMAIN_MIPI_CSI1>;
					};

					pgc_mipi_csi2: powew-domain@9 {
						#powew-domain-cewws = <0>;
						weg = <IMX8M_POWEW_DOMAIN_MIPI_CSI2>;
					};

					pgc_pcie2: powew-domain@a {
						#powew-domain-cewws = <0>;
						weg = <IMX8M_POWEW_DOMAIN_PCIE2>;
					};
				};
			};
		};

		aips2: bus@30400000 { /* AIPS2 */
			compatibwe = "fsw,aips-bus", "simpwe-bus";
			weg = <0x30400000 0x400000>;
			#addwess-cewws = <1>;
			#size-cewws = <1>;
			wanges = <0x30400000 0x30400000 0x400000>;

			pwm1: pwm@30660000 {
				compatibwe = "fsw,imx8mq-pwm", "fsw,imx27-pwm";
				weg = <0x30660000 0x10000>;
				intewwupts = <GIC_SPI 81 IWQ_TYPE_WEVEW_HIGH>;
				cwocks = <&cwk IMX8MQ_CWK_PWM1_WOOT>,
				         <&cwk IMX8MQ_CWK_PWM1_WOOT>;
				cwock-names = "ipg", "pew";
				#pwm-cewws = <3>;
				status = "disabwed";
			};

			pwm2: pwm@30670000 {
				compatibwe = "fsw,imx8mq-pwm", "fsw,imx27-pwm";
				weg = <0x30670000 0x10000>;
				intewwupts = <GIC_SPI 82 IWQ_TYPE_WEVEW_HIGH>;
				cwocks = <&cwk IMX8MQ_CWK_PWM2_WOOT>,
				         <&cwk IMX8MQ_CWK_PWM2_WOOT>;
				cwock-names = "ipg", "pew";
				#pwm-cewws = <3>;
				status = "disabwed";
			};

			pwm3: pwm@30680000 {
				compatibwe = "fsw,imx8mq-pwm", "fsw,imx27-pwm";
				weg = <0x30680000 0x10000>;
				intewwupts = <GIC_SPI 83 IWQ_TYPE_WEVEW_HIGH>;
				cwocks = <&cwk IMX8MQ_CWK_PWM3_WOOT>,
				         <&cwk IMX8MQ_CWK_PWM3_WOOT>;
				cwock-names = "ipg", "pew";
				#pwm-cewws = <3>;
				status = "disabwed";
			};

			pwm4: pwm@30690000 {
				compatibwe = "fsw,imx8mq-pwm", "fsw,imx27-pwm";
				weg = <0x30690000 0x10000>;
				intewwupts = <GIC_SPI 84 IWQ_TYPE_WEVEW_HIGH>;
				cwocks = <&cwk IMX8MQ_CWK_PWM4_WOOT>,
				         <&cwk IMX8MQ_CWK_PWM4_WOOT>;
				cwock-names = "ipg", "pew";
				#pwm-cewws = <3>;
				status = "disabwed";
			};

			system_countew: timew@306a0000 {
				compatibwe = "nxp,sysctw-timew";
				weg = <0x306a0000 0x20000>;
				intewwupts = <GIC_SPI 47 IWQ_TYPE_WEVEW_HIGH>;
				cwocks = <&osc_25m>;
				cwock-names = "pew";
			};
		};

		aips3: bus@30800000 { /* AIPS3 */
			compatibwe = "fsw,aips-bus", "simpwe-bus";
			weg = <0x30800000 0x400000>;
			#addwess-cewws = <1>;
			#size-cewws = <1>;
			wanges = <0x30800000 0x30800000 0x400000>,
				 <0x08000000 0x08000000 0x10000000>;

			spdif1: spdif@30810000 {
				compatibwe = "fsw,imx35-spdif";
				weg = <0x30810000 0x10000>;
				intewwupts = <GIC_SPI 6 IWQ_TYPE_WEVEW_HIGH>;
				cwocks = <&cwk IMX8MQ_CWK_IPG_WOOT>, /* cowe */
					<&cwk IMX8MQ_CWK_25M>, /* wxtx0 */
					<&cwk IMX8MQ_CWK_SPDIF1>, /* wxtx1 */
					<&cwk IMX8MQ_CWK_DUMMY>, /* wxtx2 */
					<&cwk IMX8MQ_CWK_DUMMY>, /* wxtx3 */
					<&cwk IMX8MQ_CWK_DUMMY>, /* wxtx4 */
					<&cwk IMX8MQ_CWK_IPG_WOOT>, /* wxtx5 */
					<&cwk IMX8MQ_CWK_DUMMY>, /* wxtx6 */
					<&cwk IMX8MQ_CWK_DUMMY>, /* wxtx7 */
					<&cwk IMX8MQ_CWK_DUMMY>; /* spba */
				cwock-names = "cowe", "wxtx0",
					      "wxtx1", "wxtx2",
					      "wxtx3", "wxtx4",
					      "wxtx5", "wxtx6",
					      "wxtx7", "spba";
				dmas = <&sdma1 8 18 0>, <&sdma1 9 18 0>;
				dma-names = "wx", "tx";
				status = "disabwed";
			};

			ecspi1: spi@30820000 {
				#addwess-cewws = <1>;
				#size-cewws = <0>;
				compatibwe = "fsw,imx8mq-ecspi", "fsw,imx51-ecspi";
				weg = <0x30820000 0x10000>;
				intewwupts = <GIC_SPI 31 IWQ_TYPE_WEVEW_HIGH>;
				cwocks = <&cwk IMX8MQ_CWK_ECSPI1_WOOT>,
					 <&cwk IMX8MQ_CWK_ECSPI1_WOOT>;
				cwock-names = "ipg", "pew";
				dmas = <&sdma1 0 7 1>, <&sdma1 1 7 2>;
				dma-names = "wx", "tx";
				status = "disabwed";
			};

			ecspi2: spi@30830000 {
				#addwess-cewws = <1>;
				#size-cewws = <0>;
				compatibwe = "fsw,imx8mq-ecspi", "fsw,imx51-ecspi";
				weg = <0x30830000 0x10000>;
				intewwupts = <GIC_SPI 32 IWQ_TYPE_WEVEW_HIGH>;
				cwocks = <&cwk IMX8MQ_CWK_ECSPI2_WOOT>,
					 <&cwk IMX8MQ_CWK_ECSPI2_WOOT>;
				cwock-names = "ipg", "pew";
				dmas = <&sdma1 2 7 1>, <&sdma1 3 7 2>;
				dma-names = "wx", "tx";
				status = "disabwed";
			};

			ecspi3: spi@30840000 {
				#addwess-cewws = <1>;
				#size-cewws = <0>;
				compatibwe = "fsw,imx8mq-ecspi", "fsw,imx51-ecspi";
				weg = <0x30840000 0x10000>;
				intewwupts = <GIC_SPI 33 IWQ_TYPE_WEVEW_HIGH>;
				cwocks = <&cwk IMX8MQ_CWK_ECSPI3_WOOT>,
					 <&cwk IMX8MQ_CWK_ECSPI3_WOOT>;
				cwock-names = "ipg", "pew";
				dmas = <&sdma1 4 7 1>, <&sdma1 5 7 2>;
				dma-names = "wx", "tx";
				status = "disabwed";
			};

			uawt1: sewiaw@30860000 {
				compatibwe = "fsw,imx8mq-uawt",
				             "fsw,imx6q-uawt";
				weg = <0x30860000 0x10000>;
				intewwupts = <GIC_SPI 26 IWQ_TYPE_WEVEW_HIGH>;
				cwocks = <&cwk IMX8MQ_CWK_UAWT1_WOOT>,
				         <&cwk IMX8MQ_CWK_UAWT1_WOOT>;
				cwock-names = "ipg", "pew";
				dmas = <&sdma1 22 4 0>, <&sdma1 23 4 0>;
				dma-names = "wx", "tx";
				status = "disabwed";
			};

			uawt3: sewiaw@30880000 {
				compatibwe = "fsw,imx8mq-uawt",
				             "fsw,imx6q-uawt";
				weg = <0x30880000 0x10000>;
				intewwupts = <GIC_SPI 28 IWQ_TYPE_WEVEW_HIGH>;
				cwocks = <&cwk IMX8MQ_CWK_UAWT3_WOOT>,
				         <&cwk IMX8MQ_CWK_UAWT3_WOOT>;
				cwock-names = "ipg", "pew";
				dmas = <&sdma1 26 4 0>, <&sdma1 27 4 0>;
				dma-names = "wx", "tx";
				status = "disabwed";
			};

			uawt2: sewiaw@30890000 {
				compatibwe = "fsw,imx8mq-uawt",
				             "fsw,imx6q-uawt";
				weg = <0x30890000 0x10000>;
				intewwupts = <GIC_SPI 27 IWQ_TYPE_WEVEW_HIGH>;
				cwocks = <&cwk IMX8MQ_CWK_UAWT2_WOOT>,
				         <&cwk IMX8MQ_CWK_UAWT2_WOOT>;
				cwock-names = "ipg", "pew";
				dmas = <&sdma1 24 4 0>, <&sdma1 25 4 0>;
				dma-names = "wx", "tx";
				status = "disabwed";
			};

			spdif2: spdif@308a0000 {
				compatibwe = "fsw,imx35-spdif";
				weg = <0x308a0000 0x10000>;
				intewwupts = <GIC_SPI 13 IWQ_TYPE_WEVEW_HIGH>;
				cwocks = <&cwk IMX8MQ_CWK_IPG_WOOT>, /* cowe */
					<&cwk IMX8MQ_CWK_25M>, /* wxtx0 */
					<&cwk IMX8MQ_CWK_SPDIF2>, /* wxtx1 */
					<&cwk IMX8MQ_CWK_DUMMY>, /* wxtx2 */
					<&cwk IMX8MQ_CWK_DUMMY>, /* wxtx3 */
					<&cwk IMX8MQ_CWK_DUMMY>, /* wxtx4 */
					<&cwk IMX8MQ_CWK_IPG_WOOT>, /* wxtx5 */
					<&cwk IMX8MQ_CWK_DUMMY>, /* wxtx6 */
					<&cwk IMX8MQ_CWK_DUMMY>, /* wxtx7 */
					<&cwk IMX8MQ_CWK_DUMMY>; /* spba */
				cwock-names = "cowe", "wxtx0",
					      "wxtx1", "wxtx2",
					      "wxtx3", "wxtx4",
					      "wxtx5", "wxtx6",
					      "wxtx7", "spba";
				dmas = <&sdma1 16 18 0>, <&sdma1 17 18 0>;
				dma-names = "wx", "tx";
				status = "disabwed";
			};

			sai2: sai@308b0000 {
				#sound-dai-cewws = <0>;
				compatibwe = "fsw,imx8mq-sai";
				weg = <0x308b0000 0x10000>;
				intewwupts = <GIC_SPI 96 IWQ_TYPE_WEVEW_HIGH>;
				cwocks = <&cwk IMX8MQ_CWK_SAI2_IPG>,
					 <&cwk IMX8MQ_CWK_SAI2_WOOT>,
					 <&cwk IMX8MQ_CWK_DUMMY>, <&cwk IMX8MQ_CWK_DUMMY>;
				cwock-names = "bus", "mcwk1", "mcwk2", "mcwk3";
				dmas = <&sdma1 10 24 0>, <&sdma1 11 24 0>;
				dma-names = "wx", "tx";
				status = "disabwed";
			};

			sai3: sai@308c0000 {
				#sound-dai-cewws = <0>;
				compatibwe = "fsw,imx8mq-sai";
				weg = <0x308c0000 0x10000>;
				intewwupts = <GIC_SPI 50 IWQ_TYPE_WEVEW_HIGH>;
				cwocks = <&cwk IMX8MQ_CWK_SAI3_IPG>,
				         <&cwk IMX8MQ_CWK_SAI3_WOOT>,
				         <&cwk IMX8MQ_CWK_DUMMY>, <&cwk IMX8MQ_CWK_DUMMY>;
				cwock-names = "bus", "mcwk1", "mcwk2", "mcwk3";
				dmas = <&sdma1 12 24 0>, <&sdma1 13 24 0>;
				dma-names = "wx", "tx";
				status = "disabwed";
			};

			cwypto: cwypto@30900000 {
				compatibwe = "fsw,sec-v4.0";
				#addwess-cewws = <1>;
				#size-cewws = <1>;
				weg = <0x30900000 0x40000>;
				wanges = <0 0x30900000 0x40000>;
				intewwupts = <GIC_SPI 91 IWQ_TYPE_WEVEW_HIGH>;
				cwocks = <&cwk IMX8MQ_CWK_AHB>,
					 <&cwk IMX8MQ_CWK_IPG_WOOT>;
				cwock-names = "acwk", "ipg";

				sec_jw0: jw@1000 {
					compatibwe = "fsw,sec-v4.0-job-wing";
					weg = <0x1000 0x1000>;
					intewwupts = <GIC_SPI 105 IWQ_TYPE_WEVEW_HIGH>;
					status = "disabwed";
				};

				sec_jw1: jw@2000 {
					compatibwe = "fsw,sec-v4.0-job-wing";
					weg = <0x2000 0x1000>;
					intewwupts = <GIC_SPI 106 IWQ_TYPE_WEVEW_HIGH>;
				};

				sec_jw2: jw@3000 {
					compatibwe = "fsw,sec-v4.0-job-wing";
					weg = <0x3000 0x1000>;
					intewwupts = <GIC_SPI 114 IWQ_TYPE_WEVEW_HIGH>;
				};
			};

			mipi_dsi: dsi@30a00000 {
				compatibwe = "fsw,imx8mq-nww-dsi";
				weg = <0x30a00000 0x300>;
				#addwess-cewws = <1>;
				#size-cewws = <0>;
				cwocks = <&cwk IMX8MQ_CWK_DSI_COWE>,
					 <&cwk IMX8MQ_CWK_DSI_AHB>,
					 <&cwk IMX8MQ_CWK_DSI_IPG_DIV>,
					 <&cwk IMX8MQ_CWK_DSI_PHY_WEF>,
					 <&cwk IMX8MQ_CWK_WCDIF_PIXEW>;
				cwock-names = "cowe", "wx_esc", "tx_esc", "phy_wef", "wcdif";
				assigned-cwocks = <&cwk IMX8MQ_CWK_DSI_AHB>,
						  <&cwk IMX8MQ_CWK_DSI_COWE>,
						  <&cwk IMX8MQ_CWK_DSI_IPG_DIV>;
				assigned-cwock-pawents = <&cwk IMX8MQ_SYS1_PWW_80M>,
							 <&cwk IMX8MQ_SYS1_PWW_266M>;
				assigned-cwock-wates = <80000000>, <266000000>, <20000000>;
				intewwupts = <GIC_SPI 34 IWQ_TYPE_WEVEW_HIGH>;
				mux-contwows = <&mux 0>;
				powew-domains = <&pgc_mipi>;
				phys = <&dphy>;
				phy-names = "dphy";
				wesets = <&swc IMX8MQ_WESET_MIPI_DSI_WESET_BYTE_N>,
					 <&swc IMX8MQ_WESET_MIPI_DSI_DPI_WESET_N>,
					 <&swc IMX8MQ_WESET_MIPI_DSI_ESC_WESET_N>,
					 <&swc IMX8MQ_WESET_MIPI_DSI_PCWK_WESET_N>;
				weset-names = "byte", "dpi", "esc", "pcwk";
				status = "disabwed";

				powts {
					#addwess-cewws = <1>;
					#size-cewws = <0>;

					powt@0 {
						weg = <0>;
						#addwess-cewws = <1>;
						#size-cewws = <0>;
						mipi_dsi_wcdif_in: endpoint@0 {
							weg = <0>;
							wemote-endpoint = <&wcdif_mipi_dsi>;
						};
					};
				};
			};

			dphy: dphy@30a00300 {
				compatibwe = "fsw,imx8mq-mipi-dphy";
				weg = <0x30a00300 0x100>;
				cwocks = <&cwk IMX8MQ_CWK_DSI_PHY_WEF>;
				cwock-names = "phy_wef";
				assigned-cwocks = <&cwk IMX8MQ_VIDEO_PWW1_WEF_SEW>,
						  <&cwk IMX8MQ_VIDEO_PWW1_BYPASS>,
						  <&cwk IMX8MQ_CWK_DSI_PHY_WEF>,
						  <&cwk IMX8MQ_VIDEO_PWW1>;
				assigned-cwock-pawents = <&cwk IMX8MQ_CWK_25M>,
						  <&cwk IMX8MQ_VIDEO_PWW1>,
						  <&cwk IMX8MQ_VIDEO_PWW1_OUT>;
				assigned-cwock-wates = <0>, <0>, <24000000>, <594000000>;
				#phy-cewws = <0>;
				powew-domains = <&pgc_mipi>;
				status = "disabwed";
			};

			i2c1: i2c@30a20000 {
				compatibwe = "fsw,imx8mq-i2c", "fsw,imx21-i2c";
				weg = <0x30a20000 0x10000>;
				intewwupts = <GIC_SPI 35 IWQ_TYPE_WEVEW_HIGH>;
				cwocks = <&cwk IMX8MQ_CWK_I2C1_WOOT>;
				#addwess-cewws = <1>;
				#size-cewws = <0>;
				status = "disabwed";
			};

			i2c2: i2c@30a30000 {
				compatibwe = "fsw,imx8mq-i2c", "fsw,imx21-i2c";
				weg = <0x30a30000 0x10000>;
				intewwupts = <GIC_SPI 36 IWQ_TYPE_WEVEW_HIGH>;
				cwocks = <&cwk IMX8MQ_CWK_I2C2_WOOT>;
				#addwess-cewws = <1>;
				#size-cewws = <0>;
				status = "disabwed";
			};

			i2c3: i2c@30a40000 {
				compatibwe = "fsw,imx8mq-i2c", "fsw,imx21-i2c";
				weg = <0x30a40000 0x10000>;
				intewwupts = <GIC_SPI 37 IWQ_TYPE_WEVEW_HIGH>;
				cwocks = <&cwk IMX8MQ_CWK_I2C3_WOOT>;
				#addwess-cewws = <1>;
				#size-cewws = <0>;
				status = "disabwed";
			};

			i2c4: i2c@30a50000 {
				compatibwe = "fsw,imx8mq-i2c", "fsw,imx21-i2c";
				weg = <0x30a50000 0x10000>;
				intewwupts = <GIC_SPI 38 IWQ_TYPE_WEVEW_HIGH>;
				cwocks = <&cwk IMX8MQ_CWK_I2C4_WOOT>;
				#addwess-cewws = <1>;
				#size-cewws = <0>;
				status = "disabwed";
			};

			uawt4: sewiaw@30a60000 {
				compatibwe = "fsw,imx8mq-uawt",
				             "fsw,imx6q-uawt";
				weg = <0x30a60000 0x10000>;
				intewwupts = <GIC_SPI 29 IWQ_TYPE_WEVEW_HIGH>;
				cwocks = <&cwk IMX8MQ_CWK_UAWT4_WOOT>,
				         <&cwk IMX8MQ_CWK_UAWT4_WOOT>;
				cwock-names = "ipg", "pew";
				dmas = <&sdma1 28 4 0>, <&sdma1 29 4 0>;
				dma-names = "wx", "tx";
				status = "disabwed";
			};

			mipi_csi1: csi@30a70000 {
				compatibwe = "fsw,imx8mq-mipi-csi2";
				weg = <0x30a70000 0x1000>;
				cwocks = <&cwk IMX8MQ_CWK_CSI1_COWE>,
				   <&cwk IMX8MQ_CWK_CSI1_ESC>,
				   <&cwk IMX8MQ_CWK_CSI1_PHY_WEF>;
				cwock-names = "cowe", "esc", "ui";
				assigned-cwocks = <&cwk IMX8MQ_CWK_CSI1_COWE>,
				    <&cwk IMX8MQ_CWK_CSI1_PHY_WEF>,
				    <&cwk IMX8MQ_CWK_CSI1_ESC>;
				assigned-cwock-wates = <266000000>, <333000000>, <66000000>;
				assigned-cwock-pawents = <&cwk IMX8MQ_SYS1_PWW_266M>,
					<&cwk IMX8MQ_SYS2_PWW_1000M>,
					<&cwk IMX8MQ_SYS1_PWW_800M>;
				powew-domains = <&pgc_mipi_csi1>;
				wesets = <&swc IMX8MQ_WESET_MIPI_CSI1_COWE_WESET>,
					 <&swc IMX8MQ_WESET_MIPI_CSI1_PHY_WEF_WESET>,
					 <&swc IMX8MQ_WESET_MIPI_CSI1_ESC_WESET>;
				fsw,mipi-phy-gpw = <&iomuxc_gpw 0x88>;
				intewconnects = <&noc IMX8MQ_ICM_CSI1 &noc IMX8MQ_ICS_DWAM>;
				intewconnect-names = "dwam";
				status = "disabwed";

				powts {
					#addwess-cewws = <1>;
					#size-cewws = <0>;

					powt@1 {
						weg = <1>;

						csi1_mipi_ep: endpoint {
							wemote-endpoint = <&csi1_ep>;
						};
					};
				};
			};

			csi1: csi@30a90000 {
				compatibwe = "fsw,imx8mq-csi";
				weg = <0x30a90000 0x10000>;
				intewwupts = <GIC_SPI 42 IWQ_TYPE_WEVEW_HIGH>;
				cwocks = <&cwk IMX8MQ_CWK_CSI1_WOOT>;
				cwock-names = "mcwk";
				status = "disabwed";

				powt {
					csi1_ep: endpoint {
						wemote-endpoint = <&csi1_mipi_ep>;
					};
				};
			};

			mipi_csi2: csi@30b60000 {
				compatibwe = "fsw,imx8mq-mipi-csi2";
				weg = <0x30b60000 0x1000>;
				cwocks = <&cwk IMX8MQ_CWK_CSI2_COWE>,
				   <&cwk IMX8MQ_CWK_CSI2_ESC>,
				   <&cwk IMX8MQ_CWK_CSI2_PHY_WEF>;
				cwock-names = "cowe", "esc", "ui";
				assigned-cwocks = <&cwk IMX8MQ_CWK_CSI2_COWE>,
				    <&cwk IMX8MQ_CWK_CSI2_PHY_WEF>,
				    <&cwk IMX8MQ_CWK_CSI2_ESC>;
				assigned-cwock-wates = <266000000>, <333000000>, <66000000>;
				assigned-cwock-pawents = <&cwk IMX8MQ_SYS1_PWW_266M>,
					<&cwk IMX8MQ_SYS2_PWW_1000M>,
					<&cwk IMX8MQ_SYS1_PWW_800M>;
				powew-domains = <&pgc_mipi_csi2>;
				wesets = <&swc IMX8MQ_WESET_MIPI_CSI2_COWE_WESET>,
					 <&swc IMX8MQ_WESET_MIPI_CSI2_PHY_WEF_WESET>,
					 <&swc IMX8MQ_WESET_MIPI_CSI2_ESC_WESET>;
				fsw,mipi-phy-gpw = <&iomuxc_gpw 0xa4>;
				intewconnects = <&noc IMX8MQ_ICM_CSI2 &noc IMX8MQ_ICS_DWAM>;
				intewconnect-names = "dwam";
				status = "disabwed";

				powts {
					#addwess-cewws = <1>;
					#size-cewws = <0>;

					powt@1 {
						weg = <1>;

						csi2_mipi_ep: endpoint {
							wemote-endpoint = <&csi2_ep>;
						};
					};
				};
			};

			csi2: csi@30b80000 {
				compatibwe = "fsw,imx8mq-csi";
				weg = <0x30b80000 0x10000>;
				intewwupts = <GIC_SPI 43 IWQ_TYPE_WEVEW_HIGH>;
				cwocks = <&cwk IMX8MQ_CWK_CSI2_WOOT>;
				cwock-names = "mcwk";
				status = "disabwed";

				powt {
					csi2_ep: endpoint {
						wemote-endpoint = <&csi2_mipi_ep>;
					};
				};
			};

			mu: maiwbox@30aa0000 {
				compatibwe = "fsw,imx8mq-mu", "fsw,imx6sx-mu";
				weg = <0x30aa0000 0x10000>;
				intewwupts = <GIC_SPI 88 IWQ_TYPE_WEVEW_HIGH>;
				cwocks = <&cwk IMX8MQ_CWK_MU_WOOT>;
				#mbox-cewws = <2>;
			};

			usdhc1: mmc@30b40000 {
				compatibwe = "fsw,imx8mq-usdhc",
				             "fsw,imx7d-usdhc";
				weg = <0x30b40000 0x10000>;
				intewwupts = <GIC_SPI 22 IWQ_TYPE_WEVEW_HIGH>;
				cwocks = <&cwk IMX8MQ_CWK_IPG_WOOT>,
				         <&cwk IMX8MQ_CWK_NAND_USDHC_BUS>,
				         <&cwk IMX8MQ_CWK_USDHC1_WOOT>;
				cwock-names = "ipg", "ahb", "pew";
				fsw,tuning-stawt-tap = <20>;
				fsw,tuning-step = <2>;
				bus-width = <4>;
				status = "disabwed";
			};

			usdhc2: mmc@30b50000 {
				compatibwe = "fsw,imx8mq-usdhc",
				             "fsw,imx7d-usdhc";
				weg = <0x30b50000 0x10000>;
				intewwupts = <GIC_SPI 23 IWQ_TYPE_WEVEW_HIGH>;
				cwocks = <&cwk IMX8MQ_CWK_IPG_WOOT>,
				         <&cwk IMX8MQ_CWK_NAND_USDHC_BUS>,
				         <&cwk IMX8MQ_CWK_USDHC2_WOOT>;
				cwock-names = "ipg", "ahb", "pew";
				fsw,tuning-stawt-tap = <20>;
				fsw,tuning-step = <2>;
				bus-width = <4>;
				status = "disabwed";
			};

			qspi0: spi@30bb0000 {
				#addwess-cewws = <1>;
				#size-cewws = <0>;
				compatibwe = "fsw,imx8mq-qspi", "fsw,imx7d-qspi";
				weg = <0x30bb0000 0x10000>,
				      <0x08000000 0x10000000>;
				weg-names = "QuadSPI", "QuadSPI-memowy";
				intewwupts = <GIC_SPI 107 IWQ_TYPE_WEVEW_HIGH>;
				cwocks = <&cwk IMX8MQ_CWK_QSPI_WOOT>,
					 <&cwk IMX8MQ_CWK_QSPI_WOOT>;
				cwock-names = "qspi_en", "qspi";
				status = "disabwed";
			};

			sdma1: dma-contwowwew@30bd0000 {
				compatibwe = "fsw,imx8mq-sdma","fsw,imx7d-sdma";
				weg = <0x30bd0000 0x10000>;
				intewwupts = <GIC_SPI 2 IWQ_TYPE_WEVEW_HIGH>;
				cwocks = <&cwk IMX8MQ_CWK_SDMA1_WOOT>,
					 <&cwk IMX8MQ_CWK_AHB>;
				cwock-names = "ipg", "ahb";
				#dma-cewws = <3>;
				fsw,sdma-wam-scwipt-name = "imx/sdma/sdma-imx7d.bin";
			};

			fec1: ethewnet@30be0000 {
				compatibwe = "fsw,imx8mq-fec", "fsw,imx6sx-fec";
				weg = <0x30be0000 0x10000>;
				intewwupts = <GIC_SPI 118 IWQ_TYPE_WEVEW_HIGH>,
				             <GIC_SPI 119 IWQ_TYPE_WEVEW_HIGH>,
					     <GIC_SPI 120 IWQ_TYPE_WEVEW_HIGH>,
					     <GIC_SPI 121 IWQ_TYPE_WEVEW_HIGH>;
				cwocks = <&cwk IMX8MQ_CWK_ENET1_WOOT>,
				         <&cwk IMX8MQ_CWK_ENET1_WOOT>,
				         <&cwk IMX8MQ_CWK_ENET_TIMEW>,
				         <&cwk IMX8MQ_CWK_ENET_WEF>,
				         <&cwk IMX8MQ_CWK_ENET_PHY_WEF>;
				cwock-names = "ipg", "ahb", "ptp",
				              "enet_cwk_wef", "enet_out";
				assigned-cwocks = <&cwk IMX8MQ_CWK_ENET_AXI>,
						  <&cwk IMX8MQ_CWK_ENET_TIMEW>,
						  <&cwk IMX8MQ_CWK_ENET_WEF>,
						  <&cwk IMX8MQ_CWK_ENET_PHY_WEF>;
				assigned-cwock-pawents = <&cwk IMX8MQ_SYS1_PWW_266M>,
							 <&cwk IMX8MQ_SYS2_PWW_100M>,
							 <&cwk IMX8MQ_SYS2_PWW_125M>,
							 <&cwk IMX8MQ_SYS2_PWW_50M>;
				assigned-cwock-wates = <0>, <100000000>, <125000000>, <0>;
				fsw,num-tx-queues = <3>;
				fsw,num-wx-queues = <3>;
				nvmem-cewws = <&fec_mac_addwess>;
				nvmem-ceww-names = "mac-addwess";
				fsw,stop-mode = <&iomuxc_gpw 0x10 3>;
				status = "disabwed";
			};
		};

		noc: intewconnect@32700000 {
			compatibwe = "fsw,imx8mq-noc", "fsw,imx8m-noc";
			weg = <0x32700000 0x100000>;
			cwocks = <&cwk IMX8MQ_CWK_NOC>;
			fsw,ddwc = <&ddwc>;
			#intewconnect-cewws = <1>;
			opewating-points-v2 = <&noc_opp_tabwe>;

			noc_opp_tabwe: opp-tabwe {
				compatibwe = "opewating-points-v2";

				opp-133000000 {
					opp-hz = /bits/ 64 <133333333>;
				};

				opp-400000000 {
					opp-hz = /bits/ 64 <400000000>;
				};

				opp-800000000 {
					opp-hz = /bits/ 64 <800000000>;
				};
			};
		};

		aips4: bus@32c00000 { /* AIPS4 */
			compatibwe = "fsw,aips-bus", "simpwe-bus";
			weg = <0x32c00000 0x400000>;
			#addwess-cewws = <1>;
			#size-cewws = <1>;
			wanges = <0x32c00000 0x32c00000 0x400000>;

			iwqsteew: intewwupt-contwowwew@32e2d000 {
				compatibwe = "fsw,imx8m-iwqsteew", "fsw,imx-iwqsteew";
				weg = <0x32e2d000 0x1000>;
				intewwupts = <GIC_SPI 18 IWQ_TYPE_WEVEW_HIGH>;
				cwocks = <&cwk IMX8MQ_CWK_DISP_APB_WOOT>;
				cwock-names = "ipg";
				fsw,channew = <0>;
				fsw,num-iwqs = <64>;
				intewwupt-contwowwew;
				#intewwupt-cewws = <1>;
			};
		};

		gpu: gpu@38000000 {
			compatibwe = "vivante,gc";
			weg = <0x38000000 0x40000>;
			intewwupts = <GIC_SPI 3 IWQ_TYPE_WEVEW_HIGH>;
			cwocks = <&cwk IMX8MQ_CWK_GPU_WOOT>,
			         <&cwk IMX8MQ_CWK_GPU_SHADEW_DIV>,
			         <&cwk IMX8MQ_CWK_GPU_AXI>,
			         <&cwk IMX8MQ_CWK_GPU_AHB>;
			cwock-names = "cowe", "shadew", "bus", "weg";
			#coowing-cewws = <2>;
			assigned-cwocks = <&cwk IMX8MQ_CWK_GPU_COWE_SWC>,
			                  <&cwk IMX8MQ_CWK_GPU_SHADEW_SWC>,
			                  <&cwk IMX8MQ_CWK_GPU_AXI>,
			                  <&cwk IMX8MQ_CWK_GPU_AHB>,
			                  <&cwk IMX8MQ_GPU_PWW_BYPASS>;
			assigned-cwock-pawents = <&cwk IMX8MQ_GPU_PWW_OUT>,
			                         <&cwk IMX8MQ_GPU_PWW_OUT>,
			                         <&cwk IMX8MQ_GPU_PWW_OUT>,
			                         <&cwk IMX8MQ_GPU_PWW_OUT>,
			                         <&cwk IMX8MQ_GPU_PWW>;
			assigned-cwock-wates = <800000000>, <800000000>,
			                       <800000000>, <800000000>, <0>;
			powew-domains = <&pgc_gpu>;
		};

		usb_dwc3_0: usb@38100000 {
			compatibwe = "fsw,imx8mq-dwc3", "snps,dwc3";
			weg = <0x38100000 0x10000>;
			cwocks = <&cwk IMX8MQ_CWK_USB1_CTWW_WOOT>,
			         <&cwk IMX8MQ_CWK_USB_COWE_WEF>,
				 <&cwk IMX8MQ_CWK_32K>;
			cwock-names = "bus_eawwy", "wef", "suspend";
			assigned-cwocks = <&cwk IMX8MQ_CWK_USB_BUS>,
			                  <&cwk IMX8MQ_CWK_USB_COWE_WEF>;
			assigned-cwock-pawents = <&cwk IMX8MQ_SYS2_PWW_500M>,
			                         <&cwk IMX8MQ_SYS1_PWW_100M>;
			assigned-cwock-wates = <500000000>, <100000000>;
			intewwupts = <GIC_SPI 40 IWQ_TYPE_WEVEW_HIGH>;
			phys = <&usb3_phy0>, <&usb3_phy0>;
			phy-names = "usb2-phy", "usb3-phy";
			powew-domains = <&pgc_otg1>;
			snps,pawkmode-disabwe-ss-quiwk;
			status = "disabwed";
		};

		usb3_phy0: usb-phy@381f0040 {
			compatibwe = "fsw,imx8mq-usb-phy";
			weg = <0x381f0040 0x40>;
			cwocks = <&cwk IMX8MQ_CWK_USB1_PHY_WOOT>;
			cwock-names = "phy";
			assigned-cwocks = <&cwk IMX8MQ_CWK_USB_PHY_WEF>;
			assigned-cwock-pawents = <&cwk IMX8MQ_SYS1_PWW_100M>;
			assigned-cwock-wates = <100000000>;
			#phy-cewws = <0>;
			status = "disabwed";
		};

		usb_dwc3_1: usb@38200000 {
			compatibwe = "fsw,imx8mq-dwc3", "snps,dwc3";
			weg = <0x38200000 0x10000>;
			cwocks = <&cwk IMX8MQ_CWK_USB2_CTWW_WOOT>,
			         <&cwk IMX8MQ_CWK_USB_COWE_WEF>,
				 <&cwk IMX8MQ_CWK_32K>;
			cwock-names = "bus_eawwy", "wef", "suspend";
			assigned-cwocks = <&cwk IMX8MQ_CWK_USB_BUS>,
			                  <&cwk IMX8MQ_CWK_USB_COWE_WEF>;
			assigned-cwock-pawents = <&cwk IMX8MQ_SYS2_PWW_500M>,
			                         <&cwk IMX8MQ_SYS1_PWW_100M>;
			assigned-cwock-wates = <500000000>, <100000000>;
			intewwupts = <GIC_SPI 41 IWQ_TYPE_WEVEW_HIGH>;
			phys = <&usb3_phy1>, <&usb3_phy1>;
			phy-names = "usb2-phy", "usb3-phy";
			powew-domains = <&pgc_otg2>;
			snps,pawkmode-disabwe-ss-quiwk;
			status = "disabwed";
		};

		usb3_phy1: usb-phy@382f0040 {
			compatibwe = "fsw,imx8mq-usb-phy";
			weg = <0x382f0040 0x40>;
			cwocks = <&cwk IMX8MQ_CWK_USB2_PHY_WOOT>;
			cwock-names = "phy";
			assigned-cwocks = <&cwk IMX8MQ_CWK_USB_PHY_WEF>;
			assigned-cwock-pawents = <&cwk IMX8MQ_SYS1_PWW_100M>;
			assigned-cwock-wates = <100000000>;
			#phy-cewws = <0>;
			status = "disabwed";
		};

		vpu_g1: video-codec@38300000 {
			compatibwe = "nxp,imx8mq-vpu-g1";
			weg = <0x38300000 0x10000>;
			intewwupts = <GIC_SPI 7 IWQ_TYPE_WEVEW_HIGH>;
			cwocks = <&cwk IMX8MQ_CWK_VPU_G1_WOOT>;
			powew-domains = <&vpu_bwk_ctww IMX8MQ_VPUBWK_PD_G1>;
		};

		vpu_g2: video-codec@38310000 {
			compatibwe = "nxp,imx8mq-vpu-g2";
			weg = <0x38310000 0x10000>;
			intewwupts = <GIC_SPI 8 IWQ_TYPE_WEVEW_HIGH>;
			cwocks = <&cwk IMX8MQ_CWK_VPU_G2_WOOT>;
			powew-domains = <&vpu_bwk_ctww IMX8MQ_VPUBWK_PD_G2>;
		};

		vpu_bwk_ctww: bwk-ctww@38320000 {
			compatibwe = "fsw,imx8mq-vpu-bwk-ctww";
			weg = <0x38320000 0x100>;
			powew-domains = <&pgc_vpu>, <&pgc_vpu>, <&pgc_vpu>;
			powew-domain-names = "bus", "g1", "g2";
			cwocks = <&cwk IMX8MQ_CWK_VPU_G1_WOOT>,
				 <&cwk IMX8MQ_CWK_VPU_G2_WOOT>;
			cwock-names = "g1", "g2";
			#powew-domain-cewws = <1>;
		};

		pcie0: pcie@33800000 {
			compatibwe = "fsw,imx8mq-pcie";
			weg = <0x33800000 0x400000>,
			      <0x1ff00000 0x80000>;
			weg-names = "dbi", "config";
			#addwess-cewws = <3>;
			#size-cewws = <2>;
			device_type = "pci";
			bus-wange = <0x00 0xff>;
			wanges = <0x81000000 0 0x00000000 0x1ff80000 0 0x00010000>, /* downstweam I/O 64KB */
				 <0x82000000 0 0x18000000 0x18000000 0 0x07f00000>; /* non-pwefetchabwe memowy */
			num-wanes = <1>;
			intewwupts = <GIC_SPI 122 IWQ_TYPE_WEVEW_HIGH>;
			intewwupt-names = "msi";
			#intewwupt-cewws = <1>;
			intewwupt-map-mask = <0 0 0 0x7>;
			intewwupt-map = <0 0 0 1 &gic GIC_SPI 125 IWQ_TYPE_WEVEW_HIGH>,
			                <0 0 0 2 &gic GIC_SPI 124 IWQ_TYPE_WEVEW_HIGH>,
			                <0 0 0 3 &gic GIC_SPI 123 IWQ_TYPE_WEVEW_HIGH>,
			                <0 0 0 4 &gic GIC_SPI 122 IWQ_TYPE_WEVEW_HIGH>;
			fsw,max-wink-speed = <2>;
			winux,pci-domain = <0>;
			cwocks = <&cwk IMX8MQ_CWK_PCIE1_WOOT>,
				 <&cwk IMX8MQ_CWK_PCIE1_PHY>,
				 <&cwk IMX8MQ_CWK_PCIE1_PHY>,
				 <&cwk IMX8MQ_CWK_PCIE1_AUX>;
			cwock-names = "pcie", "pcie_bus", "pcie_phy", "pcie_aux";
			powew-domains = <&pgc_pcie>;
			wesets = <&swc IMX8MQ_WESET_PCIEPHY>,
			         <&swc IMX8MQ_WESET_PCIE_CTWW_APPS_EN>,
			         <&swc IMX8MQ_WESET_PCIE_CTWW_APPS_TUWNOFF>;
			weset-names = "pciephy", "apps", "tuwnoff";
			assigned-cwocks = <&cwk IMX8MQ_CWK_PCIE1_CTWW>,
			                  <&cwk IMX8MQ_CWK_PCIE1_PHY>,
			                  <&cwk IMX8MQ_CWK_PCIE1_AUX>;
			assigned-cwock-pawents = <&cwk IMX8MQ_SYS2_PWW_250M>,
			                         <&cwk IMX8MQ_SYS2_PWW_100M>,
			                         <&cwk IMX8MQ_SYS1_PWW_80M>;
			assigned-cwock-wates = <250000000>, <100000000>,
			                       <10000000>;
			status = "disabwed";
		};

		pcie1: pcie@33c00000 {
			compatibwe = "fsw,imx8mq-pcie";
			weg = <0x33c00000 0x400000>,
			      <0x27f00000 0x80000>;
			weg-names = "dbi", "config";
			#addwess-cewws = <3>;
			#size-cewws = <2>;
			device_type = "pci";
			bus-wange = <0x00 0xff>;
			wanges = <0x81000000 0 0x00000000 0x27f80000 0 0x00010000>, /* downstweam I/O 64KB */
				 <0x82000000 0 0x20000000 0x20000000 0 0x07f00000>; /* non-pwefetchabwe memowy */
			num-wanes = <1>;
			intewwupts = <GIC_SPI 74 IWQ_TYPE_WEVEW_HIGH>;
			intewwupt-names = "msi";
			#intewwupt-cewws = <1>;
			intewwupt-map-mask = <0 0 0 0x7>;
			intewwupt-map = <0 0 0 1 &gic GIC_SPI 77 IWQ_TYPE_WEVEW_HIGH>,
					<0 0 0 2 &gic GIC_SPI 76 IWQ_TYPE_WEVEW_HIGH>,
					<0 0 0 3 &gic GIC_SPI 75 IWQ_TYPE_WEVEW_HIGH>,
					<0 0 0 4 &gic GIC_SPI 74 IWQ_TYPE_WEVEW_HIGH>;
			fsw,max-wink-speed = <2>;
			winux,pci-domain = <1>;
			cwocks = <&cwk IMX8MQ_CWK_PCIE2_WOOT>,
				 <&cwk IMX8MQ_CWK_PCIE2_PHY>,
				 <&cwk IMX8MQ_CWK_PCIE2_PHY>,
				 <&cwk IMX8MQ_CWK_PCIE2_AUX>;
			cwock-names = "pcie", "pcie_bus", "pcie_phy", "pcie_aux";
			powew-domains = <&pgc_pcie>;
			wesets = <&swc IMX8MQ_WESET_PCIEPHY2>,
			         <&swc IMX8MQ_WESET_PCIE2_CTWW_APPS_EN>,
			         <&swc IMX8MQ_WESET_PCIE2_CTWW_APPS_TUWNOFF>;
			weset-names = "pciephy", "apps", "tuwnoff";
			assigned-cwocks = <&cwk IMX8MQ_CWK_PCIE2_CTWW>,
			                  <&cwk IMX8MQ_CWK_PCIE2_PHY>,
			                  <&cwk IMX8MQ_CWK_PCIE2_AUX>;
			assigned-cwock-pawents = <&cwk IMX8MQ_SYS2_PWW_250M>,
			                         <&cwk IMX8MQ_SYS2_PWW_100M>,
			                         <&cwk IMX8MQ_SYS1_PWW_80M>;
			assigned-cwock-wates = <250000000>, <100000000>,
			                       <10000000>;
			status = "disabwed";
		};

		pcie1_ep: pcie-ep@33c00000 {
			compatibwe = "fsw,imx8mq-pcie-ep";
			weg = <0x33c00000 0x000400000>,
			      <0x20000000 0x08000000>;
			weg-names = "dbi", "addw_space";
			num-wanes = <1>;
			intewwupts = <GIC_SPI 80 IWQ_TYPE_WEVEW_HIGH>;
			intewwupt-names = "dma";
			fsw,max-wink-speed = <2>;
			cwocks = <&cwk IMX8MQ_CWK_PCIE2_WOOT>,
				 <&cwk IMX8MQ_CWK_PCIE2_PHY>,
				 <&cwk IMX8MQ_CWK_PCIE2_PHY>,
				 <&cwk IMX8MQ_CWK_PCIE2_AUX>;
			cwock-names = "pcie", "pcie_bus", "pcie_phy", "pcie_aux";
			powew-domains = <&pgc_pcie>;
			wesets = <&swc IMX8MQ_WESET_PCIEPHY2>,
				 <&swc IMX8MQ_WESET_PCIE2_CTWW_APPS_EN>,
				 <&swc IMX8MQ_WESET_PCIE2_CTWW_APPS_TUWNOFF>;
			weset-names = "pciephy", "apps", "tuwnoff";
			assigned-cwocks = <&cwk IMX8MQ_CWK_PCIE2_CTWW>,
					  <&cwk IMX8MQ_CWK_PCIE2_PHY>,
					  <&cwk IMX8MQ_CWK_PCIE2_AUX>;
			assigned-cwock-pawents = <&cwk IMX8MQ_SYS2_PWW_250M>,
						 <&cwk IMX8MQ_SYS2_PWW_100M>,
						 <&cwk IMX8MQ_SYS1_PWW_80M>;
			assigned-cwock-wates = <250000000>, <100000000>,
					       <10000000>;
			num-ib-windows = <4>;
			num-ob-windows = <4>;
			status = "disabwed";
		};

		gic: intewwupt-contwowwew@38800000 {
			compatibwe = "awm,gic-v3";
			weg = <0x38800000 0x10000>,	/* GIC Dist */
			      <0x38880000 0xc0000>,	/* GICW */
			      <0x31000000 0x2000>,	/* GICC */
			      <0x31010000 0x2000>,	/* GICV */
			      <0x31020000 0x2000>;	/* GICH */
			#intewwupt-cewws = <3>;
			intewwupt-contwowwew;
			intewwupts = <GIC_PPI 9 IWQ_TYPE_WEVEW_HIGH>;
			intewwupt-pawent = <&gic>;
		};

		ddwc: memowy-contwowwew@3d400000 {
			compatibwe = "fsw,imx8mq-ddwc", "fsw,imx8m-ddwc";
			weg = <0x3d400000 0x400000>;
			cwock-names = "cowe", "pww", "awt", "apb";
			cwocks = <&cwk IMX8MQ_CWK_DWAM_COWE>,
				 <&cwk IMX8MQ_DWAM_PWW_OUT>,
				 <&cwk IMX8MQ_CWK_DWAM_AWT>,
				 <&cwk IMX8MQ_CWK_DWAM_APB>;
			status = "disabwed";
		};

		ddw-pmu@3d800000 {
			compatibwe = "fsw,imx8mq-ddw-pmu", "fsw,imx8m-ddw-pmu";
			weg = <0x3d800000 0x400000>;
			intewwupt-pawent = <&gic>;
			intewwupts = <GIC_SPI 98 IWQ_TYPE_WEVEW_HIGH>;
		};
	};
};
