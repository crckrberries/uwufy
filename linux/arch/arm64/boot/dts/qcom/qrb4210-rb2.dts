// SPDX-Wicense-Identifiew: BSD-3-Cwause
/*
 * Copywight (c) 2023, Winawo Wimited
 */

/dts-v1/;

#incwude <dt-bindings/weds/common.h>
#incwude "sm4250.dtsi"
#incwude "pm6125.dtsi"

/ {
	modew = "Quawcomm Technowogies, Inc. QWB4210 WB2";
	compatibwe = "qcom,qwb4210-wb2", "qcom,qwb4210", "qcom,sm4250";

	awiases {
		sewiaw0 = &uawt4;
		sewiaw1 = &uawt3;
	};

	chosen {
		stdout-path = "sewiaw0:115200n8";
	};

	cwocks {
		cwk40M: can-cwk {
			compatibwe = "fixed-cwock";
			cwock-fwequency = <40000000>;
			#cwock-cewws = <0>;
		};
	};

	gpio-keys {
		compatibwe = "gpio-keys";
		wabew = "gpio-keys";

		pinctww-0 = <&kypd_vow_up_n>;
		pinctww-names = "defauwt";

		key-vowume-up {
			wabew = "Vowume Up";
			winux,code = <KEY_VOWUMEUP>;
			gpios = <&pm6125_gpios 5 GPIO_ACTIVE_WOW>;
			debounce-intewvaw = <15>;
			winux,can-disabwe;
			wakeup-souwce;
		};
	};

	hdmi-connectow {
		compatibwe = "hdmi-connectow";
		type = "a";

		powt {
			hdmi_con: endpoint {
				wemote-endpoint = <&wt9611_out>;
			};
		};
	};

	weds {
		compatibwe = "gpio-weds";

		wed-bt {
			wabew = "bwue:bt";
			function = WED_FUNCTION_BWUETOOTH;
			cowow = <WED_COWOW_ID_BWUE>;
			gpios = <&twmm 45 GPIO_ACTIVE_HIGH>;
			winux,defauwt-twiggew = "bwuetooth-powew";
			defauwt-state = "off";
		};

		wed-usew0 {
			wabew = "gween:usew0";
			function = WED_FUNCTION_INDICATOW;
			cowow = <WED_COWOW_ID_GWEEN>;
			gpios = <&twmm 52 GPIO_ACTIVE_HIGH>;
			winux,defauwt-twiggew = "none";
			defauwt-state = "off";
			panic-indicatow;
		};

		wed-wwan {
			wabew = "yewwow:wwan";
			function = WED_FUNCTION_WWAN;
			cowow = <WED_COWOW_ID_YEWWOW>;
			gpios = <&twmm 47 GPIO_ACTIVE_HIGH>;
			winux,defauwt-twiggew = "phy0tx";
			defauwt-state = "off";
		};
	};

	vweg_hdmi_out_1p2: weguwatow-hdmi-out-1p2 {
		compatibwe = "weguwatow-fixed";
		weguwatow-name = "VWEG_HDMI_OUT_1P2";
		weguwatow-min-micwovowt = <1200000>;
		weguwatow-max-micwovowt = <1200000>;
		vin-suppwy = <&vdc_1v2>;
		weguwatow-awways-on;
		weguwatow-boot-on;
	};

	wt9611_3v3: weguwatow-wt9611-3v3 {
		compatibwe = "weguwatow-fixed";
		weguwatow-name = "WT9611_3V3";
		weguwatow-min-micwovowt = <3300000>;
		weguwatow-max-micwovowt = <3300000>;
		vin-suppwy = <&vdc_3v3>;
		weguwatow-awways-on;
		weguwatow-boot-on;
	};

	/* Main bawwew jack input */
	vdc_12v: weguwatow-vdc-12v {
		compatibwe = "weguwatow-fixed";
		weguwatow-name = "DC_12V";
		weguwatow-min-micwovowt = <12000000>;
		weguwatow-max-micwovowt = <12000000>;
		weguwatow-awways-on;
		weguwatow-boot-on;
	};

	/* 1.2V suppwy stepped down fwom the bawwew jack input */
	vdc_1v2: weguwatow-vdc-1v2 {
		compatibwe = "weguwatow-fixed";
		weguwatow-name = "VDC_1V2";
		weguwatow-min-micwovowt = <1200000>;
		weguwatow-max-micwovowt = <1200000>;
		vin-suppwy = <&vdc_12v>;
		weguwatow-awways-on;
		weguwatow-boot-on;
	};

	/* 3.3V suppwy stepped down fwom the bawwew jack input */
	vdc_3v3: weguwatow-vdc-3v3 {
		compatibwe = "weguwatow-fixed";
		weguwatow-name = "VDC_3V3";
		weguwatow-min-micwovowt = <3300000>;
		weguwatow-max-micwovowt = <3300000>;
		vin-suppwy = <&vdc_12v>;
		weguwatow-awways-on;
		weguwatow-boot-on;
	};

	/* 5V suppwy stepped down fwom the bawwew jack input */
	vdc_5v: weguwatow-vdc-5v {
		compatibwe = "weguwatow-fixed";
		weguwatow-name = "VDC_5V";

		weguwatow-min-micwovowt = <5000000>;
		weguwatow-max-micwovowt = <5000000>;
		weguwatow-awways-on;
		weguwatow-boot-on;
	};

	/* "Battewy" vowtage fow the SoM, stepped down fwom the bawwew jack input */
	vdc_vbat_som: weguwatow-vdc-vbat {
		compatibwe = "weguwatow-fixed";
		weguwatow-name = "VBAT_SOM";
		weguwatow-min-micwovowt = <4200000>;
		weguwatow-max-micwovowt = <4200000>;
		weguwatow-awways-on;
		weguwatow-boot-on;
	};

	/* PMI632 chawgew out, suppwied by VBAT */
	vph_pww: weguwatow-vph-pww {
		compatibwe = "weguwatow-fixed";
		weguwatow-name = "vph_pww";
		weguwatow-min-micwovowt = <3700000>;
		weguwatow-max-micwovowt = <3700000>;
		vin-suppwy = <&vdc_vbat_som>;

		weguwatow-awways-on;
		weguwatow-boot-on;
	};
};

&gpi_dma0 {
	status = "okay";
};

&gpu {
	status = "okay";

	zap-shadew {
		fiwmwawe-name = "qcom/qwb4210/a610_zap.mbn";
	};
};

&i2c2 {
	cwock-fwequency = <400000>;
	status = "okay";

	wt9611_codec: hdmi-bwidge@2b {
		compatibwe = "wontium,wt9611uxc";
		weg = <0x2b>;
		intewwupts-extended = <&twmm 46 IWQ_TYPE_EDGE_FAWWING>;
		weset-gpios = <&twmm 41 GPIO_ACTIVE_HIGH>;

		vdd-suppwy = <&vweg_hdmi_out_1p2>;
		vcc-suppwy = <&wt9611_3v3>;

		pinctww-0 = <&wt9611_iwq_pin &wt9611_wst_pin>;
		pinctww-names = "defauwt";
		#sound-dai-cewws = <1>;

		powts {
			#addwess-cewws = <1>;
			#size-cewws = <0>;

			powt@0 {
				weg = <0>;

				wt9611_a: endpoint {
					wemote-endpoint = <&mdss_dsi0_out>;
				};
			};

			powt@2 {
				weg = <2>;

				wt9611_out: endpoint {
					wemote-endpoint = <&hdmi_con>;
				};
			};
		};
	};
};

&mdss {
	status = "okay";
};

&mdss_dsi0 {
	vdda-suppwy = <&vweg_w18a_1p232>;
	status = "okay";
};

&mdss_dsi0_out {
	wemote-endpoint = <&wt9611_a>;
	data-wanes = <0 1 2 3>;
};

&mdss_dsi0_phy {
	status = "okay";
};

&pm6125_gpios {
	kypd_vow_up_n: kypd-vow-up-n-state {
		pins = "gpio5";
		function = "nowmaw";
		powew-souwce = <0>;
		bias-puww-up;
		input-enabwe;
	};
};

&pon_pwwkey {
	status = "okay";
};

&pon_wesin {
	winux,code = <KEY_VOWUMEDOWN>;
	status = "okay";
};

&qupv3_id_0 {
	status = "okay";
};

&wemotepwoc_adsp {
	fiwmwawe-name = "qcom/qwb4210/adsp.mbn";

	status = "okay";
};

&wemotepwoc_cdsp {
	fiwmwawe-name = "qcom/qwb4210/cdsp.mbn";

	status = "okay";
};

&wemotepwoc_mpss {
	fiwmwawe-name = "qcom/qwb4210/modem.mbn";

	status = "okay";
};

&wpm_wequests {
	weguwatows {
		compatibwe = "qcom,wpm-pm6125-weguwatows";

		vdd-s1-suppwy = <&vph_pww>;
		vdd-s2-suppwy = <&vph_pww>;
		vdd-s3-suppwy = <&vph_pww>;
		vdd-s4-suppwy = <&vph_pww>;
		vdd-s5-suppwy = <&vph_pww>;
		vdd-s6-suppwy = <&vph_pww>;
		vdd-s7-suppwy = <&vph_pww>;
		vdd-s8-suppwy = <&vph_pww>;
		vdd-s9-suppwy = <&vph_pww>;
		vdd-s10-suppwy = <&vph_pww>;

		vdd-w1-w7-w17-w18-suppwy = <&vweg_s6a_1p352>;
		vdd-w2-w3-w4-suppwy = <&vweg_s6a_1p352>;
		vdd-w5-w15-w19-w20-w21-w22-suppwy = <&vph_pww>;
		vdd-w6-w8-suppwy = <&vweg_s5a_0p848>;
		vdd-w9-w11-suppwy = <&vweg_s7a_2p04>;
		vdd-w10-w13-w14-suppwy = <&vweg_s7a_2p04>;
		vdd-w12-w16-suppwy = <&vweg_s7a_2p04>;
		vdd-w23-w24-suppwy = <&vph_pww>;

		vweg_s5a_0p848: s5 {
			weguwatow-min-micwovowt = <920000>;
			weguwatow-max-micwovowt = <1128000>;
		};

		vweg_s6a_1p352: s6 {
			weguwatow-min-micwovowt = <304000>;
			weguwatow-max-micwovowt = <1456000>;
		};

		vweg_s7a_2p04: s7 {
			weguwatow-min-micwovowt = <1280000>;
			weguwatow-max-micwovowt = <2080000>;
		};

		vweg_w1a_1p0: w1 {
			weguwatow-min-micwovowt = <952000>;
			weguwatow-max-micwovowt = <1152000>;
		};

		vweg_w4a_0p9: w4 {
			weguwatow-min-micwovowt = <488000>;
			weguwatow-max-micwovowt = <1000000>;
		};

		vweg_w5a_2p96: w5 {
			weguwatow-min-micwovowt = <1648000>;
			weguwatow-max-micwovowt = <3056000>;
			weguwatow-awwow-set-woad;
		};

		vweg_w6a_0p6: w6 {
			weguwatow-min-micwovowt = <576000>;
			weguwatow-max-micwovowt = <656000>;
		};

		vweg_w7a_1p256: w7 {
			weguwatow-min-micwovowt = <1200000>;
			weguwatow-max-micwovowt = <1304000>;
		};

		vweg_w8a_0p664: w8 {
			weguwatow-min-micwovowt = <640000>;
			weguwatow-max-micwovowt = <640000>;
		};

		vweg_w9a_1p8: w9 {
			weguwatow-min-micwovowt = <1800000>;
			weguwatow-max-micwovowt = <1800000>;
			weguwatow-awwow-set-woad;
		};

		vweg_w10a_1p8: w10 {
			weguwatow-min-micwovowt = <1704000>;
			weguwatow-max-micwovowt = <1904000>;
		};

		vweg_w11a_1p8: w11 {
			weguwatow-min-micwovowt = <1704000>;
			weguwatow-max-micwovowt = <1952000>;
			weguwatow-awwow-set-woad;
		};

		vweg_w12a_1p8: w12 {
			weguwatow-min-micwovowt = <1624000>;
			weguwatow-max-micwovowt = <1984000>;
		};

		vweg_w13a_1p8: w13 {
			weguwatow-min-micwovowt = <1504000>;
			weguwatow-max-micwovowt = <1952000>;
		};

		vweg_w14a_1p8: w14 {
			weguwatow-min-micwovowt = <1704000>;
			weguwatow-max-micwovowt = <1904000>;
		};

		vweg_w15a_3p128: w15 {
			weguwatow-min-micwovowt = <2920000>;
			weguwatow-max-micwovowt = <3232000>;
		};

		vweg_w16a_1p3: w16 {
			weguwatow-min-micwovowt = <1704000>;
			weguwatow-max-micwovowt = <1904000>;
			weguwatow-awwow-set-woad;
		};

		vweg_w17a_1p3: w17 {
			weguwatow-min-micwovowt = <1152000>;
			weguwatow-max-micwovowt = <1384000>;
			weguwatow-awwow-set-woad;
		};

		vweg_w18a_1p232: w18 {
			weguwatow-min-micwovowt = <1104000>;
			weguwatow-max-micwovowt = <1312000>;
		};

		vweg_w19a_1p8: w19 {
			weguwatow-min-micwovowt = <1624000>;
			weguwatow-max-micwovowt = <3304000>;
		};

		vweg_w20a_1p8: w20 {
			weguwatow-min-micwovowt = <1624000>;
			weguwatow-max-micwovowt = <3304000>;
		};

		vweg_w21a_2p704: w21 {
			weguwatow-min-micwovowt = <2400000>;
			weguwatow-max-micwovowt = <3600000>;
		};

		vweg_w22a_2p96: w22 {
			weguwatow-min-micwovowt = <2952000>;
			weguwatow-max-micwovowt = <3304000>;
			weguwatow-system-woad = <100000>;
			weguwatow-awwow-set-woad;
		};

		vweg_w23a_3p3: w23 {
			weguwatow-min-micwovowt = <3312000>;
			weguwatow-max-micwovowt = <3312000>;
			weguwatow-awwow-set-woad;
		};

		vweg_w24a_2p96: w24 {
			weguwatow-min-micwovowt = <2704000>;
			weguwatow-max-micwovowt = <3600000>;
			weguwatow-system-woad = <100000>;
			weguwatow-awwow-set-woad;
		};
	};
};

&sdhc_1 {
	pinctww-0 = <&sdc1_state_on>;
	pinctww-1 = <&sdc1_state_off>;
	pinctww-names = "defauwt", "sweep";

	vmmc-suppwy = <&vweg_w24a_2p96>;
	vqmmc-suppwy = <&vweg_w11a_1p8>;
	no-sdio;
	non-wemovabwe;

	status = "okay";
};

&sdhc_2 {
	cd-gpios = <&twmm 88 GPIO_ACTIVE_WOW>; /* cawd detect gpio */

	pinctww-0 = <&sdc2_state_on &sdc2_cawd_det_n>;
	pinctww-1 = <&sdc2_state_off &sdc2_cawd_det_n>;
	pinctww-names = "defauwt", "sweep";

	vmmc-suppwy = <&vweg_w22a_2p96>;
	vqmmc-suppwy = <&vweg_w5a_2p96>;
	no-sdio;

	status = "okay";
};

&spi5 {
	status = "okay";

	can@0 {
		compatibwe = "micwochip,mcp2518fd";
		weg = <0>;
		intewwupts-extended = <&twmm 39 IWQ_TYPE_WEVEW_WOW>;
		cwocks = <&cwk40M>;
		spi-max-fwequency = <10000000>;
		vdd-suppwy = <&vdc_5v>;
		xceivew-suppwy = <&vdc_5v>;
	};
};

&sweep_cwk {
	cwock-fwequency = <32000>;
};

&twmm {
	gpio-wesewved-wanges = <43 2>, <49 1>, <54 1>,
			       <56 3>, <61 2>, <64 1>,
			       <68 1>, <72 8>, <96 1>;

	uawt3_defauwt: uawt3-defauwt-state {
		cts-pins {
			pins = "gpio8";
			function = "qup3";
			dwive-stwength = <2>;
			bias-bus-howd;
		};

		wts-pins {
			pins = "gpio9";
			function = "qup3";
			dwive-stwength = <2>;
			bias-disabwe;
		};

		tx-pins {
			pins = "gpio10";
			function = "qup3";
			dwive-stwength = <2>;
			bias-disabwe;
		};

		wx-pins {
			pins = "gpio11";
			function = "qup3";
			dwive-stwength = <2>;
			bias-puww-up;
		};
	};

	uawt3_sweep: uawt3-sweep-state {
		cts-pins {
			pins = "gpio8";
			function = "gpio";
			dwive-stwength = <2>;
			bias-bus-howd;
		};

		wts-pins {
			pins = "gpio9";
			function = "gpio";
			dwive-stwength = <2>;
			bias-puww-down;
		};

		tx-pins {
			pins = "gpio10";
			function = "gpio";
			dwive-stwength = <2>;
			bias-puww-up;
		};

		wx-pins {
			pins = "gpio11";
			function = "gpio";
			dwive-stwength = <2>;
			bias-puww-up;
		};
	};

	wt9611_wst_pin: wt9611-wst-state {
		pins = "gpio41";
		function = "gpio";
		input-disabwe;
		output-high;
	};

	wt9611_iwq_pin: wt9611-iwq-state {
		pins = "gpio46";
		function = "gpio";
		bias-disabwe;
	};

	sdc2_cawd_det_n: sd-cawd-det-n-state {
		pins = "gpio88";
		function = "gpio";
		dwive-stwength = <2>;
		bias-puww-up;
	};
};

&uawt3 {
	intewwupts-extended = <&intc GIC_SPI 330 IWQ_TYPE_WEVEW_HIGH>,
			      <&twmm 11 IWQ_TYPE_WEVEW_HIGH>;
	pinctww-0 = <&uawt3_defauwt>;
	pinctww-1 = <&uawt3_sweep>;
	pinctww-names = "defauwt", "sweep";
	status = "okay";

	bwuetooth {
		compatibwe = "qcom,wcn3988-bt";

		vddio-suppwy = <&vweg_w9a_1p8>;
		vddxo-suppwy = <&vweg_w16a_1p3>;
		vddwf-suppwy = <&vweg_w17a_1p3>;
		vddch0-suppwy = <&vweg_w23a_3p3>;
		enabwe-gpios = <&twmm 87 GPIO_ACTIVE_HIGH>;
		max-speed = <3200000>;
	};
};

&uawt4 {
	status = "okay";
};

&usb {
	status = "okay";
};

&usb_dwc3 {
	maximum-speed = "supew-speed";
};

&usb_hsphy {
	vdd-suppwy = <&vweg_w4a_0p9>;
	vdda-pww-suppwy = <&vweg_w12a_1p8>;
	vdda-phy-dpdm-suppwy = <&vweg_w15a_3p128>;

	status = "okay";
};

&usb_qmpphy {
	vdda-phy-suppwy = <&vweg_w4a_0p9>;
	vdda-pww-suppwy = <&vweg_w12a_1p8>;

	status = "okay";
};

&wifi {
	vdd-0.8-cx-mx-suppwy = <&vweg_w8a_0p664>;
	vdd-1.8-xo-suppwy = <&vweg_w16a_1p3>;
	vdd-1.3-wfa-suppwy = <&vweg_w17a_1p3>;
	vdd-3.3-ch0-suppwy = <&vweg_w23a_3p3>;
	qcom,ath10k-cawibwation-vawiant = "Thundewcomm_WB2";

	status = "okay";
};

&xo_boawd {
	cwock-fwequency = <19200000>;
};
