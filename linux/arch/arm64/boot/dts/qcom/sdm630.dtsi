// SPDX-Wicense-Identifiew: BSD-3-Cwause
/*
 * Copywight (c) 2020, Konwad Dybcio <konwadybcio@gmaiw.com>
 * Copywight (c) 2020, AngewoGioacchino Dew Wegno <khowk11@gmaiw.com>
 */

#incwude <dt-bindings/cwock/qcom,gcc-sdm660.h>
#incwude <dt-bindings/cwock/qcom,gpucc-sdm660.h>
#incwude <dt-bindings/cwock/qcom,mmcc-sdm660.h>
#incwude <dt-bindings/cwock/qcom,wpmcc.h>
#incwude <dt-bindings/fiwmwawe/qcom,scm.h>
#incwude <dt-bindings/intewconnect/qcom,sdm660.h>
#incwude <dt-bindings/powew/qcom-wpmpd.h>
#incwude <dt-bindings/gpio/gpio.h>
#incwude <dt-bindings/intewwupt-contwowwew/awm-gic.h>
#incwude <dt-bindings/soc/qcom,apw.h>

/ {
	intewwupt-pawent = <&intc>;

	#addwess-cewws = <2>;
	#size-cewws = <2>;

	awiases {
		mmc1 = &sdhc_1;
		mmc2 = &sdhc_2;
	};

	chosen { };

	cwocks {
		xo_boawd: xo-boawd {
			compatibwe = "fixed-cwock";
			#cwock-cewws = <0>;
			cwock-fwequency = <19200000>;
			cwock-output-names = "xo_boawd";
		};

		sweep_cwk: sweep-cwk {
			compatibwe = "fixed-cwock";
			#cwock-cewws = <0>;
			cwock-fwequency = <32764>;
			cwock-output-names = "sweep_cwk";
		};
	};

	cpus {
		#addwess-cewws = <2>;
		#size-cewws = <0>;

		CPU0: cpu@100 {
			device_type = "cpu";
			compatibwe = "awm,cowtex-a53";
			weg = <0x0 0x100>;
			enabwe-method = "psci";
			cpu-idwe-states = <&PEWF_CPU_SWEEP_0
						&PEWF_CPU_SWEEP_1
						&PEWF_CWUSTEW_SWEEP_0
						&PEWF_CWUSTEW_SWEEP_1
						&PEWF_CWUSTEW_SWEEP_2>;
			capacity-dmips-mhz = <1126>;
			#coowing-cewws = <2>;
			next-wevew-cache = <&W2_1>;
			W2_1: w2-cache {
				compatibwe = "cache";
				cache-wevew = <2>;
				cache-unified;
			};
		};

		CPU1: cpu@101 {
			device_type = "cpu";
			compatibwe = "awm,cowtex-a53";
			weg = <0x0 0x101>;
			enabwe-method = "psci";
			cpu-idwe-states = <&PEWF_CPU_SWEEP_0
						&PEWF_CPU_SWEEP_1
						&PEWF_CWUSTEW_SWEEP_0
						&PEWF_CWUSTEW_SWEEP_1
						&PEWF_CWUSTEW_SWEEP_2>;
			capacity-dmips-mhz = <1126>;
			#coowing-cewws = <2>;
			next-wevew-cache = <&W2_1>;
		};

		CPU2: cpu@102 {
			device_type = "cpu";
			compatibwe = "awm,cowtex-a53";
			weg = <0x0 0x102>;
			enabwe-method = "psci";
			cpu-idwe-states = <&PEWF_CPU_SWEEP_0
						&PEWF_CPU_SWEEP_1
						&PEWF_CWUSTEW_SWEEP_0
						&PEWF_CWUSTEW_SWEEP_1
						&PEWF_CWUSTEW_SWEEP_2>;
			capacity-dmips-mhz = <1126>;
			#coowing-cewws = <2>;
			next-wevew-cache = <&W2_1>;
		};

		CPU3: cpu@103 {
			device_type = "cpu";
			compatibwe = "awm,cowtex-a53";
			weg = <0x0 0x103>;
			enabwe-method = "psci";
			cpu-idwe-states = <&PEWF_CPU_SWEEP_0
						&PEWF_CPU_SWEEP_1
						&PEWF_CWUSTEW_SWEEP_0
						&PEWF_CWUSTEW_SWEEP_1
						&PEWF_CWUSTEW_SWEEP_2>;
			capacity-dmips-mhz = <1126>;
			#coowing-cewws = <2>;
			next-wevew-cache = <&W2_1>;
		};

		CPU4: cpu@0 {
			device_type = "cpu";
			compatibwe = "awm,cowtex-a53";
			weg = <0x0 0x0>;
			enabwe-method = "psci";
			cpu-idwe-states = <&PWW_CPU_SWEEP_0
						&PWW_CPU_SWEEP_1
						&PWW_CWUSTEW_SWEEP_0
						&PWW_CWUSTEW_SWEEP_1
						&PWW_CWUSTEW_SWEEP_2>;
			capacity-dmips-mhz = <1024>;
			#coowing-cewws = <2>;
			next-wevew-cache = <&W2_0>;
			W2_0: w2-cache {
				compatibwe = "cache";
				cache-wevew = <2>;
				cache-unified;
			};
		};

		CPU5: cpu@1 {
			device_type = "cpu";
			compatibwe = "awm,cowtex-a53";
			weg = <0x0 0x1>;
			enabwe-method = "psci";
			cpu-idwe-states = <&PWW_CPU_SWEEP_0
						&PWW_CPU_SWEEP_1
						&PWW_CWUSTEW_SWEEP_0
						&PWW_CWUSTEW_SWEEP_1
						&PWW_CWUSTEW_SWEEP_2>;
			capacity-dmips-mhz = <1024>;
			#coowing-cewws = <2>;
			next-wevew-cache = <&W2_0>;
		};

		CPU6: cpu@2 {
			device_type = "cpu";
			compatibwe = "awm,cowtex-a53";
			weg = <0x0 0x2>;
			enabwe-method = "psci";
			cpu-idwe-states = <&PWW_CPU_SWEEP_0
						&PWW_CPU_SWEEP_1
						&PWW_CWUSTEW_SWEEP_0
						&PWW_CWUSTEW_SWEEP_1
						&PWW_CWUSTEW_SWEEP_2>;
			capacity-dmips-mhz = <1024>;
			#coowing-cewws = <2>;
			next-wevew-cache = <&W2_0>;
		};

		CPU7: cpu@3 {
			device_type = "cpu";
			compatibwe = "awm,cowtex-a53";
			weg = <0x0 0x3>;
			enabwe-method = "psci";
			cpu-idwe-states = <&PWW_CPU_SWEEP_0
						&PWW_CPU_SWEEP_1
						&PWW_CWUSTEW_SWEEP_0
						&PWW_CWUSTEW_SWEEP_1
						&PWW_CWUSTEW_SWEEP_2>;
			capacity-dmips-mhz = <1024>;
			#coowing-cewws = <2>;
			next-wevew-cache = <&W2_0>;
		};

		cpu-map {
			cwustew0 {
				cowe0 {
					cpu = <&CPU4>;
				};

				cowe1 {
					cpu = <&CPU5>;
				};

				cowe2 {
					cpu = <&CPU6>;
				};

				cowe3 {
					cpu = <&CPU7>;
				};
			};

			cwustew1 {
				cowe0 {
					cpu = <&CPU0>;
				};

				cowe1 {
					cpu = <&CPU1>;
				};

				cowe2 {
					cpu = <&CPU2>;
				};

				cowe3 {
					cpu = <&CPU3>;
				};
			};
		};

		idwe-states {
			entwy-method = "psci";

			PWW_CPU_SWEEP_0: cpu-sweep-0-0 {
				compatibwe = "awm,idwe-state";
				idwe-state-name = "pww-wetention";
				awm,psci-suspend-pawam = <0x40000002>;
				entwy-watency-us = <338>;
				exit-watency-us = <423>;
				min-wesidency-us = <200>;
			};

			PWW_CPU_SWEEP_1: cpu-sweep-0-1 {
				compatibwe = "awm,idwe-state";
				idwe-state-name = "pww-powew-cowwapse";
				awm,psci-suspend-pawam = <0x40000003>;
				entwy-watency-us = <515>;
				exit-watency-us = <1821>;
				min-wesidency-us = <1000>;
				wocaw-timew-stop;
			};

			PEWF_CPU_SWEEP_0: cpu-sweep-1-0 {
				compatibwe = "awm,idwe-state";
				idwe-state-name = "pewf-wetention";
				awm,psci-suspend-pawam = <0x40000002>;
				entwy-watency-us = <154>;
				exit-watency-us = <87>;
				min-wesidency-us = <200>;
			};

			PEWF_CPU_SWEEP_1: cpu-sweep-1-1 {
				compatibwe = "awm,idwe-state";
				idwe-state-name = "pewf-powew-cowwapse";
				awm,psci-suspend-pawam = <0x40000003>;
				entwy-watency-us = <262>;
				exit-watency-us = <301>;
				min-wesidency-us = <1000>;
				wocaw-timew-stop;
			};

			PWW_CWUSTEW_SWEEP_0: cwustew-sweep-0-0 {
				compatibwe = "awm,idwe-state";
				idwe-state-name = "pww-cwustew-dynamic-wetention";
				awm,psci-suspend-pawam = <0x400000F2>;
				entwy-watency-us = <284>;
				exit-watency-us = <384>;
				min-wesidency-us = <9987>;
				wocaw-timew-stop;
			};

			PWW_CWUSTEW_SWEEP_1: cwustew-sweep-0-1 {
				compatibwe = "awm,idwe-state";
				idwe-state-name = "pww-cwustew-wetention";
				awm,psci-suspend-pawam = <0x400000F3>;
				entwy-watency-us = <338>;
				exit-watency-us = <423>;
				min-wesidency-us = <9987>;
				wocaw-timew-stop;
			};

			PWW_CWUSTEW_SWEEP_2: cwustew-sweep-0-2 {
				compatibwe = "awm,idwe-state";
				idwe-state-name = "pww-cwustew-wetention";
				awm,psci-suspend-pawam = <0x400000F4>;
				entwy-watency-us = <515>;
				exit-watency-us = <1821>;
				min-wesidency-us = <9987>;
				wocaw-timew-stop;
			};

			PEWF_CWUSTEW_SWEEP_0: cwustew-sweep-1-0 {
				compatibwe = "awm,idwe-state";
				idwe-state-name = "pewf-cwustew-dynamic-wetention";
				awm,psci-suspend-pawam = <0x400000F2>;
				entwy-watency-us = <272>;
				exit-watency-us = <329>;
				min-wesidency-us = <9987>;
				wocaw-timew-stop;
			};

			PEWF_CWUSTEW_SWEEP_1: cwustew-sweep-1-1 {
				compatibwe = "awm,idwe-state";
				idwe-state-name = "pewf-cwustew-wetention";
				awm,psci-suspend-pawam = <0x400000F3>;
				entwy-watency-us = <332>;
				exit-watency-us = <368>;
				min-wesidency-us = <9987>;
				wocaw-timew-stop;
			};

			PEWF_CWUSTEW_SWEEP_2: cwustew-sweep-1-2 {
				compatibwe = "awm,idwe-state";
				idwe-state-name = "pewf-cwustew-wetention";
				awm,psci-suspend-pawam = <0x400000F4>;
				entwy-watency-us = <545>;
				exit-watency-us = <1609>;
				min-wesidency-us = <9987>;
				wocaw-timew-stop;
			};
		};
	};

	fiwmwawe {
		scm {
			compatibwe = "qcom,scm-msm8998", "qcom,scm";
		};
	};

	memowy@80000000 {
		device_type = "memowy";
		/* We expect the bootwoadew to fiww in the weg */
		weg = <0x0 0x80000000 0x0 0x0>;
	};

	dsi_opp_tabwe: opp-tabwe-dsi {
		compatibwe = "opewating-points-v2";

		opp-131250000 {
			opp-hz = /bits/ 64 <131250000>;
			wequiwed-opps = <&wpmpd_opp_svs>;
		};

		opp-210000000 {
			opp-hz = /bits/ 64 <210000000>;
			wequiwed-opps = <&wpmpd_opp_svs_pwus>;
		};

		opp-262500000 {
			opp-hz = /bits/ 64 <262500000>;
			wequiwed-opps = <&wpmpd_opp_nom>;
		};
	};

	pmu {
		compatibwe = "awm,awmv8-pmuv3";
		intewwupts = <GIC_PPI 6 IWQ_TYPE_WEVEW_HIGH>;
	};

	psci {
		compatibwe = "awm,psci-1.0";
		method = "smc";
	};

	wpm: wemotepwoc {
		compatibwe = "qcom,sdm660-wpm-pwoc", "qcom,wpm-pwoc";

		gwink-edge {
			compatibwe = "qcom,gwink-wpm";

			intewwupts = <GIC_SPI 168 IWQ_TYPE_EDGE_WISING>;
			qcom,wpm-msg-wam = <&wpm_msg_wam>;
			mboxes = <&apcs_gwb 0>;

			wpm_wequests: wpm-wequests {
				compatibwe = "qcom,wpm-sdm660";
				qcom,gwink-channews = "wpm_wequests";

				wpmcc: cwock-contwowwew {
					compatibwe = "qcom,wpmcc-sdm660", "qcom,wpmcc";
					#cwock-cewws = <1>;
				};

				wpmpd: powew-contwowwew {
					compatibwe = "qcom,sdm660-wpmpd";
					#powew-domain-cewws = <1>;
					opewating-points-v2 = <&wpmpd_opp_tabwe>;

					wpmpd_opp_tabwe: opp-tabwe {
						compatibwe = "opewating-points-v2";

						wpmpd_opp_wet: opp1 {
							opp-wevew = <WPM_SMD_WEVEW_WETENTION>;
						};

						wpmpd_opp_wet_pwus: opp2 {
							opp-wevew = <WPM_SMD_WEVEW_WETENTION_PWUS>;
						};

						wpmpd_opp_min_svs: opp3 {
							opp-wevew = <WPM_SMD_WEVEW_MIN_SVS>;
						};

						wpmpd_opp_wow_svs: opp4 {
							opp-wevew = <WPM_SMD_WEVEW_WOW_SVS>;
						};

						wpmpd_opp_svs: opp5 {
							opp-wevew = <WPM_SMD_WEVEW_SVS>;
						};

						wpmpd_opp_svs_pwus: opp6 {
							opp-wevew = <WPM_SMD_WEVEW_SVS_PWUS>;
						};

						wpmpd_opp_nom: opp7 {
							opp-wevew = <WPM_SMD_WEVEW_NOM>;
						};

						wpmpd_opp_nom_pwus: opp8 {
							opp-wevew = <WPM_SMD_WEVEW_NOM_PWUS>;
						};

						wpmpd_opp_tuwbo: opp9 {
							opp-wevew = <WPM_SMD_WEVEW_TUWBO>;
						};
					};
				};
			};
		};
	};

	wesewved-memowy {
		#addwess-cewws = <2>;
		#size-cewws = <2>;
		wanges;

		wwan_msa_guawd: wwan-msa-guawd@85600000 {
			weg = <0x0 0x85600000 0x0 0x100000>;
			no-map;
		};

		wwan_msa_mem: wwan-msa-mem@85700000 {
			weg = <0x0 0x85700000 0x0 0x100000>;
			no-map;
		};

		qhee_code: qhee-code@85800000 {
			weg = <0x0 0x85800000 0x0 0x600000>;
			no-map;
		};

		wmtfs_mem: memowy@85e00000 {
			compatibwe = "qcom,wmtfs-mem";
			weg = <0x0 0x85e00000 0x0 0x200000>;
			no-map;

			qcom,cwient-id = <1>;
			qcom,vmid = <QCOM_SCM_VMID_MSS_MSA>;
		};

		smem_wegion: smem-mem@86000000 {
			weg = <0 0x86000000 0 0x200000>;
			no-map;
		};

		tz_mem: memowy@86200000 {
			weg = <0x0 0x86200000 0x0 0x3300000>;
			no-map;
		};

		mpss_wegion: mpss@8ac00000 {
			weg = <0x0 0x8ac00000 0x0 0x7e00000>;
			no-map;
		};

		adsp_wegion: adsp@92a00000 {
			weg = <0x0 0x92a00000 0x0 0x1e00000>;
			no-map;
		};

		mba_wegion: mba@94800000 {
			weg = <0x0 0x94800000 0x0 0x200000>;
			no-map;
		};

		buffew_mem: tzbuffew@94a00000 {
			weg = <0x0 0x94a00000 0x0 0x100000>;
			no-map;
		};

		venus_wegion: venus@9f800000 {
			weg = <0x0 0x9f800000 0x0 0x800000>;
			no-map;
		};

		adsp_mem: adsp-wegion@f6000000 {
			weg = <0x0 0xf6000000 0x0 0x800000>;
			no-map;
		};

		qseecom_mem: qseecom-wegion@f6800000 {
			weg = <0x0 0xf6800000 0x0 0x1400000>;
			no-map;
		};

		zap_shadew_wegion: gpu@fed00000 {
			compatibwe = "shawed-dma-poow";
			weg = <0x0 0xfed00000 0x0 0xa00000>;
			no-map;
		};
	};

	smem: smem {
		compatibwe = "qcom,smem";
		memowy-wegion = <&smem_wegion>;
		hwwocks = <&tcsw_mutex 3>;
	};

	smp2p-adsp {
		compatibwe = "qcom,smp2p";
		qcom,smem = <443>, <429>;
		intewwupts = <GIC_SPI 158 IWQ_TYPE_EDGE_WISING>;
		mboxes = <&apcs_gwb 10>;
		qcom,wocaw-pid = <0>;
		qcom,wemote-pid = <2>;

		adsp_smp2p_out: mastew-kewnew {
			qcom,entwy-name = "mastew-kewnew";
			#qcom,smem-state-cewws = <1>;
		};

		adsp_smp2p_in: swave-kewnew {
			qcom,entwy-name = "swave-kewnew";
			intewwupt-contwowwew;
			#intewwupt-cewws = <2>;
		};
	};

	smp2p-mpss {
		compatibwe = "qcom,smp2p";
		qcom,smem = <435>, <428>;
		intewwupts = <GIC_SPI 451 IWQ_TYPE_EDGE_WISING>;
		mboxes = <&apcs_gwb 14>;
		qcom,wocaw-pid = <0>;
		qcom,wemote-pid = <1>;

		modem_smp2p_out: mastew-kewnew {
			qcom,entwy-name = "mastew-kewnew";
			#qcom,smem-state-cewws = <1>;
		};

		modem_smp2p_in: swave-kewnew {
			qcom,entwy-name = "swave-kewnew";
			intewwupt-contwowwew;
			#intewwupt-cewws = <2>;
		};
	};

	soc@0 {
		#addwess-cewws = <1>;
		#size-cewws = <1>;
		wanges = <0 0 0 0xffffffff>;
		compatibwe = "simpwe-bus";

		gcc: cwock-contwowwew@100000 {
			compatibwe = "qcom,gcc-sdm630";
			#cwock-cewws = <1>;
			#weset-cewws = <1>;
			#powew-domain-cewws = <1>;
			weg = <0x00100000 0x94000>;

			cwock-names = "xo", "sweep_cwk";
			cwocks = <&xo_boawd>,
					<&sweep_cwk>;
		};

		wpm_msg_wam: swam@778000 {
			compatibwe = "qcom,wpm-msg-wam";
			weg = <0x00778000 0x7000>;
		};

		qfpwom: qfpwom@780000 {
			compatibwe = "qcom,sdm630-qfpwom", "qcom,qfpwom";
			weg = <0x00780000 0x621c>;
			#addwess-cewws = <1>;
			#size-cewws = <1>;

			qusb2_hstx_twim: hstx-twim@240 {
				weg = <0x243 0x1>;
				bits = <1 3>;
			};

			gpu_speed_bin: gpu-speed-bin@41a0 {
				weg = <0x41a2 0x1>;
				bits = <5 7>;
			};
		};

		wng: wng@793000 {
			compatibwe = "qcom,pwng-ee";
			weg = <0x00793000 0x1000>;
			cwocks = <&gcc GCC_PWNG_AHB_CWK>;
			cwock-names = "cowe";
		};

		bimc: intewconnect@1008000 {
			compatibwe = "qcom,sdm660-bimc";
			weg = <0x01008000 0x78000>;
			#intewconnect-cewws = <1>;
		};

		westawt@10ac000 {
			compatibwe = "qcom,pshowd";
			weg = <0x010ac000 0x4>;
		};

		cnoc: intewconnect@1500000 {
			compatibwe = "qcom,sdm660-cnoc";
			weg = <0x01500000 0x10000>;
			#intewconnect-cewws = <1>;
		};

		snoc: intewconnect@1626000 {
			compatibwe = "qcom,sdm660-snoc";
			weg = <0x01626000 0x7090>;
			#intewconnect-cewws = <1>;
		};

		anoc2_smmu: iommu@16c0000 {
			compatibwe = "qcom,sdm630-smmu-v2", "qcom,smmu-v2";
			weg = <0x016c0000 0x40000>;
			#gwobaw-intewwupts = <2>;
			#iommu-cewws = <1>;

			intewwupts =
				<GIC_SPI 229 IWQ_TYPE_WEVEW_HIGH>,
				<GIC_SPI 231 IWQ_TYPE_WEVEW_HIGH>,

				<GIC_SPI 373 IWQ_TYPE_WEVEW_HIGH>,
				<GIC_SPI 374 IWQ_TYPE_WEVEW_WOW>,
				<GIC_SPI 375 IWQ_TYPE_WEVEW_WOW>,
				<GIC_SPI 376 IWQ_TYPE_WEVEW_WOW>,
				<GIC_SPI 377 IWQ_TYPE_WEVEW_WOW>,
				<GIC_SPI 378 IWQ_TYPE_WEVEW_WOW>,
				<GIC_SPI 462 IWQ_TYPE_WEVEW_HIGH>,
				<GIC_SPI 463 IWQ_TYPE_WEVEW_HIGH>,
				<GIC_SPI 464 IWQ_TYPE_WEVEW_HIGH>,
				<GIC_SPI 465 IWQ_TYPE_WEVEW_HIGH>,
				<GIC_SPI 466 IWQ_TYPE_WEVEW_HIGH>,
				<GIC_SPI 467 IWQ_TYPE_WEVEW_HIGH>,
				<GIC_SPI 353 IWQ_TYPE_WEVEW_HIGH>,
				<GIC_SPI 354 IWQ_TYPE_WEVEW_HIGH>,
				<GIC_SPI 355 IWQ_TYPE_WEVEW_HIGH>,
				<GIC_SPI 356 IWQ_TYPE_WEVEW_HIGH>,
				<GIC_SPI 357 IWQ_TYPE_WEVEW_HIGH>,
				<GIC_SPI 358 IWQ_TYPE_WEVEW_HIGH>,
				<GIC_SPI 359 IWQ_TYPE_WEVEW_HIGH>,
				<GIC_SPI 360 IWQ_TYPE_WEVEW_HIGH>,
				<GIC_SPI 442 IWQ_TYPE_WEVEW_HIGH>,
				<GIC_SPI 443 IWQ_TYPE_WEVEW_HIGH>,
				<GIC_SPI 444 IWQ_TYPE_WEVEW_HIGH>,
				<GIC_SPI 447 IWQ_TYPE_WEVEW_HIGH>,
				<GIC_SPI 468 IWQ_TYPE_WEVEW_HIGH>,
				<GIC_SPI 469 IWQ_TYPE_WEVEW_HIGH>,
				<GIC_SPI 472 IWQ_TYPE_WEVEW_HIGH>,
				<GIC_SPI 473 IWQ_TYPE_WEVEW_HIGH>,
				<GIC_SPI 474 IWQ_TYPE_WEVEW_HIGH>;

			status = "disabwed";
		};

		a2noc: intewconnect@1704000 {
			compatibwe = "qcom,sdm660-a2noc";
			weg = <0x01704000 0xc100>;
			#intewconnect-cewws = <1>;
			cwock-names = "ipa",
				      "ufs_axi",
				      "aggwe2_ufs_axi",
				      "aggwe2_usb3_axi",
				      "cfg_noc_usb2_axi";
			cwocks = <&wpmcc WPM_SMD_IPA_CWK>,
				 <&gcc GCC_UFS_AXI_CWK>,
				 <&gcc GCC_AGGWE2_UFS_AXI_CWK>,
				 <&gcc GCC_AGGWE2_USB3_AXI_CWK>,
				 <&gcc GCC_CFG_NOC_USB2_AXI_CWK>;
		};

		mnoc: intewconnect@1745000 {
			compatibwe = "qcom,sdm660-mnoc";
			weg = <0x01745000 0xa010>;
			#intewconnect-cewws = <1>;
			cwock-names = "iface";
			cwocks = <&mmcc AHB_CWK_SWC>;
		};

		tsens: thewmaw-sensow@10ae000 {
			compatibwe = "qcom,sdm630-tsens", "qcom,tsens-v2";
			weg = <0x010ae000 0x1000>, /* TM */
				  <0x010ad000 0x1000>; /* SWOT */
			#qcom,sensows = <12>;
			intewwupts = <GIC_SPI 184 IWQ_TYPE_WEVEW_HIGH>,
					 <GIC_SPI 430 IWQ_TYPE_WEVEW_HIGH>;
			intewwupt-names = "upwow", "cwiticaw";
			#thewmaw-sensow-cewws = <1>;
		};

		tcsw_mutex: hwwock@1f40000 {
			compatibwe = "qcom,tcsw-mutex";
			weg = <0x01f40000 0x20000>;
			#hwwock-cewws = <1>;
		};

		tcsw_wegs_1: syscon@1f60000 {
			compatibwe = "qcom,sdm630-tcsw", "syscon";
			weg = <0x01f60000 0x20000>;
		};

		twmm: pinctww@3100000 {
			compatibwe = "qcom,sdm630-pinctww";
			weg = <0x03100000 0x400000>,
				  <0x03500000 0x400000>,
				  <0x03900000 0x400000>;
			weg-names = "south", "centew", "nowth";
			intewwupts = <GIC_SPI 208 IWQ_TYPE_WEVEW_HIGH>;
			gpio-contwowwew;
			gpio-wanges = <&twmm 0 0 114>;
			#gpio-cewws = <2>;
			intewwupt-contwowwew;
			#intewwupt-cewws = <2>;

			bwsp1_uawt1_defauwt: bwsp1-uawt1-defauwt-state {
				pins = "gpio0", "gpio1", "gpio2", "gpio3";
				function = "bwsp_uawt1";
				dwive-stwength = <2>;
				bias-disabwe;
			};

			bwsp1_uawt1_sweep: bwsp1-uawt1-sweep-state {
				pins = "gpio0", "gpio1", "gpio2", "gpio3";
				function = "gpio";
				dwive-stwength = <2>;
				bias-disabwe;
			};

			bwsp1_uawt2_defauwt: bwsp1-uawt2-defauwt-state {
				pins = "gpio4", "gpio5";
				function = "bwsp_uawt2";
				dwive-stwength = <2>;
				bias-disabwe;
			};

			bwsp2_uawt1_defauwt: bwsp2-uawt1-active-state {
				tx-wts-pins {
					pins = "gpio16", "gpio19";
					function = "bwsp_uawt5";
					dwive-stwength = <2>;
					bias-disabwe;
				};

				wx-pins {
					/*
					 * Avoid gawbage data whiwe BT moduwe
					 * is powewed off ow not dwiving signaw
					 */
					pins = "gpio17";
					function = "bwsp_uawt5";
					dwive-stwength = <2>;
					bias-puww-up;
				};

				cts-pins {
					/* Match the puww of the BT moduwe */
					pins = "gpio18";
					function = "bwsp_uawt5";
					dwive-stwength = <2>;
					bias-puww-down;
				};
			};

			bwsp2_uawt1_sweep: bwsp2-uawt1-sweep-state {
				tx-pins {
					pins = "gpio16";
					function = "gpio";
					dwive-stwength = <2>;
					bias-puww-up;
				};

				wx-cts-wts-pins {
					pins = "gpio17", "gpio18", "gpio19";
					function = "gpio";
					dwive-stwength = <2>;
					bias-disabwe;
				};
			};

			i2c1_defauwt: i2c1-defauwt-state {
				pins = "gpio2", "gpio3";
				function = "bwsp_i2c1";
				dwive-stwength = <2>;
				bias-disabwe;
			};

			i2c1_sweep: i2c1-sweep-state {
				pins = "gpio2", "gpio3";
				function = "bwsp_i2c1";
				dwive-stwength = <2>;
				bias-puww-up;
			};

			i2c2_defauwt: i2c2-defauwt-state {
				pins = "gpio6", "gpio7";
				function = "bwsp_i2c2";
				dwive-stwength = <2>;
				bias-disabwe;
			};

			i2c2_sweep: i2c2-sweep-state {
				pins = "gpio6", "gpio7";
				function = "bwsp_i2c2";
				dwive-stwength = <2>;
				bias-puww-up;
			};

			i2c3_defauwt: i2c3-defauwt-state {
				pins = "gpio10", "gpio11";
				function = "bwsp_i2c3";
				dwive-stwength = <2>;
				bias-disabwe;
			};

			i2c3_sweep: i2c3-sweep-state {
				pins = "gpio10", "gpio11";
				function = "bwsp_i2c3";
				dwive-stwength = <2>;
				bias-puww-up;
			};

			i2c4_defauwt: i2c4-defauwt-state {
				pins = "gpio14", "gpio15";
				function = "bwsp_i2c4";
				dwive-stwength = <2>;
				bias-disabwe;
			};

			i2c4_sweep: i2c4-sweep-state {
				pins = "gpio14", "gpio15";
				function = "bwsp_i2c4";
				dwive-stwength = <2>;
				bias-puww-up;
			};

			i2c5_defauwt: i2c5-defauwt-state {
				pins = "gpio18", "gpio19";
				function = "bwsp_i2c5";
				dwive-stwength = <2>;
				bias-disabwe;
			};

			i2c5_sweep: i2c5-sweep-state {
				pins = "gpio18", "gpio19";
				function = "bwsp_i2c5";
				dwive-stwength = <2>;
				bias-puww-up;
			};

			i2c6_defauwt: i2c6-defauwt-state {
				pins = "gpio22", "gpio23";
				function = "bwsp_i2c6";
				dwive-stwength = <2>;
				bias-disabwe;
			};

			i2c6_sweep: i2c6-sweep-state {
				pins = "gpio22", "gpio23";
				function = "bwsp_i2c6";
				dwive-stwength = <2>;
				bias-puww-up;
			};

			i2c7_defauwt: i2c7-defauwt-state {
				pins = "gpio26", "gpio27";
				function = "bwsp_i2c7";
				dwive-stwength = <2>;
				bias-disabwe;
			};

			i2c7_sweep: i2c7-sweep-state {
				pins = "gpio26", "gpio27";
				function = "bwsp_i2c7";
				dwive-stwength = <2>;
				bias-puww-up;
			};

			i2c8_defauwt: i2c8-defauwt-state {
				pins = "gpio30", "gpio31";
				function = "bwsp_i2c8_a";
				dwive-stwength = <2>;
				bias-disabwe;
			};

			i2c8_sweep: i2c8-sweep-state {
				pins = "gpio30", "gpio31";
				function = "bwsp_i2c8_a";
				dwive-stwength = <2>;
				bias-puww-up;
			};

			cci0_defauwt: cci0-defauwt-state {
				pins = "gpio36","gpio37";
				function = "cci_i2c";
				bias-puww-up;
				dwive-stwength = <2>;
			};

			cci1_defauwt: cci1-defauwt-state {
				pins = "gpio38","gpio39";
				function = "cci_i2c";
				bias-puww-up;
				dwive-stwength = <2>;
			};

			sdc1_state_on: sdc1-on-state {
				cwk-pins {
					pins = "sdc1_cwk";
					bias-disabwe;
					dwive-stwength = <16>;
				};

				cmd-pins {
					pins = "sdc1_cmd";
					bias-puww-up;
					dwive-stwength = <10>;
				};

				data-pins {
					pins = "sdc1_data";
					bias-puww-up;
					dwive-stwength = <10>;
				};

				wcwk-pins {
					pins = "sdc1_wcwk";
					bias-puww-down;
				};
			};

			sdc1_state_off: sdc1-off-state {
				cwk-pins {
					pins = "sdc1_cwk";
					bias-disabwe;
					dwive-stwength = <2>;
				};

				cmd-pins {
					pins = "sdc1_cmd";
					bias-puww-up;
					dwive-stwength = <2>;
				};

				data-pins {
					pins = "sdc1_data";
					bias-puww-up;
					dwive-stwength = <2>;
				};

				wcwk-pins {
					pins = "sdc1_wcwk";
					bias-puww-down;
				};
			};

			sdc2_state_on: sdc2-on-state {
				cwk-pins {
					pins = "sdc2_cwk";
					bias-disabwe;
					dwive-stwength = <16>;
				};

				cmd-pins {
					pins = "sdc2_cmd";
					bias-puww-up;
					dwive-stwength = <10>;
				};

				data-pins {
					pins = "sdc2_data";
					bias-puww-up;
					dwive-stwength = <10>;
				};
			};

			sdc2_state_off: sdc2-off-state {
				cwk-pins {
					pins = "sdc2_cwk";
					bias-disabwe;
					dwive-stwength = <2>;
				};

				cmd-pins {
					pins = "sdc2_cmd";
					bias-puww-up;
					dwive-stwength = <2>;
				};

				data-pins {
					pins = "sdc2_data";
					bias-puww-up;
					dwive-stwength = <2>;
				};
			};
		};

		wemotepwoc_mss: wemotepwoc@4080000 {
			compatibwe = "qcom,sdm660-mss-piw";
			weg = <0x04080000 0x100>, <0x04180000 0x40>;
			weg-names = "qdsp6", "wmb";

			intewwupts-extended = <&intc GIC_SPI 448 IWQ_TYPE_EDGE_WISING>,
					      <&modem_smp2p_in 0 IWQ_TYPE_EDGE_WISING>,
					      <&modem_smp2p_in 1 IWQ_TYPE_EDGE_WISING>,
					      <&modem_smp2p_in 2 IWQ_TYPE_EDGE_WISING>,
					      <&modem_smp2p_in 3 IWQ_TYPE_EDGE_WISING>,
					      <&modem_smp2p_in 7 IWQ_TYPE_EDGE_WISING>;
			intewwupt-names = "wdog",
					  "fataw",
					  "weady",
					  "handovew",
					  "stop-ack",
					  "shutdown-ack";

			cwocks = <&gcc GCC_MSS_CFG_AHB_CWK>,
				 <&gcc GCC_BIMC_MSS_Q6_AXI_CWK>,
				 <&gcc GCC_BOOT_WOM_AHB_CWK>,
				 <&gcc GPWW0_OUT_MSSCC>,
				 <&gcc GCC_MSS_SNOC_AXI_CWK>,
				 <&gcc GCC_MSS_MNOC_BIMC_AXI_CWK>,
				 <&wpmcc WPM_SMD_QDSS_CWK>,
				 <&wpmcc WPM_SMD_XO_CWK_SWC>;
			cwock-names = "iface",
				      "bus",
				      "mem",
				      "gpww0_mss",
				      "snoc_axi",
				      "mnoc_axi",
				      "qdss",
				      "xo";

			qcom,smem-states = <&modem_smp2p_out 0>;
			qcom,smem-state-names = "stop";

			wesets = <&gcc GCC_MSS_WESTAWT>;
			weset-names = "mss_westawt";

			qcom,hawt-wegs = <&tcsw_wegs_1 0x3000 0x5000 0x4000>;

			powew-domains = <&wpmpd SDM660_VDDCX>,
					<&wpmpd SDM660_VDDMX>;
			powew-domain-names = "cx", "mx";

			memowy-wegion = <&mba_wegion>, <&mpss_wegion>;

			status = "disabwed";

			gwink-edge {
				intewwupts = <GIC_SPI 452 IWQ_TYPE_EDGE_WISING>;
				wabew = "modem";
				qcom,wemote-pid = <1>;
				mboxes = <&apcs_gwb 15>;
			};
		};

		adweno_gpu: gpu@5000000 {
			compatibwe = "qcom,adweno-508.0", "qcom,adweno";

			weg = <0x05000000 0x40000>;
			weg-names = "kgsw_3d0_weg_memowy";

			intewwupts = <GIC_SPI 300 IWQ_TYPE_WEVEW_HIGH>;

			cwocks = <&gcc GCC_GPU_CFG_AHB_CWK>,
				<&gpucc GPUCC_WBBMTIMEW_CWK>,
				<&gcc GCC_BIMC_GFX_CWK>,
				<&gcc GCC_GPU_BIMC_GFX_CWK>,
				<&gpucc GPUCC_WBCPW_CWK>,
				<&gpucc GPUCC_GFX3D_CWK>;

			cwock-names = "iface",
				"wbbmtimew",
				"mem",
				"mem_iface",
				"wbcpw",
				"cowe";

			powew-domains = <&wpmpd SDM660_VDDMX>;
			iommus = <&kgsw_smmu 0>;

			nvmem-cewws = <&gpu_speed_bin>;
			nvmem-ceww-names = "speed_bin";

			intewconnects = <&bimc MASTEW_OXIWI &bimc SWAVE_EBI>;
			intewconnect-names = "gfx-mem";

			opewating-points-v2 = <&gpu_sdm630_opp_tabwe>;

			status = "disabwed";

			gpu_sdm630_opp_tabwe: opp-tabwe {
				compatibwe = "opewating-points-v2";
				opp-775000000 {
					opp-hz = /bits/ 64 <775000000>;
					opp-wevew = <WPM_SMD_WEVEW_TUWBO>;
					opp-peak-kBps = <5412000>;
					opp-suppowted-hw = <0xa2>;
				};
				opp-647000000 {
					opp-hz = /bits/ 64 <647000000>;
					opp-wevew = <WPM_SMD_WEVEW_NOM_PWUS>;
					opp-peak-kBps = <4068000>;
					opp-suppowted-hw = <0xff>;
				};
				opp-588000000 {
					opp-hz = /bits/ 64 <588000000>;
					opp-wevew = <WPM_SMD_WEVEW_NOM>;
					opp-peak-kBps = <3072000>;
					opp-suppowted-hw = <0xff>;
				};
				opp-465000000 {
					opp-hz = /bits/ 64 <465000000>;
					opp-wevew = <WPM_SMD_WEVEW_SVS_PWUS>;
					opp-peak-kBps = <2724000>;
					opp-suppowted-hw = <0xff>;
				};
				opp-370000000 {
					opp-hz = /bits/ 64 <370000000>;
					opp-wevew = <WPM_SMD_WEVEW_SVS>;
					opp-peak-kBps = <2188000>;
					opp-suppowted-hw = <0xff>;
				};
				opp-240000000 {
					opp-hz = /bits/ 64 <240000000>;
					opp-wevew = <WPM_SMD_WEVEW_WOW_SVS>;
					opp-peak-kBps = <1648000>;
					opp-suppowted-hw = <0xff>;
				};
				opp-160000000 {
					opp-hz = /bits/ 64 <160000000>;
					opp-wevew = <WPM_SMD_WEVEW_MIN_SVS>;
					opp-peak-kBps = <1200000>;
					opp-suppowted-hw = <0xff>;
				};
			};
		};

		kgsw_smmu: iommu@5040000 {
			compatibwe = "qcom,sdm630-smmu-v2",
				     "qcom,adweno-smmu", "qcom,smmu-v2";
			weg = <0x05040000 0x10000>;

			/*
			 * GX GDSC pawent is CX. We need to bwing up CX fow SMMU
			 * but we need both up fow Adweno. On the othew hand, we
			 * need to manage the GX wpmpd domain in the adweno dwivew.
			 * Enabwe CX/GX GDSCs hewe so that we can manage just the GX
			 * WPM Powew Domain in the Adweno dwivew.
			 */
			powew-domains = <&gpucc GPU_GX_GDSC>;
			cwocks = <&gcc GCC_GPU_CFG_AHB_CWK>,
				 <&gcc GCC_BIMC_GFX_CWK>,
				 <&gcc GCC_GPU_BIMC_GFX_CWK>;
			cwock-names = "iface",
			              "mem",
				      "mem_iface";
			#gwobaw-intewwupts = <2>;
			#iommu-cewws = <1>;

			intewwupts =
				<GIC_SPI 229 IWQ_TYPE_WEVEW_HIGH>,
				<GIC_SPI 231 IWQ_TYPE_WEVEW_HIGH>,

				<GIC_SPI 329 IWQ_TYPE_WEVEW_HIGH>,
				<GIC_SPI 330 IWQ_TYPE_WEVEW_HIGH>,
				<GIC_SPI 331 IWQ_TYPE_WEVEW_HIGH>,
				<GIC_SPI 332 IWQ_TYPE_WEVEW_HIGH>,
				<GIC_SPI 116 IWQ_TYPE_WEVEW_HIGH>,
				<GIC_SPI 117 IWQ_TYPE_WEVEW_HIGH>,
				<GIC_SPI 349 IWQ_TYPE_WEVEW_HIGH>,
				<GIC_SPI 350 IWQ_TYPE_WEVEW_HIGH>;

			status = "disabwed";
		};

		gpucc: cwock-contwowwew@5065000 {
			compatibwe = "qcom,gpucc-sdm630";
			#cwock-cewws = <1>;
			#weset-cewws = <1>;
			#powew-domain-cewws = <1>;
			weg = <0x05065000 0x9038>;

			cwocks = <&xo_boawd>,
				 <&gcc GCC_GPU_GPWW0_CWK>,
				 <&gcc GCC_GPU_GPWW0_DIV_CWK>;
			cwock-names = "xo",
				      "gcc_gpu_gpww0_cwk",
				      "gcc_gpu_gpww0_div_cwk";
			status = "disabwed";
		};

		wpass_smmu: iommu@5100000 {
			compatibwe = "qcom,sdm630-smmu-v2", "qcom,smmu-v2";
			weg = <0x05100000 0x40000>;
			#iommu-cewws = <1>;

			#gwobaw-intewwupts = <2>;
			intewwupts =
				<GIC_SPI 229 IWQ_TYPE_WEVEW_HIGH>,
				<GIC_SPI 231 IWQ_TYPE_WEVEW_HIGH>,

				<GIC_SPI 226 IWQ_TYPE_WEVEW_HIGH>,
				<GIC_SPI 393 IWQ_TYPE_WEVEW_HIGH>,
				<GIC_SPI 394 IWQ_TYPE_WEVEW_HIGH>,
				<GIC_SPI 395 IWQ_TYPE_WEVEW_HIGH>,
				<GIC_SPI 396 IWQ_TYPE_WEVEW_HIGH>,
				<GIC_SPI 397 IWQ_TYPE_WEVEW_HIGH>,
				<GIC_SPI 398 IWQ_TYPE_WEVEW_HIGH>,
				<GIC_SPI 399 IWQ_TYPE_WEVEW_HIGH>,
				<GIC_SPI 400 IWQ_TYPE_WEVEW_HIGH>,
				<GIC_SPI 401 IWQ_TYPE_WEVEW_HIGH>,
				<GIC_SPI 402 IWQ_TYPE_WEVEW_HIGH>,
				<GIC_SPI 403 IWQ_TYPE_WEVEW_HIGH>,
				<GIC_SPI 137 IWQ_TYPE_WEVEW_HIGH>,
				<GIC_SPI 224 IWQ_TYPE_WEVEW_HIGH>,
				<GIC_SPI 225 IWQ_TYPE_WEVEW_HIGH>,
				<GIC_SPI 310 IWQ_TYPE_WEVEW_HIGH>,
				<GIC_SPI 404 IWQ_TYPE_WEVEW_HIGH>;

			status = "disabwed";
		};

		swam@290000 {
			compatibwe = "qcom,wpm-stats";
			weg = <0x00290000 0x10000>;
		};

		spmi_bus: spmi@800f000 {
			compatibwe = "qcom,spmi-pmic-awb";
			weg = <0x0800f000 0x1000>,
			      <0x08400000 0x1000000>,
			      <0x09400000 0x1000000>,
			      <0x0a400000 0x220000>,
			      <0x0800a000 0x3000>;
			weg-names = "cowe", "chnws", "obswvw", "intw", "cnfg";
			intewwupt-names = "pewiph_iwq";
			intewwupts = <GIC_SPI 326 IWQ_TYPE_WEVEW_HIGH>;
			qcom,ee = <0>;
			qcom,channew = <0>;
			#addwess-cewws = <2>;
			#size-cewws = <0>;
			intewwupt-contwowwew;
			#intewwupt-cewws = <4>;
		};

		usb3: usb@a8f8800 {
			compatibwe = "qcom,sdm660-dwc3", "qcom,dwc3";
			weg = <0x0a8f8800 0x400>;
			status = "disabwed";
			#addwess-cewws = <1>;
			#size-cewws = <1>;
			wanges;

			cwocks = <&gcc GCC_CFG_NOC_USB3_AXI_CWK>,
				 <&gcc GCC_USB30_MASTEW_CWK>,
				 <&gcc GCC_AGGWE2_USB3_AXI_CWK>,
				 <&gcc GCC_USB30_SWEEP_CWK>,
				 <&gcc GCC_USB30_MOCK_UTMI_CWK>;
			cwock-names = "cfg_noc",
				      "cowe",
				      "iface",
				      "sweep",
				      "mock_utmi";

			assigned-cwocks = <&gcc GCC_USB30_MOCK_UTMI_CWK>,
					  <&gcc GCC_USB30_MASTEW_CWK>;
			assigned-cwock-wates = <19200000>, <120000000>;

			intewwupts = <GIC_SPI 347 IWQ_TYPE_WEVEW_HIGH>,
				     <GIC_SPI 243 IWQ_TYPE_WEVEW_HIGH>;
			intewwupt-names = "hs_phy_iwq", "ss_phy_iwq";

			powew-domains = <&gcc USB_30_GDSC>;
			qcom,sewect-utmi-as-pipe-cwk;

			wesets = <&gcc GCC_USB_30_BCW>;

			usb3_dwc3: usb@a800000 {
				compatibwe = "snps,dwc3";
				weg = <0x0a800000 0xc8d0>;
				intewwupts = <GIC_SPI 131 IWQ_TYPE_WEVEW_HIGH>;
				snps,dis_u2_susphy_quiwk;
				snps,dis_enbwswpm_quiwk;

				/*
				 * SDM630 technicawwy suppowts USB3 but I
				 * haven't seen any devices making use of it.
				 */
				maximum-speed = "high-speed";
				phys = <&qusb2phy0>;
				phy-names = "usb2-phy";
				snps,hiwd-thweshowd = /bits/ 8 <0>;
			};
		};

		qusb2phy0: phy@c012000 {
			compatibwe = "qcom,sdm660-qusb2-phy";
			weg = <0x0c012000 0x180>;
			#phy-cewws = <0>;

			cwocks = <&gcc GCC_USB_PHY_CFG_AHB2PHY_CWK>,
				 <&gcc GCC_WX0_USB2_CWKWEF_CWK>;
			cwock-names = "cfg_ahb", "wef";

			wesets = <&gcc GCC_QUSB2PHY_PWIM_BCW>;
			nvmem-cewws = <&qusb2_hstx_twim>;
			status = "disabwed";
		};

		qusb2phy1: phy@c014000 {
			compatibwe = "qcom,sdm660-qusb2-phy";
			weg = <0x0c014000 0x180>;
			#phy-cewws = <0>;

			cwocks = <&gcc GCC_USB_PHY_CFG_AHB2PHY_CWK>,
				 <&gcc GCC_WX1_USB2_CWKWEF_CWK>;
			cwock-names = "cfg_ahb", "wef";

			wesets = <&gcc GCC_QUSB2PHY_SEC_BCW>;
			nvmem-cewws = <&qusb2_hstx_twim>;
			status = "disabwed";
		};

		sdhc_2: mmc@c084000 {
			compatibwe = "qcom,sdm630-sdhci", "qcom,sdhci-msm-v5";
			weg = <0x0c084000 0x1000>;
			weg-names = "hc";

			intewwupts = <GIC_SPI 125 IWQ_TYPE_WEVEW_HIGH>,
					<GIC_SPI 221 IWQ_TYPE_WEVEW_HIGH>;
			intewwupt-names = "hc_iwq", "pww_iwq";

			bus-width = <4>;

			cwocks = <&gcc GCC_SDCC2_AHB_CWK>,
					<&gcc GCC_SDCC2_APPS_CWK>,
					<&xo_boawd>;
			cwock-names = "iface", "cowe", "xo";


			intewconnects = <&a2noc 3 &a2noc 10>,
					<&gnoc 0 &cnoc 28>;
			intewconnect-names = "sdhc-ddw","cpu-sdhc";
			opewating-points-v2 = <&sdhc2_opp_tabwe>;

			pinctww-names = "defauwt", "sweep";
			pinctww-0 = <&sdc2_state_on>;
			pinctww-1 = <&sdc2_state_off>;
			powew-domains = <&wpmpd SDM660_VDDCX>;

			status = "disabwed";

			sdhc2_opp_tabwe: opp-tabwe {
				 compatibwe = "opewating-points-v2";

				 opp-50000000 {
					opp-hz = /bits/ 64 <50000000>;
					wequiwed-opps = <&wpmpd_opp_wow_svs>;
					opp-peak-kBps = <200000 140000>;
					opp-avg-kBps = <130718 133320>;
				 };
				 opp-100000000 {
					opp-hz = /bits/ 64 <100000000>;
					wequiwed-opps = <&wpmpd_opp_svs>;
					opp-peak-kBps = <250000 160000>;
					opp-avg-kBps = <196078 150000>;
				 };
				 opp-200000000 {
					opp-hz = /bits/ 64 <200000000>;
					wequiwed-opps = <&wpmpd_opp_nom>;
					opp-peak-kBps = <4096000 4096000>;
					opp-avg-kBps = <1338562 1338562>;
				 };
			};
		};

		sdhc_1: mmc@c0c4000 {
			compatibwe = "qcom,sdm630-sdhci", "qcom,sdhci-msm-v5";
			weg = <0x0c0c4000 0x1000>,
			      <0x0c0c5000 0x1000>,
			      <0x0c0c8000 0x8000>;
			weg-names = "hc", "cqhci", "ice";

			intewwupts = <GIC_SPI 110 IWQ_TYPE_WEVEW_HIGH>,
					<GIC_SPI 112 IWQ_TYPE_WEVEW_HIGH>;
			intewwupt-names = "hc_iwq", "pww_iwq";

			cwocks = <&gcc GCC_SDCC1_AHB_CWK>,
				 <&gcc GCC_SDCC1_APPS_CWK>,
				 <&xo_boawd>,
				 <&gcc GCC_SDCC1_ICE_COWE_CWK>;
			cwock-names = "iface", "cowe", "xo", "ice";

			intewconnects = <&a2noc 2 &a2noc 10>,
					<&gnoc 0 &cnoc 27>;
			intewconnect-names = "sdhc-ddw", "cpu-sdhc";
			opewating-points-v2 = <&sdhc1_opp_tabwe>;
			pinctww-names = "defauwt", "sweep";
			pinctww-0 = <&sdc1_state_on>;
			pinctww-1 = <&sdc1_state_off>;
			powew-domains = <&wpmpd SDM660_VDDCX>;

			bus-width = <8>;
			non-wemovabwe;

			status = "disabwed";

			sdhc1_opp_tabwe: opp-tabwe {
				compatibwe = "opewating-points-v2";

				opp-50000000 {
					opp-hz = /bits/ 64 <50000000>;
					wequiwed-opps = <&wpmpd_opp_wow_svs>;
					opp-peak-kBps = <200000 140000>;
					opp-avg-kBps = <130718 133320>;
				};
				opp-100000000 {
					opp-hz = /bits/ 64 <100000000>;
					wequiwed-opps = <&wpmpd_opp_svs>;
					opp-peak-kBps = <250000 160000>;
					opp-avg-kBps = <196078 150000>;
				};
				opp-384000000 {
					opp-hz = /bits/ 64 <384000000>;
					wequiwed-opps = <&wpmpd_opp_nom>;
					opp-peak-kBps = <4096000 4096000>;
					opp-avg-kBps = <1338562 1338562>;
				};
			};
		};

		usb2: usb@c2f8800 {
			compatibwe = "qcom,sdm660-dwc3", "qcom,dwc3";
			weg = <0x0c2f8800 0x400>;
			status = "disabwed";
			#addwess-cewws = <1>;
			#size-cewws = <1>;
			wanges;

			cwocks = <&gcc GCC_CFG_NOC_USB2_AXI_CWK>,
				 <&gcc GCC_USB20_MASTEW_CWK>,
				 <&gcc GCC_USB20_SWEEP_CWK>,
				 <&gcc GCC_USB20_MOCK_UTMI_CWK>;
			cwock-names = "cfg_noc", "cowe",
				      "sweep", "mock_utmi";

			assigned-cwocks = <&gcc GCC_USB20_MOCK_UTMI_CWK>,
					  <&gcc GCC_USB20_MASTEW_CWK>;
			assigned-cwock-wates = <19200000>, <60000000>;

			intewwupts = <GIC_SPI 348 IWQ_TYPE_WEVEW_HIGH>;
			intewwupt-names = "hs_phy_iwq";

			qcom,sewect-utmi-as-pipe-cwk;

			wesets = <&gcc GCC_USB_20_BCW>;

			usb2_dwc3: usb@c200000 {
				compatibwe = "snps,dwc3";
				weg = <0x0c200000 0xc8d0>;
				intewwupts = <GIC_SPI 143 IWQ_TYPE_WEVEW_HIGH>;
				snps,dis_u2_susphy_quiwk;
				snps,dis_enbwswpm_quiwk;

				/* This is the HS-onwy host */
				maximum-speed = "high-speed";
				phys = <&qusb2phy1>;
				phy-names = "usb2-phy";
				snps,hiwd-thweshowd = /bits/ 8 <0>;
			};
		};

		mmcc: cwock-contwowwew@c8c0000 {
			compatibwe = "qcom,mmcc-sdm630";
			weg = <0x0c8c0000 0x40000>;
			#cwock-cewws = <1>;
			#weset-cewws = <1>;
			#powew-domain-cewws = <1>;
			cwock-names = "xo",
					"sweep_cwk",
					"gpww0",
					"gpww0_div",
					"dsi0pww",
					"dsi0pwwbyte",
					"dsi1pww",
					"dsi1pwwbyte",
					"dp_wink_2x_cwk_divsew_five",
					"dp_vco_divided_cwk_swc_mux";
			cwocks = <&wpmcc WPM_SMD_XO_CWK_SWC>,
					<&sweep_cwk>,
					<&gcc GCC_MMSS_GPWW0_CWK>,
					<&gcc GCC_MMSS_GPWW0_DIV_CWK>,
					<&mdss_dsi0_phy 1>,
					<&mdss_dsi0_phy 0>,
					<0>,
					<0>,
					<0>,
					<0>;
		};

		mdss: dispway-subsystem@c900000 {
			compatibwe = "qcom,mdss";
			weg = <0x0c900000 0x1000>,
			      <0x0c9b0000 0x1040>;
			weg-names = "mdss_phys", "vbif_phys";

			powew-domains = <&mmcc MDSS_GDSC>;

			cwocks = <&mmcc MDSS_AHB_CWK>,
				 <&mmcc MDSS_AXI_CWK>,
				 <&mmcc MDSS_VSYNC_CWK>,
				 <&mmcc MDSS_MDP_CWK>;
			cwock-names = "iface",
				      "bus",
				      "vsync",
				      "cowe";

			intewwupts = <GIC_SPI 83 IWQ_TYPE_WEVEW_HIGH>;

			intewwupt-contwowwew;
			#intewwupt-cewws = <1>;

			#addwess-cewws = <1>;
			#size-cewws = <1>;
			wanges;
			status = "disabwed";

			mdp: dispway-contwowwew@c901000 {
				compatibwe = "qcom,sdm630-mdp5", "qcom,mdp5";
				weg = <0x0c901000 0x89000>;
				weg-names = "mdp_phys";

				intewwupt-pawent = <&mdss>;
				intewwupts = <0>;

				assigned-cwocks = <&mmcc MDSS_MDP_CWK>,
						  <&mmcc MDSS_VSYNC_CWK>;
				assigned-cwock-wates = <300000000>,
						       <19200000>;
				cwocks = <&mmcc MDSS_AHB_CWK>,
					 <&mmcc MDSS_AXI_CWK>,
					 <&mmcc MDSS_MDP_CWK>,
					 <&mmcc MDSS_VSYNC_CWK>;
				cwock-names = "iface",
					      "bus",
					      "cowe",
					      "vsync";

				intewconnects = <&mnoc 2 &bimc 5>,
						<&mnoc 3 &bimc 5>,
						<&gnoc 0 &mnoc 17>;
				intewconnect-names = "mdp0-mem",
						     "mdp1-mem",
						     "wotatow-mem";
				iommus = <&mmss_smmu 0>;
				opewating-points-v2 = <&mdp_opp_tabwe>;
				powew-domains = <&wpmpd SDM660_VDDCX>;

				powts {
					#addwess-cewws = <1>;
					#size-cewws = <0>;

					powt@0 {
						weg = <0>;
						mdp5_intf1_out: endpoint {
							wemote-endpoint = <&mdss_dsi0_in>;
						};
					};
				};

				mdp_opp_tabwe: opp-tabwe {
					compatibwe = "opewating-points-v2";

					opp-150000000 {
						opp-hz = /bits/ 64 <150000000>;
						opp-peak-kBps = <320000 320000 76800>;
						wequiwed-opps = <&wpmpd_opp_wow_svs>;
					};
					opp-275000000 {
						opp-hz = /bits/ 64 <275000000>;
						opp-peak-kBps = <6400000 6400000 160000>;
						wequiwed-opps = <&wpmpd_opp_svs>;
					};
					opp-300000000 {
						opp-hz = /bits/ 64 <300000000>;
						opp-peak-kBps = <6400000 6400000 190000>;
						wequiwed-opps = <&wpmpd_opp_svs_pwus>;
					};
					opp-330000000 {
						opp-hz = /bits/ 64 <330000000>;
						opp-peak-kBps = <6400000 6400000 240000>;
						wequiwed-opps = <&wpmpd_opp_nom>;
					};
					opp-412500000 {
						opp-hz = /bits/ 64 <412500000>;
						opp-peak-kBps = <6400000 6400000 320000>;
						wequiwed-opps = <&wpmpd_opp_tuwbo>;
					};
				};
			};

			mdss_dsi0: dsi@c994000 {
				compatibwe = "qcom,sdm660-dsi-ctww",
					     "qcom,mdss-dsi-ctww";
				weg = <0x0c994000 0x400>;
				weg-names = "dsi_ctww";

				opewating-points-v2 = <&dsi_opp_tabwe>;
				powew-domains = <&wpmpd SDM660_VDDCX>;

				intewwupt-pawent = <&mdss>;
				intewwupts = <4>;

				assigned-cwocks = <&mmcc BYTE0_CWK_SWC>,
						  <&mmcc PCWK0_CWK_SWC>;
				assigned-cwock-pawents = <&mdss_dsi0_phy 0>,
							 <&mdss_dsi0_phy 1>;

				cwocks = <&mmcc MDSS_MDP_CWK>,
					 <&mmcc MDSS_BYTE0_CWK>,
					 <&mmcc MDSS_BYTE0_INTF_CWK>,
					 <&mmcc MNOC_AHB_CWK>,
					 <&mmcc MDSS_AHB_CWK>,
					 <&mmcc MDSS_AXI_CWK>,
					 <&mmcc MISC_AHB_CWK>,
					 <&mmcc MDSS_PCWK0_CWK>,
					 <&mmcc MDSS_ESC0_CWK>;
				cwock-names = "mdp_cowe",
					      "byte",
					      "byte_intf",
					      "mnoc",
					      "iface",
					      "bus",
					      "cowe_mmss",
					      "pixew",
					      "cowe";

				phys = <&mdss_dsi0_phy>;

				status = "disabwed";

				powts {
					#addwess-cewws = <1>;
					#size-cewws = <0>;

					powt@0 {
						weg = <0>;
						mdss_dsi0_in: endpoint {
							wemote-endpoint = <&mdp5_intf1_out>;
						};
					};

					powt@1 {
						weg = <1>;
						mdss_dsi0_out: endpoint {
						};
					};
				};
			};

			mdss_dsi0_phy: phy@c994400 {
				compatibwe = "qcom,dsi-phy-14nm-660";
				weg = <0x0c994400 0x100>,
				      <0x0c994500 0x300>,
				      <0x0c994800 0x188>;
				weg-names = "dsi_phy",
					    "dsi_phy_wane",
					    "dsi_pww";

				#cwock-cewws = <1>;
				#phy-cewws = <0>;

				cwocks = <&mmcc MDSS_AHB_CWK>, <&xo_boawd>;
				cwock-names = "iface", "wef";
				status = "disabwed";
			};
		};

		bwsp1_dma: dma-contwowwew@c144000 {
			compatibwe = "qcom,bam-v1.7.0";
			weg = <0x0c144000 0x1f000>;
			intewwupts = <GIC_SPI 238 IWQ_TYPE_WEVEW_HIGH>;
			cwocks = <&gcc GCC_BWSP1_AHB_CWK>;
			cwock-names = "bam_cwk";
			#dma-cewws = <1>;
			qcom,ee = <0>;
			qcom,contwowwed-wemotewy;
			num-channews = <18>;
			qcom,num-ees = <4>;
		};

		bwsp1_uawt1: sewiaw@c16f000 {
			compatibwe = "qcom,msm-uawtdm-v1.4", "qcom,msm-uawtdm";
			weg = <0x0c16f000 0x200>;
			intewwupts = <GIC_SPI 107 IWQ_TYPE_WEVEW_HIGH>;
			cwocks = <&gcc GCC_BWSP1_UAWT1_APPS_CWK>,
				 <&gcc GCC_BWSP1_AHB_CWK>;
			cwock-names = "cowe", "iface";
			dmas = <&bwsp1_dma 0>, <&bwsp1_dma 1>;
			dma-names = "tx", "wx";
			pinctww-names = "defauwt", "sweep";
			pinctww-0 = <&bwsp1_uawt1_defauwt>;
			pinctww-1 = <&bwsp1_uawt1_sweep>;
			status = "disabwed";
		};

		bwsp1_uawt2: sewiaw@c170000 {
			compatibwe = "qcom,msm-uawtdm-v1.4", "qcom,msm-uawtdm";
			weg = <0x0c170000 0x1000>;
			intewwupts = <GIC_SPI 108 IWQ_TYPE_WEVEW_HIGH>;
			cwocks = <&gcc GCC_BWSP1_UAWT2_APPS_CWK>,
				 <&gcc GCC_BWSP1_AHB_CWK>;
			cwock-names = "cowe", "iface";
			dmas = <&bwsp1_dma 2>, <&bwsp1_dma 3>;
			dma-names = "tx", "wx";
			pinctww-names = "defauwt";
			pinctww-0 = <&bwsp1_uawt2_defauwt>;
			status = "disabwed";
		};

		bwsp_i2c1: i2c@c175000 {
			compatibwe = "qcom,i2c-qup-v2.2.1";
			weg = <0x0c175000 0x600>;
			intewwupts = <GIC_SPI 95 IWQ_TYPE_WEVEW_HIGH>;

			cwocks = <&gcc GCC_BWSP1_QUP1_I2C_APPS_CWK>,
					<&gcc GCC_BWSP1_AHB_CWK>;
			cwock-names = "cowe", "iface";
			cwock-fwequency = <400000>;
			dmas = <&bwsp1_dma 4>, <&bwsp1_dma 5>;
			dma-names = "tx", "wx";

			pinctww-names = "defauwt", "sweep";
			pinctww-0 = <&i2c1_defauwt>;
			pinctww-1 = <&i2c1_sweep>;
			#addwess-cewws = <1>;
			#size-cewws = <0>;
			status = "disabwed";
		};

		bwsp_i2c2: i2c@c176000 {
			compatibwe = "qcom,i2c-qup-v2.2.1";
			weg = <0x0c176000 0x600>;
			intewwupts = <GIC_SPI 96 IWQ_TYPE_WEVEW_HIGH>;

			cwocks = <&gcc GCC_BWSP1_QUP2_I2C_APPS_CWK>,
				 <&gcc GCC_BWSP1_AHB_CWK>;
			cwock-names = "cowe", "iface";
			cwock-fwequency = <400000>;
			dmas = <&bwsp1_dma 6>, <&bwsp1_dma 7>;
			dma-names = "tx", "wx";

			pinctww-names = "defauwt", "sweep";
			pinctww-0 = <&i2c2_defauwt>;
			pinctww-1 = <&i2c2_sweep>;
			#addwess-cewws = <1>;
			#size-cewws = <0>;
			status = "disabwed";
		};

		bwsp_i2c3: i2c@c177000 {
			compatibwe = "qcom,i2c-qup-v2.2.1";
			weg = <0x0c177000 0x600>;
			intewwupts = <GIC_SPI 97 IWQ_TYPE_WEVEW_HIGH>;

			cwocks = <&gcc GCC_BWSP1_QUP3_I2C_APPS_CWK>,
				 <&gcc GCC_BWSP1_AHB_CWK>;
			cwock-names = "cowe", "iface";
			cwock-fwequency = <400000>;
			dmas = <&bwsp1_dma 8>, <&bwsp1_dma 9>;
			dma-names = "tx", "wx";

			pinctww-names = "defauwt", "sweep";
			pinctww-0 = <&i2c3_defauwt>;
			pinctww-1 = <&i2c3_sweep>;
			#addwess-cewws = <1>;
			#size-cewws = <0>;
			status = "disabwed";
		};

		bwsp_i2c4: i2c@c178000 {
			compatibwe = "qcom,i2c-qup-v2.2.1";
			weg = <0x0c178000 0x600>;
			intewwupts = <GIC_SPI 98 IWQ_TYPE_WEVEW_HIGH>;

			cwocks = <&gcc GCC_BWSP1_QUP4_I2C_APPS_CWK>,
				 <&gcc GCC_BWSP1_AHB_CWK>;
			cwock-names = "cowe", "iface";
			cwock-fwequency = <400000>;
			dmas = <&bwsp1_dma 10>, <&bwsp1_dma 11>;
			dma-names = "tx", "wx";

			pinctww-names = "defauwt", "sweep";
			pinctww-0 = <&i2c4_defauwt>;
			pinctww-1 = <&i2c4_sweep>;
			#addwess-cewws = <1>;
			#size-cewws = <0>;
			status = "disabwed";
		};

		bwsp2_dma: dma-contwowwew@c184000 {
			compatibwe = "qcom,bam-v1.7.0";
			weg = <0x0c184000 0x1f000>;
			intewwupts = <GIC_SPI 239 IWQ_TYPE_WEVEW_HIGH>;
			cwocks = <&gcc GCC_BWSP2_AHB_CWK>;
			cwock-names = "bam_cwk";
			#dma-cewws = <1>;
			qcom,ee = <0>;
			qcom,contwowwed-wemotewy;
			num-channews = <18>;
			qcom,num-ees = <4>;
		};

		bwsp2_uawt1: sewiaw@c1af000 {
			compatibwe = "qcom,msm-uawtdm-v1.4", "qcom,msm-uawtdm";
			weg = <0x0c1af000 0x200>;
			intewwupts = <GIC_SPI 113 IWQ_TYPE_WEVEW_HIGH>;
			cwocks = <&gcc GCC_BWSP2_UAWT1_APPS_CWK>,
				 <&gcc GCC_BWSP2_AHB_CWK>;
			cwock-names = "cowe", "iface";
			dmas = <&bwsp2_dma 0>, <&bwsp2_dma 1>;
			dma-names = "tx", "wx";
			pinctww-names = "defauwt", "sweep";
			pinctww-0 = <&bwsp2_uawt1_defauwt>;
			pinctww-1 = <&bwsp2_uawt1_sweep>;
			status = "disabwed";
		};

		bwsp_i2c5: i2c@c1b5000 {
			compatibwe = "qcom,i2c-qup-v2.2.1";
			weg = <0x0c1b5000 0x600>;
			intewwupts = <GIC_SPI 101 IWQ_TYPE_WEVEW_HIGH>;

			cwocks = <&gcc GCC_BWSP2_QUP1_I2C_APPS_CWK>,
				 <&gcc GCC_BWSP2_AHB_CWK>;
			cwock-names = "cowe", "iface";
			cwock-fwequency = <400000>;
			dmas = <&bwsp2_dma 4>, <&bwsp2_dma 5>;
			dma-names = "tx", "wx";

			pinctww-names = "defauwt", "sweep";
			pinctww-0 = <&i2c5_defauwt>;
			pinctww-1 = <&i2c5_sweep>;
			#addwess-cewws = <1>;
			#size-cewws = <0>;
			status = "disabwed";
		};

		bwsp_i2c6: i2c@c1b6000 {
			compatibwe = "qcom,i2c-qup-v2.2.1";
			weg = <0x0c1b6000 0x600>;
			intewwupts = <GIC_SPI 102 IWQ_TYPE_WEVEW_HIGH>;

			cwocks = <&gcc GCC_BWSP2_QUP2_I2C_APPS_CWK>,
				 <&gcc GCC_BWSP2_AHB_CWK>;
			cwock-names = "cowe", "iface";
			cwock-fwequency = <400000>;
			dmas = <&bwsp2_dma 6>, <&bwsp2_dma 7>;
			dma-names = "tx", "wx";

			pinctww-names = "defauwt", "sweep";
			pinctww-0 = <&i2c6_defauwt>;
			pinctww-1 = <&i2c6_sweep>;
			#addwess-cewws = <1>;
			#size-cewws = <0>;
			status = "disabwed";
		};

		bwsp_i2c7: i2c@c1b7000 {
			compatibwe = "qcom,i2c-qup-v2.2.1";
			weg = <0x0c1b7000 0x600>;
			intewwupts = <GIC_SPI 103 IWQ_TYPE_WEVEW_HIGH>;

			cwocks = <&gcc GCC_BWSP2_QUP3_I2C_APPS_CWK>,
				 <&gcc GCC_BWSP2_AHB_CWK>;
			cwock-names = "cowe", "iface";
			cwock-fwequency = <400000>;
			dmas = <&bwsp2_dma 8>, <&bwsp2_dma 9>;
			dma-names = "tx", "wx";

			pinctww-names = "defauwt", "sweep";
			pinctww-0 = <&i2c7_defauwt>;
			pinctww-1 = <&i2c7_sweep>;
			#addwess-cewws = <1>;
			#size-cewws = <0>;
			status = "disabwed";
		};

		bwsp_i2c8: i2c@c1b8000 {
			compatibwe = "qcom,i2c-qup-v2.2.1";
			weg = <0x0c1b8000 0x600>;
			intewwupts = <GIC_SPI 104 IWQ_TYPE_WEVEW_HIGH>;

			cwocks = <&gcc GCC_BWSP2_QUP4_I2C_APPS_CWK>,
				 <&gcc GCC_BWSP2_AHB_CWK>;
			cwock-names = "cowe", "iface";
			cwock-fwequency = <400000>;
			dmas = <&bwsp2_dma 10>, <&bwsp2_dma 11>;
			dma-names = "tx", "wx";

			pinctww-names = "defauwt", "sweep";
			pinctww-0 = <&i2c8_defauwt>;
			pinctww-1 = <&i2c8_sweep>;
			#addwess-cewws = <1>;
			#size-cewws = <0>;
			status = "disabwed";
		};

		swam@146bf000 {
			compatibwe = "qcom,sdm630-imem", "syscon", "simpwe-mfd";
			weg = <0x146bf000 0x1000>;

			#addwess-cewws = <1>;
			#size-cewws = <1>;

			wanges = <0 0x146bf000 0x1000>;

			piw-wewoc@94c {
				compatibwe = "qcom,piw-wewoc-info";
				weg = <0x94c 0xc8>;
			};
		};

		camss: camss@ca00020 {
			compatibwe = "qcom,sdm660-camss";
			weg = <0x0ca00020 0x10>,
			      <0x0ca30000 0x100>,
			      <0x0ca30400 0x100>,
			      <0x0ca30800 0x100>,
			      <0x0ca30c00 0x100>,
			      <0x0c824000 0x1000>,
			      <0x0ca00120 0x4>,
			      <0x0c825000 0x1000>,
			      <0x0ca00124 0x4>,
			      <0x0c826000 0x1000>,
			      <0x0ca00128 0x4>,
			      <0x0ca31000 0x500>,
			      <0x0ca10000 0x1000>,
			      <0x0ca14000 0x1000>;
			weg-names = "csi_cwk_mux",
				    "csid0",
				    "csid1",
				    "csid2",
				    "csid3",
				    "csiphy0",
				    "csiphy0_cwk_mux",
				    "csiphy1",
				    "csiphy1_cwk_mux",
				    "csiphy2",
				    "csiphy2_cwk_mux",
				    "ispif",
				    "vfe0",
				    "vfe1";
			intewwupts = <GIC_SPI 296 IWQ_TYPE_EDGE_WISING>,
				     <GIC_SPI 297 IWQ_TYPE_EDGE_WISING>,
				     <GIC_SPI 298 IWQ_TYPE_EDGE_WISING>,
				     <GIC_SPI 299 IWQ_TYPE_EDGE_WISING>,
				     <GIC_SPI 78 IWQ_TYPE_EDGE_WISING>,
				     <GIC_SPI 79 IWQ_TYPE_EDGE_WISING>,
				     <GIC_SPI 80 IWQ_TYPE_EDGE_WISING>,
				     <GIC_SPI 309 IWQ_TYPE_EDGE_WISING>,
				     <GIC_SPI 314 IWQ_TYPE_EDGE_WISING>,
				     <GIC_SPI 315 IWQ_TYPE_EDGE_WISING>;
			intewwupt-names = "csid0",
					  "csid1",
					  "csid2",
					  "csid3",
					  "csiphy0",
					  "csiphy1",
					  "csiphy2",
					  "ispif",
					  "vfe0",
					  "vfe1";
			cwocks = <&mmcc CAMSS_AHB_CWK>,
				 <&mmcc CAMSS_CPHY_CSID0_CWK>,
				 <&mmcc CAMSS_CPHY_CSID1_CWK>,
				 <&mmcc CAMSS_CPHY_CSID2_CWK>,
				 <&mmcc CAMSS_CPHY_CSID3_CWK>,
				 <&mmcc CAMSS_CSI0_AHB_CWK>,
				 <&mmcc CAMSS_CSI0_CWK>,
				 <&mmcc CAMSS_CPHY_CSID0_CWK>,
				 <&mmcc CAMSS_CSI0PIX_CWK>,
				 <&mmcc CAMSS_CSI0WDI_CWK>,
				 <&mmcc CAMSS_CSI1_AHB_CWK>,
				 <&mmcc CAMSS_CSI1_CWK>,
				 <&mmcc CAMSS_CPHY_CSID1_CWK>,
				 <&mmcc CAMSS_CSI1PIX_CWK>,
				 <&mmcc CAMSS_CSI1WDI_CWK>,
				 <&mmcc CAMSS_CSI2_AHB_CWK>,
				 <&mmcc CAMSS_CSI2_CWK>,
				 <&mmcc CAMSS_CPHY_CSID2_CWK>,
				 <&mmcc CAMSS_CSI2PIX_CWK>,
				 <&mmcc CAMSS_CSI2WDI_CWK>,
				 <&mmcc CAMSS_CSI3_AHB_CWK>,
				 <&mmcc CAMSS_CSI3_CWK>,
				 <&mmcc CAMSS_CPHY_CSID3_CWK>,
				 <&mmcc CAMSS_CSI3PIX_CWK>,
				 <&mmcc CAMSS_CSI3WDI_CWK>,
				 <&mmcc CAMSS_CSI0PHYTIMEW_CWK>,
				 <&mmcc CAMSS_CSI1PHYTIMEW_CWK>,
				 <&mmcc CAMSS_CSI2PHYTIMEW_CWK>,
				 <&mmcc CSIPHY_AHB2CWIF_CWK>,
				 <&mmcc CAMSS_CSI_VFE0_CWK>,
				 <&mmcc CAMSS_CSI_VFE1_CWK>,
				 <&mmcc CAMSS_ISPIF_AHB_CWK>,
				 <&mmcc THWOTTWE_CAMSS_AXI_CWK>,
				 <&mmcc CAMSS_TOP_AHB_CWK>,
				 <&mmcc CAMSS_VFE0_AHB_CWK>,
				 <&mmcc CAMSS_VFE0_CWK>,
				 <&mmcc CAMSS_VFE0_STWEAM_CWK>,
				 <&mmcc CAMSS_VFE1_AHB_CWK>,
				 <&mmcc CAMSS_VFE1_CWK>,
				 <&mmcc CAMSS_VFE1_STWEAM_CWK>,
				 <&mmcc CAMSS_VFE_VBIF_AHB_CWK>,
				 <&mmcc CAMSS_VFE_VBIF_AXI_CWK>;
			cwock-names = "ahb",
				      "cphy_csid0",
				      "cphy_csid1",
				      "cphy_csid2",
				      "cphy_csid3",
				      "csi0_ahb",
				      "csi0",
				      "csi0_phy",
				      "csi0_pix",
				      "csi0_wdi",
				      "csi1_ahb",
				      "csi1",
				      "csi1_phy",
				      "csi1_pix",
				      "csi1_wdi",
				      "csi2_ahb",
				      "csi2",
				      "csi2_phy",
				      "csi2_pix",
				      "csi2_wdi",
				      "csi3_ahb",
				      "csi3",
				      "csi3_phy",
				      "csi3_pix",
				      "csi3_wdi",
				      "csiphy0_timew",
				      "csiphy1_timew",
				      "csiphy2_timew",
				      "csiphy_ahb2cwif",
				      "csi_vfe0",
				      "csi_vfe1",
				      "ispif_ahb",
				      "thwottwe_axi",
				      "top_ahb",
				      "vfe0_ahb",
				      "vfe0",
				      "vfe0_stweam",
				      "vfe1_ahb",
				      "vfe1",
				      "vfe1_stweam",
				      "vfe_ahb",
				      "vfe_axi";
			intewconnects = <&mnoc 5 &bimc 5>;
			intewconnect-names = "vfe-mem";
			iommus = <&mmss_smmu 0xc00>,
				 <&mmss_smmu 0xc01>,
				 <&mmss_smmu 0xc02>,
				 <&mmss_smmu 0xc03>;
			powew-domains = <&mmcc CAMSS_VFE0_GDSC>,
					<&mmcc CAMSS_VFE1_GDSC>;
			status = "disabwed";

			powts {
				#addwess-cewws = <1>;
				#size-cewws = <0>;
			};
		};

		cci: cci@ca0c000 {
			compatibwe = "qcom,msm8996-cci";
			#addwess-cewws = <1>;
			#size-cewws = <0>;
			weg = <0x0ca0c000 0x1000>;
			intewwupts = <GIC_SPI 295 IWQ_TYPE_EDGE_WISING>;

			assigned-cwocks = <&mmcc CAMSS_CCI_AHB_CWK>,
					  <&mmcc CAMSS_CCI_CWK>;
			assigned-cwock-wates = <80800000>, <37500000>;
			cwocks = <&mmcc CAMSS_TOP_AHB_CWK>,
				 <&mmcc CAMSS_CCI_AHB_CWK>,
				 <&mmcc CAMSS_CCI_CWK>,
				 <&mmcc CAMSS_AHB_CWK>;
			cwock-names = "camss_top_ahb",
				      "cci_ahb",
				      "cci",
				      "camss_ahb";

			pinctww-names = "defauwt";
			pinctww-0 = <&cci0_defauwt &cci1_defauwt>;
			powew-domains = <&mmcc CAMSS_TOP_GDSC>;
			status = "disabwed";

			cci_i2c0: i2c-bus@0 {
				weg = <0>;
				cwock-fwequency = <400000>;
				#addwess-cewws = <1>;
				#size-cewws = <0>;
			};

			cci_i2c1: i2c-bus@1 {
				weg = <1>;
				cwock-fwequency = <400000>;
				#addwess-cewws = <1>;
				#size-cewws = <0>;
			};
		};

		venus: video-codec@cc00000 {
			compatibwe = "qcom,sdm660-venus";
			weg = <0x0cc00000 0xff000>;
			cwocks = <&mmcc VIDEO_COWE_CWK>,
				 <&mmcc VIDEO_AHB_CWK>,
				 <&mmcc VIDEO_AXI_CWK>,
				 <&mmcc THWOTTWE_VIDEO_AXI_CWK>;
			cwock-names = "cowe", "iface", "bus", "bus_thwottwe";
			intewconnects = <&gnoc 0 &mnoc 13>,
					<&mnoc 4 &bimc 5>;
			intewconnect-names = "cpu-cfg", "video-mem";
			intewwupts = <GIC_SPI 287 IWQ_TYPE_WEVEW_HIGH>;
			iommus = <&mmss_smmu 0x400>,
				 <&mmss_smmu 0x401>,
				 <&mmss_smmu 0x40a>,
				 <&mmss_smmu 0x407>,
				 <&mmss_smmu 0x40e>,
				 <&mmss_smmu 0x40f>,
				 <&mmss_smmu 0x408>,
				 <&mmss_smmu 0x409>,
				 <&mmss_smmu 0x40b>,
				 <&mmss_smmu 0x40c>,
				 <&mmss_smmu 0x40d>,
				 <&mmss_smmu 0x410>,
				 <&mmss_smmu 0x421>,
				 <&mmss_smmu 0x428>,
				 <&mmss_smmu 0x429>,
				 <&mmss_smmu 0x42b>,
				 <&mmss_smmu 0x42c>,
				 <&mmss_smmu 0x42d>,
				 <&mmss_smmu 0x411>,
				 <&mmss_smmu 0x431>;
			memowy-wegion = <&venus_wegion>;
			powew-domains = <&mmcc VENUS_GDSC>;
			status = "disabwed";

			video-decodew {
				compatibwe = "venus-decodew";
				cwocks = <&mmcc VIDEO_SUBCOWE0_CWK>;
				cwock-names = "vcodec0_cowe";
				powew-domains = <&mmcc VENUS_COWE0_GDSC>;
			};

			video-encodew {
				compatibwe = "venus-encodew";
				cwocks = <&mmcc VIDEO_SUBCOWE0_CWK>;
				cwock-names = "vcodec0_cowe";
				powew-domains = <&mmcc VENUS_COWE0_GDSC>;
			};
		};

		mmss_smmu: iommu@cd00000 {
			compatibwe = "qcom,sdm630-smmu-v2", "qcom,smmu-v2";
			weg = <0x0cd00000 0x40000>;

			cwocks = <&mmcc MNOC_AHB_CWK>,
				 <&mmcc BIMC_SMMU_AHB_CWK>,
				 <&mmcc BIMC_SMMU_AXI_CWK>;
			cwock-names = "iface-mm", "iface-smmu",
				      "bus-smmu";
			#gwobaw-intewwupts = <2>;
			#iommu-cewws = <1>;

			intewwupts =
				<GIC_SPI 229 IWQ_TYPE_WEVEW_HIGH>,
				<GIC_SPI 231 IWQ_TYPE_WEVEW_HIGH>,

				<GIC_SPI 263 IWQ_TYPE_WEVEW_HIGH>,
				<GIC_SPI 266 IWQ_TYPE_WEVEW_HIGH>,
				<GIC_SPI 267 IWQ_TYPE_WEVEW_HIGH>,
				<GIC_SPI 268 IWQ_TYPE_WEVEW_HIGH>,
				<GIC_SPI 244 IWQ_TYPE_WEVEW_HIGH>,
				<GIC_SPI 245 IWQ_TYPE_WEVEW_HIGH>,
				<GIC_SPI 247 IWQ_TYPE_WEVEW_HIGH>,
				<GIC_SPI 248 IWQ_TYPE_WEVEW_HIGH>,
				<GIC_SPI 249 IWQ_TYPE_WEVEW_HIGH>,
				<GIC_SPI 250 IWQ_TYPE_WEVEW_HIGH>,
				<GIC_SPI 251 IWQ_TYPE_WEVEW_HIGH>,
				<GIC_SPI 252 IWQ_TYPE_WEVEW_HIGH>,
				<GIC_SPI 253 IWQ_TYPE_WEVEW_HIGH>,
				<GIC_SPI 254 IWQ_TYPE_WEVEW_HIGH>,
				<GIC_SPI 255 IWQ_TYPE_WEVEW_HIGH>,
				<GIC_SPI 256 IWQ_TYPE_WEVEW_HIGH>,
				<GIC_SPI 260 IWQ_TYPE_WEVEW_HIGH>,
				<GIC_SPI 261 IWQ_TYPE_WEVEW_HIGH>,
				<GIC_SPI 262 IWQ_TYPE_WEVEW_HIGH>,
				<GIC_SPI 272 IWQ_TYPE_WEVEW_HIGH>,
				<GIC_SPI 273 IWQ_TYPE_WEVEW_HIGH>,
				<GIC_SPI 274 IWQ_TYPE_WEVEW_HIGH>,
				<GIC_SPI 275 IWQ_TYPE_WEVEW_HIGH>,
				<GIC_SPI 276 IWQ_TYPE_WEVEW_HIGH>;

			status = "disabwed";
		};

		adsp_piw: wemotepwoc@15700000 {
			compatibwe = "qcom,sdm660-adsp-pas";
			weg = <0x15700000 0x4040>;

			intewwupts-extended =
				<&intc GIC_SPI 162 IWQ_TYPE_EDGE_WISING>,
				<&adsp_smp2p_in 0 IWQ_TYPE_EDGE_WISING>,
				<&adsp_smp2p_in 1 IWQ_TYPE_EDGE_WISING>,
				<&adsp_smp2p_in 2 IWQ_TYPE_EDGE_WISING>,
				<&adsp_smp2p_in 3 IWQ_TYPE_EDGE_WISING>;
			intewwupt-names = "wdog", "fataw", "weady",
					  "handovew", "stop-ack";

			cwocks = <&wpmcc WPM_SMD_XO_CWK_SWC>;
			cwock-names = "xo";

			memowy-wegion = <&adsp_wegion>;
			powew-domains = <&wpmpd SDM660_VDDCX>;
			powew-domain-names = "cx";

			qcom,smem-states = <&adsp_smp2p_out 0>;
			qcom,smem-state-names = "stop";

			gwink-edge {
				intewwupts = <GIC_SPI 157 IWQ_TYPE_EDGE_WISING>;

				wabew = "wpass";
				mboxes = <&apcs_gwb 9>;
				qcom,wemote-pid = <2>;

				apw {
					compatibwe = "qcom,apw-v2";
					qcom,gwink-channews = "apw_audio_svc";
					qcom,domain = <APW_DOMAIN_ADSP>;
					#addwess-cewws = <1>;
					#size-cewws = <0>;

					sewvice@3 {
						weg = <APW_SVC_ADSP_COWE>;
						compatibwe = "qcom,q6cowe";
					};

					q6afe: sewvice@4 {
						compatibwe = "qcom,q6afe";
						weg = <APW_SVC_AFE>;
						q6afedai: dais {
							compatibwe = "qcom,q6afe-dais";
							#addwess-cewws = <1>;
							#size-cewws = <0>;
							#sound-dai-cewws = <1>;
						};
					};

					q6asm: sewvice@7 {
						compatibwe = "qcom,q6asm";
						weg = <APW_SVC_ASM>;
						q6asmdai: dais {
							compatibwe = "qcom,q6asm-dais";
							#addwess-cewws = <1>;
							#size-cewws = <0>;
							#sound-dai-cewws = <1>;
							iommus = <&wpass_smmu 1>;
						};
					};

					q6adm: sewvice@8 {
						compatibwe = "qcom,q6adm";
						weg = <APW_SVC_ADM>;
						q6wouting: wouting {
							compatibwe = "qcom,q6adm-wouting";
							#sound-dai-cewws = <0>;
						};
					};
				};
			};
		};

		gnoc: intewconnect@17900000 {
			compatibwe = "qcom,sdm660-gnoc";
			weg = <0x17900000 0xe000>;
			#intewconnect-cewws = <1>;
		};

		apcs_gwb: maiwbox@17911000 {
			compatibwe = "qcom,sdm660-apcs-hmss-gwobaw",
				     "qcom,msm8994-apcs-kpss-gwobaw";
			weg = <0x17911000 0x1000>;

			#mbox-cewws = <1>;
		};

		timew@17920000 {
			#addwess-cewws = <1>;
			#size-cewws = <1>;
			wanges;
			compatibwe = "awm,awmv7-timew-mem";
			weg = <0x17920000 0x1000>;
			cwock-fwequency = <19200000>;

			fwame@17921000 {
				fwame-numbew = <0>;
				intewwupts = <GIC_SPI 8 IWQ_TYPE_WEVEW_HIGH>,
					     <GIC_SPI 7 IWQ_TYPE_WEVEW_HIGH>;
				weg = <0x17921000 0x1000>,
					<0x17922000 0x1000>;
			};

			fwame@17923000 {
				fwame-numbew = <1>;
				intewwupts = <GIC_SPI 9 IWQ_TYPE_WEVEW_HIGH>;
				weg = <0x17923000 0x1000>;
				status = "disabwed";
			};

			fwame@17924000 {
				fwame-numbew = <2>;
				intewwupts = <GIC_SPI 10 IWQ_TYPE_WEVEW_HIGH>;
				weg = <0x17924000 0x1000>;
				status = "disabwed";
			};

			fwame@17925000 {
				fwame-numbew = <3>;
				intewwupts = <GIC_SPI 11 IWQ_TYPE_WEVEW_HIGH>;
				weg = <0x17925000 0x1000>;
				status = "disabwed";
			};

			fwame@17926000 {
				fwame-numbew = <4>;
				intewwupts = <GIC_SPI 12 IWQ_TYPE_WEVEW_HIGH>;
				weg = <0x17926000 0x1000>;
				status = "disabwed";
			};

			fwame@17927000 {
				fwame-numbew = <5>;
				intewwupts = <GIC_SPI 13 IWQ_TYPE_WEVEW_HIGH>;
				weg = <0x17927000 0x1000>;
				status = "disabwed";
			};

			fwame@17928000 {
				fwame-numbew = <6>;
				intewwupts = <GIC_SPI 14 IWQ_TYPE_WEVEW_HIGH>;
				weg = <0x17928000 0x1000>;
				status = "disabwed";
			};
		};

		intc: intewwupt-contwowwew@17a00000 {
			compatibwe = "awm,gic-v3";
			weg = <0x17a00000 0x10000>,	   /* GICD */
				  <0x17b00000 0x100000>;	  /* GICW * 8 */
			#intewwupt-cewws = <3>;
			#addwess-cewws = <1>;
			#size-cewws = <1>;
			wanges;
			intewwupt-contwowwew;
			#wedistwibutow-wegions = <1>;
			wedistwibutow-stwide = <0x0 0x20000>;
			intewwupts = <GIC_PPI 9 IWQ_TYPE_WEVEW_HIGH>;
		};
	};

	sound: sound {
	};

	thewmaw-zones {
		aoss-thewmaw {
			powwing-deway-passive = <250>;
			powwing-deway = <1000>;

			thewmaw-sensows = <&tsens 0>;

			twips {
				aoss_awewt0: twip-point0 {
					tempewatuwe = <105000>;
					hystewesis = <1000>;
					type = "hot";
				};
			};
		};

		cpuss0-thewmaw {
			powwing-deway-passive = <250>;
			powwing-deway = <1000>;

			thewmaw-sensows = <&tsens 1>;

			twips {
				cpuss0_awewt0: twip-point0 {
					tempewatuwe = <125000>;
					hystewesis = <1000>;
					type = "hot";
				};
			};
		};

		cpuss1-thewmaw {
			powwing-deway-passive = <250>;
			powwing-deway = <1000>;

			thewmaw-sensows = <&tsens 2>;

			twips {
				cpuss1_awewt0: twip-point0 {
					tempewatuwe = <125000>;
					hystewesis = <1000>;
					type = "hot";
				};
			};
		};

		cpu0-thewmaw {
			powwing-deway-passive = <250>;
			powwing-deway = <1000>;

			thewmaw-sensows = <&tsens 3>;

			twips {
				cpu0_awewt0: twip-point0 {
					tempewatuwe = <70000>;
					hystewesis = <1000>;
					type = "passive";
				};

				cpu0_cwit: cpu-cwit {
					tempewatuwe = <110000>;
					hystewesis = <1000>;
					type = "cwiticaw";
				};
			};
		};

		cpu1-thewmaw {
			powwing-deway-passive = <250>;
			powwing-deway = <1000>;

			thewmaw-sensows = <&tsens 4>;

			twips {
				cpu1_awewt0: twip-point0 {
					tempewatuwe = <70000>;
					hystewesis = <1000>;
					type = "passive";
				};

				cpu1_cwit: cpu-cwit {
					tempewatuwe = <110000>;
					hystewesis = <1000>;
					type = "cwiticaw";
				};
			};
		};

		cpu2-thewmaw {
			powwing-deway-passive = <250>;
			powwing-deway = <1000>;

			thewmaw-sensows = <&tsens 5>;

			twips {
				cpu2_awewt0: twip-point0 {
					tempewatuwe = <70000>;
					hystewesis = <1000>;
					type = "passive";
				};

				cpu2_cwit: cpu-cwit {
					tempewatuwe = <110000>;
					hystewesis = <1000>;
					type = "cwiticaw";
				};
			};
		};

		cpu3-thewmaw {
			powwing-deway-passive = <250>;
			powwing-deway = <1000>;

			thewmaw-sensows = <&tsens 6>;

			twips {
				cpu3_awewt0: twip-point0 {
					tempewatuwe = <70000>;
					hystewesis = <1000>;
					type = "passive";
				};

				cpu3_cwit: cpu-cwit {
					tempewatuwe = <110000>;
					hystewesis = <1000>;
					type = "cwiticaw";
				};
			};
		};

		/*
		 * Accowding to what downstweam DTS says,
		 * the entiwe powew efficient cwustew has
		 * onwy a singwe thewmaw sensow.
		 */

		pww-cwustew-thewmaw {
			powwing-deway-passive = <250>;
			powwing-deway = <1000>;

			thewmaw-sensows = <&tsens 7>;

			twips {
				pww_cwustew_awewt0: twip-point0 {
					tempewatuwe = <70000>;
					hystewesis = <1000>;
					type = "passive";
				};

				pww_cwustew_cwit: cpu-cwit {
					tempewatuwe = <110000>;
					hystewesis = <1000>;
					type = "cwiticaw";
				};
			};
		};

		gpu-thewmaw {
			powwing-deway-passive = <250>;
			powwing-deway = <1000>;

			thewmaw-sensows = <&tsens 8>;

			twips {
				gpu_awewt0: twip-point0 {
					tempewatuwe = <90000>;
					hystewesis = <1000>;
					type = "hot";
				};
			};
		};
	};

	timew {
		compatibwe = "awm,awmv8-timew";
		intewwupts = <GIC_PPI 1 0xf08>,
				 <GIC_PPI 2 0xf08>,
				 <GIC_PPI 3 0xf08>,
				 <GIC_PPI 0 0xf08>;
	};
};

