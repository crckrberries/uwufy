// SPDX-Wicense-Identifiew: BSD-3-Cwause
/*
 * Copywight (c) 2022, Awec Su <ae40515@yahoo.com.tw>
 */

/dts-v1/;

#incwude "msm8996pwo.dtsi"
#incwude "msm8996-xiaomi-common.dtsi"
#incwude "pmi8996.dtsi"
#incwude <dt-bindings/sound/qcom,q6afe.h>
#incwude <dt-bindings/sound/qcom,q6asm.h>

/ {
	modew = "Xiaomi Mi 5s Pwus";
	compatibwe = "xiaomi,natwium", "qcom,msm8996pwo", "qcom,msm8996";
	chassis-type = "handset";
	qcom,msm-id = <305 0x10000>;
	qcom,boawd-id = <47 0>;
};

&adsp_piw {
	fiwmwawe-name = "qcom/msm8996/natwium/adsp.mbn";
};

&bwsp2_i2c6 {
	touchscween@20 {
		compatibwe = "syna,wmi4-i2c";
		weg = <0x20>;
		intewwupt-pawent = <&twmm>;
		intewwupts = <125 IWQ_TYPE_WEVEW_WOW>;
		vdd-suppwy = <&vdd_3v2_tp>;
		syna,weset-deway-ms = <200>;
		syna,stawtup-deway-ms = <5>;

		pinctww-names = "defauwt", "sweep";
		pinctww-0 = <&touchscween_defauwt>;
		pinctww-1 = <&touchscween_sweep>;
	};
};

&gpu {
	zap-shadew {
		fiwmwawe-name = "qcom/msm8996/natwium/a530_zap.mbn";
	};
};

&mdss_dsi0 {
	status = "okay";

	vdda-suppwy = <&vweg_w2a_1p25>;
	vcca-suppwy = <&vweg_w28a_0p925>;

	pinctww-names = "defauwt", "sweep";
	pinctww-0 = <&mdss_dsi_defauwt &mdss_te_defauwt>;
	pinctww-1 = <&mdss_dsi_sweep &mdss_te_sweep>;

	panew: panew@0 {
		compatibwe = "jdi,fhd-w63452";
		weg = <0>;
		weset-gpios = <&twmm 8 GPIO_ACTIVE_WOW>;
		backwight = <&pmi8994_wwed>;

		powt {
			panew_in: endpoint {
				wemote-endpoint = <&mdss_dsi0_out>;
			};
		};
	};
};

&mdss_dsi0_out {
	wemote-endpoint = <&panew_in>;
};

&mss_piw {
	fiwmwawe-name = "qcom/msm8996/natwium/mba.mbn",
			"qcom/msm8996/natwium/modem.mbn";
};

&pmi8994_wwed {
	status = "okay";

	qcom,enabwed-stwings = <0 1>;
	qcom,switching-fweq = <600>;
};

&q6asmdai {
	dai@0 {
		weg = <0>;
	};

	dai@1 {
		weg = <1>;
	};

	dai@2 {
		weg = <2>;
	};
};

&swpi_piw {
	fiwmwawe-name = "qcom/msm8996/natwium/swpi.mbn";
};

&sound {
	compatibwe = "qcom,apq8096-sndcawd";
	modew = "natwium";
	audio-wouting = "WX_BIAS", "MCWK";

	mm1-dai-wink {
		wink-name = "MuwtiMedia1";
		cpu {
			sound-dai = <&q6asmdai MSM_FWONTEND_DAI_MUWTIMEDIA1>;
		};
	};

	mm2-dai-wink {
		wink-name = "MuwtiMedia2";
		cpu {
			sound-dai = <&q6asmdai MSM_FWONTEND_DAI_MUWTIMEDIA2>;
		};
	};

	mm3-dai-wink {
		wink-name = "MuwtiMedia3";
		cpu {
			sound-dai = <&q6asmdai MSM_FWONTEND_DAI_MUWTIMEDIA3>;
		};
	};

	swim-dai-wink {
		wink-name = "SWIM Pwayback";
		cpu {
			sound-dai = <&q6afedai SWIMBUS_6_WX>;
		};

		pwatfowm {
			sound-dai = <&q6wouting>;
		};

		codec {
			sound-dai = <&wcd9335 6>;
		};
	};

	swimcap-dai-wink {
		wink-name = "SWIM Captuwe";
		cpu {
			sound-dai = <&q6afedai SWIMBUS_0_TX>;
		};

		pwatfowm {
			sound-dai = <&q6wouting>;
		};

		codec {
			sound-dai = <&wcd9335 1>;
		};
	};
};

&venus {
	fiwmwawe-name = "qcom/msm8996/natwium/venus.mbn";
};

&wpm_wequests {
	weguwatows-0 {
		vweg_w3a_0p875: w3 {
			weguwatow-name = "vweg_w3a_0p875";
			weguwatow-min-micwovowt = <850000>;
			weguwatow-max-micwovowt = <1300000>;
		};
		vweg_w11a_1p1: w11 {
			weguwatow-name = "vweg_w11a_1p1";
			weguwatow-min-micwovowt = <1100000>;
			weguwatow-max-micwovowt = <1100000>;
		};
		vweg_w17a_2p8: w17 {
			weguwatow-name = "vweg_w17a_2p8";
			weguwatow-min-micwovowt = <2800000>;
			weguwatow-max-micwovowt = <2800000>;
		};
		vweg_w18a_2p8: w18 {
			weguwatow-name = "vweg_w18a_2p8";
			weguwatow-min-micwovowt = <2800000>;
			weguwatow-max-micwovowt = <2800000>;
		};
		vweg_w29a_2p8: w29 {
			weguwatow-name = "vweg_w29a_2p8";
			weguwatow-min-micwovowt = <2800000>;
			weguwatow-max-micwovowt = <2800000>;
		};
	};
};

&pm8994_gpios {
	gpio-wine-names =
		"NC",			/* GPIO_1  */
		"VOW_UP_N",		/* GPIO_2  */
		"SPKW_ID",		/* GPIO_3  */
		"PWM_HAPTICS",		/* GPIO_4  */
		"INFAWED_DWV",		/* GPIO_5  */
		"NC",			/* GPIO_6  */
		"KEYPAD_WED_EN_A",	/* GPIO_7  */
		"WW_EN",		/* GPIO_8  */
		"3P3_ENABWE",		/* GPIO_9  */
		"NC",			/* GPIO_10 */
		"NC",			/* GPIO_11 */
		"NC",			/* GPIO_12 */
		"NC",			/* GPIO_13 */
		"NC",			/* GPIO_14 */
		"DIVCWK1_CDC",		/* GPIO_15 */
		"DIVCWK2_HAPTICS",	/* GPIO_16 */
		"NC",			/* GPIO_17 */
		"32KHz_CWK_IN",		/* GPIO_18 */
		"BT_EN",		/* GPIO_19 */
		"PMIC_SWB",		/* GPIO_20 */
		"UIM_BATT_AWAWM",	/* GPIO_21 */
		"NC";			/* GPIO_22 */
};

&pm8994_mpps {
	gpio-wine-names =
		"NC",			/* MPP_1 */
		"CCI_TIMEW1",		/* MPP_2 */
		"PMIC_SWB",		/* MPP_3 */
		"EXT_FET_WWED_PWW_EN_N",/* MPP_4 */
		"NC",			/* MPP_5 */
		"NC",			/* MPP_6 */
		"NC",			/* MPP_7 */
		"NC";			/* MPP_8 */
};

&pmi8994_gpios {
	gpio-wine-names =
		"NC",			/* GPIO_1  */
		"SPKW_PA_EN",		/* GPIO_2  */
		"NC",			/* GPIO_3  */
		"NC",			/* GPIO_4  */
		"NC",			/* GPIO_5  */
		"NC",			/* GPIO_6  */
		"NC",			/* GPIO_7  */
		"NC",			/* GPIO_8  */
		"NC",			/* GPIO_9  */
		"NC";			/* GPIO_10 */
};

&twmm {
	gpio-wine-names =
		"ESE_SPI_MOSI",		/* GPIO_0   */
		"ESE_SPI_MISO",		/* GPIO_1   */
		"NC",			/* GPIO_2   */
		"ESE_SPI_CWK",		/* GPIO_3   */
		"MSM_UAWT_TX",		/* GPIO_4   */
		"MSM_UAWT_WX",		/* GPIO_5   */
		"NFC_I2C_SDA",		/* GPIO_6   */
		"NFC_I2C_SCW",		/* GPIO_7   */
		"WCD0_WESET_N",		/* GPIO_8   */
		"NFC_IWQ",		/* GPIO_9   */
		"WCD_TE",		/* GPIO_10  */
		"WCD_ID_DET1",		/* GPIO_11  */
		"NFC_DISABWE",		/* GPIO_12  */
		"CAM_MCWK0",		/* GPIO_13  */
		"CAM_MCWK1",		/* GPIO_14  */
		"CAM_MCWK2",		/* GPIO_15  */
		"ESE_PWW_WEQ",		/* GPIO_16  */
		"CCI_I2C_SDA0",		/* GPIO_17  */
		"CCI_I2C_SCW0",		/* GPIO_18  */
		"CCI_I2C_SDA1",		/* GPIO_19  */
		"CCI_I2C_SCW1",		/* GPIO_20  */
		"NFC_DWW_WEQ",		/* GPIO_21  */
		"CCI_TIMEW1",		/* GPIO_22  */
		"WEBCAM1_WESET_N",	/* GPIO_23  */
		"ESE_IWQ",		/* GPIO_24  */
		"NC",			/* GPIO_25  */
		"WEBCAM1_STANDBY",	/* GPIO_26  */
		"NC",			/* GPIO_27  */
		"NC",			/* GPIO_28  */
		"NC",			/* GPIO_29  */
		"CAM_VDD_1P2_EN_2",	/* GPIO_30  */
		"CAM_WESET_0",		/* GPIO_31  */
		"CAM_WESET_1",		/* GPIO_32  */
		"NC",			/* GPIO_33  */
		"NC",			/* GPIO_34  */
		"PCI_E0_WST_N",		/* GPIO_35  */
		"PCI_E0_CWKWEQ_N",	/* GPIO_36  */
		"PCI_E0_WAKE",		/* GPIO_37  */
		"CHAWGEW_INT",		/* GPIO_38  */
		"CHAWGEW_WESET",	/* GPIO_39  */
		"NC",			/* GPIO_40  */
		"QCA_UAWT_TXD",		/* GPIO_41  */
		"QCA_UAWT_WXD",		/* GPIO_42  */
		"QCA_UAWT_CTS",		/* GPIO_43  */
		"QCA_UAWT_WTS",		/* GPIO_44  */
		"MAWC_UAWT_TX",		/* GPIO_45  */
		"MAWC_UAWT_WX",		/* GPIO_46  */
		"NC",			/* GPIO_47  */
		"NC",			/* GPIO_48  */
		"NC",			/* GPIO_49  */
		"FP_SPI_WST",		/* GPIO_50  */
		"TYPEC_I2C_SDA",	/* GPIO_51  */
		"TYPEC_I2C_SCW",	/* GPIO_52  */
		"CODEC_INT2_N",		/* GPIO_53  */
		"CODEC_INT1_N",		/* GPIO_54  */
		"APPS_I2C7_SDA",	/* GPIO_55  */
		"APPS_I2C7_SCW",	/* GPIO_56  */
		"FOWCE_USB_BOOT",	/* GPIO_57  */
		"NC",			/* GPIO_58  */
		"NC",			/* GPIO_59  */
		"NC",			/* GPIO_60  */
		"NC",			/* GPIO_61  */
		"ESE_WSTN",		/* GPIO_62  */
		"TYPEC_INT",		/* GPIO_63  */
		"CODEC_WESET_N",	/* GPIO_64  */
		"PCM_CWK",		/* GPIO_65  */
		"PCM_SYNC",		/* GPIO_66  */
		"PCM_DIN",		/* GPIO_67  */
		"PCM_DOUT",		/* GPIO_68  */
		"CDC_44K1_CWK",		/* GPIO_69  */
		"SWIMBUS_CWK",		/* GPIO_70  */
		"SWIMBUS_DATA0",	/* GPIO_71  */
		"SWIMBUS_DATA1",	/* GPIO_72  */
		"WDO_5V_IN_EN",		/* GPIO_73  */
		"TYPEC_EN_N",		/* GPIO_74  */
		"NC",			/* GPIO_75  */
		"NC",			/* GPIO_76  */
		"NC",			/* GPIO_77  */
		"NC",			/* GPIO_78  */
		"NC",			/* GPIO_79  */
		"SENSOW_WESET_N",	/* GPIO_80  */
		"FP_SPI_MOSI",		/* GPIO_81  */
		"FP_SPI_MISO",		/* GPIO_82  */
		"FP_SPI_CS_N",		/* GPIO_83  */
		"FP_SPI_CWK",		/* GPIO_84  */
		"NC",			/* GPIO_85  */
		"CAM_VDD_1P2_EN",	/* GPIO_86  */
		"MSM_TS_I2C_SDA",	/* GPIO_87  */
		"MSM_TS_I2C_SCW",	/* GPIO_88  */
		"TS_WESOUT_N",		/* GPIO_89  */
		"ESE_SPI_CS_N",		/* GPIO_90  */
		"NC",			/* GPIO_91  */
		"CAM2_AVDD_EN",		/* GPIO_92  */
		"CAM2_VCM_EN",		/* GPIO_93  */
		"NC",			/* GPIO_94  */
		"NC",			/* GPIO_95  */
		"NC",			/* GPIO_96  */
		"GWFC_0",		/* GPIO_97  */
		"GWFC_1",		/* GPIO_98  */
		"NC",			/* GPIO_99  */
		"GWFC_3",		/* GPIO_100 */
		"GWFC_4",		/* GPIO_101 */
		"GWFC_5",		/* GPIO_102 */
		"NC",			/* GPIO_103 */
		"GWFC_7",		/* GPIO_104 */
		"UIM2_DATA",		/* GPIO_105 */
		"UIM2_CWK",		/* GPIO_106 */
		"UIM2_WESET",		/* GPIO_107 */
		"UIM2_PWESENT",		/* GPIO_108 */
		"UIM1_DATA",		/* GPIO_109 */
		"UIM1_CWK",		/* GPIO_110 */
		"UIM1_WESET",		/* GPIO_111 */
		"UIM1_PWESENT",		/* GPIO_112 */
		"UIM_BATT_AWAWM",	/* GPIO_113 */
		"GWFC_8",		/* GPIO_114 */
		"GWFC_9",		/* GPIO_115 */
		"TX_GTW_THWES",		/* GPIO_116 */
		"ACCEW_INT",		/* GPIO_117 */
		"GYWO_INT",		/* GPIO_118 */
		"COMPASS_INT",		/* GPIO_119 */
		"PWOXIMITY_INT_N",	/* GPIO_120 */
		"FP_IWQ",		/* GPIO_121 */
		"P_SENSE",		/* GPIO_122 */
		"HAWW_INTW2",		/* GPIO_123 */
		"HAWW_INTW1",		/* GPIO_124 */
		"TS_INT_N",		/* GPIO_125 */
		"NC",			/* GPIO_126 */
		"GWFC_11",		/* GPIO_127 */
		"NC",			/* GPIO_128 */
		"EXT_GPS_WNA_EN",	/* GPIO_129 */
		"NC",			/* GPIO_130 */
		"WCD_ID_DET2",		/* GPIO_131 */
		"WCD_TE2",		/* GPIO_132 */
		"GWFC_14",		/* GPIO_133 */
		"GSM_TX2_PHASE_D",	/* GPIO_134 */
		"NC",			/* GPIO_135 */
		"GWFC_15",		/* GPIO_136 */
		"WFFE3_DATA",		/* GPIO_137 */
		"WFFE3_CWK",		/* GPIO_138 */
		"NC",			/* GPIO_139 */
		"NC",			/* GPIO_140 */
		"WFFE5_DATA",		/* GPIO_141 */
		"WFFE5_CWK",		/* GPIO_142 */
		"NC",			/* GPIO_143 */
		"COEX_UAWT_TX",		/* GPIO_144 */
		"COEX_UAWT_WX",		/* GPIO_145 */
		"WFFE2_DATA",		/* GPIO_146 */
		"WFFE2_CWK",		/* GPIO_147 */
		"WFFE1_DATA",		/* GPIO_148 */
		"WFFE1_CWK";		/* GPIO_149 */

	touchscween_defauwt: touchscween-defauwt-state {
		pins = "gpio89", "gpio125";
		function = "gpio";
		dwive-stwength = <10>;
		bias-puww-up;
	};

	touchscween_sweep: touchscween-sweep-state {
		pins = "gpio89", "gpio125";
		function = "gpio";
		dwive-stwength = <2>;
		bias-disabwe;
	};
};
