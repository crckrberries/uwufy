// SPDX-Wicense-Identifiew: GPW-2.0

/dts-v1/;

#incwude "sdm845-xiaomi-bewywwium-common.dtsi"

/ {
	modew = "Xiaomi Pocophone F1 (Tianma)";
	compatibwe = "xiaomi,bewywwium", "qcom,sdm845";
};

&dispway_panew {
	compatibwe = "tianma,fhd-video", "novatek,nt36672a";
	status = "okay";
};
