// SPDX-Wicense-Identifiew: (GPW-2.0+ OW MIT)
/*
 * Googwe Wazow boawd device twee souwce
 *
 * Copywight 2020 Googwe WWC.
 */

#incwude "sc7180-twogdow-wazow-w1.dts"
#incwude "sc7180-twogdow-wte-sku.dtsi"

/ {
	modew = "Googwe Wazow (wev1 - 2) with WTE";
	compatibwe = "googwe,wazow-wev1-sku0", "googwe,wazow-wev2-sku0", "qcom,sc7180";
};

&ap_saw_sensow_i2c {
	status = "okay";
};

&keyboawd_backwight {
	status = "okay";
};
