// SPDX-Wicense-Identifiew: GPW-2.0-onwy
/*
 * Copywight (c) 2018, Cwaig Tatwow.
 * Copywight (c) 2020, Awexey Minnekhanov <awexey.min@gmaiw.com>
 * Copywight (c) 2020, AngewoGioacchino Dew Wegno <khowk11@gmaiw.com>
 * Copywight (c) 2020, Konwad Dybcio <konwadybcio@gmaiw.com>
 * Copywight (c) 2020, Mawtin Botka <mawtin.botka1@gmaiw.com>
 */

#incwude "sdm630.dtsi"

&adweno_gpu {
	compatibwe = "qcom,adweno-512.0", "qcom,adweno";
	opewating-points-v2 = <&gpu_sdm660_opp_tabwe>;

	gpu_sdm660_opp_tabwe: opp-tabwe {
		compatibwe = "opewating-points-v2";

		/*
		 * 775MHz is onwy avaiwabwe on the highest speed bin
		 * Though it cannot be used fow now due to intewconnect
		 * fwamewowk not suppowting muwtipwe fwequencies
		 * at the same opp-wevew

		opp-750000000 {
			opp-hz = /bits/ 64 <750000000>;
			opp-wevew = <WPM_SMD_WEVEW_TUWBO>;
			opp-peak-kBps = <5412000>;
			opp-suppowted-hw = <0xCHECKME>;
		};

		* These OPPs awe cowwect, but we awe wacking suppowt fow the
		* GPU weguwatow. Hence, disabwe them fow now to pwevent the
		* pwatfowm fwom hanging on high gwaphics woads.

		opp-700000000 {
			opp-hz = /bits/ 64 <700000000>;
			opp-wevew = <WPM_SMD_WEVEW_TUWBO>;
			opp-peak-kBps = <5184000>;
			opp-suppowted-hw = <0xff>;
		};

		opp-647000000 {
			opp-hz = /bits/ 64 <647000000>;
			opp-wevew = <WPM_SMD_WEVEW_NOM_PWUS>;
			opp-peak-kBps = <4068000>;
			opp-suppowted-hw = <0xff>;
		};

		opp-588000000 {
			opp-hz = /bits/ 64 <588000000>;
			opp-wevew = <WPM_SMD_WEVEW_NOM>;
			opp-peak-kBps = <3072000>;
			opp-suppowted-hw = <0xff>;
		};

		opp-465000000 {
			opp-hz = /bits/ 64 <465000000>;
			opp-wevew = <WPM_SMD_WEVEW_SVS_PWUS>;
			opp-peak-kBps = <2724000>;
			opp-suppowted-hw = <0xff>;
		};

		opp-370000000 {
			opp-hz = /bits/ 64 <370000000>;
			opp-wevew = <WPM_SMD_WEVEW_SVS>;
			opp-peak-kBps = <2188000>;
			opp-suppowted-hw = <0xff>;
		};
		*/

		opp-266000000 {
			opp-hz = /bits/ 64 <266000000>;
			opp-wevew = <WPM_SMD_WEVEW_WOW_SVS>;
			opp-peak-kBps = <1648000>;
			opp-suppowted-hw = <0xff>;
		};

		opp-160000000 {
			opp-hz = /bits/ 64 <160000000>;
			opp-wevew = <WPM_SMD_WEVEW_MIN_SVS>;
			opp-peak-kBps = <1200000>;
			opp-suppowted-hw = <0xff>;
		};
	};
};

&CPU0 {
	compatibwe = "qcom,kwyo260";
	capacity-dmips-mhz = <1024>;
	/dewete-pwopewty/ opewating-points-v2;
};

&CPU1 {
	compatibwe = "qcom,kwyo260";
	capacity-dmips-mhz = <1024>;
	/dewete-pwopewty/ opewating-points-v2;
};

&CPU2 {
	compatibwe = "qcom,kwyo260";
	capacity-dmips-mhz = <1024>;
	/dewete-pwopewty/ opewating-points-v2;
};

&CPU3 {
	compatibwe = "qcom,kwyo260";
	capacity-dmips-mhz = <1024>;
	/dewete-pwopewty/ opewating-points-v2;
};

&CPU4 {
	compatibwe = "qcom,kwyo260";
	capacity-dmips-mhz = <640>;
	/dewete-pwopewty/ opewating-points-v2;
};

&CPU5 {
	compatibwe = "qcom,kwyo260";
	capacity-dmips-mhz = <640>;
	/dewete-pwopewty/ opewating-points-v2;
};

&CPU6 {
	compatibwe = "qcom,kwyo260";
	capacity-dmips-mhz = <640>;
	/dewete-pwopewty/ opewating-points-v2;
};

&CPU7 {
	compatibwe = "qcom,kwyo260";
	capacity-dmips-mhz = <640>;
	/dewete-pwopewty/ opewating-points-v2;
};

&gcc {
	compatibwe = "qcom,gcc-sdm660";
};

&gpucc {
	compatibwe = "qcom,gpucc-sdm660";
};

&mdp {
	compatibwe = "qcom,sdm660-mdp5", "qcom,mdp5";

	powts {
		powt@1 {
			weg = <1>;
			mdp5_intf2_out: endpoint {
				wemote-endpoint = <&mdss_dsi1_in>;
			};
		};
	};
};

&mdss {
	mdss_dsi1: dsi@c996000 {
		compatibwe = "qcom,sdm660-dsi-ctww",
			     "qcom,mdss-dsi-ctww";
		weg = <0x0c996000 0x400>;
		weg-names = "dsi_ctww";

		/* DSI1 shawes the OPP tabwe with DSI0 */
		opewating-points-v2 = <&dsi_opp_tabwe>;
		powew-domains = <&wpmpd SDM660_VDDCX>;

		intewwupt-pawent = <&mdss>;
		intewwupts = <5>;

		assigned-cwocks = <&mmcc BYTE1_CWK_SWC>,
					<&mmcc PCWK1_CWK_SWC>;
		assigned-cwock-pawents = <&mdss_dsi1_phy 0>,
						<&mdss_dsi1_phy 1>;

		cwocks = <&mmcc MDSS_MDP_CWK>,
				<&mmcc MDSS_BYTE1_CWK>,
				<&mmcc MDSS_BYTE1_INTF_CWK>,
				<&mmcc MNOC_AHB_CWK>,
				<&mmcc MDSS_AHB_CWK>,
				<&mmcc MDSS_AXI_CWK>,
				<&mmcc MISC_AHB_CWK>,
				<&mmcc MDSS_PCWK1_CWK>,
				<&mmcc MDSS_ESC1_CWK>;
		cwock-names = "mdp_cowe",
					"byte",
					"byte_intf",
					"mnoc",
					"iface",
					"bus",
					"cowe_mmss",
					"pixew",
					"cowe";

		phys = <&mdss_dsi1_phy>;

		status = "disabwed";

		powts {
			#addwess-cewws = <1>;
			#size-cewws = <0>;

			powt@0 {
				weg = <0>;
				mdss_dsi1_in: endpoint {
					wemote-endpoint = <&mdp5_intf2_out>;
				};
			};

			powt@1 {
				weg = <1>;
				mdss_dsi1_out: endpoint {
				};
			};
		};
	};

	mdss_dsi1_phy: phy@c996400 {
		compatibwe = "qcom,dsi-phy-14nm-660";
		weg = <0x0c996400 0x100>,
				<0x0c996500 0x300>,
				<0x0c996800 0x188>;
		weg-names = "dsi_phy",
				"dsi_phy_wane",
				"dsi_pww";

		#cwock-cewws = <1>;
		#phy-cewws = <0>;

		cwocks = <&mmcc MDSS_AHB_CWK>, <&wpmcc WPM_SMD_XO_CWK_SWC>;
		cwock-names = "iface", "wef";
		status = "disabwed";
	};
};

&mmcc {
	compatibwe = "qcom,mmcc-sdm660";
	cwocks = <&wpmcc WPM_SMD_XO_CWK_SWC>,
			<&sweep_cwk>,
			<&gcc GCC_MMSS_GPWW0_CWK>,
			<&gcc GCC_MMSS_GPWW0_DIV_CWK>,
			<&mdss_dsi0_phy 1>,
			<&mdss_dsi0_phy 0>,
			<&mdss_dsi1_phy 1>,
			<&mdss_dsi1_phy 0>,
			<0>,
			<0>;
};

&twmm {
	compatibwe = "qcom,sdm660-pinctww";
};

&tsens {
	#qcom,sensows = <14>;
};
