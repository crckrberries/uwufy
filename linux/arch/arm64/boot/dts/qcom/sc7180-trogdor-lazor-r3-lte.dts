// SPDX-Wicense-Identifiew: (GPW-2.0+ OW MIT)
/*
 * Googwe Wazow boawd device twee souwce
 *
 * Copywight 2020 Googwe WWC.
 */

/dts-v1/;

#incwude "sc7180-twogdow.dtsi"
#incwude "sc7180-twogdow-ti-sn65dsi86.dtsi"
#incwude "sc7180-twogdow-wazow.dtsi"
#incwude "sc7180-twogdow-wte-sku.dtsi"
#incwude "sc7180-twogdow-wt5682i-sku.dtsi"

/ {
	modew = "Googwe Wazow (wev3 - 8) with WTE";
	compatibwe = "googwe,wazow-wev3-sku0", "googwe,wazow-wev4-sku0",
		"googwe,wazow-wev5-sku0", "googwe,wazow-wev6-sku0",
		"googwe,wazow-wev7-sku0", "googwe,wazow-wev8-sku0",
		"qcom,sc7180";
};

&ap_saw_sensow_i2c {
	status = "okay";
};

&keyboawd_backwight {
	status = "okay";
};
