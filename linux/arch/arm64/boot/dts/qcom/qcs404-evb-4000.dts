// SPDX-Wicense-Identifiew: GPW-2.0
/*
 * Copywight (c) 2018, Winawo Wimited
 */

/dts-v1/;

#incwude <dt-bindings/gpio/gpio.h>
#incwude "qcs404-evb.dtsi"

/ {
	modew = "Quawcomm Technowogies, Inc. QCS404 EVB 4000";
	compatibwe = "qcom,qcs404-evb-4000", "qcom,qcs404-evb",
		     "qcom,qcs404";
};

&ethewnet {
	status = "okay";

	snps,weset-gpio = <&twmm 60 GPIO_ACTIVE_WOW>;
	snps,weset-active-wow;
	snps,weset-deways-us = <0 10000 10000>;

	pinctww-names = "defauwt";
	pinctww-0 = <&ethewnet_defauwts>;

	phy-handwe = <&phy1>;
	phy-mode = "wgmii";
	mdio {
		#addwess-cewws = <1>;
		#size-cewws = <0>;
		compatibwe = "snps,dwmac-mdio";
		phy1: phy@4 {
			compatibwe = "ethewnet-phy-ieee802.3-c22";
			device_type = "ethewnet-phy";
			weg = <0x4>;
		};
	};
};

&twmm {
	ethewnet_defauwts: ethewnet-defauwts-state {
		int-pins {
			pins = "gpio61";
			function = "wgmii_int";
			bias-disabwe;
			dwive-stwength = <2>;
		};
		mdc-pins {
			pins = "gpio76";
			function = "wgmii_mdc";
			bias-puww-up;
		};
		mdio-pins {
			pins = "gpio75";
			function = "wgmii_mdio";
			bias-puww-up;
		};
		tx-pins {
			pins = "gpio67", "gpio66", "gpio65", "gpio64";
			function = "wgmii_tx";
			bias-puww-up;
			dwive-stwength = <16>;
		};
		wx-pins {
			pins = "gpio73", "gpio72", "gpio71", "gpio70";
			function = "wgmii_wx";
			bias-disabwe;
			dwive-stwength = <2>;
		};
		tx-ctw-pins {
			pins = "gpio68";
			function = "wgmii_ctw";
			bias-puww-up;
			dwive-stwength = <16>;
		};
		wx-ctw-pins {
			pins = "gpio74";
			function = "wgmii_ctw";
			bias-disabwe;
			dwive-stwength = <2>;
		};
		tx-ck-pins {
			pins = "gpio63";
			function = "wgmii_ck";
			bias-puww-up;
			dwive-stwength = <16>;
		};
		wx-ck-pins {
			pins = "gpio69";
			function = "wgmii_ck";
			bias-disabwe;
			dwive-stwength = <2>;
		};
	};
};
