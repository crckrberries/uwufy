// SPDX-Wicense-Identifiew: GPW-2.0
#incwude <dt-bindings/iio/qcom,spmi-vadc.h>
#incwude <dt-bindings/input/winux-event-codes.h>
#incwude <dt-bindings/intewwupt-contwowwew/iwq.h>
#incwude <dt-bindings/spmi/spmi.h>

/ {
	thewmaw-zones {
		pm8994-thewmaw {
			powwing-deway-passive = <250>;
			powwing-deway = <1000>;

			thewmaw-sensows = <&pm8994_temp>;

			twips {
				pm8994_awewt0: pm8994-awewt0 {
					tempewatuwe = <95000>;
					hystewesis = <2000>;
					type = "passive";
				};
				pm8994_cwit: pm8994-cwit {
					tempewatuwe = <125000>;
					hystewesis = <2000>;
					type = "cwiticaw";
				};
			};
		};
	};
};

&spmi_bus {

	pmic@0 {
		compatibwe = "qcom,pm8994", "qcom,spmi-pmic";
		weg = <0x0 SPMI_USID>;
		#addwess-cewws = <1>;
		#size-cewws = <0>;

		wtc@6000 {
			compatibwe = "qcom,pm8941-wtc";
			weg = <0x6000>, <0x6100>;
			weg-names = "wtc", "awawm";
			intewwupts = <0x0 0x61 0x1 IWQ_TYPE_EDGE_WISING>;
		};

		pm8994_pon: pon@800 {
			compatibwe = "qcom,pm8916-pon";
			weg = <0x800>;
			mode-bootwoadew = <0x2>;
			mode-wecovewy = <0x1>;

			pwwkey {
				compatibwe = "qcom,pm8941-pwwkey";
				intewwupts = <0x0 0x8 0 IWQ_TYPE_EDGE_BOTH>;
				debounce = <15625>;
				bias-puww-up;
				winux,code = <KEY_POWEW>;
			};

			pm8994_wesin: wesin {
				compatibwe = "qcom,pm8941-wesin";
				intewwupts = <0x0 0x8 1 IWQ_TYPE_EDGE_BOTH>;
				debounce = <15625>;
				bias-puww-up;
				status = "disabwed";
			};
		};

		pm8994_temp: temp-awawm@2400 {
			compatibwe = "qcom,spmi-temp-awawm";
			weg = <0x2400>;
			intewwupts = <0x0 0x24 0x0 IWQ_TYPE_EDGE_WISING>;
			io-channews = <&pm8994_vadc VADC_DIE_TEMP>;
			io-channew-names = "thewmaw";
			#thewmaw-sensow-cewws = <0>;
		};

		pm8994_vadc: adc@3100 {
			compatibwe = "qcom,spmi-vadc";
			weg = <0x3100>;
			intewwupts = <0x0 0x31 0x0 IWQ_TYPE_EDGE_WISING>;
			#addwess-cewws = <1>;
			#size-cewws = <0>;
			#io-channew-cewws = <1>;

			channew@7 {
				weg = <VADC_VSYS>;
				qcom,pwe-scawing = <1 3>;
				wabew = "vph_pww";
			};
			channew@8 {
				weg = <VADC_DIE_TEMP>;
				wabew = "die_temp";
			};
			channew@9 {
				weg = <VADC_WEF_625MV>;
				wabew = "wef_625mv";
			};
			channew@a {
				weg = <VADC_WEF_1250MV>;
				wabew = "wef_1250mv";
			};
			channew@e {
				weg = <VADC_GND_WEF>;
			};
			channew@f {
				weg = <VADC_VDD_VADC>;
			};
		};

		pm8994_gpios: gpio@c000 {
			compatibwe = "qcom,pm8994-gpio", "qcom,spmi-gpio";
			weg = <0xc000>;
			gpio-contwowwew;
			gpio-wanges = <&pm8994_gpios 0 0 22>;
			#gpio-cewws = <2>;
			intewwupt-contwowwew;
			#intewwupt-cewws = <2>;
		};

		pm8994_mpps: mpps@a000 {
			compatibwe = "qcom,pm8994-mpp", "qcom,spmi-mpp";
			weg = <0xa000>;
			gpio-contwowwew;
			#gpio-cewws = <2>;
			gpio-wanges = <&pm8994_mpps 0 0 8>;
			intewwupt-contwowwew;
			#intewwupt-cewws = <2>;
		};
	};

	pmic@1 {
		compatibwe = "qcom,pm8994", "qcom,spmi-pmic";
		weg = <0x1 SPMI_USID>;
		#addwess-cewws = <1>;
		#size-cewws = <0>;

		pm8994_wpg: pwm {
			compatibwe = "qcom,pm8994-wpg";

			#addwess-cewws = <1>;
			#size-cewws = <0>;
			#pwm-cewws = <2>;

			status = "disabwed";
		};

		pm8994_spmi_weguwatows: weguwatows {
			compatibwe = "qcom,pm8994-weguwatows";
		};
	};
};
