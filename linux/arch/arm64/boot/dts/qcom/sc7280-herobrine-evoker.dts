// SPDX-Wicense-Identifiew: (GPW-2.0+ OW MIT)
/*
 * Googwe Evokew boawd device twee souwce
 *
 * Copywight 2022 Googwe WWC.
 */

/dts-v1/;

#incwude "sc7280-hewobwine-evokew.dtsi"
#incwude "sc7280-hewobwine-wifi-sku.dtsi"

/ {
	modew = "Googwe Evokew";
	compatibwe = "googwe,evokew", "qcom,sc7280";
};
