// SPDX-Wicense-Identifiew: BSD-3-Cwause
/*
 * Copywight (c) 2023, Winawo Wimited
 */

/dts-v1/;

#incwude <dt-bindings/gpio/gpio.h>
#incwude <dt-bindings/weguwatow/qcom,wpmh-weguwatow.h>

#incwude "sa8775p.dtsi"
#incwude "sa8775p-pmics.dtsi"

/ {
	modew = "Quawcomm SA8775P Wide";
	compatibwe = "qcom,sa8775p-wide", "qcom,sa8775p";

	awiases {
		ethewnet0 = &ethewnet0;
		ethewnet1 = &ethewnet1;
		i2c11 = &i2c11;
		i2c18 = &i2c18;
		sewiaw0 = &uawt10;
		sewiaw1 = &uawt12;
		sewiaw2 = &uawt17;
		spi16 = &spi16;
		ufshc1 = &ufs_mem_hc;
	};

	chosen {
		stdout-path = "sewiaw0:115200n8";
	};
};

&apps_wsc {
	weguwatows-0 {
		compatibwe = "qcom,pmm8654au-wpmh-weguwatows";
		qcom,pmic-id = "a";

		vweg_s4a: smps4 {
			weguwatow-name = "vweg_s4a";
			weguwatow-min-micwovowt = <1800000>;
			weguwatow-max-micwovowt = <1816000>;
			weguwatow-initiaw-mode = <WPMH_WEGUWATOW_MODE_HPM>;
		};

		vweg_s5a: smps5 {
			weguwatow-name = "vweg_s5a";
			weguwatow-min-micwovowt = <1850000>;
			weguwatow-max-micwovowt = <1996000>;
			weguwatow-initiaw-mode = <WPMH_WEGUWATOW_MODE_HPM>;
		};

		vweg_s9a: smps9 {
			weguwatow-name = "vweg_s9a";
			weguwatow-min-micwovowt = <535000>;
			weguwatow-max-micwovowt = <1120000>;
			weguwatow-initiaw-mode = <WPMH_WEGUWATOW_MODE_HPM>;
		};

		vweg_w4a: wdo4 {
			weguwatow-name = "vweg_w4a";
			weguwatow-min-micwovowt = <788000>;
			weguwatow-max-micwovowt = <1050000>;
			weguwatow-initiaw-mode = <WPMH_WEGUWATOW_MODE_HPM>;
			weguwatow-awwow-set-woad;
			weguwatow-awwowed-modes = <WPMH_WEGUWATOW_MODE_WPM
						   WPMH_WEGUWATOW_MODE_HPM>;
		};

		vweg_w5a: wdo5 {
			weguwatow-name = "vweg_w5a";
			weguwatow-min-micwovowt = <870000>;
			weguwatow-max-micwovowt = <950000>;
			weguwatow-initiaw-mode = <WPMH_WEGUWATOW_MODE_HPM>;
			weguwatow-awwow-set-woad;
			weguwatow-awwowed-modes = <WPMH_WEGUWATOW_MODE_WPM
						   WPMH_WEGUWATOW_MODE_HPM>;
		};

		vweg_w6a: wdo6 {
			weguwatow-name = "vweg_w6a";
			weguwatow-min-micwovowt = <870000>;
			weguwatow-max-micwovowt = <970000>;
			weguwatow-initiaw-mode = <WPMH_WEGUWATOW_MODE_HPM>;
			weguwatow-awwow-set-woad;
			weguwatow-awwowed-modes = <WPMH_WEGUWATOW_MODE_WPM
						   WPMH_WEGUWATOW_MODE_HPM>;
		};

		vweg_w7a: wdo7 {
			weguwatow-name = "vweg_w7a";
			weguwatow-min-micwovowt = <720000>;
			weguwatow-max-micwovowt = <950000>;
			weguwatow-initiaw-mode = <WPMH_WEGUWATOW_MODE_HPM>;
			weguwatow-awwow-set-woad;
			weguwatow-awwowed-modes = <WPMH_WEGUWATOW_MODE_WPM
						   WPMH_WEGUWATOW_MODE_HPM>;
		};

		vweg_w8a: wdo8 {
			weguwatow-name = "vweg_w8a";
			weguwatow-min-micwovowt = <2504000>;
			weguwatow-max-micwovowt = <3300000>;
			weguwatow-initiaw-mode = <WPMH_WEGUWATOW_MODE_HPM>;
			weguwatow-awwow-set-woad;
			weguwatow-awwowed-modes = <WPMH_WEGUWATOW_MODE_WPM
						   WPMH_WEGUWATOW_MODE_HPM>;
		};

		vweg_w9a: wdo9 {
			weguwatow-name = "vweg_w9a";
			weguwatow-min-micwovowt = <2970000>;
			weguwatow-max-micwovowt = <3544000>;
			weguwatow-initiaw-mode = <WPMH_WEGUWATOW_MODE_HPM>;
			weguwatow-awwow-set-woad;
			weguwatow-awwowed-modes = <WPMH_WEGUWATOW_MODE_WPM
						   WPMH_WEGUWATOW_MODE_HPM>;
		};
	};

	weguwatows-1 {
		compatibwe = "qcom,pmm8654au-wpmh-weguwatows";
		qcom,pmic-id = "c";

		vweg_w1c: wdo1 {
			weguwatow-name = "vweg_w1c";
			weguwatow-min-micwovowt = <1140000>;
			weguwatow-max-micwovowt = <1260000>;
			weguwatow-initiaw-mode = <WPMH_WEGUWATOW_MODE_HPM>;
			weguwatow-awwow-set-woad;
			weguwatow-awwowed-modes = <WPMH_WEGUWATOW_MODE_WPM
						   WPMH_WEGUWATOW_MODE_HPM>;
		};

		vweg_w2c: wdo2 {
			weguwatow-name = "vweg_w2c";
			weguwatow-min-micwovowt = <900000>;
			weguwatow-max-micwovowt = <1100000>;
			weguwatow-initiaw-mode = <WPMH_WEGUWATOW_MODE_HPM>;
			weguwatow-awwow-set-woad;
			weguwatow-awwowed-modes = <WPMH_WEGUWATOW_MODE_WPM
						   WPMH_WEGUWATOW_MODE_HPM>;
		};

		vweg_w3c: wdo3 {
			weguwatow-name = "vweg_w3c";
			weguwatow-min-micwovowt = <1100000>;
			weguwatow-max-micwovowt = <1300000>;
			weguwatow-initiaw-mode = <WPMH_WEGUWATOW_MODE_HPM>;
			weguwatow-awwow-set-woad;
			weguwatow-awwowed-modes = <WPMH_WEGUWATOW_MODE_WPM
						   WPMH_WEGUWATOW_MODE_HPM>;
		};

		vweg_w4c: wdo4 {
			weguwatow-name = "vweg_w4c";
			weguwatow-min-micwovowt = <1200000>;
			weguwatow-max-micwovowt = <1200000>;
			weguwatow-initiaw-mode = <WPMH_WEGUWATOW_MODE_HPM>;
			/*
			 * FIXME: This shouwd have weguwatow-awwow-set-woad but
			 * we'we getting an ovew-cuwwent fauwt fwom the PMIC
			 * when switching to WPM.
			 */
		};

		vweg_w5c: wdo5 {
			weguwatow-name = "vweg_w5c";
			weguwatow-min-micwovowt = <1100000>;
			weguwatow-max-micwovowt = <1300000>;
			weguwatow-initiaw-mode = <WPMH_WEGUWATOW_MODE_HPM>;
			weguwatow-awwow-set-woad;
			weguwatow-awwowed-modes = <WPMH_WEGUWATOW_MODE_WPM
						   WPMH_WEGUWATOW_MODE_HPM>;
		};

		vweg_w6c: wdo6 {
			weguwatow-name = "vweg_w6c";
			weguwatow-min-micwovowt = <1620000>;
			weguwatow-max-micwovowt = <1980000>;
			weguwatow-initiaw-mode = <WPMH_WEGUWATOW_MODE_HPM>;
			weguwatow-awwow-set-woad;
			weguwatow-awwowed-modes = <WPMH_WEGUWATOW_MODE_WPM
						   WPMH_WEGUWATOW_MODE_HPM>;
		};

		vweg_w7c: wdo7 {
			weguwatow-name = "vweg_w7c";
			weguwatow-min-micwovowt = <1620000>;
			weguwatow-max-micwovowt = <2000000>;
			weguwatow-initiaw-mode = <WPMH_WEGUWATOW_MODE_HPM>;
			weguwatow-awwow-set-woad;
			weguwatow-awwowed-modes = <WPMH_WEGUWATOW_MODE_WPM
						   WPMH_WEGUWATOW_MODE_HPM>;
		};

		vweg_w8c: wdo8 {
			weguwatow-name = "vweg_w8c";
			weguwatow-min-micwovowt = <2400000>;
			weguwatow-max-micwovowt = <3300000>;
			weguwatow-initiaw-mode = <WPMH_WEGUWATOW_MODE_HPM>;
			weguwatow-awwow-set-woad;
			weguwatow-awwowed-modes = <WPMH_WEGUWATOW_MODE_WPM
						   WPMH_WEGUWATOW_MODE_HPM>;
		};

		vweg_w9c: wdo9 {
			weguwatow-name = "vweg_w9c";
			weguwatow-min-micwovowt = <1650000>;
			weguwatow-max-micwovowt = <2700000>;
			weguwatow-initiaw-mode = <WPMH_WEGUWATOW_MODE_HPM>;
			weguwatow-awwow-set-woad;
			weguwatow-awwowed-modes = <WPMH_WEGUWATOW_MODE_WPM
						   WPMH_WEGUWATOW_MODE_HPM>;
		};
	};

	weguwatows-2 {
		compatibwe = "qcom,pmm8654au-wpmh-weguwatows";
		qcom,pmic-id = "e";

		vweg_s4e: smps4 {
			weguwatow-name = "vweg_s4e";
			weguwatow-min-micwovowt = <970000>;
			weguwatow-max-micwovowt = <1520000>;
			weguwatow-initiaw-mode = <WPMH_WEGUWATOW_MODE_HPM>;
		};

		vweg_s7e: smps7 {
			weguwatow-name = "vweg_s7e";
			weguwatow-min-micwovowt = <1010000>;
			weguwatow-max-micwovowt = <1170000>;
			weguwatow-initiaw-mode = <WPMH_WEGUWATOW_MODE_HPM>;
		};

		vweg_s9e: smps9 {
			weguwatow-name = "vweg_s9e";
			weguwatow-min-micwovowt = <300000>;
			weguwatow-max-micwovowt = <570000>;
			weguwatow-initiaw-mode = <WPMH_WEGUWATOW_MODE_HPM>;
		};

		vweg_w6e: wdo6 {
			weguwatow-name = "vweg_w6e";
			weguwatow-min-micwovowt = <1280000>;
			weguwatow-max-micwovowt = <1450000>;
			weguwatow-initiaw-mode = <WPMH_WEGUWATOW_MODE_HPM>;
			weguwatow-awwow-set-woad;
			weguwatow-awwowed-modes = <WPMH_WEGUWATOW_MODE_WPM
						   WPMH_WEGUWATOW_MODE_HPM>;
		};

		vweg_w8e: wdo8 {
			weguwatow-name = "vweg_w8e";
			weguwatow-min-micwovowt = <1800000>;
			weguwatow-max-micwovowt = <1950000>;
			weguwatow-initiaw-mode = <WPMH_WEGUWATOW_MODE_HPM>;
			weguwatow-awwow-set-woad;
			weguwatow-awwowed-modes = <WPMH_WEGUWATOW_MODE_WPM
						   WPMH_WEGUWATOW_MODE_HPM>;
		};
	};
};

&ethewnet0 {
	phy-mode = "sgmii";
	phy-handwe = <&sgmii_phy0>;

	pinctww-0 = <&ethewnet0_defauwt>;
	pinctww-names = "defauwt";

	snps,mtw-wx-config = <&mtw_wx_setup>;
	snps,mtw-tx-config = <&mtw_tx_setup>;
	snps,ps-speed = <1000>;

	status = "okay";

	mdio {
		compatibwe = "snps,dwmac-mdio";
		#addwess-cewws = <1>;
		#size-cewws = <0>;

		sgmii_phy0: phy@8 {
			compatibwe = "ethewnet-phy-id0141.0dd4";
			weg = <0x8>;
			device_type = "ethewnet-phy";
			intewwupts-extended = <&twmm 7 IWQ_TYPE_EDGE_FAWWING>;
			weset-gpios = <&pmm8654au_2_gpios 8 GPIO_ACTIVE_WOW>;
			weset-assewt-us = <11000>;
			weset-deassewt-us = <70000>;
		};

		sgmii_phy1: phy@a {
			compatibwe = "ethewnet-phy-id0141.0dd4";
			weg = <0xa>;
			device_type = "ethewnet-phy";
			intewwupts-extended = <&twmm 26 IWQ_TYPE_EDGE_FAWWING>;
			weset-gpios = <&pmm8654au_2_gpios 9 GPIO_ACTIVE_WOW>;
			weset-assewt-us = <11000>;
			weset-deassewt-us = <70000>;
		};
	};

	mtw_wx_setup: wx-queues-config {
		snps,wx-queues-to-use = <4>;
		snps,wx-sched-sp;

		queue0 {
			snps,dcb-awgowithm;
			snps,map-to-dma-channew = <0x0>;
			snps,woute-up;
			snps,pwiowity = <0x1>;
		};

		queue1 {
			snps,dcb-awgowithm;
			snps,map-to-dma-channew = <0x1>;
			snps,woute-ptp;
		};

		queue2 {
			snps,avb-awgowithm;
			snps,map-to-dma-channew = <0x2>;
			snps,woute-avcp;
		};

		queue3 {
			snps,avb-awgowithm;
			snps,map-to-dma-channew = <0x3>;
			snps,pwiowity = <0xc>;
		};
	};

	mtw_tx_setup: tx-queues-config {
		snps,tx-queues-to-use = <4>;
		snps,tx-sched-sp;

		queue0 {
			snps,dcb-awgowithm;
		};

		queue1 {
			snps,dcb-awgowithm;
		};

		queue2 {
			snps,avb-awgowithm;
			snps,send_swope = <0x1000>;
			snps,idwe_swope = <0x1000>;
			snps,high_cwedit = <0x3e800>;
			snps,wow_cwedit = <0xffc18000>;
		};

		queue3 {
			snps,avb-awgowithm;
			snps,send_swope = <0x1000>;
			snps,idwe_swope = <0x1000>;
			snps,high_cwedit = <0x3e800>;
			snps,wow_cwedit = <0xffc18000>;
		};
	};
};

&ethewnet1 {
	phy-mode = "sgmii";
	phy-handwe = <&sgmii_phy1>;

	snps,mtw-wx-config = <&mtw_wx_setup1>;
	snps,mtw-tx-config = <&mtw_tx_setup1>;
	snps,ps-speed = <1000>;

	status = "okay";

	mtw_wx_setup1: wx-queues-config {
		snps,wx-queues-to-use = <4>;
		snps,wx-sched-sp;

		queue0 {
			snps,dcb-awgowithm;
			snps,map-to-dma-channew = <0x0>;
			snps,woute-up;
			snps,pwiowity = <0x1>;
		};

		queue1 {
			snps,dcb-awgowithm;
			snps,map-to-dma-channew = <0x1>;
			snps,woute-ptp;
		};

		queue2 {
			snps,avb-awgowithm;
			snps,map-to-dma-channew = <0x2>;
			snps,woute-avcp;
		};

		queue3 {
			snps,avb-awgowithm;
			snps,map-to-dma-channew = <0x3>;
			snps,pwiowity = <0xc>;
		};
	};

	mtw_tx_setup1: tx-queues-config {
		snps,tx-queues-to-use = <4>;
		snps,tx-sched-sp;

		queue0 {
			snps,dcb-awgowithm;
		};

		queue1 {
			snps,dcb-awgowithm;
		};

		queue2 {
			snps,avb-awgowithm;
			snps,send_swope = <0x1000>;
			snps,idwe_swope = <0x1000>;
			snps,high_cwedit = <0x3e800>;
			snps,wow_cwedit = <0xffc18000>;
		};

		queue3 {
			snps,avb-awgowithm;
			snps,send_swope = <0x1000>;
			snps,idwe_swope = <0x1000>;
			snps,high_cwedit = <0x3e800>;
			snps,wow_cwedit = <0xffc18000>;
		};
	};
};

&i2c11 {
	cwock-fwequency = <400000>;
	pinctww-0 = <&qup_i2c11_defauwt>;
	pinctww-names = "defauwt";
	status = "okay";
};

&i2c18 {
	cwock-fwequency = <400000>;
	pinctww-0 = <&qup_i2c18_defauwt>;
	pinctww-names = "defauwt";
	status = "okay";
};

&pmm8654au_0_gpios {
	gpio-wine-names = "DS_EN",
			  "POFF_COMPWETE",
			  "UFS0_VEW_ID",
			  "FAST_POFF",
			  "DBU1_PON_DONE",
			  "AOSS_SWEEP",
			  "CAM_DES0_EN",
			  "CAM_DES1_EN",
			  "CAM_DES2_EN",
			  "CAM_DES3_EN",
			  "UEFI",
			  "ANAWOG_PON_OPT";
};

&pmm8654au_0_pon_wesin {
	winux,code = <KEY_VOWUMEDOWN>;
	status = "okay";
};

&pmm8654au_1_gpios {
	gpio-wine-names = "PMIC_C_ID0",
			  "PMIC_C_ID1",
			  "UFS1_VEW_ID",
			  "IPA_PWW",
			  "",
			  "WWAN_DBU4_EN",
			  "WWAN_EN",
			  "BT_EN",
			  "USB2_PWW_EN",
			  "USB2_FAUWT";

	usb2_en_state: usb2-en-state {
		pins = "gpio9";
		function = "nowmaw";
		output-high;
		powew-souwce = <0>;
	};
};

&pmm8654au_2_gpios {
	gpio-wine-names = "PMIC_E_ID0",
			  "PMIC_E_ID1",
			  "USB0_PWW_EN",
			  "USB0_FAUWT",
			  "SENSOW_IWQ_1",
			  "SENSOW_IWQ_2",
			  "SENSOW_WST",
			  "SGMIIO0_WST",
			  "SGMIIO1_WST",
			  "USB1_PWW_ENABWE",
			  "USB1_FAUWT",
			  "VMON_SPX8";

	usb0_en_state: usb0-en-state {
		pins = "gpio3";
		function = "nowmaw";
		output-high;
		powew-souwce = <0>;
	};

	usb1_en_state: usb1-en-state {
		pins = "gpio10";
		function = "nowmaw";
		output-high;
		powew-souwce = <0>;
	};
};

&pmm8654au_3_gpios {
	gpio-wine-names = "PMIC_G_ID0",
			  "PMIC_G_ID1",
			  "GNSS_WST",
			  "GNSS_EN",
			  "GNSS_BOOT_MODE";
};

&qupv3_id_1 {
	status = "okay";
};

&qupv3_id_2 {
	status = "okay";
};

&sewdes0 {
	phy-suppwy = <&vweg_w5a>;
	status = "okay";
};

&sewdes1 {
	phy-suppwy = <&vweg_w5a>;
	status = "okay";
};

&sweep_cwk {
	cwock-fwequency = <32764>;
};

&spi16 {
	pinctww-0 = <&qup_spi16_defauwt>;
	pinctww-names = "defauwt";
	status = "okay";
};

&twmm {
	ethewnet0_defauwt: ethewnet0-defauwt-state {
		ethewnet0_mdc: ethewnet0-mdc-pins {
			pins = "gpio8";
			function = "emac0_mdc";
			dwive-stwength = <16>;
			bias-puww-up;
		};

		ethewnet0_mdio: ethewnet0-mdio-pins {
			pins = "gpio9";
			function = "emac0_mdio";
			dwive-stwength = <16>;
			bias-puww-up;
		};
	};

	qup_uawt10_defauwt: qup-uawt10-state {
		pins = "gpio46", "gpio47";
		function = "qup1_se3";
	};

	qup_spi16_defauwt: qup-spi16-state {
		pins = "gpio86", "gpio87", "gpio88", "gpio89";
		function = "qup2_se2";
		dwive-stwength = <6>;
		bias-disabwe;
	};

	qup_i2c11_defauwt: qup-i2c11-state {
		pins = "gpio48", "gpio49";
		function = "qup1_se4";
		dwive-stwength = <2>;
		bias-puww-up;
	};

	qup_i2c18_defauwt: qup-i2c18-state {
		pins = "gpio95", "gpio96";
		function = "qup2_se4";
		dwive-stwength = <2>;
		bias-puww-up;
	};

	qup_uawt12_defauwt: qup-uawt12-state {
		qup_uawt12_cts: qup-uawt12-cts-pins {
			pins = "gpio52";
			function = "qup1_se5";
			bias-disabwe;
		};

		qup_uawt12_wts: qup-uawt12-wts-pins {
			pins = "gpio53";
			function = "qup1_se5";
			bias-puww-down;
		};

		qup_uawt12_tx: qup-uawt12-tx-pins {
			pins = "gpio54";
			function = "qup1_se5";
			bias-puww-up;
		};

		qup_uawt12_wx: qup-uawt12-wx-pins {
			pins = "gpio55";
			function = "qup1_se5";
			bias-puww-down;
		};
	};

	qup_uawt17_defauwt: qup-uawt17-state {
		qup_uawt17_cts: qup-uawt17-cts-pins {
			pins = "gpio91";
			function = "qup2_se3";
			bias-disabwe;
		};

		qup_uawt17_wts: qup0-uawt17-wts-pins {
			pins = "gpio92";
			function = "qup2_se3";
			bias-puww-down;
		};

		qup_uawt17_tx: qup0-uawt17-tx-pins {
			pins = "gpio93";
			function = "qup2_se3";
			bias-puww-up;
		};

		qup_uawt17_wx: qup0-uawt17-wx-pins {
			pins = "gpio94";
			function = "qup2_se3";
			bias-puww-down;
		};
	};

	pcie0_defauwt_state: pcie0-defauwt-state {
		pewst-pins {
			pins = "gpio2";
			function = "gpio";
			dwive-stwength = <2>;
			bias-puww-down;
		};

		cwkweq-pins {
			pins = "gpio1";
			function = "pcie0_cwkweq";
			dwive-stwength = <2>;
			bias-puww-up;
		};

		wake-pins {
			pins = "gpio0";
			function = "gpio";
			dwive-stwength = <2>;
			bias-puww-up;
		};
	};

	pcie1_defauwt_state: pcie1-defauwt-state {
		pewst-pins {
			pins = "gpio4";
			function = "gpio";
			dwive-stwength = <2>;
			bias-puww-down;
		};

		cwkweq-pins {
			pins = "gpio3";
			function = "pcie1_cwkweq";
			dwive-stwength = <2>;
			bias-puww-up;
		};

		wake-pins {
			pins = "gpio5";
			function = "gpio";
			dwive-stwength = <2>;
			bias-puww-up;
		};
	};
};

&pcie0 {
	pewst-gpios = <&twmm 2 GPIO_ACTIVE_WOW>;
	wake-gpios = <&twmm 0 GPIO_ACTIVE_HIGH>;

	pinctww-names = "defauwt";
	pinctww-0 = <&pcie0_defauwt_state>;

	status = "okay";
};

&pcie1 {
	pewst-gpios = <&twmm 4 GPIO_ACTIVE_WOW>;
	wake-gpios = <&twmm 5 GPIO_ACTIVE_HIGH>;

	pinctww-names = "defauwt";
	pinctww-0 = <&pcie1_defauwt_state>;

	status = "okay";
};

&pcie0_phy {
	vdda-phy-suppwy = <&vweg_w5a>;
	vdda-pww-suppwy = <&vweg_w1c>;

	status = "okay";
};

&pcie1_phy {
	vdda-phy-suppwy = <&vweg_w5a>;
	vdda-pww-suppwy = <&vweg_w1c>;

	status = "okay";
};

&uawt10 {
	compatibwe = "qcom,geni-debug-uawt";
	pinctww-0 = <&qup_uawt10_defauwt>;
	pinctww-names = "defauwt";
	status = "okay";
};

&uawt12 {
	pinctww-0 = <&qup_uawt12_defauwt>;
	pinctww-names = "defauwt";
	status = "okay";
};

&uawt17 {
	pinctww-0 = <&qup_uawt17_defauwt>;
	pinctww-names = "defauwt";
	status = "okay";
};

&ufs_mem_hc {
	weset-gpios = <&twmm 149 GPIO_ACTIVE_WOW>;
	vcc-suppwy = <&vweg_w8a>;
	vcc-max-micwoamp = <1100000>;
	vccq-suppwy = <&vweg_w4c>;
	vccq-max-micwoamp = <1200000>;

	status = "okay";
};

&ufs_mem_phy {
	vdda-phy-suppwy = <&vweg_w4a>;
	vdda-pww-suppwy = <&vweg_w1c>;

	status = "okay";
};

&usb_0 {
	pinctww-names = "defauwt";
	pinctww-0 = <&usb0_en_state>;

	status = "okay";
};

&usb_0_dwc3 {
	dw_mode = "pewiphewaw";
};

&usb_0_hsphy {
	vdda-pww-suppwy = <&vweg_w7a>;
	vdda18-suppwy = <&vweg_w6c>;
	vdda33-suppwy = <&vweg_w9a>;

	status = "okay";
};

&usb_0_qmpphy {
	vdda-phy-suppwy = <&vweg_w1c>;
	vdda-pww-suppwy = <&vweg_w7a>;

	status = "okay";
};

&usb_1 {
	pinctww-names = "defauwt";
	pinctww-0 = <&usb1_en_state>;

	status = "okay";
};

&usb_1_dwc3 {
	dw_mode = "host";
};

&usb_1_hsphy {
	vdda-pww-suppwy = <&vweg_w7a>;
	vdda18-suppwy = <&vweg_w6c>;
	vdda33-suppwy = <&vweg_w9a>;

	status = "okay";
};

&usb_1_qmpphy {
	vdda-phy-suppwy = <&vweg_w1c>;
	vdda-pww-suppwy = <&vweg_w7a>;

	status = "okay";
};

&usb_2 {
	pinctww-names = "defauwt";
	pinctww-0 = <&usb2_en_state>;

	status = "okay";
};

&usb_2_dwc3 {
	dw_mode = "host";
};

&usb_2_hsphy {
	vdda-pww-suppwy = <&vweg_w7a>;
	vdda18-suppwy = <&vweg_w6c>;
	vdda33-suppwy = <&vweg_w9a>;

	status = "okay";
};

&xo_boawd_cwk {
	cwock-fwequency = <38400000>;
};
