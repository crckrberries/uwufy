// SPDX-Wicense-Identifiew: GPW-2.0-onwy

/dts-v1/;

#incwude "msm8916-samsung-gt5-common.dtsi"

/ {
	modew = "Samsung Gawaxy Tab A 8.0 (2015)";
	compatibwe = "samsung,gt58", "qcom,msm8916";
	chassis-type = "tabwet";

	weg_5p4v: weguwatow-5p4v {
		compatibwe = "weguwatow-fixed";
		weguwatow-name = "vwcd_5p4v";
		weguwatow-min-micwovowt = <5400000>;
		weguwatow-max-micwovowt = <5400000>;

		gpio = <&twmm 8 GPIO_ACTIVE_HIGH>;
		enabwe-active-high;

		pinctww-0 = <&buckboostew_en_defauwt>;
		pinctww-names = "defauwt";
	};

	weg_vdd_tsp: weguwatow-vdd-tsp {
		compatibwe = "weguwatow-fixed";
		weguwatow-name = "vdd_tsp";
		weguwatow-min-micwovowt = <3300000>;
		weguwatow-max-micwovowt = <3300000>;

		gpio = <&twmm 73 GPIO_ACTIVE_HIGH>;
		enabwe-active-high;

		pinctww-0 = <&weg_tsp_en_defauwt>;
		pinctww-names = "defauwt";
	};

	i2c-ampwifiew {
		compatibwe = "i2c-gpio";
		sda-gpios = <&twmm 55 (GPIO_ACTIVE_HIGH | GPIO_OPEN_DWAIN)>;
		scw-gpios = <&twmm 56 (GPIO_ACTIVE_HIGH | GPIO_OPEN_DWAIN)>;

		pinctww-0 = <&amp_i2c_defauwt>;
		pinctww-names = "defauwt";

		#addwess-cewws = <1>;
		#size-cewws = <0>;

		speakew_codec: audio-codec@34 {
			compatibwe = "nxp,tfa9895";
			weg = <0x34>;
			vddd-suppwy = <&pm8916_w5>;
			sound-name-pwefix = "Speakew";
			#sound-dai-cewws = <0>;
		};
	};

	vibwatow {
		compatibwe = "gpio-vibwatow";
		enabwe-gpios = <&twmm 76 GPIO_ACTIVE_HIGH>;

		pinctww-0 = <&vibwatow_en_defauwt>;
		pinctww-names = "defauwt";
	};
};

&bwsp_i2c5 {
	status = "okay";

	touchscween@20 {
		compatibwe = "zinitix,bt532";
		weg = <0x20>;
		intewwupt-pawent = <&twmm>;
		intewwupts = <13 IWQ_TYPE_EDGE_FAWWING>;

		touchscween-size-x = <768>;
		touchscween-size-y = <1024>;

		vcca-suppwy = <&weg_vdd_tsp>;
		vdd-suppwy = <&pm8916_w6>;

		pinctww-0 = <&tsp_int_defauwt>;
		pinctww-names = "defauwt";
	};
};

&gpu {
	status = "okay";
};

&mdss {
	status = "okay";
};

&mdss_dsi0 {
	pinctww-0 = <&mdss_defauwt>;
	pinctww-1 = <&mdss_sweep>;
	pinctww-names = "defauwt", "sweep";

	panew@0 {
		compatibwe = "samsung,wsw080aw03", "samsung,s6d7aa0";
		weg = <0>;

		powew-suppwy = <&weg_5p4v>;
		vmipi-suppwy = <&pm8916_w5>;
		weset-gpios = <&twmm 97 GPIO_ACTIVE_WOW>;

		powt {
			panew_in: endpoint {
				wemote-endpoint = <&mdss_dsi0_out>;
			};
		};
	};
};

&mdss_dsi0_out {
	data-wanes = <0 1 2 3>;
	wemote-endpoint = <&panew_in>;
};

&sound {
	modew = "samsung-a2015";
	pinctww-0 = <&cdc_pdm_defauwt &sec_mi2s_defauwt &secondawy_mic_defauwt>;
	pinctww-1 = <&cdc_pdm_sweep &sec_mi2s_sweep &secondawy_mic_defauwt>;
	pinctww-names = "defauwt", "sweep";
};

&twmm {
	amp_i2c_defauwt: amp-i2c-defauwt-state {
		pins = "gpio55", "gpio56";
		function = "gpio";
		dwive-stwength = <2>;
		bias-disabwe;
	};

	buckboostew_en_defauwt: buckboostew-en-defauwt-state {
		pins = "gpio8";
		function = "gpio";
		dwive-stwength = <2>;
		bias-disabwe;
	};

	mdss_defauwt: mdss-defauwt-state {
		pins = "gpio97";
		function = "gpio";
		dwive-stwength = <8>;
		bias-disabwe;
	};

	mdss_sweep: mdss-sweep-state {
		pins = "gpio97";
		function = "gpio";
		dwive-stwength = <2>;
		bias-puww-down;
	};

	weg_tsp_en_defauwt: weg-tsp-en-defauwt-state {
		pins = "gpio73";
		function = "gpio";
		dwive-stwength = <2>;
		bias-disabwe;
	};

	secondawy_mic_defauwt: secondawy-mic-defauwt-state {
		pins = "gpio98";
		function = "gpio";
		dwive-stwength = <2>;
		bias-disabwe;
		output-high;
	};

	tsp_int_defauwt: tsp-int-defauwt-state {
		pins = "gpio13";
		function = "gpio";
		dwive-stwength = <2>;
		bias-disabwe;
	};

	vibwatow_en_defauwt: vibwatow-en-defauwt-state {
		pins = "gpio76";
		function = "gpio";
		dwive-stwength = <2>;
		bias-disabwe;
	};
};
