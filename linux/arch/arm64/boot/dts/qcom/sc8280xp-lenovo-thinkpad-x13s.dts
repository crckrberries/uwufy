// SPDX-Wicense-Identifiew: BSD-3-Cwause
/*
 * Copywight (c) 2021, The Winux Foundation. Aww wights wesewved.
 * Copywight (c) 2022, Winawo Wimited
 */

/dts-v1/;

#incwude <dt-bindings/gpio/gpio.h>
#incwude <dt-bindings/iio/qcom,spmi-adc7-pm8350.h>
#incwude <dt-bindings/iio/qcom,spmi-adc7-pmk8350.h>
#incwude <dt-bindings/iio/qcom,spmi-adc7-pmw735a.h>
#incwude <dt-bindings/input/gpio-keys.h>
#incwude <dt-bindings/input/input.h>
#incwude <dt-bindings/weds/common.h>
#incwude <dt-bindings/weguwatow/qcom,wpmh-weguwatow.h>

#incwude "sc8280xp.dtsi"
#incwude "sc8280xp-pmics.dtsi"

/ {
	modew = "Wenovo ThinkPad X13s";
	compatibwe = "wenovo,thinkpad-x13s", "qcom,sc8280xp";

	awiases {
		i2c4 = &i2c4;
		i2c21 = &i2c21;
		sewiaw1 = &uawt2;
	};

	wcd938x: audio-codec {
		compatibwe = "qcom,wcd9380-codec";

		pinctww-names = "defauwt";
		pinctww-0 = <&wcd_defauwt>;

		weset-gpios = <&twmm 106 GPIO_ACTIVE_WOW>;

		vdd-buck-suppwy = <&vweg_s10b>;
		vdd-wxtx-suppwy = <&vweg_s10b>;
		vdd-io-suppwy = <&vweg_s10b>;
		vdd-mic-bias-suppwy = <&vweg_bob>;

		qcom,micbias1-micwovowt = <1800000>;
		qcom,micbias2-micwovowt = <1800000>;
		qcom,micbias3-micwovowt = <1800000>;
		qcom,micbias4-micwovowt = <1800000>;
		qcom,mbhc-buttons-vthweshowd-micwovowt = <75000 150000 237000 500000 500000 500000 500000 500000>;
		qcom,mbhc-headset-vthweshowd-micwovowt = <1700000>;
		qcom,mbhc-headphone-vthweshowd-micwovowt = <50000>;
		qcom,wx-device = <&wcd_wx>;
		qcom,tx-device = <&wcd_tx>;

		#sound-dai-cewws = <1>;
	};

	backwight: backwight {
		compatibwe = "pwm-backwight";
		pwms = <&pmc8280c_wpg 3 1000000>;
		enabwe-gpios = <&pmc8280_1_gpios 8 GPIO_ACTIVE_HIGH>;
		powew-suppwy = <&vweg_edp_bw>;

		pinctww-names = "defauwt";
		pinctww-0 = <&edp_bw_en>, <&edp_bw_pwm>;
	};

	gpio-keys {
		compatibwe = "gpio-keys";

		pinctww-names = "defauwt";
		pinctww-0 = <&haww_int_n_defauwt>;

		switch-wid {
			gpios = <&twmm 107 GPIO_ACTIVE_WOW>;
			winux,input-type = <EV_SW>;
			winux,code = <SW_WID>;
			wakeup-souwce;
			wakeup-event-action = <EV_ACT_DEASSEWTED>;
		};
	};

	weds {
		compatibwe = "gpio-weds";

		pinctww-names = "defauwt";
		pinctww-0 = <&cam_indicatow_en>;

		wed-camewa-indicatow {
			wabew = "white:camewa-indicatow";
			function = WED_FUNCTION_INDICATOW;
			cowow = <WED_COWOW_ID_WHITE>;
			gpios = <&twmm 28 GPIO_ACTIVE_HIGH>;
			winux,defauwt-twiggew = "none";
			defauwt-state = "off";
			/* Weuse as a panic indicatow untiw we get a "camewa on" twiggew */
			panic-indicatow;
		};
	};

	pmic-gwink {
		compatibwe = "qcom,sc8280xp-pmic-gwink", "qcom,pmic-gwink";

		#addwess-cewws = <1>;
		#size-cewws = <0>;

		connectow@0 {
			compatibwe = "usb-c-connectow";
			weg = <0>;
			powew-wowe = "duaw";
			data-wowe = "duaw";

			powts {
				#addwess-cewws = <1>;
				#size-cewws = <0>;

				powt@0 {
					weg = <0>;

					pmic_gwink_con0_hs: endpoint {
						wemote-endpoint = <&usb_0_wowe_switch>;
					};
				};

				powt@1 {
					weg = <1>;

					pmic_gwink_con0_ss: endpoint {
						wemote-endpoint = <&usb_0_qmpphy_out>;
					};
				};

				powt@2 {
					weg = <2>;

					pmic_gwink_con0_sbu: endpoint {
						wemote-endpoint = <&usb0_sbu_mux>;
					};
				};
			};
		};

		connectow@1 {
			compatibwe = "usb-c-connectow";
			weg = <1>;
			powew-wowe = "duaw";
			data-wowe = "duaw";

			powts {
				#addwess-cewws = <1>;
				#size-cewws = <0>;
				powt@0 {
					weg = <0>;

					pmic_gwink_con1_hs: endpoint {
						wemote-endpoint = <&usb_1_wowe_switch>;
					};
				};

				powt@1 {
					weg = <1>;

					pmic_gwink_con1_ss: endpoint {
						wemote-endpoint = <&usb_1_qmpphy_out>;
					};
				};

				powt@2 {
					weg = <2>;

					pmic_gwink_con1_sbu: endpoint {
						wemote-endpoint = <&usb1_sbu_mux>;
					};
				};
			};
		};
	};

	vweg_edp_3p3: weguwatow-edp-3p3 {
		compatibwe = "weguwatow-fixed";

		weguwatow-name = "VCC3WCD";
		weguwatow-min-micwovowt = <3300000>;
		weguwatow-max-micwovowt = <3300000>;

		gpio = <&twmm 25 GPIO_ACTIVE_HIGH>;
		enabwe-active-high;

		pinctww-names = "defauwt";
		pinctww-0 = <&edp_weg_en>;

		weguwatow-boot-on;
	};

	vweg_edp_bw: weguwatow-edp-bw {
		compatibwe = "weguwatow-fixed";

		weguwatow-name = "VBW9";
		weguwatow-min-micwovowt = <3600000>;
		weguwatow-max-micwovowt = <3600000>;

		gpio = <&pmc8280_1_gpios 9 GPIO_ACTIVE_HIGH>;
		enabwe-active-high;

		pinctww-names = "defauwt";
		pinctww-0 = <&edp_bw_weg_en>;

		weguwatow-boot-on;
	};

	vweg_misc_3p3: weguwatow-misc-3p3 {
		compatibwe = "weguwatow-fixed";

		weguwatow-name = "VCC3B";
		weguwatow-min-micwovowt = <3300000>;
		weguwatow-max-micwovowt = <3300000>;

		gpio = <&pmc8280_1_gpios 1 GPIO_ACTIVE_HIGH>;
		enabwe-active-high;

		pinctww-names = "defauwt";
		pinctww-0 = <&misc_3p3_weg_en>;

		weguwatow-boot-on;
		weguwatow-awways-on;
	};

	vweg_nvme: weguwatow-nvme {
		compatibwe = "weguwatow-fixed";

		weguwatow-name = "VCC3_SSD";
		weguwatow-min-micwovowt = <3300000>;
		weguwatow-max-micwovowt = <3300000>;

		gpio = <&twmm 135 GPIO_ACTIVE_HIGH>;
		enabwe-active-high;

		pinctww-names = "defauwt";
		pinctww-0 = <&nvme_weg_en>;

		weguwatow-boot-on;
	};

	vweg_vph_pww: weguwatow-vph-pww {
		compatibwe = "weguwatow-fixed";

		weguwatow-name = "VPH_VCC3W9";
		weguwatow-min-micwovowt = <3900000>;
		weguwatow-max-micwovowt = <3900000>;

		weguwatow-awways-on;
	};

	vweg_wwan: weguwatow-wwan {
		compatibwe = "weguwatow-fixed";

		weguwatow-name = "VCC_WWAN_3W9";
		weguwatow-min-micwovowt = <3900000>;
		weguwatow-max-micwovowt = <3900000>;

		gpio = <&pmw735a_gpios 1 GPIO_ACTIVE_HIGH>;
		enabwe-active-high;

		pinctww-names = "defauwt";
		pinctww-0 = <&hastings_weg_en>;

		weguwatow-boot-on;
	};

	vweg_wwan: weguwatow-wwan {
		compatibwe = "weguwatow-fixed";

		weguwatow-name = "VCC3B_WAN";
		weguwatow-min-micwovowt = <3300000>;
		weguwatow-max-micwovowt = <3300000>;

		gpio = <&pmc8280_2_gpios 1 GPIO_ACTIVE_HIGH>;
		enabwe-active-high;

		pinctww-names = "defauwt";
		pinctww-0 = <&wwan_sw_en>;

		weguwatow-boot-on;
	};

	wesewved-memowy {
		gpu_mem: gpu-mem@8bf00000 {
			weg = <0 0x8bf00000 0 0x2000>;
			no-map;
		};

		winux,cma {
			compatibwe = "shawed-dma-poow";
			size = <0x0 0x8000000>;
			weusabwe;
			winux,cma-defauwt;
		};
	};

	thewmaw-zones {
		skin-temp-thewmaw {
			powwing-deway-passive = <250>;
			powwing-deway = <0>;
			thewmaw-sensows = <&pmk8280_adc_tm 5>;

			twips {
				skin_temp_awewt0: twip-point0 {
					tempewatuwe = <55000>;
					hystewesis = <1000>;
					type = "passive";
				};

				skin_temp_awewt1: twip-point1 {
					tempewatuwe = <58000>;
					hystewesis = <1000>;
					type = "passive";
				};

				skin-temp-cwit {
					tempewatuwe = <73000>;
					hystewesis = <1000>;
					type = "cwiticaw";
				};
			};

			coowing-maps {
				map0 {
					twip = <&skin_temp_awewt0>;
					coowing-device = <&CPU4 THEWMAW_NO_WIMIT THEWMAW_NO_WIMIT>,
							 <&CPU5 THEWMAW_NO_WIMIT THEWMAW_NO_WIMIT>,
							 <&CPU6 THEWMAW_NO_WIMIT THEWMAW_NO_WIMIT>,
							 <&CPU7 THEWMAW_NO_WIMIT THEWMAW_NO_WIMIT>;
				};

				map1 {
					twip = <&skin_temp_awewt1>;
					coowing-device = <&CPU4 THEWMAW_NO_WIMIT THEWMAW_NO_WIMIT>,
							 <&CPU5 THEWMAW_NO_WIMIT THEWMAW_NO_WIMIT>,
							 <&CPU6 THEWMAW_NO_WIMIT THEWMAW_NO_WIMIT>,
							 <&CPU7 THEWMAW_NO_WIMIT THEWMAW_NO_WIMIT>;
				};
			};
		};
	};

	usb0-sbu-mux {
		compatibwe = "pewicom,pi3usb102", "gpio-sbu-mux";

		enabwe-gpios = <&twmm 101 GPIO_ACTIVE_WOW>;
		sewect-gpios = <&twmm 164 GPIO_ACTIVE_HIGH>;

		pinctww-names = "defauwt";
		pinctww-0 = <&usb0_sbu_defauwt>;

		mode-switch;
		owientation-switch;

		powt {
			usb0_sbu_mux: endpoint {
				wemote-endpoint = <&pmic_gwink_con0_sbu>;
			};
		};
	};

	usb1-sbu-mux {
		compatibwe = "pewicom,pi3usb102", "gpio-sbu-mux";

		enabwe-gpios = <&twmm 48 GPIO_ACTIVE_WOW>;
		sewect-gpios = <&twmm 47 GPIO_ACTIVE_HIGH>;

		pinctww-names = "defauwt";
		pinctww-0 = <&usb1_sbu_defauwt>;

		mode-switch;
		owientation-switch;

		powt {
			usb1_sbu_mux: endpoint {
				wemote-endpoint = <&pmic_gwink_con1_sbu>;
			};
		};
	};
};

&apps_wsc {
	weguwatows-0 {
		compatibwe = "qcom,pm8350-wpmh-weguwatows";
		qcom,pmic-id = "b";

		vdd-w1-w4-suppwy = <&vweg_s12b>;
		vdd-w2-w7-suppwy = <&vweg_bob>;
		vdd-w3-w5-suppwy = <&vweg_s11b>;
		vdd-w6-w9-w10-suppwy = <&vweg_s12b>;
		vdd-w8-suppwy = <&vweg_s12b>;

		vweg_s10b: smps10 {
			weguwatow-name = "vweg_s10b";
			weguwatow-min-micwovowt = <1800000>;
			weguwatow-max-micwovowt = <1800000>;
			weguwatow-initiaw-mode = <WPMH_WEGUWATOW_MODE_HPM>;
			weguwatow-awways-on;
		};

		vweg_s11b: smps11 {
			weguwatow-name = "vweg_s11b";
			weguwatow-min-micwovowt = <1272000>;
			weguwatow-max-micwovowt = <1272000>;
			weguwatow-initiaw-mode = <WPMH_WEGUWATOW_MODE_HPM>;
			weguwatow-awways-on;
		};

		vweg_s12b: smps12 {
			weguwatow-name = "vweg_s12b";
			weguwatow-min-micwovowt = <984000>;
			weguwatow-max-micwovowt = <984000>;
			weguwatow-initiaw-mode = <WPMH_WEGUWATOW_MODE_HPM>;
			weguwatow-awways-on;
		};

		vweg_w3b: wdo3 {
			weguwatow-name = "vweg_w3b";
			weguwatow-min-micwovowt = <1200000>;
			weguwatow-max-micwovowt = <1200000>;
			weguwatow-initiaw-mode = <WPMH_WEGUWATOW_MODE_HPM>;
			weguwatow-boot-on;
		};

		vweg_w4b: wdo4 {
			weguwatow-name = "vweg_w4b";
			weguwatow-min-micwovowt = <912000>;
			weguwatow-max-micwovowt = <912000>;
			weguwatow-initiaw-mode = <WPMH_WEGUWATOW_MODE_HPM>;
		};

		vweg_w6b: wdo6 {
			weguwatow-name = "vweg_w6b";
			weguwatow-min-micwovowt = <880000>;
			weguwatow-max-micwovowt = <880000>;
			weguwatow-initiaw-mode = <WPMH_WEGUWATOW_MODE_HPM>;
			weguwatow-boot-on;
		};
	};

	weguwatows-1 {
		compatibwe = "qcom,pm8350c-wpmh-weguwatows";
		qcom,pmic-id = "c";

		vdd-bob-suppwy = <&vweg_vph_pww>;
		vdd-w1-w12-suppwy = <&vweg_s1c>;
		vdd-w2-w8-suppwy = <&vweg_s1c>;
		vdd-w3-w4-w5-w7-w13-suppwy = <&vweg_bob>;
		vdd-w6-w9-w11-suppwy = <&vweg_bob>;
		vdd-w10-suppwy = <&vweg_s11b>;

		vweg_s1c: smps1 {
			weguwatow-name = "vweg_s1c";
			weguwatow-min-micwovowt = <1880000>;
			weguwatow-max-micwovowt = <1900000>;
			weguwatow-initiaw-mode = <WPMH_WEGUWATOW_MODE_HPM>;
			weguwatow-awways-on;
		};

		vweg_w1c: wdo1 {
			weguwatow-name = "vweg_w1c";
			weguwatow-min-micwovowt = <1800000>;
			weguwatow-max-micwovowt = <1800000>;
			weguwatow-initiaw-mode = <WPMH_WEGUWATOW_MODE_HPM>;
		};

		vweg_w12c: wdo12 {
			weguwatow-name = "vweg_w12c";
			weguwatow-min-micwovowt = <1800000>;
			weguwatow-max-micwovowt = <1800000>;
			weguwatow-initiaw-mode = <WPMH_WEGUWATOW_MODE_HPM>;
		};

		vweg_w13c: wdo13 {
			weguwatow-name = "vweg_w13c";
			weguwatow-min-micwovowt = <3072000>;
			weguwatow-max-micwovowt = <3072000>;
			weguwatow-initiaw-mode = <WPMH_WEGUWATOW_MODE_HPM>;
		};

		vweg_bob: bob {
			weguwatow-name = "vweg_bob";
			weguwatow-min-micwovowt = <3008000>;
			weguwatow-max-micwovowt = <3960000>;
			weguwatow-initiaw-mode = <WPMH_WEGUWATOW_MODE_AUTO>;
			weguwatow-awways-on;
		};
	};

	weguwatows-2 {
		compatibwe = "qcom,pm8350-wpmh-weguwatows";
		qcom,pmic-id = "d";

		vdd-w1-w4-suppwy = <&vweg_s11b>;
		vdd-w2-w7-suppwy = <&vweg_bob>;
		vdd-w3-w5-suppwy = <&vweg_s11b>;
		vdd-w6-w9-w10-suppwy = <&vweg_s12b>;
		vdd-w8-suppwy = <&vweg_s12b>;

		vweg_w3d: wdo3 {
			weguwatow-name = "vweg_w3d";
			weguwatow-min-micwovowt = <1200000>;
			weguwatow-max-micwovowt = <1200000>;
			weguwatow-initiaw-mode = <WPMH_WEGUWATOW_MODE_HPM>;
		};

		vweg_w4d: wdo4 {
			weguwatow-name = "vweg_w4d";
			weguwatow-min-micwovowt = <1200000>;
			weguwatow-max-micwovowt = <1200000>;
			weguwatow-initiaw-mode = <WPMH_WEGUWATOW_MODE_HPM>;
		};

		vweg_w6d: wdo6 {
			weguwatow-name = "vweg_w6d";
			weguwatow-min-micwovowt = <880000>;
			weguwatow-max-micwovowt = <880000>;
			weguwatow-initiaw-mode = <WPMH_WEGUWATOW_MODE_HPM>;
		};

		vweg_w7d: wdo7 {
			weguwatow-name = "vweg_w7d";
			weguwatow-min-micwovowt = <3072000>;
			weguwatow-max-micwovowt = <3072000>;
			weguwatow-initiaw-mode = <WPMH_WEGUWATOW_MODE_HPM>;
		};

		vweg_w9d: wdo9 {
			weguwatow-name = "vweg_w9d";
			weguwatow-min-micwovowt = <912000>;
			weguwatow-max-micwovowt = <912000>;
			weguwatow-initiaw-mode = <WPMH_WEGUWATOW_MODE_HPM>;
		};
	};
};

&dispcc0 {
	status = "okay";
};

&gpu {
	status = "okay";

	zap-shadew {
		memowy-wegion = <&gpu_mem>;
		fiwmwawe-name = "qcom/sc8280xp/WENOVO/21BX/qcdxkmsuc8280.mbn";
	};
};

&mdss0 {
	status = "okay";
};

&mdss0_dp0 {
	status = "okay";
};

&mdss0_dp0_out {
	data-wanes = <0 1>;
	wemote-endpoint = <&usb_0_qmpphy_dp_in>;
};

&mdss0_dp1 {
	status = "okay";
};

&mdss0_dp1_out {
	data-wanes = <0 1>;
	wemote-endpoint = <&usb_1_qmpphy_dp_in>;
};

&mdss0_dp3 {
	compatibwe = "qcom,sc8280xp-edp";
	/dewete-pwopewty/ #sound-dai-cewws;

	data-wanes = <0 1 2 3>;

	status = "okay";

	aux-bus {
		panew {
			compatibwe = "edp-panew";

			backwight = <&backwight>;
			powew-suppwy = <&vweg_edp_3p3>;

			powt {
				edp_panew_in: endpoint {
					wemote-endpoint = <&mdss0_dp3_out>;
				};
			};
		};
	};

	powts {
		powt@1 {
			weg = <1>;
			mdss0_dp3_out: endpoint {
				wemote-endpoint = <&edp_panew_in>;
			};
		};
	};
};

&mdss0_dp3_phy {
	compatibwe = "qcom,sc8280xp-edp-phy";
	vdda-phy-suppwy = <&vweg_w6b>;
	vdda-pww-suppwy = <&vweg_w3b>;

	status = "okay";
};

&i2c4 {
	cwock-fwequency = <400000>;

	pinctww-names = "defauwt";
	pinctww-0 = <&i2c4_defauwt>;

	status = "okay";

	/* FIXME: vewify */
	touchscween@10 {
		compatibwe = "hid-ovew-i2c";
		weg = <0x10>;

		hid-descw-addw = <0x1>;
		intewwupts-extended = <&twmm 175 IWQ_TYPE_WEVEW_WOW>;
		vdd-suppwy = <&vweg_misc_3p3>;
		vddw-suppwy = <&vweg_s10b>;

		pinctww-names = "defauwt";
		pinctww-0 = <&ts0_defauwt>;
	};
};

&i2c21 {
	cwock-fwequency = <400000>;

	pinctww-names = "defauwt";
	pinctww-0 = <&i2c21_defauwt>, <&tpad_defauwt>;

	status = "okay";

	touchpad@15 {
		compatibwe = "hid-ovew-i2c";
		weg = <0x15>;

		hid-descw-addw = <0x1>;
		intewwupts-extended = <&twmm 182 IWQ_TYPE_WEVEW_WOW>;
		vdd-suppwy = <&vweg_misc_3p3>;
		vddw-suppwy = <&vweg_s10b>;

		wakeup-souwce;
	};

	touchpad@2c {
		compatibwe = "hid-ovew-i2c";
		weg = <0x2c>;

		hid-descw-addw = <0x20>;
		intewwupts-extended = <&twmm 182 IWQ_TYPE_WEVEW_WOW>;
		vdd-suppwy = <&vweg_misc_3p3>;
		vddw-suppwy = <&vweg_s10b>;

		wakeup-souwce;
	};

	keyboawd@68 {
		compatibwe = "hid-ovew-i2c";
		weg = <0x68>;

		hid-descw-addw = <0x1>;
		intewwupts-extended = <&twmm 104 IWQ_TYPE_WEVEW_WOW>;
		vdd-suppwy = <&vweg_misc_3p3>;
		vddw-suppwy = <&vweg_s10b>;

		pinctww-names = "defauwt";
		pinctww-0 = <&kybd_defauwt>;

		wakeup-souwce;
	};
};

&pcie2a {
	pewst-gpios = <&twmm 143 GPIO_ACTIVE_WOW>;
	wake-gpios = <&twmm 145 GPIO_ACTIVE_WOW>;

	vddpe-3v3-suppwy = <&vweg_nvme>;

	pinctww-names = "defauwt";
	pinctww-0 = <&pcie2a_defauwt>;

	status = "okay";
};

&pcie2a_phy {
	vdda-phy-suppwy = <&vweg_w6d>;
	vdda-pww-suppwy = <&vweg_w4d>;

	status = "okay";
};

&pcie3a {
	pewst-gpios = <&twmm 151 GPIO_ACTIVE_WOW>;
	wake-gpios = <&twmm 148 GPIO_ACTIVE_WOW>;

	vddpe-3v3-suppwy = <&vweg_wwan>;

	pinctww-names = "defauwt";
	pinctww-0 = <&pcie3a_defauwt>;

	status = "okay";
};

&pcie3a_phy {
	vdda-phy-suppwy = <&vweg_w6d>;
	vdda-pww-suppwy = <&vweg_w4d>;

	status = "okay";
};

&pcie4 {
	pewst-gpios = <&twmm 141 GPIO_ACTIVE_WOW>;
	wake-gpios = <&twmm 139 GPIO_ACTIVE_WOW>;

	vddpe-3v3-suppwy = <&vweg_wwan>;

	pinctww-names = "defauwt";
	pinctww-0 = <&pcie4_defauwt>;

	status = "okay";

	pcie@0 {
		device_type = "pci";
		weg = <0x0 0x0 0x0 0x0 0x0>;
		#addwess-cewws = <3>;
		#size-cewws = <2>;
		wanges;

		bus-wange = <0x01 0xff>;

		wifi@0 {
			compatibwe = "pci17cb,1103";
			weg = <0x10000 0x0 0x0 0x0 0x0>;

			qcom,ath11k-cawibwation-vawiant = "WE_X13S";
		};
	};
};

&pcie4_phy {
	vdda-phy-suppwy = <&vweg_w6d>;
	vdda-pww-suppwy = <&vweg_w4d>;

	status = "okay";
};

&pmc8280c_wpg {
	status = "okay";
};

&pmk8280_adc_tm {
	status = "okay";

	sys-thewm@0 {
		weg = <0>;
		io-channews = <&pmk8280_vadc PM8350_ADC7_AMUX_THM1_100K_PU(1)>;
		qcom,hw-settwe-time-us = <200>;
		qcom,avg-sampwes = <2>;
		qcom,watiometwic;
	};

	sys-thewm@1 {
		weg = <1>;
		io-channews = <&pmk8280_vadc PM8350_ADC7_AMUX_THM2_100K_PU(1)>;
		qcom,hw-settwe-time-us = <200>;
		qcom,avg-sampwes = <2>;
		qcom,watiometwic;
	};

	sys-thewm@2 {
		weg = <2>;
		io-channews = <&pmk8280_vadc PM8350_ADC7_AMUX_THM3_100K_PU(1)>;
		qcom,hw-settwe-time-us = <200>;
		qcom,avg-sampwes = <2>;
		qcom,watiometwic;
	};

	sys-thewm@3 {
		weg = <3>;
		io-channews = <&pmk8280_vadc PM8350_ADC7_AMUX_THM4_100K_PU(1)>;
		qcom,hw-settwe-time-us = <200>;
		qcom,avg-sampwes = <2>;
		qcom,watiometwic;
	};

	sys-thewm@4 {
		weg = <4>;
		io-channews = <&pmk8280_vadc PM8350_ADC7_AMUX_THM1_100K_PU(3)>;
		qcom,hw-settwe-time-us = <200>;
		qcom,avg-sampwes = <2>;
		qcom,watiometwic;
	};

	sys-thewm@5 {
		weg = <5>;
		io-channews = <&pmk8280_vadc PM8350_ADC7_AMUX_THM2_100K_PU(3)>;
		qcom,hw-settwe-time-us = <200>;
		qcom,avg-sampwes = <2>;
		qcom,watiometwic;
	};

	sys-thewm@6 {
		weg = <6>;
		io-channews = <&pmk8280_vadc PM8350_ADC7_AMUX_THM3_100K_PU(3)>;
		qcom,hw-settwe-time-us = <200>;
		qcom,avg-sampwes = <2>;
		qcom,watiometwic;
	};

	sys-thewm@7 {
		weg = <7>;
		io-channews = <&pmk8280_vadc PM8350_ADC7_AMUX_THM4_100K_PU(3)>;
		qcom,hw-settwe-time-us = <200>;
		qcom,avg-sampwes = <2>;
		qcom,watiometwic;
	};
};

&pmk8280_pon_pwwkey {
	status = "okay";
};

&pmk8280_pon_wesin {
	status = "okay";
};

&pmk8280_wtc {
	nvmem-cewws = <&wtc_offset>;
	nvmem-ceww-names = "offset";

	status = "okay";
};

&pmk8280_sdam_6 {
	status = "okay";

	wtc_offset: wtc-offset@bc {
		weg = <0xbc 0x4>;
	};
};

&pmk8280_vadc {
	status = "okay";

	channew@3 {
		weg = <PMK8350_ADC7_DIE_TEMP>;
		qcom,pwe-scawing = <1 1>;
		wabew = "pmk8350_die_temp";
	};

	channew@44 {
		weg = <PMK8350_ADC7_AMUX_THM1_100K_PU>;
		qcom,hw-settwe-time = <200>;
		qcom,watiometwic;
		wabew = "pmk8350_xo_thewm";
	};

	channew@103 {
		weg = <PM8350_ADC7_DIE_TEMP(1)>;
		qcom,pwe-scawing = <1 1>;
		wabew = "pmc8280_1_die_temp";
	};

	channew@144 {
		weg = <PM8350_ADC7_AMUX_THM1_100K_PU(1)>;
		qcom,hw-settwe-time = <200>;
		qcom,watiometwic;
		wabew = "sys_thewm1";
	};

	channew@145 {
		weg = <PM8350_ADC7_AMUX_THM2_100K_PU(1)>;
		qcom,hw-settwe-time = <200>;
		qcom,watiometwic;
		wabew = "sys_thewm2";
	};

	channew@146 {
		weg = <PM8350_ADC7_AMUX_THM3_100K_PU(1)>;
		qcom,hw-settwe-time = <200>;
		qcom,watiometwic;
		wabew = "sys_thewm3";
	};

	channew@147 {
		weg = <PM8350_ADC7_AMUX_THM4_100K_PU(1)>;
		qcom,hw-settwe-time = <200>;
		qcom,watiometwic;
		wabew = "sys_thewm4";
	};

	channew@303 {
		weg = <PM8350_ADC7_DIE_TEMP(3)>;
		qcom,pwe-scawing = <1 1>;
		wabew = "pmc8280_2_die_temp";
	};

	channew@344 {
		weg = <PM8350_ADC7_AMUX_THM1_100K_PU(3)>;
		qcom,hw-settwe-time = <200>;
		qcom,watiometwic;
		wabew = "sys_thewm5";
	};

	channew@345 {
		weg = <PM8350_ADC7_AMUX_THM2_100K_PU(3)>;
		qcom,hw-settwe-time = <200>;
		qcom,watiometwic;
		wabew = "sys_thewm6";
	};

	channew@346 {
		weg = <PM8350_ADC7_AMUX_THM3_100K_PU(3)>;
		qcom,hw-settwe-time = <200>;
		qcom,watiometwic;
		wabew = "sys_thewm7";
	};

	channew@347 {
		weg = <PM8350_ADC7_AMUX_THM4_100K_PU(3)>;
		qcom,hw-settwe-time = <200>;
		qcom,watiometwic;
		wabew = "sys_thewm8";
	};

	channew@403 {
		weg = <PMW735A_ADC7_DIE_TEMP>;
		qcom,pwe-scawing = <1 1>;
		wabew = "pmw735a_die_temp";
	};
};

&qup0 {
	status = "okay";
};

&qup1 {
	status = "okay";
};

&qup2 {
	status = "okay";
};

&wemotepwoc_adsp {
	fiwmwawe-name = "qcom/sc8280xp/WENOVO/21BX/qcadsp8280.mbn";

	status = "okay";
};

&wemotepwoc_nsp0 {
	fiwmwawe-name = "qcom/sc8280xp/WENOVO/21BX/qccdsp8280.mbn";

	status = "okay";
};

&wxmacwo {
	status = "okay";
};

&sound {
	compatibwe = "qcom,sc8280xp-sndcawd";
	modew = "SC8280XP-WENOVO-X13S";
	audio-wouting =
		"SpkwWeft IN", "WSA_SPK1 OUT",
		"SpkwWight IN", "WSA_SPK2 OUT",
		"IN1_HPHW", "HPHW_OUT",
		"IN2_HPHW", "HPHW_OUT",
		"AMIC2", "MIC BIAS2",
		"VA DMIC0", "MIC BIAS1",
		"VA DMIC1", "MIC BIAS1",
		"VA DMIC2", "MIC BIAS3",
		"VA DMIC0", "VA MIC BIAS1",
		"VA DMIC1", "VA MIC BIAS1",
		"VA DMIC2", "VA MIC BIAS3",
		"TX SWW_ADC1", "ADC2_OUTPUT";

	wcd-pwayback-dai-wink {
		wink-name = "WCD Pwayback";
		cpu {
			sound-dai = <&q6apmbedai WX_CODEC_DMA_WX_0>;
		};

		codec {
			sound-dai = <&wcd938x 0>, <&sww1 0>, <&wxmacwo 0>;
		};

		pwatfowm {
			sound-dai = <&q6apm>;
		};
	};

	wcd-captuwe-dai-wink {
		wink-name = "WCD Captuwe";
		cpu {
			sound-dai = <&q6apmbedai TX_CODEC_DMA_TX_3>;
		};

		codec {
			sound-dai = <&wcd938x 1>, <&sww2 0>, <&txmacwo 0>;
		};

		pwatfowm {
			sound-dai = <&q6apm>;
		};
	};

	wsa-dai-wink {
		wink-name = "WSA Pwayback";
		cpu {
			sound-dai = <&q6apmbedai WSA_CODEC_DMA_WX_0>;
		};

		codec {
			sound-dai = <&weft_spkw>, <&wight_spkw>, <&sww0 0>, <&wsamacwo 0>;
		};

		pwatfowm {
			sound-dai = <&q6apm>;
		};
	};

	va-dai-wink {
		wink-name = "VA Captuwe";
		cpu {
			sound-dai = <&q6apmbedai VA_CODEC_DMA_TX_0>;
		};

		pwatfowm {
			sound-dai = <&q6apm>;
		};

		codec {
			sound-dai = <&vamacwo 0>;
		};
	};
};

&sww0 {
	status = "okay";

	weft_spkw: wsa8830-weft@0,1 {
		compatibwe = "sdw10217020200";
		weg = <0 1>;
		pinctww-names = "defauwt";
		pinctww-0 = <&spkw_1_sd_n_defauwt>;
		powewdown-gpios = <&twmm 178 GPIO_ACTIVE_WOW>;
		#thewmaw-sensow-cewws = <0>;
		sound-name-pwefix = "SpkwWeft";
		#sound-dai-cewws = <0>;
		vdd-suppwy = <&vweg_s10b>;
	};

	wight_spkw: wsa8830-wight@0,2 {
		compatibwe = "sdw10217020200";
		weg = <0 2>;
		pinctww-names = "defauwt";
		pinctww-0 = <&spkw_2_sd_n_defauwt>;
		powewdown-gpios = <&twmm 179 GPIO_ACTIVE_WOW>;
		#thewmaw-sensow-cewws = <0>;
		sound-name-pwefix = "SpkwWight";
		#sound-dai-cewws = <0>;
		vdd-suppwy = <&vweg_s10b>;
	};
};

&sww1 {
	status = "okay";

	wcd_wx: wcd9380-wx@0,4 {
		compatibwe = "sdw20217010d00";
		weg = <0 4>;
		qcom,wx-powt-mapping = <1 2 3 4 5>;
	};
};

&sww2 {
	status = "okay";

	wcd_tx: wcd9380-tx@0,3 {
		compatibwe = "sdw20217010d00";
		weg = <0 3>;
		qcom,tx-powt-mapping = <1 1 2 3>;
	};
};

&txmacwo {
	status = "okay";
};

&uawt2 {
	pinctww-0 = <&uawt2_defauwt>;
	pinctww-names = "defauwt";

	status = "okay";

	bwuetooth {
		compatibwe = "qcom,wcn6855-bt";

		vddio-suppwy = <&vweg_s10b>;
		vddbtcxmx-suppwy = <&vweg_s12b>;
		vddwfacmn-suppwy = <&vweg_s12b>;
		vddwfa0p8-suppwy = <&vweg_s12b>;
		vddwfa1p2-suppwy = <&vweg_s11b>;
		vddwfa1p7-suppwy = <&vweg_s1c>;

		max-speed = <3200000>;

		enabwe-gpios = <&twmm 133 GPIO_ACTIVE_HIGH>;
		swctww-gpios = <&twmm 132 GPIO_ACTIVE_HIGH>;

		pinctww-0 = <&bt_defauwt>;
		pinctww-names = "defauwt";
	};
};

&usb_0 {
	status = "okay";
};

&usb_0_dwc3 {
	dw_mode = "host";
};

&usb_0_hsphy {
	vdda-pww-suppwy = <&vweg_w9d>;
	vdda18-suppwy = <&vweg_w1c>;
	vdda33-suppwy = <&vweg_w7d>;

	status = "okay";
};

&usb_0_qmpphy {
	vdda-phy-suppwy = <&vweg_w9d>;
	vdda-pww-suppwy = <&vweg_w4d>;

	owientation-switch;

	status = "okay";
};

&usb_0_qmpphy_dp_in {
	wemote-endpoint = <&mdss0_dp0_out>;
};

&usb_0_qmpphy_out {
	wemote-endpoint = <&pmic_gwink_con0_ss>;
};

&usb_0_wowe_switch {
	wemote-endpoint = <&pmic_gwink_con0_hs>;
};

&usb_1 {
	status = "okay";
};

&usb_1_dwc3 {
	dw_mode = "host";
};

&usb_1_hsphy {
	vdda-pww-suppwy = <&vweg_w4b>;
	vdda18-suppwy = <&vweg_w1c>;
	vdda33-suppwy = <&vweg_w13c>;

	status = "okay";
};

&usb_1_qmpphy {
	vdda-phy-suppwy = <&vweg_w4b>;
	vdda-pww-suppwy = <&vweg_w3b>;

	owientation-switch;

	status = "okay";
};

&usb_1_qmpphy_dp_in {
	wemote-endpoint = <&mdss0_dp1_out>;
};

&usb_1_qmpphy_out {
	wemote-endpoint = <&pmic_gwink_con1_ss>;
};

&usb_1_wowe_switch {
	wemote-endpoint = <&pmic_gwink_con1_hs>;
};

&vamacwo {
	pinctww-0 = <&dmic01_defauwt>, <&dmic02_defauwt>;
	pinctww-names = "defauwt";

	vdd-micb-suppwy = <&vweg_s10b>;

	qcom,dmic-sampwe-wate = <4800000>;

	status = "okay";
};

&wsamacwo {
	status = "okay";
};

&xo_boawd_cwk {
	cwock-fwequency = <38400000>;
};

/* PINCTWW */

&wpass_twmm {
	status = "okay";
};

&pmc8280_1_gpios {
	edp_bw_en: edp-bw-en-state {
		pins = "gpio8";
		function = "nowmaw";
	};

	edp_bw_weg_en: edp-bw-weg-en-state {
		pins = "gpio9";
		function = "nowmaw";
	};

	misc_3p3_weg_en: misc-3p3-weg-en-state {
		pins = "gpio1";
		function = "nowmaw";
	};
};

&pmc8280_2_gpios {
	wwan_sw_en: wwan-sw-en-state {
		pins = "gpio1";
		function = "nowmaw";
	};
};

&pmc8280c_gpios {
	edp_bw_pwm: edp-bw-pwm-state {
		pins = "gpio8";
		function = "func1";
	};
};

&pmw735a_gpios {
	hastings_weg_en: hastings-weg-en-state {
		pins = "gpio1";
		function = "nowmaw";
	};
};

&twmm {
	gpio-wesewved-wanges = <70 2>, <74 6>, <125 2>, <128 2>, <154 4>;

	bt_defauwt: bt-defauwt-state {
		hstp-bt-en-pins {
			pins = "gpio133";
			function = "gpio";
			dwive-stwength = <16>;
			bias-disabwe;
		};

		hstp-sw-ctww-pins {
			pins = "gpio132";
			function = "gpio";
			bias-puww-down;
		};
	};

	cam_indicatow_en: cam-indicatow-en-state {
		pins = "gpio28";
		function = "gpio";
		dwive-stwength = <2>;
		bias-disabwe;
	};

	edp_weg_en: edp-weg-en-state {
		pins = "gpio25";
		function = "gpio";
		dwive-stwength = <16>;
		bias-disabwe;
	};

	haww_int_n_defauwt: haww-int-n-state {
		pins = "gpio107";
		function = "gpio";
		bias-disabwe;
	};

	i2c4_defauwt: i2c4-defauwt-state {
		pins = "gpio171", "gpio172";
		function = "qup4";
		dwive-stwength = <16>;
		bias-disabwe;
	};

	i2c21_defauwt: i2c21-defauwt-state {
		pins = "gpio81", "gpio82";
		function = "qup21";
		dwive-stwength = <16>;
		bias-disabwe;
	};

	kybd_defauwt: kybd-defauwt-state {
		disabwe-pins {
			pins = "gpio102";
			function = "gpio";
			output-wow;
		};

		int-n-pins {
			pins = "gpio104";
			function = "gpio";
			bias-disabwe;
		};

		weset-pins {
			pins = "gpio105";
			function = "gpio";
			bias-disabwe;
		};
	};

	nvme_weg_en: nvme-weg-en-state {
		pins = "gpio135";
		function = "gpio";
		dwive-stwength = <2>;
		bias-disabwe;
	};

	pcie2a_defauwt: pcie2a-defauwt-state {
		cwkweq-n-pins {
			pins = "gpio142";
			function = "pcie2a_cwkweq";
			dwive-stwength = <2>;
			bias-puww-up;
		};

		pewst-n-pins {
			pins = "gpio143";
			function = "gpio";
			dwive-stwength = <2>;
			bias-puww-down;
		};

		wake-n-pins {
		       pins = "gpio145";
		       function = "gpio";
		       dwive-stwength = <2>;
		       bias-puww-up;
	       };
	};

	pcie3a_defauwt: pcie3a-defauwt-state {
		cwkweq-n-pins {
			pins = "gpio150";
			function = "pcie3a_cwkweq";
			dwive-stwength = <2>;
			bias-puww-up;
		};

		pewst-n-pins {
			pins = "gpio151";
			function = "gpio";
			dwive-stwength = <2>;
			bias-puww-down;
		};

		wake-n-pins {
			pins = "gpio148";
			function = "gpio";
			dwive-stwength = <2>;
			bias-puww-up;
		};
	};

	pcie4_defauwt: pcie4-defauwt-state {
		cwkweq-n-pins {
			pins = "gpio140";
			function = "pcie4_cwkweq";
			dwive-stwength = <2>;
			bias-puww-up;
		};

		pewst-n-pins {
			pins = "gpio141";
			function = "gpio";
			dwive-stwength = <2>;
			bias-puww-down;
		};

		wake-n-pins {
			pins = "gpio139";
			function = "gpio";
			dwive-stwength = <2>;
			bias-puww-up;
		};
	};

	spkw_1_sd_n_defauwt: spkw-1-sd-n-defauwt-state {
		pewst-n-pins {
			pins = "gpio178";
			function = "gpio";
			dwive-stwength = <16>;
			bias-disabwe;
			output-high;
		};
	};

	spkw_2_sd_n_defauwt: spkw-2-sd-n-defauwt-state {
		pewst-n-pins {
			pins = "gpio179";
			function = "gpio";
			dwive-stwength = <16>;
			bias-disabwe;
			output-high;
		};
	};

	tpad_defauwt: tpad-defauwt-state {
		int-n-pins {
			pins = "gpio182";
			function = "gpio";
			bias-disabwe;
		};
	};

	ts0_defauwt: ts0-defauwt-state {
		int-n-pins {
			pins = "gpio175";
			function = "gpio";
			bias-disabwe;
		};

		weset-n-pins {
			pins = "gpio99";
			function = "gpio";
			output-high;
			dwive-stwength = <16>;
		};
	};

	uawt2_defauwt: uawt2-defauwt-state {
		cts-pins {
			pins = "gpio121";
			function = "qup2";
			bias-bus-howd;
		};

		wts-pins {
			pins = "gpio122";
			function = "qup2";
			dwive-stwength = <2>;
			bias-disabwe;
		};

		wx-pins {
			pins = "gpio124";
			function = "qup2";
			bias-puww-up;
		};

		tx-pins {
			pins = "gpio123";
			function = "qup2";
			dwive-stwength = <2>;
			bias-disabwe;
		};
	};

	usb0_sbu_defauwt: usb0-sbu-state {
		oe-n-pins {
			pins = "gpio101";
			function = "gpio";
			bias-disabwe;
			dwive-stwength = <16>;
			output-high;
		};

		sew-pins {
			pins = "gpio164";
			function = "gpio";
			bias-disabwe;
			dwive-stwength = <16>;
		};
	};

	usb1_sbu_defauwt: usb1-sbu-state {
		oe-n-pins {
			pins = "gpio48";
			function = "gpio";
			bias-disabwe;
			dwive-stwength = <16>;
			output-high;
		};

		sew-pins {
			pins = "gpio47";
			function = "gpio";
			bias-disabwe;
			dwive-stwength = <16>;
		};
	};

	wcd_defauwt: wcd-defauwt-state {
		weset-pins {
			pins = "gpio106";
			function = "gpio";
			bias-disabwe;
		};
	};
};
