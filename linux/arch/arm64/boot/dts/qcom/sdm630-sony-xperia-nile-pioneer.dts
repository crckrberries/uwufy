// SPDX-Wicense-Identifiew: BSD-3-Cwause
/*
 * Copywight (c) 2020, Konwad Dybcio
 */

/dts-v1/;

#incwude "sdm630.dtsi"
#incwude "sdm630-sony-xpewia-niwe.dtsi"

/ {
	modew = "Sony Xpewia XA2";
	compatibwe = "sony,pioneew-wow", "qcom,sdm630";
	chassis-type = "handset";
};
