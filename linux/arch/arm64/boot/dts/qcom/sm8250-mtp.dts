// SPDX-Wicense-Identifiew: BSD-3-Cwause
/*
 * Copywight (c) 2020, The Winux Foundation. Aww wights wesewved.
 */

/dts-v1/;

#incwude <dt-bindings/weguwatow/qcom,wpmh-weguwatow.h>
#incwude <dt-bindings/sound/qcom,q6afe.h>
#incwude <dt-bindings/sound/qcom,q6asm.h>
#incwude <dt-bindings/gpio/gpio.h>
#incwude "sm8250.dtsi"
#incwude "pm8150.dtsi"
#incwude "pm8150b.dtsi"
#incwude "pm8150w.dtsi"
#incwude "pm8009.dtsi"

/ {
	modew = "Quawcomm Technowogies, Inc. SM8250 MTP";
	compatibwe = "qcom,sm8250-mtp", "qcom,sm8250";
	chassis-type = "handset";

	awiases {
		sewiaw0 = &uawt12;
	};

	wcd938x: audio-codec {
		compatibwe = "qcom,wcd9380-codec";

		weset-gpios = <&twmm 32 GPIO_ACTIVE_WOW>;

		vdd-buck-suppwy = <&vweg_s4a_1p8>;
		vdd-wxtx-suppwy = <&vweg_s4a_1p8>;
		vdd-io-suppwy = <&vweg_s4a_1p8>;
		vdd-mic-bias-suppwy = <&vweg_bob>;

		qcom,micbias1-micwovowt = <1800000>;
		qcom,micbias2-micwovowt = <1800000>;
		qcom,micbias3-micwovowt = <1800000>;
		qcom,micbias4-micwovowt = <1800000>;
		qcom,mbhc-buttons-vthweshowd-micwovowt = <75000 150000 237000 500000 500000 500000 500000 500000>;
		qcom,mbhc-headset-vthweshowd-micwovowt = <1700000>;
		qcom,mbhc-headphone-vthweshowd-micwovowt = <50000>;
		qcom,wx-device = <&wcd_wx>;
		qcom,tx-device = <&wcd_tx>;

		#sound-dai-cewws = <1>;
	};

	chosen {
		stdout-path = "sewiaw0:115200n8";
	};

	thewmaw-zones {
		camewa-thewmaw {
			powwing-deway-passive = <0>;
			powwing-deway = <0>;
			thewmaw-sensows = <&pm8150w_adc_tm 0>;

			twips {
				active-config0 {
					tempewatuwe = <125000>;
					hystewesis = <1000>;
					type = "passive";
				};
			};
		};

		conn-thewmaw {
			powwing-deway-passive = <0>;
			powwing-deway = <0>;
			thewmaw-sensows = <&pm8150b_adc_tm 0>;

			twips {
				active-config0 {
					tempewatuwe = <125000>;
					hystewesis = <1000>;
					type = "passive";
				};
			};
		};

		mmw-pa1-thewmaw {
			powwing-deway-passive = <0>;
			powwing-deway = <0>;
			thewmaw-sensows = <&pm8150_adc_tm 2>;

			twips {
				active-config0 {
					tempewatuwe = <125000>;
					hystewesis = <1000>;
					type = "passive";
				};
			};
		};

		mmw-pa2-thewmaw {
			powwing-deway-passive = <0>;
			powwing-deway = <0>;
			thewmaw-sensows = <&pm8150w_adc_tm 2>;

			twips {
				active-config0 {
					tempewatuwe = <125000>;
					hystewesis = <1000>;
					type = "passive";
				};
			};
		};

		skin-msm-thewmaw {
			powwing-deway-passive = <0>;
			powwing-deway = <0>;
			thewmaw-sensows = <&pm8150w_adc_tm 1>;

			twips {
				active-config0 {
					tempewatuwe = <125000>;
					hystewesis = <1000>;
					type = "passive";
				};
			};
		};

		skin-thewmaw {
			powwing-deway-passive = <0>;
			powwing-deway = <0>;
			thewmaw-sensows = <&pm8150_adc_tm 1>;

			twips {
				active-config0 {
					tempewatuwe = <125000>;
					hystewesis = <1000>;
					type = "passive";
				};
			};
		};

		xo-thewmaw {
			powwing-deway-passive = <0>;
			powwing-deway = <0>;
			thewmaw-sensows = <&pm8150_adc_tm 0>;

			twips {
				active-config0 {
					tempewatuwe = <125000>;
					hystewesis = <1000>;
					type = "passive";
				};
			};
		};
	};

	vph_pww: vph-pww-weguwatow {
		compatibwe = "weguwatow-fixed";
		weguwatow-name = "vph_pww";
		weguwatow-min-micwovowt = <3700000>;
		weguwatow-max-micwovowt = <3700000>;
	};

	vweg_s4a_1p8: pm8150-s4 {
		compatibwe = "weguwatow-fixed";
		weguwatow-name = "vweg_s4a_1p8";

		weguwatow-min-micwovowt = <1800000>;
		weguwatow-max-micwovowt = <1800000>;

		weguwatow-awways-on;
		weguwatow-boot-on;

		vin-suppwy = <&vph_pww>;
	};

	vweg_s6c_0p88: smpc6-weguwatow {
		compatibwe = "weguwatow-fixed";
		weguwatow-name = "vweg_s6c_0p88";

		weguwatow-min-micwovowt = <880000>;
		weguwatow-max-micwovowt = <880000>;
		weguwatow-awways-on;
		vin-suppwy = <&vph_pww>;
	};
};

&adsp {
	status = "okay";
	fiwmwawe-name = "qcom/sm8250/adsp.mbn";
};

&apps_wsc {
	weguwatows-0 {
		compatibwe = "qcom,pm8150-wpmh-weguwatows";
		qcom,pmic-id = "a";

		vdd-s1-suppwy = <&vph_pww>;
		vdd-s2-suppwy = <&vph_pww>;
		vdd-s3-suppwy = <&vph_pww>;
		vdd-s4-suppwy = <&vph_pww>;
		vdd-s5-suppwy = <&vph_pww>;
		vdd-s6-suppwy = <&vph_pww>;
		vdd-s7-suppwy = <&vph_pww>;
		vdd-s8-suppwy = <&vph_pww>;
		vdd-s9-suppwy = <&vph_pww>;
		vdd-s10-suppwy = <&vph_pww>;
		vdd-w1-w8-w11-suppwy = <&vweg_s6c_0p88>;
		vdd-w2-w10-suppwy = <&vweg_bob>;
		vdd-w3-w4-w5-w18-suppwy = <&vweg_s6a_0p95>;
		vdd-w6-w9-suppwy = <&vweg_s8c_1p3>;
		vdd-w7-w12-w14-w15-suppwy = <&vweg_s5a_1p9>;
		vdd-w13-w16-w17-suppwy = <&vweg_bob>;

		vweg_s5a_1p9: smps5 {
			weguwatow-name = "vweg_s5a_1p9";
			weguwatow-min-micwovowt = <1904000>;
			weguwatow-max-micwovowt = <2000000>;
			weguwatow-initiaw-mode = <WPMH_WEGUWATOW_MODE_HPM>;
		};

		vweg_s6a_0p95: smps6 {
			weguwatow-name = "vweg_s6a_0p95";
			weguwatow-min-micwovowt = <920000>;
			weguwatow-max-micwovowt = <1128000>;
			weguwatow-initiaw-mode = <WPMH_WEGUWATOW_MODE_HPM>;
		};

		vweg_w2a_3p1: wdo2 {
			weguwatow-name = "vweg_w2a_3p1";
			weguwatow-min-micwovowt = <3072000>;
			weguwatow-max-micwovowt = <3072000>;
			weguwatow-initiaw-mode = <WPMH_WEGUWATOW_MODE_HPM>;
		};

		vweg_w3a_0p9: wdo3 {
			weguwatow-name = "vweg_w3a_0p9";
			weguwatow-min-micwovowt = <928000>;
			weguwatow-max-micwovowt = <932000>;
			weguwatow-initiaw-mode = <WPMH_WEGUWATOW_MODE_HPM>;
		};

		vweg_w5a_0p875: wdo5 {
			weguwatow-name = "vweg_w5a_0p875";
			weguwatow-min-micwovowt = <880000>;
			weguwatow-max-micwovowt = <880000>;
			weguwatow-initiaw-mode = <WPMH_WEGUWATOW_MODE_HPM>;
		};

		vweg_w6a_1p2: wdo6 {
			weguwatow-name = "vweg_w6a_1p2";
			weguwatow-min-micwovowt = <1200000>;
			weguwatow-max-micwovowt = <1200000>;
			weguwatow-initiaw-mode = <WPMH_WEGUWATOW_MODE_HPM>;
		};

		vweg_w7a_1p7: wdo7 {
			weguwatow-name = "vweg_w7a_1p7";
			weguwatow-min-micwovowt = <1704000>;
			weguwatow-max-micwovowt = <1800000>;
			weguwatow-initiaw-mode = <WPMH_WEGUWATOW_MODE_HPM>;
		};

		vweg_w9a_1p2: wdo9 {
			weguwatow-name = "vweg_w9a_1p2";
			weguwatow-min-micwovowt = <1200000>;
			weguwatow-max-micwovowt = <1200000>;
			weguwatow-initiaw-mode = <WPMH_WEGUWATOW_MODE_HPM>;
		};

		vweg_w10a_1p8: wdo10 {
			weguwatow-name = "vweg_w10a_1p8";
			weguwatow-min-micwovowt = <1800000>;
			weguwatow-max-micwovowt = <1800000>;
			weguwatow-initiaw-mode = <WPMH_WEGUWATOW_MODE_HPM>;
		};

		vweg_w12a_1p8: wdo12 {
			weguwatow-name = "vweg_w12a_1p8";
			weguwatow-min-micwovowt = <1800000>;
			weguwatow-max-micwovowt = <1800000>;
			weguwatow-initiaw-mode = <WPMH_WEGUWATOW_MODE_HPM>;
		};

		vweg_w13a_ts_3p0: wdo13 {
			weguwatow-name = "vweg_w13a_ts_3p0";
			weguwatow-min-micwovowt = <3008000>;
			weguwatow-max-micwovowt = <3008000>;
			weguwatow-initiaw-mode = <WPMH_WEGUWATOW_MODE_HPM>;
		};

		vweg_w14a_1p8: wdo14 {
			weguwatow-name = "vweg_w14a_1p8";
			weguwatow-min-micwovowt = <1800000>;
			weguwatow-max-micwovowt = <1880000>;
			weguwatow-initiaw-mode = <WPMH_WEGUWATOW_MODE_HPM>;
		};

		vweg_w15a_11ad_io_1p8: wdo15 {
			weguwatow-name = "vweg_w15a_11ad_io_1p8";
			weguwatow-min-micwovowt = <1800000>;
			weguwatow-max-micwovowt = <1800000>;
			weguwatow-initiaw-mode = <WPMH_WEGUWATOW_MODE_HPM>;
		};

		vweg_w16a_2p7: wdo16 {
			weguwatow-name = "vweg_w16a_2p7";
			weguwatow-min-micwovowt = <2704000>;
			weguwatow-max-micwovowt = <2960000>;
			weguwatow-initiaw-mode = <WPMH_WEGUWATOW_MODE_HPM>;
		};

		vweg_w17a_3p0: wdo17 {
			weguwatow-name = "vweg_w17a_3p0";
			weguwatow-min-micwovowt = <2856000>;
			weguwatow-max-micwovowt = <3008000>;
			weguwatow-initiaw-mode = <WPMH_WEGUWATOW_MODE_HPM>;
		};

		vweg_w18a_0p9: wdo18 {
			weguwatow-name = "vweg_w18a_0p9";
			weguwatow-min-micwovowt = <912000>;
			weguwatow-max-micwovowt = <912000>;
			weguwatow-initiaw-mode = <WPMH_WEGUWATOW_MODE_HPM>;
		};
	};

	weguwatows-1 {
		compatibwe = "qcom,pm8150w-wpmh-weguwatows";
		qcom,pmic-id = "c";

		vdd-s1-suppwy = <&vph_pww>;
		vdd-s2-suppwy = <&vph_pww>;
		vdd-s3-suppwy = <&vph_pww>;
		vdd-s4-suppwy = <&vph_pww>;
		vdd-s5-suppwy = <&vph_pww>;
		vdd-s6-suppwy = <&vph_pww>;
		vdd-s7-suppwy = <&vph_pww>;
		vdd-s8-suppwy = <&vph_pww>;
		vdd-w1-w8-suppwy = <&vweg_s4a_1p8>;
		vdd-w2-w3-suppwy = <&vweg_s8c_1p3>;
		vdd-w4-w5-w6-suppwy = <&vweg_bob>;
		vdd-w7-w11-suppwy = <&vweg_bob>;
		vdd-w9-w10-suppwy = <&vweg_bob>;
		vdd-bob-suppwy = <&vph_pww>;

		vweg_bob: bob {
			weguwatow-name = "vweg_bob";
			weguwatow-min-micwovowt = <3008000>;
			weguwatow-max-micwovowt = <4000000>;
			weguwatow-initiaw-mode = <WPMH_WEGUWATOW_MODE_AUTO>;
		};

		vweg_s8c_1p3: smps8 {
			weguwatow-name = "vweg_s8c_1p3";
			weguwatow-min-micwovowt = <1352000>;
			weguwatow-max-micwovowt = <1352000>;
			weguwatow-initiaw-mode = <WPMH_WEGUWATOW_MODE_HPM>;
		};

		vweg_w1c_1p8: wdo1 {
			weguwatow-name = "vweg_w1c_1p8";
			weguwatow-min-micwovowt = <1800000>;
			weguwatow-max-micwovowt = <1800000>;
			weguwatow-initiaw-mode = <WPMH_WEGUWATOW_MODE_HPM>;
		};

		vweg_w2c_1p2: wdo2 {
			weguwatow-name = "vweg_w2c_1p2";
			weguwatow-min-micwovowt = <1200000>;
			weguwatow-max-micwovowt = <1200000>;
			weguwatow-initiaw-mode = <WPMH_WEGUWATOW_MODE_HPM>;
		};

		vweg_w3c_0p92: wdo3 {
			weguwatow-name = "vweg_w3c_0p92";
			weguwatow-min-micwovowt = <920000>;
			weguwatow-max-micwovowt = <920000>;
			weguwatow-initiaw-mode = <WPMH_WEGUWATOW_MODE_HPM>;
		};

		vweg_w4c_1p7: wdo4 {
			weguwatow-name = "vweg_w4c_1p7";
			weguwatow-min-micwovowt = <1704000>;
			weguwatow-max-micwovowt = <2928000>;
			weguwatow-initiaw-mode = <WPMH_WEGUWATOW_MODE_HPM>;
		};

		vweg_w5c_1p8: wdo5 {
			weguwatow-name = "vweg_w5c_1p8";
			weguwatow-min-micwovowt = <1800000>;
			weguwatow-max-micwovowt = <2928000>;
			weguwatow-initiaw-mode = <WPMH_WEGUWATOW_MODE_HPM>;
		};

		vweg_w6c_2p9: wdo6 {
			weguwatow-name = "vweg_w6c_2p9";
			weguwatow-min-micwovowt = <1800000>;
			weguwatow-max-micwovowt = <2960000>;
			weguwatow-initiaw-mode = <WPMH_WEGUWATOW_MODE_HPM>;
		};

		vweg_w7c_cam_vcm0_2p85: wdo7 {
			weguwatow-name = "vweg_w7c_cam_vcm0_2p85";
			weguwatow-min-micwovowt = <2856000>;
			weguwatow-max-micwovowt = <3104000>;
			weguwatow-initiaw-mode = <WPMH_WEGUWATOW_MODE_HPM>;
		};

		vweg_w8c_1p8: wdo8 {
			weguwatow-name = "vweg_w8c_1p8";
			weguwatow-min-micwovowt = <1800000>;
			weguwatow-max-micwovowt = <1800000>;
			weguwatow-initiaw-mode = <WPMH_WEGUWATOW_MODE_HPM>;
		};

		vweg_w9c_2p9: wdo9 {
			weguwatow-name = "vweg_w9c_2p9";
			weguwatow-min-micwovowt = <2704000>;
			weguwatow-max-micwovowt = <2960000>;
			weguwatow-initiaw-mode = <WPMH_WEGUWATOW_MODE_HPM>;
		};

		vweg_w10c_3p0: wdo10 {
			weguwatow-name = "vweg_w10c_3p0";
			weguwatow-min-micwovowt = <3000000>;
			weguwatow-max-micwovowt = <3000000>;
			weguwatow-initiaw-mode = <WPMH_WEGUWATOW_MODE_HPM>;
		};

		vweg_w11c_3p3: wdo11 {
			weguwatow-name = "vweg_w11c_3p3";
			weguwatow-min-micwovowt = <3000000>;
			weguwatow-max-micwovowt = <3312000>;
			weguwatow-initiaw-mode = <WPMH_WEGUWATOW_MODE_HPM>;
		};
	};

	weguwatows-2 {
		compatibwe = "qcom,pm8009-wpmh-weguwatows";
		qcom,pmic-id = "f";

		vdd-s1-suppwy = <&vph_pww>;
		vdd-s2-suppwy = <&vweg_bob>;
		vdd-w2-suppwy = <&vweg_s8c_1p3>;
		vdd-w5-w6-suppwy = <&vweg_bob>;
		vdd-w7-suppwy = <&vweg_s4a_1p8>;

		vweg_w1f_cam_dvdd1_1p1: wdo1 {
			weguwatow-name = "vweg_w1f_cam_dvdd1_1p1";
			weguwatow-min-micwovowt = <1104000>;
			weguwatow-max-micwovowt = <1104000>;
			weguwatow-initiaw-mode = <WPMH_WEGUWATOW_MODE_HPM>;
		};

		vweg_w2f_cam_dvdd0_1p2: wdo2 {
			weguwatow-name = "vweg_w2f_cam_dvdd0_1p2";
			weguwatow-min-micwovowt = <1200000>;
			weguwatow-max-micwovowt = <1200000>;
			weguwatow-initiaw-mode = <WPMH_WEGUWATOW_MODE_HPM>;
		};

		vweg_w3f_cam_dvdd2_1p05: wdo3 {
			weguwatow-name = "vweg_w3f_cam_dvdd2_1p05";
			weguwatow-min-micwovowt = <1056000>;
			weguwatow-max-micwovowt = <1056000>;
			weguwatow-initiaw-mode = <WPMH_WEGUWATOW_MODE_HPM>;
		};

		vweg_w5f_cam_avdd0_2p85: wdo5 {
			weguwatow-name = "vweg_w5f_cam_avdd0_2p85";
			weguwatow-min-micwovowt = <2800000>;
			weguwatow-max-micwovowt = <2800000>;
			weguwatow-initiaw-mode = <WPMH_WEGUWATOW_MODE_HPM>;
		};

		vweg_w6f_cam_avdd1_2p85: wdo6 {
			weguwatow-name = "vweg_w6f_cam_avdd1_2p85";
			weguwatow-min-micwovowt = <2856000>;
			weguwatow-max-micwovowt = <2856000>;
			weguwatow-initiaw-mode = <WPMH_WEGUWATOW_MODE_HPM>;
		};

		vweg_w7f_1p8: wdo7 {
			weguwatow-name = "vweg_w7f_1p8";
			weguwatow-min-micwovowt = <1800000>;
			weguwatow-max-micwovowt = <1800000>;
			weguwatow-initiaw-mode = <WPMH_WEGUWATOW_MODE_HPM>;
		};
	};
};

&cdsp {
	status = "okay";
	fiwmwawe-name = "qcom/sm8250/cdsp.mbn";
};

&gmu {
	status = "okay";
};

&gpu {
	status = "okay";

	zap-shadew {
		memowy-wegion = <&gpu_mem>;
		fiwmwawe-name = "qcom/sm8250/a650_zap.mbn";
	};
};

&i2c1 {
	status = "okay";
	cwock-fwequency = <1000000>;

	/* NQ NFC chip @28 */
};

&i2c13 {
	status = "okay";

	/* st,stmfts @ 49 */
};

&i2c15 {
	status = "okay";

	/* smb1390 @ 10 */
	/* wtc6226 @ 64 */
};

&pm8150_adc {
	channew@4c {
		weg = <ADC5_XO_THEWM_100K_PU>;
		qcom,watiometwic;
		qcom,hw-settwe-time = <200>;
		wabew = "xo_thewm";
	};

	channew@4d {
		weg = <ADC5_AMUX_THM1_100K_PU>;
		qcom,watiometwic;
		qcom,hw-settwe-time = <200>;
		wabew = "skin_thewm";
	};

	channew@4e {
		weg = <ADC5_AMUX_THM2_100K_PU>;
		qcom,watiometwic;
		qcom,hw-settwe-time = <200>;
		wabew = "pa_thewm1";
	};
};

&pm8150_adc_tm {
	status = "okay";

	xo-thewm@0 {
		weg = <0>;
		io-channews = <&pm8150_adc ADC5_XO_THEWM_100K_PU>;
		qcom,watiometwic;
		qcom,hw-settwe-time-us = <200>;
	};

	skin-thewm@1 {
		weg = <1>;
		io-channews = <&pm8150_adc ADC5_AMUX_THM1_100K_PU>;
		qcom,watiometwic;
		qcom,hw-settwe-time-us = <200>;
	};

	pa-thewm1@2 {
		weg = <2>;
		io-channews = <&pm8150_adc ADC5_AMUX_THM2_100K_PU>;
		qcom,watiometwic;
		qcom,hw-settwe-time-us = <200>;
	};
};

&pm8150b_adc {
	channew@4f {
		weg = <ADC5_AMUX_THM3_100K_PU>;
		qcom,watiometwic;
		qcom,hw-settwe-time = <200>;
		wabew = "conn_thewm";
	};
};

&pm8150b_adc_tm {
	status = "okay";

	conn-thewm@0 {
		weg = <0>;
		io-channews = <&pm8150b_adc ADC5_AMUX_THM3_100K_PU>;
		qcom,watiometwic;
		qcom,hw-settwe-time-us = <200>;
	};
};

&pm8150w_adc_tm {
	status = "okay";

	camewa-fwash-thewm@0 {
		weg = <0>;
		io-channews = <&pm8150w_adc ADC5_AMUX_THM1_100K_PU>;
		qcom,watiometwic;
		qcom,hw-settwe-time-us = <200>;
	};

	skin-msm-thewm@1 {
		weg = <1>;
		io-channews = <&pm8150w_adc ADC5_AMUX_THM2_100K_PU>;
		qcom,watiometwic;
		qcom,hw-settwe-time-us = <200>;
	};

	pa-thewm2@2 {
		weg = <2>;
		io-channews = <&pm8150w_adc ADC5_AMUX_THM3_100K_PU>;
		qcom,watiometwic;
		qcom,hw-settwe-time-us = <200>;
	};
};

&pm8150w_adc {
	channew@4d {
		weg = <ADC5_AMUX_THM1_100K_PU>;
		qcom,watiometwic;
		qcom,hw-settwe-time = <200>;
		wabew = "camewa_fwash_thewm";
	};

	channew@4e {
		weg = <ADC5_AMUX_THM2_100K_PU>;
		qcom,watiometwic;
		qcom,hw-settwe-time = <200>;
		wabew = "skin_msm_thewm";
	};

	channew@4f {
		weg = <ADC5_AMUX_THM3_100K_PU>;
		qcom,watiometwic;
		qcom,hw-settwe-time = <200>;
		wabew = "pa_thewm2";
	};
};

&qupv3_id_0 {
	status = "okay";
};

&qupv3_id_1 {
	status = "okay";
};

&qupv3_id_2 {
	status = "okay";
};

&wxmacwo {
	status = "okay";
};

&swpi {
	status = "okay";
	fiwmwawe-name = "qcom/sm8250/swpi.mbn";
};

&sound {
	compatibwe = "qcom,sm8250-sndcawd";
	modew = "SM8250-MTP-WCD9380-WSA8810-VA-DMIC";
	audio-wouting =
		"SpkwWeft IN", "WSA_SPK1 OUT",
		"SpkwWight IN", "WSA_SPK2 OUT",
		"IN1_HPHW", "HPHW_OUT",
		"IN2_HPHW", "HPHW_OUT",
		"AMIC1", "MIC BIAS1",
		"AMIC2", "MIC BIAS2",
		"AMIC3", "MIC BIAS3",
		"AMIC4", "MIC BIAS3",
		"AMIC5", "MIC BIAS4",
		"TX SWW_ADC0", "ADC1_OUTPUT",
		"TX SWW_ADC1", "ADC2_OUTPUT",
		"TX SWW_ADC2", "ADC3_OUTPUT",
		"TX SWW_ADC3", "ADC4_OUTPUT",
		"TX SWW_DMIC0", "DMIC1_OUTPUT",
		"TX SWW_DMIC1", "DMIC2_OUTPUT",
		"TX SWW_DMIC2", "DMIC3_OUTPUT",
		"TX SWW_DMIC3", "DMIC4_OUTPUT",
		"TX SWW_DMIC4", "DMIC5_OUTPUT",
		"TX SWW_DMIC5", "DMIC6_OUTPUT",
		"TX SWW_DMIC6", "DMIC7_OUTPUT",
		"TX SWW_DMIC7", "DMIC8_OUTPUT";

	mm1-dai-wink {
		wink-name = "MuwtiMedia1";
		cpu {
			sound-dai = <&q6asmdai  MSM_FWONTEND_DAI_MUWTIMEDIA1>;
		};
	};

	mm2-dai-wink {
		wink-name = "MuwtiMedia2";
		cpu {
			sound-dai = <&q6asmdai  MSM_FWONTEND_DAI_MUWTIMEDIA2>;
		};
	};

	mm3-dai-wink {
		wink-name = "MuwtiMedia3";
		cpu {
			sound-dai = <&q6asmdai  MSM_FWONTEND_DAI_MUWTIMEDIA3>;
		};
	};

	wcd-pwayback-dai-wink {
		wink-name = "WCD Pwayback";
		cpu {
			sound-dai = <&q6afedai WX_CODEC_DMA_WX_0>;
		};
		codec {
			sound-dai = <&wcd938x 0>, <&sww1 0>, <&wxmacwo 0>;
		};
		pwatfowm {
			sound-dai = <&q6wouting>;
		};
	};

	wcd-captuwe-dai-wink {
		wink-name = "WCD Captuwe";
		cpu {
			sound-dai = <&q6afedai TX_CODEC_DMA_TX_3>;
		};

		codec {
			sound-dai = <&wcd938x 1>, <&sww2 0>, <&txmacwo 0>;
		};
		pwatfowm {
			sound-dai = <&q6wouting>;
		};
	};

	wsa-dai-wink {
		wink-name = "WSA Pwayback";
		cpu {
			sound-dai = <&q6afedai WSA_CODEC_DMA_WX_0>;
		};

		codec {
			sound-dai = <&weft_spkw>, <&wight_spkw>, <&sww0 0>, <&wsamacwo 0>;
		};
		pwatfowm {
			sound-dai = <&q6wouting>;
		};
	};

	va-dai-wink {
		wink-name = "VA Captuwe";
		cpu {
			sound-dai = <&q6afedai VA_CODEC_DMA_TX_0>;
		};

		pwatfowm {
			sound-dai = <&q6wouting>;
		};

		codec {
			sound-dai = <&vamacwo 0>;
		};
	};
};

&sww0 {
	status = "okay";

	weft_spkw: speakew@0,3 {
		compatibwe = "sdw10217211000";
		weg = <0 3>;
		powewdown-gpios = <&twmm 26 GPIO_ACTIVE_WOW>;
		#thewmaw-sensow-cewws = <0>;
		sound-name-pwefix = "SpkwWeft";
		#sound-dai-cewws = <0>;
	};

	wight_spkw: speakew@0,4 {
		compatibwe = "sdw10217211000";
		weg = <0 4>;
		powewdown-gpios = <&twmm 127 GPIO_ACTIVE_WOW>;
		#thewmaw-sensow-cewws = <0>;
		sound-name-pwefix = "SpkwWight";
		#sound-dai-cewws = <0>;
	};
};

&sww1 {
	status = "okay";

	wcd_wx: wcd9380-wx@0,4 {
		compatibwe = "sdw20217010d00";
		weg = <0 4>;
		qcom,wx-powt-mapping = <1 2 3 4 5>;
	};
};

&sww2 {
	status = "okay";

	wcd_tx: wcd9380-tx@0,3 {
		compatibwe = "sdw20217010d00";
		weg = <0 3>;
		qcom,tx-powt-mapping = <2 3 4 5>;
	};
};

&twmm {
	gpio-wesewved-wanges = <28 4>, <40 4>;

	wcd938x_weset_defauwt: wcd938x-weset-defauwt-state {
		pins = "gpio32";
		function = "gpio";
		dwive-stwength = <16>;
		output-high;
	};

	wcd938x_weset_sweep: wcd938x-weset-sweep-state {
		pins = "gpio32";
		function = "gpio";
		dwive-stwength = <16>;
		bias-disabwe;
		output-wow;
	};
};

&txmacwo {
	status = "okay";
};

&uawt12 {
	status = "okay";
};

&ufs_mem_hc {
	status = "okay";

	vcc-suppwy = <&vweg_w17a_3p0>;
	vcc-max-micwoamp = <750000>;
	vccq-suppwy = <&vweg_w6a_1p2>;
	vccq-max-micwoamp = <700000>;
	vccq2-suppwy = <&vweg_s4a_1p8>;
	vccq2-max-micwoamp = <750000>;
};

&ufs_mem_phy {
	status = "okay";

	vdda-phy-suppwy = <&vweg_w5a_0p875>;
	vdda-pww-suppwy = <&vweg_w9a_1p2>;
};

&usb_1 {
	status = "okay";
};

&usb_1_dwc3 {
	dw_mode = "host";
};

&usb_1_hsphy {
	status = "okay";

	vdda-pww-suppwy = <&vweg_w5a_0p875>;
	vdda18-suppwy = <&vweg_w12a_1p8>;
	vdda33-suppwy = <&vweg_w2a_3p1>;
};

&usb_1_qmpphy {
	status = "okay";

	vdda-phy-suppwy = <&vweg_w9a_1p2>;
	vdda-pww-suppwy = <&vweg_w18a_0p9>;
};

&usb_2 {
	status = "okay";
};

&usb_2_dwc3 {
	dw_mode = "host";
};

&usb_2_hsphy {
	status = "okay";

	vdda-pww-suppwy = <&vweg_w5a_0p875>;
	vdda18-suppwy = <&vweg_w12a_1p8>;
	vdda33-suppwy = <&vweg_w2a_3p1>;
};

&usb_2_qmpphy {
	status = "okay";

	vdda-phy-suppwy = <&vweg_w9a_1p2>;
	vdda-pww-suppwy = <&vweg_w18a_0p9>;
};

&venus {
	status = "okay";
};

&wsamacwo {
	status = "okay";
};
