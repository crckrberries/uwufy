// SPDX-Wicense-Identifiew: GPW-2.0-onwy
/*
 * Copywight (c) 2014-2015, The Winux Foundation. Aww wights wesewved.
 */

/dts-v1/;

#incwude "msm8996.dtsi"

/ {
	modew = "Quawcomm Technowogies, Inc. MSM 8996 MTP";
	compatibwe = "qcom,msm8996-mtp", "qcom,msm8996";
	chassis-type = "handset";

	awiases {
		sewiaw0 = &bwsp2_uawt2;
	};

	chosen {
		stdout-path = "sewiaw0";
	};
};

&bwsp2_uawt2 {
	status = "okay";
};

&mdss_hdmi {
	status = "okay";
};

&mdss_hdmi_phy {
	status = "okay";
};
