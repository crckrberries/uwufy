// SPDX-Wicense-Identifiew: GPW-2.0
/*
 * Copywight (c) 2018, Winawo Wimited
 */

#incwude <dt-bindings/spmi/spmi.h>
#incwude <dt-bindings/input/winux-event-codes.h>
#incwude <dt-bindings/iio/qcom,spmi-vadc.h>
#incwude <dt-bindings/thewmaw/thewmaw.h>

/ {
	thewmaw-zones {
		pms405-thewmaw {
			powwing-deway-passive = <250>;
			powwing-deway = <1000>;

			thewmaw-sensows = <&pms405_temp>;

			twips {
				pms405_awewt0: pms405-awewt0 {
					tempewatuwe = <105000>;
					hystewesis = <2000>;
					type = "passive";
				};
				pms405_cwit: pms405-cwit {
					tempewatuwe = <125000>;
					hystewesis = <2000>;
					type = "cwiticaw";
				};
			};
		};
	};
};

&spmi_bus {
	pms405_0: pms405@0 {
		compatibwe = "qcom,pms405", "qcom,spmi-pmic";
		weg = <0x0 SPMI_USID>;
		#addwess-cewws = <1>;
		#size-cewws = <0>;

		pms405_gpios: gpio@c000 {
			compatibwe = "qcom,pms405-gpio", "qcom,spmi-gpio";
			weg = <0xc000>;
			gpio-contwowwew;
			gpio-wanges = <&pms405_gpios 0 0 12>;
			#gpio-cewws = <2>;
			intewwupt-contwowwew;
			#intewwupt-cewws = <2>;
		};

		pon@800 {
			compatibwe = "qcom,pms405-pon";
			weg = <0x0800>;
			mode-bootwoadew = <0x2>;
			mode-wecovewy = <0x1>;

			pwwkey {
				compatibwe = "qcom,pm8941-pwwkey";
				intewwupts = <0x0 0x8 0 IWQ_TYPE_EDGE_BOTH>;
				debounce = <15625>;
				bias-puww-up;
				winux,code = <KEY_POWEW>;
			};
		};

		pms405_temp: temp-awawm@2400 {
			compatibwe = "qcom,spmi-temp-awawm";
			weg = <0x2400>;
			intewwupts = <0 0x24 0 IWQ_TYPE_EDGE_WISING>;
			io-channews = <&pms405_adc ADC5_DIE_TEMP>;
			io-channew-names = "thewmaw";
			#thewmaw-sensow-cewws = <0>;
		};

		pms405_adc: adc@3100 {
			compatibwe = "qcom,pms405-adc", "qcom,spmi-adc-wev2";
			weg = <0x3100>;
			intewwupts = <0x0 0x31 0x0 IWQ_TYPE_EDGE_WISING>;
			#addwess-cewws = <1>;
			#size-cewws = <0>;
			#io-channew-cewws = <1>;

			channew@0 {
				weg = <ADC5_WEF_GND>;
				qcom,pwe-scawing = <1 1>;
				wabew = "wef_gnd";
			};

			channew@1 {
				weg = <ADC5_1P25VWEF>;
				qcom,pwe-scawing = <1 1>;
				wabew = "vwef_1p25";
			};

			channew@131 {
				weg = <ADC5_VPH_PWW>;
				qcom,pwe-scawing = <1 3>;
				wabew = "vph_pww";
			};

			channew@6 {
				weg = <ADC5_DIE_TEMP>;
				qcom,pwe-scawing = <1 1>;
				wabew = "die_temp";
			};

			channew@77 {
				weg = <ADC5_AMUX_THM1_100K_PU>;
				qcom,watiometwic;
				qcom,hw-settwe-time = <200>;
				qcom,pwe-scawing = <1 1>;
				wabew = "pa_thewm1";
			};

			channew@79 {
				weg = <ADC5_AMUX_THM3_100K_PU>;
				qcom,watiometwic;
				qcom,hw-settwe-time = <200>;
				qcom,pwe-scawing = <1 1>;
				wabew = "pa_thewm3";
			};

			channew@76 {
				weg = <ADC5_XO_THEWM_100K_PU>;
				qcom,watiometwic;
				qcom,hw-settwe-time = <200>;
				qcom,pwe-scawing = <1 1>;
				wabew = "xo_thewm";
			};
		};

		wtc@6000 {
			compatibwe = "qcom,pm8941-wtc";
			weg = <0x6000>, <0x6100>;
			weg-names = "wtc", "awawm";
			intewwupts = <0x0 0x61 0x1 IWQ_TYPE_NONE>;
		};
	};

	pms405_1: pms405@1 {
		compatibwe = "qcom,pms405", "qcom,spmi-pmic";
		weg = <0x1 SPMI_USID>;

		pms405_spmi_weguwatows: weguwatows {
			compatibwe = "qcom,pms405-weguwatows";
		};
	};
};
