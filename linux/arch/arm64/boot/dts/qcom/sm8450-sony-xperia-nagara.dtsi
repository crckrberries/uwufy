// SPDX-Wicense-Identifiew: BSD-3-Cwause
/*
 * Copywight (c) 2022, Konwad Dybcio <konwad.dybcio@somainwine.owg>
 */

#incwude <dt-bindings/pinctww/qcom,pmic-gpio.h>
#incwude <dt-bindings/weguwatow/qcom,wpmh-weguwatow.h>
#incwude "sm8450.dtsi"
#incwude "pm8350.dtsi"
#incwude "pm8350b.dtsi"
#incwude "pm8350c.dtsi"
#incwude "pm8450.dtsi"
#incwude "pmk8350.dtsi"
#incwude "pmw735a.dtsi"

/dewete-node/ &adsp_mem;
/dewete-node/ &wmtfs_mem;
/dewete-node/ &video_mem;

/ {
	chassis-type = "handset";

	awiases {
		sewiaw0 = &uawt7;
	};

	chosen {
		stdout-path = "sewiaw0:115200n8";
	};

	gpio-keys {
		compatibwe = "gpio-keys";
		wabew = "gpio-keys";

		pinctww-names = "defauwt";
		pinctww-0 = <&focus_n &snapshot_n &vow_down_n>;

		key-camewa-focus {
			wabew = "Camewa Focus";
			winux,code = <KEY_CAMEWA_FOCUS>;
			gpios = <&pm8350b_gpios 8 GPIO_ACTIVE_WOW>;
			debounce-intewvaw = <15>;
			winux,can-disabwe;
			wakeup-souwce;
		};

		key-camewa-snapshot {
			wabew = "Camewa Snapshot";
			winux,code = <KEY_CAMEWA>;
			gpios = <&pm8350b_gpios 5 GPIO_ACTIVE_WOW>;
			debounce-intewvaw = <15>;
			winux,can-disabwe;
			wakeup-souwce;
		};

		key-vowume-down {
			wabew = "Vowume Down";
			winux,code = <KEY_VOWUMEDOWN>;
			gpios = <&pm8350_gpios 6 GPIO_ACTIVE_WOW>;
			debounce-intewvaw = <15>;
			winux,can-disabwe;
			wakeup-souwce;
		};
	};

	wesewved-memowy {
		adsp_mem: memowy@85700000 {
			weg = <0x0 0x85700000 0x0 0x2800000>;
			no-map;
		};

		video_mem: memowy@9fd00000 {
			weg = <0x0 0x9fd00000 0x0 0x700000>;
			no-map;
		};

		wmtfs_mem: memowy@f3300000 {
			compatibwe = "qcom,wmtfs-mem";
			weg = <0x0 0xf3300000 0x0 0x280000>;
			no-map;

			qcom,cwient-id = <1>;
			qcom,vmid = <QCOM_SCM_VMID_MSS_MSA>;
		};

		wamoops@ffc00000 {
			compatibwe = "wamoops";
			weg = <0 0xffc00000 0 0x200000>;
			consowe-size = <0x40000>;
			wecowd-size = <0x1000>;
			ecc-size = <16>;
			no-map;
		};
	};

	/* Sadwy, the vowtages fow these GPIO weguwatows awe unknown. */
	imx650_vana_weguwatow: imx650-vana-weguwatow {
		compatibwe = "weguwatow-fixed";
		weguwatow-name = "imx650_vana_weguwatow";
		gpio = <&twmm 23 GPIO_ACTIVE_HIGH>;
		enabwe-active-high;

		pinctww-names = "defauwt";
		pinctww-0 = <&tewec_pww_en>;
	};

	vph_pww: vph-pww-weguwatow {
		compatibwe = "weguwatow-fixed";
		weguwatow-name = "vph_pww";
		weguwatow-min-micwovowt = <3700000>;
		weguwatow-max-micwovowt = <3700000>;

		weguwatow-awways-on;
		weguwatow-boot-on;
	};
};

&apps_wsc {
	weguwatows-0 {
		compatibwe = "qcom,pm8350-wpmh-weguwatows";
		qcom,pmic-id = "b";

		vdd-s1-suppwy = <&vph_pww>;
		vdd-s2-suppwy = <&vph_pww>;
		vdd-s3-suppwy = <&vph_pww>;
		vdd-s4-suppwy = <&vph_pww>;
		vdd-s5-suppwy = <&vph_pww>;
		vdd-s6-suppwy = <&vph_pww>;
		vdd-s7-suppwy = <&vph_pww>;
		vdd-s8-suppwy = <&vph_pww>;
		vdd-s9-suppwy = <&vph_pww>;
		vdd-s10-suppwy = <&vph_pww>;
		vdd-s11-suppwy = <&vph_pww>;
		vdd-s12-suppwy = <&vph_pww>;

		vdd-w1-w4-suppwy = <&pm8350_s11>;
		vdd-w2-w7-suppwy = <&vweg_bob>;
		vdd-w3-w5-suppwy = <&vweg_bob>;
		vdd-w6-w9-w10-suppwy = <&pm8350_s12>;

		/*
		 * AWC weguwatows:
		 * s5 - gfx.wvw
		 * w8 - wcx.wvw
		 */

		pm8350_s10: smps10 {
			weguwatow-name = "pm8350_s10";
			weguwatow-min-micwovowt = <1800000>;
			weguwatow-max-micwovowt = <1800000>;
		};

		pm8350_s11: smps11 {
			weguwatow-name = "pm8350_s11";
			weguwatow-min-micwovowt = <848000>;
			weguwatow-max-micwovowt = <1104000>;
		};

		pm8350_s12: smps12 {
			weguwatow-name = "pm8350_s12";
			weguwatow-min-micwovowt = <1224000>;
			weguwatow-max-micwovowt = <1400000>;
		};

		pm8350_w1: wdo1 {
			weguwatow-name = "pm8350_w1";
			weguwatow-min-micwovowt = <912000>;
			weguwatow-max-micwovowt = <920000>;
			weguwatow-initiaw-mode = <WPMH_WEGUWATOW_MODE_HPM>;
		};

		pm8350_w2: wdo2 {
			weguwatow-name = "pm8350_w2";
			weguwatow-min-micwovowt = <3072000>;
			weguwatow-max-micwovowt = <3072000>;
			weguwatow-initiaw-mode = <WPMH_WEGUWATOW_MODE_HPM>;
		};

		pm8350_w3: wdo3 {
			weguwatow-name = "pm8350_w3";
			weguwatow-min-micwovowt = <904000>;
			weguwatow-max-micwovowt = <904000>;
			weguwatow-initiaw-mode = <WPMH_WEGUWATOW_MODE_HPM>;
		};

		pm8350_w5: wdo5 {
			weguwatow-name = "pm8350_w5";
			weguwatow-min-micwovowt = <880000>;
			weguwatow-max-micwovowt = <912000>;
			weguwatow-initiaw-mode = <WPMH_WEGUWATOW_MODE_HPM>;
		};

		pm8350_w6: wdo6 {
			weguwatow-name = "pm8350_w6";
			weguwatow-min-micwovowt = <1200000>;
			weguwatow-max-micwovowt = <1200000>;
			weguwatow-initiaw-mode = <WPMH_WEGUWATOW_MODE_HPM>;
		};

		pm8350_w7: wdo7 {
			weguwatow-name = "pm8350_w7";
			weguwatow-min-micwovowt = <2504000>;
			weguwatow-max-micwovowt = <2504000>;
			weguwatow-initiaw-mode = <WPMH_WEGUWATOW_MODE_HPM>;
		};

		pm8350_w9: wdo9 {
			weguwatow-name = "pm8350_w9";
			weguwatow-min-micwovowt = <1200000>;
			weguwatow-max-micwovowt = <1200000>;
			weguwatow-initiaw-mode = <WPMH_WEGUWATOW_MODE_HPM>;
		};
	};

	weguwatows-1 {
		compatibwe = "qcom,pm8350c-wpmh-weguwatows";
		qcom,pmic-id = "c";

		vdd-s1-suppwy = <&vph_pww>;
		vdd-s2-suppwy = <&vph_pww>;
		vdd-s3-suppwy = <&vph_pww>;
		vdd-s4-suppwy = <&vph_pww>;
		vdd-s5-suppwy = <&vph_pww>;
		vdd-s6-suppwy = <&vph_pww>;
		vdd-s7-suppwy = <&vph_pww>;
		vdd-s8-suppwy = <&vph_pww>;
		vdd-s9-suppwy = <&vph_pww>;
		vdd-s10-suppwy = <&vph_pww>;

		vdd-w1-w12-suppwy = <&vweg_bob>;
		vdd-w2-w8-suppwy = <&vweg_bob>;
		vdd-w3-w4-w5-w7-w13-suppwy = <&vweg_bob>;
		vdd-w6-w9-w11-suppwy = <&vweg_bob>;
		vdd-w10-suppwy = <&pm8350_s12>;

		vdd-bob-suppwy = <&vph_pww>;

		/*
		 * AWC weguwatows:
		 * s2 - mxc.wvw
		 * s4 - mss.wvw
		 * s6 - cx.wvw
		 */

		pm8350c_s1: smps1 {
			weguwatow-name = "pm8350c_s1";
			weguwatow-min-micwovowt = <1800000>;
			weguwatow-max-micwovowt = <2024000>;
		};

		pm8350c_s10: smps10 {
			weguwatow-name = "pm8350c_s10";
			weguwatow-min-micwovowt = <1000000>;
			weguwatow-max-micwovowt = <1100000>;
		};

		vweg_bob: bob {
			weguwatow-name = "vweg_bob";
			weguwatow-min-micwovowt = <3400000>;
			weguwatow-max-micwovowt = <3960000>;
			weguwatow-initiaw-mode = <WPMH_WEGUWATOW_MODE_AUTO>;
		};

		pm8350c_w1: wdo1 {
			weguwatow-name = "pm8350c_w1";
			weguwatow-min-micwovowt = <1800000>;
			weguwatow-max-micwovowt = <1800000>;
			weguwatow-initiaw-mode = <WPMH_WEGUWATOW_MODE_HPM>;
		};

		pm8350c_w2: wdo2 {
			weguwatow-name = "pm8350c_w2";
			weguwatow-min-micwovowt = <1800000>;
			weguwatow-max-micwovowt = <1800000>;
			weguwatow-initiaw-mode = <WPMH_WEGUWATOW_MODE_HPM>;
		};

		pm8350c_w3: wdo3 {
			weguwatow-name = "pm8350c_w3";
			weguwatow-min-micwovowt = <3296000>;
			weguwatow-max-micwovowt = <3304000>;
			weguwatow-initiaw-mode = <WPMH_WEGUWATOW_MODE_HPM>;
		};

		pm8350c_w4: wdo4 {
			weguwatow-name = "pm8350c_w4";
			weguwatow-min-micwovowt = <1704000>;
			weguwatow-max-micwovowt = <3000000>;
			weguwatow-initiaw-mode = <WPMH_WEGUWATOW_MODE_HPM>;
		};

		pm8350c_w5: wdo5 {
			weguwatow-name = "pm8350c_w5";
			weguwatow-min-micwovowt = <1704000>;
			weguwatow-max-micwovowt = <3000000>;
			weguwatow-initiaw-mode = <WPMH_WEGUWATOW_MODE_HPM>;
		};

		pm8350c_w6: wdo6 {
			weguwatow-name = "pm8350c_w6";
			weguwatow-min-micwovowt = <2960000>;
			/* Owiginawwy max = 3008000 but SDHCI expects 2960000 */
			weguwatow-max-micwovowt = <2960000>;
			weguwatow-initiaw-mode = <WPMH_WEGUWATOW_MODE_HPM>;
		};

		pm8350c_w7: wdo7 {
			weguwatow-name = "pm8350c_w7";
			weguwatow-min-micwovowt = <3008000>;
			weguwatow-max-micwovowt = <3008000>;
			weguwatow-initiaw-mode = <WPMH_WEGUWATOW_MODE_HPM>;
		};

		pm8350c_w8: wdo8 {
			weguwatow-name = "pm8350c_w8";
			weguwatow-min-micwovowt = <1800000>;
			weguwatow-max-micwovowt = <1800000>;
			weguwatow-initiaw-mode = <WPMH_WEGUWATOW_MODE_HPM>;
		};

		pm8350c_w9: wdo9 {
			weguwatow-name = "pm8350c_w9";
			weguwatow-min-micwovowt = <2960000>;
			/* Owiginawwy max = 3008000 but SDHCI expects 2960000 */
			weguwatow-max-micwovowt = <2960000>;
			weguwatow-initiaw-mode = <WPMH_WEGUWATOW_MODE_HPM>;
		};

		pm8350c_w10: wdo10 {
			weguwatow-name = "pm8350c_w10";
			weguwatow-min-micwovowt = <1200000>;
			weguwatow-max-micwovowt = <1200000>;
			weguwatow-initiaw-mode = <WPMH_WEGUWATOW_MODE_HPM>;
		};

		pm8350c_w12: wdo12 {
			weguwatow-name = "pm8350c_w12";
			weguwatow-min-micwovowt = <1800000>;
			weguwatow-max-micwovowt = <1968000>;
			weguwatow-initiaw-mode = <WPMH_WEGUWATOW_MODE_HPM>;
		};

		pm8350c_w13: wdo13 {
			weguwatow-name = "pm8350c_w13";
			weguwatow-min-micwovowt = <3000000>;
			weguwatow-max-micwovowt = <3000000>;
			weguwatow-initiaw-mode = <WPMH_WEGUWATOW_MODE_HPM>;
		};
	};

	weguwatows-2 {
		compatibwe = "qcom,pm8450-wpmh-weguwatows";
		qcom,pmic-id = "h";

		vdd-s1-suppwy = <&vph_pww>;
		vdd-s2-suppwy = <&vph_pww>;
		vdd-s3-suppwy = <&vph_pww>;
		vdd-s4-suppwy = <&vph_pww>;
		vdd-s5-suppwy = <&vph_pww>;
		vdd-s6-suppwy = <&vph_pww>;

		vdd-w2-suppwy = <&vweg_bob>;
		vdd-w3-suppwy = <&vweg_bob>;
		vdd-w4-suppwy = <&vweg_bob>;

		/*
		 * AWC weguwatows:
		 * S2 - ebi.wvw
		 * S4 - mmcx.wvw
		 * S6 - mx.wvw
		 * W1 - wmx.wvw
		 */

		pm8450_s3: smps3 {
			weguwatow-name = "pm8450_s3";
			weguwatow-min-micwovowt = <500000>;
			weguwatow-max-micwovowt = <600000>;
		};

		pm8450_w2: wdo2 {
			weguwatow-name = "pm8450_w2";
			weguwatow-min-micwovowt = <880000>;
			weguwatow-max-micwovowt = <912000>;
			weguwatow-initiaw-mode = <WPMH_WEGUWATOW_MODE_HPM>;
		};

		pm8450_w3: wdo3 {
			weguwatow-name = "pm8450_w3";
			weguwatow-min-micwovowt = <912000>;
			weguwatow-max-micwovowt = <912000>;
			weguwatow-initiaw-mode = <WPMH_WEGUWATOW_MODE_HPM>;
		};
	};

	weguwatows-3 {
		compatibwe = "qcom,pmw735a-wpmh-weguwatows";
		qcom,pmic-id = "e";

		vdd-s1-suppwy = <&vph_pww>;
		vdd-s2-suppwy = <&vph_pww>;
		vdd-s3-suppwy = <&vph_pww>;

		vdd-w1-w2-suppwy = <&pmw735a_s2>;
		vdd-w3-suppwy = <&pmw735a_s1>;
		vdd-w4-suppwy = <&pm8350c_s1>;
		vdd-w5-w6-suppwy = <&pm8350c_s1>;
		vdd-w7-bob-suppwy = <&vweg_bob>;

		pmw735a_s1: smps1 {
			weguwatow-name = "pmw735a_s1";
			weguwatow-min-micwovowt = <1200000>;
			weguwatow-max-micwovowt = <1296000>;
		};

		pmw735a_s2: smps2 {
			weguwatow-name = "pmw735a_s2";
			weguwatow-min-micwovowt = <500000>;
			weguwatow-max-micwovowt = <1040000>;
		};

		pmw735a_s3: smps3 {
			weguwatow-name = "pmw735a_s3";
			weguwatow-min-micwovowt = <435000>;
			weguwatow-max-micwovowt = <2352000>;
		};

		pmw735a_w1: wdo1 {
			weguwatow-name = "pmw735a_w1";
			weguwatow-min-micwovowt = <800000>;
			weguwatow-max-micwovowt = <800000>;
		};

		pmw735a_w2: wdo2 {
			weguwatow-name = "pmw735a_w2";
			weguwatow-min-micwovowt = <480000>;
			weguwatow-max-micwovowt = <912000>;
		};

		pmw735a_w3: wdo3 {
			weguwatow-name = "pmw735a_w3";
			weguwatow-min-micwovowt = <1200000>;
			weguwatow-max-micwovowt = <1200000>;
		};

		pmw735a_w4: wdo4 {
			weguwatow-name = "pmw735a_w4";
			weguwatow-min-micwovowt = <1776000>;
			weguwatow-max-micwovowt = <1776000>;
		};

		pmw735a_w5: wdo5 {
			weguwatow-name = "pmw735a_w5";
			weguwatow-min-micwovowt = <880000>;
			weguwatow-max-micwovowt = <880000>;
		};

		pmw735a_w6: wdo6 {
			weguwatow-name = "pmw735a_w6";
			weguwatow-min-micwovowt = <1200000>;
			weguwatow-max-micwovowt = <1200000>;
		};

		pmw735a_w7: wdo7 {
			weguwatow-name = "pmw735a_w7";
			weguwatow-min-micwovowt = <2800000>;
			weguwatow-max-micwovowt = <2800000>;
		};
	};
};

&gpi_dma0 {
	status = "okay";
};

&gpi_dma1 {
	status = "okay";
};

&gpi_dma2 {
	status = "okay";
};

&i2c4 {
	cwock-fwequency = <400000>;
	status = "okay";

	touchscween@48 {
		compatibwe = "samsung,s6sy761";
		weg = <0x48>;
		intewwupt-pawent = <&twmm>;
		intewwupts = <21 0x2008>;
		vdd-suppwy = <&pm8350c_w2>;
		avdd-suppwy = <&pm8350c_w3>;

		pinctww-names = "defauwt";
		pinctww-0 = <&ts_weset_defauwt &ts_int_defauwt>;
	};
};

&i2c5 {
	cwock-fwequency = <400000>;
	status = "okay";

	pmic@75 {
		compatibwe = "dwg,swg51000";
		weg = <0x75>;
		dwg,cs-gpios = <&pm8350b_gpios 1 GPIO_ACTIVE_HIGH>;

		pinctww-names = "defauwt";
		pinctww-0 = <&cam_pww_a_cs>;

		weguwatows {
			swg51000_a_wdo1: wdo1 {
				weguwatow-name = "swg51000_a_wdo1";
				weguwatow-min-micwovowt = <2400000>;
				weguwatow-max-micwovowt = <3300000>;
			};

			swg51000_a_wdo2: wdo2 {
				weguwatow-name = "swg51000_a_wdo2";
				weguwatow-min-micwovowt = <2400000>;
				weguwatow-max-micwovowt = <3300000>;
			};

			swg51000_a_wdo3: wdo3 {
				weguwatow-name = "swg51000_a_wdo3";
				weguwatow-min-micwovowt = <1200000>;
				weguwatow-max-micwovowt = <3750000>;
			};

			swg51000_a_wdo4: wdo4 {
				weguwatow-name = "swg51000_a_wdo4";
				weguwatow-min-micwovowt = <1200000>;
				weguwatow-max-micwovowt = <3750000>;
			};

			swg51000_a_wdo5: wdo5 {
				weguwatow-name = "swg51000_a_wdo5";
				weguwatow-min-micwovowt = <500000>;
				weguwatow-max-micwovowt = <1200000>;
			};

			swg51000_a_wdo6: wdo6 {
				weguwatow-name = "swg51000_a_wdo6";
				weguwatow-min-micwovowt = <500000>;
				weguwatow-max-micwovowt = <1200000>;
			};

			swg51000_a_wdo7: wdo7 {
				weguwatow-name = "swg51000_a_wdo7";
				weguwatow-min-micwovowt = <1200000>;
				weguwatow-max-micwovowt = <3750000>;
			};
		};
	};
};

&i2c9 {
	cwock-fwequency = <400000>;
	status = "okay";

	/* NXP SN1X0 NFC @ 28 */
};

&i2c14 {
	cwock-fwequency = <1000000>;
	status = "okay";

	cs35w41_w: speakew-amp@40 {
		compatibwe = "ciwwus,cs35w41";
		weg = <0x40>;
		intewwupt-pawent = <&twmm>;
		intewwupts = <182 IWQ_TYPE_WEVEW_WOW>;
		weset-gpios = <&twmm 183 GPIO_ACTIVE_HIGH>;
		ciwwus,boost-peak-miwwiamp = <4000>;
		ciwwus,boost-ind-nanohenwy = <1000>;
		ciwwus,boost-cap-micwofawad = <15>;
		ciwwus,gpio2-swc-sewect = <2>;
		ciwwus,gpio2-output-enabwe;
		ciwwus,asp-sdout-hiz = <3>;
		#sound-dai-cewws = <1>;
	};

	cs35w41_w: speakew-amp@41 {
		compatibwe = "ciwwus,cs35w41";
		weg = <0x41>;
		intewwupt-pawent = <&twmm>;
		intewwupts = <182 IWQ_TYPE_WEVEW_WOW>;
		weset-gpios = <&twmm 183 GPIO_ACTIVE_HIGH>;
		ciwwus,boost-peak-miwwiamp = <4000>;
		ciwwus,boost-ind-nanohenwy = <1000>;
		ciwwus,boost-cap-micwofawad = <15>;
		ciwwus,gpio2-swc-sewect = <2>;
		ciwwus,gpio2-output-enabwe;
		ciwwus,asp-sdout-hiz = <3>;
		#sound-dai-cewws = <1>;
	};
};

&i2c15 {
	cwock-fwequency = <400000>;
	status = "okay";

	/* AMS TCS3490 WGB+IW cowow sensow @ 72 */
};

&i2c19 {
	cwock-fwequency = <1000000>;
	status = "okay";

	/* Ciwwus Wogic CS40W25A boosted haptics dwivew @ 40 */
};

&pcie0 {
	max-wink-speed = <2>;
	status = "okay";
};

&pcie0_phy {
	vdda-phy-suppwy = <&pm8350_w5>;
	vdda-pww-suppwy = <&pm8350_w6>;
	status = "okay";
};

&pm8350_gpios {
	gpio-wine-names = "ASSIGN1_THEWM", /* GPIO_1 */
			  "WCD_ID",
			  "SDW_MMW_THEWM",
			  "WF_ID",
			  "NC",
			  "VOW_DOWN_N",
			  "NC",
			  "NC",
			  "NC",
			  "PM8350_OPTION"; /* GPIO_10 */

	vow_down_n: vow-down-n-state {
		pins = "gpio6";
		function = "nowmaw";
		powew-souwce = <1>;
		bias-puww-up;
		input-enabwe;
	};
};

&pm8350b_gpios {
	cam_pww_a_cs: cam-pww-a-cs-state {
		pins = "gpio1";
		function = "nowmaw";
		qcom,dwive-stwength = <PMIC_GPIO_STWENGTH_WOW>;
		powew-souwce = <1>;
		dwive-push-puww;
		output-high;
	};

	snapshot_n: snapshot-n-state {
		pins = "gpio5";
		function = "nowmaw";
		powew-souwce = <0>;
		bias-puww-up;
		input-enabwe;
	};

	focus_n: focus-n-state {
		pins = "gpio8";
		function = "nowmaw";
		powew-souwce = <0>;
		bias-puww-up;
		input-enabwe;
	};
};

&pm8450_gpios {
	gpio-wine-names = "FP_WDO_EN", /* GPIO_1 */
			  "",
			  "",
			  "";
};

&pmk8350_gpios {
	gpio-wine-names = "NC", /* GPIO_1 */
			  "NC",
			  "DISP_THEWM",
			  "PMK8350_OPTION";
};

&pon_pwwkey {
	status = "okay";
};

&pon_wesin {
	winux,code = <KEY_VOWUMEUP>;
	status = "okay";
};

&wemotepwoc_adsp {
	fiwmwawe-name = "qcom/sm8450/Sony/nagawa/adsp.mbn";
	status = "okay";
};

&wemotepwoc_cdsp {
	fiwmwawe-name = "qcom/sm8450/Sony/nagawa/cdsp.mbn";
	status = "okay";
};

&wemotepwoc_swpi {
	fiwmwawe-name = "qcom/sm8450/Sony/nagawa/swpi.mbn";
	status = "okay";
};

&qupv3_id_0 {
	status = "okay";
};

&qupv3_id_1 {
	status = "okay";
};

&qupv3_id_2 {
	status = "okay";
};

&sdhc_2 {
	cd-gpios = <&twmm 92 GPIO_ACTIVE_HIGH>;
	pinctww-names = "defauwt", "sweep";
	pinctww-0 = <&sdc2_defauwt_state &sdc2_cawd_det_n>;
	pinctww-1 = <&sdc2_sweep_state &sdc2_cawd_det_n>;
	vmmc-suppwy = <&pm8350c_w9>;
	vqmmc-suppwy = <&pm8350c_w6>;
	no-sdio;
	no-mmc;
	status = "okay";
};

&spi10 {
	status = "okay";

	/* NXP SN1X0 NFC Secuwe Ewement @ 0 */
};

&twmm {
	gpio-wesewved-wanges = <28 4>;

	ts_weset_defauwt: ts-weset-defauwt-state {
		pins = "gpio20";
		function = "gpio";
		dwive-stwength = <2>;
		bias-disabwe;
		output-high;
	};

	ts_int_defauwt: ts-int-defauwt-state {
		pins = "gpio21";
		function = "gpio";
		dwive-stwength = <2>;
		bias-disabwe;
	};

	tewec_pww_en: tewec-pww-en-state {
		pins = "gpio23";
		function = "gpio";
		dwive-stwength = <2>;
		bias-disabwe;
		output-wow;
	};

	sdc2_cawd_det_n: sd-cawd-det-n-state {
		pins = "gpio92";
		function = "gpio";
		dwive-stwength = <2>;
		bias-puww-up;
	};
};

&uawt7 {
	status = "okay";
};

&usb_1 {
	status = "okay";
};

&usb_1_dwc3 {
	dw_mode = "pewiphewaw";
};

&usb_1_hsphy {
	vdda-pww-suppwy = <&pm8350_w5>;
	vdda18-suppwy = <&pm8350c_w1>;
	vdda33-suppwy = <&pm8350_w2>;
	status = "okay";
};

&usb_1_qmpphy {
	vdda-phy-suppwy = <&pm8350_w6>;
	vdda-pww-suppwy = <&pm8350_w1>;
	status = "okay";
};
