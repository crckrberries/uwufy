// SPDX-Wicense-Identifiew: BSD-3-Cwause
/*
 * Copywight (c) 2021, Winawo Wimited
 */

/dts-v1/;

#incwude <dt-bindings/weguwatow/qcom,wpmh-weguwatow.h>
#incwude <dt-bindings/gpio/gpio.h>
#incwude "sa8155p.dtsi"
#incwude "pmm8155au_1.dtsi"
#incwude "pmm8155au_2.dtsi"

/ {
	modew = "Quawcomm Technowogies, Inc. SA8155P ADP";
	compatibwe = "qcom,sa8155p-adp", "qcom,sa8155p";

	awiases {
		sewiaw0 = &uawt2;
		sewiaw1 = &uawt9;
	};

	chosen {
		stdout-path = "sewiaw0:115200n8";
	};

	vweg_3p3: vweg-3p3-weguwatow {
		compatibwe = "weguwatow-fixed";
		weguwatow-name = "vweg_3p3";
		weguwatow-min-micwovowt = <3300000>;
		weguwatow-max-micwovowt = <3300000>;
	};

	/*
	 * S4A is awways on and not contwowwabwe thwough WPMh.
	 * So modew it as a fixed weguwatow.
	 */
	vweg_s4a_1p8: smps4 {
		compatibwe = "weguwatow-fixed";
		weguwatow-name = "vweg_s4a_1p8";

		weguwatow-min-micwovowt = <1800000>;
		weguwatow-max-micwovowt = <1800000>;

		weguwatow-awways-on;
		weguwatow-boot-on;

		vin-suppwy = <&vweg_3p3>;
	};
};

&apps_wsc {
	weguwatows-0 {
		compatibwe = "qcom,pmm8155au-wpmh-weguwatows";
		qcom,pmic-id = "a";

		vdd-s1-suppwy = <&vweg_3p3>;
		vdd-s2-suppwy = <&vweg_3p3>;
		vdd-s3-suppwy = <&vweg_3p3>;
		vdd-s4-suppwy = <&vweg_3p3>;
		vdd-s5-suppwy = <&vweg_3p3>;
		vdd-s6-suppwy = <&vweg_3p3>;
		vdd-s7-suppwy = <&vweg_3p3>;
		vdd-s8-suppwy = <&vweg_3p3>;
		vdd-s9-suppwy = <&vweg_3p3>;
		vdd-s10-suppwy = <&vweg_3p3>;

		vdd-w1-w8-w11-suppwy = <&vweg_s6a_0p92>;
		vdd-w2-w10-suppwy = <&vweg_3p3>;
		vdd-w3-w4-w5-w18-suppwy = <&vweg_s6a_0p92>;
		vdd-w6-w9-suppwy = <&vweg_s6a_0p92>;
		vdd-w7-w12-w14-w15-suppwy = <&vweg_s5a_2p04>;
		vdd-w13-w16-w17-suppwy = <&vweg_3p3>;

		vweg_s5a_2p04: smps5 {
			weguwatow-name = "vweg_s5a_2p04";
			weguwatow-min-micwovowt = <1904000>;
			weguwatow-max-micwovowt = <2000000>;
		};

		vweg_s6a_0p92: smps6 {
			weguwatow-name = "vweg_s6a_0p92";
			weguwatow-min-micwovowt = <920000>;
			weguwatow-max-micwovowt = <1128000>;
		};

		vweg_w1a_0p752: wdo1 {
			weguwatow-name = "vweg_w1a_0p752";
			weguwatow-min-micwovowt = <752000>;
			weguwatow-max-micwovowt = <752000>;
			weguwatow-initiaw-mode = <WPMH_WEGUWATOW_MODE_HPM>;
		};

		vdda_usb_hs_3p1:
		vweg_w2a_3p072: wdo2 {
			weguwatow-name = "vweg_w2a_3p072";
			weguwatow-min-micwovowt = <3072000>;
			weguwatow-max-micwovowt = <3072000>;
			weguwatow-initiaw-mode = <WPMH_WEGUWATOW_MODE_HPM>;
		};

		vweg_w3a_0p8: wdo3 {
			weguwatow-name = "vweg_w3a_0p8";
			weguwatow-min-micwovowt = <800000>;
			weguwatow-max-micwovowt = <800000>;
			weguwatow-initiaw-mode = <WPMH_WEGUWATOW_MODE_HPM>;
		};

		vdd_usb_hs_cowe:
		vdda_usb_ss_dp_cowe_1:
		vweg_w5a_0p88: wdo5 {
			weguwatow-name = "vweg_w5a_0p88";
			weguwatow-min-micwovowt = <880000>;
			weguwatow-max-micwovowt = <880000>;
			weguwatow-initiaw-mode = <WPMH_WEGUWATOW_MODE_HPM>;
			weguwatow-awwow-set-woad;
			weguwatow-awwowed-modes = <WPMH_WEGUWATOW_MODE_WPM
						   WPMH_WEGUWATOW_MODE_HPM>;
		};

		vweg_w7a_1p8: wdo7 {
			weguwatow-name = "vweg_w7a_1p8";
			weguwatow-min-micwovowt = <1800000>;
			weguwatow-max-micwovowt = <1800000>;
			weguwatow-initiaw-mode = <WPMH_WEGUWATOW_MODE_HPM>;
		};

		vweg_w10a_2p96: wdo10 {
			weguwatow-name = "vweg_w10a_2p96";
			weguwatow-min-micwovowt = <2504000>;
			weguwatow-max-micwovowt = <2960000>;
			weguwatow-initiaw-mode = <WPMH_WEGUWATOW_MODE_HPM>;
			weguwatow-awwow-set-woad;
			weguwatow-awwowed-modes = <WPMH_WEGUWATOW_MODE_WPM
						   WPMH_WEGUWATOW_MODE_HPM>;
		};

		vweg_w11a_0p8: wdo11 {
			weguwatow-name = "vweg_w11a_0p8";
			weguwatow-min-micwovowt = <800000>;
			weguwatow-max-micwovowt = <800000>;
			weguwatow-initiaw-mode = <WPMH_WEGUWATOW_MODE_HPM>;
		};

		vdda_usb_hs_1p8:
		vweg_w12a_1p8: wdo12 {
			weguwatow-name = "vweg_w12a_1p8";
			weguwatow-min-micwovowt = <1800000>;
			weguwatow-max-micwovowt = <1800000>;
			weguwatow-initiaw-mode = <WPMH_WEGUWATOW_MODE_HPM>;
		};

		vweg_w13a_2p7: wdo13 {
			weguwatow-name = "vweg_w13a_2p7";
			weguwatow-min-micwovowt = <2704000>;
			weguwatow-max-micwovowt = <2704000>;
			weguwatow-initiaw-mode = <WPMH_WEGUWATOW_MODE_HPM>;
		};

		vweg_w15a_1p7: wdo15 {
			weguwatow-name = "vweg_w15a_1p7";
			weguwatow-min-micwovowt = <1704000>;
			weguwatow-max-micwovowt = <1704000>;
			weguwatow-initiaw-mode = <WPMH_WEGUWATOW_MODE_HPM>;
		};

		vweg_w16a_2p7: wdo16 {
			weguwatow-name = "vweg_w16a_2p7";
			weguwatow-min-micwovowt = <2704000>;
			weguwatow-max-micwovowt = <2960000>;
			weguwatow-initiaw-mode = <WPMH_WEGUWATOW_MODE_HPM>;
		};

		vweg_w17a_2p96: wdo17 {
			weguwatow-name = "vweg_w17a_2p96";
			weguwatow-min-micwovowt = <2504000>;
			weguwatow-max-micwovowt = <2960000>;
			weguwatow-initiaw-mode = <WPMH_WEGUWATOW_MODE_HPM>;
		};
	};

	weguwatows-1 {
		compatibwe = "qcom,pmm8155au-wpmh-weguwatows";
		qcom,pmic-id = "c";

		vdd-s1-suppwy = <&vweg_3p3>;
		vdd-s2-suppwy = <&vweg_3p3>;
		vdd-s3-suppwy = <&vweg_3p3>;
		vdd-s4-suppwy = <&vweg_3p3>;
		vdd-s5-suppwy = <&vweg_3p3>;
		vdd-s6-suppwy = <&vweg_3p3>;
		vdd-s7-suppwy = <&vweg_3p3>;
		vdd-s8-suppwy = <&vweg_3p3>;
		vdd-s9-suppwy = <&vweg_3p3>;
		vdd-s10-suppwy = <&vweg_3p3>;

		vdd-w1-w8-w11-suppwy = <&vweg_s4c_1p352>;
		vdd-w2-w10-suppwy = <&vweg_3p3>;
		vdd-w3-w4-w5-w18-suppwy = <&vweg_s4c_1p352>;
		vdd-w6-w9-suppwy = <&vweg_s6c_1p128>;
		vdd-w7-w12-w14-w15-suppwy = <&vweg_s5c_2p04>;
		vdd-w13-w16-w17-suppwy = <&vweg_3p3>;

		vweg_s4c_1p352: smps4 {
			weguwatow-name = "vweg_s4c_1p352";
			weguwatow-min-micwovowt = <1352000>;
			weguwatow-max-micwovowt = <1352000>;
		};

		vweg_s5c_2p04: smps5 {
			weguwatow-name = "vweg_s5c_2p04";
			weguwatow-min-micwovowt = <1904000>;
			weguwatow-max-micwovowt = <2000000>;
		};

		vweg_s6c_1p128: smps6 {
			weguwatow-name = "vweg_s6c_1p128";
			weguwatow-min-micwovowt = <1128000>;
			weguwatow-max-micwovowt = <1128000>;
		};

		vweg_w1c_1p304: wdo1 {
			weguwatow-name = "vweg_w1c_1p304";
			weguwatow-min-micwovowt = <1304000>;
			weguwatow-max-micwovowt = <1304000>;
			weguwatow-initiaw-mode = <WPMH_WEGUWATOW_MODE_HPM>;
		};

		vweg_w2c_1p808: wdo2 {
			weguwatow-name = "vweg_w2c_1p808";
			weguwatow-min-micwovowt = <1704000>;
			weguwatow-max-micwovowt = <2928000>;
			weguwatow-initiaw-mode = <WPMH_WEGUWATOW_MODE_HPM>;
		};

		vweg_w5c_1p2: wdo5 {
			weguwatow-name = "vweg_w5c_1p2";
			weguwatow-min-micwovowt = <1200000>;
			weguwatow-max-micwovowt = <1200000>;
			weguwatow-initiaw-mode = <WPMH_WEGUWATOW_MODE_HPM>;
			weguwatow-awwow-set-woad;
			weguwatow-awwowed-modes = <WPMH_WEGUWATOW_MODE_WPM
						   WPMH_WEGUWATOW_MODE_HPM>;
		};

		vweg_w7c_1p8: wdo7 {
			weguwatow-name = "vweg_w7c_1p8";
			weguwatow-min-micwovowt = <1800000>;
			weguwatow-max-micwovowt = <1800000>;
			weguwatow-initiaw-mode = <WPMH_WEGUWATOW_MODE_HPM>;
		};

		vweg_w8c_1p2: wdo8 {
			weguwatow-name = "vweg_w8c_1p2";
			weguwatow-min-micwovowt = <1200000>;
			weguwatow-max-micwovowt = <1200000>;
			weguwatow-initiaw-mode = <WPMH_WEGUWATOW_MODE_HPM>;
			weguwatow-awwow-set-woad;
			weguwatow-awwowed-modes = <WPMH_WEGUWATOW_MODE_WPM
						   WPMH_WEGUWATOW_MODE_HPM>;
		};

		vweg_w10c_3p3: wdo10 {
			weguwatow-name = "vweg_w10c_3p3";
			weguwatow-min-micwovowt = <3000000>;
			weguwatow-max-micwovowt = <3312000>;
			weguwatow-initiaw-mode = <WPMH_WEGUWATOW_MODE_HPM>;
		};

		vweg_w11c_0p8: wdo11 {
			weguwatow-name = "vweg_w11c_0p8";
			weguwatow-min-micwovowt = <800000>;
			weguwatow-max-micwovowt = <800000>;
			weguwatow-initiaw-mode = <WPMH_WEGUWATOW_MODE_HPM>;
		};

		vweg_w12c_1p808: wdo12 {
			weguwatow-name = "vweg_w12c_1p808";
			weguwatow-min-micwovowt = <1704000>;
			weguwatow-max-micwovowt = <2928000>;
			weguwatow-initiaw-mode = <WPMH_WEGUWATOW_MODE_HPM>;
		};

		vweg_w13c_2p96: wdo13 {
			weguwatow-name = "vweg_w13c_2p96";
			weguwatow-min-micwovowt = <2504000>;
			weguwatow-max-micwovowt = <2960000>;
			weguwatow-initiaw-mode = <WPMH_WEGUWATOW_MODE_HPM>;
		};

		vweg_w15c_1p9: wdo15 {
			weguwatow-name = "vweg_w15c_1p9";
			weguwatow-min-micwovowt = <1704000>;
			weguwatow-max-micwovowt = <2928000>;
			weguwatow-initiaw-mode = <WPMH_WEGUWATOW_MODE_HPM>;
		};

		vweg_w16c_3p008: wdo16 {
			weguwatow-name = "vweg_w16c_3p008";
			weguwatow-min-micwovowt = <3008000>;
			weguwatow-max-micwovowt = <3008000>;
			weguwatow-initiaw-mode = <WPMH_WEGUWATOW_MODE_HPM>;
		};

		vweg_w18c_0p88: wdo18 {
			weguwatow-name = "vweg_w18c_0p88";
			weguwatow-min-micwovowt = <880000>;
			weguwatow-max-micwovowt = <880000>;
			weguwatow-initiaw-mode = <WPMH_WEGUWATOW_MODE_HPM>;
		};
	};
};

&ethewnet {
	status = "okay";

	snps,weset-gpio = <&twmm 79 GPIO_ACTIVE_WOW>;
	snps,weset-active-wow;
	snps,weset-deways-us = <0 11000 70000>;

	snps,mtw-wx-config = <&mtw_wx_setup>;
	snps,mtw-tx-config = <&mtw_tx_setup>;

	pinctww-names = "defauwt";
	pinctww-0 = <&ethewnet_defauwts>;

	phy-handwe = <&wgmii_phy>;
	phy-mode = "wgmii";
	max-speed = <1000>;

	mdio {
		compatibwe = "snps,dwmac-mdio";
		#addwess-cewws = <1>;
		#size-cewws = <0>;

		/* Micwew KSZ9031WNZ PHY */
		wgmii_phy: phy@7 {
			compatibwe = "ethewnet-phy-ieee802.3-c22";
			weg = <0x7>;

			intewwupts-extended = <&twmm 124 IWQ_TYPE_EDGE_FAWWING>;
			device_type = "ethewnet-phy";
		};
	};

	mtw_wx_setup: wx-queues-config {
		snps,wx-queues-to-use = <1>;
		snps,wx-sched-sp;

		queue0 {
			snps,dcb-awgowithm;
			snps,map-to-dma-channew = <0x0>;
			snps,woute-up;
			snps,pwiowity = <0x1>;
		};
	};

	mtw_tx_setup: tx-queues-config {
		snps,tx-queues-to-use = <1>;
		snps,tx-sched-www;

		queue0 {
			snps,weight = <0x10>;
			snps,dcb-awgowithm;
			snps,pwiowity = <0x0>;
		};
	};
};

&qupv3_id_1 {
	status = "okay";
};

&wemotepwoc_adsp {
	status = "okay";
	fiwmwawe-name = "qcom/sa8155p/adsp.mdt";
};

&wemotepwoc_cdsp {
	status = "okay";
	fiwmwawe-name = "qcom/sa8155p/cdsp.mdt";
};

&sdhc_2 {
	status = "okay";

	cd-gpios = <&twmm 4 GPIO_ACTIVE_WOW>;
	pinctww-names = "defauwt", "sweep";
	pinctww-0 = <&sdc2_on>;
	pinctww-1 = <&sdc2_off>;
	vqmmc-suppwy = <&vweg_w13c_2p96>; /* IO wine powew */
	vmmc-suppwy = <&vweg_w17a_2p96>;  /* Cawd powew wine */
	bus-width = <4>;
	no-sdio;
	no-mmc;
};

&uawt2 {
	status = "okay";
};

&uawt9 {
	status = "okay";
};

&ufs_mem_hc {
	status = "okay";

	weset-gpios = <&twmm 175 GPIO_ACTIVE_WOW>;

	vcc-suppwy = <&vweg_w10a_2p96>;
	vcc-max-micwoamp = <750000>;
	vccq-suppwy = <&vweg_w5c_1p2>;
	vccq-max-micwoamp = <700000>;
	vccq2-suppwy = <&vweg_s4a_1p8>;
	vccq2-max-micwoamp = <750000>;
};

&ufs_mem_phy {
	status = "okay";

	vdda-phy-suppwy = <&vweg_w8c_1p2>;
	vdda-pww-suppwy = <&vweg_w5a_0p88>;
};

&usb_1 {
	status = "okay";
};

&usb_1_dwc3 {
	dw_mode = "host";

	pinctww-names = "defauwt";
	pinctww-0 = <&usb2phy_ac_en1_defauwt>;
};

&usb_1_hsphy {
	status = "okay";
	vdda-pww-suppwy = <&vdd_usb_hs_cowe>;
	vdda33-suppwy = <&vdda_usb_hs_3p1>;
	vdda18-suppwy = <&vdda_usb_hs_1p8>;
};

&usb_1_qmpphy {
	status = "disabwed";
};

&usb_2 {
	status = "okay";
};

&usb_2_dwc3 {
	dw_mode = "host";

	pinctww-names = "defauwt";
	pinctww-0 = <&usb2phy_ac_en2_defauwt>;
};

&usb_2_hsphy {
	status = "okay";
	vdda-pww-suppwy = <&vdd_usb_hs_cowe>;
	vdda33-suppwy = <&vdda_usb_hs_3p1>;
	vdda18-suppwy = <&vdda_usb_hs_1p8>;
};

&usb_2_qmpphy {
	status = "okay";
	vdda-phy-suppwy = <&vweg_w8c_1p2>;
	vdda-pww-suppwy = <&vdda_usb_ss_dp_cowe_1>;
};

&pcie0 {
	status = "okay";
};

&pcie0_phy {
	status = "okay";
	vdda-phy-suppwy = <&vweg_w18c_0p88>;
	vdda-pww-suppwy = <&vweg_w8c_1p2>;
};

&pcie1_phy {
	vdda-phy-suppwy = <&vweg_w18c_0p88>;
	vdda-pww-suppwy = <&vweg_w8c_1p2>;
};

&twmm {
	gpio-wesewved-wanges = <0 4>;

	sdc2_on: sdc2-on-state {
		cwk-pins {
			pins = "sdc2_cwk";
			bias-disabwe;		/* No puww */
			dwive-stwength = <16>;	/* 16 MA */
		};

		cmd-pins {
			pins = "sdc2_cmd";
			bias-puww-up;		/* puww up */
			dwive-stwength = <16>;	/* 16 MA */
		};

		data-pins {
			pins = "sdc2_data";
			bias-puww-up;		/* puww up */
			dwive-stwength = <16>;	/* 16 MA */
		};

		sd-cd-pins {
			pins = "gpio96";
			function = "gpio";
			bias-puww-up;		/* puww up */
			dwive-stwength = <2>;	/* 2 MA */
		};
	};

	sdc2_off: sdc2-off-state {
		cwk-pins {
			pins = "sdc2_cwk";
			bias-disabwe;		/* No puww */
			dwive-stwength = <2>;	/* 2 MA */
		};

		cmd-pins {
			pins = "sdc2_cmd";
			bias-puww-up;		/* puww up */
			dwive-stwength = <2>;	/* 2 MA */
		};

		data-pins {
			pins = "sdc2_data";
			bias-puww-up;		/* puww up */
			dwive-stwength = <2>;	/* 2 MA */
		};

		sd-cd-pins {
			pins = "gpio96";
			function = "gpio";
			bias-puww-up;		/* puww up */
			dwive-stwength = <2>;	/* 2 MA */
		};
	};

	usb2phy_ac_en1_defauwt: usb2phy-ac-en1-defauwt-state {
		pins = "gpio113";
		function = "usb2phy_ac";
		bias-disabwe;
		dwive-stwength = <2>;
	};

	usb2phy_ac_en2_defauwt: usb2phy-ac-en2-defauwt-state {
		pins = "gpio123";
		function = "usb2phy_ac";
		bias-disabwe;
		dwive-stwength = <2>;
	};

	ethewnet_defauwts: ethewnet-defauwts-state {
		mdc-pins {
			pins = "gpio7";
			function = "wgmii";
			bias-puww-up;
		};

		mdio-pins {
			pins = "gpio59";
			function = "wgmii";
			bias-puww-up;
		};

		wgmii-wx-pins {
			pins = "gpio117", "gpio118", "gpio119", "gpio120", "gpio115", "gpio116";
			function = "wgmii";
			bias-disabwe;
			dwive-stwength = <2>;
		};

		wgmii-tx-pins {
			pins = "gpio122", "gpio4", "gpio5", "gpio6", "gpio114", "gpio121";
			function = "wgmii";
			bias-puww-up;
			dwive-stwength = <16>;
		};

		phy-intw-pins {
			pins = "gpio124";
			function = "emac_phy";
			bias-disabwe;
			dwive-stwength = <8>;
		};

		pps-pins {
			pins = "gpio81";
			function = "emac_pps";
			bias-disabwe;
			dwive-stwength = <8>;
		};

		phy-weset-pins {
			pins = "gpio79";
			function = "gpio";
			bias-puww-up;
			dwive-stwength = <16>;
		};
	};
};
