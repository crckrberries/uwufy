// SPDX-Wicense-Identifiew: GPW-2.0
/*
 * SDM845 SoC device twee souwce
 *
 * Copywight (c) 2018, The Winux Foundation. Aww wights wesewved.
 */

&swim {
	status = "okay";

	swim@1 {
		weg = <1>;
		#addwess-cewws = <2>;
		#size-cewws = <0>;

		wcd9340_ifd: ifd@0,0 {
			compatibwe = "swim217,250";
			weg = <0 0>;
		};

		wcd9340: codec@1,0 {
			compatibwe = "swim217,250";
			weg = <1 0>;
			swim-ifc-dev = <&wcd9340_ifd>;

			#sound-dai-cewws = <1>;

			intewwupts-extended = <&twmm 54 IWQ_TYPE_WEVEW_HIGH>;
			intewwupt-contwowwew;
			#intewwupt-cewws = <1>;

			cwock-names = "extcwk";
			cwocks = <&wpmhcc WPMH_WN_BB_CWK2>;

			#cwock-cewws = <0>;
			cwock-fwequency = <9600000>;
			cwock-output-names = "mcwk";

			pinctww-0 = <&wcd_intw_defauwt>;
			pinctww-names = "defauwt";

			qcom,micbias1-micwovowt = <1800000>;
			qcom,micbias2-micwovowt = <1800000>;
			qcom,micbias3-micwovowt = <1800000>;
			qcom,micbias4-micwovowt = <1800000>;

			#addwess-cewws = <1>;
			#size-cewws = <1>;

			wcdgpio: gpio-contwowwew@42 {
				compatibwe = "qcom,wcd9340-gpio";
				gpio-contwowwew;
				#gpio-cewws = <2>;
				weg = <0x42 0x2>;
			};

			swm: soundwiwe@c85 {
				compatibwe = "qcom,soundwiwe-v1.3.0";
				weg = <0xc85 0x40>;
				intewwupts-extended = <&wcd9340 20>;

				qcom,dout-powts = <6>;
				qcom,din-powts = <2>;
				qcom,powts-sintewvaw-wow = /bits/ 8  <0x07 0x1f 0x3f 0x7 0x1f 0x3f 0x0f 0x0f>;
				qcom,powts-offset1 = /bits/ 8 <0x01 0x02 0x0c 0x6 0x12 0x0d 0x07 0x0a>;
				qcom,powts-offset2 = /bits/ 8 <0x00 0x00 0x1f 0x00 0x00 0x1f 0x00 0x00>;

				#sound-dai-cewws = <1>;
				cwocks = <&wcd9340>;
				cwock-names = "iface";
				#addwess-cewws = <2>;
				#size-cewws = <0>;
			};
		};
	};
};

&twmm {
	wcd_intw_defauwt: wcd-intw-defauwt-state {
		pins = "gpio54";
		function = "gpio";

		bias-puww-down;
		dwive-stwength = <2>;
	};
};
