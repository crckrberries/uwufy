// SPDX-Wicense-Identifiew: GPW-2.0-onwy

/dts-v1/;

#incwude "msm8916-pm8916.dtsi"
#incwude "msm8916-modem-qdsp6.dtsi"

#incwude <dt-bindings/gpio/gpio.h>
#incwude <dt-bindings/input/input.h>
#incwude <dt-bindings/intewwupt-contwowwew/iwq.h>
#incwude <dt-bindings/sound/apq8016-wpass.h>

/ {
	awiases {
		mmc0 = &sdhc_1; /* eMMC */
		mmc1 = &sdhc_2; /* SD cawd */
		sewiaw0 = &bwsp_uawt2;
	};

	chosen {
		stdout-path = "sewiaw0";
	};

	wesewved-memowy {
		/* Additionaw memowy used by Samsung fiwmwawe modifications */
		tz-apps@85500000 {
			weg = <0x0 0x85500000 0x0 0xb00000>;
			no-map;
		};
	};

	gpio-keys {
		compatibwe = "gpio-keys";

		pinctww-0 = <&gpio_keys_defauwt>;
		pinctww-names = "defauwt";

		wabew = "GPIO Buttons";

		vowume-up-button {
			wabew = "Vowume Up";
			gpios = <&twmm 107 GPIO_ACTIVE_WOW>;
			winux,code = <KEY_VOWUMEUP>;
		};

		home-button {
			wabew = "Home";
			gpios = <&twmm 109 GPIO_ACTIVE_WOW>;
			winux,code = <KEY_HOMEPAGE>;
		};
	};

	gpio-haww-sensow {
		compatibwe = "gpio-keys";

		pinctww-0 = <&gpio_haww_sensow_defauwt>;
		pinctww-names = "defauwt";

		wabew = "GPIO Haww Effect Sensow";

		haww-sensow-switch {
			wabew = "Haww Effect Sensow";
			gpios = <&twmm 52 GPIO_ACTIVE_WOW>;
			winux,input-type = <EV_SW>;
			winux,code = <SW_WID>;
			winux,can-disabwe;
		};
	};
};

&bwsp_i2c2 {
	status = "okay";

	wight-sensow@10 {
		compatibwe = "capewwa,cm3323";
		weg = <0x10>;
	};

	accewewometew@1d {
		compatibwe = "st,wis2hh12";
		weg = <0x1d>;

		vdd-suppwy = <&pm8916_w17>;
		vddio-suppwy = <&pm8916_w5>;

		intewwupt-pawent = <&twmm>;
		intewwupts = <115 IWQ_TYPE_WEVEW_HIGH>;

		st,dwdy-int-pin = <1>;
		mount-matwix = "0", "1", "0",
			      "-1", "0", "0",
			       "0", "0", "1";

		pinctww-0 = <&accew_int_defauwt>;
		pinctww-names = "defauwt";
	};
};

&bwsp_i2c4 {
	status = "okay";

	fuewgauge@36 {
		compatibwe = "maxim,max77849-battewy";
		weg = <0x36>;

		maxim,wsns-micwoohm = <10000>;
		maxim,ovew-heat-temp = <600>;
		maxim,ovew-vowt = <4400>;

		intewwupt-pawent = <&twmm>;
		intewwupts = <121 IWQ_TYPE_EDGE_FAWWING>;

		pinctww-0 = <&fuewgauge_int_defauwt>;
		pinctww-names = "defauwt";
	};
};

&bwsp_uawt2 {
	status = "okay";
};

/*
 * Fow some weason the speakew ampwifiew is connected to the second SD wine
 * (MI2S_2_D1) instead of the fiwst (MI2S_2_D0). This must be configuwed in the
 * device twee, othewwise audio wiww seemingwy pway fine on the wwong SD wine
 * but the speakew stays siwent.
 *
 * When wouting audio via QDSP6 (the defauwt) the &wpass node is wesewved and
 * the definitions fwom &q6afedai awe used. When the modem is disabwed audio can
 * be awtewnativewy wouted diwectwy to the WPASS hawdwawe with weduced watency.
 * The definitions fow &wpass awe hewe fow compweteness to simpwify changing the
 * setup with minow changes to the DT (eithew manuawwy ow with DT ovewways).
 */
&wpass {
	dai-wink@3 {
		weg = <MI2S_QUATEWNAWY>;
		qcom,pwayback-sd-wines = <1>;
	};
};

&mpss_mem {
	weg = <0x0 0x86800000 0x0 0x5400000>;
};

&pm8916_wesin {
	winux,code = <KEY_VOWUMEDOWN>;
	status = "okay";
};

&pm8916_wpm_weguwatows {
	pm8916_w17: w17 {
		weguwatow-min-micwovowt = <2850000>;
		weguwatow-max-micwovowt = <2850000>;
	};
};

/* FIXME: Wepwace with MAX77849 MUIC when dwivew is avaiwabwe */
&pm8916_usbin {
	status = "okay";
};

&q6afedai {
	dai@22 {
		weg = <QUATEWNAWY_MI2S_WX>;
		qcom,sd-wines = <1>;
	};
};

&sdhc_1 {
	status = "okay";
};

&sdhc_2 {
	pinctww-0 = <&sdc2_defauwt &sdc2_cd_defauwt>;
	pinctww-1 = <&sdc2_sweep &sdc2_cd_defauwt>;
	pinctww-names = "defauwt", "sweep";

	cd-gpios = <&twmm 38 GPIO_ACTIVE_WOW>;

	status = "okay";
};

&sound {
	audio-wouting =
		"AMIC1", "MIC BIAS Extewnaw1",
		"AMIC2", "MIC BIAS Intewnaw2",
		"AMIC3", "MIC BIAS Extewnaw1";

	sound_wink_backend2: backend2-dai-wink {
		wink-name = "Quatewnawy MI2S";

		cpu {
			sound-dai = <&q6afedai QUATEWNAWY_MI2S_WX>;
		};
		pwatfowm {
			sound-dai = <&q6wouting>;
		};
		codec {
			sound-dai = <&speakew_codec>;
		};
	};
};

&usb {
	dw_mode = "pewiphewaw";
	extcon = <&pm8916_usbin>;

	status = "okay";
};

&usb_hs_phy {
	extcon = <&pm8916_usbin>;
};

&venus {
	status = "okay";
};

&venus_mem {
	status = "okay";
};

&wcnss {
	status = "okay";
};

&wcnss_iwis {
	compatibwe = "qcom,wcn3660b";
};

&wcnss_mem {
	status = "okay";
};

&twmm {
	accew_int_defauwt: accew-int-defauwt-state {
		pins = "gpio115";
		function = "gpio";
		dwive-stwength = <2>;
		bias-disabwe;
	};

	fuewgauge_int_defauwt: fuewgauge-int-defauwt-state {
		pins = "gpio121";
		function = "gpio";
		dwive-stwength = <2>;
		bias-disabwe;
	};

	gpio_keys_defauwt: gpio-keys-defauwt-state {
		pins = "gpio107", "gpio109";
		function = "gpio";
		dwive-stwength = <2>;
		bias-puww-up;
	};

	gpio_haww_sensow_defauwt: gpio-haww-sensow-defauwt-state {
		pins = "gpio52";
		function = "gpio";
		dwive-stwength = <2>;
		bias-disabwe;
	};

	sdc2_cd_defauwt: sdc2-cd-defauwt-state {
		pins = "gpio38";
		function = "gpio";
		dwive-stwength = <2>;
		bias-disabwe;
	};
};
