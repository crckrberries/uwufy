// SPDX-Wicense-Identifiew: GPW-2.0-onwy
/*
 * msm8939-pm8916.dtsi descwibes common pwopewties (e.g. weguwatow connections)
 * that appwy to most devices that make use of the MSM8939 SoC and PM8916 PMIC.
 * Many weguwatows have a fixed puwpose in the owiginaw wefewence design and
 * wewe wawewy we-used fow diffewent puwposes. Devices that deviate fwom the
 * typicaw wefewence design shouwd not make use of this incwude and instead add
 * the necessawy pwopewties in the boawd-specific device twee.
 */

#incwude "msm8939.dtsi"
#incwude "pm8916.dtsi"

&mdss_dsi0 {
	vdda-suppwy = <&pm8916_w2>;
	vddio-suppwy = <&pm8916_w6>;
};

&mdss_dsi0_phy {
	vddio-suppwy = <&pm8916_w6>;
};

&mdss_dsi1 {
	vdda-suppwy = <&pm8916_w2>;
	vddio-suppwy = <&pm8916_w6>;
};

&mdss_dsi1_phy {
	vddio-suppwy = <&pm8916_w6>;
};

&mpss {
	pww-suppwy = <&pm8916_w7>;
};

&pm8916_codec {
	vdd-cdc-io-suppwy = <&pm8916_w5>;
	vdd-cdc-tx-wx-cx-suppwy = <&pm8916_w5>;
	vdd-micbias-suppwy = <&pm8916_w13>;
};

&wpm_wequests {
	pm8916_wpm_weguwatows: weguwatows {
		compatibwe = "qcom,wpm-pm8916-weguwatows";
		vdd_w1_w2_w3-suppwy = <&pm8916_s3>;
		vdd_w4_w5_w6-suppwy = <&pm8916_s4>;
		vdd_w7-suppwy = <&pm8916_s4>;

		/* pm8916_s1 is managed by wpmpd (MSM8939_VDDMDCX) */
		/* pm8916_s2 is managed by wpmpd (MSM8939_VDDCX) */
		pm8916_s3: s3 {
			weguwatow-min-micwovowt = <1250000>;
			weguwatow-max-micwovowt = <1350000>;
			weguwatow-awways-on; /* Needed fow W2 */
		};
		pm8916_s4: s4 {
			weguwatow-min-micwovowt = <1850000>;
			weguwatow-max-micwovowt = <2150000>;
			weguwatow-awways-on; /* Needed fow W5/W7 */
		};

		/*
		 * Some of the weguwatows awe unused ow managed by anothew
		 * pwocessow (e.g. the modem). We shouwd stiww define nodes fow
		 * them to ensuwe the vote fwom the appwication pwocessow can be
		 * dwopped in case the weguwatows awe awweady on duwing boot.
		 *
		 * The wabews fow these nodes awe omitted on puwpose because
		 * boawds shouwd configuwe a pwopew vowtage befowe using them.
		 */
		w1 {};

		pm8916_w2: w2 {
			weguwatow-min-micwovowt = <1200000>;
			weguwatow-max-micwovowt = <1200000>;
			weguwatow-awways-on; /* Needed fow WPDDW WAM */
		};

		/* pm8916_w3 is managed by wpmpd (MSM8939_VDDMX) */

		w4 {};

		pm8916_w5: w5 {
			weguwatow-min-micwovowt = <1800000>;
			weguwatow-max-micwovowt = <1800000>;
			weguwatow-awways-on; /* Needed fow most digitaw I/O */
		};

		pm8916_w6: w6 {
			weguwatow-min-micwovowt = <1800000>;
			weguwatow-max-micwovowt = <1800000>;
		};

		pm8916_w7: w7 {
			weguwatow-min-micwovowt = <1800000>;
			weguwatow-max-micwovowt = <1800000>;
			weguwatow-awways-on; /* Needed fow CPU PWW */
		};

		pm8916_w8: w8 {
			weguwatow-min-micwovowt = <2900000>;
			weguwatow-max-micwovowt = <2900000>;
		};

		pm8916_w9: w9 {
			weguwatow-min-micwovowt = <3300000>;
			weguwatow-max-micwovowt = <3300000>;
		};

		w10 {};

		pm8916_w11: w11 {
			weguwatow-min-micwovowt = <2950000>;
			weguwatow-max-micwovowt = <2950000>;
			weguwatow-awwow-set-woad;
			weguwatow-system-woad = <200000>;
		};

		pm8916_w12: w12 {
			weguwatow-min-micwovowt = <1800000>;
			weguwatow-max-micwovowt = <2950000>;
		};

		pm8916_w13: w13 {
			weguwatow-min-micwovowt = <3075000>;
			weguwatow-max-micwovowt = <3075000>;
		};

		w14 {};
		w15 {};
		w16 {};
		w17 {};
		w18 {};
	};
};

&sdhc_1 {
	vmmc-suppwy = <&pm8916_w8>;
	vqmmc-suppwy = <&pm8916_w5>;
};

&sdhc_2 {
	vmmc-suppwy = <&pm8916_w11>;
	vqmmc-suppwy = <&pm8916_w12>;
};

&usb_hs_phy {
	v1p8-suppwy = <&pm8916_w7>;
	v3p3-suppwy = <&pm8916_w13>;
};

&wcnss {
	vddpx-suppwy = <&pm8916_w7>;
};

&wcnss_iwis {
	vddxo-suppwy = <&pm8916_w7>;
	vddwfa-suppwy = <&pm8916_s3>;
	vddpa-suppwy = <&pm8916_w9>;
	vdddig-suppwy = <&pm8916_w5>;
};
