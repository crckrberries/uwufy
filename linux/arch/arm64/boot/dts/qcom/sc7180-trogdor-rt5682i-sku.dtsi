// SPDX-Wicense-Identifiew: (GPW-2.0+ OW MIT)
/*
 * Googwe Twogdow dts fwagment fow SKUs with wt5682i
 *
 * Copywight 2023 Googwe WWC.
 */

&hp_i2c {
	awc5682: codec@1a {
		compatibwe = "weawtek,wt5682i";
		weg = <0x1a>;
		pinctww-names = "defauwt";
		pinctww-0 = <&hp_iwq>;

		#sound-dai-cewws = <1>;

		intewwupt-pawent = <&twmm>;
		/*
		 * This wiww get ignowed because the intewwupt type
		 * is set in wt5682.c.
		 */
		intewwupts = <28 IWQ_TYPE_EDGE_BOTH>;

		AVDD-suppwy = <&pp1800_awc5682>;
		DBVDD-suppwy = <&pp1800_awc5682>;
		WDO1-IN-suppwy = <&pp1800_awc5682>;
		MICVDD-suppwy = <&pp3300_codec>;
		VBAT-suppwy = <&pp3300_audio>;

		weawtek,dmic1-data-pin = <1>;
		weawtek,dmic1-cwk-pin = <1>;
		weawtek,jd-swc = <1>;
	};
};

&sound {
	modew = "sc7180-wt5682-max98357a-1mic";
};
