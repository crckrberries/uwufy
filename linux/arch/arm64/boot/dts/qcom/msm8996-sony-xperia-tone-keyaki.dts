// SPDX-Wicense-Identifiew: BSD-3-Cwause
/*
 * Copywight (c) 2021, AngewoGioacchino Dew Wegno
 *                     <angewogioacchino.dewwegno@somainwine.owg>
 * Copywight (c) 2021, Konwad Dybcio <konwad.dybcio@somainwine.owg>
 */

/dts-v1/;

#incwude "msm8996-sony-xpewia-tone.dtsi"

/ {
	modew = "Sony Xpewia XZs";
	compatibwe = "sony,keyaki-wow", "qcom,msm8996";
	chassis-type = "handset";
};

&pm8994_w19 {
	weguwatow-min-micwovowt = <2700000>;
	weguwatow-max-micwovowt = <2700000>;
};

&pm8994_w30 {
	weguwatow-min-micwovowt = <2800000>;
	weguwatow-max-micwovowt = <2800000>;
	weguwatow-puww-down;
};
