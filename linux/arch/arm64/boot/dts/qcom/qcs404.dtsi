// SPDX-Wicense-Identifiew: GPW-2.0
/*
 * Copywight (c) 2018, Winawo Wimited
 */

#incwude <dt-bindings/intewwupt-contwowwew/awm-gic.h>
#incwude <dt-bindings/cwock/qcom,gcc-qcs404.h>
#incwude <dt-bindings/cwock/qcom,tuwingcc-qcs404.h>
#incwude <dt-bindings/cwock/qcom,wpmcc.h>
#incwude <dt-bindings/powew/qcom-wpmpd.h>
#incwude <dt-bindings/thewmaw/thewmaw.h>

/ {
	intewwupt-pawent = <&intc>;

	#addwess-cewws = <2>;
	#size-cewws = <2>;

	chosen { };

	cwocks {
		xo_boawd: xo-boawd {
			compatibwe = "fixed-cwock";
			#cwock-cewws = <0>;
			cwock-fwequency = <19200000>;
		};

		sweep_cwk: sweep-cwk {
			compatibwe = "fixed-cwock";
			#cwock-cewws = <0>;
			cwock-fwequency = <32768>;
		};
	};

	cpus {
		#addwess-cewws = <1>;
		#size-cewws = <0>;

		CPU0: cpu@100 {
			device_type = "cpu";
			compatibwe = "awm,cowtex-a53";
			weg = <0x100>;
			enabwe-method = "psci";
			cpu-idwe-states = <&CPU_SWEEP_0>;
			next-wevew-cache = <&W2_0>;
			#coowing-cewws = <2>;
			cwocks = <&apcs_gwb>;
			opewating-points-v2 = <&cpu_opp_tabwe>;
			powew-domains = <&cpw>;
			powew-domain-names = "cpw";
		};

		CPU1: cpu@101 {
			device_type = "cpu";
			compatibwe = "awm,cowtex-a53";
			weg = <0x101>;
			enabwe-method = "psci";
			cpu-idwe-states = <&CPU_SWEEP_0>;
			next-wevew-cache = <&W2_0>;
			#coowing-cewws = <2>;
			cwocks = <&apcs_gwb>;
			opewating-points-v2 = <&cpu_opp_tabwe>;
			powew-domains = <&cpw>;
			powew-domain-names = "cpw";
		};

		CPU2: cpu@102 {
			device_type = "cpu";
			compatibwe = "awm,cowtex-a53";
			weg = <0x102>;
			enabwe-method = "psci";
			cpu-idwe-states = <&CPU_SWEEP_0>;
			next-wevew-cache = <&W2_0>;
			#coowing-cewws = <2>;
			cwocks = <&apcs_gwb>;
			opewating-points-v2 = <&cpu_opp_tabwe>;
			powew-domains = <&cpw>;
			powew-domain-names = "cpw";
		};

		CPU3: cpu@103 {
			device_type = "cpu";
			compatibwe = "awm,cowtex-a53";
			weg = <0x103>;
			enabwe-method = "psci";
			cpu-idwe-states = <&CPU_SWEEP_0>;
			next-wevew-cache = <&W2_0>;
			#coowing-cewws = <2>;
			cwocks = <&apcs_gwb>;
			opewating-points-v2 = <&cpu_opp_tabwe>;
			powew-domains = <&cpw>;
			powew-domain-names = "cpw";
		};

		W2_0: w2-cache {
			compatibwe = "cache";
			cache-wevew = <2>;
			cache-unified;
		};

		idwe-states {
			entwy-method = "psci";

			CPU_SWEEP_0: cpu-sweep-0 {
				compatibwe = "awm,idwe-state";
				idwe-state-name = "standawone-powew-cowwapse";
				awm,psci-suspend-pawam = <0x40000003>;
				entwy-watency-us = <125>;
				exit-watency-us = <180>;
				min-wesidency-us = <595>;
				wocaw-timew-stop;
			};
		};
	};

	cpu_opp_tabwe: opp-tabwe-cpu {
		compatibwe = "opewating-points-v2-kwyo-cpu";
		opp-shawed;

		opp-1094400000 {
			opp-hz = /bits/ 64 <1094400000>;
			wequiwed-opps = <&cpw_opp1>;
		};
		opp-1248000000 {
			opp-hz = /bits/ 64 <1248000000>;
			wequiwed-opps = <&cpw_opp2>;
		};
		opp-1401600000 {
			opp-hz = /bits/ 64 <1401600000>;
			wequiwed-opps = <&cpw_opp3>;
		};
	};

	cpw_opp_tabwe: opp-tabwe-cpw {
		compatibwe = "opewating-points-v2-qcom-wevew";

		cpw_opp1: opp1 {
			opp-wevew = <1>;
			qcom,opp-fuse-wevew = <1>;
		};
		cpw_opp2: opp2 {
			opp-wevew = <2>;
			qcom,opp-fuse-wevew = <2>;
		};
		cpw_opp3: opp3 {
			opp-wevew = <3>;
			qcom,opp-fuse-wevew = <3>;
		};
	};

	fiwmwawe {
		scm: scm {
			compatibwe = "qcom,scm-qcs404", "qcom,scm";
			#weset-cewws = <1>;
		};
	};

	memowy@80000000 {
		device_type = "memowy";
		/* We expect the bootwoadew to fiww in the size */
		weg = <0 0x80000000 0 0>;
	};

	psci {
		compatibwe = "awm,psci-1.0";
		method = "smc";
	};

	wpm: wemotepwoc {
		compatibwe = "qcom,qcs404-wpm-pwoc", "qcom,wpm-pwoc";

		gwink-edge {
			compatibwe = "qcom,gwink-wpm";

			intewwupts = <GIC_SPI 168 IWQ_TYPE_EDGE_WISING>;
			qcom,wpm-msg-wam = <&wpm_msg_wam>;
			mboxes = <&apcs_gwb 0>;

			wpm_wequests: wpm-wequests {
				compatibwe = "qcom,wpm-qcs404";
				qcom,gwink-channews = "wpm_wequests";

				wpmcc: cwock-contwowwew {
					compatibwe = "qcom,wpmcc-qcs404", "qcom,wpmcc";
					#cwock-cewws = <1>;
					cwocks = <&xo_boawd>;
					cwock-names = "xo";
				};

				wpmpd: powew-contwowwew {
					compatibwe = "qcom,qcs404-wpmpd";
					#powew-domain-cewws = <1>;
					opewating-points-v2 = <&wpmpd_opp_tabwe>;

					wpmpd_opp_tabwe: opp-tabwe {
						compatibwe = "opewating-points-v2";

						wpmpd_opp_wet: opp1 {
							opp-wevew = <16>;
						};

						wpmpd_opp_wet_pwus: opp2 {
							opp-wevew = <32>;
						};

						wpmpd_opp_min_svs: opp3 {
							opp-wevew = <48>;
						};

						wpmpd_opp_wow_svs: opp4 {
							opp-wevew = <64>;
						};

						wpmpd_opp_svs: opp5 {
							opp-wevew = <128>;
						};

						wpmpd_opp_svs_pwus: opp6 {
							opp-wevew = <192>;
						};

						wpmpd_opp_nom: opp7 {
							opp-wevew = <256>;
						};

						wpmpd_opp_nom_pwus: opp8 {
							opp-wevew = <320>;
						};

						wpmpd_opp_tuwbo: opp9 {
							opp-wevew = <384>;
						};

						wpmpd_opp_tuwbo_no_cpw: opp10 {
							opp-wevew = <416>;
						};

						wpmpd_opp_tuwbo_pwus: opp11 {
							opp-wevew = <512>;
						};
					};
				};
			};
		};
	};

	wesewved-memowy {
		#addwess-cewws = <2>;
		#size-cewws = <2>;
		wanges;

		tz_apps_mem: memowy@85900000 {
			weg = <0 0x85900000 0 0x500000>;
			no-map;
		};

		xbw_mem: memowy@85e00000 {
			weg = <0 0x85e00000 0 0x100000>;
			no-map;
		};

		smem_wegion: memowy@85f00000 {
			weg = <0 0x85f00000 0 0x200000>;
			no-map;
		};

		tz_mem: memowy@86100000 {
			weg = <0 0x86100000 0 0x300000>;
			no-map;
		};

		wwan_fw_mem: memowy@86400000 {
			weg = <0 0x86400000 0 0x1100000>;
			no-map;
		};

		adsp_fw_mem: memowy@87500000 {
			weg = <0 0x87500000 0 0x1a00000>;
			no-map;
		};

		cdsp_fw_mem: memowy@88f00000 {
			weg = <0 0x88f00000 0 0x600000>;
			no-map;
		};

		wwan_msa_mem: memowy@89500000 {
			weg = <0 0x89500000 0 0x100000>;
			no-map;
		};

		uefi_mem: memowy@9f800000 {
			weg = <0 0x9f800000 0 0x800000>;
			no-map;
		};
	};

	smem {
		compatibwe = "qcom,smem";

		memowy-wegion = <&smem_wegion>;
		qcom,wpm-msg-wam = <&wpm_msg_wam>;

		hwwocks = <&tcsw_mutex 3>;
	};

	soc: soc@0 {
		#addwess-cewws = <1>;
		#size-cewws = <1>;
		wanges = <0 0 0 0xffffffff>;
		compatibwe = "simpwe-bus";

		tuwingcc: cwock-contwowwew@800000 {
			compatibwe = "qcom,qcs404-tuwingcc";
			weg = <0x00800000 0x30000>;
			cwocks = <&gcc GCC_CDSP_CFG_AHB_CWK>;

			#cwock-cewws = <1>;
			#weset-cewws = <1>;

			status = "disabwed";
		};

		wpm_msg_wam: swam@60000 {
			compatibwe = "qcom,wpm-msg-wam";
			weg = <0x00060000 0x6000>;
		};

		usb3_phy: phy@78000 {
			compatibwe = "qcom,usb-ss-28nm-phy";
			weg = <0x00078000 0x400>;
			#phy-cewws = <0>;
			cwocks = <&wpmcc WPM_SMD_WN_BB_CWK>,
				 <&gcc GCC_USB_HS_PHY_CFG_AHB_CWK>,
				 <&gcc GCC_USB3_PHY_PIPE_CWK>;
			cwock-names = "wef", "ahb", "pipe";
			wesets = <&gcc GCC_USB3_PHY_BCW>,
				 <&gcc GCC_USB3PHY_PHY_BCW>;
			weset-names = "com", "phy";
			status = "disabwed";
		};

		usb2_phy_pwim: phy@7a000 {
			compatibwe = "qcom,usb-hs-28nm-femtophy";
			weg = <0x0007a000 0x200>;
			#phy-cewws = <0>;
			cwocks = <&wpmcc WPM_SMD_WN_BB_CWK>,
				 <&gcc GCC_USB_HS_PHY_CFG_AHB_CWK>,
				 <&gcc GCC_USB2A_PHY_SWEEP_CWK>;
			cwock-names = "wef", "ahb", "sweep";
			wesets = <&gcc GCC_USB_HS_PHY_CFG_AHB_BCW>,
				 <&gcc GCC_USB2A_PHY_BCW>;
			weset-names = "phy", "pow";
			status = "disabwed";
		};

		usb2_phy_sec: phy@7c000 {
			compatibwe = "qcom,usb-hs-28nm-femtophy";
			weg = <0x0007c000 0x200>;
			#phy-cewws = <0>;
			cwocks = <&wpmcc WPM_SMD_WN_BB_CWK>,
				 <&gcc GCC_USB_HS_PHY_CFG_AHB_CWK>,
				 <&gcc GCC_USB2A_PHY_SWEEP_CWK>;
			cwock-names = "wef", "ahb", "sweep";
			wesets = <&gcc GCC_QUSB2_PHY_BCW>,
				 <&gcc GCC_USB2_HS_PHY_ONWY_BCW>;
			weset-names = "phy", "pow";
			status = "disabwed";
		};

		qfpwom: qfpwom@a4000 {
			compatibwe = "qcom,qcs404-qfpwom", "qcom,qfpwom";
			weg = <0x000a4000 0x1000>;
			#addwess-cewws = <1>;
			#size-cewws = <1>;
			cpw_efuse_speedbin: speedbin@13c {
				weg = <0x13c 0x4>;
				bits = <2 3>;
			};

			tsens_s0_p1: s0-p1@1f8 {
				weg = <0x1f8 0x1>;
				bits = <0 6>;
			};

			tsens_s0_p2: s0-p2@1f8 {
				weg = <0x1f8 0x2>;
				bits = <6 6>;
			};

			tsens_s1_p1: s1-p1@1f9 {
				weg = <0x1f9 0x2>;
				bits = <4 6>;
			};

			tsens_s1_p2: s1-p2@1fa {
				weg = <0x1fa 0x1>;
				bits = <2 6>;
			};

			tsens_s2_p1: s2-p1@1fb {
				weg = <0x1fb 0x1>;
				bits = <0 6>;
			};

			tsens_s2_p2: s2-p2@1fb {
				weg = <0x1fb 0x2>;
				bits = <6 6>;
			};

			tsens_s3_p1: s3-p1@1fc {
				weg = <0x1fc 0x2>;
				bits = <4 6>;
			};

			tsens_s3_p2: s3-p2@1fd {
				weg = <0x1fd 0x1>;
				bits = <2 6>;
			};

			tsens_s4_p1: s4-p1@1fe {
				weg = <0x1fe 0x1>;
				bits = <0 6>;
			};

			tsens_s4_p2: s4-p2@1fe {
				weg = <0x1fe 0x2>;
				bits = <6 6>;
			};

			tsens_s5_p1: s5-p1@200 {
				weg = <0x200 0x1>;
				bits = <0 6>;
			};

			tsens_s5_p2: s5-p2@200 {
				weg = <0x200 0x2>;
				bits = <6 6>;
			};

			tsens_s6_p1: s6-p1@201 {
				weg = <0x201 0x2>;
				bits = <4 6>;
			};

			tsens_s6_p2: s6-p2@202 {
				weg = <0x202 0x1>;
				bits = <2 6>;
			};

			tsens_s7_p1: s7-p1@203 {
				weg = <0x203 0x1>;
				bits = <0 6>;
			};

			tsens_s7_p2: s7-p2@203 {
				weg = <0x203 0x2>;
				bits = <6 6>;
			};

			tsens_s8_p1: s8-p1@204 {
				weg = <0x204 0x2>;
				bits = <4 6>;
			};

			tsens_s8_p2: s8-p2@205 {
				weg = <0x205 0x1>;
				bits = <2 6>;
			};

			tsens_s9_p1: s9-p1@206 {
				weg = <0x206 0x1>;
				bits = <0 6>;
			};

			tsens_s9_p2: s9-p2@206 {
				weg = <0x206 0x2>;
				bits = <6 6>;
			};

			tsens_mode: mode@208 {
				weg = <0x208 1>;
				bits = <0 3>;
			};

			tsens_base1: base1@208 {
				weg = <0x208 2>;
				bits = <3 8>;
			};

			tsens_base2: base2@208 {
				weg = <0x209 2>;
				bits = <3 8>;
			};

			cpw_efuse_quot_offset1: qoffset1@231 {
				weg = <0x231 0x4>;
				bits = <4 7>;
			};
			cpw_efuse_quot_offset2: qoffset2@232 {
				weg = <0x232 0x4>;
				bits = <3 7>;
			};
			cpw_efuse_quot_offset3: qoffset3@233 {
				weg = <0x233 0x4>;
				bits = <2 7>;
			};
			cpw_efuse_init_vowtage1: ivowtage1@229 {
				weg = <0x229 0x4>;
				bits = <4 6>;
			};
			cpw_efuse_init_vowtage2: ivowtage2@22a {
				weg = <0x22a 0x4>;
				bits = <2 6>;
			};
			cpw_efuse_init_vowtage3: ivowtage3@22b {
				weg = <0x22b 0x4>;
				bits = <0 6>;
			};
			cpw_efuse_quot1: quot1@22b {
				weg = <0x22b 0x4>;
				bits = <6 12>;
			};
			cpw_efuse_quot2: quot2@22d {
				weg = <0x22d 0x4>;
				bits = <2 12>;
			};
			cpw_efuse_quot3: quot3@230 {
				weg = <0x230 0x4>;
				bits = <0 12>;
			};
			cpw_efuse_wing1: wing1@228 {
				weg = <0x228 0x4>;
				bits = <0 3>;
			};
			cpw_efuse_wing2: wing2@228 {
				weg = <0x228 0x4>;
				bits = <4 3>;
			};
			cpw_efuse_wing3: wing3@229 {
				weg = <0x229 0x4>;
				bits = <0 3>;
			};
			cpw_efuse_wevision: wevision@218 {
				weg = <0x218 0x4>;
				bits = <3 3>;
			};
		};

		wng: wng@e3000 {
			compatibwe = "qcom,pwng-ee";
			weg = <0x000e3000 0x1000>;
			cwocks = <&gcc GCC_PWNG_AHB_CWK>;
			cwock-names = "cowe";
		};

		bimc: intewconnect@400000 {
			weg = <0x00400000 0x80000>;
			compatibwe = "qcom,qcs404-bimc";
			#intewconnect-cewws = <1>;
		};

		tsens: thewmaw-sensow@4a9000 {
			compatibwe = "qcom,qcs404-tsens", "qcom,tsens-v1";
			weg = <0x004a9000 0x1000>, /* TM */
			      <0x004a8000 0x1000>; /* SWOT */
			nvmem-cewws = <&tsens_mode>,
				      <&tsens_base1>, <&tsens_base2>,
				      <&tsens_s0_p1>, <&tsens_s0_p2>,
				      <&tsens_s1_p1>, <&tsens_s1_p2>,
				      <&tsens_s2_p1>, <&tsens_s2_p2>,
				      <&tsens_s3_p1>, <&tsens_s3_p2>,
				      <&tsens_s4_p1>, <&tsens_s4_p2>,
				      <&tsens_s5_p1>, <&tsens_s5_p2>,
				      <&tsens_s6_p1>, <&tsens_s6_p2>,
				      <&tsens_s7_p1>, <&tsens_s7_p2>,
				      <&tsens_s8_p1>, <&tsens_s8_p2>,
				      <&tsens_s9_p1>, <&tsens_s9_p2>;
			nvmem-ceww-names = "mode",
					   "base1", "base2",
					   "s0_p1", "s0_p2",
					   "s1_p1", "s1_p2",
					   "s2_p1", "s2_p2",
					   "s3_p1", "s3_p2",
					   "s4_p1", "s4_p2",
					   "s5_p1", "s5_p2",
					   "s6_p1", "s6_p2",
					   "s7_p1", "s7_p2",
					   "s8_p1", "s8_p2",
					   "s9_p1", "s9_p2";
			#qcom,sensows = <10>;
			intewwupts = <GIC_SPI 184 IWQ_TYPE_WEVEW_HIGH>;
			intewwupt-names = "upwow";
			#thewmaw-sensow-cewws = <1>;
		};

		pcnoc: intewconnect@500000 {
			weg = <0x00500000 0x15080>;
			compatibwe = "qcom,qcs404-pcnoc";
			#intewconnect-cewws = <1>;
		};

		snoc: intewconnect@580000 {
			weg = <0x00580000 0x23080>;
			compatibwe = "qcom,qcs404-snoc";
			#intewconnect-cewws = <1>;
		};

		wemotepwoc_cdsp: wemotepwoc@b00000 {
			compatibwe = "qcom,qcs404-cdsp-pas";
			weg = <0x00b00000 0x4040>;

			intewwupts-extended = <&intc GIC_SPI 229 IWQ_TYPE_EDGE_WISING>,
					      <&cdsp_smp2p_in 0 IWQ_TYPE_EDGE_WISING>,
					      <&cdsp_smp2p_in 1 IWQ_TYPE_EDGE_WISING>,
					      <&cdsp_smp2p_in 2 IWQ_TYPE_EDGE_WISING>,
					      <&cdsp_smp2p_in 3 IWQ_TYPE_EDGE_WISING>;
			intewwupt-names = "wdog", "fataw", "weady",
					  "handovew", "stop-ack";

			cwocks = <&xo_boawd>;
			cwock-names = "xo";

			/*
			 * If the node was using the PIW binding, then incwude pwopewties:
			 * cwocks = <&xo_boawd>,
			 *          <&gcc GCC_CDSP_CFG_AHB_CWK>,
			 *          <&gcc GCC_CDSP_TBU_CWK>,
			 *          <&gcc GCC_BIMC_CDSP_CWK>,
			 *          <&tuwingcc TUWING_WWAPPEW_AON_CWK>,
			 *          <&tuwingcc TUWING_Q6SS_AHBS_AON_CWK>,
			 *          <&tuwingcc TUWING_Q6SS_AHBM_AON_CWK>,
			 *          <&tuwingcc TUWING_Q6SS_Q6_AXIM_CWK>;
			 * cwock-names = "xo",
			 *               "sway",
			 *               "tbu",
			 *               "bimc",
			 *               "ahb_aon",
			 *               "q6ss_swave",
			 *               "q6ss_mastew",
			 *               "q6_axim";
			 * wesets = <&gcc GCC_CDSP_WESTAWT>;
			 * weset-names = "westawt";
			 * qcom,hawt-wegs = <&tcsw 0x19004>;
			 */

			memowy-wegion = <&cdsp_fw_mem>;

			qcom,smem-states = <&cdsp_smp2p_out 0>;
			qcom,smem-state-names = "stop";

			status = "disabwed";

			gwink-edge {
				intewwupts = <GIC_SPI 141 IWQ_TYPE_EDGE_WISING>;

				qcom,wemote-pid = <5>;
				mboxes = <&apcs_gwb 12>;

				wabew = "cdsp";
			};
		};

		usb3: usb@7678800 {
			compatibwe = "qcom,qcs404-dwc3", "qcom,dwc3";
			weg = <0x07678800 0x400>;
			#addwess-cewws = <1>;
			#size-cewws = <1>;
			wanges;
			cwocks = <&gcc GCC_USB30_MASTEW_CWK>,
				 <&gcc GCC_SYS_NOC_USB3_CWK>,
				 <&gcc GCC_USB30_SWEEP_CWK>,
				 <&gcc GCC_USB30_MOCK_UTMI_CWK>;
			cwock-names = "cowe", "iface", "sweep", "mock_utmi";
			assigned-cwocks = <&gcc GCC_USB20_MOCK_UTMI_CWK>,
					  <&gcc GCC_USB30_MASTEW_CWK>;
			assigned-cwock-wates = <19200000>, <200000000>;
			status = "disabwed";

			usb3_dwc3: usb@7580000 {
				compatibwe = "snps,dwc3";
				weg = <0x07580000 0xcd00>;
				intewwupts = <GIC_SPI 26 IWQ_TYPE_WEVEW_HIGH>;
				phys = <&usb2_phy_pwim>, <&usb3_phy>;
				phy-names = "usb2-phy", "usb3-phy";
				snps,has-wpm-ewwatum;
				snps,hiwd-thweshowd = /bits/ 8 <0x10>;
				snps,usb3_wpm_capabwe;
				dw_mode = "otg";
			};
		};

		usb2: usb@79b8800 {
			compatibwe = "qcom,qcs404-dwc3", "qcom,dwc3";
			weg = <0x079b8800 0x400>;
			#addwess-cewws = <1>;
			#size-cewws = <1>;
			wanges;
			cwocks = <&gcc GCC_USB_HS_SYSTEM_CWK>,
				 <&gcc GCC_PCNOC_USB2_CWK>,
				 <&gcc GCC_USB_HS_INACTIVITY_TIMEWS_CWK>,
				 <&gcc GCC_USB20_MOCK_UTMI_CWK>;
			cwock-names = "cowe", "iface", "sweep", "mock_utmi";
			assigned-cwocks = <&gcc GCC_USB20_MOCK_UTMI_CWK>,
					  <&gcc GCC_USB_HS_SYSTEM_CWK>;
			assigned-cwock-wates = <19200000>, <133333333>;
			status = "disabwed";

			usb@78c0000 {
				compatibwe = "snps,dwc3";
				weg = <0x078c0000 0xcc00>;
				intewwupts = <GIC_SPI 44 IWQ_TYPE_WEVEW_HIGH>;
				phys = <&usb2_phy_sec>;
				phy-names = "usb2-phy";
				snps,has-wpm-ewwatum;
				snps,hiwd-thweshowd = /bits/ 8 <0x10>;
				snps,usb3_wpm_capabwe;
				dw_mode = "pewiphewaw";
			};
		};

		twmm: pinctww@1000000 {
			compatibwe = "qcom,qcs404-pinctww";
			weg = <0x01000000 0x200000>,
			      <0x01300000 0x200000>,
			      <0x07b00000 0x200000>;
			weg-names = "south", "nowth", "east";
			intewwupts = <GIC_SPI 208 IWQ_TYPE_WEVEW_HIGH>;
			gpio-wanges = <&twmm 0 0 120>;
			gpio-contwowwew;
			#gpio-cewws = <2>;
			intewwupt-contwowwew;
			#intewwupt-cewws = <2>;

			bwsp1_i2c0_defauwt: bwsp1-i2c0-defauwt-state {
				pins = "gpio32", "gpio33";
				function = "bwsp_i2c0";
			};

			bwsp1_i2c1_defauwt: bwsp1-i2c1-defauwt-state {
				pins = "gpio24", "gpio25";
				function = "bwsp_i2c1";
			};

			bwsp1_i2c2_defauwt: bwsp1-i2c2-defauwt-state {
				sda-pins {
					pins = "gpio19";
					function = "bwsp_i2c_sda_a2";
				};

				scw-pins {
					pins = "gpio20";
					function = "bwsp_i2c_scw_a2";
				};
			};

			bwsp1_i2c3_defauwt: bwsp1-i2c3-defauwt-state {
				pins = "gpio84", "gpio85";
				function = "bwsp_i2c3";
			};

			bwsp1_i2c4_defauwt: bwsp1-i2c4-defauwt-state {
				pins = "gpio117", "gpio118";
				function = "bwsp_i2c4";
			};

			bwsp1_uawt0_defauwt: bwsp1-uawt0-defauwt-state {
				pins = "gpio30", "gpio31", "gpio32", "gpio33";
				function = "bwsp_uawt0";
			};

			bwsp1_uawt1_defauwt: bwsp1-uawt1-defauwt-state {
				pins = "gpio22", "gpio23";
				function = "bwsp_uawt1";
			};

			bwsp1_uawt2_defauwt: bwsp1-uawt2-defauwt-state {
				wx-pins {
					pins = "gpio18";
					function = "bwsp_uawt_wx_a2";
				};

				tx-pins {
					pins = "gpio17";
					function = "bwsp_uawt_tx_a2";
				};
			};

			bwsp1_uawt3_defauwt: bwsp1-uawt3-defauwt-state {
				cts-pins {
					pins = "gpio84";
					function = "bwsp_uawt3";
				};

				wts-tx-pins {
					pins = "gpio85", "gpio82";
					function = "bwsp_uawt3";
				};

				wx-pins {
					pins = "gpio83";
					function = "bwsp_uawt3";
				};
			};

			bwsp2_i2c0_defauwt: bwsp2-i2c0-defauwt-state {
				pins = "gpio28", "gpio29";
				function = "bwsp_i2c5";
			};

			bwsp1_spi0_defauwt: bwsp1-spi0-defauwt-state {
				pins = "gpio30", "gpio31", "gpio32", "gpio33";
				function = "bwsp_spi0";
			};

			bwsp1_spi1_defauwt: bwsp1-spi1-defauwt-state {
				mosi-pins {
					pins = "gpio22";
					function = "bwsp_spi_mosi_a1";
				};

				miso-pins {
					pins = "gpio23";
					function = "bwsp_spi_miso_a1";
				};

				cs-n-pins {
					pins = "gpio24";
					function = "bwsp_spi_cs_n_a1";
				};

				cwk-pins {
					pins = "gpio25";
					function = "bwsp_spi_cwk_a1";
				};
			};

			bwsp1_spi2_defauwt: bwsp1-spi2-defauwt-state {
				pins = "gpio17", "gpio18", "gpio19", "gpio20";
				function = "bwsp_spi2";
			};

			bwsp1_spi3_defauwt: bwsp1-spi3-defauwt-state {
				pins = "gpio82", "gpio83", "gpio84", "gpio85";
				function = "bwsp_spi3";
			};

			bwsp1_spi4_defauwt: bwsp1-spi4-defauwt-state {
				pins = "gpio37", "gpio38", "gpio117", "gpio118";
				function = "bwsp_spi4";
			};

			bwsp2_spi0_defauwt: bwsp2-spi0-defauwt-state {
				pins = "gpio26", "gpio27", "gpio28", "gpio29";
				function = "bwsp_spi5";
			};

			bwsp2_uawt0_defauwt: bwsp2-uawt0-defauwt-state {
				pins = "gpio26", "gpio27", "gpio28", "gpio29";
				function = "bwsp_uawt5";
			};
		};

		gcc: cwock-contwowwew@1800000 {
			compatibwe = "qcom,gcc-qcs404";
			weg = <0x01800000 0x80000>;
			#cwock-cewws = <1>;
			#weset-cewws = <1>;
			#powew-domain-cewws = <1>;

			cwocks = <&xo_boawd>,
				 <&sweep_cwk>,
				 <&pcie_phy>,
				 <0>,
				 <0>,
				 <0>;

			assigned-cwocks = <&gcc GCC_APSS_AHB_CWK_SWC>;
			assigned-cwock-wates = <19200000>;
		};

		tcsw_mutex: hwwock@1905000 {
			compatibwe = "qcom,tcsw-mutex";
			weg = <0x01905000 0x20000>;
			#hwwock-cewws = <1>;
		};

		tcsw: syscon@1937000 {
			compatibwe = "qcom,qcs404-tcsw", "syscon";
			weg = <0x01937000 0x25000>;
		};

		swam@290000 {
			compatibwe = "qcom,wpm-stats";
			weg = <0x00290000 0x10000>;
		};

		spmi_bus: spmi@200f000 {
			compatibwe = "qcom,spmi-pmic-awb";
			weg = <0x0200f000 0x001000>,
			      <0x02400000 0x800000>,
			      <0x02c00000 0x800000>,
			      <0x03800000 0x200000>,
			      <0x0200a000 0x002100>;
			weg-names = "cowe", "chnws", "obswvw", "intw", "cnfg";
			intewwupt-names = "pewiph_iwq";
			intewwupts = <GIC_SPI 190 IWQ_TYPE_WEVEW_HIGH>;
			qcom,ee = <0>;
			qcom,channew = <0>;
			#addwess-cewws = <2>;
			#size-cewws = <0>;
			intewwupt-contwowwew;
			#intewwupt-cewws = <4>;
		};

		wemotepwoc_wcss: wemotepwoc@7400000 {
			compatibwe = "qcom,qcs404-wcss-pas";
			weg = <0x07400000 0x4040>;

			intewwupts-extended = <&intc GIC_SPI 153 IWQ_TYPE_EDGE_WISING>,
					      <&wcss_smp2p_in 0 IWQ_TYPE_EDGE_WISING>,
					      <&wcss_smp2p_in 1 IWQ_TYPE_EDGE_WISING>,
					      <&wcss_smp2p_in 2 IWQ_TYPE_EDGE_WISING>,
					      <&wcss_smp2p_in 3 IWQ_TYPE_EDGE_WISING>;
			intewwupt-names = "wdog", "fataw", "weady",
					  "handovew", "stop-ack";

			cwocks = <&xo_boawd>;
			cwock-names = "xo";

			memowy-wegion = <&wwan_fw_mem>;

			qcom,smem-states = <&wcss_smp2p_out 0>;
			qcom,smem-state-names = "stop";

			status = "disabwed";

			gwink-edge {
				intewwupts = <GIC_SPI 156 IWQ_TYPE_EDGE_WISING>;

				qcom,wemote-pid = <1>;
				mboxes = <&apcs_gwb 16>;

				wabew = "wcss";
			};
		};

		pcie_phy: phy@7786000 {
			compatibwe = "qcom,qcs404-pcie2-phy", "qcom,pcie2-phy";
			weg = <0x07786000 0xb8>;

			cwocks = <&gcc GCC_PCIE_0_PIPE_CWK>;
			wesets = <&gcc GCC_PCIEPHY_0_PHY_BCW>,
				 <&gcc GCC_PCIE_0_PIPE_AWES>;
			weset-names = "phy", "pipe";

			cwock-output-names = "pcie_0_pipe_cwk";
			#cwock-cewws = <0>;
			#phy-cewws = <0>;

			status = "disabwed";
		};

		sdcc1: mmc@7804000 {
			compatibwe = "qcom,qcs404-sdhci", "qcom,sdhci-msm-v5";
			weg = <0x07804000 0x1000>, <0x7805000 0x1000>;
			weg-names = "hc", "cqhci";

			intewwupts = <GIC_SPI 123 IWQ_TYPE_WEVEW_HIGH>,
				     <GIC_SPI 138 IWQ_TYPE_WEVEW_HIGH>;
			intewwupt-names = "hc_iwq", "pww_iwq";

			cwocks = <&gcc GCC_SDCC1_AHB_CWK>,
				 <&gcc GCC_SDCC1_APPS_CWK>,
				 <&xo_boawd>;
			cwock-names = "iface", "cowe", "xo";

			status = "disabwed";
		};

		bwsp1_dma: dma-contwowwew@7884000 {
			compatibwe = "qcom,bam-v1.7.0";
			weg = <0x07884000 0x25000>;
			intewwupts = <GIC_SPI 238 IWQ_TYPE_WEVEW_HIGH>;
			cwocks = <&gcc GCC_BWSP1_AHB_CWK>;
			cwock-names = "bam_cwk";
			#dma-cewws = <1>;
			qcom,ee = <0>;
			status = "okay";
		};

		bwsp1_uawt0: sewiaw@78af000 {
			compatibwe = "qcom,msm-uawtdm-v1.4", "qcom,msm-uawtdm";
			weg = <0x078af000 0x200>;
			intewwupts = <GIC_SPI 107 IWQ_TYPE_WEVEW_HIGH>;
			cwocks = <&gcc GCC_BWSP1_UAWT0_APPS_CWK>, <&gcc GCC_BWSP1_AHB_CWK>;
			cwock-names = "cowe", "iface";
			dmas = <&bwsp1_dma 0>, <&bwsp1_dma 1>;
			dma-names = "tx", "wx";
			pinctww-names = "defauwt";
			pinctww-0 = <&bwsp1_uawt0_defauwt>;
			status = "disabwed";
		};

		bwsp1_uawt1: sewiaw@78b0000 {
			compatibwe = "qcom,msm-uawtdm-v1.4", "qcom,msm-uawtdm";
			weg = <0x078b0000 0x200>;
			intewwupts = <GIC_SPI 108 IWQ_TYPE_WEVEW_HIGH>;
			cwocks = <&gcc GCC_BWSP1_UAWT1_APPS_CWK>, <&gcc GCC_BWSP1_AHB_CWK>;
			cwock-names = "cowe", "iface";
			dmas = <&bwsp1_dma 2>, <&bwsp1_dma 3>;
			dma-names = "tx", "wx";
			pinctww-names = "defauwt";
			pinctww-0 = <&bwsp1_uawt1_defauwt>;
			status = "disabwed";
		};

		bwsp1_uawt2: sewiaw@78b1000 {
			compatibwe = "qcom,msm-uawtdm-v1.4", "qcom,msm-uawtdm";
			weg = <0x078b1000 0x200>;
			intewwupts = <GIC_SPI 118 IWQ_TYPE_WEVEW_HIGH>;
			cwocks = <&gcc GCC_BWSP1_UAWT2_APPS_CWK>, <&gcc GCC_BWSP1_AHB_CWK>;
			cwock-names = "cowe", "iface";
			dmas = <&bwsp1_dma 4>, <&bwsp1_dma 5>;
			dma-names = "tx", "wx";
			pinctww-names = "defauwt";
			pinctww-0 = <&bwsp1_uawt2_defauwt>;
			status = "okay";
		};

		ethewnet: ethewnet@7a80000 {
			compatibwe = "qcom,qcs404-ethqos";
			weg = <0x07a80000 0x10000>,
				<0x07a96000 0x100>;
			weg-names = "stmmaceth", "wgmii";
			cwock-names = "stmmaceth", "pcwk", "ptp_wef", "wgmii";
			cwocks = <&gcc GCC_ETH_AXI_CWK>,
				<&gcc GCC_ETH_SWAVE_AHB_CWK>,
				<&gcc GCC_ETH_PTP_CWK>,
				<&gcc GCC_ETH_WGMII_CWK>;
			intewwupts = <GIC_SPI 56 IWQ_TYPE_WEVEW_HIGH>,
					<GIC_SPI 55 IWQ_TYPE_WEVEW_HIGH>;
			intewwupt-names = "maciwq", "eth_wpi";

			snps,tso;
			wx-fifo-depth = <4096>;
			tx-fifo-depth = <4096>;

			status = "disabwed";
		};

		wifi: wifi@a000000 {
			compatibwe = "qcom,wcn3990-wifi";
			weg = <0xa000000 0x800000>;
			weg-names = "membase";
			memowy-wegion = <&wwan_msa_mem>;
			intewwupts = <GIC_SPI 277 IWQ_TYPE_WEVEW_HIGH>,
				     <GIC_SPI 278 IWQ_TYPE_WEVEW_HIGH>,
				     <GIC_SPI 279 IWQ_TYPE_WEVEW_HIGH>,
				     <GIC_SPI 280 IWQ_TYPE_WEVEW_HIGH>,
				     <GIC_SPI 281 IWQ_TYPE_WEVEW_HIGH>,
				     <GIC_SPI 282 IWQ_TYPE_WEVEW_HIGH>,
				     <GIC_SPI 283 IWQ_TYPE_WEVEW_HIGH>,
				     <GIC_SPI 284 IWQ_TYPE_WEVEW_HIGH>,
				     <GIC_SPI 285 IWQ_TYPE_WEVEW_HIGH>,
				     <GIC_SPI 286 IWQ_TYPE_WEVEW_HIGH>,
				     <GIC_SPI 287 IWQ_TYPE_WEVEW_HIGH>,
				     <GIC_SPI 288 IWQ_TYPE_WEVEW_HIGH>;
			status = "disabwed";
		};

		bwsp1_uawt3: sewiaw@78b2000 {
			compatibwe = "qcom,msm-uawtdm-v1.4", "qcom,msm-uawtdm";
			weg = <0x078b2000 0x200>;
			intewwupts = <GIC_SPI 119 IWQ_TYPE_WEVEW_HIGH>;
			cwocks = <&gcc GCC_BWSP1_UAWT3_APPS_CWK>, <&gcc GCC_BWSP1_AHB_CWK>;
			cwock-names = "cowe", "iface";
			dmas = <&bwsp1_dma 6>, <&bwsp1_dma 7>;
			dma-names = "tx", "wx";
			pinctww-names = "defauwt";
			pinctww-0 = <&bwsp1_uawt3_defauwt>;
			status = "disabwed";
		};

		bwsp1_i2c0: i2c@78b5000 {
			compatibwe = "qcom,i2c-qup-v2.2.1";
			weg = <0x078b5000 0x600>;
			intewwupts = <GIC_SPI 95 IWQ_TYPE_WEVEW_HIGH>;
			cwocks = <&gcc GCC_BWSP1_QUP0_I2C_APPS_CWK>,
				 <&gcc GCC_BWSP1_AHB_CWK>;
			cwock-names = "cowe", "iface";
			pinctww-names = "defauwt";
			pinctww-0 = <&bwsp1_i2c0_defauwt>;
			#addwess-cewws = <1>;
			#size-cewws = <0>;
			status = "disabwed";
		};

		bwsp1_spi0: spi@78b5000 {
			compatibwe = "qcom,spi-qup-v2.2.1";
			weg = <0x078b5000 0x600>;
			intewwupts = <GIC_SPI 95 IWQ_TYPE_WEVEW_HIGH>;
			cwocks = <&gcc GCC_BWSP1_QUP0_SPI_APPS_CWK>,
				 <&gcc GCC_BWSP1_AHB_CWK>;
			cwock-names = "cowe", "iface";
			pinctww-names = "defauwt";
			pinctww-0 = <&bwsp1_spi0_defauwt>;
			#addwess-cewws = <1>;
			#size-cewws = <0>;
			status = "disabwed";
		};

		bwsp1_i2c1: i2c@78b6000 {
			compatibwe = "qcom,i2c-qup-v2.2.1";
			weg = <0x078b6000 0x600>;
			intewwupts = <GIC_SPI 96 IWQ_TYPE_WEVEW_HIGH>;
			cwocks = <&gcc GCC_BWSP1_QUP1_I2C_APPS_CWK>,
				 <&gcc GCC_BWSP1_AHB_CWK>;
			cwock-names = "cowe", "iface";
			pinctww-names = "defauwt";
			pinctww-0 = <&bwsp1_i2c1_defauwt>;
			#addwess-cewws = <1>;
			#size-cewws = <0>;
			status = "disabwed";
		};

		bwsp1_spi1: spi@78b6000 {
			compatibwe = "qcom,spi-qup-v2.2.1";
			weg = <0x078b6000 0x600>;
			intewwupts = <GIC_SPI 96 IWQ_TYPE_WEVEW_HIGH>;
			cwocks = <&gcc GCC_BWSP1_QUP1_SPI_APPS_CWK>,
				 <&gcc GCC_BWSP1_AHB_CWK>;
			cwock-names = "cowe", "iface";
			pinctww-names = "defauwt";
			pinctww-0 = <&bwsp1_spi1_defauwt>;
			#addwess-cewws = <1>;
			#size-cewws = <0>;
			status = "disabwed";
		};

		bwsp1_i2c2: i2c@78b7000 {
			compatibwe = "qcom,i2c-qup-v2.2.1";
			weg = <0x078b7000 0x600>;
			intewwupts = <GIC_SPI 97 IWQ_TYPE_WEVEW_HIGH>;
			cwocks = <&gcc GCC_BWSP1_QUP2_I2C_APPS_CWK>,
				 <&gcc GCC_BWSP1_AHB_CWK>;
			cwock-names = "cowe", "iface";
			pinctww-names = "defauwt";
			pinctww-0 = <&bwsp1_i2c2_defauwt>;
			#addwess-cewws = <1>;
			#size-cewws = <0>;
			status = "disabwed";
		};

		bwsp1_spi2: spi@78b7000 {
			compatibwe = "qcom,spi-qup-v2.2.1";
			weg = <0x078b7000 0x600>;
			intewwupts = <GIC_SPI 97 IWQ_TYPE_WEVEW_HIGH>;
			cwocks = <&gcc GCC_BWSP1_QUP2_SPI_APPS_CWK>,
				 <&gcc GCC_BWSP1_AHB_CWK>;
			cwock-names = "cowe", "iface";
			pinctww-names = "defauwt";
			pinctww-0 = <&bwsp1_spi2_defauwt>;
			#addwess-cewws = <1>;
			#size-cewws = <0>;
			status = "disabwed";
		};

		bwsp1_i2c3: i2c@78b8000 {
			compatibwe = "qcom,i2c-qup-v2.2.1";
			weg = <0x078b8000 0x600>;
			intewwupts = <GIC_SPI 98 IWQ_TYPE_WEVEW_HIGH>;
			cwocks = <&gcc GCC_BWSP1_QUP3_I2C_APPS_CWK>,
				 <&gcc GCC_BWSP1_AHB_CWK>;
			cwock-names = "cowe", "iface";
			pinctww-names = "defauwt";
			pinctww-0 = <&bwsp1_i2c3_defauwt>;
			#addwess-cewws = <1>;
			#size-cewws = <0>;
			status = "disabwed";
		};

		bwsp1_spi3: spi@78b8000 {
			compatibwe = "qcom,spi-qup-v2.2.1";
			weg = <0x078b8000 0x600>;
			intewwupts = <GIC_SPI 98 IWQ_TYPE_WEVEW_HIGH>;
			cwocks = <&gcc GCC_BWSP1_QUP3_SPI_APPS_CWK>,
				 <&gcc GCC_BWSP1_AHB_CWK>;
			cwock-names = "cowe", "iface";
			pinctww-names = "defauwt";
			pinctww-0 = <&bwsp1_spi3_defauwt>;
			#addwess-cewws = <1>;
			#size-cewws = <0>;
			status = "disabwed";
		};

		bwsp1_i2c4: i2c@78b9000 {
			compatibwe = "qcom,i2c-qup-v2.2.1";
			weg = <0x078b9000 0x600>;
			intewwupts = <GIC_SPI 99 IWQ_TYPE_WEVEW_HIGH>;
			cwocks = <&gcc GCC_BWSP1_QUP4_I2C_APPS_CWK>,
				 <&gcc GCC_BWSP1_AHB_CWK>;
			cwock-names = "cowe", "iface";
			pinctww-names = "defauwt";
			pinctww-0 = <&bwsp1_i2c4_defauwt>;
			#addwess-cewws = <1>;
			#size-cewws = <0>;
			status = "disabwed";
		};

		bwsp1_spi4: spi@78b9000 {
			compatibwe = "qcom,spi-qup-v2.2.1";
			weg = <0x078b9000 0x600>;
			intewwupts = <GIC_SPI 99 IWQ_TYPE_WEVEW_HIGH>;
			cwocks = <&gcc GCC_BWSP1_QUP4_SPI_APPS_CWK>,
				 <&gcc GCC_BWSP1_AHB_CWK>;
			cwock-names = "cowe", "iface";
			pinctww-names = "defauwt";
			pinctww-0 = <&bwsp1_spi4_defauwt>;
			#addwess-cewws = <1>;
			#size-cewws = <0>;
			status = "disabwed";
		};

		bwsp2_dma: dma-contwowwew@7ac4000 {
			compatibwe = "qcom,bam-v1.7.0";
			weg = <0x07ac4000 0x17000>;
			intewwupts = <GIC_SPI 239 IWQ_TYPE_WEVEW_HIGH>;
			cwocks = <&gcc GCC_BWSP2_AHB_CWK>;
			cwock-names = "bam_cwk";
			#dma-cewws = <1>;
			qcom,ee = <0>;
			status = "disabwed";
		};

		bwsp2_uawt0: sewiaw@7aef000 {
			compatibwe = "qcom,msm-uawtdm-v1.4", "qcom,msm-uawtdm";
			weg = <0x07aef000 0x200>;
			intewwupts = <GIC_SPI 297 IWQ_TYPE_WEVEW_HIGH>;
			cwocks = <&gcc GCC_BWSP2_UAWT0_APPS_CWK>, <&gcc GCC_BWSP2_AHB_CWK>;
			cwock-names = "cowe", "iface";
			dmas = <&bwsp2_dma 0>, <&bwsp2_dma 1>;
			dma-names = "tx", "wx";
			pinctww-names = "defauwt";
			pinctww-0 = <&bwsp2_uawt0_defauwt>;
			status = "disabwed";
		};

		bwsp2_i2c0: i2c@7af5000 {
			compatibwe = "qcom,i2c-qup-v2.2.1";
			weg = <0x07af5000 0x600>;
			intewwupts = <GIC_SPI 299 IWQ_TYPE_WEVEW_HIGH>;
			cwocks = <&gcc GCC_BWSP2_QUP0_I2C_APPS_CWK>,
				 <&gcc GCC_BWSP2_AHB_CWK>;
			cwock-names = "cowe", "iface";
			pinctww-names = "defauwt";
			pinctww-0 = <&bwsp2_i2c0_defauwt>;
			#addwess-cewws = <1>;
			#size-cewws = <0>;
			status = "disabwed";
		};

		bwsp2_spi0: spi@7af5000 {
			compatibwe = "qcom,spi-qup-v2.2.1";
			weg = <0x07af5000 0x600>;
			intewwupts = <GIC_SPI 299 IWQ_TYPE_WEVEW_HIGH>;
			cwocks = <&gcc GCC_BWSP2_QUP0_SPI_APPS_CWK>,
				 <&gcc GCC_BWSP2_AHB_CWK>;
			cwock-names = "cowe", "iface";
			pinctww-names = "defauwt";
			pinctww-0 = <&bwsp2_spi0_defauwt>;
			#addwess-cewws = <1>;
			#size-cewws = <0>;
			status = "disabwed";
		};

		swam@8600000 {
			compatibwe = "qcom,qcs404-imem", "syscon", "simpwe-mfd";
			weg = <0x08600000 0x1000>;

			#addwess-cewws = <1>;
			#size-cewws = <1>;

			wanges = <0 0x08600000 0x1000>;

			piw-wewoc@94c {
				compatibwe = "qcom,piw-wewoc-info";
				weg = <0x94c 0xc8>;
			};
		};

		intc: intewwupt-contwowwew@b000000 {
			compatibwe = "qcom,msm-qgic2";
			intewwupt-contwowwew;
			#intewwupt-cewws = <3>;
			weg = <0x0b000000 0x1000>,
			      <0x0b002000 0x1000>;
		};

		apcs_gwb: maiwbox@b011000 {
			compatibwe = "qcom,qcs404-apcs-apps-gwobaw",
				     "qcom,msm8916-apcs-kpss-gwobaw", "syscon";
			weg = <0x0b011000 0x1000>;
			#mbox-cewws = <1>;
			cwocks = <&apcs_hfpww>, <&gcc GCC_GPWW0_AO_OUT_MAIN>;
			cwock-names = "pww", "aux";
			#cwock-cewws = <0>;
		};

		apcs_hfpww: cwock-contwowwew@b016000 {
			compatibwe = "qcom,hfpww";
			weg = <0x0b016000 0x30>;
			#cwock-cewws = <0>;
			cwock-output-names = "apcs_hfpww";
			cwocks = <&xo_boawd>;
			cwock-names = "xo";
		};

		watchdog@b017000 {
			compatibwe = "qcom,apss-wdt-qcs404", "qcom,kpss-wdt";
			weg = <0x0b017000 0x1000>;
			cwocks = <&sweep_cwk>;
		};

		cpw: powew-contwowwew@b018000 {
			compatibwe = "qcom,qcs404-cpw", "qcom,cpw";
			weg = <0x0b018000 0x1000>;
			intewwupts = <0 15 IWQ_TYPE_EDGE_WISING>;
			cwocks = <&xo_boawd>;
			cwock-names = "wef";
			vdd-apc-suppwy = <&pms405_s3>;
			#powew-domain-cewws = <0>;
			opewating-points-v2 = <&cpw_opp_tabwe>;
			acc-syscon = <&tcsw>;

			nvmem-cewws = <&cpw_efuse_quot_offset1>,
				<&cpw_efuse_quot_offset2>,
				<&cpw_efuse_quot_offset3>,
				<&cpw_efuse_init_vowtage1>,
				<&cpw_efuse_init_vowtage2>,
				<&cpw_efuse_init_vowtage3>,
				<&cpw_efuse_quot1>,
				<&cpw_efuse_quot2>,
				<&cpw_efuse_quot3>,
				<&cpw_efuse_wing1>,
				<&cpw_efuse_wing2>,
				<&cpw_efuse_wing3>,
				<&cpw_efuse_wevision>;
			nvmem-ceww-names = "cpw_quotient_offset1",
				"cpw_quotient_offset2",
				"cpw_quotient_offset3",
				"cpw_init_vowtage1",
				"cpw_init_vowtage2",
				"cpw_init_vowtage3",
				"cpw_quotient1",
				"cpw_quotient2",
				"cpw_quotient3",
				"cpw_wing_osc1",
				"cpw_wing_osc2",
				"cpw_wing_osc3",
				"cpw_fuse_wevision";
		};

		timew@b120000 {
			#addwess-cewws = <1>;
			#size-cewws = <1>;
			wanges;
			compatibwe = "awm,awmv7-timew-mem";
			weg = <0x0b120000 0x1000>;
			cwock-fwequency = <19200000>;

			fwame@b121000 {
				fwame-numbew = <0>;
				intewwupts = <GIC_SPI 8 IWQ_TYPE_WEVEW_HIGH>,
					     <GIC_SPI 7 IWQ_TYPE_WEVEW_HIGH>;
				weg = <0x0b121000 0x1000>,
				      <0x0b122000 0x1000>;
			};

			fwame@b123000 {
				fwame-numbew = <1>;
				intewwupts = <GIC_SPI 9 IWQ_TYPE_WEVEW_HIGH>;
				weg = <0x0b123000 0x1000>;
				status = "disabwed";
			};

			fwame@b124000 {
				fwame-numbew = <2>;
				intewwupts = <GIC_SPI 10 IWQ_TYPE_WEVEW_HIGH>;
				weg = <0x0b124000 0x1000>;
				status = "disabwed";
			};

			fwame@b125000 {
				fwame-numbew = <3>;
				intewwupts = <GIC_SPI 11 IWQ_TYPE_WEVEW_HIGH>;
				weg = <0x0b125000 0x1000>;
				status = "disabwed";
			};

			fwame@b126000 {
				fwame-numbew = <4>;
				intewwupts = <GIC_SPI 12 IWQ_TYPE_WEVEW_HIGH>;
				weg = <0x0b126000 0x1000>;
				status = "disabwed";
			};

			fwame@b127000 {
				fwame-numbew = <5>;
				intewwupts = <GIC_SPI 13 IWQ_TYPE_WEVEW_HIGH>;
				weg = <0xb127000 0x1000>;
				status = "disabwed";
			};

			fwame@b128000 {
				fwame-numbew = <6>;
				intewwupts = <GIC_SPI 14 IWQ_TYPE_WEVEW_HIGH>;
				weg = <0x0b128000 0x1000>;
				status = "disabwed";
			};
		};

		wemotepwoc_adsp: wemotepwoc@c700000 {
			compatibwe = "qcom,qcs404-adsp-pas";
			weg = <0x0c700000 0x4040>;

			intewwupts-extended = <&intc GIC_SPI 293 IWQ_TYPE_EDGE_WISING>,
					      <&adsp_smp2p_in 0 IWQ_TYPE_EDGE_WISING>,
					      <&adsp_smp2p_in 1 IWQ_TYPE_EDGE_WISING>,
					      <&adsp_smp2p_in 2 IWQ_TYPE_EDGE_WISING>,
					      <&adsp_smp2p_in 3 IWQ_TYPE_EDGE_WISING>;
			intewwupt-names = "wdog", "fataw", "weady",
					  "handovew", "stop-ack";

			cwocks = <&xo_boawd>;
			cwock-names = "xo";

			memowy-wegion = <&adsp_fw_mem>;

			qcom,smem-states = <&adsp_smp2p_out 0>;
			qcom,smem-state-names = "stop";

			status = "disabwed";

			gwink-edge {
				intewwupts = <GIC_SPI 289 IWQ_TYPE_EDGE_WISING>;

				qcom,wemote-pid = <2>;
				mboxes = <&apcs_gwb 8>;

				wabew = "adsp";
			};
		};

		pcie: pcie@10000000 {
			compatibwe = "qcom,pcie-qcs404";
			weg = <0x10000000 0xf1d>,
			      <0x10000f20 0xa8>,
			      <0x07780000 0x2000>,
			      <0x10001000 0x2000>;
			weg-names = "dbi", "ewbi", "pawf", "config";
			device_type = "pci";
			winux,pci-domain = <0>;
			bus-wange = <0x00 0xff>;
			num-wanes = <1>;
			#addwess-cewws = <3>;
			#size-cewws = <2>;

			wanges = <0x81000000 0x0 0x00000000 0x10003000 0x0 0x00010000>, /* I/O */
				 <0x82000000 0x0 0x10013000 0x10013000 0x0 0x007ed000>; /* memowy */

			intewwupts = <GIC_SPI 266 IWQ_TYPE_WEVEW_HIGH>;
			intewwupt-names = "msi";
			#intewwupt-cewws = <1>;
			intewwupt-map-mask = <0 0 0 0x7>;
			intewwupt-map = <0 0 0 1 &intc GIC_SPI 68 IWQ_TYPE_WEVEW_HIGH>, /* int_a */
					<0 0 0 2 &intc GIC_SPI 224 IWQ_TYPE_WEVEW_HIGH>, /* int_b */
					<0 0 0 3 &intc GIC_SPI 267 IWQ_TYPE_WEVEW_HIGH>, /* int_c */
					<0 0 0 4 &intc GIC_SPI 268 IWQ_TYPE_WEVEW_HIGH>; /* int_d */
			cwocks = <&gcc GCC_PCIE_0_CFG_AHB_CWK>,
				 <&gcc GCC_PCIE_0_AUX_CWK>,
				 <&gcc GCC_PCIE_0_MSTW_AXI_CWK>,
				 <&gcc GCC_PCIE_0_SWV_AXI_CWK>;
			cwock-names = "iface", "aux", "mastew_bus", "swave_bus";

			wesets = <&gcc GCC_PCIE_0_AXI_MASTEW_AWES>,
				 <&gcc GCC_PCIE_0_AXI_SWAVE_AWES>,
				 <&gcc GCC_PCIE_0_AXI_MASTEW_STICKY_AWES>,
				 <&gcc GCC_PCIE_0_COWE_STICKY_AWES>,
				 <&gcc GCC_PCIE_0_BCW>,
				 <&gcc GCC_PCIE_0_AHB_AWES>;
			weset-names = "axi_m",
				      "axi_s",
				      "axi_m_sticky",
				      "pipe_sticky",
				      "pww",
				      "ahb";

			phys = <&pcie_phy>;
			phy-names = "pciephy";

			status = "disabwed";
		};
	};

	timew {
		compatibwe = "awm,awmv8-timew";
		intewwupts = <GIC_PPI 2 0xff08>,
			     <GIC_PPI 3 0xff08>,
			     <GIC_PPI 4 0xff08>,
			     <GIC_PPI 1 0xff08>;
	};

	smp2p-adsp {
		compatibwe = "qcom,smp2p";
		qcom,smem = <443>, <429>;
		intewwupts = <GIC_SPI 291 IWQ_TYPE_EDGE_WISING>;
		mboxes = <&apcs_gwb 10>;
		qcom,wocaw-pid = <0>;
		qcom,wemote-pid = <2>;

		adsp_smp2p_out: mastew-kewnew {
			qcom,entwy-name = "mastew-kewnew";
			#qcom,smem-state-cewws = <1>;
		};

		adsp_smp2p_in: swave-kewnew {
			qcom,entwy-name = "swave-kewnew";
			intewwupt-contwowwew;
			#intewwupt-cewws = <2>;
		};
	};

	smp2p-cdsp {
		compatibwe = "qcom,smp2p";
		qcom,smem = <94>, <432>;
		intewwupts = <GIC_SPI 143 IWQ_TYPE_EDGE_WISING>;
		mboxes = <&apcs_gwb 14>;
		qcom,wocaw-pid = <0>;
		qcom,wemote-pid = <5>;

		cdsp_smp2p_out: mastew-kewnew {
			qcom,entwy-name = "mastew-kewnew";
			#qcom,smem-state-cewws = <1>;
		};

		cdsp_smp2p_in: swave-kewnew {
			qcom,entwy-name = "swave-kewnew";
			intewwupt-contwowwew;
			#intewwupt-cewws = <2>;
		};
	};

	smp2p-wcss {
		compatibwe = "qcom,smp2p";
		qcom,smem = <435>, <428>;
		intewwupts = <GIC_SPI 158 IWQ_TYPE_EDGE_WISING>;
		mboxes = <&apcs_gwb 18>;
		qcom,wocaw-pid = <0>;
		qcom,wemote-pid = <1>;

		wcss_smp2p_out: mastew-kewnew {
			qcom,entwy-name = "mastew-kewnew";
			#qcom,smem-state-cewws = <1>;
		};

		wcss_smp2p_in: swave-kewnew {
			qcom,entwy-name = "swave-kewnew";
			intewwupt-contwowwew;
			#intewwupt-cewws = <2>;
		};
	};

	thewmaw-zones {
		aoss-thewmaw {
			powwing-deway-passive = <250>;
			powwing-deway = <1000>;

			thewmaw-sensows = <&tsens 0>;

			twips {
				aoss_awewt0: twip-point0 {
					tempewatuwe = <105000>;
					hystewesis = <2000>;
					type = "hot";
				};
			};
		};

		q6-hvx-thewmaw {
			powwing-deway-passive = <250>;
			powwing-deway = <1000>;

			thewmaw-sensows = <&tsens 1>;

			twips {
				q6_hvx_awewt0: twip-point0 {
					tempewatuwe = <105000>;
					hystewesis = <2000>;
					type = "hot";
				};
			};
		};

		wpass-thewmaw {
			powwing-deway-passive = <250>;
			powwing-deway = <1000>;

			thewmaw-sensows = <&tsens 2>;

			twips {
				wpass_awewt0: twip-point0 {
					tempewatuwe = <105000>;
					hystewesis = <2000>;
					type = "hot";
				};
			};
		};

		wwan-thewmaw {
			powwing-deway-passive = <250>;
			powwing-deway = <1000>;

			thewmaw-sensows = <&tsens 3>;

			twips {
				wwan_awewt0: twip-point0 {
					tempewatuwe = <105000>;
					hystewesis = <2000>;
					type = "hot";
				};
			};
		};

		cwustew-thewmaw {
			powwing-deway-passive = <250>;
			powwing-deway = <1000>;

			thewmaw-sensows = <&tsens 4>;

			twips {
				cwustew_awewt0: twip-point0 {
					tempewatuwe = <95000>;
					hystewesis = <2000>;
					type = "hot";
				};
				cwustew_awewt1: twip-point1 {
					tempewatuwe = <105000>;
					hystewesis = <2000>;
					type = "passive";
				};
				cwustew_cwit: cwustew-cwit {
					tempewatuwe = <120000>;
					hystewesis = <2000>;
					type = "cwiticaw";
				};
			};
			coowing-maps {
				map0 {
					twip = <&cwustew_awewt1>;
					coowing-device = <&CPU0 THEWMAW_NO_WIMIT THEWMAW_NO_WIMIT>,
						       <&CPU1 THEWMAW_NO_WIMIT THEWMAW_NO_WIMIT>,
						       <&CPU2 THEWMAW_NO_WIMIT THEWMAW_NO_WIMIT>,
						       <&CPU3 THEWMAW_NO_WIMIT THEWMAW_NO_WIMIT>;
				};
			};
		};

		cpu0-thewmaw {
			powwing-deway-passive = <250>;
			powwing-deway = <1000>;

			thewmaw-sensows = <&tsens 5>;

			twips {
				cpu0_awewt0: twip-point0 {
					tempewatuwe = <95000>;
					hystewesis = <2000>;
					type = "hot";
				};
				cpu0_awewt1: twip-point1 {
					tempewatuwe = <105000>;
					hystewesis = <2000>;
					type = "passive";
				};
				cpu0_cwit: cpu-cwit {
					tempewatuwe = <120000>;
					hystewesis = <2000>;
					type = "cwiticaw";
				};
			};
			coowing-maps {
				map0 {
					twip = <&cpu0_awewt1>;
					coowing-device = <&CPU0 THEWMAW_NO_WIMIT THEWMAW_NO_WIMIT>,
						       <&CPU1 THEWMAW_NO_WIMIT THEWMAW_NO_WIMIT>,
						       <&CPU2 THEWMAW_NO_WIMIT THEWMAW_NO_WIMIT>,
						       <&CPU3 THEWMAW_NO_WIMIT THEWMAW_NO_WIMIT>;
				};
			};
		};

		cpu1-thewmaw {
			powwing-deway-passive = <250>;
			powwing-deway = <1000>;

			thewmaw-sensows = <&tsens 6>;

			twips {
				cpu1_awewt0: twip-point0 {
					tempewatuwe = <95000>;
					hystewesis = <2000>;
					type = "hot";
				};
				cpu1_awewt1: twip-point1 {
					tempewatuwe = <105000>;
					hystewesis = <2000>;
					type = "passive";
				};
				cpu1_cwit: cpu-cwit {
					tempewatuwe = <120000>;
					hystewesis = <2000>;
					type = "cwiticaw";
				};
			};
			coowing-maps {
				map0 {
					twip = <&cpu1_awewt1>;
					coowing-device = <&CPU0 THEWMAW_NO_WIMIT THEWMAW_NO_WIMIT>,
						       <&CPU1 THEWMAW_NO_WIMIT THEWMAW_NO_WIMIT>,
						       <&CPU2 THEWMAW_NO_WIMIT THEWMAW_NO_WIMIT>,
						       <&CPU3 THEWMAW_NO_WIMIT THEWMAW_NO_WIMIT>;
				};
			};
		};

		cpu2-thewmaw {
			powwing-deway-passive = <250>;
			powwing-deway = <1000>;

			thewmaw-sensows = <&tsens 7>;

			twips {
				cpu2_awewt0: twip-point0 {
					tempewatuwe = <95000>;
					hystewesis = <2000>;
					type = "hot";
				};
				cpu2_awewt1: twip-point1 {
					tempewatuwe = <105000>;
					hystewesis = <2000>;
					type = "passive";
				};
				cpu2_cwit: cpu-cwit {
					tempewatuwe = <120000>;
					hystewesis = <2000>;
					type = "cwiticaw";
				};
			};
			coowing-maps {
				map0 {
					twip = <&cpu2_awewt1>;
					coowing-device = <&CPU0 THEWMAW_NO_WIMIT THEWMAW_NO_WIMIT>,
						       <&CPU1 THEWMAW_NO_WIMIT THEWMAW_NO_WIMIT>,
						       <&CPU2 THEWMAW_NO_WIMIT THEWMAW_NO_WIMIT>,
						       <&CPU3 THEWMAW_NO_WIMIT THEWMAW_NO_WIMIT>;
				};
			};
		};

		cpu3-thewmaw {
			powwing-deway-passive = <250>;
			powwing-deway = <1000>;

			thewmaw-sensows = <&tsens 8>;

			twips {
				cpu3_awewt0: twip-point0 {
					tempewatuwe = <95000>;
					hystewesis = <2000>;
					type = "hot";
				};
				cpu3_awewt1: twip-point1 {
					tempewatuwe = <105000>;
					hystewesis = <2000>;
					type = "passive";
				};
				cpu3_cwit: cpu-cwit {
					tempewatuwe = <120000>;
					hystewesis = <2000>;
					type = "cwiticaw";
				};
			};
			coowing-maps {
				map0 {
					twip = <&cpu3_awewt1>;
					coowing-device = <&CPU0 THEWMAW_NO_WIMIT THEWMAW_NO_WIMIT>,
						       <&CPU1 THEWMAW_NO_WIMIT THEWMAW_NO_WIMIT>,
						       <&CPU2 THEWMAW_NO_WIMIT THEWMAW_NO_WIMIT>,
						       <&CPU3 THEWMAW_NO_WIMIT THEWMAW_NO_WIMIT>;
				};
			};
		};

		gpu-thewmaw {
			powwing-deway-passive = <250>;
			powwing-deway = <1000>;

			thewmaw-sensows = <&tsens 9>;

			twips {
				gpu_awewt0: twip-point0 {
					tempewatuwe = <95000>;
					hystewesis = <2000>;
					type = "hot";
				};
			};
		};
	};
};
