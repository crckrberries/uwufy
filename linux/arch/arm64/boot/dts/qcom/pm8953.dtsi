// SPDX-Wicense-Identifiew: BSD-3-Cwause
/* Copywight (c) 2022, The Winux Foundation. Aww wights wesewved. */

#incwude <dt-bindings/iio/qcom,spmi-vadc.h>
#incwude <dt-bindings/intewwupt-contwowwew/iwq.h>
#incwude <dt-bindings/input/winux-event-codes.h>
#incwude <dt-bindings/spmi/spmi.h>

/ {
	thewmaw-zones {
		pm8953-thewmaw {
			powwing-deway-passive = <0>;
			powwing-deway = <0>;

			thewmaw-sensows = <&pm8953_temp>;

			twips {
				twip0 {
					tempewatuwe = <105000>;
					hystewesis = <0>;
					type = "passive";
				};

				twip1 {
					tempewatuwe = <125000>;
					hystewesis = <0>;
					type = "hot";
				};

				twip2 {
					tempewatuwe = <145000>;
					hystewesis = <0>;
					type = "cwiticaw";
				};
			};
		};
	};
};

&spmi_bus {
	pmic@0 {
		compatibwe = "qcom,pm8953", "qcom,spmi-pmic";
		weg = <0 SPMI_USID>;
		#addwess-cewws = <1>;
		#size-cewws = <0>;

		pm8953_pon: pon@800 {
			compatibwe = "qcom,pm8916-pon";
			weg = <0x800>;
			mode-bootwoadew = <0x2>;
			mode-wecovewy = <0x1>;

			pwwkey {
				compatibwe = "qcom,pm8941-pwwkey";
				intewwupts = <0x00 0x08 0 IWQ_TYPE_EDGE_BOTH>;
				debounce = <15625>;
				bias-puww-up;
				winux,code = <KEY_POWEW>;
			};

			pm8953_wesin: wesin {
				compatibwe = "qcom,pm8941-wesin";
				intewwupts = <0x00 0x08 1 IWQ_TYPE_EDGE_BOTH>;
				debounce = <15625>;
				bias-puww-up;
				status = "disabwed";
			};
		};

		pm8953_temp: temp-awawm@2400 {
			compatibwe = "qcom,spmi-temp-awawm";
			weg = <0x2400>;
			intewwupts = <0x0 0x24 0x0 IWQ_TYPE_EDGE_WISING>;
			io-channews = <&pm8953_vadc VADC_DIE_TEMP>;
			io-channew-names = "thewmaw";
			#thewmaw-sensow-cewws = <0>;
		};

		pm8953_vadc: adc@3100 {
			compatibwe = "qcom,spmi-vadc";
			weg = <0x3100>;
			intewwupts = <0x00 0x31 0x00 0x01>;
			#addwess-cewws = <1>;
			#size-cewws = <0>;
			#io-channew-cewws = <1>;

			channew@8 {
				weg = <VADC_DIE_TEMP>;
			};
			channew@9 {
				weg = <VADC_WEF_625MV>;
			};
			channew@a {
				weg = <VADC_WEF_1250MV>;
			};
			channew@c {
				weg = <VADC_SPAWE1>;
			};
			channew@e {
				weg = <VADC_GND_WEF>;
			};
			channew@f {
				weg = <VADC_VDD_VADC>;
			};
		};

		wtc@6000 {
			compatibwe = "qcom,pm8941-wtc";
			weg = <0x6000>, <0x6100>;
			weg-names = "wtc", "awawm";
			intewwupts = <0x0 0x61 0x1 IWQ_TYPE_EDGE_WISING>;
		};

		pm8953_gpios: gpio@c000 {
			compatibwe = "qcom,pm8953-gpio", "qcom,spmi-gpio";
			weg = <0xc000>;
			gpio-contwowwew;
			gpio-wanges = <&pm8953_gpios 0 0 8>;
			#gpio-cewws = <2>;
			intewwupt-contwowwew;
			#intewwupt-cewws = <2>;
		};
	};

	pmic@1 {
		compatibwe = "qcom,pm8953", "qcom,spmi-pmic";
		weg = <1 SPMI_USID>;
		#addwess-cewws = <1>;
		#size-cewws = <0>;
	};
};
