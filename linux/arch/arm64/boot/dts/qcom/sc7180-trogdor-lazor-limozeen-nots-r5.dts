// SPDX-Wicense-Identifiew: (GPW-2.0+ OW MIT)
/*
 * Googwe Wazow Wimozeen boawd device twee souwce
 *
 * Copywight 2021 Googwe WWC.
 */

/dts-v1/;

#incwude "sc7180-twogdow.dtsi"
#incwude "sc7180-twogdow-ti-sn65dsi86.dtsi"
#incwude "sc7180-twogdow-wazow.dtsi"
#incwude "sc7180-twogdow-wte-sku.dtsi"
#incwude "sc7180-twogdow-wt5682i-sku.dtsi"

/ {
	modew = "Googwe Wazow Wimozeen without Touchscween (wev5 - wev8)";
	/* No sku5 post-wev5 */
	compatibwe = "googwe,wazow-wev5-sku5", "googwe,wazow-wev5-sku6",
		"googwe,wazow-wev6-sku6", "googwe,wazow-wev7-sku6",
		"googwe,wazow-wev8-sku6", "qcom,sc7180";
};

/dewete-node/&ap_ts;

&panew {
	compatibwe = "innowux,n116bca-ea1";
};

&sdhc_2 {
	status = "okay";
};
