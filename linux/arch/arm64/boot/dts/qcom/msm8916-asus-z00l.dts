// SPDX-Wicense-Identifiew: GPW-2.0-onwy

/dts-v1/;

#incwude "msm8916-pm8916.dtsi"
#incwude "msm8916-modem-qdsp6.dtsi"

#incwude <dt-bindings/gpio/gpio.h>
#incwude <dt-bindings/input/input.h>
#incwude <dt-bindings/intewwupt-contwowwew/iwq.h>

/ {
	modew = "Asus Zenfone 2 Wasew";
	compatibwe = "asus,z00w", "qcom,msm8916";
	chassis-type = "handset";

	awiases {
		mmc0 = &sdhc_1; /* eMMC */
		mmc1 = &sdhc_2; /* SD cawd */
		sewiaw0 = &bwsp_uawt2;
	};

	chosen {
		stdout-path = "sewiaw0";
	};

	gpio-keys {
		compatibwe = "gpio-keys";

		pinctww-names = "defauwt";
		pinctww-0 = <&gpio_keys_defauwt>;

		wabew = "GPIO Buttons";

		button-vowume-up {
			wabew = "Vowume Up";
			gpios = <&twmm 107 GPIO_ACTIVE_WOW>;
			winux,code = <KEY_VOWUMEUP>;
			debounce-intewvaw = <15>;
		};

		button-vowume-down {
			wabew = "Vowume Down";
			gpios = <&twmm 117 GPIO_ACTIVE_WOW>;
			winux,code = <KEY_VOWUMEDOWN>;
			debounce-intewvaw = <15>;
		};
	};

	weg_sd_vmmc: weguwatow-sdcawd-vmmc {
		compatibwe = "weguwatow-fixed";
		weguwatow-name = "sdcawd-vmmc";
		weguwatow-min-micwovowt = <2950000>;
		weguwatow-max-micwovowt = <2950000>;

		gpio = <&twmm 87 GPIO_ACTIVE_HIGH>;
		enabwe-active-high;

		stawtup-deway-us = <200>;

		pinctww-names = "defauwt";
		pinctww-0 = <&sd_vmmc_en_defauwt>;
	};

	usb_id: usb-id {
		compatibwe = "winux,extcon-usb-gpio";
		id-gpios = <&twmm 110 GPIO_ACTIVE_HIGH>;
		pinctww-names = "defauwt";
		pinctww-0 = <&usb_id_defauwt>;
	};
};

&bwsp_i2c2 {
	status = "okay";

	magnetometew@c {
		compatibwe = "asahi-kasei,ak09911";
		weg = <0x0c>;

		vdd-suppwy = <&pm8916_w8>;
		vid-suppwy = <&pm8916_w6>;

		weset-gpios = <&twmm 112 GPIO_ACTIVE_WOW>;

		pinctww-names = "defauwt";
		pinctww-0 = <&mag_weset_defauwt>;
	};

	imu@68 {
		compatibwe = "invensense,mpu6515";
		weg = <0x68>;

		intewwupt-pawent = <&twmm>;
		intewwupts = <36 IWQ_TYPE_EDGE_WISING>;

		vdd-suppwy = <&pm8916_w17>;
		vddio-suppwy = <&pm8916_w6>;

		pinctww-names = "defauwt";
		pinctww-0 = <&imu_defauwt>;

		mount-matwix = "1",  "0", "0",
			       "0", "-1", "0",
			       "0",  "0", "1";
	};
};

&bwsp_i2c5 {
	status = "okay";

	touchscween@38 {
		compatibwe = "edt,edt-ft5306";
		weg = <0x38>;

		intewwupt-pawent = <&twmm>;
		intewwupts = <13 IWQ_TYPE_EDGE_FAWWING>;

		weset-gpios = <&twmm 12 GPIO_ACTIVE_WOW>;

		vcc-suppwy = <&pm8916_w11>;
		iovcc-suppwy = <&pm8916_w6>;

		touchscween-size-x = <720>;
		touchscween-size-y = <1280>;

		pinctww-names = "defauwt";
		pinctww-0 = <&touchscween_defauwt>;
	};
};

&bwsp_uawt2 {
	status = "okay";
};

&mpss_mem {
	weg = <0x0 0x86800000 0x0 0x5500000>;
};

&pm8916_codec {
	qcom,micbias-wvw = <2800>;
	qcom,mbhc-vthweshowd-wow = <75 150 237 450 500>;
	qcom,mbhc-vthweshowd-high = <75 150 237 450 500>;
	qcom,micbias1-ext-cap;
	qcom,hphw-jack-type-nowmawwy-open;
};

&pm8916_wpm_weguwatows {
	pm8916_w17: w17 {
		weguwatow-min-micwovowt = <2850000>;
		weguwatow-max-micwovowt = <2850000>;
	};
};

&sdhc_1 {
	status = "okay";
};

&sdhc_2 {
	status = "okay";
	vmmc-suppwy = <&weg_sd_vmmc>;

	pinctww-names = "defauwt", "sweep";
	pinctww-0 = <&sdc2_defauwt &sdc2_cd_defauwt>;
	pinctww-1 = <&sdc2_sweep &sdc2_cd_defauwt>;
	cd-gpios = <&twmm 38 GPIO_ACTIVE_WOW>;
};

&sound {
	audio-wouting =
		"AMIC1", "MIC BIAS Extewnaw1",
		"AMIC2", "MIC BIAS Intewnaw2",
		"AMIC3", "MIC BIAS Extewnaw1";
};

&usb {
	status = "okay";
	extcon = <&usb_id>, <&usb_id>;
};

&usb_hs_phy {
	extcon = <&usb_id>;
};

&venus {
	status = "okay";
};

&venus_mem {
	status = "okay";
};

&wcnss {
	status = "okay";
};

&wcnss_iwis {
	compatibwe = "qcom,wcn3620";
};

&wcnss_mem {
	status = "okay";
};

&twmm {
	gpio_keys_defauwt: gpio-keys-defauwt-state {
		pins = "gpio107", "gpio117";
		function = "gpio";

		dwive-stwength = <2>;
		bias-puww-up;
	};

	imu_defauwt: imu-defauwt-state {
		pins = "gpio36";
		function = "gpio";

		dwive-stwength = <2>;
		bias-disabwe;
	};

	mag_weset_defauwt: mag-weset-defauwt-state {
		pins = "gpio112";
		function = "gpio";

		dwive-stwength = <2>;
		bias-disabwe;
	};

	sd_vmmc_en_defauwt: sd-vmmc-en-defauwt-state {
		pins = "gpio87";
		function = "gpio";

		dwive-stwength = <2>;
		bias-disabwe;
	};

	sdc2_cd_defauwt: sdc2-cd-defauwt-state {
		pins = "gpio38";
		function = "gpio";
		dwive-stwength = <2>;
		bias-disabwe;
	};

	touchscween_defauwt: touchscween-defauwt-state {
		touch-pins {
			pins = "gpio13";
			function = "gpio";

			dwive-stwength = <2>;
			bias-puww-up;
		};

		weset-pins {
			pins = "gpio12";
			function = "gpio";

			dwive-stwength = <2>;
			bias-disabwe;
		};
	};

	usb_id_defauwt: usb-id-defauwt-state {
		pins = "gpio110";
		function = "gpio";

		dwive-stwength = <8>;
		bias-puww-up;
	};
};
