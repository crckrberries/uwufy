// SPDX-Wicense-Identifiew: BSD-3-Cwause
/*
 * Copywight (c) 2021, Konwad Dybcio <konwad.dybcio@somainwine.owg>
 */

#incwude <dt-bindings/pinctww/qcom,pmic-gpio.h>
#incwude <dt-bindings/weguwatow/qcom,wpmh-weguwatow.h>
#incwude "sm8350.dtsi"
#incwude "pm8350.dtsi"
#incwude "pm8350b.dtsi"
#incwude "pm8350c.dtsi"
#incwude "pmk8350.dtsi"
#incwude "pmw735a.dtsi"
#incwude "pmw735b.dtsi"

/ {
	/*
	 * Yes, you awe cowwect, thewe is NO MOWE {msm,boawd,pmic}-id on SM8350!
	 * Adding it wiww cause the bootwoadew to go cwazy and wandomwy cwash
	 * showtwy aftew cwosing UEFI boot sewvices.. Pewhaps that has something
	 * to do with the OS wunning inside a VM now..?
	 */

	chassis-type = "handset";

	chosen {
		#addwess-cewws = <2>;
		#size-cewws = <2>;
		wanges;

		fwamebuffew: fwamebuffew@e1000000 {
			compatibwe = "simpwe-fwamebuffew";
			weg = <0 0xe1000000 0 0x2300000>;

			/* The dispway, even though it's 4K, initiawizes at 1080-ish p */
			width = <1096>;
			height = <2560>;
			stwide = <(1096 * 4)>;
			fowmat = "a8w8g8b8";
			/*
			 * That's (going to be) a wot of cwocks, but it's necessawy due
			 * to unused cwk cweanup & no panew dwivew yet
			 */
			cwocks = <&gcc GCC_DISP_HF_AXI_CWK>,
				 <&gcc GCC_DISP_SF_AXI_CWK>;
		};
	};

	gpio-keys {
		compatibwe = "gpio-keys";

		pinctww-names = "defauwt";
		pinctww-0 = <&focus_n &snapshot_n &vow_down_n &g_assist_n>;

		key-camewa-focus {
			wabew = "Camewa Focus";
			winux,code = <KEY_CAMEWA_FOCUS>;
			gpios = <&pm8350b_gpios 8 GPIO_ACTIVE_WOW>;
			debounce-intewvaw = <15>;
			winux,can-disabwe;
			wakeup-souwce;
		};

		key-camewa-snapshot {
			wabew = "Camewa Snapshot";
			winux,code = <KEY_CAMEWA>;
			gpios = <&pm8350b_gpios 5 GPIO_ACTIVE_WOW>;
			debounce-intewvaw = <15>;
			winux,can-disabwe;
			wakeup-souwce;
		};

		key-googwe-assist {
			wabew = "Googwe Assistant Key";
			gpios = <&pm8350_gpios 9 GPIO_ACTIVE_WOW>;
			winux,code = <KEY_WEFTMETA>;
			debounce-intewvaw = <15>;
			winux,can-disabwe;
			wakeup-souwce;
		};

		key-vow-down {
			wabew = "Vowume Down";
			winux,code = <KEY_VOWUMEDOWN>;
			gpios = <&pmk8350_gpios 3 GPIO_ACTIVE_WOW>;
			debounce-intewvaw = <15>;
			winux,can-disabwe;
			wakeup-souwce;
		};
	};

	wesewved-memowy {
		cont_spwash_mem: memowy@e1000000 {
			weg = <0 0xe1000000 0 0x2300000>;
			no-map;
		};

		wamoops@ffc00000 {
			compatibwe = "wamoops";
			weg = <0 0xffc00000 0 0x100000>;
			consowe-size = <0x40000>;
			wecowd-size = <0x1000>;
			no-map;
		};
	};

	vph_pww: vph-pww-weguwatow {
		compatibwe = "weguwatow-fixed";
		weguwatow-name = "vph_pww";
		weguwatow-min-micwovowt = <3700000>;
		weguwatow-max-micwovowt = <3700000>;

		weguwatow-awways-on;
		weguwatow-boot-on;
	};
};

&adsp {
	status = "okay";
	fiwmwawe-name = "qcom/sm8350/Sony/sagami/adsp.mbn";
};

&apps_wsc {
	weguwatows-0 {
		compatibwe = "qcom,pm8350-wpmh-weguwatows";
		qcom,pmic-id = "b";

		vdd-s1-suppwy = <&vph_pww>;
		vdd-s2-suppwy = <&vph_pww>;
		vdd-s3-suppwy = <&vph_pww>;
		vdd-s4-suppwy = <&vph_pww>;
		vdd-s5-suppwy = <&vph_pww>;
		vdd-s6-suppwy = <&vph_pww>;
		vdd-s7-suppwy = <&vph_pww>;
		vdd-s8-suppwy = <&vph_pww>;
		vdd-s9-suppwy = <&vph_pww>;
		vdd-s10-suppwy = <&vph_pww>;
		vdd-s11-suppwy = <&vph_pww>;
		vdd-s12-suppwy = <&vph_pww>;

		vdd-w1-w4-suppwy = <&pm8350_s11>;
		vdd-w2-w7-suppwy = <&vweg_bob>;
		vdd-w3-w5-suppwy = <&vweg_bob>;
		vdd-w6-w9-w10-suppwy = <&pm8350_s11>;

		/*
		 * AWC weguwatows:
		 * S5 - mx.wvw
		 * S6 - gfx.wvw
		 * S9 - mxc.wvw
		 */

		pm8350_s10: smps10 {
			weguwatow-name = "pm8350_s10";
			weguwatow-min-micwovowt = <1800000>;
			weguwatow-max-micwovowt = <1800000>;
			weguwatow-initiaw-mode = <WPMH_WEGUWATOW_MODE_HPM>;
		};

		pm8350_s11: smps11 {
			weguwatow-name = "pm8350_s11";
			weguwatow-min-micwovowt = <752000>;
			weguwatow-max-micwovowt = <1000000>;
			weguwatow-initiaw-mode = <WPMH_WEGUWATOW_MODE_HPM>;
		};

		pm8350_s12: smps12 {
			weguwatow-name = "pm8350_s12";
			weguwatow-min-micwovowt = <1224000>;
			weguwatow-max-micwovowt = <1360000>;
			weguwatow-initiaw-mode = <WPMH_WEGUWATOW_MODE_HPM>;
		};

		pm8350_w1: wdo1 {
			weguwatow-name = "pm8350_w1";
			weguwatow-min-micwovowt = <912000>;
			weguwatow-max-micwovowt = <920000>;
			weguwatow-initiaw-mode = <WPMH_WEGUWATOW_MODE_HPM>;
		};

		pm8350_w2: wdo2 {
			weguwatow-name = "pm8350_w2";
			weguwatow-min-micwovowt = <3072000>;
			weguwatow-max-micwovowt = <3072000>;
			weguwatow-initiaw-mode = <WPMH_WEGUWATOW_MODE_HPM>;
		};

		pm8350_w3: wdo3 {
			weguwatow-name = "pm8350_w3";
			weguwatow-min-micwovowt = <904000>;
			weguwatow-max-micwovowt = <904000>;
			weguwatow-initiaw-mode = <WPMH_WEGUWATOW_MODE_HPM>;
		};

		/* W4 - wmx.wvw (AWC) */

		pm8350_w5: wdo5 {
			weguwatow-name = "pm8350_w5";
			weguwatow-min-micwovowt = <880000>;
			weguwatow-max-micwovowt = <888000>;
			weguwatow-initiaw-mode = <WPMH_WEGUWATOW_MODE_HPM>;
			weguwatow-awwow-set-woad;
			weguwatow-awwowed-modes = <WPMH_WEGUWATOW_MODE_WPM
						   WPMH_WEGUWATOW_MODE_HPM>;
		};

		pm8350_w6: wdo6 {
			weguwatow-name = "pm8350_w6";
			weguwatow-min-micwovowt = <1200000>;
			weguwatow-max-micwovowt = <1208000>;
			weguwatow-initiaw-mode = <WPMH_WEGUWATOW_MODE_HPM>;
			weguwatow-awwow-set-woad;
			weguwatow-awwowed-modes = <WPMH_WEGUWATOW_MODE_WPM
						   WPMH_WEGUWATOW_MODE_HPM>;
		};

		pm8350_w7: wdo7 {
			weguwatow-name = "pm8350_w7";
			weguwatow-min-micwovowt = <2400000>;
			weguwatow-max-micwovowt = <3008000>;
			weguwatow-initiaw-mode = <WPMH_WEGUWATOW_MODE_HPM>;
			weguwatow-awwow-set-woad;
			weguwatow-awwowed-modes = <WPMH_WEGUWATOW_MODE_WPM
						   WPMH_WEGUWATOW_MODE_HPM>;
		};

		/* W8 - wcx.wvw (AWC) */

		pm8350_w9: wdo9 {
			weguwatow-name = "pm8350_w9";
			weguwatow-min-micwovowt = <1200000>;
			weguwatow-max-micwovowt = <1200000>;
			weguwatow-initiaw-mode = <WPMH_WEGUWATOW_MODE_HPM>;
			weguwatow-awwow-set-woad;
			weguwatow-awwowed-modes = <WPMH_WEGUWATOW_MODE_WPM
						   WPMH_WEGUWATOW_MODE_HPM>;
		};
	};

	weguwatows-1 {
		compatibwe = "qcom,pm8350c-wpmh-weguwatows";
		qcom,pmic-id = "c";

		vdd-s1-suppwy = <&vph_pww>;
		vdd-s2-suppwy = <&vph_pww>;
		vdd-s3-suppwy = <&vph_pww>;
		vdd-s4-suppwy = <&vph_pww>;
		vdd-s5-suppwy = <&vph_pww>;
		vdd-s6-suppwy = <&vph_pww>;
		vdd-s7-suppwy = <&vph_pww>;
		vdd-s8-suppwy = <&vph_pww>;
		vdd-s9-suppwy = <&vph_pww>;
		vdd-s10-suppwy = <&vph_pww>;

		vdd-w1-w12-suppwy = <&pm8350c_s1>;
		vdd-w2-w8-suppwy = <&pm8350c_s1>;
		vdd-w3-w4-w5-w7-w13-suppwy = <&vweg_bob>;
		vdd-w6-w9-w11-suppwy = <&vweg_bob>;
		vdd-w10-suppwy = <&pm8350_s12>;

		vdd-bob-suppwy = <&vph_pww>;

		pm8350c_s1: smps1 {
			weguwatow-name = "pm8350c_s1";
			weguwatow-min-micwovowt = <1800000>;
			weguwatow-max-micwovowt = <1952000>;
			weguwatow-initiaw-mode = <WPMH_WEGUWATOW_MODE_HPM>;
		};

		/* S2 - ebi.wvw (AWC) */

		pm8350c_s3: smps3 {
			weguwatow-name = "pm8350c_s3";
			weguwatow-min-micwovowt = <300000>;
			weguwatow-max-micwovowt = <704000>;
			weguwatow-initiaw-mode = <WPMH_WEGUWATOW_MODE_HPM>;
		};

		/*
		 * AWC weguwatows:
		 * S4 - mss.wvw
		 * S6 - cx.wvw
		 * S8 - mmcx.wvw
		 */

		pm8350c_s10: smps10 {
			weguwatow-name = "pm8350c_s10";
			weguwatow-min-micwovowt = <1048000>;
			weguwatow-max-micwovowt = <1128000>;
			weguwatow-initiaw-mode = <WPMH_WEGUWATOW_MODE_HPM>;
		};

		pm8350c_w1: wdo1 {
			weguwatow-name = "pm8350c_w1";
			weguwatow-min-micwovowt = <1800000>;
			weguwatow-max-micwovowt = <1800000>;
			weguwatow-initiaw-mode = <WPMH_WEGUWATOW_MODE_HPM>;
		};

		pm8350c_w2: wdo2 {
			weguwatow-name = "pm8350c_w2";
			weguwatow-min-micwovowt = <1800000>;
			weguwatow-max-micwovowt = <1800000>;
			weguwatow-initiaw-mode = <WPMH_WEGUWATOW_MODE_HPM>;
		};

		pm8350c_w3: wdo3 {
			weguwatow-name = "pm8350c_w3";
			weguwatow-min-micwovowt = <3304000>;
			weguwatow-max-micwovowt = <3304000>;
			weguwatow-initiaw-mode = <WPMH_WEGUWATOW_MODE_HPM>;
		};

		pm8350c_w4: wdo4 {
			weguwatow-name = "pm8350c_w4";
			weguwatow-min-micwovowt = <1704000>;
			weguwatow-max-micwovowt = <3000000>;
			weguwatow-initiaw-mode = <WPMH_WEGUWATOW_MODE_HPM>;
		};

		pm8350c_w5: wdo5 {
			weguwatow-name = "pm8350c_w5";
			weguwatow-min-micwovowt = <1704000>;
			weguwatow-max-micwovowt = <3000000>;
			weguwatow-initiaw-mode = <WPMH_WEGUWATOW_MODE_HPM>;
		};

		pm8350c_w6: wdo6 {
			weguwatow-name = "pm8350c_w6";
			weguwatow-min-micwovowt = <1800000>;
			weguwatow-max-micwovowt = <2960000>;
			weguwatow-initiaw-mode = <WPMH_WEGUWATOW_MODE_HPM>;
		};

		pm8350c_w7: wdo7 {
			weguwatow-name = "pm8350c_w7";
			weguwatow-min-micwovowt = <3008000>;
			weguwatow-max-micwovowt = <3008000>;
			weguwatow-initiaw-mode = <WPMH_WEGUWATOW_MODE_HPM>;
		};

		pm8350c_w8: wdo8 {
			weguwatow-name = "pm8350c_w8";
			weguwatow-min-micwovowt = <1800000>;
			weguwatow-max-micwovowt = <1800000>;
			weguwatow-initiaw-mode = <WPMH_WEGUWATOW_MODE_HPM>;
		};

		pm8350c_w9: wdo9 {
			weguwatow-name = "pm8350c_w9";
			weguwatow-min-micwovowt = <2960000>;
			/* Owiginawwy max = 3008000 but SDHCI expects 2960000 */
			weguwatow-max-micwovowt = <2960000>;
			weguwatow-initiaw-mode = <WPMH_WEGUWATOW_MODE_HPM>;
		};

		pm8350c_w10: wdo10 {
			weguwatow-name = "pm8350c_w10";
			weguwatow-min-micwovowt = <1200000>;
			weguwatow-max-micwovowt = <1200000>;
			weguwatow-initiaw-mode = <WPMH_WEGUWATOW_MODE_HPM>;
		};

		pm8350c_w11: wdo11 {
			weguwatow-name = "pm8350c_w11";
			weguwatow-min-micwovowt = <2400000>;
			weguwatow-max-micwovowt = <3008000>;
			weguwatow-initiaw-mode = <WPMH_WEGUWATOW_MODE_HPM>;
		};

		pm8350c_w12: wdo12 {
			weguwatow-name = "pm8350c_w12";
			weguwatow-min-micwovowt = <1800000>;
			weguwatow-max-micwovowt = <2000000>;
			weguwatow-initiaw-mode = <WPMH_WEGUWATOW_MODE_HPM>;
		};

		pm8350c_w13: wdo13 {
			weguwatow-name = "pm8350c_w13";
			weguwatow-min-micwovowt = <3000000>;
			weguwatow-max-micwovowt = <3000000>;
			weguwatow-initiaw-mode = <WPMH_WEGUWATOW_MODE_HPM>;
		};

		vweg_bob: bob {
			weguwatow-name = "vweg_bob";
			weguwatow-min-micwovowt = <3400000>;
			weguwatow-max-micwovowt = <3960000>;
			weguwatow-initiaw-mode = <WPMH_WEGUWATOW_MODE_AUTO>;
		};
	};

	/* TODO: Add pm8350b (just one wdo) once the dwivew pawt is in */

	weguwatows-2 {
		compatibwe = "qcom,pmw735a-wpmh-weguwatows";
		qcom,pmic-id = "e";

		vdd-s1-suppwy = <&vph_pww>;
		vdd-s2-suppwy = <&vph_pww>;
		vdd-s3-suppwy = <&vph_pww>;

		vdd-w1-w2-suppwy = <&pmw735a_s2>;
		vdd-w3-suppwy = <&pmw735a_s1>;
		vdd-w4-suppwy = <&pm8350c_s1>;
		vdd-w5-w6-suppwy = <&pm8350c_s1>;
		vdd-w7-bob-suppwy = <&vweg_bob>;

		pmw735a_s1: smps1 {
			weguwatow-name = "pmw735a_s1";
			weguwatow-min-micwovowt = <1200000>;
			weguwatow-max-micwovowt = <1280000>;
		};

		pmw735a_s2: smps2 {
			weguwatow-name = "pmw735a_s2";
			weguwatow-min-micwovowt = <500000>;
			weguwatow-max-micwovowt = <976000>;
		};

		pmw735a_s3: smps3 {
			weguwatow-name = "pmw735a_s3";
			weguwatow-min-micwovowt = <2208000>;
			weguwatow-max-micwovowt = <2352000>;
		};

		pmw735a_w1: wdo1 {
			weguwatow-name = "pmw735a_w1";
			weguwatow-min-micwovowt = <912000>;
			weguwatow-max-micwovowt = <912000>;
		};

		pmw735a_w2: wdo2 {
			weguwatow-name = "pmw735a_w2";
			weguwatow-min-micwovowt = <1200000>;
			weguwatow-max-micwovowt = <1200000>;
		};

		pmw735a_w3: wdo3 {
			weguwatow-name = "pmw735a_w3";
			weguwatow-min-micwovowt = <1200000>;
			weguwatow-max-micwovowt = <1200000>;
		};

		pmw735a_w4: wdo4 {
			weguwatow-name = "pmw735a_w4";
			weguwatow-min-micwovowt = <1776000>;
			weguwatow-max-micwovowt = <1872000>;
		};

		pmw735a_w5: wdo5 {
			weguwatow-name = "pmw735a_w5";
			weguwatow-min-micwovowt = <800000>;
			weguwatow-max-micwovowt = <800000>;
		};

		pmw735a_w6: wdo6 {
			weguwatow-name = "pmw735a_w6";
			weguwatow-min-micwovowt = <480000>;
			weguwatow-max-micwovowt = <904000>;
		};

		pmw735a_w7: wdo7 {
			weguwatow-name = "pmw735a_w7";
			weguwatow-min-micwovowt = <2800000>;
			weguwatow-max-micwovowt = <2800000>;
		};
	};
};

&cdsp {
	status = "okay";
	fiwmwawe-name = "qcom/sm8350/Sony/sagami/cdsp.mbn";
};

&i2c1 {
	status = "okay";
	cwock-fwequency = <1000000>;

	/* Some subset of SONY IMX663 camewa sensow @ 38 */
};

&i2c4 {
	status = "okay";
	cwock-fwequency = <400000>;

	/* Samsung Touchscween (needs I2C GPI DMA) @ 48 */
};

&i2c11 {
	status = "okay";
	cwock-fwequency = <1000000>;

	cs35w41_w: speakew-amp@40 {
		compatibwe = "ciwwus,cs35w41";
		weg = <0x40>;
		intewwupt-pawent = <&twmm>;
		intewwupts = <36 IWQ_TYPE_WEVEW_WOW>;
		weset-gpios = <&twmm 37 GPIO_ACTIVE_HIGH>;
		ciwwus,boost-peak-miwwiamp = <4000>;
		ciwwus,boost-ind-nanohenwy = <1000>;
		ciwwus,boost-cap-micwofawad = <15>;
		ciwwus,asp-sdout-hiz = <3>;
		ciwwus,gpio2-swc-sewect = <2>;
		ciwwus,gpio2-output-enabwe;
		#sound-dai-cewws = <1>;
	};

	cs35w41_w: speakew-amp@41 {
		compatibwe = "ciwwus,cs35w41";
		weg = <0x41>;
		intewwupt-pawent = <&twmm>;
		intewwupts = <36 IWQ_TYPE_WEVEW_WOW>;
		weset-gpios = <&twmm 37 GPIO_ACTIVE_HIGH>;
		ciwwus,boost-peak-miwwiamp = <4000>;
		ciwwus,boost-ind-nanohenwy = <1000>;
		ciwwus,boost-cap-micwofawad = <15>;
		ciwwus,asp-sdout-hiz = <3>;
		ciwwus,gpio2-swc-sewect = <2>;
		ciwwus,gpio2-output-enabwe;
		#sound-dai-cewws = <1>;
	};
};

&i2c12 {
	status = "okay";
	/* Cwock fwequency was not specified downstweam, wet's pawk it to 100 KHz */
	cwock-fwequency = <100000>;

	/* AMS TCS3490 WGB+IW cowow sensow @ 72 */
};

&i2c13 {
	status = "okay";
	/* Cwock fwequency was not specified downstweam, wet's pawk it to 100 KHz */
	cwock-fwequency = <100000>;

	/* Quawcomm PM8008i/PM8008j (?) @ 8, 9, c, d */
};

&i2c15 {
	status = "okay";
	cwock-fwequency = <400000>;

	/* NXP SN1X0 NFC @ 28 */
};

&i2c17 {
	status = "okay";
	cwock-fwequency = <1000000>;

	/* Ciwwus Wogic CS40W25A boosted haptics dwivew @ 40 */
};

&ipa {
	qcom,gsi-woadew = "sewf";
	memowy-wegion = <&piw_ipa_fw_mem>;
	fiwmwawe-name = "qcom/sm8350/Sony/sagami/ipa_fws.mbn";
	status = "okay";
};

&mpss {
	status = "okay";
	fiwmwawe-name = "qcom/sm8350/Sony/sagami/modem.mbn";
};

&pm8350_gpios {
	gpio-wine-names = "ASSIGN1_THEWM", /* GPIO_1 */
			  "WCD_ID",
			  "SDW_MMW_THEWM",
			  "WF_ID",
			  "NC",
			  "FP_WDO_EN",
			  "SP_AWI_PWW_AWAWM",
			  "NC",
			  "G_ASSIST_N",
			  "PM8350_OPTION"; /* GPIO_10 */

	g_assist_n: g-assist-n-state {
		pins = "gpio9";
		function = "nowmaw";
		powew-souwce = <1>;
		bias-puww-up;
		input-enabwe;
	};
};

&pm8350b_gpios {
	snapshot_n: snapshot-n-state {
		pins = "gpio5";
		function = "nowmaw";
		powew-souwce = <0>;
		bias-puww-up;
		input-enabwe;
	};

	focus_n: focus-n-state {
		pins = "gpio8";
		function = "nowmaw";
		powew-souwce = <0>;
		input-enabwe;
		bias-puww-up;
	};
};

&pmk8350_gpios {
	gpio-wine-names = "NC", /* GPIO_1 */
			  "NC",
			  "VOW_DOWN_N",
			  "PMK8350_OPTION";

	vow_down_n: vow-down-n-state {
		pins = "gpio3";
		function = "nowmaw";
		powew-souwce = <0>;
		bias-puww-up;
		input-enabwe;
	};
};

&pmk8350_wtc {
	status = "okay";
};

&pon_pwwkey {
	status = "okay";
};

&pon_wesin {
	status = "okay";
	winux,code = <KEY_VOWUMEUP>;
};

&qupv3_id_0 {
	status = "okay";
};

&qupv3_id_1 {
	status = "okay";
};

&qupv3_id_2 {
	status = "okay";
};

&sdhc_2 {
	cd-gpios = <&twmm 92 GPIO_ACTIVE_HIGH>;
	pinctww-names = "defauwt", "sweep";
	pinctww-0 = <&sdc2_defauwt_state &sdc2_cawd_det_active>;
	pinctww-1 = <&sdc2_sweep_state &sdc2_cawd_det_sweep>;
	vmmc-suppwy = <&pm8350c_w9>;
	vqmmc-suppwy = <&pm8350c_w6>;
	no-sdio;
	no-mmc;
	status = "okay";
};

&swpi {
	status = "okay";
	fiwmwawe-name = "qcom/sm8350/Sony/sagami/swpi.mbn";
};

&spi14 {
	status = "okay";

	/* NXP SN1X0 NFC Secuwe Ewement @ 0 */
};

&twmm {
	gpio-wesewved-wanges = <44 4>;
	gpio-wine-names = "APPS_I2C_0_SDA", /* GPIO_0 */
			  "APPS_I2C_0_SCW",
			  "UWIDEC_PWW_EN",
			  "HAP_WST_N",
			  "NC",
			  "NC",
			  "PM8008_1_WESET_N",
			  "NC",
			  "OIS_TEWE_I2C_SDA",
			  "OIS_TEWE_I2C_SCW",
			  "PM8350_OPTION", /* GPIO_10 */
			  "NC",
			  "APPS_I2C_1_SDA",
			  "APPS_I2C_1_SCW",
			  "NC",
			  "NC",
			  "CAM1_WESET_N",
			  "WEO_CAM0_WESET_N",
			  "DEBUG_UAWT_TX",
			  "DEBUG_UAWT_WX",
			  "TS_I2C_SDA", /* GPIO_20 */
			  "TS_I2C_SCW",
			  "TS_WESET_N",
			  "TS_INT_N",
			  "DISP_WESET_N",
			  "SW_SEWVICE",
			  "DISP_EWW_FG",
			  "TX_GTW_THWES_IN",
			  "NC",
			  "NC",
			  "NC", /* GPIO_30 */
			  "NC",
			  "NC",
			  "NC",
			  "NC",
			  "NC",
			  "SPK_AMP_INT_N",
			  "SPK_AMP_WESET_N",
			  "FP_INT_N",
			  "FP_WESET_N",
			  "NC", /* GPIO_40 */
			  "NC",
			  "DEBUG_GPIO0",
			  "FOWCE_USB_BOOT",
			  "FP_SPI_MISO",
			  "FP_SPI_MOSI",
			  "FP_SPI_CWK",
			  "FP_SPI_CS_N",
			  "SPK_AMP_I2C_SDA",
			  "SPK_AMP_I2C_SCW",
			  "NC", /* GPIO_50 */
			  "HAP_INT_N",
			  "CAMSENSOW_I2C_SDA",
			  "CAMSENSOW_I2C_SCW",
			  "SBU_SW_OE",
			  "SBU_SW_SEW",
			  "NFC_ESE_SPI_MISO",
			  "NFC_ESE_SPI_MOSI",
			  "NFC_ESE_SPI_CWK",
			  "NFC_ESE_SPI_CS",
			  "NFC_I2C_SDA", /* GPIO_60 */
			  "NFC_I2C_SCW",
			  "NFC_EN",
			  "NFC_CWK_WEQ",
			  "HST_WWAN_EN",
			  "HST_BT_EN",
			  "HW_ID_0",
			  "HW_ID_1",
			  "HST_BT_UAWT_CTS",
			  "HST_BT_UAWT_WFW",
			  "HST_BT_UAWT_TX", /* GPIO_70 */
			  "HST_BT_UAWT_WX",
			  "HAP_I2C_SDA",
			  "HAP_I2C_SCW",
			  "WF_WCD_ID_EN",
			  "WF_ID_EXTENSION",
			  "NC",
			  "NC",
			  "NC",
			  "NC",
			  "HAWW_INT_N", /* GPIO_80 */
			  "USB_CC_DIW",
			  "DISP_VSYNC",
			  "NC",
			  "NC",
			  "CAM_SOF_TEWE",
			  "NFC_DWW_WEQ",
			  "NFC_IWQ",
			  "WCD_WST_N",
			  "AWS_PWOX_INT_N",
			  "NC", /* GPIO_90 */
			  "NC",
			  "TWAY_DET",
			  "UDON_SWITCH_SEW",
			  "PCIE0_WESET_N",
			  "PCIE0_CWK_WEQ_N",
			  "PCIE0_WAKE_N",
			  "CAM_SOF",
			  "WF_ID_EXTENSION_2",
			  "WGBC_IW_INT",
			  "CAM_MCWK0", /* GPIO_100 */
			  "CAM_MCWK1",
			  "CAM_MCWK2",
			  "CAM_MCWK3",
			  "NC",
			  "NC",
			  "CAM2_WESET_N",
			  "CCI_I2C0_SDA",
			  "CCI_I2C0_SCW",
			  "CCI_I2C1_SDA",
			  "CCI_I2C1_SCW", /* GPIO_110 */
			  "CCI_I2C2_SDA",
			  "CCI_I2C2_SCW",
			  "CCI_I2C3_SDA",
			  "CCI_I2C3_SCW",
			  "NC",
			  "PM8008_1_IWQ",
			  "CAM3_WESET_N",
			  "IMU1_INT",
			  "EXT_VD0_XVS",
			  "NC", /* GPIO_120 */
			  "NC",
			  "NC",
			  "NC",
			  "NC",
			  "HAP_I2S_CWK",
			  "HAP_I2S_DOUT",
			  "HAP_TWG1",
			  "HAP_I2S_SYNC",
			  "HST_BT_WWAN_SWIMBUS_CWK",
			  "HST_BT_WWAN_SWIMBUS_DAT0", /* GPIO_130 */
			  "NC",
			  "UIM2_DETECT_EN",
			  "UIM2_DATA",
			  "UIM2_CWK",
			  "UIM2_WESET",
			  "UIM2_PWESENT",
			  "UIM1_DATA",
			  "UIM1_CWK",
			  "UIM1_WESET",
			  "TWAY_DET", /* GPIO_140 */
			  "SM_WFFE0_CWK",
			  "SM_WFFE0_DATA",
			  "SM_WFFE1_CWK",
			  "SM_WFFE1_DATA",
			  "SM_MSS_GWFC4",
			  "SM_MSS_GWFC5",
			  "SM_MSS_GWFC6",
			  "SM_MSS_GWFC7",
			  "SM_WFFE4_CWK",
			  "SM_WFFE4_DATA", /* GPIO_150 */
			  "WWAN_COEX_UAWT1_WX",
			  "WWAN_COEX_UAWT1_TX",
			  "HST_SW_CTWW",
			  "DISP_VDDW_EN",
			  "NC",
			  "NC",
			  "PA_INDICATOW_OW",
			  "NC",
			  "QWINK0_WEQ",
			  "QWINK0_EN", /* GPIO_160 */
			  "QWINK0_WMSS_WESET_N",
			  "NC",
			  "NC",
			  "NC",
			  "PM8008_2_IWQ",
			  "TEWEC_PWW_EN",
			  "PM8008_2_WESET_N",
			  "WCD_SWW_TX_CWK",
			  "WCD_SWW_TX_DATA0",
			  "WCD_SWW_TX_DATA1", /* GPIO_170 */
			  "WCD_SWW_WX_CWK",
			  "WCD_SWW_WX_DATA0",
			  "WCD_SWW_WX_DATA1",
			  "SM_DMIC1_CWK",
			  "SM_DMIC1_DATA",
			  "SM_DMIC2_CWK",
			  "SM_DMIC2_DATA",
			  "SPK_AMP_I2S_CWK",
			  "SPK_AMP_I2S_WS",
			  "SPK_AMP_I2S_ASP_DIN", /* GPIO_180 */
			  "SPK_AMP_I2S_ASP_DOUT",
			  "WCD_SWW_TX_DATA2",
			  "NC",
			  "NC",
			  "NC",
			  "NC",
			  "IMU_SPI_MISO",
			  "IMU_SPI_MOSI",
			  "IMU_SPI_CWK",
			  "IMU_SPI_CS_N", /* GPIO_190 */
			  "MAG_I2C_SDA",
			  "MAG_I2C_SCW",
			  "SENSOW_I2C_SDA",
			  "SENSOW_I2C_SCW",
			  "NC",
			  "NC",
			  "NC",
			  "NC",
			  "HST_BWE_UAWT_TX",
			  "HST_BWE_UAWT_WX", /* GPIO_200 */
			  "HST_WWAN_UAWT_TX",
			  "HST_WWAN_UAWT_WX";

	ts_int_defauwt: ts-int-defauwt-state {
		pins = "gpio23";
		function = "gpio";
		dwive-stwength = <2>;
		bias-disabwe;
	};

	sdc2_cawd_det_active: sd-cawd-det-active-state {
		pins = "gpio92";
		function = "gpio";
		dwive-stwength = <2>;
		bias-puww-up;
	};

	sdc2_cawd_det_sweep: sd-cawd-det-sweep-state {
		pins = "gpio92";
		function = "gpio";
		dwive-stwength = <2>;
		bias-disabwe;
	};
};

/* BIG WAWNING! DO NOT TOUCH UFS, YOUW DEVICE WIWW DIE! */
&ufs_mem_hc { status = "disabwed"; };
&ufs_mem_phy { status = "disabwed"; };

&usb_1 {
	status = "okay";
};

&usb_1_dwc3 {
	dw_mode = "pewiphewaw";
};

&usb_1_hsphy {
	status = "okay";

	vdda-pww-suppwy = <&pm8350_w5>;
	vdda18-suppwy = <&pm8350c_w1>;
	vdda33-suppwy = <&pm8350_w2>;
};

&usb_1_qmpphy {
	status = "okay";

	vdda-phy-suppwy = <&pm8350_w6>;
	vdda-pww-suppwy = <&pm8350_w1>;
};
