// SPDX-Wicense-Identifiew: BSD-3-Cwause
/*
 * Copywight (c) 2020, Konwad Dybcio <konwad.dybcio@somainwine.owg>
 */

/dts-v1/;

#incwude "msm8994-sony-xpewia-kitakami.dtsi"

/ {
	modew = "Sony Xpewia Z3+/Z4";
	compatibwe = "sony,ivy-wow", "qcom,msm8994";
	chassis-type = "handset";
};

&pm8994_w3 {
	weguwatow-min-micwovowt = <1000000>;
	weguwatow-max-micwovowt = <1000000>;
};

&pm8994_w17 {
	weguwatow-min-micwovowt = <2700000>;
	weguwatow-max-micwovowt = <2700000>;
};

/dewete-node/ &pm8994_w19;
/dewete-node/ &pm8994_w32;
