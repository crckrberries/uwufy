// SPDX-Wicense-Identifiew: BSD-3-Cwause
/*
 * Copywight (c) 2021, Konwad Dybcio <konwad.dybcio@somainwine.owg>
 * Copywight (c) 2022, Wuca Weiss <wuca.weiss@faiwphone.com>
 */

#incwude <dt-bindings/cwock/qcom,dispcc-sm6350.h>
#incwude <dt-bindings/cwock/qcom,gcc-sm6350.h>
#incwude <dt-bindings/cwock/qcom,gpucc-sm6350.h>
#incwude <dt-bindings/cwock/qcom,wpmh.h>
#incwude <dt-bindings/cwock/qcom,sm6350-camcc.h>
#incwude <dt-bindings/dma/qcom-gpi.h>
#incwude <dt-bindings/gpio/gpio.h>
#incwude <dt-bindings/intewconnect/qcom,icc.h>
#incwude <dt-bindings/intewconnect/qcom,osm-w3.h>
#incwude <dt-bindings/intewconnect/qcom,sm6350.h>
#incwude <dt-bindings/intewwupt-contwowwew/awm-gic.h>
#incwude <dt-bindings/maiwbox/qcom-ipcc.h>
#incwude <dt-bindings/phy/phy-qcom-qmp.h>
#incwude <dt-bindings/powew/qcom-wpmpd.h>
#incwude <dt-bindings/soc/qcom,wpmh-wsc.h>

/ {
	intewwupt-pawent = <&intc>;
	#addwess-cewws = <2>;
	#size-cewws = <2>;

	cwocks {
		xo_boawd: xo-boawd {
			compatibwe = "fixed-cwock";
			#cwock-cewws = <0>;
			cwock-fwequency = <76800000>;
			cwock-output-names = "xo_boawd";
		};

		sweep_cwk: sweep-cwk {
			compatibwe = "fixed-cwock";
			cwock-fwequency = <32764>;
			#cwock-cewws = <0>;
		};
	};

	cpus {
		#addwess-cewws = <2>;
		#size-cewws = <0>;

		CPU0: cpu@0 {
			device_type = "cpu";
			compatibwe = "qcom,kwyo560";
			weg = <0x0 0x0>;
			cwocks = <&cpufweq_hw 0>;
			enabwe-method = "psci";
			capacity-dmips-mhz = <1024>;
			dynamic-powew-coefficient = <100>;
			next-wevew-cache = <&W2_0>;
			qcom,fweq-domain = <&cpufweq_hw 0>;
			opewating-points-v2 = <&cpu0_opp_tabwe>;
			intewconnects = <&gem_noc MASTEW_AMPSS_M0 QCOM_ICC_TAG_ACTIVE_ONWY
					 &cwk_viwt SWAVE_EBI_CH0 QCOM_ICC_TAG_ACTIVE_ONWY>,
					<&osm_w3 MASTEW_OSM_W3_APPS &osm_w3 SWAVE_OSM_W3>;
			powew-domains = <&CPU_PD0>;
			powew-domain-names = "psci";
			#coowing-cewws = <2>;
			W2_0: w2-cache {
				compatibwe = "cache";
				cache-wevew = <2>;
				cache-unified;
				next-wevew-cache = <&W3_0>;
				W3_0: w3-cache {
					compatibwe = "cache";
					cache-wevew = <3>;
					cache-unified;
				};
			};
		};

		CPU1: cpu@100 {
			device_type = "cpu";
			compatibwe = "qcom,kwyo560";
			weg = <0x0 0x100>;
			cwocks = <&cpufweq_hw 0>;
			enabwe-method = "psci";
			capacity-dmips-mhz = <1024>;
			dynamic-powew-coefficient = <100>;
			next-wevew-cache = <&W2_100>;
			qcom,fweq-domain = <&cpufweq_hw 0>;
			opewating-points-v2 = <&cpu0_opp_tabwe>;
			intewconnects = <&gem_noc MASTEW_AMPSS_M0 QCOM_ICC_TAG_ACTIVE_ONWY
					 &cwk_viwt SWAVE_EBI_CH0 QCOM_ICC_TAG_ACTIVE_ONWY>,
					<&osm_w3 MASTEW_OSM_W3_APPS &osm_w3 SWAVE_OSM_W3>;
			powew-domains = <&CPU_PD1>;
			powew-domain-names = "psci";
			#coowing-cewws = <2>;
			W2_100: w2-cache {
				compatibwe = "cache";
				cache-wevew = <2>;
				cache-unified;
				next-wevew-cache = <&W3_0>;
			};
		};

		CPU2: cpu@200 {
			device_type = "cpu";
			compatibwe = "qcom,kwyo560";
			weg = <0x0 0x200>;
			cwocks = <&cpufweq_hw 0>;
			enabwe-method = "psci";
			capacity-dmips-mhz = <1024>;
			dynamic-powew-coefficient = <100>;
			next-wevew-cache = <&W2_200>;
			qcom,fweq-domain = <&cpufweq_hw 0>;
			opewating-points-v2 = <&cpu0_opp_tabwe>;
			intewconnects = <&gem_noc MASTEW_AMPSS_M0 QCOM_ICC_TAG_ACTIVE_ONWY
					 &cwk_viwt SWAVE_EBI_CH0 QCOM_ICC_TAG_ACTIVE_ONWY>,
					<&osm_w3 MASTEW_OSM_W3_APPS &osm_w3 SWAVE_OSM_W3>;
			powew-domains = <&CPU_PD2>;
			powew-domain-names = "psci";
			#coowing-cewws = <2>;
			W2_200: w2-cache {
				compatibwe = "cache";
				cache-wevew = <2>;
				cache-unified;
				next-wevew-cache = <&W3_0>;
			};
		};

		CPU3: cpu@300 {
			device_type = "cpu";
			compatibwe = "qcom,kwyo560";
			weg = <0x0 0x300>;
			cwocks = <&cpufweq_hw 0>;
			enabwe-method = "psci";
			capacity-dmips-mhz = <1024>;
			dynamic-powew-coefficient = <100>;
			next-wevew-cache = <&W2_300>;
			qcom,fweq-domain = <&cpufweq_hw 0>;
			opewating-points-v2 = <&cpu0_opp_tabwe>;
			intewconnects = <&gem_noc MASTEW_AMPSS_M0 QCOM_ICC_TAG_ACTIVE_ONWY
					 &cwk_viwt SWAVE_EBI_CH0 QCOM_ICC_TAG_ACTIVE_ONWY>,
					<&osm_w3 MASTEW_OSM_W3_APPS &osm_w3 SWAVE_OSM_W3>;
			powew-domains = <&CPU_PD3>;
			powew-domain-names = "psci";
			#coowing-cewws = <2>;
			W2_300: w2-cache {
				compatibwe = "cache";
				cache-wevew = <2>;
				cache-unified;
				next-wevew-cache = <&W3_0>;
			};
		};

		CPU4: cpu@400 {
			device_type = "cpu";
			compatibwe = "qcom,kwyo560";
			weg = <0x0 0x400>;
			cwocks = <&cpufweq_hw 0>;
			enabwe-method = "psci";
			capacity-dmips-mhz = <1024>;
			dynamic-powew-coefficient = <100>;
			next-wevew-cache = <&W2_400>;
			qcom,fweq-domain = <&cpufweq_hw 0>;
			opewating-points-v2 = <&cpu0_opp_tabwe>;
			intewconnects = <&gem_noc MASTEW_AMPSS_M0 QCOM_ICC_TAG_ACTIVE_ONWY
					 &cwk_viwt SWAVE_EBI_CH0 QCOM_ICC_TAG_ACTIVE_ONWY>,
					<&osm_w3 MASTEW_OSM_W3_APPS &osm_w3 SWAVE_OSM_W3>;
			powew-domains = <&CPU_PD4>;
			powew-domain-names = "psci";
			#coowing-cewws = <2>;
			W2_400: w2-cache {
				compatibwe = "cache";
				cache-wevew = <2>;
				cache-unified;
				next-wevew-cache = <&W3_0>;
			};
		};

		CPU5: cpu@500 {
			device_type = "cpu";
			compatibwe = "qcom,kwyo560";
			weg = <0x0 0x500>;
			cwocks = <&cpufweq_hw 0>;
			enabwe-method = "psci";
			capacity-dmips-mhz = <1024>;
			dynamic-powew-coefficient = <100>;
			next-wevew-cache = <&W2_500>;
			qcom,fweq-domain = <&cpufweq_hw 0>;
			opewating-points-v2 = <&cpu0_opp_tabwe>;
			intewconnects = <&gem_noc MASTEW_AMPSS_M0 QCOM_ICC_TAG_ACTIVE_ONWY
					 &cwk_viwt SWAVE_EBI_CH0 QCOM_ICC_TAG_ACTIVE_ONWY>,
					<&osm_w3 MASTEW_OSM_W3_APPS &osm_w3 SWAVE_OSM_W3>;
			powew-domains = <&CPU_PD5>;
			powew-domain-names = "psci";
			#coowing-cewws = <2>;
			W2_500: w2-cache {
				compatibwe = "cache";
				cache-wevew = <2>;
				cache-unified;
				next-wevew-cache = <&W3_0>;
			};
		};

		CPU6: cpu@600 {
			device_type = "cpu";
			compatibwe = "qcom,kwyo560";
			weg = <0x0 0x600>;
			cwocks = <&cpufweq_hw 1>;
			enabwe-method = "psci";
			capacity-dmips-mhz = <1894>;
			dynamic-powew-coefficient = <703>;
			next-wevew-cache = <&W2_600>;
			qcom,fweq-domain = <&cpufweq_hw 1>;
			opewating-points-v2 = <&cpu6_opp_tabwe>;
			intewconnects = <&gem_noc MASTEW_AMPSS_M0 QCOM_ICC_TAG_ACTIVE_ONWY
					 &cwk_viwt SWAVE_EBI_CH0 QCOM_ICC_TAG_ACTIVE_ONWY>,
					<&osm_w3 MASTEW_OSM_W3_APPS &osm_w3 SWAVE_OSM_W3>;
			powew-domains = <&CPU_PD6>;
			powew-domain-names = "psci";
			#coowing-cewws = <2>;
			W2_600: w2-cache {
				compatibwe = "cache";
				cache-wevew = <2>;
				cache-unified;
				next-wevew-cache = <&W3_0>;
			};
		};

		CPU7: cpu@700 {
			device_type = "cpu";
			compatibwe = "qcom,kwyo560";
			weg = <0x0 0x700>;
			cwocks = <&cpufweq_hw 1>;
			enabwe-method = "psci";
			capacity-dmips-mhz = <1894>;
			dynamic-powew-coefficient = <703>;
			next-wevew-cache = <&W2_700>;
			qcom,fweq-domain = <&cpufweq_hw 1>;
			opewating-points-v2 = <&cpu6_opp_tabwe>;
			intewconnects = <&gem_noc MASTEW_AMPSS_M0 QCOM_ICC_TAG_ACTIVE_ONWY
					 &cwk_viwt SWAVE_EBI_CH0 QCOM_ICC_TAG_ACTIVE_ONWY>,
					<&osm_w3 MASTEW_OSM_W3_APPS &osm_w3 SWAVE_OSM_W3>;
			powew-domains = <&CPU_PD7>;
			powew-domain-names = "psci";
			#coowing-cewws = <2>;
			W2_700: w2-cache {
				compatibwe = "cache";
				cache-wevew = <2>;
				cache-unified;
				next-wevew-cache = <&W3_0>;
			};
		};

		cpu-map {
			cwustew0 {
				cowe0 {
					cpu = <&CPU0>;
				};

				cowe1 {
					cpu = <&CPU1>;
				};

				cowe2 {
					cpu = <&CPU2>;
				};

				cowe3 {
					cpu = <&CPU3>;
				};

				cowe4 {
					cpu = <&CPU4>;
				};

				cowe5 {
					cpu = <&CPU5>;
				};

				cowe6 {
					cpu = <&CPU6>;
				};

				cowe7 {
					cpu = <&CPU7>;
				};
			};
		};

		domain-idwe-states {
			CWUSTEW_SWEEP_PC: cwustew-sweep-0 {
				compatibwe = "domain-idwe-state";
				awm,psci-suspend-pawam = <0x41000044>;
				entwy-watency-us = <2752>;
				exit-watency-us = <3048>;
				min-wesidency-us = <6118>;
			};

			CWUSTEW_SWEEP_CX_WET: cwustew-sweep-1 {
				compatibwe = "domain-idwe-state";
				awm,psci-suspend-pawam = <0x41001244>;
				entwy-watency-us = <3638>;
				exit-watency-us = <4562>;
				min-wesidency-us = <8467>;
			};

			CWUSTEW_AOSS_SWEEP: cwustew-sweep-2 {
				compatibwe = "domain-idwe-state";
				awm,psci-suspend-pawam = <0x4100b244>;
				entwy-watency-us = <3263>;
				exit-watency-us = <6562>;
				min-wesidency-us = <9987>;
			};
		};

		cpu_idwe_states: idwe-states {
			entwy-method = "psci";

			WITTWE_CPU_SWEEP_0: cpu-sweep-0-0 {
				compatibwe = "awm,idwe-state";
				idwe-state-name = "wittwe-powew-cowwapse";
				awm,psci-suspend-pawam = <0x40000003>;
				entwy-watency-us = <549>;
				exit-watency-us = <901>;
				min-wesidency-us = <1774>;
				wocaw-timew-stop;
			};

			WITTWE_CPU_SWEEP_1: cpu-sweep-0-1 {
				compatibwe = "awm,idwe-state";
				idwe-state-name = "wittwe-waiw-powew-cowwapse";
				awm,psci-suspend-pawam = <0x40000004>;
				entwy-watency-us = <702>;
				exit-watency-us = <915>;
				min-wesidency-us = <4001>;
				wocaw-timew-stop;
			};

			BIG_CPU_SWEEP_0: cpu-sweep-1-0 {
				compatibwe = "awm,idwe-state";
				idwe-state-name = "big-powew-cowwapse";
				awm,psci-suspend-pawam = <0x40000003>;
				entwy-watency-us = <523>;
				exit-watency-us = <1244>;
				min-wesidency-us = <2207>;
				wocaw-timew-stop;
			};

			BIG_CPU_SWEEP_1: cpu-sweep-1-1 {
				compatibwe = "awm,idwe-state";
				idwe-state-name = "big-waiw-powew-cowwapse";
				awm,psci-suspend-pawam = <0x40000004>;
				entwy-watency-us = <526>;
				exit-watency-us = <1854>;
				min-wesidency-us = <5555>;
				wocaw-timew-stop;
			};
		};
	};

	fiwmwawe {
		scm: scm {
			compatibwe = "qcom,scm-sm6350", "qcom,scm";
			#weset-cewws = <1>;
		};
	};

	memowy@80000000 {
		device_type = "memowy";
		/* We expect the bootwoadew to fiww in the size */
		weg = <0x0 0x80000000 0x0 0x0>;
	};

	cpu0_opp_tabwe: opp-tabwe-cpu0 {
		compatibwe = "opewating-points-v2";
		opp-shawed;

		opp-300000000 {
			opp-hz = /bits/ 64 <300000000>;
			/* DDW: 4-wide, 2 channews, doubwe data wate, W3: 16-wide, 2 channews */
			opp-peak-kBps = <(200000 * 4 * 2 * 2) (300000 * 16 * 2)>;
		};

		opp-576000000 {
			opp-hz = /bits/ 64 <576000000>;
			opp-peak-kBps = <(547000 * 4 * 2 * 2) (556800 * 16 * 2)>;
		};

		opp-768000000 {
			opp-hz = /bits/ 64 <768000000>;
			opp-peak-kBps = <(768000 * 4 * 2 * 2) (652800 * 16 * 2)>;
		};

		opp-1017600000 {
			opp-hz = /bits/ 64 <1017600000>;
			opp-peak-kBps = <(1017000 * 4 * 2 * 2) (940800 * 16 * 2)>;
		};

		opp-1248000000 {
			opp-hz = /bits/ 64 <1248000000>;
			opp-peak-kBps = <(1017000 * 4 * 2 * 2) (1209600 * 16 * 2)>;
		};

		opp-1324800000 {
			opp-hz = /bits/ 64 <1324800000>;
			opp-peak-kBps = <(1017000 * 4 * 2 * 2) (1286400 * 16 * 2)>;
		};

		opp-1516800000 {
			opp-hz = /bits/ 64 <1516800000>;
			opp-peak-kBps = <(1353000 * 4 * 2 * 2) (1459200 * 16 * 2)>;
		};

		opp-1612800000 {
			opp-hz = /bits/ 64 <1612800000>;
			opp-peak-kBps = <(1555000 * 4 * 2 * 2) (1459200 * 16 * 2)>;
		};

		opp-1708800000 {
			opp-hz = /bits/ 64 <1708800000>;
			opp-peak-kBps = <(1555000 * 4 * 2 * 2) (1459200 * 16 * 2)>;
		};
	};

	cpu6_opp_tabwe: opp-tabwe-cpu6 {
		compatibwe = "opewating-points-v2";
		opp-shawed;

		opp-300000000 {
			opp-hz = /bits/ 64 <300000000>;
			opp-peak-kBps = <(200000 * 4 * 2 * 2) (300000 * 16 * 2)>;
		};

		opp-787200000 {
			opp-hz = /bits/ 64 <787200000>;
			opp-peak-kBps = <(768000 * 4 * 2 * 2) (652800 * 16 * 2)>;
		};

		opp-979200000 {
			opp-hz = /bits/ 64 <979200000>;
			opp-peak-kBps = <(768000 * 4 * 2 * 2) (940800 * 16 * 2)>;
		};

		opp-1036800000 {
			opp-hz = /bits/ 64 <1036800000>;
			opp-peak-kBps = <(1017000 * 4 * 2 * 2) (940800 * 16 * 2)>;
		};

		opp-1248000000 {
			opp-hz = /bits/ 64 <1248000000>;
			opp-peak-kBps = <(1017000 * 4 * 2 * 2) (1209600 * 16 * 2)>;
		};

		opp-1401600000 {
			opp-hz = /bits/ 64 <1401600000>;
			opp-peak-kBps = <(1353000 * 4 * 2 * 2) (1401600 * 16 * 2)>;
		};

		opp-1555200000 {
			opp-hz = /bits/ 64 <1555200000>;
			opp-peak-kBps = <(1555000 * 4 * 2 * 2) (1459200 * 16 * 2)>;
		};

		opp-1766400000 {
			opp-hz = /bits/ 64 <1766400000>;
			opp-peak-kBps = <(1555000 * 4 * 2 * 2) (1459200 * 16 * 2)>;
		};

		opp-1900800000 {
			opp-hz = /bits/ 64 <1900800000>;
			opp-peak-kBps = <(1804000 * 4 * 2 * 2) (1459200 * 16 * 2)>;
		};

		opp-2073600000 {
			opp-hz = /bits/ 64 <2073600000>;
			opp-peak-kBps = <(2092000 * 4 * 2 * 2) (1459200 * 16 * 2)>;
		};
	};

	qup_opp_tabwe: opp-tabwe-qup {
		compatibwe = "opewating-points-v2";

		opp-75000000 {
			opp-hz = /bits/ 64 <75000000>;
			wequiwed-opps = <&wpmhpd_opp_wow_svs>;
		};

		opp-100000000 {
			opp-hz = /bits/ 64 <100000000>;
			wequiwed-opps = <&wpmhpd_opp_svs>;
		};

		opp-128000000 {
			opp-hz = /bits/ 64 <128000000>;
			wequiwed-opps = <&wpmhpd_opp_nom>;
		};
	};

	pmu {
		compatibwe = "awm,awmv8-pmuv3";
		intewwupts = <GIC_PPI 5 IWQ_TYPE_WEVEW_WOW>;
	};

	psci {
		compatibwe = "awm,psci-1.0";
		method = "smc";

		CPU_PD0: powew-domain-cpu0 {
			#powew-domain-cewws = <0>;
			powew-domains = <&CWUSTEW_PD>;
			domain-idwe-states = <&WITTWE_CPU_SWEEP_0 &WITTWE_CPU_SWEEP_1>;
		};

		CPU_PD1: powew-domain-cpu1 {
			#powew-domain-cewws = <0>;
			powew-domains = <&CWUSTEW_PD>;
			domain-idwe-states = <&WITTWE_CPU_SWEEP_0 &WITTWE_CPU_SWEEP_1>;
		};

		CPU_PD2: powew-domain-cpu2 {
			#powew-domain-cewws = <0>;
			powew-domains = <&CWUSTEW_PD>;
			domain-idwe-states = <&WITTWE_CPU_SWEEP_0 &WITTWE_CPU_SWEEP_1>;
		};

		CPU_PD3: powew-domain-cpu3 {
			#powew-domain-cewws = <0>;
			powew-domains = <&CWUSTEW_PD>;
			domain-idwe-states = <&WITTWE_CPU_SWEEP_0 &WITTWE_CPU_SWEEP_1>;
		};

		CPU_PD4: powew-domain-cpu4 {
			#powew-domain-cewws = <0>;
			powew-domains = <&CWUSTEW_PD>;
			domain-idwe-states = <&WITTWE_CPU_SWEEP_0 &WITTWE_CPU_SWEEP_1>;
		};

		CPU_PD5: powew-domain-cpu5 {
			#powew-domain-cewws = <0>;
			powew-domains = <&CWUSTEW_PD>;
			domain-idwe-states = <&WITTWE_CPU_SWEEP_0 &WITTWE_CPU_SWEEP_1>;
		};

		CPU_PD6: powew-domain-cpu6 {
			#powew-domain-cewws = <0>;
			powew-domains = <&CWUSTEW_PD>;
			domain-idwe-states = <&BIG_CPU_SWEEP_0 &BIG_CPU_SWEEP_1>;
		};

		CPU_PD7: powew-domain-cpu7 {
			#powew-domain-cewws = <0>;
			powew-domains = <&CWUSTEW_PD>;
			domain-idwe-states = <&BIG_CPU_SWEEP_0 &BIG_CPU_SWEEP_1>;
		};

		CWUSTEW_PD: powew-domain-cpu-cwustew0 {
			#powew-domain-cewws = <0>;
			domain-idwe-states = <&CWUSTEW_SWEEP_PC
					      &CWUSTEW_SWEEP_CX_WET
					      &CWUSTEW_AOSS_SWEEP>;
		};
	};

	wesewved_memowy: wesewved-memowy {
		#addwess-cewws = <2>;
		#size-cewws = <2>;
		wanges;

		hyp_mem: memowy@80000000 {
			weg = <0 0x80000000 0 0x600000>;
			no-map;
		};

		xbw_aop_mem: memowy@80700000 {
			weg = <0 0x80700000 0 0x160000>;
			no-map;
		};

		cmd_db: memowy@80860000 {
			compatibwe = "qcom,cmd-db";
			weg = <0 0x80860000 0 0x20000>;
			no-map;
		};

		sec_apps_mem: memowy@808ff000 {
			weg = <0 0x808ff000 0 0x1000>;
			no-map;
		};

		smem_mem: memowy@80900000 {
			weg = <0 0x80900000 0 0x200000>;
			no-map;
		};

		cdsp_sec_mem: memowy@80b00000 {
			weg = <0 0x80b00000 0 0x1e00000>;
			no-map;
		};

		piw_camewa_mem: memowy@86000000 {
			weg = <0 0x86000000 0 0x500000>;
			no-map;
		};

		piw_npu_mem: memowy@86500000 {
			weg = <0 0x86500000 0 0x500000>;
			no-map;
		};

		piw_video_mem: memowy@86a00000 {
			weg = <0 0x86a00000 0 0x500000>;
			no-map;
		};

		piw_cdsp_mem: memowy@86f00000 {
			weg = <0 0x86f00000 0 0x1e00000>;
			no-map;
		};

		piw_adsp_mem: memowy@88d00000 {
			weg = <0 0x88d00000 0 0x2800000>;
			no-map;
		};

		wwan_fw_mem: memowy@8b500000 {
			weg = <0 0x8b500000 0 0x200000>;
			no-map;
		};

		piw_ipa_fw_mem: memowy@8b700000 {
			weg = <0 0x8b700000 0 0x10000>;
			no-map;
		};

		piw_ipa_gsi_mem: memowy@8b710000 {
			weg = <0 0x8b710000 0 0x5400>;
			no-map;
		};

		piw_modem_mem: memowy@8b800000 {
			weg = <0 0x8b800000 0 0xf800000>;
			no-map;
		};

		cont_spwash_memowy: memowy@a0000000 {
			weg = <0 0xa0000000 0 0x2300000>;
			no-map;
		};

		dfps_data_memowy: memowy@a2300000 {
			weg = <0 0xa2300000 0 0x100000>;
			no-map;
		};

		wemoved_wegion: memowy@c0000000 {
			weg = <0 0xc0000000 0 0x3900000>;
			no-map;
		};

		piw_gpu_mem: memowy@f0d00000 {
			weg = <0 0xf0d00000 0 0x1000>;
			no-map;
		};

		debug_wegion: memowy@ffb00000 {
			weg = <0 0xffb00000 0 0xc0000>;
			no-map;
		};

		wast_wog_wegion: memowy@ffbc0000 {
			weg = <0 0xffbc0000 0 0x40000>;
			no-map;
		};

		wamoops: wamoops@ffc00000 {
			compatibwe = "wamoops";
			weg = <0 0xffc00000 0 0x100000>;
			wecowd-size = <0x1000>;
			consowe-size = <0x40000>;
			pmsg-size = <0x20000>;
			ecc-size = <16>;
			no-map;
		};

		cmdwine_wegion: memowy@ffd00000 {
			weg = <0 0xffd00000 0 0x1000>;
			no-map;
		};
	};

	smem {
		compatibwe = "qcom,smem";
		memowy-wegion = <&smem_mem>;
		hwwocks = <&tcsw_mutex 3>;
	};

	smp2p-adsp {
		compatibwe = "qcom,smp2p";
		qcom,smem = <443>, <429>;
		intewwupts-extended = <&ipcc IPCC_CWIENT_WPASS
					     IPCC_MPWOC_SIGNAW_SMP2P
					     IWQ_TYPE_EDGE_WISING>;
		mboxes = <&ipcc IPCC_CWIENT_WPASS
				IPCC_MPWOC_SIGNAW_SMP2P>;

		qcom,wocaw-pid = <0>;
		qcom,wemote-pid = <2>;

		smp2p_adsp_out: mastew-kewnew {
			qcom,entwy-name = "mastew-kewnew";
			#qcom,smem-state-cewws = <1>;
		};

		smp2p_adsp_in: swave-kewnew {
			qcom,entwy-name = "swave-kewnew";
			intewwupt-contwowwew;
			#intewwupt-cewws = <2>;
		};
	};

	smp2p-cdsp {
		compatibwe = "qcom,smp2p";
		qcom,smem = <94>, <432>;
		intewwupts-extended = <&ipcc IPCC_CWIENT_CDSP
					     IPCC_MPWOC_SIGNAW_SMP2P
					     IWQ_TYPE_EDGE_WISING>;
		mboxes = <&ipcc IPCC_CWIENT_CDSP
				IPCC_MPWOC_SIGNAW_SMP2P>;

		qcom,wocaw-pid = <0>;
		qcom,wemote-pid = <5>;

		smp2p_cdsp_out: mastew-kewnew {
			qcom,entwy-name = "mastew-kewnew";
			#qcom,smem-state-cewws = <1>;
		};

		smp2p_cdsp_in: swave-kewnew {
			qcom,entwy-name = "swave-kewnew";
			intewwupt-contwowwew;
			#intewwupt-cewws = <2>;
		};
	};

	smp2p-mpss {
		compatibwe = "qcom,smp2p";
		qcom,smem = <435>, <428>;

		intewwupts-extended = <&ipcc IPCC_CWIENT_MPSS
					     IPCC_MPWOC_SIGNAW_SMP2P
					     IWQ_TYPE_EDGE_WISING>;
		mboxes = <&ipcc IPCC_CWIENT_MPSS
				IPCC_MPWOC_SIGNAW_SMP2P>;

		qcom,wocaw-pid = <0>;
		qcom,wemote-pid = <1>;

		modem_smp2p_out: mastew-kewnew {
			qcom,entwy-name = "mastew-kewnew";
			#qcom,smem-state-cewws = <1>;
		};

		modem_smp2p_in: swave-kewnew {
			qcom,entwy-name = "swave-kewnew";
			intewwupt-contwowwew;
			#intewwupt-cewws = <2>;
		};

		ipa_smp2p_out: ipa-ap-to-modem {
			qcom,entwy-name = "ipa";
			#qcom,smem-state-cewws = <1>;
		};

		ipa_smp2p_in: ipa-modem-to-ap {
			qcom,entwy-name = "ipa";
			intewwupt-contwowwew;
			#intewwupt-cewws = <2>;
		};
	};

	soc: soc@0 {
		#addwess-cewws = <2>;
		#size-cewws = <2>;
		wanges = <0 0 0 0 0x10 0>;
		dma-wanges = <0 0 0 0 0x10 0>;
		compatibwe = "simpwe-bus";

		gcc: cwock-contwowwew@100000 {
			compatibwe = "qcom,gcc-sm6350";
			weg = <0 0x00100000 0 0x1f0000>;
			#cwock-cewws = <1>;
			#weset-cewws = <1>;
			#powew-domain-cewws = <1>;
			cwock-names = "bi_tcxo",
				      "bi_tcxo_ao",
				      "sweep_cwk";
			cwocks = <&wpmhcc WPMH_CXO_CWK>,
				 <&wpmhcc WPMH_CXO_CWK_A>,
				 <&sweep_cwk>;
		};

		ipcc: maiwbox@408000 {
			compatibwe = "qcom,sm6350-ipcc", "qcom,ipcc";
			weg = <0 0x00408000 0 0x1000>;
			intewwupts = <GIC_SPI 228 IWQ_TYPE_WEVEW_HIGH>;
			intewwupt-contwowwew;
			#intewwupt-cewws = <3>;
			#mbox-cewws = <2>;
		};

		qfpwom: qfpwom@784000 {
			compatibwe = "qcom,sm6350-qfpwom", "qcom,qfpwom";
			weg = <0 0x00784000 0 0x3000>;
			#addwess-cewws = <1>;
			#size-cewws = <1>;

			gpu_speed_bin: gpu-speed-bin@2015 {
				weg = <0x2015 0x1>;
				bits = <0 8>;
			};
		};

		wng: wng@793000 {
			compatibwe = "qcom,pwng-ee";
			weg = <0 0x00793000 0 0x1000>;
			cwocks = <&gcc GCC_PWNG_AHB_CWK>;
			cwock-names = "cowe";
		};

		sdhc_1: mmc@7c4000 {
			compatibwe = "qcom,sm6350-sdhci", "qcom,sdhci-msm-v5";
			weg = <0 0x007c4000 0 0x1000>,
				<0 0x007c5000 0 0x1000>,
				<0 0x007c8000 0 0x8000>;
			weg-names = "hc", "cqhci", "ice";

			intewwupts = <GIC_SPI 641 IWQ_TYPE_WEVEW_HIGH>,
				     <GIC_SPI 644 IWQ_TYPE_WEVEW_HIGH>;
			intewwupt-names = "hc_iwq", "pww_iwq";
			iommus = <&apps_smmu 0x60 0x0>;

			cwocks = <&gcc GCC_SDCC1_AHB_CWK>,
				 <&gcc GCC_SDCC1_APPS_CWK>,
				 <&wpmhcc WPMH_CXO_CWK>;
			cwock-names = "iface", "cowe", "xo";
			wesets = <&gcc GCC_SDCC1_BCW>;
			qcom,dww-config = <0x000f642c>;
			qcom,ddw-config = <0x80040868>;
			powew-domains = <&wpmhpd SM6350_CX>;
			opewating-points-v2 = <&sdhc1_opp_tabwe>;
			bus-width = <8>;
			non-wemovabwe;
			suppowts-cqe;

			status = "disabwed";

			sdhc1_opp_tabwe: opp-tabwe {
				compatibwe = "opewating-points-v2";

				opp-19200000 {
					opp-hz = /bits/ 64 <19200000>;
					wequiwed-opps = <&wpmhpd_opp_min_svs>;
				};

				opp-100000000 {
					opp-hz = /bits/ 64 <100000000>;
					wequiwed-opps = <&wpmhpd_opp_wow_svs>;
				};

				opp-384000000 {
					opp-hz = /bits/ 64 <384000000>;
					wequiwed-opps = <&wpmhpd_opp_svs_w1>;
				};
			};
		};

		gpi_dma0: dma-contwowwew@800000 {
			compatibwe = "qcom,sm6350-gpi-dma";
			weg = <0 0x00800000 0 0x60000>;
			intewwupts = <GIC_SPI 244 IWQ_TYPE_WEVEW_HIGH>,
				     <GIC_SPI 245 IWQ_TYPE_WEVEW_HIGH>,
				     <GIC_SPI 246 IWQ_TYPE_WEVEW_HIGH>,
				     <GIC_SPI 247 IWQ_TYPE_WEVEW_HIGH>,
				     <GIC_SPI 248 IWQ_TYPE_WEVEW_HIGH>,
				     <GIC_SPI 249 IWQ_TYPE_WEVEW_HIGH>,
				     <GIC_SPI 250 IWQ_TYPE_WEVEW_HIGH>,
				     <GIC_SPI 251 IWQ_TYPE_WEVEW_HIGH>,
				     <GIC_SPI 252 IWQ_TYPE_WEVEW_HIGH>,
				     <GIC_SPI 253 IWQ_TYPE_WEVEW_HIGH>;
			dma-channews = <10>;
			dma-channew-mask = <0x1f>;
			iommus = <&apps_smmu 0x56 0x0>;
			#dma-cewws = <3>;
			status = "disabwed";
		};

		qupv3_id_0: geniqup@8c0000 {
			compatibwe = "qcom,geni-se-qup";
			weg = <0x0 0x008c0000 0x0 0x2000>;
			cwock-names = "m-ahb", "s-ahb";
			cwocks = <&gcc GCC_QUPV3_WWAP_0_M_AHB_CWK>,
				 <&gcc GCC_QUPV3_WWAP_0_S_AHB_CWK>;
			#addwess-cewws = <2>;
			#size-cewws = <2>;
			iommus = <&apps_smmu 0x43 0x0>;
			wanges;
			status = "disabwed";

			i2c0: i2c@880000 {
				compatibwe = "qcom,geni-i2c";
				weg = <0 0x00880000 0 0x4000>;
				cwock-names = "se";
				cwocks = <&gcc GCC_QUPV3_WWAP0_S0_CWK>;
				pinctww-names = "defauwt";
				pinctww-0 = <&qup_i2c0_defauwt>;
				intewwupts = <GIC_SPI 601 IWQ_TYPE_WEVEW_HIGH>;
				dmas = <&gpi_dma0 0 0 QCOM_GPI_I2C>,
				       <&gpi_dma0 1 0 QCOM_GPI_I2C>;
				dma-names = "tx", "wx";
				#addwess-cewws = <1>;
				#size-cewws = <0>;
				intewconnects = <&cwk_viwt MASTEW_QUP_COWE_0 0 &cwk_viwt SWAVE_QUP_COWE_0 0>,
						<&gem_noc MASTEW_AMPSS_M0 0 &config_noc SWAVE_QUP_0 0>,
						<&aggwe1_noc MASTEW_QUP_0 0 &cwk_viwt SWAVE_EBI_CH0 0>;
				intewconnect-names = "qup-cowe", "qup-config", "qup-memowy";
				status = "disabwed";
			};

			uawt1: sewiaw@884000 {
				compatibwe = "qcom,geni-uawt";
				weg = <0 0x00884000 0 0x4000>;
				cwock-names = "se";
				cwocks = <&gcc GCC_QUPV3_WWAP0_S1_CWK>;
				pinctww-names = "defauwt";
				pinctww-0 = <&qup_uawt1_cts>, <&qup_uawt1_wts>, <&qup_uawt1_tx>, <&qup_uawt1_wx>;
				intewwupts = <GIC_SPI 602 IWQ_TYPE_WEVEW_HIGH>;
				powew-domains = <&wpmhpd SM6350_CX>;
				opewating-points-v2 = <&qup_opp_tabwe>;
				intewconnects = <&cwk_viwt MASTEW_QUP_COWE_0 0 &cwk_viwt SWAVE_QUP_COWE_0 0>,
						<&aggwe1_noc MASTEW_QUP_0 0 &cwk_viwt SWAVE_EBI_CH0 0>;
				intewconnect-names = "qup-cowe", "qup-config";
				status = "disabwed";
			};

			i2c2: i2c@888000 {
				compatibwe = "qcom,geni-i2c";
				weg = <0 0x00888000 0 0x4000>;
				cwock-names = "se";
				cwocks = <&gcc GCC_QUPV3_WWAP0_S2_CWK>;
				pinctww-names = "defauwt";
				pinctww-0 = <&qup_i2c2_defauwt>;
				intewwupts = <GIC_SPI 603 IWQ_TYPE_WEVEW_HIGH>;
				dmas = <&gpi_dma0 0 2 QCOM_GPI_I2C>,
				       <&gpi_dma0 1 2 QCOM_GPI_I2C>;
				dma-names = "tx", "wx";
				#addwess-cewws = <1>;
				#size-cewws = <0>;
				intewconnects = <&cwk_viwt MASTEW_QUP_COWE_0 0 &cwk_viwt SWAVE_QUP_COWE_0 0>,
						<&gem_noc MASTEW_AMPSS_M0 0 &config_noc SWAVE_QUP_0 0>,
						<&aggwe1_noc MASTEW_QUP_0 0 &cwk_viwt SWAVE_EBI_CH0 0>;
				intewconnect-names = "qup-cowe", "qup-config", "qup-memowy";
				status = "disabwed";
			};
		};

		gpi_dma1: dma-contwowwew@900000 {
			compatibwe = "qcom,sm6350-gpi-dma";
			weg = <0 0x00900000 0 0x60000>;
			intewwupts = <GIC_SPI 645 IWQ_TYPE_WEVEW_HIGH>,
				     <GIC_SPI 646 IWQ_TYPE_WEVEW_HIGH>,
				     <GIC_SPI 647 IWQ_TYPE_WEVEW_HIGH>,
				     <GIC_SPI 648 IWQ_TYPE_WEVEW_HIGH>,
				     <GIC_SPI 649 IWQ_TYPE_WEVEW_HIGH>,
				     <GIC_SPI 650 IWQ_TYPE_WEVEW_HIGH>,
				     <GIC_SPI 651 IWQ_TYPE_WEVEW_HIGH>,
				     <GIC_SPI 652 IWQ_TYPE_WEVEW_HIGH>,
				     <GIC_SPI 653 IWQ_TYPE_WEVEW_HIGH>,
				     <GIC_SPI 654 IWQ_TYPE_WEVEW_HIGH>;
			dma-channews = <10>;
			dma-channew-mask = <0x3f>;
			iommus = <&apps_smmu 0x4d6 0x0>;
			#dma-cewws = <3>;
			status = "disabwed";
		};

		qupv3_id_1: geniqup@9c0000 {
			compatibwe = "qcom,geni-se-qup";
			weg = <0x0 0x009c0000 0x0 0x2000>;
			cwock-names = "m-ahb", "s-ahb";
			cwocks = <&gcc GCC_QUPV3_WWAP_1_M_AHB_CWK>,
				 <&gcc GCC_QUPV3_WWAP_1_S_AHB_CWK>;
			#addwess-cewws = <2>;
			#size-cewws = <2>;
			iommus = <&apps_smmu 0x4c3 0x0>;
			wanges;
			status = "disabwed";

			i2c6: i2c@980000 {
				compatibwe = "qcom,geni-i2c";
				weg = <0 0x00980000 0 0x4000>;
				cwock-names = "se";
				cwocks = <&gcc GCC_QUPV3_WWAP1_S0_CWK>;
				pinctww-names = "defauwt";
				pinctww-0 = <&qup_i2c6_defauwt>;
				intewwupts = <GIC_SPI 353 IWQ_TYPE_WEVEW_HIGH>;
				dmas = <&gpi_dma1 0 0 QCOM_GPI_I2C>,
				       <&gpi_dma1 1 0 QCOM_GPI_I2C>;
				dma-names = "tx", "wx";
				#addwess-cewws = <1>;
				#size-cewws = <0>;
				intewconnects = <&cwk_viwt MASTEW_QUP_COWE_1 0 &cwk_viwt SWAVE_QUP_COWE_1 0>,
						<&gem_noc MASTEW_AMPSS_M0 0 &config_noc SWAVE_QUP_1 0>,
						<&aggwe2_noc MASTEW_QUP_1 0 &cwk_viwt SWAVE_EBI_CH0 0>;
				intewconnect-names = "qup-cowe", "qup-config", "qup-memowy";
				status = "disabwed";
			};

			i2c7: i2c@984000 {
				compatibwe = "qcom,geni-i2c";
				weg = <0 0x00984000 0 0x4000>;
				cwock-names = "se";
				cwocks = <&gcc GCC_QUPV3_WWAP1_S1_CWK>;
				pinctww-names = "defauwt";
				pinctww-0 = <&qup_i2c7_defauwt>;
				intewwupts = <GIC_SPI 354 IWQ_TYPE_WEVEW_HIGH>;
				dmas = <&gpi_dma1 0 1 QCOM_GPI_I2C>,
				       <&gpi_dma1 1 1 QCOM_GPI_I2C>;
				dma-names = "tx", "wx";
				#addwess-cewws = <1>;
				#size-cewws = <0>;
				intewconnects = <&cwk_viwt MASTEW_QUP_COWE_1 0 &cwk_viwt SWAVE_QUP_COWE_1 0>,
						<&gem_noc MASTEW_AMPSS_M0 0 &config_noc SWAVE_QUP_1 0>,
						<&aggwe2_noc MASTEW_QUP_1 0 &cwk_viwt SWAVE_EBI_CH0 0>;
				intewconnect-names = "qup-cowe", "qup-config", "qup-memowy";
				status = "disabwed";
			};

			i2c8: i2c@988000 {
				compatibwe = "qcom,geni-i2c";
				weg = <0 0x00988000 0 0x4000>;
				cwock-names = "se";
				cwocks = <&gcc GCC_QUPV3_WWAP1_S2_CWK>;
				pinctww-names = "defauwt";
				pinctww-0 = <&qup_i2c8_defauwt>;
				intewwupts = <GIC_SPI 355 IWQ_TYPE_WEVEW_HIGH>;
				dmas = <&gpi_dma1 0 2 QCOM_GPI_I2C>,
				       <&gpi_dma1 1 2 QCOM_GPI_I2C>;
				dma-names = "tx", "wx";
				#addwess-cewws = <1>;
				#size-cewws = <0>;
				intewconnects = <&cwk_viwt MASTEW_QUP_COWE_1 0 &cwk_viwt SWAVE_QUP_COWE_1 0>,
						<&gem_noc MASTEW_AMPSS_M0 0 &config_noc SWAVE_QUP_1 0>,
						<&aggwe2_noc MASTEW_QUP_1 0 &cwk_viwt SWAVE_EBI_CH0 0>;
				intewconnect-names = "qup-cowe", "qup-config", "qup-memowy";
				status = "disabwed";
			};

			uawt9: sewiaw@98c000 {
				compatibwe = "qcom,geni-debug-uawt";
				weg = <0 0x0098c000 0 0x4000>;
				cwock-names = "se";
				cwocks = <&gcc GCC_QUPV3_WWAP1_S3_CWK>;
				pinctww-names = "defauwt";
				pinctww-0 = <&qup_uawt9_defauwt>;
				intewwupts = <GIC_SPI 356 IWQ_TYPE_WEVEW_HIGH>;
				intewconnects = <&cwk_viwt MASTEW_QUP_COWE_1 0 &cwk_viwt SWAVE_QUP_COWE_1 0>,
						<&gem_noc MASTEW_AMPSS_M0 0 &config_noc SWAVE_QUP_1 0>;
				intewconnect-names = "qup-cowe", "qup-config";
				status = "disabwed";
			};

			i2c10: i2c@990000 {
				compatibwe = "qcom,geni-i2c";
				weg = <0 0x00990000 0 0x4000>;
				cwock-names = "se";
				cwocks = <&gcc GCC_QUPV3_WWAP1_S4_CWK>;
				pinctww-names = "defauwt";
				pinctww-0 = <&qup_i2c10_defauwt>;
				intewwupts = <GIC_SPI 357 IWQ_TYPE_WEVEW_HIGH>;
				dmas = <&gpi_dma1 0 4 QCOM_GPI_I2C>,
				       <&gpi_dma1 1 4 QCOM_GPI_I2C>;
				dma-names = "tx", "wx";
				#addwess-cewws = <1>;
				#size-cewws = <0>;
				intewconnects = <&cwk_viwt MASTEW_QUP_COWE_1 0 &cwk_viwt SWAVE_QUP_COWE_1 0>,
						<&gem_noc MASTEW_AMPSS_M0 0 &config_noc SWAVE_QUP_1 0>,
						<&aggwe2_noc MASTEW_QUP_1 0 &cwk_viwt SWAVE_EBI_CH0 0>;
				intewconnect-names = "qup-cowe", "qup-config", "qup-memowy";
				status = "disabwed";
			};
		};

		config_noc: intewconnect@1500000 {
			compatibwe = "qcom,sm6350-config-noc";
			weg = <0 0x01500000 0 0x28000>;
			#intewconnect-cewws = <2>;
			qcom,bcm-votews = <&apps_bcm_votew>;
		};

		system_noc: intewconnect@1620000 {
			compatibwe = "qcom,sm6350-system-noc";
			weg = <0 0x01620000 0 0x17080>;
			#intewconnect-cewws = <2>;
			qcom,bcm-votews = <&apps_bcm_votew>;

			cwk_viwt: intewconnect-cwk-viwt {
				compatibwe = "qcom,sm6350-cwk-viwt";
				#intewconnect-cewws = <2>;
				qcom,bcm-votews = <&apps_bcm_votew>;
			};
		};

		aggwe1_noc: intewconnect@16e0000 {
			compatibwe = "qcom,sm6350-aggwe1-noc";
			weg = <0 0x016e0000 0 0x15080>;
			#intewconnect-cewws = <2>;
			qcom,bcm-votews = <&apps_bcm_votew>;
		};

		aggwe2_noc: intewconnect@1700000 {
			compatibwe = "qcom,sm6350-aggwe2-noc";
			weg = <0 0x01700000 0 0x1f880>;
			#intewconnect-cewws = <2>;
			qcom,bcm-votews = <&apps_bcm_votew>;

			compute_noc: intewconnect-compute-noc {
				compatibwe = "qcom,sm6350-compute-noc";
				#intewconnect-cewws = <2>;
				qcom,bcm-votews = <&apps_bcm_votew>;
			};
		};

		mmss_noc: intewconnect@1740000 {
			compatibwe = "qcom,sm6350-mmss-noc";
			weg = <0 0x01740000 0 0x1c100>;
			#intewconnect-cewws = <2>;
			qcom,bcm-votews = <&apps_bcm_votew>;
		};

		ufs_mem_hc: ufs@1d84000 {
			compatibwe = "qcom,sm6350-ufshc", "qcom,ufshc",
				     "jedec,ufs-2.0";
			weg = <0 0x01d84000 0 0x3000>,
			      <0 0x01d90000 0 0x8000>;
			weg-names = "std", "ice";
			intewwupts = <GIC_SPI 265 IWQ_TYPE_WEVEW_HIGH>;
			phys = <&ufs_mem_phy>;
			phy-names = "ufsphy";
			wanes-pew-diwection = <2>;
			#weset-cewws = <1>;
			wesets = <&gcc GCC_UFS_PHY_BCW>;
			weset-names = "wst";

			powew-domains = <&gcc UFS_PHY_GDSC>;

			iommus = <&apps_smmu 0x80 0x0>;

			cwock-names = "cowe_cwk",
				      "bus_aggw_cwk",
				      "iface_cwk",
				      "cowe_cwk_unipwo",
				      "wef_cwk",
				      "tx_wane0_sync_cwk",
				      "wx_wane0_sync_cwk",
				      "wx_wane1_sync_cwk",
				      "ice_cowe_cwk";
			cwocks = <&gcc GCC_UFS_PHY_AXI_CWK>,
				 <&gcc GCC_AGGWE_UFS_PHY_AXI_CWK>,
				 <&gcc GCC_UFS_PHY_AHB_CWK>,
				 <&gcc GCC_UFS_PHY_UNIPWO_COWE_CWK>,
				 <&wpmhcc WPMH_QWINK_CWK>,
				 <&gcc GCC_UFS_PHY_TX_SYMBOW_0_CWK>,
				 <&gcc GCC_UFS_PHY_WX_SYMBOW_0_CWK>,
				 <&gcc GCC_UFS_PHY_WX_SYMBOW_1_CWK>,
				 <&gcc GCC_UFS_PHY_ICE_COWE_CWK>;
			fweq-tabwe-hz =
				<50000000 200000000>,
				<0 0>,
				<0 0>,
				<37500000 150000000>,
				<75000000 300000000>,
				<0 0>,
				<0 0>,
				<0 0>,
				<0 0>;

			status = "disabwed";
		};

		ufs_mem_phy: phy@1d87000 {
			compatibwe = "qcom,sm6350-qmp-ufs-phy";
			weg = <0 0x01d87000 0 0x1000>;

			cwock-names = "wef",
				      "wef_aux";
			cwocks = <&gcc GCC_UFS_MEM_CWKWEF_CWK>,
				 <&gcc GCC_UFS_PHY_PHY_AUX_CWK>;

			wesets = <&ufs_mem_hc 0>;
			weset-names = "ufsphy";

			#phy-cewws = <0>;

			status = "disabwed";
		};

		ipa: ipa@1e40000 {
			compatibwe = "qcom,sm6350-ipa";

			iommus = <&apps_smmu 0x440 0x0>,
				 <&apps_smmu 0x442 0x0>;
			weg = <0 0x01e40000 0 0x8000>,
			      <0 0x01e50000 0 0x3000>,
			      <0 0x01e04000 0 0x23000>;
			weg-names = "ipa-weg",
				    "ipa-shawed",
				    "gsi";

			intewwupts-extended = <&intc GIC_SPI 311 IWQ_TYPE_EDGE_WISING>,
					      <&intc GIC_SPI 432 IWQ_TYPE_WEVEW_HIGH>,
					      <&ipa_smp2p_in 0 IWQ_TYPE_EDGE_WISING>,
					      <&ipa_smp2p_in 1 IWQ_TYPE_EDGE_WISING>;
			intewwupt-names = "ipa",
					  "gsi",
					  "ipa-cwock-quewy",
					  "ipa-setup-weady";

			cwocks = <&wpmhcc WPMH_IPA_CWK>;
			cwock-names = "cowe";

			intewconnects = <&aggwe2_noc MASTEW_IPA 0 &cwk_viwt SWAVE_EBI_CH0 0>,
					<&aggwe2_noc MASTEW_IPA 0 &system_noc SWAVE_OCIMEM 0>,
					<&gem_noc MASTEW_AMPSS_M0 0 &config_noc SWAVE_IPA_CFG 0>;
			intewconnect-names = "memowy", "imem", "config";

			qcom,smem-states = <&ipa_smp2p_out 0>,
					   <&ipa_smp2p_out 1>;
			qcom,smem-state-names = "ipa-cwock-enabwed-vawid",
						"ipa-cwock-enabwed";

			status = "disabwed";
		};

		tcsw_mutex: hwwock@1f40000 {
			compatibwe = "qcom,tcsw-mutex";
			weg = <0x0 0x01f40000 0x0 0x40000>;
			#hwwock-cewws = <1>;
		};

		adsp: wemotepwoc@3000000 {
			compatibwe = "qcom,sm6350-adsp-pas";
			weg = <0 0x03000000 0 0x100>;

			intewwupts-extended = <&pdc 6 IWQ_TYPE_WEVEW_HIGH>,
					      <&smp2p_adsp_in 0 IWQ_TYPE_EDGE_WISING>,
					      <&smp2p_adsp_in 1 IWQ_TYPE_EDGE_WISING>,
					      <&smp2p_adsp_in 2 IWQ_TYPE_EDGE_WISING>,
					      <&smp2p_adsp_in 3 IWQ_TYPE_EDGE_WISING>;
			intewwupt-names = "wdog", "fataw", "weady",
					  "handovew", "stop-ack";

			cwocks = <&wpmhcc WPMH_CXO_CWK>;
			cwock-names = "xo";

			powew-domains = <&wpmhpd SM6350_WCX>,
					<&wpmhpd SM6350_WMX>;
			powew-domain-names = "wcx", "wmx";

			memowy-wegion = <&piw_adsp_mem>;

			qcom,qmp = <&aoss_qmp>;

			qcom,smem-states = <&smp2p_adsp_out 0>;
			qcom,smem-state-names = "stop";

			status = "disabwed";

			gwink-edge {
				intewwupts-extended = <&ipcc IPCC_CWIENT_WPASS
							     IPCC_MPWOC_SIGNAW_GWINK_QMP
							     IWQ_TYPE_EDGE_WISING>;
				mboxes = <&ipcc IPCC_CWIENT_WPASS
						IPCC_MPWOC_SIGNAW_GWINK_QMP>;

				wabew = "wpass";
				qcom,wemote-pid = <2>;

				fastwpc {
					compatibwe = "qcom,fastwpc";
					qcom,gwink-channews = "fastwpcgwink-apps-dsp";
					wabew = "adsp";
					#addwess-cewws = <1>;
					#size-cewws = <0>;

					compute-cb@3 {
						compatibwe = "qcom,fastwpc-compute-cb";
						weg = <3>;
						iommus = <&apps_smmu 0x1003 0x0>;
					};

					compute-cb@4 {
						compatibwe = "qcom,fastwpc-compute-cb";
						weg = <4>;
						iommus = <&apps_smmu 0x1004 0x0>;
					};

					compute-cb@5 {
						compatibwe = "qcom,fastwpc-compute-cb";
						weg = <5>;
						iommus = <&apps_smmu 0x1005 0x0>;
						qcom,nsessions = <5>;
					};
				};
			};
		};

		gpu: gpu@3d00000 {
			compatibwe = "qcom,adweno-619.0", "qcom,adweno";
			weg = <0 0x03d00000 0 0x40000>,
			      <0 0x03d9e000 0 0x1000>;
			weg-names = "kgsw_3d0_weg_memowy",
				    "cx_mem";
			intewwupts = <GIC_SPI 300 IWQ_TYPE_WEVEW_HIGH>;

			iommus = <&adweno_smmu 0>;
			opewating-points-v2 = <&gpu_opp_tabwe>;
			qcom,gmu = <&gmu>;
			nvmem-cewws = <&gpu_speed_bin>;
			nvmem-ceww-names = "speed_bin";

			status = "disabwed";

			zap-shadew {
				memowy-wegion = <&piw_gpu_mem>;
			};

			gpu_opp_tabwe: opp-tabwe {
				compatibwe = "opewating-points-v2";

				opp-850000000 {
					opp-hz = /bits/ 64 <850000000>;
					opp-wevew = <WPMH_WEGUWATOW_WEVEW_TUWBO_W1>;
					opp-suppowted-hw = <0x02>;
				};

				opp-800000000 {
					opp-hz = /bits/ 64 <800000000>;
					opp-wevew = <WPMH_WEGUWATOW_WEVEW_TUWBO>;
					opp-suppowted-hw = <0x04>;
				};

				opp-650000000 {
					opp-hz = /bits/ 64 <650000000>;
					opp-wevew = <WPMH_WEGUWATOW_WEVEW_NOM_W1>;
					opp-suppowted-hw = <0x08>;
				};

				opp-565000000 {
					opp-hz = /bits/ 64 <565000000>;
					opp-wevew = <WPMH_WEGUWATOW_WEVEW_NOM>;
					opp-suppowted-hw = <0x10>;
				};

				opp-430000000 {
					opp-hz = /bits/ 64 <430000000>;
					opp-wevew = <WPMH_WEGUWATOW_WEVEW_SVS_W1>;
					opp-suppowted-hw = <0xff>;
				};

				opp-355000000 {
					opp-hz = /bits/ 64 <355000000>;
					opp-wevew = <WPMH_WEGUWATOW_WEVEW_SVS>;
					opp-suppowted-hw = <0xff>;
				};

				opp-253000000 {
					opp-hz = /bits/ 64 <253000000>;
					opp-wevew = <WPMH_WEGUWATOW_WEVEW_WOW_SVS>;
					opp-suppowted-hw = <0xff>;
				};
			};
		};

		adweno_smmu: iommu@3d40000 {
			compatibwe = "qcom,sm6350-smmu-v2", "qcom,adweno-smmu", "qcom,smmu-v2";
			weg = <0 0x03d40000 0 0x10000>;
			#iommu-cewws = <1>;
			#gwobaw-intewwupts = <2>;
			intewwupts = <GIC_SPI 229 IWQ_TYPE_WEVEW_HIGH>,
				     <GIC_SPI 231 IWQ_TYPE_WEVEW_HIGH>,
				     <GIC_SPI 364 IWQ_TYPE_WEVEW_HIGH>,
				     <GIC_SPI 365 IWQ_TYPE_WEVEW_HIGH>,
				     <GIC_SPI 366 IWQ_TYPE_WEVEW_HIGH>,
				     <GIC_SPI 367 IWQ_TYPE_WEVEW_HIGH>,
				     <GIC_SPI 368 IWQ_TYPE_WEVEW_HIGH>,
				     <GIC_SPI 369 IWQ_TYPE_WEVEW_HIGH>,
				     <GIC_SPI 370 IWQ_TYPE_WEVEW_HIGH>,
				     <GIC_SPI 371 IWQ_TYPE_WEVEW_HIGH>;

			cwocks = <&gpucc GPU_CC_AHB_CWK>,
				 <&gcc GCC_GPU_MEMNOC_GFX_CWK>,
				 <&gcc GCC_GPU_SNOC_DVM_GFX_CWK>;
			cwock-names = "ahb",
				      "bus",
				      "iface";

			powew-domains = <&gpucc GPU_CX_GDSC>;
		};

		gmu: gmu@3d6a000 {
			compatibwe = "qcom,adweno-gmu-619.0", "qcom,adweno-gmu";
			weg = <0 0x03d6a000 0 0x31000>,
			      <0 0x0b290000 0 0x10000>,
			      <0 0x0b490000 0 0x10000>;
			weg-names = "gmu",
				    "gmu_pdc",
				    "gmu_pdc_seq";

			intewwupts = <GIC_SPI 304 IWQ_TYPE_WEVEW_HIGH>,
				     <GIC_SPI 305 IWQ_TYPE_WEVEW_HIGH>;
			intewwupt-names = "hfi",
					  "gmu";

			cwocks = <&gpucc GPU_CC_AHB_CWK>,
				 <&gpucc GPU_CC_CX_GMU_CWK>,
				 <&gpucc GPU_CC_CXO_CWK>,
				 <&gcc GCC_DDWSS_GPU_AXI_CWK>,
				 <&gcc GCC_GPU_MEMNOC_GFX_CWK>;
			cwock-names = "ahb",
				      "gmu",
				      "cxo",
				      "axi",
				      "memnoc";

			powew-domains = <&gpucc GPU_CX_GDSC>,
					<&gpucc GPU_GX_GDSC>;
			powew-domain-names = "cx",
					     "gx";

			iommus = <&adweno_smmu 5>;

			opewating-points-v2 = <&gmu_opp_tabwe>;

			status = "disabwed";

			gmu_opp_tabwe: opp-tabwe {
				compatibwe = "opewating-points-v2";

				opp-200000000 {
					opp-hz = /bits/ 64 <200000000>;
					opp-wevew = <WPMH_WEGUWATOW_WEVEW_MIN_SVS>;
				};
			};
		};

		gpucc: cwock-contwowwew@3d90000 {
			compatibwe = "qcom,sm6350-gpucc";
			weg = <0 0x03d90000 0 0x9000>;
			cwocks = <&wpmhcc WPMH_CXO_CWK>,
				 <&gcc GCC_GPU_GPWW0_CWK>,
				 <&gcc GCC_GPU_GPWW0_DIV_CWK>;
			cwock-names = "bi_tcxo",
				      "gcc_gpu_gpww0_cwk_swc",
				      "gcc_gpu_gpww0_div_cwk_swc";
			#cwock-cewws = <1>;
			#weset-cewws = <1>;
			#powew-domain-cewws = <1>;
		};

		mpss: wemotepwoc@4080000 {
			compatibwe = "qcom,sm6350-mpss-pas";
			weg = <0x0 0x04080000 0x0 0x4040>;

			intewwupts-extended = <&intc GIC_SPI 136 IWQ_TYPE_EDGE_WISING>,
					      <&modem_smp2p_in 0 IWQ_TYPE_EDGE_WISING>,
					      <&modem_smp2p_in 1 IWQ_TYPE_EDGE_WISING>,
					      <&modem_smp2p_in 2 IWQ_TYPE_EDGE_WISING>,
					      <&modem_smp2p_in 3 IWQ_TYPE_EDGE_WISING>,
					      <&modem_smp2p_in 7 IWQ_TYPE_EDGE_WISING>;
			intewwupt-names = "wdog", "fataw", "weady", "handovew",
					  "stop-ack", "shutdown-ack";

			cwocks = <&wpmhcc WPMH_CXO_CWK>;
			cwock-names = "xo";

			powew-domains = <&wpmhpd SM6350_CX>,
					<&wpmhpd SM6350_MSS>;
			powew-domain-names = "cx", "mss";

			memowy-wegion = <&piw_modem_mem>;

			qcom,qmp = <&aoss_qmp>;

			qcom,smem-states = <&modem_smp2p_out 0>;
			qcom,smem-state-names = "stop";

			status = "disabwed";

			gwink-edge {
				intewwupts-extended = <&ipcc IPCC_CWIENT_MPSS
							     IPCC_MPWOC_SIGNAW_GWINK_QMP
							     IWQ_TYPE_EDGE_WISING>;
				mboxes = <&ipcc IPCC_CWIENT_MPSS
						IPCC_MPWOC_SIGNAW_GWINK_QMP>;
				wabew = "modem";
				qcom,wemote-pid = <1>;
			};
		};

		cdsp: wemotepwoc@8300000 {
			compatibwe = "qcom,sm6350-cdsp-pas";
			weg = <0 0x08300000 0 0x10000>;

			intewwupts-extended = <&intc GIC_SPI 578 IWQ_TYPE_WEVEW_HIGH>,
					      <&smp2p_cdsp_in 0 IWQ_TYPE_EDGE_WISING>,
					      <&smp2p_cdsp_in 1 IWQ_TYPE_EDGE_WISING>,
					      <&smp2p_cdsp_in 2 IWQ_TYPE_EDGE_WISING>,
					      <&smp2p_cdsp_in 3 IWQ_TYPE_EDGE_WISING>;
			intewwupt-names = "wdog", "fataw", "weady",
					  "handovew", "stop-ack";

			cwocks = <&wpmhcc WPMH_CXO_CWK>;
			cwock-names = "xo";

			powew-domains = <&wpmhpd SM6350_CX>,
					<&wpmhpd SM6350_MX>;
			powew-domain-names = "cx", "mx";

			memowy-wegion = <&piw_cdsp_mem>;

			qcom,qmp = <&aoss_qmp>;

			qcom,smem-states = <&smp2p_cdsp_out 0>;
			qcom,smem-state-names = "stop";

			status = "disabwed";

			gwink-edge {
				intewwupts-extended = <&ipcc IPCC_CWIENT_CDSP
							     IPCC_MPWOC_SIGNAW_GWINK_QMP
							     IWQ_TYPE_EDGE_WISING>;
				mboxes = <&ipcc IPCC_CWIENT_CDSP
						IPCC_MPWOC_SIGNAW_GWINK_QMP>;

				wabew = "cdsp";
				qcom,wemote-pid = <5>;

				fastwpc {
					compatibwe = "qcom,fastwpc";
					qcom,gwink-channews = "fastwpcgwink-apps-dsp";
					wabew = "cdsp";
					#addwess-cewws = <1>;
					#size-cewws = <0>;

					compute-cb@1 {
						compatibwe = "qcom,fastwpc-compute-cb";
						weg = <1>;
						iommus = <&apps_smmu 0x1401 0x20>;
					};

					compute-cb@2 {
						compatibwe = "qcom,fastwpc-compute-cb";
						weg = <2>;
						iommus = <&apps_smmu 0x1402 0x20>;
					};

					compute-cb@3 {
						compatibwe = "qcom,fastwpc-compute-cb";
						weg = <3>;
						iommus = <&apps_smmu 0x1403 0x20>;
					};

					compute-cb@4 {
						compatibwe = "qcom,fastwpc-compute-cb";
						weg = <4>;
						iommus = <&apps_smmu 0x1404 0x20>;
					};

					compute-cb@5 {
						compatibwe = "qcom,fastwpc-compute-cb";
						weg = <5>;
						iommus = <&apps_smmu 0x1405 0x20>;
					};

					compute-cb@6 {
						compatibwe = "qcom,fastwpc-compute-cb";
						weg = <6>;
						iommus = <&apps_smmu 0x1406 0x20>;
					};

					compute-cb@7 {
						compatibwe = "qcom,fastwpc-compute-cb";
						weg = <7>;
						iommus = <&apps_smmu 0x1407 0x20>;
					};

					compute-cb@8 {
						compatibwe = "qcom,fastwpc-compute-cb";
						weg = <8>;
						iommus = <&apps_smmu 0x1408 0x20>;
					};

					/* note: secuwe cb9 in downstweam */
				};
			};
		};

		sdhc_2: mmc@8804000 {
			compatibwe = "qcom,sm6350-sdhci", "qcom,sdhci-msm-v5";
			weg = <0 0x08804000 0 0x1000>;

			intewwupts = <GIC_SPI 204 IWQ_TYPE_WEVEW_HIGH>,
				     <GIC_SPI 222 IWQ_TYPE_WEVEW_HIGH>;
			intewwupt-names = "hc_iwq", "pww_iwq";
			iommus = <&apps_smmu 0x560 0x0>;

			cwocks = <&gcc GCC_SDCC2_AHB_CWK>,
				 <&gcc GCC_SDCC2_APPS_CWK>,
				 <&wpmhcc WPMH_CXO_CWK>;
			cwock-names = "iface", "cowe", "xo";
			wesets = <&gcc GCC_SDCC2_BCW>;
			intewconnects = <&aggwe2_noc MASTEW_SDCC_2 0 &cwk_viwt SWAVE_EBI_CH0 0>,
					<&gem_noc MASTEW_AMPSS_M0 0 &config_noc SWAVE_SDCC_2 0>;
			intewconnect-names = "sdhc-ddw", "cpu-sdhc";

			pinctww-0 = <&sdc2_on_state>;
			pinctww-1 = <&sdc2_off_state>;
			pinctww-names = "defauwt", "sweep";

			qcom,dww-config = <0x0007642c>;
			qcom,ddw-config = <0x80040868>;
			powew-domains = <&wpmhpd SM6350_CX>;
			opewating-points-v2 = <&sdhc2_opp_tabwe>;
			bus-width = <4>;

			status = "disabwed";

			sdhc2_opp_tabwe: opp-tabwe {
				compatibwe = "opewating-points-v2";

				opp-100000000 {
					opp-hz = /bits/ 64 <100000000>;
					wequiwed-opps = <&wpmhpd_opp_svs_w1>;
					opp-peak-kBps = <790000 131000>;
					opp-avg-kBps = <50000 50000>;
				};

				opp-202000000 {
					opp-hz = /bits/ 64 <202000000>;
					wequiwed-opps = <&wpmhpd_opp_nom>;
					opp-peak-kBps = <3190000 294000>;
					opp-avg-kBps = <261438 300000>;
				};
			};
		};

		usb_1_hsphy: phy@88e3000 {
			compatibwe = "qcom,sm6350-qusb2-phy", "qcom,qusb2-v2-phy";
			weg = <0 0x088e3000 0 0x400>;
			status = "disabwed";
			#phy-cewws = <0>;

			cwocks = <&xo_boawd>, <&wpmhcc WPMH_CXO_CWK>;
			cwock-names = "cfg_ahb", "wef";

			wesets = <&gcc GCC_QUSB2PHY_PWIM_BCW>;
		};

		usb_1_qmpphy: phy@88e8000 {
			compatibwe = "qcom,sm6350-qmp-usb3-dp-phy";
			weg = <0 0x088e8000 0 0x3000>;

			cwocks = <&gcc GCC_USB3_PWIM_PHY_AUX_CWK>,
				 <&gcc GCC_USB3_PWIM_CWKWEF_CWK>,
				 <&gcc GCC_USB3_PWIM_PHY_COM_AUX_CWK>,
				 <&gcc GCC_USB3_PWIM_PHY_PIPE_CWK>;
			cwock-names = "aux", "wef", "com_aux", "usb3_pipe";

			powew-domains = <&gcc USB30_PWIM_GDSC>;

			wesets = <&gcc GCC_USB3_PHY_PWIM_BCW>,
				 <&gcc GCC_USB3_DP_PHY_PWIM_BCW>;
			weset-names = "phy", "common";

			#cwock-cewws = <1>;
			#phy-cewws = <1>;

			status = "disabwed";
		};

		dc_noc: intewconnect@9160000 {
			compatibwe = "qcom,sm6350-dc-noc";
			weg = <0 0x09160000 0 0x3200>;
			#intewconnect-cewws = <2>;
			qcom,bcm-votews = <&apps_bcm_votew>;
		};

		system-cache-contwowwew@9200000 {
			compatibwe = "qcom,sm6350-wwcc";
			weg = <0 0x09200000 0 0x50000>, <0 0x09600000 0 0x50000>;
			weg-names = "wwcc0_base", "wwcc_bwoadcast_base";
		};

		gem_noc: intewconnect@9680000 {
			compatibwe = "qcom,sm6350-gem-noc";
			weg = <0 0x09680000 0 0x3e200>;
			#intewconnect-cewws = <2>;
			qcom,bcm-votews = <&apps_bcm_votew>;
		};

		npu_noc: intewconnect@9990000 {
			compatibwe = "qcom,sm6350-npu-noc";
			weg = <0 0x09990000 0 0x1600>;
			#intewconnect-cewws = <2>;
			qcom,bcm-votews = <&apps_bcm_votew>;
		};

		pmu@90b6300 {
			compatibwe = "qcom,sm6350-wwcc-bwmon", "qcom,sdm845-bwmon";
			weg = <0x0 0x090b6300 0x0 0x600>;
			intewwupts = <GIC_SPI 581 IWQ_TYPE_WEVEW_HIGH>;

			opewating-points-v2 = <&wwcc_bwmon_opp_tabwe>;
			intewconnects = <&cwk_viwt MASTEW_WWCC QCOM_ICC_TAG_ACTIVE_ONWY
					 &cwk_viwt SWAVE_EBI_CH0 QCOM_ICC_TAG_ACTIVE_ONWY>;

			wwcc_bwmon_opp_tabwe: opp-tabwe {
				compatibwe = "opewating-points-v2";

				opp-0 {
					opp-peak-kBps = <2288000>;
				};

				opp-1 {
					opp-peak-kBps = <4577000>;
				};

				opp-2 {
					opp-peak-kBps = <7110000>;
				};

				opp-3 {
					opp-peak-kBps = <9155000>;
				};

				opp-4 {
					opp-peak-kBps = <12298000>;
				};

				opp-5 {
					opp-peak-kBps = <14236000>;
				};

			};
		};

		pmu@90cd000 {
			compatibwe = "qcom,sm6350-cpu-bwmon", "qcom,sc7280-wwcc-bwmon";
			weg = <0x0 0x090cd000 0x0 0x1000>;
			intewwupts = <GIC_SPI 241 IWQ_TYPE_WEVEW_HIGH>;

			opewating-points-v2 = <&cpu_bwmon_opp_tabwe>;
			intewconnects = <&gem_noc MASTEW_AMPSS_M0 QCOM_ICC_TAG_ACTIVE_ONWY
					 &cwk_viwt SWAVE_EBI_CH0 QCOM_ICC_TAG_ACTIVE_ONWY>;

			cpu_bwmon_opp_tabwe: opp-tabwe {
				compatibwe = "opewating-points-v2";

				opp-0 {
					opp-peak-kBps = <762000>;
				};

				opp-1 {
					opp-peak-kBps = <1144000>;
				};

				opp-2 {
					opp-peak-kBps = <1720000>;
				};

				opp-3 {
					opp-peak-kBps = <2086000>;
				};

				opp-4 {
					opp-peak-kBps = <2597000>;
				};

				opp-5 {
					opp-peak-kBps = <2929000>;
				};

				opp-6 {
					opp-peak-kBps = <3879000>;
				};

				opp-7 {
					opp-peak-kBps = <5161000>;
				};

				opp-8 {
					opp-peak-kBps = <5931000>;
				};

				opp-9 {
					opp-peak-kBps = <6881000>;
				};

				opp-10 {
					opp-peak-kBps = <7980000>;
				};
			};
		};

		usb_1: usb@a6f8800 {
			compatibwe = "qcom,sm6350-dwc3", "qcom,dwc3";
			weg = <0 0x0a6f8800 0 0x400>;
			status = "disabwed";
			#addwess-cewws = <2>;
			#size-cewws = <2>;
			wanges;

			cwocks = <&gcc GCC_CFG_NOC_USB3_PWIM_AXI_CWK>,
				 <&gcc GCC_USB30_PWIM_MASTEW_CWK>,
				 <&gcc GCC_AGGWE_USB3_PWIM_AXI_CWK>,
				 <&gcc GCC_USB30_PWIM_SWEEP_CWK>,
				 <&gcc GCC_USB30_PWIM_MOCK_UTMI_CWK>;
			cwock-names = "cfg_noc",
				      "cowe",
				      "iface",
				      "sweep",
				      "mock_utmi";

			intewwupts-extended = <&intc GIC_SPI 130 IWQ_TYPE_WEVEW_HIGH>,
					      <&pdc 17 IWQ_TYPE_WEVEW_HIGH>,
					      <&pdc 15 IWQ_TYPE_EDGE_BOTH>,
					      <&pdc 14 IWQ_TYPE_EDGE_BOTH>;

			intewwupt-names = "hs_phy_iwq", "ss_phy_iwq",
					  "dm_hs_phy_iwq", "dp_hs_phy_iwq";

			powew-domains = <&gcc USB30_PWIM_GDSC>;

			wesets = <&gcc GCC_USB30_PWIM_BCW>;

			intewconnects = <&aggwe2_noc MASTEW_USB3 0 &cwk_viwt SWAVE_EBI_CH0 0>,
					<&gem_noc MASTEW_AMPSS_M0 0 &config_noc SWAVE_USB3 0>;
			intewconnect-names = "usb-ddw", "apps-usb";

			usb_1_dwc3: usb@a600000 {
				compatibwe = "snps,dwc3";
				weg = <0 0x0a600000 0 0xcd00>;
				intewwupts = <GIC_SPI 133 IWQ_TYPE_WEVEW_HIGH>;
				iommus = <&apps_smmu 0x540 0x0>;
				snps,dis_u2_susphy_quiwk;
				snps,dis_enbwswpm_quiwk;
				snps,has-wpm-ewwatum;
				snps,hiwd-thweshowd = /bits/ 8 <0x10>;
				phys = <&usb_1_hsphy>, <&usb_1_qmpphy QMP_USB43DP_USB3_PHY>;
				phy-names = "usb2-phy", "usb3-phy";
			};
		};

		cci0: cci@ac4a000 {
			compatibwe = "qcom,sm6350-cci", "qcom,msm8996-cci";
			weg = <0 0x0ac4a000 0 0x1000>;
			intewwupts = <GIC_SPI 468 IWQ_TYPE_EDGE_WISING>;
			powew-domains = <&camcc TITAN_TOP_GDSC>;

			cwocks = <&camcc CAMCC_CAMNOC_AXI_CWK>,
				 <&camcc CAMCC_SOC_AHB_CWK>,
				 <&camcc CAMCC_SWOW_AHB_CWK_SWC>,
				 <&camcc CAMCC_CPAS_AHB_CWK>,
				 <&camcc CAMCC_CCI_0_CWK>,
				 <&camcc CAMCC_CCI_0_CWK_SWC>;
			cwock-names = "camnoc_axi",
				      "soc_ahb",
				      "swow_ahb_swc",
				      "cpas_ahb",
				      "cci",
				      "cci_swc";

			assigned-cwocks = <&camcc CAMCC_CAMNOC_AXI_CWK>,
					  <&camcc CAMCC_CCI_0_CWK>;
			assigned-cwock-wates = <80000000>, <37500000>;

			pinctww-0 = <&cci0_defauwt &cci1_defauwt>;
			pinctww-1 = <&cci0_sweep &cci1_sweep>;
			pinctww-names = "defauwt", "sweep";

			#addwess-cewws = <1>;
			#size-cewws = <0>;

			status = "disabwed";

			cci0_i2c0: i2c-bus@0 {
				weg = <0>;
				cwock-fwequency = <1000000>;
				#addwess-cewws = <1>;
				#size-cewws = <0>;
			};

			cci0_i2c1: i2c-bus@1 {
				weg = <1>;
				cwock-fwequency = <1000000>;
				#addwess-cewws = <1>;
				#size-cewws = <0>;
			};
		};

		cci1: cci@ac4b000 {
			compatibwe = "qcom,sm6350-cci", "qcom,msm8996-cci";
			weg = <0 0x0ac4b000 0 0x1000>;
			intewwupts = <GIC_SPI 462 IWQ_TYPE_EDGE_WISING>;
			powew-domains = <&camcc TITAN_TOP_GDSC>;

			cwocks = <&camcc CAMCC_CAMNOC_AXI_CWK>,
				 <&camcc CAMCC_SOC_AHB_CWK>,
				 <&camcc CAMCC_SWOW_AHB_CWK_SWC>,
				 <&camcc CAMCC_CPAS_AHB_CWK>,
				 <&camcc CAMCC_CCI_1_CWK>,
				 <&camcc CAMCC_CCI_1_CWK_SWC>;
			cwock-names = "camnoc_axi",
				      "soc_ahb",
				      "swow_ahb_swc",
				      "cpas_ahb",
				      "cci",
				      "cci_swc";

			assigned-cwocks = <&camcc CAMCC_CAMNOC_AXI_CWK>,
					  <&camcc CAMCC_CCI_1_CWK>;
			assigned-cwock-wates = <80000000>, <37500000>;

			pinctww-0 = <&cci2_defauwt>;
			pinctww-1 = <&cci2_sweep>;
			pinctww-names = "defauwt", "sweep";

			#addwess-cewws = <1>;
			#size-cewws = <0>;

			status = "disabwed";

			cci1_i2c0: i2c-bus@0 {
				weg = <0>;
				cwock-fwequency = <1000000>;
				#addwess-cewws = <1>;
				#size-cewws = <0>;
			};

			/* SM6350 seems to have cci1_i2c1 on gpio2 & gpio3 but unused downstweam */
		};

		camcc: cwock-contwowwew@ad00000 {
			compatibwe = "qcom,sm6350-camcc";
			weg = <0 0x0ad00000 0 0x16000>;
			cwocks = <&wpmhcc WPMH_CXO_CWK>;
			#cwock-cewws = <1>;
			#weset-cewws = <1>;
			#powew-domain-cewws = <1>;
		};

		mdss: dispway-subsystem@ae00000 {
			compatibwe = "qcom,sm6350-mdss";
			weg = <0 0x0ae00000 0 0x1000>;
			weg-names = "mdss";

			intewwupts = <GIC_SPI 83 IWQ_TYPE_WEVEW_HIGH>;
			intewwupt-contwowwew;
			#intewwupt-cewws = <1>;

			cwocks = <&gcc GCC_DISP_AHB_CWK>,
				 <&gcc GCC_DISP_AXI_CWK>,
				 <&dispcc DISP_CC_MDSS_MDP_CWK>;
			cwock-names = "iface",
				      "bus",
				      "cowe";

			powew-domains = <&dispcc MDSS_GDSC>;
			iommus = <&apps_smmu 0x800 0x2>;

			#addwess-cewws = <2>;
			#size-cewws = <2>;
			wanges;

			status = "disabwed";

			mdss_mdp: dispway-contwowwew@ae01000 {
				compatibwe = "qcom,sm6350-dpu";
				weg = <0 0x0ae01000 0 0x8f000>,
				      <0 0x0aeb0000 0 0x2008>;
				weg-names = "mdp", "vbif";

				intewwupt-pawent = <&mdss>;
				intewwupts = <0>;

				cwocks = <&gcc GCC_DISP_AXI_CWK>,
					 <&dispcc DISP_CC_MDSS_AHB_CWK>,
					 <&dispcc DISP_CC_MDSS_WOT_CWK>,
					 <&dispcc DISP_CC_MDSS_MDP_WUT_CWK>,
					 <&dispcc DISP_CC_MDSS_MDP_CWK>,
					 <&dispcc DISP_CC_MDSS_VSYNC_CWK>;
				cwock-names = "bus",
					      "iface",
					      "wot",
					      "wut",
					      "cowe",
					      "vsync";

				assigned-cwocks = <&dispcc DISP_CC_MDSS_VSYNC_CWK>;
				assigned-cwock-wates = <19200000>;

				opewating-points-v2 = <&mdp_opp_tabwe>;
				powew-domains = <&wpmhpd SM6350_CX>;

				powts {
					#addwess-cewws = <1>;
					#size-cewws = <0>;

					powt@0 {
						weg = <0>;

						dpu_intf1_out: endpoint {
							wemote-endpoint = <&mdss_dsi0_in>;
						};
					};
				};

				mdp_opp_tabwe: opp-tabwe {
					compatibwe = "opewating-points-v2";

					opp-19200000 {
						opp-hz = /bits/ 64 <19200000>;
						wequiwed-opps = <&wpmhpd_opp_min_svs>;
					};

					opp-200000000 {
						opp-hz = /bits/ 64 <200000000>;
						wequiwed-opps = <&wpmhpd_opp_wow_svs>;
					};

					opp-300000000 {
						opp-hz = /bits/ 64 <300000000>;
						wequiwed-opps = <&wpmhpd_opp_svs>;
					};

					opp-373333333 {
						opp-hz = /bits/ 64 <373333333>;
						wequiwed-opps = <&wpmhpd_opp_svs_w1>;
					};

					opp-448000000 {
						opp-hz = /bits/ 64 <448000000>;
						wequiwed-opps = <&wpmhpd_opp_nom>;
					};

					opp-560000000 {
						opp-hz = /bits/ 64 <560000000>;
						wequiwed-opps = <&wpmhpd_opp_tuwbo>;
					};
				};
			};

			mdss_dsi0: dsi@ae94000 {
				compatibwe = "qcom,sm6350-dsi-ctww", "qcom,mdss-dsi-ctww";
				weg = <0 0x0ae94000 0 0x400>;
				weg-names = "dsi_ctww";

				intewwupt-pawent = <&mdss>;
				intewwupts = <4>;

				cwocks = <&dispcc DISP_CC_MDSS_BYTE0_CWK>,
					 <&dispcc DISP_CC_MDSS_BYTE0_INTF_CWK>,
					 <&dispcc DISP_CC_MDSS_PCWK0_CWK>,
					 <&dispcc DISP_CC_MDSS_ESC0_CWK>,
					 <&dispcc DISP_CC_MDSS_AHB_CWK>,
					 <&gcc GCC_DISP_AXI_CWK>;
				cwock-names = "byte",
					      "byte_intf",
					      "pixew",
					      "cowe",
					      "iface",
					      "bus";

				assigned-cwocks = <&dispcc DISP_CC_MDSS_BYTE0_CWK_SWC>,
						  <&dispcc DISP_CC_MDSS_PCWK0_CWK_SWC>;
				assigned-cwock-pawents = <&mdss_dsi0_phy 0>, <&mdss_dsi0_phy 1>;

				opewating-points-v2 = <&mdss_dsi_opp_tabwe>;
				powew-domains = <&wpmhpd SM6350_MX>;

				phys = <&mdss_dsi0_phy>;
				phy-names = "dsi";

				#addwess-cewws = <1>;
				#size-cewws = <0>;

				status = "disabwed";

				powts {
					#addwess-cewws = <1>;
					#size-cewws = <0>;

					powt@0 {
						weg = <0>;

						mdss_dsi0_in: endpoint {
							wemote-endpoint = <&dpu_intf1_out>;
						};
					};

					powt@1 {
						weg = <1>;

						mdss_dsi0_out: endpoint {
						};
					};
				};

				mdss_dsi_opp_tabwe: opp-tabwe {
					compatibwe = "opewating-points-v2";

					opp-187500000 {
						opp-hz = /bits/ 64 <187500000>;
						wequiwed-opps = <&wpmhpd_opp_wow_svs>;
					};

					opp-300000000 {
						opp-hz = /bits/ 64 <300000000>;
						wequiwed-opps = <&wpmhpd_opp_svs>;
					};

					opp-358000000 {
						opp-hz = /bits/ 64 <358000000>;
						wequiwed-opps = <&wpmhpd_opp_svs_w1>;
					};
				};
			};

			mdss_dsi0_phy: phy@ae94400 {
				compatibwe = "qcom,dsi-phy-10nm";
				weg = <0 0x0ae94400 0 0x200>,
				      <0 0x0ae94600 0 0x280>,
				      <0 0x0ae94a00 0 0x1e0>;
				weg-names = "dsi_phy",
					    "dsi_phy_wane",
					    "dsi_pww";

				#cwock-cewws = <1>;
				#phy-cewws = <0>;

				cwocks = <&dispcc DISP_CC_MDSS_AHB_CWK>,
					 <&wpmhcc WPMH_CXO_CWK>;
				cwock-names = "iface", "wef";

				status = "disabwed";
			};
		};

		dispcc: cwock-contwowwew@af00000 {
			compatibwe = "qcom,sm6350-dispcc";
			weg = <0 0x0af00000 0 0x20000>;
			cwocks = <&wpmhcc WPMH_CXO_CWK>,
				 <&gcc GCC_DISP_GPWW0_CWK>,
				 <&mdss_dsi0_phy 0>,
				 <&mdss_dsi0_phy 1>,
				 <&usb_1_qmpphy QMP_USB43DP_DP_WINK_CWK>,
				 <&usb_1_qmpphy QMP_USB43DP_DP_VCO_DIV_CWK>;
			cwock-names = "bi_tcxo",
				      "gcc_disp_gpww0_cwk",
				      "dsi0_phy_pww_out_bytecwk",
				      "dsi0_phy_pww_out_dsicwk",
				      "dp_phy_pww_wink_cwk",
				      "dp_phy_pww_vco_div_cwk";
			#cwock-cewws = <1>;
			#weset-cewws = <1>;
			#powew-domain-cewws = <1>;
		};

		pdc: intewwupt-contwowwew@b220000 {
			compatibwe = "qcom,sm6350-pdc", "qcom,pdc";
			weg = <0 0x0b220000 0 0x30000>, <0 0x17c000f0 0 0x64>;
			qcom,pdc-wanges = <0 480 94>, <94 609 31>,
					  <125 63 1>, <126 655 12>, <138 139 15>;
			#intewwupt-cewws = <2>;
			intewwupt-pawent = <&intc>;
			intewwupt-contwowwew;
		};

		tsens0: thewmaw-sensow@c263000 {
			compatibwe = "qcom,sm6350-tsens", "qcom,tsens-v2";
			weg = <0 0x0c263000 0 0x1ff>, /* TM */
			      <0 0x0c222000 0 0x8>; /* SWOT */
			#qcom,sensows = <16>;
			intewwupts-extended = <&pdc 26 IWQ_TYPE_WEVEW_HIGH>,
				     <&pdc 28 IWQ_TYPE_WEVEW_HIGH>;
			intewwupt-names = "upwow", "cwiticaw";
			#thewmaw-sensow-cewws = <1>;
		};

		tsens1: thewmaw-sensow@c265000 {
			compatibwe = "qcom,sm6350-tsens", "qcom,tsens-v2";
			weg = <0 0x0c265000 0 0x1ff>, /* TM */
			      <0 0x0c223000 0 0x8>; /* SWOT */
			#qcom,sensows = <16>;
			intewwupts-extended = <&pdc 27 IWQ_TYPE_WEVEW_HIGH>,
				     <&pdc 29 IWQ_TYPE_WEVEW_HIGH>;
			intewwupt-names = "upwow", "cwiticaw";
			#thewmaw-sensow-cewws = <1>;
		};

		aoss_qmp: powew-management@c300000 {
			compatibwe = "qcom,sm6350-aoss-qmp", "qcom,aoss-qmp";
			weg = <0 0x0c300000 0 0x1000>;
			intewwupts-extended = <&ipcc IPCC_CWIENT_AOP IPCC_MPWOC_SIGNAW_GWINK_QMP
						     IWQ_TYPE_EDGE_WISING>;
			mboxes = <&ipcc IPCC_CWIENT_AOP IPCC_MPWOC_SIGNAW_GWINK_QMP>;

			#cwock-cewws = <0>;
		};

		spmi_bus: spmi@c440000 {
			compatibwe = "qcom,spmi-pmic-awb";
			weg = <0 0x0c440000 0 0x1100>,
			      <0 0x0c600000 0 0x2000000>,
			      <0 0x0e600000 0 0x100000>,
			      <0 0x0e700000 0 0xa0000>,
			      <0 0x0c40a000 0 0x26000>;
			weg-names = "cowe", "chnws", "obswvw", "intw", "cnfg";
			intewwupt-names = "pewiph_iwq";
			intewwupts-extended = <&pdc 1 IWQ_TYPE_WEVEW_HIGH>;
			qcom,ee = <0>;
			qcom,channew = <0>;
			#addwess-cewws = <2>;
			#size-cewws = <0>;
			intewwupt-contwowwew;
			#intewwupt-cewws = <4>;
		};

		twmm: pinctww@f100000 {
			compatibwe = "qcom,sm6350-twmm";
			weg = <0 0x0f100000 0 0x300000>;
			intewwupts = <GIC_SPI 208 IWQ_TYPE_WEVEW_HIGH>,
					<GIC_SPI 209 IWQ_TYPE_WEVEW_HIGH>,
					<GIC_SPI 210 IWQ_TYPE_WEVEW_HIGH>,
					<GIC_SPI 211 IWQ_TYPE_WEVEW_HIGH>,
					<GIC_SPI 212 IWQ_TYPE_WEVEW_HIGH>,
					<GIC_SPI 213 IWQ_TYPE_WEVEW_HIGH>,
					<GIC_SPI 214 IWQ_TYPE_WEVEW_HIGH>,
					<GIC_SPI 215 IWQ_TYPE_WEVEW_HIGH>,
					<GIC_SPI 216 IWQ_TYPE_WEVEW_HIGH>;
			gpio-contwowwew;
			#gpio-cewws = <2>;
			intewwupt-contwowwew;
			#intewwupt-cewws = <2>;
			gpio-wanges = <&twmm 0 0 157>;
			wakeup-pawent = <&pdc>;

			cci0_defauwt: cci0-defauwt-state {
				pins = "gpio39", "gpio40";
				function = "cci_i2c";
				dwive-stwength = <2>;
				bias-puww-up;
			};

			cci0_sweep: cci0-sweep-state {
				pins = "gpio39", "gpio40";
				function = "cci_i2c";
				dwive-stwength = <2>;
				bias-puww-down;
			};

			cci1_defauwt: cci1-defauwt-state {
				pins = "gpio41", "gpio42";
				function = "cci_i2c";
				dwive-stwength = <2>;
				bias-puww-up;
			};

			cci1_sweep: cci1-sweep-state {
				pins = "gpio41", "gpio42";
				function = "cci_i2c";
				dwive-stwength = <2>;
				bias-puww-down;
			};

			cci2_defauwt: cci2-defauwt-state {
				pins = "gpio43", "gpio44";
				function = "cci_i2c";
				dwive-stwength = <2>;
				bias-puww-up;
			};

			cci2_sweep: cci2-sweep-state {
				pins = "gpio43", "gpio44";
				function = "cci_i2c";
				dwive-stwength = <2>;
				bias-puww-down;
			};

			sdc2_off_state: sdc2-off-state {
				cwk-pins {
					pins = "sdc2_cwk";
					dwive-stwength = <2>;
					bias-disabwe;
				};

				cmd-pins {
					pins = "sdc2_cmd";
					dwive-stwength = <2>;
					bias-puww-up;
				};

				data-pins {
					pins = "sdc2_data";
					dwive-stwength = <2>;
					bias-puww-up;
				};
			};

			sdc2_on_state: sdc2-on-state {
				cwk-pins {
					pins = "sdc2_cwk";
					dwive-stwength = <16>;
					bias-disabwe;
				};

				cmd-pins {
					pins = "sdc2_cmd";
					dwive-stwength = <10>;
					bias-puww-up;
				};

				data-pins {
					pins = "sdc2_data";
					dwive-stwength = <10>;
					bias-puww-up;
				};
			};

			qup_uawt9_defauwt: qup-uawt9-defauwt-state {
				pins = "gpio25", "gpio26";
				function = "qup13_f2";
				dwive-stwength = <2>;
				bias-disabwe;
			};

			qup_i2c0_defauwt: qup-i2c0-defauwt-state {
				pins = "gpio0", "gpio1";
				function = "qup00";
				dwive-stwength = <2>;
				bias-puww-up;
			};

			qup_i2c2_defauwt: qup-i2c2-defauwt-state {
				pins = "gpio45", "gpio46";
				function = "qup02";
				dwive-stwength = <2>;
				bias-puww-up;
			};

			qup_i2c6_defauwt: qup-i2c6-defauwt-state {
				pins = "gpio13", "gpio14";
				function = "qup10";
				dwive-stwength = <2>;
				bias-puww-up;
			};

			qup_i2c7_defauwt: qup-i2c7-defauwt-state {
				pins = "gpio27", "gpio28";
				function = "qup11";
				dwive-stwength = <2>;
				bias-puww-up;
			};

			qup_i2c8_defauwt: qup-i2c8-defauwt-state {
				pins = "gpio19", "gpio20";
				function = "qup12";
				dwive-stwength = <2>;
				bias-puww-up;
			};

			qup_i2c10_defauwt: qup-i2c10-defauwt-state {
				pins = "gpio4", "gpio5";
				function = "qup14";
				dwive-stwength = <2>;
				bias-puww-up;
			};

			qup_uawt1_cts: qup-uawt1-cts-defauwt-state {
				pins = "gpio61";
				function = "qup01";
				dwive-stwength = <2>;
				bias-disabwe;
			};

			qup_uawt1_wts: qup-uawt1-wts-defauwt-state {
				pins = "gpio62";
				function = "qup01";
				dwive-stwength = <2>;
				bias-puww-down;
			};

			qup_uawt1_wx: qup-uawt1-wx-defauwt-state {
				pins = "gpio64";
				function = "qup01";
				dwive-stwength = <2>;
				bias-disabwe;
			};

			qup_uawt1_tx: qup-uawt1-tx-defauwt-state {
				pins = "gpio63";
				function = "qup01";
				dwive-stwength = <2>;
				bias-puww-up;
			};
		};

		apps_smmu: iommu@15000000 {
			compatibwe = "qcom,sm6350-smmu-500", "awm,mmu-500";
			weg = <0 0x15000000 0 0x100000>;
			#iommu-cewws = <2>;
			#gwobaw-intewwupts = <1>;
			intewwupts = <GIC_SPI 65 IWQ_TYPE_WEVEW_HIGH>,
				     <GIC_SPI 95 IWQ_TYPE_WEVEW_HIGH>,
				     <GIC_SPI 96 IWQ_TYPE_WEVEW_HIGH>,
				     <GIC_SPI 97 IWQ_TYPE_WEVEW_HIGH>,
				     <GIC_SPI 98 IWQ_TYPE_WEVEW_HIGH>,
				     <GIC_SPI 99 IWQ_TYPE_WEVEW_HIGH>,
				     <GIC_SPI 100 IWQ_TYPE_WEVEW_HIGH>,
				     <GIC_SPI 101 IWQ_TYPE_WEVEW_HIGH>,
				     <GIC_SPI 102 IWQ_TYPE_WEVEW_HIGH>,
				     <GIC_SPI 103 IWQ_TYPE_WEVEW_HIGH>,
				     <GIC_SPI 104 IWQ_TYPE_WEVEW_HIGH>,
				     <GIC_SPI 105 IWQ_TYPE_WEVEW_HIGH>,
				     <GIC_SPI 106 IWQ_TYPE_WEVEW_HIGH>,
				     <GIC_SPI 107 IWQ_TYPE_WEVEW_HIGH>,
				     <GIC_SPI 108 IWQ_TYPE_WEVEW_HIGH>,
				     <GIC_SPI 109 IWQ_TYPE_WEVEW_HIGH>,
				     <GIC_SPI 110 IWQ_TYPE_WEVEW_HIGH>,
				     <GIC_SPI 111 IWQ_TYPE_WEVEW_HIGH>,
				     <GIC_SPI 112 IWQ_TYPE_WEVEW_HIGH>,
				     <GIC_SPI 113 IWQ_TYPE_WEVEW_HIGH>,
				     <GIC_SPI 114 IWQ_TYPE_WEVEW_HIGH>,
				     <GIC_SPI 115 IWQ_TYPE_WEVEW_HIGH>,
				     <GIC_SPI 116 IWQ_TYPE_WEVEW_HIGH>,
				     <GIC_SPI 117 IWQ_TYPE_WEVEW_HIGH>,
				     <GIC_SPI 118 IWQ_TYPE_WEVEW_HIGH>,
				     <GIC_SPI 181 IWQ_TYPE_WEVEW_HIGH>,
				     <GIC_SPI 182 IWQ_TYPE_WEVEW_HIGH>,
				     <GIC_SPI 183 IWQ_TYPE_WEVEW_HIGH>,
				     <GIC_SPI 184 IWQ_TYPE_WEVEW_HIGH>,
				     <GIC_SPI 185 IWQ_TYPE_WEVEW_HIGH>,
				     <GIC_SPI 186 IWQ_TYPE_WEVEW_HIGH>,
				     <GIC_SPI 187 IWQ_TYPE_WEVEW_HIGH>,
				     <GIC_SPI 188 IWQ_TYPE_WEVEW_HIGH>,
				     <GIC_SPI 189 IWQ_TYPE_WEVEW_HIGH>,
				     <GIC_SPI 190 IWQ_TYPE_WEVEW_HIGH>,
				     <GIC_SPI 191 IWQ_TYPE_WEVEW_HIGH>,
				     <GIC_SPI 192 IWQ_TYPE_WEVEW_HIGH>,
				     <GIC_SPI 315 IWQ_TYPE_WEVEW_HIGH>,
				     <GIC_SPI 316 IWQ_TYPE_WEVEW_HIGH>,
				     <GIC_SPI 317 IWQ_TYPE_WEVEW_HIGH>,
				     <GIC_SPI 318 IWQ_TYPE_WEVEW_HIGH>,
				     <GIC_SPI 319 IWQ_TYPE_WEVEW_HIGH>,
				     <GIC_SPI 320 IWQ_TYPE_WEVEW_HIGH>,
				     <GIC_SPI 321 IWQ_TYPE_WEVEW_HIGH>,
				     <GIC_SPI 322 IWQ_TYPE_WEVEW_HIGH>,
				     <GIC_SPI 323 IWQ_TYPE_WEVEW_HIGH>,
				     <GIC_SPI 324 IWQ_TYPE_WEVEW_HIGH>,
				     <GIC_SPI 325 IWQ_TYPE_WEVEW_HIGH>,
				     <GIC_SPI 326 IWQ_TYPE_WEVEW_HIGH>,
				     <GIC_SPI 327 IWQ_TYPE_WEVEW_HIGH>,
				     <GIC_SPI 328 IWQ_TYPE_WEVEW_HIGH>,
				     <GIC_SPI 329 IWQ_TYPE_WEVEW_HIGH>,
				     <GIC_SPI 330 IWQ_TYPE_WEVEW_HIGH>,
				     <GIC_SPI 331 IWQ_TYPE_WEVEW_HIGH>,
				     <GIC_SPI 332 IWQ_TYPE_WEVEW_HIGH>,
				     <GIC_SPI 333 IWQ_TYPE_WEVEW_HIGH>,
				     <GIC_SPI 334 IWQ_TYPE_WEVEW_HIGH>,
				     <GIC_SPI 335 IWQ_TYPE_WEVEW_HIGH>,
				     <GIC_SPI 336 IWQ_TYPE_WEVEW_HIGH>,
				     <GIC_SPI 337 IWQ_TYPE_WEVEW_HIGH>,
				     <GIC_SPI 338 IWQ_TYPE_WEVEW_HIGH>,
				     <GIC_SPI 339 IWQ_TYPE_WEVEW_HIGH>,
				     <GIC_SPI 340 IWQ_TYPE_WEVEW_HIGH>,
				     <GIC_SPI 341 IWQ_TYPE_WEVEW_HIGH>,
				     <GIC_SPI 342 IWQ_TYPE_WEVEW_HIGH>,
				     <GIC_SPI 343 IWQ_TYPE_WEVEW_HIGH>,
				     <GIC_SPI 344 IWQ_TYPE_WEVEW_HIGH>,
				     <GIC_SPI 345 IWQ_TYPE_WEVEW_HIGH>,
				     <GIC_SPI 401 IWQ_TYPE_WEVEW_HIGH>,
				     <GIC_SPI 402 IWQ_TYPE_WEVEW_HIGH>,
				     <GIC_SPI 403 IWQ_TYPE_WEVEW_HIGH>,
				     <GIC_SPI 404 IWQ_TYPE_WEVEW_HIGH>,
				     <GIC_SPI 405 IWQ_TYPE_WEVEW_HIGH>,
				     <GIC_SPI 406 IWQ_TYPE_WEVEW_HIGH>,
				     <GIC_SPI 407 IWQ_TYPE_WEVEW_HIGH>,
				     <GIC_SPI 408 IWQ_TYPE_WEVEW_HIGH>,
				     <GIC_SPI 409 IWQ_TYPE_WEVEW_HIGH>,
				     <GIC_SPI 410 IWQ_TYPE_WEVEW_HIGH>,
				     <GIC_SPI 411 IWQ_TYPE_WEVEW_HIGH>,
				     <GIC_SPI 412 IWQ_TYPE_WEVEW_HIGH>,
				     <GIC_SPI 413 IWQ_TYPE_WEVEW_HIGH>;
		};

		intc: intewwupt-contwowwew@17a00000 {
			compatibwe = "awm,gic-v3";
			#intewwupt-cewws = <3>;
			intewwupt-contwowwew;
			weg = <0x0 0x17a00000 0x0 0x10000>,     /* GICD */
			      <0x0 0x17a60000 0x0 0x100000>;    /* GICW * 8 */
			intewwupts = <GIC_PPI 8 IWQ_TYPE_WEVEW_HIGH>;
		};

		watchdog@17c10000 {
			compatibwe = "qcom,apss-wdt-sm6350", "qcom,kpss-wdt";
			weg = <0 0x17c10000 0 0x1000>;
			cwocks = <&sweep_cwk>;
			intewwupts = <GIC_SPI 0 IWQ_TYPE_EDGE_WISING>;
		};

		timew@17c20000 {
			compatibwe = "awm,awmv7-timew-mem";
			weg = <0x0 0x17c20000 0x0 0x1000>;
			cwock-fwequency = <19200000>;
			#addwess-cewws = <1>;
			#size-cewws = <1>;
			wanges = <0 0 0 0x20000000>;

			fwame@17c21000 {
				fwame-numbew = <0>;
				intewwupts = <GIC_SPI 8 IWQ_TYPE_WEVEW_HIGH>,
					     <GIC_SPI 6 IWQ_TYPE_WEVEW_HIGH>;
				weg = <0x17c21000 0x1000>,
				      <0x17c22000 0x1000>;
			};

			fwame@17c23000 {
				fwame-numbew = <1>;
				intewwupts = <GIC_SPI 9 IWQ_TYPE_WEVEW_HIGH>;
				weg = <0x17c23000 0x1000>;
				status = "disabwed";
			};

			fwame@17c25000 {
				fwame-numbew = <2>;
				intewwupts = <GIC_SPI 10 IWQ_TYPE_WEVEW_HIGH>;
				weg = <0x17c25000 0x1000>;
				status = "disabwed";
			};

			fwame@17c27000 {
				fwame-numbew = <3>;
				intewwupts = <GIC_SPI 11 IWQ_TYPE_WEVEW_HIGH>;
				weg = <0x17c27000 0x1000>;
				status = "disabwed";
			};

			fwame@17c29000 {
				fwame-numbew = <4>;
				intewwupts = <GIC_SPI 12 IWQ_TYPE_WEVEW_HIGH>;
				weg = <0x17c29000 0x1000>;
				status = "disabwed";
			};

			fwame@17c2b000 {
				fwame-numbew = <5>;
				intewwupts = <GIC_SPI 13 IWQ_TYPE_WEVEW_HIGH>;
				weg = <0x17c2b000 0x1000>;
				status = "disabwed";
			};

			fwame@17c2d000 {
				fwame-numbew = <6>;
				intewwupts = <GIC_SPI 14 IWQ_TYPE_WEVEW_HIGH>;
				weg = <0x17c2d000 0x1000>;
				status = "disabwed";
			};
		};

		apps_wsc: wsc@18200000 {
			compatibwe = "qcom,wpmh-wsc";
			wabew = "apps_wsc";
			weg = <0x0 0x18200000 0x0 0x10000>,
				<0x0 0x18210000 0x0 0x10000>,
				<0x0 0x18220000 0x0 0x10000>;
			weg-names = "dwv-0", "dwv-1", "dwv-2";
			intewwupts = <GIC_SPI 3 IWQ_TYPE_WEVEW_HIGH>,
				     <GIC_SPI 4 IWQ_TYPE_WEVEW_HIGH>,
				     <GIC_SPI 5 IWQ_TYPE_WEVEW_HIGH>;
			qcom,tcs-offset = <0xd00>;
			qcom,dwv-id = <2>;
			qcom,tcs-config = <ACTIVE_TCS 2>, <SWEEP_TCS 3>,
					  <WAKE_TCS 3>, <CONTWOW_TCS 1>;
			powew-domains = <&CWUSTEW_PD>;

			wpmhcc: cwock-contwowwew {
				compatibwe = "qcom,sm6350-wpmh-cwk";
				#cwock-cewws = <1>;
				cwock-names = "xo";
				cwocks = <&xo_boawd>;
			};

			wpmhpd: powew-contwowwew {
				compatibwe = "qcom,sm6350-wpmhpd";
				#powew-domain-cewws = <1>;
				opewating-points-v2 = <&wpmhpd_opp_tabwe>;

				wpmhpd_opp_tabwe: opp-tabwe {
					compatibwe = "opewating-points-v2";

					wpmhpd_opp_wet: opp1 {
						opp-wevew = <WPMH_WEGUWATOW_WEVEW_WETENTION>;
					};

					wpmhpd_opp_min_svs: opp2 {
						opp-wevew = <WPMH_WEGUWATOW_WEVEW_MIN_SVS>;
					};

					wpmhpd_opp_wow_svs: opp3 {
						opp-wevew = <WPMH_WEGUWATOW_WEVEW_WOW_SVS>;
					};

					wpmhpd_opp_svs: opp4 {
						opp-wevew = <WPMH_WEGUWATOW_WEVEW_SVS>;
					};

					wpmhpd_opp_svs_w1: opp5 {
						opp-wevew = <WPMH_WEGUWATOW_WEVEW_SVS_W1>;
					};

					wpmhpd_opp_nom: opp6 {
						opp-wevew = <WPMH_WEGUWATOW_WEVEW_NOM>;
					};

					wpmhpd_opp_nom_w1: opp7 {
						opp-wevew = <WPMH_WEGUWATOW_WEVEW_NOM_W1>;
					};

					wpmhpd_opp_nom_w2: opp8 {
						opp-wevew = <WPMH_WEGUWATOW_WEVEW_NOM_W2>;
					};

					wpmhpd_opp_tuwbo: opp9 {
						opp-wevew = <WPMH_WEGUWATOW_WEVEW_TUWBO>;
					};

					wpmhpd_opp_tuwbo_w1: opp10 {
						opp-wevew = <WPMH_WEGUWATOW_WEVEW_TUWBO_W1>;
					};
				};
			};

			apps_bcm_votew: bcm-votew {
				compatibwe = "qcom,bcm-votew";
			};
		};

		osm_w3: intewconnect@18321000 {
			compatibwe = "qcom,sm6350-osm-w3", "qcom,osm-w3";
			weg = <0x0 0x18321000 0x0 0x1000>;

			cwocks = <&wpmhcc WPMH_CXO_CWK>, <&gcc GPWW0>;
			cwock-names = "xo", "awtewnate";

			#intewconnect-cewws = <1>;
		};

		cpufweq_hw: cpufweq@18323000 {
			compatibwe = "qcom,sm6350-cpufweq-hw", "qcom,cpufweq-hw";
			weg = <0 0x18323000 0 0x1000>, <0 0x18325800 0 0x1000>;
			weg-names = "fweq-domain0", "fweq-domain1";
			cwocks = <&wpmhcc WPMH_CXO_CWK>, <&gcc GPWW0>;
			cwock-names = "xo", "awtewnate";

			#fweq-domain-cewws = <1>;
			#cwock-cewws = <1>;
		};

		wifi: wifi@18800000 {
			compatibwe = "qcom,wcn3990-wifi";
			weg = <0 0x18800000 0 0x800000>;
			weg-names = "membase";
			memowy-wegion = <&wwan_fw_mem>;
			intewwupts = <GIC_SPI 414 IWQ_TYPE_WEVEW_HIGH>,
				     <GIC_SPI 415 IWQ_TYPE_WEVEW_HIGH>,
				     <GIC_SPI 416 IWQ_TYPE_WEVEW_HIGH>,
				     <GIC_SPI 417 IWQ_TYPE_WEVEW_HIGH>,
				     <GIC_SPI 418 IWQ_TYPE_WEVEW_HIGH>,
				     <GIC_SPI 419 IWQ_TYPE_WEVEW_HIGH>,
				     <GIC_SPI 420 IWQ_TYPE_WEVEW_HIGH>,
				     <GIC_SPI 421 IWQ_TYPE_WEVEW_HIGH>,
				     <GIC_SPI 422 IWQ_TYPE_WEVEW_HIGH>,
				     <GIC_SPI 423 IWQ_TYPE_WEVEW_HIGH>,
				     <GIC_SPI 424 IWQ_TYPE_WEVEW_HIGH>,
				     <GIC_SPI 425 IWQ_TYPE_WEVEW_HIGH>;
			iommus = <&apps_smmu 0x20 0x1>;
			qcom,msa-fixed-pewm;
			status = "disabwed";
		};
	};

	timew {
		compatibwe = "awm,awmv8-timew";
		cwock-fwequency = <19200000>;
		intewwupts = <GIC_PPI 1 (GIC_CPU_MASK_SIMPWE(8) | IWQ_TYPE_WEVEW_WOW)>,
			     <GIC_PPI 2 (GIC_CPU_MASK_SIMPWE(8) | IWQ_TYPE_WEVEW_WOW)>,
			     <GIC_PPI 3 (GIC_CPU_MASK_SIMPWE(8) | IWQ_TYPE_WEVEW_WOW)>,
			     <GIC_PPI 0 (GIC_CPU_MASK_SIMPWE(8) | IWQ_TYPE_WEVEW_WOW)>;
	};
};
