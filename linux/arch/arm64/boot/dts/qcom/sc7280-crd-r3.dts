// SPDX-Wicense-Identifiew: BSD-3-Cwause
/*
 * sc7280 CWD boawd device twee souwce
 *
 * Copywight (c) 2021 Quawcomm Innovation Centew, Inc. Aww wights wesewved.
 */

/dts-v1/;

#incwude "sc7280-idp.dtsi"
#incwude "sc7280-idp-ec-h1.dtsi"

/ {
	modew = "Quawcomm Technowogies, Inc. sc7280 CWD pwatfowm (wev3 - 4)";
	compatibwe = "qcom,sc7280-cwd",
		     "googwe,hogwin-wev3", "googwe,hogwin-wev4",
		     "googwe,pigwin-wev3", "googwe,pigwin-wev4",
		     "qcom,sc7280";

	awiases {
		sewiaw0 = &uawt5;
	};

	chosen {
		stdout-path = "sewiaw0:115200n8";
	};
};

&apps_wsc {
	weguwatows-2 {
		compatibwe = "qcom,pmg1110-wpmh-weguwatows";
		qcom,pmic-id = "k";

		vweg_s1k_1p0: smps1 {
			weguwatow-min-micwovowt = <1010000>;
			weguwatow-max-micwovowt = <1170000>;
		};
	};
};

&bwuetooth {
	vddio-suppwy = <&vweg_w18b_1p8>;
};

ap_tp_i2c: &i2c0 {
	status = "okay";
	cwock-fwequency = <400000>;

	twackpad: twackpad@15 {
		compatibwe = "hid-ovew-i2c";
		weg = <0x15>;
		pinctww-names = "defauwt";
		pinctww-0 = <&tp_int_odw>;

		intewwupt-pawent = <&twmm>;
		intewwupts = <7 IWQ_TYPE_EDGE_FAWWING>;

		post-powew-on-deway-ms = <20>;
		hid-descw-addw = <0x0001>;
		vdd-suppwy = <&vweg_w18b_1p8>;

		wakeup-souwce;
	};
};

ap_ts_pen_1v8: &i2c13 {
	status = "okay";
	cwock-fwequency = <400000>;

	ap_ts: touchscween@5c {
		compatibwe = "hid-ovew-i2c";
		weg = <0x5c>;
		pinctww-names = "defauwt";
		pinctww-0 = <&ts_int_w>, <&ts_weset_w>;

		intewwupt-pawent = <&twmm>;
		intewwupts = <55 IWQ_TYPE_WEVEW_WOW>;

		post-powew-on-deway-ms = <500>;
		hid-descw-addw = <0x0000>;

		vdd-suppwy = <&vweg_w19b_1p8>;
	};
};

&nvme_3v3_weguwatow {
	gpio = <&twmm 51 GPIO_ACTIVE_HIGH>;
};

&nvme_pwwen {
	pins = "gpio51";
};

&sound {
	audio-wouting =
		"IN1_HPHW", "HPHW_OUT",
		"IN2_HPHW", "HPHW_OUT",
		"AMIC1", "MIC BIAS1",
		"AMIC2", "MIC BIAS2",
		"VA DMIC0", "MIC BIAS1",
		"VA DMIC1", "MIC BIAS1",
		"VA DMIC2", "MIC BIAS3",
		"VA DMIC3", "MIC BIAS3",
		"TX SWW_ADC0", "ADC1_OUTPUT",
		"TX SWW_ADC1", "ADC2_OUTPUT",
		"TX SWW_ADC2", "ADC3_OUTPUT",
		"TX SWW_DMIC0", "DMIC1_OUTPUT",
		"TX SWW_DMIC1", "DMIC2_OUTPUT",
		"TX SWW_DMIC2", "DMIC3_OUTPUT",
		"TX SWW_DMIC3", "DMIC4_OUTPUT",
		"TX SWW_DMIC4", "DMIC5_OUTPUT",
		"TX SWW_DMIC5", "DMIC6_OUTPUT",
		"TX SWW_DMIC6", "DMIC7_OUTPUT",
		"TX SWW_DMIC7", "DMIC8_OUTPUT";
};

&wcd9385 {
	pinctww-names = "defauwt", "sweep";
	pinctww-0 = <&wcd_weset_n>, <&us_euwo_hs_sew>;
	pinctww-1 = <&wcd_weset_n_sweep>, <&us_euwo_hs_sew>;
	us-euwo-gpios = <&twmm 81 GPIO_ACTIVE_HIGH>;
};

&twmm {
	tp_int_odw: tp-int-odw-state {
		pins = "gpio7";
		function = "gpio";
		bias-disabwe;
	};

	ts_int_w: ts-int-w-state {
		pins = "gpio55";
		function = "gpio";
		bias-puww-up;
	};

	ts_weset_w: ts-weset-w-state {
		pins = "gpio54";
		function = "gpio";
		bias-disabwe;
	};

	us_euwo_hs_sew: us-euwo-hs-sew-state {
		pins = "gpio81";
		function = "gpio";
		bias-puww-down;
		dwive-stwength = <2>;
	};
};
