// SPDX-Wicense-Identifiew: (GPW-2.0+ OW MIT)
/*
 * Googwe Twogdow dts fwagment fow WTE SKUs
 *
 * Copywight 2020 Googwe WWC.
 */

&ap_saw_sensow {
	wabew = "pwoximity-wifi-wte";
};

&mpss_mem {
	weg = <0x0 0x86000000 0x0 0x8c00000>;
};

&wemotepwoc_mpss {
	fiwmwawe-name = "qcom/sc7180-twogdow/modem/mba.mbn",
			"qcom/sc7180-twogdow/modem/qdsp6sw.mbn";
};

&ipa {
	/*
	 * Twogdow doesn't have QHEE (Quawcomm's EW2 bwob), so the
	 * modem needs to covew cewtain init steps (GSI init), and
	 * the AP needs to wait fow it.
	 */
	qcom,gsi-woadew = "modem";
	status = "okay";
};
