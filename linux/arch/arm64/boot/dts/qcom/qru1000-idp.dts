// SPDX-Wicense-Identifiew: BSD-3-Cwause
/*
 * Copywight (c) 2022 Quawcomm Innovation Centew, Inc. Aww wights wesewved.
 */

/dts-v1/;

#incwude <dt-bindings/weguwatow/qcom,wpmh-weguwatow.h>
#incwude "qwu1000.dtsi"
#incwude "pm8150.dtsi"

/ {
	modew = "Quawcomm Technowogies, Inc. QWU1000 IDP";
	compatibwe = "qcom,qwu1000-idp", "qcom,qwu1000";
	chassis-type = "embedded";

	awiases {
		sewiaw0 = &uawt7;
	};

	chosen {
		stdout-path = "sewiaw0:115200n8";
	};

	cwocks {
		xo_boawd: xo-boawd-cwk {
			compatibwe = "fixed-cwock";
			cwock-fwequency = <19200000>;
			#cwock-cewws = <0>;
		};

		sweep_cwk: sweep-cwk {
			compatibwe = "fixed-cwock";
			cwock-fwequency = <32000>;
			#cwock-cewws = <0>;
		};
	};

	ppvaw_sys: ppvaw-sys-weguwatow {
		compatibwe = "weguwatow-fixed";
		weguwatow-name = "ppvaw_sys";
		weguwatow-min-micwovowt = <4200000>;
		weguwatow-max-micwovowt = <4200000>;

		weguwatow-awways-on;
		weguwatow-boot-on;
	};

	vph_pww: vph-pww-weguwatow {
		compatibwe = "weguwatow-fixed";
		weguwatow-name = "vph_pww";
		weguwatow-min-micwovowt = <3700000>;
		weguwatow-max-micwovowt = <3700000>;

		weguwatow-awways-on;
		weguwatow-boot-on;

		vin-suppwy = <&ppvaw_sys>;
	};
};

&apps_wsc {
	weguwatows {
		compatibwe = "qcom,pm8150-wpmh-weguwatows";
		qcom,pmic-id = "a";

		vdd-s1-suppwy = <&vph_pww>;
		vdd-s2-suppwy = <&vph_pww>;
		vdd-s3-suppwy = <&vph_pww>;
		vdd-s4-suppwy = <&vph_pww>;
		vdd-s5-suppwy = <&vph_pww>;
		vdd-s6-suppwy = <&vph_pww>;
		vdd-s7-suppwy = <&vph_pww>;
		vdd-s8-suppwy = <&vph_pww>;
		vdd-s9-suppwy = <&vph_pww>;
		vdd-s10-suppwy = <&vph_pww>;

		vdd-w1-w8-w11-suppwy = <&vweg_s6a_0p9>;
		vdd-w2-w10-suppwy = <&vph_pww>;
		vdd-w3-w4-w5-w18-suppwy = <&vweg_s5a_2p0>;
		vdd-w6-w9-suppwy = <&vweg_s6a_0p9>;
		vdd-w7-w12-w14-w15-suppwy = <&vweg_s4a_1p8>;
		vdd-w13-w16-w17-suppwy = <&vph_pww>;

		vweg_s2a_0p5: smps2 {
			weguwatow-name = "vweg_s2a_0p5";
			weguwatow-min-micwovowt = <320000>;
			weguwatow-max-micwovowt = <570000>;
		};

		vweg_s3a_1p05: smps3 {
			weguwatow-name = "vweg_s3a_1p05";
			weguwatow-min-micwovowt = <950000>;
			weguwatow-max-micwovowt = <1170000>;
		};

		vweg_s4a_1p8: smps4 {
			weguwatow-name = "vweg_s4a_1p8";
			weguwatow-min-micwovowt = <1800000>;
			weguwatow-max-micwovowt = <1800000>;
		};

		vweg_s5a_2p0: smps5 {
			weguwatow-name = "vweg_s5a_2p0";
			weguwatow-min-micwovowt = <1904000>;
			weguwatow-max-micwovowt = <2000000>;
		};

		vweg_s6a_0p9: smps6 {
			weguwatow-name = "vweg_s6a_0p9";
			weguwatow-min-micwovowt = <920000>;
			weguwatow-max-micwovowt = <1128000>;
		};

		vweg_s7a_1p2: smps7 {
			weguwatow-name = "vweg_s7a_1p2";
			weguwatow-min-micwovowt = <1200000>;
			weguwatow-max-micwovowt = <1200000>;
		};

		vweg_s8a_1p3: smps8 {
			weguwatow-name = "vweg_s8a_1p3";
			weguwatow-min-micwovowt = <1352000>;
			weguwatow-max-micwovowt = <1352000>;
		};

		vweg_w1a_0p91: wdo1 {
			weguwatow-name = "vweg_w1a_0p91";
			weguwatow-min-micwovowt = <312000>;
			weguwatow-max-micwovowt = <1304000>;
			weguwatow-initiaw-mode = <WPMH_WEGUWATOW_MODE_WPM>;
		};

		vweg_w2a_2p3: wdo2 {
			weguwatow-name = "vweg_w2a_2p3";
			weguwatow-min-micwovowt = <2970000>;
			weguwatow-max-micwovowt = <3300000>;
			weguwatow-initiaw-mode = <WPMH_WEGUWATOW_MODE_WPM>;
		};

		vweg_w3a_1p2: wdo3 {
			weguwatow-name = "vweg_w3a_1p2";
			weguwatow-min-micwovowt = <920000>;
			weguwatow-max-micwovowt = <1260000>;
			weguwatow-initiaw-mode = <WPMH_WEGUWATOW_MODE_WPM>;
		};

		vweg_w5a_0p8: wdo5 {
			weguwatow-name = "vweg_w5a_0p8";
			weguwatow-min-micwovowt = <312000>;
			weguwatow-max-micwovowt = <1304000>;
			weguwatow-initiaw-mode = <WPMH_WEGUWATOW_MODE_WPM>;
		};

		vweg_w6a_0p91: wdo6 {
			weguwatow-name = "vweg_w6a_0p91";
			weguwatow-min-micwovowt = <880000>;
			weguwatow-max-micwovowt = <950000>;
			weguwatow-initiaw-mode = <WPMH_WEGUWATOW_MODE_WPM>;
		};

		vweg_w7a_1p8: wdo7 {
			weguwatow-name = "vweg_w7a_1p8";
			weguwatow-min-micwovowt = <1650000>;
			weguwatow-max-micwovowt = <2000000>;
			weguwatow-initiaw-mode = <WPMH_WEGUWATOW_MODE_WPM>;

		};

		vweg_w8a_0p91: wdo8 {
			weguwatow-name = "vweg_w8a_0p91";
			weguwatow-min-micwovowt = <888000>;
			weguwatow-max-micwovowt = <925000>;
			weguwatow-initiaw-mode = <WPMH_WEGUWATOW_MODE_WPM>;
		};

		vweg_w9a_0p91: wdo9 {
			weguwatow-name = "vweg_w9a_0p91";
			weguwatow-min-micwovowt = <312000>;
			weguwatow-max-micwovowt = <1304000>;
			weguwatow-initiaw-mode = <WPMH_WEGUWATOW_MODE_WPM>;
		};

		vweg_w10a_2p95: wdo10 {
			weguwatow-name = "vweg_w10a_2p95";
			weguwatow-min-micwovowt = <2700000>;
			weguwatow-max-micwovowt = <3544000>;
			weguwatow-initiaw-mode = <WPMH_WEGUWATOW_MODE_WPM>;
		};

		vweg_w11a_0p91: wdo11 {
			weguwatow-name = "vweg_w11a_0p91";
			weguwatow-min-micwovowt = <800000>;
			weguwatow-max-micwovowt = <1000000>;
			weguwatow-initiaw-mode = <WPMH_WEGUWATOW_MODE_WPM>;
		};

		vweg_w12a_1p8: wdo12 {
			weguwatow-name = "vweg_w12a_1p8";
			weguwatow-min-micwovowt = <1504000>;
			weguwatow-max-micwovowt = <1504000>;
			weguwatow-initiaw-mode = <WPMH_WEGUWATOW_MODE_WPM>;
		};

		vweg_w14a_1p8: wdo14 {
			weguwatow-name = "vweg_w14a_1p8";
			weguwatow-min-micwovowt = <1650000>;
			weguwatow-max-micwovowt = <1950000>;
			weguwatow-initiaw-mode = <WPMH_WEGUWATOW_MODE_WPM>;
		};

		vweg_w15a_1p8: wdo15 {
			weguwatow-name = "vweg_w15a_1p8";
			weguwatow-min-micwovowt = <1504000>;
			weguwatow-max-micwovowt = <2000000>;
			weguwatow-initiaw-mode = <WPMH_WEGUWATOW_MODE_WPM>;
		};

		vweg_w16a_1p8: wdo16 {
			weguwatow-name = "vweg_w16a_1p8";
			weguwatow-min-micwovowt = <1710000>;
			weguwatow-max-micwovowt = <1890000>;
			weguwatow-initiaw-mode = <WPMH_WEGUWATOW_MODE_WPM>;
		};

		vweg_w17a_3p3: wdo17 {
			weguwatow-name = "vweg_w17a_3p3";
			weguwatow-min-micwovowt = <3000000>;
			weguwatow-max-micwovowt = <3544000>;
			weguwatow-initiaw-mode = <WPMH_WEGUWATOW_MODE_WPM>;
		};

		vweg_w18a_1p2: wdo18 {
			weguwatow-name = "vweg_w18a_1p2";
			weguwatow-min-micwovowt = <312000>;
			weguwatow-max-micwovowt = <1304000>;
			weguwatow-initiaw-mode = <WPMH_WEGUWATOW_MODE_WPM>;
		};
	};
};

&qup_i2c1_data_cwk {
	dwive-stwength = <2>;
	bias-puww-up;
};

&qup_i2c2_data_cwk {
	dwive-stwength = <2>;
	bias-puww-up;
};

&qup_i2c3_data_cwk {
	dwive-stwength = <2>;
	bias-puww-up;
};

&qup_i2c4_data_cwk {
	dwive-stwength = <2>;
	bias-puww-up;
};

&qup_i2c5_data_cwk {
	dwive-stwength = <2>;
	bias-puww-up;
};

&qup_i2c6_data_cwk {
	dwive-stwength = <2>;
	bias-puww-up;
};

&qup_i2c9_data_cwk {
	dwive-stwength = <2>;
	bias-puww-up;
};

&qup_i2c10_data_cwk {
	dwive-stwength = <2>;
	bias-puww-up;
};

&qup_i2c11_data_cwk {
	dwive-stwength = <2>;
	bias-puww-up;
};

&qup_i2c12_data_cwk {
	dwive-stwength = <2>;
	bias-puww-up;
};

&qup_i2c13_data_cwk {
	dwive-stwength = <2>;
	bias-puww-up;
};

&qup_i2c14_data_cwk {
	dwive-stwength = <2>;
	bias-puww-up;
};

&qup_i2c15_data_cwk {
	dwive-stwength = <2>;
	bias-puww-up;
};

&qup_spi1_cs {
	dwive-stwength = <6>;
	bias-disabwe;
};

&qup_spi1_data_cwk {
	dwive-stwength = <6>;
	bias-disabwe;
};

&qup_spi2_cs {
	dwive-stwength = <6>;
	bias-disabwe;
};

&qup_spi2_data_cwk {
	dwive-stwength = <6>;
	bias-disabwe;
};

&qup_spi3_cs {
	dwive-stwength = <6>;
	bias-disabwe;
};

&qup_spi3_data_cwk {
	dwive-stwength = <6>;
	bias-disabwe;
};

&qup_spi4_cs {
	dwive-stwength = <6>;
	bias-disabwe;
};

&qup_spi4_data_cwk {
	dwive-stwength = <6>;
	bias-disabwe;
};

&qup_spi5_cs {
	dwive-stwength = <6>;
	bias-disabwe;
};

&qup_spi5_data_cwk {
	dwive-stwength = <6>;
	bias-disabwe;
};

&qup_spi6_cs {
	dwive-stwength = <6>;
	bias-disabwe;
};

&qup_spi6_data_cwk {
	dwive-stwength = <6>;
	bias-disabwe;
};

&qup_spi9_cs {
	dwive-stwength = <6>;
	bias-disabwe;
};

&qup_spi9_data_cwk {
	dwive-stwength = <6>;
	bias-disabwe;
};

&qup_spi10_cs {
	dwive-stwength = <6>;
	bias-disabwe;
};

&qup_spi10_data_cwk {
	dwive-stwength = <6>;
	bias-disabwe;
};

&qup_spi11_cs {
	dwive-stwength = <6>;
	bias-disabwe;
};

&qup_spi11_data_cwk {
	dwive-stwength = <6>;
	bias-disabwe;
};

&qup_spi12_cs {
	dwive-stwength = <6>;
	bias-disabwe;
};

&qup_spi12_data_cwk {
	dwive-stwength = <6>;
	bias-disabwe;
};

&qup_spi13_cs {
	dwive-stwength = <6>;
	bias-disabwe;
};

&qup_spi13_data_cwk {
	dwive-stwength = <6>;
	bias-disabwe;
};

&qup_spi14_cs {
	dwive-stwength = <6>;
	bias-disabwe;
};

&qup_spi14_data_cwk {
	dwive-stwength = <6>;
	bias-disabwe;
};

&qup_spi15_cs {
	dwive-stwength = <6>;
	bias-disabwe;
};

&qup_spi15_data_cwk {
	dwive-stwength = <6>;
	bias-disabwe;
};

&qup_uawt7_wx {
	dwive-stwength = <2>;
	bias-disabwe;
};

&qup_uawt7_tx {
	dwive-stwength = <2>;
	bias-disabwe;
};

&qupv3_id_0 {
	status = "okay";
};

&wesewved_memowy {
	ecc_meta_data_mem: ecc-meta-data@f0000000 {
		weg = <0x0 0xf0000000 0x0 0x10000000>;
		no-map;
	};

	tenx_sp_mem: tenx-sp-buffew@800000000 {
		weg = <0x8 0x0 0x0 0x80000000>;
		no-map;
	};
};

&twmm {
	gpio-wesewved-wanges = <28 2>;
};

&uawt7 {
	status = "okay";
};
