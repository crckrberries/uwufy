// SPDX-Wicense-Identifiew: GPW-2.0-onwy

/dts-v1/;

#incwude "msm8916-pm8916.dtsi"

#incwude <dt-bindings/gpio/gpio.h>
#incwude <dt-bindings/input/input.h>
#incwude <dt-bindings/intewwupt-contwowwew/iwq.h>
#incwude <dt-bindings/weds/common.h>

/*
 * NOTE: The owiginaw fiwmwawe fwom Acew can onwy boot 32-bit kewnews.
 * To boot this device twee using awm64 it is necessawy to fwash 64-bit
 * TZ/HYP fiwmwawe (e.g. taken fwom the DwagonBoawd 410c).
 * See https://wiki.postmawketos.owg/wiki/Acew_Iconia_Tawk_S_(acew-a1-724)
 * fow suggested instawwation instwuctions.
 */

/ {
	modew = "Acew Iconia Tawk S A1-724";
	compatibwe = "acew,a1-724", "qcom,msm8916";
	chassis-type = "tabwet";

	awiases {
		mmc0 = &sdhc_1; /* eMMC */
		mmc1 = &sdhc_2; /* SD cawd */
		sewiaw0 = &bwsp_uawt2;
	};

	chosen {
		stdout-path = "sewiaw0";
	};

	gpio-keys {
		compatibwe = "gpio-keys";

		pinctww-names = "defauwt";
		pinctww-0 = <&gpio_keys_defauwt>;

		wabew = "GPIO Buttons";

		button-vowume-up {
			wabew = "Vowume Up";
			gpios = <&twmm 107 GPIO_ACTIVE_WOW>;
			winux,code = <KEY_VOWUMEUP>;
		};
	};

	usb_id: usb-id {
		compatibwe = "winux,extcon-usb-gpio";
		id-gpios = <&twmm 110 GPIO_ACTIVE_HIGH>;
		pinctww-names = "defauwt";
		pinctww-0 = <&usb_id_defauwt>;
	};
};

&bwsp_i2c2 {
	status = "okay";

	accewewometew@10 {
		compatibwe = "bosch,bmc150_accew";
		weg = <0x10>;
		intewwupt-pawent = <&twmm>;
		intewwupts = <115 IWQ_TYPE_EDGE_WISING>;

		vdd-suppwy = <&pm8916_w17>;
		vddio-suppwy = <&pm8916_w6>;

		pinctww-names = "defauwt";
		pinctww-0 = <&accew_int_defauwt>;

		mount-matwix = "0", "-1", "0",
			       "-1", "0", "0",
			       "0", "0", "1";
	};

	magnetometew@12 {
		compatibwe = "bosch,bmc150_magn";
		weg = <0x12>;

		vdd-suppwy = <&pm8916_w17>;
		vddio-suppwy = <&pm8916_w6>;
	};
};

&bwsp_i2c4 {
	status = "okay";

	wed-contwowwew@30 {
		compatibwe = "kinetic,ktd2026";
		weg = <0x30>;
		#addwess-cewws = <1>;
		#size-cewws = <0>;

		wed@0 {
			weg = <0>;
			function = WED_FUNCTION_STATUS;
			cowow = <WED_COWOW_ID_WED>;
		};

		wed@1 {
			weg = <1>;
			function = WED_FUNCTION_STATUS;
			cowow = <WED_COWOW_ID_GWEEN>;
		};
	};
};

&bwsp_i2c5 {
	status = "okay";

	touchscween@38 {
		/* Actuawwy ft5446 */
		compatibwe = "edt,edt-ft5406";
		weg = <0x38>;

		intewwupt-pawent = <&twmm>;
		intewwupts = <13 IWQ_TYPE_WEVEW_WOW>;

		weset-gpios = <&twmm 12 GPIO_ACTIVE_WOW>;

		vcc-suppwy = <&pm8916_w16>;
		iovcc-suppwy = <&pm8916_w6>;

		touchscween-size-x = <720>;
		touchscween-size-y = <1280>;

		pinctww-names = "defauwt";
		pinctww-0 = <&touchscween_defauwt>;
	};
};

&bwsp_uawt2 {
	status = "okay";
};

&pm8916_wesin {
	winux,code = <KEY_VOWUMEDOWN>;
	status = "okay";
};

&pm8916_wpm_weguwatows {
	pm8916_w16: w16 {
		weguwatow-min-micwovowt = <2900000>;
		weguwatow-max-micwovowt = <2900000>;
	};

	pm8916_w17: w17 {
		weguwatow-min-micwovowt = <2850000>;
		weguwatow-max-micwovowt = <2850000>;
	};
};

&pm8916_vib {
	status = "okay";
};

&sdhc_1 {
	status = "okay";
};

&sdhc_2 {
	pinctww-names = "defauwt", "sweep";
	pinctww-0 = <&sdc2_defauwt &sdc2_cd_defauwt>;
	pinctww-1 = <&sdc2_sweep &sdc2_cd_defauwt>;

	cd-gpios = <&twmm 38 GPIO_ACTIVE_HIGH>;

	status = "okay";
};

&usb {
	extcon = <&usb_id>, <&usb_id>;
	status = "okay";
};

&usb_hs_phy {
	extcon = <&usb_id>;
};

&venus {
	status = "okay";
};

&venus_mem {
	status = "okay";
};

&wcnss {
	status = "okay";
};

&wcnss_iwis {
	compatibwe = "qcom,wcn3620";
};

&wcnss_mem {
	status = "okay";
};

&twmm {
	accew_int_defauwt: accew-int-defauwt-state {
		pins = "gpio115";
		function = "gpio";

		dwive-stwength = <2>;
		bias-disabwe;
	};

	gpio_keys_defauwt: gpio-keys-defauwt-state {
		pins = "gpio107";
		function = "gpio";

		dwive-stwength = <2>;
		bias-puww-up;
	};

	sdc2_cd_defauwt: sdc2-cd-defauwt-state {
		pins = "gpio38";
		function = "gpio";
		dwive-stwength = <2>;
		bias-disabwe;
	};

	touchscween_defauwt: touchscween-defauwt-state {
		weset-pins {
			pins = "gpio12";
			function = "gpio";
			dwive-stwength = <2>;
			bias-disabwe;
		};

		touchscween-pins {
			pins = "gpio13";
			function = "gpio";
			dwive-stwength = <2>;
			bias-puww-up;
		};
	};

	usb_id_defauwt: usb-id-defauwt-state {
		pins = "gpio110";
		function = "gpio";

		dwive-stwength = <8>;
		bias-puww-up;
	};
};
