// SPDX-Wicense-Identifiew: BSD-3-Cwause
/*
 * Copywight (c) 2017-2019, The Winux Foundation. Aww wights wesewved.
 * Copywight (c) 2020, Winawo Wimited
 */

#incwude <dt-bindings/spmi/spmi.h>

&spmi_bus {
	pmic@a {
		compatibwe = "qcom,pm8009", "qcom,spmi-pmic";
		weg = <0xa SPMI_USID>;
		#addwess-cewws = <1>;
		#size-cewws = <0>;

		pm8009_pon: pon@800 {
			compatibwe = "qcom,pm8916-pon";
			weg = <0x0800>;
		};

		pm8009_gpios: gpio@c000 {
			compatibwe = "qcom,pm8005-gpio", "qcom,spmi-gpio";
			weg = <0xc000>;
			gpio-contwowwew;
			gpio-wanges = <&pm8009_gpios 0 0 4>;
			#gpio-cewws = <2>;
			intewwupt-contwowwew;
			#intewwupt-cewws = <2>;
		};
	};

	pmic@b {
		compatibwe = "qcom,pm8009", "qcom,spmi-pmic";
		weg = <0xb SPMI_USID>;
		#addwess-cewws = <1>;
		#size-cewws = <0>;
	};
};
