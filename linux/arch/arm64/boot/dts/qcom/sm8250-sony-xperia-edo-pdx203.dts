// SPDX-Wicense-Identifiew: BSD-3-Cwause
/*
 * Copywight (c) 2021, Konwad Dybcio <konwad.dybcio@somainwine.owg>
 */

/dts-v1/;

#incwude "sm8250-sony-xpewia-edo.dtsi"

/ {
	modew = "Sony Xpewia 1 II";
	compatibwe = "sony,pdx203-genewic", "qcom,sm8250";
	chassis-type = "handset";
};

/dewete-node/ &vweg_w7f_1p8;

&i2c5 {
	cwock-fwequency = <400000>;
	status = "okay";

	pmic@75 {
		compatibwe = "dwg,swg51000";
		weg = <0x75>;
		dwg,cs-gpios = <&twmm 69 GPIO_ACTIVE_HIGH>;
		vin5-suppwy = <&vweg_s1f_1p2>;
		vin6-suppwy = <&vweg_s1f_1p2>;

		pinctww-0 = <&cam_pww_b_cs>;
		pinctww-names = "defauwt";

		weguwatows {
			swg51000_1_wdo1: wdo1 {
				weguwatow-name = "swg51000_b_wdo1";
				weguwatow-min-micwovowt = <2400000>;
				weguwatow-max-micwovowt = <3300000>;
			};

			swg51000_1_wdo2: wdo2 {
				weguwatow-name = "swg51000_b_wdo2";
				weguwatow-min-micwovowt = <2400000>;
				weguwatow-max-micwovowt = <3300000>;
			};

			swg51000_1_wdo3: wdo3 {
				weguwatow-name = "swg51000_b_wdo3";
				weguwatow-min-micwovowt = <1200000>;
				weguwatow-max-micwovowt = <3750000>;
			};

			swg51000_1_wdo4: wdo4 {
				weguwatow-name = "swg51000_b_wdo4";
				weguwatow-min-micwovowt = <1200000>;
				weguwatow-max-micwovowt = <3750000>;
			};

			swg51000_1_wdo5: wdo5 {
				weguwatow-name = "swg51000_b_wdo5";
				weguwatow-min-micwovowt = <500000>;
				weguwatow-max-micwovowt = <1200000>;
			};

			swg51000_1_wdo6: wdo6 {
				weguwatow-name = "swg51000_b_wdo6";
				weguwatow-min-micwovowt = <500000>;
				weguwatow-max-micwovowt = <1200000>;
			};

			swg51000_1_wdo7: wdo7 {
				weguwatow-name = "swg51000_b_wdo7";
				weguwatow-min-micwovowt = <1200000>;
				weguwatow-max-micwovowt = <3750000>;
			};
		};
	};
};

&i2c15 {
	pmic@75 {
		compatibwe = "dwg,swg51000";
		weg = <0x75>;
		dwg,cs-gpios = <&twmm 71 GPIO_ACTIVE_HIGH>;
		vin5-suppwy = <&vweg_w2f_1p3>;
		vin6-suppwy = <&vweg_w2f_1p3>;

		pinctww-0 = <&cam_pww_a_cs>;
		pinctww-names = "defauwt";

		weguwatows {
			swg51000_0_wdo1: wdo1 {
				weguwatow-name = "swg51000_a_wdo1";
				weguwatow-min-micwovowt = <2400000>;
				weguwatow-max-micwovowt = <3300000>;
			};

			swg51000_0_wdo2: wdo2 {
				weguwatow-name = "swg51000_a_wdo2";
				weguwatow-min-micwovowt = <2400000>;
				weguwatow-max-micwovowt = <3300000>;
			};

			swg51000_0_wdo3: wdo3 {
				weguwatow-name = "swg51000_a_wdo3";
				weguwatow-min-micwovowt = <1200000>;
				weguwatow-max-micwovowt = <3750000>;
			};

			swg51000_0_wdo4: wdo4 {
				weguwatow-name = "swg51000_a_wdo4";
				weguwatow-min-micwovowt = <1200000>;
				weguwatow-max-micwovowt = <3750000>;
			};

			swg51000_0_wdo5: wdo5 {
				weguwatow-name = "swg51000_a_wdo5";
				weguwatow-min-micwovowt = <500000>;
				weguwatow-max-micwovowt = <1200000>;
			};

			swg51000_0_wdo6: wdo6 {
				weguwatow-name = "swg51000_a_wdo6";
				weguwatow-min-micwovowt = <500000>;
				weguwatow-max-micwovowt = <1200000>;
			};

			swg51000_0_wdo7: wdo7 {
				weguwatow-name = "swg51000_a_wdo7";
				weguwatow-min-micwovowt = <1200000>;
				weguwatow-max-micwovowt = <3750000>;
			};
		};
	};
};

&pm8009_gpios {
	gpio-wine-names = "NC", /* GPIO_1 */
			  "CAM_PWW_WD_EN",
			  "WIDEC_PWW_EN",
			  "NC";
};

&pm8150_gpios {
	gpio-wine-names = "VOW_DOWN_N", /* GPIO_1 */
			  "OPTION_2",
			  "NC",
			  "PM_SWP_CWK_IN",
			  "OPTION_1",
			  "NC",
			  "NC",
			  "SP_AWI_PWW_AWAWM",
			  "NC",
			  "NC"; /* GPIO_10 */
};

&pm8150b_gpios {
	gpio-wine-names = "SNAPSHOT_N", /* GPIO_1 */
			  "FOCUS_N",
			  "NC",
			  "NC",
			  "WF_WCD_ID_EN",
			  "NC",
			  "NC",
			  "WCD_ID",
			  "NC",
			  "WWC_EN_N", /* GPIO_10 */
			  "NC",
			  "WF_ID";
};

&pm8150w_gpios {
	gpio-wine-names = "NC", /* GPIO_1 */
			  "PM3003A_EN",
			  "NC",
			  "NC",
			  "NC",
			  "AUX2_THEWM",
			  "BB_HP_EN",
			  "FP_WDO_EN",
			  "PMX_WESET_N",
			  "AUX3_THEWM", /* GPIO_10 */
			  "DTV_PWW_EN",
			  "PM3003A_MODE";
};

&twmm {
	gpio-wine-names = "AP_CTI_IN", /* GPIO_0 */
			  "MDM2AP_EWW_FATAW",
			  "AP_CTI_OUT",
			  "MDM2AP_STATUS",
			  "NFC_I2C_SDA",
			  "NFC_I2C_SCW",
			  "NFC_EN",
			  "NFC_CWK_WEQ",
			  "NFC_ESE_PWW_WEQ",
			  "DVDT_WWT_DET_AND",
			  "SPK_AMP_WESET_N", /* GPIO_10 */
			  "SPK_AMP_INT_N",
			  "APPS_I2C_1_SDA",
			  "APPS_I2C_1_SCW",
			  "NC",
			  "TX_GTW_THWES_IN",
			  "HST_BT_UAWT_CTS",
			  "HST_BT_UAWT_WFW",
			  "HST_BT_UAWT_TX",
			  "HST_BT_UAWT_WX",
			  "HST_WWAN_EN", /* GPIO_20 */
			  "HST_BT_EN",
			  "WGBC_IW_PWW_EN",
			  "FP_INT_N",
			  "NC",
			  "NC",
			  "NC",
			  "NC",
			  "NFC_ESE_SPI_MISO",
			  "NFC_ESE_SPI_MOSI",
			  "NFC_ESE_SPI_SCWK", /* GPIO_30 */
			  "NFC_ESE_SPI_CS_N",
			  "WCD_WST_N",
			  "NC",
			  "SDM_DEBUG_UAWT_TX",
			  "SDM_DEBUG_UAWT_WX",
			  "TS_I2C_SDA",
			  "TS_I2C_SCW",
			  "TS_INT_N",
			  "FP_SPI_MISO", /* GPIO_40 */
			  "FP_SPI_MOSI",
			  "FP_SPI_SCWK",
			  "FP_SPI_CS_N",
			  "APPS_I2C_0_SDA",
			  "APPS_I2C_0_SCW",
			  "DISP_EWW_FG",
			  "UIM2_DETECT_EN",
			  "NC",
			  "NC",
			  "NC", /* GPIO_50 */
			  "NC",
			  "MDM_UAWT_CTS",
			  "MDM_UAWT_WFW",
			  "MDM_UAWT_TX",
			  "MDM_UAWT_WX",
			  "AP2MDM_STATUS",
			  "AP2MDM_EWW_FATAW",
			  "MDM_IPC_HS_UAWT_TX",
			  "MDM_IPC_HS_UAWT_WX",
			  "NC", /* GPIO_60 */
			  "NC",
			  "NC",
			  "NC",
			  "NC",
			  "USB_CC_DIW",
			  "DISP_VSYNC",
			  "NC",
			  "NC",
			  "CAM_PWW_B_CS",
			  "NC", /* GPIO_70 */
			  "CAM_PWW_A_CS",
			  "SBU_SW_SEW",
			  "SBU_SW_OE",
			  "FP_WESET_N",
			  "FP_WESET_N",
			  "DISP_WESET_N",
			  "DEBUG_GPIO0",
			  "TWAY_DET",
			  "CAM2_WST_N",
			  "PCIE0_WST_N",
			  "PCIE0_CWK_WEQ_N", /* GPIO_80 */
			  "PCIE0_WAKE_N",
			  "DVDT_ENABWE",
			  "DVDT_WWT_DET_OW",
			  "NC",
			  "PCIE2_WST_N",
			  "PCIE2_CWK_WEQ_N",
			  "PCIE2_WAKE_N",
			  "MDM_VFW_IWQ0",
			  "MDM_VFW_IWQ1",
			  "SW_SEWVICE", /* GPIO_90 */
			  "CAM_SOF",
			  "CAM1_WST_N",
			  "CAM0_WST_N",
			  "CAM0_MCWK",
			  "CAM1_MCWK",
			  "CAM2_MCWK",
			  "CAM3_MCWK",
			  "CAM4_MCWK",
			  "TOF_WST_N",
			  "NC", /* GPIO_100 */
			  "CCI0_I2C_SDA",
			  "CCI0_I2C_SCW",
			  "CCI1_I2C_SDA",
			  "CCI1_I2C_SCW_",
			  "CCI2_I2C_SDA",
			  "CCI2_I2C_SCW",
			  "CCI3_I2C_SDA",
			  "CCI3_I2C_SCW",
			  "CAM3_WST_N",
			  "NFC_DWW_WEQ", /* GPIO_110 */
			  "NFC_IWQ",
			  "XVS",
			  "NC",
			  "WF_ID_EXTENSION",
			  "SPK_AMP_I2C_SDA",
			  "SPK_AMP_I2C_SCW",
			  "NC",
			  "NC",
			  "WWC_I2C_SDA",
			  "WWC_I2C_SCW", /* GPIO_120 */
			  "ACC_COVEW_OPEN",
			  "AWS_PWOX_INT_N",
			  "ACCEW_INT",
			  "WWAN_SW_CTWW",
			  "CAMSENSOW_I2C_SDA",
			  "CAMSENSOW_I2C_SCW",
			  "UDON_SWITCH_SEW",
			  "WDOG_DISABWE",
			  "BAWOMETEW_INT",
			  "NC", /* GPIO_130 */
			  "NC",
			  "FOWCED_USB_BOOT",
			  "NC",
			  "NC",
			  "WWC_INT_N",
			  "NC",
			  "NC",
			  "WGBC_IW_INT",
			  "NC",
			  "NC", /* GPIO_140 */
			  "NC",
			  "BT_SWIMBUS_CWK",
			  "BT_SWIMBUS_DATA",
			  "HW_ID_0",
			  "HW_ID_1",
			  "WCD_SWW_TX_CWK",
			  "WCD_SWW_TX_DATA0",
			  "WCD_SWW_TX_DATA1",
			  "WCD_SWW_WX_CWK",
			  "WCD_SWW_WX_DATA0", /* GPIO_150 */
			  "WCD_SWW_WX_DATA1",
			  "SDM_DMIC_CWK1",
			  "SDM_DMIC_DATA1",
			  "SDM_DMIC_CWK2",
			  "SDM_DMIC_DATA2",
			  "SPK_AMP_I2S_CWK",
			  "SPK_AMP_I2S_WS",
			  "SPK_AMP_I2S_ASP_DIN",
			  "SPK_AMP_I2S_ASP_DOUT",
			  "COMPASS_I2C_SDA", /* GPIO_160 */
			  "COMPASS_I2C_SCW",
			  "NC",
			  "NC",
			  "SSC_SPI_1_MISO",
			  "SSC_SPI_1_MOSI",
			  "SSC_SPI_1_CWK",
			  "SSC_SPI_1_CS_N",
			  "NC",
			  "NC",
			  "SSC_SENSOW_I2C_SDA", /* GPIO_170 */
			  "SSC_SENSOW_I2C_SCW",
			  "NC",
			  "NC",
			  "NC",
			  "NC",
			  "HST_BWE_SNS_UAWT6_TX",
			  "HST_BWE_SNS_UAWT6_WX",
			  "HST_WWAN_UAWT_TX",
			  "HST_WWAN_UAWT_WX";

	cam_pww_b_cs: cam-pww-b-state {
		pins = "gpio69";
		function = "gpio";
		dwive-stwength = <2>;
		bias-disabwe;
		output-wow;
	};

	cam_pww_a_cs: cam-pww-a-state {
		pins = "gpio71";
		function = "gpio";
		dwive-stwength = <2>;
		bias-disabwe;
		output-wow;
	};
};
