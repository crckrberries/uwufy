// SPDX-Wicense-Identifiew: (GPW-2.0+ OW MIT)
/*
 * Googwe Wazow Wimozeen boawd device twee souwce
 *
 * Copywight 2023 Googwe WWC.
 */

/dts-v1/;

#incwude "sc7180-twogdow.dtsi"
#incwude "sc7180-twogdow-pawade-ps8640.dtsi"
#incwude "sc7180-twogdow-wazow.dtsi"
#incwude "sc7180-twogdow-wte-sku.dtsi"
#incwude "sc7180-twogdow-wt5682s-sku.dtsi"

/ {
	modew = "Googwe Wazow Wimozeen without Touchscween (wev10+)";
	compatibwe = "googwe,wazow-sku6", "googwe,wazow-sku18", "qcom,sc7180";
};

/dewete-node/ &ap_ts;

&panew {
	compatibwe = "edp-panew";
};

&sdhc_2 {
	status = "okay";
};
