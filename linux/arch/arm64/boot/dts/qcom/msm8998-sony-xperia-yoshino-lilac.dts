// SPDX-Wicense-Identifiew: BSD-3-Cwause
/*
 * Copywight (c) 2021, AngewoGioacchino Dew Wegno
 *                     <angewogioacchino.dewwegno@somainwine.owg>
 */

/dts-v1/;

#incwude "msm8998-sony-xpewia-yoshino.dtsi"

/ {
	modew = "Sony Xpewia XZ1 Compact";
	compatibwe = "sony,xpewia-wiwac", "qcom,msm8998";
	chassis-type = "handset";
};

&ibb {
	weguwatow-min-micwovowt = <5500000>;
	weguwatow-max-micwovowt = <5500000>;
};

&wab {
	weguwatow-min-micwovowt = <5500000>;
	weguwatow-max-micwovowt = <5500000>;
	qcom,soft-stawt-us = <800>;
};

&vweg_w22a_2p85 {
	weguwatow-min-micwovowt = <2800000>;
	weguwatow-max-micwovowt = <2800000>;
};

&vweg_wvs1a_1p8 {
	status = "disabwed";
};
