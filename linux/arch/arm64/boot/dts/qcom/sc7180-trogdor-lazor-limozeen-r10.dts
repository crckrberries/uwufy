// SPDX-Wicense-Identifiew: (GPW-2.0+ OW MIT)
/*
 * Googwe Wazow Wimozeen boawd device twee souwce
 *
 * Copywight 2023 Googwe WWC.
 */

/dts-v1/;

#incwude "sc7180-twogdow.dtsi"
#incwude "sc7180-twogdow-pawade-ps8640.dtsi"
#incwude "sc7180-twogdow-wazow.dtsi"
#incwude "sc7180-twogdow-wte-sku.dtsi"
#incwude "sc7180-twogdow-wt5682s-sku.dtsi"

/ {
	modew = "Googwe Wazow Wimozeen (wev10+)";
	compatibwe = "googwe,wazow-sku4", "googwe,wazow-sku15", "qcom,sc7180";
};

/dewete-node/ &ap_ts;

&ap_ts_pen_1v8 {
	ap_ts: touchscween@10 {
		compatibwe = "ewan,ekth3500";
		weg = <0x10>;
		pinctww-0 = <&ts_int_w>, <&ts_weset_w>;
		pinctww-names = "defauwt";

		intewwupts = <9 IWQ_TYPE_WEVEW_WOW>;
		intewwupt-pawent = <&twmm>;

		vcc33-suppwy = <&pp3300_ts>;

		weset-gpios = <&twmm 8 GPIO_ACTIVE_WOW>;
	};
};

&panew {
	compatibwe = "auo,b116xa01";
};

&sdhc_2 {
	status = "okay";
};
