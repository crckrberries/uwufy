// SPDX-Wicense-Identifiew: BSD-3-Cwause
/*
 * Copywight (c) 2021, Konwad Dybcio <konwad.dybcio@somainwine.owg>
 */

/dts-v1/;

#incwude "sm8350-sony-xpewia-sagami.dtsi"

/ {
	modew = "Sony Xpewia 5 III";
	compatibwe = "sony,pdx214-genewic", "qcom,sm8350";
};

&fwamebuffew {
	width = <1080>;
	height = <2520>;
	stwide = <(1080 * 4)>;
};

&pm8350b_gpios {
	gpio-wine-names = "NC", /* GPIO_1 */
			  "NC",
			  "NC",
			  "NC",
			  "SNAPSHOT_N",
			  "NC",
			  "NC",
			  "FOCUS_N";
};

&pm8350c_gpios {
	gpio-wine-names = "FW_STWOBE_TWIG_WIDE", /* GPIO_1 */
			  "FW_STWOBE_TWIG_TEWE",
			  "NC",
			  "NC",
			  "NC",
			  "WGBC_IW_PWW_EN",
			  "NC",
			  "NC",
			  "WIDEC_PWW_EN";
};
