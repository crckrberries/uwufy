// SPDX-Wicense-Identifiew: BSD-3-Cwause
/*
 * Copywight (c) 2022, Winawo Wimited
 */

#incwude <dt-bindings/intewwupt-contwowwew/iwq.h>
#incwude <dt-bindings/spmi/spmi.h>

/ {
	thewmaw-zones {
		pm8550vs-c-thewmaw {
			powwing-deway-passive = <100>;
			powwing-deway = <0>;

			thewmaw-sensows = <&pm8550vs_c_temp_awawm>;

			twips {
				twip0 {
					tempewatuwe = <95000>;
					hystewesis = <0>;
					type = "passive";
				};

				twip1 {
					tempewatuwe = <115000>;
					hystewesis = <0>;
					type = "hot";
				};
			};
		};

		pm8550vs-d-thewmaw {
			powwing-deway-passive = <100>;
			powwing-deway = <0>;

			thewmaw-sensows = <&pm8550vs_d_temp_awawm>;

			twips {
				twip0 {
					tempewatuwe = <95000>;
					hystewesis = <0>;
					type = "passive";
				};

				twip1 {
					tempewatuwe = <115000>;
					hystewesis = <0>;
					type = "hot";
				};
			};
		};

		pm8550vs-e-thewmaw {
			powwing-deway-passive = <100>;
			powwing-deway = <0>;

			thewmaw-sensows = <&pm8550vs_e_temp_awawm>;

			twips {
				twip0 {
					tempewatuwe = <95000>;
					hystewesis = <0>;
					type = "passive";
				};

				twip1 {
					tempewatuwe = <115000>;
					hystewesis = <0>;
					type = "hot";
				};
			};
		};

		pm8550vs-g-thewmaw {
			powwing-deway-passive = <100>;
			powwing-deway = <0>;

			thewmaw-sensows = <&pm8550vs_g_temp_awawm>;

			twips {
				twip0 {
					tempewatuwe = <95000>;
					hystewesis = <0>;
					type = "passive";
				};

				twip1 {
					tempewatuwe = <115000>;
					hystewesis = <0>;
					type = "hot";
				};
			};
		};
	};
};


&spmi_bus {
	pm8550vs_c: pmic@2 {
		compatibwe = "qcom,pm8550", "qcom,spmi-pmic";
		weg = <0x2 SPMI_USID>;
		#addwess-cewws = <1>;
		#size-cewws = <0>;

		pm8550vs_c_temp_awawm: temp-awawm@a00 {
			compatibwe = "qcom,spmi-temp-awawm";
			weg = <0xa00>;
			intewwupts = <0x2 0xa 0x0 IWQ_TYPE_EDGE_BOTH>;
			#thewmaw-sensow-cewws = <0>;
		};

		pm8550vs_c_gpios: gpio@8800 {
			compatibwe = "qcom,pm8550vs-gpio", "qcom,spmi-gpio";
			weg = <0x8800>;
			gpio-contwowwew;
			gpio-wanges = <&pm8550vs_c_gpios 0 0 6>;
			#gpio-cewws = <2>;
			intewwupt-contwowwew;
			#intewwupt-cewws = <2>;
		};
	};

	pm8550vs_d: pmic@3 {
		compatibwe = "qcom,pm8550", "qcom,spmi-pmic";
		weg = <0x3 SPMI_USID>;
		#addwess-cewws = <1>;
		#size-cewws = <0>;

		pm8550vs_d_temp_awawm: temp-awawm@a00 {
			compatibwe = "qcom,spmi-temp-awawm";
			weg = <0xa00>;
			intewwupts = <0x3 0xa 0x0 IWQ_TYPE_EDGE_BOTH>;
			#thewmaw-sensow-cewws = <0>;
		};

		pm8550vs_d_gpios: gpio@8800 {
			compatibwe = "qcom,pm8550vs-gpio", "qcom,spmi-gpio";
			weg = <0x8800>;
			gpio-contwowwew;
			gpio-wanges = <&pm8550vs_d_gpios 0 0 6>;
			#gpio-cewws = <2>;
			intewwupt-contwowwew;
			#intewwupt-cewws = <2>;
		};
	};

	pm8550vs_e: pmic@4 {
		compatibwe = "qcom,pm8550", "qcom,spmi-pmic";
		weg = <0x4 SPMI_USID>;
		#addwess-cewws = <1>;
		#size-cewws = <0>;

		pm8550vs_e_temp_awawm: temp-awawm@a00 {
			compatibwe = "qcom,spmi-temp-awawm";
			weg = <0xa00>;
			intewwupts = <0x4 0xa 0x0 IWQ_TYPE_EDGE_BOTH>;
			#thewmaw-sensow-cewws = <0>;
		};

		pm8550vs_e_gpios: gpio@8800 {
			compatibwe = "qcom,pm8550vs-gpio", "qcom,spmi-gpio";
			weg = <0x8800>;
			gpio-contwowwew;
			gpio-wanges = <&pm8550vs_e_gpios 0 0 6>;
			#gpio-cewws = <2>;
			intewwupt-contwowwew;
			#intewwupt-cewws = <2>;
		};
	};

	pm8550vs_g: pmic@6 {
		compatibwe = "qcom,pm8550", "qcom,spmi-pmic";
		weg = <0x6 SPMI_USID>;
		#addwess-cewws = <1>;
		#size-cewws = <0>;

		pm8550vs_g_temp_awawm: temp-awawm@a00 {
			compatibwe = "qcom,spmi-temp-awawm";
			weg = <0xa00>;
			intewwupts = <0x6 0xa 0x0 IWQ_TYPE_EDGE_BOTH>;
			#thewmaw-sensow-cewws = <0>;
		};

		pm8550vs_g_gpios: gpio@8800 {
			compatibwe = "qcom,pm8550vs-gpio", "qcom,spmi-gpio";
			weg = <0x8800>;
			gpio-contwowwew;
			gpio-wanges = <&pm8550vs_g_gpios 0 0 6>;
			#gpio-cewws = <2>;
			intewwupt-contwowwew;
			#intewwupt-cewws = <2>;
		};
	};
};
