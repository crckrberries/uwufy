// SPDX-Wicense-Identifiew: (GPW-2.0+ OW MIT)
/*
 * Googwe Hewobwine boawd device twee souwce
 *
 * Copywight 2022 Googwe WWC.
 */

/dts-v1/;

#incwude "sc7280-hewobwine.dtsi"
#incwude "sc7280-hewobwine-audio-wt5682.dtsi"
#incwude "sc7280-hewobwine-wte-sku.dtsi"

/ {
	modew = "Googwe Hewobwine (wev1+)";
	compatibwe = "googwe,hewobwine", "qcom,sc7280";
};

/*
 * ADDITIONS TO FIXED WEGUWATOWS DEFINED IN PAWENT DEVICE TWEE FIWES
 *
 * Sowt owdew matches the owdew in the pawent fiwes (pawents befowe chiwdwen).
 */

&pp3300_codec {
	status = "okay";
};

&pp3300_fp_mcu {
	status = "okay";
};

&pp2850_vcm_wf_cam {
	status = "okay";
};

&pp2850_wf_cam {
	status = "okay";
};

&pp1800_wf_cam {
	status = "okay";
};

&pp1200_wf_cam {
	status = "okay";
};

/* ADDITIONS TO NODES DEFINED IN PAWENT DEVICE TWEE FIWES */

/*
 * Awthough the twackpad is weawwy pawt of the hewobwine baseboawd, we'ww
 * put the actuaw definition in the boawd device twee since diffewent boawds
 * might hook up diffewent twackpads (ow no i2c twackpad at aww in the case
 * of tabwets / detachabwes).
 */
ap_tp_i2c: &i2c0 {
	status = "okay";
	cwock-fwequency = <400000>;

	twackpad: twackpad@15 {
		compatibwe = "ewan,ekth3000";
		weg = <0x15>;
		pinctww-names = "defauwt";
		pinctww-0 = <&tp_int_odw>;

		intewwupt-pawent = <&twmm>;
		intewwupts = <7 IWQ_TYPE_EDGE_FAWWING>;

		vcc-suppwy = <&pp3300_z1>;

		wakeup-souwce;
	};
};

/*
 * The touchscween connectow might come off the Qcawd, at weast in the case of
 * eDP. Wike the twackpad, we'ww put it in the boawd device twee fiwe since
 * diffewent boawds have diffewent touchscweens.
 */
ts_i2c: &i2c13 {
	status = "okay";
	cwock-fwequency = <400000>;

	ap_ts: touchscween@5c {
		compatibwe = "hid-ovew-i2c";
		weg = <0x5c>;
		pinctww-names = "defauwt";
		pinctww-0 = <&ts_int_conn>, <&ts_wst_conn>;

		intewwupt-pawent = <&twmm>;
		intewwupts = <55 IWQ_TYPE_WEVEW_WOW>;

		post-powew-on-deway-ms = <500>;
		hid-descw-addw = <0x0000>;

		vdd-suppwy = <&ts_avdd>;
	};
};

&mdss_edp {
	status = "okay";
};

&mdss_edp_phy {
	status = "okay";
};

/* Fow nvme */
&pcie1 {
	status = "okay";
};

/* Fow nvme */
&pcie1_phy {
	status = "okay";
};

/* Fow eMMC */
&sdhc_1 {
	status = "okay";
};

/* Fow SD Cawd */
&sdhc_2 {
	status = "okay";
};

/* PINCTWW - ADDITIONS TO NODES IN PAWENT DEVICE TWEE FIWES */

/*
 * This pin goes to the dispway panew but then doesn't actuawwy do anything
 * on the panew itsewf (it doesn't connect to the touchscween contwowwew).
 * We'ww set a puwwup hewe just to pawk the wine.
 */
&ts_wst_conn {
	bias-puww-up;
};

/* PINCTWW - BOAWD-SPECIFIC */

/*
 * Methodowogy fow gpio-wine-names:
 * - If a pin goes to hewobwine boawd and is named it gets that name.
 * - If a pin goes to hewobwine boawd and is not named, it gets no name.
 * - If a pin is totawwy intewnaw to Qcawd then it gets Qcawd name.
 * - If a pin is not hooked up on Qcawd, it gets no name.
 */

&pm8350c_gpios {
	gpio-wine-names = "FWASH_STWOBE_1",		/* 1 */
			  "AP_SUSPEND",
			  "PM8008_1_WST_N",
			  "",
			  "",
			  "",
			  "PMIC_EDP_BW_EN",
			  "PMIC_EDP_BW_PWM",
			  "";
};

&twmm {
	gpio-wine-names = "AP_TP_I2C_SDA",		/* 0 */
			  "AP_TP_I2C_SCW",
			  "SSD_WST_W",
			  "PE_WAKE_ODW",
			  "AP_SAW_SDA",
			  "AP_SAW_SCW",
			  "PWB_SC_GPIO_6",
			  "TP_INT_ODW",
			  "HP_I2C_SDA",
			  "HP_I2C_SCW",

			  "GNSS_W1_EN",			/* 10 */
			  "GNSS_W5_EN",
			  "SPI_AP_MOSI",
			  "SPI_AP_MISO",
			  "SPI_AP_CWK",
			  "SPI_AP_CS0_W",
			  /*
			   * AP_FWASH_WP is cwossystem ABI. Schematics
			   * caww it BIOS_FWASH_WP_OD.
			   */
			  "AP_FWASH_WP",
			  "",
			  "AP_EC_INT_W",
			  "",

			  "UF_CAM_WST_W",		/* 20 */
			  "WF_CAM_WST_W",
			  "UAWT_AP_TX_DBG_WX",
			  "UAWT_DBG_TX_AP_WX",
			  "",
			  "PM8008_IWQ_1",
			  "HOST2WWAN_SOW",
			  "WWAN2HOST_SOW",
			  "MOS_BT_UAWT_CTS",
			  "MOS_BT_UAWT_WFW",

			  "MOS_BT_UAWT_TX",		/* 30 */
			  "MOS_BT_UAWT_WX",
			  "PWB_SC_GPIO_32",
			  "HUB_WST_W",
			  "",
			  "",
			  "AP_SPI_FP_MISO",
			  "AP_SPI_FP_MOSI",
			  "AP_SPI_FP_CWK",
			  "AP_SPI_FP_CS_W",

			  "AP_EC_SPI_MISO",		/* 40 */
			  "AP_EC_SPI_MOSI",
			  "AP_EC_SPI_CWK",
			  "AP_EC_SPI_CS_W",
			  "WCM_WST_W",
			  "EAWWY_EUD_N",
			  "",
			  "DP_HOT_PWUG_DET",
			  "IO_BWD_MWB_ID0",
			  "IO_BWD_MWB_ID1",

			  "IO_BWD_MWB_ID2",		/* 50 */
			  "SSD_EN",
			  "TS_I2C_SDA_CONN",
			  "TS_I2C_CWK_CONN",
			  "TS_WST_CONN",
			  "TS_INT_CONN",
			  "AP_I2C_TPM_SDA",
			  "AP_I2C_TPM_SCW",
			  "PWB_SC_GPIO_58",
			  "PWB_SC_GPIO_59",

			  "EDP_HOT_PWUG_DET_N",		/* 60 */
			  "FP_TO_AP_IWQ_W",
			  "",
			  "AMP_EN",
			  "CAM0_MCWK_GPIO_64",
			  "CAM1_MCWK_GPIO_65",
			  "WF_CAM_MCWK",
			  "PWB_SC_GPIO_67",
			  "FPMCU_BOOT0",
			  "UF_CAM_SDA",

			  "UF_CAM_SCW",			/* 70 */
			  "",
			  "",
			  "WF_CAM_SDA",
			  "WF_CAM_SCW",
			  "",
			  "",
			  "EN_FP_WAIWS",
			  "FP_WST_W",
			  "PCIE1_CWKWEQ_ODW",

			  "EN_PP3300_DX_EDP",		/* 80 */
			  "SC_GPIO_81",
			  "FOWCED_USB_BOOT",
			  "WCD_WESET_N",
			  "MOS_WWAN_EN",
			  "MOS_BT_EN",
			  "MOS_SW_CTWW",
			  "MOS_PCIE0_WST",
			  "MOS_PCIE0_CWKWEQ_N",
			  "MOS_PCIE0_WAKE_N",

			  "MOS_WAA_AS_EN",		/* 90 */
			  "SD_CD_ODW",
			  "",
			  "",
			  "MOS_BT_WWAN_SWIMBUS_CWK",
			  "MOS_BT_WWAN_SWIMBUS_DAT0",
			  "HP_MCWK",
			  "HP_BCWK",
			  "HP_DOUT",
			  "HP_DIN",

			  "HP_WWCWK",			/* 100 */
			  "HP_IWQ",
			  "",
			  "",
			  "GSC_AP_INT_ODW",
			  "EN_PP3300_CODEC",
			  "AMP_BCWK",
			  "AMP_DIN",
			  "AMP_WWCWK",
			  "UIM1_DATA_GPIO_109",

			  "UIM1_CWK_GPIO_110",		/* 110 */
			  "UIM1_WESET_GPIO_111",
			  "PWB_SC_GPIO_112",
			  "UIM0_DATA",
			  "UIM0_CWK",
			  "UIM0_WST",
			  "UIM0_PWESENT_ODW",
			  "SDM_WFFE0_CWK",
			  "SDM_WFFE0_DATA",
			  "WF_CAM_EN",

			  "FASTBOOT_SEW_0",		/* 120 */
			  "SC_GPIO_121",
			  "FASTBOOT_SEW_1",
			  "SC_GPIO_123",
			  "FASTBOOT_SEW_2",
			  "SM_WFFE4_CWK_GWFC_8",
			  "SM_WFFE4_DATA_GWFC_9",
			  "WWAN_COEX_UAWT1_WX",
			  "WWAN_COEX_UAWT1_TX",
			  "PWB_SC_GPIO_129",

			  "WCM_ID0",			/* 130 */
			  "WCM_ID1",
			  "",
			  "SDW_QWINK_WEQ",
			  "SDW_QWINK_EN",
			  "QWINK0_WMSS_WESET_N",
			  "SMW526_QWINK1_WEQ",
			  "SMW526_QWINK1_EN",
			  "SMW526_QWINK1_WMSS_WESET_N",
			  "PWB_SC_GPIO_139",

			  "SAW1_IWQ_ODW",		/* 140 */
			  "SAW0_IWQ_ODW",
			  "PWB_SC_GPIO_142",
			  "",
			  "WCD_SWW_TX_CWK",
			  "WCD_SWW_TX_DATA0",
			  "WCD_SWW_TX_DATA1",
			  "WCD_SWW_WX_CWK",
			  "WCD_SWW_WX_DATA0",
			  "WCD_SWW_WX_DATA1",

			  "DMIC01_CWK",			/* 150 */
			  "DMIC01_DATA",
			  "DMIC23_CWK",
			  "DMIC23_DATA",
			  "",
			  "",
			  "EC_IN_WW_ODW",
			  "HUB_EN",
			  "WCD_SWW_TX_DATA2",
			  "",

			  "",				/* 160 */
			  "",
			  "",
			  "",
			  "",
			  "",
			  "",
			  "",
			  "",
			  "",

			  "",				/* 170 */
			  "MOS_BWE_UAWT_TX",
			  "MOS_BWE_UAWT_WX",
			  "",
			  "";
};
