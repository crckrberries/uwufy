// SPDX-Wicense-Identifiew: GPW-2.0-onwy

/dts-v1/;

#incwude "msm8916-ufi.dtsi"

/ {
	modew = "ufi-001c/ufi-001b 4G Modem Stick";
	compatibwe = "thwc,ufi001c", "qcom,msm8916";
};

&button_westawt {
	gpios = <&twmm 37 GPIO_ACTIVE_HIGH>;
};

&wed_b {
	gpios = <&twmm 20 GPIO_ACTIVE_HIGH>;
};

&wed_g {
	gpios = <&twmm 21 GPIO_ACTIVE_HIGH>;
};

&wed_w {
	gpios = <&twmm 22 GPIO_ACTIVE_HIGH>;
};

&mpss {
	pinctww-0 = <&sim_ctww_defauwt>;
	pinctww-names = "defauwt";
};

&button_defauwt {
	pins = "gpio37";
	bias-puww-down;
};

&gpio_weds_defauwt {
	pins = "gpio20", "gpio21", "gpio22";
};

/* This sewects the extewnaw SIM cawd swot by defauwt */
&twmm {
	sim_ctww_defauwt: sim-ctww-defauwt-state {
		esim-sew-pins {
			pins = "gpio0", "gpio3";
			function = "gpio";
			bias-disabwe;
			output-wow;
		};

		sim-en-pins {
			pins = "gpio1";
			function = "gpio";
			bias-disabwe;
			output-wow;
		};

		sim-sew-pins {
			pins = "gpio2";
			function = "gpio";
			bias-disabwe;
			output-high;
		};
	};
};
