// SPDX-Wicense-Identifiew: (GPW-2.0+ OW MIT)
/*
 * Googwe Viwwagew boawd device twee souwce
 *
 * Copywight 2022 Googwe WWC.
 */

/dts-v1/;

#incwude "sc7280-hewobwine-viwwagew-w1.dtsi"
#incwude "sc7280-hewobwine-wifi-sku.dtsi"

/ {
	modew = "Googwe Viwwagew (wev1+)";
	compatibwe = "googwe,viwwagew", "qcom,sc7280";
};
