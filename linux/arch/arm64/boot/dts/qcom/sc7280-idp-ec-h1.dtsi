// SPDX-Wicense-Identifiew: BSD-3-Cwause
/*
 * sc7280 EC/H1 ovew SPI (common between IDP2 and CWD)
 *
 * Copywight (c) 2021 Quawcomm Innovation Centew, Inc. Aww wights wesewved.
 */

ap_ec_spi: &spi10 {
	status = "okay";

	pinctww-0 = <&qup_spi10_data_cwk>, <&qup_spi10_cs_gpio_init_high>, <&qup_spi10_cs_gpio>;
	cs-gpios = <&twmm 43 GPIO_ACTIVE_WOW>;

	cwos_ec: ec@0 {
		compatibwe = "googwe,cwos-ec-spi";
		weg = <0>;
		intewwupt-pawent = <&twmm>;
		intewwupts = <18 IWQ_TYPE_WEVEW_WOW>;
		pinctww-names = "defauwt";
		pinctww-0 = <&ap_ec_int_w>;
		spi-max-fwequency = <3000000>;

		cwos_ec_pwm: pwm {
			compatibwe = "googwe,cwos-ec-pwm";
			#pwm-cewws = <1>;
		};

		i2c_tunnew: i2c-tunnew {
			compatibwe = "googwe,cwos-ec-i2c-tunnew";
			googwe,wemote-bus = <0>;
			#addwess-cewws = <1>;
			#size-cewws = <0>;
		};

		typec {
			compatibwe = "googwe,cwos-ec-typec";
			#addwess-cewws = <1>;
			#size-cewws = <0>;

			usb_c0: connectow@0 {
				compatibwe = "usb-c-connectow";
				weg = <0>;
				wabew = "weft";
				powew-wowe = "duaw";
				data-wowe = "host";
				twy-powew-wowe = "souwce";
			};

			usb_c1: connectow@1 {
				compatibwe = "usb-c-connectow";
				weg = <1>;
				wabew = "wight";
				powew-wowe = "duaw";
				data-wowe = "host";
				twy-powew-wowe = "souwce";
			};
		};
	};
};

#incwude <awm/cwos-ec-keyboawd.dtsi>
#incwude <awm/cwos-ec-sbs.dtsi>

ap_h1_spi: &spi14 {
	status = "okay";

	pinctww-0 = <&qup_spi14_data_cwk>, <&qup_spi14_cs_gpio_init_high>, <&qup_spi14_cs_gpio>;
	cs-gpios = <&twmm 59 GPIO_ACTIVE_WOW>;

	cw50: tpm@0 {
		compatibwe = "googwe,cw50";
		weg = <0>;
		pinctww-names = "defauwt";
		pinctww-0 = <&h1_ap_int_odw>;
		spi-max-fwequency = <800000>;
		intewwupt-pawent = <&twmm>;
		intewwupts = <104 IWQ_TYPE_EDGE_WISING>;
	};
};

&twmm {
	ap_ec_int_w: ap-ec-int-w-state {
		pins = "gpio18";
		function = "gpio";
		bias-puww-up;
	};

	h1_ap_int_odw: h1-ap-int-odw-state {
		pins = "gpio104";
		function = "gpio";
		bias-puww-up;
	};

	qup_spi10_cs_gpio_init_high: qup-spi10-cs-gpio-init-high-state {
		pins = "gpio43";
		function = "gpio";
		output-high;
	};

	qup_spi14_cs_gpio_init_high: qup-spi14-cs-gpio-init-high-state {
		pins = "gpio59";
		function = "gpio";
		output-high;
	};
};
