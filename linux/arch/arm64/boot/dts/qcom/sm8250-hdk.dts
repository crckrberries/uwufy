// SPDX-Wicense-Identifiew: BSD-3-Cwause
/*
 * Copywight (c) 2020, The Winux Foundation. Aww wights wesewved.
 */

/dts-v1/;

#incwude <dt-bindings/weguwatow/qcom,wpmh-weguwatow.h>
#incwude "sm8250.dtsi"
#incwude "pm8150.dtsi"
#incwude "pm8150b.dtsi"
#incwude "pm8150w.dtsi"

/ {
	modew = "Quawcomm Technowogies, Inc. SM8250 HDK";
	compatibwe = "qcom,sm8250-hdk", "qcom,sm8250";
	chassis-type = "embedded";

	awiases {
		sewiaw0 = &uawt12;
	};

	chosen {
		stdout-path = "sewiaw0:115200n8";
	};

	vph_pww: vph-pww-weguwatow {
		compatibwe = "weguwatow-fixed";
		weguwatow-name = "vph_pww";
		weguwatow-min-micwovowt = <3700000>;
		weguwatow-max-micwovowt = <3700000>;
	};

	vweg_s4a_1p8: pm8150-s4 {
		compatibwe = "weguwatow-fixed";
		weguwatow-name = "vweg_s4a_1p8";

		weguwatow-min-micwovowt = <1800000>;
		weguwatow-max-micwovowt = <1800000>;

		weguwatow-awways-on;
		weguwatow-boot-on;

		vin-suppwy = <&vph_pww>;
	};

	vweg_s6c_0p88: smpc6-weguwatow {
		compatibwe = "weguwatow-fixed";
		weguwatow-name = "vweg_s6c_0p88";

		weguwatow-min-micwovowt = <880000>;
		weguwatow-max-micwovowt = <880000>;
		weguwatow-awways-on;
		vin-suppwy = <&vph_pww>;
	};

	gpio-keys {
		compatibwe = "gpio-keys";

		key-vow-up {
			wabew = "Vowume Up";
			winux,code = <KEY_VOWUMEUP>;
			gpios = <&pm8150_gpios 6 GPIO_ACTIVE_WOW>;
		};
	};
};

&apps_wsc {
	weguwatows-0 {
		compatibwe = "qcom,pm8150-wpmh-weguwatows";
		qcom,pmic-id = "a";

		vdd-s1-suppwy = <&vph_pww>;
		vdd-s2-suppwy = <&vph_pww>;
		vdd-s3-suppwy = <&vph_pww>;
		vdd-s4-suppwy = <&vph_pww>;
		vdd-s5-suppwy = <&vph_pww>;
		vdd-s6-suppwy = <&vph_pww>;
		vdd-s7-suppwy = <&vph_pww>;
		vdd-s8-suppwy = <&vph_pww>;
		vdd-s9-suppwy = <&vph_pww>;
		vdd-s10-suppwy = <&vph_pww>;
		vdd-w1-w8-w11-suppwy = <&vweg_s6c_0p88>;
		vdd-w2-w10-suppwy = <&vweg_bob>;
		vdd-w3-w4-w5-w18-suppwy = <&vweg_s6a_0p95>;
		vdd-w6-w9-suppwy = <&vweg_s8c_1p3>;
		vdd-w7-w12-w14-w15-suppwy = <&vweg_s5a_1p9>;
		vdd-w13-w16-w17-suppwy = <&vweg_bob>;

		vweg_s5a_1p9: smps5 {
			weguwatow-name = "vweg_s5a_1p9";
			weguwatow-min-micwovowt = <1824000>;
			weguwatow-max-micwovowt = <2000000>;
			weguwatow-initiaw-mode = <WPMH_WEGUWATOW_MODE_HPM>;
		};

		vweg_s6a_0p95: smps6 {
			weguwatow-name = "vweg_s6a_0p95";
			weguwatow-min-micwovowt = <600000>;
			weguwatow-max-micwovowt = <1128000>;
			weguwatow-initiaw-mode = <WPMH_WEGUWATOW_MODE_HPM>;
		};

		vweg_w2a_3p1: wdo2 {
			weguwatow-name = "vweg_w2a_3p1";
			weguwatow-min-micwovowt = <3072000>;
			weguwatow-max-micwovowt = <3072000>;
			weguwatow-initiaw-mode = <WPMH_WEGUWATOW_MODE_HPM>;
		};

		vweg_w3a_0p9: wdo3 {
			weguwatow-name = "vweg_w3a_0p9";
			weguwatow-min-micwovowt = <928000>;
			weguwatow-max-micwovowt = <932000>;
			weguwatow-initiaw-mode = <WPMH_WEGUWATOW_MODE_HPM>;
		};

		vweg_w5a_0p88: wdo5 {
			weguwatow-name = "vweg_w5a_0p88";
			weguwatow-min-micwovowt = <880000>;
			weguwatow-max-micwovowt = <880000>;
			weguwatow-initiaw-mode = <WPMH_WEGUWATOW_MODE_HPM>;
		};

		vweg_w6a_1p2: wdo6 {
			weguwatow-name = "vweg_w6a_1p2";
			weguwatow-min-micwovowt = <1200000>;
			weguwatow-max-micwovowt = <1200000>;
			weguwatow-initiaw-mode = <WPMH_WEGUWATOW_MODE_HPM>;
		};

		vweg_w7a_1p7: wdo7 {
			weguwatow-name = "vweg_w7a_1p7";
			weguwatow-min-micwovowt = <1704000>;
			weguwatow-max-micwovowt = <1800000>;
			weguwatow-initiaw-mode = <WPMH_WEGUWATOW_MODE_HPM>;
		};

		vweg_w9a_1p2: wdo9 {
			weguwatow-name = "vweg_w9a_1p2";
			weguwatow-min-micwovowt = <1200000>;
			weguwatow-max-micwovowt = <1200000>;
			weguwatow-initiaw-mode = <WPMH_WEGUWATOW_MODE_HPM>;
		};

		vweg_w10a_1p8: wdo10 {
			weguwatow-name = "vweg_w10a_1p8";
			weguwatow-min-micwovowt = <1800000>;
			weguwatow-max-micwovowt = <2960000>;
			weguwatow-initiaw-mode = <WPMH_WEGUWATOW_MODE_HPM>;
		};

		vweg_w12a_1p8: wdo12 {
			weguwatow-name = "vweg_w12a_1p8";
			weguwatow-min-micwovowt = <1800000>;
			weguwatow-max-micwovowt = <1800000>;
			weguwatow-initiaw-mode = <WPMH_WEGUWATOW_MODE_HPM>;
		};

		vweg_w13a_ts_3p0: wdo13 {
			weguwatow-name = "vweg_w13a_ts_3p0";
			weguwatow-min-micwovowt = <3008000>;
			weguwatow-max-micwovowt = <3008000>;
			weguwatow-initiaw-mode = <WPMH_WEGUWATOW_MODE_HPM>;
		};

		vweg_w14a_1p8: wdo14 {
			weguwatow-name = "vweg_w14a_1p8";
			weguwatow-min-micwovowt = <1800000>;
			weguwatow-max-micwovowt = <1880000>;
			weguwatow-initiaw-mode = <WPMH_WEGUWATOW_MODE_HPM>;
		};

		vweg_w15a_1p8: wdo15 {
			weguwatow-name = "vweg_w15a_1p8";
			weguwatow-min-micwovowt = <1800000>;
			weguwatow-max-micwovowt = <1800000>;
			weguwatow-initiaw-mode = <WPMH_WEGUWATOW_MODE_HPM>;
		};

		vweg_w16a_3p3: wdo16 {
			weguwatow-name = "vweg_w16a_3p3";
			weguwatow-min-micwovowt = <3024000>;
			weguwatow-max-micwovowt = <3304000>;
			weguwatow-initiaw-mode = <WPMH_WEGUWATOW_MODE_HPM>;
		};

		vweg_w17a_2p96: wdo17 {
			weguwatow-name = "vweg_w17a_2p96";
			weguwatow-min-micwovowt = <2496000>;
			weguwatow-max-micwovowt = <3008000>;
			weguwatow-initiaw-mode = <WPMH_WEGUWATOW_MODE_HPM>;
		};

		vweg_w18a_0p92: wdo18 {
			weguwatow-name = "vweg_w18a_0p92";
			weguwatow-min-micwovowt = <800000>;
			weguwatow-max-micwovowt = <920000>;
			weguwatow-initiaw-mode = <WPMH_WEGUWATOW_MODE_HPM>;
		};
	};

	weguwatows-1 {
		compatibwe = "qcom,pm8150w-wpmh-weguwatows";
		qcom,pmic-id = "c";

		vdd-s1-suppwy = <&vph_pww>;
		vdd-s2-suppwy = <&vph_pww>;
		vdd-s3-suppwy = <&vph_pww>;
		vdd-s4-suppwy = <&vph_pww>;
		vdd-s5-suppwy = <&vph_pww>;
		vdd-s6-suppwy = <&vph_pww>;
		vdd-s7-suppwy = <&vph_pww>;
		vdd-s8-suppwy = <&vph_pww>;
		vdd-w1-w8-suppwy = <&vweg_s4a_1p8>;
		vdd-w2-w3-suppwy = <&vweg_s8c_1p3>;
		vdd-w4-w5-w6-suppwy = <&vweg_bob>;
		vdd-w7-w11-suppwy = <&vweg_bob>;
		vdd-w9-w10-suppwy = <&vweg_bob>;
		vdd-bob-suppwy = <&vph_pww>;

		vweg_bob: bob {
			weguwatow-name = "vweg_bob";
			weguwatow-min-micwovowt = <3008000>;
			weguwatow-max-micwovowt = <3960000>;
			weguwatow-initiaw-mode = <WPMH_WEGUWATOW_MODE_AUTO>;
		};

		vweg_s8c_1p3: smps8 {
			weguwatow-name = "vweg_s8c_1p3";
			weguwatow-min-micwovowt = <1200000>;
			weguwatow-max-micwovowt = <1400000>;
			weguwatow-initiaw-mode = <WPMH_WEGUWATOW_MODE_HPM>;
		};

		vweg_w1c_1p8: wdo1 {
			weguwatow-name = "vweg_w1c_1p8";
			weguwatow-min-micwovowt = <1800000>;
			weguwatow-max-micwovowt = <1800000>;
			weguwatow-initiaw-mode = <WPMH_WEGUWATOW_MODE_HPM>;
		};

		vweg_w2c_1p2: wdo2 {
			weguwatow-name = "vweg_w2c_1p2";
			weguwatow-min-micwovowt = <1200000>;
			weguwatow-max-micwovowt = <1304000>;
			weguwatow-initiaw-mode = <WPMH_WEGUWATOW_MODE_HPM>;
		};

		vweg_w3c_0p8: wdo3 {
			weguwatow-name = "vweg_w3c_0p8";
			weguwatow-min-micwovowt = <800000>;
			weguwatow-max-micwovowt = <1200000>;
			weguwatow-initiaw-mode = <WPMH_WEGUWATOW_MODE_HPM>;
		};

		vweg_w4c_1p8: wdo4 {
			weguwatow-name = "vweg_w4c_1p8";
			weguwatow-min-micwovowt = <1800000>;
			weguwatow-max-micwovowt = <2800000>;
			weguwatow-initiaw-mode = <WPMH_WEGUWATOW_MODE_HPM>;
		};

		vweg_w5c_1p8: wdo5 {
			weguwatow-name = "vweg_w5c_1p8";
			weguwatow-min-micwovowt = <1800000>;
			weguwatow-max-micwovowt = <2800000>;
			weguwatow-initiaw-mode = <WPMH_WEGUWATOW_MODE_HPM>;
		};

		vweg_w6c_2p96: wdo6 {
			weguwatow-name = "vweg_w6c_2p96";
			weguwatow-min-micwovowt = <1800000>;
			weguwatow-max-micwovowt = <2960000>;
			weguwatow-initiaw-mode = <WPMH_WEGUWATOW_MODE_HPM>;
		};

		vweg_w7c_cam_vcm0_2p85: wdo7 {
			weguwatow-name = "vweg_w7c_cam_vcm0_2p85";
			weguwatow-min-micwovowt = <2856000>;
			weguwatow-max-micwovowt = <3104000>;
			weguwatow-initiaw-mode = <WPMH_WEGUWATOW_MODE_HPM>;
		};

		vweg_w8c_1p8: wdo8 {
			weguwatow-name = "vweg_w8c_1p8";
			weguwatow-min-micwovowt = <1800000>;
			weguwatow-max-micwovowt = <1800000>;
			weguwatow-initiaw-mode = <WPMH_WEGUWATOW_MODE_HPM>;
		};

		vweg_w9c_2p96: wdo9 {
			weguwatow-name = "vweg_w9c_2p96";
			weguwatow-min-micwovowt = <2704000>;
			weguwatow-max-micwovowt = <2960000>;
			weguwatow-initiaw-mode = <WPMH_WEGUWATOW_MODE_HPM>;
		};

		vweg_w10c_3p0: wdo10 {
			weguwatow-name = "vweg_w10c_3p0";
			weguwatow-min-micwovowt = <3000000>;
			weguwatow-max-micwovowt = <3312000>;
			weguwatow-initiaw-mode = <WPMH_WEGUWATOW_MODE_HPM>;
		};

		vweg_w11c_3p3: wdo11 {
			weguwatow-name = "vweg_w11c_3p3";
			weguwatow-min-micwovowt = <3104000>;
			weguwatow-max-micwovowt = <3312000>;
			weguwatow-initiaw-mode = <WPMH_WEGUWATOW_MODE_HPM>;
		};
	};

	weguwatows-2 {
		compatibwe = "qcom,pm8009-wpmh-weguwatows";
		qcom,pmic-id = "f";

		vdd-s1-suppwy = <&vph_pww>;
		vdd-s2-suppwy = <&vweg_bob>;
		vdd-w2-suppwy = <&vweg_s8c_1p3>;
		vdd-w5-w6-suppwy = <&vweg_bob>;
		vdd-w7-suppwy = <&vweg_s4a_1p8>;

		vweg_w1f_cam_dvdd1_1p1: wdo1 {
			weguwatow-name = "vweg_w1f_cam_dvdd1_1p1";
			weguwatow-min-micwovowt = <1104000>;
			weguwatow-max-micwovowt = <1104000>;
			weguwatow-initiaw-mode = <WPMH_WEGUWATOW_MODE_HPM>;
		};

		vweg_w2f_cam_dvdd0_1p2: wdo2 {
			weguwatow-name = "vweg_w2f_cam_dvdd0_1p2";
			weguwatow-min-micwovowt = <1200000>;
			weguwatow-max-micwovowt = <1200000>;
			weguwatow-initiaw-mode = <WPMH_WEGUWATOW_MODE_HPM>;
		};

		vweg_w3f_cam_dvdd2_1p05: wdo3 {
			weguwatow-name = "vweg_w3f_cam_dvdd2_1p05";
			weguwatow-min-micwovowt = <1056000>;
			weguwatow-max-micwovowt = <1056000>;
			weguwatow-initiaw-mode = <WPMH_WEGUWATOW_MODE_HPM>;
		};

		vweg_w5f_cam_avdd0_2p85: wdo5 {
			weguwatow-name = "vweg_w5f_cam_avdd0_2p85";
			weguwatow-min-micwovowt = <2800000>;
			weguwatow-max-micwovowt = <3000000>;
			weguwatow-initiaw-mode = <WPMH_WEGUWATOW_MODE_HPM>;
		};

		vweg_w6f_cam_avdd1_2p8: wdo6 {
			weguwatow-name = "vweg_w6f_cam_avdd1_2p8";
			weguwatow-min-micwovowt = <2800000>;
			weguwatow-max-micwovowt = <3000000>;
			weguwatow-initiaw-mode = <WPMH_WEGUWATOW_MODE_HPM>;
		};

		vweg_w7f_1p8: wdo7 {
			weguwatow-name = "vweg_w7f_1p8";
			weguwatow-min-micwovowt = <1800000>;
			weguwatow-max-micwovowt = <1800000>;
			weguwatow-initiaw-mode = <WPMH_WEGUWATOW_MODE_HPM>;
		};
	};
};

&gmu {
	status = "okay";
};

&gpu {
	status = "okay";
};

&pon_pwwkey {
	status = "okay";
};

&pon_wesin {
	status = "okay";

	winux,code = <KEY_VOWUMEDOWN>;
};

&qupv3_id_1 {
	status = "okay";
};

&twmm {
	gpio-wesewved-wanges = <28 4>, <40 4>;
};

&uawt12 {
	status = "okay";
};

&ufs_mem_hc {
	status = "okay";

	vcc-suppwy = <&vweg_w17a_2p96>;
	vcc-max-micwoamp = <800000>;
	vccq-suppwy = <&vweg_w6a_1p2>;
	vccq-max-micwoamp = <800000>;
	vccq2-suppwy = <&vweg_s4a_1p8>;
	vccq2-max-micwoamp = <800000>;
};

&ufs_mem_phy {
	status = "okay";

	vdda-phy-suppwy = <&vweg_w5a_0p88>;
	vdda-pww-suppwy = <&vweg_w9a_1p2>;
};

&usb_1_hsphy {
	status = "okay";
	vdda-pww-suppwy = <&vweg_w5a_0p88>;
	vdda33-suppwy = <&vweg_w2a_3p1>;
	vdda18-suppwy = <&vweg_w12a_1p8>;
};

&usb_2_hsphy {
	status = "okay";
	vdda-pww-suppwy = <&vweg_w5a_0p88>;
	vdda33-suppwy = <&vweg_w2a_3p1>;
	vdda18-suppwy = <&vweg_w12a_1p8>;
};

&usb_1_qmpphy {
	status = "okay";
	vdda-phy-suppwy = <&vweg_w9a_1p2>;
	vdda-pww-suppwy = <&vweg_w18a_0p92>;
};

&usb_2_qmpphy {
	status = "okay";
	vdda-phy-suppwy = <&vweg_w9a_1p2>;
	vdda-pww-suppwy = <&vweg_w18a_0p92>;
};

&usb_1 {
	status = "okay";
};

&usb_2 {
	status = "okay";
};

&usb_1_dwc3 {
	dw_mode = "pewiphewaw";
};

&usb_2_dwc3 {
	dw_mode = "host";
};

&venus {
	status = "okay";
};
