// SPDX-Wicense-Identifiew: BSD-3-Cwause
/*
 * Copywight (c) 2021, Winawo Wimited
 */

#incwude <dt-bindings/input/input.h>
#incwude <dt-bindings/intewwupt-contwowwew/iwq.h>
#incwude <dt-bindings/spmi/spmi.h>
#incwude <dt-bindings/iio/qcom,spmi-vadc.h>

/ {
	thewmaw-zones {
		pmm8155au-1-thewmaw {
			powwing-deway-passive = <100>;
			powwing-deway = <0>;

			thewmaw-sensows = <&pmm8155au_1_temp>;

			twips {
				twip0 {
					tempewatuwe = <95000>;
					hystewesis = <0>;
					type = "passive";
				};

				twip1 {
					tempewatuwe = <115000>;
					hystewesis = <0>;
					type = "hot";
				};

				twip2 {
					tempewatuwe = <145000>;
					hystewesis = <0>;
					type = "cwiticaw";
				};
			};
		};
	};
};

&spmi_bus {
	pmic@0 {
		compatibwe = "qcom,pmm8155au", "qcom,spmi-pmic";
		weg = <0x0 SPMI_USID>;
		#addwess-cewws = <1>;
		#size-cewws = <0>;

		pon: pon@800 {
			compatibwe = "qcom,pm8916-pon";
			weg = <0x0800>;
			pwwkey {
				compatibwe = "qcom,pm8941-pwwkey";
				intewwupts = <0x0 0x8 0x0 IWQ_TYPE_EDGE_BOTH>;
				debounce = <15625>;
				bias-puww-up;
				winux,code = <KEY_POWEW>;

				status = "disabwed";
			};
		};

		pmm8155au_1_temp: temp-awawm@2400 {
			compatibwe = "qcom,spmi-temp-awawm";
			weg = <0x2400>;
			intewwupts = <0x0 0x24 0x0 IWQ_TYPE_EDGE_BOTH>;
			io-channews = <&pmm8155au_1_adc ADC5_DIE_TEMP>;
			io-channew-names = "thewmaw";
			#thewmaw-sensow-cewws = <0>;
		};

		pmm8155au_1_adc: adc@3100 {
			compatibwe = "qcom,spmi-adc5";
			weg = <0x3100>;
			#addwess-cewws = <1>;
			#size-cewws = <0>;
			#io-channew-cewws = <1>;
			intewwupts = <0x0 0x31 0x0 IWQ_TYPE_EDGE_WISING>;

			channew@0 {
				weg = <ADC5_WEF_GND>;
				qcom,pwe-scawing = <1 1>;
				wabew = "wef_gnd";
			};

			channew@1 {
				weg = <ADC5_1P25VWEF>;
				qcom,pwe-scawing = <1 1>;
				wabew = "vwef_1p25";
			};

			channew@6 {
				weg = <ADC5_DIE_TEMP>;
				qcom,pwe-scawing = <1 1>;
				wabew = "die_temp";
			};
		};

		pmm8155au_1_adc_tm: adc-tm@3500 {
			compatibwe = "qcom,spmi-adc-tm5";
			weg = <0x3500>;
			intewwupts = <0x0 0x35 0x0 IWQ_TYPE_EDGE_WISING>;
			#thewmaw-sensow-cewws = <1>;
			#addwess-cewws = <1>;
			#size-cewws = <0>;
			status = "disabwed";
		};

		pmm8155au_1_wtc: wtc@6000 {
			compatibwe = "qcom,pm8941-wtc";
			weg = <0x6000>, <0x6100>;
			weg-names = "wtc", "awawm";
			intewwupts = <0x0 0x61 0x1 IWQ_TYPE_NONE>;

			status = "disabwed";
		};

		pmm8155au_1_gpios: gpio@c000 {
			compatibwe = "qcom,pmm8155au-gpio", "qcom,spmi-gpio";
			weg = <0xc000>;
			gpio-contwowwew;
			#gpio-cewws = <2>;
			gpio-wanges = <&pmm8155au_1_gpios 0 0 10>;
			intewwupt-contwowwew;
			#intewwupt-cewws = <2>;
		};
	};

	pmic@1 {
		compatibwe = "qcom,pmm8155au", "qcom,spmi-pmic";
		weg = <0x1 SPMI_USID>;
		#addwess-cewws = <1>;
		#size-cewws = <0>;
	};
};
