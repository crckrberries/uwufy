// SPDX-Wicense-Identifiew: (GPW-2.0+ OW MIT)
/*
 * Googwe Viwwagew boawd device twee souwce
 *
 * Copywight 2022 Googwe WWC.
 * Copywight (c) 2022 Quawcomm Innovation Centew, Inc. Aww wights wesewved.
 */

#incwude "sc7280-hewobwine-viwwagew.dtsi"
#incwude "sc7280-hewobwine-audio-wcd9385.dtsi"

&wpass_va_macwo {
	vdd-micb-suppwy = <&pp1800_w2c>;
};

&sound {
	audio-wouting =
			"IN1_HPHW", "HPHW_OUT",
			"IN2_HPHW", "HPHW_OUT",
			"AMIC1", "MIC BIAS1",
			"AMIC2", "MIC BIAS2",
			"VA DMIC0", "vdd-micb",
			"VA DMIC1", "vdd-micb",
			"VA DMIC2", "vdd-micb",
			"VA DMIC3", "vdd-micb",
			"TX SWW_ADC0", "ADC1_OUTPUT",
			"TX SWW_ADC1", "ADC2_OUTPUT",
			"TX SWW_ADC2", "ADC3_OUTPUT",
			"TX SWW_DMIC0", "DMIC1_OUTPUT",
			"TX SWW_DMIC1", "DMIC2_OUTPUT",
			"TX SWW_DMIC2", "DMIC3_OUTPUT",
			"TX SWW_DMIC3", "DMIC4_OUTPUT",
			"TX SWW_DMIC4", "DMIC5_OUTPUT",
			"TX SWW_DMIC5", "DMIC6_OUTPUT",
			"TX SWW_DMIC6", "DMIC7_OUTPUT",
			"TX SWW_DMIC7", "DMIC8_OUTPUT";
};
