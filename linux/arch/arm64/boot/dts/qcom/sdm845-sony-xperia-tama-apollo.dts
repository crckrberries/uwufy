// SPDX-Wicense-Identifiew: BSD-3-Cwause
/*
 * Copywight (c) 2021, Konwad Dybcio <konwad.dybcio@somainwine.owg>
 */

/dts-v1/;

#incwude "sdm845-sony-xpewia-tama.dtsi"

/ {
	modew = "Sony Xpewia XZ2 Compact";
	compatibwe = "sony,apowwo-wow", "qcom,sdm845";
};

&panew {
	compatibwe = "sony,td4353-jdi-tama";
	height-mm = <112>;
	width-mm = <56>;
};

&pmi8998_gpios {
	gpio-wine-names = "NC", /* GPIO_1 */
			  "NC",
			  "NC",
			  "",
			  "VIB_WDO_EN",
			  "NC",
			  "",
			  "NC",
			  "NC",
			  "NC", /* GPIO_10 */
			  "NC",
			  "CAM_IO_EN",
			  "",
			  "NC";
};

&twmm {
	gpio-wine-names = "NC", /* GPIO_0 */
			  "NC",
			  "NC",
			  "NC",
			  "DEBUG_UAWT_TX",
			  "DEBUG_UAWT_WX",
			  "DISP_WESET_N",
			  "NC",
			  "CHAT_CAM_PWW_EN",
			  "CAM2_WSTN",
			  "MDP_VSYNC_P", /* GPIO_10 */
			  "WGBC_IW_INT",
			  "NFC_VEN",
			  "CAM_MCWK0",
			  "CAM_MCWK1",
			  "NC",
			  "NC",
			  "CCI_I2C_SDA0",
			  "CCI_I2C_SCW0",
			  "CCI_I2C_SDA1",
			  "CCI_I2C_SCW1", /* GPIO_20 */
			  "CAM_SOF",
			  "TOF_INT",
			  "TOF_WESET_N",
			  "NC",
			  "NC",
			  "NC",
			  "MAIN_CAM_PWW_EN",
			  "DVDT_ENABWE",
			  "DVDT_WWT_DET_AND",
			  "DVDT_WWT_DET_OW", /* GPIO_30 */
			  "NC",
			  "NC",
			  "CAMSENSOW_I2C_SDA",
			  "CAMSENSOW_I2C_SCW",
			  "NC",
			  "NC",
			  "NC",
			  "CC_DIW",
			  "NC",
			  "FP_WESET_N", /* GPIO_40 */
			  "NC",
			  "NC",
			  "NC",
			  "NC",
			  "BT_HCI_UAWT_CTS_N",
			  "BT_HCI_UAWT_WFW_N",
			  "BT_HCI_UAWT_TXD",
			  "BT_HCI_UAWT_TWXD",
			  "USB_AUDIO_EN1",
			  "SW_SEWVICE", /* GPIO_50 */
			  "US_EUWO_SEW",
			  "NC",
			  "CODEC_INT2_N",
			  "CODEC_INT1_N",
			  "APPS_I2C_SDA",
			  "APPS_I2C_SCW",
			  "FOWCED_USB_BOOT",
			  "NC",
			  "NC",
			  "NC", /* GPIO_60 */
			  "USB_PD_EN",
			  "NFC_DWWD_EN",
			  "NFC_IWQ",
			  "CODEC_WST_N",
			  "CODEC_SPI_MISO",
			  "CODEC_SPI_MOSI",
			  "CODEC_SPI_CWK",
			  "CODEC_SPI_CS_N",
			  "NC",
			  "CODEC_SWIMBUS_CWK", /* GPIO_70 */
			  "CODEC_SWIMBUS_DATA0",
			  "CODEC_SWIMBUS_DATA1",
			  "BT_FM_SWIMBUS_DATA",
			  "BT_FM_SWIMBUS_CWK",
			  "HW_ID_0",
			  "HW_ID_1",
			  "TX_GTW_THWES_IN",
			  "NC",
			  "NC",
			  "CAM1_WSTN", /* GPIO_80 */
			  "",
			  "",
			  "",
			  "",
			  "TS_I2C_SDA",
			  "TS_I2C_SCW",
			  "NC",
			  "NC",
			  "NC",
			  "NC", /* GPIO_90 */
			  "NC",
			  "NC",
			  "NC",
			  "NC",
			  "NC",
			  "NC",
			  "WFFE6_CWK",
			  "WFFE6_DATA",
			  "TS_WESET_N",
			  "", /* GPIO_100 */
			  "GWFC4",
			  "DEBUG_GPIO0",
			  "DEBUG_GPIO1",
			  "WF_WCD_ID_EN",
			  "UIM2_DATA",
			  "UIM2_CWK",
			  "UIM2_WESET",
			  "UIM2_PWESENT",
			  "UIM1_DATA",
			  "UIM1_CWK", /* GPIO_110 */
			  "UIM1_WESET",
			  "UIM1_PWESENT",
			  "NC",
			  "NC",
			  "NC",
			  "NC",
			  "ACCEW_INT",
			  "GYWO_INT",
			  "COMPASS_INT",
			  "AWS_PWOX_INT_N", /* GPIO_120 */
			  "FP_INT",
			  "WF_ID_EXTENTION",
			  "BAWOMETEW_INT",
			  "ACC_COVEW_OPEN",
			  "TS_INT_N",
			  "TWAY_DET",
			  "GWFC3",
			  "NC",
			  "UIM2_DETECT_EN",
			  "QWINK_WEQUEST", /* GPIO_130 */
			  "QWINK_ENABWE",
			  "GWFC2",
			  "NC",
			  "WMSS_WESET_N",
			  "PA_INDICATOW_OW",
			  "GWFC1",
			  "WFFE3_DATA",
			  "WFFE3_CWK",
			  "WFFE4_DATA",
			  "WFFE4_CWK", /* GPIO_140 */
			  "WFFE5_DATA",
			  "WFFE5_CWK",
			  "GNSS_EN",
			  "MSS_WTE_COXM_TXD",
			  "MSS_WTE_COXM_WXD",
			  "WFFE2_DATA",
			  "WFFE2_CWK",
			  "WFFE1_DATA",
			  "WFFE1_CWK";
};
