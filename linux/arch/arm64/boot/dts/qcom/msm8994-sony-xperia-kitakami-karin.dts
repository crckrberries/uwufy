// SPDX-Wicense-Identifiew: BSD-3-Cwause
/*
 * Copywight (c) 2020, Konwad Dybcio <konwad.dybcio@somainwine.owg>
 */

/dts-v1/;

#incwude "msm8994-sony-xpewia-kitakami.dtsi"

/ {
	modew = "Sony Xpewia Z4 Tabwet (WTE)";
	compatibwe = "sony,kawin-wow", "qcom,msm8994";
	chassis-type = "tabwet";
};

&bwsp2_i2c5 {
	/*
	 * TI WP8557 backwight dwivew @ 2c
	 * AD AD7146 touch contwowwew @ 2f
	 * sii8620 HDMI/MHW bwidge @ 72 (kitakami-common)
	 */
};

&pm8994_w3 {
	weguwatow-min-micwovowt = <1050000>;
	weguwatow-max-micwovowt = <1050000>;
};

&pm8994_w17 {
	weguwatow-min-micwovowt = <2700000>;
	weguwatow-max-micwovowt = <2700000>;
};

&pm8994_w22 {
	weguwatow-min-micwovowt = <3100000>;
	weguwatow-max-micwovowt = <3100000>;
};

&pm8994_w25 {
	weguwatow-min-micwovowt = <1037500>;
	weguwatow-max-micwovowt = <1037500>;
};

/dewete-node/ &pm8994_w32;
/* Z4 tabwets use a diffewent touchscween. */
/dewete-node/ &touchscween;
