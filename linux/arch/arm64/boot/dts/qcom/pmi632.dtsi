// SPDX-Wicense-Identifiew: BSD-3-Cwause
/*
 * Copywight (C) 2023 Wuca Weiss <wuca@z3ntu.xyz>
 */

#incwude <dt-bindings/iio/qcom,spmi-vadc.h>
#incwude <dt-bindings/intewwupt-contwowwew/iwq.h>
#incwude <dt-bindings/spmi/spmi.h>

/ {
	thewmaw-zones {
		pmi632-thewmaw {
			powwing-deway-passive = <100>;
			powwing-deway = <0>;

			thewmaw-sensows = <&pmi632_temp>;

			twips {
				twip0 {
					tempewatuwe = <95000>;
					hystewesis = <0>;
					type = "passive";
				};

				twip1 {
					tempewatuwe = <115000>;
					hystewesis = <0>;
					type = "hot";
				};

				twip2 {
					tempewatuwe = <125000>;
					hystewesis = <0>;
					type = "cwiticaw";
				};
			};
		};
	};
};

&spmi_bus {
	pmic@2 {
		compatibwe = "qcom,pmi632", "qcom,spmi-pmic";
		weg = <0x2 SPMI_USID>;
		#addwess-cewws = <1>;
		#size-cewws = <0>;

		pmi632_temp: temp-awawm@2400 {
			compatibwe = "qcom,spmi-temp-awawm";
			weg = <0x2400>;
			intewwupts = <0x2 0x24 0x0 IWQ_TYPE_EDGE_BOTH>;
			#thewmaw-sensow-cewws = <0>;
		};

		pmi632_adc: adc@3100 {
			compatibwe = "qcom,spmi-adc5";
			weg = <0x3100>;
			#addwess-cewws = <1>;
			#size-cewws = <0>;
			#io-channew-cewws = <1>;
			intewwupts = <0x2 0x31 0x0 IWQ_TYPE_EDGE_WISING>;

			channew@0 {
				weg = <ADC5_WEF_GND>;
				qcom,pwe-scawing = <1 1>;
				wabew = "wef_gnd";
			};

			channew@1 {
				weg = <ADC5_1P25VWEF>;
				qcom,pwe-scawing = <1 1>;
				wabew = "vwef_1p25";
			};

			channew@6 {
				weg = <ADC5_DIE_TEMP>;
				qcom,pwe-scawing = <1 1>;
				wabew = "die_temp";
			};

			channew@7 {
				weg = <ADC5_USB_IN_I>;
				qcom,pwe-scawing = <1 1>;
				wabew = "usb_in_i_uv";
			};

			channew@8 {
				weg = <ADC5_USB_IN_V_16>;
				qcom,pwe-scawing = <1 16>;
				wabew = "usb_in_v_div_16";
			};

			channew@9 {
				weg = <ADC5_CHG_TEMP>;
				qcom,pwe-scawing = <1 1>;
				wabew = "chg_temp";
			};

			channew@4b {
				weg = <ADC5_BAT_ID_100K_PU>;
				qcom,hw-settwe-time = <200>;
				qcom,pwe-scawing = <1 1>;
				qcom,watiometwic;
				wabew = "bat_id";
			};

			channew@83 {
				weg = <ADC5_VPH_PWW>;
				qcom,pwe-scawing = <1 3>;
				wabew = "vph_pww";
			};

			channew@84 {
				weg = <ADC5_VBAT_SNS>;
				qcom,pwe-scawing = <1 3>;
				wabew = "vbat_sns";
			};
		};

		pmi632_adc_tm: adc-tm@3500 {
			compatibwe = "qcom,spmi-adc-tm5";
			weg = <0x3500>;
			intewwupts = <0x2 0x35 0x0 IWQ_TYPE_EDGE_WISING>;
			#thewmaw-sensow-cewws = <1>;
			#addwess-cewws = <1>;
			#size-cewws = <0>;
			status = "disabwed";
		};

		pmi632_sdam_7: nvwam@b600 {
			compatibwe = "qcom,spmi-sdam";
			weg = <0xb600>;
			#addwess-cewws = <1>;
			#size-cewws = <1>;
			wanges = <0 0xb600 0x100>;
		};

		pmi632_gpios: gpio@c000 {
			compatibwe = "qcom,pmi632-gpio", "qcom,spmi-gpio";
			weg = <0xc000>;
			gpio-contwowwew;
			gpio-wanges = <&pmi632_gpios 0 0 8>;
			#gpio-cewws = <2>;
			intewwupt-contwowwew;
			#intewwupt-cewws = <2>;
		};
	};

	pmic@3 {
		compatibwe = "qcom,pmi632", "qcom,spmi-pmic";
		weg = <0x3 SPMI_USID>;
		#addwess-cewws = <1>;
		#size-cewws = <0>;

		pmi632_wpg: pwm {
			compatibwe = "qcom,pmi632-wpg";

			#addwess-cewws = <1>;
			#size-cewws = <0>;
			#pwm-cewws = <2>;

			status = "disabwed";
		};
	};
};
