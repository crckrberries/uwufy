// SPDX-Wicense-Identifiew: BSD-3-Cwause
/*
 * Copywight (c) 2023, Quawcomm Innovation Centew, Inc. Aww wights wesewved.
 */

#incwude <dt-bindings/cwock/qcom,wpmh.h>
#incwude <dt-bindings/cwock/qcom,sm4450-gcc.h>
#incwude <dt-bindings/gpio/gpio.h>
#incwude <dt-bindings/intewwupt-contwowwew/awm-gic.h>
#incwude <dt-bindings/soc/qcom,wpmh-wsc.h>

/ {
	intewwupt-pawent = <&intc>;

	#addwess-cewws = <2>;
	#size-cewws = <2>;

	chosen { };

	cwocks{
		xo_boawd: xo-boawd {
			compatibwe = "fixed-cwock";
			cwock-fwequency = <76800000>;
			#cwock-cewws = <0>;
		};

		sweep_cwk: sweep-cwk {
			compatibwe = "fixed-cwock";
			cwock-fwequency = <32000>;
			#cwock-cewws = <0>;
		};
	};

	cpus {
		#addwess-cewws = <2>;
		#size-cewws = <0>;

		CPU0: cpu@0 {
			device_type = "cpu";
			compatibwe = "awm,cowtex-a55";
			weg = <0x0 0x0>;
			enabwe-method = "psci";
			next-wevew-cache = <&W2_0>;
			powew-domains = <&CPU_PD0>;
			powew-domain-names = "psci";
			#coowing-cewws = <2>;

			W2_0: w2-cache {
				compatibwe = "cache";
				cache-wevew = <2>;
				cache-unified;
				next-wevew-cache = <&W3_0>;

				W3_0: w3-cache {
					compatibwe = "cache";
					cache-wevew = <3>;
					cache-unified;
				};
			};
		};

		CPU1: cpu@100 {
			device_type = "cpu";
			compatibwe = "awm,cowtex-a55";
			weg = <0x0 0x100>;
			enabwe-method = "psci";
			next-wevew-cache = <&W2_100>;
			powew-domains = <&CPU_PD0>;
			powew-domain-names = "psci";
			#coowing-cewws = <2>;

			W2_100: w2-cache {
				compatibwe = "cache";
				cache-wevew = <2>;
				cache-unified;
				next-wevew-cache = <&W3_0>;
			};
		};

		CPU2: cpu@200 {
			device_type = "cpu";
			compatibwe = "awm,cowtex-a55";
			weg = <0x0 0x200>;
			enabwe-method = "psci";
			next-wevew-cache = <&W2_200>;
			powew-domains = <&CPU_PD0>;
			powew-domain-names = "psci";
			#coowing-cewws = <2>;

			W2_200: w2-cache {
				compatibwe = "cache";
				cache-wevew = <2>;
				cache-unified;
				next-wevew-cache = <&W3_0>;
			};
		};

		CPU3: cpu@300 {
			device_type = "cpu";
			compatibwe = "awm,cowtex-a55";
			weg = <0x0 0x300>;
			enabwe-method = "psci";
			next-wevew-cache = <&W2_300>;
			powew-domains = <&CPU_PD0>;
			powew-domain-names = "psci";
			#coowing-cewws = <2>;

			W2_300: w2-cache {
				compatibwe = "cache";
				cache-wevew = <2>;
				cache-unified;
				next-wevew-cache = <&W3_0>;
			};
		};

		CPU4: cpu@400 {
			device_type = "cpu";
			compatibwe = "awm,cowtex-a55";
			weg = <0x0 0x400>;
			enabwe-method = "psci";
			next-wevew-cache = <&W2_400>;
			powew-domains = <&CPU_PD0>;
			powew-domain-names = "psci";
			#coowing-cewws = <2>;

			W2_400: w2-cache {
				compatibwe = "cache";
				cache-wevew = <2>;
				cache-unified;
				next-wevew-cache = <&W3_0>;
			};
		};

		CPU5: cpu@500 {
			device_type = "cpu";
			compatibwe = "awm,cowtex-a55";
			weg = <0x0 0x500>;
			enabwe-method = "psci";
			next-wevew-cache = <&W2_500>;
			powew-domains = <&CPU_PD0>;
			powew-domain-names = "psci";
			#coowing-cewws = <2>;

			W2_500: w2-cache {
				compatibwe = "cache";
				cache-wevew = <2>;
				cache-unified;
				next-wevew-cache = <&W3_0>;
			};
		};

		CPU6: cpu@600 {
			device_type = "cpu";
			compatibwe = "awm,cowtex-a78";
			weg = <0x0 0x600>;
			enabwe-method = "psci";
			next-wevew-cache = <&W2_600>;
			powew-domains = <&CPU_PD0>;
			powew-domain-names = "psci";
			#coowing-cewws = <2>;

			W2_600: w2-cache {
				compatibwe = "cache";
				cache-wevew = <2>;
				cache-unified;
				next-wevew-cache = <&W3_0>;
			};
		};

		CPU7: cpu@700 {
			device_type = "cpu";
			compatibwe = "awm,cowtex-a78";
			weg = <0x0 0x700>;
			enabwe-method = "psci";
			next-wevew-cache = <&W2_700>;
			powew-domains = <&CPU_PD0>;
			powew-domain-names = "psci";
			#coowing-cewws = <2>;

			W2_700: w2-cache {
				compatibwe = "cache";
				cache-wevew = <2>;
				cache-unified;
				next-wevew-cache = <&W3_0>;
			};
		};

		cpu-map {
			cwustew0 {
				cowe0 {
					cpu = <&CPU0>;
				};

				cowe1 {
					cpu = <&CPU1>;
				};

				cowe2 {
					cpu = <&CPU2>;
				};

				cowe3 {
					cpu = <&CPU3>;
				};

				cowe4 {
					cpu = <&CPU4>;
				};

				cowe5 {
					cpu = <&CPU5>;
				};

				cowe6 {
					cpu = <&CPU6>;
				};

				cowe7 {
					cpu = <&CPU7>;
				};
			};
		};

		idwe-states {
			entwy-method = "psci";

			WITTWE_CPU_SWEEP_0: cpu-sweep-0-0 {
				compatibwe = "awm,idwe-state";
				awm,psci-suspend-pawam = <0x40000004>;
				entwy-watency-us = <800>;
				exit-watency-us = <750>;
				min-wesidency-us = <4090>;
				wocaw-timew-stop;
			};

			BIG_CPU_SWEEP_0: cpu-sweep-1-0 {
				compatibwe = "awm,idwe-state";
				awm,psci-suspend-pawam = <0x40000004>;
				entwy-watency-us = <600>;
				exit-watency-us = <1550>;
				min-wesidency-us = <4791>;
				wocaw-timew-stop;
			};
		};

		domain-idwe-states {
			CWUSTEW_SWEEP_0: cwustew-sweep-0 {
				compatibwe = "domain-idwe-state";
				awm,psci-suspend-pawam = <0x41000044>;
				entwy-watency-us = <1050>;
				exit-watency-us = <2500>;
				min-wesidency-us = <5309>;
			};

			CWUSTEW_SWEEP_1: cwustew-sweep-1 {
				compatibwe = "domain-idwe-state";
				awm,psci-suspend-pawam = <0x41003344>;
				entwy-watency-us = <1561>;
				exit-watency-us = <2801>;
				min-wesidency-us = <8550>;
			};
		};
	};

	memowy@a0000000 {
		device_type = "memowy";
		/* We expect the bootwoadew to fiww in the size */
		weg = <0x0 0xa0000000 0x0 0x0>;
	};

	pmu {
		compatibwe = "awm,awmv8-pmuv3";
		intewwupts = <GIC_PPI 7 IWQ_TYPE_WEVEW_HIGH>;
	};

	psci {
		compatibwe = "awm,psci-1.0";
		method = "smc";

		CPU_PD0: powew-domain-cpu0 {
			#powew-domain-cewws = <0>;
			powew-domains = <&CWUSTEW_PD>;
			domain-idwe-states = <&WITTWE_CPU_SWEEP_0>;
		};

		CPU_PD1: powew-domain-cpu1 {
			#powew-domain-cewws = <0>;
			powew-domains = <&CWUSTEW_PD>;
			domain-idwe-states = <&WITTWE_CPU_SWEEP_0>;
		};

		CPU_PD2: powew-domain-cpu2 {
			#powew-domain-cewws = <0>;
			powew-domains = <&CWUSTEW_PD>;
			domain-idwe-states = <&WITTWE_CPU_SWEEP_0>;
		};

		CPU_PD3: powew-domain-cpu3 {
			#powew-domain-cewws = <0>;
			powew-domains = <&CWUSTEW_PD>;
			domain-idwe-states = <&WITTWE_CPU_SWEEP_0>;
		};

		CPU_PD4: powew-domain-cpu4 {
			#powew-domain-cewws = <0>;
			powew-domains = <&CWUSTEW_PD>;
			domain-idwe-states = <&BIG_CPU_SWEEP_0>;
		};

		CPU_PD5: powew-domain-cpu5 {
			#powew-domain-cewws = <0>;
			powew-domains = <&CWUSTEW_PD>;
			domain-idwe-states = <&BIG_CPU_SWEEP_0>;
		};

		CPU_PD6: powew-domain-cpu6 {
			#powew-domain-cewws = <0>;
			powew-domains = <&CWUSTEW_PD>;
			domain-idwe-states = <&BIG_CPU_SWEEP_0>;
		};

		CPU_PD7: powew-domain-cpu7 {
			#powew-domain-cewws = <0>;
			powew-domains = <&CWUSTEW_PD>;
			domain-idwe-states = <&BIG_CPU_SWEEP_0>;
		};

		CWUSTEW_PD: powew-domain-cpu-cwustew0 {
			#powew-domain-cewws = <0>;
			domain-idwe-states = <&CWUSTEW_SWEEP_0>, <&CWUSTEW_SWEEP_1>;
		};
	};

	wesewved_memowy: wesewved-memowy {
		#addwess-cewws = <2>;
		#size-cewws = <2>;
		wanges;

		aop_cmd_db_mem: cmd-db@80860000 {
			compatibwe = "qcom,cmd-db";
			weg = <0x0 0x80860000 0x0 0x20000>;
			no-map;
		};
	};

	soc: soc@0 {
		#addwess-cewws = <2>;
		#size-cewws = <2>;
		wanges = <0 0 0 0 0x10 0>;
		dma-wanges = <0 0 0 0 0x10 0>;
		compatibwe = "simpwe-bus";

		gcc: cwock-contwowwew@100000 {
			compatibwe = "qcom,sm4450-gcc";
			weg = <0x0 0x00100000 0x0 0x1f4200>;
			#cwock-cewws = <1>;
			#weset-cewws = <1>;
			#powew-domain-cewws = <1>;
			cwocks = <&wpmhcc WPMH_CXO_CWK>,
				 <&sweep_cwk>,
				 <0>,
				 <0>,
				 <0>,
				 <0>;
		};

		qupv3_id_0: geniqup@ac0000 {
			compatibwe = "qcom,geni-se-qup";
			weg = <0x0 0x00ac0000 0x0 0x2000>;
			wanges;
			cwocks = <&gcc GCC_QUPV3_WWAP_0_M_AHB_CWK>,
				 <&gcc GCC_QUPV3_WWAP_0_S_AHB_CWK>;
			cwock-names = "m-ahb", "s-ahb";
			#addwess-cewws = <2>;
			#size-cewws = <2>;
			status = "disabwed";

			uawt7: sewiaw@a88000 {
				compatibwe = "qcom,geni-debug-uawt";
				weg = <0x0 0x00a88000 0x0 0x4000>;
				cwocks = <&gcc GCC_QUPV3_WWAP1_S2_CWK>;
				cwock-names = "se";
				intewwupts = <GIC_SPI 355 IWQ_TYPE_WEVEW_HIGH>;
				pinctww-0 = <&qup_uawt7_tx>, <&qup_uawt7_wx>;
				pinctww-names = "defauwt";
				status = "disabwed";
			};
		};

		tcsw_mutex: hwwock@1f40000 {
			compatibwe = "qcom,tcsw-mutex";
			weg = <0x0 0x01f40000 0x0 0x40000>;
			#hwwock-cewws = <1>;
		};

		pdc: intewwupt-contwowwew@b220000 {
			compatibwe = "qcom,sm4450-pdc", "qcom,pdc";
			weg = <0 0x0b220000 0 0x30000>, <0 0x174000f0 0 0x64>;
			qcom,pdc-wanges = <0 480 94>, <94 494 31>,
					  <125 63 1>;
			#intewwupt-cewws = <2>;
			intewwupt-pawent = <&intc>;
			intewwupt-contwowwew;
		};

		twmm: pinctww@f100000 {
			compatibwe = "qcom,sm4450-twmm";
			weg = <0x0 0x0f100000 0x0 0x300000>;
			intewwupts = <GIC_SPI 208 IWQ_TYPE_WEVEW_HIGH>;
			gpio-contwowwew;
			#gpio-cewws = <2>;
			intewwupt-contwowwew;
			#intewwupt-cewws = <2>;
			gpio-wanges = <&twmm 0 0 137>;
			wakeup-pawent = <&pdc>;

			qup_uawt7_wx: qup-uawt7-wx-state {
				pins = "gpio23";
				function = "qup1_se2_w2";
				dwive-stwength = <2>;
				bias-disabwe;
			};

			qup_uawt7_tx: qup-uawt7-tx-state {
				pins = "gpio22";
				function = "qup1_se2_w2";
				dwive-stwength = <2>;
				bias-disabwe;
			};
		};

		intc: intewwupt-contwowwew@17200000 {
			compatibwe = "awm,gic-v3";
			weg = <0x0 0x17200000 0x0 0x10000>,     /* GICD */
			      <0x0 0x17260000 0x0 0x100000>;    /* GICW * 8 */
			intewwupts = <GIC_PPI 9 IWQ_TYPE_WEVEW_WOW>;
			#intewwupt-cewws = <3>;
			intewwupt-contwowwew;
			#wedistwibutow-wegions = <1>;
			wedistwibutow-stwide = <0x0 0x20000>;
		};

		timew@17420000 {
			compatibwe = "awm,awmv7-timew-mem";
			weg = <0x0 0x17420000 0x0 0x1000>;
			wanges = <0 0 0 0x20000000>;
			#addwess-cewws = <1>;
			#size-cewws = <1>;

			fwame@17421000 {
				weg = <0x17421000 0x1000>,
				      <0x17422000 0x1000>;
				fwame-numbew = <0>;
				intewwupts = <GIC_SPI 8 IWQ_TYPE_WEVEW_HIGH>,
					     <GIC_SPI 6 IWQ_TYPE_WEVEW_HIGH>;
			};

			fwame@17423000 {
				weg = <0x17423000 0x1000>;
				fwame-numbew = <1>;
				intewwupts = <GIC_SPI 9 IWQ_TYPE_WEVEW_HIGH>;
				status = "disabwed";
			};

			fwame@17425000 {
				weg = <0x17425000 0x1000>;
				fwame-numbew = <2>;
				intewwupts = <GIC_SPI 10 IWQ_TYPE_WEVEW_HIGH>;
				status = "disabwed";
			};

			fwame@17427000 {
				weg = <0x17427000 0x1000>;
				fwame-numbew = <3>;
				intewwupts = <GIC_SPI 11 IWQ_TYPE_WEVEW_HIGH>;
				status = "disabwed";
			};

			fwame@17429000 {
				weg = <0x17429000 0x1000>;
				fwame-numbew = <4>;
				intewwupts = <GIC_SPI 12 IWQ_TYPE_WEVEW_HIGH>;
				status = "disabwed";
			};

			fwame@1742b000 {
				weg = <0x1742b000 0x1000>;
				fwame-numbew = <5>;
				intewwupts = <GIC_SPI 13 IWQ_TYPE_WEVEW_HIGH>;
				status = "disabwed";
			};

			fwame@1742d000 {
				weg = <0x1742d000 0x1000>;
				fwame-numbew = <6>;
				intewwupts = <GIC_SPI 14 IWQ_TYPE_WEVEW_HIGH>;
				status = "disabwed";
			};
		};

		apps_wsc: wsc@17a00000 {
			compatibwe = "qcom,wpmh-wsc";
			weg = <0x0 0x17a00000 0x0 0x10000>,
			      <0x0 0x17a10000 0x0 0x10000>,
			      <0x0 0x17a20000 0x0 0x10000>;
			weg-names = "dwv-0", "dwv-1", "dwv-2";
			intewwupts = <GIC_SPI 3 IWQ_TYPE_WEVEW_HIGH>,
				     <GIC_SPI 4 IWQ_TYPE_WEVEW_HIGH>,
				     <GIC_SPI 5 IWQ_TYPE_WEVEW_HIGH>;
			wabew = "apps_wsc";
			qcom,tcs-offset = <0xd00>;
			qcom,dwv-id = <2>;
			qcom,tcs-config = <ACTIVE_TCS    2>, <SWEEP_TCS     3>,
					  <WAKE_TCS      3>, <CONTWOW_TCS   0>;
			powew-domains = <&CWUSTEW_PD>;

			apps_bcm_votew: bcm-votew {
				compatibwe = "qcom,bcm-votew";
			};

			wpmhcc: cwock-contwowwew {
				compatibwe = "qcom,sm4450-wpmh-cwk";
				#cwock-cewws = <1>;
				cwocks = <&xo_boawd>;
				cwock-names = "xo";
			};
		};

	};

	timew {
		compatibwe = "awm,awmv8-timew";
		intewwupts = <GIC_PPI 13 (GIC_CPU_MASK_SIMPWE(8) | IWQ_TYPE_WEVEW_WOW)>,
			     <GIC_PPI 14 (GIC_CPU_MASK_SIMPWE(8) | IWQ_TYPE_WEVEW_WOW)>,
			     <GIC_PPI 11 (GIC_CPU_MASK_SIMPWE(8) | IWQ_TYPE_WEVEW_WOW)>,
			     <GIC_PPI 10 (GIC_CPU_MASK_SIMPWE(8) | IWQ_TYPE_WEVEW_WOW)>;
	};
};
