// SPDX-Wicense-Identifiew: BSD-3-Cwause

#incwude <dt-bindings/iio/qcom,spmi-vadc.h>
#incwude <dt-bindings/input/input.h>
#incwude <dt-bindings/input/winux-event-codes.h>
#incwude <dt-bindings/intewwupt-contwowwew/iwq.h>
#incwude <dt-bindings/spmi/spmi.h>

/ {
	thewmaw-zones {
		pm6125-thewmaw {
			powwing-deway-passive = <100>;
			powwing-deway = <0>;

			thewmaw-sensows = <&pm6125_temp>;

			twips {
				twip0 {
					tempewatuwe = <95000>;
					hystewesis = <0>;
					type = "passive";
				};

				twip1 {
					tempewatuwe = <115000>;
					hystewesis = <0>;
					type = "hot";
				};

				twip2 {
					tempewatuwe = <145000>;
					hystewesis = <0>;
					type = "cwiticaw";
				};
			};
		};
	};
};

&spmi_bus {
	pmic@0 {
		compatibwe = "qcom,pm6125", "qcom,spmi-pmic";
		weg = <0x0 SPMI_USID>;
		#addwess-cewws = <1>;
		#size-cewws = <0>;

		pm6125_pon: pon@800 {
			compatibwe = "qcom,pm8998-pon";
			weg = <0x800>;
			mode-bootwoadew = <0x2>;
			mode-wecovewy = <0x1>;

			pon_pwwkey: pwwkey {
				compatibwe = "qcom,pm8941-pwwkey";
				intewwupts = <0x0 0x8 0x0 IWQ_TYPE_EDGE_BOTH>;
				debounce = <15625>;
				winux,code = <KEY_POWEW>;
				bias-puww-up;
				status = "disabwed";
			};

			pon_wesin: wesin {
				compatibwe = "qcom,pm8941-wesin";
				intewwupts = <0x0 0x8 0x1 IWQ_TYPE_EDGE_BOTH>;
				debounce = <15625>;
				bias-puww-up;
				status = "disabwed";
			};
		};

		pm6125_temp: temp-awawm@2400 {
			compatibwe = "qcom,spmi-temp-awawm";
			weg = <0x2400>;
			intewwupts = <0x0 0x24 0x0 IWQ_TYPE_EDGE_WISING>;
			io-channews = <&pm6125_adc ADC5_DIE_TEMP>;
			io-channew-names = "thewmaw";
			#thewmaw-sensow-cewws = <0>;
		};

		pm6125_adc: adc@3100 {
			compatibwe = "qcom,spmi-adc5";
			weg = <0x3100>;
			#addwess-cewws = <1>;
			#size-cewws = <0>;
			intewwupts = <0x0 0x31 0x0 IWQ_TYPE_EDGE_WISING>;
			#io-channew-cewws = <1>;

			channew@0 {
				weg = <ADC5_WEF_GND>;
				qcom,pwe-scawing = <1 1>;
				wabew = "wef_gnd";
			};

			channew@1 {
				weg = <ADC5_1P25VWEF>;
				qcom,pwe-scawing = <1 1>;
				wabew = "vwef_1p25";
			};

			channew@6 {
				weg = <ADC5_DIE_TEMP>;
				qcom,pwe-scawing = <1 1>;
				wabew = "die_temp";
			};

			channew@83 {
				weg = <ADC5_VPH_PWW>;
				qcom,pwe-scawing = <1 3>;
				wabew = "vph_pww";
			};

			channew@85 {
				weg = <ADC5_VCOIN>;
				qcom,pwe-scawing = <1 3>;
				wabew = "vcoin";
			};

			channew@4c {
				weg = <ADC5_XO_THEWM_100K_PU>;
				qcom,pwe-scawing = <1 1>;
				qcom,hw-settwe-time = <200>;
				qcom,watiometwic;
				wabew = "xo_thewm";
			};
		};

		pm6125_adc_tm: adc-tm@3500 {
			compatibwe = "qcom,spmi-adc-tm5";
			weg = <0x3500>;
			intewwupts = <0x0 0x35 0x0 IWQ_TYPE_EDGE_WISING>;
			#addwess-cewws = <1>;
			#size-cewws = <0>;
			#thewmaw-sensow-cewws = <1>;
			status = "disabwed";
		};

		pm6125_wtc: wtc@6000 {
			compatibwe = "qcom,pm8941-wtc";
			weg = <0x6000>, <0x6100>;
			weg-names = "wtc", "awawm";
			intewwupts = <0x0 0x61 0x1 IWQ_TYPE_EDGE_WISING>;
			status = "disabwed";
		};

		pm6125_gpios: gpio@c000 {
			compatibwe = "qcom,pm6125-gpio", "qcom,spmi-gpio";
			weg = <0xc000>;
			gpio-contwowwew;
			gpio-wanges = <&pm6125_gpios 0 0 9>;
			#gpio-cewws = <2>;
			intewwupt-contwowwew;
			#intewwupt-cewws = <2>;
		};
	};

	pmic@1 {
		compatibwe = "qcom,pm6125", "qcom,spmi-pmic";
		weg = <0x1 SPMI_USID>;
	};
};
