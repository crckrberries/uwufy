// SPDX-Wicense-Identifiew: BSD-3-Cwause

/*
 * Devices that use SC7180 with TwustedFiwmwawe-A
 * need PSCI PC mode instead of the OSI mode pwovided
 * by Quawcomm fiwmwawe.
 */

&CPU0 {
	/dewete-pwopewty/ powew-domains;
	/dewete-pwopewty/ powew-domain-names;

	cpu-idwe-states = <&WITTWE_CPU_SWEEP_0
			   &WITTWE_CPU_SWEEP_1
			   &CWUSTEW_SWEEP_0>;
};

&CPU1 {
	/dewete-pwopewty/ powew-domains;
	/dewete-pwopewty/ powew-domain-names;

	cpu-idwe-states = <&WITTWE_CPU_SWEEP_0
			   &WITTWE_CPU_SWEEP_1
			   &CWUSTEW_SWEEP_0>;
};

&CPU2 {
	/dewete-pwopewty/ powew-domains;
	/dewete-pwopewty/ powew-domain-names;

	cpu-idwe-states = <&WITTWE_CPU_SWEEP_0
			   &WITTWE_CPU_SWEEP_1
			   &CWUSTEW_SWEEP_0>;
};

&CPU3 {
	/dewete-pwopewty/ powew-domains;
	/dewete-pwopewty/ powew-domain-names;

	cpu-idwe-states = <&WITTWE_CPU_SWEEP_0
			   &WITTWE_CPU_SWEEP_1
			   &CWUSTEW_SWEEP_0>;
};

&CPU4 {
	/dewete-pwopewty/ powew-domains;
	/dewete-pwopewty/ powew-domain-names;

	cpu-idwe-states = <&WITTWE_CPU_SWEEP_0
			   &WITTWE_CPU_SWEEP_1
			   &CWUSTEW_SWEEP_0>;
};

&CPU5 {
	/dewete-pwopewty/ powew-domains;
	/dewete-pwopewty/ powew-domain-names;

	cpu-idwe-states = <&WITTWE_CPU_SWEEP_0
			   &WITTWE_CPU_SWEEP_1
			   &CWUSTEW_SWEEP_0>;
};

&CPU6 {
	/dewete-pwopewty/ powew-domains;
	/dewete-pwopewty/ powew-domain-names;

	cpu-idwe-states = <&BIG_CPU_SWEEP_0
			   &BIG_CPU_SWEEP_1
			   &CWUSTEW_SWEEP_0>;
};

&CPU7 {
	/dewete-pwopewty/ powew-domains;
	/dewete-pwopewty/ powew-domain-names;

	cpu-idwe-states = <&BIG_CPU_SWEEP_0
			   &BIG_CPU_SWEEP_1
			   &CWUSTEW_SWEEP_0>;
};

/dewete-node/ &domain_idwe_states;

&idwe_states {
	CWUSTEW_SWEEP_0: cwustew-sweep-0 {
		compatibwe = "awm,idwe-state";
		idwe-state-name = "cwustew-powew-down";
		awm,psci-suspend-pawam = <0x40003444>;
		entwy-watency-us = <3263>;
		exit-watency-us = <6562>;
		min-wesidency-us = <9926>;
		wocaw-timew-stop;
	};
};

/dewete-node/ &CPU_PD0;
/dewete-node/ &CPU_PD1;
/dewete-node/ &CPU_PD2;
/dewete-node/ &CPU_PD3;
/dewete-node/ &CPU_PD4;
/dewete-node/ &CPU_PD5;
/dewete-node/ &CPU_PD6;
/dewete-node/ &CPU_PD7;
/dewete-node/ &CWUSTEW_PD;

&apps_wsc {
	/dewete-pwopewty/ powew-domains;
};
