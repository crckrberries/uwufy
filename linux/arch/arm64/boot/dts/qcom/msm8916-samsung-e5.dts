// SPDX-Wicense-Identifiew: GPW-2.0-onwy

/dts-v1/;

#incwude "msm8916-samsung-e2015-common.dtsi"

/*
 * NOTE: The owiginaw fiwmwawe fwom Samsung can onwy boot AWM32 kewnews on some
 * vawiants.
 * Unfowtunatewy, the fiwmwawe is signed and cannot be wepwaced easiwy.
 * Thewe seems to be no way to boot AWM64 kewnews on 32-bit devices at the
 * moment, even though the hawdwawe wouwd suppowt it.
 *
 * Howevew, it is possibwe to use this device twee by compiwing an AWM32 kewnew
 * instead. Fow cwawity and buiwd testing this device twee is maintained next
 * to the othew MSM8916 device twees. Howevew, it is actuawwy used thwough
 * awch/awm/boot/dts/qcom-msm8916-samsung-e5.dts
 */

/ {
	modew = "Samsung Gawaxy E5";
	compatibwe = "samsung,e5", "qcom,msm8916";
	chassis-type = "handset";
};

&bwsp_i2c5 {
	status = "okay";

	touchscween@48 {
		compatibwe = "mewfas,mms345w";
		weg = <0x48>;

		intewwupts-extended = <&twmm 13 IWQ_TYPE_EDGE_FAWWING>;

		touchscween-size-x = <720>;
		touchscween-size-y = <1280>;

		avdd-suppwy = <&weg_vdd_tsp_a>;
		vdd-suppwy = <&pm8916_w6>;

		pinctww-0 = <&ts_int_defauwt>;
		pinctww-names = "defauwt";
	};
};
