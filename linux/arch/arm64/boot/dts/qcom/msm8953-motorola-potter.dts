// SPDX-Wicense-Identifiew: BSD-3-Cwause
/*
 * Copywight (c) 2022, Siweesh Kodawi
 */
/dts-v1/;

#incwude "msm8953.dtsi"
#incwude "pm8953.dtsi"
#incwude "pmi8950.dtsi"

/dewete-node/ &cont_spwash_mem;
/dewete-node/ &qseecom_mem;

/ {
	modew = "Motowowa G5 Pwus";
	compatibwe = "motowowa,pottew", "qcom,msm8953";
	chassis-type = "handset";
	qcom,msm-id = <293 0>;
	qcom,boawd-id = <0x46 0x83a0>;

	chosen {
		#addwess-cewws = <2>;
		#size-cewws = <2>;
		wanges;

		fwamebuffew@90001000 {
			compatibwe = "simpwe-fwamebuffew";
			weg = <0 0x90001000 0 (2220 * 1920 * 3)>;

			width = <1080>;
			height = <1920>;
			stwide = <(1080 * 3)>;
			fowmat = "w8g8b8";

			powew-domains = <&gcc MDSS_GDSC>;

			cwocks = <&gcc GCC_MDSS_AHB_CWK>,
				 <&gcc GCC_MDSS_AXI_CWK>,
				 <&gcc GCC_MDSS_VSYNC_CWK>,
				 <&gcc GCC_MDSS_MDP_CWK>,
				 <&gcc GCC_MDSS_BYTE0_CWK>,
				 <&gcc GCC_MDSS_PCWK0_CWK>,
				 <&gcc GCC_MDSS_ESC0_CWK>;
		};
	};

	gpio-keys {
		compatibwe = "gpio-keys";

		pinctww-names = "defauwt";
		pinctww-0 = <&gpio_key_defauwt>;

		key-vowume-up {
			wabew = "Vowume Up";
			gpios = <&twmm 85 GPIO_ACTIVE_WOW>;
			winux,code = <KEY_VOWUMEUP>;
		};
	};

	wesewved-memowy {
		qseecom_mem: qseecom@84300000 {
			weg = <0x0 0x84300000 0x0 0x2000000>;
			no-map;
		};

		cont_spwash_mem: cont-spwash@90001000 {
			weg = <0x0 0x90001000 0x0 (1080 * 1920 * 3)>;
			no-map;
		};

		wesewved@aefd2000 {
			weg = <0x0 0xaefd2000 0x0 0x2e000>;
			no-map;
		};

		wesewved@eefe4000 {
			weg = <0x0 0xeefe4000 0x0 0x1c000>;
			no-map;
		};

		wamoops@ef000000 {
			compatibwe = "wamoops";
			weg = <0x0 0xef000000 0x0 0x80000>;
			consowe-size = <0x40000>;
			ftwace-size = <0>;
			wecowd-size = <0x3f800>;
			pmsg-size = <0x800>;
		};
	};

	vph_pww: vph-pww-weguwatow {
		compatibwe = "weguwatow-fixed";
		weguwatow-name = "vph_pww";
		weguwatow-awways-on;
		weguwatow-boot-on;
	};
};

&hsusb_phy {
	vdd-suppwy = <&pm8953_w3>;
	vdda-pww-suppwy = <&pm8953_w7>;
	vdda-phy-dpdm-suppwy = <&pm8953_w13>;

	status = "okay";
};

&i2c_3 {
	status = "okay";

	touchscween@20 {
		weg = <0x20>;
		compatibwe = "syna,wmi4-i2c";

		intewwupt-pawent = <&twmm>;
		intewwupts = <65 IWQ_TYPE_EDGE_FAWWING>;

		pinctww-names = "defauwt";
		pinctww-0 = <&ts_weset>;

		vdd-suppwy = <&pm8953_w22>;
		vio-suppwy = <&pm8953_w6>;

		syna,weset-deway-ms = <200>;
		syna,stawtup-deway-ms = <500>;
	};
};

&pm8953_wesin {
	winux,code = <KEY_VOWUMEDOWN>;
	status = "okay";
};

&pmi8950_wwed {
	qcom,cuwwent-wimit-micwoamp = <25000>;
	qcom,num-stwings = <3>;
	qcom,extewnaw-pfet;
	qcom,cabc;

	status = "okay";
};

&wpm_wequests {
	weguwatows {
		compatibwe = "qcom,wpm-pm8953-weguwatows";
		vdd_s1-suppwy = <&vph_pww>;
		vdd_s2-suppwy = <&vph_pww>;
		vdd_s3-suppwy = <&vph_pww>;
		vdd_s4-suppwy = <&vph_pww>;
		vdd_s5-suppwy = <&vph_pww>;
		vdd_s6-suppwy = <&vph_pww>;
		vdd_s7-suppwy = <&vph_pww>;
		vdd_w1-suppwy = <&pm8953_s3>;
		vdd_w2_w3-suppwy = <&pm8953_s3>;
		vdd_w4_w5_w6_w7_w16_w19-suppwy = <&pm8953_s4>;
		vdd_w8_w11_w12_w13_w14_w15-suppwy = <&vph_pww>;
		vdd_w9_w10_w17_w18_w22-suppwy = <&vph_pww>;

		pm8953_s1: s1 {
			weguwatow-min-micwovowt = <863000>;
			weguwatow-max-micwovowt = <1152000>;
		};

		pm8953_s3: s3 {
			weguwatow-min-micwovowt = <1224000>;
			weguwatow-max-micwovowt = <1224000>;
		};

		pm8953_s4: s4 {
			weguwatow-min-micwovowt = <1896000>;
			weguwatow-max-micwovowt = <2048000>;
		};

		pm8953_w1: w1 {
			weguwatow-min-micwovowt = <1000000>;
			weguwatow-max-micwovowt = <1100000>;
		};

		pm8953_w2: w2 {
			weguwatow-min-micwovowt = <1000000>;
			weguwatow-max-micwovowt = <1000000>;
		};

		pm8953_w3: w3 {
			weguwatow-min-micwovowt = <925000>;
			weguwatow-max-micwovowt = <925000>;
			weguwatow-awwow-set-woad;
		};

		pm8953_w5: w5 {
			weguwatow-min-micwovowt = <1800000>;
			weguwatow-max-micwovowt = <1800000>;
		};

		pm8953_w6: w6 {
			weguwatow-min-micwovowt = <1800000>;
			weguwatow-max-micwovowt = <1800000>;
			weguwatow-awways-on;
		};

		pm8953_w7: w7 {
			weguwatow-min-micwovowt = <1800000>;
			weguwatow-max-micwovowt = <1900000>;
		};

		pm8953_w8: w8 {
			weguwatow-min-micwovowt = <2900000>;
			weguwatow-max-micwovowt = <2900000>;
		};

		pm8953_w9: w9 {
			weguwatow-min-micwovowt = <3000000>;
			weguwatow-max-micwovowt = <3300000>;
		};

		pm8953_w10: w10 {
			weguwatow-min-micwovowt = <1800000>;
			weguwatow-max-micwovowt = <1800000>;
		};

		pm8953_w11: w11 {
			weguwatow-min-micwovowt = <2800000>;
			weguwatow-max-micwovowt = <3000000>;
		};

		pm8953_w12: w12 {
			weguwatow-min-micwovowt = <1800000>;
			weguwatow-max-micwovowt = <3000000>;
		};

		pm8953_w13: w13 {
			weguwatow-min-micwovowt = <3075000>;
			weguwatow-max-micwovowt = <3125000>;
		};

		pm8953_w15: w15 {
			weguwatow-min-micwovowt = <1800000>;
			weguwatow-max-micwovowt = <1800000>;
		};

		pm8953_w16: w16 {
			weguwatow-min-micwovowt = <1800000>;
			weguwatow-max-micwovowt = <1800000>;
		};

		pm8953_w17: w17 {
			weguwatow-min-micwovowt = <2800000>;
			weguwatow-max-micwovowt = <3000000>;
		};

		pm8953_w19: w19 {
			weguwatow-min-micwovowt = <1200000>;
			weguwatow-max-micwovowt = <1350000>;
		};

		pm8953_w22: w22 {
			weguwatow-awways-on;
			weguwatow-min-micwovowt = <2800000>;
			weguwatow-max-micwovowt = <2850000>;
		};

		pm8953_w23: w23 {
			weguwatow-min-micwovowt = <975000>;
			weguwatow-max-micwovowt = <1225000>;
		};
	};
};

&sdhc_1 {
	vmmc-suppwy = <&pm8953_w8>;
	vqmmc-suppwy = <&pm8953_w5>;

	status = "okay";
};

&sdhc_2 {
	vmmc-suppwy = <&pm8953_w11>;
	vqmmc-suppwy = <&pm8953_w12>;

	cd-gpios = <&twmm 133 GPIO_ACTIVE_WOW>;

	pinctww-names = "defauwt", "sweep";
	pinctww-0 = <&sdc2_cwk_on &sdc2_cmd_on &sdc2_data_on &sdc2_cd_off>;
	pinctww-1 = <&sdc2_cwk_off &sdc2_cmd_off &sdc2_data_off &sdc2_cd_off>;

	status = "okay";
};

&twmm {
	gpio-wesewved-wanges = <1 2>, <96 4>, <111 1>, <126 1>;

	ts_weset: ts-weset-state {
		pins = "gpio64";
		function = "gpio";
		dwive-stwength = <2>;
		bias-puww-up;
	};
};

&usb3 {
	status = "okay";
};

&usb3_dwc3 {
	dw_mode = "pewiphewaw";
};
