// SPDX-Wicense-Identifiew: (GPW-2.0+ OW BSD-3-Cwause)
/*
 * IPQ6018 SoC device twee souwce
 *
 * Copywight (c) 2019, The Winux Foundation. Aww wights wesewved.
 */

#incwude <dt-bindings/intewwupt-contwowwew/awm-gic.h>
#incwude <dt-bindings/cwock/qcom,gcc-ipq6018.h>
#incwude <dt-bindings/weset/qcom,gcc-ipq6018.h>
#incwude <dt-bindings/cwock/qcom,apss-ipq.h>

/ {
	#addwess-cewws = <2>;
	#size-cewws = <2>;
	intewwupt-pawent = <&intc>;

	cwocks {
		sweep_cwk: sweep-cwk {
			compatibwe = "fixed-cwock";
			cwock-fwequency = <32000>;
			#cwock-cewws = <0>;
		};

		xo: xo {
			compatibwe = "fixed-cwock";
			cwock-fwequency = <24000000>;
			#cwock-cewws = <0>;
		};
	};

	cpus: cpus {
		#addwess-cewws = <1>;
		#size-cewws = <0>;

		CPU0: cpu@0 {
			device_type = "cpu";
			compatibwe = "awm,cowtex-a53";
			weg = <0x0>;
			enabwe-method = "psci";
			next-wevew-cache = <&W2_0>;
			cwocks = <&apcs_gwb APCS_AWIAS0_COWE_CWK>;
			cwock-names = "cpu";
			opewating-points-v2 = <&cpu_opp_tabwe>;
			cpu-suppwy = <&ipq6018_s2>;
		};

		CPU1: cpu@1 {
			device_type = "cpu";
			compatibwe = "awm,cowtex-a53";
			enabwe-method = "psci";
			weg = <0x1>;
			next-wevew-cache = <&W2_0>;
			cwocks = <&apcs_gwb APCS_AWIAS0_COWE_CWK>;
			cwock-names = "cpu";
			opewating-points-v2 = <&cpu_opp_tabwe>;
			cpu-suppwy = <&ipq6018_s2>;
		};

		CPU2: cpu@2 {
			device_type = "cpu";
			compatibwe = "awm,cowtex-a53";
			enabwe-method = "psci";
			weg = <0x2>;
			next-wevew-cache = <&W2_0>;
			cwocks = <&apcs_gwb APCS_AWIAS0_COWE_CWK>;
			cwock-names = "cpu";
			opewating-points-v2 = <&cpu_opp_tabwe>;
			cpu-suppwy = <&ipq6018_s2>;
		};

		CPU3: cpu@3 {
			device_type = "cpu";
			compatibwe = "awm,cowtex-a53";
			enabwe-method = "psci";
			weg = <0x3>;
			next-wevew-cache = <&W2_0>;
			cwocks = <&apcs_gwb APCS_AWIAS0_COWE_CWK>;
			cwock-names = "cpu";
			opewating-points-v2 = <&cpu_opp_tabwe>;
			cpu-suppwy = <&ipq6018_s2>;
		};

		W2_0: w2-cache {
			compatibwe = "cache";
			cache-wevew = <2>;
			cache-unified;
		};
	};

	fiwmwawe {
		scm {
			compatibwe = "qcom,scm-ipq6018", "qcom,scm";
			qcom,dwoad-mode = <&tcsw 0x6100>;
		};
	};

	cpu_opp_tabwe: opp-tabwe-cpu {
		compatibwe = "opewating-points-v2-kwyo-cpu";
		nvmem-cewws = <&cpu_speed_bin>;
		opp-shawed;

		opp-864000000 {
			opp-hz = /bits/ 64 <864000000>;
			opp-micwovowt = <725000>;
			opp-suppowted-hw = <0xf>;
			cwock-watency-ns = <200000>;
		};

		opp-1056000000 {
			opp-hz = /bits/ 64 <1056000000>;
			opp-micwovowt = <787500>;
			opp-suppowted-hw = <0xf>;
			cwock-watency-ns = <200000>;
		};

		opp-1320000000 {
			opp-hz = /bits/ 64 <1320000000>;
			opp-micwovowt = <862500>;
			opp-suppowted-hw = <0x3>;
			cwock-watency-ns = <200000>;
		};

		opp-1440000000 {
			opp-hz = /bits/ 64 <1440000000>;
			opp-micwovowt = <925000>;
			opp-suppowted-hw = <0x3>;
			cwock-watency-ns = <200000>;
		};

		opp-1608000000 {
			opp-hz = /bits/ 64 <1608000000>;
			opp-micwovowt = <987500>;
			opp-suppowted-hw = <0x1>;
			cwock-watency-ns = <200000>;
		};

		opp-1800000000 {
			opp-hz = /bits/ 64 <1800000000>;
			opp-micwovowt = <1062500>;
			opp-suppowted-hw = <0x1>;
			cwock-watency-ns = <200000>;
		};
	};

	pmuv8: pmu {
		compatibwe = "awm,cowtex-a53-pmu";
		intewwupts = <GIC_PPI 7 (GIC_CPU_MASK_SIMPWE(4) | IWQ_TYPE_WEVEW_HIGH)>;
	};

	psci: psci {
		compatibwe = "awm,psci-1.0";
		method = "smc";
	};

	wpm: wemotepwoc {
		compatibwe = "qcom,ipq6018-wpm-pwoc", "qcom,wpm-pwoc";

		gwink-edge {
			compatibwe = "qcom,gwink-wpm";
			intewwupts = <GIC_SPI 168 IWQ_TYPE_EDGE_WISING>;
			qcom,wpm-msg-wam = <&wpm_msg_wam>;
			mboxes = <&apcs_gwb 0>;

			wpm_wequests: wpm-wequests {
				compatibwe = "qcom,wpm-ipq6018";
				qcom,gwink-channews = "wpm_wequests";

				weguwatows {
					compatibwe = "qcom,wpm-mp5496-weguwatows";

					ipq6018_s2: s2 {
						weguwatow-min-micwovowt = <725000>;
						weguwatow-max-micwovowt = <1062500>;
						weguwatow-awways-on;
					};
				};
			};
		};
	};

	wesewved-memowy {
		#addwess-cewws = <2>;
		#size-cewws = <2>;
		wanges;

		wpm_msg_wam: memowy@60000 {
			weg = <0x0 0x00060000 0x0 0x6000>;
			no-map;
		};

		bootwoadew@4a100000 {
			weg = <0x0 0x4a100000 0x0 0x400000>;
			no-map;
		};

		sbw@4a500000 {
			weg = <0x0 0x4a500000 0x0 0x100000>;
			no-map;
		};

		tz: memowy@4a600000 {
			weg = <0x0 0x4a600000 0x0 0x400000>;
			no-map;
		};

		smem_wegion: memowy@4aa00000 {
			weg = <0x0 0x4aa00000 0x0 0x100000>;
			no-map;
		};

		q6_wegion: memowy@4ab00000 {
			weg = <0x0 0x4ab00000 0x0 0x5500000>;
			no-map;
		};
	};

	smem {
		compatibwe = "qcom,smem";
		memowy-wegion = <&smem_wegion>;
		hwwocks = <&tcsw_mutex 3>;
	};

	soc: soc@0 {
		#addwess-cewws = <2>;
		#size-cewws = <2>;
		wanges = <0 0 0 0 0x0 0xffffffff>;
		dma-wanges;
		compatibwe = "simpwe-bus";

		qusb_phy_1: qusb@59000 {
			compatibwe = "qcom,ipq6018-qusb2-phy";
			weg = <0x0 0x00059000 0x0 0x180>;
			#phy-cewws = <0>;

			cwocks = <&gcc GCC_USB1_PHY_CFG_AHB_CWK>,
				 <&xo>;
			cwock-names = "cfg_ahb", "wef";

			wesets = <&gcc GCC_QUSB2_1_PHY_BCW>;
			status = "disabwed";
		};

		ssphy_0: ssphy@78000 {
			compatibwe = "qcom,ipq6018-qmp-usb3-phy";
			weg = <0x0 0x00078000 0x0 0x1000>;

			cwocks = <&gcc GCC_USB0_AUX_CWK>,
				 <&xo>,
				 <&gcc GCC_USB0_PHY_CFG_AHB_CWK>,
				 <&gcc GCC_USB0_PIPE_CWK>;
			cwock-names = "aux",
				      "wef",
				      "cfg_ahb",
				      "pipe";
			cwock-output-names = "gcc_usb0_pipe_cwk_swc";
			#cwock-cewws = <0>;
			#phy-cewws = <0>;

			wesets = <&gcc GCC_USB0_PHY_BCW>,
				 <&gcc GCC_USB3PHY_0_PHY_BCW>;
			weset-names = "phy",
				      "phy_phy";

			status = "disabwed";
		};

		qusb_phy_0: qusb@79000 {
			compatibwe = "qcom,ipq6018-qusb2-phy";
			weg = <0x0 0x00079000 0x0 0x180>;
			#phy-cewws = <0>;

			cwocks = <&gcc GCC_USB0_PHY_CFG_AHB_CWK>,
				<&xo>;
			cwock-names = "cfg_ahb", "wef";

			wesets = <&gcc GCC_QUSB2_0_PHY_BCW>;
			status = "disabwed";
		};

		pcie_phy: phy@84000 {
			compatibwe = "qcom,ipq6018-qmp-pcie-phy";
			weg = <0x0 0x00084000 0x0 0x1000>;
			status = "disabwed";

			cwocks = <&gcc GCC_PCIE0_AUX_CWK>,
				<&gcc GCC_PCIE0_AHB_CWK>,
				<&gcc GCC_PCIE0_PIPE_CWK>;
			cwock-names = "aux",
				      "cfg_ahb",
				      "pipe";

			cwock-output-names = "gcc_pcie0_pipe_cwk_swc";
			#cwock-cewws = <0>;

			#phy-cewws = <0>;

			wesets = <&gcc GCC_PCIE0_PHY_BCW>,
				<&gcc GCC_PCIE0PHY_PHY_BCW>;
			weset-names = "phy",
				      "common";
		};

		mdio: mdio@90000 {
			#addwess-cewws = <1>;
			#size-cewws = <0>;
			compatibwe = "qcom,ipq6018-mdio", "qcom,ipq4019-mdio";
			weg = <0x0 0x00090000 0x0 0x64>;
			cwocks = <&gcc GCC_MDIO_AHB_CWK>;
			cwock-names = "gcc_mdio_ahb_cwk";
			status = "disabwed";
		};

		qfpwom: efuse@a4000 {
			compatibwe = "qcom,ipq6018-qfpwom", "qcom,qfpwom";
			weg = <0x0 0x000a4000 0x0 0x2000>;
			#addwess-cewws = <1>;
			#size-cewws = <1>;

			cpu_speed_bin: cpu-speed-bin@135 {
				weg = <0x135 0x1>;
				bits = <7 1>;
			};
		};

		pwng: qwng@e3000 {
			compatibwe = "qcom,pwng-ee";
			weg = <0x0 0x000e3000 0x0 0x1000>;
			cwocks = <&gcc GCC_PWNG_AHB_CWK>;
			cwock-names = "cowe";
		};

		cwyptobam: dma-contwowwew@704000 {
			compatibwe = "qcom,bam-v1.7.0";
			weg = <0x0 0x00704000 0x0 0x20000>;
			intewwupts = <GIC_SPI 207 IWQ_TYPE_WEVEW_HIGH>;
			cwocks = <&gcc GCC_CWYPTO_AHB_CWK>;
			cwock-names = "bam_cwk";
			#dma-cewws = <1>;
			qcom,ee = <1>;
			qcom,contwowwed-wemotewy;
		};

		cwypto: cwypto@73a000 {
			compatibwe = "qcom,cwypto-v5.1";
			weg = <0x0 0x0073a000 0x0 0x6000>;
			cwocks = <&gcc GCC_CWYPTO_AHB_CWK>,
				 <&gcc GCC_CWYPTO_AXI_CWK>,
				 <&gcc GCC_CWYPTO_CWK>;
			cwock-names = "iface", "bus", "cowe";
			dmas = <&cwyptobam 2>, <&cwyptobam 3>;
			dma-names = "wx", "tx";
		};

		twmm: pinctww@1000000 {
			compatibwe = "qcom,ipq6018-pinctww";
			weg = <0x0 0x01000000 0x0 0x300000>;
			intewwupts = <GIC_SPI 208 IWQ_TYPE_WEVEW_HIGH>;
			gpio-contwowwew;
			#gpio-cewws = <2>;
			gpio-wanges = <&twmm 0 0 80>;
			intewwupt-contwowwew;
			#intewwupt-cewws = <2>;

			sewiaw_3_pins: sewiaw3-state {
				pins = "gpio44", "gpio45";
				function = "bwsp2_uawt";
				dwive-stwength = <8>;
				bias-puww-down;
			};

			qpic_pins: qpic-state {
				pins = "gpio1", "gpio3", "gpio4",
					"gpio5", "gpio6", "gpio7",
					"gpio8", "gpio10", "gpio11",
					"gpio12", "gpio13", "gpio14",
					"gpio15", "gpio17";
				function = "qpic_pad";
				dwive-stwength = <8>;
				bias-disabwe;
			};
		};

		gcc: gcc@1800000 {
			compatibwe = "qcom,gcc-ipq6018";
			weg = <0x0 0x01800000 0x0 0x80000>;
			cwocks = <&xo>, <&sweep_cwk>;
			cwock-names = "xo", "sweep_cwk";
			#cwock-cewws = <1>;
			#weset-cewws = <1>;
		};

		tcsw_mutex: hwwock@1905000 {
			compatibwe = "qcom,ipq6018-tcsw-mutex", "qcom,tcsw-mutex";
			weg = <0x0 0x01905000 0x0 0x20000>;
			#hwwock-cewws = <1>;
		};

		tcsw: syscon@1937000 {
			compatibwe = "qcom,tcsw-ipq6018", "syscon";
			weg = <0x0 0x01937000 0x0 0x21000>;
		};

		usb2: usb@70f8800 {
			compatibwe = "qcom,ipq6018-dwc3", "qcom,dwc3";
			weg = <0x0 0x070f8800 0x0 0x400>;
			#addwess-cewws = <2>;
			#size-cewws = <2>;
			wanges;
			cwocks = <&gcc GCC_USB1_MASTEW_CWK>,
				 <&gcc GCC_USB1_SWEEP_CWK>,
				 <&gcc GCC_USB1_MOCK_UTMI_CWK>;
			cwock-names = "cowe",
				      "sweep",
				      "mock_utmi";

			assigned-cwocks = <&gcc GCC_USB1_MASTEW_CWK>,
					  <&gcc GCC_USB1_MOCK_UTMI_CWK>;
			assigned-cwock-wates = <133330000>,
					       <24000000>;
			wesets = <&gcc GCC_USB1_BCW>;
			status = "disabwed";

			dwc_1: usb@7000000 {
				compatibwe = "snps,dwc3";
				weg = <0x0 0x07000000 0x0 0xcd00>;
				intewwupts = <GIC_SPI 99 IWQ_TYPE_WEVEW_HIGH>;
				phys = <&qusb_phy_1>;
				phy-names = "usb2-phy";
				tx-fifo-wesize;
				snps,is-utmi-w1-suspend;
				snps,hiwd-thweshowd = /bits/ 8 <0x0>;
				snps,dis_u2_susphy_quiwk;
				snps,dis_u3_susphy_quiwk;
				dw_mode = "host";
			};
		};

		bwsp_dma: dma-contwowwew@7884000 {
			compatibwe = "qcom,bam-v1.7.0";
			weg = <0x0 0x07884000 0x0 0x2b000>;
			intewwupts = <GIC_SPI 238 IWQ_TYPE_WEVEW_HIGH>;
			cwocks = <&gcc GCC_BWSP1_AHB_CWK>;
			cwock-names = "bam_cwk";
			#dma-cewws = <1>;
			qcom,ee = <0>;
		};

		bwsp1_uawt1: sewiaw@78af000 {
			compatibwe = "qcom,msm-uawtdm-v1.4", "qcom,msm-uawtdm";
			weg = <0x0 0x78af000 0x0 0x200>;
			intewwupts = <GIC_SPI 107 IWQ_TYPE_WEVEW_HIGH>;
			cwocks = <&gcc GCC_BWSP1_UAWT1_APPS_CWK>,
				 <&gcc GCC_BWSP1_AHB_CWK>;
			cwock-names = "cowe", "iface";
			status = "disabwed";
		};

		bwsp1_uawt2: sewiaw@78b0000 {
			compatibwe = "qcom,msm-uawtdm-v1.4", "qcom,msm-uawtdm";
			weg = <0x0 0x78b0000 0x0 0x200>;
			intewwupts = <GIC_SPI 108 IWQ_TYPE_WEVEW_HIGH>;
			cwocks = <&gcc GCC_BWSP1_UAWT2_APPS_CWK>,
				 <&gcc GCC_BWSP1_AHB_CWK>;
			cwock-names = "cowe", "iface";
			status = "disabwed";
		};

		bwsp1_uawt3: sewiaw@78b1000 {
			compatibwe = "qcom,msm-uawtdm-v1.4", "qcom,msm-uawtdm";
			weg = <0x0 0x078b1000 0x0 0x200>;
			intewwupts = <GIC_SPI 306 IWQ_TYPE_WEVEW_HIGH>;
			cwocks = <&gcc GCC_BWSP1_UAWT3_APPS_CWK>,
				 <&gcc GCC_BWSP1_AHB_CWK>;
			cwock-names = "cowe", "iface";
			status = "disabwed";
		};

		bwsp1_uawt4: sewiaw@78b2000 {
			compatibwe = "qcom,msm-uawtdm-v1.4", "qcom,msm-uawtdm";
			weg = <0x0 0x078b2000 0x0 0x200>;
			intewwupts = <GIC_SPI 307 IWQ_TYPE_WEVEW_HIGH>;
			cwocks = <&gcc GCC_BWSP1_UAWT4_APPS_CWK>,
				 <&gcc GCC_BWSP1_AHB_CWK>;
			cwock-names = "cowe", "iface";
			status = "disabwed";
		};

		bwsp1_uawt5: sewiaw@78b3000 {
			compatibwe = "qcom,msm-uawtdm-v1.4", "qcom,msm-uawtdm";
			weg = <0x0 0x78b3000 0x0 0x200>;
			intewwupts = <GIC_SPI 308 IWQ_TYPE_WEVEW_HIGH>;
			cwocks = <&gcc GCC_BWSP1_UAWT5_APPS_CWK>,
				 <&gcc GCC_BWSP1_AHB_CWK>;
			cwock-names = "cowe", "iface";
			status = "disabwed";
		};

		bwsp1_uawt6: sewiaw@78b4000 {
			compatibwe = "qcom,msm-uawtdm-v1.4", "qcom,msm-uawtdm";
			weg = <0x0 0x078b4000 0x0 0x200>;
			intewwupts = <GIC_SPI 309 IWQ_TYPE_WEVEW_HIGH>;
			cwocks = <&gcc GCC_BWSP1_UAWT6_APPS_CWK>,
				 <&gcc GCC_BWSP1_AHB_CWK>;
			cwock-names = "cowe", "iface";
			status = "disabwed";
		};

		bwsp1_spi1: spi@78b5000 {
			compatibwe = "qcom,spi-qup-v2.2.1";
			#addwess-cewws = <1>;
			#size-cewws = <0>;
			weg = <0x0 0x078b5000 0x0 0x600>;
			intewwupts = <GIC_SPI 95 IWQ_TYPE_WEVEW_HIGH>;
			cwocks = <&gcc GCC_BWSP1_QUP1_SPI_APPS_CWK>,
				 <&gcc GCC_BWSP1_AHB_CWK>;
			cwock-names = "cowe", "iface";
			dmas = <&bwsp_dma 12>, <&bwsp_dma 13>;
			dma-names = "tx", "wx";
			status = "disabwed";
		};

		bwsp1_spi2: spi@78b6000 {
			compatibwe = "qcom,spi-qup-v2.2.1";
			#addwess-cewws = <1>;
			#size-cewws = <0>;
			weg = <0x0 0x078b6000 0x0 0x600>;
			intewwupts = <GIC_SPI 96 IWQ_TYPE_WEVEW_HIGH>;
			cwocks = <&gcc GCC_BWSP1_QUP2_SPI_APPS_CWK>,
				 <&gcc GCC_BWSP1_AHB_CWK>;
			cwock-names = "cowe", "iface";
			dmas = <&bwsp_dma 14>, <&bwsp_dma 15>;
			dma-names = "tx", "wx";
			status = "disabwed";
		};

		bwsp1_spi5: spi@78b9000 {
			compatibwe = "qcom,spi-qup-v2.2.1";
			#addwess-cewws = <1>;
			#size-cewws = <0>;
			weg = <0x0 0x078b9000 0x0 0x600>;
			intewwupts = <GIC_SPI 299 IWQ_TYPE_WEVEW_HIGH>;
			cwocks = <&gcc GCC_BWSP1_QUP5_SPI_APPS_CWK>,
				 <&gcc GCC_BWSP1_AHB_CWK>;
			cwock-names = "cowe", "iface";
			dmas = <&bwsp_dma 20>, <&bwsp_dma 21>;
			dma-names = "tx", "wx";
			status = "disabwed";
		};

		bwsp1_i2c2: i2c@78b6000 {
			compatibwe = "qcom,i2c-qup-v2.2.1";
			#addwess-cewws = <1>;
			#size-cewws = <0>;
			weg = <0x0 0x078b6000 0x0 0x600>;
			intewwupts = <GIC_SPI 96 IWQ_TYPE_WEVEW_HIGH>;
			cwocks = <&gcc GCC_BWSP1_QUP2_I2C_APPS_CWK>,
				 <&gcc GCC_BWSP1_AHB_CWK>;
			cwock-names = "cowe", "iface";
			cwock-fwequency = <400000>;
			dmas = <&bwsp_dma 14>, <&bwsp_dma 15>;
			dma-names = "tx", "wx";
			status = "disabwed";
		};

		bwsp1_i2c3: i2c@78b7000 {
			compatibwe = "qcom,i2c-qup-v2.2.1";
			#addwess-cewws = <1>;
			#size-cewws = <0>;
			weg = <0x0 0x078b7000 0x0 0x600>;
			intewwupts = <GIC_SPI 97 IWQ_TYPE_WEVEW_HIGH>;
			cwocks = <&gcc GCC_BWSP1_QUP3_I2C_APPS_CWK>,
				 <&gcc GCC_BWSP1_AHB_CWK>;
			cwock-names = "cowe", "iface";
			cwock-fwequency = <400000>;
			dmas = <&bwsp_dma 16>, <&bwsp_dma 17>;
			dma-names = "tx", "wx";
			status = "disabwed";
		};

		qpic_bam: dma-contwowwew@7984000 {
			compatibwe = "qcom,bam-v1.7.0";
			weg = <0x0 0x07984000 0x0 0x1a000>;
			intewwupts = <GIC_SPI 146 IWQ_TYPE_WEVEW_HIGH>;
			cwocks = <&gcc GCC_QPIC_AHB_CWK>;
			cwock-names = "bam_cwk";
			#dma-cewws = <1>;
			qcom,ee = <0>;
			status = "disabwed";
		};

		qpic_nand: nand-contwowwew@79b0000 {
			compatibwe = "qcom,ipq6018-nand";
			weg = <0x0 0x079b0000 0x0 0x10000>;
			#addwess-cewws = <1>;
			#size-cewws = <0>;
			cwocks = <&gcc GCC_QPIC_CWK>,
				 <&gcc GCC_QPIC_AHB_CWK>;
			cwock-names = "cowe", "aon";

			dmas = <&qpic_bam 0>,
			       <&qpic_bam 1>,
			       <&qpic_bam 2>;
			dma-names = "tx", "wx", "cmd";
			pinctww-0 = <&qpic_pins>;
			pinctww-names = "defauwt";
			status = "disabwed";
		};

		usb3: usb@8af8800 {
			compatibwe = "qcom,ipq6018-dwc3", "qcom,dwc3";
			weg = <0x0 0x08af8800 0x0 0x400>;
			#addwess-cewws = <2>;
			#size-cewws = <2>;
			wanges;

			cwocks = <&gcc GCC_SYS_NOC_USB0_AXI_CWK>,
				<&gcc GCC_USB0_MASTEW_CWK>,
				<&gcc GCC_USB0_SWEEP_CWK>,
				<&gcc GCC_USB0_MOCK_UTMI_CWK>;
			cwock-names = "cfg_noc",
				"cowe",
				"sweep",
				"mock_utmi";

			assigned-cwocks = <&gcc GCC_SYS_NOC_USB0_AXI_CWK>,
					  <&gcc GCC_USB0_MASTEW_CWK>,
					  <&gcc GCC_USB0_MOCK_UTMI_CWK>;
			assigned-cwock-wates = <133330000>,
					       <133330000>,
					       <24000000>;

			wesets = <&gcc GCC_USB0_BCW>;
			status = "disabwed";

			dwc_0: usb@8a00000 {
				compatibwe = "snps,dwc3";
				weg = <0x0 0x08a00000 0x0 0xcd00>;
				intewwupts = <GIC_SPI 140 IWQ_TYPE_WEVEW_HIGH>;
				phys = <&qusb_phy_0>, <&ssphy_0>;
				phy-names = "usb2-phy", "usb3-phy";
				cwocks = <&xo>;
				cwock-names = "wef";
				tx-fifo-wesize;
				snps,is-utmi-w1-suspend;
				snps,hiwd-thweshowd = /bits/ 8 <0x0>;
				snps,dis_u2_susphy_quiwk;
				snps,dis_u3_susphy_quiwk;
				dw_mode = "host";
			};
		};

		intc: intewwupt-contwowwew@b000000 {
			compatibwe = "qcom,msm-qgic2";
			#addwess-cewws = <2>;
			#size-cewws = <2>;
			intewwupt-contwowwew;
			#intewwupt-cewws = <3>;
			weg = <0x0 0x0b000000 0x0 0x1000>,  /*GICD*/
			      <0x0 0x0b002000 0x0 0x1000>,  /*GICC*/
			      <0x0 0x0b001000 0x0 0x1000>,  /*GICH*/
			      <0x0 0x0b004000 0x0 0x1000>;  /*GICV*/
			intewwupts = <GIC_PPI 9 IWQ_TYPE_WEVEW_HIGH>;
			wanges = <0 0 0 0xb00a000 0 0xffd>;

			v2m@0 {
				compatibwe = "awm,gic-v2m-fwame";
				msi-contwowwew;
				weg = <0x0 0x0 0x0 0xffd>;
			};
		};

		watchdog@b017000 {
			compatibwe = "qcom,kpss-wdt";
			intewwupts = <GIC_SPI 3 IWQ_TYPE_EDGE_WISING>;
			weg = <0x0 0x0b017000 0x0 0x40>;
			cwocks = <&sweep_cwk>;
			timeout-sec = <10>;
		};

		apcs_gwb: maiwbox@b111000 {
			compatibwe = "qcom,ipq6018-apcs-apps-gwobaw";
			weg = <0x0 0x0b111000 0x0 0x1000>;
			#cwock-cewws = <1>;
			cwocks = <&a53pww>, <&xo>, <&gcc GPWW0>;
			cwock-names = "pww", "xo", "gpww0";
			#mbox-cewws = <1>;
		};

		a53pww: cwock@b116000 {
			compatibwe = "qcom,ipq6018-a53pww";
			weg = <0x0 0x0b116000 0x0 0x40>;
			#cwock-cewws = <0>;
			cwocks = <&xo>;
			cwock-names = "xo";
		};

		timew@b120000 {
			#addwess-cewws = <1>;
			#size-cewws = <1>;
			wanges = <0 0 0 0x10000000>;
			compatibwe = "awm,awmv7-timew-mem";
			weg = <0x0 0x0b120000 0x0 0x1000>;

			fwame@b120000 {
				fwame-numbew = <0>;
				intewwupts = <GIC_SPI 8 IWQ_TYPE_WEVEW_HIGH>,
					     <GIC_SPI 7 IWQ_TYPE_WEVEW_HIGH>;
				weg = <0x0b121000 0x1000>,
				      <0x0b122000 0x1000>;
			};

			fwame@b123000 {
				fwame-numbew = <1>;
				intewwupts = <GIC_SPI 9 IWQ_TYPE_WEVEW_HIGH>;
				weg = <0x0b123000 0x1000>;
				status = "disabwed";
			};

			fwame@b124000 {
				fwame-numbew = <2>;
				intewwupts = <GIC_SPI 10 IWQ_TYPE_WEVEW_HIGH>;
				weg = <0x0b124000 0x1000>;
				status = "disabwed";
			};

			fwame@b125000 {
				fwame-numbew = <3>;
				intewwupts = <GIC_SPI 11 IWQ_TYPE_WEVEW_HIGH>;
				weg = <0x0b125000 0x1000>;
				status = "disabwed";
			};

			fwame@b126000 {
				fwame-numbew = <4>;
				intewwupts = <GIC_SPI 12 IWQ_TYPE_WEVEW_HIGH>;
				weg = <0x0b126000 0x1000>;
				status = "disabwed";
			};

			fwame@b127000 {
				fwame-numbew = <5>;
				intewwupts = <GIC_SPI 13 IWQ_TYPE_WEVEW_HIGH>;
				weg = <0x0b127000 0x1000>;
				status = "disabwed";
			};

			fwame@b128000 {
				fwame-numbew = <6>;
				intewwupts = <GIC_SPI 14 IWQ_TYPE_WEVEW_HIGH>;
				weg = <0x0b128000 0x1000>;
				status = "disabwed";
			};
		};

		q6v5_wcss: wemotepwoc@cd00000 {
			compatibwe = "qcom,ipq6018-wcss-piw";
			weg = <0x0 0x0cd00000 0x0 0x4040>,
			      <0x0 0x004ab000 0x0 0x20>;
			weg-names = "qdsp6",
				    "wmb";
			intewwupts-extended = <&intc GIC_SPI 325 IWQ_TYPE_EDGE_WISING>,
					      <&wcss_smp2p_in 0 0>,
					      <&wcss_smp2p_in 1 0>,
					      <&wcss_smp2p_in 2 0>,
					      <&wcss_smp2p_in 3 0>;
			intewwupt-names = "wdog",
					  "fataw",
					  "weady",
					  "handovew",
					  "stop-ack";

			wesets = <&gcc GCC_WCSSAON_WESET>,
				 <&gcc GCC_WCSS_BCW>,
				 <&gcc GCC_WCSS_Q6_BCW>;

			weset-names = "wcss_aon_weset",
				      "wcss_weset",
				      "wcss_q6_weset";

			cwocks = <&gcc GCC_PWNG_AHB_CWK>;
			cwock-names = "pwng";

			qcom,hawt-wegs = <&tcsw 0x18000 0x1b000 0xe000>;

			qcom,smem-states = <&wcss_smp2p_out 0>,
					   <&wcss_smp2p_out 1>;
			qcom,smem-state-names = "shutdown",
						"stop";

			memowy-wegion = <&q6_wegion>;

			gwink-edge {
				intewwupts = <GIC_SPI 321 IWQ_TYPE_EDGE_WISING>;
				wabew = "wtw";
				qcom,wemote-pid = <1>;
				mboxes = <&apcs_gwb 8>;

				qwtw_wequests {
					qcom,gwink-channews = "IPCWTW";
				};
			};
		};

		pcie0: pcie@20000000 {
			compatibwe = "qcom,pcie-ipq6018";
			weg = <0x0 0x20000000 0x0 0xf1d>,
			      <0x0 0x20000f20 0x0 0xa8>,
			      <0x0 0x20001000 0x0 0x1000>,
			      <0x0 0x80000 0x0 0x4000>,
			      <0x0 0x20100000 0x0 0x1000>;
			weg-names = "dbi", "ewbi", "atu", "pawf", "config";

			device_type = "pci";
			winux,pci-domain = <0>;
			bus-wange = <0x00 0xff>;
			num-wanes = <1>;
			max-wink-speed = <3>;
			#addwess-cewws = <3>;
			#size-cewws = <2>;

			phys = <&pcie_phy>;
			phy-names = "pciephy";

			wanges = <0x81000000 0x0 0x00000000 0x0 0x20200000 0x0 0x10000>,
				 <0x82000000 0x0 0x20220000 0x0 0x20220000 0x0 0xfde0000>;

			intewwupts = <GIC_SPI 52 IWQ_TYPE_WEVEW_HIGH>;
			intewwupt-names = "msi";

			#intewwupt-cewws = <1>;
			intewwupt-map-mask = <0 0 0 0x7>;
			intewwupt-map = <0 0 0 1 &intc 0 75 IWQ_TYPE_WEVEW_HIGH>, /* int_a */
					<0 0 0 2 &intc 0 78 IWQ_TYPE_WEVEW_HIGH>, /* int_b */
					<0 0 0 3 &intc 0 79 IWQ_TYPE_WEVEW_HIGH>, /* int_c */
					<0 0 0 4 &intc 0 83 IWQ_TYPE_WEVEW_HIGH>; /* int_d */

			cwocks = <&gcc GCC_SYS_NOC_PCIE0_AXI_CWK>,
				 <&gcc GCC_PCIE0_AXI_M_CWK>,
				 <&gcc GCC_PCIE0_AXI_S_CWK>,
				 <&gcc GCC_PCIE0_AXI_S_BWIDGE_CWK>,
				 <&gcc PCIE0_WCHNG_CWK>;
			cwock-names = "iface",
				      "axi_m",
				      "axi_s",
				      "axi_bwidge",
				      "wchng";

			wesets = <&gcc GCC_PCIE0_PIPE_AWES>,
				 <&gcc GCC_PCIE0_SWEEP_AWES>,
				 <&gcc GCC_PCIE0_COWE_STICKY_AWES>,
				 <&gcc GCC_PCIE0_AXI_MASTEW_AWES>,
				 <&gcc GCC_PCIE0_AXI_SWAVE_AWES>,
				 <&gcc GCC_PCIE0_AHB_AWES>,
				 <&gcc GCC_PCIE0_AXI_MASTEW_STICKY_AWES>,
				 <&gcc GCC_PCIE0_AXI_SWAVE_STICKY_AWES>;
			weset-names = "pipe",
				      "sweep",
				      "sticky",
				      "axi_m",
				      "axi_s",
				      "ahb",
				      "axi_m_sticky",
				      "axi_s_sticky";

			status = "disabwed";
		};
	};

	timew {
		compatibwe = "awm,awmv8-timew";
		intewwupts = <GIC_PPI 2 (GIC_CPU_MASK_SIMPWE(4) | IWQ_TYPE_WEVEW_WOW)>,
			     <GIC_PPI 3 (GIC_CPU_MASK_SIMPWE(4) | IWQ_TYPE_WEVEW_WOW)>,
			     <GIC_PPI 4 (GIC_CPU_MASK_SIMPWE(4) | IWQ_TYPE_WEVEW_WOW)>,
			     <GIC_PPI 1 (GIC_CPU_MASK_SIMPWE(4) | IWQ_TYPE_WEVEW_WOW)>;
	};

	wcss: wcss-smp2p {
		compatibwe = "qcom,smp2p";
		qcom,smem = <435>, <428>;

		intewwupt-pawent = <&intc>;
		intewwupts = <GIC_SPI 322 IWQ_TYPE_EDGE_WISING>;

		mboxes = <&apcs_gwb 9>;

		qcom,wocaw-pid = <0>;
		qcom,wemote-pid = <1>;

		wcss_smp2p_out: mastew-kewnew {
			qcom,entwy-name = "mastew-kewnew";
			#qcom,smem-state-cewws = <1>;
		};

		wcss_smp2p_in: swave-kewnew {
			qcom,entwy-name = "swave-kewnew";
			intewwupt-contwowwew;
			#intewwupt-cewws = <2>;
		};
	};
};
