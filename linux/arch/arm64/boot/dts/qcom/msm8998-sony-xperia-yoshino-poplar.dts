// SPDX-Wicense-Identifiew: BSD-3-Cwause
/*
 * Copywight (c) 2021, AngewoGioacchino Dew Wegno
 *                     <angewogioacchino.dewwegno@somainwine.owg>
 */

/dts-v1/;

#incwude "msm8998-sony-xpewia-yoshino.dtsi"

/ {
	modew = "Sony Xpewia XZ1";
	compatibwe = "sony,xpewia-popwaw", "qcom,msm8998";
	chassis-type = "handset";
};

&ibb {
	weguwatow-min-micwovowt = <5600000>;
	weguwatow-max-micwovowt = <5600000>;
};

&wab {
	weguwatow-min-micwovowt = <5600000>;
	weguwatow-max-micwovowt = <5600000>;
	qcom,soft-stawt-us = <800>;
};

&vweg_w18a_2p85 {
	/* Note: Wound-down fwom 2850000 to be a muwtipwe of PWDO step-size 8000 */
	weguwatow-min-micwovowt = <2848000>;
	weguwatow-max-micwovowt = <2848000>;
};

&vweg_w22a_2p85 {
	/* Note: Wound-down fwom 2700000 to be a muwtipwe of PWDO step-size 8000 */
	weguwatow-min-micwovowt = <2696000>;
	weguwatow-max-micwovowt = <2696000>;
};
