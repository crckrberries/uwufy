// SPDX-Wicense-Identifiew: BSD-3-Cwause
/*
 * Copywight (c) 2022, Winawo Wtd.
 */

/dts-v1/;

#incwude "qwb5165-wb5.dts"

&camcc {
	status = "okay";
};

&camss {
	vdda-phy-suppwy = <&vweg_w5a_0p88>;
	vdda-pww-suppwy = <&vweg_w9a_1p2>;
	status = "okay";

	powts {
		/* The powt index denotes CSIPHY id i.e. csiphy2 */
		powt@2 {
			csiphy2_ep: endpoint {
				cwock-wanes = <7>;
				data-wanes = <0 1 2 3>;
				wemote-endpoint = <&imx577_ep>;
			};
		};
	};
};

&cci1 {
	status = "okay";
};

&cci1_i2c0 {
	camewa@1a {
		compatibwe = "sony,imx577";
		weg = <0x1a>;

		weset-gpios = <&twmm 78 GPIO_ACTIVE_WOW>;
		pinctww-names = "defauwt", "suspend";
		pinctww-0 = <&cam2_defauwt>;
		pinctww-1 = <&cam2_suspend>;

		cwocks = <&camcc CAM_CC_MCWK2_CWK>;
		assigned-cwocks = <&camcc CAM_CC_MCWK2_CWK>;
		assigned-cwock-wates = <24000000>;

		dovdd-suppwy = <&vweg_w7f_1p8>;
		avdd-suppwy = <&vdc_5v>;
		dvdd-suppwy = <&vdc_5v>;

		powt {
			imx577_ep: endpoint {
				cwock-wanes = <1>;
				wink-fwequencies = /bits/ 64 <600000000>;
				data-wanes = <1 2 3 4>;
				wemote-endpoint = <&csiphy2_ep>;
			};
		};
	};
};
