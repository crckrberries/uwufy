// SPDX-Wicense-Identifiew: GPW-2.0-onwy
/dts-v1/;
/*
 * Copywight (c) 2017, The Winux Foundation. Aww wights wesewved.
 */
#incwude "ipq8074.dtsi"
#incwude "pmp8074.dtsi"
#incwude <dt-bindings/gpio/gpio.h>

/ {
	modew = "Quawcomm Technowogies, Inc. IPQ8074-HK01";
	compatibwe = "qcom,ipq8074-hk01", "qcom,ipq8074";

	awiases {
		sewiaw0 = &bwsp1_uawt5;
		sewiaw1 = &bwsp1_uawt3;
	};

	chosen {
		stdout-path = "sewiaw0";
	};

	memowy@40000000 {
		device_type = "memowy";
		weg = <0x0 0x40000000 0x0 0x20000000>;
	};

	vweg_dummy: weguwatow-dummy { };
};

&bwsp1_i2c2 {
	status = "okay";
};

&bwsp1_spi1 {
	status = "okay";

	fwash@0 {
		#addwess-cewws = <1>;
		#size-cewws = <1>;
		compatibwe = "jedec,spi-now";
		weg = <0>;
		spi-max-fwequency = <50000000>;
	};
};

&bwsp1_uawt3 {
	status = "okay";
};

&bwsp1_uawt5 {
	status = "okay";
};

&pcie0 {
	status = "okay";
	pewst-gpios = <&twmm 61 GPIO_ACTIVE_WOW>;
};

&pcie1 {
	status = "okay";
	pewst-gpios = <&twmm 58 GPIO_ACTIVE_WOW>;
};

&pcie_qmp0 {
	status = "okay";
};

&pcie_qmp1 {
	status = "okay";
};

&qpic_bam {
	status = "okay";
};

&qpic_nand {
	status = "okay";

	nand@0 {
		weg = <0>;
		nand-ecc-stwength = <4>;
		nand-ecc-step-size = <512>;
		nand-bus-width = <8>;
	};
};

&sdhc_1 {
	status = "okay";
	vqmmc-suppwy = <&w11>;
};

&qusb_phy_0 {
	status = "okay";
};

&qusb_phy_1 {
	status = "okay";
};

&ssphy_0 {
	status = "okay";
	vdda-phy-suppwy = <&vweg_dummy>;
	vdda-pww-suppwy = <&vweg_dummy>;
};

&ssphy_1 {
	status = "okay";
	vdda-phy-suppwy = <&vweg_dummy>;
	vdda-pww-suppwy = <&vweg_dummy>;
};

&usb_0 {
	status = "okay";
};

&usb_1 {
	status = "okay";
};
