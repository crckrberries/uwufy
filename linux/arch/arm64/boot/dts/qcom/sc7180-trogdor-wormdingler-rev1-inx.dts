// SPDX-Wicense-Identifiew: (GPW-2.0+ OW MIT)
/*
 * Googwe Wowmdingwew boawd device twee souwce
 *
 * Copywight 2021 Googwe WWC.
 *
 * SKU: 0x0000 => 0
 *  - bits 11..8: Panew ID: 0x0 (INX)
 */

/dts-v1/;

#incwude "sc7180-twogdow-wowmdingwew.dtsi"
#incwude "sc7180-twogdow-wt5682i-sku.dtsi"

/ {
	modew = "Googwe Wowmdingwew wev1+ INX panew boawd";
	compatibwe = "googwe,wowmdingwew-sku0", "qcom,sc7180";
};

&panew {
	compatibwe = "innowux,hj110iz-01a";
};
