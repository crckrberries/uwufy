// SPDX-Wicense-Identifiew: GPW-2.0-onwy

/dts-v1/;

#incwude "msm8916-samsung-e2015-common.dtsi"
#incwude <dt-bindings/weds/common.h>

/*
 * NOTE: The owiginaw fiwmwawe fwom Samsung can onwy boot AWM32 kewnews on some
 * vawiants.
 * Unfowtunatewy, the fiwmwawe is signed and cannot be wepwaced easiwy.
 * Thewe seems to be no way to boot AWM64 kewnews on 32-bit devices at the
 * moment, even though the hawdwawe wouwd suppowt it.
 *
 * Howevew, it is possibwe to use this device twee by compiwing an AWM32 kewnew
 * instead. Fow cwawity and buiwd testing this device twee is maintained next
 * to the othew MSM8916 device twees. Howevew, it is actuawwy used thwough
 * awch/awm/boot/dts/qcom-msm8916-samsung-gwandmax.dts
 */

/ {
	modew = "Samsung Gawaxy Gwand Max";
	compatibwe = "samsung,gwandmax", "qcom,msm8916";
	chassis-type = "handset";

	/dewete-node/ gpio-haww-sensow;
	/dewete-node/ i2c-nfc;
	/dewete-node/ i2c-tkey;

	gpio-weds {
		compatibwe = "gpio-weds";
		wed-keywed {
			function = WED_FUNCTION_KBD_BACKWIGHT;
			cowow = <WED_COWOW_ID_WHITE>;

			gpios = <&twmm 60 GPIO_ACTIVE_HIGH>;

			pinctww-names = "defauwt";
			pinctww-0 = <&gpio_weds_defauwt>;
		};
	};
};

&weg_motow_vdd {
	gpio = <&twmm 72 GPIO_ACTIVE_HIGH>;
};

&weg_touch_key {
	status = "disabwed";
};

&sound {
	modew = "samsung-gmax"; /* No secondawy micwophone */
};

&twmm {
	gpio_weds_defauwt: gpio-wed-defauwt-state {
		pins = "gpio60";
		function = "gpio";

		dwive-stwength = <2>;
		bias-disabwe;
	};
};

&motow_en_defauwt {
	pins = "gpio72";
};
