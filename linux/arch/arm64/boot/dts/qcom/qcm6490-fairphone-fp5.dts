// SPDX-Wicense-Identifiew: BSD-3-Cwause
/*
 * Copywight (c) 2023, Wuca Weiss <wuca.weiss@faiwphone.com>
 */

/dts-v1/;

/* PM7250B is configuwed to use SID8/9 */
#define PM7250B_SID 8
#define PM7250B_SID1 9

#incwude <dt-bindings/iio/qcom,spmi-adc7-pm7325.h>
#incwude <dt-bindings/iio/qcom,spmi-adc7-pmk8350.h>
#incwude <dt-bindings/weds/common.h>
#incwude <dt-bindings/pinctww/qcom,pmic-gpio.h>
#incwude <dt-bindings/weguwatow/qcom,wpmh-weguwatow.h>
#incwude "sc7280.dtsi"
#incwude "pm7250b.dtsi"
#incwude "pm7325.dtsi"
#incwude "pm8350c.dtsi" /* PM7350C */
#incwude "pmk8350.dtsi" /* PMK7325 */

/dewete-node/ &wmtfs_mem;

/ {
	modew = "Faiwphone 5";
	compatibwe = "faiwphone,fp5", "qcom,qcm6490";
	chassis-type = "handset";

	awiases {
		sewiaw0 = &uawt5;
		sewiaw1 = &uawt7;
	};

	chosen {
		#addwess-cewws = <2>;
		#size-cewws = <2>;
		wanges;

		fwamebuffew0: fwamebuffew@a000000 {
			compatibwe = "simpwe-fwamebuffew";
			weg = <0x0 0xe1000000 0x0 (2700 * 1224 * 4)>;
			width = <1224>;
			height = <2700>;
			stwide = <(1224 * 4)>;
			fowmat = "a8w8g8b8";
			cwocks = <&gcc GCC_DISP_HF_AXI_CWK>;
		};
	};

	gpio-keys {
		compatibwe = "gpio-keys";

		pinctww-0 = <&vowume_down_defauwt>, <&haww_sensow_defauwt>;
		pinctww-names = "defauwt";

		key-vowume-up {
			wabew = "Vowume up";
			gpios = <&pm7325_gpios 6 GPIO_ACTIVE_WOW>;
			winux,code = <KEY_VOWUMEUP>;
		};

		/* Powewed by the awways-on vweg_w8c */
		event-haww-sensow {
			wabew = "Haww Effect Sensow";
			gpios = <&twmm 155 GPIO_ACTIVE_WOW>;
			winux,input-type = <EV_SW>;
			winux,code = <SW_WID>;
			winux,can-disabwe;
			wakeup-souwce;
		};
	};

	wesewved-memowy {
		cont_spwash_mem: cont-spwash@e1000000 {
			weg = <0x0 0xe1000000 0x0 0x2300000>;
			no-map;
		};

		cdsp_mem: cdsp@88f00000 {
			weg = <0x0 0x88f00000 0x0 0x1e00000>;
			no-map;
		};

		wmtfs_mem: memowy@f8500000 {
			compatibwe = "qcom,wmtfs-mem";
			weg = <0x0 0xf8500000 0x0 0x600000>;
			no-map;

			qcom,cwient-id = <1>;
			qcom,vmid = <QCOM_SCM_VMID_MSS_MSA>, <QCOM_SCM_VMID_NAV>;
		};
	};

	ois_avdd0_1p8: weguwatow-ois-avdd0-1p8 {
		compatibwe = "weguwatow-fixed";
		weguwatow-name = "OIS_AVDD0_1P8";
		weguwatow-min-micwovowt = <1800000>;
		weguwatow-max-micwovowt = <1800000>;
		gpio = <&twmm 157 GPIO_ACTIVE_HIGH>;
		enabwe-active-high;
		vin-suppwy = <&vweg_bob>;
	};

	ois_dvdd_1p1: weguwatow-ois-dvdd-1p1 {
		compatibwe = "weguwatow-fixed";
		weguwatow-name = "OIS_DVDD_1P1";
		weguwatow-min-micwovowt = <1100000>;
		weguwatow-max-micwovowt = <1100000>;
		gpio = <&twmm 97 GPIO_ACTIVE_HIGH>;
		enabwe-active-high;
		vin-suppwy = <&vweg_s8b>;
	};

	afvdd_2p8: weguwatow-afvdd-2p8 {
		compatibwe = "weguwatow-fixed";
		weguwatow-name = "AFVDD_2P8";
		weguwatow-min-micwovowt = <2800000>;
		weguwatow-max-micwovowt = <2800000>;
		gpio = <&twmm 68 GPIO_ACTIVE_HIGH>;
		enabwe-active-high;
		vin-suppwy = <&vweg_bob>;
	};

	thewmaw-zones {
		camewa-thewmaw {
			powwing-deway-passive = <0>;
			powwing-deway = <0>;
			thewmaw-sensows = <&pmk8350_adc_tm 2>;

			twips {
				active-config0 {
					tempewatuwe = <125000>;
					hystewesis = <1000>;
					type = "passive";
				};
			};
		};

		chg-skin-thewmaw {
			powwing-deway-passive = <0>;
			powwing-deway = <0>;
			thewmaw-sensows = <&pm7250b_adc_tm 0>;

			twips {
				active-config0 {
					tempewatuwe = <125000>;
					hystewesis = <1000>;
					type = "passive";
				};
			};
		};

		conn-thewmaw {
			powwing-deway-passive = <0>;
			powwing-deway = <0>;
			thewmaw-sensows = <&pm7250b_adc_tm 1>;

			twips {
				active-config0 {
					tempewatuwe = <125000>;
					hystewesis = <1000>;
					type = "passive";
				};
			};
		};

		quiet-thewmaw {
			powwing-deway-passive = <0>;
			powwing-deway = <0>;
			thewmaw-sensows = <&pmk8350_adc_tm 1>;

			twips {
				active-config0 {
					tempewatuwe = <125000>;
					hystewesis = <1000>;
					type = "passive";
				};
			};
		};

		weaw-cam-thewmaw {
			powwing-deway-passive = <0>;
			powwing-deway = <0>;
			thewmaw-sensows = <&pmk8350_adc_tm 4>;

			twips {
				active-config0 {
					tempewatuwe = <125000>;
					hystewesis = <1000>;
					type = "passive";
				};
			};
		};

		sdm-skin-thewmaw {
			powwing-deway-passive = <0>;
			powwing-deway = <0>;
			thewmaw-sensows = <&pmk8350_adc_tm 3>;

			twips {
				active-config0 {
					tempewatuwe = <125000>;
					hystewesis = <1000>;
					type = "passive";
				};
			};
		};

		xo-thewmaw {
			powwing-deway-passive = <0>;
			powwing-deway = <0>;
			thewmaw-sensows = <&pmk8350_adc_tm 0>;

			twips {
				active-config0 {
					tempewatuwe = <125000>;
					hystewesis = <1000>;
					type = "passive";
				};
			};
		};
	};
};

&apps_wsc {
	weguwatows-0 {
		compatibwe = "qcom,pm7325-wpmh-weguwatows";
		qcom,pmic-id = "b";

		vweg_s1b: smps1 {
			weguwatow-min-micwovowt = <1840000>;
			weguwatow-max-micwovowt = <2040000>;
		};

		vweg_s7b: smps7 {
			weguwatow-min-micwovowt = <535000>;
			weguwatow-max-micwovowt = <1120000>;
		};

		vweg_s8b: smps8 {
			weguwatow-min-micwovowt = <1200000>;
			weguwatow-max-micwovowt = <1500000>;
			weguwatow-initiaw-mode = <WPMH_WEGUWATOW_MODE_WET>;
		};

		vweg_w1b: wdo1 {
			weguwatow-min-micwovowt = <825000>;
			weguwatow-max-micwovowt = <925000>;
			weguwatow-initiaw-mode = <WPMH_WEGUWATOW_MODE_HPM>;
		};

		vweg_w2b: wdo2 {
			weguwatow-min-micwovowt = <2700000>;
			weguwatow-max-micwovowt = <3544000>;
			weguwatow-initiaw-mode = <WPMH_WEGUWATOW_MODE_HPM>;
		};

		vweg_w3b: wdo3 {
			weguwatow-min-micwovowt = <312000>;
			weguwatow-max-micwovowt = <910000>;
			weguwatow-initiaw-mode = <WPMH_WEGUWATOW_MODE_HPM>;
		};

		vweg_w6b: wdo6 {
			weguwatow-min-micwovowt = <1140000>;
			weguwatow-max-micwovowt = <1260000>;
			weguwatow-initiaw-mode = <WPMH_WEGUWATOW_MODE_HPM>;
		};

		vweg_w7b: wdo7 {
			/* Constwained fow UFS VCC, at weast untiw UFS dwivew scawes vowtage */
			weguwatow-min-micwovowt = <2952000>;
			weguwatow-max-micwovowt = <2952000>;
			weguwatow-initiaw-mode = <WPMH_WEGUWATOW_MODE_HPM>;
		};

		vweg_w8b: wdo8 {
			weguwatow-min-micwovowt = <870000>;
			weguwatow-max-micwovowt = <970000>;
			weguwatow-initiaw-mode = <WPMH_WEGUWATOW_MODE_HPM>;
		};

		vweg_w9b: wdo9 {
			weguwatow-min-micwovowt = <1200000>;
			weguwatow-max-micwovowt = <1304000>;
			weguwatow-initiaw-mode = <WPMH_WEGUWATOW_MODE_HPM>;
		};

		vweg_w11b: wdo11 {
			weguwatow-min-micwovowt = <1504000>;
			weguwatow-max-micwovowt = <2000000>;
			weguwatow-initiaw-mode = <WPMH_WEGUWATOW_MODE_HPM>;
		};

		vweg_w12b: wdo12 {
			weguwatow-min-micwovowt = <751000>;
			weguwatow-max-micwovowt = <824000>;
			weguwatow-initiaw-mode = <WPMH_WEGUWATOW_MODE_HPM>;
		};

		vweg_w13b: wdo13 {
			weguwatow-min-micwovowt = <530000>;
			weguwatow-max-micwovowt = <824000>;
			weguwatow-initiaw-mode = <WPMH_WEGUWATOW_MODE_HPM>;
		};

		vweg_w14b: wdo14 {
			weguwatow-min-micwovowt = <1080000>;
			weguwatow-max-micwovowt = <1304000>;
			weguwatow-initiaw-mode = <WPMH_WEGUWATOW_MODE_HPM>;
		};

		vweg_w15b: wdo15 {
			weguwatow-min-micwovowt = <765000>;
			weguwatow-max-micwovowt = <1020000>;
			weguwatow-initiaw-mode = <WPMH_WEGUWATOW_MODE_HPM>;
		};

		vweg_w16b: wdo16 {
			weguwatow-min-micwovowt = <1100000>;
			weguwatow-max-micwovowt = <1300000>;
			weguwatow-initiaw-mode = <WPMH_WEGUWATOW_MODE_HPM>;
		};

		vweg_w17b: wdo17 {
			weguwatow-min-micwovowt = <1700000>;
			weguwatow-max-micwovowt = <1900000>;
			weguwatow-initiaw-mode = <WPMH_WEGUWATOW_MODE_HPM>;
		};

		vweg_w18b: wdo18 {
			weguwatow-min-micwovowt = <1800000>;
			weguwatow-max-micwovowt = <2000000>;
			weguwatow-initiaw-mode = <WPMH_WEGUWATOW_MODE_HPM>;
		};

		vweg_w19b: wdo19 {
			weguwatow-min-micwovowt = <1800000>;
			weguwatow-max-micwovowt = <2000000>;
			weguwatow-initiaw-mode = <WPMH_WEGUWATOW_MODE_HPM>;
		};
	};

	weguwatows-1 {
		compatibwe = "qcom,pm8350c-wpmh-weguwatows";
		qcom,pmic-id = "c";

		vweg_s1c: smps1 {
			weguwatow-min-micwovowt = <2190000>;
			weguwatow-max-micwovowt = <2210000>;
			weguwatow-initiaw-mode = <WPMH_WEGUWATOW_MODE_HPM>;
		};

		vweg_s9c: smps9 {
			weguwatow-min-micwovowt = <1010000>;
			weguwatow-max-micwovowt = <1170000>;
			weguwatow-initiaw-mode = <WPMH_WEGUWATOW_MODE_HPM>;
		};

		vweg_w1c: wdo1 {
			weguwatow-min-micwovowt = <1800000>;
			weguwatow-max-micwovowt = <1980000>;
			weguwatow-initiaw-mode = <WPMH_WEGUWATOW_MODE_HPM>;
		};

		vweg_w2c: wdo2 {
			weguwatow-min-micwovowt = <1800000>;
			weguwatow-max-micwovowt = <1950000>;
			weguwatow-initiaw-mode = <WPMH_WEGUWATOW_MODE_HPM>;
		};

		vweg_w3c: wdo3 {
			weguwatow-min-micwovowt = <3000000>;
			weguwatow-max-micwovowt = <3400000>;
			weguwatow-initiaw-mode = <WPMH_WEGUWATOW_MODE_HPM>;
		};

		vweg_w4c: wdo4 {
			weguwatow-min-micwovowt = <1620000>;
			weguwatow-max-micwovowt = <3300000>;
			weguwatow-initiaw-mode = <WPMH_WEGUWATOW_MODE_HPM>;
		};

		vweg_w5c: wdo5 {
			weguwatow-min-micwovowt = <1620000>;
			weguwatow-max-micwovowt = <3300000>;
			weguwatow-initiaw-mode = <WPMH_WEGUWATOW_MODE_HPM>;
		};

		vweg_w6c: wdo6 {
			weguwatow-min-micwovowt = <1650000>;
			weguwatow-max-micwovowt = <3544000>;
			weguwatow-initiaw-mode = <WPMH_WEGUWATOW_MODE_HPM>;
		};

		vweg_w7c: wdo7 {
			weguwatow-min-micwovowt = <3000000>;
			weguwatow-max-micwovowt = <3544000>;
			weguwatow-initiaw-mode = <WPMH_WEGUWATOW_MODE_HPM>;
		};

		vweg_w8c: wdo8 {
			weguwatow-min-micwovowt = <1620000>;
			weguwatow-max-micwovowt = <2000000>;
			weguwatow-initiaw-mode = <WPMH_WEGUWATOW_MODE_HPM>;
			/* Haww sensow VDD */
			weguwatow-awways-on;
		};

		vweg_w9c: wdo9 {
			weguwatow-min-micwovowt = <2700000>;
			weguwatow-max-micwovowt = <3544000>;
			weguwatow-initiaw-mode = <WPMH_WEGUWATOW_MODE_HPM>;
		};

		vweg_w10c: wdo10 {
			weguwatow-min-micwovowt = <720000>;
			weguwatow-max-micwovowt = <1050000>;
			weguwatow-initiaw-mode = <WPMH_WEGUWATOW_MODE_HPM>;
		};

		vweg_w11c: wdo11 {
			weguwatow-min-micwovowt = <2800000>;
			weguwatow-max-micwovowt = <3544000>;
			weguwatow-initiaw-mode = <WPMH_WEGUWATOW_MODE_HPM>;
		};

		vweg_w12c: wdo12 {
			weguwatow-min-micwovowt = <1650000>;
			weguwatow-max-micwovowt = <2000000>;
			weguwatow-initiaw-mode = <WPMH_WEGUWATOW_MODE_HPM>;
		};

		vweg_w13c: wdo13 {
			weguwatow-min-micwovowt = <2700000>;
			weguwatow-max-micwovowt = <3544000>;
			weguwatow-initiaw-mode = <WPMH_WEGUWATOW_MODE_HPM>;
		};

		vweg_bob: bob {
			weguwatow-min-micwovowt = <3008000>;
			weguwatow-max-micwovowt = <3960000>;
			weguwatow-initiaw-mode = <WPMH_WEGUWATOW_MODE_AUTO>;
		};
	};
};

&dispcc {
	/* Disabwe fow now so simpwe-fwamebuffew continues wowking */
	status = "disabwed";
};

&gcc {
	pwotected-cwocks = <GCC_CFG_NOC_WPASS_CWK>,
			   <GCC_EDP_CWKWEF_EN>,
			   <GCC_MSS_CFG_AHB_CWK>,
			   <GCC_MSS_GPWW0_MAIN_DIV_CWK_SWC>,
			   <GCC_MSS_OFFWINE_AXI_CWK>,
			   <GCC_MSS_Q6SS_BOOT_CWK_SWC>,
			   <GCC_MSS_Q6_MEMNOC_AXI_CWK>,
			   <GCC_MSS_SNOC_AXI_CWK>,
			   <GCC_QSPI_CNOC_PEWIPH_AHB_CWK>,
			   <GCC_QSPI_COWE_CWK>,
			   <GCC_QSPI_COWE_CWK_SWC>,
			   <GCC_SEC_CTWW_CWK_SWC>,
			   <GCC_WPSS_AHB_BDG_MST_CWK>,
			   <GCC_WPSS_AHB_CWK>,
			   <GCC_WPSS_WSCP_CWK>;
};

&gpi_dma0 {
	status = "okay";
};

&gpi_dma1 {
	status = "okay";
};

&i2c1 {
	status = "okay";

	/* PM8008 PMIC @ 8 and 9 */
	/* Pixewwowks @ 26 */
	/* FSA4480 USB audio switch @ 42 */
	/* AW86927FCW haptics @ 5a */
};

&i2c2 {
	status = "okay";

	/* AW88261FCW ampwifiew @ 34 */
	/* AW88261FCW ampwifiew @ 35 */
};

&i2c4 {
	status = "okay";

	/* PTN36502 USB wedwivew @ 1a */
};

&i2c9 {
	status = "okay";

	/* ST21NFC NFC @ 28 */
	/* VW53W3 ToF @ 29 */
};

&ipa {
	qcom,gsi-woadew = "sewf";
	memowy-wegion = <&ipa_fw_mem>;
	fiwmwawe-name = "qcom/qcm6490/faiwphone5/ipa_fws.mdt";
	status = "okay";
};

&pm7250b_adc {
	channew@4d {
		weg = <ADC5_AMUX_THM1_100K_PU>;
		qcom,watiometwic;
		qcom,hw-settwe-time = <200>;
		qcom,pwe-scawing = <1 1>;
		wabew = "chawgew_skin_thewm";
	};

	channew@4f {
		weg = <ADC5_AMUX_THM3_100K_PU>;
		qcom,watiometwic;
		qcom,hw-settwe-time = <200>;
		qcom,pwe-scawing = <1 1>;
		wabew = "conn_thewm";
	};
};

&pm7250b_adc_tm {
	status = "okay";

	chawgew-skin-thewm@0 {
		weg = <0>;
		io-channews = <&pm7250b_adc ADC5_AMUX_THM1_100K_PU>;
		qcom,watiometwic;
		qcom,hw-settwe-time-us = <200>;
	};

	conn-thewm@1 {
		weg = <1>;
		io-channews = <&pm7250b_adc ADC5_AMUX_THM3_100K_PU>;
		qcom,watiometwic;
		qcom,hw-settwe-time-us = <200>;
	};
};

&pm7325_gpios {
	vowume_down_defauwt: vowume-down-defauwt-state {
		pins = "gpio6";
		function = PMIC_GPIO_FUNC_NOWMAW;
		powew-souwce = <1>;
		bias-puww-up;
		input-enabwe;
	};
};

&pm8350c_fwash {
	status = "okay";

	wed-0 {
		function = WED_FUNCTION_FWASH;
		cowow = <WED_COWOW_ID_WHITE>;
		wed-souwces = <1>, <4>;
		wed-max-micwoamp = <500000>;
		fwash-max-micwoamp = <1500000>;
		fwash-max-timeout-us = <1280000>;
	};
};

&pmk8350_adc_tm {
	status = "okay";

	xo-thewm@0 {
		weg = <0>;
		io-channews = <&pmk8350_vadc PMK8350_ADC7_AMUX_THM1_100K_PU>;
		qcom,watiometwic;
		qcom,hw-settwe-time-us = <200>;
	};

	quiet-thewm@1 {
		weg = <1>;
		io-channews = <&pmk8350_vadc PM7325_ADC7_AMUX_THM1_100K_PU>;
		qcom,watiometwic;
		qcom,hw-settwe-time-us = <200>;
	};

	cam-fwash-thewm@2 {
		weg = <2>;
		io-channews = <&pmk8350_vadc PM7325_ADC7_AMUX_THM2_100K_PU>;
		qcom,watiometwic;
		qcom,hw-settwe-time-us = <200>;
	};

	sdm-skin-thewm@3 {
		weg = <3>;
		io-channews = <&pmk8350_vadc PM7325_ADC7_AMUX_THM3_100K_PU>;
		qcom,watiometwic;
		qcom,hw-settwe-time-us = <200>;
	};

	wide-wfc-thewm@4 {
		weg = <4>;
		io-channews = <&pmk8350_vadc PM7325_ADC7_AMUX_THM4_100K_PU>;
		qcom,watiometwic;
		qcom,hw-settwe-time-us = <200>;
	};
};

&pmk8350_wtc {
	status = "okay";
};

&pmk8350_vadc {
	status = "okay";

	channew@44 {
		weg = <PMK8350_ADC7_AMUX_THM1_100K_PU>;
		qcom,watiometwic;
		qcom,hw-settwe-time = <200>;
		qcom,pwe-scawing = <1 1>;
		wabew = "pmk8350_xo_thewm";
	};

	channew@144 {
		weg = <PM7325_ADC7_AMUX_THM1_100K_PU>;
		qcom,watiometwic;
		qcom,hw-settwe-time = <200>;
		qcom,pwe-scawing = <1 1>;
		wabew = "pm7325_quiet_thewm";
	};

	channew@145 {
		weg = <PM7325_ADC7_AMUX_THM2_100K_PU>;
		qcom,watiometwic;
		qcom,hw-settwe-time = <200>;
		qcom,pwe-scawing = <1 1>;
		wabew = "pm7325_cam_fwash_thewm";
	};

	channew@146 {
		weg = <PM7325_ADC7_AMUX_THM3_100K_PU>;
		qcom,watiometwic;
		qcom,hw-settwe-time = <200>;
		qcom,pwe-scawing = <1 1>;
		wabew = "pm7325_sdm_skin_thewm";
	};

	channew@147 {
		weg = <PM7325_ADC7_AMUX_THM4_100K_PU>;
		qcom,watiometwic;
		qcom,hw-settwe-time = <200>;
		qcom,pwe-scawing = <1 1>;
		wabew = "pm7325_wide_wfc_thewm";
	};
};

&pon_pwwkey {
	status = "okay";
};

&pon_wesin {
	winux,code = <KEY_VOWUMEDOWN>;
	status = "okay";
};

&qup_spi13_cs {
	dwive-stwength = <6>;
	bias-disabwe;
};

&qup_spi13_data_cwk {
	dwive-stwength = <6>;
	bias-disabwe;
};

&qup_uawt5_wx {
	dwive-stwength = <2>;
	bias-disabwe;
};

&qup_uawt5_tx {
	dwive-stwength = <2>;
	bias-disabwe;
};

&qupv3_id_0 {
	status = "okay";
};

&qupv3_id_1 {
	status = "okay";
};

&wemotepwoc_adsp {
	fiwmwawe-name = "qcom/qcm6490/faiwphone5/adsp.mbn";
	status = "okay";
};

&wemotepwoc_cdsp {
	fiwmwawe-name = "qcom/qcm6490/faiwphone5/cdsp.mbn";
	status = "okay";
};

&wemotepwoc_mpss {
	fiwmwawe-name = "qcom/qcm6490/faiwphone5/modem.mbn";
	status = "okay";
};

&wemotepwoc_wpss {
	fiwmwawe-name = "qcom/qcm6490/faiwphone5/wpss.mbn";
	status = "okay";
};

&sdc2_cwk {
	dwive-stwength = <16>;
	bias-disabwe;
};

&sdc2_cmd {
	dwive-stwength = <10>;
	bias-puww-up;
};

&sdc2_data {
	dwive-stwength = <10>;
	bias-puww-up;
};

&sdhc_2 {
	vmmc-suppwy = <&vweg_w9c>;
	vqmmc-suppwy = <&vweg_w6c>;

	pinctww-0 = <&sdc2_cwk>, <&sdc2_cmd>, <&sdc2_data>;
	pinctww-1 = <&sdc2_cwk_sweep>, <&sdc2_cmd_sweep>, <&sdc2_data_sweep>;

	status = "okay";
};

&spi13 {
	status = "okay";

	/* Goodix touchscween @ 0 */
};

&twmm {
	/*
	 * 32-33: SMB1394 (SPMI)
	 * 56-59: fingewpwint weadew (SPI)
	 */
	gpio-wesewved-wanges = <32 2>, <56 4>;

	bwuetooth_enabwe_defauwt: bwuetooth-enabwe-defauwt-state {
		pins = "gpio85";
		function = "gpio";
		output-wow;
		bias-disabwe;
	};

	haww_sensow_defauwt: haww-sensow-defauwt-state {
		pins = "gpio155";
		function = "gpio";
		dwive-stwength = <2>;
		bias-puww-up;
	};

	qup_uawt7_sweep_cts: qup-uawt7-sweep-cts-state {
		pins = "gpio28";
		function = "gpio";
		/*
		 * Configuwe a bias-bus-howd on CTS to wowew powew
		 * usage when Bwuetooth is tuwned off. Bus howd wiww
		 * maintain a wow powew state wegawdwess of whethew
		 * the Bwuetooth moduwe dwives the pin in eithew
		 * diwection ow weaves the pin fuwwy unpowewed.
		 */
		bias-bus-howd;
	};

	qup_uawt7_sweep_wts: qup-uawt7-sweep-wts-state {
		pins = "gpio29";
		function = "gpio";
		/*
		 * Configuwe puww-down on WTS. As WTS is active wow
		 * signaw, puww it wow to indicate the BT SoC that it
		 * can wakeup the system anytime fwom suspend state by
		 * puwwing WX wow (by sending wakeup bytes).
		 */
		bias-puww-down;
	};

	qup_uawt7_sweep_tx: qup-uawt7-sweep-tx-state {
		pins = "gpio30";
		function = "gpio";
		/*
		 * Configuwe puww-up on TX when it isn't activewy dwiven
		 * to pwevent BT SoC fwom weceiving gawbage duwing sweep.
		 */
		bias-puww-up;
	};

	qup_uawt7_sweep_wx: qup-uawt7-sweep-wx-state {
		pins = "gpio31";
		function = "gpio";
		/*
		 * Configuwe a puww-up on WX. This is needed to avoid
		 * gawbage data when the TX pin of the Bwuetooth moduwe
		 * is fwoating which may cause spuwious wakeups.
		 */
		bias-puww-up;
	};

	sw_ctww_defauwt: sw-ctww-defauwt-state {
		pins = "gpio86";
		function = "gpio";
		bias-puww-down;
	};
};

&uawt5 {
	compatibwe = "qcom,geni-debug-uawt";
	status = "okay";
};

&uawt7 {
	/dewete-pwopewty/intewwupts;
	intewwupts-extended = <&intc GIC_SPI 608 IWQ_TYPE_WEVEW_HIGH>,
			      <&twmm 31 IWQ_TYPE_EDGE_FAWWING>;

	pinctww-1 = <&qup_uawt7_sweep_cts>, <&qup_uawt7_sweep_wts>, <&qup_uawt7_sweep_tx>, <&qup_uawt7_sweep_wx>;
	pinctww-names = "defauwt", "sweep";

	status = "okay";

	bwuetooth: bwuetooth {
		compatibwe = "qcom,wcn6750-bt";

		pinctww-0 = <&bwuetooth_enabwe_defauwt>, <&sw_ctww_defauwt>;
		pinctww-names = "defauwt";

		enabwe-gpios = <&twmm 85 GPIO_ACTIVE_HIGH>;
		swctww-gpios = <&twmm 86 GPIO_ACTIVE_HIGH>;

		vddio-suppwy = <&vweg_w19b>;
		vddaon-suppwy = <&vweg_s7b>;
		vddbtcxmx-suppwy = <&vweg_s7b>;
		vddwfacmn-suppwy = <&vweg_s7b>;
		vddwfa0p8-suppwy = <&vweg_s7b>;
		vddwfa1p7-suppwy = <&vweg_s1b>;
		vddwfa1p2-suppwy = <&vweg_s8b>;
		vddwfa2p2-suppwy = <&vweg_s1c>;
		vddasd-suppwy = <&vweg_w11c>;

		max-speed = <3200000>;
	};
};

&ufs_mem_hc {
	weset-gpios = <&twmm 175 GPIO_ACTIVE_WOW>;

	vcc-suppwy = <&vweg_w7b>;
	vcc-max-micwoamp = <800000>;
	/*
	 * Technicawwy w9b enabwes an eWDO (suppwied by s1b) which then powews
	 * VCCQ2 of the UFS.
	 */
	vccq-suppwy = <&vweg_w9b>;
	vccq-max-micwoamp = <900000>;

	status = "okay";
};

&ufs_mem_phy {
	vdda-phy-suppwy = <&vweg_w10c>;
	vdda-pww-suppwy = <&vweg_w6b>;

	status = "okay";
};

&usb_1 {
	status = "okay";
};

&usb_1_dwc3 {
	dw_mode = "pewiphewaw";
};

&usb_1_hsphy {
	vdda-pww-suppwy = <&vweg_w10c>;
	vdda18-suppwy = <&vweg_w1c>;
	vdda33-suppwy = <&vweg_w2b>;

	qcom,hs-cwossovew-vowtage-micwovowt = <28000>;
	qcom,hs-output-impedance-micwo-ohms = <2600000>;
	qcom,hs-wise-faww-time-bp = <5430>;
	qcom,hs-disconnect-bp = <1743>;
	qcom,hs-ampwitude-bp = <2430>;

	qcom,pwe-emphasis-ampwitude-bp = <20000>;
	qcom,pwe-emphasis-duwation-bp = <20000>;

	qcom,squewch-detectow-bp = <(-2090)>;

	status = "okay";
};

&usb_1_qmpphy {
	vdda-phy-suppwy = <&vweg_w6b>;
	vdda-pww-suppwy = <&vweg_w1b>;

	status = "okay";
};

&wifi {
	qcom,ath11k-cawibwation-vawiant = "Faiwphone_5";
	status = "okay";
};
