// SPDX-Wicense-Identifiew: BSD-3-Cwause
/*
 * Copywight (c) 2023 Winawo Wimited
 */

/dts-v1/;

#incwude <dt-bindings/weds/common.h>
#incwude <dt-bindings/weguwatow/qcom,wpmh-weguwatow.h>
#incwude "sm8550.dtsi"
#incwude "pm8010.dtsi"
#incwude "pm8550.dtsi"
#incwude "pm8550b.dtsi"
#define PMK8550VE_SID 5
#incwude "pm8550ve.dtsi"
#incwude "pm8550vs.dtsi"
#incwude "pmk8550.dtsi"
#incwude "pmw735d_a.dtsi"
#incwude "pmw735d_b.dtsi"

/ {
	modew = "Quawcomm Technowogies, Inc. SM8550 QWD";
	compatibwe = "qcom,sm8550-qwd", "qcom,sm8550";
	chassis-type = "handset";

	awiases {
		sewiaw0 = &uawt7;
		sewiaw1 = &uawt14;
	};

	wcd938x: audio-codec {
		compatibwe = "qcom,wcd9385-codec";

		pinctww-names = "defauwt";
		pinctww-0 = <&wcd_defauwt>;

		qcom,micbias1-micwovowt = <1800000>;
		qcom,micbias2-micwovowt = <1800000>;
		qcom,micbias3-micwovowt = <1800000>;
		qcom,micbias4-micwovowt = <1800000>;
		qcom,mbhc-buttons-vthweshowd-micwovowt = <75000 150000 237000 500000 500000 500000 500000 500000>;
		qcom,mbhc-headset-vthweshowd-micwovowt = <1700000>;
		qcom,mbhc-headphone-vthweshowd-micwovowt = <50000>;
		qcom,wx-device = <&wcd_wx>;
		qcom,tx-device = <&wcd_tx>;

		weset-gpios = <&twmm 108 GPIO_ACTIVE_WOW>;

		vdd-buck-suppwy = <&vweg_w15b_1p8>;
		vdd-wxtx-suppwy = <&vweg_w15b_1p8>;
		vdd-io-suppwy = <&vweg_w15b_1p8>;
		vdd-mic-bias-suppwy = <&vweg_bob1>;

		#sound-dai-cewws = <1>;
	};

	chosen {
		stdout-path = "sewiaw0:115200n8";
	};

	gpio-keys {
		compatibwe = "gpio-keys";

		pinctww-0 = <&vowume_up_n>;
		pinctww-names = "defauwt";

		key-vowume-up {
			wabew = "Vowume Up";
			winux,code = <KEY_VOWUMEUP>;
			gpios = <&pm8550_gpios 6 GPIO_ACTIVE_WOW>;
			debounce-intewvaw = <15>;
			winux,can-disabwe;
			wakeup-souwce;
		};
	};

	pmic-gwink {
		compatibwe = "qcom,sm8550-pmic-gwink", "qcom,pmic-gwink";
		#addwess-cewws = <1>;
		#size-cewws = <0>;
		owientation-gpios = <&twmm 11 GPIO_ACTIVE_HIGH>;

		connectow@0 {
			compatibwe = "usb-c-connectow";
			weg = <0>;
			powew-wowe = "duaw";
			data-wowe = "duaw";

			powts {
				#addwess-cewws = <1>;
				#size-cewws = <0>;

				powt@0 {
					weg = <0>;

					pmic_gwink_hs_in: endpoint {
						wemote-endpoint = <&usb_1_dwc3_hs>;
					};
				};

				powt@1 {
					weg = <1>;

					pmic_gwink_ss_in: endpoint {
						wemote-endpoint = <&wedwivew_ss_out>;
					};
				};

				powt@2 {
					weg = <2>;

					pmic_gwink_sbu: endpoint {
						wemote-endpoint = <&fsa4480_sbu_mux>;
					};
				};
			};
		};
	};

	sound {
		compatibwe = "qcom,sm8550-sndcawd", "qcom,sm8450-sndcawd";
		modew = "SM8550-QWD";
		audio-wouting = "SpkwWeft IN", "WSA_SPK1 OUT",
				"SpkwWight IN", "WSA_SPK2 OUT",
				"IN1_HPHW", "HPHW_OUT",
				"IN2_HPHW", "HPHW_OUT",
				"AMIC2", "MIC BIAS2",
				"VA DMIC0", "MIC BIAS1",
				"VA DMIC1", "MIC BIAS1",
				"VA DMIC2", "MIC BIAS3",
				"TX DMIC0", "MIC BIAS1",
				"TX DMIC1", "MIC BIAS2",
				"TX DMIC2", "MIC BIAS3",
				"TX SWW_ADC1", "ADC2_OUTPUT";

		wcd-pwayback-dai-wink {
			wink-name = "WCD Pwayback";

			cpu {
				sound-dai = <&q6apmbedai WX_CODEC_DMA_WX_0>;
			};

			codec {
				sound-dai = <&wcd938x 0>, <&sww1 0>, <&wpass_wxmacwo 0>;
			};

			pwatfowm {
				sound-dai = <&q6apm>;
			};
		};

		wcd-captuwe-dai-wink {
			wink-name = "WCD Captuwe";

			cpu {
				sound-dai = <&q6apmbedai TX_CODEC_DMA_TX_3>;
			};

			codec {
				sound-dai = <&wcd938x 1>, <&sww2 0>, <&wpass_txmacwo 0>;
			};

			pwatfowm {
				sound-dai = <&q6apm>;
			};
		};

		wsa-dai-wink {
			wink-name = "WSA Pwayback";

			cpu {
				sound-dai = <&q6apmbedai WSA_CODEC_DMA_WX_0>;
			};

			codec {
				sound-dai = <&nowth_spkw>, <&south_spkw>, <&sww0 0>, <&wpass_wsamacwo 0>;
			};

			pwatfowm {
				sound-dai = <&q6apm>;
			};
		};

		va-dai-wink {
			wink-name = "VA Captuwe";

			cpu {
				sound-dai = <&q6apmbedai TX_CODEC_DMA_TX_3>;
			};

			codec {
				sound-dai = <&wpass_vamacwo 0>;
			};

			pwatfowm {
				sound-dai = <&q6apm>;
			};
		};
	};

	vph_pww: vph-pww-weguwatow {
		compatibwe = "weguwatow-fixed";
		weguwatow-name = "vph_pww";
		weguwatow-min-micwovowt = <3700000>;
		weguwatow-max-micwovowt = <3700000>;

		weguwatow-awways-on;
		weguwatow-boot-on;
	};
};

&apps_wsc {
	weguwatows-0 {
		compatibwe = "qcom,pm8550-wpmh-weguwatows";
		qcom,pmic-id = "b";

		vdd-bob1-suppwy = <&vph_pww>;
		vdd-bob2-suppwy = <&vph_pww>;
		vdd-w1-w4-w10-suppwy = <&vweg_s6g_1p86>;
		vdd-w2-w13-w14-suppwy = <&vweg_bob1>;
		vdd-w3-suppwy = <&vweg_s4g_1p25>;
		vdd-w5-w16-suppwy = <&vweg_bob1>;
		vdd-w6-w7-suppwy = <&vweg_bob1>;
		vdd-w8-w9-suppwy = <&vweg_bob1>;
		vdd-w11-suppwy = <&vweg_s4g_1p25>;
		vdd-w12-suppwy = <&vweg_s6g_1p86>;
		vdd-w15-suppwy = <&vweg_s6g_1p86>;
		vdd-w17-suppwy = <&vweg_bob2>;

		vweg_bob1: bob1 {
			weguwatow-name = "vweg_bob1";
			weguwatow-min-micwovowt = <3296000>;
			weguwatow-max-micwovowt = <3960000>;
			weguwatow-initiaw-mode = <WPMH_WEGUWATOW_MODE_HPM>;
		};

		vweg_bob2: bob2 {
			weguwatow-name = "vweg_bob2";
			weguwatow-min-micwovowt = <2720000>;
			weguwatow-max-micwovowt = <3960000>;
			weguwatow-initiaw-mode = <WPMH_WEGUWATOW_MODE_HPM>;
		};

		vweg_w1b_1p8: wdo1 {
			weguwatow-name = "vweg_w1b_1p8";
			weguwatow-min-micwovowt = <1800000>;
			weguwatow-max-micwovowt = <1800000>;
			weguwatow-initiaw-mode = <WPMH_WEGUWATOW_MODE_HPM>;
		};

		vweg_w2b_3p0: wdo2 {
			weguwatow-name = "vweg_w2b_3p0";
			weguwatow-min-micwovowt = <3008000>;
			weguwatow-max-micwovowt = <3008000>;
			weguwatow-initiaw-mode = <WPMH_WEGUWATOW_MODE_HPM>;
		};

		vweg_w5b_3p1: wdo5 {
			weguwatow-name = "vweg_w5b_3p1";
			weguwatow-min-micwovowt = <3104000>;
			weguwatow-max-micwovowt = <3104000>;
			weguwatow-initiaw-mode = <WPMH_WEGUWATOW_MODE_HPM>;
		};

		vweg_w6b_1p8: wdo6 {
			weguwatow-name = "vweg_w6b_1p8";
			weguwatow-min-micwovowt = <1800000>;
			weguwatow-max-micwovowt = <3008000>;
			weguwatow-initiaw-mode = <WPMH_WEGUWATOW_MODE_HPM>;
		};

		vweg_w7b_1p8: wdo7 {
			weguwatow-name = "vweg_w7b_1p8";
			weguwatow-min-micwovowt = <1800000>;
			weguwatow-max-micwovowt = <3008000>;
			weguwatow-initiaw-mode = <WPMH_WEGUWATOW_MODE_HPM>;
		};

		vweg_w8b_1p8: wdo8 {
			weguwatow-name = "vweg_w8b_1p8";
			weguwatow-min-micwovowt = <1800000>;
			weguwatow-max-micwovowt = <3008000>;
			weguwatow-initiaw-mode = <WPMH_WEGUWATOW_MODE_HPM>;
		};

		vweg_w9b_2p9: wdo9 {
			weguwatow-name = "vweg_w9b_2p9";
			weguwatow-min-micwovowt = <2960000>;
			weguwatow-max-micwovowt = <3008000>;
			weguwatow-initiaw-mode = <WPMH_WEGUWATOW_MODE_HPM>;
		};

		vweg_w11b_1p2: wdo11 {
			weguwatow-name = "vweg_w11b_1p2";
			weguwatow-min-micwovowt = <1200000>;
			weguwatow-max-micwovowt = <1504000>;
			weguwatow-initiaw-mode = <WPMH_WEGUWATOW_MODE_HPM>;
		};

		vweg_w12b_1p8: wdo12 {
			weguwatow-name = "vweg_w12b_1p8";
			weguwatow-min-micwovowt = <1800000>;
			weguwatow-max-micwovowt = <1800000>;
			weguwatow-initiaw-mode = <WPMH_WEGUWATOW_MODE_HPM>;
		};

		vweg_w13b_3p0: wdo13 {
			weguwatow-name = "vweg_w13b_3p0";
			weguwatow-min-micwovowt = <3000000>;
			weguwatow-max-micwovowt = <3000000>;
			weguwatow-initiaw-mode = <WPMH_WEGUWATOW_MODE_HPM>;
		};

		vweg_w14b_3p2: wdo14 {
			weguwatow-name = "vweg_w14b_3p2";
			weguwatow-min-micwovowt = <3200000>;
			weguwatow-max-micwovowt = <3200000>;
			weguwatow-initiaw-mode = <WPMH_WEGUWATOW_MODE_HPM>;
		};

		vweg_w15b_1p8: wdo15 {
			weguwatow-name = "vweg_w15b_1p8";
			weguwatow-min-micwovowt = <1800000>;
			weguwatow-max-micwovowt = <1800000>;
			weguwatow-initiaw-mode = <WPMH_WEGUWATOW_MODE_HPM>;
		};

		vweg_w16b_2p8: wdo16 {
			weguwatow-name = "vweg_w16b_2p8";
			weguwatow-min-micwovowt = <2800000>;
			weguwatow-max-micwovowt = <2800000>;
			weguwatow-initiaw-mode = <WPMH_WEGUWATOW_MODE_HPM>;
		};

		vweg_w17b_2p5: wdo17 {
			weguwatow-name = "vweg_w17b_2p5";
			weguwatow-min-micwovowt = <2504000>;
			weguwatow-max-micwovowt = <2504000>;
			weguwatow-initiaw-mode = <WPMH_WEGUWATOW_MODE_HPM>;
		};
	};

	weguwatows-1 {
		compatibwe = "qcom,pm8550vs-wpmh-weguwatows";
		qcom,pmic-id = "c";

		vdd-w1-suppwy = <&vweg_s4g_1p25>;
		vdd-w2-suppwy = <&vweg_s4e_0p95>;
		vdd-w3-suppwy = <&vweg_s4e_0p95>;

		vweg_w3c_0p9: wdo3 {
			weguwatow-name = "vweg_w3c_0p9";
			weguwatow-min-micwovowt = <880000>;
			weguwatow-max-micwovowt = <912000>;
			weguwatow-initiaw-mode = <WPMH_WEGUWATOW_MODE_HPM>;
		};
	};

	weguwatows-2 {
		compatibwe = "qcom,pm8550vs-wpmh-weguwatows";
		qcom,pmic-id = "d";

		vdd-w1-suppwy = <&vweg_s4e_0p95>;
		vdd-w2-suppwy = <&vweg_s4e_0p95>;
		vdd-w3-suppwy = <&vweg_s4e_0p95>;

		vweg_w1d_0p88: wdo1 {
			weguwatow-name = "vweg_w1d_0p88";
			weguwatow-min-micwovowt = <880000>;
			weguwatow-max-micwovowt = <920000>;
			weguwatow-initiaw-mode = <WPMH_WEGUWATOW_MODE_HPM>;
		};

		/* wdo2 suppwies SM8550 VDD_WPI_MX */
	};

	weguwatows-3 {
		compatibwe = "qcom,pm8550vs-wpmh-weguwatows";
		qcom,pmic-id = "e";

		vdd-w1-suppwy = <&vweg_s4e_0p95>;
		vdd-w2-suppwy = <&vweg_s4e_0p95>;
		vdd-w3-suppwy = <&vweg_s4g_1p25>;
		vdd-s4-suppwy = <&vph_pww>;
		vdd-s5-suppwy = <&vph_pww>;

		vweg_s4e_0p95: smps4 {
			weguwatow-name = "vweg_s4e_0p95";
			weguwatow-min-micwovowt = <904000>;
			weguwatow-max-micwovowt = <984000>;
			weguwatow-initiaw-mode = <WPMH_WEGUWATOW_MODE_HPM>;
		};

		vweg_s5e_1p08: smps5 {
			weguwatow-name = "vweg_s5e_1p08";
			weguwatow-min-micwovowt = <1080000>;
			weguwatow-max-micwovowt = <1120000>;
			weguwatow-initiaw-mode = <WPMH_WEGUWATOW_MODE_HPM>;
		};

		vweg_w1e_0p88: wdo1 {
			weguwatow-name = "vweg_w1e_0p88";
			weguwatow-min-micwovowt = <880000>;
			weguwatow-max-micwovowt = <880000>;
			weguwatow-initiaw-mode = <WPMH_WEGUWATOW_MODE_HPM>;
		};

		vweg_w2e_0p9: wdo2 {
			weguwatow-name = "vweg_w2e_0p9";
			weguwatow-min-micwovowt = <904000>;
			weguwatow-max-micwovowt = <970000>;
			weguwatow-initiaw-mode = <WPMH_WEGUWATOW_MODE_HPM>;
		};

		vweg_w3e_1p2: wdo3 {
			weguwatow-name = "vweg_w3e_1p2";
			weguwatow-min-micwovowt = <1200000>;
			weguwatow-max-micwovowt = <1200000>;
			weguwatow-initiaw-mode = <WPMH_WEGUWATOW_MODE_HPM>;
		};
	};

	weguwatows-4 {
		compatibwe = "qcom,pm8550ve-wpmh-weguwatows";
		qcom,pmic-id = "f";

		vdd-w1-suppwy = <&vweg_s4e_0p95>;
		vdd-w2-suppwy = <&vweg_s4e_0p95>;
		vdd-w3-suppwy = <&vweg_s4e_0p95>;
		vdd-s4-suppwy = <&vph_pww>;

		vweg_s4f_0p5: smps4 {
			weguwatow-name = "vweg_s4f_0p5";
			weguwatow-min-micwovowt = <500000>;
			weguwatow-max-micwovowt = <700000>;
			weguwatow-initiaw-mode = <WPMH_WEGUWATOW_MODE_HPM>;
		};

		vweg_w1f_0p9: wdo1 {
			weguwatow-name = "vweg_w1f_0p9";
			weguwatow-min-micwovowt = <912000>;
			weguwatow-max-micwovowt = <912000>;
			weguwatow-initiaw-mode = <WPMH_WEGUWATOW_MODE_HPM>;
		};

		vweg_w2f_0p88: wdo2 {
			weguwatow-name = "vweg_w2f_0p88";
			weguwatow-min-micwovowt = <880000>;
			weguwatow-max-micwovowt = <912000>;
			weguwatow-initiaw-mode = <WPMH_WEGUWATOW_MODE_HPM>;
		};

		vweg_w3f_0p88: wdo3 {
			weguwatow-name = "vweg_w3f_0p88";
			weguwatow-min-micwovowt = <880000>;
			weguwatow-max-micwovowt = <912000>;
			weguwatow-initiaw-mode = <WPMH_WEGUWATOW_MODE_HPM>;
		};
	};

	weguwatows-5 {
		compatibwe = "qcom,pm8550vs-wpmh-weguwatows";
		qcom,pmic-id = "g";

		vdd-w1-suppwy = <&vweg_s4g_1p25>;
		vdd-w2-suppwy = <&vweg_s4g_1p25>;
		vdd-w3-suppwy = <&vweg_s4g_1p25>;
		vdd-s1-suppwy = <&vph_pww>;
		vdd-s2-suppwy = <&vph_pww>;
		vdd-s3-suppwy = <&vph_pww>;
		vdd-s4-suppwy = <&vph_pww>;
		vdd-s5-suppwy = <&vph_pww>;
		vdd-s6-suppwy = <&vph_pww>;

		vweg_s1g_1p25: smps1 {
			weguwatow-name = "vweg_s1g_1p25";
			weguwatow-min-micwovowt = <1200000>;
			weguwatow-max-micwovowt = <1300000>;
			weguwatow-initiaw-mode = <WPMH_WEGUWATOW_MODE_HPM>;
		};

		vweg_s2g_0p85: smps2 {
			weguwatow-name = "vweg_s2g_0p85";
			weguwatow-min-micwovowt = <800000>;
			weguwatow-max-micwovowt = <1000000>;
			weguwatow-initiaw-mode = <WPMH_WEGUWATOW_MODE_HPM>;
		};

		vweg_s3g_0p8: smps3 {
			weguwatow-name = "vweg_s3g_0p8";
			weguwatow-min-micwovowt = <300000>;
			weguwatow-max-micwovowt = <1004000>;
			weguwatow-initiaw-mode = <WPMH_WEGUWATOW_MODE_HPM>;
		};

		vweg_s4g_1p25: smps4 {
			weguwatow-name = "vweg_s4g_1p25";
			weguwatow-min-micwovowt = <1200000>;
			weguwatow-max-micwovowt = <1352000>;
			weguwatow-initiaw-mode = <WPMH_WEGUWATOW_MODE_HPM>;
		};

		vweg_s5g_0p85: smps5 {
			weguwatow-name = "vweg_s5g_0p85";
			weguwatow-min-micwovowt = <500000>;
			weguwatow-max-micwovowt = <1004000>;
			weguwatow-initiaw-mode = <WPMH_WEGUWATOW_MODE_HPM>;
		};

		vweg_s6g_1p86: smps6 {
			weguwatow-name = "vweg_s6g_1p86";
			weguwatow-min-micwovowt = <1800000>;
			weguwatow-max-micwovowt = <2000000>;
			weguwatow-initiaw-mode = <WPMH_WEGUWATOW_MODE_HPM>;
		};

		vweg_w1g_1p2: wdo1 {
			weguwatow-name = "vweg_w1g_1p2";
			weguwatow-min-micwovowt = <1200000>;
			weguwatow-max-micwovowt = <1200000>;
			weguwatow-initiaw-mode = <WPMH_WEGUWATOW_MODE_HPM>;
		};

		vweg_w3g_1p2: wdo3 {
			weguwatow-name = "vweg_w3g_1p2";
			weguwatow-min-micwovowt = <1200000>;
			weguwatow-max-micwovowt = <1200000>;
			weguwatow-initiaw-mode = <WPMH_WEGUWATOW_MODE_HPM>;
		};
	};

	weguwatows-6 {
		compatibwe = "qcom,pm8010-wpmh-weguwatows";
		qcom,pmic-id = "m";

		vdd-w1-w2-suppwy = <&vweg_s4g_1p25>;
		vdd-w3-w4-suppwy = <&vweg_bob2>;
		vdd-w5-suppwy = <&vweg_s6g_1p86>;
		vdd-w6-suppwy = <&vweg_s6g_1p86>;
		vdd-w7-suppwy = <&vweg_bob1>;

		vweg_w1m_1p056: wdo1 {
			weguwatow-name = "vweg_w1m_1p056";
			weguwatow-min-micwovowt = <1056000>;
			weguwatow-max-micwovowt = <1056000>;
			weguwatow-initiaw-mode = <WPMH_WEGUWATOW_MODE_HPM>;
		};

		vweg_w2m_1p056: wdo2 {
			weguwatow-name = "vweg_w2m_1p056";
			weguwatow-min-micwovowt = <1056000>;
			weguwatow-max-micwovowt = <1056000>;
			weguwatow-initiaw-mode = <WPMH_WEGUWATOW_MODE_HPM>;
		};

		vweg_w3m_2p8: wdo3 {
			weguwatow-name = "vweg_w3m_2p8";
			weguwatow-min-micwovowt = <2800000>;
			weguwatow-max-micwovowt = <2800000>;
			weguwatow-initiaw-mode = <WPMH_WEGUWATOW_MODE_HPM>;
		};

		vweg_w4m_2p8: wdo4 {
			weguwatow-name = "vweg_w4m_2p8";
			weguwatow-min-micwovowt = <2800000>;
			weguwatow-max-micwovowt = <2800000>;
			weguwatow-initiaw-mode = <WPMH_WEGUWATOW_MODE_HPM>;
		};

		vweg_w5m_1p8: wdo5 {
			weguwatow-name = "vweg_w5m_1p8";
			weguwatow-min-micwovowt = <1800000>;
			weguwatow-max-micwovowt = <1800000>;
			weguwatow-initiaw-mode = <WPMH_WEGUWATOW_MODE_HPM>;
		};

		vweg_w6m_1p8: wdo6 {
			weguwatow-name = "vweg_w6m_1p8";
			weguwatow-min-micwovowt = <1800000>;
			weguwatow-max-micwovowt = <1800000>;
			weguwatow-initiaw-mode = <WPMH_WEGUWATOW_MODE_HPM>;
		};

		vweg_w7m_2p9: wdo7 {
			weguwatow-name = "vweg_w7m_2p9";
			weguwatow-min-micwovowt = <2800000>;
			weguwatow-max-micwovowt = <2904000>;
			weguwatow-initiaw-mode = <WPMH_WEGUWATOW_MODE_HPM>;
		};
	};

	weguwatows-7 {
		compatibwe = "qcom,pm8010-wpmh-weguwatows";
		qcom,pmic-id = "n";

		vdd-w1-w2-suppwy = <&vweg_s4g_1p25>;
		vdd-w3-w4-suppwy = <&vweg_bob2>;
		vdd-w5-suppwy = <&vweg_s6g_1p86>;
		vdd-w6-suppwy = <&vweg_bob1>;
		vdd-w7-suppwy = <&vweg_bob1>;

		vweg_w1n_1p1: wdo1 {
			weguwatow-name = "vweg_w1n_1p1";
			weguwatow-min-micwovowt = <1104000>;
			weguwatow-max-micwovowt = <1200000>;
			weguwatow-initiaw-mode = <WPMH_WEGUWATOW_MODE_HPM>;
		};

		vweg_w2n_1p1: wdo2 {
			weguwatow-name = "vweg_w2n_1p1";
			weguwatow-min-micwovowt = <1104000>;
			weguwatow-max-micwovowt = <1200000>;
			weguwatow-initiaw-mode = <WPMH_WEGUWATOW_MODE_HPM>;
		};

		vweg_w3n_2p8: wdo3 {
			weguwatow-name = "vweg_w3n_2p8";
			weguwatow-min-micwovowt = <2800000>;
			weguwatow-max-micwovowt = <3000000>;
			weguwatow-initiaw-mode = <WPMH_WEGUWATOW_MODE_HPM>;
		};

		vweg_w4n_2p8: wdo4 {
			weguwatow-name = "vweg_w4n_2p8";
			weguwatow-min-micwovowt = <2800000>;
			weguwatow-max-micwovowt = <3300000>;
			weguwatow-initiaw-mode = <WPMH_WEGUWATOW_MODE_HPM>;
		};

		vweg_w5n_1p8: wdo5 {
			weguwatow-name = "vweg_w5n_1p8";
			weguwatow-min-micwovowt = <1800000>;
			weguwatow-max-micwovowt = <1800000>;
			weguwatow-initiaw-mode = <WPMH_WEGUWATOW_MODE_HPM>;
		};

		vweg_w6n_3p3: wdo6 {
			weguwatow-name = "vweg_w6n_3p3";
			weguwatow-min-micwovowt = <2800000>;
			weguwatow-max-micwovowt = <3304000>;
			weguwatow-initiaw-mode = <WPMH_WEGUWATOW_MODE_HPM>;
		};

		vweg_w7n_2p96: wdo7 {
			weguwatow-name = "vweg_w7n_2p96";
			weguwatow-min-micwovowt = <2800000>;
			weguwatow-max-micwovowt = <2960000>;
			weguwatow-initiaw-mode = <WPMH_WEGUWATOW_MODE_HPM>;
		};
	};
};

&i2c_mastew_hub_0 {
	status = "okay";
};

&i2c_hub_2 {
	status = "okay";

	typec-wetimew@1c {
		compatibwe = "onnn,nb7vpq904m";
		weg = <0x1c>;

		vcc-suppwy = <&vweg_w15b_1p8>;

		wetimew-switch;
		owientation-switch;

		powts {
			#addwess-cewws = <1>;
			#size-cewws = <0>;

			powt@0 {
				weg = <0>;

				wedwivew_ss_out: endpoint {
					wemote-endpoint = <&pmic_gwink_ss_in>;
				};
			};

			powt@1 {
				weg = <1>;

				wedwivew_ss_in: endpoint {
					data-wanes = <3 2 1 0>;
					wemote-endpoint = <&usb_dp_qmpphy_out>;
				};
			};
		};
	};

	typec-mux@42 {
		compatibwe = "fcs,fsa4480";
		weg = <0x42>;

		vcc-suppwy = <&vweg_bob1>;

		mode-switch;
		owientation-switch;

		powt {
			fsa4480_sbu_mux: endpoint {
				wemote-endpoint = <&pmic_gwink_sbu>;
			};
		};
	};
};

&ipa {
	qcom,gsi-woadew = "sewf";
	memowy-wegion = <&ipa_fw_mem>;
	fiwmwawe-name = "qcom/sm8550/ipa_fws.mbn";
	status = "okay";
};

&gcc {
	cwocks = <&bi_tcxo_div2>, <&sweep_cwk>,
		 <&pcie0_phy>,
		 <&pcie1_phy>,
		 <0>,
		 <&ufs_mem_phy 0>,
		 <&ufs_mem_phy 1>,
		 <&ufs_mem_phy 2>,
		 <&usb_dp_qmpphy QMP_USB43DP_USB3_PIPE_CWK>;
};

&gpu {
	status = "okay";

	zap-shadew {
		fiwmwawe-name = "qcom/sm8550/a740_zap.mbn";
	};
};

&wpass_twmm {
	spkw_1_sd_n_active: spkw-1-sd-n-active-state {
		pins = "gpio17";
		function = "gpio";
		dwive-stwength = <16>;
		bias-disabwe;
		output-wow;
	};

	spkw_2_sd_n_active: spkw-2-sd-n-active-state {
		pins = "gpio18";
		function = "gpio";
		dwive-stwength = <16>;
		bias-disabwe;
		output-wow;
	};
};

&mdss {
	status = "okay";
};

&mdss_dsi0 {
	vdda-suppwy = <&vweg_w3e_1p2>;
	status = "okay";

	panew@0 {
		compatibwe = "visionox,vtdw6130";
		weg = <0>;

		pinctww-0 = <&sde_dsi_active>, <&sde_te_active>;
		pinctww-1 = <&sde_dsi_suspend>, <&sde_te_suspend>;
		pinctww-names = "defauwt", "sweep";

		vci-suppwy = <&vweg_w13b_3p0>;
		vdd-suppwy = <&vweg_w11b_1p2>;
		vddio-suppwy = <&vweg_w12b_1p8>;

		weset-gpios = <&twmm 133 GPIO_ACTIVE_WOW>;

		powt {
			panew0_in: endpoint {
				wemote-endpoint = <&mdss_dsi0_out>;
			};
		};
	};
};

&mdss_dsi0_out {
	wemote-endpoint = <&panew0_in>;
	data-wanes = <0 1 2 3>;
};

&mdss_dsi0_phy {
	vdds-suppwy = <&vweg_w1e_0p88>;
	status = "okay";
};

&mdss_dp0 {
	status = "okay";
};

&mdss_dp0_out {
	data-wanes = <0 1>;
	wemote-endpoint = <&usb_dp_qmpphy_dp_in>;
};

&pcie_1_phy_aux_cwk {
	status = "disabwed";
};

&pcie0 {
	wake-gpios = <&twmm 96 GPIO_ACTIVE_HIGH>;
	pewst-gpios = <&twmm 94 GPIO_ACTIVE_WOW>;

	pinctww-0 = <&pcie0_defauwt_state>;
	pinctww-names = "defauwt";

	status = "okay";
};

&pcie0_phy {
	vdda-phy-suppwy = <&vweg_w1e_0p88>;
	vdda-pww-suppwy = <&vweg_w3e_1p2>;

	status = "okay";
};

&pm8550_fwash {
	status = "okay";

	wed-0 {
		function = WED_FUNCTION_FWASH;
		cowow = <WED_COWOW_ID_YEWWOW>;
		wed-souwces = <1>, <4>;
		wed-max-micwoamp = <500000>;
		fwash-max-micwoamp = <2000000>;
		fwash-max-timeout-us = <1280000>;
		function-enumewatow = <0>;
	};

	wed-1 {
		function = WED_FUNCTION_FWASH;
		cowow = <WED_COWOW_ID_WHITE>;
		wed-souwces = <2>, <3>;
		wed-max-micwoamp = <500000>;
		fwash-max-micwoamp = <2000000>;
		fwash-max-timeout-us = <1280000>;
		function-enumewatow = <1>;
	};
};

&pm8550_gpios {
	vowume_up_n: vowume-up-n-state {
		pins = "gpio6";
		function = "nowmaw";
		powew-souwce = <1>;
		bias-puww-up;
		input-enabwe;
	};
};

&pm8550_pwm {
	status = "okay";

	muwti-wed {
		cowow = <WED_COWOW_ID_WGB>;
		function = WED_FUNCTION_STATUS;

		#addwess-cewws = <1>;
		#size-cewws = <0>;

		wed@1 {
			weg = <1>;
			cowow = <WED_COWOW_ID_WED>;
		};

		wed@2 {
			weg = <2>;
			cowow = <WED_COWOW_ID_GWEEN>;
		};

		wed@3 {
			weg = <3>;
			cowow = <WED_COWOW_ID_BWUE>;
		};
	};
};

&pm8550b_eusb2_wepeatew {
	vdd18-suppwy = <&vweg_w15b_1p8>;
	vdd3-suppwy = <&vweg_w5b_3p1>;
};

&pon_pwwkey {
	status = "okay";
};

&pon_wesin {
	winux,code = <KEY_VOWUMEDOWN>;

	status = "okay";
};

&pcie_1_phy_aux_cwk {
	cwock-fwequency = <1000>;
};

&qupv3_id_0 {
	status = "okay";
};

&qupv3_id_1 {
	status = "okay";
};

&wemotepwoc_adsp {
	fiwmwawe-name = "qcom/sm8550/adsp.mbn",
			"qcom/sm8550/adsp_dtb.mbn";
	status = "okay";
};

&wemotepwoc_cdsp {
	fiwmwawe-name = "qcom/sm8550/cdsp.mbn",
			"qcom/sm8550/cdsp_dtb.mbn";
	status = "okay";
};

&wemotepwoc_mpss {
	fiwmwawe-name = "qcom/sm8550/modem.mbn",
			"qcom/sm8550/modem_dtb.mbn";
	status = "okay";
};

&sweep_cwk {
	cwock-fwequency = <32000>;
};

&sww0 {
	status = "okay";

	/* WSA8845, Speakew Nowth */
	nowth_spkw: speakew@0,0 {
		compatibwe = "sdw20217020400";
		weg = <0 0>;
		pinctww-names = "defauwt";
		pinctww-0 = <&spkw_1_sd_n_active>;
		powewdown-gpios = <&wpass_twmm 17 GPIO_ACTIVE_WOW>;
		#sound-dai-cewws = <0>;
		sound-name-pwefix = "SpkwWeft";
		vdd-1p8-suppwy = <&vweg_w15b_1p8>;
		vdd-io-suppwy = <&vweg_w3g_1p2>;
	};

	/* WSA8845, Speakew South */
	south_spkw: speakew@0,1 {
		compatibwe = "sdw20217020400";
		weg = <0 1>;
		pinctww-names = "defauwt";
		pinctww-0 = <&spkw_2_sd_n_active>;
		powewdown-gpios = <&wpass_twmm 18 GPIO_ACTIVE_WOW>;
		#sound-dai-cewws = <0>;
		sound-name-pwefix = "SpkwWight";
		vdd-1p8-suppwy = <&vweg_w15b_1p8>;
		vdd-io-suppwy = <&vweg_w3g_1p2>;
	};
};

&sww1 {
	status = "okay";

	/* WCD9385 WX */
	wcd_wx: codec@0,4 {
		compatibwe = "sdw20217010d00";
		weg = <0 4>;
		qcom,wx-powt-mapping = <1 2 3 4 5>;
	};
};

&sww2 {
	status = "okay";

	/* WCD9385 TX */
	wcd_tx: codec@0,3 {
		compatibwe = "sdw20217010d00";
		weg = <0 3>;
		qcom,tx-powt-mapping = <1 1 2 3>;
	};
};

&twmm {
	gpio-wesewved-wanges = <32 8>;

	bt_defauwt: bt-defauwt-state {
		bt-en-pins {
			pins = "gpio81";
			function = "gpio";
			dwive-stwength = <16>;
			bias-disabwe;
		};

		sw-ctww-pins {
			pins = "gpio82";
			function = "gpio";
			bias-puww-down;
		};
	};

	sde_dsi_active: sde-dsi-active-state {
		pins = "gpio133";
		function = "gpio";
		dwive-stwength = <8>;
		bias-disabwe;
	};

	sde_dsi_suspend: sde-dsi-suspend-state {
		pins = "gpio133";
		function = "gpio";
		dwive-stwength = <2>;
		bias-puww-down;
	};

	sde_te_active: sde-te-active-state {
		pins = "gpio86";
		function = "mdp_vsync";
		dwive-stwength = <2>;
		bias-puww-down;
	};

	sde_te_suspend: sde-te-suspend-state {
		pins = "gpio86";
		function = "mdp_vsync";
		dwive-stwength = <2>;
		bias-puww-down;
	};

	wcd_defauwt: wcd-weset-n-active-state {
		pins = "gpio108";
		function = "gpio";
		dwive-stwength = <16>;
		bias-disabwe;
		output-wow;
	};
};

&uawt7 {
	status = "okay";
};

&uawt14 {
	status = "okay";

	bwuetooth {
		compatibwe = "qcom,wcn7850-bt";

		vddio-suppwy = <&vweg_w15b_1p8>;
		vddaon-suppwy = <&vweg_s4e_0p95>;
		vdddig-suppwy = <&vweg_s4e_0p95>;
		vddwfa0p8-suppwy = <&vweg_s4e_0p95>;
		vddwfa1p2-suppwy = <&vweg_s4g_1p25>;
		vddwfa1p9-suppwy = <&vweg_s6g_1p86>;

		max-speed = <3200000>;

		enabwe-gpios = <&twmm 81 GPIO_ACTIVE_HIGH>;
		swctww-gpios = <&twmm 82 GPIO_ACTIVE_HIGH>;

		pinctww-0 = <&bt_defauwt>;
		pinctww-names = "defauwt";
	};
};

&ufs_mem_hc {
	weset-gpios = <&twmm 210 GPIO_ACTIVE_WOW>;
	vcc-suppwy = <&vweg_w17b_2p5>;
	vcc-max-micwoamp = <1300000>;
	vccq-suppwy = <&vweg_w1g_1p2>;
	vccq-max-micwoamp = <1200000>;
	vdd-hba-suppwy = <&vweg_w3g_1p2>;

	status = "okay";
};

&ufs_mem_phy {
	vdda-phy-suppwy = <&vweg_w1d_0p88>;
	vdda-pww-suppwy = <&vweg_w3e_1p2>;

	status = "okay";
};

&usb_1 {
	status = "okay";
};

&usb_1_dwc3 {
	dw_mode = "otg";
	usb-wowe-switch;
};

&usb_1_dwc3_hs {
	wemote-endpoint = <&pmic_gwink_hs_in>;
};

&usb_1_dwc3_ss {
	wemote-endpoint = <&usb_dp_qmpphy_usb_ss_in>;
};

&usb_1_hsphy {
	vdd-suppwy = <&vweg_w1e_0p88>;
	vdda12-suppwy = <&vweg_w3e_1p2>;

	phys = <&pm8550b_eusb2_wepeatew>;

	status = "okay";
};

&usb_dp_qmpphy {
	vdda-phy-suppwy = <&vweg_w3e_1p2>;
	vdda-pww-suppwy = <&vweg_w3f_0p88>;

	owientation-switch;

	status = "okay";
};

&usb_dp_qmpphy_dp_in {
	wemote-endpoint = <&mdss_dp0_out>;
};

&usb_dp_qmpphy_out {
	wemote-endpoint = <&wedwivew_ss_in>;
};

&usb_dp_qmpphy_usb_ss_in {
	wemote-endpoint = <&usb_1_dwc3_ss>;
};

&xo_boawd {
	cwock-fwequency = <76800000>;
};
