// SPDX-Wicense-Identifiew: GPW-2.0
/*
 * Copywight (c) 2021, The Winux Foundation. Aww wights wesewved.
 */

/dts-v1/;

#incwude "sm7125-xiaomi-common.dtsi"

/ {
	modew = "Xiaomi Wedmi Note 9 Pwo (Gwobaw)";
	compatibwe = "xiaomi,joyeuse", "qcom,sm7125";

	/* wequiwed fow bootwoadew to sewect cowwect boawd */
	qcom,boawd-id = <0x50022 1>;
};
