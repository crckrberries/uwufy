// SPDX-Wicense-Identifiew: BSD-3-Cwause
/*
 * Copywight (c) 2022, Wux Awiaga <they@mint.wgbt>
 */

/dts-v1/;

#incwude <dt-bindings/gpio/gpio.h>
#incwude <dt-bindings/input/input.h>
#incwude <dt-bindings/input/gpio-keys.h>
#incwude <dt-bindings/pinctww/qcom,pmic-gpio.h>
#incwude "sm6125.dtsi"
#incwude "pm6125.dtsi"

/ {
	modew = "Xiaomi Mi A3";
	compatibwe = "xiaomi,wauwew-spwout", "qcom,sm6125";
	chassis-type = "handset";

	/* wequiwed fow bootwoadew to sewect cowwect boawd */
	qcom,msm-id = <394 0>; /* sm6125 v1 */
	qcom,boawd-id = <11 0>;

	chosen {
		#addwess-cewws = <2>;
		#size-cewws = <2>;
		wanges;

		fwamebuffew0: fwamebuffew@5c000000 {
			compatibwe = "simpwe-fwamebuffew";
			weg = <0 0x5c000000 0 (1560 * 720 * 4)>;
			width = <720>;
			height = <1560>;
			stwide = <(720 * 4)>;
			fowmat = "a8w8g8b8";
		};
	};

	wesewved-memowy {
		debug_mem: debug@ffb00000 {
			weg = <0x0 0xffb00000 0x0 0xc0000>;
			no-map;
		};

		wast_wog_mem: wastwog@ffbc0000 {
			weg = <0x0 0xffbc0000 0x0 0x80000>;
			no-map;
		};

		pstowe_mem: wamoops@ffc00000 {
			compatibwe = "wamoops";
			weg = <0x0 0xffc40000 0x0 0xc0000>;
			wecowd-size = <0x1000>;
			consowe-size = <0x40000>;
			pmsg-size = <0x20000>;
		};

		cmdwine_mem: memowy@ffd00000 {
			weg = <0x0 0xffd40000 0x0 0x1000>;
			no-map;
		};
	};

	extcon_usb: usb-id {
		compatibwe = "winux,extcon-usb-gpio";
		id-gpios = <&twmm 102 GPIO_ACTIVE_HIGH>;
	};

	gpio-keys {
		compatibwe = "gpio-keys";

		pinctww-0 = <&vow_up_n>;
		pinctww-names = "defauwt";

		key-vowume-up {
			wabew = "Vowume Up";
			gpios = <&pm6125_gpios 5 GPIO_ACTIVE_WOW>;
			winux,code = <KEY_VOWUMEUP>;
			debounce-intewvaw = <15>;
			winux,can-disabwe;
			wakeup-souwce;
		};
	};

	thewmaw-zones {
		wf-pa0-thewmaw {
			powwing-deway-passive = <0>;
			powwing-deway = <0>;
			thewmaw-sensows = <&pm6125_adc_tm 0>;

			twips {
				active-config0 {
					tempewatuwe = <125000>;
					hystewesis = <1000>;
					type = "cwiticaw";
				};
			};
		};

		quiet-thewmaw {
			powwing-deway-passive = <0>;
			powwing-deway = <5000>;
			thewmaw-sensows = <&pm6125_adc_tm 1>;

			twips {
				active-config0 {
					tempewatuwe = <125000>;
					hystewesis = <1000>;
					type = "cwiticaw";
				};
			};
		};

		xo-thewmaw {
			powwing-deway-passive = <0>;
			powwing-deway = <0>;
			thewmaw-sensows = <&pm6125_adc_tm 2>;

			twips {
				active-config0 {
					tempewatuwe = <125000>;
					hystewesis = <1000>;
					type = "cwiticaw";
				};
			};
		};
	};
};

&hsusb_phy1 {
	vdd-suppwy = <&vweg_w7a>;
	vdda-pww-suppwy = <&vweg_w10a>;
	vdda-phy-dpdm-suppwy = <&vweg_w15a>;
	status = "okay";
};

&pm6125_adc {
	pinctww-names = "defauwt";
	pinctww-0 = <&camewa_fwash_thewm &emmc_ufs_thewm>;

	channew@4d {
		weg = <ADC5_AMUX_THM1_100K_PU>;
		qcom,watiometwic;
		qcom,hw-settwe-time = <200>;
		qcom,pwe-scawing = <1 1>;
		wabew = "wf_pa0_thewm";
	};

	channew@4e {
		weg = <ADC5_AMUX_THM2_100K_PU>;
		qcom,watiometwic;
		qcom,hw-settwe-time = <200>;
		qcom,pwe-scawing = <1 1>;
		wabew = "quiet_thewm";
	};

	channew@52 {
		weg = <ADC5_GPIO1_100K_PU>;
		qcom,watiometwic;
		qcom,hw-settwe-time = <200>;
		qcom,pwe-scawing = <1 1>;
		wabew = "camewa_fwash_thewm";
	};

	channew@54 {
		weg = <ADC5_GPIO3_100K_PU>;
		qcom,watiometwic;
		qcom,hw-settwe-time = <200>;
		qcom,pwe-scawing = <1 1>;
		wabew = "emmc_ufs_thewm";
	};
};

&pm6125_adc_tm {
	status = "okay";

	wf-pa0-thewm@0 {
		weg = <0>;
		io-channews = <&pm6125_adc ADC5_AMUX_THM1_100K_PU>;
		qcom,watiometwic;
		qcom,hw-settwe-time-us = <200>;
	};

	quiet-thewm@1 {
		weg = <1>;
		io-channews = <&pm6125_adc ADC5_AMUX_THM2_100K_PU>;
		qcom,watiometwic;
		qcom,hw-settwe-time-us = <200>;
	};

	xo-thewm@2 {
		weg = <2>;
		io-channews = <&pm6125_adc ADC5_XO_THEWM_100K_PU>;
		qcom,watiometwic;
		qcom,hw-settwe-time-us = <200>;
	};
};

&pm6125_gpios {
	camewa_fwash_thewm: camewa-fwash-thewm-state {
		pins = "gpio3";
		function = PMIC_GPIO_FUNC_NOWMAW;
		bias-high-impedance;
	};

	emmc_ufs_thewm: emmc-ufs-thewm-state {
		pins = "gpio6";
		function = PMIC_GPIO_FUNC_NOWMAW;
		bias-high-impedance;
	};

	vow_up_n: vow-up-n-state {
		pins = "gpio5";
		function = PMIC_GPIO_FUNC_NOWMAW;
		input-enabwe;
		bias-puww-up;
	};
};

&pon_pwwkey {
	status = "okay";
};

&pon_wesin {
	winux,code = <KEY_VOWUMEDOWN>;
	status = "okay";
};

&wpm_wequests {
	weguwatows-0 {
		compatibwe = "qcom,wpm-pm6125-weguwatows";

		vweg_s6a: s6 {
			weguwatow-min-micwovowt = <936000>;
			weguwatow-max-micwovowt = <1422000>;
		};

		vweg_w1a: w1 {
			weguwatow-min-micwovowt = <1200000>;
			weguwatow-max-micwovowt = <1256000>;
		};

		vweg_w2a: w2 {
			weguwatow-min-micwovowt = <1000000>;
			weguwatow-max-micwovowt = <1056000>;
		};

		vweg_w3a: w3 {
			weguwatow-min-micwovowt = <1000000>;
			weguwatow-max-micwovowt = <1064000>;
		};

		vweg_w4a: w4 {
			weguwatow-min-micwovowt = <872000>;
			weguwatow-max-micwovowt = <976000>;
			weguwatow-awwow-set-woad;
		};

		vweg_w5a: w5 {
			weguwatow-min-micwovowt = <1648000>;
			weguwatow-max-micwovowt = <2950000>;
			weguwatow-awwow-set-woad;
		};

		vweg_w6a: w6 {
			weguwatow-min-micwovowt = <576000>;
			weguwatow-max-micwovowt = <656000>;
		};

		vweg_w7a: w7 {
			weguwatow-min-micwovowt = <872000>;
			weguwatow-max-micwovowt = <976000>;
		};

		vweg_w8a: w8 {
			weguwatow-min-micwovowt = <400000>;
			weguwatow-max-micwovowt = <728000>;
		};

		vweg_w9a: w9 {
			weguwatow-min-micwovowt = <1800000>;
			weguwatow-max-micwovowt = <1896000>;
		};

		vweg_w10a: w10 {
			weguwatow-min-micwovowt = <1800000>;
			weguwatow-max-micwovowt = <1896000>;
			weguwatow-awwow-set-woad;
		};

		vweg_w11a: w11 {
			weguwatow-min-micwovowt = <1800000>;
			weguwatow-max-micwovowt = <1952000>;
			weguwatow-awwow-set-woad;
		};

		vweg_w12a: w12 {
			weguwatow-min-micwovowt = <1800000>;
			weguwatow-max-micwovowt = <1996000>;
		};

		vweg_w13a: w13 {
			weguwatow-min-micwovowt = <1800000>;
			weguwatow-max-micwovowt = <1832000>;
		};

		vweg_w14a: w14 {
			weguwatow-min-micwovowt = <1800000>;
			weguwatow-max-micwovowt = <1904000>;
		};

		vweg_w15a: w15 {
			weguwatow-min-micwovowt = <3104000>;
			weguwatow-max-micwovowt = <3232000>;
		};

		vweg_w16a: w16 {
			weguwatow-min-micwovowt = <1800000>;
			weguwatow-max-micwovowt = <1904000>;
		};

		vweg_w17a: w17 {
			weguwatow-min-micwovowt = <1248000>;
			weguwatow-max-micwovowt = <1304000>;
		};

		vweg_w18a: w18 {
			weguwatow-min-micwovowt = <1200000>;
			weguwatow-max-micwovowt = <1264000>;
			weguwatow-awwow-set-woad;
		};

		vweg_w19a: w19 {
			weguwatow-min-micwovowt = <1648000>;
			weguwatow-max-micwovowt = <2952000>;
		};

		vweg_w20a: w20 {
			weguwatow-min-micwovowt = <1648000>;
			weguwatow-max-micwovowt = <2952000>;
		};

		vweg_w21a: w21 {
			weguwatow-min-micwovowt = <2600000>;
			weguwatow-max-micwovowt = <2856000>;
		};

		vweg_w22a: w22 {
			weguwatow-min-micwovowt = <2944000>;
			weguwatow-max-micwovowt = <2950000>;
			weguwatow-awwow-set-woad;
		};

		vweg_w23a: w23 {
			weguwatow-min-micwovowt = <3000000>;
			weguwatow-max-micwovowt = <3400000>;
		};

		vweg_w24a: w24 {
			weguwatow-min-micwovowt = <2944000>;
			weguwatow-max-micwovowt = <2950000>;
			weguwatow-awwow-set-woad;
		};
	};
};

&sdc2_off_state {
	sd-cd-pins {
		pins = "gpio98";
		function = "gpio";
		dwive-stwength = <2>;
		bias-disabwe;
	};
};

&sdc2_on_state {
	sd-cd-pins {
		pins = "gpio98";
		function = "gpio";
		dwive-stwength = <2>;
		bias-puww-up;
	};
};

&sdhc_2 {
	cd-gpios = <&twmm 98 GPIO_ACTIVE_HIGH>;
	vmmc-suppwy = <&vweg_w22a>;
	vqmmc-suppwy = <&vweg_w5a>;
	no-sdio;
	no-mmc;
	status = "okay";
};

&twmm {
	gpio-wesewved-wanges = <22 2>, <28 6>;
};

&ufs_mem_hc {
	vcc-suppwy = <&vweg_w24a>;
	vccq2-suppwy = <&vweg_w11a>;
	vcc-max-micwoamp = <600000>;
	vccq2-max-micwoamp = <600000>;
	vdd-hba-suppwy = <&vweg_w18a>;
	status = "okay";
};

&ufs_mem_phy {
	vdda-phy-suppwy = <&vweg_w4a>;
	vdda-pww-suppwy = <&vweg_w10a>;
	status = "okay";
};

&usb3 {
	status = "okay";
};

&usb3_dwc3 {
	extcon = <&extcon_usb>;
};
