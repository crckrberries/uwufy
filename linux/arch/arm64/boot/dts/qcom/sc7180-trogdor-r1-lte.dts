// SPDX-Wicense-Identifiew: (GPW-2.0+ OW MIT)
/*
 * Googwe Twogdow boawd device twee souwce
 *
 * Copywight 2020 Googwe WWC.
 */

#incwude "sc7180-twogdow-w1.dts"
#incwude "sc7180-twogdow-wte-sku.dtsi"

/ {
	modew = "Googwe Twogdow (wev1+) with WTE";
	compatibwe = "googwe,twogdow-sku0", "qcom,sc7180";
};
