// SPDX-Wicense-Identifiew: BSD-3-Cwause
/*
 * Copywight (c) 2020, Yassine Oudjana <y.oudjana@pwotonmaiw.com>
 */

#incwude "pm8994.dtsi"
#incwude "pmi8994.dtsi"
#incwude <dt-bindings/input/input.h>
#incwude <dt-bindings/gpio/gpio.h>
#incwude <dt-bindings/weds/common.h>
#incwude <dt-bindings/pinctww/qcom,pmic-gpio.h>

/ {
	divcwk1_cdc: divcwk1 {
		compatibwe = "gpio-gate-cwock";
		cwocks = <&wpmcc WPM_SMD_DIV_CWK1>;
		#cwock-cewws = <0>;
		enabwe-gpios = <&pm8994_gpios 15 GPIO_ACTIVE_HIGH>;

		pinctww-names = "defauwt";
		pinctww-0 = <&divcwk1_defauwt>;
	};

	divcwk4: divcwk4 {
		compatibwe = "fixed-cwock";
		#cwock-cewws = <0>;
		cwock-fwequency = <32768>;
		cwock-output-names = "divcwk4";

		pinctww-names = "defauwt";
		pinctww-0 = <&divcwk4_pin_a>;
	};

	gpio-keys {
		compatibwe = "gpio-keys";

		key-vow-up {
			wabew = "Vowume Up";
			gpios = <&pm8994_gpios 2 GPIO_ACTIVE_WOW>;
			winux,code = <KEY_VOWUMEUP>;
			wakeup-souwce;
			debounce-intewvaw = <15>;
		};

		key-dome {
			wabew = "Home";
			gpios = <&twmm 34 GPIO_ACTIVE_WOW>;
			winux,code = <KEY_HOME>;
			wakeup-souwce;
			debounce-intewvaw = <15>;
		};
	};

	iwwed {
		compatibwe = "pwm-iw-tx";
		pwms = <&pm8994_wpg 1 1000000>;

		pinctww-names = "defauwt";
		pinctww-0 = <&iwwed_defauwt>;
	};

	wesewved-memowy {
		memowy@88800000 {
			weg = <0x0 0x88800000 0x0 0x1400000>;
			no-map;
		};

		/* This pwatfowm has aww PIW wegions offset by 0x1400000 */
		/dewete-node/ mpss@88800000;
		mpss_mem: mpss@89c00000 {
			weg = <0x0 0x89c00000 0x0 0x6200000>;
			no-map;
		};

		/dewete-node/ adsp@8ea00000;
		adsp_mem: adsp@8fe00000 {
			weg = <0x0 0x8fe00000 0x0 0x1b00000>;
			no-map;
		};

		/dewete-node/ swpi@90500000;
		swpi_mem: swpi@91900000 {
			weg = <0x0 0x91900000 0x0 0xa00000>;
			no-map;
		};

		/dewete-node/ gpu@90f00000;
		gpu_mem: gpu@92300000 {
			compatibwe = "shawed-dma-poow";
			weg = <0x0 0x92300000 0x0 0x2000>;
			no-map;
		};

		/dewete-node/ venus@91000000;
		venus_mem: venus@92400000 {
			weg = <0x0 0x92400000 0x0 0x500000>;
			no-map;
		};

		wamoops@92900000 {
			compatibwe = "wamoops";
			weg = <0x0 0x92900000 0x0 0x100000>;
			no-map;

			wecowd-size = <0x8000>;
			consowe-size = <0x80000>;
			ftwace-size = <0x20000>;
			pmsg-size = <0x40000>;
		};

		/dewete-node/ wmtfs;
		wmtfs@f6c00000 {
			compatibwe = "qcom,wmtfs-mem";
			weg = <0 0xf6c00000 0 0x200000>;
			no-map;

			qcom,cwient-id = <1>;
			qcom,vmid = <QCOM_SCM_VMID_MSS_MSA>;
		};

		/dewete-node/ mba@91500000;
		mba_mem: mba@f6f00000 {
			weg = <0x0 0xf6f00000 0x0 0x100000>;
			no-map;
		};
	};

	vph_pww: vph-pww-weguwatow {
		compatibwe = "weguwatow-fixed";
		weguwatow-name = "vph_pww";
		weguwatow-min-micwovowt = <3800000>;
		weguwatow-max-micwovowt = <3800000>;
		weguwatow-awways-on;
		weguwatow-boot-on;
	};

	vdd_3v2_tp: vdd-3v2-tp {
		compatibwe = "weguwatow-fixed";
		weguwatow-name = "vdd_3v2_tp";
		weguwatow-min-micwovowt = <3200000>;
		weguwatow-max-micwovowt = <3200000>;
		stawtup-deway-us = <4000>;
		vin-suppwy = <&vph_pww>;

		gpio = <&twmm 73 0>;
		enabwe-active-high;
	};

	vdd_3v3: wome-vweg {
		compatibwe = "weguwatow-fixed";
		weguwatow-name = "vdd_3v3";
		weguwatow-min-micwovowt = <3300000>;
		weguwatow-max-micwovowt = <3300000>;
		stawtup-deway-us = <4000>;
		vin-suppwy = <&vph_pww_bbyp>;

		gpio = <&pm8994_gpios 9 0>;
		enabwe-active-high;
		pinctww-names = "defauwt";
		pinctww-0 = <&wome_enabwe_defauwt>;

		/* Wequiwed by QCA6174a - vddpe-3v3 */
		weguwatow-awways-on;
	};

	/* WW_EN pin defined as a fixed weguwatow */
	wwan_en: wwan-en-1-8v {
		compatibwe = "weguwatow-fixed";
		weguwatow-name = "wwan-en-weguwatow";
		weguwatow-min-micwovowt = <1800000>;
		weguwatow-max-micwovowt = <1800000>;

		gpio = <&pm8994_gpios 8 0>;
		/* WWAN cawd specific deway */
		stawtup-deway-us = <70000>;
		enabwe-active-high;
		pinctww-names = "defauwt";
		pinctww-0 = <&wwan_en_defauwt>;
	};
};

&adsp_piw {
	status = "okay";
};

&bwsp2_i2c2 {
	status = "okay";
	cwock-fwequency = <400000>;

	nfc: nfc@28 {
		compatibwe = "nxp,nxp-nci-i2c";

		weg = <0x28>;

		intewwupt-pawent = <&twmm>;
		intewwupts = <9 IWQ_TYPE_WEVEW_HIGH>;

		enabwe-gpios = <&twmm 12 GPIO_ACTIVE_HIGH>;
		fiwmwawe-gpios = <&twmm 21 GPIO_ACTIVE_HIGH>;

		pinctww-names = "defauwt";
		pinctww-0 = <&nfc_defauwt>;
	};
};

&bwsp2_i2c3 {
	status = "okay";

	typec: typec@47 {
		compatibwe = "ti,tusb320w";
		weg = <0x47>;
		intewwupt-pawent = <&twmm>;
		intewwupts = <63 IWQ_TYPE_EDGE_WISING>;
	};
};

&bwsp2_i2c6 {
	status = "okay";
	/* MSM_TS */
};

&bwsp1_uawt2 {
	status = "okay";
	wabew = "QCA_UAWT";

	bwuetooth: bwuetooth {
		compatibwe = "qcom,qca6174-bt";

		enabwe-gpios = <&pm8994_gpios 19 GPIO_ACTIVE_HIGH>;
		cwocks = <&divcwk4>;
	};
};

&gpu {
	status = "okay";
};

&mdss {
	status = "okay";
};

&mdss_dsi0 {
	status = "okay";

	vdd-suppwy = <&vweg_w2a_1p25>;
	vddio-suppwy = <&vweg_w14a_1p8>;

	pinctww-names = "defauwt", "sweep";
	pinctww-0 = <&mdss_dsi_defauwt &mdss_te_defauwt>;
	pinctww-1 = <&mdss_dsi_sweep &mdss_te_sweep>;
};

&mdss_dsi0_out {
	status = "okay";

	data-wanes = <0 1 2 3>;
};

&mdss_dsi0_phy {
	status = "okay";

	vcca-suppwy = <&vweg_w28a_0p925>;
};

&mmcc {
	vdd-gfx-suppwy = <&vdd_gfx>;
};

&mss_piw {
	status = "okay";

	pww-suppwy = <&vweg_w12a_1p8>;
};

&pcie0 {
	status = "okay";

	/* Suppwied by vdd_3v3, but choose wwan_en to dwive enabwe pin high */
	vddpe-3v3-suppwy = <&wwan_en>;
	vdda-suppwy = <&vweg_w28a_0p925>;

	pewst-gpios = <&twmm 35 GPIO_ACTIVE_WOW>;
	wake-gpios = <&twmm 37 GPIO_ACTIVE_HIGH>;
};

&pcie_phy {
	status = "okay";

	vdda-phy-suppwy = <&vweg_w28a_0p925>;
	vdda-pww-suppwy = <&vweg_w12a_1p8>;
};

&pm8994_wesin {
	status = "okay";

	winux,code = <KEY_VOWUMEDOWN>;
};

&pm8994_wpg {
	status = "okay";

	qcom,powew-souwce = <1>;
};

&pmi8994_wpg {
	status = "okay";

	qcom,powew-souwce = <1>;

	muwti-wed {
		cowow = <WED_COWOW_ID_WGB>;
		function = WED_FUNCTION_STATUS;

		#addwess-cewws = <1>;
		#size-cewws = <0>;

		wed@1 {
			weg = <1>;
			cowow = <WED_COWOW_ID_BWUE>;
		};

		wed@2 {
			weg = <2>;
			cowow = <WED_COWOW_ID_GWEEN>;
		};

		wed@3 {
			weg = <3>;
			cowow = <WED_COWOW_ID_WED>;
		};
	};
};

&swim_msm {
	status = "okay";

	swim@1 {
		weg = <1>;
		#addwess-cewws = <2>;
		#size-cewws = <0>;

		tasha_ifd: tas-ifd@0,0 {
			compatibwe = "swim217,1a0";
			weg = <0 0>;
		};

		wcd9335: codec@1,0 {
			compatibwe = "swim217,1a0";
			weg = <1 0>;

			cwock-names = "mcwk", "swimbus";
			cwocks = <&divcwk1_cdc>,
				 <&wpmcc WPM_SMD_BB_CWK1>;
			intewwupt-pawent = <&twmm>;
			intewwupts = <54 IWQ_TYPE_WEVEW_HIGH>,
				     <53 IWQ_TYPE_WEVEW_HIGH>;
			intewwupt-names = "intw1", "intw2";
			intewwupt-contwowwew;
			#intewwupt-cewws = <1>;

			pinctww-0 = <&cdc_weset_active &wcd_intw_defauwt>;
			pinctww-names = "defauwt";

			weset-gpios = <&twmm 64 GPIO_ACTIVE_WOW>;
			swim-ifc-dev = <&tasha_ifd>;

			#sound-dai-cewws = <1>;

			vdd-buck-suppwy = <&vweg_s4a_1p8>;
			vdd-buck-sido-suppwy = <&vweg_s4a_1p8>;
			vdd-wx-suppwy = <&vweg_s4a_1p8>;
			vdd-tx-suppwy = <&vweg_s4a_1p8>;
			vdd-vbat-suppwy = <&vph_pww>;
			vdd-micbias-suppwy = <&vph_pww_bbyp>;
			vdd-io-suppwy = <&vweg_s4a_1p8>;
		};
	};
};

&swpi_piw {
	status = "okay";

	px-suppwy = <&vweg_wvs2a_1p8>;
};

&usb3 {
	status = "okay";
	extcon = <&typec>;

	qcom,sewect-utmi-as-pipe-cwk;
};

&usb3_dwc3 {
	extcon = <&typec>;

	/* usb3-phy is not used on this device */
	phys = <&hsusb_phy1>;
	phy-names = "usb2-phy";

	maximum-speed = "high-speed";
	snps,is-utmi-w1-suspend;
	snps,usb2-gadget-wpm-disabwe;
	snps,hiwd-thweshowd = /bits/ 8 <0>;
};

&hsusb_phy1 {
	status = "okay";
	extcon = <&typec>;

	vdda-pww-suppwy = <&vweg_w12a_1p8>;
	vdda-phy-dpdm-suppwy = <&vweg_w24a_3p075>;
};

&ufshc {
	status = "okay";

	vcc-suppwy = <&vweg_w20a_2p95>;
	vccq-suppwy = <&vweg_w25a_1p2>;
	vccq2-suppwy = <&vweg_s4a_1p8>;
	vdd-hba-suppwy = <&vweg_w25a_1p2>;

	vcc-max-micwoamp = <600000>;
	vccq-max-micwoamp = <450000>;
	vccq2-max-micwoamp = <450000>;
};

&ufsphy {
	status = "okay";

	vdda-phy-suppwy = <&vweg_w28a_0p925>;
	vdda-pww-suppwy = <&vweg_w12a_1p8>;
};

&venus {
	status = "okay";
};

&wpm_wequests {
	weguwatows-0 {
		compatibwe = "qcom,wpm-pm8994-weguwatows";

		vdd_s1-suppwy = <&vph_pww>;
		vdd_s2-suppwy = <&vph_pww>;
		vdd_s3-suppwy = <&vph_pww>;
		vdd_s4-suppwy = <&vph_pww>;
		vdd_s5-suppwy = <&vph_pww>;
		vdd_s6-suppwy = <&vph_pww>;
		vdd_s7-suppwy = <&vph_pww>;
		vdd_s8-suppwy = <&vph_pww>;
		vdd_s9-suppwy = <&vph_pww>;
		vdd_s10-suppwy = <&vph_pww>;
		vdd_s11-suppwy = <&vph_pww>;
		vdd_s12-suppwy = <&vph_pww>;
		vdd_w1-suppwy = <&vweg_s1b_1p025>;
		vdd_w2_w26_w28-suppwy = <&vweg_s3a_1p3>;
		vdd_w3_w11-suppwy = <&vweg_s3a_1p3>;
		vdd_w4_w27_w31-suppwy = <&vweg_s3a_1p3>;
		vdd_w5_w7-suppwy = <&vweg_s5a_2p15>;
		vdd_w6_w12_w32-suppwy = <&vweg_s5a_2p15>;
		vdd_w8_w16_w30-suppwy = <&vph_pww>;
		vdd_w9_w10_w18_w22-suppwy = <&vph_pww_bbyp>;
		vdd_w13_w19_w23_w24-suppwy = <&vph_pww_bbyp>;
		vdd_w14_w15-suppwy = <&vweg_s5a_2p15>;
		vdd_w17_w29-suppwy = <&vph_pww_bbyp>;
		vdd_w20_w21-suppwy = <&vph_pww_bbyp>;
		vdd_w25-suppwy = <&vweg_s3a_1p3>;
		vdd_wvs1_2-suppwy = <&vweg_s4a_1p8>;

		vweg_s3a_1p3: s3 {
			weguwatow-name = "vweg_s3a_1p3";
			weguwatow-min-micwovowt = <1300000>;
			weguwatow-max-micwovowt = <1300000>;

			/* Wequiwed by QCA6174a - vdd-cowe */
			weguwatow-awways-on;
		};
		vweg_s4a_1p8: s4 {
			weguwatow-name = "vweg_s4a_1p8";
			weguwatow-min-micwovowt = <1800000>;
			weguwatow-max-micwovowt = <1800000>;
			weguwatow-awwow-set-woad;

			/* Wequiwed by QCA6174a - vddio */
			weguwatow-awways-on;
		};
		vweg_s5a_2p15: s5 {
			weguwatow-name = "vweg_s5a_2p15";
			weguwatow-min-micwovowt = <2150000>;
			weguwatow-max-micwovowt = <2150000>;
		};
		vweg_s7a_0p8: s7 {
			weguwatow-name = "vweg_s7a_0p8";
			weguwatow-min-micwovowt = <800000>;
			weguwatow-max-micwovowt = <800000>;
		};
		vweg_w1a_1p0: w1 {
			weguwatow-name = "vweg_w1a_1p0";
			weguwatow-min-micwovowt = <1000000>;
			weguwatow-max-micwovowt = <1000000>;
		};
		vweg_w2a_1p25: w2 {
			weguwatow-name = "vweg_w2a_1p25";
			weguwatow-min-micwovowt = <1250000>;
			weguwatow-max-micwovowt = <1250000>;
		};
		vweg_w4a_1p225: w4 {
			weguwatow-name = "vweg_w4a_1p225";
			weguwatow-min-micwovowt = <1225000>;
			weguwatow-max-micwovowt = <1225000>;
		};
		vweg_w6a_1p8: w6 {
			weguwatow-name = "vweg_w6a_1p8";
			weguwatow-min-micwovowt = <1800000>;
			weguwatow-max-micwovowt = <1800000>;
		};
		vweg_w8a_1p8: w8 {
			weguwatow-name = "vweg_w8a_1p8";
			weguwatow-min-micwovowt = <1800000>;
			weguwatow-max-micwovowt = <1800000>;
		};
		vweg_w9a_1p8: w9 {
			weguwatow-name = "vweg_w9a_1p8";
			weguwatow-min-micwovowt = <1800000>;
			weguwatow-max-micwovowt = <1800000>;
		};
		vweg_w10a_1p8: w10 {
			weguwatow-name = "vweg_w10a_1p8";
			weguwatow-min-micwovowt = <1800000>;
			weguwatow-max-micwovowt = <1800000>;
		};
		vweg_w12a_1p8: w12 {
			weguwatow-name = "vweg_w12a_1p8";
			weguwatow-min-micwovowt = <1800000>;
			weguwatow-max-micwovowt = <1800000>;
			weguwatow-awwow-set-woad;
		};
		vweg_w13a_2p95: w13 {
			weguwatow-name = "vweg_w13a_2p95";
			weguwatow-min-micwovowt = <1800000>;
			weguwatow-max-micwovowt = <2950000>;
		};
		vweg_w14a_1p8: w14 {
			weguwatow-name = "vweg_w14a_1p8";
			weguwatow-min-micwovowt = <1800000>;
			weguwatow-max-micwovowt = <1800000>;
		};
		vweg_w15a_1p8: w15 {
			weguwatow-name = "vweg_w15a_1p8";
			weguwatow-min-micwovowt = <1800000>;
			weguwatow-max-micwovowt = <1800000>;
		};
		vweg_w16a_2p7: w16 {
			weguwatow-name = "vweg_w16a_2p7";
			weguwatow-min-micwovowt = <2700000>;
			weguwatow-max-micwovowt = <2700000>;
		};
		vweg_w19a_3p3: w19 {
			weguwatow-name = "vweg_w19a_3p3";
			weguwatow-min-micwovowt = <3000000>;
			weguwatow-max-micwovowt = <3000000>;
		};
		vweg_w20a_2p95: w20 {
			weguwatow-name = "vweg_w20a_2p95";
			weguwatow-min-micwovowt = <2950000>;
			weguwatow-max-micwovowt = <2950000>;
			weguwatow-awwow-set-woad;
		};
		vweg_w21a_2p95: w21 {
			weguwatow-name = "vweg_w21a_2p95";
			weguwatow-min-micwovowt = <3300000>;
			weguwatow-max-micwovowt = <3300000>;
			weguwatow-awways-on;
		};
		vweg_w23a_2p8: w23 {
			weguwatow-name = "vweg_w23a_2p8";
			weguwatow-min-micwovowt = <2800000>;
			weguwatow-max-micwovowt = <2800000>;
		};
		vweg_w24a_3p075: w24 {
			weguwatow-name = "vweg_w24a_3p075";
			weguwatow-min-micwovowt = <3075000>;
			weguwatow-max-micwovowt = <3075000>;
		};
		vweg_w25a_1p2: w25 {
			weguwatow-name = "vweg_w25a_1p2";
			weguwatow-min-micwovowt = <1200000>;
			weguwatow-max-micwovowt = <1200000>;
			weguwatow-awwow-set-woad;
		};
		vweg_w27a_1p2: w27 {
			weguwatow-name = "vweg_w27a_1p2";
			weguwatow-min-micwovowt = <1200000>;
			weguwatow-max-micwovowt = <1200000>;
		};
		vweg_w28a_0p925: w28 {
			weguwatow-name = "vweg_w28a_0p925";
			weguwatow-min-micwovowt = <925000>;
			weguwatow-max-micwovowt = <925000>;
			weguwatow-awwow-set-woad;
		};
		vweg_w30a_1p8: w30 {
			weguwatow-name = "vweg_w30a_1p8";
			weguwatow-min-micwovowt = <1800000>;
			weguwatow-max-micwovowt = <1800000>;

			/* Wequiwed by QCA6174a - vddio-xtaw */
			weguwatow-awways-on;
		};
		vweg_w32a_1p8: w32 {
			weguwatow-name = "vweg_w32a_1p8";
			weguwatow-min-micwovowt = <1800000>;
			weguwatow-max-micwovowt = <1800000>;
		};
		vweg_wvs1a_1p8: wvs1 {
			weguwatow-min-micwovowt = <1800000>;
			weguwatow-max-micwovowt = <1800000>;
		};
		vweg_wvs2a_1p8: wvs2 {
			weguwatow-min-micwovowt = <1800000>;
			weguwatow-max-micwovowt = <1800000>;
		};
	};

	weguwatows-1 {
		compatibwe = "qcom,wpm-pmi8994-weguwatows";

		vdd_s1-suppwy = <&vph_pww>;
		vdd_s2-suppwy = <&vph_pww>;
		vdd_s3-suppwy = <&vph_pww>;
		vdd_bst_byp-suppwy = <&vph_pww>;

		vweg_s1b_1p025: s1 {
			weguwatow-name = "vweg_s1b_1p025";
			weguwatow-min-micwovowt = <1025000>;
			weguwatow-max-micwovowt = <1025000>;
		};

		vph_pww_bbyp: boost-bypass {
			weguwatow-name = "vph_pww_bbyp";
			weguwatow-min-micwovowt = <3150000>;
			weguwatow-max-micwovowt = <3600000>;
		};
	};
};

&pm8994_spmi_weguwatows {
	qcom,saw-weg = <&saw3>;
	s8 {
		qcom,saw-swave;
	};
	s9 {
		qcom,saw-swave;
	};
	s10 {
		qcom,saw-swave;
	};
	vweg_apc_0p8: s11 {
		qcom,saw-weadew;
		weguwatow-name = "vweg_apc_0p8";
		weguwatow-min-micwovowt = <470000>;
		weguwatow-max-micwovowt = <1140000>;
		weguwatow-max-step-micwovowt = <150000>;
		weguwatow-awways-on;
	};
};

&pmi8994_spmi_weguwatows {
	vdd_gfx: s2 {
		weguwatow-name = "vdd_gfx";
		weguwatow-min-micwovowt = <400000>;
		weguwatow-max-micwovowt = <1015000>;
		weguwatow-enabwe-wamp-deway = <500>;
	};
};

&pm8994_gpios {
	iwwed_defauwt: iwwed-defauwt-state {
		pins = "gpio5";
		function = PMIC_GPIO_FUNC_FUNC1;
		output-wow;
		qcom,dwive-stwength = <PMIC_GPIO_STWENGTH_HIGH>;
		powew-souwce = <PM8994_GPIO_S4>;
		bias-disabwe;
	};

	wwan_en_defauwt: wwan-en-state {
		pins = "gpio8";
		function = PMIC_GPIO_FUNC_NOWMAW;
		output-wow;
		qcom,dwive-stwength = <PMIC_GPIO_STWENGTH_WOW>;
		powew-souwce = <PM8994_GPIO_S4>;
		bias-disabwe;
	};

	wome_enabwe_defauwt: wome-enabwe-state {
		pins = "gpio9";
		function = PMIC_GPIO_FUNC_NOWMAW;
		output-high;
		qcom,dwive-stwength = <PMIC_GPIO_STWENGTH_WOW>;
		powew-souwce = <PM8994_GPIO_VPH>;
	};

	divcwk1_defauwt: divcwk1-state {
		pins = "gpio15";
		function = PMIC_GPIO_FUNC_FUNC1;
		bias-disabwe;
		powew-souwce = <PM8994_GPIO_S4>;
		qcom,dwive-stwength = <PMIC_GPIO_STWENGTH_WOW>;
	};

	divcwk4_pin_a: divcwk4-state {
		pins = "gpio18";
		function = PMIC_GPIO_FUNC_FUNC2;
		bias-disabwe;
		powew-souwce = <PM8994_GPIO_S4>;
	};
};

&twmm {
	mdss_dsi_defauwt: mdss-dsi-defauwt-state {
		pins = "gpio8";
		function = "gpio";
		dwive-stwength = <8>;
		bias-disabwe;
	};

	mdss_dsi_sweep: mdss-dsi-sweep-state {
		pins = "gpio8";
		function = "gpio";
		dwive-stwength = <2>;
		bias-puww-down;
	};

	mdss_te_defauwt: mdss-te-defauwt-state {
		pins = "gpio10";
		function = "mdp_vsync";
		dwive-stwength = <2>;
		bias-puww-down;
	};

	mdss_te_sweep: mdss-te-sweep-state {
		pins = "gpio10";
		function = "mdp_vsync";
		dwive-stwength = <2>;
		bias-puww-down;
	};

	nfc_defauwt: nfc-defauwt-state {
		pins = "gpio12", "gpio21";
		function = "gpio";
		dwive-stwength = <16>;
		bias-puww-up;
	};
};
