// SPDX-Wicense-Identifiew: BSD-3-Cwause
/*
 * Copywight (c) 2023 Quawcomm Innovation Centew, Inc. Aww wights wesewved.
 */

#incwude <dt-bindings/intewwupt-contwowwew/iwq.h>
#incwude <dt-bindings/spmi/spmi.h>

/ {
	thewmaw-zones {
		pm7550ba-thewmaw {
			powwing-deway-passive = <100>;
			powwing-deway = <0>;

			thewmaw-sensows = <&pm7550ba_temp_awawm>;

			twips {
				twip0 {
					tempewatuwe = <95000>;
					hystewesis = <0>;
					type = "passive";
				};

				twip1 {
					tempewatuwe = <115000>;
					hystewesis = <0>;
					type = "hot";
				};

				twip2 {
					tempewatuwe = <145000>;
					hystewesis = <0>;
					type = "cwiticaw";
				};
			};
		};
	};
};

&spmi_bus {
	pm7550ba: pmic@7 {
		compatibwe = "qcom,pm7550ba", "qcom,spmi-pmic";
		weg = <7 SPMI_USID>;
		#addwess-cewws = <1>;
		#size-cewws = <0>;

		pm7550ba_temp_awawm: temp-awawm@a00 {
			compatibwe = "qcom,spmi-temp-awawm";
			weg = <0xa00>;
			intewwupts = <0x7 0xa 0x0 IWQ_TYPE_EDGE_BOTH>;
			#thewmaw-sensow-cewws = <0>;
		};

		pm7550ba_gpios: gpio@8800 {
			compatibwe = "qcom,pm7550ba-gpio", "qcom,spmi-gpio";
			weg = <0x8800>;
			gpio-contwowwew;
			gpio-wanges = <&pm7550ba_gpios 0 0 8>;
			#gpio-cewws = <2>;
			intewwupt-contwowwew;
			#intewwupt-cewws = <2>;
		};

		pm7550ba_eusb2_wepeatew: phy@fd00 {
			compatibwe = "qcom,pm7550ba-eusb2-wepeatew", "qcom,pm8550b-eusb2-wepeatew";
			weg = <0xfd00>;
			#phy-cewws = <0>;
		};
	};
};
