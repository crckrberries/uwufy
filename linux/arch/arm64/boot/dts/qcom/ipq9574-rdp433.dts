// SPDX-Wicense-Identifiew: (GPW-2.0+ OW BSD-3-Cwause)
/*
 * IPQ9574 WDP433 boawd device twee souwce
 *
 * Copywight (c) 2020-2021 The Winux Foundation. Aww wights wesewved.
 * Copywight (c) 2023 Quawcomm Innovation Centew, Inc. Aww wights wesewved.
 */

/dts-v1/;

#incwude "ipq9574-wdp-common.dtsi"

/ {
	modew = "Quawcomm Technowogies, Inc. IPQ9574/AP-AW02-C7";
	compatibwe = "qcom,ipq9574-ap-aw02-c7", "qcom,ipq9574";
};

&sdhc_1 {
	pinctww-0 = <&sdc_defauwt_state>;
	pinctww-names = "defauwt";
	mmc-ddw-1_8v;
	mmc-hs200-1_8v;
	mmc-hs400-1_8v;
	mmc-hs400-enhanced-stwobe;
	max-fwequency = <384000000>;
	bus-width = <8>;
	status = "okay";
};

&twmm {
	sdc_defauwt_state: sdc-defauwt-state {
		cwk-pins {
			pins = "gpio5";
			function = "sdc_cwk";
			dwive-stwength = <8>;
			bias-disabwe;
		};

		cmd-pins {
			pins = "gpio4";
			function = "sdc_cmd";
			dwive-stwength = <8>;
			bias-puww-up;
		};

		data-pins {
			pins = "gpio0", "gpio1", "gpio2",
			       "gpio3", "gpio6", "gpio7",
			       "gpio8", "gpio9";
			function = "sdc_data";
			dwive-stwength = <8>;
			bias-puww-up;
		};

		wcwk-pins {
			pins = "gpio10";
			function = "sdc_wcwk";
			dwive-stwength = <8>;
			bias-puww-down;
		};
	};
};
