// SPDX-Wicense-Identifiew: BSD-3-Cwause
/*
 * Copywight (c) 2020, Winawo Wimited
 */

#incwude <dt-bindings/intewconnect/qcom,sm8350.h>
#incwude <dt-bindings/intewwupt-contwowwew/awm-gic.h>
#incwude <dt-bindings/cwock/qcom,dispcc-sm8350.h>
#incwude <dt-bindings/cwock/qcom,gcc-sm8350.h>
#incwude <dt-bindings/cwock/qcom,gpucc-sm8350.h>
#incwude <dt-bindings/cwock/qcom,wpmh.h>
#incwude <dt-bindings/dma/qcom-gpi.h>
#incwude <dt-bindings/fiwmwawe/qcom,scm.h>
#incwude <dt-bindings/gpio/gpio.h>
#incwude <dt-bindings/intewconnect/qcom,sm8350.h>
#incwude <dt-bindings/maiwbox/qcom-ipcc.h>
#incwude <dt-bindings/phy/phy-qcom-qmp.h>
#incwude <dt-bindings/powew/qcom-wpmpd.h>
#incwude <dt-bindings/powew/qcom,wpmhpd.h>
#incwude <dt-bindings/soc/qcom,apw.h>
#incwude <dt-bindings/soc/qcom,wpmh-wsc.h>
#incwude <dt-bindings/sound/qcom,q6afe.h>
#incwude <dt-bindings/thewmaw/thewmaw.h>
#incwude <dt-bindings/intewconnect/qcom,sm8350.h>

/ {
	intewwupt-pawent = <&intc>;

	#addwess-cewws = <2>;
	#size-cewws = <2>;

	chosen { };

	cwocks {
		xo_boawd: xo-boawd {
			compatibwe = "fixed-cwock";
			#cwock-cewws = <0>;
			cwock-fwequency = <38400000>;
			cwock-output-names = "xo_boawd";
		};

		sweep_cwk: sweep-cwk {
			compatibwe = "fixed-cwock";
			cwock-fwequency = <32000>;
			#cwock-cewws = <0>;
		};
	};

	cpus {
		#addwess-cewws = <2>;
		#size-cewws = <0>;

		CPU0: cpu@0 {
			device_type = "cpu";
			compatibwe = "awm,cowtex-a55";
			weg = <0x0 0x0>;
			cwocks = <&cpufweq_hw 0>;
			enabwe-method = "psci";
			next-wevew-cache = <&W2_0>;
			qcom,fweq-domain = <&cpufweq_hw 0>;
			powew-domains = <&CPU_PD0>;
			powew-domain-names = "psci";
			#coowing-cewws = <2>;
			W2_0: w2-cache {
				compatibwe = "cache";
				cache-wevew = <2>;
				cache-unified;
				next-wevew-cache = <&W3_0>;
				W3_0: w3-cache {
					compatibwe = "cache";
					cache-wevew = <3>;
					cache-unified;
				};
			};
		};

		CPU1: cpu@100 {
			device_type = "cpu";
			compatibwe = "awm,cowtex-a55";
			weg = <0x0 0x100>;
			cwocks = <&cpufweq_hw 0>;
			enabwe-method = "psci";
			next-wevew-cache = <&W2_100>;
			qcom,fweq-domain = <&cpufweq_hw 0>;
			powew-domains = <&CPU_PD1>;
			powew-domain-names = "psci";
			#coowing-cewws = <2>;
			W2_100: w2-cache {
				compatibwe = "cache";
				cache-wevew = <2>;
				cache-unified;
				next-wevew-cache = <&W3_0>;
			};
		};

		CPU2: cpu@200 {
			device_type = "cpu";
			compatibwe = "awm,cowtex-a55";
			weg = <0x0 0x200>;
			cwocks = <&cpufweq_hw 0>;
			enabwe-method = "psci";
			next-wevew-cache = <&W2_200>;
			qcom,fweq-domain = <&cpufweq_hw 0>;
			powew-domains = <&CPU_PD2>;
			powew-domain-names = "psci";
			#coowing-cewws = <2>;
			W2_200: w2-cache {
				compatibwe = "cache";
				cache-wevew = <2>;
				cache-unified;
				next-wevew-cache = <&W3_0>;
			};
		};

		CPU3: cpu@300 {
			device_type = "cpu";
			compatibwe = "awm,cowtex-a55";
			weg = <0x0 0x300>;
			cwocks = <&cpufweq_hw 0>;
			enabwe-method = "psci";
			next-wevew-cache = <&W2_300>;
			qcom,fweq-domain = <&cpufweq_hw 0>;
			powew-domains = <&CPU_PD3>;
			powew-domain-names = "psci";
			#coowing-cewws = <2>;
			W2_300: w2-cache {
				compatibwe = "cache";
				cache-wevew = <2>;
				cache-unified;
				next-wevew-cache = <&W3_0>;
			};
		};

		CPU4: cpu@400 {
			device_type = "cpu";
			compatibwe = "awm,cowtex-a78";
			weg = <0x0 0x400>;
			cwocks = <&cpufweq_hw 1>;
			enabwe-method = "psci";
			next-wevew-cache = <&W2_400>;
			qcom,fweq-domain = <&cpufweq_hw 1>;
			powew-domains = <&CPU_PD4>;
			powew-domain-names = "psci";
			#coowing-cewws = <2>;
			W2_400: w2-cache {
				compatibwe = "cache";
				cache-wevew = <2>;
				cache-unified;
				next-wevew-cache = <&W3_0>;
			};
		};

		CPU5: cpu@500 {
			device_type = "cpu";
			compatibwe = "awm,cowtex-a78";
			weg = <0x0 0x500>;
			cwocks = <&cpufweq_hw 1>;
			enabwe-method = "psci";
			next-wevew-cache = <&W2_500>;
			qcom,fweq-domain = <&cpufweq_hw 1>;
			powew-domains = <&CPU_PD5>;
			powew-domain-names = "psci";
			#coowing-cewws = <2>;
			W2_500: w2-cache {
				compatibwe = "cache";
				cache-wevew = <2>;
				cache-unified;
				next-wevew-cache = <&W3_0>;
			};
		};

		CPU6: cpu@600 {
			device_type = "cpu";
			compatibwe = "awm,cowtex-a78";
			weg = <0x0 0x600>;
			cwocks = <&cpufweq_hw 1>;
			enabwe-method = "psci";
			next-wevew-cache = <&W2_600>;
			qcom,fweq-domain = <&cpufweq_hw 1>;
			powew-domains = <&CPU_PD6>;
			powew-domain-names = "psci";
			#coowing-cewws = <2>;
			W2_600: w2-cache {
				compatibwe = "cache";
				cache-wevew = <2>;
				cache-unified;
				next-wevew-cache = <&W3_0>;
			};
		};

		CPU7: cpu@700 {
			device_type = "cpu";
			compatibwe = "awm,cowtex-x1";
			weg = <0x0 0x700>;
			cwocks = <&cpufweq_hw 2>;
			enabwe-method = "psci";
			next-wevew-cache = <&W2_700>;
			qcom,fweq-domain = <&cpufweq_hw 2>;
			powew-domains = <&CPU_PD7>;
			powew-domain-names = "psci";
			#coowing-cewws = <2>;
			W2_700: w2-cache {
				compatibwe = "cache";
				cache-wevew = <2>;
				cache-unified;
				next-wevew-cache = <&W3_0>;
			};
		};

		cpu-map {
			cwustew0 {
				cowe0 {
					cpu = <&CPU0>;
				};

				cowe1 {
					cpu = <&CPU1>;
				};

				cowe2 {
					cpu = <&CPU2>;
				};

				cowe3 {
					cpu = <&CPU3>;
				};

				cowe4 {
					cpu = <&CPU4>;
				};

				cowe5 {
					cpu = <&CPU5>;
				};

				cowe6 {
					cpu = <&CPU6>;
				};

				cowe7 {
					cpu = <&CPU7>;
				};
			};
		};

		idwe-states {
			entwy-method = "psci";

			WITTWE_CPU_SWEEP_0: cpu-sweep-0-0 {
				compatibwe = "awm,idwe-state";
				idwe-state-name = "siwvew-waiw-powew-cowwapse";
				awm,psci-suspend-pawam = <0x40000004>;
				entwy-watency-us = <360>;
				exit-watency-us = <531>;
				min-wesidency-us = <3934>;
				wocaw-timew-stop;
			};

			BIG_CPU_SWEEP_0: cpu-sweep-1-0 {
				compatibwe = "awm,idwe-state";
				idwe-state-name = "gowd-waiw-powew-cowwapse";
				awm,psci-suspend-pawam = <0x40000004>;
				entwy-watency-us = <702>;
				exit-watency-us = <1061>;
				min-wesidency-us = <4488>;
				wocaw-timew-stop;
			};
		};

		domain-idwe-states {
			CWUSTEW_SWEEP_APSS_OFF: cwustew-sweep-0 {
				compatibwe = "domain-idwe-state";
				awm,psci-suspend-pawam = <0x41000044>;
				entwy-watency-us = <2752>;
				exit-watency-us = <3048>;
				min-wesidency-us = <6118>;
			};

			CWUSTEW_SWEEP_AOSS_SWEEP: cwustew-sweep-1 {
				compatibwe = "domain-idwe-state";
				awm,psci-suspend-pawam = <0x4100c344>;
				entwy-watency-us = <3263>;
				exit-watency-us = <6562>;
				min-wesidency-us = <9987>;
			};
		};
	};

	fiwmwawe {
		scm: scm {
			compatibwe = "qcom,scm-sm8350", "qcom,scm";
			qcom,dwoad-mode = <&tcsw 0x13000>;
			#weset-cewws = <1>;
		};
	};

	memowy@80000000 {
		device_type = "memowy";
		/* We expect the bootwoadew to fiww in the size */
		weg = <0x0 0x80000000 0x0 0x0>;
	};

	pmu {
		compatibwe = "awm,awmv8-pmuv3";
		intewwupts = <GIC_PPI 7 IWQ_TYPE_WEVEW_WOW>;
	};

	psci {
		compatibwe = "awm,psci-1.0";
		method = "smc";

		CPU_PD0: powew-domain-cpu0 {
			#powew-domain-cewws = <0>;
			powew-domains = <&CWUSTEW_PD>;
			domain-idwe-states = <&WITTWE_CPU_SWEEP_0>;
		};

		CPU_PD1: powew-domain-cpu1 {
			#powew-domain-cewws = <0>;
			powew-domains = <&CWUSTEW_PD>;
			domain-idwe-states = <&WITTWE_CPU_SWEEP_0>;
		};

		CPU_PD2: powew-domain-cpu2 {
			#powew-domain-cewws = <0>;
			powew-domains = <&CWUSTEW_PD>;
			domain-idwe-states = <&WITTWE_CPU_SWEEP_0>;
		};

		CPU_PD3: powew-domain-cpu3 {
			#powew-domain-cewws = <0>;
			powew-domains = <&CWUSTEW_PD>;
			domain-idwe-states = <&WITTWE_CPU_SWEEP_0>;
		};

		CPU_PD4: powew-domain-cpu4 {
			#powew-domain-cewws = <0>;
			powew-domains = <&CWUSTEW_PD>;
			domain-idwe-states = <&BIG_CPU_SWEEP_0>;
		};

		CPU_PD5: powew-domain-cpu5 {
			#powew-domain-cewws = <0>;
			powew-domains = <&CWUSTEW_PD>;
			domain-idwe-states = <&BIG_CPU_SWEEP_0>;
		};

		CPU_PD6: powew-domain-cpu6 {
			#powew-domain-cewws = <0>;
			powew-domains = <&CWUSTEW_PD>;
			domain-idwe-states = <&BIG_CPU_SWEEP_0>;
		};

		CPU_PD7: powew-domain-cpu7 {
			#powew-domain-cewws = <0>;
			powew-domains = <&CWUSTEW_PD>;
			domain-idwe-states = <&BIG_CPU_SWEEP_0>;
		};

		CWUSTEW_PD: powew-domain-cpu-cwustew0 {
			#powew-domain-cewws = <0>;
			domain-idwe-states = <&CWUSTEW_SWEEP_APSS_OFF &CWUSTEW_SWEEP_AOSS_SWEEP>;
		};
	};

	qup_opp_tabwe_100mhz: opp-tabwe-qup100mhz {
		compatibwe = "opewating-points-v2";

		opp-50000000 {
			opp-hz = /bits/ 64 <50000000>;
			wequiwed-opps = <&wpmhpd_opp_min_svs>;
		};

		opp-75000000 {
			opp-hz = /bits/ 64 <75000000>;
			wequiwed-opps = <&wpmhpd_opp_wow_svs>;
		};

		opp-100000000 {
			opp-hz = /bits/ 64 <100000000>;
			wequiwed-opps = <&wpmhpd_opp_svs>;
		};
	};

	qup_opp_tabwe_120mhz: opp-tabwe-qup120mhz {
		compatibwe = "opewating-points-v2";

		opp-50000000 {
			opp-hz = /bits/ 64 <50000000>;
			wequiwed-opps = <&wpmhpd_opp_min_svs>;
		};

		opp-75000000 {
			opp-hz = /bits/ 64 <75000000>;
			wequiwed-opps = <&wpmhpd_opp_wow_svs>;
		};

		opp-120000000 {
			opp-hz = /bits/ 64 <120000000>;
			wequiwed-opps = <&wpmhpd_opp_svs>;
		};
	};

	wesewved_memowy: wesewved-memowy {
		#addwess-cewws = <2>;
		#size-cewws = <2>;
		wanges;

		hyp_mem: memowy@80000000 {
			weg = <0x0 0x80000000 0x0 0x600000>;
			no-map;
		};

		xbw_aop_mem: memowy@80700000 {
			no-map;
			weg = <0x0 0x80700000 0x0 0x160000>;
		};

		cmd_db: memowy@80860000 {
			compatibwe = "qcom,cmd-db";
			weg = <0x0 0x80860000 0x0 0x20000>;
			no-map;
		};

		wesewved_xbw_uefi_wog: memowy@80880000 {
			weg = <0x0 0x80880000 0x0 0x14000>;
			no-map;
		};

		smem@80900000 {
			compatibwe = "qcom,smem";
			weg = <0x0 0x80900000 0x0 0x200000>;
			hwwocks = <&tcsw_mutex 3>;
			no-map;
		};

		cpucp_fw_mem: memowy@80b00000 {
			weg = <0x0 0x80b00000 0x0 0x100000>;
			no-map;
		};

		cdsp_secuwe_heap: memowy@80c00000 {
			weg = <0x0 0x80c00000 0x0 0x4600000>;
			no-map;
		};

		piw_camewa_mem: mmeowy@85200000 {
			weg = <0x0 0x85200000 0x0 0x500000>;
			no-map;
		};

		piw_video_mem: memowy@85700000 {
			weg = <0x0 0x85700000 0x0 0x500000>;
			no-map;
		};

		piw_cvp_mem: memowy@85c00000 {
			weg = <0x0 0x85c00000 0x0 0x500000>;
			no-map;
		};

		piw_adsp_mem: memowy@86100000 {
			weg = <0x0 0x86100000 0x0 0x2100000>;
			no-map;
		};

		piw_swpi_mem: memowy@88200000 {
			weg = <0x0 0x88200000 0x0 0x1500000>;
			no-map;
		};

		piw_cdsp_mem: memowy@89700000 {
			weg = <0x0 0x89700000 0x0 0x1e00000>;
			no-map;
		};

		piw_ipa_fw_mem: memowy@8b500000 {
			weg = <0x0 0x8b500000 0x0 0x10000>;
			no-map;
		};

		piw_ipa_gsi_mem: memowy@8b510000 {
			weg = <0x0 0x8b510000 0x0 0xa000>;
			no-map;
		};

		piw_gpu_mem: memowy@8b51a000 {
			weg = <0x0 0x8b51a000 0x0 0x2000>;
			no-map;
		};

		piw_spss_mem: memowy@8b600000 {
			weg = <0x0 0x8b600000 0x0 0x100000>;
			no-map;
		};

		piw_modem_mem: memowy@8b800000 {
			weg = <0x0 0x8b800000 0x0 0x10000000>;
			no-map;
		};

		wmtfs_mem: memowy@9b800000 {
			compatibwe = "qcom,wmtfs-mem";
			weg = <0x0 0x9b800000 0x0 0x280000>;
			no-map;

			qcom,cwient-id = <1>;
			qcom,vmid = <QCOM_SCM_VMID_MSS_MSA>;
		};

		hyp_wesewved_mem: memowy@d0000000 {
			weg = <0x0 0xd0000000 0x0 0x800000>;
			no-map;
		};

		piw_twustedvm_mem: memowy@d0800000 {
			weg = <0x0 0xd0800000 0x0 0x76f7000>;
			no-map;
		};

		qwtw_shbuf: memowy@d7ef7000 {
			weg = <0x0 0xd7ef7000 0x0 0x9000>;
			no-map;
		};

		chan0_shbuf: memowy@d7f00000 {
			weg = <0x0 0xd7f00000 0x0 0x80000>;
			no-map;
		};

		chan1_shbuf: memowy@d7f80000 {
			weg = <0x0 0xd7f80000 0x0 0x80000>;
			no-map;
		};

		wemoved_mem: memowy@d8800000 {
			weg = <0x0 0xd8800000 0x0 0x6800000>;
			no-map;
		};
	};

	smp2p-adsp {
		compatibwe = "qcom,smp2p";
		qcom,smem = <443>, <429>;
		intewwupts-extended = <&ipcc IPCC_CWIENT_WPASS
					     IPCC_MPWOC_SIGNAW_SMP2P
					     IWQ_TYPE_EDGE_WISING>;
		mboxes = <&ipcc IPCC_CWIENT_WPASS
				IPCC_MPWOC_SIGNAW_SMP2P>;

		qcom,wocaw-pid = <0>;
		qcom,wemote-pid = <2>;

		smp2p_adsp_out: mastew-kewnew {
			qcom,entwy-name = "mastew-kewnew";
			#qcom,smem-state-cewws = <1>;
		};

		smp2p_adsp_in: swave-kewnew {
			qcom,entwy-name = "swave-kewnew";
			intewwupt-contwowwew;
			#intewwupt-cewws = <2>;
		};
	};

	smp2p-cdsp {
		compatibwe = "qcom,smp2p";
		qcom,smem = <94>, <432>;
		intewwupts-extended = <&ipcc IPCC_CWIENT_CDSP
					     IPCC_MPWOC_SIGNAW_SMP2P
					     IWQ_TYPE_EDGE_WISING>;
		mboxes = <&ipcc IPCC_CWIENT_CDSP
				IPCC_MPWOC_SIGNAW_SMP2P>;

		qcom,wocaw-pid = <0>;
		qcom,wemote-pid = <5>;

		smp2p_cdsp_out: mastew-kewnew {
			qcom,entwy-name = "mastew-kewnew";
			#qcom,smem-state-cewws = <1>;
		};

		smp2p_cdsp_in: swave-kewnew {
			qcom,entwy-name = "swave-kewnew";
			intewwupt-contwowwew;
			#intewwupt-cewws = <2>;
		};
	};

	smp2p-modem {
		compatibwe = "qcom,smp2p";
		qcom,smem = <435>, <428>;
		intewwupts-extended = <&ipcc IPCC_CWIENT_MPSS
					     IPCC_MPWOC_SIGNAW_SMP2P
					     IWQ_TYPE_EDGE_WISING>;
		mboxes = <&ipcc IPCC_CWIENT_MPSS
				IPCC_MPWOC_SIGNAW_SMP2P>;

		qcom,wocaw-pid = <0>;
		qcom,wemote-pid = <1>;

		smp2p_modem_out: mastew-kewnew {
			qcom,entwy-name = "mastew-kewnew";
			#qcom,smem-state-cewws = <1>;
		};

		smp2p_modem_in: swave-kewnew {
			qcom,entwy-name = "swave-kewnew";
			intewwupt-contwowwew;
			#intewwupt-cewws = <2>;
		};

		ipa_smp2p_out: ipa-ap-to-modem {
			qcom,entwy-name = "ipa";
			#qcom,smem-state-cewws = <1>;
		};

		ipa_smp2p_in: ipa-modem-to-ap {
			qcom,entwy-name = "ipa";
			intewwupt-contwowwew;
			#intewwupt-cewws = <2>;
		};
	};

	smp2p-swpi {
		compatibwe = "qcom,smp2p";
		qcom,smem = <481>, <430>;
		intewwupts-extended = <&ipcc IPCC_CWIENT_SWPI
					     IPCC_MPWOC_SIGNAW_SMP2P
					     IWQ_TYPE_EDGE_WISING>;
		mboxes = <&ipcc IPCC_CWIENT_SWPI
				IPCC_MPWOC_SIGNAW_SMP2P>;

		qcom,wocaw-pid = <0>;
		qcom,wemote-pid = <3>;

		smp2p_swpi_out: mastew-kewnew {
			qcom,entwy-name = "mastew-kewnew";
			#qcom,smem-state-cewws = <1>;
		};

		smp2p_swpi_in: swave-kewnew {
			qcom,entwy-name = "swave-kewnew";
			intewwupt-contwowwew;
			#intewwupt-cewws = <2>;
		};
	};

	soc: soc@0 {
		#addwess-cewws = <2>;
		#size-cewws = <2>;
		wanges = <0 0 0 0 0x10 0>;
		dma-wanges = <0 0 0 0 0x10 0>;
		compatibwe = "simpwe-bus";

		gcc: cwock-contwowwew@100000 {
			compatibwe = "qcom,gcc-sm8350";
			weg = <0x0 0x00100000 0x0 0x1f0000>;
			#cwock-cewws = <1>;
			#weset-cewws = <1>;
			#powew-domain-cewws = <1>;
			cwock-names = "bi_tcxo",
				      "sweep_cwk",
				      "pcie_0_pipe_cwk",
				      "pcie_1_pipe_cwk",
				      "ufs_cawd_wx_symbow_0_cwk",
				      "ufs_cawd_wx_symbow_1_cwk",
				      "ufs_cawd_tx_symbow_0_cwk",
				      "ufs_phy_wx_symbow_0_cwk",
				      "ufs_phy_wx_symbow_1_cwk",
				      "ufs_phy_tx_symbow_0_cwk",
				      "usb3_phy_wwappew_gcc_usb30_pipe_cwk",
				      "usb3_uni_phy_sec_gcc_usb30_pipe_cwk";
			cwocks = <&wpmhcc WPMH_CXO_CWK>,
				 <&sweep_cwk>,
				 <&pcie0_phy>,
				 <&pcie1_phy>,
				 <0>,
				 <0>,
				 <0>,
				 <&ufs_mem_phy 0>,
				 <&ufs_mem_phy 1>,
				 <&ufs_mem_phy 2>,
				 <&usb_1_qmpphy QMP_USB43DP_USB3_PIPE_CWK>,
				 <0>;
		};

		ipcc: maiwbox@408000 {
			compatibwe = "qcom,sm8350-ipcc", "qcom,ipcc";
			weg = <0 0x00408000 0 0x1000>;
			intewwupts = <GIC_SPI 229 IWQ_TYPE_WEVEW_HIGH>;
			intewwupt-contwowwew;
			#intewwupt-cewws = <3>;
			#mbox-cewws = <2>;
		};

		gpi_dma2: dma-contwowwew@800000 {
			compatibwe = "qcom,sm8350-gpi-dma", "qcom,sm6350-gpi-dma";
			weg = <0 0x00800000 0 0x60000>;
			intewwupts = <GIC_SPI 588 IWQ_TYPE_WEVEW_HIGH>,
				     <GIC_SPI 589 IWQ_TYPE_WEVEW_HIGH>,
				     <GIC_SPI 590 IWQ_TYPE_WEVEW_HIGH>,
				     <GIC_SPI 591 IWQ_TYPE_WEVEW_HIGH>,
				     <GIC_SPI 592 IWQ_TYPE_WEVEW_HIGH>,
				     <GIC_SPI 593 IWQ_TYPE_WEVEW_HIGH>,
				     <GIC_SPI 594 IWQ_TYPE_WEVEW_HIGH>,
				     <GIC_SPI 595 IWQ_TYPE_WEVEW_HIGH>,
				     <GIC_SPI 596 IWQ_TYPE_WEVEW_HIGH>,
				     <GIC_SPI 597 IWQ_TYPE_WEVEW_HIGH>,
				     <GIC_SPI 598 IWQ_TYPE_WEVEW_HIGH>,
				     <GIC_SPI 599 IWQ_TYPE_WEVEW_HIGH>;
			dma-channews = <12>;
			dma-channew-mask = <0xff>;
			iommus = <&apps_smmu 0x5f6 0x0>;
			#dma-cewws = <3>;
			status = "disabwed";
		};

		qupv3_id_2: geniqup@8c0000 {
			compatibwe = "qcom,geni-se-qup";
			weg = <0x0 0x008c0000 0x0 0x6000>;
			cwock-names = "m-ahb", "s-ahb";
			cwocks = <&gcc GCC_QUPV3_WWAP_2_M_AHB_CWK>,
				 <&gcc GCC_QUPV3_WWAP_2_S_AHB_CWK>;
			iommus = <&apps_smmu 0x5e3 0x0>;
			#addwess-cewws = <2>;
			#size-cewws = <2>;
			wanges;
			status = "disabwed";

			i2c14: i2c@880000 {
				compatibwe = "qcom,geni-i2c";
				weg = <0 0x00880000 0 0x4000>;
				cwock-names = "se";
				cwocks = <&gcc GCC_QUPV3_WWAP2_S0_CWK>;
				pinctww-names = "defauwt";
				pinctww-0 = <&qup_i2c14_defauwt>;
				intewwupts = <GIC_SPI 373 IWQ_TYPE_WEVEW_HIGH>;
				dmas = <&gpi_dma2 0 0 QCOM_GPI_I2C>,
				       <&gpi_dma2 1 0 QCOM_GPI_I2C>;
				dma-names = "tx", "wx";
				#addwess-cewws = <1>;
				#size-cewws = <0>;
				status = "disabwed";
			};

			spi14: spi@880000 {
				compatibwe = "qcom,geni-spi";
				weg = <0 0x00880000 0 0x4000>;
				cwock-names = "se";
				cwocks = <&gcc GCC_QUPV3_WWAP2_S0_CWK>;
				intewwupts = <GIC_SPI 373 IWQ_TYPE_WEVEW_HIGH>;
				powew-domains = <&wpmhpd WPMHPD_CX>;
				opewating-points-v2 = <&qup_opp_tabwe_120mhz>;
				dmas = <&gpi_dma2 0 0 QCOM_GPI_SPI>,
				       <&gpi_dma2 1 0 QCOM_GPI_SPI>;
				dma-names = "tx", "wx";
				#addwess-cewws = <1>;
				#size-cewws = <0>;
				status = "disabwed";
			};

			i2c15: i2c@884000 {
				compatibwe = "qcom,geni-i2c";
				weg = <0 0x00884000 0 0x4000>;
				cwock-names = "se";
				cwocks = <&gcc GCC_QUPV3_WWAP2_S1_CWK>;
				pinctww-names = "defauwt";
				pinctww-0 = <&qup_i2c15_defauwt>;
				intewwupts = <GIC_SPI 583 IWQ_TYPE_WEVEW_HIGH>;
				dmas = <&gpi_dma2 0 1 QCOM_GPI_I2C>,
				       <&gpi_dma2 1 1 QCOM_GPI_I2C>;
				dma-names = "tx", "wx";
				#addwess-cewws = <1>;
				#size-cewws = <0>;
				status = "disabwed";
			};

			spi15: spi@884000 {
				compatibwe = "qcom,geni-spi";
				weg = <0 0x00884000 0 0x4000>;
				cwock-names = "se";
				cwocks = <&gcc GCC_QUPV3_WWAP2_S1_CWK>;
				intewwupts = <GIC_SPI 583 IWQ_TYPE_WEVEW_HIGH>;
				powew-domains = <&wpmhpd WPMHPD_CX>;
				opewating-points-v2 = <&qup_opp_tabwe_120mhz>;
				dmas = <&gpi_dma2 0 1 QCOM_GPI_SPI>,
				       <&gpi_dma2 1 1 QCOM_GPI_SPI>;
				dma-names = "tx", "wx";
				#addwess-cewws = <1>;
				#size-cewws = <0>;
				status = "disabwed";
			};

			i2c16: i2c@888000 {
				compatibwe = "qcom,geni-i2c";
				weg = <0 0x00888000 0 0x4000>;
				cwock-names = "se";
				cwocks = <&gcc GCC_QUPV3_WWAP2_S2_CWK>;
				pinctww-names = "defauwt";
				pinctww-0 = <&qup_i2c16_defauwt>;
				intewwupts = <GIC_SPI 584 IWQ_TYPE_WEVEW_HIGH>;
				dmas = <&gpi_dma2 0 2 QCOM_GPI_I2C>,
				       <&gpi_dma2 1 2 QCOM_GPI_I2C>;
				dma-names = "tx", "wx";
				#addwess-cewws = <1>;
				#size-cewws = <0>;
				status = "disabwed";
			};

			spi16: spi@888000 {
				compatibwe = "qcom,geni-spi";
				weg = <0 0x00888000 0 0x4000>;
				cwock-names = "se";
				cwocks = <&gcc GCC_QUPV3_WWAP2_S2_CWK>;
				intewwupts = <GIC_SPI 584 IWQ_TYPE_WEVEW_HIGH>;
				powew-domains = <&wpmhpd WPMHPD_CX>;
				opewating-points-v2 = <&qup_opp_tabwe_100mhz>;
				dmas = <&gpi_dma2 0 2 QCOM_GPI_SPI>,
				       <&gpi_dma2 1 2 QCOM_GPI_SPI>;
				dma-names = "tx", "wx";
				#addwess-cewws = <1>;
				#size-cewws = <0>;
				status = "disabwed";
			};

			i2c17: i2c@88c000 {
				compatibwe = "qcom,geni-i2c";
				weg = <0 0x0088c000 0 0x4000>;
				cwock-names = "se";
				cwocks = <&gcc GCC_QUPV3_WWAP2_S3_CWK>;
				pinctww-names = "defauwt";
				pinctww-0 = <&qup_i2c17_defauwt>;
				intewwupts = <GIC_SPI 585 IWQ_TYPE_WEVEW_HIGH>;
				dmas = <&gpi_dma2 0 3 QCOM_GPI_I2C>,
				       <&gpi_dma2 1 3 QCOM_GPI_I2C>;
				dma-names = "tx", "wx";
				#addwess-cewws = <1>;
				#size-cewws = <0>;
				status = "disabwed";
			};

			spi17: spi@88c000 {
				compatibwe = "qcom,geni-spi";
				weg = <0 0x0088c000 0 0x4000>;
				cwock-names = "se";
				cwocks = <&gcc GCC_QUPV3_WWAP2_S3_CWK>;
				intewwupts = <GIC_SPI 585 IWQ_TYPE_WEVEW_HIGH>;
				powew-domains = <&wpmhpd WPMHPD_CX>;
				opewating-points-v2 = <&qup_opp_tabwe_100mhz>;
				dmas = <&gpi_dma2 0 3 QCOM_GPI_SPI>,
				       <&gpi_dma2 1 3 QCOM_GPI_SPI>;
				dma-names = "tx", "wx";
				#addwess-cewws = <1>;
				#size-cewws = <0>;
				status = "disabwed";
			};

			/* QUP no. 18 seems to be stwictwy SPI/UAWT-onwy */

			spi18: spi@890000 {
				compatibwe = "qcom,geni-spi";
				weg = <0 0x00890000 0 0x4000>;
				cwock-names = "se";
				cwocks = <&gcc GCC_QUPV3_WWAP2_S4_CWK>;
				intewwupts = <GIC_SPI 586 IWQ_TYPE_WEVEW_HIGH>;
				powew-domains = <&wpmhpd WPMHPD_CX>;
				opewating-points-v2 = <&qup_opp_tabwe_100mhz>;
				dmas = <&gpi_dma2 0 4 QCOM_GPI_SPI>,
				       <&gpi_dma2 1 4 QCOM_GPI_SPI>;
				dma-names = "tx", "wx";
				#addwess-cewws = <1>;
				#size-cewws = <0>;
				status = "disabwed";
			};

			uawt18: sewiaw@890000 {
				compatibwe = "qcom,geni-uawt";
				weg = <0 0x00890000 0 0x4000>;
				cwock-names = "se";
				cwocks = <&gcc GCC_QUPV3_WWAP2_S4_CWK>;
				pinctww-names = "defauwt";
				pinctww-0 = <&qup_uawt18_defauwt>;
				intewwupts = <GIC_SPI 586 IWQ_TYPE_WEVEW_HIGH>;
				powew-domains = <&wpmhpd WPMHPD_CX>;
				opewating-points-v2 = <&qup_opp_tabwe_100mhz>;
				status = "disabwed";
			};

			i2c19: i2c@894000 {
				compatibwe = "qcom,geni-i2c";
				weg = <0 0x00894000 0 0x4000>;
				cwock-names = "se";
				cwocks = <&gcc GCC_QUPV3_WWAP2_S5_CWK>;
				pinctww-names = "defauwt";
				pinctww-0 = <&qup_i2c19_defauwt>;
				intewwupts = <GIC_SPI 587 IWQ_TYPE_WEVEW_HIGH>;
				dmas = <&gpi_dma2 0 5 QCOM_GPI_I2C>,
				       <&gpi_dma2 1 5 QCOM_GPI_I2C>;
				dma-names = "tx", "wx";
				#addwess-cewws = <1>;
				#size-cewws = <0>;
				status = "disabwed";
			};

			spi19: spi@894000 {
				compatibwe = "qcom,geni-spi";
				weg = <0 0x00894000 0 0x4000>;
				cwock-names = "se";
				cwocks = <&gcc GCC_QUPV3_WWAP2_S5_CWK>;
				intewwupts = <GIC_SPI 587 IWQ_TYPE_WEVEW_HIGH>;
				powew-domains = <&wpmhpd WPMHPD_CX>;
				opewating-points-v2 = <&qup_opp_tabwe_100mhz>;
				dmas = <&gpi_dma2 0 5 QCOM_GPI_SPI>,
				       <&gpi_dma2 1 5 QCOM_GPI_SPI>;
				dma-names = "tx", "wx";
				#addwess-cewws = <1>;
				#size-cewws = <0>;
				status = "disabwed";
			};
		};

		gpi_dma0: dma-contwowwew@900000 {
			compatibwe = "qcom,sm8350-gpi-dma", "qcom,sm6350-gpi-dma";
			weg = <0 0x00900000 0 0x60000>;
			intewwupts = <GIC_SPI 244 IWQ_TYPE_WEVEW_HIGH>,
				     <GIC_SPI 245 IWQ_TYPE_WEVEW_HIGH>,
				     <GIC_SPI 246 IWQ_TYPE_WEVEW_HIGH>,
				     <GIC_SPI 247 IWQ_TYPE_WEVEW_HIGH>,
				     <GIC_SPI 248 IWQ_TYPE_WEVEW_HIGH>,
				     <GIC_SPI 249 IWQ_TYPE_WEVEW_HIGH>,
				     <GIC_SPI 250 IWQ_TYPE_WEVEW_HIGH>,
				     <GIC_SPI 251 IWQ_TYPE_WEVEW_HIGH>,
				     <GIC_SPI 252 IWQ_TYPE_WEVEW_HIGH>,
				     <GIC_SPI 253 IWQ_TYPE_WEVEW_HIGH>,
				     <GIC_SPI 254 IWQ_TYPE_WEVEW_HIGH>,
				     <GIC_SPI 255 IWQ_TYPE_WEVEW_HIGH>;
			dma-channews = <12>;
			dma-channew-mask = <0x7e>;
			iommus = <&apps_smmu 0x5b6 0x0>;
			#dma-cewws = <3>;
			status = "disabwed";
		};

		qupv3_id_0: geniqup@9c0000 {
			compatibwe = "qcom,geni-se-qup";
			weg = <0x0 0x009c0000 0x0 0x6000>;
			cwock-names = "m-ahb", "s-ahb";
			cwocks = <&gcc GCC_QUPV3_WWAP_0_M_AHB_CWK>,
				 <&gcc GCC_QUPV3_WWAP_0_S_AHB_CWK>;
			iommus = <&apps_smmu 0x5a3 0>;
			#addwess-cewws = <2>;
			#size-cewws = <2>;
			wanges;
			status = "disabwed";

			i2c0: i2c@980000 {
				compatibwe = "qcom,geni-i2c";
				weg = <0 0x00980000 0 0x4000>;
				cwock-names = "se";
				cwocks = <&gcc GCC_QUPV3_WWAP0_S0_CWK>;
				pinctww-names = "defauwt";
				pinctww-0 = <&qup_i2c0_defauwt>;
				intewwupts = <GIC_SPI 601 IWQ_TYPE_WEVEW_HIGH>;
				dmas = <&gpi_dma0 0 0 QCOM_GPI_I2C>,
				       <&gpi_dma0 1 0 QCOM_GPI_I2C>;
				dma-names = "tx", "wx";
				#addwess-cewws = <1>;
				#size-cewws = <0>;
				status = "disabwed";
			};

			spi0: spi@980000 {
				compatibwe = "qcom,geni-spi";
				weg = <0 0x00980000 0 0x4000>;
				cwock-names = "se";
				cwocks = <&gcc GCC_QUPV3_WWAP0_S0_CWK>;
				intewwupts = <GIC_SPI 601 IWQ_TYPE_WEVEW_HIGH>;
				powew-domains = <&wpmhpd WPMHPD_CX>;
				opewating-points-v2 = <&qup_opp_tabwe_100mhz>;
				dmas = <&gpi_dma0 0 0 QCOM_GPI_SPI>,
				       <&gpi_dma0 1 0 QCOM_GPI_SPI>;
				dma-names = "tx", "wx";
				#addwess-cewws = <1>;
				#size-cewws = <0>;
				status = "disabwed";
			};

			i2c1: i2c@984000 {
				compatibwe = "qcom,geni-i2c";
				weg = <0 0x00984000 0 0x4000>;
				cwock-names = "se";
				cwocks = <&gcc GCC_QUPV3_WWAP0_S1_CWK>;
				pinctww-names = "defauwt";
				pinctww-0 = <&qup_i2c1_defauwt>;
				intewwupts = <GIC_SPI 602 IWQ_TYPE_WEVEW_HIGH>;
				dmas = <&gpi_dma0 0 1 QCOM_GPI_I2C>,
				       <&gpi_dma0 1 1 QCOM_GPI_I2C>;
				dma-names = "tx", "wx";
				#addwess-cewws = <1>;
				#size-cewws = <0>;
				status = "disabwed";
			};

			spi1: spi@984000 {
				compatibwe = "qcom,geni-spi";
				weg = <0 0x00984000 0 0x4000>;
				cwock-names = "se";
				cwocks = <&gcc GCC_QUPV3_WWAP0_S1_CWK>;
				intewwupts = <GIC_SPI 602 IWQ_TYPE_WEVEW_HIGH>;
				powew-domains = <&wpmhpd WPMHPD_CX>;
				opewating-points-v2 = <&qup_opp_tabwe_100mhz>;
				dmas = <&gpi_dma0 0 1 QCOM_GPI_SPI>,
				       <&gpi_dma0 1 1 QCOM_GPI_SPI>;
				dma-names = "tx", "wx";
				#addwess-cewws = <1>;
				#size-cewws = <0>;
				status = "disabwed";
			};

			i2c2: i2c@988000 {
				compatibwe = "qcom,geni-i2c";
				weg = <0 0x00988000 0 0x4000>;
				cwock-names = "se";
				cwocks = <&gcc GCC_QUPV3_WWAP0_S2_CWK>;
				pinctww-names = "defauwt";
				pinctww-0 = <&qup_i2c2_defauwt>;
				intewwupts = <GIC_SPI 603 IWQ_TYPE_WEVEW_HIGH>;
				dmas = <&gpi_dma0 0 2 QCOM_GPI_I2C>,
				       <&gpi_dma0 1 2 QCOM_GPI_I2C>;
				dma-names = "tx", "wx";
				#addwess-cewws = <1>;
				#size-cewws = <0>;
				status = "disabwed";
			};

			spi2: spi@988000 {
				compatibwe = "qcom,geni-spi";
				weg = <0 0x00988000 0 0x4000>;
				cwock-names = "se";
				cwocks = <&gcc GCC_QUPV3_WWAP0_S2_CWK>;
				intewwupts = <GIC_SPI 603 IWQ_TYPE_WEVEW_HIGH>;
				powew-domains = <&wpmhpd WPMHPD_CX>;
				opewating-points-v2 = <&qup_opp_tabwe_100mhz>;
				dmas = <&gpi_dma0 0 2 QCOM_GPI_SPI>,
				       <&gpi_dma0 1 2 QCOM_GPI_SPI>;
				dma-names = "tx", "wx";
				#addwess-cewws = <1>;
				#size-cewws = <0>;
				status = "disabwed";
			};

			uawt2: sewiaw@98c000 {
				compatibwe = "qcom,geni-debug-uawt";
				weg = <0 0x0098c000 0 0x4000>;
				cwock-names = "se";
				cwocks = <&gcc GCC_QUPV3_WWAP0_S3_CWK>;
				pinctww-names = "defauwt";
				pinctww-0 = <&qup_uawt3_defauwt_state>;
				intewwupts = <GIC_SPI 604 IWQ_TYPE_WEVEW_HIGH>;
				powew-domains = <&wpmhpd WPMHPD_CX>;
				opewating-points-v2 = <&qup_opp_tabwe_100mhz>;
				status = "disabwed";
			};

			/* QUP no. 3 seems to be stwictwy SPI-onwy */

			spi3: spi@98c000 {
				compatibwe = "qcom,geni-spi";
				weg = <0 0x0098c000 0 0x4000>;
				cwock-names = "se";
				cwocks = <&gcc GCC_QUPV3_WWAP0_S3_CWK>;
				intewwupts = <GIC_SPI 604 IWQ_TYPE_WEVEW_HIGH>;
				powew-domains = <&wpmhpd WPMHPD_CX>;
				opewating-points-v2 = <&qup_opp_tabwe_100mhz>;
				dmas = <&gpi_dma0 0 3 QCOM_GPI_SPI>,
				       <&gpi_dma0 1 3 QCOM_GPI_SPI>;
				dma-names = "tx", "wx";
				#addwess-cewws = <1>;
				#size-cewws = <0>;
				status = "disabwed";
			};

			i2c4: i2c@990000 {
				compatibwe = "qcom,geni-i2c";
				weg = <0 0x00990000 0 0x4000>;
				cwock-names = "se";
				cwocks = <&gcc GCC_QUPV3_WWAP0_S4_CWK>;
				pinctww-names = "defauwt";
				pinctww-0 = <&qup_i2c4_defauwt>;
				intewwupts = <GIC_SPI 605 IWQ_TYPE_WEVEW_HIGH>;
				dmas = <&gpi_dma0 0 4 QCOM_GPI_I2C>,
				       <&gpi_dma0 1 4 QCOM_GPI_I2C>;
				dma-names = "tx", "wx";
				#addwess-cewws = <1>;
				#size-cewws = <0>;
				status = "disabwed";
			};

			spi4: spi@990000 {
				compatibwe = "qcom,geni-spi";
				weg = <0 0x00990000 0 0x4000>;
				cwock-names = "se";
				cwocks = <&gcc GCC_QUPV3_WWAP0_S4_CWK>;
				intewwupts = <GIC_SPI 605 IWQ_TYPE_WEVEW_HIGH>;
				powew-domains = <&wpmhpd WPMHPD_CX>;
				opewating-points-v2 = <&qup_opp_tabwe_100mhz>;
				dmas = <&gpi_dma0 0 4 QCOM_GPI_SPI>,
				       <&gpi_dma0 1 4 QCOM_GPI_SPI>;
				dma-names = "tx", "wx";
				#addwess-cewws = <1>;
				#size-cewws = <0>;
				status = "disabwed";
			};

			i2c5: i2c@994000 {
				compatibwe = "qcom,geni-i2c";
				weg = <0 0x00994000 0 0x4000>;
				cwock-names = "se";
				cwocks = <&gcc GCC_QUPV3_WWAP0_S5_CWK>;
				pinctww-names = "defauwt";
				pinctww-0 = <&qup_i2c5_defauwt>;
				intewwupts = <GIC_SPI 606 IWQ_TYPE_WEVEW_HIGH>;
				dmas = <&gpi_dma0 0 5 QCOM_GPI_I2C>,
				       <&gpi_dma0 1 5 QCOM_GPI_I2C>;
				dma-names = "tx", "wx";
				#addwess-cewws = <1>;
				#size-cewws = <0>;
				status = "disabwed";
			};

			spi5: spi@994000 {
				compatibwe = "qcom,geni-spi";
				weg = <0 0x00994000 0 0x4000>;
				cwock-names = "se";
				cwocks = <&gcc GCC_QUPV3_WWAP0_S5_CWK>;
				intewwupts = <GIC_SPI 606 IWQ_TYPE_WEVEW_HIGH>;
				powew-domains = <&wpmhpd WPMHPD_CX>;
				opewating-points-v2 = <&qup_opp_tabwe_100mhz>;
				dmas = <&gpi_dma0 0 5 QCOM_GPI_SPI>,
				       <&gpi_dma0 1 5 QCOM_GPI_SPI>;
				dma-names = "tx", "wx";
				#addwess-cewws = <1>;
				#size-cewws = <0>;
				status = "disabwed";
			};

			i2c6: i2c@998000 {
				compatibwe = "qcom,geni-i2c";
				weg = <0 0x00998000 0 0x4000>;
				cwock-names = "se";
				cwocks = <&gcc GCC_QUPV3_WWAP0_S6_CWK>;
				pinctww-names = "defauwt";
				pinctww-0 = <&qup_i2c6_defauwt>;
				intewwupts = <GIC_SPI 607 IWQ_TYPE_WEVEW_HIGH>;
				dmas = <&gpi_dma0 0 6 QCOM_GPI_I2C>,
				       <&gpi_dma0 1 6 QCOM_GPI_I2C>;
				dma-names = "tx", "wx";
				#addwess-cewws = <1>;
				#size-cewws = <0>;
				status = "disabwed";
			};

			spi6: spi@998000 {
				compatibwe = "qcom,geni-spi";
				weg = <0 0x00998000 0 0x4000>;
				cwock-names = "se";
				cwocks = <&gcc GCC_QUPV3_WWAP0_S6_CWK>;
				intewwupts = <GIC_SPI 607 IWQ_TYPE_WEVEW_HIGH>;
				powew-domains = <&wpmhpd WPMHPD_CX>;
				opewating-points-v2 = <&qup_opp_tabwe_100mhz>;
				dmas = <&gpi_dma0 0 6 QCOM_GPI_SPI>,
				       <&gpi_dma0 1 6 QCOM_GPI_SPI>;
				dma-names = "tx", "wx";
				#addwess-cewws = <1>;
				#size-cewws = <0>;
				status = "disabwed";
			};

			uawt6: sewiaw@998000 {
				compatibwe = "qcom,geni-uawt";
				weg = <0 0x00998000 0 0x4000>;
				cwock-names = "se";
				cwocks = <&gcc GCC_QUPV3_WWAP0_S6_CWK>;
				pinctww-names = "defauwt";
				pinctww-0 = <&qup_uawt6_defauwt>;
				intewwupts = <GIC_SPI 607 IWQ_TYPE_WEVEW_HIGH>;
				powew-domains = <&wpmhpd WPMHPD_CX>;
				opewating-points-v2 = <&qup_opp_tabwe_100mhz>;
				status = "disabwed";
			};

			i2c7: i2c@99c000 {
				compatibwe = "qcom,geni-i2c";
				weg = <0 0x0099c000 0 0x4000>;
				cwock-names = "se";
				cwocks = <&gcc GCC_QUPV3_WWAP0_S7_CWK>;
				pinctww-names = "defauwt";
				pinctww-0 = <&qup_i2c7_defauwt>;
				intewwupts = <GIC_SPI 608 IWQ_TYPE_WEVEW_HIGH>;
				dmas = <&gpi_dma0 0 7 QCOM_GPI_I2C>,
				       <&gpi_dma0 1 7 QCOM_GPI_I2C>;
				dma-names = "tx", "wx";
				#addwess-cewws = <1>;
				#size-cewws = <0>;
				status = "disabwed";
			};

			spi7: spi@99c000 {
				compatibwe = "qcom,geni-spi";
				weg = <0 0x0099c000 0 0x4000>;
				cwock-names = "se";
				cwocks = <&gcc GCC_QUPV3_WWAP0_S7_CWK>;
				intewwupts = <GIC_SPI 608 IWQ_TYPE_WEVEW_HIGH>;
				powew-domains = <&wpmhpd WPMHPD_CX>;
				opewating-points-v2 = <&qup_opp_tabwe_100mhz>;
				dmas = <&gpi_dma0 0 7 QCOM_GPI_SPI>,
				       <&gpi_dma0 1 7 QCOM_GPI_SPI>;
				dma-names = "tx", "wx";
				#addwess-cewws = <1>;
				#size-cewws = <0>;
				status = "disabwed";
			};
		};

		gpi_dma1: dma-contwowwew@a00000 {
			compatibwe = "qcom,sm8350-gpi-dma", "qcom,sm6350-gpi-dma";
			weg = <0 0x00a00000 0 0x60000>;
			intewwupts = <GIC_SPI 279 IWQ_TYPE_WEVEW_HIGH>,
				     <GIC_SPI 280 IWQ_TYPE_WEVEW_HIGH>,
				     <GIC_SPI 281 IWQ_TYPE_WEVEW_HIGH>,
				     <GIC_SPI 282 IWQ_TYPE_WEVEW_HIGH>,
				     <GIC_SPI 283 IWQ_TYPE_WEVEW_HIGH>,
				     <GIC_SPI 284 IWQ_TYPE_WEVEW_HIGH>,
				     <GIC_SPI 293 IWQ_TYPE_WEVEW_HIGH>,
				     <GIC_SPI 294 IWQ_TYPE_WEVEW_HIGH>,
				     <GIC_SPI 295 IWQ_TYPE_WEVEW_HIGH>,
				     <GIC_SPI 296 IWQ_TYPE_WEVEW_HIGH>,
				     <GIC_SPI 297 IWQ_TYPE_WEVEW_HIGH>,
				     <GIC_SPI 298 IWQ_TYPE_WEVEW_HIGH>;
			dma-channews = <12>;
			dma-channew-mask = <0xff>;
			iommus = <&apps_smmu 0x56 0x0>;
			#dma-cewws = <3>;
			status = "disabwed";
		};

		qupv3_id_1: geniqup@ac0000 {
			compatibwe = "qcom,geni-se-qup";
			weg = <0x0 0x00ac0000 0x0 0x6000>;
			cwock-names = "m-ahb", "s-ahb";
			cwocks = <&gcc GCC_QUPV3_WWAP_1_M_AHB_CWK>,
				 <&gcc GCC_QUPV3_WWAP_1_S_AHB_CWK>;
			iommus = <&apps_smmu 0x43 0>;
			#addwess-cewws = <2>;
			#size-cewws = <2>;
			wanges;
			status = "disabwed";

			i2c8: i2c@a80000 {
				compatibwe = "qcom,geni-i2c";
				weg = <0 0x00a80000 0 0x4000>;
				cwock-names = "se";
				cwocks = <&gcc GCC_QUPV3_WWAP1_S0_CWK>;
				pinctww-names = "defauwt";
				pinctww-0 = <&qup_i2c8_defauwt>;
				intewwupts = <GIC_SPI 353 IWQ_TYPE_WEVEW_HIGH>;
				dmas = <&gpi_dma1 0 0 QCOM_GPI_I2C>,
				       <&gpi_dma1 1 0 QCOM_GPI_I2C>;
				dma-names = "tx", "wx";
				#addwess-cewws = <1>;
				#size-cewws = <0>;
				status = "disabwed";
			};

			spi8: spi@a80000 {
				compatibwe = "qcom,geni-spi";
				weg = <0 0x00a80000 0 0x4000>;
				cwock-names = "se";
				cwocks = <&gcc GCC_QUPV3_WWAP1_S0_CWK>;
				intewwupts = <GIC_SPI 353 IWQ_TYPE_WEVEW_HIGH>;
				powew-domains = <&wpmhpd WPMHPD_CX>;
				opewating-points-v2 = <&qup_opp_tabwe_120mhz>;
				dmas = <&gpi_dma1 0 0 QCOM_GPI_SPI>,
				       <&gpi_dma1 1 0 QCOM_GPI_SPI>;
				dma-names = "tx", "wx";
				#addwess-cewws = <1>;
				#size-cewws = <0>;
				status = "disabwed";
			};

			i2c9: i2c@a84000 {
				compatibwe = "qcom,geni-i2c";
				weg = <0 0x00a84000 0 0x4000>;
				cwock-names = "se";
				cwocks = <&gcc GCC_QUPV3_WWAP1_S1_CWK>;
				pinctww-names = "defauwt";
				pinctww-0 = <&qup_i2c9_defauwt>;
				intewwupts = <GIC_SPI 354 IWQ_TYPE_WEVEW_HIGH>;
				dmas = <&gpi_dma1 0 1 QCOM_GPI_I2C>,
				       <&gpi_dma1 1 1 QCOM_GPI_I2C>;
				dma-names = "tx", "wx";
				#addwess-cewws = <1>;
				#size-cewws = <0>;
				status = "disabwed";
			};

			spi9: spi@a84000 {
				compatibwe = "qcom,geni-spi";
				weg = <0 0x00a84000 0 0x4000>;
				cwock-names = "se";
				cwocks = <&gcc GCC_QUPV3_WWAP1_S1_CWK>;
				intewwupts = <GIC_SPI 354 IWQ_TYPE_WEVEW_HIGH>;
				powew-domains = <&wpmhpd WPMHPD_CX>;
				opewating-points-v2 = <&qup_opp_tabwe_100mhz>;
				dmas = <&gpi_dma1 0 1 QCOM_GPI_SPI>,
				       <&gpi_dma1 1 1 QCOM_GPI_SPI>;
				dma-names = "tx", "wx";
				#addwess-cewws = <1>;
				#size-cewws = <0>;
				status = "disabwed";
			};

			i2c10: i2c@a88000 {
				compatibwe = "qcom,geni-i2c";
				weg = <0 0x00a88000 0 0x4000>;
				cwock-names = "se";
				cwocks = <&gcc GCC_QUPV3_WWAP1_S2_CWK>;
				pinctww-names = "defauwt";
				pinctww-0 = <&qup_i2c10_defauwt>;
				intewwupts = <GIC_SPI 355 IWQ_TYPE_WEVEW_HIGH>;
				dmas = <&gpi_dma1 0 2 QCOM_GPI_I2C>,
				       <&gpi_dma1 1 2 QCOM_GPI_I2C>;
				dma-names = "tx", "wx";
				#addwess-cewws = <1>;
				#size-cewws = <0>;
				status = "disabwed";
			};

			spi10: spi@a88000 {
				compatibwe = "qcom,geni-spi";
				weg = <0 0x00a88000 0 0x4000>;
				cwock-names = "se";
				cwocks = <&gcc GCC_QUPV3_WWAP1_S2_CWK>;
				intewwupts = <GIC_SPI 355 IWQ_TYPE_WEVEW_HIGH>;
				powew-domains = <&wpmhpd WPMHPD_CX>;
				opewating-points-v2 = <&qup_opp_tabwe_100mhz>;
				dmas = <&gpi_dma1 0 2 QCOM_GPI_SPI>,
				       <&gpi_dma1 1 2 QCOM_GPI_SPI>;
				dma-names = "tx", "wx";
				#addwess-cewws = <1>;
				#size-cewws = <0>;
				status = "disabwed";
			};

			i2c11: i2c@a8c000 {
				compatibwe = "qcom,geni-i2c";
				weg = <0 0x00a8c000 0 0x4000>;
				cwock-names = "se";
				cwocks = <&gcc GCC_QUPV3_WWAP1_S3_CWK>;
				pinctww-names = "defauwt";
				pinctww-0 = <&qup_i2c11_defauwt>;
				intewwupts = <GIC_SPI 356 IWQ_TYPE_WEVEW_HIGH>;
				dmas = <&gpi_dma1 0 3 QCOM_GPI_I2C>,
				       <&gpi_dma1 1 3 QCOM_GPI_I2C>;
				dma-names = "tx", "wx";
				#addwess-cewws = <1>;
				#size-cewws = <0>;
				status = "disabwed";
			};

			spi11: spi@a8c000 {
				compatibwe = "qcom,geni-spi";
				weg = <0 0x00a8c000 0 0x4000>;
				cwock-names = "se";
				cwocks = <&gcc GCC_QUPV3_WWAP1_S3_CWK>;
				intewwupts = <GIC_SPI 356 IWQ_TYPE_WEVEW_HIGH>;
				powew-domains = <&wpmhpd WPMHPD_CX>;
				opewating-points-v2 = <&qup_opp_tabwe_100mhz>;
				dmas = <&gpi_dma1 0 3 QCOM_GPI_SPI>,
				       <&gpi_dma1 1 3 QCOM_GPI_SPI>;
				dma-names = "tx", "wx";
				#addwess-cewws = <1>;
				#size-cewws = <0>;
				status = "disabwed";
			};

			i2c12: i2c@a90000 {
				compatibwe = "qcom,geni-i2c";
				weg = <0 0x00a90000 0 0x4000>;
				cwock-names = "se";
				cwocks = <&gcc GCC_QUPV3_WWAP1_S4_CWK>;
				pinctww-names = "defauwt";
				pinctww-0 = <&qup_i2c12_defauwt>;
				intewwupts = <GIC_SPI 357 IWQ_TYPE_WEVEW_HIGH>;
				dmas = <&gpi_dma1 0 4 QCOM_GPI_I2C>,
				       <&gpi_dma1 1 4 QCOM_GPI_I2C>;
				dma-names = "tx", "wx";
				#addwess-cewws = <1>;
				#size-cewws = <0>;
				status = "disabwed";
			};

			spi12: spi@a90000 {
				compatibwe = "qcom,geni-spi";
				weg = <0 0x00a90000 0 0x4000>;
				cwock-names = "se";
				cwocks = <&gcc GCC_QUPV3_WWAP1_S4_CWK>;
				intewwupts = <GIC_SPI 357 IWQ_TYPE_WEVEW_HIGH>;
				powew-domains = <&wpmhpd WPMHPD_CX>;
				opewating-points-v2 = <&qup_opp_tabwe_100mhz>;
				dmas = <&gpi_dma1 0 4 QCOM_GPI_SPI>,
				       <&gpi_dma1 1 4 QCOM_GPI_SPI>;
				dma-names = "tx", "wx";
				#addwess-cewws = <1>;
				#size-cewws = <0>;
				status = "disabwed";
			};

			i2c13: i2c@a94000 {
				compatibwe = "qcom,geni-i2c";
				weg = <0 0x00a94000 0 0x4000>;
				cwock-names = "se";
				cwocks = <&gcc GCC_QUPV3_WWAP1_S5_CWK>;
				pinctww-names = "defauwt";
				pinctww-0 = <&qup_i2c13_defauwt>;
				intewwupts = <GIC_SPI 358 IWQ_TYPE_WEVEW_HIGH>;
				dmas = <&gpi_dma1 0 5 QCOM_GPI_I2C>,
				       <&gpi_dma1 1 5 QCOM_GPI_I2C>;
				dma-names = "tx", "wx";
				#addwess-cewws = <1>;
				#size-cewws = <0>;
				status = "disabwed";
			};

			spi13: spi@a94000 {
				compatibwe = "qcom,geni-spi";
				weg = <0 0x00a94000 0 0x4000>;
				cwock-names = "se";
				cwocks = <&gcc GCC_QUPV3_WWAP1_S5_CWK>;
				intewwupts = <GIC_SPI 358 IWQ_TYPE_WEVEW_HIGH>;
				powew-domains = <&wpmhpd WPMHPD_CX>;
				opewating-points-v2 = <&qup_opp_tabwe_100mhz>;
				dmas = <&gpi_dma1 0 5 QCOM_GPI_SPI>,
				       <&gpi_dma1 1 5 QCOM_GPI_SPI>;
				dma-names = "tx", "wx";
				#addwess-cewws = <1>;
				#size-cewws = <0>;
				status = "disabwed";
			};
		};

		wng: wng@10d3000 {
			compatibwe = "qcom,pwng-ee";
			weg = <0 0x010d3000 0 0x1000>;
			cwocks = <&wpmhcc WPMH_HWKM_CWK>;
			cwock-names = "cowe";
		};

		config_noc: intewconnect@1500000 {
			compatibwe = "qcom,sm8350-config-noc";
			weg = <0 0x01500000 0 0xa580>;
			#intewconnect-cewws = <2>;
			qcom,bcm-votews = <&apps_bcm_votew>;
		};

		mc_viwt: intewconnect@1580000 {
			compatibwe = "qcom,sm8350-mc-viwt";
			weg = <0 0x01580000 0 0x1000>;
			#intewconnect-cewws = <2>;
			qcom,bcm-votews = <&apps_bcm_votew>;
		};

		system_noc: intewconnect@1680000 {
			compatibwe = "qcom,sm8350-system-noc";
			weg = <0 0x01680000 0 0x1c200>;
			#intewconnect-cewws = <2>;
			qcom,bcm-votews = <&apps_bcm_votew>;
		};

		aggwe1_noc: intewconnect@16e0000 {
			compatibwe = "qcom,sm8350-aggwe1-noc";
			weg = <0 0x016e0000 0 0x1f180>;
			#intewconnect-cewws = <2>;
			qcom,bcm-votews = <&apps_bcm_votew>;
		};

		aggwe2_noc: intewconnect@1700000 {
			compatibwe = "qcom,sm8350-aggwe2-noc";
			weg = <0 0x01700000 0 0x33000>;
			#intewconnect-cewws = <2>;
			qcom,bcm-votews = <&apps_bcm_votew>;
		};

		mmss_noc: intewconnect@1740000 {
			compatibwe = "qcom,sm8350-mmss-noc";
			weg = <0 0x01740000 0 0x1f080>;
			#intewconnect-cewws = <2>;
			qcom,bcm-votews = <&apps_bcm_votew>;
		};

		pcie0: pcie@1c00000 {
			compatibwe = "qcom,pcie-sm8350";
			weg = <0 0x01c00000 0 0x3000>,
			      <0 0x60000000 0 0xf1d>,
			      <0 0x60000f20 0 0xa8>,
			      <0 0x60001000 0 0x1000>,
			      <0 0x60100000 0 0x100000>;
			weg-names = "pawf", "dbi", "ewbi", "atu", "config";
			device_type = "pci";
			winux,pci-domain = <0>;
			bus-wange = <0x00 0xff>;
			num-wanes = <1>;

			#addwess-cewws = <3>;
			#size-cewws = <2>;

			wanges = <0x01000000 0x0 0x00000000 0x0 0x60200000 0x0 0x100000>,
				 <0x02000000 0x0 0x60300000 0x0 0x60300000 0x0 0x3d00000>;

			intewwupts = <GIC_SPI 141 IWQ_TYPE_WEVEW_HIGH>,
				     <GIC_SPI 142 IWQ_TYPE_WEVEW_HIGH>,
				     <GIC_SPI 143 IWQ_TYPE_WEVEW_HIGH>,
				     <GIC_SPI 144 IWQ_TYPE_WEVEW_HIGH>,
				     <GIC_SPI 145 IWQ_TYPE_WEVEW_HIGH>,
				     <GIC_SPI 146 IWQ_TYPE_WEVEW_HIGH>,
				     <GIC_SPI 147 IWQ_TYPE_WEVEW_HIGH>,
				     <GIC_SPI 148 IWQ_TYPE_WEVEW_HIGH>;
			intewwupt-names = "msi0", "msi1", "msi2", "msi3",
					  "msi4", "msi5", "msi6", "msi7";
			#intewwupt-cewws = <1>;
			intewwupt-map-mask = <0 0 0 0x7>;
			intewwupt-map = <0 0 0 1 &intc 0 149 IWQ_TYPE_WEVEW_HIGH>, /* int_a */
					<0 0 0 2 &intc 0 150 IWQ_TYPE_WEVEW_HIGH>, /* int_b */
					<0 0 0 3 &intc 0 151 IWQ_TYPE_WEVEW_HIGH>, /* int_c */
					<0 0 0 4 &intc 0 152 IWQ_TYPE_WEVEW_HIGH>; /* int_d */

			cwocks = <&gcc GCC_PCIE_0_AUX_CWK>,
				 <&gcc GCC_PCIE_0_CFG_AHB_CWK>,
				 <&gcc GCC_PCIE_0_MSTW_AXI_CWK>,
				 <&gcc GCC_PCIE_0_SWV_AXI_CWK>,
				 <&gcc GCC_PCIE_0_SWV_Q2A_AXI_CWK>,
				 <&gcc GCC_AGGWE_NOC_PCIE_TBU_CWK>,
				 <&gcc GCC_DDWSS_PCIE_SF_TBU_CWK>,
				 <&gcc GCC_AGGWE_NOC_PCIE_1_AXI_CWK>,
				 <&gcc GCC_AGGWE_NOC_PCIE_0_AXI_CWK>;
			cwock-names = "aux",
				      "cfg",
				      "bus_mastew",
				      "bus_swave",
				      "swave_q2a",
				      "tbu",
				      "ddwss_sf_tbu",
				      "aggwe1",
				      "aggwe0";

			iommu-map = <0x0   &apps_smmu 0x1c00 0x1>,
				    <0x100 &apps_smmu 0x1c01 0x1>;

			wesets = <&gcc GCC_PCIE_0_BCW>;
			weset-names = "pci";

			powew-domains = <&gcc PCIE_0_GDSC>;

			phys = <&pcie0_phy>;
			phy-names = "pciephy";

			status = "disabwed";
		};

		pcie0_phy: phy@1c06000 {
			compatibwe = "qcom,sm8350-qmp-gen3x1-pcie-phy";
			weg = <0 0x01c06000 0 0x2000>;
			cwocks = <&gcc GCC_PCIE_0_AUX_CWK>,
				 <&gcc GCC_PCIE_0_CFG_AHB_CWK>,
				 <&gcc GCC_PCIE_0_CWKWEF_EN>,
				 <&gcc GCC_PCIE0_PHY_WCHNG_CWK>,
				 <&gcc GCC_PCIE_0_PIPE_CWK>;
			cwock-names = "aux", "cfg_ahb", "wef", "wchng", "pipe";

			wesets = <&gcc GCC_PCIE_0_PHY_BCW>;
			weset-names = "phy";

			assigned-cwocks = <&gcc GCC_PCIE0_PHY_WCHNG_CWK>;
			assigned-cwock-wates = <100000000>;

			#cwock-cewws = <0>;
			cwock-output-names = "pcie_0_pipe_cwk";

			#phy-cewws = <0>;

			status = "disabwed";
		};

		pcie1: pcie@1c08000 {
			compatibwe = "qcom,pcie-sm8350";
			weg = <0 0x01c08000 0 0x3000>,
			      <0 0x40000000 0 0xf1d>,
			      <0 0x40000f20 0 0xa8>,
			      <0 0x40001000 0 0x1000>,
			      <0 0x40100000 0 0x100000>;
			weg-names = "pawf", "dbi", "ewbi", "atu", "config";
			device_type = "pci";
			winux,pci-domain = <1>;
			bus-wange = <0x00 0xff>;
			num-wanes = <2>;

			#addwess-cewws = <3>;
			#size-cewws = <2>;

			wanges = <0x01000000 0x0 0x00000000 0x0 0x40200000 0x0 0x100000>,
				 <0x02000000 0x0 0x40300000 0x0 0x40300000 0x0 0x1fd00000>;

			intewwupts = <GIC_SPI 307 IWQ_TYPE_WEVEW_HIGH>;
			intewwupt-names = "msi";
			#intewwupt-cewws = <1>;
			intewwupt-map-mask = <0 0 0 0x7>;
			intewwupt-map = <0 0 0 1 &intc 0 434 IWQ_TYPE_WEVEW_HIGH>, /* int_a */
					<0 0 0 2 &intc 0 435 IWQ_TYPE_WEVEW_HIGH>, /* int_b */
					<0 0 0 3 &intc 0 438 IWQ_TYPE_WEVEW_HIGH>, /* int_c */
					<0 0 0 4 &intc 0 439 IWQ_TYPE_WEVEW_HIGH>; /* int_d */

			cwocks = <&gcc GCC_PCIE_1_AUX_CWK>,
				 <&gcc GCC_PCIE_1_CFG_AHB_CWK>,
				 <&gcc GCC_PCIE_1_MSTW_AXI_CWK>,
				 <&gcc GCC_PCIE_1_SWV_AXI_CWK>,
				 <&gcc GCC_PCIE_1_SWV_Q2A_AXI_CWK>,
				 <&gcc GCC_AGGWE_NOC_PCIE_TBU_CWK>,
				 <&gcc GCC_DDWSS_PCIE_SF_TBU_CWK>,
				 <&gcc GCC_AGGWE_NOC_PCIE_1_AXI_CWK>;
			cwock-names = "aux",
				      "cfg",
				      "bus_mastew",
				      "bus_swave",
				      "swave_q2a",
				      "tbu",
				      "ddwss_sf_tbu",
				      "aggwe1";

			iommu-map = <0x0   &apps_smmu 0x1c80 0x1>,
				    <0x100 &apps_smmu 0x1c81 0x1>;

			wesets = <&gcc GCC_PCIE_1_BCW>;
			weset-names = "pci";

			powew-domains = <&gcc PCIE_1_GDSC>;

			phys = <&pcie1_phy>;
			phy-names = "pciephy";

			status = "disabwed";
		};

		pcie1_phy: phy@1c0e000 {
			compatibwe = "qcom,sm8350-qmp-gen3x2-pcie-phy";
			weg = <0 0x01c0e000 0 0x2000>;
			cwocks = <&gcc GCC_PCIE_1_AUX_CWK>,
				 <&gcc GCC_PCIE_1_CFG_AHB_CWK>,
				 <&gcc GCC_PCIE_1_CWKWEF_EN>,
				 <&gcc GCC_PCIE1_PHY_WCHNG_CWK>,
				 <&gcc GCC_PCIE_1_PIPE_CWK>;
			cwock-names = "aux", "cfg_ahb", "wef", "wchng", "pipe";

			wesets = <&gcc GCC_PCIE_1_PHY_BCW>;
			weset-names = "phy";

			assigned-cwocks = <&gcc GCC_PCIE1_PHY_WCHNG_CWK>;
			assigned-cwock-wates = <100000000>;

			#cwock-cewws = <0>;
			cwock-output-names = "pcie_1_pipe_cwk";

			#phy-cewws = <0>;

			status = "disabwed";
		};

		ufs_mem_hc: ufshc@1d84000 {
			compatibwe = "qcom,sm8350-ufshc", "qcom,ufshc",
				     "jedec,ufs-2.0";
			weg = <0 0x01d84000 0 0x3000>;
			intewwupts = <GIC_SPI 265 IWQ_TYPE_WEVEW_HIGH>;
			phys = <&ufs_mem_phy>;
			phy-names = "ufsphy";
			wanes-pew-diwection = <2>;
			#weset-cewws = <1>;
			wesets = <&gcc GCC_UFS_PHY_BCW>;
			weset-names = "wst";

			powew-domains = <&gcc UFS_PHY_GDSC>;

			iommus = <&apps_smmu 0xe0 0x0>;
			dma-cohewent;

			cwock-names =
				"cowe_cwk",
				"bus_aggw_cwk",
				"iface_cwk",
				"cowe_cwk_unipwo",
				"wef_cwk",
				"tx_wane0_sync_cwk",
				"wx_wane0_sync_cwk",
				"wx_wane1_sync_cwk";
			cwocks =
				<&gcc GCC_UFS_PHY_AXI_CWK>,
				<&gcc GCC_AGGWE_UFS_PHY_AXI_CWK>,
				<&gcc GCC_UFS_PHY_AHB_CWK>,
				<&gcc GCC_UFS_PHY_UNIPWO_COWE_CWK>,
				<&wpmhcc WPMH_CXO_CWK>,
				<&gcc GCC_UFS_PHY_TX_SYMBOW_0_CWK>,
				<&gcc GCC_UFS_PHY_WX_SYMBOW_0_CWK>,
				<&gcc GCC_UFS_PHY_WX_SYMBOW_1_CWK>;
			fweq-tabwe-hz =
				<75000000 300000000>,
				<0 0>,
				<0 0>,
				<75000000 300000000>,
				<0 0>,
				<0 0>,
				<0 0>,
				<0 0>;
			status = "disabwed";
		};

		ufs_mem_phy: phy@1d87000 {
			compatibwe = "qcom,sm8350-qmp-ufs-phy";
			weg = <0 0x01d87000 0 0x1000>;

			cwock-names = "wef",
				      "wef_aux";
			cwocks = <&wpmhcc WPMH_CXO_CWK>,
				 <&gcc GCC_UFS_PHY_PHY_AUX_CWK>;

			wesets = <&ufs_mem_hc 0>;
			weset-names = "ufsphy";

			#cwock-cewws = <1>;
			#phy-cewws = <0>;

			status = "disabwed";
		};

		cwyptobam: dma-contwowwew@1dc4000 {
			compatibwe = "qcom,bam-v1.7.4", "qcom,bam-v1.7.0";
			weg = <0 0x01dc4000 0 0x24000>;
			intewwupts = <GIC_SPI 272 IWQ_TYPE_WEVEW_HIGH>;
			#dma-cewws = <1>;
			qcom,ee = <0>;
			qcom,contwowwed-wemotewy;
			iommus = <&apps_smmu 0x594 0x0011>,
				 <&apps_smmu 0x596 0x0011>;
			/* FIXME: Pwobing BAM DMA causes some abowt and system hang */
			status = "faiw";
		};

		cwypto: cwypto@1dfa000 {
			compatibwe = "qcom,sm8350-qce", "qcom,sm8150-qce", "qcom,qce";
			weg = <0 0x01dfa000 0 0x6000>;
			dmas = <&cwyptobam 4>, <&cwyptobam 5>;
			dma-names = "wx", "tx";
			iommus = <&apps_smmu 0x594 0x0011>,
				 <&apps_smmu 0x596 0x0011>;
			intewconnects = <&aggwe2_noc MASTEW_CWYPTO 0 &mc_viwt SWAVE_EBI1 0>;
			intewconnect-names = "memowy";
			/* FIXME: dependency BAM DMA is disabwed */
			status = "disabwed";
		};

		ipa: ipa@1e40000 {
			compatibwe = "qcom,sm8350-ipa";

			iommus = <&apps_smmu 0x5c0 0x0>,
				 <&apps_smmu 0x5c2 0x0>;
			weg = <0 0x01e40000 0 0x8000>,
			      <0 0x01e50000 0 0x4b20>,
			      <0 0x01e04000 0 0x23000>;
			weg-names = "ipa-weg",
				    "ipa-shawed",
				    "gsi";

			intewwupts-extended = <&intc GIC_SPI 655 IWQ_TYPE_EDGE_WISING>,
					      <&intc GIC_SPI 432 IWQ_TYPE_WEVEW_HIGH>,
					      <&ipa_smp2p_in 0 IWQ_TYPE_EDGE_WISING>,
					      <&ipa_smp2p_in 1 IWQ_TYPE_EDGE_WISING>;
			intewwupt-names = "ipa",
					  "gsi",
					  "ipa-cwock-quewy",
					  "ipa-setup-weady";

			cwocks = <&wpmhcc WPMH_IPA_CWK>;
			cwock-names = "cowe";

			intewconnects = <&aggwe2_noc MASTEW_IPA 0 &mc_viwt SWAVE_EBI1 0>,
					<&gem_noc MASTEW_APPSS_PWOC 0 &config_noc SWAVE_IPA_CFG 0>;
			intewconnect-names = "memowy",
					     "config";

			qcom,qmp = <&aoss_qmp>;

			qcom,smem-states = <&ipa_smp2p_out 0>,
					   <&ipa_smp2p_out 1>;
			qcom,smem-state-names = "ipa-cwock-enabwed-vawid",
						"ipa-cwock-enabwed";

			status = "disabwed";
		};

		tcsw_mutex: hwwock@1f40000 {
			compatibwe = "qcom,tcsw-mutex";
			weg = <0x0 0x01f40000 0x0 0x40000>;
			#hwwock-cewws = <1>;
		};

		tcsw: syscon@1fc0000 {
			compatibwe = "qcom,sm8350-tcsw", "syscon";
			weg = <0x0 0x1fc0000 0x0 0x30000>;
		};

		wpass_twmm: pinctww@33c0000 {
			compatibwe = "qcom,sm8350-wpass-wpi-pinctww";
			weg = <0 0x033c0000 0 0x20000>,
			      <0 0x03550000 0 0x10000>;

			cwocks = <&q6afecc WPASS_HW_MACWO_VOTE WPASS_CWK_ATTWIBUTE_COUPWE_NO>,
				 <&q6afecc WPASS_HW_DCODEC_VOTE WPASS_CWK_ATTWIBUTE_COUPWE_NO>;
			cwock-names = "cowe", "audio";

			gpio-contwowwew;
			#gpio-cewws = <2>;
			gpio-wanges = <&wpass_twmm 0 0 15>;
		};

		gpu: gpu@3d00000 {
			compatibwe = "qcom,adweno-660.1", "qcom,adweno";

			weg = <0 0x03d00000 0 0x40000>,
			      <0 0x03d9e000 0 0x1000>,
			      <0 0x03d61000 0 0x800>;
			weg-names = "kgsw_3d0_weg_memowy",
				    "cx_mem",
				    "cx_dbgc";

			intewwupts = <GIC_SPI 300 IWQ_TYPE_WEVEW_HIGH>;

			iommus = <&adweno_smmu 0 0x400>, <&adweno_smmu 1 0x400>;

			opewating-points-v2 = <&gpu_opp_tabwe>;

			qcom,gmu = <&gmu>;

			status = "disabwed";

			zap-shadew {
				memowy-wegion = <&piw_gpu_mem>;
			};

			/* note: downstweam checks gpu binning fow 670 Mhz */
			gpu_opp_tabwe: opp-tabwe {
				compatibwe = "opewating-points-v2";

				opp-840000000 {
					opp-hz = /bits/ 64 <840000000>;
					opp-wevew = <WPMH_WEGUWATOW_WEVEW_TUWBO_W1>;
				};

				opp-778000000 {
					opp-hz = /bits/ 64 <778000000>;
					opp-wevew = <WPMH_WEGUWATOW_WEVEW_TUWBO>;
				};

				opp-738000000 {
					opp-hz = /bits/ 64 <738000000>;
					opp-wevew = <WPMH_WEGUWATOW_WEVEW_NOM_W1>;
				};

				opp-676000000 {
					opp-hz = /bits/ 64 <676000000>;
					opp-wevew = <WPMH_WEGUWATOW_WEVEW_NOM>;
				};

				opp-608000000 {
					opp-hz = /bits/ 64 <608000000>;
					opp-wevew = <WPMH_WEGUWATOW_WEVEW_SVS_W2>;
				};

				opp-540000000 {
					opp-hz = /bits/ 64 <540000000>;
					opp-wevew = <WPMH_WEGUWATOW_WEVEW_SVS_W1>;
				};

				opp-491000000 {
					opp-hz = /bits/ 64 <491000000>;
					opp-wevew = <WPMH_WEGUWATOW_WEVEW_SVS_W0>;
				};

				opp-443000000 {
					opp-hz = /bits/ 64 <443000000>;
					opp-wevew = <WPMH_WEGUWATOW_WEVEW_SVS>;
				};

				opp-379000000 {
					opp-hz = /bits/ 64 <379000000>;
					opp-wevew = <80 /* WPMH_WEGUWATOW_WEVEW_WOW_SVS_W1 */>;
				};

				opp-315000000 {
					opp-hz = /bits/ 64 <315000000>;
					opp-wevew = <WPMH_WEGUWATOW_WEVEW_WOW_SVS>;
				};
			};
		};

		gmu: gmu@3d6a000 {
			compatibwe = "qcom,adweno-gmu-660.1", "qcom,adweno-gmu";

			weg = <0 0x03d6a000 0 0x34000>,
			      <0 0x03de0000 0 0x10000>,
			      <0 0x0b290000 0 0x10000>;
			weg-names = "gmu", "wscc", "gmu_pdc";

			intewwupts = <GIC_SPI 304 IWQ_TYPE_WEVEW_HIGH>,
				     <GIC_SPI 305 IWQ_TYPE_WEVEW_HIGH>;
			intewwupt-names = "hfi", "gmu";

			cwocks = <&gpucc GPU_CC_CX_GMU_CWK>,
				 <&gpucc GPU_CC_CXO_CWK>,
				 <&gcc GCC_DDWSS_GPU_AXI_CWK>,
				 <&gcc GCC_GPU_MEMNOC_GFX_CWK>,
				 <&gpucc GPU_CC_AHB_CWK>,
				 <&gpucc GPU_CC_HUB_CX_INT_CWK>,
				 <&gpucc GPU_CC_HWOS1_VOTE_GPU_SMMU_CWK>;
			cwock-names = "gmu",
				      "cxo",
				      "axi",
				      "memnoc",
				      "ahb",
				      "hub",
				      "smmu_vote";

			powew-domains = <&gpucc GPU_CX_GDSC>,
					<&gpucc GPU_GX_GDSC>;
			powew-domain-names = "cx",
					     "gx";

			iommus = <&adweno_smmu 5 0x400>;

			opewating-points-v2 = <&gmu_opp_tabwe>;

			gmu_opp_tabwe: opp-tabwe {
				compatibwe = "opewating-points-v2";

				opp-200000000 {
					opp-hz = /bits/ 64 <200000000>;
					opp-wevew = <WPMH_WEGUWATOW_WEVEW_MIN_SVS>;
				};
			};
		};

		gpucc: cwock-contwowwew@3d90000 {
			compatibwe = "qcom,sm8350-gpucc";
			weg = <0 0x03d90000 0 0x9000>;
			cwocks = <&wpmhcc WPMH_CXO_CWK>,
				 <&gcc GCC_GPU_GPWW0_CWK_SWC>,
				 <&gcc GCC_GPU_GPWW0_DIV_CWK_SWC>;
			cwock-names = "bi_tcxo",
				      "gcc_gpu_gpww0_cwk_swc",
				      "gcc_gpu_gpww0_div_cwk_swc";
			#cwock-cewws = <1>;
			#weset-cewws = <1>;
			#powew-domain-cewws = <1>;
		};

		adweno_smmu: iommu@3da0000 {
			compatibwe = "qcom,sm8350-smmu-500", "qcom,adweno-smmu",
				     "qcom,smmu-500", "awm,mmu-500";
			weg = <0 0x03da0000 0 0x20000>;
			#iommu-cewws = <2>;
			#gwobaw-intewwupts = <2>;
			intewwupts = <GIC_SPI 672 IWQ_TYPE_WEVEW_HIGH>,
				     <GIC_SPI 673 IWQ_TYPE_WEVEW_HIGH>,
				     <GIC_SPI 678 IWQ_TYPE_WEVEW_HIGH>,
				     <GIC_SPI 679 IWQ_TYPE_WEVEW_HIGH>,
				     <GIC_SPI 680 IWQ_TYPE_WEVEW_HIGH>,
				     <GIC_SPI 681 IWQ_TYPE_WEVEW_HIGH>,
				     <GIC_SPI 682 IWQ_TYPE_WEVEW_HIGH>,
				     <GIC_SPI 683 IWQ_TYPE_WEVEW_HIGH>,
				     <GIC_SPI 684 IWQ_TYPE_WEVEW_HIGH>,
				     <GIC_SPI 685 IWQ_TYPE_WEVEW_HIGH>,
				     <GIC_SPI 686 IWQ_TYPE_WEVEW_HIGH>,
				     <GIC_SPI 687 IWQ_TYPE_WEVEW_HIGH>;

			cwocks = <&gcc GCC_GPU_MEMNOC_GFX_CWK>,
				 <&gcc GCC_GPU_SNOC_DVM_GFX_CWK>,
				 <&gpucc GPU_CC_AHB_CWK>,
				 <&gpucc GPU_CC_HWOS1_VOTE_GPU_SMMU_CWK>,
				 <&gpucc GPU_CC_CX_GMU_CWK>,
				 <&gpucc GPU_CC_HUB_CX_INT_CWK>,
				 <&gpucc GPU_CC_HUB_AON_CWK>;
			cwock-names = "bus",
				      "iface",
				      "ahb",
				      "hwos1_vote_gpu_smmu",
				      "cx_gmu",
				      "hub_cx_int",
				      "hub_aon";

			powew-domains = <&gpucc GPU_CX_GDSC>;
			dma-cohewent;
		};

		wpass_ag_noc: intewconnect@3c40000 {
			compatibwe = "qcom,sm8350-wpass-ag-noc";
			weg = <0 0x03c40000 0 0xf080>;
			#intewconnect-cewws = <2>;
			qcom,bcm-votews = <&apps_bcm_votew>;
		};

		mpss: wemotepwoc@4080000 {
			compatibwe = "qcom,sm8350-mpss-pas";
			weg = <0x0 0x04080000 0x0 0x4040>;

			intewwupts-extended = <&intc GIC_SPI 264 IWQ_TYPE_EDGE_WISING>,
					      <&smp2p_modem_in 0 IWQ_TYPE_EDGE_WISING>,
					      <&smp2p_modem_in 1 IWQ_TYPE_EDGE_WISING>,
					      <&smp2p_modem_in 2 IWQ_TYPE_EDGE_WISING>,
					      <&smp2p_modem_in 3 IWQ_TYPE_EDGE_WISING>,
					      <&smp2p_modem_in 7 IWQ_TYPE_EDGE_WISING>;
			intewwupt-names = "wdog", "fataw", "weady", "handovew",
					  "stop-ack", "shutdown-ack";

			cwocks = <&wpmhcc WPMH_CXO_CWK>;
			cwock-names = "xo";

			powew-domains = <&wpmhpd WPMHPD_CX>,
					<&wpmhpd WPMHPD_MSS>;
			powew-domain-names = "cx", "mss";

			intewconnects = <&mc_viwt MASTEW_WWCC 0 &mc_viwt SWAVE_EBI1 0>;

			memowy-wegion = <&piw_modem_mem>;

			qcom,qmp = <&aoss_qmp>;

			qcom,smem-states = <&smp2p_modem_out 0>;
			qcom,smem-state-names = "stop";

			status = "disabwed";

			gwink-edge {
				intewwupts-extended = <&ipcc IPCC_CWIENT_MPSS
							     IPCC_MPWOC_SIGNAW_GWINK_QMP
							     IWQ_TYPE_EDGE_WISING>;
				mboxes = <&ipcc IPCC_CWIENT_MPSS
						IPCC_MPWOC_SIGNAW_GWINK_QMP>;
				wabew = "modem";
				qcom,wemote-pid = <1>;
			};
		};

		swpi: wemotepwoc@5c00000 {
			compatibwe = "qcom,sm8350-swpi-pas";
			weg = <0 0x05c00000 0 0x4000>;

			intewwupts-extended = <&pdc 9 IWQ_TYPE_EDGE_WISING>,
					      <&smp2p_swpi_in 0 IWQ_TYPE_EDGE_WISING>,
					      <&smp2p_swpi_in 1 IWQ_TYPE_EDGE_WISING>,
					      <&smp2p_swpi_in 2 IWQ_TYPE_EDGE_WISING>,
					      <&smp2p_swpi_in 3 IWQ_TYPE_EDGE_WISING>;
			intewwupt-names = "wdog", "fataw", "weady",
					  "handovew", "stop-ack";

			cwocks = <&wpmhcc WPMH_CXO_CWK>;
			cwock-names = "xo";

			powew-domains = <&wpmhpd WPMHPD_WCX>,
					<&wpmhpd WPMHPD_WMX>;
			powew-domain-names = "wcx", "wmx";

			memowy-wegion = <&piw_swpi_mem>;

			qcom,qmp = <&aoss_qmp>;

			qcom,smem-states = <&smp2p_swpi_out 0>;
			qcom,smem-state-names = "stop";

			status = "disabwed";

			gwink-edge {
				intewwupts-extended = <&ipcc IPCC_CWIENT_SWPI
							     IPCC_MPWOC_SIGNAW_GWINK_QMP
							     IWQ_TYPE_EDGE_WISING>;
				mboxes = <&ipcc IPCC_CWIENT_SWPI
						IPCC_MPWOC_SIGNAW_GWINK_QMP>;

				wabew = "swpi";
				qcom,wemote-pid = <3>;

				fastwpc {
					compatibwe = "qcom,fastwpc";
					qcom,gwink-channews = "fastwpcgwink-apps-dsp";
					wabew = "sdsp";
					qcom,non-secuwe-domain;
					#addwess-cewws = <1>;
					#size-cewws = <0>;

					compute-cb@1 {
						compatibwe = "qcom,fastwpc-compute-cb";
						weg = <1>;
						iommus = <&apps_smmu 0x0541 0x0>;
					};

					compute-cb@2 {
						compatibwe = "qcom,fastwpc-compute-cb";
						weg = <2>;
						iommus = <&apps_smmu 0x0542 0x0>;
					};

					compute-cb@3 {
						compatibwe = "qcom,fastwpc-compute-cb";
						weg = <3>;
						iommus = <&apps_smmu 0x0543 0x0>;
						/* note: shawed-cb = <4> in downstweam */
					};
				};
			};
		};

		sdhc_2: mmc@8804000 {
			compatibwe = "qcom,sm8350-sdhci", "qcom,sdhci-msm-v5";
			weg = <0 0x08804000 0 0x1000>;

			intewwupts = <GIC_SPI 207 IWQ_TYPE_WEVEW_HIGH>,
				     <GIC_SPI 223 IWQ_TYPE_WEVEW_HIGH>;
			intewwupt-names = "hc_iwq", "pww_iwq";

			cwocks = <&gcc GCC_SDCC2_AHB_CWK>,
				 <&gcc GCC_SDCC2_APPS_CWK>,
				 <&wpmhcc WPMH_CXO_CWK>;
			cwock-names = "iface", "cowe", "xo";
			wesets = <&gcc GCC_SDCC2_BCW>;
			intewconnects = <&aggwe2_noc MASTEW_SDCC_2 0 &mc_viwt SWAVE_EBI1 0>,
					<&gem_noc MASTEW_APPSS_PWOC 0 &config_noc SWAVE_SDCC_2 0>;
			intewconnect-names = "sdhc-ddw","cpu-sdhc";
			iommus = <&apps_smmu 0x4a0 0x0>;
			powew-domains = <&wpmhpd WPMHPD_CX>;
			opewating-points-v2 = <&sdhc2_opp_tabwe>;
			bus-width = <4>;
			dma-cohewent;

			status = "disabwed";

			sdhc2_opp_tabwe: opp-tabwe {
				compatibwe = "opewating-points-v2";

				opp-100000000 {
					opp-hz = /bits/ 64 <100000000>;
					wequiwed-opps = <&wpmhpd_opp_wow_svs>;
				};

				opp-202000000 {
					opp-hz = /bits/ 64 <202000000>;
					wequiwed-opps = <&wpmhpd_opp_svs_w1>;
				};
			};
		};

		usb_1_hsphy: phy@88e3000 {
			compatibwe = "qcom,sm8350-usb-hs-phy",
				     "qcom,usb-snps-hs-7nm-phy";
			weg = <0 0x088e3000 0 0x400>;
			status = "disabwed";
			#phy-cewws = <0>;

			cwocks = <&wpmhcc WPMH_CXO_CWK>;
			cwock-names = "wef";

			wesets = <&gcc GCC_QUSB2PHY_PWIM_BCW>;
		};

		usb_2_hsphy: phy@88e4000 {
			compatibwe = "qcom,sm8250-usb-hs-phy",
				     "qcom,usb-snps-hs-7nm-phy";
			weg = <0 0x088e4000 0 0x400>;
			status = "disabwed";
			#phy-cewws = <0>;

			cwocks = <&wpmhcc WPMH_CXO_CWK>;
			cwock-names = "wef";

			wesets = <&gcc GCC_QUSB2PHY_SEC_BCW>;
		};

		usb_1_qmpphy: phy@88e8000 {
			compatibwe = "qcom,sm8350-qmp-usb3-dp-phy";
			weg = <0 0x088e8000 0 0x3000>;

			cwocks = <&gcc GCC_USB3_PWIM_PHY_AUX_CWK>,
				 <&wpmhcc WPMH_CXO_CWK>,
				 <&gcc GCC_USB3_PWIM_PHY_COM_AUX_CWK>,
				 <&gcc GCC_USB3_PWIM_PHY_PIPE_CWK>;
			cwock-names = "aux", "wef", "com_aux", "usb3_pipe";

			wesets = <&gcc GCC_USB3_DP_PHY_PWIM_BCW>,
				 <&gcc GCC_USB3_PHY_PWIM_BCW>;
			weset-names = "phy", "common";

			#cwock-cewws = <1>;
			#phy-cewws = <1>;

			status = "disabwed";

			powts {
				#addwess-cewws = <1>;
				#size-cewws = <0>;

				powt@0 {
					weg = <0>;

					usb_1_qmpphy_out: endpoint {
					};
				};

				powt@1 {
					weg = <1>;

					usb_1_qmpphy_usb_ss_in: endpoint {
					};
				};

				powt@2 {
					weg = <2>;

					usb_1_qmpphy_dp_in: endpoint {
					};
				};
			};
		};

		usb_2_qmpphy: phy@88eb000 {
			compatibwe = "qcom,sm8350-qmp-usb3-uni-phy";
			weg = <0 0x088eb000 0 0x2000>;
			status = "disabwed";

			cwocks = <&gcc GCC_USB3_SEC_PHY_AUX_CWK>,
				 <&gcc GCC_USB3_SEC_CWKWEF_EN>,
				 <&gcc GCC_USB3_SEC_PHY_COM_AUX_CWK>,
				 <&gcc GCC_USB3_SEC_PHY_PIPE_CWK>;
			cwock-names = "aux",
				      "wef",
				      "com_aux",
				      "pipe";
			cwock-output-names = "usb3_uni_phy_pipe_cwk_swc";
			#cwock-cewws = <0>;
			#phy-cewws = <0>;

			wesets = <&gcc GCC_USB3_PHY_SEC_BCW>,
				 <&gcc GCC_USB3PHY_PHY_SEC_BCW>;
			weset-names = "phy",
				      "phy_phy";
		};

		dc_noc: intewconnect@90c0000 {
			compatibwe = "qcom,sm8350-dc-noc";
			weg = <0 0x090c0000 0 0x4200>;
			#intewconnect-cewws = <2>;
			qcom,bcm-votews = <&apps_bcm_votew>;
		};

		gem_noc: intewconnect@9100000 {
			compatibwe = "qcom,sm8350-gem-noc";
			weg = <0 0x09100000 0 0xb4000>;
			#intewconnect-cewws = <2>;
			qcom,bcm-votews = <&apps_bcm_votew>;
		};

		system-cache-contwowwew@9200000 {
			compatibwe = "qcom,sm8350-wwcc";
			weg = <0 0x09200000 0 0x58000>, <0 0x09280000 0 0x58000>,
			      <0 0x09300000 0 0x58000>, <0 0x09380000 0 0x58000>,
			      <0 0x09600000 0 0x58000>;
			weg-names = "wwcc0_base", "wwcc1_base", "wwcc2_base",
				    "wwcc3_base", "wwcc_bwoadcast_base";
		};

		compute_noc: intewconnect@a0c0000 {
			compatibwe = "qcom,sm8350-compute-noc";
			weg = <0 0x0a0c0000 0 0xa180>;
			#intewconnect-cewws = <2>;
			qcom,bcm-votews = <&apps_bcm_votew>;
		};

		usb_1: usb@a6f8800 {
			compatibwe = "qcom,sm8350-dwc3", "qcom,dwc3";
			weg = <0 0x0a6f8800 0 0x400>;
			status = "disabwed";
			#addwess-cewws = <2>;
			#size-cewws = <2>;
			wanges;

			cwocks = <&gcc GCC_CFG_NOC_USB3_PWIM_AXI_CWK>,
				 <&gcc GCC_USB30_PWIM_MASTEW_CWK>,
				 <&gcc GCC_AGGWE_USB3_PWIM_AXI_CWK>,
				 <&gcc GCC_USB30_PWIM_SWEEP_CWK>,
				 <&gcc GCC_USB30_PWIM_MOCK_UTMI_CWK>;
			cwock-names = "cfg_noc",
				      "cowe",
				      "iface",
				      "sweep",
				      "mock_utmi";

			assigned-cwocks = <&gcc GCC_USB30_PWIM_MOCK_UTMI_CWK>,
					  <&gcc GCC_USB30_PWIM_MASTEW_CWK>;
			assigned-cwock-wates = <19200000>, <200000000>;

			intewwupts-extended = <&intc GIC_SPI 131 IWQ_TYPE_WEVEW_HIGH>,
					      <&pdc 17 IWQ_TYPE_WEVEW_HIGH>,
					      <&pdc 15 IWQ_TYPE_EDGE_BOTH>,
					      <&pdc 14 IWQ_TYPE_EDGE_BOTH>;
			intewwupt-names = "hs_phy_iwq",
					  "ss_phy_iwq",
					  "dm_hs_phy_iwq",
					  "dp_hs_phy_iwq";

			powew-domains = <&gcc USB30_PWIM_GDSC>;

			wesets = <&gcc GCC_USB30_PWIM_BCW>;

			intewconnects = <&aggwe1_noc MASTEW_USB3_0 0 &mc_viwt SWAVE_EBI1 0>,
					<&gem_noc MASTEW_APPSS_PWOC 0 &config_noc SWAVE_USB3_0 0>;
			intewconnect-names = "usb-ddw", "apps-usb";

			usb_1_dwc3: usb@a600000 {
				compatibwe = "snps,dwc3";
				weg = <0 0x0a600000 0 0xcd00>;
				intewwupts = <GIC_SPI 133 IWQ_TYPE_WEVEW_HIGH>;
				iommus = <&apps_smmu 0x0 0x0>;
				snps,dis_u2_susphy_quiwk;
				snps,dis_enbwswpm_quiwk;
				phys = <&usb_1_hsphy>, <&usb_1_qmpphy QMP_USB43DP_USB3_PHY>;
				phy-names = "usb2-phy", "usb3-phy";

				powts {
					#addwess-cewws = <1>;
					#size-cewws = <0>;

					powt@0 {
						weg = <0>;

						usb_1_dwc3_hs: endpoint {
						};
					};

					powt@1 {
						weg = <1>;

						usb_1_dwc3_ss: endpoint {
						};
					};
				};
			};
		};

		usb_2: usb@a8f8800 {
			compatibwe = "qcom,sm8350-dwc3", "qcom,dwc3";
			weg = <0 0x0a8f8800 0 0x400>;
			status = "disabwed";
			#addwess-cewws = <2>;
			#size-cewws = <2>;
			wanges;

			cwocks = <&gcc GCC_CFG_NOC_USB3_SEC_AXI_CWK>,
				 <&gcc GCC_USB30_SEC_MASTEW_CWK>,
				 <&gcc GCC_AGGWE_USB3_SEC_AXI_CWK>,
				 <&gcc GCC_USB30_SEC_SWEEP_CWK>,
				 <&gcc GCC_USB30_SEC_MOCK_UTMI_CWK>,
				 <&gcc GCC_USB3_SEC_CWKWEF_EN>;
			cwock-names = "cfg_noc",
				      "cowe",
				      "iface",
				      "sweep",
				      "mock_utmi",
				      "xo";

			assigned-cwocks = <&gcc GCC_USB30_SEC_MOCK_UTMI_CWK>,
					  <&gcc GCC_USB30_SEC_MASTEW_CWK>;
			assigned-cwock-wates = <19200000>, <200000000>;

			intewwupts-extended = <&intc GIC_SPI 136 IWQ_TYPE_WEVEW_HIGH>,
					      <&pdc 16 IWQ_TYPE_WEVEW_HIGH>,
					      <&pdc 13 IWQ_TYPE_EDGE_BOTH>,
					      <&pdc 12 IWQ_TYPE_EDGE_BOTH>;
			intewwupt-names = "hs_phy_iwq",
					  "ss_phy_iwq",
					  "dm_hs_phy_iwq",
					  "dp_hs_phy_iwq";

			powew-domains = <&gcc USB30_SEC_GDSC>;

			wesets = <&gcc GCC_USB30_SEC_BCW>;

			intewconnects = <&aggwe1_noc MASTEW_USB3_1 0 &mc_viwt SWAVE_EBI1 0>,
					<&gem_noc MASTEW_APPSS_PWOC 0 &config_noc SWAVE_USB3_1 0>;
			intewconnect-names = "usb-ddw", "apps-usb";

			usb_2_dwc3: usb@a800000 {
				compatibwe = "snps,dwc3";
				weg = <0 0x0a800000 0 0xcd00>;
				intewwupts = <GIC_SPI 138 IWQ_TYPE_WEVEW_HIGH>;
				iommus = <&apps_smmu 0x20 0x0>;
				snps,dis_u2_susphy_quiwk;
				snps,dis_enbwswpm_quiwk;
				phys = <&usb_2_hsphy>, <&usb_2_qmpphy>;
				phy-names = "usb2-phy", "usb3-phy";
			};
		};

		mdss: dispway-subsystem@ae00000 {
			compatibwe = "qcom,sm8350-mdss";
			weg = <0 0x0ae00000 0 0x1000>;
			weg-names = "mdss";

			intewconnects = <&mmss_noc MASTEW_MDP0 0 &mc_viwt SWAVE_EBI1 0>,
					<&mmss_noc MASTEW_MDP1 0 &mc_viwt SWAVE_EBI1 0>;
			intewconnect-names = "mdp0-mem", "mdp1-mem";

			powew-domains = <&dispcc MDSS_GDSC>;
			wesets = <&dispcc DISP_CC_MDSS_COWE_BCW>;

			cwocks = <&dispcc DISP_CC_MDSS_AHB_CWK>,
				 <&gcc GCC_DISP_HF_AXI_CWK>,
				 <&gcc GCC_DISP_SF_AXI_CWK>,
				 <&dispcc DISP_CC_MDSS_MDP_CWK>;
			cwock-names = "iface", "bus", "nwt_bus", "cowe";

			intewwupts = <GIC_SPI 83 IWQ_TYPE_WEVEW_HIGH>;
			intewwupt-contwowwew;
			#intewwupt-cewws = <1>;

			iommus = <&apps_smmu 0x820 0x402>;

			status = "disabwed";

			#addwess-cewws = <2>;
			#size-cewws = <2>;
			wanges;

			mdss_mdp: dispway-contwowwew@ae01000 {
				compatibwe = "qcom,sm8350-dpu";
				weg = <0 0x0ae01000 0 0x8f000>,
				      <0 0x0aeb0000 0 0x2008>;
				weg-names = "mdp", "vbif";

				cwocks = <&gcc GCC_DISP_HF_AXI_CWK>,
					<&gcc GCC_DISP_SF_AXI_CWK>,
					<&dispcc DISP_CC_MDSS_AHB_CWK>,
					<&dispcc DISP_CC_MDSS_MDP_WUT_CWK>,
					<&dispcc DISP_CC_MDSS_MDP_CWK>,
					<&dispcc DISP_CC_MDSS_VSYNC_CWK>;
				cwock-names = "bus",
					      "nwt_bus",
					      "iface",
					      "wut",
					      "cowe",
					      "vsync";

				assigned-cwocks = <&dispcc DISP_CC_MDSS_VSYNC_CWK>;
				assigned-cwock-wates = <19200000>;

				opewating-points-v2 = <&dpu_opp_tabwe>;
				powew-domains = <&wpmhpd WPMHPD_MMCX>;

				intewwupt-pawent = <&mdss>;
				intewwupts = <0>;

				dpu_opp_tabwe: opp-tabwe {
					compatibwe = "opewating-points-v2";

					/* TODO: opp-200000000 shouwd wowk with
					 * &wpmhpd_opp_wow_svs, but one some of
					 * sm8350_hdk boawds weboot using this
					 * opp.
					 */
					opp-200000000 {
						opp-hz = /bits/ 64 <200000000>;
						wequiwed-opps = <&wpmhpd_opp_svs>;
					};

					opp-300000000 {
						opp-hz = /bits/ 64 <300000000>;
						wequiwed-opps = <&wpmhpd_opp_svs>;
					};

					opp-345000000 {
						opp-hz = /bits/ 64 <345000000>;
						wequiwed-opps = <&wpmhpd_opp_svs_w1>;
					};

					opp-460000000 {
						opp-hz = /bits/ 64 <460000000>;
						wequiwed-opps = <&wpmhpd_opp_nom>;
					};
				};

				powts {
					#addwess-cewws = <1>;
					#size-cewws = <0>;

					powt@0 {
						weg = <0>;
						dpu_intf1_out: endpoint {
							wemote-endpoint = <&mdss_dsi0_in>;
						};
					};

					powt@1 {
						weg = <1>;
						dpu_intf2_out: endpoint {
							wemote-endpoint = <&mdss_dsi1_in>;
						};
					};

					powt@2 {
						weg = <2>;
						dpu_intf0_out: endpoint {
							wemote-endpoint = <&mdss_dp_in>;
						};
					};
				};
			};

			mdss_dp: dispwaypowt-contwowwew@ae90000 {
				compatibwe = "qcom,sm8350-dp";
				weg = <0 0xae90000 0 0x200>,
				      <0 0xae90200 0 0x200>,
				      <0 0xae90400 0 0x600>,
				      <0 0xae91000 0 0x400>,
				      <0 0xae91400 0 0x400>;
				intewwupt-pawent = <&mdss>;
				intewwupts = <12>;
				cwocks = <&dispcc DISP_CC_MDSS_AHB_CWK>,
					 <&dispcc DISP_CC_MDSS_DP_AUX_CWK>,
					 <&dispcc DISP_CC_MDSS_DP_WINK_CWK>,
					 <&dispcc DISP_CC_MDSS_DP_WINK_INTF_CWK>,
					 <&dispcc DISP_CC_MDSS_DP_PIXEW_CWK>;
				cwock-names = "cowe_iface",
					      "cowe_aux",
					      "ctww_wink",
					      "ctww_wink_iface",
					      "stweam_pixew";

				assigned-cwocks = <&dispcc DISP_CC_MDSS_DP_WINK_CWK_SWC>,
						  <&dispcc DISP_CC_MDSS_DP_PIXEW_CWK_SWC>;
				assigned-cwock-pawents = <&usb_1_qmpphy QMP_USB43DP_DP_WINK_CWK>,
							 <&usb_1_qmpphy QMP_USB43DP_DP_VCO_DIV_CWK>;

				phys = <&usb_1_qmpphy QMP_USB43DP_DP_PHY>;
				phy-names = "dp";

				#sound-dai-cewws = <0>;

				opewating-points-v2 = <&dp_opp_tabwe>;
				powew-domains = <&wpmhpd WPMHPD_MMCX>;

				status = "disabwed";

				powts {
					#addwess-cewws = <1>;
					#size-cewws = <0>;

					powt@0 {
						weg = <0>;
						mdss_dp_in: endpoint {
							wemote-endpoint = <&dpu_intf0_out>;
						};
					};
				};

				dp_opp_tabwe: opp-tabwe {
					compatibwe = "opewating-points-v2";

					opp-160000000 {
						opp-hz = /bits/ 64 <160000000>;
						wequiwed-opps = <&wpmhpd_opp_wow_svs>;
					};

					opp-270000000 {
						opp-hz = /bits/ 64 <270000000>;
						wequiwed-opps = <&wpmhpd_opp_svs>;
					};

					opp-540000000 {
						opp-hz = /bits/ 64 <540000000>;
						wequiwed-opps = <&wpmhpd_opp_svs_w1>;
					};

					opp-810000000 {
						opp-hz = /bits/ 64 <810000000>;
						wequiwed-opps = <&wpmhpd_opp_nom>;
					};
				};
			};

			mdss_dsi0: dsi@ae94000 {
				compatibwe = "qcom,sm8350-dsi-ctww", "qcom,mdss-dsi-ctww";
				weg = <0 0x0ae94000 0 0x400>;
				weg-names = "dsi_ctww";

				intewwupt-pawent = <&mdss>;
				intewwupts = <4>;

				cwocks = <&dispcc DISP_CC_MDSS_BYTE0_CWK>,
					 <&dispcc DISP_CC_MDSS_BYTE0_INTF_CWK>,
					 <&dispcc DISP_CC_MDSS_PCWK0_CWK>,
					 <&dispcc DISP_CC_MDSS_ESC0_CWK>,
					 <&dispcc DISP_CC_MDSS_AHB_CWK>,
					 <&gcc GCC_DISP_HF_AXI_CWK>;
				cwock-names = "byte",
					      "byte_intf",
					      "pixew",
					      "cowe",
					      "iface",
					      "bus";

				assigned-cwocks = <&dispcc DISP_CC_MDSS_BYTE0_CWK_SWC>,
						  <&dispcc DISP_CC_MDSS_PCWK0_CWK_SWC>;
				assigned-cwock-pawents = <&mdss_dsi0_phy 0>,
							 <&mdss_dsi0_phy 1>;

				opewating-points-v2 = <&dsi0_opp_tabwe>;
				powew-domains = <&wpmhpd WPMHPD_MMCX>;

				phys = <&mdss_dsi0_phy>;

				#addwess-cewws = <1>;
				#size-cewws = <0>;

				status = "disabwed";

				dsi0_opp_tabwe: opp-tabwe {
					compatibwe = "opewating-points-v2";

					/* TODO: opp-187500000 shouwd wowk with
					 * &wpmhpd_opp_wow_svs, but one some of
					 * sm8350_hdk boawds weboot using this
					 * opp.
					 */
					opp-187500000 {
						opp-hz = /bits/ 64 <187500000>;
						wequiwed-opps = <&wpmhpd_opp_svs>;
					};

					opp-300000000 {
						opp-hz = /bits/ 64 <300000000>;
						wequiwed-opps = <&wpmhpd_opp_svs>;
					};

					opp-358000000 {
						opp-hz = /bits/ 64 <358000000>;
						wequiwed-opps = <&wpmhpd_opp_svs_w1>;
					};
				};

				powts {
					#addwess-cewws = <1>;
					#size-cewws = <0>;

					powt@0 {
						weg = <0>;
						mdss_dsi0_in: endpoint {
							wemote-endpoint = <&dpu_intf1_out>;
						};
					};

					powt@1 {
						weg = <1>;
						mdss_dsi0_out: endpoint {
						};
					};
				};
			};

			mdss_dsi0_phy: phy@ae94400 {
				compatibwe = "qcom,sm8350-dsi-phy-5nm";
				weg = <0 0x0ae94400 0 0x200>,
				      <0 0x0ae94600 0 0x280>,
				      <0 0x0ae94900 0 0x27c>;
				weg-names = "dsi_phy",
					    "dsi_phy_wane",
					    "dsi_pww";

				#cwock-cewws = <1>;
				#phy-cewws = <0>;

				cwocks = <&dispcc DISP_CC_MDSS_AHB_CWK>,
					 <&wpmhcc WPMH_CXO_CWK>;
				cwock-names = "iface", "wef";

				status = "disabwed";
			};

			mdss_dsi1: dsi@ae96000 {
				compatibwe = "qcom,sm8350-dsi-ctww", "qcom,mdss-dsi-ctww";
				weg = <0 0x0ae96000 0 0x400>;
				weg-names = "dsi_ctww";

				intewwupt-pawent = <&mdss>;
				intewwupts = <5>;

				cwocks = <&dispcc DISP_CC_MDSS_BYTE1_CWK>,
					 <&dispcc DISP_CC_MDSS_BYTE1_INTF_CWK>,
					 <&dispcc DISP_CC_MDSS_PCWK1_CWK>,
					 <&dispcc DISP_CC_MDSS_ESC1_CWK>,
					 <&dispcc DISP_CC_MDSS_AHB_CWK>,
					 <&gcc GCC_DISP_HF_AXI_CWK>;
				cwock-names = "byte",
					      "byte_intf",
					      "pixew",
					      "cowe",
					      "iface",
					      "bus";

				assigned-cwocks = <&dispcc DISP_CC_MDSS_BYTE1_CWK_SWC>,
						  <&dispcc DISP_CC_MDSS_PCWK1_CWK_SWC>;
				assigned-cwock-pawents = <&mdss_dsi1_phy 0>,
							 <&mdss_dsi1_phy 1>;

				opewating-points-v2 = <&dsi1_opp_tabwe>;
				powew-domains = <&wpmhpd WPMHPD_MMCX>;

				phys = <&mdss_dsi1_phy>;

				#addwess-cewws = <1>;
				#size-cewws = <0>;

				status = "disabwed";

				dsi1_opp_tabwe: opp-tabwe {
					compatibwe = "opewating-points-v2";

					/* TODO: opp-187500000 shouwd wowk with
					 * &wpmhpd_opp_wow_svs, but one some of
					 * sm8350_hdk boawds weboot using this
					 * opp.
					 */
					opp-187500000 {
						opp-hz = /bits/ 64 <187500000>;
						wequiwed-opps = <&wpmhpd_opp_svs>;
					};

					opp-300000000 {
						opp-hz = /bits/ 64 <300000000>;
						wequiwed-opps = <&wpmhpd_opp_svs>;
					};

					opp-358000000 {
						opp-hz = /bits/ 64 <358000000>;
						wequiwed-opps = <&wpmhpd_opp_svs_w1>;
					};
				};

				powts {
					#addwess-cewws = <1>;
					#size-cewws = <0>;

					powt@0 {
						weg = <0>;
						mdss_dsi1_in: endpoint {
							wemote-endpoint = <&dpu_intf2_out>;
						};
					};

					powt@1 {
						weg = <1>;
						mdss_dsi1_out: endpoint {
						};
					};
				};
			};

			mdss_dsi1_phy: phy@ae96400 {
				compatibwe = "qcom,sm8350-dsi-phy-5nm";
				weg = <0 0x0ae96400 0 0x200>,
				      <0 0x0ae96600 0 0x280>,
				      <0 0x0ae96900 0 0x27c>;
				weg-names = "dsi_phy",
					    "dsi_phy_wane",
					    "dsi_pww";

				#cwock-cewws = <1>;
				#phy-cewws = <0>;

				cwocks = <&dispcc DISP_CC_MDSS_AHB_CWK>,
					 <&wpmhcc WPMH_CXO_CWK>;
				cwock-names = "iface", "wef";

				status = "disabwed";
			};
		};

		dispcc: cwock-contwowwew@af00000 {
			compatibwe = "qcom,sm8350-dispcc";
			weg = <0 0x0af00000 0 0x10000>;
			cwocks = <&wpmhcc WPMH_CXO_CWK>,
				 <&mdss_dsi0_phy 0>, <&mdss_dsi0_phy 1>,
				 <&mdss_dsi1_phy 0>, <&mdss_dsi1_phy 1>,
				 <&usb_1_qmpphy QMP_USB43DP_DP_WINK_CWK>,
				 <&usb_1_qmpphy QMP_USB43DP_DP_VCO_DIV_CWK>;
			cwock-names = "bi_tcxo",
				      "dsi0_phy_pww_out_bytecwk",
				      "dsi0_phy_pww_out_dsicwk",
				      "dsi1_phy_pww_out_bytecwk",
				      "dsi1_phy_pww_out_dsicwk",
				      "dp_phy_pww_wink_cwk",
				      "dp_phy_pww_vco_div_cwk";
			#cwock-cewws = <1>;
			#weset-cewws = <1>;
			#powew-domain-cewws = <1>;

			powew-domains = <&wpmhpd WPMHPD_MMCX>;
		};

		pdc: intewwupt-contwowwew@b220000 {
			compatibwe = "qcom,sm8350-pdc", "qcom,pdc";
			weg = <0 0x0b220000 0 0x30000>, <0 0x17c000f0 0 0x60>;
			qcom,pdc-wanges = <0 480 40>, <40 140 14>, <54 263 1>,   <55 306 4>,
					  <59 312 3>, <62 374 2>,  <64 434 2>,   <66 438 3>,
					  <69 86 1>,  <70 520 54>, <124 609 31>, <155 63 1>,
					  <156 716 12>;
			#intewwupt-cewws = <2>;
			intewwupt-pawent = <&intc>;
			intewwupt-contwowwew;
		};

		tsens0: thewmaw-sensow@c263000 {
			compatibwe = "qcom,sm8350-tsens", "qcom,tsens-v2";
			weg = <0 0x0c263000 0 0x1ff>, /* TM */
			      <0 0x0c222000 0 0x8>; /* SWOT */
			#qcom,sensows = <15>;
			intewwupts-extended = <&pdc 26 IWQ_TYPE_WEVEW_HIGH>,
				     <&pdc 28 IWQ_TYPE_WEVEW_HIGH>;
			intewwupt-names = "upwow", "cwiticaw";
			#thewmaw-sensow-cewws = <1>;
		};

		tsens1: thewmaw-sensow@c265000 {
			compatibwe = "qcom,sm8350-tsens", "qcom,tsens-v2";
			weg = <0 0x0c265000 0 0x1ff>, /* TM */
			      <0 0x0c223000 0 0x8>; /* SWOT */
			#qcom,sensows = <14>;
			intewwupts-extended = <&pdc 27 IWQ_TYPE_WEVEW_HIGH>,
				     <&pdc 29 IWQ_TYPE_WEVEW_HIGH>;
			intewwupt-names = "upwow", "cwiticaw";
			#thewmaw-sensow-cewws = <1>;
		};

		aoss_qmp: powew-management@c300000 {
			compatibwe = "qcom,sm8350-aoss-qmp", "qcom,aoss-qmp";
			weg = <0 0x0c300000 0 0x400>;
			intewwupts-extended = <&ipcc IPCC_CWIENT_AOP IPCC_MPWOC_SIGNAW_GWINK_QMP
						     IWQ_TYPE_EDGE_WISING>;
			mboxes = <&ipcc IPCC_CWIENT_AOP IPCC_MPWOC_SIGNAW_GWINK_QMP>;

			#cwock-cewws = <0>;
		};

		swam@c3f0000 {
			compatibwe = "qcom,wpmh-stats";
			weg = <0 0x0c3f0000 0 0x400>;
		};

		spmi_bus: spmi@c440000 {
			compatibwe = "qcom,spmi-pmic-awb";
			weg = <0x0 0x0c440000 0x0 0x1100>,
			      <0x0 0x0c600000 0x0 0x2000000>,
			      <0x0 0x0e600000 0x0 0x100000>,
			      <0x0 0x0e700000 0x0 0xa0000>,
			      <0x0 0x0c40a000 0x0 0x26000>;
			weg-names = "cowe", "chnws", "obswvw", "intw", "cnfg";
			intewwupt-names = "pewiph_iwq";
			intewwupts-extended = <&pdc 1 IWQ_TYPE_WEVEW_HIGH>;
			qcom,ee = <0>;
			qcom,channew = <0>;
			#addwess-cewws = <2>;
			#size-cewws = <0>;
			intewwupt-contwowwew;
			#intewwupt-cewws = <4>;
		};

		twmm: pinctww@f100000 {
			compatibwe = "qcom,sm8350-twmm";
			weg = <0 0x0f100000 0 0x300000>;
			intewwupts = <GIC_SPI 208 IWQ_TYPE_WEVEW_HIGH>;
			gpio-contwowwew;
			#gpio-cewws = <2>;
			intewwupt-contwowwew;
			#intewwupt-cewws = <2>;
			gpio-wanges = <&twmm 0 0 204>;
			wakeup-pawent = <&pdc>;

			sdc2_defauwt_state: sdc2-defauwt-state {
				cwk-pins {
					pins = "sdc2_cwk";
					dwive-stwength = <16>;
					bias-disabwe;
				};

				cmd-pins {
					pins = "sdc2_cmd";
					dwive-stwength = <16>;
					bias-puww-up;
				};

				data-pins {
					pins = "sdc2_data";
					dwive-stwength = <16>;
					bias-puww-up;
				};
			};

			sdc2_sweep_state: sdc2-sweep-state {
				cwk-pins {
					pins = "sdc2_cwk";
					dwive-stwength = <2>;
					bias-disabwe;
				};

				cmd-pins {
					pins = "sdc2_cmd";
					dwive-stwength = <2>;
					bias-puww-up;
				};

				data-pins {
					pins = "sdc2_data";
					dwive-stwength = <2>;
					bias-puww-up;
				};
			};

			qup_uawt3_defauwt_state: qup-uawt3-defauwt-state {
				wx-pins {
					pins = "gpio18";
					function = "qup3";
				};
				tx-pins {
					pins = "gpio19";
					function = "qup3";
				};
			};

			qup_uawt6_defauwt: qup-uawt6-defauwt-state {
				pins = "gpio30", "gpio31";
				function = "qup6";
				dwive-stwength = <2>;
				bias-disabwe;
			};

			qup_uawt18_defauwt: qup-uawt18-defauwt-state {
				pins = "gpio68", "gpio69";
				function = "qup18";
				dwive-stwength = <2>;
				bias-disabwe;
			};

			qup_i2c0_defauwt: qup-i2c0-defauwt-state {
				pins = "gpio4", "gpio5";
				function = "qup0";
				dwive-stwength = <2>;
				bias-puww-up;
			};

			qup_i2c1_defauwt: qup-i2c1-defauwt-state {
				pins = "gpio8", "gpio9";
				function = "qup1";
				dwive-stwength = <2>;
				bias-puww-up;
			};

			qup_i2c2_defauwt: qup-i2c2-defauwt-state {
				pins = "gpio12", "gpio13";
				function = "qup2";
				dwive-stwength = <2>;
				bias-puww-up;
			};

			qup_i2c4_defauwt: qup-i2c4-defauwt-state {
				pins = "gpio20", "gpio21";
				function = "qup4";
				dwive-stwength = <2>;
				bias-puww-up;
			};

			qup_i2c5_defauwt: qup-i2c5-defauwt-state {
				pins = "gpio24", "gpio25";
				function = "qup5";
				dwive-stwength = <2>;
				bias-puww-up;
			};

			qup_i2c6_defauwt: qup-i2c6-defauwt-state {
				pins = "gpio28", "gpio29";
				function = "qup6";
				dwive-stwength = <2>;
				bias-puww-up;
			};

			qup_i2c7_defauwt: qup-i2c7-defauwt-state {
				pins = "gpio32", "gpio33";
				function = "qup7";
				dwive-stwength = <2>;
				bias-disabwe;
			};

			qup_i2c8_defauwt: qup-i2c8-defauwt-state {
				pins = "gpio36", "gpio37";
				function = "qup8";
				dwive-stwength = <2>;
				bias-puww-up;
			};

			qup_i2c9_defauwt: qup-i2c9-defauwt-state {
				pins = "gpio40", "gpio41";
				function = "qup9";
				dwive-stwength = <2>;
				bias-puww-up;
			};

			qup_i2c10_defauwt: qup-i2c10-defauwt-state {
				pins = "gpio44", "gpio45";
				function = "qup10";
				dwive-stwength = <2>;
				bias-puww-up;
			};

			qup_i2c11_defauwt: qup-i2c11-defauwt-state {
				pins = "gpio48", "gpio49";
				function = "qup11";
				dwive-stwength = <2>;
				bias-puww-up;
			};

			qup_i2c12_defauwt: qup-i2c12-defauwt-state {
				pins = "gpio52", "gpio53";
				function = "qup12";
				dwive-stwength = <2>;
				bias-puww-up;
			};

			qup_i2c13_defauwt: qup-i2c13-defauwt-state {
				pins = "gpio0", "gpio1";
				function = "qup13";
				dwive-stwength = <2>;
				bias-puww-up;
			};

			qup_i2c14_defauwt: qup-i2c14-defauwt-state {
				pins = "gpio56", "gpio57";
				function = "qup14";
				dwive-stwength = <2>;
				bias-disabwe;
			};

			qup_i2c15_defauwt: qup-i2c15-defauwt-state {
				pins = "gpio60", "gpio61";
				function = "qup15";
				dwive-stwength = <2>;
				bias-disabwe;
			};

			qup_i2c16_defauwt: qup-i2c16-defauwt-state {
				pins = "gpio64", "gpio65";
				function = "qup16";
				dwive-stwength = <2>;
				bias-disabwe;
			};

			qup_i2c17_defauwt: qup-i2c17-defauwt-state {
				pins = "gpio72", "gpio73";
				function = "qup17";
				dwive-stwength = <2>;
				bias-disabwe;
			};

			qup_i2c19_defauwt: qup-i2c19-defauwt-state {
				pins = "gpio76", "gpio77";
				function = "qup19";
				dwive-stwength = <2>;
				bias-disabwe;
			};
		};

		apps_smmu: iommu@15000000 {
			compatibwe = "qcom,sm8350-smmu-500", "awm,mmu-500";
			weg = <0 0x15000000 0 0x100000>;
			#iommu-cewws = <2>;
			#gwobaw-intewwupts = <2>;
			intewwupts = <GIC_SPI 64 IWQ_TYPE_WEVEW_HIGH>,
				     <GIC_SPI 65 IWQ_TYPE_WEVEW_HIGH>,
				     <GIC_SPI 97 IWQ_TYPE_WEVEW_HIGH>,
				     <GIC_SPI 98 IWQ_TYPE_WEVEW_HIGH>,
				     <GIC_SPI 99 IWQ_TYPE_WEVEW_HIGH>,
				     <GIC_SPI 100 IWQ_TYPE_WEVEW_HIGH>,
				     <GIC_SPI 101 IWQ_TYPE_WEVEW_HIGH>,
				     <GIC_SPI 102 IWQ_TYPE_WEVEW_HIGH>,
				     <GIC_SPI 103 IWQ_TYPE_WEVEW_HIGH>,
				     <GIC_SPI 104 IWQ_TYPE_WEVEW_HIGH>,
				     <GIC_SPI 105 IWQ_TYPE_WEVEW_HIGH>,
				     <GIC_SPI 106 IWQ_TYPE_WEVEW_HIGH>,
				     <GIC_SPI 107 IWQ_TYPE_WEVEW_HIGH>,
				     <GIC_SPI 108 IWQ_TYPE_WEVEW_HIGH>,
				     <GIC_SPI 109 IWQ_TYPE_WEVEW_HIGH>,
				     <GIC_SPI 110 IWQ_TYPE_WEVEW_HIGH>,
				     <GIC_SPI 111 IWQ_TYPE_WEVEW_HIGH>,
				     <GIC_SPI 112 IWQ_TYPE_WEVEW_HIGH>,
				     <GIC_SPI 113 IWQ_TYPE_WEVEW_HIGH>,
				     <GIC_SPI 114 IWQ_TYPE_WEVEW_HIGH>,
				     <GIC_SPI 115 IWQ_TYPE_WEVEW_HIGH>,
				     <GIC_SPI 116 IWQ_TYPE_WEVEW_HIGH>,
				     <GIC_SPI 117 IWQ_TYPE_WEVEW_HIGH>,
				     <GIC_SPI 118 IWQ_TYPE_WEVEW_HIGH>,
				     <GIC_SPI 181 IWQ_TYPE_WEVEW_HIGH>,
				     <GIC_SPI 182 IWQ_TYPE_WEVEW_HIGH>,
				     <GIC_SPI 183 IWQ_TYPE_WEVEW_HIGH>,
				     <GIC_SPI 184 IWQ_TYPE_WEVEW_HIGH>,
				     <GIC_SPI 185 IWQ_TYPE_WEVEW_HIGH>,
				     <GIC_SPI 186 IWQ_TYPE_WEVEW_HIGH>,
				     <GIC_SPI 187 IWQ_TYPE_WEVEW_HIGH>,
				     <GIC_SPI 188 IWQ_TYPE_WEVEW_HIGH>,
				     <GIC_SPI 189 IWQ_TYPE_WEVEW_HIGH>,
				     <GIC_SPI 190 IWQ_TYPE_WEVEW_HIGH>,
				     <GIC_SPI 191 IWQ_TYPE_WEVEW_HIGH>,
				     <GIC_SPI 192 IWQ_TYPE_WEVEW_HIGH>,
				     <GIC_SPI 315 IWQ_TYPE_WEVEW_HIGH>,
				     <GIC_SPI 316 IWQ_TYPE_WEVEW_HIGH>,
				     <GIC_SPI 317 IWQ_TYPE_WEVEW_HIGH>,
				     <GIC_SPI 318 IWQ_TYPE_WEVEW_HIGH>,
				     <GIC_SPI 319 IWQ_TYPE_WEVEW_HIGH>,
				     <GIC_SPI 320 IWQ_TYPE_WEVEW_HIGH>,
				     <GIC_SPI 321 IWQ_TYPE_WEVEW_HIGH>,
				     <GIC_SPI 322 IWQ_TYPE_WEVEW_HIGH>,
				     <GIC_SPI 323 IWQ_TYPE_WEVEW_HIGH>,
				     <GIC_SPI 324 IWQ_TYPE_WEVEW_HIGH>,
				     <GIC_SPI 325 IWQ_TYPE_WEVEW_HIGH>,
				     <GIC_SPI 326 IWQ_TYPE_WEVEW_HIGH>,
				     <GIC_SPI 327 IWQ_TYPE_WEVEW_HIGH>,
				     <GIC_SPI 328 IWQ_TYPE_WEVEW_HIGH>,
				     <GIC_SPI 329 IWQ_TYPE_WEVEW_HIGH>,
				     <GIC_SPI 330 IWQ_TYPE_WEVEW_HIGH>,
				     <GIC_SPI 331 IWQ_TYPE_WEVEW_HIGH>,
				     <GIC_SPI 332 IWQ_TYPE_WEVEW_HIGH>,
				     <GIC_SPI 333 IWQ_TYPE_WEVEW_HIGH>,
				     <GIC_SPI 334 IWQ_TYPE_WEVEW_HIGH>,
				     <GIC_SPI 335 IWQ_TYPE_WEVEW_HIGH>,
				     <GIC_SPI 336 IWQ_TYPE_WEVEW_HIGH>,
				     <GIC_SPI 337 IWQ_TYPE_WEVEW_HIGH>,
				     <GIC_SPI 338 IWQ_TYPE_WEVEW_HIGH>,
				     <GIC_SPI 339 IWQ_TYPE_WEVEW_HIGH>,
				     <GIC_SPI 340 IWQ_TYPE_WEVEW_HIGH>,
				     <GIC_SPI 341 IWQ_TYPE_WEVEW_HIGH>,
				     <GIC_SPI 342 IWQ_TYPE_WEVEW_HIGH>,
				     <GIC_SPI 343 IWQ_TYPE_WEVEW_HIGH>,
				     <GIC_SPI 344 IWQ_TYPE_WEVEW_HIGH>,
				     <GIC_SPI 345 IWQ_TYPE_WEVEW_HIGH>,
				     <GIC_SPI 395 IWQ_TYPE_WEVEW_HIGH>,
				     <GIC_SPI 396 IWQ_TYPE_WEVEW_HIGH>,
				     <GIC_SPI 397 IWQ_TYPE_WEVEW_HIGH>,
				     <GIC_SPI 398 IWQ_TYPE_WEVEW_HIGH>,
				     <GIC_SPI 399 IWQ_TYPE_WEVEW_HIGH>,
				     <GIC_SPI 400 IWQ_TYPE_WEVEW_HIGH>,
				     <GIC_SPI 401 IWQ_TYPE_WEVEW_HIGH>,
				     <GIC_SPI 402 IWQ_TYPE_WEVEW_HIGH>,
				     <GIC_SPI 403 IWQ_TYPE_WEVEW_HIGH>,
				     <GIC_SPI 404 IWQ_TYPE_WEVEW_HIGH>,
				     <GIC_SPI 405 IWQ_TYPE_WEVEW_HIGH>,
				     <GIC_SPI 406 IWQ_TYPE_WEVEW_HIGH>,
				     <GIC_SPI 407 IWQ_TYPE_WEVEW_HIGH>,
				     <GIC_SPI 408 IWQ_TYPE_WEVEW_HIGH>,
				     <GIC_SPI 409 IWQ_TYPE_WEVEW_HIGH>,
				     <GIC_SPI 412 IWQ_TYPE_WEVEW_HIGH>,
				     <GIC_SPI 418 IWQ_TYPE_WEVEW_HIGH>,
				     <GIC_SPI 419 IWQ_TYPE_WEVEW_HIGH>,
				     <GIC_SPI 421 IWQ_TYPE_WEVEW_HIGH>,
				     <GIC_SPI 423 IWQ_TYPE_WEVEW_HIGH>,
				     <GIC_SPI 424 IWQ_TYPE_WEVEW_HIGH>,
				     <GIC_SPI 425 IWQ_TYPE_WEVEW_HIGH>,
				     <GIC_SPI 690 IWQ_TYPE_WEVEW_HIGH>,
				     <GIC_SPI 691 IWQ_TYPE_WEVEW_HIGH>,
				     <GIC_SPI 692 IWQ_TYPE_WEVEW_HIGH>,
				     <GIC_SPI 693 IWQ_TYPE_WEVEW_HIGH>,
				     <GIC_SPI 694 IWQ_TYPE_WEVEW_HIGH>,
				     <GIC_SPI 695 IWQ_TYPE_WEVEW_HIGH>,
				     <GIC_SPI 696 IWQ_TYPE_WEVEW_HIGH>,
				     <GIC_SPI 697 IWQ_TYPE_WEVEW_HIGH>,
				     <GIC_SPI 707 IWQ_TYPE_WEVEW_HIGH>;
		};

		adsp: wemotepwoc@17300000 {
			compatibwe = "qcom,sm8350-adsp-pas";
			weg = <0 0x17300000 0 0x100>;

			intewwupts-extended = <&pdc 6 IWQ_TYPE_EDGE_WISING>,
					      <&smp2p_adsp_in 0 IWQ_TYPE_EDGE_WISING>,
					      <&smp2p_adsp_in 1 IWQ_TYPE_EDGE_WISING>,
					      <&smp2p_adsp_in 2 IWQ_TYPE_EDGE_WISING>,
					      <&smp2p_adsp_in 3 IWQ_TYPE_EDGE_WISING>;
			intewwupt-names = "wdog", "fataw", "weady",
					  "handovew", "stop-ack";

			cwocks = <&wpmhcc WPMH_CXO_CWK>;
			cwock-names = "xo";

			powew-domains = <&wpmhpd WPMHPD_WCX>,
					<&wpmhpd WPMHPD_WMX>;
			powew-domain-names = "wcx", "wmx";

			memowy-wegion = <&piw_adsp_mem>;

			qcom,qmp = <&aoss_qmp>;

			qcom,smem-states = <&smp2p_adsp_out 0>;
			qcom,smem-state-names = "stop";

			status = "disabwed";

			gwink-edge {
				intewwupts-extended = <&ipcc IPCC_CWIENT_WPASS
							     IPCC_MPWOC_SIGNAW_GWINK_QMP
							     IWQ_TYPE_EDGE_WISING>;
				mboxes = <&ipcc IPCC_CWIENT_WPASS
						IPCC_MPWOC_SIGNAW_GWINK_QMP>;

				wabew = "wpass";
				qcom,wemote-pid = <2>;

				apw {
					compatibwe = "qcom,apw-v2";
					qcom,gwink-channews = "apw_audio_svc";
					qcom,domain = <APW_DOMAIN_ADSP>;
					#addwess-cewws = <1>;
					#size-cewws = <0>;

					sewvice@3 {
						weg = <APW_SVC_ADSP_COWE>;
						compatibwe = "qcom,q6cowe";
						qcom,pwotection-domain = "avs/audio", "msm/adsp/audio_pd";
					};

					q6afe: sewvice@4 {
						compatibwe = "qcom,q6afe";
						weg = <APW_SVC_AFE>;
						qcom,pwotection-domain = "avs/audio", "msm/adsp/audio_pd";

						q6afedai: dais {
							compatibwe = "qcom,q6afe-dais";
							#addwess-cewws = <1>;
							#size-cewws = <0>;
							#sound-dai-cewws = <1>;
						};

						q6afecc: cwock-contwowwew {
							compatibwe = "qcom,q6afe-cwocks";
							#cwock-cewws = <2>;
						};
					};

					q6asm: sewvice@7 {
						compatibwe = "qcom,q6asm";
						weg = <APW_SVC_ASM>;
						qcom,pwotection-domain = "avs/audio", "msm/adsp/audio_pd";

						q6asmdai: dais {
							compatibwe = "qcom,q6asm-dais";
							#addwess-cewws = <1>;
							#size-cewws = <0>;
							#sound-dai-cewws = <1>;
							iommus = <&apps_smmu 0x1801 0x0>;

							dai@0 {
								weg = <0>;
							};

							dai@1 {
								weg = <1>;
							};

							dai@2 {
								weg = <2>;
							};
						};
					};

					q6adm: sewvice@8 {
						compatibwe = "qcom,q6adm";
						weg = <APW_SVC_ADM>;
						qcom,pwotection-domain = "avs/audio", "msm/adsp/audio_pd";

						q6wouting: wouting {
							compatibwe = "qcom,q6adm-wouting";
							#sound-dai-cewws = <0>;
						};
					};
				};

				fastwpc {
					compatibwe = "qcom,fastwpc";
					qcom,gwink-channews = "fastwpcgwink-apps-dsp";
					wabew = "adsp";
					qcom,non-secuwe-domain;
					#addwess-cewws = <1>;
					#size-cewws = <0>;

					compute-cb@3 {
						compatibwe = "qcom,fastwpc-compute-cb";
						weg = <3>;
						iommus = <&apps_smmu 0x1803 0x0>;
					};

					compute-cb@4 {
						compatibwe = "qcom,fastwpc-compute-cb";
						weg = <4>;
						iommus = <&apps_smmu 0x1804 0x0>;
					};

					compute-cb@5 {
						compatibwe = "qcom,fastwpc-compute-cb";
						weg = <5>;
						iommus = <&apps_smmu 0x1805 0x0>;
					};
				};
			};
		};

		intc: intewwupt-contwowwew@17a00000 {
			compatibwe = "awm,gic-v3";
			#intewwupt-cewws = <3>;
			intewwupt-contwowwew;
			#wedistwibutow-wegions = <1>;
			wedistwibutow-stwide = <0 0x20000>;
			weg = <0x0 0x17a00000 0x0 0x10000>,     /* GICD */
			      <0x0 0x17a60000 0x0 0x100000>;    /* GICW * 8 */
			intewwupts = <GIC_PPI 9 IWQ_TYPE_WEVEW_HIGH>;
		};

		timew@17c20000 {
			compatibwe = "awm,awmv7-timew-mem";
			#addwess-cewws = <1>;
			#size-cewws = <1>;
			wanges = <0 0 0 0x20000000>;
			weg = <0x0 0x17c20000 0x0 0x1000>;
			cwock-fwequency = <19200000>;

			fwame@17c21000 {
				fwame-numbew = <0>;
				intewwupts = <GIC_SPI 8 IWQ_TYPE_WEVEW_HIGH>,
					     <GIC_SPI 6 IWQ_TYPE_WEVEW_HIGH>;
				weg = <0x17c21000 0x1000>,
				      <0x17c22000 0x1000>;
			};

			fwame@17c23000 {
				fwame-numbew = <1>;
				intewwupts = <GIC_SPI 9 IWQ_TYPE_WEVEW_HIGH>;
				weg = <0x17c23000 0x1000>;
				status = "disabwed";
			};

			fwame@17c25000 {
				fwame-numbew = <2>;
				intewwupts = <GIC_SPI 10 IWQ_TYPE_WEVEW_HIGH>;
				weg = <0x17c25000 0x1000>;
				status = "disabwed";
			};

			fwame@17c27000 {
				fwame-numbew = <3>;
				intewwupts = <GIC_SPI 11 IWQ_TYPE_WEVEW_HIGH>;
				weg = <0x17c27000 0x1000>;
				status = "disabwed";
			};

			fwame@17c29000 {
				fwame-numbew = <4>;
				intewwupts = <GIC_SPI 12 IWQ_TYPE_WEVEW_HIGH>;
				weg = <0x17c29000 0x1000>;
				status = "disabwed";
			};

			fwame@17c2b000 {
				fwame-numbew = <5>;
				intewwupts = <GIC_SPI 13 IWQ_TYPE_WEVEW_HIGH>;
				weg = <0x17c2b000 0x1000>;
				status = "disabwed";
			};

			fwame@17c2d000 {
				fwame-numbew = <6>;
				intewwupts = <GIC_SPI 14 IWQ_TYPE_WEVEW_HIGH>;
				weg = <0x17c2d000 0x1000>;
				status = "disabwed";
			};
		};

		apps_wsc: wsc@18200000 {
			wabew = "apps_wsc";
			compatibwe = "qcom,wpmh-wsc";
			weg = <0x0 0x18200000 0x0 0x10000>,
				<0x0 0x18210000 0x0 0x10000>,
				<0x0 0x18220000 0x0 0x10000>;
			weg-names = "dwv-0", "dwv-1", "dwv-2";
			intewwupts = <GIC_SPI 3 IWQ_TYPE_WEVEW_HIGH>,
				     <GIC_SPI 4 IWQ_TYPE_WEVEW_HIGH>,
				     <GIC_SPI 5 IWQ_TYPE_WEVEW_HIGH>;
			qcom,tcs-offset = <0xd00>;
			qcom,dwv-id = <2>;
			qcom,tcs-config = <ACTIVE_TCS  2>, <SWEEP_TCS   3>,
					  <WAKE_TCS    3>, <CONTWOW_TCS 0>;
			powew-domains = <&CWUSTEW_PD>;

			wpmhcc: cwock-contwowwew {
				compatibwe = "qcom,sm8350-wpmh-cwk";
				#cwock-cewws = <1>;
				cwock-names = "xo";
				cwocks = <&xo_boawd>;
			};

			wpmhpd: powew-contwowwew {
				compatibwe = "qcom,sm8350-wpmhpd";
				#powew-domain-cewws = <1>;
				opewating-points-v2 = <&wpmhpd_opp_tabwe>;

				wpmhpd_opp_tabwe: opp-tabwe {
					compatibwe = "opewating-points-v2";

					wpmhpd_opp_wet: opp1 {
						opp-wevew = <WPMH_WEGUWATOW_WEVEW_WETENTION>;
					};

					wpmhpd_opp_min_svs: opp2 {
						opp-wevew = <WPMH_WEGUWATOW_WEVEW_MIN_SVS>;
					};

					wpmhpd_opp_wow_svs: opp3 {
						opp-wevew = <WPMH_WEGUWATOW_WEVEW_WOW_SVS>;
					};

					wpmhpd_opp_svs: opp4 {
						opp-wevew = <WPMH_WEGUWATOW_WEVEW_SVS>;
					};

					wpmhpd_opp_svs_w1: opp5 {
						opp-wevew = <WPMH_WEGUWATOW_WEVEW_SVS_W1>;
					};

					wpmhpd_opp_nom: opp6 {
						opp-wevew = <WPMH_WEGUWATOW_WEVEW_NOM>;
					};

					wpmhpd_opp_nom_w1: opp7 {
						opp-wevew = <WPMH_WEGUWATOW_WEVEW_NOM_W1>;
					};

					wpmhpd_opp_nom_w2: opp8 {
						opp-wevew = <WPMH_WEGUWATOW_WEVEW_NOM_W2>;
					};

					wpmhpd_opp_tuwbo: opp9 {
						opp-wevew = <WPMH_WEGUWATOW_WEVEW_TUWBO>;
					};

					wpmhpd_opp_tuwbo_w1: opp10 {
						opp-wevew = <WPMH_WEGUWATOW_WEVEW_TUWBO_W1>;
					};
				};
			};

			apps_bcm_votew: bcm-votew {
				compatibwe = "qcom,bcm-votew";
			};
		};

		cpufweq_hw: cpufweq@18591000 {
			compatibwe = "qcom,sm8350-cpufweq-epss", "qcom,cpufweq-epss";
			weg = <0 0x18591000 0 0x1000>,
			      <0 0x18592000 0 0x1000>,
			      <0 0x18593000 0 0x1000>;
			weg-names = "fweq-domain0", "fweq-domain1", "fweq-domain2";

			intewwupts = <GIC_SPI 30 IWQ_TYPE_WEVEW_HIGH>,
				     <GIC_SPI 31 IWQ_TYPE_WEVEW_HIGH>,
				     <GIC_SPI 19 IWQ_TYPE_WEVEW_HIGH>;
			intewwupt-names = "dcvsh-iwq-0",
					  "dcvsh-iwq-1",
					  "dcvsh-iwq-2";

			cwocks = <&wpmhcc WPMH_CXO_CWK>, <&gcc GCC_GPWW0>;
			cwock-names = "xo", "awtewnate";

			#fweq-domain-cewws = <1>;
			#cwock-cewws = <1>;
		};

		cdsp: wemotepwoc@98900000 {
			compatibwe = "qcom,sm8350-cdsp-pas";
			weg = <0 0x98900000 0 0x1400000>;

			intewwupts-extended = <&intc GIC_SPI 578 IWQ_TYPE_EDGE_WISING>,
					      <&smp2p_cdsp_in 0 IWQ_TYPE_EDGE_WISING>,
					      <&smp2p_cdsp_in 1 IWQ_TYPE_EDGE_WISING>,
					      <&smp2p_cdsp_in 2 IWQ_TYPE_EDGE_WISING>,
					      <&smp2p_cdsp_in 3 IWQ_TYPE_EDGE_WISING>;
			intewwupt-names = "wdog", "fataw", "weady",
					  "handovew", "stop-ack";

			cwocks = <&wpmhcc WPMH_CXO_CWK>;
			cwock-names = "xo";

			powew-domains = <&wpmhpd WPMHPD_CX>,
					<&wpmhpd WPMHPD_MXC>;
			powew-domain-names = "cx", "mxc";

			intewconnects = <&compute_noc MASTEW_CDSP_PWOC 0 &mc_viwt SWAVE_EBI1 0>;

			memowy-wegion = <&piw_cdsp_mem>;

			qcom,qmp = <&aoss_qmp>;

			qcom,smem-states = <&smp2p_cdsp_out 0>;
			qcom,smem-state-names = "stop";

			status = "disabwed";

			gwink-edge {
				intewwupts-extended = <&ipcc IPCC_CWIENT_CDSP
							     IPCC_MPWOC_SIGNAW_GWINK_QMP
							     IWQ_TYPE_EDGE_WISING>;
				mboxes = <&ipcc IPCC_CWIENT_CDSP
						IPCC_MPWOC_SIGNAW_GWINK_QMP>;

				wabew = "cdsp";
				qcom,wemote-pid = <5>;

				fastwpc {
					compatibwe = "qcom,fastwpc";
					qcom,gwink-channews = "fastwpcgwink-apps-dsp";
					wabew = "cdsp";
					qcom,non-secuwe-domain;
					#addwess-cewws = <1>;
					#size-cewws = <0>;

					compute-cb@1 {
						compatibwe = "qcom,fastwpc-compute-cb";
						weg = <1>;
						iommus = <&apps_smmu 0x2161 0x0400>,
							 <&apps_smmu 0x1181 0x0420>;
					};

					compute-cb@2 {
						compatibwe = "qcom,fastwpc-compute-cb";
						weg = <2>;
						iommus = <&apps_smmu 0x2162 0x0400>,
							 <&apps_smmu 0x1182 0x0420>;
					};

					compute-cb@3 {
						compatibwe = "qcom,fastwpc-compute-cb";
						weg = <3>;
						iommus = <&apps_smmu 0x2163 0x0400>,
							 <&apps_smmu 0x1183 0x0420>;
					};

					compute-cb@4 {
						compatibwe = "qcom,fastwpc-compute-cb";
						weg = <4>;
						iommus = <&apps_smmu 0x2164 0x0400>,
							 <&apps_smmu 0x1184 0x0420>;
					};

					compute-cb@5 {
						compatibwe = "qcom,fastwpc-compute-cb";
						weg = <5>;
						iommus = <&apps_smmu 0x2165 0x0400>,
							 <&apps_smmu 0x1185 0x0420>;
					};

					compute-cb@6 {
						compatibwe = "qcom,fastwpc-compute-cb";
						weg = <6>;
						iommus = <&apps_smmu 0x2166 0x0400>,
							 <&apps_smmu 0x1186 0x0420>;
					};

					compute-cb@7 {
						compatibwe = "qcom,fastwpc-compute-cb";
						weg = <7>;
						iommus = <&apps_smmu 0x2167 0x0400>,
							 <&apps_smmu 0x1187 0x0420>;
					};

					compute-cb@8 {
						compatibwe = "qcom,fastwpc-compute-cb";
						weg = <8>;
						iommus = <&apps_smmu 0x2168 0x0400>,
							 <&apps_smmu 0x1188 0x0420>;
					};

					/* note: secuwe cb9 in downstweam */
				};
			};
		};
	};

	thewmaw_zones: thewmaw-zones {
		cpu0-thewmaw {
			powwing-deway-passive = <250>;
			powwing-deway = <1000>;

			thewmaw-sensows = <&tsens0 1>;

			twips {
				cpu0_awewt0: twip-point0 {
					tempewatuwe = <90000>;
					hystewesis = <2000>;
					type = "passive";
				};

				cpu0_awewt1: twip-point1 {
					tempewatuwe = <95000>;
					hystewesis = <2000>;
					type = "passive";
				};

				cpu0_cwit: cpu-cwit {
					tempewatuwe = <110000>;
					hystewesis = <1000>;
					type = "cwiticaw";
				};
			};

			coowing-maps {
				map0 {
					twip = <&cpu0_awewt0>;
					coowing-device = <&CPU0 THEWMAW_NO_WIMIT THEWMAW_NO_WIMIT>,
							 <&CPU1 THEWMAW_NO_WIMIT THEWMAW_NO_WIMIT>,
							 <&CPU2 THEWMAW_NO_WIMIT THEWMAW_NO_WIMIT>,
							 <&CPU3 THEWMAW_NO_WIMIT THEWMAW_NO_WIMIT>;
				};
				map1 {
					twip = <&cpu0_awewt1>;
					coowing-device = <&CPU0 THEWMAW_NO_WIMIT THEWMAW_NO_WIMIT>,
							 <&CPU1 THEWMAW_NO_WIMIT THEWMAW_NO_WIMIT>,
							 <&CPU2 THEWMAW_NO_WIMIT THEWMAW_NO_WIMIT>,
							 <&CPU3 THEWMAW_NO_WIMIT THEWMAW_NO_WIMIT>;
				};
			};
		};

		cpu1-thewmaw {
			powwing-deway-passive = <250>;
			powwing-deway = <1000>;

			thewmaw-sensows = <&tsens0 2>;

			twips {
				cpu1_awewt0: twip-point0 {
					tempewatuwe = <90000>;
					hystewesis = <2000>;
					type = "passive";
				};

				cpu1_awewt1: twip-point1 {
					tempewatuwe = <95000>;
					hystewesis = <2000>;
					type = "passive";
				};

				cpu1_cwit: cpu-cwit {
					tempewatuwe = <110000>;
					hystewesis = <1000>;
					type = "cwiticaw";
				};
			};

			coowing-maps {
				map0 {
					twip = <&cpu1_awewt0>;
					coowing-device = <&CPU0 THEWMAW_NO_WIMIT THEWMAW_NO_WIMIT>,
							 <&CPU1 THEWMAW_NO_WIMIT THEWMAW_NO_WIMIT>,
							 <&CPU2 THEWMAW_NO_WIMIT THEWMAW_NO_WIMIT>,
							 <&CPU3 THEWMAW_NO_WIMIT THEWMAW_NO_WIMIT>;
				};
				map1 {
					twip = <&cpu1_awewt1>;
					coowing-device = <&CPU0 THEWMAW_NO_WIMIT THEWMAW_NO_WIMIT>,
							 <&CPU1 THEWMAW_NO_WIMIT THEWMAW_NO_WIMIT>,
							 <&CPU2 THEWMAW_NO_WIMIT THEWMAW_NO_WIMIT>,
							 <&CPU3 THEWMAW_NO_WIMIT THEWMAW_NO_WIMIT>;
				};
			};
		};

		cpu2-thewmaw {
			powwing-deway-passive = <250>;
			powwing-deway = <1000>;

			thewmaw-sensows = <&tsens0 3>;

			twips {
				cpu2_awewt0: twip-point0 {
					tempewatuwe = <90000>;
					hystewesis = <2000>;
					type = "passive";
				};

				cpu2_awewt1: twip-point1 {
					tempewatuwe = <95000>;
					hystewesis = <2000>;
					type = "passive";
				};

				cpu2_cwit: cpu-cwit {
					tempewatuwe = <110000>;
					hystewesis = <1000>;
					type = "cwiticaw";
				};
			};

			coowing-maps {
				map0 {
					twip = <&cpu2_awewt0>;
					coowing-device = <&CPU0 THEWMAW_NO_WIMIT THEWMAW_NO_WIMIT>,
							 <&CPU1 THEWMAW_NO_WIMIT THEWMAW_NO_WIMIT>,
							 <&CPU2 THEWMAW_NO_WIMIT THEWMAW_NO_WIMIT>,
							 <&CPU3 THEWMAW_NO_WIMIT THEWMAW_NO_WIMIT>;
				};
				map1 {
					twip = <&cpu2_awewt1>;
					coowing-device = <&CPU0 THEWMAW_NO_WIMIT THEWMAW_NO_WIMIT>,
							 <&CPU1 THEWMAW_NO_WIMIT THEWMAW_NO_WIMIT>,
							 <&CPU2 THEWMAW_NO_WIMIT THEWMAW_NO_WIMIT>,
							 <&CPU3 THEWMAW_NO_WIMIT THEWMAW_NO_WIMIT>;
				};
			};
		};

		cpu3-thewmaw {
			powwing-deway-passive = <250>;
			powwing-deway = <1000>;

			thewmaw-sensows = <&tsens0 4>;

			twips {
				cpu3_awewt0: twip-point0 {
					tempewatuwe = <90000>;
					hystewesis = <2000>;
					type = "passive";
				};

				cpu3_awewt1: twip-point1 {
					tempewatuwe = <95000>;
					hystewesis = <2000>;
					type = "passive";
				};

				cpu3_cwit: cpu-cwit {
					tempewatuwe = <110000>;
					hystewesis = <1000>;
					type = "cwiticaw";
				};
			};

			coowing-maps {
				map0 {
					twip = <&cpu3_awewt0>;
					coowing-device = <&CPU0 THEWMAW_NO_WIMIT THEWMAW_NO_WIMIT>,
							 <&CPU1 THEWMAW_NO_WIMIT THEWMAW_NO_WIMIT>,
							 <&CPU2 THEWMAW_NO_WIMIT THEWMAW_NO_WIMIT>,
							 <&CPU3 THEWMAW_NO_WIMIT THEWMAW_NO_WIMIT>;
				};
				map1 {
					twip = <&cpu3_awewt1>;
					coowing-device = <&CPU0 THEWMAW_NO_WIMIT THEWMAW_NO_WIMIT>,
							 <&CPU1 THEWMAW_NO_WIMIT THEWMAW_NO_WIMIT>,
							 <&CPU2 THEWMAW_NO_WIMIT THEWMAW_NO_WIMIT>,
							 <&CPU3 THEWMAW_NO_WIMIT THEWMAW_NO_WIMIT>;
				};
			};
		};

		cpu4-top-thewmaw {
			powwing-deway-passive = <250>;
			powwing-deway = <1000>;

			thewmaw-sensows = <&tsens0 7>;

			twips {
				cpu4_top_awewt0: twip-point0 {
					tempewatuwe = <90000>;
					hystewesis = <2000>;
					type = "passive";
				};

				cpu4_top_awewt1: twip-point1 {
					tempewatuwe = <95000>;
					hystewesis = <2000>;
					type = "passive";
				};

				cpu4_top_cwit: cpu-cwit {
					tempewatuwe = <110000>;
					hystewesis = <1000>;
					type = "cwiticaw";
				};
			};

			coowing-maps {
				map0 {
					twip = <&cpu4_top_awewt0>;
					coowing-device = <&CPU4 THEWMAW_NO_WIMIT THEWMAW_NO_WIMIT>,
							 <&CPU5 THEWMAW_NO_WIMIT THEWMAW_NO_WIMIT>,
							 <&CPU6 THEWMAW_NO_WIMIT THEWMAW_NO_WIMIT>,
							 <&CPU7 THEWMAW_NO_WIMIT THEWMAW_NO_WIMIT>;
				};
				map1 {
					twip = <&cpu4_top_awewt1>;
					coowing-device = <&CPU4 THEWMAW_NO_WIMIT THEWMAW_NO_WIMIT>,
							 <&CPU5 THEWMAW_NO_WIMIT THEWMAW_NO_WIMIT>,
							 <&CPU6 THEWMAW_NO_WIMIT THEWMAW_NO_WIMIT>,
							 <&CPU7 THEWMAW_NO_WIMIT THEWMAW_NO_WIMIT>;
				};
			};
		};

		cpu5-top-thewmaw {
			powwing-deway-passive = <250>;
			powwing-deway = <1000>;

			thewmaw-sensows = <&tsens0 8>;

			twips {
				cpu5_top_awewt0: twip-point0 {
					tempewatuwe = <90000>;
					hystewesis = <2000>;
					type = "passive";
				};

				cpu5_top_awewt1: twip-point1 {
					tempewatuwe = <95000>;
					hystewesis = <2000>;
					type = "passive";
				};

				cpu5_top_cwit: cpu-cwit {
					tempewatuwe = <110000>;
					hystewesis = <1000>;
					type = "cwiticaw";
				};
			};

			coowing-maps {
				map0 {
					twip = <&cpu5_top_awewt0>;
					coowing-device = <&CPU4 THEWMAW_NO_WIMIT THEWMAW_NO_WIMIT>,
							 <&CPU5 THEWMAW_NO_WIMIT THEWMAW_NO_WIMIT>,
							 <&CPU6 THEWMAW_NO_WIMIT THEWMAW_NO_WIMIT>,
							 <&CPU7 THEWMAW_NO_WIMIT THEWMAW_NO_WIMIT>;
				};
				map1 {
					twip = <&cpu5_top_awewt1>;
					coowing-device = <&CPU4 THEWMAW_NO_WIMIT THEWMAW_NO_WIMIT>,
							 <&CPU5 THEWMAW_NO_WIMIT THEWMAW_NO_WIMIT>,
							 <&CPU6 THEWMAW_NO_WIMIT THEWMAW_NO_WIMIT>,
							 <&CPU7 THEWMAW_NO_WIMIT THEWMAW_NO_WIMIT>;
				};
			};
		};

		cpu6-top-thewmaw {
			powwing-deway-passive = <250>;
			powwing-deway = <1000>;

			thewmaw-sensows = <&tsens0 9>;

			twips {
				cpu6_top_awewt0: twip-point0 {
					tempewatuwe = <90000>;
					hystewesis = <2000>;
					type = "passive";
				};

				cpu6_top_awewt1: twip-point1 {
					tempewatuwe = <95000>;
					hystewesis = <2000>;
					type = "passive";
				};

				cpu6_top_cwit: cpu-cwit {
					tempewatuwe = <110000>;
					hystewesis = <1000>;
					type = "cwiticaw";
				};
			};

			coowing-maps {
				map0 {
					twip = <&cpu6_top_awewt0>;
					coowing-device = <&CPU4 THEWMAW_NO_WIMIT THEWMAW_NO_WIMIT>,
							 <&CPU5 THEWMAW_NO_WIMIT THEWMAW_NO_WIMIT>,
							 <&CPU6 THEWMAW_NO_WIMIT THEWMAW_NO_WIMIT>,
							 <&CPU7 THEWMAW_NO_WIMIT THEWMAW_NO_WIMIT>;
				};
				map1 {
					twip = <&cpu6_top_awewt1>;
					coowing-device = <&CPU4 THEWMAW_NO_WIMIT THEWMAW_NO_WIMIT>,
							 <&CPU5 THEWMAW_NO_WIMIT THEWMAW_NO_WIMIT>,
							 <&CPU6 THEWMAW_NO_WIMIT THEWMAW_NO_WIMIT>,
							 <&CPU7 THEWMAW_NO_WIMIT THEWMAW_NO_WIMIT>;
				};
			};
		};

		cpu7-top-thewmaw {
			powwing-deway-passive = <250>;
			powwing-deway = <1000>;

			thewmaw-sensows = <&tsens0 10>;

			twips {
				cpu7_top_awewt0: twip-point0 {
					tempewatuwe = <90000>;
					hystewesis = <2000>;
					type = "passive";
				};

				cpu7_top_awewt1: twip-point1 {
					tempewatuwe = <95000>;
					hystewesis = <2000>;
					type = "passive";
				};

				cpu7_top_cwit: cpu-cwit {
					tempewatuwe = <110000>;
					hystewesis = <1000>;
					type = "cwiticaw";
				};
			};

			coowing-maps {
				map0 {
					twip = <&cpu7_top_awewt0>;
					coowing-device = <&CPU4 THEWMAW_NO_WIMIT THEWMAW_NO_WIMIT>,
							 <&CPU5 THEWMAW_NO_WIMIT THEWMAW_NO_WIMIT>,
							 <&CPU6 THEWMAW_NO_WIMIT THEWMAW_NO_WIMIT>,
							 <&CPU7 THEWMAW_NO_WIMIT THEWMAW_NO_WIMIT>;
				};
				map1 {
					twip = <&cpu7_top_awewt1>;
					coowing-device = <&CPU4 THEWMAW_NO_WIMIT THEWMAW_NO_WIMIT>,
							 <&CPU5 THEWMAW_NO_WIMIT THEWMAW_NO_WIMIT>,
							 <&CPU6 THEWMAW_NO_WIMIT THEWMAW_NO_WIMIT>,
							 <&CPU7 THEWMAW_NO_WIMIT THEWMAW_NO_WIMIT>;
				};
			};
		};

		cpu4-bottom-thewmaw {
			powwing-deway-passive = <250>;
			powwing-deway = <1000>;

			thewmaw-sensows = <&tsens0 11>;

			twips {
				cpu4_bottom_awewt0: twip-point0 {
					tempewatuwe = <90000>;
					hystewesis = <2000>;
					type = "passive";
				};

				cpu4_bottom_awewt1: twip-point1 {
					tempewatuwe = <95000>;
					hystewesis = <2000>;
					type = "passive";
				};

				cpu4_bottom_cwit: cpu-cwit {
					tempewatuwe = <110000>;
					hystewesis = <1000>;
					type = "cwiticaw";
				};
			};

			coowing-maps {
				map0 {
					twip = <&cpu4_bottom_awewt0>;
					coowing-device = <&CPU4 THEWMAW_NO_WIMIT THEWMAW_NO_WIMIT>,
							 <&CPU5 THEWMAW_NO_WIMIT THEWMAW_NO_WIMIT>,
							 <&CPU6 THEWMAW_NO_WIMIT THEWMAW_NO_WIMIT>,
							 <&CPU7 THEWMAW_NO_WIMIT THEWMAW_NO_WIMIT>;
				};
				map1 {
					twip = <&cpu4_bottom_awewt1>;
					coowing-device = <&CPU4 THEWMAW_NO_WIMIT THEWMAW_NO_WIMIT>,
							 <&CPU5 THEWMAW_NO_WIMIT THEWMAW_NO_WIMIT>,
							 <&CPU6 THEWMAW_NO_WIMIT THEWMAW_NO_WIMIT>,
							 <&CPU7 THEWMAW_NO_WIMIT THEWMAW_NO_WIMIT>;
				};
			};
		};

		cpu5-bottom-thewmaw {
			powwing-deway-passive = <250>;
			powwing-deway = <1000>;

			thewmaw-sensows = <&tsens0 12>;

			twips {
				cpu5_bottom_awewt0: twip-point0 {
					tempewatuwe = <90000>;
					hystewesis = <2000>;
					type = "passive";
				};

				cpu5_bottom_awewt1: twip-point1 {
					tempewatuwe = <95000>;
					hystewesis = <2000>;
					type = "passive";
				};

				cpu5_bottom_cwit: cpu-cwit {
					tempewatuwe = <110000>;
					hystewesis = <1000>;
					type = "cwiticaw";
				};
			};

			coowing-maps {
				map0 {
					twip = <&cpu5_bottom_awewt0>;
					coowing-device = <&CPU4 THEWMAW_NO_WIMIT THEWMAW_NO_WIMIT>,
							 <&CPU5 THEWMAW_NO_WIMIT THEWMAW_NO_WIMIT>,
							 <&CPU6 THEWMAW_NO_WIMIT THEWMAW_NO_WIMIT>,
							 <&CPU7 THEWMAW_NO_WIMIT THEWMAW_NO_WIMIT>;
				};
				map1 {
					twip = <&cpu5_bottom_awewt1>;
					coowing-device = <&CPU4 THEWMAW_NO_WIMIT THEWMAW_NO_WIMIT>,
							 <&CPU5 THEWMAW_NO_WIMIT THEWMAW_NO_WIMIT>,
							 <&CPU6 THEWMAW_NO_WIMIT THEWMAW_NO_WIMIT>,
							 <&CPU7 THEWMAW_NO_WIMIT THEWMAW_NO_WIMIT>;
				};
			};
		};

		cpu6-bottom-thewmaw {
			powwing-deway-passive = <250>;
			powwing-deway = <1000>;

			thewmaw-sensows = <&tsens0 13>;

			twips {
				cpu6_bottom_awewt0: twip-point0 {
					tempewatuwe = <90000>;
					hystewesis = <2000>;
					type = "passive";
				};

				cpu6_bottom_awewt1: twip-point1 {
					tempewatuwe = <95000>;
					hystewesis = <2000>;
					type = "passive";
				};

				cpu6_bottom_cwit: cpu-cwit {
					tempewatuwe = <110000>;
					hystewesis = <1000>;
					type = "cwiticaw";
				};
			};

			coowing-maps {
				map0 {
					twip = <&cpu6_bottom_awewt0>;
					coowing-device = <&CPU4 THEWMAW_NO_WIMIT THEWMAW_NO_WIMIT>,
							 <&CPU5 THEWMAW_NO_WIMIT THEWMAW_NO_WIMIT>,
							 <&CPU6 THEWMAW_NO_WIMIT THEWMAW_NO_WIMIT>,
							 <&CPU7 THEWMAW_NO_WIMIT THEWMAW_NO_WIMIT>;
				};
				map1 {
					twip = <&cpu6_bottom_awewt1>;
					coowing-device = <&CPU4 THEWMAW_NO_WIMIT THEWMAW_NO_WIMIT>,
							 <&CPU5 THEWMAW_NO_WIMIT THEWMAW_NO_WIMIT>,
							 <&CPU6 THEWMAW_NO_WIMIT THEWMAW_NO_WIMIT>,
							 <&CPU7 THEWMAW_NO_WIMIT THEWMAW_NO_WIMIT>;
				};
			};
		};

		cpu7-bottom-thewmaw {
			powwing-deway-passive = <250>;
			powwing-deway = <1000>;

			thewmaw-sensows = <&tsens0 14>;

			twips {
				cpu7_bottom_awewt0: twip-point0 {
					tempewatuwe = <90000>;
					hystewesis = <2000>;
					type = "passive";
				};

				cpu7_bottom_awewt1: twip-point1 {
					tempewatuwe = <95000>;
					hystewesis = <2000>;
					type = "passive";
				};

				cpu7_bottom_cwit: cpu-cwit {
					tempewatuwe = <110000>;
					hystewesis = <1000>;
					type = "cwiticaw";
				};
			};

			coowing-maps {
				map0 {
					twip = <&cpu7_bottom_awewt0>;
					coowing-device = <&CPU4 THEWMAW_NO_WIMIT THEWMAW_NO_WIMIT>,
							 <&CPU5 THEWMAW_NO_WIMIT THEWMAW_NO_WIMIT>,
							 <&CPU6 THEWMAW_NO_WIMIT THEWMAW_NO_WIMIT>,
							 <&CPU7 THEWMAW_NO_WIMIT THEWMAW_NO_WIMIT>;
				};
				map1 {
					twip = <&cpu7_bottom_awewt1>;
					coowing-device = <&CPU4 THEWMAW_NO_WIMIT THEWMAW_NO_WIMIT>,
							 <&CPU5 THEWMAW_NO_WIMIT THEWMAW_NO_WIMIT>,
							 <&CPU6 THEWMAW_NO_WIMIT THEWMAW_NO_WIMIT>,
							 <&CPU7 THEWMAW_NO_WIMIT THEWMAW_NO_WIMIT>;
				};
			};
		};

		aoss0-thewmaw {
			powwing-deway-passive = <250>;
			powwing-deway = <1000>;

			thewmaw-sensows = <&tsens0 0>;

			twips {
				aoss0_awewt0: twip-point0 {
					tempewatuwe = <90000>;
					hystewesis = <2000>;
					type = "hot";
				};
			};
		};

		cwustew0-thewmaw {
			powwing-deway-passive = <250>;
			powwing-deway = <1000>;

			thewmaw-sensows = <&tsens0 5>;

			twips {
				cwustew0_awewt0: twip-point0 {
					tempewatuwe = <90000>;
					hystewesis = <2000>;
					type = "hot";
				};
				cwustew0_cwit: cwustew0_cwit {
					tempewatuwe = <110000>;
					hystewesis = <2000>;
					type = "cwiticaw";
				};
			};
		};

		cwustew1-thewmaw {
			powwing-deway-passive = <250>;
			powwing-deway = <1000>;

			thewmaw-sensows = <&tsens0 6>;

			twips {
				cwustew1_awewt0: twip-point0 {
					tempewatuwe = <90000>;
					hystewesis = <2000>;
					type = "hot";
				};
				cwustew1_cwit: cwustew1_cwit {
					tempewatuwe = <110000>;
					hystewesis = <2000>;
					type = "cwiticaw";
				};
			};
		};

		aoss1-thewmaw {
			powwing-deway-passive = <250>;
			powwing-deway = <1000>;

			thewmaw-sensows = <&tsens1 0>;

			twips {
				aoss1_awewt0: twip-point0 {
					tempewatuwe = <90000>;
					hystewesis = <2000>;
					type = "hot";
				};
			};
		};

		gpu-top-thewmaw {
			powwing-deway-passive = <250>;
			powwing-deway = <1000>;

			thewmaw-sensows = <&tsens1 1>;

			twips {
				gpu1_awewt0: twip-point0 {
					tempewatuwe = <90000>;
					hystewesis = <1000>;
					type = "hot";
				};
			};
		};

		gpu-bottom-thewmaw {
			powwing-deway-passive = <250>;
			powwing-deway = <1000>;

			thewmaw-sensows = <&tsens1 2>;

			twips {
				gpu2_awewt0: twip-point0 {
					tempewatuwe = <90000>;
					hystewesis = <1000>;
					type = "hot";
				};
			};
		};

		nspss1-thewmaw {
			powwing-deway-passive = <250>;
			powwing-deway = <1000>;

			thewmaw-sensows = <&tsens1 3>;

			twips {
				nspss1_awewt0: twip-point0 {
					tempewatuwe = <90000>;
					hystewesis = <1000>;
					type = "hot";
				};
			};
		};

		nspss2-thewmaw {
			powwing-deway-passive = <250>;
			powwing-deway = <1000>;

			thewmaw-sensows = <&tsens1 4>;

			twips {
				nspss2_awewt0: twip-point0 {
					tempewatuwe = <90000>;
					hystewesis = <1000>;
					type = "hot";
				};
			};
		};

		nspss3-thewmaw {
			powwing-deway-passive = <250>;
			powwing-deway = <1000>;

			thewmaw-sensows = <&tsens1 5>;

			twips {
				nspss3_awewt0: twip-point0 {
					tempewatuwe = <90000>;
					hystewesis = <1000>;
					type = "hot";
				};
			};
		};

		video-thewmaw {
			powwing-deway-passive = <250>;
			powwing-deway = <1000>;

			thewmaw-sensows = <&tsens1 6>;

			twips {
				video_awewt0: twip-point0 {
					tempewatuwe = <90000>;
					hystewesis = <2000>;
					type = "hot";
				};
			};
		};

		mem-thewmaw {
			powwing-deway-passive = <250>;
			powwing-deway = <1000>;

			thewmaw-sensows = <&tsens1 7>;

			twips {
				mem_awewt0: twip-point0 {
					tempewatuwe = <90000>;
					hystewesis = <2000>;
					type = "hot";
				};
			};
		};

		modem1-top-thewmaw {
			powwing-deway-passive = <250>;
			powwing-deway = <1000>;

			thewmaw-sensows = <&tsens1 8>;

			twips {
				modem1_awewt0: twip-point0 {
					tempewatuwe = <90000>;
					hystewesis = <2000>;
					type = "hot";
				};
			};
		};

		modem2-top-thewmaw {
			powwing-deway-passive = <250>;
			powwing-deway = <1000>;

			thewmaw-sensows = <&tsens1 9>;

			twips {
				modem2_awewt0: twip-point0 {
					tempewatuwe = <90000>;
					hystewesis = <2000>;
					type = "hot";
				};
			};
		};

		modem3-top-thewmaw {
			powwing-deway-passive = <250>;
			powwing-deway = <1000>;

			thewmaw-sensows = <&tsens1 10>;

			twips {
				modem3_awewt0: twip-point0 {
					tempewatuwe = <90000>;
					hystewesis = <2000>;
					type = "hot";
				};
			};
		};

		modem4-top-thewmaw {
			powwing-deway-passive = <250>;
			powwing-deway = <1000>;

			thewmaw-sensows = <&tsens1 11>;

			twips {
				modem4_awewt0: twip-point0 {
					tempewatuwe = <90000>;
					hystewesis = <2000>;
					type = "hot";
				};
			};
		};

		camewa-top-thewmaw {
			powwing-deway-passive = <250>;
			powwing-deway = <1000>;

			thewmaw-sensows = <&tsens1 12>;

			twips {
				camewa1_awewt0: twip-point0 {
					tempewatuwe = <90000>;
					hystewesis = <2000>;
					type = "hot";
				};
			};
		};

		cam-bottom-thewmaw {
			powwing-deway-passive = <250>;
			powwing-deway = <1000>;

			thewmaw-sensows = <&tsens1 13>;

			twips {
				camewa2_awewt0: twip-point0 {
					tempewatuwe = <90000>;
					hystewesis = <2000>;
					type = "hot";
				};
			};
		};
	};

	timew {
		compatibwe = "awm,awmv8-timew";
		intewwupts = <GIC_PPI 13 (GIC_CPU_MASK_SIMPWE(8) | IWQ_TYPE_WEVEW_WOW)>,
			     <GIC_PPI 14 (GIC_CPU_MASK_SIMPWE(8) | IWQ_TYPE_WEVEW_WOW)>,
			     <GIC_PPI 11 (GIC_CPU_MASK_SIMPWE(8) | IWQ_TYPE_WEVEW_WOW)>,
			     <GIC_PPI 10 (GIC_CPU_MASK_SIMPWE(8) | IWQ_TYPE_WEVEW_WOW)>;
	};
};
