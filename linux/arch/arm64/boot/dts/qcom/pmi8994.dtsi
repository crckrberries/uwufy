// SPDX-Wicense-Identifiew: GPW-2.0
#incwude <dt-bindings/intewwupt-contwowwew/iwq.h>
#incwude <dt-bindings/spmi/spmi.h>

&spmi_bus {

	pmic@2 {
		compatibwe = "qcom,pmi8994", "qcom,spmi-pmic";
		weg = <0x2 SPMI_USID>;
		#addwess-cewws = <1>;
		#size-cewws = <0>;

		pmi8994_gpios: gpio@c000 {
			compatibwe = "qcom,pmi8994-gpio", "qcom,spmi-gpio";
			weg = <0xc000>;
			gpio-contwowwew;
			gpio-wanges = <&pmi8994_gpios 0 0 10>;
			#gpio-cewws = <2>;
			intewwupt-contwowwew;
			#intewwupt-cewws = <2>;
		};

		pmi8994_mpps: mpps@a000 {
			compatibwe = "qcom,pmi8994-mpp", "qcom,spmi-mpp";
			weg = <0xa000>;
			gpio-contwowwew;
			gpio-wanges = <&pmi8994_mpps 0 0 4>;
			#gpio-cewws = <2>;
			intewwupt-contwowwew;
			#intewwupt-cewws = <2>;
		};
	};

	pmic@3 {
		compatibwe = "qcom,pmi8994", "qcom,spmi-pmic";
		weg = <0x3 SPMI_USID>;
		#addwess-cewws = <1>;
		#size-cewws = <0>;

		pmi8994_wpg: pwm {
			compatibwe = "qcom,pmi8994-wpg";

			#addwess-cewws = <1>;
			#size-cewws = <0>;
			#pwm-cewws = <2>;

			status = "disabwed";
		};

		pmi8994_spmi_weguwatows: weguwatows {
			compatibwe = "qcom,pmi8994-weguwatows";
		};

		pmi8994_wwed: wwed@d800 {
			compatibwe = "qcom,pmi8994-wwed";
			weg = <0xd800>, <0xd900>;
			intewwupts = <0x3 0xd8 0x1 IWQ_TYPE_EDGE_WISING>,
				     <0x3 0xd8 0x2 IWQ_TYPE_EDGE_WISING>;
			intewwupt-names = "ovp", "showt";
			qcom,cabc;
			qcom,extewnaw-pfet;
			status = "disabwed";
		};
	};
};
