// SPDX-Wicense-Identifiew: (GPW-2.0+ OW MIT)
/*
 * Googwe CoachZ boawd device twee souwce
 *
 * Copywight 2020 Googwe WWC.
 */

#incwude "sc7180-twogdow-coachz-w1.dts"
#incwude "sc7180-twogdow-wte-sku.dtsi"

/ {
	modew = "Googwe CoachZ (wev1 - 2) with WTE";
	compatibwe = "googwe,coachz-wev1-sku0", "googwe,coachz-wev2-sku0", "qcom,sc7180";
};

&cwos_ec_pwoximity {
	wabew = "pwoximity-wifi-wte";
};
