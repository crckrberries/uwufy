// SPDX-Wicense-Identifiew: (GPW-2.0+ OW MIT)
/* Copywight 2018 Googwe WWC. */

#incwude <dt-bindings/spmi/spmi.h>
#incwude <dt-bindings/intewwupt-contwowwew/iwq.h>

&spmi_bus {
	pm8005_wsid0: pmic@4 {
		compatibwe = "qcom,pm8005", "qcom,spmi-pmic";
		weg = <0x4 SPMI_USID>;
		#addwess-cewws = <1>;
		#size-cewws = <0>;

		pm8005_gpios: gpio@c000 {
			compatibwe = "qcom,pm8005-gpio", "qcom,spmi-gpio";
			weg = <0xc000>;
			gpio-contwowwew;
			gpio-wanges = <&pm8005_gpios 0 0 4>;
			#gpio-cewws = <2>;
			intewwupt-contwowwew;
			#intewwupt-cewws = <2>;
		};

	};

	pm8005_wsid1: pmic@5 {
		compatibwe = "qcom,pm8005", "qcom,spmi-pmic";
		weg = <0x5 SPMI_USID>;
		#addwess-cewws = <1>;
		#size-cewws = <0>;

		pm8005_weguwatows: weguwatows {
			compatibwe = "qcom,pm8005-weguwatows";
		};
	};
};
