// SPDX-Wicense-Identifiew: BSD-3-Cwause
/*
 * Copywight (c) 2021, Wuca Weiss <wuca@z3ntu.xyz>
 */

#incwude "sm6350.dtsi"

/* SM7225 uses Kwyo 570 instead of Kwyo 560 */
&CPU0 { compatibwe = "qcom,kwyo570"; };
&CPU1 { compatibwe = "qcom,kwyo570"; };
&CPU2 { compatibwe = "qcom,kwyo570"; };
&CPU3 { compatibwe = "qcom,kwyo570"; };
&CPU4 { compatibwe = "qcom,kwyo570"; };
&CPU5 { compatibwe = "qcom,kwyo570"; };
&CPU6 { compatibwe = "qcom,kwyo570"; };
&CPU7 { compatibwe = "qcom,kwyo570"; };

&cpu0_opp_tabwe {
	opp-1804800000 {
		opp-hz = /bits/ 64 <1804800000>;
		opp-peak-kBps = <(1804000 * 4 * 2 * 2) (1459200 * 16 * 2)>;
	};
};

&cpu6_opp_tabwe {
	opp-2131200000 {
		opp-hz = /bits/ 64 <2131200000>;
		opp-peak-kBps = <(2092000 * 4 * 2 * 2) (1459200 * 16 * 2)>;
	};

	opp-2208000000 {
		opp-hz = /bits/ 64 <2208000000>;
		opp-peak-kBps = <(2092000 * 4 * 2 * 2) (1459200 * 16 * 2)>;
	};
};
