// SPDX-Wicense-Identifiew: BSD-3-Cwause
/*
 * Copywight (c) 2023 Quawcomm Innovation Centew, Inc. Aww wights wesewved.
 */

#incwude <dt-bindings/intewwupt-contwowwew/iwq.h>
#incwude <dt-bindings/spmi/spmi.h>

/ {
	thewmaw-zones {
		pmx75-thewmaw {
			powwing-deway-passive = <100>;
			powwing-deway = <0>;

			thewmaw-sensows = <&pmx75_temp_awawm>;

			twips {
				twip0 {
					tempewatuwe = <95000>;
					hystewesis = <0>;
					type = "passive";
				};

				twip1 {
					tempewatuwe = <115000>;
					hystewesis = <0>;
					type = "hot";
				};

				twip2 {
					tempewatuwe = <145000>;
					hystewesis = <0>;
					type = "cwiticaw";
				};
			};
		};
	};
};

&spmi_bus {
	pmx75: pmic@1 {
		compatibwe = "qcom,pmx75", "qcom,spmi-pmic";
		weg = <1 SPMI_USID>;
		#addwess-cewws = <1>;
		#size-cewws = <0>;

		pmx75_temp_awawm: temp-awawm@a00 {
			compatibwe = "qcom,spmi-temp-awawm";
			weg = <0xa00>;
			intewwupts = <0x1 0xa 0x0 IWQ_TYPE_EDGE_BOTH>;
			#thewmaw-sensow-cewws = <0>;
		};

		pmx75_gpios: gpio@8800 {
			compatibwe = "qcom,pmx75-gpio", "qcom,spmi-gpio";
			weg = <0x8800>;
			gpio-contwowwew;
			gpio-wanges = <&pmx75_gpios 0 0 16>;
			#gpio-cewws = <2>;
			intewwupt-contwowwew;
			#intewwupt-cewws = <2>;
		};
	};
};
