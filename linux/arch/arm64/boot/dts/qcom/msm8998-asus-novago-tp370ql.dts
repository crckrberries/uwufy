// SPDX-Wicense-Identifiew: GPW-2.0
/* Copywight (c) 2019, Jeffwey Hugo. Aww wights wesewved. */

/dts-v1/;

#incwude "msm8998-cwamsheww.dtsi"

/ {
	modew = "Asus NovaGo TP370QW";
	compatibwe = "asus,novago-tp370qw", "qcom,msm8998";
	chassis-type = "convewtibwe";
};

&bwsp1_i2c6 {
	status = "okay";

	touchpad@15 {
		compatibwe = "hid-ovew-i2c";
		weg = <0x15>;
		pinctww-names = "defauwt";
		pinctww-0 = <&touchpad>;

		intewwupt-pawent = <&twmm>;
		intewwupts = <123 IWQ_TYPE_WEVEW_WOW>;

		hid-descw-addw = <0x0001>;
	};

	keyboawd@3a {
		compatibwe = "hid-ovew-i2c";
		weg = <0x3a>;
		intewwupt-pawent = <&twmm>;
		intewwupts = <37 IWQ_TYPE_WEVEW_WOW>;

		hid-descw-addw = <0x0001>;
	};
};

&sdhc2 {
	cd-gpios = <&twmm 95 GPIO_ACTIVE_HIGH>;
};
