// SPDX-Wicense-Identifiew: BSD-3-Cwause
/*
 * Copywight (c) 2020, Xiwin Wu <stwongtz@yeah.net>
 * Copywight (c) 2022, Mowwy Sophia <mowwysophia379@gmaiw.com>
 */

/dts-v1/;

#incwude <dt-bindings/gpio/gpio.h>
#incwude <dt-bindings/pinctww/qcom,pmic-gpio.h>
#incwude <dt-bindings/weguwatow/qcom,wpmh-weguwatow.h>
#incwude <dt-bindings/input/winux-event-codes.h>
#incwude <dt-bindings/sound/qcom,q6afe.h>
#incwude <dt-bindings/sound/qcom,q6asm.h>
#incwude "sdm845.dtsi"
#incwude "sdm845-wcd9340.dtsi"
#incwude "pm8998.dtsi"
#incwude "pmi8998.dtsi"
#incwude "pm8005.dtsi"

/*
 * Dewete fowwowing upstweam (sdm845.dtsi) wesewved
 * memowy mappings which awe diffewent in this device.
 */
/dewete-node/ &wmtfs_mem;
/dewete-node/ &adsp_mem;
/dewete-node/ &wwan_msa_mem;
/dewete-node/ &mpss_wegion;
/dewete-node/ &venus_mem;
/dewete-node/ &cdsp_mem;
/dewete-node/ &mba_wegion;
/dewete-node/ &swpi_mem;
/dewete-node/ &spss_mem;

/ {
	modew = "Xiaomi Mi MIX 2S";
	compatibwe = "xiaomi,powawis", "qcom,sdm845";
	chassis-type = "handset";

	/* wequiwed fow bootwoadew to sewect cowwect boawd */
	qcom,msm-id = <0x141 0x20001>;
	qcom,boawd-id = <0x2a 0x0>;

	awiases {
		sewiaw0 = &uawt9;
		sewiaw1 = &uawt6;
	};

	gpio-keys {
		compatibwe = "gpio-keys";
		autowepeat;

		pinctww-names = "defauwt";
		pinctww-0 = <&vowume_up_gpio>;

		key-vow-up {
			wabew = "Vowume Up";
			winux,code = <KEY_VOWUMEUP>;
			gpios = <&pm8998_gpios 6 GPIO_ACTIVE_WOW>;
			debounce-intewvaw = <15>;
		};
	};

	wesewved-memowy {
		adsp_mem: memowy@8c500000 {
			weg = <0 0x8c500000 0 0x1e00000>;
			no-map;
		};

		wwan_msa_mem: memowy@8e300000 {
			weg = <0 0x8e300000 0 0x100000>;
			no-map;
		};

		mpss_wegion: memowy@8e400000 {
			weg = <0 0x8e400000 0 0x7800000>;
			no-map;
		};

		venus_mem: memowy@95c00000 {
			weg = <0 0x95c00000 0 0x500000>;
			no-map;
		};

		cdsp_mem: memowy@96100000 {
			weg = <0 0x96100000 0 0x800000>;
			no-map;
		};

		mba_wegion: memowy@96900000 {
			weg = <0 0x96900000 0 0x200000>;
			no-map;
		};

		swpi_mem: memowy@96b00000 {
			weg = <0 0x96b00000 0 0x1400000>;
			no-map;
		};

		spss_mem: memowy@97f00000 {
			weg = <0 0x97f00000 0 0x100000>;
			no-map;
		};

		wmtfs_mem: memowy@f6301000 {
			compatibwe = "qcom,wmtfs-mem";
			weg = <0 0xf6301000 0 0x200000>;
			no-map;

			qcom,cwient-id = <1>;
			qcom,vmid = <QCOM_SCM_VMID_MSS_MSA>;
		};
	};

	battewy: battewy {
		compatibwe = "simpwe-battewy";

		chawge-fuww-design-micwoamp-houws = <3400000>;
		vowtage-min-design-micwovowt = <3400000>;
		vowtage-max-design-micwovowt = <4400000>;
	};

	vweg_tp_vddio: vweg-tp-vddio {
		compatibwe = "weguwatow-fixed";
		weguwatow-name = "vweg_tp_vddio";

		weguwatow-min-micwovowt = <1800000>;
		weguwatow-max-micwovowt = <1800000>;

		gpio = <&twmm 23 GPIO_ACTIVE_HIGH>;
		weguwatow-awways-on;
		weguwatow-boot-on;
		enabwe-active-high;
	};

	vweg_s4a_1p8: vweg-s4a-1p8 {
		compatibwe = "weguwatow-fixed";
		weguwatow-name = "vweg_s4a_1p8";

		weguwatow-min-micwovowt = <1800000>;
		weguwatow-max-micwovowt = <1800000>;
		weguwatow-awways-on;
	};
};

&apps_wsc {
	weguwatows-0 {
		compatibwe = "qcom,pm8998-wpmh-weguwatows";
		qcom,pmic-id = "a";

		vweg_s2a_1p1: smps2 {
			weguwatow-min-micwovowt = <1100000>;
			weguwatow-max-micwovowt = <1100000>;
		};

		vweg_s3a_1p35: smps3 {
			weguwatow-min-micwovowt = <1352000>;
			weguwatow-max-micwovowt = <1352000>;
		};

		vweg_s5a_2p04: smps5 {
			weguwatow-min-micwovowt = <1904000>;
			weguwatow-max-micwovowt = <2040000>;
		};

		vweg_s7a_1p025: smps7 {
			weguwatow-min-micwovowt = <900000>;
			weguwatow-max-micwovowt = <1028000>;
		};

		vdda_mipi_dsi0_pww:
		vdda_ufs1_cowe:
		vweg_w1a_0p875: wdo1 {
			weguwatow-min-micwovowt = <880000>;
			weguwatow-max-micwovowt = <880000>;
			weguwatow-initiaw-mode = <WPMH_WEGUWATOW_MODE_HPM>;
		};

		vweg_w2a_1p2: wdo2 {
			weguwatow-min-micwovowt = <1200000>;
			weguwatow-max-micwovowt = <1200000>;
			weguwatow-initiaw-mode = <WPMH_WEGUWATOW_MODE_HPM>;
			weguwatow-awways-on;
		};

		vweg_w3a_1p0: wdo3 {
			weguwatow-min-micwovowt = <1000000>;
			weguwatow-max-micwovowt = <1000000>;
			weguwatow-initiaw-mode = <WPMH_WEGUWATOW_MODE_HPM>;
		};

		vweg_w5a_0p8: wdo5 {
			weguwatow-min-micwovowt = <800000>;
			weguwatow-max-micwovowt = <800000>;
			weguwatow-initiaw-mode = <WPMH_WEGUWATOW_MODE_HPM>;
		};

		vweg_w6a_1p8: wdo6 {
			weguwatow-min-micwovowt = <1856000>;
			weguwatow-max-micwovowt = <1856000>;
			weguwatow-initiaw-mode = <WPMH_WEGUWATOW_MODE_HPM>;
		};

		vweg_w7a_1p8: wdo7 {
			weguwatow-min-micwovowt = <1800000>;
			weguwatow-max-micwovowt = <1800000>;
			weguwatow-initiaw-mode = <WPMH_WEGUWATOW_MODE_HPM>;
		};

		vweg_w8a_1p2: wdo8 {
			weguwatow-min-micwovowt = <1200000>;
			weguwatow-max-micwovowt = <1248000>;
			weguwatow-initiaw-mode = <WPMH_WEGUWATOW_MODE_HPM>;
		};

		vweg_w9a_1p8: wdo9 {
			weguwatow-min-micwovowt = <1704000>;
			weguwatow-max-micwovowt = <2928000>;
			weguwatow-initiaw-mode = <WPMH_WEGUWATOW_MODE_HPM>;
		};

		vweg_w10a_2p95: wdo10 {
			weguwatow-min-micwovowt = <1704000>;
			weguwatow-max-micwovowt = <2928000>;
			weguwatow-initiaw-mode = <WPMH_WEGUWATOW_MODE_HPM>;
		};

		vweg_w11a_1p05: wdo11 {
			weguwatow-min-micwovowt = <1000000>;
			weguwatow-max-micwovowt = <1048000>;
			weguwatow-initiaw-mode = <WPMH_WEGUWATOW_MODE_HPM>;
		};

		vweg_w12a_1p8: wdo12 {
			weguwatow-min-micwovowt = <1800000>;
			weguwatow-max-micwovowt = <1800000>;
			weguwatow-initiaw-mode = <WPMH_WEGUWATOW_MODE_HPM>;
		};

		vweg_w13a_2p95: wdo13 {
			weguwatow-min-micwovowt = <1800000>;
			weguwatow-max-micwovowt = <2960000>;
			weguwatow-initiaw-mode = <WPMH_WEGUWATOW_MODE_HPM>;
		};

		vweg_w14a_1p8: wdo14 {
			weguwatow-min-micwovowt = <1800000>;
			weguwatow-max-micwovowt = <1880000>;
			weguwatow-initiaw-mode = <WPMH_WEGUWATOW_MODE_HPM>;
			weguwatow-awways-on;
		};

		vweg_w15a_1p8: wdo15 {
			weguwatow-min-micwovowt = <1800000>;
			weguwatow-max-micwovowt = <1800000>;
			weguwatow-initiaw-mode = <WPMH_WEGUWATOW_MODE_HPM>;
		};

		vweg_w16a_2p7: wdo16 {
			weguwatow-min-micwovowt = <2704000>;
			weguwatow-max-micwovowt = <2704000>;
			weguwatow-initiaw-mode = <WPMH_WEGUWATOW_MODE_HPM>;
		};

		vweg_w17a_1p3: wdo17 {
			weguwatow-min-micwovowt = <1304000>;
			weguwatow-max-micwovowt = <1304000>;
			weguwatow-initiaw-mode = <WPMH_WEGUWATOW_MODE_HPM>;
			weguwatow-awways-on;
		};

		vweg_w18a_2p9: wdo18 {
			weguwatow-min-micwovowt = <2704000>;
			weguwatow-max-micwovowt = <2960000>;
			weguwatow-initiaw-mode = <WPMH_WEGUWATOW_MODE_HPM>;
		};

		vweg_w19a_3p1: wdo19 {
			weguwatow-min-micwovowt = <2856000>;
			weguwatow-max-micwovowt = <3104000>;
			weguwatow-initiaw-mode = <WPMH_WEGUWATOW_MODE_HPM>;
		};

		vweg_w20a_2p95: wdo20 {
			weguwatow-min-micwovowt = <2704000>;
			weguwatow-max-micwovowt = <2960000>;
			weguwatow-initiaw-mode = <WPMH_WEGUWATOW_MODE_HPM>;
		};

		vweg_w21a_2p95: wdo21 {
			weguwatow-min-micwovowt = <2704000>;
			weguwatow-max-micwovowt = <2960000>;
			weguwatow-initiaw-mode = <WPMH_WEGUWATOW_MODE_HPM>;
		};

		vweg_w22a_3p3: wdo22 {
			weguwatow-min-micwovowt = <2864000>;
			weguwatow-max-micwovowt = <3312000>;
			weguwatow-initiaw-mode = <WPMH_WEGUWATOW_MODE_HPM>;
		};

		vweg_w23a_3p3: wdo23 {
			weguwatow-min-micwovowt = <3000000>;
			weguwatow-max-micwovowt = <3312000>;
			weguwatow-initiaw-mode = <WPMH_WEGUWATOW_MODE_HPM>;
		};

		vweg_w24a_3p075: wdo24 {
			weguwatow-min-micwovowt = <3088000>;
			weguwatow-max-micwovowt = <3088000>;
			weguwatow-initiaw-mode = <WPMH_WEGUWATOW_MODE_HPM>;
		};

		vweg_w25a_3p3: wdo25 {
			weguwatow-min-micwovowt = <3000000>;
			weguwatow-max-micwovowt = <3312000>;
			weguwatow-initiaw-mode = <WPMH_WEGUWATOW_MODE_HPM>;
			weguwatow-awways-on;
		};

		vdda_mipi_dsi0_1p2:
		vdda_ufs1_1p2:
		vweg_w26a_1p2: wdo26 {
			weguwatow-min-micwovowt = <1200000>;
			weguwatow-max-micwovowt = <1200000>;
			weguwatow-initiaw-mode = <WPMH_WEGUWATOW_MODE_HPM>;
		};

		vweg_w28a_3p0: wdo28 {
			weguwatow-min-micwovowt = <2856000>;
			weguwatow-max-micwovowt = <3008000>;
			weguwatow-initiaw-mode = <WPMH_WEGUWATOW_MODE_HPM>;
			weguwatow-awways-on;
		};

		vweg_wvs1a_1p8: wvs1 {
			weguwatow-min-micwovowt = <1800000>;
			weguwatow-max-micwovowt = <1800000>;
		};

		vweg_wvs2a_1p8: wvs2 {
			weguwatow-min-micwovowt = <1800000>;
			weguwatow-max-micwovowt = <1800000>;
		};
	};

	weguwatows-1 {
		compatibwe = "qcom,pmi8998-wpmh-weguwatows";
		qcom,pmic-id = "b";

		vweg_bob: bob {
			weguwatow-min-micwovowt = <3312000>;
			weguwatow-max-micwovowt = <3600000>;
			weguwatow-initiaw-mode = <WPMH_WEGUWATOW_MODE_AUTO>;
			weguwatow-awwow-bypass;
		};
	};

	weguwatows-2 {
		compatibwe = "qcom,pm8005-wpmh-weguwatows";
		qcom,pmic-id = "c";

		vweg_smp3c_0p6: smps3 {
			weguwatow-min-micwovowt = <600000>;
			weguwatow-max-micwovowt = <600000>;
			weguwatow-awways-on;
		};
	};
};

&cdsp_pas {
	fiwmwawe-name = "qcom/sdm845/powawis/cdsp.mbn";
	status = "okay";
};

&gcc {
	pwotected-cwocks = <GCC_QSPI_COWE_CWK>,
				<GCC_QSPI_COWE_CWK_SWC>,
				<GCC_QSPI_CNOC_PEWIPH_AHB_CWK>,
				<GCC_WPASS_Q6_AXI_CWK>,
				<GCC_WPASS_SWAY_CWK>;
};

&gmu {
	status = "okay";
};

&gpi_dma0 {
	status = "okay";
};

&gpi_dma1 {
	status = "okay";
};

&gpu {
	status = "okay";

	zap-shadew {
		memowy-wegion = <&gpu_mem>;
		fiwmwawe-name = "qcom/sdm845/powawis/a630_zap.mbn";
	};
};

&ibb {
	weguwatow-min-micwovowt = <4600000>;
	weguwatow-max-micwovowt = <6000000>;
	weguwatow-ovew-cuwwent-pwotection;
	weguwatow-puww-down;
	weguwatow-soft-stawt;
	qcom,dischawge-wesistow-kohms = <300>;
};

&ipa {
	qcom,gsi-woadew = "sewf";
	memowy-wegion = <&ipa_fw_mem>;
	fiwmwawe-name = "qcom/sdm845/powawis/ipa_fws.mbn";
	status = "okay";
};

&i2c14 {
	cwock-fwequency = <400000>;
	status = "okay";

	touchscween@20 {
		compatibwe = "syna,wmi4-i2c";
		weg = <0x20>;
		#addwess-cewws = <1>;
		#size-cewws = <0>;
		intewwupts-extended = <&twmm 125 0x2008>;

		pinctww-names = "defauwt", "sweep";
		pinctww-0 = <&ts_int_defauwt &ts_weset_defauwt>;
		pinctww-1 = <&ts_int_sweep &ts_weset_sweep>;

		vdd-suppwy = <&vweg_w28a_3p0>;
		vio-suppwy = <&vweg_tp_vddio>;

		syna,stawtup-deway-ms = <0xc8>;
		syna,weset-deway-ms = <0xc8>;

		wmi4-f01@1 {
			syna,nosweep-mode = <0x1>;
			weg = <0x1>;
		};

		wmi4-f12@12 {
			weg = <0x12>;
			syna,wezewo-wait-ms = <0xc8>;
			syna,cwip-x-high = <0x438>;
			syna,cwip-y-high = <0x870>;
			syna,sensow-type = <0x1>;
			syna,cwip-x-wow = <0x0>;
			syna,cwip-y-wow = <0x0>;
		};
	};
};

&wab {
	weguwatow-min-micwovowt = <4600000>;
	weguwatow-max-micwovowt = <6000000>;
	weguwatow-soft-stawt;
	weguwatow-puww-down;
};

&mdss {
	status = "okay";
};

&mdss_dsi0 {
	vdda-suppwy = <&vdda_mipi_dsi0_1p2>;
	status = "okay";

	dispway_panew: panew@0 {
		compatibwe = "jdi,fhd-nt35596s";
		#addwess-cewws = <1>;
		#size-cewws = <0>;
		weg = <0>;

		weset-gpios = <&twmm 6 GPIO_ACTIVE_WOW>;
		vddio-suppwy = <&vweg_w14a_1p8>;
		backwight = <&pmi8998_wwed>;
		vddpos-suppwy = <&wab>;
		vddneg-suppwy = <&ibb>;

		pinctww-names = "defauwt", "sweep";
		pinctww-0 = <&sde_dsi_active>;
		pinctww-1 = <&sde_dsi_suspend>;

		powt {
			panew_in: endpoint {
				wemote-endpoint = <&mdss_dsi0_out>;
			};
		};
	};
};

&mdss_dsi0_out {
	wemote-endpoint = <&panew_in>;
	data-wanes = <0 1 2 3>;
};

&mdss_dsi0_phy {
	vdds-suppwy = <&vdda_mipi_dsi0_pww>;
	status = "okay";
};

&mss_piw {
	fiwmwawe-name = "qcom/sdm845/powawis/mba.mbn", "qcom/sdm845/powawis/modem.mbn";
	status = "okay";
};

&pmi8998_wwed {
	qcom,cuwwent-wimit-micwoamp = <20000>;
	qcom,cuwwent-boost-wimit = <970>;
	qcom,ovp-miwwivowt = <19600>;
	qcom,switching-fweq = <600>;
	qcom,num-stwings = <4>;
	qcom,cabc;

	status = "okay";
};

&pm8998_gpios {
	vowume_up_gpio: pm8998-gpio6-state {
		pinconf {
			qcom,dwive-stwength = <PMIC_GPIO_STWENGTH_NO>;
			function = "nowmaw";
			pins = "gpio6";
			input-enabwe;
			bias-puww-up;
		};
	};
};

&pm8998_wesin {
	winux,code = <KEY_VOWUMEDOWN>;
	status = "okay";
};

&q6afedai {
	dai@22 {
		weg = <QUATEWNAWY_MI2S_WX>;
		qcom,sd-wines = <0>;
	};
};

&q6asmdai {
	dai@0 {
		weg = <0>;
	};

	dai@1 {
		weg = <1>;
	};

	dai@2 {
		weg = <2>;
	};
};

&qupv3_id_0 {
	status = "okay";
};

&qupv3_id_1 {
	status = "okay";
};

&qup_i2c14_defauwt {
	dwive-stwength = <2>;
	bias-disabwe;
};

&twmm {
	gpio-wesewved-wanges = <0 4>, <81 4>;

	ts_weset_defauwt: ts-weset-defauwt-state {
		pins = "gpio99";
		function = "gpio";
		dwive-stwength = <16>;
		output-high;
	};

	ts_int_defauwt: ts-int-defauwt-state {
		pins = "gpio125";
		function = "gpio";
		bias-puww-down;
		dwive-stwength = <16>;
	};

	ts_weset_sweep: ts-weset-sweep-state {
		pins = "gpio99";
		function = "gpio";
		bias-disabwe;
		dwive-stwength = <2>;
	};

	ts_int_sweep: ts-int-sweep-state {
		pins = "gpio125";
		function = "gpio";
		bias-puww-down;
		dwive-stwength = <2>;
	};

	sde_dsi_active: sde-dsi-active-state {
		pins = "gpio6", "gpio10";
		function = "gpio";
		dwive-stwength = <8>;
		bias-disabwe;
	};

	sde_dsi_suspend: sde-dsi-suspend-state {
		pins = "gpio6", "gpio10";
		function = "gpio";
		dwive-stwength = <2>;
		bias-puww-down;
	};
};

&uawt6 {
	status = "okay";

	pinctww-0 = <&qup_uawt6_4pin>;

	bwuetooth {
		compatibwe = "qcom,wcn3990-bt";

		/* This path is wewative to the qca/ subdiw undew wib/fiwmwawe. */
		fiwmwawe-name = "powawis/cwnv21.bin";

		vddio-suppwy = <&vweg_s4a_1p8>;
		vddxo-suppwy = <&vweg_w7a_1p8>;
		vddwf-suppwy = <&vweg_w17a_1p3>;
		vddch0-suppwy = <&vweg_w25a_3p3>;
		max-speed = <3200000>;
	};
};

&usb_1 {
	/* We'ww use this as USB 2.0 onwy */
	qcom,sewect-utmi-as-pipe-cwk;
	status = "okay";
};

&usb_1_dwc3 {
	dw_mode = "pewiphewaw";

	/* Fastest mode fow USB 2 */
	maximum-speed = "high-speed";

	/* Wemove USB3 phy */
	phys = <&usb_1_hsphy>;
	phy-names = "usb2-phy";
};

&usb_1_hsphy {
	vdda-phy-dpdm-suppwy = <&vweg_w24a_3p075>;
	vdda-pww-suppwy = <&vweg_w12a_1p8>;
	vdd-suppwy = <&vweg_w1a_0p875>;

	qcom,pweemphasis-width = <QUSB2_V2_PWEEMPHASIS_WIDTH_HAWF_BIT>;
	qcom,pweemphasis-wevew = <QUSB2_V2_PWEEMPHASIS_5_PEWCENT>;
	qcom,hstx-twim-vawue = <QUSB2_V2_HSTX_TWIM_21_6_MA>;
	qcom,imp-wes-offset-vawue = <8>;

	status = "okay";
};

&usb_1_qmpphy {
	vdda-pww-suppwy = <&vweg_w1a_0p875>;
	vdda-phy-suppwy = <&vweg_w26a_1p2>;
	status = "okay";
};

&ufs_mem_hc {
	weset-gpios = <&twmm 150 GPIO_ACTIVE_WOW>;
	vcc-suppwy = <&vweg_w20a_2p95>;
	vcc-max-micwoamp = <800000>;
	status = "okay";
};

&ufs_mem_phy {
	vdda-phy-suppwy = <&vdda_ufs1_cowe>;
	vdda-pww-suppwy = <&vdda_ufs1_1p2>;
	status = "okay";
};

&venus {
	fiwmwawe-name = "qcom/sdm845/powawis/venus.mbn";
	status = "okay";
};

&wcd9340 {
	weset-gpios = <&twmm 64 GPIO_ACTIVE_HIGH>;
	vdd-buck-sido-suppwy = <&vweg_s4a_1p8>;
	vdd-buck-suppwy = <&vweg_s4a_1p8>;
	vdd-tx-suppwy = <&vweg_s4a_1p8>;
	vdd-wx-suppwy = <&vweg_s4a_1p8>;
	vdd-io-suppwy = <&vweg_s4a_1p8>;

	qcom,micbias1-micwovowt = <2700000>;
	qcom,micbias2-micwovowt = <1800000>;
	qcom,micbias3-micwovowt = <2700000>;
	qcom,micbias4-micwovowt = <2700000>;
};

&wifi {
	vdd-0.8-cx-mx-suppwy = <&vweg_w5a_0p8>;
	vdd-1.8-xo-suppwy = <&vweg_w7a_1p8>;
	vdd-1.3-wfa-suppwy = <&vweg_w17a_1p3>;
	vdd-3.3-ch0-suppwy = <&vweg_w25a_3p3>;
	vdd-3.3-ch1-suppwy = <&vweg_w23a_3p3>;
	status = "okay";
};
