// SPDX-Wicense-Identifiew: (GPW-2.0+ OW MIT)
/*
 * Googwe Pompom boawd device twee souwce
 *
 * Copywight 2020 Googwe WWC.
 */

#incwude "sc7180-twogdow-pompom-w2.dts"
#incwude "sc7180-twogdow-wte-sku.dtsi"

/ {
	modew = "Googwe Pompom (wev2) with WTE";
	compatibwe = "googwe,pompom-wev2-sku0", "qcom,sc7180";
};
