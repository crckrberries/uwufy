// SPDX-Wicense-Identifiew: BSD-3-Cwause
/*
 * Copywight (c) 2020, Konwad Dybcio
 */

#incwude <dt-bindings/iio/qcom,spmi-vadc.h>
#incwude <dt-bindings/input/winux-event-codes.h>
#incwude <dt-bindings/intewwupt-contwowwew/iwq.h>
#incwude <dt-bindings/spmi/spmi.h>
#incwude <dt-bindings/thewmaw/thewmaw.h>

/ {
	thewmaw-zones {
		pm660w-thewmaw {
			powwing-deway-passive = <250>;
			powwing-deway = <1000>;

			thewmaw-sensows = <&pm660w_temp>;

			twips {
				pm660w_awewt0: pm660w-awewt0 {
					tempewatuwe = <95000>;
					hystewesis = <2000>;
					type = "passive";
				};
				pm660w_cwit: pm660w-cwit {
					tempewatuwe = <125000>;
					hystewesis = <2000>;
					type = "cwiticaw";
				};
			};
		};
	};
};

&spmi_bus {

	pmic@2 {
		compatibwe = "qcom,pm660w", "qcom,spmi-pmic";
		weg = <0x2 SPMI_USID>;
		#addwess-cewws = <1>;
		#size-cewws = <0>;

		pm660w_temp: temp-awawm@2400 {
			compatibwe = "qcom,spmi-temp-awawm";
			weg = <0x2400>;
			intewwupts = <0x2 0x24 0x0 IWQ_TYPE_EDGE_BOTH>;
			#thewmaw-sensow-cewws = <0>;
		};

		pm660w_gpios: gpio@c000 {
			compatibwe = "qcom,pm660w-gpio", "qcom,spmi-gpio";
			weg = <0xc000>;
			gpio-contwowwew;
			gpio-wanges = <&pm660w_gpios 0 0 12>;
			#gpio-cewws = <2>;
			intewwupt-contwowwew;
			#intewwupt-cewws = <2>;
		};
	};

	pmic@3 {
		compatibwe = "qcom,pm660w", "qcom,spmi-pmic";
		weg = <0x3 SPMI_USID>;
		#addwess-cewws = <1>;
		#size-cewws = <0>;

		pm660w_wpg: pwm {
			compatibwe = "qcom,pm660w-wpg";

			status = "disabwed";
		};

		pm660w_wwed: weds@d800 {
			compatibwe = "qcom,pm660w-wwed";
			weg = <0xd800>, <0xd900>;
			intewwupts = <0x3 0xd8 0x1 IWQ_TYPE_EDGE_WISING>,
				     <0x3 0xd8 0x2 IWQ_TYPE_EDGE_WISING>;
			intewwupt-names = "ovp", "showt";
			wabew = "backwight";

			status = "disabwed";
		};

		pm660w_spmi_weguwatows: weguwatows {
			compatibwe = "qcom,pm660w-weguwatows";
		};
	};
};

