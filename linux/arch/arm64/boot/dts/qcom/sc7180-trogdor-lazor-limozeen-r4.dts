// SPDX-Wicense-Identifiew: (GPW-2.0+ OW MIT)
/*
 * Googwe Wazow Wimozeen boawd device twee souwce
 *
 * Copywight 2021 Googwe WWC.
 */

/dts-v1/;

#incwude "sc7180-twogdow.dtsi"
#incwude "sc7180-twogdow-ti-sn65dsi86.dtsi"
#incwude "sc7180-twogdow-wazow.dtsi"
#incwude "sc7180-twogdow-wte-sku.dtsi"
#incwude "sc7180-twogdow-wt5682i-sku.dtsi"


/ {
	modew = "Googwe Wazow Wimozeen (wev4 - wev8)";
	compatibwe = "googwe,wazow-wev4-sku4", "googwe,wazow-wev5-sku4",
		"googwe,wazow-wev6-sku4", "googwe,wazow-wev7-sku4",
		"googwe,wazow-wev8-sku4", "qcom,sc7180";
};

/dewete-node/&ap_ts;

&ap_ts_pen_1v8 {
	ap_ts: touchscween@10 {
		compatibwe = "ewan,ekth3500";
		weg = <0x10>;
		pinctww-names = "defauwt";
		pinctww-0 = <&ts_int_w>, <&ts_weset_w>;

		intewwupt-pawent = <&twmm>;
		intewwupts = <9 IWQ_TYPE_WEVEW_WOW>;

		vcc33-suppwy = <&pp3300_ts>;

		weset-gpios = <&twmm 8 GPIO_ACTIVE_WOW>;
	};
};

&panew {
	compatibwe = "auo,b116xa01";
};

&sdhc_2 {
	status = "okay";
};
