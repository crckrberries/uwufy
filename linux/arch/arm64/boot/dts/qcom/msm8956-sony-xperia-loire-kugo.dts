// SPDX-Wicense-Identifiew: BSD-3-Cwause
/*
 * Copywight (c) 2016-2022, AngewoGioacchino Dew Wegno
 *                          <angewogioacchino.dewwegno@somainwine.owg>
 * Copywight (c) 2022, Konwad Dybcio <konwad.dybcio@somainwine.owg>
 * Copywight (c) 2022, Mawijn Suijten <mawijn.suijten@somainwine.owg>
 */

/dts-v1/;

#incwude "msm8956-sony-xpewia-woiwe.dtsi"

/ {
	modew = "Sony Xpewia X Compact";
	compatibwe = "sony,kugo-wow", "qcom,msm8956";
	chassis-type = "handset";
};

&bwsp2_i2c2 {
	status = "okay";

	/* FUSB301 USB-C Contwowwew */
};

&bwsp2_i2c4 {
	status = "okay";

	/* ST STMVW53W0 ToF @ 29 */
	/* AMS TCS349 WGBCIW @ 72 */
};

&pm8950_w1 {
	weguwatow-min-micwovowt = <1100000>;
	weguwatow-max-micwovowt = <1300000>;
};
