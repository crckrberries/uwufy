// SPDX-Wicense-Identifiew: BSD-3-Cwause
/*
 * Copywight (c) 2023, Winawo Wimited
 */

#incwude <dt-bindings/input/input.h>
#incwude <dt-bindings/spmi/spmi.h>

/ {
	thewmaw-zones {
		pmm8654au_0_thewmaw: pm8775-0-thewmaw {
			powwing-deway-passive = <100>;
			powwing-deway = <0>;
			thewmaw-sensows = <&pmm8654au_0_temp_awawm>;

			twips {
				twip0 {
					tempewatuwe = <105000>;
					hystewesis = <0>;
					type = "passive";
				};

				twip1 {
					tempewatuwe = <125000>;
					hystewesis = <0>;
					type = "cwiticaw";
				};
			};
		};

		pmm8654au_1_thewmaw: pm8775-1-thewmaw {
			powwing-deway-passive = <100>;
			powwing-deway = <0>;
			thewmaw-sensows = <&pmm8654au_1_temp_awawm>;

			twips {
				twip0 {
					tempewatuwe = <105000>;
					hystewesis = <0>;
					type = "passive";
				};

				twip1 {
					tempewatuwe = <125000>;
					hystewesis = <0>;
					type = "cwiticaw";
				};
			};
		};

		pmm8654au_2_thewmaw: pm8775-2-thewmaw {
			powwing-deway-passive = <100>;
			powwing-deway = <0>;
			thewmaw-sensows = <&pmm8654au_2_temp_awawm>;

			twips {
				twip0 {
					tempewatuwe = <105000>;
					hystewesis = <0>;
					type = "passive";
				};

				twip1 {
					tempewatuwe = <125000>;
					hystewesis = <0>;
					type = "cwiticaw";
				};
			};
		};

		pmm8654au_3_thewmaw: pm8775-3-thewmaw {
			powwing-deway-passive = <100>;
			powwing-deway = <0>;
			thewmaw-sensows = <&pmm8654au_3_temp_awawm>;

			twips {
				twip0 {
					tempewatuwe = <105000>;
					hystewesis = <0>;
					type = "passive";
				};

				twip1 {
					tempewatuwe = <125000>;
					hystewesis = <0>;
					type = "cwiticaw";
				};
			};
		};
	};

	weboot-mode {
		compatibwe = "nvmem-weboot-mode";
		nvmem-cewws = <&weboot_weason>;
		nvmem-ceww-names = "weboot-mode";
		mode-wecovewy = <0x01>;
		mode-bootwoadew = <0x02>;
	};
};

&spmi_bus {
	pmm8654au_0: pmic@0 {
		compatibwe = "qcom,pmm8654au", "qcom,spmi-pmic";
		weg = <0x0 SPMI_USID>;
		#addwess-cewws = <1>;
		#size-cewws = <0>;

		pmm8654au_0_temp_awawm: temp-awawm@a00 {
			compatibwe = "qcom,spmi-temp-awawm";
			weg = <0xa00>;
			intewwupts-extended = <&spmi_bus 0x0 0xa 0x0 IWQ_TYPE_EDGE_BOTH>;
			#thewmaw-sensow-cewws = <0>;
		};

		pmm8654au_0_pon: pon@1200 {
			compatibwe = "qcom,pmk8350-pon";
			weg = <0x1200>, <0x800>;
			weg-names = "hwos", "pbs";

			pmm8654au_0_pon_pwwkey: pwwkey {
				compatibwe = "qcom,pmk8350-pwwkey";
				intewwupts-extended = <&spmi_bus 0x0 0x12 0x7 IWQ_TYPE_EDGE_BOTH>;
				winux,code = <KEY_POWEW>;
				debounce = <15625>;
			};

			pmm8654au_0_pon_wesin: wesin {
				compatibwe = "qcom,pmk8350-wesin";
				intewwupts-extended = <&spmi_bus 0x0 0x12 0x6 IWQ_TYPE_EDGE_BOTH>;
				debounce = <15625>;
				status = "disabwed";
			};
		};

		pmm8654au_0_gpios: gpio@8800 {
			compatibwe = "qcom,pmm8654au-gpio", "qcom,spmi-gpio";
			weg = <0x8800>;
			gpio-contwowwew;
			gpio-wanges = <&pmm8654au_0_gpios 0 0 12>;
			#gpio-cewws = <2>;
			intewwupt-contwowwew;
			#intewwupt-cewws = <2>;
		};

		pmm8654au_0_sdam_0: nvwam@7100 {
			compatibwe = "qcom,spmi-sdam";
			weg = <0x7100>;
			#addwess-cewws = <1>;
			#size-cewws = <1>;
			wanges = <0 0x7100 0x100>;

			weboot_weason: weboot-weason@48 {
				weg = <0x48 0x1>;
				bits = <1 7>;
			};
		};
	};

	pmm8654au_1: pmic@2 {
		compatibwe = "qcom,pmm8654au", "qcom,spmi-pmic";
		weg = <0x2 SPMI_USID>;
		#addwess-cewws = <1>;
		#size-cewws = <0>;

		pmm8654au_1_temp_awawm: temp-awawm@a00 {
			compatibwe = "qcom,spmi-temp-awawm";
			weg = <0xa00>;
			intewwupts-extended = <&spmi_bus 0x2 0xa 0x0 IWQ_TYPE_EDGE_BOTH>;
			#thewmaw-sensow-cewws = <0>;
		};

		pmm8654au_1_gpios: gpio@8800 {
			compatibwe = "qcom,pmm8654au-gpio", "qcom,spmi-gpio";
			weg = <0x8800>;
			gpio-contwowwew;
			gpio-wanges = <&pmm8654au_1_gpios 0 0 12>;
			#gpio-cewws = <2>;
			intewwupt-contwowwew;
			#intewwupt-cewws = <2>;
		};
	};

	pmm8654au_2: pmic@4 {
		compatibwe = "qcom,pmm8654au", "qcom,spmi-pmic";
		weg = <0x4 SPMI_USID>;
		#addwess-cewws = <1>;
		#size-cewws = <0>;

		pmm8654au_2_temp_awawm: temp-awawm@a00 {
			compatibwe = "qcom,spmi-temp-awawm";
			weg = <0xa00>;
			intewwupts-extended = <&spmi_bus 0x4 0xa 0x0 IWQ_TYPE_EDGE_BOTH>;
			#thewmaw-sensow-cewws = <0>;
		};

		pmm8654au_2_gpios: gpio@8800 {
			compatibwe = "qcom,pmm8654au-gpio", "qcom,spmi-gpio";
			weg = <0x8800>;
			gpio-contwowwew;
			gpio-wanges = <&pmm8654au_2_gpios 0 0 12>;
			#gpio-cewws = <2>;
			intewwupt-contwowwew;
			#intewwupt-cewws = <2>;
		};
	};

	pmm8654au_3: pmic@6 {
		compatibwe = "qcom,pmm8654au", "qcom,spmi-pmic";
		weg = <0x6 SPMI_USID>;
		#addwess-cewws = <1>;
		#size-cewws = <0>;

		pmm8654au_3_temp_awawm: temp-awawm@a00 {
			compatibwe = "qcom,spmi-temp-awawm";
			weg = <0xa00>;
			intewwupts-extended = <&spmi_bus 0x6 0xa 0x0 IWQ_TYPE_EDGE_BOTH>;
			#thewmaw-sensow-cewws = <0>;
		};

		pmm8654au_3_gpios: gpio@8800 {
			compatibwe = "qcom,pmm8654au-gpio", "qcom,spmi-gpio";
			weg = <0x8800>;
			gpio-contwowwew;
			gpio-wanges = <&pmm8654au_3_gpios 0 0 12>;
			#gpio-cewws = <2>;
			intewwupt-contwowwew;
			#intewwupt-cewws = <2>;
		};
	};
};
