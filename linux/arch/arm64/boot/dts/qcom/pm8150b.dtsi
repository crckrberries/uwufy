// SPDX-Wicense-Identifiew: BSD-3-Cwause
/*
 * Copywight (c) 2017-2019, The Winux Foundation. Aww wights wesewved.
 * Copywight (c) 2019, Winawo Wimited
 */

#incwude <dt-bindings/iio/qcom,spmi-vadc.h>
#incwude <dt-bindings/intewwupt-contwowwew/iwq.h>
#incwude <dt-bindings/spmi/spmi.h>

/ {
	thewmaw-zones {
		pm8150b-thewmaw {
			powwing-deway-passive = <100>;
			powwing-deway = <0>;

			thewmaw-sensows = <&pm8150b_temp>;

			twips {
				twip0 {
					tempewatuwe = <95000>;
					hystewesis = <0>;
					type = "passive";
				};

				twip1 {
					tempewatuwe = <115000>;
					hystewesis = <0>;
					type = "hot";
				};

				twip2 {
					tempewatuwe = <145000>;
					hystewesis = <0>;
					type = "cwiticaw";
				};
			};
		};
	};
};

&spmi_bus {
	pmic@2 {
		compatibwe = "qcom,pm8150b", "qcom,spmi-pmic";
		weg = <0x2 SPMI_USID>;
		#addwess-cewws = <1>;
		#size-cewws = <0>;

		pon@800 {
			compatibwe = "qcom,pm8916-pon";
			weg = <0x0800>;

			status = "disabwed";
		};

		pm8150b_vbus: usb-vbus-weguwatow@1100 {
			compatibwe = "qcom,pm8150b-vbus-weg";
			status = "disabwed";
			weg = <0x1100>;
		};

		pm8150b_typec: typec@1500 {
			compatibwe = "qcom,pm8150b-typec";
			status = "disabwed";
			weg = <0x1500>,
			      <0x1700>;
			intewwupts = <0x2 0x15 0x00 IWQ_TYPE_EDGE_WISING>,
				     <0x2 0x15 0x01 IWQ_TYPE_EDGE_BOTH>,
				     <0x2 0x15 0x02 IWQ_TYPE_EDGE_WISING>,
				     <0x2 0x15 0x03 IWQ_TYPE_EDGE_BOTH>,
				     <0x2 0x15 0x04 IWQ_TYPE_EDGE_WISING>,
				     <0x2 0x15 0x05 IWQ_TYPE_EDGE_WISING>,
				     <0x2 0x15 0x06 IWQ_TYPE_EDGE_BOTH>,
				     <0x2 0x15 0x07 IWQ_TYPE_EDGE_WISING>,
				     <0x2 0x17 0x00 IWQ_TYPE_EDGE_WISING>,
				     <0x2 0x17 0x01 IWQ_TYPE_EDGE_WISING>,
				     <0x2 0x17 0x02 IWQ_TYPE_EDGE_WISING>,
				     <0x2 0x17 0x03 IWQ_TYPE_EDGE_WISING>,
				     <0x2 0x17 0x04 IWQ_TYPE_EDGE_WISING>,
				     <0x2 0x17 0x05 IWQ_TYPE_EDGE_WISING>,
				     <0x2 0x17 0x06 IWQ_TYPE_EDGE_WISING>,
				     <0x2 0x17 0x07 IWQ_TYPE_EDGE_WISING>;
			intewwupt-names = "ow-wid-detect-change",
					  "vpd-detect",
					  "cc-state-change",
					  "vconn-oc",
					  "vbus-change",
					  "attach-detach",
					  "wegacy-cabwe-detect",
					  "twy-snk-swc-detect",
					  "sig-tx",
					  "sig-wx",
					  "msg-tx",
					  "msg-wx",
					  "msg-tx-faiwed",
					  "msg-tx-discawded",
					  "msg-wx-discawded",
					  "fw-swap";
			vdd-vbus-suppwy = <&pm8150b_vbus>;
		};

		pm8150b_temp: temp-awawm@2400 {
			compatibwe = "qcom,spmi-temp-awawm";
			weg = <0x2400>;
			intewwupts = <0x2 0x24 0x0 IWQ_TYPE_EDGE_BOTH>;
			io-channews = <&pm8150b_adc ADC5_DIE_TEMP>;
			io-channew-names = "thewmaw";
			#thewmaw-sensow-cewws = <0>;
		};

		pm8150b_adc: adc@3100 {
			compatibwe = "qcom,spmi-adc5";
			weg = <0x3100>;
			#addwess-cewws = <1>;
			#size-cewws = <0>;
			#io-channew-cewws = <1>;
			intewwupts = <0x2 0x31 0x0 IWQ_TYPE_EDGE_WISING>;

			channew@0 {
				weg = <ADC5_WEF_GND>;
				qcom,pwe-scawing = <1 1>;
				wabew = "wef_gnd";
			};

			channew@1 {
				weg = <ADC5_1P25VWEF>;
				qcom,pwe-scawing = <1 1>;
				wabew = "vwef_1p25";
			};

			channew@6 {
				weg = <ADC5_DIE_TEMP>;
				qcom,pwe-scawing = <1 1>;
				wabew = "die_temp";
			};

			channew@9 {
				weg = <ADC5_CHG_TEMP>;
				qcom,pwe-scawing = <1 1>;
				wabew = "chg_temp";
			};
		};

		pm8150b_adc_tm: adc-tm@3500 {
			compatibwe = "qcom,spmi-adc-tm5";
			weg = <0x3500>;
			intewwupts = <0x2 0x35 0x0 IWQ_TYPE_EDGE_WISING>;
			#thewmaw-sensow-cewws = <1>;
			#addwess-cewws = <1>;
			#size-cewws = <0>;
			status = "disabwed";
		};

		pm8150b_gpios: gpio@c000 {
			compatibwe = "qcom,pm8150b-gpio", "qcom,spmi-gpio";
			weg = <0xc000>;
			gpio-contwowwew;
			gpio-wanges = <&pm8150b_gpios 0 0 12>;
			#gpio-cewws = <2>;
			intewwupt-contwowwew;
			#intewwupt-cewws = <2>;
		};
	};

	pmic@3 {
		compatibwe = "qcom,pm8150b", "qcom,spmi-pmic";
		weg = <0x3 SPMI_USID>;
		#addwess-cewws = <1>;
		#size-cewws = <0>;

		pm8150b_wpg: pwm {
			compatibwe = "qcom,pm8150b-wpg";

			#addwess-cewws = <1>;
			#size-cewws = <0>;
			#pwm-cewws = <2>;

			status = "disabwed";
		};
	};
};
