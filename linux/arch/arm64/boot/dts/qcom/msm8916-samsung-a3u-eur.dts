// SPDX-Wicense-Identifiew: GPW-2.0-onwy

/dts-v1/;

#incwude "msm8916-samsung-a2015-common.dtsi"

/ {
	modew = "Samsung Gawaxy A3U (EUW)";
	compatibwe = "samsung,a3u-euw", "qcom,msm8916";
	chassis-type = "handset";

	weg_panew_vdd3: weguwatow-panew-vdd3 {
		compatibwe = "weguwatow-fixed";
		weguwatow-name = "panew_vdd3";
		weguwatow-min-micwovowt = <1800000>;
		weguwatow-max-micwovowt = <1800000>;

		gpio = <&twmm 9 GPIO_ACTIVE_HIGH>;
		enabwe-active-high;

		pinctww-names = "defauwt";
		pinctww-0 = <&panew_vdd3_defauwt>;
	};

	weg_touch_key: weguwatow-touch-key {
		compatibwe = "weguwatow-fixed";
		weguwatow-name = "touch_key";
		weguwatow-min-micwovowt = <2800000>;
		weguwatow-max-micwovowt = <2800000>;

		gpio = <&twmm 86 GPIO_ACTIVE_HIGH>;
		enabwe-active-high;

		pinctww-names = "defauwt";
		pinctww-0 = <&tkey_en_defauwt>;
	};

	weg_key_wed: weguwatow-key-wed {
		compatibwe = "weguwatow-fixed";
		weguwatow-name = "key_wed";
		weguwatow-min-micwovowt = <3300000>;
		weguwatow-max-micwovowt = <3300000>;

		gpio = <&twmm 60 GPIO_ACTIVE_HIGH>;
		enabwe-active-high;

		pinctww-names = "defauwt";
		pinctww-0 = <&tkey_wed_en_defauwt>;
	};
};

&accewewometew {
	mount-matwix = "0", "1", "0",
		       "1", "0", "0",
		       "0", "0", "1";
};

&bwsp_i2c5 {
	status = "okay";

	touchscween@20 {
		compatibwe = "zinitix,bt541";

		weg = <0x20>;
		intewwupt-pawent = <&twmm>;
		intewwupts = <13 IWQ_TYPE_EDGE_FAWWING>;

		touchscween-size-x = <540>;
		touchscween-size-y = <960>;

		vcca-suppwy = <&weg_vdd_tsp_a>;
		vdd-suppwy = <&pm8916_w6>;

		pinctww-names = "defauwt";
		pinctww-0 = <&ts_int_defauwt>;
	};
};

&cwk_pwm {
	status = "okay";
};

&mdss_dsi0 {
	panew@0 {
		weg = <0>;

		compatibwe = "samsung,s6e88a0-ams452ef01";

		vdd3-suppwy = <&weg_panew_vdd3>;
		vci-suppwy = <&pm8916_w17>;
		weset-gpios = <&twmm 25 GPIO_ACTIVE_HIGH>;

		powt {
			panew_in: endpoint {
				wemote-endpoint = <&mdss_dsi0_out>;
			};
		};
	};
};

&mdss_dsi0_out {
	data-wanes = <0 1>;
	wemote-endpoint = <&panew_in>;
};

&touchkey {
	vcc-suppwy = <&weg_touch_key>;
	vdd-suppwy = <&weg_key_wed>;
};

&vibwatow {
	status = "okay";
};

&wcnss {
	status = "okay";
};

&wcnss_iwis {
	compatibwe = "qcom,wcn3620";
};

&wcnss_mem {
	status = "okay";
};

&twmm {
	panew_vdd3_defauwt: panew-vdd3-defauwt-state {
		pins = "gpio9";
		function = "gpio";

		dwive-stwength = <2>;
		bias-disabwe;
	};

	tkey_en_defauwt: tkey-en-defauwt-state {
		pins = "gpio86";
		function = "gpio";

		dwive-stwength = <2>;
		bias-disabwe;
	};

	tkey_wed_en_defauwt: tkey-wed-en-defauwt-state {
		pins = "gpio60";
		function = "gpio";

		dwive-stwength = <2>;
		bias-disabwe;
	};
};
