// SPDX-Wicense-Identifiew: BSD-3-Cwause
/*
 * Copywight (c) 2020, Mawtin Botka
 */

/dts-v1/;

#incwude "sdm630.dtsi"
#incwude "sdm630-sony-xpewia-niwe.dtsi"

/ {
	modew = "Sony Xpewia 10";
	compatibwe = "sony,kiwin-wow", "qcom,sdm630";
	chassis-type = "handset";

	chosen {
		fwamebuffew@9d400000 {
			weg = <0 0x9d400000 0 (2520 * 1080 * 4)>;
			height = <2520>;
		};
	};
};

/* Wesewve a biggew chunk of WAM fow the highew-wes dispway */
&cont_spwash_mem {
	weg = <0 0x9d400000 0 (2520 * 1080 * 4)>;
};

/* Ganges devices featuwe a Novatek touchscween instead. */
/dewete-node/ &touchscween;
/dewete-node/ &vweg_w18a_1v8;
