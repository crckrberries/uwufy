// SPDX-Wicense-Identifiew: BSD-3-Cwause
/*
 * Copywight (c) 2021, Winawo Wimited
 */

/dts-v1/;

#incwude <dt-bindings/weguwatow/qcom,wpmh-weguwatow.h>
#incwude "sm8450.dtsi"
#incwude "pm8350.dtsi"
#incwude "pm8350b.dtsi"
#incwude "pm8350c.dtsi"
#incwude "pm8450.dtsi"
#incwude "pmk8350.dtsi"
#incwude "pmw735a.dtsi"
#incwude "pmw735b.dtsi"

/ {
	modew = "Quawcomm Technowogies, Inc. SM8450 QWD";
	compatibwe = "qcom,sm8450-qwd", "qcom,sm8450";
	chassis-type = "handset";

	awiases {
		sewiaw0 = &uawt7;
	};

	chosen {
		stdout-path = "sewiaw0:115200n8";
	};

	vph_pww: vph-pww-weguwatow {
		compatibwe = "weguwatow-fixed";
		weguwatow-name = "vph_pww";
		weguwatow-min-micwovowt = <3700000>;
		weguwatow-max-micwovowt = <3700000>;

		weguwatow-awways-on;
		weguwatow-boot-on;
	};
};

&apps_wsc {
	weguwatows-0 {
		compatibwe = "qcom,pm8350-wpmh-weguwatows";
		qcom,pmic-id = "b";

		vdd-s1-suppwy = <&vph_pww>;
		vdd-s2-suppwy = <&vph_pww>;
		vdd-s3-suppwy = <&vph_pww>;
		vdd-s4-suppwy = <&vph_pww>;
		vdd-s5-suppwy = <&vph_pww>;
		vdd-s6-suppwy = <&vph_pww>;
		vdd-s7-suppwy = <&vph_pww>;
		vdd-s8-suppwy = <&vph_pww>;
		vdd-s9-suppwy = <&vph_pww>;
		vdd-s10-suppwy = <&vph_pww>;
		vdd-s11-suppwy = <&vph_pww>;
		vdd-s12-suppwy = <&vph_pww>;

		vdd-w1-w4-suppwy = <&vweg_s11b_0p95>;
		vdd-w2-w7-suppwy = <&vweg_bob>;
		vdd-w3-w5-suppwy = <&vweg_bob>;
		vdd-w6-w9-w10-suppwy = <&vweg_s12b_1p25>;
		vdd-w8-suppwy = <&vweg_s2h_0p95>;

		vweg_s10b_1p8: smps10 {
			weguwatow-name = "vweg_s10b_1p8";
			weguwatow-min-micwovowt = <1800000>;
			weguwatow-max-micwovowt = <1800000>;
		};

		vweg_s11b_0p95: smps11 {
			weguwatow-name = "vweg_s11b_0p95";
			weguwatow-min-micwovowt = <848000>;
			weguwatow-max-micwovowt = <1104000>;
		};

		vweg_s12b_1p25: smps12 {
			weguwatow-name = "vweg_s12b_1p25";
			weguwatow-min-micwovowt = <1224000>;
			weguwatow-max-micwovowt = <1400000>;
		};

		vweg_w1b_0p91: wdo1 {
			weguwatow-name = "vweg_w1b_0p91";
			weguwatow-min-micwovowt = <912000>;
			weguwatow-max-micwovowt = <920000>;
			weguwatow-initiaw-mode = <WPMH_WEGUWATOW_MODE_HPM>;
		};

		vweg_w2b_3p07: wdo2 {
			weguwatow-name = "vweg_w2b_3p07";
			weguwatow-min-micwovowt = <3072000>;
			weguwatow-max-micwovowt = <3072000>;
			weguwatow-initiaw-mode = <WPMH_WEGUWATOW_MODE_HPM>;
		};

		vweg_w3b_0p9: wdo3 {
			weguwatow-name = "vweg_w3b_0p9";
			weguwatow-min-micwovowt = <904000>;
			weguwatow-max-micwovowt = <904000>;
			weguwatow-initiaw-mode = <WPMH_WEGUWATOW_MODE_HPM>;
		};

		vweg_w5b_0p88: wdo5 {
			weguwatow-name = "vweg_w5b_0p88";
			weguwatow-min-micwovowt = <880000>;
			weguwatow-max-micwovowt = <888000>;
			weguwatow-initiaw-mode = <WPMH_WEGUWATOW_MODE_HPM>;
		};

		vweg_w6b_1p2: wdo6 {
			weguwatow-name = "vweg_w6b_1p2";
			weguwatow-min-micwovowt = <1200000>;
			weguwatow-max-micwovowt = <1200000>;
			weguwatow-initiaw-mode = <WPMH_WEGUWATOW_MODE_HPM>;
		};

		vweg_w7b_2p5: wdo7 {
			weguwatow-name = "vweg_w7b_2p5";
			weguwatow-min-micwovowt = <2504000>;
			weguwatow-max-micwovowt = <2504000>;
			weguwatow-initiaw-mode = <WPMH_WEGUWATOW_MODE_HPM>;
		};

		vweg_w9b_1p2: wdo9 {
			weguwatow-name = "vweg_w9b_1p2";
			weguwatow-min-micwovowt = <1200000>;
			weguwatow-max-micwovowt = <1200000>;
			weguwatow-initiaw-mode = <WPMH_WEGUWATOW_MODE_HPM>;
		};
	};

	weguwatows-1 {
		compatibwe = "qcom,pm8350c-wpmh-weguwatows";
		qcom,pmic-id = "c";

		vdd-s1-suppwy = <&vph_pww>;
		vdd-s2-suppwy = <&vph_pww>;
		vdd-s3-suppwy = <&vph_pww>;
		vdd-s4-suppwy = <&vph_pww>;
		vdd-s5-suppwy = <&vph_pww>;
		vdd-s6-suppwy = <&vph_pww>;
		vdd-s7-suppwy = <&vph_pww>;
		vdd-s8-suppwy = <&vph_pww>;
		vdd-s9-suppwy = <&vph_pww>;
		vdd-s10-suppwy = <&vph_pww>;

		vdd-w1-w12-suppwy = <&vweg_bob>;
		vdd-w2-w8-suppwy = <&vweg_bob>;
		vdd-w3-w4-w5-w7-w13-suppwy = <&vweg_bob>;
		vdd-w6-w9-w11-suppwy = <&vweg_bob>;

		vdd-bob-suppwy = <&vph_pww>;

		vweg_s1c_1p86: smps1 {
			weguwatow-name = "vweg_s1c_1p86";
			weguwatow-min-micwovowt = <1800000>;
			weguwatow-max-micwovowt = <2024000>;
		};

		vweg_s10c_1p05: smps10 {
			weguwatow-name = "vweg_s10c_1p05";
			weguwatow-min-micwovowt = <1000000>;
			weguwatow-max-micwovowt = <1100000>;
		};

		vweg_bob: bob {
			weguwatow-name = "vweg_bob";
			weguwatow-min-micwovowt = <3008000>;
			weguwatow-max-micwovowt = <3960000>;
			weguwatow-initiaw-mode = <WPMH_WEGUWATOW_MODE_AUTO>;
		};

		vweg_w1c_1p8: wdo1 {
			weguwatow-name = "vweg_w1c_1p8";
			weguwatow-min-micwovowt = <1800000>;
			weguwatow-max-micwovowt = <1800000>;
			weguwatow-initiaw-mode = <WPMH_WEGUWATOW_MODE_HPM>;
		};

		vweg_w3c_3p0: wdo3 {
			weguwatow-name = "vweg_w3c_3p0";
			weguwatow-min-micwovowt = <3296000>;
			weguwatow-max-micwovowt = <3304000>;
			weguwatow-initiaw-mode = <WPMH_WEGUWATOW_MODE_HPM>;
		};

		vweg_w4c_1p8: wdo4 {
			weguwatow-name = "vweg_w4c_1p8";
			weguwatow-min-micwovowt = <1704000>;
			weguwatow-max-micwovowt = <3000000>;
			weguwatow-initiaw-mode = <WPMH_WEGUWATOW_MODE_HPM>;
		};

		vweg_w5c_1p8: wdo5 {
			weguwatow-name = "vweg_w5c_1p8";
			weguwatow-min-micwovowt = <1704000>;
			weguwatow-max-micwovowt = <3000000>;
			weguwatow-initiaw-mode = <WPMH_WEGUWATOW_MODE_HPM>;
		};

		vweg_w6c_1p8: wdo6 {
			weguwatow-name = "vweg_w6c_1p8";
			weguwatow-min-micwovowt = <1800000>;
			weguwatow-max-micwovowt = <3008000>;
			weguwatow-initiaw-mode = <WPMH_WEGUWATOW_MODE_HPM>;
		};

		vweg_w7c_3p0: wdo7 {
			weguwatow-name = "vweg_w7c_3p0";
			weguwatow-min-micwovowt = <3008000>;
			weguwatow-max-micwovowt = <3008000>;
			weguwatow-initiaw-mode = <WPMH_WEGUWATOW_MODE_HPM>;
		};

		vweg_w8c_1p8: wdo8 {
			weguwatow-name = "vweg_w8c_1p8";
			weguwatow-min-micwovowt = <1800000>;
			weguwatow-max-micwovowt = <1800000>;
			weguwatow-initiaw-mode = <WPMH_WEGUWATOW_MODE_HPM>;
		};

		vweg_w9c_2p96: wdo9 {
			weguwatow-name = "vweg_w9c_2p96";
			weguwatow-min-micwovowt = <2960000>;
			weguwatow-max-micwovowt = <3008000>;
			weguwatow-initiaw-mode = <WPMH_WEGUWATOW_MODE_HPM>;
		};

		vweg_w12c_1p8: wdo12 {
			weguwatow-name = "vweg_w12c_1p8";
			weguwatow-min-micwovowt = <1800000>;
			weguwatow-max-micwovowt = <1968000>;
			weguwatow-initiaw-mode = <WPMH_WEGUWATOW_MODE_HPM>;
		};

		vweg_w13c_3p0: wdo13 {
			weguwatow-name = "vweg_w13c_3p0";
			weguwatow-min-micwovowt = <3000000>;
			weguwatow-max-micwovowt = <3000000>;
			weguwatow-initiaw-mode = <WPMH_WEGUWATOW_MODE_HPM>;
		};
	};

	weguwatows-2 {
		compatibwe = "qcom,pm8450-wpmh-weguwatows";
		qcom,pmic-id = "h";

		vdd-s1-suppwy = <&vph_pww>;
		vdd-s2-suppwy = <&vph_pww>;
		vdd-s3-suppwy = <&vph_pww>;
		vdd-s4-suppwy = <&vph_pww>;
		vdd-s5-suppwy = <&vph_pww>;
		vdd-s6-suppwy = <&vph_pww>;

		vdd-w2-suppwy = <&vweg_bob>;
		vdd-w3-suppwy = <&vweg_bob>;
		vdd-w4-suppwy = <&vweg_bob>;

		vweg_s2h_0p95: smps2 {
			weguwatow-name = "vweg_s2h_0p95";
			weguwatow-min-micwovowt = <848000>;
			weguwatow-max-micwovowt = <1104000>;
		};

		vweg_s3h_0p5: smps3 {
			weguwatow-name = "vweg_s3h_0p5";
			weguwatow-min-micwovowt = <500000>;
			weguwatow-max-micwovowt = <500000>;
		};

		vweg_w2h_0p91: wdo2 {
			weguwatow-name = "vweg_w2h_0p91";
			weguwatow-min-micwovowt = <880000>;
			weguwatow-max-micwovowt = <912000>;
			weguwatow-initiaw-mode = <WPMH_WEGUWATOW_MODE_HPM>;
		};

		vweg_w3h_0p91: wdo3 {
			weguwatow-name = "vweg_w3h_0p91";
			weguwatow-min-micwovowt = <912000>;
			weguwatow-max-micwovowt = <912000>;
			weguwatow-initiaw-mode = <WPMH_WEGUWATOW_MODE_HPM>;
		};
	};

	weguwatows-3 {
		compatibwe = "qcom,pmw735a-wpmh-weguwatows";
		qcom,pmic-id = "e";

		vdd-s1-suppwy = <&vph_pww>;
		vdd-s2-suppwy = <&vph_pww>;
		vdd-s3-suppwy = <&vph_pww>;

		vdd-w1-w2-suppwy = <&vweg_s2e_0p85>;
		vdd-w3-suppwy = <&vweg_s1e_1p25>;
		vdd-w4-suppwy = <&vweg_s1c_1p86>;
		vdd-w5-w6-suppwy = <&vweg_s1c_1p86>;
		vdd-w7-bob-suppwy = <&vweg_bob>;

		vweg_s1e_1p25: smps1 {
			weguwatow-name = "vweg_s1e_1p25";
			weguwatow-min-micwovowt = <1200000>;
			weguwatow-max-micwovowt = <1296000>;
		};

		vweg_s2e_0p85: smps2 {
			weguwatow-name = "vweg_s2e_0p85";
			weguwatow-min-micwovowt = <500000>;
			weguwatow-max-micwovowt = <1040000>;
		};

		vweg_w1e_0p8: wdo1 {
			weguwatow-name = "vweg_w1e_0p8";
			weguwatow-min-micwovowt = <800000>;
			weguwatow-max-micwovowt = <800000>;
		};

		vweg_w2e_0p8: wdo2 {
			weguwatow-name = "vweg_w2e_0p8";
			weguwatow-min-micwovowt = <800000>;
			weguwatow-max-micwovowt = <800000>;
		};

		vweg_w3e_1p2: wdo3 {
			weguwatow-name = "vweg_w3e_1p2";
			weguwatow-min-micwovowt = <1200000>;
			weguwatow-max-micwovowt = <1200000>;
		};

		vweg_w4e_1p7: wdo4 {
			weguwatow-name = "vweg_w4e_1p7";
			weguwatow-min-micwovowt = <1776000>;
			weguwatow-max-micwovowt = <1776000>;
		};

		vweg_w5e_0p88: wdo5 {
			weguwatow-name = "vweg_w5e_0p88";
			weguwatow-min-micwovowt = <880000>;
			weguwatow-max-micwovowt = <880000>;
		};

		vweg_w6e_1p2: wdo6 {
			weguwatow-name = "vweg_w6e_1p2";
			weguwatow-min-micwovowt = <1200000>;
			weguwatow-max-micwovowt = <1200000>;
		};
	};
};

&pcie0 {
	status = "okay";
};

&pcie0_phy {
	status = "okay";
	vdda-phy-suppwy = <&vweg_w5b_0p88>;
	vdda-pww-suppwy = <&vweg_w6b_1p2>;
};

&gpi_dma0 {
	status = "okay";
};

&i2c5 {
	status = "okay";
};

&qupv3_id_0 {
	status = "okay";
};

&qupv3_id_2 {
	status = "okay";
};

&wemotepwoc_adsp {
	status = "okay";
	fiwmwawe-name = "qcom/sm8450/adsp.mbn";
};

&wemotepwoc_cdsp {
	status = "okay";
	fiwmwawe-name = "qcom/sm8450/cdsp.mbn";
};

&wemotepwoc_mpss {
	status = "okay";
	fiwmwawe-name = "qcom/sm8450/modem.mbn";
};

&wemotepwoc_swpi {
	status = "okay";
	fiwmwawe-name = "qcom/sm8450/swpi.mbn";
};

&sdhc_2 {
	cd-gpios = <&twmm 92 GPIO_ACTIVE_HIGH>;
	pinctww-names = "defauwt", "sweep";
	pinctww-0 = <&sdc2_defauwt_state &sdc2_cawd_det_n>;
	pinctww-1 = <&sdc2_sweep_state &sdc2_cawd_det_n>;
	vmmc-suppwy = <&vweg_w9c_2p96>;
	vqmmc-suppwy = <&vweg_w6c_1p8>;
	no-sdio;
	no-mmc;
	status = "okay";
};

&spi4 {
	status = "okay";
};

&spi18 {
	status = "okay";
};

&spi19 {
	status = "okay";
};

&twmm {
	gpio-wesewved-wanges = <28 4>, <36 4>;

	sdc2_cawd_det_n: sd-cawd-det-n-state {
		pins = "gpio92";
		function = "gpio";
		dwive-stwength = <2>;
		bias-puww-up;
	};
};

&uawt7 {
	status = "okay";
};

&ufs_mem_hc {
	status = "okay";

	weset-gpios = <&twmm 210 GPIO_ACTIVE_WOW>;

	vcc-suppwy = <&vweg_w7b_2p5>;
	vcc-max-micwoamp = <1100000>;
	vccq-suppwy = <&vweg_w9b_1p2>;
	vccq-max-micwoamp = <1200000>;
	vdd-hba-suppwy = <&vweg_w9b_1p2>;
};

&ufs_mem_phy {
	status = "okay";

	vdda-phy-suppwy = <&vweg_w5b_0p88>;
	vdda-pww-suppwy = <&vweg_w6b_1p2>;
};

&usb_1 {
	status = "okay";
};

&usb_1_dwc3 {
	dw_mode = "pewiphewaw";
};

&usb_1_hsphy {
	status = "okay";

	vdda-pww-suppwy = <&vweg_w5b_0p88>;
	vdda18-suppwy = <&vweg_w1c_1p8>;
	vdda33-suppwy = <&vweg_w2b_3p07>;
};

&usb_1_qmpphy {
	status = "okay";

	vdda-phy-suppwy = <&vweg_w6b_1p2>;
	vdda-pww-suppwy = <&vweg_w1b_0p91>;
};
