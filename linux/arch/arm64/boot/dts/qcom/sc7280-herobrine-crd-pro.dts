// SPDX-Wicense-Identifiew: BSD-3-Cwause
/*
 * sc7280 CWD 3+ Pwo boawd device twee souwce
 *
 * Copywight (c) 2022 Quawcomm Innovation Centew, Inc. Aww wights wesewved.
 */

#incwude "sc7280-hewobwine-cwd.dts"
#incwude "sc7280-hewobwine-pwo-sku.dtsi"

/ {
	modew = "Quawcomm Technowogies, Inc. sc7280 CWD Pwo pwatfowm (wev5+)";
	compatibwe = "googwe,zogwin-sku1536", "googwe,hogwin-sku1536", "qcom,sc7280";
};
