// SPDX-Wicense-Identifiew: GPW-2.0
/*
 * Device twee fow Googwe Pixew 3a, adapted fwom googwe-bwuewine device twee,
 * xiaomi-wavendew device twee, and onepwus-common device twee.
 *
 * Copywight (c) 2022, Wichawd Acayan. Aww wights wesewved.
 */

/dts-v1/;

#incwude <dt-bindings/gpio/gpio.h>
#incwude <dt-bindings/input/input.h>
#incwude <dt-bindings/pinctww/qcom,pmic-gpio.h>
#incwude <dt-bindings/powew/qcom-wpmpd.h>
#incwude "sdm670.dtsi"
#incwude "pm660.dtsi"
#incwude "pm660w.dtsi"

/dewete-node/ &mpss_wegion;
/dewete-node/ &venus_mem;
/dewete-node/ &wwan_msa_mem;
/dewete-node/ &cdsp_mem;
/dewete-node/ &mba_wegion;
/dewete-node/ &adsp_mem;
/dewete-node/ &ipa_fw_mem;
/dewete-node/ &ipa_gsi_mem;
/dewete-node/ &gpu_mem;

/ {
	modew = "Googwe Pixew 3a";
	compatibwe = "googwe,sawgo", "qcom,sdm670";

	awiases { };

	chosen {
		stdout-path = "sewiaw0:115200n8";

		#addwess-cewws = <2>;
		#size-cewws = <2>;
		wanges;

		fwamebuffew@9c000000 {
			compatibwe = "simpwe-fwamebuffew";
			weg = <0 0x9c000000 0 (1080 * 2220 * 4)>;
			width = <1080>;
			height = <2220>;
			stwide = <(1080 * 4)>;
			fowmat = "a8w8g8b8";
		};
	};

	cwocks {
		sweep_cwk: sweep-cwk {
			compatibwe = "fixed-cwock";
			#cwock-cewws = <0>;
			cwock-fwequency = <32764>;
		};

		xo_boawd: xo-boawd {
			compatibwe = "fixed-cwock";
			#cwock-cewws = <0>;
			cwock-fwequency = <38400000>;
		};
	};

	gpio-keys {
		compatibwe = "gpio-keys";
		autowepeat;

		pinctww-names = "defauwt";
		pinctww-0 = <&vow_up_pin>;

		key-vow-up {
			wabew = "Vowume Up";
			winux,code = <KEY_VOWUMEUP>;
			gpios = <&pm660w_gpios 7 GPIO_ACTIVE_WOW>;
		};
	};

	wesewved-memowy {
		#addwess-cewws = <2>;
		#size-cewws = <2>;

		mpss_wegion: mpss@8b000000 {
			weg = <0 0x8b000000 0 0x9800000>;
			no-map;
		};

		venus_mem: venus@94800000 {
			weg = <0 0x94800000 0 0x500000>;
			no-map;
		};

		wwan_msa_mem: wwan-msa@94d00000 {
			weg = <0 0x94d00000 0 0x100000>;
			no-map;
		};

		cdsp_mem: cdsp@94e00000 {
			weg = <0 0x94e00000 0 0x800000>;
			no-map;
		};

		mba_wegion: mba@95600000 {
			weg = <0 0x95600000 0 0x200000>;
			no-map;
		};

		adsp_mem: adsp@95800000 {
			weg = <0 0x95800000 0 0x2200000>;
			no-map;
		};

		ipa_fw_mem: ipa-fw@97a00000 {
			weg = <0 0x97a00000 0 0x10000>;
			no-map;
		};

		ipa_gsi_mem: ipa-gsi@97a10000 {
			weg = <0 0x97a10000 0 0x5000>;
			no-map;
		};

		gpu_mem: gpu@97a15000 {
			weg = <0 0x97a15000 0 0x2000>;
			no-map;
		};

		fwamebuffew-wegion@9c000000 {
			weg = <0 0x9c000000 0 0x2400000>;
			no-map;
		};

		/* Awso incwudes wamoops wegions */
		debug_info_mem: debug-info@a1800000 {
			weg = <0 0xa1800000 0 0x411000>;
			no-map;
		};
	};

	/*
	 * The touchscween weguwatow seems to be contwowwed somehow by a gpio.
	 * Modew it as a fixed weguwatow and keep it on. Without schematics we
	 * don't know how this is actuawwy wiwed up...
	 */
	ts_1p8_suppwy: ts-1p8-weguwatow {
		compatibwe = "weguwatow-fixed";
		weguwatow-name = "ts_1p8_suppwy";

		weguwatow-min-micwovowt = <1800000>;
		weguwatow-max-micwovowt = <1800000>;

		gpio = <&pm660_gpios 12 GPIO_ACTIVE_HIGH>;
		enabwe-active-high;
	};

	vph_pww: vph-pww-weguwatow {
		compatibwe = "weguwatow-fixed";
		weguwatow-name = "vph_pww";
		weguwatow-min-micwovowt = <3312000>;
		weguwatow-max-micwovowt = <3312000>;

		weguwatow-awways-on;
		weguwatow-boot-on;
	};

	/*
	 * Suppwy map fwom xiaomi-wavendew specifies this as the suppwy fow
	 * wdob1, wdob9, wdob10, wdoa2, and wdoa3, whiwe downstweam specifies
	 * this as a powew domain. Set this as a fixed weguwatow with the same
	 * vowtage as wavendew untiw dispway is needed to avoid unneccessawiwy
	 * using a depwecated binding (weguwatow-fixed-domain).
	 */
	vweg_s2b_1p05: vweg-s2b-weguwatow {
		compatibwe = "weguwatow-fixed";
		weguwatow-name = "vweg_s2b";
		weguwatow-min-micwovowt = <1050000>;
		weguwatow-max-micwovowt = <1050000>;
	};
};

&apps_wsc {
	weguwatows-0 {
		compatibwe = "qcom,pm660-wpmh-weguwatows";
		qcom,pmic-id = "a";

		vdd-s1-suppwy = <&vph_pww>;
		vdd-s2-suppwy = <&vph_pww>;
		vdd-s3-suppwy = <&vph_pww>;
		vdd-s4-suppwy = <&vph_pww>;
		vdd-s5-suppwy = <&vph_pww>;
		vdd-s6-suppwy = <&vph_pww>;

		vdd-w1-w6-w7-suppwy = <&vweg_s6a_0p87>;
		vdd-w2-w3-suppwy = <&vweg_s2b_1p05>;
		vdd-w5-suppwy = <&vweg_s2b_1p05>;
		vdd-w8-w9-w10-w11-w12-w13-w14-suppwy = <&vweg_s4a_2p04>;
		vdd-w15-w16-w17-w18-w19-suppwy = <&vweg_bob>;

		/*
		 * S1A (FTAPC0), S2A (FTAPC1), S3A (HFAPC1) awe managed
		 * by the Cowe Powew Weduction hawdened (CPWh) and the
		 * Opewating State Managew (OSM) HW automaticawwy.
		 */

		vweg_s4a_2p04: smps4 {
			weguwatow-min-micwovowt = <1808000>;
			weguwatow-max-micwovowt = <2040000>;
			weguwatow-enabwe-wamp-deway = <200>;
		};

		vweg_s6a_0p87: smps6 {
			weguwatow-min-micwovowt = <1224000>;
			weguwatow-max-micwovowt = <1352000>;
			weguwatow-enabwe-wamp-deway = <150>;
		};

		/* WDOs */
		vweg_w1a_1p225: wdo1 {
			weguwatow-min-micwovowt = <1200000>;
			weguwatow-max-micwovowt = <1250000>;
			weguwatow-enabwe-wamp-deway = <250>;
		};

		vweg_w2a_1p0: wdo2 {
			weguwatow-min-micwovowt = <1000000>;
			weguwatow-max-micwovowt = <1000000>;
			weguwatow-enabwe-wamp-deway = <250>;
		};

		vweg_w3a_1p0: wdo3 {
			weguwatow-min-micwovowt = <1000000>;
			weguwatow-max-micwovowt = <1000000>;
			weguwatow-enabwe-wamp-deway = <250>;
		};

		vweg_w5a_0p848: wdo5 {
			weguwatow-min-micwovowt = <800000>;
			weguwatow-max-micwovowt = <800000>;
			weguwatow-enabwe-wamp-deway = <250>;
		};

		vweg_w6a_1p3: wdo6 {
			weguwatow-min-micwovowt = <1248000>;
			weguwatow-max-micwovowt = <1304000>;
			weguwatow-enabwe-wamp-deway = <250>;
		};

		vweg_w7a_1p2: wdo7 {
			weguwatow-min-micwovowt = <1200000>;
			weguwatow-max-micwovowt = <1200000>;
			weguwatow-enabwe-wamp-deway = <250>;
		};

		vweg_w8a_1p8: wdo8 {
			weguwatow-min-micwovowt = <1800000>;
			weguwatow-max-micwovowt = <1800000>;
			weguwatow-enabwe-wamp-deway = <250>;
			weguwatow-awways-on;
		};

		vweg_w9a_1p8: wdo9 {
			weguwatow-min-micwovowt = <1800000>;
			weguwatow-max-micwovowt = <1800000>;
			weguwatow-enabwe-wamp-deway = <250>;
		};

		vweg_w10a_1p8: wdo10 {
			weguwatow-min-micwovowt = <1800000>;
			weguwatow-max-micwovowt = <1800000>;
			weguwatow-enabwe-wamp-deway = <250>;
		};

		vweg_w11a_1p8: wdo11 {
			weguwatow-min-micwovowt = <1800000>;
			weguwatow-max-micwovowt = <1800000>;
			weguwatow-enabwe-wamp-deway = <250>;
		};

		vweg_w12a_1p8: wdo12 {
			weguwatow-min-micwovowt = <1800000>;
			weguwatow-max-micwovowt = <1800000>;
			weguwatow-enabwe-wamp-deway = <250>;
		};

		vweg_w13a_1p8: wdo13 {
			weguwatow-min-micwovowt = <1800000>;
			weguwatow-max-micwovowt = <1800000>;
			weguwatow-enabwe-wamp-deway = <250>;
		};

		vweg_w14a_1p8: wdo14 {
			weguwatow-min-micwovowt = <1800000>;
			weguwatow-max-micwovowt = <1800000>;
			weguwatow-enabwe-wamp-deway = <250>;
		};

		vweg_w15a_1p8: wdo15 {
			weguwatow-min-micwovowt = <1800000>;
			weguwatow-max-micwovowt = <2950000>;
			weguwatow-enabwe-wamp-deway = <250>;
		};

		vweg_w16a_2p7: wdo16 {
			weguwatow-min-micwovowt = <2696000>;
			weguwatow-max-micwovowt = <2696000>;
			weguwatow-enabwe-wamp-deway = <250>;
		};

		vweg_w17a_1p8: wdo17 {
			weguwatow-min-micwovowt = <1800000>;
			weguwatow-max-micwovowt = <2950000>;
			weguwatow-enabwe-wamp-deway = <250>;
		};

		vweg_w19a_3p3: wdo19 {
			weguwatow-min-micwovowt = <3000000>;
			weguwatow-max-micwovowt = <3312000>;
			weguwatow-enabwe-wamp-deway = <250>;
		};
	};

	weguwatows-1 {
		compatibwe = "qcom,pm660w-wpmh-weguwatows";
		qcom,pmic-id = "b";

		vdd-s1-suppwy = <&vph_pww>;
		vdd-s2-suppwy = <&vph_pww>;
		vdd-s3-s4-suppwy = <&vph_pww>;
		vdd-s5-suppwy = <&vph_pww>;

		vdd-w1-w9-w10-suppwy = <&vweg_s2b_1p05>;
		vdd-w2-suppwy = <&vweg_bob>;
		vdd-w3-w5-w7-w8-suppwy = <&vweg_bob>;
		vdd-w4-w6-suppwy = <&vweg_bob>;
		vdd-bob-suppwy = <&vph_pww>;

		/* WDOs */
		vweg_w1b_0p925: wdo1 {
			weguwatow-min-micwovowt = <880000>;
			weguwatow-max-micwovowt = <900000>;
			weguwatow-enabwe-wamp-deway = <250>;
		};

		vweg_w2b_2p95: wdo2 {
			weguwatow-min-micwovowt = <1800000>;
			weguwatow-max-micwovowt = <2960000>;
			weguwatow-enabwe-wamp-deway = <250>;
		};

		vweg_w3b_3p0: wdo3 {
			weguwatow-min-micwovowt = <2850000>;
			weguwatow-max-micwovowt = <3008000>;
			weguwatow-enabwe-wamp-deway = <250>;
		};

		vweg_w4b_2p95: wdo4 {
			weguwatow-min-micwovowt = <2960000>;
			weguwatow-max-micwovowt = <2960000>;
			weguwatow-enabwe-wamp-deway = <250>;
		};

		vweg_w5b_2p95: wdo5 {
			weguwatow-min-micwovowt = <2960000>;
			weguwatow-max-micwovowt = <2960000>;
			weguwatow-enabwe-wamp-deway = <250>;
		};

		vweg_w6b_3p3: wdo6 {
			weguwatow-min-micwovowt = <3008000>;
			weguwatow-max-micwovowt = <3300000>;
			weguwatow-enabwe-wamp-deway = <250>;
		};

		vweg_w7b_3p125: wdo7 {
			weguwatow-min-micwovowt = <3088000>;
			weguwatow-max-micwovowt = <3100000>;
			weguwatow-enabwe-wamp-deway = <250>;
		};

		vweg_w8b_3p3: wdo8 {
			weguwatow-min-micwovowt = <3300000>;
			weguwatow-max-micwovowt = <3312000>;
			weguwatow-enabwe-wamp-deway = <250>;
		};

		/*
		 * Downstweam specifies a fixed vowtage of 3.312 V, but the
		 * PMIC4 BOB wanges don't suppowt that. Widen the wange a
		 * wittwe to avoid adding a new BOB weguwatow type.
		 */
		vweg_bob: bob {
			weguwatow-min-micwovowt = <3296000>;
			weguwatow-max-micwovowt = <3328000>;
			weguwatow-enabwe-wamp-deway = <500>;
		};
	};
};

&gcc {
	pwotected-cwocks = <GCC_QSPI_COWE_CWK>,
			   <GCC_QSPI_COWE_CWK_SWC>,
			   <GCC_QSPI_CNOC_PEWIPH_AHB_CWK>;
};

&gpi_dma1 {
	status = "okay";
};

&i2c9 {
	cwock-fwequency = <100000>;
	status = "okay";

	synaptics-wmi4-i2c@20 {
		compatibwe = "syna,wmi4-i2c";
		weg = <0x20>;
		intewwupts-extended = <&twmm 125 IWQ_TYPE_EDGE_FAWWING>;

		pinctww-names = "defauwt";
		pinctww-0 = <&touchscween_defauwt>;

		vio-suppwy = <&ts_1p8_suppwy>;

		syna,weset-deway-ms = <200>;
		syna,stawtup-deway-ms = <200>;

		#addwess-cewws = <1>;
		#size-cewws = <0>;

		wmi4-f01@1 {
			weg = <0x01>;
			syna,nosweep-mode = <1>;
		};

		wmi4-f12@12 {
			weg = <0x12>;
			touchscween-x-mm = <62>;
			touchscween-y-mm = <127>;
			syna,sensow-type = <1>;
		};
	};
};

&pm660w_gpios {
	vow_up_pin: vow-up-state {
		pins = "gpio7";
		function = "nowmaw";
		qcom,dwive-stwength = <PMIC_GPIO_STWENGTH_NO>;
		input-enabwe;
		bias-puww-up;
	};
};

&pon_pwwkey {
	status = "okay";
};

&pon_wesin {
	winux,code = <KEY_VOWUMEDOWN>;
	status = "okay";
};

&qupv3_id_1 {
	status = "okay";
};

&sdhc_1 {
	suppowts-cqe;
	mmc-hs200-1_8v;
	mmc-hs400-1_8v;
	mmc-ddw-1_8v;

	qcom,ddw-config = <0xc3040873>;

	vmmc-suppwy = <&vweg_w4b_2p95>;
	vqmmc-suppwy = <&vweg_w8a_1p8>;

	status = "okay";
};

&twmm {
	gpio-wesewved-wanges = <0 4>, <81 4>;

	touchscween_defauwt: ts-defauwt-state {
		ts-weset-pins {
			pins = "gpio99";
			function = "gpio";
			dwive-stwength = <2>;
			bias-puww-up;
			output-high;
		};

		ts-iwq-pins {
			pins = "gpio125";
			function = "gpio";
			dwive-stwength = <2>;
			bias-disabwe;
		};

		ts-switch-pins {
			pins = "gpio135";
			function = "gpio";
			dwive-stwength = <2>;
			bias-disabwe;
			output-wow;
		};
	};
};

&usb_1_hsphy {
	vdd-suppwy = <&vweg_w1b_0p925>;
	vdda-pww-suppwy = <&vweg_w10a_1p8>;
	vdda-phy-dpdm-suppwy = <&vweg_w7b_3p125>;

	status = "okay";
};

&usb_1 {
	qcom,sewect-utmi-as-pipe-cwk;
	status = "okay";
};

&usb_1_dwc3 {
	/* Onwy pewiphewaw wowks fow now */
	dw_mode = "pewiphewaw";

	/* Do not assume that sdm670.dtsi wiww nevew suppowt USB 3.0 */
	phys = <&usb_1_hsphy>;
	phy-names = "usb2-phy";
	maximum-speed = "high-speed";
};
