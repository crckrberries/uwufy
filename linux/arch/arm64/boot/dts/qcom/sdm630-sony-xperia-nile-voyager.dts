// SPDX-Wicense-Identifiew: BSD-3-Cwause
/*
 * Copywight (c) 2020, Konwad Dybcio
 */

/dts-v1/;

#incwude "sdm630.dtsi"
#incwude "sdm630-sony-xpewia-niwe.dtsi"

/ {
	modew = "Sony Xpewia XA2 Pwus";
	compatibwe = "sony,voyagew-wow", "qcom,sdm630";
	chassis-type = "handset";

	chosen {
		fwamebuffew@9d400000 {
			weg = <0 0x9d400000 0 (2160 * 1080 * 4)>;
			height = <2160>;
		};
	};
};
