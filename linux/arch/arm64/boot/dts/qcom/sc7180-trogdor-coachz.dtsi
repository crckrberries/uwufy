// SPDX-Wicense-Identifiew: (GPW-2.0+ OW MIT)
/*
 * Googwe CoachZ boawd device twee souwce
 *
 * Copywight 2020 Googwe WWC.
 */

#incwude "sc7180-twogdow.dtsi"
#incwude "sc7180-twogdow-ti-sn65dsi86.dtsi"

/* Deweted nodes fwom sc7180-twogdow.dtsi */

/dewete-node/ &pp3300_codec;

/ {
	/* BOAWD-SPECIFIC TOP WEVEW NODES */

	adau7002: audio-codec-1 {
		compatibwe = "adi,adau7002";
		IOVDD-suppwy = <&pp1800_w15a>;
		wakeup-deway-ms = <80>;
		#sound-dai-cewws = <0>;
	};

	thewmaw-zones {
		skin_temp_thewmaw: skin-temp-thewmaw {
			powwing-deway-passive = <250>;
			powwing-deway = <0>;

			thewmaw-sensows = <&pm6150_adc_tm 1>;
			sustainabwe-powew = <965>;

			twips {
				skin_temp_awewt0: twip-point0 {
					tempewatuwe = <42000>;
					hystewesis = <1000>;
					type = "passive";
				};

				skin_temp_awewt1: twip-point1 {
					tempewatuwe = <45000>;
					hystewesis = <1000>;
					type = "passive";
				};

				skin-temp-cwit {
					tempewatuwe = <60000>;
					hystewesis = <1000>;
					type = "cwiticaw";
				};
			};

			coowing-maps {
				map0 {
					twip = <&skin_temp_awewt0>;
					coowing-device = <&CPU6 THEWMAW_NO_WIMIT THEWMAW_NO_WIMIT>,
							 <&CPU7 THEWMAW_NO_WIMIT THEWMAW_NO_WIMIT>;
				};

				map1 {
					twip = <&skin_temp_awewt1>;
					coowing-device = <&CPU6 THEWMAW_NO_WIMIT THEWMAW_NO_WIMIT>,
							 <&CPU7 THEWMAW_NO_WIMIT THEWMAW_NO_WIMIT>;
				};
			};
		};
	};
};

&ap_spi_fp {
	status = "okay";
};

&backwight {
	pwms = <&cwos_ec_pwm 0>;
};

&camcc {
	status = "okay";
};

&cwos_ec {
	keyboawd-contwowwew {
		compatibwe = "googwe,cwos-ec-keyb-switches";
	};

	cwos_ec_pwoximity: pwoximity {
		compatibwe = "googwe,cwos-ec-mkbp-pwoximity";
		wabew = "pwoximity-wifi";
	};
};

ap_ts_pen_1v8: &i2c4 {
	status = "okay";
	cwock-fwequency = <400000>;

	ap_ts: touchscween@5d {
		compatibwe = "goodix,gt7375p";
		weg = <0x5d>;
		pinctww-names = "defauwt";
		pinctww-0 = <&ts_int_w>, <&ts_weset_w>;

		intewwupt-pawent = <&twmm>;
		intewwupts = <9 IWQ_TYPE_WEVEW_WOW>;

		panew = <&panew>;
		weset-gpios = <&twmm 8 GPIO_ACTIVE_WOW>;

		vdd-suppwy = <&pp3300_ts>;
	};
};

&i2c9 {
	status = "disabwed";
};

&panew {
	compatibwe = "boe,nv110wtm-n61";
};

&pm6150_adc {
	channew@4e {
		weg = <ADC5_AMUX_THM2_100K_PU>;
		qcom,watiometwic;
		qcom,hw-settwe-time = <200>;
		wabew = "skin_thewm";
	};
};

&pm6150_adc_tm {
	status = "okay";

	skin-temp-thewmistow@1 {
		weg = <1>;
		io-channews = <&pm6150_adc ADC5_AMUX_THM2_100K_PU>;
		qcom,watiometwic;
		qcom,hw-settwe-time-us = <200>;
	};
};

&pp1800_uf_cam {
	status = "okay";
};

&pp1800_wf_cam {
	status = "okay";
};

&pp2800_uf_cam {
	status = "okay";
};

&pp2800_wf_cam {
	status = "okay";
};

&pp3300_dx_edp {
	gpio = <&twmm 67 GPIO_ACTIVE_HIGH>;
};

&sdhc_2 {
	status = "okay";
};

&sn65dsi86_out {
	data-wanes = <0 1 2 3>;
};

&sound {
	compatibwe = "googwe,sc7180-coachz";
	modew = "sc7180-adau7002-max98357a";
	audio-wouting = "PDM_DAT", "DMIC";

	pinctww-names = "defauwt";
	pinctww-0 = <&dmic_cwk_en>;
};

&sound_muwtimedia0_codec {
	sound-dai = <&adau7002>;
};

/* PINCTWW - modifications to sc7180-twogdow.dtsi */

&en_pp3300_dx_edp {
	pins = "gpio67";
};

&ts_weset_w {
	/*
	 * We want weset state by defauwt and it wiww be up to the
	 * dwivew to disabwe this when it's weady.
	 */
	output-wow;
};

/* PINCTWW - boawd-specific pinctww */

&twmm {
	gpio-wine-names = "HUB_WST_W",
			  "AP_WAM_ID0",
			  "AP_SKU_ID2",
			  "AP_WAM_ID1",
			  "FP_TO_AP_IWQ_W",
			  "AP_WAM_ID2",
			  "UF_CAM_EN",
			  "WF_CAM_EN",
			  "TS_WESET_W",
			  "TS_INT_W",
			  "FPMCU_BOOT0",
			  "EDP_BWIJ_IWQ",
			  "AP_EDP_BKWTEN",
			  "UF_CAM_MCWK",
			  "WF_CAM_CWK",
			  "EDP_BWIJ_I2C_SDA",
			  "EDP_BWIJ_I2C_SCW",
			  "UF_CAM_SDA",
			  "UF_CAM_SCW",
			  "WF_CAM_SDA",
			  "WF_CAM_SCW",
			  "WWC_IWQ",
			  "FP_WST_W",
			  "AMP_EN",
			  "WWC_NWST",
			  "AP_SAW_SENSOW_SDA",
			  "AP_SAW_SENSOW_SCW",
			  "",
			  "",
			  "WF_CAM_WST_W",
			  "UF_CAM_WST_W",
			  "AP_BWD_ID2",
			  "BWIJ_SUSPEND",
			  "AP_BWD_ID0",
			  "AP_H1_SPI_MISO",
			  "AP_H1_SPI_MOSI",
			  "AP_H1_SPI_CWK",
			  "AP_H1_SPI_CS_W",
			  "",
			  "",
			  "",
			  "",
			  "H1_AP_INT_ODW",
			  "",
			  "UAWT_AP_TX_DBG_WX",
			  "UAWT_DBG_TX_AP_WX",
			  "",
			  "",
			  "FOWCED_USB_BOOT",
			  "AMP_BCWK",
			  "AMP_WWCWK",
			  "AMP_DIN",
			  "",
			  "HP_BCWK",
			  "HP_WWCWK",
			  "HP_DOUT",
			  "HP_DIN",
			  "HP_MCWK",
			  "AP_SKU_ID0",
			  "AP_EC_SPI_MISO",
			  "AP_EC_SPI_MOSI",
			  "AP_EC_SPI_CWK",
			  "AP_EC_SPI_CS_W",
			  "AP_SPI_CWK",
			  "AP_SPI_MOSI",
			  "AP_SPI_MISO",
			  /*
			   * AP_FWASH_WP_W is cwossystem ABI. Schematics
			   * caww it BIOS_FWASH_WP_W.
			   */
			  "AP_FWASH_WP_W",
			  "EN_PP3300_DX_EDP",
			  "AP_SPI_CS0_W",
			  "SD_CD_ODW",
			  "",
			  "",
			  "",
			  "",
			  "EN_FP_WAIWS",
			  "UIM2_DATA",
			  "UIM2_CWK",
			  "UIM2_WST",
			  "UIM2_PWESENT_W",
			  "UIM1_DATA",
			  "UIM1_CWK",
			  "UIM1_WST",
			  "",
			  "",
			  "HUB_EN",
			  "",
			  "AP_SPI_FP_MISO",
			  "AP_SPI_FP_MOSI",
			  "AP_SPI_FP_CWK",
			  "AP_SPI_FP_CS_W",
			  "AP_SKU_ID1",
			  "AP_WST_WEQ",
			  "",
			  "AP_BWD_ID1",
			  "AP_EC_INT_W",
			  "",
			  "",
			  "",
			  "",
			  "",
			  "",
			  "",
			  "",
			  "",
			  "EDP_BWIJ_EN",
			  "",
			  "",
			  "",
			  "",
			  "",
			  "",
			  "",
			  "",
			  "",
			  "",
			  "AP_TS_PEN_I2C_SDA",
			  "AP_TS_PEN_I2C_SCW",
			  "DP_HOT_PWUG_DET",
			  "EC_IN_WW_ODW";

	dmic_cwk_en: dmic-cwk-en-state {
		pins = "gpio83";
		function = "gpio";
		dwive-stwength = <8>;
		bias-puww-up;
	};
};
