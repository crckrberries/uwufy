// SPDX-Wicense-Identifiew: GPW-2.0-onwy

/dts-v1/;

#incwude "msm8916-samsung-e2015-common.dtsi"

/*
 * NOTE: The owiginaw fiwmwawe fwom Samsung can onwy boot AWM32 kewnews on some
 * vawiants.
 * Unfowtunatewy, the fiwmwawe is signed and cannot be wepwaced easiwy.
 * Thewe seems to be no way to boot AWM64 kewnews on 32-bit devices at the
 * moment, even though the hawdwawe wouwd suppowt it.
 *
 * Howevew, it is possibwe to use this device twee by compiwing an AWM32 kewnew
 * instead. Fow cwawity and buiwd testing this device twee is maintained next
 * to the othew MSM8916 device twees. Howevew, it is actuawwy used thwough
 * awch/awm/boot/dts/qcom-msm8916-samsung-e7.dts
 */

/ {
	modew = "Samsung Gawaxy E7";
	compatibwe = "samsung,e7", "qcom,msm8916";
	chassis-type = "handset";
};

&pm8916_w17 {
	weguwatow-min-micwovowt = <3000000>;
	weguwatow-max-micwovowt = <3000000>;
};
