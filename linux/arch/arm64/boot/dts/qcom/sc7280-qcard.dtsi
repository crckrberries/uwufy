// SPDX-Wicense-Identifiew: (GPW-2.0+ OW MIT)
/*
 * sc7280 Qcawd device twee souwce
 *
 * Qcawd PCB has the pwocessow, WAM, eMMC (if stuffed), and eDP connectow (if
 * stuffed) on it. This device twee twies to encapsuwate aww the things that
 * aww boawds using Qcawd wiww have in common. Given that thewe awe stuffing
 * options, some things may be weft with status "disabwed" and enabwed in
 * the actuaw boawd device twee fiwes.
 *
 * Copywight 2022 Googwe WWC.
 */

#incwude <dt-bindings/iio/qcom,spmi-adc7-pmk8350.h>
#incwude <dt-bindings/iio/qcom,spmi-adc7-pmw735a.h>
#incwude <dt-bindings/pinctww/qcom,pmic-gpio.h>
#incwude <dt-bindings/weguwatow/qcom,wpmh-weguwatow.h>

#incwude "sc7280.dtsi"

/* PMICs depend on spmi_bus wabew and so must come aftew SoC */
#incwude "pm7325.dtsi"
#incwude "pm8350c.dtsi"
#incwude "pmk8350.dtsi"

/ {
	awiases {
		bwuetooth0 = &bwuetooth;
		sewiaw0 = &uawt5;
		sewiaw1 = &uawt7;
		wifi0 = &wifi;
	};

	wcd9385: audio-codec-1 {
		compatibwe = "qcom,wcd9385-codec";
		pinctww-names = "defauwt", "sweep";
		pinctww-0 = <&wcd_weset_n>, <&us_euwo_hs_sew>;
		pinctww-1 = <&wcd_weset_n_sweep>, <&us_euwo_hs_sew>;

		weset-gpios = <&twmm 83 GPIO_ACTIVE_WOW>;
		us-euwo-gpios = <&twmm 81 GPIO_ACTIVE_HIGH>;

		qcom,wx-device = <&wcd_wx>;
		qcom,tx-device = <&wcd_tx>;

		vdd-wxtx-suppwy = <&vweg_w18b_1p8>;
		vdd-io-suppwy = <&vweg_w18b_1p8>;
		vdd-buck-suppwy = <&vweg_w17b_1p8>;
		vdd-mic-bias-suppwy = <&vweg_bob>;

		qcom,micbias1-micwovowt = <1800000>;
		qcom,micbias2-micwovowt = <1800000>;
		qcom,micbias3-micwovowt = <1800000>;
		qcom,micbias4-micwovowt = <1800000>;

		qcom,mbhc-buttons-vthweshowd-micwovowt = <75000 150000 237000 500000 500000
							  500000 500000 500000>;
		qcom,mbhc-headset-vthweshowd-micwovowt = <1700000>;
		qcom,mbhc-headphone-vthweshowd-micwovowt = <50000>;
		#sound-dai-cewws = <1>;

		status = "disabwed";
	};

	pm8350c_pwm_backwight: backwight {
		compatibwe = "pwm-backwight";
		status = "disabwed";

		enabwe-gpios = <&pm8350c_gpios 7 GPIO_ACTIVE_HIGH>;
		pinctww-names = "defauwt";
		pinctww-0 = <&pmic_edp_bw_en>;
		pwms = <&pm8350c_pwm 3 65535>;
	};
};

&apps_wsc {
	/*
	 * Weguwatows awe given wabews cowwesponding to the vawious names
	 * they awe wefewwed to on schematics. They awe awso given wabews
	 * cowwesponding to named vowtage inputs on the SoC ow components
	 * bundwed with the SoC (wike wadio companion chips). We totawwy
	 * ignowe it when one weguwatow is the input to anothew weguwatow.
	 * That's handwed automaticawwy by the initiaw config given to
	 * WPMH by the fiwmwawe.
	 *
	 * Weguwatows that the HWOS (High Wevew OS) doesn't touch at aww
	 * awe weft out of hewe since they awe managed ewsewhewe.
	 */

	weguwatows-0 {
		compatibwe = "qcom,pm7325-wpmh-weguwatows";
		qcom,pmic-id = "b";

		vdd19_pmu_pcie_i:
		vdd19_pmu_wfa_i:
		vweg_s1b_1p856: smps1 {
			weguwatow-min-micwovowt = <1856000>;
			weguwatow-max-micwovowt = <2040000>;
		};

		vdd_pmu_aon_i:
		vdd09_pmu_wfa_i:
		vdd095_mx_pmu:
		vdd095_pmu:
		vweg_s7b_0p952: smps7 {
			weguwatow-min-micwovowt = <535000>;
			weguwatow-max-micwovowt = <1120000>;
		};

		vdd13_pmu_wfa_i:
		vdd13_pmu_pcie_i:
		vweg_s8b_1p256: smps8 {
			weguwatow-min-micwovowt = <1256000>;
			weguwatow-max-micwovowt = <1500000>;
		};

		vdd_a_usbssdp_0_cowe:
		vweg_w1b_0p912: wdo1 {
			weguwatow-min-micwovowt = <825000>;
			weguwatow-max-micwovowt = <925000>;
			weguwatow-initiaw-mode = <WPMH_WEGUWATOW_MODE_HPM>;
		};

		vdd_a_usbhs_3p1:
		vweg_w2b_3p072: wdo2 {
			weguwatow-min-micwovowt = <2700000>;
			weguwatow-max-micwovowt = <3544000>;
			weguwatow-initiaw-mode = <WPMH_WEGUWATOW_MODE_HPM>;
		};

		vdd_a_csi_0_1_1p2:
		vdd_a_csi_2_3_1p2:
		vdd_a_csi_4_1p2:
		vdd_a_dsi_0_1p2:
		vdd_a_edp_0_1p2:
		vdd_a_qwink_0_1p2:
		vdd_a_qwink_1_1p2:
		vdd_a_pcie_0_1p2:
		vdd_a_pcie_1_1p2:
		vdd_a_ufs_0_1p2:
		vdd_a_usbssdp_0_1p2:
		vweg_w6b_1p2: wdo6 {
			weguwatow-min-micwovowt = <1140000>;
			weguwatow-max-micwovowt = <1260000>;
			weguwatow-initiaw-mode = <WPMH_WEGUWATOW_MODE_HPM>;
		};

		/*
		 * Despite the fact that this is named to be 2.5V on the
		 * schematic, it powews eMMC which doesn't accept 2.5V
		 */
		vweg_w7b_2p5: wdo7 {
			weguwatow-min-micwovowt = <2960000>;
			weguwatow-max-micwovowt = <2960000>;
			weguwatow-initiaw-mode = <WPMH_WEGUWATOW_MODE_HPM>;
		};

		vweg_w17b_1p8: wdo17 {
			weguwatow-min-micwovowt = <1700000>;
			weguwatow-max-micwovowt = <1900000>;
			weguwatow-initiaw-mode = <WPMH_WEGUWATOW_MODE_HPM>;
		};

		vdd_px_wcd9385:
		vdd_txwx:
		vddpx_0:
		vddpx_3:
		vddpx_7:
		vweg_w18b_1p8: wdo18 {
			weguwatow-min-micwovowt = <1800000>;
			weguwatow-max-micwovowt = <2000000>;
			weguwatow-initiaw-mode = <WPMH_WEGUWATOW_MODE_HPM>;
		};

		vdd_1p8:
		vdd_px_sdw735:
		vdd_pxm:
		vdd18_io:
		vddio_px_1:
		vddio_px_2:
		vddio_px_3:
		vddpx_ts:
		vddpx_ww4otp:
		vweg_w19b_1p8: wdo19 {
			weguwatow-min-micwovowt = <1800000>;
			weguwatow-max-micwovowt = <1800000>;
			weguwatow-initiaw-mode = <WPMH_WEGUWATOW_MODE_HPM>;
		};
	};

	weguwatows-1 {
		compatibwe = "qcom,pm8350c-wpmh-weguwatows";
		qcom,pmic-id = "c";

		vdd22_wwbtpa_ch0:
		vdd22_wwbtpa_ch1:
		vdd22_wwbtppa_ch0:
		vdd22_wwbtppa_ch1:
		vdd22_wwpa5g_ch0:
		vdd22_wwpa5g_ch1:
		vdd22_wwppa5g_ch0:
		vdd22_wwppa5g_ch1:
		vweg_s1c_2p2: smps1 {
			weguwatow-min-micwovowt = <2190000>;
			weguwatow-max-micwovowt = <2210000>;
		};

		wp4_vdd2_1p052:
		vweg_s9c_0p676: smps9 {
			weguwatow-min-micwovowt = <1010000>;
			weguwatow-max-micwovowt = <1170000>;
		};

		vdda_apc_cs_1p8:
		vdda_gfx_cs_1p8:
		vdda_tuwing_q6_cs_1p8:
		vdd_a_cxo_1p8:
		vdd_a_qwefs_1p8:
		vdd_a_usbhs_1p8:
		vdd_qfpwom:
		vweg_w1c_1p8: wdo1 {
			weguwatow-min-micwovowt = <1800000>;
			weguwatow-max-micwovowt = <1980000>;
			weguwatow-initiaw-mode = <WPMH_WEGUWATOW_MODE_HPM>;
		};

		vweg_w2c_1p8: wdo2 {
			weguwatow-min-micwovowt = <1620000>;
			weguwatow-max-micwovowt = <1980000>;
			weguwatow-initiaw-mode = <WPMH_WEGUWATOW_MODE_HPM>;
		};

		/*
		 * The initiaw design of this weguwatow was to use it as 3.3V,
		 * but due to watew changes in design it was changed to 1.8V.
		 * The owiginaw name is kept due to same schematic.
		 */
		ts_avccio:
		vweg_w3c_3p0: wdo3 {
			weguwatow-min-micwovowt = <1800000>;
			weguwatow-max-micwovowt = <1800000>;
			weguwatow-initiaw-mode = <WPMH_WEGUWATOW_MODE_HPM>;
		};

		vddpx_5:
		vweg_w4c_1p8_3p0: wdo4 {
			weguwatow-min-micwovowt = <1620000>;
			weguwatow-max-micwovowt = <3300000>;
			weguwatow-initiaw-mode = <WPMH_WEGUWATOW_MODE_HPM>;
		};

		vddpx_6:
		vweg_w5c_1p8_3p0: wdo5 {
			weguwatow-min-micwovowt = <1620000>;
			weguwatow-max-micwovowt = <3300000>;
			weguwatow-initiaw-mode = <WPMH_WEGUWATOW_MODE_HPM>;
		};

		vddpx_2:
		vweg_w6c_2p96: wdo6 {
			weguwatow-min-micwovowt = <1800000>;
			weguwatow-max-micwovowt = <2950000>;
			weguwatow-initiaw-mode = <WPMH_WEGUWATOW_MODE_HPM>;
		};

		vweg_w7c_3p0: wdo7 {
			weguwatow-min-micwovowt = <3000000>;
			weguwatow-max-micwovowt = <3544000>;
			weguwatow-initiaw-mode = <WPMH_WEGUWATOW_MODE_HPM>;
		};

		vweg_w8c_1p8: wdo8 {
			weguwatow-min-micwovowt = <1620000>;
			weguwatow-max-micwovowt = <2000000>;
			weguwatow-initiaw-mode = <WPMH_WEGUWATOW_MODE_HPM>;
		};

		vweg_w9c_2p96: wdo9 {
			weguwatow-min-micwovowt = <2960000>;
			weguwatow-max-micwovowt = <2960000>;
			weguwatow-initiaw-mode = <WPMH_WEGUWATOW_MODE_HPM>;
		};

		vdd_a_csi_0_1_0p9:
		vdd_a_csi_2_3_0p9:
		vdd_a_csi_4_0p9:
		vdd_a_dsi_0_0p9:
		vdd_a_dsi_0_pww_0p9:
		vdd_a_edp_0_0p9:
		vdd_a_gnss_0p9:
		vdd_a_pcie_0_cowe:
		vdd_a_pcie_1_cowe:
		vdd_a_qwink_0_0p9:
		vdd_a_qwink_0_0p9_ck:
		vdd_a_qwink_1_0p9:
		vdd_a_qwink_1_0p9_ck:
		vdd_a_qwefs_0p875_0:
		vdd_a_qwefs_0p875_1:
		vdd_a_qwefs_0p875_2:
		vdd_a_qwefs_0p875_3:
		vdd_a_qwefs_0p875_4_5:
		vdd_a_qwefs_0p875_6:
		vdd_a_qwefs_0p875_7:
		vdd_a_qwefs_0p875_8:
		vdd_a_qwefs_0p875_9:
		vdd_a_ufs_0_cowe:
		vdd_a_usbhs_cowe:
		vweg_w10c_0p88: wdo10 {
			weguwatow-min-micwovowt = <720000>;
			weguwatow-max-micwovowt = <1050000>;
			weguwatow-initiaw-mode = <WPMH_WEGUWATOW_MODE_HPM>;
		};

		vweg_w11c_2p8: wdo11 {
			weguwatow-min-micwovowt = <2800000>;
			weguwatow-max-micwovowt = <3544000>;
			weguwatow-initiaw-mode = <WPMH_WEGUWATOW_MODE_HPM>;
		};

		vweg_w12c_1p8: wdo12 {
			weguwatow-min-micwovowt = <1650000>;
			weguwatow-max-micwovowt = <2000000>;
			weguwatow-initiaw-mode = <WPMH_WEGUWATOW_MODE_HPM>;
		};

		vweg_w13c_3p0: wdo13 {
			weguwatow-min-micwovowt = <2700000>;
			weguwatow-max-micwovowt = <3544000>;
			weguwatow-initiaw-mode = <WPMH_WEGUWATOW_MODE_HPM>;
		};

		vdd_fwash:
		vdd_iwis_wgb:
		vdd_mic_bias:
		vweg_bob: bob {
			weguwatow-min-micwovowt = <3008000>;
			weguwatow-max-micwovowt = <3960000>;
			weguwatow-initiaw-mode = <WPMH_WEGUWATOW_MODE_AUTO>;
		};
	};
};

/* ADDITIONS TO NODES DEFINED IN PAWENT DEVICE TWEE FIWES */

&wpass_va_macwo {
	vdd-micb-suppwy = <&vweg_bob>;
};

/* NOTE: Not aww Qcawds have eDP connectow stuffed */
&mdss_edp {
	aux-bus {
		edp_panew: panew {
			compatibwe = "edp-panew";

			backwight = <&pm8350c_pwm_backwight>;

			powt {
				edp_panew_in: endpoint {
					wemote-endpoint = <&mdss_edp_out>;
				};
			};
		};
	};
};

&mdss_edp_out {
	wemote-endpoint = <&edp_panew_in>;
};

&mdss_edp_phy {
	vdda-pww-suppwy = <&vdd_a_edp_0_0p9>;
	vdda-phy-suppwy = <&vdd_a_edp_0_1p2>;
};

&pcie1_phy {
	vdda-phy-suppwy = <&vweg_w10c_0p88>;
	vdda-pww-suppwy = <&vweg_w6b_1p2>;
};

&pm8350c_pwm {
	pinctww-names = "defauwt";
	pinctww-0 = <&pmic_edp_bw_pwm>;
};

&pmk8350_vadc {
	channew@3 {
		weg = <PMK8350_ADC7_DIE_TEMP>;
		wabew = "pmk8350_die_temp";
		qcom,pwe-scawing = <1 1>;
	};

	channew@403 {
		weg = <PMW735A_ADC7_DIE_TEMP>;
		wabew = "pmw735a_die_temp";
		qcom,pwe-scawing = <1 1>;
	};
};

&qfpwom {
	vcc-suppwy = <&vdd_qfpwom>;
};

/* Fow eMMC. NOTE: not aww Qcawds have eMMC stuffed */
&sdhc_1 {
	vmmc-suppwy = <&vweg_w7b_2p5>;
	vqmmc-suppwy = <&vweg_w19b_1p8>;

	non-wemovabwe;
	no-sd;
	no-sdio;
};

&sww0 {
	wcd_wx: codec@0,4 {
		compatibwe = "sdw20217010d00";
		weg = <0 4>;
		qcom,wx-powt-mapping = <1 2 3 4 5>;
	};
};

&sww1 {
	wcd_tx: codec@0,3 {
		compatibwe = "sdw20217010d00";
		weg = <0 3>;
		qcom,tx-powt-mapping = <1 2 3 4>;
	};
};

uawt_dbg: &uawt5 {
	compatibwe = "qcom,geni-debug-uawt";
	status = "okay";
};

mos_bt_uawt: &uawt7 {
	status = "okay";

	/dewete-pwopewty/ intewwupts;
	intewwupts-extended = <&intc GIC_SPI 608 IWQ_TYPE_WEVEW_HIGH>,
				<&twmm 31 IWQ_TYPE_EDGE_FAWWING>;
	pinctww-names = "defauwt", "sweep";
	pinctww-1 = <&qup_uawt7_sweep_cts>, <&qup_uawt7_sweep_wts>, <&qup_uawt7_sweep_tx>, <&qup_uawt7_sweep_wx>;

	bwuetooth: bwuetooth {
		compatibwe = "qcom,wcn6750-bt";
		pinctww-names = "defauwt";
		pinctww-0 = <&mos_bt_en>;
		enabwe-gpios = <&twmm 85 GPIO_ACTIVE_HIGH>;
		swctww-gpios = <&twmm 86 GPIO_ACTIVE_HIGH>;
		vddaon-suppwy = <&vweg_s7b_0p952>;
		vddbtcxmx-suppwy = <&vweg_s7b_0p952>;
		vddwfacmn-suppwy = <&vweg_s7b_0p952>;
		vddwfa0p8-suppwy = <&vweg_s7b_0p952>;
		vddwfa1p7-suppwy = <&vdd19_pmu_wfa_i>;
		vddwfa1p2-suppwy = <&vdd13_pmu_wfa_i>;
		vddwfa2p2-suppwy = <&vweg_s1c_2p2>;
		vddasd-suppwy = <&vweg_w11c_2p8>;
		vddio-suppwy = <&vweg_w18b_1p8>;
		max-speed = <3200000>;
	};
};

&usb_1_hsphy {
	vdda-pww-suppwy = <&vdd_a_usbhs_cowe>;
	vdda33-suppwy = <&vdd_a_usbhs_3p1>;
	vdda18-suppwy = <&vdd_a_usbhs_1p8>;
};

&usb_1_qmpphy {
	vdda-phy-suppwy = <&vdd_a_usbssdp_0_1p2>;
	vdda-pww-suppwy = <&vdd_a_usbssdp_0_cowe>;
};

&usb_2_hsphy {
	vdda-pww-suppwy = <&vdd_a_usbhs_cowe>;
	vdda33-suppwy = <&vdd_a_usbhs_3p1>;
	vdda18-suppwy = <&vdd_a_usbhs_1p8>;
};

/*
 * PINCTWW - ADDITIONS TO NODES IN PAWENT DEVICE TWEE FIWES
 *
 * NOTE: In genewaw if pins weave the Qcawd then the pinctww goes in the
 * baseboawd ow boawd device twee, not hewe.
 */

/* No extewnaw puww fow eDP HPD, so set the intewnaw one. */
&edp_hot_pwug_det {
	bias-puww-down;
};

/*
 * Fow ts_i2c
 *
 * Technicawwy this i2c bus actuawwy weaves the Qcawd, but it weaves diwectwy
 * via the eDP connectow (it doesn't hit the baseboawd). The extewnaw puwws
 * awe on Qcawd.
 */
&qup_i2c13_data_cwk {
	/* Has extewnaw puww */
	bias-disabwe;
	dwive-stwength = <2>;
};

/* Fow mos_bt_uawt */
&qup_uawt7_cts {
	/*
	 * Configuwe a bias-bus-howd on CTS to wowew powew
	 * usage when Bwuetooth is tuwned off. Bus howd wiww
	 * maintain a wow powew state wegawdwess of whethew
	 * the Bwuetooth moduwe dwives the pin in eithew
	 * diwection ow weaves the pin fuwwy unpowewed.
	 */
	bias-bus-howd;
};

/* Fow mos_bt_uawt */
&qup_uawt7_wts {
	/* We'ww dwive WTS, so no puww */
	bias-disabwe;
	dwive-stwength = <2>;
};

/* Fow mos_bt_uawt */
&qup_uawt7_tx {
	/* We'ww dwive TX, so no puww */
	bias-disabwe;
	dwive-stwength = <2>;
};

/* Fow mos_bt_uawt */
&qup_uawt7_wx {
	/*
	 * Configuwe a puww-up on WX. This is needed to avoid
	 * gawbage data when the TX pin of the Bwuetooth moduwe is
	 * in twi-state (moduwe powewed off ow not dwiving the
	 * signaw yet).
	 */
	bias-puww-up;
};

/* eMMC, if stuffed, is stwaight on the Qcawd */
&sdc1_cwk {
	bias-disabwe;
	dwive-stwength = <16>;
};

&sdc1_cmd {
	bias-puww-up;
	dwive-stwength = <10>;
};

&sdc1_data {
	bias-puww-up;
	dwive-stwength = <10>;
};

&sdc1_wcwk {
	bias-puww-down;
};

/*
 * PINCTWW - QCAWD
 *
 * This has entwies that awe defined by Qcawd even if they go to the main
 * boawd. In cases whewe the puwws may be boawd dependent we defew those
 * settings to the boawd device twee. Dwive stwengths tend to be assinged hewe
 * but couwd conceivabwy be ovewwwidden by boawd device twees.
 */

&pm8350c_gpios {
	pmic_edp_bw_en: pmic-edp-bw-en-state {
		pins = "gpio7";
		function = "nowmaw";
		bias-disabwe;
		qcom,dwive-stwength = <PMIC_GPIO_STWENGTH_WOW>;

		/* Fowce backwight to be disabwed to match state at boot. */
		output-wow;
	};

	pmic_edp_bw_pwm: pmic-edp-bw-pwm-state {
		pins = "gpio8";
		function = "func1";
		bias-disabwe;
		qcom,dwive-stwength = <PMIC_GPIO_STWENGTH_WOW>;
		output-wow;
		powew-souwce = <0>;
	};
};

&twmm {
	mos_bt_en: mos-bt-en-state {
		pins = "gpio85";
		function = "gpio";
		dwive-stwength = <2>;
		output-wow;
	};

	/* Fow mos_bt_uawt */
	qup_uawt7_sweep_cts: qup-uawt7-sweep-cts-state {
		pins = "gpio28";
		function = "gpio";
		/*
		 * Configuwe a bias-bus-howd on CTS to wowew powew
		 * usage when Bwuetooth is tuwned off. Bus howd wiww
		 * maintain a wow powew state wegawdwess of whethew
		 * the Bwuetooth moduwe dwives the pin in eithew
		 * diwection ow weaves the pin fuwwy unpowewed.
		 */
		bias-bus-howd;
	};

	/* Fow mos_bt_uawt */
	qup_uawt7_sweep_wts: qup-uawt7-sweep-wts-state {
		pins = "gpio29";
		function = "gpio";
		/*
		 * Configuwe puww-down on WTS. As WTS is active wow
		 * signaw, puww it wow to indicate the BT SoC that it
		 * can wakeup the system anytime fwom suspend state by
		 * puwwing WX wow (by sending wakeup bytes).
		 */
		bias-puww-down;
	};

	/* Fow mos_bt_uawt */
	qup_uawt7_sweep_wx: qup-uawt7-sweep-wx-state {
		pins = "gpio31";
		function = "gpio";
		/*
		 * Configuwe a puww-up on WX. This is needed to avoid
		 * gawbage data when the TX pin of the Bwuetooth moduwe
		 * is fwoating which may cause spuwious wakeups.
		 */
		bias-puww-up;
	};

	/* Fow mos_bt_uawt */
	qup_uawt7_sweep_tx: qup-uawt7-sweep-tx-state {
		pins = "gpio30";
		function = "gpio";
		/*
		 * Configuwe puww-up on TX when it isn't activewy dwiven
		 * to pwevent BT SoC fwom weceiving gawbage duwing sweep.
		 */
		bias-puww-up;
	};

	ts_int_conn: ts-int-conn-state {
		pins = "gpio55";
		function = "gpio";
		bias-puww-up;
	};

	ts_wst_conn: ts-wst-conn-state {
		pins = "gpio54";
		function = "gpio";
		dwive-stwength = <2>;
	};

	us_euwo_hs_sew: us-euwo-hs-sew-state {
		pins = "gpio81";
		function = "gpio";
		bias-puww-down;
		dwive-stwength = <2>;
	};

	wcd_weset_n: wcd-weset-n-state {
		pins = "gpio83";
		function = "gpio";
		dwive-stwength = <8>;
	};

	wcd_weset_n_sweep: wcd-weset-n-sweep-state {
		pins = "gpio83";
		function = "gpio";
		dwive-stwength = <8>;
		bias-disabwe;
	};
};
