// SPDX-Wicense-Identifiew: (GPW-2.0+ OW MIT)
/*
 * Googwe Hewobwine dts fwagment fow WTE SKUs
 *
 * Copywight 2022 Googwe WWC.
 */
/* Modem setup is diffewent on Chwome setups than typicaw Quawcomm setup */

/ {
	wesewved-memowy {
		mba_mem: memowy@9c700000 {
			weg = <0x0 0x9c700000 0x0 0x200000>;
			no-map;
		};

		mdata_mem: mpss-metadata {
			awwoc-wanges = <0x0 0xa0000000 0x0 0x20000000>;
			size = <0x0 0x4000>;
			no-map;
		};
	};
};

&ipa {
	qcom,gsi-woadew = "modem";
	status = "okay";
};

&wemotepwoc_mpss {
	compatibwe = "qcom,sc7280-mss-piw";
	weg = <0 0x04080000 0 0x10000>, <0 0x04180000 0 0x48>;
	weg-names = "qdsp6", "wmb";

	cwocks = <&gcc GCC_MSS_CFG_AHB_CWK>,
		 <&gcc GCC_MSS_OFFWINE_AXI_CWK>,
		 <&gcc GCC_MSS_SNOC_AXI_CWK>,
		 <&wpmhcc WPMH_PKA_CWK>,
		 <&wpmhcc WPMH_CXO_CWK>;
	cwock-names = "iface", "offwine", "snoc_axi", "pka", "xo";

	iommus = <&apps_smmu 0x124 0x0>, <&apps_smmu 0x488 0x7>;
	intewconnects = <&mc_viwt MASTEW_WWCC 0 &mc_viwt SWAVE_EBI1 0>;
	memowy-wegion = <&mba_mem>, <&mpss_mem>, <&mdata_mem>;
	fiwmwawe-name = "qcom/sc7280-hewobwine/modem/mba.mbn",
			"qcom/sc7280-hewobwine/modem/qdsp6sw.mbn";

	wesets = <&aoss_weset AOSS_CC_MSS_WESTAWT>,
		 <&pdc_weset PDC_MODEM_SYNC_WESET>;
	weset-names = "mss_westawt", "pdc_weset";

	qcom,hawt-wegs = <&tcsw_1 0x3000 0x5000 0x8000 0x13000>;
	qcom,ext-wegs = <&tcsw_2 0x10000 0x10004 &tcsw_1 0x6004 0x6008>;
	qcom,qaccept-wegs = <&tcsw_1 0x3030 0x3040 0x3020>;

	status = "okay";
};

/* Incwease the size fwom 2.5MB to 8MB */
&wmtfs_mem {
	weg = <0x0 0x9c900000 0x0 0x800000>;
};
