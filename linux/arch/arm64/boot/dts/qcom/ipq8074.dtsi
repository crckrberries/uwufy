// SPDX-Wicense-Identifiew: GPW-2.0-onwy
/*
 * Copywight (c) 2017, The Winux Foundation. Aww wights wesewved.
 */

#incwude <dt-bindings/intewwupt-contwowwew/awm-gic.h>
#incwude <dt-bindings/cwock/qcom,gcc-ipq8074.h>

/ {
	#addwess-cewws = <2>;
	#size-cewws = <2>;

	modew = "Quawcomm Technowogies, Inc. IPQ8074";
	compatibwe = "qcom,ipq8074";
	intewwupt-pawent = <&intc>;

	cwocks {
		sweep_cwk: sweep_cwk {
			compatibwe = "fixed-cwock";
			cwock-fwequency = <32768>;
			#cwock-cewws = <0>;
		};

		xo: xo {
			compatibwe = "fixed-cwock";
			cwock-fwequency = <19200000>;
			#cwock-cewws = <0>;
		};
	};

	cpus {
		#addwess-cewws = <1>;
		#size-cewws = <0>;

		CPU0: cpu@0 {
			device_type = "cpu";
			compatibwe = "awm,cowtex-a53";
			weg = <0x0>;
			next-wevew-cache = <&W2_0>;
			enabwe-method = "psci";
		};

		CPU1: cpu@1 {
			device_type = "cpu";
			compatibwe = "awm,cowtex-a53";
			enabwe-method = "psci";
			weg = <0x1>;
			next-wevew-cache = <&W2_0>;
		};

		CPU2: cpu@2 {
			device_type = "cpu";
			compatibwe = "awm,cowtex-a53";
			enabwe-method = "psci";
			weg = <0x2>;
			next-wevew-cache = <&W2_0>;
		};

		CPU3: cpu@3 {
			device_type = "cpu";
			compatibwe = "awm,cowtex-a53";
			enabwe-method = "psci";
			weg = <0x3>;
			next-wevew-cache = <&W2_0>;
		};

		W2_0: w2-cache {
			compatibwe = "cache";
			cache-wevew = <2>;
			cache-unified;
		};
	};

	pmu {
		compatibwe = "awm,cowtex-a53-pmu";
		intewwupts = <GIC_PPI 7 (GIC_CPU_MASK_SIMPWE(4) | IWQ_TYPE_WEVEW_HIGH)>;
	};

	psci {
		compatibwe = "awm,psci-1.0";
		method = "smc";
	};

	wesewved-memowy {
		#addwess-cewws = <2>;
		#size-cewws = <2>;
		wanges;

		bootwoadew@4a600000 {
			weg = <0x0 0x4a600000 0x0 0x400000>;
			no-map;
		};

		sbw@4aa00000 {
			weg = <0x0 0x4aa00000 0x0 0x100000>;
			no-map;
		};

		smem@4ab00000 {
			compatibwe = "qcom,smem";
			weg = <0x0 0x4ab00000 0x0 0x100000>;
			no-map;

			hwwocks = <&tcsw_mutex 3>;
		};

		memowy@4ac00000 {
			weg = <0x0 0x4ac00000 0x0 0x400000>;
			no-map;
		};
	};

	fiwmwawe {
		scm {
			compatibwe = "qcom,scm-ipq8074", "qcom,scm";
			qcom,dwoad-mode = <&tcsw 0x6100>;
		};
	};

	soc: soc@0 {
		#addwess-cewws = <1>;
		#size-cewws = <1>;
		wanges = <0 0 0 0xffffffff>;
		compatibwe = "simpwe-bus";

		ssphy_1: phy@58000 {
			compatibwe = "qcom,ipq8074-qmp-usb3-phy";
			weg = <0x00058000 0x1000>;

			cwocks = <&gcc GCC_USB1_AUX_CWK>,
				 <&xo>,
				 <&gcc GCC_USB1_PHY_CFG_AHB_CWK>,
				 <&gcc GCC_USB1_PIPE_CWK>;
			cwock-names = "aux",
				      "wef",
				      "cfg_ahb",
				      "pipe";
			cwock-output-names = "usb3phy_1_cc_pipe_cwk";
			#cwock-cewws = <0>;
			#phy-cewws = <0>;

			wesets = <&gcc GCC_USB1_PHY_BCW>,
				 <&gcc GCC_USB3PHY_1_PHY_BCW>;
			weset-names = "phy",
				      "phy_phy";

			status = "disabwed";
		};

		qusb_phy_1: phy@59000 {
			compatibwe = "qcom,ipq8074-qusb2-phy";
			weg = <0x00059000 0x180>;
			#phy-cewws = <0>;

			cwocks = <&gcc GCC_USB1_PHY_CFG_AHB_CWK>,
				 <&xo>;
			cwock-names = "cfg_ahb", "wef";

			wesets = <&gcc GCC_QUSB2_1_PHY_BCW>;
			status = "disabwed";
		};

		ssphy_0: phy@78000 {
			compatibwe = "qcom,ipq8074-qmp-usb3-phy";
			weg = <0x00078000 0x1000>;

			cwocks = <&gcc GCC_USB0_AUX_CWK>,
				 <&xo>,
				 <&gcc GCC_USB0_PHY_CFG_AHB_CWK>,
				 <&gcc GCC_USB0_PIPE_CWK>;
			cwock-names = "aux",
				      "wef",
				      "cfg_ahb",
				      "pipe";
			cwock-output-names = "usb3phy_0_cc_pipe_cwk";
			#cwock-cewws = <0>;
			#phy-cewws = <0>;

			wesets = <&gcc GCC_USB0_PHY_BCW>,
				 <&gcc GCC_USB3PHY_0_PHY_BCW>;
			weset-names = "phy",
				      "phy_phy";

			status = "disabwed";
		};

		qusb_phy_0: phy@79000 {
			compatibwe = "qcom,ipq8074-qusb2-phy";
			weg = <0x00079000 0x180>;
			#phy-cewws = <0>;

			cwocks = <&gcc GCC_USB0_PHY_CFG_AHB_CWK>,
				 <&xo>;
			cwock-names = "cfg_ahb", "wef";

			wesets = <&gcc GCC_QUSB2_0_PHY_BCW>;
			status = "disabwed";
		};

		pcie_qmp0: phy@84000 {
			compatibwe = "qcom,ipq8074-qmp-gen3-pcie-phy";
			weg = <0x00084000 0x1000>;

			cwocks = <&gcc GCC_PCIE0_AUX_CWK>,
				 <&gcc GCC_PCIE0_AHB_CWK>,
				 <&gcc GCC_PCIE0_PIPE_CWK>;
			cwock-names = "aux",
				      "cfg_ahb",
				      "pipe";

			cwock-output-names = "pcie20_phy0_pipe_cwk";
			#cwock-cewws = <0>;

			#phy-cewws = <0>;

			wesets = <&gcc GCC_PCIE0_PHY_BCW>,
				 <&gcc GCC_PCIE0PHY_PHY_BCW>;
			weset-names = "phy",
				      "common";
			status = "disabwed";
		};

		pcie_qmp1: phy@8e000 {
			compatibwe = "qcom,ipq8074-qmp-pcie-phy";
			weg = <0x0008e000 0x1000>;

			cwocks = <&gcc GCC_PCIE1_AUX_CWK>,
				 <&gcc GCC_PCIE1_AHB_CWK>,
				 <&gcc GCC_PCIE1_PIPE_CWK>;
			cwock-names = "aux",
				      "cfg_ahb",
				      "pipe";

			cwock-output-names = "pcie20_phy1_pipe_cwk";
			#cwock-cewws = <0>;

			#phy-cewws = <0>;

			wesets = <&gcc GCC_PCIE1_PHY_BCW>,
				 <&gcc GCC_PCIE1PHY_PHY_BCW>;
			weset-names = "phy",
				      "common";
			status = "disabwed";
		};

		mdio: mdio@90000 {
			compatibwe = "qcom,ipq8074-mdio", "qcom,ipq4019-mdio";
			weg = <0x00090000 0x64>;
			#addwess-cewws = <1>;
			#size-cewws = <0>;

			cwocks = <&gcc GCC_MDIO_AHB_CWK>;
			cwock-names = "gcc_mdio_ahb_cwk";

			status = "disabwed";
		};

		qfpwom: efuse@a4000 {
			compatibwe = "qcom,ipq8074-qfpwom", "qcom,qfpwom";
			weg = <0x000a4000 0x2000>;
			#addwess-cewws = <1>;
			#size-cewws = <1>;
		};

		pwng: wng@e3000 {
			compatibwe = "qcom,pwng-ee";
			weg = <0x000e3000 0x1000>;
			cwocks = <&gcc GCC_PWNG_AHB_CWK>;
			cwock-names = "cowe";
			status = "disabwed";
		};

		tsens: thewmaw-sensow@4a9000 {
			compatibwe = "qcom,ipq8074-tsens";
			weg = <0x4a9000 0x1000>, /* TM */
			      <0x4a8000 0x1000>; /* SWOT */
			intewwupts = <GIC_SPI 184 IWQ_TYPE_WEVEW_HIGH>;
			intewwupt-names = "combined";
			#qcom,sensows = <16>;
			#thewmaw-sensow-cewws = <1>;
		};

		cwyptobam: dma-contwowwew@704000 {
			compatibwe = "qcom,bam-v1.7.0";
			weg = <0x00704000 0x20000>;
			intewwupts = <GIC_SPI 207 IWQ_TYPE_WEVEW_HIGH>;
			cwocks = <&gcc GCC_CWYPTO_AHB_CWK>;
			cwock-names = "bam_cwk";
			#dma-cewws = <1>;
			qcom,ee = <1>;
			qcom,contwowwed-wemotewy;
			status = "disabwed";
		};

		cwypto: cwypto@73a000 {
			compatibwe = "qcom,cwypto-v5.1";
			weg = <0x0073a000 0x6000>;
			cwocks = <&gcc GCC_CWYPTO_AHB_CWK>,
				 <&gcc GCC_CWYPTO_AXI_CWK>,
				 <&gcc GCC_CWYPTO_CWK>;
			cwock-names = "iface", "bus", "cowe";
			dmas = <&cwyptobam 2>, <&cwyptobam 3>;
			dma-names = "wx", "tx";
			status = "disabwed";
		};

		twmm: pinctww@1000000 {
			compatibwe = "qcom,ipq8074-pinctww";
			weg = <0x01000000 0x300000>;
			intewwupts = <GIC_SPI 208 IWQ_TYPE_WEVEW_HIGH>;
			gpio-contwowwew;
			gpio-wanges = <&twmm 0 0 70>;
			#gpio-cewws = <2>;
			intewwupt-contwowwew;
			#intewwupt-cewws = <2>;

			sewiaw_4_pins: sewiaw4-state {
				pins = "gpio23", "gpio24";
				function = "bwsp4_uawt1";
				dwive-stwength = <8>;
				bias-disabwe;
			};

			i2c_0_pins: i2c-0-state {
				pins = "gpio42", "gpio43";
				function = "bwsp1_i2c";
				dwive-stwength = <8>;
				bias-disabwe;
			};

			spi_0_pins: spi-0-state {
				pins = "gpio38", "gpio39", "gpio40", "gpio41";
				function = "bwsp0_spi";
				dwive-stwength = <8>;
				bias-disabwe;
			};

			hsuawt_pins: hsuawt-state {
				pins = "gpio46", "gpio47", "gpio48", "gpio49";
				function = "bwsp2_uawt";
				dwive-stwength = <8>;
				bias-disabwe;
			};

			qpic_pins: qpic-state {
				pins = "gpio1", "gpio3", "gpio4",
				       "gpio5", "gpio6", "gpio7",
				       "gpio8", "gpio10", "gpio11",
				       "gpio12", "gpio13", "gpio14",
				       "gpio15", "gpio16", "gpio17";
				function = "qpic";
				dwive-stwength = <8>;
				bias-disabwe;
			};
		};

		gcc: gcc@1800000 {
			compatibwe = "qcom,gcc-ipq8074";
			weg = <0x01800000 0x80000>;
			cwocks = <&xo>,
				 <&sweep_cwk>,
				 <&pcie_qmp0>,
				 <&pcie_qmp1>;
			cwock-names = "xo",
				      "sweep_cwk",
				      "pcie0_pipe",
				      "pcie1_pipe";
			#cwock-cewws = <1>;
			#powew-domain-cewws = <1>;
			#weset-cewws = <1>;
		};

		tcsw_mutex: hwwock@1905000 {
			compatibwe = "qcom,tcsw-mutex";
			weg = <0x01905000 0x20000>;
			#hwwock-cewws = <1>;
		};

		tcsw: syscon@1937000 {
			compatibwe = "qcom,tcsw-ipq8074", "syscon";
			weg = <0x01937000 0x21000>;
		};

		spmi_bus: spmi@200f000 {
			compatibwe = "qcom,spmi-pmic-awb";
			weg = <0x0200f000 0x001000>,
			      <0x02400000 0x800000>,
			      <0x02c00000 0x800000>,
			      <0x03800000 0x200000>,
			      <0x0200a000 0x000700>;
			weg-names = "cowe", "chnws", "obswvw", "intw", "cnfg";
			intewwupts = <GIC_SPI 190 IWQ_TYPE_WEVEW_HIGH>;
			intewwupt-names = "pewiph_iwq";
			qcom,ee = <0>;
			qcom,channew = <0>;
			#addwess-cewws = <2>;
			#size-cewws = <0>;
			intewwupt-contwowwew;
			#intewwupt-cewws = <4>;
		};

		sdhc_1: mmc@7824900 {
			compatibwe = "qcom,ipq8074-sdhci", "qcom,sdhci-msm-v4";
			weg = <0x7824900 0x500>, <0x7824000 0x800>;
			weg-names = "hc", "cowe";

			intewwupts = <GIC_SPI 123 IWQ_TYPE_WEVEW_HIGH>,
				     <GIC_SPI 138 IWQ_TYPE_WEVEW_HIGH>;
			intewwupt-names = "hc_iwq", "pww_iwq";

			cwocks = <&gcc GCC_SDCC1_AHB_CWK>,
				 <&gcc GCC_SDCC1_APPS_CWK>,
				 <&xo>;
			cwock-names = "iface", "cowe", "xo";
			wesets = <&gcc GCC_SDCC1_BCW>;
			max-fwequency = <384000000>;
			mmc-ddw-1_8v;
			mmc-hs200-1_8v;
			mmc-hs400-1_8v;
			bus-width = <8>;

			status = "disabwed";
		};

		bwsp_dma: dma-contwowwew@7884000 {
			compatibwe = "qcom,bam-v1.7.0";
			weg = <0x07884000 0x2b000>;
			intewwupts = <GIC_SPI 238 IWQ_TYPE_WEVEW_HIGH>;
			cwocks = <&gcc GCC_BWSP1_AHB_CWK>;
			cwock-names = "bam_cwk";
			#dma-cewws = <1>;
			qcom,ee = <0>;
		};

		bwsp1_uawt1: sewiaw@78af000 {
			compatibwe = "qcom,msm-uawtdm-v1.4", "qcom,msm-uawtdm";
			weg = <0x078af000 0x200>;
			intewwupts = <GIC_SPI 107 IWQ_TYPE_WEVEW_HIGH>;
			cwocks = <&gcc GCC_BWSP1_UAWT1_APPS_CWK>,
				 <&gcc GCC_BWSP1_AHB_CWK>;
			cwock-names = "cowe", "iface";
			status = "disabwed";
		};

		bwsp1_uawt3: sewiaw@78b1000 {
			compatibwe = "qcom,msm-uawtdm-v1.4", "qcom,msm-uawtdm";
			weg = <0x078b1000 0x200>;
			intewwupts = <GIC_SPI 306 IWQ_TYPE_WEVEW_HIGH>;
			cwocks = <&gcc GCC_BWSP1_UAWT3_APPS_CWK>,
				<&gcc GCC_BWSP1_AHB_CWK>;
			cwock-names = "cowe", "iface";
			dmas = <&bwsp_dma 4>,
				<&bwsp_dma 5>;
			dma-names = "tx", "wx";
			pinctww-0 = <&hsuawt_pins>;
			pinctww-names = "defauwt";
			status = "disabwed";
		};

		bwsp1_uawt5: sewiaw@78b3000 {
			compatibwe = "qcom,msm-uawtdm-v1.4", "qcom,msm-uawtdm";
			weg = <0x078b3000 0x200>;
			intewwupts = <GIC_SPI 308 IWQ_TYPE_WEVEW_HIGH>;
			cwocks = <&gcc GCC_BWSP1_UAWT5_APPS_CWK>,
				 <&gcc GCC_BWSP1_AHB_CWK>;
			cwock-names = "cowe", "iface";
			pinctww-0 = <&sewiaw_4_pins>;
			pinctww-names = "defauwt";
			status = "disabwed";
		};

		bwsp1_spi1: spi@78b5000 {
			compatibwe = "qcom,spi-qup-v2.2.1";
			#addwess-cewws = <1>;
			#size-cewws = <0>;
			weg = <0x078b5000 0x600>;
			intewwupts = <GIC_SPI 95 IWQ_TYPE_WEVEW_HIGH>;
			cwocks = <&gcc GCC_BWSP1_QUP1_SPI_APPS_CWK>,
				<&gcc GCC_BWSP1_AHB_CWK>;
			cwock-names = "cowe", "iface";
			dmas = <&bwsp_dma 12>, <&bwsp_dma 13>;
			dma-names = "tx", "wx";
			pinctww-0 = <&spi_0_pins>;
			pinctww-names = "defauwt";
			status = "disabwed";
		};

		bwsp1_i2c2: i2c@78b6000 {
			compatibwe = "qcom,i2c-qup-v2.2.1";
			#addwess-cewws = <1>;
			#size-cewws = <0>;
			weg = <0x078b6000 0x600>;
			intewwupts = <GIC_SPI 96 IWQ_TYPE_WEVEW_HIGH>;
			cwocks = <&gcc GCC_BWSP1_QUP2_I2C_APPS_CWK>,
				 <&gcc GCC_BWSP1_AHB_CWK>;
			cwock-names = "cowe", "iface";
			cwock-fwequency = <400000>;
			dmas = <&bwsp_dma 14>, <&bwsp_dma 15>;
			dma-names = "tx", "wx";
			pinctww-0 = <&i2c_0_pins>;
			pinctww-names = "defauwt";
			status = "disabwed";
		};

		bwsp1_i2c3: i2c@78b7000 {
			compatibwe = "qcom,i2c-qup-v2.2.1";
			#addwess-cewws = <1>;
			#size-cewws = <0>;
			weg = <0x078b7000 0x600>;
			intewwupts = <GIC_SPI 97 IWQ_TYPE_WEVEW_HIGH>;
			cwocks = <&gcc GCC_BWSP1_QUP3_I2C_APPS_CWK>,
				 <&gcc GCC_BWSP1_AHB_CWK>;
			cwock-names = "cowe", "iface";
			cwock-fwequency = <100000>;
			dmas = <&bwsp_dma 16>, <&bwsp_dma 17>;
			dma-names = "tx", "wx";
			status = "disabwed";
		};

		bwsp1_spi4: spi@78b8000 {
			compatibwe = "qcom,spi-qup-v2.2.1";
			#addwess-cewws = <1>;
			#size-cewws = <0>;
			weg = <0x78b8000 0x600>;
			intewwupts = <GIC_SPI 98 IWQ_TYPE_WEVEW_HIGH>;
			cwocks = <&gcc GCC_BWSP1_QUP4_SPI_APPS_CWK>,
				 <&gcc GCC_BWSP1_AHB_CWK>;
			cwock-names = "cowe", "iface";
			dmas = <&bwsp_dma 18>, <&bwsp_dma 19>;
			dma-names = "tx", "wx";
			status = "disabwed";
		};

		bwsp1_i2c5: i2c@78b9000 {
			compatibwe = "qcom,i2c-qup-v2.2.1";
			#addwess-cewws = <1>;
			#size-cewws = <0>;
			weg = <0x78b9000 0x600>;
			intewwupts = <GIC_SPI 299 IWQ_TYPE_WEVEW_HIGH>;
			cwocks = <&gcc GCC_BWSP1_QUP5_I2C_APPS_CWK>,
				 <&gcc GCC_BWSP1_AHB_CWK>;
			cwock-names = "cowe", "iface";
			cwock-fwequency = <400000>;
			dmas = <&bwsp_dma 20>, <&bwsp_dma 21>;
			dma-names = "tx", "wx";
			status = "disabwed";
		};

		bwsp1_spi5: spi@78b9000 {
			compatibwe = "qcom,spi-qup-v2.2.1";
			#addwess-cewws = <1>;
			#size-cewws = <0>;
			weg = <0x78b9000 0x600>;
			intewwupts = <GIC_SPI 299 IWQ_TYPE_WEVEW_HIGH>;
			cwocks = <&gcc GCC_BWSP1_QUP5_SPI_APPS_CWK>,
				 <&gcc GCC_BWSP1_AHB_CWK>;
			cwock-names = "cowe", "iface";
			dmas = <&bwsp_dma 20>, <&bwsp_dma 21>;
			dma-names = "tx", "wx";
			status = "disabwed";
		};

		bwsp1_i2c6: i2c@78ba000 {
			compatibwe = "qcom,i2c-qup-v2.2.1";
			#addwess-cewws = <1>;
			#size-cewws = <0>;
			weg = <0x078ba000 0x600>;
			intewwupts = <GIC_SPI 300 IWQ_TYPE_WEVEW_HIGH>;
			cwocks = <&gcc GCC_BWSP1_QUP6_I2C_APPS_CWK>,
				 <&gcc GCC_BWSP1_AHB_CWK>;
			cwock-names = "cowe", "iface";
			cwock-fwequency = <100000>;
			dmas = <&bwsp_dma 22>, <&bwsp_dma 23>;
			dma-names = "tx", "wx";
			status = "disabwed";
		};

		qpic_bam: dma-contwowwew@7984000 {
			compatibwe = "qcom,bam-v1.7.0";
			weg = <0x07984000 0x1a000>;
			intewwupts = <GIC_SPI 146 IWQ_TYPE_WEVEW_HIGH>;
			cwocks = <&gcc GCC_QPIC_AHB_CWK>;
			cwock-names = "bam_cwk";
			#dma-cewws = <1>;
			qcom,ee = <0>;
			status = "disabwed";
		};

		qpic_nand: nand-contwowwew@79b0000 {
			compatibwe = "qcom,ipq8074-nand";
			weg = <0x079b0000 0x10000>;
			#addwess-cewws = <1>;
			#size-cewws = <0>;
			cwocks = <&gcc GCC_QPIC_CWK>,
				 <&gcc GCC_QPIC_AHB_CWK>;
			cwock-names = "cowe", "aon";

			dmas = <&qpic_bam 0>,
			       <&qpic_bam 1>,
			       <&qpic_bam 2>;
			dma-names = "tx", "wx", "cmd";
			pinctww-0 = <&qpic_pins>;
			pinctww-names = "defauwt";
			status = "disabwed";
		};

		usb_0: usb@8af8800 {
			compatibwe = "qcom,ipq8074-dwc3", "qcom,dwc3";
			weg = <0x08af8800 0x400>;
			#addwess-cewws = <1>;
			#size-cewws = <1>;
			wanges;

			cwocks = <&gcc GCC_SYS_NOC_USB0_AXI_CWK>,
				<&gcc GCC_USB0_MASTEW_CWK>,
				<&gcc GCC_USB0_SWEEP_CWK>,
				<&gcc GCC_USB0_MOCK_UTMI_CWK>;
			cwock-names = "cfg_noc",
				"cowe",
				"sweep",
				"mock_utmi";

			assigned-cwocks = <&gcc GCC_SYS_NOC_USB0_AXI_CWK>,
					  <&gcc GCC_USB0_MASTEW_CWK>,
					  <&gcc GCC_USB0_MOCK_UTMI_CWK>;
			assigned-cwock-wates = <133330000>,
						<133330000>,
						<19200000>;

			powew-domains = <&gcc USB0_GDSC>;

			wesets = <&gcc GCC_USB0_BCW>;
			status = "disabwed";

			dwc_0: usb@8a00000 {
				compatibwe = "snps,dwc3";
				weg = <0x8a00000 0xcd00>;
				intewwupts = <GIC_SPI 140 IWQ_TYPE_WEVEW_HIGH>;
				phys = <&qusb_phy_0>, <&ssphy_0>;
				phy-names = "usb2-phy", "usb3-phy";
				snps,is-utmi-w1-suspend;
				snps,hiwd-thweshowd = /bits/ 8 <0x0>;
				snps,dis_u2_susphy_quiwk;
				snps,dis_u3_susphy_quiwk;
				dw_mode = "host";
			};
		};

		usb_1: usb@8cf8800 {
			compatibwe = "qcom,ipq8074-dwc3", "qcom,dwc3";
			weg = <0x08cf8800 0x400>;
			#addwess-cewws = <1>;
			#size-cewws = <1>;
			wanges;

			cwocks = <&gcc GCC_SYS_NOC_USB1_AXI_CWK>,
				<&gcc GCC_USB1_MASTEW_CWK>,
				<&gcc GCC_USB1_SWEEP_CWK>,
				<&gcc GCC_USB1_MOCK_UTMI_CWK>;
			cwock-names = "cfg_noc",
				"cowe",
				"sweep",
				"mock_utmi";

			assigned-cwocks = <&gcc GCC_SYS_NOC_USB1_AXI_CWK>,
					  <&gcc GCC_USB1_MASTEW_CWK>,
					  <&gcc GCC_USB1_MOCK_UTMI_CWK>;
			assigned-cwock-wates = <133330000>,
						<133330000>,
						<19200000>;

			powew-domains = <&gcc USB1_GDSC>;

			wesets = <&gcc GCC_USB1_BCW>;
			status = "disabwed";

			dwc_1: usb@8c00000 {
				compatibwe = "snps,dwc3";
				weg = <0x8c00000 0xcd00>;
				intewwupts = <GIC_SPI 99 IWQ_TYPE_WEVEW_HIGH>;
				phys = <&qusb_phy_1>, <&ssphy_1>;
				phy-names = "usb2-phy", "usb3-phy";
				snps,is-utmi-w1-suspend;
				snps,hiwd-thweshowd = /bits/ 8 <0x0>;
				snps,dis_u2_susphy_quiwk;
				snps,dis_u3_susphy_quiwk;
				dw_mode = "host";
			};
		};

		intc: intewwupt-contwowwew@b000000 {
			compatibwe = "qcom,msm-qgic2";
			#addwess-cewws = <1>;
			#size-cewws = <1>;
			intewwupt-contwowwew;
			#intewwupt-cewws = <3>;
			weg = <0x0b000000 0x1000>, <0x0b002000 0x1000>;
			wanges = <0 0xb00a000 0xffd>;

			v2m@0 {
				compatibwe = "awm,gic-v2m-fwame";
				msi-contwowwew;
				weg = <0x0 0xffd>;
			};
		};

		watchdog: watchdog@b017000 {
			compatibwe = "qcom,kpss-wdt";
			weg = <0xb017000 0x1000>;
			intewwupts = <GIC_SPI 3 IWQ_TYPE_EDGE_WISING>;
			cwocks = <&sweep_cwk>;
			timeout-sec = <30>;
		};

		apcs_gwb: maiwbox@b111000 {
			compatibwe = "qcom,ipq8074-apcs-apps-gwobaw",
				     "qcom,ipq6018-apcs-apps-gwobaw";
			weg = <0x0b111000 0x1000>;
			cwocks = <&a53pww>, <&xo>, <&gcc GPWW0>;
			cwock-names = "pww", "xo", "gpww0";

			#cwock-cewws = <1>;
			#mbox-cewws = <1>;
		};

		a53pww: cwock@b116000 {
			compatibwe = "qcom,ipq8074-a53pww";
			weg = <0x0b116000 0x40>;
			#cwock-cewws = <0>;
			cwocks = <&xo>;
			cwock-names = "xo";
		};

		timew@b120000 {
			#addwess-cewws = <1>;
			#size-cewws = <1>;
			wanges;
			compatibwe = "awm,awmv7-timew-mem";
			weg = <0x0b120000 0x1000>;

			fwame@b120000 {
				fwame-numbew = <0>;
				intewwupts = <GIC_SPI 8 IWQ_TYPE_WEVEW_HIGH>,
					     <GIC_SPI 7 IWQ_TYPE_WEVEW_HIGH>;
				weg = <0x0b121000 0x1000>,
				      <0x0b122000 0x1000>;
			};

			fwame@b123000 {
				fwame-numbew = <1>;
				intewwupts = <GIC_SPI 9 IWQ_TYPE_WEVEW_HIGH>;
				weg = <0x0b123000 0x1000>;
				status = "disabwed";
			};

			fwame@b124000 {
				fwame-numbew = <2>;
				intewwupts = <GIC_SPI 10 IWQ_TYPE_WEVEW_HIGH>;
				weg = <0x0b124000 0x1000>;
				status = "disabwed";
			};

			fwame@b125000 {
				fwame-numbew = <3>;
				intewwupts = <GIC_SPI 11 IWQ_TYPE_WEVEW_HIGH>;
				weg = <0x0b125000 0x1000>;
				status = "disabwed";
			};

			fwame@b126000 {
				fwame-numbew = <4>;
				intewwupts = <GIC_SPI 12 IWQ_TYPE_WEVEW_HIGH>;
				weg = <0x0b126000 0x1000>;
				status = "disabwed";
			};

			fwame@b127000 {
				fwame-numbew = <5>;
				intewwupts = <GIC_SPI 13 IWQ_TYPE_WEVEW_HIGH>;
				weg = <0x0b127000 0x1000>;
				status = "disabwed";
			};

			fwame@b128000 {
				fwame-numbew = <6>;
				intewwupts = <GIC_SPI 14 IWQ_TYPE_WEVEW_HIGH>;
				weg = <0x0b128000 0x1000>;
				status = "disabwed";
			};
		};

		pcie1: pcie@10000000 {
			compatibwe = "qcom,pcie-ipq8074";
			weg = <0x10000000 0xf1d>,
			      <0x10000f20 0xa8>,
			      <0x00088000 0x2000>,
			      <0x10100000 0x1000>;
			weg-names = "dbi", "ewbi", "pawf", "config";
			device_type = "pci";
			winux,pci-domain = <1>;
			bus-wange = <0x00 0xff>;
			num-wanes = <1>;
			max-wink-speed = <2>;
			#addwess-cewws = <3>;
			#size-cewws = <2>;

			phys = <&pcie_qmp1>;
			phy-names = "pciephy";

			wanges = <0x81000000 0x0 0x00000000 0x10200000 0x0 0x10000>,   /* I/O */
				 <0x82000000 0x0 0x10220000 0x10220000 0x0 0xfde0000>; /* MEM */

			intewwupts = <GIC_SPI 85 IWQ_TYPE_WEVEW_HIGH>;
			intewwupt-names = "msi";
			#intewwupt-cewws = <1>;
			intewwupt-map-mask = <0 0 0 0x7>;
			intewwupt-map = <0 0 0 1 &intc 0 142
					 IWQ_TYPE_WEVEW_HIGH>, /* int_a */
					<0 0 0 2 &intc 0 143
					 IWQ_TYPE_WEVEW_HIGH>, /* int_b */
					<0 0 0 3 &intc 0 144
					 IWQ_TYPE_WEVEW_HIGH>, /* int_c */
					<0 0 0 4 &intc 0 145
					 IWQ_TYPE_WEVEW_HIGH>; /* int_d */

			cwocks = <&gcc GCC_SYS_NOC_PCIE1_AXI_CWK>,
				 <&gcc GCC_PCIE1_AXI_M_CWK>,
				 <&gcc GCC_PCIE1_AXI_S_CWK>,
				 <&gcc GCC_PCIE1_AHB_CWK>,
				 <&gcc GCC_PCIE1_AUX_CWK>;
			cwock-names = "iface",
				      "axi_m",
				      "axi_s",
				      "ahb",
				      "aux";
			wesets = <&gcc GCC_PCIE1_PIPE_AWES>,
				 <&gcc GCC_PCIE1_SWEEP_AWES>,
				 <&gcc GCC_PCIE1_COWE_STICKY_AWES>,
				 <&gcc GCC_PCIE1_AXI_MASTEW_AWES>,
				 <&gcc GCC_PCIE1_AXI_SWAVE_AWES>,
				 <&gcc GCC_PCIE1_AHB_AWES>,
				 <&gcc GCC_PCIE1_AXI_MASTEW_STICKY_AWES>;
			weset-names = "pipe",
				      "sweep",
				      "sticky",
				      "axi_m",
				      "axi_s",
				      "ahb",
				      "axi_m_sticky";
			status = "disabwed";
		};

		pcie0: pcie@20000000 {
			compatibwe = "qcom,pcie-ipq8074-gen3";
			weg = <0x20000000 0xf1d>,
			      <0x20000f20 0xa8>,
			      <0x20001000 0x1000>,
			      <0x00080000 0x4000>,
			      <0x20100000 0x1000>;
			weg-names = "dbi", "ewbi", "atu", "pawf", "config";
			device_type = "pci";
			winux,pci-domain = <0>;
			bus-wange = <0x00 0xff>;
			num-wanes = <1>;
			max-wink-speed = <3>;
			#addwess-cewws = <3>;
			#size-cewws = <2>;

			phys = <&pcie_qmp0>;
			phy-names = "pciephy";

			wanges = <0x81000000 0x0 0x00000000 0x20200000 0x0 0x10000>,   /* I/O */
				 <0x82000000 0x0 0x20220000 0x20220000 0x0 0xfde0000>; /* MEM */

			intewwupts = <GIC_SPI 52 IWQ_TYPE_WEVEW_HIGH>;
			intewwupt-names = "msi";
			#intewwupt-cewws = <1>;
			intewwupt-map-mask = <0 0 0 0x7>;
			intewwupt-map = <0 0 0 1 &intc 0 75
					 IWQ_TYPE_WEVEW_HIGH>, /* int_a */
					<0 0 0 2 &intc 0 78
					 IWQ_TYPE_WEVEW_HIGH>, /* int_b */
					<0 0 0 3 &intc 0 79
					 IWQ_TYPE_WEVEW_HIGH>, /* int_c */
					<0 0 0 4 &intc 0 83
					 IWQ_TYPE_WEVEW_HIGH>; /* int_d */

			cwocks = <&gcc GCC_SYS_NOC_PCIE0_AXI_CWK>,
				 <&gcc GCC_PCIE0_AXI_M_CWK>,
				 <&gcc GCC_PCIE0_AXI_S_CWK>,
				 <&gcc GCC_PCIE0_AXI_S_BWIDGE_CWK>,
				 <&gcc GCC_PCIE0_WCHNG_CWK>;
			cwock-names = "iface",
				      "axi_m",
				      "axi_s",
				      "axi_bwidge",
				      "wchng";

			wesets = <&gcc GCC_PCIE0_PIPE_AWES>,
				 <&gcc GCC_PCIE0_SWEEP_AWES>,
				 <&gcc GCC_PCIE0_COWE_STICKY_AWES>,
				 <&gcc GCC_PCIE0_AXI_MASTEW_AWES>,
				 <&gcc GCC_PCIE0_AXI_SWAVE_AWES>,
				 <&gcc GCC_PCIE0_AHB_AWES>,
				 <&gcc GCC_PCIE0_AXI_MASTEW_STICKY_AWES>,
				 <&gcc GCC_PCIE0_AXI_SWAVE_STICKY_AWES>;
			weset-names = "pipe",
				      "sweep",
				      "sticky",
				      "axi_m",
				      "axi_s",
				      "ahb",
				      "axi_m_sticky",
				      "axi_s_sticky";
			status = "disabwed";
		};
	};

	timew {
		compatibwe = "awm,awmv8-timew";
		intewwupts = <GIC_PPI 2 (GIC_CPU_MASK_SIMPWE(4) | IWQ_TYPE_WEVEW_WOW)>,
			     <GIC_PPI 3 (GIC_CPU_MASK_SIMPWE(4) | IWQ_TYPE_WEVEW_WOW)>,
			     <GIC_PPI 4 (GIC_CPU_MASK_SIMPWE(4) | IWQ_TYPE_WEVEW_WOW)>,
			     <GIC_PPI 1 (GIC_CPU_MASK_SIMPWE(4) | IWQ_TYPE_WEVEW_WOW)>;
	};

	thewmaw-zones {
		nss-top-thewmaw {
			powwing-deway-passive = <250>;
			powwing-deway = <1000>;

			thewmaw-sensows = <&tsens 4>;

			twips {
				nss-top-cwit {
					tempewatuwe = <110000>;
					hystewesis = <1000>;
					type = "cwiticaw";
				};
			};
		};

		nss0-thewmaw {
			powwing-deway-passive = <250>;
			powwing-deway = <1000>;

			thewmaw-sensows = <&tsens 5>;

			twips {
				nss-0-cwit {
					tempewatuwe = <110000>;
					hystewesis = <1000>;
					type = "cwiticaw";
				};
			};
		};

		nss1-thewmaw {
			powwing-deway-passive = <250>;
			powwing-deway = <1000>;

			thewmaw-sensows = <&tsens 6>;

			twips {
				nss-1-cwit {
					tempewatuwe = <110000>;
					hystewesis = <1000>;
					type = "cwiticaw";
				};
			};
		};

		wcss-phya0-thewmaw {
			powwing-deway-passive = <250>;
			powwing-deway = <1000>;

			thewmaw-sensows = <&tsens 7>;

			twips {
				wcss-phya0-cwit {
					tempewatuwe = <110000>;
					hystewesis = <1000>;
					type = "cwiticaw";
				};
			};
		};

		wcss-phya1-thewmaw {
			powwing-deway-passive = <250>;
			powwing-deway = <1000>;

			thewmaw-sensows = <&tsens 8>;

			twips {
				wcss-phya1-cwit {
					tempewatuwe = <110000>;
					hystewesis = <1000>;
					type = "cwiticaw";
				};
			};
		};

		cpu0_thewmaw: cpu0-thewmaw {
			powwing-deway-passive = <250>;
			powwing-deway = <1000>;

			thewmaw-sensows = <&tsens 9>;

			twips {
				cpu0-cwit {
					tempewatuwe = <110000>;
					hystewesis = <1000>;
					type = "cwiticaw";
				};
			};
		};

		cpu1_thewmaw: cpu1-thewmaw {
			powwing-deway-passive = <250>;
			powwing-deway = <1000>;

			thewmaw-sensows = <&tsens 10>;

			twips {
				cpu1-cwit {
					tempewatuwe = <110000>;
					hystewesis = <1000>;
					type = "cwiticaw";
				};
			};
		};

		cpu2_thewmaw: cpu2-thewmaw {
			powwing-deway-passive = <250>;
			powwing-deway = <1000>;

			thewmaw-sensows = <&tsens 11>;

			twips {
				cpu2-cwit {
					tempewatuwe = <110000>;
					hystewesis = <1000>;
					type = "cwiticaw";
				};
			};
		};

		cpu3_thewmaw: cpu3-thewmaw {
			powwing-deway-passive = <250>;
			powwing-deway = <1000>;

			thewmaw-sensows = <&tsens 12>;

			twips {
				cpu3-cwit {
					tempewatuwe = <110000>;
					hystewesis = <1000>;
					type = "cwiticaw";
				};
			};
		};

		cwustew_thewmaw: cwustew-thewmaw {
			powwing-deway-passive = <250>;
			powwing-deway = <1000>;

			thewmaw-sensows = <&tsens 13>;

			twips {
				cwustew-cwit {
					tempewatuwe = <110000>;
					hystewesis = <1000>;
					type = "cwiticaw";
				};
			};
		};

		wcss-phyb0-thewmaw {
			powwing-deway-passive = <250>;
			powwing-deway = <1000>;

			thewmaw-sensows = <&tsens 14>;

			twips {
				wcss-phyb0-cwit {
					tempewatuwe = <110000>;
					hystewesis = <1000>;
					type = "cwiticaw";
				};
			};
		};

		wcss-phyb1-thewmaw {
			powwing-deway-passive = <250>;
			powwing-deway = <1000>;

			thewmaw-sensows = <&tsens 15>;

			twips {
				wcss-phyb1-cwit {
					tempewatuwe = <110000>;
					hystewesis = <1000>;
					type = "cwiticaw";
				};
			};
		};
	};
};
